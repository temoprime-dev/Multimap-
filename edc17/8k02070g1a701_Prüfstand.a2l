ASAP2_VERSION 1 3
/begin PROJECT _9702_071D00 "ME97"
/begin HEADER "" VERSION "_9702_071D00" PROJECT_NO _9702_071D00 /end HEADER
/begin MODULE DIM ""
/begin MOD_COMMON "" BYTE_ORDER MSB_FIRST ALIGNMENT_BYTE 1 ALIGNMENT_WORD 2 ALIGNMENT_LONG 2 ALIGNMENT_FLOAT32_IEEE 4 /end MOD_COMMON
/begin CHARACTERISTIC AV_ACS_410h_MsgLost_DeBnc_Lim "" VALUE 0x1D1A8C dc_KwUb 255.0 DC_CNTR_U8 0.00 255.0 FORMAT "%5.1" /end CHARACTERISTIC
/begin CHARACTERISTIC AV_AMT_Creep_Trq_Max_Req "" VALUE 0x1D2FC6 dc_KwUb 191. DC_MMQ075_U8DB 0.00 191. FORMAT "%4.0" /end CHARACTERISTIC
/begin CHARACTERISTIC AV_CAN_MsgLost_ChkStrtTime "" VALUE 0x1D1A78 dc_KwUw 655.35 DC_TIME_10MS_U16 0.00 655.35 FORMAT "%6.2" /end CHARACTERISTIC
/begin CHARACTERISTIC AV_CCM_340h_MsgLost_DeBnc_Lim "" VALUE 0x1D1A8A dc_KwUb 255.0 DC_CNTR_U8 0.00 255.0 FORMAT "%5.1" /end CHARACTERISTIC
/begin CHARACTERISTIC AV_CGW_248h_MsgLost_DeBnc_Lim "" VALUE 0x1D1A88 dc_KwUb 255.0 DC_CNTR_U8 0.00 255.0 FORMAT "%5.1" /end CHARACTERISTIC
/begin CHARACTERISTIC AV_CGW_6FFh_MsgLost_DeBnc_Lim "" VALUE 0x1D1A6A dc_KwUb 255.0 DC_CNTR_U8 0.00 255.0 FORMAT "%5.1" /end CHARACTERISTIC
/begin CHARACTERISTIC AV_CSTCM_428h_MsgLost_DeBnc_Lim "" VALUE 0x1D1A86 dc_KwUb 255.0 DC_CNTR_U8 0.00 255.0 FORMAT "%5.1" /end CHARACTERISTIC
/begin CHARACTERISTIC AV_Dspl_408h_MsgLost_DeBnc_Lim "" VALUE 0x1D1A68 dc_KwUb 255.0 DC_CNTR_U8 0.00 255.0 FORMAT "%5.1" /end CHARACTERISTIC
/begin CHARACTERISTIC AV_EIL_240h_MsgLost_DeBnc_Lim "" VALUE 0x1D1A84 dc_KwUb 255.0 DC_CNTR_U8 0.00 255.0 FORMAT "%5.1" /end CHARACTERISTIC
/begin CHARACTERISTIC AV_Eng_Spd_Lim_Req "" VALUE 0x1D1A76 dc_KwUw 4000.00 DC_ROTSPD_S16 0.00 4000.00 FORMAT "%7.2" /end CHARACTERISTIC
/begin CHARACTERISTIC AV_ESM_230h_MsgLost_DeBnc_Lim "" VALUE 0x1D1A70 dc_KwUb 255.0 DC_CNTR_U8 0.00 255.0 FORMAT "%5.1" /end CHARACTERISTIC
/begin CHARACTERISTIC AV_ESP_200h_MsgLost_DeBnc_Lim "" VALUE 0x1D1A82 dc_KwUb 255.0 DC_CNTR_U8 0.00 255.0 FORMAT "%5.1" /end CHARACTERISTIC
/begin CHARACTERISTIC AV_ESP_208h_MsgLost_DeBnc_Lim "" VALUE 0x1D1A80 dc_KwUb 255.0 DC_CNTR_U8 0.00 255.0 FORMAT "%5.1" /end CHARACTERISTIC
/begin CHARACTERISTIC AV_ESP_300h_MsgLost_DeBnc_Lim "" VALUE 0x1D1A7E dc_KwUb 255.0 DC_CNTR_U8 0.00 255.0 FORMAT "%5.1" /end CHARACTERISTIC
/begin CHARACTERISTIC AV_ESP_328h_MsgLost_DeBnc_Lim "" VALUE 0x1D1A7C dc_KwUb 255.0 DC_CNTR_U8 0.00 255.0 FORMAT "%5.1" /end CHARACTERISTIC
/begin CHARACTERISTIC AV_SCT_238h_MsgLost_DeBnc_Lim "" VALUE 0x1D1A7A dc_KwUb 255.0 DC_CNTR_U8 0.00 255.0 FORMAT "%5.1" /end CHARACTERISTIC
/begin CHARACTERISTIC AV_TCM_218h_MsgLost_DeBnc_Lim "" VALUE 0x1D1A6E dc_KwUb 255.0 DC_CNTR_U8 0.00 255.0 FORMAT "%5.1" /end CHARACTERISTIC
/begin CHARACTERISTIC AV_TCM_418h_MsgLost_DeBnc_Lim "" VALUE 0x1D1A6C dc_KwUb 255.0 DC_CNTR_U8 0.00 255.0 FORMAT "%5.1" /end CHARACTERISTIC
/begin CHARACTERISTIC AV_TempCoolingWater_HighLim "" VALUE 0x1D1A74 dc_KwSw 8191.875 DC_TEMP_S16 -4096.000 4095.875 FORMAT "%8.3" /end CHARACTERISTIC
/begin CHARACTERISTIC AV_TempCoolingWater_LowLim "" VALUE 0x1D1A72 dc_KwSw 8191.875 DC_TEMP_S16 -4096.000 4095.875 FORMAT "%8.3" /end CHARACTERISTIC
/begin CHARACTERISTIC CL30LINE "30. Linie der Klassentabelle" VAL_BLK 0x1D4218 KwbUb 255.0 dez 0.00 255.0 FORMAT "%5.1" NUMBER 13 /end CHARACTERISTIC
/begin CHARACTERISTIC CL31LINE "31. Linie der Klassentabelle" VAL_BLK 0x1D4225 KwbUb 255.0 dez 0.00 255.0 FORMAT "%5.1" NUMBER 13 /end CHARACTERISTIC
/begin CHARACTERISTIC CL32LINE "32. Linie der Klassentabelle" VAL_BLK 0x1D4232 KwbUb 255.0 dez 0.00 255.0 FORMAT "%5.1" NUMBER 13 /end CHARACTERISTIC
/begin CHARACTERISTIC CL33LINE "33. Linie der Klassentabelle" VAL_BLK 0x1D423F KwbUb 255.0 dez 0.00 255.0 FORMAT "%5.1" NUMBER 13 /end CHARACTERISTIC
/begin CHARACTERISTIC CL34LINE "34. Linie der Klassentabelle" VAL_BLK 0x1D424C KwbUb 255.0 dez 0.00 255.0 FORMAT "%5.1" NUMBER 13 /end CHARACTERISTIC
/begin CHARACTERISTIC CL35LINE "35. Linie der Klassentabelle" VAL_BLK 0x1D4259 KwbUb 255.0 dez 0.00 255.0 FORMAT "%5.1" NUMBER 13 /end CHARACTERISTIC
/begin CHARACTERISTIC CL36LINE "36. Linie der Klassentabelle" VAL_BLK 0x1D4266 KwbUb 255.0 dez 0.00 255.0 FORMAT "%5.1" NUMBER 13 /end CHARACTERISTIC
/begin CHARACTERISTIC CL37LINE "37. Linie der Klassentabelle" VAL_BLK 0x1D4273 KwbUb 255.0 dez 0.00 255.0 FORMAT "%5.1" NUMBER 13 /end CHARACTERISTIC
/begin CHARACTERISTIC CL38LINE "38. Linie der Klassentabelle" VAL_BLK 0x1D4280 KwbUb 255.0 dez 0.00 255.0 FORMAT "%5.1" NUMBER 13 /end CHARACTERISTIC
/begin CHARACTERISTIC CL39LINE "39. Linie der Klassentabelle" VAL_BLK 0x1D428D KwbUb 255.0 dez 0.00 255.0 FORMAT "%5.1" NUMBER 13 /end CHARACTERISTIC
/begin CHARACTERISTIC CWBGMSZS "Codewort f¸r die BGMSZS" VALUE 0x1C2CF6 KwUb 255.0 DEZ 0.00 255.0 FORMAT "%5.1" /end CHARACTERISTIC
/begin CHARACTERISTIC CWBGRLP "Codewort Konfiguration Funktion BGRLP" VALUE 0x1C2CFC KwUb 255.0 dez 0.00 255.0 FORMAT "%5.1" /end CHARACTERISTIC
/begin CHARACTERISTIC CWBGTABST "Codewort f¸r Abstellzeitermittlung" VALUE 0x1CED92 KwWU8 255.0 dez 0.00 255.0 FORMAT "%5.1" /end CHARACTERISTIC
/begin CHARACTERISTIC CWBGWNWVFA "Codewort Nockenwellen-Istwertverfeinerung (%BGWNWVFA)" VALUE 0x1C3B38 KwUb 255.0 dez 0.00 255.0 FORMAT "%5.1" /end CHARACTERISTIC
/begin CHARACTERISTIC CWBGWNWVFE "Codewort Nockenwellen-Istwertverfeinerung (%BGWNWVFE)" VALUE 0x1C3B2A KwUb 255.0 dez 0.00 255.0 FORMAT "%5.1" /end CHARACTERISTIC
/begin CHARACTERISTIC CWBGWPR "Codewort Konfiguration Funktion BGWPR" VALUE 0x1C3392 KwUb 255.0 dez 0.00 255.0 FORMAT "%5.1" /end CHARACTERISTIC
/begin CHARACTERISTIC CWKONGTO "Codewort f¸r Konfiguration Grˆﬂe Temperatur (Motor-)÷l" VALUE 0x1CEA2C KwUb 255.0 dez 0.00 255.0 FORMAT "%5.1" /end CHARACTERISTIC
/begin CHARACTERISTIC CWPIRGAP "Codewort Applikation BGPIRG" VALUE 0x1C87D6 KwUb 255.0 dez 0.00 255.0 FORMAT "%5.1" /end CHARACTERISTIC
/begin CHARACTERISTIC CWTEMPK "Codeword f¸r Adressierung FWFTBRTA (tans/evtmod)" VALUE 0x1CA08C KwUb 255.0 dez 0.00 255.0 FORMAT "%5.1" /end CHARACTERISTIC
/begin CHARACTERISTIC DDRLDKZU "Deltadifferenz zwischen rl aus Haupt- und Nebenlastsignal" VALUE 0x1C2CF8 KwSw 1535.977 rel_sw_q0p0234 -768.0000 767.9766 FORMAT "%8.4" /end CHARACTERISTIC
/begin CHARACTERISTIC DEVTMAGR "Offset f¸r evtmod abh‰ngig von tsges_w bei hoher tans verursacht d. AGR" CURVE 0x1CA186 KlASwSstSwWSw 49151.25 temp_sw_q0p75 -24576.00 24575.25 FORMAT "%8.2"
 /begin AXIS_DESCR STD_AXIS tsr_w temp_sw_q0p75 8 -24576.00 24575.25 FORMAT "%8.2" DEPOSIT ABSOLUTE /end AXIS_DESCR
/end CHARACTERISTIC
/begin CHARACTERISTIC DNWVSMN "Delta Nockenwellenverstellschwerpunkt Minimum" VALUE 0x1C87D8 KwSw 511.9922 kw_sw_q0p0078 -256.0000 255.9922 FORMAT "%8.4" /end CHARACTERISTIC
/begin CHARACTERISTIC DRLDYNU "drl-Schwellwert f¸r te-Nachspritzer/Reduktion" VALUE 0x1C3396 KwSw 1535.977 rel_sw_q0p0234 -768.0000 767.9766 FORMAT "%8.4" /end CHARACTERISTIC
/begin CHARACTERISTIC DRLMIN "Min. F¸llungs‰nderung zur Auslˆsung eines Nachspritzers" VALUE 0x1C3398 KwSw 1535.977 rel_sw_q0p0234 -768.0000 767.9766 FORMAT "%8.4" /end CHARACTERISTIC
/begin CHARACTERISTIC DRLRLPU "Delta rl f¸r rlp - Untergrenze" VALUE 0x1C2CFE KwUw 1535.977 rel_uw_q0p0234 0.00 1535.977 FORMAT "%8.3" /end CHARACTERISTIC
/begin CHARACTERISTIC DTATMSTOL "Delta  Ansauglufttemperatur zu Starttemperatur des Motors" VALUE 0x1CEA2D KwUb 191.3 temp_ub_b191p25 0.00 191.3 FORMAT "%5.1" /end CHARACTERISTIC
/begin CHARACTERISTIC DTEPRU "delta-te-Schwelle fuer Nachspritzer-/ti-Reduktion erkannt" VALUE 0x1C339A KwUw 65.53500 t1p0usxms 0.00 65.53500 FORMAT "%8.5" /end CHARACTERISTIC
/begin CHARACTERISTIC DTMABSTOL "Delta  Motortemperatur nach Abstellen zu Start des Motors" VALUE 0x1CEA2E KwUb 191.3 temp_ub_b191p25 0.00 191.3 FORMAT "%5.1" /end CHARACTERISTIC
/begin CHARACTERISTIC DTMTATUM "Delta  Motor-/Ansauglufttemperatur f¸r Aktualisierung Umgebungstemp.-Berechnung" VALUE 0x1CEA44 KwWU8 191.3 temp_ub_b191p25 0.00 191.3 FORMAT "%5.1" /end CHARACTERISTIC
/begin CHARACTERISTIC DTMTOLOFF "Delta  Motortemperatur f¸r Initialisierung ÷ltemperaturberechnung" VALUE 0x1CEA2F KwUb 191.3 temp_ub_b191p25 0.00 191.3 FORMAT "%5.1" /end CHARACTERISTIC
/begin CHARACTERISTIC DWPR "Delta Pr‰diktionswinkel ohne Nachspritzer/ti-Reduktion" VALUE 0x1C3393 KwSb 1530. kw_q6 -768.0 762.0 FORMAT "%5.1" /end CHARACTERISTIC
/begin CHARACTERISTIC DWPRNSP "Delta Pr‰diktionswinkel bei Nachspritzerfreigabe" VALUE 0x1C3394 KwSb 1530. kw_q6 -768.0 762.0 FORMAT "%5.1" /end CHARACTERISTIC
/begin CHARACTERISTIC ETAWSSLPTM "Wirkungsgrad des W‰rmestroms durch Sekund‰rluft in Abh. von tmst" CURVE 0x1CD0F0 KlAxU8SstxU8WU8 100.0 rel_ub_b200 0.00 100.0 FORMAT "%5.1"
 /begin AXIS_DESCR STD_AXIS tmst temp_ub_q0p75_o48 4 -48.00 143.3 FORMAT "%5.1" DEPOSIT ABSOLUTE /end AXIS_DESCR
/end CHARACTERISTIC
/begin CHARACTERISTIC EVTMODO "Offset f¸r evtmod abh‰ngig von gefilterter Motortemperatur" CURVE 0x1CA090 KlAUbSstUbWUb 191.3 temp_ub_q0p75_o48 -48.00 143.3 FORMAT "%5.1"
 /begin AXIS_DESCR STD_AXIS tmotfil temp_ub_q0p75_o48 12 -48.00 143.3 FORMAT "%5.1" DEPOSIT ABSOLUTE /end AXIS_DESCR
/end CHARACTERISTIC
/begin CHARACTERISTIC FAKTABGM "Wichtungsfaktor f¸r tabgm (Abgastemperatur)  zur Berechnung der stat. Brennraumt" VALUE 0x1CA0A9 KwUb 1.992 fak_ub_b2 0.00 1.992 FORMAT "%5.3" /end CHARACTERISTIC
/begin CHARACTERISTIC FDVANS "Temperaturfaktor f¸r Drosselventildurchfluﬂ" CURVE 0x1CA0AC KlAUbSstUbWUb 1.992 fak_ub_b2 0.00 1.992 FORMAT "%5.3"
 /begin AXIS_DESCR STD_AXIS tans temp_ub_q0p75_o48 8 -48.00 143.3 FORMAT "%5.1" DEPOSIT ABSOLUTE /end AXIS_DESCR
/end CHARACTERISTIC
/begin CHARACTERISTIC FGDPSMPDVS "Faktor Gewichtung Steigung extrap. Saugrohrdruck / Saugrohrdruck aus DK" VALUE 0x1C2D00 KwUw 0.9999847 fak_uw_b1 0.00 0.9999847 FORMAT "%9.7" /end CHARACTERISTIC
/begin CHARACTERISTIC FKL2HYSTMN "untere Hystereseschwelle f¸r fkl2_w" VALUE 0x1C87DA KwUw 0.9999847 fak_uw_b1 0.00 0.9999847 FORMAT "%9.7" /end CHARACTERISTIC
/begin CHARACTERISTIC FKL2HYSTMX "obere Hystereseschwelle f¸r fkl2_w" VALUE 0x1C87DC KwUw 0.9999847 fak_uw_b1 0.00 0.9999847 FORMAT "%9.7" /end CHARACTERISTIC
/begin CHARACTERISTIC FKV1FVMX "Korrekturfaktor Fahrzeuggeschwindigkeit V1 f¸r VMAX-Regelung" VALUE 0x1C6B32 KwUb 2.000 fak_q0p007843 0.00 2.000 FORMAT "%5.3" /end CHARACTERISTIC
/begin CHARACTERISTIC FLBKKLP2 "Umschaltschwelle Faktor Ladungsbewegung f¸r LBK = Klappe 2" VALUE 0x1C87DE KwUw 0.9999847 fak_uw_b1 0.00 0.9999847 FORMAT "%9.7" /end CHARACTERISTIC
/begin CHARACTERISTIC FLTEFUEL "Faktor Anteil TEV Strom, der direkt ins Saugrohr strˆmt" CURVE 0x1CDDA4 KlAUbSstUbWUb 0.9961 fak_ub_b1 0.00 0.9961 /begin AXIS_DESCR STD_AXIS qltefil fak_ub_b1 4 0.00 0.9961 DEPOSIT ABSOLUTE /end AXIS_DESCR /end CHARACTERISTIC
/begin CHARACTERISTIC FMLZKRST "Faktor 1/(Rho Kraftstoff[kg/l] * 14,7)  [l/kg]" VALUE 0x1CE188 KwUb 0.9961 fak_ub_b1 0.00 0.9961 /end CHARACTERISTIC
/begin CHARACTERISTIC FMSLOFF "Schwelle Ausr‰umen der Sekund‰rluft beendet" VALUE 0x1CD100 KwWU8 0.9961 fak_ub_b1 0.00 0.9961 /end CHARACTERISTIC
/begin CHARACTERISTIC FMSRHOL "Dichtekorrektur der Sekund‰rluftmasse" CURVE 0x1CD0E2 KlAxU8SstxU16WU8 1.992 fak_ub_b2 0.00 1.992 FORMAT "%5.3"
 /begin AXIS_DESCR STD_AXIS frhokor_w fak_uw_b4 4 0.00 3.999939 FORMAT "%8.6" DEPOSIT ABSOLUTE /end AXIS_DESCR
/end CHARACTERISTIC
/begin CHARACTERISTIC FPVMXP "Faktor maximales Druckverh‰ltnis fuer Lastpraediktion" VALUE 0x1C2D02 KwUw 1.999969 fak_uw_b2 0.00 1.999969 FORMAT "%8.6" /end CHARACTERISTIC
/begin CHARACTERISTIC FPVMXST "Faktor maximales Druckverh‰ltnis im Start" VALUE 0x1C87E0 KwUw 3.999939 fak_uw_b4 0.00 3.999939 FORMAT "%8.6" /end CHARACTERISTIC
/begin CHARACTERISTIC FRLKEVT "Korrektur max. rl in Abh‰ngigkeit der Ventiltemperatur" CURVE 0x1CA854 KlAxU8SstxU8WU16 1.999969 fak_uw_b2 0.00 1.999969 FORMAT "%8.6"
 /begin AXIS_DESCR STD_AXIS evtmod temp_ub_q0p75_o48 6 -48.00 143.3 FORMAT "%5.1" DEPOSIT ABSOLUTE /end AXIS_DESCR
/end CHARACTERISTIC
/begin CHARACTERISTIC FTOVKRSLLA "Faktor Temperaturoffset im Kr¸mmer durch SL-Einblasung in Abh. von Motorlambda" CURVE 0x1CD0AE KlAxU8SstxU16WU16 0.9999847 fak_uw_b1 0.00 0.9999847 FORMAT "%9.7"
 /begin AXIS_DESCR STD_AXIS lamsbg_w fak_uw_b16 4 0.00 15.99976 FORMAT "%8.5" DEPOSIT ABSOLUTE /end AXIS_DESCR
/end CHARACTERISTIC
/begin CHARACTERISTIC FUMRMV "Faktor Dichte der Luft" VALUE 0x1CDDAD KwUb 1.992 dichte_ub_b2 0.00 1.992 FORMAT "%5.3" /end CHARACTERISTIC
/begin CHARACTERISTIC FUMSTEK "Faktor Umschaltung auf Kennfeld (wdk/n) zur Berechnung Massenstrom TEV" VALUE 0x1CDDAE KwUb 0.5000 fak_ub_b2 0.00 0.5000 /end CHARACTERISTIC
/begin CHARACTERISTIC FUPSRLMN "Umrechnungsfaktor Druck auf F¸llung Minimum" VALUE 0x1C87E2 KwUw 0.2999954 rel_uw_b0p3 0.00 0.2999954 FORMAT "%9.7" /end CHARACTERISTIC
/begin CHARACTERISTIC FUPSRLMX "Umrechnungsfaktor Druck auf F¸llung Maximum" VALUE 0x1C87E4 KwUw 0.2999954 rel_uw_b0p3 0.00 0.2999954 FORMAT "%9.7" /end CHARACTERISTIC
/begin CHARACTERISTIC FWFTBRTA "Wichtung ftbr in Abh‰ngigkeit von tans" CURVE 0x1CA0C0 KlAUbSstUbWUb 1.992 fak_ub_b2 0.00 1.992 FORMAT "%5.3"
 /begin AXIS_DESCR STD_AXIS tempin temp_ub_q0p75_o48 14 -48.00 143.3 FORMAT "%5.1" DEPOSIT ABSOLUTE /end AXIS_DESCR
/end CHARACTERISTIC
/begin CHARACTERISTIC FWGDMBR "Md-Soll R¸ckw‰rtsgang aus der Funktion Momentenbegrenzung" VALUE 0x1D1A9E dc_KwSw 4095.938 DC_TRQ_S16 -2048.000 2047.938 FORMAT "%8.3" /end CHARACTERISTIC
/begin CHARACTERISTIC FWLKFTBR "Warmlaufkorrektur f¸r Brennraumtemperaturmodell" CURVE 0x1CA0E0 KlAUbSstUbWUb 1.992 fak_ub_b2 0.00 1.992 FORMAT "%5.3"
 /begin AXIS_DESCR STD_AXIS tmotdif temp_ub_q0p75_o48 8 -48.00 143.3 FORMAT "%5.1" DEPOSIT ABSOLUTE /end AXIS_DESCR
/end CHARACTERISTIC
/begin CHARACTERISTIC FWNWVSAP "Nockenwellen Verstellschwerpunkt Applikationswert" VALUE 0x1C87E6 KwUw 1.000000 fak_uw_b2 0.00 1.000000 FORMAT "%8.6" /end CHARACTERISTIC
/begin CHARACTERISTIC FWNWVSO "Faktor Winkel Nockenwellenverstellschwerpunkt Obergrenze" VALUE 0x1C87E8 KwUw 1.000000 fak_uw_b2 0.00 1.000000 FORMAT "%8.6" /end CHARACTERISTIC
/begin CHARACTERISTIC FWNWVSU "Faktor Winkel Nockenwellenverstellschwerpunkt Untergrenze" VALUE 0x1C87EA KwUw 1.000000 fak_uw_b2 0.00 1.000000 FORMAT "%8.6" /end CHARACTERISTIC
/begin CHARACTERISTIC FW_LP_ENG_SPD "" VALUE 0x1D1AAE dc_KwUw 65.535 DC_TIME_1MS_U16 0.00 65.535 FORMAT "%6.3" /end CHARACTERISTIC
/begin CHARACTERISTIC IMLSLOFF "Schwelle Luftmassenintegral f¸r Ende Sekund‰rluft im Abgas" VALUE 0x1CD0FA KwWU16 4660.267 m_uw_b4660 0.00 4660.267 FORMAT "%8.3" /end CHARACTERISTIC
/begin CHARACTERISTIC IMLSLON "Schwelle Luftmassenintegral f¸r Anfang Sekund‰rluft im Abgas" VALUE 0x1CD0FC KwWU16 4660.267 m_uw_b4660 0.00 4660.267 FORMAT "%8.3" /end CHARACTERISTIC
/begin CHARACTERISTIC IMTUMTA "Schwelle integrierte Luftmasse f¸r Bestimmung Umgebungstemperatur" VALUE 0x1CEA3E KwWU16 23.30133 m_uw_b23p3 0.00 23.30133 FORMAT "%8.5" /end CHARACTERISTIC
/begin CHARACTERISTIC KAFLTESG "Ausfuﬂkonstante Leitung TEV-Saugrohr" VALUE 0x1CDE2A KwUw 28.79956 fak1_q4p3945Em4 0.00 28.79956 FORMAT "%8.5" /end CHARACTERISTIC
/begin CHARACTERISTIC KFAFTE "Kennfeld Durchfluﬂcharkteristik TEV + Leitung AKF-TEV" MAP 0x1CDDB0 KfAxUbAyUbSstxUbSstyUbWUb 1.984 fak_ub_b2 0.007813 1.992 FORMAT "%5.3"
 /begin AXIS_DESCR STD_AXIS nmot nmot_ub_q40 10 0.00 10200. FORMAT "%5.0" DEPOSIT ABSOLUTE /end AXIS_DESCR
 /begin AXIS_DESCR STD_AXIS wdkbate relDK_ub_b100 10 0.00 100.0 FORMAT "%5.1" DEPOSIT ABSOLUTE /end AXIS_DESCR
/end CHARACTERISTIC
/begin CHARACTERISTIC KFDFBTMN "Faktor Dynamikanteil Brennraumtemperaturmodell f¸r negative Gradienten" MAP 0x1CA1A8 KfAxUbAyUbSstxUwSstyUbWUb 1.992 fak_ub_b2 0.00 1.992 FORMAT "%5.3"
 /begin AXIS_DESCR STD_AXIS tabgm_w temp_uw_q0p0195_o50 6 -50.00000 1229.980 FORMAT "%8.3" DEPOSIT ABSOLUTE /end AXIS_DESCR
 /begin AXIS_DESCR STD_AXIS nmot nmot_ub_q40 8 0.00 10200. FORMAT "%5.0" DEPOSIT ABSOLUTE /end AXIS_DESCR
/end CHARACTERISTIC
/begin CHARACTERISTIC KFDFBTMP "Faktor Dynamikanteil Brennraumtemperaturmodell f¸r positive Gradienten" MAP 0x1CA1EE KfAxUbAyUbSstxUwSstyUbWUb 1.992 fak_ub_b2 0.00 1.992 FORMAT "%5.3"
 /begin AXIS_DESCR STD_AXIS tabgm_w temp_uw_q0p0195_o50 6 -50.00000 1229.980 FORMAT "%8.3" DEPOSIT ABSOLUTE /end AXIS_DESCR
 /begin AXIS_DESCR STD_AXIS nmot nmot_ub_q40 8 0.00 10200. FORMAT "%5.0" DEPOSIT ABSOLUTE /end AXIS_DESCR
/end CHARACTERISTIC
/begin CHARACTERISTIC KFFMSML "Abgasgegendruckkorrektur der Sekund‰rluftmasse" MAP 0x1CD05C KfAxU8AyU8SstxU8SstyU8WU8 1.992 fak_ub_b2 0.00 1.992 FORMAT "%5.3"
 /begin AXIS_DESCR STD_AXIS nmot nmot_ub_q40 8 0.00 10200. FORMAT "%5.0" DEPOSIT ABSOLUTE /end AXIS_DESCR
 /begin AXIS_DESCR STD_AXIS rl rel_ub_q0p75 8 0.00 191.3 FORMAT "%5.1" DEPOSIT ABSOLUTE /end AXIS_DESCR
/end CHARACTERISTIC
/begin CHARACTERISTIC KFFUPSRLK "fupsrl-Korrektur bei groﬂen Lasten" MAP 0x1C87EC KfAxUwAyUwSstxUwSstyUwWUw 1.999969 fak_uw_b2 0.00 1.999969 FORMAT "%8.6"
 /begin AXIS_DESCR STD_AXIS rlfg_w rel_uw_q0p0234 12 0.00 1535.977 FORMAT "%8.3" DEPOSIT ABSOLUTE /end AXIS_DESCR
 /begin AXIS_DESCR STD_AXIS nmot_w nmot_uw_q0p25 12 0.00 16383.75 FORMAT "%8.2" DEPOSIT ABSOLUTE /end AXIS_DESCR
/end CHARACTERISTIC
/begin CHARACTERISTIC KFPIRGRES "Partialdruck residuales Restgas im Brennraum" MAP 0x1C8940 KfAxUwAyUwSstxSwSstyUwWUw 2559.961 p_uw_q0p039 0.00 2559.961 FORMAT "%8.3"
 /begin AXIS_DESCR STD_AXIS wnwa_w kw_q0p0078 7 -256.0000 255.9922 FORMAT "%8.4" DEPOSIT ABSOLUTE /end AXIS_DESCR
 /begin AXIS_DESCR STD_AXIS nmot_w nmot_uw_q0p25 14 0.00 16383.75 FORMAT "%8.2" DEPOSIT ABSOLUTE /end AXIS_DESCR
/end CHARACTERISTIC
/begin CHARACTERISTIC KFPRGA "interner Abgaspartialdruck abh‰ngig von NW-Verstellung(Grund-KF) bei Auslaﬂ-NWS" MAP 0x1C8A32 KfAxUwAyUwSstxUwSstyUwWUw 2559.961 p_uw_q0p039 0.00 2559.961 FORMAT "%8.3"
 /begin AXIS_DESCR STD_AXIS wnwvu_w kw_q0p0078 10 0.00 511.9922 FORMAT "%8.4" DEPOSIT ABSOLUTE /end AXIS_DESCR
 /begin AXIS_DESCR STD_AXIS nmot_w nmot_uw_q0p25 14 0.00 16383.75 FORMAT "%8.2" DEPOSIT ABSOLUTE /end AXIS_DESCR
/end CHARACTERISTIC
/begin CHARACTERISTIC KFPRGE "interner Abgaspartialdruck abh‰ngig von NW-Verstellung(Grund-KF) bei Einlaﬂ-NWS" MAP 0x1C8B7E KfAxUwAyUwSstxUwSstyUwWUw 2559.961 p_uw_q0p039 0.00 2559.961 FORMAT "%8.3"
 /begin AXIS_DESCR STD_AXIS wnwvu_w kw_q0p0078 10 0.00 511.9922 FORMAT "%8.4" DEPOSIT ABSOLUTE /end AXIS_DESCR
 /begin AXIS_DESCR STD_AXIS nmot_w nmot_uw_q0p25 14 0.00 16383.75 FORMAT "%8.2" DEPOSIT ABSOLUTE /end AXIS_DESCR
/end CHARACTERISTIC
/begin CHARACTERISTIC KFPRGKL12A "interner Abgaspartialdruck abh. von NW-Verst. bei akt.1.u. 2.Klappe(Auslaﬂ-NWS)" MAP 0x1C8CCA KfAxUwAyUwSstxUwSstyUwWUw 2559.961 p_uw_q0p039 0.00 2559.961 FORMAT "%8.3"
 /begin AXIS_DESCR STD_AXIS wnwvu_w kw_q0p0078 10 0.00 511.9922 FORMAT "%8.4" DEPOSIT ABSOLUTE /end AXIS_DESCR
 /begin AXIS_DESCR STD_AXIS nmot_w nmot_uw_q0p25 14 0.00 16383.75 FORMAT "%8.2" DEPOSIT ABSOLUTE /end AXIS_DESCR
/end CHARACTERISTIC
/begin CHARACTERISTIC KFPRGKL12E "interner Abgaspartialdruck abh. von NW-Verst. bei akt.1.u. 2.Klappe(Einlaﬂ-NWS)" MAP 0x1C8E16 KfAxUwAyUwSstxUwSstyUwWUw 2559.961 p_uw_q0p039 0.00 2559.961 FORMAT "%8.3"
 /begin AXIS_DESCR STD_AXIS wnwvu_w kw_q0p0078 10 0.00 511.9922 FORMAT "%8.4" DEPOSIT ABSOLUTE /end AXIS_DESCR
 /begin AXIS_DESCR STD_AXIS nmot_w nmot_uw_q0p25 14 0.00 16383.75 FORMAT "%8.2" DEPOSIT ABSOLUTE /end AXIS_DESCR
/end CHARACTERISTIC
/begin CHARACTERISTIC KFPRGKL2A "interner Abgaspartialdruck abh. von NW-Verstellung bei akt. 2.Klappe(Auslaﬂ-NWS)" MAP 0x1C8F62 KfAxUwAyUwSstxUwSstyUwWUw 2559.961 p_uw_q0p039 0.00 2559.961 FORMAT "%8.3"
 /begin AXIS_DESCR STD_AXIS wnwvu_w kw_q0p0078 10 0.00 511.9922 FORMAT "%8.4" DEPOSIT ABSOLUTE /end AXIS_DESCR
 /begin AXIS_DESCR STD_AXIS nmot_w nmot_uw_q0p25 14 0.00 16383.75 FORMAT "%8.2" DEPOSIT ABSOLUTE /end AXIS_DESCR
/end CHARACTERISTIC
/begin CHARACTERISTIC KFPRGKL2E "interner Abgaspartialdruck abh. von NW-Verstellung bei akt. 2.Klappe(Einlaﬂ-NWS)" MAP 0x1C90AE KfAxUwAyUwSstxUwSstyUwWUw 2559.961 p_uw_q0p039 0.00 2559.961 FORMAT "%8.3"
 /begin AXIS_DESCR STD_AXIS wnwvu_w kw_q0p0078 10 0.00 511.9922 FORMAT "%8.4" DEPOSIT ABSOLUTE /end AXIS_DESCR
 /begin AXIS_DESCR STD_AXIS nmot_w nmot_uw_q0p25 14 0.00 16383.75 FORMAT "%8.2" DEPOSIT ABSOLUTE /end AXIS_DESCR
/end CHARACTERISTIC
/begin CHARACTERISTIC KFPRGSUA "interner Abgaspartialdruck abh. von NW-Verstellung bei sumode=1 (Auslaﬂ-NWS)" MAP 0x1C91FA KfAxUwAyUwSstxUwSstyUwWUw 2559.961 p_uw_q0p039 0.00 2559.961 FORMAT "%8.3"
 /begin AXIS_DESCR STD_AXIS wnwvu_w kw_q0p0078 10 0.00 511.9922 FORMAT "%8.4" DEPOSIT ABSOLUTE /end AXIS_DESCR
 /begin AXIS_DESCR STD_AXIS nmot_w nmot_uw_q0p25 14 0.00 16383.75 FORMAT "%8.2" DEPOSIT ABSOLUTE /end AXIS_DESCR
/end CHARACTERISTIC
/begin CHARACTERISTIC KFPRGSUE "interner Abgaspartialdruck abh. von NW-Verstellung bei sumode=1 (Einlaﬂ-NWS)" MAP 0x1C9346 KfAxUwAyUwSstxUwSstyUwWUw 2559.961 p_uw_q0p039 0.00 2559.961 FORMAT "%8.3"
 /begin AXIS_DESCR STD_AXIS wnwvu_w kw_q0p0078 10 0.00 511.9922 FORMAT "%8.4" DEPOSIT ABSOLUTE /end AXIS_DESCR
 /begin AXIS_DESCR STD_AXIS nmot_w nmot_uw_q0p25 14 0.00 16383.75 FORMAT "%8.2" DEPOSIT ABSOLUTE /end AXIS_DESCR
/end CHARACTERISTIC
/begin CHARACTERISTIC KFSTTANKR "Verst‰rkungsfaktor f¸r K-TP Filterung Tankf¸llstand rechts" VALUE 0x1CE189 KwUb 0.9961 fak_ub_b1 0.00 0.9961 /end CHARACTERISTIC
/begin CHARACTERISTIC KFUPSRLKNW "fupsrl-Korrektur bei groﬂen Lasten bei verstellter Nockenwelle" MAP 0x1C9492 KfAxUwAyUwSstxUwSstyUwWUw 1.999969 fak_uw_b2 0.00 1.999969 FORMAT "%8.6"
 /begin AXIS_DESCR STD_AXIS rlfg_w rel_uw_q0p0234 12 0.00 1535.977 FORMAT "%8.3" DEPOSIT ABSOLUTE /end AXIS_DESCR
 /begin AXIS_DESCR STD_AXIS nmot_w nmot_uw_q0p25 12 0.00 16383.75 FORMAT "%8.2" DEPOSIT ABSOLUTE /end AXIS_DESCR
/end CHARACTERISTIC
/begin CHARACTERISTIC KFURLA "Umrechnungsfaktor von ps->rl abh‰ngig von NW-Verstell. (Grund-KF) bei Auslaﬂ-NW" MAP 0x1C95E6 KfAxUwAyUwSstxUwSstyUwWUw 0.2999954 rel_uw_b0p3 0.00 0.2999954 FORMAT "%9.7"
 /begin AXIS_DESCR STD_AXIS wnwvu_w kw_q0p0078 10 0.00 511.9922 FORMAT "%8.4" DEPOSIT ABSOLUTE /end AXIS_DESCR
 /begin AXIS_DESCR STD_AXIS nmot_w nmot_uw_q0p25 14 0.00 16383.75 FORMAT "%8.2" DEPOSIT ABSOLUTE /end AXIS_DESCR
/end CHARACTERISTIC
/begin CHARACTERISTIC KFURLE "Umrechnungsfaktor von ps->rl abh‰ngig von NW-Verstell. (Grund-KF) bei Einlaﬂ-NW" MAP 0x1C9732 KfAxUwAyUwSstxUwSstyUwWUw 0.2999954 rel_uw_b0p3 0.00 0.2999954 FORMAT "%9.7"
 /begin AXIS_DESCR STD_AXIS wnwvu_w kw_q0p0078 10 0.00 511.9922 FORMAT "%8.4" DEPOSIT ABSOLUTE /end AXIS_DESCR
 /begin AXIS_DESCR STD_AXIS nmot_w nmot_uw_q0p25 14 0.00 16383.75 FORMAT "%8.2" DEPOSIT ABSOLUTE /end AXIS_DESCR
/end CHARACTERISTIC
/begin CHARACTERISTIC KFURLKL12A "Umrech.-faktor von ps->rl abh.von NW-Verstell.bei akt.1.u 2.Klappe bei Auslaﬂ-NW" MAP 0x1C987E KfAxUwAyUwSstxUwSstyUwWUw 0.2999954 rel_uw_b0p3 0.00 0.2999954 FORMAT "%9.7"
 /begin AXIS_DESCR STD_AXIS wnwvu_w kw_q0p0078 10 0.00 511.9922 FORMAT "%8.4" DEPOSIT ABSOLUTE /end AXIS_DESCR
 /begin AXIS_DESCR STD_AXIS nmot_w nmot_uw_q0p25 14 0.00 16383.75 FORMAT "%8.2" DEPOSIT ABSOLUTE /end AXIS_DESCR
/end CHARACTERISTIC
/begin CHARACTERISTIC KFURLKL12E "Umrech.-faktor von ps->rl abh.von NW-Verstell.bei akt.1.u 2.Klappe bei Einlaﬂ-NW" MAP 0x1C99CA KfAxUwAyUwSstxUwSstyUwWUw 0.2999954 rel_uw_b0p3 0.00 0.2999954 FORMAT "%9.7"
 /begin AXIS_DESCR STD_AXIS wnwvu_w kw_q0p0078 10 0.00 511.9922 FORMAT "%8.4" DEPOSIT ABSOLUTE /end AXIS_DESCR
 /begin AXIS_DESCR STD_AXIS nmot_w nmot_uw_q0p25 14 0.00 16383.75 FORMAT "%8.2" DEPOSIT ABSOLUTE /end AXIS_DESCR
/end CHARACTERISTIC
/begin CHARACTERISTIC KFURLKL2A "Umrechnungsfaktor von ps->rl abh.von NW-Verstell. bei akt.2.Klappe bei Auslaﬂ-NW" MAP 0x1C9B16 KfAxUwAyUwSstxUwSstyUwWUw 0.2999954 rel_uw_b0p3 0.00 0.2999954 FORMAT "%9.7"
 /begin AXIS_DESCR STD_AXIS wnwvu_w kw_q0p0078 10 0.00 511.9922 FORMAT "%8.4" DEPOSIT ABSOLUTE /end AXIS_DESCR
 /begin AXIS_DESCR STD_AXIS nmot_w nmot_uw_q0p25 14 0.00 16383.75 FORMAT "%8.2" DEPOSIT ABSOLUTE /end AXIS_DESCR
/end CHARACTERISTIC
/begin CHARACTERISTIC KFURLKL2E "Umrechnungsfaktor von ps->rl abh.von NW-Verstell. bei akt.2.Klappe bei Einlaﬂ-NW" MAP 0x1C9C62 KfAxUwAyUwSstxUwSstyUwWUw 0.2999954 rel_uw_b0p3 0.00 0.2999954 FORMAT "%9.7"
 /begin AXIS_DESCR STD_AXIS wnwvu_w kw_q0p0078 10 0.00 511.9922 FORMAT "%8.4" DEPOSIT ABSOLUTE /end AXIS_DESCR
 /begin AXIS_DESCR STD_AXIS nmot_w nmot_uw_q0p25 14 0.00 16383.75 FORMAT "%8.2" DEPOSIT ABSOLUTE /end AXIS_DESCR
/end CHARACTERISTIC
/begin CHARACTERISTIC KFURLSUA "Umrechnungsfaktor von ps->rl abh‰ngig von NW-Verstell. (sumode=1) bei Auslaﬂ-NW" MAP 0x1C9DAE KfAxUwAyUwSstxUwSstyUwWUw 0.2999954 rel_uw_b0p3 0.00 0.2999954 FORMAT "%9.7"
 /begin AXIS_DESCR STD_AXIS wnwvu_w kw_q0p0078 10 0.00 511.9922 FORMAT "%8.4" DEPOSIT ABSOLUTE /end AXIS_DESCR
 /begin AXIS_DESCR STD_AXIS nmot_w nmot_uw_q0p25 14 0.00 16383.75 FORMAT "%8.2" DEPOSIT ABSOLUTE /end AXIS_DESCR
/end CHARACTERISTIC
/begin CHARACTERISTIC KFURLSUE "Umrechnungsfaktor von ps->rl abh‰ngig von NW-Verstell. (sumode=1) bei Einlaﬂ-NW" MAP 0x1C9EFA KfAxUwAyUwSstxUwSstyUwWUw 0.2999954 rel_uw_b0p3 0.00 0.2999954 FORMAT "%9.7"
 /begin AXIS_DESCR STD_AXIS wnwvu_w kw_q0p0078 10 0.00 511.9922 FORMAT "%8.4" DEPOSIT ABSOLUTE /end AXIS_DESCR
 /begin AXIS_DESCR STD_AXIS nmot_w nmot_uw_q0p25 14 0.00 16383.75 FORMAT "%8.2" DEPOSIT ABSOLUTE /end AXIS_DESCR
/end CHARACTERISTIC
/begin CHARACTERISTIC KFWTBR "Wichtungsfaktor Tans/Tmot f¸r Brennraumtemperaturmodell" MAP 0x1CA0F4 KfAxUbAyUbSstxUbSstyUbWUb 1.992 fak_ub_b2 0.00 1.992 FORMAT "%5.3"
 /begin AXIS_DESCR STD_AXIS ps p_ub_q10 10 0.00 2550. FORMAT "%5.0" DEPOSIT ABSOLUTE /end AXIS_DESCR
 /begin AXIS_DESCR STD_AXIS nmot nmot_ub_q40 12 0.00 10200. FORMAT "%5.0" DEPOSIT ABSOLUTE /end AXIS_DESCR
/end CHARACTERISTIC
/begin CHARACTERISTIC KISRM "Integratorbeiwert f¸r Saugrohrmodell (Dynamik)" VALUE 0x1CA046 KwUw 0.9999847 fak_uw_b1 0.00 0.9999847 FORMAT "%9.7" /end CHARACTERISTIC
/begin CHARACTERISTIC KISRMKL12 "Integrationsbeiwert f¸r Saugrohrmodell bei geschalteter 1.+2.Klappe" VALUE 0x1CA048 KwUw 0.9999847 fak_uw_b1 0.00 0.9999847 FORMAT "%9.7" /end CHARACTERISTIC
/begin CHARACTERISTIC KISRMKL2 "Integrationsbeiwert f¸r Saugrohrmodell bei geschalteter 2.Klappe" VALUE 0x1CA04A KwUw 0.9999847 fak_uw_b1 0.00 0.9999847 FORMAT "%9.7" /end CHARACTERISTIC
/begin CHARACTERISTIC KISRMSU "Integrationsbeiwert f¸r Saugrohrmodell bei sumode=1" VALUE 0x1CA04C KwUw 0.9999847 fak_uw_b1 0.00 0.9999847 FORMAT "%9.7" /end CHARACTERISTIC
/begin CHARACTERISTIC KLAF "Ausfluﬂkennlinie" CURVE 0x1C34CC FklWUw 1.999969 fak_uw_b2 0.00 1.999969 FORMAT "%8.6"
 /begin AXIS_DESCR FIX_AXIS pspvdb_w fak_uw_b2 513 0.5000000 1.000946 FORMAT "%8.6" FIX_AXIS_PAR 16384 5 513 /end AXIS_DESCR
/end CHARACTERISTIC
/begin CHARACTERISTIC KLAFTE "Ausfluﬂkennlinie f¸r TEV incl. Leitung AKF-TEV" CURVE 0x1CDE2C KlAUwSstUwWUw 1.999969 fak_uw_b2 0.00 1.999969 FORMAT "%8.6"
 /begin AXIS_DESCR STD_AXIS pspute_w fak_uw_b2 14 0.00 1.999969 FORMAT "%8.6" DEPOSIT ABSOLUTE /end AXIS_DESCR
/end CHARACTERISTIC
/begin CHARACTERISTIC KLDTUMTA "Offset Ansauglufttemperatur -> Umgebungstemperatur" CURVE 0x1CEA34 KlAxU8SstxU8WS8 191.3 temp_sw_q0p75 -96.00 95.25 FORMAT "%5.2"
 /begin AXIS_DESCR STD_AXIS tans temp_ub_q0p75_o48 4 -48.00 143.3 FORMAT "%5.1" DEPOSIT ABSOLUTE /end AXIS_DESCR
/end CHARACTERISTIC
/begin CHARACTERISTIC KLFKVNWANM "Korrekturfaktor f¸r berechnete Verstellgeschwindigkeit der NW Auslaﬂ" CURVE 0x1C3B3A GklWUw 1.999969 fak_uw_b2 0.00 1.999969 FORMAT "%8.6"
 /begin AXIS_DESCR COM_AXIS nmot_w nmot_uw_q0p25 6 0.00 16383.75 AXIS_PTS_REF SNM06NWUW /end AXIS_DESCR
/end CHARACTERISTIC
/begin CHARACTERISTIC KLFKVNWENM "Korrekturfaktor f¸r berechnete Verstellgeschwindigkeit der NW Einlaﬂ" CURVE 0x1C3B2C GklWUw 1.999969 fak_uw_b2 0.00 1.999969 FORMAT "%8.6"
 /begin AXIS_DESCR COM_AXIS nmot_w nmot_uw_q0p25 6 0.00 16383.75 AXIS_PTS_REF SNM06NWUW /end AXIS_DESCR
/end CHARACTERISTIC
/begin CHARACTERISTIC KLGDMB "KL gangabh‰ngiges Md-Soll aus Funktion Momentbegrenzung" CURVE 0x1D1AA0 dc_ArrSw 2047.938 DC_TRQ_S16 0.00 2047.938 FORMAT "%8.3"
 /begin AXIS_DESCR FIX_AXIS Gear_State DC_CNTR_U8 7 0.00 6.000 FORMAT "%5.3" FIX_AXIS_PAR 0 0 7 /end AXIS_DESCR
/end CHARACTERISTIC
/begin CHARACTERISTIC KLMNFDMB "KL Md-Soll aus Notfunktion Momentbegrenzung bei GS-Narichtenunterbrechung" CURVE 0x1D1A8E dc_GKlWSw 4095.938 DC_TRQ_S16 -2048.000 2047.938 FORMAT "%8.3"
 /begin AXIS_DESCR COM_AXIS Eng_Spd DC_ROTSPD_S16 8 -16384.0 16383.5 AXIS_PTS_REF NISTV08 /end AXIS_DESCR
/end CHARACTERISTIC
/begin CHARACTERISTIC KLPABNAV "Kennlinie Abgasdruck nach Auslaﬂventil" CURVE 0x1C8770 KlAUwSstUwWUw 2559.961 p_uw_q0p039 0.00 2559.961 FORMAT "%8.3"
 /begin AXIS_DESCR STD_AXIS msabikr_w m_uw_b6553p5 8 0.00 6553.500 FORMAT "%8.3" DEPOSIT ABSOLUTE /end AXIS_DESCR
/end CHARACTERISTIC
/begin CHARACTERISTIC KLPAVHK "Kennlinie Abgasgegendruck vor Hauptkat" CURVE 0x1C8792 KlAUwSstUwWUw 2559.961 p_uw_q0p039 0.00 2559.961 FORMAT "%8.3"
 /begin AXIS_DESCR STD_AXIS msabvhk_w m_uw_b6553p5 8 0.00 6553.500 FORMAT "%8.3" DEPOSIT ABSOLUTE /end AXIS_DESCR
/end CHARACTERISTIC
/begin CHARACTERISTIC KLPAVVK "Kennlinie Abgasgegendruck vor Vorkat" CURVE 0x1C87B4 KlAUwSstUwWUw 2559.961 p_uw_q0p039 0.00 2559.961 FORMAT "%8.3"
 /begin AXIS_DESCR STD_AXIS msabvvk_w m_uw_b6553p5 8 0.00 6553.500 FORMAT "%8.3" DEPOSIT ABSOLUTE /end AXIS_DESCR
/end CHARACTERISTIC
/begin CHARACTERISTIC KLPRGAGPS "Korrektur-KL von pbrintro_w bei groﬂem Druckverh‰ltnis Saugrohr/Auslaﬂventil" CURVE 0x1CA04E KlAUwSstUwWUw 1.999969 fak_uw_b2 0.00 1.999969 FORMAT "%8.6"
 /begin AXIS_DESCR STD_AXIS vpspanav_w fak_uw_b2 8 0.00 1.999969 FORMAT "%8.6" DEPOSIT ABSOLUTE /end AXIS_DESCR
/end CHARACTERISTIC
/begin CHARACTERISTIC KLRLVMX "Maximaler Volumenstrom bei offener Drosselklappe, word" CURVE 0x1CA826 KlAxU8SstxU16WU16 1535.977 rel_uw_q0p0234 0.00 1535.977 FORMAT "%8.3"
 /begin AXIS_DESCR STD_AXIS nmot_w nmot_uw_q0p25 11 0.00 16383.75 FORMAT "%8.2" DEPOSIT ABSOLUTE /end AXIS_DESCR
/end CHARACTERISTIC
/begin CHARACTERISTIC KMLTESG "Konstante f¸r Regeneriermasse in Leitung TEV-Saugrohr bei Normdruck + Normtemp." VALUE 0x1CDE66 KwUw 1.066650 fak1_q1p63Em5 0.00 1.066650 FORMAT "%8.6" /end CHARACTERISTIC
/begin CHARACTERISTIC KMSDK "Verst‰rkungsfaktor f¸r Filterung von msdk" VALUE 0x1C38CE KwUw 7.999878 fak_uw_b8 0.00 7.999878 FORMAT "%8.6" /end CHARACTERISTIC
/begin CHARACTERISTIC KUMSIRL "Umrechnungskonstante von Massenstrom in relative Luftf¸llung" VALUE 0x1C2CFA KwUw 0.003999938965 kumsrl_uw_b0p004 0.00 0.003999938965 FORMAT "%14.12" /end CHARACTERISTIC
/begin CHARACTERISTIC LBMINIT "Initialisierungswert des Z‰hlers Bezugsmarkenverlust, wenn SG zuvor im NLDG war" VALUE 0x1C65FC KwWU16 65535.00 dez 0.00 65535.00 FORMAT "%8.2" /end CHARACTERISTIC
/begin CHARACTERISTIC LBMMX "Maximalwert f¸r Z‰hler Bezugsmarkenverlust" VALUE 0x1C65FE KwWU16 65535.00 dez 0.00 65535.00 FORMAT "%8.2" /end CHARACTERISTIC
/begin CHARACTERISTIC LNXQTM "Nat¸rlicher Logarithmus aus Temperaturquotient" CURVE 0x1CED3E KlAxU8SstxU16WU16 3.999939 fak_uw_b4 0.00 3.999939 FORMAT "%8.6"
 /begin AXIS_DESCR STD_AXIS xqtm_w fak_uw_b16 12 0.00 15.99976 FORMAT "%8.5" DEPOSIT ABSOLUTE /end AXIS_DESCR
/end CHARACTERISTIC
/begin CHARACTERISTIC MSLUB "Sekund‰rluftmasse abh‰ngig von der Batteriespannung" CURVE 0x1CD0C0 KlAxU8SstxU16WU16 204.8000 m_uw_b6553p5 0.00 204.8000 FORMAT "%8.4"
 /begin AXIS_DESCR STD_AXIS ubsqf_w spg_q0p00039 8 0.00 25.59961 FORMAT "%8.5" DEPOSIT ABSOLUTE /end AXIS_DESCR
/end CHARACTERISTIC
/begin CHARACTERISTIC MSNTATE "Kennlinie normierter Massenstrom durch TEV" CURVE 0x1CDE68 KlAUwSstUwWUw 25.59961 m_uw_b25p6 0.00 25.59961 FORMAT "%8.5"
 /begin AXIS_DESCR STD_AXIS tateist_w rel_uw_b100 10 0.00 99.99847 FORMAT "%8.5" DEPOSIT ABSOLUTE /end AXIS_DESCR
/end CHARACTERISTIC
/begin CHARACTERISTIC MSNTEVO "normierter, ¸berkritischer Massenstrom durch das 100% offene TEV (8 Bit)" VALUE 0x1CDE92 KwUw 25.59961 m_uw_b25p6 0.00 25.59961 FORMAT "%8.5" /end CHARACTERISTIC
/begin CHARACTERISTIC MSNWDK "Kennlinie normierter Massenstrom ¸ber DK" CURVE 0x1C38D0 KlAUwSstUwWUw 6553.500 m_uw_b6553p5 0.00 6553.500 FORMAT "%8.3"
 /begin AXIS_DESCR STD_AXIS wdkbab_w rel_uw_b100 16 0.00 99.99847 FORMAT "%8.5" DEPOSIT ABSOLUTE /end AXIS_DESCR
/end CHARACTERISTIC
/begin AXIS_PTS NISTV08 "Drehzahlst¸tzstellenverteilung" 0x1D1692 Eng_Spd dc_SstAUwSstSw 32767.5 DC_ROTSPD_S16 8 -16384.0 16383.5 FORMAT "%7.1" DEPOSIT ABSOLUTE /end AXIS_PTS
/begin CHARACTERISTIC NMOTOEL1 "Drehzahlschwelle 1 f¸r ÷ldruckanzeige" VALUE 0x1C6648 KwWU16 16383.75 nmot_uw_q0p25 0.00 16383.75 FORMAT "%8.2" /end CHARACTERISTIC
/begin CHARACTERISTIC NMOTOEL2 "Drehzahlschwelle 2 f¸r ÷ldruckanzeige" VALUE 0x1C664A KwWU16 16383.75 nmot_uw_q0p25 0.00 16383.75 FORMAT "%8.2" /end CHARACTERISTIC
/begin CHARACTERISTIC NTUMTA "Schwelle Drehzahl f¸r Bestimmung Umgebungstemperatur" VALUE 0x1CEA45 KwWU8 10200. nmot_ub_q40 0.00 10200. FORMAT "%5.0" /end CHARACTERISTIC
/begin CHARACTERISTIC PBRINTMN "Partialdruck internes Restgas im Brennraum Minimum" VALUE 0x1CA070 KwUw 2559.961 p_uw_q0p039 0.00 2559.961 FORMAT "%8.3" /end CHARACTERISTIC
/begin CHARACTERISTIC PBRINTMX "Partialdruck internes Restgas im Brennraum Maximum" VALUE 0x1CA072 KwUw 2559.961 p_uw_q0p039 0.00 2559.961 FORMAT "%8.3" /end CHARACTERISTIC
/begin CHARACTERISTIC PGFLNL "Anzahl an Phasenflanken bis NLDG aufgerufen wird bei eingetragenem E_n" VALUE 0x1C6600 KwWU16 65535.00 DEZ 0.00 65535.00 FORMAT "%8.2" /end CHARACTERISTIC
/begin CHARACTERISTIC PGFLWA "Anzahl PG-Flankenwechsel f¸r DG-Fehler B_signal" VALUE 0x1C6602 KwWU16 65535.00 DEZ 0.00 65535.00 FORMAT "%8.2" /end CHARACTERISTIC
/begin CHARACTERISTIC PSPVDKUG "Verh‰ltnis pspvdk ungedrosselt" VALUE 0x1C3912 KwUw 1.999969 fak_uw_b2 0.00 1.999969 FORMAT "%8.6" /end CHARACTERISTIC
/begin CHARACTERISTIC PSPVDKUGMN "Minimalschwelle f¸r Druckverh‰ltnis ungedrosselt" VALUE 0x1C3914 KwUw 1.999969 fak_uw_b2 0.00 1.999969 FORMAT "%8.6" /end CHARACTERISTIC
/begin CHARACTERISTIC RKACOMN "untere Schwelle additive Korrektur pro Zeit LL-CO Abgleich" VALUE 0x1C5648 KwSw 20.01563 rel_sw_b1536 -20.01563 0.00 FORMAT "%8.5" /end CHARACTERISTIC
/begin CHARACTERISTIC RKACOMX "obere Schwelle additive Korrektur pro Zeit LL-CO Abgleich" VALUE 0x1C564A KwSw 20.01563 rel_sw_b1536 0.00 20.01563 FORMAT "%8.5" /end CHARACTERISTIC
/begin CHARACTERISTIC RLNOT "Notlauf rl bei E_DK und E_LM" CURVE 0x1CA076 KlAUbSstUbWUw 1535.977 rel_uw_q0p0234 0.00 1535.977 FORMAT "%8.3"
 /begin AXIS_DESCR STD_AXIS nmot nmot_ub_q40 6 0.00 10200. FORMAT "%5.0" DEPOSIT ABSOLUTE /end AXIS_DESCR
/end CHARACTERISTIC
/begin AXIS_PTS SNM06NWUW "Drehzahl St¸tzstellenverteilung f¸r NW-Regler Einlaﬂ" 0x1CB8CA nmot_w SstAUwSstUw 16383.75 nmot_uw_q0p25 6 0.00 16383.75 FORMAT "%8.2" DEPOSIT ABSOLUTE /end AXIS_PTS
/begin CHARACTERISTIC TABMNTUM "Mindest-Abstellzeit bis Abk¸hlung Motor f¸r Aktualisierung Umgebungstemperatur" VALUE 0x1CEA40 KwWU16 65535.00 t1sxs_uw_q1 0.00 65535.00 FORMAT "%8.2" /end CHARACTERISTIC
/begin CHARACTERISTIC TABSTOLTM "Schwelle Abstellzeit f¸r Initialisierung ÷ltemperaturberechnung aus TMOT" VALUE 0x1CEA30 KwUw 65535.00 t1sxs_uw_q1 0.00 65535.00 FORMAT "%8.2" /end CHARACTERISTIC
/begin CHARACTERISTIC TDWSSLP "Zeitkonstante f¸r W‰rmestromanforderung der SLP" VALUE 0x1CD0FE KwWU16 6553.50000 zk100msxs_uw_b6553 0.100001526 6553.60000 FORMAT "%10.5" /end CHARACTERISTIC
/begin CHARACTERISTIC TLLCO "Motortemp. - Schwelle CO - Korrektur" VALUE 0x1C5646 KwUb 191.3 temp_ub_q0p75_o48 -48.00 143.3 FORMAT "%5.1" /end CHARACTERISTIC
/begin CHARACTERISTIC TMMXTUM "max. Motortemperatur f¸r Aktualisierung Umgebungstemp. aus Ansauglufttemp." VALUE 0x1CEA46 KwWU8 191.3 temp_ub_q0p75_o48 -48.00 143.3 FORMAT "%5.1" /end CHARACTERISTIC
/begin CHARACTERISTIC TMOTNLDG "Temperaturschwelle f¸r Drehzahlgeber-Notlauf" VALUE 0x1C6608 KwWU8 191.3 temp_ub_q0p75_o48 -48.00 143.3 FORMAT "%5.1" /end CHARACTERISTIC
/begin CHARACTERISTIC TMOTWRM "Motortemperatur f¸r warmen Motor" VALUE 0x1CA184 KwUb 191.3 temp_ub_q0p75_o48 -48.00 143.3 FORMAT "%5.1" /end CHARACTERISTIC
/begin CHARACTERISTIC TMVDBS "Entprellzeit Beschleunigungssignaldiagnose" VALUE 0x1C3CDE KwUb 25.50 t100msxs_ub_b25p5 0.00 25.50 FORMAT "%5.2" /end CHARACTERISTIC
/begin CHARACTERISTIC TNLSGM "Nachlaufzeit f¸r SG abschalten" CURVE 0x1CED70 KlAxU8SstxU8WU16 65535.00 t1sxs_uw_q1 0.00 65535.00 FORMAT "%8.2"
 /begin AXIS_DESCR STD_AXIS tmotab temp_ub_q0p75_o48 6 -48.00 143.3 FORMAT "%5.1" DEPOSIT ABSOLUTE /end AXIS_DESCR
/end CHARACTERISTIC
/begin CHARACTERISTIC TNSURLP "Zeit rl-Praediktions-Unterdrueckung im Nachstart" VALUE 0x1CA08A KwUw 655.3500 t10msxs_uw_b655p35 0.00 655.3500 FORMAT "%8.4" /end CHARACTERISTIC
/begin CHARACTERISTIC TUMTAI "Initialisierungswert Umgebungstemperatur" VALUE 0x1CEA47 KwWU8 191.3 temp_ub_q0p75_o48 -48.00 143.3 FORMAT "%5.1" /end CHARACTERISTIC
/begin CHARACTERISTIC TVCO "CO-Korrektur" CURVE 0x1C564C KlASwSstSwWSw 3071.953 rel_sw_b1536 -1536.000 1535.953 FORMAT "%8.3"
 /begin AXIS_DESCR STD_AXIS co_pot_w dez 8 -32768.00 32767.00 FORMAT "%8.2" DEPOSIT ABSOLUTE /end AXIS_DESCR
/end CHARACTERISTIC
/begin CHARACTERISTIC TVPOELAN1 "Verzˆgerungszeit 1 f¸r ÷ldruckanzeige" VALUE 0x1C664C KwWU8 25.50 t_q0p1 0.00 25.50 FORMAT "%5.2" /end CHARACTERISTIC
/begin CHARACTERISTIC TVPOELAN2 "Verzˆgerungszeit 2 f¸r ÷ldruckanzeige" VALUE 0x1C664D KwWU8 25.50 t_q0p1 0.00 25.50 FORMAT "%5.2" /end CHARACTERISTIC
/begin CHARACTERISTIC TVTUMTA "Verzugszeit Fahrgeschwindigkeitsbedingung f¸r Bestimmung Umgebungstemperatur" VALUE 0x1CEA42 KwWU16 65535.00 t1sxs_uw_b65535 0.00 65535.00 FORMAT "%8.2" /end CHARACTERISTIC
/begin CHARACTERISTIC TWBDCY "Wartezeit f¸r Erkennung Bedingung 'driving cycle'" VALUE 0x1CBBB4 KwUw 13107.00 t200msxs_uw_q0p2 0.00 13107.00 FORMAT "%8.2" /end CHARACTERISTIC
/begin CHARACTERISTIC UMSRLNMN "min. umsrln_w f¸r Sollmassenstromberechnung" VALUE 0x1C3916 KwUw 32.76750 m_q0p0005 0.00 32.76750 FORMAT "%8.5" /end CHARACTERISTIC
/begin CHARACTERISTIC VASRM "Geschwindigkeitsschwelle f¸r Schlechtwegerkennung" VALUE 0x1C3CDF KwUb 318.8 vfzg_ub_q1p25 0.00 318.8 FORMAT "%5.1" /end CHARACTERISTIC
/begin CHARACTERISTIC VBSMX "obere Plausibilit‰tsschwelle f¸r Radgeschwindigkeit" VALUE 0x1C3CE0 KwUw 4095.938 vfzg_uw_q0p0625 0.00 4095.938 FORMAT "%8.3" /end CHARACTERISTIC
/begin CHARACTERISTIC VSEKPMXN "Kennlinie Kraftstoff-Sollvolumenstrom bei Vollast abh‰ngig von der Drehzahl" CURVE 0x1CE18C KlAUbSstUbWUb 255.0 fuel_ub_q1 0.00 255.0 FORMAT "%5.1"
 /begin AXIS_DESCR STD_AXIS nmot nmot_ub_q40 5 0.00 10200. FORMAT "%5.0" DEPOSIT ABSOLUTE /end AXIS_DESCR
/end CHARACTERISTIC
/begin CHARACTERISTIC VSSSPE "Ersatzwert f¸r Sollvolumenstrom f¸r SSP" VALUE 0x1CE197 KwUb 255.0 fuel_ub_q1 0.00 255.0 FORMAT "%5.1" /end CHARACTERISTIC
/begin CHARACTERISTIC VSSSPTAIRL "KL Kraftstoff-Sollvolumenstrom f¸r die SSP abh. von dem F¸llstand" CURVE 0x1CE198 KlAUbSstUbWUb 255.0 fuel_ub_q1 0.00 255.0 FORMAT "%5.1"
 /begin AXIS_DESCR STD_AXIS fsttankrf fuel_ub_q0p5 4 0.00 127.5 FORMAT "%5.1" DEPOSIT ABSOLUTE /end AXIS_DESCR
/end CHARACTERISTIC
/begin CHARACTERISTIC VTUMTA "Schwelle Fahrzeuggeschwindigkeit f¸r Bestimmung Umgebungstemperatur" VALUE 0x1CEA48 KwWU8 318.8 vfzg_ub_q1p25 0.00 318.8 FORMAT "%5.1" /end CHARACTERISTIC
/begin CHARACTERISTIC Whl_Circumfer_Off "" VALUE 0x1D2FC7 dc_KwUb 2.550000 DC_CIR_OFFS_U8 0.00 2.550000 FORMAT "%8.6" /end CHARACTERISTIC
/begin CHARACTERISTIC WPRMX "maximaler Pr‰diktionswinkel" VALUE 0x1C3395 KwUb 1530. kw_q6 0.00 1530. FORMAT "%5.0" /end CHARACTERISTIC
/begin CHARACTERISTIC ZBRT "Zeitkonstante f¸r Brennraumtempmodell" VALUE 0x1CA234 KwUw 6553.50000 zk100msxs_uw_b6553 0.100001526 6553.60000 FORMAT "%10.5" /end CHARACTERISTIC
/begin CHARACTERISTIC ZDBTMN "Zeitkonstante Dynamikanteil Brennraumtemperaturmodell f¸r negative Gradienten" CURVE 0x1CA236 KlAUwSstUwWUw 6553.50000 zk100msxs_uw_b6553 0.100001526 6553.60000 FORMAT "%10.5"
 /begin AXIS_DESCR STD_AXIS nmot_w nmot_uw_q0p25 8 0.00 16383.75 FORMAT "%8.2" DEPOSIT ABSOLUTE /end AXIS_DESCR
/end CHARACTERISTIC
/begin CHARACTERISTIC ZDBTMP "Zeitkonstante Dynamikanteil Brennraumtemperaturmodell f¸r positive Gradienten" CURVE 0x1CA258 KlAUwSstUwWUw 6553.50000 zk100msxs_uw_b6553 0.100001526 6553.60000 FORMAT "%10.5"
 /begin AXIS_DESCR STD_AXIS nmot_w nmot_uw_q0p25 8 0.00 16383.75 FORMAT "%8.2" DEPOSIT ABSOLUTE /end AXIS_DESCR
/end CHARACTERISTIC
/begin CHARACTERISTIC ZFMVRV "Zeitkonstante f¸r Filterung des Geschwindigkeitssignals" VALUE 0x1C6B33 KwUb 5.08000 zk20msxs_ub_b5p1 0.0200000 5.10000 FORMAT "%7.5" /end CHARACTERISTIC
/begin CHARACTERISTIC ZIDFBM "Z‰hler-Inkrementierung je L¸ckenkorrektur bei BM-‹berpr¸fung" VALUE 0x1C6604 KwWU16 65535.00 dez 0.00 65535.00 FORMAT "%8.2" /end CHARACTERISTIC
/begin CHARACTERISTIC ZIDNOBM "Z‰hler-Inkrementierung nach Verlust der Bezugsmarke" VALUE 0x1C6606 KwWU16 65535.00 dez 0.00 65535.00 FORMAT "%8.2" /end CHARACTERISTIC
/begin CHARACTERISTIC ZKSLPOFF "Zeitkonstante Runterlauf Sekund‰rluftgebl‰se" VALUE 0x1CD101 KwWU8 25.4996 zk100msxs_ub_b25p5 0.100392 25.6000 FORMAT "%7.4" /end CHARACTERISTIC
/begin CHARACTERISTIC ZKSLPON "Zeitkonstante Hochlauf Sekund‰rluftgebl‰se" VALUE 0x1CD102 KwWU8 25.4996 zk100msxs_ub_b25p5 0.100392 25.6000 FORMAT "%7.4" /end CHARACTERISTIC
/begin CHARACTERISTIC ZKTABTU "Zeitkonstante f¸r Motorabk¸hlung" CURVE 0x1CED84 KlAxU8SstxU8WU16 65535.00 t1sxs_uw_b65535 0.00 65535.00 FORMAT "%8.2"
 /begin AXIS_DESCR STD_AXIS tumg temp_ub_q0p75_o48 4 -48.00 143.3 FORMAT "%5.1" DEPOSIT ABSOLUTE /end AXIS_DESCR
/end CHARACTERISTIC
/begin CHARACTERISTIC ZKTPTOLTM "Zeitkonstante f¸r Tiefpass ÷ltemperaturberechnung aus TMOT" VALUE 0x1CEA32 KwUw 65534.000000 zk1sxs_uw_b65535 1.0000000000 65535.000000 FORMAT "%12.6" /end CHARACTERISTIC
/begin CHARACTERISTIC ZNGFIL "Zeitkonstante f¸r Drehzahlgradient-Filter" VALUE 0x1C65FA KwUw 655.350000 zk10msxs_uw_b655 0.0100001526 655.360000 FORMAT "%10.6" /end CHARACTERISTIC
/begin CHARACTERISTIC ZTDAGR "Zeitkonstante Temperaturdynamik bei AGR Auf- Abschaltung" VALUE 0x1CA27A KwUw 6553.50000 zk100msxs_uw_b6553 0.100001526 6553.60000 FORMAT "%10.5" /end CHARACTERISTIC
/begin CHARACTERISTIC ZTMMBR "Zeitkonstante Motortemperatur f¸r Brennraumtempmodell" VALUE 0x1CA27C KwUw 6553.50000 zk100msxs_uw_b6553 0.100001526 6553.60000 FORMAT "%10.5" /end CHARACTERISTIC
/begin CHARACTERISTIC ZVTPRGSU "Zeitkonstante Tiefpaﬂfilterung bei Saugrohrklappendynamik" VALUE 0x1CA074 KwUw 3276.75000 zk50msxs_uw_b12p8 0.0500007630 3276.80000 FORMAT "%10.5" /end CHARACTERISTIC
/begin CHARACTERISTIC ZWDKM1 "1. Zeitkonstante Dk-Modell" VALUE 0x1C2D04 KwUw 2.550000 zk10msxs_uw_b2p55T 0.00 2.550000 FORMAT "%8.6" /end CHARACTERISTIC
/begin CHARACTERISTIC ZWDKM2 "2. Zeitkonstante Dk-Modell" VALUE 0x1C2D06 KwUw 2.550000 zk10msxs_uw_b2p55T 0.00 2.550000 FORMAT "%8.6" /end CHARACTERISTIC
/begin MEASUREMENT ABC_Trq_Loss "" UWORD DC_MMQ16 1 100 0 0.875 FORMAT "%9.7" ECU_ADDRESS 0x803272 /end MEASUREMENT
/begin MEASUREMENT ACCompr2_Run_Mode "" UBYTE DC_FLAG_U8 1 100 0 1 BIT_MASK 0x1 FORMAT "%5.3" ECU_ADDRESS 0x803807 /end MEASUREMENT
/begin MEASUREMENT ACCompr2_Trq "" UBYTE DC_M3NM 1 100 0 765 FORMAT "%5.1" ECU_ADDRESS 0x803806 /end MEASUREMENT
/begin MEASUREMENT ACCompr_Existing_Mode "" UWORD DC_FLAG_U8 1 100 0 1 BIT_MASK 0x1 FORMAT "%5.3" ECU_ADDRESS 0x80366A /end MEASUREMENT
/begin MEASUREMENT ACCompr_RefriPress "" UBYTE DC_UPAC 1 100 0 127.5 FORMAT "%5.1" ECU_ADDRESS 0x803805 /end MEASUREMENT
/begin MEASUREMENT ACCompr_Run_Mode "" UBYTE DC_FLAG_U8 1 100 0 1 BIT_MASK 0x1 FORMAT "%5.3" ECU_ADDRESS 0x80366B /end MEASUREMENT
/begin MEASUREMENT ACCompr_Trq "" UBYTE DC_M3NM 1 100 0 765 FORMAT "%5.1" ECU_ADDRESS 0x803804 /end MEASUREMENT
/begin MEASUREMENT ACC_ISRD_Mode "" UBYTE DC_FLAG_U8 1 100 0 1 BIT_MASK 0x1 FORMAT "%5.3" ECU_ADDRESS 0x80366C /end MEASUREMENT
/begin MEASUREMENT ACS_410h_MsgLost_Cntr "" UBYTE DC_CNTR_U8 1 100 0 255 FORMAT "%5.1" ECU_ADDRESS 0x8037CC /end MEASUREMENT
/begin MEASUREMENT ACS_410h_MsgLost_DeBnc_Mode "" UBYTE DC_FLAG_U8 1 100 0 1 BIT_MASK 0x1 FORMAT "%5.3" ECU_ADDRESS 0x8037CB /end MEASUREMENT
/begin MEASUREMENT ACS_410h_MsgLost_State_Mode "" UBYTE DC_FLAG_U8 1 100 0 1 BIT_MASK 0x1 FORMAT "%5.3" ECU_ADDRESS 0x80366D /end MEASUREMENT
/begin MEASUREMENT ACS_CrashConfirmBit_Mode "" UBYTE DC_FLAG_U8 1 100 0 1 BIT_MASK 0x1 FORMAT "%5.3" ECU_ADDRESS 0x803803 /end MEASUREMENT
/begin MEASUREMENT ACS_Crash_Mode "" UBYTE DC_FLAG_U8 1 100 0 1 BIT_MASK 0x1 FORMAT "%5.3" ECU_ADDRESS 0x803802 /end MEASUREMENT
/begin MEASUREMENT AdapAltitudeTempCorr_Coef "" UWORD DC_FCTR_32768_U16 1 100 0 1.99997 FORMAT "%7.5" ECU_ADDRESS 0x8032A8 /end MEASUREMENT
/begin MEASUREMENT AdapCrsCtrl_Dyn0_Mode_Req "" UBYTE DC_FLAG_U8 1 100 0 1 BIT_MASK 0x1 FORMAT "%5.3" ECU_ADDRESS 0x80366E /end MEASUREMENT
/begin MEASUREMENT AdapCrsCtrl_Parity "" UBYTE DC_FLAG_U8 1 100 0 1 BIT_MASK 0x1 FORMAT "%5.3" ECU_ADDRESS 0x80366F /end MEASUREMENT
/begin MEASUREMENT AdapCrsCtrl_Tgl "" UBYTE DC_FLAG_U8 1 100 0 1 BIT_MASK 0x1 FORMAT "%5.3" ECU_ADDRESS 0x803670 /end MEASUREMENT
/begin MEASUREMENT AdapCrsCtrl_TrqMax_Mode_Req "" UBYTE DC_FLAG_U8 1 100 0 1 BIT_MASK 0x1 FORMAT "%5.3" ECU_ADDRESS 0x803671 /end MEASUREMENT
/begin MEASUREMENT AdapCrsCtrl_TrqMin_Mode_Req "" UBYTE DC_FLAG_U8 1 100 0 1 BIT_MASK 0x1 FORMAT "%5.3" ECU_ADDRESS 0x803672 /end MEASUREMENT
/begin MEASUREMENT AdapCrsCtrl_Trq_Req "" UWORD DC_MMQ13 1 100 -500 1547.75 ECU_ADDRESS 0x803270 /end MEASUREMENT
/begin MEASUREMENT AGKInit_Mode "" UBYTE DC_FLAG_U8 1 100 0 1 BIT_MASK 0x1 FORMAT "%5.3" ECU_ADDRESS 0x803885 /end MEASUREMENT
/begin MEASUREMENT AMT_Creep_Trq_Req "" UBYTE DC_MMQ075_U8DB 1 100 0 191.25 FORMAT "%4.0" ECU_ADDRESS 0x803801 /end MEASUREMENT
/begin MEASUREMENT AMT_EmergShutOff "" UBYTE DC_FLAG_U8 1 100 0 1 BIT_MASK 0x1 FORMAT "%5.3" ECU_ADDRESS 0x803673 /end MEASUREMENT
/begin MEASUREMENT AMT_EmergShutOff_Cnf "" UBYTE DC_FLAG_U8 1 100 0 1 BIT_MASK 0x1 FORMAT "%5.3" ECU_ADDRESS 0x803674 /end MEASUREMENT
/begin MEASUREMENT AMT_Man_Mode "" UBYTE DC_FLAG_U8 1 100 0 1 BIT_MASK 0x1 FORMAT "%5.3" ECU_ADDRESS 0x803675 /end MEASUREMENT
/begin MEASUREMENT AMT_Mode "" UBYTE DC_FLAG_U8 1 100 0 1 BIT_MASK 0x1 FORMAT "%5.3" ECU_ADDRESS 0x803835 /end MEASUREMENT
/begin MEASUREMENT AT2_Mode "" UBYTE DC_FLAG_U8 1 100 0 1 BIT_MASK 0x1 FORMAT "%5.3" ECU_ADDRESS 0x80382D /end MEASUREMENT
/begin MEASUREMENT AuxiliaryHeaterEnabl_Mode "" UBYTE DC_FLAG_U8 1 100 0 1 BIT_MASK 0x1 FORMAT "%5.3" ECU_ADDRESS 0x803676 /end MEASUREMENT
/begin MEASUREMENT AuxiliaryHeaterSwOnEnabl_Mode "" UBYTE DC_FLAG_U8 1 100 0 1 BIT_MASK 0x1 FORMAT "%5.3" ECU_ADDRESS 0x803677 /end MEASUREMENT
/begin MEASUREMENT bbdcy "Byte f¸r Bedingung B_dcy als Triggerevent in DCLA" UBYTE dez 1 100 0 255 FORMAT "%5.1" ECU_ADDRESS 0x801116 /end MEASUREMENT
/begin MEASUREMENT bfzglfgr "Fahrzeugl‰ngsbeschleunigung" SBYTE bfzg_sb_q0p217 1 100 -27.776 27.559 FORMAT "%5.2" ECU_ADDRESS 0x80124C /end MEASUREMENT
/begin MEASUREMENT bgmslsAusBits "" UBYTE dez 1 100 0 255 FORMAT "%5.1" ECU_ADDRESS 0x800A5C /end MEASUREMENT
/begin MEASUREMENT bgmslsLokBits "" UBYTE dez 1 100 0 255 FORMAT "%5.1" ECU_ADDRESS 0x800A5D /end MEASUREMENT
/begin MEASUREMENT bgtabstBits1_50ms "" UBYTE dez 1 100 0 255 FORMAT "%5.1" ECU_ADDRESS 0x800CCC /end MEASUREMENT
/begin MEASUREMENT bgtabstBits2_50ms "" UBYTE dez 1 100 0 255 FORMAT "%5.1" ECU_ADDRESS 0x800CCD /end MEASUREMENT
/begin MEASUREMENT bgtabstBits3_1000ms "" UBYTE dez 1 100 0 255 FORMAT "%5.1" ECU_ADDRESS 0x7FC83A /end MEASUREMENT
/begin MEASUREMENT BGTOLausbits1 "" UBYTE dez 1 100 0 255 FORMAT "%5.1" ECU_ADDRESS 0x801211 /end MEASUREMENT
/begin MEASUREMENT bgtumgAusBits "" UBYTE dez 1 100 0 255 FORMAT "%5.1" ECU_ADDRESS 0x800CA8 /end MEASUREMENT
/begin MEASUREMENT bmloss_w "Z‰hler BM-Fehler f¸r DG Diagnose" UWORD dez 1 100 0 65535 FORMAT "%8.2" ECU_ADDRESS 0x801BCC /end MEASUREMENT
/begin MEASUREMENT BrkBit0 "" UBYTE DC_FLAG_U8 1 100 0 1 BIT_MASK 0x1 FORMAT "%5.3" ECU_ADDRESS 0x803800 /end MEASUREMENT
/begin MEASUREMENT BrkBit1 "" UBYTE DC_FLAG_U8 1 100 0 1 BIT_MASK 0x1 FORMAT "%5.3" ECU_ADDRESS 0x8037FF /end MEASUREMENT
/begin MEASUREMENT BrkLight0_Mode "" UBYTE DC_FLAG_U8 1 100 0 1 BIT_MASK 0x1 FORMAT "%5.3" ECU_ADDRESS 0x8037FE /end MEASUREMENT
/begin MEASUREMENT BrkLight1_Mode "" UBYTE DC_FLAG_U8 1 100 0 1 BIT_MASK 0x1 FORMAT "%5.3" ECU_ADDRESS 0x8037FD /end MEASUREMENT
/begin MEASUREMENT BrkLight_MsgCntr "" UBYTE DC_CNTR_U8 1 100 0 15 FORMAT "%5.2" ECU_ADDRESS 0x803678 /end MEASUREMENT
/begin MEASUREMENT BrkLight_Parity "" UBYTE DC_FLAG_U8 1 100 0 1 BIT_MASK 0x1 FORMAT "%5.3" ECU_ADDRESS 0x803679 /end MEASUREMENT
/begin MEASUREMENT BrkParity_Mode "" UBYTE DC_FLAG_U8 1 100 0 1 BIT_MASK 0x1 FORMAT "%5.3" ECU_ADDRESS 0x80367A /end MEASUREMENT
/begin MEASUREMENT bsc "Radbeschleunigungssignal aus ABS-Sensorsignal berechnet" UBYTE acc_ub_b55p55 1 100 0 55.335 FORMAT "%5.2" ECU_ADDRESS 0x801163 /end MEASUREMENT
/begin MEASUREMENT B_abstgp "Bedingung Abstellzeitermittlung g¸ltig und plausibel" UBYTE B_TRUE 1 100 0 1 BIT_MASK 0x1 FORMAT "%13.11" ECU_ADDRESS 0x800CCC /end MEASUREMENT
/begin MEASUREMENT B_abstmnpl "Bedingung Abstellzeit aus Motorabk¸hlung nicht plausibel" UBYTE B_TRUE 1 100 0 1 BIT_MASK 0x1 FORMAT "%13.11" ECU_ADDRESS 0x800CCD /end MEASUREMENT
/begin MEASUREMENT B_abstnlg0 "" UBYTE B_TRUE 1 100 0 1 BIT_MASK 0x2 FORMAT "%13.11" ECU_ADDRESS 0x7FC83A /end MEASUREMENT
/begin MEASUREMENT B_abstnlgp "Bedingung Abstellzeitermittlung ¸ber SG-Nachlauf g¸ltig und plausibel" UBYTE B_TRUE 1 100 0 1 BIT_MASK 0x1 FORMAT "%13.11" ECU_ADDRESS 0x800E87 /end MEASUREMENT
/begin MEASUREMENT B_abstnpl "Bedingung Abstellzeitermittlung nicht plausibel" UBYTE B_TRUE 1 100 0 1 BIT_MASK 0x2 FORMAT "%13.11" ECU_ADDRESS 0x800CCC /end MEASUREMENT
/begin MEASUREMENT B_abstuhrg "Bedingung Abstellzeitermittlung aus Uhr g¸ltig und plausibel" UBYTE B_TRUE 1 100 0 1 BIT_MASK 0x2 FORMAT "%13.11" ECU_ADDRESS 0x800CCD /end MEASUREMENT
/begin MEASUREMENT B_cotrim "Bedingung f¸r LL-CO Abgleich erf¸llt" UBYTE B_TRUE 1 100 0 1 BIT_MASK 0x1 FORMAT "%13.11" ECU_ADDRESS 0x7FA794 /end MEASUREMENT
/begin MEASUREMENT B_dcy "Bedingung 'driving cycle' erkannt" UBYTE B_TRUE 1 100 0 1 BIT_MASK 0x1 FORMAT "%13.11" ECU_ADDRESS 0x801116 /end MEASUREMENT
/begin MEASUREMENT B_edsli "Bedingung Error Drucksensor Ladedruck" UBYTE B_TRUE 1 100 0 1 BIT_MASK 0x1 FORMAT "%13.11" ECU_ADDRESS 0x7FA615 /end MEASUREMENT
/begin MEASUREMENT B_etoel "Bedingung Fehler in Eingangsgrˆﬂen f¸r ÷ltemperatur-Berechnung" UBYTE B_TRUE 1 100 0 1 BIT_MASK 0x1 FORMAT "%13.11" ECU_ADDRESS 0x801211 /end MEASUREMENT
/begin MEASUREMENT B_fgrabz "Bedingung zus‰tzliche FGR-Abschaltung" UBYTE B_TRUE 1 100 0 1 BIT_MASK 0x1 FORMAT "%13.11" ECU_ADDRESS 0x7FA98E /end MEASUREMENT
/begin MEASUREMENT B_fstpl "Bedingung Tankf¸llstand plausibel" UBYTE B_TRUE 1 100 0 1 BIT_MASK 0x1 FORMAT "%13.11" ECU_ADDRESS 0x7FA7EC /end MEASUREMENT
/begin MEASUREMENT B_mdmin "Bedingung minimal erreichbares indiziertes Moment erreicht" UBYTE B_TRUE 1 100 0 1 BIT_MASK 0x1 FORMAT "%13.11" ECU_ADDRESS 0x8010D4 /end MEASUREMENT
/begin MEASUREMENT B_msloff "Sekund‰rluftmasse ausger‰umt nach Sekund‰rluftphase" UBYTE B_TRUE 1 100 0 1 BIT_MASK 0x1 FORMAT "%13.11" ECU_ADDRESS 0x800A5C /end MEASUREMENT
/begin MEASUREMENT B_mslon "Sekund‰rluftmasse eingeschwungen nach Start der Sekund‰rluft" UBYTE B_TRUE 1 100 0 1 BIT_MASK 0x1 FORMAT "%13.11" ECU_ADDRESS 0x800A5D /end MEASUREMENT
/begin MEASUREMENT B_mszsdkb "Berechnung Massenstrom zum Saugrohr DK basiert" UBYTE B_TRUE 1 100 0 1 BIT_MASK 0x1 FORMAT "%13.11" ECU_ADDRESS 0x7FA616 /end MEASUREMENT
/begin MEASUREMENT B_mwfe "BDE-Modewechsel F¸llungseingriffe (Quittungssignal)" UBYTE B_TRUE 1 100 0 1 BIT_MASK 0x2 FORMAT "%13.11" ECU_ADDRESS 0x8010D4 /end MEASUREMENT
/begin MEASUREMENT B_mxrlroh "Bedingung maximal Auswahl f¸r rlroh ist erf¸llt" UBYTE B_TRUE 1 100 0 1 BIT_MASK 0x1 FORMAT "%13.11" ECU_ADDRESS 0x7FA617 /end MEASUREMENT
/begin MEASUREMENT B_ngasok "Bedingung Ringspeicher f¸r ngas-Berechnung ok" UBYTE B_TRUE 1 100 0 1 BIT_MASK 0x1 FORMAT "%13.11" ECU_ADDRESS 0x7FA869 /end MEASUREMENT
/begin MEASUREMENT B_nldg "Bedingung Drehzahlgeber-Notlauf ist aktiv." UBYTE B_TRUE 1 100 0 1 BIT_MASK 0x1 FORMAT "%13.11" ECU_ADDRESS 0x7FA86E /end MEASUREMENT
/begin MEASUREMENT B_nmin "Bedingung Unterdrehzahl: n < NMIN" UBYTE B_TRUE 1 100 0 1 BIT_MASK 0x1 FORMAT "%13.11" ECU_ADDRESS 0x7FA86B /end MEASUREMENT
/begin MEASUREMENT B_nmot "Bedingung Motordrehzahl: n > NMIN" UBYTE B_TRUE 1 100 0 1 BIT_MASK 0x1 FORMAT "%13.11" ECU_ADDRESS 0x7FA86C /end MEASUREMENT
/begin MEASUREMENT B_nsp "Bedingung Nachspritzer" UBYTE B_TRUE 1 100 0 1 BIT_MASK 0x1 FORMAT "%13.11" ECU_ADDRESS 0x7FA62C /end MEASUREMENT
/begin MEASUREMENT B_oeldran "Bedingung ÷ldruckanzeige" UBYTE B_TRUE 1 100 0 1 FORMAT "%13.11" ECU_ADDRESS 0x800CA0 /end MEASUREMENT
/begin MEASUREMENT B_pltab "Bedingung Plausibilit‰tspr¸fung Abstellzeit mˆglich" UBYTE B_TRUE 1 100 0 1 BIT_MASK 0x4 FORMAT "%13.11" ECU_ADDRESS 0x800CCD /end MEASUREMENT
/begin MEASUREMENT B_pugd "Bedingung: Druckverh‰ltnis pspvdkds_w > 0.95" UBYTE B_TRUE 1 100 0 1 BIT_MASK 0x1 FORMAT "%13.11" ECU_ADDRESS 0x7FA657 /end MEASUREMENT
/begin MEASUREMENT B_rlp "Bedingung Lastpraediktion aktiv" UBYTE B_TRUE 1 100 0 1 BIT_MASK 0x1 FORMAT "%13.11" ECU_ADDRESS 0x7FA618 /end MEASUREMENT
/begin MEASUREMENT B_rlpns "Einschaltbedingung Lastpraediktion nach Start" UBYTE B_TRUE 1 100 0 1 BIT_MASK 0x1 FORMAT "%13.11" ECU_ADDRESS 0x7FA619 /end MEASUREMENT
/begin MEASUREMENT B_slsoff "Sekund‰rlufteinblasung nach Ausr‰umen der Sekund‰rluft beendet" UBYTE B_TRUE 1 100 0 1 BIT_MASK 0x2 FORMAT "%13.11" ECU_ADDRESS 0x800A5C /end MEASUREMENT
/begin MEASUREMENT B_startini "Startbit f¸r Erkennung der ersten Synchronisation nach KL15 ein" UBYTE B_TRUE 1 100 0 1 BIT_MASK 0x1 FORMAT "%13.11" ECU_ADDRESS 0x7FA86D /end MEASUREMENT
/begin MEASUREMENT B_tabuhrof "Bedingung ‹berlauf der Uhrinformation" UBYTE B_TRUE 1 100 0 1 BIT_MASK 0x8 FORMAT "%13.11" ECU_ADDRESS 0x800CCD /end MEASUREMENT
/begin MEASUREMENT B_tired "Bedingung ti-Reduktion" UBYTE B_TRUE 1 100 0 1 BIT_MASK 0x1 FORMAT "%13.11" ECU_ADDRESS 0x7FA62D /end MEASUREMENT
/begin MEASUREMENT B_tumkst "Bedingung Aktualisierung Umgebungstemperatur beim Kaltstart" UBYTE B_TRUE 1 100 0 1 BIT_MASK 0x2 FORMAT "%13.11" ECU_ADDRESS 0x800CA8 /end MEASUREMENT
/begin MEASUREMENT B_tumnpl "Bedingung Umgebungstemperatur nicht plausibel" UBYTE B_TRUE 1 100 0 1 BIT_MASK 0x1 FORMAT "%13.11" ECU_ADDRESS 0x800CA8 /end MEASUREMENT
/begin MEASUREMENT B_ugd "Bedingung: DK-Winkel grˆﬂer als f¸r 95% der max. rel. F¸llung erforderlich" UBYTE B_TRUE 1 100 0 1 BIT_MASK 0x1 FORMAT "%13.11" ECU_ADDRESS 0x7FA658 /end MEASUREMENT
/begin MEASUREMENT B_ugdsp "Bedingung praedizierter DK-Sollwinkel im ungedrosselten Bereich" UBYTE B_TRUE 1 100 0 1 BIT_MASK 0x1 FORMAT "%13.11" ECU_ADDRESS 0x7FA61A /end MEASUREMENT
/begin MEASUREMENT B_uhrnpl "Bedingung Uhrinformation nicht plausibel" UBYTE B_TRUE 1 100 0 1 BIT_MASK 0x20 FORMAT "%13.11" ECU_ADDRESS 0x800CCD /end MEASUREMENT
/begin MEASUREMENT B_wdkhfu "Bdg: Berechnung  Winkels DK aus Signal des HF-Sensors ungedrosselt" UBYTE B_TRUE 1 100 0 1 BIT_MASK 0x1 FORMAT "%13.11" ECU_ADDRESS 0x7FA61B /end MEASUREMENT
/begin MEASUREMENT CalibOdo_Mode "" UBYTE DC_FLAG_U8 1 100 0 1 BIT_MASK 0x1 FORMAT "%5.3" ECU_ADDRESS 0x80367B /end MEASUREMENT
/begin MEASUREMENT CAN_ABC_Trq_Loss "" UBYTE DC_M3NM 1 100 0 42 FORMAT "%5.2" ECU_ADDRESS 0x80367C /end MEASUREMENT
/begin MEASUREMENT CAN_ACCompr2_Run_Mode "" UBYTE DC_FLAG_U8 1 100 0 1 BIT_MASK 0x1 FORMAT "%5.3" ECU_ADDRESS 0x80367D /end MEASUREMENT
/begin MEASUREMENT CAN_ACCompr2_Trq "" UBYTE DC_M3NM 1 100 0 765 FORMAT "%5.1" ECU_ADDRESS 0x80367E /end MEASUREMENT
/begin MEASUREMENT CAN_ACCompr_RefriPress "" UBYTE DC_UPAC 1 100 0 127.5 FORMAT "%5.1" ECU_ADDRESS 0x80367F /end MEASUREMENT
/begin MEASUREMENT CAN_ACCompr_Trq "" UBYTE DC_M3NM 1 100 0 765 FORMAT "%5.1" ECU_ADDRESS 0x803680 /end MEASUREMENT
/begin MEASUREMENT CAN_ACS_CrashConfirmBit_Mode "" UBYTE DC_FLAG_U8 1 100 0 1 BIT_MASK 0x1 FORMAT "%5.3" ECU_ADDRESS 0x803681 /end MEASUREMENT
/begin MEASUREMENT CAN_ACS_Crash_Mode "" UBYTE DC_FLAG_U8 1 100 0 1 BIT_MASK 0x1 FORMAT "%5.3" ECU_ADDRESS 0x803682 /end MEASUREMENT
/begin MEASUREMENT CAN_AdapAltitude_Coef "" UBYTE DC_FCTR_128_U8 1 100 0 1.99219 ECU_ADDRESS 0x8037F6 /end MEASUREMENT
/begin MEASUREMENT CAN_AdapCrsCtrl_Trq_Req "" UWORD DC_MMQ13 1 100 -500 1547.75 ECU_ADDRESS 0x80302A /end MEASUREMENT
/begin MEASUREMENT CAN_ADD_APPGrdt_Thres "" UBYTE DC_CNTR_U8 1 100 0 255 FORMAT "%5.1" ECU_ADDRESS 0x8037FB /end MEASUREMENT
/begin MEASUREMENT CAN_ADD_CDS_CAN "" UBYTE DC_CNTR_U8 1 100 0 255 FORMAT "%5.1" ECU_ADDRESS 0x8037FA /end MEASUREMENT
/begin MEASUREMENT CAN_ADD_Nerv_Detct "" UBYTE DC_CNTR_U8 1 100 0 255 FORMAT "%5.1" ECU_ADDRESS 0x8037F9 /end MEASUREMENT
/begin MEASUREMENT CAN_AMT_Creep_Trq_Req "" UBYTE DC_MMQ075_U8DB 1 100 0 191.25 FORMAT "%4.0" ECU_ADDRESS 0x803683 /end MEASUREMENT
/begin MEASUREMENT CAN_APP_ADD_Out_ub "" UBYTE DC_PCT_2P5_U8 1 100 0 102 ECU_ADDRESS 0x8037F8 /end MEASUREMENT
/begin MEASUREMENT CAN_APP_Out_ub "" UBYTE DC_PCT_2P5_U8 1 100 0 102 ECU_ADDRESS 0x8037F7 /end MEASUREMENT
/begin MEASUREMENT CAN_Brk "" UBYTE DC_CNTR_U8 1 100 0 3 FORMAT "%5.3" ECU_ADDRESS 0x803684 /end MEASUREMENT
/begin MEASUREMENT CAN_BrkLight "" UBYTE DC_CNTR_U8 1 100 0 3 FORMAT "%5.3" ECU_ADDRESS 0x803685 /end MEASUREMENT
/begin MEASUREMENT CAN_Cod_Body "" UBYTE DC_CNTR_U8 1 100 0 255 FORMAT "%5.1" ECU_ADDRESS 0x8037F5 /end MEASUREMENT
/begin MEASUREMENT CAN_Cod_ModelRange "" UBYTE DC_CNTR_U8 1 100 0 255 FORMAT "%5.1" ECU_ADDRESS 0x8037F4 /end MEASUREMENT
/begin MEASUREMENT CAN_CrsCtrl_Coor_Trq "" UWORD DC_MMQ13 1 100 -500 1547.75 ECU_ADDRESS 0x80326E /end MEASUREMENT
/begin MEASUREMENT CAN_DrvrInput_Trq_Req "" UWORD DC_MMQ13 1 100 -500 1547.75 ECU_ADDRESS 0x80326C /end MEASUREMENT
/begin MEASUREMENT CAN_Dspl_EngShutOff_Time "" UBYTE DC_DEZ 1 100 0 255 FORMAT "%5.1" ECU_ADDRESS 0x803686 /end MEASUREMENT
/begin MEASUREMENT CAN_Dspl_VS "" UBYTE DC_VQV1 1 100 0 255 FORMAT "%5.1" ECU_ADDRESS 0x8037F3 /end MEASUREMENT
/begin MEASUREMENT CAN_Dspl_WinterTire_SpdMax "" UBYTE DC_DEZ 1 100 0 15 FORMAT "%5.2" ECU_ADDRESS 0x803687 /end MEASUREMENT
/begin MEASUREMENT CAN_Dspl_WinterTire_SpdMax_Mode "" UBYTE DC_FLAG_U8 1 100 0 1 BIT_MASK 0x1 FORMAT "%5.3" ECU_ADDRESS 0x803688 /end MEASUREMENT
/begin MEASUREMENT CAN_ECF_Pwr_Req "" UBYTE DC_CNTR_U8 1 100 0 255 FORMAT "%5.1" ECU_ADDRESS 0x803689 /end MEASUREMENT
/begin MEASUREMENT CAN_ECTIn "" UBYTE DC_UTMP_40 1 100 -40 215 FORMAT "%5.1" ECU_ADDRESS 0x8037F2 /end MEASUREMENT
/begin MEASUREMENT CAN_Ena_CCM_Mode "" UBYTE DC_FLAG_U8 1 100 0 1 FORMAT "%5.3" ECU_ADDRESS 0x80380E /end MEASUREMENT
/begin MEASUREMENT CAN_Ena_CSTCM_Mode "" UBYTE DC_FLAG_U8 1 100 0 1 FORMAT "%5.3" ECU_ADDRESS 0x80380D /end MEASUREMENT
/begin MEASUREMENT CAN_Ena_Default_Mode "" UBYTE DC_FLAG_U8 1 100 0 1 FORMAT "%5.3" ECU_ADDRESS 0x803809 /end MEASUREMENT
/begin MEASUREMENT CAN_Ena_ESM_Mode "" UBYTE DC_FLAG_U8 1 100 0 1 FORMAT "%5.3" ECU_ADDRESS 0x80380A /end MEASUREMENT
/begin MEASUREMENT CAN_Ena_Trans_Mode "" UBYTE DC_FLAG_U8 1 100 0 1 FORMAT "%5.3" ECU_ADDRESS 0x80380B /end MEASUREMENT
/begin MEASUREMENT CAN_Eng_Spd "" UWORD DC_NQ1_W 1 100 0 65535 FORMAT "%8.2" ECU_ADDRESS 0x80326A /end MEASUREMENT
/begin MEASUREMENT CAN_Eng_Trq "" UWORD DC_MMQ13 1 100 -500 1547.75 ECU_ADDRESS 0x803264 /end MEASUREMENT
/begin MEASUREMENT CAN_Eng_TrqMaxKC "" UWORD DC_MMQ13 1 100 -500 1547.75 ECU_ADDRESS 0x803268 /end MEASUREMENT
/begin MEASUREMENT CAN_Eng_TrqMin "" UWORD DC_MMQ13 1 100 -500 1547.75 ECU_ADDRESS 0x803266 /end MEASUREMENT
/begin MEASUREMENT CAN_ESP_Info "" UBYTE DC_CNTR_U8 1 100 0 3 FORMAT "%5.3" ECU_ADDRESS 0x80368A /end MEASUREMENT
/begin MEASUREMENT CAN_ESP_Trq_Req "" UWORD DC_MMQ13 1 100 -500 1547.75 ECU_ADDRESS 0x80302C /end MEASUREMENT
/begin MEASUREMENT CAN_ExtAir_Temp "" UBYTE DC_TEMP_2_U8 1 100 -40 87.5 FORMAT "%8.5" ECU_ADDRESS 0x80368B /end MEASUREMENT
/begin MEASUREMENT CAN_Fuel_Cons "" UWORD DC_CNTR_U16 1 100 0 65535 FORMAT "%8.2" ECU_ADDRESS 0x803262 /end MEASUREMENT
/begin MEASUREMENT CAN_GearRatio_HighLim_Req "" UBYTE DC_FCTR_50_U8 1 100 0 5.1 FORMAT "%8.6" ECU_ADDRESS 0x8037F1 /end MEASUREMENT
/begin MEASUREMENT CAN_GearRatio_LowLim_Req "" UBYTE DC_FCTR_50_U8 1 100 0 5.1 FORMAT "%8.6" ECU_ADDRESS 0x8037F0 /end MEASUREMENT
/begin MEASUREMENT CAN_Gen_Utz "" UBYTE DC_CNTR_U8 1 100 0 63 FORMAT "%5.2" ECU_ADDRESS 0x8037EF /end MEASUREMENT
/begin MEASUREMENT CAN_IdleSpd_Req "" UWORD DC_NQ1_W 1 100 0 65535 FORMAT "%8.2" ECU_ADDRESS 0x803260 /end MEASUREMENT
/begin MEASUREMENT CAN_IgnSwStrtCAN_Mode "" UBYTE DC_FLAG_U8 1 100 0 1 BIT_MASK 0x1 FORMAT "%5.3" ECU_ADDRESS 0x80368C /end MEASUREMENT
/begin MEASUREMENT CAN_IntkAir_Temp "" UBYTE DC_UTMP_40 1 100 -40 215 FORMAT "%5.1" ECU_ADDRESS 0x8037EE /end MEASUREMENT
/begin MEASUREMENT CAN_KeylessGo_Enabl_Mode "" UBYTE DC_FLAG_U8 1 100 0 1 BIT_MASK 0x1 FORMAT "%5.3" ECU_ADDRESS 0x80368D /end MEASUREMENT
/begin MEASUREMENT CAN_KeylessGo_StrtEnabl_Mode "" UBYTE DC_FLAG_U8 1 100 0 1 BIT_MASK 0x1 FORMAT "%5.3" ECU_ADDRESS 0x80368E /end MEASUREMENT
/begin MEASUREMENT CAN_Odo_Abs "" UWORD DC_FAK2LDB 1 100 0 131070 FORMAT "%7.0" ECU_ADDRESS 0x80302E /end MEASUREMENT
/begin MEASUREMENT CAN_Sen_Oil_Lvl "" UBYTE DC_OEL_STAND 1 100 0 80.315 FORMAT "%5.2" ECU_ADDRESS 0x8037ED /end MEASUREMENT
/begin MEASUREMENT CAN_Sen_Oil_Qual "" UBYTE DC_OEL_QUAL 1 100 1 6 FORMAT "%5.3" ECU_ADDRESS 0x8037EC /end MEASUREMENT
/begin MEASUREMENT CAN_Sen_Oil_Temp "" UBYTE DC_COEL_TMP 1 100 -40 215 FORMAT "%5.1" ECU_ADDRESS 0x8037EB /end MEASUREMENT
/begin MEASUREMENT CAN_SteeringAngle "" UWORD DC_WL05_U16DB 1 100 0 720 FORMAT "%5.1" ECU_ADDRESS 0x803030 /end MEASUREMENT
/begin MEASUREMENT CAN_Strt_Mode "" UBYTE DC_FLAG_U8 1 100 0 1 BIT_MASK 0x1 FORMAT "%5.3" ECU_ADDRESS 0x8037EA /end MEASUREMENT
/begin MEASUREMENT CAN_Tank_Lvl "" UBYTE DC_VQ1LT_U8 1 100 0 255 FORMAT "%9.5" ECU_ADDRESS 0x80368F /end MEASUREMENT
/begin MEASUREMENT CAN_TCM_Actl_Ratio "" UBYTE DC_FCTR_50_U8 1 100 0 5.1 FORMAT "%8.6" ECU_ADDRESS 0x803690 /end MEASUREMENT
/begin MEASUREMENT CAN_TCM_Diag_Cod "" UBYTE DC_CNTR_U8 1 100 0 15 FORMAT "%5.2" ECU_ADDRESS 0x803691 /end MEASUREMENT
/begin MEASUREMENT CAN_TCM_Diag_Failure "" UBYTE DC_CNTR_U8 1 100 0 15 FORMAT "%5.2" ECU_ADDRESS 0x803692 /end MEASUREMENT
/begin MEASUREMENT CAN_TCM_Trq_Req "" UWORD DC_MMQ13 1 100 -500 1547.75 ECU_ADDRESS 0x803032 /end MEASUREMENT
/begin MEASUREMENT CAN_Trans_Gear_Actl "" UBYTE DC_CNTR_U8 1 100 0 15 FORMAT "%5.2" ECU_ADDRESS 0x803693 /end MEASUREMENT
/begin MEASUREMENT CAN_Trans_Gear_Tgt "" UBYTE DC_CNTR_U8 1 100 0 15 FORMAT "%5.2" ECU_ADDRESS 0x803694 /end MEASUREMENT
/begin MEASUREMENT CAN_Trans_SelectorPosn "" UBYTE DC_CNTR_U8 1 100 0 15 FORMAT "%5.2" ECU_ADDRESS 0x803695 /end MEASUREMENT
/begin MEASUREMENT CAN_TrqCoor_ESPOrMSL_Req "" UWORD DC_MMQ13 1 100 -500 1547.75 ECU_ADDRESS 0x80325E /end MEASUREMENT
/begin MEASUREMENT CAN_TrvrAccel "" UBYTE DC_UAYS_U8DB 1 100 -10.24 10.16 FORMAT "%5.2" ECU_ADDRESS 0x803696 /end MEASUREMENT
/begin MEASUREMENT CAN_Veh_MaxSpd "" UBYTE DC_VQV1 1 100 0 255 FORMAT "%5.1" ECU_ADDRESS 0x8037E9 /end MEASUREMENT
/begin MEASUREMENT CAN_Veh_Spd_Raw "" UWORD DC_URD_05 1 100 0 8191 FORMAT "%8.3" ECU_ADDRESS 0x803034 /end MEASUREMENT
/begin MEASUREMENT CAN_VES_Info "" UBYTE DC_CNTR_U8 1 100 0 1 FORMAT "%5.3" ECU_ADDRESS 0x803697 /end MEASUREMENT
/begin MEASUREMENT CAN_WhlSpdFrontLeft "" UWORD DC_URD_05 1 100 0 8191 FORMAT "%8.3" ECU_ADDRESS 0x803036 /end MEASUREMENT
/begin MEASUREMENT CAN_WhlSpdFrontRight "" UWORD DC_URD_05 1 100 0 8191 FORMAT "%8.3" ECU_ADDRESS 0x803038 /end MEASUREMENT
/begin MEASUREMENT CAN_WhlSpdRearLeft "" UWORD DC_URD_05 1 100 0 8191 FORMAT "%8.3" ECU_ADDRESS 0x80303A /end MEASUREMENT
/begin MEASUREMENT CAN_WhlSpdRearRight "" UWORD DC_URD_05 1 100 0 8191 FORMAT "%8.3" ECU_ADDRESS 0x80303C /end MEASUREMENT
/begin MEASUREMENT CCM_340h_MsgLost_Cntr "" UBYTE DC_CNTR_U8 1 100 0 255 FORMAT "%5.1" ECU_ADDRESS 0x8037CE /end MEASUREMENT
/begin MEASUREMENT CCM_340h_MsgLost_DeBnc_Mode "" UBYTE DC_FLAG_U8 1 100 0 1 BIT_MASK 0x1 FORMAT "%5.3" ECU_ADDRESS 0x8037CD /end MEASUREMENT
/begin MEASUREMENT CCM_340h_MsgLost_State_Mode "" UBYTE DC_FLAG_U8 1 100 0 1 BIT_MASK 0x1 FORMAT "%5.3" ECU_ADDRESS 0x803698 /end MEASUREMENT
/begin MEASUREMENT CGW_248h_MsgLost_Cntr "" UBYTE DC_CNTR_U8 1 100 0 255 FORMAT "%5.1" ECU_ADDRESS 0x8037D0 /end MEASUREMENT
/begin MEASUREMENT CGW_248h_MsgLost_DeBnc_Mode "" UBYTE DC_FLAG_U8 1 100 0 1 BIT_MASK 0x1 FORMAT "%5.3" ECU_ADDRESS 0x8037CF /end MEASUREMENT
/begin MEASUREMENT CGW_248h_MsgLost_State_Mode "" UBYTE DC_FLAG_U8 1 100 0 1 BIT_MASK 0x1 FORMAT "%5.3" ECU_ADDRESS 0x803699 /end MEASUREMENT
/begin MEASUREMENT CGW_6FFh_MsgLost_Cntr "" UBYTE DC_CNTR_U8 1 100 0 255 FORMAT "%5.1" ECU_ADDRESS 0x8037E4 /end MEASUREMENT
/begin MEASUREMENT CGW_6FFh_MsgLost_DeBnc_Mode "" UBYTE DC_FLAG_U8 1 100 0 1 BIT_MASK 0x1 FORMAT "%5.3" ECU_ADDRESS 0x8037D7 /end MEASUREMENT
/begin MEASUREMENT CGW_6FFh_MsgLost_State_Mode "" UBYTE DC_FLAG_U8 1 100 0 1 BIT_MASK 0x1 FORMAT "%5.3" ECU_ADDRESS 0x80369A /end MEASUREMENT
/begin MEASUREMENT Cod_Aggr_Gen "" UBYTE DC_CNTR_U8 1 100 0 255 FORMAT "%5.1" ECU_ADDRESS 0x80384D /end MEASUREMENT
/begin MEASUREMENT Cod_Aggr_Gen_1 "" UBYTE DC_FLAG_U8 1 100 0 1 BIT_MASK 0x1 FORMAT "%5.3" ECU_ADDRESS 0x803838 /end MEASUREMENT
/begin MEASUREMENT Cod_Aggr_Gen_2 "" UBYTE DC_FLAG_U8 1 100 0 1 BIT_MASK 0x1 FORMAT "%5.3" ECU_ADDRESS 0x803830 /end MEASUREMENT
/begin MEASUREMENT Cod_Aggr_LHD "" UBYTE DC_FLAG_U8 1 100 0 1 BIT_MASK 0x1 FORMAT "%5.3" ECU_ADDRESS 0x803843 /end MEASUREMENT
/begin MEASUREMENT Cod_Aggr_TSC "" UBYTE DC_FLAG_U8 1 100 0 1 BIT_MASK 0x1 FORMAT "%5.3" ECU_ADDRESS 0x803831 /end MEASUREMENT
/begin MEASUREMENT Cod_Aggr_TVDiag "" UBYTE DC_CNTR_U8 1 100 0 1 FORMAT "%5.3" ECU_ADDRESS 0x80384E /end MEASUREMENT
/begin MEASUREMENT Cod_Aggr_VCV "" UBYTE DC_FLAG_U8 1 100 0 1 BIT_MASK 0x1 FORMAT "%5.3" ECU_ADDRESS 0x803853 /end MEASUREMENT
/begin MEASUREMENT Cod_CANMembr_ABC "" UBYTE DC_FLAG_U8 1 100 0 1 BIT_MASK 0x1 FORMAT "%5.3" ECU_ADDRESS 0x80383B /end MEASUREMENT
/begin MEASUREMENT Cod_CANMembr_ACCompr "" UBYTE DC_FLAG_U8 1 100 0 1 BIT_MASK 0x1 FORMAT "%5.3" ECU_ADDRESS 0x80383D /end MEASUREMENT
/begin MEASUREMENT Cod_CANMembr_ACCompr2 "" UBYTE DC_FLAG_U8 1 100 0 1 BIT_MASK 0x1 FORMAT "%5.3" ECU_ADDRESS 0x803841 /end MEASUREMENT
/begin MEASUREMENT Cod_CANMembr_CTM "" UBYTE DC_FLAG_U8 1 100 0 1 BIT_MASK 0x1 FORMAT "%5.3" ECU_ADDRESS 0x80383E /end MEASUREMENT
/begin MEASUREMENT Cod_CANMembr_EIL "" UBYTE DC_FLAG_U8 1 100 0 1 BIT_MASK 0x1 FORMAT "%5.3" ECU_ADDRESS 0x803840 /end MEASUREMENT
/begin MEASUREMENT Cod_CANMembr_ESL "" UBYTE DC_FLAG_U8 1 100 0 1 BIT_MASK 0x1 FORMAT "%5.3" ECU_ADDRESS 0x80383C /end MEASUREMENT
/begin MEASUREMENT Cod_CANMembr_MSW "" UBYTE DC_FLAG_U8 1 100 0 1 BIT_MASK 0x1 FORMAT "%5.3" ECU_ADDRESS 0x80383F /end MEASUREMENT
/begin MEASUREMENT Cod_CANMembr_SBC "" UBYTE DC_FLAG_U8 1 100 0 1 BIT_MASK 0x1 FORMAT "%5.3" ECU_ADDRESS 0x803842 /end MEASUREMENT
/begin MEASUREMENT Cod_Drvabl_AdapCrsCtrl "" UBYTE DC_FLAG_U8 1 100 0 1 BIT_MASK 0x1 FORMAT "%5.3" ECU_ADDRESS 0x80382F /end MEASUREMENT
/begin MEASUREMENT Cod_Drvabl_ADD "" UBYTE DC_FLAG_U8 1 100 0 1 BIT_MASK 0x1 FORMAT "%5.3" ECU_ADDRESS 0x803851 /end MEASUREMENT
/begin MEASUREMENT Cod_Drvabl_AP "" UBYTE DC_CNTR_U8 1 100 0 1 FORMAT "%5.3" ECU_ADDRESS 0x803850 /end MEASUREMENT
/begin MEASUREMENT Cod_Drvabl_CrsCtrl "" UBYTE DC_CNTR_U8 1 100 0 255 FORMAT "%5.1" ECU_ADDRESS 0x803828 /end MEASUREMENT
/begin MEASUREMENT Cod_Drvabl_CrsCtrl_Mode "" UBYTE DC_FLAG_U8 1 100 0 1 BIT_MASK 0x1 FORMAT "%5.3" ECU_ADDRESS 0x803836 /end MEASUREMENT
/begin MEASUREMENT Cod_Drvabl_CrsCtrl_VSL "" UBYTE DC_FLAG_U8 1 100 0 1 BIT_MASK 0x1 FORMAT "%5.3" ECU_ADDRESS 0x80382E /end MEASUREMENT
/begin MEASUREMENT Cod_Drvabl_Dashp "" UBYTE DC_FLAG_U8 1 100 0 1 BIT_MASK 0x1 FORMAT "%5.3" ECU_ADDRESS 0x803826 /end MEASUREMENT
/begin MEASUREMENT Cod_Drvabl_EmergOp "" UBYTE DC_FLAG_U8 1 100 0 1 BIT_MASK 0x1 FORMAT "%5.3" ECU_ADDRESS 0x803839 /end MEASUREMENT
/begin MEASUREMENT Cod_Drvabl_LTC "" UBYTE DC_FLAG_U8 1 100 0 1 BIT_MASK 0x1 FORMAT "%5.3" ECU_ADDRESS 0x803827 /end MEASUREMENT
/begin MEASUREMENT Cod_Func_ACComprAltitude_Mode "" UBYTE DC_FLAG_U8 1 100 0 1 BIT_MASK 0x1 FORMAT "%5.3" ECU_ADDRESS 0x803845 /end MEASUREMENT
/begin MEASUREMENT Cod_Func_BoilProt "" UBYTE DC_FLAG_U8 1 100 0 1 BIT_MASK 0x1 FORMAT "%5.3" ECU_ADDRESS 0x803848 /end MEASUREMENT
/begin MEASUREMENT Cod_Func_IdleSpdSw "" UBYTE DC_FLAG_U8 1 100 0 1 BIT_MASK 0x1 FORMAT "%5.3" ECU_ADDRESS 0x80384A /end MEASUREMENT
/begin MEASUREMENT Cod_Func_SGStrat "" UBYTE DC_CNTR_U8 1 100 0 255 FORMAT "%5.1" ECU_ADDRESS 0x80384B /end MEASUREMENT
/begin MEASUREMENT Cod_Func_SLP "" UBYTE DC_FLAG_U8 1 100 0 1 BIT_MASK 0x1 FORMAT "%5.3" ECU_ADDRESS 0x803849 /end MEASUREMENT
/begin MEASUREMENT Cod_Model "" ULONG DC_CNTR_U32 1 100 0 65536 FORMAT "%13.7" ECU_ADDRESS 0x802E98 /end MEASUREMENT
/begin MEASUREMENT Cod_Model_Cntr "" UBYTE DC_FLAG_U8 1 100 0 1 BIT_MASK 0x1 FORMAT "%5.3" ECU_ADDRESS 0x80383A /end MEASUREMENT
/begin MEASUREMENT Cod_TM_FC "" UBYTE DC_CNTR_U8 1 100 0 255 FORMAT "%5.1" ECU_ADDRESS 0x803847 /end MEASUREMENT
/begin MEASUREMENT Cod_TM_FCRunOn "" UBYTE DC_FLAG_U8 1 100 0 1 BIT_MASK 0x1 FORMAT "%5.3" ECU_ADDRESS 0x80384C /end MEASUREMENT
/begin MEASUREMENT Cod_TM_Rslt "" UBYTE DC_CNTR_U8 1 100 0 255 FORMAT "%5.1" ECU_ADDRESS 0x80384F /end MEASUREMENT
/begin MEASUREMENT Cod_Trans2_FWD "" UBYTE DC_FLAG_U8 1 100 0 1 BIT_MASK 0x1 FORMAT "%5.3" ECU_ADDRESS 0x803844 /end MEASUREMENT
/begin MEASUREMENT Cod_Trans_AWD "" UBYTE DC_FLAG_U8 1 100 0 1 BIT_MASK 0x1 FORMAT "%5.3" ECU_ADDRESS 0x80382A /end MEASUREMENT
/begin MEASUREMENT Cod_Trans_SpdLim "" UBYTE DC_CNTR_U8 1 100 0 255 FORMAT "%5.1" ECU_ADDRESS 0x803829 /end MEASUREMENT
/begin MEASUREMENT Cod_Trans_Type "" UBYTE DC_CNTR_U8 1 100 0 255 FORMAT "%5.1" ECU_ADDRESS 0x803852 /end MEASUREMENT
/begin MEASUREMENT Cod_WhlFront_Circumfer "" SWORD DC_DST_MM_S16 1 100 0 4095.88 FORMAT "%8.3" ECU_ADDRESS 0x80328C /end MEASUREMENT
/begin MEASUREMENT Cod_WhlRear_Circumfer "" SWORD DC_DST_MM_S16 1 100 0 4095.88 FORMAT "%8.3" ECU_ADDRESS 0x80328A /end MEASUREMENT
/begin MEASUREMENT co_pot "Leerlauf-CO-Gemisch-Versteller" SBYTE dez 1 100 -128 127 FORMAT "%5.1" ECU_ADDRESS 0x8011BF /end MEASUREMENT
/begin MEASUREMENT co_pot_w "Leerlauf-CO-Gemisch-Versteller" SWORD dez 1 100 -32768 32767 FORMAT "%8.2" ECU_ADDRESS 0x801750 /end MEASUREMENT
/begin MEASUREMENT CreepingDetct_Mode "" UBYTE DC_FLAG_U8 1 100 0 1 BIT_MASK 0x1 FORMAT "%5.3" ECU_ADDRESS 0x8037E8 /end MEASUREMENT
/begin MEASUREMENT CreepingDsabl_Mode "" UBYTE DC_B_POS 1 100 0 1 BIT_MASK 0x1 FORMAT "%5.3" ECU_ADDRESS 0x8037E7 /end MEASUREMENT
/begin MEASUREMENT CrsCtrlDsplDsable_Mode "" UBYTE DC_FLAG_U8 1 100 0 1 BIT_MASK 0x1 FORMAT "%5.3" ECU_ADDRESS 0x80369B /end MEASUREMENT
/begin MEASUREMENT CrsCtrlDspl_Mode "" UBYTE DC_FLAG_U8 1 100 0 1 BIT_MASK 0x1 FORMAT "%5.3" ECU_ADDRESS 0x80369C /end MEASUREMENT
/begin MEASUREMENT CSTCM_428h_MsgLost_Cntr "" UBYTE DC_CNTR_U8 1 100 0 255 FORMAT "%5.1" ECU_ADDRESS 0x8037CA /end MEASUREMENT
/begin MEASUREMENT CSTCM_428h_MsgLost_DeBnc_Mode "" UBYTE DC_FLAG_U8 1 100 0 1 BIT_MASK 0x1 FORMAT "%5.3" ECU_ADDRESS 0x8037C8 /end MEASUREMENT
/begin MEASUREMENT CSTCM_428h_MsgLost_State_Mode "" UBYTE DC_FLAG_U8 1 100 0 1 BIT_MASK 0x1 FORMAT "%5.3" ECU_ADDRESS 0x80369D /end MEASUREMENT
/begin MEASUREMENT CVT_Mode "" UBYTE DC_FLAG_U8 1 100 0 1 BIT_MASK 0x1 FORMAT "%5.3" ECU_ADDRESS 0x803832 /end MEASUREMENT
/begin MEASUREMENT dcycnt "Driving cycle - counter" UWORD dez 1 100 0 65535 FORMAT "%8.2" ECU_ADDRESS 0x7FC37C /end MEASUREMENT
/begin MEASUREMENT dfrlkl2a_w "Differenz zwischen KFURLKL2A und KFURLA" SWORD rel_sw_b0p15 1 100 -0.15 0.149995 FORMAT "%9.7" ECU_ADDRESS 0x8012F0 /end MEASUREMENT
/begin MEASUREMENT dfrlkl2e_w "Differenz zwischen KFURLKL2E und KFURLE" SWORD rel_sw_b0p15 1 100 -0.15 0.149995 FORMAT "%9.7" ECU_ADDRESS 0x8012F2 /end MEASUREMENT
/begin MEASUREMENT dfupsrla_w "Delta zwischen Kennfeldern ohne SU und Kennfeldern mit SU(Auslaﬂ-NWS)" SWORD rel_sw_b0p15 1 100 -0.15 0.149995 FORMAT "%9.7" ECU_ADDRESS 0x8012F4 /end MEASUREMENT
/begin MEASUREMENT dfupsrle_w "Delta zwischen Kennfeldern ohne SU und Kennfeldern mit SU(Einlaﬂ-NWS)" SWORD rel_sw_b0p15 1 100 -0.15 0.149995 FORMAT "%9.7" ECU_ADDRESS 0x8012F6 /end MEASUREMENT
/begin MEASUREMENT dfurlsua_w "Differenz zwischen KFURLKL12A und KFURLSUA" SWORD rel_sw_b0p15 1 100 -0.15 0.149995 FORMAT "%9.7" ECU_ADDRESS 0x8012F8 /end MEASUREMENT
/begin MEASUREMENT dfurlsue_w "Differenz zwischen KFURLKL12E und KFURLSUE" SWORD rel_sw_b0p15 1 100 -0.15 0.149995 FORMAT "%9.7" ECU_ADDRESS 0x8012FA /end MEASUREMENT
/begin MEASUREMENT dmsdkugd_w "Massenstromdelta bei ps/pvdkds>0.95 (ungedrosselten)" UWORD m_uw_b6553p5 1 100 0 6553.5 FORMAT "%8.3" ECU_ADDRESS 0x801462 /end MEASUREMENT
/begin MEASUREMENT dnmotas_w "Differenzdrehzahl ¸ber ein Arbeitsspiel" SWORD nmot_sw_q0p25 1 100 -8192 8191.75 FORMAT "%8.3" ECU_ADDRESS 0x8017C2 /end MEASUREMENT
/begin MEASUREMENT dnmot_w "Differenzdrehzahl zwischen zwei folgenden Segmenten" SWORD nmot_sw_q0p25 1 100 -8192 8191.75 FORMAT "%8.3" ECU_ADDRESS 0x8017C4 /end MEASUREMENT
/begin MEASUREMENT dpbra_w "Delta zwischen Kennfeldern ohne SU und Kennfeldern mit SU(Auslaﬂ-NWS)" SWORD p_sw_q0p039 1 100 -1280 1279.96 FORMAT "%8.3" ECU_ADDRESS 0x8012FC /end MEASUREMENT
/begin MEASUREMENT dpbre_w "Delta zwischen Kennfeldern ohne SU und Kennfeldern mit SU(Einlaﬂ-NWS)" SWORD p_sw_q0p039 1 100 -1280 1279.96 FORMAT "%8.3" ECU_ADDRESS 0x8012FE /end MEASUREMENT
/begin MEASUREMENT dprgkl2a_w "Delta zwischen prga_w und prgkl2a_w" SWORD p_sw_q0p039 1 100 -1280 1279.96 FORMAT "%8.3" ECU_ADDRESS 0x801300 /end MEASUREMENT
/begin MEASUREMENT dprgkl2e_w "Delta zwischen prge_w und prgkl2e_w" SWORD p_sw_q0p039 1 100 -1280 1279.96 FORMAT "%8.3" ECU_ADDRESS 0x801302 /end MEASUREMENT
/begin MEASUREMENT dprgsua_w "Delta zwischen prgsua_w und prgkl12a_w" SWORD p_sw_q0p039 1 100 -1280 1279.96 FORMAT "%8.3" ECU_ADDRESS 0x801304 /end MEASUREMENT
/begin MEASUREMENT dprgsue_w "Delta zwischen prgsue_w und prgkl12e_w" SWORD p_sw_q0p039 1 100 -1280 1279.96 FORMAT "%8.3" ECU_ADDRESS 0x801306 /end MEASUREMENT
/begin MEASUREMENT dpsfgk_w "delta-Frischgaspartialdruck im Saugrohr korrigiert" SWORD p_sw_q0p039 1 100 -1280 1279.96 FORMAT "%8.3" ECU_ADDRESS 0x801372 /end MEASUREMENT
/begin MEASUREMENT dpspps_w "Pr‰dizierte Saugrohrdruck‰nderung" SWORD p_sw_q0p039 1 100 -1280 1279.96 FORMAT "%8.3" ECU_ADDRESS 0x801374 /end MEASUREMENT
/begin MEASUREMENT drlas_w "F¸llungs‰nderung pro Arbeitsspiel" SWORD relNWU_q0p0234 1 100 -768 767.977 FORMAT "%8.4" ECU_ADDRESS 0x80138A /end MEASUREMENT
/begin MEASUREMENT drlfdkrp_w "Pr‰dizierte ƒnderung der zuflieﬂenden Luftmasse" SWORD rel_sw_q0p0234 1 100 -768 767.977 FORMAT "%8.4" ECU_ADDRESS 0x801376 /end MEASUREMENT
/begin MEASUREMENT drllad_w "Dynamikanteil der relativen F¸llung rl bei Laderdynamik" SWORD rel_sw_q0p0234 1 100 -768 767.977 FORMAT "%8.4" ECU_ADDRESS 0x80135A /end MEASUREMENT
/begin MEASUREMENT drlmprl_w "Pr‰dizierte ƒnderung der abflieﬂenden Luftmasse" SWORD rel_sw_q0p0234 1 100 -768 767.977 FORMAT "%8.4" ECU_ADDRESS 0x801378 /end MEASUREMENT
/begin MEASUREMENT drlp_w "delta-Einspritzberechnungs-Last aus Praediktion (Word)" SWORD rel_sw_q0p0234 1 100 -768 767.977 FORMAT "%8.4" ECU_ADDRESS 0x7FAA1A /end MEASUREMENT
/begin MEASUREMENT DrProgram "" UBYTE DC_CNTR_U8 1 100 0 15 FORMAT "%5.2" ECU_ADDRESS 0x80369E /end MEASUREMENT
/begin MEASUREMENT Dspl_408h_MsgLost_Cntr "" UBYTE DC_CNTR_U8 1 100 0 255 FORMAT "%5.1" ECU_ADDRESS 0x8037E3 /end MEASUREMENT
/begin MEASUREMENT Dspl_408h_MsgLost_DeBnc_Mode "" UBYTE DC_FLAG_U8 1 100 0 1 BIT_MASK 0x1 FORMAT "%5.3" ECU_ADDRESS 0x8037D6 /end MEASUREMENT
/begin MEASUREMENT Dspl_408h_MsgLost_State_Mode "" UBYTE DC_FLAG_U8 1 100 0 1 BIT_MASK 0x1 FORMAT "%5.3" ECU_ADDRESS 0x80369F /end MEASUREMENT
/begin MEASUREMENT Dspl_EngShutOff_Time "" UBYTE DC_DEZ 1 100 0 255 FORMAT "%5.1" ECU_ADDRESS 0x8037E6 /end MEASUREMENT
/begin MEASUREMENT Dspl_State2 "" UBYTE DC_CNTR_U8 1 100 0 255 FORMAT "%5.1" ECU_ADDRESS 0x8036A0 /end MEASUREMENT
/begin MEASUREMENT Dspl_WinterTire_SpdMax "" UBYTE DC_DEZ 1 100 0 7 FORMAT "%5.3" ECU_ADDRESS 0x8037E5 /end MEASUREMENT
/begin MEASUREMENT dtbrt_w "Brennraumtemperatur Dynamikanteil" SWORD temp_sw_q0p75 1 100 -24576 24575.3 FORMAT "%8.2" ECU_ADDRESS 0x800560 /end MEASUREMENT
/begin MEASUREMENT dtnwia2_l "Zeitdelta zwischen Eintreffen zweier genutzter Phasenflanken (Bank2)" ULONG t_q1p024_ms 1 100 0 4.39805e+009 FORMAT "%13.2" ECU_ADDRESS 0x801CF0 /end MEASUREMENT
/begin MEASUREMENT dtnwia_l "Zeitdelta zwischen Eintreffen zweier genutzter Phasenflanken" ULONG t_q1p024_ms 1 100 0 4.39805e+009 FORMAT "%13.2" ECU_ADDRESS 0x801CF4 /end MEASUREMENT
/begin MEASUREMENT dtnwie2_l "Zeitdelta zwischen Eintreffen zweier genutzter Phasenflanken (Bank2)" ULONG t_q1p024_ms 1 100 0 4.39805e+009 FORMAT "%13.2" ECU_ADDRESS 0x801CDC /end MEASUREMENT
/begin MEASUREMENT dtnwie_l "Zeitdelta zwischen Eintreffen zweier genutzter Phasenflanken" ULONG t_q1p024_ms 1 100 0 4.39805e+009 FORMAT "%13.2" ECU_ADDRESS 0x801CE0 /end MEASUREMENT
/begin MEASUREMENT dtsynwa2_l "Zeitdelta zwischen tsynwa2_l und tnwia2_l" ULONG t_q1p024_ms 1 100 0 4.39805e+009 FORMAT "%13.2" ECU_ADDRESS 0x801CF8 /end MEASUREMENT
/begin MEASUREMENT dtsynwa_l "Zeitdelta zwischen tsynwa_l und tnwia_l" ULONG t_q1p024_ms 1 100 0 4.39805e+009 FORMAT "%13.2" ECU_ADDRESS 0x801CFC /end MEASUREMENT
/begin MEASUREMENT dtsynwe2_l "Zeitdelta zwischen tsynwe2_l und tnwie2_l" ULONG t_q1p024_ms 1 100 0 4.39805e+009 FORMAT "%13.2" ECU_ADDRESS 0x801CE4 /end MEASUREMENT
/begin MEASUREMENT dtsynwe_l "Zeitdelta zwischen tsynwe_l und tnwie_l" ULONG t_q1p024_ms 1 100 0 4.39805e+009 FORMAT "%13.2" ECU_ADDRESS 0x801CE8 /end MEASUREMENT
/begin MEASUREMENT dv_lh "Radgeschwindigkeitsdifferenz links hinten" SWORD vfzg_uw_q0p0625 1 100 -2048 2047.94 FORMAT "%8.3" ECU_ADDRESS 0x8015EA /end MEASUREMENT
/begin MEASUREMENT dv_lv "Radgeschwindigkeitsdifferenz links vorne" SWORD vfzg_uw_q0p0625 1 100 -2048 2047.94 FORMAT "%8.3" ECU_ADDRESS 0x8015EC /end MEASUREMENT
/begin MEASUREMENT dv_rh "Radgeschwindigkeitsdifferenz rechts hinten" SWORD vfzg_uw_q0p0625 1 100 -2048 2047.94 FORMAT "%8.3" ECU_ADDRESS 0x8015EE /end MEASUREMENT
/begin MEASUREMENT dv_rv "Radgeschwindigkeitsdifferenz rechts vorne" SWORD vfzg_uw_q0p0625 1 100 -2048 2047.94 FORMAT "%8.3" ECU_ADDRESS 0x8015F0 /end MEASUREMENT
/begin MEASUREMENT ECF_Pwr_Req "" UBYTE DC_CNTR_U8 1 100 0 255 FORMAT "%5.1" ECU_ADDRESS 0x8037E2 /end MEASUREMENT
/begin MEASUREMENT EIL_240h_MsgLost_Cntr "" UBYTE DC_CNTR_U8 1 100 0 255 FORMAT "%5.1" ECU_ADDRESS 0x8037D2 /end MEASUREMENT
/begin MEASUREMENT EIL_240h_MsgLost_DeBnc_Mode "" UBYTE DC_FLAG_U8 1 100 0 1 BIT_MASK 0x1 FORMAT "%5.3" ECU_ADDRESS 0x8037D1 /end MEASUREMENT
/begin MEASUREMENT EIL_240h_MsgLost_State_Mode "" UBYTE DC_FLAG_U8 1 100 0 1 BIT_MASK 0x1 FORMAT "%5.3" ECU_ADDRESS 0x8036A1 /end MEASUREMENT
/begin MEASUREMENT EIL_SCT_MsgLost_DeBnc_Mode "" UBYTE DC_FLAG_U8 1 100 0 1 BIT_MASK 0x1 FORMAT "%5.3" ECU_ADDRESS 0x8037FC /end MEASUREMENT
/begin MEASUREMENT EIL_State1 "" UBYTE DC_CNTR_U8 1 100 0 255 FORMAT "%5.1" ECU_ADDRESS 0x8036A2 /end MEASUREMENT
/begin MEASUREMENT EIL_State2 "" UBYTE DC_CNTR_U8 1 100 0 255 FORMAT "%5.1" ECU_ADDRESS 0x8036A3 /end MEASUREMENT
/begin MEASUREMENT EIL_State3 "" UBYTE DC_CNTR_U8 1 100 0 255 FORMAT "%5.1" ECU_ADDRESS 0x8036A4 /end MEASUREMENT
/begin MEASUREMENT Eng_MinTrqCmb_Req "" SWORD DC_TRQ_S16 1 100 -2048 2047.94 FORMAT "%8.3" ECU_ADDRESS 0x8032A6 /end MEASUREMENT
/begin MEASUREMENT Eng_Spd "Drehzahl, gefiltert" SWORD DC_ROTSPD_S16 1 100 -16384 16383.5 FORMAT "%7.1" ECU_ADDRESS 0x8032AA /end MEASUREMENT
/begin MEASUREMENT Eng_TrqMax_Effct "" SWORD DC_TRQ_S16 1 100 -2048 2047.94 FORMAT "%8.3" ECU_ADDRESS 0x8032A2 /end MEASUREMENT
/begin MEASUREMENT ESM_230h_MsgLost_Cntr "" UBYTE DC_CNTR_U8 1 100 0 255 FORMAT "%5.1" ECU_ADDRESS 0x8037D5 /end MEASUREMENT
/begin MEASUREMENT ESM_230h_MsgLost_DeBnc_Mode "" UBYTE DC_FLAG_U8 1 100 0 1 BIT_MASK 0x1 FORMAT "%5.3" ECU_ADDRESS 0x8037D4 /end MEASUREMENT
/begin MEASUREMENT ESM_230h_MsgLost_State_Mode "" UBYTE DC_FLAG_U8 1 100 0 1 BIT_MASK 0x1 FORMAT "%5.3" ECU_ADDRESS 0x8036A5 /end MEASUREMENT
/begin MEASUREMENT ESP_200h_MsgLost_Cntr "" UBYTE DC_CNTR_U8 1 100 0 255 FORMAT "%5.1" ECU_ADDRESS 0x8037C7 /end MEASUREMENT
/begin MEASUREMENT ESP_200h_MsgLost_DeBnc_Mode "" UBYTE DC_FLAG_U8 1 100 0 1 BIT_MASK 0x1 FORMAT "%5.3" ECU_ADDRESS 0x8037C9 /end MEASUREMENT
/begin MEASUREMENT ESP_200h_MsgLost_State_Mode "" UBYTE DC_FLAG_U8 1 100 0 1 BIT_MASK 0x1 FORMAT "%5.3" ECU_ADDRESS 0x8036A6 /end MEASUREMENT
/begin MEASUREMENT ESP_208h_MsgLost_Cntr "" UBYTE DC_CNTR_U8 1 100 0 255 FORMAT "%5.1" ECU_ADDRESS 0x8037C5 /end MEASUREMENT
/begin MEASUREMENT ESP_208h_MsgLost_DeBnc_Mode "" UBYTE DC_FLAG_U8 1 100 0 1 BIT_MASK 0x1 FORMAT "%5.3" ECU_ADDRESS 0x8037C6 /end MEASUREMENT
/begin MEASUREMENT ESP_208h_MsgLost_State_Mode "" UBYTE DC_FLAG_U8 1 100 0 1 BIT_MASK 0x1 FORMAT "%5.3" ECU_ADDRESS 0x8036A7 /end MEASUREMENT
/begin MEASUREMENT ESP_300h_MsgLost_Cntr "" UBYTE DC_CNTR_U8 1 100 0 255 FORMAT "%5.1" ECU_ADDRESS 0x8037C2 /end MEASUREMENT
/begin MEASUREMENT ESP_300h_MsgLost_DeBnc_Mode "" UBYTE DC_FLAG_U8 1 100 0 1 BIT_MASK 0x1 FORMAT "%5.3" ECU_ADDRESS 0x8037C1 /end MEASUREMENT
/begin MEASUREMENT ESP_300h_MsgLost_State_Mode "" UBYTE DC_FLAG_U8 1 100 0 1 BIT_MASK 0x1 FORMAT "%5.3" ECU_ADDRESS 0x8036A8 /end MEASUREMENT
/begin MEASUREMENT ESP_328h_MsgLost_Cntr "" UBYTE DC_CNTR_U8 1 100 0 255 FORMAT "%5.1" ECU_ADDRESS 0x8037C4 /end MEASUREMENT
/begin MEASUREMENT ESP_328h_MsgLost_DeBnc_Mode "" UBYTE DC_FLAG_U8 1 100 0 1 BIT_MASK 0x1 FORMAT "%5.3" ECU_ADDRESS 0x8037C3 /end MEASUREMENT
/begin MEASUREMENT ESP_328h_MsgLost_State_Mode "" UBYTE DC_FLAG_U8 1 100 0 1 BIT_MASK 0x1 FORMAT "%5.3" ECU_ADDRESS 0x8036A9 /end MEASUREMENT
/begin MEASUREMENT ESP_CrsCtrlDsable_Mode_Req "" UBYTE DC_FLAG_U8 1 100 0 1 BIT_MASK 0x1 FORMAT "%5.3" ECU_ADDRESS 0x8036AA /end MEASUREMENT
/begin MEASUREMENT ESP_Dyn0_Mode "" UBYTE DC_FLAG_U8 1 100 0 1 BIT_MASK 0x1 FORMAT "%5.3" ECU_ADDRESS 0x8036AB /end MEASUREMENT
/begin MEASUREMENT ESP_Dyn_Mode_Req "" UBYTE DC_FLAG_U8 1 100 0 1 BIT_MASK 0x1 FORMAT "%5.3" ECU_ADDRESS 0x8036AC /end MEASUREMENT
/begin MEASUREMENT ESP_IndicLight_Mode "" UBYTE DC_FLAG_U8 1 100 0 1 BIT_MASK 0x1 FORMAT "%5.3" ECU_ADDRESS 0x8036AD /end MEASUREMENT
/begin MEASUREMENT ESP_InfoBit0 "" UBYTE DC_FLAG_U8 1 100 0 1 BIT_MASK 0x1 FORMAT "%5.3" ECU_ADDRESS 0x8037E1 /end MEASUREMENT
/begin MEASUREMENT ESP_InfoBit1 "" UBYTE DC_FLAG_U8 1 100 0 1 BIT_MASK 0x1 FORMAT "%5.3" ECU_ADDRESS 0x8037E0 /end MEASUREMENT
/begin MEASUREMENT ESP_Parity_Mode "" UBYTE DC_FLAG_U8 1 100 0 1 BIT_MASK 0x1 FORMAT "%5.3" ECU_ADDRESS 0x8036AE /end MEASUREMENT
/begin MEASUREMENT ESP_Tgl "" UBYTE DC_FLAG_U8 1 100 0 1 BIT_MASK 0x1 FORMAT "%5.3" ECU_ADDRESS 0x8036AF /end MEASUREMENT
/begin MEASUREMENT ESP_TrqMax_Mode_Req "" UBYTE DC_FLAG_U8 1 100 0 1 BIT_MASK 0x1 FORMAT "%5.3" ECU_ADDRESS 0x8036B0 /end MEASUREMENT
/begin MEASUREMENT ESP_TrqMin_Mode_Req "" UBYTE DC_FLAG_U8 1 100 0 1 BIT_MASK 0x1 FORMAT "%5.3" ECU_ADDRESS 0x8036B1 /end MEASUREMENT
/begin MEASUREMENT ESP_Trq_Req "" UWORD DC_MMQ13 1 100 -500 1547.75 ECU_ADDRESS 0x80325C /end MEASUREMENT
/begin MEASUREMENT ESP_Wheel_FrontLeft_Cntr "" UBYTE DC_CNTR_U8 1 100 0 255 FORMAT "%5.1" ECU_ADDRESS 0x8036B2 /end MEASUREMENT
/begin MEASUREMENT ESP_Wheel_FrontRight_Cntr "" UBYTE DC_CNTR_U8 1 100 0 255 FORMAT "%5.1" ECU_ADDRESS 0x8036B3 /end MEASUREMENT
/begin MEASUREMENT evtmod "Einlaﬂventiltemperatur modelliert (Temperaturmodell)" UBYTE temp_ub_q0p75_o48 1 100 -48 143.25 FORMAT "%5.1" ECU_ADDRESS 0x800558 /end MEASUREMENT
/begin MEASUREMENT ExtAir_Temp "" UBYTE DC_UTMP_40 1 100 -40 215 FORMAT "%5.1" ECU_ADDRESS 0x8037DF /end MEASUREMENT
/begin MEASUREMENT faftekf "Faktor Ausfuﬂ Tankentl¸ftungsventil: Wert aus Kennfeld" UBYTE fak_ub_b2 1 100 0 1.99219 FORMAT "%5.3" ECU_ADDRESS 0x8011C3 /end MEASUREMENT
/begin MEASUREMENT fafte_w "Faktor Ausfluﬂ Tankentl¸ftungsventil" UWORD fak_uw_b2 1 100 0 1.99997 FORMAT "%8.6" ECU_ADDRESS 0x80176A /end MEASUREMENT
/begin MEASUREMENT ffupsrlk_w "fupsrl-Korrektur bei groﬂen Lasten" UWORD fak_uw_b2 1 100 0 1.99997 FORMAT "%8.6" ECU_ADDRESS 0x801308 /end MEASUREMENT
/begin MEASUREMENT fkisrm_w "Aktuell g¸ltiger Saugrohrmodell Integratorbeiwert" UWORD fak_uw_b1 1 100 0 0.999985 FORMAT "%9.7" ECU_ADDRESS 0x800526 /end MEASUREMENT
/begin MEASUREMENT fkl2_w "Faktor Klappe 2(Ladungsbewegung oder Saugrohrumschaltung 2)" UWORD fak_uw_b1 1 100 0 0.999985 FORMAT "%9.7" ECU_ADDRESS 0x80130A /end MEASUREMENT
/begin MEASUREMENT fklaf_w "Faktor Ausfluﬂ (KLAF)" UWORD fak_uw_b2 1 100 0 1.99997 FORMAT "%8.6" ECU_ADDRESS 0x801464 /end MEASUREMENT
/begin MEASUREMENT fkvnwa_w "Korrekturfaktor f¸r berechnete Verstellgeschwindigkeit der NW Auslass" UWORD fak_uw_b2 1 100 0 1.99997 FORMAT "%8.6" ECU_ADDRESS 0x8014EC /end MEASUREMENT
/begin MEASUREMENT fkvnwe_w "Korrekturfaktor f¸r berechnete Verstellgeschwindigkeit der NW Einlaﬂ" UWORD fak_uw_b2 1 100 0 1.99997 FORMAT "%8.6" ECU_ADDRESS 0x8014E2 /end MEASUREMENT
/begin MEASUREMENT flamsl2_w "Faktor Lambda‰nderung durch Sekund‰rluft, Bank 2" UWORD fak_uw_b16 1 100 0 15.9998 FORMAT "%8.5" ECU_ADDRESS 0x800A32 /end MEASUREMENT
/begin MEASUREMENT flamslth_w "Faktor Lambda‰nderung bei theoretischer Sekund‰rluft" UWORD fak_uw_b16 1 100 0 15.9998 FORMAT "%8.5" ECU_ADDRESS 0x800A34 /end MEASUREMENT
/begin MEASUREMENT flamsl_w "Faktor Lambda‰nderung durch Sekund‰rluft" UWORD fak_uw_b16 1 100 0 15.9998 FORMAT "%8.5" ECU_ADDRESS 0x800A36 /end MEASUREMENT
/begin MEASUREMENT fmsagd "Korrekturfaktor Abgasgegendruck der Sekund‰rluftmasse" UBYTE fak_ub_b2 1 100 0 1.99219 FORMAT "%5.3" ECU_ADDRESS 0x800A5E /end MEASUREMENT
/begin MEASUREMENT fmsldyn "Faktor Dynamikbeschreibung Sekund‰rluft" UBYTE fak_ub_b1 1 100 0 0.996094 ECU_ADDRESS 0x800A5F /end MEASUREMENT
/begin MEASUREMENT fmslkor "Faktor zur Korrektur der Sekund‰rluftmasse" UBYTE fak_ub_b8 1 100 0 7.96875 FORMAT "%5.3" ECU_ADDRESS 0x800A60 /end MEASUREMENT
/begin MEASUREMENT fmslrho "Dichtekorrektur der Sekund‰rluftmasse" UBYTE fak_ub_b2 1 100 0 1.99219 FORMAT "%5.3" ECU_ADDRESS 0x800A61 /end MEASUREMENT
/begin MEASUREMENT fpabnav2_w "Korrekturfaktor Abgasdruck (word) Bank2" UWORD fak_uw_b8 1 100 0 7.99988 FORMAT "%8.6" ECU_ADDRESS 0x800514 /end MEASUREMENT
/begin MEASUREMENT fpabnav_w "Korrekturfaktor Abgasdruck (word)" UWORD fak_uw_b8 1 100 0 7.99988 FORMAT "%8.6" ECU_ADDRESS 0x800516 /end MEASUREMENT
/begin MEASUREMENT fprgagps_w "Korrekturfaktor von pbrintro_w bei groﬂem Druckverh‰ltnis Saugrohr/Auslaﬂventil" UWORD fak_uw_b2 1 100 0 1.99997 FORMAT "%8.6" ECU_ADDRESS 0x800528 /end MEASUREMENT
/begin MEASUREMENT fpsrlroa_w "Rohwert f¸r Faktor systembezogene Umrechnung Druck auf F¸llung bei Auslaﬂ-NW" UWORD rel_uw_b0p3 1 100 0 0.299995 FORMAT "%9.7" ECU_ADDRESS 0x80052A /end MEASUREMENT
/begin MEASUREMENT fpsrlroe_w "Rohwert f¸r Faktor systembezogene Umrechnung Druck auf F¸llung bei Einlaﬂ-NW" UWORD rel_uw_b0p3 1 100 0 0.299995 FORMAT "%9.7" ECU_ADDRESS 0x80052C /end MEASUREMENT
/begin MEASUREMENT fpvdk "Korrekturfaktor Druck vor Drosselklappe" UBYTE fak_ub_b4 1 100 0 3.98438 FORMAT "%5.3" ECU_ADDRESS 0x8010D2 /end MEASUREMENT
/begin MEASUREMENT fpvdk_w "Korrekturfaktor Druck vor Drosselklappe 16-Bit" UWORD fak_uw_b4 1 100 0 3.99994 FORMAT "%8.6" ECU_ADDRESS 0x801466 /end MEASUREMENT
/begin MEASUREMENT frhodk_w "Faktor Luftdichtekorrektur f¸r DK-Durchfluﬂ f(Ansauglufttemp.,Hˆhe) 16 Bit" UWORD fak_uw_b2 1 100 0 1.99997 FORMAT "%8.6" ECU_ADDRESS 0x801468 /end MEASUREMENT
/begin MEASUREMENT frhovdk_w "Faktor Luftdichtekorrektur f¸r DK-Durchfluﬂ f(Ansauglufttemp.,Hˆhe) 16 Bit" UWORD fak_uw_b4 1 100 0 3.99994 FORMAT "%8.6" ECU_ADDRESS 0x80146A /end MEASUREMENT
/begin MEASUREMENT fslpdyn "Faktor Dynamikbeschreibung Sekund‰rluftpumpe" UBYTE fak_ub_b1 1 100 0 0.996094 ECU_ADDRESS 0x800A62 /end MEASUREMENT
/begin MEASUREMENT fsttankrf "F¸llstand der rechten Tankh‰lfte gefiltert" UBYTE fuel_ub_q0p5 1 100 0 127.5 FORMAT "%5.1" ECU_ADDRESS 0x800C10 /end MEASUREMENT
/begin MEASUREMENT ftbr "Faktor Temperaturkorrektur im Brennraum" UBYTE fak_ub_b2 1 100 0 1.99219 FORMAT "%5.3" ECU_ADDRESS 0x800559 /end MEASUREMENT
/begin MEASUREMENT ftbr_w "Faktor Temperaturkorrektur im Brennraum" UWORD fak_uw_b2 1 100 0 1.99997 FORMAT "%8.6" ECU_ADDRESS 0x800562 /end MEASUREMENT
/begin MEASUREMENT ftho_w "Faktor Korrektur Hˆhe und Temperatur" UWORD fak_uw_b2 1 100 0 1.99997 FORMAT "%8.6" ECU_ADDRESS 0x800BC4 /end MEASUREMENT
/begin MEASUREMENT ftsr "Korrekturfaktor Lufttemperatur im Saugrohr" UBYTE fak_ub_b2 1 100 0 1.99219 FORMAT "%5.3" ECU_ADDRESS 0x80055A /end MEASUREMENT
/begin MEASUREMENT ftu "Faktor Temperatur Umgebung" UBYTE fak_ub_b2 1 100 0 1.99219 FORMAT "%5.3" ECU_ADDRESS 0x80055B /end MEASUREMENT
/begin MEASUREMENT ftvdk "Korrekturfaktor Temperatur vor Drosselklappe" UBYTE fak_ub_b2 1 100 0 1.99219 FORMAT "%5.3" ECU_ADDRESS 0x80109E /end MEASUREMENT
/begin MEASUREMENT ftw "Faktor Temperaturgewichtung tmot, tans" UBYTE fak_ub_b2 1 100 0 1.99219 FORMAT "%5.3" ECU_ADDRESS 0x80055C /end MEASUREMENT
/begin MEASUREMENT FuelTankMinLvl_Mode "" UBYTE DC_FLAG_U8 1 100 0 1 BIT_MASK 0x1 FORMAT "%5.3" ECU_ADDRESS 0x8036B4 /end MEASUREMENT
/begin MEASUREMENT fupahoms_w "Faktor Umrechnung Solldruck Intergas in Sollfuellung Intergas Ausl.von NW in HOM" UWORD rel_uw_b0p3 1 100 0 0.299995 FORMAT "%9.7" ECU_ADDRESS 0x800548 /end MEASUREMENT
/begin MEASUREMENT fupehoms_w "Faktor Umrechnung Solldruck Intergas in Sollfuellung Intergas Einl.von NW in HOM" UWORD rel_uw_b0p3 1 100 0 0.299995 FORMAT "%9.7" ECU_ADDRESS 0x80054A /end MEASUREMENT
/begin MEASUREMENT fupohoms_w "Faktor Umrechnung Solldruck Intergas in Sollfuellung roh Intergas von NW in HOM" UWORD rel_uw_b0p3 1 100 0 0.299995 FORMAT "%9.7" ECU_ADDRESS 0x80054C /end MEASUREMENT
/begin MEASUREMENT fupshoms_w "Faktor Umrechnung Solldruck Intergas in Sollfuellung Intergas von NW in HOM" UWORD rel_uw_b0p3 1 100 0 0.299995 FORMAT "%9.7" ECU_ADDRESS 0x80054E /end MEASUREMENT
/begin MEASUREMENT fupsrlro_w "Rohwert f¸r Faktor systembezogene Umrechnung Druck auf F¸llung" UWORD rel_uw_b0p3 1 100 0 0.299995 FORMAT "%9.7" ECU_ADDRESS 0x80052E /end MEASUREMENT
/begin MEASUREMENT fupsrluk_w "Faktor systembezogene Umrechnung Druck auf F¸llung (16-Bit) unkorrigiert" UWORD rel_uw_b0p3 1 100 0 0.299995 FORMAT "%9.7" ECU_ADDRESS 0x800530 /end MEASUREMENT
/begin MEASUREMENT fupsrl_w "Faktor systembezogene Umrechnung Druck auf F¸llung (16-Bit)" UWORD rel_uw_b0p3 1 100 0 0.299995 FORMAT "%9.7" ECU_ADDRESS 0x800532 /end MEASUREMENT
/begin MEASUREMENT furla_w "Umrechnungsfaktor von ps->rl abh‰ngig von NW-Verstell. (Grundwert) bei Auslaﬂ-NW" UWORD rel_uw_b0p3 1 100 0 0.299995 FORMAT "%9.7" ECU_ADDRESS 0x80130C /end MEASUREMENT
/begin MEASUREMENT furle_w "Umrechnungsfaktor von ps->rl abh‰ngig von NW-Verstell. (Grundwert) bei Einlaﬂ-NW" UWORD rel_uw_b0p3 1 100 0 0.299995 FORMAT "%9.7" ECU_ADDRESS 0x80130E /end MEASUREMENT
/begin MEASUREMENT furlia_w "Interpolation zwischen den Kennfeldern KFURLA und KFURLKL2A" UWORD rel_uw_b0p3 1 100 0 0.299995 FORMAT "%9.7" ECU_ADDRESS 0x801310 /end MEASUREMENT
/begin MEASUREMENT furlie_w "Interpolation zwischen den Kennfeldern KFURLE und KFURLKL2E" UWORD rel_uw_b0p3 1 100 0 0.299995 FORMAT "%9.7" ECU_ADDRESS 0x801312 /end MEASUREMENT
/begin MEASUREMENT furlkl12a_w "" UWORD rel_uw_b0p3 1 100 0 0.299995 FORMAT "%9.7" ECU_ADDRESS 0x801314 /end MEASUREMENT
/begin MEASUREMENT furlkl12e_w "" UWORD rel_uw_b0p3 1 100 0 0.299995 FORMAT "%9.7" ECU_ADDRESS 0x801316 /end MEASUREMENT
/begin MEASUREMENT furlkl2a_w "Umrechnungsfaktor von ps->rl abh.von NW-Verstell. bei akt.2.Klappe bei Auslaﬂ-NW" UWORD rel_uw_b0p3 1 100 0 0.299995 FORMAT "%9.7" ECU_ADDRESS 0x801318 /end MEASUREMENT
/begin MEASUREMENT furlkl2e_w "Umrechnungsfaktor von ps->rl abh.von NW-Verstell. bei akt.2.Klappe bei Einlaﬂ-NW" UWORD rel_uw_b0p3 1 100 0 0.299995 FORMAT "%9.7" ECU_ADDRESS 0x80131A /end MEASUREMENT
/begin MEASUREMENT furlsua_w "Umrechnungsfaktor von ps->rl abh‰ngig von NW-Verstell.(bei SU) bei Einlaﬂ-NW" UWORD rel_uw_b0p3 1 100 0 0.299995 FORMAT "%9.7" ECU_ADDRESS 0x80131C /end MEASUREMENT
/begin MEASUREMENT furlsue_w "Umrechnungsfaktor von ps->rl abh‰ngig von NW-Verstell. (bei SU) bei Einlaﬂ-NW" UWORD rel_uw_b0p3 1 100 0 0.299995 FORMAT "%9.7" ECU_ADDRESS 0x80131E /end MEASUREMENT
/begin MEASUREMENT furlsuia_w "Interpolation zwischen den Kennfeldern KFURLSUA und KFURLKL12A" UWORD rel_uw_b0p3 1 100 0 0.299995 FORMAT "%9.7" ECU_ADDRESS 0x801320 /end MEASUREMENT
/begin MEASUREMENT furlsuie_w "Interpolation zwischen den Kennfeldern KFURLSUE und KFURLKL12E" UWORD rel_uw_b0p3 1 100 0 0.299995 FORMAT "%9.7" ECU_ADDRESS 0x801322 /end MEASUREMENT
/begin MEASUREMENT fvisrm_w "Faktor Verst‰rkung Integrator Saugrohrmodell" UWORD p_uw_b32 1 100 0 31.9995 FORMAT "%8.5" ECU_ADDRESS 0x800534 /end MEASUREMENT
/begin MEASUREMENT fwnwvs_w "Faktor zur Wichtung der Nockenwellenverstellung zwischen Ein- und Auslaﬂseite" UWORD fak_uw_b2 1 100 0 1.99997 FORMAT "%8.6" ECU_ADDRESS 0x801324 /end MEASUREMENT
/begin MEASUREMENT fwprs_w "Faktor Preadiktionswinkel bezogen auf Segment" UWORD fak_uw_b32 1 100 0 31.9995 FORMAT "%8.5" ECU_ADDRESS 0x8013FA /end MEASUREMENT
/begin MEASUREMENT Gear_HighLim_Req "" UBYTE DC_CNTR_U8 1 100 0 255 FORMAT "%5.1" ECU_ADDRESS 0x8037DE /end MEASUREMENT
/begin MEASUREMENT Gear_LowLim_Req "" UBYTE DC_CNTR_U8 1 100 0 255 FORMAT "%5.1" ECU_ADDRESS 0x8037DD /end MEASUREMENT
/begin MEASUREMENT GlowPlugIndicDsable_Mode "" UBYTE DC_FLAG_U8 1 100 0 1 BIT_MASK 0x1 FORMAT "%5.3" ECU_ADDRESS 0x8036B5 /end MEASUREMENT
/begin MEASUREMENT IgnSwStrtCAN_Mode "" UBYTE DC_FLAG_U8 1 100 0 1 BIT_MASK 0x1 FORMAT "%5.3" ECU_ADDRESS 0x8037DC /end MEASUREMENT
/begin MEASUREMENT IgnSwStrtr_Mode "" UBYTE DC_FLAG_U8 1 100 0 1 BIT_MASK 0x1 FORMAT "%5.3" ECU_ADDRESS 0x8037DB /end MEASUREMENT
/begin MEASUREMENT imlsloff_w "Luftmassenintegral f¸r Ende der Sekund‰rluft im Abgas" UWORD m_uw_b4660 1 100 0 4660.27 FORMAT "%8.3" ECU_ADDRESS 0x800A38 /end MEASUREMENT
/begin MEASUREMENT imlslon_w "Luftmassenintegral f¸r Einbringen der Sekund‰rluft" UWORD m_uw_b4660 1 100 0 4660.27 FORMAT "%8.3" ECU_ADDRESS 0x800A3A /end MEASUREMENT
/begin MEASUREMENT irspsyn "Index f¸r Ringspeicheradressierung tsegrsp_w, nmotrsp_w, rlrsp_w" UBYTE dez 1 100 0 255 FORMAT "%5.1" ECU_ADDRESS 0x80120E /end MEASUREMENT
/begin MEASUREMENT irspsynold "Ein  Arbeitsspiel alter Index f¸r die Ringspeicheradressierung" UBYTE dez 1 100 0 255 FORMAT "%5.1" ECU_ADDRESS 0x80120F /end MEASUREMENT
/begin MEASUREMENT JumpStrt_Mode "" UBYTE DC_FLAG_U8 1 100 0 1 BIT_MASK 0x1 FORMAT "%5.3" ECU_ADDRESS 0x8036B6 /end MEASUREMENT
/begin MEASUREMENT KD_Mode "" UBYTE DC_FLAG_U8 1 100 0 1 BIT_MASK 0x1 FORMAT "%5.3" ECU_ADDRESS 0x8036B7 /end MEASUREMENT
/begin MEASUREMENT KeylessGo_Enabl_Mode "" UBYTE DC_FLAG_U8 1 100 0 1 BIT_MASK 0x1 FORMAT "%5.3" ECU_ADDRESS 0x8037DA /end MEASUREMENT
/begin MEASUREMENT KeylessGo_StrtEnabl_Mode "" UBYTE DC_FLAG_U8 1 100 0 1 BIT_MASK 0x1 FORMAT "%5.3" ECU_ADDRESS 0x8037D9 /end MEASUREMENT
/begin MEASUREMENT kmsdk_w "Verst‰rkungsfaktor f¸r Filterung von msdk" UWORD fak_uw_b1 1 100 0 0.999985 FORMAT "%9.7" ECU_ADDRESS 0x80146C /end MEASUREMENT
/begin MEASUREMENT lambrinv "invertiertes Lambda-Brennraum (rk/rl)" UBYTE fak_ub_b16 1 100 0 15.9375 FORMAT "%5.2" ECU_ADDRESS 0x800C11 /end MEASUREMENT
/begin MEASUREMENT LH_Mode "" UBYTE DC_FLAG_U8 1 100 0 1 BIT_MASK 0x1 FORMAT "%5.3" ECU_ADDRESS 0x8037D8 /end MEASUREMENT
/begin MEASUREMENT mleitmx_w "Maximale Regeneriergasmasse in Leitung TEV Saugrohr" UWORD m_q2p71Em5_g 1 100 0 1.77775 FORMAT "%8.6" ECU_ADDRESS 0x80176C /end MEASUREMENT
/begin MEASUREMENT mleit_w "Aktuelle Regeneriergasmasse in Leitung TEV Saugrohr" UWORD m_q2p71Em5_g 1 100 0 1.77775 FORMAT "%8.6" ECU_ADDRESS 0x80176E /end MEASUREMENT
/begin MEASUREMENT mlsol_w "Soll-Luftmassenstrom" UWORD m_uw_b6553p5 1 100 0 6553.5 FORMAT "%8.3" ECU_ADDRESS 0x801488 /end MEASUREMENT
/begin MEASUREMENT msdkalm_w "Massenstrom ¸ber Drosselklappe (abgeglichen mit HFM Signal)" UWORD m_uw_b6553p5 1 100 0 6553.5 FORMAT "%8.3" ECU_ADDRESS 0x80135C /end MEASUREMENT
/begin MEASUREMENT msdkds_w "Massenstrom an der Drosselklappe berechnet aus dem Sensorsignal des DSS" UWORD m_q0p1 1 100 0 6553.5 FORMAT "%8.3" ECU_ADDRESS 0x8012E0 /end MEASUREMENT
/begin MEASUREMENT msdkf_w "Massenstrom ¸ber Drosselklappe bei Fehler HFM" UWORD m_uw_b6553p5 1 100 0 6553.5 FORMAT "%8.3" ECU_ADDRESS 0x80135E /end MEASUREMENT
/begin MEASUREMENT msdkmx_w "max. mˆglicher Massenstrom ¸ber DK" UWORD m_uw_b6553p5 1 100 0 6553.5 FORMAT "%8.3" ECU_ADDRESS 0x8012E2 /end MEASUREMENT
/begin MEASUREMENT msdkoue_w "Massenstrom ¸ber Drosselklappe ohne ‹berweg" UWORD m_uw_b6553p5 1 100 0 6553.5 FORMAT "%8.3" ECU_ADDRESS 0x80146E /end MEASUREMENT
/begin MEASUREMENT msdks_w "Soll-Luftmassenstrom durch Drosselvorrichtung" UWORD m_uw_b6553p5 1 100 0 6553.5 FORMAT "%8.3" ECU_ADDRESS 0x80148A /end MEASUREMENT
/begin MEASUREMENT msdkugd_w "Massenstrom ¸ber DK bei ps/pvdk=0.95 (ungedrosselt)" UWORD m_uw_b6553p5 1 100 0 6553.5 FORMAT "%8.3" ECU_ADDRESS 0x8012E4 /end MEASUREMENT
/begin MEASUREMENT msdkvf_w "Massenstrom ¸ber Drosselklappe vor Filterung" UWORD m_uw_b6553p5 1 100 0 6553.5 FORMAT "%8.3" ECU_ADDRESS 0x801470 /end MEASUREMENT
/begin MEASUREMENT msdk_w "Massenstrom ¸ber Drosselklappe (word)" UWORD m_uw_b6553p5 1 100 0 6553.5 FORMAT "%8.3" ECU_ADDRESS 0x801472 /end MEASUREMENT
/begin MEASUREMENT msfabrv2_w "Massenstrom F¸llung der durch die Auslaﬂventile aus dem Brennraum flieﬂt" UWORD m_uw_b6553p5 1 100 0 6553.5 FORMAT "%8.3" ECU_ADDRESS 0x800A3C /end MEASUREMENT
/begin MEASUREMENT msfabrv_w "Massenstrom der durch die Auslaﬂventile in den Abgastrakt flieﬂt" UWORD m_uw_b6553p5 1 100 0 6553.5 FORMAT "%8.3" ECU_ADDRESS 0x800A3E /end MEASUREMENT
/begin MEASUREMENT msl "Sekund‰rluftmassenstrom" UBYTE m_ub_q0p4 1 100 0 102 FORMAT "%5.1" ECU_ADDRESS 0x800A63 /end MEASUREMENT
/begin MEASUREMENT msl2 "Sekund‰rluftmasse Bank 2" UBYTE m_ub_q0p4 1 100 0 102 FORMAT "%5.1" ECU_ADDRESS 0x800A64 /end MEASUREMENT
/begin MEASUREMENT msl2_w "Sekund‰rluftmasse Bank 2 16-Bit Wert" UWORD m_uw_b6553p5 1 100 0 6553.5 FORMAT "%8.3" ECU_ADDRESS 0x800A40 /end MEASUREMENT
/begin MEASUREMENT msllam2_w "berechnete Sekund‰rluftmasse aus Lambdasignal r¸ckgerechnet (Bank2)" UWORD m_uw_b6553p5 1 100 0 6553.5 FORMAT "%8.3" ECU_ADDRESS 0x800A42 /end MEASUREMENT
/begin MEASUREMENT msllam_w "berechnete Sekund‰rluftmasse aus Lambdasignal r¸ckgerechnet" UWORD m_uw_b6553p5 1 100 0 6553.5 FORMAT "%8.3" ECU_ADDRESS 0x800A44 /end MEASUREMENT
/begin MEASUREMENT mslmdyn_w "Sekund‰rluftmassenstrom mit Ber¸cksichtigung der Korrektur- u. Dynamikfaktoren" UWORD m_uw_b6553p5 1 100 0 1638.4 FORMAT "%8.3" ECU_ADDRESS 0x800A46 /end MEASUREMENT
/begin MEASUREMENT mslpdyn_w "Sekund‰rluftmassenstrom mit Ber¸cksichtigung der Pumpendynamik" UWORD m_uw_b6553p5 1 100 0 1638.4 FORMAT "%8.3" ECU_ADDRESS 0x800A48 /end MEASUREMENT
/begin MEASUREMENT mslpub_w "Sekund‰rluftmassenstrom, batteriespannungsabh‰ngig 16-Bit" UWORD m_uw_b6553p5 1 100 0 204.8 FORMAT "%8.4" ECU_ADDRESS 0x800A4A /end MEASUREMENT
/begin MEASUREMENT mslstat_w "statische Sekund‰rluftmassestrom, 16-Bit" UWORD m_uw_b6553p5 1 100 0 6553.5 FORMAT "%8.3" ECU_ADDRESS 0x800A4C /end MEASUREMENT
/begin MEASUREMENT mslth2_w "Sekund‰rluftmassenstrom 16-Bit Wert (Theoretischer Wert)" UWORD m_uw_b6553p5 1 100 0 6553.5 FORMAT "%8.3" ECU_ADDRESS 0x800A4E /end MEASUREMENT
/begin MEASUREMENT mslth_w "Sekund‰rluftmassenstrom 16-Bit Wert (Theoretischer Wert)" UWORD m_uw_b6553p5 1 100 0 6553.5 FORMAT "%8.3" ECU_ADDRESS 0x800A50 /end MEASUREMENT
/begin MEASUREMENT msl_w "Sekund‰rluftmassenstrom 16-Bit Wert" UWORD m_uw_b6553p5 1 100 0 6553.5 FORMAT "%8.3" ECU_ADDRESS 0x800A52 /end MEASUREMENT
/begin MEASUREMENT msndkoo_w "normierter Massenstrom Drosselklappe ohne offset (word)" UWORD m_uw_b6553p5 1 100 0 6553.5 FORMAT "%8.3" ECU_ADDRESS 0x801474 /end MEASUREMENT
/begin MEASUREMENT msndkpk_w "normierter praedizierter korrig. Massenstrom ueber Drosselklappe (word)" UWORD m_uw_b6553p5 1 100 0 6553.5 FORMAT "%8.3" ECU_ADDRESS 0x80137A /end MEASUREMENT
/begin MEASUREMENT msndk_w "normierter Massenstrom ¸ber Drosselklappe (word)" UWORD m_uw_b6553p5 1 100 0 6553.5 FORMAT "%8.3" ECU_ADDRESS 0x801476 /end MEASUREMENT
/begin MEASUREMENT msnhf_w "Normmassenstrom des Hauptf¸llungssensors" UWORD m_uw_b6553p5 1 100 0 6553.5 FORMAT "%8.3" ECU_ADDRESS 0x8013A4 /end MEASUREMENT
/begin MEASUREMENT msnsgin_w "Ins Saugrohr strˆmender Massenstrom, normiert" UWORD m_uw_b6553p5 1 100 0 6553.5 FORMAT "%8.3" ECU_ADDRESS 0x801770 /end MEASUREMENT
/begin MEASUREMENT msntetev_w "normierter, ¸berkritischer Massenstrom durch das TEV" UWORD m_uw_b25p6 1 100 0 25.5996 FORMAT "%8.5" ECU_ADDRESS 0x801772 /end MEASUREMENT
/begin MEASUREMENT msntevo_w "normierter, ¸berkritischer Massenstrom durch das 100% offene TEV" UWORD m_uw_b25p6 1 100 0 25.5996 FORMAT "%8.5" ECU_ADDRESS 0x800BC6 /end MEASUREMENT
/begin MEASUREMENT mste "Massenstrom Tankentl¸ftung ins Saugrohr" UBYTE m_ub_b25p6 1 100 0 25.5 FORMAT "%5.2" ECU_ADDRESS 0x7FAA11 /end MEASUREMENT
/begin MEASUREMENT mstedte "Massenstrom TEV f¸r DTEV" UBYTE m_ub_b25p6 1 100 0 25.5 FORMAT "%5.2" ECU_ADDRESS 0x8011C4 /end MEASUREMENT
/begin MEASUREMENT mstedte_w "Massenstrom TEV f¸r DTEV (Word)" UWORD m_uw_b25p6 1 100 0 25.5996 FORMAT "%8.5" ECU_ADDRESS 0x801774 /end MEASUREMENT
/begin MEASUREMENT msteo_w "Massenstom durch das 100% offene TEV" UWORD m_uw_b25p6 1 100 0 25.5996 FORMAT "%8.5" ECU_ADDRESS 0x801776 /end MEASUREMENT
/begin MEASUREMENT mstetev_w "Massenstrom durch das TEV" UWORD m_uw_b25p6 1 100 0 25.5996 FORMAT "%8.5" ECU_ADDRESS 0x801778 /end MEASUREMENT
/begin MEASUREMENT mste_w "Massenstrom Tankentl¸ftung in das Saugrohr" UWORD m_uw_b25p6 1 100 0 25.5996 FORMAT "%8.5" ECU_ADDRESS 0x80177A /end MEASUREMENT
/begin MEASUREMENT MTXSports_Mode "" UBYTE DC_FLAG_U8 1 100 0 1 BIT_MASK 0x1 FORMAT "%5.3" ECU_ADDRESS 0x803833 /end MEASUREMENT
/begin MEASUREMENT MTX_CAN_Mode "" UBYTE DC_FLAG_U8 1 100 0 1 BIT_MASK 0x1 FORMAT "%5.3" ECU_ADDRESS 0x8036B8 /end MEASUREMENT
/begin MEASUREMENT MTX_Mode "" UBYTE DC_FLAG_U8 1 100 0 1 BIT_MASK 0x1 FORMAT "%5.3" ECU_ADDRESS 0x803834 /end MEASUREMENT
/begin MEASUREMENT ngas_w "Drehzahlgradient ¸ber ein Arbeitsspiel" SWORD nmotg_sw_q0p39 1 100 -12800.2 12799.8 FORMAT "%8.2" ECU_ADDRESS 0x8017C6 /end MEASUREMENT
/begin MEASUREMENT ngfil "gefilterter Drehzahlgradient" SBYTE nmotg_sb_q100 1 100 -12800 12700 FORMAT "%5.0" ECU_ADDRESS 0x801210 /end MEASUREMENT
/begin MEASUREMENT ngfil_w "gefilterter Drehzahlgradient" SWORD nmotg_sw_q0p39 1 100 -12800.2 12799.8 FORMAT "%8.2" ECU_ADDRESS 0x8017C8 /end MEASUREMENT
/begin MEASUREMENT nmn10msctr "Z‰hler 10 ms Raster ohne Zahninterrupt" UBYTE dez 1 100 0 255 FORMAT "%5.1" ECU_ADDRESS 0x801015 /end MEASUREMENT
/begin MEASUREMENT nmot "Motordrehzahl" UBYTE nmot_ub_q40 1 100 0 10000 FORMAT "%5.0" ECU_ADDRESS 0x801012 /end MEASUREMENT
/begin MEASUREMENT nmotarr_w "Ringspeicher f¸r Drehzahlen" UWORD nmot_uw_q0p25 1 100 0 16383.8 FORMAT "%8.2" ARRAY_SIZE 10 ECU_ADDRESS 0x801BB4 /end MEASUREMENT
/begin MEASUREMENT nmotas_w "Motordrehzahl von 2 Umdrehungen (1 Arbeitsspiel) zuvor" UWORD nmot_uw_q0p25 1 100 0 16383.8 FORMAT "%8.2" ECU_ADDRESS 0x8017CA /end MEASUREMENT
/begin MEASUREMENT nmotll "Motordrehzahl im Leerlaufbereich" UBYTE nmot_ub_q10 1 100 0 2550 FORMAT "%5.0" ECU_ADDRESS 0x801013 /end MEASUREMENT
/begin MEASUREMENT nmotllfil "Gefilterte Drehzahl nmotll" UBYTE nmot_ub_q10 1 100 0 2550 FORMAT "%5.0" ECU_ADDRESS 0x801014 /end MEASUREMENT
/begin MEASUREMENT nmot_f "Motordrehzahl" FLOAT32_IEEE fak_r32_1 1 100 0 10000 FORMAT "%43.37" ECU_ADDRESS 0x7F9958 /end MEASUREMENT
/begin MEASUREMENT nmot_w "Motordrehzahl" UWORD nmot_uw_q0p25 1 100 0 10000 FORMAT "%8.2" ECU_ADDRESS 0x801BCA /end MEASUREMENT
/begin MEASUREMENT nwvsakt_w "Nockenwellen Verstellschwerpunkt aktuell" SWORD kw_sw_q0p0078 1 100 -256 255.992 FORMAT "%8.4" ECU_ADDRESS 0x800536 /end MEASUREMENT
/begin MEASUREMENT nwvsfrue_w "Nockenwellen Verstellschwerpunkt fr¸h" SWORD kw_sw_q0p0078 1 100 -256 255.992 FORMAT "%8.4" ECU_ADDRESS 0x800538 /end MEASUREMENT
/begin MEASUREMENT nwvsmnu_w "Nockenwellen Verstellschwerpunkt f¸r minimale ‹berschneidung" SWORD kw_sw_q0p0078 1 100 -256 255.992 FORMAT "%8.4" ECU_ADDRESS 0x80053A /end MEASUREMENT
/begin MEASUREMENT nwvsspae_w "Nockenwellen Verstellschwerpunkt sp‰t" SWORD kw_sw_q0p0078 1 100 -256 255.992 FORMAT "%8.4" ECU_ADDRESS 0x80053C /end MEASUREMENT
/begin MEASUREMENT Odo_Abs "" UWORD DC_FAK2LDB 1 100 0 131070 FORMAT "%7.0" ECU_ADDRESS 0x80325A /end MEASUREMENT
/begin MEASUREMENT OvrSpdIndic_Mode "" UBYTE DC_FLAG_U8 1 100 0 1 BIT_MASK 0x1 FORMAT "%5.3" ECU_ADDRESS 0x8037C0 /end MEASUREMENT
/begin MEASUREMENT pabnav2_w "Abgasdruck nach Auslaﬂentil (Bank2)" UWORD p_uw_q0p078 1 100 0 5119.92 FORMAT "%8.3" ECU_ADDRESS 0x800518 /end MEASUREMENT
/begin MEASUREMENT pabnav_w "Abgasdruck nach Auslaﬂventil" UWORD p_uw_q0p078 1 100 0 5119.92 FORMAT "%8.3" ECU_ADDRESS 0x80051A /end MEASUREMENT
/begin MEASUREMENT pabvhk2_w "Abgasgegendruck vor Hauptkat (Bank2)" UWORD p_uw_q0p039 1 100 0 2559.96 FORMAT "%8.3" ECU_ADDRESS 0x80051C /end MEASUREMENT
/begin MEASUREMENT pabvhk_w "Abgasgegendruck vor Hauptkat" UWORD p_uw_q0p039 1 100 0 2559.96 FORMAT "%8.3" ECU_ADDRESS 0x80051E /end MEASUREMENT
/begin MEASUREMENT pabvvk2_w "Abgasgegendruck vor Vorkat (Bank2)" UWORD p_uw_q0p039 1 100 0 2559.96 FORMAT "%8.3" ECU_ADDRESS 0x800520 /end MEASUREMENT
/begin MEASUREMENT pabvvk_w "Abgasgegendruck vor Vorkat" UWORD p_uw_q0p039 1 100 0 2559.96 FORMAT "%8.3" ECU_ADDRESS 0x800522 /end MEASUREMENT
/begin MEASUREMENT pbrahoms_w "Sollpartialdruck (Inertgas+Luft) im Brennraum Ausl. durch int. AGR in Homogen" UWORD p_uw_q0p039 1 100 0 2559.96 FORMAT "%8.3" ECU_ADDRESS 0x800550 /end MEASUREMENT
/begin MEASUREMENT pbrehoms_w "Sollpartialdruck (Inertgas+Luft) im Brennraum  Einl. durch int. AGR in Homogen" UWORD p_uw_q0p039 1 100 0 2559.96 FORMAT "%8.3" ECU_ADDRESS 0x800552 /end MEASUREMENT
/begin MEASUREMENT pbrihoms_w "Sollpartialdruck (Inertgas+Luft) im Brennraum durch interne AGR in Homogen" UWORD p_uw_q0p039 1 100 0 2559.96 FORMAT "%8.3" ECU_ADDRESS 0x800554 /end MEASUREMENT
/begin MEASUREMENT pbrintna_w "pbrintro_w nach Anpassung bei hohem Saugrohrdruck" UWORD p_uw_q0p039 1 100 0 2559.96 FORMAT "%8.3" ECU_ADDRESS 0x801326 /end MEASUREMENT
/begin MEASUREMENT pbrintro_w "Partialdruck (Inertgas+Luft) im Brennraum durch internes AGR ungefiltert" UWORD p_uw_q0p039 1 100 0 2559.96 FORMAT "%8.3" ECU_ADDRESS 0x801328 /end MEASUREMENT
/begin MEASUREMENT pbrintuk_w "Partialdruck (Inertgas+Luft) im Brennraum durch internes AGR unkorrigiert" UWORD p_uw_q0p039 1 100 0 2559.96 FORMAT "%8.3" ECU_ADDRESS 0x80053E /end MEASUREMENT
/begin MEASUREMENT pbrint_w "Partialdruck (Inertgas+Luft) im Brennraum durch internes AGR" UWORD p_uw_q0p039 1 100 0 2559.96 FORMAT "%8.3" ECU_ADDRESS 0x80132A /end MEASUREMENT
/begin MEASUREMENT pbriroa_w "Partialdruck (Inertgas+Luft) im Brennraum durch int.AGR ungef. bei Auslaﬂ-NW" UWORD p_uw_q0p039 1 100 0 2559.96 FORMAT "%8.3" ECU_ADDRESS 0x80132C /end MEASUREMENT
/begin MEASUREMENT pbriroe_w "Partialdruck (Inertgas+Luft) im Brennraum durch int.AGR ungef. bei Einlaﬂ-NW" UWORD p_uw_q0p039 1 100 0 2559.96 FORMAT "%8.3" ECU_ADDRESS 0x80132E /end MEASUREMENT
/begin MEASUREMENT pbrohoms_w "Sollpartialdruck (Inertgas+Luft) im Brennraum roh durch interne AGR in Homogen" UWORD p_uw_q0p039 1 100 0 2559.96 FORMAT "%8.3" ECU_ADDRESS 0x800556 /end MEASUREMENT
/begin MEASUREMENT pirgia_w "Interpolation zwischen den Kennfeldern KFPRGA und KFPRGKL2A" UWORD p_uw_q0p039 1 100 0 2559.96 FORMAT "%8.3" ECU_ADDRESS 0x801330 /end MEASUREMENT
/begin MEASUREMENT pirgie_w "Interpolation zwischen den Kennfeldern KFPRGE und KFPRGKL2E" UWORD p_uw_q0p039 1 100 0 2559.96 FORMAT "%8.3" ECU_ADDRESS 0x801332 /end MEASUREMENT
/begin MEASUREMENT pirgres_w "Partialdruck residuales Restgas im Brennraum" UWORD p_uw_q0p039 1 100 0 2559.96 FORMAT "%8.3" ECU_ADDRESS 0x800540 /end MEASUREMENT
/begin MEASUREMENT pirgsuia_w "Interpolation zwischen den Kennfeldern KFPRGSUA und KFPRGKL12A" UWORD p_uw_q0p039 1 100 0 2559.96 FORMAT "%8.3" ECU_ADDRESS 0x801334 /end MEASUREMENT
/begin MEASUREMENT pirgsuie_w "Interpolation zwischen den Kennfeldern KFPRGSUE und KFPRGKL12E" UWORD p_uw_q0p039 1 100 0 2559.96 FORMAT "%8.3" ECU_ADDRESS 0x801336 /end MEASUREMENT
/begin MEASUREMENT pirg_w "Partialdruck Restgas interne AGR (16-Bit)" UWORD p_uw_q0p039 1 100 0 2559.96 FORMAT "%8.3" ECU_ADDRESS 0x800542 /end MEASUREMENT
/begin MEASUREMENT prga_w "interner Abgaspartialdruck abh‰ngig von NW-Verstellung(Grundwert) bei Auslaﬂ-NWS" UWORD p_uw_q0p039 1 100 0 2559.96 FORMAT "%8.3" ECU_ADDRESS 0x801338 /end MEASUREMENT
/begin MEASUREMENT prge_w "interner Abgaspartialdruck abh‰ngig von NW-Verstellung(Grundwert) bei Einlaﬂ-NWS" UWORD p_uw_q0p039 1 100 0 2559.96 FORMAT "%8.3" ECU_ADDRESS 0x80133A /end MEASUREMENT
/begin MEASUREMENT prgkl12a_w "interner Abgaspartialdruck abh. von NW-Verst. bei akt.1.u. 2.Klappe(Auslaﬂ-NWS)" UWORD p_uw_q0p039 1 100 0 2559.96 FORMAT "%8.3" ECU_ADDRESS 0x80133C /end MEASUREMENT
/begin MEASUREMENT prgkl12e_w "interner Abgaspartialdruck abh. von NW-Verst. bei akt.1.u. 2.Klappe(Einlaﬂ-NWS)" UWORD p_uw_q0p039 1 100 0 2559.96 FORMAT "%8.3" ECU_ADDRESS 0x80133E /end MEASUREMENT
/begin MEASUREMENT prgkl2a_w "interner Abgaspartialdruck abh. von NW-Verstellung bei akt. 2.Klappe(Auslaﬂ-NWS)" UWORD p_uw_q0p039 1 100 0 2559.96 FORMAT "%8.3" ECU_ADDRESS 0x801340 /end MEASUREMENT
/begin MEASUREMENT prgkl2e_w "interner Abgaspartialdruck abh. von NW-Verstellung bei akt. 2.Klappe(Einlaﬂ-NWS)" UWORD p_uw_q0p039 1 100 0 2559.96 FORMAT "%8.3" ECU_ADDRESS 0x801342 /end MEASUREMENT
/begin MEASUREMENT prgsua_w "interner Abgaspartialdruck abh. von NW-Verstellung bei Saugrohrumsch(Auslaﬂ-NWS)" UWORD p_uw_q0p039 1 100 0 2559.96 FORMAT "%8.3" ECU_ADDRESS 0x801344 /end MEASUREMENT
/begin MEASUREMENT prgsue_w "interner Abgaspartialdruck abh. von NW-Verstellung bei Saugrohrumsch(Einlaﬂ-NWS)" UWORD p_uw_q0p039 1 100 0 2559.96 FORMAT "%8.3" ECU_ADDRESS 0x801346 /end MEASUREMENT
/begin MEASUREMENT psdsssm_w "Saugrohrdruck gemessen mit Drucksensor im Saugrohr(Mitte Segment)" UWORD p_uw_q0p039 1 100 0 2559.96 FORMAT "%8.3" ECU_ADDRESS 0x801478 /end MEASUREMENT
/begin MEASUREMENT psmppvdk_w "praed. ps/Druck vor Drosselklappe (word)" UWORD fak_uw_b2 1 100 0 1.99997 FORMAT "%8.6" ECU_ADDRESS 0x80137C /end MEASUREMENT
/begin MEASUREMENT psmp_w "extrapolierter Saugrohrdruck (Word)" UWORD p_uw_q0p039 1 100 0 2559.96 FORMAT "%8.3" ECU_ADDRESS 0x80137E /end MEASUREMENT
/begin MEASUREMENT psmx_w "Saugrohrmaximaldruckbegrenzung f¸r modellierten Saugrohrdruck" UWORD p_uw_q0p039 1 100 0 2559.96 FORMAT "%8.3" ECU_ADDRESS 0x801348 /end MEASUREMENT
/begin MEASUREMENT pspmx_w "max. praedizierter Saugrohrdruck" UWORD p_uw_q0p039 1 100 0 2559.96 FORMAT "%8.3" ECU_ADDRESS 0x801380 /end MEASUREMENT
/begin MEASUREMENT pspute_w "Quotient Saugrohrdruck Umgebungsdruck" UWORD fak_uw_b2 1 100 0 1.99997 FORMAT "%8.6" ECU_ADDRESS 0x80177C /end MEASUREMENT
/begin MEASUREMENT pspvdb_w "Quotient Saugrohrduck/Druck vor DK begrenzt (word)" UWORD fak_uw_b2 1 100 0 1.99997 FORMAT "%8.6" ECU_ADDRESS 0x80147A /end MEASUREMENT
/begin MEASUREMENT pspvdkds_w "Verh‰ltnis Saugrohrdruck/Druck vor Drosselklappe von Drucksensor (word)" UWORD fak_uw_b2 1 100 0 1.99997 FORMAT "%8.6" ECU_ADDRESS 0x80147C /end MEASUREMENT
/begin MEASUREMENT pspvdk_w "Quotient Saugrohrdruck/Druck vor Drosselklappe (word)" UWORD fak_uw_b2 1 100 0 1.99997 FORMAT "%8.6" ECU_ADDRESS 0x80147E /end MEASUREMENT
/begin MEASUREMENT pssol_w "Sollsaugrohrdruck" UWORD p_uw_q0p039 1 100 0 2559.96 FORMAT "%8.3" ECU_ADDRESS 0x80148C /end MEASUREMENT
/begin MEASUREMENT pvdk "Druck vor Drosselklappe" UBYTE p_ub_q10 1 100 0 2550 FORMAT "%5.0" ECU_ADDRESS 0x8010D3 /end MEASUREMENT
/begin MEASUREMENT pvdk_w "Druck vor Drosselklappe 16-Bit" UWORD p_uw_q0p039 1 100 0 2559.96 FORMAT "%8.3" ECU_ADDRESS 0x801480 /end MEASUREMENT
/begin MEASUREMENT qltefil "F¸llungsgrad mit Regeneriergas der leitung TEV-Saugrohr" UBYTE fak_ub_b1 1 100 0 0.996094 ECU_ADDRESS 0x8011C5 /end MEASUREMENT
/begin MEASUREMENT rfinugds_w "Soll-F¸llung NWS (internes Restgas) ungedrosselt" UWORD rel_uw_q0p0234 1 100 0 1535.98 FORMAT "%8.3" ECU_ADDRESS 0x8012E6 /end MEASUREMENT
/begin MEASUREMENT rforidmx_w "max. relative F¸llung ohne interes Restgas bezogen auf DK" UWORD rel_uw_q0p0234 1 100 0 1535.98 FORMAT "%8.3" ECU_ADDRESS 0x8012E8 /end MEASUREMENT
/begin MEASUREMENT rforidug_w "relative F¸llung ohne interes Restgas bei Druckverh‰ltnis 0.95 an DK" UWORD rel_uw_q0p0234 1 100 0 1535.98 FORMAT "%8.3" ECU_ADDRESS 0x8012EA /end MEASUREMENT
/begin MEASUREMENT rfrint_w "relative F¸llung (Inertgas+Luft) ¸ber int. AGR" UWORD rel_uw_q0p0234 1 100 0 1535.98 FORMAT "%8.3" ECU_ADDRESS 0x80134A /end MEASUREMENT
/begin MEASUREMENT rfr_w "relative F¸llung (Inertgas+Luft) ¸ber int. und ext. AGR" UWORD rel_uw_q0p0234 1 100 0 1535.98 FORMAT "%8.3" ECU_ADDRESS 0x80134C /end MEASUREMENT
/begin MEASUREMENT rirint_w "relative Inertgas-F¸llung aus internem AGR" UWORD rel_uw_q0p0234 1 100 0 1535.98 FORMAT "%8.3" ECU_ADDRESS 0x80134E /end MEASUREMENT
/begin MEASUREMENT rir_w "relative Inertgas-F¸llung aus internem und externem AGR" UWORD rel_uw_q0p0234 1 100 0 1535.98 FORMAT "%8.3" ECU_ADDRESS 0x801350 /end MEASUREMENT
/begin MEASUREMENT rkaco_w "Additive Korrektur der rel. Kraftstoffmasse f¸r LL-CO einstellen" SWORD rel_sw_b1536 1 100 -1536 1535.95 FORMAT "%8.3" ECU_ADDRESS 0x801752 /end MEASUREMENT
/begin MEASUREMENT rldkmx_w "relative F¸llung ¸ber DK bei Saugrohrdruck/Druck vor Drosselklappe=1" UWORD rel_uw_q0p0234 1 100 0 1535.98 FORMAT "%8.3" ECU_ADDRESS 0x8012EC /end MEASUREMENT
/begin MEASUREMENT rldkofk_w "relative Luftf¸llung aus DK-Signal berechnet ohne Einrechnung von fkmsdk" UWORD rel_uw_q0p0234 1 100 0 1535.98 FORMAT "%8.3" ECU_ADDRESS 0x801360 /end MEASUREMENT
/begin MEASUREMENT rldkugd_w "relative F¸llung ¸ber DK bei Saugrohrdruck/Druck vor Drosselklappe=0.95" UWORD rel_uw_q0p0234 1 100 0 1535.98 FORMAT "%8.3" ECU_ADDRESS 0x8012EE /end MEASUREMENT
/begin MEASUREMENT rldvs_w "relative Luftf¸llung durch Drosselventile am Saugrohr 16-Bit" UWORD rel_uw_q0p0234 1 100 0 1535.98 FORMAT "%8.3" ECU_ADDRESS 0x801362 /end MEASUREMENT
/begin MEASUREMENT rlfdkrof_w "relative Frischluft ¸ber DK bei Fehler HFM" UWORD rel_uw_q0p0234 1 100 0 1535.98 FORMAT "%8.3" ECU_ADDRESS 0x801364 /end MEASUREMENT
/begin MEASUREMENT rlfdkroh_w "relative Frischluft ¸ber Dk vor Saugrohrmodell (ungefiltert) mit DK gemessen" UWORD rel_uw_q0p0234 1 100 0 1535.98 FORMAT "%8.3" ECU_ADDRESS 0x801366 /end MEASUREMENT
/begin MEASUREMENT rlfgks_w "Korrigierte relative  Sollfrischluft (Luft, die ¸ber DK und TEV flieﬂt)" UWORD rel_uw_q0p0234 1 100 0 1535.98 FORMAT "%8.3" ECU_ADDRESS 0x80148E /end MEASUREMENT
/begin MEASUREMENT rlfgroh_w "relative Frischluft ¸ber Drosselklappe vor Saugrohrmodell (ungefiltert)" UWORD rel_uw_q0p0234 1 100 0 1535.98 FORMAT "%8.3" ECU_ADDRESS 0x801368 /end MEASUREMENT
/begin MEASUREMENT rlfgs_w "relative Sollfrischluft (Luft, die ¸ber DK und TEV flieﬂt)" UWORD rel_uw_q0p0234 1 100 0 1535.98 FORMAT "%8.3" ECU_ADDRESS 0x801490 /end MEASUREMENT
/begin MEASUREMENT rlflmroh_w "relative Frischluft ¸ber Dk vor Saugrohrmodell (ungefiltert) mit HFM gemessen" UWORD rel_uw_q0p0234 1 100 0 1535.98 FORMAT "%8.3" ECU_ADDRESS 0x80136A /end MEASUREMENT
/begin MEASUREMENT rlgas_w "F¸llungsgradient ¸ber ein Arbeitsspiel bestimmt" SWORD relNWU_q0p0234 1 100 -768 767.977 FORMAT "%8.4" ECU_ADDRESS 0x80138C /end MEASUREMENT
/begin MEASUREMENT rlmin_w "minimal zul‰ssiges rl" UWORD rel_uw_q0p0234 1 100 0 1535.98 FORMAT "%8.3" ECU_ADDRESS 0x801494 /end MEASUREMENT
/begin MEASUREMENT rlmxs_w "maximal erreichbare F¸llung" UWORD rel_uw_q0p0234 1 100 0 1535.98 FORMAT "%8.3" ECU_ADDRESS 0x800598 /end MEASUREMENT
/begin MEASUREMENT rlnotn_w "rel.Luftf¸llung bei Haupt- und Nebenlastfehler in Abh‰ngigkeit von nmot (word)" UWORD rel_uw_q0p0234 1 100 0 1535.98 FORMAT "%8.3" ECU_ADDRESS 0x80136C /end MEASUREMENT
/begin MEASUREMENT rlp "rel. Luftf¸llung praediziert f¸r Einspritzberechnung" UBYTE rel_ub_q0p75 1 100 0 191.25 FORMAT "%5.1" ECU_ADDRESS 0x80109D /end MEASUREMENT
/begin MEASUREMENT rlpnb_w "rel. Luftf¸llung pr‰diziert, nicht begrenzt" UWORD rel_uw_q0p0234 1 100 0 1535.98 FORMAT "%8.3" ECU_ADDRESS 0x801382 /end MEASUREMENT
/begin MEASUREMENT rlpu_w "rel. Luftf¸llung pr‰diziert, Untergrenze" UWORD rel_uw_q0p0234 1 100 0 1535.98 FORMAT "%8.3" ECU_ADDRESS 0x801384 /end MEASUREMENT
/begin MEASUREMENT rlp_w "rel. Luftf¸llung praediziert f¸r Einspritzberechnung (Word)" UWORD rel_uw_q0p0234 1 100 0 1535.98 FORMAT "%8.3" ECU_ADDRESS 0x801386 /end MEASUREMENT
/begin MEASUREMENT rlrint_w "relative Luftf¸llung ¸ber internes AGR" UWORD rel_uw_q0p0234 1 100 0 1535.98 FORMAT "%8.3" ECU_ADDRESS 0x801352 /end MEASUREMENT
/begin MEASUREMENT rlroh_w "relative Luftf¸llung: Rohwert vom Lastsensor (word)" UWORD rel_uw_q0p0234 1 100 0 1535.98 FORMAT "%8.3" ECU_ADDRESS 0x80136E /end MEASUREMENT
/begin MEASUREMENT rlrsp_w "Beginn Ringspeicher relative F¸llung" UWORD rel_uw_q0p0234 1 100 0 1535.98 FORMAT "%8.3" ARRAY_SIZE 10 ECU_ADDRESS 0x80138E /end MEASUREMENT
/begin MEASUREMENT rlr_w "relative Luftf¸llung ¸ber int. und ext. AGR" UWORD rel_uw_q0p0234 1 100 0 1535.98 FORMAT "%8.3" ECU_ADDRESS 0x801354 /end MEASUREMENT
/begin MEASUREMENT rlshk "Soll-F¸llung hˆhenkorrigiert" UWORD rel_ub_q0p75 1 100 0 49151.3 FORMAT "%8.2" ECU_ADDRESS 0x8010D5 /end MEASUREMENT
/begin MEASUREMENT rlshk_w "Soll-F¸llung hˆhenkorrigiert" UWORD rel_uw_q0p0234 1 100 0 1535.98 FORMAT "%8.3" ECU_ADDRESS 0x801496 /end MEASUREMENT
/begin MEASUREMENT rlsolhom_w "Soll-F¸llung im Homogenbetrieb" UWORD rel_uw_q0p0234 1 100 0 1535.98 FORMAT "%8.3" ECU_ADDRESS 0x801498 /end MEASUREMENT
/begin MEASUREMENT rlsol_w "Soll-F¸llung" UWORD rel_uw_q0p0234 1 100 0 1535.98 FORMAT "%8.3" ECU_ADDRESS 0x80149A /end MEASUREMENT
/begin MEASUREMENT rlugd_w "F¸llung im ungedrosselten Zustand" UWORD rel_uw_q0p0234 1 100 0 1535.98 FORMAT "%8.3" ECU_ADDRESS 0x80059A /end MEASUREMENT
/begin MEASUREMENT rlvugd_w "unkorrigierte F¸llung im ungedrosselten Zustand" UWORD rel_uw_q0p0234 1 100 0 1535.98 FORMAT "%8.3" ECU_ADDRESS 0x80059C /end MEASUREMENT
/begin MEASUREMENT rml "relative Luftmasse (calc. load value) nach SAE J1979" UBYTE rel_ub_b99p6 1 100 0 99.6094 FORMAT "%5.2" ECU_ADDRESS 0x80059E /end MEASUREMENT
/begin MEASUREMENT RoadResistanceHigh_Mode "" UBYTE DC_FLAG_U8 1 100 0 1 BIT_MASK 0x1 FORMAT "%5.3" ECU_ADDRESS 0x8036B9 /end MEASUREMENT
/begin MEASUREMENT rri_w "Restgas-Inertgasrate durch externes und internes AGR" UWORD rel_uw_b100 1 100 0 99.9985 FORMAT "%8.5" ECU_ADDRESS 0x801356 /end MEASUREMENT
/begin MEASUREMENT rr_w "Restgas-Rate (Inertgas+Luft) ¸ber internes und externes AGR" UWORD rel_uw_b100 1 100 0 99.9985 FORMAT "%8.5" ECU_ADDRESS 0x801358 /end MEASUREMENT
/begin MEASUREMENT SBC_ISRD_Actvt "" UBYTE DC_FLAG_U8 1 100 0 1 BIT_MASK 0x1 FORMAT "%5.3" ECU_ADDRESS 0x8036BA /end MEASUREMENT
/begin MEASUREMENT SBC_ISRD_Parity "" UBYTE DC_FLAG_U8 1 100 0 1 BIT_MASK 0x1 FORMAT "%5.3" ECU_ADDRESS 0x8036BB /end MEASUREMENT
/begin MEASUREMENT SBC_ISRD_Tgl "" UBYTE DC_FLAG_U8 1 100 0 1 BIT_MASK 0x1 FORMAT "%5.3" ECU_ADDRESS 0x8036BC /end MEASUREMENT
/begin MEASUREMENT SBC_WireTestEnabl "" UBYTE DC_FLAG_U8 1 100 0 1 BIT_MASK 0x1 FORMAT "%5.3" ECU_ADDRESS 0x8036BD /end MEASUREMENT
/begin MEASUREMENT SCT_238h_MsgLost_Cntr "" UBYTE DC_CNTR_U8 1 100 0 255 FORMAT "%5.1" ECU_ADDRESS 0x8037D3 /end MEASUREMENT
/begin MEASUREMENT SCT_238h_MsgLost_DeBnc_Mode "" UBYTE DC_FLAG_U8 1 100 0 1 BIT_MASK 0x1 FORMAT "%5.3" ECU_ADDRESS 0x8037BF /end MEASUREMENT
/begin MEASUREMENT SCT_238h_MsgLost_State_Mode "" UBYTE DC_FLAG_U8 1 100 0 1 BIT_MASK 0x1 FORMAT "%5.3" ECU_ADDRESS 0x8036BE /end MEASUREMENT
/begin MEASUREMENT SegmentDisplay_Mode "" UBYTE DC_FLAG_U8 1 100 0 1 BIT_MASK 0x1 FORMAT "%5.3" ECU_ADDRESS 0x8036BF /end MEASUREMENT
/begin MEASUREMENT SteeringAngle "" UWORD DC_WL05_U16DB 1 100 0 720 FORMAT "%5.1" ECU_ADDRESS 0x803258 /end MEASUREMENT
/begin MEASUREMENT SteeringAngleDir "" UBYTE DC_FLAG_U8 1 100 0 1 BIT_MASK 0x1 FORMAT "%5.3" ECU_ADDRESS 0x8036C0 /end MEASUREMENT
/begin MEASUREMENT SteeringAngle_CodErr "" UBYTE DC_FLAG_U8 1 100 0 1 BIT_MASK 0x1 FORMAT "%5.3" ECU_ADDRESS 0x8036C1 /end MEASUREMENT
/begin MEASUREMENT SteeringAngle_NotInit "" UBYTE DC_FLAG_U8 1 100 0 1 BIT_MASK 0x1 FORMAT "%5.3" ECU_ADDRESS 0x8036C2 /end MEASUREMENT
/begin MEASUREMENT SteeringAngle_Overflow "" UBYTE DC_FLAG_U8 1 100 0 1 BIT_MASK 0x1 FORMAT "%5.3" ECU_ADDRESS 0x8036C3 /end MEASUREMENT
/begin MEASUREMENT SteeringAngle_Parity "" UBYTE DC_FLAG_U8 1 100 0 1 BIT_MASK 0x1 FORMAT "%5.3" ECU_ADDRESS 0x8036C4 /end MEASUREMENT
/begin MEASUREMENT StrtEnabl_Mode "" UBYTE DC_FLAG_U8 1 100 0 1 BIT_MASK 0x1 FORMAT "%5.3" ECU_ADDRESS 0x8036C5 /end MEASUREMENT
/begin MEASUREMENT synstate "Aktueller Synchronisierzustand" UBYTE dez 1 100 0 255 FORMAT "%5.1" ECU_ADDRESS 0x801016 /end MEASUREMENT
/begin MEASUREMENT synstate_o "Sychronisationszustand des vorherigen Synchros" UBYTE dez 1 100 0 255 FORMAT "%5.1" ECU_ADDRESS 0x801017 /end MEASUREMENT
/begin MEASUREMENT tabgsant_w "station‰re Brennraumtemperatur durch Restgasanteil" SWORD temp_sw_q0p75 1 100 -24576 24575.3 FORMAT "%8.2" ECU_ADDRESS 0x800564 /end MEASUREMENT
/begin MEASUREMENT tabsnl0_w "Abstellzeit aus SG-Nachlauf" UWORD t1sxs_uw_q1 1 100 0 65535 FORMAT "%8.2" ECU_ADDRESS 0x7FC838 /end MEASUREMENT
/begin MEASUREMENT tabsnl_w "Abstellzeit aus SG-Nachlauf" UWORD t1sxs_uw_b65535 1 100 0 65535 FORMAT "%8.2" ECU_ADDRESS 0x800CC2 /end MEASUREMENT
/begin MEASUREMENT tabstm_w "Abstellzeit aus Abk¸hlung des Motors" UWORD t1sxs_uw_q1 1 100 0 65535 FORMAT "%8.2" ECU_ADDRESS 0x800CC4 /end MEASUREMENT
/begin MEASUREMENT tabst_w "Abstellzeit" UWORD t1sxs_uw_q1 1 100 0 65535 FORMAT "%8.2" ECU_ADDRESS 0x800CC6 /end MEASUREMENT
/begin MEASUREMENT tabsuhr_w "Abstellzeit aus Uhrinformation" UWORD t1sxs_uw_q1 1 100 0 65535 FORMAT "%8.2" ECU_ADDRESS 0x800CC8 /end MEASUREMENT
/begin MEASUREMENT Tank_Lvl "" UBYTE DC_VQ1LT_U8 1 100 0 255 FORMAT "%9.5" ECU_ADDRESS 0x8037B8 /end MEASUREMENT
/begin MEASUREMENT tas_w "Zeit ¸ber ein Arbeitsspiel f¸r rlgas_w" UWORD t_q16us 1 100 0 1.04856e+006 FORMAT "%8.0" ECU_ADDRESS 0x8013A2 /end MEASUREMENT
/begin MEASUREMENT tbrraum_w "gesamte Brennraumtemperatur station‰r- und Dynamikanteil" SWORD temp_sw_q0p75 1 100 -24576 24575.3 FORMAT "%8.2" ECU_ADDRESS 0x800566 /end MEASUREMENT
/begin MEASUREMENT TCCClose_Mode "" UBYTE DC_FLAG_U8 1 100 0 1 BIT_MASK 0x1 FORMAT "%5.3" ECU_ADDRESS 0x8036C6 /end MEASUREMENT
/begin MEASUREMENT TCCNoLoad_Mode "" UBYTE DC_FLAG_U8 1 100 0 1 BIT_MASK 0x1 FORMAT "%5.3" ECU_ADDRESS 0x8036C7 /end MEASUREMENT
/begin MEASUREMENT TCCOpen_Mode "" UBYTE DC_FLAG_U8 1 100 0 1 BIT_MASK 0x1 FORMAT "%5.3" ECU_ADDRESS 0x8036C8 /end MEASUREMENT
/begin MEASUREMENT TCCSlip_Mode "" UBYTE DC_FLAG_U8 1 100 0 1 BIT_MASK 0x1 FORMAT "%5.3" ECU_ADDRESS 0x8036C9 /end MEASUREMENT
/begin MEASUREMENT TCM_218h_MsgLost_Cntr "" UBYTE DC_CNTR_U8 1 100 0 255 FORMAT "%5.1" ECU_ADDRESS 0x8037BE /end MEASUREMENT
/begin MEASUREMENT TCM_218h_MsgLost_DeBnc_Mode "" UBYTE DC_FLAG_U8 1 100 0 1 BIT_MASK 0x1 FORMAT "%5.3" ECU_ADDRESS 0x8037BD /end MEASUREMENT
/begin MEASUREMENT TCM_218h_MsgLost_State_Mode "" UBYTE DC_FLAG_U8 1 100 0 1 BIT_MASK 0x1 FORMAT "%5.3" ECU_ADDRESS 0x8036CA /end MEASUREMENT
/begin MEASUREMENT TCM_418h_MsgLost_Cntr "" UBYTE DC_CNTR_U8 1 100 0 255 FORMAT "%5.1" ECU_ADDRESS 0x8037BC /end MEASUREMENT
/begin MEASUREMENT TCM_418h_MsgLost_DeBnc_Mode "" UBYTE DC_FLAG_U8 1 100 0 1 BIT_MASK 0x1 FORMAT "%5.3" ECU_ADDRESS 0x8037BB /end MEASUREMENT
/begin MEASUREMENT TCM_418h_MsgLost_State_Mode "" UBYTE DC_FLAG_U8 1 100 0 1 BIT_MASK 0x1 FORMAT "%5.3" ECU_ADDRESS 0x8036CB /end MEASUREMENT
/begin MEASUREMENT TCM_Actl_Ratio "" UBYTE DC_FCTR_50_U8 1 100 0 5.1 FORMAT "%8.6" ECU_ADDRESS 0x8037BA /end MEASUREMENT
/begin MEASUREMENT TCM_BasicShiftPrg_Mode "" UBYTE DC_FLAG_U8 1 100 0 1 BIT_MASK 0x1 FORMAT "%5.3" ECU_ADDRESS 0x8036CC /end MEASUREMENT
/begin MEASUREMENT TCM_Diag_State1 "" UBYTE DC_CNTR_U8 1 100 0 255 FORMAT "%5.1" ECU_ADDRESS 0x8037B9 /end MEASUREMENT
/begin MEASUREMENT TCM_Dyn0_Mode "" UBYTE DC_FLAG_U8 1 100 0 1 BIT_MASK 0x1 FORMAT "%5.3" ECU_ADDRESS 0x8036CD /end MEASUREMENT
/begin MEASUREMENT TCM_Dyn1_Mode_Req "" UBYTE DC_FLAG_U8 1 100 0 1 BIT_MASK 0x1 FORMAT "%5.3" ECU_ADDRESS 0x8036CE /end MEASUREMENT
/begin MEASUREMENT TCM_Parity "" UBYTE DC_FLAG_U8 1 100 0 1 BIT_MASK 0x1 FORMAT "%5.3" ECU_ADDRESS 0x8036CF /end MEASUREMENT
/begin MEASUREMENT TCM_Tgl "" UBYTE DC_FLAG_U8 1 100 0 1 BIT_MASK 0x1 FORMAT "%5.3" ECU_ADDRESS 0x8036D0 /end MEASUREMENT
/begin MEASUREMENT TCM_TrqMax_Mode_Req "" UBYTE DC_FLAG_U8 1 100 0 1 BIT_MASK 0x1 FORMAT "%5.3" ECU_ADDRESS 0x8036D1 /end MEASUREMENT
/begin MEASUREMENT TCM_TrqMin_Mode_Req "" UBYTE DC_FLAG_U8 1 100 0 1 BIT_MASK 0x1 FORMAT "%5.3" ECU_ADDRESS 0x8036D2 /end MEASUREMENT
/begin MEASUREMENT TCM_Trq_Req "" UWORD DC_MMQ13 1 100 -500 1547.75 ECU_ADDRESS 0x803256 /end MEASUREMENT
/begin MEASUREMENT TempCoolingWaterOverLim_Mode "" UBYTE DC_FLAG_U8 1 100 0 1 BIT_MASK 0x1 FORMAT "%5.3" ECU_ADDRESS 0x8037B7 /end MEASUREMENT
/begin MEASUREMENT tempin "Temperatur Eingang (Adressierung von FWFTBRTA)" UBYTE temp_ub_q0p75_o48 1 100 -48 143.25 FORMAT "%5.1" ECU_ADDRESS 0x80055D /end MEASUREMENT
/begin MEASUREMENT tfrgsant_w "station‰re Brennraumtemperatur durch Frischgasanteil" SWORD temp_sw_q0p75 1 100 -24576 24575.3 FORMAT "%8.2" ECU_ADDRESS 0x800568 /end MEASUREMENT
/begin MEASUREMENT tmischbr_w "station‰re Brennraummischtemperatur" SWORD temp_sw_q0p75 1 100 -24576 24575.3 FORMAT "%8.2" ECU_ADDRESS 0x80056A /end MEASUREMENT
/begin MEASUREMENT tmotdif "Differenz aktuelle Motortemperatur zur Motor warm Temperatur" UBYTE temp_ub_q0p75_o48 1 100 -48 143.25 FORMAT "%5.1" ECU_ADDRESS 0x80055E /end MEASUREMENT
/begin MEASUREMENT tmotfil "gefilterte Motortemperatur" UBYTE temp_ub_q0p75_o48 1 100 -48 143.25 FORMAT "%5.1" ECU_ADDRESS 0x7FC316 /end MEASUREMENT
/begin MEASUREMENT toelk_w "(Motor-) ÷ltemperatur, Ausgabe in Grad C, intern in Kelvin" UWORD temp_q0p0234_o273 1 100 -273.15 1262.83 FORMAT "%8.3" ECU_ADDRESS 0x800CA4 /end MEASUREMENT
/begin MEASUREMENT toltm " ÷ltemperatur, modelliert aus Motortemperatur TMOT" UBYTE temp_ub_q0p75_o48 1 100 -48 143.25 FORMAT "%5.1" ECU_ADDRESS 0x800CA2 /end MEASUREMENT
/begin MEASUREMENT tovkrsl_w "Temperaturerhˆhung im Kr¸mmer durch Sekund‰rlufteinblasung vor Vorkat." UWORD temp_q0p0234 1 100 0 1535.98 FORMAT "%8.3" ECU_ADDRESS 0x800A54 /end MEASUREMENT
/begin MEASUREMENT tovvksl_w "Temperaturerhˆhung im Vorkat durch Sekund‰rlufteinblasung vor Vorkat." UWORD temp_q0p0234 1 100 0 1535.98 FORMAT "%8.3" ECU_ADDRESS 0x800A56 /end MEASUREMENT
/begin MEASUREMENT TransTrqLim_Mode_Req "" UBYTE DC_FLAG_U8 1 100 0 1 BIT_MASK 0x1 FORMAT "%5.3" ECU_ADDRESS 0x80385C /end MEASUREMENT
/begin MEASUREMENT TransTrqLim_Req "" SWORD DC_TRQ_S16 1 100 -2048 2047.94 FORMAT "%8.3" ECU_ADDRESS 0x803292 /end MEASUREMENT
/begin MEASUREMENT Trans_Emerg_Mode "" UBYTE DC_FLAG_U8 1 100 0 1 BIT_MASK 0x1 FORMAT "%5.3" ECU_ADDRESS 0x8036D3 /end MEASUREMENT
/begin MEASUREMENT Trans_Gear_ActlTgt "" UBYTE DC_CNTR_U8 1 100 0 255 FORMAT "%5.1" ECU_ADDRESS 0x8037B6 /end MEASUREMENT
/begin MEASUREMENT Trans_Man_Cnfg "" UBYTE DC_FLAG_U8 1 100 0 1 BIT_MASK 0x1 FORMAT "%5.3" ECU_ADDRESS 0x803837 /end MEASUREMENT
/begin MEASUREMENT Trans_OffRoad_Mode "" UBYTE DC_FLAG_U8 1 100 0 1 BIT_MASK 0x1 FORMAT "%5.3" ECU_ADDRESS 0x8036D4 /end MEASUREMENT
/begin MEASUREMENT Trans_OilTempHigh_Mode "" UBYTE DC_FLAG_U8 1 100 0 1 BIT_MASK 0x1 FORMAT "%5.3" ECU_ADDRESS 0x8036D5 /end MEASUREMENT
/begin MEASUREMENT Trans_RvrsGearMTX_Mode "" UBYTE DC_FLAG_U8 1 100 0 1 BIT_MASK 0x1 FORMAT "%5.3" ECU_ADDRESS 0x8037B5 /end MEASUREMENT
/begin MEASUREMENT Trans_RvrsGear_CAN_Mode "" UBYTE DC_FLAG_U8 1 100 0 1 BIT_MASK 0x1 FORMAT "%5.3" ECU_ADDRESS 0x8036D6 /end MEASUREMENT
/begin MEASUREMENT Trans_SelectorPosn "" UBYTE DC_CNTR_U8 1 100 0 15 FORMAT "%5.2" ECU_ADDRESS 0x8037B4 /end MEASUREMENT
/begin MEASUREMENT Trq_Loss "" SWORD DC_TRQ_S16 1 100 -2048 2047.94 FORMAT "%8.3" ECU_ADDRESS 0x8032A4 /end MEASUREMENT
/begin MEASUREMENT TrvrAccel "" UBYTE DC_UAYS_U8DB 1 100 -10.24 10.16 FORMAT "%5.2" ECU_ADDRESS 0x8037B3 /end MEASUREMENT
/begin MEASUREMENT tsast_l "Zeit ¸ber ein Arbeitsspiel genau" ULONG t_q0p0001_ms 1 100 0 429497 FORMAT "%13.6" ECU_ADDRESS 0x801E04 /end MEASUREMENT
/begin MEASUREMENT tsas_w "Zeit ¸ber ein Arbeitsspiel f¸r ngas_w" UWORD t_q0p04_ms 1 100 0 2621.4 FORMAT "%8.3" ECU_ADDRESS 0x801BC8 /end MEASUREMENT
/begin MEASUREMENT tsegrsp_l "Array mit Segmentzeiten ¸ber das letzte Arbeitsspiel" ULONG t_q0p0001_ms 1 100 0 429497 FORMAT "%13.6" ARRAY_SIZE 10 ECU_ADDRESS 0x801E08 /end MEASUREMENT
/begin MEASUREMENT tsr_w "Temperatur Luft im Saugrohr" SWORD temp_sw_q0p75 1 100 -24576 24575.3 FORMAT "%8.2" ECU_ADDRESS 0x80056C /end MEASUREMENT
/begin MEASUREMENT tsynwa_l "Systemzeit zur Berechnung der verfeinerten Istposition NW-Verstellung Auslaﬂ 1" ULONG t_q1p024_ms 1 100 0 4.39805e+009 FORMAT "%13.2" ECU_ADDRESS 0x801D00 /end MEASUREMENT
/begin MEASUREMENT tsynwe_l "Systemzeit zur Berechnung der verfeinerten Istposition NW_Verstellung Einlaﬂ 1" ULONG t_q1p024_ms 1 100 0 4.39805e+009 FORMAT "%13.2" ECU_ADDRESS 0x801CEC /end MEASUREMENT
/begin MEASUREMENT tum "Umgebungstemperatur" UBYTE temp_ub_q0p75_o48 1 100 -48 143.25 FORMAT "%5.1" ECU_ADDRESS 0x7FC7DD /end MEASUREMENT
/begin MEASUREMENT tumg "Umgebungstemperatur" UBYTE temp_ub_q0p75_o48 1 100 -48 143.25 FORMAT "%5.1" ECU_ADDRESS 0x800CA9 /end MEASUREMENT
/begin MEASUREMENT tumgk_w "Umgebungstemperatur in Kelvin, Ausgabe in Grad C, intern in Kelvin" UWORD temp_q0p0234_o273 1 100 -273.15 1262.83 FORMAT "%8.3" ECU_ADDRESS 0x800CA6 /end MEASUREMENT
/begin MEASUREMENT tumtmp "Hilfsgrˆﬂe Umgebungstemperatur" UBYTE temp_ub_q0p75_o48 1 100 -48 143.25 FORMAT "%5.1" ECU_ADDRESS 0x800CAA /end MEASUREMENT
/begin MEASUREMENT umsnms_w "Umrechnung von normiertem Massenstrom in Massenstrom" UWORD fak_uw_b4 1 100 0 3.99994 FORMAT "%8.6" ECU_ADDRESS 0x801482 /end MEASUREMENT
/begin MEASUREMENT umsrlnk_w "umsrln_w bei kleinen Drehzahlen begrenzt" UWORD m_q0p0005 1 100 0 32.7675 FORMAT "%8.5" ECU_ADDRESS 0x801492 /end MEASUREMENT
/begin MEASUREMENT umsrln_w "Umrechnungsfaktor F¸llung in Massenstrom" UWORD m_q0p0005 1 100 0 32.7675 FORMAT "%8.5" ECU_ADDRESS 0x801370 /end MEASUREMENT
/begin MEASUREMENT Veh_Spd_Raw "" UWORD DC_URD_05 1 100 0 8191.5 FORMAT "%8.3" ECU_ADDRESS 0x803254 /end MEASUREMENT
/begin MEASUREMENT VES_Emerg_Mode "" UBYTE DC_FLAG_U8 1 100 0 1 BIT_MASK 0x1 FORMAT "%5.3" ECU_ADDRESS 0x8036D7 /end MEASUREMENT
/begin MEASUREMENT VES_InfoBit0 "" UBYTE DC_FLAG_U8 1 100 0 1 BIT_MASK 0x1 FORMAT "%5.3" ECU_ADDRESS 0x8037B2 /end MEASUREMENT
/begin MEASUREMENT VES_InfoBit1 "" UBYTE DC_FLAG_U8 1 100 0 1 BIT_MASK 0x1 FORMAT "%5.3" ECU_ADDRESS 0x8037B1 /end MEASUREMENT
/begin MEASUREMENT vfgrrf_w "Referenz-Fahrzeuggeschwindigkeit f¸r FGR" UWORD vfzg_uw_b512 1 100 0 511.992 FORMAT "%8.4" ECU_ADDRESS 0x80188C /end MEASUREMENT
/begin MEASUREMENT vfgr_w "Fahrzeug-Ist-Geschwindigkeit f¸r FGR" UWORD vfzg_uw_b512 1 100 0 511.992 FORMAT "%8.4" ECU_ADDRESS 0x80188E /end MEASUREMENT
/begin MEASUREMENT vfzgk_w "Fahrzeuggeschwindigkeit, korrigiert" UWORD vfzg_uw_b512 1 100 0 511.992 FORMAT "%8.4" ECU_ADDRESS 0x801890 /end MEASUREMENT
/begin MEASUREMENT vfzgv1f_w "Fahrzeuggeschwindigkeit, CAN-Signal V1 gefiltert" UWORD vfzg_uw_b512 1 100 0 511.992 FORMAT "%8.4" ECU_ADDRESS 0x801892 /end MEASUREMENT
/begin MEASUREMENT vnwa2_w "Berechnete Verstellgeschwindigkeit der NW, Auslass 2" SWORD vnw_q0p0298 1 100 -976.486 976.457 FORMAT "%4.0" ECU_ADDRESS 0x8014EE /end MEASUREMENT
/begin MEASUREMENT vnwa_w "berechnete Verstellgeschwindigkeit der NW, Auslass" SWORD vnw_q0p0298 1 100 -976.486 976.457 FORMAT "%4.0" ECU_ADDRESS 0x8014F0 /end MEASUREMENT
/begin MEASUREMENT vnwe2_w "berechnete Verstellgeschwindigkeit der NW Einlaﬂ 2" SWORD vnw_q0p0298 1 100 -976.486 976.457 FORMAT "%4.0" ECU_ADDRESS 0x8014E4 /end MEASUREMENT
/begin MEASUREMENT vnwe_w "berechnete Verstellgeschwindigkeit der NW Einlaﬂ" SWORD vnw_q0p0298 1 100 -976.486 976.457 FORMAT "%4.0" ECU_ADDRESS 0x8014E6 /end MEASUREMENT
/begin MEASUREMENT vpspanav_w "Verh‰ltnis Saugrohrdruck ps_w zu Abgasdruck nach Auslaﬂventil pabnav_w" UWORD fak_uw_b2 1 100 0 1.99997 FORMAT "%8.6" ECU_ADDRESS 0x800544 /end MEASUREMENT
/begin MEASUREMENT vpvtpnt_w "Verh‰ltnis Druck vor Turbine zu Druck nach Turbine" UWORD fak_uw_b8 1 100 0 7.99988 FORMAT "%8.6" ECU_ADDRESS 0x800524 /end MEASUREMENT
/begin MEASUREMENT vregdia_w "Volumenstrom Tankentl¸ftungsventil: Wert f¸r Diagnose Tankdichtheit" UWORD vs_uw_b25p6 1 100 0 25.5996 FORMAT "%8.5" ECU_ADDRESS 0x80177E /end MEASUREMENT
/begin MEASUREMENT VSL_IndicMph_Mode "" UBYTE DC_FLAG_U8 1 100 0 1 BIT_MASK 0x1 FORMAT "%5.3" ECU_ADDRESS 0x8036D8 /end MEASUREMENT
/begin MEASUREMENT vssekp "EKP-Sollvolumenstrom" UBYTE fuel_ub_q1 1 100 0 255 FORMAT "%5.1" ECU_ADDRESS 0x800C12 /end MEASUREMENT
/begin MEASUREMENT vssgkrst "Kraftstoff-Sollvolumenstrom (Gesamtbedarf Motor + Saugstrahlpumpe)" UBYTE fuel_ub_q1 1 100 0 255 FORMAT "%5.1" ECU_ADDRESS 0x800C13 /end MEASUREMENT
/begin MEASUREMENT vsskrst "Kraftstoff-Sollvolumenstrom (Betriebspunktabh‰ngiger Bedarf)" UBYTE fuel_ub_q1 1 100 0 255 FORMAT "%5.1" ECU_ADDRESS 0x800C14 /end MEASUREMENT
/begin MEASUREMENT vsskrstl1 "Kraftstoff-Sollvolumenstrom f¸r Lambda=1" UBYTE fuel_ub_q1 1 100 0 255 FORMAT "%5.1" ECU_ADDRESS 0x800C15 /end MEASUREMENT
/begin MEASUREMENT vssssp "Kraftstoff-Sollvolumenstrom f¸r die Saugstrahlpumpe" UBYTE fuel_ub_q1 1 100 0 255 FORMAT "%5.1" ECU_ADDRESS 0x800C16 /end MEASUREMENT
/begin MEASUREMENT vssvlmx "Kraftstoff-Sollvolumenstrom bei Vollast" UBYTE fuel_ub_q1 1 100 0 255 FORMAT "%5.1" ECU_ADDRESS 0x800C17 /end MEASUREMENT
/begin MEASUREMENT vwkw "KW-Winkelgeschwindigkeit" UBYTE rel_ub_q0p1875 1 100 0 47.8125 FORMAT "%5.2" ECU_ADDRESS 0x8010AF /end MEASUREMENT
/begin MEASUREMENT wdkbab_w "wdkba_w begrenzt (Minimalauswahl zwischen wdkba_w und wdkugd_w)" UWORD rel_uw_b100 1 100 0 99.9985 FORMAT "%8.5" ECU_ADDRESS 0x801484 /end MEASUREMENT
/begin MEASUREMENT wdkbam_w "Drosselklappenwinkel bezogen auf unteren Anschlag(Mittelwert ¸. 1 Seg.)" UWORD rel_uw_b100 1 100 0 99.9985 FORMAT "%8.5" ECU_ADDRESS 0x801486 /end MEASUREMENT
/begin MEASUREMENT wdkbapb_w "fuer Einspritzung praediz. begr. Drosselklappenwinkel (Word)" UWORD rel_uw_b100 1 100 0 99.9985 FORMAT "%8.5" ECU_ADDRESS 0x801388 /end MEASUREMENT
/begin MEASUREMENT wdkbap_w "fuer Einspritzung praedizierter Drosselklappenwinkel (Word)" UWORD rel_uw_b100 1 100 0 99.9985 FORMAT "%8.5" ECU_ADDRESS 0x8013AA /end MEASUREMENT
/begin MEASUREMENT wdkbate "Winkel Drosselklappe f¸r Kennfeldberechnung in der Tankentl¸ftung" UBYTE relDK_ub_b100 1 100 0 100 FORMAT "%5.1" ECU_ADDRESS 0x8011C6 /end MEASUREMENT
/begin MEASUREMENT wdkbav "Virtueller Drosselklappenwinkel zur Ber¸cksichtigung von AGR in der TE" UBYTE relDK_ub_b100 1 100 0 100 FORMAT "%5.1" ECU_ADDRESS 0x8011C7 /end MEASUREMENT
/begin MEASUREMENT wdkhfu_w " WK-Winkel  ber. aus Massenstrom d. Haupf¸llungssensors ungedrosselt" UWORD rel_uw_b100 1 100 0 99.9985 FORMAT "%8.5" ECU_ADDRESS 0x8013A6 /end MEASUREMENT
/begin MEASUREMENT wdkhf_w "Berechneter Winkel der Drosselklappe aus dem Hauptf¸llungssignal" UWORD rel_uw_b100 1 100 0 99.9985 FORMAT "%8.5" ECU_ADDRESS 0x8013A8 /end MEASUREMENT
/begin MEASUREMENT WhlFront_Circumfer "" UWORD DC_UDFCPARL 1 100 0 4.16661 FORMAT "%8.6" ECU_ADDRESS 0x803288 /end MEASUREMENT
/begin MEASUREMENT WhlRear_Circumfer "" UWORD DC_UDFCPARL 1 100 0 4.16661 FORMAT "%8.6" ECU_ADDRESS 0x803286 /end MEASUREMENT
/begin MEASUREMENT WhlSpdFrontLeft "" UWORD DC_URD_05 1 100 0 8191.5 FORMAT "%8.3" ECU_ADDRESS 0x803252 /end MEASUREMENT
/begin MEASUREMENT WhlSpdFrontRight "" UWORD DC_URD_05 1 100 0 8191.5 FORMAT "%8.3" ECU_ADDRESS 0x803250 /end MEASUREMENT
/begin MEASUREMENT WhlSpdRearLeft "" UWORD DC_URD_05 1 100 0 8191.5 FORMAT "%8.3" ECU_ADDRESS 0x80324E /end MEASUREMENT
/begin MEASUREMENT WhlSpdRearRight "" UWORD DC_URD_05 1 100 0 8191.5 FORMAT "%8.3" ECU_ADDRESS 0x80324C /end MEASUREMENT
/begin MEASUREMENT wnwvfa2_w "Verfeinerter NW-Winkel Auslass-NW2" SWORD kw_q0p0078 1 100 -256 255.992 FORMAT "%8.4" ECU_ADDRESS 0x8014F2 /end MEASUREMENT
/begin MEASUREMENT wnwvfa_w "Verfeinerter NW-Winkel Auslass-NW1" SWORD kw_q0p0078 1 100 -256 255.992 FORMAT "%8.4" ECU_ADDRESS 0x8014F4 /end MEASUREMENT
/begin MEASUREMENT wnwvfe2_w "Verfeinerter NW-Winkel Einlaﬂ-NW2" SWORD kw_q0p0078 1 100 -256 255.992 FORMAT "%8.4" ECU_ADDRESS 0x8014E8 /end MEASUREMENT
/begin MEASUREMENT wnwvfe_w "Verfeinerter NW-Winkel Einlaﬂ-NW1" SWORD kw_q0p0078 1 100 -256 255.992 FORMAT "%8.4" ECU_ADDRESS 0x8014EA /end MEASUREMENT
/begin MEASUREMENT wpr "Einspritzberechnungs-Praediktions-Winkel" UBYTE zw_ub_q6 1 100 0 1530 FORMAT "%5.0" ECU_ADDRESS 0x8010B0 /end MEASUREMENT
/begin MEASUREMENT wprnsp "Einspritzberechnungs-Praediktions-Winkel bei Nachspritzer" UBYTE zw_ub_q6 1 100 0 1530 FORMAT "%5.0" ECU_ADDRESS 0x8010B1 /end MEASUREMENT
/begin MEASUREMENT wsistslf_w "tats‰chlicher Abgasenergiestrom bei Sekund‰rlufeinblasung vor Vorkat gefiltert" UWORD leist_q2 1 100 0 32768 FORMAT "%8.2" ECU_ADDRESS 0x800A58 /end MEASUREMENT
/begin MEASUREMENT wsistsvk_w "tats‰chlicher Abgasenergiestrom bei Sekund‰rlufeinblasung vor Vorkat" UWORD leist_q2 1 100 0 32768 FORMAT "%8.2" ECU_ADDRESS 0x800A5A /end MEASUREMENT
/begin MEASUREMENT xfvisrm_w "" UWORD dez 1 100 0 65535 FORMAT "%8.2" ECU_ADDRESS 0x800546 /end MEASUREMENT
/begin MEASUREMENT xqtm_w "Temperaturquotient" UWORD fak_uw_b16 1 100 0 15.9998 FORMAT "%8.5" ECU_ADDRESS 0x800CCA /end MEASUREMENT
/begin MEASUREMENT zrph2_save "" ULONG dez 1 100 0 4.29497e+009 FORMAT "%13.2" ECU_ADDRESS 0x801E30 /end MEASUREMENT
/begin MEASUREMENT zrph3_save "" ULONG dez 1 100 0 4.29497e+009 FORMAT "%13.2" ECU_ADDRESS 0x801E34 /end MEASUREMENT
/begin MEASUREMENT zrph4_save "" ULONG dez 1 100 0 4.29497e+009 FORMAT "%13.2" ECU_ADDRESS 0x801E38 /end MEASUREMENT
/begin MEASUREMENT zrph_save "" ULONG dez 1 100 0 4.29497e+009 FORMAT "%13.2" ECU_ADDRESS 0x801E3C /end MEASUREMENT
/begin MEASUREMENT ZUL_CanTimeoutFlag "" UBYTE dez 1 100 0 255 FORMAT "%5.1" ARRAY_SIZE 15 ECU_ADDRESS 0x7FC364 /end MEASUREMENT
/begin MEASUREMENT ZUL_can_buffer "" UBYTE dez 1 100 0 255 FORMAT "%5.1" ARRAY_SIZE 159 ECU_ADDRESS 0x7FB2FC /end MEASUREMENT
/begin MEASUREMENT zylvirt "Stand Zylinderz‰hler vor Umsynchronisation aus Schnellstart" UBYTE dez 1 100 0 255 FORMAT "%5.1" ECU_ADDRESS 0x801018 /end MEASUREMENT
/begin FUNCTION BGMSDK "Berechnung Massenstrom ¸ber Drosselklappe" /begin DEF_CHARACTERISTIC KLAF KMSDK MSNWDK PSPVDKUG PSPVDKUGMN /end DEF_CHARACTERISTIC /begin REF_CHARACTERISTIC /end REF_CHARACTERISTIC
 /begin IN_MEASUREMENT B_edss depsdss_w fkmsdk_w fpvdkds_w ftvdk_w msdkmx_w msdkugd_w msndko_w psdss_w pslmsm_w ps_w pvdkds_w wdkba_w wdkugd_w /end IN_MEASUREMENT
 /begin OUT_MEASUREMENT B_ugd dmsdkugd_w fklaf_w fpvdk fpvdk_w frhodk_w frhovdk_w msdkoue_w msdk_w msndkoo_w msndk_w pspvdb_w pspvdkds_w pspvdk_w pvdk pvdk_w umsnms_w /end OUT_MEASUREMENT
 /begin LOC_MEASUREMENT B_pugd kmsdk_w msdkvf_w psdsssm_w wdkbab_w wdkbam_w /end LOC_MEASUREMENT
 /begin SUB_FUNCTION /end SUB_FUNCTION
/end FUNCTION
/begin FUNCTION BGMSDKS "Berechnung Sollmassenstrom ¸ber Drosselklappe" /begin DEF_CHARACTERISTIC UMSRLNMN /end DEF_CHARACTERISTIC /begin REF_CHARACTERISTIC /end REF_CHARACTERISTIC
 /begin IN_MEASUREMENT B_nwswg drlfue_w fupsrl_w mste rirints_w rirint_w rlrints_w rlrint_w rlsol_w umsrln_w /end IN_MEASUREMENT
 /begin OUT_MEASUREMENT mlsol_w msdks_w pssol_w rlfgks_w rlfgs_w umsrlnk_w /end OUT_MEASUREMENT
 /begin LOC_MEASUREMENT /end LOC_MEASUREMENT
 /begin SUB_FUNCTION /end SUB_FUNCTION
/end FUNCTION
/begin FUNCTION BGMSDSS "Berechnung Luftmassenstrom aus Signal DS-S als Hautf¸llungssensor" /begin DEF_CHARACTERISTIC /end DEF_CHARACTERISTIC /begin REF_CHARACTERISTIC /end REF_CHARACTERISTIC /begin IN_MEASUREMENT dpsfgds_w fvisrm_w mste rlfgds_w umsrln_w /end IN_MEASUREMENT /begin OUT_MEASUREMENT msdkds_w /end OUT_MEASUREMENT /begin LOC_MEASUREMENT /end LOC_MEASUREMENT /begin SUB_FUNCTION /end SUB_FUNCTION /end FUNCTION
/begin FUNCTION BGMSLS "Berechnete Grˆﬂen f¸r Sekund‰rluftmassenbestimmung"
 /begin DEF_CHARACTERISTIC ETAWSSLPTM FMSLOFF FMSRHOL FTOVKRSLLA IMLSLOFF IMLSLON KFFMSML MSLUB TDWSSLP ZKSLPOFF ZKSLPON /end DEF_CHARACTERISTIC
 /begin REF_CHARACTERISTIC /end REF_CHARACTERISTIC
 /begin IN_MEASUREMENT B_slp B_sls fmsla fmsla2 frhokor_w frm2_w frm_w lamsbg2_w lamsbg_w lamsoni2_w lamsoni_w ml_w msfabr_w nmot rl tmst ubsqf_w verhmsb2_w verhmsb_w /end IN_MEASUREMENT
 /begin OUT_MEASUREMENT bgmslsAusBits B_msloff B_slsoff flamsl2_w flamslth_w flamsl_w fmsldyn fmslrho fslpdyn msfabrv2_w msfabrv_w msl msl2 msl2_w msllam2_w msllam_w mslstat_w mslth2_w mslth_w msl_w tovkrsl_w tovvksl_w wsistslf_w wsistsvk_w /end OUT_MEASUREMENT
 /begin LOC_MEASUREMENT bgmslsLokBits B_mslon fmsagd fmslkor imlsloff_w imlslon_w mslmdyn_w mslpdyn_w mslpub_w /end LOC_MEASUREMENT
 /begin SUB_FUNCTION /end SUB_FUNCTION
/end FUNCTION
/begin FUNCTION BGMSUGD "Berechnungsgrˆﬂe  Massenstrom ungedrosselt" /begin DEF_CHARACTERISTIC /end DEF_CHARACTERISTIC /begin REF_CHARACTERISTIC PSPVDKUG /end REF_CHARACTERISTIC /begin IN_MEASUREMENT fupsrl_w mste pbrint_w pvdkds_w rlfgks_w umsrlnk_w /end IN_MEASUREMENT /begin OUT_MEASUREMENT msdkmx_w msdkugd_w rfinugds_w rldkmx_w rldkugd_w /end OUT_MEASUREMENT /begin LOC_MEASUREMENT rforidmx_w rforidug_w /end LOC_MEASUREMENT /begin SUB_FUNCTION /end SUB_FUNCTION /end FUNCTION
/begin FUNCTION BGNG "Berechnete Grˆﬂe Drehzahlgradient" /begin DEF_CHARACTERISTIC ZNGFIL /end DEF_CHARACTERISTIC /begin REF_CHARACTERISTIC /end REF_CHARACTERISTIC /begin IN_MEASUREMENT inisynmon nmot_w tseg_l /end IN_MEASUREMENT
 /begin OUT_MEASUREMENT B_ngasok dnmotas_w dnmot_w irspsyn ngas_w ngfil ngfil_w tsegrsp_l /end OUT_MEASUREMENT
 /begin LOC_MEASUREMENT irspsynold nmotarr_w nmotas_w tsast_l tsas_w /end LOC_MEASUREMENT
 /begin SUB_FUNCTION /end SUB_FUNCTION
/end FUNCTION
/begin FUNCTION bgnmot "bgnmot.   Berechnete Grˆﬂe Drehzahl" /begin DEF_CHARACTERISTIC /end DEF_CHARACTERISTIC /begin REF_CHARACTERISTIC /end REF_CHARACTERISTIC /begin IN_MEASUREMENT B_nmin synstate tseg_l /end IN_MEASUREMENT /begin OUT_MEASUREMENT nmot nmotll nmotllfil nmot_f nmot_w /end OUT_MEASUREMENT /begin LOC_MEASUREMENT /end LOC_MEASUREMENT /begin SUB_FUNCTION /end SUB_FUNCTION /end FUNCTION
/begin FUNCTION BGODS "BGODS.    Berechnete Grˆﬂe ÷ldruckschalter" /begin DEF_CHARACTERISTIC NMOTOEL1 NMOTOEL2 TVPOELAN1 TVPOELAN2 /end DEF_CHARACTERISTIC /begin REF_CHARACTERISTIC /end REF_CHARACTERISTIC /begin IN_MEASUREMENT B_oeldr nmot_w /end IN_MEASUREMENT /begin OUT_MEASUREMENT B_oeldran /end OUT_MEASUREMENT /begin LOC_MEASUREMENT /end LOC_MEASUREMENT /begin SUB_FUNCTION /end SUB_FUNCTION /end FUNCTION
/begin FUNCTION BGPABG "Berechnete Groesse Abgasgegendruck" /begin DEF_CHARACTERISTIC KLPABNAV KLPAVHK KLPAVVK /end DEF_CHARACTERISTIC /begin REF_CHARACTERISTIC /end REF_CHARACTERISTIC
 /begin IN_MEASUREMENT msabikr2_w msabikr_w msabvhk2_w msabvhk_w msabvvk2_w msabvvk_w pu_w tavro2_w tavro_w /end IN_MEASUREMENT
 /begin OUT_MEASUREMENT fpabnav2_w fpabnav_w pabnav2_w pabnav_w pabvhk2_w pabvhk_w pabvvk2_w pabvvk_w /end OUT_MEASUREMENT
 /begin LOC_MEASUREMENT vpvtpnt_w /end LOC_MEASUREMENT
 /begin SUB_FUNCTION /end SUB_FUNCTION
/end FUNCTION
/begin FUNCTION BGPIRG "Berechnung des internen Restgasanteils"
 /begin DEF_CHARACTERISTIC CWPIRGAP DNWVSMN FKL2HYSTMN FKL2HYSTMX FLBKKLP2 FPVMXST FUPSRLMN FUPSRLMX FWNWVSAP FWNWVSO FWNWVSU KFFUPSRLK KFPIRGRES KFPRGA KFPRGE KFPRGKL12A KFPRGKL12E KFPRGKL2A KFPRGKL2E KFPRGSUA KFPRGSUE KFUPSRLKNW KFURLA KFURLE KFURLKL12A KFURLKL12E KFURLKL2A KFURLKL2E KFURLSUA KFURLSUE KISRM KISRMKL12 KISRMKL2 KISRMSU KLPRGAGPS PBRINTMN PBRINTMX ZVTPRGSU /end DEF_CHARACTERISTIC
 /begin REF_CHARACTERISTIC /end REF_CHARACTERISTIC
 /begin IN_MEASUREMENT B_st B_su fho_w fkfupsrl_w flb_w fnwue fpabnav2_w fpabnav_w fsu_w ftbr_w ftsr nmot_w ofpbrint_w pabnav2_w pabnav_w ps_w pvdkds_w rfges_w rlfg_w wnwa_w wnwe_w wnwsmna_w wnwsmxe_w wnwvumxa_w wnwvumxe_w wnwvu_w /end IN_MEASUREMENT
 /begin OUT_MEASUREMENT fkisrm_w fprgagps_w fupsrluk_w fupsrl_w fvisrm_w fwnwvs_w pbrintuk_w pbrint_w pirgres_w pirg_w psmx_w rfrint_w rfr_w rirint_w rir_w rlrint_w rlr_w rri_w rr_w xfvisrm_w /end OUT_MEASUREMENT
 /begin LOC_MEASUREMENT dfrlkl2a_w dfrlkl2e_w dfupsrla_w dfupsrle_w dfurlsua_w dfurlsue_w dpbra_w dpbre_w dprgkl2a_w dprgkl2e_w dprgsua_w dprgsue_w ffupsrlk_w fkl2_w fpsrlroa_w fpsrlroe_w fupsrlro_w furla_w furle_w furlia_w furlie_w furlkl12a_w furlkl12e_w furlkl2a_w furlkl2e_w furlsua_w furlsue_w furlsuia_w furlsuie_w nwvsakt_w nwvsfrue_w nwvsmnu_w nwvsspae_w pbrintna_w pbrintro_w pbriroa_w pbriroe_w pirgia_w pirgie_w pirgsuia_w pirgsuie_w prga_w prge_w prgkl12a_w prgkl12e_w prgkl2a_w prgkl2e_w prgsua_w prgsue_w vpspanav_w /end LOC_MEASUREMENT
 /begin SUB_FUNCTION /end SUB_FUNCTION
/end FUNCTION
/begin FUNCTION BGPRGS "Berechnungsgrˆﬂe internes Restgas Sollwert" /begin DEF_CHARACTERISTIC /end DEF_CHARACTERISTIC
 /begin REF_CHARACTERISTIC FLBKKLP2 FUPSRLMN FUPSRLMX KFPRGA KFPRGE KFPRGKL12A KFPRGKL12E KFPRGKL2A KFPRGKL2E KFPRGSUA KFPRGSUE KFURLA KFURLE KFURLKL12A KFURLKL12E KFURLKL2A KFURLKL2E KFURLSUA KFURLSUE PBRINTMN PBRINTMX /end REF_CHARACTERISTIC
 /begin IN_MEASUREMENT B_su fho_w fkfupsrl_w flb_w ftbr_w fwnwvs_w nmot_w ofpbrint_w wnvuhoms_w /end IN_MEASUREMENT
 /begin OUT_MEASUREMENT fupshoms_w pbrihoms_w /end OUT_MEASUREMENT
 /begin LOC_MEASUREMENT fupahoms_w fupehoms_w fupohoms_w pbrahoms_w pbrehoms_w pbrohoms_w /end LOC_MEASUREMENT
 /begin SUB_FUNCTION /end SUB_FUNCTION
/end FUNCTION
/begin FUNCTION BGRBS "Berechnete Grˆﬂe Radbeschleunigung aus Raddrehzahl" /begin DEF_CHARACTERISTIC TMVDBS VASRM VBSMX /end DEF_CHARACTERISTIC /begin REF_CHARACTERISTIC /end REF_CHARACTERISTIC /begin IN_MEASUREMENT B_asc2cok B_cdswe vfzg vrad_lh vrad_lv vrad_rh vrad_rv /end IN_MEASUREMENT /begin OUT_MEASUREMENT bsc dv_lh dv_lv dv_rh dv_rv /end OUT_MEASUREMENT /begin LOC_MEASUREMENT /end LOC_MEASUREMENT /begin SUB_FUNCTION /end SUB_FUNCTION /end FUNCTION
/begin FUNCTION BGRLFGZS "Berechnung zuflieﬂende Frischluftf¸llung zum Saugrohr" /begin DEF_CHARACTERISTIC CWBGMSZS DDRLDKZU KUMSIRL RLNOT /end DEF_CHARACTERISTIC /begin REF_CHARACTERISTIC /end REF_CHARACTERISTIC
 /begin IN_MEASUREMENT B_ehfm B_hfm dfuelsan_w dmsdkugd_w fkmsdkg_w fkmsdk_w lambts_w msdkoue_w msdk_w mshfms_w mste nmot nmot_w pssol_w pvdkds_w /end IN_MEASUREMENT
 /begin OUT_MEASUREMENT B_mszsdkb B_mxrlroh msdkalm_w rldvs_w rlfdkrof_w rlfdkroh_w rlfgroh_w rlflmroh_w rlroh_w umsrln_w /end OUT_MEASUREMENT
 /begin LOC_MEASUREMENT B_edsli drllad_w msdkf_w rldkofk_w rlnotn_w /end LOC_MEASUREMENT
 /begin SUB_FUNCTION /end SUB_FUNCTION
/end FUNCTION
/begin FUNCTION BGRLG "Berechnete Grˆﬂe RL-GRADIENT" /begin DEF_CHARACTERISTIC /end DEF_CHARACTERISTIC /begin REF_CHARACTERISTIC /end REF_CHARACTERISTIC /begin IN_MEASUREMENT B_ngasok irspsyn rl_w tsegrsp_l /end IN_MEASUREMENT /begin OUT_MEASUREMENT drlas_w rlgas_w /end OUT_MEASUREMENT /begin LOC_MEASUREMENT rlrsp_w tas_w /end LOC_MEASUREMENT /begin SUB_FUNCTION /end SUB_FUNCTION /end FUNCTION
/begin FUNCTION BGRLMXS "Berechnung der Maximalen Sollf¸llung" /begin DEF_CHARACTERISTIC FRLKEVT KLRLVMX /end DEF_CHARACTERISTIC /begin REF_CHARACTERISTIC /end REF_CHARACTERISTIC /begin IN_MEASUREMENT evtmod fho_w nmot_w rl_w /end IN_MEASUREMENT /begin OUT_MEASUREMENT rlmxs_w rlugd_w rml /end OUT_MEASUREMENT /begin LOC_MEASUREMENT rlvugd_w /end LOC_MEASUREMENT /begin SUB_FUNCTION /end SUB_FUNCTION /end FUNCTION
/begin FUNCTION BGRLP "Berechnungsgrˆﬂe rlp pr‰dizierte Luftf¸llung" /begin DEF_CHARACTERISTIC CWBGRLP DRLRLPU FGDPSMPDVS FPVMXP TNSURLP /end DEF_CHARACTERISTIC /begin REF_CHARACTERISTIC KLAF MSNWDK PSPVDKUG /end REF_CHARACTERISTIC
 /begin IN_MEASUREMENT B_dknolu B_ll B_nswo2 B_st B_stend dpsfg_w drl_w frhodk_w fupsrl_w fvisrm_w fwprs_w msdkmx_w msdkugd_w msdk_w msndko_w pspvds_w ps_w pvdkds_w rl_w tnst_w umsrln_w wdkbap_w wdkugd_w /end IN_MEASUREMENT
 /begin OUT_MEASUREMENT B_rlp B_rlpns drlp_w rlp rlp_w /end OUT_MEASUREMENT
 /begin LOC_MEASUREMENT B_ugdsp dpsfgk_w dpspps_w drlfdkrp_w drlmprl_w msndkpk_w psmppvdk_w psmp_w pspmx_w rlpnb_w rlpu_w wdkbapb_w /end LOC_MEASUREMENT
 /begin SUB_FUNCTION /end SUB_FUNCTION
/end FUNCTION
/begin FUNCTION BGRLSOL "Berechnungsgrˆﬂe Sollf¸llung" /begin DEF_CHARACTERISTIC /end DEF_CHARACTERISTIC /begin REF_CHARACTERISTIC /end REF_CHARACTERISTIC /begin IN_MEASUREMENT fho_w rlmdhoms_w rlminhom_w /end IN_MEASUREMENT /begin OUT_MEASUREMENT B_mdmin B_mwfe rlmin_w rlshk rlshk_w rlsolhom_w rlsol_w /end OUT_MEASUREMENT /begin LOC_MEASUREMENT /end LOC_MEASUREMENT /begin SUB_FUNCTION /end SUB_FUNCTION /end FUNCTION
/begin FUNCTION BGTABST "11.50     Berechnete Grˆﬂe Abstellzeit" /begin DEF_CHARACTERISTIC CWBGTABST LNXQTM TNLSGM ZKTABTU /end DEF_CHARACTERISTIC /begin REF_CHARACTERISTIC /end REF_CHARACTERISTIC /begin IN_MEASUREMENT B_nachlstp B_nlwst B_nmin B_pwf B_stend tmotab tmst tumg /end IN_MEASUREMENT
 /begin OUT_MEASUREMENT bgtabstBits1_50ms bgtabstBits2_50ms bgtabstBits3_1000ms B_abstgp B_abstnlgp B_abstnpl tabsnl0_w tabsnl_w tabstm_w tabst_w tabsuhr_w /end OUT_MEASUREMENT
 /begin LOC_MEASUREMENT B_abstmnpl B_abstnlg0 B_abstuhrg B_pltab B_tabuhrof B_uhrnpl xqtm_w /end LOC_MEASUREMENT
 /begin SUB_FUNCTION /end SUB_FUNCTION
/end FUNCTION
/begin FUNCTION BGTEV "Berechnungsgrˆﬂe Massenstrom TEV"
 /begin DEF_CHARACTERISTIC FLTEFUEL FUMRMV FUMSTEK KAFLTESG KFAFTE KLAFTE KMLTESG MSNTATE MSNTEVO /end DEF_CHARACTERISTIC
 /begin REF_CHARACTERISTIC FKLAFUGD WDKMSN /end REF_CHARACTERISTIC
 /begin IN_MEASUREMENT B_dteaa fho_w fklaf_w frhodk_w ftvdk mssgin_w nmot ps_w pu_w tans tateist_w wdkba /end IN_MEASUREMENT
 /begin OUT_MEASUREMENT ftho_w msntevo_w mste mstedte mstedte_w msteo_w mste_w vregdia_w /end OUT_MEASUREMENT
 /begin LOC_MEASUREMENT faftekf fafte_w mleitmx_w mleit_w msnsgin_w msntetev_w mstetev_w pspute_w qltefil wdkbate wdkbav /end LOC_MEASUREMENT
 /begin SUB_FUNCTION /end SUB_FUNCTION
/end FUNCTION
/begin FUNCTION BGTMPK "F¸llungserfassung Berechnung Temperaturkompensation"
 /begin DEF_CHARACTERISTIC CWTEMPK DEVTMAGR EVTMODO FAKTABGM FDVANS FWFTBRTA FWLKFTBR KFDFBTMN KFDFBTMP KFWTBR TMOTWRM ZBRT ZDBTMN ZDBTMP ZTDAGR ZTMMBR /end DEF_CHARACTERISTIC
 /begin REF_CHARACTERISTIC /end REF_CHARACTERISTIC
 /begin IN_MEASUREMENT nmot nmot_w pbrint_w ps ps_w rl tabgm_w tans tmot /end IN_MEASUREMENT
 /begin OUT_MEASUREMENT evtmod ftbr ftbr_w ftsr ftu ftvdk tsr_w /end OUT_MEASUREMENT
 /begin LOC_MEASUREMENT dtbrt_w ftw tabgsant_w tbrraum_w tempin tfrgsant_w tmischbr_w tmotdif tmotfil /end LOC_MEASUREMENT
 /begin SUB_FUNCTION /end SUB_FUNCTION
/end FUNCTION
/begin FUNCTION BGTOL "Berechnete Grˆﬂe (Motor-)÷ltemperatur" /begin DEF_CHARACTERISTIC CWKONGTO DTATMSTOL DTMABSTOL DTMTOLOFF TABSTOLTM ZKTPTOLTM /end DEF_CHARACTERISTIC /begin REF_CHARACTERISTIC /end REF_CHARACTERISTIC /begin IN_MEASUREMENT B_st B_tolcb tabst_w tans tmot tmotab tmst tolc /end IN_MEASUREMENT /begin OUT_MEASUREMENT BGTOLausbits1 B_etoel toelk_w toltm /end OUT_MEASUREMENT /begin LOC_MEASUREMENT /end LOC_MEASUREMENT /begin SUB_FUNCTION /end SUB_FUNCTION /end FUNCTION
/begin FUNCTION BGTUMG "6.30      Berechnete Grˆﬂe Umgebungstemperatur"
 /begin DEF_CHARACTERISTIC DTMTATUM IMTUMTA KLDTUMTA NTUMTA TABMNTUM TMMXTUM TUMTAI TVTUMTA VTUMTA /end DEF_CHARACTERISTIC
 /begin REF_CHARACTERISTIC /end REF_CHARACTERISTIC
 /begin IN_MEASUREMENT B_abstgp B_nmot B_pwf B_stend B_tmsrt imlatm_w nmot tabst_w tans tmot tmst vfzg /end IN_MEASUREMENT
 /begin OUT_MEASUREMENT bgtumgAusBits B_tumkst B_tumnpl tum tumg tumgk_w /end OUT_MEASUREMENT
 /begin LOC_MEASUREMENT tumtmp /end LOC_MEASUREMENT
 /begin SUB_FUNCTION /end SUB_FUNCTION
/end FUNCTION
/begin FUNCTION BGVFGR "Berechnete Geschwindigkeit f¸r Fahrgeschwindigkeitsregler" /begin DEF_CHARACTERISTIC FKV1FVMX ZFMVRV /end DEF_CHARACTERISTIC /begin REF_CHARACTERISTIC /end REF_CHARACTERISTIC /begin IN_MEASUREMENT bfzgldsc_w B_asc1cok B_evfzgv1 vfzgv1_w vfzg_w /end IN_MEASUREMENT /begin OUT_MEASUREMENT bfzglfgr B_fgrabz vfgrrf_w vfgr_w vfzgk_w /end OUT_MEASUREMENT /begin LOC_MEASUREMENT vfzgv1f_w /end LOC_MEASUREMENT /begin SUB_FUNCTION /end SUB_FUNCTION /end FUNCTION
/begin FUNCTION BGVSEKP "Berechnete Grˆﬂe Kraftstoff-Sollvolumenstrom f¸r bedarfsgesteuerte EKP" /begin DEF_CHARACTERISTIC FMLZKRST KFSTTANKR VSEKPMXN VSSSPE VSSSPTAIRL /end DEF_CHARACTERISTIC /begin REF_CHARACTERISTIC /end REF_CHARACTERISTIC /begin IN_MEASUREMENT B_ekp B_ins2cok fsttankl ml_w nmot rk2_w rk_w rlp_w tfst /end IN_MEASUREMENT /begin OUT_MEASUREMENT lambrinv vssekp vssgkrst vsskrst vsskrstl1 vssssp vssvlmx /end OUT_MEASUREMENT /begin LOC_MEASUREMENT B_fstpl fsttankrf /end LOC_MEASUREMENT /begin SUB_FUNCTION /end SUB_FUNCTION /end FUNCTION
/begin FUNCTION BGWDKHF "Berechnung Winkel Drosselklappe aus Signal d. Hauptf¸llungssensors" /begin DEF_CHARACTERISTIC /end DEF_CHARACTERISTIC /begin REF_CHARACTERISTIC MSLG WDKMSN /end REF_CHARACTERISTIC
 /begin IN_MEASUREMENT B_dssakt fklaf_w fpvdkds_w ftvdk msdkds_w mshfm_w wdks_w wdkugd_w /end IN_MEASUREMENT
 /begin OUT_MEASUREMENT B_wdkhfu wdkhf_w /end OUT_MEASUREMENT
 /begin LOC_MEASUREMENT msnhf_w wdkhfu_w /end LOC_MEASUREMENT
 /begin SUB_FUNCTION /end SUB_FUNCTION
/end FUNCTION
/begin FUNCTION BGWDKM "Berechnung Dk-Winkel Modell" /begin DEF_CHARACTERISTIC ZWDKM1 ZWDKM2 /end DEF_CHARACTERISTIC /begin REF_CHARACTERISTIC /end REF_CHARACTERISTIC /begin IN_MEASUREMENT wdksp_w /end IN_MEASUREMENT /begin OUT_MEASUREMENT wdkbap_w /end OUT_MEASUREMENT /begin LOC_MEASUREMENT /end LOC_MEASUREMENT /begin SUB_FUNCTION /end SUB_FUNCTION /end FUNCTION
/begin FUNCTION BGWNE "Berechnete Basis-Grˆﬂen f¸r Winkel- und Drehzahlerfassung" /begin DEF_CHARACTERISTIC /end DEF_CHARACTERISTIC /begin REF_CHARACTERISTIC NMIN TPREL /end REF_CHARACTERISTIC
 /begin IN_MEASUREMENT B_bm B_stprel B_tprel B_zprel sync_level tseg_l zzkwas_w zzvirt zzyl /end IN_MEASUREMENT
 /begin OUT_MEASUREMENT B_nmin B_nmot B_startini nmn10msctr synstate synstate_o zylvirt /end OUT_MEASUREMENT
 /begin LOC_MEASUREMENT /end LOC_MEASUREMENT
 /begin SUB_FUNCTION /end SUB_FUNCTION
/end FUNCTION
/begin FUNCTION BGWNWVFA "Istwerterfassung Nockenwellenposition Auslaﬂnockenwelle(n)" /begin DEF_CHARACTERISTIC CWBGWNWVFA KLFKVNWANM /end DEF_CHARACTERISTIC /begin REF_CHARACTERISTIC SNM06NWUW /end REF_CHARACTERISTIC /begin IN_MEASUREMENT esst_snm06nwuw nmot_w tnwia2_l tnwia_l wnwa2_w wnwa_w /end IN_MEASUREMENT
 /begin OUT_MEASUREMENT dtnwia2_l dtnwia_l fkvnwa_w vnwa2_w vnwa_w wnwvfa2_w wnwvfa_w /end OUT_MEASUREMENT
 /begin LOC_MEASUREMENT dtsynwa2_l dtsynwa_l tsynwa_l /end LOC_MEASUREMENT
 /begin SUB_FUNCTION /end SUB_FUNCTION
/end FUNCTION
/begin FUNCTION BGWNWVFE "Istwerterfassung Nockenwellenposition Einlaﬂnockenwelle(n)" /begin DEF_CHARACTERISTIC CWBGWNWVFE KLFKVNWENM /end DEF_CHARACTERISTIC /begin REF_CHARACTERISTIC SNM06NWUW /end REF_CHARACTERISTIC /begin IN_MEASUREMENT esst_snm06nwuw nmot_w tnwie2_l tnwie_l wnwe2_w wnwe_w /end IN_MEASUREMENT
 /begin OUT_MEASUREMENT dtnwie2_l dtnwie_l fkvnwe_w vnwe2_w vnwe_w wnwvfe2_w wnwvfe_w /end OUT_MEASUREMENT
 /begin LOC_MEASUREMENT dtsynwe2_l dtsynwe_l tsynwe_l /end LOC_MEASUREMENT
 /begin SUB_FUNCTION /end SUB_FUNCTION
/end FUNCTION
/begin FUNCTION BGWPR "Berechnete Grˆﬂe Pr‰diktionswinkel" /begin DEF_CHARACTERISTIC CWBGWPR DRLDYNU DRLMIN DTEPRU DWPR DWPRNSP WPRMX /end DEF_CHARACTERISTIC /begin REF_CHARACTERISTIC /end REF_CHARACTERISTIC
 /begin IN_MEASUREMENT B_rlp B_rlpns drl_w grundwert nmot_w rlp_w rl_w te_w tvu_w wea wee wessbm /end IN_MEASUREMENT
 /begin OUT_MEASUREMENT B_nsp B_tired fwprs_w /end OUT_MEASUREMENT
 /begin LOC_MEASUREMENT vwkw wpr wprnsp /end LOC_MEASUREMENT
 /begin SUB_FUNCTION /end SUB_FUNCTION
/end FUNCTION
/begin FUNCTION BKL15RESET "" /begin DEF_CHARACTERISTIC /end DEF_CHARACTERISTIC /begin REF_CHARACTERISTIC /end REF_CHARACTERISTIC /begin IN_MEASUREMENT S_kl15 /end IN_MEASUREMENT /begin OUT_MEASUREMENT /end OUT_MEASUREMENT /begin LOC_MEASUREMENT /end LOC_MEASUREMENT /begin SUB_FUNCTION /end SUB_FUNCTION /end FUNCTION
/begin FUNCTION CANREC "CANMX: RECEIVE, Signalempfang" /begin DEF_CHARACTERISTIC /end DEF_CHARACTERISTIC /begin REF_CHARACTERISTIC /end REF_CHARACTERISTIC /begin IN_MEASUREMENT /end IN_MEASUREMENT /begin OUT_MEASUREMENT ZUL_CanTimeoutFlag ZUL_can_buffer /end OUT_MEASUREMENT /begin LOC_MEASUREMENT /end LOC_MEASUREMENT /begin SUB_FUNCTION /end SUB_FUNCTION /end FUNCTION
/begin FUNCTION CANSEND "CANMX: Signalausgabe auf den CAN-Bus" /begin DEF_CHARACTERISTIC /end DEF_CHARACTERISTIC /begin REF_CHARACTERISTIC /end REF_CHARACTERISTIC /begin IN_MEASUREMENT ZUL_can_buffer /end IN_MEASUREMENT /begin OUT_MEASUREMENT /end OUT_MEASUREMENT /begin LOC_MEASUREMENT /end LOC_MEASUREMENT /begin SUB_FUNCTION /end SUB_FUNCTION /end FUNCTION
/begin FUNCTION CAN_CONF "" /begin DEF_CHARACTERISTIC /end DEF_CHARACTERISTIC /begin REF_CHARACTERISTIC /end REF_CHARACTERISTIC /begin IN_MEASUREMENT /end IN_MEASUREMENT /begin OUT_MEASUREMENT /end OUT_MEASUREMENT /begin LOC_MEASUREMENT /end LOC_MEASUREMENT /begin SUB_FUNCTION /end SUB_FUNCTION /end FUNCTION
/begin FUNCTION CAN_MTRX "20.11" /begin DEF_CHARACTERISTIC /end DEF_CHARACTERISTIC /begin REF_CHARACTERISTIC /end REF_CHARACTERISTIC
 /begin IN_MEASUREMENT ACComprDsabl_ECU_Req ACComprDsabl_Req ACComprOff_FanMalf ACComprSo_Req ACCompr_MaxTrq_Req AdapCrsCtrl_Enabl ADD_CDS_Req AirFilterFouledWal APEmerg_Mode CAN_AdapAltitude_Coef CAN_ADD_APPGrdt_Thres CAN_ADD_CDS_CAN CAN_ADD_Nerv_Detct CAN_APP_ADD_Out_ub CAN_APP_Out_ub CAN_Cod_Body CAN_Cod_ModelRange CAN_CrsCtrl_Coor_Trq CAN_DrvrInput_Trq_Req CAN_Dspl_VS CAN_ECTIn CAN_Eng_Spd CAN_Eng_Trq CAN_Eng_TrqMaxKC CAN_Eng_TrqMin CAN_Fuel_Cons CAN_GearRatio_HighLim_Req CAN_GearRatio_LowLim_Req CAN_Gen_Utz CAN_IdleSpd_Req CAN_IntkAir_Temp CAN_Sen_Oil_Lvl CAN_Sen_Oil_Qual CAN_Sen_Oil_Temp CAN_Strt_Mode CAN_TrqCoor_ESPOrMSL_Req CAN_Veh_MaxSpd CatHead_Mode Clutch_Mode Cod_Drvabl_CrsCtrl_Mode Cod_Eng Crash_Mode CreepingDsabl_Mode CrsCtrlDspl_Mode_Req CrsCtrlFlt_Mode CrsCtrl_Engaged CrsCtrl_Gear_LowLim_Req CrsCtrl_Mode CylCutoffEnabl DFSO_Mode DP_Decel DP_LongDyn DP_TrvrDyn DsplBlink_Mode DsplRefr_Mode ECU_TCC_Slip_Mode_Req Eng_StrtStopEnabl Eng_StrtStopFlt Eng_StrtStop_IL ESP_Enabl Ethnl_Mode FTBU_Mode FuelFilter_IL_Mode Gear_HighLim_Req Gear_LowLim_Req Gen_Pin61_Mode GlowPlugIndicEnabl GlowPlugIndicState HtrPmp_Flow_Req HtrVlv1_Pos_Req Idle_Mode_Req LH_Mode MIL MTX_Mode OilTemp_Mode Oil_WAL OSC_IL_defect OSC_IL_Enabl OvrSpdIndic_Mode OvrSpd_Mode PartFFR_Mode PVSLDspl_Mode ShiftPoint_Disp_Req Strtr_Mode SW_KD_Mode Tank_Cap_Wal TCCOpen_Req TCM_Enabl TempCoolingWaterOverLim_Mode TrqReqConfirm_TCM_Mode VISActv VSLDspl_Mode VSL_Ctrl_Mode VSL_Run_Mode VSL_WarnBuz_Mode WaterFuel_IL_Mode /end IN_MEASUREMENT
 /begin OUT_MEASUREMENT ACCompr_Existing_Mode ACCompr_Run_Mode ACC_ISRD_Mode ACS_410h_MsgLost_State_Mode AdapCrsCtrl_Dyn0_Mode_Req AdapCrsCtrl_Parity AdapCrsCtrl_Tgl AdapCrsCtrl_TrqMax_Mode_Req AdapCrsCtrl_TrqMin_Mode_Req AMT_EmergShutOff AMT_EmergShutOff_Cnf AMT_Man_Mode AuxiliaryHeaterEnabl_Mode AuxiliaryHeaterSwOnEnabl_Mode BrkLight_MsgCntr BrkLight_Parity BrkParity_Mode CalibOdo_Mode CAN_ABC_Trq_Loss CAN_ACCompr2_Run_Mode CAN_ACCompr2_Trq CAN_ACCompr_RefriPress CAN_ACCompr_Trq CAN_ACS_CrashConfirmBit_Mode CAN_ACS_Crash_Mode CAN_AdapCrsCtrl_Trq_Req CAN_AMT_Creep_Trq_Req CAN_Brk CAN_BrkLight CAN_Dspl_EngShutOff_Time CAN_Dspl_WinterTire_SpdMax CAN_Dspl_WinterTire_SpdMax_Mode CAN_ECF_Pwr_Req CAN_ESP_Info CAN_ESP_Trq_Req CAN_ExtAir_Temp CAN_IgnSwStrtCAN_Mode CAN_KeylessGo_Enabl_Mode CAN_KeylessGo_StrtEnabl_Mode CAN_Odo_Abs CAN_SteeringAngle CAN_Tank_Lvl CAN_TCM_Actl_Ratio CAN_TCM_Diag_Cod CAN_TCM_Diag_Failure CAN_TCM_Trq_Req CAN_Trans_Gear_Actl CAN_Trans_Gear_Tgt CAN_Trans_SelectorPosn CAN_TrvrAccel CAN_Veh_Spd_Raw CAN_VES_Info CAN_WhlSpdFrontLeft CAN_WhlSpdFrontRight CAN_WhlSpdRearLeft CAN_WhlSpdRearRight CCM_340h_MsgLost_State_Mode CGW_248h_MsgLost_State_Mode CGW_6FFh_MsgLost_State_Mode CrsCtrlDsplDsable_Mode CrsCtrlDspl_Mode CSTCM_428h_MsgLost_State_Mode DrProgram Dspl_408h_MsgLost_State_Mode Dspl_State2 EIL_240h_MsgLost_State_Mode EIL_State1 EIL_State2 EIL_State3 ESM_230h_MsgLost_State_Mode ESP_200h_MsgLost_State_Mode ESP_208h_MsgLost_State_Mode ESP_300h_MsgLost_State_Mode ESP_328h_MsgLost_State_Mode ESP_CrsCtrlDsable_Mode_Req ESP_Dyn0_Mode ESP_Dyn_Mode_Req ESP_IndicLight_Mode ESP_Parity_Mode ESP_Tgl ESP_TrqMax_Mode_Req ESP_TrqMin_Mode_Req ESP_Wheel_FrontLeft_Cntr ESP_Wheel_FrontRight_Cntr FuelTankMinLvl_Mode GlowPlugIndicDsable_Mode JumpStrt_Mode KD_Mode MTX_CAN_Mode RoadResistanceHigh_Mode SBC_ISRD_Actvt SBC_ISRD_Parity SBC_ISRD_Tgl SBC_WireTestEnabl SCT_238h_MsgLost_State_Mode SegmentDisplay_Mode SteeringAngleDir SteeringAngle_CodErr SteeringAngle_NotInit SteeringAngle_Overflow SteeringAngle_Parity StrtEnabl_Mode TCCClose_Mode TCCNoLoad_Mode TCCOpen_Mode TCCSlip_Mode TCM_218h_MsgLost_State_Mode TCM_418h_MsgLost_State_Mode TCM_BasicShiftPrg_Mode TCM_Dyn0_Mode TCM_Dyn1_Mode_Req TCM_Parity TCM_Tgl TCM_TrqMax_Mode_Req TCM_TrqMin_Mode_Req Trans_Emerg_Mode Trans_OffRoad_Mode Trans_OilTempHigh_Mode Trans_RvrsGear_CAN_Mode VES_Emerg_Mode VSL_IndicMph_Mode /end OUT_MEASUREMENT
 /begin LOC_MEASUREMENT /end LOC_MEASUREMENT
 /begin SUB_FUNCTION /end SUB_FUNCTION
/end FUNCTION
/begin FUNCTION CAN_PRCG "20.11"
 /begin DEF_CHARACTERISTIC AV_ACS_410h_MsgLost_DeBnc_Lim AV_AMT_Creep_Trq_Max_Req AV_CAN_MsgLost_ChkStrtTime AV_CCM_340h_MsgLost_DeBnc_Lim AV_CGW_248h_MsgLost_DeBnc_Lim AV_CGW_6FFh_MsgLost_DeBnc_Lim AV_CSTCM_428h_MsgLost_DeBnc_Lim AV_Dspl_408h_MsgLost_DeBnc_Lim AV_EIL_240h_MsgLost_DeBnc_Lim AV_Eng_Spd_Lim_Req AV_ESM_230h_MsgLost_DeBnc_Lim AV_ESP_200h_MsgLost_DeBnc_Lim AV_ESP_208h_MsgLost_DeBnc_Lim AV_ESP_300h_MsgLost_DeBnc_Lim AV_ESP_328h_MsgLost_DeBnc_Lim AV_SCT_238h_MsgLost_DeBnc_Lim AV_TCM_218h_MsgLost_DeBnc_Lim AV_TCM_418h_MsgLost_DeBnc_Lim AV_TempCoolingWater_HighLim AV_TempCoolingWater_LowLim /end DEF_CHARACTERISTIC
 /begin REF_CHARACTERISTIC /end REF_CHARACTERISTIC
 /begin IN_MEASUREMENT ACS_410h_MsgLost_State_Mode AdapAltitude_Coef ADD_APPGrdt_Thres ADD_CDS_CAN ADD_Nerv_Detct AGKInit_Mode AMTCrwlRepDsabl_Mode AMT_Mode APP_ADD_Out_ub APP_Out_ub CAN_ABC_Trq_Loss CAN_ACCompr2_Run_Mode CAN_ACCompr2_Trq CAN_ACCompr_RefriPress CAN_ACCompr_Trq CAN_ACS_CrashConfirmBit_Mode CAN_ACS_Crash_Mode CAN_AdapCrsCtrl_Trq_Req CAN_AMT_Creep_Trq_Req CAN_Brk CAN_BrkLight CAN_Dspl_EngShutOff_Time CAN_Dspl_WinterTire_SpdMax CAN_Dspl_WinterTire_SpdMax_Mode CAN_ECF_Pwr_Req CAN_ESP_Info CAN_ESP_Trq_Req CAN_ExtAir_Temp CAN_IgnSwStrtCAN_Mode CAN_KeylessGo_Enabl_Mode CAN_KeylessGo_StrtEnabl_Mode CAN_Odo_Abs CAN_SteeringAngle CAN_Tank_Lvl CAN_TCM_Actl_Ratio CAN_TCM_Diag_Cod CAN_TCM_Diag_Failure CAN_TCM_Trq_Req CAN_Trans_Gear_Actl CAN_Trans_Gear_Tgt CAN_Trans_SelectorPosn CAN_TrvrAccel CAN_Veh_Spd_Raw CAN_VES_Info CAN_WhlSpdFrontLeft CAN_WhlSpdFrontRight CAN_WhlSpdRearLeft CAN_WhlSpdRearRight CCM_340h_MsgLost_State_Mode CGW_248h_MsgLost_State_Mode CGW_6FFh_MsgLost_State_Mode Cod_CANMembr_ABC Cod_CANMembr_ESL Cod_Model Cod_ModelRange CrsCtrl_Coor_Trq CrsCtrl_GearRatio_HighLim_Req CrsCtrl_GearRatio_LowLim_Req CrsCtrl_Gear_HighLim_Req CrsCtrl_Gear_LowLim_Req CSTCM_428h_MsgLost_State_Mode DrvrInput_Trq_Req Dspl_408h_MsgLost_State_Mode Dspl_VS ECTIn ECU_GearRatio_HighLim_Req ECU_GearRatio_LowLim_Req ECU_TCMPlausErr EIL_240h_MsgLost_State_Mode EmergAirOp_Mode_Req Eng_MinTrqCmb_Req Eng_Run_Mode Eng_Spd Eng_Trq Eng_TrqMaxKC ErrHFM_Mode ESM_230h_MsgLost_State_Mode ESP_200h_MsgLost_State_Mode ESP_208h_MsgLost_State_Mode ESP_300h_MsgLost_State_Mode ESP_328h_MsgLost_State_Mode Fuel_Cons Gear_LowLim_ReqDrvrInput Gear_LowLim_ReqDrvrInput_Mode Gen_Utz IdleSpd_Req Idle_Mode_Req IgnSwRun_Mode IgnSwStrtrHW_Mode IntkAir_Temp LH_GearLowLim_Req LH_Gear_LowLim_Req MfDiagDsabl_Mode Mon_SFSO_Mode MTXSports_Mode MTX_Mode RvrsGearHw SCT_238h_MsgLost_State_Mode Sen_Oil_Lvl Sen_Oil_Qual Sen_Oil_Temp SFSO_Mode Strt_Mode TCCSlip_Mode TCM_218h_MsgLost_State_Mode TCM_418h_MsgLost_State_Mode TCM_TrqMax_Mode_Req TCM_TrqMin_Mode_Req ThrCurrless_Mode Trans_Man_Cnfg Trans_RvrsGear_CAN_Mode TrqCoor_ESPOrMSL_Req Veh_MaxSpd VSL_Gear_HighLim_Req VSL_Gear_LowLim_Req /end IN_MEASUREMENT
 /begin OUT_MEASUREMENT ABC_Trq_Loss ACCompr2_Run_Mode ACCompr2_Trq ACCompr_RefriPress ACCompr_Trq ACS_410h_MsgLost_Cntr ACS_410h_MsgLost_DeBnc_Mode ACS_CrashConfirmBit_Mode ACS_Crash_Mode AdapCrsCtrl_Trq_Req AMT_Creep_Trq_Req BrkBit0 BrkBit1 BrkLight0_Mode BrkLight1_Mode CAN_AdapAltitude_Coef CAN_ADD_APPGrdt_Thres CAN_ADD_CDS_CAN CAN_ADD_Nerv_Detct CAN_APP_ADD_Out_ub CAN_APP_Out_ub CAN_Cod_Body CAN_Cod_ModelRange CAN_CrsCtrl_Coor_Trq CAN_DrvrInput_Trq_Req CAN_Dspl_VS CAN_ECTIn CAN_Ena_CCM_Mode CAN_Ena_CSTCM_Mode CAN_Ena_Default_Mode CAN_Ena_ESM_Mode CAN_Ena_Trans_Mode CAN_Eng_Spd CAN_Eng_Trq CAN_Eng_TrqMaxKC CAN_Eng_TrqMin CAN_Fuel_Cons CAN_GearRatio_HighLim_Req CAN_GearRatio_LowLim_Req CAN_Gen_Utz CAN_IdleSpd_Req CAN_IntkAir_Temp CAN_Sen_Oil_Lvl CAN_Sen_Oil_Qual CAN_Sen_Oil_Temp CAN_Strt_Mode CAN_TrqCoor_ESPOrMSL_Req CAN_Veh_MaxSpd CCM_340h_MsgLost_Cntr CCM_340h_MsgLost_DeBnc_Mode CGW_248h_MsgLost_Cntr CGW_248h_MsgLost_DeBnc_Mode CGW_6FFh_MsgLost_Cntr CGW_6FFh_MsgLost_DeBnc_Mode CreepingDetct_Mode CreepingDsabl_Mode CSTCM_428h_MsgLost_Cntr CSTCM_428h_MsgLost_DeBnc_Mode Dspl_408h_MsgLost_Cntr Dspl_408h_MsgLost_DeBnc_Mode Dspl_EngShutOff_Time Dspl_WinterTire_SpdMax ECF_Pwr_Req EIL_240h_MsgLost_Cntr EIL_240h_MsgLost_DeBnc_Mode EIL_SCT_MsgLost_DeBnc_Mode ESM_230h_MsgLost_Cntr ESM_230h_MsgLost_DeBnc_Mode ESP_200h_MsgLost_Cntr ESP_200h_MsgLost_DeBnc_Mode ESP_208h_MsgLost_Cntr ESP_208h_MsgLost_DeBnc_Mode ESP_300h_MsgLost_Cntr ESP_300h_MsgLost_DeBnc_Mode ESP_328h_MsgLost_Cntr ESP_328h_MsgLost_DeBnc_Mode ESP_InfoBit0 ESP_InfoBit1 ESP_Trq_Req ExtAir_Temp Gear_HighLim_Req Gear_LowLim_Req IgnSwStrtCAN_Mode IgnSwStrtr_Mode KeylessGo_Enabl_Mode KeylessGo_StrtEnabl_Mode LH_Mode Odo_Abs OvrSpdIndic_Mode SCT_238h_MsgLost_Cntr SCT_238h_MsgLost_DeBnc_Mode SteeringAngle Tank_Lvl TCM_218h_MsgLost_Cntr TCM_218h_MsgLost_DeBnc_Mode TCM_418h_MsgLost_Cntr TCM_418h_MsgLost_DeBnc_Mode TCM_Actl_Ratio TCM_Diag_State1 TCM_Trq_Req TempCoolingWaterOverLim_Mode Trans_Gear_ActlTgt Trans_RvrsGearMTX_Mode Trans_SelectorPosn TrvrAccel Veh_Spd_Raw VES_InfoBit0 VES_InfoBit1 WhlSpdFrontLeft WhlSpdFrontRight WhlSpdRearLeft WhlSpdRearRight /end OUT_MEASUREMENT
 /begin LOC_MEASUREMENT /end LOC_MEASUREMENT
 /begin SUB_FUNCTION /end SUB_FUNCTION
/end FUNCTION
/begin FUNCTION CCP_CLEARMEMORY "" /begin DEF_CHARACTERISTIC /end DEF_CHARACTERISTIC /begin REF_CHARACTERISTIC /end REF_CHARACTERISTIC /begin IN_MEASUREMENT nmot vfzg /end IN_MEASUREMENT /begin OUT_MEASUREMENT /end OUT_MEASUREMENT /begin LOC_MEASUREMENT /end LOC_MEASUREMENT /begin SUB_FUNCTION /end SUB_FUNCTION /end FUNCTION
/begin FUNCTION CCP_CONF "" /begin DEF_CHARACTERISTIC /end DEF_CHARACTERISTIC /begin REF_CHARACTERISTIC /end REF_CHARACTERISTIC /begin IN_MEASUREMENT /end IN_MEASUREMENT /begin OUT_MEASUREMENT /end OUT_MEASUREMENT /begin LOC_MEASUREMENT /end LOC_MEASUREMENT /begin SUB_FUNCTION /end SUB_FUNCTION /end FUNCTION
/begin FUNCTION COSA "Software-Abgleich" /begin DEF_CHARACTERISTIC RKACOMN RKACOMX TLLCO TVCO /end DEF_CHARACTERISTIC /begin REF_CHARACTERISTIC N0 NRKAB /end REF_CHARACTERISTIC /begin IN_MEASUREMENT B_eepdif B_ll B_ndsav B_nokatfz nmot tmot /end IN_MEASUREMENT /begin OUT_MEASUREMENT B_cotrim co_pot rkaco_w /end OUT_MEASUREMENT /begin LOC_MEASUREMENT co_pot_w /end LOC_MEASUREMENT /begin SUB_FUNCTION /end SUB_FUNCTION /end FUNCTION
/begin FUNCTION DCDACC "Diagnose; Zugriff auf Testerdaten" /begin DEF_CHARACTERISTIC /end DEF_CHARACTERISTIC /begin REF_CHARACTERISTIC /end REF_CHARACTERISTIC /begin IN_MEASUREMENT /end IN_MEASUREMENT /begin OUT_MEASUREMENT /end OUT_MEASUREMENT /begin LOC_MEASUREMENT /end LOC_MEASUREMENT /begin SUB_FUNCTION /end SUB_FUNCTION /end FUNCTION
/begin FUNCTION DCLA "OBDII; Klassentabelle"
 /begin DEF_CHARACTERISTIC CL30LINE CL31LINE CL32LINE CL33LINE CL34LINE CL35LINE CL36LINE CL37LINE CL38LINE CL39LINE /end DEF_CHARACTERISTIC
 /begin REF_CHARACTERISTIC /end REF_CHARACTERISTIC
 /begin IN_MEASUREMENT /end IN_MEASUREMENT
 /begin OUT_MEASUREMENT /end OUT_MEASUREMENT
 /begin LOC_MEASUREMENT /end LOC_MEASUREMENT
 /begin SUB_FUNCTION /end SUB_FUNCTION
/end FUNCTION
/begin FUNCTION DC_COD "20.11" /begin DEF_CHARACTERISTIC Whl_Circumfer_Off /end DEF_CHARACTERISTIC /begin REF_CHARACTERISTIC /end REF_CHARACTERISTIC
 /begin IN_MEASUREMENT Cod_Aggr Cod_CANMembr Cod_Diff_Ratio Cod_Drvabl Cod_Eng Cod_EOL Cod_Exh Cod_Func Cod_ModelRange Cod_TM Cod_Trans1 Cod_Trans2 Cod_WhlFront_Circumfer_Fctr Cod_WhlRear_Circumfer_Fctr /end IN_MEASUREMENT
 /begin OUT_MEASUREMENT AMT_Mode AT2_Mode Cod_Aggr_Gen Cod_Aggr_Gen_1 Cod_Aggr_Gen_2 Cod_Aggr_LHD Cod_Aggr_TSC Cod_Aggr_TVDiag Cod_Aggr_VCV Cod_CANMembr_ABC Cod_CANMembr_ACCompr Cod_CANMembr_ACCompr2 Cod_CANMembr_CTM Cod_CANMembr_EIL Cod_CANMembr_ESL Cod_CANMembr_MSW Cod_CANMembr_SBC Cod_Drvabl_AdapCrsCtrl Cod_Drvabl_ADD Cod_Drvabl_AP Cod_Drvabl_CrsCtrl Cod_Drvabl_CrsCtrl_Mode Cod_Drvabl_CrsCtrl_VSL Cod_Drvabl_Dashp Cod_Drvabl_EmergOp Cod_Drvabl_LTC Cod_Func_ACComprAltitude_Mode Cod_Func_BoilProt Cod_Func_IdleSpdSw Cod_Func_SGStrat Cod_Func_SLP Cod_Model Cod_Model_Cntr Cod_TM_FC Cod_TM_FCRunOn Cod_TM_Rslt Cod_Trans2_FWD Cod_Trans_AWD Cod_Trans_SpdLim Cod_Trans_Type Cod_WhlFront_Circumfer Cod_WhlRear_Circumfer CVT_Mode MTXSports_Mode MTX_Mode Trans_Man_Cnfg WhlFront_Circumfer WhlRear_Circumfer /end OUT_MEASUREMENT
 /begin LOC_MEASUREMENT /end LOC_MEASUREMENT
 /begin SUB_FUNCTION /end SUB_FUNCTION
/end FUNCTION
/begin FUNCTION DC_MDMAX "20.11" /begin DEF_CHARACTERISTIC FWGDMBR KLGDMB KLMNFDMB /end DEF_CHARACTERISTIC /begin REF_CHARACTERISTIC NISTV08 /end REF_CHARACTERISTIC
 /begin IN_MEASUREMENT ECU_TCMPlausErr Eng_Spd Gear_State MTX_Mode nst08 Trans_Rvrs_Mode /end IN_MEASUREMENT
 /begin OUT_MEASUREMENT TransTrqLim_Mode_Req TransTrqLim_Req /end OUT_MEASUREMENT
 /begin LOC_MEASUREMENT /end LOC_MEASUREMENT
 /begin SUB_FUNCTION /end SUB_FUNCTION
/end FUNCTION
/begin FUNCTION DC_SP "20.11" /begin DEF_CHARACTERISTIC FW_LP_ENG_SPD /end DEF_CHARACTERISTIC /begin REF_CHARACTERISTIC /end REF_CHARACTERISTIC
 /begin IN_MEASUREMENT AdapAltitude_Coef Eng_Spd_Unfiltd Eng_TrqMax Eng_TrqMin Eng_Trq_Loss IntkAir_Temp ISC_TrqI_Req SG_Trq_Loss /end IN_MEASUREMENT
 /begin OUT_MEASUREMENT AdapAltitudeTempCorr_Coef AGKInit_Mode Eng_MinTrqCmb_Req Eng_Spd Eng_TrqMax_Effct Trq_Loss /end OUT_MEASUREMENT
 /begin LOC_MEASUREMENT /end LOC_MEASUREMENT
 /begin SUB_FUNCTION /end SUB_FUNCTION
/end FUNCTION
/begin FUNCTION DDCY "OBDII; Erf¸llung Bedingung 'driving cycle'" /begin DEF_CHARACTERISTIC TWBDCY /end DEF_CHARACTERISTIC /begin REF_CHARACTERISTIC /end REF_CHARACTERISTIC /begin IN_MEASUREMENT B_pwf B_stend /end IN_MEASUREMENT /begin OUT_MEASUREMENT bbdcy B_dcy dcycnt /end OUT_MEASUREMENT /begin LOC_MEASUREMENT /end LOC_MEASUREMENT /begin SUB_FUNCTION /end SUB_FUNCTION /end FUNCTION
/begin FUNCTION DDG "Diagnose Drehzahlgeber" /begin DEF_CHARACTERISTIC LBMINIT LBMMX PGFLNL PGFLWA TMOTNLDG ZIDFBM ZIDNOBM /end DEF_CHARACTERISTIC /begin REF_CHARACTERISTIC /end REF_CHARACTERISTIC
 /begin IN_MEASUREMENT bmlosctr_w B_bm B_fbm B_nmin tmot zrph2_l zrph3_l zrph4_l zrph_l /end IN_MEASUREMENT
 /begin OUT_MEASUREMENT B_nldg /end OUT_MEASUREMENT
 /begin LOC_MEASUREMENT bmloss_w zrph2_save zrph3_save zrph4_save zrph_save /end LOC_MEASUREMENT
 /begin SUB_FUNCTION /end SUB_FUNCTION
/end FUNCTION
/begin COMPU_METHOD acc_ub_b55p55 "" RAT_FUNC "%6.3" "m/(s^2)" COEFFS 0 1 0 0 0 0.217 /end COMPU_METHOD
/begin COMPU_METHOD bfzg_sb_q0p217 "" RAT_FUNC "%6.3" "m/s^2" COEFFS 0 1 0 0 0 0.217 /end COMPU_METHOD
/begin COMPU_METHOD B_TRUE "boolsche Zust‰nde, positive Logik" TAB_VERB "%6.3" "" COMPU_TAB_REF B_TRUE /end COMPU_METHOD
/begin COMPU_VTAB B_TRUE "boolsche Zust‰nde, positive Logik" TAB_VERB 2 0 "----" 1 "TRUE" /end COMPU_VTAB
/begin COMPU_METHOD DC_B_POS "" RAT_FUNC "%6.2" "" COEFFS 0 1 0 0 0 1 /end COMPU_METHOD
/begin COMPU_METHOD DC_CIR_OFFS_U8 "" RAT_FUNC "%8.5" "m" COEFFS 0 100 0 0 0 1 /end COMPU_METHOD
/begin COMPU_METHOD DC_CNTR_U16 "" RAT_FUNC "%6.2" "" COEFFS 0 1 0 0 0 1 /end COMPU_METHOD
/begin COMPU_METHOD DC_CNTR_U32 "" RAT_FUNC "%6.2" "" COEFFS 0 1 0 0 0 1 /end COMPU_METHOD
/begin COMPU_METHOD DC_CNTR_U8 "" RAT_FUNC "%6.2" "" COEFFS 0 1 0 0 0 1 /end COMPU_METHOD
/begin COMPU_METHOD DC_COEL_TMP "" RAT_FUNC "%6.2" "Grad C" COEFFS 0 1 40 0 0 1 /end COMPU_METHOD
/begin COMPU_METHOD DC_DEZ "" RAT_FUNC "%6.2" "" COEFFS 0 1 0 0 0 1 /end COMPU_METHOD
/begin COMPU_METHOD DC_DST_MM_S16 "" RAT_FUNC "%8.4" "mm" COEFFS 0 8 0 0 0 1 /end COMPU_METHOD
/begin COMPU_METHOD DC_FAK2LDB "" RAT_FUNC "%7.3" "" COEFFS 0 1 0 0 0 2 /end COMPU_METHOD
/begin COMPU_METHOD DC_FCTR_128_U8 "" RAT_FUNC "%7.5" "" COEFFS 0 128 0 0 0 1 /end COMPU_METHOD
/begin COMPU_METHOD DC_FCTR_32768_U16 "" RAT_FUNC "%8.7" "" COEFFS 0 32768 0 0 0 1 /end COMPU_METHOD
/begin COMPU_METHOD DC_FCTR_50_U8 "" RAT_FUNC "%8.5" "keine" COEFFS 0 50 0 0 0 1 /end COMPU_METHOD
/begin COMPU_METHOD DC_FLAG_U8 "" RAT_FUNC "%6.2" "" COEFFS 0 1 0 0 0 1 /end COMPU_METHOD
/begin COMPU_METHOD DC_M3NM "" RAT_FUNC "%6.2" "Nm" COEFFS 0 1 0 0 0 3 /end COMPU_METHOD
/begin COMPU_METHOD DC_MMQ075_U8DB "" RAT_FUNC "%4.2" "Nm" COEFFS 0 4 0 0 0 3 /end COMPU_METHOD
/begin COMPU_METHOD DC_MMQ13 "" RAT_FUNC "%7.2" "Nm" COEFFS 0 1 500 0 0 0.25 /end COMPU_METHOD
/begin COMPU_METHOD DC_MMQ16 "" RAT_FUNC "%8.5" "Nm" COEFFS 0 1 0 0 0 0.0625 /end COMPU_METHOD
/begin COMPU_METHOD DC_NQ1_W "" RAT_FUNC "%6.2" "Upm" COEFFS 0 1 0 0 0 1 /end COMPU_METHOD
/begin COMPU_METHOD DC_OEL_QUAL "" RAT_FUNC "%6.3" "" COEFFS 0 50.8 -50.8 0 0 1 /end COMPU_METHOD
/begin COMPU_METHOD DC_OEL_STAND "" RAT_FUNC "%6.3" "mm" COEFFS 0 3.175 0 0 0 1 /end COMPU_METHOD
/begin COMPU_METHOD DC_PCT_2P5_U8 "" RAT_FUNC "%8.4" "%" COEFFS 0 250 0 0 0 100 /end COMPU_METHOD
/begin COMPU_METHOD DC_ROTSPD_S16 "" RAT_FUNC "%7.3" "1/min" COEFFS 0 2 0 0 0 1 /end COMPU_METHOD
/begin COMPU_METHOD DC_TEMP_2_U8 "" RAT_FUNC "%8.3" "Grad	C" COEFFS 0 1 40 0 0 0.5 /end COMPU_METHOD
/begin COMPU_METHOD DC_TEMP_S16 "" RAT_FUNC "%8.4" "Grad C" COEFFS 0 8 0 0 0 1 /end COMPU_METHOD
/begin COMPU_METHOD DC_TIME_10MS_U16 "" RAT_FUNC "%6.4" "s" COEFFS 0 100 0 0 0 1 /end COMPU_METHOD
/begin COMPU_METHOD DC_TIME_1MS_U16 "" RAT_FUNC "%6.5" "s" COEFFS 0 1000 0 0 0 1 /end COMPU_METHOD
/begin COMPU_METHOD DC_TRQ_S16 "" RAT_FUNC "%8.5" "Nm" COEFFS 0 16 0 0 0 1 /end COMPU_METHOD
/begin COMPU_METHOD DC_UAYS_U8DB "" RAT_FUNC "%6.5" "m/(s*s)(m/s*2)" COEFFS 0 25 256 0 0 2 /end COMPU_METHOD
/begin COMPU_METHOD DC_UDFCPARL "" RAT_FUNC "%7.6" "m" COEFFS 0 15728.6 0 0 0 1 /end COMPU_METHOD
/begin COMPU_METHOD DC_UPAC "" RAT_FUNC "%6.3" "bar" COEFFS 0 1 0 0 0 0.5 /end COMPU_METHOD
/begin COMPU_METHOD DC_URD_05 "" RAT_FUNC "%8.4" "1/min" COEFFS 0 1 0 0 0 0.5 /end COMPU_METHOD
/begin COMPU_METHOD DC_UTMP_40 "" RAT_FUNC "%6.2" "grd C" COEFFS 0 1 40 0 0 1 /end COMPU_METHOD
/begin COMPU_METHOD DC_VQ1LT_U8 "" RAT_FUNC "%9.4" "Liter" COEFFS 0 1 0 0 0 1 /end COMPU_METHOD
/begin COMPU_METHOD DC_VQV1 "" RAT_FUNC "%6.2" "km/h" COEFFS 0 1 0 0 0 1 /end COMPU_METHOD
/begin COMPU_METHOD DC_WL05_U16DB "" RAT_FUNC "%5.2" "GRAD" COEFFS 0 2 0 0 0 1 /end COMPU_METHOD
/begin COMPU_METHOD DEZ "1 : 1 Umrechnug (dez/hex)" RAT_FUNC "%6.2" "" COEFFS 0 1 0 0 0 1 /end COMPU_METHOD
/begin COMPU_METHOD dez "1 : 1 Umrechnug (dez/hex)" RAT_FUNC "%6.2" "" COEFFS 0 1 0 0 0 1 /end COMPU_METHOD
/begin COMPU_METHOD dichte_ub_b2 "" RAT_FUNC "%6.4" "kg/m^3" COEFFS 0 256 0 0 0 2 /end COMPU_METHOD
/begin COMPU_METHOD fak1_q1p63Em5 "" RAT_FUNC "%7.6" "[g*K]/hPa" COEFFS 0 61440 0 0 0 1 /end COMPU_METHOD
/begin COMPU_METHOD fak1_q4p3945Em4 "" RAT_FUNC "%6.5" "[kg/h]/g" COEFFS 0 65536 0 0 0 28.8 /end COMPU_METHOD
/begin COMPU_METHOD fak_q0p007843 "" RAT_FUNC "%6.4" "-" COEFFS 0 1 0 0 0 0.007843 /end COMPU_METHOD
/begin COMPU_METHOD fak_r32_1 "" RAT_FUNC "%43.21" "-" COEFFS 0 1 0 0 0 1 /end COMPU_METHOD
/begin COMPU_METHOD fak_ub_b1 "" RAT_FUNC "%6.4" "-" COEFFS 0 256 0 0 0 1 /end COMPU_METHOD
/begin COMPU_METHOD fak_ub_b16 "" RAT_FUNC "%6.4" "-" COEFFS 0 256 0 0 0 16 /end COMPU_METHOD
/begin COMPU_METHOD fak_ub_b2 "" RAT_FUNC "%6.4" "-" COEFFS 0 256 0 0 0 2 /end COMPU_METHOD
/begin COMPU_METHOD fak_ub_b4 "" RAT_FUNC "%6.4" "-" COEFFS 0 256 0 0 0 4 /end COMPU_METHOD
/begin COMPU_METHOD fak_ub_b8 "" RAT_FUNC "%6.4" "-" COEFFS 0 256 0 0 0 8 /end COMPU_METHOD
/begin COMPU_METHOD fak_uw_b1 "" RAT_FUNC "%7.6" "-" COEFFS 0 65536 0 0 0 1 /end COMPU_METHOD
/begin COMPU_METHOD fak_uw_b16 "" RAT_FUNC "%6.5" "-" COEFFS 0 65536 0 0 0 16 /end COMPU_METHOD
/begin COMPU_METHOD fak_uw_b2 "" RAT_FUNC "%7.6" "-" COEFFS 0 65536 0 0 0 2 /end COMPU_METHOD
/begin COMPU_METHOD fak_uw_b32 "" RAT_FUNC "%6.5" "-" COEFFS 0 65536 0 0 0 32 /end COMPU_METHOD
/begin COMPU_METHOD fak_uw_b4 "" RAT_FUNC "%7.6" "-" COEFFS 0 65536 0 0 0 4 /end COMPU_METHOD
/begin COMPU_METHOD fak_uw_b8 "" RAT_FUNC "%6.5" "-" COEFFS 0 65536 0 0 0 8 /end COMPU_METHOD
/begin COMPU_METHOD fuel_ub_q0p5 "" RAT_FUNC "%6.3" "l" COEFFS 0 2 0 0 0 1 /end COMPU_METHOD
/begin COMPU_METHOD fuel_ub_q1 "" RAT_FUNC "%6.2" "l" COEFFS 0 1 0 0 0 1 /end COMPU_METHOD
/begin COMPU_METHOD kumsrl_uw_b0p004 "" RAT_FUNC "%13.12" "(kg/h)/(1/min)(%)" COEFFS 0 1.6384e+007 0 0 0 1 /end COMPU_METHOD
/begin COMPU_METHOD kw_q0p0078 "" RAT_FUNC "%6.4" "Grad KW" COEFFS 0 128 0 0 0 1 /end COMPU_METHOD
/begin COMPU_METHOD kw_q6 "" RAT_FUNC "%6.2" "Grad KW" COEFFS 0 1 0 0 0 6 /end COMPU_METHOD
/begin COMPU_METHOD kw_sw_q0p0078 "" RAT_FUNC "%6.4" "Grad KW" COEFFS 0 128 0 0 0 1 /end COMPU_METHOD
/begin COMPU_METHOD leist_q2 "" RAT_FUNC "%6.2" "W" COEFFS 0 1 0 0 0 2 /end COMPU_METHOD
/begin COMPU_METHOD m_q0p0005 "" RAT_FUNC "%6.5" "kg/(h*%)" COEFFS 0 1 0 0 0 0.0005 /end COMPU_METHOD
/begin COMPU_METHOD m_q0p1 "" RAT_FUNC "%6.3" "kg/h" COEFFS 0 10 0 0 0 1 /end COMPU_METHOD
/begin COMPU_METHOD m_q2p71Em5_g "" RAT_FUNC "%7.6" "g" COEFFS 0 65536 0 0 0 1.77778 /end COMPU_METHOD
/begin COMPU_METHOD m_ub_b25p6 "" RAT_FUNC "%6.3" "kg/h" COEFFS 0 256 0 0 0 25.6 /end COMPU_METHOD
/begin COMPU_METHOD m_ub_q0p4 "" RAT_FUNC "%6.3" "kg/h" COEFFS 0 1 0 0 0 0.4 /end COMPU_METHOD
/begin COMPU_METHOD m_uw_b23p3 "" RAT_FUNC "%6.5" "kg" COEFFS 0 2812.5 0 0 0 1 /end COMPU_METHOD
/begin COMPU_METHOD m_uw_b25p6 "" RAT_FUNC "%6.5" "kg/h" COEFFS 0 65536 0 0 0 25.6 /end COMPU_METHOD
/begin COMPU_METHOD m_uw_b4660 "" RAT_FUNC "%6.4" "g" COEFFS 0 3600 0 0 0 256 /end COMPU_METHOD
/begin COMPU_METHOD m_uw_b6553p5 "" RAT_FUNC "%6.3" "kg/h" COEFFS 0 1 0 0 0 0.1 /end COMPU_METHOD
/begin COMPU_METHOD nmotg_sb_q100 "" RAT_FUNC "%6.0" "1/min/s" COEFFS 0 1 0 0 0 100 /end COMPU_METHOD
/begin COMPU_METHOD nmotg_sw_q0p39 "" RAT_FUNC "%6.3" "1/min/s" COEFFS 0 1 0 0 0 0.39063 /end COMPU_METHOD
/begin COMPU_METHOD nmot_sw_q0p25 "" RAT_FUNC "%6.3" "1/min" COEFFS 0 1 0 0 0 0.25 /end COMPU_METHOD
/begin COMPU_METHOD nmot_ub_q10 "" RAT_FUNC "%6.1" "1/min" COEFFS 0 1 0 0 0 10 /end COMPU_METHOD
/begin COMPU_METHOD nmot_ub_q40 "" RAT_FUNC "%6.1" "1/min" COEFFS 0 1 0 0 0 40 /end COMPU_METHOD
/begin COMPU_METHOD nmot_uw_q0p25 "" RAT_FUNC "%6.3" "1/min" COEFFS 0 1 0 0 0 0.25 /end COMPU_METHOD
/begin COMPU_METHOD p_sw_q0p039 "" RAT_FUNC "%6.4" "hPa" COEFFS 0 256 0 0 0 10 /end COMPU_METHOD
/begin COMPU_METHOD p_ub_q10 "" RAT_FUNC "%6.1" "hPa" COEFFS 0 1 0 0 0 10 /end COMPU_METHOD
/begin COMPU_METHOD p_uw_b32 "" RAT_FUNC "%6.5" "hPa/%" COEFFS 0 65536 0 0 0 32 /end COMPU_METHOD
/begin COMPU_METHOD p_uw_q0p039 "" RAT_FUNC "%6.4" "hPa" COEFFS 0 256 0 0 0 10 /end COMPU_METHOD
/begin COMPU_METHOD p_uw_q0p078 "" RAT_FUNC "%6.4" "hPa" COEFFS 0 256 0 0 0 20 /end COMPU_METHOD
/begin COMPU_METHOD relDK_ub_b100 "" RAT_FUNC "%6.3" "%DK" COEFFS 0 255 0 0 0 100 /end COMPU_METHOD
/begin COMPU_METHOD relNWU_q0p0234 "" RAT_FUNC "%6.4" "%/NWU" COEFFS 0 32 0 0 0 0.75 /end COMPU_METHOD
/begin COMPU_METHOD rel_sw_b0p15 "" RAT_FUNC "%8.7" "%/hPa" COEFFS 0 65536 0 0 0 0.3 /end COMPU_METHOD
/begin COMPU_METHOD rel_sw_b1536 "" RAT_FUNC "%6.4" "%" COEFFS 0 65536 0 0 0 3072 /end COMPU_METHOD
/begin COMPU_METHOD rel_sw_q0p0234 "" RAT_FUNC "%6.4" "%/seg" COEFFS 0 32 0 0 0 0.75 /end COMPU_METHOD
/begin COMPU_METHOD rel_ub_b200 "" RAT_FUNC "%6.3" "%" COEFFS 0 256 0 0 0 200 /end COMPU_METHOD
/begin COMPU_METHOD rel_ub_b99p6 "" RAT_FUNC "%6.3" "%" COEFFS 0 256 0 0 0 100 /end COMPU_METHOD
/begin COMPU_METHOD rel_ub_q0p1875 "" RAT_FUNC "%6.3" "KW/ms" COEFFS 0 256 0 0 0 48 /end COMPU_METHOD
/begin COMPU_METHOD rel_ub_q0p75 "" RAT_FUNC "%6.3" "%" COEFFS 0 1 0 0 0 0.75 /end COMPU_METHOD
/begin COMPU_METHOD rel_uw_b0p3 "" RAT_FUNC "%8.7" "%/hPa" COEFFS 0 65536 0 0 0 0.3 /end COMPU_METHOD
/begin COMPU_METHOD rel_uw_b100 "" RAT_FUNC "%6.4" "%" COEFFS 0 65536 0 0 0 100 /end COMPU_METHOD
/begin COMPU_METHOD rel_uw_q0p0234 "" RAT_FUNC "%6.4" "%" COEFFS 0 32 0 0 0 0.75 /end COMPU_METHOD
/begin COMPU_METHOD spg_q0p00039 "" RAT_FUNC "%6.5" "V" COEFFS 0 1 0 0 0 0.000390625 /end COMPU_METHOD
/begin COMPU_METHOD t100msxs_ub_b25p5 "" RAT_FUNC "%6.3" "s" COEFFS 0 1 0 0 0 0.1 /end COMPU_METHOD
/begin COMPU_METHOD t10msxs_uw_b655p35 "" RAT_FUNC "%6.4" "s" COEFFS 0 1 0 0 0 0.01 /end COMPU_METHOD
/begin COMPU_METHOD t1p0usxms "" RAT_FUNC "%6.5" "ms" COEFFS 0 1000 0 0 0 1 /end COMPU_METHOD
/begin COMPU_METHOD t1sxs_uw_b65535 "" RAT_FUNC "%6.2" "s" COEFFS 0 1 0 0 0 1 /end COMPU_METHOD
/begin COMPU_METHOD t1sxs_uw_q1 "" RAT_FUNC "%6.2" "s" COEFFS 0 1 0 0 0 1 /end COMPU_METHOD
/begin COMPU_METHOD t200msxs_uw_q0p2 "" RAT_FUNC "%6.3" "s" COEFFS 0 1 0 0 0 0.2 /end COMPU_METHOD
/begin COMPU_METHOD temp_q0p0234 "" RAT_FUNC "%6.4" "K" COEFFS 0 256 0 0 0 6 /end COMPU_METHOD
/begin COMPU_METHOD temp_q0p0234_o273 "" RAT_FUNC "%6.1" "Grad C" COEFFS 0 1 273.15 0 0 0.0234375 /end COMPU_METHOD
/begin COMPU_METHOD temp_sw_q0p75 "" RAT_FUNC "%6.3" "Grad C" COEFFS 0 4 0 0 0 3 /end COMPU_METHOD
/begin COMPU_METHOD temp_ub_b191p25 "" RAT_FUNC "%6.3" "Grad C" COEFFS 0 1 0 0 0 0.75 /end COMPU_METHOD
/begin COMPU_METHOD temp_ub_q0p75_o48 "" RAT_FUNC "%6.2" "Grad C" COEFFS 0 1 48 0 0 0.75 /end COMPU_METHOD
/begin COMPU_METHOD temp_uw_q0p0195_o50 "" RAT_FUNC "%6.2" "Grad C" COEFFS 0 256 12800 0 0 5 /end COMPU_METHOD
/begin COMPU_METHOD t_q0p0001_ms "" RAT_FUNC "%7.6" "ms" COEFFS 0 1 0 0 0 0.0001 /end COMPU_METHOD
/begin COMPU_METHOD t_q0p04_ms "" RAT_FUNC "%6.4" "ms" COEFFS 0 1 0 0 0 0.04 /end COMPU_METHOD
/begin COMPU_METHOD t_q0p1 "" RAT_FUNC "%6.3" "s" COEFFS 0 10 0 0 0 1 /end COMPU_METHOD
/begin COMPU_METHOD t_q16us "" RAT_FUNC "%6.1" "us" COEFFS 0 1 0 0 0 16 /end COMPU_METHOD
/begin COMPU_METHOD t_q1p024_ms "" RAT_FUNC "%6.2" "ms" COEFFS 0 1 0 0 0 1.024 /end COMPU_METHOD
/begin COMPU_METHOD vfzg_ub_q1p25 "" RAT_FUNC "%6.2" "km/h" COEFFS 0 1 0 0 0 1.25 /end COMPU_METHOD
/begin COMPU_METHOD vfzg_uw_b512 "" RAT_FUNC "%6.4" "km/h" COEFFS 0 65536 0 0 0 512 /end COMPU_METHOD
/begin COMPU_METHOD vfzg_uw_q0p0625 "" RAT_FUNC "%6.4" "km/h" COEFFS 0 1 0 0 0 0.0625 /end COMPU_METHOD
/begin COMPU_METHOD vnw_q0p0298 "" RAT_FUNC "%4.3" "grd/Sek." COEFFS 0 10000 0 0 0 298 /end COMPU_METHOD
/begin COMPU_METHOD vs_uw_b25p6 "" RAT_FUNC "%6.5" "m^3/h" COEFFS 0 65536 0 0 0 25.6 /end COMPU_METHOD
/begin COMPU_METHOD zk100msxs_ub_b25p5 "" RAT_FUNC "%6.3" "s" COEFFS 0 0 256 0 10 0 /end COMPU_METHOD
/begin COMPU_METHOD zk100msxs_uw_b6553 "" RAT_FUNC "%10.3" "s" COEFFS 0 0 65536 0 10 0 /end COMPU_METHOD
/begin COMPU_METHOD zk10msxs_uw_b2p55T "" TAB_INTP "%6.3" "s" COMPU_TAB_REF zk10msxs_uw_b2p55T /end COMPU_METHOD
/begin COMPU_TAB zk10msxs_uw_b2p55T "" TAB_INTP 35 128 2.55 145 2.25 163 2 186 1.75 217 1.5 251 1.3 283 1.15 326 1 362 0.9 407 0.8 465 0.7 541 0.6 649 0.5 720 0.45 809 0.4 923 0.35 1074 0.3 1285 0.25 1524 0.21 1872 0.17 2259 0.14 2426 0.13 2620 0.12 2847 0.11 3118 0.1 3446 0.09 3850 0.08 4362 0.07 5030 0.06 5939 0.05 7248 0.04 9288 0.03 12893 0.02 20713 0.01 32767 0 /end COMPU_TAB
/begin COMPU_METHOD zk10msxs_uw_b655 "" RAT_FUNC "%10.4" "s" COEFFS 0 0 65536 0 100 0 /end COMPU_METHOD
/begin COMPU_METHOD zk1sxs_uw_b65535 "" RAT_FUNC "%6.0" "s" COEFFS 0 0 65535 0 1 0 /end COMPU_METHOD
/begin COMPU_METHOD zk20msxs_ub_b5p1 "" RAT_FUNC "%6.4" "s" COEFFS 0 0 5.1 0 1 0 /end COMPU_METHOD
/begin COMPU_METHOD zk50msxs_uw_b12p8 "" RAT_FUNC "%10.3" "s" COEFFS 0 0 32768 0 10 0 /end COMPU_METHOD
/begin COMPU_METHOD zw_ub_q6 "" RAT_FUNC "%6.2" "Grad KW" COEFFS 0 255 0 0 0 1530 /end COMPU_METHOD
/begin RECORD_LAYOUT dc_ArrSw FNC_VALUES 1 SWORD COLUMN_DIR DIRECT /end RECORD_LAYOUT
/begin RECORD_LAYOUT dc_GKlWSw FNC_VALUES 1 SWORD COLUMN_DIR DIRECT /end RECORD_LAYOUT
/begin RECORD_LAYOUT dc_KwSw FNC_VALUES 1 SWORD COLUMN_DIR DIRECT /end RECORD_LAYOUT
/begin RECORD_LAYOUT dc_KwUb FNC_VALUES 1 UBYTE COLUMN_DIR DIRECT /end RECORD_LAYOUT
/begin RECORD_LAYOUT dc_KwUw FNC_VALUES 1 UWORD COLUMN_DIR DIRECT /end RECORD_LAYOUT
/begin RECORD_LAYOUT dc_SstAUwSstSw NO_AXIS_PTS_X 1 UWORD AXIS_PTS_X 2 SWORD INDEX_INCR DIRECT /end RECORD_LAYOUT
/begin RECORD_LAYOUT FklWUw FNC_VALUES 1 UWORD COLUMN_DIR DIRECT /end RECORD_LAYOUT
/begin RECORD_LAYOUT GklWUw FNC_VALUES 1 UWORD COLUMN_DIR DIRECT /end RECORD_LAYOUT
/begin RECORD_LAYOUT KfAxU8AyU8SstxU8SstyU8WU8 NO_AXIS_PTS_X 1 UBYTE NO_AXIS_PTS_Y 2 UBYTE AXIS_PTS_X 3 UBYTE INDEX_INCR DIRECT AXIS_PTS_Y 4 UBYTE INDEX_INCR DIRECT FNC_VALUES 5 UBYTE COLUMN_DIR DIRECT /end RECORD_LAYOUT
/begin RECORD_LAYOUT KfAxUbAyUbSstxUbSstyUbWUb NO_AXIS_PTS_X 1 UBYTE NO_AXIS_PTS_Y 2 UBYTE AXIS_PTS_X 3 UBYTE INDEX_INCR DIRECT AXIS_PTS_Y 4 UBYTE INDEX_INCR DIRECT FNC_VALUES 5 UBYTE COLUMN_DIR DIRECT /end RECORD_LAYOUT
/begin RECORD_LAYOUT KfAxUbAyUbSstxUwSstyUbWUb NO_AXIS_PTS_X 1 UBYTE NO_AXIS_PTS_Y 2 UBYTE AXIS_PTS_X 3 UWORD INDEX_INCR DIRECT AXIS_PTS_Y 4 UBYTE INDEX_INCR DIRECT FNC_VALUES 5 UBYTE COLUMN_DIR DIRECT /end RECORD_LAYOUT
/begin RECORD_LAYOUT KfAxUwAyUwSstxSwSstyUwWUw NO_AXIS_PTS_X 1 UWORD NO_AXIS_PTS_Y 2 UWORD AXIS_PTS_X 3 SWORD INDEX_INCR DIRECT AXIS_PTS_Y 4 UWORD INDEX_INCR DIRECT FNC_VALUES 5 UWORD COLUMN_DIR DIRECT /end RECORD_LAYOUT
/begin RECORD_LAYOUT KfAxUwAyUwSstxUwSstyUwWUw NO_AXIS_PTS_X 1 UWORD NO_AXIS_PTS_Y 2 UWORD AXIS_PTS_X 3 UWORD INDEX_INCR DIRECT AXIS_PTS_Y 4 UWORD INDEX_INCR DIRECT FNC_VALUES 5 UWORD COLUMN_DIR DIRECT /end RECORD_LAYOUT
/begin RECORD_LAYOUT KlASwSstSwWSw NO_AXIS_PTS_X 1 SWORD AXIS_PTS_X 2 SWORD INDEX_INCR DIRECT FNC_VALUES 3 SWORD COLUMN_DIR DIRECT /end RECORD_LAYOUT
/begin RECORD_LAYOUT KlAUbSstUbWUb NO_AXIS_PTS_X 1 UBYTE AXIS_PTS_X 2 UBYTE INDEX_INCR DIRECT FNC_VALUES 3 UBYTE COLUMN_DIR DIRECT /end RECORD_LAYOUT
/begin RECORD_LAYOUT KlAUbSstUbWUw NO_AXIS_PTS_X 1 UBYTE AXIS_PTS_X 2 UBYTE INDEX_INCR DIRECT FNC_VALUES 3 UWORD COLUMN_DIR DIRECT /end RECORD_LAYOUT
/begin RECORD_LAYOUT KlAUwSstUwWUw NO_AXIS_PTS_X 1 UWORD AXIS_PTS_X 2 UWORD INDEX_INCR DIRECT FNC_VALUES 3 UWORD COLUMN_DIR DIRECT /end RECORD_LAYOUT
/begin RECORD_LAYOUT KlAxU8SstxU16WU16 NO_AXIS_PTS_X 1 UWORD AXIS_PTS_X 2 UWORD INDEX_INCR DIRECT FNC_VALUES 3 UWORD COLUMN_DIR DIRECT /end RECORD_LAYOUT
/begin RECORD_LAYOUT KlAxU8SstxU16WU8 NO_AXIS_PTS_X 1 UBYTE AXIS_PTS_X 2 UWORD INDEX_INCR DIRECT FNC_VALUES 3 UBYTE COLUMN_DIR DIRECT /end RECORD_LAYOUT
/begin RECORD_LAYOUT KlAxU8SstxU8WS8 NO_AXIS_PTS_X 1 UBYTE AXIS_PTS_X 2 UBYTE INDEX_INCR DIRECT FNC_VALUES 3 SBYTE COLUMN_DIR DIRECT /end RECORD_LAYOUT
/begin RECORD_LAYOUT KlAxU8SstxU8WU16 NO_AXIS_PTS_X 1 UBYTE AXIS_PTS_X 2 UBYTE INDEX_INCR DIRECT FNC_VALUES 3 UWORD COLUMN_DIR DIRECT /end RECORD_LAYOUT
/begin RECORD_LAYOUT KlAxU8SstxU8WU8 NO_AXIS_PTS_X 1 UBYTE AXIS_PTS_X 2 UBYTE INDEX_INCR DIRECT FNC_VALUES 3 UBYTE COLUMN_DIR DIRECT /end RECORD_LAYOUT
/begin RECORD_LAYOUT KwbUb FNC_VALUES 1 UBYTE COLUMN_DIR DIRECT /end RECORD_LAYOUT
/begin RECORD_LAYOUT KwSb FNC_VALUES 1 SBYTE COLUMN_DIR DIRECT /end RECORD_LAYOUT
/begin RECORD_LAYOUT KwSw FNC_VALUES 1 SWORD COLUMN_DIR DIRECT /end RECORD_LAYOUT
/begin RECORD_LAYOUT KwUb FNC_VALUES 1 UBYTE COLUMN_DIR DIRECT /end RECORD_LAYOUT
/begin RECORD_LAYOUT KwUw FNC_VALUES 1 UWORD COLUMN_DIR DIRECT /end RECORD_LAYOUT
/begin RECORD_LAYOUT KwWU16 FNC_VALUES 1 UWORD COLUMN_DIR DIRECT /end RECORD_LAYOUT
/begin RECORD_LAYOUT KwWU8 FNC_VALUES 1 UBYTE COLUMN_DIR DIRECT /end RECORD_LAYOUT
/begin RECORD_LAYOUT SstAUwSstUw NO_AXIS_PTS_X 1 UWORD AXIS_PTS_X 2 UWORD INDEX_INCR DIRECT /end RECORD_LAYOUT
/end MODULE
/end PROJECT
