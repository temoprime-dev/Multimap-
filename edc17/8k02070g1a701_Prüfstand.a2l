ASAP2_VERSION 1 3
/begin PROJECT _9702_071D00 "ME97"
/begin HEADER "" VERSION "_9702_071D00" PROJECT_NO _9702_071D00 /end HEADER
/begin MODULE DIM ""
/begin MOD_COMMON "" BYTE_ORDER MSB_FIRST ALIGNMENT_BYTE 1 ALIGNMENT_WORD 2 ALIGNMENT_LONG 2 ALIGNMENT_FLOAT32_IEEE 4 /end MOD_COMMON
/begin CHARACTERISTIC CDCFRAO "Codewort CARB: LR-Adaption obere multiplikativ" VAL_BLK 0x1D38C6 KwbUw 65535.00 dez 0.00 65535.00 FORMAT "%8.2" NUMBER 4 /end CHARACTERISTIC
/begin CHARACTERISTIC CDCFRAO2 "Codewort CARB: LR-Adaption obere multiplikativ Bank 2" VAL_BLK 0x1D38CE KwbUw 65535.00 dez 0.00 65535.00 FORMAT "%8.2" NUMBER 4 /end CHARACTERISTIC
/begin CHARACTERISTIC CDCFRAU "Codewort CARB: LR-Adaption untere multiplikativ" VAL_BLK 0x1D38D6 KwbUw 65535.00 dez 0.00 65535.00 FORMAT "%8.2" NUMBER 4 /end CHARACTERISTIC
/begin CHARACTERISTIC CDCFRAU2 "Codewort CARB: LR-Adaption untere multiplikativ Bank 2" VAL_BLK 0x1D38DE KwbUw 65535.00 dez 0.00 65535.00 FORMAT "%8.2" NUMBER 4 /end CHARACTERISTIC
/begin CHARACTERISTIC CDCFRST "Codewort CARB: LR-Abweichung" VAL_BLK 0x1D38E6 KwbUw 65535.00 dez 0.00 65535.00 FORMAT "%8.2" NUMBER 4 /end CHARACTERISTIC
/begin CHARACTERISTIC CDCFRST2 "Codewort CARB: LR-Abweichung Bank 2" VAL_BLK 0x1D38EE KwbUw 65535.00 dez 0.00 65535.00 FORMAT "%8.2" NUMBER 4 /end CHARACTERISTIC
/begin CHARACTERISTIC CDCFST "Codewort CARB: Tankf¸llstand" VAL_BLK 0x1D38F6 KwbUw 65535.00 dez 0.00 65535.00 FORMAT "%8.2" NUMBER 4 /end CHARACTERISTIC
/begin CHARACTERISTIC CDCFST2 "" VAL_BLK 0x1D38FE KwbUw 65535.00 dez 0.00 65535.00 FORMAT "%8.2" NUMBER 4 /end CHARACTERISTIC
/begin CHARACTERISTIC CDCHFM "" VAL_BLK 0x1D3906 KwbUw 65535.00 dez 0.00 65535.00 FORMAT "%8.2" NUMBER 4 /end CHARACTERISTIC
/begin CHARACTERISTIC CDCHSH "Codewort CARB:	Lambdasonden-Heizung hinter Katalysator" VAL_BLK 0x1D390E KwbUw 65535.00 dez 0.00 65535.00 FORMAT "%8.2" NUMBER 4 /end CHARACTERISTIC
/begin CHARACTERISTIC CDCHSH2 "Codewort CARB:	Lambdasonden-Heizung hinter Katalysator; (Bank2)" VAL_BLK 0x1D3916 KwbUw 65535.00 dez 0.00 65535.00 FORMAT "%8.2" NUMBER 4 /end CHARACTERISTIC
/begin CHARACTERISTIC CDCHSV "Codewort CARB:	Lambdasonden-Heizung vor Katalysator" VAL_BLK 0x1D392E KwbUw 65535.00 dez 0.00 65535.00 FORMAT "%8.2" NUMBER 4 /end CHARACTERISTIC
/begin CHARACTERISTIC CDCHSV2 "Codewort CARB:	Lambdasonden-Heizung vor Katalysator; (Bank2)" VAL_BLK 0x1D3936 KwbUw 65535.00 dez 0.00 65535.00 FORMAT "%8.2" NUMBER 4 /end CHARACTERISTIC
/begin CHARACTERISTIC CDCHSVE "Codewort CARB: Lambdasonden-Heizung vor Katalysator (Endstufe)" VAL_BLK 0x1D393E KwbUw 65535.00 dez 0.00 65535.00 FORMAT "%8.2" NUMBER 4 /end CHARACTERISTIC
/begin CHARACTERISTIC CDCHSVE2 "Codewort CARB: Lambdasonden-Heizung2 vor Katalysator (Endstufe)" VAL_BLK 0x1D3946 KwbUw 65535.00 dez 0.00 65535.00 FORMAT "%8.2" NUMBER 4 /end CHARACTERISTIC
/begin CHARACTERISTIC CDCICLSU "" VAL_BLK 0x1D395E KwbUw 65535.00 dez 0.00 65535.00 FORMAT "%8.2" NUMBER 4 /end CHARACTERISTIC
/begin CHARACTERISTIC CDCICLSU2 "" VAL_BLK 0x1D3966 KwbUw 65535.00 dez 0.00 65535.00 FORMAT "%8.2" NUMBER 4 /end CHARACTERISTIC
/begin CHARACTERISTIC CDCKAT "Codewort CARB:	Katalysator-Konvertierung" VAL_BLK 0x1D396E KwbWU16 65535.00 dez 0.00 65535.00 FORMAT "%8.2" NUMBER 4 /end CHARACTERISTIC
/begin CHARACTERISTIC CDCKAT2 "Codewort CARB:	Katalysator-Konvertierung	(Bank 2)" VAL_BLK 0x1D3976 KwbWU16 65535.00 dez 0.00 65535.00 FORMAT "%8.2" NUMBER 4 /end CHARACTERISTIC
/begin CHARACTERISTIC CDCKATSP "Codewort CARB:	Katalysator-Konvertierung" VAL_BLK 0x1D397E KwbWU16 65535.00 dez 0.00 65535.00 FORMAT "%8.2" NUMBER 4 /end CHARACTERISTIC
/begin CHARACTERISTIC CDCKATSP2 "Codewort CARB:	Katalysator-Konvertierung" VAL_BLK 0x1D3986 KwbWU16 65535.00 dez 0.00 65535.00 FORMAT "%8.2" NUMBER 4 /end CHARACTERISTIC
/begin CHARACTERISTIC CDCKRIC "Codewort CARB: Klopfregelung Klopfsensorauswerte-IC" VAL_BLK 0x1D399E KwbUw 65535.00 dez 0.00 65535.00 FORMAT "%8.2" NUMBER 4 /end CHARACTERISTIC
/begin CHARACTERISTIC CDCKRSPI "Codewort CARB: Klopfregelung SPI-‹berwachung" VAL_BLK 0x1D39A6 KwbUw 65535.00 dez 0.00 65535.00 FORMAT "%8.2" NUMBER 4 /end CHARACTERISTIC
/begin CHARACTERISTIC CDCKS1 "Codewort CARB:	Klopfsensor 1" VAL_BLK 0x1D39AE KwbWU16 65535.00 dez 0.00 65535.00 FORMAT "%8.2" NUMBER 4 /end CHARACTERISTIC
/begin CHARACTERISTIC CDCKS2 "Codewort CARB:	Klopfsensor 2" VAL_BLK 0x1D39B6 KwbWU16 65535.00 dez 0.00 65535.00 FORMAT "%8.2" NUMBER 4 /end CHARACTERISTIC
/begin CHARACTERISTIC CDCLASH "Codewort CARB:	Lambda-Sondenalterung hinter Kat." VAL_BLK 0x1D39C6 KwbUw 65535.00 dez 0.00 65535.00 FORMAT "%8.2" NUMBER 4 /end CHARACTERISTIC
/begin CHARACTERISTIC CDCLASH2 "Codewort CARB:	Lambda-Sondenalterung hinter Kat. (Bank 2)" VAL_BLK 0x1D39CE KwbUw 65535.00 dez 0.00 65535.00 FORMAT "%8.2" NUMBER 4 /end CHARACTERISTIC
/begin CHARACTERISTIC CDCLBK "Codewort CARB: LBK" VAL_BLK 0x1D39D6 KwbUw 65535.00 dez 0.00 65535.00 FORMAT "%8.2" NUMBER 4 /end CHARACTERISTIC
/begin CHARACTERISTIC CDCLBKE "Codewort CARB: Ladungsbewegungsklappe-Endstufe" VAL_BLK 0x1D39DE KwbUw 65535.00 dez 0.00 65535.00 FORMAT "%8.2" NUMBER 4 /end CHARACTERISTIC
/begin CHARACTERISTIC CDCLBKO "Codewort CARB: LBK Offset-Adaption" VAL_BLK 0x1D39E6 KwbUw 65535.00 dez 0.00 65535.00 FORMAT "%8.2" NUMBER 4 /end CHARACTERISTIC
/begin CHARACTERISTIC CDCLBKP "Codewort CARB: LBK Potentiometer" VAL_BLK 0x1D39EE KwbUw 65535.00 dez 0.00 65535.00 FORMAT "%8.2" NUMBER 4 /end CHARACTERISTIC
/begin CHARACTERISTIC CDCLLR "Codewort CARB: Leerlaufregelung am Anschlag" VAL_BLK 0x1D3A16 KwbUw 65535.00 dez 0.00 65535.00 FORMAT "%8.2" NUMBER 4 /end CHARACTERISTIC
/begin CHARACTERISTIC CDCLSH "Codewort CARB:	Lambda-Sonde hinter Kat" VAL_BLK 0x1D3A26 KwbUw 65535.00 dez 0.00 65535.00 FORMAT "%8.2" NUMBER 4 /end CHARACTERISTIC
/begin CHARACTERISTIC CDCLSH2 "Codewort CARB:	Lambda-Sonde 2 hinter Kat" VAL_BLK 0x1D3A2E KwbUw 65535.00 dez 0.00 65535.00 FORMAT "%8.2" NUMBER 4 /end CHARACTERISTIC
/begin CHARACTERISTIC CDCLSUIA "" VAL_BLK 0x1D3A36 KwbUw 65535.00 dez 0.00 65535.00 FORMAT "%8.2" NUMBER 4 /end CHARACTERISTIC
/begin CHARACTERISTIC CDCLSUIA2 "" VAL_BLK 0x1D3A3E KwbUw 65535.00 dez 0.00 65535.00 FORMAT "%8.2" NUMBER 4 /end CHARACTERISTIC
/begin CHARACTERISTIC CDCLSUUN "" VAL_BLK 0x1D3A46 KwbUw 65535.00 dez 0.00 65535.00 FORMAT "%8.2" NUMBER 4 /end CHARACTERISTIC
/begin CHARACTERISTIC CDCLSUUN2 "" VAL_BLK 0x1D3A4E KwbUw 65535.00 dez 0.00 65535.00 FORMAT "%8.2" NUMBER 4 /end CHARACTERISTIC
/begin CHARACTERISTIC CDCLSUVM "" VAL_BLK 0x1D3A56 KwbUw 65535.00 dez 0.00 65535.00 FORMAT "%8.2" NUMBER 4 /end CHARACTERISTIC
/begin CHARACTERISTIC CDCLSUVM2 "" VAL_BLK 0x1D3A5E KwbUw 65535.00 dez 0.00 65535.00 FORMAT "%8.2" NUMBER 4 /end CHARACTERISTIC
/begin CHARACTERISTIC CDCLSV "Codewort CARB: Lambda-Sonde vor Kat" VAL_BLK 0x1D3A66 KwbUw 65535.00 dez 0.00 65535.00 FORMAT "%8.2" NUMBER 4 /end CHARACTERISTIC
/begin CHARACTERISTIC CDCLSV2 "Codewort CARB: Lambda-Sonde 2 vor Kat" VAL_BLK 0x1D3A6E KwbUw 65535.00 dez 0.00 65535.00 FORMAT "%8.2" NUMBER 4 /end CHARACTERISTIC
/begin CHARACTERISTIC CDCMD "Codewort CARB: Aussetzer, Summenfehler (multiple)" VAL_BLK 0x1D3AA6 KwbWU16 65535.00 dez 0.00 65535.00 FORMAT "%8.2" NUMBER 4 /end CHARACTERISTIC
/begin CHARACTERISTIC CDCMD00 "Codewort CARB: Aussetzer Zyl. 0" VAL_BLK 0x1D3AAE KwbWU16 65535.00 dez 0.00 65535.00 FORMAT "%8.2" NUMBER 4 /end CHARACTERISTIC
/begin CHARACTERISTIC CDCMD01 "Codewort CARB: Aussetzer Zyl. 1" VAL_BLK 0x1D3AB6 KwbWU16 65535.00 dez 0.00 65535.00 FORMAT "%8.2" NUMBER 4 /end CHARACTERISTIC
/begin CHARACTERISTIC CDCMD02 "Codewort CARB: Aussetzer Zylinder 2" VAL_BLK 0x1D3ABE KwbWU16 65535.00 dez 0.00 65535.00 FORMAT "%8.2" NUMBER 4 /end CHARACTERISTIC
/begin CHARACTERISTIC CDCMD03 "Codewort CARB: Aussetzer Zylinder 3" VAL_BLK 0x1D3AC6 KwbWU16 65535.00 dez 0.00 65535.00 FORMAT "%8.2" NUMBER 4 /end CHARACTERISTIC
/begin CHARACTERISTIC CDCMD04 "Codewort CARB: Aussetzer Zylinder 4" VAL_BLK 0x1D3ACE KwbWU16 65535.00 dez 0.00 65535.00 FORMAT "%8.2" NUMBER 4 /end CHARACTERISTIC
/begin CHARACTERISTIC CDCMD05 "Codewort CARB: Aussetzer Zylinder 5" VAL_BLK 0x1D3AD6 KwbWU16 65535.00 dez 0.00 65535.00 FORMAT "%8.2" NUMBER 4 /end CHARACTERISTIC
/begin CHARACTERISTIC CDCMD06 "Codewort CARB: Aussetzer Zylinder 6" VAL_BLK 0x1D3ADE KwbWU16 65535.00 dez 0.00 65535.00 FORMAT "%8.2" NUMBER 4 /end CHARACTERISTIC
/begin CHARACTERISTIC CDCMD07 "Codewort CARB: Aussetzer Zylinder 7" VAL_BLK 0x1D3AE6 KwbWU16 65535.00 dez 0.00 65535.00 FORMAT "%8.2" NUMBER 4 /end CHARACTERISTIC
/begin CHARACTERISTIC CDCMD08 "Codewort CARB: Aussetzer Zylinder 8" VAL_BLK 0x1D3AEE KwbWU16 65535.00 dez 0.00 65535.00 FORMAT "%8.2" NUMBER 4 /end CHARACTERISTIC
/begin CHARACTERISTIC CDCMD09 "Codewort CARB: Aussetzer Zylinder 9" VAL_BLK 0x1D3AF6 KwbWU16 65535.00 dez 0.00 65535.00 FORMAT "%8.2" NUMBER 4 /end CHARACTERISTIC
/begin CHARACTERISTIC CDCMD10 "Codewort CARB: Aussetzer Zylinder 10" VAL_BLK 0x1D3AFE KwbWU16 65535.00 dez 0.00 65535.00 FORMAT "%8.2" NUMBER 4 /end CHARACTERISTIC
/begin CHARACTERISTIC CDCMD11 "Codewort CARB: Aussetzer Zylinder 11" VAL_BLK 0x1D3B06 KwbWU16 65535.00 dez 0.00 65535.00 FORMAT "%8.2" NUMBER 4 /end CHARACTERISTIC
/begin CHARACTERISTIC CDCRKAT "Codewort CARB: LR-Adaption QL-additiv" VAL_BLK 0x1D3BB6 KwbUw 65535.00 dez 0.00 65535.00 FORMAT "%8.2" NUMBER 4 /end CHARACTERISTIC
/begin CHARACTERISTIC CDCRKAT2 "Codewort CARB: LR-Adaption QL-additiv Bank 2" VAL_BLK 0x1D3BBE KwbUw 65535.00 dez 0.00 65535.00 FORMAT "%8.2" NUMBER 4 /end CHARACTERISTIC
/begin CHARACTERISTIC CDCRKAZ "Codewort CARB: LR-Adaption ti-additiv" VAL_BLK 0x1D3BC6 KwbUw 65535.00 dez 0.00 65535.00 FORMAT "%8.2" NUMBER 4 /end CHARACTERISTIC
/begin CHARACTERISTIC CDCRKAZ2 "Codewort CARB: LR-Adaption ti-additiv Bank 2" VAL_BLK 0x1D3BCE KwbUw 65535.00 dez 0.00 65535.00 FORMAT "%8.2" NUMBER 4 /end CHARACTERISTIC
/begin CHARACTERISTIC CDKFRAO "Codewort Kunde: LR- Adaption multi. obere Schwelle" VALUE 0x1D3DC6 KwUw 65535.00 dez 0.00 65535.00 FORMAT "%8.2" /end CHARACTERISTIC
/begin CHARACTERISTIC CDKFRAO2 "Codewort Kunde: LR- Adaption mult. oderer Bereich" VALUE 0x1D3DC8 KwUw 65535.00 dez 0.00 65535.00 FORMAT "%8.2" /end CHARACTERISTIC
/begin CHARACTERISTIC CDKFRAU "Codewort Kunde: LR- Adaption multi. untere Schwelle" VALUE 0x1D3DCA KwUw 65535.00 dez 0.00 65535.00 FORMAT "%8.2" /end CHARACTERISTIC
/begin CHARACTERISTIC CDKFRAU2 "Codewort Kunde: LR- Adaption mult. untere Schwelle Bank 2" VALUE 0x1D3DCC KwUw 65535.00 dez 0.00 65535.00 FORMAT "%8.2" /end CHARACTERISTIC
/begin CHARACTERISTIC CDKFRST "Codewort Kunde: LR- Abweichung" VALUE 0x1D3DCE KwUw 65535.00 dez 0.00 65535.00 FORMAT "%8.2" /end CHARACTERISTIC
/begin CHARACTERISTIC CDKFRST2 "Codewort Kunde: LR- Abweichung Bank 2" VALUE 0x1D3DD0 KwUw 65535.00 dez 0.00 65535.00 FORMAT "%8.2" /end CHARACTERISTIC
/begin CHARACTERISTIC CDKFST "Codewort Kunde: Tankf¸llstand" VALUE 0x1D3DD2 KwUw 65535.00 dez 0.00 65535.00 FORMAT "%8.2" /end CHARACTERISTIC
/begin CHARACTERISTIC CDKFST2 "" VALUE 0x1D3DD4 KwUw 65535.00 dez 0.00 65535.00 FORMAT "%8.2" /end CHARACTERISTIC
/begin CHARACTERISTIC CDKHFM "" VALUE 0x1D3DD6 KwUw 65535.00 dez 0.00 65535.00 FORMAT "%8.2" /end CHARACTERISTIC
/begin CHARACTERISTIC CDKHSH "Codewort Kunde:Lambdasonden-Heizung hinter Katalysator" VALUE 0x1D3DD8 KwUw 65535.00 dez 0.00 65535.00 FORMAT "%8.2" /end CHARACTERISTIC
/begin CHARACTERISTIC CDKHSH2 "Codewort Kunde:	Lambdasonden-Heizung hinter Katalysator, Bank 2" VALUE 0x1D3DDA KwUw 65535.00 dez 0.00 65535.00 FORMAT "%8.2" /end CHARACTERISTIC
/begin CHARACTERISTIC CDKHSV "Codewort Kunde: Lambdasonden-Heizung vor Katalysator" VALUE 0x1D3DE0 KwUw 65535.00 dez 0.00 65535.00 FORMAT "%8.2" /end CHARACTERISTIC
/begin CHARACTERISTIC CDKHSV2 "Codewort Kunde:	Lambdasonden-Heizung vor Katalysator, Bank 2" VALUE 0x1D3DE2 KwUw 65535.00 dez 0.00 65535.00 FORMAT "%8.2" /end CHARACTERISTIC
/begin CHARACTERISTIC CDKHSVE "Codewort Kunde: Lambdasonden-Heizung vor Katalysator (Endstufe)" VALUE 0x1D3DE4 KwUw 65535.00 dez 0.00 65535.00 FORMAT "%8.2" /end CHARACTERISTIC
/begin CHARACTERISTIC CDKHSVE2 "Codewort Kunde: Endstufe Heizung Sonde vor Kat. Bank 2" VALUE 0x1D3DE6 KwUw 65535.00 dez 0.00 65535.00 FORMAT "%8.2" /end CHARACTERISTIC
/begin CHARACTERISTIC CDKICLSU "" VALUE 0x1D3DEC KwUw 65535.00 dez 0.00 65535.00 FORMAT "%8.2" /end CHARACTERISTIC
/begin CHARACTERISTIC CDKICLSU2 "" VALUE 0x1D3DEE KwUw 65535.00 dez 0.00 65535.00 FORMAT "%8.2" /end CHARACTERISTIC
/begin CHARACTERISTIC CDKKAT "Codewort Kunde:	Katalysator-Konvertierung" VALUE 0x1D3DF0 KwWU16 65535.00 dez 0.00 65535.00 FORMAT "%8.2" /end CHARACTERISTIC
/begin CHARACTERISTIC CDKKAT2 "Codewort Kunde:	Katalysator-Konvertierung	(Bank 2)" VALUE 0x1D3DF2 KwWU16 65535.00 dez 0.00 65535.00 FORMAT "%8.2" /end CHARACTERISTIC
/begin CHARACTERISTIC CDKKATSP "Codewort Kunde:	Katalysator-Konvertierung" VALUE 0x1D3DF4 KwWU16 65535.00 dez 0.00 65535.00 FORMAT "%8.2" /end CHARACTERISTIC
/begin CHARACTERISTIC CDKKATSP2 "Codewort Kunde: Katalysator-Konvertierung Bank 2" VALUE 0x1D3DF6 KwWU16 65535.00 dez 0.00 65535.00 FORMAT "%8.2" /end CHARACTERISTIC
/begin CHARACTERISTIC CDKKRIC "Codewort Kunde: KlopfregelungKlopfsensorauswerte-IC" VALUE 0x1D3DFC KwUw 65535.00 dez 0.00 65535.00 FORMAT "%8.2" /end CHARACTERISTIC
/begin CHARACTERISTIC CDKKRSPI "Codewort Kunde: Klopfregelung SPI-‹berwachung" VALUE 0x1D3DFE KwUw 65535.00 dez 0.00 65535.00 FORMAT "%8.2" /end CHARACTERISTIC
/begin CHARACTERISTIC CDKKS1 "Codewort Kunde:	Klopfsensor 1" VALUE 0x1D3E00 KwWU16 65535.00 dez 0.00 65535.00 FORMAT "%8.2" /end CHARACTERISTIC
/begin CHARACTERISTIC CDKKS2 "Codewort Kunde:	Klopfsensor 2" VALUE 0x1D3E02 KwWU16 65535.00 dez 0.00 65535.00 FORMAT "%8.2" /end CHARACTERISTIC
/begin CHARACTERISTIC CDKLASH "Codewort Kunde: Lambda-Sondenalterung hinter Kat." VALUE 0x1D3E06 KwUw 65535.00 dez 0.00 65535.00 FORMAT "%8.2" /end CHARACTERISTIC
/begin CHARACTERISTIC CDKLASH2 "Codewort Kunde: Lambda-Sondenalterung hinter Kat.  Bank 2" VALUE 0x1D3E08 KwUw 65535.00 dez 0.00 65535.00 FORMAT "%8.2" /end CHARACTERISTIC
/begin CHARACTERISTIC CDKLBK "Codewort Kunde: Ladungsbewegungsklappe" VALUE 0x1D3E0A KwUw 65535.00 dez 0.00 65535.00 FORMAT "%8.2" /end CHARACTERISTIC
/begin CHARACTERISTIC CDKLBKE "" VALUE 0x1D3E0C KwUw 65535.00 dez 0.00 65535.00 FORMAT "%8.2" /end CHARACTERISTIC
/begin CHARACTERISTIC CDKLBKO "Codewort Kunde: Ladungsbewegungsklappe Offset-Adaption" VALUE 0x1D3E0E KwUw 65535.00 dez 0.00 65535.00 FORMAT "%8.2" /end CHARACTERISTIC
/begin CHARACTERISTIC CDKLBKP "Codewort Kunde: Ladungsbewegungsklappe Potentiometer" VALUE 0x1D3E10 KwUw 65535.00 dez 0.00 65535.00 FORMAT "%8.2" /end CHARACTERISTIC
/begin CHARACTERISTIC CDKLLR "Codewort Kunde: Leerlaufregelung am Anschlag" VALUE 0x1D3E1A KwUw 65535.00 dez 0.00 65535.00 FORMAT "%8.2" /end CHARACTERISTIC
/begin CHARACTERISTIC CDKLSH "Codewort Kunde: Lambda-Sonde hinter Kat" VALUE 0x1D3E1E KwUw 65535.00 dez 0.00 65535.00 FORMAT "%8.2" /end CHARACTERISTIC
/begin CHARACTERISTIC CDKLSH2 "Codewort Kunde: Lambda-Sonde 2 hinter Kat" VALUE 0x1D3E20 KwUw 65535.00 dez 0.00 65535.00 FORMAT "%8.2" /end CHARACTERISTIC
/begin CHARACTERISTIC CDKLSUIA "" VALUE 0x1D3E22 KwUw 65535.00 dez 0.00 65535.00 FORMAT "%8.2" /end CHARACTERISTIC
/begin CHARACTERISTIC CDKLSUIA2 "" VALUE 0x1D3E24 KwUw 65535.00 dez 0.00 65535.00 FORMAT "%8.2" /end CHARACTERISTIC
/begin CHARACTERISTIC CDKLSUUN "" VALUE 0x1D3E26 KwUw 65535.00 dez 0.00 65535.00 FORMAT "%8.2" /end CHARACTERISTIC
/begin CHARACTERISTIC CDKLSUUN2 "" VALUE 0x1D3E28 KwUw 65535.00 dez 0.00 65535.00 FORMAT "%8.2" /end CHARACTERISTIC
/begin CHARACTERISTIC CDKLSUVM "" VALUE 0x1D3E2A KwUw 65535.00 dez 0.00 65535.00 FORMAT "%8.2" /end CHARACTERISTIC
/begin CHARACTERISTIC CDKLSUVM2 "" VALUE 0x1D3E2C KwUw 65535.00 dez 0.00 65535.00 FORMAT "%8.2" /end CHARACTERISTIC
/begin CHARACTERISTIC CDKLSV "Codewort Kunde:	Lambda-Sonde vor Kat" VALUE 0x1D3E2E KwUw 65535.00 dez 0.00 65535.00 FORMAT "%8.2" /end CHARACTERISTIC
/begin CHARACTERISTIC CDKLSV2 "Codewort Kunde:	Lambda-Sonde 2 vor Kat" VALUE 0x1D3E30 KwUw 65535.00 dez 0.00 65535.00 FORMAT "%8.2" /end CHARACTERISTIC
/begin CHARACTERISTIC CDKMD "Codewort Kunde: Aussetzer, Summenfehler (multiple)" VALUE 0x1D3E3E KwWU16 65535.00 dez 0.00 65535.00 FORMAT "%8.2" /end CHARACTERISTIC
/begin CHARACTERISTIC CDKMD00 "Codewort Kunde: Aussetzer Zyl. 0" VALUE 0x1D3E40 KwWU16 65535.00 dez 0.00 65535.00 FORMAT "%8.2" /end CHARACTERISTIC
/begin CHARACTERISTIC CDKMD01 "Codewort Kunde: Aussetzer Zyl. 1" VALUE 0x1D3E42 KwWU16 65535.00 dez 0.00 65535.00 FORMAT "%8.2" /end CHARACTERISTIC
/begin CHARACTERISTIC CDKMD02 "Codewort Kunde: Aussetzer Zylinder 2" VALUE 0x1D3E44 KwWU16 65535.00 dez 0.00 65535.00 FORMAT "%8.2" /end CHARACTERISTIC
/begin CHARACTERISTIC CDKMD03 "Codewort Kunde: Aussetzer Zylinder 3" VALUE 0x1D3E46 KwWU16 65535.00 dez 0.00 65535.00 FORMAT "%8.2" /end CHARACTERISTIC
/begin CHARACTERISTIC CDKMD04 "Codewort Kunde: Aussetzer Zylinder 4" VALUE 0x1D3E48 KwWU16 65535.00 dez 0.00 65535.00 FORMAT "%8.2" /end CHARACTERISTIC
/begin CHARACTERISTIC CDKMD05 "Codewort Kunde: Aussetzer Zylinder 5" VALUE 0x1D3E4A KwWU16 65535.00 dez 0.00 65535.00 FORMAT "%8.2" /end CHARACTERISTIC
/begin CHARACTERISTIC CDKMD06 "Codewort Kunde: Aussetzer Zylinder 6" VALUE 0x1D3E4C KwWU16 65535.00 dez 0.00 65535.00 FORMAT "%8.2" /end CHARACTERISTIC
/begin CHARACTERISTIC CDKMD07 "Codewort Kunde: Aussetzer Zylinder 7" VALUE 0x1D3E4E KwWU16 65535.00 dez 0.00 65535.00 FORMAT "%8.2" /end CHARACTERISTIC
/begin CHARACTERISTIC CDKMD08 "Codewort Kunde: Aussetzer Zylinder 8" VALUE 0x1D3E50 KwWU16 65535.00 dez 0.00 65535.00 FORMAT "%8.2" /end CHARACTERISTIC
/begin CHARACTERISTIC CDKMD09 "Codewort Kunde: Aussetzer Zylinder 9" VALUE 0x1D3E52 KwWU16 65535.00 dez 0.00 65535.00 FORMAT "%8.2" /end CHARACTERISTIC
/begin CHARACTERISTIC CDKMD10 "Codewort Kunde: Aussetzer Zylinder 10" VALUE 0x1D3E54 KwWU16 65535.00 dez 0.00 65535.00 FORMAT "%8.2" /end CHARACTERISTIC
/begin CHARACTERISTIC CDKMD11 "Codewort Kunde: Aussetzer Zylinder 11" VALUE 0x1D3E56 KwWU16 65535.00 dez 0.00 65535.00 FORMAT "%8.2" /end CHARACTERISTIC
/begin CHARACTERISTIC CDKRKAT "Codewort Kunde: LR- Adaption pro Zeit" VALUE 0x1D3E82 KwUw 65535.00 dez 0.00 65535.00 FORMAT "%8.2" /end CHARACTERISTIC
/begin CHARACTERISTIC CDKRKAT2 "Codewort Kunde: LR- Adaption pro Zeit Bank 2" VALUE 0x1D3E84 KwUw 65535.00 dez 0.00 65535.00 FORMAT "%8.2" /end CHARACTERISTIC
/begin CHARACTERISTIC CDKRKAZ "Codewort Kunde: LR- Adaption additiv pro Z¸ndung" VALUE 0x1D3E86 KwUw 65535.00 dez 0.00 65535.00 FORMAT "%8.2" /end CHARACTERISTIC
/begin CHARACTERISTIC CDKRKAZ2 "Codewort Kunde: Lambdaregelungsadaption Kraftstoff (Bank 2)" VALUE 0x1D3E88 KwUw 65535.00 dez 0.00 65535.00 FORMAT "%8.2" /end CHARACTERISTIC
/begin CHARACTERISTIC CDTFRAO "Codewort Tester: LR-Adaption multiplikativ obere Schwelle" VALUE 0x1D3F78 KwUw 65535.00 dez 0.00 65535.00 FORMAT "%8.2" /end CHARACTERISTIC
/begin CHARACTERISTIC CDTFRAO2 "Codewort Tester: LR-Adaption multiplikativ obere Schwelle Bank 2" VALUE 0x1D3F7A KwUw 65535.00 dez 0.00 65535.00 FORMAT "%8.2" /end CHARACTERISTIC
/begin CHARACTERISTIC CDTFRAU "Codewort Tester: LR-Adaption multiplikativ untere Schwelle" VALUE 0x1D3F7C KwUw 65535.00 dez 0.00 65535.00 FORMAT "%8.2" /end CHARACTERISTIC
/begin CHARACTERISTIC CDTFRAU2 "Codewort Tester: LR-Adaption multiplikativ untere Schwelle Bank 2" VALUE 0x1D3F7E KwUw 65535.00 dez 0.00 65535.00 FORMAT "%8.2" /end CHARACTERISTIC
/begin CHARACTERISTIC CDTFRST "Codewort Tester: LR-Abweichung" VALUE 0x1D3F80 KwUw 65535.00 dez 0.00 65535.00 FORMAT "%8.2" /end CHARACTERISTIC
/begin CHARACTERISTIC CDTFRST2 "Codewort Tester: LR-Abweichung Bank 2" VALUE 0x1D3F82 KwUw 65535.00 dez 0.00 65535.00 FORMAT "%8.2" /end CHARACTERISTIC
/begin CHARACTERISTIC CDTFST "Codewort Tester: Tankf¸llstand" VALUE 0x1D3F84 KwUw 65535.00 dez 0.00 65535.00 FORMAT "%8.2" /end CHARACTERISTIC
/begin CHARACTERISTIC CDTFST2 "" VALUE 0x1D3F86 KwUw 65535.00 dez 0.00 65535.00 FORMAT "%8.2" /end CHARACTERISTIC
/begin CHARACTERISTIC CDTHFM "" VALUE 0x1D3F88 KwUw 65535.00 dez 0.00 65535.00 FORMAT "%8.2" /end CHARACTERISTIC
/begin CHARACTERISTIC CDTHSH "Codewort Tester: Lambdasonden-Heizung hinter Katalysator" VALUE 0x1D3F8A KwUw 65535.00 dez 0.00 65535.00 FORMAT "%8.2" /end CHARACTERISTIC
/begin CHARACTERISTIC CDTHSH2 "Codewort Tester: Lambdasonden-Heizung hinter Kat., Bank 2" VALUE 0x1D3F8C KwUw 65535.00 dez 0.00 65535.00 FORMAT "%8.2" /end CHARACTERISTIC
/begin CHARACTERISTIC CDTHSV "Codewort Tester: Lambdasonden-Heizung vor Katalysator" VALUE 0x1D3F92 KwUw 65535.00 dez 0.00 65535.00 FORMAT "%8.2" /end CHARACTERISTIC
/begin CHARACTERISTIC CDTHSV2 "Codewort Tester: Lambdasonden-Heizung vor Kat., Bank 2" VALUE 0x1D3F94 KwUw 65535.00 dez 0.00 65535.00 FORMAT "%8.2" /end CHARACTERISTIC
/begin CHARACTERISTIC CDTHSVE "Codewort Tester: Lambdasonden-Heizung vor Kat. (Endst.)" VALUE 0x1D3F96 KwUw 65535.00 dez 0.00 65535.00 FORMAT "%8.2" /end CHARACTERISTIC
/begin CHARACTERISTIC CDTHSVE2 "Codewort Tester: Endstufe Lambdasonden-Heizung2 vor Katalysator" VALUE 0x1D3F98 KwUw 65535.00 dez 0.00 65535.00 FORMAT "%8.2" /end CHARACTERISTIC
/begin CHARACTERISTIC CDTICLSU "Codewort Tester: Auswerte-IC f¸r LSU" VALUE 0x1D3F9E KwUw 65535.00 dez 0.00 65535.00 FORMAT "%8.2" /end CHARACTERISTIC
/begin CHARACTERISTIC CDTICLSU2 "Codewort Tester: Auswerte-IC f¸r LSU, Bank 2" VALUE 0x1D3FA0 KwUw 65535.00 dez 0.00 65535.00 FORMAT "%8.2" /end CHARACTERISTIC
/begin CHARACTERISTIC CDTKAT "Codewort Tester: Katalysator-Konvertierung" VALUE 0x1D3FA2 KwWU16 65535.00 DEZ 0.00 65535.00 FORMAT "%8.2" /end CHARACTERISTIC
/begin CHARACTERISTIC CDTKAT2 "Codewort Tester: Katalysator-Konvertierung (Bank 2)" VALUE 0x1D3FA4 KwWU16 65535.00 dez 0.00 65535.00 FORMAT "%8.2" /end CHARACTERISTIC
/begin CHARACTERISTIC CDTKATSP "Codewort Tester: Katalysator-Konvertierung" VALUE 0x1D3FA6 KwWU16 65535.00 dez 0.00 65535.00 FORMAT "%8.2" /end CHARACTERISTIC
/begin CHARACTERISTIC CDTKATSP2 "Codewort Tester: Katalysator-Konvertierung (Bank 2)" VALUE 0x1D3FA8 KwWU16 65535.00 dez 0.00 65535.00 FORMAT "%8.2" /end CHARACTERISTIC
/begin CHARACTERISTIC CDTKRIC "Codewort Tester: Klopfregelung Klopfsensorauswerte-IC" VALUE 0x1D3FAE KwUw 65535.00 dez 0.00 65535.00 FORMAT "%8.2" /end CHARACTERISTIC
/begin CHARACTERISTIC CDTKRSPI "Codewort Tester: Klopfregelung SPI-‹berwachung" VALUE 0x1D3FB0 KwUw 65535.00 dez 0.00 65535.00 FORMAT "%8.2" /end CHARACTERISTIC
/begin CHARACTERISTIC CDTKS1 "Codewort Tester: Klopfsensor 1" VALUE 0x1D3FB2 KwWU16 65535.00 dez 0.00 65535.00 FORMAT "%8.2" /end CHARACTERISTIC
/begin CHARACTERISTIC CDTKS2 "Codewort Tester: Klopfsensor 2" VALUE 0x1D3FB4 KwWU16 65535.00 dez 0.00 65535.00 FORMAT "%8.2" /end CHARACTERISTIC
/begin CHARACTERISTIC CDTLASH "Codewort Tester: Lambda-Sondenalterung hinter Kat" VALUE 0x1D3FB8 KwUw 65535.00 dez 0.00 65535.00 FORMAT "%8.2" /end CHARACTERISTIC
/begin CHARACTERISTIC CDTLASH2 "Codewort Tester: Lambda-Sondenalterung hinter Kat. Bank2" VALUE 0x1D3FBA KwUw 65535.00 dez 0.00 65535.00 FORMAT "%8.2" /end CHARACTERISTIC
/begin CHARACTERISTIC CDTLBK "Codewort Tester: LBK" VALUE 0x1D3FBC KwUw 65535.00 dez 0.00 65535.00 FORMAT "%8.2" /end CHARACTERISTIC
/begin CHARACTERISTIC CDTLBKE "" VALUE 0x1D3FBE KwUw 65535.00 dez 0.00 65535.00 FORMAT "%8.2" /end CHARACTERISTIC
/begin CHARACTERISTIC CDTLBKO "Codewort Tester: LBK Offset-Adaption" VALUE 0x1D3FC0 KwUw 65535.00 dez 0.00 65535.00 FORMAT "%8.2" /end CHARACTERISTIC
/begin CHARACTERISTIC CDTLBKP "Codewort Tester: LBK Potentiometer" VALUE 0x1D3FC2 KwUw 65535.00 dez 0.00 65535.00 FORMAT "%8.2" /end CHARACTERISTIC
/begin CHARACTERISTIC CDTLLR "Codewort Tester: Leerlaufregelung am Anschlag" VALUE 0x1D3FCC KwUw 65535.00 dez 0.00 65535.00 FORMAT "%8.2" /end CHARACTERISTIC
/begin CHARACTERISTIC CDTLSH "Codewort Tester: Lambda-Sonde hinter Kat" VALUE 0x1D3FD0 KwUw 65535.00 dez 0.00 65535.00 FORMAT "%8.2" /end CHARACTERISTIC
/begin CHARACTERISTIC CDTLSH2 "Codewort Tester: Lambda-Sonde 2 hinter Kat" VALUE 0x1D3FD2 KwUw 65535.00 dez 0.00 65535.00 FORMAT "%8.2" /end CHARACTERISTIC
/begin CHARACTERISTIC CDTLSUIA "Codewort Tester: Diagnose Lambdasondenleitung an Bond IA" VALUE 0x1D3FD4 KwUw 65535.00 dez 0.00 65535.00 FORMAT "%8.2" /end CHARACTERISTIC
/begin CHARACTERISTIC CDTLSUIA2 "Codewort Tester: Diagnose Lambdasondenleitung an Bond IA, Bank 2" VALUE 0x1D3FD6 KwUw 65535.00 dez 0.00 65535.00 FORMAT "%8.2" /end CHARACTERISTIC
/begin CHARACTERISTIC CDTLSUUN "Codewort Tester: Diagnose Lambdasondenleitung an Bond UN" VALUE 0x1D3FD8 KwUw 65535.00 dez 0.00 65535.00 FORMAT "%8.2" /end CHARACTERISTIC
/begin CHARACTERISTIC CDTLSUUN2 "Codewort Tester: Diagnose Lambdasondenleitung an Bond UN, Bank 2" VALUE 0x1D3FDA KwUw 65535.00 dez 0.00 65535.00 FORMAT "%8.2" /end CHARACTERISTIC
/begin CHARACTERISTIC CDTLSUVM "Codewort Tester: Diagnose Lambdasondenleitung an Bond VM" VALUE 0x1D3FDC KwUw 65535.00 dez 0.00 65535.00 FORMAT "%8.2" /end CHARACTERISTIC
/begin CHARACTERISTIC CDTLSUVM2 "Codewort Tester: Diagnose Lambdasondenleitung an Bond VM, Bank 2" VALUE 0x1D3FDE KwUw 65535.00 dez 0.00 65535.00 FORMAT "%8.2" /end CHARACTERISTIC
/begin CHARACTERISTIC CDTLSV "Codewort Tester: Lambda-Sonde vor Kat" VALUE 0x1D3FE0 KwUw 65535.00 dez 0.00 65535.00 FORMAT "%8.2" /end CHARACTERISTIC
/begin CHARACTERISTIC CDTLSV2 "Codewort Tester: Lambda-Sonde 2 vor Kat" VALUE 0x1D3FE2 KwUw 65535.00 dez 0.00 65535.00 FORMAT "%8.2" /end CHARACTERISTIC
/begin CHARACTERISTIC CDTMD "Codewort Tester: Aussetzer, Summenfehler (multiple)" VALUE 0x1D3FF0 KwWU16 65535.00 dez 0.00 65535.00 FORMAT "%8.2" /end CHARACTERISTIC
/begin CHARACTERISTIC CDTMD00 "Codewort Tester: Aussetzer Zyl. 0" VALUE 0x1D3FF2 KwWU16 65535.00 dez 0.00 65535.00 FORMAT "%8.2" /end CHARACTERISTIC
/begin CHARACTERISTIC CDTMD01 "Codewort Tester: Aussetzer Zyl. 1" VALUE 0x1D3FF4 KwWU16 65535.00 dez 0.00 65535.00 FORMAT "%8.2" /end CHARACTERISTIC
/begin CHARACTERISTIC CDTMD02 "Codewort Tester: Aussetzer Zylinder 2" VALUE 0x1D3FF6 KwWU16 65535.00 dez 0.00 65535.00 FORMAT "%8.2" /end CHARACTERISTIC
/begin CHARACTERISTIC CDTMD03 "Codewort Tester: Aussetzer Zylinder 3" VALUE 0x1D3FF8 KwWU16 65535.00 dez 0.00 65535.00 FORMAT "%8.2" /end CHARACTERISTIC
/begin CHARACTERISTIC CDTMD04 "Codewort Tester: Aussetzer Zylinder 4" VALUE 0x1D3FFA KwWU16 65535.00 dez 0.00 65535.00 FORMAT "%8.2" /end CHARACTERISTIC
/begin CHARACTERISTIC CDTMD05 "Codewort Tester: Aussetzer Zylinder 5" VALUE 0x1D3FFC KwWU16 65535.00 dez 0.00 65535.00 FORMAT "%8.2" /end CHARACTERISTIC
/begin CHARACTERISTIC CDTMD06 "Codewort Tester: Aussetzer Zylinder 6" VALUE 0x1D3FFE KwWU16 65535.00 dez 0.00 65535.00 FORMAT "%8.2" /end CHARACTERISTIC
/begin CHARACTERISTIC CDTMD07 "Codewort Tester: Aussetzer Zylinder 7" VALUE 0x1D4000 KwWU16 65535.00 dez 0.00 65535.00 FORMAT "%8.2" /end CHARACTERISTIC
/begin CHARACTERISTIC CDTMD08 "Codewort Tester: Aussetzer Zylinder 8" VALUE 0x1D4002 KwWU16 65535.00 dez 0.00 65535.00 FORMAT "%8.2" /end CHARACTERISTIC
/begin CHARACTERISTIC CDTMD09 "Codewort Tester: Aussetzer Zylinder 9" VALUE 0x1D4004 KwWU16 65535.00 dez 0.00 65535.00 FORMAT "%8.2" /end CHARACTERISTIC
/begin CHARACTERISTIC CDTMD10 "Codewort Tester: Aussetzer Zylinder 10" VALUE 0x1D4006 KwWU16 65535.00 dez 0.00 65535.00 FORMAT "%8.2" /end CHARACTERISTIC
/begin CHARACTERISTIC CDTMD11 "Codewort Tester: Aussetzer Zylinder 11" VALUE 0x1D4008 KwWU16 65535.00 dez 0.00 65535.00 FORMAT "%8.2" /end CHARACTERISTIC
/begin CHARACTERISTIC CDTRKAT "Codewort Tester: LR-Adaption additiv pro Zeit" VALUE 0x1D4034 KwUw 65535.00 dez 0.00 65535.00 FORMAT "%8.2" /end CHARACTERISTIC
/begin CHARACTERISTIC CDTRKAT2 "Codewort Tester: LR-Adaption additiv pro Zeit bank 2" VALUE 0x1D4036 KwUw 65535.00 dez 0.00 65535.00 FORMAT "%8.2" /end CHARACTERISTIC
/begin CHARACTERISTIC CDTRKAZ "Codewort Tester: LR-Adaption additiv pro Z¸ndung" VALUE 0x1D4038 KwUw 65535.00 dez 0.00 65535.00 FORMAT "%8.2" /end CHARACTERISTIC
/begin CHARACTERISTIC CDTRKAZ2 "Codewort Tester: LR-Adaption additiv pro Z¸ndung bank 2" VALUE 0x1D403A KwUw 65535.00 dez 0.00 65535.00 FORMAT "%8.2" /end CHARACTERISTIC
/begin CHARACTERISTIC CLAFRAO "Fehlerklasse: LR-Adaption oberer Bereich" VALUE 0x1D3199 KwUb 255.0 dez 0.00 255.0 FORMAT "%5.1" /end CHARACTERISTIC
/begin CHARACTERISTIC CLAFRAO2 "Fehlerklasse: LR-Adaption oberer Bereich Bank 2" VALUE 0x1D319A KwUb 255.0 dez 0.00 255.0 FORMAT "%5.1" /end CHARACTERISTIC
/begin CHARACTERISTIC CLAFRAU "Fehlerklasse: LR-Adaption unterer Bereich" VALUE 0x1D319B KwUb 255.0 dez 0.00 255.0 FORMAT "%5.1" /end CHARACTERISTIC
/begin CHARACTERISTIC CLAFRAU2 "Fehlerklasse: LR-Adaption unterer Bereich Bank 2" VALUE 0x1D319C KwUb 255.0 dez 0.00 255.0 FORMAT "%5.1" /end CHARACTERISTIC
/begin CHARACTERISTIC CLAFRST "Fehlerklasse: LR-Abweichung" VALUE 0x1D319D KwUb 255.0 dez 0.00 255.0 FORMAT "%5.1" /end CHARACTERISTIC
/begin CHARACTERISTIC CLAFRST2 "Fehlerklasse : LR-Abweichung Bank 2" VALUE 0x1D319E KwUb 255.0 dez 0.00 255.0 FORMAT "%5.1" /end CHARACTERISTIC
/begin CHARACTERISTIC CLAFST "Fehlerklasse: Tankf¸llstandssensor" VALUE 0x1D319F KwUb 255.0 dez 0.00 255.0 FORMAT "%5.1" /end CHARACTERISTIC
/begin CHARACTERISTIC CLAFST2 "" VALUE 0x1D31A0 KwUb 255.0 dez 0.00 255.0 FORMAT "%5.1" /end CHARACTERISTIC
/begin CHARACTERISTIC CLAHFM "" VALUE 0x1D31A1 KwUb 255.0 dez 0.00 255.0 FORMAT "%5.1" /end CHARACTERISTIC
/begin CHARACTERISTIC CLAHSH "Fehlerklasse: Heizung Lambdasonde hinter Kat" VALUE 0x1D31A2 KwUb 255.0 dez 0.00 255.0 FORMAT "%5.1" /end CHARACTERISTIC
/begin CHARACTERISTIC CLAHSH2 "Fehlerklasse: Heizung Lambdasonde 2 hinter Kat" VALUE 0x1D31A3 KwUb 255.0 dez 0.00 255.0 FORMAT "%5.1" /end CHARACTERISTIC
/begin CHARACTERISTIC CLAHSV "Fehlerklasse: Heizung Lambdasonde vor Kat" VALUE 0x1D31A6 KwUb 255.0 dez 0.00 255.0 FORMAT "%5.1" /end CHARACTERISTIC
/begin CHARACTERISTIC CLAHSV2 "Fehlerklasse: Heizung Lambdasonde 2 vor Kat" VALUE 0x1D31A7 KwUb 255.0 dez 0.00 255.0 FORMAT "%5.1" /end CHARACTERISTIC
/begin CHARACTERISTIC CLAHSVE "Fehlerklasse: Endstufe Heizung Lambdasonde vor Kat" VALUE 0x1D31A8 KwUb 255.0 dez 0.00 255.0 FORMAT "%5.1" /end CHARACTERISTIC
/begin CHARACTERISTIC CLAHSVE2 "Fehlerklasse: Endstufe Heizung Lambdasonde 2 vor Kat" VALUE 0x1D31A9 KwUb 255.0 dez 0.00 255.0 FORMAT "%5.1" /end CHARACTERISTIC
/begin CHARACTERISTIC CLAICLSU "Fehlerklasse: Auswerte-IC f¸r LSU" VALUE 0x1D31AC KwUb 255.0 dez 0.00 255.0 FORMAT "%5.1" /end CHARACTERISTIC
/begin CHARACTERISTIC CLAICLSU2 "Fehlerklasse: Auswerte-IC f¸r LSU, Bank 2" VALUE 0x1D31AD KwUb 255.0 dez 0.00 255.0 FORMAT "%5.1" /end CHARACTERISTIC
/begin CHARACTERISTIC CLAKAT "Fehlerklasse: Katalysator" VALUE 0x1D31AE KwWU8 255.0 dez 0.00 255.0 FORMAT "%5.1" /end CHARACTERISTIC
/begin CHARACTERISTIC CLAKAT2 "Fehlerklasse: Katalysator Bank 2" VALUE 0x1D31AF KwWU8 255.0 dez 0.00 255.0 FORMAT "%5.1" /end CHARACTERISTIC
/begin CHARACTERISTIC CLAKATSP "Fehlerklasse: Katalysator" VALUE 0x1D31B0 KwWU8 255.0 dez 0.00 255.0 FORMAT "%5.1" /end CHARACTERISTIC
/begin CHARACTERISTIC CLAKATSP2 "Fehlerklasse: Katalysator Bank 2" VALUE 0x1D31B1 KwWU8 255.0 dez 0.00 255.0 FORMAT "%5.1" /end CHARACTERISTIC
/begin CHARACTERISTIC CLAKRIC "Fehlerklasse: Klopfregelung Klopfsensorauswerte-IC" VALUE 0x1D31B4 KwUb 255.0 dez 0.00 255.0 FORMAT "%5.1" /end CHARACTERISTIC
/begin CHARACTERISTIC CLAKRSPI "Fehlerklasse: Klopfregelung SPI-‹berwachung" VALUE 0x1D31B5 KwUb 255.0 dez 0.00 255.0 FORMAT "%5.1" /end CHARACTERISTIC
/begin CHARACTERISTIC CLAKS1 "Fehlerklasse: Klopfsensor 1" VALUE 0x1D31B6 KwWU8 255.0 dez 0.00 255.0 FORMAT "%5.1" /end CHARACTERISTIC
/begin CHARACTERISTIC CLAKS2 "Fehlerklasse: Klopfsensor 2" VALUE 0x1D31B7 KwWU8 255.0 dez 0.00 255.0 FORMAT "%5.1" /end CHARACTERISTIC
/begin CHARACTERISTIC CLALASH "Fehlerklasse: Lambdasondenalterung hinter Kat" VALUE 0x1D31B9 KwUb 255.0 dez 0.00 255.0 FORMAT "%5.1" /end CHARACTERISTIC
/begin CHARACTERISTIC CLALASH2 "Fehlerklasse: Lambdasondenalterung hinter Kat Bank2" VALUE 0x1D31BA KwUb 255.0 dez 0.00 255.0 FORMAT "%5.1" /end CHARACTERISTIC
/begin CHARACTERISTIC CLALBK "Fehlerklasse: LBK" VALUE 0x1D31BB KwUb 255.0 dez 0.00 255.0 FORMAT "%5.1" /end CHARACTERISTIC
/begin CHARACTERISTIC CLALBKE "" VALUE 0x1D31BC KwUb 255.0 dez 0.00 255.0 FORMAT "%5.1" /end CHARACTERISTIC
/begin CHARACTERISTIC CLALBKO "Fehlerklasse: LBK Offset-Adaption" VALUE 0x1D31BD KwUb 255.0 dez 0.00 255.0 FORMAT "%5.1" /end CHARACTERISTIC
/begin CHARACTERISTIC CLALBKP "Fehlerklasse: LBK Potentiometer" VALUE 0x1D31BE KwUb 255.0 dez 0.00 255.0 FORMAT "%5.1" /end CHARACTERISTIC
/begin CHARACTERISTIC CLALLR "Fehlerklasse: Leerlaufregelung" VALUE 0x1D31C3 KwUb 255.0 dez 0.00 255.0 FORMAT "%5.1" /end CHARACTERISTIC
/begin CHARACTERISTIC CLALSH "Fehlerklasse: Lambdasonde hinter Kat" VALUE 0x1D31C5 KwUb 255.0 dez 0.00 255.0 FORMAT "%5.1" /end CHARACTERISTIC
/begin CHARACTERISTIC CLALSH2 "Fehlerklasse: Lambdasonde 2 hinter Kat" VALUE 0x1D31C6 KwUb 255.0 dez 0.00 255.0 FORMAT "%5.1" /end CHARACTERISTIC
/begin CHARACTERISTIC CLALSUIA "Fehlerklasse: Diagnose Lambdasondenleitung an Bond IA" VALUE 0x1D31C7 KwUb 255.0 dez 0.00 255.0 FORMAT "%5.1" /end CHARACTERISTIC
/begin CHARACTERISTIC CLALSUIA2 "Fehlerklasse: Diagnose Lambdasondenleitung an Bond IA, Bank 2" VALUE 0x1D31C8 KwUb 255.0 dez 0.00 255.0 FORMAT "%5.1" /end CHARACTERISTIC
/begin CHARACTERISTIC CLALSUUN "Fehlerklasse: Diagnose Lambdasondenleitung an Bond UN" VALUE 0x1D31C9 KwUb 255.0 dez 0.00 255.0 FORMAT "%5.1" /end CHARACTERISTIC
/begin CHARACTERISTIC CLALSUUN2 "Fehlerklasse: Diagnose Lambdasondenleitung an Bond UN, Bank 2" VALUE 0x1D31CA KwUb 255.0 dez 0.00 255.0 FORMAT "%5.1" /end CHARACTERISTIC
/begin CHARACTERISTIC CLALSUVM "Fehlerklasse: Diagnose Lambdasondenleitung an Bond VM" VALUE 0x1D31CB KwUb 255.0 dez 0.00 255.0 FORMAT "%5.1" /end CHARACTERISTIC
/begin CHARACTERISTIC CLALSUVM2 "Fehlerklasse: Diagnose Lambdasondenleitung an Bond VM, Bank 2" VALUE 0x1D31CC KwUb 255.0 dez 0.00 255.0 FORMAT "%5.1" /end CHARACTERISTIC
/begin CHARACTERISTIC CLALSV "Fehlerklasse: Lambdasonde vor Kat" VALUE 0x1D31CD KwUb 255.0 dez 0.00 255.0 FORMAT "%5.1" /end CHARACTERISTIC
/begin CHARACTERISTIC CLALSV2 "Fehlerklasse: Lambdasonde 2 vor Kat" VALUE 0x1D31CE KwUb 255.0 dez 0.00 255.0 FORMAT "%5.1" /end CHARACTERISTIC
/begin CHARACTERISTIC CLAMD "Fehlerklasse:  Aussetzer, Summenfehler (multiple)" VALUE 0x1D31D5 KwWU8 255.0 dez 0.00 255.0 FORMAT "%5.1" /end CHARACTERISTIC
/begin CHARACTERISTIC CLAMD00 "Fehlerklasse:  Aussetzer Zyl. 0" VALUE 0x1D31D6 KwWU8 255.0 dez 0.00 255.0 FORMAT "%5.1" /end CHARACTERISTIC
/begin CHARACTERISTIC CLAMD01 "Fehlerklasse:  Aussetzer Zyl. 1" VALUE 0x1D31D7 KwWU8 255.0 dez 0.00 255.0 FORMAT "%5.1" /end CHARACTERISTIC
/begin CHARACTERISTIC CLAMD02 "Fehlerklasse:  Aussetzer Zylinder 2" VALUE 0x1D31D8 KwWU8 255.0 dez 0.00 255.0 FORMAT "%5.1" /end CHARACTERISTIC
/begin CHARACTERISTIC CLAMD03 "Fehlerklasse:  Aussetzer Zylinder 3" VALUE 0x1D31D9 KwWU8 255.0 dez 0.00 255.0 FORMAT "%5.1" /end CHARACTERISTIC
/begin CHARACTERISTIC CLAMD04 "Fehlerklasse:  Aussetzer Zylinder 4" VALUE 0x1D31DA KwWU8 255.0 dez 0.00 255.0 FORMAT "%5.1" /end CHARACTERISTIC
/begin CHARACTERISTIC CLAMD05 "Fehlerklasse:  Aussetzer Zylinder 5" VALUE 0x1D31DB KwWU8 255.0 dez 0.00 255.0 FORMAT "%5.1" /end CHARACTERISTIC
/begin CHARACTERISTIC CLAMD06 "Fehlerklasse:  Aussetzer Zylinder 6" VALUE 0x1D31DC KwWU8 255.0 dez 0.00 255.0 FORMAT "%5.1" /end CHARACTERISTIC
/begin CHARACTERISTIC CLAMD07 "Fehlerklasse:  Aussetzer Zylinder 7" VALUE 0x1D31DD KwWU8 255.0 dez 0.00 255.0 FORMAT "%5.1" /end CHARACTERISTIC
/begin CHARACTERISTIC CLAMD08 "Fehlerklasse:  Aussetzer Zylinder 8" VALUE 0x1D31DE KwWU8 255.0 dez 0.00 255.0 FORMAT "%5.1" /end CHARACTERISTIC
/begin CHARACTERISTIC CLAMD09 "Fehlerklasse:  Aussetzer Zylinder 9" VALUE 0x1D31DF KwWU8 255.0 dez 0.00 255.0 FORMAT "%5.1" /end CHARACTERISTIC
/begin CHARACTERISTIC CLAMD10 "Fehlerklasse:  Aussetzer Zylinder 10" VALUE 0x1D31E0 KwWU8 255.0 dez 0.00 255.0 FORMAT "%5.1" /end CHARACTERISTIC
/begin CHARACTERISTIC CLAMD11 "Fehlerklasse:  Aussetzer Zylinder 11" VALUE 0x1D31E1 KwWU8 255.0 dez 0.00 255.0 FORMAT "%5.1" /end CHARACTERISTIC
/begin CHARACTERISTIC CLARKAT "Fehlerklasse: LR-Adaption additiver Bereich pro Zeit" VALUE 0x1D31F7 KwUb 255.0 dez 0.00 255.0 FORMAT "%5.1" /end CHARACTERISTIC
/begin CHARACTERISTIC CLARKAT2 "Fehlerklasse: LR-Adaption additiver Bereich pro Zeit Bank 2" VALUE 0x1D31F8 KwUb 255.0 dez 0.00 255.0 FORMAT "%5.1" /end CHARACTERISTIC
/begin CHARACTERISTIC CLARKAZ "Fehlerklasse: LR-Adaption additiver Bereich pro Z¸ndung" VALUE 0x1D31F9 KwUb 255.0 dez 0.00 255.0 FORMAT "%5.1" /end CHARACTERISTIC
/begin CHARACTERISTIC CLARKAZ2 "Fehlerklasse: LR-Adaption additiver Bereich pro Z¸ndung Bank 2" VALUE 0x1D31FA KwUb 255.0 dez 0.00 255.0 FORMAT "%5.1" /end CHARACTERISTIC
/begin CHARACTERISTIC FFTFRAO "Freeze Frame Tabelle: FRAO Gemischadaption" VAL_BLK 0x1D3358 KwbUb 255.0 dez 0.00 255.0 FORMAT "%5.1" NUMBER 4 /end CHARACTERISTIC
/begin CHARACTERISTIC FFTFRAO2 "Freeze Frame Tabelle: FRAO Gemischadaption Bank 2" VAL_BLK 0x1D335C KwbUb 255.0 dez 0.00 255.0 FORMAT "%5.1" NUMBER 4 /end CHARACTERISTIC
/begin CHARACTERISTIC FFTFRAU "Freeze Frame Tabelle: FRAU Gemischadaption" VAL_BLK 0x1D3360 KwbUb 255.0 dez 0.00 255.0 FORMAT "%5.1" NUMBER 4 /end CHARACTERISTIC
/begin CHARACTERISTIC FFTFRAU2 "Freeze Frame Tabelle: FRAU Gemischadaption Bank 2" VAL_BLK 0x1D3364 KwbUb 255.0 dez 0.00 255.0 FORMAT "%5.1" NUMBER 4 /end CHARACTERISTIC
/begin CHARACTERISTIC FFTFRST "Freeze Frame Tabelle: LR-Abweichung" VAL_BLK 0x1D3368 KwbUb 255.0 dez 0.00 255.0 FORMAT "%5.1" NUMBER 4 /end CHARACTERISTIC
/begin CHARACTERISTIC FFTFRST2 "Freeze Frame Tabelle: LR-Abweichung Bank 2" VAL_BLK 0x1D336C KwbUb 255.0 dez 0.00 255.0 FORMAT "%5.1" NUMBER 4 /end CHARACTERISTIC
/begin CHARACTERISTIC FFTFST "Freeze Frame Tabelle: Tankf¸llstand" VAL_BLK 0x1D3370 KwbUb 255.0 dez 0.00 255.0 FORMAT "%5.1" NUMBER 4 /end CHARACTERISTIC
/begin CHARACTERISTIC FFTFST2 "" VAL_BLK 0x1D3374 KwbUb 255.0 dez 0.00 255.0 FORMAT "%5.1" NUMBER 4 /end CHARACTERISTIC
/begin CHARACTERISTIC FFTHFM "" VAL_BLK 0x1D3378 KwbUb 255.0 dez 0.00 255.0 FORMAT "%5.1" NUMBER 4 /end CHARACTERISTIC
/begin CHARACTERISTIC FFTHSH "Tabelle Umweltbedingungen Heizung Lambdasonde hinter Kat" VAL_BLK 0x1D337C KwbUb 255.0 dez 0.00 255.0 FORMAT "%5.1" NUMBER 4 /end CHARACTERISTIC
/begin CHARACTERISTIC FFTHSH2 "Tabelle Umweltbedingungen Heizung Lambdasonde hinter Kat Bank2" VAL_BLK 0x1D3380 KwbUb 255.0 dez 0.00 255.0 FORMAT "%5.1" NUMBER 4 /end CHARACTERISTIC
/begin CHARACTERISTIC FFTHSV "Tabelle Umweltbedingungen Heizung Lambdasonde vor Kat" VAL_BLK 0x1D338C KwbUb 255.0 dez 0.00 255.0 FORMAT "%5.1" NUMBER 4 /end CHARACTERISTIC
/begin CHARACTERISTIC FFTHSV2 "Tabelle Umweltbedingungen Heizung Lambdasonde vor Kat Bank2" VAL_BLK 0x1D3390 KwbUb 255.0 dez 0.00 255.0 FORMAT "%5.1" NUMBER 4 /end CHARACTERISTIC
/begin CHARACTERISTIC FFTHSVE "Tabelle Umweltbedingungen Endstufe Heizung Lambdasonde vor Kat" VAL_BLK 0x1D3394 KwbUb 255.0 dez 0.00 255.0 FORMAT "%5.1" NUMBER 4 /end CHARACTERISTIC
/begin CHARACTERISTIC FFTHSVE2 "Freeze Frame Tabelle: Endstufe Heizung Lambdasonde 2 vor Kat." VAL_BLK 0x1D3398 KwbUb 255.0 dez 0.00 255.0 FORMAT "%5.1" NUMBER 4 /end CHARACTERISTIC
/begin CHARACTERISTIC FFTICLSU "Tabelle Umweltbedingungen: Auswerte-IC f¸r LSU" VAL_BLK 0x1D33A4 KwbUb 255.0 dez 0.00 255.0 FORMAT "%5.1" NUMBER 4 /end CHARACTERISTIC
/begin CHARACTERISTIC FFTICLSU2 "Tabelle Umweltbedingungen: Auswerte-IC f¸r LSU, Bank 2" VAL_BLK 0x1D33A8 KwbUb 255.0 dez 0.00 255.0 FORMAT "%5.1" NUMBER 4 /end CHARACTERISTIC
/begin CHARACTERISTIC FFTKAT "Freeze Frame Tabelle: Katalysator" VAL_BLK 0x1D33AC KwbWU8 255.0 dez 0.00 255.0 FORMAT "%5.1" NUMBER 4 /end CHARACTERISTIC
/begin CHARACTERISTIC FFTKAT2 "Freeze Frame Tabelle: Katalysator" VAL_BLK 0x1D33B0 KwbWU8 255.0 dez 0.00 255.0 FORMAT "%5.1" NUMBER 4 /end CHARACTERISTIC
/begin CHARACTERISTIC FFTKATSP "Freeze Frame Tabelle: Katalysator" VAL_BLK 0x1D33B4 KwbWU8 255.0 dez 0.00 255.0 FORMAT "%5.1" NUMBER 4 /end CHARACTERISTIC
/begin CHARACTERISTIC FFTKATSP2 "Freeze Frame Tabelle: Katalysator, Bank2" VAL_BLK 0x1D33B8 KwbWU8 255.0 dez 0.00 255.0 FORMAT "%5.1" NUMBER 4 /end CHARACTERISTIC
/begin CHARACTERISTIC FFTKRIC "Freeze Frame Tabelle: Klopfregelung Klopfsensorauswerte-IC" VAL_BLK 0x1D33C4 KwbUb 255.0 dez 0.00 255.0 FORMAT "%5.1" NUMBER 4 /end CHARACTERISTIC
/begin CHARACTERISTIC FFTKRSPI "Freeze Frame Tabelle: Klopfregelung SPI-‹berwachung" VAL_BLK 0x1D33C8 KwbUb 255.0 dez 0.00 255.0 FORMAT "%5.1" NUMBER 4 /end CHARACTERISTIC
/begin CHARACTERISTIC FFTKS1 "Freeze Frame Tabelle: Klopfsensor 1" VAL_BLK 0x1D33CC KwbWU8 255.0 dez 0.00 255.0 FORMAT "%5.1" NUMBER 4 /end CHARACTERISTIC
/begin CHARACTERISTIC FFTKS2 "Freeze Frame Tabelle: Klopfsensor 2" VAL_BLK 0x1D33D0 KwbWU8 255.0 dez 0.00 255.0 FORMAT "%5.1" NUMBER 4 /end CHARACTERISTIC
/begin CHARACTERISTIC FFTLASH "Tabelle Umweltbedingungen Lambdasonde hinter Kat" VAL_BLK 0x1D33D8 KwbUb 255.0 dez 0.00 255.0 FORMAT "%5.1" NUMBER 4 /end CHARACTERISTIC
/begin CHARACTERISTIC FFTLASH2 "Tabelle Umweltbedingungen Lambdasonde hinter Kat Bank2" VAL_BLK 0x1D33DC KwbUb 255.0 dez 0.00 255.0 FORMAT "%5.1" NUMBER 4 /end CHARACTERISTIC
/begin CHARACTERISTIC FFTLBK "Freeze Frame Tabelle: LBK" VAL_BLK 0x1D33E0 KwbUb 255.0 dez 0.00 255.0 FORMAT "%5.1" NUMBER 4 /end CHARACTERISTIC
/begin CHARACTERISTIC FFTLBKE "" VAL_BLK 0x1D33E4 KwbUb 255.0 dez 0.00 255.0 FORMAT "%5.1" NUMBER 4 /end CHARACTERISTIC
/begin CHARACTERISTIC FFTLBKO "Freeze Frame Tabelle: LBK Offset-Adaption" VAL_BLK 0x1D33E8 KwbUb 255.0 dez 0.00 255.0 FORMAT "%5.1" NUMBER 4 /end CHARACTERISTIC
/begin CHARACTERISTIC FFTLBKP "Freeze Frame Tabelle: LBK Potentiometer" VAL_BLK 0x1D33EC KwbUb 255.0 dez 0.00 255.0 FORMAT "%5.1" NUMBER 4 /end CHARACTERISTIC
/begin CHARACTERISTIC FFTLLR "Freeze Frame Tabelle: Leerlaufregelung" VAL_BLK 0x1D3400 KwbUb 255.0 dez 0.00 255.0 FORMAT "%5.1" NUMBER 4 /end CHARACTERISTIC
/begin CHARACTERISTIC FFTLSH "Tabelle Umweltbedingungen Lambdasonde hinter Kat" VAL_BLK 0x1D3408 KwbUb 255.0 dez 0.00 255.0 FORMAT "%5.1" NUMBER 4 /end CHARACTERISTIC
/begin CHARACTERISTIC FFTLSH2 "Tabelle Umweltbedingungen Lambdasonde hinter Kat Bank 2" VAL_BLK 0x1D340C KwbUb 255.0 dez 0.00 255.0 FORMAT "%5.1" NUMBER 4 /end CHARACTERISTIC
/begin CHARACTERISTIC FFTLSUIA "Tabelle Umweltbedingungen: Diagnose Lambdasondenleitung an Bond IA" VAL_BLK 0x1D3410 KwbUb 255.0 dez 0.00 255.0 FORMAT "%5.1" NUMBER 4 /end CHARACTERISTIC
/begin CHARACTERISTIC FFTLSUIA2 "Tabelle Umweltbedingungen: Diagnose Lambdasondenleitung an Bond IA, Bank 2" VAL_BLK 0x1D3414 KwbUb 255.0 dez 0.00 255.0 FORMAT "%5.1" NUMBER 4 /end CHARACTERISTIC
/begin CHARACTERISTIC FFTLSUUN "Tabelle Umweltbedingungen: Diagnose Lambdasondenleitung an Bond UN" VAL_BLK 0x1D3418 KwbUb 255.0 dez 0.00 255.0 FORMAT "%5.1" NUMBER 4 /end CHARACTERISTIC
/begin CHARACTERISTIC FFTLSUUN2 "Tabelle Umweltbedingungen: Diagnose Lambdasondenleitung an Bond UN, Bank 2" VAL_BLK 0x1D341C KwbUb 255.0 dez 0.00 255.0 FORMAT "%5.1" NUMBER 4 /end CHARACTERISTIC
/begin CHARACTERISTIC FFTLSUVM "Tabelle Umweltbedingungen: Diagnose Lambdasondenleitung an Bond VM" VAL_BLK 0x1D3420 KwbUb 255.0 dez 0.00 255.0 FORMAT "%5.1" NUMBER 4 /end CHARACTERISTIC
/begin CHARACTERISTIC FFTLSUVM2 "Tabelle Umweltbedingungen: Diagnose Lambdasondenleitung an Bond VM, Bank 2" VAL_BLK 0x1D3424 KwbUb 255.0 dez 0.00 255.0 FORMAT "%5.1" NUMBER 4 /end CHARACTERISTIC
/begin CHARACTERISTIC FFTLSV "Tabelle Umweltbedingungen: Lambdasonde vor Kat" VAL_BLK 0x1D3428 KwbUb 255.0 dez 0.00 255.0 FORMAT "%5.1" NUMBER 4 /end CHARACTERISTIC
/begin CHARACTERISTIC FFTLSV2 "Tabelle Umweltbedingungen: Lambdasonde vor Kat Bank2" VAL_BLK 0x1D342C KwbUb 255.0 dez 0.00 255.0 FORMAT "%5.1" NUMBER 4 /end CHARACTERISTIC
/begin CHARACTERISTIC FFTMD "Freeze Frame Tabelle: Aussetzer, Summenfehler (multiple)" VAL_BLK 0x1D3448 KwbWU8 255.0 dez 0.00 255.0 FORMAT "%5.1" NUMBER 4 /end CHARACTERISTIC
/begin CHARACTERISTIC FFTMD00 "Freeze Frame Tabelle: Aussetzer Zyl. 0" VAL_BLK 0x1D344C KwbWU8 255.0 dez 0.00 255.0 FORMAT "%5.1" NUMBER 4 /end CHARACTERISTIC
/begin CHARACTERISTIC FFTMD01 "Freeze Frame Tabelle: Aussetzer Zyl. 1" VAL_BLK 0x1D3450 KwbWU8 255.0 dez 0.00 255.0 FORMAT "%5.1" NUMBER 4 /end CHARACTERISTIC
/begin CHARACTERISTIC FFTMD02 "Freeze Frame Tabelle: Aussetzer Zylinder 2" VAL_BLK 0x1D3454 KwbWU8 255.0 dez 0.00 255.0 FORMAT "%5.1" NUMBER 4 /end CHARACTERISTIC
/begin CHARACTERISTIC FFTMD03 "Freeze Frame Tabelle: Aussetzer Zylinder 3" VAL_BLK 0x1D3458 KwbWU8 255.0 dez 0.00 255.0 FORMAT "%5.1" NUMBER 4 /end CHARACTERISTIC
/begin CHARACTERISTIC FFTMD04 "Freeze Frame Tabelle: Aussetzer Zylinder 4" VAL_BLK 0x1D345C KwbWU8 255.0 dez 0.00 255.0 FORMAT "%5.1" NUMBER 4 /end CHARACTERISTIC
/begin CHARACTERISTIC FFTMD05 "Freeze Frame Tabelle: Aussetzer Zylinder 5" VAL_BLK 0x1D3460 KwbWU8 255.0 dez 0.00 255.0 FORMAT "%5.1" NUMBER 4 /end CHARACTERISTIC
/begin CHARACTERISTIC FFTMD06 "Freeze Frame Tabelle: Aussetzer Zylinder 6" VAL_BLK 0x1D3464 KwbWU8 255.0 dez 0.00 255.0 FORMAT "%5.1" NUMBER 4 /end CHARACTERISTIC
/begin CHARACTERISTIC FFTMD07 "Freeze Frame Tabelle: Aussetzer Zylinder 7" VAL_BLK 0x1D3468 KwbWU8 255.0 dez 0.00 255.0 FORMAT "%5.1" NUMBER 4 /end CHARACTERISTIC
/begin CHARACTERISTIC FFTMD08 "Freeze Frame Tabelle: Aussetzer Zylinder 8" VAL_BLK 0x1D346C KwbWU8 255.0 dez 0.00 255.0 FORMAT "%5.1" NUMBER 4 /end CHARACTERISTIC
/begin CHARACTERISTIC FFTMD09 "Freeze Frame Tabelle: Aussetzer Zylinder 9" VAL_BLK 0x1D3470 KwbWU8 255.0 dez 0.00 255.0 FORMAT "%5.1" NUMBER 4 /end CHARACTERISTIC
/begin CHARACTERISTIC FFTMD10 "Freeze Frame Tabelle: Aussetzer Zylinder 10" VAL_BLK 0x1D3474 KwbWU8 255.0 dez 0.00 255.0 FORMAT "%5.1" NUMBER 4 /end CHARACTERISTIC
/begin CHARACTERISTIC FFTMD11 "Freeze Frame Tabelle: Aussetzer Zylinder 11" VAL_BLK 0x1D3478 KwbWU8 255.0 dez 0.00 255.0 FORMAT "%5.1" NUMBER 4 /end CHARACTERISTIC
/begin CHARACTERISTIC FFTRKAT "Freeze Frame Tabelle: RKAT Gemischadaption" VAL_BLK 0x1D34D0 KwbUb 255.0 dez 0.00 255.0 FORMAT "%5.1" NUMBER 4 /end CHARACTERISTIC
/begin CHARACTERISTIC FFTRKAT2 "Freeze Frame Tabelle: RKAT Gemischadaption Bank 2" VAL_BLK 0x1D34D4 KwbUb 255.0 dez 0.00 255.0 FORMAT "%5.1" NUMBER 4 /end CHARACTERISTIC
/begin CHARACTERISTIC FFTRKAZ "Freeze Frame Tabelle: RKAZ Gemischadaption" VAL_BLK 0x1D34D8 KwbUb 255.0 dez 0.00 255.0 FORMAT "%5.1" NUMBER 4 /end CHARACTERISTIC
/begin CHARACTERISTIC FFTRKAZ2 "Freeze Frame Tabelle: RKAZ Gemischadaption Bank 2" VAL_BLK 0x1D34DC KwbUb 255.0 dez 0.00 255.0 FORMAT "%5.1" NUMBER 4 /end CHARACTERISTIC
/begin CHARACTERISTIC TSFFRAO "Fehlersummenzeit: LR-Adaption oberer Bereich" VALUE 0x1D35D8 KwUb 255.0 dez 0.00 255.0 FORMAT "%5.1" /end CHARACTERISTIC
/begin CHARACTERISTIC TSFFRAO2 "Fehlersummenzeit: LR-Adaption oberer Bereich Bank 2" VALUE 0x1D35D9 KwUb 255.0 dez 0.00 255.0 FORMAT "%5.1" /end CHARACTERISTIC
/begin CHARACTERISTIC TSFFRAU "Fehlersummenzeit: LR-Adaption unterer Bereich" VALUE 0x1D35DA KwUb 255.0 dez 0.00 255.0 FORMAT "%5.1" /end CHARACTERISTIC
/begin CHARACTERISTIC TSFFRAU2 "Fehlersummenzeit: LR-Adaption unterer Bereich Bank 2" VALUE 0x1D35DB KwUb 255.0 dez 0.00 255.0 FORMAT "%5.1" /end CHARACTERISTIC
/begin CHARACTERISTIC TSFFRST "Fehlersummenzeit: LR-Abweichung" VALUE 0x1D35DC KwUb 255.0 dez 0.00 255.0 FORMAT "%5.1" /end CHARACTERISTIC
/begin CHARACTERISTIC TSFFRST2 "Fehlersummenzeit: LR-Abweichung Bank 2" VALUE 0x1D35DD KwUb 255.0 dez 0.00 255.0 FORMAT "%5.1" /end CHARACTERISTIC
/begin CHARACTERISTIC TSFFST "Fehlersummenzeit: Tankf¸llstand" VALUE 0x1D35DE KwUb 255.0 dez 0.00 255.0 FORMAT "%5.1" /end CHARACTERISTIC
/begin CHARACTERISTIC TSFFST2 "" VALUE 0x1D35DF KwUb 255.0 dez 0.00 255.0 FORMAT "%5.1" /end CHARACTERISTIC
/begin CHARACTERISTIC TSFHFM "" VALUE 0x1D35E0 KwUb 255.0 dez 0.00 255.0 FORMAT "%5.1" /end CHARACTERISTIC
/begin CHARACTERISTIC TSFHSH "Fehlersummenzeit: Lambdasonden-Heizung hinter Katalysator" VALUE 0x1D35E1 KwUb 255.0 dez 0.00 255.0 FORMAT "%5.1" /end CHARACTERISTIC
/begin CHARACTERISTIC TSFHSH2 "Fehlersummenzeit: Lambdasonden-Heizung hinter Katalysator, Bank 2" VALUE 0x1D35E2 KwUb 255.0 dez 0.00 255.0 FORMAT "%5.1" /end CHARACTERISTIC
/begin CHARACTERISTIC TSFHSV "Fehlersummenzeit: Lambdasonden-Heizung vor Katalysator" VALUE 0x1D35E5 KwUb 255.0 dez 0.00 255.0 FORMAT "%5.1" /end CHARACTERISTIC
/begin CHARACTERISTIC TSFHSV2 "Fehlersummenzeit: Lambdasonden-Heizung vor Katalysator, Bank 2" VALUE 0x1D35E6 KwUb 255.0 dez 0.00 255.0 FORMAT "%5.1" /end CHARACTERISTIC
/begin CHARACTERISTIC TSFHSVE "Fehlersummenzeit: Lambdasonden-Heizung vor Katalysator (Endstufe)" VALUE 0x1D35E7 KwUb 255.0 dez 0.00 255.0 FORMAT "%5.1" /end CHARACTERISTIC
/begin CHARACTERISTIC TSFHSVE2 "Fehlersummenzeit: Endstufe Lambdasonden-Heizung vor Katalysator, Bank 2" VALUE 0x1D35E8 KwUb 255.0 dez 0.00 255.0 FORMAT "%5.1" /end CHARACTERISTIC
/begin CHARACTERISTIC TSFICLSU "Fehlersummenzeit: Auswerte-IC f¸r LSU" VALUE 0x1D35EB KwUb 255.0 dez 0.00 255.0 FORMAT "%5.1" /end CHARACTERISTIC
/begin CHARACTERISTIC TSFICLSU2 "Fehlersummenzeit: Auswerte-IC f¸r LSU, Bank 2" VALUE 0x1D35EC KwUb 255.0 dez 0.00 255.0 FORMAT "%5.1" /end CHARACTERISTIC
/begin CHARACTERISTIC TSFKAT "Fehlersummenzeit: Katalysator-Konvertierung" VALUE 0x1D35ED KwWU8 255.0 dez 0.00 255.0 FORMAT "%5.1" /end CHARACTERISTIC
/begin CHARACTERISTIC TSFKAT2 "Fehlersummenzeit: Katalysator-Konvertierung (Bank 2)" VALUE 0x1D35EE KwWU8 255.0 dez 0.00 255.0 FORMAT "%5.1" /end CHARACTERISTIC
/begin CHARACTERISTIC TSFKATSP "Fehlersummenzeit: Katalysator-Konvertierung" VALUE 0x1D35EF KwWU8 255.0 dez 0.00 255.0 FORMAT "%5.1" /end CHARACTERISTIC
/begin CHARACTERISTIC TSFKATSP2 "Fehlersummenzeit: Katalysator-Konvertierung (Bank 2)" VALUE 0x1D35F0 KwWU8 255.0 dez 0.00 255.0 FORMAT "%5.1" /end CHARACTERISTIC
/begin CHARACTERISTIC TSFKRIC "Fehlersummenzeit: Klopfregelung Klopfsensorauswerte-IC" VALUE 0x1D35F3 KwUb 255.0 dez 0.00 255.0 FORMAT "%5.1" /end CHARACTERISTIC
/begin CHARACTERISTIC TSFKRSPI "Fehlersummenzeit: Klopfregelung SPI-‹berwachung" VALUE 0x1D35F4 KwUb 255.0 dez 0.00 255.0 FORMAT "%5.1" /end CHARACTERISTIC
/begin CHARACTERISTIC TSFKS1 "Fehlersummenzeit: Klopfsensor 1" VALUE 0x1D35F5 KwWU8 255.0 dez 0.00 255.0 FORMAT "%5.1" /end CHARACTERISTIC
/begin CHARACTERISTIC TSFKS2 "Fehlersummenzeit: Klopfsensor 2" VALUE 0x1D35F6 KwWU8 255.0 dez 0.00 255.0 FORMAT "%5.1" /end CHARACTERISTIC
/begin CHARACTERISTIC TSFLASH "Fehlersummenzeit: Lambda-Sondenalterung hinter Kat." VALUE 0x1D35F8 KwUb 255.0 dez 0.00 255.0 FORMAT "%5.1" /end CHARACTERISTIC
/begin CHARACTERISTIC TSFLASH2 "Fehlersummenzeit: Lambda-Sondenalterung hinter Kat. (Bank 2)" VALUE 0x1D35F9 KwUb 255.0 dez 0.00 255.0 FORMAT "%5.1" /end CHARACTERISTIC
/begin CHARACTERISTIC TSFLBK "Fehlersummenzeit: LBK" VALUE 0x1D35FA KwUb 255.0 dez 0.00 255.0 FORMAT "%5.1" /end CHARACTERISTIC
/begin CHARACTERISTIC TSFLBKE "" VALUE 0x1D35FB KwUb 255.0 dez 0.00 255.0 FORMAT "%5.1" /end CHARACTERISTIC
/begin CHARACTERISTIC TSFLBKO "Fehlersummenzeit: LBK Offset-Adaption" VALUE 0x1D35FC KwUb 255.0 dez 0.00 255.0 FORMAT "%5.1" /end CHARACTERISTIC
/begin CHARACTERISTIC TSFLBKP "Fehlersummenzeit: LBK Potentiometer" VALUE 0x1D35FD KwUb 255.0 dez 0.00 255.0 FORMAT "%5.1" /end CHARACTERISTIC
/begin CHARACTERISTIC TSFLLR "Fehlersummenzeit: Leerlaufregelung am Anschlag" VALUE 0x1D3602 KwUb 255.0 dez 0.00 255.0 FORMAT "%5.1" /end CHARACTERISTIC
/begin CHARACTERISTIC TSFLSH "Fehlersummenzeit: Lambda-Sonde hinter Kat" VALUE 0x1D3604 KwUb 255.0 dez 0.00 255.0 FORMAT "%5.1" /end CHARACTERISTIC
/begin CHARACTERISTIC TSFLSH2 "Fehlersummenzeit: Lambda-Sonde 2 hinter Kat" VALUE 0x1D3605 KwUb 255.0 dez 0.00 255.0 FORMAT "%5.1" /end CHARACTERISTIC
/begin CHARACTERISTIC TSFLSUIA "Fehlersummenzeit: Diagnose Lambdasondenleitung an Bond IA" VALUE 0x1D3606 KwUb 255.0 dez 0.00 255.0 FORMAT "%5.1" /end CHARACTERISTIC
/begin CHARACTERISTIC TSFLSUIA2 "Fehlersummenzeit: Diagnose Lambdasondenleitung an Bond IA, Bank 2" VALUE 0x1D3607 KwUb 255.0 dez 0.00 255.0 FORMAT "%5.1" /end CHARACTERISTIC
/begin CHARACTERISTIC TSFLSUUN "Fehlersummenzeit: Diagnose Lambdasondenleitung an Bond UN" VALUE 0x1D3608 KwUb 255.0 dez 0.00 255.0 FORMAT "%5.1" /end CHARACTERISTIC
/begin CHARACTERISTIC TSFLSUUN2 "Fehlersummenzeit: Diagnose Lambdasondenleitung an Bond UN, Bank 2" VALUE 0x1D3609 KwUb 255.0 dez 0.00 255.0 FORMAT "%5.1" /end CHARACTERISTIC
/begin CHARACTERISTIC TSFLSUVM "Fehlersummenzeit: Diagnose Lambdasondenleitung an Bond VM" VALUE 0x1D360A KwUb 255.0 dez 0.00 255.0 FORMAT "%5.1" /end CHARACTERISTIC
/begin CHARACTERISTIC TSFLSUVM2 "Fehlersummenzeit: Diagnose Lambdasondenleitung an Bond VM, Bank 2" VALUE 0x1D360B KwUb 255.0 dez 0.00 255.0 FORMAT "%5.1" /end CHARACTERISTIC
/begin CHARACTERISTIC TSFLSV "Fehlersummenzeit: Lambda-Sonde vor Kat" VALUE 0x1D360C KwUb 255.0 dez 0.00 255.0 FORMAT "%5.1" /end CHARACTERISTIC
/begin CHARACTERISTIC TSFLSV2 "Fehlersummenzeit: Lambda-Sonde 2 vor Kat" VALUE 0x1D360D KwUb 255.0 dez 0.00 255.0 FORMAT "%5.1" /end CHARACTERISTIC
/begin CHARACTERISTIC TSFMD "Fehlersummenzeit: Aussetzer, Summenfehler (multiple)" VALUE 0x1D3614 KwWU8 255.0 dez 0.00 255.0 FORMAT "%5.1" /end CHARACTERISTIC
/begin CHARACTERISTIC TSFMD00 "Fehlersummenzeit: Aussetzer Zyl. 0" VALUE 0x1D3615 KwWU8 255.0 dez 0.00 255.0 FORMAT "%5.1" /end CHARACTERISTIC
/begin CHARACTERISTIC TSFMD01 "Fehlersummenzeit: Aussetzer Zyl. 1" VALUE 0x1D3616 KwWU8 255.0 dez 0.00 255.0 FORMAT "%5.1" /end CHARACTERISTIC
/begin CHARACTERISTIC TSFMD02 "Fehlersummenzeit: Aussetzer Zylinder 2" VALUE 0x1D3617 KwWU8 255.0 dez 0.00 255.0 FORMAT "%5.1" /end CHARACTERISTIC
/begin CHARACTERISTIC TSFMD03 "Fehlersummenzeit: Aussetzer Zylinder 3" VALUE 0x1D3618 KwWU8 255.0 dez 0.00 255.0 FORMAT "%5.1" /end CHARACTERISTIC
/begin CHARACTERISTIC TSFMD04 "Fehlersummenzeit: Aussetzer Zylinder 4" VALUE 0x1D3619 KwWU8 255.0 dez 0.00 255.0 FORMAT "%5.1" /end CHARACTERISTIC
/begin CHARACTERISTIC TSFMD05 "Fehlersummenzeit: Aussetzer Zylinder 5" VALUE 0x1D361A KwWU8 255.0 dez 0.00 255.0 FORMAT "%5.1" /end CHARACTERISTIC
/begin CHARACTERISTIC TSFMD06 "Fehlersummenzeit: Aussetzer Zylinder 6" VALUE 0x1D361B KwWU8 255.0 dez 0.00 255.0 FORMAT "%5.1" /end CHARACTERISTIC
/begin CHARACTERISTIC TSFMD07 "Fehlersummenzeit: Aussetzer Zylinder 7" VALUE 0x1D361C KwWU8 255.0 dez 0.00 255.0 FORMAT "%5.1" /end CHARACTERISTIC
/begin CHARACTERISTIC TSFMD08 "Fehlersummenzeit: Aussetzer Zylinder 8" VALUE 0x1D361D KwWU8 255.0 dez 0.00 255.0 FORMAT "%5.1" /end CHARACTERISTIC
/begin CHARACTERISTIC TSFMD09 "Fehlersummenzeit: Aussetzer Zylinder 9" VALUE 0x1D361E KwWU8 255.0 dez 0.00 255.0 FORMAT "%5.1" /end CHARACTERISTIC
/begin CHARACTERISTIC TSFMD10 "Fehlersummenzeit: Aussetzer Zylinder 10" VALUE 0x1D361F KwWU8 255.0 dez 0.00 255.0 FORMAT "%5.1" /end CHARACTERISTIC
/begin CHARACTERISTIC TSFMD11 "Fehlersummenzeit: Aussetzer Zylinder 11" VALUE 0x1D3620 KwWU8 255.0 dez 0.00 255.0 FORMAT "%5.1" /end CHARACTERISTIC
/begin CHARACTERISTIC TSFRKAT "Fehlersummenzeit: LR-Adaption additiver Bereich pro Zeit" VALUE 0x1D3636 KwUb 255.0 dez 0.00 255.0 FORMAT "%5.1" /end CHARACTERISTIC
/begin CHARACTERISTIC TSFRKAT2 "Fehlersummenzeit: LR-Adaption additiver Bereich pro Zeit Bank 2" VALUE 0x1D3637 KwUb 255.0 dez 0.00 255.0 FORMAT "%5.1" /end CHARACTERISTIC
/begin CHARACTERISTIC TSFRKAZ "Fehlersummenzeit: LR-Adaption additiver Bereich pro Z¸ndung" VALUE 0x1D3638 KwUb 255.0 dez 0.00 255.0 FORMAT "%5.1" /end CHARACTERISTIC
/begin CHARACTERISTIC TSFRKAZ2 "Fehlersummenzeit: LR-Adaption additiver Bereich pro Z¸ndung Bank 2" VALUE 0x1D3639 KwUb 255.0 dez 0.00 255.0 FORMAT "%5.1" /end CHARACTERISTIC
/begin MEASUREMENT B_befrao "Bedingung: Bandendefunktionanford. f¸r FRAO" UWORD B_TRUE 1 100 0 1 BIT_MASK 0x20 FORMAT "%13.11" ECU_ADDRESS 0x7FC914 /end MEASUREMENT
/begin MEASUREMENT B_befrao2 "Bedingung: Bandendefunktionanford. f¸r FRAO2" UWORD B_TRUE 1 100 0 1 BIT_MASK 0x20 FORMAT "%13.11" ECU_ADDRESS 0x7FC916 /end MEASUREMENT
/begin MEASUREMENT B_befrau "Bedingung: Bandendefunktionanford. f¸r FRAU" UWORD B_TRUE 1 100 0 1 BIT_MASK 0x20 FORMAT "%13.11" ECU_ADDRESS 0x7FC918 /end MEASUREMENT
/begin MEASUREMENT B_befrau2 "Bedingung: Bandendefunktionanford. f¸r FRAU2" UWORD B_TRUE 1 100 0 1 BIT_MASK 0x20 FORMAT "%13.11" ECU_ADDRESS 0x7FC91A /end MEASUREMENT
/begin MEASUREMENT B_befrst "Bedingung: Bandendefunktionanford. f¸r LR- Kurztest" UWORD B_TRUE 1 100 0 1 BIT_MASK 0x20 FORMAT "%13.11" ECU_ADDRESS 0x7FC91C /end MEASUREMENT
/begin MEASUREMENT B_befrst2 "Bedingung: Bandendefunktionanford. f¸r LR- Kurztest (Bank 2)" UWORD B_TRUE 1 100 0 1 BIT_MASK 0x20 FORMAT "%13.11" ECU_ADDRESS 0x7FC91E /end MEASUREMENT
/begin MEASUREMENT B_befst "Bedingung: Bandendeanforderung f¸r Fehler FST" UWORD B_TRUE 1 100 0 1 BIT_MASK 0x20 FORMAT "%13.11" ECU_ADDRESS 0x7FC920 /end MEASUREMENT
/begin MEASUREMENT B_befst2 "Bedingung: Bandendeanforderung f¸r Fehler FST2" UWORD B_TRUE 1 100 0 1 BIT_MASK 0x20 FORMAT "%13.11" ECU_ADDRESS 0x7FC922 /end MEASUREMENT
/begin MEASUREMENT B_behfm "Bedingung Bandende-Funktionsanforderung HFM" UWORD B_TRUE 1 100 0 1 BIT_MASK 0x20 FORMAT "%13.11" ECU_ADDRESS 0x7FC924 /end MEASUREMENT
/begin MEASUREMENT B_behsh "Bedingung: Bandendefunktionanford. f¸r %DHLS" UWORD B_TRUE 1 100 0 1 BIT_MASK 0x20 FORMAT "%13.11" ECU_ADDRESS 0x7FC926 /end MEASUREMENT
/begin MEASUREMENT B_behsh2 "Bedingung: Bandendefunktionanford. f¸r %DHLS Bank 2" UWORD B_TRUE 1 100 0 1 BIT_MASK 0x20 FORMAT "%13.11" ECU_ADDRESS 0x7FC928 /end MEASUREMENT
/begin MEASUREMENT B_behsv "Bedingung: Bandendefunktionanford. f¸r %DHRLSU" UWORD B_TRUE 1 100 0 1 BIT_MASK 0x20 FORMAT "%13.11" ECU_ADDRESS 0x7FC92E /end MEASUREMENT
/begin MEASUREMENT B_behsv2 "Bedingung: Bandendefunktionanford. f¸r %DHRLSU, Bank 2" UWORD B_TRUE 1 100 0 1 BIT_MASK 0x20 FORMAT "%13.11" ECU_ADDRESS 0x7FC930 /end MEASUREMENT
/begin MEASUREMENT B_behsve "Bedingung: Bandendefunktionanford. f¸r DHRLSUE" UWORD B_TRUE 1 100 0 1 BIT_MASK 0x20 FORMAT "%13.11" ECU_ADDRESS 0x7FC932 /end MEASUREMENT
/begin MEASUREMENT B_behsve2 "Bedingung: Bandendefunktionanford. f¸r DHRLSUE, Bank 2" UWORD B_TRUE 1 100 0 1 BIT_MASK 0x20 FORMAT "%13.11" ECU_ADDRESS 0x7FC934 /end MEASUREMENT
/begin MEASUREMENT B_beiclsu "Bedingung: Bandendefunktionanford. f¸r Pr¸fung Auswerte-IC der LSU" UWORD B_TRUE 1 100 0 1 BIT_MASK 0x20 FORMAT "%13.11" ECU_ADDRESS 0x7FC93A /end MEASUREMENT
/begin MEASUREMENT B_beiclsu2 "Bedingung: Bandendefunktionanford. f¸r Pr¸fung Auswerte-IC der LSU, Bank 2" UWORD B_TRUE 1 100 0 1 BIT_MASK 0x20 FORMAT "%13.11" ECU_ADDRESS 0x7FC93C /end MEASUREMENT
/begin MEASUREMENT B_bekat "Bedingung Bandende-Funktionsanforderung Katalysatordiagnose" UWORD B_TRUE 1 100 0 1 BIT_MASK 0x20 FORMAT "%13.11" ECU_ADDRESS 0x7FC93E /end MEASUREMENT
/begin MEASUREMENT B_bekat2 "Bedingung Bandende-Funktionsanforderung Katalysatordiagnose, Bank2" UWORD B_TRUE 1 100 0 1 BIT_MASK 0x20 FORMAT "%13.11" ECU_ADDRESS 0x7FC940 /end MEASUREMENT
/begin MEASUREMENT B_bekatsp "Bedingung Bandende-Funktionsanforderung Katalysatordiagnose" UWORD B_TRUE 1 100 0 1 BIT_MASK 0x20 FORMAT "%13.11" ECU_ADDRESS 0x7FC942 /end MEASUREMENT
/begin MEASUREMENT B_bekatsp2 "Bedingung Bandende-Funktionsanforderung Katalysatordiagnose, Bank2" UWORD B_TRUE 1 100 0 1 BIT_MASK 0x20 FORMAT "%13.11" ECU_ADDRESS 0x7FC944 /end MEASUREMENT
/begin MEASUREMENT B_bekric "" UWORD B_TRUE 1 100 0 1 BIT_MASK 0x20 FORMAT "%13.11" ECU_ADDRESS 0x7FC94A /end MEASUREMENT
/begin MEASUREMENT B_bekrspi "" UWORD B_TRUE 1 100 0 1 BIT_MASK 0x20 FORMAT "%13.11" ECU_ADDRESS 0x7FC94C /end MEASUREMENT
/begin MEASUREMENT B_beks1 "Bedingung Bandende-Funktionsanforderung Diagnose Klopfsensor 1" UWORD B_TRUE 1 100 0 1 BIT_MASK 0x20 FORMAT "%13.11" ECU_ADDRESS 0x7FC94E /end MEASUREMENT
/begin MEASUREMENT B_beks2 "Bedingung Bandende-Funktionsanforderung Diagnose Klopfsensor 2" UWORD B_TRUE 1 100 0 1 BIT_MASK 0x20 FORMAT "%13.11" ECU_ADDRESS 0x7FC950 /end MEASUREMENT
/begin MEASUREMENT B_belash "Bedingung Bandende-Funktionsanforderung Schwingungspr¸fung hinter KAT" UWORD B_TRUE 1 100 0 1 BIT_MASK 0x20 FORMAT "%13.11" ECU_ADDRESS 0x7FC954 /end MEASUREMENT
/begin MEASUREMENT B_belash2 "Bedingung Bandende-Funktionsanforderung Schwingungspr¸fung hinter KAT Bank2" UWORD B_TRUE 1 100 0 1 BIT_MASK 0x20 FORMAT "%13.11" ECU_ADDRESS 0x7FC956 /end MEASUREMENT
/begin MEASUREMENT B_belbk "Bedingung Bandende-Funktionsanforderung LBK" UWORD B_TRUE 1 100 0 1 BIT_MASK 0x20 FORMAT "%13.11" ECU_ADDRESS 0x7FC958 /end MEASUREMENT
/begin MEASUREMENT B_belbke "Bedingung Bandende-Funktionsanforderung LBK Endstufe" UWORD B_TRUE 1 100 0 1 BIT_MASK 0x20 FORMAT "%13.11" ECU_ADDRESS 0x7FC95A /end MEASUREMENT
/begin MEASUREMENT B_belbko "Bedingung Bandende-Funktionsanforderung LBK Offset-Adaption" UWORD B_TRUE 1 100 0 1 BIT_MASK 0x20 FORMAT "%13.11" ECU_ADDRESS 0x7FC95C /end MEASUREMENT
/begin MEASUREMENT B_belbkp "Bedingung Bandende-Funktionsanforderung LBK Potentiometer" UWORD B_TRUE 1 100 0 1 BIT_MASK 0x20 FORMAT "%13.11" ECU_ADDRESS 0x7FC95E /end MEASUREMENT
/begin MEASUREMENT B_bellr "Bedingung Bandende-Funktionsanforderung Leerlaufregelung" UWORD B_TRUE 1 100 0 1 BIT_MASK 0x20 FORMAT "%13.11" ECU_ADDRESS 0x7FC968 /end MEASUREMENT
/begin MEASUREMENT B_belsh "Bedingung Bandende-Funktionsanforderung elktr. Diag. Lambda-Sonde hinter KAT" UWORD B_TRUE 1 100 0 1 BIT_MASK 0x20 FORMAT "%13.11" ECU_ADDRESS 0x7FC96C /end MEASUREMENT
/begin MEASUREMENT B_belsh2 "Bedingung Bandende-Funktionsanford. elktr. Diag. Lambda-Sonde hinter KAT Bank2" UWORD B_TRUE 1 100 0 1 BIT_MASK 0x20 FORMAT "%13.11" ECU_ADDRESS 0x7FC96E /end MEASUREMENT
/begin MEASUREMENT B_belsuia "Bedingung: Bandende-Fkt.-Anforderung: LSU-Leitungspr¸fung IA" UWORD B_TRUE 1 100 0 1 BIT_MASK 0x20 FORMAT "%13.11" ECU_ADDRESS 0x7FC970 /end MEASUREMENT
/begin MEASUREMENT B_belsuia2 "Bedingung: Bandende-Fkt.-Anforderung: LSU-Leitungspr¸fung IA, Bank 2" UWORD B_TRUE 1 100 0 1 BIT_MASK 0x20 FORMAT "%13.11" ECU_ADDRESS 0x7FC972 /end MEASUREMENT
/begin MEASUREMENT B_belsuun "Bedingung: Bandende-Fkt.-Anforderung: LSU-Leitungspr¸fung UN" UWORD B_TRUE 1 100 0 1 BIT_MASK 0x20 FORMAT "%13.11" ECU_ADDRESS 0x7FC974 /end MEASUREMENT
/begin MEASUREMENT B_belsuun2 "Bedingung: Bandende-Fkt.-Anforderung: LSU-Leitungspr¸fung UN, Bank 2" UWORD B_TRUE 1 100 0 1 BIT_MASK 0x20 FORMAT "%13.11" ECU_ADDRESS 0x7FC976 /end MEASUREMENT
/begin MEASUREMENT B_belsuvm "Bedingung: Bandende-Fkt.-Anforderung: LSU-Leitungspr¸fung VM" UWORD B_TRUE 1 100 0 1 BIT_MASK 0x20 FORMAT "%13.11" ECU_ADDRESS 0x7FC978 /end MEASUREMENT
/begin MEASUREMENT B_belsuvm2 "Bedingung: Bandende-Fkt.-Anforderung: LSU-Leitungspr¸fung VM, Bank 2" UWORD B_TRUE 1 100 0 1 BIT_MASK 0x20 FORMAT "%13.11" ECU_ADDRESS 0x7FC97A /end MEASUREMENT
/begin MEASUREMENT B_belsv "Bedingung Bandende-Funktionsanforderung elktr. Diag. Lambda-Sonde vor KAT" UWORD B_TRUE 1 100 0 1 BIT_MASK 0x20 FORMAT "%13.11" ECU_ADDRESS 0x7FC97C /end MEASUREMENT
/begin MEASUREMENT B_belsv2 "Bedingung Bandende-Funktionsanforderung elktr. Diag. Lambda-Sonde vor KAT Bank2" UWORD B_TRUE 1 100 0 1 BIT_MASK 0x20 FORMAT "%13.11" ECU_ADDRESS 0x7FC97E /end MEASUREMENT
/begin MEASUREMENT B_bemd "Bedingung Bandende-Funktionsanforderung Erkennung mehrfacher Aussetzer" UWORD B_TRUE 1 100 0 1 BIT_MASK 0x20 FORMAT "%13.11" ECU_ADDRESS 0x7FC98C /end MEASUREMENT
/begin MEASUREMENT B_bemd00 "Bedingung Bandende-Funktionsanforderung" UWORD B_TRUE 1 100 0 1 BIT_MASK 0x20 FORMAT "%13.11" ECU_ADDRESS 0x7FC98E /end MEASUREMENT
/begin MEASUREMENT B_bemd01 "Bedingung Bandende-Funktionsanforderung" UWORD B_TRUE 1 100 0 1 BIT_MASK 0x20 FORMAT "%13.11" ECU_ADDRESS 0x7FC990 /end MEASUREMENT
/begin MEASUREMENT B_bemd02 "Bedingung Bandende-Funktionsanforderung" UWORD B_TRUE 1 100 0 1 BIT_MASK 0x20 FORMAT "%13.11" ECU_ADDRESS 0x7FC992 /end MEASUREMENT
/begin MEASUREMENT B_bemd03 "Bedingung Bandende-Funktionsanforderung" UWORD B_TRUE 1 100 0 1 BIT_MASK 0x20 FORMAT "%13.11" ECU_ADDRESS 0x7FC994 /end MEASUREMENT
/begin MEASUREMENT B_bemd04 "" UWORD B_TRUE 1 100 0 1 BIT_MASK 0x20 FORMAT "%13.11" ECU_ADDRESS 0x7FC996 /end MEASUREMENT
/begin MEASUREMENT B_bemd05 "" UWORD B_TRUE 1 100 0 1 BIT_MASK 0x20 FORMAT "%13.11" ECU_ADDRESS 0x7FC998 /end MEASUREMENT
/begin MEASUREMENT B_bemd06 "" UWORD B_TRUE 1 100 0 1 BIT_MASK 0x20 FORMAT "%13.11" ECU_ADDRESS 0x7FC99A /end MEASUREMENT
/begin MEASUREMENT B_bemd07 "" UWORD B_TRUE 1 100 0 1 BIT_MASK 0x20 FORMAT "%13.11" ECU_ADDRESS 0x7FC99C /end MEASUREMENT
/begin MEASUREMENT B_bemd08 "" UWORD B_TRUE 1 100 0 1 BIT_MASK 0x20 FORMAT "%13.11" ECU_ADDRESS 0x7FC99E /end MEASUREMENT
/begin MEASUREMENT B_bemd09 "" UWORD B_TRUE 1 100 0 1 BIT_MASK 0x20 FORMAT "%13.11" ECU_ADDRESS 0x7FC9A0 /end MEASUREMENT
/begin MEASUREMENT B_bemd10 "" UWORD B_TRUE 1 100 0 1 BIT_MASK 0x20 FORMAT "%13.11" ECU_ADDRESS 0x7FC9A2 /end MEASUREMENT
/begin MEASUREMENT B_bemd11 "" UWORD B_TRUE 1 100 0 1 BIT_MASK 0x20 FORMAT "%13.11" ECU_ADDRESS 0x7FC9A4 /end MEASUREMENT
/begin MEASUREMENT B_berkat "Bedingung: Bandendefunktionanford. f¸r RKAT" UWORD B_TRUE 1 100 0 1 BIT_MASK 0x20 FORMAT "%13.11" ECU_ADDRESS 0x7FC9D0 /end MEASUREMENT
/begin MEASUREMENT B_berkat2 "Bedingung: Bandendefunktionanford. f¸r RKAT2" UWORD B_TRUE 1 100 0 1 BIT_MASK 0x20 FORMAT "%13.11" ECU_ADDRESS 0x7FC9D2 /end MEASUREMENT
/begin MEASUREMENT B_berkaz "Bedingung: Bandendefunktionanford. f¸r RKAZ" UWORD B_TRUE 1 100 0 1 BIT_MASK 0x20 FORMAT "%13.11" ECU_ADDRESS 0x7FC9D4 /end MEASUREMENT
/begin MEASUREMENT B_berkaz2 "Bedingung: Bandendefunktionanford. f¸r RKAZ2" UWORD B_TRUE 1 100 0 1 BIT_MASK 0x20 FORMAT "%13.11" ECU_ADDRESS 0x7FC9D6 /end MEASUREMENT
/begin MEASUREMENT B_bkfrao "Ersatzwert f¸r FRAO aktiv" UWORD B_TRUE 1 100 0 1 BIT_MASK 0x40 FORMAT "%13.11" ECU_ADDRESS 0x7FC914 /end MEASUREMENT
/begin MEASUREMENT B_bkfrao2 "Ersatzwert f¸r FRAO aktiv Bank 2" UWORD B_TRUE 1 100 0 1 BIT_MASK 0x40 FORMAT "%13.11" ECU_ADDRESS 0x7FC916 /end MEASUREMENT
/begin MEASUREMENT B_bkfrau "Ersatzwert f¸r FRAU aktiv" UWORD B_TRUE 1 100 0 1 BIT_MASK 0x40 FORMAT "%13.11" ECU_ADDRESS 0x7FC918 /end MEASUREMENT
/begin MEASUREMENT B_bkfrau2 "Ersatzwert f¸r FRAU aktiv Bank 2" UWORD B_TRUE 1 100 0 1 BIT_MASK 0x40 FORMAT "%13.11" ECU_ADDRESS 0x7FC91A /end MEASUREMENT
/begin MEASUREMENT B_bkfrst "Bedingung: LR-Abweichung" UWORD B_TRUE 1 100 0 1 BIT_MASK 0x40 FORMAT "%13.11" ECU_ADDRESS 0x7FC91C /end MEASUREMENT
/begin MEASUREMENT B_bkfrst2 "Bedingung: LR-Abweichung Bank 2" UWORD B_TRUE 1 100 0 1 BIT_MASK 0x40 FORMAT "%13.11" ECU_ADDRESS 0x7FC91E /end MEASUREMENT
/begin MEASUREMENT B_bkfst "Bedingung: Ersatzwert aktiv, Tankf¸llstandsgeber" UWORD B_TRUE 1 100 0 1 BIT_MASK 0x40 FORMAT "%13.11" ECU_ADDRESS 0x7FC920 /end MEASUREMENT
/begin MEASUREMENT B_bkfst2 "Bedingung: Ersatzwert aktiv, Tank2 F¸llstandsgeber" UWORD B_TRUE 1 100 0 1 BIT_MASK 0x40 FORMAT "%13.11" ECU_ADDRESS 0x7FC922 /end MEASUREMENT
/begin MEASUREMENT B_bkhfm "Bedingung Ersatzwert aktiv: HFM" UWORD B_TRUE 1 100 0 1 BIT_MASK 0x40 FORMAT "%13.11" ECU_ADDRESS 0x7FC924 /end MEASUREMENT
/begin MEASUREMENT B_bkhsh "Bedingung: Lambdasondenheizung hinter Kat. aktiv" UWORD B_TRUE 1 100 0 1 BIT_MASK 0x40 FORMAT "%13.11" ECU_ADDRESS 0x7FC926 /end MEASUREMENT
/begin MEASUREMENT B_bkhsh2 "Bedingung: Lambdasondenheizung hinter Kat. aktiv, Bank 2" UWORD B_TRUE 1 100 0 1 BIT_MASK 0x40 FORMAT "%13.11" ECU_ADDRESS 0x7FC928 /end MEASUREMENT
/begin MEASUREMENT B_bkhsv "Bedingung:Lambdasondenheizung vor Kat. aktiv" UWORD B_TRUE 1 100 0 1 BIT_MASK 0x40 FORMAT "%13.11" ECU_ADDRESS 0x7FC92E /end MEASUREMENT
/begin MEASUREMENT B_bkhsv2 "Bedingung:Lambdasondenheizung vor Kat. aktiv, Bank 2" UWORD B_TRUE 1 100 0 1 BIT_MASK 0x40 FORMAT "%13.11" ECU_ADDRESS 0x7FC930 /end MEASUREMENT
/begin MEASUREMENT B_bkhsve "Bedingung Ersatzwert aktiv: Heizer der LSU" UWORD B_TRUE 1 100 0 1 BIT_MASK 0x40 FORMAT "%13.11" ECU_ADDRESS 0x7FC932 /end MEASUREMENT
/begin MEASUREMENT B_bkhsve2 "Bedingung Ersatzwert aktiv: Heizer der LSU, Bank 2" UWORD B_TRUE 1 100 0 1 BIT_MASK 0x40 FORMAT "%13.11" ECU_ADDRESS 0x7FC934 /end MEASUREMENT
/begin MEASUREMENT B_bkiclsu "Bedingung Ersatzwert aktiv: Auswerte-IC f¸r LSU" UWORD B_TRUE 1 100 0 1 BIT_MASK 0x40 FORMAT "%13.11" ECU_ADDRESS 0x7FC93A /end MEASUREMENT
/begin MEASUREMENT B_bkiclsu2 "Bedingung Ersatzwert aktiv: Auswerte-IC f¸r LSU,Bank2" UWORD B_TRUE 1 100 0 1 BIT_MASK 0x40 FORMAT "%13.11" ECU_ADDRESS 0x7FC93C /end MEASUREMENT
/begin MEASUREMENT B_bkkat "Bedingung Ersatzwert f¸r Katalysator" UWORD B_TRUE 1 100 0 1 BIT_MASK 0x40 FORMAT "%13.11" ECU_ADDRESS 0x7FC93E /end MEASUREMENT
/begin MEASUREMENT B_bkkat2 "Bedingung Ersatzwert f¸r Katalysator, Bank2" UWORD B_TRUE 1 100 0 1 BIT_MASK 0x40 FORMAT "%13.11" ECU_ADDRESS 0x7FC940 /end MEASUREMENT
/begin MEASUREMENT B_bkkatsp "Bedingung Ersatzwert f¸r Katalysator" UWORD B_TRUE 1 100 0 1 BIT_MASK 0x40 FORMAT "%13.11" ECU_ADDRESS 0x7FC942 /end MEASUREMENT
/begin MEASUREMENT B_bkkatsp2 "Bedingung Ersatzwert f¸r Katalysator, Bank2" UWORD B_TRUE 1 100 0 1 BIT_MASK 0x40 FORMAT "%13.11" ECU_ADDRESS 0x7FC944 /end MEASUREMENT
/begin MEASUREMENT B_bkkric "Bedingung: Klopfregelung Klopfsensorauswerte IC aktiv" UWORD B_TRUE 1 100 0 1 BIT_MASK 0x40 FORMAT "%13.11" ECU_ADDRESS 0x7FC94A /end MEASUREMENT
/begin MEASUREMENT B_bkkrspi "Bedingung: Klopfregelung SPI-‹berwachung aktiv" UWORD B_TRUE 1 100 0 1 BIT_MASK 0x40 FORMAT "%13.11" ECU_ADDRESS 0x7FC94C /end MEASUREMENT
/begin MEASUREMENT B_bkks1 "Bedingung: Klopfsensor 1 aktiv" UWORD B_TRUE 1 100 0 1 BIT_MASK 0x40 FORMAT "%13.11" ECU_ADDRESS 0x7FC94E /end MEASUREMENT
/begin MEASUREMENT B_bkks2 "Bedingung: Klopfsensor 2 aktiv" UWORD B_TRUE 1 100 0 1 BIT_MASK 0x40 FORMAT "%13.11" ECU_ADDRESS 0x7FC950 /end MEASUREMENT
/begin MEASUREMENT B_bklash "Bedingung: Lambdasondenalterung hinter Kat." UWORD B_TRUE 1 100 0 1 BIT_MASK 0x40 FORMAT "%13.11" ECU_ADDRESS 0x7FC954 /end MEASUREMENT
/begin MEASUREMENT B_bklash2 "Bedingung: Lambdasondenalterung hinter Kat. Bank2" UWORD B_TRUE 1 100 0 1 BIT_MASK 0x40 FORMAT "%13.11" ECU_ADDRESS 0x7FC956 /end MEASUREMENT
/begin MEASUREMENT B_bklbk "Bedingung Ersatzwert aktiv: LBK" UWORD B_TRUE 1 100 0 1 BIT_MASK 0x40 FORMAT "%13.11" ECU_ADDRESS 0x7FC958 /end MEASUREMENT
/begin MEASUREMENT B_bklbke "Bedingung Ersatzwert aktiv: LBK Endstufe" UWORD B_TRUE 1 100 0 1 BIT_MASK 0x40 FORMAT "%13.11" ECU_ADDRESS 0x7FC95A /end MEASUREMENT
/begin MEASUREMENT B_bklbko "Bedingung Ersatzwert aktiv: LBK Offset-Adaption" UWORD B_TRUE 1 100 0 1 BIT_MASK 0x40 FORMAT "%13.11" ECU_ADDRESS 0x7FC95C /end MEASUREMENT
/begin MEASUREMENT B_bklbkp "Bedingung Ersatzwert aktiv: LBK Potentiometer" UWORD B_TRUE 1 100 0 1 BIT_MASK 0x40 FORMAT "%13.11" ECU_ADDRESS 0x7FC95E /end MEASUREMENT
/begin MEASUREMENT B_bkllr "Bedingung: Leerlaufregelung aktiv" UWORD B_TRUE 1 100 0 1 BIT_MASK 0x40 FORMAT "%13.11" ECU_ADDRESS 0x7FC968 /end MEASUREMENT
/begin MEASUREMENT B_bklsh "Bedingung: Lambdasonde hinter Kat. aktiv" UWORD B_TRUE 1 100 0 1 BIT_MASK 0x40 FORMAT "%13.11" ECU_ADDRESS 0x7FC96C /end MEASUREMENT
/begin MEASUREMENT B_bklsh2 "Bedingung: Lambdasonde hinter Kat. aktiv Bank2" UWORD B_TRUE 1 100 0 1 BIT_MASK 0x40 FORMAT "%13.11" ECU_ADDRESS 0x7FC96E /end MEASUREMENT
/begin MEASUREMENT B_bklsuia "Bedingung Ersatzwert aktiv: LSU-Leitungspr¸fung IA" UWORD B_TRUE 1 100 0 1 BIT_MASK 0x40 FORMAT "%13.11" ECU_ADDRESS 0x7FC970 /end MEASUREMENT
/begin MEASUREMENT B_bklsuia2 "Bedingung Ersatzwert aktiv: LSU-Leitungspr¸fung IA, Bank 2" UWORD B_TRUE 1 100 0 1 BIT_MASK 0x40 FORMAT "%13.11" ECU_ADDRESS 0x7FC972 /end MEASUREMENT
/begin MEASUREMENT B_bklsuun "Bedingung Ersatzwert aktiv: LSU-Leitungspr¸fung UN" UWORD B_TRUE 1 100 0 1 BIT_MASK 0x40 FORMAT "%13.11" ECU_ADDRESS 0x7FC974 /end MEASUREMENT
/begin MEASUREMENT B_bklsuun2 "Bedingung Ersatzwert aktiv: LSU-Leitungspr¸fung UN, Bank 2" UWORD B_TRUE 1 100 0 1 BIT_MASK 0x40 FORMAT "%13.11" ECU_ADDRESS 0x7FC976 /end MEASUREMENT
/begin MEASUREMENT B_bklsuvm "Bedingung Ersatzwert aktiv: LSU-Leitungspr¸fung VM" UWORD B_TRUE 1 100 0 1 BIT_MASK 0x40 FORMAT "%13.11" ECU_ADDRESS 0x7FC978 /end MEASUREMENT
/begin MEASUREMENT B_bklsuvm2 "Bedingung Ersatzwert aktiv: LSU-Leitungspr¸fung VM, Bank 2" UWORD B_TRUE 1 100 0 1 BIT_MASK 0x40 FORMAT "%13.11" ECU_ADDRESS 0x7FC97A /end MEASUREMENT
/begin MEASUREMENT B_bklsv "Bedingung: Lambdasonde vor Kat. aktiv" UWORD B_TRUE 1 100 0 1 BIT_MASK 0x40 FORMAT "%13.11" ECU_ADDRESS 0x7FC97C /end MEASUREMENT
/begin MEASUREMENT B_bklsv2 "Bedingung: Lambdasonde vor Kat. aktiv Bank2" UWORD B_TRUE 1 100 0 1 BIT_MASK 0x40 FORMAT "%13.11" ECU_ADDRESS 0x7FC97E /end MEASUREMENT
/begin MEASUREMENT B_bkmd "Flag f¸r Ersatzwert: Aussetzer, Summenfehler (multiple)" UWORD B_TRUE 1 100 0 1 BIT_MASK 0x40 FORMAT "%13.11" ECU_ADDRESS 0x7FC98C /end MEASUREMENT
/begin MEASUREMENT B_bkmd00 "Flag f¸r Ersatzwert: Aussetzer Z¸ndung 0" UWORD B_TRUE 1 100 0 1 BIT_MASK 0x40 FORMAT "%13.11" ECU_ADDRESS 0x7FC98E /end MEASUREMENT
/begin MEASUREMENT B_bkmd01 "Flag f¸r Ersatzwert: Aussetzer Z¸ndung 1" UWORD B_TRUE 1 100 0 1 BIT_MASK 0x40 FORMAT "%13.11" ECU_ADDRESS 0x7FC990 /end MEASUREMENT
/begin MEASUREMENT B_bkmd02 "Flag f¸r Ersatzwert: Aussetzer Z¸ndung 2" UWORD B_TRUE 1 100 0 1 BIT_MASK 0x40 FORMAT "%13.11" ECU_ADDRESS 0x7FC992 /end MEASUREMENT
/begin MEASUREMENT B_bkmd03 "Flag f¸r Ersatzwert: Aussetzer Z¸ndung 3" UWORD B_TRUE 1 100 0 1 BIT_MASK 0x40 FORMAT "%13.11" ECU_ADDRESS 0x7FC994 /end MEASUREMENT
/begin MEASUREMENT B_bkmd04 "Flag f¸r Ersatzwert: Aussetzer Z¸ndung 4" UWORD B_TRUE 1 100 0 1 BIT_MASK 0x40 FORMAT "%13.11" ECU_ADDRESS 0x7FC996 /end MEASUREMENT
/begin MEASUREMENT B_bkmd05 "Flag f¸r Ersatzwert: Aussetzer Z¸ndung 5" UWORD B_TRUE 1 100 0 1 BIT_MASK 0x40 FORMAT "%13.11" ECU_ADDRESS 0x7FC998 /end MEASUREMENT
/begin MEASUREMENT B_bkmd06 "Flag f¸r Ersatzwert: Aussetzer Z¸ndung 6" UWORD B_TRUE 1 100 0 1 BIT_MASK 0x40 FORMAT "%13.11" ECU_ADDRESS 0x7FC99A /end MEASUREMENT
/begin MEASUREMENT B_bkmd07 "Flag f¸r Ersatzwert: Aussetzer Z¸ndung 7" UWORD B_TRUE 1 100 0 1 BIT_MASK 0x40 FORMAT "%13.11" ECU_ADDRESS 0x7FC99C /end MEASUREMENT
/begin MEASUREMENT B_bkmd08 "Flag f¸r Ersatzwert: Aussetzer Z¸ndung 8" UWORD B_TRUE 1 100 0 1 BIT_MASK 0x40 FORMAT "%13.11" ECU_ADDRESS 0x7FC99E /end MEASUREMENT
/begin MEASUREMENT B_bkmd09 "Flag f¸r Ersatzwert: Aussetzer Z¸ndung 9" UWORD B_TRUE 1 100 0 1 BIT_MASK 0x40 FORMAT "%13.11" ECU_ADDRESS 0x7FC9A0 /end MEASUREMENT
/begin MEASUREMENT B_bkmd10 "Flag f¸r Ersatzwert: Aussetzer Z¸ndung 10" UWORD B_TRUE 1 100 0 1 BIT_MASK 0x40 FORMAT "%13.11" ECU_ADDRESS 0x7FC9A2 /end MEASUREMENT
/begin MEASUREMENT B_bkmd11 "Flag f¸r Ersatzwert: Aussetzer Z¸ndung 11" UWORD B_TRUE 1 100 0 1 BIT_MASK 0x40 FORMAT "%13.11" ECU_ADDRESS 0x7FC9A4 /end MEASUREMENT
/begin MEASUREMENT B_bkrkat "Ersatzwert f¸r RKAT aktiv" UWORD B_TRUE 1 100 0 1 BIT_MASK 0x40 FORMAT "%13.11" ECU_ADDRESS 0x7FC9D0 /end MEASUREMENT
/begin MEASUREMENT B_bkrkat2 "Ersatzwert f¸r RKAT aktiv Bank 2" UWORD B_TRUE 1 100 0 1 BIT_MASK 0x40 FORMAT "%13.11" ECU_ADDRESS 0x7FC9D2 /end MEASUREMENT
/begin MEASUREMENT B_bkrkaz "Ersatzwert f¸r RKAZ aktiv" UWORD B_TRUE 1 100 0 1 BIT_MASK 0x40 FORMAT "%13.11" ECU_ADDRESS 0x7FC9D4 /end MEASUREMENT
/begin MEASUREMENT B_bkrkaz2 "Ersatzwert f¸r RKAZ aktiv Bank 2" UWORD B_TRUE 1 100 0 1 BIT_MASK 0x40 FORMAT "%13.11" ECU_ADDRESS 0x7FC9D6 /end MEASUREMENT
/begin MEASUREMENT B_clfrao "Bedingung Fehlerpfad FRAO lˆschen (obere Multipl. Bereich)" UWORD B_TRUE 1 100 0 1 BIT_MASK 0x80 FORMAT "%13.11" ECU_ADDRESS 0x7FC914 /end MEASUREMENT
/begin MEASUREMENT B_clfrao2 "Bedingung Fehlerpfad FRAO2 lˆschen (Stereo)" UWORD B_TRUE 1 100 0 1 BIT_MASK 0x80 FORMAT "%13.11" ECU_ADDRESS 0x7FC916 /end MEASUREMENT
/begin MEASUREMENT B_clfrau "Bedingung Fehlerpfad FRAU lˆschen (untere Multipl. Bereich)" UWORD B_TRUE 1 100 0 1 BIT_MASK 0x80 FORMAT "%13.11" ECU_ADDRESS 0x7FC918 /end MEASUREMENT
/begin MEASUREMENT B_clfrau2 "Bedingung Fehlerpfad FRAU2 lˆschen (Stereo)" UWORD B_TRUE 1 100 0 1 BIT_MASK 0x80 FORMAT "%13.11" ECU_ADDRESS 0x7FC91A /end MEASUREMENT
/begin MEASUREMENT B_clfrst "Bedingung Fehlerpfad FRST lˆschen (Kurztest)" UWORD B_TRUE 1 100 0 1 BIT_MASK 0x80 FORMAT "%13.11" ECU_ADDRESS 0x7FC91C /end MEASUREMENT
/begin MEASUREMENT B_clfrst2 "Bedingung Fehlerpfad FRST lˆschen (Kurztest Bank 2)" UWORD B_TRUE 1 100 0 1 BIT_MASK 0x80 FORMAT "%13.11" ECU_ADDRESS 0x7FC91E /end MEASUREMENT
/begin MEASUREMENT B_clfst "Fehlerpfad in GGFST lˆschen" UWORD B_TRUE 1 100 0 1 BIT_MASK 0x80 FORMAT "%13.11" ECU_ADDRESS 0x7FC920 /end MEASUREMENT
/begin MEASUREMENT B_clfst2 "Bedingung: Fehlerflag ""FST2-Fehler"" lˆschen" UWORD B_TRUE 1 100 0 1 BIT_MASK 0x80 FORMAT "%13.11" ECU_ADDRESS 0x7FC922 /end MEASUREMENT
/begin MEASUREMENT B_clhfm "Bedingung: Fehlerpfad HFM lˆschen" UWORD B_TRUE 1 100 0 1 BIT_MASK 0x80 FORMAT "%13.11" ECU_ADDRESS 0x7FC924 /end MEASUREMENT
/begin MEASUREMENT B_clhsh "Bedingung Fehlerpfad DHLSHK lˆschen" UWORD B_TRUE 1 100 0 1 BIT_MASK 0x80 FORMAT "%13.11" ECU_ADDRESS 0x7FC926 /end MEASUREMENT
/begin MEASUREMENT B_clhsh2 "Bedingung Fehlerpfad DHLSHK2 lˆschen" UWORD B_TRUE 1 100 0 1 BIT_MASK 0x80 FORMAT "%13.11" ECU_ADDRESS 0x7FC928 /end MEASUREMENT
/begin MEASUREMENT B_clhsv "Bedingung Fehlerpfad DHLSVK lˆschen" UWORD B_TRUE 1 100 0 1 BIT_MASK 0x80 FORMAT "%13.11" ECU_ADDRESS 0x7FC92E /end MEASUREMENT
/begin MEASUREMENT B_clhsv2 "Bedingung Fehlerpfad DHLSVK2 lˆschen" UWORD B_TRUE 1 100 0 1 BIT_MASK 0x80 FORMAT "%13.11" ECU_ADDRESS 0x7FC930 /end MEASUREMENT
/begin MEASUREMENT B_clhsve "Bedingung Fehlerpfad DHLSVK lˆschen (Endstufe)" UWORD B_TRUE 1 100 0 1 BIT_MASK 0x80 FORMAT "%13.11" ECU_ADDRESS 0x7FC932 /end MEASUREMENT
/begin MEASUREMENT B_clhsve2 "Bedingung Fehlerpfad DHLSVK2 lˆschen (Endstufe)" UWORD B_TRUE 1 100 0 1 BIT_MASK 0x80 FORMAT "%13.11" ECU_ADDRESS 0x7FC934 /end MEASUREMENT
/begin MEASUREMENT B_cliclsu "Bedingung Fehler E_iclsu lˆschen" UWORD B_TRUE 1 100 0 1 BIT_MASK 0x80 FORMAT "%13.11" ECU_ADDRESS 0x7FC93A /end MEASUREMENT
/begin MEASUREMENT B_cliclsu2 "Bedingung Fehler E_iclsu lˆschen, Bank 2" UWORD B_TRUE 1 100 0 1 BIT_MASK 0x80 FORMAT "%13.11" ECU_ADDRESS 0x7FC93C /end MEASUREMENT
/begin MEASUREMENT B_clkat "Bedingung Fehlerpfad DKAT lˆschen" UWORD B_TRUE 1 100 0 1 BIT_MASK 0x80 FORMAT "%13.11" ECU_ADDRESS 0x7FC93E /end MEASUREMENT
/begin MEASUREMENT B_clkat2 "Bedingung Fehlerpfad Dkat lˆschen (Stereo)" UWORD B_TRUE 1 100 0 1 BIT_MASK 0x80 FORMAT "%13.11" ECU_ADDRESS 0x7FC940 /end MEASUREMENT
/begin MEASUREMENT B_clkatsp "Bedingung Fehlerpfad DKATSP lˆschen" UWORD B_TRUE 1 100 0 1 BIT_MASK 0x80 FORMAT "%13.11" ECU_ADDRESS 0x7FC942 /end MEASUREMENT
/begin MEASUREMENT B_clkatsp2 "Bedingung Fehlerpfad Dkatsp lˆschen (Stereo)" UWORD B_TRUE 1 100 0 1 BIT_MASK 0x80 FORMAT "%13.11" ECU_ADDRESS 0x7FC944 /end MEASUREMENT
/begin MEASUREMENT B_clkric "Bedingung Fehlerpfad KR-Diagnose Klopfsensorauswerte-IC lˆschen" UWORD B_TRUE 1 100 0 1 BIT_MASK 0x80 FORMAT "%13.11" ECU_ADDRESS 0x7FC94A /end MEASUREMENT
/begin MEASUREMENT B_clkrspi "Bedingung Fehlerpfad KR-Diagnose SPI ‹berwachung lˆschen" UWORD B_TRUE 1 100 0 1 BIT_MASK 0x80 FORMAT "%13.11" ECU_ADDRESS 0x7FC94C /end MEASUREMENT
/begin MEASUREMENT B_clks1 "Bedingung: Fehlerpfad lˆschen, Klopfsensor 1" UWORD B_TRUE 1 100 0 1 BIT_MASK 0x80 FORMAT "%13.11" ECU_ADDRESS 0x7FC94E /end MEASUREMENT
/begin MEASUREMENT B_clks2 "Bedingung: Fehlerpfad lˆschen, Klopfsensor 2" UWORD B_TRUE 1 100 0 1 BIT_MASK 0x80 FORMAT "%13.11" ECU_ADDRESS 0x7FC950 /end MEASUREMENT
/begin MEASUREMENT B_cllash "Fehlerpfad in DLSAHK lˆschen." UWORD B_TRUE 1 100 0 1 BIT_MASK 0x80 FORMAT "%13.11" ECU_ADDRESS 0x7FC954 /end MEASUREMENT
/begin MEASUREMENT B_cllash2 "Fehlerpfad in DLSAHK lˆschen Bank2" UWORD B_TRUE 1 100 0 1 BIT_MASK 0x80 FORMAT "%13.11" ECU_ADDRESS 0x7FC956 /end MEASUREMENT
/begin MEASUREMENT B_cllbk "Bedingung: Fehlerpfand ""LBK-Fehler"" lˆschen" UWORD B_TRUE 1 100 0 1 BIT_MASK 0x80 FORMAT "%13.11" ECU_ADDRESS 0x7FC958 /end MEASUREMENT
/begin MEASUREMENT B_cllbke "Bedingung: Fehlerpfad ""LBK-Fehler-Endstufe"" lˆschen" UWORD B_TRUE 1 100 0 1 BIT_MASK 0x80 FORMAT "%13.11" ECU_ADDRESS 0x7FC95A /end MEASUREMENT
/begin MEASUREMENT B_cllbko "Bedingung: Fehlerpfand ""LBK-Fehler Offset-Adaption"" lˆschen" UWORD B_TRUE 1 100 0 1 BIT_MASK 0x80 FORMAT "%13.11" ECU_ADDRESS 0x7FC95C /end MEASUREMENT
/begin MEASUREMENT B_cllbkp "Bedingung: Fehlerpfand ""LBK-Fehler Potentiometer"" lˆschen" UWORD B_TRUE 1 100 0 1 BIT_MASK 0x80 FORMAT "%13.11" ECU_ADDRESS 0x7FC95E /end MEASUREMENT
/begin MEASUREMENT B_clllr "Bedingung Fehlerpfad DLLR lˆschen" UWORD B_TRUE 1 100 0 1 BIT_MASK 0x80 FORMAT "%13.11" ECU_ADDRESS 0x7FC968 /end MEASUREMENT
/begin MEASUREMENT B_cllsh "Fehlerpfad in DLSH lˆschen" UWORD B_TRUE 1 100 0 1 BIT_MASK 0x80 FORMAT "%13.11" ECU_ADDRESS 0x7FC96C /end MEASUREMENT
/begin MEASUREMENT B_cllsh2 "Fehlerpfad in DLSH lˆschen.  Bank 2" UWORD B_TRUE 1 100 0 1 BIT_MASK 0x80 FORMAT "%13.11" ECU_ADDRESS 0x7FC96E /end MEASUREMENT
/begin MEASUREMENT B_cllsuia "Bedingung Fehler E_lsuia lˆschen," UWORD B_TRUE 1 100 0 1 BIT_MASK 0x80 FORMAT "%13.11" ECU_ADDRESS 0x7FC970 /end MEASUREMENT
/begin MEASUREMENT B_cllsuia2 "Bedingung Fehler E_lsuia2 lˆschen, Bank 2" UWORD B_TRUE 1 100 0 1 BIT_MASK 0x80 FORMAT "%13.11" ECU_ADDRESS 0x7FC972 /end MEASUREMENT
/begin MEASUREMENT B_cllsuun "Bedingung Fehler E_lsuun lˆschen," UWORD B_TRUE 1 100 0 1 BIT_MASK 0x80 FORMAT "%13.11" ECU_ADDRESS 0x7FC974 /end MEASUREMENT
/begin MEASUREMENT B_cllsuun2 "Bedingung Fehler E_lsuun2 lˆschen, Bank 2" UWORD B_TRUE 1 100 0 1 BIT_MASK 0x80 FORMAT "%13.11" ECU_ADDRESS 0x7FC976 /end MEASUREMENT
/begin MEASUREMENT B_cllsuvm "Bedingung Fehler E_lsuvm lˆschen" UWORD B_TRUE 1 100 0 1 BIT_MASK 0x80 FORMAT "%13.11" ECU_ADDRESS 0x7FC978 /end MEASUREMENT
/begin MEASUREMENT B_cllsuvm2 "Bedingung Fehler E_lsuvm2 lˆschen, Bank 2" UWORD B_TRUE 1 100 0 1 BIT_MASK 0x80 FORMAT "%13.11" ECU_ADDRESS 0x7FC97A /end MEASUREMENT
/begin MEASUREMENT B_cllsv "Fehlerpfad in DLSV lˆschen." UWORD B_TRUE 1 100 0 1 BIT_MASK 0x80 FORMAT "%13.11" ECU_ADDRESS 0x7FC97C /end MEASUREMENT
/begin MEASUREMENT B_cllsv2 "Fehlerpfad in DLSV lˆschen.  Bank2" UWORD B_TRUE 1 100 0 1 BIT_MASK 0x80 FORMAT "%13.11" ECU_ADDRESS 0x7FC97E /end MEASUREMENT
/begin MEASUREMENT B_clmd "Flag f¸r Lˆschung: Aussetzer, Summenfehler (multiple)" UWORD B_TRUE 1 100 0 1 BIT_MASK 0x80 FORMAT "%13.11" ECU_ADDRESS 0x7FC98C /end MEASUREMENT
/begin MEASUREMENT B_clmd00 "Flag f¸r Lˆschung: Aussetzer Z¸ndung 0" UWORD B_TRUE 1 100 0 1 BIT_MASK 0x80 FORMAT "%13.11" ECU_ADDRESS 0x7FC98E /end MEASUREMENT
/begin MEASUREMENT B_clmd01 "Flag f¸r Lˆschung: Aussetzer Z¸ndung 1" UWORD B_TRUE 1 100 0 1 BIT_MASK 0x80 FORMAT "%13.11" ECU_ADDRESS 0x7FC990 /end MEASUREMENT
/begin MEASUREMENT B_clmd02 "Flag f¸r Lˆschung: Aussetzer Z¸ndung 2" UWORD B_TRUE 1 100 0 1 BIT_MASK 0x80 FORMAT "%13.11" ECU_ADDRESS 0x7FC992 /end MEASUREMENT
/begin MEASUREMENT B_clmd03 "Flag f¸r Lˆschung: Aussetzer Z¸ndung 3" UWORD B_TRUE 1 100 0 1 BIT_MASK 0x80 FORMAT "%13.11" ECU_ADDRESS 0x7FC994 /end MEASUREMENT
/begin MEASUREMENT B_clmd04 "Flag f¸r Lˆschung: Aussetzer Z¸ndung 4" UWORD B_TRUE 1 100 0 1 BIT_MASK 0x80 FORMAT "%13.11" ECU_ADDRESS 0x7FC996 /end MEASUREMENT
/begin MEASUREMENT B_clmd05 "Flag f¸r Lˆschung: Aussetzer Z¸ndung 5" UWORD B_TRUE 1 100 0 1 BIT_MASK 0x80 FORMAT "%13.11" ECU_ADDRESS 0x7FC998 /end MEASUREMENT
/begin MEASUREMENT B_clmd06 "Flag f¸r Lˆschung: Aussetzer Z¸ndung 6" UWORD B_TRUE 1 100 0 1 BIT_MASK 0x80 FORMAT "%13.11" ECU_ADDRESS 0x7FC99A /end MEASUREMENT
/begin MEASUREMENT B_clmd07 "Flag f¸r Lˆschung: Aussetzer Z¸ndung 7" UWORD B_TRUE 1 100 0 1 BIT_MASK 0x80 FORMAT "%13.11" ECU_ADDRESS 0x7FC99C /end MEASUREMENT
/begin MEASUREMENT B_clmd08 "Flag f¸r Lˆschung: Aussetzer Z¸ndung 8" UWORD B_TRUE 1 100 0 1 BIT_MASK 0x80 FORMAT "%13.11" ECU_ADDRESS 0x7FC99E /end MEASUREMENT
/begin MEASUREMENT B_clmd09 "Flag f¸r Lˆschung: Aussetzer Z¸ndung 9" UWORD B_TRUE 1 100 0 1 BIT_MASK 0x80 FORMAT "%13.11" ECU_ADDRESS 0x7FC9A0 /end MEASUREMENT
/begin MEASUREMENT B_clmd10 "Flag f¸r Lˆschung: Aussetzer Z¸ndung 10" UWORD B_TRUE 1 100 0 1 BIT_MASK 0x80 FORMAT "%13.11" ECU_ADDRESS 0x7FC9A2 /end MEASUREMENT
/begin MEASUREMENT B_clmd11 "Flag f¸r Lˆschung: Aussetzer Z¸ndung 11" UWORD B_TRUE 1 100 0 1 BIT_MASK 0x80 FORMAT "%13.11" ECU_ADDRESS 0x7FC9A4 /end MEASUREMENT
/begin MEASUREMENT B_clrkat "Bedingung Fehlerpfad RKAT lˆschen (add. pro Zeit)" UWORD B_TRUE 1 100 0 1 BIT_MASK 0x80 FORMAT "%13.11" ECU_ADDRESS 0x7FC9D0 /end MEASUREMENT
/begin MEASUREMENT B_clrkat2 "Bedingung Fehlerpfad RKAT2 lˆschen (Stereo)" UWORD B_TRUE 1 100 0 1 BIT_MASK 0x80 FORMAT "%13.11" ECU_ADDRESS 0x7FC9D2 /end MEASUREMENT
/begin MEASUREMENT B_clrkaz "Bedingung Fehlerpfad RKAZ lˆschen (add. pro Z¸ndung)" UWORD B_TRUE 1 100 0 1 BIT_MASK 0x80 FORMAT "%13.11" ECU_ADDRESS 0x7FC9D4 /end MEASUREMENT
/begin MEASUREMENT B_clrkaz2 "Bedingung Fehlerpfad RKAZ2 lˆschen (Stereo)" UWORD B_TRUE 1 100 0 1 BIT_MASK 0x80 FORMAT "%13.11" ECU_ADDRESS 0x7FC9D6 /end MEASUREMENT
/begin MEASUREMENT B_fahsh "Bedingung Funktionsanforderung Diagnose Heizung Hinterkat-Lambdasonde" UWORD B_TRUE 1 100 0 1 BIT_MASK 0x10 FORMAT "%13.11" ECU_ADDRESS 0x7FC926 /end MEASUREMENT
/begin MEASUREMENT B_fahsh2 "" UWORD B_TRUE 1 100 0 1 BIT_MASK 0x10 FORMAT "%13.11" ECU_ADDRESS 0x7FC928 /end MEASUREMENT
/begin MEASUREMENT B_falash "" UWORD B_TRUE 1 100 0 1 BIT_MASK 0x10 FORMAT "%13.11" ECU_ADDRESS 0x7FC954 /end MEASUREMENT
/begin MEASUREMENT B_falash2 "" UWORD B_TRUE 1 100 0 1 BIT_MASK 0x10 FORMAT "%13.11" ECU_ADDRESS 0x7FC956 /end MEASUREMENT
/begin MEASUREMENT B_ftfrao "Bedingung Fehlereintrag durch Tester f¸r FRAO" UWORD B_TRUE 1 100 0 1 BIT_MASK 0x10 FORMAT "%13.11" ECU_ADDRESS 0x7FC914 /end MEASUREMENT
/begin MEASUREMENT B_ftfrao2 "Bedingung Fehlereintrag durch Tester f¸r FRAO2" UWORD B_TRUE 1 100 0 1 BIT_MASK 0x10 FORMAT "%13.11" ECU_ADDRESS 0x7FC916 /end MEASUREMENT
/begin MEASUREMENT B_ftfrau "Bedingung Fehlereintrag durch Tester f¸r FRAU" UWORD B_TRUE 1 100 0 1 BIT_MASK 0x10 FORMAT "%13.11" ECU_ADDRESS 0x7FC918 /end MEASUREMENT
/begin MEASUREMENT B_ftfrau2 "Bedingung Fehlereintrag durch Tester f¸r FRAU2" UWORD B_TRUE 1 100 0 1 BIT_MASK 0x10 FORMAT "%13.11" ECU_ADDRESS 0x7FC91A /end MEASUREMENT
/begin MEASUREMENT B_ftfrst "Bedingung Fehlereintrag durch Tester f¸r FRST (FR-Kurztest)" UWORD B_TRUE 1 100 0 1 BIT_MASK 0x10 FORMAT "%13.11" ECU_ADDRESS 0x7FC91C /end MEASUREMENT
/begin MEASUREMENT B_ftfrst2 "Bedingung Fehlereintrag durch Tester f¸r FRST (FR-Kurztest Bank 2)" UWORD B_TRUE 1 100 0 1 BIT_MASK 0x10 FORMAT "%13.11" ECU_ADDRESS 0x7FC91E /end MEASUREMENT
/begin MEASUREMENT B_ftfst "Bedingung: Fehlereintrag durch Tester FST" UWORD B_TRUE 1 100 0 1 BIT_MASK 0x10 FORMAT "%13.11" ECU_ADDRESS 0x7FC920 /end MEASUREMENT
/begin MEASUREMENT B_ftfst2 "Bedingung: Fehlereintrag durch Tester FST2" UWORD B_TRUE 1 100 0 1 BIT_MASK 0x10 FORMAT "%13.11" ECU_ADDRESS 0x7FC922 /end MEASUREMENT
/begin MEASUREMENT B_fthfm "Bedingung: Fehlereintrag durch Tester f¸r HFM" UWORD B_TRUE 1 100 0 1 BIT_MASK 0x10 FORMAT "%13.11" ECU_ADDRESS 0x7FC924 /end MEASUREMENT
/begin MEASUREMENT B_fthsv "Bedingung Fehlereintrag durch Tester f¸r LSU-Heizung" UWORD B_TRUE 1 100 0 1 BIT_MASK 0x10 FORMAT "%13.11" ECU_ADDRESS 0x7FC92E /end MEASUREMENT
/begin MEASUREMENT B_fthsv2 "Bedingung Fehlereintrag durch Tester f¸r LSU-Heizung, Bank 2" UWORD B_TRUE 1 100 0 1 BIT_MASK 0x10 FORMAT "%13.11" ECU_ADDRESS 0x7FC930 /end MEASUREMENT
/begin MEASUREMENT B_fthsve "Bedingung Fehlereintrag durch Tester f¸r Heizer der LSU" UWORD B_TRUE 1 100 0 1 BIT_MASK 0x10 FORMAT "%13.11" ECU_ADDRESS 0x7FC932 /end MEASUREMENT
/begin MEASUREMENT B_fthsve2 "Bedingung Fehlereintrag durch Tester f¸r Heizer der LSU, Bank 2" UWORD B_TRUE 1 100 0 1 BIT_MASK 0x10 FORMAT "%13.11" ECU_ADDRESS 0x7FC934 /end MEASUREMENT
/begin MEASUREMENT B_fticlsu "Bedingung Fehlereintrag durch Tester f¸r Auswerte-IC der LSU" UWORD B_TRUE 1 100 0 1 BIT_MASK 0x10 FORMAT "%13.11" ECU_ADDRESS 0x7FC93A /end MEASUREMENT
/begin MEASUREMENT B_fticlsu2 "Bedingung Fehlereintrag durch Tester f¸r Auswerte-IC der LSU, Bank 2" UWORD B_TRUE 1 100 0 1 BIT_MASK 0x10 FORMAT "%13.11" ECU_ADDRESS 0x7FC93C /end MEASUREMENT
/begin MEASUREMENT B_ftkat "Bedingung: Fehlereintrag durch Tester f¸r Katalysator" UWORD B_TRUE 1 100 0 1 BIT_MASK 0x10 FORMAT "%13.11" ECU_ADDRESS 0x7FC93E /end MEASUREMENT
/begin MEASUREMENT B_ftkat2 "Bedingung: Fehlereintrag durch Tester f¸r Katalysator, Bank2" UWORD B_TRUE 1 100 0 1 BIT_MASK 0x10 FORMAT "%13.11" ECU_ADDRESS 0x7FC940 /end MEASUREMENT
/begin MEASUREMENT B_ftkatsp "Bedingung: Fehlereintrag durch Tester f¸r Katalysator" UWORD B_TRUE 1 100 0 1 BIT_MASK 0x10 FORMAT "%13.11" ECU_ADDRESS 0x7FC942 /end MEASUREMENT
/begin MEASUREMENT B_ftkatsp2 "Bedingung: Fehlereintrag durch Tester f¸r Katalysator, Bank2" UWORD B_TRUE 1 100 0 1 BIT_MASK 0x10 FORMAT "%13.11" ECU_ADDRESS 0x7FC944 /end MEASUREMENT
/begin MEASUREMENT B_ftkric "" UWORD B_TRUE 1 100 0 1 BIT_MASK 0x10 FORMAT "%13.11" ECU_ADDRESS 0x7FC94A /end MEASUREMENT
/begin MEASUREMENT B_ftkrspi "" UWORD B_TRUE 1 100 0 1 BIT_MASK 0x10 FORMAT "%13.11" ECU_ADDRESS 0x7FC94C /end MEASUREMENT
/begin MEASUREMENT B_ftks1 "" UWORD B_TRUE 1 100 0 1 BIT_MASK 0x10 FORMAT "%13.11" ECU_ADDRESS 0x7FC94E /end MEASUREMENT
/begin MEASUREMENT B_ftks2 "" UWORD B_TRUE 1 100 0 1 BIT_MASK 0x10 FORMAT "%13.11" ECU_ADDRESS 0x7FC950 /end MEASUREMENT
/begin MEASUREMENT B_ftlbk "Bedingung: Fehlereintrag durch Tester f¸r LBK" UWORD B_TRUE 1 100 0 1 BIT_MASK 0x10 FORMAT "%13.11" ECU_ADDRESS 0x7FC958 /end MEASUREMENT
/begin MEASUREMENT B_ftlbke "Bedingung: Fehlereintrag durch Tester f¸r LBK Endstufe" UWORD B_TRUE 1 100 0 1 BIT_MASK 0x10 FORMAT "%13.11" ECU_ADDRESS 0x7FC95A /end MEASUREMENT
/begin MEASUREMENT B_ftlbko "Bedingung: Fehlereintrag durch Tester f¸r LBK Offset-Adaption" UWORD B_TRUE 1 100 0 1 BIT_MASK 0x10 FORMAT "%13.11" ECU_ADDRESS 0x7FC95C /end MEASUREMENT
/begin MEASUREMENT B_ftlbkp "Bedingung: Fehlereintrag durch Tester f¸r LBK Potentiometer" UWORD B_TRUE 1 100 0 1 BIT_MASK 0x10 FORMAT "%13.11" ECU_ADDRESS 0x7FC95E /end MEASUREMENT
/begin MEASUREMENT B_ftllr "" UWORD B_TRUE 1 100 0 1 BIT_MASK 0x10 FORMAT "%13.11" ECU_ADDRESS 0x7FC968 /end MEASUREMENT
/begin MEASUREMENT B_ftlsh "Bedingung Fehlereintrag durch Tester Lambda Sonde hinter KAT" UWORD B_TRUE 1 100 0 1 BIT_MASK 0x10 FORMAT "%13.11" ECU_ADDRESS 0x7FC96C /end MEASUREMENT
/begin MEASUREMENT B_ftlsh2 "Bedingung Fehlereintrag durch Tester Lambda Sonde hinter KAT Bank2" UWORD B_TRUE 1 100 0 1 BIT_MASK 0x10 FORMAT "%13.11" ECU_ADDRESS 0x7FC96E /end MEASUREMENT
/begin MEASUREMENT B_ftlsuia "Bedingung: Fehlereintrag durch Tester f¸r LSU-Leitung IA" UWORD B_TRUE 1 100 0 1 BIT_MASK 0x10 FORMAT "%13.11" ECU_ADDRESS 0x7FC970 /end MEASUREMENT
/begin MEASUREMENT B_ftlsuia2 "Bedingung: Fehlereintrag durch Tester f¸r LSU-Leitung IA, Bank 2" UWORD B_TRUE 1 100 0 1 BIT_MASK 0x10 FORMAT "%13.11" ECU_ADDRESS 0x7FC972 /end MEASUREMENT
/begin MEASUREMENT B_ftlsuun "Bedingung: Fehlereintrag durch Tester f¸r LSU-Leitung UN" UWORD B_TRUE 1 100 0 1 BIT_MASK 0x10 FORMAT "%13.11" ECU_ADDRESS 0x7FC974 /end MEASUREMENT
/begin MEASUREMENT B_ftlsuun2 "Bedingung: Fehlereintrag durch Tester f¸r LSU-Leitung UN, Bank 2" UWORD B_TRUE 1 100 0 1 BIT_MASK 0x10 FORMAT "%13.11" ECU_ADDRESS 0x7FC976 /end MEASUREMENT
/begin MEASUREMENT B_ftlsuvm "Bedingung: Fehlereintrag durch Tester f¸r LSU-Leitung VM" UWORD B_TRUE 1 100 0 1 BIT_MASK 0x10 FORMAT "%13.11" ECU_ADDRESS 0x7FC978 /end MEASUREMENT
/begin MEASUREMENT B_ftlsuvm2 "Bedingung: Fehlereintrag durch Tester f¸r LSU-Leitung VM, Bank 2" UWORD B_TRUE 1 100 0 1 BIT_MASK 0x10 FORMAT "%13.11" ECU_ADDRESS 0x7FC97A /end MEASUREMENT
/begin MEASUREMENT B_ftlsv "Bedingung Fehlereintrag durch Tester Lambda Sonde vor KAT" UWORD B_TRUE 1 100 0 1 BIT_MASK 0x10 FORMAT "%13.11" ECU_ADDRESS 0x7FC97C /end MEASUREMENT
/begin MEASUREMENT B_ftlsv2 "Bedingung Fehlereintrag durch Tester Lambda Sonde vor KAT Bank2" UWORD B_TRUE 1 100 0 1 BIT_MASK 0x10 FORMAT "%13.11" ECU_ADDRESS 0x7FC97E /end MEASUREMENT
/begin MEASUREMENT B_ftmd "Bedingung: Fehlereintrag durch Tester f¸r MD" UWORD B_TRUE 1 100 0 1 BIT_MASK 0x10 FORMAT "%13.11" ECU_ADDRESS 0x7FC98C /end MEASUREMENT
/begin MEASUREMENT B_ftmd00 "" UWORD B_TRUE 1 100 0 1 BIT_MASK 0x10 FORMAT "%13.11" ECU_ADDRESS 0x7FC98E /end MEASUREMENT
/begin MEASUREMENT B_ftmd01 "" UWORD B_TRUE 1 100 0 1 BIT_MASK 0x10 FORMAT "%13.11" ECU_ADDRESS 0x7FC990 /end MEASUREMENT
/begin MEASUREMENT B_ftmd02 "" UWORD B_TRUE 1 100 0 1 BIT_MASK 0x10 FORMAT "%13.11" ECU_ADDRESS 0x7FC992 /end MEASUREMENT
/begin MEASUREMENT B_ftmd03 "" UWORD B_TRUE 1 100 0 1 BIT_MASK 0x10 FORMAT "%13.11" ECU_ADDRESS 0x7FC994 /end MEASUREMENT
/begin MEASUREMENT B_ftmd04 "" UWORD B_TRUE 1 100 0 1 BIT_MASK 0x10 FORMAT "%13.11" ECU_ADDRESS 0x7FC996 /end MEASUREMENT
/begin MEASUREMENT B_ftmd05 "" UWORD B_TRUE 1 100 0 1 BIT_MASK 0x10 FORMAT "%13.11" ECU_ADDRESS 0x7FC998 /end MEASUREMENT
/begin MEASUREMENT B_ftmd06 "" UWORD B_TRUE 1 100 0 1 BIT_MASK 0x10 FORMAT "%13.11" ECU_ADDRESS 0x7FC99A /end MEASUREMENT
/begin MEASUREMENT B_ftmd07 "" UWORD B_TRUE 1 100 0 1 BIT_MASK 0x10 FORMAT "%13.11" ECU_ADDRESS 0x7FC99C /end MEASUREMENT
/begin MEASUREMENT B_ftmd08 "" UWORD B_TRUE 1 100 0 1 BIT_MASK 0x10 FORMAT "%13.11" ECU_ADDRESS 0x7FC99E /end MEASUREMENT
/begin MEASUREMENT B_ftmd09 "" UWORD B_TRUE 1 100 0 1 BIT_MASK 0x10 FORMAT "%13.11" ECU_ADDRESS 0x7FC9A0 /end MEASUREMENT
/begin MEASUREMENT B_ftmd10 "" UWORD B_TRUE 1 100 0 1 BIT_MASK 0x10 FORMAT "%13.11" ECU_ADDRESS 0x7FC9A2 /end MEASUREMENT
/begin MEASUREMENT B_ftmd11 "" UWORD B_TRUE 1 100 0 1 BIT_MASK 0x10 FORMAT "%13.11" ECU_ADDRESS 0x7FC9A4 /end MEASUREMENT
/begin MEASUREMENT B_ftrkat "Bedingung Fehlereintrag durch Tester f¸r RKAT" UWORD B_TRUE 1 100 0 1 BIT_MASK 0x10 FORMAT "%13.11" ECU_ADDRESS 0x7FC9D0 /end MEASUREMENT
/begin MEASUREMENT B_ftrkat2 "Bedingung Fehlereintrag durch Tester f¸r RKAT2" UWORD B_TRUE 1 100 0 1 BIT_MASK 0x10 FORMAT "%13.11" ECU_ADDRESS 0x7FC9D2 /end MEASUREMENT
/begin MEASUREMENT B_ftrkaz "Bedingung Fehlereintrag durch Tester f¸r RKAZ" UWORD B_TRUE 1 100 0 1 BIT_MASK 0x10 FORMAT "%13.11" ECU_ADDRESS 0x7FC9D4 /end MEASUREMENT
/begin MEASUREMENT B_ftrkaz2 "Bedingung Fehlereintrag durch Tester f¸r RKAZ2" UWORD B_TRUE 1 100 0 1 BIT_MASK 0x10 FORMAT "%13.11" ECU_ADDRESS 0x7FC9D6 /end MEASUREMENT
/begin MEASUREMENT B_mnfrao "Bedingung untere Plausibilit‰tsschwelle unterschritten (obere Multipl.)" UWORD B_TRUE 1 100 0 1 BIT_MASK 0x200 FORMAT "%13.11" ECU_ADDRESS 0x7FC914 /end MEASUREMENT
/begin MEASUREMENT B_mnfrao2 "Bedingung untere Plausibilit‰tsschwelle unterschritten (Stereo)" UWORD B_TRUE 1 100 0 1 BIT_MASK 0x200 FORMAT "%13.11" ECU_ADDRESS 0x7FC916 /end MEASUREMENT
/begin MEASUREMENT B_mnfrau "Bedingung untere Plausibilit‰tsschwelle unterschritten (untere Multipl.)" UWORD B_TRUE 1 100 0 1 BIT_MASK 0x200 FORMAT "%13.11" ECU_ADDRESS 0x7FC918 /end MEASUREMENT
/begin MEASUREMENT B_mnfrau2 "Bedingung untere Plausibilit‰tsschwelle unterschritten (Stereo)" UWORD B_TRUE 1 100 0 1 BIT_MASK 0x200 FORMAT "%13.11" ECU_ADDRESS 0x7FC91A /end MEASUREMENT
/begin MEASUREMENT B_mnfrst "Bedingung untere Plausibilit‰tsschwelle unterschritten(short test)" UWORD B_TRUE 1 100 0 1 BIT_MASK 0x200 FORMAT "%13.11" ECU_ADDRESS 0x7FC91C /end MEASUREMENT
/begin MEASUREMENT B_mnfrst2 "Bedingung untere Plausibilit‰tsschwelle unterschritten(short test Stereo" UWORD B_TRUE 1 100 0 1 BIT_MASK 0x200 FORMAT "%13.11" ECU_ADDRESS 0x7FC91E /end MEASUREMENT
/begin MEASUREMENT B_mnfst "Fehlertyp: Kurzschluﬂ nach Masse Tankf¸llstandssensor" UWORD B_TRUE 1 100 0 1 BIT_MASK 0x200 FORMAT "%13.11" ECU_ADDRESS 0x7FC920 /end MEASUREMENT
/begin MEASUREMENT B_mnfst2 "Fehlertyp: Kurzschluﬂ nach Masse Tank2 F¸llstandssensor" UWORD B_TRUE 1 100 0 1 BIT_MASK 0x200 FORMAT "%13.11" ECU_ADDRESS 0x7FC922 /end MEASUREMENT
/begin MEASUREMENT B_mnhfm "Bedingung untere Plausibilit‰tsschwelle unterschritten" UWORD B_TRUE 1 100 0 1 BIT_MASK 0x200 FORMAT "%13.11" ECU_ADDRESS 0x7FC924 /end MEASUREMENT
/begin MEASUREMENT B_mnhsh "Kurzschluﬂ Heizung Lambdasonde hinter Kat nach Masse" UWORD B_TRUE 1 100 0 1 BIT_MASK 0x200 FORMAT "%13.11" ECU_ADDRESS 0x7FC926 /end MEASUREMENT
/begin MEASUREMENT B_mnhsh2 "Kurzschluﬂ Heizung Lambdasonde2 hinter Kat nach Masse" UWORD B_TRUE 1 100 0 1 BIT_MASK 0x200 FORMAT "%13.11" ECU_ADDRESS 0x7FC928 /end MEASUREMENT
/begin MEASUREMENT B_mnhsv "Kurzschluﬂ Heizung Lambdasonde vor Kat nach Masse" UWORD B_TRUE 1 100 0 1 BIT_MASK 0x200 FORMAT "%13.11" ECU_ADDRESS 0x7FC92E /end MEASUREMENT
/begin MEASUREMENT B_mnhsv2 "Kurzschluﬂ Heizung Lambdasonde2 vor Kat nach Masse" UWORD B_TRUE 1 100 0 1 BIT_MASK 0x200 FORMAT "%13.11" ECU_ADDRESS 0x7FC930 /end MEASUREMENT
/begin MEASUREMENT B_mnhsve "Kurzschluﬂ Heizung Lambdasonde vor Kat nach Masse (Endstufe)" UWORD B_TRUE 1 100 0 1 BIT_MASK 0x200 FORMAT "%13.11" ECU_ADDRESS 0x7FC932 /end MEASUREMENT
/begin MEASUREMENT B_mnhsve2 "Kurzschluﬂ Heizung Lambdasonde2 vor Kat nach Masse (Endstufe)" UWORD B_TRUE 1 100 0 1 BIT_MASK 0x200 FORMAT "%13.11" ECU_ADDRESS 0x7FC934 /end MEASUREMENT
/begin MEASUREMENT B_mniclsu "Bedingung MIN-Fehler Auswerte-IC f¸r die LSU" UWORD B_TRUE 1 100 0 1 BIT_MASK 0x200 FORMAT "%13.11" ECU_ADDRESS 0x7FC93A /end MEASUREMENT
/begin MEASUREMENT B_mniclsu2 "Bedingung MIN-Fehler Auswerte-IC f¸r die LSU, Bank 2" UWORD B_TRUE 1 100 0 1 BIT_MASK 0x200 FORMAT "%13.11" ECU_ADDRESS 0x7FC93C /end MEASUREMENT
/begin MEASUREMENT B_mnkat "Fehlertyp 'Minimalwert' erkannt (Katalysator defekt)" UWORD B_TRUE 1 100 0 1 BIT_MASK 0x200 FORMAT "%13.11" ECU_ADDRESS 0x7FC93E /end MEASUREMENT
/begin MEASUREMENT B_mnkat2 "Fehlertyp min.: Katalysator Bank2" UWORD B_TRUE 1 100 0 1 BIT_MASK 0x200 FORMAT "%13.11" ECU_ADDRESS 0x7FC940 /end MEASUREMENT
/begin MEASUREMENT B_mnkatsp "Fehlertyp 'Minimalwert' erkannt (Katalysator defekt)" UWORD B_TRUE 1 100 0 1 BIT_MASK 0x200 FORMAT "%13.11" ECU_ADDRESS 0x7FC942 /end MEASUREMENT
/begin MEASUREMENT B_mnkatsp2 "Fehlertyp min.: Katalysator Bank2" UWORD B_TRUE 1 100 0 1 BIT_MASK 0x200 FORMAT "%13.11" ECU_ADDRESS 0x7FC944 /end MEASUREMENT
/begin MEASUREMENT B_mnkric "Fehlertyp min.: Klopfregelung Klopfsensorauswert IC" UWORD B_TRUE 1 100 0 1 BIT_MASK 0x200 FORMAT "%13.11" ECU_ADDRESS 0x7FC94A /end MEASUREMENT
/begin MEASUREMENT B_mnkrspi "Fehlertyp min.: Klopfregelung SPI-‹berwachung" UWORD B_TRUE 1 100 0 1 BIT_MASK 0x200 FORMAT "%13.11" ECU_ADDRESS 0x7FC94C /end MEASUREMENT
/begin MEASUREMENT B_mnks1 "Bedingung: Min-Fehler Klopfsensor 1" UWORD B_TRUE 1 100 0 1 BIT_MASK 0x200 FORMAT "%13.11" ECU_ADDRESS 0x7FC94E /end MEASUREMENT
/begin MEASUREMENT B_mnks2 "Bedingung: Min-Fehler Klopfsensor 2" UWORD B_TRUE 1 100 0 1 BIT_MASK 0x200 FORMAT "%13.11" ECU_ADDRESS 0x7FC950 /end MEASUREMENT
/begin MEASUREMENT B_mnlash "Fehlertyp 'Minimalwert' f¸r Schwingungspr¸fung hinter KAT erkannt" UWORD B_TRUE 1 100 0 1 BIT_MASK 0x200 FORMAT "%13.11" ECU_ADDRESS 0x7FC954 /end MEASUREMENT
/begin MEASUREMENT B_mnlash2 "Fehlertyp 'Minimalwert' f¸r Schwingungspr¸fung hinter KAT erkannt Bank2" UWORD B_TRUE 1 100 0 1 BIT_MASK 0x200 FORMAT "%13.11" ECU_ADDRESS 0x7FC956 /end MEASUREMENT
/begin MEASUREMENT B_mnlbk "Bedingung: min-Fehler Ladungsbewegungsklappe" UWORD B_TRUE 1 100 0 1 BIT_MASK 0x200 FORMAT "%13.11" ECU_ADDRESS 0x7FC958 /end MEASUREMENT
/begin MEASUREMENT B_mnlbke "Bedingung: min-Fehler Ladungsbewegungsklappe Endstufe" UWORD B_TRUE 1 100 0 1 BIT_MASK 0x200 FORMAT "%13.11" ECU_ADDRESS 0x7FC95A /end MEASUREMENT
/begin MEASUREMENT B_mnlbko "Bedingung: min-Fehler Ladungsbewegungsklappe Offset-Adaption" UWORD B_TRUE 1 100 0 1 BIT_MASK 0x200 FORMAT "%13.11" ECU_ADDRESS 0x7FC95C /end MEASUREMENT
/begin MEASUREMENT B_mnlbkp "Bedingung: min-Fehler LBK Potentiometer" UWORD B_TRUE 1 100 0 1 BIT_MASK 0x200 FORMAT "%13.11" ECU_ADDRESS 0x7FC95E /end MEASUREMENT
/begin MEASUREMENT B_mnllr "Fehler 'Leerlaufdrehzahl zu klein'" UWORD B_TRUE 1 100 0 1 BIT_MASK 0x200 FORMAT "%13.11" ECU_ADDRESS 0x7FC968 /end MEASUREMENT
/begin MEASUREMENT B_mnlsh "Fehlertyp 'Minimalwert' hinter KAT erkannt" UWORD B_TRUE 1 100 0 1 BIT_MASK 0x200 FORMAT "%13.11" ECU_ADDRESS 0x7FC96C /end MEASUREMENT
/begin MEASUREMENT B_mnlsh2 "Fehlertyp 'Minimalwert' hinter KAT erkannt  Bank2" UWORD B_TRUE 1 100 0 1 BIT_MASK 0x200 FORMAT "%13.11" ECU_ADDRESS 0x7FC96E /end MEASUREMENT
/begin MEASUREMENT B_mnlsuia "Fehlertyp 'Minimalwert'  an Sondenleitung IA erkannt" UWORD B_TRUE 1 100 0 1 BIT_MASK 0x200 FORMAT "%13.11" ECU_ADDRESS 0x7FC970 /end MEASUREMENT
/begin MEASUREMENT B_mnlsuia2 "Fehlertyp 'Minimalwert'  an Sondenleitung IA erkannt, Bank 2" UWORD B_TRUE 1 100 0 1 BIT_MASK 0x200 FORMAT "%13.11" ECU_ADDRESS 0x7FC972 /end MEASUREMENT
/begin MEASUREMENT B_mnlsuun "Fehlertyp 'Minimalwert'  an Sondenleitung UN erkannt" UWORD B_TRUE 1 100 0 1 BIT_MASK 0x200 FORMAT "%13.11" ECU_ADDRESS 0x7FC974 /end MEASUREMENT
/begin MEASUREMENT B_mnlsuun2 "Fehlertyp 'Minimalwert'  an Sondenleitung UN erkannt, Bank 2" UWORD B_TRUE 1 100 0 1 BIT_MASK 0x200 FORMAT "%13.11" ECU_ADDRESS 0x7FC976 /end MEASUREMENT
/begin MEASUREMENT B_mnlsuvm "Fehlertyp 'Minimalwert'  an Sondenleitung VM erkannt" UWORD B_TRUE 1 100 0 1 BIT_MASK 0x200 FORMAT "%13.11" ECU_ADDRESS 0x7FC978 /end MEASUREMENT
/begin MEASUREMENT B_mnlsuvm2 "Fehlertyp 'Minimalwert'  an Sondenleitung VM erkannt, Bank 2" UWORD B_TRUE 1 100 0 1 BIT_MASK 0x200 FORMAT "%13.11" ECU_ADDRESS 0x7FC97A /end MEASUREMENT
/begin MEASUREMENT B_mnlsv "Fehlertyp 'Minimalwert' vor KAT erkannt" UWORD B_TRUE 1 100 0 1 BIT_MASK 0x200 FORMAT "%13.11" ECU_ADDRESS 0x7FC97C /end MEASUREMENT
/begin MEASUREMENT B_mnlsv2 "Fehlertyp 'Minimalwert' vor KAT erkannt  Bank2" UWORD B_TRUE 1 100 0 1 BIT_MASK 0x200 FORMAT "%13.11" ECU_ADDRESS 0x7FC97E /end MEASUREMENT
/begin MEASUREMENT B_mnmd "Fehlertyp min.: Aussetzer, Summenfehler (multiple)" UWORD B_TRUE 1 100 0 1 BIT_MASK 0x200 FORMAT "%13.11" ECU_ADDRESS 0x7FC98C /end MEASUREMENT
/begin MEASUREMENT B_mnmd00 "Fehlertyp min.: Aussetzer Z¸ndung 0" UWORD B_TRUE 1 100 0 1 BIT_MASK 0x200 FORMAT "%13.11" ECU_ADDRESS 0x7FC98E /end MEASUREMENT
/begin MEASUREMENT B_mnmd01 "Fehlertyp min.: Aussetzer Z¸ndung 1" UWORD B_TRUE 1 100 0 1 BIT_MASK 0x200 FORMAT "%13.11" ECU_ADDRESS 0x7FC990 /end MEASUREMENT
/begin MEASUREMENT B_mnmd02 "Fehlertyp min.: Aussetzer Z¸ndung 2" UWORD B_TRUE 1 100 0 1 BIT_MASK 0x200 FORMAT "%13.11" ECU_ADDRESS 0x7FC992 /end MEASUREMENT
/begin MEASUREMENT B_mnmd03 "Fehlertyp min.: Aussetzer Z¸ndung 3" UWORD B_TRUE 1 100 0 1 BIT_MASK 0x200 FORMAT "%13.11" ECU_ADDRESS 0x7FC994 /end MEASUREMENT
/begin MEASUREMENT B_mnmd04 "Fehlertyp min.: Aussetzer Z¸ndung 4" UWORD B_TRUE 1 100 0 1 BIT_MASK 0x200 FORMAT "%13.11" ECU_ADDRESS 0x7FC996 /end MEASUREMENT
/begin MEASUREMENT B_mnmd05 "Fehlertyp min.: Aussetzer Z¸ndung 5" UWORD B_TRUE 1 100 0 1 BIT_MASK 0x200 FORMAT "%13.11" ECU_ADDRESS 0x7FC998 /end MEASUREMENT
/begin MEASUREMENT B_mnmd06 "Fehlertyp min.: Aussetzer Z¸ndung 6" UWORD B_TRUE 1 100 0 1 BIT_MASK 0x200 FORMAT "%13.11" ECU_ADDRESS 0x7FC99A /end MEASUREMENT
/begin MEASUREMENT B_mnmd07 "Fehlertyp min.: Aussetzer Z¸ndung 7" UWORD B_TRUE 1 100 0 1 BIT_MASK 0x200 FORMAT "%13.11" ECU_ADDRESS 0x7FC99C /end MEASUREMENT
/begin MEASUREMENT B_mnmd08 "Fehlertyp min.: Aussetzer Z¸ndung 8" UWORD B_TRUE 1 100 0 1 BIT_MASK 0x200 FORMAT "%13.11" ECU_ADDRESS 0x7FC99E /end MEASUREMENT
/begin MEASUREMENT B_mnmd09 "Fehlertyp min.: Aussetzer Z¸ndung 9" UWORD B_TRUE 1 100 0 1 BIT_MASK 0x200 FORMAT "%13.11" ECU_ADDRESS 0x7FC9A0 /end MEASUREMENT
/begin MEASUREMENT B_mnmd10 "Fehlertyp min.: Aussetzer Z¸ndung 10" UWORD B_TRUE 1 100 0 1 BIT_MASK 0x200 FORMAT "%13.11" ECU_ADDRESS 0x7FC9A2 /end MEASUREMENT
/begin MEASUREMENT B_mnmd11 "Fehlertyp min.: Aussetzer Z¸ndung 11" UWORD B_TRUE 1 100 0 1 BIT_MASK 0x200 FORMAT "%13.11" ECU_ADDRESS 0x7FC9A4 /end MEASUREMENT
/begin MEASUREMENT B_mnrkat "Bedingung untere Plausibilit‰tsschwelle unterschritten (add. pro Zeit)" UWORD B_TRUE 1 100 0 1 BIT_MASK 0x200 FORMAT "%13.11" ECU_ADDRESS 0x7FC9D0 /end MEASUREMENT
/begin MEASUREMENT B_mnrkat2 "Bedingung untere Plausibilit‰tsschwelle unterschritten (Stereo)" UWORD B_TRUE 1 100 0 1 BIT_MASK 0x200 FORMAT "%13.11" ECU_ADDRESS 0x7FC9D2 /end MEASUREMENT
/begin MEASUREMENT B_mnrkaz "Bedingung untere Plausibilit‰tsschwelle unterschritten (add. pro Z¸ndung)" UWORD B_TRUE 1 100 0 1 BIT_MASK 0x200 FORMAT "%13.11" ECU_ADDRESS 0x7FC9D4 /end MEASUREMENT
/begin MEASUREMENT B_mnrkaz2 "Bedingung untere Plausibilit‰tsschwelle unterschritten (Stereo)" UWORD B_TRUE 1 100 0 1 BIT_MASK 0x200 FORMAT "%13.11" ECU_ADDRESS 0x7FC9D6 /end MEASUREMENT
/begin MEASUREMENT B_mxfrao "Bedingung obere Plausibilit‰tsschwelle ¸berschritten (obere Multipl.)" UWORD B_TRUE 1 100 0 1 BIT_MASK 0x100 FORMAT "%13.11" ECU_ADDRESS 0x7FC914 /end MEASUREMENT
/begin MEASUREMENT B_mxfrao2 "Bedingung obere Plausibilit‰tsschwelle ¸berschritten (Stereo)" UWORD B_TRUE 1 100 0 1 BIT_MASK 0x100 FORMAT "%13.11" ECU_ADDRESS 0x7FC916 /end MEASUREMENT
/begin MEASUREMENT B_mxfrau "Bedingung obere Plausiblit‰tsschwelle ¸berschritten (untere Multipl.)" UWORD B_TRUE 1 100 0 1 BIT_MASK 0x100 FORMAT "%13.11" ECU_ADDRESS 0x7FC918 /end MEASUREMENT
/begin MEASUREMENT B_mxfrau2 "Bedingung obere Plausibilit‰tsschwelle ¸berschritten (mult. 2. Bank)" UWORD B_TRUE 1 100 0 1 BIT_MASK 0x100 FORMAT "%13.11" ECU_ADDRESS 0x7FC91A /end MEASUREMENT
/begin MEASUREMENT B_mxfrst "Bedingung obere Plausiblit‰tsschwelle ¸berschritten (short test" UWORD B_TRUE 1 100 0 1 BIT_MASK 0x100 FORMAT "%13.11" ECU_ADDRESS 0x7FC91C /end MEASUREMENT
/begin MEASUREMENT B_mxfrst2 "Bedingung obere Plausiblit‰tsschwelle ¸berschritten (short test Stereo" UWORD B_TRUE 1 100 0 1 BIT_MASK 0x100 FORMAT "%13.11" ECU_ADDRESS 0x7FC91E /end MEASUREMENT
/begin MEASUREMENT B_mxfst "Fehlertyp: Kurzschluﬂ nach Ubatt Tankf¸llstandssensor" UWORD B_TRUE 1 100 0 1 BIT_MASK 0x100 FORMAT "%13.11" ECU_ADDRESS 0x7FC920 /end MEASUREMENT
/begin MEASUREMENT B_mxfst2 "Fehlertyp: Kurzschluﬂ nach Ubatt Tank2 F¸llstandssensor" UWORD B_TRUE 1 100 0 1 BIT_MASK 0x100 FORMAT "%13.11" ECU_ADDRESS 0x7FC922 /end MEASUREMENT
/begin MEASUREMENT B_mxhfm "Bedingung obere Plausibilit‰tsschwelle HFM ¸berschritten" UWORD B_TRUE 1 100 0 1 BIT_MASK 0x100 FORMAT "%13.11" ECU_ADDRESS 0x7FC924 /end MEASUREMENT
/begin MEASUREMENT B_mxhsh "Kurzschluﬂ Heizung Lambdasonde hinter Kat nach UB" UWORD B_TRUE 1 100 0 1 BIT_MASK 0x100 FORMAT "%13.11" ECU_ADDRESS 0x7FC926 /end MEASUREMENT
/begin MEASUREMENT B_mxhsh2 "Kurzschluﬂ Heizung Lambdasonde2 hinter Kat nach UB" UWORD B_TRUE 1 100 0 1 BIT_MASK 0x100 FORMAT "%13.11" ECU_ADDRESS 0x7FC928 /end MEASUREMENT
/begin MEASUREMENT B_mxhsv "Kurzschluﬂ Heizung Lambdasonde vor Kat nach UB" UWORD B_TRUE 1 100 0 1 BIT_MASK 0x100 FORMAT "%13.11" ECU_ADDRESS 0x7FC92E /end MEASUREMENT
/begin MEASUREMENT B_mxhsv2 "Kurzschluﬂ Heizung Lambdasonde2 vor Kat nach UB" UWORD B_TRUE 1 100 0 1 BIT_MASK 0x100 FORMAT "%13.11" ECU_ADDRESS 0x7FC930 /end MEASUREMENT
/begin MEASUREMENT B_mxhsve "Kurzschluﬂ Heizung Lambdasonde vor Kat nach UB (Endstufe)" UWORD B_TRUE 1 100 0 1 BIT_MASK 0x100 FORMAT "%13.11" ECU_ADDRESS 0x7FC932 /end MEASUREMENT
/begin MEASUREMENT B_mxhsve2 "Kurzschluﬂ Heizung Lambdasonde2 vor Kat nach UB (Endstufe)" UWORD B_TRUE 1 100 0 1 BIT_MASK 0x100 FORMAT "%13.11" ECU_ADDRESS 0x7FC934 /end MEASUREMENT
/begin MEASUREMENT B_mxiclsu "Bedingung MAX-Fehler Auswerte-IC f¸r die LSU" UWORD B_TRUE 1 100 0 1 BIT_MASK 0x100 FORMAT "%13.11" ECU_ADDRESS 0x7FC93A /end MEASUREMENT
/begin MEASUREMENT B_mxiclsu2 "Bedingung MAX-Fehler Auswerte-IC f¸r die LSU, Bank 2" UWORD B_TRUE 1 100 0 1 BIT_MASK 0x100 FORMAT "%13.11" ECU_ADDRESS 0x7FC93C /end MEASUREMENT
/begin MEASUREMENT B_mxkat "Bedingung obere Plausibilit‰tsschwelle ¸berschritten" UWORD B_TRUE 1 100 0 1 BIT_MASK 0x100 FORMAT "%13.11" ECU_ADDRESS 0x7FC93E /end MEASUREMENT
/begin MEASUREMENT B_mxkat2 "Bedingung obere Plausibilit‰tsschwelle ¸berschritten (Stereo)" UWORD B_TRUE 1 100 0 1 BIT_MASK 0x100 FORMAT "%13.11" ECU_ADDRESS 0x7FC940 /end MEASUREMENT
/begin MEASUREMENT B_mxkatsp "Bedingung obere Plausibilit‰tsschwelle ¸berschritten" UWORD B_TRUE 1 100 0 1 BIT_MASK 0x100 FORMAT "%13.11" ECU_ADDRESS 0x7FC942 /end MEASUREMENT
/begin MEASUREMENT B_mxkatsp2 "Bedingung obere Plausibilit‰tsschwelle ¸berschritten (Stereo)" UWORD B_TRUE 1 100 0 1 BIT_MASK 0x100 FORMAT "%13.11" ECU_ADDRESS 0x7FC944 /end MEASUREMENT
/begin MEASUREMENT B_mxkric "Fehlertyp max.: Klopfregelung Klopfsensorauswerte IC" UWORD B_TRUE 1 100 0 1 BIT_MASK 0x100 FORMAT "%13.11" ECU_ADDRESS 0x7FC94A /end MEASUREMENT
/begin MEASUREMENT B_mxkrspi "Fehlertyp max.: Klopfregelung SPI-‹berwachung" UWORD B_TRUE 1 100 0 1 BIT_MASK 0x100 FORMAT "%13.11" ECU_ADDRESS 0x7FC94C /end MEASUREMENT
/begin MEASUREMENT B_mxks1 "Bedingung: Max-Fehler Klopfsensor 1" UWORD B_TRUE 1 100 0 1 BIT_MASK 0x100 FORMAT "%13.11" ECU_ADDRESS 0x7FC94E /end MEASUREMENT
/begin MEASUREMENT B_mxks2 "Bedingung: Max-Fehler Klopfsensor 2" UWORD B_TRUE 1 100 0 1 BIT_MASK 0x100 FORMAT "%13.11" ECU_ADDRESS 0x7FC950 /end MEASUREMENT
/begin MEASUREMENT B_mxlash "Fehlertyp 'Maximalwert' f¸r Schwingungs-Pr¸fung hinter KAT erkannt" UWORD B_TRUE 1 100 0 1 BIT_MASK 0x100 FORMAT "%13.11" ECU_ADDRESS 0x7FC954 /end MEASUREMENT
/begin MEASUREMENT B_mxlash2 "Fehlertyp 'Maximalwert' f¸r Schwingungs-Pr¸fung hinter KAT erkannt Bank2" UWORD B_TRUE 1 100 0 1 BIT_MASK 0x100 FORMAT "%13.11" ECU_ADDRESS 0x7FC956 /end MEASUREMENT
/begin MEASUREMENT B_mxlbk "Bedingung: max-Fehler Ladungsbewegungsklappe" UWORD B_TRUE 1 100 0 1 BIT_MASK 0x100 FORMAT "%13.11" ECU_ADDRESS 0x7FC958 /end MEASUREMENT
/begin MEASUREMENT B_mxlbke "Bedingung: max-Fehler Ladungsbewegungsklappe Endstufe" UWORD B_TRUE 1 100 0 1 BIT_MASK 0x100 FORMAT "%13.11" ECU_ADDRESS 0x7FC95A /end MEASUREMENT
/begin MEASUREMENT B_mxlbko "Bedingung: max-Fehler Ladungsbewegungsklappe Offset-Adaption" UWORD B_TRUE 1 100 0 1 BIT_MASK 0x100 FORMAT "%13.11" ECU_ADDRESS 0x7FC95C /end MEASUREMENT
/begin MEASUREMENT B_mxlbkp "Bedingung: max-Fehler LBK Potentiometer" UWORD B_TRUE 1 100 0 1 BIT_MASK 0x100 FORMAT "%13.11" ECU_ADDRESS 0x7FC95E /end MEASUREMENT
/begin MEASUREMENT B_mxllr "Fehler 'Leerlaufdrehzahl zu groﬂ'" UWORD B_TRUE 1 100 0 1 BIT_MASK 0x100 FORMAT "%13.11" ECU_ADDRESS 0x7FC968 /end MEASUREMENT
/begin MEASUREMENT B_mxlsh "Fehlertyp 'Maximalwert' hinter KAT erkannt" UWORD B_TRUE 1 100 0 1 BIT_MASK 0x100 FORMAT "%13.11" ECU_ADDRESS 0x7FC96C /end MEASUREMENT
/begin MEASUREMENT B_mxlsh2 "Fehlertyp 'Maximalwert' hinter KAT erkannt Bank2" UWORD B_TRUE 1 100 0 1 BIT_MASK 0x100 FORMAT "%13.11" ECU_ADDRESS 0x7FC96E /end MEASUREMENT
/begin MEASUREMENT B_mxlsuia "Fehlertyp 'Maximalwert'  an Sondenleitung IA erkannt" UWORD B_TRUE 1 100 0 1 BIT_MASK 0x100 FORMAT "%13.11" ECU_ADDRESS 0x7FC970 /end MEASUREMENT
/begin MEASUREMENT B_mxlsuia2 "Fehlertyp 'Maximalwert'  an Sondenleitung IA erkannt, Bank 2" UWORD B_TRUE 1 100 0 1 BIT_MASK 0x100 FORMAT "%13.11" ECU_ADDRESS 0x7FC972 /end MEASUREMENT
/begin MEASUREMENT B_mxlsuun "Fehlertyp 'Maximalwert'  an Sondenleitung UN erkannt" UWORD B_TRUE 1 100 0 1 BIT_MASK 0x100 FORMAT "%13.11" ECU_ADDRESS 0x7FC974 /end MEASUREMENT
/begin MEASUREMENT B_mxlsuun2 "Fehlertyp 'Maximalwert'  an Sondenleitung UN erkannt, Bank 2" UWORD B_TRUE 1 100 0 1 BIT_MASK 0x100 FORMAT "%13.11" ECU_ADDRESS 0x7FC976 /end MEASUREMENT
/begin MEASUREMENT B_mxlsuvm "Fehlertyp 'Maximalwert'  an Sondenleitung VM erkannt" UWORD B_TRUE 1 100 0 1 BIT_MASK 0x100 FORMAT "%13.11" ECU_ADDRESS 0x7FC978 /end MEASUREMENT
/begin MEASUREMENT B_mxlsuvm2 "Fehlertyp 'Maximalwert'  an Sondenleitung VM erkannt, Bank 2" UWORD B_TRUE 1 100 0 1 BIT_MASK 0x100 FORMAT "%13.11" ECU_ADDRESS 0x7FC97A /end MEASUREMENT
/begin MEASUREMENT B_mxlsv "Fehlertyp 'Maximalwert' vor KAT erkannt" UWORD B_TRUE 1 100 0 1 BIT_MASK 0x100 FORMAT "%13.11" ECU_ADDRESS 0x7FC97C /end MEASUREMENT
/begin MEASUREMENT B_mxlsv2 "Fehlertyp 'Maximalwert' vor KAT erkannt Bank2" UWORD B_TRUE 1 100 0 1 BIT_MASK 0x100 FORMAT "%13.11" ECU_ADDRESS 0x7FC97E /end MEASUREMENT
/begin MEASUREMENT B_mxmd "Fehlertyp max.: Aussetzer, Summenfehler (multiple)" UWORD B_TRUE 1 100 0 1 BIT_MASK 0x100 FORMAT "%13.11" ECU_ADDRESS 0x7FC98C /end MEASUREMENT
/begin MEASUREMENT B_mxmd00 "Fehlertyp max.: Aussetzer Z¸ndung 0" UWORD B_TRUE 1 100 0 1 BIT_MASK 0x100 FORMAT "%13.11" ECU_ADDRESS 0x7FC98E /end MEASUREMENT
/begin MEASUREMENT B_mxmd01 "Fehlertyp max.: Aussetzer Z¸ndung 1" UWORD B_TRUE 1 100 0 1 BIT_MASK 0x100 FORMAT "%13.11" ECU_ADDRESS 0x7FC990 /end MEASUREMENT
/begin MEASUREMENT B_mxmd02 "Fehlertyp max.: Aussetzer Z¸ndung 2" UWORD B_TRUE 1 100 0 1 BIT_MASK 0x100 FORMAT "%13.11" ECU_ADDRESS 0x7FC992 /end MEASUREMENT
/begin MEASUREMENT B_mxmd03 "Fehlertyp max.: Aussetzer Z¸ndung 3" UWORD B_TRUE 1 100 0 1 BIT_MASK 0x100 FORMAT "%13.11" ECU_ADDRESS 0x7FC994 /end MEASUREMENT
/begin MEASUREMENT B_mxmd04 "Fehlertyp max.: Aussetzer Z¸ndung 4" UWORD B_TRUE 1 100 0 1 BIT_MASK 0x100 FORMAT "%13.11" ECU_ADDRESS 0x7FC996 /end MEASUREMENT
/begin MEASUREMENT B_mxmd05 "Fehlertyp max.: Aussetzer Z¸ndung 5" UWORD B_TRUE 1 100 0 1 BIT_MASK 0x100 FORMAT "%13.11" ECU_ADDRESS 0x7FC998 /end MEASUREMENT
/begin MEASUREMENT B_mxmd06 "Fehlertyp max.: Aussetzer Z¸ndung 6" UWORD B_TRUE 1 100 0 1 BIT_MASK 0x100 FORMAT "%13.11" ECU_ADDRESS 0x7FC99A /end MEASUREMENT
/begin MEASUREMENT B_mxmd07 "Fehlertyp max.: Aussetzer Z¸ndung 7" UWORD B_TRUE 1 100 0 1 BIT_MASK 0x100 FORMAT "%13.11" ECU_ADDRESS 0x7FC99C /end MEASUREMENT
/begin MEASUREMENT B_mxmd08 "Fehlertyp max.: Aussetzer Z¸ndung 8" UWORD B_TRUE 1 100 0 1 BIT_MASK 0x100 FORMAT "%13.11" ECU_ADDRESS 0x7FC99E /end MEASUREMENT
/begin MEASUREMENT B_mxmd09 "Fehlertyp max.: Aussetzer Z¸ndung 9" UWORD B_TRUE 1 100 0 1 BIT_MASK 0x100 FORMAT "%13.11" ECU_ADDRESS 0x7FC9A0 /end MEASUREMENT
/begin MEASUREMENT B_mxmd10 "Fehlertyp max.: Aussetzer Z¸ndung 10" UWORD B_TRUE 1 100 0 1 BIT_MASK 0x100 FORMAT "%13.11" ECU_ADDRESS 0x7FC9A2 /end MEASUREMENT
/begin MEASUREMENT B_mxmd11 "Fehlertyp max.: Aussetzer Z¸ndung 11" UWORD B_TRUE 1 100 0 1 BIT_MASK 0x100 FORMAT "%13.11" ECU_ADDRESS 0x7FC9A4 /end MEASUREMENT
/begin MEASUREMENT B_mxrkat "Bedingung obere Plausibilit‰tsschwelle ¸berschritten (add. pro Zeit)" UWORD B_TRUE 1 100 0 1 BIT_MASK 0x100 FORMAT "%13.11" ECU_ADDRESS 0x7FC9D0 /end MEASUREMENT
/begin MEASUREMENT B_mxrkat2 "Bedingung obere Plausibilit‰tsschwelle ¸berschritten (Stereo)" UWORD B_TRUE 1 100 0 1 BIT_MASK 0x100 FORMAT "%13.11" ECU_ADDRESS 0x7FC9D2 /end MEASUREMENT
/begin MEASUREMENT B_mxrkaz "Bedingung obere Plausibilit‰tsschwelle ¸berschritten (add. pro Z¸ndung)" UWORD B_TRUE 1 100 0 1 BIT_MASK 0x100 FORMAT "%13.11" ECU_ADDRESS 0x7FC9D4 /end MEASUREMENT
/begin MEASUREMENT B_mxrkaz2 "Bedingung obere Plausibilit‰tsschwelle ¸berschritten (Stereo)" UWORD B_TRUE 1 100 0 1 BIT_MASK 0x100 FORMAT "%13.11" ECU_ADDRESS 0x7FC9D6 /end MEASUREMENT
/begin MEASUREMENT B_npfrao "Bedingung FRAO ist unplausibel" UWORD B_TRUE 1 100 0 1 BIT_MASK 0x800 FORMAT "%13.11" ECU_ADDRESS 0x7FC914 /end MEASUREMENT
/begin MEASUREMENT B_npfrao2 "Bedingung FRAO ist unplausibel Bank 2" UWORD B_TRUE 1 100 0 1 BIT_MASK 0x800 FORMAT "%13.11" ECU_ADDRESS 0x7FC916 /end MEASUREMENT
/begin MEASUREMENT B_npfrau "Bedingung FRAU ist unplausibel" UWORD B_TRUE 1 100 0 1 BIT_MASK 0x800 FORMAT "%13.11" ECU_ADDRESS 0x7FC918 /end MEASUREMENT
/begin MEASUREMENT B_npfrau2 "Bedingung FRAU ist unplausibel Bank 2" UWORD B_TRUE 1 100 0 1 BIT_MASK 0x800 FORMAT "%13.11" ECU_ADDRESS 0x7FC91A /end MEASUREMENT
/begin MEASUREMENT B_npfrst "Fehlertyp 'unplausibles Pr¸fresultat' erkannt (DKVS Kurztest)" UWORD B_TRUE 1 100 0 1 BIT_MASK 0x800 FORMAT "%13.11" ECU_ADDRESS 0x7FC91C /end MEASUREMENT
/begin MEASUREMENT B_npfrst2 "Fehlertyp 'unplausibles Pr¸fresultat' erkannt (DKVS Kurztest Bank 2)" UWORD B_TRUE 1 100 0 1 BIT_MASK 0x800 FORMAT "%13.11" ECU_ADDRESS 0x7FC91E /end MEASUREMENT
/begin MEASUREMENT B_npfst "Fehlertyp: Fuellstandssensor-Signal nicht plausibel" UWORD B_TRUE 1 100 0 1 BIT_MASK 0x800 FORMAT "%13.11" ECU_ADDRESS 0x7FC920 /end MEASUREMENT
/begin MEASUREMENT B_npfst2 "Fehlertyp: Tank2 Fuellstandssensor-Signal nicht plausibel" UWORD B_TRUE 1 100 0 1 BIT_MASK 0x800 FORMAT "%13.11" ECU_ADDRESS 0x7FC922 /end MEASUREMENT
/begin MEASUREMENT B_nphfm "Bed. HFM hat unplausible Position" UWORD B_TRUE 1 100 0 1 BIT_MASK 0x800 FORMAT "%13.11" ECU_ADDRESS 0x7FC924 /end MEASUREMENT
/begin MEASUREMENT B_nphsh "Nernstwiderstand Sonde hinter Kat zu groﬂ" UWORD B_TRUE 1 100 0 1 BIT_MASK 0x800 FORMAT "%13.11" ECU_ADDRESS 0x7FC926 /end MEASUREMENT
/begin MEASUREMENT B_nphsh2 "Nernstwiderstand Sonde 2 hinter Kat zu groﬂ" UWORD B_TRUE 1 100 0 1 BIT_MASK 0x800 FORMAT "%13.11" ECU_ADDRESS 0x7FC928 /end MEASUREMENT
/begin MEASUREMENT B_nphsv "Nernstwiderstand Sonde vor Kat zu groﬂ" UWORD B_TRUE 1 100 0 1 BIT_MASK 0x800 FORMAT "%13.11" ECU_ADDRESS 0x7FC92E /end MEASUREMENT
/begin MEASUREMENT B_nphsv2 "Nernstwiderstand Sonde 2 vor Kat zu groﬂ" UWORD B_TRUE 1 100 0 1 BIT_MASK 0x800 FORMAT "%13.11" ECU_ADDRESS 0x7FC930 /end MEASUREMENT
/begin MEASUREMENT B_nphsve "Fehlerart: Signal der Heizerzuleitung ist unplausibel (Endstufe)" UWORD B_TRUE 1 100 0 1 BIT_MASK 0x800 FORMAT "%13.11" ECU_ADDRESS 0x7FC932 /end MEASUREMENT
/begin MEASUREMENT B_nphsve2 "Fehlerart: Signal der Heizerzuleitung ist unplausibel, Bank 2 (Endstufe)" UWORD B_TRUE 1 100 0 1 BIT_MASK 0x800 FORMAT "%13.11" ECU_ADDRESS 0x7FC934 /end MEASUREMENT
/begin MEASUREMENT B_npiclsu "Bedingung Plausibilit‰tsfehler Auswerte-IC f¸r LSU" UWORD B_TRUE 1 100 0 1 BIT_MASK 0x800 FORMAT "%13.11" ECU_ADDRESS 0x7FC93A /end MEASUREMENT
/begin MEASUREMENT B_npiclsu2 "Bedingung Plausibilit‰tsfehler Auswerte-IC f¸r LSU, Bank 2" UWORD B_TRUE 1 100 0 1 BIT_MASK 0x800 FORMAT "%13.11" ECU_ADDRESS 0x7FC93C /end MEASUREMENT
/begin MEASUREMENT B_npkat "Fehlertyp 'unplausibles Pr¸fresultat' erkannt (Katalysator)" UWORD B_TRUE 1 100 0 1 BIT_MASK 0x800 FORMAT "%13.11" ECU_ADDRESS 0x7FC93E /end MEASUREMENT
/begin MEASUREMENT B_npkat2 "Fehlertyp 'unplausibles Pr¸fresultat' erkannt (Katalysator)2" UWORD B_TRUE 1 100 0 1 BIT_MASK 0x800 FORMAT "%13.11" ECU_ADDRESS 0x7FC940 /end MEASUREMENT
/begin MEASUREMENT B_npkatsp "Fehlertyp 'unplausibles Pr¸fresultat' erkannt (Katalysator)" UWORD B_TRUE 1 100 0 1 BIT_MASK 0x800 FORMAT "%13.11" ECU_ADDRESS 0x7FC942 /end MEASUREMENT
/begin MEASUREMENT B_npkatsp2 "Fehlertyp 'unplausibles Pr¸fresultat' erkannt (Katalysator)2" UWORD B_TRUE 1 100 0 1 BIT_MASK 0x800 FORMAT "%13.11" ECU_ADDRESS 0x7FC944 /end MEASUREMENT
/begin MEASUREMENT B_npkric "Bedingung Plausibilit‰tsfehler der KR-Diagnose Klopfsensorauswerte IC" UWORD B_TRUE 1 100 0 1 BIT_MASK 0x800 FORMAT "%13.11" ECU_ADDRESS 0x7FC94A /end MEASUREMENT
/begin MEASUREMENT B_npkrspi "Bedingung Plausibilit‰tsfehler der KR-Diagnose SPI-‹berwachung" UWORD B_TRUE 1 100 0 1 BIT_MASK 0x800 FORMAT "%13.11" ECU_ADDRESS 0x7FC94C /end MEASUREMENT
/begin MEASUREMENT B_npks1 "Nicht plausibler Fehler: Klopfsensor 1" UWORD B_TRUE 1 100 0 1 BIT_MASK 0x800 FORMAT "%13.11" ECU_ADDRESS 0x7FC94E /end MEASUREMENT
/begin MEASUREMENT B_npks2 "Nicht plausibler Fehler: Klopfsensor 2" UWORD B_TRUE 1 100 0 1 BIT_MASK 0x800 FORMAT "%13.11" ECU_ADDRESS 0x7FC950 /end MEASUREMENT
/begin MEASUREMENT B_nplash "Fehlertyp 'Wert unplausibel' f¸r Schwingungs-Pr¸fung hinter KAT erkannt" UWORD B_TRUE 1 100 0 1 BIT_MASK 0x800 FORMAT "%13.11" ECU_ADDRESS 0x7FC954 /end MEASUREMENT
/begin MEASUREMENT B_nplash2 "Fehlertyp 'Wert unplausibel' f¸r Schwingungs-Pr¸fung hinter KAT erkannt Bank2" UWORD B_TRUE 1 100 0 1 BIT_MASK 0x800 FORMAT "%13.11" ECU_ADDRESS 0x7FC956 /end MEASUREMENT
/begin MEASUREMENT B_nplbk "Bedingung: Ladungsbewegungklappe nicht plausibel" UWORD B_TRUE 1 100 0 1 BIT_MASK 0x800 FORMAT "%13.11" ECU_ADDRESS 0x7FC958 /end MEASUREMENT
/begin MEASUREMENT B_nplbke "Bedingung: Ladungsbewegungklappe nicht plausibel Endstufe" UWORD B_TRUE 1 100 0 1 BIT_MASK 0x800 FORMAT "%13.11" ECU_ADDRESS 0x7FC95A /end MEASUREMENT
/begin MEASUREMENT B_nplbko "Bedingung: Ladungsbewegungklappe Offset-Adaption nicht plausibel" UWORD B_TRUE 1 100 0 1 BIT_MASK 0x800 FORMAT "%13.11" ECU_ADDRESS 0x7FC95C /end MEASUREMENT
/begin MEASUREMENT B_nplbkp "Bedingung: Ladungsbewegungklappe Potiwert nicht plausibel" UWORD B_TRUE 1 100 0 1 BIT_MASK 0x800 FORMAT "%13.11" ECU_ADDRESS 0x7FC95E /end MEASUREMENT
/begin MEASUREMENT B_npllr "Nicht plausibler Fehler: Leerlaufregelung" UWORD B_TRUE 1 100 0 1 BIT_MASK 0x800 FORMAT "%13.11" ECU_ADDRESS 0x7FC968 /end MEASUREMENT
/begin MEASUREMENT B_nplsh "Fehlertyp 'Wert unplausibel' hinter KAT erkannt" UWORD B_TRUE 1 100 0 1 BIT_MASK 0x800 FORMAT "%13.11" ECU_ADDRESS 0x7FC96C /end MEASUREMENT
/begin MEASUREMENT B_nplsh2 "Fehlertyp 'Wert unplausibel' hinter KAT erkannt Bank2" UWORD B_TRUE 1 100 0 1 BIT_MASK 0x800 FORMAT "%13.11" ECU_ADDRESS 0x7FC96E /end MEASUREMENT
/begin MEASUREMENT B_nplsuia "Fehlertyp 'Plausibilit‰tsfehler'  an Sondenleitung IA aufgetreten" UWORD B_TRUE 1 100 0 1 BIT_MASK 0x800 FORMAT "%13.11" ECU_ADDRESS 0x7FC970 /end MEASUREMENT
/begin MEASUREMENT B_nplsuia2 "Fehlertyp 'Plausibilit‰tsfehler'  an Sondenleitung IA aufgetreten, Bank 2" UWORD B_TRUE 1 100 0 1 BIT_MASK 0x800 FORMAT "%13.11" ECU_ADDRESS 0x7FC972 /end MEASUREMENT
/begin MEASUREMENT B_nplsuun "Fehlertyp 'Plausibilit‰tsfehler'  an Sondenleitung UN aufgetreten" UWORD B_TRUE 1 100 0 1 BIT_MASK 0x800 FORMAT "%13.11" ECU_ADDRESS 0x7FC974 /end MEASUREMENT
/begin MEASUREMENT B_nplsuun2 "Fehlertyp 'Plausibilit‰tsfehler'  an Sondenleitung UN aufgetreten, Bank 2" UWORD B_TRUE 1 100 0 1 BIT_MASK 0x800 FORMAT "%13.11" ECU_ADDRESS 0x7FC976 /end MEASUREMENT
/begin MEASUREMENT B_nplsuvm "Fehlertyp 'Plausibilit‰tsfehler'  an Sondenleitung VM aufgetreten" UWORD B_TRUE 1 100 0 1 BIT_MASK 0x800 FORMAT "%13.11" ECU_ADDRESS 0x7FC978 /end MEASUREMENT
/begin MEASUREMENT B_nplsuvm2 "Fehlertyp 'Plausibilit‰tsfehler'  an Sondenleitung VM aufgetreten, Bank 2" UWORD B_TRUE 1 100 0 1 BIT_MASK 0x800 FORMAT "%13.11" ECU_ADDRESS 0x7FC97A /end MEASUREMENT
/begin MEASUREMENT B_nplsv "Fehlertyp 'Wert unplausibel' erkannt" UWORD B_TRUE 1 100 0 1 BIT_MASK 0x800 FORMAT "%13.11" ECU_ADDRESS 0x7FC97C /end MEASUREMENT
/begin MEASUREMENT B_nplsv2 "Fehlertyp 'Wert unplausibel' erkannt Bank2" UWORD B_TRUE 1 100 0 1 BIT_MASK 0x800 FORMAT "%13.11" ECU_ADDRESS 0x7FC97E /end MEASUREMENT
/begin MEASUREMENT B_npmd "Fehlertyp unplaus.: Aussetzer, Summenfehler (multiple)" UWORD B_TRUE 1 100 0 1 BIT_MASK 0x800 FORMAT "%13.11" ECU_ADDRESS 0x7FC98C /end MEASUREMENT
/begin MEASUREMENT B_npmd00 "Fehlertyp unplaus.: Aussetzer Z¸ndung 0" UWORD B_TRUE 1 100 0 1 BIT_MASK 0x800 FORMAT "%13.11" ECU_ADDRESS 0x7FC98E /end MEASUREMENT
/begin MEASUREMENT B_npmd01 "Fehlertyp unplaus.: Aussetzer Z¸ndung 1" UWORD B_TRUE 1 100 0 1 BIT_MASK 0x800 FORMAT "%13.11" ECU_ADDRESS 0x7FC990 /end MEASUREMENT
/begin MEASUREMENT B_npmd02 "Fehlertyp unplaus.: Aussetzer Z¸ndung 2" UWORD B_TRUE 1 100 0 1 BIT_MASK 0x800 FORMAT "%13.11" ECU_ADDRESS 0x7FC992 /end MEASUREMENT
/begin MEASUREMENT B_npmd03 "Fehlertyp unplaus.: Aussetzer Z¸ndung 3" UWORD B_TRUE 1 100 0 1 BIT_MASK 0x800 FORMAT "%13.11" ECU_ADDRESS 0x7FC994 /end MEASUREMENT
/begin MEASUREMENT B_npmd04 "Fehlertyp unplaus.: Aussetzer Z¸ndung 4" UWORD B_TRUE 1 100 0 1 BIT_MASK 0x800 FORMAT "%13.11" ECU_ADDRESS 0x7FC996 /end MEASUREMENT
/begin MEASUREMENT B_npmd05 "Fehlertyp unplaus.: Aussetzer Z¸ndung 5" UWORD B_TRUE 1 100 0 1 BIT_MASK 0x800 FORMAT "%13.11" ECU_ADDRESS 0x7FC998 /end MEASUREMENT
/begin MEASUREMENT B_npmd06 "Fehlertyp unplaus.: Aussetzer Z¸ndung 6" UWORD B_TRUE 1 100 0 1 BIT_MASK 0x800 FORMAT "%13.11" ECU_ADDRESS 0x7FC99A /end MEASUREMENT
/begin MEASUREMENT B_npmd07 "Fehlertyp unplaus.: Aussetzer Z¸ndung 7" UWORD B_TRUE 1 100 0 1 BIT_MASK 0x800 FORMAT "%13.11" ECU_ADDRESS 0x7FC99C /end MEASUREMENT
/begin MEASUREMENT B_npmd08 "Fehlertyp unplaus.: Aussetzer Z¸ndung 8" UWORD B_TRUE 1 100 0 1 BIT_MASK 0x800 FORMAT "%13.11" ECU_ADDRESS 0x7FC99E /end MEASUREMENT
/begin MEASUREMENT B_npmd09 "Fehlertyp unplaus.: Aussetzer Z¸ndung 9" UWORD B_TRUE 1 100 0 1 BIT_MASK 0x800 FORMAT "%13.11" ECU_ADDRESS 0x7FC9A0 /end MEASUREMENT
/begin MEASUREMENT B_npmd10 "Fehlertyp unplaus.: Aussetzer Z¸ndung 10" UWORD B_TRUE 1 100 0 1 BIT_MASK 0x800 FORMAT "%13.11" ECU_ADDRESS 0x7FC9A2 /end MEASUREMENT
/begin MEASUREMENT B_npmd11 "Fehlertyp unplaus.: Aussetzer Z¸ndung 11" UWORD B_TRUE 1 100 0 1 BIT_MASK 0x800 FORMAT "%13.11" ECU_ADDRESS 0x7FC9A4 /end MEASUREMENT
/begin MEASUREMENT B_nprkat "Bedingung RKAT ist unplausibel" UWORD B_TRUE 1 100 0 1 BIT_MASK 0x800 FORMAT "%13.11" ECU_ADDRESS 0x7FC9D0 /end MEASUREMENT
/begin MEASUREMENT B_nprkat2 "Bedingung RKAT ist unplausibel Bank 2" UWORD B_TRUE 1 100 0 1 BIT_MASK 0x800 FORMAT "%13.11" ECU_ADDRESS 0x7FC9D2 /end MEASUREMENT
/begin MEASUREMENT B_nprkaz "Bedingung RKAZ ist unplausibel" UWORD B_TRUE 1 100 0 1 BIT_MASK 0x800 FORMAT "%13.11" ECU_ADDRESS 0x7FC9D4 /end MEASUREMENT
/begin MEASUREMENT B_nprkaz2 "Bedingung RKAZ ist unplausibel Bank 2" UWORD B_TRUE 1 100 0 1 BIT_MASK 0x800 FORMAT "%13.11" ECU_ADDRESS 0x7FC9D6 /end MEASUREMENT
/begin MEASUREMENT B_sifrao "Fehlertyp 'Signal fehlt' for FRAO erkannt" UWORD B_TRUE 1 100 0 1 BIT_MASK 0x400 FORMAT "%13.11" ECU_ADDRESS 0x7FC914 /end MEASUREMENT
/begin MEASUREMENT B_sifrao2 "Fehlertyp 'Signal fehlt' for FRAO erkannt Bank 2" UWORD B_TRUE 1 100 0 1 BIT_MASK 0x400 FORMAT "%13.11" ECU_ADDRESS 0x7FC916 /end MEASUREMENT
/begin MEASUREMENT B_sifrau "Fehlertyp 'Signal fehlt' f¸r FRAU erkannt" UWORD B_TRUE 1 100 0 1 BIT_MASK 0x400 FORMAT "%13.11" ECU_ADDRESS 0x7FC918 /end MEASUREMENT
/begin MEASUREMENT B_sifrau2 "Fehlertyp 'Signal fehlt' f¸r FRAU erkannt Bank 2" UWORD B_TRUE 1 100 0 1 BIT_MASK 0x400 FORMAT "%13.11" ECU_ADDRESS 0x7FC91A /end MEASUREMENT
/begin MEASUREMENT B_sifrst "Fehlerart: LR-Abweichung" UWORD B_TRUE 1 100 0 1 BIT_MASK 0x400 FORMAT "%13.11" ECU_ADDRESS 0x7FC91C /end MEASUREMENT
/begin MEASUREMENT B_sifrst2 "Fehlerart: LR-Abweichung Bank 2" UWORD B_TRUE 1 100 0 1 BIT_MASK 0x400 FORMAT "%13.11" ECU_ADDRESS 0x7FC91E /end MEASUREMENT
/begin MEASUREMENT B_sifst "Fehlertyp: Fuellstandssensor - Signal nicht in Ordnung" UWORD B_TRUE 1 100 0 1 BIT_MASK 0x400 FORMAT "%13.11" ECU_ADDRESS 0x7FC920 /end MEASUREMENT
/begin MEASUREMENT B_sifst2 "Fehlertyp: Tank2 Fuellstandssensor - Signal nicht in Ordnung" UWORD B_TRUE 1 100 0 1 BIT_MASK 0x400 FORMAT "%13.11" ECU_ADDRESS 0x7FC922 /end MEASUREMENT
/begin MEASUREMENT B_sihfm "Fehlerart: Leitungsabfall HFM" UWORD B_TRUE 1 100 0 1 BIT_MASK 0x400 FORMAT "%13.11" ECU_ADDRESS 0x7FC924 /end MEASUREMENT
/begin MEASUREMENT B_sihsh "Lastabfall Sondenheizung hinter Kat" UWORD B_TRUE 1 100 0 1 BIT_MASK 0x400 FORMAT "%13.11" ECU_ADDRESS 0x7FC926 /end MEASUREMENT
/begin MEASUREMENT B_sihsh2 "Lastabfall Sondenheizung2 hinter Kat" UWORD B_TRUE 1 100 0 1 BIT_MASK 0x400 FORMAT "%13.11" ECU_ADDRESS 0x7FC928 /end MEASUREMENT
/begin MEASUREMENT B_sihsv "Lastabfall Sondenheizung vor Kat" UWORD B_TRUE 1 100 0 1 BIT_MASK 0x400 FORMAT "%13.11" ECU_ADDRESS 0x7FC92E /end MEASUREMENT
/begin MEASUREMENT B_sihsv2 "Lastabfall Sondenheizung2 vor Kat" UWORD B_TRUE 1 100 0 1 BIT_MASK 0x400 FORMAT "%13.11" ECU_ADDRESS 0x7FC930 /end MEASUREMENT
/begin MEASUREMENT B_sihsve "Lastabfall Sondenheizung vor Kat (Endstufe)" UWORD B_TRUE 1 100 0 1 BIT_MASK 0x400 FORMAT "%13.11" ECU_ADDRESS 0x7FC932 /end MEASUREMENT
/begin MEASUREMENT B_sihsve2 "Lastabfall Sondenheizung2 vor Kat (Endstufe)" UWORD B_TRUE 1 100 0 1 BIT_MASK 0x400 FORMAT "%13.11" ECU_ADDRESS 0x7FC934 /end MEASUREMENT
/begin MEASUREMENT B_siiclsu "Bedingung Signalfehler Auswerte-IC f¸r LSU" UWORD B_TRUE 1 100 0 1 BIT_MASK 0x400 FORMAT "%13.11" ECU_ADDRESS 0x7FC93A /end MEASUREMENT
/begin MEASUREMENT B_siiclsu2 "Bedingung Signalfehler Auswerte-IC f¸r LSU, Bank 2" UWORD B_TRUE 1 100 0 1 BIT_MASK 0x400 FORMAT "%13.11" ECU_ADDRESS 0x7FC93C /end MEASUREMENT
/begin MEASUREMENT B_sikat "Fehlertyp 'Signal fehlt' f¸r DKAT erkannt" UWORD B_TRUE 1 100 0 1 BIT_MASK 0x400 FORMAT "%13.11" ECU_ADDRESS 0x7FC93E /end MEASUREMENT
/begin MEASUREMENT B_sikat2 "Fehlertyp 'Signal fehlt' f¸r DKAT 2 erkannt" UWORD B_TRUE 1 100 0 1 BIT_MASK 0x400 FORMAT "%13.11" ECU_ADDRESS 0x7FC940 /end MEASUREMENT
/begin MEASUREMENT B_sikatsp "Fehlertyp 'Signal fehlt' f¸r DKAT erkannt" UWORD B_TRUE 1 100 0 1 BIT_MASK 0x400 FORMAT "%13.11" ECU_ADDRESS 0x7FC942 /end MEASUREMENT
/begin MEASUREMENT B_sikatsp2 "Fehlertyp 'Signal fehlt' f¸r DKAT 2 erkannt" UWORD B_TRUE 1 100 0 1 BIT_MASK 0x400 FORMAT "%13.11" ECU_ADDRESS 0x7FC944 /end MEASUREMENT
/begin MEASUREMENT B_sikric "Fehlertyp: Klopfregelung Klopfsensorauswerte IC" UWORD B_TRUE 1 100 0 1 BIT_MASK 0x400 FORMAT "%13.11" ECU_ADDRESS 0x7FC94A /end MEASUREMENT
/begin MEASUREMENT B_sikrspi "Fehlertyp: Klopfregelung SPI-‹berwachung" UWORD B_TRUE 1 100 0 1 BIT_MASK 0x400 FORMAT "%13.11" ECU_ADDRESS 0x7FC94C /end MEASUREMENT
/begin MEASUREMENT B_siks1 "Fehlertyp: Klopfsensor 1" UWORD B_TRUE 1 100 0 1 BIT_MASK 0x400 FORMAT "%13.11" ECU_ADDRESS 0x7FC94E /end MEASUREMENT
/begin MEASUREMENT B_siks2 "Fehlertyp: Klopfsensor 2" UWORD B_TRUE 1 100 0 1 BIT_MASK 0x400 FORMAT "%13.11" ECU_ADDRESS 0x7FC950 /end MEASUREMENT
/begin MEASUREMENT B_silash "Fehlertyp: Lambdasondenalterung hinter Kat." UWORD B_TRUE 1 100 0 1 BIT_MASK 0x400 FORMAT "%13.11" ECU_ADDRESS 0x7FC954 /end MEASUREMENT
/begin MEASUREMENT B_silash2 "Fehlertyp: Lambdasondenalterung hinter Kat. Bank 2" UWORD B_TRUE 1 100 0 1 BIT_MASK 0x400 FORMAT "%13.11" ECU_ADDRESS 0x7FC956 /end MEASUREMENT
/begin MEASUREMENT B_silbk "Bedingung: Signalfehler Ladungsbewegungsklappe" UWORD B_TRUE 1 100 0 1 BIT_MASK 0x400 FORMAT "%13.11" ECU_ADDRESS 0x7FC958 /end MEASUREMENT
/begin MEASUREMENT B_silbke "Bedingung: Signalfehler Ladungsbewegungsklappe Endstufe" UWORD B_TRUE 1 100 0 1 BIT_MASK 0x400 FORMAT "%13.11" ECU_ADDRESS 0x7FC95A /end MEASUREMENT
/begin MEASUREMENT B_silbko "Bedingung: Signalfehler Ladungsbewegungsklappe Offset-Adaption" UWORD B_TRUE 1 100 0 1 BIT_MASK 0x400 FORMAT "%13.11" ECU_ADDRESS 0x7FC95C /end MEASUREMENT
/begin MEASUREMENT B_silbkp "Bedingung: Signalfehler Ladungsbewegungsklappe Potentiometer" UWORD B_TRUE 1 100 0 1 BIT_MASK 0x400 FORMAT "%13.11" ECU_ADDRESS 0x7FC95E /end MEASUREMENT
/begin MEASUREMENT B_sillr "Fehlertyp: Leerlaufregelung" UWORD B_TRUE 1 100 0 1 BIT_MASK 0x400 FORMAT "%13.11" ECU_ADDRESS 0x7FC968 /end MEASUREMENT
/begin MEASUREMENT B_silsh "Fehlertyp 'Signal fehlt' hinter KAT erkannt" UWORD B_TRUE 1 100 0 1 BIT_MASK 0x400 FORMAT "%13.11" ECU_ADDRESS 0x7FC96C /end MEASUREMENT
/begin MEASUREMENT B_silsh2 "Fehlertyp 'Signal fehlt' hinter KAT erkannt Bank2" UWORD B_TRUE 1 100 0 1 BIT_MASK 0x400 FORMAT "%13.11" ECU_ADDRESS 0x7FC96E /end MEASUREMENT
/begin MEASUREMENT B_silsuia "Fehlertyp 'Signalfehler'  an Sondenleitung IA aufgetreten" UWORD B_TRUE 1 100 0 1 BIT_MASK 0x400 FORMAT "%13.11" ECU_ADDRESS 0x7FC970 /end MEASUREMENT
/begin MEASUREMENT B_silsuia2 "Fehlertyp 'Signalfehler'  an Sondenleitung IA aufgetreten, Bank 2" UWORD B_TRUE 1 100 0 1 BIT_MASK 0x400 FORMAT "%13.11" ECU_ADDRESS 0x7FC972 /end MEASUREMENT
/begin MEASUREMENT B_silsuun "Fehlertyp 'Signalfehler'  an Sondenleitung UN aufgetreten" UWORD B_TRUE 1 100 0 1 BIT_MASK 0x400 FORMAT "%13.11" ECU_ADDRESS 0x7FC974 /end MEASUREMENT
/begin MEASUREMENT B_silsuun2 "Fehlertyp 'Signalfehler'  an Sondenleitung UN aufgetreten, Bank 2" UWORD B_TRUE 1 100 0 1 BIT_MASK 0x400 FORMAT "%13.11" ECU_ADDRESS 0x7FC976 /end MEASUREMENT
/begin MEASUREMENT B_silsuvm "Fehlertyp 'Signalfehler'  an Sondenleitung VM aufgetreten" UWORD B_TRUE 1 100 0 1 BIT_MASK 0x400 FORMAT "%13.11" ECU_ADDRESS 0x7FC978 /end MEASUREMENT
/begin MEASUREMENT B_silsuvm2 "Fehlertyp 'Signalfehler'  an Sondenleitung VM aufgetreten, Bank 2" UWORD B_TRUE 1 100 0 1 BIT_MASK 0x400 FORMAT "%13.11" ECU_ADDRESS 0x7FC97A /end MEASUREMENT
/begin MEASUREMENT B_silsv "Fehlertyp 'Signal fehlt' vor KAT erkannt" UWORD B_TRUE 1 100 0 1 BIT_MASK 0x400 FORMAT "%13.11" ECU_ADDRESS 0x7FC97C /end MEASUREMENT
/begin MEASUREMENT B_silsv2 "Fehlertyp 'Signal fehlt' vor KAT erkannt Bank2" UWORD B_TRUE 1 100 0 1 BIT_MASK 0x400 FORMAT "%13.11" ECU_ADDRESS 0x7FC97E /end MEASUREMENT
/begin MEASUREMENT B_simd "Fehlertyp sig.: Aussetzer, Summenfehler (multiple)" UWORD B_TRUE 1 100 0 1 BIT_MASK 0x400 FORMAT "%13.11" ECU_ADDRESS 0x7FC98C /end MEASUREMENT
/begin MEASUREMENT B_simd00 "Fehlertyp sig.: Aussetzer Z¸ndung 0" UWORD B_TRUE 1 100 0 1 BIT_MASK 0x400 FORMAT "%13.11" ECU_ADDRESS 0x7FC98E /end MEASUREMENT
/begin MEASUREMENT B_simd01 "Fehlertyp sig.: Aussetzer Z¸ndung 1" UWORD B_TRUE 1 100 0 1 BIT_MASK 0x400 FORMAT "%13.11" ECU_ADDRESS 0x7FC990 /end MEASUREMENT
/begin MEASUREMENT B_simd02 "Fehlertyp sig.: Aussetzer Z¸ndung 2" UWORD B_TRUE 1 100 0 1 BIT_MASK 0x400 FORMAT "%13.11" ECU_ADDRESS 0x7FC992 /end MEASUREMENT
/begin MEASUREMENT B_simd03 "Fehlertyp sig.: Aussetzer Z¸ndung 3" UWORD B_TRUE 1 100 0 1 BIT_MASK 0x400 FORMAT "%13.11" ECU_ADDRESS 0x7FC994 /end MEASUREMENT
/begin MEASUREMENT B_simd04 "Fehlertyp sig.: Aussetzer Z¸ndung 4" UWORD B_TRUE 1 100 0 1 BIT_MASK 0x400 FORMAT "%13.11" ECU_ADDRESS 0x7FC996 /end MEASUREMENT
/begin MEASUREMENT B_simd05 "Fehlertyp sig.: Aussetzer Z¸ndung 5" UWORD B_TRUE 1 100 0 1 BIT_MASK 0x400 FORMAT "%13.11" ECU_ADDRESS 0x7FC998 /end MEASUREMENT
/begin MEASUREMENT B_simd06 "Fehlertyp sig.: Aussetzer Z¸ndung 6" UWORD B_TRUE 1 100 0 1 BIT_MASK 0x400 FORMAT "%13.11" ECU_ADDRESS 0x7FC99A /end MEASUREMENT
/begin MEASUREMENT B_simd07 "Fehlertyp sig.: Aussetzer Z¸ndung 7" UWORD B_TRUE 1 100 0 1 BIT_MASK 0x400 FORMAT "%13.11" ECU_ADDRESS 0x7FC99C /end MEASUREMENT
/begin MEASUREMENT B_simd08 "Fehlertyp sig.: Aussetzer Z¸ndung 8" UWORD B_TRUE 1 100 0 1 BIT_MASK 0x400 FORMAT "%13.11" ECU_ADDRESS 0x7FC99E /end MEASUREMENT
/begin MEASUREMENT B_simd09 "Fehlertyp sig.: Aussetzer Z¸ndung 9" UWORD B_TRUE 1 100 0 1 BIT_MASK 0x400 FORMAT "%13.11" ECU_ADDRESS 0x7FC9A0 /end MEASUREMENT
/begin MEASUREMENT B_simd10 "Fehlertyp sig.: Aussetzer Z¸ndung 10" UWORD B_TRUE 1 100 0 1 BIT_MASK 0x400 FORMAT "%13.11" ECU_ADDRESS 0x7FC9A2 /end MEASUREMENT
/begin MEASUREMENT B_simd11 "Fehlertyp sig.: Aussetzer Z¸ndung 11" UWORD B_TRUE 1 100 0 1 BIT_MASK 0x400 FORMAT "%13.11" ECU_ADDRESS 0x7FC9A4 /end MEASUREMENT
/begin MEASUREMENT B_sirkat "Fehlertyp 'Signal fehlt' for RKAT erkannt" UWORD B_TRUE 1 100 0 1 BIT_MASK 0x400 FORMAT "%13.11" ECU_ADDRESS 0x7FC9D0 /end MEASUREMENT
/begin MEASUREMENT B_sirkat2 "Fehlertyp 'Signal fehlt' for RKAT erkannt Bank 2" UWORD B_TRUE 1 100 0 1 BIT_MASK 0x400 FORMAT "%13.11" ECU_ADDRESS 0x7FC9D2 /end MEASUREMENT
/begin MEASUREMENT B_sirkaz "Fehlertyp 'Signal fehlt' for RKAZ erkannt" UWORD B_TRUE 1 100 0 1 BIT_MASK 0x400 FORMAT "%13.11" ECU_ADDRESS 0x7FC9D4 /end MEASUREMENT
/begin MEASUREMENT B_sirkaz2 "Fehlertyp 'Signal fehlt' for RKAZ erkannt Bank 2" UWORD B_TRUE 1 100 0 1 BIT_MASK 0x400 FORMAT "%13.11" ECU_ADDRESS 0x7FC9D6 /end MEASUREMENT
/begin MEASUREMENT E_frao "Errorflag: LR-Adaption oberer multiplikativer Bereich" UWORD B_TRUE 1 100 0 1 BIT_MASK 0x1 FORMAT "%13.11" ECU_ADDRESS 0x7FC914 /end MEASUREMENT
/begin MEASUREMENT E_frao2 "Errorflag: LR-Adaption oberer multiplikativer Bereich (Bank 2)" UWORD B_TRUE 1 100 0 1 BIT_MASK 0x1 FORMAT "%13.11" ECU_ADDRESS 0x7FC916 /end MEASUREMENT
/begin MEASUREMENT E_frau "Errorflag: LR-Adaption unterer multiplikativer Bereich" UWORD B_TRUE 1 100 0 1 BIT_MASK 0x1 FORMAT "%13.11" ECU_ADDRESS 0x7FC918 /end MEASUREMENT
/begin MEASUREMENT E_frau2 "Errorflag: LR-Adaption unterer multiplikativer Bereich (Bank 2)" UWORD B_TRUE 1 100 0 1 BIT_MASK 0x1 FORMAT "%13.11" ECU_ADDRESS 0x7FC91A /end MEASUREMENT
/begin MEASUREMENT E_frst "Errorflag: Fehler aus Diagnose Kraftstoffversorgungssystem (Kurztest)" UWORD B_TRUE 1 100 0 1 BIT_MASK 0x1 FORMAT "%13.11" ECU_ADDRESS 0x7FC91C /end MEASUREMENT
/begin MEASUREMENT E_frst2 "Errorflag: Fehler aus Diagnose Kraftstoffvers.-System (Kurztest Bank 2)" UWORD B_TRUE 1 100 0 1 BIT_MASK 0x1 FORMAT "%13.11" ECU_ADDRESS 0x7FC91E /end MEASUREMENT
/begin MEASUREMENT E_fst "Errorflag: Tankf¸llstand" UWORD B_TRUE 1 100 0 1 BIT_MASK 0x1 FORMAT "%13.11" ECU_ADDRESS 0x7FC920 /end MEASUREMENT
/begin MEASUREMENT E_fst2 "Errorflag: Tank2 F¸llstand" UWORD B_TRUE 1 100 0 1 BIT_MASK 0x1 FORMAT "%13.11" ECU_ADDRESS 0x7FC922 /end MEASUREMENT
/begin MEASUREMENT E_hfm "ersetzt durch E_lm" UWORD B_TRUE 1 100 0 1 BIT_MASK 0x1 FORMAT "%13.11" ECU_ADDRESS 0x7FC924 /end MEASUREMENT
/begin MEASUREMENT E_hsh "Errorflag: Lambdasonden-Heizung hinter Katalysator" UWORD B_TRUE 1 100 0 1 BIT_MASK 0x1 FORMAT "%13.11" ECU_ADDRESS 0x7FC926 /end MEASUREMENT
/begin MEASUREMENT E_hsh2 "Errorflag: Lambdasonden-Heizung hinter Katalysator Bank 2" UWORD B_TRUE 1 100 0 1 BIT_MASK 0x1 FORMAT "%13.11" ECU_ADDRESS 0x7FC928 /end MEASUREMENT
/begin MEASUREMENT E_hsv "Errorflag: Lambdasonden-Heizung vor Katalysator" UWORD B_TRUE 1 100 0 1 BIT_MASK 0x1 FORMAT "%13.11" ECU_ADDRESS 0x7FC92E /end MEASUREMENT
/begin MEASUREMENT E_hsv2 "Errorflag: Lambdasonden-Heizung vor Katalysator Bank 2" UWORD B_TRUE 1 100 0 1 BIT_MASK 0x1 FORMAT "%13.11" ECU_ADDRESS 0x7FC930 /end MEASUREMENT
/begin MEASUREMENT E_hsve "Errorflag: Lambdasonden-Heizung vor Katalysator (Endstufe)" UWORD B_TRUE 1 100 0 1 BIT_MASK 0x1 FORMAT "%13.11" ECU_ADDRESS 0x7FC932 /end MEASUREMENT
/begin MEASUREMENT E_hsve2 "Errorflag: Lambdasonden-Heizung vor Katalysator Bank 2 (Endstufe)" UWORD B_TRUE 1 100 0 1 BIT_MASK 0x1 FORMAT "%13.11" ECU_ADDRESS 0x7FC934 /end MEASUREMENT
/begin MEASUREMENT E_iclsu "Errorflag: Fehler Auswerte-IC f¸r die LSU (Spg.-Versorgung, Kommunikation)" UWORD B_TRUE 1 100 0 1 BIT_MASK 0x1 FORMAT "%13.11" ECU_ADDRESS 0x7FC93A /end MEASUREMENT
/begin MEASUREMENT E_iclsu2 "Errorflag: Fehler Auswerte-IC f¸r die LSU, Bank 2" UWORD B_TRUE 1 100 0 1 BIT_MASK 0x1 FORMAT "%13.11" ECU_ADDRESS 0x7FC93C /end MEASUREMENT
/begin MEASUREMENT E_kat "Errorflag: Katalysator-Konvertierung" UWORD B_TRUE 1 100 0 1 BIT_MASK 0x1 FORMAT "%13.11" ECU_ADDRESS 0x7FC93E /end MEASUREMENT
/begin MEASUREMENT E_kat2 "Errorflag: Katalysator-Konvertierung	(Bank 2)" UWORD B_TRUE 1 100 0 1 BIT_MASK 0x1 FORMAT "%13.11" ECU_ADDRESS 0x7FC940 /end MEASUREMENT
/begin MEASUREMENT E_katsp "Errorflag: Katalysator-Konvertierung" UWORD B_TRUE 1 100 0 1 BIT_MASK 0x1 FORMAT "%13.11" ECU_ADDRESS 0x7FC942 /end MEASUREMENT
/begin MEASUREMENT E_katsp2 "Errorflag: Katalysator-Konvertierung" UWORD B_TRUE 1 100 0 1 BIT_MASK 0x1 FORMAT "%13.11" ECU_ADDRESS 0x7FC944 /end MEASUREMENT
/begin MEASUREMENT E_kric "Errorflag: Klopfregelung Klopfsensorauswerte-IC" UWORD B_TRUE 1 100 0 1 BIT_MASK 0x1 FORMAT "%13.11" ECU_ADDRESS 0x7FC94A /end MEASUREMENT
/begin MEASUREMENT E_krspi "Errorflag: Klopfregelung SPI-‹berwachung" UWORD B_TRUE 1 100 0 1 BIT_MASK 0x1 FORMAT "%13.11" ECU_ADDRESS 0x7FC94C /end MEASUREMENT
/begin MEASUREMENT E_ks1 "Errorflag: Klopfsensor 1" UWORD B_TRUE 1 100 0 1 BIT_MASK 0x1 FORMAT "%13.11" ECU_ADDRESS 0x7FC94E /end MEASUREMENT
/begin MEASUREMENT E_ks2 "Errorflag: Klopfsensor 2" UWORD B_TRUE 1 100 0 1 BIT_MASK 0x1 FORMAT "%13.11" ECU_ADDRESS 0x7FC950 /end MEASUREMENT
/begin MEASUREMENT E_lash "Errorflag: Lambda-Sondenalterung hinter Katalysator" UWORD B_TRUE 1 100 0 1 BIT_MASK 0x1 FORMAT "%13.11" ECU_ADDRESS 0x7FC954 /end MEASUREMENT
/begin MEASUREMENT E_lash2 "Errorflag: Lambda-Sondenalterung hinter Kat. (Bank 2)" UWORD B_TRUE 1 100 0 1 BIT_MASK 0x1 FORMAT "%13.11" ECU_ADDRESS 0x7FC956 /end MEASUREMENT
/begin MEASUREMENT E_lbk "Errorflag: Ladungsbewegungsklappe" UWORD B_TRUE 1 100 0 1 BIT_MASK 0x1 FORMAT "%13.11" ECU_ADDRESS 0x7FC958 /end MEASUREMENT
/begin MEASUREMENT E_lbke "Errorflag: Endstufenfehler der Ladungsbewegungsklappe" UWORD B_TRUE 1 100 0 1 BIT_MASK 0x1 FORMAT "%13.11" ECU_ADDRESS 0x7FC95A /end MEASUREMENT
/begin MEASUREMENT E_lbko "Errorflag: Ladungsbewegungsklappe Offset-Adaption" UWORD B_TRUE 1 100 0 1 BIT_MASK 0x1 FORMAT "%13.11" ECU_ADDRESS 0x7FC95C /end MEASUREMENT
/begin MEASUREMENT E_lbkp "Errorflag: Ladungsbewegungsklappe Potentiometer" UWORD B_TRUE 1 100 0 1 BIT_MASK 0x1 FORMAT "%13.11" ECU_ADDRESS 0x7FC95E /end MEASUREMENT
/begin MEASUREMENT E_llr "Errorflag: Leerlaufregelung" UWORD B_TRUE 1 100 0 1 BIT_MASK 0x1 FORMAT "%13.11" ECU_ADDRESS 0x7FC968 /end MEASUREMENT
/begin MEASUREMENT E_lsh "Errorflag: Lambda-Sonde hinter Kat" UWORD B_TRUE 1 100 0 1 BIT_MASK 0x1 FORMAT "%13.11" ECU_ADDRESS 0x7FC96C /end MEASUREMENT
/begin MEASUREMENT E_lsh2 "Errorflag: Lambda-Sonde hinter Kat Bank2" UWORD B_TRUE 1 100 0 1 BIT_MASK 0x1 FORMAT "%13.11" ECU_ADDRESS 0x7FC96E /end MEASUREMENT
/begin MEASUREMENT E_lsuia "Errorflag: Diagnose Lambdasondenleitung an Bond IA (Leitungsunterbrechung)" UWORD B_TRUE 1 100 0 1 BIT_MASK 0x1 FORMAT "%13.11" ECU_ADDRESS 0x7FC970 /end MEASUREMENT
/begin MEASUREMENT E_lsuia2 "Errorflag: Diagnose Lambdasondenleitung an Bond IA (Leitungsunterbrechung)" UWORD B_TRUE 1 100 0 1 BIT_MASK 0x1 FORMAT "%13.11" ECU_ADDRESS 0x7FC972 /end MEASUREMENT
/begin MEASUREMENT E_lsuun "Errorflag: Diagnose Lambdasondenleitung an Bond UN" UWORD B_TRUE 1 100 0 1 BIT_MASK 0x1 FORMAT "%13.11" ECU_ADDRESS 0x7FC974 /end MEASUREMENT
/begin MEASUREMENT E_lsuun2 "Errorflag: Diagnose Lambdasondenleitung an Bond UN, Bank 2" UWORD B_TRUE 1 100 0 1 BIT_MASK 0x1 FORMAT "%13.11" ECU_ADDRESS 0x7FC976 /end MEASUREMENT
/begin MEASUREMENT E_lsuvm "Errorflag: Diagnose Lambdasondenleitung an Bond VM" UWORD B_TRUE 1 100 0 1 BIT_MASK 0x1 FORMAT "%13.11" ECU_ADDRESS 0x7FC978 /end MEASUREMENT
/begin MEASUREMENT E_lsuvm2 "Errorflag: Diagnose Lambdasondenleitung an Bond VM, Bank 2" UWORD B_TRUE 1 100 0 1 BIT_MASK 0x1 FORMAT "%13.11" ECU_ADDRESS 0x7FC97A /end MEASUREMENT
/begin MEASUREMENT E_lsv "Errorflag: Lambda-Sonde vor Kat" UWORD B_TRUE 1 100 0 1 BIT_MASK 0x1 FORMAT "%13.11" ECU_ADDRESS 0x7FC97C /end MEASUREMENT
/begin MEASUREMENT E_lsv2 "Errorflag: Lambda-Sonde 2 vor Kat" UWORD B_TRUE 1 100 0 1 BIT_MASK 0x1 FORMAT "%13.11" ECU_ADDRESS 0x7FC97E /end MEASUREMENT
/begin MEASUREMENT E_md "Errorflag: Aussetzer, Summenfehler (multiple)" UWORD B_TRUE 1 100 0 1 BIT_MASK 0x1 FORMAT "%13.11" ECU_ADDRESS 0x7FC98C /end MEASUREMENT
/begin MEASUREMENT E_md00 "Errorflag: Aussetzer Z¸ndung 0" UWORD B_TRUE 1 100 0 1 BIT_MASK 0x1 FORMAT "%13.11" ECU_ADDRESS 0x7FC98E /end MEASUREMENT
/begin MEASUREMENT E_md01 "Errorflag: Aussetzer Z¸ndung 1" UWORD B_TRUE 1 100 0 1 BIT_MASK 0x1 FORMAT "%13.11" ECU_ADDRESS 0x7FC990 /end MEASUREMENT
/begin MEASUREMENT E_md02 "Errorflag: Aussetzer Z¸ndung 2" UWORD B_TRUE 1 100 0 1 BIT_MASK 0x1 FORMAT "%13.11" ECU_ADDRESS 0x7FC992 /end MEASUREMENT
/begin MEASUREMENT E_md03 "Errorflag: Aussetzer Z¸ndung 3" UWORD B_TRUE 1 100 0 1 BIT_MASK 0x1 FORMAT "%13.11" ECU_ADDRESS 0x7FC994 /end MEASUREMENT
/begin MEASUREMENT E_md04 "Errorflag: Aussetzer Z¸ndung 4" UWORD B_TRUE 1 100 0 1 BIT_MASK 0x1 FORMAT "%13.11" ECU_ADDRESS 0x7FC996 /end MEASUREMENT
/begin MEASUREMENT E_md05 "Errorflag: Aussetzer Z¸ndung 5" UWORD B_TRUE 1 100 0 1 BIT_MASK 0x1 FORMAT "%13.11" ECU_ADDRESS 0x7FC998 /end MEASUREMENT
/begin MEASUREMENT E_md06 "Errorflag: Aussetzer Z¸ndung 6" UWORD B_TRUE 1 100 0 1 BIT_MASK 0x1 FORMAT "%13.11" ECU_ADDRESS 0x7FC99A /end MEASUREMENT
/begin MEASUREMENT E_md07 "Errorflag: Aussetzer Z¸ndung 7" UWORD B_TRUE 1 100 0 1 BIT_MASK 0x1 FORMAT "%13.11" ECU_ADDRESS 0x7FC99C /end MEASUREMENT
/begin MEASUREMENT E_md08 "Errorflag: Aussetzer Z¸ndung 8" UWORD B_TRUE 1 100 0 1 BIT_MASK 0x1 FORMAT "%13.11" ECU_ADDRESS 0x7FC99E /end MEASUREMENT
/begin MEASUREMENT E_md09 "Errorflag: Aussetzer Z¸ndung 9" UWORD B_TRUE 1 100 0 1 BIT_MASK 0x1 FORMAT "%13.11" ECU_ADDRESS 0x7FC9A0 /end MEASUREMENT
/begin MEASUREMENT E_md10 "Errorflag: Aussetzer Z¸ndung 10" UWORD B_TRUE 1 100 0 1 BIT_MASK 0x1 FORMAT "%13.11" ECU_ADDRESS 0x7FC9A2 /end MEASUREMENT
/begin MEASUREMENT E_md11 "Errorflag: Aussetzer Z¸ndung 11" UWORD B_TRUE 1 100 0 1 BIT_MASK 0x1 FORMAT "%13.11" ECU_ADDRESS 0x7FC9A4 /end MEASUREMENT
/begin MEASUREMENT E_rkat "Errorflag DKVS (additive Korrektur pro Zeit)" UWORD B_TRUE 1 100 0 1 BIT_MASK 0x1 FORMAT "%13.11" ECU_ADDRESS 0x7FC9D0 /end MEASUREMENT
/begin MEASUREMENT E_rkat2 "Errorflag DKVS (additive Korrektur pro Zeit Bank 2)" UWORD B_TRUE 1 100 0 1 BIT_MASK 0x1 FORMAT "%13.11" ECU_ADDRESS 0x7FC9D2 /end MEASUREMENT
/begin MEASUREMENT E_rkaz "Errorflag DKVS (additive Korrektur pro Z¸ndung)" UWORD B_TRUE 1 100 0 1 BIT_MASK 0x1 FORMAT "%13.11" ECU_ADDRESS 0x7FC9D4 /end MEASUREMENT
/begin MEASUREMENT E_rkaz2 "Errorflag DKVS (additive Korrektur pro Z¸ndung Bank 2)" UWORD B_TRUE 1 100 0 1 BIT_MASK 0x1 FORMAT "%13.11" ECU_ADDRESS 0x7FC9D6 /end MEASUREMENT
/begin MEASUREMENT sfpfrao "Status Fehlerpfad: LR-Adaption oberer multiplikativer Bereich" UWORD dez 1 100 0 65535 FORMAT "%8.2" ECU_ADDRESS 0x7FC914 /end MEASUREMENT
/begin MEASUREMENT sfpfrao2 "Status Fehlerpfad: LR Adaption oberer multiplikativer Bereich (Bank2)" UWORD dez 1 100 0 65535 FORMAT "%8.2" ECU_ADDRESS 0x7FC916 /end MEASUREMENT
/begin MEASUREMENT sfpfrau "Status Fehlerpfad: LR Adaption unterer multiplikativer Bereich" UWORD dez 1 100 0 65535 FORMAT "%8.2" ECU_ADDRESS 0x7FC918 /end MEASUREMENT
/begin MEASUREMENT sfpfrau2 "Status Fehlerpfad: LR Adaption unterer multiplikativer Bereich (Bank2)" UWORD dez 1 100 0 65535 FORMAT "%8.2" ECU_ADDRESS 0x7FC91A /end MEASUREMENT
/begin MEASUREMENT sfpfrst "Status Fehlerpfad: LR-Abweichung" UWORD dez 1 100 0 65535 FORMAT "%8.2" ECU_ADDRESS 0x7FC91C /end MEASUREMENT
/begin MEASUREMENT sfpfrst2 "Status Fehlerpfad: LR-Abweichung Bank 2" UWORD dez 1 100 0 65535 FORMAT "%8.2" ECU_ADDRESS 0x7FC91E /end MEASUREMENT
/begin MEASUREMENT sfpfst "Status Fehlerpfad: Tankf¸llstandssensor" UWORD default 1 100 0 65535 FORMAT "%8.2" ECU_ADDRESS 0x7FC920 /end MEASUREMENT
/begin MEASUREMENT sfpfst2 "Status Fehlerpfad: Tank2 F¸llstandssensor" UWORD default 1 100 0 65535 FORMAT "%8.2" ECU_ADDRESS 0x7FC922 /end MEASUREMENT
/begin MEASUREMENT sfphfm "Status Fehlerpfad: HFM" UWORD default 1 100 0 65535 FORMAT "%8.2" ECU_ADDRESS 0x7FC924 /end MEASUREMENT
/begin MEASUREMENT sfphsh "Status Fehlerpfad: Heizung Lambdasonde hinter Kat" UWORD dez 1 100 0 65535 FORMAT "%8.2" ECU_ADDRESS 0x7FC926 /end MEASUREMENT
/begin MEASUREMENT sfphsh2 "Status Fehlerpfad: Heizung Lambdasonde 2 hinter Kat" UWORD dez 1 100 0 65535 FORMAT "%8.2" ECU_ADDRESS 0x7FC928 /end MEASUREMENT
/begin MEASUREMENT sfphsv "Status Fehlerpfad: Heizung Lambdasonde vor Kat" UWORD default 1 100 0 65535 FORMAT "%8.2" ECU_ADDRESS 0x7FC92E /end MEASUREMENT
/begin MEASUREMENT sfphsv2 "Status Fehlerpfad: Heizung Lambdasonde 2 vor Kat" UWORD default 1 100 0 65535 FORMAT "%8.2" ECU_ADDRESS 0x7FC930 /end MEASUREMENT
/begin MEASUREMENT sfphsve "Status Fehlerpfad: Endstufe Heizung Lambdasonde vor Kat" UWORD default 1 100 0 65535 FORMAT "%8.2" ECU_ADDRESS 0x7FC932 /end MEASUREMENT
/begin MEASUREMENT sfphsve2 "Status Fehlerpfad: Endstufe Heizung Lambdasonde 2 vor Kat" UWORD default 1 100 0 65535 FORMAT "%8.2" ECU_ADDRESS 0x7FC934 /end MEASUREMENT
/begin MEASUREMENT sfpiclsu "Status Fehlerpfad E_ICLSU" UWORD dez 1 100 0 65535 FORMAT "%8.2" ECU_ADDRESS 0x7FC93A /end MEASUREMENT
/begin MEASUREMENT sfpiclsu2 "Status Fehlerpfad E_ICLSU, Bank 2" UWORD dez 1 100 0 65535 FORMAT "%8.2" ECU_ADDRESS 0x7FC93C /end MEASUREMENT
/begin MEASUREMENT sfpkat "Status Fehlerpfad: Katalysator-‹berwachung" UWORD dez 1 100 0 65535 FORMAT "%8.2" ECU_ADDRESS 0x7FC93E /end MEASUREMENT
/begin MEASUREMENT sfpkat2 "Status Fehlerpfad: Katalysator-‹berwachung Bank 2" UWORD dez 1 100 0 65535 FORMAT "%8.2" ECU_ADDRESS 0x7FC940 /end MEASUREMENT
/begin MEASUREMENT sfpkatsp "Status Fehlerpfad: Katalysator-‹berwachung" UWORD dez 1 100 0 65535 FORMAT "%8.2" ECU_ADDRESS 0x7FC942 /end MEASUREMENT
/begin MEASUREMENT sfpkatsp2 "Status Fehlerpfad: Katalysator-‹berwachung Bank 2" UWORD dez 1 100 0 65535 FORMAT "%8.2" ECU_ADDRESS 0x7FC944 /end MEASUREMENT
/begin MEASUREMENT sfpkric "Status Fehlerpfad: Klopfregelung Klopfsensorauswerte-IC" UWORD dez 1 100 0 65535 FORMAT "%8.2" ECU_ADDRESS 0x7FC94A /end MEASUREMENT
/begin MEASUREMENT sfpkrspi "Status Fehlerpfad: Klopfregelung SPI-‹berwachung" UWORD dez 1 100 0 65535 FORMAT "%8.2" ECU_ADDRESS 0x7FC94C /end MEASUREMENT
/begin MEASUREMENT sfpks1 "Status Fehlerpfad: Klopfsensor 1" UWORD dez 1 100 0 65535 FORMAT "%8.2" ECU_ADDRESS 0x7FC94E /end MEASUREMENT
/begin MEASUREMENT sfpks2 "Status Fehlerpfad: Klopfsensor 2" UWORD dez 1 100 0 65535 FORMAT "%8.2" ECU_ADDRESS 0x7FC950 /end MEASUREMENT
/begin MEASUREMENT sfplash "Status Fehlerpfad: Lambdasondenalterung hinter Kat" UWORD dez 1 100 0 65535 FORMAT "%8.2" ECU_ADDRESS 0x7FC954 /end MEASUREMENT
/begin MEASUREMENT sfplash2 "Status Fehlerpfad: Lambdasondenalterung hinter Kat Bank2" UWORD dez 1 100 0 65535 FORMAT "%8.2" ECU_ADDRESS 0x7FC956 /end MEASUREMENT
/begin MEASUREMENT sfplbk "Status Fehlerpfand: Diagnose Ladungsbewegungsklappe" UWORD default 1 100 0 65535 FORMAT "%8.2" ECU_ADDRESS 0x7FC958 /end MEASUREMENT
/begin MEASUREMENT sfplbke "Status Fehlerpfand: Diagnose Ladungsbewegungsklappe Endstufe" UWORD default 1 100 0 65535 FORMAT "%8.2" ECU_ADDRESS 0x7FC95A /end MEASUREMENT
/begin MEASUREMENT sfplbko "Status Fehlerpfad: Diagnose Ladungsbewegungsklappe Offset-Adaption" UWORD default 1 100 0 65535 FORMAT "%8.2" ECU_ADDRESS 0x7FC95C /end MEASUREMENT
/begin MEASUREMENT sfplbkp "Status Fehlerpfad: Diagnose LBK Potentiometer" UWORD default 1 100 0 65535 FORMAT "%8.2" ECU_ADDRESS 0x7FC95E /end MEASUREMENT
/begin MEASUREMENT sfpllr "Status Fehlerpfad: Leerlaufregelung" UWORD dez 1 100 0 65535 FORMAT "%8.2" ECU_ADDRESS 0x7FC968 /end MEASUREMENT
/begin MEASUREMENT sfplsh "Status Fehlerpfad: Diagnose Lambdasonde hinter Kat" UWORD dez 1 100 0 65535 FORMAT "%8.2" ECU_ADDRESS 0x7FC96C /end MEASUREMENT
/begin MEASUREMENT sfplsh2 "Status Fehlerpfad: Diagnose Lambdasonde hinter Kat Bank2" UWORD dez 1 100 0 65535 FORMAT "%8.2" ECU_ADDRESS 0x7FC96E /end MEASUREMENT
/begin MEASUREMENT sfplsuia "Status Fehlerpfad: LSU-Leitung IA: Unterbrechung" UWORD dez 1 100 0 65535 FORMAT "%8.2" ECU_ADDRESS 0x7FC970 /end MEASUREMENT
/begin MEASUREMENT sfplsuia2 "Status Fehlerpfad: LSU-Leitung IA defekt, Bank 2" UWORD dez 1 100 0 65535 FORMAT "%8.2" ECU_ADDRESS 0x7FC972 /end MEASUREMENT
/begin MEASUREMENT sfplsuun "Status Fehlerpfad: LSU-Leitung UN defekt" UWORD dez 1 100 0 65535 FORMAT "%8.2" ECU_ADDRESS 0x7FC974 /end MEASUREMENT
/begin MEASUREMENT sfplsuun2 "Status Fehlerpfad: LSU-Leitung UN defekt, Bank 2" UWORD dez 1 100 0 65535 FORMAT "%8.2" ECU_ADDRESS 0x7FC976 /end MEASUREMENT
/begin MEASUREMENT sfplsuvm "Status Fehlerpfad: LSU-Leitung VM defekt" UWORD dez 1 100 0 65535 FORMAT "%8.2" ECU_ADDRESS 0x7FC978 /end MEASUREMENT
/begin MEASUREMENT sfplsuvm2 "Status Fehlerpfad: LSU-Leitung VM defekt, Bank 2" UWORD dez 1 100 0 65535 FORMAT "%8.2" ECU_ADDRESS 0x7FC97A /end MEASUREMENT
/begin MEASUREMENT sfplsv "Status Fehlerpfad: Diagnose Lambdasonde vor Kat" UWORD dez 1 100 0 65535 FORMAT "%8.2" ECU_ADDRESS 0x7FC97C /end MEASUREMENT
/begin MEASUREMENT sfplsv2 "Status Fehlerpfad: Diagnose Lambdasonde vor Kat Bank2" UWORD dez 1 100 0 65535 FORMAT "%8.2" ECU_ADDRESS 0x7FC97E /end MEASUREMENT
/begin MEASUREMENT sfpmd "Statuswort:  Aussetzer, Summenfehler (multiple)" UWORD dez 1 100 0 65535 FORMAT "%8.2" ECU_ADDRESS 0x7FC98C /end MEASUREMENT
/begin MEASUREMENT sfpmd00 "Statuswort:  Aussetzer Z¸ndung 0" UWORD dez 1 100 0 65535 FORMAT "%8.2" ECU_ADDRESS 0x7FC98E /end MEASUREMENT
/begin MEASUREMENT sfpmd01 "Statuswort:  Aussetzer Z¸ndung 1" UWORD dez 1 100 0 65535 FORMAT "%8.2" ECU_ADDRESS 0x7FC990 /end MEASUREMENT
/begin MEASUREMENT sfpmd02 "Statuswort:  Aussetzer Z¸ndung 2" UWORD dez 1 100 0 65535 FORMAT "%8.2" ECU_ADDRESS 0x7FC992 /end MEASUREMENT
/begin MEASUREMENT sfpmd03 "Statuswort:  Aussetzer Z¸ndung 3" UWORD dez 1 100 0 65535 FORMAT "%8.2" ECU_ADDRESS 0x7FC994 /end MEASUREMENT
/begin MEASUREMENT sfpmd04 "Statuswort:  Aussetzer Z¸ndung 4" UWORD dez 1 100 0 65535 FORMAT "%8.2" ECU_ADDRESS 0x7FC996 /end MEASUREMENT
/begin MEASUREMENT sfpmd05 "Statuswort:  Aussetzer Z¸ndung 5" UWORD dez 1 100 0 65535 FORMAT "%8.2" ECU_ADDRESS 0x7FC998 /end MEASUREMENT
/begin MEASUREMENT sfpmd06 "Statuswort:  Aussetzer Z¸ndung 6" UWORD dez 1 100 0 65535 FORMAT "%8.2" ECU_ADDRESS 0x7FC99A /end MEASUREMENT
/begin MEASUREMENT sfpmd07 "Statuswort:  Aussetzer Z¸ndung 7" UWORD dez 1 100 0 65535 FORMAT "%8.2" ECU_ADDRESS 0x7FC99C /end MEASUREMENT
/begin MEASUREMENT sfpmd08 "Statuswort:  Aussetzer Z¸ndung 8" UWORD dez 1 100 0 65535 FORMAT "%8.2" ECU_ADDRESS 0x7FC99E /end MEASUREMENT
/begin MEASUREMENT sfpmd09 "Statuswort:  Aussetzer Z¸ndung 9" UWORD dez 1 100 0 65535 FORMAT "%8.2" ECU_ADDRESS 0x7FC9A0 /end MEASUREMENT
/begin MEASUREMENT sfpmd10 "Statuswort:  Aussetzer Z¸ndung 10" UWORD dez 1 100 0 65535 FORMAT "%8.2" ECU_ADDRESS 0x7FC9A2 /end MEASUREMENT
/begin MEASUREMENT sfpmd11 "Statuswort:  Aussetzer Z¸ndung 11" UWORD dez 1 100 0 65535 FORMAT "%8.2" ECU_ADDRESS 0x7FC9A4 /end MEASUREMENT
/begin MEASUREMENT sfprkat "Status Fehlerpfad: LR Adaption additive Korrektur pro Zeit" UWORD dez 1 100 0 65535 FORMAT "%8.2" ECU_ADDRESS 0x7FC9D0 /end MEASUREMENT
/begin MEASUREMENT sfprkat2 "Status Fehlerpfad: LR Adaption additive Korrektur pro Zeit (Bank 2)" UWORD dez 1 100 0 65535 FORMAT "%8.2" ECU_ADDRESS 0x7FC9D2 /end MEASUREMENT
/begin MEASUREMENT sfprkaz "Status Fehlerpfad: LR Adaption additive Korrektur pro Z¸ndung" UWORD dez 1 100 0 65535 FORMAT "%8.2" ECU_ADDRESS 0x7FC9D4 /end MEASUREMENT
/begin MEASUREMENT sfprkaz2 "Status Fehlerpfad: LR Adaption additive Korrektur pro Z¸ndung (Bank 2)" UWORD dez 1 100 0 65535 FORMAT "%8.2" ECU_ADDRESS 0x7FC9D6 /end MEASUREMENT
/begin MEASUREMENT TYP_frao "" UWORD B_TRUE 1 100 0 1 BIT_MASK 0xf00 FORMAT "%13.11" ECU_ADDRESS 0x7FC914 /end MEASUREMENT
/begin MEASUREMENT TYP_frao2 "" UWORD B_TRUE 1 100 0 1 BIT_MASK 0xf00 FORMAT "%13.11" ECU_ADDRESS 0x7FC916 /end MEASUREMENT
/begin MEASUREMENT TYP_frau "" UWORD B_TRUE 1 100 0 1 BIT_MASK 0xf00 FORMAT "%13.11" ECU_ADDRESS 0x7FC918 /end MEASUREMENT
/begin MEASUREMENT TYP_frau2 "" UWORD B_TRUE 1 100 0 1 BIT_MASK 0xf00 FORMAT "%13.11" ECU_ADDRESS 0x7FC91A /end MEASUREMENT
/begin MEASUREMENT TYP_frst "" UWORD B_TRUE 1 100 0 1 BIT_MASK 0xf00 FORMAT "%13.11" ECU_ADDRESS 0x7FC91C /end MEASUREMENT
/begin MEASUREMENT TYP_frst2 "" UWORD B_TRUE 1 100 0 1 BIT_MASK 0xf00 FORMAT "%13.11" ECU_ADDRESS 0x7FC91E /end MEASUREMENT
/begin MEASUREMENT TYP_fst "" UWORD B_TRUE 1 100 0 1 BIT_MASK 0xf00 FORMAT "%13.11" ECU_ADDRESS 0x7FC920 /end MEASUREMENT
/begin MEASUREMENT TYP_fst2 "" UWORD B_TRUE 1 100 0 1 BIT_MASK 0xf00 FORMAT "%13.11" ECU_ADDRESS 0x7FC922 /end MEASUREMENT
/begin MEASUREMENT TYP_hfm "" UWORD B_TRUE 1 100 0 1 BIT_MASK 0xf00 FORMAT "%13.11" ECU_ADDRESS 0x7FC924 /end MEASUREMENT
/begin MEASUREMENT TYP_hsh "Fehlertyp: Heizung Lambdasonde 1 hinter Kat" UWORD B_TRUE 1 100 0 1 BIT_MASK 0xf00 FORMAT "%13.11" ECU_ADDRESS 0x7FC926 /end MEASUREMENT
/begin MEASUREMENT TYP_hsh2 "Fehlertyp: Heizung Lambdasonde 2 hinter Kat" UWORD B_TRUE 1 100 0 1 BIT_MASK 0xf00 FORMAT "%13.11" ECU_ADDRESS 0x7FC928 /end MEASUREMENT
/begin MEASUREMENT TYP_hsv "Fehlertyp: Heizung Lambdasonde 1 vor Kat" UWORD B_TRUE 1 100 0 1 BIT_MASK 0xf00 FORMAT "%13.11" ECU_ADDRESS 0x7FC92E /end MEASUREMENT
/begin MEASUREMENT TYP_hsv2 "Fehlertyp: Heizung Lambdasonde 2 vor Kat" UWORD B_TRUE 1 100 0 1 BIT_MASK 0xf00 FORMAT "%13.11" ECU_ADDRESS 0x7FC930 /end MEASUREMENT
/begin MEASUREMENT TYP_hsve "Fehlertyp: Endstufe Heizung Lambdasonde 1 vor Kat" UWORD B_TRUE 1 100 0 1 BIT_MASK 0xf00 FORMAT "%13.11" ECU_ADDRESS 0x7FC932 /end MEASUREMENT
/begin MEASUREMENT TYP_hsve2 "Fehlertyp: Endstufe Heizung Lambdasonde 2 vor Kat" UWORD B_TRUE 1 100 0 1 BIT_MASK 0xf00 FORMAT "%13.11" ECU_ADDRESS 0x7FC934 /end MEASUREMENT
/begin MEASUREMENT TYP_iclsu "" UWORD B_TRUE 1 100 0 1 BIT_MASK 0xf00 FORMAT "%13.11" ECU_ADDRESS 0x7FC93A /end MEASUREMENT
/begin MEASUREMENT TYP_iclsu2 "" UWORD B_TRUE 1 100 0 1 BIT_MASK 0xf00 FORMAT "%13.11" ECU_ADDRESS 0x7FC93C /end MEASUREMENT
/begin MEASUREMENT TYP_kat "Fehlertyp: Katalysator-Diagnose" UWORD B_TRUE 1 100 0 1 BIT_MASK 0xf00 FORMAT "%13.11" ECU_ADDRESS 0x7FC93E /end MEASUREMENT
/begin MEASUREMENT TYP_kat2 "" UWORD B_TRUE 1 100 0 1 BIT_MASK 0xf00 FORMAT "%13.11" ECU_ADDRESS 0x7FC940 /end MEASUREMENT
/begin MEASUREMENT TYP_katsp "" UWORD B_TRUE 1 100 0 1 BIT_MASK 0xf00 FORMAT "%13.11" ECU_ADDRESS 0x7FC942 /end MEASUREMENT
/begin MEASUREMENT TYP_katsp2 "" UWORD B_TRUE 1 100 0 1 BIT_MASK 0xf00 FORMAT "%13.11" ECU_ADDRESS 0x7FC944 /end MEASUREMENT
/begin MEASUREMENT TYP_kric "" UWORD B_TRUE 1 100 0 1 BIT_MASK 0xf00 FORMAT "%13.11" ECU_ADDRESS 0x7FC94A /end MEASUREMENT
/begin MEASUREMENT TYP_krspi "" UWORD B_TRUE 1 100 0 1 BIT_MASK 0xf00 FORMAT "%13.11" ECU_ADDRESS 0x7FC94C /end MEASUREMENT
/begin MEASUREMENT TYP_ks1 "" UWORD B_TRUE 1 100 0 1 BIT_MASK 0xf00 FORMAT "%13.11" ECU_ADDRESS 0x7FC94E /end MEASUREMENT
/begin MEASUREMENT TYP_ks2 "" UWORD B_TRUE 1 100 0 1 BIT_MASK 0xf00 FORMAT "%13.11" ECU_ADDRESS 0x7FC950 /end MEASUREMENT
/begin MEASUREMENT TYP_lash "Fehlertyp: Lambda- Sondenalterung hinter Kat" UWORD B_TRUE 1 100 0 1 BIT_MASK 0xf00 FORMAT "%13.11" ECU_ADDRESS 0x7FC954 /end MEASUREMENT
/begin MEASUREMENT TYP_lash2 "Fehlertyp: Lambda-Sondenalterung hinter Kat Bank2" UWORD B_TRUE 1 100 0 1 BIT_MASK 0xf00 FORMAT "%13.11" ECU_ADDRESS 0x7FC956 /end MEASUREMENT
/begin MEASUREMENT TYP_lbk "" UWORD B_TRUE 1 100 0 1 BIT_MASK 0xf00 FORMAT "%13.11" ECU_ADDRESS 0x7FC958 /end MEASUREMENT
/begin MEASUREMENT TYP_lbke "" UWORD B_TRUE 1 100 0 1 BIT_MASK 0xf00 FORMAT "%13.11" ECU_ADDRESS 0x7FC95A /end MEASUREMENT
/begin MEASUREMENT TYP_lbko "" UWORD B_TRUE 1 100 0 1 BIT_MASK 0xf00 FORMAT "%13.11" ECU_ADDRESS 0x7FC95C /end MEASUREMENT
/begin MEASUREMENT TYP_lbkp "" UWORD B_TRUE 1 100 0 1 BIT_MASK 0xf00 FORMAT "%13.11" ECU_ADDRESS 0x7FC95E /end MEASUREMENT
/begin MEASUREMENT TYP_LLR "" UWORD B_TRUE 1 100 0 1 BIT_MASK 0xf00 FORMAT "%13.11" ECU_ADDRESS 0x7FC968 /end MEASUREMENT
/begin MEASUREMENT TYP_lsh "Fehlertyp: Lambdasonde 1 hinter Kat" UWORD B_TRUE 1 100 0 1 BIT_MASK 0xf00 FORMAT "%13.11" ECU_ADDRESS 0x7FC96C /end MEASUREMENT
/begin MEASUREMENT TYP_lsh2 "Fehlertyp: Lambdasonde 2 hinter Kat" UWORD B_TRUE 1 100 0 1 BIT_MASK 0xf00 FORMAT "%13.11" ECU_ADDRESS 0x7FC96E /end MEASUREMENT
/begin MEASUREMENT TYP_lsuia "" UWORD B_TRUE 1 100 0 1 BIT_MASK 0xf00 FORMAT "%13.11" ECU_ADDRESS 0x7FC970 /end MEASUREMENT
/begin MEASUREMENT TYP_lsuia2 "" UWORD B_TRUE 1 100 0 1 BIT_MASK 0xf00 FORMAT "%13.11" ECU_ADDRESS 0x7FC972 /end MEASUREMENT
/begin MEASUREMENT TYP_lsuun "" UWORD B_TRUE 1 100 0 1 BIT_MASK 0xf00 FORMAT "%13.11" ECU_ADDRESS 0x7FC974 /end MEASUREMENT
/begin MEASUREMENT TYP_lsuun2 "" UWORD B_TRUE 1 100 0 1 BIT_MASK 0xf00 FORMAT "%13.11" ECU_ADDRESS 0x7FC976 /end MEASUREMENT
/begin MEASUREMENT TYP_lsuvm "" UWORD B_TRUE 1 100 0 1 BIT_MASK 0xf00 FORMAT "%13.11" ECU_ADDRESS 0x7FC978 /end MEASUREMENT
/begin MEASUREMENT TYP_lsuvm2 "" UWORD B_TRUE 1 100 0 1 BIT_MASK 0xf00 FORMAT "%13.11" ECU_ADDRESS 0x7FC97A /end MEASUREMENT
/begin MEASUREMENT TYP_lsv "Fehlertyp: Lambdasonde 1 vor Kat" UWORD B_TRUE 1 100 0 1 BIT_MASK 0xf00 FORMAT "%13.11" ECU_ADDRESS 0x7FC97C /end MEASUREMENT
/begin MEASUREMENT TYP_lsv2 "Fehlertyp: Lambdasonde 2 vor Kat" UWORD B_TRUE 1 100 0 1 BIT_MASK 0xf00 FORMAT "%13.11" ECU_ADDRESS 0x7FC97E /end MEASUREMENT
/begin MEASUREMENT TYP_md "Fehlertyp:  Aussetzer, Summenfehler (multiple)" UWORD B_TRUE 1 100 0 1 BIT_MASK 0xf00 FORMAT "%13.11" ECU_ADDRESS 0x7FC98C /end MEASUREMENT
/begin MEASUREMENT TYP_md00 "Fehlertyp:  Aussetzer Z¸ndung 0" UWORD B_TRUE 1 100 0 1 BIT_MASK 0xf00 FORMAT "%13.11" ECU_ADDRESS 0x7FC98E /end MEASUREMENT
/begin MEASUREMENT TYP_md01 "Fehlertyp:  Aussetzer Z¸ndung 1" UWORD B_TRUE 1 100 0 1 BIT_MASK 0xf00 FORMAT "%13.11" ECU_ADDRESS 0x7FC990 /end MEASUREMENT
/begin MEASUREMENT TYP_md02 "Fehlertyp:  Aussetzer Z¸ndung 2" UWORD B_TRUE 1 100 0 1 BIT_MASK 0xf00 FORMAT "%13.11" ECU_ADDRESS 0x7FC992 /end MEASUREMENT
/begin MEASUREMENT TYP_md03 "Fehlertyp:  Aussetzer Z¸ndung 3" UWORD B_TRUE 1 100 0 1 BIT_MASK 0xf00 FORMAT "%13.11" ECU_ADDRESS 0x7FC994 /end MEASUREMENT
/begin MEASUREMENT TYP_md04 "Fehlertyp:  Aussetzer Z¸ndung 4" UWORD B_TRUE 1 100 0 1 BIT_MASK 0xf00 FORMAT "%13.11" ECU_ADDRESS 0x7FC996 /end MEASUREMENT
/begin MEASUREMENT TYP_md05 "Fehlertyp:  Aussetzer Z¸ndung 5" UWORD B_TRUE 1 100 0 1 BIT_MASK 0xf00 FORMAT "%13.11" ECU_ADDRESS 0x7FC998 /end MEASUREMENT
/begin MEASUREMENT TYP_md06 "Fehlertyp:  Aussetzer Z¸ndung 6" UWORD B_TRUE 1 100 0 1 BIT_MASK 0xf00 FORMAT "%13.11" ECU_ADDRESS 0x7FC99A /end MEASUREMENT
/begin MEASUREMENT TYP_md07 "Fehlertyp:  Aussetzer Z¸ndung 7" UWORD B_TRUE 1 100 0 1 BIT_MASK 0xf00 FORMAT "%13.11" ECU_ADDRESS 0x7FC99C /end MEASUREMENT
/begin MEASUREMENT TYP_md08 "Fehlertyp:  Aussetzer Z¸ndung 8" UWORD B_TRUE 1 100 0 1 BIT_MASK 0xf00 FORMAT "%13.11" ECU_ADDRESS 0x7FC99E /end MEASUREMENT
/begin MEASUREMENT TYP_md09 "Fehlertyp:  Aussetzer Z¸ndung 9" UWORD B_TRUE 1 100 0 1 BIT_MASK 0xf00 FORMAT "%13.11" ECU_ADDRESS 0x7FC9A0 /end MEASUREMENT
/begin MEASUREMENT TYP_md10 "Fehlertyp:  Aussetzer Z¸ndung 10" UWORD B_TRUE 1 100 0 1 BIT_MASK 0xf00 FORMAT "%13.11" ECU_ADDRESS 0x7FC9A2 /end MEASUREMENT
/begin MEASUREMENT TYP_md11 "Fehlertyp:  Aussetzer Z¸ndung 11" UWORD B_TRUE 1 100 0 1 BIT_MASK 0xf00 FORMAT "%13.11" ECU_ADDRESS 0x7FC9A4 /end MEASUREMENT
/begin MEASUREMENT TYP_rkat "" UWORD B_TRUE 1 100 0 1 BIT_MASK 0xf00 FORMAT "%13.11" ECU_ADDRESS 0x7FC9D0 /end MEASUREMENT
/begin MEASUREMENT TYP_rkat2 "" UWORD B_TRUE 1 100 0 1 BIT_MASK 0xf00 FORMAT "%13.11" ECU_ADDRESS 0x7FC9D2 /end MEASUREMENT
/begin MEASUREMENT TYP_rkaz "" UWORD B_TRUE 1 100 0 1 BIT_MASK 0xf00 FORMAT "%13.11" ECU_ADDRESS 0x7FC9D4 /end MEASUREMENT
/begin MEASUREMENT TYP_rkaz2 "" UWORD B_TRUE 1 100 0 1 BIT_MASK 0xf00 FORMAT "%13.11" ECU_ADDRESS 0x7FC9D6 /end MEASUREMENT
/begin MEASUREMENT Z_frao "Zyklusflag:LR-Adaption oberer multiplikativer Bereich" UWORD B_TRUE 1 100 0 1 BIT_MASK 0x2 FORMAT "%13.11" ECU_ADDRESS 0x7FC914 /end MEASUREMENT
/begin MEASUREMENT Z_frao2 "Zyklusflag:LR-Adaption oberer multiplikativer Bereich Bank2" UWORD B_TRUE 1 100 0 1 BIT_MASK 0x2 FORMAT "%13.11" ECU_ADDRESS 0x7FC916 /end MEASUREMENT
/begin MEASUREMENT Z_frau "Zyklusflag:LR-Adaption unterer multiplikativer Bereich" UWORD B_TRUE 1 100 0 1 BIT_MASK 0x2 FORMAT "%13.11" ECU_ADDRESS 0x7FC918 /end MEASUREMENT
/begin MEASUREMENT Z_frau2 "Zyklusflag:LR-Adaption unterer multiplikativer Bereich Bank 2" UWORD B_TRUE 1 100 0 1 BIT_MASK 0x2 FORMAT "%13.11" ECU_ADDRESS 0x7FC91A /end MEASUREMENT
/begin MEASUREMENT Z_frst "Zyklusmeldung Diagnose Kraftstoffversorgungssystem (Kurztest)" UWORD B_TRUE 1 100 0 1 BIT_MASK 0x2 FORMAT "%13.11" ECU_ADDRESS 0x7FC91C /end MEASUREMENT
/begin MEASUREMENT Z_frst2 "Zyklusmeldung Diagnose Kraftstoffversorgungssystem (Kurztest Bank 2)" UWORD B_TRUE 1 100 0 1 BIT_MASK 0x2 FORMAT "%13.11" ECU_ADDRESS 0x7FC91E /end MEASUREMENT
/begin MEASUREMENT Z_fst "Zyklusflag: Tankf¸llstand" UWORD B_TRUE 1 100 0 1 BIT_MASK 0x2 FORMAT "%13.11" ECU_ADDRESS 0x7FC920 /end MEASUREMENT
/begin MEASUREMENT Z_fst2 "Zyklusflag: Tank2 F¸llstand" UWORD B_TRUE 1 100 0 1 BIT_MASK 0x2 FORMAT "%13.11" ECU_ADDRESS 0x7FC922 /end MEASUREMENT
/begin MEASUREMENT Z_hfm "Zyklusflag HFM" UWORD B_TRUE 1 100 0 1 BIT_MASK 0x2 FORMAT "%13.11" ECU_ADDRESS 0x7FC924 /end MEASUREMENT
/begin MEASUREMENT Z_hsh "Zyklusflag:Lambdasonden-Heizung hinter Katalysator" UWORD B_TRUE 1 100 0 1 BIT_MASK 0x2 FORMAT "%13.11" ECU_ADDRESS 0x7FC926 /end MEASUREMENT
/begin MEASUREMENT Z_hsh2 "Zyklusflag:Lambdasonden-Heizung hinter Katalysator, Bank2" UWORD B_TRUE 1 100 0 1 BIT_MASK 0x2 FORMAT "%13.11" ECU_ADDRESS 0x7FC928 /end MEASUREMENT
/begin MEASUREMENT Z_hsv "Zyklusflag:Lambdasonden-Heizung vor Katalysator" UWORD B_TRUE 1 100 0 1 BIT_MASK 0x2 FORMAT "%13.11" ECU_ADDRESS 0x7FC92E /end MEASUREMENT
/begin MEASUREMENT Z_hsv2 "Zyklusflag:Lambdasonden-Heizung vor Katalysator, Bank2" UWORD B_TRUE 1 100 0 1 BIT_MASK 0x2 FORMAT "%13.11" ECU_ADDRESS 0x7FC930 /end MEASUREMENT
/begin MEASUREMENT Z_hsve "Zyklusflag:Lambdasonden-Heizung vor Katalysator (Endstufe)" UWORD B_TRUE 1 100 0 1 BIT_MASK 0x2 FORMAT "%13.11" ECU_ADDRESS 0x7FC932 /end MEASUREMENT
/begin MEASUREMENT Z_hsve2 "Zyklusflag:Lambdasonden-Heizung vor Katalysator, Bank2 (Endstufe)" UWORD B_TRUE 1 100 0 1 BIT_MASK 0x2 FORMAT "%13.11" ECU_ADDRESS 0x7FC934 /end MEASUREMENT
/begin MEASUREMENT Z_iclsu "Zyklusflag: Auswerte-IC f¸r die LSU" UWORD B_TRUE 1 100 0 1 BIT_MASK 0x2 FORMAT "%13.11" ECU_ADDRESS 0x7FC93A /end MEASUREMENT
/begin MEASUREMENT Z_iclsu2 "Zyklusflag: Auswerte-IC f¸r die LSU, Bank 2" UWORD B_TRUE 1 100 0 1 BIT_MASK 0x2 FORMAT "%13.11" ECU_ADDRESS 0x7FC93C /end MEASUREMENT
/begin MEASUREMENT Z_kat "Zyklusflag:	Katalysator-Konvertierung" UWORD B_TRUE 1 100 0 1 BIT_MASK 0x2 FORMAT "%13.11" ECU_ADDRESS 0x7FC93E /end MEASUREMENT
/begin MEASUREMENT Z_kat2 "Zyklusflag:	Katalysator-Konvertierung	(Bank 2)" UWORD B_TRUE 1 100 0 1 BIT_MASK 0x2 FORMAT "%13.11" ECU_ADDRESS 0x7FC940 /end MEASUREMENT
/begin MEASUREMENT Z_katsp "Zyklusflag:	Katalysator-Konvertierung" UWORD B_TRUE 1 100 0 1 BIT_MASK 0x2 FORMAT "%13.11" ECU_ADDRESS 0x7FC942 /end MEASUREMENT
/begin MEASUREMENT Z_katsp2 "Zyklusflag:	Katalysator-Konvertierung" UWORD B_TRUE 1 100 0 1 BIT_MASK 0x2 FORMAT "%13.11" ECU_ADDRESS 0x7FC944 /end MEASUREMENT
/begin MEASUREMENT Z_kric "Zyklusflag: Klopfregelung Klopfsensorauswerte-IC" UWORD B_TRUE 1 100 0 1 BIT_MASK 0x2 FORMAT "%13.11" ECU_ADDRESS 0x7FC94A /end MEASUREMENT
/begin MEASUREMENT Z_krspi "Zyklusflag: Klopfregelung SPI-‹berwachung" UWORD B_TRUE 1 100 0 1 BIT_MASK 0x2 FORMAT "%13.11" ECU_ADDRESS 0x7FC94C /end MEASUREMENT
/begin MEASUREMENT Z_ks1 "Zyklusflag: Klopfsensor 1" UWORD B_TRUE 1 100 0 1 BIT_MASK 0x2 FORMAT "%13.11" ECU_ADDRESS 0x7FC94E /end MEASUREMENT
/begin MEASUREMENT Z_ks2 "Zyklusflag: Klopfsensor 2" UWORD B_TRUE 1 100 0 1 BIT_MASK 0x2 FORMAT "%13.11" ECU_ADDRESS 0x7FC950 /end MEASUREMENT
/begin MEASUREMENT Z_lash "Zyklusflag:Lambda-Sondenalterung hinter Kat." UWORD B_TRUE 1 100 0 1 BIT_MASK 0x2 FORMAT "%13.11" ECU_ADDRESS 0x7FC954 /end MEASUREMENT
/begin MEASUREMENT Z_lash2 "Zyklusflag:	Lambda-Sondenalterung hinter Kat. (Bank 2)" UWORD B_TRUE 1 100 0 1 BIT_MASK 0x2 FORMAT "%13.11" ECU_ADDRESS 0x7FC956 /end MEASUREMENT
/begin MEASUREMENT Z_lbk "Zyklusflag: Ladungsbewegungsklappe" UWORD B_TRUE 1 100 0 1 BIT_MASK 0x2 FORMAT "%13.11" ECU_ADDRESS 0x7FC958 /end MEASUREMENT
/begin MEASUREMENT Z_lbke "Zyklusflag: Endstufe Ladungsbewegungsklappe" UWORD B_TRUE 1 100 0 1 BIT_MASK 0x2 FORMAT "%13.11" ECU_ADDRESS 0x7FC95A /end MEASUREMENT
/begin MEASUREMENT Z_lbko "Zyklusflag: Endstufe Ladungsbewegungsklappe Offset-Adaption" UWORD B_TRUE 1 100 0 1 BIT_MASK 0x2 FORMAT "%13.11" ECU_ADDRESS 0x7FC95C /end MEASUREMENT
/begin MEASUREMENT Z_lbkp "Zyklusflag: Endstufe LBK Potentiometer" UWORD B_TRUE 1 100 0 1 BIT_MASK 0x2 FORMAT "%13.11" ECU_ADDRESS 0x7FC95E /end MEASUREMENT
/begin MEASUREMENT Z_llr "Zyklusflag: Diagnose Leerlaufregelung, Steller" UWORD B_TRUE 1 100 0 1 BIT_MASK 0x2 FORMAT "%13.11" ECU_ADDRESS 0x7FC968 /end MEASUREMENT
/begin MEASUREMENT Z_lsh "Zyklusflag: Lambda-Sonde hinter Kat" UWORD B_TRUE 1 100 0 1 BIT_MASK 0x2 FORMAT "%13.11" ECU_ADDRESS 0x7FC96C /end MEASUREMENT
/begin MEASUREMENT Z_lsh2 "Zyklusflag: Lambda-Sonde hinter Kat Bank2" UWORD B_TRUE 1 100 0 1 BIT_MASK 0x2 FORMAT "%13.11" ECU_ADDRESS 0x7FC96E /end MEASUREMENT
/begin MEASUREMENT Z_lsuia "Zyklusflag: Diagnose Lambdasondenleitung an Bond IA" UWORD B_TRUE 1 100 0 1 BIT_MASK 0x2 FORMAT "%13.11" ECU_ADDRESS 0x7FC970 /end MEASUREMENT
/begin MEASUREMENT Z_lsuia2 "Zyklusflag: Diagnose Lambdasondenleitung an Bond IA, Bank 2" UWORD B_TRUE 1 100 0 1 BIT_MASK 0x2 FORMAT "%13.11" ECU_ADDRESS 0x7FC972 /end MEASUREMENT
/begin MEASUREMENT Z_lsuun "Zyklusflag: Diagnose Lambdasondenleitung an Bond UN" UWORD B_TRUE 1 100 0 1 BIT_MASK 0x2 FORMAT "%13.11" ECU_ADDRESS 0x7FC974 /end MEASUREMENT
/begin MEASUREMENT Z_lsuun2 "Zyklusflag: Diagnose Lambdasondenleitung an Bond UN, Bank 2" UWORD B_TRUE 1 100 0 1 BIT_MASK 0x2 FORMAT "%13.11" ECU_ADDRESS 0x7FC976 /end MEASUREMENT
/begin MEASUREMENT Z_lsuvm "Zyklusflag: Diagnose Lambdasondenleitung an Bond VM" UWORD B_TRUE 1 100 0 1 BIT_MASK 0x2 FORMAT "%13.11" ECU_ADDRESS 0x7FC978 /end MEASUREMENT
/begin MEASUREMENT Z_lsuvm2 "Zyklusflag: Diagnose Lambdasondenleitung an Bond VM, Bank 2" UWORD B_TRUE 1 100 0 1 BIT_MASK 0x2 FORMAT "%13.11" ECU_ADDRESS 0x7FC97A /end MEASUREMENT
/begin MEASUREMENT Z_lsv "Zyklusflag: Lambda-Sonde vor Kat" UWORD B_TRUE 1 100 0 1 BIT_MASK 0x2 FORMAT "%13.11" ECU_ADDRESS 0x7FC97C /end MEASUREMENT
/begin MEASUREMENT Z_lsv2 "Zyklusflag: Lambda-Sonde 2 vor Kat" UWORD B_TRUE 1 100 0 1 BIT_MASK 0x2 FORMAT "%13.11" ECU_ADDRESS 0x7FC97E /end MEASUREMENT
/begin MEASUREMENT Z_md "Zyklusflag: Aussetzer, Summenfehler (multiple)" UWORD B_TRUE 1 100 0 1 BIT_MASK 0x2 FORMAT "%13.11" ECU_ADDRESS 0x7FC98C /end MEASUREMENT
/begin MEASUREMENT Z_md00 "Zyklusflag: Aussetzer Z¸ndung 0" UWORD B_TRUE 1 100 0 1 BIT_MASK 0x2 FORMAT "%13.11" ECU_ADDRESS 0x7FC98E /end MEASUREMENT
/begin MEASUREMENT Z_md01 "Zyklusflag: Aussetzer Z¸ndung 1" UWORD B_TRUE 1 100 0 1 BIT_MASK 0x2 FORMAT "%13.11" ECU_ADDRESS 0x7FC990 /end MEASUREMENT
/begin MEASUREMENT Z_md02 "Zyklusflag: Aussetzer Z¸ndung 2" UWORD B_TRUE 1 100 0 1 BIT_MASK 0x2 FORMAT "%13.11" ECU_ADDRESS 0x7FC992 /end MEASUREMENT
/begin MEASUREMENT Z_md03 "Zyklusflag: Aussetzer Z¸ndung 3" UWORD B_TRUE 1 100 0 1 BIT_MASK 0x2 FORMAT "%13.11" ECU_ADDRESS 0x7FC994 /end MEASUREMENT
/begin MEASUREMENT Z_md04 "Zyklusflag: Aussetzer Z¸ndung 4" UWORD B_TRUE 1 100 0 1 BIT_MASK 0x2 FORMAT "%13.11" ECU_ADDRESS 0x7FC996 /end MEASUREMENT
/begin MEASUREMENT Z_md05 "Zyklusflag: Aussetzer Z¸ndung 5" UWORD B_TRUE 1 100 0 1 BIT_MASK 0x2 FORMAT "%13.11" ECU_ADDRESS 0x7FC998 /end MEASUREMENT
/begin MEASUREMENT Z_md06 "Zyklusflag: Aussetzer Z¸ndung 6" UWORD B_TRUE 1 100 0 1 BIT_MASK 0x2 FORMAT "%13.11" ECU_ADDRESS 0x7FC99A /end MEASUREMENT
/begin MEASUREMENT Z_md07 "Zyklusflag: Aussetzer Z¸ndung 7" UWORD B_TRUE 1 100 0 1 BIT_MASK 0x2 FORMAT "%13.11" ECU_ADDRESS 0x7FC99C /end MEASUREMENT
/begin MEASUREMENT Z_md08 "Zyklusflag: Aussetzer Z¸ndung 8" UWORD B_TRUE 1 100 0 1 BIT_MASK 0x2 FORMAT "%13.11" ECU_ADDRESS 0x7FC99E /end MEASUREMENT
/begin MEASUREMENT Z_md09 "Zyklusflag: Aussetzer Z¸ndung 9" UWORD B_TRUE 1 100 0 1 BIT_MASK 0x2 FORMAT "%13.11" ECU_ADDRESS 0x7FC9A0 /end MEASUREMENT
/begin MEASUREMENT Z_md10 "Zyklusflag: Aussetzer Z¸ndung 10" UWORD B_TRUE 1 100 0 1 BIT_MASK 0x2 FORMAT "%13.11" ECU_ADDRESS 0x7FC9A2 /end MEASUREMENT
/begin MEASUREMENT Z_md11 "Zyklusflag: Aussetzer Z¸ndung 11" UWORD B_TRUE 1 100 0 1 BIT_MASK 0x2 FORMAT "%13.11" ECU_ADDRESS 0x7FC9A4 /end MEASUREMENT
/begin MEASUREMENT Z_rkat "Zyklusflag:LR-Adaption additiv pro Zeit" UWORD B_TRUE 1 100 0 1 BIT_MASK 0x2 FORMAT "%13.11" ECU_ADDRESS 0x7FC9D0 /end MEASUREMENT
/begin MEASUREMENT Z_rkat2 "Zyklusflag:LR-Adaption additiv pro Zeit Bank 2" UWORD B_TRUE 1 100 0 1 BIT_MASK 0x2 FORMAT "%13.11" ECU_ADDRESS 0x7FC9D2 /end MEASUREMENT
/begin MEASUREMENT Z_rkaz "Zyklusflag:LR-Adaption additiv pro Einspritzung" UWORD B_TRUE 1 100 0 1 BIT_MASK 0x2 FORMAT "%13.11" ECU_ADDRESS 0x7FC9D4 /end MEASUREMENT
/begin MEASUREMENT Z_rkaz2 "Zyklusflag:LR-Adaption additiv pro Einspritzung Bank 2" UWORD B_TRUE 1 100 0 1 BIT_MASK 0x2 FORMAT "%13.11" ECU_ADDRESS 0x7FC9D6 /end MEASUREMENT
/begin FUNCTION DFPM_DFSTT ""
 /begin DEF_CHARACTERISTIC CDCFST CDCFST2 CDKFST CDKFST2 CDTFST CDTFST2 CLAFST CLAFST2 FFTFST FFTFST2 TSFFST TSFFST2 /end DEF_CHARACTERISTIC
 /begin REF_CHARACTERISTIC /end REF_CHARACTERISTIC
 /begin IN_MEASUREMENT /end IN_MEASUREMENT
 /begin OUT_MEASUREMENT B_befst B_befst2 B_bkfst B_bkfst2 B_clfst B_clfst2 B_ftfst B_ftfst2 B_mnfst B_mnfst2 B_mxfst B_mxfst2 B_npfst B_npfst2 B_sifst B_sifst2 E_fst E_fst2 sfpfst sfpfst2 TYP_fst TYP_fst2 Z_fst Z_fst2 /end OUT_MEASUREMENT
 /begin LOC_MEASUREMENT /end LOC_MEASUREMENT
 /begin SUB_FUNCTION /end SUB_FUNCTION
/end FUNCTION
/begin FUNCTION DFPM_DHFM "" /begin DEF_CHARACTERISTIC CDCHFM CDKHFM CDTHFM CLAHFM FFTHFM TSFHFM /end DEF_CHARACTERISTIC /begin REF_CHARACTERISTIC /end REF_CHARACTERISTIC /begin IN_MEASUREMENT /end IN_MEASUREMENT
 /begin OUT_MEASUREMENT B_behfm B_bkhfm B_clhfm B_fthfm B_mnhfm B_mxhfm B_nphfm B_sihfm E_hfm sfphfm TYP_hfm Z_hfm /end OUT_MEASUREMENT
 /begin LOC_MEASUREMENT /end LOC_MEASUREMENT
 /begin SUB_FUNCTION /end SUB_FUNCTION
/end FUNCTION
/begin FUNCTION DFPM_DHLSHK ""
 /begin DEF_CHARACTERISTIC CDCHSH CDCHSH2 CDKHSH CDKHSH2 CDTHSH CDTHSH2 CLAHSH CLAHSH2 FFTHSH FFTHSH2 TSFHSH TSFHSH2 /end DEF_CHARACTERISTIC
 /begin REF_CHARACTERISTIC /end REF_CHARACTERISTIC
 /begin IN_MEASUREMENT /end IN_MEASUREMENT
 /begin OUT_MEASUREMENT B_behsh B_behsh2 B_bkhsh B_bkhsh2 B_clhsh B_clhsh2 B_fahsh B_fahsh2 B_mnhsh B_mnhsh2 B_mxhsh B_mxhsh2 B_nphsh B_nphsh2 B_sihsh B_sihsh2 E_hsh E_hsh2 sfphsh sfphsh2 TYP_hsh TYP_hsh2 Z_hsh Z_hsh2 /end OUT_MEASUREMENT
 /begin LOC_MEASUREMENT /end LOC_MEASUREMENT
 /begin SUB_FUNCTION /end SUB_FUNCTION
/end FUNCTION
/begin FUNCTION DFPM_DHRLSU ""
 /begin DEF_CHARACTERISTIC CDCHSV CDCHSV2 CDKHSV CDKHSV2 CDTHSV CDTHSV2 CLAHSV CLAHSV2 FFTHSV FFTHSV2 TSFHSV TSFHSV2 /end DEF_CHARACTERISTIC
 /begin REF_CHARACTERISTIC /end REF_CHARACTERISTIC
 /begin IN_MEASUREMENT /end IN_MEASUREMENT
 /begin OUT_MEASUREMENT B_behsv B_behsv2 B_bkhsv B_bkhsv2 B_clhsv B_clhsv2 B_fthsv B_fthsv2 B_mnhsv B_mnhsv2 B_mxhsv B_mxhsv2 B_nphsv B_nphsv2 B_sihsv B_sihsv2 E_hsv E_hsv2 sfphsv sfphsv2 TYP_hsv TYP_hsv2 Z_hsv Z_hsv2 /end OUT_MEASUREMENT
 /begin LOC_MEASUREMENT /end LOC_MEASUREMENT
 /begin SUB_FUNCTION /end SUB_FUNCTION
/end FUNCTION
/begin FUNCTION DFPM_DHRLSUE ""
 /begin DEF_CHARACTERISTIC CDCHSVE CDCHSVE2 CDKHSVE CDKHSVE2 CDTHSVE CDTHSVE2 CLAHSVE CLAHSVE2 FFTHSVE FFTHSVE2 TSFHSVE TSFHSVE2 /end DEF_CHARACTERISTIC
 /begin REF_CHARACTERISTIC /end REF_CHARACTERISTIC
 /begin IN_MEASUREMENT /end IN_MEASUREMENT
 /begin OUT_MEASUREMENT B_behsve B_behsve2 B_bkhsve B_bkhsve2 B_clhsve B_clhsve2 B_fthsve B_fthsve2 B_mnhsve B_mnhsve2 B_mxhsve B_mxhsve2 B_nphsve B_nphsve2 B_sihsve B_sihsve2 E_hsve E_hsve2 sfphsve sfphsve2 TYP_hsve TYP_hsve2 Z_hsve Z_hsve2 /end OUT_MEASUREMENT
 /begin LOC_MEASUREMENT /end LOC_MEASUREMENT
 /begin SUB_FUNCTION /end SUB_FUNCTION
/end FUNCTION
/begin FUNCTION DFPM_DKATSP "DKATSP."
 /begin DEF_CHARACTERISTIC CDCKAT CDCKAT2 CDCKATSP CDCKATSP2 CDKKAT CDKKAT2 CDKKATSP CDKKATSP2 CDTKAT CDTKAT2 CDTKATSP CDTKATSP2 CLAKAT CLAKAT2 CLAKATSP CLAKATSP2 FFTKAT FFTKAT2 FFTKATSP FFTKATSP2 TSFKAT TSFKAT2 TSFKATSP TSFKATSP2 /end DEF_CHARACTERISTIC
 /begin REF_CHARACTERISTIC /end REF_CHARACTERISTIC
 /begin IN_MEASUREMENT /end IN_MEASUREMENT
 /begin OUT_MEASUREMENT B_bekat B_bekat2 B_bekatsp B_bekatsp2 B_bkkat B_bkkat2 B_bkkatsp B_bkkatsp2 B_clkat B_clkat2 B_clkatsp B_clkatsp2 B_ftkat B_ftkat2 B_ftkatsp B_ftkatsp2 B_mnkat B_mnkat2 B_mnkatsp B_mnkatsp2 B_mxkat B_mxkat2 B_mxkatsp B_mxkatsp2 B_npkat B_npkat2 B_npkatsp B_npkatsp2 B_sikat B_sikat2 B_sikatsp B_sikatsp2 E_kat E_kat2 E_katsp E_katsp2 sfpkat sfpkat2 sfpkatsp sfpkatsp2 TYP_kat TYP_kat2 TYP_katsp TYP_katsp2 Z_kat Z_kat2 Z_katsp Z_katsp2 /end OUT_MEASUREMENT
 /begin LOC_MEASUREMENT /end LOC_MEASUREMENT
 /begin SUB_FUNCTION /end SUB_FUNCTION
/end FUNCTION
/begin FUNCTION DFPM_DKRIC "" /begin DEF_CHARACTERISTIC CDCKRIC CDKKRIC CDTKRIC CLAKRIC FFTKRIC TSFKRIC /end DEF_CHARACTERISTIC /begin REF_CHARACTERISTIC /end REF_CHARACTERISTIC /begin IN_MEASUREMENT /end IN_MEASUREMENT
 /begin OUT_MEASUREMENT B_bekric B_bkkric B_clkric B_ftkric B_mnkric B_mxkric B_npkric B_sikric E_kric sfpkric TYP_kric Z_kric /end OUT_MEASUREMENT
 /begin LOC_MEASUREMENT /end LOC_MEASUREMENT
 /begin SUB_FUNCTION /end SUB_FUNCTION
/end FUNCTION
/begin FUNCTION DFPM_DKRS ""
 /begin DEF_CHARACTERISTIC CDCKS1 CDCKS2 CDKKS1 CDKKS2 CDTKS1 CDTKS2 CLAKS1 CLAKS2 FFTKS1 FFTKS2 TSFKS1 TSFKS2 /end DEF_CHARACTERISTIC
 /begin REF_CHARACTERISTIC /end REF_CHARACTERISTIC
 /begin IN_MEASUREMENT /end IN_MEASUREMENT
 /begin OUT_MEASUREMENT B_beks1 B_beks2 B_bkks1 B_bkks2 B_clks1 B_clks2 B_ftks1 B_ftks2 B_mnks1 B_mnks2 B_mxks1 B_mxks2 B_npks1 B_npks2 B_siks1 B_siks2 E_ks1 E_ks2 sfpks1 sfpks2 TYP_ks1 TYP_ks2 Z_ks1 Z_ks2 /end OUT_MEASUREMENT
 /begin LOC_MEASUREMENT /end LOC_MEASUREMENT
 /begin SUB_FUNCTION /end SUB_FUNCTION
/end FUNCTION
/begin FUNCTION DFPM_DKRSPI "" /begin DEF_CHARACTERISTIC CDCKRSPI CDKKRSPI CDTKRSPI CLAKRSPI FFTKRSPI TSFKRSPI /end DEF_CHARACTERISTIC /begin REF_CHARACTERISTIC /end REF_CHARACTERISTIC /begin IN_MEASUREMENT /end IN_MEASUREMENT
 /begin OUT_MEASUREMENT B_bekrspi B_bkkrspi B_clkrspi B_ftkrspi B_mnkrspi B_mxkrspi B_npkrspi B_sikrspi E_krspi sfpkrspi TYP_krspi Z_krspi /end OUT_MEASUREMENT
 /begin LOC_MEASUREMENT /end LOC_MEASUREMENT
 /begin SUB_FUNCTION /end SUB_FUNCTION
/end FUNCTION
/begin FUNCTION DFPM_DKVS ""
 /begin DEF_CHARACTERISTIC CDCFRAO CDCFRAO2 CDCFRAU CDCFRAU2 CDCFRST CDCFRST2 CDCRKAT CDCRKAT2 CDCRKAZ CDCRKAZ2 CDKFRAO CDKFRAO2 CDKFRAU CDKFRAU2 CDKFRST CDKFRST2 CDKRKAT CDKRKAT2 CDKRKAZ CDKRKAZ2 CDTFRAO CDTFRAO2 CDTFRAU CDTFRAU2 CDTFRST CDTFRST2 CDTRKAT CDTRKAT2 CDTRKAZ CDTRKAZ2 CLAFRAO CLAFRAO2 CLAFRAU CLAFRAU2 CLAFRST CLAFRST2 CLARKAT CLARKAT2 CLARKAZ CLARKAZ2 FFTFRAO FFTFRAO2 FFTFRAU FFTFRAU2 FFTFRST FFTFRST2 FFTRKAT FFTRKAT2 FFTRKAZ FFTRKAZ2 TSFFRAO TSFFRAO2 TSFFRAU TSFFRAU2 TSFFRST TSFFRST2 TSFRKAT TSFRKAT2 TSFRKAZ TSFRKAZ2 /end DEF_CHARACTERISTIC
 /begin REF_CHARACTERISTIC /end REF_CHARACTERISTIC
 /begin IN_MEASUREMENT /end IN_MEASUREMENT
 /begin OUT_MEASUREMENT B_befrao B_befrao2 B_befrau B_befrau2 B_befrst B_befrst2 B_berkat B_berkat2 B_berkaz B_berkaz2 B_bkfrao B_bkfrao2 B_bkfrau B_bkfrau2 B_bkfrst B_bkfrst2 B_bkrkat B_bkrkat2 B_bkrkaz B_bkrkaz2 B_clfrao B_clfrao2 B_clfrau B_clfrau2 B_clfrst B_clfrst2 B_clrkat B_clrkat2 B_clrkaz B_clrkaz2 B_ftfrao B_ftfrao2 B_ftfrau B_ftfrau2 B_ftfrst B_ftfrst2 B_ftrkat B_ftrkat2 B_ftrkaz B_ftrkaz2 B_mnfrao B_mnfrao2 B_mnfrau B_mnfrau2 B_mnfrst B_mnfrst2 B_mnrkat B_mnrkat2 B_mnrkaz B_mnrkaz2 B_mxfrao B_mxfrao2 B_mxfrau B_mxfrau2 B_mxfrst B_mxfrst2 B_mxrkat B_mxrkat2 B_mxrkaz B_mxrkaz2 B_npfrao B_npfrao2 B_npfrau B_npfrau2 B_npfrst B_npfrst2 B_nprkat B_nprkat2 B_nprkaz B_nprkaz2 B_sifrao B_sifrao2 B_sifrau B_sifrau2 B_sifrst B_sifrst2 B_sirkat B_sirkat2 B_sirkaz B_sirkaz2 E_frao E_frao2 E_frau E_frau2 E_frst E_frst2 E_rkat E_rkat2 E_rkaz E_rkaz2 sfpfrao sfpfrao2 sfpfrau sfpfrau2 sfpfrst sfpfrst2 sfprkat sfprkat2 sfprkaz sfprkaz2 TYP_frao TYP_frao2 TYP_frau TYP_frau2 TYP_frst TYP_frst2 TYP_rkat TYP_rkat2 TYP_rkaz TYP_rkaz2 Z_frao Z_frao2 Z_frau Z_frau2 Z_frst Z_frst2 Z_rkat Z_rkat2 Z_rkaz Z_rkaz2 /end OUT_MEASUREMENT
 /begin LOC_MEASUREMENT /end LOC_MEASUREMENT
 /begin SUB_FUNCTION /end SUB_FUNCTION
/end FUNCTION
/begin FUNCTION DFPM_DLBK ""
 /begin DEF_CHARACTERISTIC CDCLBK CDCLBKE CDCLBKO CDCLBKP CDKLBK CDKLBKE CDKLBKO CDKLBKP CDTLBK CDTLBKE CDTLBKO CDTLBKP CLALBK CLALBKE CLALBKO CLALBKP FFTLBK FFTLBKE FFTLBKO FFTLBKP TSFLBK TSFLBKE TSFLBKO TSFLBKP /end DEF_CHARACTERISTIC
 /begin REF_CHARACTERISTIC /end REF_CHARACTERISTIC
 /begin IN_MEASUREMENT /end IN_MEASUREMENT
 /begin OUT_MEASUREMENT B_belbk B_belbke B_belbko B_belbkp B_bklbk B_bklbke B_bklbko B_bklbkp B_cllbk B_cllbke B_cllbko B_cllbkp B_ftlbk B_ftlbke B_ftlbko B_ftlbkp B_mnlbk B_mnlbke B_mnlbko B_mnlbkp B_mxlbk B_mxlbke B_mxlbko B_mxlbkp B_nplbk B_nplbke B_nplbko B_nplbkp B_silbk B_silbke B_silbko B_silbkp E_lbk E_lbke E_lbko E_lbkp sfplbk sfplbke sfplbko sfplbkp TYP_lbk TYP_lbke TYP_lbko TYP_lbkp Z_lbk Z_lbke Z_lbko Z_lbkp /end OUT_MEASUREMENT
 /begin LOC_MEASUREMENT /end LOC_MEASUREMENT
 /begin SUB_FUNCTION /end SUB_FUNCTION
/end FUNCTION
/begin FUNCTION DFPM_DLLR "" /begin DEF_CHARACTERISTIC CDCLLR CDKLLR CDTLLR CLALLR FFTLLR TSFLLR /end DEF_CHARACTERISTIC /begin REF_CHARACTERISTIC /end REF_CHARACTERISTIC /begin IN_MEASUREMENT /end IN_MEASUREMENT
 /begin OUT_MEASUREMENT B_bellr B_bkllr B_clllr B_ftllr B_mnllr B_mxllr B_npllr B_sillr E_llr sfpllr TYP_LLR Z_llr /end OUT_MEASUREMENT
 /begin LOC_MEASUREMENT /end LOC_MEASUREMENT
 /begin SUB_FUNCTION /end SUB_FUNCTION
/end FUNCTION
/begin FUNCTION DFPM_DLSAHK ""
 /begin DEF_CHARACTERISTIC CDCLASH CDCLASH2 CDKLASH CDKLASH2 CDTLASH CDTLASH2 CLALASH CLALASH2 FFTLASH FFTLASH2 TSFLASH TSFLASH2 /end DEF_CHARACTERISTIC
 /begin REF_CHARACTERISTIC /end REF_CHARACTERISTIC
 /begin IN_MEASUREMENT /end IN_MEASUREMENT
 /begin OUT_MEASUREMENT B_belash B_belash2 B_bklash B_bklash2 B_cllash B_cllash2 B_falash B_falash2 B_mnlash B_mnlash2 B_mxlash B_mxlash2 B_nplash B_nplash2 B_silash B_silash2 E_lash E_lash2 sfplash sfplash2 TYP_lash TYP_lash2 Z_lash Z_lash2 /end OUT_MEASUREMENT
 /begin LOC_MEASUREMENT /end LOC_MEASUREMENT
 /begin SUB_FUNCTION /end SUB_FUNCTION
/end FUNCTION
/begin FUNCTION DFPM_DLSH ""
 /begin DEF_CHARACTERISTIC CDCLSH CDCLSH2 CDKLSH CDKLSH2 CDTLSH CDTLSH2 CLALSH CLALSH2 FFTLSH FFTLSH2 TSFLSH TSFLSH2 /end DEF_CHARACTERISTIC
 /begin REF_CHARACTERISTIC /end REF_CHARACTERISTIC
 /begin IN_MEASUREMENT /end IN_MEASUREMENT
 /begin OUT_MEASUREMENT B_belsh B_belsh2 B_bklsh B_bklsh2 B_cllsh B_cllsh2 B_ftlsh B_ftlsh2 B_mnlsh B_mnlsh2 B_mxlsh B_mxlsh2 B_nplsh B_nplsh2 B_silsh B_silsh2 E_lsh E_lsh2 sfplsh sfplsh2 TYP_lsh TYP_lsh2 Z_lsh Z_lsh2 /end OUT_MEASUREMENT
 /begin LOC_MEASUREMENT /end LOC_MEASUREMENT
 /begin SUB_FUNCTION /end SUB_FUNCTION
/end FUNCTION
/begin FUNCTION DFPM_DLSU ""
 /begin DEF_CHARACTERISTIC CDCICLSU CDCICLSU2 CDCLSUIA CDCLSUIA2 CDCLSUUN CDCLSUUN2 CDCLSUVM CDCLSUVM2 CDCLSV CDCLSV2 CDKICLSU CDKICLSU2 CDKLSUIA CDKLSUIA2 CDKLSUUN CDKLSUUN2 CDKLSUVM CDKLSUVM2 CDKLSV CDKLSV2 CDTICLSU CDTICLSU2 CDTLSUIA CDTLSUIA2 CDTLSUUN CDTLSUUN2 CDTLSUVM CDTLSUVM2 CDTLSV CDTLSV2 CLAICLSU CLAICLSU2 CLALSUIA CLALSUIA2 CLALSUUN CLALSUUN2 CLALSUVM CLALSUVM2 CLALSV CLALSV2 FFTICLSU FFTICLSU2 FFTLSUIA FFTLSUIA2 FFTLSUUN FFTLSUUN2 FFTLSUVM FFTLSUVM2 FFTLSV FFTLSV2 TSFICLSU TSFICLSU2 TSFLSUIA TSFLSUIA2 TSFLSUUN TSFLSUUN2 TSFLSUVM TSFLSUVM2 TSFLSV TSFLSV2 /end DEF_CHARACTERISTIC
 /begin REF_CHARACTERISTIC /end REF_CHARACTERISTIC
 /begin IN_MEASUREMENT /end IN_MEASUREMENT
 /begin OUT_MEASUREMENT B_beiclsu B_beiclsu2 B_belsuia B_belsuia2 B_belsuun B_belsuun2 B_belsuvm B_belsuvm2 B_belsv B_belsv2 B_bkiclsu B_bkiclsu2 B_bklsuia B_bklsuia2 B_bklsuun B_bklsuun2 B_bklsuvm B_bklsuvm2 B_bklsv B_bklsv2 B_cliclsu B_cliclsu2 B_cllsuia B_cllsuia2 B_cllsuun B_cllsuun2 B_cllsuvm B_cllsuvm2 B_cllsv B_cllsv2 B_fticlsu B_fticlsu2 B_ftlsuia B_ftlsuia2 B_ftlsuun B_ftlsuun2 B_ftlsuvm B_ftlsuvm2 B_ftlsv B_ftlsv2 B_mniclsu B_mniclsu2 B_mnlsuia B_mnlsuia2 B_mnlsuun B_mnlsuun2 B_mnlsuvm B_mnlsuvm2 B_mnlsv B_mnlsv2 B_mxiclsu B_mxiclsu2 B_mxlsuia B_mxlsuia2 B_mxlsuun B_mxlsuun2 B_mxlsuvm B_mxlsuvm2 B_mxlsv B_mxlsv2 B_npiclsu B_npiclsu2 B_nplsuia B_nplsuia2 B_nplsuun B_nplsuun2 B_nplsuvm B_nplsuvm2 B_nplsv B_nplsv2 B_siiclsu B_siiclsu2 B_silsuia B_silsuia2 B_silsuun B_silsuun2 B_silsuvm B_silsuvm2 B_silsv B_silsv2 E_iclsu E_iclsu2 E_lsuia E_lsuia2 E_lsuun E_lsuun2 E_lsuvm E_lsuvm2 E_lsv E_lsv2 sfpiclsu sfpiclsu2 sfplsuia sfplsuia2 sfplsuun sfplsuun2 sfplsuvm sfplsuvm2 sfplsv sfplsv2 TYP_iclsu TYP_iclsu2 TYP_lsuia TYP_lsuia2 TYP_lsuun TYP_lsuun2 TYP_lsuvm TYP_lsuvm2 TYP_lsv TYP_lsv2 Z_iclsu Z_iclsu2 Z_lsuia Z_lsuia2 Z_lsuun Z_lsuun2 Z_lsuvm Z_lsuvm2 Z_lsv Z_lsv2 /end OUT_MEASUREMENT
 /begin LOC_MEASUREMENT /end LOC_MEASUREMENT
 /begin SUB_FUNCTION /end SUB_FUNCTION
/end FUNCTION
/begin FUNCTION DFPM_DMDMIL "DMDMIL.exported"
 /begin DEF_CHARACTERISTIC CDCMD CDCMD00 CDCMD01 CDCMD02 CDCMD03 CDCMD04 CDCMD05 CDCMD06 CDCMD07 CDCMD08 CDCMD09 CDCMD10 CDCMD11 CDKMD CDKMD00 CDKMD01 CDKMD02 CDKMD03 CDKMD04 CDKMD05 CDKMD06 CDKMD07 CDKMD08 CDKMD09 CDKMD10 CDKMD11 CDTMD CDTMD00 CDTMD01 CDTMD02 CDTMD03 CDTMD04 CDTMD05 CDTMD06 CDTMD07 CDTMD08 CDTMD09 CDTMD10 CDTMD11 CLAMD CLAMD00 CLAMD01 CLAMD02 CLAMD03 CLAMD04 CLAMD05 CLAMD06 CLAMD07 CLAMD08 CLAMD09 CLAMD10 CLAMD11 FFTMD FFTMD00 FFTMD01 FFTMD02 FFTMD03 FFTMD04 FFTMD05 FFTMD06 FFTMD07 FFTMD08 FFTMD09 FFTMD10 FFTMD11 TSFMD TSFMD00 TSFMD01 TSFMD02 TSFMD03 TSFMD04 TSFMD05 TSFMD06 TSFMD07 TSFMD08 TSFMD09 TSFMD10 TSFMD11 /end DEF_CHARACTERISTIC
 /begin REF_CHARACTERISTIC /end REF_CHARACTERISTIC
 /begin IN_MEASUREMENT /end IN_MEASUREMENT
 /begin OUT_MEASUREMENT B_bemd B_bemd00 B_bemd01 B_bemd02 B_bemd03 B_bemd04 B_bemd05 B_bemd06 B_bemd07 B_bemd08 B_bemd09 B_bemd10 B_bemd11 B_bkmd B_bkmd00 B_bkmd01 B_bkmd02 B_bkmd03 B_bkmd04 B_bkmd05 B_bkmd06 B_bkmd07 B_bkmd08 B_bkmd09 B_bkmd10 B_bkmd11 B_clmd B_clmd00 B_clmd01 B_clmd02 B_clmd03 B_clmd04 B_clmd05 B_clmd06 B_clmd07 B_clmd08 B_clmd09 B_clmd10 B_clmd11 B_ftmd B_ftmd00 B_ftmd01 B_ftmd02 B_ftmd03 B_ftmd04 B_ftmd05 B_ftmd06 B_ftmd07 B_ftmd08 B_ftmd09 B_ftmd10 B_ftmd11 B_mnmd B_mnmd00 B_mnmd01 B_mnmd02 B_mnmd03 B_mnmd04 B_mnmd05 B_mnmd06 B_mnmd07 B_mnmd08 B_mnmd09 B_mnmd10 B_mnmd11 B_mxmd B_mxmd00 B_mxmd01 B_mxmd02 B_mxmd03 B_mxmd04 B_mxmd05 B_mxmd06 B_mxmd07 B_mxmd08 B_mxmd09 B_mxmd10 B_mxmd11 B_npmd B_npmd00 B_npmd01 B_npmd02 B_npmd03 B_npmd04 B_npmd05 B_npmd06 B_npmd07 B_npmd08 B_npmd09 B_npmd10 B_npmd11 B_simd B_simd00 B_simd01 B_simd02 B_simd03 B_simd04 B_simd05 B_simd06 B_simd07 B_simd08 B_simd09 B_simd10 B_simd11 E_md E_md00 E_md01 E_md02 E_md03 E_md04 E_md05 E_md06 E_md07 E_md08 E_md09 E_md10 E_md11 sfpmd sfpmd00 sfpmd01 sfpmd02 sfpmd03 sfpmd04 sfpmd05 sfpmd06 sfpmd07 sfpmd08 sfpmd09 sfpmd10 sfpmd11 TYP_md TYP_md00 TYP_md01 TYP_md02 TYP_md03 TYP_md04 TYP_md05 TYP_md06 TYP_md07 TYP_md08 TYP_md09 TYP_md10 TYP_md11 Z_md Z_md00 Z_md01 Z_md02 Z_md03 Z_md04 Z_md05 Z_md06 Z_md07 Z_md08 Z_md09 Z_md10 Z_md11 /end OUT_MEASUREMENT
 /begin LOC_MEASUREMENT /end LOC_MEASUREMENT
 /begin SUB_FUNCTION /end SUB_FUNCTION
/end FUNCTION
/begin COMPU_METHOD B_TRUE "boolsche Zust‰nde, positive Logik" TAB_VERB "%6.3" "" COMPU_TAB_REF B_TRUE /end COMPU_METHOD
/begin COMPU_VTAB B_TRUE "boolsche Zust‰nde, positive Logik" TAB_VERB 2 0 "----" 1 "TRUE" /end COMPU_VTAB
/begin COMPU_METHOD DEZ "1 : 1 Umrechnug (dez/hex)" RAT_FUNC "%6.2" "" COEFFS 0 1 0 0 0 1 /end COMPU_METHOD
/begin COMPU_METHOD dez "1 : 1 Umrechnug (dez/hex)" RAT_FUNC "%6.2" "" COEFFS 0 1 0 0 0 1 /end COMPU_METHOD
/begin COMPU_METHOD default "" RAT_FUNC "%6.2" "" COEFFS 0 1 0 0 0 1 /end COMPU_METHOD
/begin RECORD_LAYOUT KwbUb FNC_VALUES 1 UBYTE COLUMN_DIR DIRECT /end RECORD_LAYOUT
/begin RECORD_LAYOUT KwbUw FNC_VALUES 1 UWORD COLUMN_DIR DIRECT /end RECORD_LAYOUT
/begin RECORD_LAYOUT KwbWU16 FNC_VALUES 1 UWORD COLUMN_DIR DIRECT /end RECORD_LAYOUT
/begin RECORD_LAYOUT KwbWU8 FNC_VALUES 1 UBYTE COLUMN_DIR DIRECT /end RECORD_LAYOUT
/begin RECORD_LAYOUT KwUb FNC_VALUES 1 UBYTE COLUMN_DIR DIRECT /end RECORD_LAYOUT
/begin RECORD_LAYOUT KwUw FNC_VALUES 1 UWORD COLUMN_DIR DIRECT /end RECORD_LAYOUT
/begin RECORD_LAYOUT KwWU16 FNC_VALUES 1 UWORD COLUMN_DIR DIRECT /end RECORD_LAYOUT
/begin RECORD_LAYOUT KwWU8 FNC_VALUES 1 UBYTE COLUMN_DIR DIRECT /end RECORD_LAYOUT
/end MODULE
/end PROJECT
