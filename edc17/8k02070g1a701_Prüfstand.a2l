ASAP2_VERSION 1 3
/begin PROJECT _9702_071D00 "ME97"
/begin HEADER "" VERSION "_9702_071D00" PROJECT_NO _9702_071D00 /end HEADER
/begin MODULE DIM ""
/begin MOD_COMMON "" BYTE_ORDER MSB_FIRST ALIGNMENT_BYTE 1 ALIGNMENT_WORD 2 ALIGNMENT_LONG 2 ALIGNMENT_FLOAT32_IEEE 4 /end MOD_COMMON
/begin CHARACTERISTIC ABGMSIGH "Abgastemperaturschwelle f¸r Signalunterbrechung mit Ri-Diagnose hinter KAT" VALUE 0x1CCBD6 KwUb 1275. temp_ub_q5_o50 -50.00 1225. FORMAT "%5.0" /end CHARACTERISTIC
/begin CHARACTERISTIC ALFOF "Anfangswert f¸r Lernfilter bei fuel-off Adaption" VALUE 0x1C3F64 KwWR32 2.000000000000E+037 fak_r32_1 -1.000000000000E+037 1.000000000000E+037 FORMAT "%43.4" /end CHARACTERISTIC
/begin CHARACTERISTIC ANWFOST "Anzahl NW-Umdr. f¸r Reaktivierung fuel-on/-off Adaption nach Ausblendung" VALUE 0x1C3F5C KwWU16 32767.00 dez 0.00 32767.00 FORMAT "%8.2" /end CHARACTERISTIC
/begin CHARACTERISTIC ANWSTP "Anzahl NW-Umdr., die fuel-off Adaption lernt (nachdem eingeschwungen)" VALUE 0x1C3F5E KwWU16 32767.00 dez 0.00 32767.00 FORMAT "%8.2" /end CHARACTERISTIC
/begin CHARACTERISTIC ANZDYNSH "Anzahl der Dynamikmessungen f¸r Schwingungspr¸fung Sonde hinter KAT" VALUE 0x1CD12E KwUb 255.0 dez 0.00 255.0 FORMAT "%5.1" /end CHARACTERISTIC
/begin CHARACTERISTIC APKTDI "Anzahl der internen Pr¸fungen bei Katdiagnose" VALUE 0x1CD242 KwWU8 254.0 dez 1.000 255.0 FORMAT "%5.1" /end CHARACTERISTIC
/begin CHARACTERISTIC APKTDIT "Anzahl der internen Pr¸fungen bei Katdiagnose bei Testerbetrieb" VALUE 0x1CD243 KwWU8 254.0 dez 1.000 255.0 FORMAT "%5.1" /end CHARACTERISTIC
/begin CHARACTERISTIC APKTDX "Maximale Anzahl der Pr¸fungen bei Katdiagnose" VALUE 0x1CD244 KwWU8 255.0 dez 0.00 255.0 FORMAT "%5.1" /end CHARACTERISTIC
/begin CHARACTERISTIC AVKATFS "Setztwert f¸r AVKATF wenn Powerfail" VALUE 0x1CD245 KwWU8 0.9961 fak_ub_b1 0.00 0.9961 /end CHARACTERISTIC
/begin CHARACTERISTIC CDFO "Codewort zum Ausschalten und R¸cksetzen der Adaption" VALUE 0x1C3F60 KwWU8 255.0 dez 0.00 255.0 FORMAT "%5.1" /end CHARACTERISTIC
/begin CHARACTERISTIC CDFOMOD "Codewort zum Festlegen des Modus der Fuel-on/-off Adaption" VALUE 0x1C3F61 KwWU8 255.0 dez 0.00 255.0 FORMAT "%5.1" /end CHARACTERISTIC
/begin CHARACTERISTIC CDKATSLK "Codewort f¸r B_lrka aktiv" VALUE 0x1CD246 KwWU8 255.0 dez 0.00 255.0 FORMAT "%5.1" /end CHARACTERISTIC
/begin CHARACTERISTIC CIDKATSP "Component ID f¸r Kat-Diagnose" VALUE 0x1CD247 KwWU8 255.0 dez 0.00 255.0 FORMAT "%5.1" /end CHARACTERISTIC
/begin CHARACTERISTIC CIDKATSP2 "Component ID f¸r Kat-Diagnose, Bank2" VALUE 0x1CD248 KwWU8 255.0 dez 0.00 255.0 FORMAT "%5.1" /end CHARACTERISTIC
/begin CHARACTERISTIC CIDKATSPI "Component ID f¸r Kat-Diagnose" VALUE 0x1CD249 KwWU8 255.0 dez 0.00 255.0 FORMAT "%5.1" /end CHARACTERISTIC
/begin CHARACTERISTIC CIDKATSPI2 "Component ID f¸r Kat-Diagnose" VALUE 0x1CD24A KwWU8 255.0 dez 0.00 255.0 FORMAT "%5.1" /end CHARACTERISTIC
/begin CHARACTERISTIC CIDKATSPT "Component ID f¸r Kat-Diagnose bei Testerbetrieb" VALUE 0x1CD24B KwWU8 255.0 dez 0.00 255.0 FORMAT "%5.1" /end CHARACTERISTIC
/begin CHARACTERISTIC CIDKATSPT2 "Component ID f¸r Kat-Diagnose bei Testerbetrieb, Bank2" VALUE 0x1CD24C KwWU8 255.0 dez 0.00 255.0 FORMAT "%5.1" /end CHARACTERISTIC
/begin CHARACTERISTIC CPLRA "Codewort f¸r Umschaltung DKVS von HFM- auf P-System" VALUE 0x1CE1A4 KwUb 255.0 dez 0.00 255.0 FORMAT "%5.1" /end CHARACTERISTIC
/begin CHARACTERISTIC CWDKATSP "Codewort Katalysardiagnose, funktionsintern" VALUE 0x1CD24D KwWU8 255.0 dez 0.00 255.0 FORMAT "%5.1" /end CHARACTERISTIC
/begin CHARACTERISTIC CWDKRNT "Codewort: KR-Diagnose Integratorsteigung" VALUE 0x1CE8AC KwWU8 255.0 dez 0.00 255.0 FORMAT "%5.1" /end CHARACTERISTIC
/begin CHARACTERISTIC CWDKRPAR "Codewort: KR-Diagnose Parity-Check" VALUE 0x1CE8AD KwWU8 255.0 dez 0.00 255.0 FORMAT "%5.1" /end CHARACTERISTIC
/begin CHARACTERISTIC CWDKRSPI "Codewort: KR-Diagnose SPI-‹berwachung" VALUE 0x1CE8B0 KwWU8 255.0 dez 0.00 255.0 FORMAT "%5.1" /end CHARACTERISTIC
/begin CHARACTERISTIC CWDKRTP "Codewort: KR-Diagnose Testimpuls" VALUE 0x1CE8AE KwWU8 255.0 dez 0.00 255.0 FORMAT "%5.1" /end CHARACTERISTIC
/begin CHARACTERISTIC CWDKS "Codewort Klopfsensordiagnose" VALUE 0x1CE84A KwUb 255.0 dez 0.00 255.0 FORMAT "%5.1" /end CHARACTERISTIC
/begin CHARACTERISTIC CWDKVSS "Codewort f¸r Error in DKVS sperren, wenn andere Fehler vorliegen" VALUE 0x1CE1A5 KwUb 255.0 dez 0.00 255.0 FORMAT "%5.1" /end CHARACTERISTIC
/begin CHARACTERISTIC CWDLSAHK "Codewort CWDLSAHK f¸r Alterung Sonde hinter KAT" VALUE 0x1CD12F KwUb 255.0 dez 0.00 255.0 FORMAT "%5.1" /end CHARACTERISTIC
/begin CHARACTERISTIC DASA "Anzahl der SAS-Phasen zur Erkennung LLS Fehler" VALUE 0x1CF6CC KwUb 255.0 dez 0.00 255.0 FORMAT "%5.1" /end CHARACTERISTIC
/begin CHARACTERISTIC DFRMST "Delta frm-schwelle f¸r Erkennung der eingeschwungenen Grundadaption" VALUE 0x1CE1A6 KwUb 1.992 fak_ub_b2 0.00 1.992 FORMAT "%5.3" /end CHARACTERISTIC
/begin CHARACTERISTIC DKRPAR "Schwelle f¸r Fehlerzahl Parity-Check Klopfregelung" VALUE 0x1CE8AF KwWU8 255.0 dez 0.00 255.0 FORMAT "%5.1" /end CHARACTERISTIC
/begin CHARACTERISTIC DKRSPI "Schwelle f¸r Fehlerzahl SPI-‹berwachung Klopfregelung" VALUE 0x1CE8B1 KwWU8 255.0 dez 0.00 255.0 FORMAT "%5.1" /end CHARACTERISTIC
/begin CHARACTERISTIC DKRTPN "Grenzwert des Integratorergebnisses bei Testimpuls" CURVE 0x1CE890 KlAxU8SstxU16WU16 4.999924 spg_uw_q0p000076 0.00 4.999924 FORMAT "%8.6"
 /begin AXIS_DESCR STD_AXIS tmflt_w tus_uw_q3p2 6 0.00 209712.0 FORMAT "%8.1" DEPOSIT ABSOLUTE /end AXIS_DESCR
/end CHARACTERISTIC
/begin CHARACTERISTIC DLAHISATO "obere Grenze f¸r dlahisa, CARB-Tester, DLSSALRS" VALUE 0x1CC9EC KwUb 0.09961 fak_ub_b0p1_o0p05 -0.05000 0.04961 FORMAT "%7.5" /end CHARACTERISTIC
/begin CHARACTERISTIC DLAHISATU "untere Grenze f¸r dlahisa, CARB-Tester, DLSSALRS" VALUE 0x1CC9ED KwUb 0.09961 fak_ub_b0p1_o0p05 -0.05000 0.04961 FORMAT "%7.5" /end CHARACTERISTIC
/begin CHARACTERISTIC DLAHPPLMN "minimale DLAHP-Schwelle zum Setzen des Plausfehlers ""B""" VALUE 0x1CCA0E KwSw 1.999969 fak_sw_b1 -1.000000 0.9999695 FORMAT "%8.6" /end CHARACTERISTIC
/begin CHARACTERISTIC DLAMELSH "Delta-Lambda-Sollwert f¸r elektrische Sonendiagnose hinter KAT (Kurztrip)" VALUE 0x1CCBDE KwUw 15.99976 fak_uw_b16 0.00 15.99976 FORMAT "%8.5" /end CHARACTERISTIC
/begin CHARACTERISTIC DLAMLASHF "Delta-Lambda-Sollwert (Fett) f¸r Test Schwingungspr¸fung hinter KAT" VALUE 0x1CD140 KwUw 15.99976 fak_uw_b16 0.00 15.99976 FORMAT "%8.5" /end CHARACTERISTIC
/begin CHARACTERISTIC DLAMLASHM "Delta-Lambda-Sollwert (Mager) f¸r Test Schwingungspr¸fung hinter KAT" VALUE 0x1CD142 KwUw 15.99976 fak_uw_b16 0.00 15.99976 FORMAT "%8.5" /end CHARACTERISTIC
/begin CHARACTERISTIC DLURMIN "Drehzahlabh. Laufunruhe-Referenz-Minimalwert 1" CURVE 0x1C3EE4 GklWU16 181.8962 luquant_w 0.00 181.8962 FORMAT "%8.4"
 /begin AXIS_DESCR COM_AXIS nmot nmot_ub_q40 8 0.00 10200. AXIS_PTS_REF SNM08DMUB /end AXIS_DESCR
/end CHARACTERISTIC
/begin CHARACTERISTIC DMLKTDX "Schwelle ml-ƒnderung in Kat-Diagnose" VALUE 0x1CD24E KwWU8 1020. m_ub_b1020 0.00 1020. FORMAT "%5.0" /end CHARACTERISTIC
/begin CHARACTERISTIC DMRKTDS "Momentenreserve f¸r Katalysator-Diagnose" VALUE 0x1CD220 KwWU16 99.99847 rel_uw_b100 0.00 99.99847 FORMAT "%8.5" /end CHARACTERISTIC
/begin CHARACTERISTIC DMRLASH "Momentenreserve f¸r Diagnose Lambdasonden-Alterungs¸berwachung hinter KAT" VALUE 0x1CD144 KwUw 99.99847 rel_uw_b100 0.00 99.99847 FORMAT "%8.5" /end CHARACTERISTIC
/begin CHARACTERISTIC DMRLSH "Momentenreserve f¸r Diagnose Lambdasonden hinter KAT" VALUE 0x1CCBE0 KwUw 99.99847 rel_uw_b100 0.00 99.99847 FORMAT "%8.5" /end CHARACTERISTIC
/begin CHARACTERISTIC DMRLSV "Momentenreserve f¸r Diagnose Lambdasonde vor Kat" VALUE 0x1CCA10 KwUw 99.99847 rel_uw_b100 0.00 99.99847 FORMAT "%8.5" /end CHARACTERISTIC
/begin CHARACTERISTIC DMXRDL "Begrenzung bei max. Laufunruhe-Referenzwert-ƒnderung von dlurs" VALUE 0x1C3EF8 KwWR32 2.000000000000E+037 fak_r32_1 -1.000000000000E+037 1.000000000000E+037 FORMAT "%43.4" /end CHARACTERISTIC
/begin CHARACTERISTIC DNDLLRO "Maximale Drehzahlabweichung (Unterdrehzahl) f¸r Diagnose LLR" VALUE 0x1CF6CD KwUb 1270. nmot_ub_q10 0.00 1270. FORMAT "%5.0" /end CHARACTERISTIC
/begin CHARACTERISTIC DNDLLRU "Maximale Drehzahlabweichung (‹berdrehzahl) f¸r Diagnose LLR" VALUE 0x1CF6CE KwSb 1280. nmot_ub_q10 -1280. 0.00 FORMAT "%5.0" /end CHARACTERISTIC
/begin CHARACTERISTIC DRISIGH "Diagnoseschwelle Ri-Sonde f¸r Signalunterbrechung hinter KAT" VALUE 0x1CCBE2 KwUw 131070.0 r_uw_q2 0.00 131070.0 FORMAT "%8.1" /end CHARACTERISTIC
/begin CHARACTERISTIC DRLMX "Schwelle f¸r Last‰nderung" VALUE 0x1CC9FE KwUb 191.3 rel_ub_q0p75 0.00 191.3 FORMAT "%5.1" /end CHARACTERISTIC
/begin CHARACTERISTIC DTKTDGRAX "Katdiagnose: Maximaler Temperaturgradient" VALUE 0x1CD24F KwWU8 1275. temp_ub_q5 0.00 1275. FORMAT "%5.0" /end CHARACTERISTIC
/begin CHARACTERISTIC DYNLSUFA "Grenzwert f¸r LSU-Dynamik bei Kurztest" VALUE 0x1CCA12 KwUw 15.99976 fak_uw_b16 0.00 15.99976 FORMAT "%8.5" /end CHARACTERISTIC
/begin CHARACTERISTIC DYNLSUMX "Grenzwert f¸r LSU-Dynamik" VALUE 0x1CCA14 KwUw 15.99976 fak_uw_b16 0.00 15.99976 FORMAT "%8.5" /end CHARACTERISTIC
/begin CHARACTERISTIC DYNLSURD "reduzierter Grenzwert f¸r LSU-Dynamik" VALUE 0x1CCA16 KwUw 15.99976 fak_uw_b16 0.00 15.99976 FORMAT "%8.5" /end CHARACTERISTIC
/begin CHARACTERISTIC DYNLSUTO "obere Grenze f¸r dynlsusa, CARB-Tester, DLSSALRS" VALUE 0x1CC9EE KwUb 4.980 fak_q0p0195 0.00 4.980 FORMAT "%5.3" /end CHARACTERISTIC
/begin CHARACTERISTIC DYNLSUTU "untere Grenze f¸r dynlsusa, CARB-Tester, DLSSALRS" VALUE 0x1CC9EF KwUb 4.980 fak_q0p0195 0.00 4.980 FORMAT "%5.3" /end CHARACTERISTIC
/begin CHARACTERISTIC FHDLLR "Hˆhenschwelle f¸r Durchf¸hrung Diagnose Leerlaufsteller" VALUE 0x1CF6CF KwUb 3.984 fak_ub_b4 0.00 3.984 FORMAT "%5.3" /end CHARACTERISTIC
/begin CHARACTERISTIC FIKTD "Bewertungsfaktor des Kat-Ausr‰umintegrals bei Katdiagnose" VALUE 0x1CD250 KwWU8 15.94 fak_ub_b16 0.00 15.94 FORMAT "%5.2" /end CHARACTERISTIC
/begin CHARACTERISTIC FKTDAVK "Faktor avkatf-Umrechnung bei Katdiagnose" VALUE 0x1CD251 KwWU8 0.9961 fak_ub_b1 0.00 0.9961 /end CHARACTERISTIC
/begin CHARACTERISTIC FKTDFE "Faktor Fetteintrag bei Katdiagnose" VALUE 0x1CD252 KwWU8 7.969 fak_ub_b8 0.00 7.969 FORMAT "%5.3" /end CHARACTERISTIC
/begin CHARACTERISTIC FKTDFET "Faktor Fetteintrag bei Katdiagnose, Testeranforderung" VALUE 0x1CD253 KwWU8 7.969 fak_ub_b8 0.00 7.969 FORMAT "%5.3" /end CHARACTERISTIC
/begin CHARACTERISTIC FKTDGTV "Katdiagnose: Faktor f¸r Temperaturgradientenabh‰ngige Verzugszeit" VALUE 0x1CD254 KwWU8 10.20 ttemp_q0p04 0.00 10.20 FORMAT "%5.2" /end CHARACTERISTIC
/begin CHARACTERISTIC FLFOF "Filterfaktor Lernfilter der fuel-off Adaption" VALUE 0x1C3F68 KwWR32 2.000000000000E+037 fak_r32_1 -1.000000000000E+037 1.000000000000E+037 FORMAT "%43.4" /end CHARACTERISTIC
/begin CHARACTERISTIC FOFAKT "Codewort zum Anhalten der Fuel-off Adaption" VALUE 0x1C3F62 KwWU8 255.0 dez 0.00 255.0 FORMAT "%5.1" /end CHARACTERISTIC
/begin CHARACTERISTIC FRAE "Delta-fra-Schwelle f¸r Erkennung der eingeschwungenen Grundadaption" VALUE 0x1CE1C8 KwUw 1.999969 fak_uw_b2 0.00 1.999969 FORMAT "%8.6" /end CHARACTERISTIC
/begin CHARACTERISTIC FRAODN "untere Diagnoseschwelle des Korrekturfaktors frao" VALUE 0x1CE1CA KwUw 1.999969 fak_uw_b2 0.00 1.999969 FORMAT "%8.6" /end CHARACTERISTIC
/begin CHARACTERISTIC FRAODX "obere Diagnoseschwelle des Korrekturfaktors frao" VALUE 0x1CE1CC KwUw 1.999969 fak_uw_b2 0.00 1.999969 FORMAT "%8.6" /end CHARACTERISTIC
/begin CHARACTERISTIC FRAUDN "untere Diagnoseschwelle des Korrekturfaktors frau" VALUE 0x1CE1CE KwUw 1.999969 fak_uw_b2 0.00 1.999969 FORMAT "%8.6" /end CHARACTERISTIC
/begin CHARACTERISTIC FRAUDX "obere Diagnoseschwelle des Korrekturfaktors frau" VALUE 0x1CE1D0 KwUw 1.999969 fak_uw_b2 0.00 1.999969 FORMAT "%8.6" /end CHARACTERISTIC
/begin CHARACTERISTIC FRMLASHO "obere Schwelle f¸r Mittelwert des Lambdareglerfaktors" VALUE 0x1CD146 KwUw 1.999969 fak_uw_b2 0.00 1.999969 FORMAT "%8.6" /end CHARACTERISTIC
/begin CHARACTERISTIC FRMLASHU "untere Schwelle f¸r Mittelwert des Lambdareglerfaktors" VALUE 0x1CD148 KwUw 1.999969 fak_uw_b2 0.00 1.999969 FORMAT "%8.6" /end CHARACTERISTIC
/begin CHARACTERISTIC FRMSTTDN "untere Diagnoseschwelle (short test)" CURVE 0x1CE1A8 KlAUbSstUbWUb 1.992 fak_ub_b2 0.00 1.992 FORMAT "%5.3"
 /begin AXIS_DESCR STD_AXIS tans temp_ub_q0p75_o48 4 -48.00 143.3 FORMAT "%5.1" DEPOSIT ABSOLUTE /end AXIS_DESCR
/end CHARACTERISTIC
/begin CHARACTERISTIC FRMSTTDX "obere Diagnoseschwelle (short test)" CURVE 0x1CE1B4 KlAUbSstUbWUb 1.992 fak_ub_b2 0.00 1.992 FORMAT "%5.3"
 /begin AXIS_DESCR STD_AXIS tans temp_ub_q0p75_o48 4 -48.00 143.3 FORMAT "%5.1" DEPOSIT ABSOLUTE /end AXIS_DESCR
/end CHARACTERISTIC
/begin CHARACTERISTIC FS1FOF "Filterfaktor Segmentzeit-Filter 1 der fuel-off Adaption" VALUE 0x1C3F6C KwWR32 2.000000000000E+037 fak_r32_1 -1.000000000000E+037 1.000000000000E+037 FORMAT "%43.4" /end CHARACTERISTIC
/begin CHARACTERISTIC FS2FOF "Filterfaktor Segmentzeit-Filter 2 der fuel-off Adaption" VALUE 0x1C3F70 KwWR32 2.000000000000E+037 fak_r32_1 -1.000000000000E+037 1.000000000000E+037 FORMAT "%43.4" /end CHARACTERISTIC
/begin CHARACTERISTIC IMLHEMN "Minimale integierte Luftmasse zum Heilen eines Fehlers" VALUE 0x1CCA18 KwUw 1.820417 m_q2p777Em5_kg 0.00 1.820417 FORMAT "%8.6" /end CHARACTERISTIC
/begin CHARACTERISTIC IMLHEMNFA "Minimale integierte Luftmasse zum Heilen eines Fehlers, bei Bandendepr¸fung" VALUE 0x1CCA1A KwUw 1.820417 m_q2p777Em5_kg 0.00 1.820417 FORMAT "%8.6" /end CHARACTERISTIC
/begin CHARACTERISTIC IMLKVSMX "Maximale Integrationsschwelle f¸r Fehlerfreigabe in DKVS (Tank leer)" VALUE 0x1CE1D2 KwUw 233.0133 m_q0p00355 0.00 233.0133 FORMAT "%8.4" /end CHARACTERISTIC
/begin CHARACTERISTIC IMLPLCMN "minimale integrierte Luftmasse f¸r den Plausibilit‰tscheck" VALUE 0x1CCA1C KwUw 1.820417 m_q2p777Em5_kg 0.00 1.820417 FORMAT "%8.6" /end CHARACTERISTIC
/begin CHARACTERISTIC IMLPLCMNB "minimale integrierte Luftmasse f¸r den erweiterten Plausibilit‰tscheck" VALUE 0x1CCA1E KwUw 1.820417 m_q2p777Em5_kg 0.00 1.820417 FORMAT "%8.6" /end CHARACTERISTIC
/begin CHARACTERISTIC IVDYNLSU "Startwert f¸r dynlsu_w" VALUE 0x1CCA20 KwUw 15.99976 fak_uw_b16 0.00 15.99976 FORMAT "%8.5" /end CHARACTERISTIC
/begin CHARACTERISTIC KDYNFA "Rekursionskonstante f¸r LSU-Dynamik bei Kurztest" VALUE 0x1C4D38 KwUw 0.9999847 fak_uw_b1 0.00 0.9999847 FORMAT "%9.7" /end CHARACTERISTIC
/begin CHARACTERISTIC KDYNLSU "Rekursionskonstante f¸r LSU-Dynamik" VALUE 0x1C4D3A KwUw 0.9999847 fak_uw_b1 0.00 0.9999847 FORMAT "%9.7" /end CHARACTERISTIC
/begin CHARACTERISTIC KFDLUR "Kennfeld f¸r Laufunruhedifferenz dluts Referenzwert" MAP 0x1C3CE4 GkfWU16 181.8962 luquant_w 0.00 181.8962 FORMAT "%8.4"
 /begin AXIS_DESCR COM_AXIS rl rel_ub_q0p75 8 0.00 191.3 AXIS_PTS_REF SRL08DMUB /end AXIS_DESCR
 /begin AXIS_DESCR COM_AXIS nmot nmot_ub_q40 8 0.00 10200. AXIS_PTS_REF SNM08DMUB /end AXIS_DESCR
/end CHARACTERISTIC
/begin CHARACTERISTIC KFDLUR1 "Kennfeld f¸r Laufunruhedifferenz dluts Referenzwert" MAP 0x1C3D64 GkfWU16 181.8962 luquant_w 0.00 181.8962 FORMAT "%8.4"
 /begin AXIS_DESCR COM_AXIS rl rel_ub_q0p75 8 0.00 191.3 AXIS_PTS_REF SRL08DMUB /end AXIS_DESCR
 /begin AXIS_DESCR COM_AXIS nmot nmot_ub_q40 8 0.00 10200. AXIS_PTS_REF SNM08DMUB /end AXIS_DESCR
/end CHARACTERISTIC
/begin CHARACTERISTIC KFDLUR2 "Kennfeld f¸r Laufunruhedifferenz dluts Referenzwert" MAP 0x1C3DE4 GkfWU16 181.8962 luquant_w 0.00 181.8962 FORMAT "%8.4"
 /begin AXIS_DESCR COM_AXIS rl rel_ub_q0p75 8 0.00 191.3 AXIS_PTS_REF SRL08DMUB /end AXIS_DESCR
 /begin AXIS_DESCR COM_AXIS nmot nmot_ub_q40 8 0.00 10200. AXIS_PTS_REF SNM08DMUB /end AXIS_DESCR
/end CHARACTERISTIC
/begin CHARACTERISTIC KFDLURS "Kennfeld f¸r Laufunruhedifferenz dluts Referenzwert" MAP 0x1C3E64 GkfWU16 181.8962 luquant_w 0.00 181.8962 FORMAT "%8.4"
 /begin AXIS_DESCR COM_AXIS rl rel_ub_q0p75 8 0.00 191.3 AXIS_PTS_REF SRL08DMUB /end AXIS_DESCR
 /begin AXIS_DESCR COM_AXIS nmot nmot_ub_q40 8 0.00 10200. AXIS_PTS_REF SNM08DMUB /end AXIS_DESCR
/end CHARACTERISTIC
/begin CHARACTERISTIC KFOSCTM "Kennfeld OSC des Grenzkatalysators" MAP 0x1CD16A KfAxU8AyU8SstxU16SstyU16WU16 6543.500 m_q0p1_mg 10.00000 6553.500 FORMAT "%8.3"
 /begin AXIS_DESCR STD_AXIS tikatm_w temp_uw_q0p0195_o50 8 -50.00000 1229.980 FORMAT "%8.3" DEPOSIT ABSOLUTE /end AXIS_DESCR
 /begin AXIS_DESCR STD_AXIS msabg_w m_uw_b6553p5 8 0.00 6553.500 FORMAT "%8.3" DEPOSIT ABSOLUTE /end AXIS_DESCR
/end CHARACTERISTIC
/begin CHARACTERISTIC KLCFOF1N "Kennlinie zur Definition der Bereichseigenschaften (dominant..)" CURVE 0x1C3F1C GklWU8 255.0 dez 0.00 255.0 FORMAT "%5.1"
 /begin AXIS_DESCR COM_AXIS nmot_w nmot_uw_q0p25 6 0.00 16383.75 AXIS_PTS_REF SNM06DMUW1 /end AXIS_DESCR
/end CHARACTERISTIC
/begin CHARACTERISTIC KLCFOF2N "Kennlinie zur Definition der Bereichseigenschaften (dominant..)" CURVE 0x1C3F24 GklWU8 255.0 dez 0.00 255.0 FORMAT "%5.1"
 /begin AXIS_DESCR COM_AXIS nmot_w nmot_uw_q0p25 6 0.00 16383.75 AXIS_PTS_REF SNM06DMUW2 /end AXIS_DESCR
/end CHARACTERISTIC
/begin CHARACTERISTIC KLIDXFOFN1 "Kennlinie zur Definition des Bereichsindex" CURVE 0x1C3F2C GklWU8 4.000 dez 0.00 4.000 FORMAT "%5.3"
 /begin AXIS_DESCR COM_AXIS nmot_w nmot_uw_q0p25 6 0.00 16383.75 AXIS_PTS_REF SNM06DMUW1 /end AXIS_DESCR
/end CHARACTERISTIC
/begin CHARACTERISTIC KLIDXFOFN2 "Kennlinie zur Definition des Bereichsindex" CURVE 0x1C3F34 GklWU8 4.000 dez 0.00 4.000 FORMAT "%5.3"
 /begin AXIS_DESCR COM_AXIS nmot_w nmot_uw_q0p25 6 0.00 16383.75 AXIS_PTS_REF SNM06DMUW2 /end AXIS_DESCR
/end CHARACTERISTIC
/begin CHARACTERISTIC KMXSTG "Filterkonstante f¸r Filter max. Steigung f¸r Sonde hinter KAT" VALUE 0x1CD14A KwUw 0.9999847 fak_uw_b1 0.00 0.9999847 FORMAT "%9.7" /end CHARACTERISTIC
/begin CHARACTERISTIC KRFHKS "Fehlerh‰ufigkeit Klopfsensoren" VALUE 0x1CE84B KwUb 255.0 dez 0.00 255.0 FORMAT "%5.1" /end CHARACTERISTIC
/begin CHARACTERISTIC KRFHT "Fehlerh‰ufigkeit Testimpuls" VALUE 0x1C60ED KwUb 254.0 dez 1.000 255.0 FORMAT "%5.1" /end CHARACTERISTIC
/begin CHARACTERISTIC KRZYLDIAG "Auswahl (lauter) Zylinder f¸r KS-Diagnose" VALUE 0x1CE84C KwUb 255.0 dez 0.00 255.0 FORMAT "%5.1" /end CHARACTERISTIC
/begin CHARACTERISTIC KTLAMSTEIG "I-Faktor  f¸r  Rampensteigung lamlash im Kurztrip f¸r Testfunktion hinter KAT" VALUE 0x1CD14C KwUw 0.9999847 fak_uw_b1 0.00 0.9999847 FORMAT "%9.7" /end CHARACTERISTIC
/begin CHARACTERISTIC LAKTDEO "Obere Schwelle f¸r Lambda eingeschwungen bei Katdiagnose" VALUE 0x1CD222 KwWU16 15.99976 fak_uw_b16 0.00 15.99976 FORMAT "%8.5" /end CHARACTERISTIC
/begin CHARACTERISTIC LAKTDEU "Untere Schwelle f¸r Lambda eingeschwungen bei Katdiagnose" VALUE 0x1CD224 KwWU16 15.99976 fak_uw_b16 0.00 15.99976 FORMAT "%8.5" /end CHARACTERISTIC
/begin CHARACTERISTIC LAMDYNO "obere Lambdaschwelle f¸r Dynamikpr¸fung LSU" VALUE 0x1CCA22 KwUw 15.99976 fak_uw_b16 0.00 15.99976 FORMAT "%8.5" /end CHARACTERISTIC
/begin CHARACTERISTIC LAMDYNU "untere Lambdaschwelle f¸r Dynamikpr¸fung LSU" VALUE 0x1CCA24 KwUw 15.99976 fak_uw_b16 0.00 15.99976 FORMAT "%8.5" /end CHARACTERISTIC
/begin CHARACTERISTIC LAMMN "Untere Plausibilit‰tsschwelle f¸r Lambda" VALUE 0x1CCA26 KwUw 15.99976 fak_uw_b16 0.00 15.99976 FORMAT "%8.5" /end CHARACTERISTIC
/begin CHARACTERISTIC LAMMX "Obere Plausibilit‰tsschwelle f¸r Lambda" VALUE 0x1CCA28 KwUw 15.99976 fak_uw_b16 0.00 15.99976 FORMAT "%8.5" /end CHARACTERISTIC
/begin CHARACTERISTIC LAMSONSVL "Schwelle f¸r Vollast Lambda-Betrieb bei der Sondenspannung ¸berpr¸ft wird" VALUE 0x1CD14E KwUw 15.99976 fak_uw_b16 0.00 15.99976 FORMAT "%8.5" /end CHARACTERISTIC
/begin CHARACTERISTIC LAMSSAMN "untere Grenze f¸r lamsosa und lamsisa, CARB-Tester, DLSSALRS" VALUE 0x1CC9F0 KwUb 1.992 fak_ub_b2 0.00 1.992 FORMAT "%5.3" /end CHARACTERISTIC
/begin CHARACTERISTIC LAMSSAMX "obere Grenze f¸r lamsosa und lamsisa, CARB-Tester, DLSSALRS" VALUE 0x1CC9F1 KwUb 1.992 fak_ub_b2 0.00 1.992 FORMAT "%5.3" /end CHARACTERISTIC
/begin CHARACTERISTIC LAMSSMN "Minimales Lambdasoll f¸r  stˆchiometrischen Betrieb" VALUE 0x1CCA2A KwUw 15.99976 fak_uw_b16 0.00 15.99976 FORMAT "%8.5" /end CHARACTERISTIC
/begin CHARACTERISTIC LAMSSMX "Maximales Lambdasoll f¸r  stˆchiometrischen Betrieb" VALUE 0x1CCA2C KwUw 15.99976 fak_uw_b16 0.00 15.99976 FORMAT "%8.5" /end CHARACTERISTIC
/begin CHARACTERISTIC LAMSTEIG "I-Faktor  f¸r  Rampensteigung lamlash f¸r Testfunktion hinter KAT" VALUE 0x1CD150 KwUw 0.9999847 fak_uw_b1 0.00 0.9999847 FORMAT "%9.7" /end CHARACTERISTIC
/begin CHARACTERISTIC LASPLCFT "Fettschwelle f¸r den Sollwert von Lambda f¸r den Plausibilit‰tscheck" VALUE 0x1CCA2E KwUw 15.99976 fak_uw_b16 0.00 15.99976 FORMAT "%8.5" /end CHARACTERISTIC
/begin CHARACTERISTIC LASPLCMR "Magerschwelle f¸r den Sollwert von Lambda f¸r den Plausibilit‰tscheck" VALUE 0x1CCA30 KwUw 15.99976 fak_uw_b16 0.00 15.99976 FORMAT "%8.5" /end CHARACTERISTIC
/begin CHARACTERISTIC LBKDSOLMX "Wert den LBK-Sollwert ¸berschreiten muﬂ, damit Lageregler fehlerheilung mˆglich" VALUE 0x1CA6F8 KwUw 99.99847 rel_uw_b100 0.00 99.99847 FORMAT "%8.5" /end CHARACTERISTIC
/begin CHARACTERISTIC LKTDF "Lambdawert bei Kat-Diagnose, Fettsprung" VALUE 0x1CD226 KwWU16 0.2500000 fak_uw_b16 0.7500000 1.000000 FORMAT "%8.6" /end CHARACTERISTIC
/begin CHARACTERISTIC LKTDFT "Lambdawert bei Kat-Diagnose, Fettsprung, Testerbetrieb" VALUE 0x1CD228 KwWU16 0.2500000 fak_uw_b16 0.7500000 1.000000 FORMAT "%8.6" /end CHARACTERISTIC
/begin CHARACTERISTIC LKTDM "Lambdawert bei Kat-Diagnose, Magersprung" VALUE 0x1CD22A KwWU16 0.2500000 fak_uw_b16 1.000000 1.250000 FORMAT "%8.6" /end CHARACTERISTIC
/begin CHARACTERISTIC LKTDMT "Lambdawert bei Kat-Diagnose, Magersprung, Testerbetrieb" VALUE 0x1CD22C KwWU16 0.2500000 fak_uw_b16 1.000000 1.250000 FORMAT "%8.6" /end CHARACTERISTIC
/begin CHARACTERISTIC LSUNAMN "untere Schwelle f¸r LSU nicht aktiv" VALUE 0x1CCA32 KwUw 15.99976 fak_uw_b16 0.00 15.99976 FORMAT "%8.5" /end CHARACTERISTIC
/begin CHARACTERISTIC LSUNAMX "obere Schwelle f¸r LSU nicht aktiv" VALUE 0x1CCA34 KwUw 15.99976 fak_uw_b16 0.00 15.99976 FORMAT "%8.5" /end CHARACTERISTIC
/begin CHARACTERISTIC LURFOST "Laufruhe-Referenzwert f¸r stop fuel-on/-off Adaption, Vergleich mit lunw" VALUE 0x1C3F74 KwWR32 2.000000000000E+037 fak_r32_1 -1.000000000000E+037 1.000000000000E+037 FORMAT "%43.4" /end CHARACTERISTIC
/begin CHARACTERISTIC MLDKVSF "Luftmassenschwelle f¸r Fehlerfreigabe im DKVS (Tank leer)" VALUE 0x1CE1D4 KwUw 233.0133 m_q0p00355 0.00 233.0133 FORMAT "%8.4" /end CHARACTERISTIC
/begin CHARACTERISTIC MLDKVSG "Luftmassenschwelle f¸r Fehlerfreigabe Tank leer" VALUE 0x1CE1D6 KwUw 233.0133 m_q0p00355 0.00 233.0133 FORMAT "%8.4" /end CHARACTERISTIC
/begin CHARACTERISTIC MLKTDO "Obere Luftmassenschwelle f¸r Kat-Diagnose" VALUE 0x1CD22E KwWU16 6553.500 m_uw_b6553p5 0.00 6553.500 FORMAT "%8.3" /end CHARACTERISTIC
/begin CHARACTERISTIC MLKTDOO "Obere Luftmassenschwelle f¸r Kat-Diagnose, oberes Band" VALUE 0x1CD230 KwWU16 6553.500 m_uw_b6553p5 0.00 6553.500 FORMAT "%8.3" /end CHARACTERISTIC
/begin CHARACTERISTIC MLKTDOT "Obere Luftmassenschwelle f¸r Kat-Diagnose bei Testerbetrieb" VALUE 0x1CD232 KwWU16 6553.500 m_uw_b6553p5 0.00 6553.500 FORMAT "%8.3" /end CHARACTERISTIC
/begin CHARACTERISTIC MLKTDU "Untere Luftmassenschwelle f¸r Kat-Diagnose" VALUE 0x1CD234 KwWU16 6553.500 m_uw_b6553p5 0.00 6553.500 FORMAT "%8.3" /end CHARACTERISTIC
/begin CHARACTERISTIC MLKTDUO "Untere Luftmassenschwelle f¸r Kat-Diagnose, oberes Band" VALUE 0x1CD236 KwWU16 6553.500 m_uw_b6553p5 0.00 6553.500 FORMAT "%8.3" /end CHARACTERISTIC
/begin CHARACTERISTIC MLKTDUT "Untere Luftmassenschwelle f¸r Kat-Diagnose, Testerbetrieb" VALUE 0x1CD238 KwWU16 6553.500 m_uw_b6553p5 0.00 6553.500 FORMAT "%8.3" /end CHARACTERISTIC
/begin CHARACTERISTIC MLLASH "Luftmassenschwelle f¸r Schwingungspr¸fung hinter KAT" VALUE 0x1CD152 KwUw 6553.500 m_q0p1 0.00 6553.500 FORMAT "%8.3" /end CHARACTERISTIC
/begin CHARACTERISTIC MLOSTEST "obere Luftmassenschwelle f¸r Testbeginn Schwingungspr¸fung hinter KAT" VALUE 0x1CD154 KwUw 6553.500 m_q0p1 0.00 6553.500 FORMAT "%8.3" /end CHARACTERISTIC
/begin CHARACTERISTIC MLUSSTG "Luftmassenschwelle f¸r Dynamikpr¸fung hinter KAT" VALUE 0x1CD156 KwUw 6553.500 m_q0p1 0.00 6553.500 FORMAT "%8.3" /end CHARACTERISTIC
/begin CHARACTERISTIC MLUSTEST "untere Luftmassenschwelle f¸r Testbeginn Schwingungspr¸fung hinter KAT" VALUE 0x1CD158 KwUw 6553.500 m_q0p1 0.00 6553.500 FORMAT "%8.3" /end CHARACTERISTIC
/begin CHARACTERISTIC MLUSVL "Luftmassenschwelle f¸r Vollast-Pr¸fung f¸r Sonde hinter KAT" VALUE 0x1CD15A KwUw 6553.500 m_q0p1 0.00 6553.500 FORMAT "%8.3" /end CHARACTERISTIC
/begin CHARACTERISTIC MSAPLMN "untere Schwelle f¸r Plausibilit‰tspr¸fung LSU" VALUE 0x1CCA36 KwUw 6553.500 m_uw_b6553p5 0.00 6553.500 FORMAT "%8.3" /end CHARACTERISTIC
/begin CHARACTERISTIC NDKSO "Obere Diagnoseschwelle f¸r Klopfsensordiagnose" VALUE 0x1CE84D KwUb 10200. nmot_ub_q40 0.00 10200. FORMAT "%5.0" /end CHARACTERISTIC
/begin CHARACTERISTIC NDKSU "Untere Diagnoseschwelle f¸r Klopfsensordiagnose" VALUE 0x1CE84E KwUb 10200. nmot_ub_q40 0.00 10200. FORMAT "%5.0" /end CHARACTERISTIC
/begin CHARACTERISTIC NLSULFMX "Maximale Anzahl von Sondenleitungsfehlern pro Zeitinterval" VALUE 0x1CC9FF KwUb 255.0 dez 0.00 255.0 FORMAT "%5.1" /end CHARACTERISTIC
/begin CHARACTERISTIC NMIDLU "Min. Drehzahl f¸r Ausblendung der Aussetzererkennung DMDDLU" VALUE 0x1C3EF4 KwWU8 10200. nmot_ub_q40 0.00 10200. FORMAT "%5.0" /end CHARACTERISTIC
/begin CHARACTERISTIC NMOTDYFA "untere Drehzahlschwelle f¸r Dynamikpr¸fung LSU bei Kurztest" VALUE 0x1CCA00 KwUb 10200. nmot_ub_q40 0.00 10200. FORMAT "%5.0" /end CHARACTERISTIC
/begin CHARACTERISTIC NMOTDYNO "obere Drehzahlschwelle f¸r Dynamikpr¸fung LSU" VALUE 0x1CCA01 KwUb 10200. nmot_ub_q40 0.00 10200. FORMAT "%5.0" /end CHARACTERISTIC
/begin CHARACTERISTIC NMOTDYNU "untere Drehzahlschwelle f¸r Dynamikpr¸fung LSU" VALUE 0x1CCA02 KwUb 10200. nmot_ub_q40 0.00 10200. FORMAT "%5.0" /end CHARACTERISTIC
/begin CHARACTERISTIC OSCKTD "Schwelle Sauerstoffspeicherf‰higkeit des Kats f¸r Gut-Erkennung" VALUE 0x1CD23A KwWU16 15.99976 fak_uw_b16 0.00 15.99976 FORMAT "%8.5" /end CHARACTERISTIC
/begin CHARACTERISTIC OSCKTDNG "Meﬂbereich  der normierten Sauerstoffspeicherf‰higkeit" VALUE 0x1CD23C KwWU16 15.99976 fak_uw_b16 0.00 15.99976 FORMAT "%8.5" /end CHARACTERISTIC
/begin CHARACTERISTIC OSCKTDT "Schwelle Sauerstoffspeicherf‰higkeit des Kats bei Testerbetrieb" VALUE 0x1CD23E KwWU16 15.99976 fak_uw_b16 0.00 15.99976 FORMAT "%8.5" /end CHARACTERISTIC
/begin CHARACTERISTIC RISIGRESH "Schwelle f¸r Reset Signalunterbrechung mit Ri-Diagnose hinter KAT" VALUE 0x1CCBE4 KwUw 131070.0 r_uw_q2 0.00 131070.0 FORMAT "%8.1" /end CHARACTERISTIC
/begin CHARACTERISTIC RKAE "Delta rkat- bzw. rkaz-Schwelle f¸r Erkennung der eingeschwungenen Grundadaption" VALUE 0x1CE1D8 KwSw 3071.953 rel_sw_b1536 -1536.000 1535.953 FORMAT "%8.3" /end CHARACTERISTIC
/begin CHARACTERISTIC RKATDN "untere Diagnoseschwelle additive Korrektur pro Zeit" VALUE 0x1CE1DA KwSw 3071.953 rel_sw_b1536 -1536.000 1535.953 FORMAT "%8.3" /end CHARACTERISTIC
/begin CHARACTERISTIC RKATDX "obere Diagnoseschwelle additive Korrektur pro Zeit" VALUE 0x1CE1DC KwSw 3071.953 rel_sw_b1536 -1536.000 1535.953 FORMAT "%8.3" /end CHARACTERISTIC
/begin CHARACTERISTIC RKAZDN "untere Diagnoseschwelle additive Korrektur pro Z¸ndung" VALUE 0x1CE1DE KwSw 3071.953 rel_sw_b1536 -1536.000 1535.953 FORMAT "%8.3" /end CHARACTERISTIC
/begin CHARACTERISTIC RKAZDX "obere Diagnoseschwelle additive Korrektur pro Z¸ndung" VALUE 0x1CE1E0 KwSw 3071.953 rel_sw_b1536 -1536.000 1535.953 FORMAT "%8.3" /end CHARACTERISTIC
/begin CHARACTERISTIC RLDYNFA "Lastschwelle f¸r Dynamikpr¸fung LSU bei Kurztest" VALUE 0x1CCA03 KwUb 191.3 rel_ub_q0p75 0.00 191.3 FORMAT "%5.1" /end CHARACTERISTIC
/begin CHARACTERISTIC RLDYNO "obere Lastschwelle f¸r Dynamikpr¸fung LSU" VALUE 0x1CCA04 KwUb 191.3 rel_ub_q0p75 0.00 191.3 FORMAT "%5.1" /end CHARACTERISTIC
/begin CHARACTERISTIC RLDYNU "untere Lastschwelle f¸r Dynamikpr¸fung LSU" VALUE 0x1CCA05 KwUb 191.3 rel_ub_q0p75 0.00 191.3 FORMAT "%5.1" /end CHARACTERISTIC
/begin CHARACTERISTIC RLMDVERL "Lastschwelle f¸r Unterdrehzahlpr¸fung abh. von mdverl_w" CURVE 0x1CF6D2 KlAUwSstUwWUw 99.99902 rel_uw_b192 0.00 99.99902 FORMAT "%8.5"
 /begin AXIS_DESCR STD_AXIS mdverl_w rel_uw_b100 3 0.00 99.99847 FORMAT "%8.5" DEPOSIT ABSOLUTE /end AXIS_DESCR
/end CHARACTERISTIC
/begin CHARACTERISTIC SAFK1 "Filterkonstante 1 f¸r Lambdasonden-Signalausgabe" VALUE 0x1CC9FA KwUw 0.9999847 fak_uw_b1 0.00 0.9999847 FORMAT "%9.7" /end CHARACTERISTIC
/begin CHARACTERISTIC SDLAOF "Schwelle delta Lambda Offset Regler hinter Kat" VALUE 0x1CCA38 KwSw 1.999969 fak_sw_b1 -1.000000 0.9999695 FORMAT "%8.6" /end CHARACTERISTIC
/begin CHARACTERISTIC SDULSUMX "Schwelle delta Spannung max pro Rechentakt" VALUE 0x1C4D3C KwUw 319.9951 spg_uw_b5 0.00 319.9951 FORMAT "%8.4" /end CHARACTERISTIC
/begin CHARACTERISTIC SI04DMUB1 "Kennlinie zur Definition der St¸tzstellen" VAL_BLK 0x1C3F3C KwbWR32 2.000000000000E+037 fak_r32_1 -1.000000000000E+037 1.000000000000E+037 FORMAT "%43.4" NUMBER 4 /end CHARACTERISTIC
/begin CHARACTERISTIC SI04DMUB2 "Kennlinie zur Definition der St¸tzstellen" VAL_BLK 0x1C3F4C KwbWR32 2.000000000000E+037 fak_r32_1 -1.000000000000E+037 1.000000000000E+037 FORMAT "%43.4" NUMBER 4 /end CHARACTERISTIC
/begin CHARACTERISTIC SLFOFO1N "Obere Schwelle (Schwellwert-KL) f¸r Lernfilterwert bei fuel-off Adaption" CURVE 0x1C3EFC GklWU16 0.9999847 fak_uw_b1 0.00 0.9999847 FORMAT "%9.7"
 /begin AXIS_DESCR COM_AXIS nmot_w nmot_uw_q0p25 4 0.00 16383.75 AXIS_PTS_REF SNM04DMUW1 /end AXIS_DESCR
/end CHARACTERISTIC
/begin CHARACTERISTIC SLFOFO2N "Obere Schwelle (Schwellwert-KL) f¸r Lernfilterwert bei fuel-off Adaption" CURVE 0x1C3F04 GklWU16 0.9999847 fak_uw_b1 0.00 0.9999847 FORMAT "%9.7"
 /begin AXIS_DESCR COM_AXIS nmot_w nmot_uw_q0p25 4 0.00 16383.75 AXIS_PTS_REF SNM04DMUW2 /end AXIS_DESCR
/end CHARACTERISTIC
/begin CHARACTERISTIC SLFOFU1N "untere Schwelle (Schwellwert-KL) f¸r Lernfilterwert bei fuel-off Adaption" CURVE 0x1C3F0C GklWU16 0.9999847 fak_uw_b1 0.00 0.9999847 FORMAT "%9.7"
 /begin AXIS_DESCR COM_AXIS nmot_w nmot_uw_q0p25 4 0.00 16383.75 AXIS_PTS_REF SNM04DMUW1 /end AXIS_DESCR
/end CHARACTERISTIC
/begin CHARACTERISTIC SLFOFU2N "untere Schwelle (Schwellwert-KL) f¸r Lernfilterwert bei fuel-off Adaption" CURVE 0x1C3F14 GklWU16 0.9999847 fak_uw_b1 0.00 0.9999847 FORMAT "%9.7"
 /begin AXIS_DESCR COM_AXIS nmot_w nmot_uw_q0p25 4 0.00 16383.75 AXIS_PTS_REF SNM04DMUW2 /end AXIS_DESCR
/end CHARACTERISTIC
/begin CHARACTERISTIC SMLDYN "Luftmassenschwelle f¸r Sondendynamik hinter KAT" VALUE 0x1CD15C KwUw 182.0417 m_q0p00277 0.00 182.0417 FORMAT "%8.4" /end CHARACTERISTIC
/begin AXIS_PTS SNM04DMUW1 "Drehzahlst¸tzstellen" 0x1C66BA nmot_w SstAU8SstU16 16383.75 nmot_uw_q0p25 4 0.00 16383.75 FORMAT "%8.2" DEPOSIT ABSOLUTE /end AXIS_PTS
/begin AXIS_PTS SNM04DMUW2 "Drehzahlst¸tzstellen" 0x1C66C4 nmot_w SstAU8SstU16 16383.75 nmot_uw_q0p25 4 0.00 16383.75 FORMAT "%8.2" DEPOSIT ABSOLUTE /end AXIS_PTS
/begin AXIS_PTS SNM06DMUW1 "Genzen der Drehzahlbereiche" 0x1C3F78 nmot_w SstAU8SstU16 16383.75 nmot_uw_q0p25 6 0.00 16383.75 FORMAT "%8.2" DEPOSIT ABSOLUTE /end AXIS_PTS
/begin AXIS_PTS SNM06DMUW2 "Genzen der Drehzahlbereiche" 0x1C3F86 nmot_w SstAU8SstU16 16383.75 nmot_uw_q0p25 6 0.00 16383.75 FORMAT "%8.2" DEPOSIT ABSOLUTE /end AXIS_PTS
/begin AXIS_PTS SNM08DMUB "SST-Verteilung in DMD, 8 Drehzahl-SST" 0x1C6764 nmot SstAUbSstUb 10200. nmot_ub_q40 8 0.00 10200. FORMAT "%5.0" DEPOSIT ABSOLUTE /end AXIS_PTS
/begin AXIS_PTS SNM16KRUB "St¸tzstellenverteilung Drehzahl, 16 Sst." 0x1CEE10 nmot SstAUbSstUb 10200. nmot_ub_q40 16 0.00 10200. FORMAT "%5.0" DEPOSIT ABSOLUTE /end AXIS_PTS
/begin AXIS_PTS SRL08DMUB "SST-Verteilung in DMD, 8 Last-SST" 0x1C6808 rl SstAUbSstUb 191.3 rel_ub_q0p75 8 0.00 191.3 FORMAT "%5.1" DEPOSIT ABSOLUTE /end AXIS_PTS
/begin CHARACTERISTIC SULSULUFT "Schwellwert f¸r Plausibilit‰tsfehler LSU an Luft" VALUE 0x1CCA3A KwUw 159.9951 spg_uw_q0p00488 0.00 159.9951 FORMAT "%8.4" /end CHARACTERISTIC
/begin CHARACTERISTIC SULSUMX "Schwellwert f¸r Plausibilit‰tsfehler CJ110" VALUE 0x1CCA3C KwUw 159.9951 spg_uw_b5 0.00 159.9951 FORMAT "%8.4" /end CHARACTERISTIC
/begin CHARACTERISTIC TABGMCSD "Abgastemperaturschwelle f¸r CSD-Messung" VALUE 0x1C4F20 KwUb 1275. temp_ub_q5_o50 -50.00 1225. FORMAT "%5.0" /end CHARACTERISTIC
/begin CHARACTERISTIC TABGSTG "Abgastemperaturschwelle f¸r Dynamik-Messung" VALUE 0x1CD130 KwUb 1275. temp_ub_q5_o50 -50.00 1225. FORMAT "%5.0" /end CHARACTERISTIC
/begin CHARACTERISTIC TADLLR "Ansauglufttemperaturschwelle f¸r Diagnose Leerlaufsteller" VALUE 0x1CF6D0 KwUb 191.3 temp_ub_q0p75_o48 -48.00 143.3 FORMAT "%5.1" /end CHARACTERISTIC
/begin CHARACTERISTIC TALASMX "Abgastemperatur-Schwellwert f¸r Pr¸fung Heizerkopplung" VALUE 0x1CCA3E KwUw 1535.977 temp_q0p0234_o273 -273.1500 1262.827 FORMAT "%8.3" /end CHARACTERISTIC
/begin CHARACTERISTIC TALSUSMX "Maximaler Abgastemperatur-Schwellwert f¸r die Plausibilit‰tsdiagnose" VALUE 0x1CCA40 KwUw 1535.977 temp_q0p0234_o273 -273.1500 1262.827 FORMAT "%8.3" /end CHARACTERISTIC
/begin CHARACTERISTIC TASIG "Zeit f¸r Ausblendung von Stˆrspitzen auﬂerhalb Band f¸r Erk. Signalunterbrechung" VALUE 0x1C4F21 KwUb 5.100 t20msxs_ub_b5p1 0.00 5.100 FORMAT "%5.3" /end CHARACTERISTIC
/begin CHARACTERISTIC TDLLR "Wartezeit bis setzen der Bedingung Diagnose Leerlaufsteller" VALUE 0x1CF6E0 KwUw 255.0000 t200msxs_ub_b51 0.00 255.0000 FORMAT "%8.4" /end CHARACTERISTIC
/begin CHARACTERISTIC TDLLRMN "Wartezeit bis Fehlereintrag Steller geschlossen" VALUE 0x1CF6E2 KwUw 255.0000 t200msxs_ub_b51 0.00 255.0000 FORMAT "%8.4" /end CHARACTERISTIC
/begin CHARACTERISTIC TDLLRMX "Wartezeit bis Fehlereintrag Steller offen" VALUE 0x1CF6E4 KwUw 255.0000 t200msxs_ub_b51 0.00 255.0000 FORMAT "%8.4" /end CHARACTERISTIC
/begin CHARACTERISTIC TDLLRNF "Wartezeit bis Meldung kein Fehler bei Leerlaufsteller" VALUE 0x1CF6E6 KwUw 255.0000 t200msxs_ub_b51 0.00 255.0000 FORMAT "%8.4" /end CHARACTERISTIC
/begin CHARACTERISTIC TFDLLRO "Obere Schwelle f¸r Zeitfenster f¸r DLLR" VALUE 0x1CF6E8 KwUw 6553.500 t100msxs_uw_b6553p5 0.00 6553.500 FORMAT "%8.3" /end CHARACTERISTIC
/begin CHARACTERISTIC TFDLLRU "Untere Schwelle f¸r Zeitfenster f¸r DLLR" VALUE 0x1CF6EA KwUw 6553.500 t100msxs_uw_b6553p5 0.00 6553.500 FORMAT "%8.3" /end CHARACTERISTIC
/begin CHARACTERISTIC TFRA "Erkennungszeit f¸r eingeschwungene Grundadaption von fra" VALUE 0x1CE1BD KwUb 51.00 t200msxs_ub_b51 0.00 51.00 FORMAT "%5.2" /end CHARACTERISTIC
/begin CHARACTERISTIC TFRAOZ "Verweilzeit in FRAO f¸r Zyklusflag bei nicht eingeschw. Adaption" VALUE 0x1CE1BE KwUb 51.00 t200msxs_ub_b51 0.00 51.00 FORMAT "%5.2" /end CHARACTERISTIC
/begin CHARACTERISTIC TFRAUZ "Verweilzeit in FRAU f¸r Zyklusflag bei nicht eingeschw. Adaption" VALUE 0x1CE1BF KwUb 51.00 t200msxs_ub_b51 0.00 51.00 FORMAT "%5.2" /end CHARACTERISTIC
/begin CHARACTERISTIC TFRMB "Verzˆg.zeit f¸r Erkennung Mittelwert des Lambdareglers innerhalb Schwellen" VALUE 0x1CD131 KwUb 25.50 t100msxs_ub_b25p5 0.00 25.50 FORMAT "%5.2" /end CHARACTERISTIC
/begin CHARACTERISTIC TFRMST "Erkennungszeit f¸r eingeschwungene Grundadaption von frm" VALUE 0x1CE1C0 KwUb 51.00 t200msxs_ub_b51 0.00 51.00 FORMAT "%5.2" /end CHARACTERISTIC
/begin CHARACTERISTIC TFRMZST "Verweilzeit f¸r unplausibles frm-Signal (Kurztest)" VALUE 0x1CE1C1 KwUb 51.00 t200msxs_ub_b51 0.00 51.00 FORMAT "%5.2" /end CHARACTERISTIC
/begin CHARACTERISTIC TKATMSHU "Kat-Temperatur f¸r ausreichende Sondenheizung" VALUE 0x1CCBD7 KwUb 1275. temp_ub_q5_o50 -50.00 1225. FORMAT "%5.0" /end CHARACTERISTIC
/begin CHARACTERISTIC TKTDGRA "Zeit f¸r Tempereraturgradientenmessung der Katdiagnose" VALUE 0x1CD255 KwWU8 51.00 t200msxs_ub_b51 0.00 51.00 FORMAT "%5.2" /end CHARACTERISTIC
/begin CHARACTERISTIC TKTDSP "Wartezeit in der Katdiagnose auf die Schubpr¸fung" VALUE 0x1CD240 KwWU16 13107.00 t200msxs_uw_q0p2 0.00 13107.00 FORMAT "%8.2" /end CHARACTERISTIC
/begin CHARACTERISTIC TLLASH "Verzˆg.zeit um lamlash_w zu sperren wenn lamsons_w ungleich lamlash_w ist" VALUE 0x1CD132 KwUb 25.50 t100msxs_ub_b25p5 0.00 25.50 FORMAT "%5.2" /end CHARACTERISTIC
/begin CHARACTERISTIC TMAXKATA "Maximale Kat.-Temperatur f¸r Ausr‰umpr¸fung bei Katdiagnose" VALUE 0x1CD256 KwWU8 1275. temp_ub_q5_o50 -50.00 1225. FORMAT "%5.0" /end CHARACTERISTIC
/begin CHARACTERISTIC TMAXKATS "maximale Kat-Temperatur f¸r Kat-diagnose" VALUE 0x1CD257 KwWU8 1275. temp_ub_q5_o50 -50.00 1225. FORMAT "%5.0" /end CHARACTERISTIC
/begin CHARACTERISTIC TMAXKATSO "maximale Kat-Temperatur f¸r Kat-diagnose, oberes Band" VALUE 0x1CD258 KwWU8 1275. temp_ub_q5_o50 -50.00 1225. FORMAT "%5.0" /end CHARACTERISTIC
/begin CHARACTERISTIC TMDLLR "Motortemperaturschwelle f¸r Diagnose Leerlaufsteller" VALUE 0x1CF6D1 KwUb 191.3 temp_ub_q0p75_o48 -48.00 143.3 FORMAT "%5.1" /end CHARACTERISTIC
/begin CHARACTERISTIC TMFRST "Einschalttemperatur LR- Kurztest" VALUE 0x1CE1C2 KwUb 191.3 temp_ub_q0p75_o48 -48.00 143.3 FORMAT "%5.1" /end CHARACTERISTIC
/begin CHARACTERISTIC TMINKATS "Minimale Kat-Temperatur f¸r ‹berwachung" VALUE 0x1CD259 KwWU8 1275. temp_ub_q5_o50 -50.00 1225. FORMAT "%5.0" /end CHARACTERISTIC
/begin CHARACTERISTIC TMINKATSO "Minimale Kat-Temperatur f¸r ‹berwachung, oberes Band" VALUE 0x1CD25A KwWU8 1275. temp_ub_q5_o50 -50.00 1225. FORMAT "%5.0" /end CHARACTERISTIC
/begin CHARACTERISTIC TMNKATST "Minimale Kat-Temperatur f¸r ‹berwachung bei Testerbetrieb" VALUE 0x1CD25B KwWU8 1275. temp_ub_q5_o50 -50.00 1225. FORMAT "%5.0" /end CHARACTERISTIC
/begin CHARACTERISTIC TMSH "Motortemperaturschwelle f¸r Erkennung Kaltstart f¸r Messung Sonde hinter KAT" VALUE 0x1CCBD8 KwUb 191.3 temp_ub_q0p75_o48 -48.00 143.3 FORMAT "%5.1" /end CHARACTERISTIC
/begin CHARACTERISTIC TMSHA "Motorabstelltemperaturschwelle f¸r Messung Abk¸hlung Sonde hinter KAT" VALUE 0x1CCBD9 KwUb 191.3 temp_ub_q0p75_o48 -48.00 143.3 FORMAT "%5.1" /end CHARACTERISTIC
/begin CHARACTERISTIC TMSUKTDS "Minimale tmot-Start-Temperatur f¸r Katdiagnose" VALUE 0x1CD25C KwWU8 191.3 temp_ub_q0p75_o48 -48.00 143.3 FORMAT "%5.1" /end CHARACTERISTIC
/begin CHARACTERISTIC TMXKATST "Maximale Kat-Temperatur f¸r ‹berwachung bei Testerbetrieb" VALUE 0x1CD25D KwWU8 1275. temp_ub_q5_o50 -50.00 1225. FORMAT "%5.0" /end CHARACTERISTIC
/begin CHARACTERISTIC TNSTDNH "Zeit nach Start f¸r Diagnose Adernschluﬂ (Monoflop)" VALUE 0x1C4F22 KwUb 5.100 t20msxs_ub_b5p1 0.00 5.100 FORMAT "%5.3" /end CHARACTERISTIC
/begin CHARACTERISTIC TRIPFASH "Mindest Zeitdauer f¸r aktive Lamda Regelung vor KAT" VALUE 0x1CD15E KwUw 6553.500 t100msxs_uw_b6553p5 0.00 6553.500 FORMAT "%8.3" /end CHARACTERISTIC
/begin CHARACTERISTIC TRKA "Erkennungszeit f¸r eingeschwungene Grundadaption von rkat bzw. rkaz" VALUE 0x1CE1C3 KwUb 51.00 t200msxs_ub_b51 0.00 51.00 FORMAT "%5.2" /end CHARACTERISTIC
/begin CHARACTERISTIC TRKATZ "Aktivierungszeit von rkat bis Setzen Zyklusflag, wenn B_gae = FALSE" VALUE 0x1CE1C4 KwUb 51.00 t200msxs_ub_b51 0.00 51.00 FORMAT "%5.2" /end CHARACTERISTIC
/begin CHARACTERISTIC TRKAZZ "Aktivierungszeit von rkaz bis Setzen Zyklusflag, wenn B_gae = FALSE" VALUE 0x1CE1C5 KwUb 51.00 t200msxs_ub_b51 0.00 51.00 FORMAT "%5.2" /end CHARACTERISTIC
/begin CHARACTERISTIC TRSAFA "‹berwachungszeit Kabelbruch hinter KAT: Funktions Anforderung f¸r Kurz-Trip-Test" VALUE 0x1CCBE6 KwUw 6553.500 t100msxs_uw_q100 0.00 6553.500 FORMAT "%8.3" /end CHARACTERISTIC
/begin CHARACTERISTIC TRSAH "‹berwachungszeit f¸r Kabelbruch (Spg. im Band) f¸r Sonde hinter KAT" VALUE 0x1CCBE8 KwUw 6553.500 t100msxs_uw_q100 0.00 6553.500 FORMAT "%8.3" /end CHARACTERISTIC
/begin CHARACTERISTIC TRSE "‹berwachungszeit -> Regelung ein" VALUE 0x1CCBDA KwUb 25.50 t100msxs_ub_b25p5 0.00 25.50 FORMAT "%5.2" /end CHARACTERISTIC
/begin CHARACTERISTIC TSALASH "Zeit nach Schub f¸r ‹berpr¸fung Sonde hinter KAT" VALUE 0x1CD133 KwUb 25.50 t100msxs_ub_b25p5 0.00 25.50 FORMAT "%5.2" /end CHARACTERISTIC
/begin CHARACTERISTIC TSKTDTK "Temperaturabh‰ngige Verzˆgerungszeit f¸r Katdiagnose" CURVE 0x1CD20E KlAxU8SstxU16WU16 13107.00 t200msxs_uw_q0p2 0.00 13107.00 FORMAT "%8.2"
 /begin AXIS_DESCR STD_AXIS tkdkthps temp_ub_q5 4 0.00 1275.000 FORMAT "%8.3" DEPOSIT ABSOLUTE /end AXIS_DESCR
/end CHARACTERISTIC
/begin CHARACTERISTIC TTBMH "Zeit f¸r theoretische Sondenbetriebsbereitschaft mit Heizung" VALUE 0x1CCBEA KwUw 6553.500 t100msxs_uw_q100 0.00 6553.500 FORMAT "%8.3" /end CHARACTERISTIC
/begin CHARACTERISTIC TTLASH "Zeit f¸r Verweildauer der Sonde hinter KAT unter/oberhalb des Sollwertes" VALUE 0x1CD160 KwUw 6553.500 t100msxs_uw_b6553p5 0.00 6553.500 FORMAT "%8.3" /end CHARACTERISTIC
/begin CHARACTERISTIC TUSCHUB "Verzˆgerungszeit f¸r Stˆrspitzen bei Schubpr¸fung der Sonde hinter KAT" VALUE 0x1CD134 KwUb 25.50 t100msxs_ub_b25p5 0.00 25.50 FORMAT "%5.2" /end CHARACTERISTIC
/begin CHARACTERISTIC TUSENLASH "Zeitdauer bis Sonden Mager/Fett Erkennung erlaubt hinter Kat" VALUE 0x1CD162 KwUw 6553.500 t100msxs_uw_b6553p5 0.00 6553.500 FORMAT "%8.3" /end CHARACTERISTIC
/begin CHARACTERISTIC TUSHKRFM "Zeitdauer bis zur Freig. Wiederholungsmess. Schwingungspr. (Reset F/M-Flip-Flop)" VALUE 0x1CD164 KwUw 6553.500 t100msxs_uw_b6553p5 0.00 6553.500 FORMAT "%8.3" /end CHARACTERISTIC
/begin CHARACTERISTIC TUSHKVL "Verzˆgerungszeit f¸r Stˆrspitzen bei Vollastpr¸fung der Sonde hinter KAT" VALUE 0x1CD135 KwUb 25.50 t100msxs_ub_b25p5 0.00 25.50 FORMAT "%5.2" /end CHARACTERISTIC
/begin CHARACTERISTIC TUSHSMIN "Mindestdauer f¸r Steigungsmessung f¸r enable Filter hinter Kat" VALUE 0x1CD136 KwUb 25.50 t100msxs_ub_b25p5 0.00 25.50 FORMAT "%5.2" /end CHARACTERISTIC
/begin CHARACTERISTIC TUSKS "Entstˆrzeit f¸r Abschalten einzelner Funktionen Sonde hinter KAT" VALUE 0x1C4F23 KwUb 5.100 t20msxs_ub_b5p1 0.00 5.100 FORMAT "%5.3" /end CHARACTERISTIC
/begin CHARACTERISTIC TUSLASH "Testzeit f¸t Dauer Anfettung/Abmagerung hinter KAT" VALUE 0x1CD166 KwUw 6553.500 t100msxs_uw_b6553p5 0.00 6553.500 FORMAT "%8.3" /end CHARACTERISTIC
/begin CHARACTERISTIC TUSMAX "‹berwachungszeit f¸r Usmax" VALUE 0x1CCBDB KwUb 25.50 t100msxs_ub_b25p5 0.00 25.50 FORMAT "%5.2" /end CHARACTERISTIC
/begin CHARACTERISTIC TUSMSVL "Zeit nach Vollast f¸r ‹berpr¸fung Sonde hinter KAT" VALUE 0x1CD137 KwUb 25.50 t100msxs_ub_b25p5 0.00 25.50 FORMAT "%5.2" /end CHARACTERISTIC
/begin CHARACTERISTIC TUSSA "Verzˆgerungszeit nach ‹ber/Unterschreiten der Regelschwelle hinter KAT" VALUE 0x1CD138 KwUb 25.50 t100msxs_ub_b25p5 0.00 25.50 FORMAT "%5.2" /end CHARACTERISTIC
/begin CHARACTERISTIC TUSTAL "Verzˆg.zeit f¸r Erkennung Adernschluﬂ nach ""Tank leer"" fahren f¸r Sonde h. KAT" VALUE 0x1CCBEC KwUw 6553.500 t100msxs_uw_q100 0.00 6553.500 FORMAT "%8.3" /end CHARACTERISTIC
/begin CHARACTERISTIC TUSTALLASH "Verzˆg.zeit f¸r Erkennung B_maxlash nach ""Tank leer"" fahren f¸r Sonde h. KAT" VALUE 0x1CD168 KwUw 6553.500 t100msxs_uw_b6553p5 0.00 6553.500 FORMAT "%8.3" /end CHARACTERISTIC
/begin CHARACTERISTIC TVDRL "Verzˆgerungszeit f¸r Dynamikmessung LSU" VALUE 0x1CCA06 KwUb 25.50 t100msxs_ub_b25p5 0.00 25.50 FORMAT "%5.2" /end CHARACTERISTIC
/begin CHARACTERISTIC TVHKLSU "Verzˆgerungszeit f¸r Diagnose Heizerkopplung" VALUE 0x1CCA42 KwUw 30.00000 t100msxs_uw_b6553p5 0.00 30.00000 FORMAT "%8.5" /end CHARACTERISTIC
/begin CHARACTERISTIC TVHKLSUV "Zeit f¸r Diagnose Heizerkopplung" VALUE 0x1C4D34 KwUb 2.550 t10msxs_ub_b2p55 0.00 2.550 FORMAT "%5.3" /end CHARACTERISTIC
/begin CHARACTERISTIC TVKTDLE "Verzˆgerungszeit bis Lambda eingeschwungen bei Katdiagnose" VALUE 0x1CD25E KwWU8 12.75 t50msxs_q0p05 0.00 12.75 FORMAT "%5.2" /end CHARACTERISTIC
/begin CHARACTERISTIC TVKTDRX "Maximale Fettzeit f¸r hintere Sondenspannung bei Katdiagnose" VALUE 0x1CD25F KwWU8 5.100 t20msxs_ub_b5p1 0.00 5.100 FORMAT "%5.3" /end CHARACTERISTIC
/begin CHARACTERISTIC TVLSUEK "Verzˆgerungszeit f¸r Fehlerkorrektur stetige Lambdasonde LSU" VALUE 0x1CCA44 KwUw 6553.500 t100msxs_uw_b6553p6 0.00 6553.500 FORMAT "%8.3" /end CHARACTERISTIC
/begin CHARACTERISTIC TVLSULUFT "Verzˆgerungszeit f¸r Fehler LSU in Luft" VALUE 0x1CCA07 KwUb 25.50 t100msxs_ub_b25p5 0.00 25.50 FORMAT "%5.2" /end CHARACTERISTIC
/begin CHARACTERISTIC TVLSUOF "Verzˆgerungszeit f¸r Fehler stetige Lambdasonde LSU ""Offset""" VALUE 0x1CCA46 KwUw 6553.500 t100msxs_uw_b6553p6 0.00 6553.500 FORMAT "%8.3" /end CHARACTERISTIC
/begin CHARACTERISTIC TVLSUTRIM "Verzˆgerungszeit f¸r Fehler LSU Abgleichleitung unterbrochen" VALUE 0x1CCA08 KwUb 25.50 t100msxs_ub_b25p5 0.00 25.50 FORMAT "%5.2" /end CHARACTERISTIC
/begin CHARACTERISTIC TVMRFT "Verzˆgerungszeit f¸r Lambdasonde hinter Kat mager oder fett" VALUE 0x1CCA09 KwUb 25.50 t100msxs_ub_b25p5 0.00 25.50 FORMAT "%5.2" /end CHARACTERISTIC
/begin CHARACTERISTIC TVSERSL "Verzˆgerungszeit zum setzten eines Fehlers f¸r die Sondenleitungsdiangose" VALUE 0x1CCA0A KwUb 25.50 t100msxs_ub_b25p5 0.00 25.50 FORMAT "%5.2" /end CHARACTERISTIC
/begin CHARACTERISTIC TVSHESL "Verzˆgerungszeit zum Heilen von Sondenleitungsfehlern" VALUE 0x1CCA0B KwUb 25.50 t100msxs_ub_b25p5 0.00 25.50 FORMAT "%5.2" /end CHARACTERISTIC
/begin CHARACTERISTIC TVSNPF "Verzˆgerungszeit in der Stˆrungen bei der Entprellung unterdr¸ckt werden" VALUE 0x1CCA0C KwUb 25.50 t100msxs_ub_b25p5 0.00 25.50 FORMAT "%5.2" /end CHARACTERISTIC
/begin CHARACTERISTIC TVTKLSU "Verzˆgerungszeit beim Eintragen eines Fehlers aufgrund eines leeren Tanks" VALUE 0x1CCA48 KwUw 6553.500 t100msxs_uw_b6553p5 0.00 6553.500 FORMAT "%8.3" /end CHARACTERISTIC
/begin CHARACTERISTIC TWDKATS "Wartezeit nach Stoppbedingung f¸r Filter und Integrator" VALUE 0x1CD260 KwWU8 12.75 t50msxs_q0p05 0.00 12.75 FORMAT "%5.2" /end CHARACTERISTIC
/begin CHARACTERISTIC TWDLSSA "Mindestpr¸fzeit f¸r DLSSA-Extremwertbestimmung" VALUE 0x1CC9FC KwUw 3276.750 t50msxs_uw_b3276p75 0.00 3276.750 FORMAT "%8.3" /end CHARACTERISTIC
/begin CHARACTERISTIC UBDLS "Batteriespannungsschwelle zur Freigabe der Sonden-Diagnose" VALUE 0x1CCBDC KwUb 24.02 spg_ubatt 0.00 24.02 FORMAT "%5.2" /end CHARACTERISTIC
/begin CHARACTERISTIC UDKRGOFS "Spannungsschwelle f¸r DIA/KR Grundoffset Verst‰rker" VALUE 0x1CE8AA KwWU16 4.999924 spg_uw_q0p000076 0.00 4.999924 FORMAT "%8.6" /end CHARACTERISTIC
/begin CHARACTERISTIC UDKSNO "Obere Referenzspannungsschwelle DIA KS" CURVE 0x1CE850 GklWUw 319.981 spg_uw_b1280 0.00 319.981 FORMAT "%7.3"
 /begin AXIS_DESCR COM_AXIS nmot nmot_ub_q40 16 0.00 10200. AXIS_PTS_REF SNM16KRUB /end AXIS_DESCR
/end CHARACTERISTIC
/begin CHARACTERISTIC UDKSNU "untere Referenzspannungsschwelle DIA KS" CURVE 0x1CE870 GklWUw 319.981 spg_uw_b1280 0.00 319.981 FORMAT "%7.3"
 /begin AXIS_DESCR COM_AXIS nmot nmot_ub_q40 16 0.00 10200. AXIS_PTS_REF SNM16KRUB /end AXIS_DESCR
/end CHARACTERISTIC
/begin CHARACTERISTIC USHKFT "Sondenspannungs-Schwelle f¸r Erkennung ""Abgas fett"" hinter Kat" VALUE 0x1CCA4A KwUw 319.9951 spg_uw_q0p00488_o1 -1.000000 318.9951 FORMAT "%8.4" /end CHARACTERISTIC
/begin CHARACTERISTIC USHKMR "Sondenspannungs-Schwelle f¸r Erkennung ""Abgas mager"" hinter Kat" VALUE 0x1CCA4C KwUw 319.9951 spg_uw_q0p00488_o1 -1.000000 318.9951 FORMAT "%8.4" /end CHARACTERISTIC
/begin CHARACTERISTIC USHKTDM "Magerschwelle der hinteren Sonde bei Katdiagnose" VALUE 0x1CD261 KwWU8 1.330 spg_ub_q0p0052_o0p2 -0.2000 1.130 FORMAT "%5.3" /end CHARACTERISTIC
/begin CHARACTERISTIC USHKTDR "Schwelle hintere Sondenspannung f¸r Referenzmessung" VALUE 0x1CD262 KwWU8 1.330 spg_ub_q0p0052_o0p2 -0.2000 1.130 FORMAT "%5.3" /end CHARACTERISTIC
/begin CHARACTERISTIC USHKTDRX "Maximalwert der hinteren Sondenspannung f¸r Referenzmessung" VALUE 0x1CD263 KwWU8 1.330 spg_ub_q0p0052_o0p2 -0.2000 1.130 FORMAT "%5.3" /end CHARACTERISTIC
/begin CHARACTERISTIC USHKVL "Schwellwert f¸r Sondenspannung hinter KAT im Vollast-Betrieb" VALUE 0x1CD139 KwUb 1.330 spg_ub_q0p0052_o0p2 -0.2000 1.130 FORMAT "%5.3" /end CHARACTERISTIC
/begin CHARACTERISTIC USHLEAN "Schwelle f¸r Magerspannung f¸r Reset Dynamikmessung der Sonde hinter KAT" VALUE 0x1CD13A KwUb 1.330 spg_ub_q0p0052_o0p2 -0.2000 1.130 FORMAT "%5.3" /end CHARACTERISTIC
/begin CHARACTERISTIC USHRICH "Schwelle f¸r Fettspannung f¸r g¸ltige Dynamikmessung der Sonde hinter KAT" VALUE 0x1CD13B KwUb 1.330 spg_ub_q0p0052_o0p2 -0.2000 1.130 FORMAT "%5.3" /end CHARACTERISTIC
/begin CHARACTERISTIC USHSTGMX "Wert f¸r maximale Steigung f¸r Startwert Filter" VALUE 0x1CD13C KwUb 132.6 spgg_q0p52 0.00 132.6 FORMAT "%5.1" /end CHARACTERISTIC
/begin CHARACTERISTIC USHSTSOLL "Schwelle f¸r zul‰ssige Steigung der Sondenspannung hinter KAT" VALUE 0x1CD13D KwUb 132.6 spgg_q0p52 0.00 132.6 FORMAT "%5.1" /end CHARACTERISTIC
/begin CHARACTERISTIC USIVMAXH "Init value f¸r max.Sondenspg. hinter Kat nach Powerfail u. Fehlersp. lˆschen" VALUE 0x1CC9F2 KwUb 1.330 spg_ub_b1p33 0.00 1.330 FORMAT "%5.3" /end CHARACTERISTIC
/begin CHARACTERISTIC USIVMINH "Init value f¸r min.Sondenspg. hinter Kat nach Powerfail u. Fehlersp. lˆschen" VALUE 0x1CC9F3 KwUb 1.330 spg_ub_b1p33 0.00 1.330 FORMAT "%5.3" /end CHARACTERISTIC
/begin CHARACTERISTIC USMAX "Schwelle f¸r Sondenkurzschluﬂ nach Ubat" VALUE 0x1C4F24 KwUw 319.9951 spg_uw_q0p00488_o1 -1.000000 318.9951 FORMAT "%8.4" /end CHARACTERISTIC
/begin CHARACTERISTIC USMIN "Schwelle f¸r Sondenkurzschluﬂ nach Masse" VALUE 0x1C4F26 KwUw 319.9951 spg_uw_q0p00488_o1 -1.000000 318.9951 FORMAT "%8.4" /end CHARACTERISTIC
/begin CHARACTERISTIC USMNSHMN "min. erkannte Sondenspannung hinter Kat f¸r Signalausgabe (min. plaus. Wert)" VALUE 0x1CC9F4 KwUb 1.330 spg_ub_b1p33 0.00 1.330 FORMAT "%5.3" /end CHARACTERISTIC
/begin CHARACTERISTIC USMNSHMX "min. erkannte Sondenspannung hinter Kat f¸r Signalausgabe (max. plaus. Wert)" VALUE 0x1CC9F5 KwUb 1.330 spg_ub_b1p33 0.00 1.330 FORMAT "%5.3" /end CHARACTERISTIC
/begin CHARACTERISTIC USMXSHMN "max. erkannte Sondenspannung hinter Kat f¸r Signalausgabe (min. plaus. Wert)" VALUE 0x1CC9F6 KwUb 1.330 spg_ub_b1p33 0.00 1.330 FORMAT "%5.3" /end CHARACTERISTIC
/begin CHARACTERISTIC USMXSHMX "max. erkannte Sondenspannung hinter Kat f¸r Signalausgabe (max. plaus. Wert)" VALUE 0x1CC9F7 KwUb 1.330 spg_ub_b1p33 0.00 1.330 FORMAT "%5.3" /end CHARACTERISTIC
/begin CHARACTERISTIC USREFH "Schwelle f¸r Sondenbetriebsbereitschaft hinter KAT bei fettem Gemisch" VALUE 0x1C4F28 KwUw 319.9951 spg_uw_q0p00488_o1 -1.000000 318.9951 FORMAT "%8.4" /end CHARACTERISTIC
/begin CHARACTERISTIC USREMH "Schwelle f¸r Sondenbetriebsbereitschaft hinter KAT bei magerem Gemisch" VALUE 0x1C4F2A KwUw 319.9951 spg_uw_q0p00488_o1 -1.000000 318.9951 FORMAT "%8.4" /end CHARACTERISTIC
/begin CHARACTERISTIC USRHKSHJ "Regelschwelle f¸r Regelung hinter Kat, DLSSA-Ausgabe umgerechn. Wert" VALUE 0x1CC9F8 KwUb 1.330 spg_ub_b1p33 0.00 1.330 FORMAT "%5.3" /end CHARACTERISTIC
/begin CHARACTERISTIC USRJ "" VALUE 0x1CC9F9 KwUb 1.330 spg_ub_b1p33 0.00 1.330 FORMAT "%5.3" /end CHARACTERISTIC
/begin CHARACTERISTIC USSCHUB "Schwelle f¸r Sondenspannung hinter KAT nach Schub" VALUE 0x1CD13E KwUb 1.330 spg_ub_q0p0052_o0p2 -0.2000 1.130 FORMAT "%5.3" /end CHARACTERISTIC
/begin CHARACTERISTIC ZDYNFA "Z‰hlerwert f¸r Dynamikmessung LSU bei Kurztest" VALUE 0x1CCA0D KwUb 255.0 dez 0.00 255.0 FORMAT "%5.1" /end CHARACTERISTIC
/begin CHARACTERISTIC ZDYNLSU "Z‰hlerwert f¸r Dynamikmessung LSU" VALUE 0x1C4D35 KwUb 255.0 dez 0.00 255.0 FORMAT "%5.1" /end CHARACTERISTIC
/begin CHARACTERISTIC ZEHK "Fehlerz‰hler f¸r Heizerkopplung auf das Lambdasignal" VALUE 0x1C4D36 KwUb 255.0 dez 0.00 255.0 FORMAT "%5.1" /end CHARACTERISTIC
/begin CHARACTERISTIC ZFRMST "Zeitkonstante f¸r frm-Filter (short test)" VALUE 0x1CE1C6 KwUb 50.9992 zk200msxs_ub_b51p2 0.200784 51.2000 FORMAT "%7.4" /end CHARACTERISTIC
/begin CHARACTERISTIC ZKTDML "Tiefpaﬂ-Filterzeitkonstante f¸r Luftmasse" VALUE 0x1CD264 KwWU8 12.7498039 zk50msxs_ub_b12p8 0.0501960784 12.8000000 FORMAT "%10.7" /end CHARACTERISTIC
/begin CHARACTERISTIC ZKTDTK "Tiefpaﬂ-Filterzeitkonstante f¸r Temperatur-Filterung" VALUE 0x1CD265 KwWU8 50.9992 zk200msxs_ub_b51p2 0.200784 51.2000 FORMAT "%7.4" /end CHARACTERISTIC
/begin CHARACTERISTIC ZLAMFT "Zeitkonstante f¸r Filterung von lamsoni" VALUE 0x1C4D3E KwUw 6553.50000 zk100msxs_uw_b6553 0.100001526 6553.60000 FORMAT "%10.5" /end CHARACTERISTIC
/begin CHARACTERISTIC ZLAMHP "Filterzeitkonstante f¸r lamsoni_w Hochpass" VALUE 0x1C4D40 KwUw 655.350000 zk10msxs_uw_b655 0.0100001526 655.360000 FORMAT "%10.6" /end CHARACTERISTIC
/begin CHARACTERISTIC ZLAMLP "Filterzeitkonstante f¸r lamsoni_w Tiefpass" VALUE 0x1C4D42 KwUw 655.350000 zk10msxs_uw_b655 0.0100001526 655.360000 FORMAT "%10.6" /end CHARACTERISTIC
/begin CHARACTERISTIC ZLUTSFI "Zeitkonstante f¸r Filterung Laufunruhe-Testgrˆﬂe" VALUE 0x1C4150 KwWR32 2.000000000000E+037 fak_r32_1 -1.000000000000E+037 1.000000000000E+037 FORMAT "%43.4" /end CHARACTERISTIC
/begin MEASUREMENT ACComprDsabl_ECU_Req "" UBYTE DC_FLAG_U8 1 100 0 1 BIT_MASK 0x1 FORMAT "%5.3" ECU_ADDRESS 0x803881 /end MEASUREMENT
/begin MEASUREMENT ACCompr_MaxTrq_Req "" UBYTE DC_TRQ_U8 1 100 0 63.75 FORMAT "%8.5" ECU_ADDRESS 0x80386A /end MEASUREMENT
/begin MEASUREMENT AirFilterFouledWal "" UBYTE DC_FLAG_U8 1 100 0 1 BIT_MASK 0x1 FORMAT "%5.3" ECU_ADDRESS 0x803878 /end MEASUREMENT
/begin MEASUREMENT anwfofs "z‰hlt Anzahl der NW-Umdr. von Bedingungen f¸r Adaption erf¸llt bis Lernbeginn" UWORD dez 1 100 0 65535 FORMAT "%8.2" ECU_ADDRESS 0x800676 /end MEASUREMENT
/begin MEASUREMENT anwst "z‰hlt Anzahl der NW-Umdr. bei denen fuel-off Adaption nach Fertiglernen aktiv" UWORD dez 1 100 0 65535 FORMAT "%8.2" ECU_ADDRESS 0x800678 /end MEASUREMENT
/begin MEASUREMENT anzdyn "Anzahl der Dynamikmessungen LSU" UBYTE dez 1 100 0 255 FORMAT "%5.1" ECU_ADDRESS 0x801171 /end MEASUREMENT
/begin MEASUREMENT anzdyn2 "Anzahl der Dynamikmessungen LSU2" UBYTE dez 1 100 0 255 FORMAT "%5.1" ECU_ADDRESS 0x801172 /end MEASUREMENT
/begin MEASUREMENT apdkt "Anzahl der Pr¸fungen, Katdiagnose" UBYTE dez 1 100 0 255 FORMAT "%5.1" ECU_ADDRESS 0x800ADA /end MEASUREMENT
/begin MEASUREMENT apdkt2 "Anzahl der Pr¸fungen, Katdiagnose" UBYTE dez 1 100 0 255 FORMAT "%5.1" ECU_ADDRESS 0x800ADB /end MEASUREMENT
/begin MEASUREMENT apdkti "Interner Pr¸fungsanzahlz‰hler, Katdiagnose" UBYTE dez 1 100 0 255 FORMAT "%5.1" ECU_ADDRESS 0x800ADC /end MEASUREMENT
/begin MEASUREMENT apdkti2 "Interner Pr¸fungsanzahlz‰hler, Katdiagnose" UBYTE dez 1 100 0 255 FORMAT "%5.1" ECU_ADDRESS 0x800ADD /end MEASUREMENT
/begin MEASUREMENT apedkts "Anzahl der Pr¸fungen mit Fehlerergebnis bei Katdiagnose" UBYTE dez 1 100 0 255 FORMAT "%5.1" ECU_ADDRESS 0x800ADE /end MEASUREMENT
/begin MEASUREMENT apedkts2 "Anzahl der Pr¸fungen mit Fehlerergebnis bei Katdiagnose (Bank2)" UBYTE dez 1 100 0 255 FORMAT "%5.1" ECU_ADDRESS 0x800ADF /end MEASUREMENT
/begin MEASUREMENT apzdkt "Anzahl der i.O.-Pr¸fungen, Katdiagnose" UBYTE dez 1 100 0 255 FORMAT "%5.1" ECU_ADDRESS 0x800AE0 /end MEASUREMENT
/begin MEASUREMENT apzdkt2 "Anzahl der i.O.-Pr¸fungen, Katdiagnose" UBYTE dez 1 100 0 255 FORMAT "%5.1" ECU_ADDRESS 0x800AE1 /end MEASUREMENT
/begin MEASUREMENT avkatf "AmplitudenVerh‰ltnis laafh/laafv gefiltert" UBYTE fak_ub_b1 1 100 0 0.996094 ECU_ADDRESS 0x7FC764 /end MEASUREMENT
/begin MEASUREMENT avkatf2 "Amplitudenverh‰ltnis laafh/laafv gefiltert Bank2" UBYTE fak_ub_b1 1 100 0 0.996094 ECU_ADDRESS 0x7FC765 /end MEASUREMENT
/begin MEASUREMENT B_abgstg "Bedingung Modelltemperatur (tkatm od. tanhkm_w) hinter KAT ist oberhalb Schwelle" UBYTE B_TRUE 1 100 0 1 BIT_MASK 0x1 FORMAT "%13.11" ECU_ADDRESS 0x801192 /end MEASUREMENT
/begin MEASUREMENT B_abgstg2 "Bedingung Modelltemp. (tkatm od. tanhkm_w) liegt oberhalb Schwelle Bank2" UBYTE B_TRUE 1 100 0 1 BIT_MASK 0x10 FORMAT "%13.11" ECU_ADDRESS 0x801192 /end MEASUREMENT
/begin MEASUREMENT B_adsh "Bedingung Adernschluﬂ bei Lambdasonden hinter Kat" UBYTE B_TRUE 1 100 0 1 BIT_MASK 0x1 FORMAT "%13.11" ECU_ADDRESS 0x801191 /end MEASUREMENT
/begin MEASUREMENT B_adsh2 "Bedingung Adernschluﬂ bei Lambdasonden hinter Kat Bank2" UBYTE B_TRUE 1 100 0 1 BIT_MASK 0x2 FORMAT "%13.11" ECU_ADDRESS 0x801191 /end MEASUREMENT
/begin MEASUREMENT B_adshs "Bedingung Adernschluﬂ ""setzen"" bei Lambdasonden hinter Kat" UBYTE B_TRUE 1 100 0 1 BIT_MASK 0x10 FORMAT "%13.11" ECU_ADDRESS 0x801190 /end MEASUREMENT
/begin MEASUREMENT B_adshs2 "Bedingung Adernschluﬂ ""setzen"" bei Lambdasonden hinter Kat Bank2" UBYTE B_TRUE 1 100 0 1 BIT_MASK 0x20 FORMAT "%13.11" ECU_ADDRESS 0x801190 /end MEASUREMENT
/begin MEASUREMENT B_binsti "Bedingung bin‰re Stoppbedingung intern, bank¸bergreifend" UBYTE B_TRUE 1 100 0 1 BIT_MASK 0x2 FORMAT "%13.11" ECU_ADDRESS 0x800AE2 /end MEASUREMENT
/begin MEASUREMENT B_binstop "Bedingung bin‰re Stoppbedingung, bank¸bergreifend" UBYTE B_TRUE 1 100 0 1 BIT_MASK 0x1 FORMAT "%13.11" ECU_ADDRESS 0x800AE7 /end MEASUREMENT
/begin MEASUREMENT B_bkkspi "" UBYTE B_TRUE 1 100 0 1 BIT_MASK 0x1 FORMAT "%13.11" ECU_ADDRESS 0x7FA847 /end MEASUREMENT
/begin MEASUREMENT B_ddylash "Bedingung Sonde hinter KAT dynamisch langsam" UBYTE B_TRUE 1 100 0 1 BIT_MASK 0x1 FORMAT "%13.11" ECU_ADDRESS 0x7FA739 /end MEASUREMENT
/begin MEASUREMENT B_ddylash2 "Bedingung Sonde hinter KAT dynamisch langsam `dynamisch` Bank2" UBYTE B_TRUE 1 100 0 1 BIT_MASK 0x1 FORMAT "%13.11" ECU_ADDRESS 0x7FA73A /end MEASUREMENT
/begin MEASUREMENT B_dkemp "Bedingung (lambda-1) ist positiv" UBYTE B_TRUE 1 100 0 1 BIT_MASK 0x8 FORMAT "%13.11" ECU_ADDRESS 0x800AE8 /end MEASUREMENT
/begin MEASUREMENT B_dkemp2 "Bedingung (lambda-1) ist positiv" UBYTE B_TRUE 1 100 0 1 BIT_MASK 0x8 FORMAT "%13.11" ECU_ADDRESS 0x800AE3 /end MEASUREMENT
/begin MEASUREMENT B_dkifm "Integratorfreigabe f¸r Fett-Mager-Auswertung" UBYTE B_TRUE 1 100 0 1 BIT_MASK 0x20 FORMAT "%13.11" ECU_ADDRESS 0x800AE8 /end MEASUREMENT
/begin MEASUREMENT B_dkifm2 "Integratorfreigabe f¸r Fett-Mager-Auswertung, Bank2" UBYTE B_TRUE 1 100 0 1 BIT_MASK 0x20 FORMAT "%13.11" ECU_ADDRESS 0x800AE3 /end MEASUREMENT
/begin MEASUREMENT B_dkifma "Abbruch Integratorfreigabe f¸r Fett-Mager-Auswertung" UBYTE B_TRUE 1 100 0 1 BIT_MASK 0x40 FORMAT "%13.11" ECU_ADDRESS 0x800AE8 /end MEASUREMENT
/begin MEASUREMENT B_dkifma2 "Abbruch Integratorfreigabe f¸r Fett-Mager-Auswertung, Bank2" UBYTE B_TRUE 1 100 0 1 BIT_MASK 0x40 FORMAT "%13.11" ECU_ADDRESS 0x800AE3 /end MEASUREMENT
/begin MEASUREMENT B_dkmen "Bedingung (lambda-1) ist negativ, Katdiagnose" UBYTE B_TRUE 1 100 0 1 BIT_MASK 0x10 FORMAT "%13.11" ECU_ADDRESS 0x800AE8 /end MEASUREMENT
/begin MEASUREMENT B_dkmen2 "Bedingung (lambda-1) ist negativ, Katdiagnose" UBYTE B_TRUE 1 100 0 1 BIT_MASK 0x10 FORMAT "%13.11" ECU_ADDRESS 0x800AE3 /end MEASUREMENT
/begin MEASUREMENT B_dktb "Bedingung: Beginn der Katdiagnose" UBYTE B_TRUE 1 100 0 1 BIT_MASK 0x1 FORMAT "%13.11" ECU_ADDRESS 0x800AE6 /end MEASUREMENT
/begin MEASUREMENT B_dktb2 "Bedingung: Beginn der Katdiagnose" UBYTE B_TRUE 1 100 0 1 BIT_MASK 0x4 FORMAT "%13.11" ECU_ADDRESS 0x800AE6 /end MEASUREMENT
/begin MEASUREMENT B_dktens "DKAT f¸r diesen Trip nicht mehr aktiv" UBYTE B_TRUE 1 100 0 1 BIT_MASK 0x80 FORMAT "%13.11" ECU_ADDRESS 0x800AE9 /end MEASUREMENT
/begin MEASUREMENT B_dktens2 "DKAT f¸r diesen Trip nicht mehr aktiv (Bank2)" UBYTE B_TRUE 1 100 0 1 BIT_MASK 0x40 FORMAT "%13.11" ECU_ADDRESS 0x800AE4 /end MEASUREMENT
/begin MEASUREMENT B_dktgtv "Katdiagnose: Bedingung Temperaturgradient-Verzˆgerungszeit" UBYTE B_TRUE 1 100 0 1 BIT_MASK 0x10 FORMAT "%13.11" ECU_ADDRESS 0x800AE2 /end MEASUREMENT
/begin MEASUREMENT B_dktgtv2 "Katdiagnose: Bedingung Temperaturgradient-Verzˆgerungszeit, Bank2" UBYTE B_TRUE 1 100 0 1 BIT_MASK 0x20 FORMAT "%13.11" ECU_ADDRESS 0x800AE2 /end MEASUREMENT
/begin MEASUREMENT B_dktkas "Kat.-Ausr‰umpr¸fung gestoppt bei Katdiagnose" UBYTE B_TRUE 1 100 0 1 BIT_MASK 0x4 FORMAT "%13.11" ECU_ADDRESS 0x800AE2 /end MEASUREMENT
/begin MEASUREMENT B_dktkas2 "Kat.-Ausr‰umpr¸fung gestoppt bei Katdiagnose, Bank2" UBYTE B_TRUE 1 100 0 1 BIT_MASK 0x8 FORMAT "%13.11" ECU_ADDRESS 0x800AE2 /end MEASUREMENT
/begin MEASUREMENT B_dktle "Bedingung: Katdiagnose, Lambda eingeschwungen" UBYTE B_TRUE 1 100 0 1 BIT_MASK 0x4 FORMAT "%13.11" ECU_ADDRESS 0x800AE9 /end MEASUREMENT
/begin MEASUREMENT B_dktle2 "Bedingung: Katdiagnose, Lambda eingeschwungen" UBYTE B_TRUE 1 100 0 1 BIT_MASK 0x2 FORMAT "%13.11" ECU_ADDRESS 0x800AE4 /end MEASUREMENT
/begin MEASUREMENT B_dktm "Bedingung: Meﬂbeginn, Katdiagnose" UBYTE B_TRUE 1 100 0 1 BIT_MASK 0x4 FORMAT "%13.11" ECU_ADDRESS 0x800AE8 /end MEASUREMENT
/begin MEASUREMENT B_dktm2 "Bedingung: Meﬂbeginn, Katdiagnose" UBYTE B_TRUE 1 100 0 1 BIT_MASK 0x4 FORMAT "%13.11" ECU_ADDRESS 0x800AE3 /end MEASUREMENT
/begin MEASUREMENT B_dktme "Bedingung: Meﬂende, Katdiagnose" UBYTE B_TRUE 1 100 0 1 BIT_MASK 0x80 FORMAT "%13.11" ECU_ADDRESS 0x800AE8 /end MEASUREMENT
/begin MEASUREMENT B_dktme2 "Bedingung: Meﬂende, Katdiagnose" UBYTE B_TRUE 1 100 0 1 BIT_MASK 0x80 FORMAT "%13.11" ECU_ADDRESS 0x800AE3 /end MEASUREMENT
/begin MEASUREMENT B_dktr "Bedingung. Katdiagnose im Referenzzustand" UBYTE B_TRUE 1 100 0 1 BIT_MASK 0x2 FORMAT "%13.11" ECU_ADDRESS 0x800AE8 /end MEASUREMENT
/begin MEASUREMENT B_dktr2 "Bedingung. Katdiagnose im Referenzzustand" UBYTE B_TRUE 1 100 0 1 BIT_MASK 0x2 FORMAT "%13.11" ECU_ADDRESS 0x800AE3 /end MEASUREMENT
/begin MEASUREMENT B_dktre "Bedingung Katdiagnose: Referenzzustand erreicht" UBYTE B_TRUE 1 100 0 1 BIT_MASK 0x1 FORMAT "%13.11" ECU_ADDRESS 0x800AE8 /end MEASUREMENT
/begin MEASUREMENT B_dktre2 "Bedingung Katdiagnose: Referenzzustand erreicht" UBYTE B_TRUE 1 100 0 1 BIT_MASK 0x1 FORMAT "%13.11" ECU_ADDRESS 0x800AE3 /end MEASUREMENT
/begin MEASUREMENT B_dktsbs "Bankspezifische Stoppbedingung" UBYTE B_TRUE 1 100 0 1 BIT_MASK 0x2 FORMAT "%13.11" ECU_ADDRESS 0x800AE7 /end MEASUREMENT
/begin MEASUREMENT B_dktsbs2 "Bankspezifische Stoppbedingung (Stereo 2.Bank)" UBYTE B_TRUE 1 100 0 1 BIT_MASK 0x4 FORMAT "%13.11" ECU_ADDRESS 0x800AE7 /end MEASUREMENT
/begin MEASUREMENT B_dktsps "physikalische Stoppbedingung" UBYTE B_TRUE 1 100 0 1 BIT_MASK 0x2 FORMAT "%13.11" ECU_ADDRESS 0x800AE9 /end MEASUREMENT
/begin MEASUREMENT B_dktsps2 "physikalische Stoppbedingung (Stereo 2.Bank)" UBYTE B_TRUE 1 100 0 1 BIT_MASK 0x1 FORMAT "%13.11" ECU_ADDRESS 0x800AE4 /end MEASUREMENT
/begin MEASUREMENT B_dkttks "Katdiagnose temperaturbedingt gesperrt (Kat-Temperatur)" UBYTE B_TRUE 1 100 0 1 BIT_MASK 0x8 FORMAT "%13.11" ECU_ADDRESS 0x800AE7 /end MEASUREMENT
/begin MEASUREMENT B_dkttks2 "Katdiagnose temperaturbedingt gesperrt (Kat-Temperatur)" UBYTE B_TRUE 1 100 0 1 BIT_MASK 0x10 FORMAT "%13.11" ECU_ADDRESS 0x800AE7 /end MEASUREMENT
/begin MEASUREMENT B_dkvsef "Errorflag in DKVS trotz weitere Fehler im System freigeben" UBYTE B_TRUE 1 100 0 1 BIT_MASK 0x1 FORMAT "%13.11" ECU_ADDRESS 0x7FA7ED /end MEASUREMENT
/begin MEASUREMENT B_dkvsef2 "Erroflag in DKVS trotz weitere Fehler im System freigeben Bank 2" UBYTE B_TRUE 1 100 0 1 BIT_MASK 0x1 FORMAT "%13.11" ECU_ADDRESS 0x7FA7EE /end MEASUREMENT
/begin MEASUREMENT B_dkvsf "Bedingung: Freigabe des Fehlers" UBYTE B_TRUE 1 100 0 1 BIT_MASK 0x1 FORMAT "%13.11" ECU_ADDRESS 0x7FA7EF /end MEASUREMENT
/begin MEASUREMENT B_dkvsfm "Bedingung: Freigabe des Fehlers (Flipflop Ausgang)" UBYTE B_TRUE 1 100 0 1 BIT_MASK 0x1 FORMAT "%13.11" ECU_ADDRESS 0x7FC7B2 /end MEASUREMENT
/begin MEASUREMENT B_dkvstr "Bedingung: Integrator bei Tankleer zur¸cksetzen" UBYTE B_TRUE 1 100 0 1 BIT_MASK 0x1 FORMAT "%13.11" ECU_ADDRESS 0x7FA7F0 /end MEASUREMENT
/begin MEASUREMENT B_dkvszf "Zyklusflag in DKVS trotz weitere Fehler im System freigeben" UBYTE B_TRUE 1 100 0 1 BIT_MASK 0x1 FORMAT "%13.11" ECU_ADDRESS 0x800C19 /end MEASUREMENT
/begin MEASUREMENT B_dkvszf2 "Zyklusflag in DKVS trotz weitere Fehler im System freigeben (Bank 2)" UBYTE B_TRUE 1 100 0 1 BIT_MASK 0x20 FORMAT "%13.11" ECU_ADDRESS 0x800C19 /end MEASUREMENT
/begin MEASUREMENT B_dlams "Bedingung Lambdaverstellung f¸r Integrator hat max. Grenzwert erreicht." UBYTE B_TRUE 1 100 0 1 BIT_MASK 0x2 FORMAT "%13.11" ECU_ADDRESS 0x801192 /end MEASUREMENT
/begin MEASUREMENT B_dlams2 "Bedingung Lambdaverstellung f¸r Integrator hat max. Grenzwert erreicht. Bank2" UBYTE B_TRUE 1 100 0 1 BIT_MASK 0x40 FORMAT "%13.11" ECU_ADDRESS 0x801192 /end MEASUREMENT
/begin MEASUREMENT B_dlash "Bedingung Freigabe Schwingungspr¸fung hinter Kat." UBYTE B_TRUE 1 100 0 1 BIT_MASK 0x1 FORMAT "%13.11" ECU_ADDRESS 0x7FA73B /end MEASUREMENT
/begin MEASUREMENT B_dlash2 "Bedingung Freigabe Schwingungspr¸fung  hinter Kat. (Bank 2)" UBYTE B_TRUE 1 100 0 1 BIT_MASK 0x1 FORMAT "%13.11" ECU_ADDRESS 0x7FA73C /end MEASUREMENT
/begin MEASUREMENT B_dllr "Aktive diagnose: Leerlaufstellerdiagnose" UBYTE B_TRUE 1 100 0 1 BIT_MASK 0x1 FORMAT "%13.11" ECU_ADDRESS 0x7FA9AC /end MEASUREMENT
/begin MEASUREMENT B_dllra "Bedingung DLLR Anforderung" UBYTE B_TRUE 1 100 0 1 BIT_MASK 0x1 FORMAT "%13.11" ECU_ADDRESS 0x7FA9AD /end MEASUREMENT
/begin MEASUREMENT B_dluerk "Aussetzer erkannt, aus DMDDLU" UBYTE B_TRUE 1 100 0 1 BIT_MASK 0x1 FORMAT "%13.11" ECU_ADDRESS 0x800E1C /end MEASUREMENT
/begin MEASUREMENT B_dluerk_t "" UBYTE B_TRUE 1 100 0 1 BIT_MASK 0x1 FORMAT "%13.11" ECU_ADDRESS 0x800E1D /end MEASUREMENT
/begin MEASUREMENT B_drlmx "Last‰nderung unterhalb Schwellwert" UBYTE B_TRUE 1 100 0 1 BIT_MASK 0x80 FORMAT "%13.11" ECU_ADDRESS 0x8008D7 /end MEASUREMENT
/begin MEASUREMENT B_ds "KR: Sensordiagnose aktiv" UBYTE B_TRUE 1 100 0 1 BIT_MASK 0x1 FORMAT "%13.11" ECU_ADDRESS 0x7FA83D /end MEASUREMENT
/begin MEASUREMENT B_ds2 "Sensordiagnose aktiv, untere Schwelle" UBYTE B_TRUE 1 100 0 1 BIT_MASK 0x1 FORMAT "%13.11" ECU_ADDRESS 0x7FA83E /end MEASUREMENT
/begin MEASUREMENT B_dshen "Bedingung Freigabe Sondendiagnose hinter KAT" UBYTE B_TRUE 1 100 0 1 BIT_MASK 0x1 FORMAT "%13.11" ECU_ADDRESS 0x7FA72D /end MEASUREMENT
/begin MEASUREMENT B_dshen2 "Bedingung Freigabe Sondendiagnose hinter KAT Bank2" UBYTE B_TRUE 1 100 0 1 BIT_MASK 0x1 FORMAT "%13.11" ECU_ADDRESS 0x7FA72E /end MEASUREMENT
/begin MEASUREMENT B_dshk "Bedingung Diagnosefunktion in %DLSH und %DHLS mit i.O.-Meldung h. KAT" UBYTE B_TRUE 1 100 0 1 BIT_MASK 0x1 FORMAT "%13.11" ECU_ADDRESS 0x7FA73D /end MEASUREMENT
/begin MEASUREMENT B_dshk2 "Bed. Diagnosefunktion in %DLSH u.%DHLS mit i.O.-Meldung h. KAT  Bank2" UBYTE B_TRUE 1 100 0 1 BIT_MASK 0x1 FORMAT "%13.11" ECU_ADDRESS 0x7FA73E /end MEASUREMENT
/begin MEASUREMENT B_dushkvl "Bed. Schwelle f¸r Sonde h. KAT bei Vollast nicht ¸berschritten" UBYTE B_TRUE 1 100 0 1 BIT_MASK 0x8 FORMAT "%13.11" ECU_ADDRESS 0x801193 /end MEASUREMENT
/begin MEASUREMENT B_dushkvl2 "Bed. Schwelle f¸r Sonde h. KAT bei Vollast nicht ¸berschritten Bank2" UBYTE B_TRUE 1 100 0 1 BIT_MASK 0x80 FORMAT "%13.11" ECU_ADDRESS 0x801193 /end MEASUREMENT
/begin MEASUREMENT B_dushsch "Bedingung Schwelle f¸r Sonde hinter KAT im Schub nicht unterschritten" UBYTE B_TRUE 1 100 0 1 BIT_MASK 0x1 FORMAT "%13.11" ECU_ADDRESS 0x7FA73F /end MEASUREMENT
/begin MEASUREMENT B_dushsch2 "Bed. Schwelle f¸r Sonde hinter KAT im Schub nicht unterschritten  Bank2" UBYTE B_TRUE 1 100 0 1 BIT_MASK 0x1 FORMAT "%13.11" ECU_ADDRESS 0x7FA740 /end MEASUREMENT
/begin MEASUREMENT B_dylash "Bedingung Sonde hinter KAT dynamisch langsam" UBYTE B_TRUE 1 100 0 1 BIT_MASK 0x1 FORMAT "%13.11" ECU_ADDRESS 0x7FC758 /end MEASUREMENT
/begin MEASUREMENT B_dylash2 "Bedingung Sonde hinter KAT dynamisch langsam Bank2" UBYTE B_TRUE 1 100 0 1 BIT_MASK 0x2 FORMAT "%13.11" ECU_ADDRESS 0x7FC758 /end MEASUREMENT
/begin MEASUREMENT B_dylsu "Dynamik LSU gepr¸ft" UBYTE B_TRUE 1 100 0 1 BIT_MASK 0x2 FORMAT "%13.11" ECU_ADDRESS 0x8008CE /end MEASUREMENT
/begin MEASUREMENT B_dylsu2 "Dynamik LSU2 gepr¸ft" UBYTE B_TRUE 1 100 0 1 BIT_MASK 0x1 FORMAT "%13.11" ECU_ADDRESS 0x8008D4 /end MEASUREMENT
/begin MEASUREMENT B_dylsuav "Dynamik¸berwachung LSU aktiv" UBYTE B_TRUE 1 100 0 1 BIT_MASK 0x2 FORMAT "%13.11" ECU_ADDRESS 0x8008D1 /end MEASUREMENT
/begin MEASUREMENT B_dylsuav2 "Dynamik¸berwachung LSU2 aktiv" UBYTE B_TRUE 1 100 0 1 BIT_MASK 0x10 FORMAT "%13.11" ECU_ADDRESS 0x8008D2 /end MEASUREMENT
/begin MEASUREMENT B_dylsuf "Freigabe Dynamikpr¸fung LSU" UBYTE B_TRUE 1 100 0 1 BIT_MASK 0x40 FORMAT "%13.11" ECU_ADDRESS 0x8008D7 /end MEASUREMENT
/begin MEASUREMENT B_edkt "Bedingung: Katdiagnose: Schlechtpr¸fung" UBYTE B_TRUE 1 100 0 1 BIT_MASK 0x8 FORMAT "%13.11" ECU_ADDRESS 0x800AE9 /end MEASUREMENT
/begin MEASUREMENT B_edkt2 "Bedingung: Katdiagnose: Schlechtpr¸fung" UBYTE B_TRUE 1 100 0 1 BIT_MASK 0x4 FORMAT "%13.11" ECU_ADDRESS 0x800AE4 /end MEASUREMENT
/begin MEASUREMENT B_edkvs "Bedingung Adaptionsfehlerschwellen aktuell ¸berschritten" UBYTE B_TRUE 1 100 0 1 BIT_MASK 0x1 FORMAT "%13.11" ECU_ADDRESS 0x7FA7F1 /end MEASUREMENT
/begin MEASUREMENT B_edkvs2 "Bedingung Adaptionsfehlerschwellen Bank 2 aktuell ¸berschritten" UBYTE B_TRUE 1 100 0 1 BIT_MASK 0x1 FORMAT "%13.11" ECU_ADDRESS 0x7FA7F2 /end MEASUREMENT
/begin MEASUREMENT B_efrao "Bedingung Diagnoseschwellen obere multipl. Korrektur aktuell ¸berschritten" UBYTE B_TRUE 1 100 0 1 BIT_MASK 0x1 FORMAT "%13.11" ECU_ADDRESS 0x7FA7F3 /end MEASUREMENT
/begin MEASUREMENT B_efrao2 "Bedingung Diagnoseschwellen obere multipl. Korr. Bank 2 aktuell ¸berschritten" UBYTE B_TRUE 1 100 0 1 BIT_MASK 0x1 FORMAT "%13.11" ECU_ADDRESS 0x7FA7F4 /end MEASUREMENT
/begin MEASUREMENT B_efrau "Bedingung Diagnoseschwellen untere multipl. Korrektur aktuell ¸berschritten" UBYTE B_TRUE 1 100 0 1 BIT_MASK 0x1 FORMAT "%13.11" ECU_ADDRESS 0x7FA7F5 /end MEASUREMENT
/begin MEASUREMENT B_efrau2 "Bedingung Diagnoseschwellen untere multipl. Korr. Bank 2 aktuell ¸berschritten" UBYTE B_TRUE 1 100 0 1 BIT_MASK 0x1 FORMAT "%13.11" ECU_ADDRESS 0x7FA7F6 /end MEASUREMENT
/begin MEASUREMENT B_eiclsu "Bedingung Fehler am Auswerte-IC f¸r die LSU" UBYTE B_TRUE 1 100 0 1 BIT_MASK 0x10 FORMAT "%13.11" ECU_ADDRESS 0x8008D8 /end MEASUREMENT
/begin MEASUREMENT B_eiclsu2 "Bedingung Fehler am Auswerte-IC f¸r die LSU, Bank 2" UBYTE B_TRUE 1 100 0 1 BIT_MASK 0x8 FORMAT "%13.11" ECU_ADDRESS 0x8008D9 /end MEASUREMENT
/begin MEASUREMENT B_elaof "Bedingung Error Lambda-Offset LSU" UBYTE B_TRUE 1 100 0 1 BIT_MASK 0x2 FORMAT "%13.11" ECU_ADDRESS 0x8008D8 /end MEASUREMENT
/begin MEASUREMENT B_elaof2 "Bedingung Error Lambda-Offset LSU2" UBYTE B_TRUE 1 100 0 1 BIT_MASK 0x1 FORMAT "%13.11" ECU_ADDRESS 0x8008D9 /end MEASUREMENT
/begin MEASUREMENT B_elshv "Hilfsbit zur Auswertung des Erorbits E_lshv zur Umschaltung Mono/Stereo" UBYTE B_TRUE 1 100 0 1 BIT_MASK 0x4 FORMAT "%13.11" ECU_ADDRESS 0x801191 /end MEASUREMENT
/begin MEASUREMENT B_elshv2 "Hilfsbit zur Auswertung des Erorbits E_lshv2 zur Umschaltung Mono/Stereo Bank2" UBYTE B_TRUE 1 100 0 1 BIT_MASK 0x10 FORMAT "%13.11" ECU_ADDRESS 0x801191 /end MEASUREMENT
/begin MEASUREMENT B_elshvdkt "Bedingung hintere Lambdasonden vertauscht" UBYTE B_TRUE 1 100 0 1 BIT_MASK 0x20 FORMAT "%13.11" ECU_ADDRESS 0x800AE7 /end MEASUREMENT
/begin MEASUREMENT B_elsu "Bedingung Fehler oder Fehler-Vormerkung LSU (keine Betriebsbereitschaft)" UBYTE B_TRUE 1 100 0 1 BIT_MASK 0x4 FORMAT "%13.11" ECU_ADDRESS 0x8008D8 /end MEASUREMENT
/begin MEASUREMENT B_elsu2 "Bedingung Fehler oder Fehler-Vormerkung LSU Bank2 (keine Betriebsbereitschaft)" UBYTE B_TRUE 1 100 0 1 BIT_MASK 0x2 FORMAT "%13.11" ECU_ADDRESS 0x8008D9 /end MEASUREMENT
/begin MEASUREMENT B_elsuwi "Bedingung Leitungsfehler LSU ( intern)" UBYTE B_TRUE 1 100 0 1 BIT_MASK 0x20 FORMAT "%13.11" ECU_ADDRESS 0x8008D8 /end MEASUREMENT
/begin MEASUREMENT B_elsuwi2 "Bedingung Leitungsfehler LSU ( intern), Bank2" UBYTE B_TRUE 1 100 0 1 BIT_MASK 0x10 FORMAT "%13.11" ECU_ADDRESS 0x8008D9 /end MEASUREMENT
/begin MEASUREMENT B_elsvdkt "Bedingung vorderer Lambdasondenfehler" UBYTE B_TRUE 1 100 0 1 BIT_MASK 0x40 FORMAT "%13.11" ECU_ADDRESS 0x800AE7 /end MEASUREMENT
/begin MEASUREMENT B_elsvdkt2 "Bedingung vorderer Lambdasondenfehler, Bank2" UBYTE B_TRUE 1 100 0 1 BIT_MASK 0x80 FORMAT "%13.11" ECU_ADDRESS 0x800AE7 /end MEASUREMENT
/begin MEASUREMENT B_enfmst "Bedingung Enable f¸r Filter; Maximum der Steigung ¸bernehmen hinter Kat" UBYTE B_TRUE 1 100 0 1 BIT_MASK 0x1 FORMAT "%13.11" ECU_ADDRESS 0x7FA741 /end MEASUREMENT
/begin MEASUREMENT B_enfmst2 "Bedingung Enable f¸r Filter Maximum der Steigung ¸bernehmen hinter Kat Bank2" UBYTE B_TRUE 1 100 0 1 BIT_MASK 0x1 FORMAT "%13.11" ECU_ADDRESS 0x7FA742 /end MEASUREMENT
/begin MEASUREMENT B_enlash "Bedingung Test f¸r Schwingungspr¸fung abgeschlossen hinteer Kat" UBYTE B_TRUE 1 100 0 1 BIT_MASK 0x1 FORMAT "%13.11" ECU_ADDRESS 0x7FA743 /end MEASUREMENT
/begin MEASUREMENT B_enlash2 "Bedingung Test f¸r Schwingungspr¸fung abgeschlossen hinter Kat Bank2" UBYTE B_TRUE 1 100 0 1 BIT_MASK 0x1 FORMAT "%13.11" ECU_ADDRESS 0x7FA744 /end MEASUREMENT
/begin MEASUREMENT B_enmaxla "Bedingung enable B_maxlash ""setzen"" bei Fehler Lambdasonden hinter Kat" UBYTE B_TRUE 1 100 0 1 BIT_MASK 0x2 FORMAT "%13.11" ECU_ADDRESS 0x801193 /end MEASUREMENT
/begin MEASUREMENT B_enmaxla2 "Bedingung enable B_maxlash ""setzen"" bei Fehler Lambdasonden hinter Kat  Bank2" UBYTE B_TRUE 1 100 0 1 BIT_MASK 0x20 FORMAT "%13.11" ECU_ADDRESS 0x801193 /end MEASUREMENT
/begin MEASUREMENT B_entest "Bedingung Wartezeit abgeschlossen f¸r Test-‹berpr¸fung Sonde hinter KAT" UBYTE B_TRUE 1 100 0 1 BIT_MASK 0x1 FORMAT "%13.11" ECU_ADDRESS 0x7FA745 /end MEASUREMENT
/begin MEASUREMENT B_entest2 "Bedingung Wartezeit abgeschlossen f¸r Test-‹berpr¸fung Sonde hinter KAT Bank2" UBYTE B_TRUE 1 100 0 1 BIT_MASK 0x1 FORMAT "%13.11" ECU_ADDRESS 0x7FA746 /end MEASUREMENT
/begin MEASUREMENT B_erkat "Bedingung Diagnoseschwellen additive Korr. pro Zeit aktuell ¸berschritten" UBYTE B_TRUE 1 100 0 1 BIT_MASK 0x1 FORMAT "%13.11" ECU_ADDRESS 0x7FA7F7 /end MEASUREMENT
/begin MEASUREMENT B_erkat2 "Bedingung Diagnoseschwellen additive Korr. pro Zeit Bank 2 aktuell ¸berschritten" UBYTE B_TRUE 1 100 0 1 BIT_MASK 0x1 FORMAT "%13.11" ECU_ADDRESS 0x7FA7F8 /end MEASUREMENT
/begin MEASUREMENT B_erkaz "Bedingung Diagnoseschwellen additive Korr. pro Einspr.  aktuell ¸berschritten" UBYTE B_TRUE 1 100 0 1 BIT_MASK 0x1 FORMAT "%13.11" ECU_ADDRESS 0x7FA7F9 /end MEASUREMENT
/begin MEASUREMENT B_erkaz2 "Bedingung Diagnoseschw. additive Korr. pro Einspr. Bank 2 aktuell ¸berschritten" UBYTE B_TRUE 1 100 0 1 BIT_MASK 0x1 FORMAT "%13.11" ECU_ADDRESS 0x7FA7FA /end MEASUREMENT
/begin MEASUREMENT B_falsu "Bedingung Funktionsanforderung Lambda-Sonde vor KAT" UBYTE B_TRUE 1 100 0 1 BIT_MASK 0x1 FORMAT "%13.11" ECU_ADDRESS 0x8008D8 /end MEASUREMENT
/begin MEASUREMENT B_fof1 "Bedingung fuel-off Adaption in 1. Drehzahlbereich aktiv" UBYTE B_TRUE 1 100 0 1 BIT_MASK 0x1 FORMAT "%13.11" ECU_ADDRESS 0x800E22 /end MEASUREMENT
/begin MEASUREMENT B_fof2 "Bedingung fuel-off Adaption in 2. Drehzahlbereich aktiv" UBYTE B_TRUE 1 100 0 1 BIT_MASK 0x1 FORMAT "%13.11" ECU_ADDRESS 0x800E23 /end MEASUREMENT
/begin MEASUREMENT B_fof3 "Bedingung fuel-off Adaption in 3. Drehzahlbereich aktiv" UBYTE B_TRUE 1 100 0 1 BIT_MASK 0x1 FORMAT "%13.11" ECU_ADDRESS 0x800E24 /end MEASUREMENT
/begin MEASUREMENT B_fof4 "Bedingung fuel-off Adaption in 4. Drehzahlbereich aktiv" UBYTE B_TRUE 1 100 0 1 BIT_MASK 0x1 FORMAT "%13.11" ECU_ADDRESS 0x800E25 /end MEASUREMENT
/begin MEASUREMENT B_fofd "Bedingung fuel-off Adaption in dominantem Drehzahlbereich aktiv" UBYTE B_TRUE 1 100 0 1 BIT_MASK 0x1 FORMAT "%13.11" ECU_ADDRESS 0x800E26 /end MEASUREMENT
/begin MEASUREMENT B_fofdis "Bedingung fuel-off Adaption im aktuellen Betriebsbereich nicht erlaubt" UBYTE B_TRUE 1 100 0 1 BIT_MASK 0x1 FORMAT "%13.11" ECU_ADDRESS 0x800E27 /end MEASUREMENT
/begin MEASUREMENT B_fofdr "Bedingung fuel-off Adaption im dominanten Drehzahlbereich ready" UBYTE B_TRUE 1 100 0 1 BIT_MASK 0x1 FORMAT "%13.11" ECU_ADDRESS 0x7FC388 /end MEASUREMENT
/begin MEASUREMENT B_fofr "Bedingung fuel-off Adaption im aktuellen Drehzahlbereich ready" UBYTE B_TRUE 1 100 0 1 BIT_MASK 0x1 FORMAT "%13.11" ECU_ADDRESS 0x800E28 /end MEASUREMENT
/begin MEASUREMENT B_fofr1 "Drehzahlbereich 1 fertig gelernt (ready)" UBYTE B_TRUE 1 100 0 1 BIT_MASK 0x1 FORMAT "%13.11" ECU_ADDRESS 0x7FC389 /end MEASUREMENT
/begin MEASUREMENT B_fofr2 "Drehzahlbereich 2 fertig gelernt (ready)" UBYTE B_TRUE 1 100 0 1 BIT_MASK 0x1 FORMAT "%13.11" ECU_ADDRESS 0x7FC38A /end MEASUREMENT
/begin MEASUREMENT B_fofr3 "Drehzahlbereich 3 fertig gelernt (ready)" UBYTE B_TRUE 1 100 0 1 BIT_MASK 0x1 FORMAT "%13.11" ECU_ADDRESS 0x7FC38B /end MEASUREMENT
/begin MEASUREMENT B_fofr4 "Drehzahlbereich 4 fertig gelernt (ready)" UBYTE B_TRUE 1 100 0 1 BIT_MASK 0x1 FORMAT "%13.11" ECU_ADDRESS 0x7FC38C /end MEASUREMENT
/begin MEASUREMENT B_fofrun "Status fuel-off Adaption aktiv" UBYTE B_TRUE 1 100 0 1 BIT_MASK 0x1 FORMAT "%13.11" ECU_ADDRESS 0x800E29 /end MEASUREMENT
/begin MEASUREMENT B_fofrun0 "Bedingungen f¸r Fuel-off Adaption erf¸llt" UBYTE B_TRUE 1 100 0 1 BIT_MASK 0x1 FORMAT "%13.11" ECU_ADDRESS 0x800E2A /end MEASUREMENT
/begin MEASUREMENT B_folunw "Bedingung Laufunruhe zu groﬂ f¸r fuel-on/-off Adaption" UBYTE B_TRUE 1 100 0 1 BIT_MASK 0x1 FORMAT "%13.11" ECU_ADDRESS 0x800E2B /end MEASUREMENT
/begin MEASUREMENT B_fomod "zeigt Modus der fuel-on/-off Adaption (Codewort CDFOMOD)" UBYTE B_TRUE 1 100 0 1 BIT_MASK 0x1 FORMAT "%13.11" ECU_ADDRESS 0x7FC38D /end MEASUREMENT
/begin MEASUREMENT B_fomodold "" UBYTE B_TRUE 1 100 0 1 BIT_MASK 0x1 FORMAT "%13.11" ECU_ADDRESS 0x800E2C /end MEASUREMENT
/begin MEASUREMENT B_fonresd "Anforderung Reset der Fuel-On Adaption durchf¸hren" UBYTE B_TRUE 1 100 0 1 BIT_MASK 0x1 FORMAT "%13.11" ECU_ADDRESS 0x800674 /end MEASUREMENT
/begin MEASUREMENT B_frste "Bedingung frm_w eingeschwungen (Kurztest)" UBYTE B_TRUE 1 100 0 1 BIT_MASK 0x1 FORMAT "%13.11" ECU_ADDRESS 0x7FA7FB /end MEASUREMENT
/begin MEASUREMENT B_frste2 "Bedingung frm2_w eingeschwungen (Kurztest 2. Bank)" UBYTE B_TRUE 1 100 0 1 BIT_MASK 0x1 FORMAT "%13.11" ECU_ADDRESS 0x7FA7FC /end MEASUREMENT
/begin MEASUREMENT B_gae "Bedingung Grundadaption eingeschwungen" UBYTE B_TRUE 1 100 0 1 BIT_MASK 0x1 FORMAT "%13.11" ECU_ADDRESS 0x7FA7FD /end MEASUREMENT
/begin MEASUREMENT B_gaefra "Bedingung Grundadaption (fra-Integrator) eingeschwungen" UBYTE B_TRUE 1 100 0 1 BIT_MASK 0x1 FORMAT "%13.11" ECU_ADDRESS 0x7FA7FE /end MEASUREMENT
/begin MEASUREMENT B_gaefra2 "Bedingung Grundadaption (fra2-Integrator) eingeschwungen" UBYTE B_TRUE 1 100 0 1 BIT_MASK 0x1 FORMAT "%13.11" ECU_ADDRESS 0x7FA7FF /end MEASUREMENT
/begin MEASUREMENT B_gaeing "Bedingung Grundadaption Bank 1 eingeschwungen" UBYTE B_TRUE 1 100 0 1 BIT_MASK 0x1 FORMAT "%13.11" ECU_ADDRESS 0x7FA800 /end MEASUREMENT
/begin MEASUREMENT B_gaeing2 "Bedingung Grundadaption Bank 2 eingeschwungenen" UBYTE B_TRUE 1 100 0 1 BIT_MASK 0x1 FORMAT "%13.11" ECU_ADDRESS 0x7FA801 /end MEASUREMENT
/begin MEASUREMENT B_heallsv "Bedingung Heilen des Fehlerpfades LSV" UBYTE B_TRUE 1 100 0 1 BIT_MASK 0x4 FORMAT "%13.11" ECU_ADDRESS 0x8008CE /end MEASUREMENT
/begin MEASUREMENT B_heallsv2 "Bedingung Heilen des Fehlerpfades LSV2, Bank 2" UBYTE B_TRUE 1 100 0 1 BIT_MASK 0x1 FORMAT "%13.11" ECU_ADDRESS 0x8008D2 /end MEASUREMENT
/begin MEASUREMENT B_heatf "Freigabe Heizerkopplung LSU" UBYTE B_TRUE 1 100 0 1 BIT_MASK 0x8 FORMAT "%13.11" ECU_ADDRESS 0x8008D1 /end MEASUREMENT
/begin MEASUREMENT B_helsu "Diagnose Heizerkopplung LSU erfolgt" UBYTE B_TRUE 1 100 0 1 BIT_MASK 0x8 FORMAT "%13.11" ECU_ADDRESS 0x8008CE /end MEASUREMENT
/begin MEASUREMENT B_helsu2 "Diagnose Heizerkopplung LSU2 erfolgt" UBYTE B_TRUE 1 100 0 1 BIT_MASK 0x4 FORMAT "%13.11" ECU_ADDRESS 0x8008D4 /end MEASUREMENT
/begin MEASUREMENT B_helsuf "Bedingung Freigabe Heilung LSU" UBYTE B_TRUE 1 100 0 1 BIT_MASK 0x20 FORMAT "%13.11" ECU_ADDRESS 0x8008CE /end MEASUREMENT
/begin MEASUREMENT B_helsuf2 "Bedingung Freigabe Heilung LSU 2" UBYTE B_TRUE 1 100 0 1 BIT_MASK 0x40 FORMAT "%13.11" ECU_ADDRESS 0x8008D2 /end MEASUREMENT
/begin MEASUREMENT B_hlpkrnte "KR: Fehlerhilfsflag Nulltest" UBYTE B_TRUE 1 100 0 1 BIT_MASK 0x1 FORMAT "%13.11" ECU_ADDRESS 0x7FA83F /end MEASUREMENT
/begin MEASUREMENT B_hlpkrntz "KR: Zyklushilfsflag Nulltest" UBYTE B_TRUE 1 100 0 1 BIT_MASK 0x1 FORMAT "%13.11" ECU_ADDRESS 0x7FA840 /end MEASUREMENT
/begin MEASUREMENT B_hlpkrpce "KR: Fehlerhilfsflag Parity-Check" UBYTE B_TRUE 1 100 0 1 BIT_MASK 0x1 FORMAT "%13.11" ECU_ADDRESS 0x7FA841 /end MEASUREMENT
/begin MEASUREMENT B_hlpkrpcz "KR: Zyklushilfsflag Parity-Check" UBYTE B_TRUE 1 100 0 1 BIT_MASK 0x1 FORMAT "%13.11" ECU_ADDRESS 0x7FA842 /end MEASUREMENT
/begin MEASUREMENT B_hlpkrspe "KR: Fehlerhilfsflag SPI-‹berwachung" UBYTE B_TRUE 1 100 0 1 BIT_MASK 0x1 FORMAT "%13.11" ECU_ADDRESS 0x7FA848 /end MEASUREMENT
/begin MEASUREMENT B_hlpkrspz "KR: Zyklushilfsflag SPI-‹berwachung" UBYTE B_TRUE 1 100 0 1 BIT_MASK 0x1 FORMAT "%13.11" ECU_ADDRESS 0x7FA849 /end MEASUREMENT
/begin MEASUREMENT B_hlpkrtpe "KR: Fehlerhilfsflag Testimpuls" UBYTE B_TRUE 1 100 0 1 BIT_MASK 0x1 FORMAT "%13.11" ECU_ADDRESS 0x7FA843 /end MEASUREMENT
/begin MEASUREMENT B_hlpkrtpz "KR: Zyklushilfsflag Testimpuls" UBYTE B_TRUE 1 100 0 1 BIT_MASK 0x1 FORMAT "%13.11" ECU_ADDRESS 0x7FA844 /end MEASUREMENT
/begin MEASUREMENT B_iapcf "Bedingung Wackelkontakt an Leitung IA der LSU" UBYTE B_TRUE 1 100 0 1 BIT_MASK 0x1 FORMAT "%13.11" ECU_ADDRESS 0x8008CF /end MEASUREMENT
/begin MEASUREMENT B_iapcf2 "Bedingung Wackelkontakt an Leitung IA der LSU, Bank 2" UBYTE B_TRUE 1 100 0 1 BIT_MASK 0x20 FORMAT "%13.11" ECU_ADDRESS 0x8008D4 /end MEASUREMENT
/begin MEASUREMENT B_idxfof1 "Bedingung Betriebspunkt im 1. Drehzahhlbereich" UBYTE B_TRUE 1 100 0 1 BIT_MASK 0x1 FORMAT "%13.11" ECU_ADDRESS 0x800E2D /end MEASUREMENT
/begin MEASUREMENT B_idxfof2 "Bedingung Betriebspunkt im 2. Drehzahhlbereich" UBYTE B_TRUE 1 100 0 1 BIT_MASK 0x1 FORMAT "%13.11" ECU_ADDRESS 0x800E2E /end MEASUREMENT
/begin MEASUREMENT B_idxfof3 "Bedingung Betriebspunkt im 3. Drehzahhlbereich" UBYTE B_TRUE 1 100 0 1 BIT_MASK 0x1 FORMAT "%13.11" ECU_ADDRESS 0x800E2F /end MEASUREMENT
/begin MEASUREMENT B_idxfof4 "Bedingung Betriebspunkt im 4. Drehzahhlbereich" UBYTE B_TRUE 1 100 0 1 BIT_MASK 0x1 FORMAT "%13.11" ECU_ADDRESS 0x800E30 /end MEASUREMENT
/begin MEASUREMENT B_ildkt "Katalysator ¸ber Kat-Ausr‰umen gepr¸ft" UBYTE B_TRUE 1 100 0 1 BIT_MASK 0x40 FORMAT "%13.11" ECU_ADDRESS 0x800AE9 /end MEASUREMENT
/begin MEASUREMENT B_ildkt2 "Katalysator ¸ber Kat-Ausr‰umen gepr¸ft" UBYTE B_TRUE 1 100 0 1 BIT_MASK 0x20 FORMAT "%13.11" ECU_ADDRESS 0x800AE4 /end MEASUREMENT
/begin MEASUREMENT B_imlkvse "Bedingung Luftmassenintegral R¸cksetzen" UBYTE B_TRUE 1 100 0 1 BIT_MASK 0x2 FORMAT "%13.11" ECU_ADDRESS 0x7FC7B2 /end MEASUREMENT
/begin MEASUREMENT B_krntfv "KR: Fehlerverdacht Nulltest" UBYTE B_TRUE 1 100 0 1 BIT_MASK 0x1 FORMAT "%13.11" ECU_ADDRESS 0x7FA845 /end MEASUREMENT
/begin MEASUREMENT B_krtpfv "KR: Testimpuls Fehlerverdacht" UBYTE B_TRUE 1 100 0 1 BIT_MASK 0x1 FORMAT "%13.11" ECU_ADDRESS 0x7FA846 /end MEASUREMENT
/begin MEASUREMENT B_ktrlash "Bedingung Kurztrip f¸r Schwingungspr¸fung durchf¸hren Sonde hinter KAT" UBYTE B_TRUE 1 100 0 1 BIT_MASK 0x4 FORMAT "%13.11" ECU_ADDRESS 0x801192 /end MEASUREMENT
/begin MEASUREMENT B_ktrlash2 "Bedingung Kurztrip f¸r Schwingungspr¸fung durchf¸hren Sonde hinter KAT Bank2" UBYTE B_TRUE 1 100 0 1 BIT_MASK 0x20 FORMAT "%13.11" ECU_ADDRESS 0x801192 /end MEASUREMENT
/begin MEASUREMENT B_kvsffl "Bedingung: Freigabe des Fehlers trotz Tank leer" UBYTE B_TRUE 1 100 0 1 BIT_MASK 0x1 FORMAT "%13.11" ECU_ADDRESS 0x7FA802 /end MEASUREMENT
/begin MEASUREMENT B_lamdkt "Lambdasoll Eingriff f¸r Katdiagnose aktiv" UBYTE B_TRUE 1 100 0 1 BIT_MASK 0x1 FORMAT "%13.11" ECU_ADDRESS 0x800AE5 /end MEASUREMENT
/begin MEASUREMENT B_lamdkt2 "Lambdasoll Eingriff f¸r Katdiagnose aktiv" UBYTE B_TRUE 1 100 0 1 BIT_MASK 0x2 FORMAT "%13.11" ECU_ADDRESS 0x800AE5 /end MEASUREMENT
/begin MEASUREMENT B_lamend "Bedingung Ende der Lambdaverstellung in %LAMKO hinter Kat" UBYTE B_TRUE 1 100 0 1 BIT_MASK 0x1 FORMAT "%13.11" ECU_ADDRESS 0x7FA747 /end MEASUREMENT
/begin MEASUREMENT B_lamend2 "Bedingung Ende der Lambdaverstellung in %LAMKO hinter Kat Bank2" UBYTE B_TRUE 1 100 0 1 BIT_MASK 0x1 FORMAT "%13.11" ECU_ADDRESS 0x7FA748 /end MEASUREMENT
/begin MEASUREMENT B_lamlash "Bedingung f¸r Abmagern/Anfetten in %LAMKO" UBYTE B_TRUE 1 100 0 1 BIT_MASK 0x1 FORMAT "%13.11" ECU_ADDRESS 0x7FA749 /end MEASUREMENT
/begin MEASUREMENT B_lamlash2 "Bedingung f¸r Abmagern in %LAMKO Bank2" UBYTE B_TRUE 1 100 0 1 BIT_MASK 0x1 FORMAT "%13.11" ECU_ADDRESS 0x7FA74A /end MEASUREMENT
/begin MEASUREMENT B_lamverg "Bedingung Vergleich Lambdasoll in %DLSAHK mit %LAMKO ¸bereinstimmend" UBYTE B_TRUE 1 100 0 1 BIT_MASK 0x1 FORMAT "%13.11" ECU_ADDRESS 0x7FA74B /end MEASUREMENT
/begin MEASUREMENT B_lamverg2 "Bedingung Vergleich Lambdasoll in %DLSAHK mit %LAMKO ¸bereinstimmend Bank2" UBYTE B_TRUE 1 100 0 1 BIT_MASK 0x1 FORMAT "%13.11" ECU_ADDRESS 0x7FA74C /end MEASUREMENT
/begin MEASUREMENT B_lbkbb "LBK betriebsbereit" UBYTE B_TRUE 1 100 0 1 BIT_MASK 0x20 FORMAT "%13.11" ECU_ADDRESS 0x8010C0 /end MEASUREMENT
/begin MEASUREMENT B_lbkg "Istwert von LBK g¸ltig" UBYTE B_TRUE 1 100 0 1 BIT_MASK 0x1 FORMAT "%13.11" ECU_ADDRESS 0x8010C0 /end MEASUREMENT
/begin MEASUREMENT B_lbknh "Bedingung: Noftlaufforderung, da LBK ohne Drall klemmt" UBYTE B_TRUE 1 100 0 1 BIT_MASK 0x2 FORMAT "%13.11" ECU_ADDRESS 0x8010C0 /end MEASUREMENT
/begin MEASUREMENT B_lbknlb "Bedingung: Noftlaufforderung, da LBK mit Drall klemmt" UBYTE B_TRUE 1 100 0 1 BIT_MASK 0x4 FORMAT "%13.11" ECU_ADDRESS 0x8010C0 /end MEASUREMENT
/begin MEASUREMENT B_lbknol "Bedingung LBK Notlauffahren" UBYTE B_TRUE 1 100 0 1 BIT_MASK 0x8 FORMAT "%13.11" ECU_ADDRESS 0x8010C0 /end MEASUREMENT
/begin MEASUREMENT B_lbkpsio "Bedingung: Saugrohrunterdruck ausreichend f¸r LBK-Verstellung (nur bei SY_LBK=2)" UBYTE B_TRUE 1 100 0 1 BIT_MASK 0x40 FORMAT "%13.11" ECU_ADDRESS 0x8010C0 /end MEASUREMENT
/begin MEASUREMENT B_lbksg "Bedingung: LBK Sollwert g¸ltig" UBYTE B_TRUE 1 100 0 1 BIT_MASK 0x10 FORMAT "%13.11" ECU_ADDRESS 0x8010C0 /end MEASUREMENT
/begin MEASUREMENT B_lldia "Diagnose Leerlaufregelung freigegeben" UBYTE B_TRUE 1 100 0 1 BIT_MASK 0x1 FORMAT "%13.11" ECU_ADDRESS 0x7FA9AE /end MEASUREMENT
/begin MEASUREMENT B_lrasp "Bedingung stop LRA wegen LSU-Fehler" UBYTE B_TRUE 1 100 0 1 BIT_MASK 0x8 FORMAT "%13.11" ECU_ADDRESS 0x8008D8 /end MEASUREMENT
/begin MEASUREMENT B_lrasp2 "Bedingung stop LRA wegen LSU-Fehler, Bank 2" UBYTE B_TRUE 1 100 0 1 BIT_MASK 0x4 FORMAT "%13.11" ECU_ADDRESS 0x8008D9 /end MEASUREMENT
/begin MEASUREMENT B_lsahksp "allgemeine Stop-Bedingungen f¸r die DLSAHK" UBYTE B_TRUE 1 100 0 1 BIT_MASK 0x1 FORMAT "%13.11" ECU_ADDRESS 0x7FA74D /end MEASUREMENT
/begin MEASUREMENT B_lsahksp2 "allgemeine Stop-Bedingungen f¸r die DLSAHK Bank2" UBYTE B_TRUE 1 100 0 1 BIT_MASK 0x1 FORMAT "%13.11" ECU_ADDRESS 0x7FA74E /end MEASUREMENT
/begin MEASUREMENT B_lshklt "Bedingung Lambdasonde hinter Kat kalt" UBYTE B_TRUE 1 100 0 1 BIT_MASK 0x1 FORMAT "%13.11" ECU_ADDRESS 0x7FA72F /end MEASUREMENT
/begin MEASUREMENT B_lshkpft "Bedingung Lambdasondensignal hinter dem Kat. plausibel fett" UBYTE B_TRUE 1 100 0 1 BIT_MASK 0x4 FORMAT "%13.11" ECU_ADDRESS 0x8008CF /end MEASUREMENT
/begin MEASUREMENT B_lshkpft2 "Bedingung Lambdasondensignal hinter dem Kat. plausibel fett, Bank 2" UBYTE B_TRUE 1 100 0 1 BIT_MASK 0x1 FORMAT "%13.11" ECU_ADDRESS 0x8008D5 /end MEASUREMENT
/begin MEASUREMENT B_lshkpmr "Bedingung Lambdasondensignal hinter dem Kat. plausibel mager" UBYTE B_TRUE 1 100 0 1 BIT_MASK 0x8 FORMAT "%13.11" ECU_ADDRESS 0x8008CF /end MEASUREMENT
/begin MEASUREMENT B_lshkpmr2 "Bedingung Lambdasondensignal hinter dem Kat. plausibel mager, Bank 2" UBYTE B_TRUE 1 100 0 1 BIT_MASK 0x2 FORMAT "%13.11" ECU_ADDRESS 0x8008D5 /end MEASUREMENT
/begin MEASUREMENT B_lshswok "Bedingung Sonde hinter KAT nach Schwingungspr¸fung in Ordnung" UBYTE B_TRUE 1 100 0 1 BIT_MASK 0x1 FORMAT "%13.11" ECU_ADDRESS 0x800A6E /end MEASUREMENT
/begin MEASUREMENT B_lshswok2 "Bedingung Sonde hinter KAT nach Schwingungspr¸fung in Ordnung Bank2" UBYTE B_TRUE 1 100 0 1 BIT_MASK 0x2 FORMAT "%13.11" ECU_ADDRESS 0x800A6E /end MEASUREMENT
/begin MEASUREMENT B_lsuabgl "Bedingung Abgleichleitung stetige Lambda-Sonde LSU unterbrochen" UBYTE B_TRUE 1 100 0 1 BIT_MASK 0x40 FORMAT "%13.11" ECU_ADDRESS 0x8008CE /end MEASUREMENT
/begin MEASUREMENT B_lsuabgl2 "Bedingung Abgleichleitung stetige Lambda-Sonde LSU 2 unterbrochen" UBYTE B_TRUE 1 100 0 1 BIT_MASK 0x80 FORMAT "%13.11" ECU_ADDRESS 0x8008D2 /end MEASUREMENT
/begin MEASUREMENT B_lsuft "LSU Bank1 fett, nicht plausibel" UBYTE B_TRUE 1 100 0 1 BIT_MASK 0x10 FORMAT "%13.11" ECU_ADDRESS 0x8008CE /end MEASUREMENT
/begin MEASUREMENT B_lsufta "LSU Bank1 fett, nicht plausibel" UBYTE B_TRUE 1 100 0 1 BIT_MASK 0x10 FORMAT "%13.11" ECU_ADDRESS 0x8008CF /end MEASUREMENT
/begin MEASUREMENT B_lsufta2 "LSU Bank2 fett, nicht plausibel" UBYTE B_TRUE 1 100 0 1 BIT_MASK 0x4 FORMAT "%13.11" ECU_ADDRESS 0x8008D5 /end MEASUREMENT
/begin MEASUREMENT B_lsuftb "LSU Bank1 fett, nicht plausibel" UBYTE B_TRUE 1 100 0 1 BIT_MASK 0x20 FORMAT "%13.11" ECU_ADDRESS 0x8008CF /end MEASUREMENT
/begin MEASUREMENT B_lsuftb2 "LSU Bank2 fett, nicht plausibel" UBYTE B_TRUE 1 100 0 1 BIT_MASK 0x8 FORMAT "%13.11" ECU_ADDRESS 0x8008D5 /end MEASUREMENT
/begin MEASUREMENT B_lsulone "Bedingung Lambdasondensignal ist Lambda = 1" UBYTE B_TRUE 1 100 0 1 BIT_MASK 0x40 FORMAT "%13.11" ECU_ADDRESS 0x8008CF /end MEASUREMENT
/begin MEASUREMENT B_lsulone2 "Bedingung Lambdasondensignal ist Lambda = 1, Bank 2" UBYTE B_TRUE 1 100 0 1 BIT_MASK 0x10 FORMAT "%13.11" ECU_ADDRESS 0x8008D5 /end MEASUREMENT
/begin MEASUREMENT B_lsultk "Bedingung ""LSU-an-Luft-Fehler"" ist mit ""Tank-Leer-Bedingung"" entprellt" UBYTE B_TRUE 1 100 0 1 BIT_MASK 0x20 FORMAT "%13.11" ECU_ADDRESS 0x8008D1 /end MEASUREMENT
/begin MEASUREMENT B_lsultk2 "Bedingung ""LSU-an-Luft-Fehler"" ist mit ""Tank-Leer-Bedingung"" entprellt, Bank 2" UBYTE B_TRUE 1 100 0 1 BIT_MASK 0x1 FORMAT "%13.11" ECU_ADDRESS 0x8008D6 /end MEASUREMENT
/begin MEASUREMENT B_lsumr "LSU Bank1 mager, nicht plausibel" UBYTE B_TRUE 1 100 0 1 BIT_MASK 0x20 FORMAT "%13.11" ECU_ADDRESS 0x8008D7 /end MEASUREMENT
/begin MEASUREMENT B_lsumr2 "LSU Bank2 mager, nicht plausibel" UBYTE B_TRUE 1 100 0 1 BIT_MASK 0x20 FORMAT "%13.11" ECU_ADDRESS 0x8008D3 /end MEASUREMENT
/begin MEASUREMENT B_lsumra "LSU Bank1 mager, nicht plausibel" UBYTE B_TRUE 1 100 0 1 BIT_MASK 0x80 FORMAT "%13.11" ECU_ADDRESS 0x8008CF /end MEASUREMENT
/begin MEASUREMENT B_lsumra2 "LSU Bank2 mager, nicht plausibel" UBYTE B_TRUE 1 100 0 1 BIT_MASK 0x20 FORMAT "%13.11" ECU_ADDRESS 0x8008D5 /end MEASUREMENT
/begin MEASUREMENT B_lsumrb "LSU Bank1 mager, nicht plausibel" UBYTE B_TRUE 1 100 0 1 BIT_MASK 0x1 FORMAT "%13.11" ECU_ADDRESS 0x8008D0 /end MEASUREMENT
/begin MEASUREMENT B_lsumrb2 "LSU Bank2 mager, nicht plausibel" UBYTE B_TRUE 1 100 0 1 BIT_MASK 0x80 FORMAT "%13.11" ECU_ADDRESS 0x8008D3 /end MEASUREMENT
/begin MEASUREMENT B_lsumx "Maximalwert der LSU-Spannung ¸berschritten (CJ110)" UBYTE B_TRUE 1 100 0 1 BIT_MASK 0x1 FORMAT "%13.11" ECU_ADDRESS 0x8008CE /end MEASUREMENT
/begin MEASUREMENT B_lsumx2 "Maximalwert der LSU2-Spannung ¸berschritten (CJ110)" UBYTE B_TRUE 1 100 0 1 BIT_MASK 0x40 FORMAT "%13.11" ECU_ADDRESS 0x8008D3 /end MEASUREMENT
/begin MEASUREMENT B_lsumxtk "Bedingung Max-Fehler ist mit ""Tank-Leer-Bedingung"" entprellt" UBYTE B_TRUE 1 100 0 1 BIT_MASK 0x10 FORMAT "%13.11" ECU_ADDRESS 0x8008D1 /end MEASUREMENT
/begin MEASUREMENT B_lsumxtk2 "Bedingung Max-Fehler ist mit ""Tank-Leer-Bedingung"" entprellt, Bank 2" UBYTE B_TRUE 1 100 0 1 BIT_MASK 0x80 FORMAT "%13.11" ECU_ADDRESS 0x8008D5 /end MEASUREMENT
/begin MEASUREMENT B_lsuna "LSU nicht aktiv, Bank1" UBYTE B_TRUE 1 100 0 1 BIT_MASK 0x10 FORMAT "%13.11" ECU_ADDRESS 0x8008D7 /end MEASUREMENT
/begin MEASUREMENT B_lsuna2 "LSU nicht aktiv, Bank2" UBYTE B_TRUE 1 100 0 1 BIT_MASK 0x10 FORMAT "%13.11" ECU_ADDRESS 0x8008D3 /end MEASUREMENT
/begin MEASUREMENT B_lsupft "Bedingung Lambdasondensignal plausibel fett" UBYTE B_TRUE 1 100 0 1 BIT_MASK 0x2 FORMAT "%13.11" ECU_ADDRESS 0x8008D0 /end MEASUREMENT
/begin MEASUREMENT B_lsupft2 "Bedingung Lambdasondensignal plausibel fett, Bank 2" UBYTE B_TRUE 1 100 0 1 BIT_MASK 0x80 FORMAT "%13.11" ECU_ADDRESS 0x8008D4 /end MEASUREMENT
/begin MEASUREMENT B_lsupmr "Bedingung Lambdasondensignal plausibel mager" UBYTE B_TRUE 1 100 0 1 BIT_MASK 0x4 FORMAT "%13.11" ECU_ADDRESS 0x8008D0 /end MEASUREMENT
/begin MEASUREMENT B_lsupmr2 "Bedingung Lambdasondensignal plausibel mager, Bank 2" UBYTE B_TRUE 1 100 0 1 BIT_MASK 0x40 FORMAT "%13.11" ECU_ADDRESS 0x8008D4 /end MEASUREMENT
/begin MEASUREMENT B_lsurfc "Bedingung: Resettiere Fehler Counter" UBYTE B_TRUE 1 100 0 1 BIT_MASK 0x8 FORMAT "%13.11" ECU_ADDRESS 0x8008D0 /end MEASUREMENT
/begin MEASUREMENT B_lsvdkt2 "Bedingung vorderer Lambdasondenfehler" UBYTE B_TRUE 1 100 0 1 BIT_MASK 0x40 FORMAT "%13.11" ECU_ADDRESS 0x800AE2 /end MEASUREMENT
/begin MEASUREMENT B_luft "LSU an Luft" UBYTE B_TRUE 1 100 0 1 BIT_MASK 0x80 FORMAT "%13.11" ECU_ADDRESS 0x8008CE /end MEASUREMENT
/begin MEASUREMENT B_luft2 "LSU 2 an Luft" UBYTE B_TRUE 1 100 0 1 BIT_MASK 0x2 FORMAT "%13.11" ECU_ADDRESS 0x8008D4 /end MEASUREMENT
/begin MEASUREMENT B_maxflsh "Kurzsschluﬂ nach UBatt bei Sonde hinter KAT erkannt" UBYTE B_TRUE 1 100 0 1 BIT_MASK 0x1 FORMAT "%13.11" ECU_ADDRESS 0x80118F /end MEASUREMENT
/begin MEASUREMENT B_maxflsh2 "Kurzsschluﬂ nach UBatt bei Sonde hinter KAT erkannt, Bank 2" UBYTE B_TRUE 1 100 0 1 BIT_MASK 0x2 FORMAT "%13.11" ECU_ADDRESS 0x80118F /end MEASUREMENT
/begin MEASUREMENT B_maxflsu "Lambdaoffset vor / hinter Kat zu groﬂ, Bank1" UBYTE B_TRUE 1 100 0 1 BIT_MASK 0x1 FORMAT "%13.11" ECU_ADDRESS 0x8008D7 /end MEASUREMENT
/begin MEASUREMENT B_maxflsu2 "Lambdaoffset vor / hinter Kat zu groﬂ, Bank2" UBYTE B_TRUE 1 100 0 1 BIT_MASK 0x1 FORMAT "%13.11" ECU_ADDRESS 0x8008D3 /end MEASUREMENT
/begin MEASUREMENT B_maxla "Maximalwert f¸r Schwingungs-Pr¸fung hinter KAT erkannt" UBYTE B_TRUE 1 100 0 1 BIT_MASK 0x4 FORMAT "%13.11" ECU_ADDRESS 0x801193 /end MEASUREMENT
/begin MEASUREMENT B_maxla2 "Maximalwert f¸r Schwingungs-Pr¸fung hinter KAT erkannt Bank2" UBYTE B_TRUE 1 100 0 1 BIT_MASK 0x40 FORMAT "%13.11" ECU_ADDRESS 0x801193 /end MEASUREMENT
/begin MEASUREMENT B_maxlash "Maximalwert f¸r Schwingungs-Pr¸fung hinter KAT erkannt" UBYTE B_TRUE 1 100 0 1 BIT_MASK 0x1 FORMAT "%13.11" ECU_ADDRESS 0x7FA74F /end MEASUREMENT
/begin MEASUREMENT B_maxlash2 "Maximalwert f¸r Schwingungs-Pr¸fung hinter KAT erkannt Bank2" UBYTE B_TRUE 1 100 0 1 BIT_MASK 0x1 FORMAT "%13.11" ECU_ADDRESS 0x7FA750 /end MEASUREMENT
/begin MEASUREMENT B_mdzyl1 "Zyl.-Kennung (f. Zeit>TALUST), LU-Berechng. gesperrt (f. Zeit<TALUST)" UBYTE B_TRUE 1 100 0 1 BIT_MASK 0x1 FORMAT "%13.11" ECU_ADDRESS 0x800E31 /end MEASUREMENT
/begin MEASUREMENT B_minflsh "Adernschluﬂ oder KS nach Masse bei Sonde  hinter KAT erkannt" UBYTE B_TRUE 1 100 0 1 BIT_MASK 0x4 FORMAT "%13.11" ECU_ADDRESS 0x80118F /end MEASUREMENT
/begin MEASUREMENT B_minflsh2 "Adernschluﬂ oder KS nach Masse bei Sonde hinter KAT erkannt Bank2" UBYTE B_TRUE 1 100 0 1 BIT_MASK 0x8 FORMAT "%13.11" ECU_ADDRESS 0x80118F /end MEASUREMENT
/begin MEASUREMENT B_minflsu "Dynamikfehler LSU, Bank1" UBYTE B_TRUE 1 100 0 1 BIT_MASK 0x2 FORMAT "%13.11" ECU_ADDRESS 0x8008D7 /end MEASUREMENT
/begin MEASUREMENT B_minflsu2 "Dynamikfehler LSU, Bank2" UBYTE B_TRUE 1 100 0 1 BIT_MASK 0x2 FORMAT "%13.11" ECU_ADDRESS 0x8008D3 /end MEASUREMENT
/begin MEASUREMENT B_minlash "Minimalwert f¸r Schwingungspr¸fung hinter KAT erkannt" UBYTE B_TRUE 1 100 0 1 BIT_MASK 0x1 FORMAT "%13.11" ECU_ADDRESS 0x7FA751 /end MEASUREMENT
/begin MEASUREMENT B_minlash2 "Minimalwert f¸r Schwingungspr¸fung hinter KAT erkannt Bank2" UBYTE B_TRUE 1 100 0 1 BIT_MASK 0x1 FORMAT "%13.11" ECU_ADDRESS 0x7FA752 /end MEASUREMENT
/begin MEASUREMENT B_mldkt "Bedingung Katdiagnose gesperrt wegen Motor-Luftmasse" UBYTE B_TRUE 1 100 0 1 BIT_MASK 0x1 FORMAT "%13.11" ECU_ADDRESS 0x800AE9 /end MEASUREMENT
/begin MEASUREMENT B_mldyn "Bedingung erforderliche Luftmasse im Schubbetrieb f¸r Dynamikmessung erreicht" UBYTE B_TRUE 1 100 0 1 BIT_MASK 0x1 FORMAT "%13.11" ECU_ADDRESS 0x7FA753 /end MEASUREMENT
/begin MEASUREMENT B_mlustest "Bedingung ml ist innerhalb den Schwellen" UBYTE B_TRUE 1 100 0 1 BIT_MASK 0x1 FORMAT "%13.11" ECU_ADDRESS 0x7FA754 /end MEASUREMENT
/begin MEASUREMENT B_noadsh "Bedingung kein Adernschluﬂ bei Lambdasonden hinter Kat" UBYTE B_TRUE 1 100 0 1 BIT_MASK 0x40 FORMAT "%13.11" ECU_ADDRESS 0x801190 /end MEASUREMENT
/begin MEASUREMENT B_noadsh2 "Bedingung kein Adernschluﬂ bei Lambdasonden hinter Kat Bank2" UBYTE B_TRUE 1 100 0 1 BIT_MASK 0x80 FORMAT "%13.11" ECU_ADDRESS 0x801190 /end MEASUREMENT
/begin MEASUREMENT B_noflsv "Bedingung: es liegt kein Fehler im Fehlerpfad LSV vor" UBYTE B_TRUE 1 100 0 1 BIT_MASK 0x2 FORMAT "%13.11" ECU_ADDRESS 0x8008CF /end MEASUREMENT
/begin MEASUREMENT B_noflsv2 "Bedingung: es liegt kein Fehler im Fehlerpfad LSV2 vor, Bank 2" UBYTE B_TRUE 1 100 0 1 BIT_MASK 0x10 FORMAT "%13.11" ECU_ADDRESS 0x8008D4 /end MEASUREMENT
/begin MEASUREMENT B_nolash "Bedingung Diagnosefunktion Schwingungs-Pr¸fung. i.O.-Meldung beendet." UBYTE B_TRUE 1 100 0 1 BIT_MASK 0x1 FORMAT "%13.11" ECU_ADDRESS 0x7FA755 /end MEASUREMENT
/begin MEASUREMENT B_nolash2 "Bedingung Diagnosefunktion Schwingungs-Pr¸fung. i.O.-Meldung beendet. Bank2" UBYTE B_TRUE 1 100 0 1 BIT_MASK 0x1 FORMAT "%13.11" ECU_ADDRESS 0x7FA756 /end MEASUREMENT
/begin MEASUREMENT B_nolsh "Bedingung Diagnosefunktion mit i.O.-Meldung hinter KAT beendet." UBYTE B_TRUE 1 100 0 1 BIT_MASK 0x1 FORMAT "%13.11" ECU_ADDRESS 0x7FA730 /end MEASUREMENT
/begin MEASUREMENT B_nolsh2 "Bedingung Diagnosefunktion mit i.O.-Meldung hinter KAT beendet Bank2" UBYTE B_TRUE 1 100 0 1 BIT_MASK 0x1 FORMAT "%13.11" ECU_ADDRESS 0x7FA731 /end MEASUREMENT
/begin MEASUREMENT B_norkam "Bedingung additive Korrektur der Adaption pro Zeit oder Z¸ndung abgeschaltet" UBYTE B_TRUE 1 100 0 1 BIT_MASK 0x1 FORMAT "%13.11" ECU_ADDRESS 0x7FA803 /end MEASUREMENT
/begin MEASUREMENT B_nplflsh "Adernschluﬂ bei Sonde hinter KAT erkannt" UBYTE B_TRUE 1 100 0 1 BIT_MASK 0x40 FORMAT "%13.11" ECU_ADDRESS 0x80118F /end MEASUREMENT
/begin MEASUREMENT B_nplflsh2 "Adernschluﬂ hinter KAT erkannt Bank2" UBYTE B_TRUE 1 100 0 1 BIT_MASK 0x80 FORMAT "%13.11" ECU_ADDRESS 0x80118F /end MEASUREMENT
/begin MEASUREMENT B_nplflsu "Lambdasignal nicht plausibel" UBYTE B_TRUE 1 100 0 1 BIT_MASK 0x4 FORMAT "%13.11" ECU_ADDRESS 0x7FC73A /end MEASUREMENT
/begin MEASUREMENT B_nplflsu2 "Lambdasignal nicht plausibel, Bank2" UBYTE B_TRUE 1 100 0 1 BIT_MASK 0x40 FORMAT "%13.11" ECU_ADDRESS 0x7FC73A /end MEASUREMENT
/begin MEASUREMENT B_npllash "Bedingung  ""nicht plausibler Wert"" f¸r Sonde hinter KAT" UBYTE B_TRUE 1 100 0 1 BIT_MASK 0x4 FORMAT "%13.11" ECU_ADDRESS 0x801194 /end MEASUREMENT
/begin MEASUREMENT B_npllash2 "Bedingung  ""nicht plausibler Wert"" f¸r Sonde hinter KAT Bank2" UBYTE B_TRUE 1 100 0 1 BIT_MASK 0x8 FORMAT "%13.11" ECU_ADDRESS 0x801194 /end MEASUREMENT
/begin MEASUREMENT B_npsna "Bedingung nicht plaus.: Sonde nicht aktiv" UBYTE B_TRUE 1 100 0 1 BIT_MASK 0x10 FORMAT "%13.11" ECU_ADDRESS 0x8008D0 /end MEASUREMENT
/begin MEASUREMENT B_npsna2 "Bedingung nicht plaus.: Sonde nicht aktiv, Bank2" UBYTE B_TRUE 1 100 0 1 BIT_MASK 0x8 FORMAT "%13.11" ECU_ADDRESS 0x8008D4 /end MEASUREMENT
/begin MEASUREMENT B_npvshns "Bedingung nicht plaus.: Gemisch vor dem Kat Lambda=1, hinter dem Kat nicht" UBYTE B_TRUE 1 100 0 1 BIT_MASK 0x20 FORMAT "%13.11" ECU_ADDRESS 0x8008D0 /end MEASUREMENT
/begin MEASUREMENT B_npvshns2 "Bedingung nicht plaus.: Gemisch vor dem Kat Lambda=1, hinter dem Kat nicht,Bank2" UBYTE B_TRUE 1 100 0 1 BIT_MASK 0x40 FORMAT "%13.11" ECU_ADDRESS 0x8008D5 /end MEASUREMENT
/begin MEASUREMENT B_plenvh "Freigabe DLSU Plauspfad" UBYTE B_TRUE 1 100 0 1 BIT_MASK 0x40 FORMAT "%13.11" ECU_ADDRESS 0x8008D0 /end MEASUREMENT
/begin MEASUREMENT B_plenvh2 "Freigabe DLSU Plauspfad 2" UBYTE B_TRUE 1 100 0 1 BIT_MASK 0x8 FORMAT "%13.11" ECU_ADDRESS 0x8008D2 /end MEASUREMENT
/begin MEASUREMENT B_plra "Bedingung f¸r Umschaltung DKVS von HFM- auf P-System" UBYTE B_TRUE 1 100 0 1 BIT_MASK 0x1 FORMAT "%13.11" ECU_ADDRESS 0x7FA804 /end MEASUREMENT
/begin MEASUREMENT B_readap "Reset der fuel-off Adaption" UBYTE B_TRUE 1 100 0 1 BIT_MASK 0x1 FORMAT "%13.11" ECU_ADDRESS 0x800E32 /end MEASUREMENT
/begin MEASUREMENT B_risigh "Bedingung Signalunterbrechung Sondenmasse mit Ri-Diagnose hinter KAT" UBYTE B_TRUE 1 100 0 1 BIT_MASK 0x1 FORMAT "%13.11" ECU_ADDRESS 0x7FA732 /end MEASUREMENT
/begin MEASUREMENT B_risigh2 "Bedingung Signalunterbrechung Sondenmasse mit Ri-Diagnose hinter KAT Bank2" UBYTE B_TRUE 1 100 0 1 BIT_MASK 0x1 FORMAT "%13.11" ECU_ADDRESS 0x7FA733 /end MEASUREMENT
/begin MEASUREMENT B_rkam "Bedingung einer der beiden additiven Bereiche aktiv" UBYTE B_TRUE 1 100 0 1 BIT_MASK 0x1 FORMAT "%13.11" ECU_ADDRESS 0x7FA805 /end MEASUREMENT
/begin MEASUREMENT B_rkamr "Bedingung rkat oder rkaz auﬂerhalb reduzierter Schwellen" UBYTE B_TRUE 1 100 0 1 BIT_MASK 0x1 FORMAT "%13.11" ECU_ADDRESS 0x7FA806 /end MEASUREMENT
/begin MEASUREMENT B_rkamr2 "Bedingung rkat2 oder rkaz2 auﬂerhalb reduzierter Schwellen" UBYTE B_TRUE 1 100 0 1 BIT_MASK 0x1 FORMAT "%13.11" ECU_ADDRESS 0x7FA807 /end MEASUREMENT
/begin MEASUREMENT B_sbbhk "Bedingung Sonde betriebsbereit hinter Kat" UBYTE B_TRUE 1 100 0 1 BIT_MASK 0x1 FORMAT "%13.11" ECU_ADDRESS 0x7FA734 /end MEASUREMENT
/begin MEASUREMENT B_sbbhk2 "Bedingung Sonde betriebsbereit hinter Kat Bank2" UBYTE B_TRUE 1 100 0 1 BIT_MASK 0x1 FORMAT "%13.11" ECU_ADDRESS 0x7FA735 /end MEASUREMENT
/begin MEASUREMENT B_sbbhku "Bedingung umgeschaltete Betriebsbereitschaft der hinteren Sonde" UBYTE B_TRUE 1 100 0 1 BIT_MASK 0x1 FORMAT "%13.11" ECU_ADDRESS 0x800AE2 /end MEASUREMENT
/begin MEASUREMENT B_sigflsh "Signalunterbrechung (Kabelbruch) Bei Sonde hinter KAT erkannt" UBYTE B_TRUE 1 100 0 1 BIT_MASK 0x10 FORMAT "%13.11" ECU_ADDRESS 0x80118F /end MEASUREMENT
/begin MEASUREMENT B_sigflsh2 "Signalunterbrechung (Kabelbruch) bei Sonde hinter KAT erkannt Bank2" UBYTE B_TRUE 1 100 0 1 BIT_MASK 0x20 FORMAT "%13.11" ECU_ADDRESS 0x80118F /end MEASUREMENT
/begin MEASUREMENT B_sigflsu "‹bersprechen vom Heizertakt auf Lambdasignal" UBYTE B_TRUE 1 100 0 1 BIT_MASK 0x4 FORMAT "%13.11" ECU_ADDRESS 0x8008D7 /end MEASUREMENT
/begin MEASUREMENT B_sigflsu2 "‹bersprechen vom Heizertakt auf Lambdasignal, Bank2" UBYTE B_TRUE 1 100 0 1 BIT_MASK 0x4 FORMAT "%13.11" ECU_ADDRESS 0x8008D3 /end MEASUREMENT
/begin MEASUREMENT B_siglash "Bedingung Sonden-Fehler hinter KAT im Schub erkannt" UBYTE B_TRUE 1 100 0 1 BIT_MASK 0x1 FORMAT "%13.11" ECU_ADDRESS 0x801194 /end MEASUREMENT
/begin MEASUREMENT B_siglash2 "Sonden-Fehler hinter KAT im Schub und Vollast erkannt. Bank2" UBYTE B_TRUE 1 100 0 1 BIT_MASK 0x2 FORMAT "%13.11" ECU_ADDRESS 0x801194 /end MEASUREMENT
/begin MEASUREMENT B_stcal "Bedingung: alle Eingangsbedingungen der Dynamikpr¸fung sind gegeben" UBYTE B_TRUE 1 100 0 1 BIT_MASK 0x1 FORMAT "%13.11" ECU_ADDRESS 0x7FA6F2 /end MEASUREMENT
/begin MEASUREMENT B_stcal2 "Bedingung: alle Eingangsbedingungen der Dynamikpr¸fung sind gegeben, Bank2" UBYTE B_TRUE 1 100 0 1 BIT_MASK 0x1 FORMAT "%13.11" ECU_ADDRESS 0x7FA6F3 /end MEASUREMENT
/begin MEASUREMENT B_stcdyn "Bedingung Start Berechnung Dynamik der LSU" UBYTE B_TRUE 1 100 0 1 BIT_MASK 0x4 FORMAT "%13.11" ECU_ADDRESS 0x8008D1 /end MEASUREMENT
/begin MEASUREMENT B_stcdyn2 "Bedingung Start Berechnung Dynamik der LSU, Bank 2" UBYTE B_TRUE 1 100 0 1 BIT_MASK 0x20 FORMAT "%13.11" ECU_ADDRESS 0x8008D2 /end MEASUREMENT
/begin MEASUREMENT B_steigm "Bedingung Steigung des Sondensignals messen hinter KAT" UBYTE B_TRUE 1 100 0 1 BIT_MASK 0x1 FORMAT "%13.11" ECU_ADDRESS 0x7FA757 /end MEASUREMENT
/begin MEASUREMENT B_steigm2 "Bedingung Steigung des Sondensignals messen Bank2" UBYTE B_TRUE 1 100 0 1 BIT_MASK 0x1 FORMAT "%13.11" ECU_ADDRESS 0x7FA758 /end MEASUREMENT
/begin MEASUREMENT B_teslash "Bedingung Test ausf¸hren f¸r ‹berpr¸fung Sonde hinter KAT" UBYTE B_TRUE 1 100 0 1 BIT_MASK 0x1 FORMAT "%13.11" ECU_ADDRESS 0x7FA759 /end MEASUREMENT
/begin MEASUREMENT B_teslash2 "Bedingung Test ausf¸hren f¸r ‹berpr¸fung Sonde hinter KAT Bank2" UBYTE B_TRUE 1 100 0 1 BIT_MASK 0x1 FORMAT "%13.11" ECU_ADDRESS 0x7FA75A /end MEASUREMENT
/begin MEASUREMENT B_tmsdkt "Bedingung Katdiagnose gesperrt wg. zu kleiner Motorstart-Temperatur" UBYTE B_TRUE 1 100 0 1 BIT_MASK 0x80 FORMAT "%13.11" ECU_ADDRESS 0x800AE4 /end MEASUREMENT
/begin MEASUREMENT b_tm_reg "Tempomatregler aktiv" UBYTE DC_FLAG_U8 1 100 0 1 BIT_MASK 0x1 FORMAT "%5.3" ECU_ADDRESS 0x803861 /end MEASUREMENT
/begin MEASUREMENT B_trfash "Bedingung Kurztrip einleiten f¸r Schwingungspr¸fung Sonde hinter KAT" UBYTE B_TRUE 1 100 0 1 BIT_MASK 0x1 FORMAT "%13.11" ECU_ADDRESS 0x7FA75B /end MEASUREMENT
/begin MEASUREMENT B_trfash2 "Bedingung Kurztrip einleiten f¸r Schwingungspr¸fung Sonde hinter KAT Bank2" UBYTE B_TRUE 1 100 0 1 BIT_MASK 0x1 FORMAT "%13.11" ECU_ADDRESS 0x7FA75C /end MEASUREMENT
/begin MEASUREMENT B_trsah "Bedingung Kabelbruch f¸r Sonde hinter KAT" UBYTE B_TRUE 1 100 0 1 BIT_MASK 0x4 FORMAT "%13.11" ECU_ADDRESS 0x801190 /end MEASUREMENT
/begin MEASUREMENT B_trsah2 "Bedingung Kabelbruch f¸r Sonde hinter KAT, Bank 2" UBYTE B_TRUE 1 100 0 1 BIT_MASK 0x8 FORMAT "%13.11" ECU_ADDRESS 0x801190 /end MEASUREMENT
/begin MEASUREMENT B_ttbmhh "Bedingung theoretische Sondenbetriebsbereitschaft hinter KAT mit Heizung" UBYTE B_TRUE 1 100 0 1 BIT_MASK 0x1 FORMAT "%13.11" ECU_ADDRESS 0x7FA736 /end MEASUREMENT
/begin MEASUREMENT B_ttbmhh2 "Bedingung theoretische Sondenbetriebsbereitschaft hinter KAT mit Heizung Bank2" UBYTE B_TRUE 1 100 0 1 BIT_MASK 0x1 FORMAT "%13.11" ECU_ADDRESS 0x7FA737 /end MEASUREMENT
/begin MEASUREMENT B_uhsig "Bedingung Sondenspannung hinter KAT im Spannungsband f¸r Signalunterbrechung" UBYTE B_TRUE 1 100 0 1 BIT_MASK 0x1 FORMAT "%13.11" ECU_ADDRESS 0x801190 /end MEASUREMENT
/begin MEASUREMENT B_uhsig2 "Bedingung Sondenspg. hinter KAT im Spannungsband f¸r Signalunterbrechung Bank2" UBYTE B_TRUE 1 100 0 1 BIT_MASK 0x2 FORMAT "%13.11" ECU_ADDRESS 0x801190 /end MEASUREMENT
/begin MEASUREMENT B_unpcf "Bedingung Wackelkontakt an Leitung UN der LSU" UBYTE B_TRUE 1 100 0 1 BIT_MASK 0x80 FORMAT "%13.11" ECU_ADDRESS 0x8008D0 /end MEASUREMENT
/begin MEASUREMENT B_unpcf2 "Bedingung Wackelkontakt an Leitung UN der LSU, Bank 2" UBYTE B_TRUE 1 100 0 1 BIT_MASK 0x2 FORMAT "%13.11" ECU_ADDRESS 0x8008D2 /end MEASUREMENT
/begin MEASUREMENT B_uscherf "Bedingung Messung Sondenspannung hinter KAT f¸r Schubmessung erf¸llt" UBYTE B_TRUE 1 100 0 1 BIT_MASK 0x1 FORMAT "%13.11" ECU_ADDRESS 0x801193 /end MEASUREMENT
/begin MEASUREMENT B_uscherf2 "Bedingung Messung Sondenspannung f¸r hinter Kat Schubmessung erf¸llt Bank2" UBYTE B_TRUE 1 100 0 1 BIT_MASK 0x10 FORMAT "%13.11" ECU_ADDRESS 0x801193 /end MEASUREMENT
/begin MEASUREMENT B_ushkf "Bedingung Sondenspannung hinter Kat ""Fett"" (Sollwert ¸berschritten)" UBYTE B_TRUE 1 100 0 1 BIT_MASK 0x1 FORMAT "%13.11" ECU_ADDRESS 0x7FA75D /end MEASUREMENT
/begin MEASUREMENT B_ushkf2 "Bedingung Sondenspannung hinter KAT ""Fett"" (Sollwert ¸berschritten) Bank2" UBYTE B_TRUE 1 100 0 1 BIT_MASK 0x1 FORMAT "%13.11" ECU_ADDRESS 0x7FA75E /end MEASUREMENT
/begin MEASUREMENT B_ushkm "Bedingung Sondenspannung hinter KAT ""Mager"" (Sollwert unterschritten)" UBYTE B_TRUE 1 100 0 1 BIT_MASK 0x1 FORMAT "%13.11" ECU_ADDRESS 0x7FA75F /end MEASUREMENT
/begin MEASUREMENT B_ushkm2 "Bedingung Sondenspannung hinter KAT ""Mager"" (Sollwert unterschritten) Bank2" UBYTE B_TRUE 1 100 0 1 BIT_MASK 0x1 FORMAT "%13.11" ECU_ADDRESS 0x7FA760 /end MEASUREMENT
/begin MEASUREMENT B_ushkrfm "Bedingung f¸r Wiederholungsmessung Schwingungspr. h. KAT (Reset F/M -Flip-Flop)" UBYTE B_TRUE 1 100 0 1 BIT_MASK 0x8 FORMAT "%13.11" ECU_ADDRESS 0x801192 /end MEASUREMENT
/begin MEASUREMENT B_ushkrfm2 "Bedingung f¸r Wiederholungsmessung Schwingungspr. (Reset F/M -Flip-Flop) Bank2" UBYTE B_TRUE 1 100 0 1 BIT_MASK 0x80 FORMAT "%13.11" ECU_ADDRESS 0x801192 /end MEASUREMENT
/begin MEASUREMENT B_ushkvl "Bed. Schwelle f¸r Sonde h. KAT bei Vollast nicht ¸berschritten `statichisch`" UBYTE B_TRUE 1 100 0 1 BIT_MASK 0x40 FORMAT "%13.11" ECU_ADDRESS 0x7FC758 /end MEASUREMENT
/begin MEASUREMENT B_ushkvl2 "Bed. Schwelle f¸r Sonde h. KAT bei Vollast nicht ¸berschr.  `statichisch` Bank2" UBYTE B_TRUE 1 100 0 1 BIT_MASK 0x80 FORMAT "%13.11" ECU_ADDRESS 0x7FC758 /end MEASUREMENT
/begin MEASUREMENT B_ushsch "Bed. Schwelle f¸r Sonde h. KAT im Schub nicht unterschritten `statichisch`" UBYTE B_TRUE 1 100 0 1 BIT_MASK 0x4 FORMAT "%13.11" ECU_ADDRESS 0x7FC758 /end MEASUREMENT
/begin MEASUREMENT B_ushsch2 "Bed. Schwelle f¸r Sonde h. KAT im Schub nicht unterschritten `statisch` Bank2" UBYTE B_TRUE 1 100 0 1 BIT_MASK 0x8 FORMAT "%13.11" ECU_ADDRESS 0x7FC758 /end MEASUREMENT
/begin MEASUREMENT B_usrhkmx "Bedingung f¸r fehlerhafte Sonden hinter KAT nach abgeschlossenem Test" UBYTE B_TRUE 1 100 0 1 BIT_MASK 0x10 FORMAT "%13.11" ECU_ADDRESS 0x7FC758 /end MEASUREMENT
/begin MEASUREMENT B_usrhkmx2 "Bedingung f¸r fehlerhafte Sonden hinter KAT nach abgeschlossenem Test Bank2" UBYTE B_TRUE 1 100 0 1 BIT_MASK 0x20 FORMAT "%13.11" ECU_ADDRESS 0x7FC758 /end MEASUREMENT
/begin MEASUREMENT B_vekat "Fehlerverdacht bei Katdiagnose" UBYTE B_TRUE 1 100 0 1 BIT_MASK 0x1 FORMAT "%13.11" ECU_ADDRESS 0x7FC766 /end MEASUREMENT
/begin MEASUREMENT B_vekat2 "Fehlerverdacht bei Katdiagnose, Bank2" UBYTE B_TRUE 1 100 0 1 BIT_MASK 0x2 FORMAT "%13.11" ECU_ADDRESS 0x7FC766 /end MEASUREMENT
/begin MEASUREMENT B_vekati "Interner Fehlerverdacht bei Katdiagnose" UBYTE B_TRUE 1 100 0 1 BIT_MASK 0x10 FORMAT "%13.11" ECU_ADDRESS 0x800AE6 /end MEASUREMENT
/begin MEASUREMENT B_vekati2 "Interner Fehlerverdacht bei Katdiagnose, Bank2" UBYTE B_TRUE 1 100 0 1 BIT_MASK 0x20 FORMAT "%13.11" ECU_ADDRESS 0x800AE6 /end MEASUREMENT
/begin MEASUREMENT B_vlsuftb "Bedingung: LSU hat Kennlinienverschiebung nach fett (zeigt zu fett an)" UBYTE B_TRUE 1 100 0 1 BIT_MASK 0x2 FORMAT "%13.11" ECU_ADDRESS 0x7FC73A /end MEASUREMENT
/begin MEASUREMENT B_vlsuftb2 "Bedingung: LSU hat Kennlinienverschiebung nach fett (zeigt zu fett an) (B2)" UBYTE B_TRUE 1 100 0 1 BIT_MASK 0x20 FORMAT "%13.11" ECU_ADDRESS 0x7FC73A /end MEASUREMENT
/begin MEASUREMENT B_vlsumrb "Bedingung: LSU hat Kennlinienverschiebung nach mager (zeigt zu mager an)" UBYTE B_TRUE 1 100 0 1 BIT_MASK 0x1 FORMAT "%13.11" ECU_ADDRESS 0x7FC73A /end MEASUREMENT
/begin MEASUREMENT B_vlsumrb2 "Bedingung: LSU hat Kennlinienverschiebung nach mager (zeigt zu mager an) (B2)" UBYTE B_TRUE 1 100 0 1 BIT_MASK 0x10 FORMAT "%13.11" ECU_ADDRESS 0x7FC73A /end MEASUREMENT
/begin MEASUREMENT B_vmpcf "Bedingung Wackelkontakt an Leitung VM der LSU" UBYTE B_TRUE 1 100 0 1 BIT_MASK 0x1 FORMAT "%13.11" ECU_ADDRESS 0x8008D1 /end MEASUREMENT
/begin MEASUREMENT B_vmpcf2 "Bedingung Wackelkontakt an Leitung VM der LSU, Bank 2" UBYTE B_TRUE 1 100 0 1 BIT_MASK 0x4 FORMAT "%13.11" ECU_ADDRESS 0x8008D2 /end MEASUREMENT
/begin MEASUREMENT B_zdkt "Bedingung: Katdiagnose: Gutpr¸fung" UBYTE B_TRUE 1 100 0 1 BIT_MASK 0x10 FORMAT "%13.11" ECU_ADDRESS 0x800AE9 /end MEASUREMENT
/begin MEASUREMENT B_zdkt2 "Bedingung: Katdiagnose: Gutpr¸fung" UBYTE B_TRUE 1 100 0 1 BIT_MASK 0x8 FORMAT "%13.11" ECU_ADDRESS 0x800AE4 /end MEASUREMENT
/begin MEASUREMENT B_zfrao "wenn gleich TRUE, dann ist FRAO gepr¸ft" UBYTE B_TRUE 1 100 0 1 BIT_MASK 0x4 FORMAT "%13.11" ECU_ADDRESS 0x800C19 /end MEASUREMENT
/begin MEASUREMENT B_zfrao2 "wenn gleich TRUE, dann ist FRAO2 gepr¸ft" UBYTE B_TRUE 1 100 0 1 BIT_MASK 0x80 FORMAT "%13.11" ECU_ADDRESS 0x800C19 /end MEASUREMENT
/begin MEASUREMENT B_zfrau "wenn gleich TRUE, dann ist FRAU gepr¸ft" UBYTE B_TRUE 1 100 0 1 BIT_MASK 0x2 FORMAT "%13.11" ECU_ADDRESS 0x800C19 /end MEASUREMENT
/begin MEASUREMENT B_zfrau2 "wenn gleich TRUE, dann ist FRAU2 gepr¸ft" UBYTE B_TRUE 1 100 0 1 BIT_MASK 0x40 FORMAT "%13.11" ECU_ADDRESS 0x800C19 /end MEASUREMENT
/begin MEASUREMENT B_zkat "Bedingung: Zyklusflag setzen, Katdiagnose" UBYTE B_TRUE 1 100 0 1 BIT_MASK 0x20 FORMAT "%13.11" ECU_ADDRESS 0x800AE9 /end MEASUREMENT
/begin MEASUREMENT B_zkat2 "Bedingung: Zyklusflag setzen, Katdiagnose" UBYTE B_TRUE 1 100 0 1 BIT_MASK 0x10 FORMAT "%13.11" ECU_ADDRESS 0x800AE4 /end MEASUREMENT
/begin MEASUREMENT B_zlshv "Hilfsbit zur Auswertung des Zyklusbits Z_lsfhv f¸r Vertausch. Sonde h. F/H-Kat" UBYTE B_TRUE 1 100 0 1 BIT_MASK 0x8 FORMAT "%13.11" ECU_ADDRESS 0x801191 /end MEASUREMENT
/begin MEASUREMENT B_zlshv2 "Hilfsbit zur Auswertung des Zyklusbits Z_lshv2 f¸r Sonde hinter Kat  Bank2" UBYTE B_TRUE 1 100 0 1 BIT_MASK 0x20 FORMAT "%13.11" ECU_ADDRESS 0x801191 /end MEASUREMENT
/begin MEASUREMENT B_zrkat "wenn gleich TRUE, dann ist RKAT gepr¸ft" UBYTE B_TRUE 1 100 0 1 BIT_MASK 0x8 FORMAT "%13.11" ECU_ADDRESS 0x800C19 /end MEASUREMENT
/begin MEASUREMENT B_zrkat2 "wenn gleich TRUE, dann ist RKAT2 gepr¸ft" UBYTE B_TRUE 1 100 0 1 BIT_MASK 0x1 FORMAT "%13.11" ECU_ADDRESS 0x800C18 /end MEASUREMENT
/begin MEASUREMENT B_zrkaz "wenn gleich TRUE, dann ist RKAZ gepr¸ft" UBYTE B_TRUE 1 100 0 1 BIT_MASK 0x10 FORMAT "%13.11" ECU_ADDRESS 0x800C19 /end MEASUREMENT
/begin MEASUREMENT B_zrkaz2 "wenn gleich TRUE, dann ist RKAZ2 gepr¸ft" UBYTE B_TRUE 1 100 0 1 BIT_MASK 0x2 FORMAT "%13.11" ECU_ADDRESS 0x800C18 /end MEASUREMENT
/begin MEASUREMENT B_zylind "zeigt, ob zylinderindividuelles (1) oder segmentweises (0) Lernen (nur fuel-off)" UBYTE B_TRUE 1 100 0 1 BIT_MASK 0x1 FORMAT "%13.11" ECU_ADDRESS 0x800675 /end MEASUREMENT
/begin MEASUREMENT cfof "zeigt die Eigenschaften des aktuellen KF-Bereiches der Fuel-off Adaption" UBYTE dez 1 100 0 255 FORMAT "%5.1" ECU_ADDRESS 0x80067A /end MEASUREMENT
/begin MEASUREMENT Crash_Mode "" UBYTE DC_FLAG_U8 1 100 0 1 BIT_MASK 0x1 FORMAT "%5.3" ECU_ADDRESS 0x80386F /end MEASUREMENT
/begin MEASUREMENT CrsCtrl_Engaged "" UBYTE DC_FLAG_U8 1 100 0 1 BIT_MASK 0x1 FORMAT "%5.3" ECU_ADDRESS 0x80386B /end MEASUREMENT
/begin MEASUREMENT CylCutoffEnabl "" UBYTE DC_FLAG_U8 1 100 0 1 BIT_MASK 0x1 FORMAT "%5.3" ECU_ADDRESS 0x803867 /end MEASUREMENT
/begin MEASUREMENT Cyl_FIRate_Corr "" UWORD DC_FIRATE_CORR_U16 1 100 0 0.399993 FORMAT "%12.10" ECU_ADDRESS 0x803296 /end MEASUREMENT
/begin MEASUREMENT dkatspBits1_200ms "" UBYTE dez 1 100 0 255 FORMAT "%5.1" ECU_ADDRESS 0x800AE2 /end MEASUREMENT
/begin MEASUREMENT dkatspBits1_20ms "" UBYTE dez 1 100 0 255 FORMAT "%5.1" ECU_ADDRESS 0x800AE3 /end MEASUREMENT
/begin MEASUREMENT dkatspBits1_50ms "" UBYTE dez 1 100 0 255 FORMAT "%5.1" ECU_ADDRESS 0x800AE4 /end MEASUREMENT
/begin MEASUREMENT dkatspBits2_20ms "" UBYTE dez 1 100 0 255 FORMAT "%5.1" ECU_ADDRESS 0x800AE5 /end MEASUREMENT
/begin MEASUREMENT dkatspBits2_50ms "" UBYTE dez 1 100 0 255 FORMAT "%5.1" ECU_ADDRESS 0x800AE6 /end MEASUREMENT
/begin MEASUREMENT dkatspBits3_50ms "" UBYTE dez 1 100 0 255 FORMAT "%5.1" ECU_ADDRESS 0x7FC766 /end MEASUREMENT
/begin MEASUREMENT dkatspBits_200ms "" UBYTE dez 1 100 0 255 FORMAT "%5.1" ECU_ADDRESS 0x800AE7 /end MEASUREMENT
/begin MEASUREMENT dkatspBits_20ms "" UBYTE dez 1 100 0 255 FORMAT "%5.1" ECU_ADDRESS 0x800AE8 /end MEASUREMENT
/begin MEASUREMENT dkatspBits_50ms "" UBYTE dez 1 100 0 255 FORMAT "%5.1" ECU_ADDRESS 0x800AE9 /end MEASUREMENT
/begin MEASUREMENT DKVS1lokbits "" UBYTE dez 1 100 0 255 FORMAT "%5.1" ECU_ADDRESS 0x800C18 /end MEASUREMENT
/begin MEASUREMENT DKVSbits "" UBYTE dez 1 100 0 255 FORMAT "%5.1" ECU_ADDRESS 0x7FC7B2 /end MEASUREMENT
/begin MEASUREMENT DKVSlokbits "" UBYTE dez 1 100 0 255 FORMAT "%5.1" ECU_ADDRESS 0x800C19 /end MEASUREMENT
/begin MEASUREMENT dlahisa "I-Anteil LRSHK Signalausgabe DLSSA (SY_STETLR := TRUE), Bank 1" UBYTE fak_ub_b0p1_o0p05 1 100 -0.05 0.0496094 FORMAT "%7.5" ECU_ADDRESS 0x8008B8 /end MEASUREMENT
/begin MEASUREMENT dlahisa2 "I-Anteil LRSHK Signalausgabe DLSSA (SY_STETLR := TRUE), Bank 2" UBYTE fak_ub_b0p1_o0p05 1 100 -0.05 0.0496094 FORMAT "%7.5" ECU_ADDRESS 0x8008B9 /end MEASUREMENT
/begin MEASUREMENT dlams2_w "Maximalwert Lambdasoll f¸r Test Schwingungspr¸fung hinter KAT Bank2" UWORD fak_uw_b16 1 100 0 15.9998 FORMAT "%8.5" ECU_ADDRESS 0x800A74 /end MEASUREMENT
/begin MEASUREMENT dlams_w "Maximalwert Lambdasoll f¸r Test Schwingungspr¸fung hinter KAT" UWORD fak_uw_b16 1 100 0 15.9998 FORMAT "%8.5" ECU_ADDRESS 0x800A76 /end MEASUREMENT
/begin MEASUREMENT DLSHerrors "" UBYTE dez 1 100 0 255 FORMAT "%5.1" ECU_ADDRESS 0x80118F /end MEASUREMENT
/begin MEASUREMENT DLSHintbits "" UBYTE dez 1 100 0 255 FORMAT "%5.1" ECU_ADDRESS 0x801190 /end MEASUREMENT
/begin MEASUREMENT DLSHintbits2 "" UBYTE dez 1 100 0 255 FORMAT "%5.1" ECU_ADDRESS 0x801191 /end MEASUREMENT
/begin MEASUREMENT DLSUausbitsNOV1 "" UBYTE dez 1 100 0 255 FORMAT "%5.1" ECU_ADDRESS 0x7FC73A /end MEASUREMENT
/begin MEASUREMENT dlursalt_f "" FLOAT32_IEEE fak_r32_1 1 100 -1e+037 1e+037 FORMAT "%43.4" ECU_ADDRESS 0x7F8E8C /end MEASUREMENT
/begin MEASUREMENT dlurs_f "Laufunruhedifferenz-Referenzwert, signed" FLOAT32_IEEE fak_r32_1 1 100 -1e+037 1e+037 FORMAT "%43.4" ECU_ADDRESS 0x7F8E90 /end MEASUREMENT
/begin MEASUREMENT dmrdkt_w "Momenten-Reserve f¸r Katalysatordiagnose" UWORD rel_uw_b100 1 100 0 99.9985 FORMAT "%8.5" ECU_ADDRESS 0x800A84 /end MEASUREMENT
/begin MEASUREMENT dmrlash_w "Momenten-Reserve f¸r Lambdasonden-Alterungs¸berwachung hinter Kat" UWORD rel_uw_b100 1 100 0 99.9985 FORMAT "%8.5" ECU_ADDRESS 0x800A78 /end MEASUREMENT
/begin MEASUREMENT dmrlsh_w "Momenten-Reserve f¸r Sondendiagnose hinter Kat" UWORD rel_uw_b100 1 100 0 99.9985 FORMAT "%8.5" ECU_ADDRESS 0x8009D2 /end MEASUREMENT
/begin MEASUREMENT dmrlsv_w "Momenten-Reserve f¸r Sondendiagnose vor Kat" UWORD rel_uw_b100 1 100 0 99.9985 FORMAT "%8.5" ECU_ADDRESS 0x8008E0 /end MEASUREMENT
/begin MEASUREMENT drdfh "DR-Fehlerbyte Raddrehzahlen hinten" UBYTE DC_CNTR_U8 1 100 0 255 FORMAT "%5.1" ECU_ADDRESS 0x7FC868 /end MEASUREMENT
/begin MEASUREMENT drdfv "DR-Fehlerbyte Raddrehzahlen vorne" UBYTE DC_CNTR_U8 1 100 0 255 FORMAT "%5.1" ECU_ADDRESS 0x7FC86A /end MEASUREMENT
/begin MEASUREMENT drpblserr "DauerRam undifiniertes Bremslichtsignal" UBYTE DC_CNTR_U8 1 100 0 255 FORMAT "%5.1" ECU_ADDRESS 0x7FC85F /end MEASUREMENT
/begin MEASUREMENT drpblspar "DauerRam Parity-Fehler Bremslichtsignal" UBYTE DC_CNTR_U8 1 100 0 255 FORMAT "%5.1" ECU_ADDRESS 0x7FC865 /end MEASUREMENT
/begin MEASUREMENT drpblstog "DauerRam Toggle-Fehler Bremslichtschalter" UBYTE DC_CNTR_U8 1 100 0 255 FORMAT "%5.1" ECU_ADDRESS 0x7FC86C /end MEASUREMENT
/begin MEASUREMENT drswe "Fehlerspeicher Dauer-RAM: Beschl.-Signal Schlechtwegerk." UBYTE DC_CNTR_U8 1 100 0 255 FORMAT "%5.1" ECU_ADDRESS 0x7FC869 /end MEASUREMENT
/begin MEASUREMENT dr_ehbpar "Parityfehler EHB-Anforderung Leerlaufdrehzahlanhebung" UBYTE DC_CNTR_U8 1 100 0 255 FORMAT "%5.1" ECU_ADDRESS 0x7FC867 /end MEASUREMENT
/begin MEASUREMENT dr_ehbtgl "Togglefehler EHB-Anforderung Leerlaufdrehzahlanhebung" UBYTE DC_CNTR_U8 1 100 0 255 FORMAT "%5.1" ECU_ADDRESS 0x7FC866 /end MEASUREMENT
/begin MEASUREMENT dr_ehbumg "Unzul‰ssige Umgebungsbedingungen EHB-Anforderung Leerlaufdrehzahlanhebung" UBYTE DC_CNTR_U8 1 100 0 255 FORMAT "%5.1" ECU_ADDRESS 0x7FC864 /end MEASUREMENT
/begin MEASUREMENT dr_partmma "Fehlerbyte MIN/MAX-Anforderung ART-Plausibilisierung" UBYTE DC_CNTR_U8 1 100 0 255 FORMAT "%5.1" ECU_ADDRESS 0x7FC860 /end MEASUREMENT
/begin MEASUREMENT dr_partpar "Fehlerbyte Parity ART-Plausibilisierung" UBYTE DC_CNTR_U8 1 100 0 255 FORMAT "%5.1" ECU_ADDRESS 0x7FC862 /end MEASUREMENT
/begin MEASUREMENT dr_parttgl "Fehlerbyte Toggle ART-Plausibilisierung" UBYTE DC_CNTR_U8 1 100 0 255 FORMAT "%5.1" ECU_ADDRESS 0x7FC86D /end MEASUREMENT
/begin MEASUREMENT dr_pegsmma "Fehlerbyte MIN/MAX-Anforderung EGS_Plausibilisierung" UBYTE DC_CNTR_U8 1 100 0 255 FORMAT "%5.1" ECU_ADDRESS 0x7FC85D /end MEASUREMENT
/begin MEASUREMENT dr_pegspar "Fehlerbyte Parity EGS-Plausibilisierung" UBYTE DC_CNTR_U8 1 100 0 255 FORMAT "%5.1" ECU_ADDRESS 0x7FC86B /end MEASUREMENT
/begin MEASUREMENT dr_pegstgl "Fehlerbyte Toggle EGS-Plausibilisierung" UBYTE DC_CNTR_U8 1 100 0 255 FORMAT "%5.1" ECU_ADDRESS 0x7FC85C /end MEASUREMENT
/begin MEASUREMENT dr_pespesp "Fehlerbyte ESP/ASR-Status ESP-Plausibilisierung" UBYTE DC_CNTR_U8 1 100 0 255 FORMAT "%5.1" ECU_ADDRESS 0x7FC863 /end MEASUREMENT
/begin MEASUREMENT dr_pespmma "Fehlerbyte MIN/MAX-Anforderung ESP-Plausibilisierung" UBYTE DC_CNTR_U8 1 100 0 255 FORMAT "%5.1" ECU_ADDRESS 0x7FC85E /end MEASUREMENT
/begin MEASUREMENT dr_pesppar "Fehlerbyte Parity ESP-Plausibilisierung" UBYTE DC_CNTR_U8 1 100 0 255 FORMAT "%5.1" ECU_ADDRESS 0x7FC861 /end MEASUREMENT
/begin MEASUREMENT dr_pesptgl "Fehlerbyte Toggle ESP-Plausibilisierung" UBYTE DC_CNTR_U8 1 100 0 255 FORMAT "%5.1" ECU_ADDRESS 0x7FC86E /end MEASUREMENT
/begin MEASUREMENT dynlsu2_w "Dynamikwert der LSU, Bank 2" UWORD fak_uw_b16 1 100 0 15.9998 FORMAT "%8.5" ECU_ADDRESS 0x7FC73E /end MEASUREMENT
/begin MEASUREMENT dynlsusa "Dynamikwert der LSU, DLSSA" UBYTE fak_q0p0195 1 100 0 4.98047 FORMAT "%5.3" ECU_ADDRESS 0x8008BA /end MEASUREMENT
/begin MEASUREMENT dynlsusa2 "Dynamikwert der LSU, DLSSA Bank 2" UBYTE fak_q0p0195 1 100 0 4.98047 FORMAT "%5.3" ECU_ADDRESS 0x8008BB /end MEASUREMENT
/begin MEASUREMENT dynlsu_w "Dynamikwert der LSU" UWORD fak_uw_b16 1 100 0 15.9998 FORMAT "%8.5" ECU_ADDRESS 0x7FC740 /end MEASUREMENT
/begin MEASUREMENT ECU_GearRatio_HighLim_Req "" UBYTE DC_FCTR_50_U8 1 100 0 5.1 FORMAT "%8.6" ECU_ADDRESS 0x803866 /end MEASUREMENT
/begin MEASUREMENT ECU_GearRatio_LowLim_Req "" UBYTE DC_FCTR_50_U8 1 100 0 5.1 FORMAT "%8.6" ECU_ADDRESS 0x803865 /end MEASUREMENT
/begin MEASUREMENT ECU_TCC_Slip_Mode_Req "" UBYTE DC_FLAG_U8 1 100 0 1 BIT_MASK 0x1 FORMAT "%5.3" ECU_ADDRESS 0x803864 /end MEASUREMENT
/begin MEASUREMENT ECU_Temp "" SWORD DC_TEMP_S16 1 100 -4096 4095.88 FORMAT "%8.3" ECU_ADDRESS 0x80329A /end MEASUREMENT
/begin MEASUREMENT ehks "Hilfserrorflag: Klopfsensor" UBYTE dez 1 100 0 255 FORMAT "%5.1" ECU_ADDRESS 0x800C64 /end MEASUREMENT
/begin MEASUREMENT ehks_min "Hilfserrorflag: Klopfsensor Min-Fehler" UBYTE dez 1 100 0 255 FORMAT "%5.1" ECU_ADDRESS 0x800C65 /end MEASUREMENT
/begin MEASUREMENT ehlpks "Hilfserrorflag: Klopfsensor" UBYTE dez 1 100 0 255 FORMAT "%5.1" ECU_ADDRESS 0x800C66 /end MEASUREMENT
/begin MEASUREMENT ehlpks_min "Hilfserrorflag: Klopfsensor Min-Fehler" UBYTE dez 1 100 0 255 FORMAT "%5.1" ECU_ADDRESS 0x800C67 /end MEASUREMENT
/begin MEASUREMENT Eng_StrtStopEnabl "" UBYTE DC_FLAG_U8 1 100 0 1 BIT_MASK 0x1 FORMAT "%5.3" ECU_ADDRESS 0x80387F /end MEASUREMENT
/begin MEASUREMENT Eng_StrtStopFlt "" UBYTE DC_FLAG_U8 1 100 0 1 BIT_MASK 0x1 FORMAT "%5.3" ECU_ADDRESS 0x80387E /end MEASUREMENT
/begin MEASUREMENT Eng_StrtStop_IL "" UBYTE DC_FLAG_U8 1 100 0 1 BIT_MASK 0x1 FORMAT "%5.3" ECU_ADDRESS 0x803880 /end MEASUREMENT
/begin MEASUREMENT Eng_TrqDyn "" SWORD DC_MMQ16 1 100 -2048 2047.94 FORMAT "%8.3" ECU_ADDRESS 0x80329E /end MEASUREMENT
/begin MEASUREMENT ErrErs_Mode "" UBYTE DC_FLAG_U8 1 100 0 1 BIT_MASK 0x1 FORMAT "%5.3" ECU_ADDRESS 0x80387A /end MEASUREMENT
/begin MEASUREMENT esst_snm06dmuw1 "" ULONG dez 1 100 0 4.29497e+009 FORMAT "%13.2" ECU_ADDRESS 0x801D3C /end MEASUREMENT
/begin MEASUREMENT esst_snm06dmuw2 "" ULONG dez 1 100 0 4.29497e+009 FORMAT "%13.2" ECU_ADDRESS 0x801D40 /end MEASUREMENT
/begin MEASUREMENT Ethnl_Mode "" UBYTE DC_FLAG_U8 1 100 0 1 BIT_MASK 0x1 FORMAT "%5.3" ECU_ADDRESS 0x803879 /end MEASUREMENT
/begin MEASUREMENT fdlurmin_f "Offset zur Differenzlaufunruhe bei unzureichender Adaption, aus DLURMIN" FLOAT32_IEEE fak_r32_1 1 100 -1e+037 1e+037 FORMAT "%43.4" ECU_ADDRESS 0x7F8E94 /end MEASUREMENT
/begin MEASUREMENT fgdkt2_w "Integrierte Fettgasmenge bei Katdiagnose. Bank2" UWORD m_q0p1_mg 1 100 0 6553.5 FORMAT "%8.3" ECU_ADDRESS 0x800A86 /end MEASUREMENT
/begin MEASUREMENT fgdkt_w "Integrierte Fettgasmenge bei Katdiagnose" UWORD m_q0p1_mg 1 100 0 6553.5 FORMAT "%8.3" ECU_ADDRESS 0x800A88 /end MEASUREMENT
/begin MEASUREMENT fkfdlur1_f "Basis Schwellwert f¸r Differenzlaufunruhe bei B_wk=1, Faktor aus KFDLUR1" FLOAT32_IEEE fak_r32_1 1 100 -1e+037 1e+037 FORMAT "%43.4" ECU_ADDRESS 0x7F8E98 /end MEASUREMENT
/begin MEASUREMENT fkfdlur2_f "Basis Schwellwert f¸r Differenzlaufunruhe bei B_wkr=1, Faktor aus KFDLUR2" FLOAT32_IEEE fak_r32_1 1 100 -1e+037 1e+037 FORMAT "%43.4" ECU_ADDRESS 0x7F8E9C /end MEASUREMENT
/begin MEASUREMENT fkfdlurs_f "Basis Schwellwert f¸r Differenzlaufunruhe bei B_sch=1, Faktor aus KFDLURS" FLOAT32_IEEE fak_r32_1 1 100 -1e+037 1e+037 FORMAT "%43.4" ECU_ADDRESS 0x7F8EA0 /end MEASUREMENT
/begin MEASUREMENT fkfdlur_f "Basis Schwellwert f¸r Differenzlaufunruhe, Faktor aus KFDLUR" FLOAT32_IEEE fak_r32_1 1 100 -1e+037 1e+037 FORMAT "%43.4" ECU_ADDRESS 0x7F8EA4 /end MEASUREMENT
/begin MEASUREMENT flmxof_f "aktuell maximaler Lernfilterwert" FLOAT32_IEEE fak_r32_1 1 100 -1e+037 1e+037 FORMAT "%43.4" ECU_ADDRESS 0x800680 /end MEASUREMENT
/begin MEASUREMENT flnof1_f "Lernfilterwert, negativ, Drehzahlbereich 1" FLOAT32_IEEE fak_r32_1 1 100 -1e+037 1e+037 FORMAT "%43.4" ARRAY_SIZE 12 ECU_ADDRESS 0x7FC394 /end MEASUREMENT
/begin MEASUREMENT flnof2_f "Lernfilterwert, negativ, Drehzahlbereich 2" FLOAT32_IEEE fak_r32_1 1 100 -1e+037 1e+037 FORMAT "%43.4" ARRAY_SIZE 12 ECU_ADDRESS 0x7FC3C4 /end MEASUREMENT
/begin MEASUREMENT flnof3_f "Lernfilterwert, negativ, Drehzahlbereich 3" FLOAT32_IEEE fak_r32_1 1 100 -1e+037 1e+037 FORMAT "%43.4" ARRAY_SIZE 12 ECU_ADDRESS 0x7FC3F4 /end MEASUREMENT
/begin MEASUREMENT flnof4_f "Lernfilterwert, negativ, Drehzahlbereich 4" FLOAT32_IEEE fak_r32_1 1 100 -1e+037 1e+037 FORMAT "%43.4" ARRAY_SIZE 12 ECU_ADDRESS 0x7FC424 /end MEASUREMENT
/begin MEASUREMENT flpof1_f "Lernfilterwert, positiv, Drehzahlbereich 1" FLOAT32_IEEE fak_r32_1 1 100 -1e+037 1e+037 FORMAT "%43.4" ARRAY_SIZE 12 ECU_ADDRESS 0x7FC454 /end MEASUREMENT
/begin MEASUREMENT flpof2_f "Lernfilterwert, positiv, Drehzahlbereich 2" FLOAT32_IEEE fak_r32_1 1 100 -1e+037 1e+037 FORMAT "%43.4" ARRAY_SIZE 12 ECU_ADDRESS 0x7FC484 /end MEASUREMENT
/begin MEASUREMENT flpof3_f "Lernfilterwert, positiv, Drehzahlbereich 3" FLOAT32_IEEE fak_r32_1 1 100 -1e+037 1e+037 FORMAT "%43.4" ARRAY_SIZE 12 ECU_ADDRESS 0x7FC4B4 /end MEASUREMENT
/begin MEASUREMENT flpof4_f "Lernfilterwert, positiv, Drehzahlbereich 4" FLOAT32_IEEE fak_r32_1 1 100 -1e+037 1e+037 FORMAT "%43.4" ARRAY_SIZE 12 ECU_ADDRESS 0x7FC4E4 /end MEASUREMENT
/begin MEASUREMENT fofresz "Resetz‰hler Lernfilterwert weggelaufen (Fuel-on Adaption)" UWORD dez 1 100 0 65535 FORMAT "%8.2" ECU_ADDRESS 0x7FC38E /end MEASUREMENT
/begin MEASUREMENT fofstat "Status der fuel-off Adaption im aktuellen Betriebsbereich" UBYTE dez 1 100 0 2 FORMAT "%5.3" ECU_ADDRESS 0x7FC390 /end MEASUREMENT
/begin MEASUREMENT frauzs2_w "multipl. Gemischadaptionsfaktor unterer mult. Bereich (Stereo)" UWORD fak_uw_b2 1 100 0 1.99997 FORMAT "%8.6" ECU_ADDRESS 0x800C1A /end MEASUREMENT
/begin MEASUREMENT frauzs_w "multiplikativer Gemischadaptionsfaktor unterer mult. Bereich (alter Wert)" UWORD fak_uw_b2 1 100 0 1.99997 FORMAT "%8.6" ECU_ADDRESS 0x800C1C /end MEASUREMENT
/begin MEASUREMENT fseof1_f "aktueller Filterwert Segmentabweichung, zur Segmentzeit-Korrektur, Bereich 1" FLOAT32_IEEE fak_r32_1 1 100 -1e+037 1e+037 FORMAT "%43.4" ARRAY_SIZE 12 ECU_ADDRESS 0x7FC514 /end MEASUREMENT
/begin MEASUREMENT fseof2_f "aktueller Filterwert Segmentabweichung, zur Segmentzeit-Korrektur, Bereich 2" FLOAT32_IEEE fak_r32_1 1 100 -1e+037 1e+037 FORMAT "%43.4" ARRAY_SIZE 12 ECU_ADDRESS 0x7FC544 /end MEASUREMENT
/begin MEASUREMENT fseof3_f "aktueller Filterwert Segmentabweichung, zur Segmentzeit-Korrektur, Bereich 3" FLOAT32_IEEE fak_r32_1 1 100 -1e+037 1e+037 FORMAT "%43.4" ARRAY_SIZE 12 ECU_ADDRESS 0x7FC574 /end MEASUREMENT
/begin MEASUREMENT fseof4_f "aktueller Filterwert Segmentabweichung, zur Segmentzeit-Korrektur, Bereich 4" FLOAT32_IEEE fak_r32_1 1 100 -1e+037 1e+037 FORMAT "%43.4" ARRAY_SIZE 12 ECU_ADDRESS 0x7FC5A4 /end MEASUREMENT
/begin MEASUREMENT fseofkor_f "aktueller Faktor zur Segmentzeit-Korrektur" FLOAT32_IEEE fak_r32_1 1 100 -1e+037 1e+037 FORMAT "%43.4" ECU_ADDRESS 0x7F8EA8 /end MEASUREMENT
/begin MEASUREMENT fsof1_f "Filterwert Segmentabweichung, Betriebsbereich 1" FLOAT32_IEEE fak_r32_1 1 100 -1e+037 1e+037 FORMAT "%43.4" ARRAY_SIZE 12 ECU_ADDRESS 0x7FC5D4 /end MEASUREMENT
/begin MEASUREMENT fsof2_f "Filterwert Segmentabweichung, Betriebsbereich 2" FLOAT32_IEEE fak_r32_1 1 100 -1e+037 1e+037 FORMAT "%43.4" ARRAY_SIZE 12 ECU_ADDRESS 0x7FC604 /end MEASUREMENT
/begin MEASUREMENT fsof3_f "Filterwert Segmentabweichung, Betriebsbereich 3" FLOAT32_IEEE fak_r32_1 1 100 -1e+037 1e+037 FORMAT "%43.4" ARRAY_SIZE 12 ECU_ADDRESS 0x7FC634 /end MEASUREMENT
/begin MEASUREMENT fsof4_f "Filterwert Segmentabweichung, Betriebsbereich 4" FLOAT32_IEEE fak_r32_1 1 100 -1e+037 1e+037 FORMAT "%43.4" ARRAY_SIZE 12 ECU_ADDRESS 0x7FC664 /end MEASUREMENT
/begin MEASUREMENT FuelFilter_IL_Mode "" UBYTE DC_FLAG_U8 1 100 0 1 BIT_MASK 0x1 FORMAT "%5.3" ECU_ADDRESS 0x80387D /end MEASUREMENT
/begin MEASUREMENT Fuel_Cons "" UWORD DC_CNTR_U16 1 100 0 65535 FORMAT "%8.2" ECU_ADDRESS 0x80329C /end MEASUREMENT
/begin MEASUREMENT Gen_Pin61_Mode "" UBYTE DC_FLAG_U8 1 100 0 1 BIT_MASK 0x1 FORMAT "%5.3" ECU_ADDRESS 0x80387C /end MEASUREMENT
/begin MEASUREMENT Gen_Utz "" UBYTE DC_PCT_31_U8 1 100 0 822.582 ECU_ADDRESS 0x80387B /end MEASUREMENT
/begin MEASUREMENT GlowPlugIndicEnabl "" UBYTE DC_FLAG_U8 1 100 0 1 BIT_MASK 0x1 FORMAT "%5.3" ECU_ADDRESS 0x803877 /end MEASUREMENT
/begin MEASUREMENT GlowPlugIndicState "" UBYTE DC_FLAG_U8 1 100 0 1 BIT_MASK 0x1 FORMAT "%5.3" ECU_ADDRESS 0x803876 /end MEASUREMENT
/begin MEASUREMENT idktf2_w "Integratorwert ml*lambda-Produkt bei Fett-Eintrag, Katdiagnose, Bank2" UWORD mk_q1p56Em3 1 100 0 102.398 FORMAT "%8.4" ECU_ADDRESS 0x800A8A /end MEASUREMENT
/begin MEASUREMENT idktfms2_w "Integratorwert ml*lambda-Produkt bei Fett-Mager-Sprung, Katdiagnose" UWORD mk_q1p56Em3 1 100 0 102.398 FORMAT "%8.4" ECU_ADDRESS 0x800A8C /end MEASUREMENT
/begin MEASUREMENT idktfms_w "Integratorwert ml*lambda-Produkt bei Fett-Mager-Sprung, Katdiagnose" UWORD mk_q1p56Em3 1 100 0 102.398 FORMAT "%8.4" ECU_ADDRESS 0x800A8E /end MEASUREMENT
/begin MEASUREMENT idktf_w "Integratorwert ml*lambda-Produkt bei Fett-Eintrag, Katdiagnose" UWORD mk_q1p56Em3 1 100 0 102.398 FORMAT "%8.4" ECU_ADDRESS 0x800A90 /end MEASUREMENT
/begin MEASUREMENT idxfofl "Index: Kennzeichnet den aktuellen Unterbereich (fuel-off Adaption)" UBYTE dez 1 100 0 1 FORMAT "%5.3" ECU_ADDRESS 0x80067B /end MEASUREMENT
/begin MEASUREMENT idxfofn "Drehzahlindex f¸r Drehzahlbereich der fuel-off Adaption" UBYTE dez 1 100 0 4 FORMAT "%5.3" ECU_ADDRESS 0x80067C /end MEASUREMENT
/begin MEASUREMENT IgnSwStrtrHW_Mode "" UBYTE DC_FLAG_U8 1 100 0 1 BIT_MASK 0x1 FORMAT "%5.3" ECU_ADDRESS 0x803868 /end MEASUREMENT
/begin MEASUREMENT imlfta2_w "Integrierte Luftmasse zum Setzen des Fehlers LSU fett (Typa), Bank 2" UWORD m_q2p777Em5_kg 1 100 0 1.82042 FORMAT "%8.6" ECU_ADDRESS 0x8008E2 /end MEASUREMENT
/begin MEASUREMENT imlfta_w "Integrierte Luftmasse zum Setzen des Fehlers LSU fett (Typa)" UWORD m_q2p777Em5_kg 1 100 0 1.82042 FORMAT "%8.6" ECU_ADDRESS 0x8008E4 /end MEASUREMENT
/begin MEASUREMENT imlftb2_w "Integrierte Luftmasse zum Setzen des Fehlers LSU fett (Typ b), Bank 2" UWORD m_q2p777Em5_kg 1 100 0 1.82042 FORMAT "%8.6" ECU_ADDRESS 0x8008E6 /end MEASUREMENT
/begin MEASUREMENT imlftb_w "Integrierte Luftmasse zum Setzen des Fehlers LSU fett (Typ b)" UWORD m_q2p777Em5_kg 1 100 0 1.82042 FORMAT "%8.6" ECU_ADDRESS 0x8008E8 /end MEASUREMENT
/begin MEASUREMENT imlhe2_w "Integrierte Luftmasse zum Heilen des Fehlers LSV, Bank 2" UWORD m_q2p777Em5_kg 1 100 0 1.82042 FORMAT "%8.6" ECU_ADDRESS 0x8008EA /end MEASUREMENT
/begin MEASUREMENT imlhe_w "Integrierte Luftmasse zum Heilen des Fehlers LSV" UWORD m_q2p777Em5_kg 1 100 0 1.82042 FORMAT "%8.6" ECU_ADDRESS 0x8008EC /end MEASUREMENT
/begin MEASUREMENT imlkvszs_w "Zwischenspeicher: Luftmasse nach Auftreten eines DKVS Fehles bei leerem Tank" UWORD m_q0p00355 1 100 0 233.013 FORMAT "%8.4" ECU_ADDRESS 0x7FC7B0 /end MEASUREMENT
/begin MEASUREMENT imlkvs_w "Luftmasse nach Auftreten eines DKVS Fehles bei leerem Tank" UWORD m_q0p00355 1 100 0 233.013 FORMAT "%8.4" ECU_ADDRESS 0x800C1E /end MEASUREMENT
/begin MEASUREMENT imlmra2_w "Integrierte Luftmasse zum Setzen des Fehlers LSU mager (Typ a), Bank 2" UWORD m_q2p777Em5_kg 1 100 0 1.82042 FORMAT "%8.6" ECU_ADDRESS 0x8008EE /end MEASUREMENT
/begin MEASUREMENT imlmra_w "Integrierte Luftmasse zum Setzen des Fehlers LSU mager (Typ a)" UWORD m_q2p777Em5_kg 1 100 0 1.82042 FORMAT "%8.6" ECU_ADDRESS 0x8008F0 /end MEASUREMENT
/begin MEASUREMENT imlmrb2_w "Integrierte Luftmasse zum Setzen des Fehlers LSU mager (Typ b), Bank 2" UWORD m_q2p777Em5_kg 1 100 0 1.82042 FORMAT "%8.6" ECU_ADDRESS 0x8008F2 /end MEASUREMENT
/begin MEASUREMENT imlmrb_w "Integrierte Luftmasse zum Setzen des Fehlers LSU mager (Typ b)" UWORD m_q2p777Em5_kg 1 100 0 1.82042 FORMAT "%8.6" ECU_ADDRESS 0x8008F4 /end MEASUREMENT
/begin MEASUREMENT imlna2_w "Integrierte Luftmasse zum Setzen des Fehlers Sonde nicht aktiv, Bank 2" UWORD m_q2p777Em5_kg 1 100 0 1.82042 FORMAT "%8.6" ECU_ADDRESS 0x8008F6 /end MEASUREMENT
/begin MEASUREMENT imlna_w "Integrierte Luftmasse zum Setzen des Fehlers Sonde nicht aktiv" UWORD m_q2p777Em5_kg 1 100 0 1.82042 FORMAT "%8.6" ECU_ADDRESS 0x8008F8 /end MEASUREMENT
/begin MEASUREMENT intlash2_w "Integrator (Rampe) f¸r Lambdasoll Test Schwingungspr¸fung h. KAT Bank2" UWORD fak_uw_b16 1 100 0 15.9998 FORMAT "%8.5" ECU_ADDRESS 0x7FC754 /end MEASUREMENT
/begin MEASUREMENT intlash_w "Integrator (Rampe) f¸r Lambdasoll Test Schwingungspr¸fung h. KAT" UWORD fak_uw_b16 1 100 0 15.9998 FORMAT "%8.5" ECU_ADDRESS 0x7FC756 /end MEASUREMENT
/begin MEASUREMENT lamdkt2_w "Lambdasoll f¸r Katdiagnose" UWORD fak_uw_b16 1 100 0 15.9998 FORMAT "%8.5" ECU_ADDRESS 0x800A92 /end MEASUREMENT
/begin MEASUREMENT lamdkt_w "Lambdasoll f¸r Katdiagnose" UWORD fak_uw_b16 1 100 0 15.9998 FORMAT "%8.5" ECU_ADDRESS 0x800A94 /end MEASUREMENT
/begin MEASUREMENT lamelsh2_w "Lambdasoll f¸r elektrische Sondendiagnose hinter KAT (Kurztrip), Bank 2" UWORD fak_uw_b16 1 100 0 15.9998 FORMAT "%8.5" ECU_ADDRESS 0x8016EE /end MEASUREMENT
/begin MEASUREMENT lamelsh_w "Lambdasoll f¸r elektrische Sondendiagnose hinter KAT (Kurztrip)" UWORD fak_uw_b16 1 100 0 15.9998 FORMAT "%8.5" ECU_ADDRESS 0x8016F0 /end MEASUREMENT
/begin MEASUREMENT lamlash2_w "Lambdasoll f¸r Test Schwingungspr¸fung hinter KAT Bank2" UWORD fak_uw_b16 1 100 0 15.9998 FORMAT "%8.5" ECU_ADDRESS 0x800A7A /end MEASUREMENT
/begin MEASUREMENT lamlash_w "Lambdasoll f¸r Test Schwingungspr¸fung hinter KAT" UWORD fak_uw_b16 1 100 0 15.9998 FORMAT "%8.5" ECU_ADDRESS 0x800A7C /end MEASUREMENT
/begin MEASUREMENT lamsam2_w "Lambdaamplitude nach Filterung Bank 2" SWORD fak_sw_b8 1 100 -8 7.99976 FORMAT "%8.6" ECU_ADDRESS 0x80168E /end MEASUREMENT
/begin MEASUREMENT lamsam_w "Lambdaamplitude nach Filterung" SWORD fak_sw_b8 1 100 -8 7.99976 FORMAT "%8.6" ECU_ADDRESS 0x801690 /end MEASUREMENT
/begin MEASUREMENT lamsisa "Lambda Ist an Sonde Signalausgabe DLSSA, Bank 1" UBYTE fak_ub_b2 1 100 0 1.99219 FORMAT "%5.3" ECU_ADDRESS 0x8008BC /end MEASUREMENT
/begin MEASUREMENT lamsisa2 "Lambda Ist an Sonde Signalausgabe DLSSA, Bank 2" UBYTE fak_ub_b2 1 100 0 1.99219 FORMAT "%5.3" ECU_ADDRESS 0x8008BD /end MEASUREMENT
/begin MEASUREMENT lamsosa "Lambda Soll an Sonde Signalausgabe DLSSA, Bank 1" UBYTE fak_ub_b2 1 100 0 1.99219 FORMAT "%5.3" ECU_ADDRESS 0x8008BE /end MEASUREMENT
/begin MEASUREMENT lamsosa2 "Lambda Soll an Sonde Signalausgabe DLSSA, Bank 2" UBYTE fak_ub_b2 1 100 0 1.99219 FORMAT "%5.3" ECU_ADDRESS 0x8008BF /end MEASUREMENT
/begin MEASUREMENT ldktme2_w "Lambda minus eins bei Katdiagnose" SWORD fak_sw_b1 1 100 -1 0.999969 FORMAT "%8.6" ECU_ADDRESS 0x800A96 /end MEASUREMENT
/begin MEASUREMENT ldktmev2_w "Lambda minus eins bei Katdiagnose, verzˆgerter Wert" SWORD fak_sw_b1 1 100 -1 0.999969 FORMAT "%8.6" ECU_ADDRESS 0x800A98 /end MEASUREMENT
/begin MEASUREMENT ldktmev_w "Lambda minus eins bei Katdiagnose, verzˆgerter Wert" SWORD fak_sw_b1 1 100 -1 0.999969 FORMAT "%8.6" ECU_ADDRESS 0x801AA6 /end MEASUREMENT
/begin MEASUREMENT ldktme_w "Lambda minus eins bei Katdiagnose" SWORD fak_sw_b1 1 100 -1 0.999969 FORMAT "%8.6" ECU_ADDRESS 0x800A9A /end MEASUREMENT
/begin MEASUREMENT LH_GearLowLim_Req "" UBYTE DC_FLAG_U8 1 100 0 1 BIT_MASK 0x1 FORMAT "%5.3" ECU_ADDRESS 0x803869 /end MEASUREMENT
/begin MEASUREMENT lsunpstat "Statusbyte: Teilpr¸fungserkennung f¸r Plausibilit‰tsfehler" UBYTE dez 1 100 0 255 FORMAT "%5.1" ECU_ADDRESS 0x7FC73B /end MEASUREMENT
/begin MEASUREMENT lsunpstat2 "Statusbyte: Teilpr¸fungserkennung f¸r Plausibilit‰tsfehler, Bank 2" UBYTE dez 1 100 0 255 FORMAT "%5.1" ECU_ADDRESS 0x7FC73C /end MEASUREMENT
/begin MEASUREMENT lutsfi1_w "gefilterte Laufunruhe-Testgrˆﬂe von Zylinder 1,word" SWORD luquant_w 1 100 -90.9495 90.9467 FORMAT "%8.5" ECU_ADDRESS 0x7FC6C6 /end MEASUREMENT
/begin MEASUREMENT lutsfi2_w "gefilterte Laufunruhe-Testgrˆﬂe von Zylinder 2,word" SWORD luquant_w 1 100 -90.9495 90.9467 FORMAT "%8.5" ECU_ADDRESS 0x7FC6C8 /end MEASUREMENT
/begin MEASUREMENT lutsfi3_w "gefilterte Laufunruhe-Testgrˆﬂe von Zylinder 3,word" SWORD luquant_w 1 100 -90.9495 90.9467 FORMAT "%8.5" ECU_ADDRESS 0x7FC6CA /end MEASUREMENT
/begin MEASUREMENT lutsfi4_w "gefilterte Laufunruhe-Testgrˆﬂe von Zylinder 4,word" SWORD luquant_w 1 100 -90.9495 90.9467 FORMAT "%8.5" ECU_ADDRESS 0x7FC6CC /end MEASUREMENT
/begin MEASUREMENT lutsfi5_w "gefilterte Laufunruhe-Testgrˆﬂe von Zylinder 5,word" SWORD luquant_w 1 100 -90.9495 90.9467 FORMAT "%8.5" ECU_ADDRESS 0x7FC6CE /end MEASUREMENT
/begin MEASUREMENT lutsfi6_w "gefilterte Laufunruhe-Testgrˆﬂe von Zylinder 6,word" SWORD luquant_w 1 100 -90.9495 90.9467 FORMAT "%8.5" ECU_ADDRESS 0x7FC6D0 /end MEASUREMENT
/begin MEASUREMENT lutsfi7_w "gefilterte Laufunruhe-Testgrˆﬂe von Zylinder 7,word" SWORD luquant_w 1 100 -90.9495 90.9467 FORMAT "%8.5" ECU_ADDRESS 0x7FC6D2 /end MEASUREMENT
/begin MEASUREMENT lutsfi8_w "gefilterte Laufunruhe-Testgrˆﬂe von Zylinder 8,word" SWORD luquant_w 1 100 -90.9495 90.9467 FORMAT "%8.5" ECU_ADDRESS 0x7FC6D4 /end MEASUREMENT
/begin MEASUREMENT m6aktsp "Anzahl der Ausgabe-Codes SCAN-Tool Mode6 aus Kat-Diagnose" UBYTE dez 1 100 0 255 FORMAT "%5.1" ECU_ADDRESS 0x7FC767 /end MEASUREMENT
/begin MEASUREMENT m6cktsp "Ausgabe-Code SCAN-Tool Mode 6 aus KAT-Diagnose" UBYTE dez 1 100 0 255 FORMAT "%5.1" ECU_ADDRESS 0x7FC768 /end MEASUREMENT
/begin MEASUREMENT m6cktsp2 "Ausgabe-Code SCAN-Tool Mode 6 aus KAT-Diagnose" UBYTE dez 1 100 0 255 FORMAT "%5.1" ECU_ADDRESS 0x7FC769 /end MEASUREMENT
/begin MEASUREMENT m6sktsp2_w "Ausgabe Schwellwert SCAN-Tool Mode 6 aus KAT-Diagnose" UWORD dez 1 100 0 65535 FORMAT "%8.2" ECU_ADDRESS 0x7FC75C /end MEASUREMENT
/begin MEASUREMENT m6sktsp_w "Ausgabe Schwellwert SCAN-Tool Mode 6 aus KAT-Diagnose" UWORD dez 1 100 0 65535 FORMAT "%8.2" ECU_ADDRESS 0x7FC75E /end MEASUREMENT
/begin MEASUREMENT m6wktsp2_w "Ausgabe Pr¸fwert SCAN-Tool Mode 6 aus KAT-Diagnose" UWORD dez 1 100 0 65535 FORMAT "%8.2" ECU_ADDRESS 0x7FC760 /end MEASUREMENT
/begin MEASUREMENT m6wktsp_w "Ausgabe Pr¸fwert SCAN-Tool Mode 6 aus KAT-Diagnose" UWORD dez 1 100 0 65535 FORMAT "%8.2" ECU_ADDRESS 0x7FC762 /end MEASUREMENT
/begin MEASUREMENT mldkthp "hochpaﬂgefilterte Luftmasse bei Katdiagnose" UBYTE m_ub_b1020 1 100 0 1020 FORMAT "%5.0" ECU_ADDRESS 0x800AEA /end MEASUREMENT
/begin MEASUREMENT mldyn_w "Luftmassenintegral im Schubbetrieb f¸r Sonde hinter Kat" UWORD m_q0p00277 1 100 0 182.042 FORMAT "%8.4" ECU_ADDRESS 0x800A7E /end MEASUREMENT
/begin MEASUREMENT mlfdkt2_w "ml * lambda-Produkt bei Katdiagnose w‰hrend Fetteintrag, Bank2" UWORD m_uw_b102p4 1 100 0 102.398 FORMAT "%8.4" ECU_ADDRESS 0x800A9C /end MEASUREMENT
/begin MEASUREMENT mlfdkt_w "ml * lambda-Produkt bei Katdiagnose w‰hrend Fetteintrag" UWORD mk_q1p56Em3 1 100 0 102.398 FORMAT "%8.4" ECU_ADDRESS 0x800A9E /end MEASUREMENT
/begin MEASUREMENT mlldkt2_w "ml * lambda-Produkt bei Katdiagnose" UWORD m_uw_b102p4 1 100 0 102.398 FORMAT "%8.4" ECU_ADDRESS 0x800AA0 /end MEASUREMENT
/begin MEASUREMENT mlldkt_w "ml * lambda-Produkt bei Katdiagnose" UWORD m_uw_b102p4 1 100 0 102.398 FORMAT "%8.4" ECU_ADDRESS 0x800AA2 /end MEASUREMENT
/begin MEASUREMENT nist "Motor-Istdrehzahl" UBYTE DC_NIST_QUANT 1 100 0 6375 FORMAT "%5.0" ECU_ADDRESS 0x803863 /end MEASUREMENT
/begin MEASUREMENT nlsuiaf "Anzahl der Schwellwertfehler an Bond IA" UBYTE dez 1 100 0 255 FORMAT "%5.1" ECU_ADDRESS 0x8008DA /end MEASUREMENT
/begin MEASUREMENT nlsuiaf2 "Anzahl der Schwellwertfehler an Bond IA, Bank 2" UBYTE dez 1 100 0 255 FORMAT "%5.1" ECU_ADDRESS 0x8008DB /end MEASUREMENT
/begin MEASUREMENT nlsuunf "Anzahl der Schwellwertfehler an Bond UN" UBYTE dez 1 100 0 255 FORMAT "%5.1" ECU_ADDRESS 0x8008DC /end MEASUREMENT
/begin MEASUREMENT nlsuunf2 "Anzahl der Schwellwertfehler an Bond UN, Bank 2" UBYTE dez 1 100 0 255 FORMAT "%5.1" ECU_ADDRESS 0x8008DD /end MEASUREMENT
/begin MEASUREMENT nlsuvmf "Anzahl der Schwellwertfehler an Bond VM" UBYTE dez 1 100 0 255 FORMAT "%5.1" ECU_ADDRESS 0x8008DE /end MEASUREMENT
/begin MEASUREMENT nlsuvmf2 "Anzahl der Schwellwertfehler an Bond VM, Bank 2" UBYTE dez 1 100 0 255 FORMAT "%5.1" ECU_ADDRESS 0x8008DF /end MEASUREMENT
/begin MEASUREMENT oscdkt2_w "Sauerstoffspeichervermˆgen des Katalysators, Katdiagnose" UWORD m_q0p1_mg 1 100 0 6553.5 FORMAT "%8.3" ECU_ADDRESS 0x800AA4 /end MEASUREMENT
/begin MEASUREMENT oscdkta2_w "Sauerstoffspeichervermˆgen des Katalysators, Applikations-Speicherwert, Bank2" UWORD m_q0p1_mg 1 100 0 6553.5 FORMAT "%8.3" ECU_ADDRESS 0x800AA6 /end MEASUREMENT
/begin MEASUREMENT oscdkta_w "Sauerstoffspeichervermˆgen des Katalysators, Applikations-Speicherwert" UWORD m_q0p1_mg 1 100 0 6553.5 FORMAT "%8.3" ECU_ADDRESS 0x800AA8 /end MEASUREMENT
/begin MEASUREMENT oscdktf2_w "Gefiltertes Sauerstoffspeichervermˆgen des Katalysators, Katdiagnose, Bank2" UWORD fak_uw_b16 1 100 0 15.9998 FORMAT "%8.5" ECU_ADDRESS 0x800AAA /end MEASUREMENT
/begin MEASUREMENT oscdktf_w "Gefiltertes Sauerstoffspeichervermˆgen des Katalysators, Katdiagnose" UWORD fak_uw_b16 1 100 0 15.9998 FORMAT "%8.5" ECU_ADDRESS 0x800AAC /end MEASUREMENT
/begin MEASUREMENT oscdktm2_w "Mittelwert des Sauerstoffspeichervermˆgens des Katalysators, Katdiagnose, Bank2" UWORD fak_uw_b16 1 100 0 15.9998 FORMAT "%8.5" ECU_ADDRESS 0x800AAE /end MEASUREMENT
/begin MEASUREMENT oscdktm_w "Mittelwert des Sauerstoffspeichervermˆgens des Katalysators, Katdiagnose" UWORD fak_uw_b16 1 100 0 15.9998 FORMAT "%8.5" ECU_ADDRESS 0x800AB0 /end MEASUREMENT
/begin MEASUREMENT oscdktn2_w "Normierte Sauerstoffspeicherf‰higkeit, Katdiagnose" UWORD fak_uw_b16 1 100 0 15.9998 FORMAT "%8.5" ECU_ADDRESS 0x800AB2 /end MEASUREMENT
/begin MEASUREMENT oscdktn_w "Normierte Sauerstoffspeicherf‰higkeit, Katdiagnose" UWORD fak_uw_b16 1 100 0 15.9998 FORMAT "%8.5" ECU_ADDRESS 0x800AB4 /end MEASUREMENT
/begin MEASUREMENT oscdktr2_w "Normierte Sauerstoffspeicherf‰higkeit, Referenzwert, Katdiagnose" UWORD fak_uw_b16 1 100 0 15.9998 FORMAT "%8.5" ECU_ADDRESS 0x800AB6 /end MEASUREMENT
/begin MEASUREMENT oscdktr_w "Normierte Sauerstoffspeicherf‰higkeit, Referenzwert, Katdiagnose" UWORD fak_uw_b16 1 100 0 15.9998 FORMAT "%8.5" ECU_ADDRESS 0x800AB8 /end MEASUREMENT
/begin MEASUREMENT oscdkts2_w "Sauerstoffspeichervermˆgen des Katalysators, Summenwert, Bank2" UWORD fak_uw_b128 1 100 0 127.998 FORMAT "%8.4" ECU_ADDRESS 0x800ABA /end MEASUREMENT
/begin MEASUREMENT oscdkts_w "Sauerstoffspeichervermˆgen des Katalysators, Summenwert" UWORD fak_uw_b128 1 100 0 127.998 FORMAT "%8.4" ECU_ADDRESS 0x800ABC /end MEASUREMENT
/begin MEASUREMENT oscdktt2_w "Sauerstoffspeichervermˆgen des Katalysators, temperaturkorrigiert, Katdiagnose" UWORD m_q0p1_mg 1 100 10 6553.5 FORMAT "%8.3" ECU_ADDRESS 0x800ABE /end MEASUREMENT
/begin MEASUREMENT oscdktt_w "Sauerstoffspeichervermˆgen des Katalysators, temperaturkorrigiert, Katdiagnose" UWORD m_q0p1_mg 1 100 10 6553.5 FORMAT "%8.3" ECU_ADDRESS 0x800AC0 /end MEASUREMENT
/begin MEASUREMENT oscdkt_w "Sauerstoffspeichervermˆgen des Katalysators, Katdiagnose" UWORD m_q0p1_mg 1 100 0 6553.5 FORMAT "%8.3" ECU_ADDRESS 0x800AC2 /end MEASUREMENT
/begin MEASUREMENT oscmn2_w "Minimalwert des Sauerstoffspeichervermˆgens des Katalysators, Bank2" UWORD fak_uw_b16 1 100 0 15.9998 FORMAT "%8.5" ECU_ADDRESS 0x800AC4 /end MEASUREMENT
/begin MEASUREMENT oscmnd2_w "Minimale Abweichung der Sauerstoffspeichervermˆgen des Katalysators, Bank2" UWORD fak_uw_b16 1 100 0 15.9998 FORMAT "%8.5" ECU_ADDRESS 0x800AC6 /end MEASUREMENT
/begin MEASUREMENT oscmnd_w "Minimale Abweichung der Sauerstoffspeichervermˆgen des Katalysators" UWORD fak_uw_b16 1 100 0 15.9998 FORMAT "%8.5" ECU_ADDRESS 0x800AC8 /end MEASUREMENT
/begin MEASUREMENT oscmn_w "Minimalwert des Sauerstoffspeichervermˆgens des Katalysators" UWORD fak_uw_b16 1 100 0 15.9998 FORMAT "%8.5" ECU_ADDRESS 0x800ACA /end MEASUREMENT
/begin MEASUREMENT oscmx2_w "Maximalwert des Sauerstoffspeichervermˆgens des Katalysators, Bank2" UWORD fak_uw_b16 1 100 0 15.9998 FORMAT "%8.5" ECU_ADDRESS 0x800ACC /end MEASUREMENT
/begin MEASUREMENT oscmxd2_w "Maximale Abweichung der Sauerstoffspeichervermˆgen des Katalysators, Bank2" UWORD fak_uw_b16 1 100 0 15.9998 FORMAT "%8.5" ECU_ADDRESS 0x800ACE /end MEASUREMENT
/begin MEASUREMENT oscmxd_w "Maximale Abweichung der Sauerstoffspeichervermˆgen des Katalysators" UWORD fak_uw_b16 1 100 0 15.9998 FORMAT "%8.5" ECU_ADDRESS 0x800AD0 /end MEASUREMENT
/begin MEASUREMENT oscmx_w "Maximalwert des Sauerstoffspeichervermˆgens des Katalysators" UWORD fak_uw_b16 1 100 0 15.9998 FORMAT "%8.5" ECU_ADDRESS 0x800AD2 /end MEASUREMENT
/begin MEASUREMENT OSC_IL_defect "" UBYTE DC_FLAG_U8 1 100 0 1 BIT_MASK 0x1 FORMAT "%5.3" ECU_ADDRESS 0x803875 /end MEASUREMENT
/begin MEASUREMENT OSC_IL_Enabl "" UBYTE DC_FLAG_U8 1 100 0 1 BIT_MASK 0x1 FORMAT "%5.3" ECU_ADDRESS 0x803874 /end MEASUREMENT
/begin MEASUREMENT rkam2_w "Auswahl additive Gemischkorrektur der Gemischadaption f¸r Bestimmung B_gae2" SWORD rel_sw_b1536 1 100 -1536 1535.95 FORMAT "%8.3" ECU_ADDRESS 0x800C20 /end MEASUREMENT
/begin MEASUREMENT rkamzs2_w "additive Gemischkorrektur (pro Zeit oder Z¸ndung) Bank 2 (alter Wert)" SWORD rel_sw_b1536 1 100 -1536 1535.95 FORMAT "%8.3" ECU_ADDRESS 0x800C22 /end MEASUREMENT
/begin MEASUREMENT rkamzs_w "additive Gemischkorrektur (pro Zeit oder Z¸ndung); alter Wert" SWORD rel_sw_b1536 1 100 -1536 1535.95 FORMAT "%8.3" ECU_ADDRESS 0x800C24 /end MEASUREMENT
/begin MEASUREMENT rkam_w "Auswahl additive Gemischkorrektur der Gemischadaption f¸r Bestimmung B_gae" SWORD rel_sw_b1536 1 100 -1536 1535.95 FORMAT "%8.3" ECU_ADDRESS 0x800C26 /end MEASUREMENT
/begin MEASUREMENT rkrn_w "normierter Referenzpegel Klopfregelung" UWORD spg_uw_b1280 1 100 0 1279.98 FORMAT "%7.2" ARRAY_SIZE 8 ECU_ADDRESS 0x800C70 /end MEASUREMENT
/begin MEASUREMENT SC_TrqSetRes_Mode_Req "" UBYTE DC_FLAG_U8 1 100 0 1 BIT_MASK 0x1 FORMAT "%5.3" ECU_ADDRESS 0x803862 /end MEASUREMENT
/begin MEASUREMENT SG_Trq_Loss "" SWORD DC_TRQ_S16 1 100 -2048 2047.94 FORMAT "%8.3" ECU_ADDRESS 0x803298 /end MEASUREMENT
/begin MEASUREMENT sicurrent_f "" FLOAT32_IEEE fak_r32_1 1 100 -1e+037 1e+037 FORMAT "%43.4" ECU_ADDRESS 0x800684 /end MEASUREMENT
/begin MEASUREMENT slfofo_f "obere Schwelle f¸r flmxof_f, aus Kennlinie SLFOFO1/2N" FLOAT32_IEEE fak_r32_1 1 100 -1e+037 1e+037 FORMAT "%43.4" ECU_ADDRESS 0x800688 /end MEASUREMENT
/begin MEASUREMENT slfofu_f "untere Schwelle f¸r flmxof_f, aus Kennlinie SLFOFU1/2N" FLOAT32_IEEE fak_r32_1 1 100 -1e+037 1e+037 FORMAT "%43.4" ECU_ADDRESS 0x80068C /end MEASUREMENT
/begin MEASUREMENT Tank_Cap_Wal "" UBYTE DC_FLAG_U8 1 100 0 1 BIT_MASK 0x1 FORMAT "%5.3" ECU_ADDRESS 0x803873 /end MEASUREMENT
/begin MEASUREMENT tikatmu "Umgeschaltete Abgastemperatur im Katalysator aus Modell" UBYTE temp_ub_q5_o50 1 100 -50 1225 FORMAT "%5.0" ECU_ADDRESS 0x800AEB /end MEASUREMENT
/begin MEASUREMENT tikatmu_w "Umgeschaltete Abgastemperatur im Katalysator aus Modell" UWORD temp_uw_q0p0195_o50 1 100 -50 1229.98 FORMAT "%8.3" ECU_ADDRESS 0x800AD4 /end MEASUREMENT
/begin MEASUREMENT tkdktg "Katalysasto-Temperaturgradient bei Katdiagnose" UBYTE temp_ub_q5 1 100 0 1275 FORMAT "%5.0" ECU_ADDRESS 0x800AEC /end MEASUREMENT
/begin MEASUREMENT tkdktg2 "Katalysasto-Temperaturgradient bei Katdiagnose" UBYTE temp_ub_q5 1 100 0 1275 FORMAT "%5.0" ECU_ADDRESS 0x800AED /end MEASUREMENT
/begin MEASUREMENT tkdkthps "hochpaﬂgefilterte Katalysator-Temperatur" UBYTE temp_ub_q5 1 100 0 1275 FORMAT "%5.0" ECU_ADDRESS 0x800AEE /end MEASUREMENT
/begin MEASUREMENT tkdkthps2 "hochpaﬂgefilterte Katalysator-Temperatur, Bank2" UBYTE temp_ub_q5 1 100 0 1275 FORMAT "%5.0" ECU_ADDRESS 0x800AEF /end MEASUREMENT
/begin MEASUREMENT tkdktold "Katdiagnose: alter Tamperaturwert" UBYTE temp_ub_q5_o50 1 100 -50 1225 FORMAT "%5.0" ECU_ADDRESS 0x800AF0 /end MEASUREMENT
/begin MEASUREMENT tkdktold2 "Katdiagnose: alter Tamperaturwert, Bank2" UBYTE temp_ub_q5_o50 1 100 -50 1225 FORMAT "%5.0" ECU_ADDRESS 0x800AF1 /end MEASUREMENT
/begin MEASUREMENT TrqSetInjSO_Mode_Req "" UBYTE DC_FLAG_U8 1 100 0 1 BIT_MASK 0x1 FORMAT "%5.3" ECU_ADDRESS 0x803882 /end MEASUREMENT
/begin MEASUREMENT tsdkttk2_w "Temperaturabh‰ngige Verzˆgerungszeit, Bank2" UWORD t200msxs_uw_q0p2 1 100 0 13107 FORMAT "%8.2" ECU_ADDRESS 0x800AD6 /end MEASUREMENT
/begin MEASUREMENT tsdkttk_w "Temperaturabh‰ngige Verzˆgerungszeit" UWORD t200msxs_uw_q0p2 1 100 0 13107 FORMAT "%8.2" ECU_ADDRESS 0x800AD8 /end MEASUREMENT
/begin MEASUREMENT tsi1_f "" FLOAT32_IEEE fak_r32_1 1 100 -1e+037 1e+037 FORMAT "%43.4" ARRAY_SIZE 12 ECU_ADDRESS 0x800690 /end MEASUREMENT
/begin MEASUREMENT tsi_f "" FLOAT32_IEEE fak_r32_1 1 100 -1e+037 1e+037 FORMAT "%43.4" ARRAY_SIZE 12 ECU_ADDRESS 0x8006C0 /end MEASUREMENT
/begin MEASUREMENT tsk_f "korrigierte Segmentdauer" FLOAT32_IEEE fak_r32_1 1 100 -1e+037 1e+037 FORMAT "%43.4" ECU_ADDRESS 0x7F8EAC /end MEASUREMENT
/begin MEASUREMENT twdlssh2_w "Timer f¸r Mindestpr¸fzeit f¸r DLSSA-Extremwertbestimmung hinter KAT Bank2" UWORD t50msxs_uw_b3276p75 1 100 0 3276.75 FORMAT "%8.3" ECU_ADDRESS 0x8008C6 /end MEASUREMENT
/begin MEASUREMENT twdlssh_w "Timer f¸r Mindestpr¸fzeit f¸r DLSSA-Extremwertbestimmung hinter KAT" UWORD t50msxs_uw_b3276p75 1 100 0 3276.75 FORMAT "%8.3" ECU_ADDRESS 0x8008C8 /end MEASUREMENT
/begin MEASUREMENT udksnoa_w "KS-Diagnose: Aktueller Wert obere Schwelle (UDKSNO)" UWORD spg_uw_b1280 1 100 0 1279.98 FORMAT "%7.2" ECU_ADDRESS 0x8017B6 /end MEASUREMENT
/begin MEASUREMENT udksnua_w "KS-Diagnose: Aktueller Wert untere Schwelle (UDKSNU)" UWORD spg_uw_b1280 1 100 0 1279.98 FORMAT "%7.2" ECU_ADDRESS 0x8017B8 /end MEASUREMENT
/begin MEASUREMENT ushfmxstg "Gefilterte maximale Steigung der Sondenspannung hinter KAT" UBYTE spgg_q0p52 1 100 0 132.6 FORMAT "%5.1" ECU_ADDRESS 0x7FC759 /end MEASUREMENT
/begin MEASUREMENT ushfmxstg2 "Gefilterte maximale Steigung der Sondenspannung hinter KAT Bank2" UBYTE spgg_q0p52 1 100 0 132.6 FORMAT "%5.1" ECU_ADDRESS 0x7FC75A /end MEASUREMENT
/begin MEASUREMENT ushkj "Spannung Lambdasonde hinter Kat, ohne Offset, DLSSA, Bank 1" UBYTE spg_ub_b1p33 1 100 0 1.33 FORMAT "%5.3" ECU_ADDRESS 0x8008C0 /end MEASUREMENT
/begin MEASUREMENT ushkj2 "Spannung Lambdasonde hinter Kat, ohne Offset, DLSSA, Bank 2" UBYTE spg_ub_b1p33 1 100 0 1.33 FORMAT "%5.3" ECU_ADDRESS 0x8008C1 /end MEASUREMENT
/begin MEASUREMENT ushkjf2_w "Gefilterte Spannung Lambdasonde hinter Kat, ohne Offset, DLSSA (Bank2)" UWORD spg_uw_b1p33 1 100 0 1.33 FORMAT "%8.6" ECU_ADDRESS 0x8008CA /end MEASUREMENT
/begin MEASUREMENT ushkjf_w "Gefilterte Spannung Lambdasonde hinter Kat, ohne Offset, DLSSA" UWORD spg_uw_b1p33 1 100 0 1.33 FORMAT "%8.6" ECU_ADDRESS 0x8008CC /end MEASUREMENT
/begin MEASUREMENT ushkmxstg "Maximale Steigung der Sondenspannung hinter KAT" UBYTE spgg_q0p52 1 100 0 132.6 FORMAT "%5.1" ECU_ADDRESS 0x801195 /end MEASUREMENT
/begin MEASUREMENT ushkmxstg2 "Maximale Steigung der Sondenspannung hinter KAT Bank2" UBYTE spgg_q0p52 1 100 0 132.6 FORMAT "%5.1" ECU_ADDRESS 0x801196 /end MEASUREMENT
/begin MEASUREMENT ushksteig "Steigung der Sondenspannung hinter KAT" UBYTE spgg_q0p52 1 100 0 132.6 FORMAT "%5.1" ECU_ADDRESS 0x801197 /end MEASUREMENT
/begin MEASUREMENT ushksteig2 "Steigung der Sondenspannung hinter KAT Bank2" UBYTE spgg_q0p52 1 100 0 132.6 FORMAT "%5.1" ECU_ADDRESS 0x801198 /end MEASUREMENT
/begin MEASUREMENT usmnsha "minimal erkannter Sondenspannungswert h.K. (alt), DLSSA, Bank 1" UBYTE spg_ub_b1p33 1 100 0 1.33 FORMAT "%5.3" ECU_ADDRESS 0x8008C2 /end MEASUREMENT
/begin MEASUREMENT usmnsha2 "minimal erkannter Sondenspannungswert h.K. (alt), DLSSA, Bank 2" UBYTE spg_ub_b1p33 1 100 0 1.33 FORMAT "%5.3" ECU_ADDRESS 0x8008C3 /end MEASUREMENT
/begin MEASUREMENT usmnshn "minimal erkannter Sondenspannungswert h.K. (neu), DLSSA" UBYTE spg_ub_b1p33 1 100 0 1.33 FORMAT "%5.3" ECU_ADDRESS 0x7FC735 /end MEASUREMENT
/begin MEASUREMENT usmnshn2 "minimal erkannter Sondenspannungswert h.K. (neu), DLSSA (Bank2)" UBYTE spg_ub_b1p33 1 100 0 1.33 FORMAT "%5.3" ECU_ADDRESS 0x7FC736 /end MEASUREMENT
/begin MEASUREMENT usmxsha "maximal erkannter Sondenspannungswert h.K. (alt), DLSSA, Bank 1" UBYTE spg_ub_b1p33 1 100 0 1.33 FORMAT "%5.3" ECU_ADDRESS 0x8008C4 /end MEASUREMENT
/begin MEASUREMENT usmxsha2 "maximal erkannter Sondenspannungswert h.K. (alt), DLSSA, Bank 2" UBYTE spg_ub_b1p33 1 100 0 1.33 FORMAT "%5.3" ECU_ADDRESS 0x8008C5 /end MEASUREMENT
/begin MEASUREMENT usmxshn "maximal erkannter Sondenspannungswert h.K. (neu), DLSSA" UBYTE spg_ub_b1p33 1 100 0 1.33 FORMAT "%5.3" ECU_ADDRESS 0x7FC737 /end MEASUREMENT
/begin MEASUREMENT usmxshn2 "maximal erkannter Sondenspannungswert h.K. (neu), DLSSA (Bank2)" UBYTE spg_ub_b1p33 1 100 0 1.33 FORMAT "%5.3" ECU_ADDRESS 0x7FC738 /end MEASUREMENT
/begin MEASUREMENT usrhkmx "maximale Regelschwelle im Fehlerfall  f¸r Sonden-Diagnose hinter KAT" UBYTE spg_ub_q0p0052_o0p2 1 100 -0.2 1.13 FORMAT "%5.3" ECU_ADDRESS 0x7FC752 /end MEASUREMENT
/begin MEASUREMENT usrhkmx2 "maximale Regelschwelle im Fehlerfall f¸r Sonden-Dignose hinter KAT Bank2" UBYTE spg_ub_q0p0052_o0p2 1 100 -0.2 1.13 FORMAT "%5.3" ECU_ADDRESS 0x7FC753 /end MEASUREMENT
/begin MEASUREMENT usrhks "aktueller Regel-Sollwert f¸r Diagnose hinter KAT" UBYTE spg_ub_q0p0052_o0p2 1 100 -0.2 1.13 FORMAT "%5.3" ECU_ADDRESS 0x800A6F /end MEASUREMENT
/begin MEASUREMENT usrhks2 "aktueller Regel-Sollwert f¸r Diagnose hinter KAT Bank2" UBYTE spg_ub_q0p0052_o0p2 1 100 -0.2 1.13 FORMAT "%5.3" ECU_ADDRESS 0x800A70 /end MEASUREMENT
/begin MEASUREMENT VISActv "" UBYTE DC_FLAG_U8 1 100 0 1 BIT_MASK 0x1 FORMAT "%5.3" ECU_ADDRESS 0x803872 /end MEASUREMENT
/begin MEASUREMENT vk_bpb "Ergebnis der Var.-Kodierung: Band-Ende-Programm.-Byte" UBYTE DC_CNTR_U8 1 100 0 255 FORMAT "%5.1" ECU_ADDRESS 0x803860 /end MEASUREMENT
/begin MEASUREMENT vk_can "Ergebnis der Var.-Kodierung: CAN-Teilnehmer" UBYTE DC_CNTR_U8 1 100 0 255 FORMAT "%5.1" ECU_ADDRESS 0x80385F /end MEASUREMENT
/begin MEASUREMENT vk_fz_kb "Fahrzeugkodierung in der Variantencodierung" UBYTE DC_CNTR_U8 1 100 0 255 FORMAT "%5.1" ECU_ADDRESS 0x80385E /end MEASUREMENT
/begin MEASUREMENT vk_mot2 "Ergebnis der Var.-Kodierung: Motor-Code E/A 2" UBYTE DC_CNTR_U8 1 100 0 255 FORMAT "%5.1" ECU_ADDRESS 0x80385D /end MEASUREMENT
/begin MEASUREMENT VSL_Ctrl_Mode "" UBYTE DC_FLAG_U8 1 100 0 1 BIT_MASK 0x1 FORMAT "%5.3" ECU_ADDRESS 0x803871 /end MEASUREMENT
/begin MEASUREMENT VSL_DFSODsabl_Req "" UBYTE DC_FLAG_U8 1 100 0 1 BIT_MASK 0x1 FORMAT "%5.3" ECU_ADDRESS 0x803870 /end MEASUREMENT
/begin MEASUREMENT VSL_Gear_HighLim_Req "" UBYTE DC_CNTR_U8 1 100 0 255 FORMAT "%5.1" ECU_ADDRESS 0x80386E /end MEASUREMENT
/begin MEASUREMENT VSL_Gear_LowLim_Req "" UBYTE DC_CNTR_U8 1 100 0 255 FORMAT "%5.1" ECU_ADDRESS 0x80386D /end MEASUREMENT
/begin MEASUREMENT WaterFuel_IL_Mode "" UBYTE DC_FLAG_U8 1 100 0 1 BIT_MASK 0x1 FORMAT "%5.3" ECU_ADDRESS 0x80386C /end MEASUREMENT
/begin MEASUREMENT xs_f "aktueller Meﬂwert Basisgrˆﬂe f¸r Faktor Segmentzeitkorrektur" FLOAT32_IEEE fak_r32_1 1 100 -1e+037 1e+037 FORMAT "%43.4" ARRAY_SIZE 12 ECU_ADDRESS 0x8006F0 /end MEASUREMENT
/begin MEASUREMENT xzkrznt "Z‰hler Klopfregelung Zyklusflag Z_krnt" UBYTE dez 1 100 0 255 FORMAT "%5.1" ECU_ADDRESS 0x800C80 /end MEASUREMENT
/begin MEASUREMENT xzkrzs "Z‰hler f¸r Zyklusflag Diagnose Klopfsensor" UBYTE dez 1 100 0 255 FORMAT "%5.1" ARRAY_SIZE 2 ECU_ADDRESS 0x800C68 /end MEASUREMENT
/begin MEASUREMENT xzkrztp "Z‰hler Klopfregelung Zyklusflag Z_krtp" UBYTE dez 1 100 0 255 FORMAT "%5.1" ECU_ADDRESS 0x800C81 /end MEASUREMENT
/begin MEASUREMENT xzsen "Entprellz‰hler Diagnose Klopfsensor" UBYTE dez 1 100 0 255 FORMAT "%5.1" ARRAY_SIZE 2 ECU_ADDRESS 0x800C6C /end MEASUREMENT
/begin MEASUREMENT xzskrnt "Sicherheitsz‰hler Klopfregelung Nulltest" UBYTE dez 1 100 0 255 FORMAT "%5.1" ECU_ADDRESS 0x800C82 /end MEASUREMENT
/begin MEASUREMENT xzskrtp "Z‰hler Klopfregelung Errorflag E_krtp" UBYTE dez 1 100 0 255 FORMAT "%5.1" ECU_ADDRESS 0x800C83 /end MEASUREMENT
/begin MEASUREMENT zhklsu "Z‰hler Heizerkopplung LSU" UBYTE dez 1 100 0 255 FORMAT "%5.1" ECU_ADDRESS 0x801173 /end MEASUREMENT
/begin MEASUREMENT zhklsu2 "Z‰hler Heizerkopplung LSU2" UBYTE dez 1 100 0 255 FORMAT "%5.1" ECU_ADDRESS 0x801174 /end MEASUREMENT
/begin MEASUREMENT zhlpks "Hilfszyklusflag: Klopfsensor" UBYTE dez 1 100 0 255 FORMAT "%5.1" ECU_ADDRESS 0x800C6E /end MEASUREMENT
/begin MEASUREMENT zkrzpar "Zyklusz‰hler Klopfregelung Parity-Check" UBYTE dez 1 100 0 255 FORMAT "%5.1" ECU_ADDRESS 0x800C84 /end MEASUREMENT
/begin MEASUREMENT zkrzspi "Zyklusz‰hler Klopfregelung SPI-‹berwachung" UBYTE dez 1 100 0 255 FORMAT "%5.1" ECU_ADDRESS 0x800C85 /end MEASUREMENT
/begin MEASUREMENT zlash2_w "Zeitz‰hler f¸r Sondenspannung hinter KAT ober/unterhalb des Sollwertes, Bank2" UWORD t100msxs_uw_b6553p5 1 100 0 6553.5 FORMAT "%8.3" ECU_ADDRESS 0x8016F2 /end MEASUREMENT
/begin MEASUREMENT zlash_w "Zeitz‰hler f¸r Sondenspannung hinter KAT ober/unterhalb des Sollwertes" UWORD t100msxs_uw_b6553p5 1 100 0 6553.5 FORMAT "%8.3" ECU_ADDRESS 0x8016F4 /end MEASUREMENT
/begin MEASUREMENT zwdynsh "Z‰hler f¸r Anzahl der Dynamikmessungen f¸r Sonde hinter KAT" UBYTE dez 1 100 0 255 FORMAT "%5.1" ECU_ADDRESS 0x800A71 /end MEASUREMENT
/begin MEASUREMENT zwdynsh2 "Z‰hler f¸r Anzahl der Dynamikmessungen f¸r Sonde hinter KAT Bank2" UBYTE dez 1 100 0 255 FORMAT "%5.1" ECU_ADDRESS 0x800A72 /end MEASUREMENT
/begin MEASUREMENT zyl2 "" UBYTE dez 1 100 0 12 FORMAT "%5.2" ECU_ADDRESS 0x80067D /end MEASUREMENT
/begin FUNCTION DKATSP "DKATSP.exportedKatalysatordiagnose durch Gemischsprung"
 /begin DEF_CHARACTERISTIC APKTDI APKTDIT APKTDX AVKATFS CDKATSLK CIDKATSP CIDKATSP2 CIDKATSPI CIDKATSPI2 CIDKATSPT CIDKATSPT2 CWDKATSP DMLKTDX DMRKTDS DTKTDGRAX FIKTD FKTDAVK FKTDFE FKTDFET FKTDGTV KFOSCTM LAKTDEO LAKTDEU LKTDF LKTDFT LKTDM LKTDMT MLKTDO MLKTDOO MLKTDOT MLKTDU MLKTDUO MLKTDUT OSCKTD OSCKTDNG OSCKTDT TKTDGRA TKTDSP TMAXKATA TMAXKATS TMAXKATSO TMINKATS TMINKATSO TMNKATST TMSUKTDS TMXKATST TSKTDTK TVKTDLE TVKTDRX TWDKATS USHKTDM USHKTDR USHKTDRX ZKTDML ZKTDTK /end DEF_CHARACTERISTIC
 /begin REF_CHARACTERISTIC CWKONFLS /end REF_CHARACTERISTIC
 /begin IN_MEASUREMENT B_cdkatsp B_cdkatspf B_cdkatspt B_dsls B_dtes B_edkvs B_edkvs2 B_fa B_fakat B_fakat2 B_frmax B_frmax2 B_frmin B_frmin2 B_lr B_lr2 B_lrka B_lrka2 B_mdarv B_mdkat B_nswo2 B_pwf B_sbbhk B_sbbhk2 B_sls B_stend B_tehb B_ukg ilmltkx2_w ilmltkx_w imllaka2_w imllaka_w lamsons2_w lamsons_w lamzak2_w lamzak_w msabg msabg2_w msabg_w tikatm tikatm2 tikatm2_w tikatm_w tmst ushk ushk2 /end IN_MEASUREMENT
 /begin OUT_MEASUREMENT avkatf avkatf2 B_dktb B_dktb2 B_dktsbs B_dktsbs2 B_lamdkt B_lamdkt2 B_vekat B_vekat2 dkatspBits1_200ms dkatspBits1_20ms dkatspBits1_50ms dkatspBits2_20ms dkatspBits2_50ms dkatspBits3_50ms dkatspBits_200ms dkatspBits_20ms dkatspBits_50ms dmrdkt_w lamdkt2_w lamdkt_w m6aktsp m6cktsp m6cktsp2 m6sktsp2_w m6sktsp_w m6wktsp2_w m6wktsp_w /end OUT_MEASUREMENT
 /begin LOC_MEASUREMENT apdkt apdkt2 apdkti apdkti2 apedkts apedkts2 apzdkt apzdkt2 B_binsti B_binstop B_dkemp B_dkemp2 B_dkifm B_dkifm2 B_dkifma B_dkifma2 B_dkmen B_dkmen2 B_dktens B_dktens2 B_dktgtv B_dktgtv2 B_dktkas B_dktkas2 B_dktle B_dktle2 B_dktm B_dktm2 B_dktme B_dktme2 B_dktr B_dktr2 B_dktre B_dktre2 B_dktsps B_dktsps2 B_dkttks B_dkttks2 B_edkt B_edkt2 B_elshvdkt B_elsvdkt B_elsvdkt2 B_ildkt B_ildkt2 B_lsvdkt2 B_mldkt B_sbbhku B_tmsdkt B_vekati B_vekati2 B_zdkt B_zdkt2 B_zkat B_zkat2 fgdkt2_w fgdkt_w idktf2_w idktfms2_w idktfms_w idktf_w ldktme2_w ldktmev2_w ldktmev_w ldktme_w mldkthp mlfdkt2_w mlfdkt_w mlldkt2_w mlldkt_w oscdkt2_w oscdkta2_w oscdkta_w oscdktf2_w oscdktf_w oscdktm2_w oscdktm_w oscdktn2_w oscdktn_w oscdktr2_w oscdktr_w oscdkts2_w oscdkts_w oscdktt2_w oscdktt_w oscdkt_w oscmn2_w oscmnd2_w oscmnd_w oscmn_w oscmx2_w oscmxd2_w oscmxd_w oscmx_w tikatmu tikatmu_w tkdktg tkdktg2 tkdkthps tkdkthps2 tkdktold tkdktold2 tsdkttk2_w tsdkttk_w /end LOC_MEASUREMENT
 /begin SUB_FUNCTION DFPM_DKATSP INDEX_DKATSP /end SUB_FUNCTION
/end FUNCTION
/begin FUNCTION DKRIC "Diagnose Klopfsensorauswerte IC" /begin DEF_CHARACTERISTIC CWDKRNT CWDKRPAR CWDKRTP DKRPAR DKRTPN KRFHT UDKRGOFS /end DEF_CHARACTERISTIC /begin REF_CHARACTERISTIC /end REF_CHARACTERISTIC /begin IN_MEASUREMENT B_pwf ikrmen_w ikrmet_w krdizust kricdiag tmflt_w zkrpar /end IN_MEASUREMENT /begin OUT_MEASUREMENT B_krntfv B_krtpfv /end OUT_MEASUREMENT
 /begin LOC_MEASUREMENT B_hlpkrnte B_hlpkrntz B_hlpkrpce B_hlpkrpcz B_hlpkrtpe B_hlpkrtpz xzkrznt xzkrztp xzskrnt xzskrtp zkrzpar /end LOC_MEASUREMENT
 /begin SUB_FUNCTION /end SUB_FUNCTION
/end FUNCTION
/begin FUNCTION DKRS "Diagnose; Klopfsensor (OBDII)" /begin DEF_CHARACTERISTIC CWDKS KRFHKS KRZYLDIAG NDKSO NDKSU UDKSNO UDKSNU /end DEF_CHARACTERISTIC /begin REF_CHARACTERISTIC SENZZYL SNM16KRUB /end REF_CHARACTERISTIC
 /begin IN_MEASUREMENT B_kr B_krfdks B_krldy B_krndy B_pwf B_tmkr esst_snm16krub nmot rkr_w vkr /end IN_MEASUREMENT
 /begin OUT_MEASUREMENT /end OUT_MEASUREMENT
 /begin LOC_MEASUREMENT B_ds B_ds2 ehks ehks_min ehlpks ehlpks_min rkrn_w udksnoa_w udksnua_w xzkrzs xzsen zhlpks /end LOC_MEASUREMENT
 /begin SUB_FUNCTION /end SUB_FUNCTION
/end FUNCTION
/begin FUNCTION DKRSPI "Diagnose Klopfregelung SPI-‹berwachung" /begin DEF_CHARACTERISTIC CWDKRSPI DKRSPI /end DEF_CHARACTERISTIC /begin REF_CHARACTERISTIC /end REF_CHARACTERISTIC /begin IN_MEASUREMENT B_krkoer kricdiag zkrspi /end IN_MEASUREMENT /begin OUT_MEASUREMENT B_bkkspi /end OUT_MEASUREMENT /begin LOC_MEASUREMENT B_hlpkrspe B_hlpkrspz zkrzspi /end LOC_MEASUREMENT /begin SUB_FUNCTION /end SUB_FUNCTION /end FUNCTION
/begin FUNCTION DKVS "Diagnose; Plausibilit‰tspr¸fung Kraftstoffversorgungssysteme"
 /begin DEF_CHARACTERISTIC CPLRA CWDKVSS DFRMST FRAE FRAODN FRAODX FRAUDN FRAUDX FRMSTTDN FRMSTTDX IMLKVSMX MLDKVSF MLDKVSG RKAE RKATDN RKATDX RKAZDN RKAZDX TFRA TFRAOZ TFRAUZ TFRMST TFRMZST TMFRST TRKA TRKATZ TRKAZZ ZFRMST /end DEF_CHARACTERISTIC
 /begin REF_CHARACTERISTIC /end REF_CHARACTERISTIC
 /begin IN_MEASUREMENT B_cdkvs B_fa B_fakvs B_falra B_frao B_frau B_fraur B_fraur2 B_lr B_lr2 B_lra B_lra2 B_lrare B_nofra B_norkat B_norkaz B_pwf B_rkat B_rkatr B_rkatr2 B_rkaz B_rkazr B_rkazr2 B_sa B_tal B_talval B_te cd_bits1_w frao2_w frao_w frau2_w frau_w frm2_w frm_w ml rkat2_w rkat_w rkaz2_w rkaz_w tans tmot /end IN_MEASUREMENT
 /begin OUT_MEASUREMENT B_dkvsf B_dkvstr B_edkvs B_edkvs2 B_gae B_gaefra B_gaefra2 B_gaeing B_gaeing2 B_kvsffl /end OUT_MEASUREMENT
 /begin LOC_MEASUREMENT B_dkvsef B_dkvsef2 B_dkvsfm B_dkvszf B_dkvszf2 B_efrao B_efrao2 B_efrau B_efrau2 B_erkat B_erkat2 B_erkaz B_erkaz2 B_frste B_frste2 B_imlkvse B_norkam B_plra B_rkam B_rkamr B_rkamr2 B_zfrao B_zfrao2 B_zfrau B_zfrau2 B_zrkat B_zrkat2 B_zrkaz B_zrkaz2 DKVS1lokbits DKVSbits DKVSlokbits frauzs2_w frauzs_w imlkvszs_w imlkvs_w rkam2_w rkamzs2_w rkamzs_w rkam_w /end LOC_MEASUREMENT
 /begin SUB_FUNCTION /end SUB_FUNCTION
/end FUNCTION
/begin FUNCTION DLBK "Diagnose Ladungsbewegungsklappe" /begin DEF_CHARACTERISTIC LBKDSOLMX /end DEF_CHARACTERISTIC /begin REF_CHARACTERISTIC LBKLPID2T TVPLBKP /end REF_CHARACTERISTIC
 /begin IN_MEASUREMENT B_lbkdarfl B_lbkese B_lbklpide B_lbknlpab B_lbknlpne B_lbkomaab B_lbkpe B_lbkpmn B_lbkpmx B_lbkumaab B_lbkwsive B_talbk lbksol_w talbk_w /end IN_MEASUREMENT
 /begin OUT_MEASUREMENT B_lbkbb B_lbkg B_lbknh B_lbknlb B_lbknol B_lbkpsio B_lbksg /end OUT_MEASUREMENT
 /begin LOC_MEASUREMENT /end LOC_MEASUREMENT
 /begin SUB_FUNCTION /end SUB_FUNCTION
/end FUNCTION
/begin FUNCTION DLLR "Diagnose: Leerlaufregelung Erkennung blockierter Steller"
 /begin DEF_CHARACTERISTIC DASA DNDLLRO DNDLLRU FHDLLR RLMDVERL TADLLR TDLLR TDLLRMN TDLLRMX TDLLRNF TFDLLRO TFDLLRU TMDLLR /end DEF_CHARACTERISTIC
 /begin REF_CHARACTERISTIC /end REF_CHARACTERISTIC
 /begin IN_MEASUREMENT B_cdllr B_dknolu B_dkpu B_dsls B_dtes B_evakt B_ll B_llr B_lrar B_mdarv B_nldg B_nmot B_nswo1 B_sa B_st B_tehb cd_bits2_w dmllri_w dns fho limax_w limin_w mdverl_w rl tans tmot tnse_w vfzg /end IN_MEASUREMENT
 /begin OUT_MEASUREMENT B_dllr B_dllra /end OUT_MEASUREMENT
 /begin LOC_MEASUREMENT B_lldia /end LOC_MEASUREMENT
 /begin SUB_FUNCTION /end SUB_FUNCTION
/end FUNCTION
/begin FUNCTION DLSAHK "Lambdasondenalterungs¸berwachung hinter KAT"
 /begin DEF_CHARACTERISTIC ANZDYNSH CWDLSAHK DLAMLASHF DLAMLASHM DMRLASH FRMLASHO FRMLASHU KMXSTG KTLAMSTEIG LAMSONSVL LAMSTEIG MLLASH MLOSTEST MLUSSTG MLUSTEST MLUSVL SMLDYN TABGSTG TFRMB TLLASH TRIPFASH TSALASH TTLASH TUSCHUB TUSENLASH TUSHKRFM TUSHKVL TUSHSMIN TUSLASH TUSMSVL TUSSA TUSTALLASH USHKVL USHLEAN USHRICH USHSTGMX USHSTSOLL USSCHUB /end DEF_CHARACTERISTIC
 /begin REF_CHARACTERISTIC /end REF_CHARACTERISTIC
 /begin IN_MEASUREMENT B_cdlash B_cwlshdyn B_cwlshsch B_cwlshvl B_dsls B_dtest B_edkvs B_edkvs2 B_evloc B_fa B_fash B_fash2 B_gaefra B_gaefra2 B_gaeing B_gaeing2 B_lr B_lr2 B_lrhk B_lrhk2 B_lrhkp B_lrhkp2 B_lsh B_lsh2 B_mdarv B_pwf B_sa B_sbbhk B_sbbhk2 B_tal B_talval B_vlsumrb B_vlsumrb2 cd_bits2_w lamsons2_w lamsons_w ml_w tkatm tkatm2 ushk ushk2 usrhk usrhk2 /end IN_MEASUREMENT
 /begin OUT_MEASUREMENT B_ddylash B_ddylash2 B_dlash B_dlash2 B_dshk B_dshk2 B_dushsch B_dushsch2 B_enfmst B_enfmst2 B_enlash B_enlash2 B_entest B_entest2 B_lamend B_lamend2 B_lamlash B_lamlash2 B_lamverg B_lamverg2 B_lsahksp B_lsahksp2 B_lshswok B_lshswok2 B_minlash B_minlash2 B_mldyn B_mlustest B_nolash B_nolash2 B_steigm B_steigm2 B_teslash B_teslash2 B_trfash B_trfash2 B_ushkf B_ushkf2 B_ushkm B_ushkm2 dmrlash_w lamlash2_w lamlash_w mldyn_w ushfmxstg ushfmxstg2 ushkmxstg ushkmxstg2 ushksteig zlash2_w zlash_w zwdynsh zwdynsh2 /end OUT_MEASUREMENT
 /begin LOC_MEASUREMENT B_abgstg B_abgstg2 B_dlams B_dlams2 B_dushkvl B_dushkvl2 B_dylash B_dylash2 B_enmaxla B_enmaxla2 B_ktrlash B_ktrlash2 B_maxla B_maxla2 B_maxlash B_maxlash2 B_npllash B_npllash2 B_siglash B_siglash2 B_uscherf B_uscherf2 B_ushkrfm B_ushkrfm2 B_ushkvl B_ushkvl2 B_ushsch B_ushsch2 B_usrhkmx B_usrhkmx2 dlams2_w dlams_w intlash2_w intlash_w ushksteig2 usrhkmx usrhkmx2 usrhks usrhks2 /end LOC_MEASUREMENT
 /begin SUB_FUNCTION /end SUB_FUNCTION
/end FUNCTION
/begin FUNCTION DLSH "Diagnose; Sondenbetriebsbereitschaft hinter Kat"
 /begin DEF_CHARACTERISTIC ABGMSIGH DLAMELSH DMRLSH DRISIGH RISIGRESH TABGMCSD TASIG TKATMSHU TMSH TMSHA TNSTDNH TRSAFA TRSAH TRSE TTBMH TUSKS TUSMAX TUSTAL UBDLS USMAX USMIN USREFH USREMH /end DEF_CHARACTERISTIC
 /begin REF_CHARACTERISTIC /end REF_CHARACTERISTIC
 /begin IN_MEASUREMENT B_cdlsh B_fa B_falsh B_falsh2 B_hsha B_hsha2 B_lsh B_lsh2 B_nmot B_pwf B_st B_tal B_talval rinh2_w rinh_w tkatm tkatm2 tmot tmotab ub ushk2_w ushk_w /end IN_MEASUREMENT
 /begin OUT_MEASUREMENT B_risigh B_sbbhk B_sbbhk2 B_ttbmhh B_ttbmhh2 dmrlsh_w lamelsh2_w lamelsh_w /end OUT_MEASUREMENT
 /begin LOC_MEASUREMENT B_adsh B_adsh2 B_adshs B_adshs2 B_dshen B_dshen2 B_elshv B_elshv2 B_lshklt B_maxflsh B_maxflsh2 B_minflsh B_minflsh2 B_noadsh B_noadsh2 B_nolsh B_nolsh2 B_nplflsh B_nplflsh2 B_risigh2 B_sigflsh B_sigflsh2 B_trsah B_trsah2 B_uhsig B_uhsig2 B_zlshv B_zlshv2 DLSHerrors DLSHintbits DLSHintbits2 /end LOC_MEASUREMENT
 /begin SUB_FUNCTION /end SUB_FUNCTION
/end FUNCTION
/begin FUNCTION DLSSA "Signalausgabe Lambdasonden"
 /begin DEF_CHARACTERISTIC DLAHISATO DLAHISATU DYNLSUTO DYNLSUTU LAMSSAMN LAMSSAMX SAFK1 TWDLSSA USIVMAXH USIVMINH USMNSHMN USMNSHMX USMXSHMN USMXSHMX USRHKSHJ USRJ /end DEF_CHARACTERISTIC
 /begin REF_CHARACTERISTIC /end REF_CHARACTERISTIC
 /begin IN_MEASUREMENT B_lrhk B_lrhk2 B_pwf dlahi2_w dlahi_w dynlsu2_w dynlsu_w lamsoni2_w lamsoni_w lamsons2_w lamsons_w ushk ushk2 /end IN_MEASUREMENT
 /begin OUT_MEASUREMENT dlahisa dlahisa2 dynlsusa dynlsusa2 lamsisa lamsisa2 lamsosa lamsosa2 ushkj ushkj2 usmnshn usmnshn2 usmxshn usmxshn2 /end OUT_MEASUREMENT
 /begin LOC_MEASUREMENT twdlssh2_w twdlssh_w ushkjf2_w ushkjf_w usmnsha usmnsha2 usmxsha usmxsha2 /end LOC_MEASUREMENT
 /begin SUB_FUNCTION /end SUB_FUNCTION
/end FUNCTION
/begin FUNCTION DLSU "Diagnose stetige Lambdasonde LSU"
 /begin DEF_CHARACTERISTIC DLAHPPLMN DMRLSV DRLMX DYNLSUFA DYNLSUMX DYNLSURD IMLHEMN IMLHEMNFA IMLPLCMN IMLPLCMNB IVDYNLSU KDYNFA KDYNLSU LAMDYNO LAMDYNU LAMMN LAMMX LAMSSMN LAMSSMX LASPLCFT LASPLCMR LSUNAMN LSUNAMX MSAPLMN NLSULFMX NMOTDYFA NMOTDYNO NMOTDYNU RLDYNFA RLDYNO RLDYNU SDLAOF SDULSUMX SULSULUFT SULSUMX TALASMX TALSUSMX TVDRL TVHKLSU TVHKLSUV TVLSUEK TVLSULUFT TVLSUOF TVLSUTRIM TVMRFT TVSERSL TVSHESL TVSNPF TVTKLSU USHKFT USHKMR ZDYNFA ZDYNLSU ZEHK ZLAMFT ZLAMHP ZLAMLP /end DEF_CHARACTERISTIC
 /begin REF_CHARACTERISTIC CWDLSU /end REF_CHARACTERISTIC
 /begin IN_MEASUREMENT B_atmtpa B_atmtpa2 B_cdlsv B_dsls B_ehlsu B_evloc B_fa B_falsv B_falsv2 B_frmax B_frmax2 B_frmin B_frmin2 B_henrin B_hsve B_hsve2 B_kh B_lamabg B_lamabg2 B_lamverg B_lamverg2 B_lrhk B_lrhk2 B_lrhkp B_lrhkp2 B_lrs B_lrs2 B_lshswok B_lshswok2 B_lsuiamn B_lsuiamn2 B_lsuiamx B_lsuiamx2 B_lsuicif B_lsuicif2 B_lsuickf B_lsuickf2 B_lsuube B_lsuube2 B_lsuunmn B_lsuunmn2 B_lsuunmx B_lsuunmx2 B_lsuvmmn B_lsuvmmn2 B_lsuvmmx B_mdarv B_nphsv B_nphsv2 B_pwf B_sbbhk B_sbbhk2 B_sbbvk B_sbbvk2 B_sls B_stend B_tal B_talval B_tehb B_vekat B_vekat2 B_za B_za2 cd_bits1_w dfrzaf2_w dfrzaf_w dlahi2_w dlahi_w dlahp2_w dlahp_w lamsoni2_w lamsoni_w lamsons2_w lamsons_w msabg2_w msabg_w nmot rl tavvkm2_w tavvkm_w ushk2_w ushk_w usvkv2_w usvkv_w uulsuv2_w uulsuv_w /end IN_MEASUREMENT
 /begin OUT_MEASUREMENT anzdyn anzdyn2 B_eiclsu B_eiclsu2 B_elaof B_elaof2 B_elsu B_elsu2 B_elsuwi B_elsuwi2 B_falsu B_lrasp B_lrasp2 B_nplflsu B_nplflsu2 B_vlsuftb B_vlsuftb2 B_vlsumrb B_vlsumrb2 DLSUausbitsNOV1 dmrlsv_w dynlsu2_w dynlsu_w lamsam2_w lamsam_w lsunpstat lsunpstat2 zhklsu zhklsu2 /end OUT_MEASUREMENT
 /begin LOC_MEASUREMENT B_drlmx B_dylsu B_dylsu2 B_dylsuav B_dylsuav2 B_dylsuf B_heallsv B_heallsv2 B_heatf B_helsu B_helsu2 B_helsuf B_helsuf2 B_iapcf B_iapcf2 B_lshkpft B_lshkpft2 B_lshkpmr B_lshkpmr2 B_lsuabgl B_lsuabgl2 B_lsuft B_lsufta B_lsufta2 B_lsuftb B_lsuftb2 B_lsulone B_lsulone2 B_lsultk B_lsultk2 B_lsumr B_lsumr2 B_lsumra B_lsumra2 B_lsumrb B_lsumrb2 B_lsumx B_lsumx2 B_lsumxtk B_lsumxtk2 B_lsuna B_lsuna2 B_lsupft B_lsupft2 B_lsupmr B_lsupmr2 B_lsurfc B_luft B_luft2 B_maxflsu B_maxflsu2 B_minflsu B_minflsu2 B_noflsv B_noflsv2 B_npsna B_npsna2 B_npvshns B_npvshns2 B_plenvh B_plenvh2 B_sigflsu B_sigflsu2 B_stcal B_stcal2 B_stcdyn B_stcdyn2 B_unpcf B_unpcf2 B_vmpcf B_vmpcf2 imlfta2_w imlfta_w imlftb2_w imlftb_w imlhe2_w imlhe_w imlmra2_w imlmra_w imlmrb2_w imlmrb_w imlna2_w imlna_w nlsuiaf nlsuiaf2 nlsuunf nlsuunf2 nlsuvmf nlsuvmf2 /end LOC_MEASUREMENT
 /begin SUB_FUNCTION /end SUB_FUNCTION
/end FUNCTION
/begin FUNCTION DMDCS "20.11     Dummy Funktion f¸r alle DC-Projekte" /begin DEF_CHARACTERISTIC /end DEF_CHARACTERISTIC /begin REF_CHARACTERISTIC /end REF_CHARACTERISTIC
 /begin IN_MEASUREMENT Cod_CANMembr_CTM Cod_Drvabl_AdapCrsCtrl Cod_Drvabl_ADD Cod_Drvabl_CrsCtrl_VSL Cod_ModelRange Eng_Spd /end IN_MEASUREMENT
 /begin OUT_MEASUREMENT ACComprDsabl_ECU_Req ACCompr_MaxTrq_Req AirFilterFouledWal b_tm_reg Crash_Mode CrsCtrl_Engaged CylCutoffEnabl Cyl_FIRate_Corr drdfh drdfv drmkom drnesls drpac drpblserr drpblspar drpblstog drswe dr_dif12 dr_ehbpar dr_ehbtgl dr_ehbumg dr_partmma dr_partpar dr_parttgl dr_pegsmma dr_pegspar dr_pegstgl dr_pespesp dr_pespmma dr_pesppar dr_pesptgl dr_pmnaaf dr_pmnaag dr_sp1mn dr_sp1mx dr_sp2mn dr_sp2mx dr_upvg ECU_GearRatio_HighLim_Req ECU_GearRatio_LowLim_Req ECU_TCC_Slip_Mode_Req ECU_Temp Eng_StrtStopEnabl Eng_StrtStopFlt Eng_StrtStop_IL Eng_TrqDyn ErrErs_Mode Ethnl_Mode FuelFilter_IL_Mode Fuel_Cons Gen_Pin61_Mode Gen_Utz GlowPlugIndicEnabl GlowPlugIndicState IgnSwStrtrHW_Mode ir0 LH_GearLowLim_Req nist OSC_IL_defect OSC_IL_Enabl SC_TrqSetRes_Mode_Req SG_Trq_Loss Tank_Cap_Wal TrqSetInjSO_Mode_Req VISActv vk_bpb vk_can vk_fz_kb vk_mot2 VSL_Ctrl_Mode VSL_DFSODsabl_Req VSL_Gear_HighLim_Req VSL_Gear_LowLim_Req WaterFuel_IL_Mode /end OUT_MEASUREMENT
 /begin LOC_MEASUREMENT /end LOC_MEASUREMENT
 /begin SUB_FUNCTION /end SUB_FUNCTION
/end FUNCTION
/begin FUNCTION DMDDLU "DMDDLU.exportedDiagnose Misfire Detection Differenzbildung der Laufunruhe" /begin DEF_CHARACTERISTIC DLURMIN DMXRDL KFDLUR KFDLUR1 KFDLUR2 KFDLURS NMIDLU /end DEF_CHARACTERISTIC /begin REF_CHARACTERISTIC SNM08DMUB SRL08DMUB /end REF_CHARACTERISTIC
 /begin IN_MEASUREMENT B_analu B_lustop B_mdstop B_sch B_wk B_wkr dlutsk_f esst_snm08dmub esst_srl08dmub flurktm_f fofstat fonstat nmot rl /end IN_MEASUREMENT
 /begin OUT_MEASUREMENT B_dluerk fdlurmin_f fkfdlur1_f fkfdlur2_f fkfdlurs_f fkfdlur_f /end OUT_MEASUREMENT
 /begin LOC_MEASUREMENT B_dluerk_t dlursalt_f dlurs_f /end LOC_MEASUREMENT
 /begin SUB_FUNCTION /end SUB_FUNCTION
/end FUNCTION
/begin FUNCTION DMDFLU "DMDFLU.   Diagnose Misfire Detection Filterung der Laufunruhe" /begin DEF_CHARACTERISTIC ZLUTSFI /end DEF_CHARACTERISTIC /begin REF_CHARACTERISTIC /end REF_CHARACTERISTIC /begin IN_MEASUREMENT B_ll B_pwf lutszyl_f luts_f zzyllfb /end IN_MEASUREMENT
 /begin OUT_MEASUREMENT lutsfi1_w lutsfi2_w lutsfi3_w lutsfi4_w lutsfi5_w lutsfi6_w lutsfi7_w lutsfi8_w /end OUT_MEASUREMENT
 /begin LOC_MEASUREMENT /end LOC_MEASUREMENT
 /begin SUB_FUNCTION /end SUB_FUNCTION
/end FUNCTION
/begin FUNCTION DMDFOF "DMDFOF.   Diagnosis Misfire Detection Fuel-off Adaptation"
 /begin DEF_CHARACTERISTIC ALFOF ANWFOST ANWSTP CDFO CDFOMOD FLFOF FOFAKT FS1FOF FS2FOF KLCFOF1N KLCFOF2N KLIDXFOFN1 KLIDXFOFN2 LURFOST SI04DMUB1 SI04DMUB2 SLFOFO1N SLFOFO2N SLFOFU1N SLFOFU2N SNM06DMUW1 SNM06DMUW2 /end DEF_CHARACTERISTIC
 /begin REF_CHARACTERISTIC SNM04DMUW1 SNM04DMUW2 /end REF_CHARACTERISTIC
 /begin IN_MEASUREMENT B_autget B_fofstp B_fonresf B_mdstop B_pwf esst_snm04dmuw1 esst_snm04dmuw2 lunw_f nmot_f nmot_w tsroh_f zzyldmd zzyldmd_f /end IN_MEASUREMENT
 /begin OUT_MEASUREMENT B_fofr1 B_fofrun B_folunw B_fomod B_fonresd B_readap fofstat fseofkor_f tsk_f /end OUT_MEASUREMENT
 /begin LOC_MEASUREMENT anwfofs anwst B_fof1 B_fof2 B_fof3 B_fof4 B_fofd B_fofdis B_fofdr B_fofr B_fofr2 B_fofr3 B_fofr4 B_fofrun0 B_fomodold B_idxfof1 B_idxfof2 B_idxfof3 B_idxfof4 B_mdzyl1 B_zylind cfof esst_snm06dmuw1 esst_snm06dmuw2 flmxof_f flnof1_f flnof2_f flnof3_f flnof4_f flpof1_f flpof2_f flpof3_f flpof4_f fofresz fseof1_f fseof2_f fseof3_f fseof4_f fsof1_f fsof2_f fsof3_f fsof4_f idxfofl idxfofn sicurrent_f slfofo_f slfofu_f tsi1_f tsi_f xs_f zyl2 /end LOC_MEASUREMENT
 /begin SUB_FUNCTION /end SUB_FUNCTION
/end FUNCTION
/begin COMPU_METHOD B_TRUE "boolsche Zust‰nde, positive Logik" TAB_VERB "%6.3" "" COMPU_TAB_REF B_TRUE /end COMPU_METHOD
/begin COMPU_VTAB B_TRUE "boolsche Zust‰nde, positive Logik" TAB_VERB 2 0 "----" 1 "TRUE" /end COMPU_VTAB
/begin COMPU_METHOD DC_CNTR_U16 "" RAT_FUNC "%6.2" "" COEFFS 0 1 0 0 0 1 /end COMPU_METHOD
/begin COMPU_METHOD DC_CNTR_U8 "" RAT_FUNC "%6.2" "" COEFFS 0 1 0 0 0 1 /end COMPU_METHOD
/begin COMPU_METHOD DC_FCTR_50_U8 "" RAT_FUNC "%8.5" "keine" COEFFS 0 50 0 0 0 1 /end COMPU_METHOD
/begin COMPU_METHOD DC_FIRATE_CORR_U16 "" RAT_FUNC "%11.10" "(kg/h)/((U/min)*%)" COEFFS 0 1.6384e+007 0 0 0 100 /end COMPU_METHOD
/begin COMPU_METHOD DC_FLAG_U8 "" RAT_FUNC "%6.2" "" COEFFS 0 1 0 0 0 1 /end COMPU_METHOD
/begin COMPU_METHOD DC_MMQ16 "" RAT_FUNC "%8.5" "Nm" COEFFS 0 1 0 0 0 0.0625 /end COMPU_METHOD
/begin COMPU_METHOD DC_NIST_QUANT "" RAT_FUNC "%6.1" "Upm" COEFFS 0 1 0 0 0 25 /end COMPU_METHOD
/begin COMPU_METHOD DC_PCT_31_U8 "" RAT_FUNC "%6.2" "%" COEFFS 0 1 0 0 0 3.22581 /end COMPU_METHOD
/begin COMPU_METHOD DC_TEMP_S16 "" RAT_FUNC "%8.4" "Grad C" COEFFS 0 8 0 0 0 1 /end COMPU_METHOD
/begin COMPU_METHOD DC_TRQ_S16 "" RAT_FUNC "%8.5" "Nm" COEFFS 0 16 0 0 0 1 /end COMPU_METHOD
/begin COMPU_METHOD DC_TRQ_U8 "" RAT_FUNC "%8.4" "Nm" COEFFS 0 4 0 0 0 1 /end COMPU_METHOD
/begin COMPU_METHOD dez "1 : 1 Umrechnug (dez/hex)" RAT_FUNC "%6.2" "" COEFFS 0 1 0 0 0 1 /end COMPU_METHOD
/begin COMPU_METHOD fak_q0p0195 "" RAT_FUNC "%6.4" "-" COEFFS 0 256 0 0 0 5 /end COMPU_METHOD
/begin COMPU_METHOD fak_r32_1 "" RAT_FUNC "%43.21" "-" COEFFS 0 1 0 0 0 1 /end COMPU_METHOD
/begin COMPU_METHOD fak_sw_b1 "" RAT_FUNC "%7.6" "-" COEFFS 0 65536 0 0 0 2 /end COMPU_METHOD
/begin COMPU_METHOD fak_sw_b8 "" RAT_FUNC "%6.5" "-" COEFFS 0 65536 0 0 0 16 /end COMPU_METHOD
/begin COMPU_METHOD fak_ub_b0p1_o0p05 "" RAT_FUNC "%8.7" "-" COEFFS 0 256 12.8 0 0 0.1 /end COMPU_METHOD
/begin COMPU_METHOD fak_ub_b1 "" RAT_FUNC "%6.4" "-" COEFFS 0 256 0 0 0 1 /end COMPU_METHOD
/begin COMPU_METHOD fak_ub_b16 "" RAT_FUNC "%6.4" "-" COEFFS 0 256 0 0 0 16 /end COMPU_METHOD
/begin COMPU_METHOD fak_ub_b2 "" RAT_FUNC "%6.4" "-" COEFFS 0 256 0 0 0 2 /end COMPU_METHOD
/begin COMPU_METHOD fak_ub_b4 "" RAT_FUNC "%6.4" "-" COEFFS 0 256 0 0 0 4 /end COMPU_METHOD
/begin COMPU_METHOD fak_ub_b8 "" RAT_FUNC "%6.4" "-" COEFFS 0 256 0 0 0 8 /end COMPU_METHOD
/begin COMPU_METHOD fak_uw_b1 "" RAT_FUNC "%7.6" "-" COEFFS 0 65536 0 0 0 1 /end COMPU_METHOD
/begin COMPU_METHOD fak_uw_b128 "" RAT_FUNC "%6.4" "-" COEFFS 0 65536 0 0 0 128 /end COMPU_METHOD
/begin COMPU_METHOD fak_uw_b16 "" RAT_FUNC "%6.5" "-" COEFFS 0 65536 0 0 0 16 /end COMPU_METHOD
/begin COMPU_METHOD fak_uw_b2 "" RAT_FUNC "%7.6" "-" COEFFS 0 65536 0 0 0 2 /end COMPU_METHOD
/begin COMPU_METHOD luquant_w "Umrechnung Laufunruhe Word-Grˆﬂen in DMD" RAT_FUNC "%6.4" "(1/min/s)^2" COEFFS 0 256 0 0 0 0.710543 /end COMPU_METHOD
/begin COMPU_METHOD mk_q1p56Em3 "" RAT_FUNC "%6.4" "kg/h*s" COEFFS 0 65536 0 0 0 102.4 /end COMPU_METHOD
/begin COMPU_METHOD m_q0p00277 "" RAT_FUNC "%6.4" "g" COEFFS 0 360 0 0 0 1 /end COMPU_METHOD
/begin COMPU_METHOD m_q0p00355 "" RAT_FUNC "%6.4" "kg" COEFFS 0 1125 0 0 0 4 /end COMPU_METHOD
/begin COMPU_METHOD m_q0p1 "" RAT_FUNC "%6.3" "kg/h" COEFFS 0 10 0 0 0 1 /end COMPU_METHOD
/begin COMPU_METHOD m_q0p1_mg "" RAT_FUNC "%6.3" "mg" COEFFS 0 1 0 0 0 0.1 /end COMPU_METHOD
/begin COMPU_METHOD m_q2p777Em5_kg "" RAT_FUNC "%7.6" "kg" COEFFS 0 3600 0 0 0 0.1 /end COMPU_METHOD
/begin COMPU_METHOD m_ub_b1020 "" RAT_FUNC "%6.2" "kg/h" COEFFS 0 1 0 0 0 4 /end COMPU_METHOD
/begin COMPU_METHOD m_uw_b102p4 "" RAT_FUNC "%6.4" "kg/h" COEFFS 0 65536 0 0 0 102.4 /end COMPU_METHOD
/begin COMPU_METHOD m_uw_b6553p5 "" RAT_FUNC "%6.3" "kg/h" COEFFS 0 1 0 0 0 0.1 /end COMPU_METHOD
/begin COMPU_METHOD nmot_ub_q10 "" RAT_FUNC "%6.1" "1/min" COEFFS 0 1 0 0 0 10 /end COMPU_METHOD
/begin COMPU_METHOD nmot_ub_q40 "" RAT_FUNC "%6.1" "1/min" COEFFS 0 1 0 0 0 40 /end COMPU_METHOD
/begin COMPU_METHOD nmot_uw_q0p25 "" RAT_FUNC "%6.3" "1/min" COEFFS 0 1 0 0 0 0.25 /end COMPU_METHOD
/begin COMPU_METHOD rel_sw_b1536 "" RAT_FUNC "%6.4" "%" COEFFS 0 65536 0 0 0 3072 /end COMPU_METHOD
/begin COMPU_METHOD rel_ub_q0p75 "" RAT_FUNC "%6.3" "%" COEFFS 0 1 0 0 0 0.75 /end COMPU_METHOD
/begin COMPU_METHOD rel_uw_b100 "" RAT_FUNC "%6.4" "%" COEFFS 0 65536 0 0 0 100 /end COMPU_METHOD
/begin COMPU_METHOD rel_uw_b192 "" RAT_FUNC "%6.4" "%" COEFFS 0 65536 0 0 0 192 /end COMPU_METHOD
/begin COMPU_METHOD r_uw_q2 "" RAT_FUNC "%6.2" "Ohm" COEFFS 0 1 0 0 0 2 /end COMPU_METHOD
/begin COMPU_METHOD spgg_q0p52 "" RAT_FUNC "%6.3" "mV/ms" COEFFS 0 1 0 0 0 0.52 /end COMPU_METHOD
/begin COMPU_METHOD spg_ubatt "" RAT_FUNC "%6.3" "V" COEFFS 0 1 0 0 0 0.0942 /end COMPU_METHOD
/begin COMPU_METHOD spg_ub_b1p33 "" RAT_FUNC "%6.4" "V" COEFFS 0 255 0 0 0 1.33 /end COMPU_METHOD
/begin COMPU_METHOD spg_ub_q0p0052_o0p2 "" RAT_FUNC "%6.3" "V" COEFFS 0 255 51 0 0 1.33 /end COMPU_METHOD
/begin COMPU_METHOD spg_uw_b1280 "" RAT_FUNC "%7.4" "V" COEFFS 0 1000 0 0 0 19.5313 /end COMPU_METHOD
/begin COMPU_METHOD spg_uw_b1p33 "" RAT_FUNC "%7.6" "V" COEFFS 0 65535 0 0 0 1.33 /end COMPU_METHOD
/begin COMPU_METHOD spg_uw_b5 "" RAT_FUNC "%6.4" "V" COEFFS 0 1024 0 0 0 5 /end COMPU_METHOD
/begin COMPU_METHOD spg_uw_q0p000076 "" RAT_FUNC "%7.6" "V" COEFFS 0 65536 0 0 0 5 /end COMPU_METHOD
/begin COMPU_METHOD spg_uw_q0p00488 "" RAT_FUNC "%6.4" "V" COEFFS 0 1024 0 0 0 5 /end COMPU_METHOD
/begin COMPU_METHOD spg_uw_q0p00488_o1 "" RAT_FUNC "%6.3" "V" COEFFS 0 1024 1024 0 0 5 /end COMPU_METHOD
/begin COMPU_METHOD t100msxs_ub_b25p5 "" RAT_FUNC "%6.3" "s" COEFFS 0 1 0 0 0 0.1 /end COMPU_METHOD
/begin COMPU_METHOD t100msxs_uw_b6553p5 "" RAT_FUNC "%6.3" "s" COEFFS 0 1 0 0 0 0.1 /end COMPU_METHOD
/begin COMPU_METHOD t100msxs_uw_b6553p6 "" RAT_FUNC "%6.3" "s" COEFFS 0 10 0 0 0 1 /end COMPU_METHOD
/begin COMPU_METHOD t100msxs_uw_q100 "" RAT_FUNC "%6.3" "s" COEFFS 0 1 0 0 0 0.1 /end COMPU_METHOD
/begin COMPU_METHOD t10msxs_ub_b2p55 "" RAT_FUNC "%6.4" "s" COEFFS 0 1 0 0 0 0.01 /end COMPU_METHOD
/begin COMPU_METHOD t200msxs_ub_b51 "" RAT_FUNC "%6.3" "s" COEFFS 0 1 0 0 0 0.2 /end COMPU_METHOD
/begin COMPU_METHOD t200msxs_uw_q0p2 "" RAT_FUNC "%6.3" "s" COEFFS 0 1 0 0 0 0.2 /end COMPU_METHOD
/begin COMPU_METHOD t20msxs_ub_b5p1 "" RAT_FUNC "%6.4" "s" COEFFS 0 1 0 0 0 0.02 /end COMPU_METHOD
/begin COMPU_METHOD t50msxs_q0p05 "" RAT_FUNC "%6.4" "s" COEFFS 0 1 0 0 0 0.05 /end COMPU_METHOD
/begin COMPU_METHOD t50msxs_uw_b3276p75 "" RAT_FUNC "%6.4" "s" COEFFS 0 1 0 0 0 0.05 /end COMPU_METHOD
/begin COMPU_METHOD temp_q0p0234_o273 "" RAT_FUNC "%6.1" "Grad C" COEFFS 0 1 273.15 0 0 0.0234375 /end COMPU_METHOD
/begin COMPU_METHOD temp_ub_q0p75_o48 "" RAT_FUNC "%6.2" "Grad C" COEFFS 0 1 48 0 0 0.75 /end COMPU_METHOD
/begin COMPU_METHOD temp_ub_q5 "" RAT_FUNC "%6.2" "Grad C" COEFFS 0 1 0 0 0 5 /end COMPU_METHOD
/begin COMPU_METHOD temp_ub_q5_o50 "" RAT_FUNC "%6.2" "Grad C" COEFFS 0 1 50 0 0 5 /end COMPU_METHOD
/begin COMPU_METHOD temp_uw_q0p0195_o50 "" RAT_FUNC "%6.2" "Grad C" COEFFS 0 256 12800 0 0 5 /end COMPU_METHOD
/begin COMPU_METHOD ttemp_q0p04 "" RAT_FUNC "%6.4" "s/Grad C" COEFFS 0 1 0 0 0 0.04 /end COMPU_METHOD
/begin COMPU_METHOD tus_uw_q3p2 "" RAT_FUNC "%6.2" "us" COEFFS 0 1 0 0 0 3.2 /end COMPU_METHOD
/begin COMPU_METHOD zk100msxs_uw_b6553 "" RAT_FUNC "%10.3" "s" COEFFS 0 0 65536 0 10 0 /end COMPU_METHOD
/begin COMPU_METHOD zk10msxs_uw_b655 "" RAT_FUNC "%10.4" "s" COEFFS 0 0 65536 0 100 0 /end COMPU_METHOD
/begin COMPU_METHOD zk200msxs_ub_b51p2 "" RAT_FUNC "%6.3" "s" COEFFS 0 0 51.2 0 1 0 /end COMPU_METHOD
/begin COMPU_METHOD zk50msxs_ub_b12p8 "" RAT_FUNC "%10.5" "s" COEFFS 0 0 128 0 10 0 /end COMPU_METHOD
/begin RECORD_LAYOUT GkfWU16 FNC_VALUES 1 UWORD COLUMN_DIR DIRECT /end RECORD_LAYOUT
/begin RECORD_LAYOUT GklWU16 FNC_VALUES 1 UWORD COLUMN_DIR DIRECT /end RECORD_LAYOUT
/begin RECORD_LAYOUT GklWU8 FNC_VALUES 1 UBYTE COLUMN_DIR DIRECT /end RECORD_LAYOUT
/begin RECORD_LAYOUT GklWUw FNC_VALUES 1 UWORD COLUMN_DIR DIRECT /end RECORD_LAYOUT
/begin RECORD_LAYOUT KfAxU8AyU8SstxU16SstyU16WU16 NO_AXIS_PTS_X 1 UWORD NO_AXIS_PTS_Y 2 UWORD AXIS_PTS_X 3 UWORD INDEX_INCR DIRECT AXIS_PTS_Y 4 UWORD INDEX_INCR DIRECT FNC_VALUES 5 UWORD COLUMN_DIR DIRECT /end RECORD_LAYOUT
/begin RECORD_LAYOUT KlAUbSstUbWUb NO_AXIS_PTS_X 1 UBYTE AXIS_PTS_X 2 UBYTE INDEX_INCR DIRECT FNC_VALUES 3 UBYTE COLUMN_DIR DIRECT /end RECORD_LAYOUT
/begin RECORD_LAYOUT KlAUwSstUwWUw NO_AXIS_PTS_X 1 UWORD AXIS_PTS_X 2 UWORD INDEX_INCR DIRECT FNC_VALUES 3 UWORD COLUMN_DIR DIRECT /end RECORD_LAYOUT
/begin RECORD_LAYOUT KlAxU8SstxU16WU16 NO_AXIS_PTS_X 1 UWORD AXIS_PTS_X 2 UWORD INDEX_INCR DIRECT FNC_VALUES 3 UWORD COLUMN_DIR DIRECT /end RECORD_LAYOUT
/begin RECORD_LAYOUT KwbWR32 FNC_VALUES 1 FLOAT32_IEEE COLUMN_DIR DIRECT /end RECORD_LAYOUT
/begin RECORD_LAYOUT KwSb FNC_VALUES 1 SBYTE COLUMN_DIR DIRECT /end RECORD_LAYOUT
/begin RECORD_LAYOUT KwSw FNC_VALUES 1 SWORD COLUMN_DIR DIRECT /end RECORD_LAYOUT
/begin RECORD_LAYOUT KwUb FNC_VALUES 1 UBYTE COLUMN_DIR DIRECT /end RECORD_LAYOUT
/begin RECORD_LAYOUT KwUw FNC_VALUES 1 UWORD COLUMN_DIR DIRECT /end RECORD_LAYOUT
/begin RECORD_LAYOUT KwWR32 FNC_VALUES 1 FLOAT32_IEEE COLUMN_DIR DIRECT /end RECORD_LAYOUT
/begin RECORD_LAYOUT KwWU16 FNC_VALUES 1 UWORD COLUMN_DIR DIRECT /end RECORD_LAYOUT
/begin RECORD_LAYOUT KwWU8 FNC_VALUES 1 UBYTE COLUMN_DIR DIRECT /end RECORD_LAYOUT
/begin RECORD_LAYOUT SstAU8SstU16 NO_AXIS_PTS_X 1 UWORD AXIS_PTS_X 2 UWORD INDEX_INCR DIRECT /end RECORD_LAYOUT
/begin RECORD_LAYOUT SstAUbSstUb NO_AXIS_PTS_X 1 UBYTE AXIS_PTS_X 2 UBYTE INDEX_INCR DIRECT /end RECORD_LAYOUT
/end MODULE
/end PROJECT
