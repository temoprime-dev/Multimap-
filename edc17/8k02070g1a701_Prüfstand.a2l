ASAP2_VERSION 1 3
/begin PROJECT _9702_071D00 "ME97"
/begin HEADER "" VERSION "_9702_071D00" PROJECT_NO _9702_071D00 /end HEADER
/begin MODULE DIM ""
/begin MOD_COMMON "" BYTE_ORDER MSB_FIRST ALIGNMENT_BYTE 1 ALIGNMENT_WORD 2 ALIGNMENT_LONG 2 ALIGNMENT_FLOAT32_IEEE 4 /end MOD_COMMON
/begin CHARACTERISTIC ABKKATTAB "Abk¸hlkurve in Abh‰ngigkeit von der Abstellzeit" CURVE 0x1CC934 KlAxU8SstxU16WU8 0.9961 fak_ub_b1 0.00 0.9961
 /begin AXIS_DESCR STD_AXIS tabst_w t1sxs_uw_q1 6 0.00 65535.00 FORMAT "%8.2" DEPOSIT ABSOLUTE /end AXIS_DESCR
/end CHARACTERISTIC
/begin CHARACTERISTIC AZKELDYN "Z¸ndungen pro Zylinder bei KR-Lastdynamik => Klopferkennung" CURVE 0x1CE810 GklWU8 255.0 dez 0.00 255.0 FORMAT "%5.1"
 /begin AXIS_DESCR COM_AXIS nmot nmot_ub_q40 16 0.00 10200. AXIS_PTS_REF SNM16KRUB /end AXIS_DESCR
/end CHARACTERISTIC
/begin CHARACTERISTIC AZKRLDYN "Anzahl Z¸ndungen pro Zyl. bei KR-Lastdynamik" CURVE 0x1CE820 GklWU8 255.0 dez 0.00 255.0 FORMAT "%5.1"
 /begin AXIS_DESCR COM_AXIS nmot nmot_ub_q40 16 0.00 10200. AXIS_PTS_REF SNM16KRUB /end AXIS_DESCR
/end CHARACTERISTIC
/begin CHARACTERISTIC AZKRNDYN "Anzahl Z¸ndungen f¸r KR-Drehzahldynamik" CURVE 0x1CE830 GklWU8 255.0 dez 0.00 255.0 FORMAT "%5.1"
 /begin AXIS_DESCR COM_AXIS nmot nmot_ub_q40 16 0.00 10200. AXIS_PTS_REF SNM16KRUB /end AXIS_DESCR
/end CHARACTERISTIC
/begin CHARACTERISTIC BFGRO "Obere Schwelle f¸r Beschleunigung im FGR-Betrieb" VALUE 0x1C69A4 KwSb 55.34 bfzg_sb_q0p217 -27.78 27.56 FORMAT "%5.2" /end CHARACTERISTIC
/begin CHARACTERISTIC BFGRU "Untere Schwelle f¸r Beschleunigung im FGR-Betrieb" VALUE 0x1C69A5 KwSb 55.34 bfzg_sb_q0p217 -27.78 27.56 FORMAT "%5.2" /end CHARACTERISTIC
/begin CHARACTERISTIC CWBBFGR "Codewort f¸r BBFGR" VALUE 0x1C69A6 KwUb 255.0 dez 0.00 255.0 FORMAT "%5.1" /end CHARACTERISTIC
/begin CHARACTERISTIC CWBBKH "Codewort:  Einschaltbedingungen Katheizen nach Start" VALUE 0x1CC954 KwWU8 255.0 dez 0.00 255.0 FORMAT "%5.1" /end CHARACTERISTIC
/begin CHARACTERISTIC CWBFGROF "Codewort f¸r BBFGR bei externen Abschalt-Anforderungen" VALUE 0x1C69A7 KwUb 255.0 dez 0.00 255.0 FORMAT "%5.1" /end CHARACTERISTIC
/begin CHARACTERISTIC CWBGADAP "Codewort f¸r die BGADAP" VALUE 0x1C86FA KwUb 255.0 DEZ 0.00 255.0 FORMAT "%5.1" /end CHARACTERISTIC
/begin CHARACTERISTIC CWBGFKMS "Codewort f¸r die BGFKMS" VALUE 0x1C2CC2 KwUb 255.0 dez 0.00 255.0 FORMAT "%5.1" /end CHARACTERISTIC
/begin CHARACTERISTIC CWBGLBK "Codewort BGLBK" VALUE 0x1CA6D0 KwUb 255.0 dez 0.00 255.0 FORMAT "%5.1" /end CHARACTERISTIC
/begin CHARACTERISTIC CWDSAD "Codewort f¸r Toleranz zwischen DSS und DSU bzw. DSL" VALUE 0x1C873A KwWU8 255.0 dez 0.00 255.0 FORMAT "%5.1" /end CHARACTERISTIC
/begin CHARACTERISTIC CWDVEFO "Codeword ˆffnende Federpr¸fung" VALUE 0x1C3460 KwUb 255.0 dez 0.00 255.0 FORMAT "%5.1" /end CHARACTERISTIC
/begin CHARACTERISTIC CWKOMRH "Codewort f¸r %KOMRH" VALUE 0x1CC955 KwWU8 255.0 dez 0.00 255.0 FORMAT "%5.1" /end CHARACTERISTIC
/begin CHARACTERISTIC CWKRNLR "Codewort Notlauf KR bei Abfall eines von zwei KS" VALUE 0x1CE840 KwWU8 255.0 dez 0.00 255.0 FORMAT "%5.1" /end CHARACTERISTIC
/begin CHARACTERISTIC CWNWEGTR "Codewort Wiedereinsetzdrehzahl bei Getriebeeingriff" VALUE 0x1C6D00 KwUb 255.0 dez 0.00 255.0 FORMAT "%5.1" /end CHARACTERISTIC
/begin CHARACTERISTIC CWNWGE "Codewort Nockenwellensteuerung bei Getriebeeingriff" VALUE 0x1CA8F2 KwUb 255.0 dez 0.00 255.0 FORMAT "%5.1" /end CHARACTERISTIC
/begin CHARACTERISTIC CWNWSA "Codewort Nockenwellensteuerung Auslass" VALUE 0x1CA8F3 KwUb 255.0 dez 0.00 255.0 FORMAT "%5.1" /end CHARACTERISTIC
/begin CHARACTERISTIC CWNWSE "Codewort Nockenwellensteuerung Einlass" VALUE 0x1CA8F4 KwUb 255.0 dez 0.00 255.0 FORMAT "%5.1" /end CHARACTERISTIC
/begin CHARACTERISTIC CWNWSG "Codewort Nockenwellensteuerung global" VALUE 0x1CA8F5 KwUb 255.0 dez 0.00 255.0 FORMAT "%5.1" /end CHARACTERISTIC
/begin CHARACTERISTIC CWSAWE "Codewort Schubabschalten - Wiedereinsetzen" VALUE 0x1C6D01 KwUb 255.0 dez 0.00 255.0 FORMAT "%5.1" /end CHARACTERISTIC
/begin CHARACTERISTIC CWTIPIN "Codewort f¸r Tip in - Funktion" VALUE 0x1C60E4 KwWU8 255.0 dez 0.00 255.0 FORMAT "%5.1" /end CHARACTERISTIC
/begin CHARACTERISTIC DFKMSMN "Delta FKMSDKMN zum R¸cksetzen von B_fkmsmn" VALUE 0x1C2CC6 KwUw 3.999939 fak_uw_b4 0.00 3.999939 FORMAT "%8.6" /end CHARACTERISTIC
/begin CHARACTERISTIC DFKMSMX "Delta FKMSDKMX zum R¸cksetzen von B_fkmsmx" VALUE 0x1C2CC8 KwUw 3.999939 fak_uw_b4 0.00 3.999939 FORMAT "%8.6" /end CHARACTERISTIC
/begin CHARACTERISTIC DFKPVMN "Delta FKPVDKMN zum R¸cksetzen von B_fkpvmn" VALUE 0x1C873C KwUw 3.999939 fak_uw_b4 0.00 3.999939 FORMAT "%8.6" /end CHARACTERISTIC
/begin CHARACTERISTIC DFKPVMX "Delta FKPVDKMX zum R¸cksetzen von B_fkpvmx" VALUE 0x1C873E KwUw 3.999939 fak_uw_b4 0.00 3.999939 FORMAT "%8.6" /end CHARACTERISTIC
/begin CHARACTERISTIC DFRMOFNML "frm-Offset-Schwelle (negativ) in Abh‰ngigkeit vom Luftmassenfluﬂ" CURVE 0x1CBBD4 KlAxU8SstxU16WS16 1.999969 fak_sw_b1 -1.000000 0.9999695 FORMAT "%8.6"
 /begin AXIS_DESCR STD_AXIS ml_w m_uw_b6553p5 6 0.00 6553.500 FORMAT "%8.3" DEPOSIT ABSOLUTE /end AXIS_DESCR
/end CHARACTERISTIC
/begin CHARACTERISTIC DFRMOFNXKT "frm-Offset-Schwelle (negativ): Kontrolle Vorsteuerproblem (Kurztest)" VALUE 0x1CBC08 KwWS16 1.999969 fak_sw_b1 -1.000000 0.9999695 FORMAT "%8.6" /end CHARACTERISTIC
/begin CHARACTERISTIC DFRMOFPML "frm-Offset-Schwelle (positiv) in Abh‰ngigkeit vom Luftmassenfluﬂ" CURVE 0x1CBBEE KlAxU8SstxU16WS16 1.999969 fak_sw_b1 -1.000000 0.9999695 FORMAT "%8.6"
 /begin AXIS_DESCR STD_AXIS ml_w m_uw_b6553p5 6 0.00 6553.500 FORMAT "%8.3" DEPOSIT ABSOLUTE /end AXIS_DESCR
/end CHARACTERISTIC
/begin CHARACTERISTIC DFRMOFPXKT "frm-Offset-Schwelle (positiv): Kontrolle Vorsteuerproblem (Kurztest)" VALUE 0x1CBC0A KwWS16 1.999969 fak_sw_b1 -1.000000 0.9999695 FORMAT "%8.6" /end CHARACTERISTIC
/begin CHARACTERISTIC DFTEDS "Hysteresebreite Beladung f¸r Umschaltung auf Dauertankentl¸ftung" VALUE 0x1CDD6A KwSw 127.9980 fak_sw_b64 -64.00000 63.99805 FORMAT "%8.5" /end CHARACTERISTIC
/begin CHARACTERISTIC DKPSTGMIN "min. Steigung des DK-Poti zur Umr. abs. auf rel. Winkel im worst case" VALUE 0x1C3478 KwUw 39.99939 rel_uw_b40 0.00 39.99939 FORMAT "%8.5" /end CHARACTERISTIC
/begin CHARACTERISTIC DLRPIDSTMN "min. Schwelle f¸r PWM-Tastverh‰ltnis des DLR bei temp. UMA-Adapt." VALUE 0x1C347A KwUw 99.99847 rel_uw_b100 0.00 99.99847 FORMAT "%8.5" /end CHARACTERISTIC
/begin CHARACTERISTIC DMRFATE "Hysterese Hochlasterkennung" VALUE 0x1CDD58 KwUb 99.61 rel_ub_b99p6 0.00 99.61 FORMAT "%5.2" /end CHARACTERISTIC
/begin CHARACTERISTIC DNLLSNW "Delta Leerlaufsolldrehzahl zur Aktivierung der Nockenwellenfunktionalit‰t" VALUE 0x1CA8F6 KwUb 2550. nmot_ub_q10 0.00 2550. FORMAT "%5.0" /end CHARACTERISTIC
/begin CHARACTERISTIC DNSAH "Delta n SA high bezogen auf nWE" VALUE 0x1C6D02 KwUb 5080. nmot_ub_q40 0.00 5080. FORMAT "%5.0" /end CHARACTERISTIC
/begin CHARACTERISTIC DNSAL "Delta n SA low bezogen auf nWE" VALUE 0x1C6D03 KwUb 5080. nmot_ub_q40 0.00 5080. FORMAT "%5.0" /end CHARACTERISTIC
/begin CHARACTERISTIC DNSLL "Schubabschalte-Hysterese bei WE im Leerlauf" VALUE 0x1C6D04 KwUb 10200. nmot_ub_q40 0.00 10200. FORMAT "%5.0" /end CHARACTERISTIC
/begin CHARACTERISTIC DNSLLK "Schubabschalte-Hysterese bei WE im Leerlauf und geˆffneter Kupplung" VALUE 0x1C6D05 KwUb 10200. nmot_ub_q40 0.00 10200. FORMAT "%5.0" /end CHARACTERISTIC
/begin CHARACTERISTIC DNVSA "Schubabschaltedrehzahlanhebung bei kleiner Geschwindigkeit" VALUE 0x1C6D06 KwUb 10200. nmot_ub_q40 0.00 10200. FORMAT "%5.0" /end CHARACTERISTIC
/begin CHARACTERISTIC DNWEK "Delta n f¸r WE bei Klima (AC)" VALUE 0x1C6D07 KwUb 10200. nmot_ub_q40 0.00 10200. FORMAT "%5.0" /end CHARACTERISTIC
/begin CHARACTERISTIC DNWEOFF "Drehzahloffset zu nstat f¸r nwe" VALUE 0x1C6D08 KwUb 10200. nmot_ub_q40 0.00 10200. FORMAT "%5.0" /end CHARACTERISTIC
/begin CHARACTERISTIC DPLMDSFE "Delta pslm-psdss Schwelle zur Erkennung fkfupsrl eingeschwungen" VALUE 0x1C8702 KwUw 2559.961 p_uw_q0p039 0.00 2559.961 FORMAT "%8.3" /end CHARACTERISTIC
/begin CHARACTERISTIC DPLMDSOE "Delta pslm-psdss Schwelle zur Erkennung ofpbrint eingeschwungen" VALUE 0x1C8704 KwSw 1279.961 p_sw_q0p039 0.00 1279.961 FORMAT "%8.3" /end CHARACTERISTIC
/begin CHARACTERISTIC DPLMDSOEKT "Delta pslm-psdss Schwelle zur Erkennung ofpbrint eingeschwungen beim Kurztrip" VALUE 0x1C8706 KwUw 1280.000 p_uw_q0p039 0.00 1280.000 FORMAT "%8.3" /end CHARACTERISTIC
/begin CHARACTERISTIC DPLMDSOEOT "Delta pslm-psdss Schwelle zur Erkennung ofpbrint eingeschwungen ohne Totzone" VALUE 0x1C8708 KwUw 1280.000 p_uw_q0p039 0.00 1280.000 FORMAT "%8.3" /end CHARACTERISTIC
/begin CHARACTERISTIC DPLMDSTZF "Differenz modellierter zu gemessenem Saugrohrdruck Totzone Faktor" VALUE 0x1C870A KwSw 1279.961 p_uw_q0p039 0.00 1279.961 FORMAT "%8.3" /end CHARACTERISTIC
/begin CHARACTERISTIC DPLMDSTZO "Differenz modellierter zu gemessenem Saugrohrdruck Totzone Offset" VALUE 0x1C870C KwUw 1280.000 p_uw_q0p039 0.00 1280.000 FORMAT "%8.3" /end CHARACTERISTIC
/begin CHARACTERISTIC DTKIVKM "Hysterese Katalysatortemperaturregelschwelle f¸r Kat warmhalten" VALUE 0x1CC948 KwWU16 1535.977 temp_q0p0234 0.00 1535.977 FORMAT "%8.3" /end CHARACTERISTIC
/begin CHARACTERISTIC DUBLBZ "Spannungsoffset f¸r Ladebilanzberechnung" VALUE 0x1CEA10 KwUb 24.02 spg_ubatt 0.00 24.02 FORMAT "%5.2" /end CHARACTERISTIC
/begin CHARACTERISTIC DUDKNLPO "Toleranzband f¸r NLP nach oben (inkl. R¸)" VALUE 0x1C347C KwUw 5.004090 spg_uw_q0p001222 0.00 5.004090 FORMAT "%8.6" /end CHARACTERISTIC
/begin CHARACTERISTIC DUDKNLPU "Toleranzband f¸r NLP nach unten" VALUE 0x1C347E KwUw 5.004090 spg_uw_q0p001222 0.00 5.004090 FORMAT "%8.6" /end CHARACTERISTIC
/begin CHARACTERISTIC DUDKPTMP "Delta eines Rampenschrittes bei der temp. UMA-Adaption" VALUE 0x1C3480 KwUw 80.07888 spg_uw_q0p001222 0.004888000 80.08377 FORMAT "%8.5" /end CHARACTERISTIC
/begin CHARACTERISTIC DULBKNLPCH "Spg.-Delta auf NLP-Check-Wert um Uma-Lernen zu starten (LBK)" VALUE 0x1CA6D6 KwUw 319.9951 spg_q0p00488 0.00 319.9951 FORMAT "%8.4" /end CHARACTERISTIC
/begin CHARACTERISTIC DULBKOFFST "Spannungsdelta um Defaulthub zu reduzieren bei OMA-Lernen (LBK)" VALUE 0x1CA6D8 KwUw 319.9951 spg_q0p00488 0.00 319.9951 FORMAT "%8.4" /end CHARACTERISTIC
/begin CHARACTERISTIC DVAQUGMX "Max. zul. Geschw.differenz bei Aquaplaningerkennung f¸r groﬂe Geschw." VALUE 0x1C69B0 KwUw 511.9922 vfzg_uw_b512 0.00 511.9922 FORMAT "%8.4" /end CHARACTERISTIC
/begin CHARACTERISTIC DVAQUKMX "Max. zul. Geschw.differenz bei Aquaplaningerkennung f¸r kleine Geschw." VALUE 0x1C69B2 KwUw 511.9922 vfzg_uw_b512 0.00 511.9922 FORMAT "%8.4" /end CHARACTERISTIC
/begin CHARACTERISTIC DVFGREO "Delta-Geschw. f¸r obere FGR-Einschaltgeschwindigkeit" VALUE 0x1C69B4 KwUw 511.9922 vfzg_uw_b512 0.00 511.9922 FORMAT "%8.4" /end CHARACTERISTIC
/begin CHARACTERISTIC DVFGREU "Delta-Geschw. f¸r untere FGR-Einschaltgeschwindigkeit" VALUE 0x1C69B6 KwUw 511.9922 vfzg_uw_b512 0.00 511.9922 FORMAT "%8.4" /end CHARACTERISTIC
/begin CHARACTERISTIC DVIVZMX "Max. zul. Abweichung zw. Istgeschw. und Zielgeschw. bei FGR-Konstantfahrt" VALUE 0x1C69B8 KwUw 511.9922 vfzg_uw_b512 0.00 511.9922 FORMAT "%8.4" /end CHARACTERISTIC
/begin CHARACTERISTIC DVSA "delta Geschwindigkeitsschwelle f¸r SA-Drehzahlanhebung" VALUE 0x1C6D09 KwUb 318.8 vfzg_ub_q1p25 0.00 318.8 FORMAT "%5.1" /end CHARACTERISTIC
/begin CHARACTERISTIC DVZVIMX "Max. zul. Abweichung zw. Zielgeschw. und Istgeschw. bei FGR-Konstantfahrt" VALUE 0x1C69BA KwUw 511.9922 vfzg_uw_b512 0.00 511.9922 FORMAT "%8.4" /end CHARACTERISTIC
/begin CHARACTERISTIC DWLBKOMAX "Toleranzband LBK-Position ab der oberer Anschlag als g¸ltig akzept. wird" VALUE 0x1CA6DA KwSw 1599.976 rel_sw_q0p02441 -800.0000 799.9756 FORMAT "%8.4" /end CHARACTERISTIC
/begin CHARACTERISTIC DWLBKUMAX "Toleranzband LBK-Position ab der unterer Anschlag als g¸ltig akzept. wird" VALUE 0x1CA6DC KwSw 1599.976 rel_sw_q0p02441 -800.0000 799.9756 FORMAT "%8.4" /end CHARACTERISTIC
/begin CHARACTERISTIC DWNWADRPA "Max. Abweichung Nockenwellenpos. von Referenzpos. f¸r Adaptionsfreigabe Auslass" VALUE 0x1CA9B0 KwSw 255.9922 kw_sw_q0p0078 0.00 255.9922 FORMAT "%8.4" /end CHARACTERISTIC
/begin CHARACTERISTIC DWNWADRPE "Max. Abweichung Nockenwellenpos. von Referenzpos. f¸r Adaptionsfreigabe Einlass" VALUE 0x1CA9B2 KwSw 255.9922 kw_sw_q0p0078 0.00 255.9922 FORMAT "%8.4" /end CHARACTERISTIC
/begin CHARACTERISTIC DWNWSKA "Sollwinkelabweichung f¸r Abbruch Phasenflankenadaption Auslaﬂnockenwelle" VALUE 0x1CA9B4 KwSw 255.9922 kw_sw_q0p0078 0.00 255.9922 FORMAT "%8.4" /end CHARACTERISTIC
/begin CHARACTERISTIC DWNWSKE "Sollwinkelabweichung f¸r Abbruch Phasenflankenadaption Einlaﬂnockenwelle" VALUE 0x1CA9B6 KwSw 255.9922 kw_sw_q0p0078 0.00 255.9922 FORMAT "%8.4" /end CHARACTERISTIC
/begin CHARACTERISTIC ENSAKHG "Freigabe Schubabschalten bei Katheizen gangabhaengig" VALUE 0x1C6D0A KwUb 255.0 dez 0.00 255.0 FORMAT "%5.1" /end CHARACTERISTIC
/begin CHARACTERISTIC FBWRMSL "Bewertungsfaktor f¸r gleitende Mittelwertsbildung von rmsl" VALUE 0x1CBC18 KwWU8 0.9961 fak_q0p0039 0.00 0.9961 /end CHARACTERISTIC
/begin CHARACTERISTIC FHOKH "minimaler Hˆhenfaktor f¸r Katheizen" VALUE 0x1CC94A KwWU16 3.999939 fak_uw_b4 0.00 3.999939 FORMAT "%8.6" /end CHARACTERISTIC
/begin CHARACTERISTIC FKEEV0N "Korrekturfaktor zur Einspritzzeitkorrektur Ev1" CURVE 0x1C54E0 GklWU8 1.992 fak_ub_b2 0.00 1.992 FORMAT "%5.3"
 /begin AXIS_DESCR COM_AXIS nmot nmot_ub_q40 8 0.00 10200. AXIS_PTS_REF SNM08GKUB /end AXIS_DESCR
/end CHARACTERISTIC
/begin CHARACTERISTIC FKEEV1N "Korrekturfaktor zur Einspritzzeitkorrektur Ev2" CURVE 0x1C54E8 GklWU8 1.992 fak_ub_b2 0.00 1.992 FORMAT "%5.3"
 /begin AXIS_DESCR COM_AXIS nmot nmot_ub_q40 8 0.00 10200. AXIS_PTS_REF SNM08GKUB /end AXIS_DESCR
/end CHARACTERISTIC
/begin CHARACTERISTIC FKEEV2N "Korrekturfaktor zur Einspritzzeitkorrektur Ev3" CURVE 0x1C54F0 GklWU8 1.992 fak_ub_b2 0.00 1.992 FORMAT "%5.3"
 /begin AXIS_DESCR COM_AXIS nmot nmot_ub_q40 8 0.00 10200. AXIS_PTS_REF SNM08GKUB /end AXIS_DESCR
/end CHARACTERISTIC
/begin CHARACTERISTIC FKEEV3N "Korrekturfaktor zur Einspritzzeitkorrektur Ev4" CURVE 0x1C54F8 GklWU8 1.992 fak_ub_b2 0.00 1.992 FORMAT "%5.3"
 /begin AXIS_DESCR COM_AXIS nmot nmot_ub_q40 8 0.00 10200. AXIS_PTS_REF SNM08GKUB /end AXIS_DESCR
/end CHARACTERISTIC
/begin CHARACTERISTIC FKEEV4N "Korrekturfaktor zur Einspritzzeitkorrektur Ev5" CURVE 0x1C5500 GklWU8 1.992 fak_ub_b2 0.00 1.992 FORMAT "%5.3"
 /begin AXIS_DESCR COM_AXIS nmot nmot_ub_q40 8 0.00 10200. AXIS_PTS_REF SNM08GKUB /end AXIS_DESCR
/end CHARACTERISTIC
/begin CHARACTERISTIC FKEEV5N "Korrekturfaktor zur Einspritzzeitkorrektur Ev6" CURVE 0x1C5508 GklWU8 1.992 fak_ub_b2 0.00 1.992 FORMAT "%5.3"
 /begin AXIS_DESCR COM_AXIS nmot nmot_ub_q40 8 0.00 10200. AXIS_PTS_REF SNM08GKUB /end AXIS_DESCR
/end CHARACTERISTIC
/begin CHARACTERISTIC FKEEV6N "Korrekturfaktor zur Einspritzzeitkorrektur Ev7" CURVE 0x1C5510 GklWU8 1.992 fak_ub_b2 0.00 1.992 FORMAT "%5.3"
 /begin AXIS_DESCR COM_AXIS nmot nmot_ub_q40 8 0.00 10200. AXIS_PTS_REF SNM08GKUB /end AXIS_DESCR
/end CHARACTERISTIC
/begin CHARACTERISTIC FKEEV7N "Korrekturfaktor zur Einspritzzeitkorrektur Ev8" CURVE 0x1C5518 GklWU8 1.992 fak_ub_b2 0.00 1.992 FORMAT "%5.3"
 /begin AXIS_DESCR COM_AXIS nmot nmot_ub_q40 8 0.00 10200. AXIS_PTS_REF SNM08GKUB /end AXIS_DESCR
/end CHARACTERISTIC
/begin CHARACTERISTIC FKFUPSRLMN "Minimaler Intergratoradaptionswert f¸r fupsrl-Adaption" VALUE 0x1C870E KwUw 1.999969 fak_uw_b2 0.00 1.999969 FORMAT "%8.6" /end CHARACTERISTIC
/begin CHARACTERISTIC FKFUPSRLMX "Maximaler Intergratoradaptionswert f¸r fupsrl-Adaption" VALUE 0x1C8710 KwUw 1.999969 fak_uw_b2 0.00 1.999969 FORMAT "%8.6" /end CHARACTERISTIC
/begin CHARACTERISTIC FKHABMN "Schwelle Abregelfaktor Katheizen" VALUE 0x1CC956 KwWU8 0.9961 fak_ub_b1 0.00 0.9961 /end CHARACTERISTIC
/begin CHARACTERISTIC FKMSDKMN "min.Korrekturfaktor schneller Massenstromabgleich" VALUE 0x1C2CCA KwUw 3.999939 fak_uw_b4 0.00 3.999939 FORMAT "%8.6" /end CHARACTERISTIC
/begin CHARACTERISTIC FKMSDKMX "max.Korrekturfaktor schneller Massenstromabgleich" VALUE 0x1C2CCC KwUw 3.999939 fak_uw_b4 0.00 3.999939 FORMAT "%8.6" /end CHARACTERISTIC
/begin CHARACTERISTIC FKPVDKMN "Minimaler Korrekturfaktor langsamer Massenstomabgleich" VALUE 0x1C8740 KwUw 3.999939 fak_uw_b4 0.00 3.999939 FORMAT "%8.6" /end CHARACTERISTIC
/begin CHARACTERISTIC FKPVDKMX "Maximaler Korrekturfaktor langsamer Massenstomabgleich" VALUE 0x1C8742 KwUw 3.999939 fak_uw_b4 0.00 3.999939 FORMAT "%8.6" /end CHARACTERISTIC
/begin CHARACTERISTIC FKPVDKPUGD "Druckverh‰ltnis, ab dem fkpvdk_w nicht mehr gerechnet wird" VALUE 0x1C8744 KwUw 1.999969 fak_uw_b2 0.00 1.999969 FORMAT "%8.6" /end CHARACTERISTIC
/begin CHARACTERISTIC FMRFAZTE "Gewichtung der Drehzahl um jetzige Leistung zu berechnen" CURVE 0x1CDD5C KlAUbSstUbWUb 3.984 fak_ub_b4 0.00 3.984 FORMAT "%5.3"
 /begin AXIS_DESCR STD_AXIS nmot nmot_ub_q40 4 0.00 10200. FORMAT "%5.0" DEPOSIT ABSOLUTE /end AXIS_DESCR
/end CHARACTERISTIC
/begin CHARACTERISTIC FPRAT "Ansauglufttemperaturschwelle f¸r DV-E-Federpr¸fung" VALUE 0x1C3461 KwUb 191.3 temp_ub_q0p75_o48 -48.00 143.3 FORMAT "%5.1" /end CHARACTERISTIC
/begin CHARACTERISTIC FPRMT "Motortemperaturschwelle f¸r DV-E-Federpr¸fung" VALUE 0x1C3462 KwUb 191.3 temp_ub_q0p75_o48 -48.00 143.3 FORMAT "%5.1" /end CHARACTERISTIC
/begin CHARACTERISTIC FPRNMAX "Motordrehzahlschwelle f¸r DV-E-Federpr¸fung" VALUE 0x1C3463 KwUb 2550. nmot_ub_q10 0.00 2550. FORMAT "%5.0" /end CHARACTERISTIC
/begin CHARACTERISTIC FPRTIM1_T "DV-E-Federpr¸fung, Wartezeit in Pr¸fschritt 1" VALUE 0x1C3464 KwUb 2.540 t10msxs_ub_b2p55 0.01000 2.550 FORMAT "%5.3" /end CHARACTERISTIC
/begin CHARACTERISTIC FPRTIM2_T "DV-E-Federpr¸fung, Wartezeit in Pr¸fschritt 2" VALUE 0x1C3465 KwUb 2.540 t10msxs_ub_b2p55 0.01000 2.550 FORMAT "%5.3" /end CHARACTERISTIC
/begin CHARACTERISTIC FPRTIM3_T "DV-E-Federpr¸fung: Wartezeit in Pr¸fschritt 5" VALUE 0x1C3466 KwUb 2.540 t10msxs_ub_b2p55 0.01000 2.550 FORMAT "%5.3" /end CHARACTERISTIC
/begin CHARACTERISTIC FPRTIM4_T "DV-E-Federpr¸fung: Wartezeit in Pr¸fschritt 6" VALUE 0x1C3467 KwUb 2.540 t10msxs_ub_b2p55 0.01000 2.550 FORMAT "%5.3" /end CHARACTERISTIC
/begin CHARACTERISTIC FSWSTSKH "Faktor zur Korrektur der W‰rmestromanforderung in Abh‰ngigkeit von tmst" CURVE 0x1CC888 GklWU8 0.9961 fak_ub_b1 0.00 0.9961
 /begin AXIS_DESCR COM_AXIS tmst temp_ub_q0p75_o48 8 -48.00 143.3 AXIS_PTS_REF STS08KHUW /end AXIS_DESCR
/end CHARACTERISTIC
/begin CHARACTERISTIC FTEADZU "Schwelle Beladung f¸r Unterbrechung TE-Phase f¸r Diagnose Funktionen" VALUE 0x1CDD6C KwSw 127.9980 fak_sw_b64 -64.00000 63.99805 FORMAT "%8.5" /end CHARACTERISTIC
/begin CHARACTERISTIC FTEDS "Schwelle Beladung f¸r Umschaltung auf Dauertankentl¸ftung" VALUE 0x1CDD6E KwSw 127.9980 fak_sw_b64 -64.00000 63.99805 FORMAT "%8.5" /end CHARACTERISTIC
/begin CHARACTERISTIC FWIKATST "Faktor zur Beschreibung der Heizw‰rme des KAT's im Start" VALUE 0x1CC957 KwWU8 3264. qptemp_q12p8 0.00 3264. FORMAT "%5.0" /end CHARACTERISTIC
/begin CHARACTERISTIC GAFGRO "Max. zul. Gang bei FGR-Betrieb" VALUE 0x1C69A8 KwUb 255.0 dez 0.00 255.0 FORMAT "%5.1" /end CHARACTERISTIC
/begin CHARACTERISTIC GAFGRU "Min. zul. Gang bei FGR-Betrieb" VALUE 0x1C69A9 KwUb 255.0 dez 0.00 255.0 FORMAT "%5.1" /end CHARACTERISTIC
/begin CHARACTERISTIC HYNMOTNW "Hysterese f¸r nmot_w zur Adressierung von Kennfeld" VALUE 0x1CA938 KwUb 10200. nmot_ub_q40 0.00 10200. FORMAT "%5.0" /end CHARACTERISTIC
/begin CHARACTERISTIC HYRLNW "Hysterese f¸r rlnw zur Adressierung Kennfeld" VALUE 0x1CA9B8 KwUw 1535.977 rel_uw_q0p0234 0.00 1535.977 FORMAT "%8.3" /end CHARACTERISTIC
/begin CHARACTERISTIC IMLNWKHMX "Schwelle Lufmassenintegral Katheizen f¸r Ende Nockenwellenkatheizfunktionalit‰t" VALUE 0x1CA8F7 KwUb 0.9961 fak_ub_b1 0.00 0.9961 /end CHARACTERISTIC
/begin CHARACTERISTIC KFDYESPF "Lastdynamikerkennungsschwelle" MAP 0x1CE670 GkfWS16 2559.961 p_sw_q0p039 -1280.000 1279.961 FORMAT "%8.3"
 /begin AXIS_DESCR COM_AXIS nmot nmot_ub_q40 16 0.00 10200. AXIS_PTS_REF SNM16KRUB /end AXIS_DESCR
 /begin AXIS_DESCR COM_AXIS rl rel_ub_q0p75 4 0.00 191.3 AXIS_PTS_REF SRL04DYUB /end AXIS_DESCR
/end CHARACTERISTIC
/begin CHARACTERISTIC KFDYESPFOF "Dynamikvorhalt Offsetschwelle" MAP 0x1CE6F0 GkfWS16 2559.961 p_sw_q0p039 -1280.000 1279.961 FORMAT "%8.3"
 /begin AXIS_DESCR COM_AXIS nmot nmot_ub_q40 16 0.00 10200. AXIS_PTS_REF SNM16KRUB /end AXIS_DESCR
 /begin AXIS_DESCR COM_AXIS rl rel_ub_q0p75 4 0.00 191.3 AXIS_PTS_REF SRL04DYUB /end AXIS_DESCR
/end CHARACTERISTIC
/begin CHARACTERISTIC KFKHSWS "Kennfeld Anforderung W‰rmestrom im Abgas f¸r Katalysatorheizen nach Start" MAP 0x1CC8A0 KfAxU8AyU8SstxU16SstyU16WU16 65534.00 leist_q2 0.00 65534.00 FORMAT "%8.2"
 /begin AXIS_DESCR STD_AXIS nmot_w nmot_uw_q0p25 4 0.00 16383.75 FORMAT "%8.2" DEPOSIT ABSOLUTE /end AXIS_DESCR
 /begin AXIS_DESCR STD_AXIS mifal_w rel_uw_b100 4 0.00 99.99847 FORMAT "%8.5" DEPOSIT ABSOLUTE /end AXIS_DESCR
/end CHARACTERISTIC
/begin CHARACTERISTIC KFKHSWSLL "Kennfeld Anforderung (im LL)  f¸r W‰rmestrom im Abgas f¸r Kat-Heizen nach Start" MAP 0x1CC8D4 KfAxU8AyU8SstxU16SstyU16WU16 65534.00 leist_q2 0.00 65534.00 FORMAT "%8.2"
 /begin AXIS_DESCR STD_AXIS nmot_w nmot_uw_q0p25 4 0.00 16383.75 FORMAT "%8.2" DEPOSIT ABSOLUTE /end AXIS_DESCR
 /begin AXIS_DESCR STD_AXIS mifal_w rel_uw_b100 4 0.00 99.99847 FORMAT "%8.5" DEPOSIT ABSOLUTE /end AXIS_DESCR
/end CHARACTERISTIC
/begin CHARACTERISTIC KFLAMSLS "Kennfeld Lambda-Korrektur bei Sekund‰rluft" MAP 0x1C4E68 KfAxUbAyUbSstxUbSstyUbWUb 1.992 fak_ub_b2 0.00 1.992 FORMAT "%5.3"
 /begin AXIS_DESCR STD_AXIS nmot nmot_ub_q40 8 0.00 10200. FORMAT "%5.0" DEPOSIT ABSOLUTE /end AXIS_DESCR
 /begin AXIS_DESCR STD_AXIS rl rel_ub_q0p75 8 0.00 191.3 FORMAT "%5.1" DEPOSIT ABSOLUTE /end AXIS_DESCR
/end CHARACTERISTIC
/begin CHARACTERISTIC KFNWADA "Festlegung des Adaptionsbereichs f¸r Flankenadaption Phasensensor Auslass" MAP 0x1CA93C KfAxUbAyUbSstxUbSstyUbWUb 255.0 dez 0.00 255.0 FORMAT "%5.1"
 /begin AXIS_DESCR STD_AXIS nmotkf nmot_ub_q40 4 0.00 10200. FORMAT "%5.0" DEPOSIT ABSOLUTE /end AXIS_DESCR
 /begin AXIS_DESCR STD_AXIS rlnwkf rel_ub_q0p75 4 0.00 191.3 FORMAT "%5.1" DEPOSIT ABSOLUTE /end AXIS_DESCR
/end CHARACTERISTIC
/begin CHARACTERISTIC KFNWADE "Festlegung des Adaptionsbereichs f¸r Flankenadaption Phasensensor Einlass" MAP 0x1CA958 KfAxUbAyUbSstxUbSstyUbWUb 255.0 dez 0.00 255.0 FORMAT "%5.1"
 /begin AXIS_DESCR STD_AXIS nmotkf nmot_ub_q40 4 0.00 10200. FORMAT "%5.0" DEPOSIT ABSOLUTE /end AXIS_DESCR
 /begin AXIS_DESCR STD_AXIS rlnwkf rel_ub_q0p75 4 0.00 191.3 FORMAT "%5.1" DEPOSIT ABSOLUTE /end AXIS_DESCR
/end CHARACTERISTIC
/begin CHARACTERISTIC KFNWADGA "Festlegung des Adaptionsbereichs f¸r Erste Flankenadaption Phasensensor Auslass" MAP 0x1CA974 KfAxUbAyUbSstxUbSstyUbWUb 255.0 dez 0.00 255.0 FORMAT "%5.1"
 /begin AXIS_DESCR STD_AXIS nmotkf nmot_ub_q40 4 0.00 10200. FORMAT "%5.0" DEPOSIT ABSOLUTE /end AXIS_DESCR
 /begin AXIS_DESCR STD_AXIS rlnwkf rel_ub_q0p75 4 0.00 191.3 FORMAT "%5.1" DEPOSIT ABSOLUTE /end AXIS_DESCR
/end CHARACTERISTIC
/begin CHARACTERISTIC KFNWADGE "Festlegung des Adaptionsbereichs f¸r Erste Flankenadaption Phasensensor Einlass" MAP 0x1CA990 KfAxUbAyUbSstxUbSstyUbWUb 255.0 dez 0.00 255.0 FORMAT "%5.1"
 /begin AXIS_DESCR STD_AXIS nmotkf nmot_ub_q40 4 0.00 10200. FORMAT "%5.0" DEPOSIT ABSOLUTE /end AXIS_DESCR
 /begin AXIS_DESCR STD_AXIS rlnwkf rel_ub_q0p75 4 0.00 191.3 FORMAT "%5.1" DEPOSIT ABSOLUTE /end AXIS_DESCR
/end CHARACTERISTIC
/begin CHARACTERISTIC KFNWEGM "Wiedereinsetzdrehzahlkennfeld" MAP 0x1CF644 GkfWUb 10200. nmot_ub_q40 0.00 10200. FORMAT "%5.0"
 /begin AXIS_DESCR COM_AXIS tmot temp_ub_q0p75_o48 5 -48.00 143.3 AXIS_PTS_REF STM05SAUB /end AXIS_DESCR
 /begin AXIS_DESCR COM_AXIS gangi dez 8 0.00 255.0 AXIS_PTS_REF SGA08MDUB /end AXIS_DESCR
/end CHARACTERISTIC
/begin CHARACTERISTIC KFTVSA "Verzˆgerungszeit f¸r Schubabschalten" MAP 0x1CF66C GkfWUb 2.550 t10msxs_ub_b2p55 0.00 2.550 FORMAT "%5.3"
 /begin AXIS_DESCR COM_AXIS tmot temp_ub_q0p75_o48 5 -48.00 143.3 AXIS_PTS_REF STM05SAUB /end AXIS_DESCR
 /begin AXIS_DESCR COM_AXIS nmot nmot_ub_q40 8 0.00 10200. AXIS_PTS_REF SNM08__UB /end AXIS_DESCR
/end CHARACTERISTIC
/begin CHARACTERISTIC KFTVSAKAT "Verzˆgerungszeit Schubabschalten bei hohen Drehzahlen und hohen KAT-Temperatur" MAP 0x1CF694 GkfWUb 10200.0 t40ms_ub_b10200 0.00 10200.0 FORMAT "%7.1"
 /begin AXIS_DESCR COM_AXIS nmot nmot_ub_q40 8 0.00 10200. AXIS_PTS_REF SNM08__UB /end AXIS_DESCR
 /begin AXIS_DESCR COM_AXIS tkatm temp_ub_q5_o50 4 -50.00 1225. AXIS_PTS_REF STK04SAUB /end AXIS_DESCR
/end CHARACTERISTIC
/begin CHARACTERISTIC KFWNWWKA "Wichtungskennfeld f¸r NW-Sollwinkel  Auslaﬂseitig" MAP 0x1CC7F8 GkfWU8 1.992 fak_ub_b2 0.00 1.992 FORMAT "%5.3"
 /begin AXIS_DESCR COM_AXIS wistr_w fak_uw_b1 8 0.00 0.9999847 AXIS_PTS_REF SWR08KHUW /end AXIS_DESCR
 /begin AXIS_DESCR COM_AXIS tmst temp_ub_q0p75_o48 8 -48.00 143.3 AXIS_PTS_REF STS08KHUW /end AXIS_DESCR
/end CHARACTERISTIC
/begin CHARACTERISTIC KFWNWWKE "Wichtungskennfeld f¸r NW-Sollwinkel  Einlaﬂseitig" MAP 0x1CC838 GkfWU8 1.992 fak_ub_b2 0.00 1.992 FORMAT "%5.3"
 /begin AXIS_DESCR COM_AXIS wistr_w fak_uw_b1 8 0.00 0.9999847 AXIS_PTS_REF SWR08KHUW /end AXIS_DESCR
 /begin AXIS_DESCR COM_AXIS tmst temp_ub_q0p75_o48 8 -48.00 143.3 AXIS_PTS_REF STS08KHUW /end AXIS_DESCR
/end CHARACTERISTIC
/begin CHARACTERISTIC KIFKFUPSRL "Integratorbeiwert  f¸r fupsrl-Adaption" VALUE 0x1C8712 KwUw 19.99969 t50msxs_q3p052em4 0.00 19.99969 FORMAT "%8.5" /end CHARACTERISTIC
/begin CHARACTERISTIC KIMSALL "Beiwert f¸r Leerlaufluftmassenintegrator f¸r E-Gas" VALUE 0x1C8746 KwUw 2559.0000000 mk1sxs_b2560 1.0000000000 2560.0000000 FORMAT "%12.7" /end CHARACTERISTIC
/begin CHARACTERISTIC KIOFAPIRG "Integratorbeiwert  f¸r pirg-Offsetadaption" VALUE 0x1C8714 KwUw 19.99969 t50msxs_q3p052em4 0.00 19.99969 FORMAT "%8.5" /end CHARACTERISTIC
/begin CHARACTERISTIC KLFANFKH "Wichtungsfaktor f¸r Anforderungen zum Katheizen (wsanfkh_w, tanfkh_w)" CURVE 0x1CC890 GklWU8 0.9961 fak_ub_b1 0.00 0.9961
 /begin AXIS_DESCR COM_AXIS wistr_w fak_uw_b1 8 0.00 0.9999847 AXIS_PTS_REF SWR08KHUW /end AXIS_DESCR
/end CHARACTERISTIC
/begin CHARACTERISTIC KLFLAKH "Wichtungsfaktor f¸r Lambda-Steuerfaktor flakh bei Katheizen" CURVE 0x1CC898 GklWU8 0.9961 fak_ub_b1 0.00 0.9961
 /begin AXIS_DESCR COM_AXIS wistr_w fak_uw_b1 8 0.00 0.9999847 AXIS_PTS_REF SWR08KHUW /end AXIS_DESCR
/end CHARACTERISTIC
/begin CHARACTERISTIC KLKWWSANFV "Kennlinie Abgasw‰rmestromanforderung zum Vorkatalysatorwarmhalten" CURVE 0x1CC908 KlAxU8SstxU16WU16 131070.0 leist_q2 0.00 131070.0 FORMAT "%8.1"
 /begin AXIS_DESCR STD_AXIS tkivkm_w temp_q0p0234_o273 6 -273.1500 1262.827 FORMAT "%8.3" DEPOSIT ABSOLUTE /end AXIS_DESCR
/end CHARACTERISTIC
/begin CHARACTERISTIC KLSWKH "Kennlinie Sollw‰rme zum Heizen des Katalysators nach Motorstart" CURVE 0x1CC878 GklWU16 4194240. q_q64 0.00 4194240. FORMAT "%8.0"
 /begin AXIS_DESCR COM_AXIS tmst temp_ub_q0p75_o48 8 -48.00 143.3 AXIS_PTS_REF STS08KHUW /end AXIS_DESCR
/end CHARACTERISTIC
/begin CHARACTERISTIC KRAL1N "Klopfregeladaption Lastbereich 1" CURVE 0x1CE770 GklWU16 1535.977 rel_uw_q0p0234 0.00 1535.977 FORMAT "%8.3"
 /begin AXIS_DESCR COM_AXIS nmot nmot_ub_q40 16 0.00 10200. AXIS_PTS_REF SNM16KRUB /end AXIS_DESCR
/end CHARACTERISTIC
/begin CHARACTERISTIC KRAL2N "Klopfregeladaption Lastbereich 2" CURVE 0x1CE790 GklWU16 1535.977 rel_uw_q0p0234 0.00 1535.977 FORMAT "%8.3"
 /begin AXIS_DESCR COM_AXIS nmot nmot_ub_q40 16 0.00 10200. AXIS_PTS_REF SNM16KRUB /end AXIS_DESCR
/end CHARACTERISTIC
/begin CHARACTERISTIC KRAL3N "Klopfregeladaption Lastbereich 3" CURVE 0x1CE7B0 GklWU16 1535.977 rel_uw_q0p0234 0.00 1535.977 FORMAT "%8.3"
 /begin AXIS_DESCR COM_AXIS nmot nmot_ub_q40 16 0.00 10200. AXIS_PTS_REF SNM16KRUB /end AXIS_DESCR
/end CHARACTERISTIC
/begin CHARACTERISTIC KRALH "Klopfregeladaption Lasthysterese" VALUE 0x1C60E2 KwWU16 10.00781 rel_uw_q0p0234 0.00 10.00781 FORMAT "%8.5" /end CHARACTERISTIC
/begin CHARACTERISTIC KRAN1 "Klopfregeladaption Drehzahlbereich, St¸tzstelle 1" VALUE 0x1C60E5 KwWU8 10200. nmot_ub_q40 0.00 10200. FORMAT "%5.0" /end CHARACTERISTIC
/begin CHARACTERISTIC KRAN2 "Klopfregeladaption Drehzahlbereich, St¸tzstelle 2" VALUE 0x1C60E6 KwWU8 10200. nmot_ub_q40 0.00 10200. FORMAT "%5.0" /end CHARACTERISTIC
/begin CHARACTERISTIC KRAN3 "Klopfregeladaption Drehzahlbereich, St¸tzstelle 3" VALUE 0x1C60E7 KwWU8 10200. nmot_ub_q40 0.00 10200. FORMAT "%5.0" /end CHARACTERISTIC
/begin CHARACTERISTIC KRAN4 "Klopfregeladaption Drehzahlbereich, St¸tzstelle 4" VALUE 0x1C60E8 KwWU8 10200. nmot_ub_q40 0.00 10200. FORMAT "%5.0" /end CHARACTERISTIC
/begin CHARACTERISTIC KRANH "Klopfregeladaption Drehzahlhysterese" VALUE 0x1C60E9 KwWU8 240.0 nmot_ub_q40 0.00 240.0 FORMAT "%5.1" /end CHARACTERISTIC
/begin CHARACTERISTIC KRLNMDY "Lesen bei Last-/Drehzahlbereichswechsel: immer oder nur bei Dynamik" VALUE 0x1C60EA KwWU8 255.0 dez 0.00 255.0 FORMAT "%5.1" /end CHARACTERISTIC
/begin CHARACTERISTIC LALIO "Kennlinie lambda = f(O2)" CURVE 0x1C4EBA KlAUwSstSwWUw 15.99976 fak_uw_b16 0.00 15.99976 FORMAT "%8.5"
 /begin AXIS_DESCR STD_AXIS o2adap_w relO2_q9p765Em4 25 -32.00000 31.99902 FORMAT "%8.5" DEPOSIT ABSOLUTE /end AXIS_DESCR
/end CHARACTERISTIC
/begin CHARACTERISTIC LKRN "Lastschwelle Klopfregelung" CURVE 0x1CE7D0 GklWU16 1535.977 rel_uw_q0p0234 0.00 1535.977 FORMAT "%8.3"
 /begin AXIS_DESCR COM_AXIS nmot nmot_ub_q40 16 0.00 10200. AXIS_PTS_REF SNM16KRUB /end AXIS_DESCR
/end CHARACTERISTIC
/begin CHARACTERISTIC LRNST1_T "Wartezeit in Lernschritt 1" VALUE 0x1C3468 KwUb 5.080 t20msxs_ub_b5p1 0.02000 5.100 FORMAT "%5.3" /end CHARACTERISTIC
/begin CHARACTERISTIC LRNST3_T "Wartezeit in Lernschritt 3" VALUE 0x1C3469 KwUb 5.080 t20msxs_ub_b5p1 0.02000 5.100 FORMAT "%5.3" /end CHARACTERISTIC
/begin CHARACTERISTIC LRNST7_T "Wartezeit in Lernschritt 7" VALUE 0x1C346A KwUb 5.080 t20msxs_ub_b5p1 0.02000 5.100 FORMAT "%5.3" /end CHARACTERISTIC
/begin CHARACTERISTIC LRNST9_T "Wartezeit in Lernschritt 9" VALUE 0x1C346B KwUb 5.080 t20msxs_ub_b5p1 0.02000 5.100 FORMAT "%5.3" /end CHARACTERISTIC
/begin CHARACTERISTIC LRNVB_T "Lernverbotszeit f¸r 'normales Lernen'" VALUE 0x1C3482 KwUw 1310.700 t20msxs_uw_q0p02 0.00 1310.700 FORMAT "%8.3" /end CHARACTERISTIC
/begin CHARACTERISTIC MLFKMSDK "Luftmassenstromschwelle f¸r multipl. Abgleich von HFM- und DK-Massenstrom" VALUE 0x1C2CCE KwUw 6553.500 m_uw_b6553p5 0.00 6553.500 FORMAT "%8.3" /end CHARACTERISTIC
/begin CHARACTERISTIC MRFABNTE "Schwelle zur Erkennung von Dauer-Hochlastfahrt" VALUE 0x1CDD65 KwUb 99.61 rel_ub_b99p6 0.00 99.61 FORMAT "%5.2" /end CHARACTERISTIC
/begin CHARACTERISTIC MSAGROFFAD "Abschaltschwelle fur pirg- und fupsrl-Adaption wenn msagr>Schwellwert" VALUE 0x1C8716 KwUw 6553.500 m_uw_b6553p5 0.00 6553.500 FORMAT "%8.3" /end CHARACTERISTIC
/begin CHARACTERISTIC MSALLMN "Minimale Leerlaufluftmassenadaption f¸r E-Gas" VALUE 0x1C8748 KwUw 6553.500 m_uw_b6553p5 0.00 6553.500 FORMAT "%8.3" /end CHARACTERISTIC
/begin CHARACTERISTIC MSALLMX "Maximale Leerlaufluftmassenadaption f¸r E-Gas" VALUE 0x1C874A KwUw 6553.500 m_uw_b6553p5 0.00 6553.500 FORMAT "%8.3" /end CHARACTERISTIC
/begin CHARACTERISTIC MSLG "Massenstrom Leckluft gesamt" VALUE 0x1C874C KwUw 6553.500 m_uw_b6553p5 0.00 6553.500 FORMAT "%8.3" /end CHARACTERISTIC
/begin CHARACTERISTIC MXFLAD "Max. Anzahl Flankenadaptionen Nockenwellen Phasensensor" VALUE 0x1CA9AA KwUb 255.0 dez 0.00 255.0 FORMAT "%5.1" /end CHARACTERISTIC
/begin CHARACTERISTIC NAPLMDSO "Adaption pslm-psdss Drehzahlobergrenze" VALUE 0x1C86FB KwUb 10200. nmot_ub_q40 0.00 10200. FORMAT "%5.0" /end CHARACTERISTIC
/begin CHARACTERISTIC NAPLMDSU "Adaption pslm-psdss Drehzahluntergrenze" VALUE 0x1C86FC KwUb 10200. nmot_ub_q40 0.00 10200. FORMAT "%5.0" /end CHARACTERISTIC
/begin CHARACTERISTIC NFGRMAX "Max. zul. Drehzahl bei FGR-Betrieb" VALUE 0x1C69AA KwUb 10200. nmot_ub_q40 0.00 10200. FORMAT "%5.0" /end CHARACTERISTIC
/begin CHARACTERISTIC NGDNSA "Drehzahlgradient beim Absteuern der Schubabschalthysterese" VALUE 0x1C6D0E KwSw 10239.84 nmotg_sw_q0p15625 -5120.000 5119.844 FORMAT "%8.3" /end CHARACTERISTIC
/begin CHARACTERISTIC NGDNWEGTR "Drehzahlgradient beim Absteuern der Wiedereinsetzdrehzal Kuppl. offen" VALUE 0x1C6D10 KwSw 10239.84 nmotg_sw_q0p15625 -5120.000 5119.844 FORMAT "%8.3" /end CHARACTERISTIC
/begin CHARACTERISTIC NGKRWN "Schwellwert Drehzahlgradient f¸r Dynamikerkennung" CURVE 0x1CE7F0 GklWS16 25599.94 nmotg_sw_q0p39 -12800.16 12799.77 FORMAT "%8.2"
 /begin AXIS_DESCR COM_AXIS nmot nmot_ub_q40 16 0.00 10200. AXIS_PTS_REF SNM16KRUB /end AXIS_DESCR
/end CHARACTERISTIC
/begin CHARACTERISTIC NLPST1T "Wartezeit 1 im NLP-Lernen" VALUE 0x1C346C KwUb 2.540 t10msxs_ub_b2p55 0.01000 2.550 FORMAT "%5.3" /end CHARACTERISTIC
/begin CHARACTERISTIC NLPST2T "Wartezeit 2 im NLP-Lernen" VALUE 0x1C346D KwUb 2.540 t10msxs_ub_b2p55 0.01000 2.550 FORMAT "%5.3" /end CHARACTERISTIC
/begin CHARACTERISTIC NMAXKW "maximale Drehzahl zum Katalysatorwarmhalten" VALUE 0x1CC958 KwWU8 10200. nmot_ub_q40 0.00 10200. FORMAT "%5.0" /end CHARACTERISTIC
/begin CHARACTERISTIC NMNWSTMN "Minimale Drehzahl f¸r Freigabe der Nockenwellenverstellung im Start" VALUE 0x1CA8F8 KwUb 10200. nmot_ub_q40 0.00 10200. FORMAT "%5.0" /end CHARACTERISTIC
/begin CHARACTERISTIC NNSTA "Drehzahl¸bergang Normal -> Start" CURVE 0x1CEA1C KlAUbSstUbWUb 10200. nmot_ub_q40 0.00 10200. FORMAT "%5.0"
 /begin AXIS_DESCR STD_AXIS tans temp_ub_q0p75_o48 3 -48.00 143.3 FORMAT "%5.1" DEPOSIT ABSOLUTE /end AXIS_DESCR
/end CHARACTERISTIC
/begin CHARACTERISTIC NNWMX "maximale Drehzahlschwelle f¸r Abschaltung der NW-Verstellung" VALUE 0x1CA8F9 KwUb 10200. nmot_ub_q40 0.00 10200. FORMAT "%5.0" /end CHARACTERISTIC
/begin CHARACTERISTIC NNWTMN "Minimaldrehzahlschwelle f¸r Freigabe der Nockenwellenverstellung" CURVE 0x1CA900 KlAUbSstUwWUb 10200. nmot_ub_q40 0.00 10200. FORMAT "%5.0"
 /begin AXIS_DESCR STD_AXIS toelk_w temp_q0p0234_o273 4 -273.1500 1262.827 FORMAT "%8.3" DEPOSIT ABSOLUTE /end AXIS_DESCR
/end CHARACTERISTIC
/begin CHARACTERISTIC NRUBMX "Maximale Drehzahl f¸r Batteriespannungsregelung" VALUE 0x1CEA11 KwUb 2550. nmot_ub_q10 0.00 2550. FORMAT "%5.0" /end CHARACTERISTIC
/begin CHARACTERISTIC NSTNM "‹bergang Start -> Normal" CURVE 0x1CEA24 KlAUbSstUbWUb 10200. nmot_ub_q40 0.00 10200. FORMAT "%5.0"
 /begin AXIS_DESCR STD_AXIS tmot temp_ub_q0p75_o48 3 -48.00 143.3 FORMAT "%5.1" DEPOSIT ABSOLUTE /end AXIS_DESCR
/end CHARACTERISTIC
/begin CHARACTERISTIC NWENG "Wiedereinsetzdrehzahl" CURVE 0x1C6D12 KlAUbSstSbWUb 10200. nmot_ub_q40 0.00 10200. FORMAT "%5.0"
 /begin AXIS_DESCR STD_AXIS ngfil nmotg_sb_q100 5 -12800. 12700. FORMAT "%5.0" DEPOSIT ABSOLUTE /end AXIS_DESCR
/end CHARACTERISTIC
/begin CHARACTERISTIC NWENGFS "Delta Wiedereinsetzdrehzahl bei Fahrstufe" CURVE 0x1C6D1D KlAUbSstSbWUb 10200. nmot_ub_q40 0.00 10200. FORMAT "%5.0"
 /begin AXIS_DESCR STD_AXIS ngfil nmotg_sb_q100 5 -12800. 12700. FORMAT "%5.0" DEPOSIT ABSOLUTE /end AXIS_DESCR
/end CHARACTERISTIC
/begin CHARACTERISTIC OFAPIRGMN "Minimaler Intergratoradaptionswert f¸r pirg-Adaption" VALUE 0x1C8718 KwSw 2559.961 p_sw_q0p039 -1280.000 1279.961 FORMAT "%8.3" /end CHARACTERISTIC
/begin CHARACTERISTIC OFAPIRGMX "Maximaler Intergratoradaptionswert f¸r pirg-Adaption" VALUE 0x1C871A KwSw 2559.961 p_sw_q0p039 -1280.000 1279.961 FORMAT "%8.3" /end CHARACTERISTIC
/begin CHARACTERISTIC OFDSSMN "Minimaler Offsetwert f¸r Saugrohrdrucksensor" VALUE 0x1C8734 KwWS16 2559.961 p_sw_q0p039 -1280.000 1279.961 FORMAT "%8.3" /end CHARACTERISTIC
/begin CHARACTERISTIC OFDSSMX "Maximaler Offsetwert f¸r Saugrohrdrucksensor" VALUE 0x1C8736 KwWS16 2559.961 p_sw_q0p039 -1280.000 1279.961 FORMAT "%8.3" /end CHARACTERISTIC
/begin CHARACTERISTIC PVAPIRGMN "minimale Druckverh‰ltnisschwelle bei der pirg-Offsetadaption noch aktiv" VALUE 0x1C871C KwUw 1.999969 fak_uw_b2 0.00 1.999969 FORMAT "%8.6" /end CHARACTERISTIC
/begin CHARACTERISTIC PVAPIRGMX "maximale Druckverh‰ltnisschwelle bei der pirg-Offsetadaption noch aktiv" VALUE 0x1C871E KwUw 1.999969 fak_uw_b2 0.00 1.999969 FORMAT "%8.6" /end CHARACTERISTIC
/begin CHARACTERISTIC PVFKFUMN "minimale Druckverh‰ltnisschwelle bis zu der fupsrl-Adaption aktiv ist" VALUE 0x1C8720 KwUw 1.999969 fak_uw_b2 0.00 1.999969 FORMAT "%8.6" /end CHARACTERISTIC
/begin CHARACTERISTIC PVFKFUMX "maximale Druckverh‰ltnisschwelle bis zu der fupsrl-Adaption aktiv ist" VALUE 0x1C8722 KwUw 1.999969 fak_uw_b2 0.00 1.999969 FORMAT "%8.6" /end CHARACTERISTIC
/begin AXIS_PTS SGA08MDUB "St¸tzstellenverteilung Ist Gang 8 Sst." 0x1CEDC8 gangi SstAUbSstUb 255.0 dez 8 0.00 255.0 FORMAT "%5.1" DEPOSIT ABSOLUTE /end AXIS_PTS
/begin AXIS_PTS SNM08GKUB "St¸tzstellenverteilung Gemischkontrolle 8 nmot St¸tzstellen" 0x1C672C nmot SstAU8SstU8 10200. nmot_ub_q40 8 0.00 10200. FORMAT "%5.0" DEPOSIT ABSOLUTE /end AXIS_PTS
/begin AXIS_PTS SNM08__UB "St¸tzstellenverteilung Drehzahl, 8 Sst." 0x1C6788 nmot SstAUbSstUb 10200. nmot_ub_q40 8 0.00 10200. FORMAT "%5.0" DEPOSIT ABSOLUTE /end AXIS_PTS
/begin AXIS_PTS SNM16KRUB "St¸tzstellenverteilung Drehzahl, 16 Sst." 0x1CEE10 nmot SstAUbSstUb 10200. nmot_ub_q40 16 0.00 10200. FORMAT "%5.0" DEPOSIT ABSOLUTE /end AXIS_PTS
/begin AXIS_PTS SRL04DYUB "St¸tzstellenverteilung relative F¸llung, 4 Sst." 0x1CE844 rl SstAUbSstUb 191.3 rel_ub_q0p75 4 0.00 191.3 FORMAT "%5.1" DEPOSIT ABSOLUTE /end AXIS_PTS
/begin AXIS_PTS STK04SAUB "SST-Verteilung Kattemperatur f¸r Funktion SAWE" 0x1CEE70 tkatm SstAUbSstUb 1275. temp_ub_q5_o50 4 -50.00 1225. FORMAT "%5.0" DEPOSIT ABSOLUTE /end AXIS_PTS
/begin AXIS_PTS STM05SAUB "St¸tzstellenverteilung" 0x1CEE80 tmot SstAUbSstUb 191.3 temp_ub_q0p75_o48 5 -48.00 143.3 FORMAT "%5.1" DEPOSIT ABSOLUTE /end AXIS_PTS
/begin AXIS_PTS STS08KHUW "St¸tzstellenverteilung f¸r Motorstarttemperatur (tmst)" 0x1CC970 tmst SstAU8SstU8 191.3 temp_ub_q0p75_o48 8 -48.00 143.3 FORMAT "%5.1" DEPOSIT ABSOLUTE /end AXIS_PTS
/begin CHARACTERISTIC SWDFRMFOF "Schwellwert f¸r dfrmfof eingeschwungen" VALUE 0x1CBC0C KwWU16 1.999969 fak_uw_b2 0.00 1.999969 FORMAT "%8.6" /end CHARACTERISTIC
/begin CHARACTERISTIC SWMSLFEG "Schwellwert f¸r mslf- und msllamf eingeschwungen" VALUE 0x1CBC0E KwWU16 6553.500 m_uw_b6553p5 0.00 6553.500 FORMAT "%8.3" /end CHARACTERISTIC
/begin CHARACTERISTIC SWMSLVF "Schwellwert f¸r mslvf eingeschwungen" VALUE 0x1CBC10 KwWU16 6553.500 m_uw_b6553p5 0.00 6553.500 FORMAT "%8.3" /end CHARACTERISTIC
/begin AXIS_PTS SWR08KHUW "St¸tzstellenverteilung f¸r Katheizfortschritt (wsistr_w)" 0x1CC95E wistr_w SstAU8SstU16 0.9999847 fak_uw_b1 8 0.00 0.9999847 FORMAT "%9.7" DEPOSIT ABSOLUTE /end AXIS_PTS
/begin CHARACTERISTIC TAFUPSRLE "Zeitverzˆgerung f¸r Bedingung Adaption fupsrl eingeschwungen" VALUE 0x1C86FD KwUb 51.00 t200msxs_ub_b51 0.00 51.00 FORMAT "%5.2" /end CHARACTERISTIC
/begin CHARACTERISTIC TALBKOAMIN "Mindesttastverh‰ltnis LBK ab dem oberer mech. Anschlag erkannt wird." VALUE 0x1C3458 KwUb 99.61 rel_q0p39 0.00 99.61 FORMAT "%5.2" /end CHARACTERISTIC
/begin CHARACTERISTIC TALBKUAMIN "Mindesttastverh‰ltnis LBK ab dem unterer mech. Anschlag erkannt wird." VALUE 0x1C3459 KwUb 99.61 rel_q0p39 0.00 99.61 FORMAT "%5.2" /end CHARACTERISTIC
/begin CHARACTERISTIC TANSLBKMN "Minimale Ansauglufttemperatur f¸r LBK-Lernen" VALUE 0x1CA6D1 KwUb 191.3 temp_ub_q0p75_o48 -48.00 143.3 FORMAT "%5.1" /end CHARACTERISTIC
/begin CHARACTERISTIC TANSLBKMX "Maximale Ansauglufttemperatur f¸r LBK-Lernen" VALUE 0x1CA6D2 KwUb 191.3 temp_ub_q0p75_o48 -48.00 143.3 FORMAT "%5.1" /end CHARACTERISTIC
/begin CHARACTERISTIC TANW "Ansauglufttemperaturschwelle f¸r Nockenwellenverstellung" VALUE 0x1CA8FA KwUb 191.3 temp_ub_q0p75_o48 -48.00 143.3 FORMAT "%5.1" /end CHARACTERISTIC
/begin CHARACTERISTIC TAPBRINT "Adap.zeit f¸r pbrint, ab der pslm-psdss f¸r Setzen von E/Z_lzsr ausgewertet wird" VALUE 0x1C8724 KwUw 13107.00 t_q0p2 0.00 13107.00 FORMAT "%8.2" /end CHARACTERISTIC
/begin CHARACTERISTIC TAPBRINTKT "Adaptionszeit f¸r pbrint (analog zu TAPBRINT) im Kurztrip" VALUE 0x1C8726 KwUw 13107.00 t_q0p2 0.00 13107.00 FORMAT "%8.2" /end CHARACTERISTIC
/begin CHARACTERISTIC TATELL "tans- Schwelle f¸r Tankentl¸fung bei B_ll = 1" VALUE 0x1CDD66 KwUb 191.3 temp_ub_q0p75_o48 -48.00 143.3 FORMAT "%5.1" /end CHARACTERISTIC
/begin CHARACTERISTIC TAVHKSAO "Obergrenze Abgastemperatur vor Hauptkat f¸r SA" VALUE 0x1CF6C6 KwUw 1535.977 temp_q0p0234_o273 -273.1500 1262.827 FORMAT "%8.3" /end CHARACTERISTIC
/begin CHARACTERISTIC TAVVKSAO "Obergrenze Abgastemperatur vor Vorkat f¸r SA" VALUE 0x1CF6C8 KwUw 1535.977 temp_q0p0234_o273 -273.1500 1262.827 FORMAT "%8.3" /end CHARACTERISTIC
/begin CHARACTERISTIC TDABGLST "Zeitverzˆgerung Freigabe Abgleich nach Startende" VALUE 0x1C2CD0 KwUw 655.3500 t10msxs_uw_b655p35 0.00 655.3500 FORMAT "%8.4" /end CHARACTERISTIC
/begin CHARACTERISTIC TDAPBRINT "Verzˆgerung von B_apbrint" VALUE 0x1C8728 KwUw 13107.00 t_q0p2 0.00 13107.00 FORMAT "%8.2" /end CHARACTERISTIC
/begin CHARACTERISTIC TDDFRMOFF "Zeitverzˆgerung f¸r Bedingung dfrmof-Filter eingeschwungen" VALUE 0x1CBC19 KwWU8 25.50 t_q0p1 0.00 25.50 FORMAT "%5.2" /end CHARACTERISTIC
/begin CHARACTERISTIC TDFGADPS "Zeitverzˆgerung f¸r Freigabe der Adaption des Saugrohrmodells" VALUE 0x1C872A KwUw 3276.750 t50msxs_uw_b3276p75 0.00 3276.750 FORMAT "%8.3" /end CHARACTERISTIC
/begin CHARACTERISTIC TDFGINI "Zeitverzˆgerung f¸r Initialisierung der Abgleiche mit Neutralwerten" VALUE 0x1C86FE KwUb 12.75 t50msxs_q0p05 0.00 12.75 FORMAT "%5.2" /end CHARACTERISTIC
/begin CHARACTERISTIC TDIDSSU "Verzˆgerungszeit bis zur Initalisierung des Umgebungsdruck mit ge. Saugrohrdruck" VALUE 0x1C873B KwWU8 25.50 t_q0p1 0.00 25.50 FORMAT "%5.2" /end CHARACTERISTIC
/begin CHARACTERISTIC TDKNACH "Zeit im Nachlauf bis stromlose DK im NLP einschwingt" VALUE 0x1C3484 KwUw 655.3500 t10msxs_uw_b655p35 0.00 655.3500 FORMAT "%8.4" /end CHARACTERISTIC
/begin CHARACTERISTIC TDKWANF "Zeitverzˆgerung nach Start f¸r Freigabe der Bedingung Kat warmhalten" VALUE 0x1CC94C KwWU16 6553.500 t_q0p1 0.00 6553.500 FORMAT "%8.3" /end CHARACTERISTIC
/begin CHARACTERISTIC TDLRPIDMX "max. Zeit f¸r PWM-Tastverh‰ltnis des DLR bei temp. UMA-Adapt." VALUE 0x1C346E KwUb 12.75 t50msxs_q0p05 0.00 12.75 FORMAT "%5.2" /end CHARACTERISTIC
/begin CHARACTERISTIC TDLZSR "Entprellzeit f¸r Fehlerpfad Leck zum Saugrohr" VALUE 0x1C86FF KwUb 51.00 t200msxs_ub_b51 0.00 51.00 FORMAT "%5.2" /end CHARACTERISTIC
/begin CHARACTERISTIC TDMSDKS "Zeitverzˆgerung bis das Bit B_fkmsdks wirksam wird" VALUE 0x1C2CC3 KwUb 2.550 t10msxs_ub_b2p55 0.00 2.550 FORMAT "%5.3" /end CHARACTERISTIC
/begin CHARACTERISTIC TDMSLR "Zeitverzˆgerung f¸r Bedingung mslvf-Filter eingeschwungen" VALUE 0x1CBC1A KwWU8 25.50 t_q0p1 0.00 25.50 FORMAT "%5.2" /end CHARACTERISTIC
/begin CHARACTERISTIC TDPSLMDS "Filterzeitkonstante f¸r  Differenz modellierter zu gemessenem Saugrohrdruck" VALUE 0x1C872C KwUw 13106.8000 zk200msxs_uw_b13107 0.200000000 13107.0000 FORMAT "%10.4" /end CHARACTERISTIC
/begin CHARACTERISTIC TDTABGMK "Zeitverzˆgerung f¸r modellierte Abgastemperatur bei Eintritt in den Katalysator" VALUE 0x1CC959 KwWU8 254.996 zk1sxs_ub_b255 1.00392 256.000 FORMAT "%7.3" /end CHARACTERISTIC
/begin CHARACTERISTIC TDTAPLMDS "Zeitverzˆgerung DTEV f¸r Freigabe Adaption pslm-psdss" VALUE 0x1C8700 KwUb 12.70 t50msxs_q0p05 0.05000 12.75 FORMAT "%5.2" /end CHARACTERISTIC
/begin CHARACTERISTIC TDVIVZ "Toleranzzeit bei zu groﬂer Abweichung zw. Istgeschw. und Zielgeschw." VALUE 0x1C69BC KwUw 1310.680 t20msxs_uw_q0p02 0.02000000 1310.700 FORMAT "%8.3" /end CHARACTERISTIC
/begin CHARACTERISTIC TDVZVI "Toleranzzeit bei zu groﬂer Abweichung zw. Zielgeschw. und Istgeschw." VALUE 0x1C69BE KwUw 1310.680 t20msxs_uw_q0p02 0.02000000 1310.700 FORMAT "%8.3" /end CHARACTERISTIC
/begin CHARACTERISTIC TFGRAQU "Toleranzzeit f¸r Aquaplaningerkennung im FGR-Betrieb" VALUE 0x1C69AB KwUb 5.080 t20msxs_ub_b5p1 0.02000 5.100 FORMAT "%5.3" /end CHARACTERISTIC
/begin CHARACTERISTIC TFGRASCOF "Zeit f¸r FGR-Abschaltung bei aktivem Brems-Eingriff" VALUE 0x1C69C0 KwUw 1310.700 t20msxs_uw_q0p02 0.00 1310.700 FORMAT "%8.3" /end CHARACTERISTIC
/begin CHARACTERISTIC TFGRBREOF "Zeit f¸r FGR-Abschaltung bei aktivem Brems-Eingriff" VALUE 0x1C69C2 KwUw 1310.700 t20msxs_uw_q0p02 0.00 1310.700 FORMAT "%8.3" /end CHARACTERISTIC
/begin CHARACTERISTIC TFGRDSCOF "Zeit f¸r FGR-Abschaltung bei aktivem DSC-Eingriff" VALUE 0x1C69C4 KwUw 1310.700 t20msxs_uw_q0p02 0.00 1310.700 FORMAT "%8.3" /end CHARACTERISTIC
/begin CHARACTERISTIC TFGRUEOB "Toleranzzeit f¸r ‹berschreiten der oberen Beschleunigungsschwelle im FGR-Betrieb" VALUE 0x1C69AC KwUb 5.080 t20msxs_ub_b5p1 0.02000 5.100 FORMAT "%5.3" /end CHARACTERISTIC
/begin CHARACTERISTIC TFGRUM "Toleranzzeit f¸r Erkennung FGR-Betrieb in der Funktions¸berwachung" VALUE 0x1C69AD KwUb 5.080 t20msxs_ub_b5p1 0.02000 5.100 FORMAT "%5.3" /end CHARACTERISTIC
/begin CHARACTERISTIC TFGRUNUB "Toleranzzeit f¸r Unterschreiten der unteren Beschl.schwelle im FGR-Betrieb" VALUE 0x1C69AE KwUb 5.080 t20msxs_ub_b5p1 0.02000 5.100 FORMAT "%5.3" /end CHARACTERISTIC
/begin CHARACTERISTIC TGAHBX "Zeit f¸r GA-Anforderung nach erkannter unplausibler Beladung" VALUE 0x1CDD70 KwUw 6553.500 t100msxs_uw_b6553p6 0.00 6553.500 FORMAT "%8.3" /end CHARACTERISTIC
/begin CHARACTERISTIC TKATSA "Katalysator-Temperaturschwelle f¸r Schubabschalten" VALUE 0x1CF6B4 KwUb 1275. temp_ub_q5_o50 -50.00 1225. FORMAT "%5.0" /end CHARACTERISTIC
/begin CHARACTERISTIC TKHMXFHO "Maximale Einschaltdauer der Funktion Katheizen in Abh‰ngigkeit von der Hˆhe" CURVE 0x1CC922 KlAxU8SstxU16WU16 6553.500 t100msxs_uw_b6553p5 0.00 6553.500 FORMAT "%8.3"
 /begin AXIS_DESCR STD_AXIS fho_w fak_uw_b4 4 0.00 3.999939 FORMAT "%8.6" DEPOSIT ABSOLUTE /end AXIS_DESCR
/end CHARACTERISTIC
/begin CHARACTERISTIC TKIHKSAO "Obergrenze Kattemperatur im Hauptkat f¸r SA" VALUE 0x1CF6CA KwUw 1535.977 temp_q0p0234_o273 -273.1500 1262.827 FORMAT "%8.3" /end CHARACTERISTIC
/begin CHARACTERISTIC TKIVKMMN "Katalysatortemperaturregelschwelle f¸r Kat warmhalten" VALUE 0x1CC94E KwWU16 1535.977 temp_q0p0234_o273 -273.1500 1262.827 FORMAT "%8.3" /end CHARACTERISTIC
/begin CHARACTERISTIC TLBKLRN2MX "Maximale Verweilzeit im Lernschritt 2 LBK-Adaption" VALUE 0x1CA6DE KwUw 1310.700 t20msxs_uw_q0p02 0.00 1310.700 FORMAT "%8.3" /end CHARACTERISTIC
/begin CHARACTERISTIC TLBKLRN3MX "Maximale Verweilzeit im Lernschritt 3 LBK-Adaption" VALUE 0x1CA6E0 KwUw 1310.700 t20msxs_uw_q0p02 0.00 1310.700 FORMAT "%8.3" /end CHARACTERISTIC
/begin CHARACTERISTIC TLBKLRN4MX "Maximale Verweilzeit im Lernschritt 4 LBK-Adaption" VALUE 0x1CA6E2 KwUw 1310.700 t20msxs_uw_q0p02 0.00 1310.700 FORMAT "%8.3" /end CHARACTERISTIC
/begin CHARACTERISTIC TLBKLRN5MX "Maximale Verweilzeit im Lernschritt 5 LBK-Adaption" VALUE 0x1CA6E4 KwUw 1310.700 t20msxs_uw_q0p02 0.00 1310.700 FORMAT "%8.3" /end CHARACTERISTIC
/begin CHARACTERISTIC TMDYNA "TMOT - Schwelle f¸r Lastdynamikadaption aktiv" VALUE 0x1C60EB KwWU8 191.3 temp_ub_q0p75_o48 -48.00 143.3 FORMAT "%5.1" /end CHARACTERISTIC
/begin CHARACTERISTIC TMKR "Motortemperaturschwelle f¸r Klopfregelung aktiv" VALUE 0x1CE841 KwWU8 191.3 temp_ub_q0p75_o48 -48.00 143.3 FORMAT "%5.1" /end CHARACTERISTIC
/begin CHARACTERISTIC TMKRA "Motortemperaturschwelle f¸r adaptive Klopfregelung" VALUE 0x1C60EC KwWU8 191.3 temp_ub_q0p75_o48 -48.00 143.3 FORMAT "%5.1" /end CHARACTERISTIC
/begin CHARACTERISTIC TMNWKH "Temperaturschwelle f¸r Freigabe Nockenwellenkatheizfunktionalit‰t" VALUE 0x1CA8FB KwUb 191.3 temp_ub_q0p75_o48 -48.00 143.3 FORMAT "%5.1" /end CHARACTERISTIC
/begin CHARACTERISTIC TMNWMN "Minimal Motortemperaturschwelle f¸r Freigabe Nockenwellenverstellung" VALUE 0x1CA8FC KwUb 191.3 temp_ub_q0p75_o48 -48.00 143.3 FORMAT "%5.1" /end CHARACTERISTIC
/begin CHARACTERISTIC TMNWMX "Maximal Motortemperaturschwelle f¸r Freigabe Nockenwellenverstellung" VALUE 0x1CA8FD KwUb 191.3 temp_ub_q0p75_o48 -48.00 143.3 FORMAT "%5.1" /end CHARACTERISTIC
/begin CHARACTERISTIC TMNWST "Motortemoeraturschwelle f¸r Nockenwellenfreigabe im Start" VALUE 0x1CA8FE KwUb 191.3 temp_ub_q0p75_o48 -48.00 143.3 FORMAT "%5.1" /end CHARACTERISTIC
/begin CHARACTERISTIC TMOTLLBKMN "Minimale Motortemperatur f¸r LBK-Lernen" VALUE 0x1CA6D3 KwUb 191.3 temp_ub_q0p75_o48 -48.00 143.3 FORMAT "%5.1" /end CHARACTERISTIC
/begin CHARACTERISTIC TMOTLLBKMX "Maximale Motortemperatur f¸r LBK-Lernen" VALUE 0x1CA6D4 KwUb 191.3 temp_ub_q0p75_o48 -48.00 143.3 FORMAT "%5.1" /end CHARACTERISTIC
/begin CHARACTERISTIC TMSKLH "Motortemperaturschwelle f¸r kurze LRA-Anfangsphase bei Heiﬂstart" VALUE 0x1CDD67 KwUb 191.3 temp_ub_q0p75_o48 -48.00 143.3 FORMAT "%5.1" /end CHARACTERISTIC
/begin CHARACTERISTIC TMSNOGA "Schwelle tms f¸r Dauersp¸len nach Fahrzyklus mit erfolgter Gemischadaption" VALUE 0x1CDD68 KwUb 191.3 temp_ub_q0p75_o48 -48.00 143.3 FORMAT "%5.1" /end CHARACTERISTIC
/begin CHARACTERISTIC TMSUTMUMA "untere Tmot-Schwelle f¸r tempor‰re UMA-Adaption" VALUE 0x1C346F KwUb 191.3 temp_ub_q0p75_o48 -48.00 143.3 FORMAT "%5.1" /end CHARACTERISTIC
/begin CHARACTERISTIC TMWAFMN "Minimale Motortemperatur f¸r Winkeladaption Nockenwelle" VALUE 0x1CA9AB KwUb 191.3 temp_ub_q0p75_o48 -48.00 143.3 FORMAT "%5.1" /end CHARACTERISTIC
/begin CHARACTERISTIC TNWADAMX "maximale Zeit f¸r eine Flankenadaption des Nockenwellen Phsensensors" VALUE 0x1CA9BA KwUw 3276.750 t50msxs_uw_b3276p75 0.00 3276.750 FORMAT "%8.3" /end CHARACTERISTIC
/begin CHARACTERISTIC TNWADAMXA "maximale Zeit f¸r Flankenadaption des Nockenwellen Phsensensors (Feinadaption)" VALUE 0x1CA9BC KwUw 3276.750 t50msxs_uw_b3276p75 0.00 3276.750 FORMAT "%8.3" /end CHARACTERISTIC
/begin CHARACTERISTIC TOARNWMX "÷ltemperaturschwelle zur Freigabe der Adaption f¸r Nockenwellenreferenzposition" VALUE 0x1CA9BE KwUw 1535.977 temp_q0p0234_o273 -273.1500 1262.827 FORMAT "%8.3" /end CHARACTERISTIC
/begin CHARACTERISTIC TOELNWEMN "Minimal ÷ltemperaturschwelle zur Freigabe Nockenwellenverstellung (Sensorfehler)" VALUE 0x1CA90E KwUw 1535.977 temp_q0p0234_o273 -273.1500 1262.827 FORMAT "%8.3" /end CHARACTERISTIC
/begin CHARACTERISTIC TOELNWEMX "Maximal ÷ltemperaturschwelle zur Freigabe Nockenwellenverstellung (Sensorfehler)" VALUE 0x1CA910 KwUw 1535.977 temp_q0p0234_o273 -273.1500 1262.827 FORMAT "%8.3" /end CHARACTERISTIC
/begin CHARACTERISTIC TOELNWMN "Minimal ÷ltemperaturschwelle zur Freigabe der Nockenwellenverstellung" VALUE 0x1CA912 KwUw 1535.977 temp_q0p0234_o273 -273.1500 1262.827 FORMAT "%8.3" /end CHARACTERISTIC
/begin CHARACTERISTIC TOELNWMX "Maximal ÷ltemperaturschwelle zur Freigabe der Nockenwellenverstellung" VALUE 0x1CA914 KwUw 1535.977 temp_q0p0234_o273 -273.1500 1262.827 FORMAT "%8.3" /end CHARACTERISTIC
/begin CHARACTERISTIC TPSSOLFIL "Zeitkonstante zum Filtern von pssol_w" VALUE 0x1C872E KwUw 3276.75000 zk50msxs_uw_b12p8 0.0500007630 3276.80000 FORMAT "%10.5" /end CHARACTERISTIC
/begin CHARACTERISTIC TSTAPLMDS "Zeitverzˆgerung nach Startende f¸r Freigabe Adaption pslm-psdss" VALUE 0x1C8730 KwUw 655.3400 t10msxs_uw_b655p35 0.01000000 655.3500 FORMAT "%8.4" /end CHARACTERISTIC
/begin CHARACTERISTIC TTE "Zeit f¸r Tankentl¸ftungsphase" VALUE 0x1CDD72 KwUw 6553.500 t100msxs_uw_b6553p6 0.00 6553.500 FORMAT "%8.3" /end CHARACTERISTIC
/begin CHARACTERISTIC TTEAE "Zeit f¸r Tankentl¸ftungsphase bei eingeschwungener Gemischadaption" VALUE 0x1CDD74 KwUw 6553.500 t100msxs_uw_b6553p6 0.00 6553.500 FORMAT "%8.3" /end CHARACTERISTIC
/begin CHARACTERISTIC TTEBSTP "Maximal Zeit f¸r TE-Stop im Leerlauf bei nicht gesetzten Zyklusflags" VALUE 0x1CDD76 KwUw 6553.500 t100msxs_uw_b6553p6 0.00 6553.500 FORMAT "%8.3" /end CHARACTERISTIC
/begin CHARACTERISTIC TTEGA "Zeit bei der Tankentl¸ftung f¸r Grundadaption" VALUE 0x1CDD78 KwUw 6553.500 t100msxs_uw_b6553p6 0.00 6553.500 FORMAT "%8.3" /end CHARACTERISTIC
/begin CHARACTERISTIC TTEGAI "Zeitdauer der ersten  Gemischadaptionsphase" VALUE 0x1CDD7A KwUw 6553.500 t100msxs_uw_b6553p6 0.00 6553.500 FORMAT "%8.3" /end CHARACTERISTIC
/begin CHARACTERISTIC TTEGAIH "Zeitdauer der ersten  Gemischadaptionsphase bei Heiﬂstart" VALUE 0x1CDD7C KwUw 6553.500 t100msxs_uw_b6553p6 0.00 6553.500 FORMAT "%8.3" /end CHARACTERISTIC
/begin CHARACTERISTIC TTEGAZO "Zeit f¸r Tankentl¸ftungsstop wg. Gemischadaption, obere Schwelle" VALUE 0x1CDD7E KwUw 6553.500 t100msxs_uw_b6553p6 0.00 6553.500 FORMAT "%8.3" /end CHARACTERISTIC
/begin CHARACTERISTIC TTEGAZU "Zeit f¸r Tankentl¸ftungsstop wg. Gemischadaption, untere Schwelle" VALUE 0x1CDD80 KwUw 6553.500 t100msxs_uw_b6553p6 0.00 6553.500 FORMAT "%8.3" /end CHARACTERISTIC
/begin CHARACTERISTIC TTEINI "Zeit f¸r Tankentl¸ftung in erster TE-Phase nach Initialisierung (B_ini)" VALUE 0x1CDD82 KwUw 6553.500 t100msxs_uw_b6553p6 0.00 6553.500 FORMAT "%8.3" /end CHARACTERISTIC
/begin CHARACTERISTIC TTEMN "Zeit f¸r Tankentl¸ftungsphase minimal" VALUE 0x1CDD84 KwUw 6553.500 t100msxs_uw_b6553p6 0.00 6553.500 FORMAT "%8.3" /end CHARACTERISTIC
/begin CHARACTERISTIC TTEPRIO "Zeit ab Start f¸r Umschalten auf Dauertankentl¸ftung" VALUE 0x1CDD86 KwUw 6553.500 t100msxs_uw_b6553p6 0.00 6553.500 FORMAT "%8.3" /end CHARACTERISTIC
/begin CHARACTERISTIC TTEZAO "Zeit f¸r Tankentl¸ftung Daueraktivierung, obere Schwelle" VALUE 0x1CDD88 KwUw 6553.500 t100msxs_uw_b6553p6 0.00 6553.500 FORMAT "%8.3" /end CHARACTERISTIC
/begin CHARACTERISTIC TTEZAU "Zeit f¸r Tankentl¸ftung Daueraktivierung, untere Schwelle" VALUE 0x1CDD8A KwUw 6553.500 t100msxs_uw_b6553p6 0.00 6553.500 FORMAT "%8.3" /end CHARACTERISTIC
/begin CHARACTERISTIC TTMUMASTA "Zeitdauer f¸r Station‰rzustand bei temp. UMA-Adaption" VALUE 0x1C3486 KwUw 3276.750 t50msxs_q0p05 0.00 3276.750 FORMAT "%8.3" /end CHARACTERISTIC
/begin CHARACTERISTIC TVANWSTEND "Applizierbare Verzˆgerungszeit nach der Startende erreicht ist" VALUE 0x1CA9AC KwUb 12.75 t50msxs_ub_b12p75 0.00 12.75 FORMAT "%5.2" /end CHARACTERISTIC
/begin CHARACTERISTIC TVLBZ "Verzˆgerungszeit zur Freigabe der Ladebilanz" VALUE 0x1CEA16 KwUw 13107.00 t200msxs_uw_q0p2 0.00 13107.00 FORMAT "%8.2" /end CHARACTERISTIC
/begin CHARACTERISTIC TVNWGE "Verzugszeit zur NW-Umschaltfreigabe nach Getriebeeingriff" VALUE 0x1CA8FF KwUb 12.75 t50msxs_ub_b12p75 0.00 12.75 FORMAT "%5.2" /end CHARACTERISTIC
/begin CHARACTERISTIC TVNWSTNMTM "Zeitverzˆgerung f¸r Nockenwellenverstellung nach ‹berschreitung der Solldrehzahl" CURVE 0x1CA916 KlAUwSstUwWUw 3276.750 t50msxs_uw_b3276p75 0.00 3276.750 FORMAT "%8.3"
 /begin AXIS_DESCR STD_AXIS tmot temp_ub_q0p75_o48 4 -48.00000 49103.25 FORMAT "%8.2" DEPOSIT ABSOLUTE /end AXIS_DESCR
/end CHARACTERISTIC
/begin CHARACTERISTIC TVNWSTTM "Zeitverzˆgerung im Start ab der die Nockenwelle angesteuert werden kann" CURVE 0x1CA928 KlAUbSstUbWUw 3276.750 t50msxs_uw_b3276p75 0.00 3276.750 FORMAT "%8.3"
 /begin AXIS_DESCR STD_AXIS tmot temp_ub_q0p75_o48 4 -48.00 143.3 FORMAT "%5.1" DEPOSIT ABSOLUTE /end AXIS_DESCR
/end CHARACTERISTIC
/begin CHARACTERISTIC TVNW_S "Verzˆgerungszeit nach der das Einlaﬂventil sicher in Sp‰tstellung ist" VALUE 0x1CA9AD KwUb 12.75 t50msxs_ub_b12p75 0.00 12.75 FORMAT "%5.2" /end CHARACTERISTIC
/begin CHARACTERISTIC TVSABFA "SA-Verzugszeit bei Funktionsanforderung (B_fa) und gangi = 0" VALUE 0x1C6D28 KwUw 655.3500 t10msxs_uw_b655p35 0.00 655.3500 FORMAT "%8.4" /end CHARACTERISTIC
/begin CHARACTERISTIC TVSABTE "Verzugszeit f¸r TEV Schlieﬂen vor Schubabschalten" VALUE 0x1C6D2A KwUw 655.3500 t10msxs_uw_b655p35 0.00 655.3500 FORMAT "%8.4" /end CHARACTERISTIC
/begin CHARACTERISTIC TVSAG0 "Totzeit Schubabschalten bei Gang 0" VALUE 0x1C6D2C KwUw 655.3500 t10msxs_uw_b655p35 0.00 655.3500 FORMAT "%8.4" /end CHARACTERISTIC
/begin CHARACTERISTIC TVSATM "Sperrzeit Schubabschalten nach Startende" CURVE 0x1CF6B8 KlAUbSstUbWUb 255.0 t1sxs_ub_b255 0.00 255.0 FORMAT "%5.1"
 /begin AXIS_DESCR STD_AXIS tmst temp_ub_q0p75_o48 6 -48.00 143.3 FORMAT "%5.1" DEPOSIT ABSOLUTE /end AXIS_DESCR
/end CHARACTERISTIC
/begin CHARACTERISTIC TVSEAGROFF "Zeitverzˆgerung  ab Satrtende f¸r Abschalten AGR bei Abweichg. Saugrohradaption." VALUE 0x1C8732 KwUw 655.3400 t10msxs_uw_b655p35 0.01000000 655.3500 FORMAT "%8.4" /end CHARACTERISTIC
/begin CHARACTERISTIC TWAFMN "Untere Schwelle des Temperaturfensters bei Feinadaption" VALUE 0x1CA9AE KwUb 191.3 temp_ub_q0p75_o48 -48.00 143.3 FORMAT "%5.1" /end CHARACTERISTIC
/begin CHARACTERISTIC TWAFMX "Obere Schwelle des Temperaturfensters bei Feinadaption" VALUE 0x1CA9AF KwUb 191.3 temp_ub_q0p75_o48 -48.00 143.3 FORMAT "%5.1" /end CHARACTERISTIC
/begin CHARACTERISTIC UANAUFRP "Schrittweite f¸r AUF-Rampe" VALUE 0x1C3488 KwUw 0.9994659 relDK_uw_b100 0.00 0.9994659 FORMAT "%9.7" /end CHARACTERISTIC
/begin CHARACTERISTIC UANNMAX "Motordrehzahlschwelle f¸r Freigabe UMA-Lernen und Verst‰rkerabgleich" VALUE 0x1C3470 KwUb 2550. nmot_ub_q10 0.00 2550. FORMAT "%5.0" /end CHARACTERISTIC
/begin CHARACTERISTIC UANPEDMAX "Pedalschwelle f¸r UMA-Lernen erlaubt" VALUE 0x1C3471 KwUb 100.0 relDK_ub_b100 0.00 100.0 FORMAT "%5.1" /end CHARACTERISTIC
/begin CHARACTERISTIC UANPIDMIN "Abbruchschwelle PID-Summe f¸r ZU-Rampe" VALUE 0x1C348A KwUw 99.99847 rel_uw_b100 0.00 99.99847 FORMAT "%8.5" /end CHARACTERISTIC
/begin CHARACTERISTIC UANPIDMINA "Abbruchschwelle PID-Summe f¸r AUF-Rampe" VALUE 0x1C348C KwUw 99.99847 rel_uw_b100 0.00 99.99847 FORMAT "%8.5" /end CHARACTERISTIC
/begin CHARACTERISTIC UANUATS "untere Ansauglufttemperaturschwelle f¸r Lernfreigabe" VALUE 0x1C3472 KwUb 191.3 temp_ub_q0p75_o48 -48.00 143.3 FORMAT "%5.1" /end CHARACTERISTIC
/begin CHARACTERISTIC UANVFZG "Geschwindigkeitssschelle f¸r DV-E-Pr¸fung/Lernroutine" VALUE 0x1C3473 KwUb 318.8 vfzg_ub_q1p25 0.00 318.8 FORMAT "%5.1" /end CHARACTERISTIC
/begin CHARACTERISTIC UANZURP "Schrittweite f¸r ZU-Rampe" VALUE 0x1C348E KwUw 0.05010200 spg_uw_q0p001222 0.00 0.05010200 FORMAT "%10.8" /end CHARACTERISTIC
/begin CHARACTERISTIC UAN_O_MT "obere Motortemperaturschwelle f¸r Anschlag" VALUE 0x1C3474 KwUb 191.3 temp_ub_q0p75_o48 -48.00 143.3 FORMAT "%5.1" /end CHARACTERISTIC
/begin CHARACTERISTIC UAN_STORE "Schwelle f¸r Abspeicherung neuer Lernwerte" VALUE 0x1C3490 KwUw 0.05010200 spg_uw_q0p001222 0.00 0.05010200 FORMAT "%10.8" /end CHARACTERISTIC
/begin CHARACTERISTIC UAN_U_MT "untere Motortemperaturschwelle f¸r Lernfreigabe" VALUE 0x1C3475 KwUb 191.3 temp_ub_q0p75_o48 -48.00 143.3 FORMAT "%5.1" /end CHARACTERISTIC
/begin CHARACTERISTIC UBSOLMN "Minimale Batterie-Sollspannung" VALUE 0x1CEA12 KwUb 24.02 spg_ubatt 0.00 24.02 FORMAT "%5.2" /end CHARACTERISTIC
/begin CHARACTERISTIC UBSOLMX "Maximale Batterie-Sollspannung" VALUE 0x1CEA13 KwUb 24.02 spg_ubatt 0.00 24.02 FORMAT "%5.2" /end CHARACTERISTIC
/begin CHARACTERISTIC UBSQLBK "Spannungsschwelle f¸r Freigabe Offset-Adaption der LBK" VALUE 0x1CA6D5 KwUb 25.50 spg_q0p1 0.00 25.50 FORMAT "%5.2" /end CHARACTERISTIC
/begin CHARACTERISTIC UB_UANL "Batteriespannungsschwelle f¸r Lernfreigabe" VALUE 0x1C3476 KwUb 24.02 spg_ubatt 0.00 24.02 FORMAT "%5.2" /end CHARACTERISTIC
/begin CHARACTERISTIC UDKNLP1N "Nennwert-Spannung DK-Poti 1 in NLP-Stellung" VALUE 0x1C3492 KwUw 5.004090 spg_uw_q0p001222 0.00 5.004090 FORMAT "%8.6" /end CHARACTERISTIC
/begin CHARACTERISTIC UDKNLP2N "Nennwert-Spannung DK-Poti 2 in NLP-Stellung" VALUE 0x1C3494 KwUw 5.004090 spg_uw_q0p001222 0.00 5.004090 FORMAT "%8.6" /end CHARACTERISTIC
/begin CHARACTERISTIC UDKP1AMAX "max. Spannung DK-Poti 1 am unteren DK-Anschlag" VALUE 0x1C3496 KwUw 5.004090 spg_uw_q0p001222 0.00 5.004090 FORMAT "%8.6" /end CHARACTERISTIC
/begin CHARACTERISTIC UDKP1AMIN "min. Spannung DK-Poti 1 am unteren DK-Anschlag" VALUE 0x1C3498 KwUw 5.004090 spg_uw_q0p001222 0.00 5.004090 FORMAT "%8.6" /end CHARACTERISTIC
/begin CHARACTERISTIC UDKP1AURI "Spannung DK-Poti 1 am unt. DK-Anschlag, Initial. Wert" VALUE 0x1C349A KwUw 5.004090 spg_uw_q0p001222 0.00 5.004090 FORMAT "%8.6" /end CHARACTERISTIC
/begin CHARACTERISTIC UDKP1DUS "Nennumschaltschwelle zur DK-Poti-1-Umschaltung" VALUE 0x1C3477 KwUb 4.980 spg_ub_b5 0.00 4.980 FORMAT "%5.3" /end CHARACTERISTIC
/begin CHARACTERISTIC UDKP1NHUB "Nennhub der Drosselklappe im DV-E, (Poti 1)" VALUE 0x1C349C KwUw 5.004090 spg_uw_q0p001222 0.00 5.004090 FORMAT "%8.6" /end CHARACTERISTIC
/begin CHARACTERISTIC UDKP1VID "Nennverst‰rkung f¸r DK-Poti 1" VALUE 0x1C349E KwUw 7.996094 fak_q0p0039 0.00 7.996094 FORMAT "%8.6" /end CHARACTERISTIC
/begin CHARACTERISTIC UDKP1VOMA "max. Offsetfehler f¸r DK-Poti-1-Verst‰rker" VALUE 0x1C34A0 KwSw 5.004090 spg_sw_q0p001222 0.00 5.004090 FORMAT "%8.6" /end CHARACTERISTIC
/begin CHARACTERISTIC UDKP1VOMI "min. Offsetfehler f¸r DK-Poti-1-Verst‰rker" VALUE 0x1C34A2 KwSw 5.004090 spg_sw_q0p001222 -5.004090 0.00 FORMAT "%8.6" /end CHARACTERISTIC
/begin CHARACTERISTIC UDKP1VVMA "ob. Wert Verst‰rkungsfehler f¸r Verst‰rker" VALUE 0x1C34A4 KwUw 7.996094 fak_q0p0039 0.00 7.996094 FORMAT "%8.6" /end CHARACTERISTIC
/begin CHARACTERISTIC UDKP1VVMI "unt. Wert Verst‰rkungsfehler f¸r Verst‰rker" VALUE 0x1C34A6 KwUw 7.996094 fak_q0p0039 0.00 7.996094 FORMAT "%8.6" /end CHARACTERISTIC
/begin CHARACTERISTIC UDKP2AMAX "max. Spannung DK-Poti 2 am unteren DK-Anschlag" VALUE 0x1C34A8 KwUw 5.004090 spg_uw_q0p001222 0.00 5.004090 FORMAT "%8.6" /end CHARACTERISTIC
/begin CHARACTERISTIC UDKP2AMIN "min. Spannung DK-Poti 2 am unteren DK-Anschlag" VALUE 0x1C34AA KwUw 5.004090 spg_uw_q0p001222 0.00 5.004090 FORMAT "%8.6" /end CHARACTERISTIC
/begin CHARACTERISTIC UDKP2AURI "Spannung DK-Poti 2 am unt. DK-Anschlag, Initial. Wert" VALUE 0x1C34AC KwUw 5.004090 spg_uw_q0p001222 0.00 5.004090 FORMAT "%8.6" /end CHARACTERISTIC
/begin CHARACTERISTIC UDKPALOS "Spannungsoffset zur Erkennung des Loslˆsens" VALUE 0x1C34AE KwUw 0.4008160 spg_uw_q0p001222 0.00 0.4008160 FORMAT "%9.7" /end CHARACTERISTIC
/begin CHARACTERISTIC UDKPAOFF "Spannungsoffset am unteren Anschlag" VALUE 0x1C34B0 KwUw 0.05010200 spg_uw_q0p001222 0.00 0.05010200 FORMAT "%10.8" /end CHARACTERISTIC
/begin CHARACTERISTIC UDKPATMX "max. mˆglicher Offset der temp. UMA-Adaption" VALUE 0x1C34B2 KwUw 5.004090 spg_uw_q0p001222 0.00 5.004090 FORMAT "%8.6" /end CHARACTERISTIC
/begin CHARACTERISTIC ULBKAUFP "LBK Spannungsinkrement pro Rechenraster beim OMA-Lernen" VALUE 0x1CA6E6 KwUw 319.9951 spg_q0p00488 0.00 319.9951 FORMAT "%8.4" /end CHARACTERISTIC
/begin CHARACTERISTIC ULBKHUB "Default Spannungshub der LBK-Lager¸ckmeldung" VALUE 0x1CA6E8 KwUw 319.9951 spg_q0p00488 0.00 319.9951 FORMAT "%8.4" /end CHARACTERISTIC
/begin CHARACTERISTIC ULBKNLPMAX "Maximal zul‰ssiger Spg.-Wert der LBK-R¸cklese am UMA" VALUE 0x1CA6EA KwUw 319.9951 spg_q0p00488 0.00 319.9951 FORMAT "%8.4" /end CHARACTERISTIC
/begin CHARACTERISTIC ULBKNLPMIN "Minimal zul‰ssiger Spg.-Wert der LBK-R¸cklese am UMA" VALUE 0x1CA6EC KwUw 319.9951 spg_q0p00488 0.00 319.9951 FORMAT "%8.4" /end CHARACTERISTIC
/begin CHARACTERISTIC ULBKOMAMAX "Maximal zul‰ssiger Spannungswert der LBK-R¸cklese am OMA" VALUE 0x1CA6EE KwUw 319.9951 spg_q0p00488 0.00 319.9951 FORMAT "%8.4" /end CHARACTERISTIC
/begin CHARACTERISTIC ULBKOMAMIN "Minimal zul‰ssiger Spannungswert der LBK-R¸cklese am OMA" VALUE 0x1CA6F0 KwUw 319.9951 spg_q0p00488 0.00 319.9951 FORMAT "%8.4" /end CHARACTERISTIC
/begin CHARACTERISTIC ULBKOOFF "Spg.-Offset zwischen OMA und OEA der LBK" VALUE 0x1CA6F2 KwUw 319.9951 spg_q0p00488 0.00 319.9951 FORMAT "%8.4" /end CHARACTERISTIC
/begin CHARACTERISTIC ULBKUOFF "Spg.-Offset zwischen UMA und UEA der LBK" VALUE 0x1CA6F4 KwUw 319.9951 spg_q0p00488 0.00 319.9951 FORMAT "%8.4" /end CHARACTERISTIC
/begin CHARACTERISTIC ULBKZURP "LBK Spannungsdekrement pro Rechenraster beim UMA-Lernen" VALUE 0x1CA6F6 KwUw 319.9951 spg_q0p00488 0.00 319.9951 FORMAT "%8.4" /end CHARACTERISTIC
/begin CHARACTERISTIC UPVGNENN "Nennwert f¸r DV-E Potiversorgungsspannung" VALUE 0x1CA824 KwUw 1.000000 dez 65534.00 65535.00 FORMAT "%8.2" /end CHARACTERISTIC
/begin CHARACTERISTIC VBGFGRAQ "Geschwindigkeit Bereichsgrenze bei Aquaplaningerkennung" VALUE 0x1C69C6 KwUw 511.9922 vfzg_uw_b512 0.00 511.9922 FORMAT "%8.4" /end CHARACTERISTIC
/begin CHARACTERISTIC VFGRMAX "Maximal zul‰ssige Geschwindigkeit im FGR-Betrieb" VALUE 0x1C69C8 KwUw 511.9922 vfzg_uw_b512 0.00 511.9922 FORMAT "%8.4" /end CHARACTERISTIC
/begin CHARACTERISTIC VFGRMIN "Minimal zul‰ssige Geschwindigkeit im FGR-Betrieb" VALUE 0x1C69CA KwUw 511.9922 vfzg_uw_b512 0.00 511.9922 FORMAT "%8.4" /end CHARACTERISTIC
/begin CHARACTERISTIC VREGLMAXKM "Maximal zul‰ssige Sollgeschwindigkeit f¸r FGR (f¸r Kilometertacho)" VALUE 0x1C69CC KwUw 511.9922 vfzg_uw_b512 0.00 511.9922 FORMAT "%8.4" /end CHARACTERISTIC
/begin CHARACTERISTIC VREGLMINKM "Minimal zul‰ssige Sollgeschwindigkeit f¸r FGR (f¸r Kilometertacho)" VALUE 0x1C69CE KwUw 511.9922 vfzg_uw_b512 0.00 511.9922 FORMAT "%8.4" /end CHARACTERISTIC
/begin CHARACTERISTIC VSAA "Geschwindigkeitsschwelle f¸r SA-Drehzahlanhebung" VALUE 0x1C6D0B KwUb 318.8 vfzg_ub_q1p25 0.00 318.8 FORMAT "%5.1" /end CHARACTERISTIC
/begin CHARACTERISTIC VWE "Gezwindigkeitsschwelle f¸r Drehzahlgradient nwe Kuppl. offen" VALUE 0x1C6D0C KwUb 318.8 vfzg_ub_q1p25 0.00 318.8 FORMAT "%5.1" /end CHARACTERISTIC
/begin CHARACTERISTIC WDKFPRO2 "Pr¸fschwelle DK-Istwert f¸r ˆffnende DV-E-Federpr¸fung" VALUE 0x1C34B4 KwSw 1599.976 relDK_q0p02441 -800.0000 799.9756 FORMAT "%8.4" /end CHARACTERISTIC
/begin CHARACTERISTIC WDKFPROO "Obere Abschaltschwelle DK-Istwert f¸r ˆffnende DV-E-Federpr¸fung" VALUE 0x1C34B6 KwSw 1599.976 relDK_q0p02441 -800.0000 799.9756 FORMAT "%8.4" /end CHARACTERISTIC
/begin CHARACTERISTIC WDKFPROU "Untere Abschaltschwelle DK-Istwert f¸r ˆffnende DV-E-Federpr¸fung" VALUE 0x1C34B8 KwSw 1599.976 relDK_q0p02441 -800.0000 799.9756 FORMAT "%8.4" /end CHARACTERISTIC
/begin CHARACTERISTIC WDKFPRZ1 "Abschaltschwelle DK-Istwert f¸r DV-E-R¸ckstellfederpr¸fung" VALUE 0x1C34BA KwUw 100.0000 relDK_uw_b100 0.00 100.0000 FORMAT "%8.4" /end CHARACTERISTIC
/begin CHARACTERISTIC WDKFPRZ2 "Pr¸fschwelle DK-Istwert f¸r DV-E-R¸ckstellfederpr¸fung" VALUE 0x1C34BC KwUw 100.0000 relDK_uw_b100 0.00 100.0000 FORMAT "%8.4" /end CHARACTERISTIC
/begin CHARACTERISTIC WDKNLPMA "oberer erlaubter Istwert f¸r NLP-Stellung" VALUE 0x1C34BE KwUw 100.0000 relDK_uw_b100 0.00 100.0000 FORMAT "%8.4" /end CHARACTERISTIC
/begin CHARACTERISTIC WDKNLPMI "unterer erlaubter Istwert f¸r NLP-Stellung" VALUE 0x1C34C0 KwUw 100.0000 relDK_uw_b100 0.00 100.0000 FORMAT "%8.4" /end CHARACTERISTIC
/begin CHARACTERISTIC WDKNPLAUS "Schwelle rechnerische Plausibilisierung NLP wdknlp_w in Ini2" VALUE 0x1C34C2 KwUw 100.0000 relDK_uw_b100 0.00 100.0000 FORMAT "%8.4" /end CHARACTERISTIC
/begin CHARACTERISTIC WDKNSTORE "Schwelle Abspeichern neuer Lernwerte relativer NLP" VALUE 0x1C34C4 KwUw 100.0000 relDK_uw_b100 0.00 100.0000 FORMAT "%8.4" /end CHARACTERISTIC
/begin CHARACTERISTIC WDKSFPR "DK-Sollwert f¸r DV-E-R¸ckstellfederpr¸fung" VALUE 0x1C34C6 KwUw 100.0000 relDK_uw_b100 0.00 100.0000 FORMAT "%8.4" /end CHARACTERISTIC
/begin CHARACTERISTIC WDKSFPRO "DK-Sollwert f¸r ˆffnende DV-E-Federpr¸fung" VALUE 0x1C34C8 KwUw 100.0000 relDK_uw_b100 0.00 100.0000 FORMAT "%8.4" /end CHARACTERISTIC
/begin CHARACTERISTIC WDKSTMUMA "DK-Winkel-Schwelle f¸r tempor‰re UMA-Adaption" VALUE 0x1C34CA KwUw 100.0000 relDK_uw_b100 0.00 100.0000 FORMAT "%8.4" /end CHARACTERISTIC
/begin CHARACTERISTIC WKHRMAX "Maximaler relativer Heizfortschritt Katheizen f¸r Einleiten von Abregelung" VALUE 0x1CC950 KwWU16 0.9999847 fak_uw_b1 0.00 0.9999847 FORMAT "%9.7" /end CHARACTERISTIC
/begin CHARACTERISTIC WKHWMAX "Maximale Heizw‰rme f¸r Katheizen nach Wiederholstart" VALUE 0x1CC952 KwWU16 4194240. q_q64 0.00 4194240. FORMAT "%8.0" /end CHARACTERISTIC
/begin CHARACTERISTIC ZIDSSU "Zeitkonstante Integrator Drucksensorabgleich DSS DSU" VALUE 0x1C8738 KwWU16 6553.50000 zk100msxs_uw_b6553 0.100001526 6553.60000 FORMAT "%10.5" /end CHARACTERISTIC
/begin CHARACTERISTIC ZKFUB "Filterzeitkonstante f¸r Batteriespannung" VALUE 0x1CEA14 KwUb 50.9992 zk200msxs_ub_b51p2 0.200784 51.2000 FORMAT "%7.4" /end CHARACTERISTIC
/begin CHARACTERISTIC ZKHABB "Zeitkonstante f¸r Abbruch-Tiefpass Katheizen" VALUE 0x1CC95A KwWU8 25.4996 zk100msxs_ub_b25p5 0.100392 25.6000 FORMAT "%7.4" /end CHARACTERISTIC
/begin CHARACTERISTIC ZKKHSWS "‹bergangszeit f¸r W‰rmestromforderung: von LL auf Last-Forderung" VALUE 0x1CC95B KwWU8 25.4996 zk100msxs_ub_b25p5 0.100392 25.6000 FORMAT "%7.4" /end CHARACTERISTIC
/begin CHARACTERISTIC ZKKHSWSLL "‹berganszeit f¸r W‰rmestromforderung: von Last auf LL-Forderung" VALUE 0x1CC95C KwWU8 25.4996 zk100msxs_ub_b25p5 0.100392 25.6000 FORMAT "%7.4" /end CHARACTERISTIC
/begin CHARACTERISTIC ZKLBZ "Zeitkonstante des LBZ-Integrators" VALUE 0x1CEA18 KwUw 13106.8000 zk200msxs_uw_b13107 0.200000000 13107.0000 FORMAT "%10.4" /end CHARACTERISTIC
/begin CHARACTERISTIC ZKMSDKTHFM "Zeitkonstante schnelle Massenstromadaption (bei Abgleich mit HFM-Signal)" CURVE 0x1C2CD2 KlAUwSstUwWUw 655.350000 zk10msxs_uw_b655 0.0100001526 655.360000 FORMAT "%10.6"
 /begin AXIS_DESCR STD_AXIS pspvds_w fak_uw_b2 8 0.00 1.999969 FORMAT "%8.6" DEPOSIT ABSOLUTE /end AXIS_DESCR
/end CHARACTERISTIC
/begin CHARACTERISTIC ZKPVDKT "Zeitkonstante f¸r langsame Massenstromadaption" CURVE 0x1C874E KlAUwSstUwWUw 65534.000000 zk1sxs_uw_b65535 1.0000000000 65535.000000 FORMAT "%12.6"
 /begin AXIS_DESCR STD_AXIS pspvds_w fak_uw_b2 8 0.00 1.999969 FORMAT "%8.6" DEPOSIT ABSOLUTE /end AXIS_DESCR
/end CHARACTERISTIC
/begin CHARACTERISTIC ZMRFABN "berechnet aktuelle Zeitkonstante des Tiefpaﬂ (Dauerhochlast) mrfabnf_w" CURVE 0x1CDD8C KlAUwSstSwWUw 6553.50000 zk100msxs_uw_b6553 0.100001526 6553.60000 FORMAT "%10.5"
 /begin AXIS_DESCR STD_AXIS dmrfabn_w rel_sw_b100 5 -100.0000 99.99695 FORMAT "%8.4" DEPOSIT ABSOLUTE /end AXIS_DESCR
/end CHARACTERISTIC
/begin CHARACTERISTIC ZMSDKAGRON "Zeitkonstante Abgleich Massenstrom im Ladedruckbereich" VALUE 0x1C2CF4 KwUw 655.350000 zk10msxs_uw_b655 0.0100001526 655.360000 FORMAT "%10.6" /end CHARACTERISTIC
/begin CHARACTERISTIC ZRFKMSDK "Zeitkonstante Reset Massenstromabgleich fkmsdk" VALUE 0x1C2CC4 KwUb 2.54000 zk10msxs_ub_b2p55 0.0100000 2.55000 FORMAT "%7.5" /end CHARACTERISTIC
/begin CHARACTERISTIC ZTFRMF "Zeitkonstante f¸r dfrmof_w Filter" VALUE 0x1CBC12 KwWU16 6553.50000 zk100msxs_uw_b6553 0.100001526 6553.60000 FORMAT "%10.5" /end CHARACTERISTIC
/begin CHARACTERISTIC ZTMSLF "Zeitkonstante f¸r msl_w und msllam_w Filter" VALUE 0x1CBC14 KwWU16 6553.50000 zk100msxs_uw_b6553 0.100001526 6553.60000 FORMAT "%10.5" /end CHARACTERISTIC
/begin CHARACTERISTIC ZTMSLVF "Zeitkonstante f¸r mslv_w Filter" VALUE 0x1CBC16 KwWU16 6553.50000 zk100msxs_uw_b6553 0.100001526 6553.60000 FORMAT "%10.5" /end CHARACTERISTIC
/begin CHARACTERISTIC ZYLANZB "Zylinderanzahl Bank 1" VALUE 0x1CC404 KwWU16 5.000000 fak_uw_b16 1.000000 6.000000 FORMAT "%8.6" /end CHARACTERISTIC
/begin CHARACTERISTIC ZYLANZB2 "Zylinderanzahl Bank 2" VALUE 0x1CC406 KwWU16 5.000000 fak_uw_b16 1.000000 6.000000 FORMAT "%8.6" /end CHARACTERISTIC
/begin MEASUREMENT anzrmsl2_w "Anzahl der d¸rchgef¸hrten Messungen zur Bestimmung der rel. Sekund‰rluftmasse" UWORD dez 1 100 0 65535 FORMAT "%8.2" ECU_ADDRESS 0x7FC708 /end MEASUREMENT
/begin MEASUREMENT anzrmsl_w "Anzahl der d¸rchgef¸hrten Messungen zur Bestimmung der rel. Sekund‰rluftmasse" UWORD dez 1 100 0 65535 FORMAT "%8.2" ECU_ADDRESS 0x7FC70A /end MEASUREMENT
/begin MEASUREMENT anztid "Differenz Einspritzzeahler im Berechnungsraster" UBYTE dez 1 100 0 255 FORMAT "%5.1" ECU_ADDRESS 0x800B68 /end MEASUREMENT
/begin MEASUREMENT AS_hr "" UBYTE B_TRUE 1 100 0 1 BIT_MASK 0x1 FORMAT "%13.11" ECU_ADDRESS 0x7FA885 /end MEASUREMENT
/begin MEASUREMENT AS_nl "" UBYTE B_TRUE 1 100 0 1 BIT_MASK 0x1 FORMAT "%13.11" ECU_ADDRESS 0x7FA886 /end MEASUREMENT
/begin MEASUREMENT AS_psoff "" UBYTE B_TRUE 1 100 0 1 BIT_MASK 0x1 FORMAT "%13.11" ECU_ADDRESS 0x7FA887 /end MEASUREMENT
/begin MEASUREMENT azkeldy_w "aktueller Wert der Kennlinie AZKELDYN" UWORD dez 1 100 0 65535 FORMAT "%8.2" ECU_ADDRESS 0x801AD8 /end MEASUREMENT
/begin MEASUREMENT azkrldy_w "aktueller Wert der Kennlinie AZKRLDYN" UWORD dez 1 100 0 65535 FORMAT "%8.2" ECU_ADDRESS 0x801ADA /end MEASUREMENT
/begin MEASUREMENT azkrndy_w "aktueller Wert der Kennlinie AZKRNDYN" UWORD dez 1 100 0 65535 FORMAT "%8.2" ECU_ADDRESS 0x801ADC /end MEASUREMENT
/begin MEASUREMENT BBFGRlokBits "" UBYTE dez 1 100 0 255 FORMAT "%5.1" ECU_ADDRESS 0x801249 /end MEASUREMENT
/begin MEASUREMENT bbkhzAusBits1 "" UBYTE dez 1 100 0 255 FORMAT "%5.1" ECU_ADDRESS 0x80089C /end MEASUREMENT
/begin MEASUREMENT bbkhzAusBits2 "" UBYTE dez 1 100 0 255 FORMAT "%5.1" ECU_ADDRESS 0x80089D /end MEASUREMENT
/begin MEASUREMENT bbkhzLokBits1 "" UBYTE dez 1 100 0 255 FORMAT "%5.1" ECU_ADDRESS 0x80089E /end MEASUREMENT
/begin MEASUREMENT BBNWSlokbits "" UBYTE dez 1 100 0 255 FORMAT "%5.1" ECU_ADDRESS 0x8005AA /end MEASUREMENT
/begin MEASUREMENT BBNWSoutbits "" UBYTE dez 1 100 0 255 FORMAT "%5.1" ECU_ADDRESS 0x8010E9 /end MEASUREMENT
/begin MEASUREMENT BGARNWausbits "" UBYTE dez 1 100 0 255 FORMAT "%5.1" ECU_ADDRESS 0x8010ED /end MEASUREMENT
/begin MEASUREMENT BGARNWlokbits "" UBYTE dez 1 100 0 255 FORMAT "%5.1" ECU_ADDRESS 0x8005B0 /end MEASUREMENT
/begin MEASUREMENT BGBNausbits0 "" UBYTE dez 1 100 0 255 FORMAT "%5.1" ECU_ADDRESS 0x801099 /end MEASUREMENT
/begin MEASUREMENT bgdslsAusBits1 "" UBYTE dez 1 100 0 255 FORMAT "%5.1" ECU_ADDRESS 0x8007BE /end MEASUREMENT
/begin MEASUREMENT bgdslsAusBits2 "" UBYTE dez 1 100 0 255 FORMAT "%5.1" ECU_ADDRESS 0x8007BF /end MEASUREMENT
/begin MEASUREMENT bgdslsLokBits1 "" UBYTE dez 1 100 0 255 FORMAT "%5.1" ECU_ADDRESS 0x8007C0 /end MEASUREMENT
/begin MEASUREMENT BGDVEintbits "" UBYTE dez 1 100 0 255 FORMAT "%5.1" ECU_ADDRESS 0x7FC31C /end MEASUREMENT
/begin MEASUREMENT BGKVbits "" UBYTE dez 1 100 0 255 FORMAT "%5.1" ECU_ADDRESS 0x800B69 /end MEASUREMENT
/begin MEASUREMENT bmlosctr_w "Z‰hler (Word) Neusynchronisationen durch L¸ckenverlust" UWORD dez 1 100 0 65535 FORMAT "%8.2" ECU_ADDRESS 0x7FC7D6 /end MEASUREMENT
/begin MEASUREMENT B_abgle "Bedingung: Fehler beim Verst‰rkerabgleich" UBYTE B_TRUE 1 100 0 1 BIT_MASK 0x1 FORMAT "%13.11" ECU_ADDRESS 0x7FA63B /end MEASUREMENT
/begin MEASUREMENT B_afupsrl "Bedingung: Adaption fupsrl" UBYTE B_TRUE 1 100 0 1 BIT_MASK 0x1 FORMAT "%13.11" ECU_ADDRESS 0x800506 /end MEASUREMENT
/begin MEASUREMENT B_afupsrle "Bedingung: Adaption fupsrl eingeschwungen" UBYTE B_TRUE 1 100 0 1 BIT_MASK 0x4 FORMAT "%13.11" ECU_ADDRESS 0x800507 /end MEASUREMENT
/begin MEASUREMENT B_apbrint "Bedingung: Adaption pbrint" UBYTE B_TRUE 1 100 0 1 BIT_MASK 0x2 FORMAT "%13.11" ECU_ADDRESS 0x800506 /end MEASUREMENT
/begin MEASUREMENT B_apbrinte "Bedingung: Adaption pbrint eingeschwungen" UBYTE B_TRUE 1 100 0 1 BIT_MASK 0x8 FORMAT "%13.11" ECU_ADDRESS 0x800507 /end MEASUREMENT
/begin MEASUREMENT B_apslmdse "Bedingung: Adaption modellierter auf gemessenem Saugrohrdruck eingeschwungen" UBYTE B_TRUE 1 100 0 1 BIT_MASK 0x1 FORMAT "%13.11" ECU_ADDRESS 0x800507 /end MEASUREMENT
/begin MEASUREMENT B_bevab "Bedingung EV-Abschaltung auf Bank/Bank1" UBYTE B_TRUE 1 100 0 1 BIT_MASK 0x1 FORMAT "%13.11" ECU_ADDRESS 0x7FA813 /end MEASUREMENT
/begin MEASUREMENT B_bevab2 "Bedingung EV-Abschaltung auf Bank2" UBYTE B_TRUE 1 100 0 1 BIT_MASK 0x1 FORMAT "%13.11" ECU_ADDRESS 0x7FA814 /end MEASUREMENT
/begin MEASUREMENT B_bvhfm "Bedingung: Bordnetzversorgung HFM" UBYTE B_TRUE 1 100 0 1 BIT_MASK 0x1 FORMAT "%13.11" ECU_ADDRESS 0x801099 /end MEASUREMENT
/begin MEASUREMENT B_bvhls "Bedingung: Bordnetzversorgung Lambdasondenheizung" UBYTE B_TRUE 1 100 0 1 BIT_MASK 0x2 FORMAT "%13.11" ECU_ADDRESS 0x801099 /end MEASUREMENT
/begin MEASUREMENT B_dcdisr "Bedingung: DV-E-Endstufenabschaltung wird angefordert" UBYTE B_TRUE 1 100 0 1 BIT_MASK 0x1 FORMAT "%13.11" ECU_ADDRESS 0x7FA63C /end MEASUREMENT
/begin MEASUREMENT B_dfrmoff "frm-Offset-Schwelle ¸berschritten: zeigt Vorsteuerproblem" UBYTE B_TRUE 1 100 0 1 BIT_MASK 0x1 FORMAT "%13.11" ECU_ADDRESS 0x8007BE /end MEASUREMENT
/begin MEASUREMENT B_dfrmoff2 "frm-Offset-Schwelle ¸berschritten: zeigt Vorsteuerproblem Bank 2" UBYTE B_TRUE 1 100 0 1 BIT_MASK 0x2 FORMAT "%13.11" ECU_ADDRESS 0x8007BE /end MEASUREMENT
/begin MEASUREMENT B_dfrmr "Bed. gefilterte Abweichung frm von 1.0 f¸r Offsetbestimmung DSLS eingeschwungen" UBYTE B_TRUE 1 100 0 1 BIT_MASK 0x4 FORMAT "%13.11" ECU_ADDRESS 0x8007BE /end MEASUREMENT
/begin MEASUREMENT B_dfrmr2 "Bed. gefilterte Abweichung frm von 1.0 f¸r Offsetbestimmung DSLS eingeschwungen" UBYTE B_TRUE 1 100 0 1 BIT_MASK 0x8 FORMAT "%13.11" ECU_ADDRESS 0x8007BE /end MEASUREMENT
/begin MEASUREMENT B_disagra "Bedingung AGR disable bis  Saugrohradaption eingeschwungen" UBYTE B_TRUE 1 100 0 1 BIT_MASK 0x10 FORMAT "%13.11" ECU_ADDRESS 0x800507 /end MEASUREMENT
/begin MEASUREMENT B_dkaden "Bedingung: DK-Sollwert aus DK-Adaption und -Pr¸fung verwenden" UBYTE B_TRUE 1 100 0 1 BIT_MASK 0x1 FORMAT "%13.11" ECU_ADDRESS 0x7FA63D /end MEASUREMENT
/begin MEASUREMENT B_dknach "Dauer-RAM, Bedingung: DK im Nachlauf stromlos und in NLP" UBYTE B_TRUE 1 100 0 1 BIT_MASK 0x8 FORMAT "%13.11" ECU_ADDRESS 0x7FC31C /end MEASUREMENT
/begin MEASUREMENT B_dlrien "Bedingung: keine temp. Begrenzung des I-Anteils im DLR durchf¸hren" UBYTE B_TRUE 1 100 0 1 BIT_MASK 0x1 FORMAT "%13.11" ECU_ADDRESS 0x7FA63E /end MEASUREMENT
/begin MEASUREMENT B_dnsll "Bedingung SA-Drehzahl-Hysterese DNSLL" UBYTE B_TRUE 1 100 0 1 BIT_MASK 0x1 FORMAT "%13.11" ECU_ADDRESS 0x7FA9A4 /end MEASUREMENT
/begin MEASUREMENT B_dnwfozea "Bedingung Freigabe Nockenwellendiagnose ohne Zyklusflag Endstufenpr¸fung Auslass" UBYTE B_TRUE 1 100 0 1 BIT_MASK 0x80 FORMAT "%13.11" ECU_ADDRESS 0x8010EA /end MEASUREMENT
/begin MEASUREMENT B_dnwfozee "Bedingung Freigabe Nockenwellendiagnose ohne Zyklusflag Endstufenpr¸fung Einlass" UBYTE B_TRUE 1 100 0 1 BIT_MASK 0x80 FORMAT "%13.11" ECU_ADDRESS 0x8010EB /end MEASUREMENT
/begin MEASUREMENT B_drknv "handshake 10ms - KR.synchro" UBYTE B_TRUE 1 100 0 1 BIT_MASK 0x1 FORMAT "%13.11" ECU_ADDRESS 0x7FA81E /end MEASUREMENT
/begin MEASUREMENT B_dveada "Bedingung: DV-E-Adaption sperrt Einspritzung" UBYTE B_TRUE 1 100 0 1 BIT_MASK 0x1 FORMAT "%13.11" ECU_ADDRESS 0x7FA63F /end MEASUREMENT
/begin MEASUREMENT B_dvetv "Bedingung: Verriegelungsbit erweiterte Stellertauscherkennung" UBYTE B_TRUE 1 100 0 1 BIT_MASK 0x1 FORMAT "%13.11" ECU_ADDRESS 0x7FA640 /end MEASUREMENT
/begin MEASUREMENT B_eks "Bedingung Klopfsensorfehler erkannt" UBYTE B_TRUE 1 100 0 1 BIT_MASK 0x1 FORMAT "%13.11" ECU_ADDRESS 0x7FA81F /end MEASUREMENT
/begin MEASUREMENT B_elzsr "Bedingung: Fehler Leck zum Saugrohr" UBYTE B_TRUE 1 100 0 1 BIT_MASK 0x10 FORMAT "%13.11" ECU_ADDRESS 0x800506 /end MEASUREMENT
/begin MEASUREMENT B_ESrdy "" UBYTE B_TRUE 1 100 0 1 BIT_MASK 0x1 FORMAT "%13.11" ECU_ADDRESS 0x7FA641 /end MEASUREMENT
/begin MEASUREMENT B_evakt "Bedingung alle Einspritzventile aktiv/angesteuert" UBYTE B_TRUE 1 100 0 1 BIT_MASK 0x1 FORMAT "%13.11" ECU_ADDRESS 0x7FA815 /end MEASUREMENT
/begin MEASUREMENT B_evloc "Status: alle lokalen Einspritzventile werden angesteuert, = B_EVTOT bei einem SG" UBYTE B_TRUE 1 100 0 1 BIT_MASK 0x1 FORMAT "%13.11" ECU_ADDRESS 0x7FA816 /end MEASUREMENT
/begin MEASUREMENT B_fbm "Bedingung Bezugsmarkenfehler => mindestens 1 Zahn zuviel oder zuwenig erkannt" UBYTE B_TRUE 1 100 0 1 BIT_MASK 0x1 FORMAT "%13.11" ECU_ADDRESS 0x7FA864 /end MEASUREMENT
/begin MEASUREMENT B_fgabgl "Bedingung Freigabe des F¸llungsabgleichs" UBYTE B_TRUE 1 100 0 1 BIT_MASK 0x1 FORMAT "%13.11" ECU_ADDRESS 0x7FA60F /end MEASUREMENT
/begin MEASUREMENT B_fgrab "FGR-/ACC-Abschaltung aus der Funktion" UBYTE B_TRUE 1 100 0 1 BIT_MASK 0x1 FORMAT "%13.11" ECU_ADDRESS 0x7FA97D /end MEASUREMENT
/begin MEASUREMENT B_fgraext "Bedingung: FGR-Abschaltung durch externe Anforderung ASC/DSC" UBYTE B_TRUE 1 100 0 1 BIT_MASK 0x8 FORMAT "%13.11" ECU_ADDRESS 0x801249 /end MEASUREMENT
/begin MEASUREMENT B_fgrai "Bedingung FGR-Abschaltung irreversibel" UBYTE B_TRUE 1 100 0 1 BIT_MASK 0x1 FORMAT "%13.11" ECU_ADDRESS 0x7FA97E /end MEASUREMENT
/begin MEASUREMENT B_fgral "Bedingung FGR-Abschaltung langsam" UBYTE B_TRUE 1 100 0 1 BIT_MASK 0x1 FORMAT "%13.11" ECU_ADDRESS 0x7FA97F /end MEASUREMENT
/begin MEASUREMENT B_fgrars "Bedingung: FGR-Abschaltung reversibel schnell" UBYTE B_TRUE 1 100 0 1 BIT_MASK 0x2 FORMAT "%13.11" ECU_ADDRESS 0x801249 /end MEASUREMENT
/begin MEASUREMENT B_fgras "Bedingung: FGR-Abschaltung schnell" UBYTE B_TRUE 1 100 0 1 BIT_MASK 0x1 FORMAT "%13.11" ECU_ADDRESS 0x7FA980 /end MEASUREMENT
/begin MEASUREMENT B_fgrenv "Bedingung FGR-Regelung aktiv (Enable) vorl‰ufig" UBYTE B_TRUE 1 100 0 1 BIT_MASK 0x1 FORMAT "%13.11" ECU_ADDRESS 0x7FA981 /end MEASUREMENT
/begin MEASUREMENT B_fgres "Bedingung FGR-Einschaltung" UBYTE B_TRUE 1 100 0 1 BIT_MASK 0x4 FORMAT "%13.11" ECU_ADDRESS 0x801249 /end MEASUREMENT
/begin MEASUREMENT B_fgresv "Bedingung FGR-Einschaltgeschwindigkeit erreicht" UBYTE B_TRUE 1 100 0 1 BIT_MASK 0x1 FORMAT "%13.11" ECU_ADDRESS 0x7FA982 /end MEASUREMENT
/begin MEASUREMENT B_fgsabgl "Bedingung Freigabe des schnellen Massenstromabgleichs" UBYTE B_TRUE 1 100 0 1 BIT_MASK 0x1 FORMAT "%13.11" ECU_ADDRESS 0x7FA610 /end MEASUREMENT
/begin MEASUREMENT B_fklsol "Bedingung Anforderung Verst‰rkungsumschaltung Fettkennlinie LSU/CJ125" UBYTE B_TRUE 1 100 0 1 BIT_MASK 0x1 FORMAT "%13.11" ECU_ADDRESS 0x7FA721 /end MEASUREMENT
/begin MEASUREMENT B_fklsol2 "Bedingung Anforderung Verst‰rkungsumschaltung Fettkennlinie LSU2/CJ125" UBYTE B_TRUE 1 100 0 1 BIT_MASK 0x1 FORMAT "%13.11" ECU_ADDRESS 0x7FA722 /end MEASUREMENT
/begin MEASUREMENT B_fkmsmn "schnelle Massenstromadaption fkmsdks im unteren Anschlag" UBYTE B_TRUE 1 100 0 1 BIT_MASK 0x1 FORMAT "%13.11" ECU_ADDRESS 0x7FA611 /end MEASUREMENT
/begin MEASUREMENT B_fkmsmx "schnelle Massenstromadaption fkmsdks im oberen Anschlag" UBYTE B_TRUE 1 100 0 1 BIT_MASK 0x1 FORMAT "%13.11" ECU_ADDRESS 0x7FA612 /end MEASUREMENT
/begin MEASUREMENT B_fkpvdk "Bedingung f¸r die Freigabe des langsamen multiplikativen F¸llungsabgleichs" UBYTE B_TRUE 1 100 0 1 BIT_MASK 0x1 FORMAT "%13.11" ECU_ADDRESS 0x800512 /end MEASUREMENT
/begin MEASUREMENT B_fkpvmn "langsame Massenstromadaption fkpvdk im unteren Anschlag" UBYTE B_TRUE 1 100 0 1 BIT_MASK 0x20 FORMAT "%13.11" ECU_ADDRESS 0x800512 /end MEASUREMENT
/begin MEASUREMENT B_fkpvmx "langsame Massenstromadaption fkpvdk im oberen Anschlag" UBYTE B_TRUE 1 100 0 1 BIT_MASK 0x10 FORMAT "%13.11" ECU_ADDRESS 0x800512 /end MEASUREMENT
/begin MEASUREMENT B_fphad "Berechnung Freigabebedingung f¸r Flankenadaption Phasensensor" UBYTE B_TRUE 1 100 0 1 BIT_MASK 0x1 FORMAT "%13.11" ECU_ADDRESS 0x8005B0 /end MEASUREMENT
/begin MEASUREMENT B_fprakt "DK-R¸ckstellfeder-Pr¸fung aktiv" UBYTE B_TRUE 1 100 0 1 BIT_MASK 0x1 FORMAT "%13.11" ECU_ADDRESS 0x7FA642 /end MEASUREMENT
/begin MEASUREMENT B_fproab "Bedingung: DV-E-Pr¸fung ˆffnende Feder Abbruch, Feder ˆffnet nicht" UBYTE B_TRUE 1 100 0 1 BIT_MASK 0x1 FORMAT "%13.11" ECU_ADDRESS 0x7FA643 /end MEASUREMENT
/begin MEASUREMENT B_fproe "Bedingung: ÷ffnende Federpr¸fung Fehler" UBYTE B_TRUE 1 100 0 1 BIT_MASK 0x1 FORMAT "%13.11" ECU_ADDRESS 0x7FA644 /end MEASUREMENT
/begin MEASUREMENT B_fprook "Bedingung: ˆffnende Federpr¸fung i.O." UBYTE B_TRUE 1 100 0 1 BIT_MASK 0x1 FORMAT "%13.11" ECU_ADDRESS 0x7FA645 /end MEASUREMENT
/begin MEASUREMENT B_fprordy "Bedingung: ÷ffnende Federpr¸fung fertig" UBYTE B_TRUE 1 100 0 1 BIT_MASK 0x1 FORMAT "%13.11" ECU_ADDRESS 0x7FA646 /end MEASUREMENT
/begin MEASUREMENT B_fprovb "Bedingung: ÷ffnende Federpr¸fung verboten" UBYTE B_TRUE 1 100 0 1 BIT_MASK 0x1 FORMAT "%13.11" ECU_ADDRESS 0x7FA647 /end MEASUREMENT
/begin MEASUREMENT B_fprrdy "DK-R¸ckstellfeder-Pr¸fung beendet" UBYTE B_TRUE 1 100 0 1 BIT_MASK 0x1 FORMAT "%13.11" ECU_ADDRESS 0x7FA648 /end MEASUREMENT
/begin MEASUREMENT B_fprzab "Bedingung: DV-E-R¸ckstellfederpr¸fung Abbruch, Feder schlieﬂt nicht" UBYTE B_TRUE 1 100 0 1 BIT_MASK 0x1 FORMAT "%13.11" ECU_ADDRESS 0x7FA649 /end MEASUREMENT
/begin MEASUREMENT B_fprze "Bedingung: Fehler in der DV-E-R¸ckstellfederpr¸fung" UBYTE B_TRUE 1 100 0 1 BIT_MASK 0x1 FORMAT "%13.11" ECU_ADDRESS 0x7FA64A /end MEASUREMENT
/begin MEASUREMENT B_fprzok "Bedingung: DV-E-R¸ckstellfederpr¸fung i.O." UBYTE B_TRUE 1 100 0 1 BIT_MASK 0x1 FORMAT "%13.11" ECU_ADDRESS 0x7FA64B /end MEASUREMENT
/begin MEASUREMENT B_fprzvb "Bedingung: DV-E-R¸ckstellfederpr¸fung verboten" UBYTE B_TRUE 1 100 0 1 BIT_MASK 0x1 FORMAT "%13.11" ECU_ADDRESS 0x7FA64C /end MEASUREMENT
/begin MEASUREMENT B_fraoan "Anforderung TEV schnell schlieﬂen zur Aktivierung der Gemischadaption" UBYTE B_TRUE 1 100 0 1 BIT_MASK 0x1 FORMAT "%13.11" ECU_ADDRESS 0x7FA7AE /end MEASUREMENT
/begin MEASUREMENT B_gap "Bedingung Gemischadaptionsphase aktiv" UBYTE B_TRUE 1 100 0 1 BIT_MASK 0x1 FORMAT "%13.11" ECU_ADDRESS 0x7FA7AF /end MEASUREMENT
/begin MEASUREMENT B_genws "Verstellung der NW bei Getriebeeingriff untersagt" UBYTE B_TRUE 1 100 0 1 BIT_MASK 0x2 FORMAT "%13.11" ECU_ADDRESS 0x8010E9 /end MEASUREMENT
/begin MEASUREMENT B_hr "Bedingung Hauptrelais ein" UBYTE B_TRUE 1 100 0 1 BIT_MASK 0x1 FORMAT "%13.11" ECU_ADDRESS 0x7FC820 /end MEASUREMENT
/begin MEASUREMENT B_hwpwf "" UBYTE B_TRUE 1 100 0 1 BIT_MASK 0x1 FORMAT "%13.11" ECU_ADDRESS 0x800E81 /end MEASUREMENT
/begin MEASUREMENT B_inidfrm "Initialisierung Tiefpaﬂ mit aktuellen frm Abweichung von 1" UBYTE B_TRUE 1 100 0 1 BIT_MASK 0x1 FORMAT "%13.11" ECU_ADDRESS 0x8007C0 /end MEASUREMENT
/begin MEASUREMENT B_inilabgl "Bedingung zur Initialisierung des langsamen Massenstromabgleichs" UBYTE B_TRUE 1 100 0 1 BIT_MASK 0x1 FORMAT "%13.11" ECU_ADDRESS 0x7FA613 /end MEASUREMENT
/begin MEASUREMENT B_inimsdko "Bedingung Initialisierung langsamer additiver Massenstromabgleich" UBYTE B_TRUE 1 100 0 1 BIT_MASK 0x0 FORMAT "%13.11" ECU_ADDRESS 0x800513 /end MEASUREMENT
/begin MEASUREMENT B_inimslf "Initialisierung Tiefpaﬂ mit aktuellen Sekund‰rluftwert w‰hrend Messphase" UBYTE B_TRUE 1 100 0 1 BIT_MASK 0x2 FORMAT "%13.11" ECU_ADDRESS 0x8007C0 /end MEASUREMENT
/begin MEASUREMENT B_inimslvf "Initialisierung Tiefpaﬂ mit aktuellen Sekund‰rluftwert w‰hrend Ventildichtheitsc" UBYTE B_TRUE 1 100 0 1 BIT_MASK 0x4 FORMAT "%13.11" ECU_ADDRESS 0x8007C0 /end MEASUREMENT
/begin MEASUREMENT B_inisabgl "Bedingung zur Initialisierung des schnellen Massenstromabgleichs" UBYTE B_TRUE 1 100 0 1 BIT_MASK 0x1 FORMAT "%13.11" ECU_ADDRESS 0x7FA614 /end MEASUREMENT
/begin MEASUREMENT B_inisyn3s "" UBYTE B_TRUE 1 100 0 1 BIT_MASK 0x1 FORMAT "%13.11" ECU_ADDRESS 0x7FA820 /end MEASUREMENT
/begin MEASUREMENT B_kh "Bedingung Kat-Heizung" UBYTE B_TRUE 1 100 0 1 BIT_MASK 0x1 FORMAT "%13.11" ECU_ADDRESS 0x7FA6EF /end MEASUREMENT
/begin MEASUREMENT B_kha "Anforderung Katheizen" UBYTE B_TRUE 1 100 0 1 BIT_MASK 0x1 FORMAT "%13.11" ECU_ADDRESS 0x80089C /end MEASUREMENT
/begin MEASUREMENT B_khan "Anforderung Katheizen bei erreichen der Mindestdrehzahl" UBYTE B_TRUE 1 100 0 1 BIT_MASK 0x2 FORMAT "%13.11" ECU_ADDRESS 0x80089C /end MEASUREMENT
/begin MEASUREMENT B_khares "Bedingung R¸cksetzen von Bit B_kha" UBYTE B_TRUE 1 100 0 1 BIT_MASK 0x1 FORMAT "%13.11" ECU_ADDRESS 0x80089E /end MEASUREMENT
/begin MEASUREMENT B_khaset "Bedingung Setzen von Bit B_kha" UBYTE B_TRUE 1 100 0 1 BIT_MASK 0x4 FORMAT "%13.11" ECU_ADDRESS 0x80089C /end MEASUREMENT
/begin MEASUREMENT B_kherr "Fehler bedingte Sperrbedingung f¸r Bit B_kh" UBYTE B_TRUE 1 100 0 1 BIT_MASK 0x2 FORMAT "%13.11" ECU_ADDRESS 0x80089E /end MEASUREMENT
/begin MEASUREMENT B_khlbk "Bedingung: Sollvorgabe der LBK f¸r Katheizen" UBYTE B_TRUE 1 100 0 1 BIT_MASK 0x10 FORMAT "%13.11" ECU_ADDRESS 0x80089C /end MEASUREMENT
/begin MEASUREMENT B_khmrfrho "Adressierung der LL-Kennfelder f¸r Katheizen ¸ber Hˆhe oder Dichte" UBYTE B_TRUE 1 100 0 1 BIT_MASK 0x20 FORMAT "%13.11" ECU_ADDRESS 0x80089C /end MEASUREMENT
/begin MEASUREMENT B_khnwt "Bedingung: Umschaltung Motortemperaturschwelle f¸r KAT-Heizen" UBYTE B_TRUE 1 100 0 1 BIT_MASK 0x8 FORMAT "%13.11" ECU_ADDRESS 0x8005AA /end MEASUREMENT
/begin MEASUREMENT B_khoab "Bedingung Katheizen ohne Abbruchkriterium durchgef¸hrt" UBYTE B_TRUE 1 100 0 1 BIT_MASK 0x40 FORMAT "%13.11" ECU_ADDRESS 0x80089C /end MEASUREMENT
/begin MEASUREMENT B_kl15 "Bedingung Klemme 15" UBYTE B_TRUE 1 100 0 1 BIT_MASK 0x1 FORMAT "%13.11" ECU_ADDRESS 0x800E83 /end MEASUREMENT
/begin MEASUREMENT B_kr "Bedingung Klopregelung aktiv" UBYTE B_TRUE 1 100 0 1 BIT_MASK 0x1 FORMAT "%13.11" ECU_ADDRESS 0x7FA821 /end MEASUREMENT
/begin MEASUREMENT B_kra "Bedingung KR-Adaption aktiv" UBYTE B_TRUE 1 100 0 1 BIT_MASK 0x1 FORMAT "%13.11" ECU_ADDRESS 0x7FA822 /end MEASUREMENT
/begin MEASUREMENT B_kradap "Bedingung Freigabe Station‰radaption" UBYTE B_TRUE 1 100 0 1 BIT_MASK 0x1 FORMAT "%13.11" ECU_ADDRESS 0x7FA823 /end MEASUREMENT
/begin MEASUREMENT B_kra_old "" UBYTE B_TRUE 1 100 0 1 BIT_MASK 0x1 FORMAT "%13.11" ECU_ADDRESS 0x7FA824 /end MEASUREMENT
/begin MEASUREMENT B_krdws "Bedingung Klopfregelung Sicherheitssp‰tverstellung" UBYTE B_TRUE 1 100 0 1 BIT_MASK 0x1 FORMAT "%13.11" ECU_ADDRESS 0x7FA825 /end MEASUREMENT
/begin MEASUREMENT B_krdyerr "" UBYTE B_TRUE 1 100 0 1 BIT_MASK 0x1 FORMAT "%13.11" ECU_ADDRESS 0x7FA826 /end MEASUREMENT
/begin MEASUREMENT B_krdyerr_old "" UBYTE B_TRUE 1 100 0 1 BIT_MASK 0x1 FORMAT "%13.11" ECU_ADDRESS 0x7FA827 /end MEASUREMENT
/begin MEASUREMENT B_krfdks "Bedingung Freigabe Diagnose KS" UBYTE B_TRUE 1 100 0 1 BIT_MASK 0x1 FORMAT "%13.11" ECU_ADDRESS 0x7FA828 /end MEASUREMENT
/begin MEASUREMENT B_krgz "gef¸hrter Zylinder" UBYTE B_TRUE 1 100 0 1 BIT_MASK 0x1 FORMAT "%13.11" ECU_ADDRESS 0x7FA829 /end MEASUREMENT
/begin MEASUREMENT B_krkez "EV des aktuellen Zylinders abgeschaltet" UBYTE B_TRUE 1 100 0 1 BIT_MASK 0x1 FORMAT "%13.11" ECU_ADDRESS 0x7FA82A /end MEASUREMENT
/begin MEASUREMENT B_krldy "Bedingung Lastdynamik f¸r Klopferkennung aktiv" UBYTE B_TRUE 1 100 0 1 BIT_MASK 0x1 FORMAT "%13.11" ECU_ADDRESS 0x7FA82B /end MEASUREMENT
/begin MEASUREMENT B_krldya "Bedingung Lastdynamikvorhalt und -adaption aktiv" UBYTE B_TRUE 1 100 0 1 BIT_MASK 0x1 FORMAT "%13.11" ECU_ADDRESS 0x7FA82C /end MEASUREMENT
/begin MEASUREMENT B_krldya_old "" UBYTE B_TRUE 1 100 0 1 BIT_MASK 0x1 FORMAT "%13.11" ECU_ADDRESS 0x7FA82D /end MEASUREMENT
/begin MEASUREMENT B_krldya_set "" UBYTE B_TRUE 1 100 0 1 BIT_MASK 0x1 FORMAT "%13.11" ECU_ADDRESS 0x7FA82E /end MEASUREMENT
/begin MEASUREMENT B_krldyf "Bedingung Adaption Lastdynamikvorhalt nach fr¸h freigegeben" UBYTE B_TRUE 1 100 0 1 BIT_MASK 0x1 FORMAT "%13.11" ECU_ADDRESS 0x7FA82F /end MEASUREMENT
/begin MEASUREMENT B_krldyv "Bedingung Lastschwelle f¸r Dynamikvorhalt ¸berschritten" UBYTE B_TRUE 1 100 0 1 BIT_MASK 0x1 FORMAT "%13.11" ECU_ADDRESS 0x7FA830 /end MEASUREMENT
/begin MEASUREMENT B_krldyv_old "" UBYTE B_TRUE 1 100 0 1 BIT_MASK 0x1 FORMAT "%13.11" ECU_ADDRESS 0x7FA831 /end MEASUREMENT
/begin MEASUREMENT B_krndy "Bedingung Drehzahldynamik f¸r Klopferkennung aktiv" UBYTE B_TRUE 1 100 0 1 BIT_MASK 0x1 FORMAT "%13.11" ECU_ADDRESS 0x7FA832 /end MEASUREMENT
/begin MEASUREMENT B_krnl "Notlauf Klopferkennung bei Phasennotlauf und/oder Doppelz¸ndung" UBYTE B_TRUE 1 100 0 1 BIT_MASK 0x1 FORMAT "%13.11" ECU_ADDRESS 0x7FA833 /end MEASUREMENT
/begin MEASUREMENT B_krsyne "Klopfregelung Synchronisationsfehler bei Phasenfehler" UBYTE B_TRUE 1 100 0 1 BIT_MASK 0x1 FORMAT "%13.11" ECU_ADDRESS 0x7FA834 /end MEASUREMENT
/begin MEASUREMENT B_kvta "Bedingung verbrauchter Kraftstoff groesser max. Tankinhalt" UBYTE B_TRUE 1 100 0 1 BIT_MASK 0x1 FORMAT "%13.11" ECU_ADDRESS 0x800B69 /end MEASUREMENT
/begin MEASUREMENT B_kwwsanf "Bedingung Abgasw‰rmestrom angefordert zum Katalysator Warmhalten" UBYTE B_TRUE 1 100 0 1 BIT_MASK 0x80 FORMAT "%13.11" ECU_ADDRESS 0x80089C /end MEASUREMENT
/begin MEASUREMENT B_ladap "Bedingung Eintritt in Lastdynamikadaption" UBYTE B_TRUE 1 100 0 1 BIT_MASK 0x1 FORMAT "%13.11" ECU_ADDRESS 0x7FA835 /end MEASUREMENT
/begin MEASUREMENT B_lbkaden "LBK Adaption enabled" UBYTE B_TRUE 1 100 0 1 BIT_MASK 0x1 FORMAT "%13.11" ECU_ADDRESS 0x8010BC /end MEASUREMENT
/begin MEASUREMENT B_lbkdarfl "Bedingung LBK darf lernen" UBYTE B_TRUE 1 100 0 1 BIT_MASK 0x2 FORMAT "%13.11" ECU_ADDRESS 0x8010BC /end MEASUREMENT
/begin MEASUREMENT B_lbkgrlef "Bedingung: Steigungs-Adaption abgeschlossen" UBYTE B_TRUE 1 100 0 1 BIT_MASK 0x4 FORMAT "%13.11" ECU_ADDRESS 0x8010BC /end MEASUREMENT
/begin MEASUREMENT B_lbklernb "Bedingung LBK Lernbedarf" UBYTE B_TRUE 1 100 0 1 BIT_MASK 0x2 FORMAT "%13.11" ECU_ADDRESS 0x7FC31A /end MEASUREMENT
/begin MEASUREMENT B_lbklrnab "Bedingung Abbruch beim Lernen der LBK" UBYTE B_TRUE 1 100 0 1 BIT_MASK 0x8 FORMAT "%13.11" ECU_ADDRESS 0x8010BC /end MEASUREMENT
/begin MEASUREMENT B_lbklrnef "Bedingung: Offset und Steigungs-Adaption abgeschlossen" UBYTE B_TRUE 1 100 0 1 BIT_MASK 0x4 FORMAT "%13.11" ECU_ADDRESS 0x8010BD /end MEASUREMENT
/begin MEASUREMENT B_lbklrnws "Bedingung LBK hat mindestens einmal richtig gelernt (EEPROM-Werte ok)" UBYTE B_TRUE 1 100 0 1 BIT_MASK 0x2 FORMAT "%13.11" ECU_ADDRESS 0x8010BD /end MEASUREMENT
/begin MEASUREMENT B_lbknlpab "Bedingung Abbruch bei NLP-Check (LBK)" UBYTE B_TRUE 1 100 0 1 BIT_MASK 0x10 FORMAT "%13.11" ECU_ADDRESS 0x8010BC /end MEASUREMENT
/begin MEASUREMENT B_lbknlpca "Ausgabeanforderung festes TV f¸r NLP-Check oder Notlauf (LBK)" UBYTE B_TRUE 1 100 0 1 BIT_MASK 0x40 FORMAT "%13.11" ECU_ADDRESS 0x8010BC /end MEASUREMENT
/begin MEASUREMENT B_lbknlpch "Bedingung LBK-Notlaufpos.-Check wurde im Nachlauf i.O. gepr¸ft" UBYTE B_TRUE 1 100 0 1 BIT_MASK 0x1 FORMAT "%13.11" ECU_ADDRESS 0x7FC31A /end MEASUREMENT
/begin MEASUREMENT B_lbkoflef "Bedingung: Offset-Adaption abgeschlossen" UBYTE B_TRUE 1 100 0 1 BIT_MASK 0x20 FORMAT "%13.11" ECU_ADDRESS 0x8010BC /end MEASUREMENT
/begin MEASUREMENT B_lbkomaab "Bedingung Abbruch bei Lernen des OMA (LBK)" UBYTE B_TRUE 1 100 0 1 BIT_MASK 0x80 FORMAT "%13.11" ECU_ADDRESS 0x8010BC /end MEASUREMENT
/begin MEASUREMENT B_lbkumaab "Bedingung Abbruch bei Lernen des UMA (LBK)" UBYTE B_TRUE 1 100 0 1 BIT_MASK 0x1 FORMAT "%13.11" ECU_ADDRESS 0x8010BD /end MEASUREMENT
/begin MEASUREMENT B_lrnakt "Lernaktiv Bit" UBYTE B_TRUE 1 100 0 1 BIT_MASK 0x1 FORMAT "%13.11" ECU_ADDRESS 0x7FA64D /end MEASUREMENT
/begin MEASUREMENT B_lrnerf "Lernerfolg Bit" UBYTE B_TRUE 1 100 0 1 BIT_MASK 0x2 FORMAT "%13.11" ECU_ADDRESS 0x7FC31C /end MEASUREMENT
/begin MEASUREMENT B_lrnfg "Lernfreigabe Bit" UBYTE B_TRUE 1 100 0 1 BIT_MASK 0x1 FORMAT "%13.11" ECU_ADDRESS 0x7FA64E /end MEASUREMENT
/begin MEASUREMENT B_lrnrdy "Lernen ist beendet" UBYTE B_TRUE 1 100 0 1 BIT_MASK 0x1 FORMAT "%13.11" ECU_ADDRESS 0x7FA64F /end MEASUREMENT
/begin MEASUREMENT B_lrntesa "Bedingung: UMA-Lernen u. Verst.abgl wegen Tester-Anford. aktiviert" UBYTE B_TRUE 1 100 0 1 BIT_MASK 0x1 FORMAT "%13.11" ECU_ADDRESS 0x7FA650 /end MEASUREMENT
/begin MEASUREMENT B_lrnvb "Lernverbot Bit" UBYTE B_TRUE 1 100 0 1 BIT_MASK 0x1 FORMAT "%13.11" ECU_ADDRESS 0x7FA651 /end MEASUREMENT
/begin MEASUREMENT B_lrnws "Lernwertspeicherung Bit" UBYTE B_TRUE 1 100 0 1 BIT_MASK 0x1 FORMAT "%13.11" ECU_ADDRESS 0x7FC31C /end MEASUREMENT
/begin MEASUREMENT B_msllamr "Beding. gefilterte Sekund‰rluftmasse (aus Lamdbasignal berechnet) eingeschwungen" UBYTE B_TRUE 1 100 0 1 BIT_MASK 0x10 FORMAT "%13.11" ECU_ADDRESS 0x8007BE /end MEASUREMENT
/begin MEASUREMENT B_msllamr2 "Beding. gefilterte Sekund‰rluftmasse (aus Lamdbasignal berechnet) eingeschwungen" UBYTE B_TRUE 1 100 0 1 BIT_MASK 0x20 FORMAT "%13.11" ECU_ADDRESS 0x8007BE /end MEASUREMENT
/begin MEASUREMENT B_msllavr "Beding. gefilterte Sekund‰rluftmasse f¸r Ventildichtigkeitscheck eingeschwungen" UBYTE B_TRUE 1 100 0 1 BIT_MASK 0x40 FORMAT "%13.11" ECU_ADDRESS 0x8007BE /end MEASUREMENT
/begin MEASUREMENT B_msllavr2 "Beding. gefilterte Sekund‰rluftmasse f¸r Ventildichtigkeitscheck eingeschwungen" UBYTE B_TRUE 1 100 0 1 BIT_MASK 0x80 FORMAT "%13.11" ECU_ADDRESS 0x8007BE /end MEASUREMENT
/begin MEASUREMENT B_mslubr "Bedingung gefilterte Sekund‰rluftmasse aus Ubat berechent eingeschwungen (Bank1)" UBYTE B_TRUE 1 100 0 1 BIT_MASK 0x1 FORMAT "%13.11" ECU_ADDRESS 0x8007BF /end MEASUREMENT
/begin MEASUREMENT B_mslubr2 "Bedingung gefilterte Sekund‰rluftmasse aus Ubat berechent eingeschwungen (Bank2)" UBYTE B_TRUE 1 100 0 1 BIT_MASK 0x2 FORMAT "%13.11" ECU_ADDRESS 0x8007BF /end MEASUREMENT
/begin MEASUREMENT B_mslubvr "Beding. gefilterte Sekund‰rluftmasse (theo. Wert ) eingeschwungen (Bank1)" UBYTE B_TRUE 1 100 0 1 BIT_MASK 0x4 FORMAT "%13.11" ECU_ADDRESS 0x8007BF /end MEASUREMENT
/begin MEASUREMENT B_mslubvr2 "Beding. gefilterte Sekund‰rluftmasse (theo. Wert ) eingeschwungen (Bank2)" UBYTE B_TRUE 1 100 0 1 BIT_MASK 0x8 FORMAT "%13.11" ECU_ADDRESS 0x8007BF /end MEASUREMENT
/begin MEASUREMENT B_msndko "Freigabebedingung f¸r langsamen additiven Massenstromabgleich" UBYTE B_TRUE 1 100 0 1 BIT_MASK 0x2 FORMAT "%13.11" ECU_ADDRESS 0x800512 /end MEASUREMENT
/begin MEASUREMENT B_nachlauf "Steuerung SG-Nachlauf" UBYTE B_TRUE 1 100 0 1 BIT_MASK 0x1 FORMAT "%13.11" ECU_ADDRESS 0x800E84 /end MEASUREMENT
/begin MEASUREMENT B_nlpe "Bedingung: Fehler in NLP-Pr¸fung u. -Lernen" UBYTE B_TRUE 1 100 0 1 BIT_MASK 0x1 FORMAT "%13.11" ECU_ADDRESS 0x7FA652 /end MEASUREMENT
/begin MEASUREMENT B_nlperf "Dauer-RAM, Bedingung: NLP-Erfassung erfolgreich" UBYTE B_TRUE 1 100 0 1 BIT_MASK 0x4 FORMAT "%13.11" ECU_ADDRESS 0x7FC31C /end MEASUREMENT
/begin MEASUREMENT B_nlpnew "Bedingung: NLP-Position ist noch nicht bekannt" UBYTE B_TRUE 1 100 0 1 BIT_MASK 0x1 FORMAT "%13.11" ECU_ADDRESS 0x7FA653 /end MEASUREMENT
/begin MEASUREMENT B_nlpreq "Bedingung: NLP-Lernen anfordern" UBYTE B_TRUE 1 100 0 1 BIT_MASK 0x1 FORMAT "%13.11" ECU_ADDRESS 0x7FA654 /end MEASUREMENT
/begin MEASUREMENT B_nnwmx "Drehzahlschwelle f¸r NW-Regelung ¸berschritten" UBYTE B_TRUE 1 100 0 1 BIT_MASK 0x4 FORMAT "%13.11" ECU_ADDRESS 0x8010E9 /end MEASUREMENT
/begin MEASUREMENT B_nocampos "Position der Nockenwelle konnte nicht ermittelt werden" UBYTE B_TRUE 1 100 0 1 BIT_MASK 0x1 FORMAT "%13.11" ECU_ADDRESS 0x7FA865 /end MEASUREMENT
/begin MEASUREMENT B_norm "SG-Bedingung normaler Motorsteuerungsbetrieb" UBYTE B_TRUE 1 100 0 1 BIT_MASK 0x1 FORMAT "%13.11" ECU_ADDRESS 0x800E85 /end MEASUREMENT
/begin MEASUREMENT B_nwadaa "Anforderung Flankenadaption NW-Phasensensor durch Betriebsbereich Auslass" UBYTE B_TRUE 1 100 0 1 BIT_MASK 0x2 FORMAT "%13.11" ECU_ADDRESS 0x8005B0 /end MEASUREMENT
/begin MEASUREMENT B_nwadae "Anforderung Flankenadaption NW-Phasensensor durch Betriebsbereich Einlass" UBYTE B_TRUE 1 100 0 1 BIT_MASK 0x10 FORMAT "%13.11" ECU_ADDRESS 0x8005B0 /end MEASUREMENT
/begin MEASUREMENT B_nwadaga "Anforderung Erst-Flankenadaption  NW-Phasensensor durch Betriebsbereich Auslass" UBYTE B_TRUE 1 100 0 1 BIT_MASK 0x4 FORMAT "%13.11" ECU_ADDRESS 0x8005B0 /end MEASUREMENT
/begin MEASUREMENT B_nwadage "Anforderung Erst-Flankenadaption NW-Phasensensor durch Betriebsbereich Einlass" UBYTE B_TRUE 1 100 0 1 BIT_MASK 0x20 FORMAT "%13.11" ECU_ADDRESS 0x8005B0 /end MEASUREMENT
/begin MEASUREMENT B_nwadagfa "Anforderung Flankenadaption NW-Phasensensor durch Betriebsbereich Auslass" UBYTE B_TRUE 1 100 0 1 BIT_MASK 0x4 FORMAT "%13.11" ECU_ADDRESS 0x8010ED /end MEASUREMENT
/begin MEASUREMENT B_nwadagfe "Anforderung Flankenadaption NW-Phasensensor durch Betriebsbereich Einlass" UBYTE B_TRUE 1 100 0 1 BIT_MASK 0x20 FORMAT "%13.11" ECU_ADDRESS 0x8010ED /end MEASUREMENT
/begin MEASUREMENT B_nwemg "Bedingung Umschaltung der Wiedereinsetzdrehzahl bei Kupplung ˆffnet" UBYTE B_TRUE 1 100 0 1 BIT_MASK 0x1 FORMAT "%13.11" ECU_ADDRESS 0x7FA9A5 /end MEASUREMENT
/begin MEASUREMENT B_nwflada "Bedingung Flankenadaption Nockenwelle Auslaﬂ angefordert" UBYTE B_TRUE 1 100 0 1 BIT_MASK 0x1 FORMAT "%13.11" ECU_ADDRESS 0x8010ED /end MEASUREMENT
/begin MEASUREMENT B_nwflade "Bedingung Flankenadaption Nockenwelle Einlaﬂ angefordert" UBYTE B_TRUE 1 100 0 1 BIT_MASK 0x10 FORMAT "%13.11" ECU_ADDRESS 0x8010ED /end MEASUREMENT
/begin MEASUREMENT B_nwkwaosw "Bedingung: Phasenadaption ohne Vorgabe von Sollwinkeln" UBYTE B_TRUE 1 100 0 1 BIT_MASK 0x2 FORMAT "%13.11" ECU_ADDRESS 0x8010EC /end MEASUREMENT
/begin MEASUREMENT B_nwnmot "Bedingung: Nockenwellenverstellung ¸ber Drehzahlschwelle freigegeben" UBYTE B_TRUE 1 100 0 1 BIT_MASK 0x1 FORMAT "%13.11" ECU_ADDRESS 0x8005AA /end MEASUREMENT
/begin MEASUREMENT B_nwrposa "Bedingung: Ansteuerung der Nockenwellen-Referenzposition durch Steller (Auslass)" UBYTE B_TRUE 1 100 0 1 BIT_MASK 0x2 FORMAT "%13.11" ECU_ADDRESS 0x8010ED /end MEASUREMENT
/begin MEASUREMENT B_nwrpose "Bedingung: Ansteuerung der Nockenwellen-Referenzposition durch Steller (Einlass)" UBYTE B_TRUE 1 100 0 1 BIT_MASK 0x8 FORMAT "%13.11" ECU_ADDRESS 0x8010ED /end MEASUREMENT
/begin MEASUREMENT B_nws "Bedingung Nockenwellensteuerung" UBYTE B_TRUE 1 100 0 1 BIT_MASK 0x10 FORMAT "%13.11" ECU_ADDRESS 0x8010E9 /end MEASUREMENT
/begin MEASUREMENT B_nwsapkfa "Bedingung: Applikationswinkel f¸r Nockenwellenverstellung aus Kennfeld (Auslass)" UBYTE B_TRUE 1 100 0 1 BIT_MASK 0x2 FORMAT "%13.11" ECU_ADDRESS 0x8010EA /end MEASUREMENT
/begin MEASUREMENT B_nwsapkfe "Bedingung: Applikationswinkel f¸r Nockenwellenverstellung aus Kennfeld (Einlass)" UBYTE B_TRUE 1 100 0 1 BIT_MASK 0x2 FORMAT "%13.11" ECU_ADDRESS 0x8010EB /end MEASUREMENT
/begin MEASUREMENT B_nwsappa "Bed. zur Sollwertvorgabe (Auslaﬂ) ¸ber Applikationscodewort WNWSAAPP" UBYTE B_TRUE 1 100 0 1 BIT_MASK 0x1 FORMAT "%13.11" ECU_ADDRESS 0x8010EA /end MEASUREMENT
/begin MEASUREMENT B_nwsappe "Bed. zur Sollwertvorgabe (Einlaﬂ) ¸ber Applikationscodewort WNWSEAPP" UBYTE B_TRUE 1 100 0 1 BIT_MASK 0x1 FORMAT "%13.11" ECU_ADDRESS 0x8010EB /end MEASUREMENT
/begin MEASUREMENT B_nwsinva "Bed.zur Multiplik. von gemessen NW-Istwert mit (-1) vor Umspeich. in %NWSYVAR" UBYTE B_TRUE 1 100 0 1 BIT_MASK 0x4 FORMAT "%13.11" ECU_ADDRESS 0x8010EA /end MEASUREMENT
/begin MEASUREMENT B_nwsinve "Bed.zur Multiplik. von gemessen NW-Istwert mit (-1) vor Umspeich. in %NWSYVAR" UBYTE B_TRUE 1 100 0 1 BIT_MASK 0x4 FORMAT "%13.11" ECU_ADDRESS 0x8010EB /end MEASUREMENT
/begin MEASUREMENT B_nwskflla "Bedingung: B_ll -> unterschiedliche Sollwinkelkennfelder bei Nockenwelle Auslass" UBYTE B_TRUE 1 100 0 1 BIT_MASK 0x20 FORMAT "%13.11" ECU_ADDRESS 0x8010EA /end MEASUREMENT
/begin MEASUREMENT B_nwskflle "Bedingung: B_ll -> unterschiedliche Sollwinkelkennfelder bei Nockenwelle Einlass" UBYTE B_TRUE 1 100 0 1 BIT_MASK 0x20 FORMAT "%13.11" ECU_ADDRESS 0x8010EB /end MEASUREMENT
/begin MEASUREMENT B_nwskha "Bed. das bei B_kh auf seperates KF zur Sollwertvorgabe(Auslaﬂ) umgesch. wird" UBYTE B_TRUE 1 100 0 1 BIT_MASK 0x8 FORMAT "%13.11" ECU_ADDRESS 0x8010EA /end MEASUREMENT
/begin MEASUREMENT B_nwskhe "Bed. das bei B_kh auf seperates KF zur Sollwertvorgabe(Einlaﬂ) umgesch. wird" UBYTE B_TRUE 1 100 0 1 BIT_MASK 0x8 FORMAT "%13.11" ECU_ADDRESS 0x8010EB /end MEASUREMENT
/begin MEASUREMENT B_nwsoada "Freigabe Nockenwellenverstellung ohne Phasenflankenadaption" UBYTE B_TRUE 1 100 0 1 BIT_MASK 0x80 FORMAT "%13.11" ECU_ADDRESS 0x8010EC /end MEASUREMENT
/begin MEASUREMENT B_nwsrl "Bed. in NW-Steuerung zur Auswahl zwischen rlsol u. rlshk zur KF-Adressierung" UBYTE B_TRUE 1 100 0 1 BIT_MASK 0x1 FORMAT "%13.11" ECU_ADDRESS 0x8010EC /end MEASUREMENT
/begin MEASUREMENT B_nwssprga "Bed. Freigabe Sollwertspr¸nge zu Applikationszwecken Auslaﬂnockenwelle" UBYTE B_TRUE 1 100 0 1 BIT_MASK 0x40 FORMAT "%13.11" ECU_ADDRESS 0x8010EA /end MEASUREMENT
/begin MEASUREMENT B_nwssprge "Bed. Freigabe Sollwertspr¸nge zu Applikationszwecken Einlaﬂnockenwelle" UBYTE B_TRUE 1 100 0 1 BIT_MASK 0x40 FORMAT "%13.11" ECU_ADDRESS 0x8010EB /end MEASUREMENT
/begin MEASUREMENT B_nwsst "Bedingung Freigabe der Nockenwellensteuerung w‰hrend Start" UBYTE B_TRUE 1 100 0 1 BIT_MASK 0x8 FORMAT "%13.11" ECU_ADDRESS 0x8010E9 /end MEASUREMENT
/begin MEASUREMENT B_nwsstend "Bedingung:  Ende Sperrzeit f¸r  Nockenwellensteuerung  nach Startende" UBYTE B_TRUE 1 100 0 1 BIT_MASK 0x2 FORMAT "%13.11" ECU_ADDRESS 0x8005AA /end MEASUREMENT
/begin MEASUREMENT B_nwstvakt "Bedingung: Nockenwellenverstellung im Start aktiv" UBYTE B_TRUE 1 100 0 1 BIT_MASK 0x4 FORMAT "%13.11" ECU_ADDRESS 0x8010EC /end MEASUREMENT
/begin MEASUREMENT B_nwt "Bedingung: Nockenwellensteuerung ¸ber Temperatur freigegeben" UBYTE B_TRUE 1 100 0 1 BIT_MASK 0x4 FORMAT "%13.11" ECU_ADDRESS 0x8005AA /end MEASUREMENT
/begin MEASUREMENT B_outofsyn "Nockenwellenposition ausserhalb des zul‰ssigen Synchronisationsbereichs" UBYTE B_TRUE 1 100 0 1 BIT_MASK 0x1 FORMAT "%13.11" ECU_ADDRESS 0x7FA866 /end MEASUREMENT
/begin MEASUREMENT B_phadnws "Freigabe der NW-Verstellung nach erfolgreicher Adaption NW zu KW" UBYTE B_TRUE 1 100 0 1 BIT_MASK 0x1 FORMAT "%13.11" ECU_ADDRESS 0x8010E9 /end MEASUREMENT
/begin MEASUREMENT B_pwf "Bedingung Powerfail" UBYTE B_TRUE 1 100 0 1 BIT_MASK 0x1 FORMAT "%13.11" ECU_ADDRESS 0x7FA884 /end MEASUREMENT
/begin MEASUREMENT B_pwfPat "Bedingung Neuinitialisierung NVRAM angefordert durch SW" UBYTE B_TRUE 1 100 0 1 BIT_MASK 0x1 FORMAT "%13.11" ECU_ADDRESS 0x800E82 /end MEASUREMENT
/begin MEASUREMENT B_rapskt "Bedingung: Reset Adaption modellierter auf gemessenem Saugrohrdruck bei KT-AGR" UBYTE B_TRUE 1 100 0 1 BIT_MASK 0x4 FORMAT "%13.11" ECU_ADDRESS 0x800506 /end MEASUREMENT
/begin MEASUREMENT B_rapslmds "Bedingung: Reset Adaption modellierter auf gemessenem Saugrohrdruck" UBYTE B_TRUE 1 100 0 1 BIT_MASK 0x2 FORMAT "%13.11" ECU_ADDRESS 0x800507 /end MEASUREMENT
/begin MEASUREMENT B_sab "Bedingung Schubabschaltebereitschaft" UBYTE B_TRUE 1 100 0 1 BIT_MASK 0x1 FORMAT "%13.11" ECU_ADDRESS 0x7FA9A6 /end MEASUREMENT
/begin MEASUREMENT B_sabfg "Bedingung SA-Bereitschaft oder deren Freigabe" UBYTE B_TRUE 1 100 0 1 BIT_MASK 0x1 FORMAT "%13.11" ECU_ADDRESS 0x7FA9A7 /end MEASUREMENT
/begin MEASUREMENT B_sabt "Bedingung Schubabschaltebereitschaft" UBYTE B_TRUE 1 100 0 1 BIT_MASK 0x1 FORMAT "%13.11" ECU_ADDRESS 0x7FA9A8 /end MEASUREMENT
/begin MEASUREMENT B_sabte "Bedingung Schubabschaltebereitschaft f¸r Tankentl¸ftungsventil schlieﬂen" UBYTE B_TRUE 1 100 0 1 BIT_MASK 0x1 FORMAT "%13.11" ECU_ADDRESS 0x7FA9A9 /end MEASUREMENT
/begin MEASUREMENT B_sabv "Bedingung Schubabschaltebereitschaft verboten" UBYTE B_TRUE 1 100 0 1 BIT_MASK 0x1 FORMAT "%13.11" ECU_ADDRESS 0x7FA9AA /end MEASUREMENT
/begin MEASUREMENT B_saen "Bedingung Schubabschalten freigegeben" UBYTE B_TRUE 1 100 0 1 BIT_MASK 0x1 FORMAT "%13.11" ECU_ADDRESS 0x7FA9AB /end MEASUREMENT
/begin MEASUREMENT B_sbblsu "Bedingung LSU betriebsbereit vor Kat f(lamsons_w)" UBYTE B_TRUE 1 100 0 1 BIT_MASK 0x1 FORMAT "%13.11" ECU_ADDRESS 0x7FA723 /end MEASUREMENT
/begin MEASUREMENT B_sbblsu2 "Bedingung LSU betriebsbereit vor Kat, Bank 2 f(lamsons2_w)" UBYTE B_TRUE 1 100 0 1 BIT_MASK 0x1 FORMAT "%13.11" ECU_ADDRESS 0x7FA724 /end MEASUREMENT
/begin MEASUREMENT B_sbbvk "Bedingung Sonde betriebsbereit vor Kat" UBYTE B_TRUE 1 100 0 1 BIT_MASK 0x1 FORMAT "%13.11" ECU_ADDRESS 0x7FA725 /end MEASUREMENT
/begin MEASUREMENT B_sbbvk2 "Bedingung Sonde betriebsbereit vor Kat, Bank 2" UBYTE B_TRUE 1 100 0 1 BIT_MASK 0x1 FORMAT "%13.11" ECU_ADDRESS 0x7FA726 /end MEASUREMENT
/begin MEASUREMENT B_st "Bedingung Start" UBYTE B_TRUE 1 100 0 1 BIT_MASK 0x1 FORMAT "%13.11" ECU_ADDRESS 0x7FA867 /end MEASUREMENT
/begin MEASUREMENT B_stend "Bedingung Startende erreicht" UBYTE B_TRUE 1 100 0 1 BIT_MASK 0x1 FORMAT "%13.11" ECU_ADDRESS 0x7FA868 /end MEASUREMENT
/begin MEASUREMENT B_swkh "Bedingung Sollw‰rme f¸r Katheizen bei Motorstart grˆﬂer Null" UBYTE B_TRUE 1 100 0 1 BIT_MASK 0x4 FORMAT "%13.11" ECU_ADDRESS 0x80089E /end MEASUREMENT
/begin MEASUREMENT B_tatmsa "Bedingung: Temperaturen aus ATM erlauben SA" UBYTE B_TRUE 1 100 0 1 BIT_MASK 0x8 FORMAT "%13.11" ECU_ADDRESS 0x801258 /end MEASUREMENT
/begin MEASUREMENT B_tedtev "Bedingung Tankentl¸ftung zum Sp¸len vor TEV-Diagnose" UBYTE B_TRUE 1 100 0 1 BIT_MASK 0x1 FORMAT "%13.11" ECU_ADDRESS 0x7FA7B0 /end MEASUREMENT
/begin MEASUREMENT B_tehbxf "Bedingung Beladungsintegrator ftead am Maximalanschlag, gefiltert" UBYTE B_TRUE 1 100 0 1 BIT_MASK 0x1 FORMAT "%13.11" ECU_ADDRESS 0x7FA7B1 /end MEASUREMENT
/begin MEASUREMENT B_tep "Bedingung Tankentl¸ftungsphase" UBYTE B_TRUE 1 100 0 1 BIT_MASK 0x1 FORMAT "%13.11" ECU_ADDRESS 0x7FA7B2 /end MEASUREMENT
/begin MEASUREMENT B_tepi "Bedingung TE-Phase intern aktiv" UBYTE B_TRUE 1 100 0 1 BIT_MASK 0x1 FORMAT "%13.11" ECU_ADDRESS 0x7FA7B3 /end MEASUREMENT
/begin MEASUREMENT B_tepzhl "Bedingung Tankentl¸ftungphase zus‰tzlich wegen Dauerhochlast" UBYTE B_TRUE 1 100 0 1 BIT_MASK 0x1 FORMAT "%13.11" ECU_ADDRESS 0x7FA7B4 /end MEASUREMENT
/begin MEASUREMENT B_tepzus "Bedingung zus‰tzliche Tankentl¸ftungsphase" UBYTE B_TRUE 1 100 0 1 BIT_MASK 0x1 FORMAT "%13.11" ECU_ADDRESS 0x7FA7B5 /end MEASUREMENT
/begin MEASUREMENT B_tesstp "Bedingung Tankentl¸ftung schnell stoppen" UBYTE B_TRUE 1 100 0 1 BIT_MASK 0x1 FORMAT "%13.11" ECU_ADDRESS 0x7FA7B6 /end MEASUREMENT
/begin MEASUREMENT B_testop "Bedingung Tankentl¸ftung stoppen" UBYTE B_TRUE 1 100 0 1 BIT_MASK 0x1 FORMAT "%13.11" ECU_ADDRESS 0x7FA7B7 /end MEASUREMENT
/begin MEASUREMENT B_tezstp "Bedingung Tankentl¸ftung zwang stoppen" UBYTE B_TRUE 1 100 0 1 BIT_MASK 0x1 FORMAT "%13.11" ECU_ADDRESS 0x7FA7B8 /end MEASUREMENT
/begin MEASUREMENT B_tipin "Tip in erkannt" UBYTE B_TRUE 1 100 0 1 BIT_MASK 0x1 FORMAT "%13.11" ECU_ADDRESS 0x7FA836 /end MEASUREMENT
/begin MEASUREMENT B_tmkr "Bedingung Temperatur (tmot) fuer KR aktiv erreicht" UBYTE B_TRUE 1 100 0 1 BIT_MASK 0x1 FORMAT "%13.11" ECU_ADDRESS 0x7FA837 /end MEASUREMENT
/begin MEASUREMENT B_trkh "Bedingung Katheizen, Thermoreaktor wirksam" UBYTE B_TRUE 1 100 0 1 BIT_MASK 0x1 FORMAT "%13.11" ECU_ADDRESS 0x80089D /end MEASUREMENT
/begin MEASUREMENT B_trkonz "Bedingung das Katheizen mit Thermoreaktorkonzept realisiert wird" UBYTE B_TRUE 1 100 0 1 BIT_MASK 0x2 FORMAT "%13.11" ECU_ADDRESS 0x80089D /end MEASUREMENT
/begin MEASUREMENT B_trkz "Bedingung Katheizen mit Thermoreaktorkonzept mˆglich" UBYTE B_TRUE 1 100 0 1 BIT_MASK 0x8 FORMAT "%13.11" ECU_ADDRESS 0x80089E /end MEASUREMENT
/begin MEASUREMENT B_tteae "Bedingung Umschaltung auf lange TE-Phase" UBYTE B_TRUE 1 100 0 1 BIT_MASK 0x1 FORMAT "%13.11" ECU_ADDRESS 0x7FA7B9 /end MEASUREMENT
/begin MEASUREMENT B_ttegais "Bedingung erste GA-Phase ist kurz" UBYTE B_TRUE 1 100 0 1 BIT_MASK 0x1 FORMAT "%13.11" ECU_ADDRESS 0x7FA7BA /end MEASUREMENT
/begin MEASUREMENT B_umae "Bedingung: Fehler beim UMA-Lernen" UBYTE B_TRUE 1 100 0 1 BIT_MASK 0x1 FORMAT "%13.11" ECU_ADDRESS 0x7FA655 /end MEASUREMENT
/begin MEASUREMENT B_umauab "Bedingung: UMA-Lernen w‰hrend Urinitialisierung abgebrochen (SKA)" UBYTE B_TRUE 1 100 0 1 BIT_MASK 0x1 FORMAT "%13.11" ECU_ADDRESS 0x7FA656 /end MEASUREMENT
/begin MEASUREMENT B_wakeup "SG-Bedingung: wake up Betrieb" UBYTE B_TRUE 1 100 0 1 BIT_MASK 0x1 FORMAT "%13.11" ECU_ADDRESS 0x800E86 /end MEASUREMENT
/begin MEASUREMENT B_wkral "Bedingung wkr aus KR-Adaptionskennfeld einlesen" UBYTE B_TRUE 1 100 0 1 BIT_MASK 0x1 FORMAT "%13.11" ECU_ADDRESS 0x7FA838 /end MEASUREMENT
/begin MEASUREMENT B_wnwsmxfa "Maximaler Sollwinkel durch feste Grenze WNWEMAX definiert (Auslass)" UBYTE B_TRUE 1 100 0 1 BIT_MASK 0x10 FORMAT "%13.11" ECU_ADDRESS 0x8010EA /end MEASUREMENT
/begin MEASUREMENT B_wnwsmxfe "Maximaler Sollwinkel durch feste Grenze WNWEMAX definiert (Einlass)" UBYTE B_TRUE 1 100 0 1 BIT_MASK 0x10 FORMAT "%13.11" ECU_ADDRESS 0x8010EB /end MEASUREMENT
/begin MEASUREMENT B_zlzsr "Bedingung: Zyklus Leck zum Saugrohr" UBYTE B_TRUE 1 100 0 1 BIT_MASK 0x20 FORMAT "%13.11" ECU_ADDRESS 0x800506 /end MEASUREMENT
/begin MEASUREMENT B_zwkraa "Bedingung Z¸ndwinkel der KR wird ausgegeben" UBYTE B_TRUE 1 100 0 1 BIT_MASK 0x1 FORMAT "%13.11" ECU_ADDRESS 0x7FA839 /end MEASUREMENT
/begin MEASUREMENT B_zwkrum "Flag: schnelle Fr¸hverstellung" UBYTE B_TRUE 1 100 0 1 BIT_MASK 0x1 FORMAT "%13.11" ECU_ADDRESS 0x7FA83A /end MEASUREMENT
/begin MEASUREMENT ctr_phada "Z‰hler Adaptionen Nockenwellenposition zu Kurbelwellenposition Auslass-NW" UBYTE dez 1 100 0 255 FORMAT "%5.1" ECU_ADDRESS 0x8005B1 /end MEASUREMENT
/begin MEASUREMENT ctr_phade "Z‰hler Adaptionen Nockenwellenposition zu Kurbelwellenposition Einlass-NW" UBYTE dez 1 100 0 255 FORMAT "%5.1" ECU_ADDRESS 0x8005B2 /end MEASUREMENT
/begin MEASUREMENT CWNWSAoutbits "" UBYTE dez 1 100 0 255 FORMAT "%5.1" ECU_ADDRESS 0x8010EA /end MEASUREMENT
/begin MEASUREMENT CWNWSEoutbits "" UBYTE dez 1 100 0 255 FORMAT "%5.1" ECU_ADDRESS 0x8010EB /end MEASUREMENT
/begin MEASUREMENT CWNWSGoutbits "" UBYTE dez 1 100 0 255 FORMAT "%5.1" ECU_ADDRESS 0x8010EC /end MEASUREMENT
/begin MEASUREMENT dfrmfof2_w "gefilterte Abweichung Mittelwert des Lambdaregl. von 1.0 f¸r Offsetbest. in DSLS" SWORD fak_sw_b1 1 100 -1 0.999969 FORMAT "%8.6" ECU_ADDRESS 0x800792 /end MEASUREMENT
/begin MEASUREMENT dfrmfof_w "gefilterte Abweichung Mittelwert des Lambdaregl. von 1.0 f¸r Offsetbest. in DSLS" SWORD fak_sw_b1 1 100 -1 0.999969 FORMAT "%8.6" ECU_ADDRESS 0x800794 /end MEASUREMENT
/begin MEASUREMENT dfrmof2_w "tempor‰rer frm-Offsetwert, gefiltert (Bank 2)" SWORD fak_sw_b1 1 100 -1 0.999969 FORMAT "%8.6" ECU_ADDRESS 0x800796 /end MEASUREMENT
/begin MEASUREMENT dfrmofn_w "zul‰ssige negative Abweichung von frm von 1.0 f¸r Offsetbestimmung in %DSLS" SWORD fak_sw_b1 1 100 -1 0.999969 FORMAT "%8.6" ECU_ADDRESS 0x800798 /end MEASUREMENT
/begin MEASUREMENT dfrmofp_w "zul‰ssige positive Abweichung von frm von 1.0 f¸r Offsetbestimmung in %DSLS" SWORD fak_sw_b1 1 100 -1 0.999969 FORMAT "%8.6" ECU_ADDRESS 0x80079A /end MEASUREMENT
/begin MEASUREMENT dfrmof_w "Abweichung Mittelwert des Lambdareglers von 1.0 f¸r Offsetbestimmung in DSLS" SWORD fak_sw_b1 1 100 -1 0.999969 FORMAT "%8.6" ECU_ADDRESS 0x80079C /end MEASUREMENT
/begin MEASUREMENT dfuelsan_w "Delta F¸llungssensor zu Alpha/n-System" SWORD fak_sw_b1 1 100 -1 0.999969 FORMAT "%8.6" ECU_ADDRESS 0x8012D0 /end MEASUREMENT
/begin MEASUREMENT dkpstg_w "Steigung DK-Poti (% DK / V)" UWORD rel_uw_b40 1 100 0 39.9994 FORMAT "%8.5" ECU_ADDRESS 0x801434 /end MEASUREMENT
/begin MEASUREMENT dlrmxt "timer f¸r DLR im UMA in der Begrenzung" UBYTE t50msxs_q0p05 1 100 0 12.75 FORMAT "%5.2" ECU_ADDRESS 0x8010C6 /end MEASUREMENT
/begin MEASUREMENT dmrfabn_w "Aktuelle gewichtete Leistung um Schwelle MRFABNTE verschoben" SWORD rel_sw_b100 1 100 -100 99.9969 FORMAT "%8.4" ECU_ADDRESS 0x800BC0 /end MEASUREMENT
/begin MEASUREMENT dnsa "Zeitabh‰ngige Schubhysterese" UBYTE nmot_ub_q40 1 100 0 10200 FORMAT "%5.0" ECU_ADDRESS 0x801259 /end MEASUREMENT
/begin MEASUREMENT dpskrmx_w "max. Wert dpsfg_w  oder dpsmp_w" SWORD p_sw_q0p039 1 100 -1280 1279.96 FORMAT "%8.3" ECU_ADDRESS 0x801ADE /end MEASUREMENT
/begin MEASUREMENT dpslmdsf_w "Differenz modellierter zu gemessenem Saugrohrdruck(gefiltert) mit Offsetadaption" UWORD p_uw_q0p039 1 100 0 2559.96 FORMAT "%8.3" ECU_ADDRESS 0x800508 /end MEASUREMENT
/begin MEASUREMENT dpslmds_w "Differenz modellierter zu gemessenem Saugrohrdruck" SWORD p_sw_q0p039 1 100 -1280 1279.96 FORMAT "%8.3" ECU_ADDRESS 0x80050A /end MEASUREMENT
/begin MEASUREMENT dtikattum "Differenz Abgastemperatur im Katalysator zu Umgebungstemp. bei Beginn Nachlauf" UBYTE temp_q5 1 100 0 1275 FORMAT "%5.0" ECU_ADDRESS 0x80089F /end MEASUREMENT
/begin MEASUREMENT dub "Batteriespannungsabweichung f¸r Batteriespannungsregelung" SBYTE spg_ubatt 1 100 -12.0576 11.9634 FORMAT "%5.2" ECU_ADDRESS 0x800C98 /end MEASUREMENT
/begin MEASUREMENT dveadchst "DV-E-Adaption: Status Pr¸fbedingungen" UBYTE dez 1 100 0 255 FORMAT "%5.1" ECU_ADDRESS 0x8010C7 /end MEASUREMENT
/begin MEASUREMENT dyespfof_w "aktueller Wert Offset f¸r Lastdynamikerkennungsschwelle" SWORD p_sw_q0p039 1 100 -1280 1279.96 FORMAT "%8.3" ECU_ADDRESS 0x801AE0 /end MEASUREMENT
/begin MEASUREMENT dyespfv_w "aktueller Wert Lastdynamikerkennungsschwelle" SWORD p_sw_q0p039 1 100 -1280 1279.96 FORMAT "%8.3" ECU_ADDRESS 0x801AE2 /end MEASUREMENT
/begin MEASUREMENT erdrcamctr "Anzahl der Fehlermeldungen die vom Hardware Treiber der NW gemeldet wurden" UBYTE dez 1 100 0 255 FORMAT "%5.1" ECU_ADDRESS 0x80100F /end MEASUREMENT
/begin MEASUREMENT erdrrevctr "Anzahl der Fehlermeldungen die vom Hardware Treiber der KW gemeldet wurden" UBYTE dez 1 100 0 255 FORMAT "%5.1" ECU_ADDRESS 0x801010 /end MEASUREMENT
/begin MEASUREMENT erdrsynctr "Anzahl der Fehlermeldungen die vom HWT f¸r Synchronisation gemeldet werden" UBYTE dez 1 100 0 255 FORMAT "%5.1" ECU_ADDRESS 0x801011 /end MEASUREMENT
/begin MEASUREMENT esst_srl04dyub "" ULONG dez 1 100 0 4.29497e+009 FORMAT "%13.2" ECU_ADDRESS 0x801DD4 /end MEASUREMENT
/begin MEASUREMENT esst_sts08khuw "" ULONG dez 1 100 0 4.29497e+009 FORMAT "%13.2" ECU_ADDRESS 0x801D70 /end MEASUREMENT
/begin MEASUREMENT esst_swr08khuw "" ULONG dez 1 100 0 4.29497e+009 FORMAT "%13.2" ECU_ADDRESS 0x801D74 /end MEASUREMENT
/begin MEASUREMENT E_ks1h "Hilfserrorflag KS1" UBYTE B_TRUE 1 100 0 1 BIT_MASK 0x1 FORMAT "%13.11" ECU_ADDRESS 0x7FA83B /end MEASUREMENT
/begin MEASUREMENT E_ks2h "Hilfserrorflag KS2" UBYTE B_TRUE 1 100 0 1 BIT_MASK 0x1 FORMAT "%13.11" ECU_ADDRESS 0x7FA83C /end MEASUREMENT
/begin MEASUREMENT fkez "Faktor Korrektur Einspritzzeit zylinderindividuell" UBYTE fak_ub_b2 1 100 0 1.99219 FORMAT "%5.3" ARRAY_SIZE 8 ECU_ADDRESS 0x800F38 /end MEASUREMENT
/begin MEASUREMENT fkfupsrl_w "Multiplikative Korrektur von fupsrl" UWORD fak_uw_b2 1 100 0 1.99997 FORMAT "%8.6" ECU_ADDRESS 0x7FC30A /end MEASUREMENT
/begin MEASUREMENT fkhab "Faktor Katheizen zur Abregelung" UBYTE fak_ub_b1 1 100 0 0.996094 ECU_ADDRESS 0x8008A0 /end MEASUREMENT
/begin MEASUREMENT fkhabold "Faktor Katheizen zur Abregelung (alter Wert)" UBYTE fak_ub_b1 1 100 0 0.996094 ECU_ADDRESS 0x8008A1 /end MEASUREMENT
/begin MEASUREMENT fkmsdkg_w "Korrekturfaktor Massenstrom Nebenf¸llungssignal(auch bei Fehler HFM o. DK aktiv)" UWORD fak_uw_b4 1 100 0 3.99994 FORMAT "%8.6" ECU_ADDRESS 0x8012D2 /end MEASUREMENT
/begin MEASUREMENT fkmsdksg_w "Korrekturfaktor schneller Massenstromabgleich (auch bei HFM o. DK Fehler aktiv)" UWORD fak_uw_b4 1 100 0 3.99994 FORMAT "%8.6" ECU_ADDRESS 0x8012D4 /end MEASUREMENT
/begin MEASUREMENT fkmsdks_w "Korrekturfaktor schneller Massenstromabgleich" UWORD fak_uw_b4 1 100 0 3.99994 FORMAT "%8.6" ECU_ADDRESS 0x8012D6 /end MEASUREMENT
/begin MEASUREMENT fkmsdk_w "Korrekturfaktor Massenstrom Nebenf¸llungssignal" UWORD fak_uw_b4 1 100 0 3.99994 FORMAT "%8.6" ECU_ADDRESS 0x8012D8 /end MEASUREMENT
/begin MEASUREMENT fkpvdkg_w "Korrekturfaktor langsamer Massenstromabgleich (auch im Fehlerfall in Betrieb)" UWORD fak_uw_b4 1 100 0 3.99994 FORMAT "%8.6" ECU_ADDRESS 0x7FC310 /end MEASUREMENT
/begin MEASUREMENT fkpvdk_w "Korrekturfaktor langsamer Massenstromabgleich" UWORD fak_uw_b4 1 100 0 3.99994 FORMAT "%8.6" ECU_ADDRESS 0x7FC312 /end MEASUREMENT
/begin MEASUREMENT flakh "Faktor Lambda-Steuerung bei Katheizen" UBYTE fak_ub_b1 1 100 0 0.996094 ECU_ADDRESS 0x8008A2 /end MEASUREMENT
/begin MEASUREMENT flamagr "Faktor Lambda‰nderung durch Abgasr¸ckf¸hrung" UBYTE fak_ub_b2 1 100 0 1.99219 FORMAT "%5.3" ECU_ADDRESS 0x80117E /end MEASUREMENT
/begin MEASUREMENT flamagr2 "Faktor Lambda‰nderung durch Abgasr¸ckf¸hrung, Bank2" UBYTE fak_ub_b2 1 100 0 1.99219 FORMAT "%5.3" ECU_ADDRESS 0x80117F /end MEASUREMENT
/begin MEASUREMENT flamsls "Faktor Lambda‰nderung durch Sekund‰rluft" UBYTE fak_ub_b2 1 100 0 1.99219 FORMAT "%5.3" ECU_ADDRESS 0x801180 /end MEASUREMENT
/begin MEASUREMENT flamsls2 "Faktor Lambda‰nderung durch Sekund‰rluft, Bank2" UBYTE fak_ub_b2 1 100 0 1.99219 FORMAT "%5.3" ECU_ADDRESS 0x801181 /end MEASUREMENT
/begin MEASUREMENT flamslsi "Faktor Lambda‰nderung durch Sekund‰rluft (intern)" UBYTE fak_ub_b2 1 100 0 1.99219 FORMAT "%5.3" ECU_ADDRESS 0x801182 /end MEASUREMENT
/begin MEASUREMENT fnwkha "Wichtungsfaktor f¸r Nockenwellensollwinkel bei Katheizen (Auslaﬂ)" UBYTE fak_ub_b2 1 100 0 1.99219 FORMAT "%5.3" ECU_ADDRESS 0x8008A3 /end MEASUREMENT
/begin MEASUREMENT fnwkhe "Wichtungsfaktor f¸r Nockenwellensollwinkel bei Katheizen (Einlaﬂ)" UBYTE fak_ub_b2 1 100 0 1.99219 FORMAT "%5.3" ECU_ADDRESS 0x8008A4 /end MEASUREMENT
/begin MEASUREMENT fprstep_c "Schrittz‰hler DK-R¸ckstellfeder-Pr¸fung" UBYTE dez 1 100 0 255 FORMAT "%5.1" ECU_ADDRESS 0x8010C8 /end MEASUREMENT
/begin MEASUREMENT fprtim_c "Zeitz‰hler DK-R¸ckstellfeder-Pr¸fung" UBYTE t10msxs_ub_b2p55 1 100 0 2.55 FORMAT "%5.3" ECU_ADDRESS 0x8010C9 /end MEASUREMENT
/begin MEASUREMENT fwsanftmst "Faktor zur Wichtung der W‰rmestromanforderung in Abh‰ngigkeit von tmst" UBYTE fak_ub_b1 1 100 0 0.996094 ECU_ADDRESS 0x8008A5 /end MEASUREMENT
/begin MEASUREMENT fwwsanfll "Wichtungsfaktor f¸r ‹bergang d. W‰rmestromanforderung LL <--> Last" UBYTE fak_ub_b1 1 100 0 0.996094 ECU_ADDRESS 0x8008A6 /end MEASUREMENT
/begin MEASUREMENT kmstmil_w "Zur¸ckgelegte Fahrstrecke mit MIL on" UWORD s_q1_km 1 100 0 65535 FORMAT "%8.2" ECU_ADDRESS 0x7FC374 /end MEASUREMENT
/begin MEASUREMENT kmst_w "Zur¸ckgelegte Fahrstrecke seit Powerfail" UWORD s_q6_km 1 100 0 393210 FORMAT "%8.1" ECU_ADDRESS 0x7FC376 /end MEASUREMENT
/begin MEASUREMENT kral1_w "aktueller Wert Last-Adaptionsbereich 1" UWORD rel_uw_q0p0234 1 100 0 1535.98 FORMAT "%8.3" ECU_ADDRESS 0x801AE4 /end MEASUREMENT
/begin MEASUREMENT kral2_w "aktueller Wert Last-Adaptionsbereich 2" UWORD rel_uw_q0p0234 1 100 0 1535.98 FORMAT "%8.3" ECU_ADDRESS 0x801AE6 /end MEASUREMENT
/begin MEASUREMENT kral3_w "aktueller Wert Last-Adaptionsbereich 3" UWORD rel_uw_q0p0234 1 100 0 1535.98 FORMAT "%8.3" ECU_ADDRESS 0x801AE8 /end MEASUREMENT
/begin MEASUREMENT kvb_w "verbrauchter Kraftstoff" UWORD vol_q3p90625Em3_l 1 100 0 255.996 FORMAT "%8.4" ECU_ADDRESS 0x800B6A /end MEASUREMENT
/begin MEASUREMENT lalsuvj2_w "Lambda-Istwert Bank2" UWORD fak_uw_b2 1 100 0 1.99997 FORMAT "%8.6" ECU_ADDRESS 0x8016DA /end MEASUREMENT
/begin MEASUREMENT lalsuvj_w "Lambda-Istwert" UWORD fak_uw_b2 1 100 0 1.99997 FORMAT "%8.6" ECU_ADDRESS 0x8016DC /end MEASUREMENT
/begin MEASUREMENT lamsonb2_w "Basis-Lambda Istwert Bank2" UWORD fak_uw_b16 1 100 0 15.9998 FORMAT "%8.5" ECU_ADDRESS 0x8016DE /end MEASUREMENT
/begin MEASUREMENT lamsonb_w "Basis-Lambda Istwert" UWORD fak_uw_b16 1 100 0 15.9998 FORMAT "%8.5" ECU_ADDRESS 0x8016E0 /end MEASUREMENT
/begin MEASUREMENT lamsoni2_w "Lambda-Istwert Bank2" UWORD fak_uw_b16 1 100 0 15.9998 FORMAT "%8.5" ECU_ADDRESS 0x8016E2 /end MEASUREMENT
/begin MEASUREMENT lamsoni_w "Lambda-Istwert" UWORD fak_uw_b16 1 100 0 15.9998 FORMAT "%8.5" ECU_ADDRESS 0x8016E4 /end MEASUREMENT
/begin MEASUREMENT lbklrnctr "Lernschrittz‰hler Ladungsbewegungsklappe" UBYTE dez 1 100 0 255 FORMAT "%5.1" ECU_ADDRESS 0x8010BE /end MEASUREMENT
/begin MEASUREMENT lbkpstg_w "LBK Steigung Postion in % gegen Potipannung" UWORD rel_q0p002441 1 100 0 159.998 FORMAT "%8.4" ECU_ADDRESS 0x801420 /end MEASUREMENT
/begin MEASUREMENT lbkumwb "Statusbyte f¸r Umweltbedingungen LBK-Lernen" UBYTE dez 1 100 0 255 FORMAT "%5.1" ECU_ADDRESS 0x8010BF /end MEASUREMENT
/begin MEASUREMENT lbz "Ladebilanz der Batterie" UBYTE rel_ub_b99p6 1 100 0 99.6094 FORMAT "%5.2" ECU_ADDRESS 0x800C99 /end MEASUREMENT
/begin MEASUREMENT lkr_w "aktueller Wert der Lastschwelle Klopfregelung" UWORD rel_uw_q0p0234 1 100 0 1535.98 FORMAT "%8.3" ECU_ADDRESS 0x801AEA /end MEASUREMENT
/begin MEASUREMENT lrnstat "Statusbyte DV-E-Adaption f¸r Testerkommunikation" UBYTE dez 1 100 0 255 FORMAT "%5.1" ECU_ADDRESS 0x8010CA /end MEASUREMENT
/begin MEASUREMENT lrnstep_c "Z‰hler f¸r Lerndauer eines Lernsteps" UBYTE dez 1 100 0 255 FORMAT "%5.1" ECU_ADDRESS 0x8010CB /end MEASUREMENT
/begin MEASUREMENT lrntim_c "Zeitz‰hler f¸r Wartezeit in den Lernschritten" UBYTE t20msxs_ub_b5p1 1 100 0 5.1 FORMAT "%5.3" ECU_ADDRESS 0x8010CC /end MEASUREMENT
/begin MEASUREMENT lrnvb_c "Lernverbotsz‰hler (Wartezeit)" UWORD t20msxs_uw_q0p02 1 100 0 1310.7 FORMAT "%8.3" ECU_ADDRESS 0x801436 /end MEASUREMENT
/begin MEASUREMENT mabghks2_w "Abgasmassenstrom [kg/s] im Rohr vor Haupt Kat (Word), Bank 2" UWORD m_q2p777Em5 1 100 0 1.82042 FORMAT "%8.6" ECU_ADDRESS 0x800800 /end MEASUREMENT
/begin MEASUREMENT mabghks_w "Abgasmassenstrom [kg/s] im Rohr vor Haupt Kat (Word), Bank 1" UWORD m_q2p777Em5 1 100 0 1.82042 FORMAT "%8.6" ECU_ADDRESS 0x800802 /end MEASUREMENT
/begin MEASUREMENT mabikrs2_w "Massenstrom Abgas im Kr¸mmer in kg/s, Bank2" UWORD m_q2p777Em5 1 100 0 1.82042 FORMAT "%8.6" ECU_ADDRESS 0x800804 /end MEASUREMENT
/begin MEASUREMENT mabikrs_w "Massenstrom Abgas im Kr¸mmer in kg/s" UWORD m_q2p777Em5 1 100 0 1.82042 FORMAT "%8.6" ECU_ADDRESS 0x800806 /end MEASUREMENT
/begin MEASUREMENT mabnavs2_w "Abgasmassenstr. [kg/s] h. Auslassventilen korrigiert um Kraftstoffanteil, Bank 2" UWORD m_q2p777Em5 1 100 0 1.82042 FORMAT "%8.6" ECU_ADDRESS 0x800808 /end MEASUREMENT
/begin MEASUREMENT mabnavs_w "Abgasmassenstr. [kg/s] h. Auslassventilen korr. um Kraftstoffanteil, Bank 1" UWORD m_q2p777Em5 1 100 0 1.82042 FORMAT "%8.6" ECU_ADDRESS 0x80080A /end MEASUREMENT
/begin MEASUREMENT mabnhks2_w "Massenstrom Abgas nach Hauptkatalysator in kg/s, Bank 2" UWORD m_q2p777Em5 1 100 0 1.82042 FORMAT "%8.6" ECU_ADDRESS 0x80080C /end MEASUREMENT
/begin MEASUREMENT mabnhks_w "Massenstrom Abgas nach Hauptkatalysator in kg/s" UWORD m_q2p777Em5 1 100 0 1.82042 FORMAT "%8.6" ECU_ADDRESS 0x80080E /end MEASUREMENT
/begin MEASUREMENT mabnvks2_w "Massenstrom Abgas nach Vorkatalysator in kg/s, Bank 2" UWORD m_q2p777Em5 1 100 0 1.82042 FORMAT "%8.6" ECU_ADDRESS 0x800810 /end MEASUREMENT
/begin MEASUREMENT mabnvks_w "Massenstrom Abgas nach Vorkatalysator in kg/s" UWORD m_q2p777Em5 1 100 0 1.82042 FORMAT "%8.6" ECU_ADDRESS 0x800812 /end MEASUREMENT
/begin MEASUREMENT mabvhks2_w "Massenstrom Abgas vor Hauptkat in kg/s, Bank2" UWORD m_q2p777Em5 1 100 0 1.82042 FORMAT "%8.6" ECU_ADDRESS 0x800814 /end MEASUREMENT
/begin MEASUREMENT mabvhks_w "Massenstrom Abgas vor Hauptkat in kg/s" UWORD m_q2p777Em5 1 100 0 1.82042 FORMAT "%8.6" ECU_ADDRESS 0x800816 /end MEASUREMENT
/begin MEASUREMENT mabvvks2_w "Massenstrom Abdas vor Vorkat in kg/s (Bank2)" UWORD m_q2p777Em5 1 100 0 1.82042 FORMAT "%8.6" ECU_ADDRESS 0x800818 /end MEASUREMENT
/begin MEASUREMENT mabvvks_w "Massenstrom Abgas vor Frontkat in kg/s" UWORD m_q2p777Em5 1 100 0 1.82042 FORMAT "%8.6" ECU_ADDRESS 0x80081A /end MEASUREMENT
/begin MEASUREMENT mlbb2_w "Luftmassenfluﬂ gefiltert (Word), Bank2 bezogen" UWORD m_uw_b6553p5 1 100 0 6553.5 FORMAT "%8.3" ECU_ADDRESS 0x80081C /end MEASUREMENT
/begin MEASUREMENT mlbb_w "Luftmassenfluﬂ gefiltert (Word), Bank1 bezogen" UWORD m_uw_b6553p5 1 100 0 6553.5 FORMAT "%8.3" ECU_ADDRESS 0x80081E /end MEASUREMENT
/begin MEASUREMENT mrfabn "aktuelle gewichtete Leistung (f¸r Dauer-Hochlasterkennung)" UBYTE rel_ub_b100 1 100 0 99.6094 FORMAT "%5.2" ECU_ADDRESS 0x800BBE /end MEASUREMENT
/begin MEASUREMENT mrfabnf "Tiefpaﬂ-gefilterte gewichtete Leistung - DauerHochlasterkenung" UBYTE rel_ub_b100 1 100 0 99.6094 FORMAT "%5.2" ECU_ADDRESS 0x800BBF /end MEASUREMENT
/begin MEASUREMENT msabg "Abgasmassenfluﬂ gefiltert, Bank 1" UBYTE m_ub_b1020 1 100 0 1020 FORMAT "%5.0" ECU_ADDRESS 0x800850 /end MEASUREMENT
/begin MEASUREMENT msabg2 "Abgasmassenfluﬂ gefiltert, Bank 2" UBYTE m_ub_b1020 1 100 0 1020 FORMAT "%5.0" ECU_ADDRESS 0x800851 /end MEASUREMENT
/begin MEASUREMENT msabg2_w "Abgasmassenfluﬂ gefiltert (Word), Bank 2" UWORD m_uw_b6553p5 1 100 0 6553.5 FORMAT "%8.3" ECU_ADDRESS 0x800820 /end MEASUREMENT
/begin MEASUREMENT msabghk2_w "Abgasmassenstrom im Rohr vor Haupt Kat (Word), Bank 2" UWORD m_uw_b6553p5 1 100 0 6553.5 FORMAT "%8.3" ECU_ADDRESS 0x800822 /end MEASUREMENT
/begin MEASUREMENT msabghk_w "Abgasmassenstrom im Rohr vor Haupt Kat (Word), Bank 1" UWORD m_uw_b6553p5 1 100 0 6553.5 FORMAT "%8.3" ECU_ADDRESS 0x800824 /end MEASUREMENT
/begin MEASUREMENT msabgs2_w "Abgasmassenfluﬂ gefiltert in kg/s, Bank2" UWORD m_q2p777Em5 1 100 0 1.82042 FORMAT "%8.6" ECU_ADDRESS 0x800826 /end MEASUREMENT
/begin MEASUREMENT msabgs_w "Abgasmassenfluﬂ gefiltert in kg/s" UWORD m_q2p777Em5 1 100 0 1.82042 FORMAT "%8.6" ECU_ADDRESS 0x800828 /end MEASUREMENT
/begin MEASUREMENT msabg_w "Abgasmassenstrom gefiltert (Word), Bank 1" UWORD m_uw_b6553p5 1 100 0 6553.5 FORMAT "%8.3" ECU_ADDRESS 0x80082A /end MEASUREMENT
/begin MEASUREMENT msabikr2_w "Massenstrom Abgas im Kr¸mmer Bank2" UWORD m_uw_b6553p5 1 100 0 6553.5 FORMAT "%8.3" ECU_ADDRESS 0x80082C /end MEASUREMENT
/begin MEASUREMENT msabikr_w "Massenstrom Abgas im Kr¸mmer" UWORD m_uw_b6553p5 1 100 0 6553.5 FORMAT "%8.3" ECU_ADDRESS 0x80082E /end MEASUREMENT
/begin MEASUREMENT msabnav2_w "Abgasmassenstrom hinter Auslassventilen korrigiert um Kraftstoffanteil, Bank 2" UWORD m_uw_b6553p5 1 100 0 6553.5 FORMAT "%8.3" ECU_ADDRESS 0x800830 /end MEASUREMENT
/begin MEASUREMENT msabnav_w "Abgasmassenstrom hinter Auslassventilen korrigiert um Kraftstoffanteil, Bank 1" UWORD m_uw_b6553p5 1 100 0 6553.5 FORMAT "%8.3" ECU_ADDRESS 0x800832 /end MEASUREMENT
/begin MEASUREMENT msabnhk2_w "Abgasmassenfluﬂ 2" UWORD m_uw_b6553p5 1 100 0 6553.5 FORMAT "%8.3" ECU_ADDRESS 0x800834 /end MEASUREMENT
/begin MEASUREMENT msabnhk_w "Abgasmassenfluﬂ" UWORD m_uw_b6553p5 1 100 0 6553.5 FORMAT "%8.3" ECU_ADDRESS 0x800836 /end MEASUREMENT
/begin MEASUREMENT msabnvk2_w "Massenstrom Abgas nach Vorkatalysator, Bank 2" UWORD m_uw_b6553p5 1 100 0 6553.5 FORMAT "%8.3" ECU_ADDRESS 0x800838 /end MEASUREMENT
/begin MEASUREMENT msabnvk_w "Massenstrom Abgas nach Vorkatalysator" UWORD m_uw_b6553p5 1 100 0 6553.5 FORMAT "%8.3" ECU_ADDRESS 0x80083A /end MEASUREMENT
/begin MEASUREMENT msabvhk2_w "Massenstrom Abgas vor Hauptkat Bank 2" UWORD m_uw_b6553p5 1 100 0 6553.5 FORMAT "%8.3" ECU_ADDRESS 0x80083C /end MEASUREMENT
/begin MEASUREMENT msabvhk_w "Massenstrom Abgas vor Hauptkat" UWORD m_uw_b6553p5 1 100 0 6553.5 FORMAT "%8.3" ECU_ADDRESS 0x80083E /end MEASUREMENT
/begin MEASUREMENT msabvvk2_w "Massenstrom Abgas vor Vorkat (Bank2)" UWORD m_uw_b6553p5 1 100 0 6553.5 FORMAT "%8.3" ECU_ADDRESS 0x800840 /end MEASUREMENT
/begin MEASUREMENT msabvvk_w "Massenstrom Abgas vor Frontkat" UWORD m_uw_b6553p5 1 100 0 6553.5 FORMAT "%8.3" ECU_ADDRESS 0x800842 /end MEASUREMENT
/begin MEASUREMENT msaovvk2_w "Massenstrom Abgas ohne Kraftstoffanteil vor Vorkat, Bank 2" UWORD m_uw_b6553p5 1 100 0 6553.5 FORMAT "%8.3" ECU_ADDRESS 0x800844 /end MEASUREMENT
/begin MEASUREMENT msaovvk_w "Massenstrom Abgas ohne Kraftstoffanteil vor Vorkat" UWORD m_uw_b6553p5 1 100 0 6553.5 FORMAT "%8.3" ECU_ADDRESS 0x800846 /end MEASUREMENT
/begin MEASUREMENT msfbvf2_w "Massenstrom der durch die AV in de Abgastrakt w‰hrend Phase1 flieﬂt gefiltert" UWORD m_uw_b6553p5 1 100 0 6553.5 FORMAT "%8.3" ECU_ADDRESS 0x80079E /end MEASUREMENT
/begin MEASUREMENT msfbvf_w "Massenstrom der durch die AV in de Abgastrakt w‰hrend Phase1 flieﬂt gefiltert" UWORD m_uw_b6553p5 1 100 0 6553.5 FORMAT "%8.3" ECU_ADDRESS 0x8007A0 /end MEASUREMENT
/begin MEASUREMENT msfbvvf2_w "Massenstrom der durch die AV in de Abgastrakt w‰hrend Phase2 flieﬂt gefiltert" UWORD m_uw_b6553p5 1 100 0 6553.5 FORMAT "%8.3" ECU_ADDRESS 0x8007A2 /end MEASUREMENT
/begin MEASUREMENT msfbvvf_w "Massenstrom der durch die AV in de Abgastrakt w‰hrend Phase2 flieﬂt gefiltert" UWORD m_uw_b6553p5 1 100 0 6553.5 FORMAT "%8.3" ECU_ADDRESS 0x8007A4 /end MEASUREMENT
/begin MEASUREMENT mskgb2_w "Kraftstoff Massenstrom, Bank 2" UWORD m_uw_b6553p5 1 100 0 6553.5 FORMAT "%8.3" ECU_ADDRESS 0x800848 /end MEASUREMENT
/begin MEASUREMENT mskgb_w "Kraftstoff Massenstrom, Bank 1" UWORD m_uw_b6553p5 1 100 0 6553.5 FORMAT "%8.3" ECU_ADDRESS 0x80084A /end MEASUREMENT
/begin MEASUREMENT msllamf2_w "gefilterte Sekund‰rluftmasse aus Lambdasignal r¸ckgerechnet Bank2" UWORD m_uw_b6553p5 1 100 0 6553.5 FORMAT "%8.3" ECU_ADDRESS 0x8007A6 /end MEASUREMENT
/begin MEASUREMENT msllamf_w "gefilterte Sekund‰rluftmasse aus Lambdasignal r¸ckgerechnet" UWORD m_uw_b6553p5 1 100 0 6553.5 FORMAT "%8.3" ECU_ADDRESS 0x8007A8 /end MEASUREMENT
/begin MEASUREMENT msllavf2_w "tempor‰re Sekund‰rluftmasse Ventil (Bank2), gefiltert (Word)" UWORD m_uw_b6553p5 1 100 0 6553.5 FORMAT "%8.3" ECU_ADDRESS 0x8007AA /end MEASUREMENT
/begin MEASUREMENT msllavf_w "tempor‰re Sekund‰rluftmasse Ventil, gefiltert (Word)" UWORD m_uw_b6553p5 1 100 0 6553.5 FORMAT "%8.3" ECU_ADDRESS 0x8007AC /end MEASUREMENT
/begin MEASUREMENT mslofs2_w "Offsetwert Sekund‰rluftmasse, Bank 2, (Word)" SWORD m_sw_b3276p8 1 100 -3276.8 3276.7 FORMAT "%8.3" ECU_ADDRESS 0x8007AE /end MEASUREMENT
/begin MEASUREMENT mslofs_w "Offsetwert Sekund‰rluftmasse, (Word)" SWORD m_sw_b3276p8 1 100 -3276.8 3276.7 FORMAT "%8.3" ECU_ADDRESS 0x8007B0 /end MEASUREMENT
/begin MEASUREMENT mslubf2_w "aus Ubat berechnete Sekund‰rluftmasse gefiltert (Word) (Bank2)" UWORD m_uw_b6553p5 1 100 0 6553.5 FORMAT "%8.3" ECU_ADDRESS 0x8007B2 /end MEASUREMENT
/begin MEASUREMENT mslubf_w "aus Ubat berechnete Sekund‰rluftmasse gefiltert (Word) (Bank1)" UWORD m_uw_b6553p5 1 100 0 6553.5 FORMAT "%8.3" ECU_ADDRESS 0x8007B4 /end MEASUREMENT
/begin MEASUREMENT mslubvf2_w "gefilterte Sekund‰rluftmassenstrom 16-Bit Wert (Theoretischer Wert) (Bank2)" UWORD m_uw_b6553p5 1 100 0 6553.5 FORMAT "%8.3" ECU_ADDRESS 0x8007B6 /end MEASUREMENT
/begin MEASUREMENT mslubvf_w "gefilterte Sekund‰rluftmassenstrom 16-Bit Wert (Theoretischer Wert) (Bank1)" UWORD m_uw_b6553p5 1 100 0 6553.5 FORMAT "%8.3" ECU_ADDRESS 0x8007B8 /end MEASUREMENT
/begin MEASUREMENT mslvofs2_w "Offsetwert Sekund‰rluftmasse w‰hrend der Ventildichtigkeitsphase , Bank2" SWORD m_sw_b3276p8 1 100 -3276.8 3276.7 FORMAT "%8.3" ECU_ADDRESS 0x8007BA /end MEASUREMENT
/begin MEASUREMENT mslvofs_w "Offsetwert Sekund‰rluftmasse w‰hrend der Ventildichtigkeitsphase , (Word)" SWORD m_sw_b3276p8 1 100 -3276.8 3276.7 FORMAT "%8.3" ECU_ADDRESS 0x8007BC /end MEASUREMENT
/begin MEASUREMENT msndko_w "normierter Leckluftmassenstrom ¸ber Drosselklappe (word)" UWORD m_uw_b6553p5 1 100 0 6553.5 FORMAT "%8.3" ECU_ADDRESS 0x7FC314 /end MEASUREMENT
/begin MEASUREMENT ngkrv_w "aktueller Wert Drehzahldynamikschwelle" SWORD nmotg_sw_q0p39 1 100 -12800.2 12799.8 FORMAT "%8.2" ECU_ADDRESS 0x801AEC /end MEASUREMENT
/begin MEASUREMENT nlp1tim "Zeitz‰hler f¸r Wartezeit 1 im NLP-Lernen" UBYTE t10msxs_ub_b2p55 1 100 0 2.55 FORMAT "%5.3" ECU_ADDRESS 0x8010CD /end MEASUREMENT
/begin MEASUREMENT nmotkf "nmot mit Hysterese zur Kennfeldadressierung" UBYTE nmot_ub_q40 1 100 0 10200 FORMAT "%5.0" ECU_ADDRESS 0x8005B3 /end MEASUREMENT
/begin MEASUREMENT nnwtoelgmn "min. Drehzahlschwelle zur Freigabe der Nockenwellenverstellung bei groﬂem Nocken" UBYTE nmot_ub_q40 1 100 0 10200 FORMAT "%5.0" ECU_ADDRESS 0x7F8C16 /end MEASUREMENT
/begin MEASUREMENT nnwtoelmn "minimale Drehzahlschwelle zur Freigabe der Nockenwellenverstellung" UBYTE nmot_ub_q40 1 100 0 10200 FORMAT "%5.0" ECU_ADDRESS 0x7F8C17 /end MEASUREMENT
/begin MEASUREMENT nsa "Drehzahl Schub" UBYTE nmot_ub_q40 1 100 0 10200 FORMAT "%5.0" ECU_ADDRESS 0x80125A /end MEASUREMENT
/begin MEASUREMENT nwe "Wiedereinsetzdrehzahl" UBYTE nmot_ub_q40 1 100 0 10200 FORMAT "%5.0" ECU_ADDRESS 0x80125B /end MEASUREMENT
/begin MEASUREMENT nwecvt "Drehzahl Wiedereinsetzen bei CVT-Getriebe" UBYTE nmot_ub_q40 1 100 0 10200 FORMAT "%5.0" ECU_ADDRESS 0x800D8A /end MEASUREMENT
/begin MEASUREMENT nwema "Drehzahl Wiedereinsetzen" UBYTE nmot_ub_q40 1 100 0 10200 FORMAT "%5.0" ECU_ADDRESS 0x80125C /end MEASUREMENT
/begin MEASUREMENT nwemn "Minimale Wiedereinsetzdrehzahl" UBYTE nmot_ub_q40 1 100 0 10200 FORMAT "%5.0" ECU_ADDRESS 0x80125D /end MEASUREMENT
/begin MEASUREMENT nwenga "Drehzahl Wiedereinsetzen" UBYTE nmot_ub_q40 1 100 0 10200 FORMAT "%5.0" ECU_ADDRESS 0x80125E /end MEASUREMENT
/begin MEASUREMENT ofdss_w "Offset-Spannung Drucksensor Saugrohr (word)" SWORD p_sw_q0p039 1 100 -1280 1279.96 FORMAT "%8.3" ECU_ADDRESS 0x7FC30E /end MEASUREMENT
/begin MEASUREMENT ofdsu_w "Offset-Spannung Umgebungsdrucksensor (word)" SWORD p_sw_q0p039 1 100 -1280 1279.96 FORMAT "%8.3" ECU_ADDRESS 0x80050E /end MEASUREMENT
/begin MEASUREMENT ofpbrint_w "Offsetkorrektur von pbrintuk_w HFM/DSS Adaption" SWORD p_sw_q0p039 1 100 -1280 1279.96 FORMAT "%8.3" ECU_ADDRESS 0x7FC30C /end MEASUREMENT
/begin MEASUREMENT pspvds_w "Quotient Saugrohrdruck/Druck vor DK" UWORD fak_uw_b2 1 100 0 1.99997 FORMAT "%8.6" ECU_ADDRESS 0x8012DA /end MEASUREMENT
/begin MEASUREMENT redist "Ist-Reduzierstufe" UBYTE dez 1 100 0 255 FORMAT "%5.1" ECU_ADDRESS 0x8011E3 /end MEASUREMENT
/begin MEASUREMENT redistb1 "Ist-Reduzierstufe Bank 1" UBYTE dez 1 100 0 255 FORMAT "%5.1" ECU_ADDRESS 0x8011E4 /end MEASUREMENT
/begin MEASUREMENT redistb2 "Ist-Reduzierstufe Bank 2" UBYTE dez 1 100 0 255 FORMAT "%5.1" ECU_ADDRESS 0x8011E5 /end MEASUREMENT
/begin MEASUREMENT res5vCtr_u16 "" UWORD dez 1 100 0 65535 FORMAT "%8.2" ECU_ADDRESS 0x7FC824 /end MEASUREMENT
/begin MEASUREMENT res5vStart "Status des Startes nach 5V-Reset" ULONG dez 1 100 0 4.29497e+009 FORMAT "%13.2" ECU_ADDRESS 0x7FC828 /end MEASUREMENT
/begin MEASUREMENT res5vstate "Status 5V-Reset" ULONG dez 1 100 0 4.29497e+009 FORMAT "%13.2" ECU_ADDRESS 0x7FC82C /end MEASUREMENT
/begin MEASUREMENT rlnwkf "rlnw mit Hysterese f¸r Kennfeldadressierung" UBYTE rel_ub_q0p75 1 100 0 191.25 FORMAT "%5.1" ECU_ADDRESS 0x8005B4 /end MEASUREMENT
/begin MEASUREMENT rlnw_w "Auswahl zwischen rl und rlsnw" UWORD rel_uw_q0p0234 1 100 0 1535.98 FORMAT "%8.3" ECU_ADDRESS 0x8005AC /end MEASUREMENT
/begin MEASUREMENT rlsnw_w "Auswahl zwischen rlsol_w und rlshk zur Adressierung von KFNW" UWORD rel_uw_q0p0234 1 100 0 1535.98 FORMAT "%8.3" ECU_ADDRESS 0x8005AE /end MEASUREMENT
/begin MEASUREMENT rlzuhfs_w "relative Luftf¸llung (zuflieﬂend) mit Hauptf¸llungssensor bestimmt" UWORD rel_uw_q0p0234 1 100 0 1535.98 FORMAT "%8.3" ECU_ADDRESS 0x8012DC /end MEASUREMENT
/begin MEASUREMENT rlzunfs_w "relative Luftf¸llung (zuflieﬂend) mit Nebenf¸llungssensor bestimmt" UWORD rel_uw_q0p0234 1 100 0 1535.98 FORMAT "%8.3" ECU_ADDRESS 0x8012DE /end MEASUREMENT
/begin MEASUREMENT rmsl "relative Sekund‰rluftmasse" UBYTE fak_q0p0078 1 100 0 1.99219 FORMAT "%5.3" ECU_ADDRESS 0x8007C1 /end MEASUREMENT
/begin MEASUREMENT rmsl2 "relative Sekund‰rluftmasse, Bank 2" UBYTE fak_q0p0078 1 100 0 1.99219 FORMAT "%5.3" ECU_ADDRESS 0x8007C2 /end MEASUREMENT
/begin MEASUREMENT rmslf "relative Sekund‰rluftmasse gefiltert" UBYTE fak_q0p0078 1 100 0 1.99219 FORMAT "%5.3" ECU_ADDRESS 0x7FC70C /end MEASUREMENT
/begin MEASUREMENT rmslf2 "relative Sekund‰rluftmasse gefiltert (Bank2)" UBYTE fak_q0p0078 1 100 0 1.99219 FORMAT "%5.3" ECU_ADDRESS 0x7FC70D /end MEASUREMENT
/begin MEASUREMENT rmsloof "relative Sekund‰rluftmasse ohne Ber¸cksichtigung des Offsetwertes" UBYTE fak_q0p0078 1 100 0 1.99219 FORMAT "%5.3" ECU_ADDRESS 0x8007C3 /end MEASUREMENT
/begin MEASUREMENT rmsloof2 "relative Sekund‰rluftmasse ohne Ber¸cksichtigung des Offsetwertes, Bank2" UBYTE fak_q0p0078 1 100 0 1.99219 FORMAT "%5.3" ECU_ADDRESS 0x8007C4 /end MEASUREMENT
/begin MEASUREMENT rmslv "relative Sekund‰rluftmasse w‰hrend des Ventildichtigkeitschecks" UBYTE fak_q0p0078 1 100 0 1.99219 FORMAT "%5.3" ECU_ADDRESS 0x8007C5 /end MEASUREMENT
/begin MEASUREMENT rmslv2 "relative Sekund‰rluftmasse w‰hrend des Ventildichtigkeitschecks, Bank2" UBYTE fak_q0p0078 1 100 0 1.99219 FORMAT "%5.3" ECU_ADDRESS 0x8007C6 /end MEASUREMENT
/begin MEASUREMENT rmslvof "relative Sek.-masse ohne Ber¸cksichtigung des Offsetwertes bei Ventilcheck" UBYTE fak_q0p0078 1 100 0 1.99219 FORMAT "%5.3" ECU_ADDRESS 0x8007C7 /end MEASUREMENT
/begin MEASUREMENT rmslvof2 "relative Sek.-masse ohne Ber¸cksichtigung des Offsetwertes bei Ventilcheck" UBYTE fak_q0p0078 1 100 0 1.99219 FORMAT "%5.3" ECU_ADDRESS 0x8007C8 /end MEASUREMENT
/begin MEASUREMENT stkrax_w "Index f¸r KR-Adaptionskennfeld" UWORD dez 1 100 0 65535 FORMAT "%8.2" ECU_ADDRESS 0x801AEE /end MEASUREMENT
/begin MEASUREMENT stkrlx "Lastst¸tzstelle f¸r die KR-Adaption" UBYTE dez 1 100 0 255 FORMAT "%5.1" ECU_ADDRESS 0x800F70 /end MEASUREMENT
/begin MEASUREMENT stkrnx "Drehzahlst¸tzstelle f¸r die KR-Adaption" UBYTE dez 1 100 0 255 FORMAT "%5.1" ECU_ADDRESS 0x800F71 /end MEASUREMENT
/begin MEASUREMENT swkh_w "Sollw‰rme f¸r Katheizen bei Motorstart (16-Bit Wert)" UWORD q_q64 1 100 0 4.19424e+006 FORMAT "%8.0" ECU_ADDRESS 0x80088C /end MEASUREMENT
/begin MEASUREMENT tapbrint_w "Zeit in der pbrint-Adaption aktiv ist" UWORD t_q0p2 1 100 0 13107 FORMAT "%8.2" ECU_ADDRESS 0x80050C /end MEASUREMENT
/begin MEASUREMENT tdknach_w "Zeitz‰hler im Nachlauf bis stromlose DK in NLP einschwingt" UWORD t10msxs_uw_b655p35 1 100 0 655.35 FORMAT "%8.4" ECU_ADDRESS 0x801438 /end MEASUREMENT
/begin MEASUREMENT tephc "Phasenz‰hler Grundadaption / Tankentl¸ftung" UWORD t100msxs_uw_b6553p6 1 100 0 6553.5 FORMAT "%8.3" ECU_ADDRESS 0x800BC2 /end MEASUREMENT
/begin MEASUREMENT tikatmnl "Abgastemperatur im Katalysator aus Modell bei Beginn des Nachlaufs" UBYTE temp_ub_q5_o50 1 100 -50 1225 FORMAT "%5.0" ECU_ADDRESS 0x7FC733 /end MEASUREMENT
/begin MEASUREMENT tikatmst "Abgastemperatur im Katalysator aus Modell im Start" UBYTE temp_q5 1 100 0 1275 FORMAT "%5.0" ECU_ADDRESS 0x8008A7 /end MEASUREMENT
/begin MEASUREMENT tikatmstou "Temperatur im Katalysator bei Start aus Modell ohne Umgebungstemp:" UBYTE temp_q5 1 100 0 1275 FORMAT "%5.0" ECU_ADDRESS 0x8008A8 /end MEASUREMENT
/begin MEASUREMENT tirq1offdeb_u16 "" UWORD dez 1 100 0 65535 FORMAT "%8.2" ECU_ADDRESS 0x801C4A /end MEASUREMENT
/begin MEASUREMENT tloop_w "" UWORD t50msxs_q0p05 1 100 0 3276.75 FORMAT "%8.3" ECU_ADDRESS 0x80143A /end MEASUREMENT
/begin MEASUREMENT tmcorctr_w "Z‰hler L¸ckenkorrektur bei fehlendem Zahn" UWORD dez 1 100 0 65535 FORMAT "%8.2" ECU_ADDRESS 0x801BAE /end MEASUREMENT
/begin MEASUREMENT tmpumast "Status f¸r tempor‰re UMA-Adaption" UBYTE dez 1 100 0 255 FORMAT "%5.1" ECU_ADDRESS 0x8010CE /end MEASUREMENT
/begin MEASUREMENT tnse_w "Zeitz‰hler ab Startende (16bit)" UWORD t100msxs_uw_b6553p5 1 100 0 6553.5 FORMAT "%8.3" ECU_ADDRESS 0x800C9C /end MEASUREMENT
/begin MEASUREMENT tnst_w "Zeit nach Startende" UWORD t10msxs_uw_b655p35 1 100 0 655.35 FORMAT "%8.4" ECU_ADDRESS 0x8017C0 /end MEASUREMENT
/begin MEASUREMENT tpcorctr_w "Z‰hler L¸ckenkorrektur bei einem zus‰tzlichen Zahn" UWORD dez 1 100 0 65535 FORMAT "%8.2" ECU_ADDRESS 0x801BB0 /end MEASUREMENT
/begin MEASUREMENT ttmumad_w "" UWORD t50msxs_q0p05 1 100 0 3276.75 FORMAT "%8.3" ECU_ADDRESS 0x80143C /end MEASUREMENT
/begin MEASUREMENT tumgnl "Umgebungsluft - Temperatur bei Beginn des Nachlaufs" UBYTE temp_ub_q0p75_o48 1 100 -48 143.25 FORMAT "%5.1" ECU_ADDRESS 0x7FC734 /end MEASUREMENT
/begin MEASUREMENT tvsaa_w "Totzeit Schubabschneiden" UWORD t10msxs_uw_b655p35 1 100 0 655.35 FORMAT "%8.4" ECU_ADDRESS 0x8018B8 /end MEASUREMENT
/begin MEASUREMENT tvsakat_w "Verzˆgerungszeit Schubabschneiden bei hohen Drehzahlen und hoher KAT-Temperatur" UWORD t10msxs_uw_b655p35 1 100 0 655.35 FORMAT "%8.4" ECU_ADDRESS 0x8018BA /end MEASUREMENT
/begin MEASUREMENT tvsans "Totzeit Schubabschneiden im Nachstart" UBYTE t1sxs_ub_b255 1 100 0 255 FORMAT "%5.1" ECU_ADDRESS 0x800D8B /end MEASUREMENT
/begin MEASUREMENT ubf "gefilterte Batteriespannung f¸r Batteriespannungsregelung" UBYTE spg_ubatt 1 100 0 24.021 FORMAT "%5.2" ECU_ADDRESS 0x800C9A /end MEASUREMENT
/begin MEASUREMENT ubsol "Soll-Batteriespannung" UBYTE spg_ubatt 1 100 0 24.021 FORMAT "%5.2" ECU_ADDRESS 0x800C9B /end MEASUREMENT
/begin MEASUREMENT udknlp1 "Spannung DK-Poti 1 im NLP" UWORD spg_uw_q0p001222 1 100 0 80.0838 FORMAT "%8.5" ECU_ADDRESS 0x80143E /end MEASUREMENT
/begin MEASUREMENT udknlp1r "Dauer-RAM: Spannung DK-Poti 1 im NLP" UWORD spg_uw_q0p001222 1 100 0 80.0838 FORMAT "%8.5" ECU_ADDRESS 0x7FC31E /end MEASUREMENT
/begin MEASUREMENT udknlp2 "Spannung DK-Poti 2 im NLP" UWORD spg_uw_q0p001222 1 100 0 80.0838 FORMAT "%8.5" ECU_ADDRESS 0x801440 /end MEASUREMENT
/begin MEASUREMENT udknlp2r "Dauer-RAM: Spannung DK-Poti 2 im NLP" UWORD spg_uw_q0p001222 1 100 0 80.0838 FORMAT "%8.5" ECU_ADDRESS 0x7FC320 /end MEASUREMENT
/begin MEASUREMENT udkp1a "Spannung Drosselklappen-Poti 1 am (unteren) Anschlag" UBYTE spg_ub_b5 1 100 0 4.98047 FORMAT "%5.3" ECU_ADDRESS 0x8010CF /end MEASUREMENT
/begin MEASUREMENT udkp1aalt "temp. Spannung DK-Poti 1 am unteren DK-Anschlag" UWORD spg_uw_q0p001222 1 100 0 80.0838 FORMAT "%8.5" ECU_ADDRESS 0x801442 /end MEASUREMENT
/begin MEASUREMENT udkp1asr_w "Dauer-RAM: Spannung DK-Poti 1 am unteren DK-Anschlag, station‰rer Anteil" UWORD spg_uw_q0p001222 1 100 0 80.0838 FORMAT "%8.5" ECU_ADDRESS 0x7FC322 /end MEASUREMENT
/begin MEASUREMENT udkp1as_w "Spannung DK-Poti 1 am unteren Anschlag, station‰rer Anteil" UWORD spg_uw_q0p001222 1 100 0 80.0838 FORMAT "%8.5" ECU_ADDRESS 0x801444 /end MEASUREMENT
/begin MEASUREMENT udkp1a_w "Spannung DK-Poti 1 am unteren Anschlag" UWORD spg_uw_q0p001222 1 100 0 80.0838 FORMAT "%8.5" ECU_ADDRESS 0x801446 /end MEASUREMENT
/begin MEASUREMENT udkp1rob "realer DK-Poti-1-Wert am ob. Abgleichpkt." UWORD spg_uw_q0p00488 1 100 0 319.995 FORMAT "%8.4" ECU_ADDRESS 0x801448 /end MEASUREMENT
/begin MEASUREMENT udkp1run "realer DK-Poti-1-Wert am unt. Abgleichpkt." UWORD spg_uw_q0p00488 1 100 0 319.995 FORMAT "%8.4" ECU_ADDRESS 0x80144A /end MEASUREMENT
/begin MEASUREMENT udkp1sv "Maximalwert DK-Poti 1 f¸r Verwendung des verst‰rkten Signals" UBYTE spg_ub_b5 1 100 0 4.98047 FORMAT "%5.3" ECU_ADDRESS 0x8010D0 /end MEASUREMENT
/begin MEASUREMENT udkp1vor "Dauer-RAM: Spannungsoffset bei DK-Poti-1-Verst‰rkung" SWORD spg_sw_q0p001222 1 100 -40.0425 40.0413 FORMAT "%8.5" ECU_ADDRESS 0x7FC324 /end MEASUREMENT
/begin MEASUREMENT udkp1vou "Diagnose: 8 Bit Kopie von udkp1vo_w als Umweltgrˆﬂe" SBYTE spg_q0p00977 1 100 -1.25 1.24023 FORMAT "%5.3" ECU_ADDRESS 0x800594 /end MEASUREMENT
/begin MEASUREMENT udkp1vo_w "Spannungsoffset Verst‰rker DK-Poti 1" SWORD spg_sw_q0p001222 1 100 -40.0425 40.0413 FORMAT "%8.5" ECU_ADDRESS 0x80144C /end MEASUREMENT
/begin MEASUREMENT udkp1vrob "realer verst‰rkter DK-Poti-1-Wert am ob. Abgleichpkt." UWORD spg_uw_q0p00488 1 100 0 319.995 FORMAT "%8.4" ECU_ADDRESS 0x80144E /end MEASUREMENT
/begin MEASUREMENT udkp1vrun "realer verst‰rkter DK-Poti-1-Wert am unt. Abgleichpkt." UWORD spg_uw_q0p00488 1 100 0 319.995 FORMAT "%8.4" ECU_ADDRESS 0x801450 /end MEASUREMENT
/begin MEASUREMENT udkp1vv "Diagnose: 8 Bit Kopie von udkp1vv_w als Umweltgrˆﬂe" UBYTE spg_q0p03125 1 100 0 7.96875 FORMAT "%5.3" ECU_ADDRESS 0x800595 /end MEASUREMENT
/begin MEASUREMENT udkp1vvr "Dauer-RAM: Verst‰rkung bei DK-Poti-1-Verst‰rkung" UWORD fak_q0p0039 1 100 0 255.996 FORMAT "%8.4" ECU_ADDRESS 0x7FC326 /end MEASUREMENT
/begin MEASUREMENT udkp1vv_w "Verst‰rkung DK-Poti 1" UWORD fak_q0p0039 1 100 0 255.996 FORMAT "%8.4" ECU_ADDRESS 0x801452 /end MEASUREMENT
/begin MEASUREMENT udkp2a "Spannung Drosselklappen-Poti 2 am (unteren) Anschlag" UBYTE spg_ub_b5 1 100 0 4.98047 FORMAT "%5.3" ECU_ADDRESS 0x8010D1 /end MEASUREMENT
/begin MEASUREMENT udkp2aalt "temp. Spannung DK-Poti 2 am unteren DK-Anschlag" UWORD spg_uw_q0p001222 1 100 0 80.0838 FORMAT "%8.5" ECU_ADDRESS 0x801454 /end MEASUREMENT
/begin MEASUREMENT udkp2asr_w "Dauer-RAM: Spannung DK-Poti 2 am unteren DK-Anschlag, station‰rer Anteil" UWORD spg_uw_q0p001222 1 100 0 80.0838 FORMAT "%8.5" ECU_ADDRESS 0x7FC328 /end MEASUREMENT
/begin MEASUREMENT udkp2as_w "Spannung DK-Poti 2 am unteren Anschlag, station‰rer Anteil" UWORD spg_uw_q0p001222 1 100 0 80.0838 FORMAT "%8.5" ECU_ADDRESS 0x7FC32A /end MEASUREMENT
/begin MEASUREMENT udkp2a_w "Spannung DK-Poti 2 am unteren Anschlag" UWORD spg_uw_q0p001222 1 100 0 80.0838 FORMAT "%8.5" ECU_ADDRESS 0x801456 /end MEASUREMENT
/begin MEASUREMENT udkpat_w "tempor‰rer UEA-Offset des DK-Poti" UWORD spg_uw_q0p001222 1 100 0 80.0838 FORMAT "%8.5" ECU_ADDRESS 0x801458 /end MEASUREMENT
/begin MEASUREMENT ulbkisto_w "Spannungsoffset der LBK-Lager¸ckmeldung" UWORD spg_q0p00488 1 100 0 319.995 FORMAT "%8.4" ECU_ADDRESS 0x801422 /end MEASUREMENT
/begin MEASUREMENT ulbkpoa_w "LBK Potispannung am oberen mechanischen Anschlag w‰hrend Adapt." UWORD spg_q0p00488 1 100 0 319.995 FORMAT "%8.4" ECU_ADDRESS 0x801424 /end MEASUREMENT
/begin MEASUREMENT uzkw_w "Kurbelwellen-Umdrehungsz‰hler" UWORD dez 1 100 0 65535 FORMAT "%8.2" ECU_ADDRESS 0x801BB2 /end MEASUREMENT
/begin MEASUREMENT verhmsb2_w "durch Anz. der Zylinder bestimmter Aufteilungsfaktor der Massenstrˆme f¸r Bank 1" UWORD fak_uw_b2 1 100 0 1 FORMAT "%8.6" ECU_ADDRESS 0x80084C /end MEASUREMENT
/begin MEASUREMENT verhmsb_w "durch Anz. der Zylinder bestimmter Aufteilungsfaktor der Massenstrˆme f¸r Bank 1" UWORD fak_uw_b2 1 100 0 1 FORMAT "%8.6" ECU_ADDRESS 0x80084E /end MEASUREMENT
/begin MEASUREMENT vpvplufi_w "Verh‰ltnis Ladedruck pvdkds_w zu Druck nach Luftfilter plufi_w" UWORD fak_uw_b8 1 100 0 7.99988 FORMAT "%8.6" ECU_ADDRESS 0x800510 /end MEASUREMENT
/begin MEASUREMENT vreglmax_w "Maximal zul‰ssige Sollgeschwindigkeit f¸r FGR" UWORD vfzg_uw_b512 1 100 0 511.992 FORMAT "%8.4" ECU_ADDRESS 0x800D74 /end MEASUREMENT
/begin MEASUREMENT vreglmin_w "Minimal zul‰ssige Sollgeschwindigkeit f¸r FGR" UWORD vfzg_uw_b512 1 100 0 511.992 FORMAT "%8.4" ECU_ADDRESS 0x800D76 /end MEASUREMENT
/begin MEASUREMENT vsks_w "Volumenstrom Kraftstoff in L/s" UWORD vol_q5p96Em8_l 1 100 0 0.00390619 FORMAT "%11.9" ECU_ADDRESS 0x800B6C /end MEASUREMENT
/begin MEASUREMENT wdaoffdeb_u16 "" UWORD dez 1 100 0 65535 FORMAT "%8.2" ECU_ADDRESS 0x801C4C /end MEASUREMENT
/begin MEASUREMENT wdaondeb_u16 "" UWORD dez 1 100 0 65535 FORMAT "%8.2" ECU_ADDRESS 0x801C4E /end MEASUREMENT
/begin MEASUREMENT wda_actpat "Gelatchter Status: WDA Abschaltung aktiv" ULONG dez 1 100 0 4.29497e+009 FORMAT "%13.2" ECU_ADDRESS 0x7FC830 /end MEASUREMENT
/begin MEASUREMENT wda_ovpat "Gelatchter Status: WDA Abschaltung aufgrund ‹berspannung aktiv" ULONG dez 1 100 0 4.29497e+009 FORMAT "%13.2" ECU_ADDRESS 0x7FC834 /end MEASUREMENT
/begin MEASUREMENT wda_state "Status der WDA-Abschaltung" ULONG dez 1 100 0 4.29497e+009 FORMAT "%13.2" ECU_ADDRESS 0x801E74 /end MEASUREMENT
/begin MEASUREMENT wdkada_w "Sollwert DK-Winkel, aus DV-E Adaption- und Pr¸ffunktion" UWORD relDK_uw_b100 1 100 0 100 FORMAT "%8.4" ECU_ADDRESS 0x80145A /end MEASUREMENT
/begin MEASUREMENT wdknlp "Diagnose: 8 Bit Kopie von wdknlp_w als Umweltgrˆﬂe" UBYTE relDK_q0p3922 1 100 0 100 FORMAT "%5.1" ECU_ADDRESS 0x800596 /end MEASUREMENT
/begin MEASUREMENT wdknlpr "Diagnose: 8 Bit Kopie von wdknlpr_w als Umweltgrˆﬂe" UBYTE relDK_q0p3922 1 100 0 100 FORMAT "%5.1" ECU_ADDRESS 0x800597 /end MEASUREMENT
/begin MEASUREMENT wdknlpr_w "Dauer-RAM: Sollwert DK-Winkel in NLP-Stellung, bez. auf UMA" UWORD relDK_uw_b100 1 100 0 100 FORMAT "%8.4" ECU_ADDRESS 0x7FC32C /end MEASUREMENT
/begin MEASUREMENT wdknlp_w "DK-Winkel der Notluftposition" UWORD relDK_uw_b100 1 100 0 100 FORMAT "%8.4" ECU_ADDRESS 0x80145C /end MEASUREMENT
/begin MEASUREMENT wdkvabob "DK-Sollwert f¸r oberen Abgleichpunkt" UWORD relDK_uw_b100 1 100 0 100 FORMAT "%8.4" ECU_ADDRESS 0x80145E /end MEASUREMENT
/begin MEASUREMENT wdkvabub "DK-Sollwert f¸r unteren Abgleichpunkt" UWORD relDK_uw_b100 1 100 0 100 FORMAT "%8.4" ECU_ADDRESS 0x801460 /end MEASUREMENT
/begin MEASUREMENT wistr_w "Relativer Heizfortschritt f¸r Katalysator seit Motorstart" UWORD fak_uw_b1 1 100 0 0.999985 FORMAT "%9.7" ECU_ADDRESS 0x80088E /end MEASUREMENT
/begin MEASUREMENT wist_w "‹ber Abgas erzeugte Heizw‰rme f¸r Katalysator seit Motorstart" UWORD q_q64 1 100 0 2.09709e+006 FORMAT "%8.0" ECU_ADDRESS 0x800890 /end MEASUREMENT
/begin MEASUREMENT wkhw_w "Dauer-RAM: Heizw‰rme f¸r Katalysator aus k¸rzlichen Motorl‰ufen" UWORD q_q64 1 100 0 4.19424e+006 FORMAT "%8.0" ECU_ADDRESS 0x800892 /end MEASUREMENT
/begin MEASUREMENT wlbkada_w "LBK Sollposition w‰hrend Adaption" UWORD rel_uw_b100 1 100 0 99.9985 FORMAT "%8.5" ECU_ADDRESS 0x801426 /end MEASUREMENT
/begin MEASUREMENT wnwsakfa_w "Sollwinkel Nockenwelle aus Kennfeldern zu Beginn Phasenflankenadaption Auslaﬂ" SWORD kw_sw_q0p0078 1 100 -256 255.992 FORMAT "%8.4" ECU_ADDRESS 0x8005B6 /end MEASUREMENT
/begin MEASUREMENT wnwsakfe_w "Sollwinkel Nockenwelle aus Kennfeldern zu Beginn Phasenflankenadaption Einlaﬂ" SWORD kw_sw_q0p0078 1 100 -256 255.992 FORMAT "%8.4" ECU_ADDRESS 0x8005B8 /end MEASUREMENT
/begin MEASUREMENT wsanfkh_w "gesamter thermischer Abgasenergiestrom w‰hrend Katalysatorheizen nach Start" UWORD leist_q2 1 100 0 131070 FORMAT "%8.1" ECU_ADDRESS 0x800894 /end MEASUREMENT
/begin MEASUREMENT wsanfkw_w "gesamter thermischer Abgasenergiestrom w‰hrend Katalysatorwarmhalten" UWORD leist_q2 1 100 0 131070 FORMAT "%8.1" ECU_ADDRESS 0x800896 /end MEASUREMENT
/begin MEASUREMENT wsistges_w "gesamter tats‰chlicher Abgasenergiestrom" UWORD leist_q2 1 100 0 65534 FORMAT "%8.2" ECU_ADDRESS 0x800898 /end MEASUREMENT
/begin MEASUREMENT wswkhk_w "" UWORD q_q64 1 100 0 4.19424e+006 FORMAT "%8.0" ECU_ADDRESS 0x80089A /end MEASUREMENT
/begin MEASUREMENT zldy "Z¸ndungsz‰hler f¸r Lastdynamik" UWORD dez 1 100 0 65535 FORMAT "%8.2" ECU_ADDRESS 0x801AF0 /end MEASUREMENT
/begin MEASUREMENT zldyke "Z¸ndungsz‰hler f¸r Lastdynamik => Klopferkennung" UWORD dez 1 100 0 65535 FORMAT "%8.2" ECU_ADDRESS 0x801AF2 /end MEASUREMENT
/begin MEASUREMENT zndy "Z¸ndungsz‰hler f¸r Drehzahldynamik" UWORD dez 1 100 0 65535 FORMAT "%8.2" ECU_ADDRESS 0x801AF4 /end MEASUREMENT
/begin FUNCTION BBFEWNE "Aufbereitung der Fehlermeldungen des Hardwaretreibers von KW u. NW" /begin DEF_CHARACTERISTIC /end DEF_CHARACTERISTIC /begin REF_CHARACTERISTIC /end REF_CHARACTERISTIC /begin IN_MEASUREMENT B_bm B_nmot inisynmon zzyl /end IN_MEASUREMENT
 /begin OUT_MEASUREMENT bmlosctr_w B_fbm B_nocampos B_outofsyn erdrcamctr erdrrevctr erdrsynctr tmcorctr_w tpcorctr_w uzkw_w /end OUT_MEASUREMENT
 /begin LOC_MEASUREMENT /end LOC_MEASUREMENT
 /begin SUB_FUNCTION /end SUB_FUNCTION
/end FUNCTION
/begin FUNCTION BBFGR "Ein- und Ausschaltbedingungen Fahrgeschwindigkeitsregler"
 /begin DEF_CHARACTERISTIC BFGRO BFGRU CWBBFGR CWBFGROF DVAQUGMX DVAQUKMX DVFGREO DVFGREU DVIVZMX DVZVIMX GAFGRO GAFGRU NFGRMAX TDVIVZ TDVZVI TFGRAQU TFGRASCOF TFGRBREOF TFGRDSCOF TFGRUEOB TFGRUM TFGRUNUB VBGFGRAQ VFGRMAX VFGRMIN VREGLMAXKM VREGLMINKM /end DEF_CHARACTERISTIC
 /begin REF_CHARACTERISTIC TFGRARLG /end REF_CHARACTERISTIC
 /begin IN_MEASUREMENT bfzglfgr B_acc B_asc_reg B_asr B_asrext B_brems B_dknolu B_dkpiu B_dsc_reg B_evfzgv1 B_fgr B_fgrabz B_fgrat B_fgren B_fgrhe B_fgrhsa B_fgrkf B_fgrtbe B_fgrtse B_fgrtve B_fgrtwa B_fgr_um B_gwhs B_hdc B_kuppl B_lowra B_msrext B_pwgnotfr gangi nmot vfgrrf_w vfgr_w vziel_w /end IN_MEASUREMENT
 /begin OUT_MEASUREMENT B_fgrab B_fgrai B_fgral B_fgras B_fgrenv B_fgresv vreglmax_w vreglmin_w /end OUT_MEASUREMENT
 /begin LOC_MEASUREMENT BBFGRlokBits B_fgraext B_fgrars B_fgres /end LOC_MEASUREMENT
 /begin SUB_FUNCTION /end SUB_FUNCTION
/end FUNCTION
/begin FUNCTION BBHWONOF "Betriebsbereich SG HW Startup und abschalten" /begin DEF_CHARACTERISTIC /end DEF_CHARACTERISTIC /begin REF_CHARACTERISTIC CWPWF /end REF_CHARACTERISTIC /begin IN_MEASUREMENT /end IN_MEASUREMENT /begin OUT_MEASUREMENT B_hwpwf B_pwf B_pwfPat /end OUT_MEASUREMENT /begin LOC_MEASUREMENT /end LOC_MEASUREMENT /begin SUB_FUNCTION /end SUB_FUNCTION /end FUNCTION
/begin FUNCTION BBKHZ "Betriebsbereich motorisches Katheizen"
 /begin DEF_CHARACTERISTIC ABKKATTAB CWBBKH CWKOMRH DTKIVKM FHOKH FKHABMN FSWSTSKH FWIKATST KFKHSWS KFKHSWSLL KFWNWWKA KFWNWWKE KLFANFKH KLFLAKH KLKWWSANFV KLSWKH NMAXKW STS08KHUW SWR08KHUW TDKWANF TDTABGMK TKHMXFHO TKIVKMMN WKHRMAX WKHWMAX ZKHABB ZKKHSWS ZKKHSWSLL /end DEF_CHARACTERISTIC
 /begin REF_CHARACTERISTIC /end REF_CHARACTERISTIC
 /begin IN_MEASUREMENT anfsls B_hag B_ll B_nmot B_slp B_stend fho_w flbkhs_w mifal_w nmot nmot_w tabgm tabst_w tans tikatm tkivkm_w tmst tnse_w tumg wsistmr_w wsistsvk_w /end IN_MEASUREMENT
 /begin OUT_MEASUREMENT bbkhzAusBits1 bbkhzAusBits2 B_kh B_kha B_khan B_khaset B_khlbk B_khmrfrho B_khoab B_kwwsanf B_trkh B_trkonz fkhab flakh fnwkha fnwkhe wistr_w wsanfkh_w wsanfkw_w wsistges_w /end OUT_MEASUREMENT
 /begin LOC_MEASUREMENT bbkhzLokBits1 B_khares B_kherr B_swkh B_trkz dtikattum esst_sts08khuw esst_swr08khuw fkhabold fwsanftmst fwwsanfll swkh_w tikatmnl tikatmst tikatmstou tumgnl wist_w wkhw_w wswkhk_w /end LOC_MEASUREMENT
 /begin SUB_FUNCTION /end SUB_FUNCTION
/end FUNCTION
/begin FUNCTION BBKR "Betriebsbedingungen Klopfregelung"
 /begin DEF_CHARACTERISTIC AZKELDYN AZKRLDYN AZKRNDYN CWKRNLR CWTIPIN KFDYESPF KFDYESPFOF KRAL1N KRAL2N KRAL3N KRALH KRAN1 KRAN2 KRAN3 KRAN4 KRANH KRLNMDY LKRN NGKRWN SRL04DYUB TMDYNA TMKR TMKRA /end DEF_CHARACTERISTIC
 /begin REF_CHARACTERISTIC SNM16KRUB /end REF_CHARACTERISTIC
 /begin IN_MEASUREMENT B_kl B_krdwslz B_krkoueb B_kuppl B_ll B_nldg B_stend B_synph B_vnull dpsfg_w esst_snm16krub evz_aus gangi kr_monitor maskgz ngas_w nmot rl rl_w tmot wkrdy zwkrafld zzylkr /end IN_MEASUREMENT
 /begin OUT_MEASUREMENT B_eks B_kr B_kra B_kradap B_krdws B_krdyerr B_krdyerr_old B_krfdks B_krgz B_krkez B_krldy B_krldya B_krldya_old B_krldyf B_krldyv B_krldyv_old B_krndy B_krnl B_ladap B_tipin B_tmkr B_wkral B_zwkraa B_zwkrum esst_srl04dyub E_ks1h E_ks2h stkrax_w stkrnx /end OUT_MEASUREMENT
 /begin LOC_MEASUREMENT azkeldy_w azkrldy_w azkrndy_w B_drknv B_inisyn3s B_kra_old B_krldya_set B_krsyne dpskrmx_w dyespfof_w dyespfv_w kral1_w kral2_w kral3_w lkr_w ngkrv_w stkrlx zldy zldyke zndy /end LOC_MEASUREMENT
 /begin SUB_FUNCTION /end SUB_FUNCTION
/end FUNCTION
/begin FUNCTION BBLOWBAT "Betriebsbereich Spannungseinbruch unter 5V" /begin DEF_CHARACTERISTIC /end DEF_CHARACTERISTIC /begin REF_CHARACTERISTIC /end REF_CHARACTERISTIC /begin IN_MEASUREMENT B_stares5v /end IN_MEASUREMENT /begin OUT_MEASUREMENT res5vCtr_u16 res5vStart res5vstate tirq1offdeb_u16 /end OUT_MEASUREMENT /begin LOC_MEASUREMENT /end LOC_MEASUREMENT /begin SUB_FUNCTION /end SUB_FUNCTION /end FUNCTION
/begin FUNCTION BBNWS "Betriebsbedingungen zur Freigabe der NWS"
 /begin DEF_CHARACTERISTIC CWNWGE CWNWSA CWNWSE CWNWSG DNLLSNW IMLNWKHMX NMNWSTMN NNWMX NNWTMN TANW TMNWKH TMNWMN TMNWMX TMNWST TOELNWEMN TOELNWEMX TOELNWMN TOELNWMX TVNWGE TVNWSTNMTM TVNWSTTM /end DEF_CHARACTERISTIC
 /begin REF_CHARACTERISTIC CWMDAPP /end REF_CHARACTERISTIC
 /begin IN_MEASUREMENT B_dknolu B_dkpu B_fanwsa B_fanwse B_gsch B_nldg B_nmin B_nwkv B_phada B_phade B_stend fnwkha fnwkhe nmot nsol rlshk_w rlsol_w rl_w tans tmot toelk_w /end IN_MEASUREMENT
 /begin OUT_MEASUREMENT BBNWSoutbits B_dnwfozea B_dnwfozee B_genws B_nnwmx B_nwkwaosw B_nws B_nwsapkfa B_nwsapkfe B_nwsappa B_nwsappe B_nwsinva B_nwsinve B_nwskflla B_nwskflle B_nwskha B_nwskhe B_nwsoada B_nwsrl B_nwssprga B_nwssprge B_nwsst B_nwstvakt B_phadnws B_wnwsmxfa B_wnwsmxfe CWNWSAoutbits CWNWSEoutbits CWNWSGoutbits rlnw_w rlsnw_w /end OUT_MEASUREMENT
 /begin LOC_MEASUREMENT BBNWSlokbits B_khnwt B_nwnmot B_nwsstend B_nwt nnwtoelgmn nnwtoelmn /end LOC_MEASUREMENT
 /begin SUB_FUNCTION /end SUB_FUNCTION
/end FUNCTION
/begin FUNCTION BBSAWE "Betriebsbereich Schubabschalten/Wiedereinsetzen"
 /begin DEF_CHARACTERISTIC CWNWEGTR CWSAWE DNSAH DNSAL DNSLL DNSLLK DNVSA DNWEK DNWEOFF DVSA ENSAKHG KFNWEGM KFTVSA KFTVSAKAT NGDNSA NGDNWEGTR NWENG NWENGFS TAVHKSAO TAVVKSAO TKATSA TKIHKSAO TVSABFA TVSABTE TVSAG0 TVSATM VSAA VWE /end DEF_CHARACTERISTIC
 /begin REF_CHARACTERISTIC SGA08MDUB SNM08__UB STK04SAUB STM05SAUB /end REF_CHARACTERISTIC
 /begin IN_MEASUREMENT B_dash B_desu B_dsls B_fa B_fs B_kh B_koe B_kuppl B_ll B_savfgr B_savmd B_savmsr B_stend B_te B_vllr esst_sga08mdub esst_snm08__ub esst_stk04saub esst_stm05saub gangi ngfil nmot nmot_w nstat tavhkm_w tavvkm_w tkatm tkihkm_w tmot tmst vfzg /end IN_MEASUREMENT
 /begin OUT_MEASUREMENT B_sab B_sabfg B_sabte tvsans /end OUT_MEASUREMENT
 /begin LOC_MEASUREMENT B_dnsll B_nwemg B_sabt B_sabv B_saen B_tatmsa dnsa nsa nwe nwecvt nwema nwemn nwenga tvsaa_w tvsakat_w /end LOC_MEASUREMENT
 /begin SUB_FUNCTION /end SUB_FUNCTION
/end FUNCTION
/begin FUNCTION BBSTT "Betriebsbereich: Start" /begin DEF_CHARACTERISTIC NNSTA NSTNM /end DEF_CHARACTERISTIC /begin REF_CHARACTERISTIC /end REF_CHARACTERISTIC /begin IN_MEASUREMENT B_nmot nmot tans tmot /end IN_MEASUREMENT /begin OUT_MEASUREMENT B_st B_stend tnse_w tnst_w /end OUT_MEASUREMENT /begin LOC_MEASUREMENT /end LOC_MEASUREMENT /begin SUB_FUNCTION /end SUB_FUNCTION /end FUNCTION
/begin FUNCTION BBSYSCON "Betriebsbereich Systemzustandssteuerung" /begin DEF_CHARACTERISTIC /end DEF_CHARACTERISTIC /begin REF_CHARACTERISTIC /end REF_CHARACTERISTIC /begin IN_MEASUREMENT B_nachl S_kl15 /end IN_MEASUREMENT
 /begin OUT_MEASUREMENT AS_hr AS_nl AS_psoff B_hr B_kl15 B_nachlauf B_norm B_wakeup /end OUT_MEASUREMENT
 /begin LOC_MEASUREMENT /end LOC_MEASUREMENT
 /begin SUB_FUNCTION /end SUB_FUNCTION
/end FUNCTION
/begin FUNCTION BBTEGA "Phasensteuerung f¸r Tankentl¸ftung und Gemischadaption"
 /begin DEF_CHARACTERISTIC DFTEDS DMRFATE FMRFAZTE FTEADZU FTEDS MRFABNTE TATELL TGAHBX TMSKLH TMSNOGA TTE TTEAE TTEBSTP TTEGA TTEGAI TTEGAIH TTEGAZO TTEGAZU TTEINI TTEMN TTEPRIO TTEZAO TTEZAU ZMRFABN /end DEF_CHARACTERISTIC
 /begin REF_CHARACTERISTIC /end REF_CHARACTERISTIC
 /begin IN_MEASUREMENT B_dktb B_dktb2 B_dldpte B_dmmtev B_dmtltz B_dtes B_edkvs B_edkvs2 B_frao B_gae B_gaefra B_gaefra2 B_gasp B_grdst B_ll B_lr B_lr2 B_nmot B_te B_teabb B_tehbx B_teza ftead_w mrfa_w nmot tans tmst tnse_w /end IN_MEASUREMENT
 /begin OUT_MEASUREMENT B_fraoan B_gap B_tep /end OUT_MEASUREMENT
 /begin LOC_MEASUREMENT B_tedtev B_tehbxf B_tepi B_tepzhl B_tepzus B_tesstp B_testop B_tezstp B_tteae B_ttegais dmrfabn_w mrfabn mrfabnf tephc /end LOC_MEASUREMENT
 /begin SUB_FUNCTION /end SUB_FUNCTION
/end FUNCTION
/begin FUNCTION BBWDA "Betriebsbereich WDA-Abschaltung" /begin DEF_CHARACTERISTIC /end DEF_CHARACTERISTIC /begin REF_CHARACTERISTIC /end REF_CHARACTERISTIC /begin IN_MEASUREMENT B_ausc_act umerr_c_um /end IN_MEASUREMENT /begin OUT_MEASUREMENT wdaoffdeb_u16 wdaondeb_u16 wda_actpat wda_ovpat wda_state /end OUT_MEASUREMENT /begin LOC_MEASUREMENT /end LOC_MEASUREMENT /begin SUB_FUNCTION /end SUB_FUNCTION /end FUNCTION
/begin FUNCTION BGADAP "Abgleich zwischen gemessenem und modelliertem Saugrohrdruck"
 /begin DEF_CHARACTERISTIC CWBGADAP DPLMDSFE DPLMDSOE DPLMDSOEKT DPLMDSOEOT DPLMDSTZF DPLMDSTZO FKFUPSRLMN FKFUPSRLMX KIFKFUPSRL KIOFAPIRG MSAGROFFAD NAPLMDSO NAPLMDSU OFAPIRGMN OFAPIRGMX PVAPIRGMN PVAPIRGMX PVFKFUMN PVFKFUMX TAFUPSRLE TAPBRINT TAPBRINTKT TDAPBRINT TDFGADPS TDFGINI TDLZSR TDPSLMDS TDTAPLMDS TPSSOLFIL TSTAPLMDS TVSEAGROFF /end DEF_CHARACTERISTIC
 /begin REF_CHARACTERISTIC /end REF_CHARACTERISTIC
 /begin IN_MEASUREMENT B_bkvmsisr B_dteaam B_dtest B_edss B_ehfm B_faagr B_pwf B_stend nmot psdss_w pslm_w pspvds_w pssol_w pu_w pvdkds_w tnst_w /end IN_MEASUREMENT
 /begin OUT_MEASUREMENT B_afupsrle B_apbrinte B_apslmdse B_disagra B_rapslmds fkfupsrl_w ofpbrint_w /end OUT_MEASUREMENT
 /begin LOC_MEASUREMENT B_afupsrl B_apbrint B_elzsr B_rapskt B_zlzsr dpslmdsf_w dpslmds_w tapbrint_w /end LOC_MEASUREMENT
 /begin SUB_FUNCTION /end SUB_FUNCTION
/end FUNCTION
/begin FUNCTION BGARNW "Berechnete Grˆﬂe Anforderung Nockenwellenadaption"
 /begin DEF_CHARACTERISTIC DWNWADRPA DWNWADRPE DWNWSKA DWNWSKE HYNMOTNW HYRLNW KFNWADA KFNWADE KFNWADGA KFNWADGE MXFLAD TMWAFMN TNWADAMX TNWADAMXA TOARNWMX TVANWSTEND TVNW_S TWAFMN TWAFMX /end DEF_CHARACTERISTIC
 /begin REF_CHARACTERISTIC /end REF_CHARACTERISTIC
 /begin IN_MEASUREMENT B_enwsva B_enwsva2 B_enwsve B_enwsve2 B_nwkwaosw B_phada B_phade B_stend B_wnws02a B_wnws02e B_wnws0a B_wnws0e nmot rlnw_w tmot toelk_w wnwsaa_w wnwsae_w /end IN_MEASUREMENT
 /begin OUT_MEASUREMENT BGARNWausbits B_nwadagfa B_nwadagfe B_nwflada B_nwflade B_nwrposa B_nwrpose /end OUT_MEASUREMENT
 /begin LOC_MEASUREMENT BGARNWlokbits B_fphad B_nwadaa B_nwadae B_nwadaga B_nwadage ctr_phada ctr_phade nmotkf rlnwkf wnwsakfa_w wnwsakfe_w /end LOC_MEASUREMENT
 /begin SUB_FUNCTION /end SUB_FUNCTION
/end FUNCTION
/begin FUNCTION BGBN "Berechnete Grˆﬂe Bordnetzversorgung" /begin DEF_CHARACTERISTIC /end DEF_CHARACTERISTIC /begin REF_CHARACTERISTIC /end REF_CHARACTERISTIC /begin IN_MEASUREMENT /end IN_MEASUREMENT /begin OUT_MEASUREMENT BGBNausbits0 B_bvhfm B_bvhls /end OUT_MEASUREMENT /begin LOC_MEASUREMENT /end LOC_MEASUREMENT /begin SUB_FUNCTION /end SUB_FUNCTION /end FUNCTION
/begin FUNCTION BGDSAD "Berechnete Grˆﬂen f¸r Drucksensoren-Abgleich" /begin DEF_CHARACTERISTIC CWDSAD OFDSSMN OFDSSMX TDIDSSU ZIDSSU /end DEF_CHARACTERISTIC /begin REF_CHARACTERISTIC /end REF_CHARACTERISTIC /begin IN_MEASUREMENT B_nmin B_pwf plufi_w psdssi_w pus_w pvdkds_w /end IN_MEASUREMENT /begin OUT_MEASUREMENT ofdss_w ofdsu_w vpvplufi_w /end OUT_MEASUREMENT /begin LOC_MEASUREMENT /end LOC_MEASUREMENT /begin SUB_FUNCTION /end SUB_FUNCTION /end FUNCTION
/begin FUNCTION BGDSLS "Berechnete Grˆﬂen f¸r Diagnose Sekund‰rluftsystem"
 /begin DEF_CHARACTERISTIC DFRMOFNML DFRMOFNXKT DFRMOFPML DFRMOFPXKT FBWRMSL SWDFRMFOF SWMSLFEG SWMSLVF TDDFRMOFF TDMSLR ZTFRMF ZTMSLF ZTMSLVF /end DEF_CHARACTERISTIC
 /begin REF_CHARACTERISTIC /end REF_CHARACTERISTIC
 /begin IN_MEASUREMENT anfsls B_anfdslv B_fgmslofs B_phmessmf B_phoffsmf B_phofsrdy B_phstart B_phventmf B_pwf B_rmslausw B_rmslauw2 B_spodsl B_spodsl2 frm2_w frm_w ml_w msfabrv2_w msfabrv_w msl2_w msllam2_w msllam_w mslth2_w mslth_w msl_w /end IN_MEASUREMENT
 /begin OUT_MEASUREMENT anzrmsl2_w anzrmsl_w bgdslsAusBits1 bgdslsAusBits2 B_dfrmoff B_dfrmoff2 B_dfrmr B_dfrmr2 B_msllamr B_msllamr2 B_msllavr B_msllavr2 B_mslubr B_mslubr2 B_mslubvr B_mslubvr2 dfrmfof2_w dfrmfof_w dfrmof2_w dfrmofn_w dfrmofp_w dfrmof_w msllamf2_w msllamf_w msllavf2_w msllavf_w mslofs2_w mslofs_w mslubf2_w mslubf_w mslubvf2_w mslubvf_w rmsl rmsl2 rmslf rmslf2 rmsloof rmsloof2 rmslv rmslv2 rmslvof rmslvof2 /end OUT_MEASUREMENT
 /begin LOC_MEASUREMENT bgdslsLokBits1 B_inidfrm B_inimslf B_inimslvf msfbvf2_w msfbvf_w msfbvvf2_w msfbvvf_w mslvofs2_w mslvofs_w /end LOC_MEASUREMENT
 /begin SUB_FUNCTION /end SUB_FUNCTION
/end FUNCTION
/begin FUNCTION BGDVE "Grˆﬂen f¸r DV-E-Ansteuerung aus Lern- und Pr¸froutinen"
 /begin DEF_CHARACTERISTIC CWDVEFO DKPSTGMIN DLRPIDSTMN DUDKNLPO DUDKNLPU DUDKPTMP FPRAT FPRMT FPRNMAX FPRTIM1_T FPRTIM2_T FPRTIM3_T FPRTIM4_T LRNST1_T LRNST3_T LRNST7_T LRNST9_T LRNVB_T NLPST1T NLPST2T TDKNACH TDLRPIDMX TMSUTMUMA TTMUMASTA UANAUFRP UANNMAX UANPEDMAX UANPIDMIN UANPIDMINA UANUATS UANVFZG UANZURP UAN_O_MT UAN_STORE UAN_U_MT UB_UANL UDKNLP1N UDKNLP2N UDKP1AMAX UDKP1AMIN UDKP1AURI UDKP1DUS UDKP1NHUB UDKP1VID UDKP1VOMA UDKP1VOMI UDKP1VVMA UDKP1VVMI UDKP2AMAX UDKP2AMIN UDKP2AURI UDKPALOS UDKPAOFF UDKPATMX UPVGNENN WDKFPRO2 WDKFPROO WDKFPROU WDKFPRZ1 WDKFPRZ2 WDKNLPMA WDKNLPMI WDKNPLAUS WDKNSTORE WDKSFPR WDKSFPRO WDKSTMUMA /end DEF_CHARACTERISTIC
 /begin REF_CHARACTERISTIC DUDKP1HY /end REF_CHARACTERISTIC
 /begin IN_MEASUREMENT B_dcdisfr B_dknolu B_dknot B_dkp1e B_dkp2e B_dkpiu B_dlrspid B_dvete B_eemrdy B_i_ska_um B_lrndia B_pwf B_stend B_ubdve B_wdk2sel dlrspid_w nmotll tans tmot ub udkp1v_w udkp1_w udkp2_w vfzg wdkba_w wdks_w wped /end IN_MEASUREMENT
 /begin OUT_MEASUREMENT B_abgle B_dcdisr B_dkaden B_dknach B_dlrien B_dveada B_dvetv B_ESrdy B_fprakt B_fproab B_fproe B_fprook B_fprordy B_fprovb B_fprrdy B_fprzab B_fprze B_fprzok B_fprzvb B_lrnakt B_lrnerf B_lrnfg B_lrnrdy B_lrnvb B_lrnws B_nlpe B_nlperf B_nlpnew B_umae B_umauab dkpstg_w dlrmxt dveadchst fprstep_c lrnstat lrnstep_c tdknach_w tloop_w tmpumast ttmumad_w udknlp1 udknlp2 udkp1a udkp1asr_w udkp1as_w udkp1a_w udkp1sv udkp1vou udkp1vo_w udkp1vv udkp1vv_w udkp2a udkp2asr_w udkp2as_w udkp2a_w udkpat_w wdkada_w wdknlp wdknlpr wdknlpr_w wdknlp_w /end OUT_MEASUREMENT
 /begin LOC_MEASUREMENT BGDVEintbits B_lrntesa B_nlpreq fprtim_c lrntim_c lrnvb_c nlp1tim udknlp1r udknlp2r udkp1aalt udkp1rob udkp1run udkp1vor udkp1vrob udkp1vrun udkp1vvr udkp2aalt wdkvabob wdkvabub /end LOC_MEASUREMENT
 /begin SUB_FUNCTION /end SUB_FUNCTION
/end FUNCTION
/begin FUNCTION BGEVAB "Berechnung der tats‰chlichen Reduzierstufe durch EV-Abschaltung" /begin DEF_CHARACTERISTIC /end DEF_CHARACTERISTIC /begin REF_CHARACTERISTIC /end REF_CHARACTERISTIC /begin IN_MEASUREMENT evz_austot stateaevab zzbank /end IN_MEASUREMENT /begin OUT_MEASUREMENT B_bevab B_bevab2 B_evakt B_evloc redist redistb1 redistb2 /end OUT_MEASUREMENT /begin LOC_MEASUREMENT /end LOC_MEASUREMENT /begin SUB_FUNCTION /end SUB_FUNCTION /end FUNCTION
/begin FUNCTION BGFKEZ "Berechnete Grˆﬂe zylinderidividuelle Faktoren zur Kraftstoffkorrektur"
 /begin DEF_CHARACTERISTIC FKEEV0N FKEEV1N FKEEV2N FKEEV3N FKEEV4N FKEEV5N FKEEV6N FKEEV7N /end DEF_CHARACTERISTIC
 /begin REF_CHARACTERISTIC SNM08GKUB /end REF_CHARACTERISTIC
 /begin IN_MEASUREMENT esst_snm08gkub nmot /end IN_MEASUREMENT
 /begin OUT_MEASUREMENT fkez /end OUT_MEASUREMENT
 /begin LOC_MEASUREMENT /end LOC_MEASUREMENT
 /begin SUB_FUNCTION /end SUB_FUNCTION
/end FUNCTION
/begin FUNCTION BGFKMS "Berechnete Grˆﬂe Korrekturfaktor Massenstrom"
 /begin DEF_CHARACTERISTIC CWBGFKMS DFKMSMN DFKMSMX DFKPVMN DFKPVMX FKMSDKMN FKMSDKMX FKPVDKMN FKPVDKMX FKPVDKPUGD KIMSALL MLFKMSDK MSALLMN MSALLMX MSLG TDABGLST TDMSDKS ZKMSDKTHFM ZKPVDKT ZMSDKAGRON ZRFKMSDK /end DEF_CHARACTERISTIC
 /begin REF_CHARACTERISTIC /end REF_CHARACTERISTIC
 /begin IN_MEASUREMENT B_dteaam B_dtest B_edks B_ehfm B_fkmsdks B_mnmld B_mxmld B_pwf dmsnte_w msdk_w ps_w pvdkds_w rlfdkrof_w rlfdkroh_w rlflmroh_w rl_w tnst_w /end IN_MEASUREMENT
 /begin OUT_MEASUREMENT B_fgabgl B_fgsabgl B_fkmsmn B_fkmsmx B_fkpvdk B_fkpvmn B_fkpvmx B_msndko dfuelsan_w fkmsdkg_w fkmsdks_w fkmsdk_w fkpvdkg_w fkpvdk_w msndko_w pspvds_w /end OUT_MEASUREMENT
 /begin LOC_MEASUREMENT B_inilabgl B_inimsdko B_inisabgl fkmsdksg_w rlzuhfs_w rlzunfs_w /end LOC_MEASUREMENT
 /begin SUB_FUNCTION /end SUB_FUNCTION
/end FUNCTION
/begin FUNCTION BGKMST "Berechnete Grˆﬂe: Kilometerstand" /begin DEF_CHARACTERISTIC /end DEF_CHARACTERISTIC /begin REF_CHARACTERISTIC /end REF_CHARACTERISTIC /begin IN_MEASUREMENT B_ins2cok B_kmmil B_pwf fcmEnd FCMTab kmstand vfzg_u /end IN_MEASUREMENT /begin OUT_MEASUREMENT kmstmil_w kmst_w /end OUT_MEASUREMENT /begin LOC_MEASUREMENT /end LOC_MEASUREMENT /begin SUB_FUNCTION /end SUB_FUNCTION /end FUNCTION
/begin FUNCTION BGKV "Berechnungsgroesse verbrauchter Kraftstoff" /begin DEF_CHARACTERISTIC /end DEF_CHARACTERISTIC /begin REF_CHARACTERISTIC FSTTMX KUMSRL /end REF_CHARACTERISTIC /begin IN_MEASUREMENT anzti rk2_w rkte_w rk_w /end IN_MEASUREMENT /begin OUT_MEASUREMENT BGKVbits B_kvta kvb_w vsks_w /end OUT_MEASUREMENT /begin LOC_MEASUREMENT anztid /end LOC_MEASUREMENT /begin SUB_FUNCTION /end SUB_FUNCTION /end FUNCTION
/begin FUNCTION BGLAMBDA "Berechnete Grˆﬂe Lambda aus Sauerstoffsignal LSU" /begin DEF_CHARACTERISTIC KFLAMSLS LALIO /end DEF_CHARACTERISTIC /begin REF_CHARACTERISTIC /end REF_CHARACTERISTIC
 /begin IN_MEASUREMENT B_flsubb B_flsubb2 B_sls lamsons2_w lamsons_w nmot o2adap2_w o2adap_w rl /end IN_MEASUREMENT
 /begin OUT_MEASUREMENT B_fklsol B_fklsol2 B_sbblsu B_sbblsu2 B_sbbvk B_sbbvk2 lalsuvj2_w lalsuvj_w lamsonb2_w lamsonb_w lamsoni2_w lamsoni_w /end OUT_MEASUREMENT
 /begin LOC_MEASUREMENT flamagr flamagr2 flamsls flamsls2 flamslsi /end LOC_MEASUREMENT
 /begin SUB_FUNCTION /end SUB_FUNCTION
/end FUNCTION
/begin FUNCTION BGLBK "Berechenete Grˆﬂen Ladungsbewegungsklappe"
 /begin DEF_CHARACTERISTIC CWBGLBK DULBKNLPCH DULBKOFFST DWLBKOMAX DWLBKUMAX TALBKOAMIN TALBKUAMIN TANSLBKMN TANSLBKMX TLBKLRN2MX TLBKLRN3MX TLBKLRN4MX TLBKLRN5MX TMOTLLBKMN TMOTLLBKMX UBSQLBK ULBKAUFP ULBKHUB ULBKNLPMAX ULBKNLPMIN ULBKOMAMAX ULBKOMAMIN ULBKOOFF ULBKUOFF ULBKZURP /end DEF_CHARACTERISTIC
 /begin REF_CHARACTERISTIC /end REF_CHARACTERISTIC
 /begin IN_MEASUREMENT B_falbk B_kl15 B_lbkese B_lbkpe B_pwf B_talbk lbkistu_w nmot talbk_w tans tmot ubsq ulbkist_w /end IN_MEASUREMENT
 /begin OUT_MEASUREMENT B_lbkaden B_lbkdarfl B_lbkgrlef B_lbklernb B_lbklrnab B_lbklrnef B_lbklrnws B_lbknlpab B_lbknlpca B_lbkoflef B_lbkomaab B_lbkumaab lbklrnctr lbkpstg_w lbkumwb ulbkisto_w ulbkpoa_w wlbkada_w /end OUT_MEASUREMENT
 /begin LOC_MEASUREMENT B_lbknlpch /end LOC_MEASUREMENT
 /begin SUB_FUNCTION /end SUB_FUNCTION
/end FUNCTION
/begin FUNCTION BGLBZ "Berechnete Grˆﬂe Ladebilanz der Batterie" /begin DEF_CHARACTERISTIC DUBLBZ NRUBMX TVLBZ UBSOLMN UBSOLMX ZKFUB ZKLBZ /end DEF_CHARACTERISTIC /begin REF_CHARACTERISTIC /end REF_CHARACTERISTIC /begin IN_MEASUREMENT B_stend nmotll ub /end IN_MEASUREMENT /begin OUT_MEASUREMENT lbz /end OUT_MEASUREMENT /begin LOC_MEASUREMENT dub ubf ubsol /end LOC_MEASUREMENT /begin SUB_FUNCTION /end SUB_FUNCTION /end FUNCTION
/begin FUNCTION BGMSABG "Berechnung Abgasmassenstrom - bankabh‰ngig" /begin DEF_CHARACTERISTIC ZYLANZB ZYLANZB2 /end DEF_CHARACTERISTIC /begin REF_CHARACTERISTIC /end REF_CHARACTERISTIC /begin IN_MEASUREMENT msfabr_w msl2_w msl_w rkg2_w rkg_w umsrln_w /end IN_MEASUREMENT
 /begin OUT_MEASUREMENT mabghks2_w mabghks_w mabikrs2_w mabikrs_w mabnavs2_w mabnavs_w mabnhks2_w mabnhks_w mabnvks2_w mabnvks_w mabvhks2_w mabvhks_w mabvvks2_w mabvvks_w mlbb2_w mlbb_w msabg msabg2 msabg2_w msabghk2_w msabghk_w msabgs2_w msabgs_w msabg_w msabikr2_w msabikr_w msabnav2_w msabnav_w msabnhk2_w msabnhk_w msabnvk2_w msabnvk_w msabvhk2_w msabvhk_w msabvvk2_w msabvvk_w msaovvk2_w msaovvk_w verhmsb2_w verhmsb_w /end OUT_MEASUREMENT
 /begin LOC_MEASUREMENT mskgb2_w mskgb_w /end LOC_MEASUREMENT
 /begin SUB_FUNCTION /end SUB_FUNCTION
/end FUNCTION
/begin COMPU_METHOD bfzg_sb_q0p217 "" RAT_FUNC "%6.3" "m/s^2" COEFFS 0 1 0 0 0 0.217 /end COMPU_METHOD
/begin COMPU_METHOD B_TRUE "boolsche Zust‰nde, positive Logik" TAB_VERB "%6.3" "" COMPU_TAB_REF B_TRUE /end COMPU_METHOD
/begin COMPU_VTAB B_TRUE "boolsche Zust‰nde, positive Logik" TAB_VERB 2 0 "----" 1 "TRUE" /end COMPU_VTAB
/begin COMPU_METHOD DEZ "1 : 1 Umrechnug (dez/hex)" RAT_FUNC "%6.2" "" COEFFS 0 1 0 0 0 1 /end COMPU_METHOD
/begin COMPU_METHOD dez "1 : 1 Umrechnug (dez/hex)" RAT_FUNC "%6.2" "" COEFFS 0 1 0 0 0 1 /end COMPU_METHOD
/begin COMPU_METHOD fak_q0p0039 "" RAT_FUNC "%6.4" "-" COEFFS 0 256 0 0 0 1 /end COMPU_METHOD
/begin COMPU_METHOD fak_q0p0078 "" RAT_FUNC "%6.4" "-" COEFFS 0 128 0 0 0 1 /end COMPU_METHOD
/begin COMPU_METHOD fak_sw_b1 "" RAT_FUNC "%7.6" "-" COEFFS 0 65536 0 0 0 2 /end COMPU_METHOD
/begin COMPU_METHOD fak_sw_b64 "" RAT_FUNC "%6.4" "-" COEFFS 0 65536 0 0 0 128 /end COMPU_METHOD
/begin COMPU_METHOD fak_ub_b1 "" RAT_FUNC "%6.4" "-" COEFFS 0 256 0 0 0 1 /end COMPU_METHOD
/begin COMPU_METHOD fak_ub_b2 "" RAT_FUNC "%6.4" "-" COEFFS 0 256 0 0 0 2 /end COMPU_METHOD
/begin COMPU_METHOD fak_ub_b4 "" RAT_FUNC "%6.4" "-" COEFFS 0 256 0 0 0 4 /end COMPU_METHOD
/begin COMPU_METHOD fak_uw_b1 "" RAT_FUNC "%7.6" "-" COEFFS 0 65536 0 0 0 1 /end COMPU_METHOD
/begin COMPU_METHOD fak_uw_b16 "" RAT_FUNC "%6.5" "-" COEFFS 0 65536 0 0 0 16 /end COMPU_METHOD
/begin COMPU_METHOD fak_uw_b2 "" RAT_FUNC "%7.6" "-" COEFFS 0 65536 0 0 0 2 /end COMPU_METHOD
/begin COMPU_METHOD fak_uw_b4 "" RAT_FUNC "%7.6" "-" COEFFS 0 65536 0 0 0 4 /end COMPU_METHOD
/begin COMPU_METHOD fak_uw_b8 "" RAT_FUNC "%6.5" "-" COEFFS 0 65536 0 0 0 8 /end COMPU_METHOD
/begin COMPU_METHOD kw_sw_q0p0078 "" RAT_FUNC "%6.4" "Grad KW" COEFFS 0 128 0 0 0 1 /end COMPU_METHOD
/begin COMPU_METHOD leist_q2 "" RAT_FUNC "%6.2" "W" COEFFS 0 1 0 0 0 2 /end COMPU_METHOD
/begin COMPU_METHOD mk1sxs_b2560 "" RAT_FUNC "%6.1" "s/(kg/h)" COEFFS 0 0 2560 0 1 0 /end COMPU_METHOD
/begin COMPU_METHOD m_q2p777Em5 "" RAT_FUNC "%7.6" "kg/s" COEFFS 0 3600 0 0 0 0.1 /end COMPU_METHOD
/begin COMPU_METHOD m_sw_b3276p8 "" RAT_FUNC "%6.3" "kg/h" COEFFS 0 1 0 0 0 0.1 /end COMPU_METHOD
/begin COMPU_METHOD m_ub_b1020 "" RAT_FUNC "%6.2" "kg/h" COEFFS 0 1 0 0 0 4 /end COMPU_METHOD
/begin COMPU_METHOD m_uw_b6553p5 "" RAT_FUNC "%6.3" "kg/h" COEFFS 0 1 0 0 0 0.1 /end COMPU_METHOD
/begin COMPU_METHOD nmotg_sb_q100 "" RAT_FUNC "%6.0" "1/min/s" COEFFS 0 1 0 0 0 100 /end COMPU_METHOD
/begin COMPU_METHOD nmotg_sw_q0p15625 "" RAT_FUNC "%6.3" "1/min/s" COEFFS 0 1 0 0 0 0.15625 /end COMPU_METHOD
/begin COMPU_METHOD nmotg_sw_q0p39 "" RAT_FUNC "%6.3" "1/min/s" COEFFS 0 1 0 0 0 0.39063 /end COMPU_METHOD
/begin COMPU_METHOD nmot_ub_q10 "" RAT_FUNC "%6.1" "1/min" COEFFS 0 1 0 0 0 10 /end COMPU_METHOD
/begin COMPU_METHOD nmot_ub_q40 "" RAT_FUNC "%6.1" "1/min" COEFFS 0 1 0 0 0 40 /end COMPU_METHOD
/begin COMPU_METHOD nmot_uw_q0p25 "" RAT_FUNC "%6.3" "1/min" COEFFS 0 1 0 0 0 0.25 /end COMPU_METHOD
/begin COMPU_METHOD p_sw_q0p039 "" RAT_FUNC "%6.4" "hPa" COEFFS 0 256 0 0 0 10 /end COMPU_METHOD
/begin COMPU_METHOD p_uw_q0p039 "" RAT_FUNC "%6.4" "hPa" COEFFS 0 256 0 0 0 10 /end COMPU_METHOD
/begin COMPU_METHOD qptemp_q12p8 "" RAT_FUNC "%6.1" "J/K" COEFFS 0 5 0 0 0 64 /end COMPU_METHOD
/begin COMPU_METHOD q_q64 "" RAT_FUNC "%6.1" "J" COEFFS 0 1 0 0 0 64 /end COMPU_METHOD
/begin COMPU_METHOD relDK_q0p02441 "" RAT_FUNC "%6.4" "%DK" COEFFS 0 65536 0 0 0 1600 /end COMPU_METHOD
/begin COMPU_METHOD relDK_q0p3922 "" RAT_FUNC "%6.3" "%DK" COEFFS 0 255 0 0 0 100 /end COMPU_METHOD
/begin COMPU_METHOD relDK_ub_b100 "" RAT_FUNC "%6.3" "%DK" COEFFS 0 255 0 0 0 100 /end COMPU_METHOD
/begin COMPU_METHOD relDK_uw_b100 "" RAT_FUNC "%6.4" "%DK" COEFFS 0 65535 0 0 0 100 /end COMPU_METHOD
/begin COMPU_METHOD relO2_q9p765Em4 "" RAT_FUNC "%6.5" "% O2" COEFFS 0 1024 0 0 0 1 /end COMPU_METHOD
/begin COMPU_METHOD rel_q0p002441 "" RAT_FUNC "%6.4" "%/V" COEFFS 0 65536 0 0 0 160 /end COMPU_METHOD
/begin COMPU_METHOD rel_q0p39 "" RAT_FUNC "%6.3" "%" COEFFS 0 256 0 0 0 100 /end COMPU_METHOD
/begin COMPU_METHOD rel_sw_b100 "" RAT_FUNC "%6.4" "%" COEFFS 0 32768 0 0 0 100 /end COMPU_METHOD
/begin COMPU_METHOD rel_sw_q0p02441 "" RAT_FUNC "%6.4" "%" COEFFS 0 65536 0 0 0 1600 /end COMPU_METHOD
/begin COMPU_METHOD rel_ub_b100 "" RAT_FUNC "%6.3" "%" COEFFS 0 256 0 0 0 100 /end COMPU_METHOD
/begin COMPU_METHOD rel_ub_b99p6 "" RAT_FUNC "%6.3" "%" COEFFS 0 256 0 0 0 100 /end COMPU_METHOD
/begin COMPU_METHOD rel_ub_q0p75 "" RAT_FUNC "%6.3" "%" COEFFS 0 1 0 0 0 0.75 /end COMPU_METHOD
/begin COMPU_METHOD rel_uw_b100 "" RAT_FUNC "%6.4" "%" COEFFS 0 65536 0 0 0 100 /end COMPU_METHOD
/begin COMPU_METHOD rel_uw_b40 "" RAT_FUNC "%6.5" "%" COEFFS 0 65536 0 0 0 40 /end COMPU_METHOD
/begin COMPU_METHOD rel_uw_q0p0234 "" RAT_FUNC "%6.4" "%" COEFFS 0 32 0 0 0 0.75 /end COMPU_METHOD
/begin COMPU_METHOD spg_q0p00488 "" RAT_FUNC "%6.4" "V" COEFFS 0 1024 0 0 0 5 /end COMPU_METHOD
/begin COMPU_METHOD spg_q0p00977 "" RAT_FUNC "%6.4" "V" COEFFS 0 256 0 0 0 2.5 /end COMPU_METHOD
/begin COMPU_METHOD spg_q0p03125 "" RAT_FUNC "%6.4" "V" COEFFS 0 256 0 0 0 8 /end COMPU_METHOD
/begin COMPU_METHOD spg_q0p1 "" RAT_FUNC "%6.3" "V" COEFFS 0 1 0 0 0 0.1 /end COMPU_METHOD
/begin COMPU_METHOD spg_sw_q0p001222 "" RAT_FUNC "%6.4" "V" COEFFS 0 1 0 0 0 0.001222 /end COMPU_METHOD
/begin COMPU_METHOD spg_ubatt "" RAT_FUNC "%6.3" "V" COEFFS 0 1 0 0 0 0.0942 /end COMPU_METHOD
/begin COMPU_METHOD spg_ub_b5 "" RAT_FUNC "%6.4" "V" COEFFS 0 256 0 0 0 5 /end COMPU_METHOD
/begin COMPU_METHOD spg_uw_q0p001222 "" RAT_FUNC "%6.4" "V" COEFFS 0 1 0 0 0 0.001222 /end COMPU_METHOD
/begin COMPU_METHOD spg_uw_q0p00488 "" RAT_FUNC "%6.4" "V" COEFFS 0 1024 0 0 0 5 /end COMPU_METHOD
/begin COMPU_METHOD s_q1_km "" RAT_FUNC "%6.2" "km" COEFFS 0 1 0 0 0 1 /end COMPU_METHOD
/begin COMPU_METHOD s_q6_km "" RAT_FUNC "%6.2" "km" COEFFS 0 1 0 0 0 6 /end COMPU_METHOD
/begin COMPU_METHOD t100msxs_uw_b6553p5 "" RAT_FUNC "%6.3" "s" COEFFS 0 1 0 0 0 0.1 /end COMPU_METHOD
/begin COMPU_METHOD t100msxs_uw_b6553p6 "" RAT_FUNC "%6.3" "s" COEFFS 0 10 0 0 0 1 /end COMPU_METHOD
/begin COMPU_METHOD t10msxs_ub_b2p55 "" RAT_FUNC "%6.4" "s" COEFFS 0 1 0 0 0 0.01 /end COMPU_METHOD
/begin COMPU_METHOD t10msxs_uw_b655p35 "" RAT_FUNC "%6.4" "s" COEFFS 0 1 0 0 0 0.01 /end COMPU_METHOD
/begin COMPU_METHOD t1sxs_ub_b255 "" RAT_FUNC "%6.2" "s" COEFFS 0 1 0 0 0 1 /end COMPU_METHOD
/begin COMPU_METHOD t1sxs_uw_q1 "" RAT_FUNC "%6.2" "s" COEFFS 0 1 0 0 0 1 /end COMPU_METHOD
/begin COMPU_METHOD t200msxs_ub_b51 "" RAT_FUNC "%6.3" "s" COEFFS 0 1 0 0 0 0.2 /end COMPU_METHOD
/begin COMPU_METHOD t200msxs_uw_q0p2 "" RAT_FUNC "%6.3" "s" COEFFS 0 1 0 0 0 0.2 /end COMPU_METHOD
/begin COMPU_METHOD t20msxs_ub_b5p1 "" RAT_FUNC "%6.4" "s" COEFFS 0 1 0 0 0 0.02 /end COMPU_METHOD
/begin COMPU_METHOD t20msxs_uw_q0p02 "" RAT_FUNC "%6.4" "s" COEFFS 0 1 0 0 0 0.02 /end COMPU_METHOD
/begin COMPU_METHOD t40ms_ub_b10200 "" RAT_FUNC "%7.2" "ms" COEFFS 0 1 0 0 0 40 /end COMPU_METHOD
/begin COMPU_METHOD t50msxs_q0p05 "" RAT_FUNC "%6.4" "s" COEFFS 0 1 0 0 0 0.05 /end COMPU_METHOD
/begin COMPU_METHOD t50msxs_q3p052em4 "" RAT_FUNC "%6.5" "1/s" COEFFS 0 65536 0 0 0 20 /end COMPU_METHOD
/begin COMPU_METHOD t50msxs_ub_b12p75 "" RAT_FUNC "%6.4" "s" COEFFS 0 1 0 0 0 0.05 /end COMPU_METHOD
/begin COMPU_METHOD t50msxs_uw_b3276p75 "" RAT_FUNC "%6.4" "s" COEFFS 0 1 0 0 0 0.05 /end COMPU_METHOD
/begin COMPU_METHOD temp_q0p0234 "" RAT_FUNC "%6.4" "K" COEFFS 0 256 0 0 0 6 /end COMPU_METHOD
/begin COMPU_METHOD temp_q0p0234_o273 "" RAT_FUNC "%6.1" "Grad C" COEFFS 0 1 273.15 0 0 0.0234375 /end COMPU_METHOD
/begin COMPU_METHOD temp_q5 "" RAT_FUNC "%6.2" "Grad C" COEFFS 0 1 0 0 0 5 /end COMPU_METHOD
/begin COMPU_METHOD temp_ub_q0p75_o48 "" RAT_FUNC "%6.2" "Grad C" COEFFS 0 1 48 0 0 0.75 /end COMPU_METHOD
/begin COMPU_METHOD temp_ub_q5_o50 "" RAT_FUNC "%6.2" "Grad C" COEFFS 0 1 50 0 0 5 /end COMPU_METHOD
/begin COMPU_METHOD t_q0p1 "" RAT_FUNC "%6.3" "s" COEFFS 0 10 0 0 0 1 /end COMPU_METHOD
/begin COMPU_METHOD t_q0p2 "" RAT_FUNC "%6.3" "s" COEFFS 0 10 0 0 0 2 /end COMPU_METHOD
/begin COMPU_METHOD vfzg_ub_q1p25 "" RAT_FUNC "%6.2" "km/h" COEFFS 0 1 0 0 0 1.25 /end COMPU_METHOD
/begin COMPU_METHOD vfzg_uw_b512 "" RAT_FUNC "%6.4" "km/h" COEFFS 0 65536 0 0 0 512 /end COMPU_METHOD
/begin COMPU_METHOD vol_q3p90625Em3_l "" RAT_FUNC "%6.4" "l" COEFFS 0 65536 0 0 0 256 /end COMPU_METHOD
/begin COMPU_METHOD vol_q5p96Em8_l "" RAT_FUNC "%10.9" "l" COEFFS 0 65536 0 0 0 0.00390625 /end COMPU_METHOD
/begin COMPU_METHOD zk100msxs_ub_b25p5 "" RAT_FUNC "%6.3" "s" COEFFS 0 0 256 0 10 0 /end COMPU_METHOD
/begin COMPU_METHOD zk100msxs_uw_b6553 "" RAT_FUNC "%10.3" "s" COEFFS 0 0 65536 0 10 0 /end COMPU_METHOD
/begin COMPU_METHOD zk10msxs_ub_b2p55 "" RAT_FUNC "%6.4" "s" COEFFS 0 0 255 0 100 0 /end COMPU_METHOD
/begin COMPU_METHOD zk10msxs_uw_b655 "" RAT_FUNC "%10.4" "s" COEFFS 0 0 65536 0 100 0 /end COMPU_METHOD
/begin COMPU_METHOD zk1sxs_ub_b255 "" RAT_FUNC "%6.2" "s" COEFFS 0 0 256 0 1 0 /end COMPU_METHOD
/begin COMPU_METHOD zk1sxs_uw_b65535 "" RAT_FUNC "%6.0" "s" COEFFS 0 0 65535 0 1 0 /end COMPU_METHOD
/begin COMPU_METHOD zk200msxs_ub_b51p2 "" RAT_FUNC "%6.3" "s" COEFFS 0 0 51.2 0 1 0 /end COMPU_METHOD
/begin COMPU_METHOD zk200msxs_uw_b13107 "" RAT_FUNC "%10.2" "s" COEFFS 0 0 13107 0 1 0 /end COMPU_METHOD
/begin COMPU_METHOD zk50msxs_uw_b12p8 "" RAT_FUNC "%10.3" "s" COEFFS 0 0 32768 0 10 0 /end COMPU_METHOD
/begin RECORD_LAYOUT GkfWS16 FNC_VALUES 1 SWORD COLUMN_DIR DIRECT /end RECORD_LAYOUT
/begin RECORD_LAYOUT GkfWU8 FNC_VALUES 1 UBYTE COLUMN_DIR DIRECT /end RECORD_LAYOUT
/begin RECORD_LAYOUT GkfWUb FNC_VALUES 1 UBYTE COLUMN_DIR DIRECT /end RECORD_LAYOUT
/begin RECORD_LAYOUT GklWS16 FNC_VALUES 1 SWORD COLUMN_DIR DIRECT /end RECORD_LAYOUT
/begin RECORD_LAYOUT GklWU16 FNC_VALUES 1 UWORD COLUMN_DIR DIRECT /end RECORD_LAYOUT
/begin RECORD_LAYOUT GklWU8 FNC_VALUES 1 UBYTE COLUMN_DIR DIRECT /end RECORD_LAYOUT
/begin RECORD_LAYOUT KfAxU8AyU8SstxU16SstyU16WU16 NO_AXIS_PTS_X 1 UWORD NO_AXIS_PTS_Y 2 UWORD AXIS_PTS_X 3 UWORD INDEX_INCR DIRECT AXIS_PTS_Y 4 UWORD INDEX_INCR DIRECT FNC_VALUES 5 UWORD COLUMN_DIR DIRECT /end RECORD_LAYOUT
/begin RECORD_LAYOUT KfAxUbAyUbSstxUbSstyUbWUb NO_AXIS_PTS_X 1 UBYTE NO_AXIS_PTS_Y 2 UBYTE AXIS_PTS_X 3 UBYTE INDEX_INCR DIRECT AXIS_PTS_Y 4 UBYTE INDEX_INCR DIRECT FNC_VALUES 5 UBYTE COLUMN_DIR DIRECT /end RECORD_LAYOUT
/begin RECORD_LAYOUT KlAUbSstSbWUb NO_AXIS_PTS_X 1 UBYTE AXIS_PTS_X 2 SBYTE INDEX_INCR DIRECT FNC_VALUES 3 UBYTE COLUMN_DIR DIRECT /end RECORD_LAYOUT
/begin RECORD_LAYOUT KlAUbSstUbWUb NO_AXIS_PTS_X 1 UBYTE AXIS_PTS_X 2 UBYTE INDEX_INCR DIRECT FNC_VALUES 3 UBYTE COLUMN_DIR DIRECT /end RECORD_LAYOUT
/begin RECORD_LAYOUT KlAUbSstUbWUw NO_AXIS_PTS_X 1 UBYTE AXIS_PTS_X 2 UBYTE INDEX_INCR DIRECT FNC_VALUES 3 UWORD COLUMN_DIR DIRECT /end RECORD_LAYOUT
/begin RECORD_LAYOUT KlAUbSstUwWUb NO_AXIS_PTS_X 1 UBYTE AXIS_PTS_X 2 UWORD INDEX_INCR DIRECT FNC_VALUES 3 UBYTE COLUMN_DIR DIRECT /end RECORD_LAYOUT
/begin RECORD_LAYOUT KlAUwSstSwWUw NO_AXIS_PTS_X 1 UWORD AXIS_PTS_X 2 SWORD INDEX_INCR DIRECT FNC_VALUES 3 UWORD COLUMN_DIR DIRECT /end RECORD_LAYOUT
/begin RECORD_LAYOUT KlAUwSstUwWUw NO_AXIS_PTS_X 1 UWORD AXIS_PTS_X 2 UWORD INDEX_INCR DIRECT FNC_VALUES 3 UWORD COLUMN_DIR DIRECT /end RECORD_LAYOUT
/begin RECORD_LAYOUT KlAxU8SstxU16WS16 NO_AXIS_PTS_X 1 UWORD AXIS_PTS_X 2 UWORD INDEX_INCR DIRECT FNC_VALUES 3 SWORD COLUMN_DIR DIRECT /end RECORD_LAYOUT
/begin RECORD_LAYOUT KlAxU8SstxU16WU16 NO_AXIS_PTS_X 1 UWORD AXIS_PTS_X 2 UWORD INDEX_INCR DIRECT FNC_VALUES 3 UWORD COLUMN_DIR DIRECT /end RECORD_LAYOUT
/begin RECORD_LAYOUT KlAxU8SstxU16WU8 NO_AXIS_PTS_X 1 UBYTE AXIS_PTS_X 2 UWORD INDEX_INCR DIRECT FNC_VALUES 3 UBYTE COLUMN_DIR DIRECT /end RECORD_LAYOUT
/begin RECORD_LAYOUT KwSb FNC_VALUES 1 SBYTE COLUMN_DIR DIRECT /end RECORD_LAYOUT
/begin RECORD_LAYOUT KwSw FNC_VALUES 1 SWORD COLUMN_DIR DIRECT /end RECORD_LAYOUT
/begin RECORD_LAYOUT KwUb FNC_VALUES 1 UBYTE COLUMN_DIR DIRECT /end RECORD_LAYOUT
/begin RECORD_LAYOUT KwUw FNC_VALUES 1 UWORD COLUMN_DIR DIRECT /end RECORD_LAYOUT
/begin RECORD_LAYOUT KwWS16 FNC_VALUES 1 SWORD COLUMN_DIR DIRECT /end RECORD_LAYOUT
/begin RECORD_LAYOUT KwWU16 FNC_VALUES 1 UWORD COLUMN_DIR DIRECT /end RECORD_LAYOUT
/begin RECORD_LAYOUT KwWU8 FNC_VALUES 1 UBYTE COLUMN_DIR DIRECT /end RECORD_LAYOUT
/begin RECORD_LAYOUT SstAU8SstU16 NO_AXIS_PTS_X 1 UWORD AXIS_PTS_X 2 UWORD INDEX_INCR DIRECT /end RECORD_LAYOUT
/begin RECORD_LAYOUT SstAU8SstU8 NO_AXIS_PTS_X 1 UBYTE AXIS_PTS_X 2 UBYTE INDEX_INCR DIRECT /end RECORD_LAYOUT
/begin RECORD_LAYOUT SstAUbSstUb NO_AXIS_PTS_X 1 UBYTE AXIS_PTS_X 2 UBYTE INDEX_INCR DIRECT /end RECORD_LAYOUT
/end MODULE
/end PROJECT
