ASAP2_VERSION 1 3
/begin PROJECT _9702_071D00 "ME97"
/begin HEADER "" VERSION "_9702_071D00" PROJECT_NO _9702_071D00 /end HEADER
/begin MODULE DIM ""
/begin MOD_COMMON "" BYTE_ORDER MSB_FIRST ALIGNMENT_BYTE 1 ALIGNMENT_WORD 2 ALIGNMENT_LONG 2 ALIGNMENT_FLOAT32_IEEE 4 /end MOD_COMMON
/begin CHARACTERISTIC ADCY "Anzahl DCY zum Initialisieren der Dauerlaufz‰hler" VALUE 0x1C481E KwWU8 255.0 dez 0.00 255.0 FORMAT "%5.1" /end CHARACTERISTIC
/begin CHARACTERISTIC AHEAGW "Aussetzerh‰ufigkeit zum Erreichen der gesetzlichen Abgaslimits" VALUE 0x1C4810 KwWU16 65535.00 dez 0.00 65535.00 FORMAT "%8.2" /end CHARACTERISTIC
/begin CHARACTERISTIC AHEAGWS "Aussetzerh‰ufigkeit zum Erreichen der gesetzlichen Abgaslimits" VALUE 0x1C4812 KwWU16 65535.00 dez 0.00 65535.00 FORMAT "%8.2" /end CHARACTERISTIC
/begin CHARACTERISTIC AHEARV "Aussetzerh‰ufigkeit zum Erreichen der Ausblendung weiterer Funktionen" VALUE 0x1C4814 KwWU16 65535.00 dez 0.00 65535.00 FORMAT "%8.2" /end CHARACTERISTIC
/begin CHARACTERISTIC AHEKABB "Aussetzerh‰ufigkeit pro Bank zum Erreichen einer Kraftstoffabschaltung" VAL_BLK 0x1C4802 KwbWU16 65535.00 dez 0.00 65535.00 FORMAT "%8.2" NUMBER 4 /end CHARACTERISTIC
/begin CHARACTERISTIC AHEKS1B1 "Aussetzerh‰ufigkeit zum Erreichen einer Katsch‰digung im 1. Intervall Bank 1" VALUE 0x1C4816 KwWU16 65535.00 dez 0.00 65535.00 FORMAT "%8.2" /end CHARACTERISTIC
/begin CHARACTERISTIC AHEKS1B2 "Aussetzerh‰ufigkeit zum Erreichen einer Katsch‰digung im 1. Intervall Bank 2" VALUE 0x1C4818 KwWU16 65535.00 dez 0.00 65535.00 FORMAT "%8.2" /end CHARACTERISTIC
/begin CHARACTERISTIC AHEKSB1 "Aussetzerh‰ufigkeit zum Erreichen einer Katalysatorsch‰digung Bank 1" VALUE 0x1C481A KwWU16 65535.00 dez 0.00 65535.00 FORMAT "%8.2" /end CHARACTERISTIC
/begin CHARACTERISTIC AHEKSB2 "Aussetzerh‰ufigkeit zum Erreichen einer Katalysatorsch‰digung Bank 2" VALUE 0x1C481C KwWU16 65535.00 dez 0.00 65535.00 FORMAT "%8.2" /end CHARACTERISTIC
/begin CHARACTERISTIC AINTKAN "Anzahl Intervalle mit Katsch‰digung f¸r Ti-Abschaltung" CURVE 0x1C47C8 GklWU8 255.0 dez 0.00 255.0 FORMAT "%5.1"
 /begin AXIS_DESCR COM_AXIS nmot nmot_ub_q40 8 0.00 10200. AXIS_PTS_REF SNM08DMUB /end AXIS_DESCR
/end CHARACTERISTIC
/begin CHARACTERISTIC ALFO "Anfangswert f¸r Lernfilter bei fuel-on/fuel-off Adaption" VALUE 0x1C4100 KwWR32 2.000000000000E+037 fak_r32_1 -1.000000000000E+037 1.000000000000E+037 FORMAT "%43.4" /end CHARACTERISTIC
/begin CHARACTERISTIC ANALUN "Anzahl Verbrennungen f¸r Ausblendungen nach erkanntem Auss., drehzahlabh‰ngig" CURVE 0x1C4154 GklWU8 255.0 dez 0.00 255.0 FORMAT "%5.1"
 /begin AXIS_DESCR COM_AXIS nmot nmot_ub_q40 8 0.00 10200. AXIS_PTS_REF SNM08DMUB /end AXIS_DESCR
/end CHARACTERISTIC
/begin CHARACTERISTIC ANWFOHE "Anzahl NW-Umdr. f¸r Heilung" VALUE 0x1C40FC KwWU16 65535.00 dez 0.00 65535.00 FORMAT "%8.2" /end CHARACTERISTIC
/begin CHARACTERISTIC ANZRMSL "Anzahl der MSL-Messungen f¸r Auswertng des gleitenden Mittelwertes" VALUE 0x1CBC62 KwWU16 65535.00 dez 0.00 65535.00 FORMAT "%8.2" /end CHARACTERISTIC
/begin CHARACTERISTIC AVRALU "Anzahl NW-Umdr./Verbrenng. f. Reaktivierung Aussetzererkennung nach Ausblendung" VALUE 0x1C4850 KwWU8 255.0 DEZ 0.00 255.0 FORMAT "%5.1" /end CHARACTERISTIC
/begin CHARACTERISTIC AZSTLU "Verl‰ngerung der Ausblendanforderung bei Motorstart in Anzahl Z¸ndungen" VALUE 0x1C4851 KwWU8 255.0 DEZ 0.00 255.0 FORMAT "%5.1" /end CHARACTERISTIC
/begin CHARACTERISTIC AZYTIABB "Max. Anzahl von Zylindern mit Ti-Abschaltung aufgrund von Aussetzern, pro Bank" VAL_BLK 0x1C480C KwbWU8 255.0 dez 0.00 255.0 FORMAT "%5.1" NUMBER 4 /end CHARACTERISTIC
/begin CHARACTERISTIC CWDALA "Codewort DMDMIL Dauerlaufz‰hler" VALUE 0x1C481F KwWU8 255.0 dez 0.00 255.0 FORMAT "%5.1" /end CHARACTERISTIC
/begin CHARACTERISTIC CWDMDE "Codewort f¸r EOBD-Appl. DMDMIL (Heilung ohne Fensterabd.)" VALUE 0x1C4820 KwWU8 255.0 dez 0.00 255.0 FORMAT "%5.1" /end CHARACTERISTIC
/begin CHARACTERISTIC CWDMDZAG "Codewort DMDZAG Konfiguration" VALUE 0x1C48D8 KwWU8 255.0 DEZ 0.00 255.0 FORMAT "%5.1" /end CHARACTERISTIC
/begin CHARACTERISTIC CWMILCOD "Codewort MIL-Codierung aktiv" VALUE 0x1C3CD8 KwUb 255.0 dez 0.00 255.0 FORMAT "%5.1" /end CHARACTERISTIC
/begin CHARACTERISTIC CWNOMIL "Codewort MIL-Ansteuerung nicht aktiv" VALUE 0x1C3CD9 KwUb 255.0 dez 0.00 255.0 FORMAT "%5.1" /end CHARACTERISTIC
/begin CHARACTERISTIC CWPSNWSAE "Kodewort zum Abschalten der Endstufediagnose NWS Auslass" VALUE 0x1CAA62 KwWU8 255.0 dez 0.00 255.0 FORMAT "%5.1" /end CHARACTERISTIC
/begin CHARACTERISTIC CWPSNWSEE "Kodewort zum Abschalten der Endstufediagnose NWS Einlass" VALUE 0x1CAB06 KwWU8 255.0 dez 0.00 255.0 FORMAT "%5.1" /end CHARACTERISTIC
/begin CHARACTERISTIC CWSTPCNF "Codewort Ausblendkriterien 1 -> Kriterium aktiv" VALUE 0x1C4852 KwWU8 255.0 DEZ 0.00 255.0 FORMAT "%5.1" /end CHARACTERISTIC
/begin CHARACTERISTIC CW_DR_ERR1 "" VALUE 0x1D429A KwWU16 65535.00 dez 0.00 65535.00 FORMAT "%8.2" /end CHARACTERISTIC
/begin CHARACTERISTIC CW_DR_ERR2 "" VALUE 0x1D429C KwWU16 65535.00 dez 0.00 65535.00 FORMAT "%8.2" /end CHARACTERISTIC
/begin CHARACTERISTIC CW_DR_ERR_ID "" VALUE 0x1D429E KwWU8 255.0 dez 0.00 255.0 FORMAT "%5.1" /end CHARACTERISTIC
/begin CHARACTERISTIC DFSEFON1 "drehzahlabh. max. plausible Abweichungen der FSE-Werte" VAL_BLK 0x1C4064 KwbWR32 2.000000000000E+037 fak_r32_1 -1.000000000000E+037 1.000000000000E+037 FORMAT "%43.4" NUMBER 8 /end CHARACTERISTIC
/begin CHARACTERISTIC DFSEFON2 "drehzahlabh. max. plausible Abweichungen der FSE-Werte" VAL_BLK 0x1C4084 KwbWR32 2.000000000000E+037 fak_r32_1 -1.000000000000E+037 1.000000000000E+037 FORMAT "%43.4" NUMBER 8 /end CHARACTERISTIC
/begin CHARACTERISTIC DFSERES "Differenz der Adaptionswerte zum Auslˆsen eines Reset der fuel-on/-off adaption" VALUE 0x1C4104 KwWR32 2.000000000000E+037 fak_r32_1 -1.000000000000E+037 1.000000000000E+037 FORMAT "%43.4" /end CHARACTERISTIC
/begin CHARACTERISTIC DIF12_LL "maximale Differenz zwischen SP1S und SP2S unterhalb der Vollgas-Schwelle" VALUE 0x1D1FC2 dc_KwUw 12.51222 DC_APP_VOLT_U16 0.00 12.51222 FORMAT "%8.5" /end CHARACTERISTIC
/begin CHARACTERISTIC DIF12_T "" VALUE 0x1D1FB2 dc_KwUw 1310.7 DC_TIME_20MS_S16 0.00 1310.7 FORMAT "%6.1" /end CHARACTERISTIC
/begin CHARACTERISTIC DIF12_VG "maximale Differenz zwischen SP1S und SP2S oberhalb der Vollgas-Schwelle" VALUE 0x1D1FC4 dc_KwUw 29.32551 DC_APP_VOLT_U16 0.00 29.32551 FORMAT "%8.5" /end CHARACTERISTIC
/begin CHARACTERISTIC DMDSEGL "Segmentl‰nge f¸r Aussetzererkennung" VALUE 0x1C48DA KwWU16 393210.0 kw_q6 0.00 393210.0 FORMAT "%8.1" /end CHARACTERISTIC
/begin CHARACTERISTIC DMXRFL "Begrenzung bei max. Filter-Laufunruhe-Referenzwert-ƒnderung" VALUE 0x1C47C4 KwWR32 2.000000000000E+037 fak_r32_1 -1.000000000000E+037 1.000000000000E+037 FORMAT "%43.4" /end CHARACTERISTIC
/begin CHARACTERISTIC DMXRLU "Begrenzung bei max. Laufunruhe-Referenzwert-ƒnderung" VALUE 0x1C45B8 KwWR32 2.000000000000E+037 fak_r32_1 -1.000000000000E+037 1.000000000000E+037 FORMAT "%43.4" /end CHARACTERISTIC
/begin CHARACTERISTIC DPACSV_RVTRQ "" VALUE 0x1D2FC9 dc_KwUb 765.0 DC_M3NM 0.00 765.0 FORMAT "%5.1" /end CHARACTERISTIC
/begin CHARACTERISTIC DPACSV_THSW "" VALUE 0x1D1AB6 dc_KwSw 1310.7 DC_TIME_20MS_S16 -655.36 655.34 FORMAT "%6.2" /end CHARACTERISTIC
/begin CHARACTERISTIC DPACSV_TSPRS "" VALUE 0x1D1AB2 dc_KwSw 1310.7 DC_TIME_20MS_S16 -655.36 655.34 FORMAT "%6.2" /end CHARACTERISTIC
/begin CHARACTERISTIC DPACSV_TSPWR "" VALUE 0x1D1AB0 dc_KwSw 1310.7 DC_TIME_20MS_S16 -655.36 655.34 FORMAT "%6.2" /end CHARACTERISTIC
/begin CHARACTERISTIC DPACSV_TSTRQ "" VALUE 0x1D1AB4 dc_KwSw 1310.7 DC_TIME_20MS_S16 -655.36 655.34 FORMAT "%6.2" /end CHARACTERISTIC
/begin CHARACTERISTIC DPACSV_ULPWR "" VALUE 0x1D2FC8 dc_KwUb 255. DC_SD1_U8MB 0.00 255. FORMAT "%4.0" /end CHARACTERISTIC
/begin CHARACTERISTIC DRLSOLA "Misfire Detection : Schwelle Lastdynamik f¸r Ausblendung" CURVE 0x1C4828 GklWS16 1535.977 relNWU_q0p0234 -768.0000 767.9766 FORMAT "%8.4"
 /begin AXIS_DESCR COM_AXIS rl rel_ub_q0p75 8 0.00 191.3 AXIS_PTS_REF SRL08DMUB /end AXIS_DESCR
/end CHARACTERISTIC
/begin CHARACTERISTIC DWNWDHYSA "Hysterese Abweichung Nockenwellenposition f¸r Fehleraustrag Auslaﬂ" VALUE 0x1CA9C6 KwUw 255.0000 kw_uw_q0p0078 0.00 255.0000 FORMAT "%8.4" /end CHARACTERISTIC
/begin CHARACTERISTIC DWNWDHYSE "Hysterese Abweichung Nockenwellenposition f¸r Fehleraustrag Einlass" VALUE 0x1CAA6A KwUw 255.0000 kw_uw_q0p0078 0.00 255.0000 FORMAT "%8.4" /end CHARACTERISTIC
/begin CHARACTERISTIC FABSALU "Abregelfaktor Beschleunigungssignal bei Schlechtwegstrecken-Erkennung" VALUE 0x1C48E0 KwUb 553.4 accgrd_ub_b555p55 0.00 553.4 FORMAT "%5.1" /end CHARACTERISTIC
/begin CHARACTERISTIC FAINTEN "Anzahl Intervalle zur Freigabe Ti - Abschaltung" VALUE 0x1C4821 KwWU8 255.0 dez 0.00 255.0 FORMAT "%5.1" /end CHARACTERISTIC
/begin CHARACTERISTIC FASKIV1 "Faktor f¸r Verl‰ngerung 1. KAT-Intervall, Aussetzererkennung" VALUE 0x1C4822 KwWU8 255.0 dez 0.00 255.0 FORMAT "%5.1" /end CHARACTERISTIC
/begin CHARACTERISTIC FIAMALU "Anhebungsfaktor f¸r Filter Mehrfachaussetzererkennung" VALUE 0x1C45BC KwWR32 2.000000000000E+037 fak_r32_1 -1.000000000000E+037 1.000000000000E+037 FORMAT "%43.4" /end CHARACTERISTIC
/begin CHARACTERISTIC FIBSALU "Filterfaktor Beschleunigungssignal bei Schlechtwegstrecken-Erkennung" VALUE 0x1C48E1 KwUb 0.9961 fak_ub_b1 0.00 0.9961 /end CHARACTERISTIC
/begin CHARACTERISTIC FIMALU "Filterfaktor Mehrfachaussetzererkennung" VALUE 0x1C45C0 KwWR32 2.000000000000E+037 fak_r32_1 -1.000000000000E+037 1.000000000000E+037 FORMAT "%43.4" /end CHARACTERISTIC
/begin CHARACTERISTIC FLFO "Filterfaktor Lernfilter der fuel-on/-off Adaption" VALUE 0x1C4108 KwWR32 2.000000000000E+037 fak_r32_1 -1.000000000000E+037 1.000000000000E+037 FORMAT "%43.4" /end CHARACTERISTIC
/begin CHARACTERISTIC FLUTN "Filterfaktor Laufunruhe-Filter" CURVE 0x1C4160 KlAxU8SstxR32WR32 2.000000000000E+037 fak_r32_1 -1.000000000000E+037 1.000000000000E+037 FORMAT "%43.4"
 /begin AXIS_DESCR STD_AXIS nmot_f fak_r32_1 8 -1.000000000000E+037 1.000000000000E+037 FORMAT "%43.4" DEPOSIT ABSOLUTE /end AXIS_DESCR
/end CHARACTERISTIC
/begin CHARACTERISTIC FLUV1 "Schalter der Modifikation 1 der Laufunruhe-Berechnung" VALUE 0x1C41A4 KwWU8 255.0 dez 0.00 255.0 FORMAT "%5.1" /end CHARACTERISTIC
/begin CHARACTERISTIC FS1FO "Filterfaktor Segmentzeit-Filter 1 der fuel-on/-off Adaption" VALUE 0x1C410C KwWR32 2.000000000000E+037 fak_r32_1 -1.000000000000E+037 1.000000000000E+037 FORMAT "%43.4" /end CHARACTERISTIC
/begin CHARACTERISTIC FS2FO "Filterfaktor Segmentzeit-Filter 2 der fuel-on/-off Adaption" VALUE 0x1C4110 KwWR32 2.000000000000E+037 fak_r32_1 -1.000000000000E+037 1.000000000000E+037 FORMAT "%43.4" /end CHARACTERISTIC
/begin CHARACTERISTIC FSWALUV "Erkennungsschwelle Schlechtwegstrecke abh‰ngig von Fz.geschwindigkeit" CURVE 0x1C48E4 KlAUbSstUbWUb 55.34 acc_ub_b55p55 0.00 55.34 FORMAT "%5.2"
 /begin AXIS_DESCR STD_AXIS vfzg vfzg_ub_q1p25 4 0.00 318.8 FORMAT "%5.1" DEPOSIT ABSOLUTE /end AXIS_DESCR
/end CHARACTERISTIC
/begin CHARACTERISTIC FW_PWBP_GR "Gradientenschwelle f¸r Vergleich Pedalwert Bremspedal" VALUE 0x1D1FDC dc_KwSw 10000.000 DC_PER0327_20_S16DB -5000.0763 4999.9237 /end CHARACTERISTIC
/begin CHARACTERISTIC FW_PWBP_MN "Minimalwert f¸r  Vergleich Pedalwert mit Bremspedal" VALUE 0x1D1FE2 dc_KwUw 200.0031 DC_PER0327 0.00 200.0031 FORMAT "%8.4" /end CHARACTERISTIC
/begin CHARACTERISTIC FW_PWBP_N "obere Normierungsgrenze" VALUE 0x1D1FDA dc_KwSw 32767.5 DC_ROTSPD_S16 -16384.0 16383.5 FORMAT "%7.1" /end CHARACTERISTIC
/begin CHARACTERISTIC FW_PWBP_ON "Ein/Ausschalter Funktion Vergleich  Pedalwert mit Bremspedal" VALUE 0x1D3113 dc_KwUb 1.000 DC_CNTR_U8 0.00 1.000 FORMAT "%5.3" /end CHARACTERISTIC
/begin CHARACTERISTIC FW_PWBP_R "Rampensteigung  Funktion  Vergleich Pedalwert mit Bremspedal" VALUE 0x1D1FE0 dc_KwSw 4999.9237 DC_PER0327_20_S16DB 0.00 4999.9237 /end CHARACTERISTIC
/begin CHARACTERISTIC FW_PWBP_SW "Pedalwertschwelle f¸r Vergleich Pedalwert mit Bremspedal" VALUE 0x1D1FDE dc_KwUw 200.0031 DC_PER0327 0.00 200.0031 FORMAT "%8.4" /end CHARACTERISTIC
/begin CHARACTERISTIC FW_PWBP_T "Entprellzeit f¸r Funktion  Vergleich Pedalwert mit Bremspedal" VALUE 0x1D3112 dc_KwUb 5.100 DC_TQ20 0.00 5.100 FORMAT "%5.3" /end CHARACTERISTIC
/begin CHARACTERISTIC FW_PWBP_V "Geschwindigkeitsschwelle f¸r Vergleich Pedalwert mit Bremspedal" VALUE 0x1D1FD8 dc_KwUw 2000.000 DC_VEHSPD_KMH_U16 0.00 2000.000 FORMAT "%8.3" /end CHARACTERISTIC
/begin CHARACTERISTIC HYSTERESE "Pedalhysterese beim Entjittern" VALUE 0x1D1FD6 dc_KwUw 4.887586 DC_APP_VOLT_U16 0.00 4.887586 FORMAT "%8.6" /end CHARACTERISTIC
/begin CHARACTERISTIC KAMFZ "Segment- bzw. Messfensterbeginn bei Segmentzeiterfassung Aussetzererkennung" VALUE 0x1C48DC KwWU16 393210.0 kw_q6 0.00 393210.0 FORMAT "%8.1" /end CHARACTERISTIC
/begin CHARACTERISTIC KFAMAL "Kennfeld Absenkungsfaktor f¸r Lur-Wert bei erkannten Mehrfachaussetzern" MAP 0x1C44A8 GkfWU8 0.9961 fak_ub_b1 0.00 0.9961
 /begin AXIS_DESCR COM_AXIS rl rel_ub_q0p75 8 0.00 191.3 AXIS_PTS_REF SRL08DMUB /end AXIS_DESCR
 /begin AXIS_DESCR COM_AXIS nmot nmot_ub_q40 8 0.00 10200. AXIS_PTS_REF SNM08DMUB /end AXIS_DESCR
/end CHARACTERISTIC
/begin CHARACTERISTIC KFAMAL1 "Kennfeld Absenkungsfaktor f¸r Lur-Wert bei erkannten Mehrfachaussetzern" MAP 0x1C44E8 GkfWU8 0.9961 fak_ub_b1 0.00 0.9961
 /begin AXIS_DESCR COM_AXIS rl rel_ub_q0p75 8 0.00 191.3 AXIS_PTS_REF SRL08DMUB /end AXIS_DESCR
 /begin AXIS_DESCR COM_AXIS nmot nmot_ub_q40 8 0.00 10200. AXIS_PTS_REF SNM08DMUB /end AXIS_DESCR
/end CHARACTERISTIC
/begin CHARACTERISTIC KFAMAL2 "Kennfeld Absenkungsfaktor f¸r Lur-Wert bei erkannten Mehrfachaussetzern" MAP 0x1C4528 GkfWU8 0.9961 fak_ub_b1 0.00 0.9961
 /begin AXIS_DESCR COM_AXIS rl rel_ub_q0p75 8 0.00 191.3 AXIS_PTS_REF SRL08DMUB /end AXIS_DESCR
 /begin AXIS_DESCR COM_AXIS nmot nmot_ub_q40 8 0.00 10200. AXIS_PTS_REF SNM08DMUB /end AXIS_DESCR
/end CHARACTERISTIC
/begin CHARACTERISTIC KFCFO1 "Kennfeld zur Definition der Bereichseigenschaften (dominant..)" MAP 0x1C3F94 GkfWU8 255.0 dez 0.00 255.0 FORMAT "%5.1"
 /begin AXIS_DESCR COM_AXIS nmot_w nmot_uw_q0p25 10 0.00 16383.75 AXIS_PTS_REF SNM10DMUW1 /end AXIS_DESCR
 /begin AXIS_DESCR COM_AXIS rl rel_ub_q0p75 5 0.00 191.3 AXIS_PTS_REF SRL05DMUB1 /end AXIS_DESCR
/end CHARACTERISTIC
/begin CHARACTERISTIC KFCFO2 "Kennfeld zur Definition der Bereichseigenschaften (dominant..)" MAP 0x1C3FC8 GkfWU8 255.0 dez 0.00 255.0 FORMAT "%5.1"
 /begin AXIS_DESCR COM_AXIS nmot_w nmot_uw_q0p25 10 0.00 16383.75 AXIS_PTS_REF SNM10DMUW2 /end AXIS_DESCR
 /begin AXIS_DESCR COM_AXIS rl rel_ub_q0p75 5 0.00 191.3 AXIS_PTS_REF SRL05DMUB2 /end AXIS_DESCR
/end CHARACTERISTIC
/begin CHARACTERISTIC KFDWNWDMXA "Maximale Abweichung Nockenwellenposition f¸r Fehlereintrag Einlaﬂ" MAP 0x1CA9C8 KfAxUwAyUwSstxUwSstyUwWUw 511.9922 kw_uw_q0p0078 0.00 511.9922 FORMAT "%8.4"
 /begin AXIS_DESCR STD_AXIS toelk_w temp_q0p0234_o273 5 -273.1500 1262.827 FORMAT "%8.3" DEPOSIT ABSOLUTE /end AXIS_DESCR
 /begin AXIS_DESCR STD_AXIS nmot_w nmot_uw_q0p25 6 0.00 16383.75 FORMAT "%8.2" DEPOSIT ABSOLUTE /end AXIS_DESCR
/end CHARACTERISTIC
/begin CHARACTERISTIC KFDWNWDMXE "Maximale Abweichung Nockenwellenposition f¸r Fehlereintrag Einlass" MAP 0x1CAA6C KfAxUwAyUwSstxUwSstyUwWUw 511.9922 kw_uw_q0p0078 0.00 511.9922 FORMAT "%8.4"
 /begin AXIS_DESCR STD_AXIS toelk_w temp_q0p0234_o273 5 -273.1500 1262.827 FORMAT "%8.3" DEPOSIT ABSOLUTE /end AXIS_DESCR
 /begin AXIS_DESCR STD_AXIS nmot_w nmot_uw_q0p25 6 0.00 16383.75 FORMAT "%8.2" DEPOSIT ABSOLUTE /end AXIS_DESCR
/end CHARACTERISTIC
/begin CHARACTERISTIC KFKSWF "Kennfeld f¸r Kat.-Schutz-Wichtungsfaktoren" MAP 0x1C47D0 KfAxU8AyU8SstxU8SstyU8WU8 255.0 dez 0.00 255.0 FORMAT "%5.1"
 /begin AXIS_DESCR STD_AXIS rl rel_ub_q0p75 6 0.00 191.3 FORMAT "%5.1" DEPOSIT ABSOLUTE /end AXIS_DESCR
 /begin AXIS_DESCR STD_AXIS nmot nmot_ub_q40 6 0.00 10200. FORMAT "%5.0" DEPOSIT ABSOLUTE /end AXIS_DESCR
/end CHARACTERISTIC
/begin CHARACTERISTIC KFLUAR "Kennfeld f¸r Laufunruhe-Abstandsmass-Referenzwert" MAP 0x1C45C4 GkfWU16 181.8962 luquant_w 0.00 181.8962 FORMAT "%8.4"
 /begin AXIS_DESCR COM_AXIS rl rel_ub_q0p75 8 0.00 191.3 AXIS_PTS_REF SRL08DMUB /end AXIS_DESCR
 /begin AXIS_DESCR COM_AXIS nmot nmot_ub_q40 8 0.00 10200. AXIS_PTS_REF SNM08DMUB /end AXIS_DESCR
/end CHARACTERISTIC
/begin CHARACTERISTIC KFLUAR1 "Kennfeld f¸r Laufunruhe-Abstandsmass-Referenzwert" MAP 0x1C4644 GkfWU16 181.8962 luquant_w 0.00 181.8962 FORMAT "%8.4"
 /begin AXIS_DESCR COM_AXIS rl rel_ub_q0p75 8 0.00 191.3 AXIS_PTS_REF SRL08DMUB /end AXIS_DESCR
 /begin AXIS_DESCR COM_AXIS nmot nmot_ub_q40 8 0.00 10200. AXIS_PTS_REF SNM08DMUB /end AXIS_DESCR
/end CHARACTERISTIC
/begin CHARACTERISTIC KFLUAR2 "Kennfeld f¸r Laufunruhe-Abstandsmass-Referenzwert" MAP 0x1C46C4 GkfWU16 181.8962 luquant_w 0.00 181.8962 FORMAT "%8.4"
 /begin AXIS_DESCR COM_AXIS rl rel_ub_q0p75 8 0.00 191.3 AXIS_PTS_REF SRL08DMUB /end AXIS_DESCR
 /begin AXIS_DESCR COM_AXIS nmot nmot_ub_q40 8 0.00 10200. AXIS_PTS_REF SNM08DMUB /end AXIS_DESCR
/end CHARACTERISTIC
/begin CHARACTERISTIC KFLUARS "Kennfeld f¸r Laufunruhe-Abstandsmass-Referenzwert" MAP 0x1C4744 GkfWU16 181.8962 luquant_w 0.00 181.8962 FORMAT "%8.4"
 /begin AXIS_DESCR COM_AXIS rl rel_ub_q0p75 8 0.00 191.3 AXIS_PTS_REF SRL08DMUB /end AXIS_DESCR
 /begin AXIS_DESCR COM_AXIS nmot nmot_ub_q40 8 0.00 10200. AXIS_PTS_REF SNM08DMUB /end AXIS_DESCR
/end CHARACTERISTIC
/begin CHARACTERISTIC KFLURB "Kennfeld f¸r Laufunruhe-Referenz-Basiswert" MAP 0x1C41A8 GkfWU16 181.8962 luquant_w 0.00 181.8962 FORMAT "%8.4"
 /begin AXIS_DESCR COM_AXIS rl rel_ub_q0p75 8 0.00 191.3 AXIS_PTS_REF SRL08DMUB /end AXIS_DESCR
 /begin AXIS_DESCR COM_AXIS nmot nmot_ub_q40 8 0.00 10200. AXIS_PTS_REF SNM08DMUB /end AXIS_DESCR
/end CHARACTERISTIC
/begin CHARACTERISTIC KFLURB1 "Kennfeld f¸r Laufunruhe-Referenz-Basiswert" MAP 0x1C4228 GkfWU16 181.8962 luquant_w 0.00 181.8962 FORMAT "%8.4"
 /begin AXIS_DESCR COM_AXIS rl rel_ub_q0p75 8 0.00 191.3 AXIS_PTS_REF SRL08DMUB /end AXIS_DESCR
 /begin AXIS_DESCR COM_AXIS nmot nmot_ub_q40 8 0.00 10200. AXIS_PTS_REF SNM08DMUB /end AXIS_DESCR
/end CHARACTERISTIC
/begin CHARACTERISTIC KFLURB2 "Kennfeld f¸r Laufunruhe-Referenz-Basiswert" MAP 0x1C42A8 GkfWU16 181.8962 luquant_w 0.00 181.8962 FORMAT "%8.4"
 /begin AXIS_DESCR COM_AXIS rl rel_ub_q0p75 8 0.00 191.3 AXIS_PTS_REF SRL08DMUB /end AXIS_DESCR
 /begin AXIS_DESCR COM_AXIS nmot nmot_ub_q40 8 0.00 10200. AXIS_PTS_REF SNM08DMUB /end AXIS_DESCR
/end CHARACTERISTIC
/begin CHARACTERISTIC KFLURBS "Kennfeld f¸r Laufunruhe-Referenz-Basiswert" MAP 0x1C4328 GkfWU16 181.8962 luquant_w 0.00 181.8962 FORMAT "%8.4"
 /begin AXIS_DESCR COM_AXIS rl rel_ub_q0p75 8 0.00 191.3 AXIS_PTS_REF SRL08DMUB /end AXIS_DESCR
 /begin AXIS_DESCR COM_AXIS nmot nmot_ub_q40 8 0.00 10200. AXIS_PTS_REF SNM08DMUB /end AXIS_DESCR
/end CHARACTERISTIC
/begin CHARACTERISTIC KFLURM "Kennfeld f¸r Laufunruhe-Referenzwert zur Mehrfachaussetzererkennung ->Lum-Vergl." MAP 0x1C43A8 GkfWU16 181.8962 luquant_w 0.00 181.8962 FORMAT "%8.4"
 /begin AXIS_DESCR COM_AXIS rl rel_ub_q0p75 8 0.00 191.3 AXIS_PTS_REF SRL08DMUB /end AXIS_DESCR
 /begin AXIS_DESCR COM_AXIS nmot nmot_ub_q40 8 0.00 10200. AXIS_PTS_REF SNM08DMUB /end AXIS_DESCR
/end CHARACTERISTIC
/begin CHARACTERISTIC KFLURM1 "Kennfeld f¸r Laufunruhe-Referenzwert zur Mehrfachaussetzererkennung ->Lum-Vergl." MAP 0x1C4428 GkfWU16 181.8962 luquant_w 0.00 181.8962 FORMAT "%8.4"
 /begin AXIS_DESCR COM_AXIS rl rel_ub_q0p75 8 0.00 191.3 AXIS_PTS_REF SRL08DMUB /end AXIS_DESCR
 /begin AXIS_DESCR COM_AXIS nmot nmot_ub_q40 8 0.00 10200. AXIS_PTS_REF SNM08DMUB /end AXIS_DESCR
/end CHARACTERISTIC
/begin CHARACTERISTIC KFMODI "Kennfeld f¸r Aussetzermodi und deren Parameter" MAP 0x1C4856 KfAxU8AyU8SstxU16SstyU16WU16 65535.00 DEZ 0.00 65535.00 FORMAT "%8.2"
 /begin AXIS_DESCR STD_AXIS xkfmodi DEZ 6 0.00 65535.00 FORMAT "%8.2" DEPOSIT ABSOLUTE /end AXIS_DESCR
 /begin AXIS_DESCR STD_AXIS ykfmodi DEZ 8 0.00 65535.00 FORMAT "%8.2" DEPOSIT ABSOLUTE /end AXIS_DESCR
/end CHARACTERISTIC
/begin CHARACTERISTIC KFTDDNWNPA "Entprellzeit f¸r Setzen des Fehlers f¸r unplausible Stellung Einlaﬂnockenwelle" MAP 0x1CAA1E KfAxUwAyUwSstxUwSstyUwWUw 6553.500 t100msxs_uw_b6553p5 0.00 6553.500 FORMAT "%8.3"
 /begin AXIS_DESCR STD_AXIS toelk_w temp_q0p0234_o273 5 -273.1500 1262.827 FORMAT "%8.3" DEPOSIT ABSOLUTE /end AXIS_DESCR
 /begin AXIS_DESCR STD_AXIS nmot_w nmot_uw_q0p25 4 0.00 16383.75 FORMAT "%8.2" DEPOSIT ABSOLUTE /end AXIS_DESCR
/end CHARACTERISTIC
/begin CHARACTERISTIC KFTDDNWNPE "Entprellzeit f¸r Setzen des Fehlers f¸r unplausible Stellung Einlaﬂnockenwelle" MAP 0x1CAAC2 KfAxUwAyUwSstxUwSstyUwWUw 6553.500 t100msxs_uw_b6553p5 0.00 6553.500 FORMAT "%8.3"
 /begin AXIS_DESCR STD_AXIS toelk_w temp_q0p0234_o273 5 -273.1500 1262.827 FORMAT "%8.3" DEPOSIT ABSOLUTE /end AXIS_DESCR
 /begin AXIS_DESCR STD_AXIS nmot_w nmot_uw_q0p25 4 0.00 16383.75 FORMAT "%8.2" DEPOSIT ABSOLUTE /end AXIS_DESCR
/end CHARACTERISTIC
/begin CHARACTERISTIC KLIDXFONN1 "Kennlinie zur Definition des Bereichsindex" CURVE 0x1C403C GklWU8 255.0 dez 0.00 255.0 FORMAT "%5.1"
 /begin AXIS_DESCR COM_AXIS nmot_w nmot_uw_q0p25 10 0.00 16383.75 AXIS_PTS_REF SNM10DMUW1 /end AXIS_DESCR
/end CHARACTERISTIC
/begin CHARACTERISTIC KLIDXFONN2 "Kennlinie zur Definition des Bereichsindex" CURVE 0x1C4048 GklWU8 255.0 dez 0.00 255.0 FORMAT "%5.1"
 /begin AXIS_DESCR COM_AXIS nmot_w nmot_uw_q0p25 10 0.00 16383.75 AXIS_PTS_REF SNM10DMUW2 /end AXIS_DESCR
/end CHARACTERISTIC
/begin CHARACTERISTIC KLIDXFORL1 "Kennlinie zur Definition des Bereichsindex" CURVE 0x1C4054 GklWU8 255.0 dez 0.00 255.0 FORMAT "%5.1"
 /begin AXIS_DESCR COM_AXIS rl rel_ub_q0p75 5 0.00 191.3 AXIS_PTS_REF SRL05DMUB1 /end AXIS_DESCR
/end CHARACTERISTIC
/begin CHARACTERISTIC KLIDXFORL2 "Kennlinie zur Definition des Bereichsindex" CURVE 0x1C405C GklWU8 255.0 dez 0.00 255.0 FORMAT "%5.1"
 /begin AXIS_DESCR COM_AXIS rl rel_ub_q0p75 5 0.00 191.3 AXIS_PTS_REF SRL05DMUB2 /end AXIS_DESCR
/end CHARACTERISTIC
/begin CHARACTERISTIC KLTALUST "Zeitdauer Ausblendung der Aussetzererkennung nach Motorstart" CURVE 0x1CBBB8 KlAxU8SstxU8WU16 655.3500 t10msxs_uw_b655p35 0.00 655.3500 FORMAT "%8.4"
 /begin AXIS_DESCR STD_AXIS tmst temp_ub_q0p75_o48 4 -48.00 143.3 FORMAT "%5.1" DEPOSIT ABSOLUTE /end AXIS_DESCR
/end CHARACTERISTIC
/begin CHARACTERISTIC LURBRL "Laufunruhe-Referenzwert bei Fahrzeug steht" CURVE 0x1C45A8 KlAxU8SstxU8WU16 181.8962 luquant_w 0.00 181.8962 FORMAT "%8.4"
 /begin AXIS_DESCR STD_AXIS rl rel_ub_q0p75 4 0.00 191.3 FORMAT "%5.1" DEPOSIT ABSOLUTE /end AXIS_DESCR
/end CHARACTERISTIC
/begin CHARACTERISTIC LURKTM "Tmot-abh‰ngiger Laufunruhe-Referenz-Korrekturwert" CURVE 0x1C4568 GklWU16 181.8962 luquant_w 0.00 181.8962 FORMAT "%8.4"
 /begin AXIS_DESCR COM_AXIS tmot temp_ub_q0p75_o48 8 -48.00 143.3 AXIS_PTS_REF STM08DMUB /end AXIS_DESCR
/end CHARACTERISTIC
/begin CHARACTERISTIC LURMIN1 "Drehzahlabh. Laufunruhe-Referenz-Minimalwert 1" CURVE 0x1C4578 GklWU16 181.8962 luquant_w 0.00 181.8962 FORMAT "%8.4"
 /begin AXIS_DESCR COM_AXIS nmot nmot_ub_q40 8 0.00 10200. AXIS_PTS_REF SNM08DMUB /end AXIS_DESCR
/end CHARACTERISTIC
/begin CHARACTERISTIC LURMIN2 "Drehzahlabh. Laufunruhe-Referenz-Minimalwert 2" CURVE 0x1C4588 GklWU16 181.8962 luquant_w 0.00 181.8962 FORMAT "%8.4"
 /begin AXIS_DESCR COM_AXIS nmot nmot_ub_q40 8 0.00 10200. AXIS_PTS_REF SNM08DMUB /end AXIS_DESCR
/end CHARACTERISTIC
/begin CHARACTERISTIC LURMIN3 "Drehzahlabh. Laufunruhe-Referenz-Minimalwert 3" CURVE 0x1C4598 GklWU16 181.8962 luquant_w 0.00 181.8962 FORMAT "%8.4"
 /begin AXIS_DESCR COM_AXIS nmot nmot_ub_q40 8 0.00 10200. AXIS_PTS_REF SNM08DMUB /end AXIS_DESCR
/end CHARACTERISTIC
/begin CHARACTERISTIC MDERKFON "Anzahl Aussetzer f¸r Adaptionsstop (Heilung)" VALUE 0x1C40FE KwWU16 65535.00 dez 0.00 65535.00 FORMAT "%8.2" /end CHARACTERISTIC
/begin CHARACTERISTIC MILANTI "MIL ist bei ti-Abschaltung an, auch im 1.dcy" VALUE 0x1C4823 KwWU8 255.0 dez 0.00 255.0 FORMAT "%5.1" /end CHARACTERISTIC
/begin CHARACTERISTIC NFLUV "Drehzahlschwelle der Modifikation der Laufunruhe-Berechnung" VALUE 0x1C41A5 KwWU8 10200. nmot_ub_q40 0.00 10200. FORMAT "%5.0" /end CHARACTERISTIC
/begin CHARACTERISTIC NGALUN "Misfire Detection : Schwelle Drehzahl‰nderung f¸r Ausblendung" CURVE 0x1C4838 GklWS16 25599.94 nmotg_sw_q0p39 -12800.16 12799.77 FORMAT "%8.2"
 /begin AXIS_DESCR COM_AXIS nmot nmot_ub_q40 8 0.00 10200. AXIS_PTS_REF SNM08DMUB /end AXIS_DESCR
/end CHARACTERISTIC
/begin CHARACTERISTIC NMIALU "Min. Drehzahl f¸r Ausblendung der Aussetzererkennung" VALUE 0x1C4853 KwWU8 10200. nmot_ub_q40 0.00 10200. FORMAT "%5.0" /end CHARACTERISTIC
/begin CHARACTERISTIC NMXALU "Max. Drehzahl f¸r Ausblendung der Aussetzererkennung" VALUE 0x1C4854 KwWU8 10200. nmot_ub_q40 0.00 10200. FORMAT "%5.0" /end CHARACTERISTIC
/begin CHARACTERISTIC NWFDECA "Dekrementierung des Fehlerentprellz‰hlers Nockenwellensteller Auslaﬂ" VALUE 0x1CA9C0 KwUb 255.0 dez 0.00 255.0 FORMAT "%5.1" /end CHARACTERISTIC
/begin CHARACTERISTIC NWFDECE "Dekrementierung des Fehlerentprellz‰hlers Nockenwellensteller Einlaﬂ" VALUE 0x1CAA64 KwUb 255.0 dez 0.00 255.0 FORMAT "%5.1" /end CHARACTERISTIC
/begin CHARACTERISTIC NWFINCA "Inkrementierung des Fehlerentprellz‰hlers Nockenwellensteller Auslaﬂ" VALUE 0x1CA9C1 KwUb 255.0 dez 0.00 255.0 FORMAT "%5.1" /end CHARACTERISTIC
/begin CHARACTERISTIC NWFINCE "Inkrementierung des Fehlerentprellz‰hlers Nockenwellensteller Einlaﬂ" VALUE 0x1CAA65 KwUb 255.0 dez 0.00 255.0 FORMAT "%5.1" /end CHARACTERISTIC
/begin CHARACTERISTIC NWFMXA "Maximalwert des Fehlerentprellz‰hlers Nockenwellensteller Auslaﬂ f¸r Fehlereintr" VALUE 0x1CA9C2 KwUb 255.0 dez 0.00 255.0 FORMAT "%5.1" /end CHARACTERISTIC
/begin CHARACTERISTIC NWFMXE "Maximalwert des Fehlerentprellz‰hlers Nockenwellensteller Einlaﬂ f¸r Fehlereintr" VALUE 0x1CAA66 KwUb 255.0 dez 0.00 255.0 FORMAT "%5.1" /end CHARACTERISTIC
/begin CHARACTERISTIC NWFSPLA "Entprellz‰hlerstand  f¸r Fehlerspeicher lˆschen Nockenwellensteller Auslaﬂ" VALUE 0x1CA9C3 KwUb 255.0 dez 0.00 255.0 FORMAT "%5.1" /end CHARACTERISTIC
/begin CHARACTERISTIC NWFSPLE "Entprellz‰hlerstand  f¸r Fehlerspeicher lˆschen Nockenwellensteller Einlaﬂ" VALUE 0x1CAA67 KwUb 255.0 dez 0.00 255.0 FORMAT "%5.1" /end CHARACTERISTIC
/begin CHARACTERISTIC PGPRIO "Array mit Priorisierung der Phasengeber f¸r Synchronisation" VAL_BLK 0x1C660C KwbWU8 255.0 dez 0.00 255.0 FORMAT "%5.1" NUMBER 4 /end CHARACTERISTIC
/begin CHARACTERISTIC PHBM "Obergrenze f¸r die Entprellung der Bezugsmarkenfehler" VALUE 0x1C6610 KwWU8 125.0 dez 0.00 125.0 FORMAT "%5.1" /end CHARACTERISTIC
/begin CHARACTERISTIC PHNOKA "Anfangswert f¸r Z‰hler Phasensignal nicht ok" VALUE 0x1C6611 KwWU8 125.0 dez 0.00 125.0 FORMAT "%5.1" /end CHARACTERISTIC
/begin CHARACTERISTIC PHPOSERR "Obergrenze f¸r die Entprellung der Phasenflankenfehler" VALUE 0x1C6612 KwWU8 125.0 dez 0.00 125.0 FORMAT "%5.1" /end CHARACTERISTIC
/begin CHARACTERISTIC PWGNOTMA "maximal zul‰ssiger Pedal-Sollwert im PWG-Notfahren" VALUE 0x1D1FAA dc_KwUw 67.14072 DC_PER0327 0.00 67.14072 FORMAT "%8.5" /end CHARACTERISTIC
/begin CHARACTERISTIC PWGRAMP "Rampensteigung f¸r Pedalwertanstiegsbegrenzung im PWG-Notfahren" VALUE 0x1D1FA8 dc_KwUw 0.3906369 DC_PER0327 0.00 0.3906369 FORMAT "%9.7" /end CHARACTERISTIC
/begin CHARACTERISTIC RANDSEED "Startwert Zufallsgenerator" VALUE 0x1C48D6 KwWU16 65535.00 DEZ 0.00 65535.00 FORMAT "%8.2" /end CHARACTERISTIC
/begin CHARACTERISTIC RLSALULL "Lastschwelle zur Schuberkennung f¸r Ausblendung der Aussetzererkennung im LL" VALUE 0x1C4855 KwWU8 191.3 rel_ub_q0p75 0.00 191.3 FORMAT "%5.1" /end CHARACTERISTIC
/begin CHARACTERISTIC RLSALUN "Lastschwelle zur Schuberkennung f¸r Ausblendung der Aussetzererkennung" CURVE 0x1C4848 GklWU8 191.3 rel_ub_q0p75 0.00 191.3 FORMAT "%5.1"
 /begin AXIS_DESCR COM_AXIS nmot nmot_ub_q40 8 0.00 10200. AXIS_PTS_REF SNM08DMUB /end AXIS_DESCR
/end CHARACTERISTIC
/begin CHARACTERISTIC RMSLMNFAFL "min. rel. Sekund‰rluftmasse in Abh‰ngigkeit von Verd¸nnungsfaktor bei Kurztest" CURVE 0x1CBC1C KlAxU8SstxU16WU8 1.992 fak_q0p0078 0.00 1.992 FORMAT "%5.3"
 /begin AXIS_DESCR STD_AXIS lamssls_w fak_uw_b16 4 0.00 15.99976 FORMAT "%8.5" DEPOSIT ABSOLUTE /end AXIS_DESCR
/end CHARACTERISTIC
/begin CHARACTERISTIC RMSLMNFL "min. relative Sekund‰rluftmasse in Abh‰ngigkeit von Verd¸nnungsfaktor" CURVE 0x1CBC2A KlAxU8SstxU16WU8 1.992 fak_q0p0078 0.00 1.992 FORMAT "%5.3"
 /begin AXIS_DESCR STD_AXIS lamssls_w fak_uw_b16 4 0.00 15.99976 FORMAT "%8.5" DEPOSIT ABSOLUTE /end AXIS_DESCR
/end CHARACTERISTIC
/begin CHARACTERISTIC RMSLMNSTFL "min.rel. Sekund‰rluftmasse in Abh‰ngigkeit von Verd¸nnungsfakt. im Stat.-bereich" CURVE 0x1CBC38 KlAxU8SstxU16WU8 1.992 fak_q0p0078 0.00 1.992 FORMAT "%5.3"
 /begin AXIS_DESCR STD_AXIS lamssls_w fak_uw_b16 4 0.00 15.99976 FORMAT "%8.5" DEPOSIT ABSOLUTE /end AXIS_DESCR
/end CHARACTERISTIC
/begin CHARACTERISTIC RMSLMXSTFL "max.rel. Sekund‰rluftmasse in Abh‰ngigkeit von Verd¸nnungsfakt. im Stat.-bereich" CURVE 0x1CBC46 KlAxU8SstxU16WU8 1.992 fak_q0p0078 0.00 1.992 FORMAT "%5.3"
 /begin AXIS_DESCR STD_AXIS lamssls_w fak_uw_b16 4 0.00 15.99976 FORMAT "%8.5" DEPOSIT ABSOLUTE /end AXIS_DESCR
/end CHARACTERISTIC
/begin CHARACTERISTIC RMSLTMN "Schwelle: sehr geringe Sekund‰rluftmasse, ohne Offset" VALUE 0x1CBC64 KwWU8 1.992 fak_q0p0078 0.00 1.992 FORMAT "%5.3" /end CHARACTERISTIC
/begin CHARACTERISTIC RMSLVMXLA "maximal erlaubte Sekund‰rluftmasse bei Ventildichtigkeitscheck" CURVE 0x1CBC54 KlAxU8SstxU16WU8 1.992 fak_q0p0078 0.00 1.992 FORMAT "%5.3"
 /begin AXIS_DESCR STD_AXIS lamsoni_w fak_uw_b16 4 0.00 15.99976 FORMAT "%8.5" DEPOSIT ABSOLUTE /end AXIS_DESCR
/end CHARACTERISTIC
/begin CHARACTERISTIC SALUNKH "dmrkh-abh. Nullastfaktoren bei Katheizen" CURVE 0x1CBBC8 KlAxU8SstxU8WU8 1.992 fak_ub_b2 0.00 1.992 FORMAT "%5.3"
 /begin AXIS_DESCR STD_AXIS dmrkh rel_q0p39 4 0.00 99.61 FORMAT "%5.2" DEPOSIT ABSOLUTE /end AXIS_DESCR
/end CHARACTERISTIC
/begin CHARACTERISTIC SFONTM "Schwellwert tmot f¸r fuel-on Adaption aktiv" VALUE 0x1CBBD1 KwWU8 191.3 temp_ub_q0p75_o48 -48.00 143.3 FORMAT "%5.1" /end CHARACTERISTIC
/begin CHARACTERISTIC SIN08DMFL1 "St¸tzstellen KF Fuel-on-Adaption" VAL_BLK 0x1C40A4 KwbWR32 2.000000000000E+037 fak_r32_1 -1.000000000000E+037 1.000000000000E+037 FORMAT "%43.4" NUMBER 8 /end CHARACTERISTIC
/begin CHARACTERISTIC SIN08DMFL2 "St¸tzstellen KF Fuel-on-Adaption" VAL_BLK 0x1C40C4 KwbWR32 2.000000000000E+037 fak_r32_1 -1.000000000000E+037 1.000000000000E+037 FORMAT "%43.4" NUMBER 8 /end CHARACTERISTIC
/begin CHARACTERISTIC SIRL03DMF1 "St¸tzstellen KF Fuel-on-Adaption" VAL_BLK 0x1C40E4 KwbWR32 2.000000000000E+037 fak_r32_1 -1.000000000000E+037 1.000000000000E+037 FORMAT "%43.4" NUMBER 3 /end CHARACTERISTIC
/begin CHARACTERISTIC SIRL03DMF2 "St¸tzstellen KF Fuel-on-Adaption" VAL_BLK 0x1C40F0 KwbWR32 2.000000000000E+037 fak_r32_1 -1.000000000000E+037 1.000000000000E+037 FORMAT "%43.4" NUMBER 3 /end CHARACTERISTIC
/begin CHARACTERISTIC SLFOO1N "Obere Schwelle (Schwellwert-KL) f¸r Lernfilterwert bei fuel-on/-off Adaption" CURVE 0x1C3FFA GklWU16 181.8962 luquant_w 0.00 181.8962 FORMAT "%8.4"
 /begin AXIS_DESCR COM_AXIS nmot_w nmot_uw_q0p25 8 0.00 16383.75 AXIS_PTS_REF SNM08DMUW1 /end AXIS_DESCR
/end CHARACTERISTIC
/begin CHARACTERISTIC SLFOO2N "Obere Schwelle (Schwellwert-KL) f¸r Lernfilterwert bei fuel-on/-off Adaption" CURVE 0x1C400A GklWU16 181.8962 luquant_w 0.00 181.8962 FORMAT "%8.4"
 /begin AXIS_DESCR COM_AXIS nmot_w nmot_uw_q0p25 8 0.00 16383.75 AXIS_PTS_REF SNM08DMUW2 /end AXIS_DESCR
/end CHARACTERISTIC
/begin CHARACTERISTIC SLFOU1N "Untere Schwelle (Schwellwert-KL) f¸r Lernfilterwert bei fuel-on/-off Adaption" CURVE 0x1C401A GklWU16 181.8962 luquant_w 0.00 181.8962 FORMAT "%8.4"
 /begin AXIS_DESCR COM_AXIS nmot_w nmot_uw_q0p25 8 0.00 16383.75 AXIS_PTS_REF SNM08DMUW1 /end AXIS_DESCR
/end CHARACTERISTIC
/begin CHARACTERISTIC SLFOU2N "Untere Schwelle (Schwellwert-KL) f¸r Lernfilterwert bei fuel-on/-off Adaption" CURVE 0x1C402A GklWU16 181.8962 luquant_w 0.00 181.8962 FORMAT "%8.4"
 /begin AXIS_DESCR COM_AXIS nmot_w nmot_uw_q0p25 8 0.00 16383.75 AXIS_PTS_REF SNM08DMUW2 /end AXIS_DESCR
/end CHARACTERISTIC
/begin AXIS_PTS SNM08DMUB "SST-Verteilung in DMD, 8 Drehzahl-SST" 0x1C6764 nmot SstAUbSstUb 10200. nmot_ub_q40 8 0.00 10200. FORMAT "%5.0" DEPOSIT ABSOLUTE /end AXIS_PTS
/begin AXIS_PTS SNM08DMUW1 "St¸tzstellen KF Fuel-on-Adaption" 0x1C66CE nmot_w SstAU8SstU16 16383.75 nmot_uw_q0p25 8 0.00 16383.75 FORMAT "%8.2" DEPOSIT ABSOLUTE /end AXIS_PTS
/begin AXIS_PTS SNM08DMUW2 "St¸tzstellen KF Fuel-on-Adaption" 0x1C66E0 nmot_w SstAU8SstU16 16383.75 nmot_uw_q0p25 8 0.00 16383.75 FORMAT "%8.2" DEPOSIT ABSOLUTE /end AXIS_PTS
/begin AXIS_PTS SNM10DMUW1 "Bereichsgrenzen KF Fuel-on-Adaption" 0x1C4114 nmot_w SstAU8SstU16 16383.75 nmot_uw_q0p25 10 0.00 16383.75 FORMAT "%8.2" DEPOSIT ABSOLUTE /end AXIS_PTS
/begin AXIS_PTS SNM10DMUW2 "Bereichsgrenzen KF Fuel-on-Adaption" 0x1C412A nmot_w SstAU8SstU16 16383.75 nmot_uw_q0p25 10 0.00 16383.75 FORMAT "%8.2" DEPOSIT ABSOLUTE /end AXIS_PTS
/begin CHARACTERISTIC SP1MN_T "" VALUE 0x1D1FBA dc_KwUw 1310.7 DC_TIME_20MS_S16 0.00 1310.7 FORMAT "%6.1" /end CHARACTERISTIC
/begin CHARACTERISTIC SP1MX_T "" VALUE 0x1D1FC6 dc_KwUw 1310.7 DC_TIME_20MS_S16 0.00 1310.7 FORMAT "%6.1" /end CHARACTERISTIC
/begin CHARACTERISTIC SP1SMAX "obere Bereichsgrenze f¸r SP1S" VALUE 0x1D1FC8 dc_KwUw 24.92669 DC_APP_VOLT_U16 75.07331 100.0000 /end CHARACTERISTIC
/begin CHARACTERISTIC SP1SMIN "untere Bereichsgrenze f¸r SP1S" VALUE 0x1D1FBC dc_KwUw 12.51222 DC_APP_VOLT_U16 0.00 12.51222 FORMAT "%8.5" /end CHARACTERISTIC
/begin CHARACTERISTIC SP1S_KD_OF "Ausschaltbedingung f¸r KD-Ermittlung" VALUE 0x1D1FCC dc_KwUw 24.92669 DC_APP_VOLT_U16 75.07331 100.0000 /end CHARACTERISTIC
/begin CHARACTERISTIC SP1S_KD_ON "Einschaltbedingung f¸r KD-Ermittlung" VALUE 0x1D1FD0 dc_KwUw 24.92669 DC_APP_VOLT_U16 75.07331 100.0000 /end CHARACTERISTIC
/begin CHARACTERISTIC SP2MN_T "" VALUE 0x1D1FB6 dc_KwUw 1310.7 DC_TIME_20MS_S16 0.00 1310.7 FORMAT "%6.1" /end CHARACTERISTIC
/begin CHARACTERISTIC SP2MX_T "" VALUE 0x1D1FBE dc_KwUw 1310.7 DC_TIME_20MS_S16 0.00 1310.7 FORMAT "%6.1" /end CHARACTERISTIC
/begin CHARACTERISTIC SP2SMAX "obere Bereichsgrenze f¸r SP2S" VALUE 0x1D1FC0 dc_KwUw 24.92669 DC_APP_VOLT_U16 75.07331 100.0000 /end CHARACTERISTIC
/begin CHARACTERISTIC SP2SMIN "untere Bereichsgrenze f¸r SP2S" VALUE 0x1D1FB8 dc_KwUw 100.0000 DC_APP_VOLT_U16 0.00 100.0000 /end CHARACTERISTIC
/begin CHARACTERISTIC SP2S_KD_OF "Ausschaltbedingung f¸r KD-Ermittlung" VALUE 0x1D1FCA dc_KwUw 24.92669 DC_APP_VOLT_U16 75.07331 100.0000 /end CHARACTERISTIC
/begin CHARACTERISTIC SP2S_KD_ON "Einschaltbedingung f¸r KD-Ermittlung" VALUE 0x1D1FCE dc_KwUw 24.92669 DC_APP_VOLT_U16 75.07331 100.0000 /end CHARACTERISTIC
/begin CHARACTERISTIC SPS_MAX "obere Normierungsgrenze f¸r Sollwertpoti-Schleifer-Signal, min. Vollgaswert" VALUE 0x1D1FD2 dc_KwUw 49.95112 DC_APP_VOLT_U16 50.04888 100.0000 /end CHARACTERISTIC
/begin CHARACTERISTIC SPS_MIN "untere Normierungsgrenze f¸r Sollwertpoti-Schleifer-Signal, max. Leerlaufwert" VALUE 0x1D1FD4 dc_KwUw 49.95112 DC_APP_VOLT_U16 0.00 49.95112 FORMAT "%8.5" /end CHARACTERISTIC
/begin CHARACTERISTIC SPS_VG "Vollgas-Sollwert-Schwelle zur Umschaltung der maximalen Differenz SP1S-SP2S" VALUE 0x1D1FB4 dc_KwUw 75.07331 DC_APP_VOLT_U16 0.00 75.07331 FORMAT "%8.5" /end CHARACTERISTIC
/begin AXIS_PTS SRL05DMUB1 "Bereichsgrenzen KF Fuel-on-Adaption" 0x1C4140 rl SstAU8SstU8 191.3 rel_ub_q0p75 5 0.00 191.3 FORMAT "%5.1" DEPOSIT ABSOLUTE /end AXIS_PTS
/begin AXIS_PTS SRL05DMUB2 "Bereichsgrenzen KF Fuel-on-Adaption" 0x1C4148 rl SstAU8SstU8 191.3 rel_ub_q0p75 5 0.00 191.3 FORMAT "%5.1" DEPOSIT ABSOLUTE /end AXIS_PTS
/begin AXIS_PTS SRL08DMUB "SST-Verteilung in DMD, 8 Last-SST" 0x1C6808 rl SstAUbSstUb 191.3 rel_ub_q0p75 8 0.00 191.3 FORMAT "%5.1" DEPOSIT ABSOLUTE /end AXIS_PTS
/begin AXIS_PTS STM08DMUB "8 Motortemperaturst¸tzstellen f¸r DMD" 0x1CEE98 tmot SstAUbSstUb 191.3 temp_ub_q0p75_o48 8 -48.00 143.3 FORMAT "%5.1" DEPOSIT ABSOLUTE /end AXIS_PTS
/begin CHARACTERISTIC TAMIALU "Minimale Ansauglufttemperatur f¸r Ausblendung der Aussetzererkennung" VALUE 0x1CBBD2 KwWU8 191.3 temp_ub_q0p75_o48 -48.00 143.3 FORMAT "%5.1" /end CHARACTERISTIC
/begin CHARACTERISTIC TANWASTMN "minimales Tastverh‰ltnis f¸r setzen Zyklusflag Endstufendiagnose Nockenwelle" VALUE 0x1CAA5E KwWU16 655.350 vnstv_q0p01 0.00 655.350 FORMAT "%7.3" /end CHARACTERISTIC
/begin CHARACTERISTIC TANWASTMX "maximales Tastverh‰ltnis f¸r setzen Zyklusflag Endstufendiagnose Nockenwelle" VALUE 0x1CAA60 KwWU16 655.350 vnstv_q0p01 0.00 655.350 FORMAT "%7.3" /end CHARACTERISTIC
/begin CHARACTERISTIC TANWESTMN "minimales Tastverh‰ltnis f¸r setzen Zyklusflag Endstufendiagnose Nockenwelle" VALUE 0x1CAB02 KwWU16 655.350 vnstv_q0p01 0.00 655.350 FORMAT "%7.3" /end CHARACTERISTIC
/begin CHARACTERISTIC TANWESTMX "maximales Tastverh‰ltnis f¸r setzen Zyklusflag Endstufendiagnose Nockenwelle" VALUE 0x1CAB04 KwWU16 655.350 vnstv_q0p01 0.00 655.350 FORMAT "%7.3" /end CHARACTERISTIC
/begin CHARACTERISTIC TC6CSL "Mode 6: Component ID f¸r Pr¸fung Sekund‰rluftsystem" VALUE 0x1CBC65 KwWU8 127.0 dez 0.00 127.0 FORMAT "%5.1" /end CHARACTERISTIC
/begin CHARACTERISTIC TC6CSL2 "Mode 6: Component ID f¸r Pr¸fung Sekund‰rluftsystem, Bank 2" VALUE 0x1CBC66 KwWU8 127.0 dez 0.00 127.0 FORMAT "%5.1" /end CHARACTERISTIC
/begin CHARACTERISTIC TC6CSLDKH "Mode 6: Component ID f¸r Pr¸fung Sekund‰rluftsystem ¸ber Diagnose Katheizen" VALUE 0x1CBC67 KwWU8 127.0 dez 0.00 127.0 FORMAT "%5.1" /end CHARACTERISTIC
/begin CHARACTERISTIC TC6CSLDKH2 "Mode 6: Component ID f¸r Pr¸fung Sek.-luftsystem ¸ber Diagnose Katheizen, bank2" VALUE 0x1CBC68 KwWU8 127.0 dez 0.00 127.0 FORMAT "%5.1" /end CHARACTERISTIC
/begin CHARACTERISTIC TC6CSLF "Mode 6: Component ID f¸r Pr¸fung gefilterter Sekund‰rluftmittelwert" VALUE 0x1CBC69 KwWU8 127.0 dez 0.00 127.0 FORMAT "%5.1" /end CHARACTERISTIC
/begin CHARACTERISTIC TC6CSLF2 "Mode 6: Component ID f¸r Pr¸fung gefilterter Sekund‰rluftmittelwert(Bank2)" VALUE 0x1CBC6A KwWU8 127.0 dez 0.00 127.0 FORMAT "%5.1" /end CHARACTERISTIC
/begin CHARACTERISTIC TC6CSLK "Mode 6: Component ID f¸r Pr¸fung Sekund‰rluftsystem; Kurztest" VALUE 0x1CBC6B KwWU8 127.0 dez 0.00 127.0 FORMAT "%5.1" /end CHARACTERISTIC
/begin CHARACTERISTIC TC6CSLK2 "Mode 6: Component ID f¸r Pr¸fung Sekund‰rluftsystem, Bank 2; Kurztest" VALUE 0x1CBC6C KwWU8 127.0 dez 0.00 127.0 FORMAT "%5.1" /end CHARACTERISTIC
/begin CHARACTERISTIC TC6CSLN "Mode 6: Component ID f¸r Pr¸fung minimale Sekund‰rluft in Phase 1" VALUE 0x1CBC6D KwWU8 127.0 dez 0.00 127.0 FORMAT "%5.1" /end CHARACTERISTIC
/begin CHARACTERISTIC TC6CSLN2 "Mode 6: Component ID f¸r Pr¸fung minimale Sekund‰rluft in Phase 1, Bank 2" VALUE 0x1CBC6E KwWU8 127.0 dez 0.00 127.0 FORMAT "%5.1" /end CHARACTERISTIC
/begin CHARACTERISTIC TC6CSLV "Mode 6: Component ID f¸r Pr¸fung Dichtheit SL-Ventil" VALUE 0x1CBC6F KwWU8 127.0 dez 0.00 127.0 FORMAT "%5.1" /end CHARACTERISTIC
/begin CHARACTERISTIC TC6CSLV2 "Mode 6: Component ID f¸r Pr¸fung Dichtheit SL-Ventil, Bank 2" VALUE 0x1CBC70 KwWU8 127.0 dez 0.00 127.0 FORMAT "%5.1" /end CHARACTERISTIC
/begin CHARACTERISTIC TC6CSLVDK2 "Mode 6: Component ID f¸r Pr¸fung Dichtheit SL-Ventil ¸ber Diagnose Katheizen" VALUE 0x1CBC71 KwWU8 127.0 dez 0.00 127.0 FORMAT "%5.1" /end CHARACTERISTIC
/begin CHARACTERISTIC TC6CSLVDKH "Mode 6: Component ID f¸r Pr¸fung Dichtheit SL-Ventil ¸ber Diagnose Katheizen" VALUE 0x1CBC72 KwWU8 127.0 dez 0.00 127.0 FORMAT "%5.1" /end CHARACTERISTIC
/begin CHARACTERISTIC TDREPFSA "Entprellzeit Fehlerheilung Pin Schalter Fahrstufe aus" VALUE 0x1CF63F KwUb 12.75 t50msxs_ub_b12p75 0.00 12.75 FORMAT "%5.2" /end CHARACTERISTIC
/begin CHARACTERISTIC TDREPFSE "Entprellzeit Fehlerheilung Pin Schalter Fahrstufe ein" VALUE 0x1CF640 KwUb 12.75 t50msxs_ub_b12p75 0.00 12.75 FORMAT "%5.2" /end CHARACTERISTIC
/begin CHARACTERISTIC TDRMSLMN "Zeitverzˆgerung f¸r aktuelle minimale relative Sekund‰rluftmasse" VALUE 0x1CBC73 KwWU8 25.50 t_q0p1 0.00 25.50 FORMAT "%5.2" /end CHARACTERISTIC
/begin CHARACTERISTIC TDSEPFSA "Entprellzeit Fehlersetzbedingung Pin Schalter Fahrstufe aus" VALUE 0x1CF641 KwUb 12.75 t50msxs_ub_b12p75 0.00 12.75 FORMAT "%5.2" /end CHARACTERISTIC
/begin CHARACTERISTIC TDSEPFSE "Entprellzeit Fehlersetzbedingung Pin Schalter Fahrstufe ein" VALUE 0x1CF642 KwUb 12.75 t50msxs_ub_b12p75 0.00 12.75 FORMAT "%5.2" /end CHARACTERISTIC
/begin CHARACTERISTIC TLAED "Wartezeit bis Fehlerlampe aus nach Start" VALUE 0x1C3CDA KwUb 51.00 t200msxs_ub_b51 0.00 51.00 FORMAT "%5.2" /end CHARACTERISTIC
/begin CHARACTERISTIC TMASKIV1 "Temperaturschwelle f¸r Verl‰gerung 1. KAT-Intervall, Aussetzererkennung" VALUE 0x1C4824 KwWU8 191.3 temp_ub_q0p75_o48 -48.00 143.3 FORMAT "%5.1" /end CHARACTERISTIC
/begin CHARACTERISTIC TNALU "Testphasenl‰nge nach erkanntem Aussetzer" VALUE 0x1C415C KwWU8 255.0 dez 0.00 255.0 FORMAT "%5.1" /end CHARACTERISTIC
/begin CHARACTERISTIC T_GRDT "" VALUE 0x1D3110 dc_KwUb 5.100 DC_TQ20 0.00 5.100 FORMAT "%5.3" /end CHARACTERISTIC
/begin CHARACTERISTIC T_KD_PW "Kick-Down-Entprellzeit" VALUE 0x1D3111 dc_KwUb 5.100 DC_TQ20 0.00 5.100 FORMAT "%5.3" /end CHARACTERISTIC
/begin CHARACTERISTIC UPVGMAX "obere Grenze f¸r Potiversorgungsspannung" VALUE 0x1D1FAE dc_KwSw 127.9980 DC_VOLT_S16 -64.00000 63.99805 /end CHARACTERISTIC
/begin CHARACTERISTIC UPVGMIN "untere Grenze f¸r Potiversorgungsspannung" VALUE 0x1D1FB0 dc_KwSw 127.9980 DC_VOLT_S16 -64.00000 63.99805 /end CHARACTERISTIC
/begin CHARACTERISTIC UPVG_T "" VALUE 0x1D1FAC dc_KwUw 1310.7 DC_TIME_20MS_S16 0.00 1310.7 FORMAT "%6.1" /end CHARACTERISTIC
/begin CHARACTERISTIC WNWHA "Nockenwellensollposition f¸r Setzen des Zyklusflags ohne Fehler Auslass" VALUE 0x1CAA5C KwSw 511.0000 kw_sw_q0p0078 -256.0000 255.0000 FORMAT "%8.4" /end CHARACTERISTIC
/begin CHARACTERISTIC WNWHE "Nockenwellensollposition f¸r Setzen des Zyklusflags ohne Fehler Einlass" VALUE 0x1CAB00 KwSw 511.0000 kw_sw_q0p0078 -256.0000 255.0000 FORMAT "%8.4" /end CHARACTERISTIC
/begin CHARACTERISTIC ZAGRUN "Start des Aussetzergenerators" VALUE 0x1C48D9 KwWU8 255.0 DEZ 0.00 255.0 FORMAT "%5.1" /end CHARACTERISTIC
/begin CHARACTERISTIC ZKNWVDA "Zeitkonstante Nockenwellenverstellung Auslass Diagnose" VALUE 0x1CA9C4 KwUb 25.40 zk100msxs_q0p1 0.1000 25.50 FORMAT "%5.2" /end CHARACTERISTIC
/begin CHARACTERISTIC ZKNWVDE "Zeitkonstante Nockenwellenverstellung Einlass Diagnose" VALUE 0x1CAA68 KwUb 25.40 zk100msxs_q0p1 0.1000 25.50 FORMAT "%5.2" /end CHARACTERISTIC
/begin CHARACTERISTIC ZKNWVDSA "Zeitkonstante Nockenwellenverstellung Sollwinkel Auslass Diagnose" VALUE 0x1CA9C5 KwUb 25.40 zk100msxs_q0p1 0.1000 25.50 FORMAT "%5.2" /end CHARACTERISTIC
/begin CHARACTERISTIC ZKNWVDSE "Zeitkonstante Nockenwellenverstellung Sollwinkel Einlass Diagnose" VALUE 0x1CAA69 KwUb 25.40 zk100msxs_q0p1 0.1000 25.50 FORMAT "%5.2" /end CHARACTERISTIC
/begin CHARACTERISTIC ZYLKOR "Wert zur Zylinderkorrektur (tsroh zu zzyldmd)" VALUE 0x1C48DE KwWU8 255.0 dez 0.00 255.0 FORMAT "%5.1" /end CHARACTERISTIC
/begin MEASUREMENT abgsmw_w "" UWORD dez 1 100 0 12000 FORMAT "%8.2" ECU_ADDRESS 0x800742 /end MEASUREMENT
/begin MEASUREMENT ACCompr1_Sw_Mode "" UBYTE DC_FLAG_U8 1 100 0 1 BIT_MASK 0x1 FORMAT "%5.3" ECU_ADDRESS 0x8038BF /end MEASUREMENT
/begin MEASUREMENT ACCompr1_Trq_Plaus "" UBYTE DC_M3NM 1 100 0 765 FORMAT "%5.1" ECU_ADDRESS 0x8038BE /end MEASUREMENT
/begin MEASUREMENT ACCompr2_Sw_Mode "" UBYTE DC_FLAG_U8 1 100 0 1 BIT_MASK 0x1 FORMAT "%5.3" ECU_ADDRESS 0x8038BD /end MEASUREMENT
/begin MEASUREMENT ACCompr2_Trq_Plaus "" UBYTE DC_M3NM 1 100 0 765 FORMAT "%5.1" ECU_ADDRESS 0x8038BC /end MEASUREMENT
/begin MEASUREMENT ACCompr_RefriPress_Plaus "" UBYTE DC_UPAC 1 100 0 127.5 FORMAT "%5.1" ECU_ADDRESS 0x8038BB /end MEASUREMENT
/begin MEASUREMENT ACCompr_Sw_Mode "" UBYTE DC_FLAG_U8 1 100 0 1 BIT_MASK 0x1 FORMAT "%5.3" ECU_ADDRESS 0x8038BA /end MEASUREMENT
/begin MEASUREMENT ACCompr_Trq_Plaus "" UBYTE DC_M3NM 1 100 0 765 FORMAT "%5.1" ECU_ADDRESS 0x8038B9 /end MEASUREMENT
/begin MEASUREMENT afnmn "Bereichsfenster Aussetzer, minimale Drehzahl" UBYTE nmot_ub_q40 1 100 0 10200 FORMAT "%5.0" ECU_ADDRESS 0x7FC6F8 /end MEASUREMENT
/begin MEASUREMENT afnmx "Bereichsfenster Aussetzer, maximale Drehzahl" UBYTE nmot_ub_q40 1 100 0 10200 FORMAT "%5.0" ECU_ADDRESS 0x7FC6F9 /end MEASUREMENT
/begin MEASUREMENT afrlmn "Bereichsfenster Aussetzer, minimale Last" UBYTE rel_ub_q0p75 1 100 0 191.25 FORMAT "%5.1" ECU_ADDRESS 0x7FC6FA /end MEASUREMENT
/begin MEASUREMENT afrlmx "Bereichsfenster Aussetzer, maximale Last" UBYTE rel_ub_q0p75 1 100 0 191.25 FORMAT "%5.1" ECU_ADDRESS 0x7FC6FB /end MEASUREMENT
/begin MEASUREMENT aftnmn "Bereichsfenster Aussetzer, minimale Drehzahl, tempor‰r" UBYTE nmot_ub_q40 1 100 0 10200 FORMAT "%5.0" ECU_ADDRESS 0x800F08 /end MEASUREMENT
/begin MEASUREMENT aftnmx "Bereichsfenster Aussetzer, maximale Drehzahl, tempor‰r" UBYTE nmot_ub_q40 1 100 0 10200 FORMAT "%5.0" ECU_ADDRESS 0x800F09 /end MEASUREMENT
/begin MEASUREMENT aftrlmn "Bereichsfenster Aussetzer, minimale Last, tempor‰r" UBYTE rel_ub_q0p75 1 100 0 191.25 FORMAT "%5.1" ECU_ADDRESS 0x800F0A /end MEASUREMENT
/begin MEASUREMENT aftrlmx "Bereichsfenster Aussetzer, maximale Last, tempor‰r" UBYTE rel_ub_q0p75 1 100 0 191.25 FORMAT "%5.1" ECU_ADDRESS 0x800F0B /end MEASUREMENT
/begin MEASUREMENT ahearv_w "Aussetzerh‰ufigkeit zum Erreichen der Ausblendung anderer Funktionen (aus AHEARV" UWORD dez 1 100 0 65535 FORMAT "%8.2" ECU_ADDRESS 0x800744 /end MEASUREMENT
/begin MEASUREMENT aint_zyl "" UBYTE dez 1 100 0 255 FORMAT "%5.1" ARRAY_SIZE 12 ECU_ADDRESS 0x800F0C /end MEASUREMENT
/begin MEASUREMENT anfslslc "Art der Anforderung der Sekund‰rluftsteuerung (lokales Bit)" UBYTE dez 1 100 0 255 FORMAT "%5.1" ECU_ADDRESS 0x8007CE /end MEASUREMENT
/begin MEASUREMENT anwfoh_w "z‰hlt Anzahl der NW-Umdr. f¸r Heilung der fuel-on/-off Adaption" UWORD dez 1 100 0 65535 FORMAT "%8.2" ECU_ADDRESS 0x8019C0 /end MEASUREMENT
/begin MEASUREMENT anwfos_w "z‰hlt Anzahl der NW-Umdr. von Bedingungen f¸r Adaption erf¸llt bis Lernbeginn" UWORD dez 1 100 0 65535 FORMAT "%8.2" ECU_ADDRESS 0x8019C2 /end MEASUREMENT
/begin MEASUREMENT anzinten "" UBYTE dez 1 100 0 255 FORMAT "%5.1" ECU_ADDRESS 0x800F18 /end MEASUREMENT
/begin MEASUREMENT APEmergSPSMIN_Mode "" UBYTE DC_FLAG_U8 1 100 0 1 BIT_MASK 0x1 FORMAT "%5.3" ECU_ADDRESS 0x80393C /end MEASUREMENT
/begin MEASUREMENT APEmerg_Mode "" UBYTE DC_FLAG_U8 1 100 0 1 BIT_MASK 0x1 FORMAT "%5.3" ECU_ADDRESS 0x80393D /end MEASUREMENT
/begin MEASUREMENT APP "Sollwertvorgabe, normierter Pedalwert (15 Bit)" UWORD DC_PER0327 1 100 0 100 FORMAT "%8.4" ECU_ADDRESS 0x803344 /end MEASUREMENT
/begin MEASUREMENT APPoti12Diff "" UWORD DC_APP_VOLT_U16 1 100 0 100 ECU_ADDRESS 0x80334E /end MEASUREMENT
/begin MEASUREMENT APPoti12Diff_Cntr "" UBYTE DC_TIME_20MS_S16 1 100 0 5.1 ECU_ADDRESS 0x7FC878 /end MEASUREMENT
/begin MEASUREMENT APPoti12Diff_Err "" UBYTE DC_FLAG_U8 1 100 0 1 BIT_MASK 0x1 FORMAT "%5.3" ECU_ADDRESS 0x803946 /end MEASUREMENT
/begin MEASUREMENT APPoti12Diff_Mode "" UBYTE DC_FLAG_U8 1 100 0 1 BIT_MASK 0x1 FORMAT "%5.3" ECU_ADDRESS 0x803947 /end MEASUREMENT
/begin MEASUREMENT APPoti12Min "" UWORD DC_APP_VOLT_U16 1 100 0 100 ECU_ADDRESS 0x80334C /end MEASUREMENT
/begin MEASUREMENT APPoti1Less2_Mode "" UBYTE DC_FLAG_U8 1 100 0 1 BIT_MASK 0x1 FORMAT "%5.3" ECU_ADDRESS 0x803939 /end MEASUREMENT
/begin MEASUREMENT APPoti1Max_Cntr "" UBYTE DC_TIME_20MS_S16 1 100 0 5.1 ECU_ADDRESS 0x7FC870 /end MEASUREMENT
/begin MEASUREMENT APPoti1Max_Err "" UBYTE DC_FLAG_U8 1 100 0 1 BIT_MASK 0x1 FORMAT "%5.3" ECU_ADDRESS 0x80393E /end MEASUREMENT
/begin MEASUREMENT APPoti1Max_Mode "" UBYTE DC_FLAG_U8 1 100 0 1 BIT_MASK 0x1 FORMAT "%5.3" ECU_ADDRESS 0x80393F /end MEASUREMENT
/begin MEASUREMENT APPoti1Min_Cntr "" UBYTE DC_TIME_20MS_S16 1 100 0 5.1 ECU_ADDRESS 0x7FC872 /end MEASUREMENT
/begin MEASUREMENT APPoti1Min_Err "" UBYTE DC_FLAG_U8 1 100 0 1 BIT_MASK 0x1 FORMAT "%5.3" ECU_ADDRESS 0x803940 /end MEASUREMENT
/begin MEASUREMENT APPoti1Min_Mode "" UBYTE DC_FLAG_U8 1 100 0 1 BIT_MASK 0x1 FORMAT "%5.3" ECU_ADDRESS 0x803941 /end MEASUREMENT
/begin MEASUREMENT APPoti1RefInput_Mode "" UBYTE DC_FLAG_U8 1 100 0 1 BIT_MASK 0x1 FORMAT "%5.3" ECU_ADDRESS 0x80393A /end MEASUREMENT
/begin MEASUREMENT APPoti2Max_Cntr "" UBYTE DC_TIME_20MS_S16 1 100 0 5.1 ECU_ADDRESS 0x7FC874 /end MEASUREMENT
/begin MEASUREMENT APPoti2Max_Err "" UBYTE DC_FLAG_U8 1 100 0 1 BIT_MASK 0x1 FORMAT "%5.3" ECU_ADDRESS 0x803942 /end MEASUREMENT
/begin MEASUREMENT APPoti2Max_Mode "" UBYTE DC_FLAG_U8 1 100 0 1 BIT_MASK 0x1 FORMAT "%5.3" ECU_ADDRESS 0x803943 /end MEASUREMENT
/begin MEASUREMENT APPoti2Min_Cntr "" UBYTE DC_TIME_20MS_S16 1 100 0 5.1 ECU_ADDRESS 0x7FC876 /end MEASUREMENT
/begin MEASUREMENT APPoti2Min_Err "" UBYTE DC_FLAG_U8 1 100 0 1 BIT_MASK 0x1 FORMAT "%5.3" ECU_ADDRESS 0x803944 /end MEASUREMENT
/begin MEASUREMENT APPoti2Min_Mode "" UBYTE DC_FLAG_U8 1 100 0 1 BIT_MASK 0x1 FORMAT "%5.3" ECU_ADDRESS 0x803945 /end MEASUREMENT
/begin MEASUREMENT APPoti2RefInput_Mode "" UBYTE DC_FLAG_U8 1 100 0 1 BIT_MASK 0x1 FORMAT "%5.3" ECU_ADDRESS 0x80393B /end MEASUREMENT
/begin MEASUREMENT APPoti2To1 "" UWORD DC_APP_VOLT_U16 1 100 0 100 ECU_ADDRESS 0x803350 /end MEASUREMENT
/begin MEASUREMENT APPotiHyst "" UWORD DC_APP_VOLT_U16 1 100 0 100 ECU_ADDRESS 0x803356 /end MEASUREMENT
/begin MEASUREMENT APPotiLin "" UWORD DC_PER0327 1 100 0 100 FORMAT "%8.4" ECU_ADDRESS 0x803354 /end MEASUREMENT
/begin MEASUREMENT APPotiPlaus "" UWORD DC_APP_VOLT_U16 1 100 0 100 ECU_ADDRESS 0x80334A /end MEASUREMENT
/begin MEASUREMENT APPoti_MaxInc "" UWORD DC_PER0327 1 100 0 100 FORMAT "%8.4" ECU_ADDRESS 0x803346 /end MEASUREMENT
/begin MEASUREMENT APPoti_Req "" UWORD DC_PER0327 1 100 0 100 FORMAT "%8.4" ECU_ADDRESS 0x803348 /end MEASUREMENT
/begin MEASUREMENT APPoti_SupplyVolt_Cntr "" UBYTE DC_TIME_20MS_S16 1 100 0 5.1 ECU_ADDRESS 0x803352 /end MEASUREMENT
/begin MEASUREMENT APPoti_SupplyVolt_Err "" UBYTE DC_FLAG_U8 1 100 0 1 BIT_MASK 0x1 FORMAT "%5.3" ECU_ADDRESS 0x803948 /end MEASUREMENT
/begin MEASUREMENT APPoti_SupplyVolt_OK_Mode "" UBYTE DC_FLAG_U8 1 100 0 1 BIT_MASK 0x1 FORMAT "%5.3" ECU_ADDRESS 0x803938 /end MEASUREMENT
/begin MEASUREMENT AP_Grdt "" SWORD DC_AP_GRDT_S16 1 100 -32768 32767 FORMAT "%8.2" ECU_ADDRESS 0x803340 /end MEASUREMENT
/begin MEASUREMENT AP_Grdt_Unfiltd "" SWORD DC_AP_GRDT_S16 1 100 -32768 32767 FORMAT "%8.2" ECU_ADDRESS 0x803342 /end MEASUREMENT
/begin MEASUREMENT azycntb "" UBYTE dez 1 100 0 255 FORMAT "%5.1" ARRAY_SIZE 4 ECU_ADDRESS 0x800F1C /end MEASUREMENT
/begin MEASUREMENT bbsp1 "Byte f¸r Bedingung B_sp1 als Triggerevent in DCLA" UBYTE dez 1 100 0 255 FORMAT "%5.1" ECU_ADDRESS 0x801164 /end MEASUREMENT
/begin MEASUREMENT bbsp2 "Byte f¸r Bedingung B_sp2 als Triggerevent in DCLA" UBYTE dez 1 100 0 255 FORMAT "%5.1" ECU_ADDRESS 0x801165 /end MEASUREMENT
/begin MEASUREMENT bfnmn "Bereichsfenster Motorbetrieb, minimale Drehzahl" UBYTE nmot_ub_q40 1 100 0 10200 FORMAT "%5.0" ECU_ADDRESS 0x80074C /end MEASUREMENT
/begin MEASUREMENT bfnmx "Bereichsfenster Motorbetrieb, maximale Drehzahl" UBYTE nmot_ub_q40 1 100 0 10200 FORMAT "%5.0" ECU_ADDRESS 0x80074D /end MEASUREMENT
/begin MEASUREMENT bfrlmn "Bereichsfenster Motorbetrieb, minimale Last" UBYTE rel_ub_q0p75 1 100 0 191.25 FORMAT "%5.1" ECU_ADDRESS 0x80074E /end MEASUREMENT
/begin MEASUREMENT bfrlmx "Bereichsfenster Motorbetrieb, maximale Last" UBYTE rel_ub_q0p75 1 100 0 191.25 FORMAT "%5.1" ECU_ADDRESS 0x80074F /end MEASUREMENT
/begin MEASUREMENT bssp "Speicherwert Signal Beschleunigungssensor" UWORD acc_uw_b55p55 1 100 0 55.5547 FORMAT "%8.5" ECU_ADDRESS 0x8015F2 /end MEASUREMENT
/begin MEASUREMENT B_afklt "Bereichsfenster Aussetzer, Bedingung kalt, TMOT<TMWUC" UBYTE B_TRUE 1 100 0 1 BIT_MASK 0x1 FORMAT "%13.11" ECU_ADDRESS 0x7FC6D8 /end MEASUREMENT
/begin MEASUREMENT B_aftklt "Bereichsfenster Aussetzer, tempor‰r, Bedingung kalt, TMOT<TMWUC" UBYTE B_TRUE 1 100 0 1 BIT_MASK 0x1 FORMAT "%13.11" ECU_ADDRESS 0x800E3C /end MEASUREMENT
/begin MEASUREMENT B_aftwrm "Bereichsfenster Aussetzer, tempor‰r, Bedingung warm, TMOT>TMWUC" UBYTE B_TRUE 1 100 0 1 BIT_MASK 0x1 FORMAT "%13.11" ECU_ADDRESS 0x800E3D /end MEASUREMENT
/begin MEASUREMENT B_afwrm "Bereichsfenster Aussetzer, Bedingung warm, TMOT>TMWUC" UBYTE B_TRUE 1 100 0 1 BIT_MASK 0x1 FORMAT "%13.11" ECU_ADDRESS 0x7FC6D9 /end MEASUREMENT
/begin MEASUREMENT B_ainten "" UBYTE B_TRUE 1 100 0 1 BIT_MASK 0x1 FORMAT "%13.11" ECU_ADDRESS 0x800E3E /end MEASUREMENT
/begin MEASUREMENT B_analu "Ausblendung nach dem ersten erkannten Aussetzer l‰uft" UBYTE B_TRUE 1 100 0 1 BIT_MASK 0x1 FORMAT "%13.11" ECU_ADDRESS 0x800E35 /end MEASUREMENT
/begin MEASUREMENT B_anzrmsl "Bedingung Anzahl der ausgewerteten RMSL-Messungen grˆﬂer als Schwellwert" UBYTE B_TRUE 1 100 0 1 BIT_MASK 0x1 FORMAT "%13.11" ECU_ADDRESS 0x8007D2 /end MEASUREMENT
/begin MEASUREMENT B_anzrmsl2 "Bedingung Anzahl der ausgewerteten RMSL-Messungen grˆﬂer als Schwellwert, Bank2" UBYTE B_TRUE 1 100 0 1 BIT_MASK 0x2 FORMAT "%13.11" ECU_ADDRESS 0x8007D2 /end MEASUREMENT
/begin MEASUREMENT B_bfklt "Bereichsfenster Motorbetrieb, Bedingung kalt, TMOT<TMWUC" UBYTE B_TRUE 1 100 0 1 BIT_MASK 0x1 FORMAT "%13.11" ECU_ADDRESS 0x800E3F /end MEASUREMENT
/begin MEASUREMENT B_bfwrm "Bereichsfenster Motorbetrieb, Bedingung warm, TMOT>TMWUC" UBYTE B_TRUE 1 100 0 1 BIT_MASK 0x1 FORMAT "%13.11" ECU_ADDRESS 0x800E40 /end MEASUREMENT
/begin MEASUREMENT B_blkeb "MIL-Ansteuerung blinkend eigenbestimmt" UBYTE B_TRUE 1 100 0 1 BIT_MASK 0x4 FORMAT "%13.11" ECU_ADDRESS 0x801160 /end MEASUREMENT
/begin MEASUREMENT B_blkmd "MIL-Ansteuerung blinkend durch Aussetzererkennung" UBYTE B_TRUE 1 100 0 1 BIT_MASK 0x1 FORMAT "%13.11" ECU_ADDRESS 0x800E41 /end MEASUREMENT
/begin MEASUREMENT B_com1 "Allgemeine Stopbits f¸r LU und FON" UBYTE B_TRUE 1 100 0 1 BIT_MASK 0x1 FORMAT "%13.11" ECU_ADDRESS 0x800E51 /end MEASUREMENT
/begin MEASUREMENT B_com2 "Allgemeine Stopbits f¸r LU, FON und FOF" UBYTE B_TRUE 1 100 0 1 BIT_MASK 0x1 FORMAT "%13.11" ECU_ADDRESS 0x800E52 /end MEASUREMENT
/begin MEASUREMENT B_edges "" UBYTE B_TRUE 1 100 0 1 BIT_MASK 0x1 FORMAT "%13.11" ECU_ADDRESS 0x800E53 /end MEASUREMENT
/begin MEASUREMENT B_ehfs "Bedingung Ersatzwert Hauptf¸llungssensor" UBYTE B_TRUE 1 100 0 1 BIT_MASK 0x1 FORMAT "%13.11" ECU_ADDRESS 0x7FA6AD /end MEASUREMENT
/begin MEASUREMENT B_enph2bm "Freigabe der Phasenpegel¸berwachung an BM f¸r PG2 (nur Master)" UBYTE B_TRUE 1 100 0 1 BIT_MASK 0x1 FORMAT "%13.11" ECU_ADDRESS 0x80101B /end MEASUREMENT
/begin MEASUREMENT B_enph3bm "Freigabe der Phasenpegel¸berwachung an BM f¸r PG3 (nur Master)" UBYTE B_TRUE 1 100 0 1 BIT_MASK 0x1 FORMAT "%13.11" ECU_ADDRESS 0x80101C /end MEASUREMENT
/begin MEASUREMENT B_enph4bm "Freigabe der Phasenpegel¸berwachung an BM f¸r PG4 (nur Master)" UBYTE B_TRUE 1 100 0 1 BIT_MASK 0x1 FORMAT "%13.11" ECU_ADDRESS 0x80101D /end MEASUREMENT
/begin MEASUREMENT B_enphbm "Freigabe der Phasenpegel¸berwachung an BM f¸r PG1 (nur Master)" UBYTE B_TRUE 1 100 0 1 BIT_MASK 0x1 FORMAT "%13.11" ECU_ADDRESS 0x80101A /end MEASUREMENT
/begin MEASUREMENT B_enws "Bedingung Fehler Nockenwellenansteuerung liegt vor" UBYTE B_TRUE 1 100 0 1 BIT_MASK 0x1 FORMAT "%13.11" ECU_ADDRESS 0x8010EE /end MEASUREMENT
/begin MEASUREMENT B_enwsa "Bedingung Error Nockenwelle (Auslaﬂsietig)" UBYTE B_TRUE 1 100 0 1 BIT_MASK 0x10 FORMAT "%13.11" ECU_ADDRESS 0x8010EE /end MEASUREMENT
/begin MEASUREMENT B_enwse "Bedingung Error Nockenwelle (Einlaﬂseitig)" UBYTE B_TRUE 1 100 0 1 BIT_MASK 0x4 FORMAT "%13.11" ECU_ADDRESS 0x8010EE /end MEASUREMENT
/begin MEASUREMENT B_enwsva "Bedingung Fehlerverdacht Nockenwellensteller Auslass" UBYTE B_TRUE 1 100 0 1 BIT_MASK 0x1 FORMAT "%13.11" ECU_ADDRESS 0x8005BA /end MEASUREMENT
/begin MEASUREMENT B_enwsva2 "Bedingung Fehlerverdacht Nockenwellensteller Auslass2" UBYTE B_TRUE 1 100 0 1 BIT_MASK 0x4 FORMAT "%13.11" ECU_ADDRESS 0x8005BA /end MEASUREMENT
/begin MEASUREMENT B_enwsve "Bedingung Fehlerverdacht Nockenwellensteller Einlass" UBYTE B_TRUE 1 100 0 1 BIT_MASK 0x1 FORMAT "%13.11" ECU_ADDRESS 0x8005CE /end MEASUREMENT
/begin MEASUREMENT B_enwsve2 "Bedingung Fehlerverdacht Nockenwellensteller Einlass2" UBYTE B_TRUE 1 100 0 1 BIT_MASK 0x4 FORMAT "%13.11" ECU_ADDRESS 0x8005CE /end MEASUREMENT
/begin MEASUREMENT B_ermsl "Bedingung fehlerhafte relative Sekund‰rluftmasse" UBYTE B_TRUE 1 100 0 1 BIT_MASK 0x4 FORMAT "%13.11" ECU_ADDRESS 0x8007D2 /end MEASUREMENT
/begin MEASUREMENT B_ermsl2 "Bedingung fehlerhafte relative Sekund‰rluftmasse, Bank2" UBYTE B_TRUE 1 100 0 1 BIT_MASK 0x8 FORMAT "%13.11" ECU_ADDRESS 0x8007D2 /end MEASUREMENT
/begin MEASUREMENT B_ermslfa "Bedingung fehlerhafte minimale relative Sekund‰rluftmasse bei Kurztest" UBYTE B_TRUE 1 100 0 1 BIT_MASK 0x10 FORMAT "%13.11" ECU_ADDRESS 0x8007D2 /end MEASUREMENT
/begin MEASUREMENT B_ermslfa2 "Bedingung fehlerhafte minimale relative Sekund‰rluftmasse bei Kurztest" UBYTE B_TRUE 1 100 0 1 BIT_MASK 0x20 FORMAT "%13.11" ECU_ADDRESS 0x8007D2 /end MEASUREMENT
/begin MEASUREMENT B_ermslmn "Bedingung fehlerhafte minimale relative Sekund‰rluftmasse" UBYTE B_TRUE 1 100 0 1 BIT_MASK 0x40 FORMAT "%13.11" ECU_ADDRESS 0x8007D2 /end MEASUREMENT
/begin MEASUREMENT B_ermslmn2 "Bedingung fehlerhafte minimale relative Sekund‰rluftmasse" UBYTE B_TRUE 1 100 0 1 BIT_MASK 0x80 FORMAT "%13.11" ECU_ADDRESS 0x8007D2 /end MEASUREMENT
/begin MEASUREMENT B_ermslst "Bedingung fehlerhafte minimale relative Sekund‰rluftmasse im Statiskbereich" UBYTE B_TRUE 1 100 0 1 BIT_MASK 0x1 FORMAT "%13.11" ECU_ADDRESS 0x8007D3 /end MEASUREMENT
/begin MEASUREMENT B_ermslst2 "Bedingung fehlerhafte minimale relative Sekund‰rluftmasse im Statiskbereich" UBYTE B_TRUE 1 100 0 1 BIT_MASK 0x2 FORMAT "%13.11" ECU_ADDRESS 0x8007D3 /end MEASUREMENT
/begin MEASUREMENT B_error1 "" UBYTE B_TRUE 1 100 0 1 BIT_MASK 0x1 FORMAT "%13.11" ECU_ADDRESS 0x800764 /end MEASUREMENT
/begin MEASUREMENT B_error26 "" UBYTE B_TRUE 1 100 0 1 BIT_MASK 0x1 FORMAT "%13.11" ECU_ADDRESS 0x800765 /end MEASUREMENT
/begin MEASUREMENT B_error3 "" UBYTE B_TRUE 1 100 0 1 BIT_MASK 0x1 FORMAT "%13.11" ECU_ADDRESS 0x800766 /end MEASUREMENT
/begin MEASUREMENT B_error5 "" UBYTE B_TRUE 1 100 0 1 BIT_MASK 0x1 FORMAT "%13.11" ECU_ADDRESS 0x800767 /end MEASUREMENT
/begin MEASUREMENT B_error7 "" UBYTE B_TRUE 1 100 0 1 BIT_MASK 0x1 FORMAT "%13.11" ECU_ADDRESS 0x800768 /end MEASUREMENT
/begin MEASUREMENT B_esls "Bedingung Falschluft durch Fehler im Sekund‰rluftsystem" UBYTE B_TRUE 1 100 0 1 BIT_MASK 0x1 FORMAT "%13.11" ECU_ADDRESS 0x8007CF /end MEASUREMENT
/begin MEASUREMENT B_fedkb "Bedingung F¸llungserfassung drosselklappenbasiert" UBYTE B_TRUE 1 100 0 1 BIT_MASK 0x1 FORMAT "%13.11" ECU_ADDRESS 0x7FA6AE /end MEASUREMENT
/begin MEASUREMENT B_fgzodsl "Bedingung Freigabe der Setzbedingung des Zyklusflags (Bank1)" UBYTE B_TRUE 1 100 0 1 BIT_MASK 0x4 FORMAT "%13.11" ECU_ADDRESS 0x8007D3 /end MEASUREMENT
/begin MEASUREMENT B_fgzodsl2 "Bedingung Freigabe der Setzbedingung des Zyklusflags (Bank2)" UBYTE B_TRUE 1 100 0 1 BIT_MASK 0x8 FORMAT "%13.11" ECU_ADDRESS 0x8007D3 /end MEASUREMENT
/begin MEASUREMENT B_fhfs "Bedingung: Fehler Hauptf¸llungssensor" UBYTE B_TRUE 1 100 0 1 BIT_MASK 0x1 FORMAT "%13.11" ECU_ADDRESS 0x7FA6AF /end MEASUREMENT
/begin MEASUREMENT B_fnwaktv "Fehler bei Nockenwellenverstellung Ein- oder Auslaﬂ gerade vorhanden" UBYTE B_TRUE 1 100 0 1 BIT_MASK 0x2 FORMAT "%13.11" ECU_ADDRESS 0x8010EE /end MEASUREMENT
/begin MEASUREMENT B_fnwaktva "Fehler bei Nockenwellenverstellung Auslaﬂ gerade vorhanden (nicht entprellt)" UBYTE B_TRUE 1 100 0 1 BIT_MASK 0x20 FORMAT "%13.11" ECU_ADDRESS 0x8010EE /end MEASUREMENT
/begin MEASUREMENT B_fnwaktve "Fehler bei Nockenwellenverstellung Einlaﬂ gerade vorhanden (nicht entprellt)" UBYTE B_TRUE 1 100 0 1 BIT_MASK 0x8 FORMAT "%13.11" ECU_ADDRESS 0x8010EE /end MEASUREMENT
/begin MEASUREMENT B_fnwstva "Fehler Auslaﬂnockenwellensteller gerade vorhanden (nicht entprellt)" UBYTE B_TRUE 1 100 0 1 BIT_MASK 0x2 FORMAT "%13.11" ECU_ADDRESS 0x8005BB /end MEASUREMENT
/begin MEASUREMENT B_fnwstva2 "Fehler Auslaﬂnockenwellensteller 2 gerade vorhanden (nicht entprellt)" UBYTE B_TRUE 1 100 0 1 BIT_MASK 0x4 FORMAT "%13.11" ECU_ADDRESS 0x8005BB /end MEASUREMENT
/begin MEASUREMENT B_fnwstve "Fehler Einlaﬂnockenwellensteller gerade vorhanden (nicht entprellt)" UBYTE B_TRUE 1 100 0 1 BIT_MASK 0x20 FORMAT "%13.11" ECU_ADDRESS 0x8005CE /end MEASUREMENT
/begin MEASUREMENT B_fnwstve2 "Fehler Einlaﬂnockenwellensteller 2 gerade vorhanden (nicht entprellt)" UBYTE B_TRUE 1 100 0 1 BIT_MASK 0x80 FORMAT "%13.11" ECU_ADDRESS 0x8005CE /end MEASUREMENT
/begin MEASUREMENT B_fodon "Bedingung fuel-on Adaption in drehzahldominantem Bereich aktiv" UBYTE B_TRUE 1 100 0 1 BIT_MASK 0x20 FORMAT "%13.11" ECU_ADDRESS 0x800EC9 /end MEASUREMENT
/begin MEASUREMENT B_fofstp "Bedingung fuel-off Adaption gestoppt" UBYTE B_TRUE 1 100 0 1 BIT_MASK 0x1 FORMAT "%13.11" ECU_ADDRESS 0x800E54 /end MEASUREMENT
/begin MEASUREMENT B_fohe "aktueller Bereich ist ein Heilbereich" UBYTE B_TRUE 1 100 0 1 BIT_MASK 0x40 FORMAT "%13.11" ECU_ADDRESS 0x800EC9 /end MEASUREMENT
/begin MEASUREMENT B_fohold "fuel-on Adaption angehalten" UBYTE B_TRUE 1 100 0 1 BIT_MASK 0x80 FORMAT "%13.11" ECU_ADDRESS 0x800EC9 /end MEASUREMENT
/begin MEASUREMENT B_fokstp "Bedingung fuel-on Adaption gestoppt (Adaption + Korrektur)" UBYTE B_TRUE 1 100 0 1 BIT_MASK 0x1 FORMAT "%13.11" ECU_ADDRESS 0x800E55 /end MEASUREMENT
/begin MEASUREMENT B_fondis "Bedingung fuel-on Adaption gestoppt" UBYTE B_TRUE 1 100 0 1 BIT_MASK 0x1 FORMAT "%13.11" ECU_ADDRESS 0x800ECA /end MEASUREMENT
/begin MEASUREMENT B_fonresf "Reset der Fuel-On Adaption durchgef¸hrt" UBYTE B_TRUE 1 100 0 1 BIT_MASK 0x1 FORMAT "%13.11" ECU_ADDRESS 0x800E33 /end MEASUREMENT
/begin MEASUREMENT B_fonrset "Reset der fuel-on Adaption" UBYTE B_TRUE 1 100 0 1 BIT_MASK 0x4 FORMAT "%13.11" ECU_ADDRESS 0x800ECA /end MEASUREMENT
/begin MEASUREMENT B_fonstp "Bedingung fuel-on Adaption gestoppt" UBYTE B_TRUE 1 100 0 1 BIT_MASK 0x1 FORMAT "%13.11" ECU_ADDRESS 0x800E56 /end MEASUREMENT
/begin MEASUREMENT B_fontm "Motortemperatur gen¸gend hoch f¸r fuel-on-Adaption" UBYTE B_TRUE 1 100 0 1 BIT_MASK 0x1 FORMAT "%13.11" ECU_ADDRESS 0x800769 /end MEASUREMENT
/begin MEASUREMENT B_for "Bedingung fuel-on/-off Adaption aktuell ready" UBYTE B_TRUE 1 100 0 1 BIT_MASK 0x10 FORMAT "%13.11" ECU_ADDRESS 0x800EC9 /end MEASUREMENT
/begin MEASUREMENT B_fora "Bedingung fuel-on Adaption aktuell ready (Array)" UBYTE default 1 100 0 1 FORMAT "%5.3" ARRAY_SIZE 24 ECU_ADDRESS 0x7FC698 /end MEASUREMENT
/begin MEASUREMENT B_forn "Bedingung fuel-on/-off Adaption aktueller Drehzahlbereich ready" UBYTE B_TRUE 1 100 0 1 BIT_MASK 0x8 FORMAT "%13.11" ECU_ADDRESS 0x800EC9 /end MEASUREMENT
/begin MEASUREMENT B_forna "Bedingung fuel-on Adaption aktueller Drehzahlbereich ready (Array)" UBYTE default 1 100 0 1 FORMAT "%5.3" ARRAY_SIZE 9 ECU_ADDRESS 0x7FC6B0 /end MEASUREMENT
/begin MEASUREMENT B_forun "Status fuel-on/-off Adaption aktiv" UBYTE B_TRUE 1 100 0 1 BIT_MASK 0x4 FORMAT "%13.11" ECU_ADDRESS 0x800EC9 /end MEASUREMENT
/begin MEASUREMENT B_forun0 "Status fuel-on/-off Adaption aktiv" UBYTE B_TRUE 1 100 0 1 BIT_MASK 0x2 FORMAT "%13.11" ECU_ADDRESS 0x800EC9 /end MEASUREMENT
/begin MEASUREMENT B_fph1bm "Fehler des Phasenpegels an der Bezugsmarke von PG1" UBYTE B_TRUE 1 100 0 1 BIT_MASK 0x4 FORMAT "%13.11" ECU_ADDRESS 0x800C9E /end MEASUREMENT
/begin MEASUREMENT B_fph2bm "Fehler des Phasenpegels an der Bezugsmarke von PG2" UBYTE B_TRUE 1 100 0 1 BIT_MASK 0x8 FORMAT "%13.11" ECU_ADDRESS 0x800C9E /end MEASUREMENT
/begin MEASUREMENT B_fph3bm "Fehler des Phasenpegels an der Bezugsmarke von PG3" UBYTE B_TRUE 1 100 0 1 BIT_MASK 0x10 FORMAT "%13.11" ECU_ADDRESS 0x800C9E /end MEASUREMENT
/begin MEASUREMENT B_fph4bm "Fehler des Phasenpegels an der Bezugsmarke von PG4" UBYTE B_TRUE 1 100 0 1 BIT_MASK 0x20 FORMAT "%13.11" ECU_ADDRESS 0x800C9E /end MEASUREMENT
/begin MEASUREMENT B_hlanws "Bedingung Heilung des Fehlers der Auslassnockenwellensteuerung" UBYTE B_TRUE 1 100 0 1 BIT_MASK 0x2 FORMAT "%13.11" ECU_ADDRESS 0x8005BA /end MEASUREMENT
/begin MEASUREMENT B_hlanws2 "Bedingung Heilung des Fehlers der Auslassnockenwellensteuerung Bank2" UBYTE B_TRUE 1 100 0 1 BIT_MASK 0x8 FORMAT "%13.11" ECU_ADDRESS 0x8005BA /end MEASUREMENT
/begin MEASUREMENT B_hlenws "Bedingung Heilung des Fehlers der Einlassnockenwellensteuerung" UBYTE B_TRUE 1 100 0 1 BIT_MASK 0x2 FORMAT "%13.11" ECU_ADDRESS 0x8005CE /end MEASUREMENT
/begin MEASUREMENT B_hlenws2 "Bedingung Heilung des Fehlers der Einlassnockenwellensteuerung Bank2" UBYTE B_TRUE 1 100 0 1 BIT_MASK 0x8 FORMAT "%13.11" ECU_ADDRESS 0x8005CE /end MEASUREMENT
/begin MEASUREMENT B_ivzabg1 "" UBYTE B_TRUE 1 100 0 1 BIT_MASK 0x1 FORMAT "%13.11" ECU_ADDRESS 0x800E42 /end MEASUREMENT
/begin MEASUREMENT B_ivzkat1 "" UBYTE B_TRUE 1 100 0 1 BIT_MASK 0x1 FORMAT "%13.11" ECU_ADDRESS 0x800E43 /end MEASUREMENT
/begin MEASUREMENT B_kmmil "MIL-Ansteuerung mit Relevanz zu Kilometererfassung" UBYTE B_TRUE 1 100 0 1 BIT_MASK 0x1 FORMAT "%13.11" ECU_ADDRESS 0x7FA6A9 /end MEASUREMENT
/begin MEASUREMENT B_lcnpanw "lokales Bit f¸r NP-Fehler der NWS (Auslaﬂ, Bank1)" UBYTE B_TRUE 1 100 0 1 BIT_MASK 0x10 FORMAT "%13.11" ECU_ADDRESS 0x8005BA /end MEASUREMENT
/begin MEASUREMENT B_lcnpanw2 "lokales Bit f¸r NP-Fehler der NWS (Auslaﬂ, Bank2)" UBYTE B_TRUE 1 100 0 1 BIT_MASK 0x20 FORMAT "%13.11" ECU_ADDRESS 0x8005BA /end MEASUREMENT
/begin MEASUREMENT B_lcnpenw "lokales Bit f¸r NP-Fehler der NWS (Einlaﬂ, Bank1)" UBYTE B_TRUE 1 100 0 1 BIT_MASK 0x10 FORMAT "%13.11" ECU_ADDRESS 0x8005CE /end MEASUREMENT
/begin MEASUREMENT B_lcnpenw2 "lokales Bit f¸r NP-Fehler der NWS (Einlaﬂ, Bank2)" UBYTE B_TRUE 1 100 0 1 BIT_MASK 0x40 FORMAT "%13.11" ECU_ADDRESS 0x8005CE /end MEASUREMENT
/begin MEASUREMENT B_luaerk "Aussetzer erkannt ¸ber Laufunruhe Abstandsmass, aus DMDLUA" UBYTE B_TRUE 1 100 0 1 BIT_MASK 0x1 FORMAT "%13.11" ECU_ADDRESS 0x800E3B /end MEASUREMENT
/begin MEASUREMENT B_luerk "Aussetzer erkannt, aus DMDLU" UBYTE B_TRUE 1 100 0 1 BIT_MASK 0x1 FORMAT "%13.11" ECU_ADDRESS 0x800E39 /end MEASUREMENT
/begin MEASUREMENT B_luerk_t "" UBYTE B_TRUE 1 100 0 1 BIT_MASK 0x1 FORMAT "%13.11" ECU_ADDRESS 0x800E3A /end MEASUREMENT
/begin MEASUREMENT B_lustop "Laufunruhe-Berechnung gesperrt" UBYTE B_TRUE 1 100 0 1 BIT_MASK 0x1 FORMAT "%13.11" ECU_ADDRESS 0x800E57 /end MEASUREMENT
/begin MEASUREMENT B_mdarv "kritische Aussetzerrate vorhanden" UBYTE B_TRUE 1 100 0 1 BIT_MASK 0x1 FORMAT "%13.11" ECU_ADDRESS 0x800E44 /end MEASUREMENT
/begin MEASUREMENT B_mddrla "Bedingung Misfire Detection Lastgradient f¸r Aussetzererkennung" UBYTE B_TRUE 1 100 0 1 BIT_MASK 0x1 FORMAT "%13.11" ECU_ADDRESS 0x800E58 /end MEASUREMENT
/begin MEASUREMENT B_mderk "Aussetzer erkannt, Verkn¸pfung mehrerer Funktionen" UBYTE B_TRUE 1 100 0 1 BIT_MASK 0x1 FORMAT "%13.11" ECU_ADDRESS 0x800E36 /end MEASUREMENT
/begin MEASUREMENT B_mdkat "Katsch‰digende Aussetzerrate ¸berschritten (zur Ausblendung anderer Funktionen)" UBYTE B_TRUE 1 100 0 1 BIT_MASK 0x1 FORMAT "%13.11" ECU_ADDRESS 0x800E45 /end MEASUREMENT
/begin MEASUREMENT B_mdng "Bedingung Misfire Detection Drehzahlgradient f¸r Aussetzererkennung" UBYTE B_TRUE 1 100 0 1 BIT_MASK 0x1 FORMAT "%13.11" ECU_ADDRESS 0x800E59 /end MEASUREMENT
/begin MEASUREMENT B_mdnmn "Bedingung Misfire Detection untere Drehzahlgrenze" UBYTE B_TRUE 1 100 0 1 BIT_MASK 0x1 FORMAT "%13.11" ECU_ADDRESS 0x800E5A /end MEASUREMENT
/begin MEASUREMENT B_mdnmx "Bedingung Misfire Detection obere Drehzahlgrenze" UBYTE B_TRUE 1 100 0 1 BIT_MASK 0x1 FORMAT "%13.11" ECU_ADDRESS 0x800E5B /end MEASUREMENT
/begin MEASUREMENT B_mdrl "Bedingung Misfire Detection untere Lastgrenze" UBYTE B_TRUE 1 100 0 1 BIT_MASK 0x1 FORMAT "%13.11" ECU_ADDRESS 0x800E5C /end MEASUREMENT
/begin MEASUREMENT B_mdstim "Z¸ndungs-Aussetzer eingestellt, Stimuli-Signal vom Aussetzergenerator" UBYTE B_TRUE 1 100 0 1 BIT_MASK 0x1 FORMAT "%13.11" ECU_ADDRESS 0x800E38 /end MEASUREMENT
/begin MEASUREMENT B_mdstop "Misfire Detection gesperrt" UBYTE B_TRUE 1 100 0 1 BIT_MASK 0x1 FORMAT "%13.11" ECU_ADDRESS 0x800E5D /end MEASUREMENT
/begin MEASUREMENT B_mdtnst "Bedingung Misfire Detection Zeit nach Startende" UBYTE B_TRUE 1 100 0 1 BIT_MASK 0x1 FORMAT "%13.11" ECU_ADDRESS 0x80076A /end MEASUREMENT
/begin MEASUREMENT B_mdzag "Bedingung Aussetzer angefordert, Stimuli-Signal vom SW - Aussetzergenerator" UBYTE B_TRUE 1 100 0 1 BIT_MASK 0x1 FORMAT "%13.11" ECU_ADDRESS 0x800E77 /end MEASUREMENT
/begin MEASUREMENT B_mdzgstp "Aussetzererkennung und Zylindergleichstellung gesperrt" UBYTE B_TRUE 1 100 0 1 BIT_MASK 0x1 FORMAT "%13.11" ECU_ADDRESS 0x800E5E /end MEASUREMENT
/begin MEASUREMENT B_mil "MIL-Ansteuerung" UBYTE B_TRUE 1 100 0 1 BIT_MASK 0x1 FORMAT "%13.11" ECU_ADDRESS 0x7FA6AA /end MEASUREMENT
/begin MEASUREMENT B_milblk "MIL-Ansteuerung blinkend" UBYTE B_TRUE 1 100 0 1 BIT_MASK 0x8 FORMAT "%13.11" ECU_ADDRESS 0x801160 /end MEASUREMENT
/begin MEASUREMENT B_mileb "MIL-Ansteuerung eigenbestimmt" UBYTE B_TRUE 1 100 0 1 BIT_MASK 0x2 FORMAT "%13.11" ECU_ADDRESS 0x801160 /end MEASUREMENT
/begin MEASUREMENT B_milmd "MIL-Ansteuerung an durch Aussetzererkennung, bei ti-Abschaltung" UBYTE B_TRUE 1 100 0 1 BIT_MASK 0x1 FORMAT "%13.11" ECU_ADDRESS 0x800E46 /end MEASUREMENT
/begin MEASUREMENT B_milst "MIL-Ansteuerung Prueffunktion bei Start" UBYTE B_TRUE 1 100 0 1 BIT_MASK 0x1 FORMAT "%13.11" ECU_ADDRESS 0x801160 /end MEASUREMENT
/begin MEASUREMENT B_milstat "MIL - Status f¸r Scan Tool Mode $01 PID $01" UBYTE B_TRUE 1 100 0 1 BIT_MASK 0x1 FORMAT "%13.11" ECU_ADDRESS 0x7FA6AB /end MEASUREMENT
/begin MEASUREMENT B_milstp "Auswertung Aussetzererkennung (%DMDMIL) gesperrt" UBYTE B_TRUE 1 100 0 1 BIT_MASK 0x1 FORMAT "%13.11" ECU_ADDRESS 0x800E5F /end MEASUREMENT
/begin MEASUREMENT B_mnslspr "Fehlerart lokal: Sekund‰rluftmasse zu gering" UBYTE B_TRUE 1 100 0 1 BIT_MASK 0x2 FORMAT "%13.11" ECU_ADDRESS 0x8007CF /end MEASUREMENT
/begin MEASUREMENT B_mnslspr2 "Fehlerart lokal: Sekund‰rluftmasse zu gering, Bank 2" UBYTE B_TRUE 1 100 0 1 BIT_MASK 0x4 FORMAT "%13.11" ECU_ADDRESS 0x8007CF /end MEASUREMENT
/begin MEASUREMENT B_mslmin "Bedingung sehr geringe Sekund‰rluftmasse aus Meﬂphase" UBYTE B_TRUE 1 100 0 1 BIT_MASK 0x8 FORMAT "%13.11" ECU_ADDRESS 0x8007CF /end MEASUREMENT
/begin MEASUREMENT B_mslmin2 "Bedingung sehr geringe Sekund‰rluftmasse aus Meﬂphase (Bank 2)" UBYTE B_TRUE 1 100 0 1 BIT_MASK 0x10 FORMAT "%13.11" ECU_ADDRESS 0x8007CF /end MEASUREMENT
/begin MEASUREMENT B_mslmn "Bedingung zu wenig Sekund‰rluftmasse" UBYTE B_TRUE 1 100 0 1 BIT_MASK 0x20 FORMAT "%13.11" ECU_ADDRESS 0x8007CF /end MEASUREMENT
/begin MEASUREMENT B_mxslvpr "Fehlerart lokal: Sekund‰rluftmasse bei Ventildichtheitspr¸fung zu groﬂ" UBYTE B_TRUE 1 100 0 1 BIT_MASK 0x40 FORMAT "%13.11" ECU_ADDRESS 0x8007CF /end MEASUREMENT
/begin MEASUREMENT B_mxslvpr2 "Fehlerart lokal: Sekund‰rluftmasse bei Ventildichtheitspr¸fung zu groﬂ, Bank 2" UBYTE B_TRUE 1 100 0 1 BIT_MASK 0x80 FORMAT "%13.11" ECU_ADDRESS 0x8007CF /end MEASUREMENT
/begin MEASUREMENT B_nomil "MIL-Ansteuerung verriegelt" UBYTE B_TRUE 1 100 0 1 BIT_MASK 0x1 FORMAT "%13.11" ECU_ADDRESS 0x7FA6AC /end MEASUREMENT
/begin MEASUREMENT B_nopg "Kein Phasengeber funktionst¸chtig" UBYTE B_TRUE 1 100 0 1 BIT_MASK 0x1 FORMAT "%13.11" ECU_ADDRESS 0x800C9E /end MEASUREMENT
/begin MEASUREMENT B_nwnpoka "Plaus-Fehlerpr¸fung  mindestens einmal ohne Fehler Auslassnockenwelle" UBYTE B_TRUE 1 100 0 1 BIT_MASK 0x2 FORMAT "%13.11" ECU_ADDRESS 0x8005BC /end MEASUREMENT
/begin MEASUREMENT B_nwnpoka2 "Plaus-Fehlerpr¸fung  mindestens einmal ohne Fehler Auslassnockenwelle 2" UBYTE B_TRUE 1 100 0 1 BIT_MASK 0x10 FORMAT "%13.11" ECU_ADDRESS 0x8005BC /end MEASUREMENT
/begin MEASUREMENT B_nwnpoke "Plaus-Fehlerpr¸fung  mindestens einmal ohne Fehler Einlassnockenwelle" UBYTE B_TRUE 1 100 0 1 BIT_MASK 0x2 FORMAT "%13.11" ECU_ADDRESS 0x8005CF /end MEASUREMENT
/begin MEASUREMENT B_nwnpoke2 "Plaus-Fehlerpr¸fung  mindestens einmal ohne Fehler Einlassnockenwelle 2" UBYTE B_TRUE 1 100 0 1 BIT_MASK 0x10 FORMAT "%13.11" ECU_ADDRESS 0x8005CF /end MEASUREMENT
/begin MEASUREMENT B_ph2flok "Keine Abweichung der Phasenflanken im Arbeitsspiel f¸r PG2" UBYTE B_TRUE 1 100 0 1 BIT_MASK 0x1 FORMAT "%13.11" ECU_ADDRESS 0x801019 /end MEASUREMENT
/begin MEASUREMENT B_ph3flok "Keine Abweichung der Phasenflanken im Arbeitsspiel f¸r PG3" UBYTE B_TRUE 1 100 0 1 BIT_MASK 0x2 FORMAT "%13.11" ECU_ADDRESS 0x801019 /end MEASUREMENT
/begin MEASUREMENT B_ph4flok "Keine Abweichung der Phasenflanken im Arbeitsspiel f¸r PG4" UBYTE B_TRUE 1 100 0 1 BIT_MASK 0x4 FORMAT "%13.11" ECU_ADDRESS 0x801019 /end MEASUREMENT
/begin MEASUREMENT B_phflok "Keine Abweichung der Phasenflanken im Arbeitsspiel f¸r PG1" UBYTE B_TRUE 1 100 0 1 BIT_MASK 0x8 FORMAT "%13.11" ECU_ADDRESS 0x801019 /end MEASUREMENT
/begin MEASUREMENT B_plok "Plausibilit‰t der FSE-Werte in allen Drehzahlbereichen gegeben" UBYTE B_TRUE 1 100 0 1 BIT_MASK 0x2 FORMAT "%13.11" ECU_ADDRESS 0x800ECA /end MEASUREMENT
/begin MEASUREMENT B_ploka "Plausibilit‰t der FSE-Werte in allen Drehzahlbereichen gegeben (Array)" UBYTE default 1 100 0 1 FORMAT "%5.3" ARRAY_SIZE 9 ECU_ADDRESS 0x7FC6BC /end MEASUREMENT
/begin MEASUREMENT B_range "" UBYTE B_TRUE 1 100 0 1 BIT_MASK 0x1 FORMAT "%13.11" ECU_ADDRESS 0x800E60 /end MEASUREMENT
/begin MEASUREMENT B_reini "Bedingung Reinitialisierung des Aussetzergenerators" UBYTE B_TRUE 1 100 0 1 BIT_MASK 0x1 FORMAT "%13.11" ECU_ADDRESS 0x80077A /end MEASUREMENT
/begin MEASUREMENT B_resreq "" UBYTE B_TRUE 1 100 0 1 BIT_MASK 0x1 FORMAT "%13.11" ECU_ADDRESS 0x800720 /end MEASUREMENT
/begin MEASUREMENT B_rmslausw "Bedingung berechnete relative Sekund‰rluftmasse kann ausgewertet werden" UBYTE B_TRUE 1 100 0 1 BIT_MASK 0x1 FORMAT "%13.11" ECU_ADDRESS 0x8007D0 /end MEASUREMENT
/begin MEASUREMENT B_rmslauw2 "Bedingung berechnete relative Sekund‰rluftmasse kann ausgewertet werden, Bank2" UBYTE B_TRUE 1 100 0 1 BIT_MASK 0x2 FORMAT "%13.11" ECU_ADDRESS 0x8007D0 /end MEASUREMENT
/begin MEASUREMENT B_rmslvmx "Bedingung max. rel. Sekund‰rluftmasse bei Ventildichtigkeitscheck ¸berschritten" UBYTE B_TRUE 1 100 0 1 BIT_MASK 0x10 FORMAT "%13.11" ECU_ADDRESS 0x8007D3 /end MEASUREMENT
/begin MEASUREMENT B_rmslvmx2 "max. rel. Sekund‰rluftmasse bei Ventildichtigkeitscheck ¸berschritten, Bank2" UBYTE B_TRUE 1 100 0 1 BIT_MASK 0x20 FORMAT "%13.11" ECU_ADDRESS 0x8007D3 /end MEASUREMENT
/begin MEASUREMENT B_rst1ph "Heilung f¸r Phasenfehler PG1 (falsche Anzahl Flanken/AS)" UBYTE B_TRUE 1 100 0 1 BIT_MASK 0x1 FORMAT "%13.11" ECU_ADDRESS 0x80101E /end MEASUREMENT
/begin MEASUREMENT B_rst1ph2 "Heilung f¸r Phasenfehler PG2 (falsche Anzahl Flanken/AS)" UBYTE B_TRUE 1 100 0 1 BIT_MASK 0x2 FORMAT "%13.11" ECU_ADDRESS 0x80101E /end MEASUREMENT
/begin MEASUREMENT B_rst1ph3 "Heilung f¸r Phasenfehler PG3 (falsche Anzahl Flanken/AS)" UBYTE B_TRUE 1 100 0 1 BIT_MASK 0x4 FORMAT "%13.11" ECU_ADDRESS 0x80101E /end MEASUREMENT
/begin MEASUREMENT B_rst1ph4 "Heilung f¸r Phasenfehler PG4 (falsche Anzahl Flanken/AS)" UBYTE B_TRUE 1 100 0 1 BIT_MASK 0x8 FORMAT "%13.11" ECU_ADDRESS 0x80101E /end MEASUREMENT
/begin MEASUREMENT B_rst3ph "Heilung f¸r Phasenfehler PG1 (falscher Pegel an BM)" UBYTE B_TRUE 1 100 0 1 BIT_MASK 0x2 FORMAT "%13.11" ECU_ADDRESS 0x80101A /end MEASUREMENT
/begin MEASUREMENT B_rst3ph2 "Heilung f¸r Phasenfehler PG2 (falscher Pegel an BM)" UBYTE B_TRUE 1 100 0 1 BIT_MASK 0x2 FORMAT "%13.11" ECU_ADDRESS 0x80101B /end MEASUREMENT
/begin MEASUREMENT B_rst3ph3 "Heilung f¸r Phasenfehler PG3 (falscher Pegel an BM)" UBYTE B_TRUE 1 100 0 1 BIT_MASK 0x2 FORMAT "%13.11" ECU_ADDRESS 0x80101C /end MEASUREMENT
/begin MEASUREMENT B_rst3ph4 "Heilung f¸r Phasenfehler PG4 (falscher Pegel an BM)" UBYTE B_TRUE 1 100 0 1 BIT_MASK 0x2 FORMAT "%13.11" ECU_ADDRESS 0x80101D /end MEASUREMENT
/begin MEASUREMENT B_sp1 "FLC-Trigger der Aussetzererkennung" UBYTE B_TRUE 1 100 0 1 BIT_MASK 0x1 FORMAT "%13.11" ECU_ADDRESS 0x801164 /end MEASUREMENT
/begin MEASUREMENT B_sp2 "HLC-Trigger der Aussetzererkennung" UBYTE B_TRUE 1 100 0 1 BIT_MASK 0x1 FORMAT "%13.11" ECU_ADDRESS 0x801165 /end MEASUREMENT
/begin MEASUREMENT B_spodsl "Sperren der Freigabe f¸r Aktivdiagnose von Bank1" UBYTE B_TRUE 1 100 0 1 BIT_MASK 0x2 FORMAT "%13.11" ECU_ADDRESS 0x8007D1 /end MEASUREMENT
/begin MEASUREMENT B_spodsl2 "Sperren der Freigabe f¸r Aktivdiagnose von Bank2" UBYTE B_TRUE 1 100 0 1 BIT_MASK 0x4 FORMAT "%13.11" ECU_ADDRESS 0x8007D1 /end MEASUREMENT
/begin MEASUREMENT B_spodslg "Sperren der Freigabe f¸r Aktivdiagnose" UBYTE B_TRUE 1 100 0 1 BIT_MASK 0x1 FORMAT "%13.11" ECU_ADDRESS 0x8007D1 /end MEASUREMENT
/begin MEASUREMENT B_statas "Status F¸llungserfassungssignale f¸r CAN" UBYTE B_TRUE 1 100 0 1 BIT_MASK 0x1 FORMAT "%13.11" ECU_ADDRESS 0x80066E /end MEASUREMENT
/begin MEASUREMENT B_statauw "Beding. Statistikbereich kann ausgewertet werden" UBYTE B_TRUE 1 100 0 1 BIT_MASK 0x1 FORMAT "%13.11" ECU_ADDRESS 0x8007D4 /end MEASUREMENT
/begin MEASUREMENT B_statauw2 "Beding. Statistikbereich kann ausgewertet werden (Bank2)" UBYTE B_TRUE 1 100 0 1 BIT_MASK 0x2 FORMAT "%13.11" ECU_ADDRESS 0x8007D4 /end MEASUREMENT
/begin MEASUREMENT B_statrms2 "Beding. relative Sekund‰rluftmasse befindet sich im Statistikbereich" UBYTE B_TRUE 1 100 0 1 BIT_MASK 0x4 FORMAT "%13.11" ECU_ADDRESS 0x8007D4 /end MEASUREMENT
/begin MEASUREMENT B_statrmsl "Beding. relative Sekund‰rluftmasse befindet sich im Statistikbereich" UBYTE B_TRUE 1 100 0 1 BIT_MASK 0x8 FORMAT "%13.11" ECU_ADDRESS 0x8007D4 /end MEASUREMENT
/begin MEASUREMENT B_stdmd "Bedingung Aussetzererkennung w‰hrend Starthochlauf gesperrt" UBYTE B_TRUE 1 100 0 1 BIT_MASK 0x1 FORMAT "%13.11" ECU_ADDRESS 0x800E61 /end MEASUREMENT
/begin MEASUREMENT B_stimhelp "Z¸ndungs-Aussetzer eingestellt, Stimuli-Signal vom Aussetzergenerator" UBYTE B_TRUE 1 100 0 1 BIT_MASK 0x1 FORMAT "%13.11" ECU_ADDRESS 0x800E79 /end MEASUREMENT
/begin MEASUREMENT B_swe "Bedingung Schlechtwegstrecke erkannt" UBYTE B_TRUE 1 100 0 1 BIT_MASK 0x1 FORMAT "%13.11" ECU_ADDRESS 0x800E62 /end MEASUREMENT
/begin MEASUREMENT B_swe_c "Bedingung Schlechtwegstrecke erkannt aus %DSWEC" UBYTE B_TRUE 1 100 0 1 BIT_MASK 0x1 FORMAT "%13.11" ECU_ADDRESS 0x7FA6B3 /end MEASUREMENT
/begin MEASUREMENT B_synph "Bedingung Synchronisation Phase" UBYTE B_TRUE 1 100 0 1 BIT_MASK 0x2 FORMAT "%13.11" ECU_ADDRESS 0x800C9E /end MEASUREMENT
/begin MEASUREMENT B_synphab "Synchronisation abgeschlossen" UBYTE B_TRUE 1 100 0 1 BIT_MASK 0x2 FORMAT "%13.11" ECU_ADDRESS 0x800C9F /end MEASUREMENT
/begin MEASUREMENT B_szsls "Bedingung Diagnose Sekund‰rluftsystem durchgef¸hrt, Summe" UBYTE B_TRUE 1 100 0 1 BIT_MASK 0x4 FORMAT "%13.11" ECU_ADDRESS 0x8007D0 /end MEASUREMENT
/begin MEASUREMENT B_szslv "Bedingung Diagnose Ventildichtigkeitscheck durchgef¸hrt, Summe" UBYTE B_TRUE 1 100 0 1 BIT_MASK 0x8 FORMAT "%13.11" ECU_ADDRESS 0x8007D0 /end MEASUREMENT
/begin MEASUREMENT B_ti1stamp "" UBYTE B_TRUE 1 100 0 1 BIT_MASK 0x1 FORMAT "%13.11" ECU_ADDRESS 0x800E7A /end MEASUREMENT
/begin MEASUREMENT B_ti2stamp "" UBYTE B_TRUE 1 100 0 1 BIT_MASK 0x1 FORMAT "%13.11" ECU_ADDRESS 0x800E7B /end MEASUREMENT
/begin MEASUREMENT B_tnalu "Testphase nach erkanntem Aussetzer l‰uft" UBYTE B_TRUE 1 100 0 1 BIT_MASK 0x1 FORMAT "%13.11" ECU_ADDRESS 0x800E37 /end MEASUREMENT
/begin MEASUREMENT B_ts1delay "" UBYTE B_TRUE 1 100 0 1 BIT_MASK 0x1 FORMAT "%13.11" ECU_ADDRESS 0x800E7C /end MEASUREMENT
/begin MEASUREMENT B_tsbcalc "" UBYTE B_TRUE 1 100 0 1 BIT_MASK 0x1 FORMAT "%13.11" ECU_ADDRESS 0x800E7D /end MEASUREMENT
/begin MEASUREMENT B_tsbready "Bedingung Segmentzeit g¸ltig" UBYTE B_TRUE 1 100 0 1 BIT_MASK 0x1 FORMAT "%13.11" ECU_ADDRESS 0x800E7E /end MEASUREMENT
/begin MEASUREMENT B_zagrun "Bedingung Start des Aussetzergenerators" UBYTE B_TRUE 1 100 0 1 BIT_MASK 0x2 FORMAT "%13.11" ECU_ADDRESS 0x80077A /end MEASUREMENT
/begin MEASUREMENT B_zagstp "Bedingung Aussetzergenerator gestoppt" UBYTE B_TRUE 1 100 0 1 BIT_MASK 0x1 FORMAT "%13.11" ECU_ADDRESS 0x800E78 /end MEASUREMENT
/begin MEASUREMENT B_zfgdsls "Bedingung Freigabe f¸r Setzen der Fehler- und Errorflags in der DSLS" UBYTE B_TRUE 1 100 0 1 BIT_MASK 0x10 FORMAT "%13.11" ECU_ADDRESS 0x8007D4 /end MEASUREMENT
/begin MEASUREMENT B_zfgdsls2 "Bedingung Freigabe f¸r Setzen der Fehler- und Errorflags in der DSLS, Bank2" UBYTE B_TRUE 1 100 0 1 BIT_MASK 0x20 FORMAT "%13.11" ECU_ADDRESS 0x8007D4 /end MEASUREMENT
/begin MEASUREMENT B_zfsldkh "Bedingung Zyklusflag Setzen aus Information aus Kaltstartdiagnose" UBYTE B_TRUE 1 100 0 1 BIT_MASK 0x40 FORMAT "%13.11" ECU_ADDRESS 0x8007D4 /end MEASUREMENT
/begin MEASUREMENT B_zfsldkh2 "Bedingung Zyklusflag Setzen aus Information aus Kaltstartdiagnose (Bank2)" UBYTE B_TRUE 1 100 0 1 BIT_MASK 0x80 FORMAT "%13.11" ECU_ADDRESS 0x8007D4 /end MEASUREMENT
/begin MEASUREMENT B_zslsp "lokales Zyklusflag: Sekund‰rluft-System" UBYTE B_TRUE 1 100 0 1 BIT_MASK 0x10 FORMAT "%13.11" ECU_ADDRESS 0x8007D0 /end MEASUREMENT
/begin MEASUREMENT B_zslsp2 "lokales Zyklusflag: Sekund‰rluft-System, Bank 2" UBYTE B_TRUE 1 100 0 1 BIT_MASK 0x20 FORMAT "%13.11" ECU_ADDRESS 0x8007D0 /end MEASUREMENT
/begin MEASUREMENT B_zslvp "lokales Zyklusflag: Sekund‰rluftventil" UBYTE B_TRUE 1 100 0 1 BIT_MASK 0x40 FORMAT "%13.11" ECU_ADDRESS 0x8007D0 /end MEASUREMENT
/begin MEASUREMENT B_zslvp2 "lokales Zyklusflag: Sekund‰rluftventil, Bank 2" UBYTE B_TRUE 1 100 0 1 BIT_MASK 0x80 FORMAT "%13.11" ECU_ADDRESS 0x8007D0 /end MEASUREMENT
/begin MEASUREMENT case_nr "" UBYTE dez 1 100 0 255 FORMAT "%5.1" ECU_ADDRESS 0x800EC7 /end MEASUREMENT
/begin MEASUREMENT cdcy "" UBYTE dez 1 100 0 255 FORMAT "%5.1" ECU_ADDRESS 0x7FC6FC /end MEASUREMENT
/begin MEASUREMENT cfoxx "zeigt die Eigenschaften des aktuellen KF-Bereiches der Fuel-on/-off Adaption" UBYTE dez 1 100 0 255 FORMAT "%5.1" ECU_ADDRESS 0x800EC8 /end MEASUREMENT
/begin MEASUREMENT CJ945_1_10_diag "" UBYTE temp_q1 1 100 0 255 FORMAT "%5.1" ECU_ADDRESS 0x800640 /end MEASUREMENT
/begin MEASUREMENT CJ945_1_11_diag "" UBYTE temp_q1 1 100 0 255 FORMAT "%5.1" ECU_ADDRESS 0x800641 /end MEASUREMENT
/begin MEASUREMENT CJ945_1_12_diag "" UBYTE temp_q1 1 100 0 255 FORMAT "%5.1" ECU_ADDRESS 0x800642 /end MEASUREMENT
/begin MEASUREMENT CJ945_1_13_diag "" UBYTE temp_q1 1 100 0 255 FORMAT "%5.1" ECU_ADDRESS 0x800643 /end MEASUREMENT
/begin MEASUREMENT CJ945_1_14_diag "" UBYTE temp_q1 1 100 0 255 FORMAT "%5.1" ECU_ADDRESS 0x800644 /end MEASUREMENT
/begin MEASUREMENT CJ945_1_15_diag "" UBYTE temp_q1 1 100 0 255 FORMAT "%5.1" ECU_ADDRESS 0x800645 /end MEASUREMENT
/begin MEASUREMENT CJ945_1_16_diag "" UBYTE temp_q1 1 100 0 255 FORMAT "%5.1" ECU_ADDRESS 0x800646 /end MEASUREMENT
/begin MEASUREMENT CJ945_1_17_diag "" UBYTE temp_q1 1 100 0 255 FORMAT "%5.1" ECU_ADDRESS 0x800647 /end MEASUREMENT
/begin MEASUREMENT CJ945_1_18_diag "" UBYTE temp_q1 1 100 0 255 FORMAT "%5.1" ECU_ADDRESS 0x800648 /end MEASUREMENT
/begin MEASUREMENT CJ945_1_1_diag "" UBYTE temp_q1 1 100 0 255 FORMAT "%5.1" ECU_ADDRESS 0x800649 /end MEASUREMENT
/begin MEASUREMENT CJ945_1_2_diag "" UBYTE temp_q1 1 100 0 255 FORMAT "%5.1" ECU_ADDRESS 0x80064A /end MEASUREMENT
/begin MEASUREMENT CJ945_1_3_diag "" UBYTE temp_q1 1 100 0 255 FORMAT "%5.1" ECU_ADDRESS 0x80064B /end MEASUREMENT
/begin MEASUREMENT CJ945_1_4_diag "" UBYTE temp_q1 1 100 0 255 FORMAT "%5.1" ECU_ADDRESS 0x80064C /end MEASUREMENT
/begin MEASUREMENT CJ945_1_5_diag "" UBYTE temp_q1 1 100 0 255 FORMAT "%5.1" ECU_ADDRESS 0x80064D /end MEASUREMENT
/begin MEASUREMENT CJ945_1_6_diag "" UBYTE temp_q1 1 100 0 255 FORMAT "%5.1" ECU_ADDRESS 0x80064E /end MEASUREMENT
/begin MEASUREMENT CJ945_1_7_diag "" UBYTE temp_q1 1 100 0 255 FORMAT "%5.1" ECU_ADDRESS 0x80064F /end MEASUREMENT
/begin MEASUREMENT CJ945_1_8_diag "" UBYTE temp_q1 1 100 0 255 FORMAT "%5.1" ECU_ADDRESS 0x800650 /end MEASUREMENT
/begin MEASUREMENT CJ945_1_9_diag "" UBYTE temp_q1 1 100 0 255 FORMAT "%5.1" ECU_ADDRESS 0x800651 /end MEASUREMENT
/begin MEASUREMENT CJ945_2_10_diag "" UBYTE temp_q1 1 100 0 255 FORMAT "%5.1" ECU_ADDRESS 0x800652 /end MEASUREMENT
/begin MEASUREMENT CJ945_2_11_diag "" UBYTE temp_q1 1 100 0 255 FORMAT "%5.1" ECU_ADDRESS 0x800653 /end MEASUREMENT
/begin MEASUREMENT CJ945_2_12_diag "" UBYTE temp_q1 1 100 0 255 FORMAT "%5.1" ECU_ADDRESS 0x800654 /end MEASUREMENT
/begin MEASUREMENT CJ945_2_13_diag "" UBYTE temp_q1 1 100 0 255 FORMAT "%5.1" ECU_ADDRESS 0x800655 /end MEASUREMENT
/begin MEASUREMENT CJ945_2_14_diag "" UBYTE temp_q1 1 100 0 255 FORMAT "%5.1" ECU_ADDRESS 0x800656 /end MEASUREMENT
/begin MEASUREMENT CJ945_2_15_diag "" UBYTE temp_q1 1 100 0 255 FORMAT "%5.1" ECU_ADDRESS 0x800657 /end MEASUREMENT
/begin MEASUREMENT CJ945_2_16_diag "" UBYTE temp_q1 1 100 0 255 FORMAT "%5.1" ECU_ADDRESS 0x800658 /end MEASUREMENT
/begin MEASUREMENT CJ945_2_17_diag "" UBYTE temp_q1 1 100 0 255 FORMAT "%5.1" ECU_ADDRESS 0x800659 /end MEASUREMENT
/begin MEASUREMENT CJ945_2_18_diag "" UBYTE temp_q1 1 100 0 255 FORMAT "%5.1" ECU_ADDRESS 0x80065A /end MEASUREMENT
/begin MEASUREMENT CJ945_2_1_diag "" UBYTE temp_q1 1 100 0 255 FORMAT "%5.1" ECU_ADDRESS 0x80065B /end MEASUREMENT
/begin MEASUREMENT CJ945_2_2_diag "" UBYTE temp_q1 1 100 0 255 FORMAT "%5.1" ECU_ADDRESS 0x80065C /end MEASUREMENT
/begin MEASUREMENT CJ945_2_3_diag "" UBYTE temp_q1 1 100 0 255 FORMAT "%5.1" ECU_ADDRESS 0x80065D /end MEASUREMENT
/begin MEASUREMENT CJ945_2_4_diag "" UBYTE temp_q1 1 100 0 255 FORMAT "%5.1" ECU_ADDRESS 0x80065E /end MEASUREMENT
/begin MEASUREMENT CJ945_2_5_diag "" UBYTE temp_q1 1 100 0 255 FORMAT "%5.1" ECU_ADDRESS 0x80065F /end MEASUREMENT
/begin MEASUREMENT CJ945_2_6_diag "" UBYTE temp_q1 1 100 0 255 FORMAT "%5.1" ECU_ADDRESS 0x800660 /end MEASUREMENT
/begin MEASUREMENT CJ945_2_7_diag "" UBYTE temp_q1 1 100 0 255 FORMAT "%5.1" ECU_ADDRESS 0x800661 /end MEASUREMENT
/begin MEASUREMENT CJ945_2_8_diag "" UBYTE temp_q1 1 100 0 255 FORMAT "%5.1" ECU_ADDRESS 0x800662 /end MEASUREMENT
/begin MEASUREMENT CJ945_2_9_diag "" UBYTE temp_q1 1 100 0 255 FORMAT "%5.1" ECU_ADDRESS 0x800663 /end MEASUREMENT
/begin MEASUREMENT convert_f "" FLOAT32_IEEE fak_r32_1 1 100 -1e+037 1e+037 FORMAT "%43.4" ECU_ADDRESS 0x800734 /end MEASUREMENT
/begin MEASUREMENT CrsCtrlDspl_Mode_Req "" UBYTE DC_FLAG_U8 1 100 0 1 BIT_MASK 0x1 FORMAT "%5.3" ECU_ADDRESS 0x803A1D /end MEASUREMENT
/begin MEASUREMENT CrsCtrlFlt_Mode "" UBYTE DC_FLAG_U8 1 100 0 1 BIT_MASK 0x1 FORMAT "%5.3" ECU_ADDRESS 0x803A1C /end MEASUREMENT
/begin MEASUREMENT CrsCtrl_GearRatio_HighLim_Req "" UBYTE DC_FCTR_50_U8 1 100 0 5.1 FORMAT "%8.6" ECU_ADDRESS 0x803A21 /end MEASUREMENT
/begin MEASUREMENT CrsCtrl_GearRatio_LowLim_Req "" UBYTE DC_FCTR_50_U8 1 100 0 5.1 FORMAT "%8.6" ECU_ADDRESS 0x803A20 /end MEASUREMENT
/begin MEASUREMENT CrsCtrl_Gear_HighLim_Req "" UBYTE DC_FLAG_U8 1 100 0 1 BIT_MASK 0x1 FORMAT "%5.3" ECU_ADDRESS 0x803A23 /end MEASUREMENT
/begin MEASUREMENT CrsCtrl_Gear_LowLim_Req "" UBYTE DC_FLAG_U8 1 100 0 1 BIT_MASK 0x1 FORMAT "%5.3" ECU_ADDRESS 0x803A22 /end MEASUREMENT
/begin MEASUREMENT CrsCtrl_Max_Mode "" UBYTE DC_FLAG_U8 1 100 0 1 BIT_MASK 0x1 FORMAT "%5.3" ECU_ADDRESS 0x803A1F /end MEASUREMENT
/begin MEASUREMENT CrsCtrl_Min_Mode "" UBYTE DC_FLAG_U8 1 100 0 1 BIT_MASK 0x1 FORMAT "%5.3" ECU_ADDRESS 0x803A24 /end MEASUREMENT
/begin MEASUREMENT CrsCtrl_Mode "" UBYTE DC_FLAG_U8 1 100 0 1 BIT_MASK 0x1 FORMAT "%5.3" ECU_ADDRESS 0x803A1E /end MEASUREMENT
/begin MEASUREMENT CrsCtrl_Trq_Req "" SWORD DC_TRQ_S16 1 100 -2048 2047.94 FORMAT "%8.3" ECU_ADDRESS 0x803514 /end MEASUREMENT
/begin MEASUREMENT CY315_1_1_diag "" UBYTE temp_q1 1 100 0 255 FORMAT "%5.1" ECU_ADDRESS 0x800664 /end MEASUREMENT
/begin MEASUREMENT CY315_1_2_diag "" UBYTE temp_q1 1 100 0 255 FORMAT "%5.1" ECU_ADDRESS 0x800665 /end MEASUREMENT
/begin MEASUREMENT CY315_1_3_diag "" UBYTE temp_q1 1 100 0 255 FORMAT "%5.1" ECU_ADDRESS 0x800666 /end MEASUREMENT
/begin MEASUREMENT CY315_1_4_diag "" UBYTE temp_q1 1 100 0 255 FORMAT "%5.1" ECU_ADDRESS 0x800667 /end MEASUREMENT
/begin MEASUREMENT dfseresz_w "Resetz‰hler Plausibilit‰tspr¸fung FSE" UWORD dez 1 100 0 65535 FORMAT "%8.2" ECU_ADDRESS 0x7FC694 /end MEASUREMENT
/begin MEASUREMENT dfse_f "Differenz Adaptionswerte der fuel-on Adaption in bestimmtem Drehzahlbereich" FLOAT32_IEEE fak_r32_1 1 100 -1e+037 1e+037 FORMAT "%43.4" ARRAY_SIZE 9 ECU_ADDRESS 0x7F8ED4 /end MEASUREMENT
/begin MEASUREMENT dlutsk_f "Laufunruhedifferenz-Testgrˆﬂe, korrigiert" FLOAT32_IEEE fak_r32_1 1 100 -1e+037 1e+037 FORMAT "%43.4" ECU_ADDRESS 0x7F9158 /end MEASUREMENT
/begin MEASUREMENT dluts_f "Laufunruhedifferenz-Testgrˆﬂe, signed" FLOAT32_IEEE fak_r32_1 1 100 -1e+037 1e+037 FORMAT "%43.4" ECU_ADDRESS 0x7F8F64 /end MEASUREMENT
/begin MEASUREMENT dmdappBits_100ms "" UBYTE dez 1 100 0 255 FORMAT "%5.1" ECU_ADDRESS 0x80077A /end MEASUREMENT
/begin MEASUREMENT dmdsegl_w "Segmentl‰nge f¸r Aussetzererkennung" UWORD kw_q6 1 100 0 393210 FORMAT "%8.1" ECU_ADDRESS 0x801A3C /end MEASUREMENT
/begin MEASUREMENT dmdstpBits1_100ms "" UWORD dez 1 100 0 65535 FORMAT "%8.2" ECU_ADDRESS 0x800774 /end MEASUREMENT
/begin MEASUREMENT dnwszfausbits0 "" UBYTE dez 1 100 0 255 FORMAT "%5.1" ECU_ADDRESS 0x8010EE /end MEASUREMENT
/begin MEASUREMENT dphBits2_200ms "" UBYTE dez 1 100 0 255 FORMAT "%5.1" ECU_ADDRESS 0x800C9E /end MEASUREMENT
/begin MEASUREMENT dphBits2_syn "" UBYTE dez 1 100 0 255 FORMAT "%5.1" ECU_ADDRESS 0x801019 /end MEASUREMENT
/begin MEASUREMENT dphBits3_syn "" UWORD dez 1 100 0 65535 FORMAT "%8.2" ECU_ADDRESS 0x801BCE /end MEASUREMENT
/begin MEASUREMENT dphBits_200ms "" UBYTE dez 1 100 0 255 FORMAT "%5.1" ECU_ADDRESS 0x800C9F /end MEASUREMENT
/begin MEASUREMENT dphBits_ph1 "" UBYTE dez 1 100 0 255 FORMAT "%5.1" ECU_ADDRESS 0x80101A /end MEASUREMENT
/begin MEASUREMENT dphBits_ph2 "" UBYTE dez 1 100 0 255 FORMAT "%5.1" ECU_ADDRESS 0x80101B /end MEASUREMENT
/begin MEASUREMENT dphBits_ph3 "" UBYTE dez 1 100 0 255 FORMAT "%5.1" ECU_ADDRESS 0x80101C /end MEASUREMENT
/begin MEASUREMENT dphBits_ph4 "" UBYTE dez 1 100 0 255 FORMAT "%5.1" ECU_ADDRESS 0x80101D /end MEASUREMENT
/begin MEASUREMENT dphBits_syn "" UBYTE dez 1 100 0 255 FORMAT "%5.1" ECU_ADDRESS 0x80101E /end MEASUREMENT
/begin MEASUREMENT dr_errArray "" UWORD dez 1 100 0 65535 FORMAT "%8.2" ARRAY_SIZE 22 ECU_ADDRESS 0x803A60 /end MEASUREMENT
/begin MEASUREMENT dr_errCounter "" UWORD dez 1 100 0 65535 FORMAT "%8.2" ECU_ADDRESS 0x7FA320 /end MEASUREMENT
/begin MEASUREMENT dr_errId "" UWORD dez 1 100 0 65535 FORMAT "%8.2" ECU_ADDRESS 0x7FA322 /end MEASUREMENT
/begin MEASUREMENT dr_errInfoh "" UWORD dez 1 100 0 65535 FORMAT "%8.2" ECU_ADDRESS 0x803A58 /end MEASUREMENT
/begin MEASUREMENT dr_errInfol "" UWORD dez 1 100 0 65535 FORMAT "%8.2" ECU_ADDRESS 0x803A5A /end MEASUREMENT
/begin MEASUREMENT dr_errMin "" UWORD tmin_uw_q1 1 100 0 65535 FORMAT "%8.2" ECU_ADDRESS 0x803A5C /end MEASUREMENT
/begin MEASUREMENT dr_errSec "" UWORD t_q0p1 1 100 0 6553.5 FORMAT "%8.3" ECU_ADDRESS 0x803A5E /end MEASUREMENT
/begin MEASUREMENT dr_errType "" UWORD dez 1 100 0 65535 FORMAT "%8.2" ECU_ADDRESS 0x7FA324 /end MEASUREMENT
/begin MEASUREMENT dslsAusBits1 "" UBYTE dez 1 100 0 255 FORMAT "%5.1" ECU_ADDRESS 0x8007CF /end MEASUREMENT
/begin MEASUREMENT dslsAusBits2 "" UBYTE dez 1 100 0 255 FORMAT "%5.1" ECU_ADDRESS 0x8007D0 /end MEASUREMENT
/begin MEASUREMENT dslsAusBits3 "" UBYTE dez 1 100 0 255 FORMAT "%5.1" ECU_ADDRESS 0x8007D1 /end MEASUREMENT
/begin MEASUREMENT dslsLokBits1 "" UBYTE dez 1 100 0 255 FORMAT "%5.1" ECU_ADDRESS 0x8007D2 /end MEASUREMENT
/begin MEASUREMENT dslsLokBits2 "" UBYTE dez 1 100 0 255 FORMAT "%5.1" ECU_ADDRESS 0x8007D3 /end MEASUREMENT
/begin MEASUREMENT dslsLokBits3 "" UBYTE dez 1 100 0 255 FORMAT "%5.1" ECU_ADDRESS 0x8007D4 /end MEASUREMENT
/begin MEASUREMENT dslsLokBits5 "" UBYTE dez 1 100 0 255 FORMAT "%5.1" ECU_ADDRESS 0x8007D5 /end MEASUREMENT
/begin MEASUREMENT DsplBlink_Mode "" UBYTE DC_FLAG_U8 1 100 0 1 BIT_MASK 0x1 FORMAT "%5.3" ECU_ADDRESS 0x803A2C /end MEASUREMENT
/begin MEASUREMENT DsplRefr_Mode "" UBYTE DC_FLAG_U8 1 100 0 1 BIT_MASK 0x1 FORMAT "%5.3" ECU_ADDRESS 0x803A2B /end MEASUREMENT
/begin MEASUREMENT Dspl_VS "" UBYTE DC_VQV1 1 100 0 255 FORMAT "%5.1" ECU_ADDRESS 0x803A2D /end MEASUREMENT
/begin MEASUREMENT dtsarray_f "Differenzen zur Medianbildung/Dynamikkompensation, DMD" FLOAT32_IEEE fak_r32_1 1 100 -1e+037 1e+037 FORMAT "%43.4" ARRAY_SIZE 5 ECU_ADDRESS 0x7F8F6C /end MEASUREMENT
/begin MEASUREMENT dwnwdmxa_w "Maximale Abweichung Nockenwellenposition f¸r Fehlereintrag Auslaﬂ" UWORD kw_uw_q0p0078 1 100 0 511.992 FORMAT "%8.4" ECU_ADDRESS 0x8005BE /end MEASUREMENT
/begin MEASUREMENT dwnwdmxe_w "Maximale Abweichung Nockenwellenposition f¸r Fehlereintrag Einlaﬂ" UWORD kw_uw_q0p0078 1 100 0 511.992 FORMAT "%8.4" ECU_ADDRESS 0x8005D0 /end MEASUREMENT
/begin MEASUREMENT dwnwfda2_w "Differenz Ist - Sollwinkel Nockenwelle gefiltert f¸r Diagnose Auslass 2" SWORD kw_sw_q0p0078 1 100 -256 255.992 FORMAT "%8.4" ECU_ADDRESS 0x8005C0 /end MEASUREMENT
/begin MEASUREMENT dwnwfda_w "Differenz Ist - Sollwinkel Nockenwelle gefiltert f¸r Diagnose Auslass" SWORD kw_sw_q0p0078 1 100 -256 255.992 FORMAT "%8.4" ECU_ADDRESS 0x8005C2 /end MEASUREMENT
/begin MEASUREMENT dwnwfde2_w "Differenz Ist - Sollwinkel Nockenwelle gefiltert f¸r Diagnose Einlass 2" SWORD kw_sw_q0p0078 1 100 -256 255.992 FORMAT "%8.4" ECU_ADDRESS 0x8005D2 /end MEASUREMENT
/begin MEASUREMENT dwnwfde_w "Differenz Ist - Sollwinkel Nockenwelle gefiltert f¸r Diagnose Einlass" SWORD kw_sw_q0p0078 1 100 -256 255.992 FORMAT "%8.4" ECU_ADDRESS 0x8005D4 /end MEASUREMENT
/begin MEASUREMENT ECF_PwrReq_Plaus "" UBYTE DC_SD1_U8MB 1 100 0 255 FORMAT "%4.0" ECU_ADDRESS 0x8038B8 /end MEASUREMENT
/begin MEASUREMENT erg1 "" FLOAT32_IEEE fak_r32_1 1 100 -1e+037 1e+037 FORMAT "%43.4" ECU_ADDRESS 0x7F8F00 /end MEASUREMENT
/begin MEASUREMENT erg2 "" FLOAT32_IEEE fak_r32_1 1 100 -1e+037 1e+037 FORMAT "%43.4" ECU_ADDRESS 0x7F8F04 /end MEASUREMENT
/begin MEASUREMENT ErrEntry_ACCompr1_Trq "" UBYTE DC_M3NM 1 100 0 765 FORMAT "%5.1" ECU_ADDRESS 0x8038A9 /end MEASUREMENT
/begin MEASUREMENT ErrEntry_ACCompr2_Trq "" UBYTE DC_M3NM 1 100 0 765 FORMAT "%5.1" ECU_ADDRESS 0x8038A4 /end MEASUREMENT
/begin MEASUREMENT ErrEntry_ACCompr_RefriPress "" UBYTE DC_UPAC 1 100 0 127.5 FORMAT "%5.1" ECU_ADDRESS 0x8038AE /end MEASUREMENT
/begin MEASUREMENT ErrEntry_AP_Pt1HiLim "" UBYTE DC_PER255 1 100 0 100 FORMAT "%5.1" ECU_ADDRESS 0x803918 /end MEASUREMENT
/begin MEASUREMENT ErrEntry_AP_Pt1LoLim "" UBYTE DC_PER255 1 100 0 100 FORMAT "%5.1" ECU_ADDRESS 0x80391D /end MEASUREMENT
/begin MEASUREMENT ErrEntry_AP_Pt2HiLim "" UBYTE DC_PER255 1 100 0 100 FORMAT "%5.1" ECU_ADDRESS 0x803922 /end MEASUREMENT
/begin MEASUREMENT ErrEntry_AP_Pt2LoLim "" UBYTE DC_PER255 1 100 0 100 FORMAT "%5.1" ECU_ADDRESS 0x803927 /end MEASUREMENT
/begin MEASUREMENT ErrEntry_AP_PtDiff "" UBYTE DC_PER255 1 100 0 100 FORMAT "%5.1" ECU_ADDRESS 0x80392C /end MEASUREMENT
/begin MEASUREMENT ErrEntry_AP_PtSupp "" UBYTE DC_UV08 1 100 0 5 FORMAT "%5.3" ECU_ADDRESS 0x803931 /end MEASUREMENT
/begin MEASUREMENT ErrEntry_ECFPwr_Req "" UBYTE DC_SD1_U8MB 1 100 0 255 FORMAT "%4.0" ECU_ADDRESS 0x8038B3 /end MEASUREMENT
/begin MEASUREMENT esst_snm10dmuw1 "" ULONG dez 1 100 0 4.29497e+009 FORMAT "%13.2" ECU_ADDRESS 0x801D44 /end MEASUREMENT
/begin MEASUREMENT esst_snm10dmuw2 "" ULONG dez 1 100 0 4.29497e+009 FORMAT "%13.2" ECU_ADDRESS 0x801D48 /end MEASUREMENT
/begin MEASUREMENT esst_srl05dmub1 "" ULONG dez 1 100 0 4.29497e+009 FORMAT "%13.2" ECU_ADDRESS 0x801D4C /end MEASUREMENT
/begin MEASUREMENT esst_srl05dmub2 "" ULONG dez 1 100 0 4.29497e+009 FORMAT "%13.2" ECU_ADDRESS 0x801D50 /end MEASUREMENT
/begin MEASUREMENT E_abg_zyl "" UBYTE default 1 100 0 1 FORMAT "%5.3" ARRAY_SIZE 12 ECU_ADDRESS 0x800754 /end MEASUREMENT
/begin MEASUREMENT famal_f "Faktor zur Absenkung des LUR-Wertes bei Mehrfachaussetzern, aus KFFAMALU" FLOAT32_IEEE fak_r32_1 1 100 -1e+037 1e+037 FORMAT "%43.4" ECU_ADDRESS 0x7F91F8 /end MEASUREMENT
/begin MEASUREMENT fanalun "" UBYTE dez 1 100 0 255 FORMAT "%5.1" ECU_ADDRESS 0x800EE0 /end MEASUREMENT
/begin MEASUREMENT fflutn_f "Filterfaktor ¸ber n f¸r Filterung der Laufunruhe" FLOAT32_IEEE fak_r32_1 1 100 -1e+037 1e+037 FORMAT "%43.4" ECU_ADDRESS 0x800738 /end MEASUREMENT
/begin MEASUREMENT ffon1 "Statusbyte 1 ‹bersicht fuel-on Adaption" UBYTE dez 1 100 0 255 FORMAT "%5.1" ECU_ADDRESS 0x800EC9 /end MEASUREMENT
/begin MEASUREMENT ffon2 "Statusbyte 2 ‹bersicht fuel-on Adaption" UBYTE dez 1 100 0 255 FORMAT "%5.1" ECU_ADDRESS 0x800ECA /end MEASUREMENT
/begin MEASUREMENT fivzabg "Intervallz‰hler abgasrelevante Aussetzer" UBYTE dez 1 100 0 255 FORMAT "%5.1" ECU_ADDRESS 0x800761 /end MEASUREMENT
/begin MEASUREMENT fkfamal1_f "Absenkungsfaktor f¸r Laufunruheschwellwert bei Mehrfachaussetzern, aus KFAMAL" FLOAT32_IEEE fak_r32_1 1 100 -1e+037 1e+037 FORMAT "%43.4" ECU_ADDRESS 0x7F91FC /end MEASUREMENT
/begin MEASUREMENT fkfamal2_f "Absenkungsfaktor f¸r Laufunruheschwellwert bei Mehrfachaussetzern, aus KFAMAL" FLOAT32_IEEE fak_r32_1 1 100 -1e+037 1e+037 FORMAT "%43.4" ECU_ADDRESS 0x7F9200 /end MEASUREMENT
/begin MEASUREMENT fkfamal_f "Absenkungsfaktor f¸r Laufunruheschwellwert bei Mehrfachaussetzern, aus KFAMAL" FLOAT32_IEEE fak_r32_1 1 100 -1e+037 1e+037 FORMAT "%43.4" ECU_ADDRESS 0x7F9204 /end MEASUREMENT
/begin MEASUREMENT fkfluar1_f "Basis Schwellwert f¸r Laufunruhe-Abstandsmass, Faktor aus KFLUAR1" FLOAT32_IEEE fak_r32_1 1 100 -1e+037 1e+037 FORMAT "%43.4" ECU_ADDRESS 0x7F9254 /end MEASUREMENT
/begin MEASUREMENT fkfluar2_f "Basis Schwellwert f¸r Laufunruhe-Abstandsmass, Faktor aus KFLUAR2" FLOAT32_IEEE fak_r32_1 1 100 -1e+037 1e+037 FORMAT "%43.4" ECU_ADDRESS 0x7F9258 /end MEASUREMENT
/begin MEASUREMENT fkfluars_f "Basis Schwellwert f¸r Laufunruhe-Abstandsmass, Faktor aus KFLUARS" FLOAT32_IEEE fak_r32_1 1 100 -1e+037 1e+037 FORMAT "%43.4" ECU_ADDRESS 0x7F925C /end MEASUREMENT
/begin MEASUREMENT fkfluar_f "Basis Schwellwert f¸r Laufunruhe-Abstandsmass, Faktor aus KFLUAR" FLOAT32_IEEE fak_r32_1 1 100 -1e+037 1e+037 FORMAT "%43.4" ECU_ADDRESS 0x7F9260 /end MEASUREMENT
/begin MEASUREMENT fkflurb1_f "Basis Schwellwert f¸r Laufunruhe, Faktor aus KFLURB1" FLOAT32_IEEE fak_r32_1 1 100 -1e+037 1e+037 FORMAT "%43.4" ECU_ADDRESS 0x7F9208 /end MEASUREMENT
/begin MEASUREMENT fkflurb2_f "Basis Schwellwert f¸r Laufunruhe, Faktor aus KFLURB2" FLOAT32_IEEE fak_r32_1 1 100 -1e+037 1e+037 FORMAT "%43.4" ECU_ADDRESS 0x7F920C /end MEASUREMENT
/begin MEASUREMENT fkflurbs_f "Basis Schwellwert f¸r Laufunruhe, Faktor aus KFLURBS" FLOAT32_IEEE fak_r32_1 1 100 -1e+037 1e+037 FORMAT "%43.4" ECU_ADDRESS 0x7F9210 /end MEASUREMENT
/begin MEASUREMENT fkflurb_f "Basis Schwellwert f¸r Laufunruhe, Faktor aus KFLURB" FLOAT32_IEEE fak_r32_1 1 100 -1e+037 1e+037 FORMAT "%43.4" ECU_ADDRESS 0x7F9214 /end MEASUREMENT
/begin MEASUREMENT fkflurm1_f "Faktor f¸r Laufunruhe-Referenzwert zur Mehrfachaussetzererkennung ->Lum-Vergl." FLOAT32_IEEE fak_r32_1 1 100 -1e+037 1e+037 FORMAT "%43.4" ECU_ADDRESS 0x7F9218 /end MEASUREMENT
/begin MEASUREMENT fkflurm_f "Faktor f¸r Laufunruhe-Referenzwert zur Mehrfachaussetzererkennung ->Lum-Vergl." FLOAT32_IEEE fak_r32_1 1 100 -1e+037 1e+037 FORMAT "%43.4" ECU_ADDRESS 0x7F921C /end MEASUREMENT
/begin MEASUREMENT flgkat_w "Statusflag kat.sch‰digende Aussetzerraten oder ti-Abschaltung" UWORD dez 1 100 0 65535 FORMAT "%8.2" ECU_ADDRESS 0x8019E2 /end MEASUREMENT
/begin MEASUREMENT flgstign_w "flagword f¸r stimulierte Z¸ndaussetzer" UWORD DEZ 1 100 0 65535 FORMAT "%8.2" ECU_ADDRESS 0x801A28 /end MEASUREMENT
/begin MEASUREMENT flgstinj_w "flagword f¸r stimulierte Einspritzaussetzer" UWORD DEZ 1 100 0 65535 FORMAT "%8.2" ECU_ADDRESS 0x801A2A /end MEASUREMENT
/begin MEASUREMENT flgst_w "flagword f¸r stimulierten Aussetzer" UWORD DEZ 1 100 0 65535 FORMAT "%8.2" ECU_ADDRESS 0x801A2C /end MEASUREMENT
/begin MEASUREMENT flgtiab "Statusflag ti-Abschaltung bei kat.sch‰digenden Aussetzerraten" UBYTE dez 1 100 0 255 FORMAT "%5.1" ECU_ADDRESS 0x800F21 /end MEASUREMENT
/begin MEASUREMENT flgtiabm "" UBYTE dez 1 100 0 255 FORMAT "%5.1" ECU_ADDRESS 0x800F22 /end MEASUREMENT
/begin MEASUREMENT flmx_f "aktuell maximaler Lernfilterwert" FLOAT32_IEEE fak_r32_1 1 100 -1e+037 1e+037 FORMAT "%43.4" ECU_ADDRESS 0x7F8F08 /end MEASUREMENT
/begin MEASUREMENT fln00_f "Lernfilterwert, negativ, Zyl. 0" FLOAT32_IEEE fak_r32_1 1 100 -1e+037 1e+037 FORMAT "%43.4" ARRAY_SIZE 24 ECU_ADDRESS 0x7FB39C /end MEASUREMENT
/begin MEASUREMENT fln01_f "Lernfilterwert, negativ, Zyl. 1" FLOAT32_IEEE fak_r32_1 1 100 -1e+037 1e+037 FORMAT "%43.4" ARRAY_SIZE 24 ECU_ADDRESS 0x7FB3FC /end MEASUREMENT
/begin MEASUREMENT fln02_f "Lernfilterwert, negativ, Zyl. 2" FLOAT32_IEEE fak_r32_1 1 100 -1e+037 1e+037 FORMAT "%43.4" ARRAY_SIZE 24 ECU_ADDRESS 0x7FB45C /end MEASUREMENT
/begin MEASUREMENT fln03_f "Lernfilterwert, negativ, Zyl. 3" FLOAT32_IEEE fak_r32_1 1 100 -1e+037 1e+037 FORMAT "%43.4" ARRAY_SIZE 24 ECU_ADDRESS 0x7FB4BC /end MEASUREMENT
/begin MEASUREMENT fln04_f "Lernfilterwert, negativ, Zyl. 4" FLOAT32_IEEE fak_r32_1 1 100 -1e+037 1e+037 FORMAT "%43.4" ARRAY_SIZE 24 ECU_ADDRESS 0x7FB51C /end MEASUREMENT
/begin MEASUREMENT fln05_f "Lernfilterwert, negativ, Zyl. 5" FLOAT32_IEEE fak_r32_1 1 100 -1e+037 1e+037 FORMAT "%43.4" ARRAY_SIZE 24 ECU_ADDRESS 0x7FB57C /end MEASUREMENT
/begin MEASUREMENT fln06_f "" FLOAT32_IEEE fak_r32_1 1 100 -1e+037 1e+037 FORMAT "%43.4" ARRAY_SIZE 24 ECU_ADDRESS 0x7FB5DC /end MEASUREMENT
/begin MEASUREMENT fln07_f "" FLOAT32_IEEE fak_r32_1 1 100 -1e+037 1e+037 FORMAT "%43.4" ARRAY_SIZE 24 ECU_ADDRESS 0x7FB63C /end MEASUREMENT
/begin MEASUREMENT flp00_f "Lernfilterwert, positiv, Zyl. 0" FLOAT32_IEEE fak_r32_1 1 100 -1e+037 1e+037 FORMAT "%43.4" ARRAY_SIZE 24 ECU_ADDRESS 0x7FB69C /end MEASUREMENT
/begin MEASUREMENT flp01_f "Lernfilterwert, positiv, Zyl. 1" FLOAT32_IEEE fak_r32_1 1 100 -1e+037 1e+037 FORMAT "%43.4" ARRAY_SIZE 24 ECU_ADDRESS 0x7FB6FC /end MEASUREMENT
/begin MEASUREMENT flp02_f "Lernfilterwert, positiv, Zyl. 2" FLOAT32_IEEE fak_r32_1 1 100 -1e+037 1e+037 FORMAT "%43.4" ARRAY_SIZE 24 ECU_ADDRESS 0x7FB75C /end MEASUREMENT
/begin MEASUREMENT flp03_f "Lernfilterwert, positiv, Zyl. 3" FLOAT32_IEEE fak_r32_1 1 100 -1e+037 1e+037 FORMAT "%43.4" ARRAY_SIZE 24 ECU_ADDRESS 0x7FB7BC /end MEASUREMENT
/begin MEASUREMENT flp04_f "Lernfilterwert, positiv, Zyl. 4" FLOAT32_IEEE fak_r32_1 1 100 -1e+037 1e+037 FORMAT "%43.4" ARRAY_SIZE 24 ECU_ADDRESS 0x7FB81C /end MEASUREMENT
/begin MEASUREMENT flp05_f "Lernfilterwert, positiv, Zyl. 5" FLOAT32_IEEE fak_r32_1 1 100 -1e+037 1e+037 FORMAT "%43.4" ARRAY_SIZE 24 ECU_ADDRESS 0x7FB87C /end MEASUREMENT
/begin MEASUREMENT flp06_f "" FLOAT32_IEEE fak_r32_1 1 100 -1e+037 1e+037 FORMAT "%43.4" ARRAY_SIZE 24 ECU_ADDRESS 0x7FB8DC /end MEASUREMENT
/begin MEASUREMENT flp07_f "" FLOAT32_IEEE fak_r32_1 1 100 -1e+037 1e+037 FORMAT "%43.4" ARRAY_SIZE 24 ECU_ADDRESS 0x7FB93C /end MEASUREMENT
/begin MEASUREMENT flurbrl_f "Laufunruhe-Referenzwert bei Fahrzeug steht" FLOAT32_IEEE fak_r32_1 1 100 -1e+037 1e+037 FORMAT "%43.4" ECU_ADDRESS 0x7F9220 /end MEASUREMENT
/begin MEASUREMENT flurktm_f "tmot-abh‰ngiger offset zum Laufunruhe-Referenzwert lurs/dlurs" FLOAT32_IEEE fak_r32_1 1 100 -1e+037 1e+037 FORMAT "%43.4" ECU_ADDRESS 0x7F9224 /end MEASUREMENT
/begin MEASUREMENT flurmin1_f "Drehzahlabh. Laufunruhe-Referenz-Minimalwert 1" FLOAT32_IEEE fak_r32_1 1 100 -1e+037 1e+037 FORMAT "%43.4" ECU_ADDRESS 0x7F9228 /end MEASUREMENT
/begin MEASUREMENT flurmin2_f "Drehzahlabh. Laufunruhe-Referenz-Minimalwert 2" FLOAT32_IEEE fak_r32_1 1 100 -1e+037 1e+037 FORMAT "%43.4" ECU_ADDRESS 0x7F922C /end MEASUREMENT
/begin MEASUREMENT flurmin3_f "Drehzahlabh. Laufunruhe-Referenz-Minimalwert 3" FLOAT32_IEEE fak_r32_1 1 100 -1e+037 1e+037 FORMAT "%43.4" ECU_ADDRESS 0x7F9230 /end MEASUREMENT
/begin MEASUREMENT flurmin_f "Wert von LUR falls Adaption nicht abgeschlossen, Wert aus LURMINN" FLOAT32_IEEE fak_r32_1 1 100 -1e+037 1e+037 FORMAT "%43.4" ECU_ADDRESS 0x7F9234 /end MEASUREMENT
/begin MEASUREMENT flutskzy_f "Filter der Laufunruhe-Testgrˆﬂe, korrigiert, Array ¸ber alle Zylinder" FLOAT32_IEEE fak_r32_1 1 100 -1e+037 1e+037 FORMAT "%43.4" ARRAY_SIZE 12 ECU_ADDRESS 0x7F915C /end MEASUREMENT
/begin MEASUREMENT flutsk_f "Filter der Laufunruhe-Testgrˆﬂe, korrigiert" FLOAT32_IEEE fak_r32_1 1 100 -1e+037 1e+037 FORMAT "%43.4" ECU_ADDRESS 0x7F918C /end MEASUREMENT
/begin MEASUREMENT flutszyl_f "Filter der Laufunruhe-Testgrˆﬂe, Array ¸ber alle Zylinder" FLOAT32_IEEE fak_r32_1 1 100 -1e+037 1e+037 FORMAT "%43.4" ARRAY_SIZE 12 ECU_ADDRESS 0x7F8F80 /end MEASUREMENT
/begin MEASUREMENT fluts_f "Filter der Laufunruhe-Testgrˆﬂe" FLOAT32_IEEE fak_r32_1 1 100 -1e+037 1e+037 FORMAT "%43.4" ECU_ADDRESS 0x7F8FB0 /end MEASUREMENT
/begin MEASUREMENT fonstat "Status der fuel-on Adaption im aktuellen Betriebsbereich" UBYTE dez 1 100 0 255 FORMAT "%5.1" ECU_ADDRESS 0x7FC6C5 /end MEASUREMENT
/begin MEASUREMENT fs00_f "Filterwert Laufunruheabweichung, Zyl. 0" FLOAT32_IEEE fak_r32_1 1 100 -1e+037 1e+037 FORMAT "%43.4" ARRAY_SIZE 24 ECU_ADDRESS 0x7FB99C /end MEASUREMENT
/begin MEASUREMENT fs01_f "Filterwert Segmentabweichung, Zyl. 1" FLOAT32_IEEE fak_r32_1 1 100 -1e+037 1e+037 FORMAT "%43.4" ARRAY_SIZE 24 ECU_ADDRESS 0x7FB9FC /end MEASUREMENT
/begin MEASUREMENT fs02_f "Filterwert Laufunruheabweichung, Zyl. 2" FLOAT32_IEEE fak_r32_1 1 100 -1e+037 1e+037 FORMAT "%43.4" ARRAY_SIZE 24 ECU_ADDRESS 0x7FBA5C /end MEASUREMENT
/begin MEASUREMENT fs03_f "Filterwert Laufunruheabweichung, Zyl. 3" FLOAT32_IEEE fak_r32_1 1 100 -1e+037 1e+037 FORMAT "%43.4" ARRAY_SIZE 24 ECU_ADDRESS 0x7FBABC /end MEASUREMENT
/begin MEASUREMENT fs04_f "Filterwert Laufunruheabweichung, Zyl. 4" FLOAT32_IEEE fak_r32_1 1 100 -1e+037 1e+037 FORMAT "%43.4" ARRAY_SIZE 24 ECU_ADDRESS 0x7FBB1C /end MEASUREMENT
/begin MEASUREMENT fs05_f "Filterwert Laufunruheabweichung, Zyl. 5" FLOAT32_IEEE fak_r32_1 1 100 -1e+037 1e+037 FORMAT "%43.4" ARRAY_SIZE 24 ECU_ADDRESS 0x7FBB7C /end MEASUREMENT
/begin MEASUREMENT fs06_f "" FLOAT32_IEEE fak_r32_1 1 100 -1e+037 1e+037 FORMAT "%43.4" ARRAY_SIZE 24 ECU_ADDRESS 0x7FBBDC /end MEASUREMENT
/begin MEASUREMENT fs07_f "" FLOAT32_IEEE fak_r32_1 1 100 -1e+037 1e+037 FORMAT "%43.4" ARRAY_SIZE 24 ECU_ADDRESS 0x7FBC3C /end MEASUREMENT
/begin MEASUREMENT fsalunkh "Faktor Korrektur Nullastausblendung bei Katheizen" UBYTE fak_ub_b2 1 100 0 1.99219 FORMAT "%5.3" ECU_ADDRESS 0x800776 /end MEASUREMENT
/begin MEASUREMENT fse00_f "Filterwert Laufunruheabweichung, eingerechnet, Zyl. 0" FLOAT32_IEEE fak_r32_1 1 100 -1e+037 1e+037 FORMAT "%43.4" ARRAY_SIZE 24 ECU_ADDRESS 0x7FBC9C /end MEASUREMENT
/begin MEASUREMENT fse01_f "Filterwert Laufunruheabweichung, eingerechnet, Zyl. 1" FLOAT32_IEEE fak_r32_1 1 100 -1e+037 1e+037 FORMAT "%43.4" ARRAY_SIZE 24 ECU_ADDRESS 0x7FBCFC /end MEASUREMENT
/begin MEASUREMENT fse02_f "Filterwert Laufunruheabweichung, eingerechnet, Zyl. 2" FLOAT32_IEEE fak_r32_1 1 100 -1e+037 1e+037 FORMAT "%43.4" ARRAY_SIZE 24 ECU_ADDRESS 0x7FBD5C /end MEASUREMENT
/begin MEASUREMENT fse03_f "Filterwert Laufunruheabweichung, eingerechnet, Zyl. 3" FLOAT32_IEEE fak_r32_1 1 100 -1e+037 1e+037 FORMAT "%43.4" ARRAY_SIZE 24 ECU_ADDRESS 0x7FBDBC /end MEASUREMENT
/begin MEASUREMENT fse04_f "Filterwert Laufunruheabweichung, eingerechnet, Zyl. 4" FLOAT32_IEEE fak_r32_1 1 100 -1e+037 1e+037 FORMAT "%43.4" ARRAY_SIZE 24 ECU_ADDRESS 0x7FBE1C /end MEASUREMENT
/begin MEASUREMENT fse05_f "Filterwert Laufunruheabweichung, eingerechnet, Zyl. 5" FLOAT32_IEEE fak_r32_1 1 100 -1e+037 1e+037 FORMAT "%43.4" ARRAY_SIZE 24 ECU_ADDRESS 0x7FBE7C /end MEASUREMENT
/begin MEASUREMENT fse06_f "" FLOAT32_IEEE fak_r32_1 1 100 -1e+037 1e+037 FORMAT "%43.4" ARRAY_SIZE 24 ECU_ADDRESS 0x7FBEDC /end MEASUREMENT
/begin MEASUREMENT fse07_f "" FLOAT32_IEEE fak_r32_1 1 100 -1e+037 1e+037 FORMAT "%43.4" ARRAY_SIZE 24 ECU_ADDRESS 0x7FBF3C /end MEASUREMENT
/begin MEASUREMENT fsenmz2_f "" FLOAT32_IEEE fak_r32_1 1 100 -1e+037 1e+037 FORMAT "%43.4" ECU_ADDRESS 0x7F9190 /end MEASUREMENT
/begin MEASUREMENT fse_f "aktueller Korrekturwert Fuel-on Adaption" FLOAT32_IEEE fak_r32_1 1 100 -1e+037 1e+037 FORMAT "%43.4" ECU_ADDRESS 0x7F8F0C /end MEASUREMENT
/begin MEASUREMENT fswares "Erkennungsschwellwert Schlechtwegstrecke (aus einer KL)" UBYTE acc_ub_b55p55 1 100 0 55.335 FORMAT "%5.2" ECU_ADDRESS 0x801166 /end MEASUREMENT
/begin MEASUREMENT fzabgs_w "Fehlerz‰hler Summe, z‰hlt abgasrelevante Aussetzer ¸ber alle Zylinder" UWORD dez 1 100 0 65535 FORMAT "%8.2" ECU_ADDRESS 0x8019E4 /end MEASUREMENT
/begin MEASUREMENT fzabgzyl_w "Aussetzerz‰hler" UWORD dez 1 100 0 65535 FORMAT "%8.2" ARRAY_SIZE 12 ECU_ADDRESS 0x8019E6 /end MEASUREMENT
/begin MEASUREMENT fzarv_w "Fehlerz‰hler, z‰hlt Aussetzer ¸ber alle Zylinder" UWORD dez 1 100 0 65535 FORMAT "%8.2" ECU_ADDRESS 0x8019FE /end MEASUREMENT
/begin MEASUREMENT fzkats1_w "Fehlerz‰hler Summe Bank 1, z‰hlt katsch‰digende Aussetzer ¸ber alle Zyl. Bank 1" UWORD dez 1 100 0 65535 FORMAT "%8.2" ECU_ADDRESS 0x801A00 /end MEASUREMENT
/begin MEASUREMENT fzkats2_w "Fehlerz‰hler Summe Bank 2, z‰hlt katsch‰digende Aussetzer ¸ber alle Zyl. Bank 2" UWORD dez 1 100 0 65535 FORMAT "%8.2" ECU_ADDRESS 0x801A02 /end MEASUREMENT
/begin MEASUREMENT fzkats_w "Fehlerz‰hler Summe, z‰hlt katsch‰digende Aussetzer ¸ber alle Zylinder" UWORD dez 1 100 0 65535 FORMAT "%8.2" ECU_ADDRESS 0x801A04 /end MEASUREMENT
/begin MEASUREMENT fzkatzyl_w "" UWORD dez 1 100 0 65535 FORMAT "%8.2" ARRAY_SIZE 12 ECU_ADDRESS 0x801A06 /end MEASUREMENT
/begin MEASUREMENT fzmdzyl_w "Array  f¸r Anzahl der Aussetzer pro Zylinder" UWORD dez 1 100 0 65535 FORMAT "%8.2" ARRAY_SIZE 12 ECU_ADDRESS 0x7FC6DA /end MEASUREMENT
/begin MEASUREMENT hcount "" UBYTE dez 1 100 0 255 FORMAT "%5.1" ECU_ADDRESS 0x800721 /end MEASUREMENT
/begin MEASUREMENT hdfse_f "" FLOAT32_IEEE fak_r32_1 1 100 -1e+037 1e+037 FORMAT "%43.4" ECU_ADDRESS 0x7F8F10 /end MEASUREMENT
/begin MEASUREMENT hflmx_f "" FLOAT32_IEEE fak_r32_1 1 100 -1e+037 1e+037 FORMAT "%43.4" ECU_ADDRESS 0x800724 /end MEASUREMENT
/begin MEASUREMENT IdleDsablCrsCtrl_Mode_Req "" UBYTE DC_FLAG_U8 1 100 0 1 BIT_MASK 0x1 FORMAT "%5.3" ECU_ADDRESS 0x803A2A /end MEASUREMENT
/begin MEASUREMENT idxfob "Index: Kennzeichnet den aktuellen KF-Bereich (Drehz., Last)" UBYTE dez 1 100 0 255 FORMAT "%5.1" ECU_ADDRESS 0x800ECB /end MEASUREMENT
/begin MEASUREMENT idxfobap "Index: Kennzeichnet den aktuellen KF-Bereich (Drehz., Last)" UBYTE dez 1 100 0 255 FORMAT "%5.1" ECU_ADDRESS 0x800ECC /end MEASUREMENT
/begin MEASUREMENT idxfon "Drehzahlindex f¸r Betriebsbereich der fuel-on Adaption" UBYTE dez 1 100 0 255 FORMAT "%5.1" ECU_ADDRESS 0x800ECD /end MEASUREMENT
/begin MEASUREMENT idxfonap "Drehzahlindex f¸r Betriebsbereich der fuel-on Adaption" UBYTE dez 1 100 0 255 FORMAT "%5.1" ECU_ADDRESS 0x800ECE /end MEASUREMENT
/begin MEASUREMENT idxfonl "Index: Kennzeichnet den aktuellen Unterbereich" UBYTE dez 1 100 0 255 FORMAT "%5.1" ECU_ADDRESS 0x800ECF /end MEASUREMENT
/begin MEASUREMENT idxfont "" UBYTE dez 1 100 0 255 FORMAT "%5.1" ECU_ADDRESS 0x800ED0 /end MEASUREMENT
/begin MEASUREMENT idxfon_nb "" UBYTE dez 1 100 0 255 FORMAT "%5.1" ECU_ADDRESS 0x800ED1 /end MEASUREMENT
/begin MEASUREMENT idxforl "Lastindex f¸r Betriebsbereich der fuel-on Adaption" UBYTE dez 1 100 0 255 FORMAT "%5.1" ECU_ADDRESS 0x800ED2 /end MEASUREMENT
/begin MEASUREMENT idxforlap "Lastindex f¸r Betriebsbereich der fuel-on Adaption" UBYTE dez 1 100 0 255 FORMAT "%5.1" ECU_ADDRESS 0x800ED3 /end MEASUREMENT
/begin MEASUREMENT idxforlt "" UBYTE dez 1 100 0 255 FORMAT "%5.1" ECU_ADDRESS 0x800ED4 /end MEASUREMENT
/begin MEASUREMENT idxforl_nb "" UBYTE dez 1 100 0 255 FORMAT "%5.1" ECU_ADDRESS 0x800ED5 /end MEASUREMENT
/begin MEASUREMENT idx_base "" UBYTE dez 1 100 0 255 FORMAT "%5.1" ECU_ADDRESS 0x800ED6 /end MEASUREMENT
/begin MEASUREMENT idx_right "" UBYTE dez 1 100 0 255 FORMAT "%5.1" ECU_ADDRESS 0x800ED7 /end MEASUREMENT
/begin MEASUREMENT idx_up "" UBYTE dez 1 100 0 255 FORMAT "%5.1" ECU_ADDRESS 0x800ED8 /end MEASUREMENT
/begin MEASUREMENT idx_up_right "" UBYTE dez 1 100 0 255 FORMAT "%5.1" ECU_ADDRESS 0x800ED9 /end MEASUREMENT
/begin MEASUREMENT ignitioz_w "Anzahl Z¸ndung, ‹bergabe an Zustandsautomat" UWORD DEZ 1 100 0 65535 FORMAT "%8.2" ECU_ADDRESS 0x801A2E /end MEASUREMENT
/begin MEASUREMENT ivzabg_w "Intervallz‰hler f¸r abgasrelevante Aussetzer (0-1000 KW-Umdr. bzw. 0-500 NW-Um.)" UWORD dez 1 100 0 65535 FORMAT "%8.2" ECU_ADDRESS 0x801A1E /end MEASUREMENT
/begin MEASUREMENT ivzaint_w "Intervallz‰hler f¸r Freigabe ti-Abschaltung (0-200 Kw-Umdr.)" UWORD dez 1 100 0 65535 FORMAT "%8.2" ECU_ADDRESS 0x801A20 /end MEASUREMENT
/begin MEASUREMENT ivzarv_w "Intervallz‰hler f¸r Aussetzer (0-60 KW-Umdr.), zur Ausblendung weiterer Funktion" UWORD dez 1 100 0 65535 FORMAT "%8.2" ECU_ADDRESS 0x801A22 /end MEASUREMENT
/begin MEASUREMENT ivzkat_w "Intervallz‰hler f¸r katsch‰digende Aussetzer (0-200 Kw-Umdr. bzw. 0-100 NW-Um.)" UWORD dez 1 100 0 65535 FORMAT "%8.2" ECU_ADDRESS 0x801A24 /end MEASUREMENT
/begin MEASUREMENT kamfz_w "" UWORD kw_q6 1 100 0 393210 FORMAT "%8.1" ECU_ADDRESS 0x801A3E /end MEASUREMENT
/begin MEASUREMENT kswf "Kat.-Schutz-Wichtungsfaktoren, aus KFKSWF" UBYTE dez 1 100 0 255 FORMAT "%5.1" ECU_ADDRESS 0x800762 /end MEASUREMENT
/begin MEASUREMENT lamssls2_w "Lambda-Sollwert bezogen auf Einbauort Lam.-sonde bei Ende SL.-einblasung (Bank2)" UWORD fak_uw_b16 1 100 0 15.9998 FORMAT "%8.5" ECU_ADDRESS 0x8007CA /end MEASUREMENT
/begin MEASUREMENT lamssls_w "Lambda-Sollwert bezogen auf Einbauort Lam.-sonde bei Ende Sekund‰rlufteinblasung" UWORD fak_uw_b16 1 100 0 15.9998 FORMAT "%8.5" ECU_ADDRESS 0x8007CC /end MEASUREMENT
/begin MEASUREMENT lastmodz_w "Status letzter Modus im Durchlauf des Aussetzerprogrammes" UWORD DEZ 1 100 0 65535 FORMAT "%8.2" ECU_ADDRESS 0x801A30 /end MEASUREMENT
/begin MEASUREMENT luaralt_f "" FLOAT32_IEEE fak_r32_1 1 100 -1e+037 1e+037 FORMAT "%43.4" ECU_ADDRESS 0x7F9264 /end MEASUREMENT
/begin MEASUREMENT luarmn_f "Laufunruhe-Abstandsmass-Referenzwert Minimun" FLOAT32_IEEE fak_r32_1 1 100 -1e+037 1e+037 FORMAT "%43.4" ECU_ADDRESS 0x7F9268 /end MEASUREMENT
/begin MEASUREMENT luaroff_f "Laufunruhe-Abstandsmass-Referenzwert offset" FLOAT32_IEEE fak_r32_1 1 100 -1e+037 1e+037 FORMAT "%43.4" ECU_ADDRESS 0x7F926C /end MEASUREMENT
/begin MEASUREMENT luar_f "Laufunruhe-Abstandsmass-Referenzwert" FLOAT32_IEEE fak_r32_1 1 100 -1e+037 1e+037 FORMAT "%43.4" ECU_ADDRESS 0x7F9270 /end MEASUREMENT
/begin MEASUREMENT lums_f "Laufunruhe-Mittelwert f¸r Erkennung Mehrfachaussetzer, signed" FLOAT32_IEEE fak_r32_1 1 100 -1e+037 1e+037 FORMAT "%43.4" ECU_ADDRESS 0x7F9238 /end MEASUREMENT
/begin MEASUREMENT lunw_f "Laufunruhe ¸ber 1 NW-Umdr." FLOAT32_IEEE fak_r32_1 1 100 -1e+037 1e+037 FORMAT "%43.4" ECU_ADDRESS 0x7F8FB4 /end MEASUREMENT
/begin MEASUREMENT lurmsalt_f "vorangegangener Wert von lurms_f" FLOAT32_IEEE fak_r32_1 1 100 -1e+037 1e+037 FORMAT "%43.4" ECU_ADDRESS 0x7F923C /end MEASUREMENT
/begin MEASUREMENT lurms_f "Laufunruhe-Referenzwert f¸r Mehrfachaussetzererkennung, -> Vgl. mit Lum, signed" FLOAT32_IEEE fak_r32_1 1 100 -1e+037 1e+037 FORMAT "%43.4" ECU_ADDRESS 0x7F9240 /end MEASUREMENT
/begin MEASUREMENT lursalt_f "vorangegangener Wert von lurs_f" FLOAT32_IEEE fak_r32_1 1 100 -1e+037 1e+037 FORMAT "%43.4" ECU_ADDRESS 0x7F9244 /end MEASUREMENT
/begin MEASUREMENT lurs_f "Laufunruhe-Referenzwert, signed" FLOAT32_IEEE fak_r32_1 1 100 -1e+037 1e+037 FORMAT "%43.4" ECU_ADDRESS 0x7F9248 /end MEASUREMENT
/begin MEASUREMENT lutskzyl_f "Laufunruhe-Testgrˆﬂe, signed, korrigiert, Array ¸ber alle Zylinder" FLOAT32_IEEE fak_r32_1 1 100 -1e+037 1e+037 FORMAT "%43.4" ARRAY_SIZE 12 ECU_ADDRESS 0x7F9194 /end MEASUREMENT
/begin MEASUREMENT lutsk_f "Laufunruhe-Testgrˆﬂe, signed, korrigiert, Monitor" FLOAT32_IEEE fak_r32_1 1 100 -1e+037 1e+037 FORMAT "%43.4" ECU_ADDRESS 0x7F91C4 /end MEASUREMENT
/begin MEASUREMENT lutszyl_f "Laufunruhe-Testgrˆﬂe, Array ¸ber alle Zylinder" FLOAT32_IEEE fak_r32_1 1 100 -1e+037 1e+037 FORMAT "%43.4" ARRAY_SIZE 12 ECU_ADDRESS 0x7F8FB8 /end MEASUREMENT
/begin MEASUREMENT luts_f "Laufunruhe-Testgrˆﬂe" FLOAT32_IEEE fak_r32_1 1 100 -1e+037 1e+037 FORMAT "%43.4" ECU_ADDRESS 0x7F8FE8 /end MEASUREMENT
/begin MEASUREMENT m6amsl "Mode 6 - Speicher: Anzahl Werteblˆcke bei Pr¸fung Sekund‰rluftmasse" UBYTE dez 1 100 0 255 FORMAT "%5.1" ECU_ADDRESS 0x7FC71E /end MEASUREMENT
/begin MEASUREMENT m6cmsl "Mode 6 - Speicher: Component ID f¸r Pr¸fung Sekund‰rluftsystem" UBYTE dez 1 100 0 255 FORMAT "%5.1" ECU_ADDRESS 0x7FC71F /end MEASUREMENT
/begin MEASUREMENT m6cmsl2 "Mode 6 - Speicher: Component ID f¸r Pr¸fung Sekund‰rluftsystem (Bank 2)" UBYTE dez 1 100 0 255 FORMAT "%5.1" ECU_ADDRESS 0x7FC720 /end MEASUREMENT
/begin MEASUREMENT m6cmslv "Mode 6 - Speicher: Component ID f¸r Pr¸fung Dichtheit Sekund‰rluftsystem" UBYTE dez 1 100 0 255 FORMAT "%5.1" ECU_ADDRESS 0x7FC721 /end MEASUREMENT
/begin MEASUREMENT m6cmslv2 "Mode 6 - Speicher: Component ID f¸r Pr¸fung Dichtheit Sekund‰rluftsystem" UBYTE dez 1 100 0 255 FORMAT "%5.1" ECU_ADDRESS 0x7FC722 /end MEASUREMENT
/begin MEASUREMENT m6smsl2_w "Mode 6 - Speicher: Schwellwert bei Pr¸fung Sekund‰rluftmasse, Bank 2" UWORD dez 1 100 0 65535 FORMAT "%8.2" ECU_ADDRESS 0x7FC70E /end MEASUREMENT
/begin MEASUREMENT m6smslv2_w "Mode 6 - Speicher: Schwellwert bei Ventildichtheitspr¸fung, Bank 2" UWORD dez 1 100 0 65535 FORMAT "%8.2" ECU_ADDRESS 0x7FC710 /end MEASUREMENT
/begin MEASUREMENT m6smslv_w "Mode 6 - Speicher: Schwellwert bei Ventildichtheitspr¸fung" UWORD dez 1 100 0 65535 FORMAT "%8.2" ECU_ADDRESS 0x7FC712 /end MEASUREMENT
/begin MEASUREMENT m6smsl_w "Mode 6 - Speicher: Schwellwert bei Pr¸fung Sekund‰rluftmasse" UWORD dez 1 100 0 65535 FORMAT "%8.2" ECU_ADDRESS 0x7FC714 /end MEASUREMENT
/begin MEASUREMENT m6wmsl2_w "Mode 6 - Speicher: Messwert Sekund‰rluftmasse bei SL-Einblasung, Bank 2" UWORD dez 1 100 0 65535 FORMAT "%8.2" ECU_ADDRESS 0x7FC716 /end MEASUREMENT
/begin MEASUREMENT m6wmslv2_w "Mode 6 - Speicher: Messwert Ventildichtheit, Bank 2" UWORD dez 1 100 0 65535 FORMAT "%8.2" ECU_ADDRESS 0x7FC718 /end MEASUREMENT
/begin MEASUREMENT m6wmslv_w "Mode 6 - Speicher: Messwert Ventildichtheit" UWORD dez 1 100 0 65535 FORMAT "%8.2" ECU_ADDRESS 0x7FC71A /end MEASUREMENT
/begin MEASUREMENT m6wmsl_w "Mode 6 - Speicher: Messwert Sekund‰rluftmasse bei SL-Einblasung" UWORD dez 1 100 0 65535 FORMAT "%8.2" ECU_ADDRESS 0x7FC71C /end MEASUREMENT
/begin MEASUREMENT maxfse_f "" FLOAT32_IEEE fak_r32_1 1 100 -1e+037 1e+037 FORMAT "%43.4" ECU_ADDRESS 0x7F8F14 /end MEASUREMENT
/begin MEASUREMENT milstat "" UBYTE dez 1 100 0 255 FORMAT "%5.1" ECU_ADDRESS 0x801160 /end MEASUREMENT
/begin MEASUREMENT minfse_f "" FLOAT32_IEEE fak_r32_1 1 100 -1e+037 1e+037 FORMAT "%43.4" ECU_ADDRESS 0x7F8F18 /end MEASUREMENT
/begin MEASUREMENT misfirez_w "Anzahl Aussetzer, ‹bergabe an Zustandsautomat" UWORD DEZ 1 100 0 65535 FORMAT "%8.2" ECU_ADDRESS 0x801A32 /end MEASUREMENT
/begin MEASUREMENT modez_w "aktuell abgearbeiteter Aussetzermode" UWORD DEZ 1 100 0 65535 FORMAT "%8.2" ECU_ADDRESS 0x801A34 /end MEASUREMENT
/begin MEASUREMENT n1 "Drehzahl 1 U/min/Inkrement" UBYTE dez 1 100 0 255 FORMAT "%5.1" ECU_ADDRESS 0x800EDA /end MEASUREMENT
/begin MEASUREMENT n2 "Drehzahl (2-Byte-Adresse)" UBYTE dez 1 100 0 255 FORMAT "%5.1" ECU_ADDRESS 0x800EDB /end MEASUREMENT
/begin MEASUREMENT nwfctrnpa "Fehlerz‰hler zur Entprellung Not-Plaus-Fehler bei Auslaﬂnockenwellensteller" UBYTE dez 1 100 0 255 FORMAT "%5.1" ECU_ADDRESS 0x7FC32E /end MEASUREMENT
/begin MEASUREMENT nwfctrnpa2 "Fehlerz‰hler zur Entprellung Not-Plaus-Fehler bei Auslaﬂnockenwellensteller 2" UBYTE dez 1 100 0 255 FORMAT "%5.1" ECU_ADDRESS 0x7FC32F /end MEASUREMENT
/begin MEASUREMENT nwfctrnpe "Fehlerz‰hler zur Entprellung Not-Plaus-Fehler bei Einlaﬂnockenwellensteller" UBYTE dez 1 100 0 255 FORMAT "%5.1" ECU_ADDRESS 0x7FC334 /end MEASUREMENT
/begin MEASUREMENT nwfctrnpe2 "Fehlerz‰hler zur Entprellung Not-Plaus-Fehler bei Einlaﬂnockenwellensteller 2" UBYTE dez 1 100 0 255 FORMAT "%5.1" ECU_ADDRESS 0x7FC335 /end MEASUREMENT
/begin MEASUREMENT nwnumbz_w "Anzahl Nockenwellenumdrehungen, ‹bergabe an Zustandsautomat" UWORD DEZ 1 100 0 65535 FORMAT "%8.2" ECU_ADDRESS 0x801A36 /end MEASUREMENT
/begin MEASUREMENT pausez_w "Anzahl Pausensegmente, ‹bergabe an Zustandsautomat" UWORD DEZ 1 100 0 65535 FORMAT "%8.2" ECU_ADDRESS 0x801A38 /end MEASUREMENT
/begin MEASUREMENT pgmaster "Nummer des Phasengebers welcher Master ist" UBYTE dez 1 100 0 255 FORMAT "%5.1" ECU_ADDRESS 0x7FC7D8 /end MEASUREMENT
/begin MEASUREMENT ph1edpos_w "Array mit Phasenflankenwinkeln des PG1 vom Hardwaretreiber" UWORD kw_q0p1 1 100 0 6553.5 FORMAT "%8.3" ARRAY_SIZE 9 ECU_ADDRESS 0x801BDC /end MEASUREMENT
/begin MEASUREMENT ph2bmerr "Summierer f¸r falschen Phasenpegel an BM bei PG2" UBYTE fak_q0p5 1 100 0 127.5 FORMAT "%5.1" ECU_ADDRESS 0x7FC7D9 /end MEASUREMENT
/begin MEASUREMENT ph2edpos_w "Array mit Phasenflankenwinkeln des PG2 vom Hardwaretreiber" UWORD kw_q0p1 1 100 0 6553.5 FORMAT "%8.3" ARRAY_SIZE 9 ECU_ADDRESS 0x801BEE /end MEASUREMENT
/begin MEASUREMENT ph3bmerr "Summierer f¸r falschen Phasenpegel an BM bei PG3" UBYTE fak_q0p5 1 100 0 127.5 FORMAT "%5.1" ECU_ADDRESS 0x7FC7DA /end MEASUREMENT
/begin MEASUREMENT ph3edpos_w "Array mit Phasenflankenwinkeln des PG3 vom Hardwaretreiber" UWORD kw_q0p1 1 100 0 6553.5 FORMAT "%8.3" ARRAY_SIZE 9 ECU_ADDRESS 0x801C00 /end MEASUREMENT
/begin MEASUREMENT ph4bmerr "Summierer f¸r falschen Phasenpegel an BM bei PG4" UBYTE fak_q0p5 1 100 0 127.5 FORMAT "%5.1" ECU_ADDRESS 0x7FC7DB /end MEASUREMENT
/begin MEASUREMENT ph4edpos_w "Array mit Phasenflankenwinkeln des PG4 vom Hardwaretreiber" UWORD kw_q0p1 1 100 0 6553.5 FORMAT "%8.3" ARRAY_SIZE 9 ECU_ADDRESS 0x801C12 /end MEASUREMENT
/begin MEASUREMENT phbmerr "Summierer f¸r falschen Phasenpegel an BM bei PG1" UBYTE fak_q0p5 1 100 0 127.5 FORMAT "%5.1" ECU_ADDRESS 0x7FC7DC /end MEASUREMENT
/begin MEASUREMENT PVSLDspl_Mode "" UBYTE DC_FLAG_U8 1 100 0 1 BIT_MASK 0x1 FORMAT "%5.3" ECU_ADDRESS 0x803A29 /end MEASUREMENT
/begin MEASUREMENT randreg_w "Startwert Zufallsgenerator" UWORD DEZ 1 100 0 65535 FORMAT "%8.2" ECU_ADDRESS 0x801A3A /end MEASUREMENT
/begin MEASUREMENT rl_base "" UBYTE dez 1 100 0 255 FORMAT "%5.1" ECU_ADDRESS 0x800EDC /end MEASUREMENT
/begin MEASUREMENT rl_right "" UBYTE dez 1 100 0 255 FORMAT "%5.1" ECU_ADDRESS 0x800EDD /end MEASUREMENT
/begin MEASUREMENT rl_up "" UBYTE dez 1 100 0 255 FORMAT "%5.1" ECU_ADDRESS 0x800EDE /end MEASUREMENT
/begin MEASUREMENT rl_up_right "" UBYTE dez 1 100 0 255 FORMAT "%5.1" ECU_ADDRESS 0x800EDF /end MEASUREMENT
/begin MEASUREMENT rmslmin "minimal zul‰ssige rel. Sekund‰rluftmasse" UBYTE fak_q0p0078 1 100 0 1.99219 FORMAT "%5.3" ECU_ADDRESS 0x8007D6 /end MEASUREMENT
/begin MEASUREMENT rmslmin2 "minimal zul‰ssige rel. Sekund‰rluftmasse, Bank2" UBYTE fak_q0p0078 1 100 0 1.99219 FORMAT "%5.3" ECU_ADDRESS 0x8007D7 /end MEASUREMENT
/begin MEASUREMENT rmslmnf "minimal zul‰ssige rel. Sekund‰rluftmasse im Statistikbereich" UBYTE fak_q0p0078 1 100 0 1.99219 FORMAT "%5.3" ECU_ADDRESS 0x8007D8 /end MEASUREMENT
/begin MEASUREMENT rmslmnf2 "minimal zul‰ssige rel. Sekund‰rluftmasse im Statistikbereich, Bank2" UBYTE fak_q0p0078 1 100 0 1.99219 FORMAT "%5.3" ECU_ADDRESS 0x8007D9 /end MEASUREMENT
/begin MEASUREMENT rmslmnfa "minimal zul‰ssige rel. Sekund‰rluftmasse bei Kurztest" UBYTE fak_q0p0078 1 100 0 1.99219 FORMAT "%5.3" ECU_ADDRESS 0x8007DA /end MEASUREMENT
/begin MEASUREMENT rmslmnfa2 "minimal zul‰ssige rel. Sekund‰rluftmasse bei Kurztest, Bank2" UBYTE fak_q0p0078 1 100 0 1.99219 FORMAT "%5.3" ECU_ADDRESS 0x8007DB /end MEASUREMENT
/begin MEASUREMENT rmslmxsta "maximal rel. Sekund‰rluftmasse f¸r Statistikbereich" UBYTE fak_q0p0078 1 100 0 1.99219 FORMAT "%5.3" ECU_ADDRESS 0x8007DC /end MEASUREMENT
/begin MEASUREMENT rmslmxsta2 "maximal rel. Sekund‰rluftmasse f¸r Statistikbereich" UBYTE fak_q0p0078 1 100 0 1.99219 FORMAT "%5.3" ECU_ADDRESS 0x8007DD /end MEASUREMENT
/begin MEASUREMENT rmslvmx "max. zul‰ssige rel. Sekund‰rluftmasse w‰hrend des Ventildichtigkeitschecks" UBYTE fak_q0p0078 1 100 0 1.99219 FORMAT "%5.3" ECU_ADDRESS 0x8007DE /end MEASUREMENT
/begin MEASUREMENT rmslvmx2 "max. zul‰ssige rel. Sekund‰rluftmasse w‰hrend des Ventildichtigkeitschecks,Bank2" UBYTE fak_q0p0078 1 100 0 1.99219 FORMAT "%5.3" ECU_ADDRESS 0x8007DF /end MEASUREMENT
/begin MEASUREMENT seg1BegD_w "" UWORD kw_q6 1 100 0 393210 FORMAT "%8.1" ECU_ADDRESS 0x801A40 /end MEASUREMENT
/begin MEASUREMENT seg2BegD_w "" UWORD kw_q6 1 100 0 393210 FORMAT "%8.1" ECU_ADDRESS 0x801A42 /end MEASUREMENT
/begin MEASUREMENT SfpMin_EVzyl "" UBYTE default 1 100 0 1 FORMAT "%5.3" ARRAY_SIZE 8 ECU_ADDRESS 0x800F24 /end MEASUREMENT
/begin MEASUREMENT slfoo_f "obere Schwelle f¸r flmx_f, aus Kennlinie SLFOO1/2N" FLOAT32_IEEE fak_r32_1 1 100 -1e+037 1e+037 FORMAT "%43.4" ECU_ADDRESS 0x800728 /end MEASUREMENT
/begin MEASUREMENT slfou_f "untere Schwelle f¸r flmx_f, aus Kennlinie SLFOU1/2N" FLOAT32_IEEE fak_r32_1 1 100 -1e+037 1e+037 FORMAT "%43.4" ECU_ADDRESS 0x80072C /end MEASUREMENT
/begin MEASUREMENT sph2flok "Summierer f¸r Phasenflanken an richtiger Position bei PG2" UBYTE fak_q0p5 1 100 0 127.5 FORMAT "%5.1" ECU_ADDRESS 0x80102E /end MEASUREMENT
/begin MEASUREMENT sph3flok "Summierer f¸r Phasenflanken an richtiger Position bei PG3" UBYTE fak_q0p5 1 100 0 127.5 FORMAT "%5.1" ECU_ADDRESS 0x80102F /end MEASUREMENT
/begin MEASUREMENT sph4flok "Summierer f¸r Phasenflanken an richtiger Position bei PG4" UBYTE fak_q0p5 1 100 0 127.5 FORMAT "%5.1" ECU_ADDRESS 0x801030 /end MEASUREMENT
/begin MEASUREMENT sphflok "Summierer f¸r Phasenflanken an richtiger Position bei PG1" UBYTE fak_q0p5 1 100 0 127.5 FORMAT "%5.1" ECU_ADDRESS 0x801031 /end MEASUREMENT
/begin MEASUREMENT stimiread "Index Stimuli-Bit" UBYTE dez 1 100 0 255 FORMAT "%5.1" ECU_ADDRESS 0x800EE4 /end MEASUREMENT
/begin MEASUREMENT stimiwri "Index Stimuli-Bit" UBYTE dez 1 100 0 255 FORMAT "%5.1" ECU_ADDRESS 0x800EE5 /end MEASUREMENT
/begin MEASUREMENT stim_array "DMD Stimuli-Bit, Array" UBYTE default 1 100 0 1 FORMAT "%5.3" ARRAY_SIZE 15 ECU_ADDRESS 0x800EE8 /end MEASUREMENT
/begin MEASUREMENT SW_KD_Mode "" UBYTE DC_FLAG_U8 1 100 0 1 BIT_MASK 0x1 FORMAT "%5.3" ECU_ADDRESS 0x803936 /end MEASUREMENT
/begin MEASUREMENT TCCOpen_Req "" UBYTE DC_FLAG_U8 1 100 0 1 BIT_MASK 0x1 FORMAT "%5.3" ECU_ADDRESS 0x803A28 /end MEASUREMENT
/begin MEASUREMENT tddnwnpa_w "Entprellzeit f¸r Setzen des Fehler f¸r unplausible Stellung  Einlaﬂnockenwelle" UWORD t100msxs_uw_b6553p5 1 100 0 6553.5 FORMAT "%8.3" ECU_ADDRESS 0x8005C4 /end MEASUREMENT
/begin MEASUREMENT tddnwnpe_w "Entprellzeit f¸r Setzen des Fehler f¸r unplausible Stellung  Einlaﬂnockenwelle" UWORD t100msxs_uw_b6553p5 1 100 0 6553.5 FORMAT "%8.3" ECU_ADDRESS 0x8005D6 /end MEASUREMENT
/begin MEASUREMENT tdkomp_f "Dynamikkompensation zur Laufunruheberechnung, DMD" FLOAT32_IEEE fak_r32_1 1 100 -1e+037 1e+037 FORMAT "%43.4" ECU_ADDRESS 0x7F8FEC /end MEASUREMENT
/begin MEASUREMENT tsegDmd_l "" ULONG dez 1 100 0 4.29497e+009 FORMAT "%13.2" ECU_ADDRESS 0x801D54 /end MEASUREMENT
/begin MEASUREMENT tskarray_f "korrigierte Segmentdauer, Array ¸ber die letzten Werte" FLOAT32_IEEE fak_r32_1 1 100 -1e+037 1e+037 FORMAT "%43.4" ARRAY_SIZE 16 ECU_ADDRESS 0x7F8FF0 /end MEASUREMENT
/begin MEASUREMENT tskdelay "DMD Verzˆgerung Auswertung Segmentzeit" SBYTE dez_sb 1 100 0 16 ECU_ADDRESS 0x800730 /end MEASUREMENT
/begin MEASUREMENT tskin "Index korrigierte Segmentzeit 'n', DMD" UBYTE dez 1 100 0 100 FORMAT "%5.1" ECU_ADDRESS 0x800EF7 /end MEASUREMENT
/begin MEASUREMENT tskinm1 "Index korrigierte Segmentzeit 'n-1', DMD" UBYTE dez 1 100 0 100 FORMAT "%5.1" ECU_ADDRESS 0x800EF8 /end MEASUREMENT
/begin MEASUREMENT tskinm2 "Index korrigierte Segmentzeit 'n-2', DMD" UBYTE dez 1 100 0 100 FORMAT "%5.1" ECU_ADDRESS 0x800EF9 /end MEASUREMENT
/begin MEASUREMENT tskinmz2 "Index korrigierte Segmentzeit 'n-ZYLZA/2', DMD" UBYTE dez 1 100 0 100 FORMAT "%5.1" ECU_ADDRESS 0x800EFA /end MEASUREMENT
/begin MEASUREMENT tskinp1 "Index korrigierte Segmentzeit 'n+1', DMD" UBYTE dez 1 100 0 100 FORMAT "%5.1" ECU_ADDRESS 0x800EFB /end MEASUREMENT
/begin MEASUREMENT tskinpz2 "Index korrigierte Segmentzeit 'n+ZYLZA/2', DMD" UBYTE dez 1 100 0 100 FORMAT "%5.1" ECU_ADDRESS 0x800EFC /end MEASUREMENT
/begin MEASUREMENT tskiwri "Index korrigierte Segmentzeit 'aktuell', DMD" UBYTE dez 1 100 0 100 FORMAT "%5.1" ECU_ADDRESS 0x800EFD /end MEASUREMENT
/begin MEASUREMENT tskixmz "Index korrigierte Segmentzeit 'x-ZYLAZ/2', DMD" UBYTE dez 1 100 0 100 FORMAT "%5.1" ECU_ADDRESS 0x800EFE /end MEASUREMENT
/begin MEASUREMENT tskiy "Index korrigierte Segmentzeit 'y', DMD" UBYTE dez 1 100 0 100 FORMAT "%5.1" ECU_ADDRESS 0x800EFF /end MEASUREMENT
/begin MEASUREMENT tskiym1 "Index korrigierte Segmentzeit 'y-1', DMD" UBYTE dez 1 100 0 100 FORMAT "%5.1" ECU_ADDRESS 0x800F00 /end MEASUREMENT
/begin MEASUREMENT tskiyp1 "Index korrigierte Segmentzeit 'y+1', DMD" UBYTE dez 1 100 0 100 FORMAT "%5.1" ECU_ADDRESS 0x800F01 /end MEASUREMENT
/begin MEASUREMENT tskiyp2 "Index korrigierte Segmentzeit 'y+2', DMD" UBYTE dez 1 100 0 100 FORMAT "%5.1" ECU_ADDRESS 0x800F02 /end MEASUREMENT
/begin MEASUREMENT tskiyp3 "Index korrigierte Segmentzeit 'y+3', DMD" UBYTE dez 1 100 0 100 FORMAT "%5.1" ECU_ADDRESS 0x800F03 /end MEASUREMENT
/begin MEASUREMENT tsklen "DMD L‰nge tsk-Array" UBYTE dez 1 100 0 100 FORMAT "%5.1" ECU_ADDRESS 0x800731 /end MEASUREMENT
/begin MEASUREMENT tskll_f "" FLOAT32_IEEE fak_r32_1 1 100 -1e+037 1e+037 FORMAT "%43.4" ECU_ADDRESS 0x7F9030 /end MEASUREMENT
/begin MEASUREMENT tsknm1_f "korrigierte Segmentdauer 'n-1'" FLOAT32_IEEE fak_r32_1 1 100 -1e+037 1e+037 FORMAT "%43.4" ECU_ADDRESS 0x7F9034 /end MEASUREMENT
/begin MEASUREMENT tsknm2_f "korrigierte Segmentdauer 'n-2'" FLOAT32_IEEE fak_r32_1 1 100 -1e+037 1e+037 FORMAT "%43.4" ECU_ADDRESS 0x7F9038 /end MEASUREMENT
/begin MEASUREMENT tsknp1_f "korrigierte Segmentdauer 'n+1'" FLOAT32_IEEE fak_r32_1 1 100 -1e+037 1e+037 FORMAT "%43.4" ECU_ADDRESS 0x7F903C /end MEASUREMENT
/begin MEASUREMENT tsknx3_f "korrigierte Segmentdauer 'n'^3" FLOAT32_IEEE fak_r32_1 1 100 -1e+037 1e+037 FORMAT "%43.4" ECU_ADDRESS 0x7F9040 /end MEASUREMENT
/begin MEASUREMENT tskn_f "korrigierte Segmentdauer 'n'" FLOAT32_IEEE fak_r32_1 1 100 -1e+037 1e+037 FORMAT "%43.4" ECU_ADDRESS 0x7F9044 /end MEASUREMENT
/begin MEASUREMENT tskyx3_f "korrigierte Segmentdauer 'y'^3" FLOAT32_IEEE fak_r32_1 1 100 -1e+037 1e+037 FORMAT "%43.4" ECU_ADDRESS 0x7F9048 /end MEASUREMENT
/begin MEASUREMENT tSlave1_l "" ULONG dez 1 100 0 4.29497e+009 FORMAT "%13.2" ECU_ADDRESS 0x801D58 /end MEASUREMENT
/begin MEASUREMENT tSlave2_l "" ULONG dez 1 100 0 4.29497e+009 FORMAT "%13.2" ECU_ADDRESS 0x801D5C /end MEASUREMENT
/begin MEASUREMENT tsroh_f "Segmentzeit unkorrigiert" FLOAT32_IEEE fak_r32_1 1 100 -1e+010 1e+010 FORMAT "%43.31" ECU_ADDRESS 0x7F92BC /end MEASUREMENT
/begin MEASUREMENT VSLDspl_Mode "" UBYTE DC_FLAG_U8 1 100 0 1 BIT_MASK 0x1 FORMAT "%5.3" ECU_ADDRESS 0x803A25 /end MEASUREMENT
/begin MEASUREMENT VSL_Run_Mode "" UBYTE DC_FLAG_U8 1 100 0 1 BIT_MASK 0x1 FORMAT "%5.3" ECU_ADDRESS 0x803A27 /end MEASUREMENT
/begin MEASUREMENT VSL_WarnBuz_Mode "" UBYTE DC_FLAG_U8 1 100 0 1 BIT_MASK 0x1 FORMAT "%5.3" ECU_ADDRESS 0x803A26 /end MEASUREMENT
/begin MEASUREMENT wkfmodi_w "Statusword Aussetzermodi aus KFMODI" UWORD DEZ 1 100 0 65535 FORMAT "%8.2" ECU_ADDRESS 0x800778 /end MEASUREMENT
/begin MEASUREMENT wnwfda2_w "Winkel Nockenwelle gefiltert f¸r Diagnose Auslass" SWORD kw_sw_q0p0078 1 100 -256 255.992 FORMAT "%8.4" ECU_ADDRESS 0x8005C6 /end MEASUREMENT
/begin MEASUREMENT wnwfda_w "Winkel Nockenwelle gefiltert f¸r Diagnose Auslass" SWORD kw_sw_q0p0078 1 100 -256 255.992 FORMAT "%8.4" ECU_ADDRESS 0x8005C8 /end MEASUREMENT
/begin MEASUREMENT wnwfde2_w "Winkel Nockenwelle gefiltert f¸r Diagnose Einlass 2" SWORD kw_sw_q0p0078 1 100 -256 255.992 FORMAT "%8.4" ECU_ADDRESS 0x8005D8 /end MEASUREMENT
/begin MEASUREMENT wnwfde_w "Winkel Nockenwelle gefiltert f¸r Diagnose Einlass" SWORD kw_sw_q0p0078 1 100 -256 255.992 FORMAT "%8.4" ECU_ADDRESS 0x8005DA /end MEASUREMENT
/begin MEASUREMENT wnwsanp2_w "Sollwinkel bei Detektierung einer nicht plausiblen NW-Stellung  (Auslaﬂ 2)" SWORD kw_sw_q0p0078 1 100 -256 255.992 FORMAT "%8.4" ECU_ADDRESS 0x7FC330 /end MEASUREMENT
/begin MEASUREMENT wnwsanp_w "Sollwinkel bei Detektierung einer nicht plausiblen NW-Stellung  (Auslaﬂ)" SWORD kw_sw_q0p0078 1 100 -256 255.992 FORMAT "%8.4" ECU_ADDRESS 0x7FC332 /end MEASUREMENT
/begin MEASUREMENT wnwsenp2_w "Sollwinkel bei Detektierung einer nicht plausiblen NW-Stellung (Einlass,Bank2)" SWORD kw_sw_q0p0078 1 100 -256 255.992 FORMAT "%8.4" ECU_ADDRESS 0x7FC336 /end MEASUREMENT
/begin MEASUREMENT wnwsenp_w "Sollwinkel bei Detektierung einer nicht plausiblen NW-Stellung  (Einlass,Bank1)" SWORD kw_sw_q0p0078 1 100 -256 255.992 FORMAT "%8.4" ECU_ADDRESS 0x7FC338 /end MEASUREMENT
/begin MEASUREMENT wnwsfda2_w "Sollwinkel Nockenwelle gefiltert f¸r Diagnose Auslass 2" SWORD kw_sw_q0p0078 1 100 -256 255.992 FORMAT "%8.4" ECU_ADDRESS 0x8005CA /end MEASUREMENT
/begin MEASUREMENT wnwsfda_w "Sollwinkel Nockenwelle gefiltert f¸r Diagnose Auslass" SWORD kw_sw_q0p0078 1 100 -256 255.992 FORMAT "%8.4" ECU_ADDRESS 0x8005CC /end MEASUREMENT
/begin MEASUREMENT wnwsfde2_w "Sollwinkel Nockenwelle gefiltert f¸r Diagnose Einlass 2" SWORD kw_sw_q0p0078 1 100 -256 255.992 FORMAT "%8.4" ECU_ADDRESS 0x8005DC /end MEASUREMENT
/begin MEASUREMENT wnwsfde_w "Sollwinkel Nockenwelle gefiltert f¸r Diagnose Einlass" SWORD kw_sw_q0p0078 1 100 -256 255.992 FORMAT "%8.4" ECU_ADDRESS 0x8005DE /end MEASUREMENT
/begin MEASUREMENT xkfmodi "Parameterkoordinate f¸r die Aussetzermodi in KFMODI" UBYTE DEZ 1 100 0 255 FORMAT "%5.1" ECU_ADDRESS 0x80077B /end MEASUREMENT
/begin MEASUREMENT ykfmodi "Modekoordinate der Aussetzermodi in KFMODI" UBYTE DEZ 1 100 0 255 FORMAT "%5.1" ECU_ADDRESS 0x80077C /end MEASUREMENT
/begin MEASUREMENT z2_f "1/(ZYLZA/2)^2, float" FLOAT32_IEEE fak_r32_1 1 100 -1e+037 1e+037 FORMAT "%43.4" ECU_ADDRESS 0x80073C /end MEASUREMENT
/begin MEASUREMENT zphnok "Z‰hler Fehler auf Phasensignal" UBYTE dez 1 100 0 255 FORMAT "%5.1" ECU_ADDRESS 0x801032 /end MEASUREMENT
/begin MEASUREMENT zphnok2 "Z‰hler Fehler auf Phasensignal 2" UBYTE dez 1 100 0 255 FORMAT "%5.1" ECU_ADDRESS 0x801033 /end MEASUREMENT
/begin MEASUREMENT zphnok3 "Z‰hler Fehler auf Phasensignal 3" UBYTE dez 1 100 0 255 FORMAT "%5.1" ECU_ADDRESS 0x801034 /end MEASUREMENT
/begin MEASUREMENT zphnok4 "Z‰hler Fehler auf Phasensignal 4" UBYTE dez 1 100 0 255 FORMAT "%5.1" ECU_ADDRESS 0x801035 /end MEASUREMENT
/begin MEASUREMENT zrph2diff0 "Phasenflanken im Arbeitsspiel bei PG2" UBYTE dez 1 100 0 255 FORMAT "%5.1" ECU_ADDRESS 0x801036 /end MEASUREMENT
/begin MEASUREMENT zrph3diff0 "Phasenflanken im Arbeitsspiel bei PG3" UBYTE dez 1 100 0 255 FORMAT "%5.1" ECU_ADDRESS 0x801037 /end MEASUREMENT
/begin MEASUREMENT zrph4diff0 "Phasenflanken im Arbeitsspiel bei PG4" UBYTE dez 1 100 0 255 FORMAT "%5.1" ECU_ADDRESS 0x801038 /end MEASUREMENT
/begin MEASUREMENT zrphdiff0 "Phasenflanken im Arbeitsspiel bei PG1" UBYTE dez 1 100 0 255 FORMAT "%5.1" ECU_ADDRESS 0x801039 /end MEASUREMENT
/begin MEASUREMENT zzuend_l "Z¸ndungsz‰hler" ULONG dez 1 100 0 4.29497e+009 FORMAT "%13.2" ECU_ADDRESS 0x7FC6F4 /end MEASUREMENT
/begin MEASUREMENT zzyldmd "SW-Zylinderz‰hler f¸r DMD" SBYTE dez_sb 1 100 -128 127 FORMAT "%4.0" ECU_ADDRESS 0x80077D /end MEASUREMENT
/begin MEASUREMENT zzyldmd_f "SW-Zylinderz‰hler f¸r DMD" FLOAT32_IEEE fak_r32_1 1 100 -1e+010 1e+010 FORMAT "%43.31" ECU_ADDRESS 0x7F92C0 /end MEASUREMENT
/begin MEASUREMENT zzyllfb "SW-Zylinderz‰hler f¸r DMD" SBYTE dez_sb 1 100 -16 24 ECU_ADDRESS 0x800F04 /end MEASUREMENT
/begin MEASUREMENT zzylzag "SW-Zylinderz‰hler f¸r DMDZAG" UBYTE DEZ 1 100 0 255 FORMAT "%5.1" ECU_ADDRESS 0x800F2C /end MEASUREMENT
/begin FUNCTION DMDFON "DMDFON.exportedDiagnosis Misfire Detection Fuel-on Adaptation"
 /begin DEF_CHARACTERISTIC ALFO ANWFOHE DFSEFON1 DFSEFON2 DFSERES FLFO FS1FO FS2FO KFCFO1 KFCFO2 KLIDXFONN1 KLIDXFONN2 KLIDXFORL1 KLIDXFORL2 MDERKFON SIN08DMFL1 SIN08DMFL2 SIRL03DMF1 SIRL03DMF2 SLFOO1N SLFOO2N SLFOU1N SLFOU2N SNM10DMUW1 SNM10DMUW2 SRL05DMUB1 SRL05DMUB2 /end DEF_CHARACTERISTIC
 /begin REF_CHARACTERISTIC ANWFOST CDFO CDFOMOD SNM08DMUW1 SNM08DMUW2 /end REF_CHARACTERISTIC
 /begin IN_MEASUREMENT B_autget B_fofr1 B_folunw B_fomod B_fonresd B_fonstp B_lustop B_mderk B_mdstop B_milstp B_pwf esst_snm08dmuw1 esst_snm08dmuw2 fzabgs_w luts_f nmot_f nmot_w rl rl_f zzyllfb /end IN_MEASUREMENT
 /begin OUT_MEASUREMENT B_fonresf B_fonrset dfseresz_w ffon1 ffon2 fonstat fse_f /end OUT_MEASUREMENT
 /begin LOC_MEASUREMENT anwfoh_w anwfos_w B_fodon B_fohe B_fohold B_fondis B_for B_fora B_forn B_forna B_forun B_forun0 B_plok B_ploka B_resreq case_nr cfoxx dfse_f erg1 erg2 esst_snm10dmuw1 esst_snm10dmuw2 esst_srl05dmub1 esst_srl05dmub2 flmx_f fln00_f fln01_f fln02_f fln03_f fln04_f fln05_f fln06_f fln07_f flp00_f flp01_f flp02_f flp03_f flp04_f flp05_f flp06_f flp07_f fs00_f fs01_f fs02_f fs03_f fs04_f fs05_f fs06_f fs07_f fse00_f fse01_f fse02_f fse03_f fse04_f fse05_f fse06_f fse07_f hcount hdfse_f hflmx_f idxfob idxfobap idxfon idxfonap idxfonl idxfont idxfon_nb idxforl idxforlap idxforlt idxforl_nb idx_base idx_right idx_up idx_up_right maxfse_f minfse_f n1 n2 rl_base rl_right rl_up rl_up_right slfoo_f slfou_f /end LOC_MEASUREMENT
 /begin SUB_FUNCTION /end SUB_FUNCTION
/end FUNCTION
/begin FUNCTION DMDLAD "DMDLAD.   Logic and Delay; Log. Verkn¸pfung versch. Blˆcke zur Aussetzererkennung" /begin DEF_CHARACTERISTIC ANALUN TNALU /end DEF_CHARACTERISTIC /begin REF_CHARACTERISTIC SNM08DMUB /end REF_CHARACTERISTIC
 /begin IN_MEASUREMENT B_dluerk B_luaerk B_luerk B_lustop B_mdstop esst_snm08dmub nmot /end IN_MEASUREMENT
 /begin OUT_MEASUREMENT B_analu B_mderk B_tnalu /end OUT_MEASUREMENT
 /begin LOC_MEASUREMENT fanalun /end LOC_MEASUREMENT
 /begin SUB_FUNCTION /end SUB_FUNCTION
/end FUNCTION
/begin FUNCTION DMDLFB "DMDLFB.   Diagnose Misfire Detection Berechnung Laufunruhe luts und gefilterte fluts" /begin DEF_CHARACTERISTIC FLUTN FLUV1 NFLUV /end DEF_CHARACTERISTIC /begin REF_CHARACTERISTIC /end REF_CHARACTERISTIC
 /begin IN_MEASUREMENT B_lustop B_mdstop B_stimhelp dmdsegl_w nmot nmot_f tsk_f zzyldmd /end IN_MEASUREMENT
 /begin OUT_MEASUREMENT dluts_f flutszyl_f fluts_f lunw_f lutszyl_f luts_f tsknm1_f tsknm2_f tsknp1_f tsknx3_f tskn_f z2_f zzyllfb /end OUT_MEASUREMENT
 /begin LOC_MEASUREMENT B_mdstim convert_f dtsarray_f fflutn_f stimiread stimiwri stim_array tdkomp_f tskarray_f tskdelay tskin tskinm1 tskinm2 tskinmz2 tskinp1 tskinpz2 tskiwri tskixmz tskiy tskiym1 tskiyp1 tskiyp2 tskiyp3 tsklen tskll_f tskyx3_f /end LOC_MEASUREMENT
 /begin SUB_FUNCTION /end SUB_FUNCTION
/end FUNCTION
/begin FUNCTION DMDLFK "DMDLFK.   Diagnose Misfire Detection Korrektur der Laufunruhe luts und fluts" /begin DEF_CHARACTERISTIC /end DEF_CHARACTERISTIC /begin REF_CHARACTERISTIC /end REF_CHARACTERISTIC /begin IN_MEASUREMENT B_mdstop dluts_f fluts_f fse_f luts_f zzyllfb /end IN_MEASUREMENT /begin OUT_MEASUREMENT dlutsk_f flutskzy_f flutsk_f lutskzyl_f lutsk_f /end OUT_MEASUREMENT /begin LOC_MEASUREMENT fsenmz2_f /end LOC_MEASUREMENT /begin SUB_FUNCTION /end SUB_FUNCTION /end FUNCTION
/begin FUNCTION DMDLU "DMDLU.    Diagnose misfire detection; Laufunruhe"
 /begin DEF_CHARACTERISTIC DMXRLU FIAMALU FIMALU KFAMAL KFAMAL1 KFAMAL2 KFLURB KFLURB1 KFLURB2 KFLURBS KFLURM KFLURM1 LURBRL LURKTM LURMIN1 LURMIN2 LURMIN3 /end DEF_CHARACTERISTIC
 /begin REF_CHARACTERISTIC SNM08DMUB SRL08DMUB STM08DMUB /end REF_CHARACTERISTIC
 /begin IN_MEASUREMENT B_analu B_fokstp B_ll B_lustop B_mdstop B_sch B_wk B_wkr esst_snm08dmub esst_srl08dmub esst_stm08dmub fofstat fonstat lutsk_f nmot rl tmot tsknm1_f tsknm2_f tsknp1_f tsknx3_f tskn_f vfzg z2_f /end IN_MEASUREMENT
 /begin OUT_MEASUREMENT B_luerk fkfamal1_f fkfamal2_f fkfamal_f fkflurb1_f fkflurb2_f fkflurbs_f fkflurb_f fkflurm1_f fkflurm_f flurbrl_f flurktm_f flurmin1_f flurmin2_f flurmin3_f flurmin_f /end OUT_MEASUREMENT
 /begin LOC_MEASUREMENT B_luerk_t famal_f lums_f lurmsalt_f lurms_f lursalt_f lurs_f /end LOC_MEASUREMENT
 /begin SUB_FUNCTION /end SUB_FUNCTION
/end FUNCTION
/begin FUNCTION DMDLUA "DMDLUA.   Diagnose Misfire Detection Laufunruhe Abstandsmass" /begin DEF_CHARACTERISTIC DMXRFL KFLUAR KFLUAR1 KFLUAR2 KFLUARS /end DEF_CHARACTERISTIC /begin REF_CHARACTERISTIC SNM08DMUB SRL08DMUB /end REF_CHARACTERISTIC
 /begin IN_MEASUREMENT B_lustop B_mdstop B_sch B_wk B_wkr esst_snm08dmub esst_srl08dmub flurmin_f flutskzy_f flutsk_f nmot rl zzyllfb /end IN_MEASUREMENT
 /begin OUT_MEASUREMENT B_luaerk fkfluar1_f fkfluar2_f fkfluars_f fkfluar_f /end OUT_MEASUREMENT
 /begin LOC_MEASUREMENT luaralt_f luarmn_f luaroff_f luar_f /end LOC_MEASUREMENT
 /begin SUB_FUNCTION /end SUB_FUNCTION
/end FUNCTION
/begin FUNCTION DMDMIL "DMDMIL.exportedFehlerbehandlung der Aussetzererkennung, Ansteuerung der MIL und Heilung"
 /begin DEF_CHARACTERISTIC ADCY AHEAGW AHEAGWS AHEARV AHEKABB AHEKS1B1 AHEKS1B2 AHEKSB1 AHEKSB2 AINTKAN AZYTIABB CWDALA CWDMDE FAINTEN FASKIV1 KFKSWF MILANTI TMASKIV1 /end DEF_CHARACTERISTIC
 /begin REF_CHARACTERISTIC SNM08DMUB TMWUC /end REF_CHARACTERISTIC
 /begin IN_MEASUREMENT bbdcy B_mderk B_mdstop B_milstp B_pwf B_synph esst_snm08dmub nmot nsllm rl tmot zzyllfb /end IN_MEASUREMENT
 /begin OUT_MEASUREMENT ahearv_w bbsp1 bbsp2 B_blkmd B_mdarv B_mdkat B_milmd B_sp1 B_sp2 flgtiab fzabgs_w fzabgzyl_w /end OUT_MEASUREMENT
 /begin LOC_MEASUREMENT abgsmw_w afnmn afnmx afrlmn afrlmx aftnmn aftnmx aftrlmn aftrlmx aint_zyl anzinten azycntb bfnmn bfnmx bfrlmn bfrlmx B_afklt B_aftklt B_aftwrm B_afwrm B_ainten B_bfklt B_bfwrm B_ivzabg1 B_ivzkat1 cdcy E_abg_zyl fivzabg flgkat_w flgtiabm fzarv_w fzkats1_w fzkats2_w fzkats_w fzkatzyl_w fzmdzyl_w ivzabg_w ivzaint_w ivzarv_w ivzkat_w kswf SfpMin_EVzyl zzuend_l /end LOC_MEASUREMENT
 /begin SUB_FUNCTION DFPM_DMDMIL INDEX_DMDMIL /end SUB_FUNCTION
/end FUNCTION
/begin FUNCTION DMDSTP "DMDSTP.   Diagnose Misfire Detection; Stopbedingungen"
 /begin DEF_CHARACTERISTIC AVRALU AZSTLU CWSTPCNF DRLSOLA KLTALUST NGALUN NMIALU NMXALU RLSALULL RLSALUN SALUNKH SFONTM TAMIALU /end DEF_CHARACTERISTIC
 /begin REF_CHARACTERISTIC SNM08DMUB SRL08DMUB /end REF_CHARACTERISTIC
 /begin IN_MEASUREMENT B_asc_reg B_autget B_cdmd B_dkpu B_dtest B_edkvs B_edkvs2 B_eev B_enws B_evasel B_evloc B_fbm B_fomod B_fonrset B_koe B_kuppl B_ll B_mdarv B_mdein B_mderk B_nldg B_nws B_phsnl B_readap B_sa B_st B_sta B_su B_synph B_tehb B_tsbready B_wk B_wkr dmrkh esst_snm08dmub esst_srl08dmub ngfil_w nmot rl rlgas_w tans tmot tmst tnst_w vfzg /end IN_MEASUREMENT
 /begin OUT_MEASUREMENT B_fofstp B_fokstp B_fonstp B_lustop B_mdstop B_mdzgstp B_milstp B_swe dmdstpBits1_100ms /end OUT_MEASUREMENT
 /begin LOC_MEASUREMENT B_com1 B_com2 B_edges B_error1 B_error26 B_error3 B_error5 B_error7 B_fontm B_mddrla B_mdng B_mdnmn B_mdnmx B_mdrl B_mdtnst B_range B_stdmd fsalunkh /end LOC_MEASUREMENT
 /begin SUB_FUNCTION /end SUB_FUNCTION
/end FUNCTION
/begin FUNCTION DMDTSB "Diagnosis Misfire Detection Segmentzeitbildung" /begin DEF_CHARACTERISTIC DMDSEGL KAMFZ ZYLKOR /end DEF_CHARACTERISTIC /begin REF_CHARACTERISTIC /end REF_CHARACTERISTIC /begin IN_MEASUREMENT zzyl /end IN_MEASUREMENT
 /begin OUT_MEASUREMENT B_stimhelp B_ti1stamp B_ti2stamp B_ts1delay B_tsbcalc B_tsbready dmdsegl_w kamfz_w seg1BegD_w seg2BegD_w tsegDmd_l tSlave1_l tSlave2_l tsroh_f zzyldmd zzyldmd_f /end OUT_MEASUREMENT
 /begin LOC_MEASUREMENT /end LOC_MEASUREMENT
 /begin SUB_FUNCTION /end SUB_FUNCTION
/end FUNCTION
/begin FUNCTION DMDZAG "DMDZAG.exportedDiagnose misfire detection: Aussetzergenerator" /begin DEF_CHARACTERISTIC CWDMDZAG KFMODI RANDSEED ZAGRUN /end DEF_CHARACTERISTIC /begin REF_CHARACTERISTIC /end REF_CHARACTERISTIC /begin IN_MEASUREMENT zzyl /end IN_MEASUREMENT
 /begin OUT_MEASUREMENT B_mdzag B_reini B_zagrun B_zagstp dmdappBits_100ms flgstign_w flgstinj_w flgst_w ignitioz_w lastmodz_w misfirez_w modez_w nwnumbz_w pausez_w randreg_w zzylzag /end OUT_MEASUREMENT
 /begin LOC_MEASUREMENT wkfmodi_w xkfmodi ykfmodi /end LOC_MEASUREMENT
 /begin SUB_FUNCTION /end SUB_FUNCTION
/end FUNCTION
/begin FUNCTION DMIL "OBDII; MIL-Ansteuerung" /begin DEF_CHARACTERISTIC CWMILCOD CWNOMIL TLAED /end DEF_CHARACTERISTIC /begin REF_CHARACTERISTIC /end REF_CHARACTERISTIC
 /begin IN_MEASUREMENT B_blkfb B_blkmd B_bt B_btemil B_btmil B_milfb B_milmd B_nmot B_nokatfz dfpmMilState /end IN_MEASUREMENT
 /begin OUT_MEASUREMENT B_kmmil B_mil B_milblk B_milst B_milstat B_nomil milstat /end OUT_MEASUREMENT
 /begin LOC_MEASUREMENT B_blkeb B_mileb /end LOC_MEASUREMENT
 /begin SUB_FUNCTION /end SUB_FUNCTION
/end FUNCTION
/begin FUNCTION DMNGR "20.11" /begin DEF_CHARACTERISTIC /end DEF_CHARACTERISTIC /begin REF_CHARACTERISTIC /end REF_CHARACTERISTIC /begin IN_MEASUREMENT /end IN_MEASUREMENT
 /begin OUT_MEASUREMENT CrsCtrlDspl_Mode_Req CrsCtrlFlt_Mode CrsCtrl_GearRatio_HighLim_Req CrsCtrl_GearRatio_LowLim_Req CrsCtrl_Gear_HighLim_Req CrsCtrl_Gear_LowLim_Req CrsCtrl_Max_Mode CrsCtrl_Min_Mode CrsCtrl_Mode CrsCtrl_Trq_Req DsplBlink_Mode DsplRefr_Mode Dspl_VS IdleDsablCrsCtrl_Mode_Req PVSLDspl_Mode TCCOpen_Req VSLDspl_Mode VSL_Run_Mode VSL_WarnBuz_Mode /end OUT_MEASUREMENT
 /begin LOC_MEASUREMENT /end LOC_MEASUREMENT
 /begin SUB_FUNCTION /end SUB_FUNCTION
/end FUNCTION
/begin FUNCTION DNWSAUS "Diagnose Nockenwellensteuerung (Auslaﬂseitig)"
 /begin DEF_CHARACTERISTIC DWNWDHYSA KFDWNWDMXA KFTDDNWNPA NWFDECA NWFINCA NWFMXA NWFSPLA WNWHA ZKNWVDA ZKNWVDSA /end DEF_CHARACTERISTIC
 /begin REF_CHARACTERISTIC /end REF_CHARACTERISTIC
 /begin IN_MEASUREMENT B_cdanws B_dnwsa B_dnwsa2 B_fanwsaa B_fanwstaa nmot_w toelk_w wnwa2_w wnwa_w wnwsa2_w wnwsa_w /end IN_MEASUREMENT
 /begin OUT_MEASUREMENT B_enwsva B_enwsva2 B_fnwstva B_fnwstva2 B_hlanws B_hlanws2 B_lcnpanw B_lcnpanw2 nwfctrnpa nwfctrnpa2 /end OUT_MEASUREMENT
 /begin LOC_MEASUREMENT B_nwnpoka B_nwnpoka2 dwnwdmxa_w dwnwfda2_w dwnwfda_w tddnwnpa_w wnwfda2_w wnwfda_w wnwsanp2_w wnwsanp_w wnwsfda2_w wnwsfda_w /end LOC_MEASUREMENT
 /begin SUB_FUNCTION /end SUB_FUNCTION
/end FUNCTION
/begin FUNCTION DNWSEAUS "Diagnose: Endstufe Nockenwellensteuerung (Auslaﬂseitig)" /begin DEF_CHARACTERISTIC CWPSNWSAE TANWASTMN TANWASTMX /end DEF_CHARACTERISTIC /begin REF_CHARACTERISTIC TVP /end REF_CHARACTERISTIC /begin IN_MEASUREMENT B_desee tanwra2_w tanwra_w /end IN_MEASUREMENT /begin OUT_MEASUREMENT /end OUT_MEASUREMENT /begin LOC_MEASUREMENT /end LOC_MEASUREMENT /begin SUB_FUNCTION DFPM_DNWSEAUS /end SUB_FUNCTION /end FUNCTION
/begin FUNCTION DNWSEEIN "Diagnose der Nockenwellenendstufe (einlaﬂseitig)" /begin DEF_CHARACTERISTIC CWPSNWSEE TANWESTMN TANWESTMX /end DEF_CHARACTERISTIC /begin REF_CHARACTERISTIC TVP /end REF_CHARACTERISTIC /begin IN_MEASUREMENT B_desee tanwre2_w tanwre_w /end IN_MEASUREMENT /begin OUT_MEASUREMENT /end OUT_MEASUREMENT /begin LOC_MEASUREMENT /end LOC_MEASUREMENT /begin SUB_FUNCTION DFPM_DNWSEEIN /end SUB_FUNCTION /end FUNCTION
/begin FUNCTION DNWSEIN "Diagnose Nockenwellensteuerung (Einlaﬂseitig)"
 /begin DEF_CHARACTERISTIC DWNWDHYSE KFDWNWDMXE KFTDDNWNPE NWFDECE NWFINCE NWFMXE NWFSPLE WNWHE ZKNWVDE ZKNWVDSE /end DEF_CHARACTERISTIC
 /begin REF_CHARACTERISTIC /end REF_CHARACTERISTIC
 /begin IN_MEASUREMENT B_cdenws B_dnwse B_dnwse2 B_fanwsea B_fanwstae nmot_w toelk_w wnwe2_w wnwe_w wnwse2_w wnwse_w /end IN_MEASUREMENT
 /begin OUT_MEASUREMENT B_enwsve B_enwsve2 B_fnwstve B_fnwstve2 B_hlenws B_hlenws2 B_lcnpenw B_lcnpenw2 nwfctrnpe nwfctrnpe2 /end OUT_MEASUREMENT
 /begin LOC_MEASUREMENT B_nwnpoke B_nwnpoke2 dwnwdmxe_w dwnwfde2_w dwnwfde_w tddnwnpe_w wnwfde2_w wnwfde_w wnwsenp2_w wnwsenp_w wnwsfde2_w wnwsfde_w /end LOC_MEASUREMENT
 /begin SUB_FUNCTION /end SUB_FUNCTION
/end FUNCTION
/begin FUNCTION DNWSZF "Diagnose Nockenwellensteuerung Fehlerzusammenfassung" /begin DEF_CHARACTERISTIC /end DEF_CHARACTERISTIC /begin REF_CHARACTERISTIC /end REF_CHARACTERISTIC /begin IN_MEASUREMENT B_fnwstva B_fnwstva2 B_fnwstve B_fnwstve2 /end IN_MEASUREMENT
 /begin OUT_MEASUREMENT B_enws B_enwsa B_enwse B_fnwaktv B_fnwaktva B_fnwaktve dnwszfausbits0 /end OUT_MEASUREMENT
 /begin LOC_MEASUREMENT /end LOC_MEASUREMENT
 /begin SUB_FUNCTION /end SUB_FUNCTION
/end FUNCTION
/begin FUNCTION DPACS "20.11     Klimakompressor - Steuerung + Diagnose"
 /begin DEF_CHARACTERISTIC DPACSV_RVTRQ DPACSV_THSW DPACSV_TSPRS DPACSV_TSPWR DPACSV_TSTRQ DPACSV_ULPWR /end DEF_CHARACTERISTIC
 /begin REF_CHARACTERISTIC /end REF_CHARACTERISTIC
 /begin IN_MEASUREMENT ACCompr2_Run_Mode ACCompr2_Trq ACCompr_RefriPress ACCompr_Run_Mode ACCompr_Trq AGKInit_Mode Cod_CANMembr_ACCompr Cod_CANMembr_ACCompr2 ECF_Pwr_Req Eng_Run_Mode /end IN_MEASUREMENT
 /begin OUT_MEASUREMENT ACCompr1_Sw_Mode ACCompr1_Trq_Plaus ACCompr2_Sw_Mode ACCompr2_Trq_Plaus ACCompr_RefriPress_Plaus ACCompr_Sw_Mode ACCompr_Trq_Plaus ECF_PwrReq_Plaus ErrEntry_ACCompr1_Trq ErrEntry_ACCompr2_Trq ErrEntry_ACCompr_RefriPress ErrEntry_ECFPwr_Req /end OUT_MEASUREMENT
 /begin LOC_MEASUREMENT /end LOC_MEASUREMENT
 /begin SUB_FUNCTION /end SUB_FUNCTION
/end FUNCTION
/begin FUNCTION DPH "DPH.      Diagnose; Plausibilit‰tspr¸fung Phasensensor" /begin DEF_CHARACTERISTIC PGPRIO PHBM PHNOKA PHPOSERR /end DEF_CHARACTERISTIC /begin REF_CHARACTERISTIC CWPG1 CWPG2 CWPG3 CWPG4 /end REF_CHARACTERISTIC
 /begin IN_MEASUREMENT B_checkpg B_checkpg2 B_checkpg3 B_checkpg4 B_st inisynmon uzkw_w zphfl2ct_w zphfl3ct_w zphfl4ct_w zphflct_w zrph2_l zrph3_l zrph4_l zrph_l zzyl /end IN_MEASUREMENT
 /begin OUT_MEASUREMENT B_fph1bm B_fph2bm B_fph3bm B_fph4bm B_nopg B_ph2flok B_ph3flok B_ph4flok B_phflok B_synph dphBits2_200ms dphBits2_syn dphBits3_syn dphBits_200ms dphBits_ph1 dphBits_ph2 dphBits_ph3 dphBits_ph4 dphBits_syn pgmaster /end OUT_MEASUREMENT
 /begin LOC_MEASUREMENT B_enph2bm B_enph3bm B_enph4bm B_enphbm B_rst1ph B_rst1ph2 B_rst1ph3 B_rst1ph4 B_rst3ph B_rst3ph2 B_rst3ph3 B_rst3ph4 B_synphab ph1edpos_w ph2bmerr ph2edpos_w ph3bmerr ph3edpos_w ph4bmerr ph4edpos_w phbmerr sph2flok sph3flok sph4flok sphflok zphnok zphnok2 zphnok3 zphnok4 zrph2diff0 zrph3diff0 zrph4diff0 zrphdiff0 /end LOC_MEASUREMENT
 /begin SUB_FUNCTION DFPM_DPH INDEX_DPH /end SUB_FUNCTION
/end FUNCTION
/begin FUNCTION DPN "Diagnose: P/N-Schalter" /begin DEF_CHARACTERISTIC TDREPFSA TDREPFSE TDSEPFSA TDSEPFSE /end DEF_CHARACTERISTIC /begin REF_CHARACTERISTIC /end REF_CHARACTERISTIC /begin IN_MEASUREMENT B_fs B_fsp B_gstcmv /end IN_MEASUREMENT /begin OUT_MEASUREMENT /end OUT_MEASUREMENT /begin LOC_MEASUREMENT /end LOC_MEASUREMENT /begin SUB_FUNCTION /end SUB_FUNCTION /end FUNCTION
/begin FUNCTION DPPWG "20.11     Diagnose/Plausibilisierung Pedalwertgeber"
 /begin DEF_CHARACTERISTIC DIF12_LL DIF12_T DIF12_VG FW_PWBP_GR FW_PWBP_MN FW_PWBP_N FW_PWBP_ON FW_PWBP_R FW_PWBP_SW FW_PWBP_T FW_PWBP_V HYSTERESE PWGNOTMA PWGRAMP SP1MN_T SP1MX_T SP1SMAX SP1SMIN SP1S_KD_OF SP1S_KD_ON SP2MN_T SP2MX_T SP2SMAX SP2SMIN SP2S_KD_OF SP2S_KD_ON SPS_MAX SPS_MIN SPS_VG T_GRDT T_KD_PW UPVGMAX UPVGMIN UPVG_T /end DEF_CHARACTERISTIC
 /begin REF_CHARACTERISTIC /end REF_CHARACTERISTIC
 /begin IN_MEASUREMENT AGKInit_Mode APEmergOp_Mode_Req APPoti_SupplyVolt APP_Volt1 APP_Volt2 BrkLightDrv_Mode BrkLight_PlausCheck_Mode Eng_Spd ErrErs_Mode Veh_Spd /end IN_MEASUREMENT
 /begin OUT_MEASUREMENT APEmergSPSMIN_Mode APEmerg_Mode APP APPoti12Diff APPoti12Diff_Cntr APPoti12Diff_Err APPoti12Diff_Mode APPoti12Min APPoti1Less2_Mode APPoti1Max_Cntr APPoti1Max_Err APPoti1Max_Mode APPoti1Min_Cntr APPoti1Min_Err APPoti1Min_Mode APPoti1RefInput_Mode APPoti2Max_Cntr APPoti2Max_Err APPoti2Max_Mode APPoti2Min_Cntr APPoti2Min_Err APPoti2Min_Mode APPoti2RefInput_Mode APPoti2To1 APPotiHyst APPotiLin APPotiPlaus APPoti_MaxInc APPoti_Req APPoti_SupplyVolt_Cntr APPoti_SupplyVolt_Err APPoti_SupplyVolt_OK_Mode AP_Grdt AP_Grdt_Unfiltd ErrEntry_AP_Pt1HiLim ErrEntry_AP_Pt1LoLim ErrEntry_AP_Pt2HiLim ErrEntry_AP_Pt2LoLim ErrEntry_AP_PtDiff ErrEntry_AP_PtSupp SW_KD_Mode /end OUT_MEASUREMENT
 /begin LOC_MEASUREMENT /end LOC_MEASUREMENT
 /begin SUB_FUNCTION /end SUB_FUNCTION
/end FUNCTION
/begin FUNCTION dr_showerr "" /begin DEF_CHARACTERISTIC CW_DR_ERR1 CW_DR_ERR2 CW_DR_ERR_ID /end DEF_CHARACTERISTIC /begin REF_CHARACTERISTIC /end REF_CHARACTERISTIC /begin IN_MEASUREMENT /end IN_MEASUREMENT
 /begin OUT_MEASUREMENT dr_errArray dr_errCounter dr_errId dr_errInfoh dr_errInfol dr_errMin dr_errSec dr_errType /end OUT_MEASUREMENT
 /begin LOC_MEASUREMENT /end LOC_MEASUREMENT
 /begin SUB_FUNCTION /end SUB_FUNCTION
/end FUNCTION
/begin FUNCTION DSELHFS "Selektion Diagnose Hauptf¸llungssensor" /begin DEF_CHARACTERISTIC /end DEF_CHARACTERISTIC /begin REF_CHARACTERISTIC /end REF_CHARACTERISTIC
 /begin IN_MEASUREMENT B_dknolu B_dssakt B_edss B_ehfm B_ehfmmn B_ehfmmx B_ehfmnpl B_ehfmsg B_headsslm B_hehfm B_hfm B_i_ska_fr B_mndsslm B_mszsdkb B_mxdsslm B_npldsslm B_sidsslm /end IN_MEASUREMENT
 /begin OUT_MEASUREMENT B_ehfs B_fedkb B_fhfs B_statas /end OUT_MEASUREMENT
 /begin LOC_MEASUREMENT /end LOC_MEASUREMENT
 /begin SUB_FUNCTION /end SUB_FUNCTION
/end FUNCTION
/begin FUNCTION DSLS "Diagnose; Sekund‰rluftsystem"
 /begin DEF_CHARACTERISTIC ANZRMSL RMSLMNFAFL RMSLMNFL RMSLMNSTFL RMSLMXSTFL RMSLTMN RMSLVMXLA TC6CSL TC6CSL2 TC6CSLDKH TC6CSLDKH2 TC6CSLF TC6CSLF2 TC6CSLK TC6CSLK2 TC6CSLN TC6CSLN2 TC6CSLV TC6CSLV2 TC6CSLVDK2 TC6CSLVDKH TDRMSLMN /end DEF_CHARACTERISTIC
 /begin REF_CHARACTERISTIC /end REF_CHARACTERISTIC
 /begin IN_MEASUREMENT anfsls anzrmsl2_w anzrmsl_w B_awsalsu B_cdsls B_dfrmoff B_dfrmoff2 B_erradsls B_fasla B_ko2vke B_ko2vke2 B_phend B_phmessab B_phmessmf B_phoffsab B_phstart B_phventab B_prventil B_sls B_trslsfa B_zeffasla B_zefhsvsa B_zeflsv B_zfganzm lamsoni2_w lamsoni_w lamsons2_w lamsons_w ndsalsu rmsl rmsl2 rmslf rmslf2 rmsloof rmsloof2 rmslv rmslv2 /end IN_MEASUREMENT
 /begin OUT_MEASUREMENT B_esls B_mnslspr B_mnslspr2 B_mslmin B_mslmin2 B_mslmn B_mxslvpr B_mxslvpr2 B_rmslausw B_rmslauw2 B_spodsl B_spodsl2 B_spodslg B_szsls B_szslv B_zslsp B_zslsp2 B_zslvp B_zslvp2 dslsAusBits1 dslsAusBits2 dslsAusBits3 m6amsl m6cmsl m6cmsl2 m6cmslv m6cmslv2 m6smsl2_w m6smslv2_w m6smslv_w m6smsl_w m6wmsl2_w m6wmslv2_w m6wmslv_w m6wmsl_w /end OUT_MEASUREMENT
 /begin LOC_MEASUREMENT anfslslc B_anzrmsl B_anzrmsl2 B_ermsl B_ermsl2 B_ermslfa B_ermslfa2 B_ermslmn B_ermslmn2 B_ermslst B_ermslst2 B_fgzodsl B_fgzodsl2 B_rmslvmx B_rmslvmx2 B_statauw B_statauw2 B_statrms2 B_statrmsl B_zfgdsls B_zfgdsls2 B_zfsldkh B_zfsldkh2 dslsLokBits1 dslsLokBits2 dslsLokBits3 dslsLokBits5 lamssls2_w lamssls_w rmslmin rmslmin2 rmslmnf rmslmnf2 rmslmnfa rmslmnfa2 rmslmxsta rmslmxsta2 rmslvmx rmslvmx2 /end LOC_MEASUREMENT
 /begin SUB_FUNCTION DFPM_DSLS /end SUB_FUNCTION
/end FUNCTION
/begin FUNCTION DSWEC "Schlechtwegerk. aus Rad-Beschl.,-> mittels CAN von ABS SG zu Motronic" /begin DEF_CHARACTERISTIC FABSALU FIBSALU FSWALUV /end DEF_CHARACTERISTIC /begin REF_CHARACTERISTIC /end REF_CHARACTERISTIC /begin IN_MEASUREMENT bsc B_cdswe cd_bits1_w vfzg /end IN_MEASUREMENT /begin OUT_MEASUREMENT B_swe_c /end OUT_MEASUREMENT /begin LOC_MEASUREMENT bssp fswares /end LOC_MEASUREMENT /begin SUB_FUNCTION /end SUB_FUNCTION /end FUNCTION
/begin FUNCTION DTESTE "" /begin DEF_CHARACTERISTIC /end DEF_CHARACTERISTIC /begin REF_CHARACTERISTIC /end REF_CHARACTERISTIC /begin IN_MEASUREMENT /end IN_MEASUREMENT
 /begin OUT_MEASUREMENT CJ945_1_10_diag CJ945_1_11_diag CJ945_1_12_diag CJ945_1_13_diag CJ945_1_14_diag CJ945_1_15_diag CJ945_1_16_diag CJ945_1_17_diag CJ945_1_18_diag CJ945_1_1_diag CJ945_1_2_diag CJ945_1_3_diag CJ945_1_4_diag CJ945_1_5_diag CJ945_1_6_diag CJ945_1_7_diag CJ945_1_8_diag CJ945_1_9_diag CJ945_2_10_diag CJ945_2_11_diag CJ945_2_12_diag CJ945_2_13_diag CJ945_2_14_diag CJ945_2_15_diag CJ945_2_16_diag CJ945_2_17_diag CJ945_2_18_diag CJ945_2_1_diag CJ945_2_2_diag CJ945_2_3_diag CJ945_2_4_diag CJ945_2_5_diag CJ945_2_6_diag CJ945_2_7_diag CJ945_2_8_diag CJ945_2_9_diag CY315_1_1_diag CY315_1_2_diag CY315_1_3_diag CY315_1_4_diag /end OUT_MEASUREMENT
 /begin LOC_MEASUREMENT /end LOC_MEASUREMENT
 /begin SUB_FUNCTION /end SUB_FUNCTION
/end FUNCTION
/begin COMPU_METHOD accgrd_ub_b555p55 "" RAT_FUNC "%6.2" "m/(s^3)" COEFFS 0 1 0 0 0 2.17 /end COMPU_METHOD
/begin COMPU_METHOD acc_ub_b55p55 "" RAT_FUNC "%6.3" "m/(s^2)" COEFFS 0 1 0 0 0 0.217 /end COMPU_METHOD
/begin COMPU_METHOD acc_uw_b55p55 "" RAT_FUNC "%6.5" "m/(s^2)" COEFFS 0 147456 0 0 0 125 /end COMPU_METHOD
/begin COMPU_METHOD B_TRUE "boolsche Zust‰nde, positive Logik" TAB_VERB "%6.3" "" COMPU_TAB_REF B_TRUE /end COMPU_METHOD
/begin COMPU_VTAB B_TRUE "boolsche Zust‰nde, positive Logik" TAB_VERB 2 0 "----" 1 "TRUE" /end COMPU_VTAB
/begin COMPU_METHOD DC_APP_VOLT_U16 "" RAT_FUNC "%8.4" "%" COEFFS 0 1023 0 0 0 100 /end COMPU_METHOD
/begin COMPU_METHOD DC_AP_GRDT_S16 "" RAT_FUNC "%6.2" "%/s" COEFFS 0 1 0 0 0 1 /end COMPU_METHOD
/begin COMPU_METHOD DC_CNTR_U8 "" RAT_FUNC "%6.2" "" COEFFS 0 1 0 0 0 1 /end COMPU_METHOD
/begin COMPU_METHOD DC_FCTR_50_U8 "" RAT_FUNC "%8.5" "keine" COEFFS 0 50 0 0 0 1 /end COMPU_METHOD
/begin COMPU_METHOD DC_FLAG_U8 "" RAT_FUNC "%6.2" "" COEFFS 0 1 0 0 0 1 /end COMPU_METHOD
/begin COMPU_METHOD DC_M3NM "" RAT_FUNC "%6.2" "Nm" COEFFS 0 1 0 0 0 3 /end COMPU_METHOD
/begin COMPU_METHOD DC_PER0327 "" RAT_FUNC "%6.4" "%" COEFFS 0 327.67 0 0 0 1 /end COMPU_METHOD
/begin COMPU_METHOD DC_PER0327_20_S16DB "" RAT_FUNC "%9.4" "%/s" COEFFS 0 6.5535 0 0 0 1 /end COMPU_METHOD
/begin COMPU_METHOD DC_PER255 "" RAT_FUNC "%6.3" "%" COEFFS 0 255 0 0 0 100 /end COMPU_METHOD
/begin COMPU_METHOD DC_ROTSPD_S16 "" RAT_FUNC "%7.3" "1/min" COEFFS 0 2 0 0 0 1 /end COMPU_METHOD
/begin COMPU_METHOD DC_SD1_U8MB "" RAT_FUNC "%4.1" "%" COEFFS 0 1 0 0 0 1 /end COMPU_METHOD
/begin COMPU_METHOD DC_TIME_20MS_S16 "" RAT_FUNC "%6.4" "s" COEFFS 0 50 0 0 0 1 /end COMPU_METHOD
/begin COMPU_METHOD DC_TQ20 "" RAT_FUNC "%6.4" "sec" COEFFS 0 50 0 0 0 1 /end COMPU_METHOD
/begin COMPU_METHOD DC_TRQ_S16 "" RAT_FUNC "%8.5" "Nm" COEFFS 0 16 0 0 0 1 /end COMPU_METHOD
/begin COMPU_METHOD DC_UPAC "" RAT_FUNC "%6.3" "bar" COEFFS 0 1 0 0 0 0.5 /end COMPU_METHOD
/begin COMPU_METHOD DC_UV08 "" RAT_FUNC "%6.4" "V" COEFFS 0 255 0 0 0 5 /end COMPU_METHOD
/begin COMPU_METHOD DC_VEHSPD_KMH_U16 "" RAT_FUNC "%8.5" "km/h" COEFFS 0 16 0 0 0 1 /end COMPU_METHOD
/begin COMPU_METHOD DC_VOLT_S16 "" RAT_FUNC "%8.5" "V" COEFFS 0 512 0 0 0 1 /end COMPU_METHOD
/begin COMPU_METHOD DC_VQV1 "" RAT_FUNC "%6.2" "km/h" COEFFS 0 1 0 0 0 1 /end COMPU_METHOD
/begin COMPU_METHOD DEZ "1 : 1 Umrechnug (dez/hex)" RAT_FUNC "%6.2" "" COEFFS 0 1 0 0 0 1 /end COMPU_METHOD
/begin COMPU_METHOD dez "1 : 1 Umrechnug (dez/hex)" RAT_FUNC "%6.2" "" COEFFS 0 1 0 0 0 1 /end COMPU_METHOD
/begin COMPU_METHOD dez_sb "" RAT_FUNC "%4.1" "Anzahl" COEFFS 0 1 0 0 0 1 /end COMPU_METHOD
/begin COMPU_METHOD fak_q0p0078 "" RAT_FUNC "%6.4" "-" COEFFS 0 128 0 0 0 1 /end COMPU_METHOD
/begin COMPU_METHOD fak_q0p5 "" RAT_FUNC "%6.3" "-" COEFFS 0 1 0 0 0 0.5 /end COMPU_METHOD
/begin COMPU_METHOD fak_r32_1 "" RAT_FUNC "%43.21" "-" COEFFS 0 1 0 0 0 1 /end COMPU_METHOD
/begin COMPU_METHOD fak_ub_b1 "" RAT_FUNC "%6.4" "-" COEFFS 0 256 0 0 0 1 /end COMPU_METHOD
/begin COMPU_METHOD fak_ub_b2 "" RAT_FUNC "%6.4" "-" COEFFS 0 256 0 0 0 2 /end COMPU_METHOD
/begin COMPU_METHOD fak_uw_b16 "" RAT_FUNC "%6.5" "-" COEFFS 0 65536 0 0 0 16 /end COMPU_METHOD
/begin COMPU_METHOD kw_q0p1 "" RAT_FUNC "%6.3" "Grad KW" COEFFS 0 10 0 0 0 1 /end COMPU_METHOD
/begin COMPU_METHOD kw_q6 "" RAT_FUNC "%6.2" "Grad KW" COEFFS 0 1 0 0 0 6 /end COMPU_METHOD
/begin COMPU_METHOD kw_sw_q0p0078 "" RAT_FUNC "%6.4" "Grad KW" COEFFS 0 128 0 0 0 1 /end COMPU_METHOD
/begin COMPU_METHOD kw_uw_q0p0078 "" RAT_FUNC "%6.4" "Grad KW" COEFFS 0 128 0 0 0 1 /end COMPU_METHOD
/begin COMPU_METHOD luquant_w "Umrechnung Laufunruhe Word-Grˆﬂen in DMD" RAT_FUNC "%6.4" "(1/min/s)^2" COEFFS 0 256 0 0 0 0.710543 /end COMPU_METHOD
/begin COMPU_METHOD nmotg_sw_q0p39 "" RAT_FUNC "%6.3" "1/min/s" COEFFS 0 1 0 0 0 0.39063 /end COMPU_METHOD
/begin COMPU_METHOD nmot_ub_q40 "" RAT_FUNC "%6.1" "1/min" COEFFS 0 1 0 0 0 40 /end COMPU_METHOD
/begin COMPU_METHOD nmot_uw_q0p25 "" RAT_FUNC "%6.3" "1/min" COEFFS 0 1 0 0 0 0.25 /end COMPU_METHOD
/begin COMPU_METHOD relNWU_q0p0234 "" RAT_FUNC "%6.4" "%/NWU" COEFFS 0 32 0 0 0 0.75 /end COMPU_METHOD
/begin COMPU_METHOD rel_q0p39 "" RAT_FUNC "%6.3" "%" COEFFS 0 256 0 0 0 100 /end COMPU_METHOD
/begin COMPU_METHOD rel_ub_q0p75 "" RAT_FUNC "%6.3" "%" COEFFS 0 1 0 0 0 0.75 /end COMPU_METHOD
/begin COMPU_METHOD t100msxs_uw_b6553p5 "" RAT_FUNC "%6.3" "s" COEFFS 0 1 0 0 0 0.1 /end COMPU_METHOD
/begin COMPU_METHOD t10msxs_uw_b655p35 "" RAT_FUNC "%6.4" "s" COEFFS 0 1 0 0 0 0.01 /end COMPU_METHOD
/begin COMPU_METHOD t200msxs_ub_b51 "" RAT_FUNC "%6.3" "s" COEFFS 0 1 0 0 0 0.2 /end COMPU_METHOD
/begin COMPU_METHOD t50msxs_ub_b12p75 "" RAT_FUNC "%6.4" "s" COEFFS 0 1 0 0 0 0.05 /end COMPU_METHOD
/begin COMPU_METHOD temp_q0p0234_o273 "" RAT_FUNC "%6.1" "Grad C" COEFFS 0 1 273.15 0 0 0.0234375 /end COMPU_METHOD
/begin COMPU_METHOD temp_q1 "" RAT_FUNC "%6.2" "Grad C" COEFFS 0 1 0 0 0 1 /end COMPU_METHOD
/begin COMPU_METHOD temp_ub_q0p75_o48 "" RAT_FUNC "%6.2" "Grad C" COEFFS 0 1 48 0 0 0.75 /end COMPU_METHOD
/begin COMPU_METHOD tmin_uw_q1 "" RAT_FUNC "%6.2" "min" COEFFS 0 1 0 0 0 1 /end COMPU_METHOD
/begin COMPU_METHOD t_q0p1 "" RAT_FUNC "%6.3" "s" COEFFS 0 10 0 0 0 1 /end COMPU_METHOD
/begin COMPU_METHOD vfzg_ub_q1p25 "" RAT_FUNC "%6.2" "km/h" COEFFS 0 1 0 0 0 1.25 /end COMPU_METHOD
/begin COMPU_METHOD vnstv_q0p01 "" RAT_FUNC "%7.5" "%" COEFFS 0 100 0 0 0 1 /end COMPU_METHOD
/begin COMPU_METHOD zk100msxs_q0p1 "" RAT_FUNC "%6.3" "s" COEFFS 0 1 0 0 0 0.1 /end COMPU_METHOD
/begin COMPU_METHOD default "" RAT_FUNC "%6.2" "" COEFFS 0 1 0 0 0 1 /end COMPU_METHOD
/begin RECORD_LAYOUT dc_KwSw FNC_VALUES 1 SWORD COLUMN_DIR DIRECT /end RECORD_LAYOUT
/begin RECORD_LAYOUT dc_KwUb FNC_VALUES 1 UBYTE COLUMN_DIR DIRECT /end RECORD_LAYOUT
/begin RECORD_LAYOUT dc_KwUw FNC_VALUES 1 UWORD COLUMN_DIR DIRECT /end RECORD_LAYOUT
/begin RECORD_LAYOUT GkfWU16 FNC_VALUES 1 UWORD COLUMN_DIR DIRECT /end RECORD_LAYOUT
/begin RECORD_LAYOUT GkfWU8 FNC_VALUES 1 UBYTE COLUMN_DIR DIRECT /end RECORD_LAYOUT
/begin RECORD_LAYOUT GklWS16 FNC_VALUES 1 SWORD COLUMN_DIR DIRECT /end RECORD_LAYOUT
/begin RECORD_LAYOUT GklWU16 FNC_VALUES 1 UWORD COLUMN_DIR DIRECT /end RECORD_LAYOUT
/begin RECORD_LAYOUT GklWU8 FNC_VALUES 1 UBYTE COLUMN_DIR DIRECT /end RECORD_LAYOUT
/begin RECORD_LAYOUT KfAxU8AyU8SstxU16SstyU16WU16 NO_AXIS_PTS_X 1 UWORD NO_AXIS_PTS_Y 2 UWORD AXIS_PTS_X 3 UWORD INDEX_INCR DIRECT AXIS_PTS_Y 4 UWORD INDEX_INCR DIRECT FNC_VALUES 5 UWORD COLUMN_DIR DIRECT /end RECORD_LAYOUT
/begin RECORD_LAYOUT KfAxU8AyU8SstxU8SstyU8WU8 NO_AXIS_PTS_X 1 UBYTE NO_AXIS_PTS_Y 2 UBYTE AXIS_PTS_X 3 UBYTE INDEX_INCR DIRECT AXIS_PTS_Y 4 UBYTE INDEX_INCR DIRECT FNC_VALUES 5 UBYTE COLUMN_DIR DIRECT /end RECORD_LAYOUT
/begin RECORD_LAYOUT KfAxUwAyUwSstxUwSstyUwWUw NO_AXIS_PTS_X 1 UWORD NO_AXIS_PTS_Y 2 UWORD AXIS_PTS_X 3 UWORD INDEX_INCR DIRECT AXIS_PTS_Y 4 UWORD INDEX_INCR DIRECT FNC_VALUES 5 UWORD COLUMN_DIR DIRECT /end RECORD_LAYOUT
/begin RECORD_LAYOUT KlAUbSstUbWUb NO_AXIS_PTS_X 1 UBYTE AXIS_PTS_X 2 UBYTE INDEX_INCR DIRECT FNC_VALUES 3 UBYTE COLUMN_DIR DIRECT /end RECORD_LAYOUT
/begin RECORD_LAYOUT KlAxU8SstxR32WR32 NO_AXIS_PTS_X 1 ULONG AXIS_PTS_X 2 FLOAT32_IEEE INDEX_INCR DIRECT FNC_VALUES 3 FLOAT32_IEEE COLUMN_DIR DIRECT /end RECORD_LAYOUT
/begin RECORD_LAYOUT KlAxU8SstxU16WU8 NO_AXIS_PTS_X 1 UBYTE AXIS_PTS_X 2 UWORD INDEX_INCR DIRECT FNC_VALUES 3 UBYTE COLUMN_DIR DIRECT /end RECORD_LAYOUT
/begin RECORD_LAYOUT KlAxU8SstxU8WU16 NO_AXIS_PTS_X 1 UBYTE AXIS_PTS_X 2 UBYTE INDEX_INCR DIRECT FNC_VALUES 3 UWORD COLUMN_DIR DIRECT /end RECORD_LAYOUT
/begin RECORD_LAYOUT KlAxU8SstxU8WU8 NO_AXIS_PTS_X 1 UBYTE AXIS_PTS_X 2 UBYTE INDEX_INCR DIRECT FNC_VALUES 3 UBYTE COLUMN_DIR DIRECT /end RECORD_LAYOUT
/begin RECORD_LAYOUT KwbWR32 FNC_VALUES 1 FLOAT32_IEEE COLUMN_DIR DIRECT /end RECORD_LAYOUT
/begin RECORD_LAYOUT KwbWU16 FNC_VALUES 1 UWORD COLUMN_DIR DIRECT /end RECORD_LAYOUT
/begin RECORD_LAYOUT KwbWU8 FNC_VALUES 1 UBYTE COLUMN_DIR DIRECT /end RECORD_LAYOUT
/begin RECORD_LAYOUT KwSw FNC_VALUES 1 SWORD COLUMN_DIR DIRECT /end RECORD_LAYOUT
/begin RECORD_LAYOUT KwUb FNC_VALUES 1 UBYTE COLUMN_DIR DIRECT /end RECORD_LAYOUT
/begin RECORD_LAYOUT KwUw FNC_VALUES 1 UWORD COLUMN_DIR DIRECT /end RECORD_LAYOUT
/begin RECORD_LAYOUT KwWR32 FNC_VALUES 1 FLOAT32_IEEE COLUMN_DIR DIRECT /end RECORD_LAYOUT
/begin RECORD_LAYOUT KwWU16 FNC_VALUES 1 UWORD COLUMN_DIR DIRECT /end RECORD_LAYOUT
/begin RECORD_LAYOUT KwWU8 FNC_VALUES 1 UBYTE COLUMN_DIR DIRECT /end RECORD_LAYOUT
/begin RECORD_LAYOUT SstAU8SstU16 NO_AXIS_PTS_X 1 UWORD AXIS_PTS_X 2 UWORD INDEX_INCR DIRECT /end RECORD_LAYOUT
/begin RECORD_LAYOUT SstAU8SstU8 NO_AXIS_PTS_X 1 UBYTE AXIS_PTS_X 2 UBYTE INDEX_INCR DIRECT /end RECORD_LAYOUT
/begin RECORD_LAYOUT SstAUbSstUb NO_AXIS_PTS_X 1 UBYTE AXIS_PTS_X 2 UBYTE INDEX_INCR DIRECT /end RECORD_LAYOUT
/end MODULE
/end PROJECT
