/* Erstellt von DAMOS++ V1.17 */
ASAP2_VERSION 1 3
/begin PROJECT _9702_071D00 "ME97"
/begin HEADER "" VERSION "_9702_071D00" PROJECT_NO _9702_071D00 /end HEADER
/begin MODULE DIM ""
/begin MOD_PAR "ME97" VERSION "ME97" ADDR_EPK 0x5C217C EPK "6KFFF000000" CUSTOMER_NO "1" USER "GS/PDC" PHONE_NO "" CPU_TYPE "GoldenOak" ECU "ME9.7"
 /begin MEMORY_SEGMENT Prog0 "programmable_0_0" CODE FLASH EXTERN 0x20000 0x160000 -1 -1 -1 -1 -1 /begin IF_DATA ETK ADDRESS_MAPPING 0x20000 0x20000 0x160000 /end IF_DATA /begin IF_DATA ASAP1B_CCP ADDRESS_MAPPING 0x20000 0x20000 0x160000 /end IF_DATA /begin IF_DATA ASAP1B_KWP2000 ADDRESS_MAPPING 0x20000 0x20000 0x160000 /end IF_DATA /end MEMORY_SEGMENT
 /begin MEMORY_SEGMENT KBB "programmable_0_1" CODE FLASH EXTERN 0x180000 0x20000 -1 -1 -1 -1 -1 /begin IF_DATA ETK ADDRESS_MAPPING 0x180000 0x180000 0x20000 /end IF_DATA /begin IF_DATA ASAP1B_CCP ADDRESS_MAPPING 0x180000 0x180000 0x20000 /end IF_DATA /begin IF_DATA ASAP1B_KWP2000 ADDRESS_MAPPING 0x180000 0x180000 0x20000 /end IF_DATA /end MEMORY_SEGMENT
 /begin MEMORY_SEGMENT Prog1 "programmable_0_2" CODE FLASH EXTERN 0x200000 0x1E0000 -1 -1 -1 -1 -1 /begin IF_DATA ETK ADDRESS_MAPPING 0x200000 0x200000 0x1E0000 /end IF_DATA /begin IF_DATA ASAP1B_CCP ADDRESS_MAPPING 0x200000 0x200000 0x1E0000 /end IF_DATA /begin IF_DATA ASAP1B_KWP2000 ADDRESS_MAPPING 0x200000 0x200000 0x1E0000 /end IF_DATA /end MEMORY_SEGMENT
 /begin MEMORY_SEGMENT Prog2 "programmable_0_3" CODE FLASH EXTERN 0x404000 0x7C000 -1 -1 -1 -1 -1 /begin IF_DATA ETK ADDRESS_MAPPING 0x404000 0x404000 0x7C000 /end IF_DATA /begin IF_DATA ASAP1B_CCP ADDRESS_MAPPING 0x404000 0x404000 0x7C000 /end IF_DATA /begin IF_DATA ASAP1B_KWP2000 ADDRESS_MAPPING 0x404000 0x404000 0x7C000 /end IF_DATA /end MEMORY_SEGMENT
 /begin MEMORY_SEGMENT Data0 "programmable_1_0" DATA FLASH EXTERN 0x1C2000 0x1E000 -1 -1 -1 -1 -1 /begin IF_DATA ETK ADDRESS_MAPPING 0x1C2000 0x902000 0x1E000 /end IF_DATA /begin IF_DATA ASAP1B_CCP ADDRESS_MAPPING 0x1C2000 0x5C2000 0x1E000 /end IF_DATA /begin IF_DATA ASAP1B_KWP2000 ADDRESS_MAPPING 0x1C2000 0x5C2000 0x1E000 /end IF_DATA /end MEMORY_SEGMENT
 /begin MEMORY_SEGMENT TriggerETK "nonprogrammable_x_x" VARIABLES RAM EXTERN 0x900000 0x2000 -1 -1 -1 -1 -1 /* AsapMLXFm - CCP_V2_1 */ /begin IF_DATA ETK ADDRESS_MAPPING 0x900000 0x900000 0x2000 /end IF_DATA /* AsapMLXFm - KWP2000 */ /end MEMORY_SEGMENT
 SYSTEM_CONSTANT "DPS_ANWSE" "0"
 SYSTEM_CONSTANT "DPS_ANWSE2" "1"
 SYSTEM_CONSTANT "DPS_COUNT_EV" "8"
 SYSTEM_CONSTANT "DPS_ENWSE" "0"
 SYSTEM_CONSTANT "DPS_ENWSE2" "1"
 SYSTEM_CONSTANT "DPS_KPE" "0"
 SYSTEM_CONSTANT "DPS_TEVE" "0"
 SYSTEM_CONSTANT "EPK_LEN" "11"
 SYSTEM_CONSTANT "SWOFFD2_REQUEST_MASK" "3"
 SYSTEM_CONSTANT "SWOFFDL_REQUEST_MASK" "16383"
 SYSTEM_CONSTANT "SY_2HFM" "0"
 SYSTEM_CONSTANT "SY_2SG" "0"
 SYSTEM_CONSTANT "SY_2SLS" "0"
 SYSTEM_CONSTANT "SY_2TEV" "0"
 SYSTEM_CONSTANT "SY_AAU" "0"
 SYSTEM_CONSTANT "SY_AAV" "0"
 SYSTEM_CONSTANT "SY_ABGY" "0"
 SYSTEM_CONSTANT "SY_ABGYVBP" "0"
 SYSTEM_CONSTANT "SY_ABMZND" "0"
 SYSTEM_CONSTANT "SY_ADRLAY" "2"
 SYSTEM_CONSTANT "SY_AEKPBI" "0"
 SYSTEM_CONSTANT "SY_AFR" "0"
 SYSTEM_CONSTANT "SY_AGR" "0"
 SYSTEM_CONSTANT "SY_AGR_DSS" "0"
 SYSTEM_CONSTANT "SY_AIRBAG" "0"
 SYSTEM_CONSTANT "SY_ANNWSYN" "4"
 SYSTEM_CONSTANT "SY_ASG" "0"
 SYSTEM_CONSTANT "SY_ASM" "0"
 SYSTEM_CONSTANT "SY_ASR" "1"
 SYSTEM_CONSTANT "SY_ASTIKR" "0"
 SYSTEM_CONSTANT "SY_ATLB" "0"
 SYSTEM_CONSTANT "SY_ATMLA" "0"
 SYSTEM_CONSTANT "SY_ATMST" "0"
 SYSTEM_CONSTANT "SY_ATR" "0"
 SYSTEM_CONSTANT "SY_AWUE" "0"
 SYSTEM_CONSTANT "SY_BATTSG" "0"
 SYSTEM_CONSTANT "SY_BBPHSYN" "0"
 SYSTEM_CONSTANT "SY_BDE" "0"
 SYSTEM_CONSTANT "SY_BGSRM" "0"
 SYSTEM_CONSTANT "SY_BGVMX" "0"
 SYSTEM_CONSTANT "SY_BIOS" "380"
 SYSTEM_CONSTANT "SY_BKV" "0"
 SYSTEM_CONSTANT "SY_BKVP" "0"
 SYSTEM_CONSTANT "SY_BLOOP" "0"
 SYSTEM_CONSTANT "SY_C95ANZ" "1"
 SYSTEM_CONSTANT "SY_CAN" "1"
 SYSTEM_CONSTANT "SY_CANAC" "0"
 SYSTEM_CONSTANT "SY_CARBPROT" "1"
 SYSTEM_CONSTANT "SY_CC195" "0"
 SYSTEM_CONSTANT "SY_CC196" "1"
 SYSTEM_CONSTANT "SY_CDCSIZE" "4"
 SYSTEM_CONSTANT "SY_CDKSIZE" "1"
 SYSTEM_CONSTANT "SY_CDTSIZE" "1"
 SYSTEM_CONSTANT "SY_CJ120" "0"
 SYSTEM_CONSTANT "SY_CJ125" "2"
 SYSTEM_CONSTANT "SY_CJ830" "0"
 SYSTEM_CONSTANT "SY_CJ840" "0"
 SYSTEM_CONSTANT "SY_CJ940" "0"
 SYSTEM_CONSTANT "SY_CJ945" "3"
 SYSTEM_CONSTANT "SY_CLASIZE" "1"
 SYSTEM_CONSTANT "SY_CONFSL" "1"
 SYSTEM_CONSTANT "SY_COPOTI" "0"
 SYSTEM_CONSTANT "SY_CVT" "0"
 SYSTEM_CONSTANT "SY_CY310" "0"
 SYSTEM_CONSTANT "SY_CY315" "1"
 SYSTEM_CONSTANT "SY_DATABUS" "1"
 SYSTEM_CONSTANT "SY_DATIO" "0"
 SYSTEM_CONSTANT "SY_DECOS" "0"
 SYSTEM_CONSTANT "SY_DEGFE" "1"
 SYSTEM_CONSTANT "SY_DELFCMS" "0"
 SYSTEM_CONSTANT "SY_DFPMENV" "4"
 SYSTEM_CONSTANT "SY_DFPMTIM" "2"
 SYSTEM_CONSTANT "SY_DFPMVAR" "3"
 SYSTEM_CONSTANT "SY_DFPNL" "3"
 SYSTEM_CONSTANT "SY_DGANZ" "1"
 SYSTEM_CONSTANT "SY_DISA" "1"
 SYSTEM_CONSTANT "SY_DKAT" "2"
 SYSTEM_CONSTANT "SY_DKATLRS" "0"
 SYSTEM_CONSTANT "SY_DKATSP" "1"
 SYSTEM_CONSTANT "SY_DKHZ" "0"
 SYSTEM_CONSTANT "SY_DLCKD" "40"
 SYSTEM_CONSTANT "SY_DLCPEN" "40"
 SYSTEM_CONSTANT "SY_DLDP" "0"
 SYSTEM_CONSTANT "SY_DLSHV" "0"
 SYSTEM_CONSTANT "SY_DLSU" "0"
 SYSTEM_CONSTANT "SY_DLSUV" "0"
 SYSTEM_CONSTANT "SY_DLSUVBK" "1"
 SYSTEM_CONSTANT "SY_DMDZAG" "0"
 SYSTEM_CONSTANT "SY_DMTL" "0"
 SYSTEM_CONSTANT "SY_DOPZW" "0"
 SYSTEM_CONSTANT "SY_DSL10MS" "0"
 SYSTEM_CONSTANT "SY_DSL2MS" "0"
 SYSTEM_CONSTANT "SY_DSM" "0"
 SYSTEM_CONSTANT "SY_DSS" "1"
 SYSTEM_CONSTANT "SY_DSU" "1"
 SYSTEM_CONSTANT "SY_DSVDK" "0"
 SYSTEM_CONSTANT "SY_DTANKL" "0"
 SYSTEM_CONSTANT "SY_DTES" "2"
 SYSTEM_CONSTANT "SY_DUZND" "0"
 SYSTEM_CONSTANT "SY_DVEADA" "0"
 SYSTEM_CONSTANT "SY_EGAS" "1"
 SYSTEM_CONSTANT "SY_EGFE" "11"
 SYSTEM_CONSTANT "SY_ELKUP" "0"
 SYSTEM_CONSTANT "SY_ENVBLOK" "3"
 SYSTEM_CONSTANT "SY_ERCOS_TIMER_INPUT_SEL" "5"
 SYSTEM_CONSTANT "SY_ESFTVMLF" "25"
 SYSTEM_CONSTANT "SY_ESNWS" "0"
 SYSTEM_CONSTANT "SY_ESTZ" "0"
 SYSTEM_CONSTANT "SY_ESUKNGN" "0"
 SYSTEM_CONSTANT "SY_ETKBYP" "1"
 SYSTEM_CONSTANT "SY_ETKTYP" "2"
 SYSTEM_CONSTANT "SY_F1GETR" "0"
 SYSTEM_CONSTANT "SY_FANT" "0"
 SYSTEM_CONSTANT "SY_FCMDISP" "5"
 SYSTEM_CONSTANT "SY_FCMIRD" "0"
 SYSTEM_CONSTANT "SY_FCMSIZE" "20"
 SYSTEM_CONSTANT "SY_FDTHM" "0"
 SYSTEM_CONSTANT "SY_FFESIZE" "0"
 SYSTEM_CONSTANT "SY_FFTSIZE" "4"
 SYSTEM_CONSTANT "SY_FFXSIZE" "11"
 SYSTEM_CONSTANT "SY_FFZ" "0"
 SYSTEM_CONSTANT "SY_FKAT" "1"
 SYSTEM_CONSTANT "SY_FKAT2" "1"
 SYSTEM_CONSTANT "SY_FLC" "3"
 SYSTEM_CONSTANT "SY_GAP" "2"
 SYSTEM_CONSTANT "SY_GENOT" "0"
 SYSTEM_CONSTANT "SY_GGGTS" "0"
 SYSTEM_CONSTANT "SY_GRDWOF" "0"
 SYSTEM_CONSTANT "SY_GRDWRT" "54"
 SYSTEM_CONSTANT "SY_GRUNDWERT" "54"
 SYSTEM_CONSTANT "SY_HDP" "0"
 SYSTEM_CONSTANT "SY_HFM" "1"
 SYSTEM_CONSTANT "SY_HFM2" "0"
 SYSTEM_CONSTANT "SY_HKAT" "1"
 SYSTEM_CONSTANT "SY_HKAT2" "1"
 SYSTEM_CONSTANT "SY_HLCCARB" "4"
 SYSTEM_CONSTANT "SY_IGNMX" "255"
 SYSTEM_CONSTANT "SY_INGASOS" "10"
 SYSTEM_CONSTANT "SY_INI_OBD" "2"
 SYSTEM_CONSTANT "SY_KHFMDY" "1"
 SYSTEM_CONSTANT "SY_KLDF" "0"
 SYSTEM_CONSTANT "SY_KOEST" "0"
 SYSTEM_CONSTANT "SY_KOEVAB" "1"
 SYSTEM_CONSTANT "SY_KOPWM" "0"
 SYSTEM_CONSTANT "SY_KRLZ" "1"
 SYSTEM_CONSTANT "SY_KS1" "0"
 SYSTEM_CONSTANT "SY_KS2" "1"
 SYSTEM_CONSTANT "SY_KS3" "5"
 SYSTEM_CONSTANT "SY_KS4" "5"
 SYSTEM_CONSTANT "SY_KSZA" "2"
 SYSTEM_CONSTANT "SY_KUPOT" "0"
 SYSTEM_CONSTANT "SY_LAMBTS" "1"
 SYSTEM_CONSTANT "SY_LBK" "6"
 SYSTEM_CONSTANT "SY_LECK" "0"
 SYSTEM_CONSTANT "SY_LENKH" "1"
 SYSTEM_CONSTANT "SY_LFS" "1"
 SYSTEM_CONSTANT "SY_LOWRA" "0"
 SYSTEM_CONSTANT "SY_LRSEZ" "0"
 SYSTEM_CONSTANT "SY_LS" "0"
 SYSTEM_CONSTANT "SY_LSFNHK" "0"
 SYSTEM_CONSTANT "SY_LSFNVK" "0"
 SYSTEM_CONSTANT "SY_LSFNVK2" "0"
 SYSTEM_CONSTANT "SY_LWS" "0"
 SYSTEM_CONSTANT "SY_M1I00A" "191"
 SYSTEM_CONSTANT "SY_M1I00B" "191"
 SYSTEM_CONSTANT "SY_M1I00C" "232"
 SYSTEM_CONSTANT "SY_M1I00D" "145"
 SYSTEM_CONSTANT "SY_M1I20A" "128"
 SYSTEM_CONSTANT "SY_M1I20B" "0"
 SYSTEM_CONSTANT "SY_M1I20C" "17"
 SYSTEM_CONSTANT "SY_M1I20D" "0"
 SYSTEM_CONSTANT "SY_M2I00A" "127"
 SYSTEM_CONSTANT "SY_M2I00B" "184"
 SYSTEM_CONSTANT "SY_M2I00C" "0"
 SYSTEM_CONSTANT "SY_M2I00D" "0"
 SYSTEM_CONSTANT "SY_M5IH00A" "195"
 SYSTEM_CONSTANT "SY_M5IH00B" "0"
 SYSTEM_CONSTANT "SY_M5IH00C" "0"
 SYSTEM_CONSTANT "SY_M5IH00D" "0"
 SYSTEM_CONSTANT "SY_M5IV00A" "195"
 SYSTEM_CONSTANT "SY_M5IV00B" "0"
 SYSTEM_CONSTANT "SY_M5IV00C" "0"
 SYSTEM_CONSTANT "SY_M5IV00D" "0"
 SYSTEM_CONSTANT "SY_M5IV20A" "0"
 SYSTEM_CONSTANT "SY_M5IV20B" "0"
 SYSTEM_CONSTANT "SY_M5IV20C" "0"
 SYSTEM_CONSTANT "SY_M5IV20D" "1"
 SYSTEM_CONSTANT "SY_M5IV40A" "0"
 SYSTEM_CONSTANT "SY_M5IV40B" "0"
 SYSTEM_CONSTANT "SY_M5IV40C" "0"
 SYSTEM_CONSTANT "SY_M5IV40D" "1"
 SYSTEM_CONSTANT "SY_M5IV60A" "0"
 SYSTEM_CONSTANT "SY_M5IV60B" "0"
 SYSTEM_CONSTANT "SY_M5IV60C" "0"
 SYSTEM_CONSTANT "SY_M5IV60D" "1"
 SYSTEM_CONSTANT "SY_M5IV80A" "240"
 SYSTEM_CONSTANT "SY_M5IV80B" "0"
 SYSTEM_CONSTANT "SY_M5IV80C" "0"
 SYSTEM_CONSTANT "SY_M5IV80D" "0"
 SYSTEM_CONSTANT "SY_M6I00A" "168"
 SYSTEM_CONSTANT "SY_M6I00B" "0"
 SYSTEM_CONSTANT "SY_M6I00C" "0"
 SYSTEM_CONSTANT "SY_M6I00D" "0"
 SYSTEM_CONSTANT "SY_M8I00B" "0"
 SYSTEM_CONSTANT "SY_M8I00C" "0"
 SYSTEM_CONSTANT "SY_M8I00D" "0"
 SYSTEM_CONSTANT "SY_M8I00E" "0"
 SYSTEM_CONSTANT "SY_M9I00A" "48"
 SYSTEM_CONSTANT "SY_M9I00B" "0"
 SYSTEM_CONSTANT "SY_M9I00C" "0"
 SYSTEM_CONSTANT "SY_M9I00D" "0"
 SYSTEM_CONSTANT "SY_MAGER" "0"
 SYSTEM_CONSTANT "SY_MLSUBREF" "138"
 SYSTEM_CONSTANT "SY_MODMASK" "0"
 SYSTEM_CONSTANT "SY_NLDG" "0"
 SYSTEM_CONSTANT "SY_NOHK" "0"
 SYSTEM_CONSTANT "SY_NSEXT" "0"
 SYSTEM_CONSTANT "SY_NVRAMBK" "0"
 SYSTEM_CONSTANT "SY_NWACED1" "1"
 SYSTEM_CONSTANT "SY_NWACED2" "1"
 SYSTEM_CONSTANT "SY_NWACED3" "1"
 SYSTEM_CONSTANT "SY_NWACED4" "1"
 SYSTEM_CONSTANT "SY_NWGA" "3"
 SYSTEM_CONSTANT "SY_NWGA2" "4"
 SYSTEM_CONSTANT "SY_NWGE" "1"
 SYSTEM_CONSTANT "SY_NWGE2" "2"
 SYSTEM_CONSTANT "SY_NWRA" "0"
 SYSTEM_CONSTANT "SY_NWRE" "1"
 SYSTEM_CONSTANT "SY_NWS" "2"
 SYSTEM_CONSTANT "SY_NWSA" "2"
 SYSTEM_CONSTANT "SY_NWVAR" "4"
 SYSTEM_CONSTANT "SY_NWZUHW1" "2"
 SYSTEM_CONSTANT "SY_NWZUHW2" "3"
 SYSTEM_CONSTANT "SY_NWZUHW3" "4"
 SYSTEM_CONSTANT "SY_NWZUHW4" "1"
 SYSTEM_CONSTANT "SY_ODT_100MS" "5"
 SYSTEM_CONSTANT "SY_ODT_10MS" "10"
 SYSTEM_CONSTANT "SY_ODT_SYN" "1"
 SYSTEM_CONSTANT "SY_OVERSIZ" "2"
 SYSTEM_CONSTANT "SY_OVLLIM" "3"
 SYSTEM_CONSTANT "SY_PBRPW" "1"
 SYSTEM_CONSTANT "SY_PEDABS" "0"
 SYSTEM_CONSTANT "SY_PGRAD" "4"
 SYSTEM_CONSTANT "SY_PGRAD2" "4"
 SYSTEM_CONSTANT "SY_PGRAD3" "4"
 SYSTEM_CONSTANT "SY_PGRAD4" "4"
 SYSTEM_CONSTANT "SY_PGTPO" "1"
 SYSTEM_CONSTANT "SY_PORTERW" "0"
 SYSTEM_CONSTANT "SY_PORTLATCH" "0"
 SYSTEM_CONSTANT "SY_PTCAN" "0"
 SYSTEM_CONSTANT "SY_RASFAKM" "160"
 SYSTEM_CONSTANT "SY_RASNMAX" "150"
 SYSTEM_CONSTANT "SY_RASNMIN" "75"
 SYSTEM_CONSTANT "SY_RDE" "0"
 SYSTEM_CONSTANT "SY_REDMX" "8"
 SYSTEM_CONSTANT "SY_RLAPP" "0"
 SYSTEM_CONSTANT "SY_RLTEST" "50"
 SYSTEM_CONSTANT "SY_SALSU" "1"
 SYSTEM_CONSTANT "SY_SDFP" "0"
 SYSTEM_CONSTANT "SY_SEGL" "90"
 SYSTEM_CONSTANT "SY_SGANZ" "1"
 SYSTEM_CONSTANT "SY_SLPANST" "0"
 SYSTEM_CONSTANT "SY_SLPANZ" "1"
 SYSTEM_CONSTANT "SY_SLS" "1"
 SYSTEM_CONSTANT "SY_SLSHK" "1"
 SYSTEM_CONSTANT "SY_SLVANST" "0"
 SYSTEM_CONSTANT "SY_SLVANZ" "1"
 SYSTEM_CONSTANT "SY_SLWG" "0"
 SYSTEM_CONSTANT "SY_STA" "1"
 SYSTEM_CONSTANT "SY_STADAP" "1"
 SYSTEM_CONSTANT "SY_STERBTS" "1"
 SYSTEM_CONSTANT "SY_STEREO" "1"
 SYSTEM_CONSTANT "SY_STERHK" "1"
 SYSTEM_CONSTANT "SY_STERSY" "1"
 SYSTEM_CONSTANT "SY_STERVK" "1"
 SYSTEM_CONSTANT "SY_STETLR" "1"
 SYSTEM_CONSTANT "SY_SU" "1"
 SYSTEM_CONSTANT "SY_SWE_B" "0"
 SYSTEM_CONSTANT "SY_SWE_C" "0"
 SYSTEM_CONSTANT "SY_SWE_S" "0"
 SYSTEM_CONSTANT "SY_T6MDTHM" "1"
 SYSTEM_CONSTANT "SY_TABST" "1"
 SYSTEM_CONSTANT "SY_TAMLFINI" "25"
 SYSTEM_CONSTANT "SY_TEBF" "0"
 SYSTEM_CONSTANT "SY_TEETH" "60"
 SYSTEM_CONSTANT "SY_TFA" "1"
 SYSTEM_CONSTANT "SY_TFBA" "0"
 SYSTEM_CONSTANT "SY_TFMA" "1"
 SYSTEM_CONSTANT "SY_TFMAP" "1"
 SYSTEM_CONSTANT "SY_TFMHST" "1"
 SYSTEM_CONSTANT "SY_TFMO" "0"
 SYSTEM_CONSTANT "SY_TFNS" "0"
 SYSTEM_CONSTANT "SY_TFRK" "0"
 SYSTEM_CONSTANT "SY_TFST" "0"
 SYSTEM_CONSTANT "SY_TFUMG" "0"
 SYSTEM_CONSTANT "SY_TFVA" "0"
 SYSTEM_CONSTANT "SY_TFWL" "0"
 SYSTEM_CONSTANT "SY_TKAT" "0"
 SYSTEM_CONSTANT "SY_TLE6232" "0"
 SYSTEM_CONSTANT "SY_TLR" "0"
 SYSTEM_CONSTANT "SY_TN" "1"
 SYSTEM_CONSTANT "SY_TRLX" "0"
 SYSTEM_CONSTANT "SY_TSFSIZE" "1"
 SYSTEM_CONSTANT "SY_TUM" "0"
 SYSTEM_CONSTANT "SY_TURBO" "0"
 SYSTEM_CONSTANT "SY_TVVR" "0"
 SYSTEM_CONSTANT "SY_TWAN" "0"
 SYSTEM_CONSTANT "SY_TWDKS" "0"
 SYSTEM_CONSTANT "SY_TZW" "0"
 SYSTEM_CONSTANT "SY_T_ESFLUES" "1"
 SYSTEM_CONSTANT "SY_UB13V" "138"
 SYSTEM_CONSTANT "SY_UBDEDIS" "74"
 SYSTEM_CONSTANT "SY_UBDEEN" "86"
 SYSTEM_CONSTANT "SY_UBOKDIS" "63"
 SYSTEM_CONSTANT "SY_UBOKEN" "74"
 SYSTEM_CONSTANT "SY_UBR" "0"
 SYSTEM_CONSTANT "SY_UBSQ_W" "965"
 SYSTEM_CONSTANT "SY_UHR" "0"
 SYSTEM_CONSTANT "SY_UMALS" "0"
 SYSTEM_CONSTANT "SY_USBUS" "0"
 SYSTEM_CONSTANT "SY_USBUSIC" "0"
 SYSTEM_CONSTANT "SY_USOFF" "205"
 SYSTEM_CONSTANT "SY_VK_CAN" "64"
 SYSTEM_CONSTANT "SY_VK_KEN" "1"
 SYSTEM_CONSTANT "SY_VK_NL" "4"
 SYSTEM_CONSTANT "SY_VS" "0"
 SYSTEM_CONSTANT "SY_VSA" "0"
 SYSTEM_CONSTANT "SY_VVT" "0"
 SYSTEM_CONSTANT "SY_WFS" "0"
 SYSTEM_CONSTANT "SY_WNBM" "6"
 SYSTEM_CONSTANT "SY_ZAS" "0"
 SYSTEM_CONSTANT "SY_ZIZWV" "1"
 SYSTEM_CONSTANT "SY_ZMS" "0"
 SYSTEM_CONSTANT "SY_ZNDAUS" "1"
 SYSTEM_CONSTANT "SY_ZWCALC" "1"
 SYSTEM_CONSTANT "SY_ZYLOFFH" "3"
 SYSTEM_CONSTANT "SY_ZYLZA" "8"
 SYSTEM_CONSTANT "SY_ZYLZG" "8"
 SYSTEM_CONSTANT "SY_ZZBANK" "210"
 SYSTEM_CONSTANT "SY_ZZLAM" "0"
 SYSTEM_CONSTANT "SY_ZZRL" "0" /end MOD_PAR
/begin MOD_COMMON "" BYTE_ORDER MSB_FIRST ALIGNMENT_BYTE 1 ALIGNMENT_WORD 2 ALIGNMENT_LONG 2 ALIGNMENT_FLOAT32_IEEE 4 /end MOD_COMMON
/* --- AgI-Objekt f¸r CCP (ASAP V1.21), Stand 1.0 31.7.98 --- */
/begin IF_DATA ASAP1B_CCP
 /begin SOURCE "time synchronous event channel - 10 ms" 4 1 /begin QP_BLOB 0 LENGTH 10 CAN_ID_FIXED 0x6A9 RASTER 0 /end QP_BLOB /end SOURCE
 /begin SOURCE "time synchronous event channel - 100 ms" 5 1 /begin QP_BLOB 1 LENGTH 5 CAN_ID_FIXED 0x6AA RASTER 1 /end QP_BLOB /end SOURCE
 /begin SOURCE "segment synchronous event channel" 103 1 /begin QP_BLOB 2 LENGTH 1 CAN_ID_FIXED 0x6A8 RASTER 2 /end QP_BLOB /end SOURCE
 /begin RASTER "time synchronous event channel - 10 ms" "10_ms" 0 4 1 /end RASTER
 /begin RASTER "time synchronous event channel - 100 ms" "100_ms" 1 5 1 /end RASTER
 /begin RASTER "segment synchronous event channel" "seg_sync" 2 103 1 /end RASTER
 /begin SEED_KEY /* seed&key dll for CAL privilege */ "" /* seed&key dll for DAQ privilege */ "" /* seed&key dll for PGM privilege */ "" /end SEED_KEY
 /begin TP_BLOB /* CCP version */ 0x201 /* Blob version */ 0x202 /* CAN msg ID - send */ 0x630 /* CAN msg ID - recv */ 0x631 /* station address */ 0x1 /* byte order */ 1
  /begin CAN_PARAM /* crystal frequency */ 0x1F4 /* timing register 0 */ 0x41 /* timing register 1 */ 0x25 /end CAN_PARAM
  DAQ_MODE BURST CONSISTENCY ODT ADDRESS_EXTENSION ODT
  /begin CHECKSUM_PARAM /* algorithm */ 0x8006 /* limit */ 0xFFFFFFFF CHECKSUM_CALCULATION ACTIVE_PAGE /end CHECKSUM_PARAM
  /begin DEFINED_PAGES 1 "reference page" /* address ext. */ 0x1 /* base address */ 0x5C2000 /* page length */ 0x1DFFF ROM /end DEFINED_PAGES
  /begin DEFINED_PAGES 2 "working page" /* address ext. */ 0x0 /* base address */ 0x902000 /* page length */ 0x1DFFF RAM RAM_INIT_BY_TOOL /end DEFINED_PAGES
  OPTIONAL_CMD 0xC /* SELECT_CAL_PAGE */ OPTIONAL_CMD 0xD /* BUILD_CHKSUM */ OPTIONAL_CMD 0xE /* MOVE */ OPTIONAL_CMD 0x11 /* GET_ACTIVE_CAL_PAGE */ OPTIONAL_CMD 0x19 /* SET_S_STATUS */ OPTIONAL_CMD 0xD /* GET_S_STATUS */ OPTIONAL_CMD 0x12 /* GET_SEED */ OPTIONAL_CMD 0x13 /* UNLOCK */ /end TP_BLOB
/end IF_DATA
/* --- Default-AgI-Objekt */ /* --- AgI-Objekt f¸r ETK (ASAP V1.3B0), Stand 1.0 16.7.98 --- */
/begin IF_DATA ETK
 /begin TP_BLOB /*version:*/ 0x1000001 /*pba:*/ 0x0 /*reset_cfg:*/ 0x40001800
  /begin DISTAB_CFG /*dsptab:*/ 0xD /*dat_mod:*/ 0x1 /*rfg:*/ 0x1 /*trgsegad:*/ 0x900000 /*trg_cfg:*/ 0x1020100 TRG_MOD /*Id:*/ 0x0 /*trg_mod:*/ 0xFF 0x0 0x0 0x0 /end DISTAB_CFG
  CODE_CHK /*prg_data:*/ 0x90217D /*prg_length:*/ 0x1 /*prg_eram:*/ 0x90019C /*prg_length:*/ 0x1 ETK_CFG 0x2 0xc2 0x3d 0xff 0xef 0x3e 0xdf 0xef 0x3d 0xff 0xfb 0xfe 0xff 0xff 0xfe 0xff 0xff 0xff 0xff 0xff 0x3 0x60 0x5 0xff /* EMU_RAM start_addr length CS offset >>>>> (multiple) */ /* EMU_DATA start_addr length CS offset >>>>> (multiple) */ /* EMU_CODE start_addr length CS offset >>>>> (multiple) */ /* RESERVED start_addr length CS offset >>>>> (multiple) */ RESERVED /*start_addr:*/ 0x902190 0x618 EXTERN -1 -1 -1 -1 -1 ETK_MAILBOX /*pattern:*/ 0x55555555 /*page_ecu:*/ DATA /*ecu_adr:*/ 0x903000 /*..length:*/ 0x8000 /*page_am:*/ EXRAM /*am_adr:*/ 0x901000 /*..length:*/ 0x7000 /end TP_BLOB
 /begin SOURCE "Synchro" 103 1 QP_BLOB 1 0x38 0x902190 0x900054 0x900040 0 0 0 /end SOURCE
 /begin SOURCE "10ms" 4 1 QP_BLOB 2 0x58 0x902278 0x90008C 0x900044 10 0 0 /end SOURCE
 /begin SOURCE "100ms" 5 1 QP_BLOB 3 0x58 0x9023E0 0x9000E4 0x900048 100 0 0 /end SOURCE
 /begin SOURCE "Bypass_Synchro" 103 1 QP_BLOB 4 0x30 0x902548 0x90013C 0x90004C 0 0x30 0x9026D8 /end SOURCE
 /begin SOURCE "Bypass_10ms" 4 1 QP_BLOB 5 0x30 0x902610 0x90016C 0x900050 10 0x30 0x902740 /end SOURCE
/end IF_DATA
/begin IF_DATA ASAP1B_KWP2000
 /begin SOURCE "timeslot" 0 0 QP_BLOB 0 BLOCKMODE 0xF0 0 20 /end SOURCE
 /begin TP_BLOB /* Blob version */ 0x100 /* ECU address on k line */ 0x12 /* requ. tester address */ 0xF1 /* ECU stimulation mode */ WuP /* byte order */ MSB_FIRST 1 /* project base address */ 0x0 SERAM /* SERAM_A */ 0x1C0000 /* SERAM_O */ 0x1C0000 /* SERAM_U */ 0x1DFFFE /* SERAM_E */ 0x1DFFFE /* Flash address */ 0x000000 /* RAM address */ 0x000000 /* Data Read */ 1 /* Code Verify */ 0 /* Code Read */ 0 /* Load mode */ 1 /begin CHECKSUM 0x010201 1 1 RequestRoutineResults RNC_RESULT 0x23 /end CHECKSUM
  /begin FLASH_COPY NOFLASHBACK 3 RequestRoutineResults RAM_InitByECU 0x86 COPY_FRAME 1 RNC_RESULT 0x23 0xFB 0xFC /end FLASH_COPY
  BAUD_DEF /* BaudRate */ 10400 /* DiagMode */ 0x86 0x14 BAUD_DEF /* BaudRate */ 20800 /* DiagMode */ 0x86 0x34 TIME_DEF 0x0005 0x0000 0x0032 0x000F 0x1388 0x0002 TIME_DEF 0x0005 0x0000 0x0032 0x0014 0x1388 0x0003 TIME_DEF 0x0014 0x000A 0x0032 0x0014 0x1388 0x0004 TIME_DEF 0x0014 0x0019 0x0032 0x001E 0x1388 0x0005 /end TP_BLOB
/end IF_DATA
/begin CHARACTERISTIC A0 "‹bertragungsfunktionskoeffizient" VALUE 0x1C6B72 KwSw 0.1249981 fak_sw_b0p0625 -0.06250000 0.06249809 FORMAT "%10.8" /end CHARACTERISTIC
/begin CHARACTERISTIC A1 "‹bertragungsfunktionskoeffizient" VALUE 0x1C6B74 KwSw 0.1249981 fak_sw_b0p0625 -0.06250000 0.06249809 FORMAT "%10.8" /end CHARACTERISTIC
/begin CHARACTERISTIC A2 "‹bertragungsfunktionskoeffizient" VALUE 0x1C6B76 KwSw 0.1249981 fak_sw_b0p0625 -0.06250000 0.06249809 FORMAT "%10.8" /end CHARACTERISTIC
/begin CHARACTERISTIC AADKB_FA "Filterfaktor in %AADKB" VALUE 0x1D146A dc_KwUw 50.00000 DC_CNTR_U16 0.00 50.00000 FORMAT "%8.5" /end CHARACTERISTIC
/begin CHARACTERISTIC AADKB_FV "Untergrenze Geschw. zur Dynamikerkennung" VALUE 0x1D2FAA dc_KwUb 255.0 DC_CNTR_U8 0.00 255.0 FORMAT "%5.1" /end CHARACTERISTIC
/begin CHARACTERISTIC AADKB_OF "Filteroffset in %AADKB" VALUE 0x1D146C dc_KwUw 100.0000 DC_CNTR_U16 0.00 100.0000 FORMAT "%8.4" /end CHARACTERISTIC
/begin CHARACTERISTIC AADKB_ON "Zuschaltfunktion von %AADKB" VALUE 0x1D2FAB dc_KwUb 1.000 DC_CNTR_U8 0.00 1.000 FORMAT "%5.3" /end CHARACTERISTIC
/begin CHARACTERISTIC AADKB_RE "Reduktion pro Zyklus in %AADKB" VALUE 0x1D146E dc_KwUw 50.00000 DC_CNTR_U16 0.00 50.00000 FORMAT "%8.5" /end CHARACTERISTIC
/begin CHARACTERISTIC AADKB_SG "Normierungsfaktor MQA dpw-Schwelle" VALUE 0x1D2FAC dc_KwUb 255.0 DC_CNTR_U8 0.00 255.0 FORMAT "%5.1" /end CHARACTERISTIC
/begin CHARACTERISTIC AADKB_SO "oberer Schwellwert" VALUE 0x1D2FAD dc_KwUb 255.0 DC_CNTR_U8 0.00 255.0 FORMAT "%5.1" /end CHARACTERISTIC
/begin CHARACTERISTIC AADKB_SU "unterer Schwellwert" VALUE 0x1D2FAE dc_KwUb 255.0 DC_CNTR_U8 0.00 255.0 FORMAT "%5.1" /end CHARACTERISTIC
/begin CHARACTERISTIC AADNT1 "Eingangsfilterkonstante 1" VALUE 0x1D1470 dc_KwUw 65535.00 DC_CNTR_U16 0.00 65535.00 FORMAT "%8.2" /end CHARACTERISTIC
/begin CHARACTERISTIC AADNT2 "Eingangsfilterkonstante 2" VALUE 0x1D1472 dc_KwUw 65534.00 DC_CNTR_U16 1.000000 65535.00 FORMAT "%8.2" /end CHARACTERISTIC
/begin CHARACTERISTIC AADNT3 "Eingangsfilterkonstante 3" VALUE 0x1D1474 dc_KwUw 65535.00 DC_CNTR_U16 0.00 65535.00 FORMAT "%8.2" /end CHARACTERISTIC
/begin CHARACTERISTIC AADNT4 "Eingangsfilterkonstante 4" VALUE 0x1D1476 dc_KwUw 65535.00 DC_CNTR_U16 0.00 65535.00 FORMAT "%8.2" /end CHARACTERISTIC
/begin CHARACTERISTIC AADNT5 "Eingangsfilterkonstante 5" VALUE 0x1D1478 dc_KwUw 65535.00 DC_CNTR_U16 0.00 65535.00 FORMAT "%8.2" /end CHARACTERISTIC
/begin CHARACTERISTIC AADNTRED "Reduktionskonstante" VALUE 0x1D147A dc_KwUw 65535.00 DC_CNTR_U16 0.00 65535.00 FORMAT "%8.2" /end CHARACTERISTIC
/begin CHARACTERISTIC AADNT_ON "Zuschaltfunktion von %AADNT" VALUE 0x1D2FAF dc_KwUb 1.000 DC_CNTR_U8 0.00 1.000 FORMAT "%5.3" /end CHARACTERISTIC
/begin CHARACTERISTIC AADPD_CB "‹berhˆhung-Basiswert in %AADPD" VALUE 0x1D147C dc_KwUw 64.00000 DC_CNTR_U16 0.00 64.00000 FORMAT "%8.5" /end CHARACTERISTIC
/begin CHARACTERISTIC AADPD_KB "Schwelle ab der KFB voll wirkt in %AADPD" VALUE 0x1D147E dc_KwUw 249.0000 DC_CNTR_U16 1.000000 250.0000 FORMAT "%8.4" /end CHARACTERISTIC
/begin CHARACTERISTIC AADPD_MA "Dynamik Abschalt Momentenschwelle" VALUE 0x1D1480 dc_KwSw 4000.000 DC_TRQ_S16 -2000.000 2000.000 FORMAT "%8.3" /end CHARACTERISTIC
/begin CHARACTERISTIC AADPD_MD "Delta Soll-Ist-Moment" VALUE 0x1D1482 dc_KwSw 4000.000 DC_TRQ_S16 -2000.000 2000.000 FORMAT "%8.3" /end CHARACTERISTIC
/begin CHARACTERISTIC AADPD_MS "Dynamik-Abschaltsteuerung" VALUE 0x1D1484 dc_KwUw 65535.00 DC_CNTR_U16 0.00 65535.00 FORMAT "%8.2" /end CHARACTERISTIC
/begin CHARACTERISTIC AADPD_MT "Dynamik-Abschalttrigger" VALUE 0x1D1486 dc_KwUw 65535.00 DC_CNTR_U16 0.00 65535.00 FORMAT "%8.2" /end CHARACTERISTIC
/begin CHARACTERISTIC AADPD_ON "Zuschaltfunktion von %AADPD" VALUE 0x1D2FB0 dc_KwUb 1.000 DC_CNTR_U8 0.00 1.000 FORMAT "%5.3" /end CHARACTERISTIC
/begin CHARACTERISTIC AADPD_RU "R¸ckschaltschwelle in %AADPD" VALUE 0x1D1488 dc_KwSw 500.0000 DC_CNTR_U16 -500.0000 0.00 FORMAT "%8.4" /end CHARACTERISTIC
/begin CHARACTERISTIC AADPD_TB "Tiefpass-Basiswert in %AADPD" VALUE 0x1D148A dc_KwUw 1000.000 DC_CNTR_U16 0.00 1000.000 FORMAT "%8.3" /end CHARACTERISTIC
/begin CHARACTERISTIC AADPS_FP "Auswahl Fahrprogramm" VALUE 0x1D2FB1 dc_KwUb 255.0 DC_CNTR_U8 0.00 255.0 FORMAT "%5.1" /end CHARACTERISTIC
/begin CHARACTERISTIC AADPS_GM "Mindest Pedalgradient f¸r Variationsgrad-Nachf¸hrung" VALUE 0x1D2FB2 dc_KwUb 255.0 DC_CNTR_U8 0.00 255.0 FORMAT "%5.1" /end CHARACTERISTIC
/begin CHARACTERISTIC AADPS_GV "Gradient f¸r Variationsgrad-Nachf¸hrung" VALUE 0x1D2FB3 dc_KwUb 255.0 DC_CNTR_U8 0.00 255.0 FORMAT "%5.1" /end CHARACTERISTIC
/begin CHARACTERISTIC AADPS_H1 "Hˆhenfaktor Beginn vg-Reduktion" VALUE 0x1D2FB4 dc_KwUb 1.992 DC_FKT128 0.00 1.992 FORMAT "%5.3" /end CHARACTERISTIC
/begin CHARACTERISTIC AADPS_H2 "Hˆhenfaktor Ende vg_reduktion" VALUE 0x1D2FB5 dc_KwUb 1.992 DC_FKT128 0.00 1.992 FORMAT "%5.3" /end CHARACTERISTIC
/begin CHARACTERISTIC AADPS_ON "Zuschaltfunktion von %AADPS" VALUE 0x1D2FB6 dc_KwUb 1.000 DC_CNTR_U8 0.00 1.000 FORMAT "%5.3" /end CHARACTERISTIC
/begin CHARACTERISTIC AADPS_VX "maximaler Variationsgradsprung" VALUE 0x1D2FB7 dc_KwUb 255.0 DC_CNTR_U8 0.00 255.0 FORMAT "%5.1" /end CHARACTERISTIC
/begin CHARACTERISTIC ABOINI "Init-Wert  Start-Z‰hler f¸r Erkennung Benzin im ÷l" VALUE 0x1CBC74 KwUb 255.0 dez 0.00 255.0 FORMAT "%5.1" /end CHARACTERISTIC
/begin CHARACTERISTIC ABOLRAR "Schwelle Anzahl Starts mit Benzin im ÷l f¸r reduzierte LRA" VALUE 0x1CBC75 KwUb 255.0 dez 0.00 255.0 FORMAT "%5.1" /end CHARACTERISTIC
/begin CHARACTERISTIC ABOMX "max. Anzahl Start-Z‰hler f¸r Erkennung Benzin im ÷l" VALUE 0x1CBC76 KwUb 255.0 dez 0.00 255.0 FORMAT "%5.1" /end CHARACTERISTIC
/begin AXIS_PTS AdapAltitudeTempCorrV8 "" 0x1D15D0 AdapAltitudeTempCorr_Coef dc_SstAUwSstUw 1.99997 DC_FCTR_32768_U16 8 0.00 1.99997 FORMAT "%7.5" DEPOSIT ABSOLUTE /end AXIS_PTS
/begin CHARACTERISTIC ANZEKPVLMX "Max. Anzahl EKP Vorl‰ufe ohne Erreichen von Startende" VALUE 0x1CE160 KwUb 255.0 dez 0.00 255.0 FORMAT "%5.1" /end CHARACTERISTIC
/begin CHARACTERISTIC ATMTANS "Temperaturkorrektur der Abgas-Modell-Temperatur" CURVE 0x1CC657 KlAUbSstUbWSb 1275. temp_q5 -640.0 635.0 FORMAT "%5.1"
 /begin AXIS_DESCR STD_AXIS tatu temp_ub_q0p75_o48 3 -48.00 143.3 FORMAT "%5.1" DEPOSIT ABSOLUTE /end AXIS_DESCR
/end CHARACTERISTIC
/begin AXIS_PTS AV08 "Beschleunigungsst¸tzstellen" 0x1D15E4 LongAccel dc_SstAUbSstSb 11.07 DC_UAFZ_S8 8 -5.555 5.512 FORMAT "%5.3" DEPOSIT ABSOLUTE /end AXIS_PTS
/begin CHARACTERISTIC AWALEMX "max. Drehwinkel nach Motorstop" VALUE 0x1C65EC KwWU16 180.0000 kw_q0p1 0.00 180.0000 FORMAT "%8.4" /end CHARACTERISTIC
/begin CHARACTERISTIC B1 "‹bertragungsfunktionskoeffizient" VALUE 0x1C6B78 KwSw 3.999939 fak_sw_b2 -2.000000 1.999939 FORMAT "%8.6" /end CHARACTERISTIC
/begin CHARACTERISTIC B2 "‹bertragungsfunktionskoeffizient" VALUE 0x1C6B7A KwSw 3.999939 fak_sw_b2 -2.000000 1.999939 FORMAT "%8.6" /end CHARACTERISTIC
/begin CHARACTERISTIC CDPCV "Code wort PCV -Ventil vorhanden" VALUE 0x1CBC77 KwUb 255.0 dez 0.00 255.0 FORMAT "%5.1" /end CHARACTERISTIC
/begin AXIS_PTS CVTRATIO "" 0x1D15F0 TCM_Actl_Ratio dc_SstAUbSstUb 5.100000 DC_FCTR_50_U8 13 0.00 5.100000 FORMAT "%8.6" DEPOSIT ABSOLUTE /end AXIS_PTS
/begin CHARACTERISTIC CWALBK "Codewort f¸r die Ladungsbewegungsklappe in %ALBK" VALUE 0x1C33EE KwUb 255.0 dez 0.00 255.0 FORMAT "%5.1" /end CHARACTERISTIC
/begin CHARACTERISTIC CWARMD "Codewort Antiruckelfunktion" VALUE 0x1C6B7C KwUw 65535.00 dez 0.00 65535.00 FORMAT "%8.2" /end CHARACTERISTIC
/begin CHARACTERISTIC CWDKNOLU "" VALUE 0x1CA822 KwUb 255.0 dez 0.00 255.0 FORMAT "%5.1" /end CHARACTERISTIC
/begin CHARACTERISTIC CWEVAB "Codewort zur Abschaltung von Einspritzventilen" VALUE 0x1CE332 KwUb 255.0 dez 0.00 255.0 FORMAT "%5.1" /end CHARACTERISTIC
/begin CHARACTERISTIC CWLBKNOL "Codewort f¸r LBK Notlaufapplikation" VALUE 0x1C33EF KwUb 255.0 dez 0.00 255.0 FORMAT "%5.1" /end CHARACTERISTIC
/begin CHARACTERISTIC DMARMX "Maximalbegrenzung des station‰ren Momenteneingriffs der Antiruckelfunktion" CURVE 0x1CF39A KlAUbSstUbWUw 99.99847 rel_uw_b100 0.00 99.99847 FORMAT "%8.5"
 /begin AXIS_DESCR STD_AXIS tmot temp_ub_q0p75_o48 6 -48.00 143.3 FORMAT "%5.1" DEPOSIT ABSOLUTE /end AXIS_DESCR
/end CHARACTERISTIC
/begin CHARACTERISTIC DNFILO "obere Schwelle f¸r Gradient des Filterausgangs ndfil" VALUE 0x1C6B7E KwSw 8191.750 nmot_sw_q0p25 0.00 8191.750 FORMAT "%8.3" /end CHARACTERISTIC
/begin CHARACTERISTIC DRLASMES "Schwellwert f¸r F¸llungs‰nderung pro Arbeitsspiel zur Freigabe der Diagnose SLS" VALUE 0x1CD104 KwWS16 1535.977 relNWU_q0p0234 -768.0000 767.9766 FORMAT "%8.4" /end CHARACTERISTIC
/begin CHARACTERISTIC DSLVFZMN "vfzg-Schwelle:  Aktivieren Phase 4 durch B_ll-Bedingung" VALUE 0x1CD11E KwWU8 318.8 vfzg_ub_q1p25 0.00 318.8 FORMAT "%5.1" /end CHARACTERISTIC
/begin CHARACTERISTIC DTMDSLA "Temperaturdifferenz zwischen Abstellen und Neustart f¸r Zusatzdiagnose" VALUE 0x1CD11F KwWU8 191.3 temp_ub_q0p75 0.00 191.3 FORMAT "%5.1" /end CHARACTERISTIC
/begin CHARACTERISTIC DTUMTAT "Offset Ansauglufttemperatur -> Umgebungstemperatur" VALUE 0x1CC408 KwUb 191.3 temp_ub_b191p25 0.00 191.3 FORMAT "%5.1" /end CHARACTERISTIC
/begin CHARACTERISTIC DVFZAR "Hysterese fuer Geschwindigkeitsschwelle bei AR" VALUE 0x1C6B34 KwUb 318.8 vfzg_ub_q1p25 0.00 318.8 FORMAT "%5.1" /end CHARACTERISTIC
/begin CHARACTERISTIC DWLBKIRES "Resetierung I-Anteil bei Soll-/Ist-Differenz LBK" VALUE 0x1C33F0 KwSw 3199.951 rel_sw_b1600 -1600.000 1599.951 FORMAT "%8.3" /end CHARACTERISTIC
/begin CHARACTERISTIC DWLBKLRMX "Maximale LBK Soll/Ist Differenz f¸r Reibungskompensation" VALUE 0x1C33F2 KwSw 1599.976 rel_sw_q0p02441 -800.0000 799.9756 FORMAT "%8.4" /end CHARACTERISTIC
/begin CHARACTERISTIC DWLBKSBAMX "LBK Kennlinie erlaubte Soll/Ist Abweichung" CURVE 0x1C33F4 KlAUwSstSwWUw 1599.976 rel_sw_q0p02441 0.00 1599.976 FORMAT "%8.3"
 /begin AXIS_DESCR STD_AXIS lbkgwl_w rel_sw_q0p02441 11 -800.0000 799.9756 FORMAT "%8.4" DEPOSIT ABSOLUTE /end AXIS_DESCR
/end CHARACTERISTIC
/begin AXIS_PTS EBG_RP_SST "St¸tzstellen der Kennlinie EBG_RP_KF Rampensteigungen" 0x1D1600 TransGuard_Cntr dc_SstAUbSstUb 255.0 DC_CNTR_U8 2 0.00 255.0 FORMAT "%5.1" DEPOSIT ABSOLUTE /end AXIS_PTS
/begin AXIS_PTS ECC_sstRotVlv_PReqV08 "" 0x1D1604 TM_ECP_VolFlowLCir dc_SstAUwSstUw 65535. DC_FLOW_U16 8 0.00 65535. FORMAT "%6.0" DEPOSIT ABSOLUTE /end AXIS_PTS
/begin CHARACTERISTIC FATMRML "Faktor fuer die Aufteilung Abgas-/Abgas-Rohrwandtemperatur" CURVE 0x1CC40C GklWUb 0.9961 fak_ub_b1 0.00 0.9961
 /begin AXIS_DESCR COM_AXIS ml_w m_uw_b6553p5 7 0.00 6553.500 AXIS_PTS_REF SML07TMUW /end AXIS_DESCR
/end CHARACTERISTIC
/begin CHARACTERISTIC FATMRML2 "Faktor fuer die Aufteilung Abgas-/Abgas-Rohrwandtemperatur Bank2" CURVE 0x1CC414 GklWUb 0.9961 fak_ub_b1 0.00 0.9961
 /begin AXIS_DESCR COM_AXIS ml_w m_uw_b6553p5 7 0.00 6553.500 AXIS_PTS_REF SML07TMUW /end AXIS_DESCR
/end CHARACTERISTIC
/begin CHARACTERISTIC FKFDARTM "Korrekturfaktor f¸r fdar und fdars" CURVE 0x1CF2B8 KlAUbSstUbWUb 1.992 fak_q0p0078 0.00 1.992 FORMAT "%5.3"
 /begin AXIS_DESCR STD_AXIS tmot temp_ub_q0p75_o48 6 -48.00 143.3 FORMAT "%5.1" DEPOSIT ABSOLUTE /end AXIS_DESCR
/end CHARACTERISTIC
/begin CHARACTERISTIC FLRAWG "Verst‰rkung Lastregler bei AT, WK geschlossen" CURVE 0x1CF2C8 FklWUb 15.94 fak_ub_b16 0.00 15.94 FORMAT "%5.2"
 /begin AXIS_DESCR FIX_AXIS gangi dez 8 0.00 7.000 FORMAT "%5.3" FIX_AXIS_PAR 0 0 8 /end AXIS_DESCR
/end CHARACTERISTIC
/begin CHARACTERISTIC FLRFDAR "Faktor f¸r Verst‰rkung des AR-Eingriffs im Low Range" VALUE 0x1CF2D0 KwUb 3.984 fak_ub_b4 0.00 3.984 FORMAT "%5.3" /end CHARACTERISTIC
/begin CHARACTERISTIC FLRFLRAR "Faktor f¸r Verst‰rkung zur Nachbildung der externen Last im Low Range" VALUE 0x1CF2D1 KwUb 3.984 fak_ub_b4 0.00 3.984 FORMAT "%5.3" /end CHARACTERISTIC
/begin CHARACTERISTIC FLRHG "Verst‰rkung Lastregler" CURVE 0x1CF2D4 FklWUb 15.94 fak_ub_b16 0.00 15.94 FORMAT "%5.2"
 /begin AXIS_DESCR FIX_AXIS gangi dez 8 0.00 7.000 FORMAT "%5.3" FIX_AXIS_PAR 0 0 8 /end AXIS_DESCR
/end CHARACTERISTIC
/begin CHARACTERISTIC FLRKIFZ "Faktor f¸r Verst‰rkung Fahrzeugmodell im Low Range" VALUE 0x1CF2DC KwUb 3.984 fak_ub_b4 0.00 3.984 FORMAT "%5.3" /end CHARACTERISTIC
/begin CHARACTERISTIC FMSLMESS "Freigabe Messfenster in Messphase nach ¸berschreiten des SW durch fmsldyn" VALUE 0x1CD120 KwWU8 0.9961 fak_ub_b1 0.00 0.9961 /end CHARACTERISTIC
/begin CHARACTERISTIC FMSLOFFS "Freigabe Messfenster in Offsetphase nach unterschreiten des SW durch fmsldyn" VALUE 0x1CD121 KwWU8 0.9961 fak_ub_b1 0.00 0.9961 /end CHARACTERISTIC
/begin CHARACTERISTIC FRARAWGS "Verst‰rkungsfaktor Antiruckel bei AT, WK geschlossen f¸r Station‰rpfad" CURVE 0x1CF2E0 FklWUb 3.113 fak_ub_b3p125 0.00 3.113 FORMAT "%5.3"
 /begin AXIS_DESCR FIX_AXIS gangi dez 8 0.00 7.000 FORMAT "%5.3" FIX_AXIS_PAR 0 0 8 /end AXIS_DESCR
/end CHARACTERISTIC
/begin CHARACTERISTIC FRARHGS "Verst‰rkungsfaktor Antiruckel f¸r Station‰rpfad" CURVE 0x1CF2E8 FklWUb 3.113 fak_ub_b3p125 0.00 3.113 FORMAT "%5.3"
 /begin AXIS_DESCR FIX_AXIS gangi dez 8 0.00 7.000 FORMAT "%5.3" FIX_AXIS_PAR 0 0 8 /end AXIS_DESCR
/end CHARACTERISTIC
/begin CHARACTERISTIC FWMABGW "Faktor f¸r W‰rmemengen bei Wiederholstart f¸r Taupunktende Abgas vor Vorkat" VALUE 0x1CC41B KwUb 0.9961 fak_ub_b1 0.00 0.9961 /end CHARACTERISTIC
/begin CHARACTERISTIC FWMABGW2 "Faktor f¸r W‰rmemengen bei Wiederholstart Abgas Bank2" VALUE 0x1CC41C KwUb 0.9961 fak_ub_b1 0.00 0.9961 /end CHARACTERISTIC
/begin CHARACTERISTIC FWMKATW "Faktor f¸r W‰rmemengen bei Wiederholstart f¸r Taupunktende hinter Hauptkat" VALUE 0x1CC41D KwUb 0.9961 fak_ub_b1 0.00 0.9961 /end CHARACTERISTIC
/begin CHARACTERISTIC FWMKATW2 "Faktor f¸r W‰rmemengen bei Wiederholstart f¸r Taupunktende hinter Hauptkat Bank2" VALUE 0x1CC41E KwUb 0.9961 fak_ub_b1 0.00 0.9961 /end CHARACTERISTIC
/begin CHARACTERISTIC GAP_TOOTH "Differenz L¸cke SW-Benchmark in Z‰hnen" VALUE 0x1C65F8 KwWU8 120.0 dez 0.00 120.0 FORMAT "%5.1" /end CHARACTERISTIC
/begin CHARACTERISTIC HYDFRMOF "zul‰ssige Abweichung von frm-Offset-Schwelle" VALUE 0x1CD106 KwWS16 1.999969 fak_sw_b1 -1.000000 0.9999695 FORMAT "%8.6" /end CHARACTERISTIC
/begin CHARACTERISTIC IMLATDSL "min. Luftmassenfluﬂ f¸r Adaption/Zusatzdiagnose" VALUE 0x1CD108 KwWU16 23.30133 m_uw_b23p3 0.00 23.30133 FORMAT "%8.5" /end CHARACTERISTIC
/begin CHARACTERISTIC IMLATDSLK "min. Luftmassenfluﬂ f¸r Kurztest" VALUE 0x1CD10A KwWU16 23.30133 m_uw_b23p3 0.00 23.30133 FORMAT "%8.5" /end CHARACTERISTIC
/begin CHARACTERISTIC IMLKS "Schwelle f¸r integrierten Luftmassenstrom f¸r Erkennung Benzin im ÷l" VALUE 0x1CBC78 KwUb 23.21 m_ub_b23p3 0.00 23.21 FORMAT "%5.2" /end CHARACTERISTIC
/begin CHARACTERISTIC IMTUMTAT "Schwelle integrierte Luftmasse f¸r Bestimmung Umgebungstemperatur aus TANS" VALUE 0x1CC41F KwUb 23.21 m_ub_b23p3 0.00 23.21 FORMAT "%5.2" /end CHARACTERISTIC
/begin AXIS_PTS IntkAir_TempV8 "" 0x1D1616 IntkAir_Temp dc_SstAUwSstSw 8191.875 temp_sw_q1p25Em1 8 -4096.000 4095.875 FORMAT "%8.3" DEPOSIT ABSOLUTE /end AXIS_PTS
/begin CHARACTERISTIC KATMEXML "Exotherme Temperatur im KAT tkatm" CURVE 0x1CC420 GklWSb 1275. temp_q5 -640.0 635.0 FORMAT "%5.1"
 /begin AXIS_DESCR COM_AXIS ml_w m_uw_b6553p5 7 0.00 6553.500 AXIS_PTS_REF SML07TMUW /end AXIS_DESCR
/end CHARACTERISTIC
/begin CHARACTERISTIC KATMEXML2 "Exotherme Temperatur im Kat, Bank 2" CURVE 0x1CC428 GklWSb 1275. temp_q5 -640.0 635.0 FORMAT "%5.1"
 /begin AXIS_DESCR COM_AXIS ml_w m_uw_b6553p5 7 0.00 6553.500 AXIS_PTS_REF SML07TMUW /end AXIS_DESCR
/end CHARACTERISTIC
/begin CHARACTERISTIC KATMIEXML "Exotherme Temperatur im KAT tikatm" CURVE 0x1CC430 GklWSb 1275. temp_q5 -640.0 635.0 FORMAT "%5.1"
 /begin AXIS_DESCR COM_AXIS ml_w m_uw_b6553p5 7 0.00 6553.500 AXIS_PTS_REF SML07TMUW /end AXIS_DESCR
/end CHARACTERISTIC
/begin CHARACTERISTIC KATMIEXML2 "Exotherme Temperatur im KAT tikatm, Bank 2" CURVE 0x1CC438 GklWSb 1275. temp_q5 -640.0 635.0 FORMAT "%5.1"
 /begin AXIS_DESCR COM_AXIS ml_w m_uw_b6553p5 7 0.00 6553.500 AXIS_PTS_REF SML07TMUW /end AXIS_DESCR
/end CHARACTERISTIC
/begin CHARACTERISTIC KFATMABKA "Faktor f¸r Abgastemperaturabnahme = f(Abstellzeit,Umgebungstemperatur)" MAP 0x1CC440 GkfWUb 0.9961 fak_ub_b1 0.00 0.9961
 /begin AXIS_DESCR COM_AXIS tabstatm_w t1sxs_uw_q1 6 0.00 65535.00 AXIS_PTS_REF STS06TMUW /end AXIS_DESCR
 /begin AXIS_DESCR COM_AXIS tatu temp_ub_q0p75_o48 5 -48.00 143.3 AXIS_PTS_REF STU05TMUB /end AXIS_DESCR
/end CHARACTERISTIC
/begin CHARACTERISTIC KFATMABKA2 "Faktor f¸r Abgastemperaturabnahme = f(Abstellzeit,Umgebungstemperatur), Bank2" MAP 0x1CC460 GkfWUb 0.9961 fak_ub_b1 0.00 0.9961
 /begin AXIS_DESCR COM_AXIS tabstatm_w t1sxs_uw_q1 6 0.00 65535.00 AXIS_PTS_REF STS06TMUW /end AXIS_DESCR
 /begin AXIS_DESCR COM_AXIS tatu temp_ub_q0p75_o48 5 -48.00 143.3 AXIS_PTS_REF STU05TMUB /end AXIS_DESCR
/end CHARACTERISTIC
/begin CHARACTERISTIC KFATMABKK "Faktor f¸r Abnahme der Katalysatortemperatur = f(Abstellzeit,Umg.temp.)" MAP 0x1CC480 GkfWUb 0.9961 fak_ub_b1 0.00 0.9961
 /begin AXIS_DESCR COM_AXIS tabstatm_w t1sxs_uw_q1 6 0.00 65535.00 AXIS_PTS_REF STS06TMUW /end AXIS_DESCR
 /begin AXIS_DESCR COM_AXIS tatu temp_ub_q0p75_o48 5 -48.00 143.3 AXIS_PTS_REF STU05TMUB /end AXIS_DESCR
/end CHARACTERISTIC
/begin CHARACTERISTIC KFATMABKK2 "Faktor f¸r Abnahme der Katalysatortemperatur = f(Abstellzeit,Umg.temp.), Bank2" MAP 0x1CC4A0 GkfWUb 0.9961 fak_ub_b1 0.00 0.9961
 /begin AXIS_DESCR COM_AXIS tabstatm_w t1sxs_uw_q1 6 0.00 65535.00 AXIS_PTS_REF STS06TMUW /end AXIS_DESCR
 /begin AXIS_DESCR COM_AXIS tatu temp_ub_q0p75_o48 5 -48.00 143.3 AXIS_PTS_REF STU05TMUB /end AXIS_DESCR
/end CHARACTERISTIC
/begin CHARACTERISTIC KFATMLA "Kennfeld Abgastemperatur-Korrektur = f(Lambda)" MAP 0x1CC4C0 GkfWSb 1275. temp_q5 -640.0 635.0 FORMAT "%5.1"
 /begin AXIS_DESCR COM_AXIS ml_w m_uw_b6553p5 6 0.00 6553.500 AXIS_PTS_REF SML06TMUW /end AXIS_DESCR
 /begin AXIS_DESCR COM_AXIS lamsbg_w fak_uw_b16 6 0.00 15.99976 AXIS_PTS_REF SLX06TMUW /end AXIS_DESCR
/end CHARACTERISTIC
/begin CHARACTERISTIC KFATMLA2 "Kennfeld Abgastemperatur-Korrektur = f(lambda) Bank2" MAP 0x1CC4E4 GkfWSb 1275. temp_q5 -640.0 635.0 FORMAT "%5.1"
 /begin AXIS_DESCR COM_AXIS ml_w m_uw_b6553p5 6 0.00 6553.500 AXIS_PTS_REF SML06TMUW /end AXIS_DESCR
 /begin AXIS_DESCR COM_AXIS lamsbg2_w fak_uw_b16 6 0.00 15.99976 AXIS_PTS_REF SLY06TMUW /end AXIS_DESCR
/end CHARACTERISTIC
/begin CHARACTERISTIC KFATMZW "Kennfeld Abgastemperatur-Korrektur = f(Z¸ndwinkelverstellung)" MAP 0x1CC508 GkfWSb 1275. temp_q5 -640.0 635.0 FORMAT "%5.1"
 /begin AXIS_DESCR COM_AXIS ml_w m_uw_b6553p5 6 0.00 6553.500 AXIS_PTS_REF SML06TMUW /end AXIS_DESCR
 /begin AXIS_DESCR COM_AXIS etazwimt rel_ub_b127p5 6 0.00 127.5 AXIS_PTS_REF SEZ06TMUB /end AXIS_DESCR
/end CHARACTERISTIC
/begin CHARACTERISTIC KFATMZW2 "Kennfeld Abgastemperatur-Korrektur = f(Z¸ndwinkel) Bank2" MAP 0x1CC52C GkfWSb 1275. temp_q5 -640.0 635.0 FORMAT "%5.1"
 /begin AXIS_DESCR COM_AXIS ml_w m_uw_b6553p5 6 0.00 6553.500 AXIS_PTS_REF SML06TMUW /end AXIS_DESCR
 /begin AXIS_DESCR COM_AXIS etazwimt rel_ub_b127p5 6 0.00 127.5 AXIS_PTS_REF SEZ06TMUB /end AXIS_DESCR
/end CHARACTERISTIC
/begin CHARACTERISTIC KFDMDADP "Obere Schwelle f¸r Momenteneingriff bei Dashpot" MAP 0x1CF3AE GkfWUw 99.99847 rel_uw_b100 0.00 99.99847 FORMAT "%8.5" /begin AXIS_DESCR COM_AXIS gangi dez 6 0.00 255.0 AXIS_PTS_REF SGA06MDUB /end AXIS_DESCR
 /begin AXIS_DESCR COM_AXIS mkar_w rel_sw_b100 8 -100.0000 99.99695 AXIS_PTS_REF SMK08MDSW /end AXIS_DESCR
/end CHARACTERISTIC
/begin CHARACTERISTIC KFDMDARO "Obere Schwelle f¸r Momenteneingriff" MAP 0x1CF40E GkfWUw 99.99847 rel_uw_b100 0.00 99.99847 FORMAT "%8.5" /begin AXIS_DESCR COM_AXIS gangi dez 6 0.00 255.0 AXIS_PTS_REF SGA06MDUB /end AXIS_DESCR
 /begin AXIS_DESCR COM_AXIS mkar_w rel_sw_b100 8 -100.0000 99.99695 AXIS_PTS_REF SMK08MDSW /end AXIS_DESCR
/end CHARACTERISTIC
/begin CHARACTERISTIC KFDMDAROS "Obere Schwelle f¸r Momenteneingriff station‰r" MAP 0x1CF46E GkfWUw 99.99847 rel_uw_b100 0.00 99.99847 FORMAT "%8.5" /begin AXIS_DESCR COM_AXIS gangi dez 6 0.00 255.0 AXIS_PTS_REF SGA06MDUB /end AXIS_DESCR
 /begin AXIS_DESCR COM_AXIS mkar_w rel_sw_b100 8 -100.0000 99.99695 AXIS_PTS_REF SMK08MDSW /end AXIS_DESCR
/end CHARACTERISTIC
/begin CHARACTERISTIC KFFGDMAR "Gewichtungsfaktor f¸r maximalen station‰ren Antiruckel-Eingriff" MAP 0x1CF2F0 KfAxUbAyUbSstxUbSstyUbWUb 1.992 fak_ub_b2 0.00 1.992 FORMAT "%5.3"
 /begin AXIS_DESCR STD_AXIS rl rel_ub_q0p75 6 0.00 191.3 FORMAT "%5.1" DEPOSIT ABSOLUTE /end AXIS_DESCR
 /begin AXIS_DESCR STD_AXIS nmot nmot_ub_q40 6 0.00 10200. FORMAT "%5.0" DEPOSIT ABSOLUTE /end AXIS_DESCR
/end CHARACTERISTIC
/begin CHARACTERISTIC KFFRARAW "Verst‰rkungsfaktor bei AT, WK geschlossen" MAP 0x1CF324 KfAxUbAyUbSstxUbSstyUbWUb 3.113 fak_ub_b3p125 0.00 3.113 FORMAT "%5.3"
 /begin AXIS_DESCR STD_AXIS nmot nmot_ub_q40 6 0.00 10200. FORMAT "%5.0" DEPOSIT ABSOLUTE /end AXIS_DESCR
 /begin AXIS_DESCR STD_AXIS gangi dez 7 0.00 255.0 FORMAT "%5.1" DEPOSIT ABSOLUTE /end AXIS_DESCR
/end CHARACTERISTIC
/begin CHARACTERISTIC KFFRARHG "Verst‰rkungsfaktor" MAP 0x1CF360 KfAxUbAyUbSstxUbSstyUbWUb 3.113 fak_ub_b3p125 0.00 3.113 FORMAT "%5.3"
 /begin AXIS_DESCR STD_AXIS nmot nmot_ub_q40 6 0.00 10200. FORMAT "%5.0" DEPOSIT ABSOLUTE /end AXIS_DESCR
 /begin AXIS_DESCR STD_AXIS gangi dez 7 0.00 255.0 FORMAT "%5.1" DEPOSIT ABSOLUTE /end AXIS_DESCR
/end CHARACTERISTIC
/begin CHARACTERISTIC KFTATM "Kennfeld Abgastemperatur   f(nmot,rl)" MAP 0x1CC550 KfAxUbAyUbSstxUbSstyUbWUb 1275. temp_ub_q5_o50 -50.00 1225. FORMAT "%5.0"
 /begin AXIS_DESCR STD_AXIS nmot nmot_ub_q40 8 0.00 10200. FORMAT "%5.0" DEPOSIT ABSOLUTE /end AXIS_DESCR
 /begin AXIS_DESCR STD_AXIS rl rel_ub_q0p75 8 0.00 191.3 FORMAT "%5.1" DEPOSIT ABSOLUTE /end AXIS_DESCR
/end CHARACTERISTIC
/begin CHARACTERISTIC KFTATM2 "Kennfeld Abgastemperatur f(nmot,rl) Bank2" MAP 0x1CC5A4 KfAxUbAyUbSstxUbSstyUbWUb 1275. temp_ub_q5_o50 -50.00 1225. FORMAT "%5.0"
 /begin AXIS_DESCR STD_AXIS nmot nmot_ub_q40 8 0.00 10200. FORMAT "%5.0" DEPOSIT ABSOLUTE /end AXIS_DESCR
 /begin AXIS_DESCR STD_AXIS rl rel_ub_q0p75 8 0.00 191.3 FORMAT "%5.1" DEPOSIT ABSOLUTE /end AXIS_DESCR
/end CHARACTERISTIC
/begin CHARACTERISTIC KFTEVP "Kennfeld Periodendauer TEV" MAP 0x1CDCC0 KfAxUbAyUbSstxUbSstyUbWUb 127.5 t500usxms_ub_q0p5 0.00 127.5 FORMAT "%5.1"
 /begin AXIS_DESCR STD_AXIS nmot nmot_ub_q40 5 0.00 10200. FORMAT "%5.0" DEPOSIT ABSOLUTE /end AXIS_DESCR
 /begin AXIS_DESCR STD_AXIS tateroh rel_ub_b99p6 9 0.00 99.61 FORMAT "%5.2" DEPOSIT ABSOLUTE /end AXIS_DESCR
/end CHARACTERISTIC
/begin CHARACTERISTIC KFTVTEV "Kennfeld Verzugszeit Tankentl¸ftungsventil" MAP 0x1CDD00 KfAxUbAyUbSstxUbSstyUbWUb 127.5 t500usxms_ub_q0p5 0.00 127.5 FORMAT "%5.1"
 /begin AXIS_DESCR STD_AXIS ub spg_ubatt 6 0.00 24.02 FORMAT "%5.2" DEPOSIT ABSOLUTE /end AXIS_DESCR
 /begin AXIS_DESCR STD_AXIS tans temp_ub_q0p75_o48 3 -48.00 143.3 FORMAT "%5.1" DEPOSIT ABSOLUTE /end AXIS_DESCR
/end CHARACTERISTIC
/begin CHARACTERISTIC KFWMABG "Kennfeld f¸r W‰rmemengen-Schwellwert Taupunktende Abgas" MAP 0x1CC65E GkfWUw 29825.71 q_q0p4551 0.00 29825.71 FORMAT "%8.2"
 /begin AXIS_DESCR COM_AXIS tabgmst temp_ub_q5_o50 7 -50.00 1225. AXIS_PTS_REF ST107TMUB /end AXIS_DESCR
 /begin AXIS_DESCR COM_AXIS tmst temp_ub_q0p75_o48 5 -48.00000 49103.25 AXIS_PTS_REF STM05TMUB /end AXIS_DESCR
/end CHARACTERISTIC
/begin CHARACTERISTIC KFWMABG2 "Kennfeld f¸r W‰rmemengen-Schwellwert Taupunktende Abgas Bank2" MAP 0x1CC6A4 GkfWUw 29825.71 q_q0p4551 0.00 29825.71 FORMAT "%8.2"
 /begin AXIS_DESCR COM_AXIS tabgmst2 temp_ub_q5_o50 7 -50.00 1225. AXIS_PTS_REF ST207TMUB /end AXIS_DESCR
 /begin AXIS_DESCR COM_AXIS tmst temp_ub_q0p75_o48 5 -48.00000 49103.25 AXIS_PTS_REF STM05TMUB /end AXIS_DESCR
/end CHARACTERISTIC
/begin CHARACTERISTIC KFWMKAT "Kennfeld f¸r W‰rmemengen-Schwellwert Taupunktende hinter Kat" MAP 0x1CC6EA GkfWUw 29825.71 q_q0p4551 0.00 29825.71 FORMAT "%8.2"
 /begin AXIS_DESCR COM_AXIS tkatmst temp_ub_q5_o50 7 -50.00 1225. AXIS_PTS_REF ST307TMUB /end AXIS_DESCR
 /begin AXIS_DESCR COM_AXIS tmst temp_ub_q0p75_o48 5 -48.00000 49103.25 AXIS_PTS_REF STM05TMUB /end AXIS_DESCR
/end CHARACTERISTIC
/begin CHARACTERISTIC KFWMKAT2 "Kennfeld f¸r W‰rmemengen-Schwellwert Taupunktende hinter Kat Bank2" MAP 0x1CC730 GkfWUw 29825.71 q_q0p4551 0.00 29825.71 FORMAT "%8.2"
 /begin AXIS_DESCR COM_AXIS tkatmst2 temp_ub_q5_o50 7 -50.00 1225. AXIS_PTS_REF ST407TMUB /end AXIS_DESCR
 /begin AXIS_DESCR COM_AXIS tmst temp_ub_q0p75_o48 5 -48.00000 49103.25 AXIS_PTS_REF STM05TMUB /end AXIS_DESCR
/end CHARACTERISTIC
/begin CHARACTERISTIC KIFZGAWG "Integratorverst‰rkung des Fahrzeugmodells bei AT, geschlossene WK" CURVE 0x1CF4CE FklWUw 4863.926 fak_uw_b4864 0.00 4863.926 FORMAT "%8.3"
 /begin AXIS_DESCR FIX_AXIS gangi dez 8 0.00 7.000 FORMAT "%5.3" FIX_AXIS_PAR 0 0 8 /end AXIS_DESCR
/end CHARACTERISTIC
/begin CHARACTERISTIC KIFZGHG "Integratorverst‰rkung des Fahrzeugmodells bei Handschalter" CURVE 0x1CF4DE FklWUw 4863.926 fak_uw_b4864 0.00 4863.926 FORMAT "%8.3"
 /begin AXIS_DESCR FIX_AXIS gangi dez 8 0.00 7.000 FORMAT "%5.3" FIX_AXIS_PAR 0 0 8 /end AXIS_DESCR
/end CHARACTERISTIC
/begin CHARACTERISTIC KLAADO2 "statische Pedal-Variation oben Handschalter" CURVE 0x1D14D0 dc_GKlWUw 100.0000 DC_PER0327 0.00 100.0000 FORMAT "%8.4"
 /begin AXIS_DESCR COM_AXIS APP_ADD DC_PER0327 16 0.00 100.0000 AXIS_PTS_REF SWPEDV16 /end AXIS_DESCR
/end CHARACTERISTIC
/begin CHARACTERISTIC KLAADO3 "statische Pedal-Variation oben W163" CURVE 0x1D14F0 dc_GKlWUw 100.0000 DC_PER0327 0.00 100.0000 FORMAT "%8.4"
 /begin AXIS_DESCR COM_AXIS APP_ADD DC_PER0327 16 0.00 100.0000 AXIS_PTS_REF SWPEDV16 /end AXIS_DESCR
/end CHARACTERISTIC
/begin CHARACTERISTIC KLAADO4 "statische Pedal-Variation oben vor KLD4" CURVE 0x1D1510 dc_GKlWUw 100.0000 DC_PER0327 0.00 100.0000 FORMAT "%8.4"
 /begin AXIS_DESCR COM_AXIS APP_ADD DC_PER0327 16 0.00 100.0000 AXIS_PTS_REF SWPEDV16 /end AXIS_DESCR
/end CHARACTERISTIC
/begin CHARACTERISTIC KLAADPSO "statische Fahrpedalcharakteristik Kennlinie oben" CURVE 0x1D1530 dc_GKlWUw 100.0000 DC_PER0327 0.00 100.0000 FORMAT "%8.4"
 /begin AXIS_DESCR COM_AXIS APP_ADD DC_PER0327 16 0.00 100.0000 AXIS_PTS_REF SWPEDV16 /end AXIS_DESCR
/end CHARACTERISTIC
/begin CHARACTERISTIC KLAADPSU "statische Fahrpedalcharakteristik Kennlinie unten" CURVE 0x1D1550 dc_GKlWUw 100.0000 DC_PER0327 0.00 100.0000 FORMAT "%8.4"
 /begin AXIS_DESCR COM_AXIS APP_ADD DC_PER0327 16 0.00 100.0000 AXIS_PTS_REF SWPEDV16 /end AXIS_DESCR
/end CHARACTERISTIC
/begin CHARACTERISTIC KLAADU2 "statische Pedal-Variation unten Handschalter" CURVE 0x1D1570 dc_GKlWUw 100.0000 DC_PER0327 0.00 100.0000 FORMAT "%8.4"
 /begin AXIS_DESCR COM_AXIS APP_ADD DC_PER0327 16 0.00 100.0000 AXIS_PTS_REF SWPEDV16 /end AXIS_DESCR
/end CHARACTERISTIC
/begin CHARACTERISTIC KLAADU3 "statische Pedal-Variation unten W163" CURVE 0x1D1590 dc_GKlWUw 100.0000 DC_PER0327 0.00 100.0000 FORMAT "%8.4"
 /begin AXIS_DESCR COM_AXIS APP_ADD DC_PER0327 16 0.00 100.0000 AXIS_PTS_REF SWPEDV16 /end AXIS_DESCR
/end CHARACTERISTIC
/begin CHARACTERISTIC KLAADU4 "statische Pedal-Variation unten vor KLD4" CURVE 0x1D15B0 dc_GKlWUw 100.0000 DC_PER0327 0.00 100.0000 FORMAT "%8.4"
 /begin AXIS_DESCR COM_AXIS APP_ADD DC_PER0327 16 0.00 100.0000 AXIS_PTS_REF SWPEDV16 /end AXIS_DESCR
/end CHARACTERISTIC
/begin CHARACTERISTIC KLAADWAB "Wandlerabsenkung" CURVE 0x1D148C dc_GKlWUb 1.00000 DC_FKT255 0.00 1.00000
 /begin AXIS_DESCR COM_AXIS Veh_Spd DC_VEHSPD_KMH_U16 4 0.00 4095.938 AXIS_PTS_REF VWAG04 /end AXIS_DESCR
/end CHARACTERISTIC
/begin CHARACTERISTIC KLALETM "Kennlinie f¸r R¸ckdreh Zahnzeiten" CURVE 0x1C65E4 KlAxU8SstxU8WU8 255.000 t1ms_ub_b255 0.00 255.000
 /begin AXIS_DESCR STD_AXIS tmot temp_ub_q0p75_o48 3 -48.00 143.3 FORMAT "%5.1" DEPOSIT ABSOLUTE /end AXIS_DESCR
/end CHARACTERISTIC
/begin CHARACTERISTIC KLATMILAE "Exotherme Temperaturabnahme bei Anfettung tikatm" CURVE 0x1CC5F8 GklWUb 1.992 fak_ub_b2 0.00 1.992 FORMAT "%5.3"
 /begin AXIS_DESCR COM_AXIS lamsbg_w fak_uw_b16 6 0.00 15.99976 AXIS_PTS_REF SLX06TMUW /end AXIS_DESCR
/end CHARACTERISTIC
/begin CHARACTERISTIC KLATMILAE2 "Exotherme Temperaturabnahme bei Anfettung tikatm, Bank 2" CURVE 0x1CC600 GklWUb 1.992 fak_ub_b2 0.00 1.992 FORMAT "%5.3"
 /begin AXIS_DESCR COM_AXIS lamsbg2_w fak_uw_b16 6 0.00 15.99976 AXIS_PTS_REF SLY06TMUW /end AXIS_DESCR
/end CHARACTERISTIC
/begin CHARACTERISTIC KLATMIZWE "Exotherme Temperaturabnahme im Kat bei sp‰terem Z¸ndwinkel tikatm" CURVE 0x1CC608 GklWUb 1.992 fak_ub_b2 0.00 1.992 FORMAT "%5.3"
 /begin AXIS_DESCR COM_AXIS etazwimt rel_ub_b127p5 6 0.00 127.5 AXIS_PTS_REF SEZ06TMUB /end AXIS_DESCR
/end CHARACTERISTIC
/begin CHARACTERISTIC KLATMIZWE2 "Exotherme Temperaturabnahme im Kat bei sp‰terem Z¸ndwinkel tikatm, Bank2" CURVE 0x1CC610 GklWUb 1.992 fak_ub_b2 0.00 1.992 FORMAT "%5.3"
 /begin AXIS_DESCR COM_AXIS etazwimt rel_ub_b127p5 6 0.00 127.5 AXIS_PTS_REF SEZ06TMUB /end AXIS_DESCR
/end CHARACTERISTIC
/begin CHARACTERISTIC KLATMLAE "Exotherme Temperaturabnahme bei Anfettung" CURVE 0x1CC618 GklWUb 1.992 fak_ub_b2 0.00 1.992 FORMAT "%5.3"
 /begin AXIS_DESCR COM_AXIS lamsbg_w fak_uw_b16 6 0.00 15.99976 AXIS_PTS_REF SLX06TMUW /end AXIS_DESCR
/end CHARACTERISTIC
/begin CHARACTERISTIC KLATMLAE2 "Exotherme Temperaturabnahme bei Anfettung, Bank 2" CURVE 0x1CC620 GklWUb 1.992 fak_ub_b2 0.00 1.992 FORMAT "%5.3"
 /begin AXIS_DESCR COM_AXIS lamsbg2_w fak_uw_b16 6 0.00 15.99976 AXIS_PTS_REF SLY06TMUW /end AXIS_DESCR
/end CHARACTERISTIC
/begin CHARACTERISTIC KLATMZWE "Exotherme Temperaturabnahme im Kat bei sp‰terem Z¸ndwinkel tkatm" CURVE 0x1CC628 GklWUb 1.992 fak_ub_b2 0.00 1.992 FORMAT "%5.3"
 /begin AXIS_DESCR COM_AXIS etazwimt rel_ub_b127p5 6 0.00 127.5 AXIS_PTS_REF SEZ06TMUB /end AXIS_DESCR
/end CHARACTERISTIC
/begin CHARACTERISTIC KLATMZWE2 "Exotherme Temperaturabnahme im Kat bei sp‰terem Z¸ndwinkel, Bank 2" CURVE 0x1CC630 GklWUb 1.992 fak_ub_b2 0.00 1.992 FORMAT "%5.3"
 /begin AXIS_DESCR COM_AXIS etazwimt rel_ub_b127p5 6 0.00 127.5 AXIS_PTS_REF SEZ06TMUB /end AXIS_DESCR
/end CHARACTERISTIC
/begin CHARACTERISTIC KLLBKRDANT "LBK Lageregler Kennlinie P-Anteil" VAL_BLK 0x1CA670 KwbUb 3.984 fak_ub_b4 0.00 3.984 FORMAT "%5.3" NUMBER 21 /end CHARACTERISTIC
/begin CHARACTERISTIC KLLBKRIANT "LBK Lageregler Kennlinie I-Anteil" VAL_BLK 0x1CA688 KwbUb 0.9961 fak_ub_b1 0.00 0.9961 NUMBER 21 /end CHARACTERISTIC
/begin CHARACTERISTIC KLLBKRPANT "LBK Lageregler Kennlinie P-Anteil" VAL_BLK 0x1CA6A0 KwbUb 3.984 fak_ub_b4 0.00 3.984 FORMAT "%5.3" NUMBER 21 /end CHARACTERISTIC
/begin CHARACTERISTIC KLVGK1 "v-abh. Variationsgrad Komfort f¸r KLD1" CURVE 0x1D1490 dc_GKlWUb 255.0 DC_CNTR_U8 0.00 255.0 FORMAT "%5.1"
 /begin AXIS_DESCR COM_AXIS Veh_Spd DC_VEHSPD_KMH_U16 4 0.00 4095.938 AXIS_PTS_REF VVGAU1 /end AXIS_DESCR
/end CHARACTERISTIC
/begin CHARACTERISTIC KLVGK2 "v-abh. Variationsgrad Komfort f¸r KLD2" CURVE 0x1D1494 dc_GKlWUb 255.0 DC_CNTR_U8 0.00 255.0 FORMAT "%5.1"
 /begin AXIS_DESCR COM_AXIS Veh_Spd DC_VEHSPD_KMH_U16 4 0.00 4095.938 AXIS_PTS_REF VVGAU2 /end AXIS_DESCR
/end CHARACTERISTIC
/begin CHARACTERISTIC KLVGK3 "v-abh. Variationsgrad Komfort f¸r KLD3" CURVE 0x1D1498 dc_GKlWUb 255.0 DC_CNTR_U8 0.00 255.0 FORMAT "%5.1"
 /begin AXIS_DESCR COM_AXIS Veh_Spd DC_VEHSPD_KMH_U16 4 0.00 4095.938 AXIS_PTS_REF VVGAU3 /end AXIS_DESCR
/end CHARACTERISTIC
/begin CHARACTERISTIC KLVGK4 "v-abh. Variationsgrad Komfort f¸r KLD4" CURVE 0x1D149C dc_GKlWUb 255.0 DC_CNTR_U8 0.00 255.0 FORMAT "%5.1"
 /begin AXIS_DESCR COM_AXIS Veh_Spd DC_VEHSPD_KMH_U16 4 0.00 4095.938 AXIS_PTS_REF VVGAU4 /end AXIS_DESCR
/end CHARACTERISTIC
/begin CHARACTERISTIC KLVGO1 "v-abh. Variationsgrad AAD oben f¸r KLD1" CURVE 0x1D14A0 dc_GKlWUb 255.0 DC_CNTR_U8 0.00 255.0 FORMAT "%5.1"
 /begin AXIS_DESCR COM_AXIS Veh_Spd DC_VEHSPD_KMH_U16 4 0.00 4095.938 AXIS_PTS_REF VVGAO1 /end AXIS_DESCR
/end CHARACTERISTIC
/begin CHARACTERISTIC KLVGO2 "v-abh. Variationsgrad AAD oben f¸r KLD2" CURVE 0x1D14A4 dc_GKlWUb 255.0 DC_CNTR_U8 0.00 255.0 FORMAT "%5.1"
 /begin AXIS_DESCR COM_AXIS Veh_Spd DC_VEHSPD_KMH_U16 4 0.00 4095.938 AXIS_PTS_REF VVGAO2 /end AXIS_DESCR
/end CHARACTERISTIC
/begin CHARACTERISTIC KLVGO3 "v-abh. Variationsgrad AAD oben f¸r KLD3" CURVE 0x1D14A8 dc_GKlWUb 255.0 DC_CNTR_U8 0.00 255.0 FORMAT "%5.1"
 /begin AXIS_DESCR COM_AXIS Veh_Spd DC_VEHSPD_KMH_U16 4 0.00 4095.938 AXIS_PTS_REF VVGAO3 /end AXIS_DESCR
/end CHARACTERISTIC
/begin CHARACTERISTIC KLVGO4 "v-abh. Variationsgrad AAD oben f¸r KLD4" CURVE 0x1D14AC dc_GKlWUb 255.0 DC_CNTR_U8 0.00 255.0 FORMAT "%5.1"
 /begin AXIS_DESCR COM_AXIS Veh_Spd DC_VEHSPD_KMH_U16 4 0.00 4095.938 AXIS_PTS_REF VVGAO4 /end AXIS_DESCR
/end CHARACTERISTIC
/begin CHARACTERISTIC KLVGS1 "v-abh. Variationsgrad Sport f¸r KLD1" CURVE 0x1D14B0 dc_GKlWUb 255.0 DC_CNTR_U8 0.00 255.0 FORMAT "%5.1"
 /begin AXIS_DESCR COM_AXIS Veh_Spd DC_VEHSPD_KMH_U16 4 0.00 4095.938 AXIS_PTS_REF VVGAO1 /end AXIS_DESCR
/end CHARACTERISTIC
/begin CHARACTERISTIC KLVGS2 "v-abh. Variationsgrad Sport f¸r KLD2" CURVE 0x1D14B4 dc_GKlWUb 255.0 DC_CNTR_U8 0.00 255.0 FORMAT "%5.1"
 /begin AXIS_DESCR COM_AXIS Veh_Spd DC_VEHSPD_KMH_U16 4 0.00 4095.938 AXIS_PTS_REF VVGAO2 /end AXIS_DESCR
/end CHARACTERISTIC
/begin CHARACTERISTIC KLVGS3 "v-abh. Variationsgrad Sport f¸r KLD3" CURVE 0x1D14B8 dc_GKlWUb 255.0 DC_CNTR_U8 0.00 255.0 FORMAT "%5.1"
 /begin AXIS_DESCR COM_AXIS Veh_Spd DC_VEHSPD_KMH_U16 4 0.00 4095.938 AXIS_PTS_REF VVGAO3 /end AXIS_DESCR
/end CHARACTERISTIC
/begin CHARACTERISTIC KLVGS4 "v-abh. Variationsgrad Sport f¸r KLD4" CURVE 0x1D14BC dc_GKlWUb 255.0 DC_CNTR_U8 0.00 255.0 FORMAT "%5.1"
 /begin AXIS_DESCR COM_AXIS Veh_Spd DC_VEHSPD_KMH_U16 4 0.00 4095.938 AXIS_PTS_REF VVGAO4 /end AXIS_DESCR
/end CHARACTERISTIC
/begin CHARACTERISTIC KLVGU1 "v-abh. Variationsgrad AAD unten f¸r KLD1" CURVE 0x1D14C0 dc_GKlWUb 255.0 DC_CNTR_U8 0.00 255.0 FORMAT "%5.1"
 /begin AXIS_DESCR COM_AXIS Veh_Spd DC_VEHSPD_KMH_U16 4 0.00 4095.938 AXIS_PTS_REF VVGAU1 /end AXIS_DESCR
/end CHARACTERISTIC
/begin CHARACTERISTIC KLVGU2 "v-abh. Variationsgrad AAD unten f¸r KLD2" CURVE 0x1D14C4 dc_GKlWUb 255.0 DC_CNTR_U8 0.00 255.0 FORMAT "%5.1"
 /begin AXIS_DESCR COM_AXIS Veh_Spd DC_VEHSPD_KMH_U16 4 0.00 4095.938 AXIS_PTS_REF VVGAU2 /end AXIS_DESCR
/end CHARACTERISTIC
/begin CHARACTERISTIC KLVGU3 "v-abh. Variationsgrad AAD unten f¸r KLD3" CURVE 0x1D14C8 dc_GKlWUb 255.0 DC_CNTR_U8 0.00 255.0 FORMAT "%5.1"
 /begin AXIS_DESCR COM_AXIS Veh_Spd DC_VEHSPD_KMH_U16 4 0.00 4095.938 AXIS_PTS_REF VVGAU3 /end AXIS_DESCR
/end CHARACTERISTIC
/begin CHARACTERISTIC KLVGU4 "v-abh. Variationsgrad AAD unten f¸r KLD4" CURVE 0x1D14CC dc_GKlWUb 255.0 DC_CNTR_U8 0.00 255.0 FORMAT "%5.1"
 /begin AXIS_DESCR COM_AXIS Veh_Spd DC_VEHSPD_KMH_U16 4 0.00 4095.938 AXIS_PTS_REF VVGAU4 /end AXIS_DESCR
/end CHARACTERISTIC
/begin CHARACTERISTIC LBKASBSTG "Steigung Anstiegsbegrenzung LBK" VALUE 0x1CA6B6 KwSw 799.9756 rel_sw_q0p02441 0.00 799.9756 FORMAT "%8.4" /end CHARACTERISTIC
/begin CHARACTERISTIC LBKLAGERT "LBK Maximale Zeit f¸r Lage¸berwachungsfehler" VALUE 0x1CA6B8 KwUw 1310.700 t_q0p02 0.00 1310.700 FORMAT "%8.3" /end CHARACTERISTIC
/begin CHARACTERISTIC LBKLIAMAXA "LBK maximaler I-Anteil" VALUE 0x1C3422 KwSw 3199.951 rel_sw_b1600 -1600.000 1599.951 FORMAT "%8.3" /end CHARACTERISTIC
/begin CHARACTERISTIC LBKLKREIS "LBK Kreisverst‰rkung" VALUE 0x1CA6BA KwUw 1.999969 fak_uw_b2 0.00 1.999969 FORMAT "%8.6" /end CHARACTERISTIC
/begin CHARACTERISTIC LBKLKREISS "LBK Kreisverst‰rkung Start" VALUE 0x1CA6BC KwUw 1.999969 fak_uw_b2 0.00 1.999969 FORMAT "%8.6" /end CHARACTERISTIC
/begin CHARACTERISTIC LBKLPID0T "LBK PWM ‹berwachung Zeit 0" VALUE 0x1CA6BE KwUw 1310.700 t_q0p02 0.00 1310.700 FORMAT "%8.3" /end CHARACTERISTIC
/begin CHARACTERISTIC LBKLPID1T "LBK PWM ‹berwachung Zeit 1" VALUE 0x1CA6C0 KwUw 1310.700 t_q0p02 0.00 1310.700 FORMAT "%8.3" /end CHARACTERISTIC
/begin CHARACTERISTIC LBKLPID2T "LBK PWM ‹berwachung Zeit 2" VALUE 0x1CA6C2 KwUw 1310.700 t_q0p02 0.00 1310.700 FORMAT "%8.3" /end CHARACTERISTIC
/begin CHARACTERISTIC LBKLPIDMAX "LBK Lageregler maximales PWM" VALUE 0x1CA6C4 KwUw 99.99847 rel_uw_b100 0.00 99.99847 FORMAT "%8.5" /end CHARACTERISTIC
/begin CHARACTERISTIC LBKLUBSOLL "LBK Batteriespannung Soll" VALUE 0x1CA6B5 KwUb 25.50 spg_q0p1 0.00 25.50 FORMAT "%5.2" /end CHARACTERISTIC
/begin AXIS_PTS LK2_AX "St¸tzstellenverteilung f¸r FTKLK" 0x1D1628 DMTD_TrvrAccelMax_LongAccel dc_SstAUbSstSb 11.07 DC_UAFZ_S8 15 -5.555 5.512 FORMAT "%5.3" DEPOSIT ABSOLUTE /end AXIS_PTS
/begin AXIS_PTS MIST16 "ƒnderungsbegrenzung des Vorgabemoments" 0x1D1638 mist_roh dc_SstAUwSstSw 600.0000 DC_TRQ_S16 8 -100.0000 500.0000 FORMAT "%8.4" DEPOSIT ABSOLUTE /end AXIS_PTS
/begin CHARACTERISTIC MLBKREIBK "LBK spezifisches Reibungsmoment" VALUE 0x1C3424 KwSw 1599.976 rel_sw_q0p02441 -800.0000 799.9756 FORMAT "%8.4" /end CHARACTERISTIC
/begin CHARACTERISTIC MLDSLKMN "min. Luftmasse f¸r Bedingung Kurztest-Diagnose" VALUE 0x1CD10C KwWU16 6553.500 m_uw_b6553p5 0.00 6553.500 FORMAT "%8.3" /end CHARACTERISTIC
/begin CHARACTERISTIC MLDSLKMX "max. Luftmasse f¸r Bedingung Kurztest-Diagnose" VALUE 0x1CD10E KwWU16 6553.500 m_uw_b6553p5 0.00 6553.500 FORMAT "%8.3" /end CHARACTERISTIC
/begin CHARACTERISTIC MLDSLMN "min. Luftmasse f¸r Bedingung Diagnose" VALUE 0x1CD110 KwWU16 6553.500 m_uw_b6553p5 0.00 6553.500 FORMAT "%8.3" /end CHARACTERISTIC
/begin CHARACTERISTIC MLDSLMX "max. Luftmasse f¸r Bedingung Diagnose" VALUE 0x1CD112 KwWU16 6553.500 m_uw_b6553p5 0.00 6553.500 FORMAT "%8.3" /end CHARACTERISTIC
/begin CHARACTERISTIC MLDSLODMN "min. Luftmasse f¸r Bedingung Optionaldiagnose SLS" VALUE 0x1CD114 KwWU16 6553.500 m_uw_b6553p5 0.00 6553.500 FORMAT "%8.3" /end CHARACTERISTIC
/begin CHARACTERISTIC MLDSLODMX "max. Luftmasse f¸r Bedingung Optionaldiagnose SLS" VALUE 0x1CD116 KwWU16 6553.500 m_uw_b6553p5 0.00 6553.500 FORMAT "%8.3" /end CHARACTERISTIC
/begin CHARACTERISTIC MLDSLOFSMN "min. Luftmasse f¸r Bedingung Diagnose (Offsetphase)" VALUE 0x1CD118 KwWU16 6553.500 m_uw_b6553p5 0.00 6553.500 FORMAT "%8.3" /end CHARACTERISTIC
/begin CHARACTERISTIC MLDSLOFSMX "max. Luftmasse f¸r Bedingung Diagnose (Offsetphase)" VALUE 0x1CD11A KwWU16 6553.500 m_uw_b6553p5 0.00 6553.500 FORMAT "%8.3" /end CHARACTERISTIC
/begin CHARACTERISTIC MSNPCV "Massenstrom ¸ber PCV Ventil" CURVE 0x1CBC7C KlAUbSstUbWUb 25.50 m_q0p1 0.00 25.50 FORMAT "%5.2"
 /begin AXIS_DESCR STD_AXIS dpspu p_ub_q10 14 0.00 2550. FORMAT "%5.0" DEPOSIT ABSOLUTE /end AXIS_DESCR
/end CHARACTERISTIC
/begin AXIS_PTS MV_DP "ƒnderungsbegrenzung d. Vorgabemoments" 0x1D164A TrqIndDashpLTC_Req dc_SstAUwSstSw 4095.938 DC_TRQ_S16 8 -2048.000 2047.938 FORMAT "%8.3" DEPOSIT ABSOLUTE /end AXIS_PTS
/begin AXIS_PTS MV_LSD "ƒnderungsbegrenzung des Vorgabemoments" 0x1D165C Eng_Trq dc_SstAUwSstSw 4095.938 md_sw_q0p0625 8 -2048.000 2047.938 FORMAT "%8.3" DEPOSIT ABSOLUTE /end AXIS_PTS
/begin CHARACTERISTIC MXSLPODSLS "maximale Einschaltzahl der SLP f¸r Aktivdiagnosen" VALUE 0x1CD122 KwWU8 255.0 dez 0.00 255.0 FORMAT "%5.1" /end CHARACTERISTIC
/begin CHARACTERISTIC NALEMIN "Drehzahl,untehalb der der Zahnint. aktiviert wird" VALUE 0x1C65EE KwWU16 1000.000 nmot_uw_q0p25 0.00 1000.000 FORMAT "%8.3" /end CHARACTERISTIC
/begin CHARACTERISTIC NARASTGU "Gangabh‰ngige Drehzahlschwelle f¸r AR aktiv" CURVE 0x1C6B38 FklWUb 10200. nmot_ub_q40 0.00 10200. FORMAT "%5.0"
 /begin AXIS_DESCR FIX_AXIS gangi dez 8 0.00 7.000 FORMAT "%5.3" FIX_AXIS_PAR 0 0 8 /end AXIS_DESCR
/end CHARACTERISTIC
/begin CHARACTERISTIC NARLLGA "Drehzahlschwelle f¸r AR im Leerlauf" CURVE 0x1C6B40 FklWUb 10200. nmot_ub_q40 0.00 10200. FORMAT "%5.0"
 /begin AXIS_DESCR FIX_AXIS gangi dez 8 0.00 7.000 FORMAT "%5.3" FIX_AXIS_PAR 0 0 8 /end AXIS_DESCR
/end CHARACTERISTIC
/begin CHARACTERISTIC NARLLMXG "Maximaldrehzahl f¸r Aktivierung Antiruckel-Eingriff im Leerlauf" CURVE 0x1C6B48 FklWUb 10200. nmot_ub_q40 0.00 10200. FORMAT "%5.0"
 /begin AXIS_DESCR FIX_AXIS gangi dez 8 0.00 7.000 FORMAT "%5.3" FIX_AXIS_PAR 0 0 8 /end AXIS_DESCR
/end CHARACTERISTIC
/begin CHARACTERISTIC NARMXG "Maximaldrehzahl f¸r Aktivierung Antiruckel-Eingriff auﬂerhalb Leerlauf" CURVE 0x1C6B50 FklWUb 10200. nmot_ub_q40 0.00 10200. FORMAT "%5.0"
 /begin AXIS_DESCR FIX_AXIS gangi dez 8 0.00 7.000 FORMAT "%5.3" FIX_AXIS_PAR 0 0 8 /end AXIS_DESCR
/end CHARACTERISTIC
/begin CHARACTERISTIC NDFILOG "Schwelle f¸r Filterausgang ndfil" CURVE 0x1C6B80 FklWUw 16383.75 nmot_uw_q0p25 0.00 16383.75 FORMAT "%8.2"
 /begin AXIS_DESCR FIX_AXIS gangi dez 8 0.00 7.000 FORMAT "%5.3" FIX_AXIS_PAR 0 0 8 /end AXIS_DESCR
/end CHARACTERISTIC
/begin CHARACTERISTIC NDIFFOG "Schwelle Drehzahldifferenz zum Auslˆsen Ini der AR beim Verzˆgern" CURVE 0x1CF4EE FklWSw 16383.75 nmot_sw_q0p25 -8192.000 8191.750 FORMAT "%8.3"
 /begin AXIS_DESCR FIX_AXIS gangi dez 8 0.00 7.000 FORMAT "%5.3" FIX_AXIS_PAR 0 0 8 /end AXIS_DESCR
/end CHARACTERISTIC
/begin CHARACTERISTIC NDNWMN "Minimaldrehzahl f¸r Diagnose Nockenwellensteuerung" VALUE 0x1CA8E6 KwUb 10200. nmot_ub_q40 0.00 10200. FORMAT "%5.0" /end CHARACTERISTIC
/begin CHARACTERISTIC NDNWMNFA "Minimaldrehzahl f¸r Diagnose Nockenwellensteuerung bei Testeranforderung" VALUE 0x1CA8E7 KwUb 10200. nmot_ub_q40 0.00 10200. FORMAT "%5.0" /end CHARACTERISTIC
/begin CHARACTERISTIC NDNWMX "Maximaldrehzahl f¸r Diagnose Nockenwellensteuerung" VALUE 0x1CA8E8 KwUb 10200. nmot_ub_q40 0.00 10200. FORMAT "%5.0" /end CHARACTERISTIC
/begin AXIS_PTS NG08 "St¸tzstellenverteilung fuer ng_nhgb" 0x1D166E ng_nhgb dc_SstAUwSstSw 655350. DC_NGRDQ10_S16DB 8 -327680. 327670. FORMAT "%6.0" DEPOSIT ABSOLUTE /end AXIS_PTS
/begin AXIS_PTS NGWF08 "St¸tzstellenverteilung f¸r ng_nhgb" 0x1D1680 ng_nhgb dc_SstAUwSstSw 655350. DC_NGRDQ10_S16DB 8 -327680. 327670. FORMAT "%6.0" DEPOSIT ABSOLUTE /end AXIS_PTS
/begin AXIS_PTS NISTV08 "Drehzahlst¸tzstellenverteilung" 0x1D1692 Eng_Spd dc_SstAUwSstSw 32767.5 DC_ROTSPD_S16 8 -16384.0 16383.5 FORMAT "%7.1" DEPOSIT ABSOLUTE /end AXIS_PTS
/begin AXIS_PTS NISTV17 "Drehzahlst¸tzstellenverteilung" 0x1D16A4 Eng_Spd dc_SstAUwSstSw 32767.5 DC_ROTSPD_S16 16 -16384.0 16383.5 FORMAT "%7.1" DEPOSIT ABSOLUTE /end AXIS_PTS
/begin AXIS_PTS NIST_LSD "St¸tzstellenverteilung ATK" 0x1D16C6 Eng_Spd dc_SstAUwSstSw 32767.5 DC_ROTSPD_S16 8 -16384.0 16383.5 FORMAT "%7.1" DEPOSIT ABSOLUTE /end AXIS_PTS
/begin CHARACTERISTIC NMXSKA "Maximaldrehzahl bei unbekannter Drosselklappenposition -> Ev-Abschaltung" VALUE 0x1C5733 KwUb 10200. nmot_ub_q40 0.00 10200. FORMAT "%5.0" /end CHARACTERISTIC
/begin CHARACTERISTIC NSKAZO "Offset f¸r Drehzahlschwelle zur Abschaltung Z¸ndung bei SKA" VALUE 0x1C5734 KwUb 10200. nmot_ub_q40 0.00 10200. FORMAT "%5.0" /end CHARACTERISTIC
/begin CHARACTERISTIC NTUMTAT "Schwelle Drehzahl f¸r Bestimmung Umgebungstemperatur aus TANS" VALUE 0x1CC636 KwUb 10200. nmot_ub_q40 0.00 10200. FORMAT "%5.0" /end CHARACTERISTIC
/begin AXIS_PTS NVERH "SST-Vert. f¸r Rad- Motordrehzah.-Quotient" 0x1D16D8 nrmverh dc_SstAUwSstUw 1.999969 DC_FKT32768 13 0.00 1.999969 FORMAT "%8.6" DEPOSIT ABSOLUTE /end AXIS_PTS
/begin AXIS_PTS NVERHSP "SST-Verteilung f¸r Rad- u. Motordrehzahl-Quotient bei Sport-NSG" 0x1D16F4 nrmverh dc_SstAUwSstUw 1.999969 DC_FKT32768 13 0.00 1.999969 FORMAT "%8.6" DEPOSIT ABSOLUTE /end AXIS_PTS
/begin CHARACTERISTIC PEKP "Fˆrderleistung EKP" VALUE 0x1CE161 KwUb 25.50 vs_q0p1 0.00 25.50 FORMAT "%5.2" /end CHARACTERISTIC
/begin AXIS_PTS PWV "St¸tzstellenverteilung f¸r KFFVMN (Momentencharakteristik)" 0x1D1710 APP_Char dc_SstAUwSstUw 100.0000 DC_PER0327 16 0.00 100.0000 FORMAT "%8.4" DEPOSIT ABSOLUTE /end AXIS_PTS
/begin CHARACTERISTIC RALEMAX "Begrenzungswinkel f¸r max R¸ckdrehen" VALUE 0x1C65F0 KwWU16 360.0000 kw_q0p1 0.00 360.0000 FORMAT "%8.4" /end CHARACTERISTIC
/begin CHARACTERISTIC RDUNDEF "Winkelbereich in dem keine Plausibilisierung des R¸ckdrehverdachts mˆglich ist" VALUE 0x1C65F2 KwWS16 180.0000 kw_q0p1 0.00 180.0000 FORMAT "%8.4" /end CHARACTERISTIC
/begin CHARACTERISTIC REDABM "Ev-Abschaltmuster f¸r Momentenreduzierung" MAP 0x1C56F3 FkfNoShNoOffWUb 255.0 dez 0.00 255.0 FORMAT "%5.1"
 /begin AXIS_DESCR FIX_AXIS evrbgn_one dez 8 0.00 7.000 FORMAT "%5.3" FIX_AXIS_PAR 0 0 8 /end AXIS_DESCR
 /begin AXIS_DESCR FIX_AXIS redsol_one dez 8 0.00 7.000 FORMAT "%5.3" FIX_AXIS_PAR 0 0 8 /end AXIS_DESCR
/end CHARACTERISTIC
/begin AXIS_PTS SDW21LBSW "" 0x1C3426 dwlbkl_w SstASwSstSw 1599.976 rel_sw_q0p02441 21 -800.0000 799.9756 FORMAT "%8.4" DEPOSIT ABSOLUTE /end AXIS_PTS
/begin AXIS_PTS SEZ06TMUB "St¸tzstellenverteilung, Z¸ndwinkelwirkungsgrad" 0x1CEDB0 etazwimt SstAUbSstUb 127.5 rel_ub_b127p5 6 0.00 127.5 FORMAT "%5.1" DEPOSIT ABSOLUTE /end AXIS_PTS
/begin AXIS_PTS SGA06MDUB "St¸tzstellenverteilung Ist Gang 6 Sst." 0x1CEEEC gangi SstAUbSstUb 255.0 dez 6 0.00 255.0 FORMAT "%5.1" DEPOSIT ABSOLUTE /end AXIS_PTS
/begin AXIS_PTS SLX06TMUW "St¸tzstellenverteilung, Lambdasoll" 0x1CEF02 lamsbg_w SstAUwSstUw 15.99976 fak_uw_b16 6 0.00 15.99976 FORMAT "%8.5" DEPOSIT ABSOLUTE /end AXIS_PTS
/begin AXIS_PTS SLY06TMUW "St¸tzstellenverteilung, Lambdasoll Bank2" 0x1CEF10 lamsbg2_w SstAUwSstUw 15.99976 fak_uw_b16 6 0.00 15.99976 FORMAT "%8.5" DEPOSIT ABSOLUTE /end AXIS_PTS
/begin AXIS_PTS SMK08MDSW "Antiruckelmoment-abh‰ngige St¸tzstellen (Anzahl =8)" 0x1CF4FE mkar_w SstASwSstSw 199.9969 rel_sw_b100 8 -100.0000 99.99695 FORMAT "%8.4" DEPOSIT ABSOLUTE /end AXIS_PTS
/begin AXIS_PTS SML06TMUW "St¸tzstellenverteilung, Luftmasse, 6 St¸tzstellen" 0x1CEF1E ml_w SstAUwSstUw 6553.500 m_uw_b6553p5 6 0.00 6553.500 FORMAT "%8.3" DEPOSIT ABSOLUTE /end AXIS_PTS
/begin AXIS_PTS SML07TMUW "St¸tzstellenverteilung, Luftmasse, 7 St¸tzstellen" 0x1CEF2C ml_w SstAUwSstUw 6553.500 m_uw_b6553p5 7 0.00 6553.500 FORMAT "%8.3" DEPOSIT ABSOLUTE /end AXIS_PTS
/begin AXIS_PTS SST_PWR_VG16 "" 0x1D1734 ETC_VariRate dc_SstAUbSstUb 255.0 DC_DEZ 16 0.00 255.0 FORMAT "%5.1" DEPOSIT ABSOLUTE /end AXIS_PTS
/begin AXIS_PTS sst_TM_CAF_CT_AC_MAF_Req "" 0x1D1748 AC_MAF_Req dc_SstAUbSstUb 255. DC_SD1_U8MB 8 0.00 255. FORMAT "%4.0" DEPOSIT ABSOLUTE /end AXIS_PTS
/begin AXIS_PTS sst_TM_CAF_CT_CoolFanSpd_Req "" 0x1D1752 TM_CAF_CT_CoolFanSpd_Req dc_SstAUwSstSw 200.0031 DC_PER0327 8 -100.0031 100.0000 FORMAT "%8.4" DEPOSIT ABSOLUTE /end AXIS_PTS
/begin AXIS_PTS sst_TM_CAF_CT_ECU_Temp "" 0x1D1764 TM_ECU_Temp dc_SstAUwSstSw 8191.875 DC_TEMP_S16 8 -4096.000 4095.875 FORMAT "%8.3" DEPOSIT ABSOLUTE /end AXIS_PTS
/begin AXIS_PTS sst_TM_CAF_CT_EngLoad "" 0x1D1776 TM_CAF_CT_EngLoad_sstIn dc_SstAUwSstSw 200.0031 DC_PCT_S16 8 -100.0031 100.0000 FORMAT "%8.4" DEPOSIT ABSOLUTE /end AXIS_PTS
/begin AXIS_PTS sst_TM_CAF_CT_ETC "" 0x1D1788 TM_CAF_CT_ETC_sstIn dc_SstAUwSstSw 8191.875 DC_TEMP_S16 8 -4096.000 4095.875 FORMAT "%8.3" DEPOSIT ABSOLUTE /end AXIS_PTS
/begin AXIS_PTS sst_TM_CAF_CT_ETC_C_Setpoint "" 0x1D179A TM_CAF_CT_ETC_C_Setpoint dc_SstAUwSstSw 8191.875 DC_TEMP_S16 8 -4096.000 4095.875 FORMAT "%8.3" DEPOSIT ABSOLUTE /end AXIS_PTS
/begin AXIS_PTS sst_TM_CAF_CT_ExtAir_Temp "" 0x1D17AC TM_CAF_CT_ExtAir_Temp_S dc_SstAUwSstSw 8191.875 DC_TEMP_S16 8 -4096.000 4095.875 FORMAT "%8.3" DEPOSIT ABSOLUTE /end AXIS_PTS
/begin AXIS_PTS sst_TM_CAF_CT_IntkAir_Temp "" 0x1D17BE IntkAir_Temp dc_SstAUwSstSw 8191.875 temp_sw_q1p25Em1 8 -4096.000 4095.875 FORMAT "%8.3" DEPOSIT ABSOLUTE /end AXIS_PTS
/begin AXIS_PTS sst_TM_CAF_CT_MAF "" 0x1D17D0 MAF dc_SstAUwSstUw 65535.00 m_ub_q1p0 16 0.00 65535.00 FORMAT "%8.2" DEPOSIT ABSOLUTE /end AXIS_PTS
/begin AXIS_PTS sst_TM_CAF_CT_Sen_Oil_Temp "" 0x1D17F2 Sen_Oil_Temp dc_SstAUwSstSw 8191.875 temp_sw_q1p25Em1 8 -4096.000 4095.875 FORMAT "%8.3" DEPOSIT ABSOLUTE /end AXIS_PTS
/begin AXIS_PTS sst_TM_CoolFan_MAF_Req "" 0x1D1804 CoolFan_MAF_Req dc_SstAUwSstUw 65535.00 DC_CNTR_U16 16 0.00 65535.00 FORMAT "%8.2" DEPOSIT ABSOLUTE /end AXIS_PTS
/begin AXIS_PTS sst_TM_Cyl_FIRate "" 0x1D1826 TM_Cyl_FIRate_sstIn dc_SstAUwSstUw 1.999969 DC_FKT32768 16 0.00 1.999969 FORMAT "%8.6" DEPOSIT ABSOLUTE /end AXIS_PTS
/begin AXIS_PTS ST107TMUB "St¸tzstellenverteilung, Starttemperatur an Sonde vorne" 0x1CEE48 tabgmst SstAUbSstUb 1275. temp_ub_q5_o50 7 -50.00 1225. FORMAT "%5.0" DEPOSIT ABSOLUTE /end AXIS_PTS
/begin AXIS_PTS ST207TMUB "St¸tzstellenverteilung, Starttemperatur an Sonde vorne, Bank2" 0x1CEE50 tabgmst2 SstAUbSstUb 1275. temp_ub_q5_o50 7 -50.00 1225. FORMAT "%5.0" DEPOSIT ABSOLUTE /end AXIS_PTS
/begin AXIS_PTS ST307TMUB "St¸tzstellenverteilung, Starttemperatur an Sonde hinten" 0x1CEE58 tkatmst SstAUbSstUb 1275. temp_ub_q5_o50 7 -50.00 1225. FORMAT "%5.0" DEPOSIT ABSOLUTE /end AXIS_PTS
/begin AXIS_PTS ST407TMUB "St¸tzstellenverteilung, Starttemperatur an Sonde hinten, Bank2" 0x1CEE60 tkatmst2 SstAUbSstUb 1275. temp_ub_q5_o50 7 -50.00 1225. FORMAT "%5.0" DEPOSIT ABSOLUTE /end AXIS_PTS
/begin AXIS_PTS STM05TMUB "St¸tzstellenverteilung, Motorstarttemperatur" 0x1CEF5C tmst SstAUwSstUw 49151.25 temp_ub_q0p75_o48 5 -48.00000 49103.25 FORMAT "%8.2" DEPOSIT ABSOLUTE /end AXIS_PTS
/begin AXIS_PTS STS06TMUW "St¸tzstellenverteilung, Abgasmassenfluﬂ" 0x1CC776 tabstatm_w SstAUwSstUw 65535.00 t1sxs_uw_q1 6 0.00 65535.00 FORMAT "%8.2" DEPOSIT ABSOLUTE /end AXIS_PTS
/begin AXIS_PTS STU05TMUB "St¸tzstellenverteilung, Ersatz-Umgebungstemperatur" 0x1CC638 tatu SstAUbSstUb 191.3 temp_ub_q0p75_o48 5 -48.00 143.3 FORMAT "%5.1" DEPOSIT ABSOLUTE /end AXIS_PTS
/begin AXIS_PTS SWPEDV16 "St¸tzstellenverteilung f¸r Pedalwert" 0x1D1848 APP_ADD dc_SstAUwSstUw 100.0000 DC_PER0327 16 0.00 100.0000 FORMAT "%8.4" DEPOSIT ABSOLUTE /end AXIS_PTS
/begin CHARACTERISTIC TABGMEX "Abgastemperatur unterhalb der Kat-Anspringtemperatur" VALUE 0x1CC63E KwUb 1275. temp_ub_q5_o50 -50.00 1225. FORMAT "%5.0" /end CHARACTERISTIC
/begin CHARACTERISTIC TALBKFOFF "Feder-Offset Tastverh‰ltnis LBK" VALUE 0x1C3452 KwSw 1599.976 rel_sw_q0p02441 -800.0000 799.9756 FORMAT "%8.4" /end CHARACTERISTIC
/begin CHARACTERISTIC TALBKFSTG "Feder-Steigung f¸r Tastverh‰ltnisaufschaltung LBK" VALUE 0x1C3454 KwSw 1.999969 fak_sw_b1 -1.000000 0.9999695 FORMAT "%8.6" /end CHARACTERISTIC
/begin CHARACTERISTIC TAPVLTM "Schwelle Abstellzeit f¸r EKP-Vorlauf" CURVE 0x1CE164 KlAUbSstUbWUw 65535.00 t1sxs_uw_q1 0.00 65535.00 FORMAT "%8.2"
 /begin AXIS_DESCR STD_AXIS tmotab temp_ub_q0p75_o48 4 -48.00 143.3 FORMAT "%5.1" DEPOSIT ABSOLUTE /end AXIS_DESCR
/end CHARACTERISTIC
/begin CHARACTERISTIC TAREIN "Sperrzeit f¸r Antiruckelfunktion" VALUE 0x1C6B58 KwUb 2.550 t10msxs_ub_b2p55 0.00 2.550 FORMAT "%5.3" /end CHARACTERISTIC
/begin CHARACTERISTIC TASTBFA "Modell-Temperatur vor Vorkatalysator Startwert bei B_faatm Anforderung" VALUE 0x1CC63F KwUb 1275. temp_ub_q5_o50 -50.00 1225. FORMAT "%5.0" /end CHARACTERISTIC
/begin CHARACTERISTIC TATEGMX "Maximales Tastverh‰ltnis f¸r getakteten Betrieb." VALUE 0x1CDD2C KwUw 99.99847 rel_uw_b100 0.00 99.99847 FORMAT "%8.5" /end CHARACTERISTIC
/begin CHARACTERISTIC TATEMSN "Kennlinie Tastverh‰ltnis TEV abh‰ngig vom gew¸nschten Massenstrom" CURVE 0x1CDD2E KlAUwSstUwWUw 99.99847 rel_uw_b100 0.00 99.99847 FORMAT "%8.5"
 /begin AXIS_DESCR STD_AXIS msntev_w m_uw_b25p6 10 0.00 25.59961 FORMAT "%8.5" DEPOSIT ABSOLUTE /end AXIS_DESCR
/end CHARACTERISTIC
/begin CHARACTERISTIC TATMKH "Abgastemperaturkorrektur bei Kat-Heizen aktiv" VALUE 0x1CC640 KwUb 1275. temp_q5 0.00 1275. FORMAT "%5.0" /end CHARACTERISTIC
/begin CHARACTERISTIC TATMKH2 "Abgastemperaturkorrektur bei Kat-Heizen aktiv Bank2" VALUE 0x1CC641 KwUb 1275. temp_q5 0.00 1275. FORMAT "%5.0" /end CHARACTERISTIC
/begin CHARACTERISTIC TATMKW "Abgastemperaturkorrektur bei Kat warmhalten aktiv" VALUE 0x1CC642 KwUb 1275. temp_q5 0.00 1275. FORMAT "%5.0" /end CHARACTERISTIC
/begin CHARACTERISTIC TATMSA "Abgastemperatur bei Schubabschneiden" VALUE 0x1CC643 KwUb 1275. temp_ub_q5_o50 -50.00 1225. FORMAT "%5.0" /end CHARACTERISTIC
/begin CHARACTERISTIC TATMSAE "exotherme Temperaturerhˆhung im Schub" VALUE 0x1CC644 KwUb 1275. temp_ub_q5_o50 -50.00 1225. FORMAT "%5.0" /end CHARACTERISTIC
/begin CHARACTERISTIC TATMSAE2 "exotherme Temperaturerhˆhung im Schub Bank 2" VALUE 0x1CC645 KwUb 1275. temp_ub_q5_o50 -50.00 1225. FORMAT "%5.0" /end CHARACTERISTIC
/begin CHARACTERISTIC TATMSTI "Initialisierungswert f¸r tabgm, tkatm Startwert bei Powerfail" VALUE 0x1CC646 KwUb 1275. temp_ub_q5_o50 -50.00 1225. FORMAT "%5.0" /end CHARACTERISTIC
/begin CHARACTERISTIC TATMTMOT "Motortemperatur warmer Motor , f¸r Temperaturkorrektur beim Kaltstart" VALUE 0x1CC647 KwUb 191.3 temp_ub_q0p75_o48 -48.00 143.3 FORMAT "%5.1" /end CHARACTERISTIC
/begin CHARACTERISTIC TATMTP "Abgastaupunkttemperatur" VALUE 0x1CC648 KwUb 1275. temp_ub_q5_o50 -50.00 1225. FORMAT "%5.0" /end CHARACTERISTIC
/begin CHARACTERISTIC TATMTRKH "Abgastemperaturkorrektur bei Thermoreaktor-Katheizen" VALUE 0x1CC649 KwUb 1275. temp_q5 0.00 1275. FORMAT "%5.0" /end CHARACTERISTIC
/begin CHARACTERISTIC TATMTRKH2 "Abgastemperaturkorrektur bei Thermoreaktor-Katheizen Bank 2" VALUE 0x1CC64A KwUb 1275. temp_q5 0.00 1275. FORMAT "%5.0" /end CHARACTERISTIC
/begin CHARACTERISTIC TATMWMK "Temperaturoffset  f¸r W‰rmemengenberechnung" VALUE 0x1CC64B KwSb 1275. temp_q5 -640.0 635.0 FORMAT "%5.1" /end CHARACTERISTIC
/begin CHARACTERISTIC TDDSLSFG "Zeitverzˆgerung f¸r Freigabe der Zusatzdiagnose SLS (Bank1)" VALUE 0x1CD123 KwWU8 25.50 t_q0p1 0.00 25.50 FORMAT "%5.2" /end CHARACTERISTIC
/begin CHARACTERISTIC TDDSLSLL "Zeitverzˆgerung f¸r Freigabe der SLS-Diagnose durch Leerlauf" VALUE 0x1CD124 KwWU8 25.50 t_q0p1 0.00 25.50 FORMAT "%5.2" /end CHARACTERISTIC
/begin CHARACTERISTIC TDSLMDRL "Einschaltverzˆgerung Delta-rl-Sperre bei Bildung B_dslmes" VALUE 0x1CD125 KwWU8 25.50 t_q0p1 0.00 25.50 FORMAT "%5.2" /end CHARACTERISTIC
/begin CHARACTERISTIC TIKATMOE "Temperaturkorrektur im Kat ohne Exotherme tikatm" VALUE 0x1CC64C KwSb 1275. temp_q5 -640.0 635.0 FORMAT "%5.1" /end CHARACTERISTIC
/begin CHARACTERISTIC TKATMOE "Temperaturkorrektur Kat ohne Exotherme tkatm" VALUE 0x1CC64D KwSb 1275. temp_q5 -640.0 635.0 FORMAT "%5.1" /end CHARACTERISTIC
/begin CHARACTERISTIC TKSTBFA "Modell-Temperatur hinter Hauptkat Startwert bei B_faatm Anforderun" VALUE 0x1CC64E KwUb 1275. temp_ub_q5_o50 -50.00 1225. FORMAT "%5.0" /end CHARACTERISTIC
/begin AXIS_PTS TL8V08 "Lastst¸tzstellen" 0x1D186A Eng_RelLoad dc_SstAUwSstSw 1023.984 rel_sw_q1p562Em2 8 -512.0000 511.9844 FORMAT "%8.4" DEPOSIT ABSOLUTE /end AXIS_PTS
/begin CHARACTERISTIC TLBKLAGDE "LBK Abbaugeschwindigkeit Lager¸berwachungsz‰hler" VALUE 0x1C3456 KwUw 1310.700 t_q0p02 0.00 1310.700 FORMAT "%8.3" /end CHARACTERISTIC
/begin CHARACTERISTIC TLBKLUB "LBK Zeitkonstante Batteriespannungsanpassung" VALUE 0x1CA6C6 KwUw 6553.50000 zk100msxs_uw_b6553 0.100001526 6553.60000 FORMAT "%10.5" /end CHARACTERISTIC
/begin CHARACTERISTIC TLBKPWRSV "LBK Powersave Verzˆgerung" VALUE 0x1CA6C8 KwUw 1310.700 t_q0p02 0.00 1310.700 FORMAT "%8.3" /end CHARACTERISTIC
/begin CHARACTERISTIC TLBKSASB "Tiefpass-Zeikonstante Sollwert/Anstiegsbegrenzung" VALUE 0x1CA6CA KwUw 1309.98001 zk20msxs_uw_b1310 0.0199893187 1310.00000 FORMAT "%10.5" /end CHARACTERISTIC
/begin CHARACTERISTIC TLBKSPT1 "LBK PT1 Konstante f¸r Istwertpr‰diktion aus Sollwert" VALUE 0x1CA6CC KwUw 1309.98001 zk20msxs_uw_b1310 0.0199893187 1310.00000 FORMAT "%10.5" /end CHARACTERISTIC
/begin CHARACTERISTIC TMAR "Untere tmot-Schwelle f¸r AR-Freigabe" VALUE 0x1C6B59 KwUb 191.3 temp_ub_q0p75_o48 -48.00 143.3 FORMAT "%5.1" /end CHARACTERISTIC
/begin CHARACTERISTIC TMDNWMN "Minimale Motortemperatur zur Freigabe der Nockenwellendiagnose" VALUE 0x1CA8E9 KwUb 191.3 temp_ub_q0p75_o48 -48.00 143.3 FORMAT "%5.1" /end CHARACTERISTIC
/begin CHARACTERISTIC TMDNWMX "Maximale Motortemperatur zur Freigabe der Nockenwellendiagnose" VALUE 0x1CA8EA KwUb 191.3 temp_ub_q0p75_o48 -48.00 143.3 FORMAT "%5.1" /end CHARACTERISTIC
/begin CHARACTERISTIC TMESSMN "minimale notwendige Zeit im Messfenster der Messphase" VALUE 0x1CD126 KwWU8 25.50 t_q0p1 0.00 25.50 FORMAT "%5.2" /end CHARACTERISTIC
/begin CHARACTERISTIC TMESSMNK "minimale notwendige Zeit im Messfenster der Messphase bei Funktionsanforderung" VALUE 0x1CD127 KwWU8 25.50 t_q0p1 0.00 25.50 FORMAT "%5.2" /end CHARACTERISTIC
/begin CHARACTERISTIC TMLAST "Sperrzeit bis zum Auslˆsen des Ini der AR beim Verzˆgern" VALUE 0x1C6B5A KwUb 2.550 t10msxs_ub_b2p55 0.00 2.550 FORMAT "%5.3" /end CHARACTERISTIC
/begin CHARACTERISTIC TMSKS "Motortemperaturschwelle f¸r Erkennung Benzin im ÷l" VALUE 0x1CBC99 KwUb 191.3 temp_ub_q0p75_o48 -48.00 143.3 FORMAT "%5.1" /end CHARACTERISTIC
/begin CHARACTERISTIC TMSTABO "Kennlinie f¸r Hochz‰hlen des ABO-Z‰hlers abh‰ngig von der Starttemperatur" CURVE 0x1CBC9C KlAUbSstUbWUb 255.0 dez 0.00 255.0 FORMAT "%5.1"
 /begin AXIS_DESCR STD_AXIS tmst temp_ub_q0p75_o48 4 -48.00 143.3 FORMAT "%5.1" DEPOSIT ABSOLUTE /end AXIS_DESCR
/end CHARACTERISTIC
/begin CHARACTERISTIC TMTKS "Temperaturschwelle f¸r  integrierten Luftmassenstrom f¸r Erkennung Benzin im ÷l" VALUE 0x1CBCA5 KwUb 191.3 temp_ub_q0p75_o48 -48.00 143.3 FORMAT "%5.1" /end CHARACTERISTIC
/begin AXIS_PTS TM_ECF_sstVolFlowV08 "" 0x1D187C ECF_VolFlow dc_SstAUwSstUw 65535. DC_FLOW_U16 8 0.00 65535. FORMAT "%6.0" DEPOSIT ABSOLUTE /end AXIS_PTS
/begin AXIS_PTS TM_ECP_sstECTOutV08 "" 0x1D188E ECTOut dc_SstAUwSstSw 8191.875 temp_sw_q1p25Em1 8 -4096.000 4095.875 FORMAT "%8.3" DEPOSIT ABSOLUTE /end AXIS_PTS
/begin AXIS_PTS TM_ECP_sstVolFlowV08 "" 0x1D18A0 TM_ECP_VolFlow dc_SstAUwSstUw 65535. DC_FLOW_U16 8 0.00 65535. FORMAT "%6.0" DEPOSIT ABSOLUTE /end AXIS_PTS
/begin AXIS_PTS TM_EM_DEM_sst_ECTOutV08 "" 0x1D18B2 ECTOut dc_SstAUwSstSw 8191.875 temp_sw_q1p25Em1 8 -4096.000 4095.875 FORMAT "%8.3" DEPOSIT ABSOLUTE /end AXIS_PTS
/begin AXIS_PTS TM_sstDissHeatFlowClV08 "" 0x1D18C4 TM_DissHeatFlowCl dc_SstAUwSstUw 8191.8750 DC_PWR_S16 8 0.00 8191.8750 DEPOSIT ABSOLUTE /end AXIS_PTS
/begin AXIS_PTS TM_sstDissHeatFlowFanV08 "" 0x1D18D6 TM_DissHeatFlowFan dc_SstAUwSstUw 65535.00 DC_CNTR_U16 8 0.00 65535.00 FORMAT "%8.2" DEPOSIT ABSOLUTE /end AXIS_PTS
/begin AXIS_PTS TM_sstExtAirTV08 "" 0x1D18E8 ExtAir_Temp dc_SstAUwSstSw 65535.00 DC_UTMP_40 8 -32808.00 32727.00 FORMAT "%8.2" DEPOSIT ABSOLUTE /end AXIS_PTS
/begin AXIS_PTS TM_TMP_SP_sstExAiTV08 "" 0x1D18FA ExtAir_Temp dc_SstAUwSstSw 65535.00 DC_UTMP_40 8 -32808.00 32727.00 FORMAT "%8.2" DEPOSIT ABSOLUTE /end AXIS_PTS
/begin CHARACTERISTIC TNLATM "Minimale SG-Nachlaufzeit f¸r ATM - Abstellzeit" VALUE 0x1CC784 KwUw 65535.00 t1sxs_uw_q1 0.00 65535.00 FORMAT "%8.2" /end CHARACTERISTIC
/begin CHARACTERISTIC TNLATMTM "bei tmot > Schwellert  SG-Nachlauf-Anforderung B_nlatm = 1" VALUE 0x1CC64F KwUb 191.3 temp_ub_q0p75_o48 -48.00 143.3 FORMAT "%5.1" /end CHARACTERISTIC
/begin CHARACTERISTIC TNLATMTU "bei tumg (tatu -ATM) > Schwellwert SG-Nachlauf-Anforderung" VALUE 0x1CC650 KwUb 191.3 temp_ub_q0p75_o48 -48.00 143.3 FORMAT "%5.1" /end CHARACTERISTIC
/begin CHARACTERISTIC TNLEKPVL "Schwelle SG-Nachlaufzeit f¸r EKP-Vorlauf" VALUE 0x1CE172 KwUw 6553.500 t100msxs_uw_b6553p6 0.00 6553.500 FORMAT "%8.3" /end CHARACTERISTIC
/begin CHARACTERISTIC TNLZOFF "Verzˆgerungszeit zur Abschaltung der Z¸ndung bei SKA f¸r ‹berwachung" VALUE 0x1C5735 KwUb 2.550 t10msxs_ub_b2p55 0.00 2.550 FORMAT "%5.3" /end CHARACTERISTIC
/begin CHARACTERISTIC TNSTDSL "Schwelle Zeit nach Start f¸r aktivieren Phase 4" VALUE 0x1CD11C KwWU16 6553.500 t_q0p1 0.00 6553.500 FORMAT "%8.3" /end CHARACTERISTIC
/begin CHARACTERISTIC TNWDSTEND "Verzˆgerunszeit nach Startende bis zur Freigabe der Nockenwellendiagnose" VALUE 0x1CA8EC KwUw 6553.500 t100msxs_uw_b6553p5 0.00 6553.500 FORMAT "%8.3" /end CHARACTERISTIC
/begin CHARACTERISTIC TOELDNWMN "Minimale ÷ltemperatur zur Freigabe der Nockenwellendiagnose" VALUE 0x1CA8EE KwUw 1535.977 temp_q0p0234_o273 -273.1500 1262.827 FORMAT "%8.3" /end CHARACTERISTIC
/begin CHARACTERISTIC TOELDNWMX "Maximale ÷ltemperatur zur Freigabe der Nockenwellendiagnose" VALUE 0x1CA8F0 KwUw 1535.977 temp_q0p0234_o273 -273.1500 1262.827 FORMAT "%8.3" /end CHARACTERISTIC
/begin CHARACTERISTIC TOFFSMN "minimale notwendige Zeit im Messfenster der Phase zur Bestimmung des Offsets" VALUE 0x1CD128 KwWU8 25.50 t_q0p1 0.00 25.50 FORMAT "%5.2" /end CHARACTERISTIC
/begin CHARACTERISTIC TOFFSMNK "minimale notw. Zeit im Messfenster der Phase zur Bestimmung des Offsets bei FA" VALUE 0x1CD129 KwWU8 25.50 t_q0p1 0.00 25.50 FORMAT "%5.2" /end CHARACTERISTIC
/begin CHARACTERISTIC TOFFSMX "maximal zul‰ssige Zeit im Messfenster der Phase f¸r Bestimmung des Offsets" VALUE 0x1CD12A KwWU8 25.50 t_q0p1 0.00 25.50 FORMAT "%5.2" /end CHARACTERISTIC
/begin CHARACTERISTIC TPHRLSU "Periodendauer f¸r die Heizertaktung der LSU" VALUE 0x1CCBA2 KwUw 1.048560 t100msxs_q16Em6 0.00 1.048560 FORMAT "%8.6" /end CHARACTERISTIC
/begin CHARACTERISTIC TSTAPVL "Zeit f¸r EKP Aktivierung bei Startautomatik" VALUE 0x1CE162 KwUb 2.550 t10msxs_ub_b2p55 0.00 2.550 FORMAT "%5.3" /end CHARACTERISTIC
/begin CHARACTERISTIC TUMTAIT "Initialisierungswert Umgebungstemperatur aus TANS" VALUE 0x1CC651 KwUb 191.3 temp_ub_q0p75_o48 -48.00 143.3 FORMAT "%5.1" /end CHARACTERISTIC
/begin CHARACTERISTIC TVACRES "zul‰ssige Zeit f¸r Momentenreserve nach Einschalten AC" VALUE 0x1CFE4A KwWU8 25.50 t_q0p1 0.00 25.50 FORMAT "%5.2" /end CHARACTERISTIC
/begin CHARACTERISTIC TVARS "Verzoegerungszeit fuer AR wieder inaktiv" VALUE 0x1C6B5B KwUb 2.550 t10msxs_ub_b2p55 0.00 2.550 FORMAT "%5.3" /end CHARACTERISTIC
/begin CHARACTERISTIC TVARSA "Zeit f¸r Aktivierung dynamischer Antiruckel-Eingriff nach Schubabschalten" VALUE 0x1C6B5C KwUb 2.550 t10msxs_ub_b2p55 0.00 2.550 FORMAT "%5.3" /end CHARACTERISTIC
/begin CHARACTERISTIC TVARSS "Verzˆgerungszeit f¸r AR wieder inaktiv im Station‰rfall" VALUE 0x1C6B5D KwUb 2.550 t10msxs_ub_b2p55 0.00 2.550 FORMAT "%5.3" /end CHARACTERISTIC
/begin CHARACTERISTIC TVENTMN "minimale notwendige Zeit im Messfenster der Phase f¸r Ventildichtigkeitscheck" VALUE 0x1CD12B KwWU8 25.50 t_q0p1 0.00 25.50 FORMAT "%5.2" /end CHARACTERISTIC
/begin CHARACTERISTIC TVENTMNK "minimale notw. Zeit im Messfenster der Phase f¸r Ventildichtigkeitscheck bei FA" VALUE 0x1CD12C KwWU8 25.50 t_q0p1 0.00 25.50 FORMAT "%5.2" /end CHARACTERISTIC
/begin CHARACTERISTIC TVENTMX "maximal zul‰ssige Zeit im Messfenster der Phase f¸r Ventildichtigkeitscheck" VALUE 0x1CD12D KwWU8 25.50 t_q0p1 0.00 25.50 FORMAT "%5.2" /end CHARACTERISTIC
/begin CHARACTERISTIC TVGWHS "Entprellzeit Gangwechsel" VALUE 0x1CFE4B KwWU8 255.0 t_q0p02 0.00 255.0 FORMAT "%5.1" /end CHARACTERISTIC
/begin CHARACTERISTIC TVKUPGW "Verzˆgerungszeit vor R¸cksetzen von B_kupgw nach Einkuppeln" VALUE 0x1C6B5E KwUb 2.550 t10msxs_ub_b2p55 0.00 2.550 FORMAT "%5.3" /end CHARACTERISTIC
/begin CHARACTERISTIC TVKUPHS "Verzˆgerungszeit Kupplungsschalter beim Hochschalten" CURVE 0x1C6B60 FklWUb 2.550 t10msxs_ub_b2p55 0.00 2.550 FORMAT "%5.3"
 /begin AXIS_DESCR FIX_AXIS gangi dez 8 0.00 7.000 FORMAT "%5.3" FIX_AXIS_PAR 0 0 8 /end AXIS_DESCR
/end CHARACTERISTIC
/begin CHARACTERISTIC TVKUPRS "Verzˆgerungszeit Kupplungsschalter beim Runterschalten" CURVE 0x1C6B68 FklWUb 2.550 t10msxs_ub_b2p55 0.00 2.550 FORMAT "%5.3"
 /begin AXIS_DESCR FIX_AXIS gangi dez 8 0.00 7.000 FORMAT "%5.3" FIX_AXIS_PAR 0 0 8 /end AXIS_DESCR
/end CHARACTERISTIC
/begin CHARACTERISTIC TVREABO "Verzugszeit f¸r zur¸cksetzen des Z‰hlers f¸r Benzin im ÷l" VALUE 0x1CBCA6 KwUb 25.50 t100msxs_ub_b25p5 0.00 25.50 FORMAT "%5.2" /end CHARACTERISTIC
/begin CHARACTERISTIC TVTEVPS "Druckabh‰ngige Verzugszeit Tankentl¸ftungsventil" CURVE 0x1CDD20 KlAUbSstUbWUb 127.5 t500usxms_ub_q0p5 0.00 127.5 FORMAT "%5.1"
 /begin AXIS_DESCR STD_AXIS pspu fak_ub_b2 5 0.00 1.992 FORMAT "%5.3" DEPOSIT ABSOLUTE /end AXIS_DESCR
/end CHARACTERISTIC
/begin CHARACTERISTIC TZSPINI "Sperrzeit fuer Filterinitialisierung" VALUE 0x1C6B70 KwUb 2.550 t10msxs_ub_b2p55 0.00 2.550 FORMAT "%5.3" /end CHARACTERISTIC
/begin CHARACTERISTIC USVKKS "Lambdasondenspannungsschwelle f¸r R¸cksetzen des Z‰hlers f¸r Benzin im ÷l" VALUE 0x1CBCA8 KwUw 319.9951 spg_q0p00488 0.00 319.9951 FORMAT "%8.4" /end CHARACTERISTIC
/begin CHARACTERISTIC VARAU "minimale Fahrzeuggeschwindigkeit f¸r ARA - Funktion" VALUE 0x1C6B71 KwUb 317.5 fak_ub_b318p75 0.00 317.5 FORMAT "%5.1" /end CHARACTERISTIC
/begin AXIS_PTS VCANV05 "St¸tzstellenverteilung" 0x1D190C Veh_Spd dc_SstAUwSstUw 4095.938 DC_VEHSPD_KMH_U16 5 0.00 4095.938 FORMAT "%8.3" DEPOSIT ABSOLUTE /end AXIS_PTS
/begin AXIS_PTS VCANV16 "St¸tzstellenverteilung v_can" 0x1D1918 Veh_Spd dc_SstAUwSstUw 4095.938 DC_VEHSPD_KMH_U16 16 0.00 4095.938 FORMAT "%8.3" DEPOSIT ABSOLUTE /end AXIS_PTS
/begin CHARACTERISTIC VFZGMIN "Geschwindigkeitsschwelle zum Generieren von b_vnull" VALUE 0x1CFE48 KwWU16 4097.813 vfzg_uw_q0p0625 0.00 4097.813 FORMAT "%8.3" /end CHARACTERISTIC
/begin CHARACTERISTIC VKSTPVLAB "Fˆrdervolumen EKP Vorlauf aus Abstellzeit" CURVE 0x1CE174 KlAUwSstUwWUw 6553.500 vol_q0p1 0.00 6553.500 FORMAT "%8.3"
 /begin AXIS_DESCR STD_AXIS tabst_w t1sxs_uw_q1 4 0.00 65535.00 FORMAT "%8.2" DEPOSIT ABSOLUTE /end AXIS_DESCR
/end CHARACTERISTIC
/begin CHARACTERISTIC VKSTPVLNL "Fˆrdervolumen EKP Vorlauf aus Nachlaufzeit" VALUE 0x1CE186 KwUw 6553.500 vol_q0p1 0.00 6553.500 FORMAT "%8.3" /end CHARACTERISTIC
/begin CHARACTERISTIC VTUMTAT "Schwelle Fahrzeuggeschwindigkeit f¸r TANS -> Umgebungstemperatur" VALUE 0x1CC652 KwUb 318.8 vfzg_ub_q1p25 0.00 318.8 FORMAT "%5.1" /end CHARACTERISTIC
/begin AXIS_PTS VVGAO1 "St¸tzstellenverteilung v-abh. Variationsgrad AADoben f¸r KLD1" 0x1D193A Veh_Spd dc_SstAUwSstUw 4095.938 DC_VEHSPD_KMH_U16 4 0.00 4095.938 FORMAT "%8.3" DEPOSIT ABSOLUTE /end AXIS_PTS
/begin AXIS_PTS VVGAO2 "St¸tzstellenverteilung v-abh. Variationsgrad AAD oben f¸r KLD2" 0x1D1944 Veh_Spd dc_SstAUwSstUw 4095.938 DC_VEHSPD_KMH_U16 4 0.00 4095.938 FORMAT "%8.3" DEPOSIT ABSOLUTE /end AXIS_PTS
/begin AXIS_PTS VVGAO3 "St¸tzstellenverteilung v-abh. Variationsgrad AAD oben f¸r KLD3" 0x1D194E Veh_Spd dc_SstAUwSstUw 4095.938 DC_VEHSPD_KMH_U16 4 0.00 4095.938 FORMAT "%8.3" DEPOSIT ABSOLUTE /end AXIS_PTS
/begin AXIS_PTS VVGAO4 "St¸tzstellenverteilung v-abh. Variationsgrad AAD oben f¸r KLD4" 0x1D1958 Veh_Spd dc_SstAUwSstUw 4095.938 DC_VEHSPD_KMH_U16 4 0.00 4095.938 FORMAT "%8.3" DEPOSIT ABSOLUTE /end AXIS_PTS
/begin AXIS_PTS VVGAU1 "St¸tzstellenverteilung v-abh. Variationsgrad AAD unten f¸r KLD1" 0x1D1962 Veh_Spd dc_SstAUwSstUw 4095.938 DC_VEHSPD_KMH_U16 4 0.00 4095.938 FORMAT "%8.3" DEPOSIT ABSOLUTE /end AXIS_PTS
/begin AXIS_PTS VVGAU2 "St¸tzstellenverteilung v-abh. Variationsgrad AAD unten f¸r KLD2" 0x1D196C Veh_Spd dc_SstAUwSstUw 4095.938 DC_VEHSPD_KMH_U16 4 0.00 4095.938 FORMAT "%8.3" DEPOSIT ABSOLUTE /end AXIS_PTS
/begin AXIS_PTS VVGAU3 "St¸tzstellenverteilung v-abh. Variationsgrad AAD unten f¸r KLD3" 0x1D1976 Veh_Spd dc_SstAUwSstUw 4095.938 DC_VEHSPD_KMH_U16 4 0.00 4095.938 FORMAT "%8.3" DEPOSIT ABSOLUTE /end AXIS_PTS
/begin AXIS_PTS VVGAU4 "St¸tzstellenverteilung v-abh. Variationsgrad AAD unten f¸r KLD4" 0x1D1980 Veh_Spd dc_SstAUwSstUw 4095.938 DC_VEHSPD_KMH_U16 4 0.00 4095.938 FORMAT "%8.3" DEPOSIT ABSOLUTE /end AXIS_PTS
/begin AXIS_PTS VWAG04 "St¸tzstellenverteilung Wandlerabsenkung %AADPS" 0x1D198A Veh_Spd dc_SstAUwSstUw 4095.938 DC_VEHSPD_KMH_U16 4 0.00 4095.938 FORMAT "%8.3" DEPOSIT ABSOLUTE /end AXIS_PTS
/begin CHARACTERISTIC W360_ALE_IMPL "" VALUE 0x1C65F4 KwWU16 360.0000 kw_q0p1 0.00 360.0000 FORMAT "%8.4" READ_ONLY /end CHARACTERISTIC
/begin CHARACTERISTIC W720_ALE_IMPL "" VALUE 0x1C65F6 KwWU16 719.9000 kw_q0p1 0.1000000 720.0000 FORMAT "%8.4" READ_ONLY /end CHARACTERISTIC
/begin CHARACTERISTIC WLBKSAPNOL "LBK Sollwinkel im Applikationsmodus" VALUE 0x1CA6CE KwSw 1599.976 rel_sw_q0p02441 -800.0000 799.9756 FORMAT "%8.4" /end CHARACTERISTIC
/begin CHARACTERISTIC WMABGKH "Faktor f¸r W‰rmemengenkorrektur bei Katheizen f¸r Taupunktende" VALUE 0x1CC653 KwUb 1.000 fak_ub_b2 0.00 1.000 FORMAT "%5.3" /end CHARACTERISTIC
/begin CHARACTERISTIC WMABGKH2 "Faktor f¸r W‰rmemengenkorrektur bei Katheizen f¸r Taupunktende Bank2" VALUE 0x1CC654 KwUb 1.000 fak_ub_b2 0.00 1.000 FORMAT "%5.3" /end CHARACTERISTIC
/begin CHARACTERISTIC WMKATKH "Faktor f¸r W‰rmemengenkorrektur bei Katheizen f¸r Taupunktende hinter Kat" VALUE 0x1CC655 KwUb 1.000 fak_ub_b2 0.00 1.000 FORMAT "%5.3" /end CHARACTERISTIC
/begin CHARACTERISTIC WMKATKH2 "Faktor f¸r W‰rmemengenkorrektur bei Katheizen f¸r Taupunktende hinter Kat, Bank2" VALUE 0x1CC656 KwUb 1.000 fak_ub_b2 0.00 1.000 FORMAT "%5.3" /end CHARACTERISTIC
/begin CHARACTERISTIC ZATMAML "Zeitkonstante fuer Abgastemperaturmodell" CURVE 0x1CC786 GklWUw 13106.8000 zk200msxs_uw_b13107 0.200000000 13107.0000 FORMAT "%10.4"
 /begin AXIS_DESCR COM_AXIS ml_w m_uw_b6553p5 7 0.00 6553.500 AXIS_PTS_REF SML07TMUW /end AXIS_DESCR
/end CHARACTERISTIC
/begin CHARACTERISTIC ZATMAML2 "Zeitkonstante fuer Abgastemperaturmodell Bank2" CURVE 0x1CC794 GklWUw 13106.8000 zk200msxs_uw_b13107 0.200000000 13107.0000 FORMAT "%10.4"
 /begin AXIS_DESCR COM_AXIS ml_w m_uw_b6553p5 7 0.00 6553.500 AXIS_PTS_REF SML07TMUW /end AXIS_DESCR
/end CHARACTERISTIC
/begin CHARACTERISTIC ZATMIKML "Zeitkonstante fuer Katalysatortemperaturmodell - Temperatur im Kat tikatm" CURVE 0x1CC7A2 GklWUw 13106.8000 zk200msxs_uw_b13107 0.200000000 13107.0000 FORMAT "%10.4"
 /begin AXIS_DESCR COM_AXIS ml_w m_uw_b6553p5 7 0.00 6553.500 AXIS_PTS_REF SML07TMUW /end AXIS_DESCR
/end CHARACTERISTIC
/begin CHARACTERISTIC ZATMIKML2 "Zeitkonstante fuer Katalysatortemperaturmodell - Temperatur im Kat Bank 2" CURVE 0x1CC7B0 GklWUw 13106.8000 zk200msxs_uw_b13107 0.200000000 13107.0000 FORMAT "%10.4"
 /begin AXIS_DESCR COM_AXIS ml_w m_uw_b6553p5 7 0.00 6553.500 AXIS_PTS_REF SML07TMUW /end AXIS_DESCR
/end CHARACTERISTIC
/begin CHARACTERISTIC ZATMKML "Zeitkonstante fuer Katalysatortemperaturmodell - Kat-Temperatur tkatm" CURVE 0x1CC7BE GklWUw 13106.8000 zk200msxs_uw_b13107 0.200000000 13107.0000 FORMAT "%10.4"
 /begin AXIS_DESCR COM_AXIS ml_w m_uw_b6553p5 7 0.00 6553.500 AXIS_PTS_REF SML07TMUW /end AXIS_DESCR
/end CHARACTERISTIC
/begin CHARACTERISTIC ZATMKML2 "Zeitkonstante fuer Katalysatortemperaturmodell - Kat-Temperatur Bank2" CURVE 0x1CC7CC GklWUw 13106.8000 zk200msxs_uw_b13107 0.200000000 13107.0000 FORMAT "%10.4"
 /begin AXIS_DESCR COM_AXIS ml_w m_uw_b6553p5 7 0.00 6553.500 AXIS_PTS_REF SML07TMUW /end AXIS_DESCR
/end CHARACTERISTIC
/begin CHARACTERISTIC ZATMRML "Zeitkonstante fuer Abgastemperaturmodell - Rohrwandtemperatur" CURVE 0x1CC7DA GklWUw 13106.8000 zk200msxs_uw_b13107 0.200000000 13107.0000 FORMAT "%10.4"
 /begin AXIS_DESCR COM_AXIS ml_w m_uw_b6553p5 7 0.00 6553.500 AXIS_PTS_REF SML07TMUW /end AXIS_DESCR
/end CHARACTERISTIC
/begin CHARACTERISTIC ZATMRML2 "Zeitkonstante fuer Abgastemperaturmodell - Rohrwandtemperatur Bank2" CURVE 0x1CC7E8 GklWUw 13106.8000 zk200msxs_uw_b13107 0.200000000 13107.0000 FORMAT "%10.4"
 /begin AXIS_DESCR COM_AXIS ml_w m_uw_b6553p5 7 0.00 6553.500 AXIS_PTS_REF SML07TMUW /end AXIS_DESCR
/end CHARACTERISTIC
/begin MEASUREMENT abmf "Festeinspritzausblendmuster" UBYTE dez 1 100 0 255 FORMAT "%5.1" ECU_ADDRESS 0x8011D9 /end MEASUREMENT
/begin MEASUREMENT abo "Anzahl Starts mit Benzin im ÷l" UBYTE dez 1 100 0 255 FORMAT "%5.1" ECU_ADDRESS 0x7FC723 /end MEASUREMENT
/begin MEASUREMENT ACCompr_Run_Mode_Old "" UBYTE B_TRUE 1 100 0 1 BIT_MASK 0x1 FORMAT "%13.11" ECU_ADDRESS 0x7FA9C5 /end MEASUREMENT
/begin MEASUREMENT ADD_APPDyn_Mem "" UWORD DC_PER0327 1 100 0 200.003 FORMAT "%8.4" ECU_ADDRESS 0x802F44 /end MEASUREMENT
/begin MEASUREMENT ADD_APPFiltd "" UWORD DC_PER0327 1 100 0 200.003 FORMAT "%8.4" ECU_ADDRESS 0x802F08 /end MEASUREMENT
/begin MEASUREMENT ADD_APPFiltd_Mem "" UWORD DC_PER0327 1 100 0 200.003 FORMAT "%8.4" ECU_ADDRESS 0x802F0A /end MEASUREMENT
/begin MEASUREMENT ADD_APPGrdt "" SWORD DC_AP_GRDT_S16 1 100 -32768 32767 FORMAT "%8.2" ECU_ADDRESS 0x802F46 /end MEASUREMENT
/begin MEASUREMENT ADD_APPGrdt_Filtd "" SWORD DC_AP_GRDT_S16 1 100 -32768 32767 FORMAT "%8.2" ECU_ADDRESS 0x802F48 /end MEASUREMENT
/begin MEASUREMENT ADD_APPGrdt_IncrdThres "" UWORD DC_DEZL 1 100 0 65535 FORMAT "%8.2" ECU_ADDRESS 0x802F0C /end MEASUREMENT
/begin MEASUREMENT ADD_APPGrdt_Thres "" UBYTE DC_DEZ 1 100 0 255 FORMAT "%5.1" ECU_ADDRESS 0x803640 /end MEASUREMENT
/begin MEASUREMENT ADD_APP_Mem "" UWORD DC_PER0327 1 100 0 200.003 FORMAT "%8.4" ECU_ADDRESS 0x802F4A /end MEASUREMENT
/begin MEASUREMENT ADD_CDS "" UWORD DC_DEZL 1 100 0 65535 FORMAT "%8.2" ECU_ADDRESS 0x802F0E /end MEASUREMENT
/begin MEASUREMENT ADD_CDS_APPGrdt "" SWORD DC_AP_GRDT_S16 1 100 -32678 32767 FORMAT "%8.2" ECU_ADDRESS 0x802F10 /end MEASUREMENT
/begin MEASUREMENT ADD_CDS_CAN "" UBYTE DC_DEZ 1 100 0 255 FORMAT "%5.1" ECU_ADDRESS 0x803641 /end MEASUREMENT
/begin MEASUREMENT ADD_CDS_Filtd "" UWORD DC_DEZL 1 100 0 65535 FORMAT "%8.2" ECU_ADDRESS 0x802F12 /end MEASUREMENT
/begin MEASUREMENT ADD_CDS_Req "" UBYTE DC_FLAG_U8 1 100 0 1 BIT_MASK 0x1 FORMAT "%5.3" ECU_ADDRESS 0x803642 /end MEASUREMENT
/begin MEASUREMENT ADD_CDS_Thres "" UWORD DC_DEZL 1 100 0 65535 FORMAT "%8.2" ECU_ADDRESS 0x802F14 /end MEASUREMENT
/begin MEASUREMENT ADD_Dynamic_VariRate "" UWORD DC_DEZL 1 100 0 65535 FORMAT "%8.2" ECU_ADDRESS 0x802F4C /end MEASUREMENT
/begin MEASUREMENT ADD_Nerv_Detct "" UBYTE DC_FLAG_U8 1 100 0 1 BIT_MASK 0x1 FORMAT "%5.3" ECU_ADDRESS 0x803655 /end MEASUREMENT
/begin MEASUREMENT ADD_Nerv_Rate "" UBYTE DC_DEZ 1 100 0 255 FORMAT "%5.1" ECU_ADDRESS 0x803656 /end MEASUREMENT
/begin MEASUREMENT aekp8bits "" UBYTE dez 1 100 0 255 FORMAT "%5.1" ECU_ADDRESS 0x800C0C /end MEASUREMENT
/begin MEASUREMENT ALEBits1_10msSwOff "" UBYTE dez 1 100 0 255 FORMAT "%5.1" ECU_ADDRESS 0x801004 /end MEASUREMENT
/begin MEASUREMENT ALEBits_10msSwOff "" UBYTE dez 1 100 0 255 FORMAT "%5.1" ECU_ADDRESS 0x7FC7D4 /end MEASUREMENT
/begin MEASUREMENT ALEBits_tooth_int "" UBYTE dez 1 100 0 255 FORMAT "%5.1" ECU_ADDRESS 0x801005 /end MEASUREMENT
/begin MEASUREMENT ALSUausbits1 "" UBYTE dez 1 100 0 255 FORMAT "%5.1" ECU_ADDRESS 0x80117A /end MEASUREMENT
/begin MEASUREMENT anzeab "Anzahl Segmente Ev-Abschaltung f¸r Notlauf Phasensuche" UBYTE dez 1 100 0 255 FORMAT "%5.1" ECU_ADDRESS 0x8011DA /end MEASUREMENT
/begin MEASUREMENT anzekpvl "Anzahl EKP Vorl‰ufe ohne erreichen von Startende" UBYTE dez 1 100 0 255 FORMAT "%5.1" ECU_ADDRESS 0x7FC7AD /end MEASUREMENT
/begin MEASUREMENT applw1 "1. Applikationswort f. Applik.tools" UWORD DC_CNTR_U16 1 100 0 65535 FORMAT "%8.2" ECU_ADDRESS 0x803516 /end MEASUREMENT
/begin MEASUREMENT APP_ADD "" UWORD DC_PER0327 1 100 0 200.003 FORMAT "%8.4" ECU_ADDRESS 0x802F58 /end MEASUREMENT
/begin MEASUREMENT APP_ADDDyn "dynamisch variierter Pedalwert nach %AADPD, normiert (15 Bit)" UWORD DC_PER0327 1 100 0 200.003 FORMAT "%8.4" ECU_ADDRESS 0x802F4E /end MEASUREMENT
/begin MEASUREMENT aqelhp "Durchsatzanforderung an elektr. Heizpumpe von Thermomanagement" UWORD rel_uw_b200 1 100 0 199.997 FORMAT "%8.4" ECU_ADDRESS 0x801926 /end MEASUREMENT
/begin MEASUREMENT ATMbits "" UBYTE dez 1 100 0 255 FORMAT "%5.1" ECU_ADDRESS 0x7FC726 /end MEASUREMENT
/begin MEASUREMENT ATMbits1 "" UBYTE dez 1 100 0 255 FORMAT "%5.1" ECU_ADDRESS 0x800852 /end MEASUREMENT
/begin MEASUREMENT av08_r "SST-Ausgangsgrˆﬂe von AV08" UWORD DC_SEARCH 1 100 0 65535 FORMAT "%6.0" ECU_ADDRESS 0x802F6C /end MEASUREMENT
/begin MEASUREMENT bbdnwsAusBits "" UBYTE dez 1 100 0 255 FORMAT "%5.1" ECU_ADDRESS 0x8005A8 /end MEASUREMENT
/begin MEASUREMENT bbdnwsLokBits "" UBYTE dez 1 100 0 255 FORMAT "%5.1" ECU_ADDRESS 0x8005A9 /end MEASUREMENT
/begin MEASUREMENT bbdslsAusBits1 "" UBYTE dez 1 100 0 255 FORMAT "%5.1" ECU_ADDRESS 0x800A65 /end MEASUREMENT
/begin MEASUREMENT bbdslsAusBits2 "" UBYTE dez 1 100 0 255 FORMAT "%5.1" ECU_ADDRESS 0x800A66 /end MEASUREMENT
/begin MEASUREMENT bbdslsAusBits3 "" UBYTE dez 1 100 0 255 FORMAT "%5.1" ECU_ADDRESS 0x800A67 /end MEASUREMENT
/begin MEASUREMENT bbdslsLokBits1 "" UBYTE dez 1 100 0 255 FORMAT "%5.1" ECU_ADDRESS 0x800A68 /end MEASUREMENT
/begin MEASUREMENT bbdslsLokBits2 "" UBYTE dez 1 100 0 255 FORMAT "%5.1" ECU_ADDRESS 0x800A69 /end MEASUREMENT
/begin MEASUREMENT B_abor "Bedigung Anzahl Starts mit Benzin im ÷l f¸r reduzierte LRA" UBYTE B_TRUE 1 100 0 1 BIT_MASK 0x1 FORMAT "%13.11" ECU_ADDRESS 0x7FA6B4 /end MEASUREMENT
/begin MEASUREMENT B_acmlf "Bedingung f¸r Kompressor aus bei Endstufenfehler in Motorl¸ftersteuerung" UBYTE B_TRUE 1 100 0 1 BIT_MASK 0x1 FORMAT "%13.11" ECU_ADDRESS 0x7FA9C6 /end MEASUREMENT
/begin MEASUREMENT B_acres "Bedingung f¸r Aufbau einer Drehmomentenreserve bei Klimabereitschaft" UBYTE B_TRUE 1 100 0 1 BIT_MASK 0x1 FORMAT "%13.11" ECU_ADDRESS 0x7FA9C7 /end MEASUREMENT
/begin MEASUREMENT B_ale "Bedingung Motorabstellposition erkannt" UBYTE B_TRUE 1 100 0 1 BIT_MASK 0x1 FORMAT "%13.11" ECU_ADDRESS 0x7FC7D4 /end MEASUREMENT
/begin MEASUREMENT B_alechk "Bedingung R¸ckdrehen erkannt" UBYTE B_TRUE 1 100 0 1 BIT_MASK 0x4 FORMAT "%13.11" ECU_ADDRESS 0x801005 /end MEASUREMENT
/begin MEASUREMENT B_aleundef "R¸ckdreherkennung im undefiniertem Bereich" UBYTE B_TRUE 1 100 0 1 FORMAT "%13.11" ECU_ADDRESS 0x7FC7D5 /end MEASUREMENT
/begin MEASUREMENT B_anfdslp "Bedingung Anforderung einer SLP-Diagnose" UBYTE B_TRUE 1 100 0 1 BIT_MASK 0x1 FORMAT "%13.11" ECU_ADDRESS 0x800A65 /end MEASUREMENT
/begin MEASUREMENT B_anfdslv "Bedingung Anforderung einer SLV-Diagnose" UBYTE B_TRUE 1 100 0 1 BIT_MASK 0x2 FORMAT "%13.11" ECU_ADDRESS 0x800A65 /end MEASUREMENT
/begin MEASUREMENT B_anstslp "Bedingung Ansteuerung der Sekund‰rluftpumpe f¸r Ventildichtigkeitscheck" UBYTE B_TRUE 1 100 0 1 BIT_MASK 0x4 FORMAT "%13.11" ECU_ADDRESS 0x800A65 /end MEASUREMENT
/begin MEASUREMENT B_apnoluv "Verriegelungsbit: Applikationshilfe DK-Notluftfahren" UBYTE B_TRUE 1 100 0 1 BIT_MASK 0x1 FORMAT "%13.11" ECU_ADDRESS 0x7FA639 /end MEASUREMENT
/begin MEASUREMENT B_appnolu "Bedingung: DK-Notluftfahren durch Applikation angefordert" UBYTE B_TRUE 1 100 0 1 BIT_MASK 0x1 FORMAT "%13.11" ECU_ADDRESS 0x7FA63A /end MEASUREMENT
/begin MEASUREMENT B_ar "Antiruckeleingriff aktiv" UBYTE B_TRUE 1 100 0 1 BIT_MASK 0x1 FORMAT "%13.11" ECU_ADDRESS 0x7FA98F /end MEASUREMENT
/begin MEASUREMENT B_asr "Bedingung f¸r ASR aktiv" UBYTE B_TRUE 1 100 0 1 BIT_MASK 0x1 FORMAT "%13.11" ECU_ADDRESS 0x7FA9C8 /end MEASUREMENT
/begin MEASUREMENT B_atmst "Bedingung Startwert tabgmst,tkatmst berechnet" UBYTE B_TRUE 1 100 0 1 BIT_MASK 0x2 FORMAT "%13.11" ECU_ADDRESS 0x800852 /end MEASUREMENT
/begin MEASUREMENT B_atmst2 "Bedingung Startwert tabgmst, tkatmst berechnet Bank2" UBYTE B_TRUE 1 100 0 1 BIT_MASK 0x4 FORMAT "%13.11" ECU_ADDRESS 0x800852 /end MEASUREMENT
/begin MEASUREMENT B_atmtpa "Bedingung Taupunkt vor Kat ueberschritten" UBYTE B_TRUE 1 100 0 1 BIT_MASK 0x1 FORMAT "%13.11" ECU_ADDRESS 0x7FA6EB /end MEASUREMENT
/begin MEASUREMENT B_atmtpa2 "Bedingung Taupunkt2 vor Kat ueberschritten" UBYTE B_TRUE 1 100 0 1 BIT_MASK 0x1 FORMAT "%13.11" ECU_ADDRESS 0x7FA6EC /end MEASUREMENT
/begin MEASUREMENT B_atmtpf "Bedingung Taupunkt vor Kat ¸berschritten (last trip)" UBYTE B_TRUE 1 100 0 1 BIT_MASK 0x4 FORMAT "%13.11" ECU_ADDRESS 0x7FC726 /end MEASUREMENT
/begin MEASUREMENT B_atmtpf2 "Bedingung Taupunkt vor Kat ¸berschritten (last trip) Bank2" UBYTE B_TRUE 1 100 0 1 BIT_MASK 0x8 FORMAT "%13.11" ECU_ADDRESS 0x7FC726 /end MEASUREMENT
/begin MEASUREMENT B_atmtpk "Bedingung Taupunkt hinter Kat ueberschritten" UBYTE B_TRUE 1 100 0 1 BIT_MASK 0x1 FORMAT "%13.11" ECU_ADDRESS 0x7FA6ED /end MEASUREMENT
/begin MEASUREMENT B_atmtpk2 "Bedingung Taupunkt2 hinter Kat ueberschritten" UBYTE B_TRUE 1 100 0 1 BIT_MASK 0x1 FORMAT "%13.11" ECU_ADDRESS 0x7FA6EE /end MEASUREMENT
/begin MEASUREMENT B_atmtpl "Bedingung Taupunkt hinter Kat ¸berschritten (last trip)" UBYTE B_TRUE 1 100 0 1 BIT_MASK 0x1 FORMAT "%13.11" ECU_ADDRESS 0x7FC726 /end MEASUREMENT
/begin MEASUREMENT B_atmtpl2 "Bedingung Taupunkt hinter Kat ¸berschritten (last trip) Bank2" UBYTE B_TRUE 1 100 0 1 BIT_MASK 0x2 FORMAT "%13.11" ECU_ADDRESS 0x7FC726 /end MEASUREMENT
/begin MEASUREMENT B_autget "Bedingung Automatikgetriebe" UBYTE B_TRUE 1 100 0 1 BIT_MASK 0x1 FORMAT "%13.11" ECU_ADDRESS 0x7FA9C9 /end MEASUREMENT
/begin MEASUREMENT B_bbodsls "Betriebsbedingungen zur Freigabe der Aktivdiagnose erf¸llt" UBYTE B_TRUE 1 100 0 1 BIT_MASK 0x1 FORMAT "%13.11" ECU_ADDRESS 0x800A68 /end MEASUREMENT
/begin MEASUREMENT B_brems "Bedingung Bremse bet‰tigt" UBYTE B_TRUE 1 100 0 1 BIT_MASK 0x1 FORMAT "%13.11" ECU_ADDRESS 0x7FA9CA /end MEASUREMENT
/begin MEASUREMENT B_dash "Bedingung: Dashpot-ƒnderungsbegrenzung aktiv" UBYTE B_TRUE 1 100 0 1 BIT_MASK 0x1 FORMAT "%13.11" ECU_ADDRESS 0x7FA9CB /end MEASUREMENT
/begin MEASUREMENT B_dashv "Bedingung Dashpot verzˆgert" UBYTE B_TRUE 1 100 0 1 BIT_MASK 0x1 FORMAT "%13.11" ECU_ADDRESS 0x7FA9CC /end MEASUREMENT
/begin MEASUREMENT B_dfrmrg "gefilterte Abweichung frm von 1.0 f¸r Offsetbestimmung eingeschwungen(Bank1+2)" UBYTE B_TRUE 1 100 0 1 BIT_MASK 0x2 FORMAT "%13.11" ECU_ADDRESS 0x800A68 /end MEASUREMENT
/begin MEASUREMENT B_dkuevab "Bedingung Ev-Abschaltung bei unplausibler DK" UBYTE B_TRUE 1 100 0 1 BIT_MASK 0x1 FORMAT "%13.11" ECU_ADDRESS 0x7FA80D /end MEASUREMENT
/begin MEASUREMENT B_dmdstop "Ev-Abschaltung aktiv --> Aussetzerekennung sperren" UBYTE B_TRUE 1 100 0 1 BIT_MASK 0x1 FORMAT "%13.11" ECU_ADDRESS 0x7FA808 /end MEASUREMENT
/begin MEASUREMENT B_dnws "Aktive Diagnose: Nockenwellensteuerung" UBYTE B_TRUE 1 100 0 1 BIT_MASK 0x1 FORMAT "%13.11" ECU_ADDRESS 0x8005A8 /end MEASUREMENT
/begin MEASUREMENT B_dnwsa "Aktive Diagnose: Nockenwellensteuerung Auslaﬂ" UBYTE B_TRUE 1 100 0 1 BIT_MASK 0x2 FORMAT "%13.11" ECU_ADDRESS 0x8005A8 /end MEASUREMENT
/begin MEASUREMENT B_dnwsa2 "Aktive Diagnose: Nockenwellensteuerung Auslaﬂ 2" UBYTE B_TRUE 1 100 0 1 BIT_MASK 0x4 FORMAT "%13.11" ECU_ADDRESS 0x8005A8 /end MEASUREMENT
/begin MEASUREMENT B_dnwse "Aktive Diagnose: Nockenwellensteuerung Einlaﬂ" UBYTE B_TRUE 1 100 0 1 BIT_MASK 0x8 FORMAT "%13.11" ECU_ADDRESS 0x8005A8 /end MEASUREMENT
/begin MEASUREMENT B_dnwse2 "Aktive Diagnose: Nockenwellensteuerung Einlaﬂ 2" UBYTE B_TRUE 1 100 0 1 BIT_MASK 0x10 FORMAT "%13.11" ECU_ADDRESS 0x8005A8 /end MEASUREMENT
/begin MEASUREMENT B_dnwsfa "Diagnose Nockenwellensteuerung: Freigabeanteil f¸r alle Nockenwellen" UBYTE B_TRUE 1 100 0 1 BIT_MASK 0x1 FORMAT "%13.11" ECU_ADDRESS 0x8005A9 /end MEASUREMENT
/begin MEASUREMENT B_dsl "Bedingung Diagnoseanforderung" UBYTE B_TRUE 1 100 0 1 BIT_MASK 0x8 FORMAT "%13.11" ECU_ADDRESS 0x800A65 /end MEASUREMENT
/begin MEASUREMENT B_dsla "Adaptionsphase: Bestimmung Sekund‰rluftmasse" UBYTE B_TRUE 1 100 0 1 BIT_MASK 0x10 FORMAT "%13.11" ECU_ADDRESS 0x800A65 /end MEASUREMENT
/begin MEASUREMENT B_dslerr "Zusammenfassung Abbruchmerkmale Sekund‰rluftdiagnose" UBYTE B_TRUE 1 100 0 1 BIT_MASK 0x20 FORMAT "%13.11" ECU_ADDRESS 0x800A65 /end MEASUREMENT
/begin MEASUREMENT B_dslmes "Bedingung: Freigabe Meﬂfenster" UBYTE B_TRUE 1 100 0 1 BIT_MASK 0x80 FORMAT "%13.11" ECU_ADDRESS 0x800A67 /end MEASUREMENT
/begin MEASUREMENT B_dsls "Aktive Diagnose: Sekund‰rluft-System" UBYTE B_TRUE 1 100 0 1 BIT_MASK 0x40 FORMAT "%13.11" ECU_ADDRESS 0x800A65 /end MEASUREMENT
/begin MEASUREMENT B_dslsfg "Freigabe Diagnose: Sekund‰rluft-System" UBYTE B_TRUE 1 100 0 1 BIT_MASK 0x4 FORMAT "%13.11" ECU_ADDRESS 0x800A68 /end MEASUREMENT
/begin MEASUREMENT B_ekp "Freigabe der EKP-Versorgung" UBYTE B_TRUE 1 100 0 1 BIT_MASK 0x1 FORMAT "%13.11" ECU_ADDRESS 0x7FA7E9 /end MEASUREMENT
/begin MEASUREMENT B_ekpd "Bedingung EKP Dauerbetrieb" UBYTE B_TRUE 1 100 0 1 BIT_MASK 0x1 FORMAT "%13.11" ECU_ADDRESS 0x7FA7EA /end MEASUREMENT
/begin MEASUREMENT B_ekps "Bedingung schnelle Aktivierung der EKP beim Start" UBYTE B_TRUE 1 100 0 1 BIT_MASK 0x1 FORMAT "%13.11" ECU_ADDRESS 0x7FA7EB /end MEASUREMENT
/begin MEASUREMENT B_ekpvl "Bedingung EKP-Vorlauf" UBYTE B_TRUE 1 100 0 1 BIT_MASK 0x1 FORMAT "%13.11" ECU_ADDRESS 0x800C0C /end MEASUREMENT
/begin MEASUREMENT B_ekpvla "Bedingung EKP Vorlauf angefordert" UBYTE B_TRUE 1 100 0 1 BIT_MASK 0x2 FORMAT "%13.11" ECU_ADDRESS 0x800C0C /end MEASUREMENT
/begin MEASUREMENT B_ekpvlz "Bedingung EKP Vorlauf zul‰ssig" UBYTE B_TRUE 1 100 0 1 BIT_MASK 0x4 FORMAT "%13.11" ECU_ADDRESS 0x800C0C /end MEASUREMENT
/begin MEASUREMENT B_enabale "Bedingung: Freigabe zur Berechnung der Motorabstellposition" UBYTE B_TRUE 1 100 0 1 FORMAT "%13.11" ECU_ADDRESS 0x801006 /end MEASUREMENT
/begin MEASUREMENT B_enabint "Bedingung Zahninterrupt f¸r ALE aktiviert" UBYTE B_TRUE 1 100 0 1 FORMAT "%13.11" ECU_ADDRESS 0x801007 /end MEASUREMENT
/begin MEASUREMENT B_engstop "Bedingung Motor steht l‰nger als 100ms" UBYTE B_TRUE 1 100 0 1 BIT_MASK 0x4 FORMAT "%13.11" ECU_ADDRESS 0x801004 /end MEASUREMENT
/begin MEASUREMENT B_espanf "ESP im Koordinationsblock-Durchgriff" UBYTE B_TRUE 1 100 0 1 BIT_MASK 0x1 FORMAT "%13.11" ECU_ADDRESS 0x7FA9CD /end MEASUREMENT
/begin MEASUREMENT B_estart "Bedingung KL 50 ein" UBYTE B_TRUE 1 100 0 1 BIT_MASK 0x1 FORMAT "%13.11" ECU_ADDRESS 0x7FA9CE /end MEASUREMENT
/begin MEASUREMENT B_evabu "Bedingung Ev-Abschaltung durch ‹berwachungsfunktionen" UBYTE B_TRUE 1 100 0 1 BIT_MASK 0x1 FORMAT "%13.11" ECU_ADDRESS 0x7FA80E /end MEASUREMENT
/begin MEASUREMENT B_evasel "Status alle f¸r DASE relevant. lokalen Einspritzventile d. SG werden angesteuert" UBYTE B_TRUE 1 100 0 1 BIT_MASK 0x1 FORMAT "%13.11" ECU_ADDRESS 0x7FA812 /end MEASUREMENT
/begin MEASUREMENT B_fgdslsll "Bedingung Freigabe SLS-Diagnose im Leerlauf" UBYTE B_TRUE 1 100 0 1 BIT_MASK 0x8 FORMAT "%13.11" ECU_ADDRESS 0x800A68 /end MEASUREMENT
/begin MEASUREMENT B_fgprvent "Freigabebedingung zur ‹berpr¸fung der Ventildichtigkeit" UBYTE B_TRUE 1 100 0 1 BIT_MASK 0x10 FORMAT "%13.11" ECU_ADDRESS 0x800A68 /end MEASUREMENT
/begin MEASUREMENT B_fophsnl "Evabschaltung ¸ber feste Abschaltmuster ohne Notlauf Phasensuche" UBYTE B_TRUE 1 100 0 1 BIT_MASK 0x1 FORMAT "%13.11" ECU_ADDRESS 0x7FA809 /end MEASUREMENT
/begin MEASUREMENT B_frdph "Bed. Transition 'to_Fixred' aktiviert durch Notlauf-Phasensuche" UBYTE B_TRUE 1 100 0 1 BIT_MASK 0x1 FORMAT "%13.11" ECU_ADDRESS 0x7FA80A /end MEASUREMENT
/begin MEASUREMENT B_fs "Bedingung Fahrstufe" UBYTE B_TRUE 1 100 0 1 BIT_MASK 0x1 FORMAT "%13.11" ECU_ADDRESS 0x7FA9CF /end MEASUREMENT
/begin MEASUREMENT B_gwhs "Bedingung Gangwechsel bei Handschalter" UBYTE B_TRUE 1 100 0 1 BIT_MASK 0x1 FORMAT "%13.11" ECU_ADDRESS 0x7FA9D0 /end MEASUREMENT
/begin MEASUREMENT B_hg "Bedingung Handschaltgetriebe" UBYTE B_TRUE 1 100 0 1 BIT_MASK 0x1 FORMAT "%13.11" ECU_ADDRESS 0x7FA9D1 /end MEASUREMENT
/begin MEASUREMENT B_hklvent "Ventil Heizkreislauf von Thermomanagement" UBYTE B_TRUE 1 100 0 1 BIT_MASK 0x1 FORMAT "%13.11" ECU_ADDRESS 0x7FA9D2 /end MEASUREMENT
/begin MEASUREMENT B_hklvent1 "Ventil 1 Heizkreislauf von Thermomanagement" UBYTE B_TRUE 1 100 0 1 BIT_MASK 0x1 FORMAT "%13.11" ECU_ADDRESS 0x7FA9D3 /end MEASUREMENT
/begin MEASUREMENT B_hklvent2 "Ventil 2 Heizkreislauf von Thermomanagement" UBYTE B_TRUE 1 100 0 1 BIT_MASK 0x1 FORMAT "%13.11" ECU_ADDRESS 0x7FA9D4 /end MEASUREMENT
/begin MEASUREMENT B_hlsumx "Bedingung U_bat-korregierte Stellgrˆﬂe ist maximal (=100%)" UBYTE B_TRUE 1 100 0 1 BIT_MASK 0x2 FORMAT "%13.11" ECU_ADDRESS 0x80117A /end MEASUREMENT
/begin MEASUREMENT B_hlsumx2 "Bedingung U_bat-korregierte Stellgrˆﬂe ist maximal (=100%), Bank 2" UBYTE B_TRUE 1 100 0 1 BIT_MASK 0x4 FORMAT "%13.11" ECU_ADDRESS 0x80117A /end MEASUREMENT
/begin MEASUREMENT B_hpnmot "Bedingung Hochpunkt Drehzahlschwingung" UBYTE B_TRUE 1 100 0 1 BIT_MASK 0x1 FORMAT "%13.11" ECU_ADDRESS 0x7FA990 /end MEASUREMENT
/begin MEASUREMENT B_hrlsaus "Bedingung Ausschalten der Heizungsregelung" UBYTE B_TRUE 1 100 0 1 BIT_MASK 0x1 FORMAT "%13.11" ECU_ADDRESS 0x80117A /end MEASUREMENT
/begin MEASUREMENT B_iniar "Bedingung Initialisierung der AR-Funktion" UBYTE B_TRUE 1 100 0 1 BIT_MASK 0x1 FORMAT "%13.11" ECU_ADDRESS 0x7FA991 /end MEASUREMENT
/begin MEASUREMENT B_iniarv "Bedingung Initialisierung der Filterfunktion verzˆgert" UBYTE B_TRUE 1 100 0 1 BIT_MASK 0x1 FORMAT "%13.11" ECU_ADDRESS 0x7FA992 /end MEASUREMENT
/begin MEASUREMENT B_koe "Bedingung f¸r Kompressoreinschalten" UBYTE B_TRUE 1 100 0 1 BIT_MASK 0x1 FORMAT "%13.11" ECU_ADDRESS 0x7FA9D5 /end MEASUREMENT
/begin MEASUREMENT B_kupgw "Bedingung Kupplung bet‰tigt bis erkannter Gangwechsel" UBYTE B_TRUE 1 100 0 1 BIT_MASK 0x1 FORMAT "%13.11" ECU_ADDRESS 0x7FA993 /end MEASUREMENT
/begin MEASUREMENT B_kuppl "Bedingung Kupplung bet‰tigt" UBYTE B_TRUE 1 100 0 1 BIT_MASK 0x1 FORMAT "%13.11" ECU_ADDRESS 0x7FA9D6 /end MEASUREMENT
/begin MEASUREMENT B_kupplv "Bedingung Kupplung bet‰tigt verzˆgert" UBYTE B_TRUE 1 100 0 1 BIT_MASK 0x1 FORMAT "%13.11" ECU_ADDRESS 0x7FA9D7 /end MEASUREMENT
/begin MEASUREMENT B_lbkapnlv "LBK Notlaufmode Applikation verboten" UBYTE B_TRUE 1 100 0 1 BIT_MASK 0x1 FORMAT "%13.11" ECU_ADDRESS 0x8010B8 /end MEASUREMENT
/begin MEASUREMENT B_lbkappnl "LBK Notlaufmode Applikation enabled" UBYTE B_TRUE 1 100 0 1 BIT_MASK 0x2 FORMAT "%13.11" ECU_ADDRESS 0x8010B8 /end MEASUREMENT
/begin MEASUREMENT B_lbkdisfr "Bedingung LBK Endstufenfreigabe Funktionsrechner" UBYTE B_TRUE 1 100 0 1 BIT_MASK 0x1 FORMAT "%13.11" ECU_ADDRESS 0x7FA633 /end MEASUREMENT
/begin MEASUREMENT B_lbkese "Bedingung LBK Endstufenabschaltung" UBYTE B_TRUE 1 100 0 1 BIT_MASK 0x1 FORMAT "%13.11" ECU_ADDRESS 0x8010B7 /end MEASUREMENT
/begin MEASUREMENT B_lbklbe "Bedingung LBK Tastverh‰ltnis zu hoch" UBYTE B_TRUE 1 100 0 1 BIT_MASK 0x2 FORMAT "%13.11" ECU_ADDRESS 0x8010B7 /end MEASUREMENT
/begin MEASUREMENT B_lbklparc "Bedingung LBK Lageregler Umschaltung erlaubt" UBYTE B_TRUE 1 100 0 1 BIT_MASK 0x4 FORMAT "%13.11" ECU_ADDRESS 0x8010B7 /end MEASUREMENT
/begin MEASUREMENT B_lbklpide "Bedingung LBK Tastverh‰ltnis dauerhaft zu hoch" UBYTE B_TRUE 1 100 0 1 BIT_MASK 0x4 FORMAT "%13.11" ECU_ADDRESS 0x8010B8 /end MEASUREMENT
/begin MEASUREMENT B_lbknl "Bedingung LBK wird im Nachlauf bestromt" UBYTE B_TRUE 1 100 0 1 BIT_MASK 0x8 FORMAT "%13.11" ECU_ADDRESS 0x8010B7 /end MEASUREMENT
/begin MEASUREMENT B_lbknlpne "Bedingung LBK Notlaufposition nicht erreicht" UBYTE B_TRUE 1 100 0 1 BIT_MASK 0x8 FORMAT "%13.11" ECU_ADDRESS 0x8010B8 /end MEASUREMENT
/begin MEASUREMENT B_lbkpwrsv "Bedingung LBK in Powersave" UBYTE B_TRUE 1 100 0 1 BIT_MASK 0x20 FORMAT "%13.11" ECU_ADDRESS 0x8010B8 /end MEASUREMENT
/begin MEASUREMENT B_lbkte "Bedingung LBK hoher Strom schliessend bei Motor aus -> Neulernen" UBYTE B_TRUE 1 100 0 1 BIT_MASK 0x10 FORMAT "%13.11" ECU_ADDRESS 0x8010B7 /end MEASUREMENT
/begin MEASUREMENT B_lbkub "Bedingung LBK Batteriespannung ausreichend" UBYTE B_TRUE 1 100 0 1 BIT_MASK 0x40 FORMAT "%13.11" ECU_ADDRESS 0x8010B8 /end MEASUREMENT
/begin MEASUREMENT B_lbkwsive "Bedingung LBK Lage¸berwachung Fehler" UBYTE B_TRUE 1 100 0 1 BIT_MASK 0x80 FORMAT "%13.11" ECU_ADDRESS 0x8010B8 /end MEASUREMENT
/begin MEASUREMENT B_ll "Bedingung Leerlauf" UBYTE B_TRUE 1 100 0 1 BIT_MASK 0x1 FORMAT "%13.11" ECU_ADDRESS 0x7FA9D8 /end MEASUREMENT
/begin MEASUREMENT B_lsd "Bedingung: Pos. Lastschlagd‰mpfung aktiv" UBYTE B_TRUE 1 100 0 1 BIT_MASK 0x1 FORMAT "%13.11" ECU_ADDRESS 0x7FA9D9 /end MEASUREMENT
/begin MEASUREMENT B_maxdu "" UBYTE B_TRUE 1 100 0 1 BIT_MASK 0x2 FORMAT "%13.11" ECU_ADDRESS 0x80105A /end MEASUREMENT
/begin MEASUREMENT B_mdeeagk "Bedingung Momentenreduzierung ¸ber Einspritzausblendung durch AGK erlaubt" UBYTE B_TRUE 1 100 0 1 BIT_MASK 0x1 FORMAT "%13.11" ECU_ADDRESS 0x7FA9DA /end MEASUREMENT
/begin MEASUREMENT B_mdeinext "Bedingung externer Momenteneingriff aktiv" UBYTE B_TRUE 1 100 0 1 BIT_MASK 0x1 FORMAT "%13.11" ECU_ADDRESS 0x7FA9DB /end MEASUREMENT
/begin MEASUREMENT B_mdresagk "Bedingung: Momentenreserve aus AGK aktiv" UBYTE B_TRUE 1 100 0 1 BIT_MASK 0x1 FORMAT "%13.11" ECU_ADDRESS 0x7FA9DC /end MEASUREMENT
/begin MEASUREMENT B_meaoper "ml-/nmot-/rl-Bedingung: Freigabe Meﬂfenster in Block MEASURE" UBYTE B_TRUE 1 100 0 1 BIT_MASK 0x80 FORMAT "%13.11" ECU_ADDRESS 0x800A65 /end MEASUREMENT
/begin MEASUREMENT B_mflai "Bedingung FGR-ACC-Abschaltung irrev." UBYTE B_TRUE 1 100 0 1 FORMAT "%13.11" ECU_ADDRESS 0x800E92 /end MEASUREMENT
/begin MEASUREMENT B_mflal "Bedingung FGR-ACC-Abschaltung langsam" UBYTE B_TRUE 1 100 0 1 FORMAT "%13.11" ECU_ADDRESS 0x800E93 /end MEASUREMENT
/begin MEASUREMENT B_mflar "Bedingung FGR-Abschaltung rev." UBYTE B_TRUE 1 100 0 1 FORMAT "%13.11" ECU_ADDRESS 0x800E94 /end MEASUREMENT
/begin MEASUREMENT B_mflas "Bedingung FGR-ACC-Abschaltung schnell" UBYTE B_TRUE 1 100 0 1 FORMAT "%13.11" ECU_ADDRESS 0x800E95 /end MEASUREMENT
/begin MEASUREMENT B_mflen "Bedingung FGR-ACC-Regelung aktiv" UBYTE B_TRUE 1 100 0 1 FORMAT "%13.11" ECU_ADDRESS 0x800E96 /end MEASUREMENT
/begin MEASUREMENT B_mindu "" UBYTE B_TRUE 1 100 0 1 BIT_MASK 0x1 FORMAT "%13.11" ECU_ADDRESS 0x80105A /end MEASUREMENT
/begin MEASUREMENT B_msllavrg "gefilterte Sek.-masse f¸r Ventildichtigkeitscheck eingeschwungen (Bank1+2)" UBYTE B_TRUE 1 100 0 1 BIT_MASK 0x20 FORMAT "%13.11" ECU_ADDRESS 0x800A68 /end MEASUREMENT
/begin MEASUREMENT B_msr "Bedingung f¸r Momentenschlupfregelung" UBYTE B_TRUE 1 100 0 1 BIT_MASK 0x1 FORMAT "%13.11" ECU_ADDRESS 0x7FA9DD /end MEASUREMENT
/begin MEASUREMENT B_nlphea "Ev-Abschaltung f¸r Notlauf Phasensynchronisation aktiv" UBYTE B_TRUE 1 100 0 1 BIT_MASK 0x1 FORMAT "%13.11" ECU_ADDRESS 0x7FA80B /end MEASUREMENT
/begin MEASUREMENT B_nlpheai "Ev-Abschaltung f¸r Notlauf Phasensynchronisation aktiv AEVAB intern" UBYTE B_TRUE 1 100 0 1 BIT_MASK 0x1 FORMAT "%13.11" ECU_ADDRESS 0x7FA80C /end MEASUREMENT
/begin MEASUREMENT B_nlzoff "Bedingung Abschaltung der Z¸ndung f¸r ‹berwachungsfunktion" UBYTE B_TRUE 1 100 0 1 BIT_MASK 0x1 FORMAT "%13.11" ECU_ADDRESS 0x7FA80F /end MEASUREMENT
/begin MEASUREMENT B_nmotnwdf "Freigabe Nockenwellendiagnose ¸ber Drehzahlschwellen" UBYTE B_TRUE 1 100 0 1 BIT_MASK 0x2 FORMAT "%13.11" ECU_ADDRESS 0x8005A9 /end MEASUREMENT
/begin MEASUREMENT B_phaseab "Diagnose SLS w‰hrend des Phasenablaufs abgebrochen" UBYTE B_TRUE 1 100 0 1 BIT_MASK 0x1 FORMAT "%13.11" ECU_ADDRESS 0x800A66 /end MEASUREMENT
/begin MEASUREMENT B_phend "Zustandsautomat einmal durchlaufen" UBYTE B_TRUE 1 100 0 1 BIT_MASK 0x40 FORMAT "%13.11" ECU_ADDRESS 0x800A67 /end MEASUREMENT
/begin MEASUREMENT B_phmesend "Bedingung Messphase beendet" UBYTE B_TRUE 1 100 0 1 BIT_MASK 0x40 FORMAT "%13.11" ECU_ADDRESS 0x800A68 /end MEASUREMENT
/begin MEASUREMENT B_phmesrdy "Bedingung Messphase in der erforderlichen Zeit durchgelaufen" UBYTE B_TRUE 1 100 0 1 BIT_MASK 0x80 FORMAT "%13.11" ECU_ADDRESS 0x800A68 /end MEASUREMENT
/begin MEASUREMENT B_phmess "Diagnose in Phase zur Bestimmung der Sekund‰rluftmasse" UBYTE B_TRUE 1 100 0 1 BIT_MASK 0x2 FORMAT "%13.11" ECU_ADDRESS 0x800A66 /end MEASUREMENT
/begin MEASUREMENT B_phmessab "Diagnose in Phase zur Bestimmung der Sekund‰rluftmasse abgebrochen" UBYTE B_TRUE 1 100 0 1 BIT_MASK 0x4 FORMAT "%13.11" ECU_ADDRESS 0x800A66 /end MEASUREMENT
/begin MEASUREMENT B_phmessmf "Diagnose in Phase zur Bestimmung der Sekund‰rluftmasse im Meﬂfenster" UBYTE B_TRUE 1 100 0 1 BIT_MASK 0x8 FORMAT "%13.11" ECU_ADDRESS 0x800A66 /end MEASUREMENT
/begin MEASUREMENT B_phoffs "Diagnose in Phase zur Bestimmung des Offsets" UBYTE B_TRUE 1 100 0 1 BIT_MASK 0x10 FORMAT "%13.11" ECU_ADDRESS 0x800A66 /end MEASUREMENT
/begin MEASUREMENT B_phoffsab "Diagnose in Phase zur Bestimmung des Offsets abgebrochen" UBYTE B_TRUE 1 100 0 1 BIT_MASK 0x20 FORMAT "%13.11" ECU_ADDRESS 0x800A66 /end MEASUREMENT
/begin MEASUREMENT B_phoffsmf "Diagnose in Phase zur Bestimmung des Offsets im Meﬂfenster" UBYTE B_TRUE 1 100 0 1 BIT_MASK 0x40 FORMAT "%13.11" ECU_ADDRESS 0x800A66 /end MEASUREMENT
/begin MEASUREMENT B_phofsend "Diagnose in Phase zur Bestimmung des Offsets ordnungsgem‰ﬂ durchgelaufen" UBYTE B_TRUE 1 100 0 1 BIT_MASK 0x80 FORMAT "%13.11" ECU_ADDRESS 0x800A66 /end MEASUREMENT
/begin MEASUREMENT B_phofsmx "Bedingung max. Zeit Offsetphase abgelaufen" UBYTE B_TRUE 1 100 0 1 BIT_MASK 0x1 FORMAT "%13.11" ECU_ADDRESS 0x800A69 /end MEASUREMENT
/begin MEASUREMENT B_phofsrdy "Bedingung Offsetphase in der erforderlichen Zeit durchgelaufen" UBYTE B_TRUE 1 100 0 1 BIT_MASK 0x20 FORMAT "%13.11" ECU_ADDRESS 0x800A67 /end MEASUREMENT
/begin MEASUREMENT B_phstart "Zustandsautomat f¸r Diagnose SLS befindet sich im Startzustand" UBYTE B_TRUE 1 100 0 1 BIT_MASK 0x1 FORMAT "%13.11" ECU_ADDRESS 0x800A67 /end MEASUREMENT
/begin MEASUREMENT B_phvent "Diagnose in Phase zur ‹berpr¸fung des Ventildichtigkeitschecks" UBYTE B_TRUE 1 100 0 1 BIT_MASK 0x2 FORMAT "%13.11" ECU_ADDRESS 0x800A67 /end MEASUREMENT
/begin MEASUREMENT B_phventab "Diagnose in Phase zur ‹berpr¸fung des Ventildichtigkeitschecks abgebrochen" UBYTE B_TRUE 1 100 0 1 BIT_MASK 0x4 FORMAT "%13.11" ECU_ADDRESS 0x800A67 /end MEASUREMENT
/begin MEASUREMENT B_phventmf "Diagnose in Phase zur ‹berpr¸fung des Ventildichtigkeitschecks im Meﬂfenster" UBYTE B_TRUE 1 100 0 1 BIT_MASK 0x8 FORMAT "%13.11" ECU_ADDRESS 0x800A67 /end MEASUREMENT
/begin MEASUREMENT B_phventmx "Bedingung max. Zeit f¸r Ventildichtigkeitsphase abgelaufen" UBYTE B_TRUE 1 100 0 1 BIT_MASK 0x2 FORMAT "%13.11" ECU_ADDRESS 0x800A69 /end MEASUREMENT
/begin MEASUREMENT B_phventry "Bedingung Ventildichtigkeitsphase in der erforderlichen Zeit durchgelaufen" UBYTE B_TRUE 1 100 0 1 BIT_MASK 0x4 FORMAT "%13.11" ECU_ADDRESS 0x800A69 /end MEASUREMENT
/begin MEASUREMENT B_phvntend "Bedingung Ventildichtigkeitsphase beendet" UBYTE B_TRUE 1 100 0 1 BIT_MASK 0x8 FORMAT "%13.11" ECU_ADDRESS 0x800A69 /end MEASUREMENT
/begin MEASUREMENT B_plw "Vergleichsergebnis plaus. Lenkwinkel mit adaptivem Maximallenkw. ¸ber Hysterese" UBYTE B_TRUE 1 100 0 1 BIT_MASK 0x1 FORMAT "%13.11" ECU_ADDRESS 0x7FA9DE /end MEASUREMENT
/begin MEASUREMENT B_pvlab "Bedingung EKP Vorlauf aus Abstellzeit¸berschreitung" UBYTE B_TRUE 1 100 0 1 BIT_MASK 0x8 FORMAT "%13.11" ECU_ADDRESS 0x800C0C /end MEASUREMENT
/begin MEASUREMENT B_pvlnl "Bedingung EKP-Vorlauf aus Nachlaufzeit¸berschreitung" UBYTE B_TRUE 1 100 0 1 BIT_MASK 0x10 FORMAT "%13.11" ECU_ADDRESS 0x800C0C /end MEASUREMENT
/begin MEASUREMENT B_pwgnotfr "FR-Fehlerreaktion PWG-Notfahren" UBYTE B_TRUE 1 100 0 1 BIT_MASK 0x1 FORMAT "%13.11" ECU_ADDRESS 0x7FA9DF /end MEASUREMENT
/begin MEASUREMENT B_ralectr "Bedingung letzte Zahnzeit > TRD" UBYTE B_TRUE 1 100 0 1 FORMAT "%13.11" ECU_ADDRESS 0x801008 /end MEASUREMENT
/begin MEASUREMENT B_raleok "Bedingung letzter Zahn liegt im plausiblen R¸ckdrehbereich" UBYTE B_TRUE 1 100 0 1 FORMAT "%13.11" ECU_ADDRESS 0x801009 /end MEASUREMENT
/begin MEASUREMENT B_rrdet "Bedingung R¸ckdrehen erkannt" UBYTE B_TRUE 1 100 0 1 BIT_MASK 0x8 FORMAT "%13.11" ECU_ADDRESS 0x801005 /end MEASUREMENT
/begin MEASUREMENT B_rsdsls "Bedingung zum Zur¸cksetzen der Bedingung B_dsls" UBYTE B_TRUE 1 100 0 1 BIT_MASK 0x10 FORMAT "%13.11" ECU_ADDRESS 0x800A67 /end MEASUREMENT
/begin MEASUREMENT B_savmd "Bedingung: Schubabschalteverbot wegen Momentenanforderung" UBYTE B_TRUE 1 100 0 1 BIT_MASK 0x1 FORMAT "%13.11" ECU_ADDRESS 0x7FA9E0 /end MEASUREMENT
/begin MEASUREMENT B_sgs "Bedingung: Momenteingriff zur Drehzahlsynchronisation bei Getriebeschaltung" UBYTE B_TRUE 1 100 0 1 BIT_MASK 0x1 FORMAT "%13.11" ECU_ADDRESS 0x7FA9E1 /end MEASUREMENT
/begin MEASUREMENT B_skaevab "Bedingung Ev-Abschaltung durch Sicherheitskraftstoffabschaltung aktiv" UBYTE B_TRUE 1 100 0 1 BIT_MASK 0x1 FORMAT "%13.11" ECU_ADDRESS 0x7FA810 /end MEASUREMENT
/begin MEASUREMENT B_slpoffms "Bedingung Sekund‰rluftpumpe wurde abgeschaltet in der Messphase" UBYTE B_TRUE 1 100 0 1 BIT_MASK 0x10 FORMAT "%13.11" ECU_ADDRESS 0x800A69 /end MEASUREMENT
/begin MEASUREMENT B_slponfz "SLP ist einmal im Fahrzyklus gelaufen" UBYTE B_TRUE 1 100 0 1 BIT_MASK 0x20 FORMAT "%13.11" ECU_ADDRESS 0x800A69 /end MEASUREMENT
/begin MEASUREMENT B_sp1s "Mitteilung an SR: SP1S ist F¸hrungsgrˆﬂe." UBYTE B_TRUE 1 100 0 1 BIT_MASK 0x1 FORMAT "%13.11" ECU_ADDRESS 0x7FA9E2 /end MEASUREMENT
/begin MEASUREMENT B_sp2s "Mitteilung an SR:Poti2 SP2S F¸hrungsgrˆﬂe,Poti1 Ober-oder Untergrenze ¸berschr." UBYTE B_TRUE 1 100 0 1 BIT_MASK 0x1 FORMAT "%13.11" ECU_ADDRESS 0x7FA9E3 /end MEASUREMENT
/begin MEASUREMENT B_spsmin "Mitteilung an SR: '1'= PWG-Notfahren mit SPSMIN" UBYTE B_TRUE 1 100 0 1 BIT_MASK 0x1 FORMAT "%13.11" ECU_ADDRESS 0x7FA9E4 /end MEASUREMENT
/begin MEASUREMENT B_stndnl "Bedingung Beginn SG-Nachlauf oder Startende (1->0)" UBYTE B_TRUE 1 100 0 1 BIT_MASK 0x1 FORMAT "%13.11" ECU_ADDRESS 0x800852 /end MEASUREMENT
/begin MEASUREMENT B_strtint "Bedingung Start Zahninterrupt (Initialisierung)" SBYTE B_TRUE 1 100 0 1 FORMAT "%13.11" ECU_ADDRESS 0x80100A /end MEASUREMENT
/begin MEASUREMENT B_strtswof "Bedingung Nachlaufphase beginnt" UBYTE B_TRUE 1 100 0 1 FORMAT "%13.11" ECU_ADDRESS 0x80100B /end MEASUREMENT
/begin MEASUREMENT B_talbk "Bedingung LBK Vorzeichen PWM" UBYTE B_TRUE 1 100 0 1 BIT_MASK 0x1 FORMAT "%13.11" ECU_ADDRESS 0x7FA634 /end MEASUREMENT
/begin MEASUREMENT B_tmotnwdf "Freigabe Nockenwellendiagnose ¸ber Motortemperaturschwellen" UBYTE B_TRUE 1 100 0 1 BIT_MASK 0x4 FORMAT "%13.11" ECU_ADDRESS 0x8005A9 /end MEASUREMENT
/begin MEASUREMENT B_tolnwdf "Freigabe Nockenwellendiagnose ¸ber ÷ltemperaturschwellen" UBYTE B_TRUE 1 100 0 1 BIT_MASK 0x8 FORMAT "%13.11" ECU_ADDRESS 0x8005A9 /end MEASUREMENT
/begin MEASUREMENT B_tpnmot "Bedingung Tiefpunkt Drehzahlschwingung" UBYTE B_TRUE 1 100 0 1 BIT_MASK 0x1 FORMAT "%13.11" ECU_ADDRESS 0x7FA994 /end MEASUREMENT
/begin MEASUREMENT B_trqcoor_bit4 "" UBYTE B_TRUE 1 100 0 1 BIT_MASK 0x10 FORMAT "%13.11" ECU_ADDRESS 0x80105B /end MEASUREMENT
/begin MEASUREMENT B_trqcoor_bit5 "" UBYTE B_TRUE 1 100 0 1 BIT_MASK 0x20 FORMAT "%13.11" ECU_ADDRESS 0x80105B /end MEASUREMENT
/begin MEASUREMENT B_tvars "Bedingung Antiruckelfunktion dynamisch aktiv" UBYTE B_TRUE 1 100 0 1 BIT_MASK 0x1 FORMAT "%13.11" ECU_ADDRESS 0x7FA995 /end MEASUREMENT
/begin MEASUREMENT B_tvarsa "Bedingung Antiruckelfunktion dynamisch aktiv nach Schubabschalten" UBYTE B_TRUE 1 100 0 1 BIT_MASK 0x1 FORMAT "%13.11" ECU_ADDRESS 0x7FA996 /end MEASUREMENT
/begin MEASUREMENT B_tvarss "Bedingung Antiruckelfunktion station‰r aktiv" UBYTE B_TRUE 1 100 0 1 BIT_MASK 0x1 FORMAT "%13.11" ECU_ADDRESS 0x7FA997 /end MEASUREMENT
/begin MEASUREMENT B_undef "Bedingung R¸ckdreherkennung im undef. Bereich (Zwischenspeicher)" UBYTE B_TRUE 1 100 0 1 FORMAT "%13.11" ECU_ADDRESS 0x80100C /end MEASUREMENT
/begin MEASUREMENT B_vl "Bedingung Vollast" UBYTE B_TRUE 1 100 0 1 BIT_MASK 0x1 FORMAT "%13.11" ECU_ADDRESS 0x7FA9E5 /end MEASUREMENT
/begin MEASUREMENT B_vnull "Bedingung Fahrzeug steht" UBYTE B_TRUE 1 100 0 1 BIT_MASK 0x1 FORMAT "%13.11" ECU_ADDRESS 0x7FA9E6 /end MEASUREMENT
/begin MEASUREMENT B_wksch "Bedingung Wandlerkupplung geschlossen, keine Schaltung aktiv" UBYTE B_TRUE 1 100 0 1 BIT_MASK 0x1 FORMAT "%13.11" ECU_ADDRESS 0x7FA998 /end MEASUREMENT
/begin MEASUREMENT B_zwfgagk "Bedingung f¸r Z¸ndwinkeleingriff der Momentenschnittstelle von AGK" UBYTE B_TRUE 1 100 0 1 BIT_MASK 0x1 FORMAT "%13.11" ECU_ADDRESS 0x7FA9E7 /end MEASUREMENT
/begin MEASUREMENT count_b_acres "" UWORD dez 1 100 0 65535 FORMAT "%8.2" ECU_ADDRESS 0x801284 /end MEASUREMENT
/begin MEASUREMENT count_b_gwhs "" UWORD dez 1 100 0 65535 FORMAT "%8.2" ECU_ADDRESS 0x801285 /end MEASUREMENT
/begin MEASUREMENT CO_GAP "Winkel zur L¸ckenkorrekturerkennung" UWORD kw_q0p1 1 100 0 1440 FORMAT "%8.3" ECU_ADDRESS 0x801B96 /end MEASUREMENT
/begin MEASUREMENT CO_WAS "Winkel zur L¸ckenerkennung" UWORD kw_q0p1 1 100 0 720 FORMAT "%8.4" ECU_ADDRESS 0x801B98 /end MEASUREMENT
/begin MEASUREMENT CO_WNBM "Winkel pro Zahn" UBYTE kw_q0p1 1 100 0 25.5 FORMAT "%5.2" ECU_ADDRESS 0x80100D /end MEASUREMENT
/begin MEASUREMENT cvtratio_r "" UWORD DC_SEARCH 1 100 0 65535 FORMAT "%6.0" ECU_ADDRESS 0x802F6E /end MEASUREMENT
/begin MEASUREMENT dmar_w "Delta Drehmoment antiruckel" SWORD rel_sw_b100 1 100 -100 99.9969 FORMAT "%8.4" ECU_ADDRESS 0x801894 /end MEASUREMENT
/begin MEASUREMENT dmdevab "Ev-Abschaltmuster der Aussetzererkennung das auf dem aktuellen SG umgesetzt wird" UBYTE dez 1 100 0 255 FORMAT "%5.1" ECU_ADDRESS 0x8011DB /end MEASUREMENT
/begin MEASUREMENT dpspu "Delta zwischen Absolut- und Umgebungsdruck" UBYTE p_ub_q10 1 100 0 2550 FORMAT "%5.0" ECU_ADDRESS 0x8007E0 /end MEASUREMENT
/begin MEASUREMENT DSLF1_w "" UWORD spg_uw_q0p00488 1 100 0 319.995 FORMAT "%8.4" ECU_ADDRESS 0x801820 /end MEASUREMENT
/begin MEASUREMENT DSLF2_w "" UWORD spg_uw_q0p00488 1 100 0 319.995 FORMAT "%8.4" ECU_ADDRESS 0x801822 /end MEASUREMENT
/begin MEASUREMENT DSLL_w "" UWORD spg_uw_q0p00488 1 100 0 319.995 FORMAT "%8.4" ECU_ADDRESS 0x801824 /end MEASUREMENT
/begin MEASUREMENT dsoel_w "" UWORD spg_uw_q0p00488 1 100 0 319.995 FORMAT "%8.4" ECU_ADDRESS 0x801826 /end MEASUREMENT
/begin MEASUREMENT dst_w "" UWORD spg_uw_q0p00488 1 100 0 319.995 FORMAT "%8.4" ECU_ADDRESS 0x801828 /end MEASUREMENT
/begin MEASUREMENT dwlbkl_w "LBK Soll/Ist Differenz" SWORD rel_sw_q0p02441 1 100 -800 799.976 FORMAT "%8.4" ECU_ADDRESS 0x801404 /end MEASUREMENT
/begin MEASUREMENT dwped "Gradient des normierten Fahrpedalwinkels" SBYTE rel_sb_q0p39 1 100 -49.9968 49.6062 FORMAT "%5.2" ECU_ADDRESS 0x801286 /end MEASUREMENT
/begin MEASUREMENT dwped_w "Gradient des normierten Fahrpedalwinkels" SWORD rel_sw_b50 1 100 -50 49.9985 FORMAT "%8.5" ECU_ADDRESS 0x801928 /end MEASUREMENT
/begin MEASUREMENT ebg_rp_r "SST-Ausgangsgrˆﬂe von EBG_RP_SST" UWORD DC_SEARCH 1 100 0 65535 FORMAT "%6.0" ECU_ADDRESS 0x802F70 /end MEASUREMENT
/begin MEASUREMENT eevx "EV Fehlerbyte" UBYTE dez 1 100 0 255 FORMAT "%5.1" ECU_ADDRESS 0x800C5E /end MEASUREMENT
/begin MEASUREMENT ei_egs_fr "EGS-Botschaftsz‰hler-Fehler" UBYTE B_TRUE 1 100 0 1 BIT_MASK 0x1 FORMAT "%13.11" ECU_ADDRESS 0x7FA9E8 /end MEASUREMENT
/begin MEASUREMENT esst_sdw21lbsw "" ULONG dez 1 100 0 4.29497e+009 FORMAT "%13.2" ECU_ADDRESS 0x801CD8 /end MEASUREMENT
/begin MEASUREMENT esst_smk08mdsw "" ULONG dez 1 100 0 4.29497e+009 FORMAT "%13.2" ECU_ADDRESS 0x8020B4 /end MEASUREMENT
/begin MEASUREMENT esst_sts06tmuw "" ULONG dez 1 100 0 4.29497e+009 FORMAT "%13.2" ECU_ADDRESS 0x801D68 /end MEASUREMENT
/begin MEASUREMENT esst_stu05tmub "" ULONG dez 1 100 0 4.29497e+009 FORMAT "%13.2" ECU_ADDRESS 0x801D6C /end MEASUREMENT
/begin MEASUREMENT etazwimt "Ist_Z¸ndwinkelwirkungsgrad f¸r ATM gemittelt (200 ms)" UBYTE rel_ub_b127p5 1 100 0 127.5 FORMAT "%5.1" ECU_ADDRESS 0x800853 /end MEASUREMENT
/begin MEASUREMENT ETC_EnvCond_VariRate "" UBYTE DC_DEZ 1 100 0 255 FORMAT "%5.1" ECU_ADDRESS 0x80365C /end MEASUREMENT
/begin MEASUREMENT ETC_VariRate "" UBYTE DC_DEZ 1 100 0 255 FORMAT "%5.1" ECU_ADDRESS 0x80365D /end MEASUREMENT
/begin MEASUREMENT ETC_VariRate_Complement "" UBYTE DC_DEZ 1 100 0 255 FORMAT "%5.1" ECU_ADDRESS 0x80365E /end MEASUREMENT
/begin MEASUREMENT ETC_VariRate_Req "" UBYTE DC_DEZ 1 100 0 255 FORMAT "%5.1" ECU_ADDRESS 0x80365F /end MEASUREMENT
/begin MEASUREMENT evrbgn_one "Ev Nr -1 bei Beginn der Ev-Abschaltung zur Adressierung von REDABM" UBYTE dez 1 100 0 255 FORMAT "%5.1" ECU_ADDRESS 0x8011DC /end MEASUREMENT
/begin MEASUREMENT evz_aus "Einspritzausblendmuster" UBYTE dez 1 100 0 255 FORMAT "%5.1" ECU_ADDRESS 0x8011DD /end MEASUREMENT
/begin MEASUREMENT evz_austot "Einspritzausblendmuster total" UBYTE dez 1 100 0 255 FORMAT "%5.1" ECU_ADDRESS 0x8011E2 /end MEASUREMENT
/begin MEASUREMENT e_vsig_up "Fehler Geschwindigkeitssignal" UBYTE B_TRUE 1 100 0 1 BIT_MASK 0x1 FORMAT "%13.11" ECU_ADDRESS 0x7FA9E9 /end MEASUREMENT
/begin MEASUREMENT fdar "Verst‰rkungsfaktor des AR-Eingriffs" UBYTE fak_ub_b3p125 1 100 0 3.11279 FORMAT "%5.3" ECU_ADDRESS 0x80124D /end MEASUREMENT
/begin MEASUREMENT fdars "Verst‰rkungsfaktor des AR-Eingriffs f¸r Station‰rpfad" UBYTE fak_ub_b3p125 1 100 0 3.11279 FORMAT "%5.3" ECU_ADDRESS 0x80124E /end MEASUREMENT
/begin MEASUREMENT fevab "festes Muster EV-Abschaltung" UBYTE dez 1 100 0 255 FORMAT "%5.1" ECU_ADDRESS 0x800C5F /end MEASUREMENT
/begin MEASUREMENT fevabe "Ausblendmuster aus erkannten Fehlern" UBYTE dez 1 100 0 255 FORMAT "%5.1" ECU_ADDRESS 0x800C60 /end MEASUREMENT
/begin MEASUREMENT fevabkas "festes EV-Abschaltmuster Katschutz" UBYTE dez 1 100 0 255 FORMAT "%5.1" ECU_ADDRESS 0x800C61 /end MEASUREMENT
/begin MEASUREMENT fgr_stat "Status Fahrgeschwindigkeitsregler" UBYTE dez 1 100 0 255 FORMAT "%5.1" ECU_ADDRESS 0x801059 /end MEASUREMENT
/begin MEASUREMENT flrar "Verst‰rkungsfaktor zum Nachbilden der externen Last" UBYTE fak_ub_b16 1 100 0 15.9375 FORMAT "%5.2" ECU_ADDRESS 0x80124F /end MEASUREMENT
/begin MEASUREMENT fmiv08_r "SST-Ausgangsgrˆﬂe von FMIV08" UWORD DC_SEARCH 1 100 0 65535 FORMAT "%6.0" ECU_ADDRESS 0x802F72 /end MEASUREMENT
/begin MEASUREMENT fubkor_w "U_bat Tastverh‰ltnis-Korrekturfaktor in %HRLSU" UWORD fak_uw_b2 1 100 0 1.99997 FORMAT "%8.6" ECU_ADDRESS 0x8009AA /end MEASUREMENT
/begin MEASUREMENT gangi "Ist-Gang" UBYTE dez 1 100 0 255 FORMAT "%5.1" ECU_ADDRESS 0x801287 /end MEASUREMENT
/begin MEASUREMENT HFM_SL_w "" UWORD spg_uw_q0p00488 1 100 0 319.995 FORMAT "%8.4" ECU_ADDRESS 0x80182A /end MEASUREMENT
/begin MEASUREMENT imlatm "integr. Luftmassenfluss ab Motorstart bis Max.wert" UBYTE m_ub_b23p3 1 100 0 23.2107 FORMAT "%5.2" ECU_ADDRESS 0x800854 /end MEASUREMENT
/begin MEASUREMENT imlatm_w "integr. Luftmassenfluss ab Startende bis max. Wert, (Word)" UWORD m_uw_b23p3 1 100 0 23.3013 FORMAT "%8.5" ECU_ADDRESS 0x800870 /end MEASUREMENT
/begin MEASUREMENT imlbbo "Integrator Luftmasse f¸r Erkennung Benzin im ÷l" UBYTE m_ub_b23p3 1 100 0 23.2107 FORMAT "%5.2" ECU_ADDRESS 0x7FC724 /end MEASUREMENT
/begin MEASUREMENT iwmatm2_w "W‰rmemenge f¸r Kondenswasser-Taupunktende Abgas/Kat (word) bank2" UWORD q_q0p4551 1 100 0 29825.7 FORMAT "%8.2" ECU_ADDRESS 0x800872 /end MEASUREMENT
/begin MEASUREMENT iwmatm_w "W‰rmemenge f¸r Kondenswasser-Taupunktende Abgas/Kat (word)" UWORD q_q0p4551 1 100 0 29825.7 FORMAT "%8.2" ECU_ADDRESS 0x800874 /end MEASUREMENT
/begin MEASUREMENT kifz_w "Verst‰rkung des Fahrzeugmodells" UWORD fak_uw_b4864 1 100 0 4863.93 FORMAT "%8.3" ECU_ADDRESS 0x801896 /end MEASUREMENT
/begin MEASUREMENT lbkfkomp_w "Anteil Federkompensation LBK" SWORD rel_sw_q0p02441 1 100 -800 799.976 FORMAT "%8.4" ECU_ADDRESS 0x801406 /end MEASUREMENT
/begin MEASUREMENT lbkgwl_w "LBK ƒnderung Sollwert" SWORD rel_sw_q0p02441 1 100 -800 799.976 FORMAT "%8.4" ECU_ADDRESS 0x801408 /end MEASUREMENT
/begin MEASUREMENT lbklagec_w "LBK Zeitz‰hler Lagefehler" UWORD t_q0p02 1 100 0 1310.7 FORMAT "%8.3" ECU_ADDRESS 0x80140A /end MEASUREMENT
/begin MEASUREMENT lbkld "LBK Regler D-Anteil" UBYTE fak_ub_b4 1 100 0 3.98438 FORMAT "%5.3" ECU_ADDRESS 0x8010B9 /end MEASUREMENT
/begin MEASUREMENT lbkli "LBK I-Anteil" UBYTE fak_ub_b1 1 100 0 0.996094 ECU_ADDRESS 0x8010BA /end MEASUREMENT
/begin MEASUREMENT lbklkomp_w "LBK Kreisverst‰rkung (word)" UWORD fak_uw_b4 1 100 0 3.99994 FORMAT "%8.6" ECU_ADDRESS 0x80140C /end MEASUREMENT
/begin MEASUREMENT lbklp "LBK P-Anteil" UBYTE fak_ub_b4 1 100 0 3.98438 FORMAT "%5.3" ECU_ADDRESS 0x8010BB /end MEASUREMENT
/begin MEASUREMENT lbklpidc_w "LBK hohes PWM-Verh‰ltnis Zeitz‰hler" UWORD t_q0p02 1 100 0 1310.7 FORMAT "%8.3" ECU_ADDRESS 0x80140E /end MEASUREMENT
/begin MEASUREMENT lbkpwrsc_w "LBK Powersave Zeitz‰hler" UWORD t_q0p02 1 100 0 1310.7 FORMAT "%8.3" ECU_ADDRESS 0x801410 /end MEASUREMENT
/begin MEASUREMENT lbkrkomp_w "Anteil Reibungskompensation LBK" SWORD rel_sw_q0p02441 1 100 -800 799.976 FORMAT "%8.4" ECU_ADDRESS 0x801412 /end MEASUREMENT
/begin MEASUREMENT lbksasb_w "LBK Sollwert mit Anstiegsbegrenzung" SWORD rel_sw_q0p02441 1 100 -800 799.976 FORMAT "%8.4" ECU_ADDRESS 0x801414 /end MEASUREMENT
/begin MEASUREMENT ls1ik_w "" UWORD spg_uw_q0p00488 1 100 0 319.995 FORMAT "%8.4" ECU_ADDRESS 0x80182C /end MEASUREMENT
/begin MEASUREMENT LS2IK_w "" UWORD spg_uw_q0p00488 1 100 0 319.995 FORMAT "%8.4" ECU_ADDRESS 0x80182E /end MEASUREMENT
/begin MEASUREMENT lws_w "Lenkwinkel" SWORD lw_sw_q0p04375 1 100 -1434.04 1434 FORMAT "%8.3" ECU_ADDRESS 0x80192A /end MEASUREMENT
/begin MEASUREMENT mdbes_w "Beschleunigungsmoment" SWORD rel_sw_b100 1 100 -100 99.9969 FORMAT "%8.4" ECU_ADDRESS 0x801898 /end MEASUREMENT
/begin MEASUREMENT miagkres_w "koordiniertes inneres Moment mit Reservemoment aus AGK" UWORD rel_uw_b100 1 100 0 99.9985 FORMAT "%8.5" ECU_ADDRESS 0x80192C /end MEASUREMENT
/begin MEASUREMENT miagk_w "koordiniertes inneres Moment aus AGK" UWORD rel_uw_b100 1 100 0 99.9985 FORMAT "%8.5" ECU_ADDRESS 0x80192E /end MEASUREMENT
/begin MEASUREMENT miautget_w "Motormoment ohne Getriebeeingriff" UWORD rel_uw_b100 1 100 0 99.9985 FORMAT "%8.5" ECU_ADDRESS 0x801930 /end MEASUREMENT
/begin MEASUREMENT mifa "indiziertes Motormoment Fahrerwunsch" UBYTE rel_ub_b99p6 1 100 0 99.6094 FORMAT "%5.2" ECU_ADDRESS 0x801289 /end MEASUREMENT
/begin MEASUREMENT mifaagk_w "Indiziertes Fahrerwunschmoment vom AGK" UWORD rel_uw_b100 1 100 0 99.9985 FORMAT "%8.5" ECU_ADDRESS 0x801932 /end MEASUREMENT
/begin MEASUREMENT mifab_w "Begrenztes indiziertes Fahrerwunschmoment" UWORD rel_uw_b100 1 100 0 99.9985 FORMAT "%8.5" ECU_ADDRESS 0x801934 /end MEASUREMENT
/begin MEASUREMENT mifal_w "Indiziertes Fahrerwunschmoment f¸r Momentenkoordination F¸llung" UWORD rel_uw_b100 1 100 0 99.9985 FORMAT "%8.5" ECU_ADDRESS 0x801936 /end MEASUREMENT
/begin MEASUREMENT mifa_w "indiziertes Motormoment Fahrerwunsch" UWORD rel_uw_b100 1 100 0 99.9985 FORMAT "%8.5" ECU_ADDRESS 0x801938 /end MEASUREMENT
/begin MEASUREMENT miistoar_w "Istmoment ohne Antiruckel-Anteil" UWORD rel_uw_b100 1 100 0 99.9985 FORMAT "%8.5" ECU_ADDRESS 0x80193A /end MEASUREMENT
/begin MEASUREMENT miminagk_w "minimales Motormoment, aus AGK" UWORD rel_uw_b100 1 100 0 99.9985 FORMAT "%8.5" ECU_ADDRESS 0x80193C /end MEASUREMENT
/begin MEASUREMENT mist16_r "SST-Ausgangsgrˆﬂe von MIST16" UWORD DC_SEARCH 1 100 0 65535 FORMAT "%6.0" ECU_ADDRESS 0x802F74 /end MEASUREMENT
/begin MEASUREMENT mivbeb_w "Indiziertes Moment vor ƒnderungsbegrenzung, nach oben auf mimax_w begrenzt" UWORD rel_uw_b100 1 100 0 99.9985 FORMAT "%8.5" ECU_ADDRESS 0x80193E /end MEASUREMENT
/begin MEASUREMENT mivbeg_w "inidziertes Fahrerwunschmoment vor ƒnderungsbegrenzung" UWORD rel_uw_b100 1 100 0 99.9985 FORMAT "%8.5" ECU_ADDRESS 0x801940 /end MEASUREMENT
/begin MEASUREMENT mkar_w "Berechnetes Kupplungsmoment f¸r Antiruckelfunktion" SWORD rel_sw_b100 1 100 -100 99.9969 FORMAT "%8.4" ECU_ADDRESS 0x80189A /end MEASUREMENT
/begin MEASUREMENT mlast_w "gesch‰tztes Lastmoment" SWORD rel_sw_b100 1 100 -100 99.9969 FORMAT "%8.4" ECU_ADDRESS 0x80189C /end MEASUREMENT
/begin MEASUREMENT mrfa_w "Relatives Fahrerwunschmoment aus FGR und Pedal" UWORD rel_uw_b200 1 100 0 199.997 FORMAT "%8.4" ECU_ADDRESS 0x801942 /end MEASUREMENT
/begin MEASUREMENT msntev_w "gew¸nschter normierter, ¸berkritischer Massenstrom TEV" UWORD m_uw_b25p6 1 100 0 25.5996 FORMAT "%8.5" ECU_ADDRESS 0x80175E /end MEASUREMENT
/begin MEASUREMENT mspcv "Massenstrom ¸ber PCV Ventil" UBYTE m_q0p1 1 100 0 25.5 FORMAT "%5.2" ECU_ADDRESS 0x8007E1 /end MEASUREMENT
/begin MEASUREMENT mv_dp_r "SST-Ausgangsgrˆﬂe von MV_DP" UWORD DC_SEARCH 1 100 0 65535 FORMAT "%6.0" ECU_ADDRESS 0x802F76 /end MEASUREMENT
/begin MEASUREMENT mv_lsd_r "SST-Ausgangsgrˆﬂe von MV_LSD" UWORD DC_SEARCH 1 100 0 65535 FORMAT "%6.0" ECU_ADDRESS 0x802F78 /end MEASUREMENT
/begin MEASUREMENT ndar_w "Differenzdrehzahl f¸r Momenteneingriff" SWORD nmot_sw_q0p25 1 100 -8192 8191.75 FORMAT "%8.3" ECU_ADDRESS 0x80189E /end MEASUREMENT
/begin MEASUREMENT ndfibet_w "Betrag der gefilterten Differenzdrehzahl" UWORD nmot_uw_q0p25 1 100 0 16383.8 FORMAT "%8.2" ECU_ADDRESS 0x8018A0 /end MEASUREMENT
/begin MEASUREMENT ndfil_w "gefilterte Differenzdrehzahl" SWORD nmot_sw_q0p25 1 100 -8192 8191.75 FORMAT "%8.3" ECU_ADDRESS 0x8018A2 /end MEASUREMENT
/begin MEASUREMENT ndiffog_w "Schwelle Drehzahldifferenz zum Resetieren der AR beim Verzˆgern" SWORD nmot_sw_q0p25 1 100 -8192 8191.75 FORMAT "%8.3" ECU_ADDRESS 0x8018A4 /end MEASUREMENT
/begin MEASUREMENT ndiff_w "Differenzdrehzahl f¸r LFR-HS-Verst‰rkungen" SWORD nmot_sw_q0p25 1 100 -8192 8191.75 FORMAT "%8.3" ECU_ADDRESS 0x8018A6 /end MEASUREMENT
/begin MEASUREMENT ng08_r "SST-Ausgang von NG08" UWORD DC_SEARCH 1 100 0 65535 FORMAT "%6.0" ECU_ADDRESS 0x802F7A /end MEASUREMENT
/begin MEASUREMENT ngwf08_r "SST-Ausgangsgrˆﬂe von NGWF08" UWORD DC_SEARCH 1 100 0 65535 FORMAT "%6.0" ECU_ADDRESS 0x802F7C /end MEASUREMENT
/begin MEASUREMENT nist_1uf_r "Ergebnisgrˆsse NISTV17" UWORD DC_SEARCH 1 100 0 65535 FORMAT "%6.0" ECU_ADDRESS 0x802F7E /end MEASUREMENT
/begin MEASUREMENT nist_lsd_r "SST-Ausgangsgrˆﬂe von NIST_LSD" UWORD DC_SEARCH 1 100 0 65535 FORMAT "%6.0" ECU_ADDRESS 0x802F80 /end MEASUREMENT
/begin MEASUREMENT nmod_w "Motordrehzahl aus Modell" UWORD nmot_uw_q0p25 1 100 0 16383.8 FORMAT "%8.2" ECU_ADDRESS 0x8018A8 /end MEASUREMENT
/begin MEASUREMENT nst08 "" UWORD DC_SEARCH 1 100 0 65535 FORMAT "%6.0" ECU_ADDRESS 0x802F82 /end MEASUREMENT
/begin MEASUREMENT nverh_r "SST-Ausgangsgrˆﬂe von NVERH" UWORD DC_SEARCH 1 100 0 65535 FORMAT "%6.0" ECU_ADDRESS 0x802F84 /end MEASUREMENT
/begin MEASUREMENT ottstamp_l "Berechnungsgrˆsse letzte Zahnzeit absolut" SLONG t_q0p0001_ms 1 100 -107374 107374 FORMAT "%13.6" ECU_ADDRESS 0x801DE4 /end MEASUREMENT
/begin MEASUREMENT phasedsls "Phase des Zustandsautomate in der sich die SLS-Diagnose aktuell befindet" UBYTE dez 1 100 0 255 FORMAT "%5.1" ECU_ADDRESS 0x800A6A /end MEASUREMENT
/begin MEASUREMENT prem_w "" UWORD spg_uw_q0p00488 1 100 0 319.995 FORMAT "%8.4" ECU_ADDRESS 0x801830 /end MEASUREMENT
/begin MEASUREMENT pw12r_r "?" UWORD DC_SEARCH 1 100 0 65535 FORMAT "%6.0" ECU_ADDRESS 0x802F86 /end MEASUREMENT
/begin MEASUREMENT redsolr "Realisierte Reduzierstufe" UBYTE dez 1 100 0 255 FORMAT "%5.1" ECU_ADDRESS 0x8011DE /end MEASUREMENT
/begin MEASUREMENT redsol_one "Berechnete Soll-Reduzierstufe - 1 zur Adress. von REDABM" UBYTE dez 1 100 0 255 FORMAT "%5.1" ECU_ADDRESS 0x8011DF /end MEASUREMENT
/begin MEASUREMENT RES1_w "" UWORD spg_uw_q0p00488 1 100 0 319.995 FORMAT "%8.4" ECU_ADDRESS 0x801832 /end MEASUREMENT
/begin MEASUREMENT RES2_w "" UWORD spg_uw_q0p00488 1 100 0 319.995 FORMAT "%8.4" ECU_ADDRESS 0x801834 /end MEASUREMENT
/begin MEASUREMENT RES3_w "" UWORD spg_uw_q0p00488 1 100 0 319.995 FORMAT "%8.4" ECU_ADDRESS 0x801836 /end MEASUREMENT
/begin MEASUREMENT sst_ax_ay "SST-Ausgangsgrˆﬂe von LK2_AX" UWORD DC_SEARCH 1 100 0 65535 FORMAT "%6.0" ECU_ADDRESS 0x802F88 /end MEASUREMENT
/begin MEASUREMENT sst_ia_t "St¸tzstellen Intake Air Temperature" UWORD DC_SEARCH 1 100 0 65535 FORMAT "%6.0" ECU_ADDRESS 0x802F8A /end MEASUREMENT
/begin MEASUREMENT sst_pwr_vg16_r "" UWORD DC_SEARCH 1 100 0 65535 FORMAT "%6.0" ECU_ADDRESS 0x802F8C /end MEASUREMENT
/begin MEASUREMENT stateaevab "Nr des aktiven Zustandes in AEVAB" UBYTE dez 1 100 0 255 FORMAT "%5.1" ECU_ADDRESS 0x8011E0 /end MEASUREMENT
/begin MEASUREMENT sw_ped_r " Ergebnis SST PWV" UWORD DC_SEARCH 1 100 0 65535 FORMAT "%6.0" ECU_ADDRESS 0x802F8E /end MEASUREMENT
/begin MEASUREMENT tabgm "Abgastemperatur vor Kat aus Modell" UBYTE temp_ub_q5_o50 1 100 -50 1225 FORMAT "%5.0" ECU_ADDRESS 0x800855 /end MEASUREMENT
/begin MEASUREMENT tabgm2 "Abgastemperatur vor Kat aus Modell Bank2" UBYTE temp_ub_q5_o50 1 100 -50 1225 FORMAT "%5.0" ECU_ADDRESS 0x800856 /end MEASUREMENT
/begin MEASUREMENT tabgm2_w "Abgastemperatur vor Kat aus Modell (Word) Bank2" UWORD temp_uw_q0p0195_o50 1 100 -50 1229.98 FORMAT "%8.3" ECU_ADDRESS 0x800876 /end MEASUREMENT
/begin MEASUREMENT tabgmab "Abgastemperatur beim Abstellen des Motors" UBYTE temp_ub_q5_o50 1 100 -50 1225 FORMAT "%5.0" ECU_ADDRESS 0x7FC727 /end MEASUREMENT
/begin MEASUREMENT tabgmab2 "Abgastemperatur beim Abstellen des Motors (Modell) Bank2" UBYTE temp_ub_q5_o50 1 100 -50 1225 FORMAT "%5.0" ECU_ADDRESS 0x7FC728 /end MEASUREMENT
/begin MEASUREMENT tabgmst "Abgastemperatur bei Motorstart" UBYTE temp_ub_q5_o50 1 100 -50 1225 FORMAT "%5.0" ECU_ADDRESS 0x800857 /end MEASUREMENT
/begin MEASUREMENT tabgmst2 "Abgastemperatur bei Motorstart Bank2" UBYTE temp_ub_q5_o50 1 100 -50 1225 FORMAT "%5.0" ECU_ADDRESS 0x800858 /end MEASUREMENT
/begin MEASUREMENT tabgm_w "Abgastemperatur vor Kat aus Modell (Word)" UWORD temp_uw_q0p0195_o50 1 100 -50 1229.98 FORMAT "%8.3" ECU_ADDRESS 0x800878 /end MEASUREMENT
/begin MEASUREMENT tabstatm_w "Abstellzeit im SG-Nachlauf f¸r ATM" UWORD t1sxs_uw_q1 1 100 0 65535 FORMAT "%8.2" ECU_ADDRESS 0x80087A /end MEASUREMENT
/begin MEASUREMENT tabstmx_w "Abstellzeit Maximumabfrage f¸r ATM" UWORD t1sxs_uw_q1 1 100 0 65535 FORMAT "%8.2" ECU_ADDRESS 0x7FC730 /end MEASUREMENT
/begin MEASUREMENT TAG1_w "" UWORD spg_uw_q0p00488 1 100 0 319.995 FORMAT "%8.4" ECU_ADDRESS 0x801838 /end MEASUREMENT
/begin MEASUREMENT TAG2_w "" UWORD spg_uw_q0p00488 1 100 0 319.995 FORMAT "%8.4" ECU_ADDRESS 0x80183A /end MEASUREMENT
/begin MEASUREMENT tahrlsu2_w "Tastverh‰ltnis f¸r Lambdasondenheizung, Bank 2" UWORD rel_uw_b200 1 100 0 199.997 FORMAT "%8.4" ECU_ADDRESS 0x8009AC /end MEASUREMENT
/begin MEASUREMENT tahrlsu_w "Tastverh‰ltnis f¸r Lambdasondenheizung" UWORD rel_uw_b200 1 100 0 199.997 FORMAT "%8.4" ECU_ADDRESS 0x8009AE /end MEASUREMENT
/begin MEASUREMENT tajal "Tastverh‰ltnis Jalousie-Position aus Thermomanagement" UWORD rel_uw_b200 1 100 0 199.997 FORMAT "%8.4" ECU_ADDRESS 0x801944 /end MEASUREMENT
/begin MEASUREMENT talbks_w "Vorzeichenbehaftetes Tastverh‰ltnis LBK" SWORD rel_sw_b100 1 100 -100 99.9969 FORMAT "%8.4" ECU_ADDRESS 0x801416 /end MEASUREMENT
/begin MEASUREMENT talbk_w "Tastverh‰ltnis LBK" UWORD rel_uw_b100 1 100 0 99.9985 FORMAT "%8.5" ECU_ADDRESS 0x801418 /end MEASUREMENT
/begin MEASUREMENT taml "Tastverh‰ltnis E-L¸fter" UBYTE tv_ub_b100 1 100 0 99.6094 FORMAT "%5.2" ECU_ADDRESS 0x800DB3 /end MEASUREMENT
/begin MEASUREMENT tateist "aktuelles Ist-Tastverh‰ltnis Tankentl¸ftungsventil" UBYTE rel_ub_b99p6 1 100 0 99.6094 FORMAT "%5.2" ECU_ADDRESS 0x8011C0 /end MEASUREMENT
/begin MEASUREMENT tateist_w "aktuelles Ist-Tastverh‰ltnis Tankentl¸ftungsventil (16 Bit)" UWORD rel_uw_b100 1 100 0 99.9985 FORMAT "%8.5" ECU_ADDRESS 0x801760 /end MEASUREMENT
/begin MEASUREMENT tateout "ausgegebenes Tastverh‰ltnis f¸r Tankentl¸ftungsventil" UBYTE rel_ub_b99p6 1 100 0 99.6094 FORMAT "%5.2" ECU_ADDRESS 0x8011C1 /end MEASUREMENT
/begin MEASUREMENT tateout_w "ausgegebenes Tastverh‰ltnis f¸r Tankentl¸ftungsventil (16 Bit)" UWORD rel_uw_b100 1 100 0 99.9985 FORMAT "%8.5" ECU_ADDRESS 0x801762 /end MEASUREMENT
/begin MEASUREMENT tateroh "Rohwert Tastverh‰ltnis TEV" UBYTE rel_ub_b99p6 1 100 0 99.6094 FORMAT "%5.2" ECU_ADDRESS 0x800BBC /end MEASUREMENT
/begin MEASUREMENT tateroh_w "Rohwert Tastverh‰ltnis TEV (16 Bit)" UWORD rel_uw_b100 1 100 0 99.9985 FORMAT "%8.5" ECU_ADDRESS 0x801764 /end MEASUREMENT
/begin MEASUREMENT tatesold_w "gew¸nschtes Soll-Tastverh‰ltnis Tankentl¸ftungsventil ; alter Wert" UWORD rel_uw_b100 1 100 0 99.9985 FORMAT "%8.5" ECU_ADDRESS 0x801766 /end MEASUREMENT
/begin MEASUREMENT tatesoll_w "gew¸nschtes Soll-Tastverh‰ltnis Tankentl¸ftungsventil (16 Bit)" UWORD rel_uw_b100 1 100 0 99.9985 FORMAT "%8.5" ECU_ADDRESS 0x801768 /end MEASUREMENT
/begin MEASUREMENT tatherm "Tastverh‰ltnis Thermostat aus Thermomanagement" UWORD rel_uw_q0p03125 1 100 0 2047.97 FORMAT "%8.3" ECU_ADDRESS 0x801946 /end MEASUREMENT
/begin MEASUREMENT tatmaml "Ausgang aus PT1-Glied Abgastemperatur-Einfluﬂ auf tabgm" UBYTE temp_ub_q5_o50 1 100 -50 1225 FORMAT "%5.0" ECU_ADDRESS 0x800859 /end MEASUREMENT
/begin MEASUREMENT tatmaml2 "Ausgang aus PT1-Glied Abgastemperatur-Einfluﬂ auf tabgm, Bank2" UBYTE temp_ub_q5_o50 1 100 -50 1225 FORMAT "%5.0" ECU_ADDRESS 0x80085A /end MEASUREMENT
/begin MEASUREMENT tatmkf "Abgastemperatur vor Kat aus Kennfeld KFTATM" UBYTE temp_ub_q5_o50 1 100 -50 1225 FORMAT "%5.0" ECU_ADDRESS 0x80085B /end MEASUREMENT
/begin MEASUREMENT tatmkf2 "Abgastemperatur vor Kat aus Kennfeld KFTATM Bank2" UBYTE temp_ub_q5_o50 1 100 -50 1225 FORMAT "%5.0" ECU_ADDRESS 0x80085C /end MEASUREMENT
/begin MEASUREMENT tatmrml "Ausgang aus PT1-Glied Rohrwandtemperatur-Einfluﬂ auf tabgm" UBYTE temp_ub_q5_o50 1 100 -50 1225 FORMAT "%5.0" ECU_ADDRESS 0x80085D /end MEASUREMENT
/begin MEASUREMENT tatmrml2 "Ausgang aus PT1-Glied Rohrwandtemperatur-Einfluﬂ auf tabgm, Bank2" UBYTE temp_ub_q5_o50 1 100 -50 1225 FORMAT "%5.0" ECU_ADDRESS 0x80085E /end MEASUREMENT
/begin MEASUREMENT tatmsta "Abgastemperatur vor Kat aus Modell station‰r" UBYTE temp_ub_q5_o50 1 100 -50 1225 FORMAT "%5.0" ECU_ADDRESS 0x80085F /end MEASUREMENT
/begin MEASUREMENT tatmsta2 "Abgastemperatur vor Kat aus Modell station‰r Bank2" UBYTE temp_ub_q5_o50 1 100 -50 1225 FORMAT "%5.0" ECU_ADDRESS 0x800860 /end MEASUREMENT
/begin MEASUREMENT tatu "Ansaugluft- oder Umgebungstemperatur" UBYTE temp_ub_q0p75_o48 1 100 -48 143.25 FORMAT "%5.1" ECU_ADDRESS 0x800861 /end MEASUREMENT
/begin MEASUREMENT temp_klt_l "Zahnzeit aus KLALETM mit der Temperatur zum Beginn der Nachlaufphase" SLONG t_q0p0001_ms 1 100 -214748 214748 FORMAT "%13.6" ECU_ADDRESS 0x801DE8 /end MEASUREMENT
/begin MEASUREMENT temp_tn1_l "Ringpuffervariable, letzte Zahnzeit" SLONG t_q0p0001_ms 1 100 -214748 214748 FORMAT "%13.6" ECU_ADDRESS 0x801DEC /end MEASUREMENT
/begin MEASUREMENT temp_tn2_l "Ringpuffervariable, vorletzte Zahnzeit" SLONG t_q0p0001_ms 1 100 -214748 214748 FORMAT "%13.6" ECU_ADDRESS 0x801DF0 /end MEASUREMENT
/begin MEASUREMENT temp_tn_l "Ringpuffervariable, aktuelle Zahnzeit" SLONG t_q0p0001_ms 1 100 -214748 214748 FORMAT "%13.6" ECU_ADDRESS 0x801DF4 /end MEASUREMENT
/begin MEASUREMENT temp_w1 "Zwischenwerte f¸r Plausibilisierung" SWORD kw_q0p1 1 100 0 412 FORMAT "%8.4" ECU_ADDRESS 0x801B9A /end MEASUREMENT
/begin MEASUREMENT temp_w2 "Zwischenwerte f¸r Plausibilisierung" SWORD kw_q0p1 1 100 -3276.8 3276.7 FORMAT "%8.3" ECU_ADDRESS 0x801B9C /end MEASUREMENT
/begin MEASUREMENT temp_w3 "Zwischenwerte f¸r Plausibilisierung" SWORD kw_q0p1 1 100 -3276.8 3276.7 FORMAT "%8.3" ECU_ADDRESS 0x801B9E /end MEASUREMENT
/begin MEASUREMENT temp_w4 "Zwischenwerte f¸r Plausibilisierung" SWORD kw_q0p1 1 100 -3276.8 3276.7 FORMAT "%8.3" ECU_ADDRESS 0x801BA0 /end MEASUREMENT
/begin MEASUREMENT tevper "Periodendauer bei Ansteuerung Tankentl¸ftungsventil" UBYTE t500usxms_ub_q0p5 1 100 0 127.5 FORMAT "%5.1" ECU_ADDRESS 0x800BBD /end MEASUREMENT
/begin MEASUREMENT texkor "Korrektur der exothermen Temperaturerhˆhung im Kat texom_w" UBYTE fak_ub_b2 1 100 0 1.99219 FORMAT "%5.3" ECU_ADDRESS 0x800862 /end MEASUREMENT
/begin MEASUREMENT texkor2 "Korrektur der exothermen Temperaturerhˆhung im Kat texom2_w, Bank2" UBYTE fak_ub_b2 1 100 0 1.99219 FORMAT "%5.3" ECU_ADDRESS 0x800863 /end MEASUREMENT
/begin MEASUREMENT texml "Exotherme Temperaturerhˆhung im Kat f¸r tkatm aus Kennlinie" SBYTE temp_q5 1 100 -640 635 FORMAT "%5.1" ECU_ADDRESS 0x800864 /end MEASUREMENT
/begin MEASUREMENT texml2 "Exotherme Temperaturerhˆhung im Kat f¸r tkatm aus Kennlinie, Bank2" SBYTE temp_q5 1 100 -640 635 FORMAT "%5.1" ECU_ADDRESS 0x800865 /end MEASUREMENT
/begin MEASUREMENT texoikm2_w "Exotherme Temperaturerhˆhung im Kat  f¸r tikatm, Bank2" SWORD temp_q0p0195 1 100 -640 639.98 FORMAT "%8.4" ECU_ADDRESS 0x80087C /end MEASUREMENT
/begin MEASUREMENT texoikm_w "Exotherme Temperaturerhˆhung im Kat f¸r tikatm" SWORD temp_q0p0195 1 100 -640 639.98 FORMAT "%8.4" ECU_ADDRESS 0x80087E /end MEASUREMENT
/begin MEASUREMENT texom2_w "Exotherme Temperaturerhˆhung im Kat  f¸r tkatm2, Bank2" SWORD temp_q0p0195 1 100 -640 639.98 FORMAT "%8.4" ECU_ADDRESS 0x800880 /end MEASUREMENT
/begin MEASUREMENT texom_w "Exotherme Temperaturerhˆhung im Kat f¸r tkatm" SWORD temp_q0p0195 1 100 -640 639.98 FORMAT "%8.4" ECU_ADDRESS 0x800882 /end MEASUREMENT
/begin MEASUREMENT tiexkor "Korrektur der exothermen Temperaturerhˆhung im Kat texoikm_w" UBYTE fak_ub_b2 1 100 0 1.99219 FORMAT "%5.3" ECU_ADDRESS 0x800866 /end MEASUREMENT
/begin MEASUREMENT tiexkor2 "Korrektur der exothermen Temperaturerhˆhung im Kat texoikm2_w, Bank2" UBYTE fak_ub_b2 1 100 0 1.99219 FORMAT "%5.3" ECU_ADDRESS 0x800867 /end MEASUREMENT
/begin MEASUREMENT tiexml "Exotherme Temperaturerhˆhung im Kat f¸r tikatm aus Kennlinie" SBYTE temp_q5 1 100 -640 635 FORMAT "%5.1" ECU_ADDRESS 0x800868 /end MEASUREMENT
/begin MEASUREMENT tiexml2 "Exotherme Temperaturerhˆhung im Kat f¸r tikatm aus Kennlinie, Bank2" SBYTE temp_q5 1 100 -640 635 FORMAT "%5.1" ECU_ADDRESS 0x800869 /end MEASUREMENT
/begin MEASUREMENT tikatm "Abgastemperatur im Katalysator aus Modell" UBYTE temp_ub_q5_o50 1 100 -50 1225 FORMAT "%5.0" ECU_ADDRESS 0x80086A /end MEASUREMENT
/begin MEASUREMENT tikatm2 "Abgastemperatur im Katalysator aus Modell Bank 2" UBYTE temp_ub_q5_o50 1 100 -50 1225 FORMAT "%5.0" ECU_ADDRESS 0x80086B /end MEASUREMENT
/begin MEASUREMENT tikatm2_w "Abgastemperatur im Katalysator aus Modell Bank 2" UWORD temp_uw_q0p0195_o50 1 100 -50 1229.98 FORMAT "%8.3" ECU_ADDRESS 0x800884 /end MEASUREMENT
/begin MEASUREMENT tikatm_w "Abgastemperatur im Katalysator aus Modell" UWORD temp_uw_q0p0195_o50 1 100 -50 1229.98 FORMAT "%8.3" ECU_ADDRESS 0x800886 /end MEASUREMENT
/begin MEASUREMENT tkatm "Katalysatortemperatur aus Modell" UBYTE temp_ub_q5_o50 1 100 -50 1225 FORMAT "%5.0" ECU_ADDRESS 0x80086C /end MEASUREMENT
/begin MEASUREMENT tkatm2 "Katalysatortemperatur aus Modell,  Bank2" UBYTE temp_ub_q5_o50 1 100 -50 1225 FORMAT "%5.0" ECU_ADDRESS 0x80086D /end MEASUREMENT
/begin MEASUREMENT tkatm2_w "Katalysatortemperatur aus Modell (Word) Bank2" UWORD temp_uw_q0p0195_o50 1 100 -50 1229.98 FORMAT "%8.3" ECU_ADDRESS 0x800888 /end MEASUREMENT
/begin MEASUREMENT tkatmab "Abgastemperatur hinter Kat beim Abstellen des Motors (Modell)" UBYTE temp_ub_q5_o50 1 100 -50 1225 FORMAT "%5.0" ECU_ADDRESS 0x7FC729 /end MEASUREMENT
/begin MEASUREMENT tkatmab2 "Abgastemperatur hinter Kat beim Abstellen des Motors (Modell) Bank2" UBYTE temp_ub_q5_o50 1 100 -50 1225 FORMAT "%5.0" ECU_ADDRESS 0x7FC72A /end MEASUREMENT
/begin MEASUREMENT tkatmst "Katalysatortemperatur Modell Startwert = f(Abstellwert, Abstellzeit)" UBYTE temp_ub_q5_o50 1 100 -50 1225 FORMAT "%5.0" ECU_ADDRESS 0x80086E /end MEASUREMENT
/begin MEASUREMENT tkatmst2 "Katalysatortemperatur Modell Startwert = f(Abstellwert,Abstellzeit) Bank2" UBYTE temp_ub_q5_o50 1 100 -50 1225 FORMAT "%5.0" ECU_ADDRESS 0x80086F /end MEASUREMENT
/begin MEASUREMENT tkatm_w "Katalysatortemperatur aus Modell (Word)" UWORD temp_uw_q0p0195_o50 1 100 -50 1229.98 FORMAT "%8.3" ECU_ADDRESS 0x80088A /end MEASUREMENT
/begin MEASUREMENT tlst08 "SS-Suche nach tl8 in TL8V08" UWORD DC_SEARCH 1 100 0 65535 FORMAT "%6.0" ECU_ADDRESS 0x802F90 /end MEASUREMENT
/begin MEASUREMENT tmessmf "Zeit innerhalb des Messfensters der Messphase" UBYTE t_q0p1 1 100 0 25.5 FORMAT "%5.2" ECU_ADDRESS 0x800A6B /end MEASUREMENT
/begin MEASUREMENT tmlastz "Abw‰rtsz‰hler zum Resetieren der AR beim Verzˆgern" UBYTE t10msxs_ub_b2p55 1 100 0 2.55 FORMAT "%5.3" ECU_ADDRESS 0x801250 /end MEASUREMENT
/begin MEASUREMENT tnmst1z "" UBYTE t10msxs_ub_b2p55 1 100 0 2.55 FORMAT "%5.3" ECU_ADDRESS 0x801251 /end MEASUREMENT
/begin MEASUREMENT tnmst2z "" UBYTE t10msxs_ub_b2p55 1 100 0 2.55 FORMAT "%5.3" ECU_ADDRESS 0x801252 /end MEASUREMENT
/begin MEASUREMENT toffsmf "Zeit innerhalb des Messfensters der Offsetphase" UBYTE t_q0p1 1 100 0 25.5 FORMAT "%5.2" ECU_ADDRESS 0x800A6C /end MEASUREMENT
/begin MEASUREMENT tooth10ms "Z‰hlvariable; f¸r die Abfrage, ob der letzte Zahnint l‰nger als 100ms her ist" UBYTE dez 1 100 0 127 FORMAT "%5.1" ECU_ADDRESS 0x80100E /end MEASUREMENT
/begin MEASUREMENT toothtim_l "Zahnzeit" SLONG t_q0p0001_ms 1 100 -214748 214748 FORMAT "%13.6" ECU_ADDRESS 0x801DF8 /end MEASUREMENT
/begin MEASUREMENT tphrlsu_w "Periodendauer f¸r die Heizertaktung der LSU" UWORD t100msxs_q16Em6 1 100 0 1.04856 FORMAT "%8.6" ECU_ADDRESS 0x8009B0 /end MEASUREMENT
/begin MEASUREMENT ttstamp_l "Berechnungsgrˆsse aktuelle Zahnzeit absolut" SLONG t_q0p0001_ms 1 100 -107374 107374 FORMAT "%13.6" ECU_ADDRESS 0x801DFC /end MEASUREMENT
/begin MEASUREMENT ttstmpmx_l "‹berlauf Zahnzeit Ausgabe aus HW-Treiber" ULONG t_q0p0001_ms 1 100 0 214748 FORMAT "%13.6" ECU_ADDRESS 0x801E00 /end MEASUREMENT
/begin MEASUREMENT tventmf "Zeit innerhalb des Messfensters der Ventildichtigkeitsphase" UBYTE t_q0p1 1 100 0 25.5 FORMAT "%5.2" ECU_ADDRESS 0x800A6D /end MEASUREMENT
/begin MEASUREMENT tvrnr "Verzˆgerungszeit bis zum wirklichen Ev-Abschaltende" UBYTE dez 1 100 0 255 FORMAT "%5.1" ECU_ADDRESS 0x8011E1 /end MEASUREMENT
/begin MEASUREMENT tvtevptu "Verzugszeit von TEV  (druck-, batteriespannung- und temperaturabh‰ngig)" UBYTE t500usxms_ub_q0p5 1 100 0 127.5 FORMAT "%5.1" ECU_ADDRESS 0x8011C2 /end MEASUREMENT
/begin MEASUREMENT tzarni "Zeitz‰hler AR nach Initialisierung" UBYTE t10msxs_ub_b2p55 1 100 0 2.55 FORMAT "%5.3" ECU_ADDRESS 0x801253 /end MEASUREMENT
/begin MEASUREMENT udkp1v_w "Verst‰rkte Spannung DK-Poti 1" UWORD spg_uw_q0p00488 1 100 0 319.995 FORMAT "%8.4" ECU_ADDRESS 0x80183C /end MEASUREMENT
/begin MEASUREMENT udkp1_w "Spannung DK-Poti 1" UWORD spg_uw_q0p001222 1 100 0 80.0838 FORMAT "%8.5" ECU_ADDRESS 0x80183E /end MEASUREMENT
/begin MEASUREMENT udkp2_w "Spannung DK-Poti 2" UWORD spg_uw_q0p001222 1 100 0 80.0838 FORMAT "%8.5" ECU_ADDRESS 0x801840 /end MEASUREMENT
/begin MEASUREMENT udss_w "Spannung Drucksensor Saugrohrdruck (word)" UWORD spg_uw_q0p00488 1 100 0 319.995 FORMAT "%8.4" ECU_ADDRESS 0x800D10 /end MEASUREMENT
/begin MEASUREMENT udsu_w "Spannung Umgebungsdrucksensor (word 10-Bit von ADC)" UWORD spg_uw_q0p00488 1 100 0 319.995 FORMAT "%8.4" ECU_ADDRESS 0x801842 /end MEASUREMENT
/begin MEASUREMENT ulbkist_w "Spannung der LBK-Lager¸ckmeldung" UWORD spg_uw_q0p00488 1 100 0 319.995 FORMAT "%8.4" ECU_ADDRESS 0x801844 /end MEASUREMENT
/begin MEASUREMENT upwg1_w "Spannung PWG-Poti 1 (Word)" UWORD spg_uw_q0p00488 1 100 0 319.995 FORMAT "%8.4" ECU_ADDRESS 0x801846 /end MEASUREMENT
/begin MEASUREMENT upwg2_w "Spannung PWG-Poti 2 (Word)" UWORD spg_uw_q0p00488 1 100 0 319.995 FORMAT "%8.4" ECU_ADDRESS 0x801848 /end MEASUREMENT
/begin MEASUREMENT vcanv05_r "SST-Ausgangsgrˆﬂe von VCANV05" UWORD DC_SEARCH 1 100 0 65535 FORMAT "%6.0" ECU_ADDRESS 0x802F92 /end MEASUREMENT
/begin MEASUREMENT vcanv16_r "SST-Ausgangsgrˆﬂe von VCANV16" UWORD DC_SEARCH 1 100 0 65535 FORMAT "%6.0" ECU_ADDRESS 0x802F94 /end MEASUREMENT
/begin MEASUREMENT vfzg "Fahrzeuggeschwindigkeit" UBYTE vfzg_ub_q1p25 1 100 0 318.75 FORMAT "%5.1" ECU_ADDRESS 0x80128A /end MEASUREMENT
/begin MEASUREMENT vfzg_w "Fahrzeuggeschwindigkeit" UWORD vfzg_uw_b512 1 100 0 511.992 FORMAT "%8.4" ECU_ADDRESS 0x801948 /end MEASUREMENT
/begin MEASUREMENT vkst_w "Gefˆrdertes Kraftstoffvolumen" UWORD vol_q0p1 1 100 0 6553.5 FORMAT "%8.3" ECU_ADDRESS 0x800C0E /end MEASUREMENT
/begin MEASUREMENT vvg_r "SST-Ausgangsgrˆﬂe von VVG*" UWORD DC_SEARCH 1 100 0 65535 FORMAT "%6.0" ECU_ADDRESS 0x802F96 /end MEASUREMENT
/begin MEASUREMENT vwag04_r "SST-Ausgangsgrˆﬂe von VWAG04" UWORD DC_SEARCH 1 100 0 65535 FORMAT "%6.0" ECU_ADDRESS 0x802F98 /end MEASUREMENT
/begin MEASUREMENT wkwalerr_w "unkorrigierter Auslaufwinkel" SWORD kw_q0p1 1 100 -3276.8 3276.7 FORMAT "%8.3" ECU_ADDRESS 0x801BA2 /end MEASUREMENT
/begin MEASUREMENT wkwale_w "Kurbelwellenwinkel im Arbeitsspiel ohne L¸ckenkorrektur" SWORD kw_q0p1 1 100 -720 1440 FORMAT "%8.3" ECU_ADDRESS 0x801BA4 /end MEASUREMENT
/begin MEASUREMENT wkwalkor_w "Winkel inklusive L¸cke bei Start ALE" UWORD kw_q0p1 1 100 0 720 FORMAT "%8.4" ECU_ADDRESS 0x801BA6 /end MEASUREMENT
/begin MEASUREMENT wkwalold_w "Kurbelwinkel zum Zeitpunkt B_ale  = 1" SWORD kw_q0p1 1 100 -3276.8 3276.7 FORMAT "%8.3" ECU_ADDRESS 0x801BA8 /end MEASUREMENT
/begin MEASUREMENT wkwaskor_w "korrigierter Auslaufwinkel" SWORD kw_q0p1 1 100 -3276.8 3276.7 FORMAT "%8.3" ECU_ADDRESS 0x801BAA /end MEASUREMENT
/begin MEASUREMENT wkwrale_w "Winkel Kurbelwelle beim ersten r¸ckdrehenden Zahn (word)" SWORD kw_q0p1 1 100 -720 1440 FORMAT "%8.3" ECU_ADDRESS 0x801BAC /end MEASUREMENT
/begin MEASUREMENT wkwstop_w "Motorabstellposition im Arbeitsspiel mit L¸ckenkorrektur" UWORD kw_q0p1 1 100 0 1000 FORMAT "%8.3" ECU_ADDRESS 0x7FC7D2 /end MEASUREMENT
/begin MEASUREMENT wlbkdlra_w "LBK letzter Sollwert" SWORD rel_sw_q0p02441 1 100 -800 799.976 FORMAT "%8.4" ECU_ADDRESS 0x80141A /end MEASUREMENT
/begin MEASUREMENT wlbkdlr_w "LBK Sollposition" SWORD rel_sw_q0p02441 1 100 -800 799.976 FORMAT "%8.4" ECU_ADDRESS 0x80141C /end MEASUREMENT
/begin MEASUREMENT wlbksfi_w "LBK gefilterter Soll-Wert" SWORD rel_sw_q0p02441 1 100 -800 799.976 FORMAT "%8.4" ECU_ADDRESS 0x80141E /end MEASUREMENT
/begin MEASUREMENT wped "Normierter Fahrpedalwinkel" UBYTE relPED_ub_b100 1 100 0 100 FORMAT "%5.1" ECU_ADDRESS 0x80128B /end MEASUREMENT
/begin MEASUREMENT wped_w "normierter Fahrpedalwinkel" UWORD relPED_uw_b100 1 100 0 100 FORMAT "%8.4" ECU_ADDRESS 0x80194A /end MEASUREMENT
/begin MEASUREMENT wtans "A/D-Wert f¸r Ansauglufttemperatur tans" UBYTE spg_ub_b5 1 100 0 4.98047 FORMAT "%5.3" ECU_ADDRESS 0x801243 /end MEASUREMENT
/begin MEASUREMENT wtka "A/D-Wert f¸r TKA (Temperatur K¸hlerausgang)" UWORD spg_uw_q0p00488 1 100 0 319.995 FORMAT "%8.4" ECU_ADDRESS 0x80184A /end MEASUREMENT
/begin MEASUREMENT wtmot_w "A/D-Wert f¸r tmot 10 bit" UWORD spg_uw_q0p00488 1 100 0 319.995 FORMAT "%8.4" ECU_ADDRESS 0x80184C /end MEASUREMENT
/begin MEASUREMENT wtsg "Wert Temperatur Steuerger‰t" UBYTE spg_ub_b5 1 100 0 4.98047 FORMAT "%5.3" ECU_ADDRESS 0x801244 /end MEASUREMENT
/begin MEASUREMENT wub "Batteriespannung; vom AD-Wandler erfaﬂter Wert" UBYTE spg_ubatt 1 100 0 24.021 FORMAT "%5.2" ECU_ADDRESS 0x800D0E /end MEASUREMENT
/begin MEASUREMENT zwmatm "Z‰hler f¸r ATM-Wiederholstart und Faktor f¸r W‰rmemengen-Schwellen" UBYTE dez 1 100 0 255 FORMAT "%5.1" ECU_ADDRESS 0x7FC72B /end MEASUREMENT
/begin MEASUREMENT zwmatm2 "Z‰hler f¸r ATM-Wiederholstart und Faktor f¸r W‰rmemengen-Schwellen Bank2" UBYTE dez 1 100 0 255 FORMAT "%5.1" ECU_ADDRESS 0x7FC72C /end MEASUREMENT
/begin MEASUREMENT zwmatmf "Z‰hler f¸r ATM-Wiederholstart und Faktor f¸r W‰rmemengen-Schwellwert upstream" UBYTE dez 1 100 0 255 FORMAT "%5.1" ECU_ADDRESS 0x7FC72D /end MEASUREMENT
/begin MEASUREMENT zwmatmf2 "Z‰hler f¸r ATM-Wiederholst.und Faktor f¸r W‰rmemengen-Schwellw. upstream Bank2" UBYTE dez 1 100 0 255 FORMAT "%5.1" ECU_ADDRESS 0x7FC72E /end MEASUREMENT
/begin FUNCTION AADKB "20.11     Adaptive AntriebsDynamik:Kontinuierliche Fahrerbeobachtung"
 /begin DEF_CHARACTERISTIC AADKB_FA AADKB_FV AADKB_OF AADKB_ON AADKB_RE AADKB_SG AADKB_SO AADKB_SU /end DEF_CHARACTERISTIC
 /begin REF_CHARACTERISTIC AADPD_RU /end REF_CHARACTERISTIC
 /begin IN_MEASUREMENT APP DMLD_APPGrdtMax DMLD_Off DMLD_VehSpd10kmh_Tmr DP_LongDyn EfficDP_HighLim EfficDP_LowLim Tmr100ms_lw Veh_Spd vk_mot2 /end IN_MEASUREMENT
 /begin OUT_MEASUREMENT ADD_APPFiltd ADD_APPFiltd_Mem ADD_APPGrdt_IncrdThres ADD_APPGrdt_Thres ADD_CDS ADD_CDS_APPGrdt ADD_CDS_CAN ADD_CDS_Filtd ADD_CDS_Req ADD_CDS_Thres /end OUT_MEASUREMENT
 /begin LOC_MEASUREMENT /end LOC_MEASUREMENT
 /begin SUB_FUNCTION /end SUB_FUNCTION
/end FUNCTION
/begin FUNCTION AADNT "20.11     Adaptive AntriebsDynamik:Erkennung der Fahreraktivit‰t und Nervosit‰t" /begin DEF_CHARACTERISTIC AADNT1 AADNT2 AADNT3 AADNT4 AADNT5 AADNTRED AADNT_ON /end DEF_CHARACTERISTIC /begin REF_CHARACTERISTIC /end REF_CHARACTERISTIC /begin IN_MEASUREMENT APP DP_LongDyn DP_TrvrDyn vk_mot2 /end IN_MEASUREMENT /begin OUT_MEASUREMENT ADD_Nerv_Detct ADD_Nerv_Rate /end OUT_MEASUREMENT /begin LOC_MEASUREMENT /end LOC_MEASUREMENT /begin SUB_FUNCTION /end SUB_FUNCTION /end FUNCTION
/begin FUNCTION AADPD "20.11     Adaptive AntriebsDynamik,Variation der dyn. Fahrercharakteristik"
 /begin DEF_CHARACTERISTIC AADPD_CB AADPD_KB AADPD_MA AADPD_MD AADPD_MS AADPD_MT AADPD_ON AADPD_RU AADPD_TB /end DEF_CHARACTERISTIC
 /begin REF_CHARACTERISTIC /end REF_CHARACTERISTIC
 /begin IN_MEASUREMENT ADD_CDS_CAN ADD_Nerv_Detct APP DP_LongDyn EfficDP_HighLim EfficDP_LowLim Eng_Trq Trq_Req vk_mot2 /end IN_MEASUREMENT
 /begin OUT_MEASUREMENT ADD_APPDyn_Mem ADD_APPGrdt ADD_APPGrdt_Filtd ADD_APP_Mem ADD_Dynamic_VariRate APP_ADDDyn /end OUT_MEASUREMENT
 /begin LOC_MEASUREMENT /end LOC_MEASUREMENT
 /begin SUB_FUNCTION /end SUB_FUNCTION
/end FUNCTION
/begin FUNCTION AADPS "20.11     Adaptive AntriebsDynamik,Variation der stat. Fahrercharakteristik"
 /begin DEF_CHARACTERISTIC AADPS_FP AADPS_GM AADPS_GV AADPS_H1 AADPS_H2 AADPS_ON AADPS_VX KLAADO2 KLAADO3 KLAADO4 KLAADPSO KLAADPSU KLAADU2 KLAADU3 KLAADU4 KLAADWAB KLVGK1 KLVGK2 KLVGK3 KLVGK4 KLVGO1 KLVGO2 KLVGO3 KLVGO4 KLVGS1 KLVGS2 KLVGS3 KLVGS4 KLVGU1 KLVGU2 KLVGU3 KLVGU4 /end DEF_CHARACTERISTIC
 /begin REF_CHARACTERISTIC SWPEDV16 VVGAO1 VVGAO2 VVGAO3 VVGAO4 VVGAU1 VVGAU2 VVGAU3 VVGAU4 VWAG04 /end REF_CHARACTERISTIC
 /begin IN_MEASUREMENT AdapAltitudeTempCorr_Coef ADD_APPGrdt ADD_CDS_Req ADD_Nerv_Detct AGKInit_Mode APPotiLin APP_ADDDyn DP_LongDyn DrProgram EfficDP_HighLim EfficDP_LowLim ETCLine_Slct Gear_State sw_ped_r Trans_Man_Cnfg Veh_Spd vk_mot2 vvg_r vwag04_r /end IN_MEASUREMENT
 /begin OUT_MEASUREMENT APP_ADD ETC_EnvCond_VariRate ETC_VariRate ETC_VariRate_Complement ETC_VariRate_Req /end OUT_MEASUREMENT
 /begin LOC_MEASUREMENT /end LOC_MEASUREMENT
 /begin SUB_FUNCTION /end SUB_FUNCTION
/end FUNCTION
/begin FUNCTION ADCIN "" /begin DEF_CHARACTERISTIC /end DEF_CHARACTERISTIC /begin REF_CHARACTERISTIC /end REF_CHARACTERISTIC
 /begin IN_MEASUREMENT B_adcc_um urinlsu2_w urinlsu_w uulsuv2_w uulsuv_w uushk2_w uushk_w /end IN_MEASUREMENT
 /begin OUT_MEASUREMENT DSLF1_w DSLF2_w DSLL_w dsoel_w dst_w HFM_SL_w ls1ik_w LS2IK_w prem_w RES1_w RES2_w RES3_w TAG1_w TAG2_w udkp1v_w udkp1_w udkp2_w udss_w udsu_w ulbkist_w upwg1_w upwg2_w wtans wtka wtmot_w wtsg wub /end OUT_MEASUREMENT
 /begin LOC_MEASUREMENT /end LOC_MEASUREMENT
 /begin SUB_FUNCTION /end SUB_FUNCTION
/end FUNCTION
/begin FUNCTION ADVE "Ansteuerung der DV-E mit dem DLR" /begin DEF_CHARACTERISTIC CWDKNOLU /end DEF_CHARACTERISTIC /begin REF_CHARACTERISTIC DLRHAFTMN DLRININI DLRKREIS /end REF_CHARACTERISTIC
 /begin IN_MEASUREMENT B_dlrbe B_dlrpide B_dveese B_kl15 B_lrnrdy B_st B_wdk1v B_wdksive dklagerc dlrhaftak dlrini_w dlrpidc dveesc nmot /end IN_MEASUREMENT
 /begin OUT_MEASUREMENT B_apnoluv B_appnolu /end OUT_MEASUREMENT
 /begin LOC_MEASUREMENT /end LOC_MEASUREMENT
 /begin SUB_FUNCTION /end SUB_FUNCTION
/end FUNCTION
/begin FUNCTION AEKP "Ausgabe EKP-Ansteuerung"
 /begin DEF_CHARACTERISTIC ANZEKPVLMX PEKP TAPVLTM TNLEKPVL TSTAPVL VKSTPVLAB VKSTPVLNL /end DEF_CHARACTERISTIC
 /begin REF_CHARACTERISTIC /end REF_CHARACTERISTIC
 /begin IN_MEASUREMENT B_abstgp B_estart B_nachlend B_nmot B_stend tabst_w tmotab tnachl_w /end IN_MEASUREMENT
 /begin OUT_MEASUREMENT B_ekp /end OUT_MEASUREMENT
 /begin LOC_MEASUREMENT aekp8bits anzekpvl B_ekpd B_ekps B_ekpvl B_ekpvla B_ekpvlz B_pvlab B_pvlnl vkst_w /end LOC_MEASUREMENT
 /begin SUB_FUNCTION /end SUB_FUNCTION
/end FUNCTION
/begin FUNCTION AEVAB "Ausgabe Einspritzung Ev-Ausblendung" /begin DEF_CHARACTERISTIC CWEVAB REDABM /end DEF_CHARACTERISTIC /begin REF_CHARACTERISTIC /end REF_CHARACTERISTIC
 /begin IN_MEASUREMENT anzeausb B_dkuevab B_faevz B_kas B_phsnl devoff flgtiab redsol zyleausb zzyl /end IN_MEASUREMENT
 /begin OUT_MEASUREMENT abmf B_dmdstop B_nlphea eevx evz_aus fevab stateaevab /end OUT_MEASUREMENT
 /begin LOC_MEASUREMENT anzeab B_fophsnl B_frdph B_nlpheai dmdevab evrbgn_one fevabe fevabkas redsolr redsol_one tvrnr /end LOC_MEASUREMENT
 /begin SUB_FUNCTION /end SUB_FUNCTION
/end FUNCTION
/begin FUNCTION AEVABU "Ausgabe EV-Abschaltung durch ‹berwachungsfunktionen bei EGAS" /begin DEF_CHARACTERISTIC NMXSKA NSKAZO TNLZOFF /end DEF_CHARACTERISTIC /begin REF_CHARACTERISTIC /end REF_CHARACTERISTIC /begin IN_MEASUREMENT B_dknolu B_dkpu B_i_ska_um B_nmaxd nmot /end IN_MEASUREMENT /begin OUT_MEASUREMENT B_dkuevab B_evabu B_nlzoff B_skaevab /end OUT_MEASUREMENT /begin LOC_MEASUREMENT /end LOC_MEASUREMENT /begin SUB_FUNCTION /end SUB_FUNCTION /end FUNCTION
/begin FUNCTION AEVABZK "Ausgabe Ev-Abschaltung %MDRED + Komplettabschaltung durch ‹berwachungsfunktionen" /begin DEF_CHARACTERISTIC /end DEF_CHARACTERISTIC /begin REF_CHARACTERISTIC /end REF_CHARACTERISTIC /begin IN_MEASUREMENT B_dmdstop B_dveada B_evabu B_koevab evz_aus /end IN_MEASUREMENT /begin OUT_MEASUREMENT B_evasel evz_austot /end OUT_MEASUREMENT /begin LOC_MEASUREMENT /end LOC_MEASUREMENT /begin SUB_FUNCTION /end SUB_FUNCTION /end FUNCTION
/begin FUNCTION AGK2ME "Schnittstellenadapter f¸r Grˆﬂen vom AGK zur ME9" /begin DEF_CHARACTERISTIC TVACRES TVGWHS VFZGMIN /end DEF_CHARACTERISTIC /begin REF_CHARACTERISTIC CWMDFILM MDNORM /end REF_CHARACTERISTIC
 /begin IN_MEASUREMENT ACComprOff_FanMalf ACCompr_Run_Mode APEmergSPSMIN_Mode APEmerg_Mode APP APPoti1RefInput_Mode APPoti2RefInput_Mode AP_Grdt_Unfiltd BrkLightSigErr BrkLight_Mode B_nlthm CAN_IgnSwStrtCAN_Mode Clutch_Mode CoolFan_Pwr_Req CrsCtrl_Coor_Trq DashpChrgIntv_Mode Drvr_MaxPwr_Mode ECC_RotVlv_Posn_Req ECU_RunOn_Mode_Req Eng_MinTrqCmb_Req Eng_ResTrq_Req Eng_Trq_Req Gear_State HtrPmp_Flow_Req HtrVlv1_Pos_Req HtrVlv2_Pos_Req HtrVlv_Mode_Req Idle_Mode_Req LTC_Mode mdverf_w mdverl_w miistoal_w miistoa_w mimax_w PNTgtGear_Mode Shuttr_Pos_Req SteeringAngle SteeringAngleDir SteeringAngleOverLim Trans_Man_Cnfg TrqCoor_ESP_Mode TrqCoor_Info TrqSetIgn_Mode_Req TrqSetInjSO_Mode_Req TrqSetRes_Mode_Req Veh_speed z_dfv z_pblserr /end IN_MEASUREMENT
 /begin OUT_MEASUREMENT aqelhp B_acmlf B_acres B_asr B_autget B_brems B_dash B_dashv B_espanf B_estart B_fs B_gwhs B_hg B_hklvent B_hklvent1 B_hklvent2 B_koe B_kuppl B_kupplv B_ll B_lsd B_mdeeagk B_mdeinext B_mdresagk B_msr B_plw B_pwgnotfr B_savmd B_sgs B_sp1s B_sp2s B_spsmin B_vl B_vnull B_zwfgagk dwped dwped_w ei_egs_fr e_vsig_up gangi lws_w miagkres_w miagk_w miautget_w mifa mifaagk_w mifab_w mifal_w mifa_w miistoar_w miminagk_w mivbeb_w mivbeg_w mrfa_w tajal taml tatherm vfzg vfzg_w wped wped_w /end OUT_MEASUREMENT
 /begin LOC_MEASUREMENT ACCompr_Run_Mode_Old B_maxdu B_mindu B_trqcoor_bit4 B_trqcoor_bit5 count_b_acres count_b_gwhs /end LOC_MEASUREMENT
 /begin SUB_FUNCTION /end SUB_FUNCTION
/end FUNCTION
/begin FUNCTION ALBK "Ansteuerung Ladungsbewegungsklappe"
 /begin DEF_CHARACTERISTIC CWALBK CWLBKNOL DWLBKIRES DWLBKLRMX DWLBKSBAMX KLLBKRDANT KLLBKRIANT KLLBKRPANT LBKASBSTG LBKLAGERT LBKLIAMAXA LBKLKREIS LBKLKREISS LBKLPID0T LBKLPID1T LBKLPID2T LBKLPIDMAX LBKLUBSOLL MLBKREIBK SDW21LBSW TALBKFOFF TALBKFSTG TLBKLAGDE TLBKLUB TLBKPWRSV TLBKSASB TLBKSPT1 WLBKSAPNOL /end DEF_CHARACTERISTIC
 /begin REF_CHARACTERISTIC ULBKNLPMAX /end REF_CHARACTERISTIC
 /begin IN_MEASUREMENT B_kl15 B_lbkaden B_lbkeson B_lbklernb B_lbknlpca B_lbknol B_lbkpe B_nmot B_st lbkistu_w lbksol_w nmot ubsq ulbkist_w wlbkada_w wped /end IN_MEASUREMENT
 /begin OUT_MEASUREMENT B_lbkapnlv B_lbkappnl B_lbkdisfr B_lbklpide B_lbknlpne B_lbkpwrsv B_lbkub B_lbkwsive B_talbk esst_sdw21lbsw lbklagec_w talbks_w talbk_w wlbkdlr_w /end OUT_MEASUREMENT
 /begin LOC_MEASUREMENT B_lbkese B_lbklbe B_lbklparc B_lbknl B_lbkte dwlbkl_w lbkfkomp_w lbkgwl_w lbkld lbkli lbklkomp_w lbklp lbklpidc_w lbkpwrsc_w lbkrkomp_w lbksasb_w wlbkdlra_w wlbksfi_w /end LOC_MEASUREMENT
 /begin SUB_FUNCTION /end SUB_FUNCTION
/end FUNCTION
/begin FUNCTION ALE "ALE.exportedAuslauferkennung"
 /begin DEF_CHARACTERISTIC AWALEMX GAP_TOOTH KLALETM NALEMIN RALEMAX RDUNDEF W360_ALE_IMPL W720_ALE_IMPL /end DEF_CHARACTERISTIC
 /begin REF_CHARACTERISTIC CWALE /end REF_CHARACTERISTIC
 /begin IN_MEASUREMENT B_bm B_nlale B_nldg B_nmot B_phsnlinv B_pwf B_stend B_zprel nmot_w tmot /end IN_MEASUREMENT
 /begin OUT_MEASUREMENT ALEBits1_10msSwOff ALEBits_10msSwOff ALEBits_tooth_int B_ale B_aleundef wkwstop_w /end OUT_MEASUREMENT
 /begin LOC_MEASUREMENT B_alechk B_enabale B_enabint B_engstop B_ralectr B_raleok B_rrdet B_strtint B_strtswof B_undef CO_GAP CO_WAS CO_WNBM ottstamp_l temp_klt_l temp_tn1_l temp_tn2_l temp_tn_l temp_w1 temp_w2 temp_w3 temp_w4 tooth10ms toothtim_l ttstamp_l ttstmpmx_l wkwalerr_w wkwale_w wkwalkor_w wkwalold_w wkwaskor_w wkwrale_w /end LOC_MEASUREMENT
 /begin SUB_FUNCTION /end SUB_FUNCTION
/end FUNCTION
/begin FUNCTION ALSU "Ausgabefunktion LSU" /begin DEF_CHARACTERISTIC TPHRLSU /end DEF_CHARACTERISTIC /begin REF_CHARACTERISTIC UBHS /end REF_CHARACTERISTIC
 /begin IN_MEASUREMENT B_eiclsu B_eiclsu2 B_elsuwi B_elsuwi2 B_nmot prhrlsu2_w prhrlsu_w ub /end IN_MEASUREMENT
 /begin OUT_MEASUREMENT ALSUausbits1 B_hlsumx B_hlsumx2 B_hrlsaus tahrlsu2_w tahrlsu_w tphrlsu_w /end OUT_MEASUREMENT
 /begin LOC_MEASUREMENT fubkor_w /end LOC_MEASUREMENT
 /begin SUB_FUNCTION /end SUB_FUNCTION
/end FUNCTION
/begin FUNCTION APPLW1 "1.11" /begin DEF_CHARACTERISTIC /end DEF_CHARACTERISTIC /begin REF_CHARACTERISTIC /end REF_CHARACTERISTIC
 /begin IN_MEASUREMENT ACCompr_Run_Mode B_ap_aktiv B_dc_sls B_sbbvk B_sbbvk2 B_te B_vllr CatHead_Mode Drvr_MaxPwr_Mode evz_aus fns_w fwl Idle_Mode_Req PNTgtGear_Mode SteeringAngleOverLim usrj uulsuv2_w uulsuv_w /end IN_MEASUREMENT
 /begin OUT_MEASUREMENT applw1 /end OUT_MEASUREMENT
 /begin LOC_MEASUREMENT /end LOC_MEASUREMENT
 /begin SUB_FUNCTION /end SUB_FUNCTION
/end FUNCTION
/begin FUNCTION ARMD "Momentenbasierte Antiruckelfunktion"
 /begin DEF_CHARACTERISTIC A0 A1 A2 B1 B2 CWARMD DMARMX DNFILO DVFZAR FKFDARTM FLRAWG FLRFDAR FLRFLRAR FLRHG FLRKIFZ FRARAWGS FRARHGS KFDMDADP KFDMDARO KFDMDAROS KFFGDMAR KFFRARAW KFFRARHG KIFZGAWG KIFZGHG NARASTGU NARLLGA NARLLMXG NARMXG NDFILOG NDIFFOG SMK08MDSW TAREIN TMAR TMLAST TVARS TVARSA TVARSS TVKUPGW TVKUPHS TVKUPRS TZSPINI VARAU /end DEF_CHARACTERISTIC
 /begin REF_CHARACTERISTIC SGA06MDUB /end REF_CHARACTERISTIC
 /begin IN_MEASUREMENT B_autget B_brems B_dashv B_fgr B_gsch B_gwhs B_kuppl B_ll B_lowra B_lsd B_mdein B_sa B_stend B_wk esst_sga06mdub gangi mdverl_w mifa_w misolv_w mkfanb_w nmot nmot_w rl tmot vfzg vfzg_w /end IN_MEASUREMENT
 /begin OUT_MEASUREMENT B_ar dmar_w esst_smk08mdsw tmlastz tnmst1z tnmst2z /end OUT_MEASUREMENT
 /begin LOC_MEASUREMENT B_hpnmot B_iniar B_iniarv B_kupgw B_tpnmot B_tvars B_tvarsa B_tvarss B_wksch fdar fdars flrar kifz_w mdbes_w mkar_w mlast_w ndar_w ndfibet_w ndfil_w ndiffog_w ndiff_w nmod_w tzarni /end LOC_MEASUREMENT
 /begin SUB_FUNCTION /end SUB_FUNCTION
/end FUNCTION
/begin FUNCTION ATEV "Ansteuerung Tankentl¸ftungsventil (Periodendauer)" /begin DEF_CHARACTERISTIC KFTEVP KFTVTEV TATEGMX TATEMSN TVTEVPS /end DEF_CHARACTERISTIC /begin REF_CHARACTERISTIC /end REF_CHARACTERISTIC
 /begin IN_MEASUREMENT B_dtes B_tevtini msntevo_w msteo_w mstesoll_w nmot pspu tadtea tans ub /end IN_MEASUREMENT
 /begin OUT_MEASUREMENT tateist tateist_w tateout tateout_w tatesoll_w tevper /end OUT_MEASUREMENT
 /begin LOC_MEASUREMENT msntev_w tateroh tateroh_w tatesold_w tvtevptu /end LOC_MEASUREMENT
 /begin SUB_FUNCTION /end SUB_FUNCTION
/end FUNCTION
/begin FUNCTION ATM "Abgastemperaturmodell"
 /begin DEF_CHARACTERISTIC ATMTANS DTUMTAT FATMRML FATMRML2 FWMABGW FWMABGW2 FWMKATW FWMKATW2 IMTUMTAT KATMEXML KATMEXML2 KATMIEXML KATMIEXML2 KFATMABKA KFATMABKA2 KFATMABKK KFATMABKK2 KFATMLA KFATMLA2 KFATMZW KFATMZW2 KFTATM KFTATM2 KFWMABG KFWMABG2 KFWMKAT KFWMKAT2 KLATMILAE KLATMILAE2 KLATMIZWE KLATMIZWE2 KLATMLAE KLATMLAE2 KLATMZWE KLATMZWE2 NTUMTAT STS06TMUW STU05TMUB TABGMEX TASTBFA TATMKH TATMKH2 TATMKW TATMSA TATMSAE TATMSAE2 TATMSTI TATMTMOT TATMTP TATMTRKH TATMTRKH2 TATMWMK TIKATMOE TKATMOE TKSTBFA TNLATM TNLATMTM TNLATMTU TUMTAIT VTUMTAT WMABGKH WMABGKH2 WMKATKH WMKATKH2 ZATMAML ZATMAML2 ZATMIKML ZATMIKML2 ZATMKML ZATMKML2 ZATMRML ZATMRML2 /end DEF_CHARACTERISTIC
 /begin REF_CHARACTERISTIC SEZ06TMUB SLX06TMUW SLY06TMUW SML06TMUW SML07TMUW ST107TMUB ST207TMUB ST307TMUB ST407TMUB STM05TMUB /end REF_CHARACTERISTIC
 /begin IN_MEASUREMENT B_faatm B_kh B_kw B_nachlend B_nlatm B_nmot B_pwf B_sa B_st B_stend B_trkh B_uhrrmin B_uhrrsec esst_sez06tmub esst_slx06tmuw esst_sly06tmuw esst_sml06tmuw esst_sml07tmuw esst_st107tmub esst_st207tmub esst_st307tmub esst_st407tmub esst_stm05tmub etazwist lamsbg2_w lamsbg_w ml ml_w nmot rl tabst_w tans tmot tmst vfzg /end IN_MEASUREMENT
 /begin OUT_MEASUREMENT ATMbits B_atmtpa B_atmtpa2 B_atmtpf B_atmtpf2 B_atmtpk B_atmtpk2 B_atmtpl B_atmtpl2 esst_sts06tmuw esst_stu05tmub etazwimt imlatm imlatm_w iwmatm2_w iwmatm_w tabgm tabgm2 tabgm2_w tabgmab tabgmab2 tabgmst tabgmst2 tabgm_w tatu tikatm tikatm2 tikatm2_w tikatm_w tkatm tkatm2 tkatm2_w tkatmab tkatmab2 tkatmst tkatmst2 tkatm_w zwmatm zwmatm2 zwmatmf zwmatmf2 /end OUT_MEASUREMENT
 /begin LOC_MEASUREMENT ATMbits1 B_atmst B_atmst2 B_stndnl tabstatm_w tabstmx_w tatmaml tatmaml2 tatmkf tatmkf2 tatmrml tatmrml2 tatmsta tatmsta2 texkor texkor2 texml texml2 texoikm2_w texoikm_w texom2_w texom_w tiexkor tiexkor2 tiexml tiexml2 /end LOC_MEASUREMENT
 /begin SUB_FUNCTION /end SUB_FUNCTION
/end FUNCTION
/begin FUNCTION AUFS2 "20.11     Funktion f¸r die Ergebnisgrˆﬂen der St¸tzstellensuche"
 /begin DEF_CHARACTERISTIC AdapAltitudeTempCorrV8 AV08 CVTRATIO EBG_RP_SST ECC_sstRotVlv_PReqV08 IntkAir_TempV8 LK2_AX MIST16 MV_DP MV_LSD NG08 NGWF08 NISTV08 NISTV17 NIST_LSD NVERH NVERHSP PWV SST_PWR_VG16 sst_TM_CAF_CT_AC_MAF_Req sst_TM_CAF_CT_CoolFanSpd_Req sst_TM_CAF_CT_ECU_Temp sst_TM_CAF_CT_EngLoad sst_TM_CAF_CT_ETC sst_TM_CAF_CT_ETC_C_Setpoint sst_TM_CAF_CT_ExtAir_Temp sst_TM_CAF_CT_IntkAir_Temp sst_TM_CAF_CT_MAF sst_TM_CAF_CT_Sen_Oil_Temp sst_TM_CoolFan_MAF_Req sst_TM_Cyl_FIRate SWPEDV16 TL8V08 TM_ECF_sstVolFlowV08 TM_ECP_sstECTOutV08 TM_ECP_sstVolFlowV08 TM_EM_DEM_sst_ECTOutV08 TM_sstDissHeatFlowClV08 TM_sstDissHeatFlowFanV08 TM_sstExtAirTV08 TM_TMP_SP_sstExAiTV08 VCANV05 VCANV16 VVGAO1 VVGAO2 VVGAO3 VVGAO4 VVGAU1 VVGAU2 VVGAU3 VVGAU4 VWAG04 /end DEF_CHARACTERISTIC
 /begin REF_CHARACTERISTIC /end REF_CHARACTERISTIC
 /begin IN_MEASUREMENT AC_MAF_Req AdapAltitudeTempCorr_Coef APP_ADD APP_Char CoolFan_MAF_Req DMTD_TrvrAccelMax_LongAccel ECC_sstRotVlv_Preq ECF_VolFlow ECTOut Eng_RelLoad Eng_Spd Eng_Trq ETC_VariRate ExtAir_Temp IntkAir_Temp LongAccel MAF mist_roh ng_nhgb nrmverh Sen_Oil_Temp sst_EngLoad TCM_Actl_Ratio TM_CAF_CT_AC_MAF_Req TM_CAF_CT_CoolFanSpd_Req TM_CAF_CT_ECU_Temp TM_CAF_CT_EngLoad_sstIn TM_CAF_CT_ETC TM_CAF_CT_ETC_C_Setpoint TM_CAF_CT_ETC_C_Setp_In TM_CAF_CT_ETC_sstIn TM_CAF_CT_ExtAir_Temp TM_CAF_CT_ExtAir_Temp_S TM_CAF_CT_IntkAir_Temp TM_CAF_CT_MAF TM_CAF_CT_Sen_Oil_Temp TM_CoolFanSpd_Req TM_CoolFan_MAF_Req TM_Cyl_FIRate TM_Cyl_FIRate_sstIn TM_DissHeatFlowCl TM_DissHeatFlowFan TM_ECF_sstVolFlow TM_ECP_sstECTOut TM_ECP_sstVolFlow TM_ECP_VolFlow TM_ECP_VolFlowLCir TM_ECU_Temp TM_EM_DEM_sst_ECTOut TM_sstDissHeatFlowCl TM_sstDissHeatFlowFan TM_sstExtAirT TM_TMP_SP_sstExAiT TransGuard_Cntr TrqIndDashpLTC_Req Veh_Spd /end IN_MEASUREMENT
 /begin OUT_MEASUREMENT av08_r cvtratio_r ebg_rp_r fmiv08_r mist16_r mv_dp_r mv_lsd_r ng08_r ngwf08_r nist_1uf_r nist_lsd_r nst08 nverh_r pw12r_r sst_ax_ay sst_ia_t sst_pwr_vg16_r sw_ped_r tlst08 vcanv05_r vcanv16_r vvg_r vwag04_r /end OUT_MEASUREMENT
 /begin LOC_MEASUREMENT /end LOC_MEASUREMENT
 /begin SUB_FUNCTION /end SUB_FUNCTION
/end FUNCTION
/begin FUNCTION BBACC "BBACC.    Ein.- und Ausschaltbedingungen ACC (Adaptiv Cruise Control)" /begin DEF_CHARACTERISTIC /end DEF_CHARACTERISTIC /begin REF_CHARACTERISTIC /end REF_CHARACTERISTIC
 /begin IN_MEASUREMENT B_fgrai B_fgral B_fgras B_fgren B_fgrkf B_fgrtbe B_fgrtve B_tpdn B_tpup B_wiauf /end IN_MEASUREMENT
 /begin OUT_MEASUREMENT B_mflai B_mflal B_mflar B_mflas B_mflen fgr_stat /end OUT_MEASUREMENT
 /begin LOC_MEASUREMENT /end LOC_MEASUREMENT
 /begin SUB_FUNCTION /end SUB_FUNCTION
/end FUNCTION
/begin FUNCTION BBBO "Betriebsbereich Erkennung Benzin im ÷l"
 /begin DEF_CHARACTERISTIC ABOINI ABOLRAR ABOMX CDPCV IMLKS MSNPCV TMSKS TMSTABO TMTKS TVREABO USVKKS /end DEF_CHARACTERISTIC
 /begin REF_CHARACTERISTIC /end REF_CHARACTERISTIC
 /begin IN_MEASUREMENT B_nmot B_pwf B_sa B_sbbvk B_sbbvk2 ftho_w ml_w ps_w pu_w tmot tmst usvkk2_w usvkk_w /end IN_MEASUREMENT
 /begin OUT_MEASUREMENT abo B_abor imlbbo /end OUT_MEASUREMENT
 /begin LOC_MEASUREMENT dpspu mspcv /end LOC_MEASUREMENT
 /begin SUB_FUNCTION /end SUB_FUNCTION
/end FUNCTION
/begin FUNCTION BBDNWS "Betriebsbereitschaft Diagnose Nockenwelle"
 /begin DEF_CHARACTERISTIC NDNWMN NDNWMNFA NDNWMX TMDNWMN TMDNWMX TNWDSTEND TOELDNWMN TOELDNWMX /end DEF_CHARACTERISTIC
 /begin REF_CHARACTERISTIC /end REF_CHARACTERISTIC
 /begin IN_MEASUREMENT B_dnwfozea B_dnwfozee B_fanwsa B_fanwsaa B_fanwse B_fanwsea B_nwrposa B_nwrpose B_nws B_phada B_phade B_stend nmot tmot toelk_w /end IN_MEASUREMENT
 /begin OUT_MEASUREMENT bbdnwsAusBits bbdnwsLokBits B_dnws B_dnwsa B_dnwsa2 B_dnwse B_dnwse2 /end OUT_MEASUREMENT
 /begin LOC_MEASUREMENT B_dnwsfa B_nmotnwdf B_tmotnwdf B_tolnwdf /end LOC_MEASUREMENT
 /begin SUB_FUNCTION /end SUB_FUNCTION
/end FUNCTION
/begin FUNCTION BBDSLS "Betriebsbedingungen f¸r Sekund‰rluftdiagnose"
 /begin DEF_CHARACTERISTIC DRLASMES DSLVFZMN DTMDSLA FMSLMESS FMSLOFFS HYDFRMOF IMLATDSL IMLATDSLK MLDSLKMN MLDSLKMX MLDSLMN MLDSLMX MLDSLODMN MLDSLODMX MLDSLOFSMN MLDSLOFSMX MXSLPODSLS TDDSLSFG TDDSLSLL TDSLMDRL TMESSMN TMESSMNK TNSTDSL TOFFSMN TOFFSMNK TOFFSMX TVENTMN TVENTMNK TVENTMX /end DEF_CHARACTERISTIC
 /begin REF_CHARACTERISTIC /end REF_CHARACTERISTIC
 /begin IN_MEASUREMENT anfsls anzslp anzslpkh B_aflldsls B_aktdsls B_bag B_cdsls B_dfrmr B_dfrmr2 B_edkvs B_edkvs2 B_evloc B_fganfdsl B_fganfsls B_ll B_lrs B_mdarv B_msllamrg B_msllavr B_msllavr2 B_mslmn B_nmot B_prventil B_sbblsu B_sbblsu2 B_slp B_slpbb B_sls B_slskh B_spodslg B_szsls B_szslv B_te B_vag dfrmfof2_w dfrmfof_w dfrmofn_w dfrmofp_w drlas_w fmsldyn imlatm_w ml_w tmotab tmst tnse_w vfzg /end IN_MEASUREMENT
 /begin OUT_MEASUREMENT bbdslsAusBits1 bbdslsAusBits2 bbdslsAusBits3 B_anfdslp B_anfdslv B_anstslp B_dsl B_dsla B_dslerr B_dslmes B_dsls B_meaoper B_phaseab B_phend B_phmess B_phmessab B_phmessmf B_phoffs B_phoffsab B_phoffsmf B_phofsend B_phofsrdy B_phstart B_phvent B_phventab B_phventmf B_rsdsls phasedsls /end OUT_MEASUREMENT
 /begin LOC_MEASUREMENT bbdslsLokBits1 bbdslsLokBits2 B_bbodsls B_dfrmrg B_dslsfg B_fgdslsll B_fgprvent B_msllavrg B_phmesend B_phmesrdy B_phofsmx B_phventmx B_phventry B_phvntend B_slpoffms B_slponfz tmessmf toffsmf tventmf /end LOC_MEASUREMENT
 /begin SUB_FUNCTION /end SUB_FUNCTION
/end FUNCTION
/begin COMPU_METHOD B_TRUE "boolsche Zust‰nde, positive Logik" TAB_VERB "%6.3" "" COMPU_TAB_REF B_TRUE /end COMPU_METHOD
/begin COMPU_VTAB B_TRUE "boolsche Zust‰nde, positive Logik" TAB_VERB 2 0 "----" 1 "TRUE" /end COMPU_VTAB
/begin COMPU_METHOD DC_AP_GRDT_S16 "" RAT_FUNC "%6.2" "%/s" COEFFS 0 1 0 0 0 1 /end COMPU_METHOD
/begin COMPU_METHOD DC_CNTR_U16 "" RAT_FUNC "%6.2" "" COEFFS 0 1 0 0 0 1 /end COMPU_METHOD
/begin COMPU_METHOD DC_CNTR_U8 "" RAT_FUNC "%6.2" "" COEFFS 0 1 0 0 0 1 /end COMPU_METHOD
/begin COMPU_METHOD DC_DEZ "" RAT_FUNC "%6.2" "" COEFFS 0 1 0 0 0 1 /end COMPU_METHOD
/begin COMPU_METHOD DC_DEZL "" RAT_FUNC "%6.2" "" COEFFS 0 1 0 0 0 1 /end COMPU_METHOD
/begin COMPU_METHOD DC_FCTR_32768_U16 "" RAT_FUNC "%8.7" "" COEFFS 0 32768 0 0 0 1 /end COMPU_METHOD
/begin COMPU_METHOD DC_FCTR_50_U8 "" RAT_FUNC "%8.5" "keine" COEFFS 0 50 0 0 0 1 /end COMPU_METHOD
/begin COMPU_METHOD DC_FKT128 "" RAT_FUNC "%6.4" "Faktor" COEFFS 0 128 0 0 0 1 /end COMPU_METHOD
/begin COMPU_METHOD DC_FKT255 "" RAT_FUNC "%7.5" "Faktor" COEFFS 0 255 0 0 0 1 /end COMPU_METHOD
/begin COMPU_METHOD DC_FKT32768 "" RAT_FUNC "%7.6" "Faktor" COEFFS 0 32768 0 0 0 1 /end COMPU_METHOD
/begin COMPU_METHOD DC_FLAG_U8 "" RAT_FUNC "%6.2" "" COEFFS 0 1 0 0 0 1 /end COMPU_METHOD
/begin COMPU_METHOD DC_FLOW_U16 "" RAT_FUNC "%6.2" "kg/h" COEFFS 0 1 0 0 0 1 /end COMPU_METHOD
/begin COMPU_METHOD DC_NGRDQ10_S16DB "" RAT_FUNC "%6.1" "U/min/s" COEFFS 0 1 0 0 0 10 /end COMPU_METHOD
/begin COMPU_METHOD DC_PCT_S16 "" RAT_FUNC "%8.5" "%" COEFFS 0 327.67 0 0 0 1 /end COMPU_METHOD
/begin COMPU_METHOD DC_PER0327 "" RAT_FUNC "%6.4" "%" COEFFS 0 327.67 0 0 0 1 /end COMPU_METHOD
/begin COMPU_METHOD DC_PWR_S16 "" RAT_FUNC "%9.4" "kw" COEFFS 0 8 0 0 0 1 /end COMPU_METHOD
/begin COMPU_METHOD DC_ROTSPD_S16 "" RAT_FUNC "%7.3" "1/min" COEFFS 0 2 0 0 0 1 /end COMPU_METHOD
/begin COMPU_METHOD DC_SD1_U8MB "" RAT_FUNC "%4.1" "%" COEFFS 0 1 0 0 0 1 /end COMPU_METHOD
/begin COMPU_METHOD DC_SEARCH "" RAT_FUNC "%6.2" "" COEFFS 0 1 0 0 0 1 /end COMPU_METHOD
/begin COMPU_METHOD DC_TEMP_S16 "" RAT_FUNC "%8.4" "Grad C" COEFFS 0 8 0 0 0 1 /end COMPU_METHOD
/begin COMPU_METHOD DC_TRQ_S16 "" RAT_FUNC "%8.5" "Nm" COEFFS 0 16 0 0 0 1 /end COMPU_METHOD
/begin COMPU_METHOD DC_UAFZ_S8 "" RAT_FUNC "%6.4" "m/(s*s)" COEFFS 0 1 0 0 0 0.0434 /end COMPU_METHOD
/begin COMPU_METHOD DC_UTMP_40 "" RAT_FUNC "%6.2" "grd C" COEFFS 0 1 40 0 0 1 /end COMPU_METHOD
/begin COMPU_METHOD DC_VEHSPD_KMH_U16 "" RAT_FUNC "%8.5" "km/h" COEFFS 0 16 0 0 0 1 /end COMPU_METHOD
/begin COMPU_METHOD dez "1 : 1 Umrechnug (dez/hex)" RAT_FUNC "%6.2" "" COEFFS 0 1 0 0 0 1 /end COMPU_METHOD
/begin COMPU_METHOD fak_q0p0078 "" RAT_FUNC "%6.4" "-" COEFFS 0 128 0 0 0 1 /end COMPU_METHOD
/begin COMPU_METHOD fak_sw_b0p0625 "" RAT_FUNC "%8.7" "-" COEFFS 0 65536 0 0 0 0.125 /end COMPU_METHOD
/begin COMPU_METHOD fak_sw_b1 "" RAT_FUNC "%7.6" "-" COEFFS 0 65536 0 0 0 2 /end COMPU_METHOD
/begin COMPU_METHOD fak_sw_b2 "" RAT_FUNC "%7.6" "-" COEFFS 0 65536 0 0 0 4 /end COMPU_METHOD
/begin COMPU_METHOD fak_ub_b1 "" RAT_FUNC "%6.4" "-" COEFFS 0 256 0 0 0 1 /end COMPU_METHOD
/begin COMPU_METHOD fak_ub_b16 "" RAT_FUNC "%6.4" "-" COEFFS 0 256 0 0 0 16 /end COMPU_METHOD
/begin COMPU_METHOD fak_ub_b2 "" RAT_FUNC "%6.4" "-" COEFFS 0 256 0 0 0 2 /end COMPU_METHOD
/begin COMPU_METHOD fak_ub_b318p75 "" RAT_FUNC "%6.2" "-" COEFFS 0 256 0 0 0 318.75 /end COMPU_METHOD
/begin COMPU_METHOD fak_ub_b3p125 "" RAT_FUNC "%6.4" "%/1/min" COEFFS 0 2048 0 0 0 25 /end COMPU_METHOD
/begin COMPU_METHOD fak_ub_b4 "" RAT_FUNC "%6.4" "-" COEFFS 0 256 0 0 0 4 /end COMPU_METHOD
/begin COMPU_METHOD fak_uw_b16 "" RAT_FUNC "%6.5" "-" COEFFS 0 65536 0 0 0 16 /end COMPU_METHOD
/begin COMPU_METHOD fak_uw_b2 "" RAT_FUNC "%7.6" "-" COEFFS 0 65536 0 0 0 2 /end COMPU_METHOD
/begin COMPU_METHOD fak_uw_b4 "" RAT_FUNC "%7.6" "-" COEFFS 0 65536 0 0 0 4 /end COMPU_METHOD
/begin COMPU_METHOD fak_uw_b4864 "" RAT_FUNC "%6.4" "-" COEFFS 0 65536 0 0 0 4864 /end COMPU_METHOD
/begin COMPU_METHOD kw_q0p1 "" RAT_FUNC "%6.3" "Grad KW" COEFFS 0 10 0 0 0 1 /end COMPU_METHOD
/begin COMPU_METHOD lw_sw_q0p04375 "" RAT_FUNC "%6.4" "∞" COEFFS 0 32767 0 0 0 1434 /end COMPU_METHOD
/begin COMPU_METHOD md_sw_q0p0625 "" RAT_FUNC "%6.4" "Nm" COEFFS 0 16 0 0 0 1 /end COMPU_METHOD
/begin COMPU_METHOD m_q0p1 "" RAT_FUNC "%6.3" "kg/h" COEFFS 0 10 0 0 0 1 /end COMPU_METHOD
/begin COMPU_METHOD m_ub_b23p3 "" RAT_FUNC "%6.3" "kg" COEFFS 0 2812.5 0 0 0 256 /end COMPU_METHOD
/begin COMPU_METHOD m_ub_q1p0 "" RAT_FUNC "%6.2" "kg/h" COEFFS 0 1 0 0 0 1 /end COMPU_METHOD
/begin COMPU_METHOD m_uw_b23p3 "" RAT_FUNC "%6.5" "kg" COEFFS 0 2812.5 0 0 0 1 /end COMPU_METHOD
/begin COMPU_METHOD m_uw_b25p6 "" RAT_FUNC "%6.5" "kg/h" COEFFS 0 65536 0 0 0 25.6 /end COMPU_METHOD
/begin COMPU_METHOD m_uw_b6553p5 "" RAT_FUNC "%6.3" "kg/h" COEFFS 0 1 0 0 0 0.1 /end COMPU_METHOD
/begin COMPU_METHOD nmot_sw_q0p25 "" RAT_FUNC "%6.3" "1/min" COEFFS 0 1 0 0 0 0.25 /end COMPU_METHOD
/begin COMPU_METHOD nmot_ub_q40 "" RAT_FUNC "%6.1" "1/min" COEFFS 0 1 0 0 0 40 /end COMPU_METHOD
/begin COMPU_METHOD nmot_uw_q0p25 "" RAT_FUNC "%6.3" "1/min" COEFFS 0 1 0 0 0 0.25 /end COMPU_METHOD
/begin COMPU_METHOD p_ub_q10 "" RAT_FUNC "%6.1" "hPa" COEFFS 0 1 0 0 0 10 /end COMPU_METHOD
/begin COMPU_METHOD q_q0p4551 "" RAT_FUNC "%6.3" "kJ" COEFFS 0 36000 0 0 0 16384 /end COMPU_METHOD
/begin COMPU_METHOD relNWU_q0p0234 "" RAT_FUNC "%6.4" "%/NWU" COEFFS 0 32 0 0 0 0.75 /end COMPU_METHOD
/begin COMPU_METHOD relPED_ub_b100 "" RAT_FUNC "%6.3" "%PED" COEFFS 0 255 0 0 0 100 /end COMPU_METHOD
/begin COMPU_METHOD relPED_uw_b100 "" RAT_FUNC "%6.4" "%PED" COEFFS 0 65535 0 0 0 100 /end COMPU_METHOD
/begin COMPU_METHOD rel_sb_q0p39 "" RAT_FUNC "%6.3" "%" COEFFS 0 1 0 0 0 0.3906 /end COMPU_METHOD
/begin COMPU_METHOD rel_sw_b100 "" RAT_FUNC "%6.4" "%" COEFFS 0 32768 0 0 0 100 /end COMPU_METHOD
/begin COMPU_METHOD rel_sw_b1600 "" RAT_FUNC "%6.4" "%" COEFFS 0 65536 0 0 0 3200 /end COMPU_METHOD
/begin COMPU_METHOD rel_sw_b50 "" RAT_FUNC "%6.4" "%" COEFFS 0 65536 0 0 0 100 /end COMPU_METHOD
/begin COMPU_METHOD rel_sw_q0p02441 "" RAT_FUNC "%6.4" "%" COEFFS 0 65536 0 0 0 1600 /end COMPU_METHOD
/begin COMPU_METHOD rel_sw_q1p562Em2 "" RAT_FUNC "%6.4" "%" COEFFS 0 64 0 0 0 1 /end COMPU_METHOD
/begin COMPU_METHOD rel_ub_b127p5 "" RAT_FUNC "%6.3" "%" COEFFS 0 2 0 0 0 1 /end COMPU_METHOD
/begin COMPU_METHOD rel_ub_b99p6 "" RAT_FUNC "%6.3" "%" COEFFS 0 256 0 0 0 100 /end COMPU_METHOD
/begin COMPU_METHOD rel_ub_q0p75 "" RAT_FUNC "%6.3" "%" COEFFS 0 1 0 0 0 0.75 /end COMPU_METHOD
/begin COMPU_METHOD rel_uw_b100 "" RAT_FUNC "%6.4" "%" COEFFS 0 65536 0 0 0 100 /end COMPU_METHOD
/begin COMPU_METHOD rel_uw_b200 "" RAT_FUNC "%6.4" "%" COEFFS 0 65536 0 0 0 200 /end COMPU_METHOD
/begin COMPU_METHOD rel_uw_q0p03125 "" RAT_FUNC "%6.4" "Grad" COEFFS 0 65536 0 0 0 2048 /end COMPU_METHOD
/begin COMPU_METHOD spg_q0p00488 "" RAT_FUNC "%6.4" "V" COEFFS 0 1024 0 0 0 5 /end COMPU_METHOD
/begin COMPU_METHOD spg_q0p1 "" RAT_FUNC "%6.3" "V" COEFFS 0 1 0 0 0 0.1 /end COMPU_METHOD
/begin COMPU_METHOD spg_ubatt "" RAT_FUNC "%6.3" "V" COEFFS 0 1 0 0 0 0.0942 /end COMPU_METHOD
/begin COMPU_METHOD spg_ub_b5 "" RAT_FUNC "%6.4" "V" COEFFS 0 256 0 0 0 5 /end COMPU_METHOD
/begin COMPU_METHOD spg_uw_q0p001222 "" RAT_FUNC "%6.4" "V" COEFFS 0 1 0 0 0 0.001222 /end COMPU_METHOD
/begin COMPU_METHOD spg_uw_q0p00488 "" RAT_FUNC "%6.4" "V" COEFFS 0 1024 0 0 0 5 /end COMPU_METHOD
/begin COMPU_METHOD t100msxs_q16Em6 "" RAT_FUNC "%7.6" "s" COEFFS 0 1 0 0 0 1.6e-005 /end COMPU_METHOD
/begin COMPU_METHOD t100msxs_ub_b25p5 "" RAT_FUNC "%6.3" "s" COEFFS 0 1 0 0 0 0.1 /end COMPU_METHOD
/begin COMPU_METHOD t100msxs_uw_b6553p5 "" RAT_FUNC "%6.3" "s" COEFFS 0 1 0 0 0 0.1 /end COMPU_METHOD
/begin COMPU_METHOD t100msxs_uw_b6553p6 "" RAT_FUNC "%6.3" "s" COEFFS 0 10 0 0 0 1 /end COMPU_METHOD
/begin COMPU_METHOD t10msxs_ub_b2p55 "" RAT_FUNC "%6.4" "s" COEFFS 0 1 0 0 0 0.01 /end COMPU_METHOD
/begin COMPU_METHOD t1ms_ub_b255 "" RAT_FUNC "%7.3" "ms" COEFFS 0 1 0 0 0 1 /end COMPU_METHOD
/begin COMPU_METHOD t1sxs_uw_q1 "" RAT_FUNC "%6.2" "s" COEFFS 0 1 0 0 0 1 /end COMPU_METHOD
/begin COMPU_METHOD t500usxms_ub_q0p5 "" RAT_FUNC "%6.3" "ms" COEFFS 0 1 0 0 0 0.5 /end COMPU_METHOD
/begin COMPU_METHOD temp_q0p0195 "" RAT_FUNC "%6.4" "Grad C" COEFFS 0 256 0 0 0 5 /end COMPU_METHOD
/begin COMPU_METHOD temp_q0p0234_o273 "" RAT_FUNC "%6.1" "Grad C" COEFFS 0 1 273.15 0 0 0.0234375 /end COMPU_METHOD
/begin COMPU_METHOD temp_q5 "" RAT_FUNC "%6.2" "Grad C" COEFFS 0 1 0 0 0 5 /end COMPU_METHOD
/begin COMPU_METHOD temp_sw_q1p25Em1 "" RAT_FUNC "%6.3" "Grad C" COEFFS 0 8 0 0 0 1 /end COMPU_METHOD
/begin COMPU_METHOD temp_ub_b191p25 "" RAT_FUNC "%6.3" "Grad C" COEFFS 0 1 0 0 0 0.75 /end COMPU_METHOD
/begin COMPU_METHOD temp_ub_q0p75 "" RAT_FUNC "%6.3" "Grad C" COEFFS 0 1 0 0 0 0.75 /end COMPU_METHOD
/begin COMPU_METHOD temp_ub_q0p75_o48 "" RAT_FUNC "%6.2" "Grad C" COEFFS 0 1 48 0 0 0.75 /end COMPU_METHOD
/begin COMPU_METHOD temp_ub_q5_o50 "" RAT_FUNC "%6.2" "Grad C" COEFFS 0 1 50 0 0 5 /end COMPU_METHOD
/begin COMPU_METHOD temp_uw_q0p0195_o50 "" RAT_FUNC "%6.2" "Grad C" COEFFS 0 256 12800 0 0 5 /end COMPU_METHOD
/begin COMPU_METHOD tv_ub_b100 "" RAT_FUNC "%6.3" "%TV" COEFFS 0 256 0 0 0 100 /end COMPU_METHOD
/begin COMPU_METHOD t_q0p0001_ms "" RAT_FUNC "%7.6" "ms" COEFFS 0 1 0 0 0 0.0001 /end COMPU_METHOD
/begin COMPU_METHOD t_q0p02 "" RAT_FUNC "%6.4" "s" COEFFS 0 100 0 0 0 2 /end COMPU_METHOD
/begin COMPU_METHOD t_q0p1 "" RAT_FUNC "%6.3" "s" COEFFS 0 10 0 0 0 1 /end COMPU_METHOD
/begin COMPU_METHOD vfzg_ub_q1p25 "" RAT_FUNC "%6.2" "km/h" COEFFS 0 1 0 0 0 1.25 /end COMPU_METHOD
/begin COMPU_METHOD vfzg_uw_b512 "" RAT_FUNC "%6.4" "km/h" COEFFS 0 65536 0 0 0 512 /end COMPU_METHOD
/begin COMPU_METHOD vfzg_uw_q0p0625 "" RAT_FUNC "%6.4" "km/h" COEFFS 0 1 0 0 0 0.0625 /end COMPU_METHOD
/begin COMPU_METHOD vol_q0p1 "" RAT_FUNC "%6.3" "ml" COEFFS 0 1 0 0 0 0.1 /end COMPU_METHOD
/begin COMPU_METHOD vs_q0p1 "" RAT_FUNC "%6.3" "ml/dT" COEFFS 0 1 0 0 0 0.1 /end COMPU_METHOD
/begin COMPU_METHOD zk100msxs_uw_b6553 "" RAT_FUNC "%10.3" "s" COEFFS 0 0 65536 0 10 0 /end COMPU_METHOD
/begin COMPU_METHOD zk200msxs_uw_b13107 "" RAT_FUNC "%10.2" "s" COEFFS 0 0 13107 0 1 0 /end COMPU_METHOD
/begin COMPU_METHOD zk20msxs_uw_b1310 "" RAT_FUNC "%10.3" "s" COEFFS 0 0 1310 0 1 0 /end COMPU_METHOD
/begin RECORD_LAYOUT dc_GKlWUb FNC_VALUES 1 UBYTE COLUMN_DIR DIRECT /end RECORD_LAYOUT
/begin RECORD_LAYOUT dc_GKlWUw FNC_VALUES 1 UWORD COLUMN_DIR DIRECT /end RECORD_LAYOUT
/begin RECORD_LAYOUT dc_KwSw FNC_VALUES 1 SWORD COLUMN_DIR DIRECT /end RECORD_LAYOUT
/begin RECORD_LAYOUT dc_KwUb FNC_VALUES 1 UBYTE COLUMN_DIR DIRECT /end RECORD_LAYOUT
/begin RECORD_LAYOUT dc_KwUw FNC_VALUES 1 UWORD COLUMN_DIR DIRECT /end RECORD_LAYOUT
/begin RECORD_LAYOUT dc_SstAUbSstSb NO_AXIS_PTS_X 1 UBYTE AXIS_PTS_X 2 SBYTE INDEX_INCR DIRECT /end RECORD_LAYOUT
/begin RECORD_LAYOUT dc_SstAUbSstUb NO_AXIS_PTS_X 1 UBYTE AXIS_PTS_X 2 UBYTE INDEX_INCR DIRECT /end RECORD_LAYOUT
/begin RECORD_LAYOUT dc_SstAUwSstSw NO_AXIS_PTS_X 1 UWORD AXIS_PTS_X 2 SWORD INDEX_INCR DIRECT /end RECORD_LAYOUT
/begin RECORD_LAYOUT dc_SstAUwSstUw NO_AXIS_PTS_X 1 UWORD AXIS_PTS_X 2 UWORD INDEX_INCR DIRECT /end RECORD_LAYOUT
/begin RECORD_LAYOUT FkfNoShNoOffWUb FNC_VALUES 1 UBYTE COLUMN_DIR DIRECT /end RECORD_LAYOUT
/begin RECORD_LAYOUT FklWSw FNC_VALUES 1 SWORD COLUMN_DIR DIRECT /end RECORD_LAYOUT
/begin RECORD_LAYOUT FklWUb FNC_VALUES 1 UBYTE COLUMN_DIR DIRECT /end RECORD_LAYOUT
/begin RECORD_LAYOUT FklWUw FNC_VALUES 1 UWORD COLUMN_DIR DIRECT /end RECORD_LAYOUT
/begin RECORD_LAYOUT GkfWSb FNC_VALUES 1 SBYTE COLUMN_DIR DIRECT /end RECORD_LAYOUT
/begin RECORD_LAYOUT GkfWUb FNC_VALUES 1 UBYTE COLUMN_DIR DIRECT /end RECORD_LAYOUT
/begin RECORD_LAYOUT GkfWUw FNC_VALUES 1 UWORD COLUMN_DIR DIRECT /end RECORD_LAYOUT
/begin RECORD_LAYOUT GklWSb FNC_VALUES 1 SBYTE COLUMN_DIR DIRECT /end RECORD_LAYOUT
/begin RECORD_LAYOUT GklWUb FNC_VALUES 1 UBYTE COLUMN_DIR DIRECT /end RECORD_LAYOUT
/begin RECORD_LAYOUT GklWUw FNC_VALUES 1 UWORD COLUMN_DIR DIRECT /end RECORD_LAYOUT
/begin RECORD_LAYOUT KfAxUbAyUbSstxUbSstyUbWUb NO_AXIS_PTS_X 1 UBYTE NO_AXIS_PTS_Y 2 UBYTE AXIS_PTS_X 3 UBYTE INDEX_INCR DIRECT AXIS_PTS_Y 4 UBYTE INDEX_INCR DIRECT FNC_VALUES 5 UBYTE COLUMN_DIR DIRECT /end RECORD_LAYOUT
/begin RECORD_LAYOUT KlAUbSstUbWSb NO_AXIS_PTS_X 1 UBYTE AXIS_PTS_X 2 UBYTE INDEX_INCR DIRECT FNC_VALUES 3 SBYTE COLUMN_DIR DIRECT /end RECORD_LAYOUT
/begin RECORD_LAYOUT KlAUbSstUbWUb NO_AXIS_PTS_X 1 UBYTE AXIS_PTS_X 2 UBYTE INDEX_INCR DIRECT FNC_VALUES 3 UBYTE COLUMN_DIR DIRECT /end RECORD_LAYOUT
/begin RECORD_LAYOUT KlAUbSstUbWUw NO_AXIS_PTS_X 1 UBYTE AXIS_PTS_X 2 UBYTE INDEX_INCR DIRECT FNC_VALUES 3 UWORD COLUMN_DIR DIRECT /end RECORD_LAYOUT
/begin RECORD_LAYOUT KlAUwSstSwWUw NO_AXIS_PTS_X 1 UWORD AXIS_PTS_X 2 SWORD INDEX_INCR DIRECT FNC_VALUES 3 UWORD COLUMN_DIR DIRECT /end RECORD_LAYOUT
/begin RECORD_LAYOUT KlAUwSstUwWUw NO_AXIS_PTS_X 1 UWORD AXIS_PTS_X 2 UWORD INDEX_INCR DIRECT FNC_VALUES 3 UWORD COLUMN_DIR DIRECT /end RECORD_LAYOUT
/begin RECORD_LAYOUT KlAxU8SstxU8WU8 NO_AXIS_PTS_X 1 UBYTE AXIS_PTS_X 2 UBYTE INDEX_INCR DIRECT FNC_VALUES 3 UBYTE COLUMN_DIR DIRECT /end RECORD_LAYOUT
/begin RECORD_LAYOUT KwbUb FNC_VALUES 1 UBYTE COLUMN_DIR DIRECT /end RECORD_LAYOUT
/begin RECORD_LAYOUT KwSb FNC_VALUES 1 SBYTE COLUMN_DIR DIRECT /end RECORD_LAYOUT
/begin RECORD_LAYOUT KwSw FNC_VALUES 1 SWORD COLUMN_DIR DIRECT /end RECORD_LAYOUT
/begin RECORD_LAYOUT KwUb FNC_VALUES 1 UBYTE COLUMN_DIR DIRECT /end RECORD_LAYOUT
/begin RECORD_LAYOUT KwUw FNC_VALUES 1 UWORD COLUMN_DIR DIRECT /end RECORD_LAYOUT
/begin RECORD_LAYOUT KwWS16 FNC_VALUES 1 SWORD COLUMN_DIR DIRECT /end RECORD_LAYOUT
/begin RECORD_LAYOUT KwWU16 FNC_VALUES 1 UWORD COLUMN_DIR DIRECT /end RECORD_LAYOUT
/begin RECORD_LAYOUT KwWU8 FNC_VALUES 1 UBYTE COLUMN_DIR DIRECT /end RECORD_LAYOUT
/begin RECORD_LAYOUT SstASwSstSw NO_AXIS_PTS_X 1 SWORD AXIS_PTS_X 2 SWORD INDEX_INCR DIRECT /end RECORD_LAYOUT
/begin RECORD_LAYOUT SstAUbSstUb NO_AXIS_PTS_X 1 UBYTE AXIS_PTS_X 2 UBYTE INDEX_INCR DIRECT /end RECORD_LAYOUT
/begin RECORD_LAYOUT SstAUwSstUw NO_AXIS_PTS_X 1 UWORD AXIS_PTS_X 2 UWORD INDEX_INCR DIRECT /end RECORD_LAYOUT
/end MODULE
/end PROJECT
