ASAP2_VERSION 1 3
/begin PROJECT _9702_071D00 "ME97"
/begin HEADER "" VERSION "_9702_071D00" PROJECT_NO _9702_071D00 /end HEADER
/begin MODULE DIM ""
/begin MOD_COMMON "" BYTE_ORDER MSB_FIRST ALIGNMENT_BYTE 1 ALIGNMENT_WORD 2 ALIGNMENT_LONG 2 ALIGNMENT_FLOAT32_IEEE 4 /end MOD_COMMON
/begin CHARACTERISTIC ANZTPMX "Maximale Anzahl von hintereinander erlaubten Tips" VALUE 0x1C69D4 KwUb 255.0 dez 0.00 255.0 FORMAT "%5.1" /end CHARACTERISTIC
/begin CHARACTERISTIC APDTEFRE "Anzahl Vergleiche Gradient fr f¸r Erkennen fr-eingeschwungen in DTEV" VALUE 0x1CDE94 KwUb 50.00 dez 0.00 50.00 FORMAT "%5.2" /end CHARACTERISTIC
/begin CHARACTERISTIC APDTEVX "max. Anzahl Pr¸fungen bei erkanntem Fehler" VALUE 0x1CDE95 KwUb 10.00 dez 0.00 10.00 FORMAT "%5.2" /end CHARACTERISTIC
/begin CHARACTERISTIC AVDTEVX "max. Anzahl Pr¸fversuche DTEV" VALUE 0x1CDE96 KwUb 20.00 dez 0.00 20.00 FORMAT "%5.2" /end CHARACTERISTIC
/begin CHARACTERISTIC BRABEVI "Beschleunigung bei Rampe Beschleunigen" CURVE 0x1C69DA KlAUwSstUwWUw 7110.547 bfzg_uw_q0p1085 0.00 7110.547 FORMAT "%8.3"
 /begin AXIS_DESCR STD_AXIS vfgr_w vfzg_uw_b512 8 0.00 511.9922 FORMAT "%8.4" DEPOSIT ABSOLUTE /end AXIS_DESCR
/end CHARACTERISTIC
/begin CHARACTERISTIC BRATD "Beschleunigung (Betrag) bei Rampe Tip-Down" VALUE 0x1C69D5 KwUb 27.56 bfzg_ub_b27p67 0.00 27.56 FORMAT "%5.2" /end CHARACTERISTIC
/begin CHARACTERISTIC BRATU "Beschleunigung bei Rampe Tip-Up" VALUE 0x1C69D6 KwUb 27.56 bfzg_ub_b27p67 0.00 27.56 FORMAT "%5.2" /end CHARACTERISTIC
/begin CHARACTERISTIC BRAWA1GA "Beschleunigung Rampe Wiederaufnahme im Lande-Mode Bereich 1" CURVE 0x1CF142 KlAUwSstUwWUw 7110.547 bfzg_uw_q0p1085 0.00 7110.547 FORMAT "%8.3"
 /begin AXIS_DESCR STD_AXIS vfgr_w vfzg_uw_b512 8 0.00 511.9922 FORMAT "%8.4" DEPOSIT ABSOLUTE /end AXIS_DESCR
/end CHARACTERISTIC
/begin CHARACTERISTIC BRAWA2GA "Beschleunigung Rampe Wiederaufnahme im Lande-Mode Bereich 2" CURVE 0x1CF164 KlAUwSstUwWUw 7110.547 bfzg_uw_q0p1085 0.00 7110.547 FORMAT "%8.3"
 /begin AXIS_DESCR STD_AXIS vfgr_w vfzg_uw_b512 8 0.00 511.9922 FORMAT "%8.4" DEPOSIT ABSOLUTE /end AXIS_DESCR
/end CHARACTERISTIC
/begin CHARACTERISTIC BRAWA3GA "Beschleunigung Rampe Wiederaufnahme im Lande-Mode Bereich 3" CURVE 0x1CF186 KlAUwSstUwWUw 7110.547 bfzg_uw_q0p1085 0.00 7110.547 FORMAT "%8.3"
 /begin AXIS_DESCR STD_AXIS vfgr_w vfzg_uw_b512 8 0.00 511.9922 FORMAT "%8.4" DEPOSIT ABSOLUTE /end AXIS_DESCR
/end CHARACTERISTIC
/begin CHARACTERISTIC BRAWAVI "Beschleunigung Rampe Wiederaufnahme" CURVE 0x1C69FC KlAUwSstUwWUw 7110.547 bfzg_uw_q0p1085 0.00 7110.547 FORMAT "%8.3"
 /begin AXIS_DESCR STD_AXIS vfgr_w vfzg_uw_b512 8 0.00 511.9922 FORMAT "%8.4" DEPOSIT ABSOLUTE /end AXIS_DESCR
/end CHARACTERISTIC
/begin CHARACTERISTIC CUKA "Codewort ‹K-Adaption" VALUE 0x1C53A2 KwUb 255.0 dez 0.00 255.0 FORMAT "%5.1" /end CHARACTERISTIC
/begin CHARACTERISTIC CWDLDPTE "Codewort f¸r DLDP in System Vorhanden" VALUE 0x1CDE97 KwUb 255.0 dez 0.00 255.0 FORMAT "%5.1" /end CHARACTERISTIC
/begin CHARACTERISTIC CWDTEAPP "Applikationscodeword f¸r DTEV immer aktiv und Umschaltung von HFM auf P-System" VALUE 0x1CDE98 KwUb 255.0 dez 0.00 255.0 FORMAT "%5.1" /end CHARACTERISTIC
/begin CHARACTERISTIC CWDTHM "Codewort DTHM-Funktion" VALUE 0x1CEA4C KwUb 255.0 dez 0.00 255.0 FORMAT "%5.1" /end CHARACTERISTIC
/begin CHARACTERISTIC CWESVW "Codewort: Einspritzung Vorlagerungswinkel" VALUE 0x1CD8E0 KwUb 255.0 dez 0.00 255.0 FORMAT "%5.1" /end CHARACTERISTIC
/begin CHARACTERISTIC CWFGRMD "Codewort f¸r FGRMD" VALUE 0x1C69D7 KwUb 255.0 dez 0.00 255.0 FORMAT "%5.1" /end CHARACTERISTIC
/begin CHARACTERISTIC CWFUEDK "Codewort FUEDK" VALUE 0x1C3918 KwUb 255.0 dez 0.00 255.0 FORMAT "%5.1" /end CHARACTERISTIC
/begin CHARACTERISTIC CWFUEREG "Codewort F¸llungsregler auﬂerhalb Leerlauf aktiv" VALUE 0x1C39E6 KwUb 255.0 dez 0.00 255.0 FORMAT "%5.1" /end CHARACTERISTIC
/begin CHARACTERISTIC CWPSTEVE "Kodewort zum Abschalten der Endstufediagnose" VALUE 0x1C5677 KwUb 255.0 dez 0.00 255.0 FORMAT "%5.1" /end CHARACTERISTIC
/begin CHARACTERISTIC CWUGD "Codewort zur Applikationsvorgabe des ungedrosselten DK- und AGR- Winkels" VALUE 0x1CA86A KwUb 255.0 dez 0.00 255.0 FORMAT "%5.1" /end CHARACTERISTIC
/begin CHARACTERISTIC CWWDKSPE "Codewort: pr‰dizierende DK-Sollwertentjitterung aktiv" VALUE 0x1C39C8 KwUb 255.0 dez 0.00 255.0 FORMAT "%5.1" /end CHARACTERISTIC
/begin CHARACTERISTIC DFAFRG "Aufreglungsfaktor nach Einschalten des F¸llungsreglers" VALUE 0x1CA8C8 KwUb 0.9961 fak_ub_b1 0.00 0.9961 /end CHARACTERISTIC
/begin CHARACTERISTIC DFRMDTEE "Delta-frm-Schwelle f¸r Erkennung der eingeschwungenen Gemischkorrektur" VALUE 0x1CDF0E KwUw 0.03125000 fak_uw_b2 0.00 0.03125000 FORMAT "%10.8" /end CHARACTERISTIC
/begin CHARACTERISTIC DFRMDTEF "Regelhubschwelle f¸r Fettkorrektur des fr f¸r Pr¸fung i.O." VALUE 0x1CDF10 KwSw 0.2000122 fak_sw_b1 -0.2000122 0.00 FORMAT "%9.7" /end CHARACTERISTIC
/begin CHARACTERISTIC DFRMDTEM "Regelhubschwelle f¸r Magerkorrektur des fr f¸r Pr¸fung i.O." VALUE 0x1CDF12 KwSw 0.2000122 fak_sw_b1 0.00 0.2000122 FORMAT "%9.7" /end CHARACTERISTIC
/begin CHARACTERISTIC DKNOTBEGR "Sollwertbegrenzung bei DK-Potinotfahren als f(nmot)" CURVE 0x1C39CC KlAUbSstUbWUw 100.0000 relDK_uw_b100 0.00 100.0000 FORMAT "%8.4"
 /begin AXIS_DESCR STD_AXIS nmot nmot_ub_q40 8 0.00 10200. FORMAT "%5.0" DEPOSIT ABSOLUTE /end AXIS_DESCR
/end CHARACTERISTIC
/begin CHARACTERISTIC DMLDTEFN "Schwelle Luftmassenstrom unplausibel f¸r Erkennung Fehler in DTEV" VALUE 0x1CDF14 KwSw 2.000000 m_q0p0031 -2.000000 0.00 FORMAT "%8.6" /end CHARACTERISTIC
/begin CHARACTERISTIC DMLDTEFX "Luftmassenschwelle f¸r Erkennung TEV defekt nicht mehr nˆtig" VALUE 0x1CDF16 KwSw 3.025000 m_q0p0031 0.00 3.025000 FORMAT "%8.6" /end CHARACTERISTIC
/begin CHARACTERISTIC DMLDTEMN "Untere Schwelle f¸r Erkennung Luftmassenstrom unplausibel f¸r Auswertung in DTEV" VALUE 0x1CDF18 KwSw 2.000000 m_q0p0031 -2.000000 0.00 FORMAT "%8.6" /end CHARACTERISTIC
/begin CHARACTERISTIC DMLDTEMX "Obere Schwelle f¸r Erkennung Luftmassenstrom unplausibel f¸r Auswertung in DTEV" VALUE 0x1CDF1A KwSw 2.000000 m_q0p0031 0.00 2.000000 FORMAT "%8.6" /end CHARACTERISTIC
/begin CHARACTERISTIC DMRFGRAL "Delta Relatives Moment bei langsamer FGR-Abschaltung" VALUE 0x1C69D0 KwUw 199.9969 rel_uw_b200 0.00 199.9969 FORMAT "%8.4" /end CHARACTERISTIC
/begin CHARACTERISTIC DMSFUEDRL "P-Anteil von Luftmassenregler" CURVE 0x1C39E8 KlAUbSstSwWSw 6553.500 m_q0p1 -3276.800 3276.700 FORMAT "%8.3"
 /begin AXIS_DESCR STD_AXIS drlm_w rel_q0p02344 8 -768.0000 767.9766 FORMAT "%8.4" DEPOSIT ABSOLUTE /end AXIS_DESCR
/end CHARACTERISTIC
/begin CHARACTERISTIC DMSNTEMN "Minmale normierte Massenstrom‰nderung TEV" VALUE 0x1CDF1C KwSw 3281.700 m_q0p1 -5.000000 3276.700 FORMAT "%8.3" /end CHARACTERISTIC
/begin CHARACTERISTIC DMSNTEMX "Maximale normierte Massenstrom‰nderung TEV" VALUE 0x1CDF1E KwSw 3274.700 m_q0p1 2.000000 3276.700 FORMAT "%8.3" /end CHARACTERISTIC
/begin CHARACTERISTIC DMVTEVDO "Schwelle Verlustadaption zur Unterscheidung min, max Fehler in DTEV" VALUE 0x1CDF20 KwSw 199.9969 rel_sw_b100 -100.0000 99.99695 FORMAT "%8.4" /end CHARACTERISTIC
/begin CHARACTERISTIC DN10BURN "Minimaler Drehzahlanstieg f¸r ""Verbrennnung erfolgt""" VALUE 0x1C5110 KwUb 2550. nmot_ub_q10 0.00 2550. FORMAT "%5.0" /end CHARACTERISTIC
/begin CHARACTERISTIC DNDTEO "obere Nsoll-Nist-Schwelle f¸r Abbruch Diagnose TEV" VALUE 0x1CDE99 KwSb 200.0 nmot_ub_q10 0.00 200.0 FORMAT "%5.1" /end CHARACTERISTIC
/begin CHARACTERISTIC DNDTEU "lower Nsoll-Nist-Schwelle f¸r Abbruch Diagnose TEV" VALUE 0x1CDE9A KwSb 200.0 nmot_ub_q10 -200.0 0.00 FORMAT "%5.1" /end CHARACTERISTIC
/begin CHARACTERISTIC DNNSOL "Drehzahlschwelle f¸r Solldrehzahl‰nderung w‰hrend DTEV" VALUE 0x1CDE9B KwUb 200.0 nmot_ub_q10 0.00 200.0 FORMAT "%5.1" /end CHARACTERISTIC
/begin CHARACTERISTIC DPUPVDK "Differenzdruck pu-pvdk" CURVE 0x1CA4B2 KlAxU8SstxU16WU16 2559.961 p_uw_q0p039 0.00 2559.961 FORMAT "%8.3"
 /begin AXIS_DESCR STD_AXIS ml_w m_uw_b6553p5 8 0.00 6553.500 FORMAT "%8.3" DEPOSIT ABSOLUTE /end AXIS_DESCR
/end CHARACTERISTIC
/begin CHARACTERISTIC DRLSOLMF "Schwelle delta rlsol f¸r Medianfilter" VALUE 0x1C3928 KwUw 1535.977 rel_uw_q0p0234 0.00 1535.977 FORMAT "%8.3" /end CHARACTERISTIC
/begin CHARACTERISTIC DSACGRAD "Gradient f¸r Drucksensor AC" VALUE 0x1C86C4 KwUw 24025.00 adp_q0p3666 0.00 24025.00 FORMAT "%8.2" /end CHARACTERISTIC
/begin CHARACTERISTIC DSACOFS "Offset Drucksensor AC" VALUE 0x1C86C6 KwSw 60000.92 p_q0p9155 -30000.92 30000.00 FORMAT "%8.2" /end CHARACTERISTIC
/begin CHARACTERISTIC DSSGRAD "Gradient f¸r Drucksensor Saugrohrdruck" VALUE 0x1C2DBE KwUw 1023.984 dgrad_uw_q0p015 0.00 1023.984 FORMAT "%8.3" /end CHARACTERISTIC
/begin CHARACTERISTIC DSSOFS "Offset Drucksensor Saugrohrdruck" VALUE 0x1C2DC0 KwSw 2559.961 p_sw_q0p039 -1280.000 1279.961 FORMAT "%8.3" /end CHARACTERISTIC
/begin CHARACTERISTIC DSUGRAD "Gradient f¸r Drucksensor Umgebung" VALUE 0x1CA4D4 KwWU16 1023.984 dgrad_uw_q0p015 0.00 1023.984 FORMAT "%8.3" /end CHARACTERISTIC
/begin CHARACTERISTIC DSUOFS "Offset Drucksensor Umgebung" VALUE 0x1CA4D6 KwWS16 2559.961 p_sw_q0p039 -1280.000 1279.961 FORMAT "%8.3" /end CHARACTERISTIC
/begin CHARACTERISTIC DTDTHM "Delta Entprellzeit Fehlerheilung Thermostat" VALUE 0x1CEA4D KwUb 25.50 t100msxs_ub_b25p5 0.00 25.50 FORMAT "%5.2" /end CHARACTERISTIC
/begin CHARACTERISTIC DTHMD "Delta Motortemperatur Sicherheitsabstand zur Thermostat-Modelltemperatur" VALUE 0x1CEA4E KwUb 191.3 temp_ub_b191p25 0.00 191.3 FORMAT "%5.1" /end CHARACTERISTIC
/begin CHARACTERISTIC DTMWUC "Delta Motortemperaturschwelle f¸r Erf¸llung 'warm up cycle'" VALUE 0x1C3CDB KwUb 191.3 temp_ub_b191p25 0.00 191.3 FORMAT "%5.1" /end CHARACTERISTIC
/begin CHARACTERISTIC DUF_T "Zeit f¸rs Setzen der Zyklusflags der Funktions¸berwachungs-Diagnose" VALUE 0x1C2CBE KwUb 25.50 t100msxs_ub_b25p5 0.00 25.50 FORMAT "%5.2" /end CHARACTERISTIC
/begin CHARACTERISTIC DUKK "Schwelle f¸r Kurzzeitanteil" VALUE 0x1C52E6 KwSw 3071.953 rel_sw_q0p0468 -1536.000 1535.953 FORMAT "%8.3" /end CHARACTERISTIC
/begin CHARACTERISTIC DVIVZTMX "Maximales Delta zw. Ist- und Zielgeschw. f¸r Tip-Erlaubnis" VALUE 0x1C6A1E KwUw 511.9922 vfzg_uw_b512 0.00 511.9922 FORMAT "%8.4" /end CHARACTERISTIC
/begin CHARACTERISTIC DVSAVO "Delta Geschwindigkeit f¸r R¸cksetzen Schubabschalteverbot vom FGR" VALUE 0x1C6A20 KwUw 511.9922 vfzg_uw_b512 0.00 511.9922 FORMAT "%8.4" /end CHARACTERISTIC
/begin CHARACTERISTIC DVSAVU "Delta Geschwindigkeit f¸r Setzen Schubabschalteverbot vom FGR" VALUE 0x1C6A22 KwUw 511.9922 vfzg_uw_b512 0.00 511.9922 FORMAT "%8.4" /end CHARACTERISTIC
/begin CHARACTERISTIC DVSKNBGA "Delta Geschwindigkeit f¸r Setzwertkorrektur nach Beschleunigen" CURVE 0x1CF1A8 KlAUwSstUwWUw 511.9922 vfzg_uw_b512 0.00 511.9922 FORMAT "%8.4"
 /begin AXIS_DESCR STD_AXIS gangi dez 8 0.00 65535.00 FORMAT "%8.2" DEPOSIT ABSOLUTE /end AXIS_DESCR
/end CHARACTERISTIC
/begin CHARACTERISTIC DVSKNVGA "Delta Geschwindigkeit f¸r Setzwertkorrektur nach Verzˆgern" CURVE 0x1CF1CA KlAUwSstUwWUw 511.9922 vfzg_uw_b512 0.00 511.9922 FORMAT "%8.4"
 /begin AXIS_DESCR STD_AXIS gangi dez 8 0.00 65535.00 FORMAT "%8.2" DEPOSIT ABSOLUTE /end AXIS_DESCR
/end CHARACTERISTIC
/begin CHARACTERISTIC DVTIPUD "ƒnderung der Zielgeschwindigkeit bei Tip-Up oder Tip-Down" VALUE 0x1C6A24 KwUw 511.9922 vfzg_uw_b512 0.00 511.9922 FORMAT "%8.4" /end CHARACTERISTIC
/begin CHARACTERISTIC DVZVITMX "Maximales Delta zw. Ziel- und Istgeschw. f¸r Tip-Erlaubnis" VALUE 0x1C6A26 KwUw 511.9922 vfzg_uw_b512 0.00 511.9922 FORMAT "%8.4" /end CHARACTERISTIC
/begin CHARACTERISTIC DVZVIWA "Delta zw. Ziel- und Istgeschw. f¸r ‹bergang von Konstantfahrt in Wiederaufnahme" VALUE 0x1C6A28 KwUw 511.9922 vfzg_uw_b512 0.00 511.9922 FORMAT "%8.4" /end CHARACTERISTIC
/begin CHARACTERISTIC DVZVRWA1 "Delta zw. Ziel- und Sollgeschw. f¸r ‹bergang in WA-Lande-Mode Bereich 1" VALUE 0x1C6A2A KwUw 511.9922 vfzg_uw_b512 0.00 511.9922 FORMAT "%8.4" /end CHARACTERISTIC
/begin CHARACTERISTIC DVZVRWA2 "Delta zw. Ziel- und Sollgeschw. f¸r ‹bergang in WA-Lande-Mode Bereich 2" VALUE 0x1C6A2C KwUw 511.9922 vfzg_uw_b512 0.00 511.9922 FORMAT "%8.4" /end CHARACTERISTIC
/begin CHARACTERISTIC DVZVRWA3 "Delta zw. Ziel- und Sollgeschw. f¸r ‹bergang in WA-Lande-Mode Bereich 3" VALUE 0x1C6A2E KwUw 511.9922 vfzg_uw_b512 0.00 511.9922 FORMAT "%8.4" /end CHARACTERISTIC
/begin CHARACTERISTIC DWEEAMX "maximal zul‰ssige Abnahme Winkel Einspritzende pro Syncro" VALUE 0x1C552C KwUb 1530. zw_ub_q6 0.00 1530. FORMAT "%5.0" /end CHARACTERISTIC
/begin CHARACTERISTIC DWEEMX "maximal zul‰ssige Zunahme Winkel Einspritzende pro Syncro" VALUE 0x1C552D KwUb 1530. zw_ub_q6 0.00 1530. FORMAT "%5.0" /end CHARACTERISTIC
/begin CHARACTERISTIC ENTDKLL "Entjitterschwelle (Ink) f¸r DK-Sollwert im Leerlauf (B_ll)" VALUE 0x1C39C9 KwUb 20.00 dez 0.00 20.00 FORMAT "%5.2" /end CHARACTERISTIC
/begin CHARACTERISTIC ENTDKNLL "Entjitterschwelle (Ink) f¸r DK-Sollwert auﬂerhalb Leerlauf (!B_ll)" VALUE 0x1C39CA KwUb 20.00 dez 0.00 20.00 FORMAT "%5.2" /end CHARACTERISTIC
/begin CHARACTERISTIC ETAZWTEN "minimale Z¸ndwinkelwirkungsgrad Schwelle f¸r DTEV" VALUE 0x1CDE9C KwUb 60.00 rel_ub_b127p5 0.00 60.00 FORMAT "%5.2" /end CHARACTERISTIC
/begin CHARACTERISTIC EVTMODMNDK "min. Temperatur bei der Offset nicht zu DK-Kennlinie bei nmot=0 addiert wird" VALUE 0x1C3919 KwUb 191.3 temp_ub_q0p75_o48 -48.00 143.3 FORMAT "%5.1" /end CHARACTERISTIC
/begin CHARACTERISTIC FHODTEA "untere Hˆhenschwelle f¸r DTEV aktiv" VALUE 0x1CDF22 KwUw 0.5999756 fak_uw_b4 0.2000122 0.7999878 FORMAT "%9.7" /end CHARACTERISTIC
/begin CHARACTERISTIC FHOE "Ersatzwert f¸r Hˆhe" VALUE 0x1CA4DC KwWU8 3.984 fak_ub_b4 0.00 3.984 FORMAT "%5.3" /end CHARACTERISTIC
/begin CHARACTERISTIC FIMHU "Faktor Impuls hart" CURVE 0x1C53C8 FklWUb 1.992 fak_ub_b2 0.00 1.992 FORMAT "%5.3"
 /begin AXIS_DESCR FIX_AXIS anzwefim dez 16 0.00 15.00 FORMAT "%5.2" FIX_AXIS_PAR 0 0 16 /end AXIS_DESCR
/end CHARACTERISTIC
/begin CHARACTERISTIC FIMWU "Faktor Impuls weich" CURVE 0x1C53D8 FklWUb 1.992 fak_ub_b2 0.00 1.992 FORMAT "%5.3"
 /begin AXIS_DESCR FIX_AXIS anzwefim dez 16 0.00 15.00 FORMAT "%5.2" FIX_AXIS_PAR 0 0 16 /end AXIS_DESCR
/end CHARACTERISTIC
/begin CHARACTERISTIC FKADPMN "miminaler Kraftstoffanteil ¸ber TEV f¸r passive i.O. Pr¸fung." VALUE 0x1CDE9D KwSb 0.6953 fak_sb_b1 0.1016 0.7969 /end CHARACTERISTIC
/begin CHARACTERISTIC FKLAFUGD "Ausgang aus KLAF bei PSPVDKUG" VALUE 0x1C392A KwUw 1.999969 fak_uw_b2 0.00 1.999969 FORMAT "%8.6" /end CHARACTERISTIC
/begin CHARACTERISTIC FKSTT "Faktor Kaltstart" CURVE 0x1C526E KlAUbSstUbWUw 63.99902 fak_uw_b64 0.00 63.99902 FORMAT "%8.5"
 /begin AXIS_DESCR STD_AXIS tmst temp_ub_q0p75_o48 12 -48.00 143.3 FORMAT "%5.1" DEPOSIT ABSOLUTE /end AXIS_DESCR
/end CHARACTERISTIC
/begin CHARACTERISTIC FKUKAO "Obergrenze Korrekturfaktor in UK-Adaption" VALUE 0x1C53A3 KwUb 3.984 fak_ub_b4 0.00 3.984 FORMAT "%5.3" /end CHARACTERISTIC
/begin CHARACTERISTIC FKUKAU "Untergrenze Korrekturfaktor in UK-Adaption" VALUE 0x1C53A4 KwUb 3.891 fak_ub_b4 0.09375 3.984 FORMAT "%5.3" /end CHARACTERISTIC
/begin CHARACTERISTIC FLAMSBATM "Faktor Lambdasoll bei Beschleunigungsanreicherung" CURVE 0x1CD7F4 GklWUw 2.000000 fak_uw_b16 0.00 2.000000 FORMAT "%8.6"
 /begin AXIS_DESCR COM_AXIS tmot temp_ub_q0p75_o48 9 -48.00 143.3 AXIS_PTS_REF STM09ESUB /end AXIS_DESCR
/end CHARACTERISTIC
/begin CHARACTERISTIC FLAMSVATM "Faktor Lambdasoll bei Verzˆgerungsabmagerung" CURVE 0x1CD806 GklWUw 2.000000 fak_uw_b16 0.00 2.000000 FORMAT "%8.6"
 /begin AXIS_DESCR COM_AXIS tmot temp_ub_q0p75_o48 9 -48.00 143.3 AXIS_PTS_REF STM09ESUB /end AXIS_DESCR
/end CHARACTERISTIC
/begin CHARACTERISTIC FNSHO "Wichtung Nachstartanhebung" CURVE 0x1CD354 KlAUbSstUbWUb 1.992 fak_ub_b2 0.00 1.992 FORMAT "%5.3"
 /begin AXIS_DESCR STD_AXIS fho fak_ub_b4 4 0.00 3.984 FORMAT "%5.3" DEPOSIT ABSOLUTE /end AXIS_DESCR
/end CHARACTERISTIC
/begin CHARACTERISTIC FNSSM "Nachstartanhebung" CURVE 0x1CD360 GklWUb 3.984 fak_ub_b4 0.00 3.984 FORMAT "%5.3"
 /begin AXIS_DESCR COM_AXIS tmst temp_ub_q0p75_o48 12 -48.00 143.3 AXIS_PTS_REF STS12ESUB /end AXIS_DESCR
/end CHARACTERISTIC
/begin CHARACTERISTIC FPLMRM "Wichtungsfaktor f¸r P-Anteil Luftmassenregler" CURVE 0x1CA8CC KlAUbSstUbWUb 0.9961 fak_ub_b1 0.00 0.9961
 /begin AXIS_DESCR STD_AXIS tmot temp_ub_q0p75_o48 6 -48.00 143.3 FORMAT "%5.1" DEPOSIT ABSOLUTE /end AXIS_DESCR
/end CHARACTERISTIC
/begin CHARACTERISTIC FPWDKAPP "Drosselklappenkennlinie abh. von Fahrpedal nur f. Applik." CURVE 0x1C392C KlAUwSstUwWUw 98.79913 rel_uw_b100 0.00 99.99847 FORMAT "%8.5"
 /begin AXIS_DESCR STD_AXIS wped_w relPED_uw_b100 16 0.00 100.0000 FORMAT "%8.4" DEPOSIT ABSOLUTE /end AXIS_DESCR
/end CHARACTERISTIC
/begin CHARACTERISTIC FRKAP "Faktor relative Kraftstoffmasse f¸r Applikation" VALUE 0x1CD352 KwUb 1.992 fak_ub_b2 0.00 1.992 FORMAT "%5.3" /end CHARACTERISTIC
/begin CHARACTERISTIC FRMDPMO "obere frm Schwelle f¸r passive Einschaltbedingungen Diagnose TEV" VALUE 0x1CDF24 KwUw 0.1499939 fak_uw_b2 1.000000 1.149994 FORMAT "%8.6" /end CHARACTERISTIC
/begin CHARACTERISTIC FRMDPMU "untere frm Schwelle f¸r passive Einschaltbedingungen Diagnose TEV" VALUE 0x1CDF26 KwUw 0.1499939 fak_uw_b2 0.8500061 1.000000 FORMAT "%8.6" /end CHARACTERISTIC
/begin CHARACTERISTIC FRMDTEVO "obere frm Schwelle f¸r passive i.O. Pr¸fung Diagnose TEV" VALUE 0x1CDF28 KwUw 0.1499939 fak_uw_b2 1.000000 1.149994 FORMAT "%8.6" /end CHARACTERISTIC
/begin CHARACTERISTIC FRMDTEVU "untere frm Schwelle f¸r passive i.O. Pr¸fung Diagnose TEV" VALUE 0x1CDF2A KwUw 0.1499939 fak_uw_b2 0.8500061 1.000000 FORMAT "%8.6" /end CHARACTERISTIC
/begin CHARACTERISTIC FSTHO "Wichtung Startfaktor" CURVE 0x1CD5A4 KlAUbSstUbWUb 1.992 fak_ub_b2 0.00 1.992 FORMAT "%5.3"
 /begin AXIS_DESCR STD_AXIS fho fak_ub_b4 4 0.00 3.984 FORMAT "%5.3" DEPOSIT ABSOLUTE /end AXIS_DESCR
/end CHARACTERISTIC
/begin CHARACTERISTIC FTEADDPO "obere Beladungsschwelle f¸r passive i.O. Pr¸fung" VALUE 0x1CDF2C KwSw 30.00000 fak_sw_b64 20.00000 50.00000 FORMAT "%8.5" /end CHARACTERISTIC
/begin CHARACTERISTIC FTEADDPU "untere Beladungsschwelle f¸r passive i.O. Pr¸fung" VALUE 0x1CDF2E KwSw 8.000000 fak_sw_b64 2.000000 10.00000 FORMAT "%8.5" /end CHARACTERISTIC
/begin CHARACTERISTIC FTEADSZ "Schwelle Beladung f¸r TEV sofort schlieﬂen aus DTEV" VALUE 0x1CDF30 KwSw 15.00000 fak_sw_b64 0.00 15.00000 FORMAT "%8.5" /end CHARACTERISTIC
/begin CHARACTERISTIC FTKBRED1 "Reduktionskennziffer 1" VALUE 0x1D2FB8 dc_KwUb 25.50 DC_TQ100 0.00 25.50 FORMAT "%5.2" /end CHARACTERISTIC
/begin CHARACTERISTIC FTKBRED2 "Reduktionskennziffer 2" VALUE 0x1D2FB9 dc_KwUb 25.50 DC_TQ100 0.00 25.50 FORMAT "%5.2" /end CHARACTERISTIC
/begin CHARACTERISTIC FTKB_ON "Zuschaltfunktionvon %FTKBM, %FTKBK" VALUE 0x1D2FBC dc_KwUb 1.000 DC_CNTR_U8 0.00 1.000 FORMAT "%5.3" /end CHARACTERISTIC
/begin CHARACTERISTIC FTKB_VAL "Einzelwert Klassifikation Beschleunigung" VALUE 0x1D2FBA dc_KwUb 255.0 DC_CNTR_U8 0.00 255.0 FORMAT "%5.1" /end CHARACTERISTIC
/begin CHARACTERISTIC FTKL_ON "Zuschaltfunktion von %FTKLM, %FTKLK" VALUE 0x1D2FC0 dc_KwUb 1.000 DC_CNTR_U8 0.00 1.000 FORMAT "%5.3" /end CHARACTERISTIC
/begin CHARACTERISTIC FTKL_RED "Reduktionskennziffer Lenkklassifikation" VALUE 0x1D2FBE dc_KwUb 25.50 DC_TQ100 0.00 25.50 FORMAT "%5.2" /end CHARACTERISTIC
/begin CHARACTERISTIC FTKL_VAL "Defaultwert bei abgeschalteter %FTKLK" VALUE 0x1D2FBF dc_KwUb 255.0 DC_CNTR_U8 0.00 255.0 FORMAT "%5.1" /end CHARACTERISTIC
/begin CHARACTERISTIC FTKV_BGW "Bremsgewicht" VALUE 0x1D2FC3 dc_KwUb 255.0 DC_CNTR_U8 0.00 255.0 FORMAT "%5.1" /end CHARACTERISTIC
/begin CHARACTERISTIC FTKV_ON "Zuschaltfunktion von %FTKVM, %FTKVK" VALUE 0x1D2FC5 dc_KwUb 1.000 DC_CNTR_U8 0.00 1.000 FORMAT "%5.3" /end CHARACTERISTIC
/begin CHARACTERISTIC FTKV_VAL "Defaultwert bei abgeschalteter %FTKVK" VALUE 0x1D2FC4 dc_KwUb 255.0 DC_CNTR_U8 0.00 255.0 FORMAT "%5.1" /end CHARACTERISTIC
/begin CHARACTERISTIC FTK_KW "Motorleistung" VALUE 0x1D2FBB dc_KwUb 510.0 DC_KW_U8DB 0.00 510.0 FORMAT "%5.1" /end CHARACTERISTIC
/begin CHARACTERISTIC FTK_LUE "Lenk¸bersetzung" VALUE 0x1D2FC1 dc_KwUb 255.0 DC_CNTR_U8 0.00 255.0 FORMAT "%5.1" /end CHARACTERISTIC
/begin CHARACTERISTIC FTK_NKL "Drehzahlgrenze, ab der Klassifikation in %FTK* aussetzt" VALUE 0x1D2FBD dc_KwUb 6375. DC_NIST_QUANT 0.00 6375. FORMAT "%5.0" /end CHARACTERISTIC
/begin CHARACTERISTIC FTK_RST "Radstand" VALUE 0x1D2FC2 dc_KwUb 25500. DC_RS_U8DB 0.00 25500. FORMAT "%5.0" /end CHARACTERISTIC
/begin CHARACTERISTIC FTK_VKL "Geschwindigkeitsgrenze, ab der Klassifikation in %FTK aussetzt" VALUE 0x1D1A04 dc_KwUw 4095.938 DC_VEHSPD_KMH_U16 0.00 4095.938 FORMAT "%8.3" /end CHARACTERISTIC
/begin CHARACTERISTIC FUKABAKI "Init.-Wert adaptiver ‹K-Korrekturfaktor BA f¸r kalten Motor" VALUE 0x1C53A5 KwUb 3.984 fak_ub_b4 0.00 3.984 FORMAT "%5.3" /end CHARACTERISTIC
/begin CHARACTERISTIC FUKABAKO "Obergrenze adaptiver ‹K-Korrekturfaktor BA bei kaltem Motor" VALUE 0x1C53A6 KwUb 3.984 fak_ub_b4 0.00 3.984 FORMAT "%5.3" /end CHARACTERISTIC
/begin CHARACTERISTIC FUKABAKU "Untergrenze adaptiver ‹K-Korrekturfaktor BA bei kaltem Motor" VALUE 0x1C53A7 KwUb 3.891 fak_ub_b4 0.09375 3.984 FORMAT "%5.3" /end CHARACTERISTIC
/begin CHARACTERISTIC FUKABAWI "Init.-Wert adaptiver ‹K-Korrekturfaktor BA f¸r warmen Motor" VALUE 0x1C53A8 KwUb 3.984 fak_ub_b4 0.00 3.984 FORMAT "%5.3" /end CHARACTERISTIC
/begin CHARACTERISTIC FUKABAWO "Obergrenze adaptiver ‹K-Korrekturfaktor BA bei warmem Motor" VALUE 0x1C53A9 KwUb 3.984 fak_ub_b4 0.00 3.984 FORMAT "%5.3" /end CHARACTERISTIC
/begin CHARACTERISTIC FUKABAWU "Untergrenze adaptiver ‹K-Korrekturfaktor BA bei warmem Motor" VALUE 0x1C53AA KwUb 3.891 fak_ub_b4 0.09375 3.984 FORMAT "%5.3" /end CHARACTERISTIC
/begin CHARACTERISTIC FUKAVAKI "Init.-Wert adaptiver ‹K-Korrekturfaktor VA f¸r kalten Motor" VALUE 0x1C53AB KwUb 3.984 fak_ub_b4 0.00 3.984 FORMAT "%5.3" /end CHARACTERISTIC
/begin CHARACTERISTIC FUKAVAKO "Obergrenze adaptiver ‹K-Korrekturfaktor VA bei kaltem Motor" VALUE 0x1C53AC KwUb 3.984 fak_ub_b4 0.00 3.984 FORMAT "%5.3" /end CHARACTERISTIC
/begin CHARACTERISTIC FUKAVAKU "Untergrenze adaptiver ‹K-Korrekturfaktor VA bei kaltem Motor" VALUE 0x1C53AD KwUb 3.891 fak_ub_b4 0.09375 3.984 FORMAT "%5.3" /end CHARACTERISTIC
/begin CHARACTERISTIC FUKAVAWI "Init.-Wert adaptiver ‹K-Korrekturfaktor VA f¸r warmen Motor" VALUE 0x1C53AE KwUb 3.984 fak_ub_b4 0.00 3.984 FORMAT "%5.3" /end CHARACTERISTIC
/begin CHARACTERISTIC FUKAVAWO "Obergrenze adaptiver ‹K-Korrekturfaktor VA bei warmem Motor" VALUE 0x1C53AF KwUb 3.984 fak_ub_b4 0.00 3.984 FORMAT "%5.3" /end CHARACTERISTIC
/begin CHARACTERISTIC FUKAVAWU "Untergrenze adaptiver ‹K-Korrekturfaktor VA bei warmem Motor" VALUE 0x1C53B0 KwUb 3.891 fak_ub_b4 0.09375 3.984 FORMAT "%5.3" /end CHARACTERISTIC
/begin CHARACTERISTIC FUKE "Faktor ‹K-Ersatzwert" VALUE 0x1C52E8 KwUw 7.999878 fak_uw_b8 0.00 7.999878 FORMAT "%8.6" /end CHARACTERISTIC
/begin CHARACTERISTIC FUKLAMSBG "Kl. Faktor Lambdasoll Begrenzung" CURVE 0x1C52EA KlAUwSstUwWUw 1.999969 fak_uw_b2 0.00 1.999969 FORMAT "%8.6"
 /begin AXIS_DESCR STD_AXIS lamsbg_w fak_uw_b16 6 0.00 15.99976 FORMAT "%8.5" DEPOSIT ABSOLUTE /end AXIS_DESCR
/end CHARACTERISTIC
/begin CHARACTERISTIC FUKNSTHO "Hoehenfaktor ‹K im Nachstart" CURVE 0x1CD5B0 KlAUbSstUbWUb 1.992 fak_ub_b2 0.00 1.992 FORMAT "%5.3"
 /begin AXIS_DESCR STD_AXIS fho fak_ub_b4 6 0.00 3.984 FORMAT "%5.3" DEPOSIT ABSOLUTE /end AXIS_DESCR
/end CHARACTERISTIC
/begin CHARACTERISTIC FUKNSTM "Startwert Faktor ‹K im Nachstart" CURVE 0x1CD5C0 KlAUbSstUbWUb 3.984 fak_ub_b4 0.00 3.984 FORMAT "%5.3"
 /begin AXIS_DESCR STD_AXIS tmst temp_ub_q0p75_o48 9 -48.00 143.3 FORMAT "%5.1" DEPOSIT ABSOLUTE /end AXIS_DESCR
/end CHARACTERISTIC
/begin CHARACTERISTIC FUKTINEO "Kl. Faktor Einspritzzeit nach Einlaﬂventil ˆffnen" CURVE 0x1C5304 KlAUwSstUwWUw 1.999969 fak_uw_b2 0.00 1.999969 FORMAT "%8.6"
 /begin AXIS_DESCR STD_AXIS vti_w fak_uw_b2 6 0.00 1.999969 FORMAT "%8.6" DEPOSIT ABSOLUTE /end AXIS_DESCR
/end CHARACTERISTIC
/begin CHARACTERISTIC FVANST "Gewichtungsfaktor VA im Nachstart" VALUE 0x1C52E4 KwUb 1.992 fak_ub_b2 0.00 1.992 FORMAT "%5.3" /end CHARACTERISTIC
/begin CHARACTERISTIC FVFKUKA "Gewichtung des Korrekturfaktors in UK-Adaption" VALUE 0x1C53B1 KwUb 7.969 fak_ub_b8 0.00 7.969 FORMAT "%5.3" /end CHARACTERISTIC
/begin CHARACTERISTIC FWEHT "Faktor Wiedereinsetzmenge  temperaturabh‰ngig (hartes WE)" CURVE 0x1CD83C KlAUbSstUbWUb 1.992 fak_ub_b2 0.00 1.992 FORMAT "%5.3"
 /begin AXIS_DESCR STD_AXIS tmot temp_ub_q0p75_o48 9 -48.00 143.3 FORMAT "%5.1" DEPOSIT ABSOLUTE /end AXIS_DESCR
/end CHARACTERISTIC
/begin CHARACTERISTIC FWEMRFA "Faktor Wiedereinsetzmenge ¸ber Fahrerwunschmoment" CURVE 0x1C53E8 KlAUwSstUwWUb 1.992 fak_ub_b2 0.00 1.992 FORMAT "%5.3"
 /begin AXIS_DESCR STD_AXIS mrfa_w rel_uw_b200 6 0.00 199.9969 FORMAT "%8.4" DEPOSIT ABSOLUTE /end AXIS_DESCR
/end CHARACTERISTIC
/begin CHARACTERISTIC FWET "Faktor Wiedereinsetzmenge temperaturabhaengig" CURVE 0x1CD850 KlAUbSstUbWUb 1.992 fak_ub_b2 0.00 1.992 FORMAT "%5.3"
 /begin AXIS_DESCR STD_AXIS tmot temp_ub_q0p75_o48 9 -48.00 143.3 FORMAT "%5.1" DEPOSIT ABSOLUTE /end AXIS_DESCR
/end CHARACTERISTIC
/begin CHARACTERISTIC FWFN "Faktor Wandfilm Drehzahleinfluss" VALUE 0x1C531E KwSw 2.999954 rel_sw_b1p5 -1.500000 1.499954 FORMAT "%8.6" /end CHARACTERISTIC
/begin CHARACTERISTIC FWGAEIN "Schwellwert f¸r plausiblen Gang erkannt" VALUE 0x1D311E dc_KwUb 5.100 DC_TQ20 0.00 5.100 FORMAT "%5.3" /end CHARACTERISTIC
/begin CHARACTERISTIC FWGAOUT "Schwellwert f¸r Gang unplausibel" VALUE 0x1D311F dc_KwUb 5.100 DC_TQ20 0.00 5.100 FORMAT "%5.3" /end CHARACTERISTIC
/begin CHARACTERISTIC FWHGUE6 "‹bersetzung HG 6ter Gang" VALUE 0x1D3120 dc_KwUb 5.100000 DC_FCTR_50_U8 0.00 5.100000 FORMAT "%8.6" /end CHARACTERISTIC
/begin CHARACTERISTIC FWKUPEIN "Schwellwert f¸r getretene Kupplung bei Tempomat" VALUE 0x1D3121 dc_KwUb 5.100 DC_TQ20 0.00 5.100 FORMAT "%5.3" /end CHARACTERISTIC
/begin CHARACTERISTIC FWKUPWEG "Gang¸bernahme nach Kuppeln" VALUE 0x1D3122 dc_KwUb 5.100 DC_TQ20 0.00 5.100 FORMAT "%5.3" /end CHARACTERISTIC
/begin CHARACTERISTIC FWSTAA1 "Wichtung Nachstart" CURVE 0x1CD36C GklWUb 1.992 fak_ub_b2 0.00 1.992 FORMAT "%5.3"
 /begin AXIS_DESCR COM_AXIS kstaa fak_ub_b2 6 0.00 1.992 AXIS_PTS_REF SKS06ESUB /end AXIS_DESCR
/end CHARACTERISTIC
/begin CHARACTERISTIC FWSTAB1 "Wichtung Nachstart Abregelung Bereich 1" CURVE 0x1CD374 GklWUb 1.992 fak_ub_b2 0.00 1.992 FORMAT "%5.3"
 /begin AXIS_DESCR COM_AXIS kstaa fak_ub_b2 6 0.00 1.992 AXIS_PTS_REF SKS06ESUB /end AXIS_DESCR
/end CHARACTERISTIC
/begin CHARACTERISTIC FWSTAB2 "Wichtung Nachstart Abregelung Bereich 2" CURVE 0x1CD37C GklWUb 1.992 fak_ub_b2 0.00 1.992 FORMAT "%5.3"
 /begin AXIS_DESCR COM_AXIS kstaa fak_ub_b2 6 0.00 1.992 AXIS_PTS_REF SKS06ESUB /end AXIS_DESCR
/end CHARACTERISTIC
/begin CHARACTERISTIC FWSTAB3 "Wichtung Nachstart Abregelung Bereich 3" CURVE 0x1CD384 GklWUb 1.992 fak_ub_b2 0.00 1.992 FORMAT "%5.3"
 /begin AXIS_DESCR COM_AXIS kstaa fak_ub_b2 6 0.00 1.992 AXIS_PTS_REF SKS06ESUB /end AXIS_DESCR
/end CHARACTERISTIC
/begin CHARACTERISTIC FWSTAS1 "Wichtung Nachstart Umschaltschwelle 1" CURVE 0x1CD38C GklWUb 1.992 fak_ub_b2 0.00 1.992 FORMAT "%5.3"
 /begin AXIS_DESCR COM_AXIS kstaa fak_ub_b2 6 0.00 1.992 AXIS_PTS_REF SKS06ESUB /end AXIS_DESCR
/end CHARACTERISTIC
/begin CHARACTERISTIC FWSTAS2 "Wichtung Nachstart Umschaltschwelle 2" CURVE 0x1CD394 GklWUb 1.992 fak_ub_b2 0.00 1.992 FORMAT "%5.3"
 /begin AXIS_DESCR COM_AXIS kstaa fak_ub_b2 6 0.00 1.992 AXIS_PTS_REF SKS06ESUB /end AXIS_DESCR
/end CHARACTERISTIC
/begin CHARACTERISTIC FWTNKUP "Schwellwert f¸rZeit nach Kuppeln" VALUE 0x1D3123 dc_KwUb 5.100 DC_TQ20 0.00 5.100 FORMAT "%5.3" /end CHARACTERISTIC
/begin CHARACTERISTIC FWVROLL "Schwellwert f¸r Rollgeschwindigkeit" VALUE 0x1D2290 dc_KwUw 100.0000 DC_VEHSPD_KMH_U16 0.00 100.0000 FORMAT "%8.4" /end CHARACTERISTIC
/begin CHARACTERISTIC FZANSSA1 "Faktor f¸r z¸ndsynchrone Abregelung des Nachstartfaktors bei Heiﬂstart Bereich 1" CURVE 0x1CD39C GklWUb 0.249023438 fak_ub_b0p25 0.00 0.249023438 FORMAT "%11.9"
 /begin AXIS_DESCR COM_AXIS tans temp_ub_q0p75_o48 6 -48.00 143.3 AXIS_PTS_REF STA06ESUB /end AXIS_DESCR
/end CHARACTERISTIC
/begin CHARACTERISTIC FZANSSA2 "Faktor f¸r z¸ndsynchrone Abregelung des Nachstartfaktors bei Heiﬂstart Bereich 2" CURVE 0x1CD3A4 GklWUb 0.249023438 fak_ub_b0p25 0.00 0.249023438 FORMAT "%11.9"
 /begin AXIS_DESCR COM_AXIS tans temp_ub_q0p75_o48 6 -48.00 143.3 AXIS_PTS_REF STA06ESUB /end AXIS_DESCR
/end CHARACTERISTIC
/begin CHARACTERISTIC FZANSSM1 "Faktor f¸r z¸ndsynchrone Abregelung des Nachstartfaktors oberhalb Schwelle" CURVE 0x1CD3AC GklWUb 0.249023438 fak_ub_b0p25 0.00 0.249023438 FORMAT "%11.9"
 /begin AXIS_DESCR COM_AXIS tmst temp_ub_q0p75_o48 12 -48.00 143.3 AXIS_PTS_REF STS12ESUB /end AXIS_DESCR
/end CHARACTERISTIC
/begin CHARACTERISTIC FZANSSM2 "Faktor f¸r z¸ndsynchrone Abregelung des Nachstartfaktors unterhalb Schwelle" CURVE 0x1CD3B8 GklWUb 0.249023438 fak_ub_b0p25 0.00 0.249023438 FORMAT "%11.9"
 /begin AXIS_DESCR COM_AXIS tmst temp_ub_q0p75_o48 12 -48.00 143.3 AXIS_PTS_REF STS12ESUB /end AXIS_DESCR
/end CHARACTERISTIC
/begin CHARACTERISTIC FZANSSM3 "Faktor f¸r z¸ndsynchrone Abregelung des Nachstartfaktors im Bereich 3" CURVE 0x1CD3C4 GklWUb 0.249023438 fak_ub_b0p25 0.00 0.249023438 FORMAT "%11.9"
 /begin AXIS_DESCR COM_AXIS tmst temp_ub_q0p75_o48 12 -48.00 143.3 AXIS_PTS_REF STS12ESUB /end AXIS_DESCR
/end CHARACTERISTIC
/begin CHARACTERISTIC IDTHMU "untere Schwelle der integrierten Luftmasse f¸r Freigabe Thermostatdiagnose" VALUE 0x1CEA4F KwUb 23.21 m_ub_b23p3 0.00 23.21 FORMAT "%5.2" /end CHARACTERISTIC
/begin CHARACTERISTIC IMLHS "Luftmassenintegral Heiﬂstart" VALUE 0x1C5111 KwUb 23.21 m_ub_b23p3 0.00 23.21 FORMAT "%5.2" /end CHARACTERISTIC
/begin CHARACTERISTIC IMSDTEVA "Schwelle f¸r Intergal des Massenstroms TEV nach l‰ngerm TE-Stop" VALUE 0x1CDE9E KwUb 11.32 m_ub_q0p0444 0.00 11.32 FORMAT "%5.2" /end CHARACTERISTIC
/begin CHARACTERISTIC KFABAK "Aufteilungsfaktor Wandfilm bei BA" MAP 0x1CD5D4 GkfWUb 0.9961 fak_ub_b1 0.00 0.9961
 /begin AXIS_DESCR COM_AXIS tmot temp_ub_q0p75_o48 9 -48.00 143.3 AXIS_PTS_REF STM09ESUB /end AXIS_DESCR
 /begin AXIS_DESCR COM_AXIS nmot nmot_ub_q40 7 0.00 10200. AXIS_PTS_REF SNM07ESUB /end AXIS_DESCR
/end CHARACTERISTIC
/begin CHARACTERISTIC KFABALBK "Aufteilungsfaktor Wandfilm bei BA mit LBK" MAP 0x1CD614 GkfWUb 0.9961 fak_ub_b1 0.00 0.9961
 /begin AXIS_DESCR COM_AXIS tmot temp_ub_q0p75_o48 9 -48.00 143.3 AXIS_PTS_REF STM09ESUB /end AXIS_DESCR
 /begin AXIS_DESCR COM_AXIS nmot nmot_ub_q40 7 0.00 10200. AXIS_PTS_REF SNM07ESUB /end AXIS_DESCR
/end CHARACTERISTIC
/begin CHARACTERISTIC KFAVAK "Aufteilungsfaktor Wandfilm bei VA" MAP 0x1CD654 GkfWUb 0.9961 fak_ub_b1 0.00 0.9961
 /begin AXIS_DESCR COM_AXIS tmot temp_ub_q0p75_o48 9 -48.00 143.3 AXIS_PTS_REF STM09ESUB /end AXIS_DESCR
 /begin AXIS_DESCR COM_AXIS nmot nmot_ub_q40 7 0.00 10200. AXIS_PTS_REF SNM07ESUB /end AXIS_DESCR
/end CHARACTERISTIC
/begin CHARACTERISTIC KFAVALBK "Aufteilungsfaktor Wandfilm bei VA mit LBK" MAP 0x1CD694 GkfWUb 0.9961 fak_ub_b1 0.00 0.9961
 /begin AXIS_DESCR COM_AXIS tmot temp_ub_q0p75_o48 9 -48.00 143.3 AXIS_PTS_REF STM09ESUB /end AXIS_DESCR
 /begin AXIS_DESCR COM_AXIS nmot nmot_ub_q40 7 0.00 10200. AXIS_PTS_REF SNM07ESUB /end AXIS_DESCR
/end CHARACTERISTIC
/begin CHARACTERISTIC KFBAKL "Faktor Beschleunigungsanreicherung (K+L-Anteil)" MAP 0x1CD6D4 GkfWUb 15.94 fak_ub_b16 0.00 15.94 FORMAT "%5.2"
 /begin AXIS_DESCR COM_AXIS tmot temp_ub_q0p75_o48 9 -48.00 143.3 AXIS_PTS_REF STM09ESUB /end AXIS_DESCR
 /begin AXIS_DESCR COM_AXIS nmot nmot_ub_q40 7 0.00 10200. AXIS_PTS_REF SNM07ESUB /end AXIS_DESCR
/end CHARACTERISTIC
/begin CHARACTERISTIC KFDETATE "Z¸ndwinkelwirkungsgrad Korrektur for DTEV" MAP 0x1CDEA0 KfAxUbAyUbSstxUbSstyUbWUb 127.5 rel_ub_b127p5 0.00 127.5 FORMAT "%5.1"
 /begin AXIS_DESCR STD_AXIS etazwist rel_ub_b127p5 4 0.00 127.5 FORMAT "%5.1" DEPOSIT ABSOLUTE /end AXIS_DESCR
 /begin AXIS_DESCR STD_AXIS dmletanu m_q0p1 6 0.00 25.50 FORMAT "%5.2" DEPOSIT ABSOLUTE /end AXIS_DESCR
/end CHARACTERISTIC
/begin CHARACTERISTIC KFDTHML "Kennfeld Temperaturgradient f¸r Thermostatdiagnose" MAP 0x1CEA66 KfAxUbAyUbSstxUbSstyUbWSb 1.494 tempg_q0p00586 -0.7500 0.7441
 /begin AXIS_DESCR STD_AXIS ml m_ub_b1020 5 0.00 1020. FORMAT "%5.0" DEPOSIT ABSOLUTE /end AXIS_DESCR
 /begin AXIS_DESCR STD_AXIS thmdmm temp_ub_q0p75_o48 4 -48.00 143.3 FORMAT "%5.1" DEPOSIT ABSOLUTE /end AXIS_DESCR
/end CHARACTERISTIC
/begin CHARACTERISTIC KFFWL "Kennfeld Warmlauffaktor" MAP 0x1CD3D0 GkfWUb 1.992 fak_ub_b2 0.00 1.992 FORMAT "%5.3"
 /begin AXIS_DESCR COM_AXIS tmot temp_ub_q0p75_o48 12 -48.00 143.3 AXIS_PTS_REF STM12ESUB /end AXIS_DESCR
 /begin AXIS_DESCR COM_AXIS tmst temp_ub_q0p75_o48 12 -48.00 143.3 AXIS_PTS_REF STS12ESUB /end AXIS_DESCR
/end CHARACTERISTIC
/begin CHARACTERISTIC KFFWLRL "Kennfeld Warmlauffaktor lastabh‰ngiger Anteil" MAP 0x1C507C GkfWUb 1.992 fak_ub_b2 0.00 1.992 FORMAT "%5.3"
 /begin AXIS_DESCR COM_AXIS tmst temp_ub_q0p75_o48 8 -48.00 143.3 AXIS_PTS_REF STS08ESUB /end AXIS_DESCR
 /begin AXIS_DESCR COM_AXIS rlp rel_ub_q0p75 6 0.00 191.3 AXIS_PTS_REF SRP06ESUB /end AXIS_DESCR
/end CHARACTERISTIC
/begin CHARACTERISTIC KFFWLW "Kennfeld Wichtung Warmlauffaktor" MAP 0x1CD460 GkfWUb 1.992 fak_ub_b2 0.00 1.992 FORMAT "%5.3"
 /begin AXIS_DESCR COM_AXIS nmot nmot_ub_q40 6 0.00 10200. AXIS_PTS_REF SNM06ESUB /end AXIS_DESCR
 /begin AXIS_DESCR COM_AXIS rlp rel_ub_q0p75 6 0.00 191.3 AXIS_PTS_REF SRP06ESUB /end AXIS_DESCR
/end CHARACTERISTIC
/begin CHARACTERISTIC KFHSTT "Faktor Heiﬂstart" MAP 0x1C5114 KfAxUbAyUbSstxUbSstyUbWUb 63.75 fak_ub_b64 0.00 63.75 FORMAT "%5.2"
 /begin AXIS_DESCR STD_AXIS tans temp_ub_q0p75_o48 6 -48.00 143.3 FORMAT "%5.1" DEPOSIT ABSOLUTE /end AXIS_DESCR
 /begin AXIS_DESCR STD_AXIS tmst temp_ub_q0p75_o48 3 -48.00 143.3 FORMAT "%5.1" DEPOSIT ABSOLUTE /end AXIS_DESCR
/end CHARACTERISTIC
/begin CHARACTERISTIC KFNSA "Nachstartanhebung" MAP 0x1CD484 KfAxUbAyUbSstxUbSstyUbWUb 1.992 fak_ub_b2 0.00 1.992 FORMAT "%5.3"
 /begin AXIS_DESCR STD_AXIS tans temp_ub_q0p75_o48 6 -48.00 143.3 FORMAT "%5.1" DEPOSIT ABSOLUTE /end AXIS_DESCR
 /begin AXIS_DESCR STD_AXIS tmot temp_ub_q0p75_o48 3 -48.00 143.3 FORMAT "%5.1" DEPOSIT ABSOLUTE /end AXIS_DESCR
/end CHARACTERISTIC
/begin CHARACTERISTIC KFNSWRL "Wichtung Nachstartanhebung" MAP 0x1C50AC GkfWUb 1.992 fak_ub_b2 0.00 1.992 FORMAT "%5.3"
 /begin AXIS_DESCR COM_AXIS tmst temp_ub_q0p75_o48 8 -48.00 143.3 AXIS_PTS_REF STS08ESUB /end AXIS_DESCR
 /begin AXIS_DESCR COM_AXIS rlp rel_ub_q0p75 6 0.00 191.3 AXIS_PTS_REF SRP06ESUB /end AXIS_DESCR
/end CHARACTERISTIC
/begin CHARACTERISTIC KFTVFRR "Kennfeld: Lambda-Regler nach dieser Zeit auf Referenzwert zur¸cksetzen" MAP 0x1CDEC4 KfAxUbAyUbSstxUbSstyUbWUb 25.50 t100msxs_ub_b25p5 0.00 25.50 FORMAT "%5.2"
 /begin AXIS_DESCR STD_AXIS tadteazs rel_ub_b99p6 4 0.00 99.61 FORMAT "%5.2" DEPOSIT ABSOLUTE /end AXIS_DESCR
 /begin AXIS_DESCR STD_AXIS ml m_ub_b1020 3 0.00 1020. FORMAT "%5.0" DEPOSIT ABSOLUTE /end AXIS_DESCR
/end CHARACTERISTIC
/begin CHARACTERISTIC KFVAKL "Faktor Verzˆgerungsabmagerung (K+L-Anteil)" MAP 0x1CD714 GkfWUb 15.94 fak_ub_b16 0.00 15.94 FORMAT "%5.2"
 /begin AXIS_DESCR COM_AXIS tmot temp_ub_q0p75_o48 9 -48.00 143.3 AXIS_PTS_REF STM09ESUB /end AXIS_DESCR
 /begin AXIS_DESCR COM_AXIS nmot nmot_ub_q40 7 0.00 10200. AXIS_PTS_REF SNM07ESUB /end AXIS_DESCR
/end CHARACTERISTIC
/begin CHARACTERISTIC KFVALDIF "Wichtungsfaktor Verzˆgerungsabmagerung f¸r Lambdaist > 1.0" MAP 0x1CD754 GkfWUb 0.9961 fak_ub_b1 0.00 0.9961
 /begin AXIS_DESCR COM_AXIS tmot temp_ub_q0p75_o48 9 -48.00 143.3 AXIS_PTS_REF STM09ESUB /end AXIS_DESCR
 /begin AXIS_DESCR COM_AXIS ladiff_w fak_sw_b1 5 0.00 1.999969 AXIS_PTS_REF SLA05ESUB /end AXIS_DESCR
/end CHARACTERISTIC
/begin CHARACTERISTIC KFVOFFS "Geschwindigkeits-Offset f¸r FGR-Regler" MAP 0x1C6A30 KfAxUwAyUwSstxUwSstyUwWUw 511.9922 vfzg_uw_b512 0.00 511.9922 FORMAT "%8.4"
 /begin AXIS_DESCR STD_AXIS vziel_w vfzg_uw_b512 6 0.00 511.9922 FORMAT "%8.4" DEPOSIT ABSOLUTE /end AXIS_DESCR
 /begin AXIS_DESCR STD_AXIS gangi dez 8 0.00 65535.00 FORMAT "%8.2" DEPOSIT ABSOLUTE /end AXIS_DESCR
/end CHARACTERISTIC
/begin CHARACTERISTIC KFWDKSMX "maximaler Solldrosselklappenwinkel" MAP 0x1CA86C KfAxUwAyUwSstxUwSstyUwWUw 99.99847 rel_uw_b100 0.00 99.99847 FORMAT "%8.5"
 /begin AXIS_DESCR STD_AXIS nmot_w nmot_uw_q0p25 10 0.00 16383.75 FORMAT "%8.2" DEPOSIT ABSOLUTE /end AXIS_DESCR
 /begin AXIS_DESCR STD_AXIS fho_w fak_uw_b4 3 0.00 3.999939 FORMAT "%8.6" DEPOSIT ABSOLUTE /end AXIS_DESCR
/end CHARACTERISTIC
/begin CHARACTERISTIC KFWEE "Kennfeld Winkel Einspritzende" MAP 0x1C5530 GkfWUb 1530. zw_ub_q6 0.00 1530. FORMAT "%5.0"
 /begin AXIS_DESCR COM_AXIS nmot_w nmot_uw_q0p25 8 0.00 16383.75 AXIS_PTS_REF SNM08GKUW /end AXIS_DESCR
 /begin AXIS_DESCR COM_AXIS rl rel_ub_q0p75 8 0.00 191.3 AXIS_PTS_REF SRL08GKUB /end AXIS_DESCR
/end CHARACTERISTIC
/begin CHARACTERISTIC KFWEEK "Kennfeld-Kalt Winkel Einspritzende" MAP 0x1C5570 GkfWUb 1530. zw_ub_q6 0.00 1530. FORMAT "%5.0"
 /begin AXIS_DESCR COM_AXIS nmot_w nmot_uw_q0p25 8 0.00 16383.75 AXIS_PTS_REF SNM08GKUW /end AXIS_DESCR
 /begin AXIS_DESCR COM_AXIS rl rel_ub_q0p75 8 0.00 191.3 AXIS_PTS_REF SRL08GKUB /end AXIS_DESCR
/end CHARACTERISTIC
/begin CHARACTERISTIC KFWEEST "Kennfeld Winkel Einspritzende w‰hrend Start" MAP 0x1C55B0 KfAxUbAyUbSstxUbSstyUbWUb 1530. zw_ub_q6 0.00 1530. FORMAT "%5.0"
 /begin AXIS_DESCR STD_AXIS tmot temp_ub_q0p75_o48 8 -48.00 143.3 FORMAT "%5.1" DEPOSIT ABSOLUTE /end AXIS_DESCR
 /begin AXIS_DESCR STD_AXIS anztib dez 8 0.00 255.0 FORMAT "%5.1" DEPOSIT ABSOLUTE /end AXIS_DESCR
/end CHARACTERISTIC
/begin CHARACTERISTIC KFWEETM "Kennfeld Winkel Einspritzende Temperaturkorrektur" MAP 0x1CD8F5 KfAxUbAyUbSstxUbSstyUbWSb 1530. zw_sb_q6 -768.0 762.0 FORMAT "%5.1"
 /begin AXIS_DESCR STD_AXIS tmot temp_ub_q0p75_o48 8 -48.00 143.3 FORMAT "%5.1" DEPOSIT ABSOLUTE /end AXIS_DESCR
 /begin AXIS_DESCR STD_AXIS rl rel_ub_q0p75 6 0.00 191.3 FORMAT "%5.1" DEPOSIT ABSOLUTE /end AXIS_DESCR
/end CHARACTERISTIC
/begin CHARACTERISTIC KFWHSTT "Wichtungskennfeld Heiﬂstart" MAP 0x1C5134 KfAxUbAyUbSstxUbSstyUbWUb 1.992 fak_ub_b2 0.00 1.992 FORMAT "%5.3"
 /begin AXIS_DESCR STD_AXIS tans temp_ub_q0p75_o48 6 -48.00 143.3 FORMAT "%5.1" DEPOSIT ABSOLUTE /end AXIS_DESCR
 /begin AXIS_DESCR STD_AXIS anztib dez 8 0.00 255.0 FORMAT "%5.1" DEPOSIT ABSOLUTE /end AXIS_DESCR
/end CHARACTERISTIC
/begin CHARACTERISTIC KFWKSTAB "Faktor Wiederholkaltstart zur Reduzierung der Startmenge" MAP 0x1C5294 KfAxUbAyUbSstxUwSstyUbWUb 1.992 fak_ub_b2 0.00 1.992 FORMAT "%5.3"
 /begin AXIS_DESCR STD_AXIS tabst_w t1sxs_uw_q1 4 0.00 65535.00 FORMAT "%8.2" DEPOSIT ABSOLUTE /end AXIS_DESCR
 /begin AXIS_DESCR STD_AXIS tmst temp_ub_q0p75_o48 4 -48.00 143.3 FORMAT "%5.1" DEPOSIT ABSOLUTE /end AXIS_DESCR
/end CHARACTERISTIC
/begin CHARACTERISTIC KFWKSTN "Wichtungskennfeld Kaltstart" MAP 0x1C5174 KfAxUbAyUbSstxUbSstyUbWUb 0.9961 fak_ub_b1 0.00 0.9961
 /begin AXIS_DESCR STD_AXIS tmst temp_ub_q0p75_o48 4 -48.00 143.3 FORMAT "%5.1" DEPOSIT ABSOLUTE /end AXIS_DESCR
 /begin AXIS_DESCR STD_AXIS nmot nmot_ub_q40 4 0.00 10200. FORMAT "%5.0" DEPOSIT ABSOLUTE /end AXIS_DESCR
/end CHARACTERISTIC
/begin CHARACTERISTIC KFWKSTT "Wichtungskennfeld Kaltstart" MAP 0x1C5190 KfAxUbAyUbSstxUbSstyUbWUb 1.992 fak_ub_b2 0.00 1.992 FORMAT "%5.3"
 /begin AXIS_DESCR STD_AXIS tmst temp_ub_q0p75_o48 12 -48.00 143.3 FORMAT "%5.1" DEPOSIT ABSOLUTE /end AXIS_DESCR
 /begin AXIS_DESCR STD_AXIS anztib dez 12 0.00 255.0 FORMAT "%5.1" DEPOSIT ABSOLUTE /end AXIS_DESCR
/end CHARACTERISTIC
/begin CHARACTERISTIC KFWNSNW "Kennfeld Wichtung Nachstartfaktor in Abh‰ngigkeit von der Nockenwellenstellung" MAP 0x1CD4BC KfAxUbAyUbSstxUwSstyUwWUw 1.999969 fak_uw_b2 0.00 1.999969 FORMAT "%8.6"
 /begin AXIS_DESCR STD_AXIS fwnwvs_w fak_uw_b2 3 0.00 1.999969 FORMAT "%8.6" DEPOSIT ABSOLUTE /end AXIS_DESCR
 /begin AXIS_DESCR STD_AXIS wnwue_w kw_q0p0019 5 0.00 127.9980 FORMAT "%8.4" DEPOSIT ABSOLUTE /end AXIS_DESCR
/end CHARACTERISTIC
/begin CHARACTERISTIC KFWWLML "Kennfeld Wichtung Warmlauffaktor" MAP 0x1C50DC GkfWUb 1.992 fak_ub_b2 0.00 1.992 FORMAT "%5.3"
 /begin AXIS_DESCR COM_AXIS imlatm_w m_uw_b23p3 6 0.00 23.30133 AXIS_PTS_REF SIM06ESUW /end AXIS_DESCR
 /begin AXIS_DESCR COM_AXIS tmst temp_ub_q0p75_o48 8 -48.00 143.3 AXIS_PTS_REF STS08ESUB /end AXIS_DESCR
/end CHARACTERISTIC
/begin CHARACTERISTIC KFWWLNW "Kennfeld Wichtung Warmlauffaktor in Abh‰ngigkeit von der Nockenwellenstellung" MAP 0x1CD4EE KfAxUbAyUbSstxUwSstyUwWUw 1.999969 fak_uw_b2 0.00 1.999969 FORMAT "%8.6"
 /begin AXIS_DESCR STD_AXIS fwnwvs_w fak_uw_b2 3 0.00 1.999969 FORMAT "%8.6" DEPOSIT ABSOLUTE /end AXIS_DESCR
 /begin AXIS_DESCR STD_AXIS wnwue_w kw_q0p0019 5 0.00 127.9980 FORMAT "%8.4" DEPOSIT ABSOLUTE /end AXIS_DESCR
/end CHARACTERISTIC
/begin CHARACTERISTIC KFWWNS "Wiederholstartzeitfaktor" MAP 0x1CD520 KfAxUbAyUbSstxUbSstyUwWUb 1.992 fak_ub_b2 0.00 1.992 FORMAT "%5.3"
 /begin AXIS_DESCR STD_AXIS tmst temp_ub_q0p75_o48 8 -48.00 143.3 FORMAT "%5.1" DEPOSIT ABSOLUTE /end AXIS_DESCR
 /begin AXIS_DESCR STD_AXIS tabst_w t1sxs_uw_q1 8 0.00 65535.00 FORMAT "%8.2" DEPOSIT ABSOLUTE /end AXIS_DESCR
/end CHARACTERISTIC
/begin CHARACTERISTIC KIDMSNTE "Integrationsgeschwindigkeit f¸r die Berechnung der Massenstrom‰nderung TEV" VALUE 0x1CDF32 KwUw 127.9980 m_q0p00195 0.00 127.9980 FORMAT "%8.4" /end CHARACTERISTIC
/begin CHARACTERISTIC KIRMSMS "Integrationsgeschwindigkeit Abgleich Massenstrom TEV mit berechnetem Massenstrom" CURVE 0x1CDF34 KlAUbSstUbWUw 2498.970 fak_q0p03815 0.9918213 2499.962 FORMAT "%8.3"
 /begin AXIS_DESCR STD_AXIS mstedte m_ub_b25p6 4 0.00 25.50 FORMAT "%5.2" DEPOSIT ABSOLUTE /end AXIS_DESCR
/end CHARACTERISTIC
/begin CHARACTERISTIC KKFFGRGA "Verst‰rkungsfaktor bei Konstantfahrt f¸r FGR-Regler" CURVE 0x1CF1EC KlAUwSstUwWUw 3199.951 rel_uw_b3200 0.00 3199.951 FORMAT "%8.3"
 /begin AXIS_DESCR STD_AXIS gangi dez 8 0.00 65535.00 FORMAT "%8.2" DEPOSIT ABSOLUTE /end AXIS_DESCR
/end CHARACTERISTIC
/begin CHARACTERISTIC KLEGSUE1 "" CURVE 0x1D2294 dc_ArrUb 5.100000 DC_FCTR_50_U8 0.00 5.100000 FORMAT "%8.6" READ_ONLY
 /begin AXIS_DESCR FIX_AXIS TgtGear_State DC_CNTR_U8 16 0.00 15.00 FORMAT "%5.2" FIX_AXIS_PAR 0 0 16 /end AXIS_DESCR
/end CHARACTERISTIC
/begin CHARACTERISTIC KLEGSUE2 "" CURVE 0x1D22A4 dc_ArrUb 5.100000 DC_FCTR_50_U8 0.00 5.100000 FORMAT "%8.6" READ_ONLY
 /begin AXIS_DESCR FIX_AXIS TgtGear_State DC_CNTR_U8 16 0.00 15.00 FORMAT "%5.2" FIX_AXIS_PAR 0 0 16 /end AXIS_DESCR
/end CHARACTERISTIC
/begin CHARACTERISTIC KLKSGUE "Berechnung Getriebe¸bersetzung bei KSG" CURVE 0x1D22B4 dc_ArrUb 5.100000 DC_FCTR_50_U8 0.00 5.100000 FORMAT "%8.6"
 /begin AXIS_DESCR FIX_AXIS TgtGear_State DC_CNTR_U8 16 0.00 15.00 FORMAT "%5.2" FIX_AXIS_PAR 0 0 16 /end AXIS_DESCR
/end CHARACTERISTIC
/begin CHARACTERISTIC KLLK1AY1 "Lenkkennfeld 1 Querbeschleunigung 1" CURVE 0x1D1A08 dc_GKlWSb 20.40 DC_UAY_S8DB -10.24 10.16 FORMAT "%5.2"
 /begin AXIS_DESCR COM_AXIS Veh_Spd DC_VEHSPD_KMH_U16 16 0.00 4095.938 AXIS_PTS_REF VCANV16 /end AXIS_DESCR
/end CHARACTERISTIC
/begin CHARACTERISTIC KLLK1AY9 "Lenkkennfeld 1 Querbeschleunigung 9" CURVE 0x1D1A18 dc_GKlWSb 20.40 DC_UAY_S8DB -10.24 10.16 FORMAT "%5.2"
 /begin AXIS_DESCR COM_AXIS Veh_Spd DC_VEHSPD_KMH_U16 16 0.00 4095.938 AXIS_PTS_REF VCANV16 /end AXIS_DESCR
/end CHARACTERISTIC
/begin CHARACTERISTIC KLLK2AY1 "Lenkkennfeld 2 Querbeschleunigung 1" CURVE 0x1D1A28 dc_GKlWUb 10.20 DC_UAY_U8DB 0.00 10.20 FORMAT "%5.2"
 /begin AXIS_DESCR COM_AXIS DMTD_TrvrAccelMax_LongAccel DC_UAFZ_S8 15 -5.555 5.512 AXIS_PTS_REF LK2_AX /end AXIS_DESCR
/end CHARACTERISTIC
/begin CHARACTERISTIC KLLK2AY9 "Lenkkennfeld 2 Querbeschleunigung 9" CURVE 0x1D1A38 dc_GKlWUb 10.20 DC_UAY_U8DB 0.00 10.20 FORMAT "%5.2"
 /begin AXIS_DESCR COM_AXIS DMTD_TrvrAccelMax_LongAccel DC_UAFZ_S8 15 -5.555 5.512 AXIS_PTS_REF LK2_AX /end AXIS_DESCR
/end CHARACTERISTIC
/begin CHARACTERISTIC KLSDTHMS "Kennlinie starttemp.-abh. Anpassung Steigungskonstante Thermostat-Temp.Modell" CURVE 0x1CEA86 KlAUbSstUbWUw 0.9999847 fak_uw_b1 0.00 0.9999847 FORMAT "%9.7"
 /begin AXIS_DESCR STD_AXIS tmst temp_ub_q0p75_o48 6 -48.00 143.3 FORMAT "%5.1" DEPOSIT ABSOLUTE /end AXIS_DESCR
/end CHARACTERISTIC
/begin CHARACTERISTIC KLTMOTDIFF "Differenz von tmot im SG-Nachlauf f¸r Bed. Heiﬂstart" CURVE 0x1C523C KlAUbSstUbWUb 191.3 temp_ub_b191p25 0.00 191.3 FORMAT "%5.1"
 /begin AXIS_DESCR STD_AXIS tmotab temp_ub_q0p75_o48 6 -48.00 143.3 FORMAT "%5.1" DEPOSIT ABSOLUTE /end AXIS_DESCR
/end CHARACTERISTIC
/begin CHARACTERISTIC KLWEESTN "Winkel Einspritzende im Start" CURVE 0x1C560E KlAUwSstUwWUw 1530.000 zw_ub_q6 0.00 1530.000 FORMAT "%8.3"
 /begin AXIS_DESCR STD_AXIS nmot_w nmot_uw_q0p25 4 0.00 16383.75 FORMAT "%8.2" DEPOSIT ABSOLUTE /end AXIS_DESCR
/end CHARACTERISTIC
/begin CHARACTERISTIC KLWNSLBK "KL Wichtung Nachstart in Abh. der LBK" CURVE 0x1CD57A KlAUwSstUwWUw 1.999969 fak_uw_b2 0.00 1.999969 FORMAT "%8.6"
 /begin AXIS_DESCR STD_AXIS lbksol_w rel_uw_b100 5 0.00 99.99847 FORMAT "%8.5" DEPOSIT ABSOLUTE /end AXIS_DESCR
/end CHARACTERISTIC
/begin CHARACTERISTIC KLWWLLBK "KL Wichtung Warmlauf in Abh. der LBK" CURVE 0x1CD590 KlAUbSstUwWUb 1.992 fak_ub_b2 0.00 1.992 FORMAT "%5.3"
 /begin AXIS_DESCR STD_AXIS lbksol_w rel_uw_b100 5 0.00 99.99847 FORMAT "%8.5" DEPOSIT ABSOLUTE /end AXIS_DESCR
/end CHARACTERISTIC
/begin CHARACTERISTIC KL_BAURS "Fahrzeugkodierung Sondervarianten" CURVE 0x1D1994 dc_ArrUb 255.0 DC_CNTR_U8 0.00 255.0 FORMAT "%5.1"
 /begin AXIS_DESCR FIX_AXIS ir0 DC_CNTR_U8 16 0.00 15.00 FORMAT "%5.2" FIX_AXIS_PAR 0 0 16 /end AXIS_DESCR
/end CHARACTERISTIC
/begin CHARACTERISTIC KL_BAURSLG "mittleres Leergewicht Sonderbaureihen" CURVE 0x1D19A4 dc_ArrUb 5100. DC_LGW_U8DB 0.00 5100. FORMAT "%5.0"
 /begin AXIS_DESCR FIX_AXIS ir0 DC_CNTR_U8 16 0.00 15.00 FORMAT "%5.2" FIX_AXIS_PAR 0 0 16 /end AXIS_DESCR
/end CHARACTERISTIC
/begin CHARACTERISTIC KL_BAUR_LG "mittleres Leergewicht Baureihe" CURVE 0x1D19B4 dc_ArrUb 5100. DC_LGW_U8DB 0.00 5100. FORMAT "%5.0"
 /begin AXIS_DESCR FIX_AXIS ir0 DC_CNTR_U8 32 0.00 31.00 FORMAT "%5.2" FIX_AXIS_PAR 0 0 32 /end AXIS_DESCR
/end CHARACTERISTIC
/begin CHARACTERISTIC KL_BKAX1 "Beschleunigungskennfeld L‰ngsbeschleunigung 1" CURVE 0x1D19D4 dc_GKlWSb 11.07 DC_UAFZ_S8 -5.555 5.512 FORMAT "%5.3"
 /begin AXIS_DESCR COM_AXIS Veh_Spd DC_VEHSPD_KMH_U16 16 0.00 4095.938 AXIS_PTS_REF VCANV16 /end AXIS_DESCR
/end CHARACTERISTIC
/begin CHARACTERISTIC KL_BKAX9 "Beschleunigungskennfeld L‰ngsbeschleunigung 1" CURVE 0x1D19E4 dc_GKlWSb 11.07 DC_UAFZ_S8 -5.555 5.512 FORMAT "%5.3"
 /begin AXIS_DESCR COM_AXIS Veh_Spd DC_VEHSPD_KMH_U16 16 0.00 4095.938 AXIS_PTS_REF VCANV16 /end AXIS_DESCR
/end CHARACTERISTIC
/begin CHARACTERISTIC KL_VGBK "Geschwindigkeitsabh‰ngige Grenzkennlinie Beschleunigungsklassifikation" CURVE 0x1D19F4 dc_GKlWUb 255.0 DC_CNTR_U8 0.00 255.0 FORMAT "%5.1"
 /begin AXIS_DESCR COM_AXIS Veh_Spd DC_VEHSPD_KMH_U16 16 0.00 4095.938 AXIS_PTS_REF VCANV16 /end AXIS_DESCR
/end CHARACTERISTIC
/begin CHARACTERISTIC KRAFGRGA "Verst‰rkungsfaktor bei Rampe f¸r FGR-Regler" CURVE 0x1CF20E KlAUwSstUwWUw 3199.951 rel_uw_b3200 0.00 3199.951 FORMAT "%8.3"
 /begin AXIS_DESCR STD_AXIS gangi dez 8 0.00 65535.00 FORMAT "%8.2" DEPOSIT ABSOLUTE /end AXIS_DESCR
/end CHARACTERISTIC
/begin CHARACTERISTIC LADIFFVA "Schwelle f¸r Wichtungsfaktor Verzˆgerungsabmagerung f¸r Lambdaist > 1.0" VALUE 0x1C5320 KwSw 1.999969 fak_sw_b1 -1.000000 0.9999695 FORMAT "%8.6" /end CHARACTERISTIC
/begin CHARACTERISTIC LAMUKAF "Lambda-Soll Fettgrenze f¸r Freigabe ‹K-Adaption" VALUE 0x1C53BC KwUw 15.99976 fak_uw_b16 0.00 15.99976 FORMAT "%8.5" /end CHARACTERISTIC
/begin CHARACTERISTIC LAMUKAM "Lambda-Soll Magergrenze f¸r Freigabe ‹K-Adaption" VALUE 0x1C53BE KwUw 15.99976 fak_uw_b16 0.00 15.99976 FORMAT "%8.5" /end CHARACTERISTIC
/begin AXIS_PTS LK2_AX "St¸tzstellenverteilung f¸r FTKLK" 0x1D1628 DMTD_TrvrAccelMax_LongAccel dc_SstAUbSstSb 11.07 DC_UAFZ_S8 15 -5.555 5.512 FORMAT "%5.3" DEPOSIT ABSOLUTE /end AXIS_PTS
/begin CHARACTERISTIC MLDTEFPF "Schwelle Motorluftmasse f¸r Freigabe ‹berpr¸fung Diagnose DTEV passiv mˆglich" VALUE 0x1CDF42 KwUw 80.00000 m_q0p1 0.00 80.00000 FORMAT "%8.5" /end CHARACTERISTIC
/begin CHARACTERISTIC MLDTEPF "Schwelle Motorluftmasse f¸r Freigabe Diagnose DTEV passiv mˆglich" VALUE 0x1CDF44 KwUw 80.00000 m_q0p1 0.00 80.00000 FORMAT "%8.5" /end CHARACTERISTIC
/begin CHARACTERISTIC MRFAVW "Schwelle zur Umschaltung des Vorlagerungswinkels bei max. Fahrerwunsches" CURVE 0x1CD936 GklWUw 199.9969 rel_uw_b200 0.00 199.9969 FORMAT "%8.4"
 /begin AXIS_DESCR COM_AXIS nmot_w nmot_uw_q0p25 8 0.00 16383.75 AXIS_PTS_REF SNM08GKUW /end AXIS_DESCR
/end CHARACTERISTIC
/begin CHARACTERISTIC MRFGRMAX "Maximalwert f¸r relatives Moment aus FGR" VALUE 0x1C69D2 KwUw 199.9969 rel_uw_b200 0.00 199.9969 FORMAT "%8.4" /end CHARACTERISTIC
/begin CHARACTERISTIC MRFGRMR "FGR-Korrekturkennlinie" CURVE 0x1C6AB0 KlAUwSstUwWUw 199.9969 rel_uw_b200 0.00 199.9969 FORMAT "%8.4"
 /begin AXIS_DESCR STD_AXIS mrregl_w rel_uw_b200 8 0.00 199.9969 FORMAT "%8.4" DEPOSIT ABSOLUTE /end AXIS_DESCR
/end CHARACTERISTIC
/begin CHARACTERISTIC MRFGRSTA "Startwert f¸r Relatives Moment bei Aktivierung FGR-Regler" VALUE 0x1C6AD2 KwUw 199.9969 rel_uw_b200 0.00 199.9969 FORMAT "%8.4" /end CHARACTERISTIC
/begin CHARACTERISTIC MRMRFGR "Inverse FGR-Korrekturkennlinie" CURVE 0x1C6AD4 KlAUwSstUwWUw 199.9969 rel_uw_b200 0.00 199.9969 FORMAT "%8.4"
 /begin AXIS_DESCR STD_AXIS mrfgri_w rel_uw_b200 8 0.00 199.9969 FORMAT "%8.4" DEPOSIT ABSOLUTE /end AXIS_DESCR
/end CHARACTERISTIC
/begin CHARACTERISTIC NDTHMU "untere Drehzahlschwelle f¸r Freigabe Thermostatdiagnose" VALUE 0x1CEA50 KwUb 10200. nmot_ub_q40 0.00 10200. FORMAT "%5.0" /end CHARACTERISTIC
/begin CHARACTERISTIC NMN_DUF "Drehzahl-Schwelle f¸rs Setzen der Zyklusflags der Funktions¸berwachungs-Diagnose" VALUE 0x1C2CBF KwUb 10200. nmot_ub_q40 0.00 10200. FORMAT "%5.0" /end CHARACTERISTIC
/begin CHARACTERISTIC NPSSEG "Drehzahlschwelle f¸r Umschaltung auf Segmentraster" VALUE 0x1C2DC2 KwUw 16383.75 nmot_uw_q0p25 0.00 16383.75 FORMAT "%8.2" /end CHARACTERISTIC
/begin CHARACTERISTIC NUKAO "obere Drehzahlgrenze f¸r ‹K-Adaption" VALUE 0x1C53B2 KwUb 10200. nmot_ub_q40 0.00 10200. FORMAT "%5.0" /end CHARACTERISTIC
/begin CHARACTERISTIC NUKAU "untere Drehzahlgrenze f¸r ‹K-Adaption" VALUE 0x1C53B3 KwUb 10200. nmot_ub_q40 0.00 10200. FORMAT "%5.0" /end CHARACTERISTIC
/begin CHARACTERISTIC PACE "Ersatzwert f¸r K¸hlmitteldruck der Klimaanlage" VALUE 0x1C86C0 KwUb 30000. p_q117p647 0.00 30000. FORMAT "%5.0" /end CHARACTERISTIC
/begin CHARACTERISTIC PUE "Ersatzwert f¸r Umgebungsdruck" VALUE 0x1CA4D8 KwWU16 1275.000 p_uw_q0p039 0.00 1275.000 FORMAT "%8.3" /end CHARACTERISTIC
/begin CHARACTERISTIC RKADTEVO "obere rka Schwelle f¸r passive Einschaltbedingungen Diagnose TEV" VALUE 0x1CDF46 KwSw 9.984375 rel_sw_b1536 0.00 9.984375 FORMAT "%8.6" /end CHARACTERISTIC
/begin CHARACTERISTIC RKADTEVU "untere rka Schwelle f¸r passive Einschaltbedingungen Diagnose TEV" VALUE 0x1CDF48 KwSw 9.984375 rel_sw_b1536 -9.984375 0.00 FORMAT "%8.6" /end CHARACTERISTIC
/begin CHARACTERISTIC RKBAUM "rk-Schwelle f¸r BA-Anzeige" CURVE 0x1CD7B2 GklWSw 1535.953 rel_sw_q0p0468 0.00 1535.953 FORMAT "%8.3"
 /begin AXIS_DESCR COM_AXIS tmot temp_ub_q0p75_o48 9 -48.00 143.3 AXIS_PTS_REF STM09ESUB /end AXIS_DESCR
/end CHARACTERISTIC
/begin CHARACTERISTIC RKUKKLU "Schwelle Summe Kurz-/Langzeitanteil" VALUE 0x1C5322 KwSw 3071.953 rel_sw_q0p0468 -1536.000 1535.953 FORMAT "%8.3" /end CHARACTERISTIC
/begin CHARACTERISTIC RKUKKTUBA "Schwelle f¸r Erkennung UK-Aktivit‰t (Kurzzeitanteil) BA" VALUE 0x1C53C0 KwSw 6143.813 rel_sw_q0p1875 0.00 6143.813 FORMAT "%8.3" /end CHARACTERISTIC
/begin CHARACTERISTIC RKUKKTUVA "Schwelle f¸r Erkennung UK-Aktivit‰t (Kurzzeitanteil) VA" VALUE 0x1C53C2 KwSw 6144.000 rel_sw_q0p1875 -6144.000 0.00 FORMAT "%8.3" /end CHARACTERISTIC
/begin CHARACTERISTIC RKVAUM "rk-Schwelle f¸r VA-Anzeige" CURVE 0x1CD7C4 GklWSw 1536.000 rel_sw_q0p0468 -1536.000 0.00 FORMAT "%8.3"
 /begin AXIS_DESCR COM_AXIS tmot temp_ub_q0p75_o48 9 -48.00 143.3 AXIS_PTS_REF STM09ESUB /end AXIS_DESCR
/end CHARACTERISTIC
/begin CHARACTERISTIC RLUKAO "obere Lastgrenze f¸r ‹K-Adaption" VALUE 0x1C53B4 KwUb 191.3 rel_ub_q0p75 0.00 191.3 FORMAT "%5.1" /end CHARACTERISTIC
/begin CHARACTERISTIC RLUKAU "untere Lastgrenze f¸r ‹K-Adaption" VALUE 0x1C53B5 KwUb 191.3 rel_ub_q0p75 0.00 191.3 FORMAT "%5.1" /end CHARACTERISTIC
/begin CHARACTERISTIC RMSTEVIO "Schwelle relativer Massenstrom f¸r i.O. Erkennung" VALUE 0x1CDF4A KwUw 199.9969 rel_uw_b200 0.00 199.9969 FORMAT "%8.4" /end CHARACTERISTIC
/begin CHARACTERISTIC RMSTEVMN "Minimalwert relativer Massenstrom TEV" VALUE 0x1CDF4C KwSw 399.9939 rel_sw_b200 -200.0000 199.9939 FORMAT "%8.4" /end CHARACTERISTIC
/begin CHARACTERISTIC RMSTEVMX "Maximalwert relativer Massenstrom TEV" VALUE 0x1CDF4E KwSw 399.9939 rel_sw_b200 -200.0000 199.9939 FORMAT "%8.4" /end CHARACTERISTIC
/begin AXIS_PTS SIM06ESUW "SST-Verteilung f¸r integrierten Luftmassenstrom ab Startende" 0x1CEEF4 imlatm_w SstAUwSstUw 23.30133 m_uw_b23p3 6 0.00 23.30133 FORMAT "%8.5" DEPOSIT ABSOLUTE /end AXIS_PTS
/begin AXIS_PTS SKS06ESUB "SST-Verteilung f¸r den Startadaptionsfaktor kstaa" 0x1C6744 kstaa SstAUbSstUb 1.992 fak_ub_b2 6 0.00 1.992 FORMAT "%5.3" DEPOSIT ABSOLUTE /end AXIS_PTS
/begin AXIS_PTS SLA05ESUB "St¸tzstellenverteilung Regelabweichung Lambda, 5 Sst." 0x1C68BC ladiff_w SstAUwSstUw 1.999969 fak_sw_b1 5 0.00 1.999969 FORMAT "%8.6" DEPOSIT ABSOLUTE /end AXIS_PTS
/begin AXIS_PTS SNM06ESUB "SST-Verteilung f¸r Drehzahl" 0x1CEDE8 nmot SstAUbSstUb 10200. nmot_ub_q40 6 0.00 10200. FORMAT "%5.0" DEPOSIT ABSOLUTE /end AXIS_PTS
/begin AXIS_PTS SNM07ESUB "St¸tzstellenverteilung Drehzahl, 7 Sst." 0x1CEDF0 nmot SstAUbSstUb 10200. nmot_ub_q40 7 0.00 10200. FORMAT "%5.0" DEPOSIT ABSOLUTE /end AXIS_PTS
/begin AXIS_PTS SNM08GKUW "St¸tzstellenverteilung Gemischkontrolle 8 nmot_w St¸tzstellen" 0x1C5620 nmot_w SstAUwSstUw 16383.75 nmot_uw_q0p25 8 0.00 16383.75 FORMAT "%8.2" DEPOSIT ABSOLUTE /end AXIS_PTS
/begin AXIS_PTS SNM12FEUB "St¸tzstellen f¸r WDKSMX, WDKUGDN" 0x1C67B0 nmot SstAUbSstUb 10200. nmot_ub_q40 12 0.00 10200. FORMAT "%5.0" DEPOSIT ABSOLUTE /end AXIS_PTS
/begin AXIS_PTS SRL08GKUB "St¸tzstellenverteilung Gemischkontrolle 8 rl St¸tzstellen" 0x1C5604 rl SstAUbSstUb 191.3 rel_ub_q0p75 8 0.00 191.3 FORMAT "%5.1" DEPOSIT ABSOLUTE /end AXIS_PTS
/begin AXIS_PTS SRP06ESUB "SST-Verteilung f¸r rel. Luftf¸llung pr‰d. f¸r Einspritzung" 0x1C6854 rlp SstAUbSstUb 191.3 rel_ub_q0p75 6 0.00 191.3 FORMAT "%5.1" DEPOSIT ABSOLUTE /end AXIS_PTS
/begin AXIS_PTS STA06ESUB "SST-Verteilung f¸r die Ansauglufttemperatur" 0x1CEE68 tans SstAUbSstUb 191.3 temp_ub_q0p75_o48 6 -48.00 143.3 FORMAT "%5.1" DEPOSIT ABSOLUTE /end AXIS_PTS
/begin AXIS_PTS STM09ESUB "St¸tzstellenverteilung Motortemperatur, 9 Sst." 0x1CEEB0 tmot SstAUbSstUb 191.3 temp_ub_q0p75_o48 9 -48.00 143.3 FORMAT "%5.1" DEPOSIT ABSOLUTE /end AXIS_PTS
/begin AXIS_PTS STM12ESUB "SST-Verteilung f¸r die Motortemperatur tmot" 0x1CEEC8 tmot SstAUbSstUb 191.3 temp_ub_q0p75_o48 12 -48.00 143.3 FORMAT "%5.1" DEPOSIT ABSOLUTE /end AXIS_PTS
/begin AXIS_PTS STS08ESUB "SST-Verteilung f¸r Motorstarttemperatur" 0x1C687C tmst SstAUbSstUb 191.3 temp_ub_q0p75_o48 8 -48.00 143.3 FORMAT "%5.1" DEPOSIT ABSOLUTE /end AXIS_PTS
/begin AXIS_PTS STS12ESUB "SST-Verteilung f¸r Motorstarttemperatur" 0x1C6888 tmst SstAUbSstUb 191.3 temp_ub_q0p75_o48 12 -48.00 143.3 FORMAT "%5.1" DEPOSIT ABSOLUTE /end AXIS_PTS
/begin CHARACTERISTIC SZANSSM1 "Absteuerungsfaktorumschaltschwelle 1 f¸r Nachstartfaktor" CURVE 0x1CD4A4 GklWUb 0.9961 fak_ub_b1 0.00 0.9961
 /begin AXIS_DESCR COM_AXIS tmst temp_ub_q0p75_o48 12 -48.00 143.3 AXIS_PTS_REF STS12ESUB /end AXIS_DESCR
/end CHARACTERISTIC
/begin CHARACTERISTIC SZANSSM2 "Absteuerungsfaktorumschaltschwelle 2 f¸r Nachstartfaktor" CURVE 0x1CD4B0 GklWUb 0.9961 fak_ub_b1 0.00 0.9961
 /begin AXIS_DESCR COM_AXIS tmst temp_ub_q0p75_o48 12 -48.00 143.3 AXIS_PTS_REF STS12ESUB /end AXIS_DESCR
/end CHARACTERISTIC
/begin CHARACTERISTIC TABSTTHM "Schwelle Abstellzeit f¸r Freigabe Thermostat-Diagnose" VALUE 0x1CEA9A KwUw 65535.00 t1sxs_uw_b65535 0.00 65535.00 FORMAT "%8.2" /end CHARACTERISTIC
/begin CHARACTERISTIC TADTEAMX "Kennlinie Max. tastverh‰ltnis abh‰ngig vom Integral Massenstrom TE nach TE Stop" CURVE 0x1CDEDC KlAUbSstUbWUb 99.61 rel_ub_b99p6 0.00 99.61 FORMAT "%5.2"
 /begin AXIS_DESCR STD_AXIS tdtesta t100msxs_ub_b25p5 14 0.00 25.50 FORMAT "%5.2" DEPOSIT ABSOLUTE /end AXIS_DESCR
/end CHARACTERISTIC
/begin CHARACTERISTIC TADTEMX "Tastverh‰ltnisschwelle f¸r aktive Pr¸fung" VALUE 0x1CDEF9 KwUb 89.84 rel_ub_b99p6 9.766 99.61 FORMAT "%5.2" /end CHARACTERISTIC
/begin CHARACTERISTIC TANDT "Schwelle Temperaturdifferenz Ansaugluft f¸r Heiﬂstart" CURVE 0x1C524C KlAUbSstUbWUb 191.3 temp_ub_b191p25 0.00 191.3 FORMAT "%5.1"
 /begin AXIS_DESCR STD_AXIS tansab temp_ub_q0p75_o48 8 -48.00 143.3 FORMAT "%5.1" DEPOSIT ABSOLUTE /end AXIS_DESCR
/end CHARACTERISTIC
/begin CHARACTERISTIC TANH "Ansauglufttemperatur - Schwelle heiﬂ" VALUE 0x1C525D KwUb 191.3 temp_ub_q0p75_o48 -48.00 143.3 FORMAT "%5.1" /end CHARACTERISTIC
/begin CHARACTERISTIC TC6CTHM "Mode 6: Component ID f¸r Pr¸fung K¸hlwasserthermostat" VALUE 0x1CEA51 KwUb 126.0 dez 1.000 127.0 FORMAT "%5.1" /end CHARACTERISTIC
/begin CHARACTERISTIC TC6TECI "Mode 6 Codewort f¸r i.O. Pr¸fung des TEVs aus DLDP" VALUE 0x1CDEFA KwUb 127.0 dez 0.00 127.0 FORMAT "%5.1" /end CHARACTERISTIC
/begin CHARACTERISTIC TC6TECL "Mode 6 Codewort f¸r i.O. Pr¸fung des TEVs aus Luft-Pr¸fung" VALUE 0x1CDEFB KwUb 127.0 dez 0.00 127.0 FORMAT "%5.1" /end CHARACTERISTIC
/begin CHARACTERISTIC TC6TECNL "Mode 6 Codewort f¸r NICHT i.O. Pr¸fung des TEVs aus Luft-Pr¸fung" VALUE 0x1CDEFC KwUb 127.0 dez 0.00 127.0 FORMAT "%5.1" /end CHARACTERISTIC
/begin CHARACTERISTIC TC6TECP "Mode 6 Codewort f¸r passive i.O. Pr¸fung des TEVs" VALUE 0x1CDEFD KwUb 127.0 dez 0.00 127.0 FORMAT "%5.1" /end CHARACTERISTIC
/begin CHARACTERISTIC TC6TECRF "Mode 6 Codewort f¸r i.O. Pr¸fung des TEVs aus FR-Abweichung Richtung fett" VALUE 0x1CDEFE KwUb 127.0 dez 0.00 127.0 FORMAT "%5.1" /end CHARACTERISTIC
/begin CHARACTERISTIC TC6TECRM "Mode 6 Codewort f¸r i.O. Pr¸fung des TEVs aus FR-Abweichung Richtung mager" VALUE 0x1CDEFF KwUb 127.0 dez 0.00 127.0 FORMAT "%5.1" /end CHARACTERISTIC
/begin CHARACTERISTIC TC6TECT "Mode 6 Codewort f¸r i.O. Pr¸fung des TEVs aus DLDP" VALUE 0x1CDF00 KwUb 127.0 dez 0.00 127.0 FORMAT "%5.1" /end CHARACTERISTIC
/begin CHARACTERISTIC TCEKP "‹berwachung CAN time out f¸r EKP-Abschaltung" VALUE 0x1C2CC0 KwUb 2.550 t10msxs_ub_b2p55 0.00 2.550 FORMAT "%5.3" /end CHARACTERISTIC
/begin CHARACTERISTIC TDDFAC "Entprellzeit f¸r Fehlereintrag Druckksensor AC" VALUE 0x1C86C1 KwUb 25.50 t100msxs_ub_b25p5 0.00 25.50 FORMAT "%5.2" /end CHARACTERISTIC
/begin CHARACTERISTIC TDDFU "Entprellzeit f¸r Fehlereintrag Druckksensor Umgebung" VALUE 0x1CA4DD KwWU8 25.50 t_q0p1 0.00 25.50 FORMAT "%5.2" /end CHARACTERISTIC
/begin CHARACTERISTIC TDTEFA "Zeit f¸r Sperre DTEV ab Start bei Testeranforderung" VALUE 0x1CDF50 KwUw 180.0000 t100msxs_uw_b6553p6 20.00000 200.0000 FORMAT "%8.4" /end CHARACTERISTIC
/begin CHARACTERISTIC TDTESZO "Zeit ab Startende f¸r schnelle Sp¸lratenabsteuerung DTEV bei B_ll = TRUE inaktiv" VALUE 0x1CDF52 KwUw 6553.500 t100msxs_uw_b6553p6 0.00 6553.500 FORMAT "%8.3" /end CHARACTERISTIC
/begin CHARACTERISTIC TDTESZU "Zeit ab Startende f¸r Aktivierung Sp¸lratenabsteuerung DTEV bei B_ll = TRUE" VALUE 0x1CDF54 KwUw 6553.500 t100msxs_uw_b6553p6 0.00 6553.500 FORMAT "%8.3" /end CHARACTERISTIC
/begin CHARACTERISTIC TDTEZAM "Zeit ab Start f¸r aktive DTEV mˆglich" VALUE 0x1CDF56 KwUw 6553.500 t100msxs_uw_b6553p6 0.00 6553.500 FORMAT "%8.3" /end CHARACTERISTIC
/begin CHARACTERISTIC TDTHM "Entprellzeit Fehlererkennung Thermostat" VALUE 0x1CEA52 KwUb 25.50 t100msxs_ub_b25p5 0.00 25.50 FORMAT "%5.2" /end CHARACTERISTIC
/begin CHARACTERISTIC TDTHMO "obere Temp.-Schwelle (tans/tum) f¸r Thermostatdiagnose" VALUE 0x1CEA53 KwUb 191.3 temp_ub_q0p75_o48 -48.00 143.3 FORMAT "%5.1" /end CHARACTERISTIC
/begin CHARACTERISTIC TDTHMU "untere Temp.-Schwelle (tans/tum) f¸r Thermostatdiagnose" VALUE 0x1CEA54 KwUb 191.3 temp_ub_q0p75_o48 -48.00 143.3 FORMAT "%5.1" /end CHARACTERISTIC
/begin CHARACTERISTIC TFGRARLG "Rampenlaufzeit bei langsamer FGR-Abschaltung" CURVE 0x1CF130 KlAUbSstUbWUb 5.100 t20msxs_ub_b5p1 0.00 5.100 FORMAT "%5.3"
 /begin AXIS_DESCR STD_AXIS gangi dez 8 0.00 255.0 FORMAT "%5.1" DEPOSIT ABSOLUTE /end AXIS_DESCR
/end CHARACTERISTIC
/begin CHARACTERISTIC TFGRTP "Zeit f¸r Tip-Erkennung bei FGR-Bedientasten" VALUE 0x1C69D8 KwUb 5.080 t20msxs_ub_b5p1 0.02000 5.100 FORMAT "%5.3" /end CHARACTERISTIC
/begin CHARACTERISTIC TFRMDTEE "Erkennungszeit f¸r eingeschwungene frm" VALUE 0x1CDF01 KwUb 3.000 t100msxs_ub_b25p5 0.00 3.000 FORMAT "%5.3" /end CHARACTERISTIC
/begin CHARACTERISTIC TFWDKPSPV "Zeit f¸r Soll-Drosselklappenfilterung (abh‰ngig von Druckverh‰ltnis an DK)" CURVE 0x1C396E KlAUwSstUwWUw 655.350000 zk10msxs_uw_b655 0.0100001526 655.360000 FORMAT "%10.6"
 /begin AXIS_DESCR STD_AXIS pspvds_w fak_uw_b2 4 0.00 1.999969 FORMAT "%8.6" DEPOSIT ABSOLUTE /end AXIS_DESCR
/end CHARACTERISTIC
/begin CHARACTERISTIC THMDMMA "Anfangswert f¸r Thermostat-Temperaturmodell" VALUE 0x1CEA55 KwUb 191.3 temp_ub_q0p75_o48 -48.00 143.3 FORMAT "%5.1" /end CHARACTERISTIC
/begin CHARACTERISTIC THMDMME "Endwert f¸r Thermostat-Temperaturmodell" VALUE 0x1CEA56 KwUb 191.3 temp_ub_q0p75_o48 -48.00 143.3 FORMAT "%5.1" /end CHARACTERISTIC
/begin CHARACTERISTIC THMDMMS "Thermostat-Modelltemperatur-Gradient im Schub als f(tmdmm)" CURVE 0x1CEA9C KlAUbSstUbWSb 1.494 tempg_q0p00586 -0.7500 0.7441
 /begin AXIS_DESCR STD_AXIS thmdmm temp_ub_q0p75_o48 6 -48.00 143.3 FORMAT "%5.1" DEPOSIT ABSOLUTE /end AXIS_DESCR
/end CHARACTERISTIC
/begin CHARACTERISTIC TKRF "Flugzeit von Einspritzventil bis Einlassventil" VALUE 0x1CD781 KwUb 25.50 txms_ub_q0p1 0.00 25.50 FORMAT "%5.2" /end CHARACTERISTIC
/begin CHARACTERISTIC TMDTEU "Untere Motortemperaturschwelle f¸r Tankentl¸ftungsdiagnose" VALUE 0x1CDF02 KwUb 63.75 temp_ub_q0p75_o48 27.00 90.75 FORMAT "%5.2" /end CHARACTERISTIC
/begin CHARACTERISTIC TMEWDTEU "Untere Temperaturschwelle f¸r TE-Diagnose bezogen auf modellierte Motortemp." VALUE 0x1CDF03 KwUb 191.3 temp_ub_q0p75_o48 -48.00 143.3 FORMAT "%5.1" /end CHARACTERISTIC
/begin CHARACTERISTIC TMH "Motortemperatur - Schwelle heiﬂ" VALUE 0x1C525E KwUb 191.3 temp_ub_q0p75_o48 -48.00 143.3 FORMAT "%5.1" /end CHARACTERISTIC
/begin CHARACTERISTIC TMHSG "Motortemperatur Heiﬂstartgrenze" VALUE 0x1C525F KwUb 191.3 temp_ub_q0p75_o48 -48.00 143.3 FORMAT "%5.1" /end CHARACTERISTIC
/begin CHARACTERISTIC TMK "Motortemperatur - Schwelle kalt" VALUE 0x1C5260 KwUb 191.3 temp_ub_q0p75_o48 -48.00 143.3 FORMAT "%5.1" /end CHARACTERISTIC
/begin CHARACTERISTIC TMNUUKA "Minimalzeit zwischen 2 Adaptionsvorg‰ngen (‹K-Adaption)" VALUE 0x1C53B6 KwUb 1.850 t10msxs_ub_b2p55 0.7000 2.550 FORMAT "%5.3" /end CHARACTERISTIC
/begin CHARACTERISTIC TMODT "Schwelle Temperaturdifferenz Wassertemperatur f¸r Heiﬂstart" CURVE 0x1C5264 KlAUbSstUbWUb 191.3 temp_ub_b191p25 0.00 191.3 FORMAT "%5.1"
 /begin AXIS_DESCR STD_AXIS tmotab temp_ub_q0p75_o48 3 -48.00 143.3 FORMAT "%5.1" DEPOSIT ABSOLUTE /end AXIS_DESCR
/end CHARACTERISTIC
/begin CHARACTERISTIC TMORSTE "Obere Temperaturschwelle resetieren B_stendes bei B_stend = false" VALUE 0x1C526B KwUb 191.3 temp_ub_q0p75_o48 -48.00 143.3 FORMAT "%5.1" /end CHARACTERISTIC
/begin CHARACTERISTIC TMSDTHMU "untere Motorstart-Temp.-Schwelle f¸r Thermostatdiagnose" VALUE 0x1CEA57 KwUb 191.3 temp_ub_q0p75_o48 -48.00 143.3 FORMAT "%5.1" /end CHARACTERISTIC
/begin CHARACTERISTIC TMUDTEU "Untere Umgebungstmperaturschwelle f¸r Tankentl¸ftungsdiagnose" VALUE 0x1CDF04 KwUb 191.3 temp_ub_q0p75_o48 -48.00 143.3 FORMAT "%5.1" /end CHARACTERISTIC
/begin CHARACTERISTIC TMUKAK "Temperaturbereich kalter Motor f¸r ‹K-Adaption" VALUE 0x1C53B7 KwUb 191.3 temp_ub_q0p75_o48 -48.00 143.3 FORMAT "%5.1" /end CHARACTERISTIC
/begin CHARACTERISTIC TMUKAU "untere Motortemperatur-Grenze f¸r ‹K-Adaption" VALUE 0x1C53B8 KwUb 191.3 temp_ub_q0p75_o48 -48.00 143.3 FORMAT "%5.1" /end CHARACTERISTIC
/begin CHARACTERISTIC TMUKAW "Temperaturbereich warmer Motor f¸r ‹K-Adaption" VALUE 0x1C53B9 KwUb 191.3 temp_ub_q0p75_o48 -48.00 143.3 FORMAT "%5.1" /end CHARACTERISTIC
/begin CHARACTERISTIC TMURSTE "Untere Temperaturschwelle resetieren B_stendes bei B_stend = false" VALUE 0x1C526C KwUb 191.3 temp_ub_q0p75_o48 -48.00 143.3 FORMAT "%5.1" /end CHARACTERISTIC
/begin CHARACTERISTIC TMWUC "Motortemperaturschwelle f¸r Erf¸llung 'warm up cycle'" VALUE 0x1C3CDC KwUb 191.3 temp_ub_q0p75_o48 -48.00 143.3 FORMAT "%5.1" /end CHARACTERISTIC
/begin CHARACTERISTIC TMWUCST "max. Motortemperatur im Start f¸r Erf¸llung 'warm up cycle'" VALUE 0x1C3CDD KwUb 191.3 temp_ub_q0p75_o48 -48.00 143.3 FORMAT "%5.1" /end CHARACTERISTIC
/begin CHARACTERISTIC TN2FGRGA "Doppelte Nennerzeitkonstante f¸r FGR-Regler" CURVE 0x1CF230 KlAUwSstUwWUw 1310.700 t20msxs_uw_q0p02 0.00 1310.700 FORMAT "%8.3"
 /begin AXIS_DESCR STD_AXIS gangi dez 8 0.00 65535.00 FORMAT "%8.2" DEPOSIT ABSOLUTE /end AXIS_DESCR
/end CHARACTERISTIC
/begin CHARACTERISTIC TNSUUK "Zeit UK-Unterdr¸ckung im Nachstart" VALUE 0x1C52E5 KwUb 25.50 t100msxs_ub_b25p5 0.00 25.50 FORMAT "%5.2" /end CHARACTERISTIC
/begin CHARACTERISTIC TNSUUKA "Verbotszeit ‹K-Adaption im Nachstart" VALUE 0x1C53C4 KwUw 655.3500 t10msxs_uw_b655p35 0.00 655.3500 FORMAT "%8.4" /end CHARACTERISTIC
/begin CHARACTERISTIC TPERDTE "Zeit f¸r Wiederholung DTEV bei Dauerleerlauf" VALUE 0x1CDF05 KwUb 25.50 t100msxs_ub_b25p5 0.00 25.50 FORMAT "%5.2" /end CHARACTERISTIC
/begin CHARACTERISTIC TPUKUKA "Entprellzeit f¸r Erkennung ‹K-Eingriff (‹K-Adaption)" VALUE 0x1C53BA KwUb 2.550 t10msxs_ub_b2p55 0.00 2.550 FORMAT "%5.3" /end CHARACTERISTIC
/begin CHARACTERISTIC TSPUUKA "Sperrzeit fuer Freigabe UK-Adaption" VALUE 0x1C53BB KwUb 24.50 t100msxs_ub_b25p5 1.000 25.50 FORMAT "%5.2" /end CHARACTERISTIC
/begin CHARACTERISTIC TSWKNBGA "Zeit bis Setzwertkorrektur nach Ende Beschleunigen" CURVE 0x1CF252 KlAUwSstUwWUw 1310.700 t20msxs_uw_q0p02 0.00 1310.700 FORMAT "%8.3"
 /begin AXIS_DESCR STD_AXIS gangi dez 8 0.00 65535.00 FORMAT "%8.2" DEPOSIT ABSOLUTE /end AXIS_DESCR
/end CHARACTERISTIC
/begin CHARACTERISTIC TSWKNVGA "Zeit bis Setzwertkorrektur nach Ende Verzˆgern" CURVE 0x1CF274 KlAUwSstUwWUw 1310.700 t20msxs_uw_q0p02 0.00 1310.700 FORMAT "%8.3"
 /begin AXIS_DESCR STD_AXIS gangi dez 8 0.00 65535.00 FORMAT "%8.2" DEPOSIT ABSOLUTE /end AXIS_DESCR
/end CHARACTERISTIC
/begin CHARACTERISTIC TTEVAZ "Verweilzeit f¸r TEV Aufsteuern bei nicht eingeschwungen frm" VALUE 0x1CDF06 KwUb 10.00 t100msxs_ub_b25p5 0.00 10.00 FORMAT "%5.2" /end CHARACTERISTIC
/begin CHARACTERISTIC TVAG "Zeit f¸r Gewichtungsfaktor VA aktiv" VALUE 0x1CD782 KwUb 25.50 t100msxs_ub_b25p5 0.00 25.50 FORMAT "%5.2" /end CHARACTERISTIC
/begin CHARACTERISTIC TVDTEABG "Verzˆgerungszeit zwischen Motor und Lambdasonde" VALUE 0x1CDF07 KwUb 2.000 t100msxs_ub_b25p5 0.00 2.000 FORMAT "%5.3" /end CHARACTERISTIC
/begin CHARACTERISTIC TVDTEB "Verzˆgerungszeit ab TEV offen f¸r Aussage TEV i.O./defekt in Diagnose DTEV" VALUE 0x1CDF08 KwUb 10.00 t100msxs_ub_b25p5 0.00 10.00 FORMAT "%5.2" /end CHARACTERISTIC
/begin CHARACTERISTIC TVDTEE "Zeitdauer ab TEV offen f¸r Pr¸fung DTEV" VALUE 0x1CDF09 KwUb 12.00 t100msxs_ub_b25p5 3.000 15.00 FORMAT "%5.2" /end CHARACTERISTIC
/begin CHARACTERISTIC TVDTELLA "Mindestzzeit f¸r Aktivierungsbedingungen f¸r Aufsteuerpr¸fung DTEV erf¸llt" VALUE 0x1CDF0A KwUb 9.500 t100msxs_ub_b25p5 0.5000 10.00 FORMAT "%5.2" /end CHARACTERISTIC
/begin CHARACTERISTIC TVDTEVP "Entprellung f¸r Setzen Flip-Flop Passiv-Pr¸fung DTEV i.O." VALUE 0x1CDF0B KwUb 19.00 t100msxs_ub_b25p5 1.000 20.00 FORMAT "%5.2" /end CHARACTERISTIC
/begin CHARACTERISTIC TVDTEVPM "Entprellung f¸r Setzen Flip-Flop ""Diagnose passiv mˆglich""" VALUE 0x1CDF0C KwUb 19.00 t100msxs_ub_b25p5 1.000 20.00 FORMAT "%5.2" /end CHARACTERISTIC
/begin CHARACTERISTIC TVDTEVZ "Verzˆgerungszeit f¸r Schlieﬂen TEV f¸r Aufsteuerpr¸fung DTEV" VALUE 0x1CDF0D KwUb 10.00 t100msxs_ub_b25p5 0.00 10.00 FORMAT "%5.2" /end CHARACTERISTIC
/begin CHARACTERISTIC TVFRG "Verzˆgerundszeit nach Satrtende bis zur Freigabe des F¸llungsreglers" VALUE 0x1CA8DA KwUw 655.3500 t10msxs_uw_b655p35 0.00 655.3500 FORMAT "%8.4" /end CHARACTERISTIC
/begin CHARACTERISTIC TVLADV "Zeitkonstante f¸r Integrator bei vlast-Berechnung" CURVE 0x1C6AF6 KlAUwSstSwWUw 1309.98001 zk20msxs_uw_b1310 0.0199893187 1310.00000 FORMAT "%10.5"
 /begin AXIS_DESCR STD_AXIS dvzvi_w vfzg_sw_q0p00781 8 -256.0000 255.9922 FORMAT "%8.4" DEPOSIT ABSOLUTE /end AXIS_DESCR
/end CHARACTERISTIC
/begin CHARACTERISTIC TVWDKS "Verzˆgerungszeit f¸r Drosselklappen-Sollwinkel" VALUE 0x1C39CB KwUb 2.550 t10msxs_ub_b2p55 0.00 2.550 FORMAT "%5.3" /end CHARACTERISTIC
/begin CHARACTERISTIC TWADTHMS "Zeit, starttemperaturabh‰ngig, f¸r Anhalten Temperaturmodell Thermostatdiagnose" CURVE 0x1CEA58 KlAUbSstUbWUb 25.50 t100msxs_ub_b25p5 0.00 25.50 FORMAT "%5.2"
 /begin AXIS_DESCR STD_AXIS tmst temp_ub_q0p75_o48 6 -48.00 143.3 FORMAT "%5.1" DEPOSIT ABSOLUTE /end AXIS_DESCR
/end CHARACTERISTIC
/begin CHARACTERISTIC TWSTT "Schwelle Abstellzeit f¸r Wiederholstart" CURVE 0x1C52B2 KlAUwSstUwWUw 65535.00 t1sxs_uw_q1 0.00 65535.00 FORMAT "%8.2"
 /begin AXIS_DESCR STD_AXIS tmotab temp_ub_q0p75_o48 12 -48.00000 49103.25 FORMAT "%8.2" DEPOSIT ABSOLUTE /end AXIS_DESCR
/end CHARACTERISTIC
/begin CHARACTERISTIC TZ2FGRGA "Doppelte Z‰hlerzeitkonstante f¸r FGR-Regler" CURVE 0x1CF296 KlAUwSstUwWUw 1310.700 t20msxs_uw_q0p02 0.00 1310.700 FORMAT "%8.3"
 /begin AXIS_DESCR STD_AXIS gangi dez 8 0.00 65535.00 FORMAT "%8.2" DEPOSIT ABSOLUTE /end AXIS_DESCR
/end CHARACTERISTIC
/begin CHARACTERISTIC UADPACMN "min. Spannungswert f¸r Diagnose Drucksensor AC" VALUE 0x1C86C2 KwUb 4.980 spg_ub_q0p019 0.00 4.980 FORMAT "%5.3" /end CHARACTERISTIC
/begin CHARACTERISTIC UADPACMX "max. Spannungswert f¸r Diagnose Drucksensor AC" VALUE 0x1C86C3 KwUb 4.980 spg_ub_q0p019 0.00 4.980 FORMAT "%5.3" /end CHARACTERISTIC
/begin CHARACTERISTIC UADPUMN "min. Spannungswert f¸r Diagnose Drucksensor" VALUE 0x1CA4DE KwWU8 4.980 spg_ub_q0p019 0.00 4.980 FORMAT "%5.3" /end CHARACTERISTIC
/begin CHARACTERISTIC UADPUMX "max. Spannungswert f¸r Diagnose Drucksensor" VALUE 0x1CA4DF KwWU8 4.980 spg_ub_q0p019 0.00 4.980 FORMAT "%5.3" /end CHARACTERISTIC
/begin CHARACTERISTIC UKAFRTMO "Obere Schwelle Faktor Lambdaregler (fr) zur Freigabe der UK-Adaption" CURVE 0x1CD818 GklWUw 1.999969 fak_uw_b2 0.00 1.999969 FORMAT "%8.6"
 /begin AXIS_DESCR COM_AXIS tmot temp_ub_q0p75_o48 9 -48.00 143.3 AXIS_PTS_REF STM09ESUB /end AXIS_DESCR
/end CHARACTERISTIC
/begin CHARACTERISTIC UKAFRTMU "Untere Schwelle Faktor Lambdaregler (fr) zur Freigabe der UK-Adaption" CURVE 0x1CD82A GklWUw 1.999969 fak_uw_b2 0.00 1.999969 FORMAT "%8.6"
 /begin AXIS_DESCR COM_AXIS tmot temp_ub_q0p75_o48 9 -48.00 143.3 AXIS_PTS_REF STM09ESUB /end AXIS_DESCR
/end CHARACTERISTIC
/begin AXIS_PTS VCANV16 "St¸tzstellenverteilung v_can" 0x1D1918 Veh_Spd dc_SstAUwSstUw 4095.938 DC_VEHSPD_KMH_U16 16 0.00 4095.938 FORMAT "%8.3" DEPOSIT ABSOLUTE /end AXIS_PTS
/begin CHARACTERISTIC VDTHMU "untere Geschwindigkeitsschwelle f¸r Freigabe Thermostatdiagnose" VALUE 0x1CEA65 KwUb 318.8 vfzg_ub_q1p25 0.00 318.8 FORMAT "%5.1" /end CHARACTERISTIC
/begin CHARACTERISTIC VLMXVZ "Maximalwert f¸r vlast_w" CURVE 0x1C6B18 KlAUwSstUwWUw 511.9844 vfzg_uw_b512 0.007812500 511.9922 FORMAT "%8.4"
 /begin AXIS_DESCR STD_AXIS vziel_w vfzg_uw_b512 6 0.00 511.9922 FORMAT "%8.4" DEPOSIT ABSOLUTE /end AXIS_DESCR
/end CHARACTERISTIC
/begin CHARACTERISTIC WDKMSN "Drosselklappen-Sollwinkel" CURVE 0x1C3980 KlAUwSstUwWUw 99.99847 rel_uw_b100 0.00 99.99847 FORMAT "%8.5"
 /begin AXIS_DESCR STD_AXIS msndkoug_w m_uw_b6553p5 16 0.00 6553.500 FORMAT "%8.3" DEPOSIT ABSOLUTE /end AXIS_DESCR
/end CHARACTERISTIC
/begin CHARACTERISTIC WDKSAPP "Drosselklappensollwert f¸r Applikationszwecke" VALUE 0x1C39C2 KwUw 99.99847 rel_uw_b100 0.00 99.99847 FORMAT "%8.5" /end CHARACTERISTIC
/begin CHARACTERISTIC WDKSHYS "Drosselklappen-Hystereseschwelle f¸r Aktivierung/Deaktivierung ‹berweg" VALUE 0x1C39C4 KwUw 99.99847 rel_uw_b100 0.00 99.99847 FORMAT "%8.5" /end CHARACTERISTIC
/begin CHARACTERISTIC WDKSOFS "Offset zu appl. DK-Sollwinkel bei niedrigen Temperaturen" VALUE 0x1C39C6 KwUw 99.99847 rel_uw_b100 0.00 99.99847 FORMAT "%8.5" /end CHARACTERISTIC
/begin CHARACTERISTIC WDKUGDN "KL Drosselklappenwinkel, ab der keine Drosselung mehr erfolgt" CURVE 0x1C391C GklWUb 99.61 rel_ub_b100 0.00 99.61 FORMAT "%5.2"
 /begin AXIS_DESCR COM_AXIS nmot nmot_ub_q40 12 0.00 10200. AXIS_PTS_REF SNM12FEUB /end AXIS_DESCR
/end CHARACTERISTIC
/begin CHARACTERISTIC WEAN "Winkel Einspritzabbruch" CURVE 0x1CD8E4 GklWUb 1530. zw_ub_q6 0.00 1530. FORMAT "%5.0"
 /begin AXIS_DESCR COM_AXIS nmot_w nmot_uw_q0p25 8 0.00 16383.75 AXIS_PTS_REF SNM08GKUW /end AXIS_DESCR
/end CHARACTERISTIC
/begin CHARACTERISTIC WEEMRFAN "Winkel Einspritzende bei maximalem Fahrerwunsch" CURVE 0x1CD8EC GklWUb 1530. zw_ub_q6 0.00 1530. FORMAT "%5.0"
 /begin AXIS_DESCR COM_AXIS nmot_w nmot_uw_q0p25 8 0.00 16383.75 AXIS_PTS_REF SNM08GKUW /end AXIS_DESCR
/end CHARACTERISTIC
/begin CHARACTERISTIC WESSOT "Winkel Einlass schliesst sp‰t bis OT" VALUE 0x1CD8F4 KwUb 717.2 kw_q2p8125 0.00 717.2 FORMAT "%5.1" /end CHARACTERISTIC
/begin CHARACTERISTIC WFLBK "Kraftstoffwandfilmkennlinie in Abh‰ngigkeit v. LBK-Stellung" CURVE 0x1C5324 FklWUw 3071.953 rel_uw_b3072 0.00 3071.953 FORMAT "%8.3"
 /begin AXIS_DESCR FIX_AXIS lbksol_w rel_uw_b100 31 0.00 12.10785 FORMAT "%8.5" FIX_AXIS_PAR 0 8 31 /end AXIS_DESCR
/end CHARACTERISTIC
/begin CHARACTERISTIC WFRL "Kraftstoffwandfilmkennlinie" CURVE 0x1C5362 FklWUw 3071.953 rel_uw_b3072 0.00 3071.953 FORMAT "%8.3"
 /begin AXIS_DESCR FIX_AXIS rlp_w rel_uw_q0p0234 31 0.00 185.9766 FORMAT "%8.4" FIX_AXIS_PAR 0 8 31 /end AXIS_DESCR
/end CHARACTERISTIC
/begin CHARACTERISTIC WLBKMN "Minimaler Wert d. LBK zur Umschaltung der Aufteilungsfaktoren" VALUE 0x1CD7D6 KwUw 99.99847 rel_uw_b100 0.00 99.99847 FORMAT "%8.5" /end CHARACTERISTIC
/begin CHARACTERISTIC ZBAKM "Abregelfaktor K-Speicher (tmot) BA" CURVE 0x1CD784 GklWUb 0.9961 fak_q0p0039 0.00 0.9961
 /begin AXIS_DESCR COM_AXIS tmot temp_ub_q0p75_o48 9 -48.00 143.3 AXIS_PTS_REF STM09ESUB /end AXIS_DESCR
/end CHARACTERISTIC
/begin CHARACTERISTIC ZBALM "Abregelfaktor L-Speicher (tmot) BA" CURVE 0x1CD790 GklWUb 0.1245 fak_ub_b0p125 0.00 0.1245 FORMAT "%6.4"
 /begin AXIS_DESCR COM_AXIS tmot temp_ub_q0p75_o48 9 -48.00 143.3 AXIS_PTS_REF STM09ESUB /end AXIS_DESCR
/end CHARACTERISTIC
/begin CHARACTERISTIC ZBURNLIM "Schwelle erkannte Verbrennungen f¸r Wiederholstart" VALUE 0x1C526D KwUb 255.0 dez 0.00 255.0 FORMAT "%5.1" /end CHARACTERISTIC
/begin CHARACTERISTIC ZDGZA1 "Z¸ndungszahl Abregelung Bereich 1" VALUE 0x1C510C KwUb 255.0 dez 0.00 255.0 FORMAT "%5.1" /end CHARACTERISTIC
/begin CHARACTERISTIC ZDGZA2 "Z¸ndungszahl Abregelung Bereich 2" VALUE 0x1C510D KwUb 255.0 dez 0.00 255.0 FORMAT "%5.1" /end CHARACTERISTIC
/begin CHARACTERISTIC ZDGZA3 "Z¸ndungszahl Abregelung Bereich 3" VALUE 0x1C510E KwUb 255.0 dez 0.00 255.0 FORMAT "%5.1" /end CHARACTERISTIC
/begin CHARACTERISTIC ZDSU "Zeitkonstante f¸r Filterung von pu und fho in GGDSU" VALUE 0x1CA4DA KwWU16 6553.50000 zk100msxs_uw_b6553 0.100001526 6553.60000 FORMAT "%10.5" /end CHARACTERISTIC
/begin CHARACTERISTIC ZFRMFIL "Filterzeitkonstante Lambdareglergrˆﬂen" VALUE 0x1CDF58 KwUw 5.90696456 zk100msxs_uw_b6553 0.100001526 6.00696609 FORMAT "%10.8" /end CHARACTERISTIC
/begin CHARACTERISTIC ZFRMXAF "Filterzeitkonstante f¸r frmxa_w Signal" VALUE 0x1CDF5A KwUw 6553.50000 zk100msxs_uw_b6553 0.100001526 6553.60000 FORMAT "%10.5" /end CHARACTERISTIC
/begin CHARACTERISTIC ZKRMSTEV "Zeitkonstante Tiefpaﬂfilterung f¸r Mode 6 DTEV" VALUE 0x1CDF5C KwUw 60.0247691 zk100msxs_uw_b6553 0.100001526 60.1247706 FORMAT "%10.7" /end CHARACTERISTIC
/begin CHARACTERISTIC ZMLETAN "Zeitkonstante f¸r Filterung zur Berechnung des Leerlaufenergiebedarf f¸r DTEV" VALUE 0x1CDF5E KwUw 9.90549466 zk100msxs_uw_b6553 0.100001526 10.0054962 FORMAT "%10.7" /end CHARACTERISTIC
/begin CHARACTERISTIC ZMSTEDTE "Zeitkonstante f¸r Filterung des berechneten Massenstrom TEV" VALUE 0x1CDF60 KwUw 14.9311911 zk100msxs_uw_b6553 0.100001526 15.0311927 FORMAT "%10.7" /end CHARACTERISTIC
/begin CHARACTERISTIC ZRLTEDTE "Zeitkonstante f¸r Filterung der berechneten F¸llung TEV" VALUE 0x1CDF62 KwUw 6553.50000 zk100msxs_uw_b6553 0.100001526 6553.60000 FORMAT "%10.5" /end CHARACTERISTIC
/begin CHARACTERISTIC ZUKE "Zeitkonstante ‹K-Ersatzwert" VALUE 0x1C53A0 KwUw 655.350000 zk10msxs_uw_b655 0.0100001526 655.360000 FORMAT "%10.6" /end CHARACTERISTIC
/begin CHARACTERISTIC ZUKNSTM "Abregelzeitkonstante ‹K-Faktor im Nachstart abh‰ngig von tmot" CURVE 0x1CD7D8 KlAUbSstUbWUw 6553.50000 zk100msxs_uw_b6553 0.100001526 6553.60000 FORMAT "%10.5"
 /begin AXIS_DESCR STD_AXIS tmst temp_ub_q0p75_o48 9 -48.00 143.3 FORMAT "%5.1" DEPOSIT ABSOLUTE /end AXIS_DESCR
/end CHARACTERISTIC
/begin CHARACTERISTIC ZVAKM "Abregelfaktor K-Speicher (tmot) VA" CURVE 0x1CD79C GklWUb 0.9961 fak_q0p0039 0.00 0.9961
 /begin AXIS_DESCR COM_AXIS tmot temp_ub_q0p75_o48 9 -48.00 143.3 AXIS_PTS_REF STM09ESUB /end AXIS_DESCR
/end CHARACTERISTIC
/begin CHARACTERISTIC ZVALM "Abregelfaktor L-Speicher (tmot) VA" CURVE 0x1CD7A8 GklWUb 0.1245 fak_ub_b0p125 0.00 0.1245 FORMAT "%6.4"
 /begin AXIS_DESCR COM_AXIS tmot temp_ub_q0p75_o48 9 -48.00 143.3 AXIS_PTS_REF STM09ESUB /end AXIS_DESCR
/end CHARACTERISTIC
/begin CHARACTERISTIC ZZWEETM "Umschaltschwelle Vorlagerungswinkel" CURVE 0x1CD946 KlAUwSstUwWUw 65535.00 dez 0.00 65535.00 FORMAT "%8.2"
 /begin AXIS_DESCR STD_AXIS tmst temp_ub_q0p75_o48 8 -48.00000 49103.25 FORMAT "%8.2" DEPOSIT ABSOLUTE /end AXIS_DESCR
/end CHARACTERISTIC
/begin MEASUREMENT abak "Aufteilungsfaktor Wandfilm bei BA" UBYTE fak_ub_b1 1 100 0 0.996094 ECU_ADDRESS 0x800B3A /end MEASUREMENT
/begin MEASUREMENT abr1_count "Nachstart Abregelz‰hler 1" UBYTE dez 1 100 0 255 FORMAT "%5.1" ECU_ADDRESS 0x801199 /end MEASUREMENT
/begin MEASUREMENT anzfkuka "Anzahl berechnete Korrekturfaktoren w‰hrend ‹K-Eingriff (‹K-Adaption)" UBYTE dez 1 100 0 255 FORMAT "%5.1" ECU_ADDRESS 0x8011A3 /end MEASUREMENT
/begin MEASUREMENT anzfkuka2 "Anzahl berechnete Korrekturfaktoren w‰hrend ‹K-Eingriff Bank 2 (‹K-Adaption)" UBYTE dez 1 100 0 255 FORMAT "%5.1" ECU_ADDRESS 0x8011A4 /end MEASUREMENT
/begin MEASUREMENT anztis "Anzahl vom CIFI initialisierter ti's (Synchro-Abtastung)" UBYTE dez 1 100 0 255 FORMAT "%5.1" ECU_ADDRESS 0x8011A1 /end MEASUREMENT
/begin MEASUREMENT anztpdn "Anzahl der hintereinander erfolgten Tip-Downs" UBYTE dez 1 100 0 255 FORMAT "%5.1" ECU_ADDRESS 0x80124A /end MEASUREMENT
/begin MEASUREMENT anztpup "Anzahl der hintereinander erfolgten Tip-Ups" UBYTE dez 1 100 0 255 FORMAT "%5.1" ECU_ADDRESS 0x80124B /end MEASUREMENT
/begin MEASUREMENT anzwefim "Anzahl der abgearbeiteten Wiedereinsetzfaktoren" UBYTE dez 1 100 0 255 FORMAT "%5.1" ECU_ADDRESS 0x8011A7 /end MEASUREMENT
/begin MEASUREMENT apdtev "Anzahl der erfolgreichen DTEV Pr¸fungen" UBYTE dez 1 100 0 255 FORMAT "%5.1" ECU_ADDRESS 0x800BC8 /end MEASUREMENT
/begin MEASUREMENT avak "Aufteilungsfaktor Wandfilm bei VA" UBYTE fak_ub_b1 1 100 0 0.996094 ECU_ADDRESS 0x800B3B /end MEASUREMENT
/begin MEASUREMENT avdtev "Anzahl der nicht erfolgreichen DTEV Pr¸fversuche" UBYTE dez 1 100 0 255 FORMAT "%5.1" ECU_ADDRESS 0x800BC9 /end MEASUREMENT
/begin MEASUREMENT azpdtefre "Anzahl Pr¸fungen Faktor Lambdaregelung auf eingeschwungen" UBYTE dez 1 100 0 255 FORMAT "%5.1" ECU_ADDRESS 0x800BCA /end MEASUREMENT
/begin MEASUREMENT azylwe "Anzahl wiedereingesetzter Zylinder" UBYTE dez 1 100 0 255 FORMAT "%5.1" ECU_ADDRESS 0x8011A8 /end MEASUREMENT
/begin MEASUREMENT bbwuc "Byte f¸r Bedingung B_wuc als Triggerevent in DCLA" UBYTE dez 1 100 0 255 FORMAT "%5.1" ECU_ADDRESS 0x801162 /end MEASUREMENT
/begin MEASUREMENT B_afwe "Bedingung Anzahl der Wiedereinsetzfaktoren" UBYTE B_TRUE 1 100 0 1 BIT_MASK 0x1 FORMAT "%13.11" ECU_ADDRESS 0x7FA78A /end MEASUREMENT
/begin MEASUREMENT B_airbag "Bedingung Airbag ausgelˆst" UBYTE B_TRUE 1 100 0 1 BIT_MASK 0x1 FORMAT "%13.11" ECU_ADDRESS 0x7FA60E /end MEASUREMENT
/begin MEASUREMENT B_ba "Bedingung Beschleunigungsanreicherung (Anzeige)" UBYTE B_TRUE 1 100 0 1 BIT_MASK 0x1 FORMAT "%13.11" ECU_ADDRESS 0x7FA767 /end MEASUREMENT
/begin MEASUREMENT B_bag "Bedingung starke Beschleunigungsanreicherung" UBYTE B_TRUE 1 100 0 1 BIT_MASK 0x1 FORMAT "%13.11" ECU_ADDRESS 0x7FA768 /end MEASUREMENT
/begin MEASUREMENT B_bbdthm "Bedingung Betriebsbereich Diagn. Thermostat erf¸llt" UBYTE B_TRUE 1 100 0 1 BIT_MASK 0x1 FORMAT "%13.11" ECU_ADDRESS 0x7FA87D /end MEASUREMENT
/begin MEASUREMENT B_besch "Bedingung FGR im Zustand Beschleunigen" UWORD B_TRUE 1 100 0 1 BIT_MASK 0x1 FORMAT "%13.11" ECU_ADDRESS 0x80186C /end MEASUREMENT
/begin MEASUREMENT B_beths "Bandendepr¸fung" UWORD B_TRUE 1 100 0 1 BIT_MASK 0x20 FORMAT "%13.11" ECU_ADDRESS 0x7FCA2E /end MEASUREMENT
/begin MEASUREMENT B_cfkuka "Bedingung Berechnung Korrekturfaktor UK-Adaption" UBYTE B_TRUE 1 100 0 1 BIT_MASK 0x1 FORMAT "%13.11" ECU_ADDRESS 0x7FA777 /end MEASUREMENT
/begin MEASUREMENT B_cfkuka2 "Bedingung Berechnung Korrekturfaktor UK-Adaption Bank 2" UBYTE B_TRUE 1 100 0 1 BIT_MASK 0x1 FORMAT "%13.11" ECU_ADDRESS 0x7FA778 /end MEASUREMENT
/begin MEASUREMENT B_cfuka "Bedingung UK-Adaptionsfaktor berechnen" UBYTE B_TRUE 1 100 0 1 BIT_MASK 0x1 FORMAT "%13.11" ECU_ADDRESS 0x7FA779 /end MEASUREMENT
/begin MEASUREMENT B_cfuka2 "Bedingung UK-Adaptionsfaktor berechnen (Bank 2)" UBYTE B_TRUE 1 100 0 1 BIT_MASK 0x1 FORMAT "%13.11" ECU_ADDRESS 0x7FA77A /end MEASUREMENT
/begin MEASUREMENT B_cwdthm "Bedingung: Diagnose Thermostat Motor-K¸hlmittel eingeschaltet" UBYTE B_TRUE 1 100 0 1 BIT_MASK 0x1 FORMAT "%13.11" ECU_ADDRESS 0x7FA87E /end MEASUREMENT
/begin MEASUREMENT B_dsseg "Bedingung elektr. Fehler Saugrohrdrucksensor  nicht vorhanden" UBYTE B_TRUE 1 100 0 1 BIT_MASK 0x1 FORMAT "%13.11" ECU_ADDRESS 0x7FA625 /end MEASUREMENT
/begin MEASUREMENT B_dteaa "Bedingung Aufsteuerpr¸fung f¸r TEV Diagnose aktiv" UBYTE B_TRUE 1 100 0 1 BIT_MASK 0x1 FORMAT "%13.11" ECU_ADDRESS 0x7FA7BB /end MEASUREMENT
/begin MEASUREMENT B_dteaab "Bedingung DTEV-Abbruch wegen Verlassen Aktivierungsbedingungen" UBYTE B_TRUE 1 100 0 1 BIT_MASK 0x1 FORMAT "%13.11" ECU_ADDRESS 0x7FA7BC /end MEASUREMENT
/begin MEASUREMENT B_dteaam "Bedingung Aufsteuerpr¸fung f¸r TEV Diagnose aktiv mˆglich" UBYTE B_TRUE 1 100 0 1 BIT_MASK 0x1 FORMAT "%13.11" ECU_ADDRESS 0x7FA7BD /end MEASUREMENT
/begin MEASUREMENT B_dteabu "Bedingung Abbruch TE Diagnose ohne Pr¸fergebnis" UBYTE B_TRUE 1 100 0 1 BIT_MASK 0x1 FORMAT "%13.11" ECU_ADDRESS 0x7FA7BE /end MEASUREMENT
/begin MEASUREMENT B_dteanfl "abgelaufene Zeit ab die, das Tastverh‰lnis aus DTEV grˆﬂer Schwelle" UBYTE B_TRUE 1 100 0 1 BIT_MASK 0x1 FORMAT "%13.11" ECU_ADDRESS 0x7FA7BF /end MEASUREMENT
/begin MEASUREMENT B_dteend "Bedingung Diagnose TEV erfolgreich zu Ende" UBYTE B_TRUE 1 100 0 1 BIT_MASK 0x1 FORMAT "%13.11" ECU_ADDRESS 0x7FA7C0 /end MEASUREMENT
/begin MEASUREMENT B_dteendl "Bedingung Diagnose TEV ¸ber Luftpr¸fung erfolgreich zu Ende" UBYTE B_TRUE 1 100 0 1 BIT_MASK 0x1 FORMAT "%13.11" ECU_ADDRESS 0x7FA7C1 /end MEASUREMENT
/begin MEASUREMENT B_dteenf "Bedingung Diagnose TEV wegen System-Error nicht freigegeben" UBYTE B_TRUE 1 100 0 1 BIT_MASK 0x1 FORMAT "%13.11" ECU_ADDRESS 0x7FA7C2 /end MEASUREMENT
/begin MEASUREMENT B_dtefre "Bedingung fr f¸r Diagnose TEV eingeschwungen." UBYTE B_TRUE 1 100 0 1 BIT_MASK 0x1 FORMAT "%13.11" ECU_ADDRESS 0x7FA7C3 /end MEASUREMENT
/begin MEASUREMENT B_dtefrr "Bedingung Lambdareglerreset bei Tankentl¸ftungsdiagnose" UBYTE B_TRUE 1 100 0 1 BIT_MASK 0x1 FORMAT "%13.11" ECU_ADDRESS 0x7FA7C4 /end MEASUREMENT
/begin MEASUREMENT B_dtelab "Bedingung DTEV-Abbruch wegen Stˆrung Leerlaufluftpr¸fung" UBYTE B_TRUE 1 100 0 1 BIT_MASK 0x1 FORMAT "%13.11" ECU_ADDRESS 0x7FA7C5 /end MEASUREMENT
/begin MEASUREMENT B_dtelbm "Bedingung Bewertung des Lambda Reglers bei Diagnose TEV mˆglich" UBYTE B_TRUE 1 100 0 1 BIT_MASK 0x1 FORMAT "%13.11" ECU_ADDRESS 0x7FA7C6 /end MEASUREMENT
/begin MEASUREMENT B_dtelbr "Bedingung Reset Flip-Flop Passiv-Pr¸fung DTEV mˆglich" UBYTE B_TRUE 1 100 0 1 BIT_MASK 0x1 FORMAT "%13.11" ECU_ADDRESS 0x7FA7C7 /end MEASUREMENT
/begin MEASUREMENT B_dtelnm "LL-Pr¸fung Diagnose TEV nicht mˆglich" UBYTE B_TRUE 1 100 0 1 BIT_MASK 0x1 FORMAT "%13.11" ECU_ADDRESS 0x7FA7C8 /end MEASUREMENT
/begin MEASUREMENT B_dtelnmb "Best‰tigt : LL-Pr¸fung Diagnose TEV nicht mˆglich" UBYTE B_TRUE 1 100 0 1 BIT_MASK 0x1 FORMAT "%13.11" ECU_ADDRESS 0x7FA7C9 /end MEASUREMENT
/begin MEASUREMENT B_dtelnmv "Vorbehalt: LL-Pr¸fung Diagnose TEV nicht mˆglich" UBYTE B_TRUE 1 100 0 1 BIT_MASK 0x1 FORMAT "%13.11" ECU_ADDRESS 0x7FA7CA /end MEASUREMENT
/begin MEASUREMENT B_dtenam "Bedingung TEV Diagnose nur ¸ber Aufsteuerpr¸fung mˆglich" UBYTE B_TRUE 1 100 0 1 BIT_MASK 0x1 FORMAT "%13.11" ECU_ADDRESS 0x7FA7CB /end MEASUREMENT
/begin MEASUREMENT B_dtephm "Bedingung physikalische Freigabe DTEV" UBYTE B_TRUE 1 100 0 1 BIT_MASK 0x1 FORMAT "%13.11" ECU_ADDRESS 0x7FA7CC /end MEASUREMENT
/begin MEASUREMENT B_dtepm "Bedingung passive TEV Diagnose mˆglich" UBYTE B_TRUE 1 100 0 1 BIT_MASK 0x1 FORMAT "%13.11" ECU_ADDRESS 0x7FA7CD /end MEASUREMENT
/begin MEASUREMENT B_dterab "Bedingung DTEV-Abbruch wegen Abweichung Lambdaregler zur groﬂ" UBYTE B_TRUE 1 100 0 1 BIT_MASK 0x1 FORMAT "%13.11" ECU_ADDRESS 0x7FA7CE /end MEASUREMENT
/begin MEASUREMENT B_dterap "Bedingung DTEV Reset durch Applikation" UBYTE B_TRUE 1 100 0 1 BIT_MASK 0x1 FORMAT "%13.11" ECU_ADDRESS 0x7FA7CF /end MEASUREMENT
/begin MEASUREMENT B_dteres "Bedingung TEV Diagnose Reset" UBYTE B_TRUE 1 100 0 1 BIT_MASK 0x1 FORMAT "%13.11" ECU_ADDRESS 0x7FA7D0 /end MEASUREMENT
/begin MEASUREMENT B_dternm "Bedingung kein fr-Hub f¸r Diagnose TEV vorhanden" UBYTE B_TRUE 1 100 0 1 BIT_MASK 0x1 FORMAT "%13.11" ECU_ADDRESS 0x7FA7D1 /end MEASUREMENT
/begin MEASUREMENT B_dtes "Aktive Diagnose: Tankentl¸ftungssystem" UBYTE B_TRUE 1 100 0 1 BIT_MASK 0x1 FORMAT "%13.11" ECU_ADDRESS 0x7FA7D2 /end MEASUREMENT
/begin MEASUREMENT B_dtest "Start f¸r TEV-Ansteuerung" UBYTE B_TRUE 1 100 0 1 BIT_MASK 0x1 FORMAT "%13.11" ECU_ADDRESS 0x7FA7D3 /end MEASUREMENT
/begin MEASUREMENT B_dtezam "Bedingung Diagnose TEV f¸r Zusteuer-/Aufsteuerpr¸fung ist mˆglich" UBYTE B_TRUE 1 100 0 1 BIT_MASK 0x1 FORMAT "%13.11" ECU_ADDRESS 0x7FA7D4 /end MEASUREMENT
/begin MEASUREMENT B_dwdksugd "Delta Sollwinkel Drosselklappe ab Beginn ungedrosselt aktiv" UBYTE B_TRUE 1 100 0 1 BIT_MASK 0x1 FORMAT "%13.11" ECU_ADDRESS 0x7FA659 /end MEASUREMENT
/begin MEASUREMENT B_ecfuka "Bedingung ‹K-Adaptionsfaktor berechnen erlaubt" UBYTE B_TRUE 1 100 0 1 BIT_MASK 0x1 FORMAT "%13.11" ECU_ADDRESS 0x7FA77B /end MEASUREMENT
/begin MEASUREMENT B_ecfuka2 "Bedingung ‹K-Adaptionsfaktor berechnen erlaubt (Bank 2)" UBYTE B_TRUE 1 100 0 1 BIT_MASK 0x1 FORMAT "%13.11" ECU_ADDRESS 0x7FA77C /end MEASUREMENT
/begin MEASUREMENT B_elmi "Bedingung Error Luftmasse bei Initialisierung" UBYTE B_TRUE 1 100 0 1 BIT_MASK 0x1 FORMAT "%13.11" ECU_ADDRESS 0x7FA626 /end MEASUREMENT
/begin MEASUREMENT B_esbnb "Bedingung Einspritzbeginn im Normalbetrieb" UBYTE B_TRUE 1 100 0 1 BIT_MASK 0x2 FORMAT "%13.11" ECU_ADDRESS 0x8011B7 /end MEASUREMENT
/begin MEASUREMENT B_esbst "Bedingung Einspritzbeginn im Start" UBYTE B_TRUE 1 100 0 1 BIT_MASK 0x1 FORMAT "%13.11" ECU_ADDRESS 0x8011B7 /end MEASUREMENT
/begin MEASUREMENT B_ethmr "Bedingung Thermostatfehler im RS-Flip-Flop gespeichert" UBYTE B_TRUE 1 100 0 1 BIT_MASK 0x2 FORMAT "%13.11" ECU_ADDRESS 0x801212 /end MEASUREMENT
/begin MEASUREMENT B_ethms "Bedingung Thermostatfehler erkannt und Auslˆsen des Zyklusflags" UBYTE B_TRUE 1 100 0 1 BIT_MASK 0x1 FORMAT "%13.11" ECU_ADDRESS 0x801212 /end MEASUREMENT
/begin MEASUREMENT B_fgrakt "Bedingung FGR-Regler aktiv" UWORD B_TRUE 1 100 0 1 BIT_MASK 0x4 FORMAT "%13.11" ECU_ADDRESS 0x80186C /end MEASUREMENT
/begin MEASUREMENT B_fgrari "Bedingung FGR-Abschaltrampe Initialisierung" UBYTE B_TRUE 1 100 0 1 BIT_MASK 0x1 FORMAT "%13.11" ECU_ADDRESS 0x7FA983 /end MEASUREMENT
/begin MEASUREMENT B_fgrdvi "Bedingung FGR-Regler Initialisierung der gespeicherten Regelabweichung" UWORD B_TRUE 1 100 0 1 BIT_MASK 0x8 FORMAT "%13.11" ECU_ADDRESS 0x80186C /end MEASUREMENT
/begin MEASUREMENT B_fgren "Bedingung Fahrgeschwindigkeitsregelung aktiv (Enable)" UBYTE B_TRUE 1 100 0 1 BIT_MASK 0x1 FORMAT "%13.11" ECU_ADDRESS 0x7FA98A /end MEASUREMENT
/begin MEASUREMENT B_fgrene "Bedingung FGR-Regelung aktiv (Enable) erweitert" UBYTE B_TRUE 1 100 0 1 BIT_MASK 0x1 FORMAT "%13.11" ECU_ADDRESS 0x7FA984 /end MEASUREMENT
/begin MEASUREMENT B_fgrkf "Bedingung: FGR im Zustand Konstantfahrt" UBYTE B_TRUE 1 100 0 1 BIT_MASK 0x1 FORMAT "%13.11" ECU_ADDRESS 0x7FA98B /end MEASUREMENT
/begin MEASUREMENT B_fgrkfm "Bedingung: FGR im Zustand Konstantfahrt (aus ME)" UBYTE B_TRUE 1 100 0 1 BIT_MASK 0x1 FORMAT "%13.11" ECU_ADDRESS 0x7FA985 /end MEASUREMENT
/begin MEASUREMENT B_fgrra "Bedingung FGR-Rampe" UWORD B_TRUE 1 100 0 1 BIT_MASK 0x10 FORMAT "%13.11" ECU_ADDRESS 0x80186C /end MEASUREMENT
/begin MEASUREMENT B_fgrvem "Bedingung: FGR im Zustand Verzˆgern (aus ME)" UBYTE B_TRUE 1 100 0 1 BIT_MASK 0x1 FORMAT "%13.11" ECU_ADDRESS 0x7FA986 /end MEASUREMENT
/begin MEASUREMENT B_fgrver "Bedingung: FGR im Zustand Verzˆgern" UBYTE B_TRUE 1 100 0 1 BIT_MASK 0x1 FORMAT "%13.11" ECU_ADDRESS 0x7FA98C /end MEASUREMENT
/begin MEASUREMENT B_fkmsdks "Integratorstop fkmsdk" UBYTE B_TRUE 1 100 0 1 BIT_MASK 0x1 FORMAT "%13.11" ECU_ADDRESS 0x7FA65A /end MEASUREMENT
/begin MEASUREMENT B_flsubb "Bedingung: Freigabe der Betriebsbereitschaft der LSU" UBYTE B_TRUE 1 100 0 1 BIT_MASK 0x1 FORMAT "%13.11" ECU_ADDRESS 0x7FA71F /end MEASUREMENT
/begin MEASUREMENT B_flsubb2 "Bedingung: Freigabe der Betriebsbereitschaft der LSU, Bank 2" UBYTE B_TRUE 1 100 0 1 BIT_MASK 0x1 FORMAT "%13.11" ECU_ADDRESS 0x7FA720 /end MEASUREMENT
/begin MEASUREMENT B_fnsoff "Bedingung Berechnung Nachstart abschalten" UBYTE B_TRUE 1 100 0 1 BIT_MASK 0x1 FORMAT "%13.11" ECU_ADDRESS 0x80119A /end MEASUREMENT
/begin MEASUREMENT B_ftedab "Bedingung Sp¸lrate f¸r Diagnose zusteuern" UBYTE B_TRUE 1 100 0 1 BIT_MASK 0x1 FORMAT "%13.11" ECU_ADDRESS 0x7FA7D5 /end MEASUREMENT
/begin MEASUREMENT B_furpen "Bedingung F¸llungsregler P-Anteil aktiv" UBYTE B_TRUE 1 100 0 1 BIT_MASK 0x1 FORMAT "%13.11" ECU_ADDRESS 0x7FA65F /end MEASUREMENT
/begin MEASUREMENT B_fwe "Bedingung Faktor Wiedereinsetzen" UBYTE B_TRUE 1 100 0 1 BIT_MASK 0x1 FORMAT "%13.11" ECU_ADDRESS 0x7FA78B /end MEASUREMENT
/begin MEASUREMENT b_gaerk "Gang erkannt" UBYTE DC_FLAG_U8 1 100 0 1 BIT_MASK 0x1 FORMAT "%5.3" ECU_ADDRESS 0x80398B /end MEASUREMENT
/begin MEASUREMENT b_gain "erkannter Gang plausibel" UBYTE DC_FLAG_U8 1 100 0 1 BIT_MASK 0x1 FORMAT "%5.3" ECU_ADDRESS 0x80398C /end MEASUREMENT
/begin MEASUREMENT b_gaout "Gangerkennung unplausibel" UBYTE DC_FLAG_U8 1 100 0 1 BIT_MASK 0x1 FORMAT "%5.3" ECU_ADDRESS 0x80398D /end MEASUREMENT
/begin MEASUREMENT b_gapl "Bedingung Verh‰ltnis v/n plausibel f¸r Gangerkennung" UBYTE DC_FLAG_U8 1 100 0 1 BIT_MASK 0x1 FORMAT "%5.3" ECU_ADDRESS 0x80398E /end MEASUREMENT
/begin MEASUREMENT B_hag "Bedingung Hˆhenadaption g¸ltig" UBYTE B_TRUE 1 100 0 1 BIT_MASK 0x1 FORMAT "%13.11" ECU_ADDRESS 0x7FA627 /end MEASUREMENT
/begin MEASUREMENT B_hst "Bedingung Heiﬂstart" UBYTE B_TRUE 1 100 0 1 BIT_MASK 0x1 FORMAT "%13.11" ECU_ADDRESS 0x7FC76E /end MEASUREMENT
/begin MEASUREMENT B_hstnl "Bed. Heiﬂstart aus tmot-Verlauf im SG-Nachlauf" UBYTE B_TRUE 1 100 0 1 BIT_MASK 0x1 FORMAT "%13.11" ECU_ADDRESS 0x7FA761 /end MEASUREMENT
/begin MEASUREMENT B_kfnb "Bedingung Konstantfahrt nach Beschleunigen" UWORD B_TRUE 1 100 0 1 BIT_MASK 0x20 FORMAT "%13.11" ECU_ADDRESS 0x80186C /end MEASUREMENT
/begin MEASUREMENT B_kfnv "Bedingung Konstantfahrt nach Verzˆgern" UWORD B_TRUE 1 100 0 1 BIT_MASK 0x40 FORMAT "%13.11" ECU_ADDRESS 0x80186C /end MEASUREMENT
/begin MEASUREMENT B_kfwee "Bedingung Kennfeld KFWEE aktiv" UBYTE B_TRUE 1 100 0 1 BIT_MASK 0x1 FORMAT "%13.11" ECU_ADDRESS 0x7FA790 /end MEASUREMENT
/begin MEASUREMENT b_kuperr "Kupplung zu lange getreten" UBYTE DC_FLAG_U8 1 100 0 1 BIT_MASK 0x1 FORMAT "%5.3" ECU_ADDRESS 0x80398F /end MEASUREMENT
/begin MEASUREMENT b_kuplow "Kupplung geschlossen" UBYTE DC_FLAG_U8 1 100 0 1 BIT_MASK 0x1 FORMAT "%5.3" ECU_ADDRESS 0x803990 /end MEASUREMENT
/begin MEASUREMENT B_m8te "Bedingung Fkt-Anforderung Tankentl¸ftung nach SAE J1979 Mode 8 TID $01" UBYTE B_TRUE 1 100 0 1 BIT_MASK 0x1 FORMAT "%13.11" ECU_ADDRESS 0x7FA896 /end MEASUREMENT
/begin MEASUREMENT B_mfact "Bedingung Medianfilter aktiv" UBYTE B_TRUE 1 100 0 1 BIT_MASK 0x1 FORMAT "%13.11" ECU_ADDRESS 0x7FA65B /end MEASUREMENT
/begin MEASUREMENT B_mnths "Minimaler Wert unterschritten" UWORD B_TRUE 1 100 0 1 BIT_MASK 0x8 FORMAT "%13.11" ECU_ADDRESS 0x7FCA2E /end MEASUREMENT
/begin MEASUREMENT B_mrfamx "Vorlagerungswinkel ¸ber maximales Fahrerwunschmomment aktiv" UBYTE B_TRUE 1 100 0 1 BIT_MASK 0x1 FORMAT "%13.11" ECU_ADDRESS 0x7FA791 /end MEASUREMENT
/begin MEASUREMENT B_mxths "Maximaler Wert ‹berschritten" UWORD B_TRUE 1 100 0 1 BIT_MASK 0x4 FORMAT "%13.11" ECU_ADDRESS 0x7FCA2E /end MEASUREMENT
/begin MEASUREMENT B_nowuc "Bedingung 'kein warm up cycle' erkannt" UBYTE B_TRUE 1 100 0 1 BIT_MASK 0x1 FORMAT "%13.11" ECU_ADDRESS 0x7FA6B0 /end MEASUREMENT
/begin MEASUREMENT B_pug "Bedingung Umgebungsdruck g¸ltig" UBYTE B_TRUE 1 100 0 1 BIT_MASK 0x1 FORMAT "%13.11" ECU_ADDRESS 0x7FA628 /end MEASUREMENT
/begin MEASUREMENT B_redkl "Freigabe Reduzierung ‹K-K- und -L-Anteil" UBYTE B_TRUE 1 100 0 1 BIT_MASK 0x1 FORMAT "%13.11" ECU_ADDRESS 0x7FA769 /end MEASUREMENT
/begin MEASUREMENT B_rfkuka "Bedingung Korrekturfaktor r¸cksetzen (‹K-Adaption)" UBYTE B_TRUE 1 100 0 1 BIT_MASK 0x1 FORMAT "%13.11" ECU_ADDRESS 0x7FA77D /end MEASUREMENT
/begin MEASUREMENT B_rfkuka2 "Bedingung Korrekturfaktor r¸cksetzen (Bank 2) (‹K-Adaption)" UBYTE B_TRUE 1 100 0 1 BIT_MASK 0x1 FORMAT "%13.11" ECU_ADDRESS 0x7FA77E /end MEASUREMENT
/begin MEASUREMENT B_rmsval "Bedingung relativer Massenstrom TEV f¸ltig" UBYTE B_TRUE 1 100 0 1 BIT_MASK 0x1 FORMAT "%13.11" ECU_ADDRESS 0x7FC7AC /end MEASUREMENT
/begin MEASUREMENT B_savfgr "Bedingung: Schubabschalteverbot durch FGR" UBYTE B_TRUE 1 100 0 1 BIT_MASK 0x1 FORMAT "%13.11" ECU_ADDRESS 0x7FA98D /end MEASUREMENT
/begin MEASUREMENT B_savm "Bedingung: Schubabschalteverbot durch FGR (aus ME)" UBYTE B_TRUE 1 100 0 1 BIT_MASK 0x1 FORMAT "%13.11" ECU_ADDRESS 0x7FA987 /end MEASUREMENT
/begin MEASUREMENT B_siths "Signal inaktiv" UWORD B_TRUE 1 100 0 1 BIT_MASK 0x10 FORMAT "%13.11" ECU_ADDRESS 0x7FCA2E /end MEASUREMENT
/begin MEASUREMENT B_stendes "Bedingung Startende Einspritzung erreicht" UBYTE B_TRUE 1 100 0 1 BIT_MASK 0x1 FORMAT "%13.11" ECU_ADDRESS 0x7FA762 /end MEASUREMENT
/begin MEASUREMENT B_stndfr "Freigabe F¸llungsregler nach Start" UBYTE B_TRUE 1 100 0 1 BIT_MASK 0x1 FORMAT "%13.11" ECU_ADDRESS 0x7FA660 /end MEASUREMENT
/begin MEASUREMENT B_swknb "Bedingung Setzwertkorrektur nach Beschleunigen" UWORD B_TRUE 1 100 0 1 BIT_MASK 0x80 FORMAT "%13.11" ECU_ADDRESS 0x80186C /end MEASUREMENT
/begin MEASUREMENT B_swknv "Bedingung Setzwertkorrektur nach Verzˆgern" UWORD B_TRUE 1 100 0 1 BIT_MASK 0x100 FORMAT "%13.11" ECU_ADDRESS 0x80186C /end MEASUREMENT
/begin MEASUREMENT B_tb2p "Bedingung Taste Beschleunigen ¸berdr¸ckt positive Flanke" UBYTE B_TRUE 1 100 0 1 BIT_MASK 0x1 FORMAT "%13.11" ECU_ADDRESS 0x7FA988 /end MEASUREMENT
/begin MEASUREMENT B_tbenh "Bedingung Taste Beschleunigen negative Flanke nach Halten" UWORD B_TRUE 1 100 0 1 BIT_MASK 0x200 FORMAT "%13.11" ECU_ADDRESS 0x80186C /end MEASUREMENT
/begin MEASUREMENT B_tbent "Bedingung Taste Beschleunigen negative Flanke nach Tip" UWORD B_TRUE 1 100 0 1 BIT_MASK 0x400 FORMAT "%13.11" ECU_ADDRESS 0x80186C /end MEASUREMENT
/begin MEASUREMENT B_tbep "Bedingung Taste Beschleunigen positive Flanke" UWORD B_TRUE 1 100 0 1 BIT_MASK 0x800 FORMAT "%13.11" ECU_ADDRESS 0x80186C /end MEASUREMENT
/begin MEASUREMENT B_tbeph "Bedingung Taste Beschleunigen positive Flanke Halten" UWORD B_TRUE 1 100 0 1 BIT_MASK 0x1000 FORMAT "%13.11" ECU_ADDRESS 0x80186C /end MEASUREMENT
/begin MEASUREMENT b_temakt "Bedingung automatische Aktivierung FGR" UBYTE DC_FLAG_U8 1 100 0 1 BIT_MASK 0x1 FORMAT "%5.3" ECU_ADDRESS 0x803991 /end MEASUREMENT
/begin MEASUREMENT b_temina "Gangerkennung unplausibel" UBYTE DC_FLAG_U8 1 100 0 1 BIT_MASK 0x1 FORMAT "%5.3" ECU_ADDRESS 0x803992 /end MEASUREMENT
/begin MEASUREMENT B_teviol "Bedingung TEV aus der Reaktion der Leerlaufregelung als i.O. erkannt" UBYTE B_TRUE 1 100 0 1 BIT_MASK 0x1 FORMAT "%13.11" ECU_ADDRESS 0x7FA7D6 /end MEASUREMENT
/begin MEASUREMENT B_teviolm "Bedingung i.O-Aussage TEV ¸ber Leerlaufluftpr¸fung mˆglich" UBYTE B_TRUE 1 100 0 1 BIT_MASK 0x1 FORMAT "%13.11" ECU_ADDRESS 0x7FA7D7 /end MEASUREMENT
/begin MEASUREMENT B_teviop "Bedingung TEV in passiver Pr¸fung als i.O. erkannt." UBYTE B_TRUE 1 100 0 1 BIT_MASK 0x1 FORMAT "%13.11" ECU_ADDRESS 0x7FA7D8 /end MEASUREMENT
/begin MEASUREMENT B_tevior "Bedingung TEV aus fr-Abweichung als i.O. erkannt." UBYTE B_TRUE 1 100 0 1 BIT_MASK 0x1 FORMAT "%13.11" ECU_ADDRESS 0x7FA7D9 /end MEASUREMENT
/begin MEASUREMENT B_tevnio "Bedingung TEV in aktiver Pr¸fung als defekt erkannt" UBYTE B_TRUE 1 100 0 1 BIT_MASK 0x1 FORMAT "%13.11" ECU_ADDRESS 0x7FA7DA /end MEASUREMENT
/begin MEASUREMENT B_tevniom "Bedingung i.O-Aussage TEV ¸ber Leerlaufpr¸fung nicht mˆglich" UBYTE B_TRUE 1 100 0 1 BIT_MASK 0x1 FORMAT "%13.11" ECU_ADDRESS 0x7FA7DB /end MEASUREMENT
/begin MEASUREMENT B_tmnuka "Bedingung: Minimalzeit zwischen 2 Adaptionsvorg‰nge l‰uft" UBYTE B_TRUE 1 100 0 1 BIT_MASK 0x1 FORMAT "%13.11" ECU_ADDRESS 0x7FA77F /end MEASUREMENT
/begin MEASUREMENT b_tnkup "Gang¸bernahme nach kuppeln aktiv" UBYTE DC_FLAG_U8 1 100 0 1 BIT_MASK 0x1 FORMAT "%5.3" ECU_ADDRESS 0x803993 /end MEASUREMENT
/begin MEASUREMENT B_tpderl "Bedingung Tip-Down erlaubt" UWORD B_TRUE 1 100 0 1 BIT_MASK 0x2000 FORMAT "%13.11" ECU_ADDRESS 0x80186C /end MEASUREMENT
/begin MEASUREMENT B_tpdn "Bedingung FGR im Zustand Tip-Down" UWORD B_TRUE 1 100 0 1 BIT_MASK 0x4000 FORMAT "%13.11" ECU_ADDRESS 0x80186C /end MEASUREMENT
/begin MEASUREMENT B_tpuerl "Bedingung Tip-Up erlaubt" UWORD B_TRUE 1 100 0 1 BIT_MASK 0x8000 FORMAT "%13.11" ECU_ADDRESS 0x80186C /end MEASUREMENT
/begin MEASUREMENT B_tpup "Bedingung FGR im Zustand Tip-Up" UWORD B_TRUE 1 100 0 1 BIT_MASK 0x1 FORMAT "%13.11" ECU_ADDRESS 0x80186E /end MEASUREMENT
/begin MEASUREMENT B_tsenh "Bedingung Taste Setzen negative Flanke nach Halten" UWORD B_TRUE 1 100 0 1 BIT_MASK 0x2 FORMAT "%13.11" ECU_ADDRESS 0x80186E /end MEASUREMENT
/begin MEASUREMENT B_tsent "Bedingung Taste setzen negative Flanke nach Tip" UWORD B_TRUE 1 100 0 1 BIT_MASK 0x4 FORMAT "%13.11" ECU_ADDRESS 0x80186E /end MEASUREMENT
/begin MEASUREMENT B_tspuuka "Bedingung Ende der Einschaltverzˆgerung TPSUUKA  erreicht Bank1" UBYTE B_TRUE 1 100 0 1 BIT_MASK 0x1 FORMAT "%13.11" ECU_ADDRESS 0x7FA780 /end MEASUREMENT
/begin MEASUREMENT B_tspuuka2 "Bedingung Ende der Einschaltverzˆgerung TPSUUKA  erreicht Bank2" UBYTE B_TRUE 1 100 0 1 BIT_MASK 0x1 FORMAT "%13.11" ECU_ADDRESS 0x7FA781 /end MEASUREMENT
/begin MEASUREMENT B_tv2p "Bedingung Taste Verzˆgern ¸berdr¸ckt positive Flanke" UBYTE B_TRUE 1 100 0 1 BIT_MASK 0x1 FORMAT "%13.11" ECU_ADDRESS 0x7FA989 /end MEASUREMENT
/begin MEASUREMENT B_tvenh "Bedingung Taste Verzˆgern negative Flanke nach Halten" UWORD B_TRUE 1 100 0 1 BIT_MASK 0x8 FORMAT "%13.11" ECU_ADDRESS 0x80186E /end MEASUREMENT
/begin MEASUREMENT B_tvent "Bedingung Taste Verzˆgern negative Flanke nach Tip" UWORD B_TRUE 1 100 0 1 BIT_MASK 0x10 FORMAT "%13.11" ECU_ADDRESS 0x80186E /end MEASUREMENT
/begin MEASUREMENT B_tvep "Bedingung Taste Verzˆgern positive Flanke" UWORD B_TRUE 1 100 0 1 BIT_MASK 0x20 FORMAT "%13.11" ECU_ADDRESS 0x80186E /end MEASUREMENT
/begin MEASUREMENT B_tveph "Bedingung Taste Verzˆgern positive Flanke Halten" UWORD B_TRUE 1 100 0 1 BIT_MASK 0x40 FORMAT "%13.11" ECU_ADDRESS 0x80186E /end MEASUREMENT
/begin MEASUREMENT B_twap "Bedingung Taste Wiederaufnahme positive Fanke" UWORD B_TRUE 1 100 0 1 BIT_MASK 0x80 FORMAT "%13.11" ECU_ADDRESS 0x80186E /end MEASUREMENT
/begin MEASUREMENT B_uebetu "Bedingung ‹bergang Beschleunigen nach Tip-Up erfolgt" UWORD B_TRUE 1 100 0 1 BIT_MASK 0x100 FORMAT "%13.11" ECU_ADDRESS 0x80186E /end MEASUREMENT
/begin MEASUREMENT B_uebrkf "Bedingung ‹bergang von begrenzter Rampe nach Konstantfahrt erfolgt" UWORD B_TRUE 1 100 0 1 BIT_MASK 0x200 FORMAT "%13.11" ECU_ADDRESS 0x80186E /end MEASUREMENT
/begin MEASUREMENT B_uebvau "Bedingung ‹bergang von Beschleunigen oder Verzˆgern nach Aus erfolgt" UWORD B_TRUE 1 100 0 1 BIT_MASK 0x400 FORMAT "%13.11" ECU_ADDRESS 0x80186E /end MEASUREMENT
/begin MEASUREMENT B_uevztd "Bedingung ‹bergang von Verzˆgern nach Tip-Down erfolgt" UWORD B_TRUE 1 100 0 1 BIT_MASK 0x800 FORMAT "%13.11" ECU_ADDRESS 0x80186E /end MEASUREMENT
/begin MEASUREMENT B_ugdap "Bedinung: ungedrosselter Winkel DK und AGR  ¸ber Applikationswert vorgegeben" UBYTE B_TRUE 1 100 0 1 BIT_MASK 0x1 FORMAT "%13.11" ECU_ADDRESS 0x7FA65C /end MEASUREMENT
/begin MEASUREMENT B_ugdnws "Bedingung:" UBYTE B_TRUE 1 100 0 1 BIT_MASK 0x1 FORMAT "%13.11" ECU_ADDRESS 0x7FA65D /end MEASUREMENT
/begin MEASUREMENT B_uk1 "Einschaltbedingung ‹bergangskompensation" UBYTE B_TRUE 1 100 0 1 BIT_MASK 0x1 FORMAT "%13.11" ECU_ADDRESS 0x7FA76A /end MEASUREMENT
/begin MEASUREMENT B_uka "Freigabebedingung ‹K-Adaption" UBYTE B_TRUE 1 100 0 1 BIT_MASK 0x1 FORMAT "%13.11" ECU_ADDRESS 0x7FA782 /end MEASUREMENT
/begin MEASUREMENT B_uka2 "Freigabebedingung ‹K-Adaption Zylinderbank 2" UBYTE B_TRUE 1 100 0 1 BIT_MASK 0x1 FORMAT "%13.11" ECU_ADDRESS 0x7FA783 /end MEASUREMENT
/begin MEASUREMENT B_ukab "Bedingung g¸ltiger Betriebsbereich f¸r adaptive ‹K" UBYTE B_TRUE 1 100 0 1 BIT_MASK 0x1 FORMAT "%13.11" ECU_ADDRESS 0x7FA784 /end MEASUREMENT
/begin MEASUREMENT B_ukabat "Bedingung Beschleunigung totzeitverschoben (‹K-Adaption)" UBYTE B_TRUE 1 100 0 1 BIT_MASK 0x1 FORMAT "%13.11" ECU_ADDRESS 0x7FA785 /end MEASUREMENT
/begin MEASUREMENT B_ukaukat "Bedingung:UK-Aktivit‰t Anfang totzeitverschoben" UBYTE B_TRUE 1 100 0 1 BIT_MASK 0x1 FORMAT "%13.11" ECU_ADDRESS 0x7FA786 /end MEASUREMENT
/begin MEASUREMENT B_ukauket "Bedingung: UK-Aktivit‰t Ende totzeitverschoben" UBYTE B_TRUE 1 100 0 1 BIT_MASK 0x1 FORMAT "%13.11" ECU_ADDRESS 0x7FA787 /end MEASUREMENT
/begin MEASUREMENT B_ukava "Bedingung Verzˆgerung (‹K-Adaption)" UBYTE B_TRUE 1 100 0 1 BIT_MASK 0x1 FORMAT "%13.11" ECU_ADDRESS 0x7FA788 /end MEASUREMENT
/begin MEASUREMENT B_ukavat "Bedingung Verzˆgerung totzeitverschoben (‹K-Adaption)" UBYTE B_TRUE 1 100 0 1 BIT_MASK 0x1 FORMAT "%13.11" ECU_ADDRESS 0x7FA789 /end MEASUREMENT
/begin MEASUREMENT B_uke "Einschaltbedingung ‹K-Ersatzwert" UBYTE B_TRUE 1 100 0 1 BIT_MASK 0x1 FORMAT "%13.11" ECU_ADDRESS 0x7FA76B /end MEASUREMENT
/begin MEASUREMENT B_ukg "Bedingung ‹k wirkt stark" UBYTE B_TRUE 1 100 0 1 BIT_MASK 0x1 FORMAT "%13.11" ECU_ADDRESS 0x7FA76C /end MEASUREMENT
/begin MEASUREMENT B_ukk "Einschaltbedingung ‹K Kurzzeit-Anteil" UBYTE B_TRUE 1 100 0 1 BIT_MASK 0x1 FORMAT "%13.11" ECU_ADDRESS 0x7FA76D /end MEASUREMENT
/begin MEASUREMENT B_ukns "Einschaltbedingung ‹K nach Start" UBYTE B_TRUE 1 100 0 1 BIT_MASK 0x1 FORMAT "%13.11" ECU_ADDRESS 0x7FA76E /end MEASUREMENT
/begin MEASUREMENT B_va "Bedingung Verzˆgerungsabmagerung (Anzeige)" UBYTE B_TRUE 1 100 0 1 BIT_MASK 0x1 FORMAT "%13.11" ECU_ADDRESS 0x7FA76F /end MEASUREMENT
/begin MEASUREMENT B_vaau "Bedingung Verzˆgerungsabmagerung Aufteilung" UBYTE B_TRUE 1 100 0 1 BIT_MASK 0x1 FORMAT "%13.11" ECU_ADDRESS 0x7FA770 /end MEASUREMENT
/begin MEASUREMENT B_vag "Bedingung starke Verzˆgerungsabmagerung" UBYTE B_TRUE 1 100 0 1 BIT_MASK 0x1 FORMAT "%13.11" ECU_ADDRESS 0x7FA771 /end MEASUREMENT
/begin MEASUREMENT B_vak "Bedingung Verzˆgerungsabmagerung K-Anteil" UBYTE B_TRUE 1 100 0 1 BIT_MASK 0x1 FORMAT "%13.11" ECU_ADDRESS 0x7FA772 /end MEASUREMENT
/begin MEASUREMENT B_vakl "Bedingung Verzˆgerungsabmagerung L- und K-Anteil" UBYTE B_TRUE 1 100 0 1 BIT_MASK 0x1 FORMAT "%13.11" ECU_ADDRESS 0x7FA773 /end MEASUREMENT
/begin MEASUREMENT B_val "Bedingung Verzˆgerungsabmagerung L-Anteil" UBYTE B_TRUE 1 100 0 1 BIT_MASK 0x1 FORMAT "%13.11" ECU_ADDRESS 0x7FA774 /end MEASUREMENT
/begin MEASUREMENT B_vbemg "Bedingung Verbrennungserkennung mˆglich" UBYTE B_TRUE 1 100 0 1 BIT_MASK 0x1 FORMAT "%13.11" ECU_ADDRESS 0x7FA763 /end MEASUREMENT
/begin MEASUREMENT B_vbmg "Bedingung Verbrennung mˆglich" UBYTE B_TRUE 1 100 0 1 BIT_MASK 0x1 FORMAT "%13.11" ECU_ADDRESS 0x7FA764 /end MEASUREMENT
/begin MEASUREMENT B_wavo "Bedingung Wiederaufnahme von oben" UWORD B_TRUE 1 100 0 1 BIT_MASK 0x2 FORMAT "%13.11" ECU_ADDRESS 0x80186C /end MEASUREMENT
/begin MEASUREMENT B_wdkap "Bedingung: DK-Sollwert aus appl. Kennlinie bzw. im Start aus Startwinkel" UBYTE B_TRUE 1 100 0 1 BIT_MASK 0x1 FORMAT "%13.11" ECU_ADDRESS 0x7FA65E /end MEASUREMENT
/begin MEASUREMENT B_wf "Bedingung Wandfilmberechnung" UBYTE B_TRUE 1 100 0 1 BIT_MASK 0x1 FORMAT "%13.11" ECU_ADDRESS 0x7FA775 /end MEASUREMENT
/begin MEASUREMENT B_wiauf "Bedingung FGR im Zustand Wiederaufnahme" UWORD B_TRUE 1 100 0 1 BIT_MASK 0x1000 FORMAT "%13.11" ECU_ADDRESS 0x80186E /end MEASUREMENT
/begin MEASUREMENT B_wks "Bedingung Wiederholkaltstart" UBYTE B_TRUE 1 100 0 1 BIT_MASK 0x1 FORMAT "%13.11" ECU_ADDRESS 0x7FA765 /end MEASUREMENT
/begin MEASUREMENT B_wst "Bedingung Wiederholstart" UBYTE B_TRUE 1 100 0 1 BIT_MASK 0x1 FORMAT "%13.11" ECU_ADDRESS 0x7FA766 /end MEASUREMENT
/begin MEASUREMENT B_wst0 "Bedingung Wiederholstart (Anteil 1: erkannte Verbrennungen)" UBYTE B_TRUE 1 100 0 1 BIT_MASK 0x2 FORMAT "%13.11" ECU_ADDRESS 0x7FC76E /end MEASUREMENT
/begin MEASUREMENT B_wst1 "Bedingung Wiederholstart (Anteil 2: Abstellzeit)" UBYTE B_TRUE 1 100 0 1 BIT_MASK 0x1 FORMAT "%13.11" ECU_ADDRESS 0x800B36 /end MEASUREMENT
/begin MEASUREMENT B_wst2 "Bedingung Wiederholstart (Anteil1: letzter Zyklus erkannte Verbrennungen)" UBYTE B_TRUE 1 100 0 1 BIT_MASK 0x2 FORMAT "%13.11" ECU_ADDRESS 0x800B36 /end MEASUREMENT
/begin MEASUREMENT B_wuc "Bedingung 'warm up cycle' erkannt" UBYTE B_TRUE 1 100 0 1 BIT_MASK 0x1 FORMAT "%13.11" ECU_ADDRESS 0x801162 /end MEASUREMENT
/begin MEASUREMENT B_zthmr "Bedingung Thermostat-Pr¸fung  g¸ltig" UBYTE B_TRUE 1 100 0 1 BIT_MASK 0x8 FORMAT "%13.11" ECU_ADDRESS 0x801212 /end MEASUREMENT
/begin MEASUREMENT B_zthms "Bedingung Modellendtemperatur erreicht und Betriebsbereich war freigegeben" UBYTE B_TRUE 1 100 0 1 BIT_MASK 0x4 FORMAT "%13.11" ECU_ADDRESS 0x801212 /end MEASUREMENT
/begin MEASUREMENT Clutch_Mode "" UBYTE DC_FLAG_U8 1 100 0 1 BIT_MASK 0x1 FORMAT "%5.3" ECU_ADDRESS 0x803994 /end MEASUREMENT
/begin MEASUREMENT CurbWeight "" UBYTE DC_LGW_U8DB 1 100 0 5100 FORMAT "%5.0" ECU_ADDRESS 0x8036D9 /end MEASUREMENT
/begin MEASUREMENT cw_erfil "Status Codewort Filtervariante f¸r Ausgabe der AS-Fehler an GST" UBYTE dez 1 100 0 255 FORMAT "%5.1" ECU_ADDRESS 0x801220 /end MEASUREMENT
/begin MEASUREMENT depsdss_w "Delta Saugrohrdruck gemessen mit Drucksensor am Saugrohr (DS-S)" SWORD p_uw_q0p039 1 100 -1280 1279.96 FORMAT "%8.3" ECU_ADDRESS 0x8013C4 /end MEASUREMENT
/begin MEASUREMENT detazwte "Korrekturfaktor des Z¸ndwinkelwirkungsgrads f¸r DTEV" UBYTE rel_ub_b127p5 1 100 0 127.5 FORMAT "%5.1" ECU_ADDRESS 0x800BCB /end MEASUREMENT
/begin MEASUREMENT dham "Raddrehzahl Hinterachse arithmetisch gemittelt" UWORD DC_URD_05 1 100 0 8191.5 FORMAT "%8.3" ECU_ADDRESS 0x803378 /end MEASUREMENT
/begin MEASUREMENT DMD_Actv "" UBYTE DC_CNTR_U8 1 100 0 255 FORMAT "%5.1" ECU_ADDRESS 0x8036EA /end MEASUREMENT
/begin MEASUREMENT DMD_Off "" UBYTE DC_CNTR_U8 1 100 0 255 FORMAT "%5.1" ECU_ADDRESS 0x8036EB /end MEASUREMENT
/begin MEASUREMENT DMD_VehSpd10kmh_Tmr "" UWORD DC_TIME_100MS_U16 1 100 0 6553.5 FORMAT "%6.1" ECU_ADDRESS 0x8031E0 /end MEASUREMENT
/begin MEASUREMENT DMD_VehSpd_Begin "" UWORD DC_VEHSPD_KMH_U16 1 100 0 4095.94 FORMAT "%8.3" ECU_ADDRESS 0x8031E2 /end MEASUREMENT
/begin MEASUREMENT DMLD_Actv "" UBYTE DC_CNTR_U8 1 100 0 255 FORMAT "%5.1" ECU_ADDRESS 0x8036DC /end MEASUREMENT
/begin MEASUREMENT DMLD_APPAvg "" UWORD DC_PER0327 1 100 0 200.003 FORMAT "%8.4" ECU_ADDRESS 0x8030B8 /end MEASUREMENT
/begin MEASUREMENT DMLD_APPGrdtMax "" SWORD DC_CNTR_U8 1 100 -32768 32767 FORMAT "%8.2" ECU_ADDRESS 0x8030BA /end MEASUREMENT
/begin MEASUREMENT DMLD_ESP_Tmr "" SWORD DC_TIME_100MS_U16 1 100 -3276.8 3276.7 FORMAT "%6.1" ECU_ADDRESS 0x8030BC /end MEASUREMENT
/begin MEASUREMENT DMLD_KD_Tmr "" UWORD DC_TIME_100MS_U16 1 100 0 6553.5 FORMAT "%6.1" ECU_ADDRESS 0x8030BE /end MEASUREMENT
/begin MEASUREMENT DMLD_LongAccelMax "" SBYTE DC_UAFZ_S8 1 100 -5.5552 5.5118 FORMAT "%5.3" ECU_ADDRESS 0x8036DD /end MEASUREMENT
/begin MEASUREMENT DMLD_Off "" UBYTE DC_CNTR_U8 1 100 0 255 FORMAT "%5.1" ECU_ADDRESS 0x8036DE /end MEASUREMENT
/begin MEASUREMENT DMLD_Tmr "" UWORD DC_TIME_100MS_U16 1 100 0 6553.5 FORMAT "%6.1" ECU_ADDRESS 0x8030C0 /end MEASUREMENT
/begin MEASUREMENT DMLD_VehSpd10kmh_Tmr "" UWORD DC_TIME_100MS_U16 1 100 0 6553.5 FORMAT "%6.1" ECU_ADDRESS 0x8030C2 /end MEASUREMENT
/begin MEASUREMENT DMLD_VehSpd_Begin "" UWORD DC_VEHSPD_KMH_U16 1 100 0 4095.94 FORMAT "%8.3" ECU_ADDRESS 0x8030C4 /end MEASUREMENT
/begin MEASUREMENT DMLD_VehSpd_End "" UWORD DC_VEHSPD_KMH_U16 1 100 0 4095.94 FORMAT "%8.3" ECU_ADDRESS 0x8030C6 /end MEASUREMENT
/begin MEASUREMENT dmletanf_w "gefilterter Wert f¸r Abweichung Leerlaufenergiebedarf w‰hrend DTEV" SWORD m_q0p0031 1 100 -102.4 102.397 FORMAT "%8.4" ECU_ADDRESS 0x800BD6 /end MEASUREMENT
/begin MEASUREMENT dmletanu "Abweichung Produkt Luftmasse * Z¸ndwinkelwirkungsgrad bei Pr¸fung DTEV unsigned" UBYTE m_q0p1 1 100 0 25.5 FORMAT "%5.2" ECU_ADDRESS 0x800BCC /end MEASUREMENT
/begin MEASUREMENT dmletan_w "Abweichung Produkt Luftmasse * Z¸ndwinkelwirkungsgrad bei Pr¸fung DTEV 16 Bits" SWORD m_q0p0031 1 100 -102.4 102.397 FORMAT "%8.4" ECU_ADDRESS 0x800BD8 /end MEASUREMENT
/begin MEASUREMENT dmrar_w "Delta Relatives Moment bei Abschaltrampe FGR" UWORD rel_uw_b200 1 100 0 199.997 FORMAT "%8.4" ECU_ADDRESS 0x801860 /end MEASUREMENT
/begin MEASUREMENT dmsfue_w "Lastkorrektur des F¸llungsreglers" SWORD m_q0p1 1 100 -3276.8 3276.7 FORMAT "%8.3" ECU_ADDRESS 0x8014C8 /end MEASUREMENT
/begin MEASUREMENT dmsnte_w "normierte Massenstrom‰nderung ¸ber TEV" SWORD m_q0p1 1 100 -3276.8 3276.7 FORMAT "%8.3" ECU_ADDRESS 0x800BDA /end MEASUREMENT
/begin MEASUREMENT DMTD_Actv "" UBYTE DC_CNTR_U8 1 100 0 255 FORMAT "%5.1" ECU_ADDRESS 0x8036E2 /end MEASUREMENT
/begin MEASUREMENT DMTD_ESP_Tmr "" UWORD DC_TIME_100MS_U16 1 100 0 6553.5 FORMAT "%6.1" ECU_ADDRESS 0x803190 /end MEASUREMENT
/begin MEASUREMENT DMTD_LongAccelMax "" SBYTE DC_UAFZ_S8 1 100 -5.5552 5.5118 FORMAT "%5.3" ECU_ADDRESS 0x8036E3 /end MEASUREMENT
/begin MEASUREMENT DMTD_Off "" UBYTE DC_CNTR_U8 1 100 0 255 FORMAT "%5.1" ECU_ADDRESS 0x8036E4 /end MEASUREMENT
/begin MEASUREMENT DMTD_Tmr "" UWORD DC_TIME_100MS_U16 1 100 0 6553.5 FORMAT "%6.1" ECU_ADDRESS 0x803192 /end MEASUREMENT
/begin MEASUREMENT DMTD_TrvrAccelMax "" UBYTE DC_UAY_S8DB 1 100 0 10.16 FORMAT "%5.2" ECU_ADDRESS 0x8036E5 /end MEASUREMENT
/begin MEASUREMENT DMTD_TrvrAccelMax_LongAccel "" SBYTE DC_UAFZ_S8 1 100 -5.5552 5.5118 FORMAT "%5.3" ECU_ADDRESS 0x8036E6 /end MEASUREMENT
/begin MEASUREMENT DMTD_TrvrAccelMax_VehSpd "" UWORD DC_VEHSPD_KMH_U16 1 100 0 4095.94 FORMAT "%8.3" ECU_ADDRESS 0x803194 /end MEASUREMENT
/begin MEASUREMENT DP_APPGrdt "" SWORD DC_DEZL 1 100 -32768 32767 FORMAT "%8.2" ECU_ADDRESS 0x8030C8 /end MEASUREMENT
/begin MEASUREMENT DP_Decel "" UBYTE DC_CNTR_U8 1 100 0 255 FORMAT "%5.1" ECU_ADDRESS 0x8036E8 /end MEASUREMENT
/begin MEASUREMENT DP_Decel_SnglVal "" UBYTE DC_CNTR_U8 1 100 0 255 FORMAT "%5.1" ECU_ADDRESS 0x8036E9 /end MEASUREMENT
/begin MEASUREMENT DP_LongDyn "Mittelwert Klassifikation Beschleunigung" UBYTE DC_CNTR_U8 1 100 0 255 FORMAT "%5.1" ECU_ADDRESS 0x8036DA /end MEASUREMENT
/begin MEASUREMENT DP_LongDyn_Red_Mode "" UBYTE DC_FLAG_U8 1 100 0 1 BIT_MASK 0x1 FORMAT "%5.3" ECU_ADDRESS 0x8036DF /end MEASUREMENT
/begin MEASUREMENT DP_LongDyn_SnglVal "" UBYTE DC_CNTR_U8 1 100 0 255 FORMAT "%5.1" ECU_ADDRESS 0x8036DB /end MEASUREMENT
/begin MEASUREMENT DP_SteeringAngle "" UWORD DC_LRW_U16DB 1 100 0 6553.5 FORMAT "%8.3" ECU_ADDRESS 0x803196 /end MEASUREMENT
/begin MEASUREMENT DP_TrvrDyn "" UBYTE DC_CNTR_U8 1 100 0 255 FORMAT "%5.1" ECU_ADDRESS 0x8036E0 /end MEASUREMENT
/begin MEASUREMENT DP_TrvrDyn_Red_Mode "" UBYTE DC_FLAG_U8 1 100 0 1 BIT_MASK 0x1 FORMAT "%5.3" ECU_ADDRESS 0x8036E7 /end MEASUREMENT
/begin MEASUREMENT DP_TrvrDyn_SnglVal "" UBYTE DC_CNTR_U8 1 100 0 255 FORMAT "%5.1" ECU_ADDRESS 0x8036E1 /end MEASUREMENT
/begin MEASUREMENT drkuke_w "Delta relative Kraftstoffmasse Ersatzwert" UWORD rel_uw_q0p1875 1 100 0 12287.8 FORMAT "%8.2" ECU_ADDRESS 0x801704 /end MEASUREMENT
/begin MEASUREMENT drlfue_w "Lastkorrektur des F¸llungsreglers" SWORD rel_q0p02344 1 100 -768 767.977 FORMAT "%8.4" ECU_ADDRESS 0x8014CA /end MEASUREMENT
/begin MEASUREMENT drlm_w "Soll- Istwertdifferenz des Luftmassenreglers" SWORD rel_q0p02344 1 100 -768 767.977 FORMAT "%8.4" ECU_ADDRESS 0x8014CC /end MEASUREMENT
/begin MEASUREMENT drlsolmf_w "delta Sollf¸llung f¸r medianfilter" UWORD rel_uw_q0p0234 1 100 0 1535.98 FORMAT "%8.3" ECU_ADDRESS 0x80149C /end MEASUREMENT
/begin MEASUREMENT dtevAusBitsNov "" UBYTE dez 1 100 0 255 FORMAT "%5.1" ECU_ADDRESS 0x7FC7AC /end MEASUREMENT
/begin MEASUREMENT DTEVbit "" UBYTE dez 1 100 0 255 FORMAT "%5.1" ECU_ADDRESS 0x8011C8 /end MEASUREMENT
/begin MEASUREMENT DTHMlokBits "" UBYTE dez 1 100 0 255 FORMAT "%5.1" ECU_ADDRESS 0x801212 /end MEASUREMENT
/begin MEASUREMENT dthmtm "Delta Thermostat-Modelltemperatur zu gemessener Motortemperatur" UBYTE temp_ub_b191p25 1 100 0 191.25 FORMAT "%5.1" ECU_ADDRESS 0x800CAB /end MEASUREMENT
/begin MEASUREMENT duf_c "Zeitz‰hler f¸rs Setzen der Zyklusflags der Funktions¸berwachungs-Diagnose" UBYTE t100msxs_ub_b25p5 1 100 0 25.5 FORMAT "%5.2" ECU_ADDRESS 0x801096 /end MEASUREMENT
/begin MEASUREMENT dvrabe_w "Delta Geschwindigkeit bei Beschleunigungsrampe" UWORD vfzg_uw_b512 1 100 0 511.992 FORMAT "%8.4" ECU_ADDRESS 0x801866 /end MEASUREMENT
/begin MEASUREMENT dvrave_w "Delta Geschwindigkeit bei Verzˆgerungsrampe" UWORD vfzg_uw_b512 1 100 0 511.992 FORMAT "%8.4" ECU_ADDRESS 0x801868 /end MEASUREMENT
/begin MEASUREMENT dvzvi_w "Differenz zwischen Ziel- und Istgeschwindigkeit" SWORD vfzg_sw_q0p00781 1 100 -256 255.992 FORMAT "%8.4" ECU_ADDRESS 0x80186A /end MEASUREMENT
/begin MEASUREMENT dwdksugd_w "Delta Sollwinkel Drosselklappe ab Beginn ungedrosselt (ps/pvdkds=0.95)" UWORD rel_uw_b100 1 100 0 99.9985 FORMAT "%8.5" ECU_ADDRESS 0x80149E /end MEASUREMENT
/begin MEASUREMENT dwdksumx_w "Delta Sollwinkel Drosselklappe Beginn ungedrosselt bis Maximum" UWORD rel_uw_b100 1 100 0 99.9985 FORMAT "%8.5" ECU_ADDRESS 0x8014A0 /end MEASUREMENT
/begin MEASUREMENT dwdks_w "ƒnderung des Drosselklappen-Sollwinkels" UWORD relDK_uw_b100 1 100 0 100 FORMAT "%8.4" ECU_ADDRESS 0x8014B6 /end MEASUREMENT
/begin MEASUREMENT dwfk_w "Wandfilmmengendifferenz Kurzzeitanteil" SWORD rel_q0p09375 1 100 -3072 3071.91 FORMAT "%8.3" ECU_ADDRESS 0x801706 /end MEASUREMENT
/begin MEASUREMENT dwfl_w "Wandfilmmengendifferenz Langzeitanteil" SWORD rel_q0p09375 1 100 -3072 3071.91 FORMAT "%8.3" ECU_ADDRESS 0x801708 /end MEASUREMENT
/begin MEASUREMENT dwf_w "Wandfilmmengendifferenz" SWORD rel_q0p09375 1 100 -3072 3071.91 FORMAT "%8.3" ECU_ADDRESS 0x80170A /end MEASUREMENT
/begin MEASUREMENT ei_dufska "Diagnose ‹berwachungsfunktion hat den 1. Fehler irreversible SKA gespeichert" UWORD B_TRUE 1 100 0 1 BIT_MASK 0x1 FORMAT "%13.11" ECU_ADDRESS 0x7FA60D /end MEASUREMENT
/begin MEASUREMENT errorCntAskTcsort "" UBYTE dez 1 100 0 255 FORMAT "%5.1" ECU_ADDRESS 0x800CCE /end MEASUREMENT
/begin MEASUREMENT errorCntTcsort "" UBYTE dez 1 100 0 255 FORMAT "%5.1" ECU_ADDRESS 0x800CCF /end MEASUREMENT
/begin MEASUREMENT esnswlbits "" UBYTE default 1 100 0 255 FORMAT "%5.1" ECU_ADDRESS 0x80119A /end MEASUREMENT
/begin MEASUREMENT esst_snm08gkuw "" ULONG dez 1 100 0 4.29497e+009 FORMAT "%13.2" ECU_ADDRESS 0x801D80 /end MEASUREMENT
/begin MEASUREMENT esst_srl08gkub "" ULONG dez 1 100 0 4.29497e+009 FORMAT "%13.2" ECU_ADDRESS 0x801D84 /end MEASUREMENT
/begin MEASUREMENT etazwif "Ist-Z¸ndwinkelwirkungsgrad: f¸r DTEV gefilterter Wert" UBYTE rel_ub_b127p5 1 100 0 127.5 FORMAT "%5.1" ECU_ADDRESS 0x800BCD /end MEASUREMENT
/begin MEASUREMENT etazwkte "korrigierter Z¸ndwinkelwirkungsgrad f¸r DTEV" UBYTE rel_ub_b127p5 1 100 0 127.5 FORMAT "%5.1" ECU_ADDRESS 0x800BCE /end MEASUREMENT
/begin MEASUREMENT E_OS_LIMIT_ctr "" ULONG dez 1 100 0 4.29497e+009 FORMAT "%13.2" ECU_ADDRESS 0x802058 /end MEASUREMENT
/begin MEASUREMENT E_ths "Fehlerflag DTHS" UWORD B_TRUE 1 100 0 1 BIT_MASK 0x1 FORMAT "%13.11" ECU_ADDRESS 0x7FCA2E /end MEASUREMENT
/begin MEASUREMENT fbakl_w "Faktor K- und L-Anteil der ‹K bei BA" SWORD fak_sw_b256 1 100 -256 255.992 FORMAT "%8.4" ECU_ADDRESS 0x800B42 /end MEASUREMENT
/begin MEASUREMENT fbans "Nachstartfaktor der ‹K bei BA" UBYTE fak_ub_b8 1 100 0 7.96875 FORMAT "%5.3" ECU_ADDRESS 0x800B3C /end MEASUREMENT
/begin MEASUREMENT fbansini_w "Startwert Faktor ‹K im Nachstart (word)" UWORD fak_uw_b8 1 100 0 7.99988 FORMAT "%8.6" ECU_ADDRESS 0x800B44 /end MEASUREMENT
/begin MEASUREMENT fbavst_w "Faktor ‹K-Verstellung bei Beschleunigungsanreicherung" SWORD fak_sw_b256 1 100 -256 255.992 FORMAT "%8.4" ECU_ADDRESS 0x800B46 /end MEASUREMENT
/begin MEASUREMENT ffzdfp "Fehlerpfadidentifikationsnummer (dfp) zum Freeze-Frame Zero" UBYTE dez 1 100 0 255 FORMAT "%5.1" ECU_ADDRESS 0x801161 /end MEASUREMENT
/begin MEASUREMENT FGRMDlokBits1 "" UWORD dez 1 100 0 65535 FORMAT "%8.2" ECU_ADDRESS 0x80186C /end MEASUREMENT
/begin MEASUREMENT FGRMDlokBits2 "" UWORD dez 1 100 0 65535 FORMAT "%8.2" ECU_ADDRESS 0x80186E /end MEASUREMENT
/begin MEASUREMENT fgru "Faktor Grundvorsteuerung" UBYTE fak_ub_b2 1 100 0 1.99219 FORMAT "%5.3" ECU_ADDRESS 0x800B2F /end MEASUREMENT
/begin MEASUREMENT fho "Korrekturfaktor Hˆhe" UBYTE fak_ub_b4 1 100 0 3.98438 FORMAT "%5.3" ECU_ADDRESS 0x800588 /end MEASUREMENT
/begin MEASUREMENT fho_w "Korrekturfaktor Hˆhe (word)" UWORD fak_uw_b4 1 100 0 3.99994 FORMAT "%8.6" ECU_ADDRESS 0x800578 /end MEASUREMENT
/begin MEASUREMENT fktns_w "Nachstartanhebung" UWORD fak_uw_b16 1 100 0 15.9998 FORMAT "%8.5" ECU_ADDRESS 0x8016F6 /end MEASUREMENT
/begin MEASUREMENT fkukaba2_w "Korrekturfaktor ‹K-Adaption BA Bank 2" UWORD fak_uw_b4 1 100 0 3.99994 FORMAT "%8.6" ECU_ADDRESS 0x80172A /end MEASUREMENT
/begin MEASUREMENT fkukaba_w "Korrekturfaktor ‹K-Adaption BA" UWORD fak_uw_b4 1 100 0 3.99994 FORMAT "%8.6" ECU_ADDRESS 0x80172C /end MEASUREMENT
/begin MEASUREMENT fkukas2_w "Korrekturfaktor aufsummiert Bank 2 ‹K-Adaption" UWORD fak_q0p0625 1 100 0 4095.94 FORMAT "%8.3" ECU_ADDRESS 0x80172E /end MEASUREMENT
/begin MEASUREMENT fkukas_w "Korrekturfaktor aufsummiert ‹K-Adaption" UWORD fak_q0p0625 1 100 0 4095.94 FORMAT "%8.3" ECU_ADDRESS 0x801730 /end MEASUREMENT
/begin MEASUREMENT fkukava2_w "Korrekturfaktor ‹K-Adaption VA Bank 2" UWORD fak_uw_b4 1 100 0 3.99994 FORMAT "%8.6" ECU_ADDRESS 0x801732 /end MEASUREMENT
/begin MEASUREMENT fkukava_w "Korrekturfaktor ‹K-Adaption VA" UWORD fak_uw_b4 1 100 0 3.99994 FORMAT "%8.6" ECU_ADDRESS 0x801734 /end MEASUREMENT
/begin MEASUREMENT flamsba_w "Faktor Lambdasoll bei Beschleunigungsanreicherung" UWORD fak_uw_b16 1 100 0 15.9998 FORMAT "%8.5" ECU_ADDRESS 0x800B50 /end MEASUREMENT
/begin MEASUREMENT flamsbg_w "Faktor Lambdasoll Begrenzung (word)" UWORD fak_uw_b2 1 100 0 1.99997 FORMAT "%8.6" ECU_ADDRESS 0x80170C /end MEASUREMENT
/begin MEASUREMENT flamsva_w "Faktor Lambdasoll bei Verzˆgerungsabmagerung" UWORD fak_uw_b16 1 100 0 15.9998 FORMAT "%8.5" ECU_ADDRESS 0x800B52 /end MEASUREMENT
/begin MEASUREMENT fnswlst_w "Faktor Nachstart und Warmlauf f¸r Max-Auswahl im Start" UWORD fak_uw_b16 1 100 0 15.9998 FORMAT "%8.5" ECU_ADDRESS 0x8016F8 /end MEASUREMENT
/begin MEASUREMENT fnswl_w "Faktor Nachstart und Warmlauf" UWORD fak_uw_b16 1 100 0 15.9998 FORMAT "%8.5" ECU_ADDRESS 0x8016FA /end MEASUREMENT
/begin MEASUREMENT fns_w "Faktor Nachstart" UWORD fak_uw_b16 1 100 0 15.9998 FORMAT "%8.5" ECU_ADDRESS 0x8016FC /end MEASUREMENT
/begin MEASUREMENT fplufi_w "Faktor( plufi_w/1013) von modellierter Absolutdruck stromabw‰rts von Luftfilter" UWORD fak_uw_b4 1 100 0 3.99994 FORMAT "%8.6" ECU_ADDRESS 0x80057A /end MEASUREMENT
/begin MEASUREMENT fpvdkds "Faktor Druck vor Drosselklappe von Drucksensor" UBYTE fak_ub_b4 1 100 0 3.98438 FORMAT "%5.3" ECU_ADDRESS 0x800589 /end MEASUREMENT
/begin MEASUREMENT fpvdkds_w "Faktor Druck vor Drosselklappe von Drucksensor (word)" UWORD fak_uw_b4 1 100 0 3.99994 FORMAT "%8.6" ECU_ADDRESS 0x80057C /end MEASUREMENT
/begin MEASUREMENT frdter_w "Faktor Regelung Referenz f¸r TE-Diagnose" UWORD fak_uw_b2 1 100 0 1.99997 FORMAT "%8.6" ECU_ADDRESS 0x800BDC /end MEASUREMENT
/begin MEASUREMENT frhol_w "Faktor Luftdichte f(Ansauglufttemp., Hˆhe) 16-Bit" UWORD fak_uw_b2 1 100 0 1.99997 FORMAT "%8.6" ECU_ADDRESS 0x80057E /end MEASUREMENT
/begin MEASUREMENT frmfdif_w "Diffrenzwert zwischen Probewert und Momentanwert" SWORD fak_sw_b1 1 100 -1 0.999969 FORMAT "%8.6" ECU_ADDRESS 0x800BDE /end MEASUREMENT
/begin MEASUREMENT frmfref_w "gefilterter Referenzwert fr f¸r DTEV Ausfsteuerpr¸fung" UWORD fak_uw_b2 1 100 0 1.99997 FORMAT "%8.6" ECU_ADDRESS 0x800BE0 /end MEASUREMENT
/begin MEASUREMENT frmitf_w "gefilterter Mittelwert fr f¸r DTEV" UWORD fak_uw_b2 1 100 0 1.99997 FORMAT "%8.6" ECU_ADDRESS 0x800BE2 /end MEASUREMENT
/begin MEASUREMENT frmxaf_w "fr-Max-Ausschlag: Bei Stereo LR der fr, der am weitesten von 1.0 weg (gefiltert)" UWORD fak_uw_b2 1 100 0 1.99997 FORMAT "%8.6" ECU_ADDRESS 0x800BE4 /end MEASUREMENT
/begin MEASUREMENT fst0_w "Vorgesteuerter Startfaktor 16 Bit" UWORD fak_uw_b64 1 100 0 63.999 FORMAT "%8.5" ECU_ADDRESS 0x8016FE /end MEASUREMENT
/begin MEASUREMENT fst_w "Faktor Starteinspritzung" UWORD fak_uw_b64 1 100 0 63.999 FORMAT "%8.5" ECU_ADDRESS 0x801700 /end MEASUREMENT
/begin MEASUREMENT fthozs_w "Faktor Korrektur Hˆhe und Temperatur" UWORD fak_uw_b2 1 100 0 1.99997 FORMAT "%8.6" ECU_ADDRESS 0x800BE6 /end MEASUREMENT
/begin MEASUREMENT ftineo_w "Faktor Einspritzzeit nach Einlaﬂventil ˆffnen" UWORD fak_uw_b2 1 100 0 1.99997 FORMAT "%8.6" ECU_ADDRESS 0x80170E /end MEASUREMENT
/begin MEASUREMENT fukabak_w "‹K-Adaptionsfaktor (kalter Motor) BA" UWORD fak_uw_b4 1 100 0 3.99994 FORMAT "%8.6" ECU_ADDRESS 0x7FC770 /end MEASUREMENT
/begin MEASUREMENT fukabaw_w "‹K-Adaptionsfaktor (warmer Motor) BA" UWORD fak_uw_b4 1 100 0 3.99994 FORMAT "%8.6" ECU_ADDRESS 0x7FC772 /end MEASUREMENT
/begin MEASUREMENT fukaba_w "‹K-Adaptions-Faktor BA" UWORD fak_uw_b4 1 100 0 3.99994 FORMAT "%8.6" ECU_ADDRESS 0x800B54 /end MEASUREMENT
/begin MEASUREMENT fukavak_w "‹K-Adaptionsfaktor (kalter Motor) VA" UWORD fak_uw_b4 1 100 0 3.99994 FORMAT "%8.6" ECU_ADDRESS 0x7FC774 /end MEASUREMENT
/begin MEASUREMENT fukavaw_w "‹K-Adaptionsfaktor (warmer Motor) VA" UWORD fak_uw_b4 1 100 0 3.99994 FORMAT "%8.6" ECU_ADDRESS 0x7FC776 /end MEASUREMENT
/begin MEASUREMENT fukava_w "‹K-Adaptions-Faktor VA" UWORD fak_uw_b4 1 100 0 3.99994 FORMAT "%8.6" ECU_ADDRESS 0x800B56 /end MEASUREMENT
/begin MEASUREMENT fvaklw_w "Faktor K- und L-Anteil der ‹K bei VA, gewichtet lambdaabh‰ngigem Faktor fvaladif" SWORD fak_sw_b256 1 100 -256 255.992 FORMAT "%8.4" ECU_ADDRESS 0x801710 /end MEASUREMENT
/begin MEASUREMENT fvakl_w "Faktor K- und L-Anteil der ‹K bei VA" SWORD fak_sw_b256 1 100 -256 255.992 FORMAT "%8.4" ECU_ADDRESS 0x800B48 /end MEASUREMENT
/begin MEASUREMENT fvaladif "Wichtungsfaktor Verzˆgerungsabmagerung bie Labdaist > 1.0" UBYTE fak_ub_b1 1 100 0 0.996094 ECU_ADDRESS 0x8011A2 /end MEASUREMENT
/begin MEASUREMENT fvans "Nachstartfaktor der ‹K bei VA" UBYTE fak_ub_b8 1 100 0 7.96875 FORMAT "%5.3" ECU_ADDRESS 0x800B3D /end MEASUREMENT
/begin MEASUREMENT fvavst_w "Faktor ‹K-Verstellung bei Verzˆgerungsabmagerung" SWORD fak_sw_b256 1 100 -256 255.992 FORMAT "%8.4" ECU_ADDRESS 0x800B4A /end MEASUREMENT
/begin MEASUREMENT fwe "Faktor Wiedereinsetzen" UBYTE fak_ub_b2 1 100 0 1.99219 FORMAT "%5.3" ECU_ADDRESS 0x8011A9 /end MEASUREMENT
/begin MEASUREMENT fwfkorr_w "Faktor Wandfilm Korrektur" UWORD fak_uw_b2 1 100 0 1.99997 FORMAT "%8.6" ECU_ADDRESS 0x801712 /end MEASUREMENT
/begin MEASUREMENT fwl "Faktor Warmlauf" UBYTE fak_ub_b2 1 100 0 1.99219 FORMAT "%5.3" ECU_ADDRESS 0x80119B /end MEASUREMENT
/begin MEASUREMENT fwlrl "Faktor Warmlauf lastabh‰ngiger Anteil" UBYTE fak_ub_b2 1 100 0 1.99219 FORMAT "%5.3" ECU_ADDRESS 0x80119C /end MEASUREMENT
/begin MEASUREMENT fwnslbk_w "Faktor Wichtung Nachstart in Abh‰ngigkeit von der LBK" UWORD fak_uw_b2 1 100 0 1.99997 FORMAT "%8.6" ECU_ADDRESS 0x800B32 /end MEASUREMENT
/begin MEASUREMENT fwnsnw_w "Faktor Wichtung Nachstartfaktor in Abh‰ngigkeit von der Nockenwellenverstellung" UWORD fak_uw_b2 1 100 0 1.99997 FORMAT "%8.6" ECU_ADDRESS 0x800B34 /end MEASUREMENT
/begin MEASUREMENT fwwllbk "Faktor Wichtung Warmlauf in Abh. von der LBK" UBYTE fak_ub_b2 1 100 0 1.99219 FORMAT "%5.3" ECU_ADDRESS 0x800B30 /end MEASUREMENT
/begin MEASUREMENT fwwlnw "Faktor Wichtung Warmlauffaktor in Abh‰ngigkeit von der Nockenwellenverstellung" UBYTE fak_ub_b2 1 100 0 1.99219 FORMAT "%5.3" ECU_ADDRESS 0x800B31 /end MEASUREMENT
/begin MEASUREMENT fzans1 "Faktor Abregelung Nachstart ohne Ber¸cksichtigung des Startmengenadaptionswerts" UBYTE fak_ub_b0p25 1 100 0 0.249023 FORMAT "%11.9" ECU_ADDRESS 0x80119D /end MEASUREMENT
/begin MEASUREMENT Gear_State "" UBYTE DC_CNTR_U8 1 100 0 16 FORMAT "%5.2" ECU_ADDRESS 0x803995 /end MEASUREMENT
/begin MEASUREMENT Gear_State_CVT "" UBYTE DC_CNTR_U8 1 100 0 16 FORMAT "%5.2" ECU_ADDRESS 0x803996 /end MEASUREMENT
/begin MEASUREMENT Gear_State_CVT_Raw "" UBYTE DC_CNTR_U8 1 100 0 16 FORMAT "%5.2" ECU_ADDRESS 0x803997 /end MEASUREMENT
/begin MEASUREMENT Gear_State_MTX "" UBYTE DC_CNTR_U8 1 100 0 16 FORMAT "%5.2" ECU_ADDRESS 0x803998 /end MEASUREMENT
/begin MEASUREMENT Gear_State_TCM "" UBYTE DC_CNTR_U8 1 100 0 16 FORMAT "%5.2" ECU_ADDRESS 0x803999 /end MEASUREMENT
/begin MEASUREMENT handsst "Zwischengrˆﬂe zur Gangberechnung NSG" UBYTE DC_CNTR_U8 1 100 0 6 FORMAT "%5.3" ECU_ADDRESS 0x80399A /end MEASUREMENT
/begin MEASUREMENT kfgr_w "Verst‰rkungsfaktor FGR-Regler" UWORD rel_uw_b3200 1 100 0 3199.95 FORMAT "%8.3" ECU_ADDRESS 0x801870 /end MEASUREMENT
/begin MEASUREMENT kl_twstt_w "Ausgang Kennlinie TWSTT" UWORD t1sxs_uw_q1 1 100 0 65535 FORMAT "%8.2" ECU_ADDRESS 0x800B38 /end MEASUREMENT
/begin MEASUREMENT m6cthm "Mode 6 - Speicher: Component ID f¸r Thermostat-Monitoring" UBYTE dez 1 100 0 255 FORMAT "%5.1" ECU_ADDRESS 0x7FC7DE /end MEASUREMENT
/begin MEASUREMENT m6sthm_w "Mode 6 - Speicher: Schwellwert f¸r Thermostat-Monitoring" UWORD dez 1 100 0 65535 FORMAT "%8.2" ECU_ADDRESS 0x7FC7E0 /end MEASUREMENT
/begin MEASUREMENT m6wthm_w "Mode 6 - Speicher: Meﬂwert f¸r Thermostat-Monitoring" UWORD dez 1 100 0 65535 FORMAT "%8.2" ECU_ADDRESS 0x7FC7E2 /end MEASUREMENT
/begin MEASUREMENT m6zwwthm "Zwischenwert f¸r Mode 6 - Meﬂwert f¸r Thermostat-Monitoring" UBYTE dez 1 100 0 255 FORMAT "%5.1" ECU_ADDRESS 0x800CAC /end MEASUREMENT
/begin MEASUREMENT mi_duf "Istmoment beim Ansprechen des Momentenvergleichs in der Funktions¸berwachung" UBYTE rel_ub_b99p6 1 100 0 99.6094 FORMAT "%5.2" ECU_ADDRESS 0x801097 /end MEASUREMENT
/begin MEASUREMENT mletanzs_w "Zwischenspeicher: Auf den Z¸ndwinkelwirkungsgrad 100% normierter Luftmassenstrom" UWORD m_q0p004 1 100 0 262.14 FORMAT "%8.4" ECU_ADDRESS 0x800BE8 /end MEASUREMENT
/begin MEASUREMENT mletan_w "Auf den Z¸ndwinkelwirkungsgrad 100% normierter Luftmassenstrom" UWORD m_q0p004 1 100 0 262.14 FORMAT "%8.4" ECU_ADDRESS 0x800BEA /end MEASUREMENT
/begin MEASUREMENT mpfad "Momenten-Pfad in Funktion und Funktions¸berwachung als Umweltbedingung f¸r Diag." UBYTE dez 1 100 0 255 FORMAT "%5.1" ECU_ADDRESS 0x801098 /end MEASUREMENT
/begin MEASUREMENT mrfgri_w "Relatives Moment Initialisierungswert f¸r FGR-Regler" UWORD rel_uw_b200 1 100 0 199.997 FORMAT "%8.4" ECU_ADDRESS 0x801872 /end MEASUREMENT
/begin MEASUREMENT mrfgrm_w "Relativer Momentenwunsch von FGR (aus ME)" UWORD rel_uw_b200 1 100 0 199.997 FORMAT "%8.4" ECU_ADDRESS 0x801874 /end MEASUREMENT
/begin MEASUREMENT mrfgru_w "Untere Grenze f¸r relatives Moment aus FGR" UWORD rel_uw_b200 1 100 0 199.997 FORMAT "%8.4" ECU_ADDRESS 0x801862 /end MEASUREMENT
/begin MEASUREMENT mrfgrv_w "Relativer Momentenwunsch aus FGR vor Begrenzung" UWORD rel_uw_b200 1 100 0 199.997 FORMAT "%8.4" ECU_ADDRESS 0x80188A /end MEASUREMENT
/begin MEASUREMENT mrfgr_w "Relative Momentenanforderung von FGR" UWORD rel_uw_b200 1 100 0 199.997 FORMAT "%8.4" ECU_ADDRESS 0x801864 /end MEASUREMENT
/begin MEASUREMENT mrregl_w "Relatives Moment Reglerausgang FGR" UWORD rel_uw_b200 1 100 0 199.997 FORMAT "%8.4" ECU_ADDRESS 0x801876 /end MEASUREMENT
/begin MEASUREMENT mrrgli_w "Initialisierungswert Relatives Moment f¸r FGR-Regler" UWORD rel_uw_b200 1 100 0 199.997 FORMAT "%8.4" ECU_ADDRESS 0x801878 /end MEASUREMENT
/begin MEASUREMENT msdkoo_w "Massenstrom Drosselklappe ohne offset" UWORD m_q0p1 1 100 0 6553.5 FORMAT "%8.3" ECU_ADDRESS 0x800BEC /end MEASUREMENT
/begin MEASUREMENT msndkoos_w "Normierter Luftmassenstrom f¸r Sollwinkelbestimmung Drosselklappe" UWORD m_uw_b6553p5 1 100 0 6553.5 FORMAT "%8.3" ECU_ADDRESS 0x8014A2 /end MEASUREMENT
/begin MEASUREMENT msndkoug_w "Normmassenstrom ¸ber DK ohne Leckluft bei ps/pvdk=0.95 (ungedrosselt)" UWORD m_uw_b6553p5 1 100 0 6553.5 FORMAT "%8.3" ECU_ADDRESS 0x8014A4 /end MEASUREMENT
/begin MEASUREMENT msndks_w "Normierter Soll-Luftmassenstrom durch Drosselvorrichtung" UWORD m_uw_b6553p5 1 100 0 6553.5 FORMAT "%8.3" ECU_ADDRESS 0x8014A6 /end MEASUREMENT
/begin MEASUREMENT msndkugd_w "Normmassenstrom ¸ber DK bei ps/pvdk=0.95 (ungedrosselt)" UWORD m_uw_b6553p5 1 100 0 6553.5 FORMAT "%8.3" ECU_ADDRESS 0x8014A8 /end MEASUREMENT
/begin MEASUREMENT mstedtef_w "Massenstrom Tankentl¸ftungsventil (gefiltert) f¸r DTEV" UWORD m_q0p0031 1 100 0 204.797 FORMAT "%8.4" ECU_ADDRESS 0x800BEE /end MEASUREMENT
/begin MEASUREMENT nrmverh "Quotient aus Rad-/Motordrehzahl" UWORD DC_FKT32768 1 100 0 1.99997 FORMAT "%8.6" ECU_ADDRESS 0x80337A /end MEASUREMENT
/begin MEASUREMENT nsactr "Nachstartcounter" UBYTE fak_ub_b2 1 100 0 1.99219 FORMAT "%5.3" ECU_ADDRESS 0x80119E /end MEASUREMENT
/begin MEASUREMENT nswrl "Ausgang KF KFNSWRL Wichtung Nachstartanhebung" UBYTE fak_ub_b2 1 100 0 1.99219 FORMAT "%5.3" ECU_ADDRESS 0x80119F /end MEASUREMENT
/begin MEASUREMENT OWRatio_Rel "" UWORD DC_CNTR_U16 1 100 0 32767 FORMAT "%8.2" ECU_ADDRESS 0x803040 /end MEASUREMENT
/begin MEASUREMENT pac "K¸hlmitteldruck in der Klimaanlage" UBYTE p_q117p647 1 100 0 30000 FORMAT "%5.0" ECU_ADDRESS 0x800500 /end MEASUREMENT
/begin MEASUREMENT pach "K¸hlmitteldruck in der Klimaanlage" UBYTE p_q156p86 1 100 0 39999.3 FORMAT "%5.0" ECU_ADDRESS 0x800501 /end MEASUREMENT
/begin MEASUREMENT pach_w "K¸hlmitteldruck in der Klimaanlage" UWORD p_q0p9155 1 100 0 60000.9 FORMAT "%8.2" ECU_ADDRESS 0x800502 /end MEASUREMENT
/begin MEASUREMENT pac_w "K¸hlmitteldruck in der Klimaanlage" UWORD p_q0p9155 1 100 0 60000.9 FORMAT "%8.2" ECU_ADDRESS 0x800504 /end MEASUREMENT
/begin MEASUREMENT plufi_w "modellierter Absolutdruck stromabw‰rts von Luftfilter" UWORD p_uw_q0p039 1 100 0 2559.96 FORMAT "%8.3" ECU_ADDRESS 0x800580 /end MEASUREMENT
/begin MEASUREMENT PNTgtGear_Mode "" UBYTE DC_FLAG_U8 1 100 0 1 BIT_MASK 0x1 FORMAT "%5.3" ECU_ADDRESS 0x80399B /end MEASUREMENT
/begin MEASUREMENT PN_Mode "" UBYTE DC_FLAG_U8 1 100 0 1 BIT_MASK 0x1 FORMAT "%5.3" ECU_ADDRESS 0x80399C /end MEASUREMENT
/begin MEASUREMENT psdss "Saugrohrdruck gemessen mit Drucksensor am Saugrohr (DS-S)" UBYTE p_ub_q10 1 100 0 2550 FORMAT "%5.0" ECU_ADDRESS 0x8010A3 /end MEASUREMENT
/begin MEASUREMENT psdssi "Saugrohrdruck gemessen mit Drucksensor am Saugrohr (DS-S) intern" UBYTE p_ub_q10 1 100 0 2550 FORMAT "%5.0" ECU_ADDRESS 0x8010A4 /end MEASUREMENT
/begin MEASUREMENT psdssi_w "Saugrohrdruck gemessen mit Drucksensor am Saugrohr (DS-S) intern" UWORD p_uw_q0p039 1 100 0 2559.96 FORMAT "%8.3" ECU_ADDRESS 0x8013C6 /end MEASUREMENT
/begin MEASUREMENT psdss_w "Saugrohrdruck gemessen mit Drucksensor am Saugrohr (DS-S)" UWORD p_uw_q0p039 1 100 0 2559.96 FORMAT "%8.3" ECU_ADDRESS 0x8013C8 /end MEASUREMENT
/begin MEASUREMENT pu "Umgebungsdruck" UBYTE p_ub_q5 1 100 0 1275 FORMAT "%5.0" ECU_ADDRESS 0x80058A /end MEASUREMENT
/begin MEASUREMENT pus_w "Umgebungsdruck ohne Umschaltung auf Ersatzwert bei Sensorfehler" UWORD p_uw_q0p039 1 100 0 2559.96 FORMAT "%8.3" ECU_ADDRESS 0x800582 /end MEASUREMENT
/begin MEASUREMENT pu_w "Umgebungsdruck" UWORD p_uw_q0p039 1 100 0 2559.96 FORMAT "%8.3" ECU_ADDRESS 0x800584 /end MEASUREMENT
/begin MEASUREMENT pvdkds "Druck vor Drosselklappe von Drucksensor" UBYTE p_ub_q10 1 100 0 2550 FORMAT "%5.0" ECU_ADDRESS 0x80058B /end MEASUREMENT
/begin MEASUREMENT pvdkds_w "Druck vor Drosselklappe von Drucksensor (word)" UWORD p_uw_q0p039 1 100 0 2559.96 FORMAT "%8.3" ECU_ADDRESS 0x800586 /end MEASUREMENT
/begin MEASUREMENT rkuke_w "rel. Kraftstoffmasse ‹bergangskompensation Ersatzwert" SWORD rel_sw_q0p0468 1 100 -1536 1535.95 FORMAT "%8.3" ECU_ADDRESS 0x801714 /end MEASUREMENT
/begin MEASUREMENT rkukg_w "rel. Kraftstoffmasse ‹bergangskompensation" SWORD rel_sw_q0p0468 1 100 -1536 1535.95 FORMAT "%8.3" ECU_ADDRESS 0x801716 /end MEASUREMENT
/begin MEASUREMENT rkukkl_w "Kurz- und Langzeitanteil der UK" SWORD rel_sw_q0p0468 1 100 -1536 1535.95 FORMAT "%8.3" ECU_ADDRESS 0x801718 /end MEASUREMENT
/begin MEASUREMENT rkukkt_w "rk-Kurzzeitanteil der UK totzeitverschoben (UK-Adaption)" SWORD rel_sw_q0p1875 1 100 -6144 6143.81 FORMAT "%8.3" ECU_ADDRESS 0x801736 /end MEASUREMENT
/begin MEASUREMENT rkukk_w "rk-Kurzzeitanteil der UK" SWORD rel_sw_q0p0468 1 100 -1536 1535.95 FORMAT "%8.3" ECU_ADDRESS 0x80171A /end MEASUREMENT
/begin MEASUREMENT rkukl_w "rk-Langzeitanteil der UK" SWORD rel_sw_q0p0468 1 100 -1536 1535.95 FORMAT "%8.3" ECU_ADDRESS 0x80171C /end MEASUREMENT
/begin MEASUREMENT rkuk_w "rel. Kraftstoffmasse ‹bergangskompensation ohne Verstelleingriffe" SWORD rel_sw_q0p0468 1 100 -1536 1535.95 FORMAT "%8.3" ECU_ADDRESS 0x80171E /end MEASUREMENT
/begin MEASUREMENT rltedte_w "Aus DTEV ermittelte relative F¸llung ¸ber das Tankentl¸ftungsventil" UWORD rel_uw_q0p0234 1 100 0 1535.98 FORMAT "%8.3" ECU_ADDRESS 0x800BF0 /end MEASUREMENT
/begin MEASUREMENT rmstevf_w "aktueller Meﬂwert f¸r relative TEV-G¸te" SWORD rel_sw_b200 1 100 -200 199.994 FORMAT "%8.4" ECU_ADDRESS 0x800BF2 /end MEASUREMENT
/begin MEASUREMENT rmstevuf_w "aktueller, unsigned Meﬂwert f¸r relative TEV-G¸te" UWORD rel_uw_b200 1 100 0 199.997 FORMAT "%8.4" ECU_ADDRESS 0x800BF4 /end MEASUREMENT
/begin MEASUREMENT rmstev_w "Langzeitgespeicherter Meﬂwert der relativen TEV-G¸te" UWORD rel_uw_b200 1 100 0 199.997 FORMAT "%8.4" ECU_ADDRESS 0x7FC7A6 /end MEASUREMENT
/begin MEASUREMENT rstMon_um "" UWORD dez 1 100 0 65535 FORMAT "%8.2" ECU_ADDRESS 0x7F817A /end MEASUREMENT
/begin MEASUREMENT rstpfad "Reset-Pfad als Umweltbedingung f¸r Rechner¸berwachungs-Diagnoseeintrag" UBYTE dez 1 100 0 255 FORMAT "%5.1" ECU_ADDRESS 0x801095 /end MEASUREMENT
/begin MEASUREMENT sdwfk_w "Speicherinhalt der Wandfilmdifferenz f¸r Kurzzeitanteil" SWORD rel_q0p09375 1 100 -3072 3071.91 FORMAT "%8.3" ECU_ADDRESS 0x801720 /end MEASUREMENT
/begin MEASUREMENT sdwfl_w "Speicherinhalt der Wandfilmdifferenz f¸r Langzeitanteil" SWORD rel_q0p09375 1 100 -3072 3071.91 FORMAT "%8.3" ECU_ADDRESS 0x801722 /end MEASUREMENT
/begin MEASUREMENT sfpths "Status Fehlerpfad DTHS" UWORD dez 1 100 0 65535 FORMAT "%8.2" ECU_ADDRESS 0x7FCA2E /end MEASUREMENT
/begin MEASUREMENT tadtea "TEV-Tastverh‰ltnis aus Tankentl¸ftungsdiagnose" UBYTE rel_ub_b99p6 1 100 0 99.6094 FORMAT "%5.2" ECU_ADDRESS 0x800BCF /end MEASUREMENT
/begin MEASUREMENT tadteazs "Letzter Tastverh‰ltniswert aus Tankentl¸ftungsdiagnose" UBYTE rel_ub_b99p6 1 100 0 99.6094 FORMAT "%5.2" ECU_ADDRESS 0x800BD0 /end MEASUREMENT
/begin MEASUREMENT tanwrhf "Adaptiertes Halte-Tastverh‰ltnis (NW-Regelung)" UBYTE tv_ub_b100 1 100 0 99.6094 FORMAT "%5.2" ARRAY_SIZE 2 ECU_ADDRESS 0x801224 /end MEASUREMENT
/begin MEASUREMENT tc6tesc "Ausgabe-Code SCAN-Tool Mode 6 aus TES-Diagnose" UBYTE dez 1 100 0 255 FORMAT "%5.1" ECU_ADDRESS 0x7FC7A4 /end MEASUREMENT
/begin MEASUREMENT tc6tess "Ausgabe Schwellwert SCAN-Tool Mode 6 aus TES-Diagnose" UWORD dez 1 100 0 65535 FORMAT "%8.2" ECU_ADDRESS 0x7FC7A8 /end MEASUREMENT
/begin MEASUREMENT tc6tesw "Ausgabe Pr¸fwert SCAN-Tool Mode 6 aus TES-Diagnose" UWORD dez 1 100 0 65535 FORMAT "%8.2" ECU_ADDRESS 0x7FC7AA /end MEASUREMENT
/begin MEASUREMENT tdtesta "Zeit DTEV Aufsteuerpr¸fung aktiv" UBYTE t100msxs_ub_b25p5 1 100 0 25.5 FORMAT "%5.2" ECU_ADDRESS 0x800BD1 /end MEASUREMENT
/begin MEASUREMENT tdtetevo "Zeit Tastverh‰lnis aus DTEV grˆﬂer Schwelle" UBYTE t100msxs_ub_b25p5 1 100 0 25.5 FORMAT "%5.2" ECU_ADDRESS 0x800BD2 /end MEASUREMENT
/begin MEASUREMENT TgtGear_State "" UBYTE DC_CNTR_U8 1 100 0 16 FORMAT "%5.2" ECU_ADDRESS 0x80399D /end MEASUREMENT
/begin MEASUREMENT thmdmm "berechneter Minimalwert der Motortemperatur aus Motor-Temperaturmodell f¸r DTHM" UBYTE temp_ub_q0p75_o48 1 100 -48 143.25 FORMAT "%5.1" ECU_ADDRESS 0x800CAD /end MEASUREMENT
/begin MEASUREMENT tmnuka "Minimalzeit zwischen 2 Adaptionsvorg‰ngen (‹K-Adaption)" UWORD t10msxs_ub_b2p55 1 100 0 655.35 FORMAT "%8.4" ECU_ADDRESS 0x801738 /end MEASUREMENT
/begin MEASUREMENT tmotnldiff "Differenz der Motortemperatur im SG-Nachlauf" UBYTE temp_ub_b191p25 1 100 0 191.25 FORMAT "%5.1" ECU_ADDRESS 0x801702 /end MEASUREMENT
/begin MEASUREMENT tmotnlmx "Maximale Motortemperatur w‰hrend SG-Nachlauf" UBYTE temp_ub_q0p75_o48 1 100 -48 143.25 FORMAT "%5.1" ECU_ADDRESS 0x7FC76F /end MEASUREMENT
/begin MEASUREMENT Tmr100ms_hw "" UWORD DC_CNTR_U16 1 100 0 65535 FORMAT "%8.2" ECU_ADDRESS 0x8030CA /end MEASUREMENT
/begin MEASUREMENT Tmr100ms_lw "" UWORD DC_CNTR_U16 1 100 0 65535 FORMAT "%8.2" ECU_ADDRESS 0x8030CC /end MEASUREMENT
/begin MEASUREMENT tmstem "Motortemperatur bei Startende in Memory" UBYTE temp_ub_q0p75_o48 1 100 -48 143.25 FORMAT "%5.1" ECU_ADDRESS 0x80066F /end MEASUREMENT
/begin MEASUREMENT tn2fgr_w "Doppelte Nennerzeitkonstante FGR-Regler" UWORD t20msxs_uw_q0p02 1 100 0 1310.7 FORMAT "%8.3" ECU_ADDRESS 0x80187A /end MEASUREMENT
/begin MEASUREMENT tntevzu "Zeit nach Schlieﬂen des TEVs" UBYTE t100msxs_ub_b25p5 1 100 0 25.5 FORMAT "%5.2" ECU_ADDRESS 0x800BD3 /end MEASUREMENT
/begin MEASUREMENT top_w "Operating time seit powerfail" UWORD t6minxmin_q6 1 100 0 393210 FORMAT "%8.1" ECU_ADDRESS 0x7FC384 /end MEASUREMENT
/begin MEASUREMENT tpbauka "Entrellzeit f¸r Erkennung Beschleunigung (‹K-Adaption)" UBYTE t10msxs_ub_b2p55 1 100 0 2.55 FORMAT "%5.3" ECU_ADDRESS 0x8011A5 /end MEASUREMENT
/begin MEASUREMENT tpvauka "Entprellzeit f¸r Erkennung Verzˆgerung (‹K-Adaption)" UBYTE t10msxs_ub_b2p55 1 100 0 2.55 FORMAT "%5.3" ECU_ADDRESS 0x8011A6 /end MEASUREMENT
/begin MEASUREMENT Trans_Ratio "" UBYTE DC_FCTR_50_U8 1 100 0 5.1 FORMAT "%8.6" ECU_ADDRESS 0x80399E /end MEASUREMENT
/begin MEASUREMENT Trans_Ratio_Calc "" UBYTE DC_FCTR_50_U8 1 100 0 5.1 FORMAT "%8.6" ECU_ADDRESS 0x80399F /end MEASUREMENT
/begin MEASUREMENT Trans_Rvrs_Mode "" UBYTE DC_FLAG_U8 1 100 0 1 BIT_MASK 0x1 FORMAT "%5.3" ECU_ADDRESS 0x8039A0 /end MEASUREMENT
/begin MEASUREMENT tvfrrdte "Verzˆgerungszeit f¸r Zur¸cksetzen des Lambda-Reglers nach Schlieﬂen des TEVs" UBYTE t100msxs_ub_b25p5 1 100 0 25.5 FORMAT "%5.2" ECU_ADDRESS 0x800BD4 /end MEASUREMENT
/begin MEASUREMENT tz2fgr_w "Doppelte Z‰hlerzeitkonstante FGR-Regler" UWORD t20msxs_uw_q0p02 1 100 0 1310.7 FORMAT "%8.3" ECU_ADDRESS 0x80187C /end MEASUREMENT
/begin MEASUREMENT udsm_w "Drucksensorspannung ¸ber ein Segment gemittelt (word)" UWORD spg_uw_q0p000076 1 100 0 4.99992 FORMAT "%8.6" ECU_ADDRESS 0x8013CA /end MEASUREMENT
/begin MEASUREMENT ukafrtmo_w "Obere Schwelle Faktor Lambdaregler (fr) zur Freigabe der UK-Adaption" UWORD fak_uw_b2 1 100 0 1.99997 FORMAT "%8.6" ECU_ADDRESS 0x800B58 /end MEASUREMENT
/begin MEASUREMENT ukafrtmu_w "Untere Schwelle Faktor Lambdaregler (fr) zur Freigabe der UK-Adaption" UWORD fak_uw_b2 1 100 0 1.99997 FORMAT "%8.6" ECU_ADDRESS 0x800B5A /end MEASUREMENT
/begin MEASUREMENT vfzg2 "" UBYTE vfzg_ub_q1p25 1 100 0 318.75 FORMAT "%5.1" ECU_ADDRESS 0x801049 /end MEASUREMENT
/begin MEASUREMENT vlast_w "Zus‰tzliche Offset-Geschwindigkeit f¸r FGR-Regler bei hˆherer Last" UWORD vfzg_uw_b512 1 100 0 511.992 FORMAT "%8.4" ECU_ADDRESS 0x80187E /end MEASUREMENT
/begin MEASUREMENT voffs_w "Offsetgeschwindigkeit f¸r FGR-Regler" UWORD vfzg_uw_b512 1 100 0 511.992 FORMAT "%8.4" ECU_ADDRESS 0x801880 /end MEASUREMENT
/begin MEASUREMENT vrbemx_w "Maximalwert f¸r vregl_w bei Beschleunigung" UWORD vfzg_uw_b512 1 100 0 511.992 FORMAT "%8.4" ECU_ADDRESS 0x801882 /end MEASUREMENT
/begin MEASUREMENT vregl_w "Sollgeschwindigkeit f¸r FGR-Regler" UWORD vfzg_uw_b512 1 100 0 511.992 FORMAT "%8.4" ECU_ADDRESS 0x801884 /end MEASUREMENT
/begin MEASUREMENT vrvemn_w "Minimalwert f¸r vregl_w bei Verzˆgern" UWORD vfzg_uw_b512 1 100 0 511.992 FORMAT "%8.4" ECU_ADDRESS 0x801886 /end MEASUREMENT
/begin MEASUREMENT vstvvr "Erhˆhung des Sollwerts der VMAX-Regelung ¸ber Werkstatt-Tester" UBYTE dez 1 100 0 255 FORMAT "%5.1" ECU_ADDRESS 0x801226 /end MEASUREMENT
/begin MEASUREMENT vti_w "Verh‰ltnis Einspritzzeit nach Einlaﬂventil ˆffnen zu gesamte Einspritzzeit" UWORD fak_uw_b2 1 100 0 1.99997 FORMAT "%8.6" ECU_ADDRESS 0x801724 /end MEASUREMENT
/begin MEASUREMENT vziel_w "Zielgeschwindigkeit FGR" UWORD vfzg_uw_b512 1 100 0 511.992 FORMAT "%8.4" ECU_ADDRESS 0x801888 /end MEASUREMENT
/begin MEASUREMENT wdkink_w "aktuelles Inkrement des DK-Sollwinkels" UWORD relDK_uw_b100 1 100 0 100 FORMAT "%8.4" ECU_ADDRESS 0x8014B8 /end MEASUREMENT
/begin MEASUREMENT wdkobugs_w "Soll-DK-Winkel aus Momentenstruktur ohne Begrenzung auf ungedrosselten Winkel" UWORD rel_uw_b100 1 100 0 99.9985 FORMAT "%8.5" ECU_ADDRESS 0x8014AA /end MEASUREMENT
/begin MEASUREMENT wdks "Sollwert DK-Winkel, bezogen auf unteren Anschlag" UBYTE relDK_ub_b100 1 100 0 100 FORMAT "%5.1" ECU_ADDRESS 0x8010D6 /end MEASUREMENT
/begin MEASUREMENT wdksap_w "DK-Sollwinkel aus Applikationsblock" UWORD rel_uw_b100 1 100 0 99.9985 FORMAT "%8.5" ECU_ADDRESS 0x8014AC /end MEASUREMENT
/begin MEASUREMENT wdksba2_w "DK-Sollwinkel nach der Begrenzung, Wert aus Rechenraster n-2" UWORD relDK_uw_b100 1 100 0 100 FORMAT "%8.4" ECU_ADDRESS 0x8014BA /end MEASUREMENT
/begin MEASUREMENT wdksba_w "DK-Sollwinkel nach der Begrenzung, Wert aus Rechenraster n-1" UWORD relDK_uw_b100 1 100 0 100 FORMAT "%8.4" ECU_ADDRESS 0x8014BC /end MEASUREMENT
/begin MEASUREMENT wdksb_w "DK-Sollwinkel nach der Begrenzung" UWORD relDK_uw_b100 1 100 0 100 FORMAT "%8.4" ECU_ADDRESS 0x8014BE /end MEASUREMENT
/begin MEASUREMENT wdksfl "Flankenwechselanzeige f¸r DK-Sollwert wdksap_w" SBYTE fak_sb_b1 1 100 -1 0.992188 FORMAT "%5.3" ECU_ADDRESS 0x8010D7 /end MEASUREMENT
/begin MEASUREMENT wdksgvin_w "Solldrosselklappenwinkel-Eingang in Tiefpassfilter" UWORD rel_uw_b100 1 100 0 99.9985 FORMAT "%8.5" ECU_ADDRESS 0x8014AE /end MEASUREMENT
/begin MEASUREMENT wdksgv_w "Drosselklappen-Sollwinkel vor Applikationsschnittstelle (gefiltert)" UWORD rel_uw_b100 1 100 0 99.9985 FORMAT "%8.5" ECU_ADDRESS 0x8014B0 /end MEASUREMENT
/begin MEASUREMENT wdksmx_w "max. Sollwert Drosselklappenwinkel" UWORD rel_uw_b100 1 100 0 99.9985 FORMAT "%8.5" ECU_ADDRESS 0x8005A0 /end MEASUREMENT
/begin MEASUREMENT wdksobmx_w "Soll-Drosselklappenwinkel ohne MAX-Begrenzung" UWORD rel_uw_b100 1 100 0 99.9985 FORMAT "%8.5" ECU_ADDRESS 0x8005A2 /end MEASUREMENT
/begin MEASUREMENT wdksof_w "Solldrosselklappenwinkel ohne Medianfilter" UWORD rel_uw_b100 1 100 0 99.9985 FORMAT "%8.5" ECU_ADDRESS 0x8014B2 /end MEASUREMENT
/begin MEASUREMENT wdkspa_w "pr‰dizierter DK-Winkel, Wert aus Rechenraster n-1" UWORD relDK_uw_b100 1 100 0 100 FORMAT "%8.4" ECU_ADDRESS 0x8014C0 /end MEASUREMENT
/begin MEASUREMENT wdksp_w "Pr‰dizierter Drosselklappen-Sollwinkel" UWORD relDK_uw_b100 1 100 0 100 FORMAT "%8.4" ECU_ADDRESS 0x8014C2 /end MEASUREMENT
/begin MEASUREMENT wdksvfl "Flankenwechselanzeige f¸r DK-Sollwert wdksapa_w" SBYTE fak_sb_b1 1 100 -1 0.992188 FORMAT "%5.3" ECU_ADDRESS 0x8010D8 /end MEASUREMENT
/begin MEASUREMENT wdkswe_w "DK-Sollwertschwelle f¸r pr‰diz. Entjitterung" UWORD relDK_uw_b100 1 100 0 100 FORMAT "%8.4" ECU_ADDRESS 0x8014C4 /end MEASUREMENT
/begin MEASUREMENT wdks_w "Sollwert Drosselklappenwinkel, bezogen auf (unteren) Anschlag" UWORD relDK_uw_b100 1 100 0 100 FORMAT "%8.4" ECU_ADDRESS 0x8014C6 /end MEASUREMENT
/begin MEASUREMENT wdkugd_w "Drosselklappenwinkel, bei dem 95% F¸llung erreicht wird" UWORD rel_uw_b100 1 100 0 99.9985 FORMAT "%8.5" ECU_ADDRESS 0x8014B4 /end MEASUREMENT
/begin MEASUREMENT wea "Winkelmarke Einspritzabbruch" UBYTE zw_ub_q6 1 100 0 1530 FORMAT "%5.0" ECU_ADDRESS 0x800B6E /end MEASUREMENT
/begin MEASUREMENT wee "Winkel Einspritzende im Normalbetrieb" UBYTE zw_ub_q6 1 100 0 1530 FORMAT "%5.0" ECU_ADDRESS 0x8011B8 /end MEASUREMENT
/begin MEASUREMENT weemrfa "Winkel Einspritzende im maximalem Fahrerwunschmomment" UBYTE zw_ub_q6 1 100 0 1530 FORMAT "%5.0" ECU_ADDRESS 0x8011B9 /end MEASUREMENT
/begin MEASUREMENT weenst "Winkel Einspritzende nach Startende" UBYTE zw_ub_q6 1 100 0 1530 FORMAT "%5.0" ECU_ADDRESS 0x8011BA /end MEASUREMENT
/begin MEASUREMENT weeotkrf_w "Winkel Einspritzende im Normalbetrieb ohne Flugzeit" UWORD kw_q0p0234 1 100 0 1535.98 FORMAT "%8.3" ECU_ADDRESS 0x800B4C /end MEASUREMENT
/begin MEASUREMENT weest "Winkel Einspritzende im Start" UBYTE zw_ub_q6 1 100 0 1530 FORMAT "%5.0" ECU_ADDRESS 0x8011BB /end MEASUREMENT
/begin MEASUREMENT weetm "Winkel Einspritzende Temperaturkorrektur" SBYTE zw_sb_q6 1 100 -768 762 FORMAT "%5.1" ECU_ADDRESS 0x8011BC /end MEASUREMENT
/begin MEASUREMENT wes "Winkelmarke Einlass schliesst bezogen auf Z¸nd-OT Zylinder 1" UBYTE kw_q6 1 100 0 1530 FORMAT "%5.0" ECU_ADDRESS 0x800B6F /end MEASUREMENT
/begin MEASUREMENT wf_w "Wandfilmmenge" SWORD rel_q0p09375 1 100 -3072 3071.91 FORMAT "%8.3" ECU_ADDRESS 0x801726 /end MEASUREMENT
/begin MEASUREMENT woe_w "Winkel offenes Einlaﬂventil" UWORD kw_q0p0234 1 100 0 1535.98 FORMAT "%8.3" ECU_ADDRESS 0x801728 /end MEASUREMENT
/begin MEASUREMENT wuccnt "Warm-up cycle - counter" UBYTE dez 1 100 0 255 FORMAT "%5.1" ECU_ADDRESS 0x7FC386 /end MEASUREMENT
/begin MEASUREMENT zbake "Abregelfaktor Kurzzeitanteil bei BA" UBYTE fak_q0p0039 1 100 0 0.996094 ECU_ADDRESS 0x800B3E /end MEASUREMENT
/begin MEASUREMENT zbale "Abregelfaktor Langzeitanteil bei BA" UBYTE fak_ub_b0p125 1 100 0 0.124512 FORMAT "%6.4" ECU_ADDRESS 0x800B3F /end MEASUREMENT
/begin MEASUREMENT zburnsum "Summe erkannter Verbrennungen im Start" UBYTE dez 1 100 0 255 FORMAT "%5.1" ECU_ADDRESS 0x8011A0 /end MEASUREMENT
/begin MEASUREMENT zuknstm_w "Abregelzeitkonstante ‹K-Faktor im Nachstart abh‰ngig von tmot" UWORD zk100msxs_uw_b6553 1 100 0.100002 6553.6 FORMAT "%10.5" ECU_ADDRESS 0x800B4E /end MEASUREMENT
/begin MEASUREMENT zvake "Abregelfaktor Kurzzeitanteil bei VA" UBYTE fak_q0p0039 1 100 0 0.996094 ECU_ADDRESS 0x800B40 /end MEASUREMENT
/begin MEASUREMENT zvale "Abregelfaktor Langzeitanteil bei VA" UBYTE fak_ub_b0p125 1 100 0 0.124512 FORMAT "%6.4" ECU_ADDRESS 0x800B41 /end MEASUREMENT
/begin MEASUREMENT Z_ths "Zyklusflag DTHS" UWORD B_TRUE 1 100 0 1 BIT_MASK 0x2 FORMAT "%13.11" ECU_ADDRESS 0x7FCA2E /end MEASUREMENT
/begin FUNCTION DTEV "Diagnose Tankentl¸ftungsventil (OBDII)"
 /begin DEF_CHARACTERISTIC APDTEFRE APDTEVX AVDTEVX CWDLDPTE CWDTEAPP DFRMDTEE DFRMDTEF DFRMDTEM DMLDTEFN DMLDTEFX DMLDTEMN DMLDTEMX DMSNTEMN DMSNTEMX DMVTEVDO DNDTEO DNDTEU DNNSOL ETAZWTEN FHODTEA FKADPMN FRMDPMO FRMDPMU FRMDTEVO FRMDTEVU FTEADDPO FTEADDPU FTEADSZ IMSDTEVA KFDETATE KFTVFRR KIDMSNTE KIRMSMS MLDTEFPF MLDTEPF RKADTEVO RKADTEVU RMSTEVIO RMSTEVMN RMSTEVMX TADTEAMX TADTEMX TC6TECI TC6TECL TC6TECNL TC6TECP TC6TECRF TC6TECRM TC6TECT TDTEFA TDTESZO TDTESZU TDTEZAM TFRMDTEE TMDTEU TMEWDTEU TMUDTEU TPERDTE TTEVAZ TVDTEABG TVDTEB TVDTEE TVDTELLA TVDTEVP TVDTEVPM TVDTEVZ ZFRMFIL ZFRMXAF ZKRMSTEV ZMLETAN ZMSTEDTE ZRLTEDTE /end DEF_CHARACTERISTIC
 /begin REF_CHARACTERISTIC /end REF_CHARACTERISTIC
 /begin IN_MEASUREMENT B_cdtes B_dldpte B_dllra B_dmtltz B_dsls B_edkvs B_edkvs2 B_enws B_fa B_fates B_fs B_gae B_gap B_grdst B_hag B_koe B_ll B_llr B_lr B_lr2 B_m8te B_mdarv B_nldg B_nswo1 B_pwf B_sls dfuelsan_w dmvad_w etazwist fho_w fkatei fklaf_w frmit_w frmn_w frmxa_w frmx_w ftead_w ftefsoll_w ftvdk imsteini ml ml_w msndkoo_w mstedte nmotll nsol rkat_w rkaz_w tateout tmew tmot tnse_w tumg umsrln_w vfzg /end IN_MEASUREMENT
 /begin OUT_MEASUREMENT apdtev avdtev azpdtefre B_dteaa B_dteaam B_dtefrr B_dtes B_dtest B_ftedab B_rmsval dmsnte_w dtevAusBitsNov DTEVbit frdter_w rltedte_w rmstev_w tadtea tadteazs tc6tesc tc6tess tc6tesw /end OUT_MEASUREMENT
 /begin LOC_MEASUREMENT B_dteaab B_dteabu B_dteanfl B_dteend B_dteendl B_dteenf B_dtefre B_dtelab B_dtelbm B_dtelbr B_dtelnm B_dtelnmb B_dtelnmv B_dtenam B_dtephm B_dtepm B_dterab B_dterap B_dteres B_dternm B_dtezam B_teviol B_teviolm B_teviop B_tevior B_tevnio B_tevniom detazwte dmletanf_w dmletanu dmletan_w etazwif etazwkte frmfdif_w frmfref_w frmitf_w frmxaf_w fthozs_w mletanzs_w mletan_w msdkoo_w mstedtef_w rmstevf_w rmstevuf_w tdtesta tdtetevo tntevzu tvfrrdte /end LOC_MEASUREMENT
 /begin SUB_FUNCTION /end SUB_FUNCTION
/end FUNCTION
/begin FUNCTION DTEVE "Diagnose; Tankentl¸ftungsventil - Endstufe" /begin DEF_CHARACTERISTIC CWPSTEVE /end DEF_CHARACTERISTIC /begin REF_CHARACTERISTIC /end REF_CHARACTERISTIC /begin IN_MEASUREMENT B_desee tateist /end IN_MEASUREMENT /begin OUT_MEASUREMENT /end OUT_MEASUREMENT /begin LOC_MEASUREMENT /end LOC_MEASUREMENT /begin SUB_FUNCTION /end SUB_FUNCTION /end FUNCTION
/begin FUNCTION DTHM "Diagnose Thermostat Motor-K¸hlmittel"
 /begin DEF_CHARACTERISTIC CWDTHM DTDTHM DTHMD IDTHMU KFDTHML KLSDTHMS NDTHMU TABSTTHM TC6CTHM TDTHM TDTHMO TDTHMU THMDMMA THMDMME THMDMMS TMSDTHMU TWADTHMS VDTHMU /end DEF_CHARACTERISTIC
 /begin REF_CHARACTERISTIC /end REF_CHARACTERISTIC
 /begin IN_MEASUREMENT B_ll B_nmot B_pwf B_sa B_st imlatm ml nmot tabst_w tans tmotlin tmst tum vfzg /end IN_MEASUREMENT
 /begin OUT_MEASUREMENT B_bbdthm B_cwdthm m6cthm m6sthm_w m6wthm_w /end OUT_MEASUREMENT
 /begin LOC_MEASUREMENT B_ethmr B_ethms B_zthmr B_zthms DTHMlokBits dthmtm m6zwwthm thmdmm /end LOC_MEASUREMENT
 /begin SUB_FUNCTION /end SUB_FUNCTION
/end FUNCTION
/begin FUNCTION DTIP "OBDII; Tester-Interface Package" /begin DEF_CHARACTERISTIC /end DEF_CHARACTERISTIC /begin REF_CHARACTERISTIC /end REF_CHARACTERISTIC /begin IN_MEASUREMENT cw_erfil fcmEnd FCMTab /end IN_MEASUREMENT /begin OUT_MEASUREMENT ffzdfp /end OUT_MEASUREMENT /begin LOC_MEASUREMENT /end LOC_MEASUREMENT /begin SUB_FUNCTION /end SUB_FUNCTION /end FUNCTION
/begin FUNCTION DTOP "Diagnose; Betriebszeit" /begin DEF_CHARACTERISTIC /end DEF_CHARACTERISTIC /begin REF_CHARACTERISTIC /end REF_CHARACTERISTIC /begin IN_MEASUREMENT B_nmot B_pwf /end IN_MEASUREMENT /begin OUT_MEASUREMENT top_w /end OUT_MEASUREMENT /begin LOC_MEASUREMENT /end LOC_MEASUREMENT /begin SUB_FUNCTION /end SUB_FUNCTION /end FUNCTION
/begin FUNCTION DTRIG "OBDII; Ausw‰hlbare Trigger f¸r Fehlerpfad-Management" /begin DEF_CHARACTERISTIC /end DEF_CHARACTERISTIC /begin REF_CHARACTERISTIC /end REF_CHARACTERISTIC /begin IN_MEASUREMENT bbdcy bbno bbsp1 bbsp2 bbsp3 bbtim bbwuc /end IN_MEASUREMENT /begin OUT_MEASUREMENT /end OUT_MEASUREMENT /begin LOC_MEASUREMENT /end LOC_MEASUREMENT /begin SUB_FUNCTION /end SUB_FUNCTION /end FUNCTION
/begin FUNCTION DUF "Diagnose aus der Funktions¸berwachung" /begin DEF_CHARACTERISTIC DUF_T NMN_DUF /end DEF_CHARACTERISTIC /begin REF_CHARACTERISTIC /end REF_CHARACTERISTIC
 /begin IN_MEASUREMENT B_ehfs B_fgr B_fgr_um B_i_ska_um B_mibeg B_msr B_nomsr_um B_nosgs_um B_notlu_fr B_pwgnotfr B_sp1s B_sp2s B_spsmin B_ub_ok B_wdk2sel ei_adcc_um ei_ipa_um ei_mver_um ei_nc_um ei_reac_um ei_rlc_um ei_rlip_um ei_spsc_um ei_tpu_um ei_ubr_um ei_zwc_um mi_um nmot_um /end IN_MEASUREMENT
 /begin OUT_MEASUREMENT duf_c ei_dufska mi_duf mpfad /end OUT_MEASUREMENT
 /begin LOC_MEASUREMENT /end LOC_MEASUREMENT
 /begin SUB_FUNCTION /end SUB_FUNCTION
/end FUNCTION
/begin FUNCTION DUMMY_DFPM "Dummy DFPM" /begin DEF_CHARACTERISTIC /end DEF_CHARACTERISTIC /begin REF_CHARACTERISTIC /end REF_CHARACTERISTIC /begin IN_MEASUREMENT /end IN_MEASUREMENT
 /begin OUT_MEASUREMENT B_beths B_m8te B_mnths B_mxths B_siths cw_erfil errorCntAskTcsort errorCntTcsort E_ths sfpths tanwrhf vfzg2 vstvvr Z_ths /end OUT_MEASUREMENT
 /begin LOC_MEASUREMENT /end LOC_MEASUREMENT
 /begin SUB_FUNCTION /end SUB_FUNCTION
/end FUNCTION
/begin FUNCTION DUMWEX "Diagose; Erweiterte Umweltbedingumgen" /begin DEF_CHARACTERISTIC /end DEF_CHARACTERISTIC /begin REF_CHARACTERISTIC /end REF_CHARACTERISTIC /begin IN_MEASUREMENT kmstand /end IN_MEASUREMENT /begin OUT_MEASUREMENT /end OUT_MEASUREMENT /begin LOC_MEASUREMENT /end LOC_MEASUREMENT /begin SUB_FUNCTION /end SUB_FUNCTION /end FUNCTION
/begin FUNCTION DUR "Diagnose aus der Rechner¸berwachung" /begin DEF_CHARACTERISTIC /end DEF_CHARACTERISTIC /begin REF_CHARACTERISTIC /end REF_CHARACTERISTIC /begin IN_MEASUREMENT /end IN_MEASUREMENT /begin OUT_MEASUREMENT rstpfad /end OUT_MEASUREMENT /begin LOC_MEASUREMENT rstMon_um /end LOC_MEASUREMENT /begin SUB_FUNCTION /end SUB_FUNCTION /end FUNCTION
/begin FUNCTION DWUC "OBDII; Erf¸llung Bedingung 'warm up cycle'" /begin DEF_CHARACTERISTIC DTMWUC TMWUC TMWUCST /end DEF_CHARACTERISTIC /begin REF_CHARACTERISTIC /end REF_CHARACTERISTIC /begin IN_MEASUREMENT B_pwf B_stend tmot /end IN_MEASUREMENT /begin OUT_MEASUREMENT bbwuc B_nowuc B_wuc wuccnt /end OUT_MEASUREMENT /begin LOC_MEASUREMENT tmstem /end LOC_MEASUREMENT /begin SUB_FUNCTION /end SUB_FUNCTION /end FUNCTION
/begin FUNCTION ERCO_ERR "" /begin DEF_CHARACTERISTIC /end DEF_CHARACTERISTIC /begin REF_CHARACTERISTIC /end REF_CHARACTERISTIC /begin IN_MEASUREMENT /end IN_MEASUREMENT /begin OUT_MEASUREMENT E_OS_LIMIT_ctr /end OUT_MEASUREMENT /begin LOC_MEASUREMENT /end LOC_MEASUREMENT /begin SUB_FUNCTION /end SUB_FUNCTION /end FUNCTION
/begin FUNCTION ESGRU "Grundeinspritzungen" /begin DEF_CHARACTERISTIC FRKAP /end DEF_CHARACTERISTIC /begin REF_CHARACTERISTIC /end REF_CHARACTERISTIC /begin IN_MEASUREMENT /end IN_MEASUREMENT /begin OUT_MEASUREMENT fgru /end OUT_MEASUREMENT /begin LOC_MEASUREMENT /end LOC_MEASUREMENT /begin SUB_FUNCTION /end SUB_FUNCTION /end FUNCTION
/begin FUNCTION ESNSWL "Einspritzung Nachstart und Warmlauf"
 /begin DEF_CHARACTERISTIC FNSHO FNSSM FWSTAA1 FWSTAB1 FWSTAB2 FWSTAB3 FWSTAS1 FWSTAS2 FZANSSA1 FZANSSA2 FZANSSM1 FZANSSM2 FZANSSM3 KFFWL KFFWLRL KFFWLW KFNSA KFNSWRL KFWNSNW KFWWLML KFWWLNW KFWWNS KLWNSLBK KLWWLLBK SZANSSM1 SZANSSM2 ZDGZA1 ZDGZA2 ZDGZA3 /end DEF_CHARACTERISTIC
 /begin REF_CHARACTERISTIC CWLBK CWNWGE SIM06ESUW SKS06ESUB SNM06ESUB SRP06ESUB STA06ESUB STM12ESUB STS08ESUB STS12ESUB /end REF_CHARACTERISTIC
 /begin IN_MEASUREMENT B_hst B_staa B_stendes B_wks esst_sim06esuw esst_sks06esub esst_snm06esub esst_srp06esub esst_sta06esub esst_stm12esub esst_sts08esub esst_sts12esub fho fwnwvs_w imlatm_w kstaa lbksol_w nmot rlp tabst_w tans tmot tmst wnwue_w /end IN_MEASUREMENT
 /begin OUT_MEASUREMENT B_fnsoff esnswlbits fnswlst_w fnswl_w fns_w fwl /end OUT_MEASUREMENT
 /begin LOC_MEASUREMENT abr1_count fktns_w fwlrl fwnslbk_w fwnsnw_w fwwllbk fwwlnw fzans1 nsactr nswrl /end LOC_MEASUREMENT
 /begin SUB_FUNCTION /end SUB_FUNCTION
/end FUNCTION
/begin FUNCTION ESSTT "Einspritzzeit Start"
 /begin DEF_CHARACTERISTIC DN10BURN FKSTT FSTHO IMLHS KFHSTT KFWHSTT KFWKSTAB KFWKSTN KFWKSTT KLTMOTDIFF TANDT TANH TMH TMHSG TMK TMODT TMORSTE TMURSTE TWSTT ZBURNLIM /end DEF_CHARACTERISTIC
 /begin REF_CHARACTERISTIC CWWL /end REF_CHARACTERISTIC
 /begin IN_MEASUREMENT anztib B_nachl B_nmin B_pwf B_stend B_zesync dnmot_w fho imlatm kstaa nmot tabst_w tans tansab tmot tmotab tmst /end IN_MEASUREMENT
 /begin OUT_MEASUREMENT B_hst B_hstnl B_stendes B_vbemg B_wks B_wst B_wst0 fst_w tmotnldiff tmotnlmx /end OUT_MEASUREMENT
 /begin LOC_MEASUREMENT B_vbmg B_wst1 B_wst2 fst0_w kl_twstt_w zburnsum /end LOC_MEASUREMENT
 /begin SUB_FUNCTION /end SUB_FUNCTION
/end FUNCTION
/begin FUNCTION ESUK "Einspritzung ‹bergangskompensation"
 /begin DEF_CHARACTERISTIC DUKK FUKE FUKLAMSBG FUKNSTHO FUKNSTM FUKTINEO FVANST FWFN KFABAK KFABALBK KFAVAK KFAVALBK KFBAKL KFVAKL KFVALDIF LADIFFVA RKBAUM RKUKKLU RKVAUM TKRF TNSUUK TVAG WFLBK WFRL WLBKMN ZBAKM ZBALM ZUKE ZUKNSTM ZVAKM ZVALM /end DEF_CHARACTERISTIC
 /begin REF_CHARACTERISTIC SLA05ESUB SNM07ESUB STM09ESUB WESSOT WNWREO /end REF_CHARACTERISTIC
 /begin IN_MEASUREMENT anzti B_ll B_nswo2 B_sa B_sbblsu B_sls B_slsoff B_st B_stend drlp_w esst_sla05esub esst_snm07esub esst_stm09esub fho fukaba_w fukava_w gangi ladiff_w lamsbg_w lbksol_w nmot nmot_w rlp rlp_w tef_w tmot tmst vwkw wee /end IN_MEASUREMENT
 /begin OUT_MEASUREMENT B_ba B_bag B_ukg B_va B_vag B_vak dwf_w fvaklw_w fvakl_w fvaladif rkukg_w rkukk_w weeotkrf_w zuknstm_w /end OUT_MEASUREMENT
 /begin LOC_MEASUREMENT abak anztis avak B_redkl B_uk1 B_uke B_ukk B_ukns B_vaau B_vakl B_val B_wf drkuke_w dwfk_w dwfl_w fbakl_w fbans fbansini_w fbavst_w flamsbg_w ftineo_w fvans fvavst_w fwfkorr_w rkuke_w rkukkl_w rkukl_w rkuk_w sdwfk_w sdwfl_w vti_w wf_w woe_w zbake zbale zvake zvale /end LOC_MEASUREMENT
 /begin SUB_FUNCTION /end SUB_FUNCTION
/end FUNCTION
/begin FUNCTION ESUKAS "Adaption der ‹bergangskompensation (mit stetiger Lambda-Regelung)"
 /begin DEF_CHARACTERISTIC CUKA FKUKAO FKUKAU FLAMSBATM FLAMSVATM FUKABAKI FUKABAKO FUKABAKU FUKABAWI FUKABAWO FUKABAWU FUKAVAKI FUKAVAKO FUKAVAKU FUKAVAWI FUKAVAWO FUKAVAWU FVFKUKA LAMUKAF LAMUKAM NUKAO NUKAU RKUKKTUBA RKUKKTUVA RLUKAO RLUKAU TMNUUKA TMUKAK TMUKAU TMUKAW TNSUUKA TPUKUKA TSPUUKA UKAFRTMO UKAFRTMU /end DEF_CHARACTERISTIC
 /begin REF_CHARACTERISTIC STM09ESUB /end REF_CHARACTERISTIC
 /begin IN_MEASUREMENT B_dktlp B_enws B_frmax B_frmax2 B_frmin B_frmin2 B_lrs B_lrs2 B_mdarv B_nldg B_nswo1 B_pwf B_slp B_te B_tehb esst_stm09esub fr2_w fr_w lamsbgt2_w lamsbgt_w lamzak2_w lamzak_w nmot rkukk_w rl tlrs_w tmot tnst_w /end IN_MEASUREMENT
 /begin OUT_MEASUREMENT fukaba_w fukava_w /end OUT_MEASUREMENT
 /begin LOC_MEASUREMENT anzfkuka anzfkuka2 B_cfkuka B_cfkuka2 B_cfuka B_cfuka2 B_ecfuka B_ecfuka2 B_rfkuka B_rfkuka2 B_tmnuka B_tspuuka B_tspuuka2 B_uka B_uka2 B_ukab B_ukabat B_ukaukat B_ukauket B_ukava B_ukavat fkukaba2_w fkukaba_w fkukas2_w fkukas_w fkukava2_w fkukava_w flamsba_w flamsva_w fukabak_w fukabaw_w fukavak_w fukavaw_w rkukkt_w tmnuka tpbauka tpvauka ukafrtmo_w ukafrtmu_w /end LOC_MEASUREMENT
 /begin SUB_FUNCTION /end SUB_FUNCTION
/end FUNCTION
/begin FUNCTION ESVW "Einspritzung: Berechnung der Vorlagerungswinkel"
 /begin DEF_CHARACTERISTIC CWESVW DWEEAMX DWEEMX KFWEE KFWEEK KFWEEST KFWEETM KLWEESTN MRFAVW SNM08GKUW SRL08GKUB WEAN WEEMRFAN WESSOT ZZWEETM /end DEF_CHARACTERISTIC
 /begin REF_CHARACTERISTIC /end REF_CHARACTERISTIC
 /begin IN_MEASUREMENT anztib B_stend mrfa_w nmot_w rl tmot tmst uzkw_w wnwve_w /end IN_MEASUREMENT
 /begin OUT_MEASUREMENT B_esbnb B_esbst esst_snm08gkuw esst_srl08gkub wea wee wes /end OUT_MEASUREMENT
 /begin LOC_MEASUREMENT B_kfwee B_mrfamx weemrfa weenst weest weetm /end LOC_MEASUREMENT
 /begin SUB_FUNCTION /end SUB_FUNCTION
/end FUNCTION
/begin FUNCTION ESWE "Einspritzung Schubabschalten Wiedereinsetzen" /begin DEF_CHARACTERISTIC FIMHU FIMWU FWEHT FWEMRFA FWET /end DEF_CHARACTERISTIC /begin REF_CHARACTERISTIC /end REF_CHARACTERISTIC /begin IN_MEASUREMENT anzti B_ll B_sa mrfa_w tmot /end IN_MEASUREMENT /begin OUT_MEASUREMENT fwe /end OUT_MEASUREMENT /begin LOC_MEASUREMENT anzwefim azylwe B_afwe B_fwe /end LOC_MEASUREMENT /begin SUB_FUNCTION /end SUB_FUNCTION /end FUNCTION
/begin FUNCTION FGRAUS "Abschaltung Fahrgeschwindigkeitsregler" /begin DEF_CHARACTERISTIC DMRFGRAL MRFGRMAX TFGRARLG /end DEF_CHARACTERISTIC /begin REF_CHARACTERISTIC /end REF_CHARACTERISTIC
 /begin IN_MEASUREMENT B_acc B_fgr B_fgras B_fgren B_fgrver gangi mracc_w mrfgrv_w /end IN_MEASUREMENT
 /begin OUT_MEASUREMENT mrfgr_w /end OUT_MEASUREMENT
 /begin LOC_MEASUREMENT B_fgrari dmrar_w mrfgru_w /end LOC_MEASUREMENT
 /begin SUB_FUNCTION /end SUB_FUNCTION
/end FUNCTION
/begin FUNCTION FGRMD "Funktionslogik und Regelalgorithmus Fahrgeschwindigkeitsregler"
 /begin DEF_CHARACTERISTIC ANZTPMX BRABEVI BRATD BRATU BRAWA1GA BRAWA2GA BRAWA3GA BRAWAVI CWFGRMD DVIVZTMX DVSAVO DVSAVU DVSKNBGA DVSKNVGA DVTIPUD DVZVITMX DVZVIWA DVZVRWA1 DVZVRWA2 DVZVRWA3 KFVOFFS KKFFGRGA KRAFGRGA MRFGRMR MRFGRSTA MRMRFGR TFGRTP TN2FGRGA TSWKNBGA TSWKNVGA TVLADV TZ2FGRGA VLMXVZ /end DEF_CHARACTERISTIC
 /begin REF_CHARACTERISTIC MRFGRMAX VFGRMAX VFGRMIN /end REF_CHARACTERISTIC
 /begin IN_MEASUREMENT B_acc B_fgr B_fgrenv B_fgresv B_fgrhsa B_fgrtb2 B_fgrtbe B_fgrtse B_fgrtv2 B_fgrtve B_fgrtwa B_vziels gangi mrfgr_w mrped_w vfgr_w vreglmax_w vreglmin_w vziels_w /end IN_MEASUREMENT
 /begin OUT_MEASUREMENT B_besch B_fgrene B_fgrkfm B_fgrvem B_savm B_tb2p B_tpdn B_tpup B_tv2p B_wiauf mrfgrm_w mrregl_w mrrgli_w vziel_w /end OUT_MEASUREMENT
 /begin LOC_MEASUREMENT anztpdn anztpup B_fgrakt B_fgrdvi B_fgrra B_kfnb B_kfnv B_swknb B_swknv B_tbenh B_tbent B_tbep B_tbeph B_tpderl B_tpuerl B_tsenh B_tsent B_tvenh B_tvent B_tvep B_tveph B_twap B_uebetu B_uebrkf B_uebvau B_uevztd B_wavo dvrabe_w dvrave_w dvzvi_w FGRMDlokBits1 FGRMDlokBits2 kfgr_w mrfgri_w tn2fgr_w tz2fgr_w vlast_w voffs_w vrbemx_w vregl_w vrvemn_w /end LOC_MEASUREMENT
 /begin SUB_FUNCTION /end SUB_FUNCTION
/end FUNCTION
/begin FUNCTION FGRUE "‹bersicht Fahrgeschwindigkeitsregler" /begin DEF_CHARACTERISTIC /end DEF_CHARACTERISTIC /begin REF_CHARACTERISTIC /end REF_CHARACTERISTIC
 /begin IN_MEASUREMENT B_acc B_fgrene B_fgrenv B_fgrkfm B_fgrvem B_savacc B_savm mracc_w mrfgrm_w /end IN_MEASUREMENT
 /begin OUT_MEASUREMENT B_fgren B_fgrkf B_fgrver B_savfgr mrfgrv_w /end OUT_MEASUREMENT
 /begin LOC_MEASUREMENT /end LOC_MEASUREMENT
 /begin SUB_FUNCTION /end SUB_FUNCTION
/end FUNCTION
/begin FUNCTION FLSUBB "Freigabe der Betriebsbereitschaft der LSU" /begin DEF_CHARACTERISTIC /end DEF_CHARACTERISTIC /begin REF_CHARACTERISTIC /end REF_CHARACTERISTIC
 /begin IN_MEASUREMENT B_ehlsu B_ehlsu2 B_ehsve B_ehsve2 B_eiclsu B_eiclsu2 B_elsu B_elsu2 B_elsuwi B_elsuwi2 B_hrlsaus B_hstlsua B_hstlsua2 /end IN_MEASUREMENT
 /begin OUT_MEASUREMENT B_flsubb B_flsubb2 /end OUT_MEASUREMENT
 /begin LOC_MEASUREMENT /end LOC_MEASUREMENT
 /begin SUB_FUNCTION /end SUB_FUNCTION
/end FUNCTION
/begin FUNCTION FTKBK "20.11     Fahrertypklassifikation"
 /begin DEF_CHARACTERISTIC FTKBRED1 FTKBRED2 FTKB_VAL FTK_KW KL_BAURS KL_BAURSLG KL_BAUR_LG KL_BKAX1 KL_BKAX9 KL_VGBK /end DEF_CHARACTERISTIC
 /begin REF_CHARACTERISTIC FTKB_ON VCANV16 /end REF_CHARACTERISTIC
 /begin IN_MEASUREMENT DMLD_APPAvg DMLD_APPGrdtMax DMLD_ESP_Tmr DMLD_KD_Tmr DMLD_LongAccelMax DMLD_Off DMLD_VehSpd10kmh_Tmr DMLD_VehSpd_Begin DMLD_VehSpd_End DP_LongDyn_Red_Mode ir0 OWRatio_Coef Tmr100ms_hw Tmr100ms_lw Trans_Man_Cnfg vcanv16_r Veh_Spd vk_fz_kb /end IN_MEASUREMENT
 /begin OUT_MEASUREMENT CurbWeight DP_LongDyn DP_LongDyn_SnglVal OWRatio_Rel /end OUT_MEASUREMENT
 /begin LOC_MEASUREMENT /end LOC_MEASUREMENT
 /begin SUB_FUNCTION /end SUB_FUNCTION
/end FUNCTION
/begin FUNCTION FTKBM "20.11     Fahrertypklassifizierung" /begin DEF_CHARACTERISTIC FTKB_ON FTK_NKL FTK_VKL /end DEF_CHARACTERISTIC /begin REF_CHARACTERISTIC /end REF_CHARACTERISTIC
 /begin IN_MEASUREMENT AdapCrsCtrl_TrqMaxPls_Mode_Req AdapCrsCtrl_TrqMinPls_Mode_Req APP b_tm_reg Drvr_MaxPwr_Mode ESP_IndicLight_Mode LongAccel nist Trans_Rvrs_Mode Veh_Spd /end IN_MEASUREMENT
 /begin OUT_MEASUREMENT DMLD_Actv DMLD_APPAvg DMLD_APPGrdtMax DMLD_ESP_Tmr DMLD_KD_Tmr DMLD_LongAccelMax DMLD_Off DMLD_Tmr DMLD_VehSpd10kmh_Tmr DMLD_VehSpd_Begin DMLD_VehSpd_End DP_APPGrdt DP_LongDyn_Red_Mode Tmr100ms_hw Tmr100ms_lw /end OUT_MEASUREMENT
 /begin LOC_MEASUREMENT /end LOC_MEASUREMENT
 /begin SUB_FUNCTION /end SUB_FUNCTION
/end FUNCTION
/begin FUNCTION FTKLK "20.11     Klassifikation Lenkung Fahrertypklassifikation" /begin DEF_CHARACTERISTIC FTKL_RED FTKL_VAL KLLK1AY1 KLLK1AY9 KLLK2AY1 KLLK2AY9 /end DEF_CHARACTERISTIC /begin REF_CHARACTERISTIC FTKL_ON LK2_AX VCANV16 /end REF_CHARACTERISTIC
 /begin IN_MEASUREMENT DMTD_ESP_Tmr DMTD_LongAccelMax DMTD_Off DMTD_Tmr DMTD_TrvrAccelMax DMTD_TrvrAccelMax_LongAccel DMTD_TrvrAccelMax_VehSpd DP_TrvrDyn_Red_Mode OWRatio_Rel sst_ax_ay Tmr100ms_hw Tmr100ms_lw vcanv16_r Veh_Spd /end IN_MEASUREMENT
 /begin OUT_MEASUREMENT DP_TrvrDyn DP_TrvrDyn_SnglVal /end OUT_MEASUREMENT
 /begin LOC_MEASUREMENT /end LOC_MEASUREMENT
 /begin SUB_FUNCTION /end SUB_FUNCTION
/end FUNCTION
/begin FUNCTION FTKLM "20.11     Manˆver¸berwachung Lenkung Fahrertypklassifikation" /begin DEF_CHARACTERISTIC FTKL_ON FTK_LUE FTK_RST /end DEF_CHARACTERISTIC /begin REF_CHARACTERISTIC FTK_NKL /end REF_CHARACTERISTIC
 /begin IN_MEASUREMENT AdapCrsCtrl_TrqMaxPls_Mode_Req AdapCrsCtrl_TrqMinPls_Mode_Req BrkLight_Mode b_tm_reg ESP_IndicLight_Mode LongAccel nist SteeringAngle Trans_Rvrs_Mode TrvrAccel Veh_Spd vk_can /end IN_MEASUREMENT
 /begin OUT_MEASUREMENT DMTD_Actv DMTD_ESP_Tmr DMTD_LongAccelMax DMTD_Off DMTD_Tmr DMTD_TrvrAccelMax DMTD_TrvrAccelMax_LongAccel DMTD_TrvrAccelMax_VehSpd DP_SteeringAngle DP_TrvrDyn_Red_Mode /end OUT_MEASUREMENT
 /begin LOC_MEASUREMENT /end LOC_MEASUREMENT
 /begin SUB_FUNCTION /end SUB_FUNCTION
/end FUNCTION
/begin FUNCTION FTKVK "20.11     Klassifikation Verzˆgerung Fahrertypklassifikation" /begin DEF_CHARACTERISTIC FTKV_BGW FTKV_VAL /end DEF_CHARACTERISTIC /begin REF_CHARACTERISTIC FTKV_ON /end REF_CHARACTERISTIC /begin IN_MEASUREMENT DMD_Off DMD_VehSpd10kmh_Tmr Tmr100ms_hw Tmr100ms_lw /end IN_MEASUREMENT /begin OUT_MEASUREMENT DP_Decel DP_Decel_SnglVal /end OUT_MEASUREMENT /begin LOC_MEASUREMENT /end LOC_MEASUREMENT /begin SUB_FUNCTION /end SUB_FUNCTION /end FUNCTION
/begin FUNCTION FTKVM "20.11     Manˆver¸berwachung Verzˆgerung Fahrertypklassifikation" /begin DEF_CHARACTERISTIC FTKV_ON /end DEF_CHARACTERISTIC /begin REF_CHARACTERISTIC FTK_NKL /end REF_CHARACTERISTIC
 /begin IN_MEASUREMENT AdapCrsCtrl_TrqMaxPls_Mode_Req AdapCrsCtrl_TrqMinPls_Mode_Req BrkLight_Mode nist Tmr100ms_hw Tmr100ms_lw Trans_Rvrs_Mode Veh_Spd /end IN_MEASUREMENT
 /begin OUT_MEASUREMENT DMD_Actv DMD_Off DMD_VehSpd10kmh_Tmr DMD_VehSpd_Begin /end OUT_MEASUREMENT
 /begin LOC_MEASUREMENT /end LOC_MEASUREMENT
 /begin SUB_FUNCTION /end SUB_FUNCTION
/end FUNCTION
/begin FUNCTION FUEDK "F¸llungssteuerung (Berechnung DK-Sollwinkel)"
 /begin DEF_CHARACTERISTIC CWFUEDK CWUGD DRLSOLMF EVTMODMNDK FKLAFUGD FPWDKAPP KFWDKSMX TFWDKPSPV WDKMSN WDKSAPP WDKSHYS WDKSOFS WDKUGDN /end DEF_CHARACTERISTIC
 /begin REF_CHARACTERISTIC SNM12FEUB /end REF_CHARACTERISTIC
 /begin IN_MEASUREMENT B_dwdknws B_fpwdkap B_nmin B_stend B_tfwdksom B_wdksap B_wdksom esst_snm12feub evtmod fho_w frhovdk_w msdkmx_w msdks_w msdkugd_w msndko_w nmot nmot_w pspvds_w rldkmx_w rldkugd_w rlfgks_w rlsol_w tfwdksom_w umsnms_w wdksom_w wped_w /end IN_MEASUREMENT
 /begin OUT_MEASUREMENT B_fkmsdks B_ugdap B_ugdnws B_wdkap msndkoug_w msndkugd_w wdksap_w wdkugd_w /end OUT_MEASUREMENT
 /begin LOC_MEASUREMENT B_dwdksugd B_mfact drlsolmf_w dwdksugd_w dwdksumx_w msndkoos_w msndks_w wdkobugs_w wdksgvin_w wdksgv_w wdksmx_w wdksobmx_w wdksof_w /end LOC_MEASUREMENT
 /begin SUB_FUNCTION /end SUB_FUNCTION
/end FUNCTION
/begin FUNCTION FUEDKSA "F¸llungsbeeinflussung ¸ber DK, Sollwertaufbereitung" /begin DEF_CHARACTERISTIC CWWDKSPE DKNOTBEGR ENTDKLL ENTDKNLL TVWDKS /end DEF_CHARACTERISTIC /begin REF_CHARACTERISTIC /end REF_CHARACTERISTIC
 /begin IN_MEASUREMENT B_dknolu B_dkpiu B_dksbeg B_i_ska_um B_ll B_wdk1v nmot wdknlp_w wdksap_w /end IN_MEASUREMENT
 /begin OUT_MEASUREMENT dwdks_w wdks wdksp_w wdks_w /end OUT_MEASUREMENT
 /begin LOC_MEASUREMENT wdkink_w wdksba2_w wdksba_w wdksb_w wdksfl wdkspa_w wdksvfl wdkswe_w /end LOC_MEASUREMENT
 /begin SUB_FUNCTION /end SUB_FUNCTION
/end FUNCTION
/begin FUNCTION FUEREG "F¸llungsregelung" /begin DEF_CHARACTERISTIC CWFUEREG DFAFRG DMSFUEDRL FPLMRM TVFRG /end DEF_CHARACTERISTIC /begin REF_CHARACTERISTIC /end REF_CHARACTERISTIC /begin IN_MEASUREMENT B_llrpd nmotll rlsol_w rl_w tmot tnst_w umsrln_w /end IN_MEASUREMENT /begin OUT_MEASUREMENT drlfue_w /end OUT_MEASUREMENT /begin LOC_MEASUREMENT B_furpen B_stndfr dmsfue_w drlm_w /end LOC_MEASUREMENT /begin SUB_FUNCTION /end SUB_FUNCTION /end FUNCTION
/begin FUNCTION GETR "20.11     Getriebesignal-Aufbereitung"
 /begin DEF_CHARACTERISTIC FWGAEIN FWGAOUT FWHGUE6 FWKUPEIN FWKUPWEG FWTNKUP FWVROLL KLEGSUE1 KLEGSUE2 KLKSGUE /end DEF_CHARACTERISTIC
 /begin REF_CHARACTERISTIC CVTRATIO DF_ROH_UP NVERH NVERHSP /end REF_CHARACTERISTIC
 /begin IN_MEASUREMENT AMT_Mode AT2_Mode Cod_Diff_Ratio CPPSw cvtratio_r CVT_Mode ECU_TCMPlausErr Eng_Spd MsgLost_PA_Mode MTXSports_Mode MTX_Mode nverh_r TCCClose_Mode TCCOpen_Mode TCCSlip_Mode TCM_Actl_Ratio Trans_Gear_ActlTgt Trans_RvrsGearMTX_Mode Veh_Spd WSS_PALeft_Err_Mode WSS_PALeft_Plaus WSS_PARight /end IN_MEASUREMENT
 /begin OUT_MEASUREMENT b_gaerk b_gain b_gaout b_gapl b_kuperr b_kuplow b_temakt b_temina b_tnkup Clutch_Mode dham Gear_State Gear_State_CVT Gear_State_CVT_Raw Gear_State_MTX Gear_State_TCM handsst nrmverh PNTgtGear_Mode PN_Mode TgtGear_State Trans_Ratio Trans_Ratio_Calc Trans_Rvrs_Mode /end OUT_MEASUREMENT
 /begin LOC_MEASUREMENT /end LOC_MEASUREMENT
 /begin SUB_FUNCTION /end SUB_FUNCTION
/end FUNCTION
/begin FUNCTION ggairb "Gebergrˆﬂe Airbag" /begin DEF_CHARACTERISTIC TCEKP /end DEF_CHARACTERISTIC /begin REF_CHARACTERISTIC /end REF_CHARACTERISTIC /begin IN_MEASUREMENT B_ins3cok B_nmot ekpausc /end IN_MEASUREMENT /begin OUT_MEASUREMENT B_airbag /end OUT_MEASUREMENT /begin LOC_MEASUREMENT /end LOC_MEASUREMENT /begin SUB_FUNCTION /end SUB_FUNCTION /end FUNCTION
/begin FUNCTION GGDSAC "Gebergrˆﬂe Druck AC-System" /begin DEF_CHARACTERISTIC DSACGRAD DSACOFS PACE TDDFAC UADPACMN UADPACMX /end DEF_CHARACTERISTIC /begin REF_CHARACTERISTIC /end REF_CHARACTERISTIC /begin IN_MEASUREMENT B_kl15 B_pwf B_stend udsac_w /end IN_MEASUREMENT /begin OUT_MEASUREMENT pac pach pach_w pac_w /end OUT_MEASUREMENT /begin LOC_MEASUREMENT /end LOC_MEASUREMENT /begin SUB_FUNCTION /end SUB_FUNCTION /end FUNCTION
/begin FUNCTION GGDSS "Gebergrˆﬂe Drucksensor Saugrohrdruck" /begin DEF_CHARACTERISTIC DSSGRAD DSSOFS NPSSEG /end DEF_CHARACTERISTIC /begin REF_CHARACTERISTIC UADPSMN UADPSMX /end REF_CHARACTERISTIC /begin IN_MEASUREMENT B_edss nmot_w ofdss_w udss_w /end IN_MEASUREMENT
 /begin OUT_MEASUREMENT B_dsseg B_elmi depsdss_w psdss psdssi psdssi_w psdss_w udsm_w /end OUT_MEASUREMENT
 /begin LOC_MEASUREMENT /end LOC_MEASUREMENT
 /begin SUB_FUNCTION /end SUB_FUNCTION
/end FUNCTION
/begin FUNCTION GGDSU "Gebergrˆﬂe Drucksensor Umgebungsdruck" /begin DEF_CHARACTERISTIC DPUPVDK DSUGRAD DSUOFS FHOE PUE TDDFU UADPUMN UADPUMX ZDSU /end DEF_CHARACTERISTIC /begin REF_CHARACTERISTIC /end REF_CHARACTERISTIC /begin IN_MEASUREMENT ftu ml_w ofdsu_w udsu_w /end IN_MEASUREMENT
 /begin OUT_MEASUREMENT B_hag B_pug fho fho_w fplufi_w fpvdkds fpvdkds_w frhol_w plufi_w pu pus_w pu_w pvdkds pvdkds_w /end OUT_MEASUREMENT
 /begin LOC_MEASUREMENT /end LOC_MEASUREMENT
 /begin SUB_FUNCTION DFPM_GGDSU /end SUB_FUNCTION
/end FUNCTION
/begin COMPU_METHOD adp_q0p3666 "" RAT_FUNC "%6.3" "hPa/V" COEFFS 0 65535 0 0 0 24025 /end COMPU_METHOD
/begin COMPU_METHOD bfzg_ub_b27p67 "" RAT_FUNC "%6.3" "m/s^2" COEFFS 0 256 0 0 0 27.67 /end COMPU_METHOD
/begin COMPU_METHOD bfzg_uw_q0p1085 "" RAT_FUNC "%6.3" "m/s^2" COEFFS 0 1 0 0 0 0.1085 /end COMPU_METHOD
/begin COMPU_METHOD B_TRUE "boolsche Zust‰nde, positive Logik" TAB_VERB "%6.3" "" COMPU_TAB_REF B_TRUE /end COMPU_METHOD
/begin COMPU_VTAB B_TRUE "boolsche Zust‰nde, positive Logik" TAB_VERB 2 0 "----" 1 "TRUE" /end COMPU_VTAB
/begin COMPU_METHOD DC_CNTR_U16 "" RAT_FUNC "%6.2" "" COEFFS 0 1 0 0 0 1 /end COMPU_METHOD
/begin COMPU_METHOD DC_CNTR_U8 "" RAT_FUNC "%6.2" "" COEFFS 0 1 0 0 0 1 /end COMPU_METHOD
/begin COMPU_METHOD DC_DEZL "" RAT_FUNC "%6.2" "" COEFFS 0 1 0 0 0 1 /end COMPU_METHOD
/begin COMPU_METHOD DC_FCTR_50_U8 "" RAT_FUNC "%8.5" "keine" COEFFS 0 50 0 0 0 1 /end COMPU_METHOD
/begin COMPU_METHOD DC_FKT32768 "" RAT_FUNC "%7.6" "Faktor" COEFFS 0 32768 0 0 0 1 /end COMPU_METHOD
/begin COMPU_METHOD DC_FLAG_U8 "" RAT_FUNC "%6.2" "" COEFFS 0 1 0 0 0 1 /end COMPU_METHOD
/begin COMPU_METHOD DC_KW_U8DB "" RAT_FUNC "%6.2" "kw" COEFFS 0 1 0 0 0 2 /end COMPU_METHOD
/begin COMPU_METHOD DC_LGW_U8DB "" RAT_FUNC "%6.1" "kg" COEFFS 0 1 0 0 0 20 /end COMPU_METHOD
/begin COMPU_METHOD DC_LRW_U16DB "" RAT_FUNC "%6.3" "Grad" COEFFS 0 10 0 0 0 1 /end COMPU_METHOD
/begin COMPU_METHOD DC_NIST_QUANT "" RAT_FUNC "%6.1" "Upm" COEFFS 0 1 0 0 0 25 /end COMPU_METHOD
/begin COMPU_METHOD DC_PER0327 "" RAT_FUNC "%6.4" "%" COEFFS 0 327.67 0 0 0 1 /end COMPU_METHOD
/begin COMPU_METHOD DC_RS_U8DB "" RAT_FUNC "%6.0" "mm" COEFFS 0 1 0 0 0 100 /end COMPU_METHOD
/begin COMPU_METHOD DC_TIME_100MS_U16 "" RAT_FUNC "%6.3" "s" COEFFS 0 10 0 0 0 1 /end COMPU_METHOD
/begin COMPU_METHOD DC_TQ100 "" RAT_FUNC "%6.3" "sec" COEFFS 0 10 0 0 0 1 /end COMPU_METHOD
/begin COMPU_METHOD DC_TQ20 "" RAT_FUNC "%6.4" "sec" COEFFS 0 50 0 0 0 1 /end COMPU_METHOD
/begin COMPU_METHOD DC_UAFZ_S8 "" RAT_FUNC "%6.4" "m/(s*s)" COEFFS 0 1 0 0 0 0.0434 /end COMPU_METHOD
/begin COMPU_METHOD DC_UAY_S8DB "" RAT_FUNC "%6.3" "m/(s*s)" COEFFS 0 25 0 0 0 2 /end COMPU_METHOD
/begin COMPU_METHOD DC_UAY_U8DB "" RAT_FUNC "%6.4" "m/(s*s)" COEFFS 0 25 0 0 0 1 /end COMPU_METHOD
/begin COMPU_METHOD DC_URD_05 "" RAT_FUNC "%8.4" "1/min" COEFFS 0 1 0 0 0 0.5 /end COMPU_METHOD
/begin COMPU_METHOD DC_VEHSPD_KMH_U16 "" RAT_FUNC "%8.5" "km/h" COEFFS 0 16 0 0 0 1 /end COMPU_METHOD
/begin COMPU_METHOD dez "1 : 1 Umrechnug (dez/hex)" RAT_FUNC "%6.2" "" COEFFS 0 1 0 0 0 1 /end COMPU_METHOD
/begin COMPU_METHOD dgrad_uw_q0p015 "" RAT_FUNC "%6.4" "hPa/V" COEFFS 0 65536 0 0 0 1024 /end COMPU_METHOD
/begin COMPU_METHOD fak_q0p0039 "" RAT_FUNC "%6.4" "-" COEFFS 0 256 0 0 0 1 /end COMPU_METHOD
/begin COMPU_METHOD fak_q0p03815 "" RAT_FUNC "%6.4" "%/(s*kg/h)" COEFFS 0 65536 0 0 0 2500 /end COMPU_METHOD
/begin COMPU_METHOD fak_q0p0625 "" RAT_FUNC "%6.4" "-" COEFFS 0 16 0 0 0 1 /end COMPU_METHOD
/begin COMPU_METHOD fak_sb_b1 "" RAT_FUNC "%6.4" "-" COEFFS 0 256 0 0 0 2 /end COMPU_METHOD
/begin COMPU_METHOD fak_sw_b1 "" RAT_FUNC "%7.6" "-" COEFFS 0 65536 0 0 0 2 /end COMPU_METHOD
/begin COMPU_METHOD fak_sw_b256 "" RAT_FUNC "%6.4" "-" COEFFS 0 65536 0 0 0 512 /end COMPU_METHOD
/begin COMPU_METHOD fak_sw_b64 "" RAT_FUNC "%6.4" "-" COEFFS 0 65536 0 0 0 128 /end COMPU_METHOD
/begin COMPU_METHOD fak_ub_b0p125 "" RAT_FUNC "%6.5" "-" COEFFS 0 256 0 0 0 0.125 /end COMPU_METHOD
/begin COMPU_METHOD fak_ub_b0p25 "" RAT_FUNC "%10.7" "-" COEFFS 0 256 0 0 0 0.25 /end COMPU_METHOD
/begin COMPU_METHOD fak_ub_b1 "" RAT_FUNC "%6.4" "-" COEFFS 0 256 0 0 0 1 /end COMPU_METHOD
/begin COMPU_METHOD fak_ub_b16 "" RAT_FUNC "%6.4" "-" COEFFS 0 256 0 0 0 16 /end COMPU_METHOD
/begin COMPU_METHOD fak_ub_b2 "" RAT_FUNC "%6.4" "-" COEFFS 0 256 0 0 0 2 /end COMPU_METHOD
/begin COMPU_METHOD fak_ub_b4 "" RAT_FUNC "%6.4" "-" COEFFS 0 256 0 0 0 4 /end COMPU_METHOD
/begin COMPU_METHOD fak_ub_b64 "" RAT_FUNC "%6.3" "-" COEFFS 0 256 0 0 0 64 /end COMPU_METHOD
/begin COMPU_METHOD fak_ub_b8 "" RAT_FUNC "%6.4" "-" COEFFS 0 256 0 0 0 8 /end COMPU_METHOD
/begin COMPU_METHOD fak_uw_b1 "" RAT_FUNC "%7.6" "-" COEFFS 0 65536 0 0 0 1 /end COMPU_METHOD
/begin COMPU_METHOD fak_uw_b16 "" RAT_FUNC "%6.5" "-" COEFFS 0 65536 0 0 0 16 /end COMPU_METHOD
/begin COMPU_METHOD fak_uw_b2 "" RAT_FUNC "%7.6" "-" COEFFS 0 65536 0 0 0 2 /end COMPU_METHOD
/begin COMPU_METHOD fak_uw_b4 "" RAT_FUNC "%7.6" "-" COEFFS 0 65536 0 0 0 4 /end COMPU_METHOD
/begin COMPU_METHOD fak_uw_b64 "" RAT_FUNC "%6.5" "-" COEFFS 0 65536 0 0 0 64 /end COMPU_METHOD
/begin COMPU_METHOD fak_uw_b8 "" RAT_FUNC "%6.5" "-" COEFFS 0 65536 0 0 0 8 /end COMPU_METHOD
/begin COMPU_METHOD kw_q0p0019 "" RAT_FUNC "%6.4" "Grad KW" COEFFS 0 512 0 0 0 1 /end COMPU_METHOD
/begin COMPU_METHOD kw_q0p0234 "" RAT_FUNC "%6.4" "Grad KW" COEFFS 0 32768 0 0 0 768 /end COMPU_METHOD
/begin COMPU_METHOD kw_q2p8125 "" RAT_FUNC "%6.2" "∞KW" COEFFS 0 1 0 0 0 2.8125 /end COMPU_METHOD
/begin COMPU_METHOD kw_q6 "" RAT_FUNC "%6.2" "Grad KW" COEFFS 0 1 0 0 0 6 /end COMPU_METHOD
/begin COMPU_METHOD m_q0p00195 "" RAT_FUNC "%6.4" "kg/(h*s)" COEFFS 0 65536 0 0 0 128 /end COMPU_METHOD
/begin COMPU_METHOD m_q0p0031 "" RAT_FUNC "%6.4" "kg/h" COEFFS 0 320 0 0 0 1 /end COMPU_METHOD
/begin COMPU_METHOD m_q0p004 "" RAT_FUNC "%6.4" "kg/h" COEFFS 0 250 0 0 0 1 /end COMPU_METHOD
/begin COMPU_METHOD m_q0p1 "" RAT_FUNC "%6.3" "kg/h" COEFFS 0 10 0 0 0 1 /end COMPU_METHOD
/begin COMPU_METHOD m_ub_b1020 "" RAT_FUNC "%6.2" "kg/h" COEFFS 0 1 0 0 0 4 /end COMPU_METHOD
/begin COMPU_METHOD m_ub_b23p3 "" RAT_FUNC "%6.3" "kg" COEFFS 0 2812.5 0 0 0 256 /end COMPU_METHOD
/begin COMPU_METHOD m_ub_b25p6 "" RAT_FUNC "%6.3" "kg/h" COEFFS 0 256 0 0 0 25.6 /end COMPU_METHOD
/begin COMPU_METHOD m_ub_q0p0444 "" RAT_FUNC "%6.4" "g" COEFFS 0 1 0 0 0 0.0444 /end COMPU_METHOD
/begin COMPU_METHOD m_uw_b23p3 "" RAT_FUNC "%6.5" "kg" COEFFS 0 2812.5 0 0 0 1 /end COMPU_METHOD
/begin COMPU_METHOD m_uw_b6553p5 "" RAT_FUNC "%6.3" "kg/h" COEFFS 0 1 0 0 0 0.1 /end COMPU_METHOD
/begin COMPU_METHOD nmot_ub_q10 "" RAT_FUNC "%6.1" "1/min" COEFFS 0 1 0 0 0 10 /end COMPU_METHOD
/begin COMPU_METHOD nmot_ub_q40 "" RAT_FUNC "%6.1" "1/min" COEFFS 0 1 0 0 0 40 /end COMPU_METHOD
/begin COMPU_METHOD nmot_uw_q0p25 "" RAT_FUNC "%6.3" "1/min" COEFFS 0 1 0 0 0 0.25 /end COMPU_METHOD
/begin COMPU_METHOD p_q0p9155 "" RAT_FUNC "%6.2" "hPa" COEFFS 0 32767 0 0 0 30000 /end COMPU_METHOD
/begin COMPU_METHOD p_q117p647 "" RAT_FUNC "%6.0" "hPa" COEFFS 0 1 0 0 0 117.647 /end COMPU_METHOD
/begin COMPU_METHOD p_q156p86 "" RAT_FUNC "%6.0" "hPa" COEFFS 0 1 0 0 0 156.86 /end COMPU_METHOD
/begin COMPU_METHOD p_sw_q0p039 "" RAT_FUNC "%6.4" "hPa" COEFFS 0 256 0 0 0 10 /end COMPU_METHOD
/begin COMPU_METHOD p_ub_q10 "" RAT_FUNC "%6.1" "hPa" COEFFS 0 1 0 0 0 10 /end COMPU_METHOD
/begin COMPU_METHOD p_ub_q5 "" RAT_FUNC "%6.2" "hPa" COEFFS 0 1 0 0 0 5 /end COMPU_METHOD
/begin COMPU_METHOD p_uw_q0p039 "" RAT_FUNC "%6.4" "hPa" COEFFS 0 256 0 0 0 10 /end COMPU_METHOD
/begin COMPU_METHOD relDK_ub_b100 "" RAT_FUNC "%6.3" "%DK" COEFFS 0 255 0 0 0 100 /end COMPU_METHOD
/begin COMPU_METHOD relDK_uw_b100 "" RAT_FUNC "%6.4" "%DK" COEFFS 0 65535 0 0 0 100 /end COMPU_METHOD
/begin COMPU_METHOD relPED_uw_b100 "" RAT_FUNC "%6.4" "%PED" COEFFS 0 65535 0 0 0 100 /end COMPU_METHOD
/begin COMPU_METHOD rel_q0p02344 "" RAT_FUNC "%6.4" "%" COEFFS 0 32 0 0 0 0.75 /end COMPU_METHOD
/begin COMPU_METHOD rel_q0p09375 "" RAT_FUNC "%6.3" "%" COEFFS 0 1 0 0 0 0.09375 /end COMPU_METHOD
/begin COMPU_METHOD rel_sw_b100 "" RAT_FUNC "%6.4" "%" COEFFS 0 32768 0 0 0 100 /end COMPU_METHOD
/begin COMPU_METHOD rel_sw_b1536 "" RAT_FUNC "%6.4" "%" COEFFS 0 65536 0 0 0 3072 /end COMPU_METHOD
/begin COMPU_METHOD rel_sw_b1p5 "" RAT_FUNC "%7.6" "%" COEFFS 0 32768 0 0 0 1.5 /end COMPU_METHOD
/begin COMPU_METHOD rel_sw_b200 "" RAT_FUNC "%6.4" "%" COEFFS 0 65536 0 0 0 400 /end COMPU_METHOD
/begin COMPU_METHOD rel_sw_q0p0468 "" RAT_FUNC "%6.4" "%" COEFFS 0 65536 0 0 0 3072 /end COMPU_METHOD
/begin COMPU_METHOD rel_sw_q0p1875 "" RAT_FUNC "%6.3" "%" COEFFS 0 65536 0 0 0 12288 /end COMPU_METHOD
/begin COMPU_METHOD rel_ub_b100 "" RAT_FUNC "%6.3" "%" COEFFS 0 256 0 0 0 100 /end COMPU_METHOD
/begin COMPU_METHOD rel_ub_b127p5 "" RAT_FUNC "%6.3" "%" COEFFS 0 2 0 0 0 1 /end COMPU_METHOD
/begin COMPU_METHOD rel_ub_b99p6 "" RAT_FUNC "%6.3" "%" COEFFS 0 256 0 0 0 100 /end COMPU_METHOD
/begin COMPU_METHOD rel_ub_q0p75 "" RAT_FUNC "%6.3" "%" COEFFS 0 1 0 0 0 0.75 /end COMPU_METHOD
/begin COMPU_METHOD rel_uw_b100 "" RAT_FUNC "%6.4" "%" COEFFS 0 65536 0 0 0 100 /end COMPU_METHOD
/begin COMPU_METHOD rel_uw_b200 "" RAT_FUNC "%6.4" "%" COEFFS 0 65536 0 0 0 200 /end COMPU_METHOD
/begin COMPU_METHOD rel_uw_b3072 "" RAT_FUNC "%6.4" "%" COEFFS 0 65536 0 0 0 3072 /end COMPU_METHOD
/begin COMPU_METHOD rel_uw_b3200 "" RAT_FUNC "%6.4" "%" COEFFS 0 65536 0 0 0 3200 /end COMPU_METHOD
/begin COMPU_METHOD rel_uw_q0p0234 "" RAT_FUNC "%6.4" "%" COEFFS 0 32 0 0 0 0.75 /end COMPU_METHOD
/begin COMPU_METHOD rel_uw_q0p1875 "" RAT_FUNC "%6.3" "%" COEFFS 0 65536 0 0 0 12288 /end COMPU_METHOD
/begin COMPU_METHOD spg_ub_q0p019 "" RAT_FUNC "%6.4" "V" COEFFS 0 256 0 0 0 5 /end COMPU_METHOD
/begin COMPU_METHOD spg_uw_q0p000076 "" RAT_FUNC "%7.6" "V" COEFFS 0 65536 0 0 0 5 /end COMPU_METHOD
/begin COMPU_METHOD t100msxs_ub_b25p5 "" RAT_FUNC "%6.3" "s" COEFFS 0 1 0 0 0 0.1 /end COMPU_METHOD
/begin COMPU_METHOD t100msxs_uw_b6553p6 "" RAT_FUNC "%6.3" "s" COEFFS 0 10 0 0 0 1 /end COMPU_METHOD
/begin COMPU_METHOD t10msxs_ub_b2p55 "" RAT_FUNC "%6.4" "s" COEFFS 0 1 0 0 0 0.01 /end COMPU_METHOD
/begin COMPU_METHOD t10msxs_uw_b655p35 "" RAT_FUNC "%6.4" "s" COEFFS 0 1 0 0 0 0.01 /end COMPU_METHOD
/begin COMPU_METHOD t1sxs_uw_b65535 "" RAT_FUNC "%6.2" "s" COEFFS 0 1 0 0 0 1 /end COMPU_METHOD
/begin COMPU_METHOD t1sxs_uw_q1 "" RAT_FUNC "%6.2" "s" COEFFS 0 1 0 0 0 1 /end COMPU_METHOD
/begin COMPU_METHOD t20msxs_ub_b5p1 "" RAT_FUNC "%6.4" "s" COEFFS 0 1 0 0 0 0.02 /end COMPU_METHOD
/begin COMPU_METHOD t20msxs_uw_q0p02 "" RAT_FUNC "%6.4" "s" COEFFS 0 1 0 0 0 0.02 /end COMPU_METHOD
/begin COMPU_METHOD t6minxmin_q6 "" RAT_FUNC "%6.2" "min" COEFFS 0 1 0 0 0 6 /end COMPU_METHOD
/begin COMPU_METHOD tempg_q0p00586 "" RAT_FUNC "%6.4" "Grad C/s" COEFFS 0 128 0 0 0 0.75 /end COMPU_METHOD
/begin COMPU_METHOD temp_ub_b191p25 "" RAT_FUNC "%6.3" "Grad C" COEFFS 0 1 0 0 0 0.75 /end COMPU_METHOD
/begin COMPU_METHOD temp_ub_q0p75_o48 "" RAT_FUNC "%6.2" "Grad C" COEFFS 0 1 48 0 0 0.75 /end COMPU_METHOD
/begin COMPU_METHOD tv_ub_b100 "" RAT_FUNC "%6.3" "%TV" COEFFS 0 256 0 0 0 100 /end COMPU_METHOD
/begin COMPU_METHOD txms_ub_q0p1 "" RAT_FUNC "%6.3" "ms" COEFFS 0 10 0 0 0 1 /end COMPU_METHOD
/begin COMPU_METHOD t_q0p1 "" RAT_FUNC "%6.3" "s" COEFFS 0 10 0 0 0 1 /end COMPU_METHOD
/begin COMPU_METHOD vfzg_sw_q0p00781 "" RAT_FUNC "%6.4" "km/h" COEFFS 0 1 0 0 0 0.0078125 /end COMPU_METHOD
/begin COMPU_METHOD vfzg_ub_q1p25 "" RAT_FUNC "%6.2" "km/h" COEFFS 0 1 0 0 0 1.25 /end COMPU_METHOD
/begin COMPU_METHOD vfzg_uw_b512 "" RAT_FUNC "%6.4" "km/h" COEFFS 0 65536 0 0 0 512 /end COMPU_METHOD
/begin COMPU_METHOD zk100msxs_uw_b6553 "" RAT_FUNC "%10.3" "s" COEFFS 0 0 65536 0 10 0 /end COMPU_METHOD
/begin COMPU_METHOD zk10msxs_uw_b655 "" RAT_FUNC "%10.4" "s" COEFFS 0 0 65536 0 100 0 /end COMPU_METHOD
/begin COMPU_METHOD zk20msxs_uw_b1310 "" RAT_FUNC "%10.3" "s" COEFFS 0 0 1310 0 1 0 /end COMPU_METHOD
/begin COMPU_METHOD zw_sb_q6 "" RAT_FUNC "%6.2" "Grad KW" COEFFS 0 1 0 0 0 6 /end COMPU_METHOD
/begin COMPU_METHOD zw_ub_q6 "" RAT_FUNC "%6.2" "Grad KW" COEFFS 0 255 0 0 0 1530 /end COMPU_METHOD
/begin COMPU_METHOD default "" RAT_FUNC "%6.2" "" COEFFS 0 1 0 0 0 1 /end COMPU_METHOD
/begin RECORD_LAYOUT dc_ArrUb FNC_VALUES 1 UBYTE COLUMN_DIR DIRECT /end RECORD_LAYOUT
/begin RECORD_LAYOUT dc_GKlWSb FNC_VALUES 1 SBYTE COLUMN_DIR DIRECT /end RECORD_LAYOUT
/begin RECORD_LAYOUT dc_GKlWUb FNC_VALUES 1 UBYTE COLUMN_DIR DIRECT /end RECORD_LAYOUT
/begin RECORD_LAYOUT dc_KwUb FNC_VALUES 1 UBYTE COLUMN_DIR DIRECT /end RECORD_LAYOUT
/begin RECORD_LAYOUT dc_KwUw FNC_VALUES 1 UWORD COLUMN_DIR DIRECT /end RECORD_LAYOUT
/begin RECORD_LAYOUT dc_SstAUbSstSb NO_AXIS_PTS_X 1 UBYTE AXIS_PTS_X 2 SBYTE INDEX_INCR DIRECT /end RECORD_LAYOUT
/begin RECORD_LAYOUT dc_SstAUwSstUw NO_AXIS_PTS_X 1 UWORD AXIS_PTS_X 2 UWORD INDEX_INCR DIRECT /end RECORD_LAYOUT
/begin RECORD_LAYOUT FklWUb FNC_VALUES 1 UBYTE COLUMN_DIR DIRECT /end RECORD_LAYOUT
/begin RECORD_LAYOUT FklWUw FNC_VALUES 1 UWORD COLUMN_DIR DIRECT /end RECORD_LAYOUT
/begin RECORD_LAYOUT GkfWUb FNC_VALUES 1 UBYTE COLUMN_DIR DIRECT /end RECORD_LAYOUT
/begin RECORD_LAYOUT GklWSw FNC_VALUES 1 SWORD COLUMN_DIR DIRECT /end RECORD_LAYOUT
/begin RECORD_LAYOUT GklWUb FNC_VALUES 1 UBYTE COLUMN_DIR DIRECT /end RECORD_LAYOUT
/begin RECORD_LAYOUT GklWUw FNC_VALUES 1 UWORD COLUMN_DIR DIRECT /end RECORD_LAYOUT
/begin RECORD_LAYOUT KfAxUbAyUbSstxUbSstyUbWSb NO_AXIS_PTS_X 1 UBYTE NO_AXIS_PTS_Y 2 UBYTE AXIS_PTS_X 3 UBYTE INDEX_INCR DIRECT AXIS_PTS_Y 4 UBYTE INDEX_INCR DIRECT FNC_VALUES 5 SBYTE COLUMN_DIR DIRECT /end RECORD_LAYOUT
/begin RECORD_LAYOUT KfAxUbAyUbSstxUbSstyUbWUb NO_AXIS_PTS_X 1 UBYTE NO_AXIS_PTS_Y 2 UBYTE AXIS_PTS_X 3 UBYTE INDEX_INCR DIRECT AXIS_PTS_Y 4 UBYTE INDEX_INCR DIRECT FNC_VALUES 5 UBYTE COLUMN_DIR DIRECT /end RECORD_LAYOUT
/begin RECORD_LAYOUT KfAxUbAyUbSstxUbSstyUwWUb NO_AXIS_PTS_X 1 UBYTE NO_AXIS_PTS_Y 2 UBYTE AXIS_PTS_X 3 UBYTE INDEX_INCR DIRECT AXIS_PTS_Y 4 UWORD INDEX_INCR DIRECT FNC_VALUES 5 UBYTE COLUMN_DIR DIRECT /end RECORD_LAYOUT
/begin RECORD_LAYOUT KfAxUbAyUbSstxUwSstyUbWUb NO_AXIS_PTS_X 1 UBYTE NO_AXIS_PTS_Y 2 UBYTE AXIS_PTS_X 3 UWORD INDEX_INCR DIRECT AXIS_PTS_Y 4 UBYTE INDEX_INCR DIRECT FNC_VALUES 5 UBYTE COLUMN_DIR DIRECT /end RECORD_LAYOUT
/begin RECORD_LAYOUT KfAxUbAyUbSstxUwSstyUwWUw NO_AXIS_PTS_X 1 UWORD NO_AXIS_PTS_Y 2 UWORD AXIS_PTS_X 3 UWORD INDEX_INCR DIRECT AXIS_PTS_Y 4 UWORD INDEX_INCR DIRECT FNC_VALUES 5 UWORD COLUMN_DIR DIRECT /end RECORD_LAYOUT
/begin RECORD_LAYOUT KfAxUwAyUwSstxUwSstyUwWUw NO_AXIS_PTS_X 1 UWORD NO_AXIS_PTS_Y 2 UWORD AXIS_PTS_X 3 UWORD INDEX_INCR DIRECT AXIS_PTS_Y 4 UWORD INDEX_INCR DIRECT FNC_VALUES 5 UWORD COLUMN_DIR DIRECT /end RECORD_LAYOUT
/begin RECORD_LAYOUT KlAUbSstSwWSw NO_AXIS_PTS_X 1 SWORD AXIS_PTS_X 2 SWORD INDEX_INCR DIRECT FNC_VALUES 3 SWORD COLUMN_DIR DIRECT /end RECORD_LAYOUT
/begin RECORD_LAYOUT KlAUbSstUbWSb NO_AXIS_PTS_X 1 UBYTE AXIS_PTS_X 2 UBYTE INDEX_INCR DIRECT FNC_VALUES 3 SBYTE COLUMN_DIR DIRECT /end RECORD_LAYOUT
/begin RECORD_LAYOUT KlAUbSstUbWUb NO_AXIS_PTS_X 1 UBYTE AXIS_PTS_X 2 UBYTE INDEX_INCR DIRECT FNC_VALUES 3 UBYTE COLUMN_DIR DIRECT /end RECORD_LAYOUT
/begin RECORD_LAYOUT KlAUbSstUbWUw NO_AXIS_PTS_X 1 UBYTE AXIS_PTS_X 2 UBYTE INDEX_INCR DIRECT FNC_VALUES 3 UWORD COLUMN_DIR DIRECT /end RECORD_LAYOUT
/begin RECORD_LAYOUT KlAUbSstUwWUb NO_AXIS_PTS_X 1 UBYTE AXIS_PTS_X 2 UWORD INDEX_INCR DIRECT FNC_VALUES 3 UBYTE COLUMN_DIR DIRECT /end RECORD_LAYOUT
/begin RECORD_LAYOUT KlAUwSstSwWUw NO_AXIS_PTS_X 1 UWORD AXIS_PTS_X 2 SWORD INDEX_INCR DIRECT FNC_VALUES 3 UWORD COLUMN_DIR DIRECT /end RECORD_LAYOUT
/begin RECORD_LAYOUT KlAUwSstUwWUb NO_AXIS_PTS_X 1 UWORD AXIS_PTS_X 2 UWORD INDEX_INCR DIRECT FNC_VALUES 3 UBYTE COLUMN_DIR DIRECT /end RECORD_LAYOUT
/begin RECORD_LAYOUT KlAUwSstUwWUw NO_AXIS_PTS_X 1 UWORD AXIS_PTS_X 2 UWORD INDEX_INCR DIRECT FNC_VALUES 3 UWORD COLUMN_DIR DIRECT /end RECORD_LAYOUT
/begin RECORD_LAYOUT KlAxU8SstxU16WU16 NO_AXIS_PTS_X 1 UWORD AXIS_PTS_X 2 UWORD INDEX_INCR DIRECT FNC_VALUES 3 UWORD COLUMN_DIR DIRECT /end RECORD_LAYOUT
/begin RECORD_LAYOUT KwSb FNC_VALUES 1 SBYTE COLUMN_DIR DIRECT /end RECORD_LAYOUT
/begin RECORD_LAYOUT KwSw FNC_VALUES 1 SWORD COLUMN_DIR DIRECT /end RECORD_LAYOUT
/begin RECORD_LAYOUT KwUb FNC_VALUES 1 UBYTE COLUMN_DIR DIRECT /end RECORD_LAYOUT
/begin RECORD_LAYOUT KwUw FNC_VALUES 1 UWORD COLUMN_DIR DIRECT /end RECORD_LAYOUT
/begin RECORD_LAYOUT KwWS16 FNC_VALUES 1 SWORD COLUMN_DIR DIRECT /end RECORD_LAYOUT
/begin RECORD_LAYOUT KwWU16 FNC_VALUES 1 UWORD COLUMN_DIR DIRECT /end RECORD_LAYOUT
/begin RECORD_LAYOUT KwWU8 FNC_VALUES 1 UBYTE COLUMN_DIR DIRECT /end RECORD_LAYOUT
/begin RECORD_LAYOUT SstAUbSstUb NO_AXIS_PTS_X 1 UBYTE AXIS_PTS_X 2 UBYTE INDEX_INCR DIRECT /end RECORD_LAYOUT
/begin RECORD_LAYOUT SstAUwSstUw NO_AXIS_PTS_X 1 UWORD AXIS_PTS_X 2 UWORD INDEX_INCR DIRECT /end RECORD_LAYOUT
/end MODULE
/end PROJECT
