ASAP2_VERSION 1 3
/begin PROJECT _9702_071D00 "ME97"
/begin HEADER "" VERSION "_9702_071D00" PROJECT_NO _9702_071D00 /end HEADER
/begin MODULE DIM ""
/begin MOD_COMMON "" BYTE_ORDER MSB_FIRST ALIGNMENT_BYTE 1 ALIGNMENT_WORD 2 ALIGNMENT_LONG 2 ALIGNMENT_FLOAT32_IEEE 4 /end MOD_COMMON
/begin CHARACTERISTIC ADCC_MX_UM "Maximaler ADC-Wert bei nach low verzogenem ADC-Kanal bei der ADC-Pr¸fung" VALUE 0x1C8204 KwUb 2.490 spg_ub_q0p0098 0.00 2.490 FORMAT "%5.3" /end CHARACTERISTIC
/begin CHARACTERISTIC ADCC_T_UM "Fehlerzeit bei zueinander unplausiblen ADC-Werten f¸r sp1s" VALUE 0x1C8205 KwUb 5100.00 t20ms_ub_b5100 0.00 5100.00 /end CHARACTERISTIC
/begin CHARACTERISTIC ADCQ_T_UM "Fehlerzeit bei defekter ADC-Queue in der Queue¸berwachung" VALUE 0x1C8206 KwUb 2550.00 t10ms_ub_b2550 0.00 2550.00 /end CHARACTERISTIC
/begin CHARACTERISTIC AUSCH_T_UM "Maximale Anzahl von Antworten an das UM zur Heilung des FZ im Abschaltpfadtest" VALUE 0x1C81C2 KwUb 255.0 dez 0.00 255.0 FORMAT "%5.1" /end CHARACTERISTIC
/begin CHARACTERISTIC AUSC_T_UM "zul‰ssige Anzahl von Pr¸fungen auf nicht angezogenes Hauptrelais in %UMAUSC" VALUE 0x1C81C3 KwUb 255.0 dez 0.00 255.0 FORMAT "%5.1" /end CHARACTERISTIC
/begin CHARACTERISTIC AUSGH_T_UM "Heilungszeit f¸r Fehler in der zyklischen RAM-Pr¸fung der Funktions¸berwachung" VALUE 0x1C8210 KwUb 10200.0 t40ms_ub_b10200 0.00 10200.0 FORMAT "%7.1" /end CHARACTERISTIC
/begin CHARACTERISTIC AUSG_T_UM "Fehlertoleranzschwelle f¸r zyklische RAM-Pr¸fung in der Funktions¸berwachung" VALUE 0x1C8211 KwUb 255.0 dezsub1 1.000 256.0 FORMAT "%5.1" /end CHARACTERISTIC
/begin CHARACTERISTIC AUSZH_T_UM "Heilungszeit f¸r Fehler in der zyklischen ROM-Pr¸fung der Funktions¸berwachung" VALUE 0x1C8212 KwUb 10200.0 t40ms_ub_b10200 0.00 10200.0 FORMAT "%7.1" /end CHARACTERISTIC
/begin CHARACTERISTIC AUSZ_T_UM "Fehlertoleranzschwelle f¸r zyklische ROM-Pr¸fung in der Funktions¸berwachung" VALUE 0x1C8213 KwUb 255.0 dezsub1 1.000 256.0 FORMAT "%5.1" /end CHARACTERISTIC
/begin CHARACTERISTIC BREMS_T_UM "Entprellzeit f¸r bet‰tigte Bremse in der Funktions¸berwachung" VALUE 0x1C7CFC KwUb 10200.0 t40ms_ub_b10200 0.00 10200.0 FORMAT "%7.1" /end CHARACTERISTIC
/begin CHARACTERISTIC BZ_MSR_M "MSR-Botschaftsz‰hler-Maske (0Fh f¸r 4-Bit-Botschaftsz‰hler)" VALUE 0x1C7D95 KwUb 255.0 dez 0.00 255.0 FORMAT "%5.1" /end CHARACTERISTIC
/begin CHARACTERISTIC CNOKT "Codewort Niederoktan-Kraftstoff" VALUE 0x1CE334 KwUb 255.0 dez 0.00 255.0 FORMAT "%5.1" /end CHARACTERISTIC
/begin CHARACTERISTIC CWKHZW "Codewort f¸r sp‰testen Z¸ndwinkel bei Katheizen" VALUE 0x1C5D48 KwUb 255.0 dez 0.00 255.0 FORMAT "%5.1" /end CHARACTERISTIC
/begin CHARACTERISTIC CWNOMSRU "Codewort MSR-‹berwachung nicht aktiv" VALUE 0x1C7D96 KwUb 255.0 dez 0.00 255.0 FORMAT "%5.1" /end CHARACTERISTIC
/begin CHARACTERISTIC CWNWRA "Codewort zur Einschaltung Filter  Verstellgeschwindigkeit Nockenwelle (Auslaﬂ)" VALUE 0x1C3C60 KwUb 255.0 dez 0.00 255.0 FORMAT "%5.1" /end CHARACTERISTIC
/begin CHARACTERISTIC CWNWRE "Codewort zur Einschaltung Filter  Verstellgeschwindigkeit Nockenwelle Einlass" VALUE 0x1C3C98 KwUb 255.0 dez 0.00 255.0 FORMAT "%5.1" /end CHARACTERISTIC
/begin CHARACTERISTIC CWZWBANK "Codewort zyl.individuelle Freigabe des ZW-Offsets" VALUE 0x1CE335 KwUb 255.0 dez 0.00 255.0 FORMAT "%5.1" /end CHARACTERISTIC
/begin CHARACTERISTIC CW_BDE_UM "Codewort f¸r Benzindirekteinspritzung in Funktions¸berwachung" VALUE 0x1C81BE KwUb 255.0 dez 0.00 255.0 FORMAT "%5.1" /end CHARACTERISTIC
/begin CHARACTERISTIC CW_FUBND "Codewort f¸r Funkenbandz¸ndung" VALUE 0x1C5738 KwUb 255.0 DEZ 0.00 255.0 FORMAT "%5.1" /end CHARACTERISTIC
/begin CHARACTERISTIC CW_NOROMCHKRESET "" VALUE 0x1C2CBD KwUb 255.0 dez 0.00 255.0 FORMAT "%5.1" /end CHARACTERISTIC
/begin CHARACTERISTIC DNTIPDYN "Einschaltschwelle Drehzahdynamik f¸r Tip-In Offset auf sp‰testen Z¸ndwinkel" VALUE 0x1C5D49 KwSb 25500. nmotg_sb_q100 -12800. 12700. FORMAT "%5.0" /end CHARACTERISTIC
/begin CHARACTERISTIC DNZWMN "Drehzahloffset auf nstat f¸r Abschalten des Tip-In ZW-Offsets" VALUE 0x1C5D4A KwUb 10200. nmot_ub_q40 0.00 10200. FORMAT "%5.0" /end CHARACTERISTIC
/begin CHARACTERISTIC DPIPFIL_UM "Filter-Zeitkonstante f¸r verzˆgerte Druckinfo dpipf_um in d. Funktions¸berwachun" VALUE 0x1C7EA4 KwUb 10159.4 zk40ms_ub_b10200 40.6299 10200.0 FORMAT "%7.1" /end CHARACTERISTIC
/begin CHARACTERISTIC DPIPTV_UM "Verzugszeit f¸r Druckinfo dpipf_um in der Funktions¸berwachung" VALUE 0x1C7EA5 KwUb 320.000 t40ms_ub_b10200 0.00 320.000 FORMAT "%7.3" /end CHARACTERISTIC
/begin CHARACTERISTIC DPS_T_UM "Fehlertoleranzzeit f¸r unplausible Druckinfo f.d. Funktions¸berwachung" VALUE 0x1C7EA6 KwUb 10200.0 t40ms_ub_b10200 0.00 10200.0 FORMAT "%7.1" /end CHARACTERISTIC
/begin CHARACTERISTIC DWNWARA "max. Abweichung von Referenzposition f¸r Verstellgeschwindigkeit = 0 Auslass" VALUE 0x1C3C72 KwUw 511.9922 kw_q0p0078 0.00 511.9922 FORMAT "%8.4" /end CHARACTERISTIC
/begin CHARACTERISTIC DWNWARE "max. Abweichung von Referenzposition f¸r Verstellgeschwindigkeit = 0 Einlass" VALUE 0x1C3CAA KwUw 511.9922 kw_q0p0078 0.00 511.9922 FORMAT "%8.4" /end CHARACTERISTIC
/begin CHARACTERISTIC DWNWASIMN "Minimalwert von dwnwa_w f¸r Eingang schneller I-Anteil des NW-Reglers" VALUE 0x1C3C74 KwSw 511.9922 kw_q0p0078 -256.0000 255.9922 FORMAT "%8.4" /end CHARACTERISTIC
/begin CHARACTERISTIC DWNWASIMX "Maximalwert von dwnwa_w f¸r Eingang schneller I-Anteil des NW-Reglers" VALUE 0x1C3C76 KwSw 511.9922 kw_q0p0078 -256.0000 255.9922 FORMAT "%8.4" /end CHARACTERISTIC
/begin CHARACTERISTIC DWNWDATMN "Untere Schwelle f¸r Totzone von D-Regelanteil Auslaﬂ" VALUE 0x1C3C78 KwSw 511.9922 kw_q0p0078 -256.0000 255.9922 FORMAT "%8.4" /end CHARACTERISTIC
/begin CHARACTERISTIC DWNWDATMX "Obere Schwelle f¸r Totzone von D-Regelanteil Auslaﬂ" VALUE 0x1C3C7A KwSw 511.9922 kw_q0p0078 -256.0000 255.9922 FORMAT "%8.4" /end CHARACTERISTIC
/begin CHARACTERISTIC DWNWDETMN "Untere Schwelle f¸r Totzone von D-Regelanteil" VALUE 0x1C3CAC KwSw 511.9922 kw_q0p0078 -256.0000 255.9922 FORMAT "%8.4" /end CHARACTERISTIC
/begin CHARACTERISTIC DWNWDETMX "Obere Schwelle f¸r Totzone von D-Regelanteil" VALUE 0x1C3CAE KwSw 511.9922 kw_q0p0078 -256.0000 255.9922 FORMAT "%8.4" /end CHARACTERISTIC
/begin CHARACTERISTIC DWNWESIMN "Minimalwert von dwnwe_w f¸r Eingang schneller I-Anteil des NW-Reglers" VALUE 0x1C3CB0 KwSw 511.9922 kw_q0p0078 -256.0000 255.9922 FORMAT "%8.4" /end CHARACTERISTIC
/begin CHARACTERISTIC DWNWESIMX "Maximalwert von dwnwe_w f¸r Eingang schneller I-Anteil des NW-Reglers" VALUE 0x1C3CB2 KwSw 511.9922 kw_q0p0078 -256.0000 255.9922 FORMAT "%8.4" /end CHARACTERISTIC
/begin CHARACTERISTIC DZWAML "Auf/Abregelgeschwindigkeit zwischen den Begrenzungskennfeldern" CURVE 0x1CE4FE KlAUbSstUbWSb 94.50 zw_sb_q0p75 0.7500 95.25 FORMAT "%5.2"
 /begin AXIS_DESCR STD_AXIS ml m_ub_b1020 12 0.00 1020. FORMAT "%5.0" DEPOSIT ABSOLUTE /end AXIS_DESCR
/end CHARACTERISTIC
/begin CHARACTERISTIC DZWDYN "Fr¸hverschiebung des Brenngrenzenz¸ndwinkels bei Tip-In" CURVE 0x1CE4F0 GklWSb 191.3 zw_sb_q0p75 -96.00 95.25 FORMAT "%5.2"
 /begin AXIS_DESCR COM_AXIS tmot temp_ub_q0p75_o48 6 -48.00 143.3 AXIS_PTS_REF STM06__UB /end AXIS_DESCR
/end CHARACTERISTIC
/begin CHARACTERISTIC DZWSPM "Delta sp‰tester Z¸ndwinkel abh‰ngig von Motortemperatur" CURVE 0x1CE4F8 GklWSb 191.3 zw_sb_q0p75 -96.00 95.25 FORMAT "%5.2"
 /begin AXIS_DESCR COM_AXIS tmot temp_ub_q0p75_o48 6 -48.00 143.3 AXIS_PTS_REF STM06__UB /end AXIS_DESCR
/end CHARACTERISTIC
/begin CHARACTERISTIC DZWSTTA "Delta Z¸ndwinkel im Start" CURVE 0x1CE548 KlAUbSstUbWSb 191.3 zw_sb_q0p75 -96.00 95.25 FORMAT "%5.2"
 /begin AXIS_DESCR STD_AXIS tans temp_ub_q0p75_o48 6 -48.00 143.3 FORMAT "%5.1" DEPOSIT ABSOLUTE /end AXIS_DESCR
/end CHARACTERISTIC
/begin CHARACTERISTIC EVHUBMX_UM "Maximalwert des plausibilisierbaren Ventilhubs" VALUE 0x1C7EA7 KwUb 16.32 hub_ub_q0p064 0.00 16.32 FORMAT "%5.2" /end CHARACTERISTIC
/begin CHARACTERISTIC FFLDZ "Folgefunkenladezeit" CURVE 0x1C580A KlAUbSstUbWUw 4.900000 t_q0p001_ms 0.1000000 5.000000 FORMAT "%8.6"
 /begin AXIS_DESCR STD_AXIS ub spg_ubatt 8 0.00 24.02 FORMAT "%5.2" DEPOSIT ABSOLUTE /end AXIS_DESCR
/end CHARACTERISTIC
/begin CHARACTERISTIC FGREN_T_UM "Toleranzzeit f¸r FGR-Einschaltung nach Erkennung FGR in der Funktions¸berwachung" VALUE 0x1C7CFD KwUb 10200.0 t40ms_ub_b10200 0.00 10200.0 FORMAT "%7.1" /end CHARACTERISTIC
/begin CHARACTERISTIC FQUARZ_UM "Quarzfrequenz in der Funktions¸berwachung" VALUE 0x1C7E82 KwUw 65535.00 fquarz_uw_q1p0 0.00 65535.00 FORMAT "%8.2" /end CHARACTERISTIC
/begin CHARACTERISTIC FRERR_T_UM "" VALUE 0x1C81C1 KwUb 10200.0 t40ms_ub_b10200 0.00 10200.0 FORMAT "%7.1" /end CHARACTERISTIC
/begin CHARACTERISTIC FSZTM "Faktor Schlieﬂzeitkorrektur tmot-abh‰ngig" CURVE 0x1C573C KlAUbSstUbWUb 1.992 fak_ub_b2 0.00 1.992 FORMAT "%5.3"
 /begin AXIS_DESCR STD_AXIS tmot temp_ub_q0p75_o48 8 -48.00 143.3 FORMAT "%5.1" DEPOSIT ABSOLUTE /end AXIS_DESCR
/end CHARACTERISTIC
/begin CHARACTERISTIC FTANWUBA "Faktor Korrektur Tastverh‰ltnis Nockenwelle f(ub),  (Auslaﬂ)" CURVE 0x1C3C64 KlAUbSstUbWUb 1.992 fak_ub_b2 0.00 1.992 FORMAT "%5.3"
 /begin AXIS_DESCR STD_AXIS ub spg_ubatt 6 0.00 24.02 FORMAT "%5.2" DEPOSIT ABSOLUTE /end AXIS_DESCR
/end CHARACTERISTIC
/begin CHARACTERISTIC FTANWUBE "Faktor Korrektur Tastverh‰ltnis Nockenwelle f(ub) Einlass" CURVE 0x1C3C9C KlAUbSstUbWUb 1.992 fak_ub_b2 0.00 1.992 FORMAT "%5.3"
 /begin AXIS_DESCR STD_AXIS ub spg_ubatt 6 0.00 24.02 FORMAT "%5.2" DEPOSIT ABSOLUTE /end AXIS_DESCR
/end CHARACTERISTIC
/begin CHARACTERISTIC FTMFFANZ "Folgefunken Bewertungsfaktor" CURVE 0x1C5750 KlAUbSstUbWUb 1.992 fak_ub_b2 0.00 1.992 FORMAT "%5.3"
 /begin AXIS_DESCR STD_AXIS tmot temp_ub_q0p75_o48 8 -48.00 143.3 FORMAT "%5.1" DEPOSIT ABSOLUTE /end AXIS_DESCR
/end CHARACTERISTIC
/begin CHARACTERISTIC FUBAOF "Offenzeit f¸r Funkenbandz¸ndung" VALUE 0x1C5824 KwUw 4.900000 t_q0p001_ms 0.1000000 5.000000 FORMAT "%8.6" /end CHARACTERISTIC
/begin CHARACTERISTIC FWNMOT "Einschaltschwelle nmot f¸r Funkenbandz¸ndung" VALUE 0x1C5761 KwUb 3000. nmot_ub_q40 0.00 3000. FORMAT "%5.0" /end CHARACTERISTIC
/begin CHARACTERISTIC FZWKHMX "Normierung f¸r Faktor Momentenreserve Katheizen" VALUE 0x1C5D4B KwUb 0.9961 fak_ub_b1 0.00 0.9961 /end CHARACTERISTIC
/begin CHARACTERISTIC FZWWLRLN "Wichtung Delta-Z¸ndwinkel im Warmlauf" MAP 0x1CE558 GkfWUb 1.992 fak_ub_b2 0.00 1.992 FORMAT "%5.3"
 /begin AXIS_DESCR COM_AXIS nmot nmot_ub_q40 12 0.00 10200. AXIS_PTS_REF SNM12ESUB /end AXIS_DESCR
 /begin AXIS_DESCR COM_AXIS rl rel_ub_q0p75 6 0.00 191.3 AXIS_PTS_REF SRL06ESUB /end AXIS_DESCR
/end CHARACTERISTIC
/begin AXIS_PTS HUBV08_UM "" 0x1C7EA8 evhubi_um SstAUbSstUb 16.32 hub_ub_q0p064 8 0.00 16.32 FORMAT "%5.2" DEPOSIT ABSOLUTE /end AXIS_PTS
/begin CHARACTERISTIC IP1A_MX_UM "max. Spannung f¸r DK-Istwert-Poti 1 am unteren Anschlag f¸r die Funktions¸berw." VALUE 0x1C7EB1 KwUb 4.980 spg_ub_q0p019 0.00 4.980 FORMAT "%5.3" /end CHARACTERISTIC
/begin CHARACTERISTIC IP2A_MN_UM "min. Spannung f¸r DK-Istwert-Poti 2 am unteren Anschlag f¸r die Funktions¸berw." VALUE 0x1C7EB2 KwUb 4.980 spg_ub_q0p019 0.00 4.980 FORMAT "%5.3" /end CHARACTERISTIC
/begin CHARACTERISTIC IPA_T_UM "Fehlertoleranzzeit f¸r unteren DK-Anschlag im ung¸ltigen Bereich f. d. Fkt¸berw." VALUE 0x1C7EB3 KwUb 10200.0 t40ms_ub_b10200 0.00 10200.0 FORMAT "%7.1" /end CHARACTERISTIC
/begin AXIS_PTS IPSNV08_UM "St¸tzstellenverteilung DK-Ist-Wert-Poti" 0x1C7EB4 ipsn_um SstAUbSstUb 4.980 spg_ub_q0p019 8 0.00 4.980 FORMAT "%5.3" DEPOSIT ABSOLUTE /end AXIS_PTS
/begin CHARACTERISTIC ITANWLIA "Inititiwert f¸r langsamen I-Anteil  Nockenwellenregler Auslass" CURVE 0x1CB99A GklWSw 100.0000 rel_sw_b200 0.00 100.0000 FORMAT "%8.4"
 /begin AXIS_DESCR COM_AXIS toelk_w temp_q0p0234_o273 6 -273.1500 1262.827 AXIS_PTS_REF STO06NWUW /end AXIS_DESCR
/end CHARACTERISTIC
/begin CHARACTERISTIC ITANWLIE "Inititiwert f¸r langsamen I-Anteil  Nockenwellenregler Einlass" CURVE 0x1CBA8A GklWSw 100.0000 rel_sw_b200 0.00 100.0000 FORMAT "%8.4"
 /begin AXIS_DESCR COM_AXIS toelk_w temp_q0p0234_o273 6 -273.1500 1262.827 AXIS_PTS_REF STO06NWUW /end AXIS_DESCR
/end CHARACTERISTIC
/begin CHARACTERISTIC ITANWLIGA "Inititiwert f¸r langsamen I-Anteil  Nockenwellenregler Auslass(groﬂer Hub)" CURVE 0x1CB9A6 GklWSw 100.0000 rel_sw_b200 0.00 100.0000 FORMAT "%8.4"
 /begin AXIS_DESCR COM_AXIS toelk_w temp_q0p0234_o273 6 -273.1500 1262.827 AXIS_PTS_REF STO06NWUW /end AXIS_DESCR
/end CHARACTERISTIC
/begin CHARACTERISTIC ITANWLIGE "Inititiwert f¸r langsamen I-Anteil  Nockenwellenregler Einlass(groﬂer Hub)" CURVE 0x1CBA96 GklWSw 100.0000 rel_sw_b200 0.00 100.0000 FORMAT "%8.4"
 /begin AXIS_DESCR COM_AXIS toelk_w temp_q0p0234_o273 6 -273.1500 1262.827 AXIS_PTS_REF STO06NWUW /end AXIS_DESCR
/end CHARACTERISTIC
/begin CHARACTERISTIC KFDPIP_UM "Kennfeld f¸r Druck - Berechnung aus Drosselklappenwinkel in der Funktions¸berwac" MAP 0x1C7EC0 KfAxUbAyUbSstxUbSstyUbWUb 1275. p_q5 0.00 1275. FORMAT "%5.0"
 /begin AXIS_DESCR STD_AXIS ipsn_um spg_ub_q0p019 8 0.00 4.980 FORMAT "%5.3" DEPOSIT ABSOLUTE /end AXIS_DESCR
 /begin AXIS_DESCR STD_AXIS nmot_um nmot_ub_q40 8 0.00 10200. FORMAT "%5.0" DEPOSIT ABSOLUTE /end AXIS_DESCR
/end CHARACTERISTIC
/begin CHARACTERISTIC KFDWSZ "delta Z¸ndwinkelkennfeld f¸r selektive Z¸ndverstellung" MAP 0x1C58C4 GkfWSb 191.3 zw_sb_q0p75 -96.00 95.25 FORMAT "%5.2"
 /begin AXIS_DESCR COM_AXIS nmot nmot_ub_q40 16 0.00 2621400. AXIS_PTS_REF SNM16ZUUW /end AXIS_DESCR
 /begin AXIS_DESCR COM_AXIS rl rel_ub_q0p75 12 0.00 49151.25 AXIS_PTS_REF SRL12ZUUW /end AXIS_DESCR
/end CHARACTERISTIC
/begin CHARACTERISTIC KFDWSZ2 "delta ZW f¸r Banksel. ZW-Verstellung; bei NWV" MAP 0x1C5984 GkfWSb 191.3 zw_sb_q0p75 -96.00 95.25 FORMAT "%5.2"
 /begin AXIS_DESCR COM_AXIS nmot nmot_ub_q40 16 0.00 2621400. AXIS_PTS_REF SNM16ZUUW /end AXIS_DESCR
 /begin AXIS_DESCR COM_AXIS rl rel_ub_q0p75 12 0.00 49151.25 AXIS_PTS_REF SRL12ZUUW /end AXIS_DESCR
/end CHARACTERISTIC
/begin CHARACTERISTIC KFDZK "delta Z¸ndwinkel bei Dauerklopfen" MAP 0x1CE338 GkfWSb 191.3 zw_sb_q0p75 -96.00 95.25 FORMAT "%5.2"
 /begin AXIS_DESCR COM_AXIS nmot nmot_ub_q40 16 0.00 2621400. AXIS_PTS_REF SNM16ZUUW /end AXIS_DESCR
 /begin AXIS_DESCR COM_AXIS rl rel_ub_q0p75 12 0.00 49151.25 AXIS_PTS_REF SRL12ZUUW /end AXIS_DESCR
/end CHARACTERISTIC
/begin CHARACTERISTIC KFDZMNST "Min-Z¸ndwinkeloffset im Nachstart - Regelung des Start¸berschwingers" MAP 0x1C5D4C GkfWSb 191.3 zw_sb_q0p75 -96.00 95.25 FORMAT "%5.2"
 /begin AXIS_DESCR COM_AXIS nmot_w nmot_uw_q0p25 4 0.00 16383.75 AXIS_PTS_REF SNM04ZUUW /end AXIS_DESCR
 /begin AXIS_DESCR COM_AXIS dns nmotd_sb_q10 4 -1280. 1270. AXIS_PTS_REF SNS04ZUSB /end AXIS_DESCR
/end CHARACTERISTIC
/begin CHARACTERISTIC KFDZWKG "Z¸ndwinkelkorrektur durch Verschieben der Klopfgrenze" MAP 0x1CE4B8 KfAxUbAyUbSstxUbSstyUbWSb 191.3 zw_sb_q0p75 -96.00 95.25 FORMAT "%5.2"
 /begin AXIS_DESCR STD_AXIS nmot nmot_ub_q40 8 0.00 10200. FORMAT "%5.0" DEPOSIT ABSOLUTE /end AXIS_DESCR
 /begin AXIS_DESCR STD_AXIS lambas fak_ub_b2 5 0.00 1.992 FORMAT "%5.3" DEPOSIT ABSOLUTE /end AXIS_DESCR
/end CHARACTERISTIC
/begin CHARACTERISTIC KFFFANZ "Anzahl Folgefunken" MAP 0x1C5764 KfAxUbAyUbSstxUbSstyUbWUb 255.0 dez 0.00 255.0 FORMAT "%5.1"
 /begin AXIS_DESCR STD_AXIS tmot temp_ub_q0p75_o48 8 -48.00 143.3 FORMAT "%5.1" DEPOSIT ABSOLUTE /end AXIS_DESCR
 /begin AXIS_DESCR STD_AXIS nmot nmot_ub_q40 8 0.00 10200. FORMAT "%5.0" DEPOSIT ABSOLUTE /end AXIS_DESCR
/end CHARACTERISTIC
/begin CHARACTERISTIC KFFFANZUB "Anzahl Folgefunken" MAP 0x1C57B8 KfAxUbAyUbSstxUbSstyUbWUb 127.0 dez 0.00 127.0 FORMAT "%5.1"
 /begin AXIS_DESCR STD_AXIS ub spg_ubatt 8 0.00 24.02 FORMAT "%5.2" DEPOSIT ABSOLUTE /end AXIS_DESCR
 /begin AXIS_DESCR STD_AXIS nmot nmot_ub_q40 8 0.00 10200. FORMAT "%5.0" DEPOSIT ABSOLUTE /end AXIS_DESCR
/end CHARACTERISTIC
/begin CHARACTERISTIC KFLVVTM_UM "" MAP 0x1C7F14 KfAxUbAyUbSstxUbSstyUbWUb 191.3 rel_ub_q0p75 0.00 191.3 FORMAT "%5.1"
 /begin AXIS_DESCR STD_AXIS evhubim_um hub_ub_q0p064 8 0.00 16.32 FORMAT "%5.2" DEPOSIT ABSOLUTE /end AXIS_DESCR
 /begin AXIS_DESCR STD_AXIS nmot_um nmot_ub_q40 8 0.00 10200. FORMAT "%5.0" DEPOSIT ABSOLUTE /end AXIS_DESCR
/end CHARACTERISTIC
/begin CHARACTERISTIC KFLVVT_UM "Kennfeld f¸r rl-Berechnung aus der VVT-Stellung" MAP 0x1C7F68 KfAxUbAyUbSstxUbSstyUbWUb 191.3 rel_ub_q0p75 0.00 191.3 FORMAT "%5.1"
 /begin AXIS_DESCR STD_AXIS evhubi_um hub_ub_q0p064 8 0.00 16.32 FORMAT "%5.2" DEPOSIT ABSOLUTE /end AXIS_DESCR
 /begin AXIS_DESCR STD_AXIS nmot_um nmot_ub_q40 8 0.00 10200. FORMAT "%5.0" DEPOSIT ABSOLUTE /end AXIS_DESCR
/end CHARACTERISTIC
/begin CHARACTERISTIC KFMDZOF_UM "Kennfeld f¸r Offset-Toleranz in Abh‰ngigkeit vom zul‰ssigen Moment" MAP 0x1C7D9C GkfWUb 99.61 rel_ub_b99p6 0.00 99.61 FORMAT "%5.2"
 /begin AXIS_DESCR COM_AXIS mz_um rel_ub_b99p6 8 0.00 99.61 AXIS_PTS_REF MDV08_UM /end AXIS_DESCR
 /begin AXIS_DESCR COM_AXIS nmot_um nmot_ub_q40 8 0.00 10200. AXIS_PTS_REF NMV08_UM /end AXIS_DESCR
/end CHARACTERISTIC
/begin CHARACTERISTIC KFMI_UM "Kennfeld optimales Motormoment in der Funktions¸berwachung" MAP 0x1C7D04 GkfWUb 99.61 rel_ub_b99p6 0.00 99.61 FORMAT "%5.2"
 /begin AXIS_DESCR COM_AXIS rl_um rel_ub_q0p75 8 0.00 191.3 AXIS_PTS_REF RLV08_UM /end AXIS_DESCR
 /begin AXIS_DESCR COM_AXIS nmot_um nmot_ub_q40 8 0.00 10200. AXIS_PTS_REF NZWV08_UM /end AXIS_DESCR
/end CHARACTERISTIC
/begin CHARACTERISTIC KFMPED_UM "Kennfeld f¸r zul‰ssiges Moment aus der Pedalstellung in der Funktions¸berwachg" MAP 0x1C7DDC GkfWUb 99.61 rel_ub_b99p6 0.00 99.61 FORMAT "%5.2"
 /begin AXIS_DESCR COM_AXIS spsn_um spg_ub_q0p019 8 0.00 4.980 AXIS_PTS_REF SPSNV08_UM /end AXIS_DESCR
 /begin AXIS_DESCR COM_AXIS nmot_um nmot_ub_q40 8 0.00 10200. AXIS_PTS_REF NMV08_UM /end AXIS_DESCR
/end CHARACTERISTIC
/begin CHARACTERISTIC KFMPNS_UM "Kennfeld f¸r zul. Moment aus Pedalstellung bei kaltem Motor" MAP 0x1C7E1C GkfWUb 99.61 rel_ub_b99p6 0.00 99.61 FORMAT "%5.2"
 /begin AXIS_DESCR COM_AXIS spsn_um spg_ub_q0p019 8 0.00 4.980 AXIS_PTS_REF SPSNV08_UM /end AXIS_DESCR
 /begin AXIS_DESCR COM_AXIS nmot_um nmot_ub_q40 8 0.00 10200. AXIS_PTS_REF NMV08_UM /end AXIS_DESCR
/end CHARACTERISTIC
/begin CHARACTERISTIC KFNWRDA "Kennfeld D-Anteil Nockenwellenregler Auslaﬂ" MAP 0x1CB9B2 GkfWSw 99.99847 relKW_q0p0015259 -50.00000 49.99847 FORMAT "%8.5"
 /begin AXIS_DESCR COM_AXIS nmot_w nmot_uw_q0p25 6 0.00 16383.75 AXIS_PTS_REF SNM06NWUW /end AXIS_DESCR
 /begin AXIS_DESCR COM_AXIS toelk_w temp_q0p0234_o273 6 -273.1500 1262.827 AXIS_PTS_REF STO06NWUW /end AXIS_DESCR
/end CHARACTERISTIC
/begin CHARACTERISTIC KFNWRDE "Kennfeld D-Anteil Nockenwellenregler Einlaﬂ" MAP 0x1CBAA2 GkfWSw 99.99847 relKW_q0p0015259 -50.00000 49.99847 FORMAT "%8.5"
 /begin AXIS_DESCR COM_AXIS nmot_w nmot_uw_q0p25 6 0.00 16383.75 AXIS_PTS_REF SNM06NWUW /end AXIS_DESCR
 /begin AXIS_DESCR COM_AXIS toelk_w temp_q0p0234_o273 6 -273.1500 1262.827 AXIS_PTS_REF STO06NWUW /end AXIS_DESCR
/end CHARACTERISTIC
/begin CHARACTERISTIC KFNWRPA "Kennfeld P-Anteil Nockenwellenregler Auslaﬂ" MAP 0x1CB9FA GkfWSw 99.99847 relKW_q0p0015259 -50.00000 49.99847 FORMAT "%8.5"
 /begin AXIS_DESCR COM_AXIS nmot_w nmot_uw_q0p25 6 0.00 16383.75 AXIS_PTS_REF SNM06NWUW /end AXIS_DESCR
 /begin AXIS_DESCR COM_AXIS toelk_w temp_q0p0234_o273 6 -273.1500 1262.827 AXIS_PTS_REF STO06NWUW /end AXIS_DESCR
/end CHARACTERISTIC
/begin CHARACTERISTIC KFNWRPE "Kennfeld P-Anteil Nockenwellenregler Einlaﬂ" MAP 0x1CBAEA GkfWSw 99.99847 relKW_q0p0015259 -50.00000 49.99847 FORMAT "%8.5"
 /begin AXIS_DESCR COM_AXIS nmot_w nmot_uw_q0p25 6 0.00 16383.75 AXIS_PTS_REF SNM06NWUW /end AXIS_DESCR
 /begin AXIS_DESCR COM_AXIS toelk_w temp_q0p0234_o273 6 -273.1500 1262.827 AXIS_PTS_REF STO06NWUW /end AXIS_DESCR
/end CHARACTERISTIC
/begin CHARACTERISTIC KFNWRSIA "Kennfeld I-Anteil Nockenwellenregler Auslaﬂ" MAP 0x1CBA42 GkfWSw 99.99847 relKW_q0p0015259 -50.00000 49.99847 FORMAT "%8.5"
 /begin AXIS_DESCR COM_AXIS nmot_w nmot_uw_q0p25 6 0.00 16383.75 AXIS_PTS_REF SNM06NWUW /end AXIS_DESCR
 /begin AXIS_DESCR COM_AXIS toelk_w temp_q0p0234_o273 6 -273.1500 1262.827 AXIS_PTS_REF STO06NWUW /end AXIS_DESCR
/end CHARACTERISTIC
/begin CHARACTERISTIC KFNWRSIE "Kennfeld I-Anteil Nockenwellenregler Einlaﬂ" MAP 0x1CBB32 GkfWSw 99.99847 relKW_q0p0015259 -50.00000 49.99847 FORMAT "%8.5"
 /begin AXIS_DESCR COM_AXIS nmot_w nmot_uw_q0p25 6 0.00 16383.75 AXIS_PTS_REF SNM06NWUW /end AXIS_DESCR
 /begin AXIS_DESCR COM_AXIS toelk_w temp_q0p0234_o273 6 -273.1500 1262.827 AXIS_PTS_REF STO06NWUW /end AXIS_DESCR
/end CHARACTERISTIC
/begin CHARACTERISTIC KFRLDP_UM "Kennfeld f¸r rl-Berechnung aus Druck-Info und DK-Info" MAP 0x1C7FBC KfAxUbAyUbSstxUbSstyUbWUb 1913. m_q7p5 0.00 1913. FORMAT "%5.0"
 /begin AXIS_DESCR STD_AXIS ipsn_um spg_ub_q0p019 8 0.00 4.980 FORMAT "%5.3" DEPOSIT ABSOLUTE /end AXIS_DESCR
 /begin AXIS_DESCR STD_AXIS dps_um p_q5 8 0.00 1275. FORMAT "%5.0" DEPOSIT ABSOLUTE /end AXIS_DESCR
/end CHARACTERISTIC
/begin CHARACTERISTIC KFRLNM1_UM "Kennfeld 1 f¸r Berechnung Nebenlast aus DK-Info und Ventilhub" MAP 0x1C8010 GkfWUb 191.3 rel_ub_q0p75 0.00 191.3 FORMAT "%5.1"
 /begin AXIS_DESCR COM_AXIS ipsn_um spg_ub_q0p019 8 0.00 4.980 AXIS_PTS_REF IPSNV08_UM /end AXIS_DESCR
 /begin AXIS_DESCR COM_AXIS evhubi_um hub_ub_q0p064 8 0.00 16.32 AXIS_PTS_REF HUBV08_UM /end AXIS_DESCR
/end CHARACTERISTIC
/begin CHARACTERISTIC KFRLNM2_UM "Kennfeld 2 f¸r Berechnung Nebenlast aus DK-Info und Ventilhub" MAP 0x1C8050 GkfWUb 191.3 rel_ub_q0p75 0.00 191.3 FORMAT "%5.1"
 /begin AXIS_DESCR COM_AXIS ipsn_um spg_ub_q0p019 8 0.00 4.980 AXIS_PTS_REF IPSNV08_UM /end AXIS_DESCR
 /begin AXIS_DESCR COM_AXIS evhubi_um hub_ub_q0p064 8 0.00 16.32 AXIS_PTS_REF HUBV08_UM /end AXIS_DESCR
/end CHARACTERISTIC
/begin CHARACTERISTIC KFRLNM3_UM "Kennfeld 3 f¸r Berechnung Nebenlast aus DK-Info und Ventilhub" MAP 0x1C8090 GkfWUb 191.3 rel_ub_q0p75 0.00 191.3 FORMAT "%5.1"
 /begin AXIS_DESCR COM_AXIS ipsn_um spg_ub_q0p019 8 0.00 4.980 AXIS_PTS_REF IPSNV08_UM /end AXIS_DESCR
 /begin AXIS_DESCR COM_AXIS evhubi_um hub_ub_q0p064 8 0.00 16.32 AXIS_PTS_REF HUBV08_UM /end AXIS_DESCR
/end CHARACTERISTIC
/begin CHARACTERISTIC KFRLNM4_UM "Kennfeld 4 f¸r Berechnung Nebenlast aus DK-Info und Ventilhub" MAP 0x1C80D0 GkfWUb 191.3 rel_ub_q0p75 0.00 191.3 FORMAT "%5.1"
 /begin AXIS_DESCR COM_AXIS ipsn_um spg_ub_q0p019 8 0.00 4.980 AXIS_PTS_REF IPSNV08_UM /end AXIS_DESCR
 /begin AXIS_DESCR COM_AXIS evhubi_um hub_ub_q0p064 8 0.00 16.32 AXIS_PTS_REF HUBV08_UM /end AXIS_DESCR
/end CHARACTERISTIC
/begin CHARACTERISTIC KFRLNM5_UM "Kennfeld 5 f¸r Berechnung Nebenlast aus DK-Info und Ventilhub" MAP 0x1C8110 GkfWUb 191.3 rel_ub_q0p75 0.00 191.3 FORMAT "%5.1"
 /begin AXIS_DESCR COM_AXIS ipsn_um spg_ub_q0p019 8 0.00 4.980 AXIS_PTS_REF IPSNV08_UM /end AXIS_DESCR
 /begin AXIS_DESCR COM_AXIS evhubi_um hub_ub_q0p064 8 0.00 16.32 AXIS_PTS_REF HUBV08_UM /end AXIS_DESCR
/end CHARACTERISTIC
/begin CHARACTERISTIC KFRLNM6_UM "Kennfeld 6 f¸r Berechnung Nebenlast aus DK-Info und Ventilhub" MAP 0x1C8150 GkfWUb 191.3 rel_ub_q0p75 0.00 191.3 FORMAT "%5.1"
 /begin AXIS_DESCR COM_AXIS ipsn_um spg_ub_q0p019 8 0.00 4.980 AXIS_PTS_REF IPSNV08_UM /end AXIS_DESCR
 /begin AXIS_DESCR COM_AXIS evhubi_um hub_ub_q0p064 8 0.00 16.32 AXIS_PTS_REF HUBV08_UM /end AXIS_DESCR
/end CHARACTERISTIC
/begin CHARACTERISTIC KFSWKFZK "Schwelle der ZW-Sp‰tverstellungen f¸r ZW-Kennfeldumschaltung" MAP 0x1CE3F8 GkfWUb 191.3 zw_ub_qn0p75 -191.3 0.00 FORMAT "%5.1"
 /begin AXIS_DESCR COM_AXIS nmot nmot_ub_q40 16 0.00 2621400. AXIS_PTS_REF SNM16ZUUW /end AXIS_DESCR
 /begin AXIS_DESCR COM_AXIS rl rel_ub_q0p75 12 0.00 49151.25 AXIS_PTS_REF SRL12ZUUW /end AXIS_DESCR
/end CHARACTERISTIC
/begin CHARACTERISTIC KFSZT "Schlieﬂzeit-Kennfeld" MAP 0x1C5826 KfAxUbAyUbSstxUbSstyUwWUw 32.66700 t_q0p001_ms 0.1000000 32.76700 FORMAT "%8.5"
 /begin AXIS_DESCR STD_AXIS ub spg_ubatt 8 0.00 24.02 FORMAT "%5.2" DEPOSIT ABSOLUTE /end AXIS_DESCR
 /begin AXIS_DESCR STD_AXIS nmot_w nmot_uw_q0p25 8 0.00 16383.75 FORMAT "%8.2" DEPOSIT ABSOLUTE /end AXIS_DESCR
/end CHARACTERISTIC
/begin CHARACTERISTIC KFWDKSST "Sollwert Drosselklappenwinkel im Start" MAP 0x1C33A0 KfAxUbAyUbSstxUbSstyUbWUb 100.0 relDK_ub_b100 0.00 100.0 FORMAT "%5.1"
 /begin AXIS_DESCR STD_AXIS tmst temp_ub_q0p75_o48 12 -48.00 143.3 FORMAT "%5.1" DEPOSIT ABSOLUTE /end AXIS_DESCR
 /begin AXIS_DESCR STD_AXIS nmot nmot_ub_q40 4 0.00 10200. FORMAT "%5.0" DEPOSIT ABSOLUTE /end AXIS_DESCR
/end CHARACTERISTIC
/begin CHARACTERISTIC KFWDKTHO "Sollwert Drosselklappenwinkel im Start - f (Hˆhe, Motorstarttemperatur)" MAP 0x1CA5BE KfAxUbAyUbSstxUbSstyUwWUw 100.0000 relDK_uw_b100 0.00 100.0000 FORMAT "%8.4"
 /begin AXIS_DESCR STD_AXIS tmst temp_ub_q0p75_o48 12 -48.00 143.3 FORMAT "%5.1" DEPOSIT ABSOLUTE /end AXIS_DESCR
 /begin AXIS_DESCR STD_AXIS fho fak_ub_b4 4 0.00 1023.984 FORMAT "%8.3" DEPOSIT ABSOLUTE /end AXIS_DESCR
/end CHARACTERISTIC
/begin CHARACTERISTIC KFZW "Z¸ndwinkelkennfeld" MAP 0x1C5A44 GkfWSb 191.3 zw_sb_q0p75 -96.00 95.25 FORMAT "%5.2"
 /begin AXIS_DESCR COM_AXIS nmot nmot_ub_q40 16 0.00 2621400. AXIS_PTS_REF SNM16ZUUW /end AXIS_DESCR
 /begin AXIS_DESCR COM_AXIS rl rel_ub_q0p75 12 0.00 49151.25 AXIS_PTS_REF SRL12ZUUW /end AXIS_DESCR
/end CHARACTERISTIC
/begin CHARACTERISTIC KFZW2 "Z¸ndwinkelkennfeld Variante 2" MAP 0x1C5B04 GkfWSb 191.3 zw_sb_q0p75 -96.00 95.25 FORMAT "%5.2"
 /begin AXIS_DESCR COM_AXIS nmot nmot_ub_q40 16 0.00 2621400. AXIS_PTS_REF SNM16ZUUW /end AXIS_DESCR
 /begin AXIS_DESCR COM_AXIS rl rel_ub_q0p75 12 0.00 49151.25 AXIS_PTS_REF SRL12ZUUW /end AXIS_DESCR
/end CHARACTERISTIC
/begin CHARACTERISTIC KFZWA "Z¸ndwinkelkorrektur durch Ansaugluft und Last" MAP 0x1C5BC4 GkfWSb 191.3 zw_sb_q0p75 -96.00 95.25 FORMAT "%5.2"
 /begin AXIS_DESCR COM_AXIS nmot nmot_ub_q40 16 0.00 2621400. AXIS_PTS_REF SNM16ZUUW /end AXIS_DESCR
 /begin AXIS_DESCR COM_AXIS rl rel_ub_q0p75 12 0.00 49151.25 AXIS_PTS_REF SRL12ZUUW /end AXIS_DESCR
/end CHARACTERISTIC
/begin CHARACTERISTIC KFZWA2 "Z¸ndwinkelkennfeld, Auslaﬂnockenwelle max. verstellt, Variante 2" MAP 0x1C5C84 GkfWSb 191.3 zw_sb_q0p75 -96.00 95.25 FORMAT "%5.2"
 /begin AXIS_DESCR COM_AXIS nmot nmot_ub_q40 16 0.00 2621400. AXIS_PTS_REF SNM16ZUUW /end AXIS_DESCR
 /begin AXIS_DESCR COM_AXIS rl rel_ub_q0p75 12 0.00 49151.25 AXIS_PTS_REF SRL12ZUUW /end AXIS_DESCR
/end CHARACTERISTIC
/begin CHARACTERISTIC KFZWMN "Min-Z¸ndwinkel" MAP 0x1C5D5C GkfWSb 191.3 zw_sb_q0p75 -96.00 95.25 FORMAT "%5.2"
 /begin AXIS_DESCR COM_AXIS nmot nmot_ub_q40 16 0.00 2621400. AXIS_PTS_REF SNM16ZUUW /end AXIS_DESCR
 /begin AXIS_DESCR COM_AXIS rl rel_ub_q0p75 12 0.00 49151.25 AXIS_PTS_REF SRL12ZUUW /end AXIS_DESCR
/end CHARACTERISTIC
/begin CHARACTERISTIC KFZWMNKH "Min-Z¸ndwinkel Katheizen" MAP 0x1C5EE5 KfAxUbAyUbSstxUbSstyUbWSb 191.3 zw_sb_q0p75 -96.00 95.25 FORMAT "%5.2"
 /begin AXIS_DESCR STD_AXIS nmot nmot_ub_q40 16 0.00 10200. FORMAT "%5.0" DEPOSIT ABSOLUTE /end AXIS_DESCR
 /begin AXIS_DESCR STD_AXIS rl rel_ub_q0p75 12 0.00 191.3 FORMAT "%5.1" DEPOSIT ABSOLUTE /end AXIS_DESCR
/end CHARACTERISTIC
/begin CHARACTERISTIC KFZWMNST "Min-Z¸ndwinkel f¸r Start und Nachstart" MAP 0x1C5FC3 KfAxUbAyUbSstxUbSstyUbWSb 191.3 zw_sb_q0p75 -96.00 95.25 FORMAT "%5.2"
 /begin AXIS_DESCR STD_AXIS nmot nmot_ub_q40 16 0.00 10200. FORMAT "%5.0" DEPOSIT ABSOLUTE /end AXIS_DESCR
 /begin AXIS_DESCR STD_AXIS rl rel_ub_q0p75 12 0.00 191.3 FORMAT "%5.1" DEPOSIT ABSOLUTE /end AXIS_DESCR
/end CHARACTERISTIC
/begin CHARACTERISTIC KFZWMS "Kennfeld mit dauerhaft sp‰test mˆglichem Z¸ndwinkel" MAP 0x1C5E1C GkfWSb 191.3 zw_sb_q0p75 -96.00 95.25 FORMAT "%5.2"
 /begin AXIS_DESCR COM_AXIS nmot nmot_ub_q40 16 0.00 2621400. AXIS_PTS_REF SNM16ZUUW /end AXIS_DESCR
 /begin AXIS_DESCR COM_AXIS rl rel_ub_q0p75 12 0.00 49151.25 AXIS_PTS_REF SRL12ZUUW /end AXIS_DESCR
/end CHARACTERISTIC
/begin CHARACTERISTIC KFZWSTTM "Z¸ndwinkel im Start" MAP 0x1C60AF KfAxUbAyUbSstxUbSstyUbWSb 191.3 zw_sb_q0p75 -96.00 95.25 FORMAT "%5.2"
 /begin AXIS_DESCR STD_AXIS nmot nmot_ub_q40 6 0.00 10200. FORMAT "%5.0" DEPOSIT ABSOLUTE /end AXIS_DESCR
 /begin AXIS_DESCR STD_AXIS tmst temp_ub_q0p75_o48 6 -48.00 143.3 FORMAT "%5.1" DEPOSIT ABSOLUTE /end AXIS_DESCR
/end CHARACTERISTIC
/begin CHARACTERISTIC KFZWWLNM "Delta Z¸ndwinkel im Warmlauf" MAP 0x1CE5A0 GkfWSb 191.3 zw_sb_q0p75 -96.00 95.25 FORMAT "%5.2"
 /begin AXIS_DESCR COM_AXIS nmot nmot_ub_q40 12 0.00 10200. AXIS_PTS_REF SNM12ESUB /end AXIS_DESCR
 /begin AXIS_DESCR COM_AXIS tans temp_ub_q0p75_o48 12 -48.00 143.3 AXIS_PTS_REF STA12WLUB /end AXIS_DESCR
/end CHARACTERISTIC
/begin CHARACTERISTIC KFZWWLRL "Delta Z¸ndwinkel im Warmlauf" MAP 0x1CE630 KfAxUbAyUbSstxUbSstyUbWSb 191.3 zw_sb_q0p75 -96.00 95.25 FORMAT "%5.2"
 /begin AXIS_DESCR STD_AXIS tmot temp_ub_q0p75_o48 8 -48.00 143.3 FORMAT "%5.1" DEPOSIT ABSOLUTE /end AXIS_DESCR
 /begin AXIS_DESCR STD_AXIS rl rel_ub_q0p75 6 0.00 191.3 FORMAT "%5.1" DEPOSIT ABSOLUTE /end AXIS_DESCR
/end CHARACTERISTIC
/begin CHARACTERISTIC KFZW_UM "Kennfeld f¸r optimalen Z¸ndwinkel in der Funktions¸berwachung" MAP 0x1C7D44 GkfWSb 191.3 zw_sb_q0p75 -96.00 95.25 FORMAT "%5.2"
 /begin AXIS_DESCR COM_AXIS rl_um rel_ub_q0p75 8 0.00 191.3 AXIS_PTS_REF RLV08_UM /end AXIS_DESCR
 /begin AXIS_DESCR COM_AXIS nmot_um nmot_ub_q40 8 0.00 10200. AXIS_PTS_REF NZWV08_UM /end AXIS_DESCR
/end CHARACTERISTIC
/begin CHARACTERISTIC KLETAZW_UM "ZW-Wirkungsgrad in Abh‰ngigkeit von delta ZW in der Funktions¸berwachung" CURVE 0x1C7D84 KlAUbSstUbWUb 127.5 rel_ub_b127p5 0.00 127.5 FORMAT "%5.1"
 /begin AXIS_DESCR STD_AXIS dzw_um zw_ub_q0p75 8 0.00 191.3 FORMAT "%5.1" DEPOSIT ABSOLUTE /end AXIS_DESCR
/end CHARACTERISTIC
/begin CHARACTERISTIC KLFZWMNKH "Abregelsteilheit der Brenngrenze im Nachstart bei Katheizen" CURVE 0x1CE518 KlAUbSstUbWUw 655.350000 zk10msxs_uw_b655 0.0100001526 655.360000 FORMAT "%10.6"
 /begin AXIS_DESCR STD_AXIS tmot temp_ub_q0p75_o48 6 -48.00 143.3 FORMAT "%5.1" DEPOSIT ABSOLUTE /end AXIS_DESCR
/end CHARACTERISTIC
/begin CHARACTERISTIC KLFZWMNST "Abregelsteilheit der Brenngrenze im Nachstart" CURVE 0x1CE52C KlAUbSstUbWUw 655.350000 zk10msxs_uw_b655 0.0100001526 655.360000 FORMAT "%10.6"
 /begin AXIS_DESCR STD_AXIS tmot temp_ub_q0p75_o48 6 -48.00 143.3 FORMAT "%5.1" DEPOSIT ABSOLUTE /end AXIS_DESCR
/end CHARACTERISTIC
/begin CHARACTERISTIC KLNPED_UM "pedalsollwertabh. Drehzahlbegrenzung in der DK-Antrieb-Ersatzfunktion, Fkts¸berw" CURVE 0x1C7E90 KlAUbSstUbWUb 10200. nmot_ub_q40 0.00 10200. FORMAT "%5.0"
 /begin AXIS_DESCR STD_AXIS spsn_um spg_ub_q0p019 8 0.00 4.980 FORMAT "%5.3" DEPOSIT ABSOLUTE /end AXIS_DESCR
/end CHARACTERISTIC
/begin CHARACTERISTIC KLWDKABST "Wichtung Sollwert Drosselklappenwinkel im Start" CURVE 0x1CA634 KlAUwSstUwWUw 1.999969 fak_uw_b2 0.00 1.999969 FORMAT "%8.6"
 /begin AXIS_DESCR STD_AXIS tabst_w t1sxs_uw_q1 4 0.00 65535.00 FORMAT "%8.2" DEPOSIT ABSOLUTE /end AXIS_DESCR
/end CHARACTERISTIC
/begin CHARACTERISTIC KLWDKPED "Offset Sollwert Drosselklappenwinkel im Start" CURVE 0x1C33E4 KlAUbSstUbWUb 100.0 relDK_ub_b100 0.00 100.0 FORMAT "%5.1"
 /begin AXIS_DESCR STD_AXIS wped relPED_ub_b100 3 0.00 100.0 FORMAT "%5.1" DEPOSIT ABSOLUTE /end AXIS_DESCR
/end CHARACTERISTIC
/begin CHARACTERISTIC KLWDKTAN "Wichtung der Drosselklappenposition im Start mit Ansauglufttemperatur" CURVE 0x1CA5A4 KlAUbSstUbWUb 7.969 fak_ub_b8 0.00 7.969 FORMAT "%5.3"
 /begin AXIS_DESCR STD_AXIS tans temp_ub_q0p75_o48 4 -48.00 143.3 FORMAT "%5.1" DEPOSIT ABSOLUTE /end AXIS_DESCR
/end CHARACTERISTIC
/begin CHARACTERISTIC KUMSRL_UM "Umrechnungskonstante von Massenstrom in relative Luftf¸llung in der ‹berwachung" VALUE 0x1C8190 KwUb 0.00199218750 kumsrl_ub_b0p002 0.00 0.00199218750 FORMAT "%13.11" /end CHARACTERISTIC
/begin AXIS_PTS MDV08_UM "St¸tzstellenverteilung f¸r Moment in der Funktions¸berwachung" 0x1C7E5C mz_um SstAUbSstUb 99.61 rel_ub_b99p6 8 0.00 99.61 FORMAT "%5.2" DEPOSIT ABSOLUTE /end AXIS_PTS
/begin CHARACTERISTIC MSK_Cod_Aggr "" VALUE 0x1C86D2 KwWU8 255.0 DEZ 0.00 255.0 FORMAT "%5.1" /end CHARACTERISTIC
/begin CHARACTERISTIC MSK_Cod_CANMembr "" VALUE 0x1C86D3 KwWU8 255.0 DEZ 0.00 255.0 FORMAT "%5.1" /end CHARACTERISTIC
/begin CHARACTERISTIC MSK_Cod_Diff_Ratio "" VALUE 0x1C86D4 KwWU8 255.0 DEZ 0.00 255.0 FORMAT "%5.1" /end CHARACTERISTIC
/begin CHARACTERISTIC MSK_Cod_Drvabl "" VALUE 0x1C86D5 KwWU8 255.0 DEZ 0.00 255.0 FORMAT "%5.1" /end CHARACTERISTIC
/begin CHARACTERISTIC MSK_Cod_Eng "" VALUE 0x1C86D6 KwWU8 255.0 DEZ 0.00 255.0 FORMAT "%5.1" /end CHARACTERISTIC
/begin CHARACTERISTIC MSK_Cod_EOL "" VALUE 0x1C86D7 KwWU8 255.0 DEZ 0.00 255.0 FORMAT "%5.1" /end CHARACTERISTIC
/begin CHARACTERISTIC MSK_Cod_Exh "" VALUE 0x1C86D8 KwWU8 255.0 DEZ 0.00 255.0 FORMAT "%5.1" /end CHARACTERISTIC
/begin CHARACTERISTIC MSK_Cod_Func "" VALUE 0x1C86D9 KwWU8 255.0 DEZ 0.00 255.0 FORMAT "%5.1" /end CHARACTERISTIC
/begin CHARACTERISTIC MSK_Cod_ModelRange "" VALUE 0x1C86DA KwWU8 255.0 DEZ 0.00 255.0 FORMAT "%5.1" /end CHARACTERISTIC
/begin CHARACTERISTIC MSK_Cod_Res1 "" VALUE 0x1C86DB KwWU8 255.0 DEZ 0.00 255.0 FORMAT "%5.1" /end CHARACTERISTIC
/begin CHARACTERISTIC MSK_Cod_Res2 "" VALUE 0x1C86DC KwWU8 255.0 DEZ 0.00 255.0 FORMAT "%5.1" /end CHARACTERISTIC
/begin CHARACTERISTIC MSK_Cod_Res3 "" VALUE 0x1C86DD KwWU8 255.0 DEZ 0.00 255.0 FORMAT "%5.1" /end CHARACTERISTIC
/begin CHARACTERISTIC MSK_Cod_Res4 "" VALUE 0x1C86DE KwWU8 255.0 DEZ 0.00 255.0 FORMAT "%5.1" /end CHARACTERISTIC
/begin CHARACTERISTIC MSK_Cod_Res5 "" VALUE 0x1C86DF KwWU8 255.0 DEZ 0.00 255.0 FORMAT "%5.1" /end CHARACTERISTIC
/begin CHARACTERISTIC MSK_Cod_Res6 "" VALUE 0x1C86E0 KwWU8 255.0 DEZ 0.00 255.0 FORMAT "%5.1" /end CHARACTERISTIC
/begin CHARACTERISTIC MSK_Cod_TM "" VALUE 0x1C86E1 KwWU8 255.0 DEZ 0.00 255.0 FORMAT "%5.1" /end CHARACTERISTIC
/begin CHARACTERISTIC MSK_Cod_Trans1 "" VALUE 0x1C86E2 KwWU8 255.0 DEZ 0.00 255.0 FORMAT "%5.1" /end CHARACTERISTIC
/begin CHARACTERISTIC MSK_Cod_Trans2 "" VALUE 0x1C86E3 KwWU8 255.0 DEZ 0.00 255.0 FORMAT "%5.1" /end CHARACTERISTIC
/begin CHARACTERISTIC MSK_Cod_WhlFront_Circumfer_Fctr "" VALUE 0x1C86E4 KwWU8 255.0 DEZ 0.00 255.0 FORMAT "%5.1" /end CHARACTERISTIC
/begin CHARACTERISTIC MSK_Cod_WhlRear_Circumfer_Fctr "" VALUE 0x1C86E5 KwWU8 255.0 DEZ 0.00 255.0 FORMAT "%5.1" /end CHARACTERISTIC
/begin CHARACTERISTIC MSRC_T_UM "Fehlerzeit f¸r MSR-Eingriff-‹berwachung der Funktions¸berwachung" VALUE 0x1C7D97 KwUb 10200.0 t40ms_ub_b10200 0.00 10200.0 FORMAT "%7.1" /end CHARACTERISTIC
/begin CHARACTERISTIC MVER_T_UM "Fehlerzeit beim Momentenvergleich in der Funktions¸berwachung" VALUE 0x1C7D98 KwUb 10200.0 t40ms_ub_b10200 0.00 10200.0 FORMAT "%7.1" /end CHARACTERISTIC
/begin CHARACTERISTIC MZFFIL_UM "Filter-Zeitkonstante f¸r verzˆgertes Moment in der Funktions¸berwachung" VALUE 0x1C7D99 KwUb 10159.4 zk40ms_ub_b10200 40.6299 10200.0 FORMAT "%7.1" /end CHARACTERISTIC
/begin CHARACTERISTIC MZFTV_UM "Verzugszeit f¸r zul‰ssiges Moment mz_um in der Funktions¸berwachg" VALUE 0x1C7D9A KwUb 280.000 t40ms_ub_b10200 40.0000 320.000 FORMAT "%7.3" /end CHARACTERISTIC
/begin CHARACTERISTIC NACHZUEND "Z¸ndungen im Nachlauf" VALUE 0x1C60AE KwWU8 255.0 dez 0.00 255.0 FORMAT "%5.1" /end CHARACTERISTIC
/begin CHARACTERISTIC NC_T_UM "Fehlertoleranzzeit f¸r Motordrehzahl¸berwachung f¸r Funktions¸berwachung" VALUE 0x1C7E68 KwUb 10200.0 t40ms_ub_b10200 0.00 10200.0 FORMAT "%7.1" /end CHARACTERISTIC
/begin CHARACTERISTIC NDIF_UM "erlaubte Differenz zwischen nmot und nz_um in der Funktions¸berwachung" VALUE 0x1C7E69 KwUb 10200. nmot_ub_q40 0.00 10200. FORMAT "%5.0" /end CHARACTERISTIC
/begin CHARACTERISTIC NMIN_UM "minimale Drehzahl f¸r Motordrehzahl¸berwachung der Funktions¸berwachung" VALUE 0x1C7E6A KwUb 10200. nmot_ub_q40 0.00 10200. FORMAT "%5.0" /end CHARACTERISTIC
/begin CHARACTERISTIC NMOT1_UM "Drehzahlschwelle 1 f¸r Nebenlastermittlung" VALUE 0x1C8191 KwUb 10200. nmot_ub_q40 0.00 10200. FORMAT "%5.0" /end CHARACTERISTIC
/begin CHARACTERISTIC NMOT2_UM "Drehzahlschwelle 2 f¸r Nebenlastermittlung" VALUE 0x1C8192 KwUb 10200. nmot_ub_q40 0.00 10200. FORMAT "%5.0" /end CHARACTERISTIC
/begin CHARACTERISTIC NMOT3_UM "Drehzahlschwelle 3 f¸r Nebenlasetermittlung" VALUE 0x1C8193 KwUb 10200. nmot_ub_q40 0.00 10200. FORMAT "%5.0" /end CHARACTERISTIC
/begin CHARACTERISTIC NMOT4_UM "Drehzahlschwelle 4 f¸r Nebenlastermittlung" VALUE 0x1C8194 KwUb 10200. nmot_ub_q40 0.00 10200. FORMAT "%5.0" /end CHARACTERISTIC
/begin CHARACTERISTIC NMOT5_UM "Drehzahlschwelle 5 f¸r Nebenlastermittlung" VALUE 0x1C8195 KwUb 10200. nmot_ub_q40 0.00 10200. FORMAT "%5.0" /end CHARACTERISTIC
/begin CHARACTERISTIC NMOT6_UM "Drehzahlschwelle 6 f¸r Nebenlastermittlung" VALUE 0x1C8196 KwUb 10200. nmot_ub_q40 0.00 10200. FORMAT "%5.0" /end CHARACTERISTIC
/begin AXIS_PTS NMV08_UM "St¸tzstellenverteilung f¸r Motordrehzahl in der Funktions¸berwachung" 0x1C7E6C nmot_um SstAUbSstUb 10200. nmot_ub_q40 8 0.00 10200. FORMAT "%5.0" DEPOSIT ABSOLUTE /end AXIS_PTS
/begin CHARACTERISTIC NRLIP_UM "Motordrehzahl-Schwelle f¸r den rl/rlip-Vergleich in der Funktions¸berwachg" VALUE 0x1C8197 KwUb 10200. nmot_ub_q40 0.00 10200. FORMAT "%5.0" /end CHARACTERISTIC
/begin CHARACTERISTIC NSC_T_UM "Nachstart¸berwachungszeit f¸r die Funktions¸berwachung" VALUE 0x1C7E8E KwUw 2621.400 t40msxs_uw_q0p04 0.00 2621.400 FORMAT "%8.3" /end CHARACTERISTIC
/begin CHARACTERISTIC NSEGMAX_UM "Maximaldrehzahl in der Funktions¸berwachung" VALUE 0x1C7E75 KwUb 10200. nmot_ub_q40 0.00 10200. FORMAT "%5.0" /end CHARACTERISTIC
/begin CHARACTERISTIC NSOF_T_UM "Entprellzeit f¸r Abschaltung der Nachstartaufweitung" VALUE 0x1C7E88 KwUb 10200.0 t40ms_ub_b10200 0.00 10200.0 FORMAT "%7.1" /end CHARACTERISTIC
/begin CHARACTERISTIC NWDKSST "Drehzahlschwelle Abschaltung Solldrosselklappenwinkel ohne Momentenstruktur" CURVE 0x1CA5B0 KlAUbSstUbWUb 10200. nmot_ub_q40 0.00 10200. FORMAT "%5.0"
 /begin AXIS_DESCR STD_AXIS tmst temp_ub_q0p75_o48 6 -48.00 143.3 FORMAT "%5.1" DEPOSIT ABSOLUTE /end AXIS_DESCR
/end CHARACTERISTIC
/begin CHARACTERISTIC NZMAX_UM "Maximale Drehzahl aus Zahnz‰hlerberechnung bei fehlendem Synchro in der FU" VALUE 0x1C8296 KwUb 10200.0 t40ms_ub_b10200 0.00 10200.0 FORMAT "%7.1" /end CHARACTERISTIC
/begin AXIS_PTS NZWV08_UM "" 0x1C7E78 nmot_um SstAUbSstUb 10200. nmot_ub_q40 8 0.00 10200. FORMAT "%5.0" DEPOSIT ABSOLUTE /end AXIS_PTS
/begin CHARACTERISTIC N_START_UM "Motordrehzahlschwelle f¸r Unterdrehzahl-Ausstieg f¸r die Fkt.-‹berwachung" VALUE 0x1C7E89 KwUb 10200. nmot_ub_q40 0.00 10200. FORMAT "%5.0" /end CHARACTERISTIC
/begin CHARACTERISTIC N_STEND_UM "Motordrehzahlschwelle f¸r Startende in der Fkt.-‹berwachung" VALUE 0x1C7E8A KwUb 10200. nmot_ub_q40 0.00 10200. FORMAT "%5.0" /end CHARACTERISTIC
/begin CHARACTERISTIC PHNMO "Drehzahlschwelle f¸r Umschaltung auf 1 Phasenflanke" VALUE 0x1C3C3A KwWU8 10200. nmot_ub_q40 0.00 10200. FORMAT "%5.0" /end CHARACTERISTIC
/begin CHARACTERISTIC PHNMU "Drehzahlschwelle f¸r Umschaltung auf 2 Phasenflanken" VALUE 0x1C3C3B KwWU8 10200. nmot_ub_q40 0.00 10200. FORMAT "%5.0" /end CHARACTERISTIC
/begin CHARACTERISTIC PRESCAL_UM "Prescaler f¸r Time-Base-Register in der Funktions¸berwachung" VALUE 0x1C7E84 KwUw 65535.00 dez 0.00 65535.00 FORMAT "%8.2" /end CHARACTERISTIC
/begin CHARACTERISTIC REAC_T1_UM "Fehlerzeit bei der Funktions-Fehlerreaktions¸berwachung in der Funktions¸berw." VALUE 0x1C7EA1 KwUb 10200.0 t40ms_ub_b10200 0.00 10200.0 FORMAT "%7.1" /end CHARACTERISTIC
/begin CHARACTERISTIC REAC_T2_UM "Fehlerzeit bei der Funktions¸berwachungs-Fehlerreaktions¸berwachung" VALUE 0x1C7EA2 KwUb 10200.0 t40ms_ub_b10200 0.00 10200.0 FORMAT "%7.1" /end CHARACTERISTIC
/begin CHARACTERISTIC RLC_T_UM "Fehlertoleranzzeit f¸r den rl-Vergleich mit der Funktion in der Funktions¸berw." VALUE 0x1C8198 KwUb 10200.0 t40ms_ub_b10200 0.00 10200.0 FORMAT "%7.1" /end CHARACTERISTIC
/begin CHARACTERISTIC RLDFIL_UM "Filterzeitkonstanate f¸r verzˆgerte Lastinformation rldf_um" VALUE 0x1C8199 KwUb 10159.4 zk40ms_ub_b10200 40.6299 10200.0 FORMAT "%7.1" /end CHARACTERISTIC
/begin CHARACTERISTIC RLDPFIL_UM "Filterzeitkonstante f¸r verzˆgerte Lastinfo rldp_um in der Funktions¸berwachung" VALUE 0x1C819A KwUb 10159.4 zk40ms_ub_b10200 40.6299 10200.0 FORMAT "%7.1" /end CHARACTERISTIC
/begin CHARACTERISTIC RLDPTV_UM "Verzugszeit f¸r Lastinformation rldp_um in der Funktions¸berwachung" VALUE 0x1C819B KwUb 320.000 t40ms_ub_b10200 0.00 320.000 FORMAT "%7.3" /end CHARACTERISTIC
/begin CHARACTERISTIC RLDTV_UM "Verzugszeit f¸r Lastinformation rldf_um" VALUE 0x1C819C KwUb 320.000 t40ms_ub_b10200 0.00 320.000 FORMAT "%7.3" /end CHARACTERISTIC
/begin CHARACTERISTIC RLIP_T_UM "Fehlertoleranzzeit f¸r den rl/rlip-Vergleich in der Funktions¸berwachg" VALUE 0x1C819D KwUb 10200.0 t40ms_ub_b10200 0.00 10200.0 FORMAT "%7.1" /end CHARACTERISTIC
/begin AXIS_PTS RLV08_UM "Stutzstellenverteilung f¸r Lastinfo in der Funktions¸berwachung" 0x1C81A0 rl_um SstAUbSstUb 191.3 rel_ub_q0p75 8 0.00 191.3 FORMAT "%5.1" DEPOSIT ABSOLUTE /end AXIS_PTS
/begin CHARACTERISTIC RLVT_BO_UM "Offset f¸r obere Toleranzgerade VVT" VALUE 0x1C81A9 KwUb 191.3 rel_ub_q0p75 0.00 191.3 FORMAT "%5.1" /end CHARACTERISTIC
/begin CHARACTERISTIC RLVT_MO_UM "Steigung f¸r obere Toleranzgerade VVT" VALUE 0x1C81AA KwUb 255.0 dez 0.00 255.0 FORMAT "%5.1" /end CHARACTERISTIC
/begin CHARACTERISTIC RL_BO_UM "Offset f¸r Toleranzgerade f(rl_um) f¸r rlipf_um in der Funktions¸berwachung" VALUE 0x1C81AB KwUb 191.3 rel_ub_q0p75 0.00 191.3 FORMAT "%5.1" /end CHARACTERISTIC
/begin CHARACTERISTIC RL_MO_UM "Steigung f¸r Toleranzgerade f(rl_um) f¸r rlipf_um in der Funktions¸berwachung" VALUE 0x1C81AC KwUb 255.0 dez 0.00 255.0 FORMAT "%5.1" /end CHARACTERISTIC
/begin CHARACTERISTIC ROMRSTA_UM "maximale Anzahl Resets bei Fehlererkennung im ROM-Check in der Initialisierung" VALUE 0x1C8294 KwUb 255.0 dez 0.00 255.0 FORMAT "%5.1" /end CHARACTERISTIC
/begin CHARACTERISTIC SGSC_T_UM "Fehlerzeit f¸r SGS-Eingriff-‹berwachung der Funktions¸berwachung" VALUE 0x1C81AE KwUb 10200.0 t40ms_ub_b10200 0.00 10200.0 FORMAT "%7.1" /end CHARACTERISTIC
/begin CHARACTERISTIC SKA_DRHZ_UM "" VALUE 0x1C7EA3 KwUb 10200. nmot_ub_q40 0.00 10200. FORMAT "%5.0" /end CHARACTERISTIC
/begin AXIS_PTS SNM04ZUUW "St¸tzstellenverteilung Drehzahl" 0x1C60A2 nmot_w SstAUwSstUw 16383.75 nmot_uw_q0p25 4 0.00 16383.75 FORMAT "%8.2" DEPOSIT ABSOLUTE /end AXIS_PTS
/begin AXIS_PTS SNM06NWUW "Drehzahl St¸tzstellenverteilung f¸r NW-Regler Einlaﬂ" 0x1CB8CA nmot_w SstAUwSstUw 16383.75 nmot_uw_q0p25 6 0.00 16383.75 FORMAT "%8.2" DEPOSIT ABSOLUTE /end AXIS_PTS
/begin AXIS_PTS SNM08__UB "St¸tzstellenverteilung Drehzahl, 8 Sst." 0x1C6788 nmot SstAUbSstUb 10200. nmot_ub_q40 8 0.00 10200. FORMAT "%5.0" DEPOSIT ABSOLUTE /end AXIS_PTS
/begin AXIS_PTS SNM12ESUB "SST-Verteilung f¸r die Motordrehzahl nmot" 0x1C67A0 nmot SstAUbSstUb 10200. nmot_ub_q40 12 0.00 10200. FORMAT "%5.0" DEPOSIT ABSOLUTE /end AXIS_PTS
/begin AXIS_PTS SNM16ZUUW "St¸tzstellenverteilung Drehzahl, 16 Sst." 0x1C6904 nmot SstAUwSstUw 2621400. nmot_ub_q40 16 0.00 2621400. FORMAT "%8.0" DEPOSIT ABSOLUTE /end AXIS_PTS
/begin AXIS_PTS SNS04ZUSB "St¸tzstellenverteilung Drehzahlgradient" 0x1C5EDC dns SstAUbSstSb 2550. nmotd_sb_q10 4 -1280. 1270. FORMAT "%5.0" DEPOSIT ABSOLUTE /end AXIS_PTS
/begin CHARACTERISTIC SP12LL_UM "maximale Differenz zwischen SP1S und SP2S unterhalb der Vollgas-Schwelle" VALUE 0x1C81B0 KwUb 4.980 spg_ub_q0p019 0.00 4.980 FORMAT "%5.3" /end CHARACTERISTIC
/begin CHARACTERISTIC SP12VG_UM "maximale Differenz zwischen SP1S und SP2S oberhalb der Vollgas-Schwelle" VALUE 0x1C81B1 KwUb 4.980 spg_ub_q0p019 0.00 4.980 FORMAT "%5.3" /end CHARACTERISTIC
/begin CHARACTERISTIC SPSC_MINUM "= SPSC_MIN_UM Pedal-Leergas-Grenze f¸r die Funktions¸berwachung" VALUE 0x1C81B2 KwUb 4.980 spg_ub_q0p019 0.00 4.980 FORMAT "%5.3" /end CHARACTERISTIC
/begin CHARACTERISTIC SPSC_T_UM "Fehlerzeit bei zueinander unplausiblen Sollwerten in der Funktions¸berwachung" VALUE 0x1C81B3 KwUb 10200.0 t40ms_ub_b10200 0.00 10200.0 FORMAT "%7.1" /end CHARACTERISTIC
/begin AXIS_PTS SPSNV08_UM "St¸tzstellenverteilung f¸r Pedalwert in der Funktions¸berwachung" 0x1C81B4 spsn_um SstAUbSstUb 4.980 spg_ub_q0p019 8 0.00 4.980 FORMAT "%5.3" DEPOSIT ABSOLUTE /end AXIS_PTS
/begin CHARACTERISTIC SPSVG_UM "Vollgas-Sollwert-Schwelle zur Umschaltung der maximalen Differenz SP1S-SP2S" VALUE 0x1C81BD KwUb 4.980 spg_ub_q0p019 0.00 4.980 FORMAT "%5.3" /end CHARACTERISTIC
/begin AXIS_PTS SRL06ESUB "Sst-Verteilung f¸r die relative F¸llung rl" 0x1C67F8 rl SstAUbSstUb 191.3 rel_ub_q0p75 6 0.00 191.3 FORMAT "%5.1" DEPOSIT ABSOLUTE /end AXIS_PTS
/begin AXIS_PTS SRL12ZUUW "St¸tzstellenverteilung relative Luftf¸llung, 12 St." 0x1C6938 rl SstAUwSstUw 49151.25 rel_ub_q0p75 12 0.00 49151.25 FORMAT "%8.2" DEPOSIT ABSOLUTE /end AXIS_PTS
/begin AXIS_PTS STA12WLUB "SST-Verteilung f¸r die Ansauglufttemperatur" 0x1C6864 tans SstAUbSstUb 191.3 temp_ub_q0p75_o48 12 -48.00 143.3 FORMAT "%5.1" DEPOSIT ABSOLUTE /end AXIS_PTS
/begin AXIS_PTS STM05EPMSB "St¸tzstellenverteilung f¸r WNWKM* / NW Korrektur ¸ber tmot" 0x1CB968 tmot SstAUbSstUb 191.3 temp_ub_q0p75_o48 5 -48.00 143.3 FORMAT "%5.1" DEPOSIT ABSOLUTE /end AXIS_PTS
/begin AXIS_PTS STM06__UB "St¸tzstellenverteilung Motortemperatur, 6 Sst." 0x1CEE90 tmot SstAUbSstUb 191.3 temp_ub_q0p75_o48 6 -48.00 143.3 FORMAT "%5.1" DEPOSIT ABSOLUTE /end AXIS_PTS
/begin AXIS_PTS STO06NWUW "Gruppenst¸tzstellen" 0x1CB958 toelk_w SstAUwSstUw 1535.977 temp_q0p0234_o273 6 -273.1500 1262.827 FORMAT "%8.3" DEPOSIT ABSOLUTE /end AXIS_PTS
/begin CHARACTERISTIC TANSMN_UM "Ansauglufttemperaturschwelle zur Nachstartaufweitung in der Fkt.-‹berwachung" VALUE 0x1C7E8B KwUb 191.3 temp_ub_q0p75_o48 -48.00 143.3 FORMAT "%5.1" /end CHARACTERISTIC
/begin CHARACTERISTIC TANWFRA " Tastverh‰ltnis f¸r Sp‰tverstellung Auslassnockenwelle" VALUE 0x1C3C7C KwUw 99.99847 rel_uw_b100 0.00 99.99847 FORMAT "%8.5" /end CHARACTERISTIC
/begin CHARACTERISTIC TANWFRE "Tastverh‰ltnis f¸r Fr¸hverstellung Einlassnockenwelle" VALUE 0x1C3CB4 KwUw 99.99847 rel_uw_b100 0.00 99.99847 FORMAT "%8.5" /end CHARACTERISTIC
/begin CHARACTERISTIC TANWMNLIA "Minimales TV langsamer I-Anteil NW-Regler (Auslass)" VALUE 0x1C3C7E KwSw 200.0000 rel_sw_b200 -100.0000 100.0000 FORMAT "%8.4" /end CHARACTERISTIC
/begin CHARACTERISTIC TANWMNLIE "Minimales TV langsamer I-Anteil NW-Regler (Einlass)" VALUE 0x1C3CB6 KwSw 200.0000 rel_sw_b200 -100.0000 100.0000 FORMAT "%8.4" /end CHARACTERISTIC
/begin CHARACTERISTIC TANWMNSIA "MMinimales TV schneller I-Anteil NW-Regler (Auslass)" VALUE 0x1C3C80 KwSw 399.9939 rel_sw_b200 -200.0000 199.9939 FORMAT "%8.4" /end CHARACTERISTIC
/begin CHARACTERISTIC TANWMNSIE "MMinimales TV schneller I-Anteil NW-Regler (Einlass)" VALUE 0x1C3CB8 KwSw 399.9939 rel_sw_b200 -200.0000 199.9939 FORMAT "%8.4" /end CHARACTERISTIC
/begin CHARACTERISTIC TANWMXLIA "Maximales TV langsamer I-Anteil NW-Regler (Auslass)" VALUE 0x1C3C82 KwSw 200.0000 rel_sw_b200 -100.0000 100.0000 FORMAT "%8.4" /end CHARACTERISTIC
/begin CHARACTERISTIC TANWMXLIE "Maximales TV langsamer I-Anteil NW-Regler (Einlass)" VALUE 0x1C3CBA KwSw 200.0000 rel_sw_b200 -100.0000 100.0000 FORMAT "%8.4" /end CHARACTERISTIC
/begin CHARACTERISTIC TANWMXSIA "Maximales TV schneller I-Anteil NW-Regler (Auslass)" VALUE 0x1C3C84 KwSw 399.9939 rel_sw_b200 -200.0000 199.9939 FORMAT "%8.4" /end CHARACTERISTIC
/begin CHARACTERISTIC TANWMXSIE "Maximales TV schneller I-Anteil NW-Regler (Einlass)" VALUE 0x1C3CBC KwSw 399.9939 rel_sw_b200 -200.0000 199.9939 FORMAT "%8.4" /end CHARACTERISTIC
/begin CHARACTERISTIC TANWRMAXA "Maximales Tastverh‰ltnis NW-Regler Auslass" VALUE 0x1C3C86 KwUw 99.99847 rel_uw_b100 0.00 99.99847 FORMAT "%8.5" /end CHARACTERISTIC
/begin CHARACTERISTIC TANWRMAXE "Maximales Tastverh‰ltnis NW-Regler Einlass" VALUE 0x1C3CBE KwUw 99.99847 rel_uw_b100 0.00 99.99847 FORMAT "%8.5" /end CHARACTERISTIC
/begin CHARACTERISTIC TANWRMINA "Minimales Tastverh‰ltnis NW-Regler Auslass" VALUE 0x1C3C88 KwUw 99.99847 rel_uw_b100 0.00 99.99847 FORMAT "%8.5" /end CHARACTERISTIC
/begin CHARACTERISTIC TANWRMINE "Minimales Tastverh‰ltnis NW-Regler Einlass" VALUE 0x1C3CC0 KwUw 99.99847 rel_uw_b100 0.00 99.99847 FORMAT "%8.5" /end CHARACTERISTIC
/begin CHARACTERISTIC TANWSPA " Tastverh‰ltnis f¸r Fr¸hverstellung Auslassnockenwelle" VALUE 0x1C3C8A KwUw 99.99847 rel_uw_b100 0.00 99.99847 FORMAT "%8.5" /end CHARACTERISTIC
/begin CHARACTERISTIC TANWSPE "Tastverh‰ltnis f¸r Sp‰tverstellung Einlassnockenwelle" VALUE 0x1C3CC2 KwUw 99.99847 rel_uw_b100 0.00 99.99847 FORMAT "%8.5" /end CHARACTERISTIC
/begin CHARACTERISTIC TBASTPU_UM "" VALUE 0x1C829C KwUw 65535.00 tns_q1 0.00 65535.00 FORMAT "%8.2" /end CHARACTERISTIC
/begin CHARACTERISTIC TDIFMX_UM "Maximale Abweichung der Summe von Zeitdifferenzen zw. TPU u. CPU in der FU" VALUE 0x1C829E KwUw 26.21400 txms_uw_q0p0004 0.00 26.21400 FORMAT "%8.5" /end CHARACTERISTIC
/begin CHARACTERISTIC TFWDKSOM "Zeitkonstante f¸r Drosselklappensollwinkelfilterung bei Kl15 aus" VALUE 0x1CA646 KwUw 655.350000 zk10msxs_uw_b655 0.0100001526 655.360000 FORMAT "%10.6" /end CHARACTERISTIC
/begin CHARACTERISTIC TMNSMN_UM "Motortemperaturschwelle f¸r die Nachstartaufweitung in der FKT.-‹berwachung" VALUE 0x1C7E8C KwUb 191.3 temp_ub_q0p75_o48 -48.00 143.3 FORMAT "%5.1" /end CHARACTERISTIC
/begin CHARACTERISTIC TMZIZWV "Motortemperaturschwelle zum Freigeben der Zylinder-individuellen ZW-Verstellung" VALUE 0x1C5D44 KwUb 191.3 temp_ub_q0p75_o48 -48.00 143.3 FORMAT "%5.1" /end CHARACTERISTIC
/begin CHARACTERISTIC TPUCA_T_UM "Zeitlicher Abstand der zyklischen Aktivierung der TPU-Pr¸fung in der FU" VALUE 0x1C8297 KwUb 2550.00 t10ms_ub_b2550 0.00 2550.00 /end CHARACTERISTIC
/begin CHARACTERISTIC TPUCR_T_UM "Fehlerzeit des TPU-Code-RAM-Tests in der Funktions¸berwachung" VALUE 0x1C8298 KwUb 255.0 dez 0.00 255.0 FORMAT "%5.1" /end CHARACTERISTIC
/begin CHARACTERISTIC TPURA_T_UM "Zeitlicher Abstand der zyklischen Aktivierung des TPU-Code-RAM-Tests in der FU" VALUE 0x1C8299 KwUb 2550.00 t10ms_ub_b2550 0.00 2550.00 /end CHARACTERISTIC
/begin CHARACTERISTIC TPURSTA_UM "Maximale Anzahl von Resets aus der TPU-‹berwachung" VALUE 0x1C829A KwUb 255.0 dez 0.00 255.0 FORMAT "%5.1" /end CHARACTERISTIC
/begin CHARACTERISTIC TPU_T_UM "Fehlerzeit der TPU-‹berwachung in der Funktions¸berwachung" VALUE 0x1C829B KwUb 255.0 dez 0.00 255.0 FORMAT "%5.1" /end CHARACTERISTIC
/begin CHARACTERISTIC TSEGMIN_UM "Minimale Segmentzeit in der Drehzahlberechnung mit Segmentzeiten in der FU" VALUE 0x1C7E86 KwUw 26.21400 txms_uw_q0p0004 0.00 26.21400 FORMAT "%8.5" /end CHARACTERISTIC
/begin CHARACTERISTIC TSWKR "Totzeit f¸r Summen-ZW-Sp‰tverstellabfrage" VALUE 0x1C5D45 KwUb 25.50 t100msxs_ub_b25p5 0.00 25.50 FORMAT "%5.2" /end CHARACTERISTIC
/begin CHARACTERISTIC TTANWLIA "Zeitkonstane langsamer I-Anteil Nockenwellenregler(Auslaﬂ)" VALUE 0x1C3C8C KwUw 655.350000 zk10msxs_uw_b655 0.0100001526 655.360000 FORMAT "%10.6" /end CHARACTERISTIC
/begin CHARACTERISTIC TTANWLIE "Zeitkonstane langsamer I-Anteil Nockenwellenregler(Einlaﬂ)" VALUE 0x1C3CC4 KwUw 655.350000 zk10msxs_uw_b655 0.0100001526 655.360000 FORMAT "%10.6" /end CHARACTERISTIC
/begin CHARACTERISTIC TTANWLIGA "Zeitkonstane langsamer I-Anteil Nockenwellenregler(Auslaﬂ,groﬂer Nocken)" VALUE 0x1C3C8E KwUw 655.350000 zk10msxs_uw_b655 0.0100001526 655.360000 FORMAT "%10.6" /end CHARACTERISTIC
/begin CHARACTERISTIC TTANWLIGE "Zeitkonstane langsamer I-Anteil Nockenwellenregler(Einlaﬂ,groﬂer Nocken)" VALUE 0x1C3CC6 KwUw 655.350000 zk10msxs_uw_b655 0.0100001526 655.360000 FORMAT "%10.6" /end CHARACTERISTIC
/begin CHARACTERISTIC TTIPINEN "Zeit bis zur Abfrage auf Kraftschluﬂ bei Drehzahldynamik" VALUE 0x1C5EE1 KwUb 2.550 t10msxs_ub_b2p55 0.00 2.550 FORMAT "%5.3" /end CHARACTERISTIC
/begin CHARACTERISTIC TTIPINON "Einschaltzeit Tip-In Offset auf sp‰testen Z¸ndwinkel" VALUE 0x1C5EE2 KwUb 12.75 t50msxs_ub_b12p75 0.00 12.75 FORMAT "%5.2" /end CHARACTERISTIC
/begin CHARACTERISTIC TVZWMSA "Zeit bis zum ‹bergehen auf Dauersp‰tbegrenzung" VALUE 0x1C5EE3 KwUb 2.550 t10msxs_ub_b2p55 0.00 2.550 FORMAT "%5.3" /end CHARACTERISTIC
/begin CHARACTERISTIC TVZWMSE "Zeit bis zum ‹bergehen auf Dynamiksp‰tbegrenzung" VALUE 0x1C5EE4 KwUb 2.550 t10msxs_ub_b2p55 0.00 2.550 FORMAT "%5.3" /end CHARACTERISTIC
/begin CHARACTERISTIC TWDKRED "Wichtung Zeitkonstante f¸r Drosselklappensollwinkelfilterung im Start" VALUE 0x1C33EC KwUw 655.350000 zk10msxs_uw_b655 0.0100001526 655.360000 FORMAT "%10.6" /end CHARACTERISTIC
/begin CHARACTERISTIC TWDKSNST "Zeitkonstante f¸r Drosselklappensollwinkelfilterung im Start" CURVE 0x1CA648 KlAUbSstUbWUw 655.3400 t10msxs_uw_b655p35 0.01000000 655.3500 FORMAT "%8.4"
 /begin AXIS_DESCR STD_AXIS tmst temp_ub_q0p75_o48 6 -48.00 143.3 FORMAT "%5.1" DEPOSIT ABSOLUTE /end AXIS_DESCR
/end CHARACTERISTIC
/begin CHARACTERISTIC VB_Cod_Aggr "" VALUE 0x1C86E6 KwWU8 255.0 DEZ 0.00 255.0 FORMAT "%5.1" /end CHARACTERISTIC
/begin CHARACTERISTIC VB_Cod_CANMembr "" VALUE 0x1C86E7 KwWU8 255.0 DEZ 0.00 255.0 FORMAT "%5.1" /end CHARACTERISTIC
/begin CHARACTERISTIC VB_Cod_Diff_Ratio "" VALUE 0x1C86E8 KwWU8 255.0 DEZ 0.00 255.0 FORMAT "%5.1" /end CHARACTERISTIC
/begin CHARACTERISTIC VB_Cod_Drvabl "" VALUE 0x1C86E9 KwWU8 255.0 DEZ 0.00 255.0 FORMAT "%5.1" /end CHARACTERISTIC
/begin CHARACTERISTIC VB_Cod_Eng "" VALUE 0x1C86EA KwWU8 255.0 DEZ 0.00 255.0 FORMAT "%5.1" /end CHARACTERISTIC
/begin CHARACTERISTIC VB_Cod_EOL "" VALUE 0x1C86EB KwWU8 255.0 DEZ 0.00 255.0 FORMAT "%5.1" /end CHARACTERISTIC
/begin CHARACTERISTIC VB_Cod_Exh "" VALUE 0x1C86EC KwWU8 255.0 DEZ 0.00 255.0 FORMAT "%5.1" /end CHARACTERISTIC
/begin CHARACTERISTIC VB_Cod_Func "" VALUE 0x1C86ED KwWU8 255.0 DEZ 0.00 255.0 FORMAT "%5.1" /end CHARACTERISTIC
/begin CHARACTERISTIC VB_Cod_ModelRange "" VALUE 0x1C86EE KwWU8 255.0 DEZ 0.00 255.0 FORMAT "%5.1" /end CHARACTERISTIC
/begin CHARACTERISTIC VB_Cod_Res1 "" VALUE 0x1C86EF KwWU8 255.0 DEZ 0.00 255.0 FORMAT "%5.1" /end CHARACTERISTIC
/begin CHARACTERISTIC VB_Cod_Res2 "" VALUE 0x1C86F0 KwWU8 255.0 DEZ 0.00 255.0 FORMAT "%5.1" /end CHARACTERISTIC
/begin CHARACTERISTIC VB_Cod_Res3 "" VALUE 0x1C86F1 KwWU8 255.0 DEZ 0.00 255.0 FORMAT "%5.1" /end CHARACTERISTIC
/begin CHARACTERISTIC VB_Cod_Res4 "" VALUE 0x1C86F2 KwWU8 255.0 DEZ 0.00 255.0 FORMAT "%5.1" /end CHARACTERISTIC
/begin CHARACTERISTIC VB_Cod_Res5 "" VALUE 0x1C86F3 KwWU8 255.0 DEZ 0.00 255.0 FORMAT "%5.1" /end CHARACTERISTIC
/begin CHARACTERISTIC VB_Cod_Res6 "" VALUE 0x1C86F4 KwWU8 255.0 DEZ 0.00 255.0 FORMAT "%5.1" /end CHARACTERISTIC
/begin CHARACTERISTIC VB_Cod_TM "" VALUE 0x1C86F5 KwWU8 255.0 DEZ 0.00 255.0 FORMAT "%5.1" /end CHARACTERISTIC
/begin CHARACTERISTIC VB_Cod_Trans1 "" VALUE 0x1C86F6 KwWU8 255.0 DEZ 0.00 255.0 FORMAT "%5.1" /end CHARACTERISTIC
/begin CHARACTERISTIC VB_Cod_Trans2 "" VALUE 0x1C86F7 KwWU8 255.0 DEZ 0.00 255.0 FORMAT "%5.1" /end CHARACTERISTIC
/begin CHARACTERISTIC VB_Cod_WhlFront_Circumfer_Fctr "" VALUE 0x1C86F8 KwWU8 255.0 DEZ 0.00 255.0 FORMAT "%5.1" /end CHARACTERISTIC
/begin CHARACTERISTIC VB_Cod_WhlRear_Circumfer_Fctr "" VALUE 0x1C86F9 KwWU8 255.0 DEZ 0.00 255.0 FORMAT "%5.1" /end CHARACTERISTIC
/begin CHARACTERISTIC VVT_T_UM "Fehlertoleranzzeit f¸r unplausible VVT-Info f.d. Funktions¸berwachung" VALUE 0x1C81AD KwUb 10200.0 t40ms_ub_b10200 0.00 10200.0 FORMAT "%7.1" /end CHARACTERISTIC
/begin CHARACTERISTIC VZIZWV "VFZG-Schwelle zum Sperren der Zylinder-individuellen ZW-Verstellung" VALUE 0x1C5D46 KwUb 318.8 vfzg_ub_q1p25 0.00 318.8 FORMAT "%5.1" /end CHARACTERISTIC
/begin CHARACTERISTIC watch_acmode "" VALUE 0x1CBB8E KwSw 65535.00 dez -32768.00 32767.00 FORMAT "%8.2" /end CHARACTERISTIC
/begin CHARACTERISTIC watch_addr0_h "" VALUE 0x1CBB7C KwUw 65535.00 dez 0.00 65535.00 FORMAT "%8.2" /end CHARACTERISTIC
/begin CHARACTERISTIC watch_addr0_l "" VALUE 0x1CBB7E KwUw 65535.00 dez 0.00 65535.00 FORMAT "%8.2" /end CHARACTERISTIC
/begin CHARACTERISTIC watch_addr1_h "" VALUE 0x1CBB80 KwUw 65535.00 dez 0.00 65535.00 FORMAT "%8.2" /end CHARACTERISTIC
/begin CHARACTERISTIC watch_addr1_l "" VALUE 0x1CBB82 KwUw 65535.00 dez 0.00 65535.00 FORMAT "%8.2" /end CHARACTERISTIC
/begin CHARACTERISTIC watch_addr2_h "" VALUE 0x1CBB84 KwUw 65535.00 dez 0.00 65535.00 FORMAT "%8.2" /end CHARACTERISTIC
/begin CHARACTERISTIC watch_addr2_l "" VALUE 0x1CBB86 KwUw 65535.00 dez 0.00 65535.00 FORMAT "%8.2" /end CHARACTERISTIC
/begin CHARACTERISTIC watch_addr3_h "" VALUE 0x1CBB88 KwUw 65535.00 dez 0.00 65535.00 FORMAT "%8.2" /end CHARACTERISTIC
/begin CHARACTERISTIC watch_addr3_l "" VALUE 0x1CBB8A KwUw 65535.00 dez 0.00 65535.00 FORMAT "%8.2" /end CHARACTERISTIC
/begin CHARACTERISTIC watch_addr4_h "" VALUE 0x1CBB90 KwUw 65535.00 dez 0.00 65535.00 FORMAT "%8.2" /end CHARACTERISTIC
/begin CHARACTERISTIC watch_addr4_l "" VALUE 0x1CBB92 KwUw 65535.00 dez 0.00 65535.00 FORMAT "%8.2" /end CHARACTERISTIC
/begin CHARACTERISTIC watch_addr5_h "" VALUE 0x1CBB94 KwUw 65535.00 dez 0.00 65535.00 FORMAT "%8.2" /end CHARACTERISTIC
/begin CHARACTERISTIC watch_addr5_l "" VALUE 0x1CBB96 KwUw 65535.00 dez 0.00 65535.00 FORMAT "%8.2" /end CHARACTERISTIC
/begin CHARACTERISTIC watch_cmode4 "" VALUE 0x1CBB98 KwSw 65535.00 dez -32768.00 32767.00 FORMAT "%8.2" /end CHARACTERISTIC
/begin CHARACTERISTIC watch_cmode5 "" VALUE 0x1CBB9A KwSw 65535.00 dez -32768.00 32767.00 FORMAT "%8.2" /end CHARACTERISTIC
/begin CHARACTERISTIC watch_dcmode "" VALUE 0x1CBB9C KwSw 65535.00 dez -32768.00 32767.00 FORMAT "%8.2" /end CHARACTERISTIC
/begin CHARACTERISTIC watch_mode "" VALUE 0x1CBB8C KwSb 255.0 dez -128.0 127.0 FORMAT "%5.1" /end CHARACTERISTIC
/begin CHARACTERISTIC watch_newdata "" VALUE 0x1CBB7A KwSb 255.0 dez -128.0 127.0 FORMAT "%5.1" /end CHARACTERISTIC
/begin CHARACTERISTIC watch_on "" VALUE 0x1CBB7B KwSb 255.0 dez -128.0 127.0 FORMAT "%5.1" /end CHARACTERISTIC
/begin CHARACTERISTIC watch_rw4 "" VALUE 0x1CBB9E KwSw 65535.00 dez -32768.00 32767.00 FORMAT "%8.2" /end CHARACTERISTIC
/begin CHARACTERISTIC watch_rw5 "" VALUE 0x1CBBA0 KwSw 65535.00 dez -32768.00 32767.00 FORMAT "%8.2" /end CHARACTERISTIC
/begin CHARACTERISTIC watch_sign4 "" VALUE 0x1CBBA2 KwSw 65535.00 dez -32768.00 32767.00 FORMAT "%8.2" /end CHARACTERISTIC
/begin CHARACTERISTIC watch_sign5 "" VALUE 0x1CBBA4 KwSw 65535.00 dez -32768.00 32767.00 FORMAT "%8.2" /end CHARACTERISTIC
/begin CHARACTERISTIC watch_size_bits4 "" VALUE 0x1CBBA6 KwSw 65535.00 dez -32768.00 32767.00 FORMAT "%8.2" /end CHARACTERISTIC
/begin CHARACTERISTIC watch_size_bits5 "" VALUE 0x1CBBA8 KwSw 65535.00 dez -32768.00 32767.00 FORMAT "%8.2" /end CHARACTERISTIC
/begin CHARACTERISTIC watch_value4_h "" VALUE 0x1CBBAA KwUw 65535.00 dez 0.00 65535.00 FORMAT "%8.2" /end CHARACTERISTIC
/begin CHARACTERISTIC watch_value4_l "" VALUE 0x1CBBAC KwUw 65535.00 dez 0.00 65535.00 FORMAT "%8.2" /end CHARACTERISTIC
/begin CHARACTERISTIC watch_value5_h "" VALUE 0x1CBBAE KwUw 65535.00 dez 0.00 65535.00 FORMAT "%8.2" /end CHARACTERISTIC
/begin CHARACTERISTIC watch_value5_l "" VALUE 0x1CBBB0 KwUw 65535.00 dez 0.00 65535.00 FORMAT "%8.2" /end CHARACTERISTIC
/begin CHARACTERISTIC WDKSNLN "Sollwinkel f¸r Drosselklappe bei Kl15 aus" CURVE 0x1CA65C KlAUbSstUbWUb 100.0 relDK_ub_b100 0.00 100.0 FORMAT "%5.1"
 /begin AXIS_DESCR STD_AXIS nmot nmot_ub_q40 8 0.00 10200. FORMAT "%5.0" DEPOSIT ABSOLUTE /end AXIS_DESCR
/end CHARACTERISTIC
/begin CHARACTERISTIC WNWAFMX "Begrenzung Adaption Sp‰tanschlag nach 'fr¸h'" VALUE 0x1C3C3C KwWS8 128.0 kw_q1 -128.0 0.00 FORMAT "%5.1" /end CHARACTERISTIC
/begin CHARACTERISTIC WNWASMX "Obere Begrenzung Adaption NW-Sp‰tanschlag (Richtung sp‰t)" VALUE 0x1C3C3D KwWS8 127.0 kw_q1 0.00 127.0 FORMAT "%5.1" /end CHARACTERISTIC
/begin CHARACTERISTIC WNWKMA "Korrekturwinkel Nockenwelle ¸ber Motortemperatur f¸r Auslass Bank 1" CURVE 0x1CB970 GklWSb 15.94 kw_q0p0625 -8.000 7.938 FORMAT "%5.3"
 /begin AXIS_DESCR COM_AXIS tmot temp_ub_q0p75_o48 5 -48.00 143.3 AXIS_PTS_REF STM05EPMSB /end AXIS_DESCR
/end CHARACTERISTIC
/begin CHARACTERISTIC WNWKMA2 "Korrekturwinkel Nockenwelle ¸ber Motortemperatur f¸r Auslass Bank 2" CURVE 0x1CB978 GklWSb 15.94 kw_q0p0625 -8.000 7.938 FORMAT "%5.3"
 /begin AXIS_DESCR COM_AXIS tmot temp_ub_q0p75_o48 5 -48.00 143.3 AXIS_PTS_REF STM05EPMSB /end AXIS_DESCR
/end CHARACTERISTIC
/begin CHARACTERISTIC WNWKME "Korrekturwinkel Nockenwelle ¸ber Motortemperatur f¸r Einlass Bank 1" CURVE 0x1CB980 GklWSb 15.94 kw_q0p0625 -8.000 7.938 FORMAT "%5.3"
 /begin AXIS_DESCR COM_AXIS tmot temp_ub_q0p75_o48 5 -48.00 143.3 AXIS_PTS_REF STM05EPMSB /end AXIS_DESCR
/end CHARACTERISTIC
/begin CHARACTERISTIC WNWKME2 "Korrekturwinkel Nockenwelle ¸ber Motortemperatur f¸r Einlass Bank 2" CURVE 0x1CB988 GklWSb 15.94 kw_q0p0625 -8.000 7.938 FORMAT "%5.3"
 /begin AXIS_DESCR COM_AXIS tmot temp_ub_q0p75_o48 5 -48.00 143.3 AXIS_PTS_REF STM05EPMSB /end AXIS_DESCR
/end CHARACTERISTIC
/begin CHARACTERISTIC WNWKN "Korrekturwinkel Nockenwelle ¸ber Drehzahl" CURVE 0x1CB98D KlAUbSstUbWSb 15.94 kw_q0p0625 -8.000 7.938 FORMAT "%5.3"
 /begin AXIS_DESCR STD_AXIS nmot nmot_ub_q40 6 0.00 10200. FORMAT "%5.0" DEPOSIT ABSOLUTE /end AXIS_DESCR
/end CHARACTERISTIC
/begin CHARACTERISTIC WNWRPSA "Sollwinkel der NW-Flanken in Referenzposition, Auslassnockenwelle  Bank 1" VAL_BLK 0x1C3C40 KwbUw 1023.984 kw_q0p0156 0.00 1023.984 FORMAT "%8.3" NUMBER 4 /end CHARACTERISTIC
/begin CHARACTERISTIC WNWRPSA2 "Sollwinkel der NW-Flanken in Referenzposition, Auslassnockenwelle  Bank 2" VAL_BLK 0x1C3C48 KwbUw 1023.984 kw_q0p0156 0.00 1023.984 FORMAT "%8.3" NUMBER 4 /end CHARACTERISTIC
/begin CHARACTERISTIC WNWRPSE "Sollwinkel der NW-Flanken in Referenzposition, Einlassnockenwelle  Bank 1" VAL_BLK 0x1C3C50 KwbUw 1023.984 kw_q0p0156 0.00 1023.984 FORMAT "%8.3" NUMBER 4 /end CHARACTERISTIC
/begin CHARACTERISTIC WNWRPSE2 "Sollwinkel der NW-Flanken in Referenzposition, Einlassnockenwelle  Bank 2" VAL_BLK 0x1C3C58 KwbUw 1023.984 kw_q0p0156 0.00 1023.984 FORMAT "%8.3" NUMBER 4 /end CHARACTERISTIC
/begin CHARACTERISTIC WNWSMNAAA "minimaler Winkel zum Aktivanschlag f¸r Regler Auslaﬂ" VALUE 0x1C3C90 KwUw 511.9922 kw_q0p0078 0.00 511.9922 FORMAT "%8.4" /end CHARACTERISTIC
/begin CHARACTERISTIC WNWSMNAAE "minimaler Winkel zum Aktivanschlag f¸r Regler Einlaﬂ" VALUE 0x1C3CC8 KwUw 511.9922 kw_q0p0078 0.00 511.9922 FORMAT "%8.4" /end CHARACTERISTIC
/begin CHARACTERISTIC WNWSMNRA "Winkel Nockelwellen-Sollwert Minimum f¸r Regler Auslaﬂ" VALUE 0x1C3C92 KwUw 511.9922 kw_q0p0078 0.00 511.9922 FORMAT "%8.4" /end CHARACTERISTIC
/begin CHARACTERISTIC WNWSMNRE "Winkel Nockelwellen-Sollwert Minimum f¸r Regler Einlaﬂ" VALUE 0x1C3CCA KwUw 511.9922 kw_q0p0078 0.00 511.9922 FORMAT "%8.4" /end CHARACTERISTIC
/begin CHARACTERISTIC WNWVAAA "Winkel f¸r Aktivanschlag NW-Regelung Auslaﬂ" VALUE 0x1C3C94 KwSw 511.9922 kw_q0p0078 -256.0000 255.9922 FORMAT "%8.4" /end CHARACTERISTIC
/begin CHARACTERISTIC WNWVAAE "Winkel f¸r Aktivanschlag NW-Regelung" VALUE 0x1C3CCC KwSw 511.9922 kw_q0p0078 -256.0000 255.9922 FORMAT "%8.4" /end CHARACTERISTIC
/begin CHARACTERISTIC WPHN "Phasengang" CURVE 0x1CE540 GklWS8 191.3 zw_sb_q0p75 -96.00 95.25 FORMAT "%5.2"
 /begin AXIS_DESCR COM_AXIS nmot nmot_ub_q40 8 0.00 10200. AXIS_PTS_REF SNM08__UB /end AXIS_DESCR
/end CHARACTERISTIC
/begin CHARACTERISTIC ZNWSP "Zeitkonstante f¸r Adaption-Sp‰tanschlagposition" VALUE 0x1C3C3E KwUb 99.61 rel_ub_b99p6 0.00 99.61 FORMAT "%5.2" /end CHARACTERISTIC
/begin CHARACTERISTIC ZWAPPL "Applikationsschnittstelle Z¸ndwinkelverstellung" VALUE 0x1C58C0 KwWS8 191.3 zw_sb_q0p75 -96.00 95.25 FORMAT "%5.2" /end CHARACTERISTIC
/begin CHARACTERISTIC ZWC_T_UM "Fehlertoleranzzeit der Z¸ndwinkel¸berwachung in der Funktions¸berw." VALUE 0x1C81BF KwUb 255.0 dez 0.00 255.0 FORMAT "%5.1" /end CHARACTERISTIC
/begin CHARACTERISTIC ZWSPTIP "Zeit f¸r Freischalten des TIPIN-Offsets auf den sp‰testen Z¸ndwinkel" VALUE 0x1C60AC KwUw 655.3500 t10msxs_uw_b655p35 0.00 655.3500 FORMAT "%8.4" /end CHARACTERISTIC
/begin CHARACTERISTIC ZYLANZ_UM "Zylinderzahl f¸r die Z¸ndwinkel¸berwachung in der Funktions¸berw." VALUE 0x1C81C0 KwUb 23.00 dez 1.000 24.00 FORMAT "%5.2" /end CHARACTERISTIC
/begin MEASUREMENT abtres_um "Antwortbeitrag des Befehlstests in der Funktions¸berwachung" ULONG dez 1 100 0 4.29497e+009 FORMAT "%13.2" ECU_ADDRESS 0x801CD0 /end MEASUREMENT
/begin MEASUREMENT adcc_c_um "Fehlerz‰hler bei zueinander unplausiblen ADC-Werten f¸r sp1s" UBYTE t20ms_ub_b5100 1 100 0 5100 ECU_ADDRESS 0x7F816F /end MEASUREMENT
/begin MEASUREMENT adcc_c_ur "Doppelablage (DA) f¸r ADCC_C_UM" UBYTE dez 1 100 0 255 FORMAT "%5.1" ECU_ADDRESS 0x7F825C /end MEASUREMENT
/begin MEASUREMENT adcq_c_um "Fehlerz‰hler  in der ADC-Queue-‹berwachung" UBYTE t10ms_ub_b2550 1 100 0 2550 ECU_ADDRESS 0x7F8170 /end MEASUREMENT
/begin MEASUREMENT adcq_c_ur "Doppelablage (DA) f¸r ADCQ_C_UM" UBYTE dez 1 100 0 255 FORMAT "%5.1" ECU_ADDRESS 0x7F825D /end MEASUREMENT
/begin MEASUREMENT adcq_um "Info aus dem ADC-Queue-Status Register" UBYTE dez 1 100 0 255 FORMAT "%5.1" ECU_ADDRESS 0x7F825E /end MEASUREMENT
/begin MEASUREMENT alv_old_um "" UBYTE dez 1 100 0 255 FORMAT "%5.1" ECU_ADDRESS 0x7F80A5 /end MEASUREMENT
/begin MEASUREMENT alv_old_ur "" UBYTE dez 1 100 0 255 FORMAT "%5.1" ECU_ADDRESS 0x7F81BB /end MEASUREMENT
/begin MEASUREMENT apakres_um "Antwortbeitrag der Programmablaufkontrolle in der Funktions¸berwachung" ULONG dez 1 100 0 4.29497e+009 FORMAT "%13.2" ECU_ADDRESS 0x801CD4 /end MEASUREMENT
/begin MEASUREMENT auscf_c_um "Fehlerz‰hler im DauerRAM f¸r nicht angezogenes Hauptrelais (Diagnose) in %UMAUSC" UBYTE dez 1 100 0 255 FORMAT "%5.1" ECU_ADDRESS 0x7FC2D6 /end MEASUREMENT
/begin MEASUREMENT ausch_c_um "Heilungsz‰hler f¸r Anzahl von Antworten an das UM im Abschaltpfadtest" UBYTE dez 1 100 0 255 FORMAT "%5.1" ECU_ADDRESS 0x801093 /end MEASUREMENT
/begin MEASUREMENT ausc_c_um "Pr¸fungsz‰hler im DauerRAM f¸r nicht angezogenes Hauptrelais im Abschaltpfadtest" UBYTE dez 1 100 0 255 FORMAT "%5.1" ECU_ADDRESS 0x7FC2D7 /end MEASUREMENT
/begin MEASUREMENT ausc_ur "" UBYTE dez 1 100 0 255 FORMAT "%5.1" ECU_ADDRESS 0x7F825B /end MEASUREMENT
/begin MEASUREMENT ausgh_c_um "Heilungsz‰hler f¸r Fehler in der zyklischen RAM-Pr¸fung der Funktions¸berwachung" UBYTE t40ms_ub_b10200 1 100 0 10200 FORMAT "%7.1" ECU_ADDRESS 0x7F8172 /end MEASUREMENT
/begin MEASUREMENT ausgh_c_ur "Doppelablage (DA) f¸r AUSGH_C_UM" UBYTE dez 1 100 0 255 FORMAT "%5.1" ECU_ADDRESS 0x7F8262 /end MEASUREMENT
/begin MEASUREMENT ausg_c_um "Fehlerz‰hler f¸r zyklische RAM-Pr¸fung in der Funktions¸berwachung" UBYTE dezsub1 1 100 1 256 FORMAT "%5.1" ECU_ADDRESS 0x7F8173 /end MEASUREMENT
/begin MEASUREMENT ausg_c_ur "Doppelablage (DA) f¸r AUSG_C_UM" UBYTE dez 1 100 0 255 FORMAT "%5.1" ECU_ADDRESS 0x7F8263 /end MEASUREMENT
/begin MEASUREMENT auszh_c_um "Heilungsz‰hler f¸r Fehler in der zyklischen ROM-Pr¸fung der Funktions¸berwachung" UBYTE t40ms_ub_b10200 1 100 0 10200 FORMAT "%7.1" ECU_ADDRESS 0x7F8174 /end MEASUREMENT
/begin MEASUREMENT auszh_c_ur "Doppelablage (DA) f¸r AUSZH_C_UM" UBYTE dez 1 100 0 255 FORMAT "%5.1" ECU_ADDRESS 0x7F8264 /end MEASUREMENT
/begin MEASUREMENT ausz_c_um "Fehlerz‰hler f¸r zyklische ROM-Pr¸fung in der Funktions¸berwachung" UBYTE dezsub1 1 100 1 256 FORMAT "%5.1" ECU_ADDRESS 0x7F8175 /end MEASUREMENT
/begin MEASUREMENT ausz_c_ur "Doppelablage (DA) f¸r AUSZ_C_UM" UBYTE dez 1 100 0 255 FORMAT "%5.1" ECU_ADDRESS 0x7F8265 /end MEASUREMENT
/begin MEASUREMENT brems_c_um "Entprellz‰hler f¸r bet‰tigte Bremse in der Funktions¸berwachung" UBYTE t40ms_ub_b10200 1 100 0 10200 FORMAT "%7.1" ECU_ADDRESS 0x7F8098 /end MEASUREMENT
/begin MEASUREMENT brems_c_ur "Doppelablage (DA) f¸r BREMS_C_UM" UBYTE dez 1 100 0 255 FORMAT "%5.1" ECU_ADDRESS 0x7F81B0 /end MEASUREMENT
/begin MEASUREMENT B_adcc_um "Bedingung ADC-Test aktiv" UBYTE B_TRUE 1 100 0 1 BIT_MASK 0x1 FORMAT "%13.11" ECU_ADDRESS 0x7F816C /end MEASUREMENT
/begin MEASUREMENT B_ausc_act "Bedingung f¸r Abschaltpfadtest aktiv" UBYTE B_TRUE 1 100 0 1 BIT_MASK 0x1 FORMAT "%13.11" ECU_ADDRESS 0x7FA60A /end MEASUREMENT
/begin MEASUREMENT B_ausc_um "Bedingung f¸r Abschaltpfadtest abgeschlossen in der Funktions¸berwachung" UBYTE B_TRUE 1 100 0 1 BIT_MASK 0x1 FORMAT "%13.11" ECU_ADDRESS 0x7FA60B /end MEASUREMENT
/begin MEASUREMENT B_brems_um "Bedingung Bremse getreten f¸r die Funktions¸berwachung" UBYTE B_TRUE 1 100 0 1 BIT_MASK 0x1 FORMAT "%13.11" ECU_ADDRESS 0x7F812C /end MEASUREMENT
/begin MEASUREMENT B_brfgr_um "Bedingung Bremse getreten f¸r die Funktions¸berwachung" UBYTE B_TRUE 1 100 0 1 BIT_MASK 0x2 FORMAT "%13.11" ECU_ADDRESS 0x7F812C /end MEASUREMENT
/begin MEASUREMENT B_bsl_um "erkannter Low-Pegel am FGR-Bedienhebelschalter Beschleunigen in Funktions¸berw." UBYTE B_TRUE 1 100 0 1 BIT_MASK 0x2 FORMAT "%13.11" ECU_ADDRESS 0x7F812D /end MEASUREMENT
/begin MEASUREMENT B_dcdis_um "Fehlerreaktions-Info der Funktions¸berwachung (Abschaltung der DK-Steller-ES)" UBYTE B_TRUE 1 100 0 1 BIT_MASK 0x1 FORMAT "%13.11" ECU_ADDRESS 0x7F812B /end MEASUREMENT
/begin MEASUREMENT B_develop_ECU "" UBYTE B_TRUE 1 100 0 1 BIT_MASK 0x1 FORMAT "%13.11" ECU_ADDRESS 0x7FA895 /end MEASUREMENT
/begin MEASUREMENT B_ff "Bedingung Folgefunkenz¸ndung" UBYTE B_TRUE 1 100 0 1 BIT_MASK 0x1 FORMAT "%13.11" ECU_ADDRESS 0x7FA818 /end MEASUREMENT
/begin MEASUREMENT B_fgrea_um "FGR-/ACC-Einschaltung g¸ltig in der Funktions¸berwachung, zeitverzˆgert" UBYTE B_TRUE 1 100 0 1 BIT_MASK 0x80 FORMAT "%13.11" ECU_ADDRESS 0x7F812D /end MEASUREMENT
/begin MEASUREMENT B_fgr_umc "" UBYTE B_TRUE 1 100 0 1 BIT_MASK 0x2 FORMAT "%13.11" ECU_ADDRESS 0x7F812E /end MEASUREMENT
/begin MEASUREMENT b_flags_um "Flag f¸r Bitinformationen in der Funktions¸berwachung" UBYTE dez 1 100 0 255 FORMAT "%5.1" ECU_ADDRESS 0x7F8129 /end MEASUREMENT
/begin MEASUREMENT B_fnwrlia "Freigabe langsamer I-Anteil Nockenwellenregler (Auslaﬂ)" UBYTE B_TRUE 1 100 0 1 BIT_MASK 0x80 FORMAT "%13.11" ECU_ADDRESS 0x801110 /end MEASUREMENT
/begin MEASUREMENT B_fnwrlia2 "Freigabe langsamer I-Anteil Nockenwellenregler (Auslaﬂ 2)" UBYTE B_TRUE 1 100 0 1 BIT_MASK 0x1 FORMAT "%13.11" ECU_ADDRESS 0x801111 /end MEASUREMENT
/begin MEASUREMENT B_fnwrlie "Freigabe langsamer I-Anteil Nockenwellenregler (Einlaﬂ)" UBYTE B_TRUE 1 100 0 1 BIT_MASK 0x80 FORMAT "%13.11" ECU_ADDRESS 0x801114 /end MEASUREMENT
/begin MEASUREMENT B_fnwrlie2 "Freigabe langsamer I-Anteil Nockenwellenregler (Einlaﬂ 2)" UBYTE B_TRUE 1 100 0 1 BIT_MASK 0x1 FORMAT "%13.11" ECU_ADDRESS 0x801115 /end MEASUREMENT
/begin MEASUREMENT B_fnwrsia "Freigabe schneller I-Anteil Nockenwellenregler (Auslaﬂ)" UBYTE B_TRUE 1 100 0 1 BIT_MASK 0x4 FORMAT "%13.11" ECU_ADDRESS 0x801111 /end MEASUREMENT
/begin MEASUREMENT B_fnwrsia2 "Freigabe schneller I-Anteil Nockenwellenregler (Auslaﬂ 2)" UBYTE B_TRUE 1 100 0 1 BIT_MASK 0x2 FORMAT "%13.11" ECU_ADDRESS 0x801111 /end MEASUREMENT
/begin MEASUREMENT B_fnwrsie "Freigabe schneller I-Anteil Nockenwellenregler (Einlaﬂ)" UBYTE B_TRUE 1 100 0 1 BIT_MASK 0x4 FORMAT "%13.11" ECU_ADDRESS 0x801115 /end MEASUREMENT
/begin MEASUREMENT B_fnwrsie2 "Freigabe schneller I-Anteil Nockenwellenregler (Einlaﬂ 2)" UBYTE B_TRUE 1 100 0 1 BIT_MASK 0x2 FORMAT "%13.11" ECU_ADDRESS 0x801115 /end MEASUREMENT
/begin MEASUREMENT B_i_ska "Funktions-Fehlerreaktion irreversible SKA (Sicherheits-Kraftstoffabschaltung)" UBYTE B_TRUE 1 100 0 1 BIT_MASK 0x4 FORMAT "%13.11" ECU_ADDRESS 0x7F812B /end MEASUREMENT
/begin MEASUREMENT B_i_ska_um "Fehlerreaktion irrev. SKA (Sicherheitskraftstoffabschaltung) aus Fkt-‹berwachung" UBYTE B_TRUE 1 100 0 1 BIT_MASK 0x1 FORMAT "%13.11" ECU_ADDRESS 0x7F8128 /end MEASUREMENT
/begin MEASUREMENT B_kfzk "Bedingung Kennfeld Klopfschutz" UBYTE B_TRUE 1 100 0 1 BIT_MASK 0x1 FORMAT "%13.11" ECU_ADDRESS 0x7FA819 /end MEASUREMENT
/begin MEASUREMENT B_kkl_um "erkannter Low-Pegel am FGR-Bedienhebelschalter Kontrollkontakt in Funktions¸berw" UBYTE B_TRUE 1 100 0 1 BIT_MASK 0x8 FORMAT "%13.11" ECU_ADDRESS 0x7F812D /end MEASUREMENT
/begin MEASUREMENT B_msthw_um "Bedingung Master-SG gem‰ﬂ Codier-Pin f¸r die Funktions¸berwachung" UBYTE B_TRUE 1 100 0 1 BIT_MASK 0x80 FORMAT "%13.11" ECU_ADDRESS 0x7F812E /end MEASUREMENT
/begin MEASUREMENT B_munst "Bedingung Eingriff Momenten¸berwachung zulassen" UBYTE B_TRUE 1 100 0 1 BIT_MASK 0x1 FORMAT "%13.11" ECU_ADDRESS 0x7FA630 /end MEASUREMENT
/begin MEASUREMENT B_mzns_um "Nachstartaufweitung des zul‰sigen Moments in der Funktons¸berwachung aktiv" UBYTE B_TRUE 1 100 0 1 BIT_MASK 0x1 FORMAT "%13.11" ECU_ADDRESS 0x7F80D0 /end MEASUREMENT
/begin MEASUREMENT B_naccf_um "" UBYTE B_TRUE 1 100 0 1 BIT_MASK 0x40 FORMAT "%13.11" ECU_ADDRESS 0x7F812D /end MEASUREMENT
/begin MEASUREMENT B_newqr_um "Bedingung f¸r neue Frage vom UM empfangen in der Funktions¸berwachung" UBYTE B_TRUE 1 100 0 1 BIT_MASK 0x1 FORMAT "%13.11" ECU_ADDRESS 0x7FA608 /end MEASUREMENT
/begin MEASUREMENT B_nlh_um "Anforderung Notlauf  mit Lambda 1 aus Funktions¸berwachung" UBYTE B_TRUE 1 100 0 1 BIT_MASK 0x1 FORMAT "%13.11" ECU_ADDRESS 0x7F8129 /end MEASUREMENT
/begin MEASUREMENT B_nomsr_um "MSR-Momentenvorgabe in der Funktions¸berwachung nicht ¸bernommen" UBYTE B_TRUE 1 100 0 1 BIT_MASK 0x1 FORMAT "%13.11" ECU_ADDRESS 0x7F80A3 /end MEASUREMENT
/begin MEASUREMENT B_nosgs_um "SGS-Momentenvorgabe in der Funktions¸berwachung nicht ¸bernommen" UBYTE B_TRUE 1 100 0 1 BIT_MASK 0x1 FORMAT "%13.11" ECU_ADDRESS 0x7F811C /end MEASUREMENT
/begin MEASUREMENT B_notlu "Anforderung Notluftfahren aus der Funktion" UBYTE B_TRUE 1 100 0 1 BIT_MASK 0x8 FORMAT "%13.11" ECU_ADDRESS 0x7F812B /end MEASUREMENT
/begin MEASUREMENT B_nsakt_um "Nachstart aktiv f¸r die Fkt.-‹berwachung" UBYTE B_TRUE 1 100 0 1 BIT_MASK 0x4 FORMAT "%13.11" ECU_ADDRESS 0x7F812A /end MEASUREMENT
/begin MEASUREMENT B_nsend_um "Nachstart¸berwachungszeit abgelaufen f¸r die Fkt.-‹berwachung" UBYTE B_TRUE 1 100 0 1 BIT_MASK 0x1 FORMAT "%13.11" ECU_ADDRESS 0x7F812A /end MEASUREMENT
/begin MEASUREMENT B_nwha "Halte-Tastverh‰ltnis Auslaﬂ NW-Lageregelung" UBYTE B_TRUE 1 100 0 1 BIT_MASK 0x1 FORMAT "%13.11" ECU_ADDRESS 0x801110 /end MEASUREMENT
/begin MEASUREMENT B_nwha2 "Halte-Tastverh‰ltnis  NW-Lageregelung aktiv Auslass 2" UBYTE B_TRUE 1 100 0 1 BIT_MASK 0x2 FORMAT "%13.11" ECU_ADDRESS 0x801110 /end MEASUREMENT
/begin MEASUREMENT B_nwhe "Halte-Tastverh‰ltnis Einlaﬂ NW-Lageregelung" UBYTE B_TRUE 1 100 0 1 BIT_MASK 0x1 FORMAT "%13.11" ECU_ADDRESS 0x801114 /end MEASUREMENT
/begin MEASUREMENT B_nwhe2 "Halte-Tastverh‰ltnis  NW-Lageregelung aktiv Einlass 2" UBYTE B_TRUE 1 100 0 1 BIT_MASK 0x2 FORMAT "%13.11" ECU_ADDRESS 0x801114 /end MEASUREMENT
/begin MEASUREMENT B_nwoffa "Abschaltung der Auslaﬂ-NW-Regelung" UBYTE B_TRUE 1 100 0 1 BIT_MASK 0x1 FORMAT "%13.11" ECU_ADDRESS 0x80110F /end MEASUREMENT
/begin MEASUREMENT B_nwoffa2 "Abschaltung der Nockenwellenregelung  Auslaﬂ 2" UBYTE B_TRUE 1 100 0 1 BIT_MASK 0x2 FORMAT "%13.11" ECU_ADDRESS 0x80110F /end MEASUREMENT
/begin MEASUREMENT B_nwoffe "Abschaltung der Einlaﬂ-NW-Regelung" UBYTE B_TRUE 1 100 0 1 BIT_MASK 0x1 FORMAT "%13.11" ECU_ADDRESS 0x801113 /end MEASUREMENT
/begin MEASUREMENT B_nwoffe2 "Abschaltung der Nockenwellenregelung  Einlaﬂ 2" UBYTE B_TRUE 1 100 0 1 BIT_MASK 0x2 FORMAT "%13.11" ECU_ADDRESS 0x801113 /end MEASUREMENT
/begin MEASUREMENT B_nwvfra "Nockenwellenverstellung in Fr¸h-Richtung Auslaﬂ" UBYTE B_TRUE 1 100 0 1 BIT_MASK 0x4 FORMAT "%13.11" ECU_ADDRESS 0x801110 /end MEASUREMENT
/begin MEASUREMENT B_nwvfra2 "Nockenwellenverstellung in Fr¸h-Richtung Auslaﬂ 2" UBYTE B_TRUE 1 100 0 1 BIT_MASK 0x8 FORMAT "%13.11" ECU_ADDRESS 0x801110 /end MEASUREMENT
/begin MEASUREMENT B_nwvfre "Nockenwellenverstellung in Fr¸h-Richtung Einlaﬂ" UBYTE B_TRUE 1 100 0 1 BIT_MASK 0x4 FORMAT "%13.11" ECU_ADDRESS 0x801114 /end MEASUREMENT
/begin MEASUREMENT B_nwvfre2 "Nockenwellenverstellung in Fr¸h-Richtung Einlaﬂ 2" UBYTE B_TRUE 1 100 0 1 BIT_MASK 0x8 FORMAT "%13.11" ECU_ADDRESS 0x801114 /end MEASUREMENT
/begin MEASUREMENT B_nwvspa "Nockenwellenverstellung in Sp‰t-Richtung Auslaﬂ" UBYTE B_TRUE 1 100 0 1 BIT_MASK 0x10 FORMAT "%13.11" ECU_ADDRESS 0x801110 /end MEASUREMENT
/begin MEASUREMENT B_nwvspa2 "Nockenwellenverstellung in Sp‰t-Richtung Auslaﬂ 2" UBYTE B_TRUE 1 100 0 1 BIT_MASK 0x20 FORMAT "%13.11" ECU_ADDRESS 0x801110 /end MEASUREMENT
/begin MEASUREMENT B_nwvspe "Nockenwellenverstellung in Sp‰t-Richtung Einlaﬂ" UBYTE B_TRUE 1 100 0 1 BIT_MASK 0x10 FORMAT "%13.11" ECU_ADDRESS 0x801114 /end MEASUREMENT
/begin MEASUREMENT B_nwvspe2 "Nockenwellenverstellung in Sp‰t-Richtung Einlaﬂ 2" UBYTE B_TRUE 1 100 0 1 BIT_MASK 0x20 FORMAT "%13.11" ECU_ADDRESS 0x801114 /end MEASUREMENT
/begin MEASUREMENT B_nxptr_um "" UBYTE B_TRUE 1 100 0 1 BIT_MASK 0x1 FORMAT "%13.11" ECU_ADDRESS 0x7FA60C /end MEASUREMENT
/begin MEASUREMENT B_nxtrp_um "Bedingung f¸r n‰chste Antwort korrekt an das UM ausgeben in der F‹" UBYTE B_TRUE 1 100 0 1 BIT_MASK 0x1 FORMAT "%13.11" ECU_ADDRESS 0x7FA609 /end MEASUREMENT
/begin MEASUREMENT B_phada "Adaption Kurbel/Auslaﬂnockenwelle erfolgt" UBYTE B_TRUE 1 100 0 1 BIT_MASK 0x1 FORMAT "%13.11" ECU_ADDRESS 0x7FC342 /end MEASUREMENT
/begin MEASUREMENT B_phada1 "Adaption Kurbel- zu Nockenwelle von Auslass Bank 1 erfolgt" UBYTE B_TRUE 1 100 0 1 BIT_MASK 0x2 FORMAT "%13.11" ECU_ADDRESS 0x7FC342 /end MEASUREMENT
/begin MEASUREMENT B_phada2 "Adaption Kurbel- zu Nockenwelle von Auslass Bank 2 erfolgt" UBYTE B_TRUE 1 100 0 1 BIT_MASK 0x4 FORMAT "%13.11" ECU_ADDRESS 0x7FC342 /end MEASUREMENT
/begin MEASUREMENT B_phade "Adaption Kurbel/Einlaﬂnockenwelle erfolgt" UBYTE B_TRUE 1 100 0 1 BIT_MASK 0x8 FORMAT "%13.11" ECU_ADDRESS 0x7FC342 /end MEASUREMENT
/begin MEASUREMENT B_phade1 "Adaption Kurbel- zu Nockenwelle von Einlass Bank 1 erfolgt" UBYTE B_TRUE 1 100 0 1 BIT_MASK 0x10 FORMAT "%13.11" ECU_ADDRESS 0x7FC342 /end MEASUREMENT
/begin MEASUREMENT B_phade2 "Adaption Kurbel- zu Nockenwelle von Einlass Bank 2 erfolgt" UBYTE B_TRUE 1 100 0 1 BIT_MASK 0x20 FORMAT "%13.11" ECU_ADDRESS 0x7FC342 /end MEASUREMENT
/begin MEASUREMENT B_phgefla "Bedingung, dass Phasenflanke von Auslass Bank 1 ausgewertet wird" UBYTE B_TRUE 1 100 0 1 BIT_MASK 0x1 FORMAT "%13.11" ECU_ADDRESS 0x80110D /end MEASUREMENT
/begin MEASUREMENT B_phgefla2 "Bedingung, dass Phasenflanke von Auslass Bank 2 ausgewertet wird" UBYTE B_TRUE 1 100 0 1 BIT_MASK 0x2 FORMAT "%13.11" ECU_ADDRESS 0x80110D /end MEASUREMENT
/begin MEASUREMENT B_phgefle "Bedingung, dass Phasenflanke von Einlass Bank 1 ausgewertet wird" UBYTE B_TRUE 1 100 0 1 BIT_MASK 0x4 FORMAT "%13.11" ECU_ADDRESS 0x80110D /end MEASUREMENT
/begin MEASUREMENT B_phgefle2 "Bedingung, dass Phasenflanke von Einlass Bank 2 ausgewertet wird" UBYTE B_TRUE 1 100 0 1 BIT_MASK 0x8 FORMAT "%13.11" ECU_ADDRESS 0x80110D /end MEASUREMENT
/begin MEASUREMENT B_phnmo "Bedingung f¸r Umschaltung auf Auswertung von einer Phasenflanke" UBYTE B_TRUE 1 100 0 1 BIT_MASK 0x40 FORMAT "%13.11" ECU_ADDRESS 0x7FC342 /end MEASUREMENT
/begin MEASUREMENT B_phnmu "Bedingung f¸r Umschaltung auf Auswertung von 2 Phasenflanken" UBYTE B_TRUE 1 100 0 1 BIT_MASK 0x80 FORMAT "%13.11" ECU_ADDRESS 0x7FC342 /end MEASUREMENT
/begin MEASUREMENT B_pwgnotum "= b_pwgnot_um Funktions¸berwachungs-Fehlerreaktion PWG-Leerlauf (= b_pwgnot_sr)" UBYTE B_TRUE 1 100 0 1 BIT_MASK 0x1 FORMAT "%13.11" ECU_ADDRESS 0x7F8120 /end MEASUREMENT
/begin MEASUREMENT B_reaci_um "" UBYTE B_TRUE 1 100 0 1 BIT_MASK 0x10 FORMAT "%13.11" ECU_ADDRESS 0x7F812B /end MEASUREMENT
/begin MEASUREMENT B_rldif_um "Bedingung Last¸berwachung erkennt Fehler" UBYTE B_TRUE 1 100 0 1 BIT_MASK 0x1 FORMAT "%13.11" ECU_ADDRESS 0x7F80DC /end MEASUREMENT
/begin MEASUREMENT B_rlini_um "" UBYTE B_TRUE 1 100 0 1 BIT_MASK 0x2 FORMAT "%13.11" ECU_ADDRESS 0x7F8129 /end MEASUREMENT
/begin MEASUREMENT B_rluf_um "" UBYTE B_TRUE 1 100 0 1 BIT_MASK 0x4 FORMAT "%13.11" ECU_ADDRESS 0x7F8129 /end MEASUREMENT
/begin MEASUREMENT B_spsaa "Bedingung Winkeladaption Auslassnockenwelle Bank 1 zu Kurbelwelle zul‰ssig" UBYTE B_TRUE 1 100 0 1 BIT_MASK 0x1 FORMAT "%13.11" ECU_ADDRESS 0x80110C /end MEASUREMENT
/begin MEASUREMENT B_spsaa2 "Bedingung Winkeladaption Auslassnockenwelle Bank 2 zu Kurbelwelle zul‰ssig" UBYTE B_TRUE 1 100 0 1 BIT_MASK 0x2 FORMAT "%13.11" ECU_ADDRESS 0x80110C /end MEASUREMENT
/begin MEASUREMENT B_spsae "Bedingung Winkeladaption Einlassnockenwelle Bank 1 zu Kurbelwelle zul‰ssig" UBYTE B_TRUE 1 100 0 1 BIT_MASK 0x4 FORMAT "%13.11" ECU_ADDRESS 0x80110C /end MEASUREMENT
/begin MEASUREMENT B_spsae2 "Bedingung Winkeladaption Einlassnockenwelle Bank 2 zu Kurbelwelle zul‰ssig" UBYTE B_TRUE 1 100 0 1 BIT_MASK 0x8 FORMAT "%13.11" ECU_ADDRESS 0x80110C /end MEASUREMENT
/begin MEASUREMENT B_srstz_um "Software-Reset-Anforderung aus der zyklischen ROM-Absicherung der Fkt-‹berwach." UBYTE B_TRUE 1 100 0 1 BIT_MASK 0x80 FORMAT "%13.11" ECU_ADDRESS 0x7F812B /end MEASUREMENT
/begin MEASUREMENT B_srst_um "Software-Reset-Anforderung aus der zyklischen RAM-Absicherung der Fkt-‹berwach." UBYTE B_TRUE 1 100 0 1 BIT_MASK 0x40 FORMAT "%13.11" ECU_ADDRESS 0x7F812B /end MEASUREMENT
/begin MEASUREMENT B_tfwdksom "Zeitkonstante f¸r Filterung Drosselklappenwinkel ohne Momentenstruktur aktiv" UBYTE B_TRUE 1 100 0 1 BIT_MASK 0x1 FORMAT "%13.11" ECU_ADDRESS 0x7FA631 /end MEASUREMENT
/begin MEASUREMENT B_tpu_um "" UBYTE B_TRUE 1 100 0 1 BIT_MASK 0x20 FORMAT "%13.11" ECU_ADDRESS 0x7F812B /end MEASUREMENT
/begin MEASUREMENT B_tvinva "Invertierung Tastverh‰ltnis Auslaﬂnockenwelle aktiv" UBYTE B_TRUE 1 100 0 1 BIT_MASK 0x40 FORMAT "%13.11" ECU_ADDRESS 0x801110 /end MEASUREMENT
/begin MEASUREMENT B_tvinve "Invertierung Tastverh‰ltnis Einlaﬂnockenwelle aktiv" UBYTE B_TRUE 1 100 0 1 BIT_MASK 0x40 FORMAT "%13.11" ECU_ADDRESS 0x801114 /end MEASUREMENT
/begin MEASUREMENT B_ub_ska "Batteriespannung nicht o.k., Unterspannungsabschaltung aktiv" UBYTE B_TRUE 1 100 0 1 BIT_MASK 0x2 FORMAT "%13.11" ECU_ADDRESS 0x7F812B /end MEASUREMENT
/begin MEASUREMENT B_vklakt "" UBYTE B_TRUE 1 100 0 1 BIT_MASK 0x1 FORMAT "%13.11" ECU_ADDRESS 0x80109B /end MEASUREMENT
/begin MEASUREMENT B_vklend "" UBYTE B_TRUE 1 100 0 1 BIT_MASK 0x2 FORMAT "%13.11" ECU_ADDRESS 0x80109B /end MEASUREMENT
/begin MEASUREMENT B_vklerr "" UBYTE B_TRUE 1 100 0 1 BIT_MASK 0x10 FORMAT "%13.11" ECU_ADDRESS 0x80109B /end MEASUREMENT
/begin MEASUREMENT B_vksakt "" UBYTE B_TRUE 1 100 0 1 BIT_MASK 0x1 FORMAT "%13.11" ECU_ADDRESS 0x80109C /end MEASUREMENT
/begin MEASUREMENT B_vksend "" UBYTE B_TRUE 1 100 0 1 BIT_MASK 0x2 FORMAT "%13.11" ECU_ADDRESS 0x80109C /end MEASUREMENT
/begin MEASUREMENT B_vkserr "" UBYTE B_TRUE 1 100 0 1 BIT_MASK 0x10 FORMAT "%13.11" ECU_ADDRESS 0x80109C /end MEASUREMENT
/begin MEASUREMENT B_vzl_um "erkannter Low-Pegel am FGR-Bedienhebelschalter Verzˆgern in der Funktions¸berw." UBYTE B_TRUE 1 100 0 1 BIT_MASK 0x1 FORMAT "%13.11" ECU_ADDRESS 0x7F812D /end MEASUREMENT
/begin MEASUREMENT B_wal_um "erkannter Low-Pegel am FGR-Bedienhebelschalter Wiederaufnahme in Funktions¸berw." UBYTE B_TRUE 1 100 0 1 BIT_MASK 0x4 FORMAT "%13.11" ECU_ADDRESS 0x7F812D /end MEASUREMENT
/begin MEASUREMENT B_wdksom "Drosselklappensollwinkel ohne Momentenstruktur aktiv" UBYTE B_TRUE 1 100 0 1 BIT_MASK 0x1 FORMAT "%13.11" ECU_ADDRESS 0x7FA632 /end MEASUREMENT
/begin MEASUREMENT B_wnwinla "Bedingung: Winkeldifferenz wnwia1_w nicht plausibel" UBYTE B_TRUE 1 100 0 1 BIT_MASK 0x10 FORMAT "%13.11" ECU_ADDRESS 0x80110C /end MEASUREMENT
/begin MEASUREMENT B_wnwinla2 "Bedingung: Winkeldifferenz wnwia2_w nicht plausibel" UBYTE B_TRUE 1 100 0 1 BIT_MASK 0x20 FORMAT "%13.11" ECU_ADDRESS 0x80110C /end MEASUREMENT
/begin MEASUREMENT B_wnwinle "Bedingung: Winkeldifferenz wnwie1_w nicht plausibel" UBYTE B_TRUE 1 100 0 1 BIT_MASK 0x40 FORMAT "%13.11" ECU_ADDRESS 0x80110C /end MEASUREMENT
/begin MEASUREMENT B_wnwinle2 "Bedingung: Winkeldifferenz wnwie2_w nicht plausibel" UBYTE B_TRUE 1 100 0 1 BIT_MASK 0x80 FORMAT "%13.11" ECU_ADDRESS 0x80110C /end MEASUREMENT
/begin MEASUREMENT B_zwkra "Bedingung: Z¸ndwinkel der KR wird ausgegeben" UBYTE B_TRUE 1 100 0 1 BIT_MASK 0x1 FORMAT "%13.11" ECU_ADDRESS 0x7FA81C /end MEASUREMENT
/begin MEASUREMENT B_zwmnpst "Bedingung Nachstartphase bzgl. Z¸ndwinkelsp‰tgrenze erreicht" UBYTE B_TRUE 1 100 0 1 BIT_MASK 0x1 FORMAT "%13.11" ECU_ADDRESS 0x7FA81A /end MEASUREMENT
/begin MEASUREMENT B_zwms "Bedingung Motorschutz-Z¸ndwinkelbegrenzung" UBYTE B_TRUE 1 100 0 1 BIT_MASK 0x1 FORMAT "%13.11" ECU_ADDRESS 0x7FA81B /end MEASUREMENT
/begin MEASUREMENT B_zwspae "Bedingung: Z¸ndwinkel zwspae bei Schubabschaltung wird ausgegeben" UBYTE B_TRUE 1 100 0 1 BIT_MASK 0x1 FORMAT "%13.11" ECU_ADDRESS 0x7FA81D /end MEASUREMENT
/begin MEASUREMENT c720alt_um "Zahnz‰hler720∞ des vorhergehenden Berechnungszeitpunkts im 10ms-Raster" UBYTE dez 1 100 0 255 FORMAT "%5.1" ECU_ADDRESS 0x7F817D /end MEASUREMENT
/begin MEASUREMENT c720alt_ur "Doppelablage (DA) f¸r C720ALT_UM" UBYTE dez 1 100 0 255 FORMAT "%5.1" ECU_ADDRESS 0x7F8268 /end MEASUREMENT
/begin MEASUREMENT Cod_Aggr "" UBYTE dez 1 100 0 255 FORMAT "%5.1" ECU_ADDRESS 0x7FC2F5 /end MEASUREMENT
/begin MEASUREMENT Cod_CANMembr "" UBYTE dez 1 100 0 255 FORMAT "%5.1" ECU_ADDRESS 0x7FC2F6 /end MEASUREMENT
/begin MEASUREMENT Cod_Diff_Ratio "" UBYTE dez 1 100 0 255 FORMAT "%5.1" ECU_ADDRESS 0x7FC2F7 /end MEASUREMENT
/begin MEASUREMENT Cod_Drvabl "" UBYTE dez 1 100 0 255 FORMAT "%5.1" ECU_ADDRESS 0x7FC2F8 /end MEASUREMENT
/begin MEASUREMENT Cod_Eng "" UBYTE dez 1 100 0 255 FORMAT "%5.1" ECU_ADDRESS 0x7FC2F9 /end MEASUREMENT
/begin MEASUREMENT Cod_EOL "" UBYTE dez 1 100 0 255 FORMAT "%5.1" ECU_ADDRESS 0x7FC2FA /end MEASUREMENT
/begin MEASUREMENT Cod_Exh "" UBYTE dez 1 100 0 255 FORMAT "%5.1" ECU_ADDRESS 0x7FC2FB /end MEASUREMENT
/begin MEASUREMENT Cod_Func "" UBYTE dez 1 100 0 255 FORMAT "%5.1" ECU_ADDRESS 0x7FC2FC /end MEASUREMENT
/begin MEASUREMENT Cod_ModelRange "" UBYTE dez 1 100 0 255 FORMAT "%5.1" ECU_ADDRESS 0x7FC2FD /end MEASUREMENT
/begin MEASUREMENT Cod_Res1 "" UBYTE dez 1 100 0 255 FORMAT "%5.1" ECU_ADDRESS 0x7FC2FE /end MEASUREMENT
/begin MEASUREMENT Cod_Res2 "" UBYTE dez 1 100 0 255 FORMAT "%5.1" ECU_ADDRESS 0x7FC2FF /end MEASUREMENT
/begin MEASUREMENT Cod_Res3 "" UBYTE dez 1 100 0 255 FORMAT "%5.1" ECU_ADDRESS 0x7FC300 /end MEASUREMENT
/begin MEASUREMENT Cod_Res4 "" UBYTE dez 1 100 0 255 FORMAT "%5.1" ECU_ADDRESS 0x7FC301 /end MEASUREMENT
/begin MEASUREMENT Cod_Res5 "" UBYTE dez 1 100 0 255 FORMAT "%5.1" ECU_ADDRESS 0x7FC302 /end MEASUREMENT
/begin MEASUREMENT Cod_Res6 "" UBYTE dez 1 100 0 255 FORMAT "%5.1" ECU_ADDRESS 0x7FC303 /end MEASUREMENT
/begin MEASUREMENT Cod_TM "" UBYTE dez 1 100 0 255 FORMAT "%5.1" ECU_ADDRESS 0x7FC304 /end MEASUREMENT
/begin MEASUREMENT Cod_Trans1 "" UBYTE dez 1 100 0 255 FORMAT "%5.1" ECU_ADDRESS 0x7FC305 /end MEASUREMENT
/begin MEASUREMENT Cod_Trans2 "" UBYTE dez 1 100 0 255 FORMAT "%5.1" ECU_ADDRESS 0x7FC306 /end MEASUREMENT
/begin MEASUREMENT Cod_WhlFront_Circumfer_Fctr "" UBYTE dez 1 100 0 255 FORMAT "%5.1" ECU_ADDRESS 0x7FC307 /end MEASUREMENT
/begin MEASUREMENT Cod_WhlRear_Circumfer_Fctr "" UBYTE dez 1 100 0 255 FORMAT "%5.1" ECU_ADDRESS 0x7FC308 /end MEASUREMENT
/begin MEASUREMENT dpipf_l_um "Zul‰ssiger gefilterter Druck (LOW-Byte)" UBYTE p_q0p0195 1 100 0 4.98047 FORMAT "%5.3" ECU_ADDRESS 0x7F80E2 /end MEASUREMENT
/begin MEASUREMENT dpipf_l_ur "Komplement: Zul‰ssiger gefilteter Druck (LOW-Byte)" UBYTE dez 1 100 0 255 FORMAT "%5.1" ECU_ADDRESS 0x7F81FC /end MEASUREMENT
/begin MEASUREMENT dpipf_p_um "" UBYTE dez 1 100 0 255 FORMAT "%5.1" ECU_ADDRESS 0x7F80E3 /end MEASUREMENT
/begin MEASUREMENT dpipf_p_ur "" UBYTE dez 1 100 0 255 FORMAT "%5.1" ECU_ADDRESS 0x7F81FD /end MEASUREMENT
/begin MEASUREMENT dpipf_r_um "" UBYTE p_q5 1 100 0 1275 FORMAT "%5.0" ARRAY_SIZE 8 ECU_ADDRESS 0x7F80E4 /end MEASUREMENT
/begin MEASUREMENT dpipf_r_ur "" UBYTE dez 1 100 0 255 FORMAT "%5.1" ARRAY_SIZE 8 ECU_ADDRESS 0x7F8200 /end MEASUREMENT
/begin MEASUREMENT dpipf_um "Zul‰ssiger gefilterter Druck" UBYTE p_q5 1 100 0 1275 FORMAT "%5.0" ECU_ADDRESS 0x7F80EC /end MEASUREMENT
/begin MEASUREMENT dpipf_ur "Doppelablage (DA) f¸r DPIPF_UM" UBYTE dez 1 100 0 255 FORMAT "%5.1" ECU_ADDRESS 0x7F8208 /end MEASUREMENT
/begin MEASUREMENT dpip_um "Zul‰ssiger Druck (aus Istwertpoti und Motordrehzahl)" UBYTE p_q5 1 100 0 1275 FORMAT "%5.0" ECU_ADDRESS 0x7F8209 /end MEASUREMENT
/begin MEASUREMENT dps_c_um "Entprellz‰hler zur Absicherung der Druckinformation" UBYTE t40ms_ub_b10200 1 100 0 10200 FORMAT "%7.1" ECU_ADDRESS 0x7F80ED /end MEASUREMENT
/begin MEASUREMENT dps_c_ur "Doppelablage (DA) f¸r DPC_C_UM" UBYTE dez 1 100 0 255 FORMAT "%5.1" ECU_ADDRESS 0x7F820A /end MEASUREMENT
/begin MEASUREMENT dps_um "Druckinformation f¸r die Funktions¸berwachung" UBYTE p_q5 1 100 0 1275 FORMAT "%5.0" ECU_ADDRESS 0x7F80EE /end MEASUREMENT
/begin MEASUREMENT dps_ur "Doppelablage (DA) f¸r DPS_UM" UBYTE dez 1 100 0 255 FORMAT "%5.1" ECU_ADDRESS 0x7F820B /end MEASUREMENT
/begin MEASUREMENT drrev_sta "Zustand der Synchronisation" UBYTE dez 1 100 0 255 FORMAT "%5.1" ECU_ADDRESS 0x801053 /end MEASUREMENT
/begin MEASUREMENT dwnwa2_w "delta Winkel Nockenwelle(Sollwinkel - Istwinkel) Auslaﬂ 2" SWORD kw_q0p0078 1 100 -256 255.992 FORMAT "%8.4" ECU_ADDRESS 0x801580 /end MEASUREMENT
/begin MEASUREMENT dwnwaa2_w "delta Winkel Nockenwelle(Sollwinkel - Istwinkel) Auslaﬂ 2 alter Wert" SWORD kw_q0p0078 1 100 -256 255.992 FORMAT "%8.4" ECU_ADDRESS 0x801582 /end MEASUREMENT
/begin MEASUREMENT dwnwaa_w "delta Winkel Auslaﬂ-NW (Sollwinkel - Istwinkel) alter Wert" SWORD kw_q0p0078 1 100 -256 255.992 FORMAT "%8.4" ECU_ADDRESS 0x801584 /end MEASUREMENT
/begin MEASUREMENT dwnwae2_w "delta Winkel Nockenwelle(Sollwinkel - Istwinkel) Einlaﬂ 2 alter Wert" SWORD kw_q0p0078 1 100 -256 255.992 FORMAT "%8.4" ECU_ADDRESS 0x8015B4 /end MEASUREMENT
/begin MEASUREMENT dwnwae_w "delta Winkel Einlaﬂ-NW (Sollwinkel - Istwinkel) alter Wert" SWORD kw_q0p0078 1 100 -256 255.992 FORMAT "%8.4" ECU_ADDRESS 0x8015B6 /end MEASUREMENT
/begin MEASUREMENT dwnwa_w "delta Winkel Auslaﬂ-NW (Sollwinkel - Istwinkel)" SWORD kw_q0p0078 1 100 -256 255.992 FORMAT "%8.4" ECU_ADDRESS 0x801586 /end MEASUREMENT
/begin MEASUREMENT dwnwda2_w "delta Winkel D-Anteil Nockenwelle f¸r D-Regelanteil Auslaﬂ 2" SWORD kw_q0p0078 1 100 -256 255.992 FORMAT "%8.4" ECU_ADDRESS 0x801588 /end MEASUREMENT
/begin MEASUREMENT dwnwda_w "delta Winkel D-Anteil Nockenwelle f¸r D-Regelanteil Auslaﬂ" SWORD kw_q0p0078 1 100 -256 255.992 FORMAT "%8.4" ECU_ADDRESS 0x80158A /end MEASUREMENT
/begin MEASUREMENT dwnwde2_w "delta Winkel D-Anteil Nockenwelle f¸r D-Regelanteil Einlaﬂ 2" SWORD kw_q0p0078 1 100 -256 255.992 FORMAT "%8.4" ECU_ADDRESS 0x8015B8 /end MEASUREMENT
/begin MEASUREMENT dwnwde_w "delta Winkel D-Anteil Nockenwelle f¸r D-Regelanteil" SWORD kw_q0p0078 1 100 -256 255.992 FORMAT "%8.4" ECU_ADDRESS 0x8015BA /end MEASUREMENT
/begin MEASUREMENT dwnwe2_w "delta Winkel Nockenwelle(Sollwinkel - Istwinkel) Einlaﬂ 2" SWORD kw_q0p0078 1 100 -256 255.992 FORMAT "%8.4" ECU_ADDRESS 0x8015BC /end MEASUREMENT
/begin MEASUREMENT dwnwe_w "delta Winkel Einlaﬂ-NW (Sollwinkel - Istwinkel)" SWORD kw_q0p0078 1 100 -256 255.992 FORMAT "%8.4" ECU_ADDRESS 0x8015BE /end MEASUREMENT
/begin MEASUREMENT dzwb2 "Z¸ndwinkeloffset f¸r Bank 2" SBYTE zw_sb_q0p75 1 100 -96 95.25 FORMAT "%5.2" ECU_ADDRESS 0x8011EC /end MEASUREMENT
/begin MEASUREMENT dzwbank "Bankindividueller Z¸ndwinkeloffset" SBYTE zw_sb_q0p75 1 100 -96 95.25 FORMAT "%5.2" ARRAY_SIZE 8 ECU_ADDRESS 0x8011F0 /end MEASUREMENT
/begin MEASUREMENT dzwdyn "" SBYTE zw_sb_q0p75 1 100 -96 95.25 FORMAT "%5.2" ECU_ADDRESS 0x8011FF /end MEASUREMENT
/begin MEASUREMENT dzwdyntp "Tip-In Korrektur sp‰tester Z¸ndwinkel" SBYTE zw_sb_q0p75 1 100 -96 95.25 FORMAT "%5.2" ECU_ADDRESS 0x801200 /end MEASUREMENT
/begin MEASUREMENT dzwkg "Delta-Z¸ndwinkel Verschiebung Klopfgrenze" SBYTE zw_sb_q0p75 1 100 -96 95.25 FORMAT "%5.2" ECU_ADDRESS 0x8011F8 /end MEASUREMENT
/begin MEASUREMENT dzwmna "Min-Z¸ndwinkel ƒnderungsgeschwindigeit zw. Brenngrenze und Motorschutz" SBYTE zw_sb_q0p75 1 100 -96 95.25 FORMAT "%5.2" ECU_ADDRESS 0x801201 /end MEASUREMENT
/begin MEASUREMENT dzwnwsu "" SBYTE zw_sb_q0p75 1 100 -96 95.25 FORMAT "%5.2" ECU_ADDRESS 0x8011F9 /end MEASUREMENT
/begin MEASUREMENT dzwspae "Korrektur-Z¸ndwinkel f¸r den sp‰test erlaubten Z¸ndwinkel" SBYTE zw_sb_q0p75 1 100 -96 95.25 FORMAT "%5.2" ECU_ADDRESS 0x801202 /end MEASUREMENT
/begin MEASUREMENT dzwwl "Delta Zuendwinkel aus Warmlauf" SBYTE zw_sb_q0p75 1 100 -96 95.25 FORMAT "%5.2" ECU_ADDRESS 0x80120A /end MEASUREMENT
/begin MEASUREMENT dzwzk "delta Z¸ndwinkel bei Dauerklopfen" SBYTE zw_sb_q0p75 1 100 -96 95.25 FORMAT "%5.2" ECU_ADDRESS 0x8011FA /end MEASUREMENT
/begin MEASUREMENT dzw_um "Delta Z¸ndwinkel zwischen zwopt und zwout in der Funktions¸berwachung" UBYTE zw_ub_q0p75 1 100 0 191.25 FORMAT "%5.1" ECU_ADDRESS 0x7F80A1 /end MEASUREMENT
/begin MEASUREMENT dzw_ur "Doppelablage (DA) f¸r DZW_UM" UBYTE dez 1 100 0 255 FORMAT "%5.1" ECU_ADDRESS 0x7F81B6 /end MEASUREMENT
/begin MEASUREMENT egaspfad "EGAS-Pfad als Umweltbedingung f¸r Funktions¸berwachungs-Diagnoseeintrag" UBYTE dez 1 100 0 255 FORMAT "%5.1" ECU_ADDRESS 0x80108D /end MEASUREMENT
/begin MEASUREMENT ei_adcc_um "irreversibles Fehlerbit bei der AD-Wandler-‹berwachung" UBYTE B_TRUE 1 100 0 1 BIT_MASK 0x1 FORMAT "%13.11" ECU_ADDRESS 0x7F816D /end MEASUREMENT
/begin MEASUREMENT ei_adcq_um "irreversibles Fehlerbit bei der AD-Wandler-Queue-‹berwachung" UBYTE B_TRUE 1 100 0 1 BIT_MASK 0x1 FORMAT "%13.11" ECU_ADDRESS 0x7F816E /end MEASUREMENT
/begin MEASUREMENT ei_dps_um "irreversibles Fehlerbit aus der Drucksensorplausibilisierung in der Funktions¸be" UBYTE B_TRUE 1 100 0 1 BIT_MASK 0x1 FORMAT "%13.11" ECU_ADDRESS 0x7F80DD /end MEASUREMENT
/begin MEASUREMENT ei_ipa_um "irrev. Fehlerbit f¸r unterer DK-Anschlag im ung¸ltigen Bereich in der Fkt-‹berw." UBYTE B_TRUE 1 100 0 1 BIT_MASK 0x1 FORMAT "%13.11" ECU_ADDRESS 0x7F80DE /end MEASUREMENT
/begin MEASUREMENT ei_msrc_um "irreversibles Fehlerbit bei der MSR-‹berwachung der Funktions¸berwachung" UBYTE B_TRUE 1 100 0 1 BIT_MASK 0x1 FORMAT "%13.11" ECU_ADDRESS 0x7F80A4 /end MEASUREMENT
/begin MEASUREMENT ei_mver_um "irreversibles Fehlerbit beim Momentenvergleich der Funktions¸berwachung" UBYTE B_TRUE 1 100 0 1 BIT_MASK 0x1 FORMAT "%13.11" ECU_ADDRESS 0x7F80A8 /end MEASUREMENT
/begin MEASUREMENT ei_nc_um "irreversibles Fehlerbit beim Drehzahlvergleich der Funktions¸berwachung" UBYTE B_TRUE 1 100 0 1 BIT_MASK 0x1 FORMAT "%13.11" ECU_ADDRESS 0x7F80C4 /end MEASUREMENT
/begin MEASUREMENT ei_reac_um "irreversibles Fehlerbit der Fehlerreaktions¸berwachung der Funktions¸berwachung" UBYTE B_TRUE 1 100 0 1 BIT_MASK 0x1 FORMAT "%13.11" ECU_ADDRESS 0x7F80D4 /end MEASUREMENT
/begin MEASUREMENT ei_rlc_um "irreversibles Fehlerbit beim rl-Vergleich mit der Funktion in der Funktions¸berw" UBYTE B_TRUE 1 100 0 1 BIT_MASK 0x1 FORMAT "%13.11" ECU_ADDRESS 0x7F80DF /end MEASUREMENT
/begin MEASUREMENT ei_rlip_um "irreversibles Fehlerbit beim rl/rlip-Vergleich der Funktions¸berwachung" UBYTE B_TRUE 1 100 0 1 BIT_MASK 0x1 FORMAT "%13.11" ECU_ADDRESS 0x7F80E0 /end MEASUREMENT
/begin MEASUREMENT ei_sgsc_um "irreversibles Fehlerbit bei der SGS-‹berwachung der Funktions¸berwachung" UBYTE B_TRUE 1 100 0 1 BIT_MASK 0x1 FORMAT "%13.11" ECU_ADDRESS 0x7F811D /end MEASUREMENT
/begin MEASUREMENT ei_spsc_um "irreversibles Fehlerbit bei d. Sollwertplausibilisierung d. Funktions¸berwachung" UBYTE B_TRUE 1 100 0 1 BIT_MASK 0x1 FORMAT "%13.11" ECU_ADDRESS 0x7F8121 /end MEASUREMENT
/begin MEASUREMENT ei_tpu_um "Irreversibles Fehlerbit der TPU-‹berwachung in der Funktions¸berwachung" UBYTE B_TRUE 1 100 0 1 BIT_MASK 0x1 FORMAT "%13.11" ECU_ADDRESS 0x7F817C /end MEASUREMENT
/begin MEASUREMENT ei_ubr_um "irrev. Fehlerbit zur Anforderung Fehlereintrag Hauptrelais-Diagnose aus %UMAUSC" UBYTE B_TRUE 1 100 0 1 BIT_MASK 0x1 FORMAT "%13.11" ECU_ADDRESS 0x7F816B /end MEASUREMENT
/begin MEASUREMENT ei_vvt_um "Irreversibles Fehlerbit aus der VVT-Ventilhubplausibilisierung" UBYTE B_TRUE 1 100 0 1 BIT_MASK 0x1 FORMAT "%13.11" ECU_ADDRESS 0x7F80E1 /end MEASUREMENT
/begin MEASUREMENT ei_zwc_um "irreversibles Fehlerbit bei der Z¸ndwinkel¸berwachung der Funktions¸berwachung" UBYTE B_TRUE 1 100 0 1 BIT_MASK 0x1 FORMAT "%13.11" ECU_ADDRESS 0x7F8168 /end MEASUREMENT
/begin MEASUREMENT esst_snm04zuuw "" ULONG dez 1 100 0 4.29497e+009 FORMAT "%13.2" ECU_ADDRESS 0x801DCC /end MEASUREMENT
/begin MEASUREMENT esst_sns04zusb "" ULONG dez 1 100 0 4.29497e+009 FORMAT "%13.2" ECU_ADDRESS 0x801DD0 /end MEASUREMENT
/begin MEASUREMENT esst_stm05epmsb "" ULONG dez 1 100 0 4.29497e+009 FORMAT "%13.2" ECU_ADDRESS 0x801D38 /end MEASUREMENT
/begin MEASUREMENT etazwmn "Minimum-Z¸ndwinkelwirkungsgrad" UBYTE rel_ub_b127p5 1 100 0 127.5 FORMAT "%5.1" ECU_ADDRESS 0x7FAA18 /end MEASUREMENT
/begin MEASUREMENT etazw_um "Ist-Z¸ndwinkelwirkungsgrad in der Funktions¸berwachung" UBYTE rel_ub_b127p5 1 100 0 127.5 FORMAT "%5.1" ECU_ADDRESS 0x7F81B7 /end MEASUREMENT
/begin MEASUREMENT evhubim_um "Istwert Hubverstellung (Minimalwert) f¸r VVT-System in der Funktions¸berwachung" UBYTE hub_ub_q0p064 1 100 0 16.32 FORMAT "%5.2" ECU_ADDRESS 0x7F80EF /end MEASUREMENT
/begin MEASUREMENT evhubim_ur "DA f¸r evhubim_um" UBYTE dez 1 100 0 255 FORMAT "%5.1" ECU_ADDRESS 0x7F820C /end MEASUREMENT
/begin MEASUREMENT evhubi_um "Istwert Hubverstellung (Maximalwert) f¸r VVT-System in der Funktions¸berwachung" UBYTE hub_ub_q0p064 1 100 0 16.32 FORMAT "%5.2" ECU_ADDRESS 0x7F80F0 /end MEASUREMENT
/begin MEASUREMENT evhubi_ur "Doppelablage (DA) f¸r EVHUBI_UM" UBYTE dez 1 100 0 255 FORMAT "%5.1" ECU_ADDRESS 0x7F820D /end MEASUREMENT
/begin MEASUREMENT e_mem_um "Errorflag im DauerRAM f¸r Fehler im zyklischen Speichertest in der FU" UBYTE B_TRUE 1 100 0 1 BIT_MASK 0x1 FORMAT "%13.11" ECU_ADDRESS 0x7FC2E0 /end MEASUREMENT
/begin MEASUREMENT e_ram_um "Errorflag im DauerRAM f¸r RAM-Fehler in der Funktions¸berwachung" UBYTE B_TRUE 1 100 0 1 BIT_MASK 0x1 FORMAT "%13.11" ECU_ADDRESS 0x7FC2EA /end MEASUREMENT
/begin MEASUREMENT e_rom1_um "Errorflag im DauerRAM f¸r Fehler nur in einer ROM-Page in der Fkt.¸berwachung" UBYTE B_TRUE 1 100 0 1 BIT_MASK 0x1 FORMAT "%13.11" ECU_ADDRESS 0x7FC2EC /end MEASUREMENT
/begin MEASUREMENT e_romx_um "Errorflag im DauerRAM f¸r Fehler in mehreren ROM-Pages in der Fkt.¸berwachung" UBYTE B_TRUE 1 100 0 1 BIT_MASK 0x1 FORMAT "%13.11" ECU_ADDRESS 0x7FC2ED /end MEASUREMENT
/begin MEASUREMENT e_tpu_um "Fehlerflag im DauerRAM f¸r TPU-Fehler in der Funktions¸berwachung" UBYTE B_TRUE 1 100 0 1 BIT_MASK 0x1 FORMAT "%13.11" ECU_ADDRESS 0x7FC2F4 /end MEASUREMENT
/begin MEASUREMENT fgren_c_um "" UBYTE t40ms_ub_b10200 1 100 0 10200 FORMAT "%7.1" ECU_ADDRESS 0x7F8099 /end MEASUREMENT
/begin MEASUREMENT fgren_c_ur "" UBYTE dez 1 100 0 255 FORMAT "%5.1" ECU_ADDRESS 0x7F81B1 /end MEASUREMENT
/begin MEASUREMENT frerr_c_um "FR-Fehlerz‰hler f¸r Differenz FZ-R¸ckmeldung/FZ-Erwartungswert in der Fkt.¸berw." UBYTE dez 1 100 0 255 FORMAT "%5.1" ECU_ADDRESS 0x7F8256 /end MEASUREMENT
/begin MEASUREMENT frerr_c_ur "" UBYTE dez 1 100 0 255 FORMAT "%5.1" ECU_ADDRESS 0x7F8257 /end MEASUREMENT
/begin MEASUREMENT frtar_c_um "Funktionsrechner Fehlerz‰hler-Erwartungswert der Funktions¸berwachung" UBYTE dez 1 100 0 255 FORMAT "%5.1" ECU_ADDRESS 0x80108F /end MEASUREMENT
/begin MEASUREMENT ftanwubka "Faktor Korrektur Tasverh‰ltnis Nockenwelle f(ub),  Auslaﬂ" UBYTE fak_ub_b2 1 100 0 1.99219 FORMAT "%5.3" ECU_ADDRESS 0x80110E /end MEASUREMENT
/begin MEASUREMENT ftanwubke "Faktor Korrektur Tasverh‰ltnis Nockenwelle f(ub) Einlass" UBYTE fak_ub_b2 1 100 0 1.99219 FORMAT "%5.3" ECU_ADDRESS 0x801112 /end MEASUREMENT
/begin MEASUREMENT fubaanz "Anzahl der Funkenpakete Funkenbandz¸ndung" UBYTE dez 1 100 0 255 FORMAT "%5.1" ECU_ADDRESS 0x8011EA /end MEASUREMENT
/begin MEASUREMENT fuel_co_um "Um ein Abarbeitungsraster verzˆgerte (alte) Einspritzzeit in der Funktions¸berw." ULONG dez 1 100 0 4.29497e+009 FORMAT "%13.2" ECU_ADDRESS 0x7F80D8 /end MEASUREMENT
/begin MEASUREMENT fuel_co_ur "Doppelablage (DA) f¸r FUEL_CO_UM" ULONG dez 1 100 0 4.29497e+009 FORMAT "%13.2" ECU_ADDRESS 0x7F81F8 /end MEASUREMENT
/begin MEASUREMENT fwkor_um "Wichtungsfaktor f¸r Ventilhub Abweichung in der Funktions¸berwachung" UBYTE fak_q0p00392 1 100 0 1 FORMAT "%5.3" ECU_ADDRESS 0x7F80F1 /end MEASUREMENT
/begin MEASUREMENT fwnm_um "Aktueller Normierungsfaktor fuer Drehzahl" UBYTE fak_q0p00781 1 100 0 1.99219 FORMAT "%5.3" ECU_ADDRESS 0x7F820E /end MEASUREMENT
/begin MEASUREMENT fzwmn_w "Abregelfaktor Sp‰twinkel im Nachstart" UWORD fak_uw_b1 1 100 0 0.999985 FORMAT "%9.7" ECU_ADDRESS 0x8017B2 /end MEASUREMENT
/begin MEASUREMENT hubst08_um "" ULONG dez 1 100 0 4.29497e+009 FORMAT "%13.2" ECU_ADDRESS 0x7F8110 /end MEASUREMENT
/begin MEASUREMENT hubst08_ur "" ULONG dez 1 100 0 4.29497e+009 FORMAT "%13.2" ECU_ADDRESS 0x7F8234 /end MEASUREMENT
/begin MEASUREMENT hwError_um "Fehler HW Zugriff aus CY310 Modulen" UBYTE dez 1 100 0 255 FORMAT "%5.1" ECU_ADDRESS 0x7FC2D8 /end MEASUREMENT
/begin MEASUREMENT inisynmon "Monitor-Array mit Gr¸nden der letzten Anforderung einer Neusynchronisation" UWORD dez 1 100 0 65535 FORMAT "%8.2" ARRAY_SIZE 2 ECU_ADDRESS 0x801C6E /end MEASUREMENT
/begin MEASUREMENT ipa_c_um "Fehlerz‰hler f¸r unterer DK-Anschlag im ung¸ltigen Bereich f. d. Funktions¸berw." UBYTE t40ms_ub_b10200 1 100 0 10200 FORMAT "%7.1" ECU_ADDRESS 0x7F80F2 /end MEASUREMENT
/begin MEASUREMENT ipa_c_ur "Doppelablage (DA) f¸r IPA_C_UM" UBYTE dez 1 100 0 255 FORMAT "%5.1" ECU_ADDRESS 0x7F820F /end MEASUREMENT
/begin MEASUREMENT ipnst08_um "St¸tzstelle f¸r aktive DK-Istwertpoti-Info (IPSN_UM)" ULONG dez 1 100 0 4.29497e+009 FORMAT "%13.2" ECU_ADDRESS 0x7F8114 /end MEASUREMENT
/begin MEASUREMENT ipnst08_ur "" ULONG dez 1 100 0 4.29497e+009 FORMAT "%13.2" ECU_ADDRESS 0x7F8238 /end MEASUREMENT
/begin MEASUREMENT ipsn_um "aktive DK-Istwertpoti-Info ohne unteren Anschlag f¸r die Funktions¸berwachung" UBYTE spg_ub_q0p019 1 100 0 4.98047 FORMAT "%5.3" ECU_ADDRESS 0x7F80F3 /end MEASUREMENT
/begin MEASUREMENT ipsn_ur "Doppelablage (DA) f¸r IPSN_UM" UBYTE dez 1 100 0 255 FORMAT "%5.1" ECU_ADDRESS 0x7F8210 /end MEASUREMENT
/begin MEASUREMENT mdif_w_um "Differenz zwischen zul‰ssigem und Ist-Moment in der Funktions¸berwachung" SWORD rel_ub_q0p3906 1 100 -12800 12799.6 FORMAT "%8.2" ECU_ADDRESS 0x7F81C0 /end MEASUREMENT
/begin MEASUREMENT mdst08_um "St¸tzstelle f¸r Momenten-Info (MZ_UM) zur Ermittlung des Momenten-Offsets in FU" ULONG dez 1 100 0 4.29497e+009 FORMAT "%13.2" ECU_ADDRESS 0x7F80C0 /end MEASUREMENT
/begin MEASUREMENT mdst08_ur "Doppelablage der St¸tzstelle f¸r Momenten-Info zur Ermittlung des Offsets in FU" ULONG dez 1 100 0 4.29497e+009 FORMAT "%13.2" ECU_ADDRESS 0x7F81D8 /end MEASUREMENT
/begin MEASUREMENT mem_ur "Doppelablage (DA) im DauerRAM f¸r Bit E_MEM_UM" UBYTE dez 1 100 0 255 FORMAT "%5.1" ECU_ADDRESS 0x7FC2E1 /end MEASUREMENT
/begin MEASUREMENT miopt_um "optimales indiziertes Moment in der Funktions¸berwachung" UBYTE rel_ub_b99p6 1 100 0 99.6094 FORMAT "%5.2" ECU_ADDRESS 0x7F81B8 /end MEASUREMENT
/begin MEASUREMENT mi_um "Berechnetes Ist-Moment in der Funktions¸berwachung" UBYTE rel_ub_b99p6 1 100 0 99.6094 FORMAT "%5.2" ECU_ADDRESS 0x7F80A2 /end MEASUREMENT
/begin MEASUREMENT mi_ur "DA (Doppelablage)  f¸r MI_UM" UBYTE dez 1 100 0 255 FORMAT "%5.1" ECU_ADDRESS 0x7F81B9 /end MEASUREMENT
/begin MEASUREMENT mmsr_um "zul‰ssiger MSR-Momentenwunsch f¸r die Funktions¸berwachung" UBYTE rel_ub_q0p3906 1 100 0 99.6094 FORMAT "%5.2" ECU_ADDRESS 0x7F80A6 /end MEASUREMENT
/begin MEASUREMENT mmsr_ur "DA (Doppelablage)  f¸r MMSR_UM" UBYTE dez 1 100 0 255 FORMAT "%5.1" ECU_ADDRESS 0x7F81BC /end MEASUREMENT
/begin MEASUREMENT modul_c_um "Modulaufrufz‰hler f¸r Programm-Ablauf-Kontrolle (%URPAK)in der FU" UWORD dez 1 100 0 65535 FORMAT "%8.2" ECU_ADDRESS 0x8012CE /end MEASUREMENT
/begin MEASUREMENT mped_um "zul‰ssiges indiziertes Moment aus Fahrpedal in der Funktions¸berwachung" UBYTE rel_ub_b99p6 1 100 0 99.6094 FORMAT "%5.2" ECU_ADDRESS 0x7F81D4 /end MEASUREMENT
/begin MEASUREMENT msgs_um "Soll- Motormoment aus Getriebe¸berwachung in der Funktions¸berwachung" UBYTE rel_ub_q0p3906 1 100 0 99.6094 FORMAT "%5.2" ECU_ADDRESS 0x7F811E /end MEASUREMENT
/begin MEASUREMENT msgs_ur "Doppelablage (DA) f¸r MSGS_UM" UBYTE dez 1 100 0 255 FORMAT "%5.1" ECU_ADDRESS 0x7F8248 /end MEASUREMENT
/begin MEASUREMENT msrc_c_um "Fehlerz‰hler f¸r MSR-Eingriff-‹berwachung der Funktions¸berwachung" UBYTE t40ms_ub_b10200 1 100 0 10200 FORMAT "%7.1" ECU_ADDRESS 0x7F80A7 /end MEASUREMENT
/begin MEASUREMENT msrc_c_ur "Doppelablage (DA) f¸r MSRC_C_UM" UBYTE dez 1 100 0 255 FORMAT "%5.1" ECU_ADDRESS 0x7F81BD /end MEASUREMENT
/begin MEASUREMENT mver_c_um "Fehlerz‰hler f¸r Momentenvergleich der Funktions¸berwachung" UBYTE t40ms_ub_b10200 1 100 0 10200 FORMAT "%7.1" ECU_ADDRESS 0x7F80A9 /end MEASUREMENT
/begin MEASUREMENT mver_c_ur "Doppelablage (DA) f¸r MVER_C_UM" UBYTE dez 1 100 0 255 FORMAT "%5.1" ECU_ADDRESS 0x7F81BE /end MEASUREMENT
/begin MEASUREMENT mzfo_um "gefiltertes zul‰ssiges Moment inclusive Offset in der Funktions¸berwachung" UBYTE rel_ub_q0p3906 1 100 0 99.6094 FORMAT "%5.2" ECU_ADDRESS 0x7F81BF /end MEASUREMENT
/begin MEASUREMENT mzf_l_um "Nachkommastellen f¸r gefiltertes zul‰ssiges Moment der Funktions¸berwachung" UBYTE rel_ub_q0p00153 1 100 0 0.389074 ECU_ADDRESS 0x7F80AC /end MEASUREMENT
/begin MEASUREMENT mzf_l_ur "Doppelablage (DA) f¸r MZF_L_UM" UBYTE dez 1 100 0 255 FORMAT "%5.1" ECU_ADDRESS 0x7F81C4 /end MEASUREMENT
/begin MEASUREMENT mzf_p_um "Zeiger des Schieberegisters f¸r Verzugszeit mzf_r_um im Momentenfilter der FU" UBYTE dez 1 100 0 255 FORMAT "%5.1" ECU_ADDRESS 0x7F80AD /end MEASUREMENT
/begin MEASUREMENT mzf_p_ur "Doppelablage (DA) f¸r MZF_P_UM" UBYTE dez 1 100 0 255 FORMAT "%5.1" ECU_ADDRESS 0x7F81C5 /end MEASUREMENT
/begin MEASUREMENT mzf_r_um "Schieberegister f¸r Verzugszeit im Momentenfilter der Funktions¸berwachung" UBYTE rel_ub_q0p3906 1 100 0 99.6094 FORMAT "%5.2" ARRAY_SIZE 8 ECU_ADDRESS 0x7F80B0 /end MEASUREMENT
/begin MEASUREMENT mzf_r_ur "Doppelablage (DA) f¸r MZF_R_UM" UBYTE dez 1 100 0 255 FORMAT "%5.1" ARRAY_SIZE 8 ECU_ADDRESS 0x7F81C8 /end MEASUREMENT
/begin MEASUREMENT mzf_um "gefiltertes zul‰ssiges Moment der Funktions¸berwachung" UBYTE rel_ub_q0p3906 1 100 0 99.6094 FORMAT "%5.2" ECU_ADDRESS 0x7F80B8 /end MEASUREMENT
/begin MEASUREMENT mzf_ur "Doppelablage (DA) f¸r MZF_UM" UBYTE dez 1 100 0 255 FORMAT "%5.1" ECU_ADDRESS 0x7F81D0 /end MEASUREMENT
/begin MEASUREMENT mzo_um "Toleranz-Offset f¸rs zul‰ssige Moment in der Funktions¸berwachung" UBYTE rel_ub_b99p6 1 100 0 99.6094 FORMAT "%5.2" ECU_ADDRESS 0x7F80BC /end MEASUREMENT
/begin MEASUREMENT mzo_ur "Doppelablage (DA) f¸r MZO_UM" UBYTE dez 1 100 0 255 FORMAT "%5.1" ECU_ADDRESS 0x7F81D5 /end MEASUREMENT
/begin MEASUREMENT mz_um "resultierendes zul‰ssiges Moment aus der Koordination der Funktions¸berwachung" UBYTE rel_ub_b99p6 1 100 0 99.6094 FORMAT "%5.2" ECU_ADDRESS 0x7F80BD /end MEASUREMENT
/begin MEASUREMENT mz_ur "Doppelablage (DA) f¸r MZ_UM" UBYTE dez 1 100 0 255 FORMAT "%5.1" ECU_ADDRESS 0x7F81D6 /end MEASUREMENT
/begin MEASUREMENT nc_c_um "Fehlerz‰hler f¸r Motordrehzahlvergleich f¸r die Funktions¸berwachung" UBYTE t40ms_ub_b10200 1 100 0 10200 FORMAT "%7.1" ECU_ADDRESS 0x7F80C5 /end MEASUREMENT
/begin MEASUREMENT nc_c_ur "Doppelablage Fehlerz‰hler f¸r Motordrehzahlvergleich f¸r die Funktions¸berwachug" UBYTE dez 1 100 0 255 FORMAT "%5.1" ECU_ADDRESS 0x7F81DC /end MEASUREMENT
/begin MEASUREMENT newansw_um "Neue Antwort an das UM in der Funktions¸berwachung" ULONG dez 1 100 0 4.29497e+009 FORMAT "%13.2" ECU_ADDRESS 0x801CC8 /end MEASUREMENT
/begin MEASUREMENT newqr_ur "" UBYTE dez 1 100 0 255 FORMAT "%5.1" ECU_ADDRESS 0x7F8258 /end MEASUREMENT
/begin MEASUREMENT newque_um "Neue Frage vom UM, expandiert in der Funktions¸berwachung" ULONG dez 1 100 0 4.29497e+009 FORMAT "%13.2" ECU_ADDRESS 0x801CCC /end MEASUREMENT
/begin MEASUREMENT newqu_uc "" UBYTE dez 1 100 0 255 FORMAT "%5.1" ECU_ADDRESS 0x801094 /end MEASUREMENT
/begin MEASUREMENT newqu_um "Neue Frage vom UM in der Funktions¸berwachung" UBYTE dez 1 100 0 255 FORMAT "%5.1" ECU_ADDRESS 0x801090 /end MEASUREMENT
/begin MEASUREMENT nmot_um "Motordrehzahl in der Funktions¸berwachung" UBYTE nmot_ub_q40 1 100 0 10200 FORMAT "%5.0" ECU_ADDRESS 0x7F80C6 /end MEASUREMENT
/begin MEASUREMENT nmot_ur "Doppelablage Motordrehzahl in der Funktions¸berwachung" UBYTE dez 1 100 0 255 FORMAT "%5.1" ECU_ADDRESS 0x7F81DD /end MEASUREMENT
/begin MEASUREMENT nmst08_um "St¸tzstelle f¸r Motordrehzahl in der Funktions¸berwachung (NMOT_UM)" ULONG dez 1 100 0 4.29497e+009 FORMAT "%13.2" ECU_ADDRESS 0x7F80C8 /end MEASUREMENT
/begin MEASUREMENT nmst08_ur "Doppelablage der St¸tzstelle f¸r Motordrehzahl in der Funktions¸berwachung" ULONG dez 1 100 0 4.29497e+009 FORMAT "%13.2" ECU_ADDRESS 0x7F81E4 /end MEASUREMENT
/begin MEASUREMENT nsc_c_um "Nachstart-Zeitz‰hler Nachstartaufweitung der FU" UWORD t40msxs_uw_q0p04 1 100 0 2621.4 FORMAT "%8.3" ECU_ADDRESS 0x7F80D2 /end MEASUREMENT
/begin MEASUREMENT nsc_c_ur "Komplement:Nachstart¸berwachungszeitz‰hler f¸r die Funktions¸berwachung" UWORD dez 1 100 0 65535 FORMAT "%8.2" ECU_ADDRESS 0x7F81F2 /end MEASUREMENT
/begin MEASUREMENT nseg_um "Motordrehzahl aus Segmentzeit in der Funktions¸berwachung" UBYTE nmot_ub_q40 1 100 0 10200 FORMAT "%5.0" ECU_ADDRESS 0x7F81DE /end MEASUREMENT
/begin MEASUREMENT nska_um "Grenzdrehzahl bei aktiver Fehlerreaktion in der Funktions¸berwachung" UBYTE nmot_ub_q40 1 100 0 10200 FORMAT "%5.0" ECU_ADDRESS 0x7F81F4 /end MEASUREMENT
/begin MEASUREMENT nsof_c_um "Z‰hler Entprellzeit f¸r Abschaltung der Nachstartaufweitung" UBYTE t40ms_ub_b10200 1 100 0 10200 FORMAT "%7.1" ECU_ADDRESS 0x7F80D1 /end MEASUREMENT
/begin MEASUREMENT nsof_c_ur "Komplement:Z‰hler Entprellzeit F¸r Abschaltung Nachstartaufweitung" UBYTE dez 1 100 0 255 FORMAT "%5.1" ECU_ADDRESS 0x7F81F0 /end MEASUREMENT
/begin MEASUREMENT nwrda_w "Nockenwellenregler D-Anteil Auslaﬂ" SWORD relKW_q0p0015259 1 100 -50 49.9985 FORMAT "%8.5" ECU_ADDRESS 0x80158C /end MEASUREMENT
/begin MEASUREMENT nwrde_w "Nockenwellenregler D-Anteil Einlaﬂ" SWORD relKW_q0p0015259 1 100 -50 49.9985 FORMAT "%8.5" ECU_ADDRESS 0x8015C0 /end MEASUREMENT
/begin MEASUREMENT nwria_w "Nockenwellenregler I-Anteil Auslaﬂ" SWORD relKW_q0p0015259 1 100 -50 49.9985 FORMAT "%8.5" ECU_ADDRESS 0x80158E /end MEASUREMENT
/begin MEASUREMENT nwrie_w "Nockenwellenregler I-Anteil Einlaﬂ" SWORD relKW_q0p0015259 1 100 -50 49.9985 FORMAT "%8.5" ECU_ADDRESS 0x8015C2 /end MEASUREMENT
/begin MEASUREMENT nwrpa_w "Nockenwellenregler P-Anteil Auslaﬂ" SWORD relKW_q0p0015259 1 100 -50 49.9985 FORMAT "%8.5" ECU_ADDRESS 0x801590 /end MEASUREMENT
/begin MEASUREMENT nwrpe_w "Nockenwellenregler P-Anteil Einlaﬂ" SWORD relKW_q0p0015259 1 100 -50 49.9985 FORMAT "%8.5" ECU_ADDRESS 0x8015C4 /end MEASUREMENT
/begin MEASUREMENT nxtrp_ur "" UBYTE dez 1 100 0 255 FORMAT "%5.1" ECU_ADDRESS 0x7F8259 /end MEASUREMENT
/begin MEASUREMENT nzwst08_um "" ULONG dez 1 100 0 4.29497e+009 FORMAT "%13.2" ECU_ADDRESS 0x7F80CC /end MEASUREMENT
/begin MEASUREMENT nzwst08_ur "" ULONG dez 1 100 0 4.29497e+009 FORMAT "%13.2" ECU_ADDRESS 0x7F81E8 /end MEASUREMENT
/begin MEASUREMENT nz_um "Motordrehzahl aus Zahnz‰hlerdifferenz pro Zeit in der Funktions¸berwachung" UBYTE t40ms_ub_b10200 1 100 0 10200 FORMAT "%7.1" ECU_ADDRESS 0x7F8269 /end MEASUREMENT
/begin MEASUREMENT n_flags_um "Byte f¸r Nachstart-Bits der Funktions¸berwachung" UBYTE dez 1 100 0 255 FORMAT "%5.1" ECU_ADDRESS 0x7F812A /end MEASUREMENT
/begin MEASUREMENT offz_w "Offenzeit Funkenpakete Funkenbandz¸ndung" UWORD t_q0p001_ms 1 100 0 65.535 FORMAT "%8.5" ECU_ADDRESS 0x8017AC /end MEASUREMENT
/begin MEASUREMENT plstate_um "Zustand zur Plausibilisierung des UM in der Funktions¸berwachung" UBYTE dez 1 100 0 255 FORMAT "%5.1" ECU_ADDRESS 0x801091 /end MEASUREMENT
/begin MEASUREMENT plstate_ur "" UBYTE dez 1 100 0 255 FORMAT "%5.1" ECU_ADDRESS 0x7F825A /end MEASUREMENT
/begin MEASUREMENT ram_c_um "Fehlerz‰hler im Dauer-RAM f¸r RAM-Konsistenz-Pr¸fung (Diagnose) in der Fkt-‹berw" UBYTE dez 1 100 0 255 FORMAT "%5.1" ECU_ADDRESS 0x7FC2CC /end MEASUREMENT
/begin MEASUREMENT ram_ur "" UBYTE dez 1 100 0 255 FORMAT "%5.1" ECU_ADDRESS 0x7FC2EB /end MEASUREMENT
/begin MEASUREMENT raster_um "Allgemeiner Z‰hler des 10ms Raster der Funktions¸berwachung" ULONG dez 1 100 0 4.29497e+009 FORMAT "%13.2" ECU_ADDRESS 0x801CC4 /end MEASUREMENT
/begin MEASUREMENT reac_c1_um "Fehlerz‰hler 1 f¸r Fehlerreaktions¸berwachung in Funktions¸berwachung" UBYTE t40ms_ub_b10200 1 100 0 10200 FORMAT "%7.1" ECU_ADDRESS 0x7F80D5 /end MEASUREMENT
/begin MEASUREMENT reac_c1_ur "Doppelablage (DA) f¸r REAC_C1_UM" UBYTE dez 1 100 0 255 FORMAT "%5.1" ECU_ADDRESS 0x7F81F5 /end MEASUREMENT
/begin MEASUREMENT reac_c2_um "Fehlerz‰hler 2 f¸r Fehlerreaktions¸berwachung in Funktions¸berwachung" UBYTE t40ms_ub_b10200 1 100 0 10200 FORMAT "%7.1" ECU_ADDRESS 0x7F80D6 /end MEASUREMENT
/begin MEASUREMENT reac_c2_ur "Doppelablage (DA) f¸r REAC_C2_UM" UBYTE dez 1 100 0 255 FORMAT "%5.1" ECU_ADDRESS 0x7F81F6 /end MEASUREMENT
/begin MEASUREMENT reac_c_um "Fehlerz‰hler im Dauer-RAM f¸r Fehlerreaktions¸berwachung (Diagnose) in der FU" UBYTE dez 1 100 0 255 FORMAT "%5.1" ECU_ADDRESS 0x7FC2CD /end MEASUREMENT
/begin MEASUREMENT reset_indication_um "" UWORD dez 1 100 0 65535 FORMAT "%8.2" ECU_ADDRESS 0x7FC2D2 /end MEASUREMENT
/begin MEASUREMENT rlc_c_um "Fehlerz‰hler f¸r rl-Vergleich mit der Funktion in der Funktions¸berwachung" UBYTE t40ms_ub_b10200 1 100 0 10200 FORMAT "%7.1" ECU_ADDRESS 0x7F80F4 /end MEASUREMENT
/begin MEASUREMENT rlc_c_ur "Doppelablage Fehlerz‰hler f¸r rl-Vergleich mit der Funktion in der FU" UBYTE dez 1 100 0 255 FORMAT "%5.1" ECU_ADDRESS 0x7F8211 /end MEASUREMENT
/begin MEASUREMENT rldf_l_um "Nachkommastellen des rld-Filterwertes" UBYTE rel_ub_q0p0029 1 100 0 0.74707 ECU_ADDRESS 0x7F80F5 /end MEASUREMENT
/begin MEASUREMENT rldf_l_ur "DA rldf_l_um" UBYTE dez 1 100 0 255 FORMAT "%5.1" ECU_ADDRESS 0x7F8212 /end MEASUREMENT
/begin MEASUREMENT rldf_p_um "" UBYTE dez 1 100 0 255 FORMAT "%5.1" ECU_ADDRESS 0x7F80F6 /end MEASUREMENT
/begin MEASUREMENT rldf_p_ur "" UBYTE dez 1 100 0 255 FORMAT "%5.1" ECU_ADDRESS 0x7F8213 /end MEASUREMENT
/begin MEASUREMENT rldf_r_um "" UBYTE rel_ub_q0p75 1 100 0 191.25 FORMAT "%5.1" ARRAY_SIZE 8 ECU_ADDRESS 0x7F80F8 /end MEASUREMENT
/begin MEASUREMENT rldf_r_ur "" UBYTE dez 1 100 0 255 FORMAT "%5.1" ARRAY_SIZE 8 ECU_ADDRESS 0x7F8214 /end MEASUREMENT
/begin MEASUREMENT rldf_um "Relative Luftf¸llung aus Drosselinformation nach Tiefpaﬂfilter" UBYTE rel_ub_q0p75 1 100 0 191.25 FORMAT "%5.1" ECU_ADDRESS 0x7F8100 /end MEASUREMENT
/begin MEASUREMENT rldf_ur "DA rldf_um" UBYTE dez 1 100 0 255 FORMAT "%5.1" ECU_ADDRESS 0x7F821C /end MEASUREMENT
/begin MEASUREMENT rldif_um "Differenz zwischen zul‰ssigem rl und Ist-rl in der Funktions¸berwachung" SWORD rel_ub_q0p75 1 100 -24576 24575.3 FORMAT "%8.2" ECU_ADDRESS 0x7F8240 /end MEASUREMENT
/begin MEASUREMENT rldpf_l_um "rel. Luftf¸llung aus DK- und Druckinfo hinter Tiefpaﬂ (Low-Byte)" UBYTE rel_ub_q0p0029 1 100 0 0.74707 ECU_ADDRESS 0x7F8101 /end MEASUREMENT
/begin MEASUREMENT rldpf_l_ur "Doppelablage: rel. Luftf¸llung aus DK- und Druckinfo hinter Tiefpaﬂ (Low-Byte)" UBYTE dez 1 100 0 255 FORMAT "%5.1" ECU_ADDRESS 0x7F821D /end MEASUREMENT
/begin MEASUREMENT rldpf_p_um "" UBYTE dez 1 100 0 255 FORMAT "%5.1" ECU_ADDRESS 0x7F8102 /end MEASUREMENT
/begin MEASUREMENT rldpf_p_ur "" UBYTE dez 1 100 0 255 FORMAT "%5.1" ECU_ADDRESS 0x7F821E /end MEASUREMENT
/begin MEASUREMENT rldpf_r_um "" UBYTE rel_ub_q0p75 1 100 0 191.25 FORMAT "%5.1" ARRAY_SIZE 8 ECU_ADDRESS 0x7F8104 /end MEASUREMENT
/begin MEASUREMENT rldpf_r_ur "" UBYTE dez 1 100 0 255 FORMAT "%5.1" ARRAY_SIZE 8 ECU_ADDRESS 0x7F8220 /end MEASUREMENT
/begin MEASUREMENT rldpf_um "rel. Luftf¸llung aus DK- und Druckinfo hinter Tiefpaﬂ" UBYTE rel_ub_q0p75 1 100 0 191.25 FORMAT "%5.1" ECU_ADDRESS 0x7F810C /end MEASUREMENT
/begin MEASUREMENT rldpf_ur "Doppelablage: rel. Luftf¸llung aus DK- und Druckinfo hinter Tiefpaﬂ" UBYTE dez 1 100 0 255 FORMAT "%5.1" ECU_ADDRESS 0x7F8228 /end MEASUREMENT
/begin MEASUREMENT rldpzo_um "" UBYTE rel_ub_q0p75 1 100 0 191.25 FORMAT "%5.1" ECU_ADDRESS 0x7F8229 /end MEASUREMENT
/begin MEASUREMENT rldp_um "rel. Luftf¸llung aus DK- und Druckinfo" UBYTE rel_ub_q0p75 1 100 0 191.25 FORMAT "%5.1" ECU_ADDRESS 0x7F822A /end MEASUREMENT
/begin MEASUREMENT rld_um "Relative Luftf¸llung aus Drosselinformation in der Funktions¸berwachung" UBYTE rel_ub_q0p75 1 100 0 191.25 FORMAT "%5.1" ECU_ADDRESS 0x7F822B /end MEASUREMENT
/begin MEASUREMENT rlip_c_um "Fehlerz‰hler f¸r rl/rlip-Vergleich in der Funktions¸berwachung" UBYTE t40ms_ub_b10200 1 100 0 10200 FORMAT "%7.1" ECU_ADDRESS 0x7F810D /end MEASUREMENT
/begin MEASUREMENT rlip_c_ur "Doppelablage Fehlerz‰hler f¸r rl/rlip-Vergleich in der Funktions¸berwachung" UBYTE dez 1 100 0 255 FORMAT "%5.1" ECU_ADDRESS 0x7F822C /end MEASUREMENT
/begin MEASUREMENT rlnmo_um "Gewichtete Last in Bezug auf obere Drehzahlschwelle" UWORD rel_uw_q0p75 1 100 0 49151.3 FORMAT "%8.2" ECU_ADDRESS 0x7F8242 /end MEASUREMENT
/begin MEASUREMENT rlnmu_um "Gewichtete Last in Bezug auf untere Drehzahlschwelle" UWORD rel_uw_q0p75 1 100 0 49151.3 FORMAT "%8.2" ECU_ADDRESS 0x7F8244 /end MEASUREMENT
/begin MEASUREMENT rlst08_um "St¸tzstelle der SSV RLV08_UM" ULONG dez 1 100 0 4.29497e+009 FORMAT "%13.2" ECU_ADDRESS 0x7F8118 /end MEASUREMENT
/begin MEASUREMENT rlst08_ur "Doppelablage von rlst08_um" ULONG dez 1 100 0 4.29497e+009 FORMAT "%13.2" ECU_ADDRESS 0x7F823C /end MEASUREMENT
/begin MEASUREMENT rlvvtzo_um "Obere Toleranzgerade f¸r VVT" UBYTE rel_ub_q0p75 1 100 0 191.25 FORMAT "%5.1" ECU_ADDRESS 0x7F822D /end MEASUREMENT
/begin MEASUREMENT rlvvt_um "relative Luftf¸llung aus VVT-Stellung und Drehzahl" UBYTE rel_ub_q0p75 1 100 0 191.25 FORMAT "%5.1" ECU_ADDRESS 0x7F822E /end MEASUREMENT
/begin MEASUREMENT rlzo_um "obere Toleranzgrenze f¸r rl aus Nebenlastsignal in der Funktions¸berwachung" UBYTE rel_ub_q0p75 1 100 0 191.25 FORMAT "%5.1" ECU_ADDRESS 0x7F822F /end MEASUREMENT
/begin MEASUREMENT rl_um "relative Luftf¸llung in der Funktions¸berwachung" UBYTE rel_ub_q0p75 1 100 0 191.25 FORMAT "%5.1" ECU_ADDRESS 0x7F810E /end MEASUREMENT
/begin MEASUREMENT rl_ur "Doppelablage relative Luftf¸llung in der Funktions¸berwachung" UBYTE dez 1 100 0 255 FORMAT "%5.1" ECU_ADDRESS 0x7F8230 /end MEASUREMENT
/begin MEASUREMENT rl_w_um "relative Luftf¸llung (Word) in der Funktions¸berwachung" UWORD rel_uw_q0p0234 1 100 0 1535.98 FORMAT "%8.3" ECU_ADDRESS 0x7F8246 /end MEASUREMENT
/begin MEASUREMENT rom1_ur "" UBYTE dez 1 100 0 255 FORMAT "%5.1" ECU_ADDRESS 0x7FC2EE /end MEASUREMENT
/begin MEASUREMENT rompage_um "Adresse im DauerRAM der einzelnen fehlerhaften ROM-Page  in der Fkt.¸berw." UBYTE dez 1 100 0 255 FORMAT "%5.1" ECU_ADDRESS 0x7FC2EF /end MEASUREMENT
/begin MEASUREMENT rompage_ur "" UBYTE dez 1 100 0 255 FORMAT "%5.1" ECU_ADDRESS 0x7FC2F0 /end MEASUREMENT
/begin MEASUREMENT romrstc_um "Z‰hler im DauerRAM f¸r Resets bei ROM-Check-Fehler in der Init. in der FU" UBYTE dez 1 100 0 255 FORMAT "%5.1" ECU_ADDRESS 0x7FC2F1 /end MEASUREMENT
/begin MEASUREMENT romx_ur "" UBYTE dez 1 100 0 255 FORMAT "%5.1" ECU_ADDRESS 0x7FC2F2 /end MEASUREMENT
/begin MEASUREMENT romz_c_um "Fehlerz‰hler im Dauer-RAM f¸r ROM-Pr¸fung (Diagnose) in der Funktions¸berwachung" UBYTE dez 1 100 0 255 FORMAT "%5.1" ECU_ADDRESS 0x7FC2CE /end MEASUREMENT
/begin MEASUREMENT r_flags_um "Byte f¸r Fehlerreaktions-Bits der Funktions¸berwachung" UBYTE dez 1 100 0 255 FORMAT "%5.1" ECU_ADDRESS 0x7F812B /end MEASUREMENT
/begin MEASUREMENT sgsc_c_um "Fehlerz‰hler f¸r Getriebe¸berwachung der Funktions¸berwachung" UBYTE t40ms_ub_b10200 1 100 0 10200 FORMAT "%7.1" ECU_ADDRESS 0x7F811F /end MEASUREMENT
/begin MEASUREMENT sgsc_c_ur "Doppelablage Fehlerz‰hler f¸r Momentenvergleich der Funktions¸berwachung" UBYTE dez 1 100 0 255 FORMAT "%5.1" ECU_ADDRESS 0x7F8249 /end MEASUREMENT
/begin MEASUREMENT skapfad "SKA-Pfad als Umweltbedingung f¸r Funktions¸berwachungs-Diagnoseeintrag" UBYTE dez 1 100 0 255 FORMAT "%5.1" ECU_ADDRESS 0x80108E /end MEASUREMENT
/begin MEASUREMENT sp1s_um "aktueller Wert f¸r Sollwert-Poti 1 (PWG) f¸r die Funktions¸berwachung" UBYTE spg_ub_q0p019 1 100 0 4.98047 FORMAT "%5.3" ECU_ADDRESS 0x7F824C /end MEASUREMENT
/begin MEASUREMENT sp2s_um "aktueller Wert f¸r Sollwert-Poti 2 (PWG) f¸r die Funktions¸berwachung" UBYTE spg_ub_q0p0098 1 100 0 2.49023 FORMAT "%5.3" ECU_ADDRESS 0x7F824D /end MEASUREMENT
/begin MEASUREMENT spnst08_um "St¸tzstelle f¸r aktive Sollwertpoti-Info (SPSN_UM) in FU" ULONG dez 1 100 0 4.29497e+009 FORMAT "%13.2" ECU_ADDRESS 0x7F8124 /end MEASUREMENT
/begin MEASUREMENT spnst08_ur "Doppelablage der St¸tzstelle f¸r aktive Sollwertpoti-Info in FU" ULONG dez 1 100 0 4.29497e+009 FORMAT "%13.2" ECU_ADDRESS 0x7F8250 /end MEASUREMENT
/begin MEASUREMENT spsc_c_um "Fehlerz‰hler bei zueinander unplausiblen Sollwerten in der Funktions¸berwachung" UBYTE t40ms_ub_b10200 1 100 0 10200 FORMAT "%7.1" ECU_ADDRESS 0x7F8122 /end MEASUREMENT
/begin MEASUREMENT spsc_c_ur "Doppelablage (DA) f¸r SPSC_C_UM" UBYTE dez 1 100 0 255 FORMAT "%5.1" ECU_ADDRESS 0x7F824E /end MEASUREMENT
/begin MEASUREMENT spsn_um "Pedalsollwert (8 Bit) in der Funktions¸berwachung" UBYTE spg_ub_q0p019 1 100 0 4.98047 FORMAT "%5.3" ECU_ADDRESS 0x7F8123 /end MEASUREMENT
/begin MEASUREMENT spsn_ur "Doppelablage (DA) f¸r SPSN_UM" UBYTE dez 1 100 0 255 FORMAT "%5.1" ECU_ADDRESS 0x7F824F /end MEASUREMENT
/begin MEASUREMENT srst_c_um "Z‰hler im Dauer-RAM f¸r Software-Reset (Diagnose) aus der Funktions¸berwachung" UBYTE dez 1 100 0 255 FORMAT "%5.1" ECU_ADDRESS 0x7FC2CF /end MEASUREMENT
/begin MEASUREMENT szfuba_w "Schlieﬂzeit Funkenband" UWORD t_q0p001_ms 1 100 0 65.535 FORMAT "%8.5" ECU_ADDRESS 0x8017AE /end MEASUREMENT
/begin MEASUREMENT szout_w "Schlieﬂzeitausgabe" UWORD t_q0p001_ms 1 100 0 65.535 FORMAT "%8.5" ECU_ADDRESS 0x8017B0 /end MEASUREMENT
/begin MEASUREMENT s_flags_um "Byte f¸r Status-Bits der Funktions¸berwachung" UBYTE dez 1 100 0 255 FORMAT "%5.1" ECU_ADDRESS 0x7F812C /end MEASUREMENT
/begin MEASUREMENT tanwda2_w "Tastverh‰ltnis D-Anteil NW- Lageregler Auslaﬂ 2" SWORD rel_sw_b200 1 100 -200 199.994 FORMAT "%8.4" ECU_ADDRESS 0x801592 /end MEASUREMENT
/begin MEASUREMENT tanwda_w "Tastverh‰ltnis D-Anteil NW- Lageregler Auslaﬂ" SWORD rel_sw_b200 1 100 -200 199.994 FORMAT "%8.4" ECU_ADDRESS 0x801594 /end MEASUREMENT
/begin MEASUREMENT tanwde2_w "Tastverh‰ltnis D-Anteil NW- Lageregler Einlaﬂ 2" SWORD rel_sw_b200 1 100 -200 199.994 FORMAT "%8.4" ECU_ADDRESS 0x8015C6 /end MEASUREMENT
/begin MEASUREMENT tanwde_w "Tastverh‰ltnis D-Anteil NW- Lageregler Einlaﬂ" SWORD rel_sw_b200 1 100 -200 199.994 FORMAT "%8.4" ECU_ADDRESS 0x8015C8 /end MEASUREMENT
/begin MEASUREMENT tanwia2_w "I-Anteil des Tastverh‰ltnisses NW-Regler Auslass Bank2 (Word)" SWORD rel_sw_b200 1 100 -200 199.994 FORMAT "%8.4" ECU_ADDRESS 0x801596 /end MEASUREMENT
/begin MEASUREMENT tanwia_w "I-Anteil des Tastverh‰ltnisses NW-Regler Auslass (Word)" SWORD rel_sw_b200 1 100 -200 199.994 FORMAT "%8.4" ECU_ADDRESS 0x801598 /end MEASUREMENT
/begin MEASUREMENT tanwie2_w "I-Anteil des Tastverh‰ltnisses NW-Regler Einlass Bank2 (Word)" SWORD rel_sw_b200 1 100 -200 199.994 FORMAT "%8.4" ECU_ADDRESS 0x8015CA /end MEASUREMENT
/begin MEASUREMENT tanwie_w "I-Anteil des Tastverh‰ltnisses NW-Regler Einlass (Word)" SWORD rel_sw_b200 1 100 -200 199.994 FORMAT "%8.4" ECU_ADDRESS 0x8015CC /end MEASUREMENT
/begin MEASUREMENT tanwita_w "Haltetastverh‰ltnis Vorsteuerwert Nockenwellenregler Auslaﬂ" SWORD rel_sw_b200 1 100 -200 199.994 FORMAT "%8.4" ECU_ADDRESS 0x80159A /end MEASUREMENT
/begin MEASUREMENT tanwite_w "Haltetastverh‰ltnis Vorsteuerwert Nockenwellenregler Einlaﬂ" SWORD rel_sw_b200 1 100 -200 199.994 FORMAT "%8.4" ECU_ADDRESS 0x8015CE /end MEASUREMENT
/begin MEASUREMENT tanwlia2_w "langsamer I-Anteil des Tastverh‰ltnisses NW-Regler Auslass Bank2 (Word)" SWORD rel_sw_b200 1 100 -200 199.994 FORMAT "%8.4" ECU_ADDRESS 0x80159C /end MEASUREMENT
/begin MEASUREMENT tanwlia_w "langsamer I-Anteil des Tastverh‰ltnisses NW-Regler Auslass (Word)" SWORD rel_sw_b200 1 100 -200 199.994 FORMAT "%8.4" ECU_ADDRESS 0x80159E /end MEASUREMENT
/begin MEASUREMENT tanwlie2_w "langsamer I-Anteil des Tastverh‰ltnisses NW-Regler Einlass Bank2 (Word)" SWORD rel_sw_b200 1 100 -200 199.994 FORMAT "%8.4" ECU_ADDRESS 0x8015D0 /end MEASUREMENT
/begin MEASUREMENT tanwlie_w "langsamer I-Anteil des Tastverh‰ltnisses NW-Regler Einlass (Word)" SWORD rel_sw_b200 1 100 -200 199.994 FORMAT "%8.4" ECU_ADDRESS 0x8015D2 /end MEASUREMENT
/begin MEASUREMENT tanwnka2_w "unkorrigiertes Tastverh‰ltnis Nockenwellenregelung Auslaﬂ(Bank 2)" UWORD tv_uw_b100 1 100 0 100 FORMAT "%8.4" ECU_ADDRESS 0x8015A0 /end MEASUREMENT
/begin MEASUREMENT tanwnka_w "unkorrigiertes Tastverh‰ltnis Nockenwellenregelung Auslaﬂ" UWORD tv_uw_b100 1 100 0 100 FORMAT "%8.4" ECU_ADDRESS 0x8015A2 /end MEASUREMENT
/begin MEASUREMENT tanwnke2_w "unkorrigiertes Tastverh‰ltnis Nockenwellenregelung Einlaﬂ(Bank 2)" UWORD tv_uw_b100 1 100 0 100 FORMAT "%8.4" ECU_ADDRESS 0x8015D4 /end MEASUREMENT
/begin MEASUREMENT tanwnke_w "unkorrigiertes Tastverh‰ltnis Nockenwellenregelung Einlaﬂ" UWORD tv_uw_b100 1 100 0 100 FORMAT "%8.4" ECU_ADDRESS 0x8015D6 /end MEASUREMENT
/begin MEASUREMENT tanwpa2_w "Tastverh‰ltnis f¸r Auslaﬂ-NW-Verstellung P-Anteil (word)" SWORD rel_sw_b200 1 100 -200 199.994 FORMAT "%8.4" ECU_ADDRESS 0x8015A4 /end MEASUREMENT
/begin MEASUREMENT tanwpa_w "Tastverh‰ltnis f¸r Auslaﬂ-NW-Verstellung P-Anteil (word)" SWORD rel_sw_b200 1 100 -200 199.994 FORMAT "%8.4" ECU_ADDRESS 0x8015A6 /end MEASUREMENT
/begin MEASUREMENT tanwpe2_w "Tastverh‰ltnis f¸r NW-Verstellung P-Anteil Einlaﬂ 2(word)" SWORD rel_sw_b200 1 100 -200 199.994 FORMAT "%8.4" ECU_ADDRESS 0x8015D8 /end MEASUREMENT
/begin MEASUREMENT tanwpe_w "Tatverh‰ltnis f¸r Einlaﬂ-NW-Verstellung P-Anteil (word)" SWORD rel_sw_b200 1 100 -200 199.994 FORMAT "%8.4" ECU_ADDRESS 0x8015DA /end MEASUREMENT
/begin MEASUREMENT tanwra2_w "Unkorrigiertes Tastverh‰ltnis Nockenwellenregelung Auslaﬂ Bank 2 (word)" UWORD tv_uw_b100 1 100 0 100 FORMAT "%8.4" ECU_ADDRESS 0x8015A8 /end MEASUREMENT
/begin MEASUREMENT tanwraa2_w "Tastverh‰ltnis Auslaﬂnockenwellenregelung 2 Ansteuerung Endstufe(word)" UWORD tv_uw_b100 1 100 0 100 FORMAT "%8.4" ECU_ADDRESS 0x8015AA /end MEASUREMENT
/begin MEASUREMENT tanwraa_w "Tastverh‰ltnis Auslaﬂnockenwellenregelung Ansteuerung Endstufe(word)" UWORD tv_uw_b100 1 100 0 100 FORMAT "%8.4" ECU_ADDRESS 0x8015AC /end MEASUREMENT
/begin MEASUREMENT tanwra_w "Tastverh‰ltnis Nockenwellenregelung Auslaﬂ" UWORD tv_uw_b100 1 100 0 100 FORMAT "%8.4" ECU_ADDRESS 0x8015AE /end MEASUREMENT
/begin MEASUREMENT tanwre2_w "Tastverh‰ltnis Einlaﬂnockenwellenregelung Bank2" UWORD tv_uw_b100 1 100 0 100 FORMAT "%8.4" ECU_ADDRESS 0x8015DC /end MEASUREMENT
/begin MEASUREMENT tanwree2_w "Tastverh‰ltnis Einlaﬂnockenwellenregelung 2 Ansteuerung Endstufe(word)" UWORD tv_uw_b100 1 100 0 100 FORMAT "%8.4" ECU_ADDRESS 0x8015DE /end MEASUREMENT
/begin MEASUREMENT tanwree_w "Tastverh‰ltnis Einlaﬂnockenwellenregelung Ansteuerung Endstufe(word)" UWORD tv_uw_b100 1 100 0 100 FORMAT "%8.4" ECU_ADDRESS 0x8015E0 /end MEASUREMENT
/begin MEASUREMENT tanwre_w "Tastverh‰ltnis Nockenwellenregelung Einlaﬂ" UWORD tv_uw_b100 1 100 0 100 FORMAT "%8.4" ECU_ADDRESS 0x8015E2 /end MEASUREMENT
/begin MEASUREMENT tanwsia2_w "schneller I-Anteil des Tastverh‰ltnisses NW-Regler Auslass (Bank 2)" SWORD rel_sw_b200 1 100 -200 199.994 FORMAT "%8.4" ECU_ADDRESS 0x8015B0 /end MEASUREMENT
/begin MEASUREMENT tanwsia_w "schneller I-Anteil des Tastverh‰ltnisses NW-Regler Auslass (Word)" SWORD rel_sw_b200 1 100 -200 199.994 FORMAT "%8.4" ECU_ADDRESS 0x8015B2 /end MEASUREMENT
/begin MEASUREMENT tanwsie2_w "schneller I-Anteil des Tastverh‰ltnisses NW-Regler Einlass (Bank 2)" SWORD rel_sw_b200 1 100 -200 199.994 FORMAT "%8.4" ECU_ADDRESS 0x8015E4 /end MEASUREMENT
/begin MEASUREMENT tanwsie_w "schneller I-Anteil des Tastverh‰ltnisses NW-Regler Einlass (Word)" SWORD rel_sw_b200 1 100 -200 199.994 FORMAT "%8.4" ECU_ADDRESS 0x8015E6 /end MEASUREMENT
/begin MEASUREMENT tc72alt_um "System-Timerwert zum vorhergehen Berechnungszeitpunkt des 720∞ Zahnz‰hlers in FU" ULONG txms_uw_q0p0004 1 100 0 1.71799e+006 FORMAT "%13.5" ECU_ADDRESS 0x7F8184 /end MEASUREMENT
/begin MEASUREMENT tc72alt_ur "Doppelablage (DA) f¸rTC72ALT_UM" ULONG dez 1 100 0 4.29497e+009 FORMAT "%13.2" ECU_ADDRESS 0x7F8270 /end MEASUREMENT
/begin MEASUREMENT tdifs1_um "Summe der Zeitdifferenzen zwischen der TPU- und der CPU-Segmentzeit in der FU" SLONG txms_uw_q0p0004 1 100 -858993 858993 FORMAT "%13.6" ECU_ADDRESS 0x7F8274 /end MEASUREMENT
/begin MEASUREMENT tdifs1_ur "Doppelablagebyte f¸r tdifs1_um in der Funktions¸berwachung" SLONG dez 1 100 -2.14748e+009 2.14748e+009 FORMAT "%13.2" ECU_ADDRESS 0x7F8278 /end MEASUREMENT
/begin MEASUREMENT tfwdksom_w "Zeitkonstante f¸r Filterung Drosselklappenwinkel ohne Momentenstruktur" UWORD zk10msxs_uw_b655 1 100 0.0100002 655.36 FORMAT "%10.6" ECU_ADDRESS 0x801400 /end MEASUREMENT
/begin MEASUREMENT tpuca_c_um "Z‰hler f¸r TPU-Pr¸fung aktiv in der Funktions¸berwachung" UBYTE t10ms_ub_b2550 1 100 0 2550 ECU_ADDRESS 0x7F817E /end MEASUREMENT
/begin MEASUREMENT tpuca_c_ur "Doppelablagebyte f¸r tpuca_c_um in der Funktions¸berwachung" UBYTE dez 1 100 0 255 FORMAT "%5.1" ECU_ADDRESS 0x7F826A /end MEASUREMENT
/begin MEASUREMENT tpucr_c_um "Fehlerz‰hler des TPU-Code-RAM-Tests in der Funktions¸berwachung" UBYTE dez 1 100 0 255 FORMAT "%5.1" ECU_ADDRESS 0x7F817F /end MEASUREMENT
/begin MEASUREMENT tpucr_c_ur "Doppelablagebyte f¸r tpucr_c_um in der Funktions¸berwachung" UBYTE dez 1 100 0 255 FORMAT "%5.1" ECU_ADDRESS 0x7F826B /end MEASUREMENT
/begin MEASUREMENT tpura_c_um "Z‰hler f¸r TPU-Code-RAM-Test aktiv in der Funktions¸berwachung" UBYTE t10ms_ub_b2550 1 100 0 2550 ECU_ADDRESS 0x7F8180 /end MEASUREMENT
/begin MEASUREMENT tpura_c_ur "Doppelablagebyte f¸r tpura_c_um in der Funktions¸berwachung" UBYTE dez 1 100 0 255 FORMAT "%5.1" ECU_ADDRESS 0x7F826C /end MEASUREMENT
/begin MEASUREMENT tpurstc_um "Z‰hler im DauerRAM f¸r Resets aus der TPU-‹berwachung" UBYTE dez 1 100 0 255 FORMAT "%5.1" ECU_ADDRESS 0x7FC2F3 /end MEASUREMENT
/begin MEASUREMENT tpu_c_um "Fehlerz‰hler der TPU-‹berwachung in der Funktions¸berwachung" UBYTE dez 1 100 0 255 FORMAT "%5.1" ECU_ADDRESS 0x7F8181 /end MEASUREMENT
/begin MEASUREMENT tpu_c_ur "Doppelablagebyte f¸r tpu_c_um in der Funktions¸berwachung" UBYTE dez 1 100 0 255 FORMAT "%5.1" ECU_ADDRESS 0x7F826D /end MEASUREMENT
/begin MEASUREMENT tseg_um "Segmentzeit aus Differenz der Timerst‰nde aus dem Sync in der FU" ULONG txms_uw_q0p0004 1 100 0 1.71799e+006 FORMAT "%13.5" ECU_ADDRESS 0x7F81EC /end MEASUREMENT
/begin MEASUREMENT tsm_alt_um "Timerwert des Sys.timers an vorhergeher Synchronmarke aus Sync-Raster in der FU" ULONG txms_uw_q0p0004 1 100 0 1.71799e+006 FORMAT "%13.5" ECU_ADDRESS 0x7F827C /end MEASUREMENT
/begin MEASUREMENT tsm_um "Timerwert des Systemtimers an Synchronmarke aus Sync-Raster in der FU" ULONG txms_uw_q0p0004 1 100 0 1.71799e+006 FORMAT "%13.5" ECU_ADDRESS 0x7F8280 /end MEASUREMENT
/begin MEASUREMENT tzwmnnst_w "Zeitkonstante f¸r Abregelrampe sp‰tester Z¸ndwinkle" UWORD zk10msxs_uw_b655 1 100 0.0100002 655.36 FORMAT "%10.6" ECU_ADDRESS 0x8017B4 /end MEASUREMENT
/begin MEASUREMENT t_flags_um "Byte f¸r Tempomat-Bits der Funktions¸berwachung" UBYTE dez 1 100 0 255 FORMAT "%5.1" ECU_ADDRESS 0x7F812D /end MEASUREMENT
/begin MEASUREMENT umerr_c_um "Fehlerz‰hler-R¸ckmeldung des UM in der Funktions¸berwachung" UBYTE dez 1 100 0 255 FORMAT "%5.1" ECU_ADDRESS 0x801092 /end MEASUREMENT
/begin MEASUREMENT umrst_c_um "Z‰hler im Dauer-RAM f¸r Software-Reset (Diagnose) aus %UMKOM" UBYTE dez 1 100 0 255 FORMAT "%5.1" ECU_ADDRESS 0x7FC2D0 /end MEASUREMENT
/begin MEASUREMENT upwg2_um "Spannung PWG-Poti2 im ADC-Test in der Funktions¸berwachung" UWORD spg_q0p00977 1 100 0 639.99 FORMAT "%8.4" ECU_ADDRESS 0x7F8260 /end MEASUREMENT
/begin MEASUREMENT urmcksco "Checksumme ¸ber Code der Funktions¸berwachung im zyklischen ROM-Test" UWORD dez 1 100 0 65535 FORMAT "%8.2" ARRAY_SIZE 2 ECU_ADDRESS 0x7FC2E2 /end MEASUREMENT
/begin MEASUREMENT urmcksda "Checksumme ¸ber Daten der Funktions¸berwachung im zyklischen ROM-Test" UWORD dez 1 100 0 65535 FORMAT "%8.2" ARRAY_SIZE 2 ECU_ADDRESS 0x7FC2E6 /end MEASUREMENT
/begin MEASUREMENT urmpatco "Patch-Adresse im Code der Funktions¸berwachung f¸r ‹berpr¸fung zykl. ROM-Test" UWORD dez 1 100 0 65535 FORMAT "%8.2" ARRAY_SIZE 2 ECU_ADDRESS 0x7F8176 /end MEASUREMENT
/begin MEASUREMENT vvt_c_um "Entprellz‰hler zur Absicherung der VVT-Information" UBYTE t40ms_ub_b10200 1 100 0 10200 FORMAT "%7.1" ECU_ADDRESS 0x7F810F /end MEASUREMENT
/begin MEASUREMENT vvt_c_ur "Doppelablage: Entprellz‰hler zur Absicherung der VVT-Information" UBYTE dez 1 100 0 255 FORMAT "%5.1" ECU_ADDRESS 0x7F8231 /end MEASUREMENT
/begin MEASUREMENT watch_error "" SBYTE dez 1 100 -128 127 FORMAT "%5.1" ECU_ADDRESS 0x800EC4 /end MEASUREMENT
/begin MEASUREMENT watch_state "" SBYTE dez 1 100 -128 127 FORMAT "%5.1" ECU_ADDRESS 0x800EC5 /end MEASUREMENT
/begin MEASUREMENT wdksom_w "Drosselklappensollwinkel ohne Momentenstruktur" UWORD relDK_uw_b100 1 100 0 100 FORMAT "%8.4" ECU_ADDRESS 0x801402 /end MEASUREMENT
/begin MEASUREMENT wnwa2_w "Winkel Auslassventil schlieﬂt bezogen auf LWOT" SWORD kw_q0p0078 1 100 -256 255.992 FORMAT "%8.4" ECU_ADDRESS 0x8019A8 /end MEASUREMENT
/begin MEASUREMENT wnwadmna_w "Minimalwertauswahl von adaptierten Werten (Auslaﬂ)" SWORD kw_q0p0078 1 100 -256 255.992 FORMAT "%8.4" ECU_ADDRESS 0x800620 /end MEASUREMENT
/begin MEASUREMENT wnwadmne_w "Minimalwertauswahl von adaptierten Werten (Einlaﬂ)" SWORD kw_q0p0078 1 100 -256 255.992 FORMAT "%8.4" ECU_ADDRESS 0x800622 /end MEASUREMENT
/begin MEASUREMENT wnwadmxa_w "Maximalwertauswahl von adaptierten Werten (Auslaﬂ)" SWORD kw_q0p0078 1 100 -256 255.992 FORMAT "%8.4" ECU_ADDRESS 0x800624 /end MEASUREMENT
/begin MEASUREMENT wnwadmxe_w "Maximalwertauswahl von adaptierten Werten (Einlaﬂ)" SWORD kw_q0p0078 1 100 -256 255.992 FORMAT "%8.4" ECU_ADDRESS 0x800626 /end MEASUREMENT
/begin MEASUREMENT wnwa_w "Winkel Auslassventil schlieﬂt bezogen auf LWOT" SWORD kw_q0p0078 1 100 -256 255.992 FORMAT "%8.4" ECU_ADDRESS 0x8019AA /end MEASUREMENT
/begin MEASUREMENT wnwe2_w "Winkel Einlassventil oeffnet bezogen auf LWOT Einlass 2" SWORD kw_q0p0078 1 100 -256 255.992 FORMAT "%8.4" ECU_ADDRESS 0x8019AC /end MEASUREMENT
/begin MEASUREMENT wnwe_w "Winkel Einlassventil oeffnet bezogen auf LWOT" SWORD kw_q0p0078 1 100 -256 255.992 FORMAT "%8.4" ECU_ADDRESS 0x8019AE /end MEASUREMENT
/begin MEASUREMENT wnwiada1_w "Winkeldifferenz zwischen adaptierter und aktueller NW-Flanke Auslass Bank1" SWORD kw_q0p0039 1 100 -128 127.996 FORMAT "%8.4" ECU_ADDRESS 0x8019B0 /end MEASUREMENT
/begin MEASUREMENT wnwiada2_w "Winkeldifferenz zwischen adaptierter und aktueller NW-Flanke Auslass Bank2" SWORD kw_q0p0039 1 100 -128 127.996 FORMAT "%8.4" ECU_ADDRESS 0x8019B2 /end MEASUREMENT
/begin MEASUREMENT wnwiade1_w "Winkeldifferenz zwischen adaptierter und aktueller NW-Flanke Einlass Bank1" SWORD kw_q0p0039 1 100 -128 127.996 FORMAT "%8.4" ECU_ADDRESS 0x8019B4 /end MEASUREMENT
/begin MEASUREMENT wnwiade2_w "Winkeldifferenz zwischen adaptierter und aktueller NW-Flanke Einlass Bank2" SWORD kw_q0p0039 1 100 -128 127.996 FORMAT "%8.4" ECU_ADDRESS 0x8019B6 /end MEASUREMENT
/begin MEASUREMENT wnwima2_w "Mittelwert Abweichung Adaption Nocken-/Kurbelwelle von Auslass Bank 2" UWORD kw_q0p0039 1 100 0 255.996 FORMAT "%8.4" ECU_ADDRESS 0x7FC33A /end MEASUREMENT
/begin MEASUREMENT wnwima_w "Mittelwert Abweichung Adaption Nocken-/Kurbelwelle von Auslass Bank 1" UWORD kw_q0p0039 1 100 0 255.996 FORMAT "%8.4" ECU_ADDRESS 0x7FC33C /end MEASUREMENT
/begin MEASUREMENT wnwime2_w "Mittelwert Abweichung Adaption Nocken-/Kurbelwelle von Einlass Bank 2" UWORD kw_q0p0039 1 100 0 255.996 FORMAT "%8.4" ECU_ADDRESS 0x7FC33E /end MEASUREMENT
/begin MEASUREMENT wnwime_w "Mittelwert Abweichung Adaption Nocken-/Kurbelwelle von Einlass Bank 1" UWORD kw_q0p0039 1 100 0 255.996 FORMAT "%8.4" ECU_ADDRESS 0x7FC340 /end MEASUREMENT
/begin MEASUREMENT wnwkora1_w "Aktueller Korrekturwert f¸r NW-Winkel von Auslass Bank 1" SWORD kw_q0p0156 1 100 -512 511.984 FORMAT "%8.4" ECU_ADDRESS 0x800628 /end MEASUREMENT
/begin MEASUREMENT wnwkora2_w "Aktueller Korrekturwert f¸r NW-Winkel von Auslass Bank 2" SWORD kw_q0p0156 1 100 -512 511.984 FORMAT "%8.4" ECU_ADDRESS 0x80062A /end MEASUREMENT
/begin MEASUREMENT wnwkore1_w "Aktueller Korrekturwert f¸r NW-Winkel von Einlass Bank 1" SWORD kw_q0p0156 1 100 -512 511.984 FORMAT "%8.4" ECU_ADDRESS 0x80062C /end MEASUREMENT
/begin MEASUREMENT wnwkore2_w "Aktueller Korrekturwert f¸r NW-Winkel von Einlass Bank 2" SWORD kw_q0p0156 1 100 -512 511.984 FORMAT "%8.4" ECU_ADDRESS 0x80062E /end MEASUREMENT
/begin MEASUREMENT wnwmna2_w "Minimalwertauswahl der adaptierten Phasenflanken von Auslass Bank 2" SWORD kw_q0p0156 1 100 -512 511.984 FORMAT "%8.4" ECU_ADDRESS 0x800630 /end MEASUREMENT
/begin MEASUREMENT wnwmna_w "Minimalwertauswahl der adaptierten Phasenflanken von Auslass Bank 1" SWORD kw_q0p0156 1 100 -512 511.984 FORMAT "%8.4" ECU_ADDRESS 0x800632 /end MEASUREMENT
/begin MEASUREMENT wnwmne2_w "Minimalwertauswahl der adaptierten Phasenflanken von Einlass Bank 2" SWORD kw_q0p0156 1 100 -512 511.984 FORMAT "%8.4" ECU_ADDRESS 0x800634 /end MEASUREMENT
/begin MEASUREMENT wnwmne_w "Minimalwertauswahl der adaptierten Phasenflanken von Einlass Bank 1" SWORD kw_q0p0156 1 100 -512 511.984 FORMAT "%8.4" ECU_ADDRESS 0x800636 /end MEASUREMENT
/begin MEASUREMENT wnwmxa2_w "Maximalwertauswahl von adaptierten Winkelwerten bei Auslass Bank2" SWORD kw_q0p0156 1 100 -512 511.984 FORMAT "%8.4" ECU_ADDRESS 0x800638 /end MEASUREMENT
/begin MEASUREMENT wnwmxa_w "Maximalwertauswahl von adaptierten Winkelwerten bei Auslass Bank1" SWORD kw_q0p0156 1 100 -512 511.984 FORMAT "%8.4" ECU_ADDRESS 0x80063A /end MEASUREMENT
/begin MEASUREMENT wnwmxe2_w "Maximalwertauswahl von adaptierten Winkelwerten bei Einlass Bank 2" SWORD kw_q0p0156 1 100 -512 511.984 FORMAT "%8.4" ECU_ADDRESS 0x80063C /end MEASUREMENT
/begin MEASUREMENT wnwmxe_w "Maximalwertauswahl von adaptierten Winkelwerten bei Einlass Bank1" SWORD kw_q0p0156 1 100 -512 511.984 FORMAT "%8.4" ECU_ADDRESS 0x80063E /end MEASUREMENT
/begin MEASUREMENT wnwspa2_w "Adaptionswinkel der Nockenwellenflanken von Auslass Bank 2  (Referenzposition)" UWORD kw_q0p0156 1 100 0 1023.98 FORMAT "%8.3" ARRAY_SIZE 4 ECU_ADDRESS 0x7FC344 /end MEASUREMENT
/begin MEASUREMENT wnwspaa2_w "Adaptionswinkel der NW-Flanken (Referenzposition) f¸r Auslass Bank2" UWORD kw_q0p0156 1 100 0 1023.98 FORMAT "%8.3" ECU_ADDRESS 0x8019B8 /end MEASUREMENT
/begin MEASUREMENT wnwspaa_w "Adaptionswinkel der NW-Flanken (Referenzposition) f¸r Auslass Bank1" UWORD kw_q0p0156 1 100 0 1023.98 FORMAT "%8.3" ECU_ADDRESS 0x8019BA /end MEASUREMENT
/begin MEASUREMENT wnwspae2_w "Adaptionswinkel der NW-Flanken (Referenzposition) f¸r Einlass Bank2" UWORD kw_q0p0156 1 100 0 1023.98 FORMAT "%8.3" ECU_ADDRESS 0x8019BC /end MEASUREMENT
/begin MEASUREMENT wnwspae_w "Adaptionswinkel der NW-Flanken (Referenzposition) f¸r Einlass Bank1" UWORD kw_q0p0156 1 100 0 1023.98 FORMAT "%8.3" ECU_ADDRESS 0x8019BE /end MEASUREMENT
/begin MEASUREMENT wnwspa_w "Adaptionswinkel der Nockenwellenflanken von Auslass Bank 1  (Referenzposition)" UWORD kw_q0p0156 1 100 0 1023.98 FORMAT "%8.3" ARRAY_SIZE 4 ECU_ADDRESS 0x7FC34C /end MEASUREMENT
/begin MEASUREMENT wnwspe2_w "Adaptionswinkel der Nockenwellenflanken von Einlass Bank 2  (Referenzposition)" UWORD kw_q0p0156 1 100 0 1023.98 FORMAT "%8.3" ARRAY_SIZE 4 ECU_ADDRESS 0x7FC354 /end MEASUREMENT
/begin MEASUREMENT wnwspe_w "Adaptionswinkel der Nockenwellenflanken von Einlass Bank 1  (Referenzposition)" UWORD kw_q0p0156 1 100 0 1023.98 FORMAT "%8.3" ARRAY_SIZE 4 ECU_ADDRESS 0x7FC35C /end MEASUREMENT
/begin MEASUREMENT wphg "Z¸ndwinkel DG-Phasenkorrektur" SBYTE zw_sb_q0p75 1 100 -96 95.25 FORMAT "%5.2" ECU_ADDRESS 0x800F60 /end MEASUREMENT
/begin MEASUREMENT wri_c_um "Fehlerz‰hler im Dauer-RAM f¸r RAM-Beschreibbarkeits-Pr¸fung (Diagnose) in der FU" UBYTE dez 1 100 0 255 FORMAT "%5.1" ECU_ADDRESS 0x7FC2D1 /end MEASUREMENT
/begin MEASUREMENT znachanz "Anzahl der Z¸ndungen im Nachlauf" UBYTE dez 1 100 0 255 FORMAT "%5.1" ECU_ADDRESS 0x800F61 /end MEASUREMENT
/begin MEASUREMENT zrphgefla "fortlauf.Phasenflankenz‰hler der genutzten(berechn.)Phasenflanke(Auslaﬂ)" UBYTE dez 1 100 0 255 FORMAT "%5.1" ECU_ADDRESS 0x800EC0 /end MEASUREMENT
/begin MEASUREMENT zrphgefla2 "fortlauf.Phasenflankenz‰hler der genutzten Phasenflanke(Auslass, Bank2)" UBYTE dez 1 100 0 255 FORMAT "%5.1" ECU_ADDRESS 0x800EC1 /end MEASUREMENT
/begin MEASUREMENT zrphgefle "fortlauf.Phasenflankenz‰hler der genutzten (berechn.)Phasenflanke(Einlaﬂ)" UBYTE dez 1 100 0 255 FORMAT "%5.1" ECU_ADDRESS 0x800EC2 /end MEASUREMENT
/begin MEASUREMENT zrphgefle2 "fortlauf.Phasenflankenz‰hler der genutzten Phasenflanke(Einlaﬂ, Bank2)" UBYTE dez 1 100 0 255 FORMAT "%5.1" ECU_ADDRESS 0x800EC3 /end MEASUREMENT
/begin MEASUREMENT zsync_um "Kennung f¸r Synchronisation in der Funktions¸berwachung" UBYTE dez 1 100 0 255 FORMAT "%5.1" ECU_ADDRESS 0x7F81DF /end MEASUREMENT
/begin MEASUREMENT zsync_ur "1-er Komplement zur Kennung f¸r Synchronisation in der Funktions¸berwachung" UBYTE dez 1 100 0 255 FORMAT "%5.1" ECU_ADDRESS 0x7F81E0 /end MEASUREMENT
/begin MEASUREMENT zsytp1_um "Kennung1 f¸r fehlendes Synchro" UBYTE dez 1 100 0 255 FORMAT "%5.1" ECU_ADDRESS 0x7F826E /end MEASUREMENT
/begin MEASUREMENT zsytp2_um "Kennung2 f¸r fehlendes Synchro" UBYTE dez 1 100 0 255 FORMAT "%5.1" ECU_ADDRESS 0x7F826F /end MEASUREMENT
/begin MEASUREMENT zwbas "Basisz¸ndwinkel" SBYTE zw_sb_q0p75 1 100 -96 95.25 FORMAT "%5.2" ECU_ADDRESS 0x800F54 /end MEASUREMENT
/begin MEASUREMENT zwbasar "Basisz¸ndwinkelarray" SBYTE zw_sb_q0p75 1 100 -96 95.25 FORMAT "%5.2" ARRAY_SIZE 8 ECU_ADDRESS 0x800F58 /end MEASUREMENT
/begin MEASUREMENT zwcalcar "Z¸ndwinkel-Ausgabe Array" SBYTE zw_sb_q0p75 1 100 -96 95.25 FORMAT "%5.2" ARRAY_SIZE 8 ECU_ADDRESS 0x800F68 /end MEASUREMENT
/begin MEASUREMENT zwc_c_um "Fehlerz‰hler f¸r Z¸ndwinkel¸berwachung in der Funktions¸berwachung" UBYTE dez 1 100 0 255 FORMAT "%5.1" ECU_ADDRESS 0x7F8169 /end MEASUREMENT
/begin MEASUREMENT zwc_c_ur "Doppelablage des Fehlerz‰hlers for ignition angle monitoring" UBYTE dez 1 100 0 255 FORMAT "%5.1" ECU_ADDRESS 0x7F8254 /end MEASUREMENT
/begin MEASUREMENT zwgru "Grundz¸ndwinkel" SBYTE zw_sb_q0p75 1 100 -96 95.25 FORMAT "%5.2" ECU_ADDRESS 0x8011FB /end MEASUREMENT
/begin MEASUREMENT zwist "Ist-Z¸ndwinkel" SBYTE zw_sb_q0p75 1 100 -96 95.25 FORMAT "%5.2" ECU_ADDRESS 0x800F62 /end MEASUREMENT
/begin MEASUREMENT zwkrafld "Bitmuster des zyl.ind. abgelegten B_zwkra" UBYTE dez 1 100 0 255 FORMAT "%5.1" ECU_ADDRESS 0x800F63 /end MEASUREMENT
/begin MEASUREMENT zwlate "Sp‰tester Z¸ndwinkel nach Motorschutzplausibilisierung" SBYTE zw_sb_q0p75 1 100 -96 95.25 FORMAT "%5.2" ECU_ADDRESS 0x801203 /end MEASUREMENT
/begin MEASUREMENT zwmn "Sp‰tester Z¸ndwinkel" SBYTE zw_sb_q0p75 1 100 -96 95.25 FORMAT "%5.2" ECU_ADDRESS 0x801204 /end MEASUREMENT
/begin MEASUREMENT zwmnd "dynamisch sp‰test zul‰ssiger Z¸ndwinkel" SBYTE zw_sb_q0p75 1 100 -96 95.25 FORMAT "%5.2" ECU_ADDRESS 0x801205 /end MEASUREMENT
/begin MEASUREMENT zwmnms "dauerhaft sp‰test mˆglicher Z¸ndwinkel" SBYTE zw_sb_q0p75 1 100 -96 95.25 FORMAT "%5.2" ECU_ADDRESS 0x801206 /end MEASUREMENT
/begin MEASUREMENT zwmnt "Z¸ndwinkel der Brenngrenze plus Temperatur und Dynamikkorrektur" SBYTE zw_sb_q0p75 1 100 -96 95.25 FORMAT "%5.2" ECU_ADDRESS 0x801207 /end MEASUREMENT
/begin MEASUREMENT zwnws "Grundz¸ndwinkel mit Ber¸cksichtigung von Nockenwellensteuerung" SBYTE zw_sb_q0p75 1 100 -96 95.25 FORMAT "%5.2" ECU_ADDRESS 0x8011FC /end MEASUREMENT
/begin MEASUREMENT zwnws0 "Grundz¸ndwinkel bei KNWS, Auslaﬂnocke in Ruhestellung" SBYTE zw_sb_q0p75 1 100 -96 95.25 FORMAT "%5.2" ECU_ADDRESS 0x8011FD /end MEASUREMENT
/begin MEASUREMENT zwnws1 "Grundz¸ndwinkel bei KNWS, Auslaﬂnocke aktiv" SBYTE zw_sb_q0p75 1 100 -96 95.25 FORMAT "%5.2" ECU_ADDRESS 0x8011FE /end MEASUREMENT
/begin MEASUREMENT zwopt_um "optimaler Z¸ndwinkel in der Funktions¸berwachung" SBYTE zw_sb_q0p75 1 100 -96 95.25 FORMAT "%5.2" ECU_ADDRESS 0x7F81BA /end MEASUREMENT
/begin MEASUREMENT zwout "Z¸ndwinkel-Ausgabe" SBYTE zw_sb_q0p75 1 100 -96 95.25 FORMAT "%5.2" ECU_ADDRESS 0x800F64 /end MEASUREMENT
/begin MEASUREMENT zwoutcpl "Einerkomplement des Z¸ndwinkels f¸r die Funktions¸berwachung" SBYTE zw_sb_q0p75 1 100 -96 95.25 FORMAT "%5.2" ECU_ADDRESS 0x800F65 /end MEASUREMENT
/begin MEASUREMENT zwout_um "Ausgabe-Z¸ndwinkel f¸r die Funktions¸berwachung" SBYTE zw_sb_q0p75 1 100 -96 95.25 FORMAT "%5.2" ECU_ADDRESS 0x7F816A /end MEASUREMENT
/begin MEASUREMENT zwout_ur "Doppelablage Ausgabe-Z¸ndwinkel f¸r die Funktins¸berwachung" SBYTE dez 1 100 -128 127 FORMAT "%5.1" ECU_ADDRESS 0x7F8255 /end MEASUREMENT
/begin MEASUREMENT zwspae "Sp‰tester Z¸ndwinkel" SBYTE zw_sb_q0p75 1 100 -96 95.25 FORMAT "%5.2" ECU_ADDRESS 0x801208 /end MEASUREMENT
/begin MEASUREMENT zwstt "Z¸ndwinkel im Start" SBYTE zw_sb_q0p75 1 100 -96 95.25 FORMAT "%5.2" ECU_ADDRESS 0x801209 /end MEASUREMENT
/begin MEASUREMENT zwzyl1 "Z¸ndwinkel Zylinder 1" SBYTE zw_sb_q0p75 1 100 -96 95.25 FORMAT "%5.2" ECU_ADDRESS 0x800F66 /end MEASUREMENT
/begin MEASUREMENT z_flags_um "Byte f¸r Status-Bits beim 2-SG-Konzept in der Funktions¸berwachung" UBYTE dez 1 100 0 255 FORMAT "%5.1" ECU_ADDRESS 0x7F812E /end MEASUREMENT
/begin FUNCTION UFFGRE "EGAS ‹berwachungskonzept: FGR-Eingangsinfos f¸r die Funktions¸berwachung" /begin DEF_CHARACTERISTIC BREMS_T_UM FGREN_T_UM /end DEF_CHARACTERISTIC /begin REF_CHARACTERISTIC /end REF_CHARACTERISTIC
 /begin IN_MEASUREMENT B_fgrab B_fgrat B_fgren B_fgrhsa B_fgrtbe B_fgrtve B_fgrtwa modul_c_um raster_um S_bls S_brs /end IN_MEASUREMENT
 /begin OUT_MEASUREMENT /end OUT_MEASUREMENT
 /begin LOC_MEASUREMENT brems_c_um brems_c_ur fgren_c_um fgren_c_ur /end LOC_MEASUREMENT
 /begin SUB_FUNCTION /end SUB_FUNCTION
/end FUNCTION
/begin FUNCTION UFMIST "EGAS ‹berwachungskonzept: Ist-Moment der Funktions¸berwachung" /begin DEF_CHARACTERISTIC KFMI_UM KFZW_UM KLETAZW_UM /end DEF_CHARACTERISTIC /begin REF_CHARACTERISTIC NZWV08_UM RLV08_UM /end REF_CHARACTERISTIC
 /begin IN_MEASUREMENT modul_c_um nmot_um nzwst08_um nzwst08_ur raster_um rlst08_um rlst08_ur rl_um zwout_um zwout_ur /end IN_MEASUREMENT
 /begin OUT_MEASUREMENT mi_um mi_ur /end OUT_MEASUREMENT
 /begin LOC_MEASUREMENT dzw_um dzw_ur etazw_um miopt_um zwopt_um /end LOC_MEASUREMENT
 /begin SUB_FUNCTION /end SUB_FUNCTION
/end FUNCTION
/begin FUNCTION UFMSRC "EGAS ‹berwachungskonzept: MSR-Eingriff-‹berwachung f¸r die Funktions¸berwachung" /begin DEF_CHARACTERISTIC BZ_MSR_M CWNOMSRU MSRC_T_UM /end DEF_CHARACTERISTIC /begin REF_CHARACTERISTIC /end REF_CHARACTERISTIC /begin IN_MEASUREMENT modul_c_um raster_um /end IN_MEASUREMENT /begin OUT_MEASUREMENT B_nomsr_um ei_msrc_um mmsr_um mmsr_ur /end OUT_MEASUREMENT /begin LOC_MEASUREMENT alv_old_um alv_old_ur msrc_c_um msrc_c_ur /end LOC_MEASUREMENT /begin SUB_FUNCTION /end SUB_FUNCTION /end FUNCTION
/begin FUNCTION UFMVER "EGAS ‹berwachungskonzept: Momentenvergleich der Funktions¸berwachung" /begin DEF_CHARACTERISTIC MVER_T_UM /end DEF_CHARACTERISTIC /begin REF_CHARACTERISTIC /end REF_CHARACTERISTIC
 /begin IN_MEASUREMENT B_i_ska_um mi_um mi_ur modul_c_um mzf_um mzf_ur mzo_um mzo_ur raster_um /end IN_MEASUREMENT
 /begin OUT_MEASUREMENT ei_mver_um /end OUT_MEASUREMENT
 /begin LOC_MEASUREMENT mdif_w_um mver_c_um mver_c_ur mzfo_um /end LOC_MEASUREMENT
 /begin SUB_FUNCTION /end SUB_FUNCTION
/end FUNCTION
/begin FUNCTION UFMZF "EGAS ‹berwachungskonzept: Momentenfilter f¸r die Funktions¸berwachung" /begin DEF_CHARACTERISTIC MZFFIL_UM MZFTV_UM /end DEF_CHARACTERISTIC /begin REF_CHARACTERISTIC /end REF_CHARACTERISTIC /begin IN_MEASUREMENT modul_c_um mz_um mz_ur raster_um /end IN_MEASUREMENT /begin OUT_MEASUREMENT mzf_um mzf_ur /end OUT_MEASUREMENT /begin LOC_MEASUREMENT mzf_l_um mzf_l_ur mzf_p_um mzf_p_ur mzf_r_um mzf_r_ur /end LOC_MEASUREMENT /begin SUB_FUNCTION /end SUB_FUNCTION /end FUNCTION
/begin FUNCTION UFMZUL "EGAS ‹berwachungskonzept: zul‰ssiges Moment der Funktions¸berwachung" /begin DEF_CHARACTERISTIC KFMDZOF_UM KFMPED_UM KFMPNS_UM MDV08_UM /end DEF_CHARACTERISTIC /begin REF_CHARACTERISTIC NMV08_UM SPSNV08_UM /end REF_CHARACTERISTIC
 /begin IN_MEASUREMENT mfgr_um mfgr_ur mmsr_um mmsr_ur modul_c_um msgs_um msgs_ur nmot_um nmst08_um nmst08_ur raster_um spnst08_um spnst08_ur spsn_um /end IN_MEASUREMENT
 /begin OUT_MEASUREMENT mdst08_um mdst08_ur mzo_um mzo_ur mz_um mz_ur /end OUT_MEASUREMENT
 /begin LOC_MEASUREMENT mped_um /end LOC_MEASUREMENT
 /begin SUB_FUNCTION /end SUB_FUNCTION
/end FUNCTION
/begin FUNCTION UFNC "EGAS ‹berwachungskonzept: N-‹berwachung f¸r die Funktions¸berwachung"
 /begin DEF_CHARACTERISTIC FQUARZ_UM NC_T_UM NDIF_UM NMIN_UM NMV08_UM NSEGMAX_UM NZWV08_UM PRESCAL_UM TSEGMIN_UM /end DEF_CHARACTERISTIC
 /begin REF_CHARACTERISTIC ZYLANZ_UM /end REF_CHARACTERISTIC
 /begin IN_MEASUREMENT B_i_ska_um modul_c_um nmot raster_um tsm_alt_um tsm_um /end IN_MEASUREMENT
 /begin OUT_MEASUREMENT ei_nc_um nmot_um nmot_ur nmst08_um nmst08_ur nzwst08_um nzwst08_ur zsync_um zsync_ur /end OUT_MEASUREMENT
 /begin LOC_MEASUREMENT nc_c_um nc_c_ur nseg_um tseg_um /end LOC_MEASUREMENT
 /begin SUB_FUNCTION /end SUB_FUNCTION
/end FUNCTION
/begin FUNCTION UFNSC "EGAS ‹berwachungskonzept: Nachstart¸berwachung f¸r die Funktions¸berwachung"
 /begin DEF_CHARACTERISTIC NSC_T_UM NSOF_T_UM N_START_UM N_STEND_UM TANSMN_UM TMNSMN_UM /end DEF_CHARACTERISTIC
 /begin REF_CHARACTERISTIC /end REF_CHARACTERISTIC
 /begin IN_MEASUREMENT modul_c_um nmot_um nmot_ur raster_um tans tmot /end IN_MEASUREMENT
 /begin OUT_MEASUREMENT B_mzns_um /end OUT_MEASUREMENT
 /begin LOC_MEASUREMENT nsc_c_um nsc_c_ur nsof_c_um nsof_c_ur /end LOC_MEASUREMENT
 /begin SUB_FUNCTION /end SUB_FUNCTION
/end FUNCTION
/begin FUNCTION UFREAC "EGAS ‹berwachungskonzept: Fehlerreaktions¸berw.d.Funktions¸berwachung" /begin DEF_CHARACTERISTIC KLNPED_UM REAC_T1_UM REAC_T2_UM SKA_DRHZ_UM /end DEF_CHARACTERISTIC /begin REF_CHARACTERISTIC /end REF_CHARACTERISTIC
 /begin IN_MEASUREMENT B_i_ska_um evz_austot modul_c_um nmot_um nmot_ur raster_um spsn_um spsn_ur /end IN_MEASUREMENT
 /begin OUT_MEASUREMENT ei_reac_um /end OUT_MEASUREMENT
 /begin LOC_MEASUREMENT fuel_co_um fuel_co_ur nska_um reac_c1_um reac_c1_ur reac_c2_um reac_c2_ur /end LOC_MEASUREMENT
 /begin SUB_FUNCTION /end SUB_FUNCTION
/end FUNCTION
/begin FUNCTION UFRLC "EGAS ‹berwachungskonzept: Lastsignal¸berw. f¸r Funktions¸berwachung"
 /begin DEF_CHARACTERISTIC DPIPFIL_UM DPIPTV_UM DPS_T_UM EVHUBMX_UM HUBV08_UM IP1A_MX_UM IP2A_MN_UM IPA_T_UM IPSNV08_UM KFDPIP_UM KFLVVTM_UM KFLVVT_UM KFRLDP_UM KFRLNM1_UM KFRLNM2_UM KFRLNM3_UM KFRLNM4_UM KFRLNM5_UM KFRLNM6_UM KUMSRL_UM NMOT1_UM NMOT2_UM NMOT3_UM NMOT4_UM NMOT5_UM NMOT6_UM NRLIP_UM RLC_T_UM RLDFIL_UM RLDPFIL_UM RLDPTV_UM RLDTV_UM RLIP_T_UM RLV08_UM RLVT_BO_UM RLVT_MO_UM RL_BO_UM RL_MO_UM VVT_T_UM /end DEF_CHARACTERISTIC
 /begin REF_CHARACTERISTIC /end REF_CHARACTERISTIC
 /begin IN_MEASUREMENT B_ehfs B_i_ska_um B_wdk2sel dps_w evhbi2_w evhbi_w modul_c_um nmot_um nmot_ur raster_um rl rl_w udkp1a udkp2a /end IN_MEASUREMENT
 /begin OUT_MEASUREMENT B_rldif_um ei_dps_um ei_ipa_um ei_rlc_um ei_rlip_um ei_vvt_um hubst08_um hubst08_ur ipnst08_um ipnst08_ur rlst08_um rlst08_ur rl_um rl_ur /end OUT_MEASUREMENT
 /begin LOC_MEASUREMENT dpipf_l_um dpipf_l_ur dpipf_p_um dpipf_p_ur dpipf_r_um dpipf_r_ur dpipf_um dpipf_ur dpip_um dps_c_um dps_c_ur dps_um dps_ur evhubim_um evhubim_ur evhubi_um evhubi_ur fwkor_um fwnm_um ipa_c_um ipa_c_ur ipsn_um ipsn_ur rlc_c_um rlc_c_ur rldf_l_um rldf_l_ur rldf_p_um rldf_p_ur rldf_r_um rldf_r_ur rldf_um rldf_ur rldif_um rldpf_l_um rldpf_l_ur rldpf_p_um rldpf_p_ur rldpf_r_um rldpf_r_ur rldpf_um rldpf_ur rldpzo_um rldp_um rld_um rlip_c_um rlip_c_ur rlnmo_um rlnmu_um rlvvtzo_um rlvvt_um rlzo_um rl_w_um vvt_c_um vvt_c_ur /end LOC_MEASUREMENT
 /begin SUB_FUNCTION /end SUB_FUNCTION
/end FUNCTION
/begin FUNCTION UFSGSC "EGAS ‹berwachungskonzept: SGS-Eingriff-‹berwachung f¸r die Funktions¸bersicht" /begin DEF_CHARACTERISTIC SGSC_T_UM /end DEF_CHARACTERISTIC /begin REF_CHARACTERISTIC /end REF_CHARACTERISTIC /begin IN_MEASUREMENT modul_c_um raster_um /end IN_MEASUREMENT /begin OUT_MEASUREMENT B_nosgs_um ei_sgsc_um msgs_um msgs_ur /end OUT_MEASUREMENT /begin LOC_MEASUREMENT sgsc_c_um sgsc_c_ur /end LOC_MEASUREMENT /begin SUB_FUNCTION /end SUB_FUNCTION /end FUNCTION
/begin FUNCTION UFSPSC "EGAS ‹berwachungskonzept: Pedal-Sollwert-‹. f¸r Funktions¸berwachung"
 /begin DEF_CHARACTERISTIC SP12LL_UM SP12VG_UM SPSC_MINUM SPSC_T_UM SPSNV08_UM SPSVG_UM /end DEF_CHARACTERISTIC
 /begin REF_CHARACTERISTIC /end REF_CHARACTERISTIC
 /begin IN_MEASUREMENT B_i_ska_um B_pwgnotfr B_sp1s B_sp2s B_spsmin modul_c_um raster_um upwg1_w upwg2_w /end IN_MEASUREMENT
 /begin OUT_MEASUREMENT B_pwgnotum ei_spsc_um spnst08_um spnst08_ur spsn_um spsn_ur /end OUT_MEASUREMENT
 /begin LOC_MEASUREMENT sp1s_um sp2s_um spsc_c_um spsc_c_ur /end LOC_MEASUREMENT
 /begin SUB_FUNCTION /end SUB_FUNCTION
/end FUNCTION
/begin FUNCTION UFURAM "" /begin DEF_CHARACTERISTIC CW_BDE_UM /end DEF_CHARACTERISTIC /begin REF_CHARACTERISTIC /end REF_CHARACTERISTIC /begin IN_MEASUREMENT /end IN_MEASUREMENT
 /begin OUT_MEASUREMENT b_flags_um B_i_ska_um n_flags_um ram_c_um raster_um reac_c_um romz_c_um r_flags_um srst_c_um s_flags_um t_flags_um umrst_c_um wri_c_um z_flags_um /end OUT_MEASUREMENT
 /begin LOC_MEASUREMENT B_brems_um B_brfgr_um B_bsl_um B_dcdis_um B_fgrea_um B_fgr_umc B_i_ska B_kkl_um B_msthw_um B_naccf_um B_nlh_um B_notlu B_nsakt_um B_nsend_um B_reaci_um B_rlini_um B_rluf_um B_srstz_um B_srst_um B_tpu_um B_ub_ska B_vzl_um B_wal_um reset_indication_um /end LOC_MEASUREMENT
 /begin SUB_FUNCTION /end SUB_FUNCTION
/end FUNCTION
/begin FUNCTION UFZWC "EGAS ‹berwachungskonzept: ZW-‹berwachung f¸r Funktions¸berwachung" /begin DEF_CHARACTERISTIC ZWC_T_UM ZYLANZ_UM /end DEF_CHARACTERISTIC /begin REF_CHARACTERISTIC /end REF_CHARACTERISTIC /begin IN_MEASUREMENT B_i_ska_um modul_c_um raster_um zwout zwoutcpl /end IN_MEASUREMENT /begin OUT_MEASUREMENT ei_zwc_um zwout_um zwout_ur /end OUT_MEASUREMENT /begin LOC_MEASUREMENT zwc_c_um zwc_c_ur /end LOC_MEASUREMENT /begin SUB_FUNCTION /end SUB_FUNCTION /end FUNCTION
/begin FUNCTION UF_DUMMY "" /begin DEF_CHARACTERISTIC /end DEF_CHARACTERISTIC /begin REF_CHARACTERISTIC /end REF_CHARACTERISTIC /begin IN_MEASUREMENT /end IN_MEASUREMENT /begin OUT_MEASUREMENT egaspfad skapfad /end OUT_MEASUREMENT /begin LOC_MEASUREMENT /end LOC_MEASUREMENT /begin SUB_FUNCTION /end SUB_FUNCTION /end FUNCTION
/begin FUNCTION UMAUSC "EGAS ‹berwachungskonzept: Abschaltpfadtest ‹berwachungsmodul" /begin DEF_CHARACTERISTIC AUSCH_T_UM AUSC_T_UM /end DEF_CHARACTERISTIC /begin REF_CHARACTERISTIC /end REF_CHARACTERISTIC
 /begin IN_MEASUREMENT B_i_ska_um B_norm B_ubdve evz_austot e_mem_um mem_ur newqu_um umerr_c_um /end IN_MEASUREMENT
 /begin OUT_MEASUREMENT auscf_c_um ausch_c_um ausc_c_um ausc_ur B_ausc_act B_ausc_um B_nxptr_um ei_ubr_um /end OUT_MEASUREMENT
 /begin LOC_MEASUREMENT hwError_um /end LOC_MEASUREMENT
 /begin SUB_FUNCTION /end SUB_FUNCTION
/end FUNCTION
/begin FUNCTION UMKOM "EGAS ‹berwachungskonzept: Frage/Antwort-Kommunikation zw. UM und FR" /begin DEF_CHARACTERISTIC FRERR_T_UM /end DEF_CHARACTERISTIC /begin REF_CHARACTERISTIC AUSCH_T_UM /end REF_CHARACTERISTIC
 /begin IN_MEASUREMENT abtres_um apakres_um ausc_ur B_ausc_act B_ausc_um e_mem_um mem_ur /end IN_MEASUREMENT
 /begin OUT_MEASUREMENT B_newqr_um B_nxtrp_um frerr_c_um frerr_c_ur frtar_c_um newansw_um newqr_ur newque_um newqu_um umerr_c_um /end OUT_MEASUREMENT
 /begin LOC_MEASUREMENT nxtrp_ur plstate_um plstate_ur /end LOC_MEASUREMENT
 /begin SUB_FUNCTION /end SUB_FUNCTION
/end FUNCTION
/begin FUNCTION URADCC "EGAS ‹berwachungskonzept: AD-Wandler-Test" /begin DEF_CHARACTERISTIC ADCC_MX_UM ADCC_T_UM ADCQ_T_UM /end DEF_CHARACTERISTIC /begin REF_CHARACTERISTIC /end REF_CHARACTERISTIC /begin IN_MEASUREMENT B_i_ska_um B_pwgnotum modul_c_um raster_um upwg2_w /end IN_MEASUREMENT /begin OUT_MEASUREMENT B_adcc_um ei_adcc_um ei_adcq_um /end OUT_MEASUREMENT /begin LOC_MEASUREMENT adcc_c_um adcc_c_ur adcq_c_um adcq_c_ur adcq_um upwg2_um /end LOC_MEASUREMENT /begin SUB_FUNCTION /end SUB_FUNCTION /end FUNCTION
/begin FUNCTION URMEM "EGAS ‹berwachungskonzept: Zyklischer Speichertest" /begin DEF_CHARACTERISTIC AUSGH_T_UM AUSG_T_UM AUSZH_T_UM AUSZ_T_UM /end DEF_CHARACTERISTIC /begin REF_CHARACTERISTIC /end REF_CHARACTERISTIC /begin IN_MEASUREMENT modul_c_um raster_um /end IN_MEASUREMENT /begin OUT_MEASUREMENT e_mem_um mem_ur urmcksco urmcksda urmpatco /end OUT_MEASUREMENT
 /begin LOC_MEASUREMENT ausgh_c_um ausgh_c_ur ausg_c_um ausg_c_ur auszh_c_um auszh_c_ur ausz_c_um ausz_c_ur /end LOC_MEASUREMENT
 /begin SUB_FUNCTION /end SUB_FUNCTION
/end FUNCTION
/begin FUNCTION URPAK "EGAS ‹berwachungskonzept: Programmablaufkontrolle" /begin DEF_CHARACTERISTIC /end DEF_CHARACTERISTIC /begin REF_CHARACTERISTIC /end REF_CHARACTERISTIC /begin IN_MEASUREMENT B_newqr_um newqr_ur newque_um raster_um /end IN_MEASUREMENT /begin OUT_MEASUREMENT abtres_um apakres_um modul_c_um newqu_uc /end OUT_MEASUREMENT /begin LOC_MEASUREMENT /end LOC_MEASUREMENT /begin SUB_FUNCTION /end SUB_FUNCTION /end FUNCTION
/begin FUNCTION URRAM "EGAS ‹berwachungskonzept: RAM-Test" /begin DEF_CHARACTERISTIC /end DEF_CHARACTERISTIC /begin REF_CHARACTERISTIC /end REF_CHARACTERISTIC
 /begin IN_MEASUREMENT B_pwf e_mem_um e_rom1_um e_romx_um mem_ur nmot_um rom1_ur rompage_um rompage_ur romx_ur wri_c_um /end IN_MEASUREMENT
 /begin OUT_MEASUREMENT e_ram_um ram_ur /end OUT_MEASUREMENT
 /begin LOC_MEASUREMENT /end LOC_MEASUREMENT
 /begin SUB_FUNCTION /end SUB_FUNCTION
/end FUNCTION
/begin FUNCTION URROM "EGAS ‹berwachungskonzept: ROM-Test" /begin DEF_CHARACTERISTIC CW_NOROMCHKRESET ROMRSTA_UM /end DEF_CHARACTERISTIC /begin REF_CHARACTERISTIC /end REF_CHARACTERISTIC /begin IN_MEASUREMENT B_nlsiko B_pwf e_mem_um e_ram_um mem_ur ram_ur swOffDlBits /end IN_MEASUREMENT
 /begin OUT_MEASUREMENT e_rom1_um e_romx_um rom1_ur rompage_um rompage_ur romrstc_um romx_ur /end OUT_MEASUREMENT
 /begin LOC_MEASUREMENT /end LOC_MEASUREMENT
 /begin SUB_FUNCTION /end SUB_FUNCTION
/end FUNCTION
/begin FUNCTION URTPU "EGAS ‹berwachungskonzept: TPU-‹berwachung f¸r Funktions¸berwachung"
 /begin DEF_CHARACTERISTIC NZMAX_UM TBASTPU_UM TDIFMX_UM TPUCA_T_UM TPUCR_T_UM TPURA_T_UM TPURSTA_UM TPU_T_UM /end DEF_CHARACTERISTIC
 /begin REF_CHARACTERISTIC FQUARZ_UM PRESCAL_UM /end REF_CHARACTERISTIC
 /begin IN_MEASUREMENT e_mem_um mem_ur modul_c_um raster_um /end IN_MEASUREMENT
 /begin OUT_MEASUREMENT c720alt_um c720alt_ur ei_tpu_um e_tpu_um nz_um tc72alt_um tc72alt_ur tdifs1_um tdifs1_ur tsm_alt_um tsm_um zsytp1_um zsytp2_um /end OUT_MEASUREMENT
 /begin LOC_MEASUREMENT tpuca_c_um tpuca_c_ur tpucr_c_um tpucr_c_ur tpura_c_um tpura_c_ur tpurstc_um tpu_c_um tpu_c_ur /end LOC_MEASUREMENT
 /begin SUB_FUNCTION /end SUB_FUNCTION
/end FUNCTION
/begin FUNCTION UTIL "" /begin DEF_CHARACTERISTIC /end DEF_CHARACTERISTIC /begin REF_CHARACTERISTIC /end REF_CHARACTERISTIC /begin IN_MEASUREMENT B_bm B_nachl B_nmin B_stprel B_wakeup sync_level /end IN_MEASUREMENT /begin OUT_MEASUREMENT drrev_sta inisynmon /end OUT_MEASUREMENT /begin LOC_MEASUREMENT /end LOC_MEASUREMENT /begin SUB_FUNCTION /end SUB_FUNCTION /end FUNCTION
/begin FUNCTION VAR "Variantencodierung"
 /begin DEF_CHARACTERISTIC MSK_Cod_Aggr MSK_Cod_CANMembr MSK_Cod_Diff_Ratio MSK_Cod_Drvabl MSK_Cod_Eng MSK_Cod_EOL MSK_Cod_Exh MSK_Cod_Func MSK_Cod_ModelRange MSK_Cod_Res1 MSK_Cod_Res2 MSK_Cod_Res3 MSK_Cod_Res4 MSK_Cod_Res5 MSK_Cod_Res6 MSK_Cod_TM MSK_Cod_Trans1 MSK_Cod_Trans2 MSK_Cod_WhlFront_Circumfer_Fctr MSK_Cod_WhlRear_Circumfer_Fctr VB_Cod_Aggr VB_Cod_CANMembr VB_Cod_Diff_Ratio VB_Cod_Drvabl VB_Cod_Eng VB_Cod_EOL VB_Cod_Exh VB_Cod_Func VB_Cod_ModelRange VB_Cod_Res1 VB_Cod_Res2 VB_Cod_Res3 VB_Cod_Res4 VB_Cod_Res5 VB_Cod_Res6 VB_Cod_TM VB_Cod_Trans1 VB_Cod_Trans2 VB_Cod_WhlFront_Circumfer_Fctr VB_Cod_WhlRear_Circumfer_Fctr /end DEF_CHARACTERISTIC
 /begin REF_CHARACTERISTIC /end REF_CHARACTERISTIC
 /begin IN_MEASUREMENT B_pwf /end IN_MEASUREMENT
 /begin OUT_MEASUREMENT B_vklakt B_vklend B_vklerr B_vksakt B_vksend B_vkserr Cod_Aggr Cod_CANMembr Cod_Diff_Ratio Cod_Drvabl Cod_Eng Cod_EOL Cod_Exh Cod_Func Cod_ModelRange Cod_Res1 Cod_Res2 Cod_Res3 Cod_Res4 Cod_Res5 Cod_Res6 Cod_TM Cod_Trans1 Cod_Trans2 Cod_WhlFront_Circumfer_Fctr Cod_WhlRear_Circumfer_Fctr /end OUT_MEASUREMENT
 /begin LOC_MEASUREMENT /end LOC_MEASUREMENT
 /begin SUB_FUNCTION /end SUB_FUNCTION
/end FUNCTION
/begin FUNCTION WANWKW "Winkeladaption der Nockenwelle zur Kurbelwelle"
 /begin DEF_CHARACTERISTIC PHNMO PHNMU STM05EPMSB WNWAFMX WNWASMX WNWKMA WNWKMA2 WNWKME WNWKME2 WNWKN WNWRPSA WNWRPSA2 WNWRPSE WNWRPSE2 ZNWSP /end DEF_CHARACTERISTIC
 /begin REF_CHARACTERISTIC WNWRAS WNWREO /end REF_CHARACTERISTIC
 /begin IN_MEASUREMENT B_nldg B_nwflada B_nwflade B_pwf nmot synstate tmot wnwkwa2_w wnwkwa_w wnwkwe2_w wnwkwe_w zphfl zphfl2 zphfl3 zphfl4 /end IN_MEASUREMENT
 /begin OUT_MEASUREMENT B_phada B_phada1 B_phada2 B_phade B_phade1 B_phade2 B_phnmo B_phnmu B_spsaa B_spsaa2 B_spsae B_spsae2 B_wnwinla B_wnwinla2 B_wnwinle B_wnwinle2 wnwa2_w wnwadmna_w wnwadmne_w wnwadmxa_w wnwadmxe_w wnwa_w wnwe2_w wnwe_w wnwiada1_w wnwiada2_w wnwiade1_w wnwiade2_w wnwspaa2_w wnwspaa_w wnwspae2_w wnwspae_w zrphgefla zrphgefla2 zrphgefle zrphgefle2 /end OUT_MEASUREMENT
 /begin LOC_MEASUREMENT B_phgefla B_phgefla2 B_phgefle B_phgefle2 esst_stm05epmsb wnwima2_w wnwima_w wnwime2_w wnwime_w wnwkora1_w wnwkora2_w wnwkore1_w wnwkore2_w wnwmna2_w wnwmna_w wnwmne2_w wnwmne_w wnwmxa2_w wnwmxa_w wnwmxe2_w wnwmxe_w wnwspa2_w wnwspa_w wnwspe2_w wnwspe_w /end LOC_MEASUREMENT
 /begin SUB_FUNCTION /end SUB_FUNCTION
/end FUNCTION
/begin FUNCTION Watchpoint ""
 /begin DEF_CHARACTERISTIC watch_addr0_h watch_addr0_l watch_addr1_h watch_addr1_l watch_addr2_h watch_addr2_l watch_addr3_h watch_addr3_l watch_newdata watch_on /end DEF_CHARACTERISTIC
 /begin REF_CHARACTERISTIC /end REF_CHARACTERISTIC
 /begin IN_MEASUREMENT /end IN_MEASUREMENT
 /begin OUT_MEASUREMENT /end OUT_MEASUREMENT
 /begin LOC_MEASUREMENT /end LOC_MEASUREMENT
 /begin SUB_FUNCTION /end SUB_FUNCTION
/end FUNCTION
/begin FUNCTION Watchpoint_Extended ""
 /begin DEF_CHARACTERISTIC watch_acmode watch_addr4_h watch_addr4_l watch_addr5_h watch_addr5_l watch_cmode4 watch_cmode5 watch_dcmode watch_mode watch_rw4 watch_rw5 watch_sign4 watch_sign5 watch_size_bits4 watch_size_bits5 watch_value4_h watch_value4_l watch_value5_h watch_value5_l /end DEF_CHARACTERISTIC
 /begin REF_CHARACTERISTIC /end REF_CHARACTERISTIC
 /begin IN_MEASUREMENT /end IN_MEASUREMENT
 /begin OUT_MEASUREMENT /end OUT_MEASUREMENT
 /begin LOC_MEASUREMENT watch_error watch_state /end LOC_MEASUREMENT
 /begin SUB_FUNCTION /end SUB_FUNCTION
/end FUNCTION
/begin FUNCTION WDKSOM "Berechnung Drosselklappensollwinkel ohne Momentenstruktur"
 /begin DEF_CHARACTERISTIC KFWDKSST KFWDKTHO KLWDKABST KLWDKPED KLWDKTAN NWDKSST TFWDKSOM TWDKRED TWDKSNST WDKSNLN /end DEF_CHARACTERISTIC
 /begin REF_CHARACTERISTIC /end REF_CHARACTERISTIC
 /begin IN_MEASUREMENT B_enllri B_llrein B_nmin fho miist_w miszul_w nmot nmot_w tabst_w tans tmst wped /end IN_MEASUREMENT
 /begin OUT_MEASUREMENT B_munst B_tfwdksom B_wdksom tfwdksom_w wdksom_w /end OUT_MEASUREMENT
 /begin LOC_MEASUREMENT /end LOC_MEASUREMENT
 /begin SUB_FUNCTION /end SUB_FUNCTION
/end FUNCTION
/begin FUNCTION WFS "Wegfahrsperre" /begin DEF_CHARACTERISTIC /end DEF_CHARACTERISTIC /begin REF_CHARACTERISTIC /end REF_CHARACTERISTIC /begin IN_MEASUREMENT /end IN_MEASUREMENT /begin OUT_MEASUREMENT B_develop_ECU /end OUT_MEASUREMENT /begin LOC_MEASUREMENT /end LOC_MEASUREMENT /begin SUB_FUNCTION /end SUB_FUNCTION /end FUNCTION
/begin FUNCTION WNWRA "Auslaﬂ-NW-Lageregelung"
 /begin DEF_CHARACTERISTIC CWNWRA DWNWARA DWNWASIMN DWNWASIMX DWNWDATMN DWNWDATMX FTANWUBA ITANWLIA ITANWLIGA KFNWRDA KFNWRPA KFNWRSIA TANWFRA TANWMNLIA TANWMNSIA TANWMXLIA TANWMXSIA TANWRMAXA TANWRMINA TANWSPA TTANWLIA TTANWLIGA WNWSMNAAA WNWSMNRA WNWVAAA /end DEF_CHARACTERISTIC
 /begin REF_CHARACTERISTIC CWKVHR SNM06NWUW STO06NWUW WNWRAS /end REF_CHARACTERISTIC
 /begin IN_MEASUREMENT B_kdhra B_nmin B_nnwmx B_nwrposa B_nwsst B_wnws02a B_wnws0a esst_snm06nwuw esst_sto06nwuw nmot_w toelk_w ub wnwa2_w wnwa_w wnwsa2_w wnwsa_w wnwvfa2_w wnwvfa_w /end IN_MEASUREMENT
 /begin OUT_MEASUREMENT B_nwoffa B_nwoffa2 tanwra2_w tanwraa2_w tanwraa_w tanwra_w /end OUT_MEASUREMENT
 /begin LOC_MEASUREMENT B_fnwrlia B_fnwrlia2 B_fnwrsia B_fnwrsia2 B_nwha B_nwha2 B_nwvfra B_nwvfra2 B_nwvspa B_nwvspa2 B_tvinva dwnwa2_w dwnwaa2_w dwnwaa_w dwnwa_w dwnwda2_w dwnwda_w ftanwubka nwrda_w nwria_w nwrpa_w tanwda2_w tanwda_w tanwia2_w tanwia_w tanwita_w tanwlia2_w tanwlia_w tanwnka2_w tanwnka_w tanwpa2_w tanwpa_w tanwsia2_w tanwsia_w /end LOC_MEASUREMENT
 /begin SUB_FUNCTION /end SUB_FUNCTION
/end FUNCTION
/begin FUNCTION WNWRE "Einlaﬂnockenwellen-Lageregelung"
 /begin DEF_CHARACTERISTIC CWNWRE DWNWARE DWNWDETMN DWNWDETMX DWNWESIMN DWNWESIMX FTANWUBE ITANWLIE ITANWLIGE KFNWRDE KFNWRPE KFNWRSIE TANWFRE TANWMNLIE TANWMNSIE TANWMXLIE TANWMXSIE TANWRMAXE TANWRMINE TANWSPE TTANWLIE TTANWLIGE WNWSMNAAE WNWSMNRE WNWVAAE /end DEF_CHARACTERISTIC
 /begin REF_CHARACTERISTIC CWKVHR SNM06NWUW STO06NWUW WNWREO /end REF_CHARACTERISTIC
 /begin IN_MEASUREMENT B_kdhre B_nmin B_nnwmx B_nwrpose B_nwsst B_wnws02e B_wnws0e esst_snm06nwuw esst_sto06nwuw nmot_w toelk_w ub wnwe2_w wnwe_w wnwse2_w wnwse_w wnwvfe2_w wnwvfe_w /end IN_MEASUREMENT
 /begin OUT_MEASUREMENT B_nwoffe B_nwoffe2 tanwre2_w tanwree2_w tanwree_w tanwre_w /end OUT_MEASUREMENT
 /begin LOC_MEASUREMENT B_fnwrlie B_fnwrlie2 B_fnwrsie B_fnwrsie2 B_nwhe B_nwhe2 B_nwvfre B_nwvfre2 B_nwvspe B_nwvspe2 B_tvinve dwnwae2_w dwnwae_w dwnwde2_w dwnwde_w dwnwe2_w dwnwe_w ftanwubke nwrde_w nwrie_w nwrpe_w tanwde2_w tanwde_w tanwie2_w tanwie_w tanwite_w tanwlie2_w tanwlie_w tanwnke2_w tanwnke_w tanwpe2_w tanwpe_w tanwsie2_w tanwsie_w /end LOC_MEASUREMENT
 /begin SUB_FUNCTION /end SUB_FUNCTION
/end FUNCTION
/begin FUNCTION ZUESZ "Z¸ndung, Berechnung Schlieﬂzeit"
 /begin DEF_CHARACTERISTIC CW_FUBND FFLDZ FSZTM FTMFFANZ FUBAOF FWNMOT KFFFANZ KFFFANZUB KFSZT /end DEF_CHARACTERISTIC
 /begin REF_CHARACTERISTIC /end REF_CHARACTERISTIC
 /begin IN_MEASUREMENT B_stend nmot nmot_w tmot ub /end IN_MEASUREMENT
 /begin OUT_MEASUREMENT B_ff fubaanz offz_w szfuba_w szout_w /end OUT_MEASUREMENT
 /begin LOC_MEASUREMENT /end LOC_MEASUREMENT
 /begin SUB_FUNCTION /end SUB_FUNCTION
/end FUNCTION
/begin FUNCTION ZWBAS "Berechnung Z¸ndwinkel f¸r zwbasar" /begin DEF_CHARACTERISTIC ZWAPPL /end DEF_CHARACTERISTIC /begin REF_CHARACTERISTIC /end REF_CHARACTERISTIC /begin IN_MEASUREMENT B_llrein dwkrz dzwwl wkrdy zwgru zwstt zzylzue /end IN_MEASUREMENT /begin OUT_MEASUREMENT zwbas zwbasar /end OUT_MEASUREMENT /begin LOC_MEASUREMENT /end LOC_MEASUREMENT /begin SUB_FUNCTION /end SUB_FUNCTION /end FUNCTION
/begin FUNCTION ZWGRU "Grundz¸ndwinkel"
 /begin DEF_CHARACTERISTIC CNOKT CWZWBANK KFDWSZ KFDWSZ2 KFDZK KFDZWKG KFSWKFZK KFZW KFZW2 KFZWA KFZWA2 TMZIZWV TSWKR VZIZWV /end DEF_CHARACTERISTIC
 /begin REF_CHARACTERISTIC SNM16ZUUW SRL12ZUUW /end REF_CHARACTERISTIC
 /begin IN_MEASUREMENT B_krdws B_nozwe dzwoag dzwol esst_snm16zuuw esst_srl12zuuw fnwaa fnwea lambas nmot rl tmot vfzg wkrma /end IN_MEASUREMENT
 /begin OUT_MEASUREMENT B_kfzk dzwbank dzwkg dzwnwsu dzwzk zwgru /end OUT_MEASUREMENT
 /begin LOC_MEASUREMENT dzwb2 zwnws zwnws0 zwnws1 /end LOC_MEASUREMENT
 /begin SUB_FUNCTION /end SUB_FUNCTION
/end FUNCTION
/begin FUNCTION ZWMIN "Berechnung des sp‰test erlaubten Z¸ndwinkels"
 /begin DEF_CHARACTERISTIC CWKHZW DNTIPDYN DNZWMN DZWAML DZWDYN DZWSPM FZWKHMX KFDZMNST KFZWMN KFZWMNKH KFZWMNST KFZWMS KLFZWMNKH KLFZWMNST SNM04ZUUW SNS04ZUSB TTIPINEN TTIPINON TVZWMSA TVZWMSE ZWSPTIP /end DEF_CHARACTERISTIC
 /begin REF_CHARACTERISTIC ETADZW SNM16ZUUW SRL12ZUUW STM06__UB /end REF_CHARACTERISTIC
 /begin IN_MEASUREMENT B_kh B_kuppl B_kw B_ll B_llrein B_munst B_sa B_st dns dzwoag esst_snm16zuuw esst_srl12zuuw esst_stm06__ub fmdkh gangi migs_w misolv_w misol_w ml ngfil nmot nmot_w nstat rl tmot tnst_w zwist zwopt zwstt /end IN_MEASUREMENT
 /begin OUT_MEASUREMENT dzwspae esst_snm04zuuw esst_sns04zusb etazwmn zwspae /end OUT_MEASUREMENT
 /begin LOC_MEASUREMENT B_zwmnpst B_zwms dzwdyn dzwdyntp dzwmna fzwmn_w tzwmnnst_w zwlate zwmn zwmnd zwmnms zwmnt /end LOC_MEASUREMENT
 /begin SUB_FUNCTION /end SUB_FUNCTION
/end FUNCTION
/begin FUNCTION ZWOUT "Berechnung Ausgabez¸ndwinkel" /begin DEF_CHARACTERISTIC NACHZUEND WPHN /end DEF_CHARACTERISTIC /begin REF_CHARACTERISTIC SNM08__UB /end REF_CHARACTERISTIC /begin IN_MEASUREMENT esst_snm08__ub nmot zwbasar zwcalcar zzylzue /end IN_MEASUREMENT /begin OUT_MEASUREMENT B_zwkra znachanz zwist zwkrafld zwout zwoutcpl zwzyl1 /end OUT_MEASUREMENT /begin LOC_MEASUREMENT wphg /end LOC_MEASUREMENT /begin SUB_FUNCTION /end SUB_FUNCTION /end FUNCTION
/begin FUNCTION ZWSEL "Berechnung ZW nach Fr¸h- und Sp‰tbegrenzung" /begin DEF_CHARACTERISTIC /end DEF_CHARACTERISTIC /begin REF_CHARACTERISTIC /end REF_CHARACTERISTIC /begin IN_MEASUREMENT B_nozwe B_sa B_zwappl redist zwbasar zwsol zwspae zzylzue /end IN_MEASUREMENT /begin OUT_MEASUREMENT B_zwspae zwcalcar /end OUT_MEASUREMENT /begin LOC_MEASUREMENT /end LOC_MEASUREMENT /begin SUB_FUNCTION /end SUB_FUNCTION /end FUNCTION
/begin FUNCTION ZWSTT "Z¸ndung im Start" /begin DEF_CHARACTERISTIC DZWSTTA KFZWSTTM /end DEF_CHARACTERISTIC /begin REF_CHARACTERISTIC /end REF_CHARACTERISTIC /begin IN_MEASUREMENT B_llrein nmot tans tmst /end IN_MEASUREMENT /begin OUT_MEASUREMENT zwstt /end OUT_MEASUREMENT /begin LOC_MEASUREMENT /end LOC_MEASUREMENT /begin SUB_FUNCTION /end SUB_FUNCTION /end FUNCTION
/begin FUNCTION ZWWL "Warmlauf Z¸ndwinkel" /begin DEF_CHARACTERISTIC FZWWLRLN KFZWWLNM KFZWWLRL /end DEF_CHARACTERISTIC /begin REF_CHARACTERISTIC SNM12ESUB SRL06ESUB STA12WLUB /end REF_CHARACTERISTIC
 /begin IN_MEASUREMENT esst_snm12esub esst_srl06esub esst_sta12wlub nmot rl tans tmot /end IN_MEASUREMENT
 /begin OUT_MEASUREMENT dzwwl /end OUT_MEASUREMENT
 /begin LOC_MEASUREMENT /end LOC_MEASUREMENT
 /begin SUB_FUNCTION /end SUB_FUNCTION
/end FUNCTION
/begin COMPU_METHOD B_TRUE "boolsche Zust‰nde, positive Logik" TAB_VERB "%6.3" "" COMPU_TAB_REF B_TRUE /end COMPU_METHOD
/begin COMPU_VTAB B_TRUE "boolsche Zust‰nde, positive Logik" TAB_VERB 2 0 "----" 1 "TRUE" /end COMPU_VTAB
/begin COMPU_METHOD DEZ "1 : 1 Umrechnug (dez/hex)" RAT_FUNC "%6.2" "" COEFFS 0 1 0 0 0 1 /end COMPU_METHOD
/begin COMPU_METHOD dez "1 : 1 Umrechnug (dez/hex)" RAT_FUNC "%6.2" "" COEFFS 0 1 0 0 0 1 /end COMPU_METHOD
/begin COMPU_METHOD dezsub1 "" RAT_FUNC "%6.2" "-" COEFFS 0 1 -1 0 0 1 /end COMPU_METHOD
/begin COMPU_METHOD fak_q0p00392 "" RAT_FUNC "%6.4" "-" COEFFS 0 255 0 0 0 1 /end COMPU_METHOD
/begin COMPU_METHOD fak_q0p00781 "" RAT_FUNC "%6.4" "-" COEFFS 0 128 0 0 0 1 /end COMPU_METHOD
/begin COMPU_METHOD fak_ub_b1 "" RAT_FUNC "%6.4" "-" COEFFS 0 256 0 0 0 1 /end COMPU_METHOD
/begin COMPU_METHOD fak_ub_b2 "" RAT_FUNC "%6.4" "-" COEFFS 0 256 0 0 0 2 /end COMPU_METHOD
/begin COMPU_METHOD fak_ub_b4 "" RAT_FUNC "%6.4" "-" COEFFS 0 256 0 0 0 4 /end COMPU_METHOD
/begin COMPU_METHOD fak_ub_b8 "" RAT_FUNC "%6.4" "-" COEFFS 0 256 0 0 0 8 /end COMPU_METHOD
/begin COMPU_METHOD fak_uw_b1 "" RAT_FUNC "%7.6" "-" COEFFS 0 65536 0 0 0 1 /end COMPU_METHOD
/begin COMPU_METHOD fak_uw_b2 "" RAT_FUNC "%7.6" "-" COEFFS 0 65536 0 0 0 2 /end COMPU_METHOD
/begin COMPU_METHOD fquarz_uw_q1p0 "" RAT_FUNC "%6.2" "MHz" COEFFS 0 1 0 0 0 1 /end COMPU_METHOD
/begin COMPU_METHOD hub_ub_q0p064 "" RAT_FUNC "%6.4" "mm" COEFFS 0 255 0 0 0 16.32 /end COMPU_METHOD
/begin COMPU_METHOD kumsrl_ub_b0p002 "" RAT_FUNC "%10.9" "(kg/h)/((1/min)*%)" COEFFS 0 128000 0 0 0 1 /end COMPU_METHOD
/begin COMPU_METHOD kw_q0p0039 "" RAT_FUNC "%6.4" "Grad KW" COEFFS 0 256 0 0 0 1 /end COMPU_METHOD
/begin COMPU_METHOD kw_q0p0078 "" RAT_FUNC "%6.4" "Grad KW" COEFFS 0 128 0 0 0 1 /end COMPU_METHOD
/begin COMPU_METHOD kw_q0p0156 "" RAT_FUNC "%6.4" "Grad KW" COEFFS 0 64 0 0 0 1 /end COMPU_METHOD
/begin COMPU_METHOD kw_q0p0625 "" RAT_FUNC "%6.4" "Grad KW" COEFFS 0 16 0 0 0 1 /end COMPU_METHOD
/begin COMPU_METHOD kw_q1 "" RAT_FUNC "%6.2" "Grad KW" COEFFS 0 1 0 0 0 1 /end COMPU_METHOD
/begin COMPU_METHOD m_q7p5 "" RAT_FUNC "%6.2" "kg/h" COEFFS 0 1 0 0 0 7.5 /end COMPU_METHOD
/begin COMPU_METHOD m_ub_b1020 "" RAT_FUNC "%6.2" "kg/h" COEFFS 0 1 0 0 0 4 /end COMPU_METHOD
/begin COMPU_METHOD nmotd_sb_q10 "" RAT_FUNC "%6.1" "1/min" COEFFS 0 1 0 0 0 10 /end COMPU_METHOD
/begin COMPU_METHOD nmotg_sb_q100 "" RAT_FUNC "%6.0" "1/min/s" COEFFS 0 1 0 0 0 100 /end COMPU_METHOD
/begin COMPU_METHOD nmot_ub_q40 "" RAT_FUNC "%6.1" "1/min" COEFFS 0 1 0 0 0 40 /end COMPU_METHOD
/begin COMPU_METHOD nmot_uw_q0p25 "" RAT_FUNC "%6.3" "1/min" COEFFS 0 1 0 0 0 0.25 /end COMPU_METHOD
/begin COMPU_METHOD p_q0p0195 "" RAT_FUNC "%6.4" "HPa" COEFFS 0 256 0 0 0 5 /end COMPU_METHOD
/begin COMPU_METHOD p_q5 "" RAT_FUNC "%6.2" "HPa" COEFFS 0 1 0 0 0 5 /end COMPU_METHOD
/begin COMPU_METHOD relDK_ub_b100 "" RAT_FUNC "%6.3" "%DK" COEFFS 0 255 0 0 0 100 /end COMPU_METHOD
/begin COMPU_METHOD relDK_uw_b100 "" RAT_FUNC "%6.4" "%DK" COEFFS 0 65535 0 0 0 100 /end COMPU_METHOD
/begin COMPU_METHOD relKW_q0p0015259 "" RAT_FUNC "%6.4" "%/Grad KW" COEFFS 0 65536 0 0 0 100 /end COMPU_METHOD
/begin COMPU_METHOD relPED_ub_b100 "" RAT_FUNC "%6.3" "%PED" COEFFS 0 255 0 0 0 100 /end COMPU_METHOD
/begin COMPU_METHOD rel_sw_b200 "" RAT_FUNC "%6.4" "%" COEFFS 0 65536 0 0 0 400 /end COMPU_METHOD
/begin COMPU_METHOD rel_ub_b127p5 "" RAT_FUNC "%6.3" "%" COEFFS 0 2 0 0 0 1 /end COMPU_METHOD
/begin COMPU_METHOD rel_ub_b99p6 "" RAT_FUNC "%6.3" "%" COEFFS 0 256 0 0 0 100 /end COMPU_METHOD
/begin COMPU_METHOD rel_ub_q0p00153 "" RAT_FUNC "%6.4" "%" COEFFS 0 256 0 0 0 0.3906 /end COMPU_METHOD
/begin COMPU_METHOD rel_ub_q0p0029 "" RAT_FUNC "%6.4" "%" COEFFS 0 256 0 0 0 0.75 /end COMPU_METHOD
/begin COMPU_METHOD rel_ub_q0p3906 "" RAT_FUNC "%6.3" "%" COEFFS 0 256 0 0 0 100 /end COMPU_METHOD
/begin COMPU_METHOD rel_ub_q0p75 "" RAT_FUNC "%6.3" "%" COEFFS 0 1 0 0 0 0.75 /end COMPU_METHOD
/begin COMPU_METHOD rel_uw_b100 "" RAT_FUNC "%6.4" "%" COEFFS 0 65536 0 0 0 100 /end COMPU_METHOD
/begin COMPU_METHOD rel_uw_q0p0234 "" RAT_FUNC "%6.4" "%" COEFFS 0 32 0 0 0 0.75 /end COMPU_METHOD
/begin COMPU_METHOD rel_uw_q0p75 "" RAT_FUNC "%6.3" "%" COEFFS 0 1 0 0 0 0.75 /end COMPU_METHOD
/begin COMPU_METHOD spg_q0p00977 "" RAT_FUNC "%6.4" "V" COEFFS 0 256 0 0 0 2.5 /end COMPU_METHOD
/begin COMPU_METHOD spg_ubatt "" RAT_FUNC "%6.3" "V" COEFFS 0 1 0 0 0 0.0942 /end COMPU_METHOD
/begin COMPU_METHOD spg_ub_q0p0098 "" RAT_FUNC "%6.4" "V" COEFFS 0 256 0 0 0 2.5 /end COMPU_METHOD
/begin COMPU_METHOD spg_ub_q0p019 "" RAT_FUNC "%6.4" "V" COEFFS 0 256 0 0 0 5 /end COMPU_METHOD
/begin COMPU_METHOD t100msxs_ub_b25p5 "" RAT_FUNC "%6.3" "s" COEFFS 0 1 0 0 0 0.1 /end COMPU_METHOD
/begin COMPU_METHOD t10msxs_ub_b2p55 "" RAT_FUNC "%6.4" "s" COEFFS 0 1 0 0 0 0.01 /end COMPU_METHOD
/begin COMPU_METHOD t10msxs_uw_b655p35 "" RAT_FUNC "%6.4" "s" COEFFS 0 1 0 0 0 0.01 /end COMPU_METHOD
/begin COMPU_METHOD t10ms_ub_b2550 "" RAT_FUNC "%7.2" "ms" COEFFS 0 1 0 0 0 10 /end COMPU_METHOD
/begin COMPU_METHOD t1sxs_uw_q1 "" RAT_FUNC "%6.2" "s" COEFFS 0 1 0 0 0 1 /end COMPU_METHOD
/begin COMPU_METHOD t20ms_ub_b5100 "" RAT_FUNC "%7.2" "ms" COEFFS 0 1 0 0 0 20 /end COMPU_METHOD
/begin COMPU_METHOD t40msxs_uw_q0p04 "" RAT_FUNC "%6.4" "s" COEFFS 0 1 0 0 0 0.04 /end COMPU_METHOD
/begin COMPU_METHOD t40ms_ub_b10200 "" RAT_FUNC "%7.2" "ms" COEFFS 0 1 0 0 0 40 /end COMPU_METHOD
/begin COMPU_METHOD t50msxs_ub_b12p75 "" RAT_FUNC "%6.4" "s" COEFFS 0 1 0 0 0 0.05 /end COMPU_METHOD
/begin COMPU_METHOD temp_q0p0234_o273 "" RAT_FUNC "%6.1" "Grad C" COEFFS 0 1 273.15 0 0 0.0234375 /end COMPU_METHOD
/begin COMPU_METHOD temp_ub_q0p75_o48 "" RAT_FUNC "%6.2" "Grad C" COEFFS 0 1 48 0 0 0.75 /end COMPU_METHOD
/begin COMPU_METHOD tns_q1 "" RAT_FUNC "%6.2" "ns" COEFFS 0 1 0 0 0 1 /end COMPU_METHOD
/begin COMPU_METHOD tv_uw_b100 "" RAT_FUNC "%6.4" "%TV" COEFFS 0 65535 0 0 0 100 /end COMPU_METHOD
/begin COMPU_METHOD txms_uw_q0p0004 "" RAT_FUNC "%6.5" "ms" COEFFS 0 2500 0 0 0 1 /end COMPU_METHOD
/begin COMPU_METHOD t_q0p001_ms "" RAT_FUNC "%6.5" "ms" COEFFS 0 1 0 0 0 0.001 /end COMPU_METHOD
/begin COMPU_METHOD vfzg_ub_q1p25 "" RAT_FUNC "%6.2" "km/h" COEFFS 0 1 0 0 0 1.25 /end COMPU_METHOD
/begin COMPU_METHOD zk10msxs_uw_b655 "" RAT_FUNC "%10.4" "s" COEFFS 0 0 65536 0 100 0 /end COMPU_METHOD
/begin COMPU_METHOD zk40ms_ub_b10200 "" RAT_FUNC "%6.1" "ms" COEFFS 0 0 10240 0 1 40 /end COMPU_METHOD
/begin COMPU_METHOD zw_sb_q0p75 "" RAT_FUNC "%6.3" "Grad KW" COEFFS 0 255 0 0 0 191.25 /end COMPU_METHOD
/begin COMPU_METHOD zw_ub_q0p75 "" RAT_FUNC "%6.3" "Grad KW" COEFFS 0 255 0 0 0 191.25 /end COMPU_METHOD
/begin COMPU_METHOD zw_ub_qn0p75 "" RAT_FUNC "%6.4" "Grad KW" COEFFS 0 1 0 0 0 -0.75 /end COMPU_METHOD
/begin COMPU_METHOD defaultAscii "" RAT_FUNC "%6.2" "" COEFFS 0 1 0 0 0 1 /end COMPU_METHOD
/begin RECORD_LAYOUT GkfWSb FNC_VALUES 1 SBYTE COLUMN_DIR DIRECT /end RECORD_LAYOUT
/begin RECORD_LAYOUT GkfWSw FNC_VALUES 1 SWORD COLUMN_DIR DIRECT /end RECORD_LAYOUT
/begin RECORD_LAYOUT GkfWUb FNC_VALUES 1 UBYTE COLUMN_DIR DIRECT /end RECORD_LAYOUT
/begin RECORD_LAYOUT GklWS8 FNC_VALUES 1 SBYTE COLUMN_DIR DIRECT /end RECORD_LAYOUT
/begin RECORD_LAYOUT GklWSb FNC_VALUES 1 SBYTE COLUMN_DIR DIRECT /end RECORD_LAYOUT
/begin RECORD_LAYOUT GklWSw FNC_VALUES 1 SWORD COLUMN_DIR DIRECT /end RECORD_LAYOUT
/begin RECORD_LAYOUT KfAxUbAyUbSstxUbSstyUbWSb NO_AXIS_PTS_X 1 UBYTE NO_AXIS_PTS_Y 2 UBYTE AXIS_PTS_X 3 UBYTE INDEX_INCR DIRECT AXIS_PTS_Y 4 UBYTE INDEX_INCR DIRECT FNC_VALUES 5 SBYTE COLUMN_DIR DIRECT /end RECORD_LAYOUT
/begin RECORD_LAYOUT KfAxUbAyUbSstxUbSstyUbWUb NO_AXIS_PTS_X 1 UBYTE NO_AXIS_PTS_Y 2 UBYTE AXIS_PTS_X 3 UBYTE INDEX_INCR DIRECT AXIS_PTS_Y 4 UBYTE INDEX_INCR DIRECT FNC_VALUES 5 UBYTE COLUMN_DIR DIRECT /end RECORD_LAYOUT
/begin RECORD_LAYOUT KfAxUbAyUbSstxUbSstyUwWUw NO_AXIS_PTS_X 1 UBYTE NO_AXIS_PTS_Y 2 UBYTE AXIS_PTS_X 3 UBYTE INDEX_INCR DIRECT AXIS_PTS_Y 4 UWORD INDEX_INCR DIRECT FNC_VALUES 5 UWORD COLUMN_DIR DIRECT /end RECORD_LAYOUT
/begin RECORD_LAYOUT KlAUbSstUbWSb NO_AXIS_PTS_X 1 UBYTE AXIS_PTS_X 2 UBYTE INDEX_INCR DIRECT FNC_VALUES 3 SBYTE COLUMN_DIR DIRECT /end RECORD_LAYOUT
/begin RECORD_LAYOUT KlAUbSstUbWUb NO_AXIS_PTS_X 1 UBYTE AXIS_PTS_X 2 UBYTE INDEX_INCR DIRECT FNC_VALUES 3 UBYTE COLUMN_DIR DIRECT /end RECORD_LAYOUT
/begin RECORD_LAYOUT KlAUbSstUbWUw NO_AXIS_PTS_X 1 UBYTE AXIS_PTS_X 2 UBYTE INDEX_INCR DIRECT FNC_VALUES 3 UWORD COLUMN_DIR DIRECT /end RECORD_LAYOUT
/begin RECORD_LAYOUT KlAUwSstUwWUw NO_AXIS_PTS_X 1 UWORD AXIS_PTS_X 2 UWORD INDEX_INCR DIRECT FNC_VALUES 3 UWORD COLUMN_DIR DIRECT /end RECORD_LAYOUT
/begin RECORD_LAYOUT KwbUw FNC_VALUES 1 UWORD COLUMN_DIR DIRECT /end RECORD_LAYOUT
/begin RECORD_LAYOUT KwSb FNC_VALUES 1 SBYTE COLUMN_DIR DIRECT /end RECORD_LAYOUT
/begin RECORD_LAYOUT KwSw FNC_VALUES 1 SWORD COLUMN_DIR DIRECT /end RECORD_LAYOUT
/begin RECORD_LAYOUT KwUb FNC_VALUES 1 UBYTE COLUMN_DIR DIRECT /end RECORD_LAYOUT
/begin RECORD_LAYOUT KwUw FNC_VALUES 1 UWORD COLUMN_DIR DIRECT /end RECORD_LAYOUT
/begin RECORD_LAYOUT KwWS8 FNC_VALUES 1 SBYTE COLUMN_DIR DIRECT /end RECORD_LAYOUT
/begin RECORD_LAYOUT KwWU8 FNC_VALUES 1 UBYTE COLUMN_DIR DIRECT /end RECORD_LAYOUT
/begin RECORD_LAYOUT SstAUbSstSb NO_AXIS_PTS_X 1 UBYTE AXIS_PTS_X 2 SBYTE INDEX_INCR DIRECT /end RECORD_LAYOUT
/begin RECORD_LAYOUT SstAUbSstUb NO_AXIS_PTS_X 1 UBYTE AXIS_PTS_X 2 UBYTE INDEX_INCR DIRECT /end RECORD_LAYOUT
/begin RECORD_LAYOUT SstAUwSstUw NO_AXIS_PTS_X 1 UWORD AXIS_PTS_X 2 UWORD INDEX_INCR DIRECT /end RECORD_LAYOUT
/end MODULE
/end PROJECT
