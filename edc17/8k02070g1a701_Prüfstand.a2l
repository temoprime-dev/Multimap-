ASAP2_VERSION 1 3
/begin PROJECT _9702_071D00 "ME97"
/begin HEADER "" VERSION "_9702_071D00" PROJECT_NO _9702_071D00 /end HEADER
/begin MODULE DIM ""
/begin MOD_COMMON "" BYTE_ORDER MSB_FIRST ALIGNMENT_BYTE 1 ALIGNMENT_WORD 2 ALIGNMENT_LONG 2 ALIGNMENT_FLOAT32_IEEE 4 /end MOD_COMMON
/begin CHARACTERISTIC ANRZUEMX "Z¸ndungsz‰hler-Schwelle bis zu der STADAP aktiv" VALUE 0x1C53FC KwUb 255.0 dez 0.00 255.0 FORMAT "%5.1" /end CHARACTERISTIC
/begin CHARACTERISTIC ANZUSTA "Anzahl Motorumdrehungen f¸r Startautomatik" CURVE 0x1C6654 KlAUbSstUbWUb 255.0 dez 0.00 255.0 FORMAT "%5.1"
 /begin AXIS_DESCR STD_AXIS tmot temp_ub_q0p75_o48 4 -48.00 143.3 FORMAT "%5.1" DEPOSIT ABSOLUTE /end AXIS_DESCR
/end CHARACTERISTIC
/begin CHARACTERISTIC CDAGR "Codewort DAGR abschalten (EURO-Codierung), CD..=0 -> keine Diagnose" VALUE 0x1C6694 KwUb 255.0 dez 0.00 255.0 FORMAT "%5.1" /end CHARACTERISTIC
/begin CHARACTERISTIC CDDMTL "Codewort DMTL-Diagnose einschalten (EURO-Codierung), CD..=0 -> keine Dia" VALUE 0x1C6695 KwUb 255.0 dez 0.00 255.0 FORMAT "%5.1" /end CHARACTERISTIC
/begin CHARACTERISTIC CDEDSS "Codewort zum Aktivieren der %DDSS" VALUE 0x1C6696 KwUb 255.0 dez 0.00 255.0 FORMAT "%5.1" /end CHARACTERISTIC
/begin CHARACTERISTIC CDEFST "Codewort DFSTT abschalten (EURO-Codierung), CD..=0 -> keine Diagnose" VALUE 0x1C6697 KwUb 255.0 dez 0.00 255.0 FORMAT "%5.1" /end CHARACTERISTIC
/begin CHARACTERISTIC CDEHFM "Codewort zum Aktivieren der %DHFM" VALUE 0x1C6698 KwUb 255.0 dez 0.00 255.0 FORMAT "%5.1" /end CHARACTERISTIC
/begin CHARACTERISTIC CDHRLSU "Codewort zum Einschalten der DHRLSU" VALUE 0x1C6699 KwUb 255.0 dez 0.00 255.0 FORMAT "%5.1" /end CHARACTERISTIC
/begin CHARACTERISTIC CDHRLSUE "Codewort zum Einschalten der DHRLSUE" VALUE 0x1C669A KwUb 255.0 dez 0.00 255.0 FORMAT "%5.1" /end CHARACTERISTIC
/begin CHARACTERISTIC CDHSH "Codewort Heizerdiagnose hinter Kat (CDHSH = 0  => keine Diagnose)" VALUE 0x1C669B KwUb 255.0 dez 0.00 255.0 FORMAT "%5.1" /end CHARACTERISTIC
/begin CHARACTERISTIC CDHSV "Codewort Heizerdiagnose vor Kat im (CDHSV = 0  => keine Diagnose)" VALUE 0x1C669C KwUb 255.0 dez 0.00 255.0 FORMAT "%5.1" /end CHARACTERISTIC
/begin CHARACTERISTIC CDHSVSA "Codewort Heizerdiagnose vor Kat im Schub (CDHSVsa = 0  => keine Diagnose)" VALUE 0x1C6682 KwWU8 255.0 dez 0.00 255.0 FORMAT "%5.1" /end CHARACTERISTIC
/begin CHARACTERISTIC CDKAT "Codewort Katalysator-Diagnose im OBDII-Mode (invers: Europa-Mode)" VALUE 0x1C669D KwUb 255.0 dez 0.00 255.0 FORMAT "%5.1" /end CHARACTERISTIC
/begin CHARACTERISTIC CDKATSP "Codewort Katalysator-Diagnose im OBDII-Mode (invers: Europa-Mode)" VALUE 0x1C6683 KwWU8 255.0 dez 0.00 255.0 FORMAT "%5.1" /end CHARACTERISTIC
/begin CHARACTERISTIC CDKATSPF "Katdiagnose, Freigabe" VALUE 0x1C6684 KwWU8 255.0 dez 0.00 255.0 FORMAT "%5.1" /end CHARACTERISTIC
/begin CHARACTERISTIC CDKVS "Codeword DKVS aktiv/inaktiv, CD..=0 -> keine Diagnose" VALUE 0x1C669E KwUb 255.0 dez 0.00 255.0 FORMAT "%5.1" /end CHARACTERISTIC
/begin CHARACTERISTIC CDLASH "Codewort Lambdasondenalterungsdiagnose (SHK) im OBDII-Mode (invers: Europa-Mode)" VALUE 0x1C669F KwUb 255.0 dez 0.00 255.0 FORMAT "%5.1" /end CHARACTERISTIC
/begin CHARACTERISTIC CDLATP "Codewort Lambdasondenalterungsdiagnose (TP) im OBDII-Mode (invers: Europa-Mode)" VALUE 0x1C66A0 KwUb 255.0 dez 0.00 255.0 FORMAT "%5.1" /end CHARACTERISTIC
/begin CHARACTERISTIC CDLATV "Codewort Lambdasondenalterungsdiagnose (tv) im OBDII-Mode (invers: Europa-Mode)" VALUE 0x1C66A1 KwUb 255.0 dez 0.00 255.0 FORMAT "%5.1" /end CHARACTERISTIC
/begin CHARACTERISTIC CDLDP "Codewort LDP-Diagnose im OBDII-Modus (invers: Europa-Modus), CD..=0 -> keine Dia" VALUE 0x1C66A2 KwUb 255.0 dez 0.00 255.0 FORMAT "%5.1" /end CHARACTERISTIC
/begin CHARACTERISTIC CDLLR "Codewort DLLR abschalten (EURO-Codierung), CD..=0 -> keine Diagnose" VALUE 0x1C66A3 KwUb 255.0 dez 0.00 255.0 FORMAT "%5.1" /end CHARACTERISTIC
/begin CHARACTERISTIC CDLSH "Codewort Sondendiagnose hinter Kat im OBDII-Mode (invers: Europa-Mode)" VALUE 0x1C66A4 KwUb 255.0 dez 0.00 255.0 FORMAT "%5.1" /end CHARACTERISTIC
/begin CHARACTERISTIC CDLSV "Codewort Sondendiagnose vor KAT im OBDII-Mode" VALUE 0x1C66A5 KwUb 255.0 dez 0.00 255.0 FORMAT "%5.1" /end CHARACTERISTIC
/begin CHARACTERISTIC CDLSVV "Codewort Diagnose vertauschte Sonden vor Kat im OBDII-Mode (invers: Europa-Mode)" VALUE 0x1C66A6 KwUb 255.0 dez 0.00 255.0 FORMAT "%5.1" /end CHARACTERISTIC
/begin CHARACTERISTIC CDMD "Codewort DMD abschalten (EURO-Codierung), CD..=0 -> keine Diagnose" VALUE 0x1C66A7 KwUb 255.0 dez 0.00 255.0 FORMAT "%5.1" /end CHARACTERISTIC
/begin CHARACTERISTIC CDNWS "Codewort DNWS abschalten (EURO-Codierung), CD..=0 -> keine Diagnose" VALUE 0x1C6685 KwWU8 255.0 dez 0.00 255.0 FORMAT "%5.1" /end CHARACTERISTIC
/begin CHARACTERISTIC CDSLS "Euro-Byte f¸r Diagnose Sekund‰rluft-System" VALUE 0x1C66A8 KwUb 255.0 dez 0.00 255.0 FORMAT "%5.1" /end CHARACTERISTIC
/begin CHARACTERISTIC CDSWE "Codewort DSWE abschalten (EURO-Codierung), CD..=0 -> keine Diagnose" VALUE 0x1C66A9 KwUb 255.0 dez 0.00 255.0 FORMAT "%5.1" /end CHARACTERISTIC
/begin CHARACTERISTIC CDTANKL "Codewort DTANKL abschalten (EURO-Codierung), CD..=0 -> keine Diagnose" VALUE 0x1C66AA KwUb 255.0 dez 0.00 255.0 FORMAT "%5.1" /end CHARACTERISTIC
/begin CHARACTERISTIC CDTES "Codewort Tankentl¸ftungsdiagnose abschalten (EURO-Codierung), CD..=0 ->keine Dia" VALUE 0x1C66AB KwUb 255.0 dez 0.00 255.0 FORMAT "%5.1" /end CHARACTERISTIC
/begin CHARACTERISTIC CDWVERAD "Codewort : Sperrung Bedarfsadaption dmvadll f¸r AG" VALUE 0x1CED9A KwUb 255.0 dez 0.00 255.0 FORMAT "%5.1" /end CHARACTERISTIC
/begin CHARACTERISTIC CWADRES "Codewort f¸r Adaptionswerte lˆschen bei FSP lˆschen" VALUE 0x1CED9B KwUb 255.0 dez 0.00 255.0 FORMAT "%5.1" /end CHARACTERISTIC
/begin CHARACTERISTIC CWALE "Auslauferkennung aktiv" VALUE 0x1C6686 KwWU8 255.0 dez 0.00 255.0 FORMAT "%5.1" /end CHARACTERISTIC
/begin CHARACTERISTIC CWDLSU "Codewort f¸r DLSU" VALUE 0x1C6687 KwWU8 255.0 dez 0.00 255.0 FORMAT "%5.1" /end CHARACTERISTIC
/begin CHARACTERISTIC CWGANG "Codewort Gangauswahl Dauerstrichregeleinrichtung (in RKTI/RKTE)" VALUE 0x1CD96A KwUb 255.0 dez 0.00 255.0 FORMAT "%5.1" /end CHARACTERISTIC
/begin CHARACTERISTIC CWGEN1 "Codewort: kein Einfluss des Generatormomentes auf mdverl" VALUE 0x1C6688 KwWU8 255.0 dez 0.00 255.0 FORMAT "%5.1" /end CHARACTERISTIC
/begin CHARACTERISTIC CWGEN2 "Codewort: kein Einfluss des Generatormomentes auf mimin" VALUE 0x1C6689 KwWU8 255.0 dez 0.00 255.0 FORMAT "%5.1" /end CHARACTERISTIC
/begin CHARACTERISTIC CWHRLSU "Codewort Heizungsregelung LSU" VALUE 0x1C66AC KwUb 255.0 dez 0.00 255.0 FORMAT "%5.1" /end CHARACTERISTIC
/begin CHARACTERISTIC CWKMMILSCT "Ausgabe ""Km bei MIL on""  f¸r Scan Tool abschalten (0 = keine Ausgabe in PID $21)" VALUE 0x1C668A KwWU8 255.0 dez 0.00 255.0 FORMAT "%5.1" /end CHARACTERISTIC
/begin CHARACTERISTIC CWKONABG "Codewort f¸r Konfiguration Abgasbehandlung" VALUE 0x1CED9C KwUb 255.0 dez 0.00 255.0 FORMAT "%5.1" /end CHARACTERISTIC
/begin CHARACTERISTIC CWKONFLS "Beschreibung der Lambdasondenposition hinter Katalysator im Abgasstrang" VALUE 0x1C668B KwWU8 255.0 dez 0.00 255.0 FORMAT "%5.1" /end CHARACTERISTIC
/begin CHARACTERISTIC CWKONLS "Codewort f¸r Konfiguration Lambda Sonden" VALUE 0x1C668C KwWU8 255.0 dez 0.00 255.0 FORMAT "%5.1" /end CHARACTERISTIC
/begin CHARACTERISTIC CWLSHA "Codewort f¸r Lambdasonden hinter KAT Alterung in %DLSAHK" VALUE 0x1C668D KwWU8 255.0 dez 0.00 255.0 FORMAT "%5.1" /end CHARACTERISTIC
/begin CHARACTERISTIC CWMDAPP "Codewort Applikation ohne Drehmomentfunktionen" VALUE 0x1C668E KwWU8 255.0 dez 0.00 255.0 FORMAT "%5.1" /end CHARACTERISTIC
/begin CHARACTERISTIC CWNSABG "Codewort Einstellen Leerlauf-Solldrehzahl mit Diagnosetester" VALUE 0x1CED9D KwUb 255.0 dez 0.00 255.0 FORMAT "%5.1" /end CHARACTERISTIC
/begin CHARACTERISTIC CWNWEHOE "CW Umschaltung  f¸r Sollwertvorgabe bei Fehler  Einlassnockenwelle" VALUE 0x1C3BD8 KwUb 255.0 dez 0.00 255.0 FORMAT "%5.1" /end CHARACTERISTIC
/begin CHARACTERISTIC CWOBD "Codewort f¸r Konfiguration OBD Zertifikationsnachweis" VALUE 0x1C66AD KwUb 255.0 dez 0.00 255.0 FORMAT "%5.1" /end CHARACTERISTIC
/begin CHARACTERISTIC CWPKAPP "Codewort Applikation Druckreferenz f¸r Kraftstoffdruckregler" VALUE 0x1CD96B KwUb 255.0 dez 0.00 255.0 FORMAT "%5.1" /end CHARACTERISTIC
/begin CHARACTERISTIC CWPSGER "Codewort Umschaltung Saugrohrdruck von modelliertem auf gerechneten" VALUE 0x1C668F KwWU8 255.0 dez 0.00 255.0 FORMAT "%5.1" /end CHARACTERISTIC
/begin CHARACTERISTIC CWPWF "Codewort Powerfail" VALUE 0x1C6690 KwWU8 255.0 dez 0.00 255.0 FORMAT "%5.1" /end CHARACTERISTIC
/begin CHARACTERISTIC CWREGDS "Codewort Dauerstrichregelung" VALUE 0x1CD96C KwUb 255.0 dez 0.00 255.0 FORMAT "%5.1" /end CHARACTERISTIC
/begin CHARACTERISTIC CWRPSLSU "Codewort f¸r Referenzpumpstrom" VALUE 0x1CCBD2 KwWU8 255.0 dez 0.00 255.0 FORMAT "%5.1" /end CHARACTERISTIC
/begin CHARACTERISTIC CWRTFSGID "" VALUE 0x1C696C KwWU8 255.0 default 0.00 255.0 FORMAT "%5.1" /end CHARACTERISTIC
/begin CHARACTERISTIC CWRTFSGMEM "" VALUE 0x1C696D KwWU8 255.0 default 0.00 255.0 FORMAT "%5.1" /end CHARACTERISTIC
/begin CHARACTERISTIC CWRTFSGMOD "" VALUE 0x1C696E KwWU8 255.0 default 0.00 255.0 FORMAT "%5.1" /end CHARACTERISTIC
/begin CHARACTERISTIC CWSLS "Codewort f¸r Sekund‰rluftsystem" VALUE 0x1C66AE KwUb 255.0 dez 0.00 255.0 FORMAT "%5.1" /end CHARACTERISTIC
/begin CHARACTERISTIC CWSTA "Codewort f¸r Ansteuerung Start-Relais - Automatik" VALUE 0x1C665D KwUb 255.0 dez 0.00 255.0 FORMAT "%5.1" /end CHARACTERISTIC
/begin CHARACTERISTIC CWSTADAP "Codewort Startadaption" VALUE 0x1C53FD KwUb 255.0 dez 0.00 255.0 FORMAT "%5.1" /end CHARACTERISTIC
/begin CHARACTERISTIC CWSU "Codewort: Saugrohrumschaltung" VALUE 0x1C339C KwUb 255.0 dez 0.00 255.0 FORMAT "%5.1" /end CHARACTERISTIC
/begin CHARACTERISTIC CWTF "Codewort f¸r Konfiguration Temperaturf¸hler" VALUE 0x1C6691 KwWU8 255.0 dez 0.00 255.0 FORMAT "%5.1" /end CHARACTERISTIC
/begin CHARACTERISTIC CWUHR "Codewort f¸r Uhr" VALUE 0x1C6692 KwWU8 255.0 dez 0.00 255.0 FORMAT "%5.1" /end CHARACTERISTIC
/begin CHARACTERISTIC CWVL "Erkennung Vollast ¸ber relativen Fahrerwunsch (CWVL=1)" VALUE 0x1C6693 KwWU8 255.0 dez 0.00 255.0 FORMAT "%5.1" /end CHARACTERISTIC
/begin CHARACTERISTIC CW_RUNTIME "" VALUE 0x1C696F KwWU8 255.0 default 0.00 255.0 FORMAT "%5.1" /end CHARACTERISTIC
/begin CHARACTERISTIC DECKSTAI "Decrement-Step f¸r STADAP-Faktor" CURVE 0x1C5400 KlAUbSstUbWSb 1.000 fak_sb_b1 -1.000 0.00 FORMAT "%5.3"
 /begin AXIS_DESCR STD_AXIS tmadb dez 3 0.00 255.0 FORMAT "%5.1" DEPOSIT ABSOLUTE /end AXIS_DESCR
/end CHARACTERISTIC
/begin CHARACTERISTIC DNBURN0 "Minimaler Drehzahlanstieg f¸r erkannte Verbrennung im Bereich 0" CURVE 0x1C5446 KlAUwSstUwWUw 4112.000 nmot_uw_q0p25 0.00 4112.000 FORMAT "%8.3"
 /begin AXIS_DESCR STD_AXIS nmot_w nmot_uw_q0p25 12 0.00 16383.75 FORMAT "%8.2" DEPOSIT ABSOLUTE /end AXIS_DESCR
/end CHARACTERISTIC
/begin CHARACTERISTIC DNBURN1 "Minimaler Drehzahlanstieg f¸r erkannte Verbrennung im Bereich 1" CURVE 0x1C5478 KlAUwSstUwWUw 4112.000 nmot_uw_q0p25 0.00 4112.000 FORMAT "%8.3"
 /begin AXIS_DESCR STD_AXIS nmot_w nmot_uw_q0p25 12 0.00 16383.75 FORMAT "%8.2" DEPOSIT ABSOLUTE /end AXIS_DESCR
/end CHARACTERISTIC
/begin CHARACTERISTIC DNBURN2 "Minimaler Drehzahlanstieg f¸r erkannte Verbrennung im Bereich 2" CURVE 0x1C54AA KlAUwSstUwWUw 4112.000 nmot_uw_q0p25 0.00 4112.000 FORMAT "%8.3"
 /begin AXIS_DESCR STD_AXIS nmot_w nmot_uw_q0p25 12 0.00 16383.75 FORMAT "%8.2" DEPOSIT ABSOLUTE /end AXIS_DESCR
/end CHARACTERISTIC
/begin CHARACTERISTIC DWNWABGE "Max-Winkel zur Berechnung der Sollwert‰nderungsbegrenzung Einlass Nockenwelle" CURVE 0x1CB2AE GklWUw 511.9922 kw_q0p0078 0.00 511.9922 FORMAT "%8.4"
 /begin AXIS_DESCR COM_AXIS nmot_w nmot_uw_q0p25 5 0.00 16383.75 AXIS_PTS_REF SNM05NWUW /end AXIS_DESCR
/end CHARACTERISTIC
/begin CHARACTERISTIC DWNWAMXE "Max-Winkel zur Abschaltung der Sollwert‰nderungsbegrenzung Einlass Nockenwelle" CURVE 0x1C3C2E GklWUw 511.9922 kw_q0p0078 0.00 511.9922 FORMAT "%8.4"
 /begin AXIS_DESCR COM_AXIS nmot_w nmot_uw_q0p25 5 0.00 16383.75 AXIS_PTS_REF SNM05NWUW /end AXIS_DESCR
/end CHARACTERISTIC
/begin CHARACTERISTIC EBENSALSU "ETK-Bypass enable f¸r %SALSU" VALUE 0x1C4DB4 KwUb 255.0 dez 0.00 255.0 FORMAT "%5.1" /end CHARACTERISTIC
/begin CHARACTERISTIC EBOYKO2VK "Offset f¸r ko2vk_w in CHNL_Y (ETK-Bypass)" VALUE 0x1C4DB5 KwUb 255.0 dez 0.00 255.0 FORMAT "%5.1" /end CHARACTERISTIC
/begin CHARACTERISTIC EBOYKO2VK2 "Offset f¸r ko2vk2_w in CHNL_Y (ETK-Bypass)" VALUE 0x1C4DB6 KwUb 255.0 dez 0.00 255.0 FORMAT "%5.1" /end CHARACTERISTIC
/begin CHARACTERISTIC EBOYO2AD "Offset f¸r o2adap_w in CHNL_Y (ETK-Bypass)" VALUE 0x1C4DB7 KwUb 255.0 dez 0.00 255.0 FORMAT "%5.1" /end CHARACTERISTIC
/begin CHARACTERISTIC EBOYO2AD2 "Offset f¸r o2adap2_w in CHNL_Y (ETK-Bypass)" VALUE 0x1C4DB8 KwUb 255.0 dez 0.00 255.0 FORMAT "%5.1" /end CHARACTERISTIC
/begin CHARACTERISTIC ENSUKHG "Freigabe Saugrohrumschaltung gangabhaengig" VALUE 0x1CA4F4 KwUb 255.0 dez 0.00 255.0 FORMAT "%5.1" /end CHARACTERISTIC
/begin CHARACTERISTIC FAKEZ "Festwert-Array zyl. individuelle Korrekturfaktoren d. eff. Einspritzdauer" CURVE 0x1C5632 FklWUw 1.999969 fak_uw_b2 0.00 1.999969 FORMAT "%8.6"
 /begin AXIS_DESCR FIX_AXIS i_zyl dez 8 0.00 7.000 FORMAT "%5.3" FIX_AXIS_PAR 0 0 8 /end AXIS_DESCR
/end CHARACTERISTIC
/begin CHARACTERISTIC FKKVS "Korrekturfaktor Kraftstoffversorgungssystem" MAP 0x1CD96E KfAxUwAyUwSstxUwSstyUwWUw 1.999969 fak_uw_b2 0.00 1.999969 FORMAT "%8.6"
 /begin AXIS_DESCR STD_AXIS nmot_w nmot_uw_q0p25 16 0.00 16383.75 FORMAT "%8.2" DEPOSIT ABSOLUTE /end AXIS_DESCR
 /begin AXIS_DESCR STD_AXIS tevfak_w t1p0usxms 16 0.00 65.53500 FORMAT "%8.5" DEPOSIT ABSOLUTE /end AXIS_DESCR
/end CHARACTERISTIC
/begin CHARACTERISTIC FNWSKRE "Faktor Nockenwellen-Sollwinkelkorrektur durch klopfende Verbrennungen Einlaﬂ" CURVE 0x1CB27C KlAUbSstUbWUb 1.000 fak_ub_b2 0.00 1.000 FORMAT "%5.3"
 /begin AXIS_DESCR STD_AXIS wkrma zw_sb_q0p75 3 0.00 191.3 FORMAT "%5.1" DEPOSIT ABSOLUTE /end AXIS_DESCR
/end CHARACTERISTIC
/begin CHARACTERISTIC FRLFSDP "Einspritzkorrektur bei RLFS" CURVE 0x1CDBB2 KlAUwSstSwWUw 1.999969 fak_uw_b2 0.00 1.999969 FORMAT "%8.6"
 /begin AXIS_DESCR STD_AXIS dppk_w p_sw_q0p312 11 -10240.00 10239.69 FORMAT "%8.2" DEPOSIT ABSOLUTE /end AXIS_DESCR
/end CHARACTERISTIC
/begin CHARACTERISTIC FSWPW "Filterkonstante (Wichtungsfaktor) zur Filterungvon sw_pw" VALUE 0x1D2FCA dc_KwUb 0.9961 DC_FKT256 0.00 0.9961 /end CHARACTERISTIC
/begin CHARACTERISTIC FWPBLSTO "" VALUE 0x1D24A8 dc_KwUw 1310.5 DC_TIME_20MS_U16 0.18000 1310.7 FORMAT "%6.1" /end CHARACTERISTIC
/begin CHARACTERISTIC FWPLWCN "" VALUE 0x1D313F dc_KwUb 253.0 DC_CNTR_U8 2.000 255.0 FORMAT "%5.1" /end CHARACTERISTIC
/begin CHARACTERISTIC FWPLWHO "" VALUE 0x1D24C0 dc_KwSw 100.0000 DC_PCT_S16 0.00 100.0000 FORMAT "%8.4" /end CHARACTERISTIC
/begin CHARACTERISTIC FWPLWHU "" VALUE 0x1D24C2 dc_KwSw 100.0000 DC_PCT_S16 0.00 100.0000 FORMAT "%8.4" /end CHARACTERISTIC
/begin CHARACTERISTIC FWPLWN "" VALUE 0x1D24C4 dc_KwSw 16383.5 DC_ROTSPD_S16 0.00 16383.5 FORMAT "%7.1" /end CHARACTERISTIC
/begin CHARACTERISTIC FWPLWSC "" VALUE 0x1D3140 dc_KwUb 255.0 DC_CNTR_U8 0.00 255.0 FORMAT "%5.1" /end CHARACTERISTIC
/begin CHARACTERISTIC FWPLWTO "" VALUE 0x1D24C6 dc_KwUw 1310.6 DC_TIME_20MS_U16 0.10000 1310.7 FORMAT "%6.1" /end CHARACTERISTIC
/begin CHARACTERISTIC FWPLWURI "" VALUE 0x1D24C8 dc_KwUw 32408. DC_WL05_U16DB 360.0 32768. FORMAT "%5.0" /end CHARACTERISTIC
/begin CHARACTERISTIC FWPLWWD "" VALUE 0x1D24CA dc_KwUw 32766. DC_WL05_U16DB 2.000 32768. FORMAT "%5.0" /end CHARACTERISTIC
/begin CHARACTERISTIC FWPMNAN "" VALUE 0x1D228A dc_KwSw 32767.5 DC_ROTSPD_S16 -16384.0 16383.5 FORMAT "%7.1" /end CHARACTERISTIC
/begin CHARACTERISTIC FWPMNAPW "" VALUE 0x1D228C dc_KwUw 200.0031 DC_PER0327 0.00 200.0031 FORMAT "%8.4" /end CHARACTERISTIC
/begin CHARACTERISTIC FWPMNAV "" VALUE 0x1D2288 dc_KwUw 4095.938 DC_VEHSPD_KMH_U16 0.00 4095.938 FORMAT "%8.3" /end CHARACTERISTIC
/begin CHARACTERISTIC FWSMEBR "" VALUE 0x1D24CC dc_KwUl 2147483647.00 DC_CNTR_U32 0.00 2147483647.00 FORMAT "%13.2" /end CHARACTERISTIC
/begin CHARACTERISTIC FWSMEBR2 "" VALUE 0x1D24D0 dc_KwUl 2147483647.00 DC_CNTR_U32 0.00 2147483647.00 FORMAT "%13.2" /end CHARACTERISTIC
/begin CHARACTERISTIC FWSMEHM "" VALUE 0x1D24D4 dc_KwSw 2047.938 DC_TRQ_S16 0.00 2047.938 FORMAT "%8.3" /end CHARACTERISTIC
/begin CHARACTERISTIC FWSMEHN "" VALUE 0x1D24D6 dc_KwSw 16383.5 DC_ROTSPD_S16 0.00 16383.5 FORMAT "%7.1" /end CHARACTERISTIC
/begin CHARACTERISTIC FWSMEHV "" VALUE 0x1D24D8 dc_KwUw 4095.938 DC_VEHSPD_KMH_U16 0.00 4095.938 FORMAT "%8.3" /end CHARACTERISTIC
/begin CHARACTERISTIC FWSMEN "" VALUE 0x1D24DA dc_KwSw 16383.5 DC_ROTSPD_S16 0.00 16383.5 FORMAT "%7.1" /end CHARACTERISTIC
/begin CHARACTERISTIC FWSMETTLB "" VALUE 0x1D24DC dc_KwUw 655.35 DC_TIME_10MS_U16 0.00 655.35 FORMAT "%6.2" /end CHARACTERISTIC
/begin CHARACTERISTIC FWSMEV "" VALUE 0x1D24DE dc_KwUw 4095.938 DC_VEHSPD_KMH_U16 0.00 4095.938 FORMAT "%8.3" /end CHARACTERISTIC
/begin CHARACTERISTIC FW_EHB_CN "EHB-Plaus: Entprellanzahl Nachrichtenunterbrechung" VALUE 0x1D313A dc_KwUb 2.000 DC_CNTR_U8 2.000 4.000 FORMAT "%5.3" /end CHARACTERISTIC
/begin CHARACTERISTIC FW_EHB_DN "EHB-Plaus: Delta nist_1u zu nsoll_ehb" VALUE 0x1D24AE dc_KwSw 32767.5 DC_ROTSPD_S16 -16384.0 16383.5 FORMAT "%7.1" /end CHARACTERISTIC
/begin CHARACTERISTIC FW_EHB_EZ "EHB-Plaus: Entprellzeit EHB-Anforderung B_ehb_bn1" VALUE 0x1D24B0 dc_KwUw 1310.7 DC_TIME_20MS_U16 0.00 1310.7 FORMAT "%6.1" /end CHARACTERISTIC
/begin CHARACTERISTIC FW_EHB_N "EHB-Plaus: Aktivierungsschwellwert Motordrehzahl" VALUE 0x1D24B2 dc_KwUw 32767.5 DC_ROTSPD_S16 0.00 32767.5 FORMAT "%7.1" /end CHARACTERISTIC
/begin CHARACTERISTIC FW_EHB_NS "EHB-Plaus: Schwellwert Motordrehzahl f¸r aktive/passive Anhebung" VALUE 0x1D24B4 dc_KwUw 32767.5 DC_ROTSPD_S16 0.00 32767.5 FORMAT "%7.1" /end CHARACTERISTIC
/begin CHARACTERISTIC FW_EHB_TO "EHB-Plaus: Entprellzeit Togglefehler" VALUE 0x1D24B6 dc_KwUw 1310.6 DC_TIME_20MS_U16 0.060000 1310.7 FORMAT "%6.1" /end CHARACTERISTIC
/begin CHARACTERISTIC FW_EHB_VS "EHB-Plaus: Schwellwert Geschwindigkeit f¸r aktive Anhebung ohne Bremse" VALUE 0x1D24B8 dc_KwUw 4095.938 DC_VEHSPD_KMH_U16 0.00 4095.938 FORMAT "%8.3" /end CHARACTERISTIC
/begin CHARACTERISTIC FW_EHB_WS "EHB-Plaus: Wiederholsperre Anforderung LL-Anhebung" VALUE 0x1D24BA dc_KwUw 1310.7 DC_TIME_20MS_U16 0.00 1310.7 FORMAT "%6.1" /end CHARACTERISTIC
/begin CHARACTERISTIC FW_PART_CN "Fehlerschwellwert fuer c_nomesX ART-Plausibilisierung" VALUE 0x1D3134 dc_KwUb 2.000 DC_CNTR_U8 2.000 4.000 FORMAT "%5.3" /end CHARACTERISTIC
/begin CHARACTERISTIC FW_PART_RD "Md-Dekrement momentenerniedrigende Rampe ART-Plausibilisierung" VALUE 0x1D24A4 dc_KwSw 2047.875 DC_TRQ_S16 0.06250000 2047.938 FORMAT "%8.3" /end CHARACTERISTIC
/begin CHARACTERISTIC FW_PART_RI "Md-Inkrement momentenerhoehende Rampe ART-Plausibilisierung" VALUE 0x1D24A6 dc_KwSw 2047.875 DC_TRQ_S16 0.06250000 2047.938 FORMAT "%8.3" /end CHARACTERISTIC
/begin CHARACTERISTIC FW_PART_TO "Fkt.zyklenanzahl regulaeres Togglefenster ART-Plausibilisierung" VALUE 0x1D3135 dc_KwUb 5.040 DC_TQ20 0.06000 5.100 FORMAT "%5.3" /end CHARACTERISTIC
/begin CHARACTERISTIC FW_PART_TR "Fkt.zyklenanzahl Entprelltogglefenster ART-Plausibilisierung" VALUE 0x1D3136 dc_KwUb 4.960 DC_TQ20 0.1400 5.100 FORMAT "%5.3" /end CHARACTERISTIC
/begin CHARACTERISTIC FW_PEGS_CN "Fehlerschwellwert fuer c_nomesX EGS-Plausibilisierung" VALUE 0x1D3137 dc_KwUb 2.000 DC_CNTR_U8 2.000 4.000 FORMAT "%5.3" /end CHARACTERISTIC
/begin CHARACTERISTIC FW_PEGS_RD "Md-Dekrement momentenerniedrigende Rampe EGS-Plausibilisierung" VALUE 0x1D24AA dc_KwSw 2047.875 DC_TRQ_S16 0.06250000 2047.938 FORMAT "%8.3" /end CHARACTERISTIC
/begin CHARACTERISTIC FW_PEGS_RI "Md-Inkrement momentenerhoehende Rampe EGS-Plausibilisierung" VALUE 0x1D24AC dc_KwSw 2047.875 DC_TRQ_S16 0.06250000 2047.938 FORMAT "%8.3" /end CHARACTERISTIC
/begin CHARACTERISTIC FW_PEGS_TO "Fkt.zyklenanzahl regulaeres Togglefenster EGS-Plausibilisierung" VALUE 0x1D3138 dc_KwUb 2.490 DC_TQ10 0.06000 2.550 FORMAT "%5.3" /end CHARACTERISTIC
/begin CHARACTERISTIC FW_PEGS_TR "Fkt.zyklenanzahl Entprelltogglefenster EGS-Plausibilisierung" VALUE 0x1D3139 dc_KwUb 2.410 DC_TQ10 0.1400 2.550 FORMAT "%5.3" /end CHARACTERISTIC
/begin CHARACTERISTIC FW_PESP_CN "Fehlerschwellwert fuer c_nomesX ESP-Plausibilisierung" VALUE 0x1D313B dc_KwUb 2.000 DC_CNTR_U8 2.000 4.000 FORMAT "%5.3" /end CHARACTERISTIC
/begin CHARACTERISTIC FW_PESP_RD "Md-Dekrement momentenerniedrigende Rampe ESP-Plausibilisierung" VALUE 0x1D24BC dc_KwSw 2047.875 DC_TRQ_S16 0.06250000 2047.938 FORMAT "%8.3" /end CHARACTERISTIC
/begin CHARACTERISTIC FW_PESP_RI "Md-Inkrement momentenerhoehende Rampe ESP-Plausibilisierung" VALUE 0x1D24BE dc_KwSw 2047.875 DC_TRQ_S16 0.06250000 2047.938 FORMAT "%8.3" /end CHARACTERISTIC
/begin CHARACTERISTIC FW_PESP_TO "Fkt.zyklenanzahl regulaeres Togglefenster ESP-Plausibilisierung" VALUE 0x1D313C dc_KwUb 5.040 DC_TQ20 0.06000 5.100 FORMAT "%5.3" /end CHARACTERISTIC
/begin CHARACTERISTIC FW_PESP_TR "Fkt.zyklenanzahl Entprelltogglefenster ESP-Plausibilisierung" VALUE 0x1D313D dc_KwUb 4.960 DC_TQ20 0.1400 5.100 FORMAT "%5.3" /end CHARACTERISTIC
/begin CHARACTERISTIC FW_PXXX_MO "Plausibilisierung Md-Schnittstellen: Motorenart" VALUE 0x1D313E dc_KwUb 1.000 DC_CNTR_U8 0.00 1.000 FORMAT "%5.3" /end CHARACTERISTIC
/begin CHARACTERISTIC FZG_ON "Betrieb im Fahrzeug" VALUE 0x1CED9E KwUb 255.0 dez 0.00 255.0 FORMAT "%5.1" /end CHARACTERISTIC
/begin CHARACTERISTIC INCKSTAI "Inkrement-Step f¸r STADAP-Faktor" CURVE 0x1C5408 KlAUbSstUbWSb 0.9922 fak_sb_b1 0.00 0.9922
 /begin AXIS_DESCR STD_AXIS tmadb dez 3 0.00 255.0 FORMAT "%5.1" DEPOSIT ABSOLUTE /end AXIS_DESCR
/end CHARACTERISTIC
/begin CHARACTERISTIC INFO1 "Information 1" ASCII 0x1C2168 KwbWU8 255.0 KennText 0.00 255.0 FORMAT "%5.1" NUMBER 20 /end CHARACTERISTIC
/begin CHARACTERISTIC IPREFLSUB "Grˆﬂe f¸r Basis-Referenzpumpstrom der LSU" VALUE 0x1CCBD3 KwWU8 15.00 dez 0.00 15.00 FORMAT "%5.2" /end CHARACTERISTIC
/begin CHARACTERISTIC IPREFLSUE "Grˆﬂe f¸r erhˆhten Ref.-Pumpstrom der LSU" VALUE 0x1CCBD4 KwWU8 15.00 dez 0.00 15.00 FORMAT "%5.2" /end CHARACTERISTIC
/begin CHARACTERISTIC KFNSTAMX "Drehzahlschwelle f¸r STADAP aktiv" MAP 0x1CD8B8 KfAxUbAyUbSstxUbSstyUbWUb 10200. nmot_ub_q40 0.00 10200. FORMAT "%5.0"
 /begin AXIS_DESCR STD_AXIS fho fak_ub_b4 4 0.00 3.984 FORMAT "%5.3" DEPOSIT ABSOLUTE /end AXIS_DESCR
 /begin AXIS_DESCR STD_AXIS nstat nmot_q10 4 0.00 2550. FORMAT "%5.0" DEPOSIT ABSOLUTE /end AXIS_DESCR
/end CHARACTERISTIC
/begin CHARACTERISTIC KFNWKHE "Kennfeld f¸r Nockenwellenspreizung bei Katheizen (Einlaﬂ)" MAP 0x1CB2B8 GkfWSw 511.9922 kw_sw_q0p0078 -256.0000 255.9922 FORMAT "%8.4"
 /begin AXIS_DESCR COM_AXIS nmot_w nmot_uw_q0p25 16 0.00 16383.75 AXIS_PTS_REF SNM16NEUW /end AXIS_DESCR
 /begin AXIS_DESCR COM_AXIS rlnw_w rel_uw_q0p0234 8 0.00 1535.977 AXIS_PTS_REF SRL08NEUW /end AXIS_DESCR
/end CHARACTERISTIC
/begin CHARACTERISTIC KFNWKHLLE "Kennfeld f¸r Nockenwellenspreizung bei Katheizen und B_ll (Einlaﬂ)" MAP 0x1CB3B8 GkfWSw 511.9922 kw_sw_q0p0078 -256.0000 255.9922 FORMAT "%8.4"
 /begin AXIS_DESCR COM_AXIS nmot_w nmot_uw_q0p25 5 0.00 16383.75 AXIS_PTS_REF SNM05NEUW /end AXIS_DESCR
 /begin AXIS_DESCR COM_AXIS rlnw_w rel_uw_q0p0234 5 0.00 1535.977 AXIS_PTS_REF SRL05NEUW /end AXIS_DESCR
/end CHARACTERISTIC
/begin CHARACTERISTIC KFNWKRE "Sollwinkel Nockenwelle  bei klopfender Verbrennung Einlaﬂ" MAP 0x1CB3EA GkfWSw 511.9922 kw_sw_q0p0078 -256.0000 255.9922 FORMAT "%8.4"
 /begin AXIS_DESCR COM_AXIS nmot_w nmot_uw_q0p25 16 0.00 16383.75 AXIS_PTS_REF SNM16NEUW /end AXIS_DESCR
 /begin AXIS_DESCR COM_AXIS rlnw_w rel_uw_q0p0234 8 0.00 1535.977 AXIS_PTS_REF SRL08NEUW /end AXIS_DESCR
/end CHARACTERISTIC
/begin CHARACTERISTIC KFNWLLE "Kennfeld f¸r Nockenwellenspreizung im Leerlauf (Einlaﬂ)" MAP 0x1CB4EA GkfWSw 511.9922 kw_sw_q0p0078 -256.0000 255.9922 FORMAT "%8.4"
 /begin AXIS_DESCR COM_AXIS nmot_w nmot_uw_q0p25 5 0.00 16383.75 AXIS_PTS_REF SNM05NEUW /end AXIS_DESCR
 /begin AXIS_DESCR COM_AXIS rlnw_w rel_uw_q0p0234 5 0.00 1535.977 AXIS_PTS_REF SRL05NEUW /end AXIS_DESCR
/end CHARACTERISTIC
/begin CHARACTERISTIC KFNWSE "Kennfeld f¸r Nockenwellenspreizung (Einlaﬂ)" MAP 0x1CB51C GkfWSw 511.9922 kw_sw_q0p0078 -256.0000 255.9922 FORMAT "%8.4"
 /begin AXIS_DESCR COM_AXIS nmot_w nmot_uw_q0p25 16 0.00 16383.75 AXIS_PTS_REF SNM16NEUW /end AXIS_DESCR
 /begin AXIS_DESCR COM_AXIS rlnw_w rel_uw_q0p0234 8 0.00 1535.977 AXIS_PTS_REF SRL08NEUW /end AXIS_DESCR
/end CHARACTERISTIC
/begin CHARACTERISTIC KFNWTME "Faktor ‹bergang von Kalt- auf Warm-Kennfelder bei Nockenwellensollwinkeln Einlaﬂ" MAP 0x1CB284 KfAxUbAyUbSstxUbSstyUbWUb 1.992 fak_ub_b2 0.00 1.992 FORMAT "%5.3"
 /begin AXIS_DESCR STD_AXIS tmot temp_ub_q0p75_o48 4 -48.00 143.3 FORMAT "%5.1" DEPOSIT ABSOLUTE /end AXIS_DESCR
 /begin AXIS_DESCR STD_AXIS tmst temp_ub_q0p75_o48 4 -48.00 143.3 FORMAT "%5.1" DEPOSIT ABSOLUTE /end AXIS_DESCR
/end CHARACTERISTIC
/begin CHARACTERISTIC KFNWWLE "Kennfeld f¸r Nockenwellenspreizung im Warmlauf (Einlaﬂ)" MAP 0x1CB61C GkfWSw 511.9922 kw_sw_q0p0078 -256.0000 255.9922 FORMAT "%8.4"
 /begin AXIS_DESCR COM_AXIS nmot_w nmot_uw_q0p25 16 0.00 16383.75 AXIS_PTS_REF SNM16NEUW /end AXIS_DESCR
 /begin AXIS_DESCR COM_AXIS rlnw_w rel_uw_q0p0234 8 0.00 1535.977 AXIS_PTS_REF SRL08NEUW /end AXIS_DESCR
/end CHARACTERISTIC
/begin CHARACTERISTIC KFNWWLLE "Kennfeld f¸r Nockenwellenspreizung im Warmlauf bei B_ll (Einlaﬂ)" MAP 0x1CB71C GkfWSw 511.9922 kw_sw_q0p0078 -256.0000 255.9922 FORMAT "%8.4"
 /begin AXIS_DESCR COM_AXIS nmot_w nmot_uw_q0p25 5 0.00 16383.75 AXIS_PTS_REF SNM05NEUW /end AXIS_DESCR
 /begin AXIS_DESCR COM_AXIS rlnw_w rel_uw_q0p0234 5 0.00 1535.977 AXIS_PTS_REF SRL05NEUW /end AXIS_DESCR
/end CHARACTERISTIC
/begin CHARACTERISTIC KFSU "Kennfeld f¸r Saugrohrumschaltung, Klappe 1" MAP 0x1CA4F8 KfAxUbAyUbSstxUbSstyUbWUb 2.000 dez 0.00 2.000 FORMAT "%5.3"
 /begin AXIS_DESCR STD_AXIS nmotsu nmot_ub_q40 12 0.00 10200. FORMAT "%5.0" DEPOSIT ABSOLUTE /end AXIS_DESCR
 /begin AXIS_DESCR STD_AXIS rlsu rel_ub_q0p75 8 0.00 191.3 FORMAT "%5.1" DEPOSIT ABSOLUTE /end AXIS_DESCR
/end CHARACTERISTIC
/begin CHARACTERISTIC KFWNWSAPE "Kennfeld f¸r Nockenwellenspreizung w‰hrend Applikationsphase Einlass" MAP 0x1CB74E KfAxUwAyUwSstxUwSstyUwWSw 511.9922 kw_sw_q0p0078 -256.0000 255.9922 FORMAT "%8.4"
 /begin AXIS_DESCR STD_AXIS nmot_w nmot_uw_q0p25 12 0.00 16383.75 FORMAT "%8.2" DEPOSIT ABSOLUTE /end AXIS_DESCR
 /begin AXIS_DESCR STD_AXIS rk_w rel_uw_b3072 8 0.00 3071.953 FORMAT "%8.3" DEPOSIT ABSOLUTE /end AXIS_DESCR
/end CHARACTERISTIC
/begin CHARACTERISTIC KIREGDS "Konstante I-Anteil Dauerstrich-Regler" VALUE 0x1CD96D KwUb 30.40 fak_q0p1192_Pdivmss 0.00 30.40 FORMAT "%5.2" /end CHARACTERISTIC
/begin CHARACTERISTIC KLAADO2_R "" MAP 0x1D1AB8 dc_GKfWUb 99.60938 DC_PCT_U8 0.00 99.60938 FORMAT "%8.5"
 /begin AXIS_DESCR COM_AXIS ETC_VariRate DC_DEZ 16 0.00 255.0 AXIS_PTS_REF SST_PWR_VG16 /end AXIS_DESCR
 /begin AXIS_DESCR COM_AXIS APP_ADD DC_PER0327 16 0.00 100.0000 AXIS_PTS_REF SWPEDV16 /end AXIS_DESCR
/end CHARACTERISTIC
/begin CHARACTERISTIC KLAADO3_R "" MAP 0x1D1BB8 dc_GKfWUb 99.60938 DC_PCT_U8 0.00 99.60938 FORMAT "%8.5"
 /begin AXIS_DESCR COM_AXIS ETC_VariRate DC_DEZ 16 0.00 255.0 AXIS_PTS_REF SST_PWR_VG16 /end AXIS_DESCR
 /begin AXIS_DESCR COM_AXIS APP_ADD DC_PER0327 16 0.00 100.0000 AXIS_PTS_REF SWPEDV16 /end AXIS_DESCR
/end CHARACTERISTIC
/begin CHARACTERISTIC KLAADO4_R "" MAP 0x1D1CB8 dc_GKfWUb 99.60938 DC_PCT_U8 0.00 99.60938 FORMAT "%8.5"
 /begin AXIS_DESCR COM_AXIS ETC_VariRate DC_DEZ 16 0.00 255.0 AXIS_PTS_REF SST_PWR_VG16 /end AXIS_DESCR
 /begin AXIS_DESCR COM_AXIS APP_ADD DC_PER0327 16 0.00 100.0000 AXIS_PTS_REF SWPEDV16 /end AXIS_DESCR
/end CHARACTERISTIC
/begin CHARACTERISTIC KLAADPSO_R "" MAP 0x1D1DB8 dc_GKfWUb 99.60938 DC_PCT_U8 0.00 99.60938 FORMAT "%8.5"
 /begin AXIS_DESCR COM_AXIS ETC_VariRate DC_DEZ 16 0.00 255.0 AXIS_PTS_REF SST_PWR_VG16 /end AXIS_DESCR
 /begin AXIS_DESCR COM_AXIS APP_ADD DC_PER0327 16 0.00 100.0000 AXIS_PTS_REF SWPEDV16 /end AXIS_DESCR
/end CHARACTERISTIC
/begin CHARACTERISTIC KLDNFHO "Wichtung Minimaler Drehzahlanstieg f¸r erkannte Verbrennung" CURVE 0x1CD8D4 KlAUbSstUbWUb 1.992 fak_ub_b2 0.00 1.992 FORMAT "%5.3"
 /begin AXIS_DESCR STD_AXIS fho fak_ub_b4 4 0.00 3.984 FORMAT "%5.3" DEPOSIT ABSOLUTE /end AXIS_DESCR
/end CHARACTERISTIC
/begin CHARACTERISTIC KLDWNWSUE "Sollwinkel‰nderung Einlaﬂnockenwelle bei aktiver Saugrohrumschaltung" CURVE 0x1CB83A KlAUwSstUwWSw 511.9922 kw_sw_q0p0078 -256.0000 255.9922 FORMAT "%8.4"
 /begin AXIS_DESCR STD_AXIS nmot_w nmot_uw_q0p25 5 0.00 16383.75 FORMAT "%8.2" DEPOSIT ABSOLUTE /end AXIS_DESCR
/end CHARACTERISTIC
/begin CHARACTERISTIC KLSMEFKT1 "" CURVE 0x1D24E0 dc_GKlWUb 7.96875 DC_FCTR_32_U8 0.00 7.96875 FORMAT "%7.5"
 /begin AXIS_DESCR COM_AXIS Veh_Spd DC_VEHSPD_KMH_U16 5 0.00 4095.938 AXIS_PTS_REF VCANV05 /end AXIS_DESCR
/end CHARACTERISTIC
/begin CHARACTERISTIC KLSMEFKT2 "" CURVE 0x1D24E8 dc_GKlWUb 7.96875 DC_FCTR_32_U8 0.00 7.96875 FORMAT "%7.5"
 /begin AXIS_DESCR COM_AXIS Veh_Spd DC_VEHSPD_KMH_U16 5 0.00 4095.938 AXIS_PTS_REF VCANV05 /end AXIS_DESCR
/end CHARACTERISTIC
/begin CHARACTERISTIC KLTVNW "Verstellzeit Nockenwelle" CURVE 0x1CB2A0 KlAUbSstUbWUb 12.75 t50msxs_q0p05 0.00 12.75 FORMAT "%5.2"
 /begin AXIS_DESCR STD_AXIS tmot temp_ub_q0p75_o48 6 -48.00 143.3 FORMAT "%5.1" DEPOSIT ABSOLUTE /end AXIS_DESCR
/end CHARACTERISTIC
/begin CHARACTERISTIC KO2INI "Initialisierunswert f¸r Korrektur Funktionspumpstrom LSU" VALUE 0x1CCB6A KwUw 15.99976 fak_uw_b16 0.00 15.99976 FORMAT "%8.5" /end CHARACTERISTIC
/begin CHARACTERISTIC KO2MN "Min. zul‰ssiger Korrekturfaktor f¸r Funktionspumpstorm-Korrektur" VALUE 0x1CCB6C KwUw 15.99976 fak_uw_b16 0.00 15.99976 FORMAT "%8.5" /end CHARACTERISTIC
/begin CHARACTERISTIC KO2MX "Max. zul‰ssiger Korrekturfaktor f¸r Funktionspumpstorm-Korrektur" VALUE 0x1CCB6E KwUw 15.99976 fak_uw_b16 0.00 15.99976 FORMAT "%8.5" /end CHARACTERISTIC
/begin CHARACTERISTIC KPREGDS "Konstante P-Anteil Dauerstrich-Regler" VALUE 0x1CDBE0 KwUw 6.002188 fak_q5p960Em3 0.00 6.002188 FORMAT "%8.6" /end CHARACTERISTIC
/begin CHARACTERISTIC KRKATE "Umrechnung relative Kraftstoffmasse rk in effektive Einspritzzeit te" VALUE 0x1CDBE2 KwUw 0.6826562 rkti_q0p10416Em4 0.00 0.6826562 FORMAT "%9.7" /end CHARACTERISTIC
/begin CHARACTERISTIC KSTA0INI "Initialisierungswert STADAP-Faktor in Bereich 0" VALUE 0x1C540F KwUb 1.992 fak_ub_b2 0.00 1.992 FORMAT "%5.3" /end CHARACTERISTIC
/begin CHARACTERISTIC KSTA1INI "Initialisierungswert STADAP-Faktor in Bereich 1" VALUE 0x1C5410 KwUb 1.992 fak_ub_b2 0.00 1.992 FORMAT "%5.3" /end CHARACTERISTIC
/begin CHARACTERISTIC KSTA2INI "Initialisierungswert STADAP-Faktor in Bereich 2" VALUE 0x1C5411 KwUb 1.992 fak_ub_b2 0.00 1.992 FORMAT "%5.3" /end CHARACTERISTIC
/begin CHARACTERISTIC KSTAI "Arbeitsbereiche f¸r STADAP-Faktoren" CURVE 0x1C5414 KlAUbSstUbWUb 255.0 dez 0.00 255.0 FORMAT "%5.1"
 /begin AXIS_DESCR STD_AXIS tmst temp_ub_q0p75_o48 12 -48.00 143.3 FORMAT "%5.1" DEPOSIT ABSOLUTE /end AXIS_DESCR
/end CHARACTERISTIC
/begin CHARACTERISTIC KSTAMN0 "Min-Begrenzung des STADAP-Faktors in Bereich 0" VALUE 0x1C542D KwUb 1.992 fak_ub_b2 0.00 1.992 FORMAT "%5.3" /end CHARACTERISTIC
/begin CHARACTERISTIC KSTAMN1 "Min-Begrenzung des STADAP-Faktors in Bereich 1" VALUE 0x1C542E KwUb 1.992 fak_ub_b2 0.00 1.992 FORMAT "%5.3" /end CHARACTERISTIC
/begin CHARACTERISTIC KSTAMN2 "Min-Begrenzung des STADAP-Faktors in Bereich 2" VALUE 0x1C542F KwUb 1.992 fak_ub_b2 0.00 1.992 FORMAT "%5.3" /end CHARACTERISTIC
/begin CHARACTERISTIC KSTAMX0 "Max-Begrenzung des STADAP-Faktors in Bereich 0" VALUE 0x1C5430 KwUb 0.9922 fak_ub_b2 1.000 1.992 FORMAT "%5.3" /end CHARACTERISTIC
/begin CHARACTERISTIC KSTAMX1 "Max-Begrenzung des STADAP-Faktors in Bereich 1" VALUE 0x1C5431 KwUb 0.9922 fak_ub_b2 1.000 1.992 FORMAT "%5.3" /end CHARACTERISTIC
/begin CHARACTERISTIC KSTAMX2 "Max-Begrenzung des STADAP-Faktors in Bereich 2" VALUE 0x1C5432 KwUb 0.9922 fak_ub_b2 1.000 1.992 FORMAT "%5.3" /end CHARACTERISTIC
/begin CHARACTERISTIC KSTTOPMN "Minimale Betriebsdauer seit PWF f¸r Startmengenadaption" VALUE 0x1C54DC KwUw 393210.0 t6minxmin_q6 0.00 393210.0 FORMAT "%8.1" /end CHARACTERISTIC
/begin CHARACTERISTIC KTNWSABGKE "Zeitkonstante f¸r Sollwert‰nderungsbegrenzung Einlaﬂnockenwelle kalt" MAP 0x1C3BDC GkfWUb 2.54000 zk10msxs_ub_b2p55 0.0100000 2.55000 FORMAT "%7.5"
 /begin AXIS_DESCR COM_AXIS nmot nmot_ub_q40 5 0.00 10200. AXIS_PTS_REF SNM05NWUB /end AXIS_DESCR
 /begin AXIS_DESCR COM_AXIS tmot temp_ub_q0p75_o48 5 -48.00 143.3 AXIS_PTS_REF STM05NWUB /end AXIS_DESCR
/end CHARACTERISTIC
/begin CHARACTERISTIC KTNWSNABGE "Zeitkonstante f¸r negative Sollwert‰nderungsbegrenzung Einlaﬂnockenwelle" MAP 0x1C3BF8 GkfWUb 2.54000 zk10msxs_ub_b2p55 0.0100000 2.55000 FORMAT "%7.5"
 /begin AXIS_DESCR COM_AXIS nmot nmot_ub_q40 5 0.00 10200. AXIS_PTS_REF SNM05NWUB /end AXIS_DESCR
 /begin AXIS_DESCR COM_AXIS tmot temp_ub_q0p75_o48 5 -48.00 143.3 AXIS_PTS_REF STM05NWUB /end AXIS_DESCR
/end CHARACTERISTIC
/begin CHARACTERISTIC KTNWSPABGE "Zeitkonstante f¸r positive Sollwert‰nderungsbegrenzung Einlaﬂnockenwelle" MAP 0x1C3C14 GkfWUb 2.54000 zk10msxs_ub_b2p55 0.0100000 2.55000 FORMAT "%7.5"
 /begin AXIS_DESCR COM_AXIS nmot nmot_ub_q40 5 0.00 10200. AXIS_PTS_REF SNM05NWUB /end AXIS_DESCR
 /begin AXIS_DESCR COM_AXIS tmot temp_ub_q0p75_o48 5 -48.00 143.3 AXIS_PTS_REF STM05NWUB /end AXIS_DESCR
/end CHARACTERISTIC
/begin CHARACTERISTIC NMKFNWLLE "Drehzahlschwelle zur Aktivierung LL-Sollwinkelkennfelder bei Einlaﬂnockenwelle" VALUE 0x1CB850 KwUw 16383.75 nmot_uw_q0p25 0.00 16383.75 FORMAT "%8.2" /end CHARACTERISTIC
/begin CHARACTERISTIC NMOTNGAS "Drehzahlkorrekturfaktor in Abh‰ngigkeit des Drehzahlgradienten" CURVE 0x1CA586 KlAUbSstSwWUw 1.000000 fak_ub_b2 0.9921875 1.992188 FORMAT "%8.6"
 /begin AXIS_DESCR STD_AXIS ngfilsu_w nmotg_sw_q0p39 6 -12800.16 12799.77 FORMAT "%8.2" DEPOSIT ABSOLUTE /end AXIS_DESCR
/end CHARACTERISTIC
/begin CHARACTERISTIC NNWGLEHE "Drehzahlschwelle Nockenwellengleichstellung bei Fehler in 2Bank-System Einlaﬂ" VALUE 0x1CB852 KwUw 16383.75 nmot_uw_q0p25 0.00 16383.75 FORMAT "%8.2" /end CHARACTERISTIC
/begin CHARACTERISTIC NSTAK "Anlassdrehzahlschwelle f¸r Hochlauferkennung" VALUE 0x1C54DE KwUw 16383.75 nmot_uw_q0p25 0.00 16383.75 FORMAT "%8.2" /end CHARACTERISTIC
/begin CHARACTERISTIC NSTMXM "Drehzahlschwelle f¸r Startende autom. Start f(TMOT)" CURVE 0x1C666E KlAUwSstUwWUw 16383.75 nmot_uw_q0p25 0.00 16383.75 FORMAT "%8.2"
 /begin AXIS_DESCR STD_AXIS tmot temp_ub_q0p75_o48 4 -48.00000 49103.25 FORMAT "%8.2" DEPOSIT ABSOLUTE /end AXIS_DESCR
/end CHARACTERISTIC
/begin CHARACTERISTIC NSWO "Drehzahlschwelle Umschaltg. zur Rechenzeitersparnis" VALUE 0x1CED9F KwUb 10200. nmot_ub_q40 0.00 10200. FORMAT "%5.0" /end CHARACTERISTIC
/begin CHARACTERISTIC NSWO1 "Drehzahlschwelle 1 Umschaltg. zur Rechenzeitersparnis" VALUE 0x1CEDA0 KwUb 10200. nmot_ub_q40 0.00 10200. FORMAT "%5.0" /end CHARACTERISTIC
/begin CHARACTERISTIC O2DELTAMN "Untere Grenze Differenz Referenz-O2 und Korr-O2 f¸r eingeschwungen Abgleich" VALUE 0x1CCB70 KwSw 63.99902 relO2_q9p765Em4 -32.00000 31.99902 FORMAT "%8.5" /end CHARACTERISTIC
/begin CHARACTERISTIC O2DELTAMX "Obere Grenze Differenz Referenz-O2 und Korr-O2 f¸r eingeschwungen Abgleich" VALUE 0x1CCB72 KwSw 63.99902 relO2_q9p765Em4 -32.00000 31.99902 FORMAT "%8.5" /end CHARACTERISTIC
/begin CHARACTERISTIC O2REF "Sauerstoffkonzentration in der Umgebungsluft (0% rel. Luftfeuchte)" VALUE 0x1C4DBC KwSw 63.99902 relO2_q9p765Em4 -32.00000 31.99902 FORMAT "%8.5" /end CHARACTERISTIC
/begin CHARACTERISTIC O2SAMN "Min. zul‰ssiger O2-Konzentration zur Aktivierung Schubableich" VALUE 0x1C4DBE KwSw 63.99902 relO2_q9p765Em4 -32.00000 31.99902 FORMAT "%8.5" /end CHARACTERISTIC
/begin CHARACTERISTIC O2SAMX "Max. zul‰ssiger O2-Konzentration zur Aktivierung Schubableich" VALUE 0x1C4DC0 KwSw 63.99902 relO2_q9p765Em4 -32.00000 31.99902 FORMAT "%8.5" /end CHARACTERISTIC
/begin CHARACTERISTIC PSAPES "Saugrohrdruck f¸r Applikation Einspritzung" VALUE 0x1CDBE4 KwUw 2559.961 p_uw_q0p039 0.00 2559.961 FORMAT "%8.3" /end CHARACTERISTIC
/begin CHARACTERISTIC RIRPSONS "Sollwert f¸r Ri bei welchem der Ref.-Pumpstrom wirksam ist" VALUE 0x1CCBCE KwWU16 2559.961 r_q0p0391 0.00 2559.961 FORMAT "%8.3" /end CHARACTERISTIC
/begin CHARACTERISTIC SADYNMX "Max. dynamische Welligkeit zur Aktivierung Schubagleich" VALUE 0x1C4DC2 KwSw 31.99902 relO2_q9p765Em4 0.00 31.99902 FORMAT "%8.5" /end CHARACTERISTIC
/begin AXIS_PTS SAN12ESUW "SST-Verteilung f¸r den begrenzten Einspritzz‰hler anztib_w" 0x1C68A2 anztib_w SstAUwSstUw 65535.00 dez 12 0.00 65535.00 FORMAT "%8.2" DEPOSIT ABSOLUTE /end AXIS_PTS
/begin CHARACTERISTIC SANMOT "Min. Drehzahl zur Aktivierung Schubabgleich" VALUE 0x1C4DB9 KwUb 10200. nmot_ub_q40 0.00 10200. FORMAT "%5.0" /end CHARACTERISTIC
/begin CHARACTERISTIC SATMOT "Min. Motortemperatur zur Aktivierung Schubabgleich" VALUE 0x1CCB68 KwUb 191.3 temp_ub_q0p75_o48 -48.00 143.3 FORMAT "%5.1" /end CHARACTERISTIC
/begin CHARACTERISTIC SATUMG "Max. zul‰ssige Umgebungstemperatur zur Aktivierung Schubabgleich" VALUE 0x1C4DBA KwUb 191.3 temp_ub_q0p75_o48 -48.00 143.3 FORMAT "%5.1" /end CHARACTERISTIC
/begin AXIS_PTS SDK10TEUB "wdkba abh‰ngige St¸tzstellen (Anzahl 10)" 0x1CEDA4 wdkba SstAUbSstUb 100.0 relDK_ub_b100 10 0.00 100.0 FORMAT "%5.1" DEPOSIT ABSOLUTE /end AXIS_PTS
/begin AXIS_PTS SDM05TESB "dmssginr abh‰ngige St¸tzstellen (Anzahl 5)" 0x1C66F4 dmssginr SstAU8SstS8 1.992 fak_sb_b1 5 -1.000 0.9922 FORMAT "%5.3" DEPOSIT ABSOLUTE /end AXIS_PTS
/begin AXIS_PTS SEZ06TMUB "St¸tzstellenverteilung, Z¸ndwinkelwirkungsgrad" 0x1CEDB0 etazwimt SstAUbSstUb 127.5 rel_ub_b127p5 6 0.00 127.5 FORMAT "%5.1" DEPOSIT ABSOLUTE /end AXIS_PTS
/begin AXIS_PTS SFR04BBUW "" 0x1C66B0 frhol_w SstAU8SstU16 1.999969 fak_uw_b2 4 0.00 1.999969 FORMAT "%8.6" DEPOSIT ABSOLUTE /end AXIS_PTS
/begin AXIS_PTS SFR05TEUB "frmit abh‰ngige St¸tzstellen (Anzahl 5)" 0x1CEDB8 frmit SstAUbSstUb 1.992 fak_ub_b2 5 0.00 1.992 FORMAT "%5.3" DEPOSIT ABSOLUTE /end AXIS_PTS
/begin AXIS_PTS SGA06MDUB "St¸tzstellenverteilung Ist Gang 6 Sst." 0x1CEEEC gangi SstAUbSstUb 255.0 dez 6 0.00 255.0 FORMAT "%5.1" DEPOSIT ABSOLUTE /end AXIS_PTS
/begin AXIS_PTS SGA07MDUB "Gruppenst¸tzstelle Gangabh‰ngig" 0x1CEDC0 gangi SstAUbSstUb 255.0 dez 7 0.00 255.0 FORMAT "%5.1" DEPOSIT ABSOLUTE /end AXIS_PTS
/begin AXIS_PTS SGA08MDUB "St¸tzstellenverteilung Ist Gang 8 Sst." 0x1CEDC8 gangi SstAUbSstUb 255.0 dez 8 0.00 255.0 FORMAT "%5.1" DEPOSIT ABSOLUTE /end AXIS_PTS
/begin AXIS_PTS SIM06ESUW "SST-Verteilung f¸r integrierten Luftmassenstrom ab Startende" 0x1CEEF4 imlatm_w SstAUwSstUw 23.30133 m_uw_b23p3 6 0.00 23.30133 FORMAT "%8.5" DEPOSIT ABSOLUTE /end AXIS_PTS
/begin AXIS_PTS SKS06ESUB "SST-Verteilung f¸r den Startadaptionsfaktor kstaa" 0x1C6744 kstaa SstAUbSstUb 1.992 fak_ub_b2 6 0.00 1.992 FORMAT "%5.3" DEPOSIT ABSOLUTE /end AXIS_PTS
/begin AXIS_PTS SLA05ESUB "St¸tzstellenverteilung Regelabweichung Lambda, 5 Sst." 0x1C68BC ladiff_w SstAUwSstUw 1.999969 fak_sw_b1 5 0.00 1.999969 FORMAT "%8.6" DEPOSIT ABSOLUTE /end AXIS_PTS
/begin AXIS_PTS SLX06TMUW "St¸tzstellenverteilung, Lambdasoll" 0x1CEF02 lamsbg_w SstAUwSstUw 15.99976 fak_uw_b16 6 0.00 15.99976 FORMAT "%8.5" DEPOSIT ABSOLUTE /end AXIS_PTS
/begin AXIS_PTS SLY06TMUW "St¸tzstellenverteilung, Lambdasoll Bank2" 0x1CEF10 lamsbg2_w SstAUwSstUw 15.99976 fak_uw_b16 6 0.00 15.99976 FORMAT "%8.5" DEPOSIT ABSOLUTE /end AXIS_PTS
/begin AXIS_PTS SMI04LLUB "St¸tzstellenverteilung: ind. Moment f¸r Momentenreserve" 0x1C68C8 mifa_w SstAUwSstUw 99.99847 rel_uw_b100 4 0.00 99.99847 FORMAT "%8.5" DEPOSIT ABSOLUTE /end AXIS_PTS
/begin AXIS_PTS SML06TEUB "ml abh‰ngige St¸tzstellen (Anzahl 6)" 0x1CEDD4 ml SstAUbSstUb 1020. m_ub_b1020 6 0.00 1020. FORMAT "%5.0" DEPOSIT ABSOLUTE /end AXIS_PTS
/begin AXIS_PTS SML06TMUW "St¸tzstellenverteilung, Luftmasse, 6 St¸tzstellen" 0x1CEF1E ml_w SstAUwSstUw 6553.500 m_uw_b6553p5 6 0.00 6553.500 FORMAT "%8.3" DEPOSIT ABSOLUTE /end AXIS_PTS
/begin AXIS_PTS SML07TMUW "St¸tzstellenverteilung, Luftmasse, 7 St¸tzstellen" 0x1CEF2C ml_w SstAUwSstUw 6553.500 m_uw_b6553p5 7 0.00 6553.500 FORMAT "%8.3" DEPOSIT ABSOLUTE /end AXIS_PTS
/begin AXIS_PTS SML08LHUB "ml abh‰ngige St¸tzstellen (Anzahl 8)" 0x1CEDDC ml SstAUbSstUb 1020. m_ub_b1020 8 0.00 1020. FORMAT "%5.0" DEPOSIT ABSOLUTE /end AXIS_PTS
/begin AXIS_PTS SN16KR1UB "" 0x1C66FC nmot SstAU8SstU8 10200. nmot_ub_q40 16 0.00 10200. FORMAT "%5.0" DEPOSIT ABSOLUTE /end AXIS_PTS
/begin AXIS_PTS SN16KR2UB "" 0x1C6710 nmot SstAU8SstU8 10200. nmot_ub_q40 16 0.00 10200. FORMAT "%5.0" DEPOSIT ABSOLUTE /end AXIS_PTS
/begin AXIS_PTS SNG06LLSB "St¸tzstellenverteilung Drehzahlgradient, 6 Sst." 0x1C674C ngfil SstAUbSstSb 25500. nmotg_sb_q100 6 -12800. 12700. FORMAT "%5.0" DEPOSIT ABSOLUTE /end AXIS_PTS
/begin AXIS_PTS SNM04DMUW1 "Drehzahlst¸tzstellen" 0x1C66BA nmot_w SstAU8SstU16 16383.75 nmot_uw_q0p25 4 0.00 16383.75 FORMAT "%8.2" DEPOSIT ABSOLUTE /end AXIS_PTS
/begin AXIS_PTS SNM04DMUW2 "Drehzahlst¸tzstellen" 0x1C66C4 nmot_w SstAU8SstU16 16383.75 nmot_uw_q0p25 4 0.00 16383.75 FORMAT "%8.2" DEPOSIT ABSOLUTE /end AXIS_PTS
/begin AXIS_PTS SNM04TEUB "Motordrehzahl-abh‰ngige St¸tzstellen (Anzahl =4)" 0x1C6724 nmot SstAU8SstU8 10200. nmot_ub_q40 4 0.00 10200. FORMAT "%5.0" DEPOSIT ABSOLUTE /end AXIS_PTS
/begin AXIS_PTS SNM05NAUW "Drehzahlst¸tzstellen Nockenwellensollwinkel Auslaﬂ" 0x1CB8A6 nmot_w SstAUwSstUw 16383.75 nmot_uw_q0p25 5 0.00 16383.75 FORMAT "%8.2" DEPOSIT ABSOLUTE /end AXIS_PTS
/begin AXIS_PTS SNM05NEUW "Drehzahlst¸tzstellen Nockenwellensollwinkel Einlaﬂ" 0x1CB8B2 nmot_w SstAUwSstUw 16383.75 nmot_uw_q0p25 5 0.00 16383.75 FORMAT "%8.2" DEPOSIT ABSOLUTE /end AXIS_PTS
/begin AXIS_PTS SNM05NWUB "Drehzahlst¸tzstellen Nockenwellensollwinkel" 0x1CB898 nmot SstAUbSstUb 10200. nmot_ub_q40 5 0.00 10200. FORMAT "%5.0" DEPOSIT ABSOLUTE /end AXIS_PTS
/begin AXIS_PTS SNM05NWUW "Drehzahlst¸tzstellen Nockenwellensollwinkel" 0x1CB8BE nmot_w SstAUwSstUw 16383.75 nmot_uw_q0p25 5 0.00 16383.75 FORMAT "%8.2" DEPOSIT ABSOLUTE /end AXIS_PTS
/begin AXIS_PTS SNM06ESUB "SST-Verteilung f¸r Drehzahl" 0x1CEDE8 nmot SstAUbSstUb 10200. nmot_ub_q40 6 0.00 10200. FORMAT "%5.0" DEPOSIT ABSOLUTE /end AXIS_PTS
/begin AXIS_PTS SNM06LLUB "S¸tzstellenverteilung f¸r Motordrehzahl" 0x1C6754 nmot SstAUbSstUb 10200. nmot_ub_q40 6 0.00 10200. FORMAT "%5.0" DEPOSIT ABSOLUTE /end AXIS_PTS
/begin AXIS_PTS SNM06MDUW "Rover" 0x1CEF3C nmot_w SstAUwSstUw 16383.75 nmot_uw_q0p25 6 0.00 16383.75 FORMAT "%8.2" DEPOSIT ABSOLUTE /end AXIS_PTS
/begin AXIS_PTS SNM06NWUW "Drehzahl St¸tzstellenverteilung f¸r NW-Regler Einlaﬂ" 0x1CB8CA nmot_w SstAUwSstUw 16383.75 nmot_uw_q0p25 6 0.00 16383.75 FORMAT "%8.2" DEPOSIT ABSOLUTE /end AXIS_PTS
/begin AXIS_PTS SNM07ASUB "Gruppenst¸tzstelle Motordrehzahl" 0x1C675C nmot SstAUbSstUb 10200. nmot_ub_q40 7 0.00 10200. FORMAT "%5.0" DEPOSIT ABSOLUTE /end AXIS_PTS
/begin AXIS_PTS SNM07ESUB "St¸tzstellenverteilung Drehzahl, 7 Sst." 0x1CEDF0 nmot SstAUbSstUb 10200. nmot_ub_q40 7 0.00 10200. FORMAT "%5.0" DEPOSIT ABSOLUTE /end AXIS_PTS
/begin AXIS_PTS SNM07LSUW "St¸tzstellenverteilung Reglerparameter LRS" 0x1C68D2 nmot_w SstAUwSstUw 16383.75 nmot_uw_q0p25 7 0.00 16383.75 FORMAT "%8.2" DEPOSIT ABSOLUTE /end AXIS_PTS
/begin AXIS_PTS SNM08DMUB "SST-Verteilung in DMD, 8 Drehzahl-SST" 0x1C6764 nmot SstAUbSstUb 10200. nmot_ub_q40 8 0.00 10200. FORMAT "%5.0" DEPOSIT ABSOLUTE /end AXIS_PTS
/begin AXIS_PTS SNM08DMUW1 "St¸tzstellen KF Fuel-on-Adaption" 0x1C66CE nmot_w SstAU8SstU16 16383.75 nmot_uw_q0p25 8 0.00 16383.75 FORMAT "%8.2" DEPOSIT ABSOLUTE /end AXIS_PTS
/begin AXIS_PTS SNM08DMUW2 "St¸tzstellen KF Fuel-on-Adaption" 0x1C66E0 nmot_w SstAU8SstU16 16383.75 nmot_uw_q0p25 8 0.00 16383.75 FORMAT "%8.2" DEPOSIT ABSOLUTE /end AXIS_PTS
/begin AXIS_PTS SNM08FEUB "St¸tzstellenverteilung Drehzahl, 08 Sst., F¸llungseingriffe" 0x1C6770 nmot SstAUbSstUb 10200. nmot_ub_q40 8 0.00 10200. FORMAT "%5.0" DEPOSIT ABSOLUTE /end AXIS_PTS
/begin AXIS_PTS SNM08GKUB "St¸tzstellenverteilung Gemischkontrolle 8 nmot St¸tzstellen" 0x1C672C nmot SstAU8SstU8 10200. nmot_ub_q40 8 0.00 10200. FORMAT "%5.0" DEPOSIT ABSOLUTE /end AXIS_PTS
/begin AXIS_PTS SNM08KRUW "St¸tzstellenverteilung Drehzahl, 8 Sst." 0x1CEF4A nmot_w SstAUwSstUw 16383.75 nmot_uw_q0p25 8 0.00 16383.75 FORMAT "%8.2" DEPOSIT ABSOLUTE /end AXIS_PTS
/begin AXIS_PTS SNM08LHUB "nmot abh‰ngige St¸tzstellen (Anzahl 8)" 0x1CEDF8 nmot SstAUbSstUb 10200. nmot_ub_q40 8 0.00 10200. FORMAT "%5.0" DEPOSIT ABSOLUTE /end AXIS_PTS
/begin AXIS_PTS SNM08OPUB "St¸tzstellenverteilung f¸r Motordrehzahl nmot" 0x1C677C nmot SstAUbSstUb 10200. nmot_ub_q40 8 0.00 10200. FORMAT "%5.0" DEPOSIT ABSOLUTE /end AXIS_PTS
/begin AXIS_PTS SNM08__UB "St¸tzstellenverteilung Drehzahl, 8 Sst." 0x1C6788 nmot SstAUbSstUb 10200. nmot_ub_q40 8 0.00 10200. FORMAT "%5.0" DEPOSIT ABSOLUTE /end AXIS_PTS
/begin AXIS_PTS SNM10LSUB "St¸tzstellenverteilung Kat-Vorsteuerwert LRS" 0x1C6794 nmot SstAUbSstUb 10200. nmot_ub_q40 10 0.00 10200. FORMAT "%5.0" DEPOSIT ABSOLUTE /end AXIS_PTS
/begin AXIS_PTS SNM10TEUB "nmot abh‰ngige St¸tzstellen (Anzahl 10)" 0x1CEE04 nmot SstAUbSstUb 10200. nmot_ub_q40 10 0.00 10200. FORMAT "%5.0" DEPOSIT ABSOLUTE /end AXIS_PTS
/begin AXIS_PTS SNM12ESUB "SST-Verteilung f¸r die Motordrehzahl nmot" 0x1C67A0 nmot SstAUbSstUb 10200. nmot_ub_q40 12 0.00 10200. FORMAT "%5.0" DEPOSIT ABSOLUTE /end AXIS_PTS
/begin AXIS_PTS SNM12FEUB "St¸tzstellen f¸r WDKSMX, WDKUGDN" 0x1C67B0 nmot SstAUbSstUb 10200. nmot_ub_q40 12 0.00 10200. FORMAT "%5.0" DEPOSIT ABSOLUTE /end AXIS_PTS
/begin AXIS_PTS SNM16KRUB "St¸tzstellenverteilung Drehzahl, 16 Sst." 0x1CEE10 nmot SstAUbSstUb 10200. nmot_ub_q40 16 0.00 10200. FORMAT "%5.0" DEPOSIT ABSOLUTE /end AXIS_PTS
/begin AXIS_PTS SNM16NAUW "Drehzahlst¸tzstellen Nockenwellensollwinkel Auslaﬂ" 0x1CB8D8 nmot_w SstAUwSstUw 16383.75 nmot_uw_q0p25 16 0.00 16383.75 FORMAT "%8.2" DEPOSIT ABSOLUTE /end AXIS_PTS
/begin AXIS_PTS SNM16NEUW "Drehzahlst¸tzstellen Nockenwellensollwinkel Einlaﬂ" 0x1CB8FA nmot_w SstAUwSstUw 16383.75 nmot_uw_q0p25 16 0.00 16383.75 FORMAT "%8.2" DEPOSIT ABSOLUTE /end AXIS_PTS
/begin AXIS_PTS SNM16OPUW "St¸tzstellenverteilung Drehzahl" 0x1C68E2 nmot_w SstAUwSstUw 16383.75 nmot_uw_q0p25 16 0.00 16383.75 FORMAT "%8.2" DEPOSIT ABSOLUTE /end AXIS_PTS
/begin AXIS_PTS SNM16ZUUB "St¸tzstellenverteilung Drehzahl, 16 Sst." 0x1C67C0 nmot SstAUbSstUb 10200. nmot_ub_q40 16 0.00 10200. FORMAT "%5.0" DEPOSIT ABSOLUTE /end AXIS_PTS
/begin AXIS_PTS SNM16ZUUW "St¸tzstellenverteilung Drehzahl, 16 Sst." 0x1C6904 nmot SstAUwSstUw 2621400. nmot_ub_q40 16 0.00 2621400. FORMAT "%8.0" DEPOSIT ABSOLUTE /end AXIS_PTS
/begin AXIS_PTS SNM24ZUUB "St¸tzstellenverteilung Drehzahl, 24 Sst." 0x1C67D4 nmot SstAUbSstUb 10200. nmot_ub_q40 24 0.00 10200. FORMAT "%5.0" DEPOSIT ABSOLUTE /end AXIS_PTS
/begin AXIS_PTS SQM05TEUB "Luftmassenquotient-abh‰ngige St¸tzstellen (Anzahl =5)" 0x1C67F0 qmsdyn SstAUbSstUb 15.94 fak_ub_b16 5 0.00 15.94 FORMAT "%5.2" DEPOSIT ABSOLUTE /end AXIS_PTS
/begin AXIS_PTS SRL04KRUB "St¸tzstellenverteilung relative F¸llung, 4 Sst." 0x1CEE24 rl SstAUbSstUb 191.3 rel_ub_q0p75 4 0.00 191.3 FORMAT "%5.1" DEPOSIT ABSOLUTE /end AXIS_PTS
/begin AXIS_PTS SRL05NAUW "Lastst¸tzstellen Nockenwellensollwinkel Auslaﬂ" 0x1CB91C rlnw_w SstAUwSstUw 1535.977 rel_uw_q0p0234 5 0.00 1535.977 FORMAT "%8.3" DEPOSIT ABSOLUTE /end AXIS_PTS
/begin AXIS_PTS SRL05NEUW "Lastst¸tzstellen Nockenwellensollwinkel Einlaﬂ" 0x1CB928 rlnw_w SstAUwSstUw 1535.977 rel_uw_q0p0234 5 0.00 1535.977 FORMAT "%8.3" DEPOSIT ABSOLUTE /end AXIS_PTS
/begin AXIS_PTS SRL06ESUB "Sst-Verteilung f¸r die relative F¸llung rl" 0x1C67F8 rl SstAUbSstUb 191.3 rel_ub_q0p75 6 0.00 191.3 FORMAT "%5.1" DEPOSIT ABSOLUTE /end AXIS_PTS
/begin AXIS_PTS SRL06ZUUB "" 0x1C6800 rl SstAUbSstUb 191.3 rel_ub_q0p75 6 0.00 191.3 FORMAT "%5.1" DEPOSIT ABSOLUTE /end AXIS_PTS
/begin AXIS_PTS SRL08DMUB "SST-Verteilung in DMD, 8 Last-SST" 0x1C6808 rl SstAUbSstUb 191.3 rel_ub_q0p75 8 0.00 191.3 FORMAT "%5.1" DEPOSIT ABSOLUTE /end AXIS_PTS
/begin AXIS_PTS SRL08LSUW "St¸tzstellenverteilung Reglerparameter" 0x1C6926 rl_w SstAUwSstUw 1535.977 rel_uw_q0p0234 8 0.00 1535.977 FORMAT "%8.3" DEPOSIT ABSOLUTE /end AXIS_PTS
/begin AXIS_PTS SRL08NAUW "Lastst¸tzstellen Nockenwellensollwinkel Auslaﬂ" 0x1CB934 rlnw_w SstAUwSstUw 1535.977 rel_uw_q0p0234 8 0.00 1535.977 FORMAT "%8.3" DEPOSIT ABSOLUTE /end AXIS_PTS
/begin AXIS_PTS SRL08NEUW "Lastst¸tzstellen Nockenwellensollwinkel Einlaﬂ" 0x1CB946 rlnw_w SstAUwSstUw 1535.977 rel_uw_q0p0234 8 0.00 1535.977 FORMAT "%8.3" DEPOSIT ABSOLUTE /end AXIS_PTS
/begin AXIS_PTS SRL08NXUB "St¸tzstellenverteilung relative Luftf¸llung 8 Sst." 0x1CEE2C rl SstAUbSstUb 191.3 rel_ub_q0p75 8 0.00 191.3 FORMAT "%5.1" DEPOSIT ABSOLUTE /end AXIS_PTS
/begin AXIS_PTS SRL10LSUB "St¸tzstellenverteilung Kat-Vorsteuerwert LRS" 0x1C6814 rl SstAUbSstUb 191.3 rel_ub_q0p75 10 0.00 191.3 FORMAT "%5.1" DEPOSIT ABSOLUTE /end AXIS_PTS
/begin AXIS_PTS SRL12ESUB "Sst-Verteilung f¸r die relative F¸llung rl" 0x1C6820 rl SstAUbSstUb 191.3 rel_ub_q0p75 12 0.00 191.3 FORMAT "%5.1" DEPOSIT ABSOLUTE /end AXIS_PTS
/begin AXIS_PTS SRL12GKUB "12 F¸llungsst¸tzstellen f¸r ?" 0x1CEE38 rl SstAUbSstUb 191.3 rel_ub_q0p75 12 0.00 191.3 FORMAT "%5.1" DEPOSIT ABSOLUTE /end AXIS_PTS
/begin AXIS_PTS SRL12ZUUB "St¸tzstellenverteilung relative Luftf¸llung, 12 St." 0x1C6830 rl SstAUbSstUb 191.3 rel_ub_q0p75 12 0.00 191.3 FORMAT "%5.1" DEPOSIT ABSOLUTE /end AXIS_PTS
/begin AXIS_PTS SRL12ZUUW "St¸tzstellenverteilung relative Luftf¸llung, 12 St." 0x1C6938 rl SstAUwSstUw 49151.25 rel_ub_q0p75 12 0.00 49151.25 FORMAT "%8.2" DEPOSIT ABSOLUTE /end AXIS_PTS
/begin AXIS_PTS SRL16ZUUB "St¸tzstellenverteilung relative F¸llung, 16 Sst." 0x1C6840 rl SstAUbSstUb 191.3 rel_ub_q0p75 16 0.00 191.3 FORMAT "%5.1" DEPOSIT ABSOLUTE /end AXIS_PTS
/begin AXIS_PTS SRP06ESUB "SST-Verteilung f¸r rel. Luftf¸llung pr‰d. f¸r Einspritzung" 0x1C6854 rlp SstAUbSstUb 191.3 rel_ub_q0p75 6 0.00 191.3 FORMAT "%5.1" DEPOSIT ABSOLUTE /end AXIS_PTS
/begin AXIS_PTS SST_PWR_VG16 "" 0x1D1734 ETC_VariRate dc_SstAUbSstUb 255.0 DC_DEZ 16 0.00 255.0 FORMAT "%5.1" DEPOSIT ABSOLUTE /end AXIS_PTS
/begin AXIS_PTS ST107TMUB "St¸tzstellenverteilung, Starttemperatur an Sonde vorne" 0x1CEE48 tabgmst SstAUbSstUb 1275. temp_ub_q5_o50 7 -50.00 1225. FORMAT "%5.0" DEPOSIT ABSOLUTE /end AXIS_PTS
/begin AXIS_PTS ST207TMUB "St¸tzstellenverteilung, Starttemperatur an Sonde vorne, Bank2" 0x1CEE50 tabgmst2 SstAUbSstUb 1275. temp_ub_q5_o50 7 -50.00 1225. FORMAT "%5.0" DEPOSIT ABSOLUTE /end AXIS_PTS
/begin AXIS_PTS ST307TMUB "St¸tzstellenverteilung, Starttemperatur an Sonde hinten" 0x1CEE58 tkatmst SstAUbSstUb 1275. temp_ub_q5_o50 7 -50.00 1225. FORMAT "%5.0" DEPOSIT ABSOLUTE /end AXIS_PTS
/begin AXIS_PTS ST407TMUB "St¸tzstellenverteilung, Starttemperatur an Sonde hinten, Bank2" 0x1CEE60 tkatmst2 SstAUbSstUb 1275. temp_ub_q5_o50 7 -50.00 1225. FORMAT "%5.0" DEPOSIT ABSOLUTE /end AXIS_PTS
/begin AXIS_PTS STA04LLUB "St¸tzstellenverteilung: tans f¸r Momentenreserve" 0x1C6952 tans SstAUwSstUw 49151.25 temp_ub_q0p75_o48 4 -48.00000 49103.25 FORMAT "%8.2" DEPOSIT ABSOLUTE /end AXIS_PTS
/begin AXIS_PTS STA04SAUB "" 0x1C685C tans SstAUbSstUb 191.3 temp_ub_q0p75_o48 4 -48.00 143.3 FORMAT "%5.1" DEPOSIT ABSOLUTE /end AXIS_PTS
/begin AXIS_PTS STA06ESUB "SST-Verteilung f¸r die Ansauglufttemperatur" 0x1CEE68 tans SstAUbSstUb 191.3 temp_ub_q0p75_o48 6 -48.00 143.3 FORMAT "%5.1" DEPOSIT ABSOLUTE /end AXIS_PTS
/begin AXIS_PTS STA12WLUB "SST-Verteilung f¸r die Ansauglufttemperatur" 0x1C6864 tans SstAUbSstUb 191.3 temp_ub_q0p75_o48 12 -48.00 143.3 FORMAT "%5.1" DEPOSIT ABSOLUTE /end AXIS_PTS
/begin AXIS_PTS STK04SAUB "SST-Verteilung Kattemperatur f¸r Funktion SAWE" 0x1CEE70 tkatm SstAUbSstUb 1275. temp_ub_q5_o50 4 -50.00 1225. FORMAT "%5.0" DEPOSIT ABSOLUTE /end AXIS_PTS
/begin AXIS_PTS STK06SAUB "SST-Verteilung Kattemperatur f¸r Funktion SAWE" 0x1CEE78 tkatm SstAUbSstUb 1275. temp_ub_q5_o50 6 -50.00 1225. FORMAT "%5.0" DEPOSIT ABSOLUTE /end AXIS_PTS
/begin AXIS_PTS STM04SAUB "St¸tzstellenverteilung Motortemperatur, 4 Sst." 0x1C6874 tmot SstAUbSstUb 191.3 temp_ub_q0p75_o48 4 -48.00 143.3 FORMAT "%5.1" DEPOSIT ABSOLUTE /end AXIS_PTS
/begin AXIS_PTS STM05NWUB "Temperaturst¸tzstellen Nockenwellensollwinkel" 0x1CB8A0 tmot SstAUbSstUb 191.3 temp_ub_q0p75_o48 5 -48.00 143.3 FORMAT "%5.1" DEPOSIT ABSOLUTE /end AXIS_PTS
/begin AXIS_PTS STM05SAUB "St¸tzstellenverteilung" 0x1CEE80 tmot SstAUbSstUb 191.3 temp_ub_q0p75_o48 5 -48.00 143.3 FORMAT "%5.1" DEPOSIT ABSOLUTE /end AXIS_PTS
/begin AXIS_PTS STM05TMUB "St¸tzstellenverteilung, Motorstarttemperatur" 0x1CEF5C tmst SstAUwSstUw 49151.25 temp_ub_q0p75_o48 5 -48.00000 49103.25 FORMAT "%8.2" DEPOSIT ABSOLUTE /end AXIS_PTS
/begin AXIS_PTS STM06LLUB "St¸tzstellenverteilung Motortemperatur, 6 Sst." 0x1CEE88 tmot SstAUbSstUb 191.3 temp_ub_q0p75_o48 6 -48.00 143.3 FORMAT "%5.1" DEPOSIT ABSOLUTE /end AXIS_PTS
/begin AXIS_PTS STM06__UB "St¸tzstellenverteilung Motortemperatur, 6 Sst." 0x1CEE90 tmot SstAUbSstUb 191.3 temp_ub_q0p75_o48 6 -48.00 143.3 FORMAT "%5.1" DEPOSIT ABSOLUTE /end AXIS_PTS
/begin AXIS_PTS STM08BBUB "" 0x1C6738 tmot SstAU8SstU8 191.3 temp_ub_q0p75_o48 8 -48.00 143.3 FORMAT "%5.1" DEPOSIT ABSOLUTE /end AXIS_PTS
/begin AXIS_PTS STM08DMUB "8 Motortemperaturst¸tzstellen f¸r DMD" 0x1CEE98 tmot SstAUbSstUb 191.3 temp_ub_q0p75_o48 8 -48.00 143.3 FORMAT "%5.1" DEPOSIT ABSOLUTE /end AXIS_PTS
/begin AXIS_PTS STM08MDUB "St¸tzstellenverteilung: tmot f¸r Drehmomentwandler" 0x1CEEA4 tmot SstAUbSstUb 191.3 temp_ub_q0p75_o48 8 -48.00 143.3 FORMAT "%5.1" DEPOSIT ABSOLUTE /end AXIS_PTS
/begin AXIS_PTS STM09ESUB "St¸tzstellenverteilung Motortemperatur, 9 Sst." 0x1CEEB0 tmot SstAUbSstUb 191.3 temp_ub_q0p75_o48 9 -48.00 143.3 FORMAT "%5.1" DEPOSIT ABSOLUTE /end AXIS_PTS
/begin AXIS_PTS STM10__UB "" 0x1CEEBC tmot SstAUbSstUb 191.3 temp_ub_q0p75_o48 10 -48.00 143.3 FORMAT "%5.1" DEPOSIT ABSOLUTE /end AXIS_PTS
/begin AXIS_PTS STM12ESUB "SST-Verteilung f¸r die Motortemperatur tmot" 0x1CEEC8 tmot SstAUbSstUb 191.3 temp_ub_q0p75_o48 12 -48.00 143.3 FORMAT "%5.1" DEPOSIT ABSOLUTE /end AXIS_PTS
/begin AXIS_PTS STO06NWUW "Gruppenst¸tzstellen" 0x1CB958 toelk_w SstAUwSstUw 1535.977 temp_q0p0234_o273 6 -273.1500 1262.827 FORMAT "%8.3" DEPOSIT ABSOLUTE /end AXIS_PTS
/begin AXIS_PTS STS08COUB "SST-Verteilung f¸r Motorstarttemperatur tmst" 0x1CEED8 tmst SstAUbSstUb 191.3 temp_ub_q0p75_o48 8 -48.00 143.3 FORMAT "%5.1" DEPOSIT ABSOLUTE /end AXIS_PTS
/begin AXIS_PTS STS08ESUB "SST-Verteilung f¸r Motorstarttemperatur" 0x1C687C tmst SstAUbSstUb 191.3 temp_ub_q0p75_o48 8 -48.00 143.3 FORMAT "%5.1" DEPOSIT ABSOLUTE /end AXIS_PTS
/begin AXIS_PTS STS12ESUB "SST-Verteilung f¸r Motorstarttemperatur" 0x1C6888 tmst SstAUbSstUb 191.3 temp_ub_q0p75_o48 12 -48.00 143.3 FORMAT "%5.1" DEPOSIT ABSOLUTE /end AXIS_PTS
/begin AXIS_PTS STW06MDUB "6 twan-St¸tzstellen f¸r ?" 0x1CEEE4 twan SstAUbSstUb 191.3 temp_ub_q0p75_o48 6 -48.00 143.3 FORMAT "%5.1" DEPOSIT ABSOLUTE /end AXIS_PTS
/begin CHARACTERISTIC SUMODE0 "keine Bestromung der Saugrohrklappen" VALUE 0x1CA56E KwUb 255.0 dez 0.00 255.0 FORMAT "%5.1" /end CHARACTERISTIC
/begin CHARACTERISTIC SUMODE1 "Bestromung von Klappe 1, keine Bestromung von Klappe 2" VALUE 0x1CA56F KwUb 255.0 dez 0.00 255.0 FORMAT "%5.1" /end CHARACTERISTIC
/begin AXIS_PTS SWD06KRSW "St¸tzstellenverteilung DK-Winkel, 6 Sst." 0x1CEF68 wdkba_w SstASwSstSw 1599.976 relDK_q0p02441 6 -800.0000 799.9756 FORMAT "%8.4" DEPOSIT ABSOLUTE /end AXIS_PTS
/begin AXIS_PTS SWP08OPUB "St¸tzstellenverteilung f¸r Pedalstellung wped" 0x1C6898 wped SstAUbSstUb 100.0 relPED_ub_b100 8 0.00 100.0 FORMAT "%5.1" DEPOSIT ABSOLUTE /end AXIS_PTS
/begin AXIS_PTS SWPEDV16 "St¸tzstellenverteilung f¸r Pedalwert" 0x1D1848 APP_ADD dc_SstAUwSstUw 100.0000 DC_PER0327 16 0.00 100.0000 FORMAT "%8.4" DEPOSIT ABSOLUTE /end AXIS_PTS
/begin CHARACTERISTIC TANMN "Minimale Zeit f¸r Automatik-Start" VALUE 0x1C665E KwUb 2.550 t10msxs_ub_b2p55 0.00 2.550 FORMAT "%5.3" /end CHARACTERISTIC
/begin CHARACTERISTIC TANMXT "Maximale Zeit fuer Automatik-Start abh. von Motortemperatur" CURVE 0x1C6660 KlAUbSstUbWUb 255.0 t1sxs_ub_b255 0.00 255.0 FORMAT "%5.1"
 /begin AXIS_DESCR STD_AXIS tmot temp_ub_q0p75_o48 5 -48.00 143.3 FORMAT "%5.1" DEPOSIT ABSOLUTE /end AXIS_DESCR
/end CHARACTERISTIC
/begin CHARACTERISTIC TANOVMX "Startzeitverlaengerung bei Schluessel in Crank-Position" VALUE 0x1C666B KwUb 255.0 t1sxs_ub_b255 0.00 255.0 FORMAT "%5.1" /end CHARACTERISTIC
/begin CHARACTERISTIC TASUS "Ansauglufttemperaturschwelle f¸r Saugrohrumschaltung" VALUE 0x1CA570 KwUb 191.3 temp_ub_q0p75_o48 -48.00 143.3 FORMAT "%5.1" /end CHARACTERISTIC
/begin CHARACTERISTIC TEMN "minimales TE" VALUE 0x1C5642 KwUw 65.53500 t1p0usxms 0.00 65.53500 FORMAT "%8.5" /end CHARACTERISTIC
/begin CHARACTERISTIC TEMNVA "minimales TE bei VA (Verzˆgerungsabmagerung)" VALUE 0x1C5644 KwUw 65.53500 t1p0usxms 0.00 65.53500 FORMAT "%8.5" /end CHARACTERISTIC
/begin CHARACTERISTIC TESAMN "Min. Zeit zur Aktivierung Schubabgleich nach Schubabschaltung" VALUE 0x1C4DC4 KwUw 655.3500 t10msxs_uw_b655p35 0.00 655.3500 FORMAT "%8.4" /end CHARACTERISTIC
/begin CHARACTERISTIC TESAMX "Max. Zeit Schubabgleich" VALUE 0x1C4DC6 KwUw 655.3500 t10msxs_uw_b655p35 0.00 655.3500 FORMAT "%8.4" /end CHARACTERISTIC
/begin CHARACTERISTIC TMADB0 "Motortemperaturbereich 0 f¸r Berechnung Kaltstartanreicherung" VALUE 0x1C5433 KwUb 255.0 dez 0.00 255.0 FORMAT "%5.1" /end CHARACTERISTIC
/begin CHARACTERISTIC TMADB1 "Motortemperaturbereich 1 f¸r Berechnung Kaltstartanreicherung" VALUE 0x1C5434 KwUb 255.0 dez 0.00 255.0 FORMAT "%5.1" /end CHARACTERISTIC
/begin CHARACTERISTIC TMADB2 "Motortemperaturbereich 2 f¸r Berechnung Kaltstartanreicherung" VALUE 0x1C5435 KwUb 255.0 dez 0.00 255.0 FORMAT "%5.1" /end CHARACTERISTIC
/begin CHARACTERISTIC TMLIM "TMOT Schwelle f¸r  KSTAA aktiv im Nachstart" VALUE 0x1C5436 KwUb 191.3 temp_ub_q0p75_o48 -48.00 143.3 FORMAT "%5.1" /end CHARACTERISTIC
/begin CHARACTERISTIC TMNWLLKHE "Motortemperaturschwelle zur Aktivierung Katheiz KF im Leerlauf Einlaﬂnockenwelle" VALUE 0x1C3C2D KwUb 191.3 temp_ub_q0p75_o48 -48.00 143.3 FORMAT "%5.1" /end CHARACTERISTIC
/begin CHARACTERISTIC TMSUS "Temperaturschwelle f¸r Saugrohrumschaltung" VALUE 0x1CA571 KwUb 191.3 temp_ub_q0p75_o48 -48.00 143.3 FORMAT "%5.1" /end CHARACTERISTIC
/begin CHARACTERISTIC TMSUSV "Temperaturschwelle f¸r Saugrohrumschaltung mit nachgeschalteter Verzˆgerung" VALUE 0x1CA572 KwUb 191.3 temp_ub_q0p75_o48 -48.00 143.3 FORMAT "%5.1" /end CHARACTERISTIC
/begin CHARACTERISTIC TNWWSPE "Verweildauer in einer Position bei Sollwinkelspr¸ngen Einlaﬂnockenwelle" VALUE 0x1CB2AD KwUb 50.80 t200msxs_ub_b51 0.2000 51.00 FORMAT "%5.2" /end CHARACTERISTIC
/begin CHARACTERISTIC TPAST "Entprellzeit f¸r automatischen Start" VALUE 0x1C666C KwUb 2.550 t10msxs_ub_b2p55 0.00 2.550 FORMAT "%5.3" /end CHARACTERISTIC
/begin CHARACTERISTIC TSTA "Wartezeit bis Erkennung blockierter Motor" VALUE 0x1C6680 KwUw 6553.500 t100msxs_uw_b6553p5 0.00 6553.500 FORMAT "%8.3" /end CHARACTERISTIC
/begin CHARACTERISTIC TSTEKPV "Startverzˆgerung f¸r EKP-Vorlauf" VALUE 0x1C666D KwUb 2.550 t10msxs_ub_b2p55 0.00 2.550 FORMAT "%5.3" /end CHARACTERISTIC
/begin CHARACTERISTIC TVKTSPEV "EV-temperaturabh‰ngige Verzugszeitkorrektur" CURVE 0x1CDBE6 KlAUwSstUwWUw 65.53500 t1p0usxms 0.00 65.53500 FORMAT "%8.5"
 /begin AXIS_DESCR STD_AXIS evtmodev temp_ub_q0p75_o48 4 -48.00000 49103.25 FORMAT "%8.2" DEPOSIT ABSOLUTE /end AXIS_DESCR
/end CHARACTERISTIC
/begin CHARACTERISTIC TVRPSONMX "Verzˆgerungszeit zum Ausschalten des erhˆhten Ref.-Pumpstroms nach dem Start" VALUE 0x1CCBD0 KwWU16 6553.500 t_q0p1 0.00 6553.500 FORMAT "%8.3" /end CHARACTERISTIC
/begin CHARACTERISTIC TVSATMOT "Verzˆgerungszeit zur Aktivierung Schubableich durch Motortemperatur" VALUE 0x1CCB74 KwUw 6553.500 t100msxs_uw_b6553p5 0.00 6553.500 FORMAT "%8.3" /end CHARACTERISTIC
/begin CHARACTERISTIC TVSU "Verzˆgerungszeit f¸r Saugrohrumschaltung" VALUE 0x1CA573 KwUb 5.100 t20msxs_ub_b5p1 0.00 5.100 FORMAT "%5.3" /end CHARACTERISTIC
/begin CHARACTERISTIC TVSUAN "Verzˆgerungszeit f¸r Saugrohrumschaltung, wenn angesteuert" VALUE 0x1CA574 KwUb 12.75 t50msxs_q0p05 0.00 12.75 FORMAT "%5.2" /end CHARACTERISTIC
/begin CHARACTERISTIC TVSUM "Zeitverzˆgerung der Saugrohrumschaltung in Abh‰ngigkeit von der Motortemperatur" CURVE 0x1CA578 KlAUbSstUbWUb 25.50 t100msxs_ub_b25p5 0.00 25.50 FORMAT "%5.2"
 /begin AXIS_DESCR STD_AXIS tmot temp_ub_q0p75_o48 6 -48.00 143.3 FORMAT "%5.1" DEPOSIT ABSOLUTE /end AXIS_DESCR
/end CHARACTERISTIC
/begin CHARACTERISTIC TVSUNA "Verzˆgerungszeit f¸r Saugrohrumschaltung, wenn nicht angesteuert" VALUE 0x1CA585 KwUb 12.75 t50msxs_q0p05 0.00 12.75 FORMAT "%5.2" /end CHARACTERISTIC
/begin CHARACTERISTIC TVSUST "Sperrzeit f¸r Freigabe SU nach Start" VALUE 0x1CA5A0 KwUw 655.3500 t10msxs_uw_b655p35 0.00 655.3500 FORMAT "%8.4" /end CHARACTERISTIC
/begin CHARACTERISTIC TVUBAT "Batteriespannungsabh‰ngige Verzugszeit bei Einspritzventilen" CURVE 0x1CDBF8 KlAUbSstUbWUw 65.53500 t1p0usxms 0.00 65.53500 FORMAT "%8.5"
 /begin AXIS_DESCR STD_AXIS ub spg_ubatt 5 0.00 24.02 FORMAT "%5.2" DEPOSIT ABSOLUTE /end AXIS_DESCR
/end CHARACTERISTIC
/begin CHARACTERISTIC UBKST "Ubat-Schwelle f¸r ZUBKSTMX" VALUE 0x1C5437 KwUb 24.02 spg_ubatt 0.00 24.02 FORMAT "%5.2" /end CHARACTERISTIC
/begin CHARACTERISTIC UBKSTMX "Anzahlschwelle Ubat unter UBKST f¸r Adaptionssperrung" VALUE 0x1C5438 KwUb 255.0 dez 0.00 255.0 FORMAT "%5.1" /end CHARACTERISTIC
/begin AXIS_PTS VCANV05 "St¸tzstellenverteilung" 0x1D190C Veh_Spd dc_SstAUwSstUw 4095.938 DC_VEHSPD_KMH_U16 5 0.00 4095.938 FORMAT "%8.3" DEPOSIT ABSOLUTE /end AXIS_PTS
/begin CHARACTERISTIC WAD0T1 "Wichtungsfaktor Adaptionsbereich 0 zu 1" VALUE 0x1C5439 KwUb 15.94 fak_ub_b16 0.00 15.94 FORMAT "%5.2" /end CHARACTERISTIC
/begin CHARACTERISTIC WAD0T2 "Wichtungsfaktor Adaptionsbereich 0 zu 2" VALUE 0x1C543A KwUb 15.94 fak_ub_b16 0.00 15.94 FORMAT "%5.2" /end CHARACTERISTIC
/begin CHARACTERISTIC WAD1T0 "Wichtungsfaktor Adaptionsbereich 1 zu 0" VALUE 0x1C543B KwUb 15.94 fak_ub_b16 0.00 15.94 FORMAT "%5.2" /end CHARACTERISTIC
/begin CHARACTERISTIC WAD1T2 "Wichtungsfaktor Adaptionsbereich 1 zu 2" VALUE 0x1C543C KwUb 15.94 fak_ub_b16 0.00 15.94 FORMAT "%5.2" /end CHARACTERISTIC
/begin CHARACTERISTIC WAD2T0 "Wichtungsfaktor Adaptionsbereich 2 zu 0" VALUE 0x1C543D KwUb 15.94 fak_ub_b16 0.00 15.94 FORMAT "%5.2" /end CHARACTERISTIC
/begin CHARACTERISTIC WAD2T1 "Wichtungsfaktor Adaptionsbereich 2 zu 1" VALUE 0x1C543E KwUb 15.94 fak_ub_b16 0.00 15.94 FORMAT "%5.2" /end CHARACTERISTIC
/begin CHARACTERISTIC WESBM "Winkel Einlaﬂ-schlieﬂt vor SW-Bezugsmarke (tR)" VALUE 0x1C66AF KwSb 717.2 kw_q2p8125 -360.0 357.2 FORMAT "%5.1" /end CHARACTERISTIC
/begin CHARACTERISTIC WNWDSHKE "Deltasollwinkel Nockenwelle Korrektur Katheizen ¸ber Hˆhe Einlaﬂ" CURVE 0x1CB854 KlAUwSstUwWSw 511.9922 kw_sw_q0p0078 -256.0000 255.9922 FORMAT "%8.4"
 /begin AXIS_DESCR STD_AXIS fho_w fak_uw_b4 4 0.00 3.999939 FORMAT "%8.6" DEPOSIT ABSOLUTE /end AXIS_DESCR
/end CHARACTERISTIC
/begin CHARACTERISTIC WNWREO "Winkel Einlassventil ˆffnet in Referenzposition bezogen auf Ladungswechsel(LWOT)" VALUE 0x1C3C38 KwSw 511.9922 kw_sw_q0p0078 -256.0000 255.9922 FORMAT "%8.4" /end CHARACTERISTIC
/begin CHARACTERISTIC WNWSAPFE "Applikationswert Sollwinkel f¸r Fr¸hposition bei Spr¸ngen Einlaﬂnockenwelle" VALUE 0x1CB866 KwSw 511.9922 kw_sw_q0p0078 -256.0000 255.9922 FORMAT "%8.4" /end CHARACTERISTIC
/begin CHARACTERISTIC WNWSAPSE "Applikationswert Sollwinkel f¸r Sp‰tposition bei Spr¸ngen Einlaﬂnockenwelle" VALUE 0x1CB868 KwSw 511.9922 kw_sw_q0p0078 -256.0000 255.9922 FORMAT "%8.4" /end CHARACTERISTIC
/begin CHARACTERISTIC WNWSEAPP "Applikationswert f¸r den Einlaﬂ-Nockenwellensollwinkel" VALUE 0x1CB86A KwSw 511.9922 kw_sw_q0p0078 -256.0000 255.9922 FORMAT "%8.4" /end CHARACTERISTIC
/begin CHARACTERISTIC WNWSGLEHE "Sollwinkelschwelle Nockenwellengleichstellung bei Fehler in 2Bank-System Einlaﬂ" VALUE 0x1CB86C KwSw 511.9922 kw_sw_q0p0078 -256.0000 255.9922 FORMAT "%8.4" /end CHARACTERISTIC
/begin CHARACTERISTIC WNWSMNE "Minimal zul‰ssiger Sollwert f¸r Nockenwellenverstellung Einlass ˆffnet (LWOT)" VALUE 0x1CB86E KwSw 511.9922 kw_sw_q0p0078 -256.0000 255.9922 FORMAT "%8.4" /end CHARACTERISTIC
/begin CHARACTERISTIC WNWSMXE "Maximal zul‰ssiger Sollwert f¸r Nockenwellenverstellung Einlass ˆffnet (LWOT)" VALUE 0x1CB870 KwSw 511.9922 kw_sw_q0p0078 -256.0000 255.9922 FORMAT "%8.4" /end CHARACTERISTIC
/begin CHARACTERISTIC WNWSTE "Sollwinkel f¸r Einlaﬂnockenwellenposition w‰hrend Start" CURVE 0x1CB872 KlAUbSstSwWSw 511.9922 kw_sw_q0p0078 -256.0000 255.9922 FORMAT "%8.4"
 /begin AXIS_DESCR STD_AXIS tmot temp_ub_q0p75_o48 4 -24624.00 24527.25 FORMAT "%8.2" DEPOSIT ABSOLUTE /end AXIS_DESCR
/end CHARACTERISTIC
/begin CHARACTERISTIC WNWSWOFE "Sollwinkel f¸r Einlaﬂnockenwellenposition bei S_KL15 = aus" CURVE 0x1CB884 KlAUbSstSwWSw 511.9922 kw_sw_q0p0078 -256.0000 255.9922 FORMAT "%8.4"
 /begin AXIS_DESCR STD_AXIS tumg temp_ub_q0p75_o48 4 -24624.00 24527.25 FORMAT "%8.2" DEPOSIT ABSOLUTE /end AXIS_DESCR
/end CHARACTERISTIC
/begin CHARACTERISTIC ZBURNABR "Verbrennungsanzahl f¸r Entscheidung Adaptionsabbruch" VALUE 0x1C543F KwUb 255.0 dez 0.00 255.0 FORMAT "%5.1" /end CHARACTERISTIC
/begin CHARACTERISTIC ZBURNDEC "Zu ¸berschreitende Verbrennungsanzahl f¸r ""Abmagern""" VALUE 0x1C5440 KwUb 255.0 dez 0.00 255.0 FORMAT "%5.1" /end CHARACTERISTIC
/begin CHARACTERISTIC ZBURNSOL "Erforderliche Verbrennungsanzahl f¸r ""keine Anreicherung""" VALUE 0x1C5441 KwUb 255.0 dez 0.00 255.0 FORMAT "%5.1" /end CHARACTERISTIC
/begin CHARACTERISTIC ZFSADYN "Zeitkonstante f¸r PT1-Filter" VALUE 0x1C4DC8 KwUw 655.350000 zk10msxs_uw_b655 0.0100001526 655.360000 FORMAT "%10.6" /end CHARACTERISTIC
/begin CHARACTERISTIC ZNGFILSU "Zeitkonstante f¸r Drehzahlgradientfilterung" VALUE 0x1CA5A2 KwUw 1309.98001 zk20msxs_uw_b1310 0.0199893187 1310.00000 FORMAT "%10.5" /end CHARACTERISTIC
/begin CHARACTERISTIC ZSAINT "Zeitkonstante f¸r Intergrator Schubagleich" VALUE 0x1CCB76 KwUw 6553.50000 zk100msxs_uw_b6553 0.100001526 6553.60000 FORMAT "%10.5" /end CHARACTERISTIC
/begin CHARACTERISTIC ZSYNABR "Z¸ndungsanzahl f¸r Entscheidung Adaptionsabbruch" VALUE 0x1C5442 KwUb 255.0 dez 0.00 255.0 FORMAT "%5.1" /end CHARACTERISTIC
/begin CHARACTERISTIC ZSYNAUSW "Anzahl Z¸ndungen (Synchros) bis Auswerten" VALUE 0x1C5443 KwUb 255.0 dez 0.00 255.0 FORMAT "%5.1" /end CHARACTERISTIC
/begin CHARACTERISTIC ZSYNDEL "Anzahl ausgeblendete Verbrennungen f¸r Verbrennungserkennung" VALUE 0x1C5444 KwUb 255.0 dez 0.00 255.0 FORMAT "%5.1" /end CHARACTERISTIC
/begin CHARACTERISTIC ZTSPEV "Zeitkonstante zur Bildung der Spulentemperatur eines Einspritzventils" VALUE 0x1CDC08 KwUw 6553.50000 zk100msxs_uw_b6553 0.100001526 6553.60000 FORMAT "%10.5" /end CHARACTERISTIC
/begin MEASUREMENT AdapCrsCtrl_Dyn0Plaus_Mode_Req "" UBYTE DC_FLAG_U8 1 100 0 1 BIT_MASK 0x1 FORMAT "%5.3" ECU_ADDRESS 0x8039DC /end MEASUREMENT
/begin MEASUREMENT AdapCrsCtrl_Enabl "" UBYTE DC_FLAG_U8 1 100 0 1 BIT_MASK 0x1 FORMAT "%5.3" ECU_ADDRESS 0x8039DD /end MEASUREMENT
/begin MEASUREMENT AdapCrsCtrl_IrvrsLout_Mode "" UBYTE DC_FLAG_U8 1 100 0 1 BIT_MASK 0x1 FORMAT "%5.3" ECU_ADDRESS 0x8039DE /end MEASUREMENT
/begin MEASUREMENT AdapCrsCtrl_PlausDsabl_Mode "" UBYTE DC_FLAG_U8 1 100 0 1 BIT_MASK 0x1 FORMAT "%5.3" ECU_ADDRESS 0x8039DF /end MEASUREMENT
/begin MEASUREMENT AdapCrsCtrl_PlausRslt "" UBYTE DC_CNTR_U8 1 100 0 255 FORMAT "%5.1" ECU_ADDRESS 0x8039E0 /end MEASUREMENT
/begin MEASUREMENT AdapCrsCtrl_TglMem "" UBYTE DC_FLAG_U8 1 100 0 1 BIT_MASK 0x1 FORMAT "%5.3" ECU_ADDRESS 0x8039E1 /end MEASUREMENT
/begin MEASUREMENT AdapCrsCtrl_TglPlaus_Cntr "" UBYTE DC_CNTR_U8 1 100 0 255 FORMAT "%5.1" ECU_ADDRESS 0x8039E2 /end MEASUREMENT
/begin MEASUREMENT AdapCrsCtrl_TrqMaxMem_Mode_Req "" UBYTE DC_FLAG_U8 1 100 0 1 BIT_MASK 0x1 FORMAT "%5.3" ECU_ADDRESS 0x8039E3 /end MEASUREMENT
/begin MEASUREMENT AdapCrsCtrl_TrqMaxPls_Mode_Req "" UBYTE DC_FLAG_U8 1 100 0 1 BIT_MASK 0x1 FORMAT "%5.3" ECU_ADDRESS 0x8039E4 /end MEASUREMENT
/begin MEASUREMENT AdapCrsCtrl_TrqMem_Req "" SWORD DC_TRQ_S16 1 100 -2048 2047.94 FORMAT "%8.3" ECU_ADDRESS 0x8034B8 /end MEASUREMENT
/begin MEASUREMENT AdapCrsCtrl_TrqMinMem_Mode_Req "" UBYTE DC_FLAG_U8 1 100 0 1 BIT_MASK 0x1 FORMAT "%5.3" ECU_ADDRESS 0x8039E5 /end MEASUREMENT
/begin MEASUREMENT AdapCrsCtrl_TrqMinPls_Mode_Req "" UBYTE DC_FLAG_U8 1 100 0 1 BIT_MASK 0x1 FORMAT "%5.3" ECU_ADDRESS 0x8039E6 /end MEASUREMENT
/begin MEASUREMENT AdapCrsCtrl_TrqPlaus_Req "" SWORD DC_TRQ_S16 1 100 -2048 2047.94 FORMAT "%8.3" ECU_ADDRESS 0x8034BA /end MEASUREMENT
/begin MEASUREMENT adastep "Adaptionsschritt f¸r STADAP-Faktor" SBYTE fak_sb_b1 1 100 -1 0.992188 FORMAT "%5.3" ECU_ADDRESS 0x8011AA /end MEASUREMENT
/begin MEASUREMENT AMT_EngEmergStop_Req "" UBYTE DC_FLAG_U8 1 100 0 1 BIT_MASK 0x1 FORMAT "%5.3" ECU_ADDRESS 0x803989 /end MEASUREMENT
/begin MEASUREMENT AMT_EngEmergStop_State "" UBYTE DC_CNTR_U8 1 100 0 255 FORMAT "%5.1" ECU_ADDRESS 0x803987 /end MEASUREMENT
/begin MEASUREMENT AMT_FuncCntr "" UBYTE DC_CNTR_U8 1 100 0 255 FORMAT "%5.1" ECU_ADDRESS 0x803988 /end MEASUREMENT
/begin MEASUREMENT anzustaf "maximale Anzahl Motorumdrehungen f¸r Startautomatik" UBYTE dez 1 100 0 255 FORMAT "%5.1" ECU_ADDRESS 0x801219 /end MEASUREMENT
/begin MEASUREMENT APPRecalcSpdLim_Mode "" UBYTE DC_FLAG_U8 1 100 0 1 BIT_MASK 0x1 FORMAT "%5.3" ECU_ADDRESS 0x8038C0 /end MEASUREMENT
/begin MEASUREMENT APPRecalc_Mode "" UBYTE DC_FLAG_U8 1 100 0 1 BIT_MASK 0x1 FORMAT "%5.3" ECU_ADDRESS 0x8038C1 /end MEASUREMENT
/begin MEASUREMENT APP_ADD_Out "" UWORD DC_PER0327 1 100 0 100 FORMAT "%8.4" ECU_ADDRESS 0x8032C8 /end MEASUREMENT
/begin MEASUREMENT APP_ADD_Out_ub "" UBYTE DC_PCT_U8 1 100 0 99.6094 FORMAT "%8.5" ECU_ADDRESS 0x8038C2 /end MEASUREMENT
/begin MEASUREMENT APP_DrvrRepl "" UWORD DC_PER0327 1 100 0 100 FORMAT "%8.4" ECU_ADDRESS 0x8032CA /end MEASUREMENT
/begin MEASUREMENT APP_Out_ub "" UBYTE DC_PCT_U8 1 100 0 99.6094 FORMAT "%8.5" ECU_ADDRESS 0x8038C3 /end MEASUREMENT
/begin MEASUREMENT APP_Recalc "" UWORD DC_PER0327 1 100 0 100 FORMAT "%8.4" ECU_ADDRESS 0x8032CC /end MEASUREMENT
/begin MEASUREMENT bgCtr "" ULONG dez 1 100 0 4.29497e+009 FORMAT "%13.2" ECU_ADDRESS 0x801E78 /end MEASUREMENT
/begin MEASUREMENT bg_swoff_Ctr "" ULONG dez 1 100 0 4.29497e+009 FORMAT "%13.2" ECU_ADDRESS 0x801E7C /end MEASUREMENT
/begin MEASUREMENT BrkLightDrv_Mode "" UBYTE DC_FLAG_U8 1 100 0 1 BIT_MASK 0x1 FORMAT "%5.3" ECU_ADDRESS 0x8039E7 /end MEASUREMENT
/begin MEASUREMENT BrkLightParityErr "" UBYTE DC_FLAG_U8 1 100 0 1 BIT_MASK 0x1 FORMAT "%5.3" ECU_ADDRESS 0x8039E8 /end MEASUREMENT
/begin MEASUREMENT BrkLightSigErr "" UBYTE DC_FLAG_U8 1 100 0 1 BIT_MASK 0x1 FORMAT "%5.3" ECU_ADDRESS 0x8039E9 /end MEASUREMENT
/begin MEASUREMENT BrkLightTglErr "" UBYTE DC_FLAG_U8 1 100 0 1 BIT_MASK 0x1 FORMAT "%5.3" ECU_ADDRESS 0x8039EA /end MEASUREMENT
/begin MEASUREMENT BrkLight_FuncCntr "" UBYTE DC_CNTR_U8 1 100 0 255 FORMAT "%5.1" ECU_ADDRESS 0x8039EB /end MEASUREMENT
/begin MEASUREMENT BrkLight_IrvrsLout_Mode "" UBYTE DC_FLAG_U8 1 100 0 1 BIT_MASK 0x1 FORMAT "%5.3" ECU_ADDRESS 0x8039EC /end MEASUREMENT
/begin MEASUREMENT BrkLight_Mode "" UBYTE DC_FLAG_U8 1 100 0 1 BIT_MASK 0x1 FORMAT "%5.3" ECU_ADDRESS 0x8039ED /end MEASUREMENT
/begin MEASUREMENT BrkLight_PlausCheck_Mode "" UBYTE DC_FLAG_U8 1 100 0 1 BIT_MASK 0x1 FORMAT "%5.3" ECU_ADDRESS 0x8039EE /end MEASUREMENT
/begin MEASUREMENT BrkLight_TglTmr "" UWORD DC_TIME_20MS_U16 1 100 0 1310.7 FORMAT "%6.1" ECU_ADDRESS 0x8034C4 /end MEASUREMENT
/begin MEASUREMENT B_abstnl "Bedingung Abstellzeitermittlung ¸ber SG-Nachlauf" UBYTE B_TRUE 1 100 0 1 BIT_MASK 0x1 FORMAT "%13.11" ECU_ADDRESS 0x7FA897 /end MEASUREMENT
/begin MEASUREMENT B_ad "Bedingung Adaption erlaubt" UWORD B_TRUE 1 100 0 1 BIT_MASK 0x1 FORMAT "%13.11" ECU_ADDRESS 0x800B5C /end MEASUREMENT
/begin MEASUREMENT B_adb0 "Bedingung Adaptionsbereich 0" UWORD B_TRUE 1 100 0 1 BIT_MASK 0x2 FORMAT "%13.11" ECU_ADDRESS 0x800B5C /end MEASUREMENT
/begin MEASUREMENT B_adb1 "Bedingung Adaptionsbereich 1" UWORD B_TRUE 1 100 0 1 BIT_MASK 0x4 FORMAT "%13.11" ECU_ADDRESS 0x800B5C /end MEASUREMENT
/begin MEASUREMENT B_adb2 "Bedingung Adaptionsbereich 2" UWORD B_TRUE 1 100 0 1 BIT_MASK 0x8 FORMAT "%13.11" ECU_ADDRESS 0x800B5C /end MEASUREMENT
/begin MEASUREMENT B_adlck "Richtungsabh‰ngige Startadaptionssperre" UWORD B_TRUE 1 100 0 1 BIT_MASK 0x10 FORMAT "%13.11" ECU_ADDRESS 0x800B5C /end MEASUREMENT
/begin MEASUREMENT B_adrsta "Bedingung Adaptionswerte von STADAP resetieren bei Fehlerspeicher lˆschen" UBYTE B_TRUE 1 100 0 1 BIT_MASK 0x1 FORMAT "%13.11" ECU_ADDRESS 0x7FA898 /end MEASUREMENT
/begin MEASUREMENT B_auakt "Bedingung Abgasuntersuchung aktiv" UBYTE B_TRUE 1 100 0 1 BIT_MASK 0x1 FORMAT "%13.11" ECU_ADDRESS 0x7FA899 /end MEASUREMENT
/begin MEASUREMENT B_ausw "Bedingung Auswerten nach Verbrennungen" UWORD B_TRUE 1 100 0 1 BIT_MASK 0x20 FORMAT "%13.11" ECU_ADDRESS 0x800B5C /end MEASUREMENT
/begin MEASUREMENT B_blkfb "MIL-Ansteuerung blinkend fremdbestimmt durch externes SG" UBYTE B_TRUE 1 100 0 1 BIT_MASK 0x1 FORMAT "%13.11" ECU_ADDRESS 0x7FA6B1 /end MEASUREMENT
/begin MEASUREMENT B_burn "letzte Verbrennung als erfolgreich erkannt (dnmot_w > dnburnsol)" UBYTE B_TRUE 1 100 0 1 BIT_MASK 0x1 FORMAT "%13.11" ECU_ADDRESS 0x7FA78C /end MEASUREMENT
/begin MEASUREMENT B_cdagr "Funktion ¸ber Codewort CDAGR freigegeben" UWORD B_TRUE 1 100 0 1 BIT_MASK 0x8000 FORMAT "%13.11" ECU_ADDRESS 0x8017D2 /end MEASUREMENT
/begin MEASUREMENT B_cdanws "Funktion ¸ber Codewort CDNWS freigegeben (Auslaﬂ)" UBYTE B_TRUE 1 100 0 1 BIT_MASK 0x1 FORMAT "%13.11" ECU_ADDRESS 0x7FA89A /end MEASUREMENT
/begin MEASUREMENT B_cddmtl "Funktionfreigabe per Codewort" UBYTE B_TRUE 1 100 0 1 BIT_MASK 0x1 FORMAT "%13.11" ECU_ADDRESS 0x7FA89B /end MEASUREMENT
/begin MEASUREMENT B_cdedss "Funktion %DDSS ¸ber Codewort CDEDSS freigegeben" UWORD B_TRUE 1 100 0 1 BIT_MASK 0x400 FORMAT "%13.11" ECU_ADDRESS 0x8017D4 /end MEASUREMENT
/begin MEASUREMENT B_cdehfm "Funktion %DHFM ¸ber Codewort CDEHFM in %KONCW freigegeben" UWORD B_TRUE 1 100 0 1 BIT_MASK 0x200 FORMAT "%13.11" ECU_ADDRESS 0x8017D4 /end MEASUREMENT
/begin MEASUREMENT B_cdenws "Funktion ¸ber Codewort CDNWS freigegeben (Einlaﬂ)" UBYTE B_TRUE 1 100 0 1 BIT_MASK 0x1 FORMAT "%13.11" ECU_ADDRESS 0x7FA89C /end MEASUREMENT
/begin MEASUREMENT B_cdfst "F¸llstandsgeberdiagnose ¸ber Euro-Codewort CDEFST freigeben" UBYTE B_TRUE 1 100 0 1 BIT_MASK 0x1 FORMAT "%13.11" ECU_ADDRESS 0x7FA89D /end MEASUREMENT
/begin MEASUREMENT B_cdhrlsu "Bedingung Funktion %DHRLSU ¸ber CDHRLSU freigegeben" UBYTE B_TRUE 1 100 0 1 BIT_MASK 0x1 FORMAT "%13.11" ECU_ADDRESS 0x7FA89E /end MEASUREMENT
/begin MEASUREMENT B_cdhrlsue "Bedingung: Funktion ¸ber Codewort CDHRLSUE freigeben" UBYTE B_TRUE 1 100 0 1 BIT_MASK 0x1 FORMAT "%13.11" ECU_ADDRESS 0x7FA89F /end MEASUREMENT
/begin MEASUREMENT B_cdhsh "Funktion ¸ber Codewort CDHSH freigegeben" UWORD B_TRUE 1 100 0 1 BIT_MASK 0x80 FORMAT "%13.11" ECU_ADDRESS 0x8017D2 /end MEASUREMENT
/begin MEASUREMENT B_cdhsv "Funktion ¸ber Codewort CDHSV freigegeben" UWORD B_TRUE 1 100 0 1 BIT_MASK 0x40 FORMAT "%13.11" ECU_ADDRESS 0x8017D2 /end MEASUREMENT
/begin MEASUREMENT B_cdhsvsa "Funktion ¸ber Codewort CDHSVSA freigegeben" UBYTE B_TRUE 1 100 0 1 BIT_MASK 0x1 FORMAT "%13.11" ECU_ADDRESS 0x7FA8A0 /end MEASUREMENT
/begin MEASUREMENT B_cdkat "Funktion ¸ber Codewort CDKAT freigegeben" UWORD B_TRUE 1 100 0 1 BIT_MASK 0x100 FORMAT "%13.11" ECU_ADDRESS 0x8017D2 /end MEASUREMENT
/begin MEASUREMENT B_cdkatsp "Funktion ¸ber Codewort CDKATSP freigegeben" UBYTE B_TRUE 1 100 0 1 BIT_MASK 0x1 FORMAT "%13.11" ECU_ADDRESS 0x7FA8A1 /end MEASUREMENT
/begin MEASUREMENT B_cdkatspf "Funktion DKATSP f¸r Feld- bzw. Strassenbetrieb freigegeben" UBYTE B_TRUE 1 100 0 1 BIT_MASK 0x1 FORMAT "%13.11" ECU_ADDRESS 0x7FA8A2 /end MEASUREMENT
/begin MEASUREMENT B_cdkatspt "Funktion DKATSP f¸r Testerbetrieb freigegeben" UBYTE B_TRUE 1 100 0 1 BIT_MASK 0x1 FORMAT "%13.11" ECU_ADDRESS 0x7FA8A3 /end MEASUREMENT
/begin MEASUREMENT B_cdkvs "Funktion ¸ber Codewort CDKVS freigegeben" UWORD B_TRUE 1 100 0 1 BIT_MASK 0x800 FORMAT "%13.11" ECU_ADDRESS 0x8017D2 /end MEASUREMENT
/begin MEASUREMENT B_cdlash "Funktion ¸ber Codewort CDLASH freigegeben" UWORD B_TRUE 1 100 0 1 BIT_MASK 0x40 FORMAT "%13.11" ECU_ADDRESS 0x8017D4 /end MEASUREMENT
/begin MEASUREMENT B_cdlatp "Funktion ¸ber Codewort CDLATP freigegeben" UWORD B_TRUE 1 100 0 1 BIT_MASK 0x10 FORMAT "%13.11" ECU_ADDRESS 0x8017D4 /end MEASUREMENT
/begin MEASUREMENT B_cdlatv "Funktion ¸ber Codewort CDLATV freigeben" UWORD B_TRUE 1 100 0 1 BIT_MASK 0x20 FORMAT "%13.11" ECU_ADDRESS 0x8017D4 /end MEASUREMENT
/begin MEASUREMENT B_cdldp "Funktion ¸ber Codewort CDLDP freigegeben" UWORD B_TRUE 1 100 0 1 BIT_MASK 0x4000 FORMAT "%13.11" ECU_ADDRESS 0x8017D2 /end MEASUREMENT
/begin MEASUREMENT B_cdllr "Funktion ¸ber Codewort CDLLR freigegeben" UWORD B_TRUE 1 100 0 1 BIT_MASK 0x8 FORMAT "%13.11" ECU_ADDRESS 0x8017D4 /end MEASUREMENT
/begin MEASUREMENT B_cdlsh "Funktion ¸ber Codewort CDLSH freigegeben" UWORD B_TRUE 1 100 0 1 BIT_MASK 0x10 FORMAT "%13.11" ECU_ADDRESS 0x8017D2 /end MEASUREMENT
/begin MEASUREMENT B_cdlsv "Funktion ¸ber Codewort CDLSV freigegeben" UWORD B_TRUE 1 100 0 1 BIT_MASK 0x8 FORMAT "%13.11" ECU_ADDRESS 0x8017D2 /end MEASUREMENT
/begin MEASUREMENT B_cdlsvv "Funktion ¸ber Codewort CDLSVV freigegeben" UBYTE B_TRUE 1 100 0 1 BIT_MASK 0x1 FORMAT "%13.11" ECU_ADDRESS 0x7FA8A4 /end MEASUREMENT
/begin MEASUREMENT B_cdmd "Funktion ¸ber Codewort CDMD freigegeben" UWORD B_TRUE 1 100 0 1 BIT_MASK 0x1 FORMAT "%13.11" ECU_ADDRESS 0x8017D2 /end MEASUREMENT
/begin MEASUREMENT B_cdsls "Funktion ¸ber Codewort CDSLS freigegeben" UWORD B_TRUE 1 100 0 1 BIT_MASK 0x1 FORMAT "%13.11" ECU_ADDRESS 0x8017D4 /end MEASUREMENT
/begin MEASUREMENT B_cdswe "Funktion ¸ber Codewort CDSWE freigegeben" UWORD B_TRUE 1 100 0 1 BIT_MASK 0x2 FORMAT "%13.11" ECU_ADDRESS 0x8017D2 /end MEASUREMENT
/begin MEASUREMENT B_cdtankl "Funktion ¸ber Codewort CDTANKL freigegeben" UWORD B_TRUE 1 100 0 1 BIT_MASK 0x4 FORMAT "%13.11" ECU_ADDRESS 0x8017D2 /end MEASUREMENT
/begin MEASUREMENT B_cdtes "Funktion ¸ber Codewort CDTES freigegeben" UWORD B_TRUE 1 100 0 1 BIT_MASK 0x2000 FORMAT "%13.11" ECU_ADDRESS 0x8017D2 /end MEASUREMENT
/begin MEASUREMENT B_cwlshdyn "Beding. Abschaltung f¸r Teilfunktion Dynamikpr¸fung Sonde hinter KAT in %DLSAHK" UBYTE B_TRUE 1 100 0 1 BIT_MASK 0x1 FORMAT "%13.11" ECU_ADDRESS 0x7FA8A5 /end MEASUREMENT
/begin MEASUREMENT B_cwlshsch "Bedingung Abschaltung f¸r Teilfunktion im Schub Sonde hinter KAT in %DLSAHK" UBYTE B_TRUE 1 100 0 1 BIT_MASK 0x1 FORMAT "%13.11" ECU_ADDRESS 0x7FA8A6 /end MEASUREMENT
/begin MEASUREMENT B_cwlshvl "Bed. Abschaltung f¸r Teilfunktion im Vollastbetrieb Sonde hinter KAT in %DLSAHK" UBYTE B_TRUE 1 100 0 1 BIT_MASK 0x1 FORMAT "%13.11" ECU_ADDRESS 0x7FA8A7 /end MEASUREMENT
/begin MEASUREMENT B_decr "Bedingung Dekrementierung Startadaptionsfaktor" UWORD B_TRUE 1 100 0 1 BIT_MASK 0x40 FORMAT "%13.11" ECU_ADDRESS 0x800B5C /end MEASUREMENT
/begin MEASUREMENT B_dknolu "Bedingung Drosselklappensteller stromlos" UBYTE B_TRUE 1 100 0 1 BIT_MASK 0x1 FORMAT "%13.11" ECU_ADDRESS 0x7FA68C /end MEASUREMENT
/begin MEASUREMENT B_dknot "Bedingung DK-Poti-Notfahren aktiv" UBYTE B_TRUE 1 100 0 1 BIT_MASK 0x1 FORMAT "%13.11" ECU_ADDRESS 0x7FA68D /end MEASUREMENT
/begin MEASUREMENT B_dkpiu "Bedingung: irreversible SKA" UBYTE B_TRUE 1 100 0 1 BIT_MASK 0x1 FORMAT "%13.11" ECU_ADDRESS 0x7FA68E /end MEASUREMENT
/begin MEASUREMENT B_dkpru "Bedingung: reversible SKA" UBYTE B_TRUE 1 100 0 1 BIT_MASK 0x1 FORMAT "%13.11" ECU_ADDRESS 0x7FA68F /end MEASUREMENT
/begin MEASUREMENT B_dkpu "Bedingung Sicherheitskraftstoffabschaltung (SKA)" UBYTE B_TRUE 1 100 0 1 BIT_MASK 0x1 FORMAT "%13.11" ECU_ADDRESS 0x7FA690 /end MEASUREMENT
/begin MEASUREMENT B_dkunb "Bedingung: Drosselklappenposition unbekannt" UBYTE B_TRUE 1 100 0 1 BIT_MASK 0x1 FORMAT "%13.11" ECU_ADDRESS 0x7FA691 /end MEASUREMENT
/begin MEASUREMENT B_dssakt "Bedingung Saugrohrdrucksensor ist Hauptf¸llungssensor" UBYTE B_TRUE 1 100 0 1 BIT_MASK 0x1 FORMAT "%13.11" ECU_ADDRESS 0x7FA62B /end MEASUREMENT
/begin MEASUREMENT B_enimiti "Bedingung Freigabe des Reglers zur Momentenbegrenzung bei Dauereinspritzung" UBYTE B_TRUE 1 100 0 1 BIT_MASK 0x1 FORMAT "%13.11" ECU_ADDRESS 0x8011BE /end MEASUREMENT
/begin MEASUREMENT B_etol "Bedingung Fehler in ÷ltemperatur" UBYTE B_TRUE 1 100 0 1 BIT_MASK 0x1 FORMAT "%13.11" ECU_ADDRESS 0x7FA8A8 /end MEASUREMENT
/begin MEASUREMENT B_fphubap "Bedingung Hubsteuerung direkt ¸ber Fahrpedal" UBYTE B_TRUE 1 100 0 1 BIT_MASK 0x1 FORMAT "%13.11" ECU_ADDRESS 0x7FA8A9 /end MEASUREMENT
/begin MEASUREMENT B_fpwdkap "DK-Steuerung direkt ¸ber Fahrpedal" UBYTE B_TRUE 1 100 0 1 BIT_MASK 0x1 FORMAT "%13.11" ECU_ADDRESS 0x7FA8AA /end MEASUREMENT
/begin MEASUREMENT B_fzg_on "Bedingung Betrieb im Fahrzeug aktiviert" UBYTE B_TRUE 1 100 0 1 BIT_MASK 0x1 FORMAT "%13.11" ECU_ADDRESS 0x7FA8AB /end MEASUREMENT
/begin MEASUREMENT B_gen1 "Bedingung kein Einfluss des Generatormomentes auf mdverl" UBYTE B_TRUE 1 100 0 1 BIT_MASK 0x1 FORMAT "%13.11" ECU_ADDRESS 0x7FA8AC /end MEASUREMENT
/begin MEASUREMENT B_gen2 "Bedingung kein Einfluss des Generatormomentes auf mimin" UBYTE B_TRUE 1 100 0 1 BIT_MASK 0x1 FORMAT "%13.11" ECU_ADDRESS 0x7FA8AD /end MEASUREMENT
/begin MEASUREMENT B_hubap "Bedingung Hubsteuerung ¸ber Festwert" UBYTE B_TRUE 1 100 0 1 BIT_MASK 0x1 FORMAT "%13.11" ECU_ADDRESS 0x7FA8AE /end MEASUREMENT
/begin MEASUREMENT B_incr "Bedingung Inkrementierung Startadaptionsfaktor" UWORD B_TRUE 1 100 0 1 BIT_MASK 0x80 FORMAT "%13.11" ECU_ADDRESS 0x800B5C /end MEASUREMENT
/begin MEASUREMENT B_i_ska_fr "FR-Fehlerreaktion irreversible SKA (Sicherheits-Kraftstoff-Abschaltung)" UBYTE B_TRUE 1 100 0 1 BIT_MASK 0x1 FORMAT "%13.11" ECU_ADDRESS 0x7FA692 /end MEASUREMENT
/begin MEASUREMENT B_katfz "Bedingung Kat in Fahrzeug eingebaut" UBYTE B_TRUE 1 100 0 1 BIT_MASK 0x1 FORMAT "%13.11" ECU_ADDRESS 0x7FA8AF /end MEASUREMENT
/begin MEASUREMENT B_kmmilsct "Ausgabe ""km bei MIL on"" f¸r Scan Tool abschalten (0 = keine Ausgabe in PID $21)" UBYTE B_TRUE 1 100 0 1 BIT_MASK 0x1 FORMAT "%13.11" ECU_ADDRESS 0x7FA8B0 /end MEASUREMENT
/begin MEASUREMENT B_kstai "Bedingung Inkrementierung/Dekrementierung Startadaptionsfaktor" UWORD B_TRUE 1 100 0 1 BIT_MASK 0x100 FORMAT "%13.11" ECU_ADDRESS 0x800B5C /end MEASUREMENT
/begin MEASUREMENT B_kstaue "Startmengenadaptionswerte beim n‰chsten Start g¸ltig" UWORD B_TRUE 1 100 0 1 BIT_MASK 0x200 FORMAT "%13.11" ECU_ADDRESS 0x800B5C /end MEASUREMENT
/begin MEASUREMENT B_kufs "Bedingung Kupplung nicht getreten oder Fahrstufe eingelegt" UBYTE B_TRUE 1 100 0 1 BIT_MASK 0x1 FORMAT "%13.11" ECU_ADDRESS 0x7FA88A /end MEASUREMENT
/begin MEASUREMENT B_lsh "Bedingung Lambda-Sonde hinter Kat verbaut" UBYTE B_TRUE 1 100 0 1 BIT_MASK 0x1 FORMAT "%13.11" ECU_ADDRESS 0x7FA8B1 /end MEASUREMENT
/begin MEASUREMENT B_lsh2 "Bedingung Lambda-Sonde hinter Kat verbaut (Bank2)" UBYTE B_TRUE 1 100 0 1 BIT_MASK 0x1 FORMAT "%13.11" ECU_ADDRESS 0x7FA8B2 /end MEASUREMENT
/begin MEASUREMENT B_lsv "Bedingung Lambda-Sonde vor Kat verbaut, 1. Sonde nach Auslaﬂ (Bank1)" UBYTE B_TRUE 1 100 0 1 BIT_MASK 0x1 FORMAT "%13.11" ECU_ADDRESS 0x7FA8B3 /end MEASUREMENT
/begin MEASUREMENT B_lsv2 "Bedingung Lambda-Sonde vor Kat verbaut, 1. Sonde nach Auslaﬂ (Bank2)" UBYTE B_TRUE 1 100 0 1 BIT_MASK 0x1 FORMAT "%13.11" ECU_ADDRESS 0x7FA8B4 /end MEASUREMENT
/begin MEASUREMENT B_milfb "MIL-Ansteuerung fremdbestimmt durch externes SG" UBYTE B_TRUE 1 100 0 1 BIT_MASK 0x1 FORMAT "%13.11" ECU_ADDRESS 0x7FA6B2 /end MEASUREMENT
/begin MEASUREMENT B_mrfavl "Vollasterkennung ¸ber relativen Fahrerwunsch" UBYTE B_TRUE 1 100 0 1 BIT_MASK 0x1 FORMAT "%13.11" ECU_ADDRESS 0x7FA8B5 /end MEASUREMENT
/begin MEASUREMENT B_ndsav "Bedingung EEPROM-Emulation aktiv" UBYTE B_TRUE 1 100 0 1 BIT_MASK 0x1 FORMAT "%13.11" ECU_ADDRESS 0x7FA8B6 /end MEASUREMENT
/begin MEASUREMENT B_nodec "Bedingung kein Dekrementieren des Startadaptionsfactors innerhalb dieses Starts" UWORD B_TRUE 1 100 0 1 BIT_MASK 0x400 FORMAT "%13.11" ECU_ADDRESS 0x800B5C /end MEASUREMENT
/begin MEASUREMENT B_noinc "Bedingung kein Inkrementieren des Startadaptionsfaktors innerhalb dieses Starts" UWORD B_TRUE 1 100 0 1 BIT_MASK 0x800 FORMAT "%13.11" ECU_ADDRESS 0x800B5C /end MEASUREMENT
/begin MEASUREMENT B_notlu_fr "Anforderung Notluftfahren vom Funktionsrechner" UBYTE B_TRUE 1 100 0 1 BIT_MASK 0x1 FORMAT "%13.11" ECU_ADDRESS 0x7FA693 /end MEASUREMENT
/begin MEASUREMENT B_nswo1 "Bedingung Drehzahl > NSWO1" UBYTE B_TRUE 1 100 0 1 BIT_MASK 0x1 FORMAT "%13.11" ECU_ADDRESS 0x7FA8B7 /end MEASUREMENT
/begin MEASUREMENT B_nswo2 "Bedingung Drehzahl > NSWO2" UBYTE B_TRUE 1 100 0 1 BIT_MASK 0x1 FORMAT "%13.11" ECU_ADDRESS 0x7FA8B8 /end MEASUREMENT
/begin MEASUREMENT B_nwglehe "Nockenwellengleichstellung  Einlaﬂ-NW bei 2Bank-System erlaubt bei Fehler Bank1" UBYTE B_TRUE 1 100 0 1 BIT_MASK 0x2 FORMAT "%13.11" ECU_ADDRESS 0x801105 /end MEASUREMENT
/begin MEASUREMENT B_nwglehe2 "Nockenwellengleichstellung  Einlaﬂ-NW bei 2Bank-System erlaubt bei Fehler Bank2" UBYTE B_TRUE 1 100 0 1 BIT_MASK 0x4 FORMAT "%13.11" ECU_ADDRESS 0x801105 /end MEASUREMENT
/begin MEASUREMENT B_nwsapspe "Bedingung: Sollwertumschaltung bei Sollwinkelspr¸ngen Einlaﬂnockenwelle" UBYTE B_TRUE 1 100 0 1 BIT_MASK 0x1 FORMAT "%13.11" ECU_ADDRESS 0x801105 /end MEASUREMENT
/begin MEASUREMENT B_nwswg "Bedingung: Sollwinkel Nockenwelle(n) g¸ltig" UBYTE B_TRUE 1 100 0 1 BIT_MASK 0x1 FORMAT "%13.11" ECU_ADDRESS 0x80110A /end MEASUREMENT
/begin MEASUREMENT B_psapp "Bedingung delta Saugrohrdruck Vorsteuerung f¸r Applikation" UBYTE B_TRUE 1 100 0 1 BIT_MASK 0x1 FORMAT "%13.11" ECU_ADDRESS 0x7FA8B9 /end MEASUREMENT
/begin MEASUREMENT B_psger "Bedingung Umschaltung Saugrohrdruck auf gerechnetem" UBYTE B_TRUE 1 100 0 1 BIT_MASK 0x1 FORMAT "%13.11" ECU_ADDRESS 0x7FA8BA /end MEASUREMENT
/begin MEASUREMENT B_ressta "Bedingung Startautomatik zur¸cksetzen" UBYTE B_TRUE 1 100 0 1 BIT_MASK 0x1 FORMAT "%13.11" ECU_ADDRESS 0x7FA88B /end MEASUREMENT
/begin MEASUREMENT B_sadyn "Bedingung: Sauerstoffkonzentrationssignal ist station‰r f¸r Schubabgleich" UBYTE B_TRUE 1 100 0 1 BIT_MASK 0x1 FORMAT "%13.11" ECU_ADDRESS 0x7FA716 /end MEASUREMENT
/begin MEASUREMENT B_sadyn2 "Bedingung: Sauerstoffkonzentrationssignal ist station‰r f¸r Schubabgleich, Bank2" UBYTE B_TRUE 1 100 0 1 BIT_MASK 0x1 FORMAT "%13.11" ECU_ADDRESS 0x7FA717 /end MEASUREMENT
/begin MEASUREMENT B_sag "Bedingung: Schubabgleich g¸ltig" UBYTE B_TRUE 1 100 0 1 BIT_MASK 0x1 FORMAT "%13.11" ECU_ADDRESS 0x7FA718 /end MEASUREMENT
/begin MEASUREMENT B_sag2 "Bedingung: Schubabgleich g¸ltig, Bank2" UBYTE B_TRUE 1 100 0 1 BIT_MASK 0x1 FORMAT "%13.11" ECU_ADDRESS 0x7FA719 /end MEASUREMENT
/begin MEASUREMENT B_salsu "Bedingung: Schubagleich der LSU aktiv" UBYTE B_TRUE 1 100 0 1 BIT_MASK 0x1 FORMAT "%13.11" ECU_ADDRESS 0x7FA71A /end MEASUREMENT
/begin MEASUREMENT B_salsu2 "Bedingung: Schubagleich der LSU aktiv, Bank2" UBYTE B_TRUE 1 100 0 1 BIT_MASK 0x1 FORMAT "%13.11" ECU_ADDRESS 0x7FA71B /end MEASUREMENT
/begin MEASUREMENT B_sape "Bedingung: steigende Flanke B_sav" UBYTE B_TRUE 1 100 0 1 BIT_MASK 0x1 FORMAT "%13.11" ECU_ADDRESS 0x7FA71C /end MEASUREMENT
/begin MEASUREMENT B_saumg "Bedingung: Umgebungsbedinungen f¸r Schubabgleich der LSU liegen vor" UBYTE B_TRUE 1 100 0 1 BIT_MASK 0x1 FORMAT "%13.11" ECU_ADDRESS 0x7FA71D /end MEASUREMENT
/begin MEASUREMENT B_sav "Bedingung: Schubabschalten um TESAMN verzˆgert" UBYTE B_TRUE 1 100 0 1 BIT_MASK 0x1 FORMAT "%13.11" ECU_ADDRESS 0x7FA71E /end MEASUREMENT
/begin MEASUREMENT B_sta "Bedingung automatischer Start" UBYTE B_TRUE 1 100 0 1 BIT_MASK 0x1 FORMAT "%13.11" ECU_ADDRESS 0x7FA88C /end MEASUREMENT
/begin MEASUREMENT B_sta1 "Bedingung Start-Automatik Funktion" UBYTE B_TRUE 1 100 0 1 BIT_MASK 0x1 FORMAT "%13.11" ECU_ADDRESS 0x7FA88D /end MEASUREMENT
/begin MEASUREMENT B_staa "Bedingung Startadaption aktiv im Nachstart" UBYTE B_TRUE 1 100 0 1 BIT_MASK 0x1 FORMAT "%13.11" ECU_ADDRESS 0x7FA78D /end MEASUREMENT
/begin MEASUREMENT B_stdperr "Bedingung Adaptionsende aufgrund erkanntem Fehler" UWORD B_TRUE 1 100 0 1 BIT_MASK 0x1000 FORMAT "%13.11" ECU_ADDRESS 0x800B5C /end MEASUREMENT
/begin MEASUREMENT B_stseit "" UBYTE B_TRUE 1 100 0 1 BIT_MASK 0x1 FORMAT "%13.11" ECU_ADDRESS 0x7FA88E /end MEASUREMENT
/begin MEASUREMENT B_su "Bedingung Saugrohrumschaltung" UBYTE B_TRUE 1 100 0 1 BIT_MASK 0x1 FORMAT "%13.11" ECU_ADDRESS 0x7FA62E /end MEASUREMENT
/begin MEASUREMENT B_su2 "Bedingung Saugrohrumschaltung, 2. Klappe" UBYTE B_TRUE 1 100 0 1 BIT_MASK 0x1 FORMAT "%13.11" ECU_ADDRESS 0x7FA62F /end MEASUREMENT
/begin MEASUREMENT B_sukp "Bedingung f¸r die Freigabe der Saugrohrumschaltung Klappe 1" UBYTE B_TRUE 1 100 0 1 BIT_MASK 0x1 FORMAT "%13.11" ECU_ADDRESS 0x8010B4 /end MEASUREMENT
/begin MEASUREMENT B_sunw "Sollwinkel‰nderung Einlaﬂnockenwelle bei Saugrohrumschaltung aktiv" UBYTE B_TRUE 1 100 0 1 BIT_MASK 0x1 FORMAT "%13.11" ECU_ADDRESS 0x801104 /end MEASUREMENT
/begin MEASUREMENT B_tanmn "Bedingung Timer TANMN abgelaufen" UBYTE B_TRUE 1 100 0 1 BIT_MASK 0x1 FORMAT "%13.11" ECU_ADDRESS 0x7FA88F /end MEASUREMENT
/begin MEASUREMENT B_tanmx "Bedingung Timer TANMX abgelaufen" UBYTE B_TRUE 1 100 0 1 BIT_MASK 0x1 FORMAT "%13.11" ECU_ADDRESS 0x7FA890 /end MEASUREMENT
/begin MEASUREMENT B_temin "Bedingung TEMIN-Begrenzung aktiv, Bank 1" UBYTE B_TRUE 1 100 0 1 BIT_MASK 0x1 FORMAT "%13.11" ECU_ADDRESS 0x7FA792 /end MEASUREMENT
/begin MEASUREMENT B_temin2 "Bedingung TEMIN-Begrenzung aktiv, Bank 2" UBYTE B_TRUE 1 100 0 1 BIT_MASK 0x1 FORMAT "%13.11" ECU_ADDRESS 0x7FA793 /end MEASUREMENT
/begin MEASUREMENT B_tfu "Bedingung Temperaturf¸hler Umgebung vorhanden" UBYTE B_TRUE 1 100 0 1 BIT_MASK 0x1 FORMAT "%13.11" ECU_ADDRESS 0x7FA8BB /end MEASUREMENT
/begin MEASUREMENT B_tpast "Bedingung Timer TPAST abgelaufen" UBYTE B_TRUE 1 100 0 1 BIT_MASK 0x1 FORMAT "%13.11" ECU_ADDRESS 0x7FA891 /end MEASUREMENT
/begin MEASUREMENT B_tsta "Bedingung Timer TSTA abgelaufen" UBYTE B_TRUE 1 100 0 1 BIT_MASK 0x1 FORMAT "%13.11" ECU_ADDRESS 0x7FA892 /end MEASUREMENT
/begin MEASUREMENT B_tstekpv "Bedingung Timer TSTEKPV abgelaufen" UBYTE B_TRUE 1 100 0 1 BIT_MASK 0x1 FORMAT "%13.11" ECU_ADDRESS 0x7FA893 /end MEASUREMENT
/begin MEASUREMENT B_ubkst "Ubat-Schwelle ZUBKSTMX mal unterschritten" UBYTE B_TRUE 1 100 0 1 BIT_MASK 0x1 FORMAT "%13.11" ECU_ADDRESS 0x7FA78E /end MEASUREMENT
/begin MEASUREMENT B_uhrrmin "Bedingung Uhr mit relativem Minutenz‰hler" UBYTE B_TRUE 1 100 0 1 BIT_MASK 0x1 FORMAT "%13.11" ECU_ADDRESS 0x7FA8BC /end MEASUREMENT
/begin MEASUREMENT B_uhrrsec "Bedingung Uhr mit relativem Sekundenz‰hler" UBYTE B_TRUE 1 100 0 1 BIT_MASK 0x1 FORMAT "%13.11" ECU_ADDRESS 0x7FA8BD /end MEASUREMENT
/begin MEASUREMENT B_wdksap "DK-Steuerung ¸ber Festwert, Bit 1 hat Priorit‰t" UBYTE B_TRUE 1 100 0 1 BIT_MASK 0x1 FORMAT "%13.11" ECU_ADDRESS 0x7FA8BE /end MEASUREMENT
/begin MEASUREMENT B_wnws02e "Bedingung NW-Sollwertvorgabe f¸r Bank2 ist 0" UBYTE B_TRUE 1 100 0 1 BIT_MASK 0x2 FORMAT "%13.11" ECU_ADDRESS 0x801103 /end MEASUREMENT
/begin MEASUREMENT B_wnws0e "Bedingung NW-Sollwertvorgabe ist 0" UBYTE B_TRUE 1 100 0 1 BIT_MASK 0x1 FORMAT "%13.11" ECU_ADDRESS 0x801103 /end MEASUREMENT
/begin MEASUREMENT B_wnws0e2 "Bedingung NW-Sollwertvorgabe ist 0 (Bank2, Einlaﬂ)" UBYTE B_TRUE 1 100 0 1 BIT_MASK 0x4 FORMAT "%13.11" ECU_ADDRESS 0x801103 /end MEASUREMENT
/begin MEASUREMENT B_xff "Bedingung externer Freeze Frame" UBYTE B_TRUE 1 100 0 1 BIT_MASK 0x1 FORMAT "%13.11" ECU_ADDRESS 0x7FC387 /end MEASUREMENT
/begin MEASUREMENT B_zanzusta "Bedingung Anzahl Motorumdrehungen f¸r Startautomatik erreicht" UBYTE B_TRUE 1 100 0 1 BIT_MASK 0x1 FORMAT "%13.11" ECU_ADDRESS 0x7FA894 /end MEASUREMENT
/begin MEASUREMENT B_zwappl "Bedingung Z¸ndwinkelapplikation ohne Drehmomenteingriffe" UBYTE B_TRUE 1 100 0 1 BIT_MASK 0x1 FORMAT "%13.11" ECU_ADDRESS 0x7FA8BF /end MEASUREMENT
/begin MEASUREMENT cd_bits1_w "" UWORD dez 1 100 0 65535 FORMAT "%8.2" ECU_ADDRESS 0x8017D2 /end MEASUREMENT
/begin MEASUREMENT cd_bits2_w "" UWORD dez 1 100 0 65535 FORMAT "%8.2" ECU_ADDRESS 0x8017D4 /end MEASUREMENT
/begin MEASUREMENT common_rt "" ULONG dez 1 100 0 4.29497e+009 FORMAT "%13.2" ECU_ADDRESS 0x80205C /end MEASUREMENT
/begin MEASUREMENT dnburns_w "Minimaler Drehzahlanstieg f¸r Erkennung einer Verbrennung" SWORD nmot_sw_q0p25 1 100 -8192 8191.75 FORMAT "%8.3" ECU_ADDRESS 0x801748 /end MEASUREMENT
/begin MEASUREMENT dppk_w "Differenzdruck f¸r Druckkorrektur von frkate_w" SWORD p_sw_q0p312 1 100 -10240 10239.7 FORMAT "%8.2" ECU_ADDRESS 0x800B72 /end MEASUREMENT
/begin MEASUREMENT dpsfgds_w "Delta Frischluftpartialdruck im Saugrohr zwischen zwei Rechenrastern beim DSS" SWORD p_sw_q0p039 1 100 -1280 1279.96 FORMAT "%8.3" ECU_ADDRESS 0x8013D0 /end MEASUREMENT
/begin MEASUREMENT dpsfglm_w "Delta Frischluftpartialdruck im Saugrohr zwischen zwei Rechenrastern beim HFM" SWORD p_sw_q0p039 1 100 -1280 1279.96 FORMAT "%8.3" ECU_ADDRESS 0x8013DA /end MEASUREMENT
/begin MEASUREMENT dpsfg_w "delta-Frischgaspartialdruck im Saugrohr" SWORD p_sw_q0p039 1 100 -1280 1279.96 FORMAT "%8.3" ECU_ADDRESS 0x8013EC /end MEASUREMENT
/begin MEASUREMENT dpslm_w "Delta Saugrohrdruck zwischen zwei Rechenrastern beim HFM" SWORD p_sw_q0p039 1 100 -1280 1279.96 FORMAT "%8.3" ECU_ADDRESS 0x8013DC /end MEASUREMENT
/begin MEASUREMENT dpus_w "Delta Druck Umgebung Saugrohr" SWORD p_sw_q0p078 1 100 -2560 2559.92 FORMAT "%8.3" ECU_ADDRESS 0x800B74 /end MEASUREMENT
/begin MEASUREMENT drl_w "F¸llungs‰nderung (Word)" SWORD rel_sw_q0p0234 1 100 -768 767.977 FORMAT "%8.4" ECU_ADDRESS 0x8013EE /end MEASUREMENT
/begin MEASUREMENT dr_reg_resetBuffer "" ULONG default 1 100 0 4.29497e+009 FORMAT "%13.2" ARRAY_SIZE 60 ECU_ADDRESS 0x7FB1A0 /end MEASUREMENT
/begin MEASUREMENT dr_reg_resetBuffer_cnt "" UWORD default 1 100 0 65535 FORMAT "%8.2" ECU_ADDRESS 0x7FB298 /end MEASUREMENT
/begin MEASUREMENT dr_reg_resetBuffer_idx "" UWORD default 1 100 0 65535 FORMAT "%8.2" ECU_ADDRESS 0x7FB294 /end MEASUREMENT
/begin MEASUREMENT dr_reg_resetTimestampBuffer "" ULONG default 1 100 0 4.29497e+009 FORMAT "%13.2" ARRAY_SIZE 10 ECU_ADDRESS 0x7FB2A0 /end MEASUREMENT
/begin MEASUREMENT dr_reg_resetTimestampBuffer_idx "" UWORD default 1 100 0 65535 FORMAT "%8.2" ECU_ADDRESS 0x7FB2CC /end MEASUREMENT
/begin MEASUREMENT dtimx_l "Differenz zwischen max.Einspritzzeit und theoretischer max. Einspritzzeit" SLONG t1p0usxms 1 100 -2.14748e+006 2.14748e+006 FORMAT "%13.5" ECU_ADDRESS 0x800B84 /end MEASUREMENT
/begin MEASUREMENT dwnwabge_w "Max-Winkel zur Berechnung der Sollwert‰nderungsbegrenzung Einlass Nockenwelle" UWORD kw_q0p0078 1 100 0 511.992 FORMAT "%8.4" ECU_ADDRESS 0x801552 /end MEASUREMENT
/begin MEASUREMENT dwnwamxe_w "Max-Winkel zur Abschaltung der Sollwert‰nderungsbegrenzung Einlass Nockenwelle" UWORD kw_q0p0078 1 100 0 511.992 FORMAT "%8.4" ECU_ADDRESS 0x801554 /end MEASUREMENT
/begin MEASUREMENT dwnwsue_w "ƒnderung Sollwinkel Einlaﬂnockenwelle bei aktiver Saugrohrumschaltung" SWORD kw_q0p0078 1 100 -256 255.992 FORMAT "%8.4" ECU_ADDRESS 0x800608 /end MEASUREMENT
/begin MEASUREMENT ECU_TCMPlausErr "" UBYTE DC_FLAG_U8 1 100 0 1 BIT_MASK 0x1 FORMAT "%5.3" ECU_ADDRESS 0x8039EF /end MEASUREMENT
/begin MEASUREMENT Eng_TrqIndDrvrRepl "" SWORD DC_TRQ_S16 1 100 -2048 2047.94 FORMAT "%8.3" ECU_ADDRESS 0x8032CE /end MEASUREMENT
/begin MEASUREMENT Eng_TrqIndDrvrRepl_Stnd "" UWORD DC_PER1023 1 100 0 3203.03 FORMAT "%8.3" ECU_ADDRESS 0x8032D0 /end MEASUREMENT
/begin MEASUREMENT ErrEntry_AMT_EngEmOffEnabl "" UBYTE DC_CNTR_U8 1 100 0 255 FORMAT "%5.1" ECU_ADDRESS 0x803982 /end MEASUREMENT
/begin MEASUREMENT ErrEntry_AMT_EngEmOffFlt "" UBYTE DC_CNTR_U8 1 100 0 255 FORMAT "%5.1" ECU_ADDRESS 0x80397D /end MEASUREMENT
/begin MEASUREMENT ESP_Dyn0Plaus_Mode_Req "" UBYTE DC_FLAG_U8 1 100 0 1 BIT_MASK 0x1 FORMAT "%5.3" ECU_ADDRESS 0x803A04 /end MEASUREMENT
/begin MEASUREMENT ESP_Dyn1Plaus_Mode_Req "" UBYTE DC_FLAG_U8 1 100 0 1 BIT_MASK 0x1 FORMAT "%5.3" ECU_ADDRESS 0x803A05 /end MEASUREMENT
/begin MEASUREMENT ESP_Enabl "" UBYTE DC_FLAG_U8 1 100 0 1 BIT_MASK 0x1 FORMAT "%5.3" ECU_ADDRESS 0x803A06 /end MEASUREMENT
/begin MEASUREMENT ESP_IrvrsLout_Mode "" UBYTE DC_FLAG_U8 1 100 0 1 BIT_MASK 0x1 FORMAT "%5.3" ECU_ADDRESS 0x803A07 /end MEASUREMENT
/begin MEASUREMENT ESP_PlausDsabl_Mode "" UBYTE DC_FLAG_U8 1 100 0 1 BIT_MASK 0x1 FORMAT "%5.3" ECU_ADDRESS 0x803A08 /end MEASUREMENT
/begin MEASUREMENT ESP_PlausRslt "" UBYTE DC_CNTR_U8 1 100 0 255 FORMAT "%5.1" ECU_ADDRESS 0x803A09 /end MEASUREMENT
/begin MEASUREMENT ESP_TglMem "" UBYTE DC_FLAG_U8 1 100 0 1 BIT_MASK 0x1 FORMAT "%5.3" ECU_ADDRESS 0x803A0A /end MEASUREMENT
/begin MEASUREMENT ESP_TglPlaus_Cntr "" UBYTE DC_CNTR_U8 1 100 0 255 FORMAT "%5.1" ECU_ADDRESS 0x803A0B /end MEASUREMENT
/begin MEASUREMENT ESP_TrqMaxMem_Mode_Req "" UBYTE DC_FLAG_U8 1 100 0 1 BIT_MASK 0x1 FORMAT "%5.3" ECU_ADDRESS 0x803A0C /end MEASUREMENT
/begin MEASUREMENT ESP_TrqMaxPlaus_Mode_Req "" UBYTE DC_FLAG_U8 1 100 0 1 BIT_MASK 0x1 FORMAT "%5.3" ECU_ADDRESS 0x803A0D /end MEASUREMENT
/begin MEASUREMENT ESP_TrqMem_Req "" SWORD DC_TRQ_S16 1 100 -2048 2047.94 FORMAT "%8.3" ECU_ADDRESS 0x8034E4 /end MEASUREMENT
/begin MEASUREMENT ESP_TrqMinMem_Mode_Req "" UBYTE DC_FLAG_U8 1 100 0 1 BIT_MASK 0x1 FORMAT "%5.3" ECU_ADDRESS 0x803A0E /end MEASUREMENT
/begin MEASUREMENT ESP_TrqMinPlaus_Mode_Req "" UBYTE DC_FLAG_U8 1 100 0 1 BIT_MASK 0x1 FORMAT "%5.3" ECU_ADDRESS 0x803A0F /end MEASUREMENT
/begin MEASUREMENT ESP_TrqPlaus_Req "" SWORD DC_TRQ_S16 1 100 -2048 2047.94 FORMAT "%8.3" ECU_ADDRESS 0x8034E6 /end MEASUREMENT
/begin MEASUREMENT esst_san12esuw "" ULONG dez 1 100 0 4.29497e+009 FORMAT "%13.2" ECU_ADDRESS 0x801EEC /end MEASUREMENT
/begin MEASUREMENT esst_sdk10teub "" ULONG dez 1 100 0 4.29497e+009 FORMAT "%13.2" ECU_ADDRESS 0x801EF0 /end MEASUREMENT
/begin MEASUREMENT esst_sdm05tesb "" ULONG dez 1 100 0 4.29497e+009 FORMAT "%13.2" ECU_ADDRESS 0x801EF4 /end MEASUREMENT
/begin MEASUREMENT esst_sez06tmub "" ULONG dez 1 100 0 4.29497e+009 FORMAT "%13.2" ECU_ADDRESS 0x801EF8 /end MEASUREMENT
/begin MEASUREMENT esst_sfr04bbuw "" ULONG dez 1 100 0 4.29497e+009 FORMAT "%13.2" ECU_ADDRESS 0x801EFC /end MEASUREMENT
/begin MEASUREMENT esst_sfr05teub "" ULONG dez 1 100 0 4.29497e+009 FORMAT "%13.2" ECU_ADDRESS 0x801F00 /end MEASUREMENT
/begin MEASUREMENT esst_sga06mdub "" ULONG dez 1 100 0 4.29497e+009 FORMAT "%13.2" ECU_ADDRESS 0x801F04 /end MEASUREMENT
/begin MEASUREMENT esst_sga07mdub "" ULONG dez 1 100 0 4.29497e+009 FORMAT "%13.2" ECU_ADDRESS 0x801F08 /end MEASUREMENT
/begin MEASUREMENT esst_sga08mdub "" ULONG dez 1 100 0 4.29497e+009 FORMAT "%13.2" ECU_ADDRESS 0x801F0C /end MEASUREMENT
/begin MEASUREMENT esst_sim06esuw "" ULONG dez 1 100 0 4.29497e+009 FORMAT "%13.2" ECU_ADDRESS 0x801F10 /end MEASUREMENT
/begin MEASUREMENT esst_sks06esub "" ULONG dez 1 100 0 4.29497e+009 FORMAT "%13.2" ECU_ADDRESS 0x801F14 /end MEASUREMENT
/begin MEASUREMENT esst_sla05esub "" ULONG dez 1 100 0 4.29497e+009 FORMAT "%13.2" ECU_ADDRESS 0x801F18 /end MEASUREMENT
/begin MEASUREMENT esst_slx06tmuw "" ULONG dez 1 100 0 4.29497e+009 FORMAT "%13.2" ECU_ADDRESS 0x801F1C /end MEASUREMENT
/begin MEASUREMENT esst_sly06tmuw "" ULONG dez 1 100 0 4.29497e+009 FORMAT "%13.2" ECU_ADDRESS 0x801F20 /end MEASUREMENT
/begin MEASUREMENT esst_smi04llub "" ULONG dez 1 100 0 4.29497e+009 FORMAT "%13.2" ECU_ADDRESS 0x801F24 /end MEASUREMENT
/begin MEASUREMENT esst_sml06teub "" ULONG dez 1 100 0 4.29497e+009 FORMAT "%13.2" ECU_ADDRESS 0x801F28 /end MEASUREMENT
/begin MEASUREMENT esst_sml06tmuw "" ULONG dez 1 100 0 4.29497e+009 FORMAT "%13.2" ECU_ADDRESS 0x801F2C /end MEASUREMENT
/begin MEASUREMENT esst_sml07tmuw "" ULONG dez 1 100 0 4.29497e+009 FORMAT "%13.2" ECU_ADDRESS 0x801F30 /end MEASUREMENT
/begin MEASUREMENT esst_sml08lhub "" ULONG dez 1 100 0 4.29497e+009 FORMAT "%13.2" ECU_ADDRESS 0x801F34 /end MEASUREMENT
/begin MEASUREMENT esst_sn16kr1ub "" ULONG dez 1 100 0 4.29497e+009 FORMAT "%13.2" ECU_ADDRESS 0x801F38 /end MEASUREMENT
/begin MEASUREMENT esst_sn16kr2ub "" ULONG dez 1 100 0 4.29497e+009 FORMAT "%13.2" ECU_ADDRESS 0x801F3C /end MEASUREMENT
/begin MEASUREMENT esst_sng06llsb "" ULONG dez 1 100 0 4.29497e+009 FORMAT "%13.2" ECU_ADDRESS 0x801F40 /end MEASUREMENT
/begin MEASUREMENT esst_snm04dmuw1 "" ULONG dez 1 100 0 4.29497e+009 FORMAT "%13.2" ECU_ADDRESS 0x801F44 /end MEASUREMENT
/begin MEASUREMENT esst_snm04dmuw2 "" ULONG dez 1 100 0 4.29497e+009 FORMAT "%13.2" ECU_ADDRESS 0x801F48 /end MEASUREMENT
/begin MEASUREMENT esst_snm04teub "" ULONG dez 1 100 0 4.29497e+009 FORMAT "%13.2" ECU_ADDRESS 0x801F4C /end MEASUREMENT
/begin MEASUREMENT esst_snm05nauw "" ULONG dez 1 100 0 4.29497e+009 FORMAT "%13.2" ECU_ADDRESS 0x801D04 /end MEASUREMENT
/begin MEASUREMENT esst_snm05neuw "" ULONG dez 1 100 0 4.29497e+009 FORMAT "%13.2" ECU_ADDRESS 0x801D08 /end MEASUREMENT
/begin MEASUREMENT esst_snm05nwub "" ULONG dez 1 100 0 4.29497e+009 FORMAT "%13.2" ECU_ADDRESS 0x801D0C /end MEASUREMENT
/begin MEASUREMENT esst_snm05nwuw "" ULONG dez 1 100 0 4.29497e+009 FORMAT "%13.2" ECU_ADDRESS 0x801D10 /end MEASUREMENT
/begin MEASUREMENT esst_snm06esub "" ULONG dez 1 100 0 4.29497e+009 FORMAT "%13.2" ECU_ADDRESS 0x801F50 /end MEASUREMENT
/begin MEASUREMENT esst_snm06llub "" ULONG dez 1 100 0 4.29497e+009 FORMAT "%13.2" ECU_ADDRESS 0x801F54 /end MEASUREMENT
/begin MEASUREMENT esst_snm06mduw "" ULONG dez 1 100 0 4.29497e+009 FORMAT "%13.2" ECU_ADDRESS 0x801F58 /end MEASUREMENT
/begin MEASUREMENT esst_snm06nwuw "" ULONG dez 1 100 0 4.29497e+009 FORMAT "%13.2" ECU_ADDRESS 0x801D14 /end MEASUREMENT
/begin MEASUREMENT esst_snm07asub "" ULONG dez 1 100 0 4.29497e+009 FORMAT "%13.2" ECU_ADDRESS 0x801F5C /end MEASUREMENT
/begin MEASUREMENT esst_snm07esub "" ULONG dez 1 100 0 4.29497e+009 FORMAT "%13.2" ECU_ADDRESS 0x801F60 /end MEASUREMENT
/begin MEASUREMENT esst_snm07lsuw "" ULONG dez 1 100 0 4.29497e+009 FORMAT "%13.2" ECU_ADDRESS 0x801F64 /end MEASUREMENT
/begin MEASUREMENT esst_snm08dmub "" ULONG dez 1 100 0 4.29497e+009 FORMAT "%13.2" ECU_ADDRESS 0x801F68 /end MEASUREMENT
/begin MEASUREMENT esst_snm08dmuw1 "" ULONG dez 1 100 0 4.29497e+009 FORMAT "%13.2" ECU_ADDRESS 0x801F6C /end MEASUREMENT
/begin MEASUREMENT esst_snm08dmuw2 "" ULONG dez 1 100 0 4.29497e+009 FORMAT "%13.2" ECU_ADDRESS 0x801F70 /end MEASUREMENT
/begin MEASUREMENT esst_snm08feub "" ULONG dez 1 100 0 4.29497e+009 FORMAT "%13.2" ECU_ADDRESS 0x801F74 /end MEASUREMENT
/begin MEASUREMENT esst_snm08gkub "" ULONG dez 1 100 0 4.29497e+009 FORMAT "%13.2" ECU_ADDRESS 0x801F78 /end MEASUREMENT
/begin MEASUREMENT esst_snm08kruw "" ULONG dez 1 100 0 4.29497e+009 FORMAT "%13.2" ECU_ADDRESS 0x801F7C /end MEASUREMENT
/begin MEASUREMENT esst_snm08lhub "" ULONG dez 1 100 0 4.29497e+009 FORMAT "%13.2" ECU_ADDRESS 0x801F80 /end MEASUREMENT
/begin MEASUREMENT esst_snm08opub "" ULONG dez 1 100 0 4.29497e+009 FORMAT "%13.2" ECU_ADDRESS 0x801F84 /end MEASUREMENT
/begin MEASUREMENT esst_snm08__ub "" ULONG dez 1 100 0 4.29497e+009 FORMAT "%13.2" ECU_ADDRESS 0x801F88 /end MEASUREMENT
/begin MEASUREMENT esst_snm10lsub "" ULONG dez 1 100 0 4.29497e+009 FORMAT "%13.2" ECU_ADDRESS 0x801F8C /end MEASUREMENT
/begin MEASUREMENT esst_snm10teub "" ULONG dez 1 100 0 4.29497e+009 FORMAT "%13.2" ECU_ADDRESS 0x801F90 /end MEASUREMENT
/begin MEASUREMENT esst_snm12esub "" ULONG dez 1 100 0 4.29497e+009 FORMAT "%13.2" ECU_ADDRESS 0x801F94 /end MEASUREMENT
/begin MEASUREMENT esst_snm12feub "" ULONG dez 1 100 0 4.29497e+009 FORMAT "%13.2" ECU_ADDRESS 0x801F98 /end MEASUREMENT
/begin MEASUREMENT esst_snm16krub "" ULONG dez 1 100 0 4.29497e+009 FORMAT "%13.2" ECU_ADDRESS 0x801F9C /end MEASUREMENT
/begin MEASUREMENT esst_snm16nauw "" ULONG dez 1 100 0 4.29497e+009 FORMAT "%13.2" ECU_ADDRESS 0x801D18 /end MEASUREMENT
/begin MEASUREMENT esst_snm16neuw "" ULONG dez 1 100 0 4.29497e+009 FORMAT "%13.2" ECU_ADDRESS 0x801D1C /end MEASUREMENT
/begin MEASUREMENT esst_snm16opuw "" ULONG dez 1 100 0 4.29497e+009 FORMAT "%13.2" ECU_ADDRESS 0x801FA0 /end MEASUREMENT
/begin MEASUREMENT esst_snm16zuub "" ULONG dez 1 100 0 4.29497e+009 FORMAT "%13.2" ECU_ADDRESS 0x801FA4 /end MEASUREMENT
/begin MEASUREMENT esst_snm16zuuw "" ULONG dez 1 100 0 4.29497e+009 FORMAT "%13.2" ECU_ADDRESS 0x801FA8 /end MEASUREMENT
/begin MEASUREMENT esst_snm24zuub "" ULONG dez 1 100 0 4.29497e+009 FORMAT "%13.2" ECU_ADDRESS 0x801FAC /end MEASUREMENT
/begin MEASUREMENT esst_sqm05teub "" ULONG dez 1 100 0 4.29497e+009 FORMAT "%13.2" ECU_ADDRESS 0x801FB0 /end MEASUREMENT
/begin MEASUREMENT esst_srl04krub "" ULONG dez 1 100 0 4.29497e+009 FORMAT "%13.2" ECU_ADDRESS 0x801FB4 /end MEASUREMENT
/begin MEASUREMENT esst_srl05nauw "" ULONG dez 1 100 0 4.29497e+009 FORMAT "%13.2" ECU_ADDRESS 0x801D20 /end MEASUREMENT
/begin MEASUREMENT esst_srl05neuw "" ULONG dez 1 100 0 4.29497e+009 FORMAT "%13.2" ECU_ADDRESS 0x801D24 /end MEASUREMENT
/begin MEASUREMENT esst_srl06esub "" ULONG dez 1 100 0 4.29497e+009 FORMAT "%13.2" ECU_ADDRESS 0x801FB8 /end MEASUREMENT
/begin MEASUREMENT esst_srl06zuub "" ULONG dez 1 100 0 4.29497e+009 FORMAT "%13.2" ECU_ADDRESS 0x801FBC /end MEASUREMENT
/begin MEASUREMENT esst_srl08dmub "" ULONG dez 1 100 0 4.29497e+009 FORMAT "%13.2" ECU_ADDRESS 0x801FC0 /end MEASUREMENT
/begin MEASUREMENT esst_srl08lsuw "" ULONG dez 1 100 0 4.29497e+009 FORMAT "%13.2" ECU_ADDRESS 0x801FC4 /end MEASUREMENT
/begin MEASUREMENT esst_srl08nauw "" ULONG dez 1 100 0 4.29497e+009 FORMAT "%13.2" ECU_ADDRESS 0x801D28 /end MEASUREMENT
/begin MEASUREMENT esst_srl08neuw "" ULONG dez 1 100 0 4.29497e+009 FORMAT "%13.2" ECU_ADDRESS 0x801D2C /end MEASUREMENT
/begin MEASUREMENT esst_srl08nxub "" ULONG dez 1 100 0 4.29497e+009 FORMAT "%13.2" ECU_ADDRESS 0x801FC8 /end MEASUREMENT
/begin MEASUREMENT esst_srl10lsub "" ULONG dez 1 100 0 4.29497e+009 FORMAT "%13.2" ECU_ADDRESS 0x801FCC /end MEASUREMENT
/begin MEASUREMENT esst_srl12esub "" ULONG dez 1 100 0 4.29497e+009 FORMAT "%13.2" ECU_ADDRESS 0x801FD0 /end MEASUREMENT
/begin MEASUREMENT esst_srl12gkub "" ULONG dez 1 100 0 4.29497e+009 FORMAT "%13.2" ECU_ADDRESS 0x801FD4 /end MEASUREMENT
/begin MEASUREMENT esst_srl12zuub "" ULONG dez 1 100 0 4.29497e+009 FORMAT "%13.2" ECU_ADDRESS 0x801FD8 /end MEASUREMENT
/begin MEASUREMENT esst_srl12zuuw "" ULONG dez 1 100 0 4.29497e+009 FORMAT "%13.2" ECU_ADDRESS 0x801FDC /end MEASUREMENT
/begin MEASUREMENT esst_srl16zuub "" ULONG dez 1 100 0 4.29497e+009 FORMAT "%13.2" ECU_ADDRESS 0x801FE0 /end MEASUREMENT
/begin MEASUREMENT esst_srp06esub "" ULONG dez 1 100 0 4.29497e+009 FORMAT "%13.2" ECU_ADDRESS 0x801FE4 /end MEASUREMENT
/begin MEASUREMENT esst_st107tmub "" ULONG dez 1 100 0 4.29497e+009 FORMAT "%13.2" ECU_ADDRESS 0x801FE8 /end MEASUREMENT
/begin MEASUREMENT esst_st207tmub "" ULONG dez 1 100 0 4.29497e+009 FORMAT "%13.2" ECU_ADDRESS 0x801FEC /end MEASUREMENT
/begin MEASUREMENT esst_st307tmub "" ULONG dez 1 100 0 4.29497e+009 FORMAT "%13.2" ECU_ADDRESS 0x801FF0 /end MEASUREMENT
/begin MEASUREMENT esst_st407tmub "" ULONG dez 1 100 0 4.29497e+009 FORMAT "%13.2" ECU_ADDRESS 0x801FF4 /end MEASUREMENT
/begin MEASUREMENT esst_sta04llub "" ULONG dez 1 100 0 4.29497e+009 FORMAT "%13.2" ECU_ADDRESS 0x801FF8 /end MEASUREMENT
/begin MEASUREMENT esst_sta04saub "" ULONG dez 1 100 0 4.29497e+009 FORMAT "%13.2" ECU_ADDRESS 0x801FFC /end MEASUREMENT
/begin MEASUREMENT esst_sta06esub "" ULONG dez 1 100 0 4.29497e+009 FORMAT "%13.2" ECU_ADDRESS 0x802000 /end MEASUREMENT
/begin MEASUREMENT esst_sta12wlub "" ULONG dez 1 100 0 4.29497e+009 FORMAT "%13.2" ECU_ADDRESS 0x802004 /end MEASUREMENT
/begin MEASUREMENT esst_stk04saub "" ULONG dez 1 100 0 4.29497e+009 FORMAT "%13.2" ECU_ADDRESS 0x802008 /end MEASUREMENT
/begin MEASUREMENT esst_stk06saub "" ULONG dez 1 100 0 4.29497e+009 FORMAT "%13.2" ECU_ADDRESS 0x80200C /end MEASUREMENT
/begin MEASUREMENT esst_stm04saub "" ULONG dez 1 100 0 4.29497e+009 FORMAT "%13.2" ECU_ADDRESS 0x802010 /end MEASUREMENT
/begin MEASUREMENT esst_stm05nwub "" ULONG dez 1 100 0 4.29497e+009 FORMAT "%13.2" ECU_ADDRESS 0x801D30 /end MEASUREMENT
/begin MEASUREMENT esst_stm05saub "" ULONG dez 1 100 0 4.29497e+009 FORMAT "%13.2" ECU_ADDRESS 0x802014 /end MEASUREMENT
/begin MEASUREMENT esst_stm05tmub "" ULONG dez 1 100 0 4.29497e+009 FORMAT "%13.2" ECU_ADDRESS 0x802018 /end MEASUREMENT
/begin MEASUREMENT esst_stm06llub "" ULONG dez 1 100 0 4.29497e+009 FORMAT "%13.2" ECU_ADDRESS 0x80201C /end MEASUREMENT
/begin MEASUREMENT esst_stm06__ub "" ULONG dez 1 100 0 4.29497e+009 FORMAT "%13.2" ECU_ADDRESS 0x802020 /end MEASUREMENT
/begin MEASUREMENT esst_stm08bbub "" ULONG dez 1 100 0 4.29497e+009 FORMAT "%13.2" ECU_ADDRESS 0x802024 /end MEASUREMENT
/begin MEASUREMENT esst_stm08dmub "" ULONG dez 1 100 0 4.29497e+009 FORMAT "%13.2" ECU_ADDRESS 0x802028 /end MEASUREMENT
/begin MEASUREMENT esst_stm08mdub "" ULONG dez 1 100 0 4.29497e+009 FORMAT "%13.2" ECU_ADDRESS 0x80202C /end MEASUREMENT
/begin MEASUREMENT esst_stm09esub "" ULONG dez 1 100 0 4.29497e+009 FORMAT "%13.2" ECU_ADDRESS 0x802030 /end MEASUREMENT
/begin MEASUREMENT esst_stm10__ub "" ULONG dez 1 100 0 4.29497e+009 FORMAT "%13.2" ECU_ADDRESS 0x802034 /end MEASUREMENT
/begin MEASUREMENT esst_stm12esub "" ULONG dez 1 100 0 4.29497e+009 FORMAT "%13.2" ECU_ADDRESS 0x802038 /end MEASUREMENT
/begin MEASUREMENT esst_sto06nwuw "" ULONG dez 1 100 0 4.29497e+009 FORMAT "%13.2" ECU_ADDRESS 0x801D34 /end MEASUREMENT
/begin MEASUREMENT esst_sts08coub "" ULONG dez 1 100 0 4.29497e+009 FORMAT "%13.2" ECU_ADDRESS 0x80203C /end MEASUREMENT
/begin MEASUREMENT esst_sts08esub "" ULONG dez 1 100 0 4.29497e+009 FORMAT "%13.2" ECU_ADDRESS 0x802040 /end MEASUREMENT
/begin MEASUREMENT esst_sts12esub "" ULONG dez 1 100 0 4.29497e+009 FORMAT "%13.2" ECU_ADDRESS 0x802044 /end MEASUREMENT
/begin MEASUREMENT esst_stw06mdub "" ULONG dez 1 100 0 4.29497e+009 FORMAT "%13.2" ECU_ADDRESS 0x802048 /end MEASUREMENT
/begin MEASUREMENT esst_swd06krsw "" ULONG dez 1 100 0 4.29497e+009 FORMAT "%13.2" ECU_ADDRESS 0x80204C /end MEASUREMENT
/begin MEASUREMENT esst_swp08opub "" ULONG dez 1 100 0 4.29497e+009 FORMAT "%13.2" ECU_ADDRESS 0x802050 /end MEASUREMENT
/begin MEASUREMENT evtmodev "Spulentemperatur eines Einspritzventils" UBYTE temp_ub_q0p75_o48 1 100 -48 143.25 FORMAT "%5.1" ECU_ADDRESS 0x800B70 /end MEASUREMENT
/begin MEASUREMENT fakezmn_w "Minimum aus zyl. individuellen  Korrekturfaktoren d.  effektiven Einspritzdauer" UWORD fak_uw_b2 1 100 0 1.99997 FORMAT "%8.6" ECU_ADDRESS 0x800B76 /end MEASUREMENT
/begin MEASUREMENT fcmclrCtr "" ULONG dez 1 100 0 4.29497e+009 FORMAT "%13.2" ECU_ADDRESS 0x801E80 /end MEASUREMENT
/begin MEASUREMENT firstsynchroCtr "" ULONG dez 1 100 0 4.29497e+009 FORMAT "%13.2" ECU_ADDRESS 0x801E84 /end MEASUREMENT
/begin MEASUREMENT fnwua "Gewichtungsfaktor Nockenwellen¸berschneidung (Auslaﬂ)" UBYTE fak_ub_b1 1 100 0 0.996094 ECU_ADDRESS 0x801108 /end MEASUREMENT
/begin MEASUREMENT fnwue "Gewichtungsfaktor Nockenwellen¸berschneidung (Einlaﬂ)" UBYTE fak_ub_b1 1 100 0 0.996094 ECU_ADDRESS 0x801109 /end MEASUREMENT
/begin MEASUREMENT fnwu_w "Faktor Nockenwellen Gesamt¸berschneidung" UWORD fak_uw_b2 1 100 0 1.99997 FORMAT "%8.6" ECU_ADDRESS 0x801566 /end MEASUREMENT
/begin MEASUREMENT fnwwarme "Faktor Nockenwellensollwinkel ‹bergang kalt -> Warmkennfelder Einlaﬂ" UBYTE fak_ub_b2 1 100 0 1.99219 FORMAT "%5.3" ECU_ADDRESS 0x800604 /end MEASUREMENT
/begin MEASUREMENT frkate_w "Faktor Umrechnung rel. Kraftstoffmasse rk  in eff. Einspritzzeit te" UWORD rkti_q0p4166Em4 1 100 0 2.73062 FORMAT "%8.6" ECU_ADDRESS 0x80174A /end MEASUREMENT
/begin MEASUREMENT FsgIdCounter "" UWORD dez 1 100 0 65535 FORMAT "%8.2" ECU_ADDRESS 0x7FA15C /end MEASUREMENT
/begin MEASUREMENT FsgIdMemCounter "" UWORD dez 1 100 0 65535 FORMAT "%8.2" ECU_ADDRESS 0x7FA15E /end MEASUREMENT
/begin MEASUREMENT FsgMemCounter "" UWORD dez 1 100 0 65535 FORMAT "%8.2" ECU_ADDRESS 0x7FA160 /end MEASUREMENT
/begin MEASUREMENT fsu_w "Faktor Saugrohrumschaltung" UWORD fak_uw_b1 1 100 0 0.999985 FORMAT "%9.7" ECU_ADDRESS 0x8013FC /end MEASUREMENT
/begin MEASUREMENT FTBU_Cond1_Mode "" UBYTE DC_FLAG_U8 1 100 0 1 BIT_MASK 0x1 FORMAT "%5.3" ECU_ADDRESS 0x803A14 /end MEASUREMENT
/begin MEASUREMENT FTBU_Cond2_Mode "" UBYTE DC_FLAG_U8 1 100 0 1 BIT_MASK 0x1 FORMAT "%5.3" ECU_ADDRESS 0x803A15 /end MEASUREMENT
/begin MEASUREMENT FTBU_Cond3_Mode "" UBYTE DC_FLAG_U8 1 100 0 1 BIT_MASK 0x1 FORMAT "%5.3" ECU_ADDRESS 0x803A16 /end MEASUREMENT
/begin MEASUREMENT FTBU_Cond4_Mode "" UBYTE DC_FLAG_U8 1 100 0 1 BIT_MASK 0x1 FORMAT "%5.3" ECU_ADDRESS 0x803A17 /end MEASUREMENT
/begin MEASUREMENT FTBU_Cond_Mode "" UBYTE DC_FLAG_U8 1 100 0 1 BIT_MASK 0x1 FORMAT "%5.3" ECU_ADDRESS 0x803A18 /end MEASUREMENT
/begin MEASUREMENT FTBU_DelTrq_Fctr "" UBYTE DC_FCTR_32_U8 1 100 0 7.96875 FORMAT "%7.5" ECU_ADDRESS 0x803A19 /end MEASUREMENT
/begin MEASUREMENT FTBU_FuncCntr "" UBYTE DC_CNTR_U8 1 100 0 255 FORMAT "%5.1" ECU_ADDRESS 0x803A1A /end MEASUREMENT
/begin MEASUREMENT FTBU_RelLoadLimSprd_Mode "" UBYTE DC_FLAG_U8 1 100 0 1 BIT_MASK 0x1 FORMAT "%5.3" ECU_ADDRESS 0x803A1B /end MEASUREMENT
/begin MEASUREMENT FTBU_Trq_Req "" SWORD DC_TRQ_S16 1 100 -2048 2047.94 FORMAT "%8.3" ECU_ADDRESS 0x803500 /end MEASUREMENT
/begin MEASUREMENT ftek2_w "Korrekturfaktor f¸r effektive Einspritzzeit, Bank 2" UWORD fak_uw_b2 1 100 0 1.99997 FORMAT "%8.6" ECU_ADDRESS 0x80174C /end MEASUREMENT
/begin MEASUREMENT ftek_w "Korrekturfaktor f¸r effektive Einspritzzeit" UWORD fak_uw_b2 1 100 0 1.99997 FORMAT "%8.6" ECU_ADDRESS 0x80174E /end MEASUREMENT
/begin MEASUREMENT grundwert "Abstand SW-Bezugsmarke zu OT in ∞KW" UBYTE dez 1 100 0 255 FORMAT "%5.1" ECU_ADDRESS 0x801227 /end MEASUREMENT
/begin MEASUREMENT hw1Ctr "" ULONG dez 1 100 0 4.29497e+009 FORMAT "%13.2" ECU_ADDRESS 0x801E88 /end MEASUREMENT
/begin MEASUREMENT hw2Ctr "" ULONG dez 1 100 0 4.29497e+009 FORMAT "%13.2" ECU_ADDRESS 0x801E8C /end MEASUREMENT
/begin MEASUREMENT hw3Ctr "" ULONG dez 1 100 0 4.29497e+009 FORMAT "%13.2" ECU_ADDRESS 0x801E90 /end MEASUREMENT
/begin MEASUREMENT hw4Ctr "" ULONG dez 1 100 0 4.29497e+009 FORMAT "%13.2" ECU_ADDRESS 0x801E94 /end MEASUREMENT
/begin MEASUREMENT inisynchroCtr "" ULONG dez 1 100 0 4.29497e+009 FORMAT "%13.2" ECU_ADDRESS 0x801E98 /end MEASUREMENT
/begin MEASUREMENT inisynct_w "Z‰hler f¸r Initialisierungsdurchl‰ufe" UWORD dez 1 100 0 65535 FORMAT "%8.2" ECU_ADDRESS 0x801C50 /end MEASUREMENT
/begin MEASUREMENT iprefanf "Referenzpumpstrom LSU" UBYTE dez 1 100 0 15 FORMAT "%5.2" ECU_ADDRESS 0x8009CA /end MEASUREMENT
/begin MEASUREMENT iprefanf2 "Referenzpumpstrom LSU 2" UBYTE dez 1 100 0 15 FORMAT "%5.2" ECU_ADDRESS 0x8009CB /end MEASUREMENT
/begin MEASUREMENT ko2vk2_w "Korrekturfaktor f¸r Funktionspumstrom LSU aus Schubabgleich, Bank2" UWORD fak_uw_b16 1 100 0 15.9998 FORMAT "%8.5" ECU_ADDRESS 0x8016C6 /end MEASUREMENT
/begin MEASUREMENT ko2vki2_w "Korrekturfaktor f¸r Funktionspumpstrom LSU (intern), Bank2" UWORD fak_uw_b16 1 100 0 15.9998 FORMAT "%8.5" ECU_ADDRESS 0x7FC74A /end MEASUREMENT
/begin MEASUREMENT ko2vkin2_w "Korrekturfaktor f¸r Funktionspumstrom LSU aus Schubabgleich, Bypass-Wert Bank2" UWORD fak_uw_b16 1 100 0 15.9998 FORMAT "%8.5" ECU_ADDRESS 0x8016C8 /end MEASUREMENT
/begin MEASUREMENT ko2vkin_w "Korrekturfaktor f¸r Funktionspumstrom LSU aus Schubabgleich, Bypass-Wert" UWORD fak_uw_b16 1 100 0 15.9998 FORMAT "%8.5" ECU_ADDRESS 0x8016CA /end MEASUREMENT
/begin MEASUREMENT ko2vki_w "Korrekturfaktor f¸r Funktionspumpstrom LSU (intern)" UWORD fak_uw_b16 1 100 0 15.9998 FORMAT "%8.5" ECU_ADDRESS 0x7FC74C /end MEASUREMENT
/begin MEASUREMENT ko2vk_w "Korrekturfaktor f¸r Funktionspumstrom LSU aus Schubabgleich" UWORD fak_uw_b16 1 100 0 15.9998 FORMAT "%8.5" ECU_ADDRESS 0x8016CC /end MEASUREMENT
/begin MEASUREMENT ksta0 "Kaltstartanreicherung Bereich 0, gepuffert" UBYTE fak_ub_b2 1 100 0 1.99219 FORMAT "%5.3" ECU_ADDRESS 0x7FC778 /end MEASUREMENT
/begin MEASUREMENT ksta0w "Kaltstartanreicherung Bereich 0, aktuell eingerechnet" UBYTE fak_ub_b2 1 100 0 1.99219 FORMAT "%5.3" ECU_ADDRESS 0x8011AB /end MEASUREMENT
/begin MEASUREMENT ksta1 "Kaltstartanreicherung Bereich 1, gepuffert" UBYTE fak_ub_b2 1 100 0 1.99219 FORMAT "%5.3" ECU_ADDRESS 0x7FC779 /end MEASUREMENT
/begin MEASUREMENT ksta1w "Kaltstartanreicherung Bereich 1, aktuell eingerechnet" UBYTE fak_ub_b2 1 100 0 1.99219 FORMAT "%5.3" ECU_ADDRESS 0x8011AC /end MEASUREMENT
/begin MEASUREMENT ksta2 "Kaltstartanreicherung Bereich 2, gepuffert" UBYTE fak_ub_b2 1 100 0 1.99219 FORMAT "%5.3" ECU_ADDRESS 0x7FC77A /end MEASUREMENT
/begin MEASUREMENT ksta2w "Kaltstartanreicherung Bereich 2, aktuell eingerechnet" UBYTE fak_ub_b2 1 100 0 1.99219 FORMAT "%5.3" ECU_ADDRESS 0x8011AD /end MEASUREMENT
/begin MEASUREMENT kstaa "Aktueller Startmengenadaptionsfaktor" UBYTE fak_ub_b2 1 100 0 1.99219 FORMAT "%5.3" ECU_ADDRESS 0x8011AE /end MEASUREMENT
/begin MEASUREMENT mitibgri_w "I-Anteil f¸r begrenztes Moment aus ti-Regelung bei ununterbrochener Einspritzung" UWORD rel_uw_b100 1 100 0 99.9985 FORMAT "%8.5" ECU_ADDRESS 0x800B78 /end MEASUREMENT
/begin MEASUREMENT mitibgrp_w "P-Anteil f¸r begrenztes Moment aus ti-Regelung bei ununterbrochener Einspritzung" SWORD rel_sw_b50 1 100 -50 49.9985 FORMAT "%8.5" ECU_ADDRESS 0x800B7A /end MEASUREMENT
/begin MEASUREMENT mitibgr_w "begrenztes Moment aus ti-Regelung bei ununterbrochener Einspritzung" UWORD rel_uw_b100 1 100 0 99.9985 FORMAT "%8.5" ECU_ADDRESS 0x800B7C /end MEASUREMENT
/begin MEASUREMENT ml "Luftmassenfluﬂ" UBYTE m_ub_b1020 1 100 0 1020 FORMAT "%5.0" ECU_ADDRESS 0x7FAA0B /end MEASUREMENT
/begin MEASUREMENT ml_w "Luftmassenfluﬂ gefiltert (Word)" UWORD m_uw_b6553p5 1 100 0 6553.5 FORMAT "%8.3" ECU_ADDRESS 0x7FAA32 /end MEASUREMENT
/begin MEASUREMENT msfabr_w "Massenstrom F¸llung der durch die Auslaﬂventile aus dem Brennraum flieﬂt" UWORD m_uw_b6553p5 1 100 0 6553.5 FORMAT "%8.3" ECU_ADDRESS 0x8013F0 /end MEASUREMENT
/begin MEASUREMENT msfebr_w "Massenstrom F¸llung der durch die Einlaﬂventile in den Brennraum flieﬂt" UWORD m_uw_b6553p5 1 100 0 6553.5 FORMAT "%8.3" ECU_ADDRESS 0x8013F2 /end MEASUREMENT
/begin MEASUREMENT ngfilsu_w "Drehzahlgradient ¸ber ein Arbeitsspiel f¸r Saugrohrumschaltung gefiltert" SWORD nmotg_sw_q0p39 1 100 -12800.2 12799.8 FORMAT "%8.2" ECU_ADDRESS 0x8013FE /end MEASUREMENT
/begin MEASUREMENT nmotsu "korrigierte Drehzahl in Abh‰ngigkeit vom Drehzahlgradienten" UBYTE nmot_ub_q40 1 100 0 10200 FORMAT "%5.0" ECU_ADDRESS 0x8010B2 /end MEASUREMENT
/begin MEASUREMENT nstmxm "" UWORD nmot_uw_q0p25 1 100 0 16383.8 FORMAT "%8.2" ECU_ADDRESS 0x8017CE /end MEASUREMENT
/begin MEASUREMENT NWSOLLEausbits_10ms "" UBYTE dez 1 100 0 255 FORMAT "%5.1" ECU_ADDRESS 0x801103 /end MEASUREMENT
/begin MEASUREMENT NWSOLLEausbits_koop "" UBYTE dez 1 100 0 255 FORMAT "%5.1" ECU_ADDRESS 0x801104 /end MEASUREMENT
/begin MEASUREMENT NWSOLLElokbits_koop "" UBYTE dez 1 100 0 255 FORMAT "%5.1" ECU_ADDRESS 0x801105 /end MEASUREMENT
/begin MEASUREMENT o2adap2_w "Adaptiertes O2-Konzentration-Signal nach erfolgreichem Schubabgleich, Bank2" SWORD relO2_q9p765Em4 1 100 -32 31.999 FORMAT "%8.5" ECU_ADDRESS 0x8016CE /end MEASUREMENT
/begin MEASUREMENT o2adapi2_w "Adaptiertes O2-Konzentration-Signal nach erfolgreichem Schubabgleich (Byp) Bank2" SWORD relO2_q9p765Em4 1 100 -32 31.999 FORMAT "%8.5" ECU_ADDRESS 0x8016D0 /end MEASUREMENT
/begin MEASUREMENT o2adapi_w "Adaptiertes O2-Konzentration-Signal nach erfolgreichem Schubabgleich (Byp)" SWORD relO2_q9p765Em4 1 100 -32 31.999 FORMAT "%8.5" ECU_ADDRESS 0x8016D2 /end MEASUREMENT
/begin MEASUREMENT o2adap_w "Adaptiertes O2-Konzentration-Signal nach erfolgreichem Schubabgleich" SWORD relO2_q9p765Em4 1 100 -32 31.999 FORMAT "%8.5" ECU_ADDRESS 0x8016D4 /end MEASUREMENT
/begin MEASUREMENT o2delta2_w "Differenz zwischen Referenz-O2-Konzentration (Frischluft) und LSU-Signal, Bank2" SWORD relO2_q9p765Em4 1 100 -32 31.999 FORMAT "%8.5" ECU_ADDRESS 0x800958 /end MEASUREMENT
/begin MEASUREMENT o2delta_w "Differenz zwischen Referenz-O2-Konzentration (Frischluft) und LSU-Signal" SWORD relO2_q9p765Em4 1 100 -32 31.999 FORMAT "%8.5" ECU_ADDRESS 0x80095A /end MEASUREMENT
/begin MEASUREMENT o2korr2_w "Korrigierte O2-Konzentration w‰hrend Schubabgleich, Bank2" SWORD relO2_q9p765Em4 1 100 -32 31.999 FORMAT "%8.5" ECU_ADDRESS 0x80095C /end MEASUREMENT
/begin MEASUREMENT o2korr_w "Korrigierte O2-Konzentration w‰hrend Schubabgleich" SWORD relO2_q9p765Em4 1 100 -32 31.999 FORMAT "%8.5" ECU_ADDRESS 0x80095E /end MEASUREMENT
/begin MEASUREMENT obdsteuer "aus CAN-Signal OBD_STEUER aufbereitete Grˆﬂe f¸r ME" UBYTE dez 1 100 0 255 FORMAT "%5.1" ECU_ADDRESS 0x800670 /end MEASUREMENT
/begin MEASUREMENT pbrdss_w "Berechneter Brennraumdruck mit DSS" UWORD p_uw_q0p039 1 100 0 2559.96 FORMAT "%8.3" ECU_ADDRESS 0x8013D2 /end MEASUREMENT
/begin MEASUREMENT performance "" UBYTE rel_ub_b100 1 100 0 99.6094 FORMAT "%5.2" ECU_ADDRESS 0x801054 /end MEASUREMENT
/begin MEASUREMENT ps "gemessener Saugrohr-Absolutdruck" UBYTE p_ub_q10 1 100 0 2550 FORMAT "%5.0" ECU_ADDRESS 0x8010AE /end MEASUREMENT
/begin MEASUREMENT psfgds_w "Frischluftpartialdruck im Saugrohr (Luft, ¸ber DK und TEV)DSS-basiert+int. Restg" UWORD p_uw_q0p039 1 100 0 2559.96 FORMAT "%8.3" ECU_ADDRESS 0x8013D4 /end MEASUREMENT
/begin MEASUREMENT psfglm_w "Frischluftpartialdruck im Saugrohr (Luft, ¸ber DK und TEV)HFM-basiert+int. Restg" UWORD p_uw_q0p039 1 100 0 2559.96 FORMAT "%8.3" ECU_ADDRESS 0x8013DE /end MEASUREMENT
/begin MEASUREMENT psfg_w "Frischgaspartialdruck im Saugrohr (word)" UWORD p_uw_q0p039 1 100 0 2559.96 FORMAT "%8.3" ECU_ADDRESS 0x8013F4 /end MEASUREMENT
/begin MEASUREMENT pslmsm_w "modellierter Saugrohrdruck HFM basiert(MItte segment)" UWORD p_uw_q0p039 1 100 0 2559.96 FORMAT "%8.3" ECU_ADDRESS 0x8013E0 /end MEASUREMENT
/begin MEASUREMENT pslm_w "modellierter Saugrohrdruck HFM basiert" UWORD p_uw_q0p039 1 100 0 2559.96 FORMAT "%8.3" ECU_ADDRESS 0x8013E2 /end MEASUREMENT
/begin MEASUREMENT ps_w "Saugrohr-Absolutdruck (Word)" UWORD p_uw_q0p039 1 100 0 2559.96 FORMAT "%8.3" ECU_ADDRESS 0x7FAA34 /end MEASUREMENT
/begin MEASUREMENT qtitimnh "Quotient ti / TIMIN ( im Homogenbetrieb - bei BDE)" UBYTE fak_ub_b4 1 100 0 3.98438 FORMAT "%5.3" ECU_ADDRESS 0x800B71 /end MEASUREMENT
/begin MEASUREMENT r1000msCtr "" ULONG dez 1 100 0 4.29497e+009 FORMAT "%13.2" ECU_ADDRESS 0x801E9C /end MEASUREMENT
/begin MEASUREMENT r1000ms_swoff_Ctr "" ULONG dez 1 100 0 4.29497e+009 FORMAT "%13.2" ECU_ADDRESS 0x801EA0 /end MEASUREMENT
/begin MEASUREMENT r100msCtr "" ULONG dez 1 100 0 4.29497e+009 FORMAT "%13.2" ECU_ADDRESS 0x801EA4 /end MEASUREMENT
/begin MEASUREMENT r100ms_swoff_Ctr "" ULONG dez 1 100 0 4.29497e+009 FORMAT "%13.2" ECU_ADDRESS 0x801EA8 /end MEASUREMENT
/begin MEASUREMENT r10msCtr "10ms-Raster-Z‰hler der Funktion" ULONG dez 1 100 0 4.29497e+009 FORMAT "%13.2" ECU_ADDRESS 0x801EAC /end MEASUREMENT
/begin MEASUREMENT r10ms_swoff_Ctr "" ULONG dez 1 100 0 4.29497e+009 FORMAT "%13.2" ECU_ADDRESS 0x801EB0 /end MEASUREMENT
/begin MEASUREMENT r1msCtr "Z‰hler f¸r 1ms Abl‰ufe" ULONG dez 1 100 0 4.29497e+009 FORMAT "%13.2" ECU_ADDRESS 0x801EB4 /end MEASUREMENT
/begin MEASUREMENT r1ms_swoff_Ctr "" ULONG dez 1 100 0 4.29497e+009 FORMAT "%13.2" ECU_ADDRESS 0x801EB8 /end MEASUREMENT
/begin MEASUREMENT r200msCtr "" ULONG dez 1 100 0 4.29497e+009 FORMAT "%13.2" ECU_ADDRESS 0x801EBC /end MEASUREMENT
/begin MEASUREMENT r200ms_swoff_Ctr "" ULONG dez 1 100 0 4.29497e+009 FORMAT "%13.2" ECU_ADDRESS 0x801EC0 /end MEASUREMENT
/begin MEASUREMENT r20msCtr "" ULONG dez 1 100 0 4.29497e+009 FORMAT "%13.2" ECU_ADDRESS 0x801EC4 /end MEASUREMENT
/begin MEASUREMENT r20ms_swoff_Ctr "" ULONG dez 1 100 0 4.29497e+009 FORMAT "%13.2" ECU_ADDRESS 0x801EC8 /end MEASUREMENT
/begin MEASUREMENT r2msCtr "" ULONG dez 1 100 0 4.29497e+009 FORMAT "%13.2" ECU_ADDRESS 0x801ECC /end MEASUREMENT
/begin MEASUREMENT r2ms_swoff_Ctr "" ULONG dez 1 100 0 4.29497e+009 FORMAT "%13.2" ECU_ADDRESS 0x801ED0 /end MEASUREMENT
/begin MEASUREMENT r50msCtr "" ULONG dez 1 100 0 4.29497e+009 FORMAT "%13.2" ECU_ADDRESS 0x801ED4 /end MEASUREMENT
/begin MEASUREMENT r50ms_swoff_Ctr "" ULONG dez 1 100 0 4.29497e+009 FORMAT "%13.2" ECU_ADDRESS 0x801ED8 /end MEASUREMENT
/begin MEASUREMENT r5msCtr "" ULONG dez 1 100 0 4.29497e+009 FORMAT "%13.2" ECU_ADDRESS 0x801EDC /end MEASUREMENT
/begin MEASUREMENT r5ms_swoff_Ctr "" ULONG dez 1 100 0 4.29497e+009 FORMAT "%13.2" ECU_ADDRESS 0x801EE0 /end MEASUREMENT
/begin MEASUREMENT rasfak "Korrekturfaktor f¸r Rasteraufweitung (10ms-Raster und grˆﬂer)" UBYTE fak_ub_b2 1 100 0 1.99219 FORMAT "%5.3" ECU_ADDRESS 0x801229 /end MEASUREMENT
/begin MEASUREMENT rfdsorgi_w "relative F¸llung gesamt ohne internes Restgas DSS basiert" UWORD rel_uw_q0p0234 1 100 0 1535.98 FORMAT "%8.3" ECU_ADDRESS 0x8013D6 /end MEASUREMENT
/begin MEASUREMENT rfges_w "gesamte relative F¸llung (inclusive AGR) 16-Bit" UWORD rel_uw_q0p0234 1 100 0 1535.98 FORMAT "%8.3" ECU_ADDRESS 0x7FAA36 /end MEASUREMENT
/begin MEASUREMENT rflmoism_w "relative F¸llung gesamt ohne internes Restgas HFM basiert(Mitte Segment)" UWORD rel_uw_q0p0234 1 100 0 1535.98 FORMAT "%8.3" ECU_ADDRESS 0x8013E4 /end MEASUREMENT
/begin MEASUREMENT rflmorgi_w "relative F¸llung gesamt ohne internes Restgas HFM basiert" UWORD rel_uw_q0p0234 1 100 0 1535.98 FORMAT "%8.3" ECU_ADDRESS 0x8013E6 /end MEASUREMENT
/begin MEASUREMENT rforgi_w "relative F¸llung gesamt ohne internes Restgas" UWORD rel_uw_q0p0234 1 100 0 1535.98 FORMAT "%8.3" ECU_ADDRESS 0x8013F6 /end MEASUREMENT
/begin MEASUREMENT rkteLocBitsCoop "" UBYTE dez 1 100 0 255 FORMAT "%5.1" ECU_ADDRESS 0x8011BE /end MEASUREMENT
/begin MEASUREMENT rl "relative Luftf¸llung" UBYTE rel_ub_q0p75 1 100 0 191.25 FORMAT "%5.1" ECU_ADDRESS 0x7FAA0C /end MEASUREMENT
/begin MEASUREMENT rlfgds_w "relative Frischluft (Luft ¸ber DK und TEV) DSS-basiert" UWORD rel_uw_q0p0234 1 100 0 1535.98 FORMAT "%8.3" ECU_ADDRESS 0x8013D8 /end MEASUREMENT
/begin MEASUREMENT rlfglmsm_w "relative Frischluft (Luft ¸ber DK und TEV) HFM-basiert(Mitte Segment)" UWORD rel_uw_q0p0234 1 100 0 1535.98 FORMAT "%8.3" ECU_ADDRESS 0x8013E8 /end MEASUREMENT
/begin MEASUREMENT rlfglm_w "relative Frischluft (Luft ¸ber DK und TEV) HFM-basiert" UWORD rel_uw_q0p0234 1 100 0 1535.98 FORMAT "%8.3" ECU_ADDRESS 0x8013EA /end MEASUREMENT
/begin MEASUREMENT rlfg_w "relative Frischluft (Luft, die ¸ber DK und TEV flieﬂt)" UWORD rel_uw_q0p0234 1 100 0 1535.98 FORMAT "%8.3" ECU_ADDRESS 0x8013F8 /end MEASUREMENT
/begin MEASUREMENT rlsu "Auswahl zwischen rl und rlshk ¸ber SY_EGAS" UBYTE rel_ub_q0p75 1 100 0 191.25 FORMAT "%5.1" ECU_ADDRESS 0x8010B3 /end MEASUREMENT
/begin MEASUREMENT rl_w "relative Luftf¸llung (Word)" UWORD rel_uw_q0p0234 1 100 0 1535.98 FORMAT "%8.3" ECU_ADDRESS 0x7FAA38 /end MEASUREMENT
/begin MEASUREMENT rt_1000ms "" UWORD txms_uw_q0p0004 1 100 0 26.214 FORMAT "%8.5" ECU_ADDRESS 0x801C72 /end MEASUREMENT
/begin MEASUREMENT rt_100ms "" UWORD txms_uw_q0p0004 1 100 0 26.214 FORMAT "%8.5" ECU_ADDRESS 0x801C74 /end MEASUREMENT
/begin MEASUREMENT rt_100msModAkt "" ULONG rel_ul_q0p0004 1 100 0 1.71799e+006 FORMAT "%13.5" ECU_ADDRESS 0x802060 /end MEASUREMENT
/begin MEASUREMENT rt_10ms "" UWORD txms_uw_q0p0004 1 100 0 26.214 FORMAT "%8.5" ECU_ADDRESS 0x801C76 /end MEASUREMENT
/begin MEASUREMENT rt_10msModAkt "" ULONG rel_ul_q0p0004 1 100 0 1.71799e+006 FORMAT "%13.5" ECU_ADDRESS 0x802064 /end MEASUREMENT
/begin MEASUREMENT rt_10mss "" ULONG rel_ul_q0p0004 1 100 0 1.71799e+006 FORMAT "%13.5" ECU_ADDRESS 0x802068 /end MEASUREMENT
/begin MEASUREMENT rt_1ms "" UWORD txms_uw_q0p0004 1 100 0 26.214 FORMAT "%8.5" ECU_ADDRESS 0x801C78 /end MEASUREMENT
/begin MEASUREMENT rt_1msModAkt "" ULONG rel_ul_q0p0004 1 100 0 1.71799e+006 FORMAT "%13.5" ECU_ADDRESS 0x80206C /end MEASUREMENT
/begin MEASUREMENT rt_1mss "" ULONG rel_ul_q0p0004 1 100 0 1.71799e+006 FORMAT "%13.5" ECU_ADDRESS 0x802070 /end MEASUREMENT
/begin MEASUREMENT rt_200ms "" UWORD txms_uw_q0p0004 1 100 0 26.214 FORMAT "%8.5" ECU_ADDRESS 0x801C7A /end MEASUREMENT
/begin MEASUREMENT rt_20ms "" UWORD txms_uw_q0p0004 1 100 0 26.214 FORMAT "%8.5" ECU_ADDRESS 0x801C7C /end MEASUREMENT
/begin MEASUREMENT rt_20msModAkt "" ULONG rel_ul_q0p0004 1 100 0 1.71799e+006 FORMAT "%13.5" ECU_ADDRESS 0x802074 /end MEASUREMENT
/begin MEASUREMENT rt_20mss "" ULONG rel_ul_q0p0004 1 100 0 1.71799e+006 FORMAT "%13.5" ECU_ADDRESS 0x802078 /end MEASUREMENT
/begin MEASUREMENT rt_2ms "" UWORD txms_uw_q0p0004 1 100 0 26.214 FORMAT "%8.5" ECU_ADDRESS 0x801C7E /end MEASUREMENT
/begin MEASUREMENT rt_2msModAkt "" ULONG rel_ul_q0p0004 1 100 0 1.71799e+006 FORMAT "%13.5" ECU_ADDRESS 0x80207C /end MEASUREMENT
/begin MEASUREMENT rt_2mss "" ULONG rel_ul_q0p0004 1 100 0 1.71799e+006 FORMAT "%13.5" ECU_ADDRESS 0x802080 /end MEASUREMENT
/begin MEASUREMENT rt_50ms "" UWORD txms_uw_q0p0004 1 100 0 26.214 FORMAT "%8.5" ECU_ADDRESS 0x801C80 /end MEASUREMENT
/begin MEASUREMENT rt_50msModAkt "" ULONG rel_ul_q0p0004 1 100 0 1.71799e+006 FORMAT "%13.5" ECU_ADDRESS 0x802084 /end MEASUREMENT
/begin MEASUREMENT rt_50mss "" ULONG rel_ul_q0p0004 1 100 0 1.71799e+006 FORMAT "%13.5" ECU_ADDRESS 0x802088 /end MEASUREMENT
/begin MEASUREMENT rt_5ms "" UWORD txms_uw_q0p0004 1 100 0 26.214 FORMAT "%8.5" ECU_ADDRESS 0x801C82 /end MEASUREMENT
/begin MEASUREMENT rt_5msModAkt "" ULONG rel_ul_q0p0004 1 100 0 1.71799e+006 FORMAT "%13.5" ECU_ADDRESS 0x80208C /end MEASUREMENT
/begin MEASUREMENT rt_5mss "" ULONG rel_ul_q0p0004 1 100 0 1.71799e+006 FORMAT "%13.5" ECU_ADDRESS 0x802090 /end MEASUREMENT
/begin MEASUREMENT rt_bg "" UWORD txms_uw_q0p0004 1 100 0 26.214 FORMAT "%8.5" ECU_ADDRESS 0x801C84 /end MEASUREMENT
/begin MEASUREMENT rt_bg_brutto "" UWORD txms_uw_q0p0032 1 100 0 209.712 FORMAT "%8.4" ECU_ADDRESS 0x801C86 /end MEASUREMENT
/begin MEASUREMENT rt_bg_brutto_max "" UWORD txms_uw_q0p0032 1 100 0 209.712 FORMAT "%8.4" ECU_ADDRESS 0x801C88 /end MEASUREMENT
/begin MEASUREMENT rt_bit_time "" UWORD txms_uw_q0p0004 1 100 0 26.214 FORMAT "%8.5" ECU_ADDRESS 0x801C8A /end MEASUREMENT
/begin MEASUREMENT rt_hw1 "" UWORD txms_uw_q0p0004 1 100 0 26.214 FORMAT "%8.5" ECU_ADDRESS 0x801C8C /end MEASUREMENT
/begin MEASUREMENT rt_hw1s "" ULONG rel_ul_q0p0004 1 100 0 1.71799e+006 FORMAT "%13.5" ECU_ADDRESS 0x802094 /end MEASUREMENT
/begin MEASUREMENT rt_hw2 "" UWORD txms_uw_q0p0004 1 100 0 26.214 FORMAT "%8.5" ECU_ADDRESS 0x801C8E /end MEASUREMENT
/begin MEASUREMENT rt_hw2s "" ULONG rel_ul_q0p0004 1 100 0 1.71799e+006 FORMAT "%13.5" ECU_ADDRESS 0x802098 /end MEASUREMENT
/begin MEASUREMENT rt_hw3 "" UWORD txms_uw_q0p0004 1 100 0 26.214 FORMAT "%8.5" ECU_ADDRESS 0x801C90 /end MEASUREMENT
/begin MEASUREMENT rt_hw3s "" ULONG rel_ul_q0p0004 1 100 0 1.71799e+006 FORMAT "%13.5" ECU_ADDRESS 0x80209C /end MEASUREMENT
/begin MEASUREMENT rt_hw4 "" UWORD txms_uw_q0p0004 1 100 0 26.214 FORMAT "%8.5" ECU_ADDRESS 0x801C92 /end MEASUREMENT
/begin MEASUREMENT rt_hw4s "" ULONG rel_ul_q0p0004 1 100 0 1.71799e+006 FORMAT "%13.5" ECU_ADDRESS 0x8020A0 /end MEASUREMENT
/begin MEASUREMENT rt_ModAkt "" ULONG rel_ul_q0p0004 1 100 0 1.71799e+006 FORMAT "%13.5" ECU_ADDRESS 0x8020A4 /end MEASUREMENT
/begin MEASUREMENT rt_res5v "" UWORD txms_uw_q0p0004 1 100 0 26.214 FORMAT "%8.5" ECU_ADDRESS 0x801C94 /end MEASUREMENT
/begin MEASUREMENT rt_syn "" UWORD txms_uw_q0p0004 1 100 0 26.214 FORMAT "%8.5" ECU_ADDRESS 0x801C96 /end MEASUREMENT
/begin MEASUREMENT rt_synModAkt "" ULONG rel_ul_q0p0004 1 100 0 1.71799e+006 FORMAT "%13.5" ECU_ADDRESS 0x8020A8 /end MEASUREMENT
/begin MEASUREMENT rt_syns "" ULONG rel_ul_q0p0004 1 100 0 1.71799e+006 FORMAT "%13.5" ECU_ADDRESS 0x8020AC /end MEASUREMENT
/begin MEASUREMENT rt_taskCamshaft1 "" UWORD txms_uw_q0p0004 1 100 0 26.214 FORMAT "%8.5" ECU_ADDRESS 0x801C98 /end MEASUREMENT
/begin MEASUREMENT rt_taskCamshaft2 "" UWORD txms_uw_q0p0004 1 100 0 26.214 FORMAT "%8.5" ECU_ADDRESS 0x801C9A /end MEASUREMENT
/begin MEASUREMENT rt_taskCamshaft3 "" UWORD txms_uw_q0p0004 1 100 0 26.214 FORMAT "%8.5" ECU_ADDRESS 0x801C9C /end MEASUREMENT
/begin MEASUREMENT rt_taskCamshaft4 "" UWORD txms_uw_q0p0004 1 100 0 26.214 FORMAT "%8.5" ECU_ADDRESS 0x801C9E /end MEASUREMENT
/begin MEASUREMENT rt_taskEveryToothIntISR "" UWORD txms_uw_q0p0004 1 100 0 26.214 FORMAT "%8.5" ECU_ADDRESS 0x801CA0 /end MEASUREMENT
/begin MEASUREMENT rt_umtask "" UWORD txms_uw_q0p0004 1 100 0 26.214 FORMAT "%8.5" ECU_ADDRESS 0x801CA2 /end MEASUREMENT
/begin MEASUREMENT sadyn2_w "Dynamische Welligkeit des O2-Konzentration-Signals, Bank2" SWORD relO2_q9p765Em4 1 100 -32 31.999 FORMAT "%8.5" ECU_ADDRESS 0x8016D6 /end MEASUREMENT
/begin MEASUREMENT sadyn_w "Dynamische Welligkeit des O2-Konzentration-Signals" SWORD relO2_q9p765Em4 1 100 -32 31.999 FORMAT "%8.5" ECU_ADDRESS 0x8016D8 /end MEASUREMENT
/begin MEASUREMENT SBC_FuncDsabllrr "" UBYTE DC_FLAG_U8 1 100 0 1 BIT_MASK 0x1 FORMAT "%5.3" ECU_ADDRESS 0x8039FD /end MEASUREMENT
/begin MEASUREMENT SBC_ISRDActv_Mem "" UBYTE DC_CNTR_U8 1 100 0 255 FORMAT "%5.1" ECU_ADDRESS 0x8039FE /end MEASUREMENT
/begin MEASUREMENT SBC_ISRDReq_Mem "" UBYTE DC_FLAG_U8 1 100 0 1 BIT_MASK 0x1 FORMAT "%5.3" ECU_ADDRESS 0x8039FF /end MEASUREMENT
/begin MEASUREMENT SBC_ISRD_Req "" UBYTE DC_FLAG_U8 1 100 0 1 BIT_MASK 0x1 FORMAT "%5.3" ECU_ADDRESS 0x803A00 /end MEASUREMENT
/begin MEASUREMENT SBC_ISRD_State "" UBYTE DC_CNTR_U8 1 100 0 255 FORMAT "%5.1" ECU_ADDRESS 0x803A01 /end MEASUREMENT
/begin MEASUREMENT SBC_RepDsabl_Tmr "" UWORD DC_TIME_20MS_U16 1 100 0 1310.7 FORMAT "%6.1" ECU_ADDRESS 0x8034D8 /end MEASUREMENT
/begin MEASUREMENT SBC_SigDbnc_Tmr "" UWORD DC_TIME_20MS_U16 1 100 0 1310.7 FORMAT "%6.1" ECU_ADDRESS 0x8034DA /end MEASUREMENT
/begin MEASUREMENT SBC_SS "" UBYTE DC_FLAG_U8 1 100 0 1 BIT_MASK 0x1 FORMAT "%5.3" ECU_ADDRESS 0x803A02 /end MEASUREMENT
/begin MEASUREMENT SBC_Tgl_Mem "" UBYTE DC_FLAG_U8 1 100 0 1 BIT_MASK 0x1 FORMAT "%5.3" ECU_ADDRESS 0x803A03 /end MEASUREMENT
/begin MEASUREMENT SBC_Tgl_Tmr "" UWORD DC_TIME_20MS_U16 1 100 0 1310.7 FORMAT "%6.1" ECU_ADDRESS 0x8034DC /end MEASUREMENT
/begin MEASUREMENT sst_dyn_app_add_dyn_r "" UWORD DC_SEARCH 1 100 0 65535 FORMAT "%6.0" ECU_ADDRESS 0x8032D2 /end MEASUREMENT
/begin MEASUREMENT stactr "Startadaptionscounter" UBYTE dez 1 100 0 255 FORMAT "%5.1" ECU_ADDRESS 0x8011AF /end MEASUREMENT
/begin MEASUREMENT STADAPlokBits "" UWORD dez 1 100 0 65535 FORMAT "%8.2" ECU_ADDRESS 0x800B5C /end MEASUREMENT
/begin MEASUREMENT SteeringAngleOverLim "" UBYTE DC_FLAG_U8 1 100 0 1 BIT_MASK 0x1 FORMAT "%5.3" ECU_ADDRESS 0x803A10 /end MEASUREMENT
/begin MEASUREMENT SteeringAngle_AdapValLeft "" UWORD DC_WL05_U16DB 1 100 0 32767.5 FORMAT "%5.0" ECU_ADDRESS 0x7FC858 /end MEASUREMENT
/begin MEASUREMENT SteeringAngle_AdapValRight "" UWORD DC_WL05_U16DB 1 100 0 32767.5 FORMAT "%5.0" ECU_ADDRESS 0x7FC85A /end MEASUREMENT
/begin MEASUREMENT SteeringAngle_EngRun_Cntr "" UBYTE DC_CNTR_U8 1 100 0 255 FORMAT "%5.1" ECU_ADDRESS 0x7FC87A /end MEASUREMENT
/begin MEASUREMENT SteeringAngle_FuncCntr "" UBYTE DC_CNTR_U8 1 100 0 255 FORMAT "%5.1" ECU_ADDRESS 0x803A11 /end MEASUREMENT
/begin MEASUREMENT SteeringAngle_IrvrsLout_Mode "" UBYTE DC_FLAG_U8 1 100 0 1 BIT_MASK 0x1 FORMAT "%5.3" ECU_ADDRESS 0x803A12 /end MEASUREMENT
/begin MEASUREMENT SteeringAngle_PlausCheck_Mode "" UBYTE DC_FLAG_U8 1 100 0 1 BIT_MASK 0x1 FORMAT "%5.3" ECU_ADDRESS 0x803A13 /end MEASUREMENT
/begin MEASUREMENT SteeringAngle_TglTmr "" UWORD DC_TIME_20MS_U16 1 100 0 1310.7 FORMAT "%6.1" ECU_ADDRESS 0x8034F0 /end MEASUREMENT
/begin MEASUREMENT sumode "Zustand der Saugrohrumschaltung" UBYTE dez 1 100 0 255 FORMAT "%5.1" ECU_ADDRESS 0x8010B5 /end MEASUREMENT
/begin MEASUREMENT synchroCtr "Synchroraster-Counter" ULONG dez 1 100 0 4.29497e+009 FORMAT "%13.2" ECU_ADDRESS 0x801EE4 /end MEASUREMENT
/begin MEASUREMENT synchroSwoffCtr "" ULONG dez 1 100 0 4.29497e+009 FORMAT "%13.2" ECU_ADDRESS 0x801EE8 /end MEASUREMENT
/begin MEASUREMENT tanmnCtr "" UBYTE t10msxs_ub_b2p55 1 100 0 2.55 FORMAT "%5.3" ECU_ADDRESS 0x80121A /end MEASUREMENT
/begin MEASUREMENT tanmxCtr "" UBYTE t1sxs_ub_b255 1 100 0 255 FORMAT "%5.1" ECU_ADDRESS 0x80121B /end MEASUREMENT
/begin MEASUREMENT tanovmxCtr "" UBYTE t1sxs_ub_b255 1 100 0 255 FORMAT "%5.1" ECU_ADDRESS 0x80121C /end MEASUREMENT
/begin MEASUREMENT TCM_Dyn0Plaus_Mode_Req "" UBYTE DC_FLAG_U8 1 100 0 1 BIT_MASK 0x1 FORMAT "%5.3" ECU_ADDRESS 0x8039F0 /end MEASUREMENT
/begin MEASUREMENT TCM_Dyn1Plaus_Mode_Req "" UBYTE DC_FLAG_U8 1 100 0 1 BIT_MASK 0x1 FORMAT "%5.3" ECU_ADDRESS 0x8039F1 /end MEASUREMENT
/begin MEASUREMENT TCM_EmergSo_Dsabl "" UBYTE DC_CNTR_U8 1 100 0 255 FORMAT "%5.1" ECU_ADDRESS 0x8039F2 /end MEASUREMENT
/begin MEASUREMENT TCM_Enabl "" UBYTE DC_FLAG_U8 1 100 0 1 BIT_MASK 0x1 FORMAT "%5.3" ECU_ADDRESS 0x8039F3 /end MEASUREMENT
/begin MEASUREMENT TCM_IrvrsLout_Mode "" UBYTE DC_FLAG_U8 1 100 0 1 BIT_MASK 0x1 FORMAT "%5.3" ECU_ADDRESS 0x8039F4 /end MEASUREMENT
/begin MEASUREMENT TCM_PlausDsabl_Mode "" UBYTE DC_FLAG_U8 1 100 0 1 BIT_MASK 0x1 FORMAT "%5.3" ECU_ADDRESS 0x8039F5 /end MEASUREMENT
/begin MEASUREMENT TCM_PlausRslt "" UBYTE DC_CNTR_U8 1 100 0 255 FORMAT "%5.1" ECU_ADDRESS 0x8039F6 /end MEASUREMENT
/begin MEASUREMENT TCM_TglMem "" UBYTE DC_FLAG_U8 1 100 0 1 BIT_MASK 0x1 FORMAT "%5.3" ECU_ADDRESS 0x8039F7 /end MEASUREMENT
/begin MEASUREMENT TCM_TglPlaus_Cntr "" UBYTE DC_CNTR_U8 1 100 0 255 FORMAT "%5.1" ECU_ADDRESS 0x8039F8 /end MEASUREMENT
/begin MEASUREMENT TCM_TrqMaxMem_Mode_Req "" UBYTE DC_FLAG_U8 1 100 0 1 BIT_MASK 0x1 FORMAT "%5.3" ECU_ADDRESS 0x8039F9 /end MEASUREMENT
/begin MEASUREMENT TCM_TrqMaxPlaus_Mode_Req "" UBYTE DC_FLAG_U8 1 100 0 1 BIT_MASK 0x1 FORMAT "%5.3" ECU_ADDRESS 0x8039FA /end MEASUREMENT
/begin MEASUREMENT TCM_TrqMem_Req "" SWORD DC_TRQ_S16 1 100 -2048 2047.94 FORMAT "%8.3" ECU_ADDRESS 0x8034CA /end MEASUREMENT
/begin MEASUREMENT TCM_TrqMinMem_Mode_Req "" UBYTE DC_FLAG_U8 1 100 0 1 BIT_MASK 0x1 FORMAT "%5.3" ECU_ADDRESS 0x8039FB /end MEASUREMENT
/begin MEASUREMENT TCM_TrqMinPlaus_Mode_Req "" UBYTE DC_FLAG_U8 1 100 0 1 BIT_MASK 0x1 FORMAT "%5.3" ECU_ADDRESS 0x8039FC /end MEASUREMENT
/begin MEASUREMENT TCM_TrqPlaus_Req "" SWORD DC_TRQ_S16 1 100 -2048 2047.94 FORMAT "%8.3" ECU_ADDRESS 0x8034CC /end MEASUREMENT
/begin MEASUREMENT te2_l "effektive Einspritzzeit (long), Bank 2" ULONG t1p0usxms 1 100 0 4.29497e+006 FORMAT "%13.5" ECU_ADDRESS 0x801D8C /end MEASUREMENT
/begin MEASUREMENT tef2_w "effektive Einspritzzeit Bank 2" UWORD t100msxs_q16Em6 1 100 0 1.04856 FORMAT "%8.6" ECU_ADDRESS 0x801AD2 /end MEASUREMENT
/begin MEASUREMENT tef_w "effektive Einspritzzeit" UWORD t100msxs_q16Em6 1 100 0 1.04856 FORMAT "%8.6" ECU_ADDRESS 0x801AD4 /end MEASUREMENT
/begin MEASUREMENT tevfa2_l "effektive Einspritzzeit vor Feinabgleich (longword) Bank 2" ULONG t1p0usxms 1 100 0 4.29497e+006 FORMAT "%13.5" ECU_ADDRESS 0x801D90 /end MEASUREMENT
/begin MEASUREMENT tevfak_w "effektive Einspritzzeit vor Feinabgleich (word); zur KF-Adressierung" UWORD t1p0usxms 1 100 0 65.535 FORMAT "%8.5" ECU_ADDRESS 0x800B7E /end MEASUREMENT
/begin MEASUREMENT tevfawe_l "effektive Einspritzzeit vor Feinabgleich (longword, Wiedereinsetzen)" ULONG t1p0usxms 1 100 0 4.29497e+006 FORMAT "%13.5" ECU_ADDRESS 0x801D94 /end MEASUREMENT
/begin MEASUREMENT tevfa_l "effektive Einspritzzeit vor Feinabgleich (longword)" ULONG t1p0usxms 1 100 0 4.29497e+006 FORMAT "%13.5" ECU_ADDRESS 0x801D98 /end MEASUREMENT
/begin MEASUREMENT tezwe_l "effektive Wiedereinsatzmehrmenge (long)" ULONG t1p0usxms 1 100 0 4.29497e+006 FORMAT "%13.5" ECU_ADDRESS 0x801D9C /end MEASUREMENT
/begin MEASUREMENT tez_l "effektive Einspritzzeit (long) zylinderindividuell" ULONG t1p0usxms 1 100 0 4.29497e+006 FORMAT "%13.5" ARRAY_SIZE 8 ECU_ADDRESS 0x801DA0 /end MEASUREMENT
/begin MEASUREMENT te_l "effektive Einspritzzeit (long)" ULONG t1p0usxms 1 100 0 4.29497e+006 FORMAT "%13.5" ECU_ADDRESS 0x801DC0 /end MEASUREMENT
/begin MEASUREMENT timxth_l "theoretische maximale Einspritzzeit" ULONG t1p0usxms 1 100 0 4.29497e+006 FORMAT "%13.5" ECU_ADDRESS 0x801DC4 /end MEASUREMENT
/begin MEASUREMENT timx_l "maximale Einspritzzeit" ULONG t1p0usxms 1 100 0 4.29497e+006 FORMAT "%13.5" ECU_ADDRESS 0x801DC8 /end MEASUREMENT
/begin MEASUREMENT tmadb "Bereich Motortemperatur f¸r Startmengenadaption" UBYTE dez 1 100 0 255 FORMAT "%5.1" ECU_ADDRESS 0x8011B0 /end MEASUREMENT
/begin MEASUREMENT tnwsbge "Zeitkonstante f¸r Sollwert‰nderungsbegrenzung Einlassnockenwelle" UBYTE zk10msxs_ub_b2p55 1 100 0.01 2.55 FORMAT "%5.3" ECU_ADDRESS 0x801106 /end MEASUREMENT
/begin MEASUREMENT tnwsbge2 "Zeitkonstante f¸r Sollwert‰nderungsbegrenzung Einlassnockenwelle 2" UBYTE zk10msxs_ub_b2p55 1 100 0.01 2.55 FORMAT "%5.3" ECU_ADDRESS 0x801107 /end MEASUREMENT
/begin MEASUREMENT tpastCtr "" UBYTE t10msxs_ub_b2p55 1 100 0 2.55 FORMAT "%5.3" ECU_ADDRESS 0x80121D /end MEASUREMENT
/begin MEASUREMENT tstaCtr "" UWORD t100msxs_uw_b6553p5 1 100 0 6553.5 FORMAT "%8.3" ECU_ADDRESS 0x8017D0 /end MEASUREMENT
/begin MEASUREMENT tstekpvCtr "" UBYTE t10msxs_ub_b2p55 1 100 0 2.55 FORMAT "%5.3" ECU_ADDRESS 0x80121E /end MEASUREMENT
/begin MEASUREMENT tvktsp_w "EV-temperaturabh‰ngige Verzugszeitkorrektur" SWORD t1p0usxms 1 100 -32.768 32.767 FORMAT "%8.5" ECU_ADDRESS 0x800B80 /end MEASUREMENT
/begin MEASUREMENT tvnwe "Verstellzeit Einlaﬂnockenwelle" UBYTE t50msxs_q0p05 1 100 0 12.75 FORMAT "%5.2" ECU_ADDRESS 0x800605 /end MEASUREMENT
/begin MEASUREMENT tvsuae "Verzˆgerungszeit f¸r Saugrohrumschaltung bei Anschlag erreicht" UBYTE t50msxs_q0p05 1 100 0 12.75 FORMAT "%5.2" ECU_ADDRESS 0x8010B6 /end MEASUREMENT
/begin MEASUREMENT tvub_w "Verzugszeit bei Einspritzventilen, batteriespannungsabh‰ngig" UWORD t1p0usxms 1 100 0 65.535 FORMAT "%8.5" ECU_ADDRESS 0x800B82 /end MEASUREMENT
/begin MEASUREMENT wdnwse2_w "Sollwinkeldifferenz am Eingang ƒnderungsbegrenzung Einlaﬂnockenwelle 2" SWORD kw_sw_q0p0078 1 100 -256 255.992 FORMAT "%8.4" ECU_ADDRESS 0x801556 /end MEASUREMENT
/begin MEASUREMENT wdnwse_w "Sollwinkeldifferenz am Eingang ƒnderungsbegrenzung Einlaﬂnockenwelle" SWORD kw_sw_q0p0078 1 100 -256 255.992 FORMAT "%8.4" ECU_ADDRESS 0x801558 /end MEASUREMENT
/begin MEASUREMENT wessbm "Winkel Einlass schliesst sp‰t bis Bezugsmarke" SBYTE kw_q2p8125 1 100 -360 357.188 FORMAT "%5.1" ECU_ADDRESS 0x801228 /end MEASUREMENT
/begin MEASUREMENT wnvuhoms_w "Soll¸berschneidungswinkel  Nockenw.  nur durch Verstellung homogen Mode" UWORD kw_q0p0078 1 100 0 511.992 FORMAT "%8.4" ECU_ADDRESS 0x801568 /end MEASUREMENT
/begin MEASUREMENT wnwdshke_w "Deltasollwinkel Nockenwelle Einlaﬂ Hˆhenkorrektur bei Katheizen" SWORD kw_sw_q0p0078 1 100 -256 255.992 FORMAT "%8.4" ECU_ADDRESS 0x80060A /end MEASUREMENT
/begin MEASUREMENT wnwehom_w "Vorsteuerwert f¸r NW-Sollwinkel im Homogenbetrieb Einlaﬂ" SWORD kw_sw_q0p0078 1 100 -256 255.992 FORMAT "%8.4" ECU_ADDRESS 0x80060C /end MEASUREMENT
/begin MEASUREMENT wnweos "Sollwinkel f¸r Nockenwelle Einlaﬂ ˆffnet" UBYTE kw_ub_q0p5 1 100 0 127.5 FORMAT "%5.1" ECU_ADDRESS 0x800606 /end MEASUREMENT
/begin MEASUREMENT wnweos2 "Sollwinkel f¸r Nockenwelle Einlaﬂ ˆffnet (Bank2)" UBYTE kw_ub_q0p5 1 100 0 127.5 FORMAT "%5.1" ECU_ADDRESS 0x800607 /end MEASUREMENT
/begin MEASUREMENT wnwgv_w "Gesamtverstellwinkel  Ein- und Auslass Nockenwelle" UWORD kw_q0p0078 1 100 0 511.992 FORMAT "%8.4" ECU_ADDRESS 0x80156A /end MEASUREMENT
/begin MEASUREMENT wnwkhe_w "Sollwinkel Nockenwelle Einlaﬂ bei Katheizen" SWORD kw_sw_q0p0078 1 100 -256 255.992 FORMAT "%8.4" ECU_ADDRESS 0x80060E /end MEASUREMENT
/begin MEASUREMENT wnwkhlle_w "Sollwinkel Nockenwelle Einlaﬂ bei Katheizen und B_ll" SWORD kw_sw_q0p0078 1 100 -256 255.992 FORMAT "%8.4" ECU_ADDRESS 0x800610 /end MEASUREMENT
/begin MEASUREMENT wnwsae_w "aktiver Sollwinkel, der aus den verschiedenen Kennfeldern selektiert wurde Einla" SWORD kw_sw_q0p0078 1 100 -256 255.992 FORMAT "%8.4" ECU_ADDRESS 0x800612 /end MEASUREMENT
/begin MEASUREMENT wnwsape_w "Sollwinkel Einlassnockenwelle aus Kennfeld oder Festwert f¸r Applikationszwecke" SWORD kw_sw_q0p0078 1 100 -256 255.992 FORMAT "%8.4" ECU_ADDRESS 0x800614 /end MEASUREMENT
/begin MEASUREMENT wnwsbge2_w "Sollwert Nockewellenverstellung nach ƒnderungsbegrenzung Einlassnockenwelle 2" SWORD kw_sw_q0p0078 1 100 -256 255.992 FORMAT "%8.4" ECU_ADDRESS 0x80155A /end MEASUREMENT
/begin MEASUREMENT wnwsbge_w "Sollwert Nockewellenverstellung nach ƒnderungsbegrenzung Einlassnockenwelle" SWORD kw_sw_q0p0078 1 100 -256 255.992 FORMAT "%8.4" ECU_ADDRESS 0x80155C /end MEASUREMENT
/begin MEASUREMENT wnwse2_w "Sollwinkel Nockenwelle Einlass 2 ˆffnet" SWORD kw_sw_q0p0078 1 100 -256 255.992 FORMAT "%8.4" ECU_ADDRESS 0x80155E /end MEASUREMENT
/begin MEASUREMENT wnwse_w "Sollwinkel Nockenwelle Einlass ˆffnet" SWORD kw_sw_q0p0078 1 100 -256 255.992 FORMAT "%8.4" ECU_ADDRESS 0x801560 /end MEASUREMENT
/begin MEASUREMENT wnwskwe_w "Sollwinkel Nockenwelle Einlaﬂ aus Kalt oder Warmkennfeld" SWORD kw_sw_q0p0078 1 100 -256 255.992 FORMAT "%8.4" ECU_ADDRESS 0x800616 /end MEASUREMENT
/begin MEASUREMENT wnwskwke_w "Sollwinkel Nockenwelle Einlaﬂ aus Kalt oder Warmkennfeld mit Klopfeingriff" SWORD kw_sw_q0p0078 1 100 -256 255.992 FORMAT "%8.4" ECU_ADDRESS 0x800618 /end MEASUREMENT
/begin MEASUREMENT wnwskwle_w "Sollwinkel Nockenwelle Einlaﬂ aus Kalt oder Warmkennfeld bei B_ll" SWORD kw_sw_q0p0078 1 100 -256 255.992 FORMAT "%8.4" ECU_ADDRESS 0x80061A /end MEASUREMENT
/begin MEASUREMENT wnwsmne_w "minimaler Sollwinkel Nockenwelle Einlaﬂ ˆffnet" SWORD kw_sw_q0p0078 1 100 -256 255.992 FORMAT "%8.4" ECU_ADDRESS 0x80061C /end MEASUREMENT
/begin MEASUREMENT wnwsmxe_w "maximaler Sollwinkel Nockenwelle Einlaﬂ ˆffnet" SWORD kw_sw_q0p0078 1 100 -256 255.992 FORMAT "%8.4" ECU_ADDRESS 0x80061E /end MEASUREMENT
/begin MEASUREMENT wnwsswe2_w "gespeicherter Nockenwellensollwinkel Einlaﬂ 2" SWORD kw_sw_q0p0078 1 100 -256 255.992 FORMAT "%8.4" ECU_ADDRESS 0x801562 /end MEASUREMENT
/begin MEASUREMENT wnwsswe_w "gespeicherter Nockenwellensollwinkel Einlaﬂ" SWORD kw_sw_q0p0078 1 100 -256 255.992 FORMAT "%8.4" ECU_ADDRESS 0x801564 /end MEASUREMENT
/begin MEASUREMENT wnwue "Winkel Nockenwellenueberschneidung" UBYTE kw_q0p5 1 100 0 127.5 FORMAT "%5.1" ECU_ADDRESS 0x80110B /end MEASUREMENT
/begin MEASUREMENT wnwue_w "Winkel Nockenwellenueberschneidung" UWORD kw_q0p0019 1 100 0 127.998 FORMAT "%8.4" ECU_ADDRESS 0x80156C /end MEASUREMENT
/begin MEASUREMENT wnwug_w "Grund¸berschneidungswinkel  Ein- und Auslass Nockenwelle" SWORD kw_q0p0078 1 100 -256 255.992 FORMAT "%8.4" ECU_ADDRESS 0x80156E /end MEASUREMENT
/begin MEASUREMENT wnwu_w "Gesamt¸berschneidungswinkel  Ein- und Auslass Nockenw. incl. Grund¸berschneidung" SWORD kw_q0p0078 1 100 -256 255.992 FORMAT "%8.4" ECU_ADDRESS 0x801570 /end MEASUREMENT
/begin MEASUREMENT wnwva_w "Verstellwinkel  Auslass Nockenwelle" SWORD kw_q0p0078 1 100 -256 255.992 FORMAT "%8.4" ECU_ADDRESS 0x801572 /end MEASUREMENT
/begin MEASUREMENT wnwve_w "Verstellwinkel  Einlass Nockenwelle" SWORD kw_q0p0078 1 100 -256 255.992 FORMAT "%8.4" ECU_ADDRESS 0x801574 /end MEASUREMENT
/begin MEASUREMENT wnwvg_w "Gesamtverstellwinkel der Nockenwelle" UWORD kw_q0p0019 1 100 0 127.998 FORMAT "%8.4" ECU_ADDRESS 0x801576 /end MEASUREMENT
/begin MEASUREMENT wnwvumxa_w "Max. mˆglicher ‹berschneidungswinkel durch Verstellung der Auslass-Nockenwelle" UWORD kw_q0p0078 1 100 0 511.992 FORMAT "%8.4" ECU_ADDRESS 0x801578 /end MEASUREMENT
/begin MEASUREMENT wnwvumxe_w "Max. mˆglicher ‹berschneidungswinkel durch Verstellung der Einlass-Nockenwelle" UWORD kw_q0p0078 1 100 0 511.992 FORMAT "%8.4" ECU_ADDRESS 0x80157A /end MEASUREMENT
/begin MEASUREMENT wnwvumx_w "Max. mˆglicher ‹berschneidungswinkel durch Verstellung der Nockenwelle(n)" UWORD kw_q0p0078 1 100 0 511.992 FORMAT "%8.4" ECU_ADDRESS 0x80157C /end MEASUREMENT
/begin MEASUREMENT wnwvu_w "‹berschneidungswinkel  Ein- und Auslass Nockenw.  nur durch Verstellung" UWORD kw_q0p0078 1 100 0 511.992 FORMAT "%8.4" ECU_ADDRESS 0x80157E /end MEASUREMENT
/begin MEASUREMENT zanzusta "Anzahl Motorumdrehungen f¸r Startautomatik" UBYTE dez 1 100 0 255 FORMAT "%5.1" ECU_ADDRESS 0x80121F /end MEASUREMENT
/begin MEASUREMENT zburn "Anzahl erkannter Verbrennungen" UBYTE dez 1 100 0 255 FORMAT "%5.1" ECU_ADDRESS 0x8011B1 /end MEASUREMENT
/begin MEASUREMENT zburnsu "Summe aller erkannten Verbrennungen w‰hrend ZSYNABR" UBYTE dez 1 100 0 255 FORMAT "%5.1" ECU_ADDRESS 0x8011B2 /end MEASUREMENT
/begin MEASUREMENT zsynchro "Anzahl Z¸ndungen bis Auswertung der Verbrennungen" UBYTE dez 1 100 0 255 FORMAT "%5.1" ECU_ADDRESS 0x8011B3 /end MEASUREMENT
/begin MEASUREMENT zsyndelc "Z‰hler Verzˆgerung Verbrennungserkennung" UBYTE dez 1 100 0 255 FORMAT "%5.1" ECU_ADDRESS 0x8011B4 /end MEASUREMENT
/begin MEASUREMENT zsynsu "Z¸ndungsz‰hler f¸r Begrenzung Startmengenadaption" UBYTE dez 1 100 0 255 FORMAT "%5.1" ECU_ADDRESS 0x8011B5 /end MEASUREMENT
/begin MEASUREMENT zubkst "Z‰hler: UBatt < UBKST" UBYTE dez 1 100 0 255 FORMAT "%5.1" ECU_ADDRESS 0x8011B6 /end MEASUREMENT
/begin MEASUREMENT zzbank "Zylinderzuordnung zu Einspritzb‰nken" UBYTE dez 1 100 0 255 FORMAT "%5.1" ECU_ADDRESS 0x800CD0 /end MEASUREMENT
/begin FUNCTION NWSOLLE "Sollwertvorgabe NWS (Einlaﬂseitig)"
 /begin DEF_CHARACTERISTIC CWNWEHOE DWNWABGE DWNWAMXE FNWSKRE KFNWKHE KFNWKHLLE KFNWKRE KFNWLLE KFNWSE KFNWTME KFNWWLE KFNWWLLE KFWNWSAPE KLDWNWSUE KLTVNW KTNWSABGKE KTNWSNABGE KTNWSPABGE NMKFNWLLE NNWGLEHE TMNWLLKHE TNWWSPE WNWDSHKE WNWREO WNWSAPFE WNWSAPSE WNWSEAPP WNWSGLEHE WNWSMNE WNWSMXE WNWSTE WNWSWOFE /end DEF_CHARACTERISTIC
 /begin REF_CHARACTERISTIC SNM05NEUW SNM05NWUB SNM05NWUW SNM16NEUW SRL05NEUW SRL08NEUW STM05NWUB /end REF_CHARACTERISTIC
 /begin IN_MEASUREMENT B_dnwse B_dnwse2 B_enwsve B_enwsve2 B_fanwsea B_fanwstae B_fnwstve B_fnwstve2 B_ll B_nwrpose B_nws B_nwsapkfe B_nwsappe B_nwseve B_nwseve2 B_nwskflle B_nwssprge B_nwsst B_stpsyne B_su B_wnwsmxfe esst_snm05neuw esst_snm05nwub esst_snm05nwuw esst_snm16neuw esst_srl05neuw esst_srl08neuw esst_stm05nwub fho_w fnwkhe nmot nmot_w rk_w rlnw_w tmot tmst tumg tvsuae wkrma wnwadmne_w wnwe2_w wnwe_w wnwseve2_w wnwseve_w wnwsfae_w /end IN_MEASUREMENT
 /begin OUT_MEASUREMENT B_sunw B_wnws02e B_wnws0e B_wnws0e2 NWSOLLEausbits_10ms NWSOLLEausbits_koop wnwehom_w wnweos wnweos2 wnwsae_w wnwse2_w wnwse_w wnwsmne_w wnwsmxe_w /end OUT_MEASUREMENT
 /begin LOC_MEASUREMENT B_nwglehe B_nwglehe2 B_nwsapspe dwnwabge_w dwnwamxe_w dwnwsue_w fnwwarme NWSOLLElokbits_koop tnwsbge tnwsbge2 tvnwe wdnwse2_w wdnwse_w wnwdshke_w wnwkhe_w wnwkhlle_w wnwsape_w wnwsbge2_w wnwsbge_w wnwskwe_w wnwskwke_w wnwskwle_w wnwsswe2_w wnwsswe_w /end LOC_MEASUREMENT
 /begin SUB_FUNCTION /end SUB_FUNCTION
/end FUNCTION
/begin FUNCTION NWWUE "Berechnung der Nockenwellen¸berschneidung" /begin DEF_CHARACTERISTIC /end DEF_CHARACTERISTIC /begin REF_CHARACTERISTIC WNWRAS WNWREO /end REF_CHARACTERISTIC
 /begin IN_MEASUREMENT B_dnwsa B_dnwsa2 B_dnwse B_dnwse2 B_enwsva B_enwsva2 B_enwsve B_enwsve2 wnwahom_w wnwa_w wnwehom_w wnwe_w wnwsmna_w wnwsmne_w wnwsmxa_w wnwsmxe_w /end IN_MEASUREMENT
 /begin OUT_MEASUREMENT B_nwswg fnwua fnwue fnwu_w wnvuhoms_w wnwgv_w wnwue wnwue_w wnwva_w wnwve_w wnwvg_w wnwvumxa_w wnwvumxe_w wnwvumx_w wnwvu_w /end OUT_MEASUREMENT
 /begin LOC_MEASUREMENT wnwug_w wnwu_w /end LOC_MEASUREMENT
 /begin SUB_FUNCTION /end SUB_FUNCTION
/end FUNCTION
/begin FUNCTION OBDSV "OBD-Statusverwaltung" /begin DEF_CHARACTERISTIC /end DEF_CHARACTERISTIC /begin REF_CHARACTERISTIC /end REF_CHARACTERISTIC /begin IN_MEASUREMENT bbdcy bbwuc B_egscok B_pwf ffzdfp obdstegs /end IN_MEASUREMENT /begin OUT_MEASUREMENT B_blkfb B_milfb B_xff obdsteuer /end OUT_MEASUREMENT /begin LOC_MEASUREMENT /end LOC_MEASUREMENT /begin SUB_FUNCTION /end SUB_FUNCTION /end FUNCTION
/begin FUNCTION PART "20.11     Plausibilisiert von %CAN ART-Signalen" /begin DEF_CHARACTERISTIC FW_PART_CN FW_PART_RD FW_PART_RI FW_PART_TO FW_PART_TR /end DEF_CHARACTERISTIC /begin REF_CHARACTERISTIC FW_PXXX_MO /end REF_CHARACTERISTIC
 /begin IN_MEASUREMENT AdapCrsCtrl_Dyn0_Mode_Req AdapCrsCtrl_Parity AdapCrsCtrl_Tgl AdapCrsCtrl_TrqMax_Mode_Req AdapCrsCtrl_TrqMin_Mode_Req AdapCrsCtrl_Trq_Req dr_partmma dr_partpar dr_parttgl dr_pespesp ESP_208h_MsgLost_Cntr ESP_300h_MsgLost_Cntr ESP_InfoBit0 ESP_InfoBit1 LH_Mode TrqCoor_AdapCrsCtrl_Mode TrqReqLoutAdapCrsCtrl_Mode vk_bpb vk_mot2 /end IN_MEASUREMENT
 /begin OUT_MEASUREMENT AdapCrsCtrl_Dyn0Plaus_Mode_Req AdapCrsCtrl_Enabl AdapCrsCtrl_IrvrsLout_Mode AdapCrsCtrl_PlausDsabl_Mode AdapCrsCtrl_PlausRslt AdapCrsCtrl_TglMem AdapCrsCtrl_TglPlaus_Cntr AdapCrsCtrl_TrqMaxMem_Mode_Req AdapCrsCtrl_TrqMaxPls_Mode_Req AdapCrsCtrl_TrqMem_Req AdapCrsCtrl_TrqMinMem_Mode_Req AdapCrsCtrl_TrqMinPls_Mode_Req AdapCrsCtrl_TrqPlaus_Req /end OUT_MEASUREMENT
 /begin LOC_MEASUREMENT /end LOC_MEASUREMENT
 /begin SUB_FUNCTION /end SUB_FUNCTION
/end FUNCTION
/begin FUNCTION PBLS "20.11     Plausibilierung Bremssignal" /begin DEF_CHARACTERISTIC FWPBLSTO /end DEF_CHARACTERISTIC /begin REF_CHARACTERISTIC /end REF_CHARACTERISTIC
 /begin IN_MEASUREMENT AGKInit_Mode BrkBit0 BrkBit1 BrkLight0_Mode BrkLight1_Mode BrkLight_MsgCntr BrkLight_Parity BrkParity_Mode drpblserr drpblspar drpblstog ESP_200h_MsgLost_Cntr ESP_200h_MsgLost_DeBnc_Mode /end IN_MEASUREMENT
 /begin OUT_MEASUREMENT BrkLightDrv_Mode BrkLightParityErr BrkLightSigErr BrkLightTglErr BrkLight_FuncCntr BrkLight_IrvrsLout_Mode BrkLight_Mode BrkLight_PlausCheck_Mode BrkLight_TglTmr /end OUT_MEASUREMENT
 /begin LOC_MEASUREMENT /end LOC_MEASUREMENT
 /begin SUB_FUNCTION /end SUB_FUNCTION
/end FUNCTION
/begin FUNCTION PEGS "20.11     Plausibilisiert von %CAN EGS-Signalen" /begin DEF_CHARACTERISTIC FW_PEGS_CN FW_PEGS_RD FW_PEGS_RI FW_PEGS_TO FW_PEGS_TR /end DEF_CHARACTERISTIC /begin REF_CHARACTERISTIC FW_PXXX_MO /end REF_CHARACTERISTIC
 /begin IN_MEASUREMENT AMT_Mode dr_pegsmma dr_pegspar dr_pegstgl LH_Mode MTX_CAN_Mode MTX_Mode TCM_218h_MsgLost_Cntr TCM_Dyn0_Mode TCM_Dyn1_Mode_Req TCM_Parity TCM_Tgl TCM_TrqMax_Mode_Req TCM_TrqMin_Mode_Req TCM_Trq_Req Trans_Man_Cnfg TrqCoor_TCM_Mode TrqCoor_TCM_Type TrqReqLoutTCM_Mode /end IN_MEASUREMENT
 /begin OUT_MEASUREMENT ECU_TCMPlausErr TCM_Dyn0Plaus_Mode_Req TCM_Dyn1Plaus_Mode_Req TCM_EmergSo_Dsabl TCM_Enabl TCM_IrvrsLout_Mode TCM_PlausDsabl_Mode TCM_PlausRslt TCM_TglMem TCM_TglPlaus_Cntr TCM_TrqMaxMem_Mode_Req TCM_TrqMaxPlaus_Mode_Req TCM_TrqMem_Req TCM_TrqMinMem_Mode_Req TCM_TrqMinPlaus_Mode_Req TCM_TrqPlaus_Req /end OUT_MEASUREMENT
 /begin LOC_MEASUREMENT /end LOC_MEASUREMENT
 /begin SUB_FUNCTION /end SUB_FUNCTION
/end FUNCTION
/begin FUNCTION PEHB "20.11     Plausibilisierung EHB-Anforderung Leerlaufdrehzahlanhebung"
 /begin DEF_CHARACTERISTIC FW_EHB_CN FW_EHB_DN FW_EHB_EZ FW_EHB_N FW_EHB_NS FW_EHB_TO FW_EHB_VS FW_EHB_WS /end DEF_CHARACTERISTIC
 /begin REF_CHARACTERISTIC /end REF_CHARACTERISTIC
 /begin IN_MEASUREMENT BrkLight_Mode BrkLight_PlausCheck_Mode Cod_CANMembr_SBC dr_ehbpar dr_ehbtgl dr_ehbumg ECU_TCMPlausErr Eng_Spd ESP_328h_MsgLost_Cntr Gear_State IdleSpd_Req MTX_Mode SBC_ISRD_Actvt SBC_ISRD_Parity SBC_ISRD_Tgl Strt_Mode TgtGear_State Veh_Spd VES_InfoBit0 VES_InfoBit1 /end IN_MEASUREMENT
 /begin OUT_MEASUREMENT SBC_FuncDsabllrr SBC_ISRDActv_Mem SBC_ISRDReq_Mem SBC_ISRD_Req SBC_ISRD_State SBC_RepDsabl_Tmr SBC_SigDbnc_Tmr SBC_SS SBC_Tgl_Mem SBC_Tgl_Tmr /end OUT_MEASUREMENT
 /begin LOC_MEASUREMENT /end LOC_MEASUREMENT
 /begin SUB_FUNCTION /end SUB_FUNCTION
/end FUNCTION
/begin FUNCTION PESP "20.11     Plausibilisiert von %CAN ESP-Signalen"
 /begin DEF_CHARACTERISTIC FW_PESP_CN FW_PESP_RD FW_PESP_RI FW_PESP_TO FW_PESP_TR FW_PXXX_MO /end DEF_CHARACTERISTIC
 /begin REF_CHARACTERISTIC /end REF_CHARACTERISTIC
 /begin IN_MEASUREMENT dr_pespesp dr_pespmma dr_pesppar dr_pesptgl ESP_208h_MsgLost_Cntr ESP_300h_MsgLost_Cntr ESP_Dyn0_Mode ESP_Dyn_Mode_Req ESP_InfoBit0 ESP_InfoBit1 ESP_Parity_Mode ESP_Tgl ESP_TrqMax_Mode_Req ESP_TrqMin_Mode_Req ESP_Trq_Req LH_Mode TrqCoor_ESP_Mode TrqReqLoutESP_Mode /end IN_MEASUREMENT
 /begin OUT_MEASUREMENT ESP_Dyn0Plaus_Mode_Req ESP_Dyn1Plaus_Mode_Req ESP_Enabl ESP_IrvrsLout_Mode ESP_PlausDsabl_Mode ESP_PlausRslt ESP_TglMem ESP_TglPlaus_Cntr ESP_TrqMaxMem_Mode_Req ESP_TrqMaxPlaus_Mode_Req ESP_TrqMem_Req ESP_TrqMinMem_Mode_Req ESP_TrqMinPlaus_Mode_Req ESP_TrqPlaus_Req /end OUT_MEASUREMENT
 /begin LOC_MEASUREMENT /end LOC_MEASUREMENT
 /begin SUB_FUNCTION /end SUB_FUNCTION
/end FUNCTION
/begin FUNCTION PLW "20.11     Plausibilisierung des aktuellen Lenkwinkels"
 /begin DEF_CHARACTERISTIC FWPLWCN FWPLWHO FWPLWHU FWPLWN FWPLWSC FWPLWTO FWPLWURI FWPLWWD /end DEF_CHARACTERISTIC
 /begin REF_CHARACTERISTIC /end REF_CHARACTERISTIC
 /begin IN_MEASUREMENT Cod_CANMembr_CTM EIL_State3 Eng_Run_Mode Eng_Spd FirstStrt_Mode SCT_238h_MsgLost_Cntr SteeringAngle SteeringAngleDir SteeringAngle_CodErr SteeringAngle_NotInit SteeringAngle_Overflow SteeringAngle_Parity /end IN_MEASUREMENT
 /begin OUT_MEASUREMENT SteeringAngleOverLim SteeringAngle_AdapValLeft SteeringAngle_AdapValRight SteeringAngle_EngRun_Cntr SteeringAngle_FuncCntr SteeringAngle_IrvrsLout_Mode SteeringAngle_PlausCheck_Mode SteeringAngle_TglTmr /end OUT_MEASUREMENT
 /begin LOC_MEASUREMENT /end LOC_MEASUREMENT
 /begin SUB_FUNCTION /end SUB_FUNCTION
/end FUNCTION
/begin FUNCTION PMNA "20.11     Plausibilisierung der KSG-Anforderung ""Motor-Not-Aus""" /begin DEF_CHARACTERISTIC FWPMNAN FWPMNAPW FWPMNAV /end DEF_CHARACTERISTIC /begin REF_CHARACTERISTIC /end REF_CHARACTERISTIC
 /begin IN_MEASUREMENT AMT_EmergShutOff AMT_EmergShutOff_Cnf AMT_Mode APP_ADD Eng_Spd ErrErs_Mode MTX_CAN_Mode TCM_EmergSo_Dsabl Veh_Spd /end IN_MEASUREMENT
 /begin OUT_MEASUREMENT AMT_EngEmergStop_Req AMT_EngEmergStop_State AMT_FuncCntr ErrEntry_AMT_EngEmOffEnabl ErrEntry_AMT_EngEmOffFlt /end OUT_MEASUREMENT
 /begin LOC_MEASUREMENT /end LOC_MEASUREMENT
 /begin SUB_FUNCTION /end SUB_FUNCTION
/end FUNCTION
/begin FUNCTION PROCESS "" /begin DEF_CHARACTERISTIC /end DEF_CHARACTERISTIC /begin REF_CHARACTERISTIC /end REF_CHARACTERISTIC /begin IN_MEASUREMENT B_nachlauf nmot /end IN_MEASUREMENT
 /begin OUT_MEASUREMENT bgCtr bg_swoff_Ctr fcmclrCtr firstsynchroCtr hw1Ctr hw2Ctr hw3Ctr hw4Ctr inisynchroCtr inisynct_w r1000msCtr r1000ms_swoff_Ctr r100msCtr r100ms_swoff_Ctr r10msCtr r10ms_swoff_Ctr r1msCtr r1ms_swoff_Ctr r200msCtr r200ms_swoff_Ctr r20msCtr r20ms_swoff_Ctr r2msCtr r2ms_swoff_Ctr r50msCtr r50ms_swoff_Ctr r5msCtr r5ms_swoff_Ctr rasfak synchroCtr synchroSwoffCtr /end OUT_MEASUREMENT
 /begin LOC_MEASUREMENT /end LOC_MEASUREMENT
 /begin SUB_FUNCTION /end SUB_FUNCTION
/end FUNCTION
/begin FUNCTION PROKON "Projektkonfiguration"
 /begin DEF_CHARACTERISTIC CDAGR CDDMTL CDEDSS CDEFST CDEHFM CDHRLSU CDHRLSUE CDHSH CDHSV CDHSVSA CDKAT CDKATSP CDKATSPF CDKVS CDLASH CDLATP CDLATV CDLDP CDLLR CDLSH CDLSV CDLSVV CDMD CDNWS CDSLS CDSWE CDTANKL CDTES CDWVERAD CWADRES CWALE CWDLSU CWGEN1 CWGEN2 CWHRLSU CWKMMILSCT CWKONABG CWKONFLS CWKONLS CWLSHA CWMDAPP CWNSABG CWOBD CWPSGER CWPWF CWSLS CWTF CWUHR CWVL FZG_ON NSWO NSWO1 WESBM /end DEF_CHARACTERISTIC
 /begin REF_CHARACTERISTIC /end REF_CHARACTERISTIC
 /begin IN_MEASUREMENT nmot /end IN_MEASUREMENT
 /begin OUT_MEASUREMENT B_abstnl B_adrsta B_auakt B_cdagr B_cdanws B_cddmtl B_cdedss B_cdehfm B_cdenws B_cdfst B_cdhrlsu B_cdhrlsue B_cdhsh B_cdhsv B_cdhsvsa B_cdkat B_cdkatsp B_cdkatspf B_cdkatspt B_cdkvs B_cdlash B_cdlatp B_cdlatv B_cdldp B_cdllr B_cdlsh B_cdlsv B_cdlsvv B_cdmd B_cdsls B_cdswe B_cdtankl B_cdtes B_cwlshdyn B_cwlshsch B_cwlshvl B_etol B_fphubap B_fpwdkap B_fzg_on B_gen1 B_gen2 B_hubap B_katfz B_kmmilsct B_lsh B_lsh2 B_lsv B_lsv2 B_mrfavl B_ndsav B_nswo1 B_nswo2 B_psapp B_psger B_tfu B_uhrrmin B_uhrrsec B_wdksap B_zwappl cd_bits1_w cd_bits2_w grundwert wessbm zzbank /end OUT_MEASUREMENT
 /begin LOC_MEASUREMENT /end LOC_MEASUREMENT
 /begin SUB_FUNCTION /end SUB_FUNCTION
/end FUNCTION
/begin FUNCTION PWR "20.11     Pedalwertr¸ckrechnung" /begin DEF_CHARACTERISTIC FSWPW KLAADO2_R KLAADO3_R KLAADO4_R KLAADPSO_R /end DEF_CHARACTERISTIC
 /begin REF_CHARACTERISTIC KFFVMN KLD1 KLD2 KLD3 KLD4 KLR NISTV17 PWV SST_PWR_VG16 SWPEDV16 /end REF_CHARACTERISTIC
 /begin IN_MEASUREMENT APP APP_ADD CrsCtrl_Coor_Trq DrvrInput_IndDiffTrq EMSL_Mode Eng_MinTrqCmb_Req Eng_Spd ETCLine_Slct ETC_VariRate MSL_Trq_Req nist_1uf_r pw12r_r sst_pwr_vg16_r sw_ped_r TrqCoor_AdapCrsCtrl_Mode TrqCoor_CrsCtrl_Mode TrqCoor_ESP_Mode TrqCoor_MSL_Mode TrqCoor_TCM_Mode /end IN_MEASUREMENT
 /begin OUT_MEASUREMENT APPRecalcSpdLim_Mode APPRecalc_Mode APP_ADD_Out APP_ADD_Out_ub APP_DrvrRepl APP_Out_ub APP_Recalc Eng_TrqIndDrvrRepl Eng_TrqIndDrvrRepl_Stnd sst_dyn_app_add_dyn_r /end OUT_MEASUREMENT
 /begin LOC_MEASUREMENT /end LOC_MEASUREMENT
 /begin SUB_FUNCTION /end SUB_FUNCTION
/end FUNCTION
/begin FUNCTION RESET_MON "" /begin DEF_CHARACTERISTIC /end DEF_CHARACTERISTIC /begin REF_CHARACTERISTIC /end REF_CHARACTERISTIC /begin IN_MEASUREMENT /end IN_MEASUREMENT
 /begin OUT_MEASUREMENT dr_reg_resetBuffer dr_reg_resetBuffer_cnt dr_reg_resetBuffer_idx dr_reg_resetTimestampBuffer dr_reg_resetTimestampBuffer_idx /end OUT_MEASUREMENT
 /begin LOC_MEASUREMENT /end LOC_MEASUREMENT
 /begin SUB_FUNCTION /end SUB_FUNCTION
/end FUNCTION
/begin FUNCTION RKTE "Berechnung effektive Einspritzdauer aus relativer Kraftstoffmasse rk"
 /begin DEF_CHARACTERISTIC CWGANG CWPKAPP CWREGDS FAKEZ FKKVS FRLFSDP KIREGDS KPREGDS KRKATE PSAPES TEMN TEMNVA TVKTSPEV TVUBAT ZTSPEV /end DEF_CHARACTERISTIC
 /begin REF_CHARACTERISTIC /end REF_CHARACTERISTIC
 /begin IN_MEASUREMENT B_ba B_bag B_eswez B_stend B_va evtmod evz_austot gangi mifafu_w milsol_w nmot nmot_w ps_w pu_w rk2_w rkweza_w rk_w ub vsfpses zzbank /end IN_MEASUREMENT
 /begin OUT_MEASUREMENT B_temin B_temin2 dpus_w mitibgr_w qtitimnh te2_l tef2_w tef_w tez_l te_l timxth_l timx_l tvub_w /end OUT_MEASUREMENT
 /begin LOC_MEASUREMENT B_enimiti dppk_w dtimx_l evtmodev fakezmn_w frkate_w ftek2_w ftek_w mitibgri_w mitibgrp_w rkteLocBitsCoop tevfa2_l tevfak_w tevfawe_l tevfa_l tezwe_l tvktsp_w /end LOC_MEASUREMENT
 /begin SUB_FUNCTION /end SUB_FUNCTION
/end FUNCTION
/begin FUNCTION RPSLSU "2.10      Referenzpumpstromsteuerung f¸r die LSU mit gepumpter Referenz" /begin DEF_CHARACTERISTIC CWRPSLSU IPREFLSUB IPREFLSUE RIRPSONS TVRPSONMX /end DEF_CHARACTERISTIC /begin REF_CHARACTERISTIC /end REF_CHARACTERISTIC /begin IN_MEASUREMENT B_hsv B_hsv2 B_nmot rinlsu2_w rinlsu_w /end IN_MEASUREMENT /begin OUT_MEASUREMENT iprefanf iprefanf2 /end OUT_MEASUREMENT /begin LOC_MEASUREMENT /end LOC_MEASUREMENT /begin SUB_FUNCTION /end SUB_FUNCTION /end FUNCTION
/begin FUNCTION RUNTIME "" /begin DEF_CHARACTERISTIC CWRTFSGID CWRTFSGMEM CWRTFSGMOD CW_RUNTIME /end DEF_CHARACTERISTIC /begin REF_CHARACTERISTIC /end REF_CHARACTERISTIC /begin IN_MEASUREMENT /end IN_MEASUREMENT
 /begin OUT_MEASUREMENT common_rt FsgIdCounter FsgIdMemCounter FsgMemCounter performance rt_1000ms rt_100ms rt_100msModAkt rt_10ms rt_10msModAkt rt_10mss rt_1ms rt_1msModAkt rt_1mss rt_200ms rt_20ms rt_20msModAkt rt_20mss rt_2ms rt_2msModAkt rt_2mss rt_50ms rt_50msModAkt rt_50mss rt_5ms rt_5msModAkt rt_5mss rt_bg rt_bg_brutto rt_bg_brutto_max rt_bit_time rt_hw1 rt_hw1s rt_hw2 rt_hw2s rt_hw3 rt_hw3s rt_hw4 rt_hw4s rt_ModAkt rt_res5v rt_syn rt_synModAkt rt_syns rt_taskCamshaft1 rt_taskCamshaft2 rt_taskCamshaft3 rt_taskCamshaft4 rt_taskEveryToothIntISR rt_umtask /end OUT_MEASUREMENT
 /begin LOC_MEASUREMENT /end LOC_MEASUREMENT
 /begin SUB_FUNCTION /end SUB_FUNCTION
/end FUNCTION
/begin FUNCTION SALSU "Schubabgleich LSU"
 /begin DEF_CHARACTERISTIC EBENSALSU EBOYKO2VK EBOYKO2VK2 EBOYO2AD EBOYO2AD2 KO2INI KO2MN KO2MX O2DELTAMN O2DELTAMX O2REF O2SAMN O2SAMX SADYNMX SANMOT SATMOT SATUMG TESAMN TESAMX TVSATMOT ZFSADYN ZSAINT /end DEF_CHARACTERISTIC
 /begin REF_CHARACTERISTIC /end REF_CHARACTERISTIC
 /begin IN_MEASUREMENT B_ebDavY B_hstlsub B_hstlsub2 B_pwf B_sa B_sbblsu B_sbblsu2 nmot o2vk2_w o2vk_w tmot tumg /end IN_MEASUREMENT
 /begin OUT_MEASUREMENT B_salsu B_salsu2 ko2vk2_w ko2vkin2_w ko2vkin_w ko2vk_w o2adap2_w o2adapi2_w o2adapi_w o2adap_w /end OUT_MEASUREMENT
 /begin LOC_MEASUREMENT B_sadyn B_sadyn2 B_sag B_sag2 B_sape B_saumg B_sav ko2vki2_w ko2vki_w o2delta2_w o2delta_w o2korr2_w o2korr_w sadyn2_w sadyn_w /end LOC_MEASUREMENT
 /begin SUB_FUNCTION /end SUB_FUNCTION
/end FUNCTION
/begin FUNCTION SG_IDENT "" /begin DEF_CHARACTERISTIC INFO1 /end DEF_CHARACTERISTIC /begin REF_CHARACTERISTIC /end REF_CHARACTERISTIC /begin IN_MEASUREMENT /end IN_MEASUREMENT /begin OUT_MEASUREMENT /end OUT_MEASUREMENT /begin LOC_MEASUREMENT /end LOC_MEASUREMENT /begin SUB_FUNCTION /end SUB_FUNCTION /end FUNCTION
/begin FUNCTION SME "20.11     Schnelle Momenteneinstellung"
 /begin DEF_CHARACTERISTIC FWSMEBR FWSMEBR2 FWSMEHM FWSMEHN FWSMEHV FWSMEN FWSMETTLB FWSMEV KLSMEFKT1 KLSMEFKT2 /end DEF_CHARACTERISTIC
 /begin REF_CHARACTERISTIC VCANV05 /end REF_CHARACTERISTIC
 /begin IN_MEASUREMENT Cod_Model DrvrInput_TrqLim_Req Eng_Spd Eng_Trq Eng_TrqMax ESP_TrqMaxPlaus_Mode_Req ESP_TrqMinPlaus_Mode_Req Idle_Mode_Req MTX_Mode vcanv05_r Veh_Spd /end IN_MEASUREMENT
 /begin OUT_MEASUREMENT FTBU_Cond1_Mode FTBU_Cond2_Mode FTBU_Cond3_Mode FTBU_Cond4_Mode FTBU_Cond_Mode FTBU_DelTrq_Fctr FTBU_FuncCntr FTBU_RelLoadLimSprd_Mode FTBU_Trq_Req /end OUT_MEASUREMENT
 /begin LOC_MEASUREMENT /end LOC_MEASUREMENT
 /begin SUB_FUNCTION /end SUB_FUNCTION
/end FUNCTION
/begin FUNCTION SREAKT "EGAS: Sicherheitskonzept, Fehlerreaktionen" /begin DEF_CHARACTERISTIC /end DEF_CHARACTERISTIC /begin REF_CHARACTERISTIC /end REF_CHARACTERISTIC
 /begin IN_MEASUREMENT B_appnolu B_dkp1e B_dkp2e B_dkpaw B_dlrbe B_dlrpide B_fproab B_fprzab B_i_ska_um B_nlpne B_ubdve B_ub_ok B_umauab B_wdksive /end IN_MEASUREMENT
 /begin OUT_MEASUREMENT B_dknolu B_dknot B_dkpiu B_dkpru B_dkpu B_i_ska_fr B_notlu_fr /end OUT_MEASUREMENT
 /begin LOC_MEASUREMENT B_dkunb /end LOC_MEASUREMENT
 /begin SUB_FUNCTION /end SUB_FUNCTION
/end FUNCTION
/begin FUNCTION SRMDSS "Saugrohrmodell DSS" /begin DEF_CHARACTERISTIC /end DEF_CHARACTERISTIC /begin REF_CHARACTERISTIC /end REF_CHARACTERISTIC /begin IN_MEASUREMENT fupsrl_w pbrint_w psdss_w pu_w /end IN_MEASUREMENT /begin OUT_MEASUREMENT dpsfgds_w pbrdss_w psfgds_w rlfgds_w /end OUT_MEASUREMENT /begin LOC_MEASUREMENT rfdsorgi_w /end LOC_MEASUREMENT /begin SUB_FUNCTION /end SUB_FUNCTION /end FUNCTION
/begin FUNCTION SRMHFM "Saugrohrmodell HFM" /begin DEF_CHARACTERISTIC /end DEF_CHARACTERISTIC /begin REF_CHARACTERISTIC /end REF_CHARACTERISTIC /begin IN_MEASUREMENT fupsrl_w pbrint_w psmx_w pu_w rlfgroh_w xfvisrm_w /end IN_MEASUREMENT /begin OUT_MEASUREMENT dpsfglm_w psfglm_w pslmsm_w pslm_w rflmorgi_w rlfglm_w /end OUT_MEASUREMENT /begin LOC_MEASUREMENT dpslm_w rflmoism_w rlfglmsm_w /end LOC_MEASUREMENT /begin SUB_FUNCTION /end SUB_FUNCTION /end FUNCTION
/begin FUNCTION SRMSEL "Saugrohrmodell Selektion" /begin DEF_CHARACTERISTIC /end DEF_CHARACTERISTIC /begin REF_CHARACTERISTIC /end REF_CHARACTERISTIC
 /begin IN_MEASUREMENT B_edss B_hfm B_nmot dpsfgds_w dpsfglm_w psdss_w psfgds_w psfglm_w pslm_w pu_w rfdsorgi_w rflmorgi_w rir_w rlfgds_w rlfglm_w rlr_w umsrln_w /end IN_MEASUREMENT
 /begin OUT_MEASUREMENT B_dssakt dpsfg_w drl_w ml ml_w msfabr_w msfebr_w ps psfg_w ps_w rfges_w rforgi_w rl rlfg_w rl_w /end OUT_MEASUREMENT
 /begin LOC_MEASUREMENT /end LOC_MEASUREMENT
 /begin SUB_FUNCTION /end SUB_FUNCTION
/end FUNCTION
/begin FUNCTION SSTBER ""
 /begin DEF_CHARACTERISTIC SAN12ESUW SDK10TEUB SDM05TESB SEZ06TMUB SFR04BBUW SFR05TEUB SGA06MDUB SGA07MDUB SGA08MDUB SIM06ESUW SKS06ESUB SLA05ESUB SLX06TMUW SLY06TMUW SMI04LLUB SML06TEUB SML06TMUW SML07TMUW SML08LHUB SN16KR1UB SN16KR2UB SNG06LLSB SNM04DMUW1 SNM04DMUW2 SNM04TEUB SNM06ESUB SNM06LLUB SNM06MDUW SNM07ASUB SNM07ESUB SNM07LSUW SNM08DMUB SNM08DMUW1 SNM08DMUW2 SNM08FEUB SNM08GKUB SNM08KRUW SNM08LHUB SNM08OPUB SNM08__UB SNM10LSUB SNM10TEUB SNM12ESUB SNM12FEUB SNM16KRUB SNM16OPUW SNM16ZUUB SNM16ZUUW SNM24ZUUB SQM05TEUB SRL04KRUB SRL06ESUB SRL06ZUUB SRL08DMUB SRL08LSUW SRL08NXUB SRL10LSUB SRL12ESUB SRL12GKUB SRL12ZUUB SRL12ZUUW SRL16ZUUB SRP06ESUB ST107TMUB ST207TMUB ST307TMUB ST407TMUB STA04LLUB STA04SAUB STA06ESUB STA12WLUB STK04SAUB STK06SAUB STM04SAUB STM05SAUB STM05TMUB STM06LLUB STM06__UB STM08BBUB STM08DMUB STM08MDUB STM09ESUB STM10__UB STM12ESUB STS08COUB STS08ESUB STS12ESUB STW06MDUB SWD06KRSW SWP08OPUB /end DEF_CHARACTERISTIC
 /begin REF_CHARACTERISTIC /end REF_CHARACTERISTIC
 /begin IN_MEASUREMENT anztib_w dmssginr etazwimt frhol_w frmit gangi imlatm_w kstaa ladiff_w lamsbg2_w lamsbg_w mifa_w ml ml_w ngfil nmot nmot_w qmsdyn rl rlp rl_w tabgmst tabgmst2 tans tkatm tkatmst tkatmst2 tmot tmst twan wdkba wdkba_w wped /end IN_MEASUREMENT
 /begin OUT_MEASUREMENT esst_san12esuw esst_sdk10teub esst_sdm05tesb esst_sez06tmub esst_sfr04bbuw esst_sfr05teub esst_sga06mdub esst_sga07mdub esst_sga08mdub esst_sim06esuw esst_sks06esub esst_sla05esub esst_slx06tmuw esst_sly06tmuw esst_smi04llub esst_sml06teub esst_sml06tmuw esst_sml07tmuw esst_sml08lhub esst_sn16kr1ub esst_sn16kr2ub esst_sng06llsb esst_snm04dmuw1 esst_snm04dmuw2 esst_snm04teub esst_snm06esub esst_snm06llub esst_snm06mduw esst_snm07asub esst_snm07esub esst_snm07lsuw esst_snm08dmub esst_snm08dmuw1 esst_snm08dmuw2 esst_snm08feub esst_snm08gkub esst_snm08kruw esst_snm08lhub esst_snm08opub esst_snm08__ub esst_snm10lsub esst_snm10teub esst_snm12esub esst_snm12feub esst_snm16krub esst_snm16opuw esst_snm16zuub esst_snm16zuuw esst_snm24zuub esst_sqm05teub esst_srl04krub esst_srl06esub esst_srl06zuub esst_srl08dmub esst_srl08lsuw esst_srl08nxub esst_srl10lsub esst_srl12esub esst_srl12gkub esst_srl12zuub esst_srl12zuuw esst_srl16zuub esst_srp06esub esst_st107tmub esst_st207tmub esst_st307tmub esst_st407tmub esst_sta04llub esst_sta04saub esst_sta06esub esst_sta12wlub esst_stk04saub esst_stk06saub esst_stm04saub esst_stm05saub esst_stm05tmub esst_stm06llub esst_stm06__ub esst_stm08bbub esst_stm08dmub esst_stm08mdub esst_stm09esub esst_stm10__ub esst_stm12esub esst_sts08coub esst_sts08esub esst_sts12esub esst_stw06mdub esst_swd06krsw esst_swp08opub /end OUT_MEASUREMENT
 /begin LOC_MEASUREMENT /end LOC_MEASUREMENT
 /begin SUB_FUNCTION /end SUB_FUNCTION
/end FUNCTION
/begin FUNCTION SSTNW "St¸tzstellenberechnung f¸r Nockenwellenverstellung"
 /begin DEF_CHARACTERISTIC SNM05NAUW SNM05NEUW SNM05NWUB SNM05NWUW SNM06NWUW SNM16NAUW SNM16NEUW SRL05NAUW SRL05NEUW SRL08NAUW SRL08NEUW STM05NWUB STO06NWUW /end DEF_CHARACTERISTIC
 /begin REF_CHARACTERISTIC /end REF_CHARACTERISTIC
 /begin IN_MEASUREMENT nmot nmot_w rlnw_w tmot toelk_w /end IN_MEASUREMENT
 /begin OUT_MEASUREMENT esst_snm05nauw esst_snm05neuw esst_snm05nwub esst_snm05nwuw esst_snm06nwuw esst_snm16nauw esst_snm16neuw esst_srl05nauw esst_srl05neuw esst_srl08nauw esst_srl08neuw esst_stm05nwub esst_sto06nwuw /end OUT_MEASUREMENT
 /begin LOC_MEASUREMENT /end LOC_MEASUREMENT
 /begin SUB_FUNCTION /end SUB_FUNCTION
/end FUNCTION
/begin FUNCTION STA "Startautomatik"
 /begin DEF_CHARACTERISTIC ANZUSTA CWSTA NSTMXM TANMN TANMXT TANOVMX TPAST TSTA TSTEKPV /end DEF_CHARACTERISTIC
 /begin REF_CHARACTERISTIC /end REF_CHARACTERISTIC
 /begin IN_MEASUREMENT B_autget B_eculock B_estart B_fs B_fsp B_gstcmv B_kl15 B_kuppv B_nmot nmot_w tmot tseg_l /end IN_MEASUREMENT
 /begin OUT_MEASUREMENT B_sta /end OUT_MEASUREMENT
 /begin LOC_MEASUREMENT anzustaf B_kufs B_ressta B_sta1 B_stseit B_tanmn B_tanmx B_tpast B_tsta B_tstekpv B_zanzusta nstmxm tanmnCtr tanmxCtr tanovmxCtr tpastCtr tstaCtr tstekpvCtr zanzusta /end LOC_MEASUREMENT
 /begin SUB_FUNCTION /end SUB_FUNCTION
/end FUNCTION
/begin FUNCTION STADAP "Startmengen-Adaption"
 /begin DEF_CHARACTERISTIC ANRZUEMX CWSTADAP DECKSTAI DNBURN0 DNBURN1 DNBURN2 INCKSTAI KFNSTAMX KLDNFHO KSTA0INI KSTA1INI KSTA2INI KSTAI KSTAMN0 KSTAMN1 KSTAMN2 KSTAMX0 KSTAMX1 KSTAMX2 KSTTOPMN NSTAK TMADB0 TMADB1 TMADB2 TMLIM UBKST UBKSTMX WAD0T1 WAD0T2 WAD1T0 WAD1T2 WAD2T0 WAD2T1 ZBURNABR ZBURNDEC ZBURNSOL ZSYNABR ZSYNAUSW ZSYNDEL /end DEF_CHARACTERISTIC
 /begin REF_CHARACTERISTIC /end REF_CHARACTERISTIC
 /begin IN_MEASUREMENT B_adrsta B_nmin B_pwf B_stend B_umsync B_vbemg B_wks dnmot_w E_ev1 E_ev2 E_ev3 E_ev4 E_ev5 E_ev6 E_ev7 E_ev8 E_frao E_frao2 E_frau E_frau2 E_n E_ph E_rkat E_rkat2 E_tm E_ub fho nmot nmot_w nstat tmot tmst top_w ub vfzg /end IN_MEASUREMENT
 /begin OUT_MEASUREMENT B_staa kstaa /end OUT_MEASUREMENT
 /begin LOC_MEASUREMENT adastep B_ad B_adb0 B_adb1 B_adb2 B_adlck B_ausw B_burn B_decr B_incr B_kstai B_kstaue B_nodec B_noinc B_stdperr B_ubkst dnburns_w ksta0 ksta0w ksta1 ksta1w ksta2 ksta2w stactr STADAPlokBits tmadb zburn zburnsu zsynchro zsyndelc zsynsu zubkst /end LOC_MEASUREMENT
 /begin SUB_FUNCTION /end SUB_FUNCTION
/end FUNCTION
/begin FUNCTION SU "Saugrohrumschaltung"
 /begin DEF_CHARACTERISTIC CWSU ENSUKHG KFSU NMOTNGAS SUMODE0 SUMODE1 TASUS TMSUS TMSUSV TVSU TVSUAN TVSUM TVSUNA TVSUST ZNGFILSU /end DEF_CHARACTERISTIC
 /begin REF_CHARACTERISTIC CWMDAPP /end REF_CHARACTERISTIC
 /begin IN_MEASUREMENT B_ll gangi ngas_w nmot rl rlshk tans tmot tnst_w /end IN_MEASUREMENT
 /begin OUT_MEASUREMENT B_su B_su2 B_sukp fsu_w nmotsu rlsu sumode tvsuae /end OUT_MEASUREMENT
 /begin LOC_MEASUREMENT ngfilsu_w /end LOC_MEASUREMENT
 /begin SUB_FUNCTION /end SUB_FUNCTION
/end FUNCTION
/begin COMPU_METHOD B_TRUE "boolsche Zust‰nde, positive Logik" TAB_VERB "%6.3" "" COMPU_TAB_REF B_TRUE /end COMPU_METHOD
/begin COMPU_VTAB B_TRUE "boolsche Zust‰nde, positive Logik" TAB_VERB 2 0 "----" 1 "TRUE" /end COMPU_VTAB
/begin COMPU_METHOD DC_CNTR_U32 "" RAT_FUNC "%6.2" "" COEFFS 0 1 0 0 0 1 /end COMPU_METHOD
/begin COMPU_METHOD DC_CNTR_U8 "" RAT_FUNC "%6.2" "" COEFFS 0 1 0 0 0 1 /end COMPU_METHOD
/begin COMPU_METHOD DC_DEZ "" RAT_FUNC "%6.2" "" COEFFS 0 1 0 0 0 1 /end COMPU_METHOD
/begin COMPU_METHOD DC_FCTR_32_U8 "" RAT_FUNC "%7.4" "" COEFFS 0 32 0 0 0 1 /end COMPU_METHOD
/begin COMPU_METHOD DC_FKT256 "" RAT_FUNC "%6.4" "Faktor" COEFFS 0 256 0 0 0 1 /end COMPU_METHOD
/begin COMPU_METHOD DC_FLAG_U8 "" RAT_FUNC "%6.2" "" COEFFS 0 1 0 0 0 1 /end COMPU_METHOD
/begin COMPU_METHOD DC_PCT_S16 "" RAT_FUNC "%8.5" "%" COEFFS 0 327.67 0 0 0 1 /end COMPU_METHOD
/begin COMPU_METHOD DC_PCT_U8 "" RAT_FUNC "%8.4" "%" COEFFS 0 256 0 0 0 100 /end COMPU_METHOD
/begin COMPU_METHOD DC_PER0327 "" RAT_FUNC "%6.4" "%" COEFFS 0 327.67 0 0 0 1 /end COMPU_METHOD
/begin COMPU_METHOD DC_PER1023 "" RAT_FUNC "%6.3" "%" COEFFS 0 1023 0 0 0 100 /end COMPU_METHOD
/begin COMPU_METHOD DC_ROTSPD_S16 "" RAT_FUNC "%7.3" "1/min" COEFFS 0 2 0 0 0 1 /end COMPU_METHOD
/begin COMPU_METHOD DC_SEARCH "" RAT_FUNC "%6.2" "" COEFFS 0 1 0 0 0 1 /end COMPU_METHOD
/begin COMPU_METHOD DC_TIME_10MS_U16 "" RAT_FUNC "%6.4" "s" COEFFS 0 100 0 0 0 1 /end COMPU_METHOD
/begin COMPU_METHOD DC_TIME_20MS_U16 "" RAT_FUNC "%6.4" "s" COEFFS 0 50 0 0 0 1 /end COMPU_METHOD
/begin COMPU_METHOD DC_TQ10 "" RAT_FUNC "%6.4" "sec" COEFFS 0 100 0 0 0 1 /end COMPU_METHOD
/begin COMPU_METHOD DC_TQ20 "" RAT_FUNC "%6.4" "sec" COEFFS 0 50 0 0 0 1 /end COMPU_METHOD
/begin COMPU_METHOD DC_TRQ_S16 "" RAT_FUNC "%8.5" "Nm" COEFFS 0 16 0 0 0 1 /end COMPU_METHOD
/begin COMPU_METHOD DC_VEHSPD_KMH_U16 "" RAT_FUNC "%8.5" "km/h" COEFFS 0 16 0 0 0 1 /end COMPU_METHOD
/begin COMPU_METHOD DC_WL05_U16DB "" RAT_FUNC "%5.2" "GRAD" COEFFS 0 2 0 0 0 1 /end COMPU_METHOD
/begin COMPU_METHOD dez "1 : 1 Umrechnug (dez/hex)" RAT_FUNC "%6.2" "" COEFFS 0 1 0 0 0 1 /end COMPU_METHOD
/begin COMPU_METHOD fak_q0p1192_Pdivmss "" RAT_FUNC "%6.3" "%/ms*s" COEFFS 0 131072 0 0 0 15625 /end COMPU_METHOD
/begin COMPU_METHOD fak_q5p960Em3 "" RAT_FUNC "%6.4" "%/ms" COEFFS 0 524288 0 0 0 3125 /end COMPU_METHOD
/begin COMPU_METHOD fak_sb_b1 "" RAT_FUNC "%6.4" "-" COEFFS 0 256 0 0 0 2 /end COMPU_METHOD
/begin COMPU_METHOD fak_sw_b1 "" RAT_FUNC "%7.6" "-" COEFFS 0 65536 0 0 0 2 /end COMPU_METHOD
/begin COMPU_METHOD fak_ub_b1 "" RAT_FUNC "%6.4" "-" COEFFS 0 256 0 0 0 1 /end COMPU_METHOD
/begin COMPU_METHOD fak_ub_b16 "" RAT_FUNC "%6.4" "-" COEFFS 0 256 0 0 0 16 /end COMPU_METHOD
/begin COMPU_METHOD fak_ub_b2 "" RAT_FUNC "%6.4" "-" COEFFS 0 256 0 0 0 2 /end COMPU_METHOD
/begin COMPU_METHOD fak_ub_b4 "" RAT_FUNC "%6.4" "-" COEFFS 0 256 0 0 0 4 /end COMPU_METHOD
/begin COMPU_METHOD fak_uw_b1 "" RAT_FUNC "%7.6" "-" COEFFS 0 65536 0 0 0 1 /end COMPU_METHOD
/begin COMPU_METHOD fak_uw_b16 "" RAT_FUNC "%6.5" "-" COEFFS 0 65536 0 0 0 16 /end COMPU_METHOD
/begin COMPU_METHOD fak_uw_b2 "" RAT_FUNC "%7.6" "-" COEFFS 0 65536 0 0 0 2 /end COMPU_METHOD
/begin COMPU_METHOD fak_uw_b4 "" RAT_FUNC "%7.6" "-" COEFFS 0 65536 0 0 0 4 /end COMPU_METHOD
/begin COMPU_METHOD KennText "" RAT_FUNC "%6.2" "" COEFFS 0 1 0 0 0 1 /end COMPU_METHOD
/begin COMPU_METHOD kw_q0p0019 "" RAT_FUNC "%6.4" "Grad KW" COEFFS 0 512 0 0 0 1 /end COMPU_METHOD
/begin COMPU_METHOD kw_q0p0078 "" RAT_FUNC "%6.4" "Grad KW" COEFFS 0 128 0 0 0 1 /end COMPU_METHOD
/begin COMPU_METHOD kw_q0p5 "" RAT_FUNC "%6.3" "Grad KW" COEFFS 0 2 0 0 0 1 /end COMPU_METHOD
/begin COMPU_METHOD kw_q2p8125 "" RAT_FUNC "%6.2" "∞KW" COEFFS 0 1 0 0 0 2.8125 /end COMPU_METHOD
/begin COMPU_METHOD kw_sw_q0p0078 "" RAT_FUNC "%6.4" "Grad KW" COEFFS 0 128 0 0 0 1 /end COMPU_METHOD
/begin COMPU_METHOD kw_ub_q0p5 "" RAT_FUNC "%6.3" "Grad KW" COEFFS 0 256 0 0 0 128 /end COMPU_METHOD
/begin COMPU_METHOD m_ub_b1020 "" RAT_FUNC "%6.2" "kg/h" COEFFS 0 1 0 0 0 4 /end COMPU_METHOD
/begin COMPU_METHOD m_uw_b23p3 "" RAT_FUNC "%6.5" "kg" COEFFS 0 2812.5 0 0 0 1 /end COMPU_METHOD
/begin COMPU_METHOD m_uw_b6553p5 "" RAT_FUNC "%6.3" "kg/h" COEFFS 0 1 0 0 0 0.1 /end COMPU_METHOD
/begin COMPU_METHOD nmotg_sb_q100 "" RAT_FUNC "%6.0" "1/min/s" COEFFS 0 1 0 0 0 100 /end COMPU_METHOD
/begin COMPU_METHOD nmotg_sw_q0p39 "" RAT_FUNC "%6.3" "1/min/s" COEFFS 0 1 0 0 0 0.39063 /end COMPU_METHOD
/begin COMPU_METHOD nmot_q10 "" RAT_FUNC "%6.1" "1/min" COEFFS 0 1 0 0 0 10 /end COMPU_METHOD
/begin COMPU_METHOD nmot_sw_q0p25 "" RAT_FUNC "%6.3" "1/min" COEFFS 0 1 0 0 0 0.25 /end COMPU_METHOD
/begin COMPU_METHOD nmot_ub_q40 "" RAT_FUNC "%6.1" "1/min" COEFFS 0 1 0 0 0 40 /end COMPU_METHOD
/begin COMPU_METHOD nmot_uw_q0p25 "" RAT_FUNC "%6.3" "1/min" COEFFS 0 1 0 0 0 0.25 /end COMPU_METHOD
/begin COMPU_METHOD p_sw_q0p039 "" RAT_FUNC "%6.4" "hPa" COEFFS 0 256 0 0 0 10 /end COMPU_METHOD
/begin COMPU_METHOD p_sw_q0p078 "" RAT_FUNC "%6.4" "hPa" COEFFS 0 65536 0 0 0 5120 /end COMPU_METHOD
/begin COMPU_METHOD p_sw_q0p312 "" RAT_FUNC "%6.3" "hPa" COEFFS 0 256 0 0 0 80 /end COMPU_METHOD
/begin COMPU_METHOD p_ub_q10 "" RAT_FUNC "%6.1" "hPa" COEFFS 0 1 0 0 0 10 /end COMPU_METHOD
/begin COMPU_METHOD p_uw_q0p039 "" RAT_FUNC "%6.4" "hPa" COEFFS 0 256 0 0 0 10 /end COMPU_METHOD
/begin COMPU_METHOD relDK_q0p02441 "" RAT_FUNC "%6.4" "%DK" COEFFS 0 65536 0 0 0 1600 /end COMPU_METHOD
/begin COMPU_METHOD relDK_ub_b100 "" RAT_FUNC "%6.3" "%DK" COEFFS 0 255 0 0 0 100 /end COMPU_METHOD
/begin COMPU_METHOD relO2_q9p765Em4 "" RAT_FUNC "%6.5" "% O2" COEFFS 0 1024 0 0 0 1 /end COMPU_METHOD
/begin COMPU_METHOD relPED_ub_b100 "" RAT_FUNC "%6.3" "%PED" COEFFS 0 255 0 0 0 100 /end COMPU_METHOD
/begin COMPU_METHOD rel_sw_b50 "" RAT_FUNC "%6.4" "%" COEFFS 0 65536 0 0 0 100 /end COMPU_METHOD
/begin COMPU_METHOD rel_sw_q0p0234 "" RAT_FUNC "%6.4" "%/seg" COEFFS 0 32 0 0 0 0.75 /end COMPU_METHOD
/begin COMPU_METHOD rel_ub_b100 "" RAT_FUNC "%6.3" "%" COEFFS 0 256 0 0 0 100 /end COMPU_METHOD
/begin COMPU_METHOD rel_ub_b127p5 "" RAT_FUNC "%6.3" "%" COEFFS 0 2 0 0 0 1 /end COMPU_METHOD
/begin COMPU_METHOD rel_ub_q0p75 "" RAT_FUNC "%6.3" "%" COEFFS 0 1 0 0 0 0.75 /end COMPU_METHOD
/begin COMPU_METHOD rel_ul_q0p0004 "" RAT_FUNC "%6.5" "%" COEFFS 0 2500 0 0 0 1 /end COMPU_METHOD
/begin COMPU_METHOD rel_uw_b100 "" RAT_FUNC "%6.4" "%" COEFFS 0 65536 0 0 0 100 /end COMPU_METHOD
/begin COMPU_METHOD rel_uw_b3072 "" RAT_FUNC "%6.4" "%" COEFFS 0 65536 0 0 0 3072 /end COMPU_METHOD
/begin COMPU_METHOD rel_uw_q0p0234 "" RAT_FUNC "%6.4" "%" COEFFS 0 32 0 0 0 0.75 /end COMPU_METHOD
/begin COMPU_METHOD rkti_q0p10416Em4 "" RAT_FUNC "%7.6" "ms/%" COEFFS 0 96000 0 0 0 1 /end COMPU_METHOD
/begin COMPU_METHOD rkti_q0p4166Em4 "" RAT_FUNC "%7.6" "ms/%" COEFFS 0 24000 0 0 0 1 /end COMPU_METHOD
/begin COMPU_METHOD r_q0p0391 "" RAT_FUNC "%6.4" "Ohm" COEFFS 0 65536 0 0 0 2560 /end COMPU_METHOD
/begin COMPU_METHOD spg_ubatt "" RAT_FUNC "%6.3" "V" COEFFS 0 1 0 0 0 0.0942 /end COMPU_METHOD
/begin COMPU_METHOD t100msxs_q16Em6 "" RAT_FUNC "%7.6" "s" COEFFS 0 1 0 0 0 1.6e-005 /end COMPU_METHOD
/begin COMPU_METHOD t100msxs_ub_b25p5 "" RAT_FUNC "%6.3" "s" COEFFS 0 1 0 0 0 0.1 /end COMPU_METHOD
/begin COMPU_METHOD t100msxs_uw_b6553p5 "" RAT_FUNC "%6.3" "s" COEFFS 0 1 0 0 0 0.1 /end COMPU_METHOD
/begin COMPU_METHOD t10msxs_ub_b2p55 "" RAT_FUNC "%6.4" "s" COEFFS 0 1 0 0 0 0.01 /end COMPU_METHOD
/begin COMPU_METHOD t10msxs_uw_b655p35 "" RAT_FUNC "%6.4" "s" COEFFS 0 1 0 0 0 0.01 /end COMPU_METHOD
/begin COMPU_METHOD t1p0usxms "" RAT_FUNC "%6.5" "ms" COEFFS 0 1000 0 0 0 1 /end COMPU_METHOD
/begin COMPU_METHOD t1sxs_ub_b255 "" RAT_FUNC "%6.2" "s" COEFFS 0 1 0 0 0 1 /end COMPU_METHOD
/begin COMPU_METHOD t200msxs_ub_b51 "" RAT_FUNC "%6.3" "s" COEFFS 0 1 0 0 0 0.2 /end COMPU_METHOD
/begin COMPU_METHOD t20msxs_ub_b5p1 "" RAT_FUNC "%6.4" "s" COEFFS 0 1 0 0 0 0.02 /end COMPU_METHOD
/begin COMPU_METHOD t50msxs_q0p05 "" RAT_FUNC "%6.4" "s" COEFFS 0 1 0 0 0 0.05 /end COMPU_METHOD
/begin COMPU_METHOD t6minxmin_q6 "" RAT_FUNC "%6.2" "min" COEFFS 0 1 0 0 0 6 /end COMPU_METHOD
/begin COMPU_METHOD temp_q0p0234_o273 "" RAT_FUNC "%6.1" "Grad C" COEFFS 0 1 273.15 0 0 0.0234375 /end COMPU_METHOD
/begin COMPU_METHOD temp_ub_q0p75_o48 "" RAT_FUNC "%6.2" "Grad C" COEFFS 0 1 48 0 0 0.75 /end COMPU_METHOD
/begin COMPU_METHOD temp_ub_q5_o50 "" RAT_FUNC "%6.2" "Grad C" COEFFS 0 1 50 0 0 5 /end COMPU_METHOD
/begin COMPU_METHOD txms_uw_q0p0004 "" RAT_FUNC "%6.5" "ms" COEFFS 0 2500 0 0 0 1 /end COMPU_METHOD
/begin COMPU_METHOD txms_uw_q0p0032 "" RAT_FUNC "%6.4" "ms" COEFFS 0 625 0 0 0 2 /end COMPU_METHOD
/begin COMPU_METHOD t_q0p1 "" RAT_FUNC "%6.3" "s" COEFFS 0 10 0 0 0 1 /end COMPU_METHOD
/begin COMPU_METHOD zk100msxs_uw_b6553 "" RAT_FUNC "%10.3" "s" COEFFS 0 0 65536 0 10 0 /end COMPU_METHOD
/begin COMPU_METHOD zk10msxs_ub_b2p55 "" RAT_FUNC "%6.4" "s" COEFFS 0 0 255 0 100 0 /end COMPU_METHOD
/begin COMPU_METHOD zk10msxs_uw_b655 "" RAT_FUNC "%10.4" "s" COEFFS 0 0 65536 0 100 0 /end COMPU_METHOD
/begin COMPU_METHOD zk20msxs_uw_b1310 "" RAT_FUNC "%10.3" "s" COEFFS 0 0 1310 0 1 0 /end COMPU_METHOD
/begin COMPU_METHOD zw_sb_q0p75 "" RAT_FUNC "%6.3" "Grad KW" COEFFS 0 255 0 0 0 191.25 /end COMPU_METHOD
/begin COMPU_METHOD default "" RAT_FUNC "%6.2" "" COEFFS 0 1 0 0 0 1 /end COMPU_METHOD
/begin RECORD_LAYOUT dc_GKfWUb FNC_VALUES 1 UBYTE COLUMN_DIR DIRECT /end RECORD_LAYOUT
/begin RECORD_LAYOUT dc_GKlWUb FNC_VALUES 1 UBYTE COLUMN_DIR DIRECT /end RECORD_LAYOUT
/begin RECORD_LAYOUT dc_KwSw FNC_VALUES 1 SWORD COLUMN_DIR DIRECT /end RECORD_LAYOUT
/begin RECORD_LAYOUT dc_KwUb FNC_VALUES 1 UBYTE COLUMN_DIR DIRECT /end RECORD_LAYOUT
/begin RECORD_LAYOUT dc_KwUl FNC_VALUES 1 ULONG COLUMN_DIR DIRECT /end RECORD_LAYOUT
/begin RECORD_LAYOUT dc_KwUw FNC_VALUES 1 UWORD COLUMN_DIR DIRECT /end RECORD_LAYOUT
/begin RECORD_LAYOUT dc_SstAUbSstUb NO_AXIS_PTS_X 1 UBYTE AXIS_PTS_X 2 UBYTE INDEX_INCR DIRECT /end RECORD_LAYOUT
/begin RECORD_LAYOUT dc_SstAUwSstUw NO_AXIS_PTS_X 1 UWORD AXIS_PTS_X 2 UWORD INDEX_INCR DIRECT /end RECORD_LAYOUT
/begin RECORD_LAYOUT FklWUw FNC_VALUES 1 UWORD COLUMN_DIR DIRECT /end RECORD_LAYOUT
/begin RECORD_LAYOUT GkfWSw FNC_VALUES 1 SWORD COLUMN_DIR DIRECT /end RECORD_LAYOUT
/begin RECORD_LAYOUT GkfWUb FNC_VALUES 1 UBYTE COLUMN_DIR DIRECT /end RECORD_LAYOUT
/begin RECORD_LAYOUT GklWUw FNC_VALUES 1 UWORD COLUMN_DIR DIRECT /end RECORD_LAYOUT
/begin RECORD_LAYOUT KfAxUbAyUbSstxUbSstyUbWUb NO_AXIS_PTS_X 1 UBYTE NO_AXIS_PTS_Y 2 UBYTE AXIS_PTS_X 3 UBYTE INDEX_INCR DIRECT AXIS_PTS_Y 4 UBYTE INDEX_INCR DIRECT FNC_VALUES 5 UBYTE COLUMN_DIR DIRECT /end RECORD_LAYOUT
/begin RECORD_LAYOUT KfAxUwAyUwSstxUwSstyUwWSw NO_AXIS_PTS_X 1 UWORD NO_AXIS_PTS_Y 2 UWORD AXIS_PTS_X 3 UWORD INDEX_INCR DIRECT AXIS_PTS_Y 4 UWORD INDEX_INCR DIRECT FNC_VALUES 5 SWORD COLUMN_DIR DIRECT /end RECORD_LAYOUT
/begin RECORD_LAYOUT KfAxUwAyUwSstxUwSstyUwWUw NO_AXIS_PTS_X 1 UWORD NO_AXIS_PTS_Y 2 UWORD AXIS_PTS_X 3 UWORD INDEX_INCR DIRECT AXIS_PTS_Y 4 UWORD INDEX_INCR DIRECT FNC_VALUES 5 UWORD COLUMN_DIR DIRECT /end RECORD_LAYOUT
/begin RECORD_LAYOUT KlAUbSstSwWSw NO_AXIS_PTS_X 1 SWORD AXIS_PTS_X 2 SWORD INDEX_INCR DIRECT FNC_VALUES 3 SWORD COLUMN_DIR DIRECT /end RECORD_LAYOUT
/begin RECORD_LAYOUT KlAUbSstSwWUw NO_AXIS_PTS_X 1 UBYTE AXIS_PTS_X 2 SWORD INDEX_INCR DIRECT FNC_VALUES 3 UWORD COLUMN_DIR DIRECT /end RECORD_LAYOUT
/begin RECORD_LAYOUT KlAUbSstUbWSb NO_AXIS_PTS_X 1 UBYTE AXIS_PTS_X 2 UBYTE INDEX_INCR DIRECT FNC_VALUES 3 SBYTE COLUMN_DIR DIRECT /end RECORD_LAYOUT
/begin RECORD_LAYOUT KlAUbSstUbWUb NO_AXIS_PTS_X 1 UBYTE AXIS_PTS_X 2 UBYTE INDEX_INCR DIRECT FNC_VALUES 3 UBYTE COLUMN_DIR DIRECT /end RECORD_LAYOUT
/begin RECORD_LAYOUT KlAUbSstUbWUw NO_AXIS_PTS_X 1 UBYTE AXIS_PTS_X 2 UBYTE INDEX_INCR DIRECT FNC_VALUES 3 UWORD COLUMN_DIR DIRECT /end RECORD_LAYOUT
/begin RECORD_LAYOUT KlAUwSstSwWUw NO_AXIS_PTS_X 1 UWORD AXIS_PTS_X 2 SWORD INDEX_INCR DIRECT FNC_VALUES 3 UWORD COLUMN_DIR DIRECT /end RECORD_LAYOUT
/begin RECORD_LAYOUT KlAUwSstUwWSw NO_AXIS_PTS_X 1 UWORD AXIS_PTS_X 2 UWORD INDEX_INCR DIRECT FNC_VALUES 3 SWORD COLUMN_DIR DIRECT /end RECORD_LAYOUT
/begin RECORD_LAYOUT KlAUwSstUwWUw NO_AXIS_PTS_X 1 UWORD AXIS_PTS_X 2 UWORD INDEX_INCR DIRECT FNC_VALUES 3 UWORD COLUMN_DIR DIRECT /end RECORD_LAYOUT
/begin RECORD_LAYOUT KwbWU8 FNC_VALUES 1 UBYTE COLUMN_DIR DIRECT /end RECORD_LAYOUT
/begin RECORD_LAYOUT KwSb FNC_VALUES 1 SBYTE COLUMN_DIR DIRECT /end RECORD_LAYOUT
/begin RECORD_LAYOUT KwSw FNC_VALUES 1 SWORD COLUMN_DIR DIRECT /end RECORD_LAYOUT
/begin RECORD_LAYOUT KwUb FNC_VALUES 1 UBYTE COLUMN_DIR DIRECT /end RECORD_LAYOUT
/begin RECORD_LAYOUT KwUw FNC_VALUES 1 UWORD COLUMN_DIR DIRECT /end RECORD_LAYOUT
/begin RECORD_LAYOUT KwWU16 FNC_VALUES 1 UWORD COLUMN_DIR DIRECT /end RECORD_LAYOUT
/begin RECORD_LAYOUT KwWU8 FNC_VALUES 1 UBYTE COLUMN_DIR DIRECT /end RECORD_LAYOUT
/begin RECORD_LAYOUT SstASwSstSw NO_AXIS_PTS_X 1 SWORD AXIS_PTS_X 2 SWORD INDEX_INCR DIRECT /end RECORD_LAYOUT
/begin RECORD_LAYOUT SstAU8SstS8 NO_AXIS_PTS_X 1 SBYTE AXIS_PTS_X 2 SBYTE INDEX_INCR DIRECT /end RECORD_LAYOUT
/begin RECORD_LAYOUT SstAU8SstU16 NO_AXIS_PTS_X 1 UWORD AXIS_PTS_X 2 UWORD INDEX_INCR DIRECT /end RECORD_LAYOUT
/begin RECORD_LAYOUT SstAU8SstU8 NO_AXIS_PTS_X 1 UBYTE AXIS_PTS_X 2 UBYTE INDEX_INCR DIRECT /end RECORD_LAYOUT
/begin RECORD_LAYOUT SstAUbSstSb NO_AXIS_PTS_X 1 UBYTE AXIS_PTS_X 2 SBYTE INDEX_INCR DIRECT /end RECORD_LAYOUT
/begin RECORD_LAYOUT SstAUbSstUb NO_AXIS_PTS_X 1 UBYTE AXIS_PTS_X 2 UBYTE INDEX_INCR DIRECT /end RECORD_LAYOUT
/begin RECORD_LAYOUT SstAUwSstUw NO_AXIS_PTS_X 1 UWORD AXIS_PTS_X 2 UWORD INDEX_INCR DIRECT /end RECORD_LAYOUT
/end MODULE
/end PROJECT
