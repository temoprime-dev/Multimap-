ASAP2_VERSION 1 3
/begin PROJECT _9702_071D00 "ME97"
/begin HEADER "" VERSION "_9702_071D00" PROJECT_NO _9702_071D00 /end HEADER
/begin MODULE DIM ""
/begin MOD_COMMON "" BYTE_ORDER MSB_FIRST ALIGNMENT_BYTE 1 ALIGNMENT_WORD 2 ALIGNMENT_LONG 2 ALIGNMENT_FLOAT32_IEEE 4 /end MOD_COMMON
/begin CHARACTERISTIC ABIT_DAT_UC "" VAL_BLK 0x1C27B0 KwbUb 255.0 dez 0.00 255.0 FORMAT "%5.1" NUMBER 16 /end CHARACTERISTIC
/begin CHARACTERISTIC ABRE_DAT_UC "" VAL_BLK 0x1C27C0 KwbUb 255.0 dez 0.00 255.0 FORMAT "%5.1" NUMBER 16 /end CHARACTERISTIC
/begin CHARACTERISTIC ACCA_D_UC "" VAL_BLK 0x1C27D0 KwbUb 255.0 dez 0.00 255.0 FORMAT "%5.1" NUMBER 16 /end CHARACTERISTIC
/begin CHARACTERISTIC ACCA_T_UC "" VALUE 0x1C2B40 KwUb 10200.0 t40ms_ub_b10200 0.00 10200.0 FORMAT "%7.1" /end CHARACTERISTIC
/begin CHARACTERISTIC ACCA_T_UM "Entprellung bei ACC-Z‰hler-Fehler" VALUE 0x1C7CFE KwUb 10200.0 t40ms_ub_b10200 0.00 10200.0 FORMAT "%7.1" /end CHARACTERISTIC
/begin CHARACTERISTIC ACCC_D_UC "" VAL_BLK 0x1C27E0 KwbUb 255.0 dez 0.00 255.0 FORMAT "%5.1" NUMBER 16 /end CHARACTERISTIC
/begin CHARACTERISTIC ACCC_T_UC "" VALUE 0x1C2B41 KwUb 10200.0 t40ms_ub_b10200 0.00 10200.0 FORMAT "%7.1" /end CHARACTERISTIC
/begin CHARACTERISTIC ACCC_T_UM "Fehlerzeit f¸r ACC-Eingriff-‹berwachnung der Funktions¸berwachung" VALUE 0x1C7CFF KwUb 10200.0 t40ms_ub_b10200 0.00 10200.0 FORMAT "%7.1" /end CHARACTERISTIC
/begin CHARACTERISTIC ACTR_DAT_UC "" VAL_BLK 0x1C27F0 KwbUb 255.0 dez 0.00 255.0 FORMAT "%5.1" NUMBER 16 /end CHARACTERISTIC
/begin CHARACTERISTIC ALTC_D_UC "" VAL_BLK 0x1C2800 KwbUb 255.0 dez 0.00 255.0 FORMAT "%5.1" NUMBER 16 /end CHARACTERISTIC
/begin CHARACTERISTIC AMDI_DAT_UC "" VAL_BLK 0x1C2810 KwbUb 255.0 dez 0.00 255.0 FORMAT "%5.1" NUMBER 16 /end CHARACTERISTIC
/begin CHARACTERISTIC ASRL_DAT_UC "" VAL_BLK 0x1C2820 KwbUb 255.0 dez 0.00 255.0 FORMAT "%5.1" NUMBER 16 /end CHARACTERISTIC
/begin CHARACTERISTIC ASRS_DAT_UC "" VAL_BLK 0x1C2830 KwbUb 255.0 dez 0.00 255.0 FORMAT "%5.1" NUMBER 16 /end CHARACTERISTIC
/begin CHARACTERISTIC ASTA_DAT_UC "" VAL_BLK 0x1C2840 KwbUb 255.0 dez 0.00 255.0 FORMAT "%5.1" NUMBER 16 /end CHARACTERISTIC
/begin CHARACTERISTIC BACC_DAT_UC "" VAL_BLK 0x1C2850 KwbUb 255.0 dez 0.00 255.0 FORMAT "%5.1" NUMBER 16 /end CHARACTERISTIC
/begin CHARACTERISTIC BFGR_DAT_UC "" VAL_BLK 0x1C2860 KwbUb 255.0 dez 0.00 255.0 FORMAT "%5.1" NUMBER 16 /end CHARACTERISTIC
/begin CHARACTERISTIC BZSGS_DAT_UC "" VAL_BLK 0x1C2870 KwbUb 255.0 dez 0.00 255.0 FORMAT "%5.1" NUMBER 16 /end CHARACTERISTIC
/begin CHARACTERISTIC CWKVHR "Codewort f¸r Komponenten-Versorgungsspannung ¸ber Hauptrelais" VALUE 0x1CEF78 KwUw 65535.00 dez 0.00 65535.00 FORMAT "%8.2" /end CHARACTERISTIC
/begin CHARACTERISTIC CWNOMSR_BT "" VALUE 0x1C2BD5 KwUb 255.0 dez 0.00 255.0 FORMAT "%5.1" /end CHARACTERISTIC
/begin CHARACTERISTIC CWNOSCAT "Codewort zum Abschalten der Scan Tool Kommunikation" VALUE 0x1CBBB2 KwUb 255.0 dez 0.00 255.0 FORMAT "%5.1" /end CHARACTERISTIC
/begin CHARACTERISTIC CWTEACFG "ausserordentliche Konfiguration der Tankentl¸ftung" VALUE 0x1CE156 KwUb 255.0 dez 0.00 255.0 FORMAT "%5.1" /end CHARACTERISTIC
/begin CHARACTERISTIC CWTEZW "Codewort Z¸ndwinkeleingriff bei TEV-Pr¸fung" VALUE 0x1C6964 KwUb 255.0 dez 0.00 255.0 FORMAT "%5.1" /end CHARACTERISTIC
/begin CHARACTERISTIC DFTEAHB "Schwelle Gemischanteil Tankentl¸ftung zum Setzen Bit ""Hohe Beladung""" VALUE 0x1CDF64 KwSb 1.992 fak_sb_b1 -1.000 0.9922 FORMAT "%5.3" /end CHARACTERISTIC
/begin CHARACTERISTIC DMSTES "Kennlinie maximale Zunahme Massenstrom Tankentl¸ftung" CURVE 0x1C56A2 KlAUwSstUwWUw 3276.800 m_uw_q3p2 0.00 3276.800 FORMAT "%8.3"
 /begin AXIS_DESCR STD_AXIS mstesoll_w m_uw_b25p6 6 0.00 25.59961 FORMAT "%8.5" DEPOSIT ABSOLUTE /end AXIS_DESCR
/end CHARACTERISTIC
/begin CHARACTERISTIC DNMAXH "‹berschreitung der Maximaldrehzahl f¸r Einspritzausblendung an allen Zylindern" VALUE 0x1C696A KwUw 2550.000 nmot_uw_q0p25 0.00 2550.000 FORMAT "%8.3" /end CHARACTERISTIC
/begin CHARACTERISTIC DSTEMIN "Minimalwert f¸r Weitertransport in Totzeitglied Gemischtransport" VALUE 0x1C56BC KwUw 0.9999695 fak_uw_b2 0.00 0.9999695 FORMAT "%9.7" /end CHARACTERISTIC
/begin CHARACTERISTIC DTEMN "Min-Schwelle f¸r delta effekt. Einspritzzeit" VALUE 0x1C695C KwWU16 65.53500 t1p0usxms 0.00 65.53500 FORMAT "%8.5" /end CHARACTERISTIC
/begin CHARACTERISTIC DUETMOT "Delta Motor¸bertemperatur-Schwelle" VALUE 0x1C6650 KwUb 191.3 temp_ub_b191p25 0.00 191.3 FORMAT "%5.1" /end CHARACTERISTIC
/begin CHARACTERISTIC ECC_RotVlv_Posn_ReqV08 "" CURVE 0x1D12A4 dc_GKlWSw 4095.938 DC_ANGL_S16 -2048.000 2047.938 FORMAT "%8.3"
 /begin AXIS_DESCR COM_AXIS TM_ECP_VolFlowLCir DC_FLOW_U16 8 0.00 65535. AXIS_PTS_REF ECC_sstRotVlv_PReqV08 /end AXIS_DESCR
/end CHARACTERISTIC
/begin AXIS_PTS ECC_sstRotVlv_PReqV08 "" 0x1D1604 TM_ECP_VolFlowLCir dc_SstAUwSstUw 65535. DC_FLOW_U16 8 0.00 65535. FORMAT "%6.0" DEPOSIT ABSOLUTE /end AXIS_PTS
/begin CHARACTERISTIC EVZ_DAT_UC "" VAL_BLK 0x1C2880 KwbUb 255.0 dez 0.00 255.0 FORMAT "%5.1" NUMBER 16 /end CHARACTERISTIC
/begin CHARACTERISTIC FBTEB "Faktor Begrenzung Lerngeschwindigkeit f¸r Beladung" CURVE 0x1CDF68 KlAUbSstUbWUb 0.9961 fak_ub_b1 0.00 0.9961
 /begin AXIS_DESCR STD_AXIS ftefvab fak_ub_b0p03125 6 0.00 0.03113 FORMAT "%7.5" DEPOSIT ABSOLUTE /end AXIS_DESCR
/end CHARACTERISTIC
/begin CHARACTERISTIC FBTEVA "Faktor ftefva-abh‰ngige Lerngeschwindigkeit der Beladung" CURVE 0x1CDF78 KlAUbSstUbWUb 0.9961 fak_ub_b1 0.00 0.9961 /begin AXIS_DESCR STD_AXIS ftefva fak_ub_b0p5 6 0.00 0.4980 DEPOSIT ABSOLUTE /end AXIS_DESCR /end CHARACTERISTIC
/begin CHARACTERISTIC FBZBTEML "Bewertungsfaktor Integrationsgeschwindigkeit Beladungsfaktor" CURVE 0x1CDF88 KlAUbSstUbWUb 0.9961 fak_ub_b1 0.00 0.9961
 /begin AXIS_DESCR STD_AXIS abo dez 5 0.00 255.0 FORMAT "%5.1" DEPOSIT ABSOLUTE /end AXIS_DESCR
/end CHARACTERISTIC
/begin CHARACTERISTIC FETATEBN "Kennlinie f¸r drehzahlabh‰ngigen Sollwert des Motorwirkungsgrades" CURVE 0x1CDF94 KlAUbSstUbWUb 0.9961 fak_ub_b1 0.00 0.9961
 /begin AXIS_DESCR STD_AXIS nmot nmot_ub_q40 5 0.00 10200. FORMAT "%5.0" DEPOSIT ABSOLUTE /end AXIS_DESCR
/end CHARACTERISTIC
/begin CHARACTERISTIC FKATEB "Kennlinie Kraftstoffanteil Tankentl¸ftung abh. von te / TEMIN" CURVE 0x1CDFA0 KlAUbSstUbWUb 0.9961 fak_ub_b1 0.00 0.9961
 /begin AXIS_DESCR STD_AXIS qtetemin fak_ub_b4 5 0.00 3.984 FORMAT "%5.3" DEPOSIT ABSOLUTE /end AXIS_DESCR
/end CHARACTERISTIC
/begin CHARACTERISTIC FQTEDL "Kennlinie Faktor f¸r exponentielle Absteuerung Sp¸lrate" CURVE 0x1CDFAC KlAUbSstUbWUb 1.992 fak_ub_b2 0.00 1.992 FORMAT "%5.3"
 /begin AXIS_DESCR STD_AXIS dmlftef fak_ub_b0p5 5 0.00 0.4980 DEPOSIT ABSOLUTE /end AXIS_DESCR
/end CHARACTERISTIC
/begin CHARACTERISTIC FQTEFR "Kennlinie stetige Grenzwertregelung (fr)" CURVE 0x1CE0E7 KlAUbSstUbWSb 15.88 fak_sb_b16 0.00 15.88 FORMAT "%5.2"
 /begin AXIS_DESCR STD_AXIS frmxa fak_ub_b2 8 0.00 1.992 FORMAT "%5.3" DEPOSIT ABSOLUTE /end AXIS_DESCR
/end CHARACTERISTIC
/begin CHARACTERISTIC FQTEPT "Kennlinie Tankunterdruckbegrenzung (pte)" CURVE 0x1CDFB8 KlAUbSstSbWSb 15.88 fak_sb_b16 0.00 15.88 FORMAT "%5.2"
 /begin AXIS_DESCR STD_AXIS pte p_sb_q32 6 -32.00 31.75 FORMAT "%5.2" DEPOSIT ABSOLUTE /end AXIS_DESCR
/end CHARACTERISTIC
/begin CHARACTERISTIC FQTEVA "Progression bei Sp¸lratenaufsteuerung" CURVE 0x1CDFC8 KlAUbSstUbWUb 15.94 fak_ub_b16 0.00 15.94 FORMAT "%5.2" /begin AXIS_DESCR STD_AXIS ftefva fak_ub_b0p5 6 0.00 0.4980 DEPOSIT ABSOLUTE /end AXIS_DESCR /end CHARACTERISTIC
/begin CHARACTERISTIC FRHB "fr-Schwelle f¸r mˆgliches R¸cksetzten Flip-Flop ""Hohe Beladung""" VALUE 0x1CDFD5 KwUb 1.992 fak_ub_b2 0.00 1.992 FORMAT "%5.3" /end CHARACTERISTIC
/begin CHARACTERISTIC FSRFTEF "Faktor Steilheit Sp¸lratenregelung in der N‰he des gew¸nschten Krafstoffanteils" VALUE 0x1C5678 KwUb 59.75 fak_ub_b64 4.000 63.75 FORMAT "%5.2" /end CHARACTERISTIC
/begin CHARACTERISTIC FTEADAB "Schwelle Beladung f¸r Abbruch TE-Phase" VALUE 0x1CDFD6 KwSb 127.5 fak_sb_b64 -64.00 63.50 FORMAT "%5.2" /end CHARACTERISTIC
/begin CHARACTERISTIC FTEADMX "Maximalwert der Beladung des AKF's" VALUE 0x1CDFD7 KwSb 127.5 fak_sb_b64 -64.00 63.50 FORMAT "%5.2" /end CHARACTERISTIC
/begin CHARACTERISTIC FTEFHB "Schwelle f¸r Sp¸lrate Tankentl¸ftung f¸r Erkennung hohe Beladung" VALUE 0x1CDFD8 KwUb 0.4980 fak_ub_b0p5 0.00 0.4980 /end CHARACTERISTIC
/begin CHARACTERISTIC FTEHB "Schwelle f¸r Faktor Tankentl¸ftung f¸r Erkennung hohe Beladung" VALUE 0x1CDFD9 KwSb 127.5 fak_sb_b64 -64.00 63.50 FORMAT "%5.2" /end CHARACTERISTIC
/begin CHARACTERISTIC FTEINIX "Kennlinie Max. Sp¸lrate abh‰ngig vom Integral Massenstrom TE nach TE Stop" CURVE 0x1CDFDC KlAUbSstUbWUb 0.1992 fak_ub_b0p5 0.00 0.1992
 /begin AXIS_DESCR STD_AXIS imsteini m_ub_q0p0444 5 0.00 11.32 FORMAT "%5.2" DEPOSIT ABSOLUTE /end AXIS_DESCR
/end CHARACTERISTIC
/begin CHARACTERISTIC FUELA_DH_UC "" VAL_BLK 0x1C2AA0 KwbUw 4095.938 vfzg_uw_q0p0625 0.00 4095.938 FORMAT "%8.3" NUMBER 16 /end CHARACTERISTIC
/begin CHARACTERISTIC FUELA_DL_UC "" VAL_BLK 0x1C2AC0 KwbUw 4095.938 vfzg_uw_q0p0625 0.00 4095.938 FORMAT "%8.3" NUMBER 16 /end CHARACTERISTIC
/begin CHARACTERISTIC FUEL_DH_UC "" VAL_BLK 0x1C2AE0 KwbUw 4095.938 vfzg_uw_q0p0625 0.00 4095.938 FORMAT "%8.3" NUMBER 16 /end CHARACTERISTIC
/begin CHARACTERISTIC FUEL_DL_UC "" VAL_BLK 0x1C2B00 KwbUw 4095.938 vfzg_uw_q0p0625 0.00 4095.938 FORMAT "%8.3" NUMBER 16 /end CHARACTERISTIC
/begin CHARACTERISTIC FUMRBRK "Faktor Umrechnung HC-Konzentration in Beladung ftead" VALUE 0x1CDFE7 KwUb 31.88 fak_ub_b32 0.00 31.88 FORMAT "%5.2" /end CHARACTERISTIC
/begin CHARACTERISTIC FVERMN "Kennlinie Faktor Vermischung Regeneriergas Tankentl¸ftung mit Frischluft" CURVE 0x1C567C KlAUbSstUbWUb 0.9961 fak_ub_b1 0.00 0.9961
 /begin AXIS_DESCR STD_AXIS nmot nmot_ub_q40 6 0.00 10200. FORMAT "%5.0" DEPOSIT ABSOLUTE /end AXIS_DESCR
/end CHARACTERISTIC
/begin CHARACTERISTIC FVERZDYN "Dynamischer Faktor Verzˆgerung Regeneriergas zw. Drosselklappe, Einspritzventil" CURVE 0x1C56BE GklWUw 0.003905886 t_min_q5p96em8 0.00 0.003905886 FORMAT "%11.9"
 /begin AXIS_DESCR COM_AXIS qmsdyn fak_ub_b16 5 0.00 15.94 AXIS_PTS_REF SQM05TEUB /end AXIS_DESCR
/end CHARACTERISTIC
/begin CHARACTERISTIC FVRMDYN "dynamischer Faktor Vermischung Regeneriergas Tankentl¸ftung mit Frischluft" CURVE 0x1C568C GklWUb 7.969 fak_ub_b8 0.00 7.969 FORMAT "%5.3"
 /begin AXIS_DESCR COM_AXIS qmsdyn fak_ub_b16 5 0.00 15.94 AXIS_PTS_REF SQM05TEUB /end AXIS_DESCR
/end CHARACTERISTIC
/begin CHARACTERISTIC FWRLMNN "Festwert minimale F¸llung" VALUE 0x1CEF7A KwUw 1535.977 rel_uw_q0p0234 0.00 1535.977 FORMAT "%8.3" /end CHARACTERISTIC
/begin CHARACTERISTIC FW_Cyl_FIRate_Corr "" VALUE 0x1D2AC8 dc_KwUw 4095.938 DC_FKT16 0.00 4095.938 FORMAT "%8.3" /end CHARACTERISTIC
/begin CHARACTERISTIC FW_ECF_ECTInDW "" VALUE 0x1D2CD4 dc_KwSw 8191.875 DC_TEMP_S16 -4096.000 4095.875 FORMAT "%8.3" /end CHARACTERISTIC
/begin CHARACTERISTIC FW_ECF_ECTInP "" VALUE 0x1D2CCA dc_KwSw 3.984375 DC_FCTR_128_S16 -1.992188 1.992188 FORMAT "%8.6" /end CHARACTERISTIC
/begin CHARACTERISTIC FW_ECF_ECTOutDW "" VALUE 0x1D2CD2 dc_KwSw 8191.875 DC_TEMP_S16 -4096.000 4095.875 FORMAT "%8.3" /end CHARACTERISTIC
/begin CHARACTERISTIC FW_ECF_ECTOutP "" VALUE 0x1D2CCC dc_KwSw 3.984375 DC_FCTR_128_S16 -1.992188 1.992188 FORMAT "%8.6" /end CHARACTERISTIC
/begin CHARACTERISTIC FW_ECF_OilTDW "" VALUE 0x1D2CD0 dc_KwSw 8191.875 DC_TEMP_S16 -4096.000 4095.875 FORMAT "%8.3" /end CHARACTERISTIC
/begin CHARACTERISTIC FW_ECF_OilTP "" VALUE 0x1D2CCE dc_KwSw 3.984375 DC_FCTR_128_S16 -1.992188 1.992188 FORMAT "%8.6" /end CHARACTERISTIC
/begin CHARACTERISTIC FW_ECF_VolFlow_MAX "" VALUE 0x1D2CD6 dc_KwUw 65535. DC_FLOW_U16 0.00 65535. FORMAT "%6.0" /end CHARACTERISTIC
/begin CHARACTERISTIC FW_ECP_CV_THR "" VALUE 0x1D1468 dc_KwUw 65535. DC_FLOW_U16 0.00 65535. FORMAT "%6.0" /end CHARACTERISTIC
/begin CHARACTERISTIC FW_ECP_ECTInDW "" VALUE 0x1D2D5A dc_KwSw 4095.875 DC_TEMP_S16 0.00 4095.875 FORMAT "%8.3" /end CHARACTERISTIC
/begin CHARACTERISTIC FW_ECP_ECTInP "" VALUE 0x1D2D60 dc_KwSw 3.984375 DC_FCTR_128_S16 -1.992188 1.992188 FORMAT "%8.6" /end CHARACTERISTIC
/begin CHARACTERISTIC FW_ECP_ECTOutDW "" VALUE 0x1D2D5E dc_KwSw 4095.875 DC_TEMP_S16 0.00 4095.875 FORMAT "%8.3" /end CHARACTERISTIC
/begin CHARACTERISTIC FW_ECP_ECTOutP "" VALUE 0x1D2D64 dc_KwSw 3.984375 DC_FCTR_128_S16 -1.992188 1.992188 FORMAT "%8.6" /end CHARACTERISTIC
/begin CHARACTERISTIC FW_ECP_OilTDW "" VALUE 0x1D2D62 dc_KwSw 4095.875 DC_TEMP_S16 0.00 4095.875 FORMAT "%8.3" /end CHARACTERISTIC
/begin CHARACTERISTIC FW_ECP_OilTP "" VALUE 0x1D2D5C dc_KwSw 3.984375 DC_FCTR_128_S16 -1.992188 1.992188 FORMAT "%8.6" /end CHARACTERISTIC
/begin CHARACTERISTIC FW_ECP_PwrOut_MAX "" VALUE 0x1D2D66 dc_KwSw 8191.8750 DC_PWR_S16 -4096.0000 4095.8750 /end CHARACTERISTIC
/begin CHARACTERISTIC FW_ECTOut_MAX "" VALUE 0x1D1466 dc_KwSw 8191.875 DC_TEMP_S16 -4096.000 4095.875 FORMAT "%8.3" /end CHARACTERISTIC
/begin CHARACTERISTIC FW_EM_THRES "" VALUE 0x1D2DFA dc_KwUw 65535. DC_FLOW_U16 0.00 65535. FORMAT "%6.0" /end CHARACTERISTIC
/begin CHARACTERISTIC FW_EngLoad_FIRate "" VALUE 0x1D314C dc_KwUb 1.000 DC_FLAG_U8 0.00 1.000 FORMAT "%5.3" /end CHARACTERISTIC
/begin CHARACTERISTIC FW_Eng_Spd_RelLoad_T "" VALUE 0x1D2ABE dc_KwUw 655.35 DC_TIME_10MS_U16 0.00 655.35 FORMAT "%6.2" /end CHARACTERISTIC
/begin CHARACTERISTIC FW_HeatPuReqOff "" VALUE 0x1D12A2 dc_KwUw 65535. DC_FLOW_U16 0.00 65535. FORMAT "%6.0" /end CHARACTERISTIC
/begin CHARACTERISTIC FW_HeatPuReqOn "" VALUE 0x1D12A0 dc_KwUw 65535. DC_FLOW_U16 0.00 65535. FORMAT "%6.0" /end CHARACTERISTIC
/begin CHARACTERISTIC FW_ManHeatPuMan "" VALUE 0x1D2FA7 dc_KwUb 1.000 DC_FLAG_U8 0.00 1.000 FORMAT "%5.3" /end CHARACTERISTIC
/begin CHARACTERISTIC FW_ManHeatPuSet "" VALUE 0x1D2FA6 dc_KwUb 1.000 DC_FLAG_U8 0.00 1.000 FORMAT "%5.3" /end CHARACTERISTIC
/begin CHARACTERISTIC FW_ManRotValMan "" VALUE 0x1D1464 dc_KwUw 65535. DC_FLOW_U16 0.00 65535. FORMAT "%6.0" /end CHARACTERISTIC
/begin CHARACTERISTIC FW_ManRotValSet "" VALUE 0x1D2FA8 dc_KwUb 255.0 DC_FLAG_U8 0.00 255.0 FORMAT "%5.1" /end CHARACTERISTIC
/begin CHARACTERISTIC FW_TMManOverride "" VALUE 0x1D2FA9 dc_KwUb 255.0 DC_FLAG_U8 0.00 255.0 FORMAT "%5.1" /end CHARACTERISTIC
/begin CHARACTERISTIC FW_TM_ACC_Trq_LowLim "" VALUE 0x1D3142 dc_KwUb 765.0 DC_M3NM 0.00 765.0 FORMAT "%5.1" /end CHARACTERISTIC
/begin CHARACTERISTIC FW_TM_ACC_Trq_UpLim "" VALUE 0x1D3141 dc_KwUb 765.0 DC_M3NM 0.00 765.0 FORMAT "%5.1" /end CHARACTERISTIC
/begin CHARACTERISTIC FW_TM_Bat_Volt_min "" VALUE 0x1D127E dc_KwSw 127.9980 DC_VOLT_S16 -64.00000 63.99805 /end CHARACTERISTIC
/begin CHARACTERISTIC FW_TM_CAF_CT_CF_LowLim "" VALUE 0x1D2AC4 dc_KwUw 65535.00 DC_CNTR_U16 0.00 65535.00 FORMAT "%8.2" /end CHARACTERISTIC
/begin CHARACTERISTIC FW_TM_CAF_CV_DTM_ETC_UpLim "" VALUE 0x1D128C dc_KwSw 8191.875 DC_TEMP_S16 -4096.000 4095.875 FORMAT "%8.3" /end CHARACTERISTIC
/begin CHARACTERISTIC FW_TM_CF_ECU_RunOn_Delay_t1 "" VALUE 0x1D1278 dc_KwUw 65.535 DC_TIME_1MS_U16 0.00 65.535 FORMAT "%6.3" /end CHARACTERISTIC
/begin CHARACTERISTIC FW_TM_CF_ECU_RunOn_Delay_t2 "" VALUE 0x1D127A dc_KwUw 65.535 DC_TIME_1MS_U16 0.00 65.535 FORMAT "%6.3" /end CHARACTERISTIC
/begin CHARACTERISTIC FW_TM_CF_ECU_RunOn_Delay_t3 "" VALUE 0x1D127C dc_KwUw 65.535 DC_TIME_1MS_U16 0.00 65.535 FORMAT "%6.3" /end CHARACTERISTIC
/begin CHARACTERISTIC FW_TM_CF_ECU_RunOn_EndValue "" VALUE 0x1D1276 dc_KwSw 200.0031 DC_PCT_S16 -100.0031 100.0000 FORMAT "%8.4" /end CHARACTERISTIC
/begin CHARACTERISTIC FW_TM_CF_ECU_RunOn_tn "" VALUE 0x1D1274 dc_KwSw 200.0031 DC_PCT_S16 -100.0031 100.0000 FORMAT "%8.4" /end CHARACTERISTIC
/begin CHARACTERISTIC FW_TM_CoolFanSpd_Req "" VALUE 0x1D2AC2 dc_KwUw 200.0031 DC_PER0327 0.00 200.0031 FORMAT "%8.4" /end CHARACTERISTIC
/begin CHARACTERISTIC FW_TM_CoolFan_DTC "" VALUE 0x1D128A dc_KwSw 200.0031 DC_PCT_S16 -100.0031 100.0000 FORMAT "%8.4" /end CHARACTERISTIC
/begin CHARACTERISTIC FW_TM_CoolFan_DTM "" VALUE 0x1D2F9E dc_KwUb 1.000 DC_FLAG_U8 0.00 1.000 FORMAT "%5.3" /end CHARACTERISTIC
/begin CHARACTERISTIC FW_TM_CoolFan_DTM_0 "" VALUE 0x1D2F9F dc_KwUb 1.000 DC_FLAG_U8 0.00 1.000 FORMAT "%5.3" /end CHARACTERISTIC
/begin CHARACTERISTIC FW_TM_CoolFan_DTM_Pos "" VALUE 0x1D1280 dc_KwSw 200.0031 DC_PCT_S16 -100.0031 100.0000 FORMAT "%8.4" /end CHARACTERISTIC
/begin CHARACTERISTIC FW_TM_CoolFan_Eng_Run_Mode_T "" VALUE 0x1D1282 dc_KwUw 6553.5 DC_TIME_100MS_U16 0.00 6553.5 FORMAT "%6.1" /end CHARACTERISTIC
/begin CHARACTERISTIC FW_TM_CoolFan_Req_Min "" VALUE 0x1D1288 dc_KwSw 200.0031 DC_PCT_S16 -100.0031 100.0000 FORMAT "%8.4" /end CHARACTERISTIC
/begin CHARACTERISTIC FW_TM_CoolFan_RunOn_Req_perm "" VALUE 0x1D2F9C dc_KwUb 1.000 DC_FLAG_U8 0.00 1.000 FORMAT "%5.3" /end CHARACTERISTIC
/begin CHARACTERISTIC FW_TM_ECC_RotVlv_St_disable "" VALUE 0x1D2F9D dc_KwUb 1.000 DC_FLAG_U8 0.00 1.000 FORMAT "%5.3" /end CHARACTERISTIC
/begin CHARACTERISTIC FW_TM_EngHood_Mode "" VALUE 0x1D2FA1 dc_KwUb 1.000 DC_FLAG_U8 0.00 1.000 FORMAT "%5.3" /end CHARACTERISTIC
/begin CHARACTERISTIC FW_TM_ExtAir_Temp_ErrMode "" VALUE 0x1D2AC6 dc_KwSw 8191.875 DC_TEMP_S16 -4096.000 4095.875 FORMAT "%8.3" /end CHARACTERISTIC
/begin CHARACTERISTIC FW_TM_FIRate_RelLoad_T "" VALUE 0x1D2AC0 dc_KwUw 655.35 DC_TIME_10MS_U16 0.00 655.35 FORMAT "%6.2" /end CHARACTERISTIC
/begin CHARACTERISTIC FW_TM_Luefter_T "" VALUE 0x1D1286 dc_KwUw 655.35 DC_TIME_10MS_U16 0.00 655.35 FORMAT "%6.2" /end CHARACTERISTIC
/begin CHARACTERISTIC FW_TM_Sens_Oil_Temp_Max "" VALUE 0x1D128E dc_KwSw 8191.875 DC_TEMP_S16 -4096.000 4095.875 FORMAT "%8.3" /end CHARACTERISTIC
/begin CHARACTERISTIC FW_TM_Shuttr_BREnable "" VALUE 0x1D2FA2 dc_KwUb 1.000 DC_FLAG_U8 0.00 1.000 FORMAT "%5.3" /end CHARACTERISTIC
/begin CHARACTERISTIC FW_TM_Shuttr_DTM "" VALUE 0x1D2FA5 dc_KwUb 1.000 DC_FLAG_U8 0.00 1.000 FORMAT "%5.3" /end CHARACTERISTIC
/begin CHARACTERISTIC FW_TM_Shuttr_DTM_Pos "" VALUE 0x1D1298 dc_KwSw 200.0031 DC_PCT_S16 -100.0031 100.0000 FORMAT "%8.4" /end CHARACTERISTIC
/begin CHARACTERISTIC FW_TM_Shuttr_ECU_RunOn_Pos "" VALUE 0x1D129C dc_KwSw 200.0031 DC_PCT_S16 -100.0031 100.0000 FORMAT "%8.4" /end CHARACTERISTIC
/begin CHARACTERISTIC FW_TM_Shuttr_Enable "" VALUE 0x1D2FA0 dc_KwUb 1.000 DC_FLAG_U8 0.00 1.000 FORMAT "%5.3" /end CHARACTERISTIC
/begin CHARACTERISTIC FW_TM_Shuttr_ETC_OffLim "" VALUE 0x1D1292 dc_KwSw 8191.875 DC_TEMP_S16 -4096.000 4095.875 FORMAT "%8.3" /end CHARACTERISTIC
/begin CHARACTERISTIC FW_TM_Shuttr_ETC_OnLim "" VALUE 0x1D1294 dc_KwSw 8191.875 DC_TEMP_S16 -4096.000 4095.875 FORMAT "%8.3" /end CHARACTERISTIC
/begin CHARACTERISTIC FW_TM_Shuttr_ExtAirTemp_OffLim "" VALUE 0x1D2FA3 dc_KwUb 255.0 DC_UTMP_40 -40.00 215.0 FORMAT "%5.1" /end CHARACTERISTIC
/begin CHARACTERISTIC FW_TM_Shuttr_ExtAirTemp_OnLim "" VALUE 0x1D2FA4 dc_KwUb 255.0 DC_UTMP_40 -40.00 215.0 FORMAT "%5.1" /end CHARACTERISTIC
/begin CHARACTERISTIC FW_TM_Shuttr_PosOpen "" VALUE 0x1D129E dc_KwSw 200.0031 DC_PCT_S16 -100.0031 100.0000 FORMAT "%8.4" /end CHARACTERISTIC
/begin CHARACTERISTIC FW_TM_Shuttr_Pos_Req_LowLim "" VALUE 0x1D1284 dc_KwSw 200.0031 DC_PCT_S16 -100.0031 100.0000 FORMAT "%8.4" /end CHARACTERISTIC
/begin CHARACTERISTIC FW_TM_Shuttr_T "" VALUE 0x1D1296 dc_KwUw 6553.5 DC_TIME_100MS_U16 0.00 6553.5 FORMAT "%6.1" /end CHARACTERISTIC
/begin CHARACTERISTIC FW_TM_Shuttr_Veh_Spd_OffLim "" VALUE 0x1D129A dc_KwUw 300.0000 DC_VEHSPD_KMH_U16 0.00 300.0000 FORMAT "%8.4" /end CHARACTERISTIC
/begin CHARACTERISTIC FW_TM_Shuttr_Veh_Spd_OnLim "" VALUE 0x1D1290 dc_KwUw 300.0000 DC_VEHSPD_KMH_U16 0.00 300.0000 FORMAT "%8.4" /end CHARACTERISTIC
/begin CHARACTERISTIC FW_T_ECF_PreCtrlT "" VALUE 0x1D2CD8 dc_KwUw 655.35 DC_TIME_10MS_U16 0.00 655.35 FORMAT "%6.2" /end CHARACTERISTIC
/begin CHARACTERISTIC FW_T_ECPFilT "" VALUE 0x1D2D68 dc_KwUw 327.67 DC_TIME_10MS_U16 0.00 327.67 FORMAT "%6.2" /end CHARACTERISTIC
/begin CHARACTERISTIC GANG_NFB "Vorbesetzung des Sollgangs im Notfahrbetrieb" VALUE 0x1CEF76 KwUb 255.0 DEZ 0.00 255.0 FORMAT "%5.1" /end CHARACTERISTIC
/begin CHARACTERISTIC KFATMKRH "Kennfeld station‰re Kr¸mmertemperatur im Homogenbetrieb" MAP 0x1CEF7C KfAxUwAyUwSstxUwSstyUwWUw 1262.836 temp_q0p0234_o273 -0.009375000 1262.827 FORMAT "%8.3"
 /begin AXIS_DESCR STD_AXIS nmot_w nmot_uw_q0p25 8 0.00 16383.75 FORMAT "%8.2" DEPOSIT ABSOLUTE /end AXIS_DESCR
 /begin AXIS_DESCR STD_AXIS rlmnomr_w rel_uw_q0p0234 8 0.00 1535.977 FORMAT "%8.3" DEPOSIT ABSOLUTE /end AXIS_DESCR
/end CHARACTERISTIC
/begin CHARACTERISTIC KFETATE "Kennfeld gew¸nscher Wirkungsgrad bei Tankentl¸ftung bei Erreichen te = TEMIN" MAP 0x1CE0F8 KfAxUwAyUwSstxSwSstyUwWUw 50.00000 rel_q0p00195 50.00000 100.0000 FORMAT "%8.4"
 /begin AXIS_DESCR STD_AXIS fteadf_w fak_q0p00195 3 -64.00000 63.99805 FORMAT "%8.5" DEPOSIT ABSOLUTE /end AXIS_DESCR
 /begin AXIS_DESCR STD_AXIS mifa_w rel_uw_b100 5 0.00 99.99847 FORMAT "%8.5" DEPOSIT ABSOLUTE /end AXIS_DESCR
/end CHARACTERISTIC
/begin CHARACTERISTIC KFFTEAN "Kennfeld Maximale Sp¸lrate bei Notlauftankentl¸ftung" MAP 0x1CDFE8 GkfWUb 0.1992 fak_ub_b0p5 0.00 0.1992
 /begin AXIS_DESCR COM_AXIS nmot nmot_ub_q40 10 0.00 10200. AXIS_PTS_REF SNM10TEUB /end AXIS_DESCR
 /begin AXIS_DESCR COM_AXIS wdkba relDK_ub_b100 10 0.00 100.0 AXIS_PTS_REF SDK10TEUB /end AXIS_DESCR
/end CHARACTERISTIC
/begin CHARACTERISTIC KFFTEAX "Kennfeld maximale Sp¸lrate" MAP 0x1CE04C KfAxUbAyUbSstxUbSstyUbWUb 0.1992 fak_ub_b0p5 0.00 0.1992
 /begin AXIS_DESCR STD_AXIS ml m_ub_b1020 5 0.00 1020. FORMAT "%5.0" DEPOSIT ABSOLUTE /end AXIS_DESCR
 /begin AXIS_DESCR STD_AXIS tans temp_ub_q0p75_o48 4 -48.00 143.3 FORMAT "%5.1" DEPOSIT ABSOLUTE /end AXIS_DESCR
/end CHARACTERISTIC
/begin CHARACTERISTIC KFMDZOF_UC "Kennfeld f¸r Offset-Toleranz in Abh‰ngigkeit vom zul. Moment im Befehlstest" MAP 0x1C2BDC GkfWUb 99.61 rel_ub_b99p6 0.00 99.61 FORMAT "%5.2"
 /begin AXIS_DESCR COM_AXIS mz_uc rel_ub_b99p6 8 0.00 99.61 AXIS_PTS_REF MDV08_UC /end AXIS_DESCR
 /begin AXIS_DESCR COM_AXIS nmot_uc nmot_ub_q40 8 0.00 10200. AXIS_PTS_REF NMV08_UC /end AXIS_DESCR
/end CHARACTERISTIC
/begin CHARACTERISTIC KFMI_UC "Kennfeld optimales Motormoment im Befehlstest" MAP 0x1C2B44 GkfWUb 99.61 rel_ub_b99p6 0.00 99.61 FORMAT "%5.2"
 /begin AXIS_DESCR COM_AXIS rl_uc rel_ub_q0p75 8 0.00 191.3 AXIS_PTS_REF RLV08_UC /end AXIS_DESCR
 /begin AXIS_DESCR COM_AXIS nmot_uc nmot_ub_q40 8 0.00 10200. AXIS_PTS_REF NZWV08_UC /end AXIS_DESCR
/end CHARACTERISTIC
/begin CHARACTERISTIC KFMPED_UC "Kennfeld f¸r zul‰ssiges Moment aus der Pedalstellung im Befehlstest" MAP 0x1C2C1C GkfWUb 99.61 rel_ub_b99p6 0.00 99.61 FORMAT "%5.2"
 /begin AXIS_DESCR COM_AXIS spsn_uc spg_ub_q0p019 8 0.00 4.980 AXIS_PTS_REF SPSNV08_UC /end AXIS_DESCR
 /begin AXIS_DESCR COM_AXIS nmot_uc nmot_ub_q40 8 0.00 10200. AXIS_PTS_REF NMV08_UC /end AXIS_DESCR
/end CHARACTERISTIC
/begin CHARACTERISTIC KFMPNS_UC "Kennfeld f¸r zul. Moment aus Pedalstellung bei kaltem Motor im Befehlstest" MAP 0x1C2C5C GkfWUb 99.61 rel_ub_b99p6 0.00 99.61 FORMAT "%5.2"
 /begin AXIS_DESCR COM_AXIS spsn_uc spg_ub_q0p019 8 0.00 4.980 AXIS_PTS_REF SPSNV08_UC /end AXIS_DESCR
 /begin AXIS_DESCR COM_AXIS nmot_uc nmot_ub_q40 8 0.00 10200. AXIS_PTS_REF NMV08_UC /end AXIS_DESCR
/end CHARACTERISTIC
/begin CHARACTERISTIC KFQTE "Kennfeld Auf-/Absteuergeschwindigkeit der Sollsp¸lrate Tankentl¸ftung" MAP 0x1CE06C GkfWUb 0.0121593164 perio_ub_b0p012207 0.00 0.0121593164 FORMAT "%12.10" /begin AXIS_DESCR COM_AXIS ml m_ub_b1020 6 0.00 1020. AXIS_PTS_REF SML06TEUB /end AXIS_DESCR
 /begin AXIS_DESCR COM_AXIS frmit fak_ub_b2 5 0.00 1.992 AXIS_PTS_REF SFR05TEUB /end AXIS_DESCR
/end CHARACTERISTIC
/begin CHARACTERISTIC KFTADMS "dynamischer Bewertungsfaktor f¸r das Absteuern des TEV" MAP 0x1C56C8 KfAxUbAyUbSstxSbSstyUbWUb 1.992 fak_ub_b2 0.00 1.992 FORMAT "%5.3"
 /begin AXIS_DESCR STD_AXIS dmssginr fak_sb_b1 5 -1.000 0.9922 FORMAT "%5.3" DEPOSIT ABSOLUTE /end AXIS_DESCR
 /begin AXIS_DESCR STD_AXIS nmot nmot_ub_q40 4 0.00 10200. FORMAT "%5.0" DEPOSIT ABSOLUTE /end AXIS_DESCR
/end CHARACTERISTIC
/begin CHARACTERISTIC KFTATX "Kennfeld f¸r maximales Tastverh‰ltnis" MAP 0x1CE08C KfAxUbAyUbSstxUbSstyUbWUb 99.61 rel_ub_b99p6 0.00 99.61 FORMAT "%5.2"
 /begin AXIS_DESCR STD_AXIS nmot nmot_ub_q40 10 0.00 10200. FORMAT "%5.0" DEPOSIT ABSOLUTE /end AXIS_DESCR
 /begin AXIS_DESCR STD_AXIS pspu fak_ub_b2 6 0.00 1.992 FORMAT "%5.3" DEPOSIT ABSOLUTE /end AXIS_DESCR
/end CHARACTERISTIC
/begin CHARACTERISTIC KFTEKA "Kennfeld Sollkraftstoffanteil bei Regenerierung" MAP 0x1CE12A KfAxUbAyUbSstxUbSstyUbWSb 0.9922 fak_sb_b1 0.00 0.9922
 /begin AXIS_DESCR STD_AXIS nmot nmot_ub_q40 5 0.00 10200. FORMAT "%5.0" DEPOSIT ABSOLUTE /end AXIS_DESCR
 /begin AXIS_DESCR STD_AXIS rl rel_ub_q0p75 5 0.00 191.3 FORMAT "%5.1" DEPOSIT ABSOLUTE /end AXIS_DESCR
/end CHARACTERISTIC
/begin CHARACTERISTIC KFZW_UC "Kennfeld f¸r optimalen Z¸ndwinkel im Befehlstest" MAP 0x1C2B84 GkfWSb 191.3 zw_sb_q0p75 -96.00 95.25 FORMAT "%5.2"
 /begin AXIS_DESCR COM_AXIS rl_uc rel_ub_q0p75 8 0.00 191.3 AXIS_PTS_REF RLV08_UC /end AXIS_DESCR
 /begin AXIS_DESCR COM_AXIS nmot_uc nmot_ub_q40 8 0.00 10200. AXIS_PTS_REF NZWV08_UC /end AXIS_DESCR
/end CHARACTERISTIC
/begin CHARACTERISTIC KHCTEAMX "Maximalwert HC-Konzentration Regeneriergas Tankentl¸ftung(bei B_abor)" VALUE 0x1CE0DA KwSb 3.984 fak_sb_b2 -2.000 1.984 FORMAT "%5.3" /end CHARACTERISTIC
/begin CHARACTERISTIC KHCTEMN "Minimalwert HC-Konzentration Regeneriergas Tankentl¸ftung" VALUE 0x1CE0DB KwSb 3.984 fak_sb_b2 -2.000 1.984 FORMAT "%5.3" /end CHARACTERISTIC
/begin CHARACTERISTIC KHCTEMX "Maximalwert HC-Konzentration Regeneriergas Tankentl¸ftung" VALUE 0x1CE0DC KwSb 3.984 fak_sb_b2 -2.000 1.984 FORMAT "%5.3" /end CHARACTERISTIC
/begin CHARACTERISTIC KLETAZW_UC "ZW-Wirkungsgrad in Abh‰ngigkeit von delta ZW im Befehlstest" CURVE 0x1C2BC4 KlAUbSstUbWUb 127.5 rel_ub_b127p5 0.00 127.5 FORMAT "%5.1"
 /begin AXIS_DESCR STD_AXIS dzw_uc zw_ub_q0p75 8 0.00 191.3 FORMAT "%5.1" DEPOSIT ABSOLUTE /end AXIS_DESCR
/end CHARACTERISTIC
/begin CHARACTERISTIC KLNPED_UC "pedalsollwertabh. Drehzahlbegr. in der DK-Antrieb-Ersatzfunktion; Befehlstest" CURVE 0x1C2CA8 KlAUbSstUbWUb 10200. nmot_ub_q40 0.00 10200. FORMAT "%5.0"
 /begin AXIS_DESCR STD_AXIS spsn_uc spg_ub_q0p019 8 0.00 4.980 FORMAT "%5.3" DEPOSIT ABSOLUTE /end AXIS_DESCR
/end CHARACTERISTIC
/begin CHARACTERISTIC KL_TM_CAF_CT_AC_MAF_Req "" CURVE 0x1D24FE dc_GKlWUw 65535.00 DC_CNTR_U16 0.00 65535.00 FORMAT "%8.2"
 /begin AXIS_DESCR COM_AXIS AC_MAF_Req DC_SD1_U8MB 8 0.00 255. AXIS_PTS_REF sst_TM_CAF_CT_AC_MAF_Req /end AXIS_DESCR
/end CHARACTERISTIC
/begin CHARACTERISTIC KL_TM_CAF_CT_CFSR_Veh_Spd "" MAP 0x1D253E dc_GKfWUw 65535.00 DC_CNTR_U16 0.00 65535.00 FORMAT "%8.2"
 /begin AXIS_DESCR COM_AXIS TM_CAF_CT_CoolFanSpd_Req DC_PER0327 8 -100.0031 100.0000 AXIS_PTS_REF sst_TM_CAF_CT_CoolFanSpd_Req /end AXIS_DESCR
 /begin AXIS_DESCR COM_AXIS Veh_Spd DC_VEHSPD_KMH_U16 16 0.00 4095.938 AXIS_PTS_REF VCANV16 /end AXIS_DESCR
/end CHARACTERISTIC
/begin CHARACTERISTIC KL_TM_CAF_CT_ECU_Temp "" CURVE 0x1D251E dc_GKlWUw 65535.00 DC_CNTR_U16 0.00 65535.00 FORMAT "%8.2"
 /begin AXIS_DESCR COM_AXIS TM_ECU_Temp DC_TEMP_S16 8 -4096.000 4095.875 AXIS_PTS_REF sst_TM_CAF_CT_ECU_Temp /end AXIS_DESCR
/end CHARACTERISTIC
/begin CHARACTERISTIC KL_TM_CAF_CT_EngLoad "" CURVE 0x1D24EE dc_GKlWSw 8191.875 DC_TEMP_S16 -4096.000 4095.875 FORMAT "%8.3"
 /begin AXIS_DESCR COM_AXIS TM_CAF_CT_EngLoad_sstIn DC_PCT_S16 8 -100.0031 100.0000 AXIS_PTS_REF sst_TM_CAF_CT_EngLoad /end AXIS_DESCR
/end CHARACTERISTIC
/begin CHARACTERISTIC KL_TM_CAF_CT_ETC_C_Setpoint "" MAP 0x1D263E dc_GKfWUw 65535.00 DC_CNTR_U16 0.00 65535.00 FORMAT "%8.2"
 /begin AXIS_DESCR COM_AXIS TM_CAF_CT_ETC_C_Setpoint DC_TEMP_S16 8 -4096.000 4095.875 AXIS_PTS_REF sst_TM_CAF_CT_ETC_C_Setpoint /end AXIS_DESCR
 /begin AXIS_DESCR COM_AXIS TM_CAF_CT_ETC_sstIn DC_TEMP_S16 8 -4096.000 4095.875 AXIS_PTS_REF sst_TM_CAF_CT_ETC /end AXIS_DESCR
/end CHARACTERISTIC
/begin CHARACTERISTIC KL_TM_CAF_CT_ExtAir_Temp "" CURVE 0x1D3144 dc_GKlWUb 15.94 DC_FKT16 0.00 15.94 FORMAT "%5.2"
 /begin AXIS_DESCR COM_AXIS TM_CAF_CT_ExtAir_Temp_S DC_TEMP_S16 8 -4096.000 4095.875 AXIS_PTS_REF sst_TM_CAF_CT_ExtAir_Temp /end AXIS_DESCR
/end CHARACTERISTIC
/begin CHARACTERISTIC KL_TM_CAF_CT_FIRate_nst08 "" MAP 0x1D26BE dc_GKfWSw 200.0031 DC_PCT_S16 -100.0031 100.0000 FORMAT "%8.4"
 /begin AXIS_DESCR COM_AXIS Eng_Spd DC_ROTSPD_S16 8 -16384.0 16383.5 AXIS_PTS_REF NISTV08 /end AXIS_DESCR
 /begin AXIS_DESCR COM_AXIS TM_Cyl_FIRate_sstIn DC_FKT32768 16 0.00 1.999969 AXIS_PTS_REF sst_TM_Cyl_FIRate /end AXIS_DESCR
/end CHARACTERISTIC
/begin CHARACTERISTIC KL_TM_CAF_CT_IntkAir_Temp "" CURVE 0x1D250E dc_GKlWUw 65535.00 DC_CNTR_U16 0.00 65535.00 FORMAT "%8.2"
 /begin AXIS_DESCR COM_AXIS IntkAir_Temp temp_sw_q1p25Em1 8 -4096.000 4095.875 AXIS_PTS_REF sst_TM_CAF_CT_IntkAir_Temp /end AXIS_DESCR
/end CHARACTERISTIC
/begin CHARACTERISTIC KL_TM_CAF_CT_MAF_nst08 "" MAP 0x1D28BE dc_GKfWSw 0.00 DC_PCT_S16 0.00 0.00 FORMAT "%8.2"
 /begin AXIS_DESCR COM_AXIS Eng_Spd DC_ROTSPD_S16 8 -16384.0 16383.5 AXIS_PTS_REF NISTV08 /end AXIS_DESCR
 /begin AXIS_DESCR COM_AXIS MAF m_ub_q1p0 16 0.00 65535.00 AXIS_PTS_REF sst_TM_CAF_CT_MAF /end AXIS_DESCR
/end CHARACTERISTIC
/begin CHARACTERISTIC KL_TM_CAF_CT_Sen_Oil_Temp "" CURVE 0x1D252E dc_GKlWUw 65535.00 DC_CNTR_U16 0.00 65535.00 FORMAT "%8.2"
 /begin AXIS_DESCR COM_AXIS Sen_Oil_Temp temp_sw_q1p25Em1 8 -4096.000 4095.875 AXIS_PTS_REF sst_TM_CAF_CT_Sen_Oil_Temp /end AXIS_DESCR
/end CHARACTERISTIC
/begin CHARACTERISTIC KL_TM_CoolFan_MAF_Req_Veh_spd "" MAP 0x1D1074 dc_GKfWSw 200.0031 DC_PCT_S16 -100.0031 100.0000 FORMAT "%8.4"
 /begin AXIS_DESCR COM_AXIS Veh_Spd DC_VEHSPD_KMH_U16 16 0.00 4095.938 AXIS_PTS_REF VCANV16 /end AXIS_DESCR
 /begin AXIS_DESCR COM_AXIS CoolFan_MAF_Req DC_CNTR_U16 16 0.00 65535.00 AXIS_PTS_REF sst_TM_CoolFan_MAF_Req /end AXIS_DESCR
/end CHARACTERISTIC
/begin CHARACTERISTIC KL_TM_Luefter1 "" MAP 0x1D0E74 dc_GKfWSw 200.0031 DC_PCT_S16 -100.0031 100.0000 FORMAT "%8.4"
 /begin AXIS_DESCR COM_AXIS Veh_Spd DC_VEHSPD_KMH_U16 16 0.00 4095.938 AXIS_PTS_REF VCANV16 /end AXIS_DESCR
 /begin AXIS_DESCR COM_AXIS CoolFan_MAF_Req DC_CNTR_U16 16 0.00 65535.00 AXIS_PTS_REF sst_TM_CoolFan_MAF_Req /end AXIS_DESCR
/end CHARACTERISTIC
/begin CHARACTERISTIC KL_TM_Luefter2 "" MAP 0x1D0C74 dc_GKfWSw 200.0031 DC_PCT_S16 -100.0031 100.0000 FORMAT "%8.4"
 /begin AXIS_DESCR COM_AXIS Veh_Spd DC_VEHSPD_KMH_U16 16 0.00 4095.938 AXIS_PTS_REF VCANV16 /end AXIS_DESCR
 /begin AXIS_DESCR COM_AXIS CoolFan_MAF_Req DC_CNTR_U16 16 0.00 65535.00 AXIS_PTS_REF sst_TM_CoolFan_MAF_Req /end AXIS_DESCR
/end CHARACTERISTIC
/begin CHARACTERISTIC KL_TM_Luefter3 "" MAP 0x1D0674 dc_GKfWSw 200.0031 DC_PCT_S16 -100.0031 100.0000 FORMAT "%8.4"
 /begin AXIS_DESCR COM_AXIS Veh_Spd DC_VEHSPD_KMH_U16 16 0.00 4095.938 AXIS_PTS_REF VCANV16 /end AXIS_DESCR
 /begin AXIS_DESCR COM_AXIS CoolFan_MAF_Req DC_CNTR_U16 16 0.00 65535.00 AXIS_PTS_REF sst_TM_CoolFan_MAF_Req /end AXIS_DESCR
/end CHARACTERISTIC
/begin CHARACTERISTIC KL_TM_Luefter4 "" MAP 0x1D0874 dc_GKfWSw 200.0031 DC_PCT_S16 -100.0031 100.0000 FORMAT "%8.4"
 /begin AXIS_DESCR COM_AXIS Veh_Spd DC_VEHSPD_KMH_U16 16 0.00 4095.938 AXIS_PTS_REF VCANV16 /end AXIS_DESCR
 /begin AXIS_DESCR COM_AXIS CoolFan_MAF_Req DC_CNTR_U16 16 0.00 65535.00 AXIS_PTS_REF sst_TM_CoolFan_MAF_Req /end AXIS_DESCR
/end CHARACTERISTIC
/begin CHARACTERISTIC KL_TM_Luefter5 "" MAP 0x1D0A74 dc_GKfWSw 200.0031 DC_PCT_S16 -100.0031 100.0000 FORMAT "%8.4"
 /begin AXIS_DESCR COM_AXIS Veh_Spd DC_VEHSPD_KMH_U16 16 0.00 4095.938 AXIS_PTS_REF VCANV16 /end AXIS_DESCR
 /begin AXIS_DESCR COM_AXIS CoolFan_MAF_Req DC_CNTR_U16 16 0.00 65535.00 AXIS_PTS_REF sst_TM_CoolFan_MAF_Req /end AXIS_DESCR
/end CHARACTERISTIC
/begin CHARACTERISTIC KL_TM_Luefter6 "" MAP 0x1D0474 dc_GKfWSw 200.0031 DC_PCT_S16 -100.0031 100.0000 FORMAT "%8.4"
 /begin AXIS_DESCR COM_AXIS Veh_Spd DC_VEHSPD_KMH_U16 16 0.00 4095.938 AXIS_PTS_REF VCANV16 /end AXIS_DESCR
 /begin AXIS_DESCR COM_AXIS CoolFan_MAF_Req DC_CNTR_U16 16 0.00 65535.00 AXIS_PTS_REF sst_TM_CoolFan_MAF_Req /end AXIS_DESCR
/end CHARACTERISTIC
/begin CHARACTERISTIC KL_TM_Luefter7 "" MAP 0x1D0274 dc_GKfWSw 200.0031 DC_PCT_S16 -100.0031 100.0000 FORMAT "%8.4"
 /begin AXIS_DESCR COM_AXIS Veh_Spd DC_VEHSPD_KMH_U16 16 0.00 4095.938 AXIS_PTS_REF VCANV16 /end AXIS_DESCR
 /begin AXIS_DESCR COM_AXIS CoolFan_MAF_Req DC_CNTR_U16 16 0.00 65535.00 AXIS_PTS_REF sst_TM_CoolFan_MAF_Req /end AXIS_DESCR
/end CHARACTERISTIC
/begin CHARACTERISTIC KL_TM_Luefter8 "" MAP 0x1D0074 dc_GKfWSw 200.0031 DC_PCT_S16 -100.0031 100.0000 FORMAT "%8.4"
 /begin AXIS_DESCR COM_AXIS Veh_Spd DC_VEHSPD_KMH_U16 16 0.00 4095.938 AXIS_PTS_REF VCANV16 /end AXIS_DESCR
 /begin AXIS_DESCR COM_AXIS CoolFan_MAF_Req DC_CNTR_U16 16 0.00 65535.00 AXIS_PTS_REF sst_TM_CoolFan_MAF_Req /end AXIS_DESCR
/end CHARACTERISTIC
/begin CHARACTERISTIC KUMSRL "Umrechnungskonstante von Massenstrom in relative Luftf¸llung" VALUE 0x1C6965 KwUb 0.00199218750 kumsrl_ub_b0p002 0.00 0.00199218750 FORMAT "%13.11" /end CHARACTERISTIC
/begin CHARACTERISTIC LAMTEMN "minimale Lambda-Schwelle, bei der die Tankentl¸ftung aktiv sein kann" VALUE 0x1CE15A KwUw 15.99976 fak_uw_b16 0.00 15.99976 FORMAT "%8.5" /end CHARACTERISTIC
/begin CHARACTERISTIC LAMTEMX "maximale Lambda-Schwelle, bei der die Tankentl¸ftung aktiv sein kann" VALUE 0x1CE15C KwUw 15.99976 fak_uw_b16 0.00 15.99976 FORMAT "%8.5" /end CHARACTERISTIC
/begin CHARACTERISTIC MBIT_DAT_UC "" VAL_BLK 0x1C2890 KwbUb 255.0 dez 0.00 255.0 FORMAT "%5.1" NUMBER 16 /end CHARACTERISTIC
/begin CHARACTERISTIC MCTR_DAT_UC "" VAL_BLK 0x1C28A0 KwbUb 255.0 dez 0.00 255.0 FORMAT "%5.1" NUMBER 16 /end CHARACTERISTIC
/begin CHARACTERISTIC MDMSR_DAT_UC "" VAL_BLK 0x1C28B0 KwbUb 255.0 dez 0.00 255.0 FORMAT "%5.1" NUMBER 16 /end CHARACTERISTIC
/begin CHARACTERISTIC MDNORM "Maximales indiziertes Motormoment f¸r Moment-Normierung" VALUE 0x1CEF77 KwUb 2550. md_ub_q10 0.00 2550. FORMAT "%5.0" /end CHARACTERISTIC
/begin CHARACTERISTIC MDSGS_DAT_UC "" VAL_BLK 0x1C28C0 KwbUb 255.0 dez 0.00 255.0 FORMAT "%5.1" NUMBER 16 /end CHARACTERISTIC
/begin AXIS_PTS MDV08_UC "St¸tzstellenverteilung f¸r Moment im Befehlstest" 0x1C2C9C mz_uc SstAUbSstUb 99.61 rel_ub_b99p6 8 0.00 99.61 FORMAT "%5.2" DEPOSIT ABSOLUTE /end AXIS_PTS
/begin CHARACTERISTIC MIFA_DAT_UC "" VAL_BLK 0x1C28D0 KwbUb 99.61 rel_ub_q0p3906 0.00 99.61 FORMAT "%5.2" NUMBER 16 /end CHARACTERISTIC
/begin CHARACTERISTIC MSDKLMMN "minimaler Massenstrom ¸ber Drosselklappe in TE" VALUE 0x1C56E8 KwUw 6553.500 m_uw_b6553p5 0.00 6553.500 FORMAT "%8.3" /end CHARACTERISTIC
/begin CHARACTERISTIC MSRC_D_UC "" VAL_BLK 0x1C28E0 KwbUb 255.0 dez 0.00 255.0 FORMAT "%5.1" NUMBER 16 /end CHARACTERISTIC
/begin CHARACTERISTIC MSRC_T_UC "Fehlerzeit f¸r MSR-Eingriff-‹berwachung des Befehlstests" VALUE 0x1C2BD6 KwUb 10200.0 t40ms_ub_b10200 0.00 10200.0 FORMAT "%7.1" /end CHARACTERISTIC
/begin CHARACTERISTIC MVER_D_UC "" VAL_BLK 0x1C28F0 KwbUb 255.0 dez 0.00 255.0 FORMAT "%5.1" NUMBER 16 /end CHARACTERISTIC
/begin CHARACTERISTIC MVER_T_UC "Fehlerzeit beim Momentenvergleich im Befehlstest" VALUE 0x1C2BD8 KwUb 10200.0 t40ms_ub_b10200 0.00 10200.0 FORMAT "%7.1" /end CHARACTERISTIC
/begin CHARACTERISTIC MZFFIL_UC "Filter-Zeitkonstante f¸r verzˆgertes Moment im Befehlstest" VALUE 0x1C2BD9 KwUb 10159.4 zk40ms_ub_b10200 40.6299 10200.0 FORMAT "%7.1" /end CHARACTERISTIC
/begin CHARACTERISTIC MZFPTR_DAT_UC "" VAL_BLK 0x1C2900 KwbUb 255.0 dez 0.00 255.0 FORMAT "%5.1" NUMBER 16 /end CHARACTERISTIC
/begin CHARACTERISTIC MZFREG_DAT_UC "" MAP 0x1C2910 KfWUb 255.0 dez 0.00 255.0 FORMAT "%5.1"
 /begin AXIS_DESCR FIX_AXIS x_uc dez 16 0.00 15.00 FORMAT "%5.2" FIX_AXIS_PAR 0 0 16 /end AXIS_DESCR
 /begin AXIS_DESCR FIX_AXIS y_uc dez 8 0.00 7.000 FORMAT "%5.3" FIX_AXIS_PAR 0 0 8 /end AXIS_DESCR
/end CHARACTERISTIC
/begin CHARACTERISTIC MZFTV_UC "Verzugszeit f¸r zul‰ssiges Moment mz_um im Befehlstest" VALUE 0x1C2BDA KwUb 280.000 t40ms_ub_b10200 40.0000 320.000 FORMAT "%7.3" /end CHARACTERISTIC
/begin CHARACTERISTIC MZF_DAT_UC "" VAL_BLK 0x1C2990 KwbUb 99.61 rel_ub_q0p3906 0.00 99.61 FORMAT "%5.2" NUMBER 16 /end CHARACTERISTIC
/begin CHARACTERISTIC MZL_DAT_UC "" VAL_BLK 0x1C29A0 KwbUb 0.3891 rel_ub_q0p00153 0.00 0.3891 NUMBER 16 /end CHARACTERISTIC
/begin CHARACTERISTIC M_BZMSR_UC "" VALUE 0x1C2BD7 KwUb 255.0 dez 0.00 255.0 FORMAT "%5.1" /end CHARACTERISTIC
/begin CHARACTERISTIC NFLAGS_D_UC "" VAL_BLK 0x1C29B0 KwbUb 255.0 dez 0.00 255.0 FORMAT "%5.1" NUMBER 16 /end CHARACTERISTIC
/begin AXIS_PTS NISTV08 "Drehzahlst¸tzstellenverteilung" 0x1D1692 Eng_Spd dc_SstAUwSstSw 32767.5 DC_ROTSPD_S16 8 -16384.0 16383.5 FORMAT "%7.1" DEPOSIT ABSOLUTE /end AXIS_PTS
/begin CHARACTERISTIC NMOT_DAT_UC "" VAL_BLK 0x1C29C0 KwbUb 10200. nmot_ub_q40 0.00 10200. FORMAT "%5.0" NUMBER 16 /end CHARACTERISTIC
/begin AXIS_PTS NMV08_UC "St¸tzstellenverteilung f¸r Motordrehzahl im Befehlstest" 0x1C29D0 nmot_uc SstAUbSstUb 10200. nmot_ub_q40 8 0.00 10200. FORMAT "%5.0" DEPOSIT ABSOLUTE /end AXIS_PTS
/begin CHARACTERISTIC NUSGS_DAT_UC "" VAL_BLK 0x1C29DC KwbUb 255.0 dez 0.00 255.0 FORMAT "%5.1" NUMBER 16 /end CHARACTERISTIC
/begin CHARACTERISTIC NVERZMN "minimale Drehzahl f¸r Verzˆgerung" VALUE 0x1C56EA KwUw 16383.75 nmot_uw_q0p25 0.00 16383.75 FORMAT "%8.2" /end CHARACTERISTIC
/begin AXIS_PTS NZWV08_UC "" 0x1C29EC nmot_uc SstAUbSstUb 10200. nmot_ub_q40 8 0.00 10200. FORMAT "%5.0" DEPOSIT ABSOLUTE /end AXIS_PTS
/begin CHARACTERISTIC REAC_D1_UC "" VAL_BLK 0x1C29F8 KwbUb 255.0 dez 0.00 255.0 FORMAT "%5.1" NUMBER 16 /end CHARACTERISTIC
/begin CHARACTERISTIC REAC_D2_UC "" VAL_BLK 0x1C2A08 KwbUb 255.0 dez 0.00 255.0 FORMAT "%5.1" NUMBER 16 /end CHARACTERISTIC
/begin CHARACTERISTIC REAC_T1_UC "Fehlerzeit bei der Funktions-Fehlerreaktions¸berwachung im Befehlstest" VALUE 0x1C2CB9 KwUb 10200.0 t40ms_ub_b10200 0.00 10200.0 FORMAT "%7.1" /end CHARACTERISTIC
/begin CHARACTERISTIC REAC_T2_UC "Fehlerzeit bei der Funktions¸berwachungs-Fehlerreaktions¸berw. im Befehlstest" VALUE 0x1C2CBA KwUb 10200.0 t40ms_ub_b10200 0.00 10200.0 FORMAT "%7.1" /end CHARACTERISTIC
/begin CHARACTERISTIC RFLAGS_D_UC "" VAL_BLK 0x1C2A18 KwbUb 255.0 dez 0.00 255.0 FORMAT "%5.1" NUMBER 16 /end CHARACTERISTIC
/begin AXIS_PTS RLV08_UC "Stutzstellenverteilung f¸r Lastinfo im Befehlstest" 0x1C2A28 rl_uc SstAUbSstUb 191.3 rel_ub_q0p75 8 0.00 191.3 FORMAT "%5.1" DEPOSIT ABSOLUTE /end AXIS_PTS
/begin CHARACTERISTIC RL_DAT_UC "" VAL_BLK 0x1C2A34 KwbUb 191.3 rel_ub_q0p75 0.00 191.3 FORMAT "%5.1" NUMBER 16 /end CHARACTERISTIC
/begin AXIS_PTS SDK10TEUB "wdkba abh‰ngige St¸tzstellen (Anzahl 10)" 0x1CEDA4 wdkba SstAUbSstUb 100.0 relDK_ub_b100 10 0.00 100.0 FORMAT "%5.1" DEPOSIT ABSOLUTE /end AXIS_PTS
/begin CHARACTERISTIC SFLAGS_D_UC "" VAL_BLK 0x1C2A44 KwbUb 255.0 dez 0.00 255.0 FORMAT "%5.1" NUMBER 16 /end CHARACTERISTIC
/begin AXIS_PTS SFR05TEUB "frmit abh‰ngige St¸tzstellen (Anzahl 5)" 0x1CEDB8 frmit SstAUbSstUb 1.992 fak_ub_b2 5 0.00 1.992 FORMAT "%5.3" DEPOSIT ABSOLUTE /end AXIS_PTS
/begin CHARACTERISTIC SGSC_D_UC "" VAL_BLK 0x1C2A54 KwbUb 255.0 dez 0.00 255.0 FORMAT "%5.1" NUMBER 16 /end CHARACTERISTIC
/begin CHARACTERISTIC SGSC_T_UC "Fehlerzeit f¸r SGS-Eingriff-‹berwachung des Befehlstestes" VALUE 0x1C2CBC KwUb 10200.0 t40ms_ub_b10200 0.00 10200.0 FORMAT "%7.1" /end CHARACTERISTIC
/begin CHARACTERISTIC SKA_DRHZ_UC "" VALUE 0x1C2CBB KwUb 10200. nmot_ub_q40 0.00 10200. FORMAT "%5.0" /end CHARACTERISTIC
/begin AXIS_PTS SML06TEUB "ml abh‰ngige St¸tzstellen (Anzahl 6)" 0x1CEDD4 ml SstAUbSstUb 1020. m_ub_b1020 6 0.00 1020. FORMAT "%5.0" DEPOSIT ABSOLUTE /end AXIS_PTS
/begin AXIS_PTS SNM10TEUB "nmot abh‰ngige St¸tzstellen (Anzahl 10)" 0x1CEE04 nmot SstAUbSstUb 10200. nmot_ub_q40 10 0.00 10200. FORMAT "%5.0" DEPOSIT ABSOLUTE /end AXIS_PTS
/begin AXIS_PTS SPSNV08_UC "St¸tzstellenverteilung f¸r Pedalwert im Befehlstest" 0x1C2A64 spsn_uc SstAUbSstUb 4.980 spg_ub_q0p019 8 0.00 4.980 FORMAT "%5.3" DEPOSIT ABSOLUTE /end AXIS_PTS
/begin CHARACTERISTIC SPSN_DAT_UC "" VAL_BLK 0x1C2A70 KwbUb 4.980 spg_ub_q0p019 0.00 4.980 FORMAT "%5.3" NUMBER 16 /end CHARACTERISTIC
/begin AXIS_PTS SQM05TEUB "Luftmassenquotient-abh‰ngige St¸tzstellen (Anzahl =5)" 0x1C67F0 qmsdyn SstAUbSstUb 15.94 fak_ub_b16 5 0.00 15.94 FORMAT "%5.2" DEPOSIT ABSOLUTE /end AXIS_PTS
/begin AXIS_PTS sst_TM_CAF_CT_AC_MAF_Req "" 0x1D1748 AC_MAF_Req dc_SstAUbSstUb 255. DC_SD1_U8MB 8 0.00 255. FORMAT "%4.0" DEPOSIT ABSOLUTE /end AXIS_PTS
/begin AXIS_PTS sst_TM_CAF_CT_CoolFanSpd_Req "" 0x1D1752 TM_CAF_CT_CoolFanSpd_Req dc_SstAUwSstSw 200.0031 DC_PER0327 8 -100.0031 100.0000 FORMAT "%8.4" DEPOSIT ABSOLUTE /end AXIS_PTS
/begin AXIS_PTS sst_TM_CAF_CT_ECU_Temp "" 0x1D1764 TM_ECU_Temp dc_SstAUwSstSw 8191.875 DC_TEMP_S16 8 -4096.000 4095.875 FORMAT "%8.3" DEPOSIT ABSOLUTE /end AXIS_PTS
/begin AXIS_PTS sst_TM_CAF_CT_EngLoad "" 0x1D1776 TM_CAF_CT_EngLoad_sstIn dc_SstAUwSstSw 200.0031 DC_PCT_S16 8 -100.0031 100.0000 FORMAT "%8.4" DEPOSIT ABSOLUTE /end AXIS_PTS
/begin AXIS_PTS sst_TM_CAF_CT_ETC "" 0x1D1788 TM_CAF_CT_ETC_sstIn dc_SstAUwSstSw 8191.875 DC_TEMP_S16 8 -4096.000 4095.875 FORMAT "%8.3" DEPOSIT ABSOLUTE /end AXIS_PTS
/begin AXIS_PTS sst_TM_CAF_CT_ETC_C_Setpoint "" 0x1D179A TM_CAF_CT_ETC_C_Setpoint dc_SstAUwSstSw 8191.875 DC_TEMP_S16 8 -4096.000 4095.875 FORMAT "%8.3" DEPOSIT ABSOLUTE /end AXIS_PTS
/begin AXIS_PTS sst_TM_CAF_CT_ExtAir_Temp "" 0x1D17AC TM_CAF_CT_ExtAir_Temp_S dc_SstAUwSstSw 8191.875 DC_TEMP_S16 8 -4096.000 4095.875 FORMAT "%8.3" DEPOSIT ABSOLUTE /end AXIS_PTS
/begin AXIS_PTS sst_TM_CAF_CT_IntkAir_Temp "" 0x1D17BE IntkAir_Temp dc_SstAUwSstSw 8191.875 temp_sw_q1p25Em1 8 -4096.000 4095.875 FORMAT "%8.3" DEPOSIT ABSOLUTE /end AXIS_PTS
/begin AXIS_PTS sst_TM_CAF_CT_MAF "" 0x1D17D0 MAF dc_SstAUwSstUw 65535.00 m_ub_q1p0 16 0.00 65535.00 FORMAT "%8.2" DEPOSIT ABSOLUTE /end AXIS_PTS
/begin AXIS_PTS sst_TM_CAF_CT_Sen_Oil_Temp "" 0x1D17F2 Sen_Oil_Temp dc_SstAUwSstSw 8191.875 temp_sw_q1p25Em1 8 -4096.000 4095.875 FORMAT "%8.3" DEPOSIT ABSOLUTE /end AXIS_PTS
/begin AXIS_PTS sst_TM_CoolFan_MAF_Req "" 0x1D1804 CoolFan_MAF_Req dc_SstAUwSstUw 65535.00 DC_CNTR_U16 16 0.00 65535.00 FORMAT "%8.2" DEPOSIT ABSOLUTE /end AXIS_PTS
/begin AXIS_PTS sst_TM_Cyl_FIRate "" 0x1D1826 TM_Cyl_FIRate_sstIn dc_SstAUwSstUw 1.999969 DC_FKT32768 16 0.00 1.999969 FORMAT "%8.6" DEPOSIT ABSOLUTE /end AXIS_PTS
/begin CHARACTERISTIC SWPEDNOT "Pedal-Sollwert-Schwelle f¸r Anfahren im 2. Gang" VALUE 0x1CF020 KwUw 99.99847 rel_uw_b100 0.00 99.99847 FORMAT "%8.5" /end CHARACTERISTIC
/begin CHARACTERISTIC TEMIN "minimales TE" VALUE 0x1C6960 KwWU32 540.000000000 t1p0usxms 0.00 540.000000000 FORMAT "%13.9" /end CHARACTERISTIC
/begin CHARACTERISTIC TFLAGS_D_UC "" VAL_BLK 0x1C2A80 KwbUb 255.0 dez 0.00 255.0 FORMAT "%5.1" NUMBER 16 /end CHARACTERISTIC
/begin CHARACTERISTIC TFTEINI "Zeit f¸r Erkennung TE Stop" VALUE 0x1C56EC KwUw 6553.500 t100msxs_uw_b6553p5 0.00 6553.500 FORMAT "%8.3" /end CHARACTERISTIC
/begin CHARACTERISTIC TMSTTE "Starttemperaturschwelle, bei der die TE sofort aktiv werden kann" VALUE 0x1CE157 KwUb 191.3 temp_ub_q0p75_o48 -48.00 143.3 FORMAT "%5.1" /end CHARACTERISTIC
/begin CHARACTERISTIC TMTE "TMOT - Schwelle f¸r Tankentl¸ftung" VALUE 0x1CE158 KwUb 191.3 temp_ub_q0p75_o48 -48.00 143.3 FORMAT "%5.1" /end CHARACTERISTIC
/begin CHARACTERISTIC TM_DissHeatFlowVehSpdV08 "" CURVE 0x1D13C4 dc_GKlWUw 65535.00 DC_CNTR_U16 0.00 65535.00 FORMAT "%8.2"
 /begin AXIS_DESCR COM_AXIS Veh_Spd DC_VEHSPD_KMH_U16 16 0.00 4095.938 AXIS_PTS_REF VCANV16 /end AXIS_DESCR
/end CHARACTERISTIC
/begin AXIS_PTS TM_ECF_sstVolFlowV08 "" 0x1D187C ECF_VolFlow dc_SstAUwSstUw 65535. DC_FLOW_U16 8 0.00 65535. FORMAT "%6.0" DEPOSIT ABSOLUTE /end AXIS_PTS
/begin CHARACTERISTIC TM_ECPThermostatOutV08 "" CURVE 0x1D13B4 dc_GKlWUw 65535. DC_FLOW_U16 0.00 65535. FORMAT "%6.0"
 /begin AXIS_DESCR COM_AXIS ECTOut temp_sw_q1p25Em1 8 -4096.000 4095.875 AXIS_PTS_REF TM_ECP_sstECTOutV08 /end AXIS_DESCR
/end CHARACTERISTIC
/begin CHARACTERISTIC TM_ECP_EngSpdLdV08 "" MAP 0x1D2CDA dc_GKfWSw 8191.8750 DC_PWR_S16 -4096.0000 4095.8750
 /begin AXIS_DESCR COM_AXIS Eng_Spd DC_ROTSPD_S16 8 -16384.0 16383.5 AXIS_PTS_REF NISTV08 /end AXIS_DESCR
 /begin AXIS_DESCR COM_AXIS TM_CAF_CT_EngLoad_sstIn DC_PCT_S16 8 -100.0031 100.0000 AXIS_PTS_REF sst_TM_CAF_CT_EngLoad /end AXIS_DESCR
/end CHARACTERISTIC
/begin AXIS_PTS TM_ECP_sstECTOutV08 "" 0x1D188E ECTOut dc_SstAUwSstSw 8191.875 temp_sw_q1p25Em1 8 -4096.000 4095.875 FORMAT "%8.3" DEPOSIT ABSOLUTE /end AXIS_PTS
/begin AXIS_PTS TM_ECP_sstVolFlowV08 "" 0x1D18A0 TM_ECP_VolFlow dc_SstAUwSstUw 65535. DC_FLOW_U16 8 0.00 65535. FORMAT "%6.0" DEPOSIT ABSOLUTE /end AXIS_PTS
/begin CHARACTERISTIC TM_ECP_VolFlowLCirV08 "" MAP 0x1D12B4 dc_GKfWUw 65535. DC_FLOW_U16 0.00 65535. FORMAT "%6.0"
 /begin AXIS_DESCR COM_AXIS ECF_VolFlow DC_FLOW_U16 8 0.00 65535. AXIS_PTS_REF TM_ECF_sstVolFlowV08 /end AXIS_DESCR
 /begin AXIS_DESCR COM_AXIS TM_ECP_VolFlow DC_FLOW_U16 8 0.00 65535. AXIS_PTS_REF TM_ECP_sstVolFlowV08 /end AXIS_DESCR
/end CHARACTERISTIC
/begin CHARACTERISTIC TM_ECP_VolFlowSCirV08 "" MAP 0x1D1334 dc_GKfWUw 65535. DC_FLOW_U16 0.00 65535. FORMAT "%6.0"
 /begin AXIS_DESCR COM_AXIS ECF_VolFlow DC_FLOW_U16 8 0.00 65535. AXIS_PTS_REF TM_ECF_sstVolFlowV08 /end AXIS_DESCR
 /begin AXIS_DESCR COM_AXIS TM_ECP_VolFlow DC_FLOW_U16 8 0.00 65535. AXIS_PTS_REF TM_ECP_sstVolFlowV08 /end AXIS_DESCR
/end CHARACTERISTIC
/begin CHARACTERISTIC TM_ECP_VolFlowV08 "" MAP 0x1D13E4 dc_GKfWUw 65535. DC_FLOW_U16 0.00 65535. FORMAT "%6.0"
 /begin AXIS_DESCR COM_AXIS TM_DissHeatFlowCl DC_PWR_S16 8 0.00 8191.8750 AXIS_PTS_REF TM_sstDissHeatFlowClV08 /end AXIS_DESCR
 /begin AXIS_DESCR COM_AXIS TM_DissHeatFlowFan DC_CNTR_U16 8 0.00 65535.00 AXIS_PTS_REF TM_sstDissHeatFlowFanV08 /end AXIS_DESCR
/end CHARACTERISTIC
/begin CHARACTERISTIC TM_EM_DEM_Emis_AdjustV08 "" CURVE 0x1D2D6A dc_GKlWSw 3.984375 DC_FCTR_128_S16 -1.992188 1.992188 FORMAT "%8.6"
 /begin AXIS_DESCR COM_AXIS ECTOut temp_sw_q1p25Em1 8 -4096.000 4095.875 AXIS_PTS_REF TM_EM_DEM_sst_ECTOutV08 /end AXIS_DESCR
/end CHARACTERISTIC
/begin CHARACTERISTIC TM_EM_DEM_EngSpdLd_VolFlowV08 "" MAP 0x1D2D7A dc_GKfWUw 65535. DC_FLOW_U16 0.00 65535. FORMAT "%6.0"
 /begin AXIS_DESCR COM_AXIS Eng_Spd DC_ROTSPD_S16 8 -16384.0 16383.5 AXIS_PTS_REF NISTV08 /end AXIS_DESCR
 /begin AXIS_DESCR COM_AXIS TM_CAF_CT_EngLoad_sstIn DC_PCT_S16 8 -100.0031 100.0000 AXIS_PTS_REF sst_TM_CAF_CT_EngLoad /end AXIS_DESCR
/end CHARACTERISTIC
/begin AXIS_PTS TM_EM_DEM_sst_ECTOutV08 "" 0x1D18B2 ECTOut dc_SstAUwSstSw 8191.875 temp_sw_q1p25Em1 8 -4096.000 4095.875 FORMAT "%8.3" DEPOSIT ABSOLUTE /end AXIS_PTS
/begin CHARACTERISTIC TM_EngSpdLd_PCMainV08 "" MAP 0x1D2ACA dc_GKfWUw 65535. DC_FLOW_U16 0.00 65535. FORMAT "%6.0"
 /begin AXIS_DESCR COM_AXIS Eng_Spd DC_ROTSPD_S16 8 -16384.0 16383.5 AXIS_PTS_REF NISTV08 /end AXIS_DESCR
 /begin AXIS_DESCR COM_AXIS TM_CAF_CT_EngLoad_sstIn DC_PCT_S16 8 -100.0031 100.0000 AXIS_PTS_REF sst_TM_CAF_CT_EngLoad /end AXIS_DESCR
/end CHARACTERISTIC
/begin CHARACTERISTIC TM_EngSpdLd_PCSupV08 "" MAP 0x1D2B4A dc_GKfWUw 65535. DC_FLOW_U16 0.00 65535. FORMAT "%6.0"
 /begin AXIS_DESCR COM_AXIS Eng_Spd DC_ROTSPD_S16 8 -16384.0 16383.5 AXIS_PTS_REF NISTV08 /end AXIS_DESCR
 /begin AXIS_DESCR COM_AXIS TM_CAF_CT_EngLoad_sstIn DC_PCT_S16 8 -100.0031 100.0000 AXIS_PTS_REF sst_TM_CAF_CT_EngLoad /end AXIS_DESCR
/end CHARACTERISTIC
/begin AXIS_PTS TM_sstDissHeatFlowClV08 "" 0x1D18C4 TM_DissHeatFlowCl dc_SstAUwSstUw 8191.8750 DC_PWR_S16 8 0.00 8191.8750 DEPOSIT ABSOLUTE /end AXIS_PTS
/begin AXIS_PTS TM_sstDissHeatFlowFanV08 "" 0x1D18D6 TM_DissHeatFlowFan dc_SstAUwSstUw 65535.00 DC_CNTR_U16 8 0.00 65535.00 FORMAT "%8.2" DEPOSIT ABSOLUTE /end AXIS_PTS
/begin AXIS_PTS TM_sstExtAirTV08 "" 0x1D18E8 ExtAir_Temp dc_SstAUwSstSw 65535.00 DC_UTMP_40 8 -32808.00 32727.00 FORMAT "%8.2" DEPOSIT ABSOLUTE /end AXIS_PTS
/begin CHARACTERISTIC TM_TMP_SP_ECTEnspl_SpV08 "" MAP 0x1D2F1C dc_GKfWSw 8191.875 DC_TEMP_S16 -4096.000 4095.875 FORMAT "%8.3"
 /begin AXIS_DESCR COM_AXIS Eng_Spd DC_ROTSPD_S16 8 -16384.0 16383.5 AXIS_PTS_REF NISTV08 /end AXIS_DESCR
 /begin AXIS_DESCR COM_AXIS TM_CAF_CT_EngLoad_sstIn DC_PCT_S16 8 -100.0031 100.0000 AXIS_PTS_REF sst_TM_CAF_CT_EngLoad /end AXIS_DESCR
/end CHARACTERISTIC
/begin CHARACTERISTIC TM_TMP_SP_ECTExAiT_SpV08 "" CURVE 0x1D2E0C dc_GKlWSw 8191.875 DC_TEMP_S16 -4096.000 4095.875 FORMAT "%8.3"
 /begin AXIS_DESCR COM_AXIS ExtAir_Temp DC_UTMP_40 8 -32808.00 32727.00 AXIS_PTS_REF TM_TMP_SP_sstExAiTV08 /end AXIS_DESCR
/end CHARACTERISTIC
/begin CHARACTERISTIC TM_TMP_SP_ECTInEnspl_SpV08 "" MAP 0x1D2E1C dc_GKfWSw 8191.875 DC_TEMP_S16 -4096.000 4095.875 FORMAT "%8.3"
 /begin AXIS_DESCR COM_AXIS Eng_Spd DC_ROTSPD_S16 8 -16384.0 16383.5 AXIS_PTS_REF NISTV08 /end AXIS_DESCR
 /begin AXIS_DESCR COM_AXIS TM_CAF_CT_EngLoad_sstIn DC_PCT_S16 8 -100.0031 100.0000 AXIS_PTS_REF sst_TM_CAF_CT_EngLoad /end AXIS_DESCR
/end CHARACTERISTIC
/begin CHARACTERISTIC TM_TMP_SP_ECTInExAiT_SpV08 "" CURVE 0x1D2DFC dc_GKlWSw 8191.875 DC_TEMP_S16 -4096.000 4095.875 FORMAT "%8.3"
 /begin AXIS_DESCR COM_AXIS ExtAir_Temp DC_UTMP_40 8 -32808.00 32727.00 AXIS_PTS_REF TM_TMP_SP_sstExAiTV08 /end AXIS_DESCR
/end CHARACTERISTIC
/begin CHARACTERISTIC TM_TMP_SP_OilTEnspl_SpV08 "" MAP 0x1D2E9C dc_GKfWSw 8191.875 DC_TEMP_S16 -4096.000 4095.875 FORMAT "%8.3"
 /begin AXIS_DESCR COM_AXIS Eng_Spd DC_ROTSPD_S16 8 -16384.0 16383.5 AXIS_PTS_REF NISTV08 /end AXIS_DESCR
 /begin AXIS_DESCR COM_AXIS TM_CAF_CT_EngLoad_sstIn DC_PCT_S16 8 -100.0031 100.0000 AXIS_PTS_REF sst_TM_CAF_CT_EngLoad /end AXIS_DESCR
/end CHARACTERISTIC
/begin AXIS_PTS TM_TMP_SP_sstExAiTV08 "" 0x1D18FA ExtAir_Temp dc_SstAUwSstSw 65535.00 DC_UTMP_40 8 -32808.00 32727.00 FORMAT "%8.2" DEPOSIT ABSOLUTE /end AXIS_PTS
/begin CHARACTERISTIC TM_VehSpdExATAdjV08 "" MAP 0x1D2BCA dc_GKfWSw 3.984375 DC_FCTR_128_S16 -1.992188 1.992188 FORMAT "%8.6"
 /begin AXIS_DESCR COM_AXIS Veh_Spd DC_VEHSPD_KMH_U16 16 0.00 4095.938 AXIS_PTS_REF VCANV16 /end AXIS_DESCR
 /begin AXIS_DESCR COM_AXIS ExtAir_Temp DC_UTMP_40 8 -32808.00 32727.00 AXIS_PTS_REF TM_sstExtAirTV08 /end AXIS_DESCR
/end CHARACTERISTIC
/begin CHARACTERISTIC TQTEAB "Zeit f¸r Absteuerung Sp¸lrate Tankentl¸ftung" VALUE 0x1C5691 KwUb 81.28 t20msxs_ub_q0p32 0.3200 81.60 FORMAT "%5.2" /end CHARACTERISTIC
/begin CHARACTERISTIC TQTEDAB "Zeit f¸r schnelle Absteuerung Sp¸lrate Tankentl¸ftung" VALUE 0x1C5692 KwUb 81.28 t20msxs_ub_q0p32 0.3200 81.60 FORMAT "%5.2" /end CHARACTERISTIC
/begin CHARACTERISTIC TTEAUS "Zeit nach Start bis TEB aktiv wird" VALUE 0x1CE15E KwUw 195.0000 t100msxs_uw_q100 5.000000 200.0000 FORMAT "%8.4" /end CHARACTERISTIC
/begin CHARACTERISTIC TUETM "Zeit¸bertemperatur nach Start" VALUE 0x1C6652 KwUw 655.3500 t_q0p01 0.00 655.3500 FORMAT "%8.4" /end CHARACTERISTIC
/begin CHARACTERISTIC TVAGRFTE "Verzˆgerungszeit f¸r Freigabe der AGR nach einer Sperrung" VALUE 0x1CE0DD KwUb 25.50 t100msxs_ub_b25p5 0.00 25.50 FORMAT "%5.2" /end CHARACTERISTIC
/begin CHARACTERISTIC TVP "Verzˆgerungszeit Fehlerverifizierung Endstufendiagnose ME(D) 9" VALUE 0x1C6966 KwUb 255.0 dez 0.00 255.0 FORMAT "%5.1" /end CHARACTERISTIC
/begin CHARACTERISTIC TVSATEM "Verzˆgerungszeit f¸r TEV zu nach SA-Bereitschaft" CURVE 0x1C5694 KlAUbSstUbWUb 5.100 t20msxs_ub_b5p1 0.00 5.100 FORMAT "%5.3"
 /begin AXIS_DESCR STD_AXIS tmot temp_ub_q0p75_o48 6 -48.00 143.3 FORMAT "%5.1" DEPOSIT ABSOLUTE /end AXIS_DESCR
/end CHARACTERISTIC
/begin CHARACTERISTIC UETMOT "Motor¸bertemperatur-Schwelle" VALUE 0x1C6651 KwUb 191.3 temp_ub_q0p75_o48 -48.00 143.3 FORMAT "%5.1" /end CHARACTERISTIC
/begin CHARACTERISTIC UPWGO "Oberer PWG-Spannungswert f¸r Umnormierung auf Pedalwert" VALUE 0x1C6967 KwUb 4.980 spg_ub_b5 0.00 4.980 FORMAT "%5.3" /end CHARACTERISTIC
/begin CHARACTERISTIC UPWGU "Unterer PWG-Spannungswert f¸r Umnormierung auf Pedalwert" VALUE 0x1C6968 KwUb 4.980 spg_ub_b5 0.00 4.980 FORMAT "%5.3" /end CHARACTERISTIC
/begin AXIS_PTS VCANV16 "St¸tzstellenverteilung v_can" 0x1D1918 Veh_Spd dc_SstAUwSstUw 4095.938 DC_VEHSPD_KMH_U16 16 0.00 4095.938 FORMAT "%8.3" DEPOSIT ABSOLUTE /end AXIS_PTS
/begin CHARACTERISTIC VFGR_DAT_UC "" VAL_BLK 0x1C2B20 KwbUw 4095.938 vfzg_uw_q0p0625 0.00 4095.938 FORMAT "%8.3" NUMBER 16 /end CHARACTERISTIC
/begin CHARACTERISTIC VMIN_UC "Minimalgeschwindigkeit f¸r FGR-Betrieb im Befehlstest" VALUE 0x1C2B42 KwUw 511.9922 vfzg_uw_q0p00781 0.00 511.9922 FORMAT "%8.4" /end CHARACTERISTIC
/begin CHARACTERISTIC VMIN_UM "Minimalgeschwindigkeit f¸r FGR-Betrieb in der Funktions¸berwachung" VALUE 0x1C7D00 KwUw 511.9922 vfzg_uw_q0p00781 0.00 511.9922 FORMAT "%8.4" /end CHARACTERISTIC
/begin CHARACTERISTIC ZBTEML "Integrationsgeschwindigkeit Beladungsfaktor" CURVE 0x1CE0E0 GklWUb 6.101 perio_ub_b6p125 0.00 6.101 FORMAT "%5.3" /begin AXIS_DESCR COM_AXIS ml m_ub_b1020 6 0.00 1020. AXIS_PTS_REF SML06TEUB /end AXIS_DESCR /end CHARACTERISTIC
/begin CHARACTERISTIC ZETATE "Rampensteilheit f¸r Ver‰nderung Motorwirkungsgrad durch Tankentl¸ftung" VALUE 0x1CE150 KwUw 1279.590 rgrad_uw_b1280 0.3906250 1279.980 FORMAT "%8.3" /end CHARACTERISTIC
/begin CHARACTERISTIC ZKFTEAD "Zeitkonstante gefilteter Faktor Beladung Sp¸lstrom bei Tankentl¸ftung" VALUE 0x1CE152 KwUw 6553.50000 zk100msxs_uw_b6553 0.100001526 6553.60000 FORMAT "%10.5" /end CHARACTERISTIC
/begin CHARACTERISTIC ZMLTE "Zeitkonstante f¸r ml-Filter in beladungsabh. Tankentl¸ftung" VALUE 0x1CE154 KwUw 6553.4999985 zk100msxs_uw_b655 0.10000152590 6553.6000000 FORMAT "%12.7" /end CHARACTERISTIC
/begin CHARACTERISTIC ZMSSGIN "Filterzeitkonstante f¸r Berechnung der relativen ƒnderung von mssgin_w" VALUE 0x1CE0E6 KwUb 25.4996 zk100msxs_ub_b25p5 0.100392 25.6000 FORMAT "%7.4" /end CHARACTERISTIC
/begin CHARACTERISTIC ZWOUT_DAT_UC "" VAL_BLK 0x1C2A90 KwbUb 191.3 zw_sb_q0p75 0.00 191.3 FORMAT "%5.1" NUMBER 16 /end CHARACTERISTIC
/begin MEASUREMENT acca_c_uc "" UBYTE t40ms_ub_b10200 1 100 0 10200 FORMAT "%7.1" ECU_ADDRESS 0x801065 /end MEASUREMENT
/begin MEASUREMENT acca_c_um "Fehlerz‰hler: Botschaftsabsicherung ACC-Botschaft" UBYTE t40ms_ub_b10200 1 100 0 10200 FORMAT "%7.1" ECU_ADDRESS 0x7F809D /end MEASUREMENT
/begin MEASUREMENT acca_c_ur "" UBYTE dez 1 100 0 255 FORMAT "%5.1" ECU_ADDRESS 0x7F81B2 /end MEASUREMENT
/begin MEASUREMENT accc_c_uc "" UBYTE t40ms_ub_b10200 1 100 0 10200 FORMAT "%7.1" ECU_ADDRESS 0x801066 /end MEASUREMENT
/begin MEASUREMENT accc_c_um "Fehlerz‰hler: Botschaftsabsicherung ACC-Botschaft" UBYTE t40ms_ub_b10200 1 100 0 10200 FORMAT "%7.1" ECU_ADDRESS 0x7F809E /end MEASUREMENT
/begin MEASUREMENT accc_c_ur "Doppelablage (DA) f¸r ACCC_C_UM" UBYTE dez 1 100 0 255 FORMAT "%5.1" ECU_ADDRESS 0x7F81B3 /end MEASUREMENT
/begin MEASUREMENT ACComprOff_FanMalf "" UBYTE DC_FLAG_U8 1 100 0 1 BIT_MASK 0x1 FORMAT "%5.3" ECU_ADDRESS 0x80362F /end MEASUREMENT
/begin MEASUREMENT AC_MAF_Req "" UBYTE DC_SD1_U8MB 1 100 0 255 FORMAT "%4.0" ECU_ADDRESS 0x803A2E /end MEASUREMENT
/begin MEASUREMENT ahkat "Mittelwert der Amplitude Sondensignal hinter Kat. korrigiert mit KB" UBYTE fak_ub_b1 1 100 0 0.996094 ECU_ADDRESS 0x80122A /end MEASUREMENT
/begin MEASUREMENT ahkat2 "Mittelwert der Amplitude Sondensignal hinter Kat. korrigiert mit KB (2.Bank)" UBYTE fak_ub_b1 1 100 0 0.996094 ECU_ADDRESS 0x80122B /end MEASUREMENT
/begin MEASUREMENT alc_old_uc "" UBYTE dez 1 100 0 255 FORMAT "%5.1" ECU_ADDRESS 0x801067 /end MEASUREMENT
/begin MEASUREMENT alc_old_um "" UBYTE dez 1 100 0 255 FORMAT "%5.1" ECU_ADDRESS 0x7F809F /end MEASUREMENT
/begin MEASUREMENT alc_old_ur "" UBYTE dez 1 100 0 255 FORMAT "%5.1" ECU_ADDRESS 0x7F81B4 /end MEASUREMENT
/begin MEASUREMENT alv_old_uc "" UBYTE dez 1 100 0 255 FORMAT "%5.1" ECU_ADDRESS 0x80106E /end MEASUREMENT
/begin MEASUREMENT anzeausb "Anzahl der auszublendenen Einspritzungen; begrenzt zwischen 4 und 7" UBYTE dez 1 100 0 255 FORMAT "%5.1" ECU_ADDRESS 0x80104A /end MEASUREMENT
/begin MEASUREMENT AS_ccv "" UBYTE B_TRUE 1 100 0 1 BIT_MASK 0x1 FORMAT "%13.11" ECU_ADDRESS 0x7FA8C0 /end MEASUREMENT
/begin MEASUREMENT AS_epee "Flash programing control" UBYTE B_TRUE 1 100 0 1 BIT_MASK 0x1 FORMAT "%13.11" ECU_ADDRESS 0x7FA8C1 /end MEASUREMENT
/begin MEASUREMENT AS_mar "margin MPC 555" UBYTE B_TRUE 1 100 0 1 BIT_MASK 0x1 FORMAT "%13.11" ECU_ADDRESS 0x7FA8C2 /end MEASUREMENT
/begin MEASUREMENT AS_wp "" UBYTE B_TRUE 1 100 0 1 BIT_MASK 0x1 FORMAT "%13.11" ECU_ADDRESS 0x7FA8C3 /end MEASUREMENT
/begin MEASUREMENT azlrdkt "Lambdaregler-Zwangsamplitude aus Kat-Diagnose" UBYTE fak_ub_b0p25 1 100 0 0.249023 FORMAT "%11.9" ECU_ADDRESS 0x80122C /end MEASUREMENT
/begin MEASUREMENT bfzgldsc_w "Fahrzeugl‰ngsbeschleunigung bereitgestellt vom DSC-SG" UWORD bfzg_uw_q0p025 1 100 0 1638.38 FORMAT "%8.3" ECU_ADDRESS 0x800CEE /end MEASUREMENT
/begin MEASUREMENT B_acc "Bedingung: ACC-Steuerger‰t vorhanden" UBYTE B_TRUE 1 100 0 1 BIT_MASK 0x1 FORMAT "%13.11" ECU_ADDRESS 0x7FC842 /end MEASUREMENT
/begin MEASUREMENT B_acc_bt "" UBYTE B_TRUE 1 100 0 1 BIT_MASK 0x1 FORMAT "%13.11" ECU_ADDRESS 0x7FA5FC /end MEASUREMENT
/begin MEASUREMENT B_agr "Bedingung AGR ein" UBYTE B_TRUE 1 100 0 1 BIT_MASK 0x1 FORMAT "%13.11" ECU_ADDRESS 0x7FA8C4 /end MEASUREMENT
/begin MEASUREMENT B_agrlrasp "Bedingung Sperren der Gemischadaption w‰hrend der AGR-Kennlinienadaption" UBYTE B_TRUE 1 100 0 1 BIT_MASK 0x1 FORMAT "%13.11" ECU_ADDRESS 0x7FA8C5 /end MEASUREMENT
/begin MEASUREMENT B_agrste "Bedingung AGR von Tankentl¸ftung gesperrt" UBYTE B_TRUE 1 100 0 1 BIT_MASK 0x1 FORMAT "%13.11" ECU_ADDRESS 0x7FA7DD /end MEASUREMENT
/begin MEASUREMENT B_ap_aktiv "" UBYTE B_TRUE 1 100 0 1 BIT_MASK 0x1 FORMAT "%13.11" ECU_ADDRESS 0x7F9B00 /end MEASUREMENT
/begin MEASUREMENT B_asc1cok "Bedingung CAN-ASC1-Botschaft empfangen" UBYTE B_TRUE 1 100 0 1 BIT_MASK 0x1 FORMAT "%13.11" ECU_ADDRESS 0x800E88 /end MEASUREMENT
/begin MEASUREMENT B_asc2cok "Bedingung ASC verbaut und ASC2-Botschaft vorhanden" UBYTE B_TRUE 1 100 0 1 BIT_MASK 0x1 FORMAT "%13.11" ECU_ADDRESS 0x800E89 /end MEASUREMENT
/begin MEASUREMENT B_asc_reg "CAN-Botschaft: ASC regelt (mit Bremsen-Eingriff)" UBYTE B_TRUE 1 100 0 1 BIT_MASK 0x1 FORMAT "%13.11" ECU_ADDRESS 0x800E8A /end MEASUREMENT
/begin MEASUREMENT B_asrext "Bedingung f¸r externe ASR-Anforderung" UBYTE B_TRUE 1 100 0 1 BIT_MASK 0x1 FORMAT "%13.11" ECU_ADDRESS 0x800E8B /end MEASUREMENT
/begin MEASUREMENT B_bkvmsisr "Bedingung Massenstrom ins Saugrohr aus Bermskraftverst‰rker" UBYTE B_TRUE 1 100 0 1 BIT_MASK 0x1 FORMAT "%13.11" ECU_ADDRESS 0x7FA8C6 /end MEASUREMENT
/begin MEASUREMENT B_bkvnkhab "Bedingung: LL-Drehzahl f¸r KH abschalten, da nicht gen¸gend Unterdruck in BKV" UBYTE B_TRUE 1 100 0 1 BIT_MASK 0x1 FORMAT "%13.11" ECU_ADDRESS 0x7FA8C7 /end MEASUREMENT
/begin MEASUREMENT B_bt "Bedingung Bauteileansteuerung  allgemein" UBYTE B_TRUE 1 100 0 1 BIT_MASK 0x1 FORMAT "%13.11" ECU_ADDRESS 0x7FA8C8 /end MEASUREMENT
/begin MEASUREMENT B_bteepcl "Bedingung Bauteileansteuerung;  EML-Lampe (enable)" UBYTE B_TRUE 1 100 0 1 BIT_MASK 0x1 FORMAT "%13.11" ECU_ADDRESS 0x7FA8C9 /end MEASUREMENT
/begin MEASUREMENT B_btekp "Bedingung Bauteileansteuerung; Elektrokraftstoffpumpe" UBYTE B_TRUE 1 100 0 1 BIT_MASK 0x1 FORMAT "%13.11" ECU_ADDRESS 0x7FA8CA /end MEASUREMENT
/begin MEASUREMENT B_btemil "Bedingung Bauteileansteuerung;  Fehlerlampe (MIL)" UBYTE B_TRUE 1 100 0 1 BIT_MASK 0x1 FORMAT "%13.11" ECU_ADDRESS 0x7FA8CB /end MEASUREMENT
/begin MEASUREMENT B_btepcl "Bedingung Bauteileansteuerung;  EML-Lampe" UBYTE B_TRUE 1 100 0 1 BIT_MASK 0x1 FORMAT "%13.11" ECU_ADDRESS 0x7FA8CC /end MEASUREMENT
/begin MEASUREMENT B_bthsh "Bedingung Bauteileansteuerung; LS-Heizung hinter Kat." UBYTE B_TRUE 1 100 0 1 BIT_MASK 0x1 FORMAT "%13.11" ECU_ADDRESS 0x7FA8CD /end MEASUREMENT
/begin MEASUREMENT B_bthsh2 "Bedingung Bauteileansteuerung; LS-Heizung hinter Kat. Bank 2" UBYTE B_TRUE 1 100 0 1 BIT_MASK 0x1 FORMAT "%13.11" ECU_ADDRESS 0x7FA8CE /end MEASUREMENT
/begin MEASUREMENT B_bthsv2 "Bedingung Bauteileansteuerung; LS-Heizung vor Kat. Bank 2" UBYTE B_TRUE 1 100 0 1 BIT_MASK 0x1 FORMAT "%13.11" ECU_ADDRESS 0x7FA8CF /end MEASUREMENT
/begin MEASUREMENT B_btkos "Bedingung Bauteileansteuerung; Klimakompressor" UBYTE B_TRUE 1 100 0 1 BIT_MASK 0x1 FORMAT "%13.11" ECU_ADDRESS 0x7FA8D0 /end MEASUREMENT
/begin MEASUREMENT B_btmil "Bedingung Bauteileansteuerung;  Fehlerlampe (MIL)" UBYTE B_TRUE 1 100 0 1 BIT_MASK 0x1 FORMAT "%13.11" ECU_ADDRESS 0x7FA8D1 /end MEASUREMENT
/begin MEASUREMENT B_btsta "Bedingung Bauteileansteuerung; Startrelais" UBYTE B_TRUE 1 100 0 1 BIT_MASK 0x1 FORMAT "%13.11" ECU_ADDRESS 0x7FA8D2 /end MEASUREMENT
/begin MEASUREMENT B_bttev "Bedingung Bauteileansteuerung; Tankentl¸ftungsventil" UBYTE B_TRUE 1 100 0 1 BIT_MASK 0x1 FORMAT "%13.11" ECU_ADDRESS 0x7FA8D3 /end MEASUREMENT
/begin MEASUREMENT B_c95ks3 "Ansteuersignal f¸r den Nulltest des CC195" UBYTE B_TRUE 1 100 0 1 BIT_MASK 0x1 FORMAT "%13.11" ECU_ADDRESS 0x7FA8D4 /end MEASUREMENT
/begin MEASUREMENT B_clkatfz "Bedingung Variantenerkennung zur¸cksetzen (mit Adaptionswerte lˆschen)" UBYTE B_TRUE 1 100 0 1 BIT_MASK 0x1 FORMAT "%13.11" ECU_ADDRESS 0x7FA8D5 /end MEASUREMENT
/begin MEASUREMENT B_craus "Ausgewertet durch LREB: Werkstattbit zum Stillegen LR" UBYTE DEZ 1 100 0 1 BIT_MASK 0x1 FORMAT "%5.3" ECU_ADDRESS 0x7FA8D6 /end MEASUREMENT
/begin MEASUREMENT B_desu "Anforderung Schwefelregenerierung NOx-Katalysator" UBYTE B_TRUE 1 100 0 1 BIT_MASK 0x1 FORMAT "%13.11" ECU_ADDRESS 0x7FA8D7 /end MEASUREMENT
/begin MEASUREMENT B_diagia "Diagnosebedingung Ip<|x| zur Kurzschluﬂerkennung an IA/IP ausschalten" UBYTE B_TRUE 1 100 0 1 BIT_MASK 0x1 FORMAT "%13.11" ECU_ADDRESS 0x7FA8D8 /end MEASUREMENT
/begin MEASUREMENT B_diagia2 "Diagnosebedingung Ip<|x| zur Kurzschluﬂerkennung an IA/IP ausschalten" UBYTE B_TRUE 1 100 0 1 BIT_MASK 0x1 FORMAT "%13.11" ECU_ADDRESS 0x7FA8D9 /end MEASUREMENT
/begin MEASUREMENT B_dktlp "Umschaltung der Lambdaregelungsparameter angefordert" UBYTE B_TRUE 1 100 0 1 BIT_MASK 0x1 FORMAT "%13.11" ECU_ADDRESS 0x7FA8DA /end MEASUREMENT
/begin MEASUREMENT B_dldpte "Anforderung TEV schlieﬂen aus Tankentl¸ftungsdiagnose" UBYTE B_TRUE 1 100 0 1 BIT_MASK 0x1 FORMAT "%13.11" ECU_ADDRESS 0x7FA8DB /end MEASUREMENT
/begin MEASUREMENT B_dmmtev "TEV-schlieﬂen wegen Bedingung Endstufentest DMTL-Magnetventil" UBYTE B_TRUE 1 100 0 1 BIT_MASK 0x1 FORMAT "%13.11" ECU_ADDRESS 0x7FA8DC /end MEASUREMENT
/begin MEASUREMENT B_dmtltz "Bedingung TEV soll geschlossen werden" UBYTE B_TRUE 1 100 0 1 BIT_MASK 0x1 FORMAT "%13.11" ECU_ADDRESS 0x7FA8DD /end MEASUREMENT
/begin MEASUREMENT B_dnt "Aktive Diagnose: Klopfregelung Nulltest" UBYTE B_TRUE 1 100 0 1 BIT_MASK 0x1 FORMAT "%13.11" ECU_ADDRESS 0x7FA8DE /end MEASUREMENT
/begin MEASUREMENT B_dntb "Bedingung Diagnose: Bereitschaft zum Nulltest (Nulltest im n‰chsten MF)" UBYTE B_TRUE 1 100 0 1 BIT_MASK 0x1 FORMAT "%13.11" ECU_ADDRESS 0x7FA8DF /end MEASUREMENT
/begin MEASUREMENT B_dopzue "Bedingung doppelte Z¸ndausgabe" UBYTE B_TRUE 1 100 0 1 BIT_MASK 0x1 FORMAT "%13.11" ECU_ADDRESS 0x7FA8E0 /end MEASUREMENT
/begin MEASUREMENT B_dsc_reg "CAN-Botschaft: DSC regelt (Motor und Bremseingriffe)" UBYTE B_TRUE 1 100 0 1 BIT_MASK 0x1 FORMAT "%13.11" ECU_ADDRESS 0x800E8C /end MEASUREMENT
/begin MEASUREMENT B_dslsk "Bedingung Diagnose Sekund‰rluftsystem f¸r Kurztest" UBYTE B_TRUE 1 100 0 1 BIT_MASK 0x1 FORMAT "%13.11" ECU_ADDRESS 0x7FA8E1 /end MEASUREMENT
/begin MEASUREMENT B_dtp "Aktive Diagnose: Klopfregelung Testimpuls" UBYTE B_TRUE 1 100 0 1 BIT_MASK 0x1 FORMAT "%13.11" ECU_ADDRESS 0x7FA8E2 /end MEASUREMENT
/begin MEASUREMENT B_dtpb "Bedingung Diagnose: Bereitschaft zum Testpuls (Testpuls im n‰chsten MF)" UBYTE B_TRUE 1 100 0 1 BIT_MASK 0x1 FORMAT "%13.11" ECU_ADDRESS 0x7FA8E3 /end MEASUREMENT
/begin MEASUREMENT B_dwdknws "Freigabe DK-Restwegsteuerung wenn Nockenwelle Position f¸r max. F¸llung erreicht" UBYTE B_TRUE 1 100 0 1 BIT_MASK 0x1 FORMAT "%13.11" ECU_ADDRESS 0x7FA8E4 /end MEASUREMENT
/begin MEASUREMENT B_eculock "Verriegelungsanforderung Wegfahrsperre" UBYTE B_TRUE 1 100 0 1 BIT_MASK 0x1 FORMAT "%13.11" ECU_ADDRESS 0x7FA8E5 /end MEASUREMENT
/begin MEASUREMENT B_eemrdy "EEPROM-Spiegel bereit f¸r Speicherung" UBYTE B_TRUE 1 100 0 1 BIT_MASK 0x1 FORMAT "%13.11" ECU_ADDRESS 0x7FA8E6 /end MEASUREMENT
/begin MEASUREMENT B_eepdif "Plausibilit‰tspr¸fung EEPROM und FLASH-Daten" UBYTE B_TRUE 1 100 0 1 BIT_MASK 0x1 FORMAT "%13.11" ECU_ADDRESS 0x7FA8E7 /end MEASUREMENT
/begin MEASUREMENT B_egscok "Bedingung Getriebebotschaft CAN empfangen" UBYTE B_TRUE 1 100 0 1 BIT_MASK 0x1 FORMAT "%13.11" ECU_ADDRESS 0x7FA8E8 /end MEASUREMENT
/begin MEASUREMENT B_ekpet "Stellglieddiagnose EKP: Eingriff Tester" UBYTE B_TRUE 1 100 0 1 BIT_MASK 0x1 FORMAT "%13.11" ECU_ADDRESS 0x7FA8E9 /end MEASUREMENT
/begin MEASUREMENT B_eslkl "Meldung Motorl¸fter defekt" UBYTE B_TRUE 1 100 0 1 BIT_MASK 0x1 FORMAT "%13.11" ECU_ADDRESS 0x7FA8EA /end MEASUREMENT
/begin MEASUREMENT B_eswez "Bedingung Berechnung Wiedereinsetzmenge zylinderselektiv" UBYTE B_TRUE 1 100 0 1 BIT_MASK 0x1 FORMAT "%13.11" ECU_ADDRESS 0x7FA8EB /end MEASUREMENT
/begin MEASUREMENT B_evfzgv1 "Bedingung Fehler Geschwindigkeitssignal V1 (¸ber CAN)" UBYTE B_TRUE 1 100 0 1 BIT_MASK 0x1 FORMAT "%13.11" ECU_ADDRESS 0x800E8D /end MEASUREMENT
/begin MEASUREMENT B_fa "Bedingung Funktionsanforderung allgemein" UBYTE B_TRUE 1 100 0 1 BIT_MASK 0x1 FORMAT "%13.11" ECU_ADDRESS 0x7FA8EC /end MEASUREMENT
/begin MEASUREMENT B_faagr "Bedingung Funktionsanforderung AGR und Diagnose f¸r Kurztest" UBYTE B_TRUE 1 100 0 1 BIT_MASK 0x1 FORMAT "%13.11" ECU_ADDRESS 0x7FA8ED /end MEASUREMENT
/begin MEASUREMENT B_faam "Anforderung allgemeine Momentenreserve Kurztrip" UBYTE B_TRUE 1 100 0 1 BIT_MASK 0x1 FORMAT "%13.11" ECU_ADDRESS 0x7FA8EE /end MEASUREMENT
/begin MEASUREMENT B_faan "Bedingung Funktionsanforderung Allgemeine Drehzahlerhˆhung" UBYTE B_TRUE 1 100 0 1 BIT_MASK 0x1 FORMAT "%13.11" ECU_ADDRESS 0x7FA8EF /end MEASUREMENT
/begin MEASUREMENT B_faatm "Bedingung Funktionsanforderung kurze Taupunktendezeiten" UBYTE B_TRUE 1 100 0 1 BIT_MASK 0x1 FORMAT "%13.11" ECU_ADDRESS 0x7FA8F0 /end MEASUREMENT
/begin MEASUREMENT B_fadylsu "Bedingung Funktionsanforderung Dynamikdiagnose der LSU" UBYTE B_TRUE 1 100 0 1 BIT_MASK 0x1 FORMAT "%13.11" ECU_ADDRESS 0x7FA8F1 /end MEASUREMENT
/begin MEASUREMENT B_faevz "Bedingung Zylinderausblendung durch Tester" UBYTE B_TRUE 1 100 0 1 BIT_MASK 0x1 FORMAT "%13.11" ECU_ADDRESS 0x7FA8F2 /end MEASUREMENT
/begin MEASUREMENT B_faezla "Bedingung : Funktionsanforderung DEZLA" UBYTE B_TRUE 1 100 0 1 BIT_MASK 0x1 FORMAT "%13.11" ECU_ADDRESS 0x7FA8F3 /end MEASUREMENT
/begin MEASUREMENT B_fakat "Bedingung Funktionsanforderung Katalysator¸berwachung" UBYTE DEZ 1 100 0 1 BIT_MASK 0x1 FORMAT "%5.3" ECU_ADDRESS 0x7FA8F4 /end MEASUREMENT
/begin MEASUREMENT B_fakat2 "Bedingung Funktionanforderung Katalysator¸berwachung (Stereo 2.Bank)" UBYTE DEZ 1 100 0 1 BIT_MASK 0x1 FORMAT "%5.3" ECU_ADDRESS 0x7FA8F5 /end MEASUREMENT
/begin MEASUREMENT B_fakrs "Bedingung Funktionsanforderung Klopfsensordiagnose" UBYTE B_TRUE 1 100 0 1 BIT_MASK 0x1 FORMAT "%13.11" ECU_ADDRESS 0x7FA8F6 /end MEASUREMENT
/begin MEASUREMENT B_fakvs "Funktionsaufforderung Diagnose Kraftstoffsystem f¸r Schnelltest" UBYTE B_TRUE 1 100 0 1 BIT_MASK 0x1 FORMAT "%13.11" ECU_ADDRESS 0x7FA8F7 /end MEASUREMENT
/begin MEASUREMENT B_falbk "Funktionsaufforderung Offsetlernen der LBK" UWORD B_TRUE 1 100 0 1 BIT_MASK 0x100 FORMAT "%13.11" ECU_ADDRESS 0x801C5E /end MEASUREMENT
/begin MEASUREMENT B_faldp "Bedingung Funktionsanforderung Leckdiagnosepumpe" UBYTE B_TRUE 1 100 0 1 BIT_MASK 0x1 FORMAT "%13.11" ECU_ADDRESS 0x7FA8F8 /end MEASUREMENT
/begin MEASUREMENT B_falr "Bedingung: Funktionsanforderung Lambdaregelung aus" UBYTE B_TRUE 1 100 0 1 BIT_MASK 0x1 FORMAT "%13.11" ECU_ADDRESS 0x7FA8F9 /end MEASUREMENT
/begin MEASUREMENT B_falra "Bedingung: Funktionsanforderung Lambdaregelung-Adaption" UBYTE B_TRUE 1 100 0 1 BIT_MASK 0x1 FORMAT "%13.11" ECU_ADDRESS 0x7FA8FA /end MEASUREMENT
/begin MEASUREMENT B_falsf "Bedingung Funktionsanforderung Lambda-Sonde hinter Front KAT" UBYTE B_TRUE 1 100 0 1 BIT_MASK 0x1 FORMAT "%13.11" ECU_ADDRESS 0x7FA8FB /end MEASUREMENT
/begin MEASUREMENT B_falsh "Bedingung Funktionsanforderung Lambda-Sonde hinter KAT" UBYTE B_TRUE 1 100 0 1 BIT_MASK 0x1 FORMAT "%13.11" ECU_ADDRESS 0x7FA8FC /end MEASUREMENT
/begin MEASUREMENT B_falsh2 "Bedingung Funktionsanforderung Lambda-Sonde hinter KAT Bank2" UBYTE B_TRUE 1 100 0 1 BIT_MASK 0x1 FORMAT "%13.11" ECU_ADDRESS 0x7FA8FD /end MEASUREMENT
/begin MEASUREMENT B_falshv "Bedingung Funktionsanforderung f¸r Kurztrip Vertauschung Lambda-Sonde hinter KAT" UBYTE B_TRUE 1 100 0 1 BIT_MASK 0x1 FORMAT "%13.11" ECU_ADDRESS 0x7FA8FE /end MEASUREMENT
/begin MEASUREMENT B_falsv "Bedingung Funktionsanforderung Lambda-Sonde vor KAT" UBYTE B_TRUE 1 100 0 1 BIT_MASK 0x1 FORMAT "%13.11" ECU_ADDRESS 0x7FA8FF /end MEASUREMENT
/begin MEASUREMENT B_falsv2 "Bedingung Funktionsanforderung Lambda-Sonde vor KAT Bank2" UBYTE B_TRUE 1 100 0 1 BIT_MASK 0x1 FORMAT "%13.11" ECU_ADDRESS 0x7FA900 /end MEASUREMENT
/begin MEASUREMENT B_fanwsa "Bedingung Funktionsanforderung Diagnose Nockenwellensteuerung (Auslaﬂ)" UBYTE B_TRUE 1 100 0 1 BIT_MASK 0x1 FORMAT "%13.11" ECU_ADDRESS 0x7FA901 /end MEASUREMENT
/begin MEASUREMENT B_fanwse "Bedingung Funktionsanforderung Diagnose Nockenwellensteuerung (Einlaﬂseitig)" UBYTE B_TRUE 1 100 0 1 BIT_MASK 0x1 FORMAT "%13.11" ECU_ADDRESS 0x7FA902 /end MEASUREMENT
/begin MEASUREMENT B_fasf "Bedingung Funktionsanforderung Schwingungspr¸fung hinter Front KAT" UBYTE B_TRUE 1 100 0 1 BIT_MASK 0x1 FORMAT "%13.11" ECU_ADDRESS 0x7FA903 /end MEASUREMENT
/begin MEASUREMENT B_fash "Bedingung Funktionsanforderung Schwingungspr¸fung" UBYTE B_TRUE 1 100 0 1 BIT_MASK 0x1 FORMAT "%13.11" ECU_ADDRESS 0x7FA904 /end MEASUREMENT
/begin MEASUREMENT B_fash2 "Bedingung Funktionsanforderung Schwingungspr¸fung Bank2" UBYTE B_TRUE 1 100 0 1 BIT_MASK 0x1 FORMAT "%13.11" ECU_ADDRESS 0x7FA905 /end MEASUREMENT
/begin MEASUREMENT B_faskno "Bedingung Funktionsanforderung Speicherkatdiagnose" UBYTE B_TRUE 1 100 0 1 BIT_MASK 0x1 FORMAT "%13.11" ECU_ADDRESS 0x7FA906 /end MEASUREMENT
/begin MEASUREMENT B_fasls "Bedingung Funktionsanforderung Sekund‰rluftsystem" UBYTE B_TRUE 1 100 0 1 BIT_MASK 0x1 FORMAT "%13.11" ECU_ADDRESS 0x7FA907 /end MEASUREMENT
/begin MEASUREMENT B_fates "Bedingung Funktionsanforderung Tankentl¸ftungssystem" UBYTE B_TRUE 1 100 0 1 BIT_MASK 0x1 FORMAT "%13.11" ECU_ADDRESS 0x7FA908 /end MEASUREMENT
/begin MEASUREMENT B_fgr "Bedingung FGR (Tempomat) aktiv" UBYTE B_TRUE 1 100 0 1 BIT_MASK 0x1 FORMAT "%13.11" ECU_ADDRESS 0x7FA909 /end MEASUREMENT
/begin MEASUREMENT B_fgrat "Bedingung: Tip-Schalter Aus am FGR-Bedienteil bet‰tigt" UBYTE B_TRUE 1 100 0 1 BIT_MASK 0x1 FORMAT "%13.11" ECU_ADDRESS 0x7FA90A /end MEASUREMENT
/begin MEASUREMENT B_fgrhe "Bedingung: FGR-Bedienteil-Fehler" UBYTE B_TRUE 1 100 0 1 BIT_MASK 0x1 FORMAT "%13.11" ECU_ADDRESS 0x7FA90B /end MEASUREMENT
/begin MEASUREMENT B_fgrhsa "Bedingung: FGR-Hauptschalter aus" UBYTE B_TRUE 1 100 0 1 BIT_MASK 0x1 FORMAT "%13.11" ECU_ADDRESS 0x7FA90C /end MEASUREMENT
/begin MEASUREMENT B_fgrtb2 "Bedingung FGR-Taste Auswahl der n‰chsthˆheren Zielgeschwindigkeit" UBYTE B_TRUE 1 100 0 1 BIT_MASK 0x1 FORMAT "%13.11" ECU_ADDRESS 0x7FA90D /end MEASUREMENT
/begin MEASUREMENT B_fgrtbe "Bedingung FGR-Taste Beschleunigen" UBYTE B_TRUE 1 100 0 1 BIT_MASK 0x1 FORMAT "%13.11" ECU_ADDRESS 0x7FA90E /end MEASUREMENT
/begin MEASUREMENT B_fgrtse "Bedingung FGR-Taste Setzen" UBYTE B_TRUE 1 100 0 1 BIT_MASK 0x1 FORMAT "%13.11" ECU_ADDRESS 0x7FA90F /end MEASUREMENT
/begin MEASUREMENT B_fgrtv2 "Bedingung FGR-Taste Auswahl der n‰chstniederen Zielgeschwindigkeit" UBYTE B_TRUE 1 100 0 1 BIT_MASK 0x1 FORMAT "%13.11" ECU_ADDRESS 0x7FA910 /end MEASUREMENT
/begin MEASUREMENT B_fgrtve "Bedingung FGR-Taste Verzˆgern" UBYTE B_TRUE 1 100 0 1 BIT_MASK 0x1 FORMAT "%13.11" ECU_ADDRESS 0x7FA911 /end MEASUREMENT
/begin MEASUREMENT B_fgrtwa "Bedingung FGR-Taste Wiederaufnahme" UBYTE B_TRUE 1 100 0 1 BIT_MASK 0x1 FORMAT "%13.11" ECU_ADDRESS 0x7FA912 /end MEASUREMENT
/begin MEASUREMENT B_fgr_bt "" UBYTE B_TRUE 1 100 0 1 BIT_MASK 0x1 FORMAT "%13.11" ECU_ADDRESS 0x7FA5FD /end MEASUREMENT
/begin MEASUREMENT B_fgr_uc "FGR-/ACC-Momenteneingriff im Befehlstest erlaubt" UBYTE B_TRUE 1 100 0 1 BIT_MASK 0x1 FORMAT "%13.11" ECU_ADDRESS 0x7FA5FE /end MEASUREMENT
/begin MEASUREMENT B_fgr_um "FGR-/ACC-Momenteneingriff in der Funktions¸berwachung erlaubt" UBYTE B_TRUE 1 100 0 1 BIT_MASK 0x1 FORMAT "%13.11" ECU_ADDRESS 0x7F809A /end MEASUREMENT
/begin MEASUREMENT B_fnwea "Bedingung Bereich fnwea (NW-‹berschneidung)" UBYTE B_TRUE 1 100 0 1 BIT_MASK 0x1 FORMAT "%13.11" ECU_ADDRESS 0x7FA913 /end MEASUREMENT
/begin MEASUREMENT B_fnwea2 "Bedingung Bereich fnwea2 (NW-‹berschneidung)" UBYTE B_TRUE 1 100 0 1 BIT_MASK 0x1 FORMAT "%13.11" ECU_ADDRESS 0x7FA914 /end MEASUREMENT
/begin MEASUREMENT B_fnwea3 "Bedingung Bereich fnwea3 (NW-‹berschneidung)" UBYTE B_TRUE 1 100 0 1 BIT_MASK 0x1 FORMAT "%13.11" ECU_ADDRESS 0x7FA915 /end MEASUREMENT
/begin MEASUREMENT B_fsp "Bedingung Fahrstufe hardwired ueber Pin" UBYTE B_TRUE 1 100 0 1 BIT_MASK 0x1 FORMAT "%13.11" ECU_ADDRESS 0x7FA916 /end MEASUREMENT
/begin MEASUREMENT B_grdst "Bedingung Grundeinstellung" UBYTE B_TRUE 1 100 0 1 BIT_MASK 0x1 FORMAT "%13.11" ECU_ADDRESS 0x7FA917 /end MEASUREMENT
/begin MEASUREMENT B_gsaf "Bedingung Getriebe-Schalteingriff-Anforderung" UBYTE B_TRUE 1 100 0 1 BIT_MASK 0x1 FORMAT "%13.11" ECU_ADDRESS 0x7FA918 /end MEASUREMENT
/begin MEASUREMENT B_gsch "Bedingung Getriebeschaltung aktiv" UBYTE B_TRUE 1 100 0 1 BIT_MASK 0x1 FORMAT "%13.11" ECU_ADDRESS 0x7FA919 /end MEASUREMENT
/begin MEASUREMENT B_gstcmv "CAN-Botschaft ""General Status TCM"" gueltig" UBYTE B_TRUE 1 100 0 1 BIT_MASK 0x1 FORMAT "%13.11" ECU_ADDRESS 0x7FA91A /end MEASUREMENT
/begin MEASUREMENT B_gwrte "Bedingung fr-Grenzwertregelung Tankentl¸ftung aktiv" UBYTE B_TRUE 1 100 0 1 BIT_MASK 0x1 FORMAT "%13.11" ECU_ADDRESS 0x7FA7DE /end MEASUREMENT
/begin MEASUREMENT B_hdc "Bedingung Hill Desent Control aktiv" UBYTE B_TRUE 1 100 0 1 BIT_MASK 0x1 FORMAT "%13.11" ECU_ADDRESS 0x7FA91B /end MEASUREMENT
/begin MEASUREMENT B_hfmsl "" UBYTE B_TRUE 1 100 0 1 BIT_MASK 0x1 FORMAT "%13.11" ECU_ADDRESS 0x7FA91C /end MEASUREMENT
/begin MEASUREMENT B_hksv "Bedingung Betriebsart der n‰chsten Verbrennung Homogen-Klopfschutz" UBYTE B_TRUE 1 100 0 1 BIT_MASK 0x1 FORMAT "%13.11" ECU_ADDRESS 0x7FA91D /end MEASUREMENT
/begin MEASUREMENT B_hmmfes "Bedingung Homogen-Mager als Sollbetriebsart f¸r F¸llungssteuerung" UBYTE B_TRUE 1 100 0 1 BIT_MASK 0x1 FORMAT "%13.11" ECU_ADDRESS 0x7FA91E /end MEASUREMENT
/begin MEASUREMENT B_hom "Bedingung Betriebsart Homogen" UBYTE B_TRUE 1 100 0 1 BIT_MASK 0x1 FORMAT "%13.11" ECU_ADDRESS 0x7FA91F /end MEASUREMENT
/begin MEASUREMENT B_homfes "Bedingung Homogen als Sollbetriebsart f¸r F¸llungssteuerung" UBYTE B_TRUE 1 100 0 1 BIT_MASK 0x1 FORMAT "%13.11" ECU_ADDRESS 0x7FA920 /end MEASUREMENT
/begin MEASUREMENT B_homlbks "Bedingung Homogen als Sollbetriebsart f¸r Ladungsbewegungsklappe" UBYTE B_TRUE 1 100 0 1 BIT_MASK 0x1 FORMAT "%13.11" ECU_ADDRESS 0x7FA921 /end MEASUREMENT
/begin MEASUREMENT B_hosfes "Bedingung Homogen-Schicht als Sollbetriebsart f¸r F¸llungssteuerung" UBYTE B_TRUE 1 100 0 1 BIT_MASK 0x1 FORMAT "%13.11" ECU_ADDRESS 0x7FA922 /end MEASUREMENT
/begin MEASUREMENT B_hsh2et "" UBYTE B_TRUE 1 100 0 1 BIT_MASK 0x1 FORMAT "%13.11" ECU_ADDRESS 0x7FA923 /end MEASUREMENT
/begin MEASUREMENT B_hshet "Bedingung LS-Heizung hinter KAT Bank 1 ein ¸ber Tester" UBYTE B_TRUE 1 100 0 1 BIT_MASK 0x1 FORMAT "%13.11" ECU_ADDRESS 0x7FA924 /end MEASUREMENT
/begin MEASUREMENT B_hspmd "Bedingung Homogen Split f¸r Drehmomentsruktur" UBYTE B_TRUE 1 100 0 1 BIT_MASK 0x1 FORMAT "%13.11" ECU_ADDRESS 0x7FA925 /end MEASUREMENT
/begin MEASUREMENT B_hsv2et "" UBYTE B_TRUE 1 100 0 1 BIT_MASK 0x1 FORMAT "%13.11" ECU_ADDRESS 0x7FA926 /end MEASUREMENT
/begin MEASUREMENT B_ins2cok "Bedingung: CAN-Botschaft INSTR2 vorhanden" UBYTE B_TRUE 1 100 0 1 BIT_MASK 0x1 FORMAT "%13.11" ECU_ADDRESS 0x800E8E /end MEASUREMENT
/begin MEASUREMENT B_ins3cok "Bedingung CAN-Botschaft-INST3 vorhanden" UBYTE B_TRUE 1 100 0 1 BIT_MASK 0x1 FORMAT "%13.11" ECU_ADDRESS 0x7FA927 /end MEASUREMENT
/begin MEASUREMENT B_i_ska_uc "Ebene 3 irreversibles Fehlerbit fuer BT" UBYTE B_TRUE 1 100 0 1 BIT_MASK 0x1 FORMAT "%13.11" ECU_ADDRESS 0x7FA607 /end MEASUREMENT
/begin MEASUREMENT B_kas "Kat.schutzfunktion aktiv" UBYTE B_TRUE 1 100 0 1 BIT_MASK 0x1 FORMAT "%13.11" ECU_ADDRESS 0x7FA928 /end MEASUREMENT
/begin MEASUREMENT B_kdhra "Bedingung Komponenten an Hauptrelais zur Diagnose UBR einschalten" UBYTE B_TRUE 1 100 0 1 BIT_MASK 0x1 FORMAT "%13.11" ECU_ADDRESS 0x7FA929 /end MEASUREMENT
/begin MEASUREMENT B_kdhre "Bedingung Komponenten an Hauptrelais zur Diagnose UBR einschalten" UBYTE B_TRUE 1 100 0 1 BIT_MASK 0x1 FORMAT "%13.11" ECU_ADDRESS 0x7FA92A /end MEASUREMENT
/begin MEASUREMENT B_khls "Bedingung Katheizen mit Lamda-split" UBYTE B_TRUE 1 100 0 1 BIT_MASK 0x1 FORMAT "%13.11" ECU_ADDRESS 0x7FA92B /end MEASUREMENT
/begin MEASUREMENT B_klmzu_um "Bedingung  KLMZUMN wird im Tempomatbetrieb ber¸cksichtigt" UBYTE B_TRUE 1 100 0 1 BIT_MASK 0x1 FORMAT "%13.11" ECU_ADDRESS 0x7FA92C /end MEASUREMENT
/begin MEASUREMENT B_ko "Bedingung Kompressor freigegeben" UBYTE B_TRUE 1 100 0 1 BIT_MASK 0x1 FORMAT "%13.11" ECU_ADDRESS 0x7FA92D /end MEASUREMENT
/begin MEASUREMENT B_ko2vke "Bedingung: Adaptionsfaktor (Schubabgleich) eingeschwungen" UBYTE B_TRUE 1 100 0 1 BIT_MASK 0x1 FORMAT "%13.11" ECU_ADDRESS 0x7FA92E /end MEASUREMENT
/begin MEASUREMENT B_ko2vke2 "Bedingung: Adaptionsfaktor (Schubabgleich) eingeschwungen" UBYTE B_TRUE 1 100 0 1 BIT_MASK 0x1 FORMAT "%13.11" ECU_ADDRESS 0x7FA92F /end MEASUREMENT
/begin MEASUREMENT B_koset "Stellglieddiagnose Klimakompressor-Relais: Eingriff Tester" UBYTE B_TRUE 1 100 0 1 BIT_MASK 0x1 FORMAT "%13.11" ECU_ADDRESS 0x7FA930 /end MEASUREMENT
/begin MEASUREMENT B_kuppv "Bedingung Kupplung voll bet‰tigt" UBYTE B_TRUE 1 100 0 1 BIT_MASK 0x1 FORMAT "%13.11" ECU_ADDRESS 0x7FA931 /end MEASUREMENT
/begin MEASUREMENT B_kw "Bedingung Kat warmhalten" UBYTE B_TRUE 1 100 0 1 BIT_MASK 0x1 FORMAT "%13.11" ECU_ADDRESS 0x7FA932 /end MEASUREMENT
/begin MEASUREMENT B_lamabg "Bedingung Lambdaabgleich mit CJ120 anfordern" UBYTE B_TRUE 1 100 0 1 BIT_MASK 0x1 FORMAT "%13.11" ECU_ADDRESS 0x7FA933 /end MEASUREMENT
/begin MEASUREMENT B_lamabg2 "Bedingung Lambdaabgleich mit CJ120 anfordern, Bank 2" UBYTE B_TRUE 1 100 0 1 BIT_MASK 0x1 FORMAT "%13.11" ECU_ADDRESS 0x7FA934 /end MEASUREMENT
/begin MEASUREMENT B_lbkeson "Bedingung LBK Enstufe an" UBYTE B_TRUE 1 100 0 1 BIT_MASK 0x1 FORMAT "%13.11" ECU_ADDRESS 0x7FA935 /end MEASUREMENT
/begin MEASUREMENT B_lf1nbres "Bedingung f¸r Aufbau Drehmomentenreserve bei Motorl¸fter Stufe 1 Normalbetr. ein" UBYTE B_TRUE 1 100 0 1 BIT_MASK 0x1 FORMAT "%13.11" ECU_ADDRESS 0x7FA936 /end MEASUREMENT
/begin MEASUREMENT B_lf1s "Bedingung L¸fter 1.Stufe ein" UBYTE B_TRUE 1 100 0 1 BIT_MASK 0x1 FORMAT "%13.11" ECU_ADDRESS 0x7FA937 /end MEASUREMENT
/begin MEASUREMENT B_lf2nbres "Bedingung f¸r Aufbau Drehmomentreserve bei Motorl¸fterstufe 2 Normalbetr. ein" UBYTE B_TRUE 1 100 0 1 BIT_MASK 0x1 FORMAT "%13.11" ECU_ADDRESS 0x7FA938 /end MEASUREMENT
/begin MEASUREMENT B_lf2s "Bedingung L¸fter 2.Stufe ein" UBYTE B_TRUE 1 100 0 1 BIT_MASK 0x1 FORMAT "%13.11" ECU_ADDRESS 0x7FA939 /end MEASUREMENT
/begin MEASUREMENT B_lowra "Bedingung Zwischengelege f¸r Low Range zugeschaltet" UBYTE B_TRUE 1 100 0 1 BIT_MASK 0x1 FORMAT "%13.11" ECU_ADDRESS 0x7FA93A /end MEASUREMENT
/begin MEASUREMENT B_lrar "Bedingung reduzierte Korrekturbereiche in der LRA" UBYTE B_TRUE 1 100 0 1 BIT_MASK 0x1 FORMAT "%13.11" ECU_ADDRESS 0x7FA7DF /end MEASUREMENT
/begin MEASUREMENT B_lrndia "Bedingung: DV-E-Adaption und Pr¸fungen per Diagnose-Tester aktivieren" UBYTE B_TRUE 1 100 0 1 BIT_MASK 0x1 FORMAT "%13.11" ECU_ADDRESS 0x7FA93B /end MEASUREMENT
/begin MEASUREMENT B_lsvvsp "Bedingung Vertauschte Lambda-Sonden, Regelung sperren" UBYTE B_TRUE 1 100 0 1 BIT_MASK 0x1 FORMAT "%13.11" ECU_ADDRESS 0x7FA93C /end MEASUREMENT
/begin MEASUREMENT B_lwser "Fehler im Lenkwinkelsensorpfad" UBYTE B_TRUE 1 100 0 1 BIT_MASK 0x1 FORMAT "%13.11" ECU_ADDRESS 0x7FA93D /end MEASUREMENT
/begin MEASUREMENT B_mdvur "Bedingung Vermeidung Umschaltruck in Md-Struktur ber¸cksichtigt" UBYTE B_TRUE 1 100 0 1 BIT_MASK 0x1 FORMAT "%13.11" ECU_ADDRESS 0x7FA93E /end MEASUREMENT
/begin MEASUREMENT B_mdwaner "Bedingung Fehler auf mdwan_w" UBYTE B_TRUE 1 100 0 1 BIT_MASK 0x1 FORMAT "%13.11" ECU_ADDRESS 0x7FA93F /end MEASUREMENT
/begin MEASUREMENT B_msrext "Bedingung f¸r externe Anforderung MSR" UBYTE B_TRUE 1 100 0 1 BIT_MASK 0x1 FORMAT "%13.11" ECU_ADDRESS 0x800E8F /end MEASUREMENT
/begin MEASUREMENT B_nac "Bedingung f¸r erhˆhte LL-Drehzahl bei Klimaanlage" UBYTE B_TRUE 1 100 0 1 BIT_MASK 0x1 FORMAT "%13.11" ECU_ADDRESS 0x7FA940 /end MEASUREMENT
/begin MEASUREMENT B_nachlstp "Bedingung SG-Nachlauf beendet" UBYTE B_TRUE 1 100 0 1 BIT_MASK 0x1 FORMAT "%13.11" ECU_ADDRESS 0x7FA941 /end MEASUREMENT
/begin MEASUREMENT B_nllstab "Drehzahlmaximum im Start erreicht." UBYTE B_TRUE 1 100 0 1 BIT_MASK 0x1 FORMAT "%13.11" ECU_ADDRESS 0x7FA942 /end MEASUREMENT
/begin MEASUREMENT B_nmaxext "Externe Drehzahlbegrenzung aktiv" UBYTE B_TRUE 1 100 0 1 BIT_MASK 0x1 FORMAT "%13.11" ECU_ADDRESS 0x7FA943 /end MEASUREMENT
/begin MEASUREMENT B_noacc_uc "" UBYTE B_TRUE 1 100 0 1 BIT_MASK 0x1 FORMAT "%13.11" ECU_ADDRESS 0x7FA5FF /end MEASUREMENT
/begin MEASUREMENT B_noacc_um "Bedingung keine ‹bernahme des ACC-Momentes" UBYTE B_TRUE 1 100 0 1 BIT_MASK 0x1 FORMAT "%13.11" ECU_ADDRESS 0x7F809B /end MEASUREMENT
/begin MEASUREMENT B_nomsr_uc "MSR-Momentenvorgabe im Befehlstest nicht ¸bernommen" UBYTE B_TRUE 1 100 0 1 BIT_MASK 0x1 FORMAT "%13.11" ECU_ADDRESS 0x7FA601 /end MEASUREMENT
/begin MEASUREMENT B_nosgs_uc "SGS-Momentenvorgabe im Befehlstest nicht ¸bernommen" UBYTE B_TRUE 1 100 0 1 BIT_MASK 0x1 FORMAT "%13.11" ECU_ADDRESS 0x7FA605 /end MEASUREMENT
/begin MEASUREMENT B_nouetm "Bedingung keine ‹bertemperatur im Nachlauf" UBYTE B_TRUE 1 100 0 1 BIT_MASK 0x1 FORMAT "%13.11" ECU_ADDRESS 0x7FC7EB /end MEASUREMENT
/begin MEASUREMENT B_nsolst "Solldrehzahlvorgabe im Start aktiv" UBYTE B_TRUE 1 100 0 1 BIT_MASK 0x1 FORMAT "%13.11" ECU_ADDRESS 0x7FA944 /end MEASUREMENT
/begin MEASUREMENT B_nwkv "Bedingung NW korrekt verbaut" UBYTE B_TRUE 1 100 0 1 BIT_MASK 0x1 FORMAT "%13.11" ECU_ADDRESS 0x7FA945 /end MEASUREMENT
/begin MEASUREMENT B_oeldr "Bedingung ÷ldruck" UBYTE B_TRUE 1 100 0 1 BIT_MASK 0x1 FORMAT "%13.11" ECU_ADDRESS 0x7FA946 /end MEASUREMENT
/begin MEASUREMENT B_phsnl "Bedingung Phasensuche w‰hrend PG-Notlauf" UBYTE B_TRUE 1 100 0 1 BIT_MASK 0x1 FORMAT "%13.11" ECU_ADDRESS 0x7FA947 /end MEASUREMENT
/begin MEASUREMENT B_phsnlinv "Bedingung Phaselage invertieren" UBYTE B_TRUE 1 100 0 1 BIT_MASK 0x1 FORMAT "%13.11" ECU_ADDRESS 0x7FA948 /end MEASUREMENT
/begin MEASUREMENT B_qtedab "Bedingung schnelle Absteuerung der Sp¸lrate" UBYTE B_TRUE 1 100 0 1 BIT_MASK 0x1 FORMAT "%13.11" ECU_ADDRESS 0x7FA7E4 /end MEASUREMENT
/begin MEASUREMENT B_rineza "Bedingung Abschaltung Ri-Messtrom LSU/CJ120 wegen Einzelzylinder-Erkennung" UBYTE B_TRUE 1 100 0 1 BIT_MASK 0x1 FORMAT "%13.11" ECU_ADDRESS 0x7FA949 /end MEASUREMENT
/begin MEASUREMENT B_rineza2 "Bedingung Abschaltung Ri-Messtrom LSU2 / CJ120 wegen Einzelzylinder-Erkennung" UBYTE B_TRUE 1 100 0 1 BIT_MASK 0x1 FORMAT "%13.11" ECU_ADDRESS 0x7FA94A /end MEASUREMENT
/begin MEASUREMENT B_ripuv "Bedingung Strom-Pumpen f¸r Sonde vor KAT" UBYTE B_TRUE 1 100 0 1 BIT_MASK 0x1 FORMAT "%13.11" ECU_ADDRESS 0x7FA94B /end MEASUREMENT
/begin MEASUREMENT B_ripuv2 "Bedingung Strom-Pumpen f¸r Sonde vor KAT Bank2" UBYTE B_TRUE 1 100 0 1 BIT_MASK 0x1 FORMAT "%13.11" ECU_ADDRESS 0x7FA94C /end MEASUREMENT
/begin MEASUREMENT B_savacc "Bedingung: Schubabschalteverbot von ACC" UBYTE B_TRUE 1 100 0 1 BIT_MASK 0x1 FORMAT "%13.11" ECU_ADDRESS 0x7FA94D /end MEASUREMENT
/begin MEASUREMENT B_savmsr "Bedingung Schubabschalteverbot bei MSR-Anforderung" UBYTE B_TRUE 1 100 0 1 BIT_MASK 0x1 FORMAT "%13.11" ECU_ADDRESS 0x7FA94E /end MEASUREMENT
/begin MEASUREMENT B_sch "Bedingung Betriebsart Schicht" UBYTE B_TRUE 1 100 0 1 BIT_MASK 0x1 FORMAT "%13.11" ECU_ADDRESS 0x7FA94F /end MEASUREMENT
/begin MEASUREMENT B_schfes "Bedingung Schicht als Sollbetriebsart f¸r F¸llungssteuerung" UBYTE B_TRUE 1 100 0 1 BIT_MASK 0x1 FORMAT "%13.11" ECU_ADDRESS 0x7FA950 /end MEASUREMENT
/begin MEASUREMENT B_skhfes "Bedingung Schicht-Katheizen als Sollbetriebsart f¸r F¸llungssteuerung" UBYTE B_TRUE 1 100 0 1 BIT_MASK 0x1 FORMAT "%13.11" ECU_ADDRESS 0x7FA951 /end MEASUREMENT
/begin MEASUREMENT B_sl "Bedingung Servo-Lenkung" UBYTE B_TRUE 1 100 0 1 BIT_MASK 0x1 FORMAT "%13.11" ECU_ADDRESS 0x7FA952 /end MEASUREMENT
/begin MEASUREMENT B_slsfz "Bedingung SLS in Fahrzeug eingebaut" UBYTE B_TRUE 1 100 0 1 BIT_MASK 0x1 FORMAT "%13.11" ECU_ADDRESS 0x7FA953 /end MEASUREMENT
/begin MEASUREMENT B_spf3k "Bedingung: Anforderung, das 3kHz-Meﬂsignal f¸r Ri abschalten" UBYTE B_TRUE 1 100 0 1 BIT_MASK 0x1 FORMAT "%13.11" ECU_ADDRESS 0x7FA954 /end MEASUREMENT
/begin MEASUREMENT B_spf3k2 "Bedingung: Anforderung, das 3kHz-Meﬂsignal f¸r Ri abschalten, Bank 2" UBYTE B_TRUE 1 100 0 1 BIT_MASK 0x1 FORMAT "%13.11" ECU_ADDRESS 0x7FA955 /end MEASUREMENT
/begin MEASUREMENT B_staet "Stellglieddiagnose Startrelais: Eingriff Tester" UBYTE B_TRUE 1 100 0 1 BIT_MASK 0x1 FORMAT "%13.11" ECU_ADDRESS 0x7FA956 /end MEASUREMENT
/begin MEASUREMENT B_stalock "Verriegelungsanforderung an Starter von Wegfahrsperre" UBYTE B_TRUE 1 100 0 1 BIT_MASK 0x1 FORMAT "%13.11" ECU_ADDRESS 0x7FA957 /end MEASUREMENT
/begin MEASUREMENT B_stares5v "Bedingung 5V-Reset im Start" UBYTE B_TRUE 1 100 0 1 BIT_MASK 0x1 FORMAT "%13.11" ECU_ADDRESS 0x7FA958 /end MEASUREMENT
/begin MEASUREMENT B_svuerf "Bedingung Sondenspannung vor KAT erfassen" UBYTE B_TRUE 1 100 0 1 BIT_MASK 0x1 FORMAT "%13.11" ECU_ADDRESS 0x7FA959 /end MEASUREMENT
/begin MEASUREMENT B_svuerf2 "Bedingung Sondenspannung vor KAT erfassen Bank2" UBYTE B_TRUE 1 100 0 1 BIT_MASK 0x1 FORMAT "%13.11" ECU_ADDRESS 0x7FA95A /end MEASUREMENT
/begin MEASUREMENT B_synnot "Verbot der Einspritzung wenn Phasensynchronisation nicht gefunden werden kann" UBYTE B_TRUE 1 100 0 1 BIT_MASK 0x1 FORMAT "%13.11" ECU_ADDRESS 0x7FA95B /end MEASUREMENT
/begin MEASUREMENT B_tcm0x320cok "" UBYTE B_TRUE 1 100 0 1 BIT_MASK 0x1 FORMAT "%13.11" ECU_ADDRESS 0x7FA95C /end MEASUREMENT
/begin MEASUREMENT B_te "Bedingung Tankentl¸ftung" UBYTE B_TRUE 1 100 0 1 BIT_MASK 0x1 FORMAT "%13.11" ECU_ADDRESS 0x7FA7E5 /end MEASUREMENT
/begin MEASUREMENT B_teabb "Bedingung Tankentl¸ftung abbruchbereit" UBYTE B_TRUE 1 100 0 1 BIT_MASK 0x1 FORMAT "%13.11" ECU_ADDRESS 0x7FA7E0 /end MEASUREMENT
/begin MEASUREMENT B_teakt "Bedingung Tankentl¸ftung aktiv (normaler Betrieb oder Notlauf)" UBYTE B_TRUE 1 100 0 1 BIT_MASK 0x1 FORMAT "%13.11" ECU_ADDRESS 0x7FA7E1 /end MEASUREMENT
/begin MEASUREMENT B_tef "Bedingung Tankentl¸ftung prinzipiell freigegeben" UBYTE B_TRUE 1 100 0 1 BIT_MASK 0x1 FORMAT "%13.11" ECU_ADDRESS 0x7FA7E6 /end MEASUREMENT
/begin MEASUREMENT B_tehb "Bedingung Tankentl¸ftung mit hoher Beladung" UBYTE B_TRUE 1 100 0 1 BIT_MASK 0x1 FORMAT "%13.11" ECU_ADDRESS 0x7FA7E2 /end MEASUREMENT
/begin MEASUREMENT B_tehbx "Bedingung Beladungsintegrator ftead am Maximalanschlag" UBYTE B_TRUE 1 100 0 1 BIT_MASK 0x1 FORMAT "%13.11" ECU_ADDRESS 0x7FA7E3 /end MEASUREMENT
/begin MEASUREMENT B_tei "Bedingung Tankentl¸ftung funktionsintern" UBYTE B_TRUE 1 100 0 1 BIT_MASK 0x1 FORMAT "%13.11" ECU_ADDRESS 0x7FA7E7 /end MEASUREMENT
/begin MEASUREMENT B_ten "Bedingung Tankentl¸ftung im Notlaufbetrieb (ohne Lambdaregelung)" UBYTE B_TRUE 1 100 0 1 BIT_MASK 0x1 FORMAT "%13.11" ECU_ADDRESS 0x7FA7E8 /end MEASUREMENT
/begin MEASUREMENT B_tenmda "Notlauf TE beim Aussetzer" UBYTE B_TRUE 1 100 0 1 BIT_MASK 0x1 FORMAT "%13.11" ECU_ADDRESS 0x800C0A /end MEASUREMENT
/begin MEASUREMENT B_tevet "Condition purge valve on by tester" UBYTE B_TRUE 1 100 0 1 BIT_MASK 0x1 FORMAT "%13.11" ECU_ADDRESS 0x7FA95D /end MEASUREMENT
/begin MEASUREMENT B_tevtstp "Bedingung Stop f¸r TEV Timer" UBYTE B_TRUE 1 100 0 1 BIT_MASK 0x1 FORMAT "%13.11" ECU_ADDRESS 0x7FA95E /end MEASUREMENT
/begin MEASUREMENT B_teza "Bedingung Tankentl¸ftung zwangsaktiv" UBYTE B_TRUE 1 100 0 1 BIT_MASK 0x1 FORMAT "%13.11" ECU_ADDRESS 0x7FA95F /end MEASUREMENT
/begin MEASUREMENT B_tolcb "Bed. Fehlerstatus ÷ltemperatur aus Kombibotschaft od. aus COWIV abh‰ngig von LH" UBYTE B_TRUE 1 100 0 1 BIT_MASK 0x1 FORMAT "%13.11" ECU_ADDRESS 0x7FA960 /end MEASUREMENT
/begin MEASUREMENT B_uetm "Bedingung ‹bertemperatur" UBYTE B_TRUE 1 100 0 1 BIT_MASK 0x1 FORMAT "%13.11" ECU_ADDRESS 0x7FA882 /end MEASUREMENT
/begin MEASUREMENT B_uetmc "Bedingung ‹bertemperatur; CAN-Sende-Botschaft" UBYTE B_TRUE 1 100 0 1 BIT_MASK 0x1 FORMAT "%13.11" ECU_ADDRESS 0x7FA883 /end MEASUREMENT
/begin MEASUREMENT B_umsync "Bedingung Umsynchronisation nach Bezugsmarke" UBYTE B_TRUE 1 100 0 1 BIT_MASK 0x1 FORMAT "%13.11" ECU_ADDRESS 0x7FA961 /end MEASUREMENT
/begin MEASUREMENT B_vs "Bedingung Ventilhub gross" UBYTE B_TRUE 1 100 0 1 BIT_MASK 0x1 FORMAT "%13.11" ECU_ADDRESS 0x7FA962 /end MEASUREMENT
/begin MEASUREMENT B_vziels "Bedingung ‹bernahme berechnete Zielgeschwindigkeit" UBYTE B_TRUE 1 100 0 1 BIT_MASK 0x1 FORMAT "%13.11" ECU_ADDRESS 0x7FA963 /end MEASUREMENT
/begin MEASUREMENT B_wdaactiv "Bedingung WDA-Abschaltung aktiv" UBYTE B_TRUE 1 100 0 1 BIT_MASK 0x1 FORMAT "%13.11" ECU_ADDRESS 0x7FA964 /end MEASUREMENT
/begin MEASUREMENT B_wk "Bedingung: Wandlerkupplung ¸berbr¸ckt" UBYTE B_TRUE 1 100 0 1 BIT_MASK 0x1 FORMAT "%13.11" ECU_ADDRESS 0x7FA965 /end MEASUREMENT
/begin MEASUREMENT B_wkr "Bedingung f¸r Wandlerkupplung geregelt" UBYTE B_TRUE 1 100 0 1 BIT_MASK 0x1 FORMAT "%13.11" ECU_ADDRESS 0x7FA966 /end MEASUREMENT
/begin MEASUREMENT B_zesync "Bedingung Z¸ndung synchronisiert" UBYTE B_TRUE 1 100 0 1 BIT_MASK 0x1 FORMAT "%13.11" ECU_ADDRESS 0x7FA967 /end MEASUREMENT
/begin MEASUREMENT CoolFan_MAF_Req "" UWORD DC_CNTR_U16 1 100 0 65535 FORMAT "%8.2" ECU_ADDRESS 0x803554 /end MEASUREMENT
/begin MEASUREMENT CoolFan_Pwr_Req "" SWORD DC_PCT_S16 1 100 -100.003 100 FORMAT "%8.4" ECU_ADDRESS 0x802ECA /end MEASUREMENT
/begin MEASUREMENT devoff "EV-Ausblendmaske bei Testeranforderung" UBYTE dez 1 100 0 255 FORMAT "%5.1" ECU_ADDRESS 0x80104B /end MEASUREMENT
/begin MEASUREMENT dftef_w "Eingang Integrator Sp¸lrate" SWORD perio_sw_b1p562 1 100 -1.562 1.56195 FORMAT "%8.6" ECU_ADDRESS 0x801780 /end MEASUREMENT
/begin MEASUREMENT dkatefrg "Abweichung Kraftstoffanteil Tankentl¸ftung bei Sollsp¸lrate von Zielwert" SBYTE fak_sb_b1 1 100 -1 0.992188 FORMAT "%5.3" ECU_ADDRESS 0x8011C9 /end MEASUREMENT
/begin MEASUREMENT dkhc_w "Eingang Integrator HC-Konzentration" SWORD perio_sw_b6p125 1 100 -6.125 6.12481 FORMAT "%8.6" ECU_ADDRESS 0x800C02 /end MEASUREMENT
/begin MEASUREMENT dmlftef "Produkt Sp¸lrate mal prozentuale Luftmassen‰nderung" UBYTE fak_ub_b0p5 1 100 0 0.498047 ECU_ADDRESS 0x8011CA /end MEASUREMENT
/begin MEASUREMENT dmssginr "relative ƒnderung des Massenstromes mssgin_w" SBYTE fak_sb_b1 1 100 -1 0.992188 FORMAT "%5.3" ECU_ADDRESS 0x8011CB /end MEASUREMENT
/begin MEASUREMENT dps_w "delta-Saugrohrdruck" SWORD p_sw_q0p039 1 100 -1280 1279.96 FORMAT "%8.3" ECU_ADDRESS 0x801C52 /end MEASUREMENT
/begin MEASUREMENT dstert20_w "Normierte Weitertransportstrecke Regeneriergas im Saugrohr im 20ms-Raster" UWORD fak_uw_b2 1 100 0 1.99997 FORMAT "%8.6" ECU_ADDRESS 0x801782 /end MEASUREMENT
/begin MEASUREMENT dzw_uc "Delta Z¸ndwinkel zwischen zwopt und zwout im Befehlstest" UBYTE zw_ub_q0p75 1 100 0 191.25 FORMAT "%5.1" ECU_ADDRESS 0x801069 /end MEASUREMENT
/begin MEASUREMENT ECC_RotVlv_Posn_Req "" SWORD DC_ANGL_S16 1 100 -2048 2047.94 FORMAT "%8.3" ECU_ADDRESS 0x802EEA /end MEASUREMENT
/begin MEASUREMENT ECC_RotVlv_St "" UBYTE DC_FLAG_U8 1 100 0 1 BIT_MASK 0x1 FORMAT "%5.3" ECU_ADDRESS 0x80363E /end MEASUREMENT
/begin MEASUREMENT ECC_sstRotVlv_Preq "" UWORD DC_SEARCH 1 100 0 65535 FORMAT "%6.0" ECU_ADDRESS 0x802EE8 /end MEASUREMENT
/begin MEASUREMENT ECF_VolFlow "" UWORD DC_FLOW_U16 1 100 0 65535 FORMAT "%6.0" ECU_ADDRESS 0x80357C /end MEASUREMENT
/begin MEASUREMENT ECF_VolFlowRaw "" UWORD DC_FLOW_U16 1 100 0 65535 FORMAT "%6.0" ECU_ADDRESS 0x80357A /end MEASUREMENT
/begin MEASUREMENT ECP_PwrOut "" SWORD DC_PWR_S16 1 100 -4096 4095.88 ECU_ADDRESS 0x8035A2 /end MEASUREMENT
/begin MEASUREMENT ECP_PwrOutRaw "" SWORD DC_PWR_S16 1 100 -4096 4095.88 ECU_ADDRESS 0x80359E /end MEASUREMENT
/begin MEASUREMENT ECTIn_Setpoint "" SWORD DC_TEMP_S16 1 100 -4096 4095.88 FORMAT "%8.3" ECU_ADDRESS 0x8035BE /end MEASUREMENT
/begin MEASUREMENT ECTOut_FailSafe_Mode "" UBYTE DC_FLAG_U8 1 100 0 1 BIT_MASK 0x1 FORMAT "%5.3" ECU_ADDRESS 0x80363D /end MEASUREMENT
/begin MEASUREMENT ECT_Setpoint "" SWORD DC_TEMP_S16 1 100 -4096 4095.88 FORMAT "%8.3" ECU_ADDRESS 0x8035C0 /end MEASUREMENT
/begin MEASUREMENT ECU_RunOn_Mode_Req "" UBYTE DC_FLAG_U8 1 100 0 1 BIT_MASK 0x1 FORMAT "%5.3" ECU_ADDRESS 0x80362E /end MEASUREMENT
/begin MEASUREMENT ECU_RunOn_Req "" UWORD DC_TIME_1MS_U16 1 100 0 65.535 FORMAT "%6.3" ECU_ADDRESS 0x802ECE /end MEASUREMENT
/begin MEASUREMENT ei_accc_uc "" UBYTE B_TRUE 1 100 0 1 BIT_MASK 0x1 FORMAT "%13.11" ECU_ADDRESS 0x7FA600 /end MEASUREMENT
/begin MEASUREMENT ei_accc_um "irreversibles Fehlerbit bei der ACC-‹berwachung der Funktions¸berwachung" UBYTE B_TRUE 1 100 0 1 BIT_MASK 0x1 FORMAT "%13.11" ECU_ADDRESS 0x7F809C /end MEASUREMENT
/begin MEASUREMENT ei_msrc_uc "irreversibles Fehlerbit bei der MSR-‹berwachung im Befehlstest" UBYTE B_TRUE 1 100 0 1 BIT_MASK 0x1 FORMAT "%13.11" ECU_ADDRESS 0x7FA602 /end MEASUREMENT
/begin MEASUREMENT ei_mver_uc "Ebene 3 irreversibles Fehlerbit fuer URCMVER aus BT" UBYTE B_TRUE 1 100 0 1 BIT_MASK 0x1 FORMAT "%13.11" ECU_ADDRESS 0x7FA603 /end MEASUREMENT
/begin MEASUREMENT ei_reac_uc "Ebene 3 irreversibles Fehlerbit fuer UFREAC aus BT" UBYTE B_TRUE 1 100 0 1 BIT_MASK 0x1 FORMAT "%13.11" ECU_ADDRESS 0x7FA604 /end MEASUREMENT
/begin MEASUREMENT ei_sgsc_uc "irreversibles Fehlerbit bei der SGS-‹berwachung im Befehlstest" UWORD B_TRUE 1 100 0 1 BIT_MASK 0x1 FORMAT "%13.11" ECU_ADDRESS 0x7FA606 /end MEASUREMENT
/begin MEASUREMENT ekpausc "CAN-Botschaft EKP-Abschaltung ¸ber Crash-Sensor Airbag-SG" UBYTE dez 1 100 0 3 FORMAT "%5.3" ECU_ADDRESS 0x80122D /end MEASUREMENT
/begin MEASUREMENT elamnhmm_w "Minimaler Lambda-Wirkungsgrad in Betriebsart Homogen mager" UWORD dez 1 100 0 65535 FORMAT "%8.2" ECU_ADDRESS 0x800CF0 /end MEASUREMENT
/begin MEASUREMENT elamnhos_w "Minimaler Lambda-Wirkungsgrad in Betriebsart Homogen/Schicht" UWORD dez 1 100 0 65535 FORMAT "%8.2" ECU_ADDRESS 0x800CF2 /end MEASUREMENT
/begin MEASUREMENT elamnsch_w "Minimaler Lambda-Wirkungsgrad in Betriebsart Schicht" UWORD dez 1 100 0 65535 FORMAT "%8.2" ECU_ADDRESS 0x800CF4 /end MEASUREMENT
/begin MEASUREMENT elamnskh_w "Minimaler Lambda-Wirkungsgrad in Betriebsart Schicht/Katheizen" UWORD dez 1 100 0 65535 FORMAT "%8.2" ECU_ADDRESS 0x800CF6 /end MEASUREMENT
/begin MEASUREMENT elamxskh_w "Maximaler Lambda-Wirkungsgrad in Betriebsart Schicht/Katheizen" UWORD dez 1 100 0 65535 FORMAT "%8.2" ECU_ADDRESS 0x800CF8 /end MEASUREMENT
/begin MEASUREMENT Emis_Mode_Req "" UBYTE DC_FLAG_U8 1 100 0 1 BIT_MASK 0x1 FORMAT "%5.3" ECU_ADDRESS 0x803A49 /end MEASUREMENT
/begin MEASUREMENT Emis_VolFlow "" UWORD DC_FLOW_U16 1 100 0 65535 FORMAT "%6.0" ECU_ADDRESS 0x8035B0 /end MEASUREMENT
/begin MEASUREMENT etaaufte "Wirkungsgrad abh‰ngig von Einspritzaufteilung" UBYTE rel_ub_b127p5 1 100 0 127.5 FORMAT "%5.1" ECU_ADDRESS 0x80122E /end MEASUREMENT
/begin MEASUREMENT etate "Motorwirkungsgrad bei Tankentl¸ftung mit hoher Beladung" UBYTE rel_ub_b127p5 1 100 0 127.5 FORMAT "%5.1" ECU_ADDRESS 0x800BF6 /end MEASUREMENT
/begin MEASUREMENT etateint "Integrator Motrwirkungsgrad bei Tankentl¸ftung" UBYTE rel_ub_b127p5 1 100 0 127.5 FORMAT "%5.1" ECU_ADDRESS 0x800BF7 /end MEASUREMENT
/begin MEASUREMENT etatesol "beladungsabh‰ngiger Soll-Motorwirkungsgrad bei Betrieb mit Tankentl¸ftung" UBYTE rel_ub_b127p5 1 100 0 127.5 FORMAT "%5.1" ECU_ADDRESS 0x800BF8 /end MEASUREMENT
/begin MEASUREMENT etazw_uc "Ist-Z¸ndwinkelwirkungsgrad im Befehlstest" UBYTE rel_ub_b127p5 1 100 0 127.5 FORMAT "%5.1" ECU_ADDRESS 0x80106A /end MEASUREMENT
/begin MEASUREMENT evhbi2_w "Istwert Hubverstellung Bank2. ‹bergabe an ‹berwachung" UWORD wink_uw_q0p1 1 100 0 6553.5 FORMAT "%8.3" ECU_ADDRESS 0x801C54 /end MEASUREMENT
/begin MEASUREMENT evhbi_w "Istwert Hubverstellung. ‹bergabe an ‹berwachung" UWORD wink_uw_q0p1 1 100 0 6553.5 FORMAT "%8.3" ECU_ADDRESS 0x801C56 /end MEASUREMENT
/begin MEASUREMENT evz_aus_uc "Einspritzausblendmuster im Befehlstest" UBYTE dez 1 100 0 255 FORMAT "%5.1" ECU_ADDRESS 0x80105D /end MEASUREMENT
/begin MEASUREMENT fbetate "gew¸nschter Motorwirkungsgrad als f(nmot) bei TE zur Vermeidung von te <= TEMIN" UBYTE fak_ub_b1 1 100 0 0.996094 ECU_ADDRESS 0x800BF9 /end MEASUREMENT
/begin MEASUREMENT fbkate "Faktor Kraftstoffanteil Tankentl¸ftung abh‰ngig von te / TEMIN" UBYTE fak_ub_b1 1 100 0 0.996094 ECU_ADDRESS 0x800BFA /end MEASUREMENT
/begin MEASUREMENT fgwrte "Eingriff Grenzwertregelung Tankentl¸ftung" SBYTE fak_sb_b16 1 100 -16 15.875 FORMAT "%5.2" ECU_ADDRESS 0x800BFB /end MEASUREMENT
/begin MEASUREMENT fkateapp "Faktor applizierter Krafstoffanteil Tankentl¸ftung" SBYTE fak_sb_b1 1 100 -1 0.992188 FORMAT "%5.3" ECU_ADDRESS 0x800BFC /end MEASUREMENT
/begin MEASUREMENT fkatefrg "Faktor Kraftstoffanteil Tankentl¸ftung bei Sollsp¸lrate" SBYTE fak_sb_b1 1 100 -1 0.992188 FORMAT "%5.3" ECU_ADDRESS 0x8011CC /end MEASUREMENT
/begin MEASUREMENT fkatei "Faktor Kraftstoffanteil Tankentl¸ftung (aktueller Istwert)" SBYTE fak_sb_b1 1 100 -1 0.992188 FORMAT "%5.3" ECU_ADDRESS 0x8011CD /end MEASUREMENT
/begin MEASUREMENT fkates "Faktor Kraftstoffanteil Tankentl¸ftung (Sollwert)" SBYTE fak_sb_b1 1 100 -1 0.992188 FORMAT "%5.3" ECU_ADDRESS 0x800BFD /end MEASUREMENT
/begin MEASUREMENT flamkh "Faktor Aufregelung Lambda-Motor-Soll bei Katheizen" UBYTE dez 1 100 0 255 FORMAT "%5.1" ECU_ADDRESS 0x800D08 /end MEASUREMENT
/begin MEASUREMENT fmdkh "Faktor Steuerung Drehmomentreserve f¸r Katheizen" UBYTE dez 1 100 0 255 FORMAT "%5.1" ECU_ADDRESS 0x800D09 /end MEASUREMENT
/begin MEASUREMENT fmsla "Korrekturfaktor Sekund‰rluftmasse adaptiv" UBYTE fak_ub_b2 1 100 0 1.99219 FORMAT "%5.3" ECU_ADDRESS 0x800D0A /end MEASUREMENT
/begin MEASUREMENT fmsla2 "Korrekturfaktor Sekund‰rluftmasse adaptiv Bank 2" UBYTE fak_ub_b2 1 100 0 1.99219 FORMAT "%5.3" ECU_ADDRESS 0x800D0B /end MEASUREMENT
/begin MEASUREMENT fmvurh_w "Faktor Delta Drehmoment Vermeidung Umschaltruck (HOM, HMM, HKS)" UWORD dez 1 100 0 65535 FORMAT "%8.2" ECU_ADDRESS 0x800CFA /end MEASUREMENT
/begin MEASUREMENT fmvurs_w "Faktor Delta Drehmoment Vermeidung Umschaltruck (HOS, SCH, SKH)" UWORD dez 1 100 0 65535 FORMAT "%8.2" ECU_ADDRESS 0x800CFC /end MEASUREMENT
/begin MEASUREMENT fngwrte "Faktor Regelung Sp¸lrate nach Grenzwertregeleingriff" SBYTE fak_sb_b16 1 100 -16 15.875 FORMAT "%5.2" ECU_ADDRESS 0x8011CE /end MEASUREMENT
/begin MEASUREMENT fnwea2 "Interpolationsfaktor NW-‹berschneidung Bereich 2" UBYTE fak_ub_b1 1 100 0 0.996094 ECU_ADDRESS 0x80122F /end MEASUREMENT
/begin MEASUREMENT fnwea3 "Interpolationsfaktor NW-‹berschneidung Bereich 3" UBYTE fak_ub_b1 1 100 0 0.996094 ECU_ADDRESS 0x801230 /end MEASUREMENT
/begin MEASUREMENT fregfte "Faktor Regelung Sp¸lrate vor Grenzwertregeleingriff" SBYTE fak_sb_b16 1 100 -16 15.875 FORMAT "%5.2" ECU_ADDRESS 0x8011CF /end MEASUREMENT
/begin MEASUREMENT frmit "Bei Stereo-LR: Mittelwert des fr,fr2 oder bei Ausfall einer Bank: fr der i.O. Bk" UBYTE fak_ub_b2 1 100 0 1.99219 FORMAT "%5.3" ECU_ADDRESS 0x8011D0 /end MEASUREMENT
/begin MEASUREMENT frmit_w "Mittelwert aus fr und fr2 (16 bit)" UWORD fak_uw_b2 1 100 0 1.99997 FORMAT "%8.6" ECU_ADDRESS 0x801784 /end MEASUREMENT
/begin MEASUREMENT frmxa "fr-Max-Auschlag: Bei Stereo-LR: der fr, der am weitesten von 1.0 entfernt" UBYTE fak_ub_b2 1 100 0 1.99219 FORMAT "%5.3" ECU_ADDRESS 0x8011D1 /end MEASUREMENT
/begin MEASUREMENT frmxaold_w "Mittelwert Lambdaregler - alter Wert (16 bit)" UWORD fak_uw_b2 1 100 0 1.99997 FORMAT "%8.6" ECU_ADDRESS 0x801786 /end MEASUREMENT
/begin MEASUREMENT frmxa_w "fr-Max-Ausschlag: Bei Stereo LR der fr, der am weitesten von 1.0 weg (16 bit)" UWORD fak_uw_b2 1 100 0 1.99997 FORMAT "%8.6" ECU_ADDRESS 0x801788 /end MEASUREMENT
/begin MEASUREMENT fsol "F¸llstand (Motor-)Oel" UBYTE dez 1 100 0 255 FORMAT "%5.1" ECU_ADDRESS 0x80104C /end MEASUREMENT
/begin MEASUREMENT fsttankl "F¸llstand der linken Tankh‰lfte" UBYTE fuel_ub_q0p5 1 100 0 127.5 FORMAT "%5.1" ECU_ADDRESS 0x80104D /end MEASUREMENT
/begin MEASUREMENT ftadmste "Bewrtungsfaktor f¸r Absteuern des TEV bei dynamischer Vorg‰nge" UBYTE fak_ub_b2 1 100 0 1.99219 FORMAT "%5.3" ECU_ADDRESS 0x8011D2 /end MEASUREMENT
/begin MEASUREMENT fteadf "gefilteter Faktor Beladung Sp¸lstrom bei Tankentl¸ftung" SBYTE fak_sb_q0p5 1 100 -64 63.5 FORMAT "%5.2" ECU_ADDRESS 0x800BFE /end MEASUREMENT
/begin MEASUREMENT fteadf_w "gefilteter Faktor Beladung Sp¸lstrom bei Tankentl¸ftung (16 Bit)" SWORD fak_q0p00195 1 100 -64 63.998 FORMAT "%8.5" ECU_ADDRESS 0x800C04 /end MEASUREMENT
/begin MEASUREMENT ftead_w "Beladung des Aktivkohlefilters" SWORD fak_sw_b64 1 100 -64 63.998 FORMAT "%8.5" ECU_ADDRESS 0x800C06 /end MEASUREMENT
/begin MEASUREMENT ftefsold_w "Letzter Sollwert der Sp¸lrate Tankentl¸ftung vor Absteuerung" UWORD fak_uw_b0p5 1 100 0 0.499992 FORMAT "%9.7" ECU_ADDRESS 0x80178A /end MEASUREMENT
/begin MEASUREMENT ftefsoll_w "Sollwert der Sp¸lrate Tankentl¸ftung" UWORD fak_uw_b0p5 1 100 0 0.499992 FORMAT "%9.7" ECU_ADDRESS 0x80178C /end MEASUREMENT
/begin MEASUREMENT ftefva "Sp¸lrate der Tankentl¸ftung" UBYTE fak_ub_b0p5 1 100 0 0.498047 ECU_ADDRESS 0x8011D3 /end MEASUREMENT
/begin MEASUREMENT ftefvab "Begrenzungswert der Sp¸lrate Tankentl¸ftung" UBYTE fak_ub_b0p03125 1 100 0 0.0311279 FORMAT "%7.5" ECU_ADDRESS 0x800BFF /end MEASUREMENT
/begin MEASUREMENT ftefvamx_w "max. Sp¸lrate (Begrenzung absolut, 16 bit)" UWORD fak_uw_b0p5 1 100 0 0.499992 FORMAT "%9.7" ECU_ADDRESS 0x80178E /end MEASUREMENT
/begin MEASUREMENT ftefva_w "Sp¸lrate Tankentl¸ftung" UWORD fak_uw_b0p5 1 100 0 0.499992 FORMAT "%9.7" ECU_ADDRESS 0x801790 /end MEASUREMENT
/begin MEASUREMENT fteml "Aufsteuergeschwindigkeit der Sp¸lrate und des Massenstroms TEV" UBYTE perio_ub_b0p012207 1 100 0 0.0121593 FORMAT "%12.10" ECU_ADDRESS 0x800C00 /end MEASUREMENT
/begin MEASUREMENT ftvdk_w "Korrekturfaktor Temperatur vor Drosselklappe" UWORD fak_uw_b2 1 100 0 1.99997 FORMAT "%8.6" ECU_ADDRESS 0x800CDA /end MEASUREMENT
/begin MEASUREMENT fuel_co_bt "" ULONG dez 1 100 0 4.29497e+009 FORMAT "%13.2" ECU_ADDRESS 0x801CA8 /end MEASUREMENT
/begin MEASUREMENT fuel_co_uc "Um ein Abarbeitungsraster verzˆgerte (alte) Einspritzzeit im Befehlstest" ULONG dez 1 100 0 4.29497e+009 FORMAT "%13.2" ECU_ADDRESS 0x801CC0 /end MEASUREMENT
/begin MEASUREMENT fvermte_w "Faktor Vermischung Regeneriergas im Saugrohr" UWORD fak_uw_b1 1 100 0 0.999985 FORMAT "%9.7" ECU_ADDRESS 0x801792 /end MEASUREMENT
/begin MEASUREMENT fzgtypz "Fahrzeugtyp-Zeiger" UBYTE dez 1 100 0 255 FORMAT "%5.1" ECU_ADDRESS 0x7FC843 /end MEASUREMENT
/begin MEASUREMENT HtrPmp_Flow_Req "" UBYTE DC_FLAG_U8 1 100 0 1 BIT_MASK 0x1 FORMAT "%5.3" ECU_ADDRESS 0x803635 /end MEASUREMENT
/begin MEASUREMENT HtrVlv1_Pos_Req "" UBYTE DC_FLAG_U8 1 100 0 1 BIT_MASK 0x1 FORMAT "%5.3" ECU_ADDRESS 0x803639 /end MEASUREMENT
/begin MEASUREMENT HtrVlv2_Pos_Req "" UBYTE DC_FLAG_U8 1 100 0 1 BIT_MASK 0x1 FORMAT "%5.3" ECU_ADDRESS 0x803637 /end MEASUREMENT
/begin MEASUREMENT HtrVlv_Mode_Req "" UBYTE DC_FLAG_U8 1 100 0 1 BIT_MASK 0x1 FORMAT "%5.3" ECU_ADDRESS 0x803638 /end MEASUREMENT
/begin MEASUREMENT igod_w "Integratorgradient f¸r Nulltest-Diagnose Klopfregelung" SWORD spgg_sw_b3052 1 100 -3051.76 3051.67 FORMAT "%8.3" ECU_ADDRESS 0x8017D6 /end MEASUREMENT
/begin MEASUREMENT igokr_w "Integratorgradient f¸r Offsetkorrektur Klopfregelung (Word)" SWORD spgg_sw_b3052 1 100 -3051.76 3051.67 FORMAT "%8.3" ECU_ADDRESS 0x8017D8 /end MEASUREMENT
/begin MEASUREMENT ikrma_w "Integratorwert Klopfregelung Meﬂfensteranfang" UWORD spg_uw_q0p000076 1 100 0 4.99992 FORMAT "%8.6" ECU_ADDRESS 0x8017DA /end MEASUREMENT
/begin MEASUREMENT ikrme_w "KR: Integratorwert Meﬂfensterende" UWORD dez 1 100 0 65535 FORMAT "%8.2" ECU_ADDRESS 0x800CFE /end MEASUREMENT
/begin MEASUREMENT imsteini "Integral Massenstrom TEV nach l‰ngerem TE-Stop" UBYTE m_ub_q0p0444 1 100 0 11.322 FORMAT "%5.2" ECU_ADDRESS 0x800C01 /end MEASUREMENT
/begin MEASUREMENT khc_w "Adaptierte HC-Konzentration Regenerierstrom" SWORD fak_sw_b2 1 100 -2 1.99994 FORMAT "%8.6" ECU_ADDRESS 0x800C08 /end MEASUREMENT
/begin MEASUREMENT kmstand "Fahrstrecke des Fahrzeugs als Information ¸ber CAN" UWORD km_uw_q10 1 100 0 655350 FORMAT "%8.1" ECU_ADDRESS 0x801C58 /end MEASUREMENT
/begin MEASUREMENT KOP_NSOLF "Korrekturprogrammierung NSOL nicht P/N" SBYTE dez 1 100 -128 127 FORMAT "%5.1" ECU_ADDRESS 0x801231 /end MEASUREMENT
/begin MEASUREMENT KOP_NSOLN "Korrekturprogrammierung NSOL nur  P/N" SBYTE dez 1 100 -128 127 FORMAT "%5.1" ECU_ADDRESS 0x801232 /end MEASUREMENT
/begin MEASUREMENT kteev_w "Konzentration Regeneriergas im Saugrohr auf Hˆhe der Einspritzventile" UWORD fak_uw_b1 1 100 0 0.999985 FORMAT "%9.7" ECU_ADDRESS 0x801794 /end MEASUREMENT
/begin MEASUREMENT ktetevvz_w "Konzentration Regeneriergas im Saugrohr verzˆgert" UWORD fak_uw_b1 1 100 0 0.999985 FORMAT "%9.7" ECU_ADDRESS 0x801796 /end MEASUREMENT
/begin MEASUREMENT ktetev_w "Konzentration Regeneriergas im Saugrohr auf Hˆhe vom TEV" UWORD fak_uw_b1 1 100 0 0.999985 FORMAT "%9.7" ECU_ADDRESS 0x801798 /end MEASUREMENT
/begin MEASUREMENT lamsbrs2_w "Soll-Lambda-Brennraum bezogen auf die Einbauort der Sonde (Bank 2)" UWORD fak_uw_b16 1 100 0 15.9998 FORMAT "%8.5" ECU_ADDRESS 0x8017DC /end MEASUREMENT
/begin MEASUREMENT lamsbrs_w "Soll-Lambda-Brennraum bezogen auf die Einbauort der Sonde" UWORD fak_uw_b16 1 100 0 15.9998 FORMAT "%8.5" ECU_ADDRESS 0x8017DE /end MEASUREMENT
/begin MEASUREMENT lokBits_Tebeb "" UBYTE dez 1 100 0 255 FORMAT "%5.1" ECU_ADDRESS 0x800C0A /end MEASUREMENT
/begin MEASUREMENT mdif_w_uc "Differenz zwischen zul‰ssigem und Ist-Moment im Befehlstest" SWORD rel_ub_q0p3906 1 100 -12800 12799.6 FORMAT "%8.2" ECU_ADDRESS 0x8012CC /end MEASUREMENT
/begin MEASUREMENT mdslw_w "Verlustmoment: Ladungswechsel" UWORD rel_uw_b100 1 100 0 99.9985 FORMAT "%8.5" ECU_ADDRESS 0x8017E0 /end MEASUREMENT
/begin MEASUREMENT mdst08_uc "" ULONG dez 1 100 0 4.29497e+009 FORMAT "%13.2" ECU_ADDRESS 0x801CBC /end MEASUREMENT
/begin MEASUREMENT mdwancan "Drehmomentaufnahme des Wandlers ¸ber CAN" UWORD rel_uw_b200 1 100 0 199.997 FORMAT "%8.4" ECU_ADDRESS 0x8017E2 /end MEASUREMENT
/begin MEASUREMENT mfgr_uc "Momentenwunsch aus der Fahrgeschwindigkeitsregelung im Befehlstest" UBYTE rel_ub_q0p3906 1 100 0 99.6094 FORMAT "%5.2" ECU_ADDRESS 0x801068 /end MEASUREMENT
/begin MEASUREMENT mfgr_um "Momentenwunsch aus der Fahrgeschwindigkeitsregelung f¸r die Funktions¸berwachung" UBYTE rel_ub_q0p3906 1 100 0 99.6094 FORMAT "%5.2" ECU_ADDRESS 0x7F80A0 /end MEASUREMENT
/begin MEASUREMENT mfgr_ur "Doppelablage (DA) f¸r MFGR_UM" UBYTE dez 1 100 0 255 FORMAT "%5.1" ECU_ADDRESS 0x7F81B5 /end MEASUREMENT
/begin MEASUREMENT mibgr_w "indiziertes soll-Moment f¸r gangabh‰ngige Kupplungsmomentbegrenzung" UWORD rel_uw_b100 1 100 0 99.9985 FORMAT "%8.5" ECU_ADDRESS 0x800CDC /end MEASUREMENT
/begin MEASUREMENT mibmn_w "inneres Basis-Moment, betriebsartabh‰ngige untere Grenze" UWORD rel_uw_b100 1 100 0 99.9985 FORMAT "%8.5" ECU_ADDRESS 0x8017E4 /end MEASUREMENT
/begin MEASUREMENT mibmx_w "inneres Basis-Moment, betriebsartabh‰ngige obere Grenze" UWORD rel_uw_b100 1 100 0 99.9985 FORMAT "%8.5" ECU_ADDRESS 0x8017E6 /end MEASUREMENT
/begin MEASUREMENT midstn_w "Gefiltertes indiziertes Sollmoment (Z¸ndungspfad) im Start" UWORD dez 1 100 0 65535 FORMAT "%8.2" ECU_ADDRESS 0x800CDE /end MEASUREMENT
/begin MEASUREMENT mifafu_w "Fahrermomentenwunsch f¸r F¸llung" UWORD rel_uw_b100 1 100 0 99.9985 FORMAT "%8.5" ECU_ADDRESS 0x8017E8 /end MEASUREMENT
/begin MEASUREMENT mifa_bt "" UBYTE dez 1 100 0 255 FORMAT "%5.1" ECU_ADDRESS 0x80105E /end MEASUREMENT
/begin MEASUREMENT migs_w "Indiziertes Soll-Motormoment GS f¸r schnellen Eingriff" UWORD rel_uw_b100 1 100 0 99.9985 FORMAT "%8.5" ECU_ADDRESS 0x800CE0 /end MEASUREMENT
/begin MEASUREMENT miopt_uc "optimales indiziertes Moment im Befehlstest" UBYTE rel_ub_b99p6 1 100 0 99.6094 FORMAT "%5.2" ECU_ADDRESS 0x80106B /end MEASUREMENT
/begin MEASUREMENT mitebg_w "Momentvorgabe f¸r Mindestf¸llung Tankentl¸ftung" UWORD rel_uw_b100 1 100 0 99.9985 FORMAT "%8.5" ECU_ADDRESS 0x80179A /end MEASUREMENT
/begin MEASUREMENT mi_uc "Berechnetes Ist-Moment im Befehlstest" UBYTE rel_ub_b99p6 1 100 0 99.6094 FORMAT "%5.2" ECU_ADDRESS 0x80106C /end MEASUREMENT
/begin MEASUREMENT mkfanb_w "Kupplungsmoment aus begrenztem Fahrerwunsch" SWORD rel_sw_b100 1 100 -100 99.9969 FORMAT "%8.4" ECU_ADDRESS 0x8017EA /end MEASUREMENT
/begin MEASUREMENT mmsr_uc "zul‰ssiger MSR-Momentenwunsch f¸r die Funktions¸berwachung" UBYTE rel_ub_q0p3906 1 100 0 99.6094 FORMAT "%5.2" ECU_ADDRESS 0x80106F /end MEASUREMENT
/begin MEASUREMENT mped_uc "zul‰ssiges indiziertes Moment aus Fahrpedal im Befehlstest" UBYTE rel_ub_b99p6 1 100 0 99.6094 FORMAT "%5.2" ECU_ADDRESS 0x801081 /end MEASUREMENT
/begin MEASUREMENT mracc_w "Relativer Momentenwunsch von ACC" UWORD dez 1 100 0 65535 FORMAT "%8.2" ECU_ADDRESS 0x800D00 /end MEASUREMENT
/begin MEASUREMENT mrped_w "relatives Fahrerwunschmoment aus Fahrpedal" UWORD rel_uw_b200 1 100 0 199.997 FORMAT "%8.4" ECU_ADDRESS 0x8017EC /end MEASUREMENT
/begin MEASUREMENT msgs_uc "Soll- Motormoment aus Getriebe¸berwachung im Befehlstest" UBYTE rel_ub_q0p3906 1 100 0 99.6094 FORMAT "%5.2" ECU_ADDRESS 0x801087 /end MEASUREMENT
/begin MEASUREMENT msrc_c_uc "Fehlerz‰hler f¸r MSR-‹berwachung des Befehlstestes" UBYTE t40ms_ub_b10200 1 100 0 10200 FORMAT "%7.1" ECU_ADDRESS 0x801070 /end MEASUREMENT
/begin MEASUREMENT mssginmn_w "Minmaler ins Saugrohr strˆmender Massenstrom (Drosselklappe + TEV)" UWORD m_uw_b6553p5 1 100 0 6553.5 FORMAT "%8.3" ECU_ADDRESS 0x80179C /end MEASUREMENT
/begin MEASUREMENT mssgin_w "Ins Saugrohr strˆmender Massenstrom (Drosselklappe + TEV)" UWORD m_uw_b6553p5 1 100 0 6553.5 FORMAT "%8.3" ECU_ADDRESS 0x80179E /end MEASUREMENT
/begin MEASUREMENT msteev_w "Massenstrom Regeneriergas auf Hˆhe Einspritzventil" UWORD m_uw_b25p6 1 100 0 25.5996 FORMAT "%8.5" ECU_ADDRESS 0x8017A0 /end MEASUREMENT
/begin MEASUREMENT mstesmx_w "Maximal mˆglicher Sollmassenstrom Tankentl¸ftung" UWORD m_uw_b25p6 1 100 0 25.5996 FORMAT "%8.5" ECU_ADDRESS 0x8017A2 /end MEASUREMENT
/begin MEASUREMENT mstesoll_w "Massenstrom Tankentl¸ftung ins Saugrohr, Sollwert" UWORD m_uw_b25p6 1 100 0 25.5996 FORMAT "%8.5" ECU_ADDRESS 0x8017A4 /end MEASUREMENT
/begin MEASUREMENT mver_c_uc "Fehlerz‰hler f¸r Momentenvergleich im Befehlstest" UBYTE t40ms_ub_b10200 1 100 0 10200 FORMAT "%7.1" ECU_ADDRESS 0x801071 /end MEASUREMENT
/begin MEASUREMENT mzfo_uc "Gefiltertes zul‰ssiges Moment inclusive Offset im Befehlstest" UBYTE rel_ub_q0p3906 1 100 0 99.6094 FORMAT "%5.2" ECU_ADDRESS 0x801072 /end MEASUREMENT
/begin MEASUREMENT mzf_l_uc "Nachkommastellen f¸r gefiltertes zul‰ssiges Moment des Befehlstestes" UBYTE rel_ub_q0p00153 1 100 0 0.389074 ECU_ADDRESS 0x801074 /end MEASUREMENT
/begin MEASUREMENT mzf_p_uc "Zeiger des Schieberegisters f¸r Verzugszeit mzf_r_ur im Momentenfilter des BT" UBYTE dez 1 100 0 255 FORMAT "%5.1" ECU_ADDRESS 0x801075 /end MEASUREMENT
/begin MEASUREMENT mzf_r_uc "Schieberegister f¸r Verzugszeit im Momentenfilter des Befehlstestes" UBYTE rel_ub_q0p3906 1 100 0 99.6094 FORMAT "%5.2" ARRAY_SIZE 8 ECU_ADDRESS 0x801078 /end MEASUREMENT
/begin MEASUREMENT mzf_uc "gefiltertes zul‰ssiges Moment im Befehlstest" UBYTE rel_ub_q0p3906 1 100 0 99.6094 FORMAT "%5.2" ECU_ADDRESS 0x801080 /end MEASUREMENT
/begin MEASUREMENT mzo_uc "Toleranz-Offset f¸r das zul‰ssige Moment im Befehlstest" UBYTE rel_ub_b99p6 1 100 0 99.6094 FORMAT "%5.2" ECU_ADDRESS 0x801082 /end MEASUREMENT
/begin MEASUREMENT mz_uc "resultierendes zul‰ssiges Moment im Befehlstest" UBYTE rel_ub_b99p6 1 100 0 99.6094 FORMAT "%5.2" ECU_ADDRESS 0x801083 /end MEASUREMENT
/begin MEASUREMENT ndcdis_w "Drehzahlgrenze bei Abgeschalteter DK durch ‹berwachung" UWORD nmot_uw_q0p25 1 100 0 16383.8 FORMAT "%8.2" ECU_ADDRESS 0x800CE2 /end MEASUREMENT
/begin MEASUREMENT ndsalsu "Anzahl der g¸ltigen Schubvorg‰nge f¸r die Diagnosefunktion" UBYTE dez 1 100 0 255 FORMAT "%5.1" ECU_ADDRESS 0x800D0C /end MEASUREMENT
/begin MEASUREMENT nmaxext_w "Externe Drehzahlgrenze" UWORD nmot_uw_q0p25 1 100 0 16383.8 FORMAT "%8.2" ECU_ADDRESS 0x7F9B02 /end MEASUREMENT
/begin MEASUREMENT nmot_uc "Motordrehzahl im Befehlstest" UBYTE nmot_ub_q40 1 100 0 10200 FORMAT "%5.0" ECU_ADDRESS 0x80105F /end MEASUREMENT
/begin MEASUREMENT nmst08_uc "" ULONG dez 1 100 0 4.29497e+009 FORMAT "%13.2" ECU_ADDRESS 0x801CAC /end MEASUREMENT
/begin MEASUREMENT nska_uc "Grenzdrehzahl bei aktiver Fehlerreaktion im Befehlstest" UBYTE nmot_ub_q40 1 100 0 10200 FORMAT "%5.0" ECU_ADDRESS 0x801084 /end MEASUREMENT
/begin MEASUREMENT nsllm "LLR: Motortemperaturabh‰ngige Solldrehzahl im LL" UBYTE nmot_ub_q10 1 100 0 2550 FORMAT "%5.0" ECU_ADDRESS 0x800CD3 /end MEASUREMENT
/begin MEASUREMENT nturbc_w "Wandler-Turbinendrehzahl ¸ber CAN" UWORD nmot_q0p1453421 1 100 0 9524.99 FORMAT "%8.3" ECU_ADDRESS 0x800CE4 /end MEASUREMENT
/begin MEASUREMENT nzwst08_uc "" ULONG dez 1 100 0 4.29497e+009 FORMAT "%13.2" ECU_ADDRESS 0x801CB0 /end MEASUREMENT
/begin MEASUREMENT n_flags_uc "Byte f¸r Nachstart-Bits des Befehlstestes" UBYTE dez 1 100 0 255 FORMAT "%5.1" ECU_ADDRESS 0x801089 /end MEASUREMENT
/begin MEASUREMENT obdstegs "aus CAN-Signal OBD_STAT_GS aufbereitete Grˆﬂe f¸r ME" UBYTE dez 1 100 0 4 FORMAT "%5.3" ECU_ADDRESS 0x80104E /end MEASUREMENT
/begin MEASUREMENT OilTemp_Mode "" UBYTE DC_FLAG_U8 1 100 0 1 BIT_MASK 0x1 FORMAT "%5.3" ECU_ADDRESS 0x80362D /end MEASUREMENT
/begin MEASUREMENT OilT_Setpoint "" SWORD DC_TEMP_S16 1 100 -4096 4095.88 FORMAT "%8.3" ECU_ADDRESS 0x8035BA /end MEASUREMENT
/begin MEASUREMENT pabvtl2_w "Abgasgegendruck vor Turbolader Bank 2" UWORD p_uw_q0p039 1 100 0 2559.96 FORMAT "%8.3" ECU_ADDRESS 0x800CE6 /end MEASUREMENT
/begin MEASUREMENT pabvtl_w "Abgasgegendruck vor Turbolader" UWORD p_uw_q0p039 1 100 0 2559.96 FORMAT "%8.3" ECU_ADDRESS 0x800CE8 /end MEASUREMENT
/begin MEASUREMENT psdss_u "Saugrohrdruck gemessen mit Drucksensor am Saugrohr (DS-S) mit SAE-Quantisierung" UBYTE p_ub_q10 1 100 0 2550 FORMAT "%5.0" ECU_ADDRESS 0x801233 /end MEASUREMENT
/begin MEASUREMENT psmxbkvg_w "geforderter max. Saugrohrdruck f¸r Bremsunterdruckspeicher" UWORD dez 1 100 0 65535 FORMAT "%8.2" ECU_ADDRESS 0x800D02 /end MEASUREMENT
/begin MEASUREMENT pspu "Quotient Saugrohrdruck Umgebungsdruck" UBYTE fak_ub_b2 1 100 0 1.99219 FORMAT "%5.3" ECU_ADDRESS 0x8011D4 /end MEASUREMENT
/begin MEASUREMENT pte "Tankdifferenzdruck, Eingangssignal, (nach AD-Wandler)" UBYTE p_sb_q32 1 100 0 63.75 FORMAT "%5.2" ECU_ADDRESS 0x800CD2 /end MEASUREMENT
/begin MEASUREMENT qmsdyn "Quotient aus ml_w und mssgin_w" UBYTE fak_ub_b16 1 100 0 15.9375 FORMAT "%5.2" ECU_ADDRESS 0x8011D5 /end MEASUREMENT
/begin MEASUREMENT qtetemin "Quotient: te / TEMIN f¸r BDE teh_w/teminh_w bzw. tes_w/temins" UBYTE fak_ub_b4 1 100 0 3.98438 FORMAT "%5.3" ECU_ADDRESS 0x8011D6 /end MEASUREMENT
/begin MEASUREMENT qualol "Qualit‰t (Motor-)Oel" UBYTE dez 1 100 0 255 FORMAT "%5.1" ECU_ADDRESS 0x80104F /end MEASUREMENT
/begin MEASUREMENT reac_c1_uc "Fehlerz‰hler 1 f¸r Fehlerreaktions¸berwachung im Befehlstest" UBYTE t40ms_ub_b10200 1 100 0 10200 FORMAT "%7.1" ECU_ADDRESS 0x801085 /end MEASUREMENT
/begin MEASUREMENT reac_c2_uc "Fehlerz‰hler 2 f¸r Fehlerreaktions¸berwachung im Befehlstest" UBYTE t40ms_ub_b10200 1 100 0 10200 FORMAT "%7.1" ECU_ADDRESS 0x801086 /end MEASUREMENT
/begin MEASUREMENT recilamf_w "gefilterte Grˆﬂe recilam" UWORD fak_uw_b16 1 100 0 15.9998 FORMAT "%8.5" ECU_ADDRESS 0x8017EE /end MEASUREMENT
/begin MEASUREMENT rememberP3Max "" ULONG dez 1 100 0 4.29497e+009 FORMAT "%13.2" ECU_ADDRESS 0x802054 /end MEASUREMENT
/begin MEASUREMENT rinv2_w "Istwert (word) Innenwiderstand Ri-Nernstzelle der Lambdasonde vor KAT Bank2" UWORD r_uw_q2 1 100 0 131070 FORMAT "%8.1" ECU_ADDRESS 0x8017F0 /end MEASUREMENT
/begin MEASUREMENT rinv_w "Istwert (word) Innenwiderstand Ri-Nernstzelle der Lambdasonde vor KAT" UWORD r_uw_q2 1 100 0 131070 FORMAT "%8.1" ECU_ADDRESS 0x8017F2 /end MEASUREMENT
/begin MEASUREMENT rirints_w "rel.Sollinertgasf¸llung ¸ber internes AGR" UWORD rel_uw_q0p0234 1 100 0 1535.98 FORMAT "%8.3" ECU_ADDRESS 0x8017F4 /end MEASUREMENT
/begin MEASUREMENT rkte_w "Relativer Gemischanteil Tankentl¸ftung" SWORD rel_sw_q0p0468 1 100 -1536 1535.95 FORMAT "%8.3" ECU_ADDRESS 0x8017A6 /end MEASUREMENT
/begin MEASUREMENT rkweza_w "Vektor additive Kraftstoffmenge bei Wiedereinsetzen (Array)" UWORD rel_uw_b3072 1 100 0 3071.95 FORMAT "%8.3" ARRAY_SIZE 8 ECU_ADDRESS 0x7F9B04 /end MEASUREMENT
/begin MEASUREMENT rlminhom_w "minimale Luft f¸r Homogenbetrieb" UWORD rel_uw_q0p0234 1 100 0 1535.98 FORMAT "%8.3" ECU_ADDRESS 0x8017F6 /end MEASUREMENT
/begin MEASUREMENT rlrints_w "relative Solluftfullung uber internes AGR" UWORD rel_uw_q0p0234 1 100 0 1535.98 FORMAT "%8.3" ECU_ADDRESS 0x8017F8 /end MEASUREMENT
/begin MEASUREMENT rlst08_uc "rlst08_um im Befehlstest" ULONG dez 1 100 0 4.29497e+009 FORMAT "%13.2" ECU_ADDRESS 0x801CB4 /end MEASUREMENT
/begin MEASUREMENT rlteev_w "Relative F¸llung verursacht durch Regeneriergas Tankentl¸ftung" UWORD rel_uw_b192 1 100 0 191.997 FORMAT "%8.4" ECU_ADDRESS 0x8017A8 /end MEASUREMENT
/begin MEASUREMENT rl_f "relative Luftf¸llung (Float)" FLOAT32_IEEE fak_r32_1 1 100 -1e+037 1e+037 FORMAT "%43.4" ECU_ADDRESS 0x7F9B14 /end MEASUREMENT
/begin MEASUREMENT rl_uc "relative Luftf¸llung im Befehlstest" UBYTE rel_ub_q0p75 1 100 0 191.25 FORMAT "%5.1" ECU_ADDRESS 0x801060 /end MEASUREMENT
/begin MEASUREMENT r_flags_uc "Byte f¸r Fehlerreaktions-Bits des Befehlstest" UBYTE dez 1 100 0 255 FORMAT "%5.1" ECU_ADDRESS 0x80108A /end MEASUREMENT
/begin MEASUREMENT sgsc_c_uc "Fehlerz‰hler f¸r Getriebe¸berwachung des Befehlstestes" UBYTE t40ms_ub_b10200 1 100 0 10200 FORMAT "%7.1" ECU_ADDRESS 0x801088 /end MEASUREMENT
/begin MEASUREMENT Shuttr_Pos_Req "" SWORD DC_PCT_S16 1 100 -100.003 100 FORMAT "%8.4" ECU_ADDRESS 0x802ECC /end MEASUREMENT
/begin MEASUREMENT spnst08_uc "" ULONG dez 1 100 0 4.29497e+009 FORMAT "%13.2" ECU_ADDRESS 0x801CB8 /end MEASUREMENT
/begin MEASUREMENT spsn_uc "Pedalwert (8 Bit) im Befehlstest" UBYTE spg_ub_q0p019 1 100 0 4.98047 FORMAT "%5.3" ECU_ADDRESS 0x801061 /end MEASUREMENT
/begin MEASUREMENT sst_EngLoad "" UWORD DC_SEARCH 1 100 0 65535 FORMAT "%6.0" ECU_ADDRESS 0x803524 /end MEASUREMENT
/begin MEASUREMENT S_bls "Schalter Bremslicht" UBYTE B_TRUE 1 100 0 1 BIT_MASK 0x1 FORMAT "%13.11" ECU_ADDRESS 0x7FA968 /end MEASUREMENT
/begin MEASUREMENT S_brs "Schalter Bremstest" UBYTE B_TRUE 1 100 0 1 BIT_MASK 0x1 FORMAT "%13.11" ECU_ADDRESS 0x7FA969 /end MEASUREMENT
/begin MEASUREMENT s_flags_uc "Byte f¸r Status-Bits des Befehlstests" UBYTE dez 1 100 0 255 FORMAT "%5.1" ECU_ADDRESS 0x80108B /end MEASUREMENT
/begin MEASUREMENT tahso2_w "Abgastemperatur an Sonde hinter Kat aus Modell, Bank 2" UWORD temp_q0p0234_o273 1 100 -273.15 1262.83 FORMAT "%8.3" ECU_ADDRESS 0x800906 /end MEASUREMENT
/begin MEASUREMENT tahsoab2_w "Abgastemperatur beim Abstellen des Motors an Sonde hinter Kat aus Modell, Bank2" UWORD temp_q0p0234_o273 1 100 -273.15 1262.83 FORMAT "%8.3" ECU_ADDRESS 0x800908 /end MEASUREMENT
/begin MEASUREMENT tahsoab_w "Abgastemperatur beim Abstellen des Motors an Sonde hinter Kat aus Modell" UWORD temp_q0p0234_o273 1 100 -273.15 1262.83 FORMAT "%8.3" ECU_ADDRESS 0x80090A /end MEASUREMENT
/begin MEASUREMENT tahsom2_w "Abgastemperatur an Sonde hinter Kat aus Modell, Bank 2" UWORD temp_q0p0234_o273 1 100 -273.15 1262.83 FORMAT "%8.3" ECU_ADDRESS 0x80090C /end MEASUREMENT
/begin MEASUREMENT tahsom_w "Abgastemperatur an Sonde hinter Kat aus Modell" UWORD temp_q0p0234_o273 1 100 -273.15 1262.83 FORMAT "%8.3" ECU_ADDRESS 0x80090E /end MEASUREMENT
/begin MEASUREMENT tahso_w "Abgastemperatur an Sonde hinter Kat aus Modell" UWORD temp_q0p0234_o273 1 100 -273.15 1262.83 FORMAT "%8.3" ECU_ADDRESS 0x800910 /end MEASUREMENT
/begin MEASUREMENT taikrm2_w "Abgastemperatur im Kr¸mmer (Zusammenf¸hrung aller Zylinder) aus Modell, Bank 2" UWORD temp_q0p0234_o273 1 100 -273.15 1262.83 FORMAT "%8.3" ECU_ADDRESS 0x800912 /end MEASUREMENT
/begin MEASUREMENT taikrm_w "Abgastemperatur im Kr¸mmer (Zusammenf¸hrung aller Zylinder) aus Modell" UWORD temp_q0p0234_o273 1 100 -273.15 1262.83 FORMAT "%8.3" ECU_ADDRESS 0x800914 /end MEASUREMENT
/begin MEASUREMENT talsuf "gefilterte Abgastemperatur aus Modell" UBYTE temp_ub_q5_o50 1 100 -50 1225 FORMAT "%5.0" ECU_ADDRESS 0x800CD4 /end MEASUREMENT
/begin MEASUREMENT talsuf2 "gefilterte Abgastemperatur aus Modell, Bank2" UBYTE temp_ub_q5_o50 1 100 -50 1225 FORMAT "%5.0" ECU_ADDRESS 0x800CD5 /end MEASUREMENT
/begin MEASUREMENT tanhkm2_w "Abgastemperatur nach Hauptkat aus Modell, Bank2" UWORD temp_q0p0234_o273 1 100 -273.15 1262.83 FORMAT "%8.3" ECU_ADDRESS 0x800916 /end MEASUREMENT
/begin MEASUREMENT tanhkm_w "Abgastemperatur hinter Hauptkat aus Modell" UWORD temp_q0p0234_o273 1 100 -273.15 1262.83 FORMAT "%8.3" ECU_ADDRESS 0x800918 /end MEASUREMENT
/begin MEASUREMENT tanvk2_w "Abgastemperatur nach dem Vorkat, Bank 2" UWORD temp_q0p0234_o273 1 100 -273.15 1262.83 FORMAT "%8.3" ECU_ADDRESS 0x80091A /end MEASUREMENT
/begin MEASUREMENT tanvkm2_w "Modellierte Abgastemperatur hinter dem Vorkatalysator, Bank 2" UWORD temp_q0p0234_o273 1 100 -273.15 1262.83 FORMAT "%8.3" ECU_ADDRESS 0x80091C /end MEASUREMENT
/begin MEASUREMENT tanvkm_w "Modellierte Abgastemperatur hinter dem Vorkatalysator" UWORD temp_q0p0234_o273 1 100 -273.15 1262.83 FORMAT "%8.3" ECU_ADDRESS 0x80091E /end MEASUREMENT
/begin MEASUREMENT tanvk_w "Abgastemperatur nach dem Vorkat" UWORD temp_q0p0234_o273 1 100 -273.15 1262.83 FORMAT "%8.3" ECU_ADDRESS 0x800920 /end MEASUREMENT
/begin MEASUREMENT tatuk "Ansaugluft- oder Umgebungstemperatur, Ausgabe in Grad C, intern in Kelvin" UBYTE temp_q6_o273 1 100 -273.15 1256.85 FORMAT "%5.0" ECU_ADDRESS 0x80094A /end MEASUREMENT
/begin MEASUREMENT tatuk_w "Ansaugluft- oder Umgebungstemperatur, Ausgabe in Grad C, intern in Kelvin" UWORD temp_q0p0234_o273 1 100 -273.15 1256.85 FORMAT "%8.3" ECU_ADDRESS 0x800922 /end MEASUREMENT
/begin MEASUREMENT tavdkg_w "" UWORD temp_uw_q0p0029_o48 1 100 -48 143.997 FORMAT "%8.4" ECU_ADDRESS 0x8017FA /end MEASUREMENT
/begin MEASUREMENT tavhkm2_w "Abgastemperatur vor Hauptkat aus Modell, Bank 2" UWORD temp_q0p0234_o273 1 100 -273.15 1262.83 FORMAT "%8.3" ECU_ADDRESS 0x800924 /end MEASUREMENT
/begin MEASUREMENT tavhkm_w "Abgastemperatur vor Hauptkat aus Modell" UWORD temp_q0p0234_o273 1 100 -273.15 1262.83 FORMAT "%8.3" ECU_ADDRESS 0x800926 /end MEASUREMENT
/begin MEASUREMENT tavro2_w "Abgastemperatur im Rohrst¸ck vor Frontkat, Bank2" UWORD temp_q0p0234_o273 1 100 -273.15 1262.83 FORMAT "%8.3" ECU_ADDRESS 0x800D04 /end MEASUREMENT
/begin MEASUREMENT tavrom2_w "Abgastemperatur im Rohrst¸ck vor Vorkat modelliert (Bank2)" UWORD temp_q0p0234_o273 1 100 -273.15 1262.83 FORMAT "%8.3" ECU_ADDRESS 0x800928 /end MEASUREMENT
/begin MEASUREMENT tavrom_w "Abgastemperatur im Rohrstuck nach Kr¸mmer modelliert" UWORD temp_q0p0234_o273 1 100 -273.15 1262.83 FORMAT "%8.3" ECU_ADDRESS 0x80092A /end MEASUREMENT
/begin MEASUREMENT tavro_w "Abgastemperatur im Rohrst¸ck vor Frontkat" UWORD temp_q0p0234_o273 1 100 -273.15 1262.83 FORMAT "%8.3" ECU_ADDRESS 0x800CEA /end MEASUREMENT
/begin MEASUREMENT tavso2_w "Abgastemperatur an Sonde vor Kat aus Modell, Bank 2" UWORD temp_q0p0234_o273 1 100 -273.15 1262.83 FORMAT "%8.3" ECU_ADDRESS 0x80092C /end MEASUREMENT
/begin MEASUREMENT tavsoab2_w "Abgastemperatur beim Abstellen des Motors an Sonde vor Kat aus Modell, Bank2" UWORD temp_q0p0234_o273 1 100 -273.15 1262.83 FORMAT "%8.3" ECU_ADDRESS 0x80092E /end MEASUREMENT
/begin MEASUREMENT tavsoab_w "Abgastemperatur beim Abstellen des Motors an Sonde vor Kat aus Modell" UWORD temp_q0p0234_o273 1 100 -273.15 1262.83 FORMAT "%8.3" ECU_ADDRESS 0x800930 /end MEASUREMENT
/begin MEASUREMENT tavsom2_w "Abgastemperatur an Sonde vor Kat aus Modell, Bank 2" UWORD temp_q0p0234_o273 1 100 -273.15 1262.83 FORMAT "%8.3" ECU_ADDRESS 0x800932 /end MEASUREMENT
/begin MEASUREMENT tavsom_w "Abgastemperatur an Sonde vor Kat aus Modell" UWORD temp_q0p0234_o273 1 100 -273.15 1262.83 FORMAT "%8.3" ECU_ADDRESS 0x800934 /end MEASUREMENT
/begin MEASUREMENT tavso_w "Abgastemperatur an Sonde vor Kat aus Modell" UWORD temp_q0p0234_o273 1 100 -273.15 1262.83 FORMAT "%8.3" ECU_ADDRESS 0x800936 /end MEASUREMENT
/begin MEASUREMENT tavvkm2_w "Abgastemperatur vor Vorkat aus Modell, Bank2" UWORD temp_q0p0234_o273 1 100 -273.15 1262.83 FORMAT "%8.3" ECU_ADDRESS 0x800938 /end MEASUREMENT
/begin MEASUREMENT tavvkm_w "Abgastemperatur vor Vorkat aus Modell" UWORD temp_q0p0234_o273 1 100 -273.15 1262.83 FORMAT "%8.3" ECU_ADDRESS 0x80093A /end MEASUREMENT
/begin MEASUREMENT te2_w "effektive Einspritzzeit Bank2 (word)" UWORD t8p0usxms 1 100 0 524.28 FORMAT "%8.4" ECU_ADDRESS 0x801C5A /end MEASUREMENT
/begin MEASUREMENT te_w "effektive Einspritzzeit (word)" UWORD t8p0usxms 1 100 0 524.28 FORMAT "%8.4" ECU_ADDRESS 0x801C5C /end MEASUREMENT
/begin MEASUREMENT tfst "Tankf¸llstand" UBYTE fuel_ub_q1 1 100 0 255 FORMAT "%5.1" ECU_ADDRESS 0x801050 /end MEASUREMENT
/begin MEASUREMENT timmot_w "Z‰hler Zeit nach Motorlauf n>NINI (word)" UWORD t10msxs_uw_b655p35 1 100 0 655.35 FORMAT "%8.4" ECU_ADDRESS 0x8015E8 /end MEASUREMENT
/begin MEASUREMENT tkatmf "gefilterte Katalysatortemperatur aus Modell" UBYTE temp_ub_q5_o50 1 100 -50 1225 FORMAT "%5.0" ECU_ADDRESS 0x800CD6 /end MEASUREMENT
/begin MEASUREMENT tkatmf2 "gefilterte Katalysatortemperatur aus Modell, Bank2" UBYTE temp_ub_q5_o50 1 100 -50 1225 FORMAT "%5.0" ECU_ADDRESS 0x800CD7 /end MEASUREMENT
/begin MEASUREMENT tkdfaAusBits2 "" UWORD dez 1 100 0 65535 FORMAT "%8.2" ECU_ADDRESS 0x801C5E /end MEASUREMENT
/begin MEASUREMENT tkihkm2_w "Temperatur Katalysator im Hauptkat aus  Modell, Bank2" UWORD temp_q0p0234_o273 1 100 -273.15 1262.83 FORMAT "%8.3" ECU_ADDRESS 0x80093C /end MEASUREMENT
/begin MEASUREMENT tkihkm_w "Temperatur Katalysator im Hauptkat aus Modell" UWORD temp_q0p0234_o273 1 100 -273.15 1262.83 FORMAT "%8.3" ECU_ADDRESS 0x80093E /end MEASUREMENT
/begin MEASUREMENT tkiuem2_w "Temperatur Katalysator im ¸berwachten Kat aus Modell, Bank 2" UWORD temp_q0p0234_o273 1 100 -273.15 1262.83 FORMAT "%8.3" ECU_ADDRESS 0x800940 /end MEASUREMENT
/begin MEASUREMENT tkiuem_w "Temperatur Katalysator im ¸berwachten Kat aus Modell" UWORD temp_q0p0234_o273 1 100 -273.15 1262.83 FORMAT "%8.3" ECU_ADDRESS 0x800942 /end MEASUREMENT
/begin MEASUREMENT tkivkm2_w "Temperatur im Vorkatalysator nach dem ersten Teil des Monolithen, Bank2" UWORD temp_q0p0234_o273 1 100 -273.15 1262.83 FORMAT "%8.3" ECU_ADDRESS 0x800944 /end MEASUREMENT
/begin MEASUREMENT tkivkm_w "Temperatur im Vorkatalysator nach dem ersten Teil des Monolithen" UWORD temp_q0p0234_o273 1 100 -273.15 1262.83 FORMAT "%8.3" ECU_ADDRESS 0x800946 /end MEASUREMENT
/begin MEASUREMENT tmki "Motortemperatur aus Kombiinstrument" UBYTE temp_ub_q0p75_o48 1 100 -48 143.25 FORMAT "%5.1" ECU_ADDRESS 0x800CD8 /end MEASUREMENT
/begin MEASUREMENT tmotk "Motor-Temperatur, Ausgabe in Grad C, intern in Kelvin" UBYTE temp_q6_o273 1 100 -273.15 1256.85 FORMAT "%5.0" ECU_ADDRESS 0x80094B /end MEASUREMENT
/begin MEASUREMENT tmotk_w "Motor-Temperatur, Ausgabe in Grad C, intern in Kelvin" UWORD temp_q0p0234_o273 1 100 -273.15 1256.85 FORMAT "%8.3" ECU_ADDRESS 0x800948 /end MEASUREMENT
/begin MEASUREMENT TMOverride "" UBYTE DC_FLAG_U8 1 100 0 1 BIT_MASK 0x1 FORMAT "%5.3" ECU_ADDRESS 0x80363C /end MEASUREMENT
/begin MEASUREMENT TM_CAF_CT_AC_MAF_Req "" UWORD DC_SEARCH 1 100 0 65535 FORMAT "%6.0" ECU_ADDRESS 0x80351C /end MEASUREMENT
/begin MEASUREMENT TM_CAF_CT_AC_MAF_Req_Out "" UWORD DC_CNTR_U16 1 100 0 65535 FORMAT "%8.2" ECU_ADDRESS 0x80352E /end MEASUREMENT
/begin MEASUREMENT TM_CAF_CT_AC_Req "" UWORD DC_CNTR_U16 1 100 0 65535 FORMAT "%8.2" ECU_ADDRESS 0x80355C /end MEASUREMENT
/begin MEASUREMENT TM_CAF_CT_CFSR_Veh_Spd_Req "" UWORD DC_CNTR_U16 1 100 0 65535 FORMAT "%8.2" ECU_ADDRESS 0x803536 /end MEASUREMENT
/begin MEASUREMENT TM_CAF_CT_CoolFanSpd_Req "" UWORD DC_PER0327 1 100 0 100 FORMAT "%8.4" ECU_ADDRESS 0x80355A /end MEASUREMENT
/begin MEASUREMENT TM_CAF_CT_CoolFan_MAF_Req "" UWORD DC_CNTR_U16 1 100 0 65535 FORMAT "%8.2" ECU_ADDRESS 0x803558 /end MEASUREMENT
/begin MEASUREMENT TM_CAF_CT_ECU_Temp "" UWORD DC_SEARCH 1 100 0 65535 FORMAT "%6.0" ECU_ADDRESS 0x803528 /end MEASUREMENT
/begin MEASUREMENT TM_CAF_CT_ECU_Temp_Req "" UWORD DC_CNTR_U16 1 100 0 65535 FORMAT "%8.2" ECU_ADDRESS 0x803532 /end MEASUREMENT
/begin MEASUREMENT TM_CAF_CT_EngLoad "" SWORD DC_TEMP_S16 1 100 -4096 4095.88 FORMAT "%8.3" ECU_ADDRESS 0x80352C /end MEASUREMENT
/begin MEASUREMENT TM_CAF_CT_EngLoad_sstIn "" SWORD DC_PCT_S16 1 100 -100.003 100 FORMAT "%8.4" ECU_ADDRESS 0x803542 /end MEASUREMENT
/begin MEASUREMENT TM_CAF_CT_ETC "" UWORD DC_SEARCH 1 100 0 65535 FORMAT "%6.0" ECU_ADDRESS 0x803522 /end MEASUREMENT
/begin MEASUREMENT TM_CAF_CT_ETC_C_Setpoint "" SWORD DC_TEMP_S16 1 100 -4096 4095.88 FORMAT "%8.3" ECU_ADDRESS 0x80355E /end MEASUREMENT
/begin MEASUREMENT TM_CAF_CT_ETC_C_Setp_In "" UWORD DC_SEARCH 1 100 0 65535 FORMAT "%6.0" ECU_ADDRESS 0x803520 /end MEASUREMENT
/begin MEASUREMENT TM_CAF_CT_ETC_C_Setp_Req "" UWORD DC_CNTR_U16 1 100 0 65535 FORMAT "%8.2" ECU_ADDRESS 0x803538 /end MEASUREMENT
/begin MEASUREMENT TM_CAF_CT_ETC_sstIn "" SWORD DC_TEMP_S16 1 100 -4096 4095.88 FORMAT "%8.3" ECU_ADDRESS 0x803556 /end MEASUREMENT
/begin MEASUREMENT TM_CAF_CT_ExtAir_Temp "" UWORD DC_SEARCH 1 100 0 65535 FORMAT "%6.0" ECU_ADDRESS 0x803526 /end MEASUREMENT
/begin MEASUREMENT TM_CAF_CT_ExtAir_Temp_Req "" UBYTE DC_FKT16 1 100 0 15.9375 FORMAT "%5.2" ECU_ADDRESS 0x803A31 /end MEASUREMENT
/begin MEASUREMENT TM_CAF_CT_ExtAir_Temp_S "" SWORD DC_TEMP_S16 1 100 -4096 4095.88 FORMAT "%8.3" ECU_ADDRESS 0x803552 /end MEASUREMENT
/begin MEASUREMENT TM_CAF_CT_FIRate_nst08 "" SWORD DC_PCT_S16 1 100 -100.003 100 FORMAT "%8.4" ECU_ADDRESS 0x80353E /end MEASUREMENT
/begin MEASUREMENT TM_CAF_CT_FIRate_sstIn "" SWORD DC_PCT_S16 1 100 -100.003 100 FORMAT "%8.4" ECU_ADDRESS 0x803546 /end MEASUREMENT
/begin MEASUREMENT TM_CAF_CT_IntkAir_Temp "" UWORD DC_SEARCH 1 100 0 65535 FORMAT "%6.0" ECU_ADDRESS 0x80351E /end MEASUREMENT
/begin MEASUREMENT TM_CAF_CT_IntkAir_Temp_Req "" UWORD DC_CNTR_U16 1 100 0 65535 FORMAT "%8.2" ECU_ADDRESS 0x803530 /end MEASUREMENT
/begin MEASUREMENT TM_CAF_CT_MAF "" UWORD DC_FLOW_U16 1 100 0 65535 FORMAT "%6.0" ECU_ADDRESS 0x80353A /end MEASUREMENT
/begin MEASUREMENT TM_CAF_CT_MAF_nst08 "" SWORD DC_PCT_S16 1 100 -100.003 100 FORMAT "%8.4" ECU_ADDRESS 0x803540 /end MEASUREMENT
/begin MEASUREMENT TM_CAF_CT_Sen_Oil_Req "" UWORD DC_CNTR_U16 1 100 0 65535 FORMAT "%8.2" ECU_ADDRESS 0x803534 /end MEASUREMENT
/begin MEASUREMENT TM_CAF_CT_Sen_Oil_Temp "" UWORD DC_SEARCH 1 100 0 65535 FORMAT "%6.0" ECU_ADDRESS 0x80352A /end MEASUREMENT
/begin MEASUREMENT TM_CAF_CV_BR211 "" UBYTE DC_FLAG_U8 1 100 0 1 BIT_MASK 0x1 FORMAT "%5.3" ECU_ADDRESS 0x803630 /end MEASUREMENT
/begin MEASUREMENT TM_CoolFanSpd_Req "" UWORD DC_SEARCH 1 100 0 65535 FORMAT "%6.0" ECU_ADDRESS 0x80351A /end MEASUREMENT
/begin MEASUREMENT TM_CoolFan_MAF_Req "" UWORD DC_SEARCH 1 100 0 65535 FORMAT "%6.0" ECU_ADDRESS 0x802EC8 /end MEASUREMENT
/begin MEASUREMENT TM_CoolFan_MAF_Req_Veh_spd "" UWORD DC_PER0327_S16 1 100 0 100 FORMAT "%8.4" ECU_ADDRESS 0x802EE0 /end MEASUREMENT
/begin MEASUREMENT TM_Cyl_FIRate "" UWORD DC_SEARCH 1 100 0 65535 FORMAT "%6.0" ECU_ADDRESS 0x80353C /end MEASUREMENT
/begin MEASUREMENT TM_Cyl_FIRate_sstIn "" UWORD DC_FKT32768 1 100 0 1.99997 FORMAT "%8.6" ECU_ADDRESS 0x80354A /end MEASUREMENT
/begin MEASUREMENT TM_DissHeatFlowCl "" SWORD DC_PWR_S16 1 100 -4096 4095.88 ECU_ADDRESS 0x802F00 /end MEASUREMENT
/begin MEASUREMENT TM_DissHeatFlowFan "" UWORD DC_CNTR_U16 1 100 0 65535 FORMAT "%8.2" ECU_ADDRESS 0x802F02 /end MEASUREMENT
/begin MEASUREMENT TM_DissHeatFlowVehSpd "" UWORD DC_CNTR_U16 1 100 0 65535 FORMAT "%8.2" ECU_ADDRESS 0x802EFC /end MEASUREMENT
/begin MEASUREMENT TM_ECFReqIn "" UBYTE DC_FLAG_U8 1 100 0 1 BIT_MASK 0x1 FORMAT "%5.3" ECU_ADDRESS 0x803636 /end MEASUREMENT
/begin MEASUREMENT TM_ECFVarCodeBR171 "" UBYTE DC_FLAG_U8 1 100 0 1 BIT_MASK 0x1 FORMAT "%5.3" ECU_ADDRESS 0x80363B /end MEASUREMENT
/begin MEASUREMENT TM_ECFVarCodeBR220 "" UBYTE DC_FLAG_U8 1 100 0 1 BIT_MASK 0x1 FORMAT "%5.3" ECU_ADDRESS 0x80363A /end MEASUREMENT
/begin MEASUREMENT TM_ECF_PreCtrl "" UWORD DC_FLOW_U16 1 100 0 65535 FORMAT "%6.0" ECU_ADDRESS 0x803586 /end MEASUREMENT
/begin MEASUREMENT TM_ECF_sstVolFlow "" UWORD DC_SEARCH 1 100 0 65535 FORMAT "%6.0" ECU_ADDRESS 0x802EE6 /end MEASUREMENT
/begin MEASUREMENT TM_ECPManOut "" UWORD DC_FLOW_U16 1 100 0 65535 FORMAT "%6.0" ECU_ADDRESS 0x802EF6 /end MEASUREMENT
/begin MEASUREMENT TM_ECPReqIn "" UWORD DC_FLOW_U16 1 100 0 65535 FORMAT "%6.0" ECU_ADDRESS 0x802EF4 /end MEASUREMENT
/begin MEASUREMENT TM_ECPThermostatOut "" UWORD DC_FLOW_U16 1 100 0 65535 FORMAT "%6.0" ECU_ADDRESS 0x802EF2 /end MEASUREMENT
/begin MEASUREMENT TM_ECP_ECTInDelP "" SWORD DC_TEMP_S16 1 100 -4096 4095.88 FORMAT "%8.3" ECU_ADDRESS 0x80359A /end MEASUREMENT
/begin MEASUREMENT TM_ECP_ECTInDelPNl "" SWORD DC_TEMP_S16 1 100 -4096 4095.88 FORMAT "%8.3" ECU_ADDRESS 0x8035A4 /end MEASUREMENT
/begin MEASUREMENT TM_ECP_ECTOutDelP "" SWORD DC_TEMP_S16 1 100 -4096 4095.88 FORMAT "%8.3" ECU_ADDRESS 0x803598 /end MEASUREMENT
/begin MEASUREMENT TM_ECP_ECTOutDelPNl "" SWORD DC_TEMP_S16 1 100 -4096 4095.88 FORMAT "%8.3" ECU_ADDRESS 0x8035A8 /end MEASUREMENT
/begin MEASUREMENT TM_ECP_EngSpdLd "" SWORD DC_PWR_S16 1 100 -4096 4095.88 ECU_ADDRESS 0x803596 /end MEASUREMENT
/begin MEASUREMENT TM_ECP_EngSpdLdFil "" SWORD DC_PWR_S16 1 100 -4096 4095.88 ECU_ADDRESS 0x8035A0 /end MEASUREMENT
/begin MEASUREMENT TM_ECP_OilTDelP "" SWORD DC_TEMP_S16 1 100 -4096 4095.88 FORMAT "%8.3" ECU_ADDRESS 0x80359C /end MEASUREMENT
/begin MEASUREMENT TM_ECP_OilTDelPNl "" SWORD DC_TEMP_S16 1 100 -4096 4095.88 FORMAT "%8.3" ECU_ADDRESS 0x8035A6 /end MEASUREMENT
/begin MEASUREMENT TM_ECP_sstECTOut "" UWORD DC_SEARCH 1 100 0 65535 FORMAT "%6.0" ECU_ADDRESS 0x802EF0 /end MEASUREMENT
/begin MEASUREMENT TM_ECP_sstVolFlow "" UWORD DC_SEARCH 1 100 0 65535 FORMAT "%6.0" ECU_ADDRESS 0x802EE4 /end MEASUREMENT
/begin MEASUREMENT TM_ECP_VolFlow "" UWORD DC_FLOW_U16 1 100 0 65535 FORMAT "%6.0" ECU_ADDRESS 0x802EFE /end MEASUREMENT
/begin MEASUREMENT TM_ECP_VolFlowLCir "" UWORD DC_FLOW_U16 1 100 0 65535 FORMAT "%6.0" ECU_ADDRESS 0x802EEC /end MEASUREMENT
/begin MEASUREMENT TM_ECP_VolFlowSCir "" UWORD DC_FLOW_U16 1 100 0 65535 FORMAT "%6.0" ECU_ADDRESS 0x802EEE /end MEASUREMENT
/begin MEASUREMENT TM_ECTInDelP "" SWORD DC_TEMP_S16 1 100 -4096 4095.88 FORMAT "%8.3" ECU_ADDRESS 0x803576 /end MEASUREMENT
/begin MEASUREMENT TM_ECTInDelPNl "" SWORD DC_TEMP_S16 1 100 -4096 4095.88 FORMAT "%8.3" ECU_ADDRESS 0x80358C /end MEASUREMENT
/begin MEASUREMENT TM_ECTOutDelP "" SWORD DC_TEMP_S16 1 100 -4096 4095.88 FORMAT "%8.3" ECU_ADDRESS 0x803578 /end MEASUREMENT
/begin MEASUREMENT TM_ECTOutDelPNl "" SWORD DC_TEMP_S16 1 100 -4096 4095.88 FORMAT "%8.3" ECU_ADDRESS 0x80358A /end MEASUREMENT
/begin MEASUREMENT TM_EM_DEM_Emis_Adjust "" SWORD DC_FCTR_128_S16 1 100 -1.99219 1.99219 FORMAT "%8.6" ECU_ADDRESS 0x8035AC /end MEASUREMENT
/begin MEASUREMENT TM_EM_DEM_EngSpdLd_VolFlow "" UWORD DC_FLOW_U16 1 100 0 65535 FORMAT "%6.0" ECU_ADDRESS 0x8035AE /end MEASUREMENT
/begin MEASUREMENT TM_EM_DEM_sst_ECTOut "" UWORD DC_SEARCH 1 100 0 65535 FORMAT "%6.0" ECU_ADDRESS 0x8035AA /end MEASUREMENT
/begin MEASUREMENT TM_EngSpdLd_PCMain "" UWORD DC_FLOW_U16 1 100 0 65535 FORMAT "%6.0" ECU_ADDRESS 0x803580 /end MEASUREMENT
/begin MEASUREMENT TM_EngSpdLd_PCSup "" UWORD DC_FLOW_U16 1 100 0 65535 FORMAT "%6.0" ECU_ADDRESS 0x803582 /end MEASUREMENT
/begin MEASUREMENT TM_EngSpdLd_PCSupA "" UWORD DC_FLOW_U16 1 100 0 65535 FORMAT "%6.0" ECU_ADDRESS 0x803588 /end MEASUREMENT
/begin MEASUREMENT TM_Luefter1 "" SWORD DC_PCT_S16 1 100 -100.003 100 FORMAT "%8.4" ECU_ADDRESS 0x802EDE /end MEASUREMENT
/begin MEASUREMENT TM_Luefter2 "" SWORD DC_PCT_S16 1 100 -100.003 100 FORMAT "%8.4" ECU_ADDRESS 0x802EDC /end MEASUREMENT
/begin MEASUREMENT TM_Luefter3 "" SWORD DC_PCT_S16 1 100 -100.003 100 FORMAT "%8.4" ECU_ADDRESS 0x802ED6 /end MEASUREMENT
/begin MEASUREMENT TM_Luefter4 "" SWORD DC_PCT_S16 1 100 -100.003 100 FORMAT "%8.4" ECU_ADDRESS 0x802ED8 /end MEASUREMENT
/begin MEASUREMENT TM_Luefter5 "" SWORD DC_PCT_S16 1 100 -100.003 100 FORMAT "%8.4" ECU_ADDRESS 0x802EDA /end MEASUREMENT
/begin MEASUREMENT TM_Luefter6 "" SWORD DC_PCT_S16 1 100 -100.003 100 FORMAT "%8.4" ECU_ADDRESS 0x802ED4 /end MEASUREMENT
/begin MEASUREMENT TM_Luefter7 "" SWORD DC_PCT_S16 1 100 -100.003 100 FORMAT "%8.4" ECU_ADDRESS 0x802ED2 /end MEASUREMENT
/begin MEASUREMENT TM_Luefter8 "" SWORD DC_PCT_S16 1 100 -100.003 100 FORMAT "%8.4" ECU_ADDRESS 0x802ED0 /end MEASUREMENT
/begin MEASUREMENT TM_OilTDelP "" SWORD DC_TEMP_S16 1 100 -4096 4095.88 FORMAT "%8.3" ECU_ADDRESS 0x803574 /end MEASUREMENT
/begin MEASUREMENT TM_OilTDelPNl "" SWORD DC_TEMP_S16 1 100 -4096 4095.88 FORMAT "%8.3" ECU_ADDRESS 0x80358E /end MEASUREMENT
/begin MEASUREMENT TM_sstDissHeatFlowCl "" UWORD DC_SEARCH 1 100 0 65535 FORMAT "%6.0" ECU_ADDRESS 0x802EFA /end MEASUREMENT
/begin MEASUREMENT TM_sstDissHeatFlowFan "" UWORD DC_SEARCH 1 100 0 65535 FORMAT "%6.0" ECU_ADDRESS 0x802EF8 /end MEASUREMENT
/begin MEASUREMENT TM_sstExtAirT "" UWORD DC_SEARCH 1 100 0 65535 FORMAT "%6.0" ECU_ADDRESS 0x80357E /end MEASUREMENT
/begin MEASUREMENT TM_TMP_SP_ECTEnspl_Sp "" SWORD DC_TEMP_S16 1 100 -4096 4095.88 FORMAT "%8.3" ECU_ADDRESS 0x8035BC /end MEASUREMENT
/begin MEASUREMENT TM_TMP_SP_ECTExAiT_Sp "" SWORD DC_TEMP_S16 1 100 -4096 4095.88 FORMAT "%8.3" ECU_ADDRESS 0x8035B6 /end MEASUREMENT
/begin MEASUREMENT TM_TMP_SP_ECTInEnspl_Sp "" SWORD DC_TEMP_S16 1 100 -4096 4095.88 FORMAT "%8.3" ECU_ADDRESS 0x8035B8 /end MEASUREMENT
/begin MEASUREMENT TM_TMP_SP_ECTInExAiT_Sp "" SWORD DC_TEMP_S16 1 100 -4096 4095.88 FORMAT "%8.3" ECU_ADDRESS 0x8035B4 /end MEASUREMENT
/begin MEASUREMENT TM_TMP_SP_sstExAiT "" UWORD DC_SEARCH 1 100 0 65535 FORMAT "%6.0" ECU_ADDRESS 0x8035B2 /end MEASUREMENT
/begin MEASUREMENT TM_VehSpdExATAdj "" SWORD DC_FCTR_128_S16 1 100 -1.99219 1.99219 FORMAT "%8.6" ECU_ADDRESS 0x803584 /end MEASUREMENT
/begin MEASUREMENT toel "÷ltemperatur" UBYTE temp_ub_q1_o40 1 100 -40 215 FORMAT "%5.1" ECU_ADDRESS 0x801051 /end MEASUREMENT
/begin MEASUREMENT tolc "÷ltemperatur aus Kombibotschaft od. aus COWIV abh‰ngig von LH" UBYTE temp_ub_q1_o60 1 100 -60 195 FORMAT "%5.1" ECU_ADDRESS 0x801234 /end MEASUREMENT
/begin MEASUREMENT tpsvkmf2_w "gefilterter Periodendauerwert des Sondensignals vor Kat, Bank2 (Word)" UWORD t10msxs_uw_b655p35 1 100 0 655.35 FORMAT "%8.4" ECU_ADDRESS 0x7FC844 /end MEASUREMENT
/begin MEASUREMENT tpsvkmf_w "gefilterter Periodendauerwert des Sondensignals vor Kat. (Word)" UWORD t10msxs_uw_b655p35 1 100 0 655.35 FORMAT "%8.4" ECU_ADDRESS 0x7FC846 /end MEASUREMENT
/begin MEASUREMENT tvu_w "Batteriespannungskorrektur" UWORD t1p0usxms 1 100 0 65.535 FORMAT "%8.5" ECU_ADDRESS 0x801C60 /end MEASUREMENT
/begin MEASUREMENT twan "÷ltemperatur im Wandler" UBYTE temp_ub_q0p75_o48 1 100 -48 143.25 FORMAT "%5.1" ECU_ADDRESS 0x801235 /end MEASUREMENT
/begin MEASUREMENT tzlrdkt_w "Lambdaregler-Periodendauer aus Katdiagnose" UWORD t10msxs_uw_b655p35 1 100 0 655.35 FORMAT "%8.4" ECU_ADDRESS 0x8017FC /end MEASUREMENT
/begin MEASUREMENT t_flags_uc "Byte f¸r Tempomat-Bits des Befehlstests" UBYTE dez 1 100 0 255 FORMAT "%5.1" ECU_ADDRESS 0x80108C /end MEASUREMENT
/begin MEASUREMENT u5ref1 "ADC-Wert 5 Volt-Referenzspannung 1 (Byte)" UBYTE spg_ub_b5 1 100 0 4.98047 FORMAT "%5.3" ECU_ADDRESS 0x801236 /end MEASUREMENT
/begin MEASUREMENT u5ref2 "ADC-Wert 5 Volt-Referenzspannung 2 (Byte)" UBYTE spg_ub_b5 1 100 0 4.98047 FORMAT "%5.3" ECU_ADDRESS 0x801237 /end MEASUREMENT
/begin MEASUREMENT udsac_w "Spannung Drucksensor AC (word 10-Bit von ADC)" UWORD spg_uw_q0p00488 1 100 0 319.995 FORMAT "%8.4" ECU_ADDRESS 0x8017FE /end MEASUREMENT
/begin MEASUREMENT UetmNvBits "" UBYTE dez 1 100 0 255 FORMAT "%5.1" ECU_ADDRESS 0x7FC7EB /end MEASUREMENT
/begin MEASUREMENT ufst1_w "A/D Eingangsspannung Tank1 fuellstandsgeber (% auf 5V ADC)" UWORD rel_uw_b100 1 100 0 99.9985 FORMAT "%8.5" ECU_ADDRESS 0x801800 /end MEASUREMENT
/begin MEASUREMENT ufst2_w "A/D Eingangsspannung Tank2 fuellstandsgeber (% auf 5V ADC)" UWORD rel_uw_b100 1 100 0 99.9985 FORMAT "%8.5" ECU_ADDRESS 0x801802 /end MEASUREMENT
/begin MEASUREMENT uhfm_w "HFM-Spannung" UWORD spg_uw_q0p00488 1 100 0 319.995 FORMAT "%8.4" ECU_ADDRESS 0x800CEC /end MEASUREMENT
/begin MEASUREMENT uhsh "Spannung an der Heizerendstufe hinter Kat" UBYTE spg_ub_b5 1 100 0 4.98047 FORMAT "%5.3" ECU_ADDRESS 0x801238 /end MEASUREMENT
/begin MEASUREMENT uhsh2 "Spannung an der Heizerendstufe 2 hinter Kat" UBYTE spg_ub_b5 1 100 0 4.98047 FORMAT "%5.3" ECU_ADDRESS 0x801239 /end MEASUREMENT
/begin MEASUREMENT uhsv "Spannung an der Heizerendstufe vor Kat" UBYTE spg_ub_b5 1 100 0 4.98047 FORMAT "%5.3" ECU_ADDRESS 0x80123A /end MEASUREMENT
/begin MEASUREMENT uhsv2 "Spannung an der Heizerendstufe 2 vor Kat" UBYTE spg_ub_b5 1 100 0 4.98047 FORMAT "%5.3" ECU_ADDRESS 0x80123B /end MEASUREMENT
/begin MEASUREMENT upwg2d_w "Verdoppelte PWG-Poti-2-Spannung (Word)" UWORD dez 1 100 0 65535 FORMAT "%8.2" ECU_ADDRESS 0x800D06 /end MEASUREMENT
/begin MEASUREMENT usrj "Regelschwelle der Lambdaregelung, ohne Offset, DLSSA" UBYTE spg_ub_b1p33 1 100 0 1.33 FORMAT "%5.3" ECU_ADDRESS 0x800CD9 /end MEASUREMENT
/begin MEASUREMENT usvk "Spannung Lambdasonde vor Kat" UBYTE spg_ub_q0p0052_o0p2 1 100 -0.2 1.13 FORMAT "%5.3" ECU_ADDRESS 0x80123C /end MEASUREMENT
/begin MEASUREMENT usvk2 "Spannung Lambdasonde vor Kat 2" UBYTE spg_ub_q0p0052_o0p2 1 100 -0.2 1.13 FORMAT "%5.3" ECU_ADDRESS 0x80123D /end MEASUREMENT
/begin MEASUREMENT usvkk2_w "LSU-Spannung vor Kat, korrigiert Bank2" UWORD spg_uw_q0p00488 1 100 0 319.995 FORMAT "%8.4" ECU_ADDRESS 0x801804 /end MEASUREMENT
/begin MEASUREMENT usvkk_w "LSU-Spannung vor Kat, korrigiert" UWORD spg_uw_q0p00488 1 100 0 319.995 FORMAT "%8.4" ECU_ADDRESS 0x801806 /end MEASUREMENT
/begin MEASUREMENT usvkv2_w "LSU-Spannung vor Kat, verbessert, Bank 2" SWORD spg_q4p88Em4 1 100 -16 15.9995 FORMAT "%8.5" ECU_ADDRESS 0x801C62 /end MEASUREMENT
/begin MEASUREMENT usvkv_w "LSU-Spannung vor Kat, verbessert" SWORD spg_q4p88Em4 1 100 -16 15.9995 FORMAT "%8.5" ECU_ADDRESS 0x801C64 /end MEASUREMENT
/begin MEASUREMENT uulsuf2_w "gefilterte Sondenspannung vor Kat einer Breitbandlambdasonde Bank2" UWORD spg_uw_q0p00488 1 100 0 319.995 FORMAT "%8.4" ECU_ADDRESS 0x801808 /end MEASUREMENT
/begin MEASUREMENT uulsuf_w "gefilterte Sondenspannung vor Kat einer Breitbandlambdasonde" UWORD spg_uw_q0p00488 1 100 0 319.995 FORMAT "%8.4" ECU_ADDRESS 0x80180A /end MEASUREMENT
/begin MEASUREMENT uusvk2_w "ADC-Spannung Lambdasonde vor Katalysator 2 (Word)" UWORD spg_uw_q0p00488 1 100 0 319.995 FORMAT "%8.4" ECU_ADDRESS 0x801C66 /end MEASUREMENT
/begin MEASUREMENT uusvk_w "ADC-Spannung Lambdasonde vor Katalysator (Word)" UWORD spg_uw_q0p00488 1 100 0 319.995 FORMAT "%8.4" ECU_ADDRESS 0x801C68 /end MEASUREMENT
/begin MEASUREMENT uusvmb2_w "Spannung (word, 1 ms-Raster) Lambdasonde mit Widerstand belastet vor KAT Bank2" UWORD spg_uw_q0p00488 1 100 0 319.995 FORMAT "%8.4" ECU_ADDRESS 0x80180C /end MEASUREMENT
/begin MEASUREMENT uusvmb_w "Spannung (word, 1 ms-Raster) Lambdasonde mit Widerstand belastet vor KAT" UWORD spg_uw_q0p00488 1 100 0 319.995 FORMAT "%8.4" ECU_ADDRESS 0x80180E /end MEASUREMENT
/begin MEASUREMENT uusvob2_w "ADC-Spannung (word, 1 ms-Raster) Sonde ohne Belastung vor Katalysator Bank2" UWORD spg_uw_q0p00488 1 100 0 319.995 FORMAT "%8.4" ECU_ADDRESS 0x801810 /end MEASUREMENT
/begin MEASUREMENT uusvob_w "ADC-Spannung (word, 1 ms-Raster) Sonde ohne Belastung vor Katalysator" UWORD spg_uw_q0p00488 1 100 0 319.995 FORMAT "%8.4" ECU_ADDRESS 0x801812 /end MEASUREMENT
/begin MEASUREMENT Veh_speed "Fahrzeuggeschwindigkeit" UWORD vfzg_uw_q0p0625 1 100 0 4095.94 FORMAT "%8.3" ECU_ADDRESS 0x801814 /end MEASUREMENT
/begin MEASUREMENT vfgr_bt "" UWORD dez 1 100 0 65535 FORMAT "%8.2" ECU_ADDRESS 0x8012CA /end MEASUREMENT
/begin MEASUREMENT vfzgv1_w "Fahrzeuggeschwindigkeit, CAN-Signal V1" UWORD vfzg_uw_b512 1 100 0 511.992 FORMAT "%8.4" ECU_ADDRESS 0x801C6A /end MEASUREMENT
/begin MEASUREMENT vrad_lh "Radgeschwindigkeit links hinten" UWORD vfzg_uw_q0p0625 1 100 0 4095.94 FORMAT "%8.3" ECU_ADDRESS 0x801816 /end MEASUREMENT
/begin MEASUREMENT vrad_lv "Radgeschwindigkeit links vorne" UWORD vfzg_uw_q0p0625 1 100 0 4095.94 FORMAT "%8.3" ECU_ADDRESS 0x801818 /end MEASUREMENT
/begin MEASUREMENT vrad_rh "Radgeschwindigkeit rechts hinten" UWORD vfzg_uw_q0p0625 1 100 0 4095.94 FORMAT "%8.3" ECU_ADDRESS 0x80181A /end MEASUREMENT
/begin MEASUREMENT vrad_rv "Radgeschwindigkeit rechts vorne" UWORD vfzg_uw_q0p0625 1 100 0 4095.94 FORMAT "%8.3" ECU_ADDRESS 0x80181C /end MEASUREMENT
/begin MEASUREMENT vsdmr "Vorgabe Drehmomentreserve ¸ber Verstellsystem VSxy" UBYTE rel_ub_q0p3906 1 100 0 99.6094 FORMAT "%5.2" ECU_ADDRESS 0x80123E /end MEASUREMENT
/begin MEASUREMENT vsfpses "Faktor zur Verstellung Saugrohrdruck zur Applikation Einspritzung" UBYTE fak_ub_b2 1 100 0 1.99219 FORMAT "%5.3" ECU_ADDRESS 0x80123F /end MEASUREMENT
/begin MEASUREMENT vske "verstellbarer Offset f¸r Klopferkennungsschwelle ¸ber VS20" SBYTE fak_ub_b4 1 100 -2 1.98438 FORMAT "%5.3" ECU_ADDRESS 0x801240 /end MEASUREMENT
/begin MEASUREMENT vstmdr "Anpassung Momentenreserve Leerlaufregelung (Testerschnitst.)" UBYTE rel_ub_b25 1 100 0 24.9023 FORMAT "%5.2" ECU_ADDRESS 0x801241 /end MEASUREMENT
/begin MEASUREMENT vziels_w "Berechnete Soll-Zielgeschwindigkeit f¸r FGR" UWORD vfzg_uw_b512 1 100 0 511.992 FORMAT "%8.4" ECU_ADDRESS 0x801C6C /end MEASUREMENT
/begin MEASUREMENT wnwi_w "Istwinkel f¸r Nockenwelle (word)" SWORD wkw_sw_b128 1 100 -128 127.996 FORMAT "%7.3" ECU_ADDRESS 0x7FAA54 /end MEASUREMENT
/begin MEASUREMENT wtmot "A/D-Wert f¸r tmot" UWORD spg_uw_q0p00488 1 100 0 319.995 FORMAT "%8.4" ECU_ADDRESS 0x80181E /end MEASUREMENT
/begin MEASUREMENT wtol "A/D-Wert f¸r (Motor-) Oeltemperatur" UBYTE spg_ub_b5 1 100 0 4.98047 FORMAT "%5.3" ECU_ADDRESS 0x801242 /end MEASUREMENT
/begin MEASUREMENT x_uc "" UBYTE dez 1 100 0 255 FORMAT "%5.1" ECU_ADDRESS 0x801062 /end MEASUREMENT
/begin MEASUREMENT y_uc "" UBYTE dez 1 100 0 255 FORMAT "%5.1" ECU_ADDRESS 0x801063 /end MEASUREMENT
/begin MEASUREMENT zwopt_uc "optimaler Z¸ndwinkel im Befehlstest" SBYTE zw_sb_q0p75 1 100 -96 95.25 FORMAT "%5.2" ECU_ADDRESS 0x80106D /end MEASUREMENT
/begin MEASUREMENT zwout_uc "Ausgabe-Z¸ndwinkel im Befehlstest" SBYTE zw_sb_q0p75 1 100 -96 95.25 FORMAT "%5.2" ECU_ADDRESS 0x801064 /end MEASUREMENT
/begin MEASUREMENT zyleausb "auszublendender Zylinder; bin‰re Darstellung" UBYTE dez 1 100 0 255 FORMAT "%5.1" ECU_ADDRESS 0x801052 /end MEASUREMENT
/begin MEASUREMENT z_dfv "" UBYTE B_TRUE 1 100 0 1 BIT_MASK 0x1 FORMAT "%13.11" ECU_ADDRESS 0x7FA96A /end MEASUREMENT
/begin MEASUREMENT z_pblserr "" UBYTE B_TRUE 1 100 0 1 BIT_MASK 0x1 FORMAT "%13.11" ECU_ADDRESS 0x7FA96B /end MEASUREMENT
/begin FUNCTION SWADP "Software-Adapter"
 /begin DEF_CHARACTERISTIC CWKVHR CWTEZW DNMAXH DTEMN FWRLMNN GANG_NFB KFATMKRH KUMSRL MDNORM SWPEDNOT TEMIN TVP UPWGO UPWGU /end DEF_CHARACTERISTIC
 /begin REF_CHARACTERISTIC KUMSIRL MDIMX /end REF_CHARACTERISTIC
 /begin IN_MEASUREMENT B_autget B_develop_ECU B_iclsabg B_iclsabg2 B_kupplv B_nachlend dua10g2_w dua10g_w flb_w ftvdk lamsons2_w lamsons_w mdko_w mdwanvf_w milsol_w mrfa_w msabg_w nmot_w nsol nstat pabnav2_w pabnav_w rirint_w rlmnomr_w rl_w tabgm2_w tabgm_w tans tansk_w tavrom_w te_l tikatm tikatm_w tkatm tkatm2 tkivkm_w tmot tmotlin toelk_w tum tvub_w uulsuv2_w uulsuv_w Veh_Spd /end IN_MEASUREMENT
 /begin OUT_MEASUREMENT ahkat ahkat2 anzeausb AS_ccv AS_epee AS_mar AS_wp azlrdkt bfzgldsc_w B_acc B_agr B_agrlrasp B_ap_aktiv B_asc1cok B_asc2cok B_asc_reg B_asrext B_bkvmsisr B_bkvnkhab B_bt B_bteepcl B_btekp B_btemil B_btepcl B_bthsh B_bthsh2 B_bthsv2 B_btkos B_btmil B_btsta B_bttev B_c95ks3 B_clkatfz B_craus B_desu B_diagia B_diagia2 B_dktlp B_dldpte B_dmmtev B_dmtltz B_dnt B_dntb B_dopzue B_dsc_reg B_dslsk B_dtp B_dtpb B_dwdknws B_eculock B_eemrdy B_eepdif B_egscok B_ekpet B_eslkl B_eswez B_evfzgv1 B_fa B_faagr B_faam B_faan B_faatm B_fadylsu B_faevz B_faezla B_fakat B_fakat2 B_fakrs B_fakvs B_falbk B_faldp B_falr B_falra B_falsf B_falsh B_falsh2 B_falshv B_falsv B_falsv2 B_fanwsa B_fanwse B_fasf B_fash B_fash2 B_faskno B_fasls B_fates B_fgr B_fgrat B_fgrhe B_fgrhsa B_fgrtb2 B_fgrtbe B_fgrtse B_fgrtv2 B_fgrtve B_fgrtwa B_fnwea B_fnwea2 B_fnwea3 B_fsp B_grdst B_gsaf B_gsch B_gstcmv B_hdc B_hfmsl B_hksv B_hmmfes B_hom B_homfes B_homlbks B_hosfes B_hsh2et B_hshet B_hspmd B_hsv2et B_ins2cok B_ins3cok B_kas B_kdhra B_kdhre B_khls B_klmzu_um B_ko B_ko2vke B_ko2vke2 B_koset B_kuppv B_kw B_lamabg B_lamabg2 B_lbkeson B_lf1nbres B_lf1s B_lf2nbres B_lf2s B_lowra B_lrndia B_lsvvsp B_lwser B_mdvur B_mdwaner B_msrext B_nac B_nachlstp B_nllstab B_nmaxext B_nsolst B_nwkv B_oeldr B_phsnl B_phsnlinv B_rineza B_rineza2 B_ripuv B_ripuv2 B_savacc B_savmsr B_sch B_schfes B_skhfes B_sl B_slsfz B_spf3k B_spf3k2 B_staet B_stalock B_stares5v B_svuerf B_svuerf2 B_synnot B_tcm0x320cok B_tevet B_tevtstp B_teza B_tolcb B_umsync B_vs B_vziels B_wdaactiv B_wk B_wkr B_zesync devoff dps_w ekpausc elamnhmm_w elamnhos_w elamnsch_w elamnskh_w elamxskh_w etaaufte evhbi2_w evhbi_w flamkh fmdkh fmsla fmsla2 fmvurh_w fmvurs_w fnwea2 fnwea3 fsol fsttankl ftvdk_w fzgtypz igod_w igokr_w ikrma_w ikrme_w kmstand KOP_NSOLF KOP_NSOLN lamsbrs2_w lamsbrs_w mdslw_w mdwancan mibgr_w mibmn_w mibmx_w midstn_w mifafu_w migs_w mkfanb_w mracc_w mrped_w ndcdis_w ndsalsu nmaxext_w nsllm nturbc_w obdstegs pabvtl2_w pabvtl_w psdss_u psmxbkvg_w pte qualol recilamf_w rememberP3Max rinv2_w rinv_w rirints_w rkweza_w rlminhom_w rlrints_w rl_f S_bls S_brs talsuf talsuf2 tavdkg_w tavro2_w tavro_w te2_w te_w tfst tkatmf tkatmf2 tkdfaAusBits2 tmki toel tolc tpsvkmf2_w tpsvkmf_w tvu_w twan tzlrdkt_w u5ref1 u5ref2 udsac_w ufst1_w ufst2_w uhfm_w uhsh uhsh2 uhsv uhsv2 upwg2d_w usrj usvk usvk2 usvkk2_w usvkk_w usvkv2_w usvkv_w uulsuf2_w uulsuf_w uusvk2_w uusvk_w uusvmb2_w uusvmb_w uusvob2_w uusvob_w Veh_speed vfzgv1_w vrad_lh vrad_lv vrad_rh vrad_rv vsdmr vsfpses vske vstmdr vziels_w wnwi_w wtmot wtol zyleausb z_dfv z_pblserr /end OUT_MEASUREMENT
 /begin LOC_MEASUREMENT /end LOC_MEASUREMENT
 /begin SUB_FUNCTION /end SUB_FUNCTION
/end FUNCTION
/begin FUNCTION SYSKN "" /begin DEF_CHARACTERISTIC /end DEF_CHARACTERISTIC /begin REF_CHARACTERISTIC /end REF_CHARACTERISTIC /begin IN_MEASUREMENT B_nmot /end IN_MEASUREMENT /begin OUT_MEASUREMENT timmot_w /end OUT_MEASUREMENT /begin LOC_MEASUREMENT /end LOC_MEASUREMENT /begin SUB_FUNCTION /end SUB_FUNCTION /end FUNCTION
/begin FUNCTION SYSKON "Systemkonstanten" /begin DEF_CHARACTERISTIC /end DEF_CHARACTERISTIC /begin REF_CHARACTERISTIC /end REF_CHARACTERISTIC /begin IN_MEASUREMENT /end IN_MEASUREMENT /begin OUT_MEASUREMENT /end OUT_MEASUREMENT /begin LOC_MEASUREMENT /end LOC_MEASUREMENT /begin SUB_FUNCTION /end SUB_FUNCTION /end FUNCTION
/begin FUNCTION SY_DFPM3 "" /begin DEF_CHARACTERISTIC /end DEF_CHARACTERISTIC /begin REF_CHARACTERISTIC /end REF_CHARACTERISTIC /begin IN_MEASUREMENT /end IN_MEASUREMENT /begin OUT_MEASUREMENT /end OUT_MEASUREMENT /begin LOC_MEASUREMENT /end LOC_MEASUREMENT /begin SUB_FUNCTION /end SUB_FUNCTION /end FUNCTION
/begin FUNCTION T2DTCS "KWP2000: Read Diagnostic Trouble Codes By Status" /begin DEF_CHARACTERISTIC /end DEF_CHARACTERISTIC /begin REF_CHARACTERISTIC /end REF_CHARACTERISTIC /begin IN_MEASUREMENT fcmEnd /end IN_MEASUREMENT /begin OUT_MEASUREMENT /end OUT_MEASUREMENT /begin LOC_MEASUREMENT /end LOC_MEASUREMENT /begin SUB_FUNCTION /end SUB_FUNCTION /end FUNCTION
/begin FUNCTION T2FCMD "KWP2000: Clear Diagnostic Information" /begin DEF_CHARACTERISTIC /end DEF_CHARACTERISTIC /begin REF_CHARACTERISTIC /end REF_CHARACTERISTIC /begin IN_MEASUREMENT fcmEnd /end IN_MEASUREMENT /begin OUT_MEASUREMENT /end OUT_MEASUREMENT /begin LOC_MEASUREMENT /end LOC_MEASUREMENT /begin SUB_FUNCTION /end SUB_FUNCTION /end FUNCTION
/begin FUNCTION T2ID "KWP2000: Read ECU Information" /begin DEF_CHARACTERISTIC /end DEF_CHARACTERISTIC /begin REF_CHARACTERISTIC /end REF_CHARACTERISTIC /begin IN_MEASUREMENT /end IN_MEASUREMENT /begin OUT_MEASUREMENT /end OUT_MEASUREMENT /begin LOC_MEASUREMENT /end LOC_MEASUREMENT /begin SUB_FUNCTION /end SUB_FUNCTION /end FUNCTION
/begin FUNCTION T2IOC "Input Output control (Device Control)" /begin DEF_CHARACTERISTIC /end DEF_CHARACTERISTIC /begin REF_CHARACTERISTIC /end REF_CHARACTERISTIC /begin IN_MEASUREMENT B_vklakt B_vklend B_vklerr B_vksakt B_vksend B_vkserr /end IN_MEASUREMENT /begin OUT_MEASUREMENT /end OUT_MEASUREMENT /begin LOC_MEASUREMENT /end LOC_MEASUREMENT /begin SUB_FUNCTION /end SUB_FUNCTION /end FUNCTION
/begin FUNCTION T2LID "KWP2000: Read/write Data by Local Identifier" /begin DEF_CHARACTERISTIC /end DEF_CHARACTERISTIC /begin REF_CHARACTERISTIC /end REF_CHARACTERISTIC /begin IN_MEASUREMENT /end IN_MEASUREMENT /begin OUT_MEASUREMENT /end OUT_MEASUREMENT /begin LOC_MEASUREMENT /end LOC_MEASUREMENT /begin SUB_FUNCTION /end SUB_FUNCTION /end FUNCTION
/begin FUNCTION T2TP "Tester Present (Tester Protokoll)" /begin DEF_CHARACTERISTIC /end DEF_CHARACTERISTIC /begin REF_CHARACTERISTIC /end REF_CHARACTERISTIC /begin IN_MEASUREMENT /end IN_MEASUREMENT /begin OUT_MEASUREMENT /end OUT_MEASUREMENT /begin LOC_MEASUREMENT /end LOC_MEASUREMENT /begin SUB_FUNCTION /end SUB_FUNCTION /end FUNCTION
/begin FUNCTION TCKOMUE "Testerkommunikation CARB; Kommunikationsaufbau ‹bersicht" /begin DEF_CHARACTERISTIC CWNOSCAT /end DEF_CHARACTERISTIC /begin REF_CHARACTERISTIC /end REF_CHARACTERISTIC /begin IN_MEASUREMENT /end IN_MEASUREMENT /begin OUT_MEASUREMENT /end OUT_MEASUREMENT /begin LOC_MEASUREMENT /end LOC_MEASUREMENT /begin SUB_FUNCTION /end SUB_FUNCTION /end FUNCTION
/begin FUNCTION TEB "Tankentl¸ftung beladungsabh‰ngig"
 /begin DEF_CHARACTERISTIC DFTEAHB DMSTES DSTEMIN FBTEB FBTEVA FBZBTEML FETATEBN FKATEB FQTEDL FQTEFR FQTEPT FQTEVA FRHB FSRFTEF FTEADAB FTEADMX FTEFHB FTEHB FTEINIX FUMRBRK FVERMN FVERZDYN FVRMDYN KFETATE KFFTEAN KFFTEAX KFQTE KFTADMS KFTATX KFTEKA KHCTEAMX KHCTEMN KHCTEMX MSDKLMMN NVERZMN TFTEINI TQTEAB TQTEDAB TVAGRFTE TVSATEM ZBTEML ZETATE ZKFTEAD ZMLTE ZMSSGIN /end DEF_CHARACTERISTIC
 /begin REF_CHARACTERISTIC KUMSRL SDK10TEUB SFR05TEUB SML06TEUB SNM10TEUB SQM05TEUB TEMIN /end REF_CHARACTERISTIC
 /begin IN_MEASUREMENT abo B_abor B_evloc B_frmax B_frmax2 B_frmin B_frmin2 B_lr B_lr2 B_lrasp B_lrasp2 B_nmot B_nswo1 B_qtedab B_sab B_te B_tef B_tei B_ten B_tep esst_sdk10teub esst_sfr05teub esst_sml06teub esst_snm10teub esst_sqm05teub frm2_w frm_w mifa_w miopt_w ml mlsol_w ml_w msdkalm_w mste mstedte_w msteo_w mste_w nmot nmot_w ps_w pte pu rl tans te2_w te_w tmot umsrln_w wdkba /end IN_MEASUREMENT
 /begin OUT_MEASUREMENT B_agrste B_lrar B_teabb B_tehb B_tehbx dmssginr etate fkatei frmit frmit_w frmxa frmxa_w fteadf ftead_w ftefsoll_w ftefva_w imsteini mitebg_w mssgin_w mstesoll_w pspu qmsdyn rkte_w /end OUT_MEASUREMENT
 /begin LOC_MEASUREMENT B_gwrte B_teakt dftef_w dkatefrg dkhc_w dmlftef dstert20_w etateint etatesol fbetate fbkate fgwrte fkateapp fkatefrg fkates fngwrte fregfte frmxaold_w ftadmste fteadf_w ftefsold_w ftefva ftefvab ftefvamx_w fteml fvermte_w khc_w kteev_w ktetevvz_w ktetev_w mssginmn_w msteev_w mstesmx_w qtetemin rlteev_w /end LOC_MEASUREMENT
 /begin SUB_FUNCTION /end SUB_FUNCTION
/end FUNCTION
/begin FUNCTION TEBEB "Einschaltbedingungen Tankentl¸ftung" /begin DEF_CHARACTERISTIC CWTEACFG LAMTEMN LAMTEMX TMSTTE TMTE TTEAUS /end DEF_CHARACTERISTIC /begin REF_CHARACTERISTIC /end REF_CHARACTERISTIC
 /begin IN_MEASUREMENT B_atmtpa B_dldpte B_dllra B_dsls B_dteaa B_eobdlr B_fraoan B_ftedab B_lamka B_lamka2 B_lamsdef B_lr B_lr2 B_lrasp B_lrasp2 B_lrssa B_lrssa2 B_m8te B_mdarv B_mlrsa B_sbbvk B_sbbvk2 B_sls B_stend B_tep lamsons_w tateist_w tmot tmst /end IN_MEASUREMENT
 /begin OUT_MEASUREMENT B_qtedab B_te B_tef B_tei B_ten /end OUT_MEASUREMENT
 /begin LOC_MEASUREMENT B_tenmda lokBits_Tebeb /end LOC_MEASUREMENT
 /begin SUB_FUNCTION /end SUB_FUNCTION
/end FUNCTION
/begin FUNCTION TEMPKON "Temperatur-Konvertermodul" /begin DEF_CHARACTERISTIC /end DEF_CHARACTERISTIC /begin REF_CHARACTERISTIC /end REF_CHARACTERISTIC
 /begin IN_MEASUREMENT tabgm2_w tabgmab tabgmab2 tabgm_w tatu tikatm2_w tikatm_w tkatm2_w tkatmab tkatmab2 tkatm_w tmot /end IN_MEASUREMENT
 /begin OUT_MEASUREMENT tahso2_w tahsoab2_w tahsoab_w tahsom2_w tahsom_w tahso_w taikrm2_w taikrm_w tanhkm2_w tanhkm_w tanvk2_w tanvkm2_w tanvkm_w tanvk_w tatuk tatuk_w tavhkm2_w tavhkm_w tavrom2_w tavrom_w tavso2_w tavsoab2_w tavsoab_w tavsom2_w tavsom_w tavso_w tavvkm2_w tavvkm_w tkihkm2_w tkihkm_w tkiuem2_w tkiuem_w tkivkm2_w tkivkm_w tmotk tmotk_w /end OUT_MEASUREMENT
 /begin LOC_MEASUREMENT /end LOC_MEASUREMENT
 /begin SUB_FUNCTION /end SUB_FUNCTION
/end FUNCTION
/begin FUNCTION TM_AC_DEM "1.11" /begin DEF_CHARACTERISTIC FW_TM_ACC_Trq_LowLim FW_TM_ACC_Trq_UpLim /end DEF_CHARACTERISTIC /begin REF_CHARACTERISTIC /end REF_CHARACTERISTIC /begin IN_MEASUREMENT ACCompr_Run_Mode ACCompr_Trq ECF_PwrReq_Plaus /end IN_MEASUREMENT /begin OUT_MEASUREMENT AC_MAF_Req /end OUT_MEASUREMENT /begin LOC_MEASUREMENT /end LOC_MEASUREMENT /begin SUB_FUNCTION /end SUB_FUNCTION /end FUNCTION
/begin FUNCTION TM_CAF_CT "1.11"
 /begin DEF_CHARACTERISTIC FW_Cyl_FIRate_Corr FW_EngLoad_FIRate FW_Eng_Spd_RelLoad_T FW_TM_CAF_CT_CF_LowLim FW_TM_CoolFanSpd_Req FW_TM_ExtAir_Temp_ErrMode FW_TM_FIRate_RelLoad_T KL_TM_CAF_CT_AC_MAF_Req KL_TM_CAF_CT_CFSR_Veh_Spd KL_TM_CAF_CT_ECU_Temp KL_TM_CAF_CT_EngLoad KL_TM_CAF_CT_ETC_C_Setpoint KL_TM_CAF_CT_ExtAir_Temp KL_TM_CAF_CT_FIRate_nst08 KL_TM_CAF_CT_IntkAir_Temp KL_TM_CAF_CT_MAF_nst08 KL_TM_CAF_CT_Sen_Oil_Temp /end DEF_CHARACTERISTIC
 /begin REF_CHARACTERISTIC NISTV08 sst_TM_CAF_CT_AC_MAF_Req sst_TM_CAF_CT_CoolFanSpd_Req sst_TM_CAF_CT_ECU_Temp sst_TM_CAF_CT_EngLoad sst_TM_CAF_CT_ETC sst_TM_CAF_CT_ETC_C_Setpoint sst_TM_CAF_CT_ExtAir_Temp sst_TM_CAF_CT_IntkAir_Temp sst_TM_CAF_CT_MAF sst_TM_CAF_CT_Sen_Oil_Temp sst_TM_Cyl_FIRate VCANV16 /end REF_CHARACTERISTIC
 /begin IN_MEASUREMENT AC_MAF_Req CylBank1_FIRate_Rel CylBank2_FIRate_Rel Cyl_FIRate_Corr ECTIn ECTOut Eng_Spd ExtAir_Temp IntkAir_Temp MAF nst08 Sen_Oil_Temp vcanv16_r Veh_Spd /end IN_MEASUREMENT
 /begin OUT_MEASUREMENT CoolFan_MAF_Req sst_EngLoad TM_CAF_CT_AC_MAF_Req TM_CAF_CT_AC_MAF_Req_Out TM_CAF_CT_AC_Req TM_CAF_CT_CFSR_Veh_Spd_Req TM_CAF_CT_CoolFanSpd_Req TM_CAF_CT_CoolFan_MAF_Req TM_CAF_CT_ECU_Temp TM_CAF_CT_ECU_Temp_Req TM_CAF_CT_EngLoad TM_CAF_CT_EngLoad_sstIn TM_CAF_CT_ETC TM_CAF_CT_ETC_C_Setpoint TM_CAF_CT_ETC_C_Setp_In TM_CAF_CT_ETC_C_Setp_Req TM_CAF_CT_ETC_sstIn TM_CAF_CT_ExtAir_Temp TM_CAF_CT_ExtAir_Temp_Req TM_CAF_CT_ExtAir_Temp_S TM_CAF_CT_FIRate_nst08 TM_CAF_CT_FIRate_sstIn TM_CAF_CT_IntkAir_Temp TM_CAF_CT_IntkAir_Temp_Req TM_CAF_CT_MAF TM_CAF_CT_MAF_nst08 TM_CAF_CT_Sen_Oil_Req TM_CAF_CT_Sen_Oil_Temp TM_CoolFanSpd_Req TM_Cyl_FIRate TM_Cyl_FIRate_sstIn TM_ECU_Temp /end OUT_MEASUREMENT
 /begin LOC_MEASUREMENT /end LOC_MEASUREMENT
 /begin SUB_FUNCTION /end SUB_FUNCTION
/end FUNCTION
/begin FUNCTION TM_CAF_CV "1.11"
 /begin DEF_CHARACTERISTIC FW_TM_Bat_Volt_min FW_TM_CAF_CV_DTM_ETC_UpLim FW_TM_CF_ECU_RunOn_Delay_t1 FW_TM_CF_ECU_RunOn_Delay_t2 FW_TM_CF_ECU_RunOn_Delay_t3 FW_TM_CF_ECU_RunOn_EndValue FW_TM_CF_ECU_RunOn_tn FW_TM_CoolFan_DTC FW_TM_CoolFan_DTM FW_TM_CoolFan_DTM_0 FW_TM_CoolFan_DTM_Pos FW_TM_CoolFan_Eng_Run_Mode_T FW_TM_CoolFan_Req_Min FW_TM_CoolFan_RunOn_Req_perm FW_TM_ECC_RotVlv_St_disable FW_TM_EngHood_Mode FW_TM_Luefter_T FW_TM_Sens_Oil_Temp_Max FW_TM_Shuttr_BREnable FW_TM_Shuttr_DTM FW_TM_Shuttr_DTM_Pos FW_TM_Shuttr_ECU_RunOn_Pos FW_TM_Shuttr_Enable FW_TM_Shuttr_ETC_OffLim FW_TM_Shuttr_ETC_OnLim FW_TM_Shuttr_ExtAirTemp_OffLim FW_TM_Shuttr_ExtAirTemp_OnLim FW_TM_Shuttr_PosOpen FW_TM_Shuttr_Pos_Req_LowLim FW_TM_Shuttr_T FW_TM_Shuttr_Veh_Spd_OffLim FW_TM_Shuttr_Veh_Spd_OnLim KL_TM_CoolFan_MAF_Req_Veh_spd KL_TM_Luefter1 KL_TM_Luefter2 KL_TM_Luefter3 KL_TM_Luefter4 KL_TM_Luefter5 KL_TM_Luefter6 KL_TM_Luefter7 KL_TM_Luefter8 /end DEF_CHARACTERISTIC
 /begin REF_CHARACTERISTIC FW_TMManOverride sst_TM_CoolFan_MAF_Req VCANV16 /end REF_CHARACTERISTIC
 /begin IN_MEASUREMENT ACCompr_Run_Mode ACCompr_Trq Bat_Volt Cod_CANMembr Cod_ModelRange Cod_TM Cod_TM_FC Cod_TM_FCRunOn CoolFan_MAF_Req ECC_RotVlv_St ECF_PwrReq_Plaus ECTIn ECTOut Eng_Run_Mode ExtAir_Temp FanMalf_Mode IgnSwRun_Mode Sen_Oil_Temp vcanv16_r Veh_Spd VES_InfoBit0 VES_InfoBit1 /end IN_MEASUREMENT
 /begin OUT_MEASUREMENT ACComprOff_FanMalf CoolFan_Pwr_Req ECU_RunOn_Mode_Req ECU_RunOn_Req OilTemp_Mode Shuttr_Pos_Req TM_CAF_CV_BR211 TM_CoolFan_MAF_Req TM_CoolFan_MAF_Req_Veh_spd TM_Luefter1 TM_Luefter2 TM_Luefter3 TM_Luefter4 TM_Luefter5 TM_Luefter6 TM_Luefter7 TM_Luefter8 /end OUT_MEASUREMENT
 /begin LOC_MEASUREMENT /end LOC_MEASUREMENT
 /begin SUB_FUNCTION /end SUB_FUNCTION
/end FUNCTION
/begin FUNCTION TM_ECF_CT "1.11"
 /begin DEF_CHARACTERISTIC FW_ECF_ECTInDW FW_ECF_ECTInP FW_ECF_ECTOutDW FW_ECF_ECTOutP FW_ECF_OilTDW FW_ECF_OilTP FW_ECF_VolFlow_MAX FW_T_ECF_PreCtrlT TM_EngSpdLd_PCMainV08 TM_EngSpdLd_PCSupV08 TM_VehSpdExATAdjV08 /end DEF_CHARACTERISTIC
 /begin REF_CHARACTERISTIC FW_TM_ExtAir_Temp_ErrMode NISTV08 sst_TM_CAF_CT_EngLoad TM_sstExtAirTV08 VCANV16 /end REF_CHARACTERISTIC
 /begin IN_MEASUREMENT ECTIn ECTIn_Setpoint ECTOut ECT_Setpoint Emis_VolFlow Eng_Spd ExtAir_Temp IntkAir_Temp nst08 OilT_Setpoint Sen_Oil_Temp sst_EngLoad TM_CAF_CT_EngLoad_sstIn vcanv16_r Veh_Spd /end IN_MEASUREMENT
 /begin OUT_MEASUREMENT ECF_VolFlow ECF_VolFlowRaw TM_ECF_PreCtrl TM_ECF_PreCtrlFil TM_ECTInDelP TM_ECTInDelPNl TM_ECTOutDelP TM_ECTOutDelPNl TM_EngSpdLd_PCMain TM_EngSpdLd_PCSup TM_EngSpdLd_PCSupA TM_OilTDelP TM_OilTDelPNl TM_sstExtAirT TM_VehSpdExATAdj /end OUT_MEASUREMENT
 /begin LOC_MEASUREMENT /end LOC_MEASUREMENT
 /begin SUB_FUNCTION /end SUB_FUNCTION
/end FUNCTION
/begin FUNCTION TM_ECF_CV "1.11"
 /begin DEF_CHARACTERISTIC FW_HeatPuReqOff FW_HeatPuReqOn FW_ManHeatPuMan FW_ManHeatPuSet /end DEF_CHARACTERISTIC
 /begin REF_CHARACTERISTIC /end REF_CHARACTERISTIC
 /begin IN_MEASUREMENT Cod_ModelRange ECF_VolFlow /end IN_MEASUREMENT
 /begin OUT_MEASUREMENT HtrPmp_Flow_Req HtrVlv1_Pos_Req HtrVlv2_Pos_Req HtrVlv_Mode_Req TM_ECFReqIn TM_ECFVarCodeBR171 TM_ECFVarCodeBR220 /end OUT_MEASUREMENT
 /begin LOC_MEASUREMENT /end LOC_MEASUREMENT
 /begin SUB_FUNCTION /end SUB_FUNCTION
/end FUNCTION
/begin FUNCTION TM_ECP_CT "1.11"
 /begin DEF_CHARACTERISTIC FW_ECP_ECTInDW FW_ECP_ECTInP FW_ECP_ECTOutDW FW_ECP_ECTOutP FW_ECP_OilTDW FW_ECP_OilTP FW_ECP_PwrOut_MAX FW_T_ECPFilT TM_ECP_EngSpdLdV08 /end DEF_CHARACTERISTIC
 /begin REF_CHARACTERISTIC NISTV08 sst_TM_CAF_CT_EngLoad /end REF_CHARACTERISTIC
 /begin IN_MEASUREMENT ECTIn ECTIn_Setpoint ECTOut ECT_Setpoint Eng_Spd nst08 OilT_Setpoint Sen_Oil_Temp sst_EngLoad TM_CAF_CT_EngLoad_sstIn /end IN_MEASUREMENT
 /begin OUT_MEASUREMENT ECP_PwrOut ECP_PwrOutRaw TM_ECP_ECTInDelP TM_ECP_ECTInDelPNl TM_ECP_ECTOutDelP TM_ECP_ECTOutDelPNl TM_ECP_EngSpdLd TM_ECP_EngSpdLdFil TM_ECP_OilTDelP TM_ECP_OilTDelPNl /end OUT_MEASUREMENT
 /begin LOC_MEASUREMENT /end LOC_MEASUREMENT
 /begin SUB_FUNCTION /end SUB_FUNCTION
/end FUNCTION
/begin FUNCTION TM_ECP_CV "1.11"
 /begin DEF_CHARACTERISTIC ECC_RotVlv_Posn_ReqV08 FW_ECP_CV_THR FW_ECTOut_MAX FW_ManRotValMan FW_ManRotValSet FW_TMManOverride TM_DissHeatFlowVehSpdV08 TM_ECPThermostatOutV08 TM_ECP_VolFlowLCirV08 TM_ECP_VolFlowSCirV08 TM_ECP_VolFlowV08 /end DEF_CHARACTERISTIC
 /begin REF_CHARACTERISTIC ECC_sstRotVlv_PReqV08 FW_TM_ExtAir_Temp_ErrMode TM_ECF_sstVolFlowV08 TM_ECP_sstECTOutV08 TM_ECP_sstVolFlowV08 TM_sstDissHeatFlowClV08 TM_sstDissHeatFlowFanV08 VCANV16 /end REF_CHARACTERISTIC
 /begin IN_MEASUREMENT Cod_TM CoolFan_MAF_Req ECF_VolFlow ECP_PwrOut ECTIn ECTOut Emis_Mode_Req ExtAir_Temp IntkAir_Temp vcanv16_r Veh_Spd /end IN_MEASUREMENT
 /begin OUT_MEASUREMENT ECC_RotVlv_Posn_Req ECC_RotVlv_St ECC_sstRotVlv_Preq ECTOut_FailSafe_Mode TMOverride TM_DissHeatFlowCl TM_DissHeatFlowFan TM_DissHeatFlowVehSpd TM_ECF_sstVolFlow TM_ECPManOut TM_ECPReqIn TM_ECPThermostatOut TM_ECP_sstECTOut TM_ECP_sstVolFlow TM_ECP_VolFlow TM_ECP_VolFlowLCir TM_ECP_VolFlowSCir TM_sstDissHeatFlowCl TM_sstDissHeatFlowFan /end OUT_MEASUREMENT
 /begin LOC_MEASUREMENT /end LOC_MEASUREMENT
 /begin SUB_FUNCTION /end SUB_FUNCTION
/end FUNCTION
/begin FUNCTION TM_EM_DEM "1.11"
 /begin DEF_CHARACTERISTIC FW_EM_THRES TM_EM_DEM_Emis_AdjustV08 TM_EM_DEM_EngSpdLd_VolFlowV08 /end DEF_CHARACTERISTIC
 /begin REF_CHARACTERISTIC NISTV08 sst_TM_CAF_CT_EngLoad TM_EM_DEM_sst_ECTOutV08 /end REF_CHARACTERISTIC
 /begin IN_MEASUREMENT ECTIn ECTOut Eng_Spd nst08 sst_EngLoad TM_CAF_CT_EngLoad_sstIn /end IN_MEASUREMENT
 /begin OUT_MEASUREMENT Emis_Mode_Req Emis_VolFlow TM_EM_DEM_Emis_Adjust TM_EM_DEM_EngSpdLd_VolFlow TM_EM_DEM_sst_ECTOut /end OUT_MEASUREMENT
 /begin LOC_MEASUREMENT /end LOC_MEASUREMENT
 /begin SUB_FUNCTION /end SUB_FUNCTION
/end FUNCTION
/begin FUNCTION TM_TMP_SP "1.11"
 /begin DEF_CHARACTERISTIC TM_TMP_SP_ECTEnspl_SpV08 TM_TMP_SP_ECTExAiT_SpV08 TM_TMP_SP_ECTInEnspl_SpV08 TM_TMP_SP_ECTInExAiT_SpV08 TM_TMP_SP_OilTEnspl_SpV08 /end DEF_CHARACTERISTIC
 /begin REF_CHARACTERISTIC FW_TM_ExtAir_Temp_ErrMode NISTV08 sst_TM_CAF_CT_EngLoad TM_TMP_SP_sstExAiTV08 /end REF_CHARACTERISTIC
 /begin IN_MEASUREMENT Eng_Spd ExtAir_Temp IntkAir_Temp nst08 sst_EngLoad TM_CAF_CT_EngLoad_sstIn /end IN_MEASUREMENT
 /begin OUT_MEASUREMENT ECTIn_Setpoint ECT_Setpoint OilT_Setpoint TM_TMP_SP_ECTEnspl_Sp TM_TMP_SP_ECTExAiT_Sp TM_TMP_SP_ECTInEnspl_Sp TM_TMP_SP_ECTInExAiT_Sp TM_TMP_SP_sstExAiT /end OUT_MEASUREMENT
 /begin LOC_MEASUREMENT /end LOC_MEASUREMENT
 /begin SUB_FUNCTION /end SUB_FUNCTION
/end FUNCTION
/begin FUNCTION UCAUS "" /begin DEF_CHARACTERISTIC /end DEF_CHARACTERISTIC /begin REF_CHARACTERISTIC /end REF_CHARACTERISTIC
 /begin IN_MEASUREMENT abtres_um B_fgr_uc B_i_ska_uc B_nomsr_uc B_nosgs_uc ei_msrc_uc ei_mver_uc ei_reac_uc ei_sgsc_uc mfgr_uc mi_uc mmsr_uc mped_uc msgs_uc mver_c_uc mzfo_uc raster_um reac_c1_uc reac_c2_uc /end IN_MEASUREMENT
 /begin OUT_MEASUREMENT /end OUT_MEASUREMENT
 /begin LOC_MEASUREMENT /end LOC_MEASUREMENT
 /begin SUB_FUNCTION /end SUB_FUNCTION
/end FUNCTION
/begin FUNCTION UCEIN ""
 /begin DEF_CHARACTERISTIC ABIT_DAT_UC ABRE_DAT_UC ACCA_D_UC ACCC_D_UC ACTR_DAT_UC ALTC_D_UC AMDI_DAT_UC ASRL_DAT_UC ASRS_DAT_UC ASTA_DAT_UC BACC_DAT_UC BFGR_DAT_UC BZSGS_DAT_UC EVZ_DAT_UC FUELA_DH_UC FUELA_DL_UC FUEL_DH_UC FUEL_DL_UC MBIT_DAT_UC MCTR_DAT_UC MDMSR_DAT_UC MDSGS_DAT_UC MIFA_DAT_UC MSRC_D_UC MVER_D_UC MZFPTR_DAT_UC MZFREG_DAT_UC MZF_DAT_UC MZL_DAT_UC NFLAGS_D_UC NMOT_DAT_UC NMV08_UC NUSGS_DAT_UC NZWV08_UC REAC_D1_UC REAC_D2_UC RFLAGS_D_UC RLV08_UC RL_DAT_UC SFLAGS_D_UC SGSC_D_UC SPSNV08_UC SPSN_DAT_UC TFLAGS_D_UC VFGR_DAT_UC ZWOUT_DAT_UC /end DEF_CHARACTERISTIC
 /begin REF_CHARACTERISTIC MZFTV_UC /end REF_CHARACTERISTIC
 /begin IN_MEASUREMENT acca_c_uc accc_c_uc alc_old_uc alv_old_uc B_fgr_uc B_noacc_uc fuel_co_uc msrc_c_uc mver_c_uc mzf_l_uc mzf_p_uc mzf_r_uc mzf_uc newqu_uc raster_um reac_c1_uc reac_c2_uc sgsc_c_uc /end IN_MEASUREMENT
 /begin OUT_MEASUREMENT B_acc_bt B_fgr_bt evz_aus_uc fuel_co_bt mifa_bt nmot_uc nmst08_uc nzwst08_uc rlst08_uc rl_uc spnst08_uc spsn_uc vfgr_bt zwout_uc /end OUT_MEASUREMENT
 /begin LOC_MEASUREMENT x_uc y_uc /end LOC_MEASUREMENT
 /begin SUB_FUNCTION /end SUB_FUNCTION
/end FUNCTION
/begin FUNCTION UCFGRC "" /begin DEF_CHARACTERISTIC ACCA_T_UC ACCC_T_UC VMIN_UC /end DEF_CHARACTERISTIC /begin REF_CHARACTERISTIC /end REF_CHARACTERISTIC /begin IN_MEASUREMENT B_acc_bt B_fgr_bt mifa_bt raster_um vfgr_bt /end IN_MEASUREMENT
 /begin OUT_MEASUREMENT acca_c_uc accc_c_uc alc_old_uc B_fgr_uc B_noacc_uc ei_accc_uc mfgr_uc /end OUT_MEASUREMENT
 /begin LOC_MEASUREMENT /end LOC_MEASUREMENT
 /begin SUB_FUNCTION /end SUB_FUNCTION
/end FUNCTION
/begin FUNCTION UCMIST "" /begin DEF_CHARACTERISTIC KFMI_UC KFZW_UC KLETAZW_UC /end DEF_CHARACTERISTIC /begin REF_CHARACTERISTIC NZWV08_UC RLV08_UC /end REF_CHARACTERISTIC /begin IN_MEASUREMENT nmot_uc nzwst08_uc raster_um rlst08_uc rl_uc zwout_uc /end IN_MEASUREMENT /begin OUT_MEASUREMENT mi_uc /end OUT_MEASUREMENT /begin LOC_MEASUREMENT dzw_uc etazw_uc miopt_uc zwopt_uc /end LOC_MEASUREMENT /begin SUB_FUNCTION /end SUB_FUNCTION /end FUNCTION
/begin FUNCTION UCMSRC "" /begin DEF_CHARACTERISTIC CWNOMSR_BT MSRC_T_UC M_BZMSR_UC /end DEF_CHARACTERISTIC /begin REF_CHARACTERISTIC /end REF_CHARACTERISTIC /begin IN_MEASUREMENT raster_um /end IN_MEASUREMENT /begin OUT_MEASUREMENT alv_old_uc B_nomsr_uc ei_msrc_uc mmsr_uc msrc_c_uc /end OUT_MEASUREMENT /begin LOC_MEASUREMENT /end LOC_MEASUREMENT /begin SUB_FUNCTION /end SUB_FUNCTION /end FUNCTION
/begin FUNCTION UCMVER "" /begin DEF_CHARACTERISTIC MVER_T_UC /end DEF_CHARACTERISTIC /begin REF_CHARACTERISTIC /end REF_CHARACTERISTIC /begin IN_MEASUREMENT B_i_ska_uc mi_uc mzf_uc mzo_uc raster_um /end IN_MEASUREMENT /begin OUT_MEASUREMENT ei_mver_uc mver_c_uc mzfo_uc /end OUT_MEASUREMENT /begin LOC_MEASUREMENT mdif_w_uc /end LOC_MEASUREMENT /begin SUB_FUNCTION /end SUB_FUNCTION /end FUNCTION
/begin FUNCTION UCMZF "" /begin DEF_CHARACTERISTIC MZFFIL_UC MZFTV_UC /end DEF_CHARACTERISTIC /begin REF_CHARACTERISTIC /end REF_CHARACTERISTIC /begin IN_MEASUREMENT mz_uc raster_um /end IN_MEASUREMENT /begin OUT_MEASUREMENT mzf_l_uc mzf_p_uc mzf_r_uc mzf_uc /end OUT_MEASUREMENT /begin LOC_MEASUREMENT /end LOC_MEASUREMENT /begin SUB_FUNCTION /end SUB_FUNCTION /end FUNCTION
/begin FUNCTION UCMZUL "" /begin DEF_CHARACTERISTIC KFMDZOF_UC KFMPED_UC KFMPNS_UC MDV08_UC /end DEF_CHARACTERISTIC /begin REF_CHARACTERISTIC NMV08_UC SPSNV08_UC /end REF_CHARACTERISTIC
 /begin IN_MEASUREMENT mfgr_uc mmsr_uc msgs_uc nmot_uc nmst08_uc raster_um spnst08_uc spsn_uc /end IN_MEASUREMENT
 /begin OUT_MEASUREMENT mdst08_uc mped_uc mzo_uc mz_uc /end OUT_MEASUREMENT
 /begin LOC_MEASUREMENT /end LOC_MEASUREMENT
 /begin SUB_FUNCTION /end SUB_FUNCTION
/end FUNCTION
/begin FUNCTION UCREAC "" /begin DEF_CHARACTERISTIC KLNPED_UC REAC_T1_UC REAC_T2_UC SKA_DRHZ_UC /end DEF_CHARACTERISTIC /begin REF_CHARACTERISTIC /end REF_CHARACTERISTIC /begin IN_MEASUREMENT B_i_ska_uc evz_aus_uc fuel_co_bt nmot_uc raster_um spsn_uc /end IN_MEASUREMENT /begin OUT_MEASUREMENT ei_reac_uc fuel_co_uc reac_c1_uc reac_c2_uc /end OUT_MEASUREMENT /begin LOC_MEASUREMENT nska_uc /end LOC_MEASUREMENT /begin SUB_FUNCTION /end SUB_FUNCTION /end FUNCTION
/begin FUNCTION UCSGSC "" /begin DEF_CHARACTERISTIC SGSC_T_UC /end DEF_CHARACTERISTIC /begin REF_CHARACTERISTIC /end REF_CHARACTERISTIC /begin IN_MEASUREMENT raster_um /end IN_MEASUREMENT /begin OUT_MEASUREMENT B_nosgs_uc ei_sgsc_uc msgs_uc sgsc_c_uc /end OUT_MEASUREMENT /begin LOC_MEASUREMENT /end LOC_MEASUREMENT /begin SUB_FUNCTION /end SUB_FUNCTION /end FUNCTION
/begin FUNCTION UCURAM "" /begin DEF_CHARACTERISTIC /end DEF_CHARACTERISTIC /begin REF_CHARACTERISTIC /end REF_CHARACTERISTIC /begin IN_MEASUREMENT /end IN_MEASUREMENT /begin OUT_MEASUREMENT B_i_ska_uc n_flags_uc r_flags_uc s_flags_uc t_flags_uc /end OUT_MEASUREMENT /begin LOC_MEASUREMENT /end LOC_MEASUREMENT /begin SUB_FUNCTION /end SUB_FUNCTION /end FUNCTION
/begin FUNCTION UETM "Motor¸bertemperatur-Anzeige" /begin DEF_CHARACTERISTIC DUETMOT TUETM UETMOT /end DEF_CHARACTERISTIC /begin REF_CHARACTERISTIC /end REF_CHARACTERISTIC /begin IN_MEASUREMENT B_kl15 B_pwf B_stend nmot tmot tnst_w /end IN_MEASUREMENT /begin OUT_MEASUREMENT B_uetm B_uetmc UetmNvBits /end OUT_MEASUREMENT /begin LOC_MEASUREMENT B_nouetm /end LOC_MEASUREMENT /begin SUB_FUNCTION /end SUB_FUNCTION /end FUNCTION
/begin FUNCTION UFEING "EGAS ‹berwachungskonzept: Eingangssignal¸bernahme f¸r Funktions¸berwachung" /begin DEF_CHARACTERISTIC /end DEF_CHARACTERISTIC /begin REF_CHARACTERISTIC /end REF_CHARACTERISTIC /begin IN_MEASUREMENT B_i_ska_fr B_notlu_fr B_ub_ok modul_c_um raster_um /end IN_MEASUREMENT /begin OUT_MEASUREMENT /end OUT_MEASUREMENT /begin LOC_MEASUREMENT /end LOC_MEASUREMENT /begin SUB_FUNCTION /end SUB_FUNCTION /end FUNCTION
/begin FUNCTION UFFGRC "EGAS ‹berwachungskonzept: FGR-‹berwachung der Funktions¸berwachung" /begin DEF_CHARACTERISTIC ACCA_T_UM ACCC_T_UM VMIN_UM /end DEF_CHARACTERISTIC /begin REF_CHARACTERISTIC /end REF_CHARACTERISTIC /begin IN_MEASUREMENT B_acc B_fgr mifa modul_c_um raster_um vfgr_w /end IN_MEASUREMENT /begin OUT_MEASUREMENT B_fgr_um B_noacc_um ei_accc_um mfgr_um mfgr_ur /end OUT_MEASUREMENT
 /begin LOC_MEASUREMENT acca_c_um acca_c_ur accc_c_um accc_c_ur alc_old_um alc_old_ur /end LOC_MEASUREMENT
 /begin SUB_FUNCTION /end SUB_FUNCTION
/end FUNCTION
/begin COMPU_METHOD bfzg_uw_q0p025 "" RAT_FUNC "%6.4" "m/s^2" COEFFS 0 40 0 0 0 1 /end COMPU_METHOD
/begin COMPU_METHOD B_TRUE "boolsche Zust‰nde, positive Logik" TAB_VERB "%6.3" "" COMPU_TAB_REF B_TRUE /end COMPU_METHOD
/begin COMPU_VTAB B_TRUE "boolsche Zust‰nde, positive Logik" TAB_VERB 2 0 "----" 1 "TRUE" /end COMPU_VTAB
/begin COMPU_METHOD DC_ANGL_S16 "" RAT_FUNC "%8.5" "GRAD" COEFFS 0 16 0 0 0 1 /end COMPU_METHOD
/begin COMPU_METHOD DC_CNTR_U16 "" RAT_FUNC "%6.2" "" COEFFS 0 1 0 0 0 1 /end COMPU_METHOD
/begin COMPU_METHOD DC_FCTR_128_S16 "" RAT_FUNC "%8.5" "" COEFFS 0 128 0 0 0 1 /end COMPU_METHOD
/begin COMPU_METHOD DC_FKT16 "" RAT_FUNC "%6.4" "Faktor" COEFFS 0 16 0 0 0 1 /end COMPU_METHOD
/begin COMPU_METHOD DC_FKT32768 "" RAT_FUNC "%7.6" "Faktor" COEFFS 0 32768 0 0 0 1 /end COMPU_METHOD
/begin COMPU_METHOD DC_FLAG_U8 "" RAT_FUNC "%6.2" "" COEFFS 0 1 0 0 0 1 /end COMPU_METHOD
/begin COMPU_METHOD DC_FLOW_U16 "" RAT_FUNC "%6.2" "kg/h" COEFFS 0 1 0 0 0 1 /end COMPU_METHOD
/begin COMPU_METHOD DC_M3NM "" RAT_FUNC "%6.2" "Nm" COEFFS 0 1 0 0 0 3 /end COMPU_METHOD
/begin COMPU_METHOD DC_PCT_S16 "" RAT_FUNC "%8.5" "%" COEFFS 0 327.67 0 0 0 1 /end COMPU_METHOD
/begin COMPU_METHOD DC_PER0327 "" RAT_FUNC "%6.4" "%" COEFFS 0 327.67 0 0 0 1 /end COMPU_METHOD
/begin COMPU_METHOD DC_PER0327_S16 "" RAT_FUNC "%6.4" "%/10ms" COEFFS 0 327.67 0 0 0 1 /end COMPU_METHOD
/begin COMPU_METHOD DC_PWR_S16 "" RAT_FUNC "%9.4" "kw" COEFFS 0 8 0 0 0 1 /end COMPU_METHOD
/begin COMPU_METHOD DC_ROTSPD_S16 "" RAT_FUNC "%7.3" "1/min" COEFFS 0 2 0 0 0 1 /end COMPU_METHOD
/begin COMPU_METHOD DC_SD1_U8MB "" RAT_FUNC "%4.1" "%" COEFFS 0 1 0 0 0 1 /end COMPU_METHOD
/begin COMPU_METHOD DC_SEARCH "" RAT_FUNC "%6.2" "" COEFFS 0 1 0 0 0 1 /end COMPU_METHOD
/begin COMPU_METHOD DC_TEMP_S16 "" RAT_FUNC "%8.4" "Grad C" COEFFS 0 8 0 0 0 1 /end COMPU_METHOD
/begin COMPU_METHOD DC_TIME_100MS_U16 "" RAT_FUNC "%6.3" "s" COEFFS 0 10 0 0 0 1 /end COMPU_METHOD
/begin COMPU_METHOD DC_TIME_10MS_U16 "" RAT_FUNC "%6.4" "s" COEFFS 0 100 0 0 0 1 /end COMPU_METHOD
/begin COMPU_METHOD DC_TIME_1MS_U16 "" RAT_FUNC "%6.5" "s" COEFFS 0 1000 0 0 0 1 /end COMPU_METHOD
/begin COMPU_METHOD DC_UTMP_40 "" RAT_FUNC "%6.2" "grd C" COEFFS 0 1 40 0 0 1 /end COMPU_METHOD
/begin COMPU_METHOD DC_VEHSPD_KMH_U16 "" RAT_FUNC "%8.5" "km/h" COEFFS 0 16 0 0 0 1 /end COMPU_METHOD
/begin COMPU_METHOD DC_VOLT_S16 "" RAT_FUNC "%8.5" "V" COEFFS 0 512 0 0 0 1 /end COMPU_METHOD
/begin COMPU_METHOD DEZ "1 : 1 Umrechnug (dez/hex)" RAT_FUNC "%6.2" "" COEFFS 0 1 0 0 0 1 /end COMPU_METHOD
/begin COMPU_METHOD dez "1 : 1 Umrechnug (dez/hex)" RAT_FUNC "%6.2" "" COEFFS 0 1 0 0 0 1 /end COMPU_METHOD
/begin COMPU_METHOD fak_q0p00195 "" RAT_FUNC "%6.4" "-" COEFFS 0 65536 0 0 0 128 /end COMPU_METHOD
/begin COMPU_METHOD fak_r32_1 "" RAT_FUNC "%43.21" "-" COEFFS 0 1 0 0 0 1 /end COMPU_METHOD
/begin COMPU_METHOD fak_sb_b1 "" RAT_FUNC "%6.4" "-" COEFFS 0 256 0 0 0 2 /end COMPU_METHOD
/begin COMPU_METHOD fak_sb_b16 "" RAT_FUNC "%6.3" "-" COEFFS 0 256 0 0 0 32 /end COMPU_METHOD
/begin COMPU_METHOD fak_sb_b2 "" RAT_FUNC "%6.4" "-" COEFFS 0 256 0 0 0 4 /end COMPU_METHOD
/begin COMPU_METHOD fak_sb_b64 "" RAT_FUNC "%6.3" "-" COEFFS 0 256 0 0 0 128 /end COMPU_METHOD
/begin COMPU_METHOD fak_sb_q0p5 "" RAT_FUNC "%6.3" "-" COEFFS 0 256 0 0 0 128 /end COMPU_METHOD
/begin COMPU_METHOD fak_sw_b2 "" RAT_FUNC "%7.6" "-" COEFFS 0 65536 0 0 0 4 /end COMPU_METHOD
/begin COMPU_METHOD fak_sw_b64 "" RAT_FUNC "%6.4" "-" COEFFS 0 65536 0 0 0 128 /end COMPU_METHOD
/begin COMPU_METHOD fak_ub_b0p03125 "" RAT_FUNC "%6.5" "-" COEFFS 0 256 0 0 0 0.03125 /end COMPU_METHOD
/begin COMPU_METHOD fak_ub_b0p25 "" RAT_FUNC "%10.7" "-" COEFFS 0 256 0 0 0 0.25 /end COMPU_METHOD
/begin COMPU_METHOD fak_ub_b0p5 "" RAT_FUNC "%6.4" "-" COEFFS 0 256 0 0 0 0.5 /end COMPU_METHOD
/begin COMPU_METHOD fak_ub_b1 "" RAT_FUNC "%6.4" "-" COEFFS 0 256 0 0 0 1 /end COMPU_METHOD
/begin COMPU_METHOD fak_ub_b16 "" RAT_FUNC "%6.4" "-" COEFFS 0 256 0 0 0 16 /end COMPU_METHOD
/begin COMPU_METHOD fak_ub_b2 "" RAT_FUNC "%6.4" "-" COEFFS 0 256 0 0 0 2 /end COMPU_METHOD
/begin COMPU_METHOD fak_ub_b32 "" RAT_FUNC "%6.3" "-" COEFFS 0 256 0 0 0 32 /end COMPU_METHOD
/begin COMPU_METHOD fak_ub_b4 "" RAT_FUNC "%6.4" "-" COEFFS 0 256 0 0 0 4 /end COMPU_METHOD
/begin COMPU_METHOD fak_ub_b64 "" RAT_FUNC "%6.3" "-" COEFFS 0 256 0 0 0 64 /end COMPU_METHOD
/begin COMPU_METHOD fak_ub_b8 "" RAT_FUNC "%6.4" "-" COEFFS 0 256 0 0 0 8 /end COMPU_METHOD
/begin COMPU_METHOD fak_uw_b0p5 "" RAT_FUNC "%8.7" "-" COEFFS 0 65536 0 0 0 0.5 /end COMPU_METHOD
/begin COMPU_METHOD fak_uw_b1 "" RAT_FUNC "%7.6" "-" COEFFS 0 65536 0 0 0 1 /end COMPU_METHOD
/begin COMPU_METHOD fak_uw_b16 "" RAT_FUNC "%6.5" "-" COEFFS 0 65536 0 0 0 16 /end COMPU_METHOD
/begin COMPU_METHOD fak_uw_b2 "" RAT_FUNC "%7.6" "-" COEFFS 0 65536 0 0 0 2 /end COMPU_METHOD
/begin COMPU_METHOD fuel_ub_q0p5 "" RAT_FUNC "%6.3" "l" COEFFS 0 2 0 0 0 1 /end COMPU_METHOD
/begin COMPU_METHOD fuel_ub_q1 "" RAT_FUNC "%6.2" "l" COEFFS 0 1 0 0 0 1 /end COMPU_METHOD
/begin COMPU_METHOD km_uw_q10 "" RAT_FUNC "%6.1" "km" COEFFS 0 1 0 0 0 10 /end COMPU_METHOD
/begin COMPU_METHOD kumsrl_ub_b0p002 "" RAT_FUNC "%10.9" "(kg/h)/((1/min)*%)" COEFFS 0 128000 0 0 0 1 /end COMPU_METHOD
/begin COMPU_METHOD md_ub_q10 "" RAT_FUNC "%6.1" "Nm" COEFFS 0 1 0 0 0 10 /end COMPU_METHOD
/begin COMPU_METHOD m_ub_b1020 "" RAT_FUNC "%6.2" "kg/h" COEFFS 0 1 0 0 0 4 /end COMPU_METHOD
/begin COMPU_METHOD m_ub_q0p0444 "" RAT_FUNC "%6.4" "g" COEFFS 0 1 0 0 0 0.0444 /end COMPU_METHOD
/begin COMPU_METHOD m_ub_q1p0 "" RAT_FUNC "%6.2" "kg/h" COEFFS 0 1 0 0 0 1 /end COMPU_METHOD
/begin COMPU_METHOD m_uw_b25p6 "" RAT_FUNC "%6.5" "kg/h" COEFFS 0 65536 0 0 0 25.6 /end COMPU_METHOD
/begin COMPU_METHOD m_uw_b6553p5 "" RAT_FUNC "%6.3" "kg/h" COEFFS 0 1 0 0 0 0.1 /end COMPU_METHOD
/begin COMPU_METHOD m_uw_q3p2 "" RAT_FUNC "%6.2" "kg/h" COEFFS 0 1 0 0 0 3.2 /end COMPU_METHOD
/begin COMPU_METHOD nmot_q0p1453421 "" RAT_FUNC "%6.3" "U/min" COEFFS 0 1 0 0 0 0.145342 /end COMPU_METHOD
/begin COMPU_METHOD nmot_ub_q10 "" RAT_FUNC "%6.1" "1/min" COEFFS 0 1 0 0 0 10 /end COMPU_METHOD
/begin COMPU_METHOD nmot_ub_q40 "" RAT_FUNC "%6.1" "1/min" COEFFS 0 1 0 0 0 40 /end COMPU_METHOD
/begin COMPU_METHOD nmot_uw_q0p25 "" RAT_FUNC "%6.3" "1/min" COEFFS 0 1 0 0 0 0.25 /end COMPU_METHOD
/begin COMPU_METHOD perio_sw_b1p562 "" RAT_FUNC "%7.6" "1/s" COEFFS 0 65536 0 0 0 3.124 /end COMPU_METHOD
/begin COMPU_METHOD perio_sw_b6p125 "" RAT_FUNC "%6.5" "1/s" COEFFS 0 65536 0 0 0 12.25 /end COMPU_METHOD
/begin COMPU_METHOD perio_ub_b0p012207 "" RAT_FUNC "%10.8" "1/s" COEFFS 0 256 0 0 0 0.012207 /end COMPU_METHOD
/begin COMPU_METHOD perio_ub_b6p125 "" RAT_FUNC "%6.4" "1/s" COEFFS 0 256 0 0 0 6.125 /end COMPU_METHOD
/begin COMPU_METHOD p_sb_q32 "" RAT_FUNC "%6.3" "hPa" COEFFS 0 256 0 0 0 64 /end COMPU_METHOD
/begin COMPU_METHOD p_sw_q0p039 "" RAT_FUNC "%6.4" "hPa" COEFFS 0 256 0 0 0 10 /end COMPU_METHOD
/begin COMPU_METHOD p_ub_q10 "" RAT_FUNC "%6.1" "hPa" COEFFS 0 1 0 0 0 10 /end COMPU_METHOD
/begin COMPU_METHOD p_uw_q0p039 "" RAT_FUNC "%6.4" "hPa" COEFFS 0 256 0 0 0 10 /end COMPU_METHOD
/begin COMPU_METHOD relDK_ub_b100 "" RAT_FUNC "%6.3" "%DK" COEFFS 0 255 0 0 0 100 /end COMPU_METHOD
/begin COMPU_METHOD rel_q0p00195 "" RAT_FUNC "%6.4" "%" COEFFS 0 65536 0 0 0 128 /end COMPU_METHOD
/begin COMPU_METHOD rel_sw_b100 "" RAT_FUNC "%6.4" "%" COEFFS 0 32768 0 0 0 100 /end COMPU_METHOD
/begin COMPU_METHOD rel_sw_q0p0468 "" RAT_FUNC "%6.4" "%" COEFFS 0 65536 0 0 0 3072 /end COMPU_METHOD
/begin COMPU_METHOD rel_ub_b127p5 "" RAT_FUNC "%6.3" "%" COEFFS 0 2 0 0 0 1 /end COMPU_METHOD
/begin COMPU_METHOD rel_ub_b25 "" RAT_FUNC "%6.3" "%" COEFFS 0 256 0 0 0 25 /end COMPU_METHOD
/begin COMPU_METHOD rel_ub_b99p6 "" RAT_FUNC "%6.3" "%" COEFFS 0 256 0 0 0 100 /end COMPU_METHOD
/begin COMPU_METHOD rel_ub_q0p00153 "" RAT_FUNC "%6.4" "%" COEFFS 0 256 0 0 0 0.3906 /end COMPU_METHOD
/begin COMPU_METHOD rel_ub_q0p3906 "" RAT_FUNC "%6.3" "%" COEFFS 0 256 0 0 0 100 /end COMPU_METHOD
/begin COMPU_METHOD rel_ub_q0p75 "" RAT_FUNC "%6.3" "%" COEFFS 0 1 0 0 0 0.75 /end COMPU_METHOD
/begin COMPU_METHOD rel_uw_b100 "" RAT_FUNC "%6.4" "%" COEFFS 0 65536 0 0 0 100 /end COMPU_METHOD
/begin COMPU_METHOD rel_uw_b192 "" RAT_FUNC "%6.4" "%" COEFFS 0 65536 0 0 0 192 /end COMPU_METHOD
/begin COMPU_METHOD rel_uw_b200 "" RAT_FUNC "%6.4" "%" COEFFS 0 65536 0 0 0 200 /end COMPU_METHOD
/begin COMPU_METHOD rel_uw_b3072 "" RAT_FUNC "%6.4" "%" COEFFS 0 65536 0 0 0 3072 /end COMPU_METHOD
/begin COMPU_METHOD rel_uw_q0p0234 "" RAT_FUNC "%6.4" "%" COEFFS 0 32 0 0 0 0.75 /end COMPU_METHOD
/begin COMPU_METHOD rgrad_uw_b1280 "" RAT_FUNC "%6.4" "%/s" COEFFS 0 65536 0 0 0 1280 /end COMPU_METHOD
/begin COMPU_METHOD r_uw_q2 "" RAT_FUNC "%6.2" "Ohm" COEFFS 0 1 0 0 0 2 /end COMPU_METHOD
/begin COMPU_METHOD spgg_sw_b3052 "" RAT_FUNC "%6.3" "V/s" COEFFS 0 1 0 0 0 0.0931323 /end COMPU_METHOD
/begin COMPU_METHOD spg_q4p88Em4 "" RAT_FUNC "%6.5" "V" COEFFS 0 2048 0 0 0 1 /end COMPU_METHOD
/begin COMPU_METHOD spg_ub_b1p33 "" RAT_FUNC "%6.4" "V" COEFFS 0 255 0 0 0 1.33 /end COMPU_METHOD
/begin COMPU_METHOD spg_ub_b5 "" RAT_FUNC "%6.4" "V" COEFFS 0 256 0 0 0 5 /end COMPU_METHOD
/begin COMPU_METHOD spg_ub_q0p0052_o0p2 "" RAT_FUNC "%6.3" "V" COEFFS 0 255 51 0 0 1.33 /end COMPU_METHOD
/begin COMPU_METHOD spg_ub_q0p019 "" RAT_FUNC "%6.4" "V" COEFFS 0 256 0 0 0 5 /end COMPU_METHOD
/begin COMPU_METHOD spg_uw_q0p000076 "" RAT_FUNC "%7.6" "V" COEFFS 0 65536 0 0 0 5 /end COMPU_METHOD
/begin COMPU_METHOD spg_uw_q0p00488 "" RAT_FUNC "%6.4" "V" COEFFS 0 1024 0 0 0 5 /end COMPU_METHOD
/begin COMPU_METHOD t100msxs_ub_b25p5 "" RAT_FUNC "%6.3" "s" COEFFS 0 1 0 0 0 0.1 /end COMPU_METHOD
/begin COMPU_METHOD t100msxs_uw_b6553p5 "" RAT_FUNC "%6.3" "s" COEFFS 0 1 0 0 0 0.1 /end COMPU_METHOD
/begin COMPU_METHOD t100msxs_uw_q100 "" RAT_FUNC "%6.3" "s" COEFFS 0 1 0 0 0 0.1 /end COMPU_METHOD
/begin COMPU_METHOD t10msxs_uw_b655p35 "" RAT_FUNC "%6.4" "s" COEFFS 0 1 0 0 0 0.01 /end COMPU_METHOD
/begin COMPU_METHOD t1p0usxms "" RAT_FUNC "%6.5" "ms" COEFFS 0 1000 0 0 0 1 /end COMPU_METHOD
/begin COMPU_METHOD t20msxs_ub_b5p1 "" RAT_FUNC "%6.4" "s" COEFFS 0 1 0 0 0 0.02 /end COMPU_METHOD
/begin COMPU_METHOD t20msxs_ub_q0p32 "" RAT_FUNC "%6.3" "s" COEFFS 0 256 0 0 0 81.92 /end COMPU_METHOD
/begin COMPU_METHOD t40ms_ub_b10200 "" RAT_FUNC "%7.2" "ms" COEFFS 0 1 0 0 0 40 /end COMPU_METHOD
/begin COMPU_METHOD t8p0usxms "" RAT_FUNC "%6.4" "ms" COEFFS 0 1000 0 0 0 8 /end COMPU_METHOD
/begin COMPU_METHOD temp_q0p0234_o273 "" RAT_FUNC "%6.1" "Grad C" COEFFS 0 1 273.15 0 0 0.0234375 /end COMPU_METHOD
/begin COMPU_METHOD temp_q6_o273 "" RAT_FUNC "%6.1" "Grad C" COEFFS 0 1 273.15 0 0 6 /end COMPU_METHOD
/begin COMPU_METHOD temp_sw_q1p25Em1 "" RAT_FUNC "%6.3" "Grad C" COEFFS 0 8 0 0 0 1 /end COMPU_METHOD
/begin COMPU_METHOD temp_ub_b191p25 "" RAT_FUNC "%6.3" "Grad C" COEFFS 0 1 0 0 0 0.75 /end COMPU_METHOD
/begin COMPU_METHOD temp_ub_q0p75_o48 "" RAT_FUNC "%6.2" "Grad C" COEFFS 0 1 48 0 0 0.75 /end COMPU_METHOD
/begin COMPU_METHOD temp_ub_q1_o40 "" RAT_FUNC "%6.2" "Grad C" COEFFS 0 1 40 0 0 1 /end COMPU_METHOD
/begin COMPU_METHOD temp_ub_q1_o60 "" RAT_FUNC "%6.2" "Grad C" COEFFS 0 1 60 0 0 1 /end COMPU_METHOD
/begin COMPU_METHOD temp_ub_q5_o50 "" RAT_FUNC "%6.2" "Grad C" COEFFS 0 1 50 0 0 5 /end COMPU_METHOD
/begin COMPU_METHOD temp_uw_q0p0029_o48 "" RAT_FUNC "%6.2" "Grad C" COEFFS 0 256 12288 0 0 0.75 /end COMPU_METHOD
/begin COMPU_METHOD t_min_q5p96em8 "" RAT_FUNC "%10.9" "min" COEFFS 0 1 0 0 0 5.96e-008 /end COMPU_METHOD
/begin COMPU_METHOD t_q0p01 "" RAT_FUNC "%6.4" "s" COEFFS 0 100 0 0 0 1 /end COMPU_METHOD
/begin COMPU_METHOD vfzg_uw_b512 "" RAT_FUNC "%6.4" "km/h" COEFFS 0 65536 0 0 0 512 /end COMPU_METHOD
/begin COMPU_METHOD vfzg_uw_q0p00781 "" RAT_FUNC "%6.4" "km/h" COEFFS 0 1 0 0 0 0.0078125 /end COMPU_METHOD
/begin COMPU_METHOD vfzg_uw_q0p0625 "" RAT_FUNC "%6.4" "km/h" COEFFS 0 1 0 0 0 0.0625 /end COMPU_METHOD
/begin COMPU_METHOD wink_uw_q0p1 "" RAT_FUNC "%6.3" "Grad" COEFFS 0 10 0 0 0 1 /end COMPU_METHOD
/begin COMPU_METHOD wkw_sw_b128 "" RAT_FUNC "%7.5" "Grad KW" COEFFS 0 256 0 0 0 1 /end COMPU_METHOD
/begin COMPU_METHOD zk100msxs_ub_b25p5 "" RAT_FUNC "%6.3" "s" COEFFS 0 0 256 0 10 0 /end COMPU_METHOD
/begin COMPU_METHOD zk100msxs_uw_b655 "" RAT_FUNC "%6.1" "s" COEFFS 0 0 65536 0 10 0 /end COMPU_METHOD
/begin COMPU_METHOD zk100msxs_uw_b6553 "" RAT_FUNC "%10.3" "s" COEFFS 0 0 65536 0 10 0 /end COMPU_METHOD
/begin COMPU_METHOD zk40ms_ub_b10200 "" RAT_FUNC "%6.1" "ms" COEFFS 0 0 10240 0 1 40 /end COMPU_METHOD
/begin COMPU_METHOD zw_sb_q0p75 "" RAT_FUNC "%6.3" "Grad KW" COEFFS 0 255 0 0 0 191.25 /end COMPU_METHOD
/begin COMPU_METHOD zw_ub_q0p75 "" RAT_FUNC "%6.3" "Grad KW" COEFFS 0 255 0 0 0 191.25 /end COMPU_METHOD
/begin RECORD_LAYOUT dc_GKfWSw FNC_VALUES 1 SWORD COLUMN_DIR DIRECT /end RECORD_LAYOUT
/begin RECORD_LAYOUT dc_GKfWUw FNC_VALUES 1 UWORD COLUMN_DIR DIRECT /end RECORD_LAYOUT
/begin RECORD_LAYOUT dc_GKlWSw FNC_VALUES 1 SWORD COLUMN_DIR DIRECT /end RECORD_LAYOUT
/begin RECORD_LAYOUT dc_GKlWUb FNC_VALUES 1 UBYTE COLUMN_DIR DIRECT /end RECORD_LAYOUT
/begin RECORD_LAYOUT dc_GKlWUw FNC_VALUES 1 UWORD COLUMN_DIR DIRECT /end RECORD_LAYOUT
/begin RECORD_LAYOUT dc_KwSw FNC_VALUES 1 SWORD COLUMN_DIR DIRECT /end RECORD_LAYOUT
/begin RECORD_LAYOUT dc_KwUb FNC_VALUES 1 UBYTE COLUMN_DIR DIRECT /end RECORD_LAYOUT
/begin RECORD_LAYOUT dc_KwUw FNC_VALUES 1 UWORD COLUMN_DIR DIRECT /end RECORD_LAYOUT
/begin RECORD_LAYOUT dc_SstAUbSstUb NO_AXIS_PTS_X 1 UBYTE AXIS_PTS_X 2 UBYTE INDEX_INCR DIRECT /end RECORD_LAYOUT
/begin RECORD_LAYOUT dc_SstAUwSstSw NO_AXIS_PTS_X 1 UWORD AXIS_PTS_X 2 SWORD INDEX_INCR DIRECT /end RECORD_LAYOUT
/begin RECORD_LAYOUT dc_SstAUwSstUw NO_AXIS_PTS_X 1 UWORD AXIS_PTS_X 2 UWORD INDEX_INCR DIRECT /end RECORD_LAYOUT
/begin RECORD_LAYOUT GkfWSb FNC_VALUES 1 SBYTE COLUMN_DIR DIRECT /end RECORD_LAYOUT
/begin RECORD_LAYOUT GkfWUb FNC_VALUES 1 UBYTE COLUMN_DIR DIRECT /end RECORD_LAYOUT
/begin RECORD_LAYOUT GklWUb FNC_VALUES 1 UBYTE COLUMN_DIR DIRECT /end RECORD_LAYOUT
/begin RECORD_LAYOUT GklWUw FNC_VALUES 1 UWORD COLUMN_DIR DIRECT /end RECORD_LAYOUT
/begin RECORD_LAYOUT KfAxUbAyUbSstxSbSstyUbWUb NO_AXIS_PTS_X 1 UBYTE NO_AXIS_PTS_Y 2 UBYTE AXIS_PTS_X 3 SBYTE INDEX_INCR DIRECT AXIS_PTS_Y 4 UBYTE INDEX_INCR DIRECT FNC_VALUES 5 UBYTE COLUMN_DIR DIRECT /end RECORD_LAYOUT
/begin RECORD_LAYOUT KfAxUbAyUbSstxUbSstyUbWSb NO_AXIS_PTS_X 1 UBYTE NO_AXIS_PTS_Y 2 UBYTE AXIS_PTS_X 3 UBYTE INDEX_INCR DIRECT AXIS_PTS_Y 4 UBYTE INDEX_INCR DIRECT FNC_VALUES 5 SBYTE COLUMN_DIR DIRECT /end RECORD_LAYOUT
/begin RECORD_LAYOUT KfAxUbAyUbSstxUbSstyUbWUb NO_AXIS_PTS_X 1 UBYTE NO_AXIS_PTS_Y 2 UBYTE AXIS_PTS_X 3 UBYTE INDEX_INCR DIRECT AXIS_PTS_Y 4 UBYTE INDEX_INCR DIRECT FNC_VALUES 5 UBYTE COLUMN_DIR DIRECT /end RECORD_LAYOUT
/begin RECORD_LAYOUT KfAxUwAyUwSstxSwSstyUwWUw NO_AXIS_PTS_X 1 UWORD NO_AXIS_PTS_Y 2 UWORD AXIS_PTS_X 3 SWORD INDEX_INCR DIRECT AXIS_PTS_Y 4 UWORD INDEX_INCR DIRECT FNC_VALUES 5 UWORD COLUMN_DIR DIRECT /end RECORD_LAYOUT
/begin RECORD_LAYOUT KfAxUwAyUwSstxUwSstyUwWUw NO_AXIS_PTS_X 1 UWORD NO_AXIS_PTS_Y 2 UWORD AXIS_PTS_X 3 UWORD INDEX_INCR DIRECT AXIS_PTS_Y 4 UWORD INDEX_INCR DIRECT FNC_VALUES 5 UWORD COLUMN_DIR DIRECT /end RECORD_LAYOUT
/begin RECORD_LAYOUT KfWUb FNC_VALUES 1 UBYTE COLUMN_DIR DIRECT /end RECORD_LAYOUT
/begin RECORD_LAYOUT KlAUbSstSbWSb NO_AXIS_PTS_X 1 UBYTE AXIS_PTS_X 2 SBYTE INDEX_INCR DIRECT FNC_VALUES 3 SBYTE COLUMN_DIR DIRECT /end RECORD_LAYOUT
/begin RECORD_LAYOUT KlAUbSstUbWSb NO_AXIS_PTS_X 1 UBYTE AXIS_PTS_X 2 UBYTE INDEX_INCR DIRECT FNC_VALUES 3 SBYTE COLUMN_DIR DIRECT /end RECORD_LAYOUT
/begin RECORD_LAYOUT KlAUbSstUbWUb NO_AXIS_PTS_X 1 UBYTE AXIS_PTS_X 2 UBYTE INDEX_INCR DIRECT FNC_VALUES 3 UBYTE COLUMN_DIR DIRECT /end RECORD_LAYOUT
/begin RECORD_LAYOUT KlAUwSstUwWUw NO_AXIS_PTS_X 1 UWORD AXIS_PTS_X 2 UWORD INDEX_INCR DIRECT FNC_VALUES 3 UWORD COLUMN_DIR DIRECT /end RECORD_LAYOUT
/begin RECORD_LAYOUT KwbUb FNC_VALUES 1 UBYTE COLUMN_DIR DIRECT /end RECORD_LAYOUT
/begin RECORD_LAYOUT KwbUw FNC_VALUES 1 UWORD COLUMN_DIR DIRECT /end RECORD_LAYOUT
/begin RECORD_LAYOUT KwSb FNC_VALUES 1 SBYTE COLUMN_DIR DIRECT /end RECORD_LAYOUT
/begin RECORD_LAYOUT KwUb FNC_VALUES 1 UBYTE COLUMN_DIR DIRECT /end RECORD_LAYOUT
/begin RECORD_LAYOUT KwUw FNC_VALUES 1 UWORD COLUMN_DIR DIRECT /end RECORD_LAYOUT
/begin RECORD_LAYOUT KwWU16 FNC_VALUES 1 UWORD COLUMN_DIR DIRECT /end RECORD_LAYOUT
/begin RECORD_LAYOUT KwWU32 FNC_VALUES 1 ULONG COLUMN_DIR DIRECT /end RECORD_LAYOUT
/begin RECORD_LAYOUT SstAUbSstUb NO_AXIS_PTS_X 1 UBYTE AXIS_PTS_X 2 UBYTE INDEX_INCR DIRECT /end RECORD_LAYOUT
/end MODULE
/end PROJECT
