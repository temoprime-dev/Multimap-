ASAP2_VERSION 1 3
/begin PROJECT _9702_071D00 "ME97"
/begin HEADER "" VERSION "_9702_071D00" PROJECT_NO _9702_071D00 /end HEADER
/begin MODULE DIM ""
/begin MOD_COMMON "" BYTE_ORDER MSB_FIRST ALIGNMENT_BYTE 1 ALIGNMENT_WORD 2 ALIGNMENT_LONG 2 ALIGNMENT_FLOAT32_IEEE 4 /end MOD_COMMON
/begin CHARACTERISTIC ATMRWT "Temperaturkorrektur f¸r Rohrwand hinter Kat aus TKATM" VALUE 0x1CCBA6 KwSw 1535.977 temp_q0p0234_o273 -1041.150 494.8266 FORMAT "%8.3" /end CHARACTERISTIC
/begin CHARACTERISTIC CDCAGRE "Codewort CARB:	‹berwachung AGR-Endstufe" VAL_BLK 0x1D369E KwbWU16 65535.00 dez 0.00 65535.00 FORMAT "%8.2" NUMBER 4 /end CHARACTERISTIC
/begin CHARACTERISTIC CDCAGRF "Codewort CARB: ‹berwachung AGR-FLOW" VAL_BLK 0x1D36A6 KwbWU16 65535.00 dez 0.00 65535.00 FORMAT "%8.2" NUMBER 4 /end CHARACTERISTIC
/begin CHARACTERISTIC CDCBREMS "Codewort CARB: Bremspedalgeber" VAL_BLK 0x1D372E KwbUw 65535.00 dez 0.00 65535.00 FORMAT "%8.2" NUMBER 4 /end CHARACTERISTIC
/begin CHARACTERISTIC CDCCAS "Codewort CARB: CAN-Schnittstelle, Timeout ASC" VAL_BLK 0x1D373E KwbWU16 65535.00 dez 0.00 65535.00 FORMAT "%8.2" NUMBER 4 /end CHARACTERISTIC
/begin CHARACTERISTIC CDCCAT "Codewort CARB: CAN-Schnittstelle, Timeout ASR" VAL_BLK 0x1D3746 KwbWU16 65535.00 dez 0.00 65535.00 FORMAT "%8.2" NUMBER 4 /end CHARACTERISTIC
/begin CHARACTERISTIC CDCCGE "Codewort CARB: CAN-Schnittstelle, Timeout EGS" VAL_BLK 0x1D374E KwbWU16 65535.00 dez 0.00 65535.00 FORMAT "%8.2" NUMBER 4 /end CHARACTERISTIC
/begin CHARACTERISTIC CDCCIF "Codewort CARB: CAN-Schnittstelle, interner Fehler" VAL_BLK 0x1D3756 KwbWU16 65535.00 dez 0.00 65535.00 FORMAT "%8.2" NUMBER 4 /end CHARACTERISTIC
/begin CHARACTERISTIC CDCCINS "Codewort CARB: CAN-Schnittstelle, Timeout Instrument" VAL_BLK 0x1D375E KwbWU16 65535.00 dez 0.00 65535.00 FORMAT "%8.2" NUMBER 4 /end CHARACTERISTIC
/begin CHARACTERISTIC CDCCSZL "Codewort CARB: CAN-Schnittstelle, Timeout SZL" VAL_BLK 0x1D376E KwbWU16 65535.00 dez 0.00 65535.00 FORMAT "%8.2" NUMBER 4 /end CHARACTERISTIC
/begin CHARACTERISTIC CDCDDSS "Codewort CARB: Differenzdrucksensor Saugrohr" VAL_BLK 0x1D3776 KwbWU16 65535.00 dez 0.00 65535.00 FORMAT "%8.2" NUMBER 4 /end CHARACTERISTIC
/begin CHARACTERISTIC CDCDMTK "Codewort CARB: Tankentl¸ftungssystem Feinstleck" VAL_BLK 0x1D3796 KwbWU16 65535.00 dez 0.00 65535.00 FORMAT "%8.2" NUMBER 4 /end CHARACTERISTIC
/begin CHARACTERISTIC CDCDMTKNM "Codewort CARB: Kleinstleck, no MIL" VAL_BLK 0x1D379E KwbWU16 65535.00 dez 0.00 65535.00 FORMAT "%8.2" NUMBER 4 /end CHARACTERISTIC
/begin CHARACTERISTIC CDCDMTL "Codewort CARB: Tankentl¸ftungssystem Modulfehler (Hardware)" VAL_BLK 0x1D37A6 KwbWU16 65535.00 dez 0.00 65535.00 FORMAT "%8.2" NUMBER 4 /end CHARACTERISTIC
/begin CHARACTERISTIC CDCDPL "Codewort CARB:	Dauerplus" VAL_BLK 0x1D37AE KwbWU16 65535.00 dez 0.00 65535.00 FORMAT "%8.2" NUMBER 4 /end CHARACTERISTIC
/begin CHARACTERISTIC CDCFAN "" VAL_BLK 0x1D38BE KwbWU16 65535.00 dez 0.00 65535.00 FORMAT "%8.2" NUMBER 4 /end CHARACTERISTIC
/begin CHARACTERISTIC CDCHSHE "Codewort CARB: Endstufe Heizung Sonde hinter Kat." VAL_BLK 0x1D391E KwbWU16 65535.00 dez 0.00 65535.00 FORMAT "%8.2" NUMBER 4 /end CHARACTERISTIC
/begin CHARACTERISTIC CDCHSHE2 "Codewort CARB: Endstufe Heizung Sonde Hinter Kat. Bank 2" VAL_BLK 0x1D3926 KwbWU16 65535.00 dez 0.00 65535.00 FORMAT "%8.2" NUMBER 4 /end CHARACTERISTIC
/begin CHARACTERISTIC CDCHSVSA "Codewort CARB:	Lambdasonden-Heizung vor Katalysator" VAL_BLK 0x1D394E KwbWU16 65535.00 dez 0.00 65535.00 FORMAT "%8.2" NUMBER 4 /end CHARACTERISTIC
/begin CHARACTERISTIC CDCHSVSA2 "Codewort CARB:	Lambdasonden-Heizung 2 vor Katalysator" VAL_BLK 0x1D3956 KwbWU16 65535.00 dez 0.00 65535.00 FORMAT "%8.2" NUMBER 4 /end CHARACTERISTIC
/begin CHARACTERISTIC CDCKUPPL "Codewort CARB: Kupplungspedalwertgeber" VAL_BLK 0x1D39BE KwbUw 65535.00 dez 0.00 65535.00 FORMAT "%8.2" NUMBER 4 /end CHARACTERISTIC
/begin CHARACTERISTIC CDCLDP "Codewort CARB: Leckdiagnosepumpe" VAL_BLK 0x1D39FE KwbWU16 65535.00 dez 0.00 65535.00 FORMAT "%8.2" NUMBER 4 /end CHARACTERISTIC
/begin CHARACTERISTIC CDCLFSE "" VAL_BLK 0x1D3A0E KwbWU16 65535.00 dez 0.00 65535.00 FORMAT "%8.2" NUMBER 4 /end CHARACTERISTIC
/begin CHARACTERISTIC CDCLSVV "Codewort CARB: Vertauschte Lambda-Sonden vor Kat" VAL_BLK 0x1D3A76 KwbWU16 65535.00 dez 0.00 65535.00 FORMAT "%8.2" NUMBER 4 /end CHARACTERISTIC
/begin CHARACTERISTIC CDCLUEA "Codewort CARB: Endstufe L¸fter A" VAL_BLK 0x1D3A7E KwbWU16 65535.00 dez 0.00 65535.00 FORMAT "%8.2" NUMBER 4 /end CHARACTERISTIC
/begin CHARACTERISTIC CDCLUEB "Codewort CARB: Endstufe L¸fter B" VAL_BLK 0x1D3A86 KwbWU16 65535.00 dez 0.00 65535.00 FORMAT "%8.2" NUMBER 4 /end CHARACTERISTIC
/begin CHARACTERISTIC CDCLUEC "Codewort CARB: Endstufe L¸fter C" VAL_BLK 0x1D3A8E KwbWU16 65535.00 dez 0.00 65535.00 FORMAT "%8.2" NUMBER 4 /end CHARACTERISTIC
/begin CHARACTERISTIC CDCMFA "Codewort CARB: MIL-fremdbestimmt" VAL_BLK 0x1D3B16 KwbWU16 65535.00 dez 0.00 65535.00 FORMAT "%8.2" NUMBER 4 /end CHARACTERISTIC
/begin CHARACTERISTIC CDCMILE "Codewort CARB: MIL-Endstufe" VAL_BLK 0x1D3B1E KwbWU16 65535.00 dez 0.00 65535.00 FORMAT "%8.2" NUMBER 4 /end CHARACTERISTIC
/begin CHARACTERISTIC CDCNWKW "Codewort CARB: Zuordnung Nockenwelle zu Kurbelwelle" VAL_BLK 0x1D3B2E KwbUw 65535.00 dez 0.00 65535.00 FORMAT "%8.2" NUMBER 4 /end CHARACTERISTIC
/begin CHARACTERISTIC CDCNWKW2 "Codewort CARB: Zuordnung Nockenwelle 2 zu Kurbelwelle" VAL_BLK 0x1D3B36 KwbUw 65535.00 dez 0.00 65535.00 FORMAT "%8.2" NUMBER 4 /end CHARACTERISTIC
/begin CHARACTERISTIC CDCNWKW3 "Codewort CARB: Zuordnung Nockenwelle 3 zu Kurbelwelle" VAL_BLK 0x1D3B3E KwbUw 65535.00 dez 0.00 65535.00 FORMAT "%8.2" NUMBER 4 /end CHARACTERISTIC
/begin CHARACTERISTIC CDCNWKW4 "Codewort CARB: Zuordnung Nockenwelle 4 zu Kurbelwelle" VAL_BLK 0x1D3B46 KwbUw 65535.00 dez 0.00 65535.00 FORMAT "%8.2" NUMBER 4 /end CHARACTERISTIC
/begin CHARACTERISTIC CDCNWKWA "Codewort CARB: Zuordnung Auslassnockenwelle zur Kurbelwelle" VAL_BLK 0x1D3B4E KwbUw 65535.00 dez 0.00 65535.00 FORMAT "%8.2" NUMBER 4 /end CHARACTERISTIC
/begin CHARACTERISTIC CDCNWKWA2 "Codewort CARB: Zuordnung Auslassnockenwelle Bank 2 zur Kurbelwelle" VAL_BLK 0x1D3B56 KwbUw 65535.00 dez 0.00 65535.00 FORMAT "%8.2" NUMBER 4 /end CHARACTERISTIC
/begin CHARACTERISTIC CDCNWKWE "Codewort CARB: Zuordnung Einlassnockenwelle zur Kurbelwelle" VAL_BLK 0x1D3B5E KwbUw 65535.00 dez 0.00 65535.00 FORMAT "%8.2" NUMBER 4 /end CHARACTERISTIC
/begin CHARACTERISTIC CDCNWKWE2 "Codewort CARB: Zuordnung Einlassnockenwelle Bank 2 zur Kurbelwelle" VAL_BLK 0x1D3B66 KwbUw 65535.00 dez 0.00 65535.00 FORMAT "%8.2" NUMBER 4 /end CHARACTERISTIC
/begin CHARACTERISTIC CDCNWS "Codewort CARB: Nockenwellensteuerung" VAL_BLK 0x1D3B6E KwbWU16 65535.00 dez 0.00 65535.00 FORMAT "%8.2" NUMBER 4 /end CHARACTERISTIC
/begin CHARACTERISTIC CDCPDDSS "Codewort CARB: Druck Differenzdrucksensor Saugrohr" VAL_BLK 0x1D3B7E KwbWU16 65535.00 dez 0.00 65535.00 FORMAT "%8.2" NUMBER 4 /end CHARACTERISTIC
/begin CHARACTERISTIC CDCSALSU "" VAL_BLK 0x1D3BD6 KwbUw 65535.00 dez 0.00 65535.00 FORMAT "%8.2" NUMBER 4 /end CHARACTERISTIC
/begin CHARACTERISTIC CDCSALSU2 "" VAL_BLK 0x1D3BDE KwbUw 65535.00 dez 0.00 65535.00 FORMAT "%8.2" NUMBER 4 /end CHARACTERISTIC
/begin CHARACTERISTIC CDCSLPE "Codewort CARB: Sekund‰rluftpumpe (Endstufe)" VAL_BLK 0x1D3BE6 KwbWU16 65535.00 dez 0.00 65535.00 FORMAT "%8.2" NUMBER 4 /end CHARACTERISTIC
/begin CHARACTERISTIC CDCSLVE "Codewort CARB: Sekund‰rluftventil (Endstufe)" VAL_BLK 0x1D3C0E KwbWU16 65535.00 dez 0.00 65535.00 FORMAT "%8.2" NUMBER 4 /end CHARACTERISTIC
/begin CHARACTERISTIC CDCSTAE "Codewort CARB: Startautomatik Endstufe" VAL_BLK 0x1D3C16 KwbWU16 65535.00 dez 0.00 65535.00 FORMAT "%8.2" NUMBER 4 /end CHARACTERISTIC
/begin CHARACTERISTIC CDCSUE "Codewort Carb: Endstufe Saugrohrumschaltung" VAL_BLK 0x1D3C1E KwbWU16 65535.00 dez 0.00 65535.00 FORMAT "%8.2" NUMBER 4 /end CHARACTERISTIC
/begin CHARACTERISTIC CDCSVSFA "Codewort CARB: SVS-fremdbestimmt" VAL_BLK 0x1D3C26 KwbWU16 65535.00 dez 0.00 65535.00 FORMAT "%8.2" NUMBER 4 /end CHARACTERISTIC
/begin CHARACTERISTIC CDCTCM_Par "" VAL_BLK 0x1D3C3E KwbUw 65535.00 dez 0.00 65535.00 FORMAT "%8.2" NUMBER 4 /end CHARACTERISTIC
/begin CHARACTERISTIC CDCTCM_Tgl "" VAL_BLK 0x1D3C46 KwbUw 65535.00 dez 0.00 65535.00 FORMAT "%8.2" NUMBER 4 /end CHARACTERISTIC
/begin CHARACTERISTIC CDCTCM_TrqReq "" VAL_BLK 0x1D3C4E KwbUw 65535.00 dez 0.00 65535.00 FORMAT "%8.2" NUMBER 4 /end CHARACTERISTIC
/begin CHARACTERISTIC CDCTESK "Codewort CARB: Tankentl¸ftungssystem Kleinstleck" VAL_BLK 0x1D3C5E KwbWU16 65535.00 dez 0.00 65535.00 FORMAT "%8.2" NUMBER 4 /end CHARACTERISTIC
/begin CHARACTERISTIC CDCTMKI "Codewort CARB: Motortemperatur aus Kombiinstrument TMKI" VAL_BLK 0x1D3C86 KwbWU16 65535.00 dez 0.00 65535.00 FORMAT "%8.2" NUMBER 4 /end CHARACTERISTIC
/begin CHARACTERISTIC CDCTUM "Codewort CARB: Umgebungs(-luft)-Temperatur TUM" VAL_BLK 0x1D3C96 KwbWU16 65535.00 dez 0.00 65535.00 FORMAT "%8.2" NUMBER 4 /end CHARACTERISTIC
/begin CHARACTERISTIC CDCTX "Codewort CARB: Temperatur EBOX" VAL_BLK 0x1D3C9E KwbWU16 65535.00 dez 0.00 65535.00 FORMAT "%8.2" NUMBER 4 /end CHARACTERISTIC
/begin CHARACTERISTIC CDCUVSE "Codewort CARB: Umluftventil-Steuerung Endstufe" VAL_BLK 0x1D3CFE KwbWU16 65535.00 dez 0.00 65535.00 FORMAT "%8.2" NUMBER 4 /end CHARACTERISTIC
/begin CHARACTERISTIC CDCVFZ "Codewort CARB: Fahrzeug-Geschwindigkeit" VAL_BLK 0x1D3D06 KwbUw 65535.00 dez 0.00 65535.00 FORMAT "%8.2" NUMBER 4 /end CHARACTERISTIC
/begin CHARACTERISTIC CDCWWS_BRD "" VAL_BLK 0x1D3D0E KwbUw 65535.00 dez 0.00 65535.00 FORMAT "%8.2" NUMBER 4 /end CHARACTERISTIC
/begin CHARACTERISTIC CDCWWS_NoPA "" VAL_BLK 0x1D3D16 KwbUw 65535.00 dez 0.00 65535.00 FORMAT "%8.2" NUMBER 4 /end CHARACTERISTIC
/begin CHARACTERISTIC CDCWWS_PA "" VAL_BLK 0x1D3D1E KwbUw 65535.00 dez 0.00 65535.00 FORMAT "%8.2" NUMBER 4 /end CHARACTERISTIC
/begin CHARACTERISTIC CDKAGRE "Codewort Kunde: ‹berwachung AGR-Endstufe" VALUE 0x1D3D3C KwWU16 65535.00 dez 0.00 65535.00 FORMAT "%8.2" /end CHARACTERISTIC
/begin CHARACTERISTIC CDKAGRF "Codewort Kunde: ‹berwachung AGR-FLOW" VALUE 0x1D3D3E KwWU16 65535.00 dez 0.00 65535.00 FORMAT "%8.2" /end CHARACTERISTIC
/begin CHARACTERISTIC CDKBREMS "Codewort Kunde: BREMS (Bremsschalter)" VALUE 0x1D3D60 KwUw 65535.00 dez 0.00 65535.00 FORMAT "%8.2" /end CHARACTERISTIC
/begin CHARACTERISTIC CDKCAS "Codewort Kunde: CAN-Schnittstelle, Timeout ASC" VALUE 0x1D3D64 KwWU16 65535.00 dez 0.00 65535.00 FORMAT "%8.2" /end CHARACTERISTIC
/begin CHARACTERISTIC CDKCAT "Codewort Kunde: CAN-Schnittstelle, Timeout ASR" VALUE 0x1D3D66 KwWU16 65535.00 dez 0.00 65535.00 FORMAT "%8.2" /end CHARACTERISTIC
/begin CHARACTERISTIC CDKCGE "Codewort Kunde: CAN-Schnittstelle, Timeout EGS" VALUE 0x1D3D68 KwWU16 65535.00 dez 0.00 65535.00 FORMAT "%8.2" /end CHARACTERISTIC
/begin CHARACTERISTIC CDKCIF "Codewort Kunde: CAN-Schnittstelle, interner Fehler" VALUE 0x1D3D6A KwWU16 65535.00 dez 0.00 65535.00 FORMAT "%8.2" /end CHARACTERISTIC
/begin CHARACTERISTIC CDKCINS "Codewort Kunde: CAN- timeout, Instrumente" VALUE 0x1D3D6C KwWU16 65535.00 dez 0.00 65535.00 FORMAT "%8.2" /end CHARACTERISTIC
/begin CHARACTERISTIC CDKCSZL "Codewort Kunde: CAN-Timeout SZL- Botschaft" VALUE 0x1D3D70 KwWU16 65535.00 dez 0.00 65535.00 FORMAT "%8.2" /end CHARACTERISTIC
/begin CHARACTERISTIC CDKDDSS "Codewort Kunde: Differenzdrucksensor Saugrohr" VALUE 0x1D3D72 KwWU16 65535.00 dez 0.00 65535.00 FORMAT "%8.2" /end CHARACTERISTIC
/begin CHARACTERISTIC CDKDMTK "Codewort Kunde: Tankentl¸ftungssystem, Feinstleck" VALUE 0x1D3D7A KwWU16 65535.00 dez 0.00 65535.00 FORMAT "%8.2" /end CHARACTERISTIC
/begin CHARACTERISTIC CDKDMTKNM "Codewort Kunde: Kleinstleck, no MIL" VALUE 0x1D3D7C KwWU16 65535.00 dez 0.00 65535.00 FORMAT "%8.2" /end CHARACTERISTIC
/begin CHARACTERISTIC CDKDMTL "Codewort Kunde: Tankentl¸ftungssystem, Modulefehler (Hardware)" VALUE 0x1D3D7E KwWU16 65535.00 dez 0.00 65535.00 FORMAT "%8.2" /end CHARACTERISTIC
/begin CHARACTERISTIC CDKDPL "Codewort Kunde: Dauerplus" VALUE 0x1D3D80 KwWU16 65535.00 dez 0.00 65535.00 FORMAT "%8.2" /end CHARACTERISTIC
/begin CHARACTERISTIC CDKFAN "" VALUE 0x1D3DC4 KwWU16 65535.00 dez 0.00 65535.00 FORMAT "%8.2" /end CHARACTERISTIC
/begin CHARACTERISTIC CDKHSHE "Codewort Kunde: Endstufe Heizung Sonde hinter Kat." VALUE 0x1D3DDC KwWU16 65535.00 dez 0.00 65535.00 FORMAT "%8.2" /end CHARACTERISTIC
/begin CHARACTERISTIC CDKHSHE2 "Codewort Kunde: Enstufe Heizung Sonde Hinter Kat. Bank 2" VALUE 0x1D3DDE KwWU16 65535.00 dez 0.00 65535.00 FORMAT "%8.2" /end CHARACTERISTIC
/begin CHARACTERISTIC CDKHSVSA "" VALUE 0x1D3DE8 KwWU16 65535.00 dez 0.00 65535.00 FORMAT "%8.2" /end CHARACTERISTIC
/begin CHARACTERISTIC CDKHSVSA2 "" VALUE 0x1D3DEA KwWU16 65535.00 dez 0.00 65535.00 FORMAT "%8.2" /end CHARACTERISTIC
/begin CHARACTERISTIC CDKKUPPL "Codewort Kunde: Pedalwertgeber Kupplung" VALUE 0x1D3E04 KwUw 65535.00 dez 0.00 65535.00 FORMAT "%8.2" /end CHARACTERISTIC
/begin CHARACTERISTIC CDKLDP "Codewort Kunde: Leckdiagnosepumpe" VALUE 0x1D3E14 KwWU16 65535.00 dez 0.00 65535.00 FORMAT "%8.2" /end CHARACTERISTIC
/begin CHARACTERISTIC CDKLFSE "" VALUE 0x1D3E18 KwWU16 65535.00 dez 0.00 65535.00 FORMAT "%8.2" /end CHARACTERISTIC
/begin CHARACTERISTIC CDKLSVV "Codewort Kunde: Vertauschte Lambda- Sonden vor Kat" VALUE 0x1D3E32 KwWU16 65535.00 dez 0.00 65535.00 FORMAT "%8.2" /end CHARACTERISTIC
/begin CHARACTERISTIC CDKLUEA "Codewort Kunde:	Endstufe L¸fter A" VALUE 0x1D3E34 KwWU16 65535.00 dez 0.00 65535.00 FORMAT "%8.2" /end CHARACTERISTIC
/begin CHARACTERISTIC CDKLUEB "Codewort Kunde:	Endstufe L¸fter B" VALUE 0x1D3E36 KwWU16 65535.00 dez 0.00 65535.00 FORMAT "%8.2" /end CHARACTERISTIC
/begin CHARACTERISTIC CDKLUEC "Codewort Kunde:	Endstufe L¸fter C" VALUE 0x1D3E38 KwWU16 65535.00 dez 0.00 65535.00 FORMAT "%8.2" /end CHARACTERISTIC
/begin CHARACTERISTIC CDKMFA "Codewort Kunde: MIL-fremdbestimmt" VALUE 0x1D3E5A KwWU16 65535.00 dez 0.00 65535.00 FORMAT "%8.2" /end CHARACTERISTIC
/begin CHARACTERISTIC CDKMILE "Codewort Kunde: MIL-Endstufe" VALUE 0x1D3E5C KwWU16 65535.00 dez 0.00 65535.00 FORMAT "%8.2" /end CHARACTERISTIC
/begin CHARACTERISTIC CDKNWKW "Codewort Kunde: Zuordnung Nockwelle zu Kurbelwelle" VALUE 0x1D3E60 KwUw 65535.00 dez 0.00 65535.00 FORMAT "%8.2" /end CHARACTERISTIC
/begin CHARACTERISTIC CDKNWKW2 "Codewort Kunde: Zuordnung Nockwelle 2 zu Kurbelwelle" VALUE 0x1D3E62 KwUw 65535.00 dez 0.00 65535.00 FORMAT "%8.2" /end CHARACTERISTIC
/begin CHARACTERISTIC CDKNWKW3 "Codewort Kunde: Zuordnung Nockwelle 3 zu Kurbelwelle" VALUE 0x1D3E64 KwUw 65535.00 dez 0.00 65535.00 FORMAT "%8.2" /end CHARACTERISTIC
/begin CHARACTERISTIC CDKNWKW4 "Codewort Kunde: Zuordnung Nockwelle 4 zu Kurbelwelle" VALUE 0x1D3E66 KwUw 65535.00 dez 0.00 65535.00 FORMAT "%8.2" /end CHARACTERISTIC
/begin CHARACTERISTIC CDKNWKWA "Codewort Kunde: Zuordnung Auslassnockwelle  zur Kurbelwelle" VALUE 0x1D3E68 KwUw 65535.00 dez 0.00 65535.00 FORMAT "%8.2" /end CHARACTERISTIC
/begin CHARACTERISTIC CDKNWKWA2 "Codewort Kunde: Zuordnung Auslassnockwelle Bank 2  zur Kurbelwelle" VALUE 0x1D3E6A KwUw 65535.00 dez 0.00 65535.00 FORMAT "%8.2" /end CHARACTERISTIC
/begin CHARACTERISTIC CDKNWKWE "Codewort Kunde: Zuordnung Einlassnockwelle zur Kurbelwelle" VALUE 0x1D3E6C KwUw 65535.00 dez 0.00 65535.00 FORMAT "%8.2" /end CHARACTERISTIC
/begin CHARACTERISTIC CDKNWKWE2 "Codewort Kunde: Zuordnung Einlassnockwelle Bank 2 zur Kurbelwelle" VALUE 0x1D3E6E KwUw 65535.00 dez 0.00 65535.00 FORMAT "%8.2" /end CHARACTERISTIC
/begin CHARACTERISTIC CDKNWS "Codewort Kunde: Nockenwellensteuerung" VALUE 0x1D3E70 KwWU16 65535.00 dez 0.00 65535.00 FORMAT "%8.2" /end CHARACTERISTIC
/begin CHARACTERISTIC CDKPDDSS "Codewort Kunde: Druck Differenzdrucksensor Saugrohr" VALUE 0x1D3E74 KwWU16 65535.00 dez 0.00 65535.00 FORMAT "%8.2" /end CHARACTERISTIC
/begin CHARACTERISTIC CDKSALSU "" VALUE 0x1D3E8A KwUw 65535.00 dez 0.00 65535.00 FORMAT "%8.2" /end CHARACTERISTIC
/begin CHARACTERISTIC CDKSALSU2 "" VALUE 0x1D3E8C KwUw 65535.00 dez 0.00 65535.00 FORMAT "%8.2" /end CHARACTERISTIC
/begin CHARACTERISTIC CDKSLPE "Codewort Kunde: Sekund‰rluftpumpe  (Endstufe)" VALUE 0x1D3E8E KwWU16 65535.00 dez 0.00 65535.00 FORMAT "%8.2" /end CHARACTERISTIC
/begin CHARACTERISTIC CDKSLVE "Codewort Kunde:	Sekund‰rluftventil (Endstufe)" VALUE 0x1D3E98 KwWU16 65535.00 dez 0.00 65535.00 FORMAT "%8.2" /end CHARACTERISTIC
/begin CHARACTERISTIC CDKSTAE "Codewort Kunde: Startautomatik (Endstufe)" VALUE 0x1D3E9A KwWU16 65535.00 dez 0.00 65535.00 FORMAT "%8.2" /end CHARACTERISTIC
/begin CHARACTERISTIC CDKSUE "Codewort Kunde: Endstufe Saugrohrumschaltung" VALUE 0x1D3E9C KwWU16 65535.00 dez 0.00 65535.00 FORMAT "%8.2" /end CHARACTERISTIC
/begin CHARACTERISTIC CDKSVSFA "Codewort Kunde: SVS-fremdbestimmt" VALUE 0x1D3E9E KwWU16 65535.00 dez 0.00 65535.00 FORMAT "%8.2" /end CHARACTERISTIC
/begin CHARACTERISTIC CDKTCM_Par "" VALUE 0x1D3EA4 KwUw 65535.00 dez 0.00 65535.00 FORMAT "%8.2" /end CHARACTERISTIC
/begin CHARACTERISTIC CDKTCM_Tgl "" VALUE 0x1D3EA6 KwUw 65535.00 dez 0.00 65535.00 FORMAT "%8.2" /end CHARACTERISTIC
/begin CHARACTERISTIC CDKTCM_TrqReq "" VALUE 0x1D3EA8 KwUw 65535.00 dez 0.00 65535.00 FORMAT "%8.2" /end CHARACTERISTIC
/begin CHARACTERISTIC CDKTESK "Codewort Kunde: Tankentl¸ftungssystem Kleinstleck" VALUE 0x1D3EAC KwWU16 65535.00 dez 0.00 65535.00 FORMAT "%8.2" /end CHARACTERISTIC
/begin CHARACTERISTIC CDKTMKI "Codewort Kunde: Motortemperatur aus Kombiinstrument TMKI" VALUE 0x1D3EB6 KwWU16 65535.00 dez 0.00 65535.00 FORMAT "%8.2" /end CHARACTERISTIC
/begin CHARACTERISTIC CDKTUM "Codewort Kunde: Umgebungstemperatur" VALUE 0x1D3EBA KwWU16 65535.00 dez 0.00 65535.00 FORMAT "%8.2" /end CHARACTERISTIC
/begin CHARACTERISTIC CDKTX "Codewort Kunde: Temperatur EBOX" VALUE 0x1D3EBC KwWU16 65535.00 dez 0.00 65535.00 FORMAT "%8.2" /end CHARACTERISTIC
/begin CHARACTERISTIC CDKUVSE "Codeword Kunde: Endstufe Umluftventil turbo" VALUE 0x1D3ED4 KwWU16 65535.00 dez 0.00 65535.00 FORMAT "%8.2" /end CHARACTERISTIC
/begin CHARACTERISTIC CDKVFZ "Codewort Kunde:	Fahrzeug-Geschwindigkeit" VALUE 0x1D3ED6 KwUw 65535.00 dez 0.00 65535.00 FORMAT "%8.2" /end CHARACTERISTIC
/begin CHARACTERISTIC CDKWWS_BRD "" VALUE 0x1D3ED8 KwUw 65535.00 dez 0.00 65535.00 FORMAT "%8.2" /end CHARACTERISTIC
/begin CHARACTERISTIC CDKWWS_NoPA "" VALUE 0x1D3EDA KwUw 65535.00 dez 0.00 65535.00 FORMAT "%8.2" /end CHARACTERISTIC
/begin CHARACTERISTIC CDKWWS_PA "" VALUE 0x1D3EDC KwUw 65535.00 dez 0.00 65535.00 FORMAT "%8.2" /end CHARACTERISTIC
/begin CHARACTERISTIC CDTAGRE "Codewort Tester: ‹berwachung AGR-Endstufe" VALUE 0x1D3EEE KwWU16 65535.00 dez 0.00 65535.00 FORMAT "%8.2" /end CHARACTERISTIC
/begin CHARACTERISTIC CDTAGRF "Codewort Tester: ‹berwachung AGR-FLOW" VALUE 0x1D3EF0 KwWU16 65535.00 dez 0.00 65535.00 FORMAT "%8.2" /end CHARACTERISTIC
/begin CHARACTERISTIC CDTBREMS "Fehlerpfadcode: BREMS (Bremsschalter)" VALUE 0x1D3F12 KwUw 65535.00 dez 0.00 65535.00 FORMAT "%8.2" /end CHARACTERISTIC
/begin CHARACTERISTIC CDTCAS "Codewort Tester: CAN-Schnittstelle, Timeout ASC" VALUE 0x1D3F16 KwWU16 65535.00 dez 0.00 65535.00 FORMAT "%8.2" /end CHARACTERISTIC
/begin CHARACTERISTIC CDTCAT "" VALUE 0x1D3F18 KwWU16 65535.00 dez 0.00 65535.00 FORMAT "%8.2" /end CHARACTERISTIC
/begin CHARACTERISTIC CDTCGE "Codewort Tester: CAN-Schnittstelle, Timeout EGS" VALUE 0x1D3F1A KwWU16 65535.00 dez 0.00 65535.00 FORMAT "%8.2" /end CHARACTERISTIC
/begin CHARACTERISTIC CDTCIF "Codewort Tester: CAN-Schnittstelle, interner Fehler" VALUE 0x1D3F1C KwWU16 65535.00 dez 0.00 65535.00 FORMAT "%8.2" /end CHARACTERISTIC
/begin CHARACTERISTIC CDTCINS "Codewort Tester: CAN-Timeout, Instrumente" VALUE 0x1D3F1E KwWU16 65535.00 dez 0.00 65535.00 FORMAT "%8.2" /end CHARACTERISTIC
/begin CHARACTERISTIC CDTCSZL "Codewort Tester: CAN-Schnittstelle, Timeout SZL" VALUE 0x1D3F22 KwWU16 65535.00 dez 0.00 65535.00 FORMAT "%8.2" /end CHARACTERISTIC
/begin CHARACTERISTIC CDTDDSS "Codewort Tester: Differenzdrucksensor Saugrohr" VALUE 0x1D3F24 KwWU16 65535.00 dez 0.00 65535.00 FORMAT "%8.2" /end CHARACTERISTIC
/begin CHARACTERISTIC CDTDMTK "Codewort Tester: Tankentl¸ftungssystem Feinstleck" VALUE 0x1D3F2C KwWU16 65535.00 dez 0.00 65535.00 FORMAT "%8.2" /end CHARACTERISTIC
/begin CHARACTERISTIC CDTDMTKNM "Codewort Tester: Kleinstleck ohne MIL Ansteuerung" VALUE 0x1D3F2E KwWU16 65535.00 dez 0.00 65535.00 FORMAT "%8.2" /end CHARACTERISTIC
/begin CHARACTERISTIC CDTDMTL "Codewort Tester: Tankentl¸ftungssystem Modulfehler (Hardware)" VALUE 0x1D3F30 KwWU16 65535.00 dez 0.00 65535.00 FORMAT "%8.2" /end CHARACTERISTIC
/begin CHARACTERISTIC CDTDPL "Codewort Tester: Dauerplus" VALUE 0x1D3F32 KwWU16 65535.00 dez 0.00 65535.00 FORMAT "%8.2" /end CHARACTERISTIC
/begin CHARACTERISTIC CDTFAN "" VALUE 0x1D3F76 KwWU16 65535.00 dez 0.00 65535.00 FORMAT "%8.2" /end CHARACTERISTIC
/begin CHARACTERISTIC CDTHSHE "Codewort Tester: Endstufe Lambdasonden-Heizung hinter Katalysator" VALUE 0x1D3F8E KwWU16 65535.00 dez 0.00 65535.00 FORMAT "%8.2" /end CHARACTERISTIC
/begin CHARACTERISTIC CDTHSHE2 "Codewort Tester: Endstufe Lambdasonden-Heizung2 hinter Katalysator" VALUE 0x1D3F90 KwWU16 65535.00 dez 0.00 65535.00 FORMAT "%8.2" /end CHARACTERISTIC
/begin CHARACTERISTIC CDTHSVSA "Codewort Tester: Lambdasonden-Heizung vor Katalysator" VALUE 0x1D3F9A KwWU16 65535.00 dez 0.00 65535.00 FORMAT "%8.2" /end CHARACTERISTIC
/begin CHARACTERISTIC CDTHSVSA2 "Codewort Tester: Lambdasonden-Heizung vor Kat., Bank 2" VALUE 0x1D3F9C KwWU16 65535.00 dez 0.00 65535.00 FORMAT "%8.2" /end CHARACTERISTIC
/begin CHARACTERISTIC CDTKUPPL "Fehlerpfadcode: Pedalwertgeber Kupplung" VALUE 0x1D3FB6 KwUw 65535.00 dez 0.00 65535.00 FORMAT "%8.2" /end CHARACTERISTIC
/begin CHARACTERISTIC CDTLDP "Codewort Tester: Tankentl¸ftung; Leckdiagnosepumpe" VALUE 0x1D3FC6 KwWU16 65535.00 dez 0.00 65535.00 FORMAT "%8.2" /end CHARACTERISTIC
/begin CHARACTERISTIC CDTLFSE "" VALUE 0x1D3FCA KwWU16 65535.00 dez 0.00 65535.00 FORMAT "%8.2" /end CHARACTERISTIC
/begin CHARACTERISTIC CDTLSVV "Codewort Tester: Vertauschte Lambda-Sonde vor Kat" VALUE 0x1D3FE4 KwWU16 65535.00 dez 0.00 65535.00 FORMAT "%8.2" /end CHARACTERISTIC
/begin CHARACTERISTIC CDTLUEA "Codewort Tester: Endstufe L¸fter A" VALUE 0x1D3FE6 KwWU16 65535.00 dez 0.00 65535.00 FORMAT "%8.2" /end CHARACTERISTIC
/begin CHARACTERISTIC CDTLUEB "Codewort Tester: Endstufe L¸fter B" VALUE 0x1D3FE8 KwWU16 65535.00 dez 0.00 65535.00 FORMAT "%8.2" /end CHARACTERISTIC
/begin CHARACTERISTIC CDTLUEC "Codewort Tester: Endstufe L¸fter C" VALUE 0x1D3FEA KwWU16 65535.00 dez 0.00 65535.00 FORMAT "%8.2" /end CHARACTERISTIC
/begin CHARACTERISTIC CDTMFA "Codewort Tester: MIL-fremdbestimmt" VALUE 0x1D400C KwWU16 65535.00 dez 0.00 65535.00 FORMAT "%8.2" /end CHARACTERISTIC
/begin CHARACTERISTIC CDTMILE "Codewort Tester: MIL-Endstufe" VALUE 0x1D400E KwWU16 65535.00 dez 0.00 65535.00 FORMAT "%8.2" /end CHARACTERISTIC
/begin CHARACTERISTIC CDTNWKW "Codewort Tester: Zuordnung Nockenwelle zu Kurbelwelle" VALUE 0x1D4012 KwUw 65535.00 dez 0.00 65535.00 FORMAT "%8.2" /end CHARACTERISTIC
/begin CHARACTERISTIC CDTNWKW2 "Codewort Tester: Zuordnung Nockenwelle 2 zu Kurbelwelle" VALUE 0x1D4014 KwUw 65535.00 dez 0.00 65535.00 FORMAT "%8.2" /end CHARACTERISTIC
/begin CHARACTERISTIC CDTNWKW3 "Codewort Tester: Zuordnung Nockenwelle 3 zu Kurbelwelle" VALUE 0x1D4016 KwUw 65535.00 dez 0.00 65535.00 FORMAT "%8.2" /end CHARACTERISTIC
/begin CHARACTERISTIC CDTNWKW4 "Codewort Tester: Zuordnung Nockenwelle 4 zu Kurbelwelle" VALUE 0x1D4018 KwUw 65535.00 dez 0.00 65535.00 FORMAT "%8.2" /end CHARACTERISTIC
/begin CHARACTERISTIC CDTNWKWA "Codewort Tester: Zuordnung Auslassnockenwelle zur Kurbelwelle" VALUE 0x1D401A KwUw 65535.00 dez 0.00 65535.00 FORMAT "%8.2" /end CHARACTERISTIC
/begin CHARACTERISTIC CDTNWKWA2 "Codewort Tester: Zuordnung Auslassnockenwelle Bank 2 zur Kurbelwelle" VALUE 0x1D401C KwUw 65535.00 dez 0.00 65535.00 FORMAT "%8.2" /end CHARACTERISTIC
/begin CHARACTERISTIC CDTNWKWE "Codewort Tester: Zuordnung Einlassnockenwelle zur Kurbelwelle" VALUE 0x1D401E KwUw 65535.00 dez 0.00 65535.00 FORMAT "%8.2" /end CHARACTERISTIC
/begin CHARACTERISTIC CDTNWKWE2 "Codewort Tester: Zuordnung Einlassnockenwelle Bank 2 zur Kurbelwelle" VALUE 0x1D4020 KwUw 65535.00 dez 0.00 65535.00 FORMAT "%8.2" /end CHARACTERISTIC
/begin CHARACTERISTIC CDTNWS "Codewort Tester: Nockenwellensteuerung" VALUE 0x1D4022 KwWU16 65535.00 dez 0.00 65535.00 FORMAT "%8.2" /end CHARACTERISTIC
/begin CHARACTERISTIC CDTPDDSS "Codewort Tester: Druck Differenzdrucksensor Saugrohr" VALUE 0x1D4026 KwWU16 65535.00 dez 0.00 65535.00 FORMAT "%8.2" /end CHARACTERISTIC
/begin CHARACTERISTIC CDTSALSU "" VALUE 0x1D403C KwUw 65535.00 dez 0.00 65535.00 FORMAT "%8.2" /end CHARACTERISTIC
/begin CHARACTERISTIC CDTSALSU2 "" VALUE 0x1D403E KwUw 65535.00 dez 0.00 65535.00 FORMAT "%8.2" /end CHARACTERISTIC
/begin CHARACTERISTIC CDTSLPE "Codewort Tester: Sekund‰rluftpumpe (Endstufe)" VALUE 0x1D4040 KwWU16 65535.00 dez 0.00 65535.00 FORMAT "%8.2" /end CHARACTERISTIC
/begin CHARACTERISTIC CDTSLVE "Codewort Tester: Sekund‰rluftventil (Endstufe)" VALUE 0x1D404A KwWU16 65535.00 dez 0.00 65535.00 FORMAT "%8.2" /end CHARACTERISTIC
/begin CHARACTERISTIC CDTSTAE "Codewort Tester: Startautomatik     (Endstufe)" VALUE 0x1D404C KwWU16 65535.00 dez 0.00 65535.00 FORMAT "%8.2" /end CHARACTERISTIC
/begin CHARACTERISTIC CDTSUE "Codewort Tester: Endstufe Saugrohrumschaltung" VALUE 0x1D404E KwWU16 65535.00 dez 0.00 65535.00 FORMAT "%8.2" /end CHARACTERISTIC
/begin CHARACTERISTIC CDTSVSFA "Codewort Tester: SVS-fremdbestimmt" VALUE 0x1D4050 KwWU16 65535.00 dez 0.00 65535.00 FORMAT "%8.2" /end CHARACTERISTIC
/begin CHARACTERISTIC CDTTCM_Par "" VALUE 0x1D4056 KwUw 65535.00 dez 0.00 65535.00 FORMAT "%8.2" /end CHARACTERISTIC
/begin CHARACTERISTIC CDTTCM_Tgl "" VALUE 0x1D4058 KwUw 65535.00 dez 0.00 65535.00 FORMAT "%8.2" /end CHARACTERISTIC
/begin CHARACTERISTIC CDTTCM_TrqReq "" VALUE 0x1D405A KwUw 65535.00 dez 0.00 65535.00 FORMAT "%8.2" /end CHARACTERISTIC
/begin CHARACTERISTIC CDTTESK "Codewort Tester: Tankentl¸ftungssystem Kleinstleck" VALUE 0x1D405E KwWU16 65535.00 dez 0.00 65535.00 FORMAT "%8.2" /end CHARACTERISTIC
/begin CHARACTERISTIC CDTTMKI "Codewort Tester: Motortemperatur aus Kombiinstrument TMKI" VALUE 0x1D4068 KwWU16 65535.00 dez 0.00 65535.00 FORMAT "%8.2" /end CHARACTERISTIC
/begin CHARACTERISTIC CDTTUM "Codewort Tester: Umgebungstemperatur TUM" VALUE 0x1D406C KwWU16 65535.00 dez 0.00 65535.00 FORMAT "%8.2" /end CHARACTERISTIC
/begin CHARACTERISTIC CDTTX "Codewort Tester: Temperatur EBOX" VALUE 0x1D406E KwWU16 65535.00 dez 0.00 65535.00 FORMAT "%8.2" /end CHARACTERISTIC
/begin CHARACTERISTIC CDTUVSE "Codewort Tester: Endstufe Umluftventil Turbo" VALUE 0x1D4086 KwWU16 65535.00 dez 0.00 65535.00 FORMAT "%8.2" /end CHARACTERISTIC
/begin CHARACTERISTIC CDTVFZ "Codewort Tester: Fahrzeug-Geschwindigkeit" VALUE 0x1D4088 KwUw 65535.00 dez 0.00 65535.00 FORMAT "%8.2" /end CHARACTERISTIC
/begin CHARACTERISTIC CDTWWS_BRD "" VALUE 0x1D408A KwUw 65535.00 dez 0.00 65535.00 FORMAT "%8.2" /end CHARACTERISTIC
/begin CHARACTERISTIC CDTWWS_NoPA "" VALUE 0x1D408C KwUw 65535.00 dez 0.00 65535.00 FORMAT "%8.2" /end CHARACTERISTIC
/begin CHARACTERISTIC CDTWWS_PA "" VALUE 0x1D408E KwUw 65535.00 dez 0.00 65535.00 FORMAT "%8.2" /end CHARACTERISTIC
/begin CHARACTERISTIC CLAAGRE "Fehlerklasse: AGR-Ventil Endstufe" VALUE 0x1D3154 KwWU8 255.0 dez 0.00 255.0 FORMAT "%5.1" /end CHARACTERISTIC
/begin CHARACTERISTIC CLAAGRF "Fehlerklasse: ‹berwachung AGR-Flow" VALUE 0x1D3155 KwWU8 255.0 dez 0.00 255.0 FORMAT "%5.1" /end CHARACTERISTIC
/begin CHARACTERISTIC CLABREMS "Fehlerklasse: BREMS (Bremsschalter)" VALUE 0x1D3166 KwUb 255.0 dez 0.00 255.0 FORMAT "%5.1" /end CHARACTERISTIC
/begin CHARACTERISTIC CLACAS "Fehlerklasse: CAN-Timeout ASC-Botschaft" VALUE 0x1D3168 KwWU8 255.0 dez 0.00 255.0 FORMAT "%5.1" /end CHARACTERISTIC
/begin CHARACTERISTIC CLACAT "Fehlerklasse: CAN-Schnittstelle, Timeout ASR" VALUE 0x1D3169 KwWU8 255.0 dez 0.00 255.0 FORMAT "%5.1" /end CHARACTERISTIC
/begin CHARACTERISTIC CLACGE "Fehlerklasse: CAN-Timeout EGS-Botschaft" VALUE 0x1D316A KwWU8 255.0 dez 0.00 255.0 FORMAT "%5.1" /end CHARACTERISTIC
/begin CHARACTERISTIC CLACIF "Fehlerklasse: CAN-Schnittstelle, interner Fehler" VALUE 0x1D316B KwWU8 255.0 dez 0.00 255.0 FORMAT "%5.1" /end CHARACTERISTIC
/begin CHARACTERISTIC CLACINS "Fehlerklasse: CAN-Timeout Botschaft Kombiinstrument" VALUE 0x1D316C KwWU8 255.0 dez 0.00 255.0 FORMAT "%5.1" /end CHARACTERISTIC
/begin CHARACTERISTIC CLACSZL "Fehlerklasse: CAN-Timeout SZL-Botschaft" VALUE 0x1D316E KwWU8 255.0 dez 0.00 255.0 FORMAT "%5.1" /end CHARACTERISTIC
/begin CHARACTERISTIC CLADDSS "Fehlerklasse: Differenzdrucksensor Saugrohr" VALUE 0x1D316F KwWU8 255.0 dez 0.00 255.0 FORMAT "%5.1" /end CHARACTERISTIC
/begin CHARACTERISTIC CLADMTK "Fehlerklasse: Tankdiagnose, Feinstleck" VALUE 0x1D3173 KwWU8 255.0 dez 0.00 255.0 FORMAT "%5.1" /end CHARACTERISTIC
/begin CHARACTERISTIC CLADMTKNM "Fehlerklasse: Kleinstleck, no MIL" VALUE 0x1D3174 KwWU8 255.0 dez 0.00 255.0 FORMAT "%5.1" /end CHARACTERISTIC
/begin CHARACTERISTIC CLADMTL "Fehlerklasse: Tankdiagnose, Modulfehler" VALUE 0x1D3175 KwWU8 255.0 dez 0.00 255.0 FORMAT "%5.1" /end CHARACTERISTIC
/begin CHARACTERISTIC CLADPL "Fehlerklasse: Dauerplus" VALUE 0x1D3176 KwWU8 255.0 dez 0.00 255.0 FORMAT "%5.1" /end CHARACTERISTIC
/begin CHARACTERISTIC CLAFAN "" VALUE 0x1D3198 KwWU8 255.0 dez 0.00 255.0 FORMAT "%5.1" /end CHARACTERISTIC
/begin CHARACTERISTIC CLAHSHE "Fehlerklasse: Endstufe Heizung Lambdasonde hinter Kat" VALUE 0x1D31A4 KwWU8 255.0 dez 0.00 255.0 FORMAT "%5.1" /end CHARACTERISTIC
/begin CHARACTERISTIC CLAHSHE2 "Fehlerklasse: Endstufe Heizung Lambdasonde 2 hinter Kat" VALUE 0x1D31A5 KwWU8 255.0 dez 0.00 255.0 FORMAT "%5.1" /end CHARACTERISTIC
/begin CHARACTERISTIC CLAHSVSA "Fehlerklasse: Heizung Lambdasonde vor Kat" VALUE 0x1D31AA KwWU8 255.0 dez 0.00 255.0 FORMAT "%5.1" /end CHARACTERISTIC
/begin CHARACTERISTIC CLAHSVSA2 "Fehlerklasse: Heizung Lambdasonde 2 vor Kat" VALUE 0x1D31AB KwWU8 255.0 dez 0.00 255.0 FORMAT "%5.1" /end CHARACTERISTIC
/begin CHARACTERISTIC CLAKUPPL "Fehlerklasse: Pedalwertgeber Kupplung" VALUE 0x1D31B8 KwUb 255.0 dez 0.00 255.0 FORMAT "%5.1" /end CHARACTERISTIC
/begin CHARACTERISTIC CLALDP "Fehlerklasse: Leckdiagnosepumpe" VALUE 0x1D31C0 KwWU8 255.0 dez 0.00 255.0 FORMAT "%5.1" /end CHARACTERISTIC
/begin CHARACTERISTIC CLALFSE "" VALUE 0x1D31C2 KwWU8 255.0 dez 0.00 255.0 FORMAT "%5.1" /end CHARACTERISTIC
/begin CHARACTERISTIC CLALSVV "Fehlerklasse: Vertauschte Lambda-Sonden vor Kat" VALUE 0x1D31CF KwWU8 255.0 dez 0.00 255.0 FORMAT "%5.1" /end CHARACTERISTIC
/begin CHARACTERISTIC CLALUEA "Fehlerklasse: Motorl¸fter Endstufe A" VALUE 0x1D31D0 KwWU8 255.0 dez 0.00 255.0 FORMAT "%5.1" /end CHARACTERISTIC
/begin CHARACTERISTIC CLALUEB "Fehlerklasse: Motorl¸fter Endstufe B" VALUE 0x1D31D1 KwWU8 255.0 dez 0.00 255.0 FORMAT "%5.1" /end CHARACTERISTIC
/begin CHARACTERISTIC CLALUEC "Fehlerklasse: L¸fterendstufe C" VALUE 0x1D31D2 KwWU8 255.0 dez 0.00 255.0 FORMAT "%5.1" /end CHARACTERISTIC
/begin CHARACTERISTIC CLAMFA "Fehlerklasse: MIL-fremdbestimmt" VALUE 0x1D31E3 KwWU8 255.0 dez 0.00 255.0 FORMAT "%5.1" /end CHARACTERISTIC
/begin CHARACTERISTIC CLAMILE "Fehlerklasse: MIL-Endstufe" VALUE 0x1D31E4 KwWU8 255.0 dez 0.00 255.0 FORMAT "%5.1" /end CHARACTERISTIC
/begin CHARACTERISTIC CLANWKW "Fehlerklasse: Zuordnung Nockenwelle zu Kurbelwelle" VALUE 0x1D31E6 KwUb 255.0 dez 0.00 255.0 FORMAT "%5.1" /end CHARACTERISTIC
/begin CHARACTERISTIC CLANWKW2 "Fehlerklasse: Zuordnung Nockenwelle 2 zu Kurbelwelle" VALUE 0x1D31E7 KwUb 255.0 dez 0.00 255.0 FORMAT "%5.1" /end CHARACTERISTIC
/begin CHARACTERISTIC CLANWKW3 "Fehlerklasse: Zuordnung Nockenwelle 3 zu Kurbelwelle" VALUE 0x1D31E8 KwUb 255.0 dez 0.00 255.0 FORMAT "%5.1" /end CHARACTERISTIC
/begin CHARACTERISTIC CLANWKW4 "Fehlerklasse: Zuordnung Nockenwelle 3 zu Kurbelwelle" VALUE 0x1D31E9 KwUb 255.0 dez 0.00 255.0 FORMAT "%5.1" /end CHARACTERISTIC
/begin CHARACTERISTIC CLANWKWA "Fehlerklasse: Zuordnung Auslassnockenwelle zur Kurbelwelle" VALUE 0x1D31EA KwUb 255.0 dez 0.00 255.0 FORMAT "%5.1" /end CHARACTERISTIC
/begin CHARACTERISTIC CLANWKWA2 "Fehlerklasse: Zuordnung Auslassnockenwelle Bank 2 zur Kurbelwelle" VALUE 0x1D31EB KwUb 255.0 dez 0.00 255.0 FORMAT "%5.1" /end CHARACTERISTIC
/begin CHARACTERISTIC CLANWKWE "Fehlerklasse: Zuordnung Einlassnockenwelle zur Kurbelwelle" VALUE 0x1D31EC KwUb 255.0 dez 0.00 255.0 FORMAT "%5.1" /end CHARACTERISTIC
/begin CHARACTERISTIC CLANWKWE2 "Fehlerklasse: Zuordnung Einlassnockenwelle Bank 2 zur Kurbelwelle" VALUE 0x1D31ED KwUb 255.0 dez 0.00 255.0 FORMAT "%5.1" /end CHARACTERISTIC
/begin CHARACTERISTIC CLANWS "Fehlerklasse: Nockenwellensteuerung" VALUE 0x1D31EE KwWU8 255.0 dez 0.00 255.0 FORMAT "%5.1" /end CHARACTERISTIC
/begin CHARACTERISTIC CLAPDDSS "Fehlerklasse: Druck Differenzdrucksensor Saugrohr" VALUE 0x1D31F0 KwWU8 255.0 dez 0.00 255.0 FORMAT "%5.1" /end CHARACTERISTIC
/begin CHARACTERISTIC CLASALSU "" VALUE 0x1D31FB KwUb 255.0 dez 0.00 255.0 FORMAT "%5.1" /end CHARACTERISTIC
/begin CHARACTERISTIC CLASALSU2 "" VALUE 0x1D31FC KwUb 255.0 dez 0.00 255.0 FORMAT "%5.1" /end CHARACTERISTIC
/begin CHARACTERISTIC CLASLPE "Fehlerklasse: Sekund‰rluftpumpe Endstufe" VALUE 0x1D31FD KwWU8 255.0 dez 0.00 255.0 FORMAT "%5.1" /end CHARACTERISTIC
/begin CHARACTERISTIC CLASLVE "Fehlerklasse: Sekund‰rluftventil Endstufe" VALUE 0x1D3202 KwWU8 255.0 dez 0.00 255.0 FORMAT "%5.1" /end CHARACTERISTIC
/begin CHARACTERISTIC CLASTAE "Fehlerklasse: Start-Relais Endstufe" VALUE 0x1D3203 KwWU8 255.0 dez 0.00 255.0 FORMAT "%5.1" /end CHARACTERISTIC
/begin CHARACTERISTIC CLASUE "Fehlerklasse: Saugrohrumschaltung Endstufe" VALUE 0x1D3204 KwWU8 255.0 dez 0.00 255.0 FORMAT "%5.1" /end CHARACTERISTIC
/begin CHARACTERISTIC CLASVSFA "Fehlerklasse: SVS-fremdbestimmt" VALUE 0x1D3205 KwWU8 255.0 dez 0.00 255.0 FORMAT "%5.1" /end CHARACTERISTIC
/begin CHARACTERISTIC CLATCM_Par "" VALUE 0x1D3208 KwUb 255.0 dez 0.00 255.0 FORMAT "%5.1" /end CHARACTERISTIC
/begin CHARACTERISTIC CLATCM_Tgl "" VALUE 0x1D3209 KwUb 255.0 dez 0.00 255.0 FORMAT "%5.1" /end CHARACTERISTIC
/begin CHARACTERISTIC CLATCM_TrqReq "" VALUE 0x1D320A KwUb 255.0 dez 0.00 255.0 FORMAT "%5.1" /end CHARACTERISTIC
/begin CHARACTERISTIC CLATESK "Fehlerklasse: Tankdiagnose, Kleinstleck" VALUE 0x1D320C KwWU8 255.0 dez 0.00 255.0 FORMAT "%5.1" /end CHARACTERISTIC
/begin CHARACTERISTIC CLATMKI "Fehlerklasse: Motortemperatur aus Kombiinstrument TMKI" VALUE 0x1D3211 KwWU8 255.0 dez 0.00 255.0 FORMAT "%5.1" /end CHARACTERISTIC
/begin CHARACTERISTIC CLATUM "Fehlerklasse: Umgebungstemperatur TUM" VALUE 0x1D3213 KwWU8 255.0 dez 0.00 255.0 FORMAT "%5.1" /end CHARACTERISTIC
/begin CHARACTERISTIC CLATX "Fehlerklasse: Temperatur EBOX" VALUE 0x1D3214 KwWU8 255.0 dez 0.00 255.0 FORMAT "%5.1" /end CHARACTERISTIC
/begin CHARACTERISTIC CLAUVSE "Fehlerklasse: Endstufe Umluftventil Turbo" VALUE 0x1D3220 KwWU8 255.0 dez 0.00 255.0 FORMAT "%5.1" /end CHARACTERISTIC
/begin CHARACTERISTIC CLAVFZ "Fehlerklasse: Geschwindigkeitssignal" VALUE 0x1D3221 KwUb 255.0 dez 0.00 255.0 FORMAT "%5.1" /end CHARACTERISTIC
/begin CHARACTERISTIC CLAWWS_BRD "" VALUE 0x1D3222 KwUb 255.0 dez 0.00 255.0 FORMAT "%5.1" /end CHARACTERISTIC
/begin CHARACTERISTIC CLAWWS_NoPA "" VALUE 0x1D3223 KwUb 255.0 dez 0.00 255.0 FORMAT "%5.1" /end CHARACTERISTIC
/begin CHARACTERISTIC CLAWWS_PA "" VALUE 0x1D3224 KwUb 255.0 dez 0.00 255.0 FORMAT "%5.1" /end CHARACTERISTIC
/begin CHARACTERISTIC CWDHFM "Codewort in DHFM" VALUE 0x1C2D0A KwUb 255.0 dez 0.00 255.0 FORMAT "%5.1" /end CHARACTERISTIC
/begin CHARACTERISTIC CWFSTD "Codewort Tankfuellstandsdiagnose" VALUE 0x1CE1E2 KwUb 255.0 dez 0.00 255.0 FORMAT "%5.1" /end CHARACTERISTIC
/begin CHARACTERISTIC DFSKVMN "untere Grenze f¸r F¸llstandssensor-Plausibilit‰tsfehler-Erkennung" VALUE 0x1CE1E4 KwSw 6553.500 vol_q0p1_l -3276.800 3276.700 FORMAT "%8.3" /end CHARACTERISTIC
/begin CHARACTERISTIC DFSKVMX "obere Grenze f¸r F¸llstandssensor-Plausibilit‰tsfehler-Erkennung" VALUE 0x1CE1E6 KwSw 6553.500 vol_q0p1_l -3276.800 3276.700 FORMAT "%8.3" /end CHARACTERISTIC
/begin CHARACTERISTIC DFSTTH "Minimale Kraftstoffvolumenaenderung im Zweitanks. f¸r Plausibilit‰tspr¸fung" VALUE 0x1CE1E8 KwSw 6553.500 vol_q0p1_l -3276.800 3276.700 FORMAT "%8.3" /end CHARACTERISTIC
/begin CHARACTERISTIC DKVBTH "minimal verbrauchtes Kraftstoffvolumen f¸r Zweitank-Plausibilit‰tspr¸fung" VALUE 0x1CE1EA KwSw 6553.500 vol_q0p1_l -3276.800 3276.700 FORMAT "%8.3" /end CHARACTERISTIC
/begin CHARACTERISTIC EBEN "Bypass-Hauptschalter" VALUE 0x1C6974 KwWU8 1.000 dez 0.00 1.000 FORMAT "%5.3" /end CHARACTERISTIC
/begin CHARACTERISTIC EBMISS_T "" VALUE 0x1C6970 KwWU16 65535.00 dez 0.00 65535.00 FORMAT "%8.2" /end CHARACTERISTIC
/begin CHARACTERISTIC EBMISS_Y "" VALUE 0x1C6972 KwWU16 65535.00 dez 0.00 65535.00 FORMAT "%8.2" /end CHARACTERISTIC
/begin CHARACTERISTIC FFTAGRE "Freeze Frame Tabelle: AGR-Ventil Endstufe" VAL_BLK 0x1D3244 KwbWU8 255.0 dez 0.00 255.0 FORMAT "%5.1" NUMBER 4 /end CHARACTERISTIC
/begin CHARACTERISTIC FFTAGRF "Freeze Frame Tabelle: ‹berwachung AGR-Flow" VAL_BLK 0x1D3248 KwbWU8 255.0 dez 0.00 255.0 FORMAT "%5.1" NUMBER 4 /end CHARACTERISTIC
/begin CHARACTERISTIC FFTBREMS "Freeze Frame Tabelle: Pedalwertgeber Bremse" VAL_BLK 0x1D328C KwbUb 255.0 dez 0.00 255.0 FORMAT "%5.1" NUMBER 4 /end CHARACTERISTIC
/begin CHARACTERISTIC FFTCAS "Freeze Frame Tabelle: CAN-Timeout ASC-Botschaft" VAL_BLK 0x1D3294 KwbWU8 255.0 dez 0.00 255.0 FORMAT "%5.1" NUMBER 4 /end CHARACTERISTIC
/begin CHARACTERISTIC FFTCAT "Freeze Frame Tabelle: CAN-Schnittstelle, Timeout ASR" VAL_BLK 0x1D3298 KwbWU8 255.0 dez 0.00 255.0 FORMAT "%5.1" NUMBER 4 /end CHARACTERISTIC
/begin CHARACTERISTIC FFTCGE "Freeze Frame Tabelle: CAN-Timeout EGS-Botschaft" VAL_BLK 0x1D329C KwbWU8 255.0 dez 0.00 255.0 FORMAT "%5.1" NUMBER 4 /end CHARACTERISTIC
/begin CHARACTERISTIC FFTCIF "Freeze Frame Tabelle: CAN-Schnittstelle, interner Fehler" VAL_BLK 0x1D32A0 KwbWU8 255.0 dez 0.00 255.0 FORMAT "%5.1" NUMBER 4 /end CHARACTERISTIC
/begin CHARACTERISTIC FFTCINS "Freeze Frame Tabelle: CAN-Timeout Instr.-Botschaft" VAL_BLK 0x1D32A4 KwbWU8 255.0 dez 0.00 255.0 FORMAT "%5.1" NUMBER 4 /end CHARACTERISTIC
/begin CHARACTERISTIC FFTCSZL "Freeze Frame Tabelle: CAN-Timeout SZL-Botschaft" VAL_BLK 0x1D32AC KwbWU8 255.0 dez 0.00 255.0 FORMAT "%5.1" NUMBER 4 /end CHARACTERISTIC
/begin CHARACTERISTIC FFTDDSS "Freeze Frame Tabelle: Differenzdrucksensor Saugrohr" VAL_BLK 0x1D32B0 KwbWU8 255.0 dez 0.00 255.0 FORMAT "%5.1" NUMBER 4 /end CHARACTERISTIC
/begin CHARACTERISTIC FFTDMTK "Freeze Frame Tabelle: Tankdiagnose, Feinstleck" VAL_BLK 0x1D32C0 KwbWU8 255.0 dez 0.00 255.0 FORMAT "%5.1" NUMBER 4 /end CHARACTERISTIC
/begin CHARACTERISTIC FFTDMTKNM "Freeze Frame Tabelle: Kleinstleck, no MIL" VAL_BLK 0x1D32C4 KwbWU8 255.0 dez 0.00 255.0 FORMAT "%5.1" NUMBER 4 /end CHARACTERISTIC
/begin CHARACTERISTIC FFTDMTL "Freeze Frame Tabelle: Tankdiagnose, Modulfehler (Hardware)" VAL_BLK 0x1D32C8 KwbWU8 255.0 dez 0.00 255.0 FORMAT "%5.1" NUMBER 4 /end CHARACTERISTIC
/begin CHARACTERISTIC FFTDPL "Freeze Frame Tabelle: Dauerplus" VAL_BLK 0x1D32CC KwbWU8 255.0 dez 0.00 255.0 FORMAT "%5.1" NUMBER 4 /end CHARACTERISTIC
/begin CHARACTERISTIC FFTFAN "" VAL_BLK 0x1D3354 KwbWU8 255.0 dez 0.00 255.0 FORMAT "%5.1" NUMBER 4 /end CHARACTERISTIC
/begin CHARACTERISTIC FFTHSHE "Tabelle Umweltbedingungen Endstufe Heizung Lambdasonde hinter Kat" VAL_BLK 0x1D3384 KwbWU8 255.0 dez 0.00 255.0 FORMAT "%5.1" NUMBER 4 /end CHARACTERISTIC
/begin CHARACTERISTIC FFTHSHE2 "Freeze Frame Tabelle: Endstufe Heizung Sonde hinter Kat. Bank 2" VAL_BLK 0x1D3388 KwbWU8 255.0 dez 0.00 255.0 FORMAT "%5.1" NUMBER 4 /end CHARACTERISTIC
/begin CHARACTERISTIC FFTHSVSA "Tabelle Umweltbedingungen Heizung Lambdasonde vor Kat" VAL_BLK 0x1D339C KwbWU8 255.0 dez 0.00 255.0 FORMAT "%5.1" NUMBER 4 /end CHARACTERISTIC
/begin CHARACTERISTIC FFTHSVSA2 "Tabelle Umweltbedingungen Heizung Lambdasonde vor Kat Bank2" VAL_BLK 0x1D33A0 KwbWU8 255.0 dez 0.00 255.0 FORMAT "%5.1" NUMBER 4 /end CHARACTERISTIC
/begin CHARACTERISTIC FFTKUPPL "Freeze Frame Tabelle: Pedalwertgeber Kupplung" VAL_BLK 0x1D33D4 KwbUb 255.0 dez 0.00 255.0 FORMAT "%5.1" NUMBER 4 /end CHARACTERISTIC
/begin CHARACTERISTIC FFTLDP "Freeze Frame Tabelle: Leckdiagnosepumpe" VAL_BLK 0x1D33F4 KwbWU8 255.0 dez 0.00 255.0 FORMAT "%5.1" NUMBER 4 /end CHARACTERISTIC
/begin CHARACTERISTIC FFTLFSE "" VAL_BLK 0x1D33FC KwbWU8 255.0 dez 0.00 255.0 FORMAT "%5.1" NUMBER 4 /end CHARACTERISTIC
/begin CHARACTERISTIC FFTLSVV "Tabelle Umweltbedingungen: Vertauschte Lambdasonden vor Kat" VAL_BLK 0x1D3430 KwbWU8 255.0 dez 0.00 255.0 FORMAT "%5.1" NUMBER 4 /end CHARACTERISTIC
/begin CHARACTERISTIC FFTLUEA "Freeze Frame Tabelle: L¸fterendstufe A" VAL_BLK 0x1D3434 KwbWU8 255.0 dez 0.00 255.0 FORMAT "%5.1" NUMBER 4 /end CHARACTERISTIC
/begin CHARACTERISTIC FFTLUEB "Freeze Frame Tabelle: L¸fterendstufe B" VAL_BLK 0x1D3438 KwbWU8 255.0 dez 0.00 255.0 FORMAT "%5.1" NUMBER 4 /end CHARACTERISTIC
/begin CHARACTERISTIC FFTLUEC "Freeze Frame Tabelle: L¸fterendstufe C" VAL_BLK 0x1D343C KwbWU8 255.0 dez 0.00 255.0 FORMAT "%5.1" NUMBER 4 /end CHARACTERISTIC
/begin CHARACTERISTIC FFTMFA "Freeze Frame Tabelle: MIL-fremdbestimmt" VAL_BLK 0x1D3480 KwbWU8 255.0 dez 0.00 255.0 FORMAT "%5.1" NUMBER 4 /end CHARACTERISTIC
/begin CHARACTERISTIC FFTMILE "Freeze Frame Tabelle: MIL-Endstufe" VAL_BLK 0x1D3484 KwbWU8 255.0 dez 0.00 255.0 FORMAT "%5.1" NUMBER 4 /end CHARACTERISTIC
/begin CHARACTERISTIC FFTNWKW "Freeze Frame Tabelle: Zuordnung Nockenwelle zu Kurbelwelle" VAL_BLK 0x1D348C KwbUb 255.0 dez 0.00 255.0 FORMAT "%5.1" NUMBER 4 /end CHARACTERISTIC
/begin CHARACTERISTIC FFTNWKW2 "Freeze Frame Tabelle: Zuordnung Nockenwelle 2 zu Kurbelwelle" VAL_BLK 0x1D3490 KwbUb 255.0 dez 0.00 255.0 FORMAT "%5.1" NUMBER 4 /end CHARACTERISTIC
/begin CHARACTERISTIC FFTNWKW3 "Freeze Frame Tabelle: Zuordnung Nockenwelle 3 zu Kurbelwelle" VAL_BLK 0x1D3494 KwbUb 255.0 dez 0.00 255.0 FORMAT "%5.1" NUMBER 4 /end CHARACTERISTIC
/begin CHARACTERISTIC FFTNWKW4 "Freeze Frame Tabelle: Zuordnung Nockenwelle 4 zu Kurbelwelle" VAL_BLK 0x1D3498 KwbUb 255.0 dez 0.00 255.0 FORMAT "%5.1" NUMBER 4 /end CHARACTERISTIC
/begin CHARACTERISTIC FFTNWKWA "Freeze Frame Tabelle: Zuordnung Auslassnockenwelle zur Kurbelwelle" VAL_BLK 0x1D349C KwbUb 255.0 dez 0.00 255.0 FORMAT "%5.1" NUMBER 4 /end CHARACTERISTIC
/begin CHARACTERISTIC FFTNWKWA2 "Freeze Frame Tabelle: Zuordnung Auslassnockenwelle Bank 2 zur Kurbelwelle" VAL_BLK 0x1D34A0 KwbUb 255.0 dez 0.00 255.0 FORMAT "%5.1" NUMBER 4 /end CHARACTERISTIC
/begin CHARACTERISTIC FFTNWKWE "Freeze Frame Tabelle: Zuordnung Einlassnockenwelle zur Kurbelwelle" VAL_BLK 0x1D34A4 KwbUb 255.0 dez 0.00 255.0 FORMAT "%5.1" NUMBER 4 /end CHARACTERISTIC
/begin CHARACTERISTIC FFTNWKWE2 "Freeze Frame Tabelle: Zuordnung Einlassnockenwelle Bank 2 zur Kurbelwelle" VAL_BLK 0x1D34A8 KwbUb 255.0 dez 0.00 255.0 FORMAT "%5.1" NUMBER 4 /end CHARACTERISTIC
/begin CHARACTERISTIC FFTNWS "Freeze Frame Tabelle: Nockenwellensteuerung" VAL_BLK 0x1D34AC KwbWU8 255.0 dez 0.00 255.0 FORMAT "%5.1" NUMBER 4 /end CHARACTERISTIC
/begin CHARACTERISTIC FFTPDDSS "Freeze Frame Table: Druck Differenzdrucksensor Saugrohr" VAL_BLK 0x1D34B4 KwbWU8 255.0 dez 0.00 255.0 FORMAT "%5.1" NUMBER 4 /end CHARACTERISTIC
/begin CHARACTERISTIC FFTSALSU "" VAL_BLK 0x1D34E0 KwbUb 255.0 dez 0.00 255.0 FORMAT "%5.1" NUMBER 4 /end CHARACTERISTIC
/begin CHARACTERISTIC FFTSALSU2 "" VAL_BLK 0x1D34E4 KwbUb 255.0 dez 0.00 255.0 FORMAT "%5.1" NUMBER 4 /end CHARACTERISTIC
/begin CHARACTERISTIC FFTSLPE "Freeze Frame Tabelle: Sekund‰rluftpumpe Endstufe" VAL_BLK 0x1D34E8 KwbWU8 255.0 dez 0.00 255.0 FORMAT "%5.1" NUMBER 4 /end CHARACTERISTIC
/begin CHARACTERISTIC FFTSLVE "Freeze Frame Tabelle: Sekund‰rluftventil Endstufe" VAL_BLK 0x1D34FC KwbWU8 255.0 dez 0.00 255.0 FORMAT "%5.1" NUMBER 4 /end CHARACTERISTIC
/begin CHARACTERISTIC FFTSTAE "Freeze Frame Tabelle: Start-Relais Endstufe" VAL_BLK 0x1D3500 KwbWU8 255.0 dez 0.00 255.0 FORMAT "%5.1" NUMBER 4 /end CHARACTERISTIC
/begin CHARACTERISTIC FFTSUE "Freeze Frame Tabelle: Saugrohrumschaltung Endstufe" VAL_BLK 0x1D3504 KwbWU8 255.0 dez 0.00 255.0 FORMAT "%5.1" NUMBER 4 /end CHARACTERISTIC
/begin CHARACTERISTIC FFTSVSFA "Freeze Frame Tabelle: SVS-fremdbestimmt" VAL_BLK 0x1D3508 KwbWU8 255.0 dez 0.00 255.0 FORMAT "%5.1" NUMBER 4 /end CHARACTERISTIC
/begin CHARACTERISTIC FFTTCM_Par "" VAL_BLK 0x1D3514 KwbUb 255.0 dez 0.00 255.0 FORMAT "%5.1" NUMBER 4 /end CHARACTERISTIC
/begin CHARACTERISTIC FFTTCM_Tgl "" VAL_BLK 0x1D3518 KwbUb 255.0 dez 0.00 255.0 FORMAT "%5.1" NUMBER 4 /end CHARACTERISTIC
/begin CHARACTERISTIC FFTTCM_TrqReq "" VAL_BLK 0x1D351C KwbUb 255.0 dez 0.00 255.0 FORMAT "%5.1" NUMBER 4 /end CHARACTERISTIC
/begin CHARACTERISTIC FFTTESK "Freeze Frame Tabelle: Tankdiagnose, Kleinstleck" VAL_BLK 0x1D3524 KwbWU8 255.0 dez 0.00 255.0 FORMAT "%5.1" NUMBER 4 /end CHARACTERISTIC
/begin CHARACTERISTIC FFTTMKI "Freeze Frame Tabelle: Motortemperatur aus Kombiinstrument TMKI" VAL_BLK 0x1D3538 KwbWU8 255.0 dez 0.00 255.0 FORMAT "%5.1" NUMBER 4 /end CHARACTERISTIC
/begin CHARACTERISTIC FFTTUM "Freeze Frame Tabelle: Umgebungstemperatur TUM" VAL_BLK 0x1D3540 KwbWU8 255.0 dez 0.00 255.0 FORMAT "%5.1" NUMBER 4 /end CHARACTERISTIC
/begin CHARACTERISTIC FFTTX "Freeze Frame Tabelle: Temperatur EBOX" VAL_BLK 0x1D3544 KwbWU8 255.0 dez 0.00 255.0 FORMAT "%5.1" NUMBER 4 /end CHARACTERISTIC
/begin CHARACTERISTIC FFTUVSE "Freeze Frame Tabelle:Endstufe Umluftventil Turbo" VAL_BLK 0x1D3574 KwbWU8 255.0 dez 0.00 255.0 FORMAT "%5.1" NUMBER 4 /end CHARACTERISTIC
/begin CHARACTERISTIC FFTVFZ "Freeze Frame Tabelle: Geschwindigkeitssignal" VAL_BLK 0x1D3578 KwbUb 255.0 dez 0.00 255.0 FORMAT "%5.1" NUMBER 4 /end CHARACTERISTIC
/begin CHARACTERISTIC FFTWWS_BRD "" VAL_BLK 0x1D357C KwbUb 255.0 dez 0.00 255.0 FORMAT "%5.1" NUMBER 4 /end CHARACTERISTIC
/begin CHARACTERISTIC FFTWWS_NoPA "" VAL_BLK 0x1D3580 KwbUb 255.0 dez 0.00 255.0 FORMAT "%5.1" NUMBER 4 /end CHARACTERISTIC
/begin CHARACTERISTIC FFTWWS_PA "" VAL_BLK 0x1D3584 KwbUb 255.0 dez 0.00 255.0 FORMAT "%5.1" NUMBER 4 /end CHARACTERISTIC
/begin CHARACTERISTIC FKPMHFMMN "Untere Grenze f¸r Korrekturfaktor Periodendauer Massenstrom aus HFM 1" VALUE 0x1CA3F0 KwUw 1.999969 fak_uw_b2 0.00 1.999969 FORMAT "%8.6" /end CHARACTERISTIC
/begin CHARACTERISTIC FKPMHFMMX "Obere Grenze f¸r Korrekturfaktor Periodendauer Massenstrom aus HFM 1" VALUE 0x1CA3F2 KwUw 1.999969 fak_uw_b2 0.00 1.999969 FORMAT "%8.6" /end CHARACTERISTIC
/begin CHARACTERISTIC FMLDMXKO "Faktor auf max. Luftmasse f¸r Erkennung HFM-Kurzschluﬂ nach 5V" VALUE 0x1C2D0E KwUw 15.99976 fak_uw_b16 0.00 15.99976 FORMAT "%8.5" /end CHARACTERISTIC
/begin CHARACTERISTIC FRINH1 "Multiplikativer Faktor f¸r RIN Sollwert hinter Kat" CURVE 0x1CC982 KlAUbSstUwWUb 63.75 fak_ub_b64 0.00 63.75 FORMAT "%5.2"
 /begin AXIS_DESCR STD_AXIS tahsomf_w temp_q0p0234_o273 5 -273.1500 1262.827 FORMAT "%8.3" DEPOSIT ABSOLUTE /end AXIS_DESCR
/end CHARACTERISTIC
/begin CHARACTERISTIC FRINH2 "Multiplikativer Faktor f¸r RIN Sollwert hinter Kat" CURVE 0x1CC994 KlAUbSstUwWUb 63.75 fak_ub_b64 0.00 63.75 FORMAT "%5.2"
 /begin AXIS_DESCR STD_AXIS tahsomf2_w temp_q0p0234_o273 5 -273.1500 1262.827 FORMAT "%8.3" DEPOSIT ABSOLUTE /end AXIS_DESCR
/end CHARACTERISTIC
/begin CHARACTERISTIC FST1EMT "Prim‰rtankvolumen-'leer'-Schwelle f¸r Transferpumpen-Diagnose" VALUE 0x1CE1EC KwUw 6553.500 vol_q0p1_l 0.00 6553.500 FORMAT "%8.3" /end CHARACTERISTIC
/begin CHARACTERISTIC FST1SKTH "Prim‰rtank-Kraftstoffvolumen-ƒnderungs-Schwelle f¸r Sensor 'defekt' Erkennung" VALUE 0x1CE1EE KwUw 6553.500 vol_q0p1_l 0.00 6553.500 FORMAT "%8.3" /end CHARACTERISTIC
/begin CHARACTERISTIC FST2SKTH "Sekund‰rtank-Kraftstoffvolumen-ƒnderungsschwelle f¸r Sensor 'defekt' Erkennung" VALUE 0x1CE1F0 KwUw 6553.500 vol_q0p1_l 0.00 6553.500 FORMAT "%8.3" /end CHARACTERISTIC
/begin CHARACTERISTIC FSTERNTH "Anzahl aufeinanderfolgender Plausibilit‰ts-Widersprueche zur Fehlerbestaetigung" VALUE 0x1CE1E3 KwUb 255.0 dez 0.00 255.0 FORMAT "%5.1" /end CHARACTERISTIC
/begin CHARACTERISTIC FWMLHFMMN "Wichtungsfaktor f¸r minimale HFM-Luftmassen Schwelle in Abh‰ngigkeit von d.Hˆhe" CURVE 0x1CA3F8 KlAUwSstUwWUw 0.9999847 fak_uw_b1 0.00 0.9999847 FORMAT "%9.7"
 /begin AXIS_DESCR STD_AXIS fho_w fak_uw_b4 2 0.00 3.999939 FORMAT "%8.6" DEPOSIT ABSOLUTE /end AXIS_DESCR
/end CHARACTERISTIC
/begin CHARACTERISTIC KFMLDMN "ML-Schwelle f¸r B_minflr-Diagnose HFM/HLM" MAP 0x1CA402 KfAxUbAyUbSstxSwSstyUbWSw 6553.500 m_q0p1 -3276.800 3276.700 FORMAT "%8.3"
 /begin AXIS_DESCR STD_AXIS wdkba_w relDK_q0p02441 8 -800.0000 799.9756 FORMAT "%8.4" DEPOSIT ABSOLUTE /end AXIS_DESCR
 /begin AXIS_DESCR STD_AXIS nmot nmot_ub_q40 9 0.00 10200. FORMAT "%5.0" DEPOSIT ABSOLUTE /end AXIS_DESCR
/end CHARACTERISTIC
/begin CHARACTERISTIC KFMLDMX "ML-Schwelle f¸r B_maxflr-Diagnose HFM/HLM" MAP 0x1C2D10 KfAxUbAyUbSstxSwSstyUbWSw 6553.500 m_q0p1 -3276.800 3276.700 FORMAT "%8.3"
 /begin AXIS_DESCR STD_AXIS wdkbadmx_w relDK_q0p02441 8 -800.0000 799.9756 FORMAT "%8.4" DEPOSIT ABSOLUTE /end AXIS_DESCR
 /begin AXIS_DESCR STD_AXIS nmot nmot_ub_q40 9 0.00 10200. FORMAT "%5.0" DEPOSIT ABSOLUTE /end AXIS_DESCR
/end CHARACTERISTIC
/begin CHARACTERISTIC KFRINH "Kennfeld f¸r Nernst-Innenwiderstand hinter Kat" MAP 0x1CC9A6 KfAxUbAyUbSstxUwSstyUbWUb 2040. r_q8 0.00 2040. FORMAT "%5.0"
 /begin AXIS_DESCR STD_AXIS tahsomf_w temp_q0p0234_o273 5 -273.1500 1262.827 FORMAT "%8.3" DEPOSIT ABSOLUTE /end AXIS_DESCR
 /begin AXIS_DESCR STD_AXIS phlsnhf fak_ub_q0p01 3 0.00 2.550 FORMAT "%5.3" DEPOSIT ABSOLUTE /end AXIS_DESCR
/end CHARACTERISTIC
/begin CHARACTERISTIC KFRINH2 "Kennfeld f¸r Nernst-Innenwiderstand hinter Kat Bank2" MAP 0x1CC9C4 KfAxUbAyUbSstxUwSstyUbWUb 2040. r_q8 0.00 2040. FORMAT "%5.0"
 /begin AXIS_DESCR STD_AXIS tahsomf2_w temp_q0p0234_o273 5 -273.1500 1262.827 FORMAT "%8.3" DEPOSIT ABSOLUTE /end AXIS_DESCR
 /begin AXIS_DESCR STD_AXIS phlsnhf2 fak_ub_q0p01 3 0.00 2.550 FORMAT "%5.3" DEPOSIT ABSOLUTE /end AXIS_DESCR
/end CHARACTERISTIC
/begin CHARACTERISTIC KRIVKMX "Maximaler Korrekturwert krivk_w" VALUE 0x1CCBA8 KwUw 2559.961 r_q0p0391 0.00 2559.961 FORMAT "%8.3" /end CHARACTERISTIC
/begin CHARACTERISTIC MLDHFMKO "Luftmassen Obergrenze f¸r Erkennung HFM-Kurzschluﬂ" VALUE 0x1CA4AE KwSw 6553.500 m_q0p1 -3276.800 3276.700 FORMAT "%8.3" /end CHARACTERISTIC
/begin CHARACTERISTIC MLDHFMKU "Luftmassen Untergrenze f¸r Erkennung HFM-Kurzschluﬂ" VALUE 0x1C2DBC KwSw 6553.500 m_q0p1 -3276.800 3276.700 FORMAT "%8.3" /end CHARACTERISTIC
/begin CHARACTERISTIC MLHFMMN "minimale HFM-Luftmassen Schwelle zum R¸cksetzen des Min-Fehlers" VALUE 0x1CA4B0 KwSw 6553.500 m_q0p1 -3276.800 3276.700 FORMAT "%8.3" /end CHARACTERISTIC
/begin CHARACTERISTIC RINDCMN "Minimale RI-Schwelle f¸r ""Duty-Cycle-Diagnose""" VALUE 0x1CCBAA KwUw 2559.961 r_q0p0391 0.00 2559.961 FORMAT "%8.3" /end CHARACTERISTIC
/begin CHARACTERISTIC RINLSUPMN "Minimale Schwelle f¸r einen plausiblen Innenwiderstand der LSU" VALUE 0x1CCBAC KwUw 2559.961 r_q0p0391 0.00 2559.961 FORMAT "%8.3" /end CHARACTERISTIC
/begin CHARACTERISTIC SRYAGR "Schwelle f¸r Readiness-Bildung Abgasr¸ckf¸hrungs-Diagnose" VALUE 0x1C3CD3 KwUb 255.0 dez 0.00 255.0 FORMAT "%5.1" /end CHARACTERISTIC
/begin CHARACTERISTIC SRYHS "Schwelle f¸r Readiness-Bildung Sondenheizungs-Diagnose" VALUE 0x1C3CD4 KwUb 255.0 dez 0.00 255.0 FORMAT "%5.1" /end CHARACTERISTIC
/begin CHARACTERISTIC SRYKAT "Schwelle f¸r Readiness-Bildung Katalysator-Diagnose" VALUE 0x1C3CD5 KwUb 255.0 dez 0.00 255.0 FORMAT "%5.1" /end CHARACTERISTIC
/begin CHARACTERISTIC SRYLS "Schwelle f¸r Readiness-Bildung Lambdasonden-Diagnose" VALUE 0x1C3CD6 KwUb 255.0 dez 0.00 255.0 FORMAT "%5.1" /end CHARACTERISTIC
/begin CHARACTERISTIC SRYSLS "Schwelle f¸r Readiness-Bildung Sekund‰rluft-Diagnose" VALUE 0x1C3CD7 KwUb 255.0 dez 0.00 255.0 FORMAT "%5.1" /end CHARACTERISTIC
/begin CHARACTERISTIC TABSTHLS "Mindestabstellzeit f¸r Diagnose Heizung Lambdasonde" VALUE 0x1CC9E2 KwUw 65534.00 t1sxs_uw_q1 1.000000 65535.00 FORMAT "%8.2" /end CHARACTERISTIC
/begin CHARACTERISTIC TADHMN "untere Temperaturschwelle f¸r die Heizerdiagnose" VALUE 0x1CC9E4 KwUw 1535.977 temp_q0p0234_o273 -273.1500 1262.827 FORMAT "%8.3" /end CHARACTERISTIC
/begin CHARACTERISTIC TADHMXH "obere Temperaturschwelle f¸r die Heizerdiagnose hinter Kat" VALUE 0x1CC9E6 KwUw 1535.977 temp_q0p0234_o273 -273.1500 1262.827 FORMAT "%8.3" /end CHARACTERISTIC
/begin CHARACTERISTIC TAVVDCMN "Minimale -T-Schwelle f¸r die Abgastemp. vor dem Vor.-Kat. f¸r ""Duty-Cycle-Diag.""" VALUE 0x1CCBAE KwUw 1535.977 temp_q0p0234_o273 -273.1500 1262.827 FORMAT "%8.3" /end CHARACTERISTIC
/begin CHARACTERISTIC TDEHFMMN "Entprellzeit HFM-(Hauptlastgeber-)Fehlererkennung Minimalwert" VALUE 0x1CA3E8 KwUb 25.50 t_q0p1 0.00 25.50 FORMAT "%5.2" /end CHARACTERISTIC
/begin CHARACTERISTIC TDEHFMMX "Entprellzeit HFM-(Hauptlastgeber-)Fehlererkennung Maximalwert" VALUE 0x1CA3E9 KwUb 25.50 t_q0p1 0.00 25.50 FORMAT "%5.2" /end CHARACTERISTIC
/begin CHARACTERISTIC TDEHFMNPL "Entprellzeit HFM-(Hauptlastgeber-)Fehlererkennung Nicht Plausibel" VALUE 0x1CA3EA KwUb 25.50 t_q0p1 0.00 25.50 FORMAT "%5.2" /end CHARACTERISTIC
/begin CHARACTERISTIC TDEHFMSG "Entprellzeit HFM-(Hauptlastgeber-)Fehlererkennung Signalfehler" VALUE 0x1CA3EB KwUb 25.50 t_q0p1 0.00 25.50 FORMAT "%5.2" /end CHARACTERISTIC
/begin CHARACTERISTIC TDHEAHFMLM "Entprellzeit HFM-(Hauptlastgeber-) Heilung" VALUE 0x1CA3EC KwUb 25.50 t_q0p1 0.00 25.50 FORMAT "%5.2" /end CHARACTERISTIC
/begin CHARACTERISTIC TDMLHFM "Zeitverzˆgerung f¸r das Setzen von B_ehfm" VALUE 0x1C2D0B KwUb 2.550 t10msxs_ub_b2p55 0.00 2.550 FORMAT "%5.3" /end CHARACTERISTIC
/begin CHARACTERISTIC TDMLST "Entprellzeit HFM-(Hauptlastgeber-)Fehlererkennung im Start" VALUE 0x1CA3F4 KwUw 6553.500 t_q0p1 0.00 6553.500 FORMAT "%8.3" /end CHARACTERISTIC
/begin CHARACTERISTIC TDUBHFM "Zeit f¸r HFM-Diagnose mit u < UBHFM" VALUE 0x1CA3ED KwUb 25.50 t_q0p1 0.00 25.50 FORMAT "%5.2" /end CHARACTERISTIC
/begin CHARACTERISTIC TEHEHRLSU "Entprellzeit zum Heilen des Fehlerpfades HRLSU" VALUE 0x1CCBB0 KwUw 6553.500 t100msxs_uw_b6553p5 0.00 6553.500 FORMAT "%8.3" /end CHARACTERISTIC
/begin CHARACTERISTIC TEHRF "Entprellzeit f¸r Heizungsregelungsfehler" VALUE 0x1CCBB2 KwUw 6553.500 t100msxs_uw_b6553p5 0.00 6553.500 FORMAT "%8.3" /end CHARACTERISTIC
/begin CHARACTERISTIC TEHRLSUE "Entprellzeit f¸r Heizungsregelung der LSU f¸r elektrischen Fehler" VALUE 0x1CCBB4 KwUw 6553.500 t100msxs_uw_b6553p5 0.00 6553.500 FORMAT "%8.3" /end CHARACTERISTIC
/begin CHARACTERISTIC TSFAGRE "Fehlersummenzeit: ‹berwachung AGR-Endstufe" VALUE 0x1D3593 KwWU8 255.0 dez 0.00 255.0 FORMAT "%5.1" /end CHARACTERISTIC
/begin CHARACTERISTIC TSFAGRF "Fehlersummenzeit: ‹berwachung AGR-FLOW" VALUE 0x1D3594 KwWU8 255.0 dez 0.00 255.0 FORMAT "%5.1" /end CHARACTERISTIC
/begin CHARACTERISTIC TSFBREMS "Fehlersummenzeit: BREMS (Bremsschalter)" VALUE 0x1D35A5 KwUb 255.0 dez 0.00 255.0 FORMAT "%5.1" /end CHARACTERISTIC
/begin CHARACTERISTIC TSFCAS "Fehlersummenzeit: CAN-Schnittstelle, Timeout ASC" VALUE 0x1D35A7 KwWU8 255.0 dez 0.00 255.0 FORMAT "%5.1" /end CHARACTERISTIC
/begin CHARACTERISTIC TSFCAT "Fehlersummenzeit: CAN-Schnittstelle, Timeout ASR" VALUE 0x1D35A8 KwWU8 255.0 dez 0.00 255.0 FORMAT "%5.1" /end CHARACTERISTIC
/begin CHARACTERISTIC TSFCGE "Fehlersummenzeit: CAN-Schnittstelle, Timeout EGS" VALUE 0x1D35A9 KwWU8 255.0 dez 0.00 255.0 FORMAT "%5.1" /end CHARACTERISTIC
/begin CHARACTERISTIC TSFCIF "Fehlersummenzeit: CAN-Schnittstelle, interner Fehler" VALUE 0x1D35AA KwWU8 255.0 dez 0.00 255.0 FORMAT "%5.1" /end CHARACTERISTIC
/begin CHARACTERISTIC TSFCINS "Fehlersummenzeit: CAN-Schnittstelle, Timeout Instrument" VALUE 0x1D35AB KwWU8 255.0 dez 0.00 255.0 FORMAT "%5.1" /end CHARACTERISTIC
/begin CHARACTERISTIC TSFCSZL "Fehlersummenzeit: CAN-Schnittstelle, Timeout SZL" VALUE 0x1D35AD KwWU8 255.0 dez 0.00 255.0 FORMAT "%5.1" /end CHARACTERISTIC
/begin CHARACTERISTIC TSFDDSS "Fehlersummenzeit: Differenzdrucksensor Saugrohr" VALUE 0x1D35AE KwWU8 255.0 dez 0.00 255.0 FORMAT "%5.1" /end CHARACTERISTIC
/begin CHARACTERISTIC TSFDMTK "Fehlersummenzeit: Tankentl¸ftungssystem, Feinstleck" VALUE 0x1D35B2 KwWU8 255.0 dez 0.00 255.0 FORMAT "%5.1" /end CHARACTERISTIC
/begin CHARACTERISTIC TSFDMTKNM "Fehlersummenzeit: Feinstleck, no Mil" VALUE 0x1D35B3 KwWU8 255.0 dez 0.00 255.0 FORMAT "%5.1" /end CHARACTERISTIC
/begin CHARACTERISTIC TSFDMTL "Fehlersummenzeit: Tankentl¸ftungssystem, Modulfehler (Hardware)" VALUE 0x1D35B4 KwWU8 255.0 dez 0.00 255.0 FORMAT "%5.1" /end CHARACTERISTIC
/begin CHARACTERISTIC TSFDPL "Fehlersummenzeit: Dauerplus" VALUE 0x1D35B5 KwWU8 255.0 dez 0.00 255.0 FORMAT "%5.1" /end CHARACTERISTIC
/begin CHARACTERISTIC TSFFAN "" VALUE 0x1D35D7 KwWU8 255.0 dez 0.00 255.0 FORMAT "%5.1" /end CHARACTERISTIC
/begin CHARACTERISTIC TSFHSHE "Fehlersummenzeit: Endstufe Heizung Sonde hinter Kat." VALUE 0x1D35E3 KwWU8 255.0 dez 0.00 255.0 FORMAT "%5.1" /end CHARACTERISTIC
/begin CHARACTERISTIC TSFHSHE2 "Fehlersummenzeit: Endstufe Heizung Sonde hinter Kat. Bank 2" VALUE 0x1D35E4 KwWU8 255.0 dez 0.00 255.0 FORMAT "%5.1" /end CHARACTERISTIC
/begin CHARACTERISTIC TSFHSVSA "Fehlersummenzeit: Lambdasonden-Heizung vor Katalysator" VALUE 0x1D35E9 KwWU8 255.0 dez 0.00 255.0 FORMAT "%5.1" /end CHARACTERISTIC
/begin CHARACTERISTIC TSFHSVSA2 "Fehlersummenzeit: Lambdasonden-Heizung vor Katalysator, Bank 2" VALUE 0x1D35EA KwWU8 255.0 dez 0.00 255.0 FORMAT "%5.1" /end CHARACTERISTIC
/begin CHARACTERISTIC TSFKUPPL "Fehlersummenzeit: Pedalwertgeber Kupplung" VALUE 0x1D35F7 KwUb 255.0 dez 0.00 255.0 FORMAT "%5.1" /end CHARACTERISTIC
/begin CHARACTERISTIC TSFLDP "Fehlersummenzeit: Leckdiagnosepumpe" VALUE 0x1D35FF KwWU8 255.0 dez 0.00 255.0 FORMAT "%5.1" /end CHARACTERISTIC
/begin CHARACTERISTIC TSFLFSE "" VALUE 0x1D3601 KwWU8 255.0 dez 0.00 255.0 FORMAT "%5.1" /end CHARACTERISTIC
/begin CHARACTERISTIC TSFLSVV "Fehlersummenzeit: Vertauschte Lambda-Sonden vor Kat" VALUE 0x1D360E KwWU8 255.0 dez 0.00 255.0 FORMAT "%5.1" /end CHARACTERISTIC
/begin CHARACTERISTIC TSFLUEA "Fehlersummenzeit: L¸fterendstufe A" VALUE 0x1D360F KwWU8 255.0 dez 0.00 255.0 FORMAT "%5.1" /end CHARACTERISTIC
/begin CHARACTERISTIC TSFLUEB "Fehlersummenzeit: L¸fterendstufe B" VALUE 0x1D3610 KwWU8 255.0 dez 0.00 255.0 FORMAT "%5.1" /end CHARACTERISTIC
/begin CHARACTERISTIC TSFLUEC "Fehlersummenzeit: L¸fterendstufe C" VALUE 0x1D3611 KwWU8 255.0 dez 0.00 255.0 FORMAT "%5.1" /end CHARACTERISTIC
/begin CHARACTERISTIC TSFMFA "Fehlersummenzeit: MIL-fremdbestimmt" VALUE 0x1D3622 KwWU8 255.0 dez 0.00 255.0 FORMAT "%5.1" /end CHARACTERISTIC
/begin CHARACTERISTIC TSFMILE "Fehlersummenzeit: MIL-Endstufe" VALUE 0x1D3623 KwWU8 255.0 dez 0.00 255.0 FORMAT "%5.1" /end CHARACTERISTIC
/begin CHARACTERISTIC TSFNWKW "Fehlersummenzeit: Zuordnung Nockenwelle zu Kurbelwelle" VALUE 0x1D3625 KwUb 255.0 dez 0.00 255.0 FORMAT "%5.1" /end CHARACTERISTIC
/begin CHARACTERISTIC TSFNWKW2 "Fehlersummenzeit: Zuordnung Nockenwelle 2 zu Kurbelwelle" VALUE 0x1D3626 KwUb 255.0 dez 0.00 255.0 FORMAT "%5.1" /end CHARACTERISTIC
/begin CHARACTERISTIC TSFNWKW3 "Fehlersummenzeit: Zuordnung Nockenwelle 3 zu Kurbelwelle" VALUE 0x1D3627 KwUb 255.0 dez 0.00 255.0 FORMAT "%5.1" /end CHARACTERISTIC
/begin CHARACTERISTIC TSFNWKW4 "Fehlersummenzeit: Zuordnung Nockenwelle 4 zu Kurbelwelle" VALUE 0x1D3628 KwUb 255.0 dez 0.00 255.0 FORMAT "%5.1" /end CHARACTERISTIC
/begin CHARACTERISTIC TSFNWKWA "Fehlersummenzeit: Zuordnung Auslassnockenwelle zur Kurbelwelle" VALUE 0x1D3629 KwUb 255.0 dez 0.00 255.0 FORMAT "%5.1" /end CHARACTERISTIC
/begin CHARACTERISTIC TSFNWKWA2 "Fehlersummenzeit: Zuordnung Auslassnockenwelle Bank 2 zur Kurbelwelle" VALUE 0x1D362A KwUb 255.0 dez 0.00 255.0 FORMAT "%5.1" /end CHARACTERISTIC
/begin CHARACTERISTIC TSFNWKWE "Fehlersummenzeit: Zuordnung Einlassnockenwelle zur Kurbelwelle" VALUE 0x1D362B KwUb 255.0 dez 0.00 255.0 FORMAT "%5.1" /end CHARACTERISTIC
/begin CHARACTERISTIC TSFNWKWE2 "Fehlersummenzeit: Zuordnung Einlassnockenwelle Bank 2 zur Kurbelwelle" VALUE 0x1D362C KwUb 255.0 dez 0.00 255.0 FORMAT "%5.1" /end CHARACTERISTIC
/begin CHARACTERISTIC TSFNWS "Fehlersummenzeit: Nockenwellensteuerung" VALUE 0x1D362D KwWU8 255.0 dez 0.00 255.0 FORMAT "%5.1" /end CHARACTERISTIC
/begin CHARACTERISTIC TSFPDDSS "Fehlersummenzeit: Druck Differenzdrucksensor Saugrohr" VALUE 0x1D362F KwWU8 255.0 dez 0.00 255.0 FORMAT "%5.1" /end CHARACTERISTIC
/begin CHARACTERISTIC TSFSALSU "" VALUE 0x1D363A KwUb 255.0 dez 0.00 255.0 FORMAT "%5.1" /end CHARACTERISTIC
/begin CHARACTERISTIC TSFSALSU2 "" VALUE 0x1D363B KwUb 255.0 dez 0.00 255.0 FORMAT "%5.1" /end CHARACTERISTIC
/begin CHARACTERISTIC TSFSLPE "Fehlersummenzeit: Sekund‰rluftpumpe (Endstufe)" VALUE 0x1D363C KwWU8 255.0 dez 0.00 255.0 FORMAT "%5.1" /end CHARACTERISTIC
/begin CHARACTERISTIC TSFSLVE "Fehlersummenzeit: Sekund‰rluftventil (Endstufe)" VALUE 0x1D3641 KwWU8 255.0 dez 0.00 255.0 FORMAT "%5.1" /end CHARACTERISTIC
/begin CHARACTERISTIC TSFSTAE "Fehlersummenzeit: Startautomatik (Endstufe)" VALUE 0x1D3642 KwWU8 255.0 dez 0.00 255.0 FORMAT "%5.1" /end CHARACTERISTIC
/begin CHARACTERISTIC TSFSUE "Fehlersummenzeit: Endstufe Saugrohrumschaltung" VALUE 0x1D3643 KwWU8 255.0 dez 0.00 255.0 FORMAT "%5.1" /end CHARACTERISTIC
/begin CHARACTERISTIC TSFSVSFA "" VALUE 0x1D3644 KwWU8 255.0 dez 0.00 255.0 FORMAT "%5.1" /end CHARACTERISTIC
/begin CHARACTERISTIC TSFTCM_Par "" VALUE 0x1D3647 KwUb 255.0 dez 0.00 255.0 FORMAT "%5.1" /end CHARACTERISTIC
/begin CHARACTERISTIC TSFTCM_Tgl "" VALUE 0x1D3648 KwUb 255.0 dez 0.00 255.0 FORMAT "%5.1" /end CHARACTERISTIC
/begin CHARACTERISTIC TSFTCM_TrqReq "" VALUE 0x1D3649 KwUb 255.0 dez 0.00 255.0 FORMAT "%5.1" /end CHARACTERISTIC
/begin CHARACTERISTIC TSFTESK "Fehlersummenzeit: Tankentl¸ftungssystem Leck vorhanden" VALUE 0x1D364B KwWU8 255.0 dez 0.00 255.0 FORMAT "%5.1" /end CHARACTERISTIC
/begin CHARACTERISTIC TSFTMKI "Fehlersummenzeit: Motortemperatur aus Kombiinstrument TMKI" VALUE 0x1D3650 KwWU8 255.0 dez 0.00 255.0 FORMAT "%5.1" /end CHARACTERISTIC
/begin CHARACTERISTIC TSFTUM "Fehlersummenzeit: Umgebungstemperatur TUM" VALUE 0x1D3652 KwWU8 255.0 dez 0.00 255.0 FORMAT "%5.1" /end CHARACTERISTIC
/begin CHARACTERISTIC TSFTX "Fehlersummenzeit: Temperatur EBOX" VALUE 0x1D3653 KwWU8 255.0 dez 0.00 255.0 FORMAT "%5.1" /end CHARACTERISTIC
/begin CHARACTERISTIC TSFUVSE "Fehlersummenzeit: Endstufe Umluftventil Turbo" VALUE 0x1D365F KwWU8 255.0 dez 0.00 255.0 FORMAT "%5.1" /end CHARACTERISTIC
/begin CHARACTERISTIC TSFVFZ "Fehlersummenzeit: Fahrzeug-Geschwindigkeit" VALUE 0x1D3660 KwUb 255.0 dez 0.00 255.0 FORMAT "%5.1" /end CHARACTERISTIC
/begin CHARACTERISTIC TSFWWS_BRD "" VALUE 0x1D3661 KwUb 255.0 dez 0.00 255.0 FORMAT "%5.1" /end CHARACTERISTIC
/begin CHARACTERISTIC TSFWWS_NoPA "" VALUE 0x1D3662 KwUb 255.0 dez 0.00 255.0 FORMAT "%5.1" /end CHARACTERISTIC
/begin CHARACTERISTIC TSFWWS_PA "" VALUE 0x1D3663 KwUb 255.0 dez 0.00 255.0 FORMAT "%5.1" /end CHARACTERISTIC
/begin CHARACTERISTIC TVFHS "Entprellzeit f¸r Heizerendstufe" VALUE 0x1CC97A KwUb 2.550 t10msxs_ub_b2p55 0.00 2.550 FORMAT "%5.3" /end CHARACTERISTIC
/begin CHARACTERISTIC TVFSTD "Entprellzeit elektrische Fuellstandsgeberdiagnose" VALUE 0x1CE1F2 KwUw 6553.500 t100msxs_uw_b6553p5 0.00 6553.500 FORMAT "%8.3" /end CHARACTERISTIC
/begin CHARACTERISTIC TVHATA "Verzoegerungszeit Halt vor Tankvorgang" VALUE 0x1CE1F4 KwUw 6553.500 t100msxs_uw_b6553p5 0.00 6553.500 FORMAT "%8.3" /end CHARACTERISTIC
/begin CHARACTERISTIC TVRI "Verzˆgerungszeit f¸r Ri-Fehler nach Endstufenfehler" VALUE 0x1CC97B KwUb 255.0 t1sxs_ub_b255 0.00 255.0 FORMAT "%5.1" /end CHARACTERISTIC
/begin CHARACTERISTIC TVRIF "Verzˆgerungszeit f¸r Ri-Fehler" VALUE 0x1CC97C KwUb 255.0 t1sxs_ub_b255 0.00 255.0 FORMAT "%5.1" /end CHARACTERISTIC
/begin CHARACTERISTIC TWVSOMOS "Obere Schwelle der Rohrwandtemperatur an der Sondeneinbauposition vor dem Kat." VALUE 0x1CCBB6 KwUw 1535.977 temp_q0p0234_o273 -273.1500 1262.827 FORMAT "%8.3" /end CHARACTERISTIC
/begin CHARACTERISTIC UBDFSTMN "Ubat-Minimum f|r Diagnose Fuellstandsgeber" VALUE 0x1C56F1 KwUb 24.02 spg_ubatt 0.00 24.02 FORMAT "%5.2" /end CHARACTERISTIC
/begin CHARACTERISTIC UBDFSTMX "Ubat-Maximum f|r Diagnose Fuellstandsgeber" VALUE 0x1C56F2 KwUb 24.02 spg_ubatt 0.00 24.02 FORMAT "%5.2" /end CHARACTERISTIC
/begin CHARACTERISTIC UBDHLSMN "untere Batteriespannungsschwelle zur Freigabe der Lambdasonden-Heizer-Diagnose" VALUE 0x1CC97D KwUb 24.02 spg_ubatt 0.00 24.02 FORMAT "%5.2" /end CHARACTERISTIC
/begin CHARACTERISTIC UBDHLSMX "obere Batteriespannungsschwelle f¸r die Lambdasonden- Heizer-Diagnose" VALUE 0x1CC97E KwUb 24.02 spg_ubatt 0.00 24.02 FORMAT "%5.2" /end CHARACTERISTIC
/begin CHARACTERISTIC UBHFM "Batteriespannungsschwelle zur Umschaltung auf Ersatzlastsignal" VALUE 0x1CA3EE KwUb 24.02 spg_ubatt 0.00 24.02 FORMAT "%5.2" /end CHARACTERISTIC
/begin CHARACTERISTIC UBHRLSUMN "Minimale Versorgungsspannung f¸r die Diagnose DHRLSU / DHRLSUE" VALUE 0x1CCBA4 KwUb 24.02 spg_ubatt 0.00 24.02 FORMAT "%5.2" /end CHARACTERISTIC
/begin CHARACTERISTIC UBHRLSUMX "Maximale Versorgungsspannung f¸r die Diagnose DHRLSU" VALUE 0x1CCBA5 KwUb 24.02 spg_ubatt 0.00 24.02 FORMAT "%5.2" /end CHARACTERISTIC
/begin CHARACTERISTIC UFST1MN "Minimum Prim‰rtank-F¸llstandssignal zur Kurzschlusserkennung (Gnd)" VALUE 0x1CE1F6 KwUw 99.99847 rel_uw_b100 0.00 99.99847 FORMAT "%8.5" /end CHARACTERISTIC
/begin CHARACTERISTIC UFST1MX "Maximum Prim‰rtank-F¸llstandssignal f¸r Kurzschlusserkennung (Spann.versorg.)" VALUE 0x1CE1F8 KwUw 99.99847 rel_uw_b100 0.00 99.99847 FORMAT "%8.5" /end CHARACTERISTIC
/begin CHARACTERISTIC UFST2MN "Minimum Sekund‰rtank-F¸llstandssignal zur Kurzschlusserkennung (Gnd)" VALUE 0x1CE1FA KwUw 99.99847 rel_uw_b100 0.00 99.99847 FORMAT "%8.5" /end CHARACTERISTIC
/begin CHARACTERISTIC UFST2MX "Maximum Sekund‰rtank-F¸llstandssignal f¸r Kurzschlusserkennung (Spann.versorg.)" VALUE 0x1CE1FC KwUw 99.99847 rel_uw_b100 0.00 99.99847 FORMAT "%8.5" /end CHARACTERISTIC
/begin CHARACTERISTIC UHDMN "Schwellwert f¸r bestromte Heizerendstufe" VALUE 0x1CC97F KwUb 4.980 spg_ub_b5 0.00 4.980 FORMAT "%5.3" /end CHARACTERISTIC
/begin CHARACTERISTIC UHDMX "Schwellwert f¸r stromlose Heizerendstufe" VALUE 0x1CC980 KwUb 4.980 spg_ub_b5 0.00 4.980 FORMAT "%5.3" /end CHARACTERISTIC
/begin CHARACTERISTIC UNWDHFM "Umdrehungen Nockenwelle f¸r Fehlerentprellung Diagnose HFM" VALUE 0x1CA3F6 KwUb 255.0 dez 0.00 255.0 FORMAT "%5.1" /end CHARACTERISTIC
/begin CHARACTERISTIC ZATMRW "Zeitkonstante f¸r Rohrwandtemperaturmodell" CURVE 0x1CCBB8 KlAUwSstUwWUw 13106.8000 zk200msxs_uw_b13107 0.200000000 13107.0000 FORMAT "%10.4"
 /begin AXIS_DESCR STD_AXIS msabg_w m_uw_b6553p5 5 0.00 6553.500 FORMAT "%8.3" DEPOSIT ABSOLUTE /end AXIS_DESCR
/end CHARACTERISTIC
/begin CHARACTERISTIC ZFSTPLTH "Minimum Zeitschwelle f¸r Zweitank-Pla¸sibilitat-Fehlererkennung" VALUE 0x1CE1FE KwUw 6553.500 t100msxs_uw_b6553p5 0.00 6553.500 FORMAT "%8.3" /end CHARACTERISTIC
/begin CHARACTERISTIC ZFSTSIHL "Minimum Zeitschwelle f¸r Zweitank-Transferpumpenfehler-Ausraeumung" VALUE 0x1CE200 KwUw 6553.500 t100msxs_uw_b6553p5 0.00 6553.500 FORMAT "%8.3" /end CHARACTERISTIC
/begin CHARACTERISTIC ZFSTSITH "Minimum Zeitschwelle f¸r Zweitank-Transferpumpen-Fehlererkennung" VALUE 0x1CE202 KwUw 6553.500 t100msxs_uw_b6553p5 0.00 6553.500 FORMAT "%8.3" /end CHARACTERISTIC
/begin CHARACTERISTIC ZKARIH "Filterzeitkonst.f¸r Nachbildung Dynamik der Keramiktemp. aus Abgastemp. h.Kat" VALUE 0x1CC9E8 KwUw 6553.50000 zk100msxs_uw_b6553 0.100001526 6553.60000 FORMAT "%10.5" /end CHARACTERISTIC
/begin CHARACTERISTIC ZKPRIH "Filter f¸r Nachbildung Dynamik der Sondenkeramiktemp.aus el.Heizleistung h.Kat" VALUE 0x1CC9EA KwUw 6553.50000 zk100msxs_uw_b6553 0.100001526 6553.60000 FORMAT "%10.5" /end CHARACTERISTIC
/begin CHARACTERISTIC ZMLRO "Zeitkonstante mlroh-Tiefpaﬂ bei Diagnose HFM/HLM" VALUE 0x1C2D0C KwUb 2.54000 zk10msxs_ub_b2p55 0.0100000 2.55000 FORMAT "%7.5" /end CHARACTERISTIC
/begin MEASUREMENT B_agrrdy "Bedingung AGR gepr¸ft f¸r 'ready-Byte'" UBYTE B_TRUE 1 100 0 1 BIT_MASK 0x80 FORMAT "%13.11" ECU_ADDRESS 0x7FC383 /end MEASUREMENT
/begin MEASUREMENT B_bebrems "Bedingung Bandende-Funktionsanforderung Bremsschalter" UWORD B_TRUE 1 100 0 1 BIT_MASK 0x20 FORMAT "%13.11" ECU_ADDRESS 0x7FC8AE /end MEASUREMENT
/begin MEASUREMENT B_becat "Bedingung Bandende Funktionsanforderung : CAN-Schnittstelle, Timeout ASR" UWORD B_TRUE 1 100 0 1 BIT_MASK 0x20 FORMAT "%13.11" ECU_ADDRESS 0x7FC8B4 /end MEASUREMENT
/begin MEASUREMENT B_becif "Bedingung Bandende-Funktionsanforderung CAN-Schnittstelle interner Fehler" UWORD B_TRUE 1 100 0 1 BIT_MASK 0x20 FORMAT "%13.11" ECU_ADDRESS 0x7FC8B8 /end MEASUREMENT
/begin MEASUREMENT B_behshe "Bedingung Bandende-Funktionsanforderung Endstufe Sondenheizung nach Kat" UWORD B_TRUE 1 100 0 1 BIT_MASK 0x20 FORMAT "%13.11" ECU_ADDRESS 0x7FC92A /end MEASUREMENT
/begin MEASUREMENT B_behshe2 "Bedingung Bandende-Funktionsanforderung Endstufe Sondenheizung nach Kat Bank 2" UWORD B_TRUE 1 100 0 1 BIT_MASK 0x20 FORMAT "%13.11" ECU_ADDRESS 0x7FC92C /end MEASUREMENT
/begin MEASUREMENT B_behsvsa "Bedingung: Bandendefunktionanford. f¸r %DHLSU" UWORD B_TRUE 1 100 0 1 BIT_MASK 0x20 FORMAT "%13.11" ECU_ADDRESS 0x7FC936 /end MEASUREMENT
/begin MEASUREMENT B_behsvsa2 "Bedingung: Bandendefunktionanford. f¸r %DHLSU, Bank 2" UWORD B_TRUE 1 100 0 1 BIT_MASK 0x20 FORMAT "%13.11" ECU_ADDRESS 0x7FC938 /end MEASUREMENT
/begin MEASUREMENT B_bekuppl "Bedingung Bandende-Funktionsanforderung Kupplungssensor" UWORD B_TRUE 1 100 0 1 BIT_MASK 0x20 FORMAT "%13.11" ECU_ADDRESS 0x7FC952 /end MEASUREMENT
/begin MEASUREMENT B_belfse "" UWORD B_TRUE 1 100 0 1 BIT_MASK 0x20 FORMAT "%13.11" ECU_ADDRESS 0x7FC966 /end MEASUREMENT
/begin MEASUREMENT B_belsvv "Bedingung Bandende-Funktionsanforderung vertauschte Lambda-Sonde vor KAT" UWORD B_TRUE 1 100 0 1 BIT_MASK 0x20 FORMAT "%13.11" ECU_ADDRESS 0x7FC980 /end MEASUREMENT
/begin MEASUREMENT B_beluea "Bedingung Bandende-Funktionsanforderung Endstufe L¸ftermotor A" UWORD B_TRUE 1 100 0 1 BIT_MASK 0x20 FORMAT "%13.11" ECU_ADDRESS 0x7FC982 /end MEASUREMENT
/begin MEASUREMENT B_belueb "Bedingung Bandende-Funktionsanforderung Endstufe L¸ftermotor B" UWORD B_TRUE 1 100 0 1 BIT_MASK 0x20 FORMAT "%13.11" ECU_ADDRESS 0x7FC984 /end MEASUREMENT
/begin MEASUREMENT B_beluec "Bedingung Bandende-Funktionsanforderung Endstufe L¸ftermotor C" UWORD B_TRUE 1 100 0 1 BIT_MASK 0x20 FORMAT "%13.11" ECU_ADDRESS 0x7FC986 /end MEASUREMENT
/begin MEASUREMENT B_bemile "Bedingung Bandende-Funktionsanforderung Endstufe Fehlerlampe" UWORD B_TRUE 1 100 0 1 BIT_MASK 0x20 FORMAT "%13.11" ECU_ADDRESS 0x7FC9AA /end MEASUREMENT
/begin MEASUREMENT B_benwkw "Bedingung Bandende-Funktionsanforderung Zuordnung Nockenwelle zu Kurbelwelle" UWORD B_TRUE 1 100 0 1 BIT_MASK 0x20 FORMAT "%13.11" ECU_ADDRESS 0x7FC9AE /end MEASUREMENT
/begin MEASUREMENT B_benwkw2 "Bedingung Bandende-Funktionsanforderung Zuordnung Nockenwelle zu Kurbelwelle" UWORD B_TRUE 1 100 0 1 BIT_MASK 0x20 FORMAT "%13.11" ECU_ADDRESS 0x7FC9B0 /end MEASUREMENT
/begin MEASUREMENT B_benwkw3 "Bedingung Bandende-Funktionsanforderung Zuordnung Nockenwelle zu Kurbelwelle" UWORD B_TRUE 1 100 0 1 BIT_MASK 0x20 FORMAT "%13.11" ECU_ADDRESS 0x7FC9B2 /end MEASUREMENT
/begin MEASUREMENT B_benwkw4 "Bedingung Bandende-Funktionsanforderung Zuordnung Nockenwelle zu Kurbelwelle" UWORD B_TRUE 1 100 0 1 BIT_MASK 0x20 FORMAT "%13.11" ECU_ADDRESS 0x7FC9B4 /end MEASUREMENT
/begin MEASUREMENT B_benwkwa "Bedingung Bandende-Funktionsanforderung Zuordnung NW Auslaﬂ 1 zur KW" UWORD B_TRUE 1 100 0 1 BIT_MASK 0x20 FORMAT "%13.11" ECU_ADDRESS 0x7FC9B6 /end MEASUREMENT
/begin MEASUREMENT B_benwkwa2 "Bedingung Bandende-Funktionsanforderung Zuordnung NW Auslaﬂ 2 zur KW" UWORD B_TRUE 1 100 0 1 BIT_MASK 0x20 FORMAT "%13.11" ECU_ADDRESS 0x7FC9B8 /end MEASUREMENT
/begin MEASUREMENT B_benwkwe "Bedingung Bandende-Funktionsanforderung Zuordnung NW Einlaﬂ 1 zur KW" UWORD B_TRUE 1 100 0 1 BIT_MASK 0x20 FORMAT "%13.11" ECU_ADDRESS 0x7FC9BA /end MEASUREMENT
/begin MEASUREMENT B_benwkwe2 "Bedingung Bandende-Funktionsanforderung Zuordnung NW Einlaﬂ 2 zur KW" UWORD B_TRUE 1 100 0 1 BIT_MASK 0x20 FORMAT "%13.11" ECU_ADDRESS 0x7FC9BC /end MEASUREMENT
/begin MEASUREMENT B_bestae "Bedingung Bandendeanforderung f¸r Fehler Endstufe Starter Relais" UWORD B_TRUE 1 100 0 1 BIT_MASK 0x20 FORMAT "%13.11" ECU_ADDRESS 0x7FC9E8 /end MEASUREMENT
/begin MEASUREMENT B_besue "Bedingung Bandendeanforderung f¸r Endstufe Saugrohrumschaltung" UWORD B_TRUE 1 100 0 1 BIT_MASK 0x20 FORMAT "%13.11" ECU_ADDRESS 0x7FC9EA /end MEASUREMENT
/begin MEASUREMENT B_betmki "Bedingung Bandende-Funktionsanforderung Motortemperatur ¸b. Kombiinstrument tmki" UWORD B_TRUE 1 100 0 1 BIT_MASK 0x20 FORMAT "%13.11" ECU_ADDRESS 0x7FCA04 /end MEASUREMENT
/begin MEASUREMENT B_betum "Bedingung Bandende-Funktionsanforderung" UWORD B_TRUE 1 100 0 1 BIT_MASK 0x20 FORMAT "%13.11" ECU_ADDRESS 0x7FCA08 /end MEASUREMENT
/begin MEASUREMENT B_bevfz "Bedingung Bandende-Funktionsanforderung f¸r Fehlerpfad Fahrzeuggeschwindigkeit" UWORD B_TRUE 1 100 0 1 BIT_MASK 0x20 FORMAT "%13.11" ECU_ADDRESS 0x7FCA24 /end MEASUREMENT
/begin MEASUREMENT B_bkbrems "Bedingung Ersatzwert aktiv: BREMS (Bremsschalter)" UWORD B_TRUE 1 100 0 1 BIT_MASK 0x40 FORMAT "%13.11" ECU_ADDRESS 0x7FC8AE /end MEASUREMENT
/begin MEASUREMENT B_bkcat "Bedingung: CAN-Schnittstelle, Timeout ASR" UWORD B_TRUE 1 100 0 1 BIT_MASK 0x40 FORMAT "%13.11" ECU_ADDRESS 0x7FC8B4 /end MEASUREMENT
/begin MEASUREMENT B_bkcif "Bedingung: CAN-Schnittstelle, interner Fehler" UWORD B_TRUE 1 100 0 1 BIT_MASK 0x40 FORMAT "%13.11" ECU_ADDRESS 0x7FC8B8 /end MEASUREMENT
/begin MEASUREMENT B_bkhshe "Bedingung: Lambdasondenheizung hinter Kat. Endstufe" UWORD B_TRUE 1 100 0 1 BIT_MASK 0x40 FORMAT "%13.11" ECU_ADDRESS 0x7FC92A /end MEASUREMENT
/begin MEASUREMENT B_bkhshe2 "Bedingung: Lambdasondenheizung hinter Kat. Bank 2 Endstufe" UWORD B_TRUE 1 100 0 1 BIT_MASK 0x40 FORMAT "%13.11" ECU_ADDRESS 0x7FC92C /end MEASUREMENT
/begin MEASUREMENT B_bkhsvsa "Bedingung:Lambdasondenheizung vor Kat. aktiv" UWORD B_TRUE 1 100 0 1 BIT_MASK 0x40 FORMAT "%13.11" ECU_ADDRESS 0x7FC936 /end MEASUREMENT
/begin MEASUREMENT B_bkhsvsa2 "Bedingung:Lambdasondenheizung vor Kat. aktiv, Bank 2" UWORD B_TRUE 1 100 0 1 BIT_MASK 0x40 FORMAT "%13.11" ECU_ADDRESS 0x7FC938 /end MEASUREMENT
/begin MEASUREMENT B_bkkuppl "Ersatzwert aktiv" UWORD B_TRUE 1 100 0 1 BIT_MASK 0x40 FORMAT "%13.11" ECU_ADDRESS 0x7FC952 /end MEASUREMENT
/begin MEASUREMENT B_bklfse "" UWORD B_TRUE 1 100 0 1 BIT_MASK 0x40 FORMAT "%13.11" ECU_ADDRESS 0x7FC966 /end MEASUREMENT
/begin MEASUREMENT B_bklsvv "Bedingung: vertauschte Lambdasonde vor Kat. aktiv" UWORD B_TRUE 1 100 0 1 BIT_MASK 0x40 FORMAT "%13.11" ECU_ADDRESS 0x7FC980 /end MEASUREMENT
/begin MEASUREMENT B_bkluea "Bedingung Ersatzwert aktiv: Motor-L¸fter Endstufe A" UWORD B_TRUE 1 100 0 1 BIT_MASK 0x40 FORMAT "%13.11" ECU_ADDRESS 0x7FC982 /end MEASUREMENT
/begin MEASUREMENT B_bklueb "Bedingung Ersatzwert aktiv: Motor-L¸fter Endstufe B" UWORD B_TRUE 1 100 0 1 BIT_MASK 0x40 FORMAT "%13.11" ECU_ADDRESS 0x7FC984 /end MEASUREMENT
/begin MEASUREMENT B_bkluec "Bedingung Ersatzwert aktiv: Motor-L¸fter Endstufe C" UWORD B_TRUE 1 100 0 1 BIT_MASK 0x40 FORMAT "%13.11" ECU_ADDRESS 0x7FC986 /end MEASUREMENT
/begin MEASUREMENT B_bkmile "Bedingung: MIL-Endstufe aktiv" UWORD B_TRUE 1 100 0 1 BIT_MASK 0x40 FORMAT "%13.11" ECU_ADDRESS 0x7FC9AA /end MEASUREMENT
/begin MEASUREMENT B_bknwkw "Bedingung: Zuordnung Nockenwelle zu Kurbelwelle aktiv" UWORD B_TRUE 1 100 0 1 BIT_MASK 0x40 FORMAT "%13.11" ECU_ADDRESS 0x7FC9AE /end MEASUREMENT
/begin MEASUREMENT B_bknwkw2 "Bedingung: Zuordnung Nockenwelle 2 zu Kurbelwelle aktiv" UWORD B_TRUE 1 100 0 1 BIT_MASK 0x40 FORMAT "%13.11" ECU_ADDRESS 0x7FC9B0 /end MEASUREMENT
/begin MEASUREMENT B_bknwkw3 "Bedingung: Zuordnung Nockenwelle 3 zu Kurbelwelle aktiv" UWORD B_TRUE 1 100 0 1 BIT_MASK 0x40 FORMAT "%13.11" ECU_ADDRESS 0x7FC9B2 /end MEASUREMENT
/begin MEASUREMENT B_bknwkw4 "Bedingung: Zuordnung Nockenwelle 4 zu Kurbelwelle aktiv" UWORD B_TRUE 1 100 0 1 BIT_MASK 0x40 FORMAT "%13.11" ECU_ADDRESS 0x7FC9B4 /end MEASUREMENT
/begin MEASUREMENT B_bknwkwa "Bedingung: Zuordnung Nockenwelle Auslaﬂ 1  zu Kurbelwelle aktiv" UWORD B_TRUE 1 100 0 1 BIT_MASK 0x40 FORMAT "%13.11" ECU_ADDRESS 0x7FC9B6 /end MEASUREMENT
/begin MEASUREMENT B_bknwkwa2 "Bedingung: Zuordnung Nockenwelle Auslaﬂ 2  zu Kurbelwelle aktiv" UWORD B_TRUE 1 100 0 1 BIT_MASK 0x40 FORMAT "%13.11" ECU_ADDRESS 0x7FC9B8 /end MEASUREMENT
/begin MEASUREMENT B_bknwkwe "Bedingung: Zuordnung Nockenwelle Einlaﬂ 1  zu Kurbelwelle aktiv" UWORD B_TRUE 1 100 0 1 BIT_MASK 0x40 FORMAT "%13.11" ECU_ADDRESS 0x7FC9BA /end MEASUREMENT
/begin MEASUREMENT B_bknwkwe2 "Bedingung: Zuordnung Nockenwelle Einlaﬂ 2  zu Kurbelwelle aktiv" UWORD B_TRUE 1 100 0 1 BIT_MASK 0x40 FORMAT "%13.11" ECU_ADDRESS 0x7FC9BC /end MEASUREMENT
/begin MEASUREMENT B_bkstae "Bedingung Ersatzwert f¸r Starter Relais Endstufe" UWORD B_TRUE 1 100 0 1 BIT_MASK 0x40 FORMAT "%13.11" ECU_ADDRESS 0x7FC9E8 /end MEASUREMENT
/begin MEASUREMENT B_bksue "Bedingung: Ersatzwert Saugrohrumschaltung Endstufe aktiv" UWORD B_TRUE 1 100 0 1 BIT_MASK 0x40 FORMAT "%13.11" ECU_ADDRESS 0x7FC9EA /end MEASUREMENT
/begin MEASUREMENT B_bktmki "Bedingung Ersatzwert f¸r Motortemperatur aus Kombiinstrument" UWORD B_TRUE 1 100 0 1 BIT_MASK 0x40 FORMAT "%13.11" ECU_ADDRESS 0x7FCA04 /end MEASUREMENT
/begin MEASUREMENT B_bktum "Bedingung Ersatzwert f¸r Umgebumgstemperatur" UWORD B_TRUE 1 100 0 1 BIT_MASK 0x40 FORMAT "%13.11" ECU_ADDRESS 0x7FCA08 /end MEASUREMENT
/begin MEASUREMENT B_bkvfz "Bedingung Ersatzwert aktiv: Fahrzeuggeschwindigkeitssignal" UWORD B_TRUE 1 100 0 1 BIT_MASK 0x40 FORMAT "%13.11" ECU_ADDRESS 0x7FCA24 /end MEASUREMENT
/begin MEASUREMENT B_canoff "CAN Controller Zustand: BUS_OFF" UBYTE B_TRUE 1 100 0 1 BIT_MASK 0x1 FORMAT "%13.11" ECU_ADDRESS 0x800E18 /end MEASUREMENT
/begin MEASUREMENT B_cdiagoff "Bedingung: CAN-Diagnose aus, bei Flashprogrammierung ¸ber CAN" UBYTE B_TRUE 1 100 0 1 BIT_MASK 0x1 FORMAT "%13.11" ECU_ADDRESS 0x800E19 /end MEASUREMENT
/begin MEASUREMENT B_clbrems "Bedingung Fehlerpfad BREMS (Bremsschalter) lˆschen" UWORD B_TRUE 1 100 0 1 BIT_MASK 0x80 FORMAT "%13.11" ECU_ADDRESS 0x7FC8AE /end MEASUREMENT
/begin MEASUREMENT B_clcat "Bedingung Fehlerpfad CAT lˆschen" UWORD B_TRUE 1 100 0 1 BIT_MASK 0x80 FORMAT "%13.11" ECU_ADDRESS 0x7FC8B4 /end MEASUREMENT
/begin MEASUREMENT B_clcif "Bedingung Fehlerpfad CIF lˆschen" UWORD B_TRUE 1 100 0 1 BIT_MASK 0x80 FORMAT "%13.11" ECU_ADDRESS 0x7FC8B8 /end MEASUREMENT
/begin MEASUREMENT B_clhshe "Bedingung Fehlerpfad DHLSHK lˆschen (Endstufe)" UWORD B_TRUE 1 100 0 1 BIT_MASK 0x80 FORMAT "%13.11" ECU_ADDRESS 0x7FC92A /end MEASUREMENT
/begin MEASUREMENT B_clhshe2 "Bedingung Fehlerpfad DHLSHK2 lˆschen (Endstufe)" UWORD B_TRUE 1 100 0 1 BIT_MASK 0x80 FORMAT "%13.11" ECU_ADDRESS 0x7FC92C /end MEASUREMENT
/begin MEASUREMENT B_clhsvsa "Bedingung Fehlerpfad DHLSUSA lˆschen" UWORD B_TRUE 1 100 0 1 BIT_MASK 0x80 FORMAT "%13.11" ECU_ADDRESS 0x7FC936 /end MEASUREMENT
/begin MEASUREMENT B_clhsvsa2 "Bedingung Fehlerpfad DHLSUSA2 lˆschen" UWORD B_TRUE 1 100 0 1 BIT_MASK 0x80 FORMAT "%13.11" ECU_ADDRESS 0x7FC938 /end MEASUREMENT
/begin MEASUREMENT B_clkuppl "Bedingung: Fehlerpfad KUPPL (Gebergrˆﬂe Kupplung) lˆschen" UWORD B_TRUE 1 100 0 1 BIT_MASK 0x80 FORMAT "%13.11" ECU_ADDRESS 0x7FC952 /end MEASUREMENT
/begin MEASUREMENT B_cllfse "" UWORD B_TRUE 1 100 0 1 BIT_MASK 0x80 FORMAT "%13.11" ECU_ADDRESS 0x7FC966 /end MEASUREMENT
/begin MEASUREMENT B_cllsvv "Bedingung Fehlerpfad Vertauschte Sonden lˆschen" UWORD B_TRUE 1 100 0 1 BIT_MASK 0x80 FORMAT "%13.11" ECU_ADDRESS 0x7FC980 /end MEASUREMENT
/begin MEASUREMENT B_clluea "Bedingung: Fehlerpfad Endstufe Motor L¸fter A Lˆschen" UWORD B_TRUE 1 100 0 1 BIT_MASK 0x80 FORMAT "%13.11" ECU_ADDRESS 0x7FC982 /end MEASUREMENT
/begin MEASUREMENT B_cllueb "Bedingung: Fehlerpfad Entstufe Motor L¸fter B Lˆschen" UWORD B_TRUE 1 100 0 1 BIT_MASK 0x80 FORMAT "%13.11" ECU_ADDRESS 0x7FC984 /end MEASUREMENT
/begin MEASUREMENT B_clluec "Bedingung: Fehlerpfad Entstufe Motor L¸fter C Lˆschen" UWORD B_TRUE 1 100 0 1 BIT_MASK 0x80 FORMAT "%13.11" ECU_ADDRESS 0x7FC986 /end MEASUREMENT
/begin MEASUREMENT B_clmile "Bedingung Fehlerpfad MIL-Endstufe lˆschen" UWORD B_TRUE 1 100 0 1 BIT_MASK 0x80 FORMAT "%13.11" ECU_ADDRESS 0x7FC9AA /end MEASUREMENT
/begin MEASUREMENT B_clnwkw "Bedingung Fehlerpfad Zuordnung Nockenwelle zu Kurbelwelle lˆschen" UWORD B_TRUE 1 100 0 1 BIT_MASK 0x80 FORMAT "%13.11" ECU_ADDRESS 0x7FC9AE /end MEASUREMENT
/begin MEASUREMENT B_clnwkw2 "Bedingung Fehlerpfad Zuordnung Nockenwelle 2 zu Kurbelwelle lˆschen" UWORD B_TRUE 1 100 0 1 BIT_MASK 0x80 FORMAT "%13.11" ECU_ADDRESS 0x7FC9B0 /end MEASUREMENT
/begin MEASUREMENT B_clnwkw3 "Bedingung Fehlerpfad Zuordnung Nockenwelle 3 zu Kurbelwelle lˆschen" UWORD B_TRUE 1 100 0 1 BIT_MASK 0x80 FORMAT "%13.11" ECU_ADDRESS 0x7FC9B2 /end MEASUREMENT
/begin MEASUREMENT B_clnwkw4 "Bedingung Fehlerpfad Zuordnung Nockenwelle 4 zu Kurbelwelle lˆschen" UWORD B_TRUE 1 100 0 1 BIT_MASK 0x80 FORMAT "%13.11" ECU_ADDRESS 0x7FC9B4 /end MEASUREMENT
/begin MEASUREMENT B_clnwkwa "Fehlerpfad der Zuordnung Auslassnockenwelle  zur Kurbelwelle lˆschen" UWORD B_TRUE 1 100 0 1 BIT_MASK 0x80 FORMAT "%13.11" ECU_ADDRESS 0x7FC9B6 /end MEASUREMENT
/begin MEASUREMENT B_clnwkwa2 "Fehlerpfad der Zuordnung Auslassnockenwelle Bank 2 zur Kurbelwelle lˆschen" UWORD B_TRUE 1 100 0 1 BIT_MASK 0x80 FORMAT "%13.11" ECU_ADDRESS 0x7FC9B8 /end MEASUREMENT
/begin MEASUREMENT B_clnwkwe "Fehlerpfad der Zuordnung Einlassnockenwelle zur Kurbelwelle lˆschen" UWORD B_TRUE 1 100 0 1 BIT_MASK 0x80 FORMAT "%13.11" ECU_ADDRESS 0x7FC9BA /end MEASUREMENT
/begin MEASUREMENT B_clnwkwe2 "Fehlerpfad der Zuordnung Einlassnockenwelle Bank 2 zur Kurbelwelle lˆschen" UWORD B_TRUE 1 100 0 1 BIT_MASK 0x80 FORMAT "%13.11" ECU_ADDRESS 0x7FC9BC /end MEASUREMENT
/begin MEASUREMENT B_clstae "Bedingung: Fehlerpfad Endstufe Start Relais lˆschen" UWORD B_TRUE 1 100 0 1 BIT_MASK 0x80 FORMAT "%13.11" ECU_ADDRESS 0x7FC9E8 /end MEASUREMENT
/begin MEASUREMENT B_clsue "Bedingung Fehlerpfad Saugrohrumschaltung-Endstufe lˆschen" UWORD B_TRUE 1 100 0 1 BIT_MASK 0x80 FORMAT "%13.11" ECU_ADDRESS 0x7FC9EA /end MEASUREMENT
/begin MEASUREMENT B_cltmki "Bedingung: Fehler Motortemperatur aus Kombiinstrument lˆschen" UWORD B_TRUE 1 100 0 1 BIT_MASK 0x80 FORMAT "%13.11" ECU_ADDRESS 0x7FCA04 /end MEASUREMENT
/begin MEASUREMENT B_cltum "Bedingung Fehlerpfad Umgebungstemperatur TUM  lˆschen" UWORD B_TRUE 1 100 0 1 BIT_MASK 0x80 FORMAT "%13.11" ECU_ADDRESS 0x7FCA08 /end MEASUREMENT
/begin MEASUREMENT B_clvfz "Bedingung Fehlerpfad VFZ (Fahrzeuggeschwindigkeit) lˆschen" UWORD B_TRUE 1 100 0 1 BIT_MASK 0x80 FORMAT "%13.11" ECU_ADDRESS 0x7FCA24 /end MEASUREMENT
/begin MEASUREMENT B_diagtimeout "" UBYTE B_TRUE 1 100 0 1 BIT_MASK 0x1 FORMAT "%13.11" ECU_ADDRESS 0x800E1A /end MEASUREMENT
/begin MEASUREMENT B_dtankm "Bedingung Diagnose Tankvorgang moeglich" UWORD B_TRUE 1 100 0 1 BIT_MASK 0x1 FORMAT "%13.11" ECU_ADDRESS 0x800C2C /end MEASUREMENT
/begin MEASUREMENT B_dtimer "" UBYTE B_TRUE 1 100 0 1 BIT_MASK 0x1 FORMAT "%13.11" ECU_ADDRESS 0x800E1B /end MEASUREMENT
/begin MEASUREMENT B_ebDavT "Bedingung ETK_Bypass Daten verf¸gbar" UBYTE B_TRUE 1 100 0 1 BIT_MASK 0x1 FORMAT "%13.11" ECU_ADDRESS 0x800E90 /end MEASUREMENT
/begin MEASUREMENT B_ebDavY "ETK-Bypass Daten vorhanden" UBYTE B_TRUE 1 100 0 1 BIT_MASK 0x1 FORMAT "%13.11" ECU_ADDRESS 0x800E91 /end MEASUREMENT
/begin MEASUREMENT B_edhfmpl "Bedingung f¸r HFM Signal nicht plausibel" UBYTE B_TRUE 1 100 0 1 BIT_MASK 0x1 FORMAT "%13.11" ECU_ADDRESS 0x8010A1 /end MEASUREMENT
/begin MEASUREMENT B_ehfm "Bedingung Fehler HFM (ohne Entprellung)" UBYTE B_TRUE 1 100 0 1 BIT_MASK 0x1 FORMAT "%13.11" ECU_ADDRESS 0x7FA61C /end MEASUREMENT
/begin MEASUREMENT B_ehfm1 "Bedingung Fehler HFM (ohne Entprellung) (Zwischengrˆﬂe ohne Abfrage von UBAT)" UBYTE B_TRUE 1 100 0 1 BIT_MASK 0x1 FORMAT "%13.11" ECU_ADDRESS 0x7FA61F /end MEASUREMENT
/begin MEASUREMENT B_ehfmasy "Bedingung  HFM's verhalten sich asymmetrisch zueinander" UBYTE B_TRUE 1 100 0 1 BIT_MASK 0x2 FORMAT "%13.11" ECU_ADDRESS 0x8010A1 /end MEASUREMENT
/begin MEASUREMENT B_ehfmmn "Bedingung f¸r Komponenten-Fehler HFM minimal" UBYTE B_TRUE 1 100 0 1 BIT_MASK 0x1 FORMAT "%13.11" ECU_ADDRESS 0x8010A0 /end MEASUREMENT
/begin MEASUREMENT B_ehfmmx "Bedingung f¸r Komponenten-Fehler HFM  maximal" UBYTE B_TRUE 1 100 0 1 BIT_MASK 0x2 FORMAT "%13.11" ECU_ADDRESS 0x8010A0 /end MEASUREMENT
/begin MEASUREMENT B_ehfmnpl "Bedingung f¸r HFM Signal nicht plausibel" UBYTE B_TRUE 1 100 0 1 BIT_MASK 0x4 FORMAT "%13.11" ECU_ADDRESS 0x8010A0 /end MEASUREMENT
/begin MEASUREMENT B_ehfmsg "Bedingung f¸r Komponenten-Fehler HFM Signal" UBYTE B_TRUE 1 100 0 1 BIT_MASK 0x8 FORMAT "%13.11" ECU_ADDRESS 0x8010A0 /end MEASUREMENT
/begin MEASUREMENT B_ehlsu "Bedingung Fehler Heizung LSU" UBYTE B_TRUE 1 100 0 1 BIT_MASK 0x1 FORMAT "%13.11" ECU_ADDRESS 0x80117B /end MEASUREMENT
/begin MEASUREMENT B_ehlsu2 "Bedingung Fehler Heizung LSU Bank2" UBYTE B_TRUE 1 100 0 1 BIT_MASK 0x4 FORMAT "%13.11" ECU_ADDRESS 0x80117B /end MEASUREMENT
/begin MEASUREMENT B_ehsh "Bedingung Error HSH" UBYTE B_TRUE 1 100 0 1 BIT_MASK 0x1 FORMAT "%13.11" ECU_ADDRESS 0x8008AA /end MEASUREMENT
/begin MEASUREMENT B_ehsh2 "Bedingung Error HSH2" UBYTE B_TRUE 1 100 0 1 BIT_MASK 0x1 FORMAT "%13.11" ECU_ADDRESS 0x8008AB /end MEASUREMENT
/begin MEASUREMENT B_ehsve "Bedingung Endstufenfehler an der Heizung" UBYTE B_TRUE 1 100 0 1 BIT_MASK 0x1 FORMAT "%13.11" ECU_ADDRESS 0x8009B2 /end MEASUREMENT
/begin MEASUREMENT B_ehsve2 "Bedingung Endstufenfehler an der Heizung, Bank 2" UBYTE B_TRUE 1 100 0 1 BIT_MASK 0x2 FORMAT "%13.11" ECU_ADDRESS 0x8009B2 /end MEASUREMENT
/begin MEASUREMENT B_enh "Bedingung Freigabe Ri-Diagnose Sondenheizung hinter Kat" UBYTE B_TRUE 1 100 0 1 BIT_MASK 0x20 FORMAT "%13.11" ECU_ADDRESS 0x8008AA /end MEASUREMENT
/begin MEASUREMENT B_enh2 "Bedingung Freigabe Ri-Diagnose Sondenheizung 2 hinter Kat" UBYTE B_TRUE 1 100 0 1 BIT_MASK 0x20 FORMAT "%13.11" ECU_ADDRESS 0x8008AB /end MEASUREMENT
/begin MEASUREMENT B_fgahfm "Bedingung Freigabe Auswertung HFM" UBYTE B_TRUE 1 100 0 1 BIT_MASK 0x1 FORMAT "%13.11" ECU_ADDRESS 0x7FA620 /end MEASUREMENT
/begin MEASUREMENT B_fgdhfmst "Bedingung Freigabe der HFM Diagnose nach Startende" UBYTE B_TRUE 1 100 0 1 BIT_MASK 0x1 FORMAT "%13.11" ECU_ADDRESS 0x8010A2 /end MEASUREMENT
/begin MEASUREMENT B_fgfshfm "Freigabe Fehlerspeichereintrag HFM" UBYTE B_TRUE 1 100 0 1 BIT_MASK 0x2 FORMAT "%13.11" ECU_ADDRESS 0x8010A2 /end MEASUREMENT
/begin MEASUREMENT B_fst1mn "Bedingung: Prim‰rtank-Kraftstoffsensor Min.-Fehler" UWORD B_TRUE 1 100 0 1 BIT_MASK 0x2 FORMAT "%13.11" ECU_ADDRESS 0x800C2C /end MEASUREMENT
/begin MEASUREMENT B_fst1mx "Bedingung: Prim‰rtank-Kraftstoffsensor Max.-Fehler" UWORD B_TRUE 1 100 0 1 BIT_MASK 0x4 FORMAT "%13.11" ECU_ADDRESS 0x800C2C /end MEASUREMENT
/begin MEASUREMENT B_fst1np "Bedingung: Prim‰rtank-Kraftstoffsensor defekt" UWORD B_TRUE 1 100 0 1 BIT_MASK 0x8 FORMAT "%13.11" ECU_ADDRESS 0x800C2C /end MEASUREMENT
/begin MEASUREMENT B_fst1si "Bedingung: Zweitank-Transferpumpenausfall" UBYTE B_TRUE 1 100 0 1 BIT_MASK 0x10 FORMAT "%13.11" ECU_ADDRESS 0x800C28 /end MEASUREMENT
/begin MEASUREMENT B_fst1siok "Bedingung: Kein Ausfall der Zweitank-Transferpumpe" UWORD B_TRUE 1 100 0 1 BIT_MASK 0x10 FORMAT "%13.11" ECU_ADDRESS 0x800C2C /end MEASUREMENT
/begin MEASUREMENT B_fst1sk "Bedingung: Mˆglicher Prim‰rtank-Kraftstoffsensor-Defekt" UBYTE B_TRUE 1 100 0 1 BIT_MASK 0x1 FORMAT "%13.11" ECU_ADDRESS 0x7FC7B8 /end MEASUREMENT
/begin MEASUREMENT B_fst2mn "Bedingung: Sekund‰rtank-Kraftstoffsensor Min.-Fehler" UWORD B_TRUE 1 100 0 1 BIT_MASK 0x20 FORMAT "%13.11" ECU_ADDRESS 0x800C2C /end MEASUREMENT
/begin MEASUREMENT B_fst2mx "Bedingung: Sekund‰rtank-Kraftstoffsensor Max.-Fehler" UWORD B_TRUE 1 100 0 1 BIT_MASK 0x40 FORMAT "%13.11" ECU_ADDRESS 0x800C2C /end MEASUREMENT
/begin MEASUREMENT B_fst2np "Bedingung: Sekund‰rtank-Kraftstoffsensor defekt" UWORD B_TRUE 1 100 0 1 BIT_MASK 0x80 FORMAT "%13.11" ECU_ADDRESS 0x800C2C /end MEASUREMENT
/begin MEASUREMENT B_fst2si "Bedingung: Zweitank-F¸llstand - unbekannter Plausibilit‰tsfehler" UWORD B_TRUE 1 100 0 1 BIT_MASK 0x100 FORMAT "%13.11" ECU_ADDRESS 0x800C2C /end MEASUREMENT
/begin MEASUREMENT B_fst2sk "Bedingung: Mˆglicher Sekund‰rtank-Kraftstoffsensor-Defekt" UBYTE B_TRUE 1 100 0 1 BIT_MASK 0x2 FORMAT "%13.11" ECU_ADDRESS 0x7FC7B8 /end MEASUREMENT
/begin MEASUREMENT B_fstpler "Bedingung: Zweitank-F¸llstands-Plausibilit‰tsfehler wird vermutet" UWORD B_TRUE 1 100 0 1 BIT_MASK 0x200 FORMAT "%13.11" ECU_ADDRESS 0x800C2C /end MEASUREMENT
/begin MEASUREMENT B_fstplok "Bedingung: Zweitank-F¸llstands-Plausibilit‰tspr¸fung ist OK" UWORD B_TRUE 1 100 0 1 BIT_MASK 0x400 FORMAT "%13.11" ECU_ADDRESS 0x800C2C /end MEASUREMENT
/begin MEASUREMENT B_fstplre "Bedingung: Restart der Zweitank-F¸llstands-Plausibilit‰tspr¸fung" UWORD B_TRUE 1 100 0 1 BIT_MASK 0x800 FORMAT "%13.11" ECU_ADDRESS 0x800C2C /end MEASUREMENT
/begin MEASUREMENT B_fstsok "Bedingung: Zweitank-F¸llstands-Signal(min-max)-Pr¸fung ist OK" UWORD B_TRUE 1 100 0 1 BIT_MASK 0x1000 FORMAT "%13.11" ECU_ADDRESS 0x800C2C /end MEASUREMENT
/begin MEASUREMENT B_fstt1 "Gueltigkeit Fuellstand Tank 1" UBYTE B_TRUE 1 100 0 1 BIT_MASK 0x1 FORMAT "%13.11" ECU_ADDRESS 0x800C28 /end MEASUREMENT
/begin MEASUREMENT B_fstt2 "Gueltigkeit Fuellstand Tank 2" UBYTE B_TRUE 1 100 0 1 BIT_MASK 0x2 FORMAT "%13.11" ECU_ADDRESS 0x800C28 /end MEASUREMENT
/begin MEASUREMENT B_fsttden "Bedingung Diagnosefreigabe Fuellstand Tank" UWORD B_TRUE 1 100 0 1 BIT_MASK 0x2000 FORMAT "%13.11" ECU_ADDRESS 0x800C2C /end MEASUREMENT
/begin MEASUREMENT B_fsttnp "Bedingung: Zweitank-F¸llstands-Plausibilit‰tsfehler erkannt" UWORD B_TRUE 1 100 0 1 BIT_MASK 0x4000 FORMAT "%13.11" ECU_ADDRESS 0x800C2C /end MEASUREMENT
/begin MEASUREMENT B_fsttpro "Gueltigkeit Tankfuellstand in Prozent" UBYTE B_TRUE 1 100 0 1 BIT_MASK 0x4 FORMAT "%13.11" ECU_ADDRESS 0x800C28 /end MEASUREMENT
/begin MEASUREMENT B_fsttsen "Bedingung: Zweitank-F¸llstands-Signal(min-max)-Pr¸fung wird freigegeben" UWORD B_TRUE 1 100 0 1 BIT_MASK 0x8000 FORMAT "%13.11" ECU_ADDRESS 0x800C2C /end MEASUREMENT
/begin MEASUREMENT B_ftbrems "Bedingung: Fehlereintrag durch Tester f¸r Bremsschalter" UWORD B_TRUE 1 100 0 1 BIT_MASK 0x10 FORMAT "%13.11" ECU_ADDRESS 0x7FC8AE /end MEASUREMENT
/begin MEASUREMENT B_ftcat "Bedingung Fehlereintrag durch Tester : CAN-Schnittstelle, Timeout ASR" UWORD B_TRUE 1 100 0 1 BIT_MASK 0x10 FORMAT "%13.11" ECU_ADDRESS 0x7FC8B4 /end MEASUREMENT
/begin MEASUREMENT B_ftcif "" UWORD B_TRUE 1 100 0 1 BIT_MASK 0x10 FORMAT "%13.11" ECU_ADDRESS 0x7FC8B8 /end MEASUREMENT
/begin MEASUREMENT B_fthshe "Bedingung Fehlereintrag durch Tester f¸r Endstufe LS-Heizung hinter Kat" UWORD B_TRUE 1 100 0 1 BIT_MASK 0x10 FORMAT "%13.11" ECU_ADDRESS 0x7FC92A /end MEASUREMENT
/begin MEASUREMENT B_fthshe2 "Bedingung Fehlereintrag durch Tester f¸r Endstufe LS-Heizung hinter Kat, Bank 2" UWORD B_TRUE 1 100 0 1 BIT_MASK 0x10 FORMAT "%13.11" ECU_ADDRESS 0x7FC92C /end MEASUREMENT
/begin MEASUREMENT B_fthsvsa "Bedingung Fehlereintrag durch Tester f¸r LSU-Heizung" UWORD B_TRUE 1 100 0 1 BIT_MASK 0x10 FORMAT "%13.11" ECU_ADDRESS 0x7FC936 /end MEASUREMENT
/begin MEASUREMENT B_fthsvsa2 "Bedingung Fehlereintrag durch Tester f¸r LSU-Heizung, Bank 2" UWORD B_TRUE 1 100 0 1 BIT_MASK 0x10 FORMAT "%13.11" ECU_ADDRESS 0x7FC938 /end MEASUREMENT
/begin MEASUREMENT B_ftkuppl "Bedingung: Fehlereintrag durch Tester f¸r Kupplungssensor" UWORD B_TRUE 1 100 0 1 BIT_MASK 0x10 FORMAT "%13.11" ECU_ADDRESS 0x7FC952 /end MEASUREMENT
/begin MEASUREMENT B_ftlfse "" UWORD B_TRUE 1 100 0 1 BIT_MASK 0x10 FORMAT "%13.11" ECU_ADDRESS 0x7FC966 /end MEASUREMENT
/begin MEASUREMENT B_ftlsvv "Bedingung Fehlereintrag durch Tester Lambda Sonde vertauscht vor KAT" UWORD B_TRUE 1 100 0 1 BIT_MASK 0x10 FORMAT "%13.11" ECU_ADDRESS 0x7FC980 /end MEASUREMENT
/begin MEASUREMENT B_ftluea "Bedingung: Fehlereintrag durch Tester f¸r L¸fter Endstufe A" UWORD B_TRUE 1 100 0 1 BIT_MASK 0x10 FORMAT "%13.11" ECU_ADDRESS 0x7FC982 /end MEASUREMENT
/begin MEASUREMENT B_ftlueb "Bedingung: Fehlereintrag durch Tester f¸r L¸fter Endstufe B" UWORD B_TRUE 1 100 0 1 BIT_MASK 0x10 FORMAT "%13.11" ECU_ADDRESS 0x7FC984 /end MEASUREMENT
/begin MEASUREMENT B_ftluec "Bedingung: Fehlereintrag durch Tester f¸r L¸fter Endstufe C" UWORD B_TRUE 1 100 0 1 BIT_MASK 0x10 FORMAT "%13.11" ECU_ADDRESS 0x7FC986 /end MEASUREMENT
/begin MEASUREMENT B_ftmile "Bedingung: Fehlereintrag durch Tester f¸r Endstufendiagnose Fehlerlampe" UWORD B_TRUE 1 100 0 1 BIT_MASK 0x10 FORMAT "%13.11" ECU_ADDRESS 0x7FC9AA /end MEASUREMENT
/begin MEASUREMENT B_ftnwkw "Bedingung Fehlereintrag durch Tester f¸r Zuordnung Nockenwelle zu Kurbelwelle" UWORD B_TRUE 1 100 0 1 BIT_MASK 0x10 FORMAT "%13.11" ECU_ADDRESS 0x7FC9AE /end MEASUREMENT
/begin MEASUREMENT B_ftnwkw2 "Bedingung Fehlereintrag durch Tester f¸r Zuordnung Nockenwelle zu Kurbelwelle" UWORD B_TRUE 1 100 0 1 BIT_MASK 0x10 FORMAT "%13.11" ECU_ADDRESS 0x7FC9B0 /end MEASUREMENT
/begin MEASUREMENT B_ftnwkw3 "Bedingung Fehlereintrag durch Tester f¸r Zuordnung Nockenwelle zu Kurbelwelle" UWORD B_TRUE 1 100 0 1 BIT_MASK 0x10 FORMAT "%13.11" ECU_ADDRESS 0x7FC9B2 /end MEASUREMENT
/begin MEASUREMENT B_ftnwkw4 "Bedingung Fehlereintrag durch Tester f¸r Zuordnung Nockenwelle zu Kurbelwelle" UWORD B_TRUE 1 100 0 1 BIT_MASK 0x10 FORMAT "%13.11" ECU_ADDRESS 0x7FC9B4 /end MEASUREMENT
/begin MEASUREMENT B_ftnwkwa "Bedingung: Fehlereintrag durch Tester f¸r Zuordnung NW Auslaﬂ 1 zur ZW" UWORD B_TRUE 1 100 0 1 BIT_MASK 0x10 FORMAT "%13.11" ECU_ADDRESS 0x7FC9B6 /end MEASUREMENT
/begin MEASUREMENT B_ftnwkwa2 "Bedingung: Fehlereintrag durch Tester f¸r Zuordnung NW Auslaﬂ 2 zur ZW" UWORD B_TRUE 1 100 0 1 BIT_MASK 0x10 FORMAT "%13.11" ECU_ADDRESS 0x7FC9B8 /end MEASUREMENT
/begin MEASUREMENT B_ftnwkwe "Bedingung: Fehlereintrag durch Tester f¸r Zuordnung NW Einlaﬂ 1 zur ZW" UWORD B_TRUE 1 100 0 1 BIT_MASK 0x10 FORMAT "%13.11" ECU_ADDRESS 0x7FC9BA /end MEASUREMENT
/begin MEASUREMENT B_ftnwkwe2 "Bedingung: Fehlereintrag durch Tester f¸r Zuordnung NW Einlaﬂ 2 zur ZW" UWORD B_TRUE 1 100 0 1 BIT_MASK 0x10 FORMAT "%13.11" ECU_ADDRESS 0x7FC9BC /end MEASUREMENT
/begin MEASUREMENT B_ftstae "Bedingung: Fehlereintrag durch Tester f¸r Endstufendiagnose Starter Relais" UWORD B_TRUE 1 100 0 1 BIT_MASK 0x10 FORMAT "%13.11" ECU_ADDRESS 0x7FC9E8 /end MEASUREMENT
/begin MEASUREMENT B_ftsue "Bedingung: Fehlereintrag durch Tester f¸r Endstufe Saugrohrumschaltung" UWORD B_TRUE 1 100 0 1 BIT_MASK 0x10 FORMAT "%13.11" ECU_ADDRESS 0x7FC9EA /end MEASUREMENT
/begin MEASUREMENT B_fttmki "Bedingung Fehlereintrag durch Tester Motortemperatur aus Kombiinstrument tmki" UWORD B_TRUE 1 100 0 1 BIT_MASK 0x10 FORMAT "%13.11" ECU_ADDRESS 0x7FCA04 /end MEASUREMENT
/begin MEASUREMENT B_fttum "Bedingung: Fehlereintrag durch Tester" UWORD B_TRUE 1 100 0 1 BIT_MASK 0x10 FORMAT "%13.11" ECU_ADDRESS 0x7FCA08 /end MEASUREMENT
/begin MEASUREMENT B_ftvfz "Bedingung Fehlereintrag durch Tester f¸r Fehlerpfad VFZ" UWORD B_TRUE 1 100 0 1 BIT_MASK 0x10 FORMAT "%13.11" ECU_ADDRESS 0x7FCA24 /end MEASUREMENT
/begin MEASUREMENT B_hdhfmpl "Heilbedingung aus Systemdiagnose HFM" UBYTE B_TRUE 1 100 0 1 BIT_MASK 0x4 FORMAT "%13.11" ECU_ADDRESS 0x8010A1 /end MEASUREMENT
/begin MEASUREMENT B_hehfm "Bedingung Fehlerheilung HFM (f¸r %DSELHFS)" UBYTE B_TRUE 1 100 0 1 BIT_MASK 0x10 FORMAT "%13.11" ECU_ADDRESS 0x8010A0 /end MEASUREMENT
/begin MEASUREMENT B_hehfmasy "Bedingung f¸r Heilen des Asymetrie-Fehlers zwischen 2 HFM¥s" UBYTE B_TRUE 1 100 0 1 BIT_MASK 0x8 FORMAT "%13.11" ECU_ADDRESS 0x8010A1 /end MEASUREMENT
/begin MEASUREMENT B_hfm "Bedingung HFM messbereit" UBYTE B_TRUE 1 100 0 1 BIT_MASK 0x1 FORMAT "%13.11" ECU_ADDRESS 0x7FA61E /end MEASUREMENT
/begin MEASUREMENT B_hfmko "Bedingung: HFM Kurzschluﬂ Obergrenze ¸berschritten" UBYTE B_TRUE 1 100 0 1 BIT_MASK 0x1 FORMAT "%13.11" ECU_ADDRESS 0x7FA621 /end MEASUREMENT
/begin MEASUREMENT B_hfmku "Bedingung: HFM Kurzschluﬂ Obergrenze unterschritten" UBYTE B_TRUE 1 100 0 1 BIT_MASK 0x1 FORMAT "%13.11" ECU_ADDRESS 0x7FA622 /end MEASUREMENT
/begin MEASUREMENT B_hsokh "Bedingung Sondenheizung OK hinter Kat" UBYTE B_TRUE 1 100 0 1 BIT_MASK 0x1 FORMAT "%13.11" ECU_ADDRESS 0x7FA6F0 /end MEASUREMENT
/begin MEASUREMENT B_hsokh2 "Bedingung Sondenheizung 2 OK hinter Kat" UBYTE B_TRUE 1 100 0 1 BIT_MASK 0x1 FORMAT "%13.11" ECU_ADDRESS 0x7FA6F1 /end MEASUREMENT
/begin MEASUREMENT B_hsrdy "Bedingung Sondenheizung gepr¸ft f¸r 'ready-Byte'" UBYTE B_TRUE 1 100 0 1 BIT_MASK 0x40 FORMAT "%13.11" ECU_ADDRESS 0x7FC383 /end MEASUREMENT
/begin MEASUREMENT B_hsveemn "Bedingung Entprellter Min-Fehler der Heizerendstufe der LSU" UBYTE B_TRUE 1 100 0 1 BIT_MASK 0x1 FORMAT "%13.11" ECU_ADDRESS 0x8009B3 /end MEASUREMENT
/begin MEASUREMENT B_hsveemn2 "Bedingung Entprellter Min-Fehler der Heizerendstufe der LSU, Bank 2" UBYTE B_TRUE 1 100 0 1 BIT_MASK 0x10 FORMAT "%13.11" ECU_ADDRESS 0x8009B3 /end MEASUREMENT
/begin MEASUREMENT B_hsveemx "Bedingung Entprellter Max-Fehler der Heizerendstufe der LSU" UBYTE B_TRUE 1 100 0 1 BIT_MASK 0x2 FORMAT "%13.11" ECU_ADDRESS 0x8009B3 /end MEASUREMENT
/begin MEASUREMENT B_hsveemx2 "Bedingung Entprellter Max-Fehler der Heizerendstufe der LSU, Bank 2" UBYTE B_TRUE 1 100 0 1 BIT_MASK 0x20 FORMAT "%13.11" ECU_ADDRESS 0x8009B3 /end MEASUREMENT
/begin MEASUREMENT B_hsveesi "Bedingung Entprellter Sig-Fehler der Heizerendstufe der LSU" UBYTE B_TRUE 1 100 0 1 BIT_MASK 0x4 FORMAT "%13.11" ECU_ADDRESS 0x8009B3 /end MEASUREMENT
/begin MEASUREMENT B_hsveesi2 "Bedingung Entprellter Sig-Fehler der Heizerendstufe der LSU, Bank 2" UBYTE B_TRUE 1 100 0 1 BIT_MASK 0x40 FORMAT "%13.11" ECU_ADDRESS 0x8009B3 /end MEASUREMENT
/begin MEASUREMENT B_kathrdy "Bedingung Katalysator-Heizungen gepr¸ft f¸r 'ready-Byte'" UBYTE B_TRUE 1 100 0 1 BIT_MASK 0x2 FORMAT "%13.11" ECU_ADDRESS 0x7FC383 /end MEASUREMENT
/begin MEASUREMENT B_katrdy "Bedingung Katalysatoren gepr¸ft f¸r 'ready-Byte'" UBYTE B_TRUE 1 100 0 1 BIT_MASK 0x1 FORMAT "%13.11" ECU_ADDRESS 0x7FC383 /end MEASUREMENT
/begin MEASUREMENT B_kkrdy "Bedingung Klimak¸hlmittel gepr¸ft f¸r 'ready-Byte'" UBYTE B_TRUE 1 100 0 1 BIT_MASK 0x10 FORMAT "%13.11" ECU_ADDRESS 0x7FC383 /end MEASUREMENT
/begin MEASUREMENT B_kphfmnp "Bedingung Faktor Korrektur Periodendauer Massenstrom aus HFM nicht plausibel" UBYTE B_TRUE 1 100 0 1 BIT_MASK 0x40 FORMAT "%13.11" ECU_ADDRESS 0x8010A0 /end MEASUREMENT
/begin MEASUREMENT B_lsrdy "Bedingung Lambda-Sonden gepr¸ft f¸r 'ready-Byte'" UBYTE B_TRUE 1 100 0 1 BIT_MASK 0x20 FORMAT "%13.11" ECU_ADDRESS 0x7FC383 /end MEASUREMENT
/begin MEASUREMENT B_mnbrems "Fehlertyp BREMS (Bremssschalter): Minimalwert unterschritten" UWORD B_TRUE 1 100 0 1 BIT_MASK 0x200 FORMAT "%13.11" ECU_ADDRESS 0x7FC8AE /end MEASUREMENT
/begin MEASUREMENT B_mncat "Fehlertyp min.: CAN-Schnittstelle, Timeout ASR" UWORD B_TRUE 1 100 0 1 BIT_MASK 0x200 FORMAT "%13.11" ECU_ADDRESS 0x7FC8B4 /end MEASUREMENT
/begin MEASUREMENT B_mncif "Fehlertyp min.: CAN-Schnittstelle, interner Fehler" UWORD B_TRUE 1 100 0 1 BIT_MASK 0x200 FORMAT "%13.11" ECU_ADDRESS 0x7FC8B8 /end MEASUREMENT
/begin MEASUREMENT B_mnfhsh "Kurzschluﬂ Heizung Lambdasonde hinter Kat nach Masse" UBYTE B_TRUE 1 100 0 1 BIT_MASK 0x4 FORMAT "%13.11" ECU_ADDRESS 0x8008AA /end MEASUREMENT
/begin MEASUREMENT B_mnfhsh2 "Kurzschluﬂ Heizung Lambdasonde2 hinter Kat nach Masse" UBYTE B_TRUE 1 100 0 1 BIT_MASK 0x4 FORMAT "%13.11" ECU_ADDRESS 0x8008AB /end MEASUREMENT
/begin MEASUREMENT B_mnhshe "Kurzschluﬂ Heizung Lambdasonde hinter Kat nach Masse (Endstufe)" UWORD B_TRUE 1 100 0 1 BIT_MASK 0x200 FORMAT "%13.11" ECU_ADDRESS 0x7FC92A /end MEASUREMENT
/begin MEASUREMENT B_mnhshe2 "Kurzschluﬂ Heizung Lambdasonde2 hinter Kat nach Masse (Endstufe)" UWORD B_TRUE 1 100 0 1 BIT_MASK 0x200 FORMAT "%13.11" ECU_ADDRESS 0x7FC92C /end MEASUREMENT
/begin MEASUREMENT B_mnhsvsa "Min-Fehler erkannt" UWORD B_TRUE 1 100 0 1 BIT_MASK 0x200 FORMAT "%13.11" ECU_ADDRESS 0x7FC936 /end MEASUREMENT
/begin MEASUREMENT B_mnhsvsa2 "Min-Fehler erkannt Bank 2" UWORD B_TRUE 1 100 0 1 BIT_MASK 0x200 FORMAT "%13.11" ECU_ADDRESS 0x7FC938 /end MEASUREMENT
/begin MEASUREMENT B_mnkuppl "Fehlertyp KUPPL: Minimalwert unterschritten" UWORD B_TRUE 1 100 0 1 BIT_MASK 0x200 FORMAT "%13.11" ECU_ADDRESS 0x7FC952 /end MEASUREMENT
/begin MEASUREMENT B_mnlfse "" UWORD B_TRUE 1 100 0 1 BIT_MASK 0x200 FORMAT "%13.11" ECU_ADDRESS 0x7FC966 /end MEASUREMENT
/begin MEASUREMENT B_mnlsvv "MIN-Fehler: Vertauschte Lambda-Sonden" UWORD B_TRUE 1 100 0 1 BIT_MASK 0x200 FORMAT "%13.11" ECU_ADDRESS 0x7FC980 /end MEASUREMENT
/begin MEASUREMENT B_mnluea "Fehlertype: Kurzschluﬂ nach Masse Endstufe Motor L¸fter A" UWORD B_TRUE 1 100 0 1 BIT_MASK 0x200 FORMAT "%13.11" ECU_ADDRESS 0x7FC982 /end MEASUREMENT
/begin MEASUREMENT B_mnlueb "Fehlertype: Kurzschluﬂ nach Masse Endstufe Motor L¸fter B" UWORD B_TRUE 1 100 0 1 BIT_MASK 0x200 FORMAT "%13.11" ECU_ADDRESS 0x7FC984 /end MEASUREMENT
/begin MEASUREMENT B_mnluec "Fehlertype: Kurzschluﬂ nach Masse Endstufe Motor L¸fter C" UWORD B_TRUE 1 100 0 1 BIT_MASK 0x200 FORMAT "%13.11" ECU_ADDRESS 0x7FC986 /end MEASUREMENT
/begin MEASUREMENT B_mnmile "Fehlerart: Kurzschluﬂ Masse an MIL-Endstufe" UWORD B_TRUE 1 100 0 1 BIT_MASK 0x200 FORMAT "%13.11" ECU_ADDRESS 0x7FC9AA /end MEASUREMENT
/begin MEASUREMENT B_mnmld "Bedingung untere Plausibilit‰tsschwelle (Luftmassenvergleich) HFM ¸berschritten" UBYTE B_TRUE 1 100 0 1 BIT_MASK 0x1 FORMAT "%13.11" ECU_ADDRESS 0x7FA623 /end MEASUREMENT
/begin MEASUREMENT B_mnnwkw "Fehlerart: Nockenwelle sp‰tverstellt" UWORD B_TRUE 1 100 0 1 BIT_MASK 0x200 FORMAT "%13.11" ECU_ADDRESS 0x7FC9AE /end MEASUREMENT
/begin MEASUREMENT B_mnnwkw2 "Fehlerart: Nockenwelle 2 sp‰tverstellt" UWORD B_TRUE 1 100 0 1 BIT_MASK 0x200 FORMAT "%13.11" ECU_ADDRESS 0x7FC9B0 /end MEASUREMENT
/begin MEASUREMENT B_mnnwkw3 "Fehlerart: Nockenwelle 3 sp‰tverstellt" UWORD B_TRUE 1 100 0 1 BIT_MASK 0x200 FORMAT "%13.11" ECU_ADDRESS 0x7FC9B2 /end MEASUREMENT
/begin MEASUREMENT B_mnnwkw4 "Fehlerart: Nockenwelle 4 sp‰tverstellt" UWORD B_TRUE 1 100 0 1 BIT_MASK 0x200 FORMAT "%13.11" ECU_ADDRESS 0x7FC9B4 /end MEASUREMENT
/begin MEASUREMENT B_mnnwkwa "Fehlerart: Auslassnockenwelle  sp‰tverstellt" UWORD B_TRUE 1 100 0 1 BIT_MASK 0x200 FORMAT "%13.11" ECU_ADDRESS 0x7FC9B6 /end MEASUREMENT
/begin MEASUREMENT B_mnnwkwa2 "Fehlerart: Auslassnockenwelle Bank 2 sp‰tverstellt" UWORD B_TRUE 1 100 0 1 BIT_MASK 0x200 FORMAT "%13.11" ECU_ADDRESS 0x7FC9B8 /end MEASUREMENT
/begin MEASUREMENT B_mnnwkwe "Fehlerart: Einlassnockenwelle sp‰tverstellt" UWORD B_TRUE 1 100 0 1 BIT_MASK 0x200 FORMAT "%13.11" ECU_ADDRESS 0x7FC9BA /end MEASUREMENT
/begin MEASUREMENT B_mnnwkwe2 "Fehlerart: Einlassnockenwelle Bank 2 sp‰tverstellt" UWORD B_TRUE 1 100 0 1 BIT_MASK 0x200 FORMAT "%13.11" ECU_ADDRESS 0x7FC9BC /end MEASUREMENT
/begin MEASUREMENT B_mnstae "Fehlertype: Kurzschluﬂ nach Masse Endstufe Start Relais" UWORD B_TRUE 1 100 0 1 BIT_MASK 0x200 FORMAT "%13.11" ECU_ADDRESS 0x7FC9E8 /end MEASUREMENT
/begin MEASUREMENT B_mnsue "Fehlerart: Kurzschluﬂ Masse an Endstufe f¸r Saugrohrumschaltung" UWORD B_TRUE 1 100 0 1 BIT_MASK 0x200 FORMAT "%13.11" ECU_ADDRESS 0x7FC9EA /end MEASUREMENT
/begin MEASUREMENT B_mntmki "Bedingung: Min-Fehler Motortemperatur aus Kombiinstrument" UWORD B_TRUE 1 100 0 1 BIT_MASK 0x200 FORMAT "%13.11" ECU_ADDRESS 0x7FCA04 /end MEASUREMENT
/begin MEASUREMENT B_mntum "Fehlertyp: Minimalwertunterschreitung Umgebungstemperatur" UWORD B_TRUE 1 100 0 1 BIT_MASK 0x200 FORMAT "%13.11" ECU_ADDRESS 0x7FCA08 /end MEASUREMENT
/begin MEASUREMENT B_mnvfz "Fehlertyp min,: Fahrzeuggeschwindigkeit" UWORD B_TRUE 1 100 0 1 BIT_MASK 0x200 FORMAT "%13.11" ECU_ADDRESS 0x7FCA24 /end MEASUREMENT
/begin MEASUREMENT B_mxbrems "Fehlertyp BREMS (Bremsschalter): Maximalwert ¸berschritten" UWORD B_TRUE 1 100 0 1 BIT_MASK 0x100 FORMAT "%13.11" ECU_ADDRESS 0x7FC8AE /end MEASUREMENT
/begin MEASUREMENT B_mxcat "Fehlertyp max.: CAN-Schnittstelle, Timeout ASR" UWORD B_TRUE 1 100 0 1 BIT_MASK 0x100 FORMAT "%13.11" ECU_ADDRESS 0x7FC8B4 /end MEASUREMENT
/begin MEASUREMENT B_mxcif "Fehlertyp max.: CAN-Schnittstelle, interner Fehler            2" UWORD B_TRUE 1 100 0 1 BIT_MASK 0x100 FORMAT "%13.11" ECU_ADDRESS 0x7FC8B8 /end MEASUREMENT
/begin MEASUREMENT B_mxfhsh "Kurzschluﬂ Heizung Lambdasonde hinter Kat nach UB" UBYTE B_TRUE 1 100 0 1 BIT_MASK 0x2 FORMAT "%13.11" ECU_ADDRESS 0x8008AA /end MEASUREMENT
/begin MEASUREMENT B_mxfhsh2 "Kurzschluﬂ Heizung Lambdasonde2 hinter Kat nach UB" UBYTE B_TRUE 1 100 0 1 BIT_MASK 0x2 FORMAT "%13.11" ECU_ADDRESS 0x8008AB /end MEASUREMENT
/begin MEASUREMENT B_mxhshe "Kurzschluﬂ Heizung Lambdasonde hinter Kat nach UB (Endstufe)" UWORD B_TRUE 1 100 0 1 BIT_MASK 0x100 FORMAT "%13.11" ECU_ADDRESS 0x7FC92A /end MEASUREMENT
/begin MEASUREMENT B_mxhshe2 "Kurzschluﬂ Heizung Lambdasonde2 hinter Kat nach UB (Endstufe)" UWORD B_TRUE 1 100 0 1 BIT_MASK 0x100 FORMAT "%13.11" ECU_ADDRESS 0x7FC92C /end MEASUREMENT
/begin MEASUREMENT B_mxhsvsa "Max-Fehler erkannt" UWORD B_TRUE 1 100 0 1 BIT_MASK 0x100 FORMAT "%13.11" ECU_ADDRESS 0x7FC936 /end MEASUREMENT
/begin MEASUREMENT B_mxhsvsa2 "Max-Fehler erkannt Bank 2" UWORD B_TRUE 1 100 0 1 BIT_MASK 0x100 FORMAT "%13.11" ECU_ADDRESS 0x7FC938 /end MEASUREMENT
/begin MEASUREMENT B_mxkuppl "Fehlertyp KUPPL: Maximalwert ¸berschritten" UWORD B_TRUE 1 100 0 1 BIT_MASK 0x100 FORMAT "%13.11" ECU_ADDRESS 0x7FC952 /end MEASUREMENT
/begin MEASUREMENT B_mxlfse "" UWORD B_TRUE 1 100 0 1 BIT_MASK 0x100 FORMAT "%13.11" ECU_ADDRESS 0x7FC966 /end MEASUREMENT
/begin MEASUREMENT B_mxlsvv "MAX-Fehler: Vertauschte Lambda-Sonden" UWORD B_TRUE 1 100 0 1 BIT_MASK 0x100 FORMAT "%13.11" ECU_ADDRESS 0x7FC980 /end MEASUREMENT
/begin MEASUREMENT B_mxluea "Fehlertype: Kurzschluﬂ nach Ubat Endstufe Motor L¸fter A" UWORD B_TRUE 1 100 0 1 BIT_MASK 0x100 FORMAT "%13.11" ECU_ADDRESS 0x7FC982 /end MEASUREMENT
/begin MEASUREMENT B_mxlueb "Fehlertype: Kurzschluﬂ nach Ubat Endstufe Motor L¸fter B" UWORD B_TRUE 1 100 0 1 BIT_MASK 0x100 FORMAT "%13.11" ECU_ADDRESS 0x7FC984 /end MEASUREMENT
/begin MEASUREMENT B_mxluec "Fehlertype: Kurzschluﬂ nach Ubat Endstufe Motor L¸fter C" UWORD B_TRUE 1 100 0 1 BIT_MASK 0x100 FORMAT "%13.11" ECU_ADDRESS 0x7FC986 /end MEASUREMENT
/begin MEASUREMENT B_mxmile "Fehlerart: Kurzschluﬂ Ubat an MIL-Endstufe" UWORD B_TRUE 1 100 0 1 BIT_MASK 0x100 FORMAT "%13.11" ECU_ADDRESS 0x7FC9AA /end MEASUREMENT
/begin MEASUREMENT B_mxmld "Bedingung obere Plausibilit‰tsschwelle (Luftmassenvergleich) HFM ¸berschritten" UBYTE B_TRUE 1 100 0 1 BIT_MASK 0x1 FORMAT "%13.11" ECU_ADDRESS 0x7FA624 /end MEASUREMENT
/begin MEASUREMENT B_mxnwkw "Fehlerart: Nockenwelle fr¸hverstellt" UWORD B_TRUE 1 100 0 1 BIT_MASK 0x100 FORMAT "%13.11" ECU_ADDRESS 0x7FC9AE /end MEASUREMENT
/begin MEASUREMENT B_mxnwkw2 "Fehlerart: Nockenwelle 2 fr¸hverstellt" UWORD B_TRUE 1 100 0 1 BIT_MASK 0x100 FORMAT "%13.11" ECU_ADDRESS 0x7FC9B0 /end MEASUREMENT
/begin MEASUREMENT B_mxnwkw3 "Fehlerart: Nockenwelle 3 fr¸hverstellt" UWORD B_TRUE 1 100 0 1 BIT_MASK 0x100 FORMAT "%13.11" ECU_ADDRESS 0x7FC9B2 /end MEASUREMENT
/begin MEASUREMENT B_mxnwkw4 "Fehlerart: Nockenwelle 4 fr¸hverstellt" UWORD B_TRUE 1 100 0 1 BIT_MASK 0x100 FORMAT "%13.11" ECU_ADDRESS 0x7FC9B4 /end MEASUREMENT
/begin MEASUREMENT B_mxnwkwa "Fehlerart: Auslassnockenwelle  fr¸hverstellt" UWORD B_TRUE 1 100 0 1 BIT_MASK 0x100 FORMAT "%13.11" ECU_ADDRESS 0x7FC9B6 /end MEASUREMENT
/begin MEASUREMENT B_mxnwkwa2 "Fehlerart: Auslassnockenwelle Bank 2  fr¸hverstellt" UWORD B_TRUE 1 100 0 1 BIT_MASK 0x100 FORMAT "%13.11" ECU_ADDRESS 0x7FC9B8 /end MEASUREMENT
/begin MEASUREMENT B_mxnwkwe "Fehlerart: Einlassnockenwelle fr¸hverstellt" UWORD B_TRUE 1 100 0 1 BIT_MASK 0x100 FORMAT "%13.11" ECU_ADDRESS 0x7FC9BA /end MEASUREMENT
/begin MEASUREMENT B_mxnwkwe2 "Fehlerart: Einlassnockenwelle Bank 2 fr¸hverstellt" UWORD B_TRUE 1 100 0 1 BIT_MASK 0x100 FORMAT "%13.11" ECU_ADDRESS 0x7FC9BC /end MEASUREMENT
/begin MEASUREMENT B_mxstae "Fehlertype: Kurzschluﬂ nach Ubatt Endstufe Start Relais" UWORD B_TRUE 1 100 0 1 BIT_MASK 0x100 FORMAT "%13.11" ECU_ADDRESS 0x7FC9E8 /end MEASUREMENT
/begin MEASUREMENT B_mxsue "Fehlerart: Kurzschluﬂ Ubat an Endstufe f¸r Saugrohrumschaltung" UWORD B_TRUE 1 100 0 1 BIT_MASK 0x100 FORMAT "%13.11" ECU_ADDRESS 0x7FC9EA /end MEASUREMENT
/begin MEASUREMENT B_mxtmki "Bedingung: Max-Fehler Motortemperatur aus Kombiinstrument" UWORD B_TRUE 1 100 0 1 BIT_MASK 0x100 FORMAT "%13.11" ECU_ADDRESS 0x7FCA04 /end MEASUREMENT
/begin MEASUREMENT B_mxtum "Fehlertyp: Maximalwert¸berschreitung Umgebungstemperatur" UWORD B_TRUE 1 100 0 1 BIT_MASK 0x100 FORMAT "%13.11" ECU_ADDRESS 0x7FCA08 /end MEASUREMENT
/begin MEASUREMENT B_mxvfz "Fehlertyp max.: Fahrzeuggeschwindigkeit" UWORD B_TRUE 1 100 0 1 BIT_MASK 0x100 FORMAT "%13.11" ECU_ADDRESS 0x7FCA24 /end MEASUREMENT
/begin MEASUREMENT B_npbrems "Fehlertyp BREMS (Bremsschalter): Pr¸fresultat nicht plausibel" UWORD B_TRUE 1 100 0 1 BIT_MASK 0x800 FORMAT "%13.11" ECU_ADDRESS 0x7FC8AE /end MEASUREMENT
/begin MEASUREMENT B_npcat "Fehlertyp: CAN-Schnittstelle Timeout ASR" UWORD B_TRUE 1 100 0 1 BIT_MASK 0x800 FORMAT "%13.11" ECU_ADDRESS 0x7FC8B4 /end MEASUREMENT
/begin MEASUREMENT B_npcif "Fehlertyp: nicht plausibles Signal vom CAN (bus-off)" UWORD B_TRUE 1 100 0 1 BIT_MASK 0x800 FORMAT "%13.11" ECU_ADDRESS 0x7FC8B8 /end MEASUREMENT
/begin MEASUREMENT B_npfhsh "Nernstwiderstand Sonde hinter Kat zu groﬂ" UBYTE B_TRUE 1 100 0 1 BIT_MASK 0x10 FORMAT "%13.11" ECU_ADDRESS 0x8008AA /end MEASUREMENT
/begin MEASUREMENT B_npfhsh2 "Nernstwiderstand Sonde 2 hinter Kat zu groﬂ" UBYTE B_TRUE 1 100 0 1 BIT_MASK 0x10 FORMAT "%13.11" ECU_ADDRESS 0x8008AB /end MEASUREMENT
/begin MEASUREMENT B_nphshe "Nicht plausibler Fehler: Lambda-Sonden Heizung hinter Kat. (Endstufe)" UWORD B_TRUE 1 100 0 1 BIT_MASK 0x800 FORMAT "%13.11" ECU_ADDRESS 0x7FC92A /end MEASUREMENT
/begin MEASUREMENT B_nphshe2 "Nicht plausibler Fehler: Lambda-Sonden Heizung 2 hinter Kat. (Endstufe)" UWORD B_TRUE 1 100 0 1 BIT_MASK 0x800 FORMAT "%13.11" ECU_ADDRESS 0x7FC92C /end MEASUREMENT
/begin MEASUREMENT B_nphsvsa "  reduzierte  LSU-Heizung oder LSU-Kennlinie abgeflacht" UWORD B_TRUE 1 100 0 1 BIT_MASK 0x800 FORMAT "%13.11" ECU_ADDRESS 0x7FC936 /end MEASUREMENT
/begin MEASUREMENT B_nphsvsa2 "  reduzierte  LSU_2-Heizung oder LSU_2-Kennlinie abgeflacht" UWORD B_TRUE 1 100 0 1 BIT_MASK 0x800 FORMAT "%13.11" ECU_ADDRESS 0x7FC938 /end MEASUREMENT
/begin MEASUREMENT B_npkuppl "Fehlertyp KUPPL: Pr¸fresultat nicht plausibel" UWORD B_TRUE 1 100 0 1 BIT_MASK 0x800 FORMAT "%13.11" ECU_ADDRESS 0x7FC952 /end MEASUREMENT
/begin MEASUREMENT B_nplfse "" UWORD B_TRUE 1 100 0 1 BIT_MASK 0x800 FORMAT "%13.11" ECU_ADDRESS 0x7FC966 /end MEASUREMENT
/begin MEASUREMENT B_nplsvv "Plausibilit‰ts-Fehler: Vertauschte Lambda-Sonden" UWORD B_TRUE 1 100 0 1 BIT_MASK 0x800 FORMAT "%13.11" ECU_ADDRESS 0x7FC980 /end MEASUREMENT
/begin MEASUREMENT B_npluea "Bedingung: Endstufe Motor-L¸fter A  Fehlertype nicht plausibel" UWORD B_TRUE 1 100 0 1 BIT_MASK 0x800 FORMAT "%13.11" ECU_ADDRESS 0x7FC982 /end MEASUREMENT
/begin MEASUREMENT B_nplueb "Bedingung: Endstufe Motor-L¸fter B  Fehlertype nicht plausibel" UWORD B_TRUE 1 100 0 1 BIT_MASK 0x800 FORMAT "%13.11" ECU_ADDRESS 0x7FC984 /end MEASUREMENT
/begin MEASUREMENT B_npluec "Bedingung: Endstufe Motor-L¸fter C  Fehlertype nicht plausibel" UWORD B_TRUE 1 100 0 1 BIT_MASK 0x800 FORMAT "%13.11" ECU_ADDRESS 0x7FC986 /end MEASUREMENT
/begin MEASUREMENT B_npmile "Fehlerart: Zustand nicht plausibel an MIL-Endstufe" UWORD B_TRUE 1 100 0 1 BIT_MASK 0x800 FORMAT "%13.11" ECU_ADDRESS 0x7FC9AA /end MEASUREMENT
/begin MEASUREMENT B_npnwkw "Nicht plausibler Fehler: Zuordnung Nockenwelle zu Kurbelwelle" UWORD B_TRUE 1 100 0 1 BIT_MASK 0x800 FORMAT "%13.11" ECU_ADDRESS 0x7FC9AE /end MEASUREMENT
/begin MEASUREMENT B_npnwkw2 "Nicht plausibler Fehler: Zuordnung Nockenwelle 2 zu Kurbelwelle" UWORD B_TRUE 1 100 0 1 BIT_MASK 0x800 FORMAT "%13.11" ECU_ADDRESS 0x7FC9B0 /end MEASUREMENT
/begin MEASUREMENT B_npnwkw3 "Nicht plausibler Fehler: Zuordnung Nockenwelle 3 zu Kurbelwelle" UWORD B_TRUE 1 100 0 1 BIT_MASK 0x800 FORMAT "%13.11" ECU_ADDRESS 0x7FC9B2 /end MEASUREMENT
/begin MEASUREMENT B_npnwkw4 "Nicht plausibler Fehler: Zuordnung Nockenwelle 4 zu Kurbelwelle" UWORD B_TRUE 1 100 0 1 BIT_MASK 0x800 FORMAT "%13.11" ECU_ADDRESS 0x7FC9B4 /end MEASUREMENT
/begin MEASUREMENT B_npnwkwa "Nicht plausibler Fehler: Zuordnung Auslassnockenwelle  zur Kurbelwelle" UWORD B_TRUE 1 100 0 1 BIT_MASK 0x800 FORMAT "%13.11" ECU_ADDRESS 0x7FC9B6 /end MEASUREMENT
/begin MEASUREMENT B_npnwkwa2 "Nicht plausibler Fehler: Zuordnung Auslassnockenwelle2  zur Kurbelwelle" UWORD B_TRUE 1 100 0 1 BIT_MASK 0x800 FORMAT "%13.11" ECU_ADDRESS 0x7FC9B8 /end MEASUREMENT
/begin MEASUREMENT B_npnwkwe "Nicht plausibler Fehler: Zuordnung Einlassnockenwelle zur Kurbelwelle" UWORD B_TRUE 1 100 0 1 BIT_MASK 0x800 FORMAT "%13.11" ECU_ADDRESS 0x7FC9BA /end MEASUREMENT
/begin MEASUREMENT B_npnwkwe2 "Nicht plausibler Fehler: Zuordnung Einlassnockenwelle Bank 2 zur Kurbelwelle" UWORD B_TRUE 1 100 0 1 BIT_MASK 0x800 FORMAT "%13.11" ECU_ADDRESS 0x7FC9BC /end MEASUREMENT
/begin MEASUREMENT B_npstae "Bedingung f¸r Fehlertyp ""Wert bunplausibel"" f¸r Starter Relais Endstufe erkannt" UWORD B_TRUE 1 100 0 1 BIT_MASK 0x800 FORMAT "%13.11" ECU_ADDRESS 0x7FC9E8 /end MEASUREMENT
/begin MEASUREMENT B_npsue "Nicht plausibler Fehler: Saugrohrumschaltung Endstufe" UWORD B_TRUE 1 100 0 1 BIT_MASK 0x800 FORMAT "%13.11" ECU_ADDRESS 0x7FC9EA /end MEASUREMENT
/begin MEASUREMENT B_nptmki "Bedingung: Unplausible Motortemperatur aus Kombiinstrument" UWORD B_TRUE 1 100 0 1 BIT_MASK 0x800 FORMAT "%13.11" ECU_ADDRESS 0x7FCA04 /end MEASUREMENT
/begin MEASUREMENT B_nptum "Fehlerart: Signal Umgebungstemperatur unplausibel" UWORD B_TRUE 1 100 0 1 BIT_MASK 0x800 FORMAT "%13.11" ECU_ADDRESS 0x7FCA08 /end MEASUREMENT
/begin MEASUREMENT B_npvfz "Fehlerart: Fahrzeuggeschwindigkeit nicht plausibel" UWORD B_TRUE 1 100 0 1 BIT_MASK 0x800 FORMAT "%13.11" ECU_ADDRESS 0x7FCA24 /end MEASUREMENT
/begin MEASUREMENT B_ricalf "Bedingung Kalibrierwiderstand nicht im Sollband" UBYTE B_TRUE 1 100 0 1 BIT_MASK 0x2 FORMAT "%13.11" ECU_ADDRESS 0x80117B /end MEASUREMENT
/begin MEASUREMENT B_ricalf2 "Bedingung Kalibrierwiderstand nicht im Sollband, Bank 2" UBYTE B_TRUE 1 100 0 1 BIT_MASK 0x8 FORMAT "%13.11" ECU_ADDRESS 0x80117B /end MEASUREMENT
/begin MEASUREMENT B_rinnp "Bedingung RI der LSU ist nicht plausibel" UBYTE B_TRUE 1 100 0 1 BIT_MASK 0x1 FORMAT "%13.11" ECU_ADDRESS 0x80117C /end MEASUREMENT
/begin MEASUREMENT B_rinnp2 "Bedingung RI der LSU ist nicht plausibel, Bank 2" UBYTE B_TRUE 1 100 0 1 BIT_MASK 0x1 FORMAT "%13.11" ECU_ADDRESS 0x80117D /end MEASUREMENT
/begin MEASUREMENT B_sibrems "Fehlertyp BREMS (Bremsschalter): Signal inaktiv" UWORD B_TRUE 1 100 0 1 BIT_MASK 0x400 FORMAT "%13.11" ECU_ADDRESS 0x7FC8AE /end MEASUREMENT
/begin MEASUREMENT B_sicat "Fehlertyp: ASR/MSR Codierfehler" UWORD B_TRUE 1 100 0 1 BIT_MASK 0x400 FORMAT "%13.11" ECU_ADDRESS 0x7FC8B4 /end MEASUREMENT
/begin MEASUREMENT B_sicif "Signalfehler CAN-Schnittstelle (Bus off)" UWORD B_TRUE 1 100 0 1 BIT_MASK 0x400 FORMAT "%13.11" ECU_ADDRESS 0x7FC8B8 /end MEASUREMENT
/begin MEASUREMENT B_sifhsh "Lastabfall Sondenheizung hinter Kat" UBYTE B_TRUE 1 100 0 1 BIT_MASK 0x8 FORMAT "%13.11" ECU_ADDRESS 0x8008AA /end MEASUREMENT
/begin MEASUREMENT B_sifhsh2 "Lastabfall Sondenheizung2 hinter Kat" UBYTE B_TRUE 1 100 0 1 BIT_MASK 0x8 FORMAT "%13.11" ECU_ADDRESS 0x8008AB /end MEASUREMENT
/begin MEASUREMENT B_sihshe "Lastabfall Sondenheizung hinter Kat (Endstufe)" UWORD B_TRUE 1 100 0 1 BIT_MASK 0x400 FORMAT "%13.11" ECU_ADDRESS 0x7FC92A /end MEASUREMENT
/begin MEASUREMENT B_sihshe2 "Lastabfall Sondenheizung2 hinter Kat (Endstufe)" UWORD B_TRUE 1 100 0 1 BIT_MASK 0x400 FORMAT "%13.11" ECU_ADDRESS 0x7FC92C /end MEASUREMENT
/begin MEASUREMENT B_sihsvsa "Signal - Fehler erkannt" UWORD B_TRUE 1 100 0 1 BIT_MASK 0x400 FORMAT "%13.11" ECU_ADDRESS 0x7FC936 /end MEASUREMENT
/begin MEASUREMENT B_sihsvsa2 "Signal - Fehler erkannt Bank 2" UWORD B_TRUE 1 100 0 1 BIT_MASK 0x400 FORMAT "%13.11" ECU_ADDRESS 0x7FC938 /end MEASUREMENT
/begin MEASUREMENT B_sikuppl "Fehlertyp KUPPL: Signal inaktiv" UWORD B_TRUE 1 100 0 1 BIT_MASK 0x400 FORMAT "%13.11" ECU_ADDRESS 0x7FC952 /end MEASUREMENT
/begin MEASUREMENT B_silfse "" UWORD B_TRUE 1 100 0 1 BIT_MASK 0x400 FORMAT "%13.11" ECU_ADDRESS 0x7FC966 /end MEASUREMENT
/begin MEASUREMENT B_silsvv "Signal-Fehler: Vertauschte Lambda-Sonden" UWORD B_TRUE 1 100 0 1 BIT_MASK 0x400 FORMAT "%13.11" ECU_ADDRESS 0x7FC980 /end MEASUREMENT
/begin MEASUREMENT B_siluea "Fehlertype: Leitungsabfall Endstufe Motor L¸fter A" UWORD B_TRUE 1 100 0 1 BIT_MASK 0x400 FORMAT "%13.11" ECU_ADDRESS 0x7FC982 /end MEASUREMENT
/begin MEASUREMENT B_silueb "Fehlertype: Leitungsabfall Endstufe Motor L¸fter B" UWORD B_TRUE 1 100 0 1 BIT_MASK 0x400 FORMAT "%13.11" ECU_ADDRESS 0x7FC984 /end MEASUREMENT
/begin MEASUREMENT B_siluec "Fehlertype: Leitungsabfall Endstufe Motor L¸fter B" UWORD B_TRUE 1 100 0 1 BIT_MASK 0x400 FORMAT "%13.11" ECU_ADDRESS 0x7FC986 /end MEASUREMENT
/begin MEASUREMENT B_simile "Fehlerart: Unterbrechung an MIL-Endstufe" UWORD B_TRUE 1 100 0 1 BIT_MASK 0x400 FORMAT "%13.11" ECU_ADDRESS 0x7FC9AA /end MEASUREMENT
/begin MEASUREMENT B_sinwkw "Fehlertyp: Zuordnung Nockenwelle zu Kurbelwelle" UWORD B_TRUE 1 100 0 1 BIT_MASK 0x400 FORMAT "%13.11" ECU_ADDRESS 0x7FC9AE /end MEASUREMENT
/begin MEASUREMENT B_sinwkw2 "Fehlertyp: Zuordnung Nockenwelle 2 zu Kurbelwelle" UWORD B_TRUE 1 100 0 1 BIT_MASK 0x400 FORMAT "%13.11" ECU_ADDRESS 0x7FC9B0 /end MEASUREMENT
/begin MEASUREMENT B_sinwkw3 "Fehlertyp: Zuordnung Nockenwelle 3 zu Kurbelwelle" UWORD B_TRUE 1 100 0 1 BIT_MASK 0x400 FORMAT "%13.11" ECU_ADDRESS 0x7FC9B2 /end MEASUREMENT
/begin MEASUREMENT B_sinwkw4 "Fehlertyp: Zuordnung Nockenwelle 4 zu Kurbelwelle" UWORD B_TRUE 1 100 0 1 BIT_MASK 0x400 FORMAT "%13.11" ECU_ADDRESS 0x7FC9B4 /end MEASUREMENT
/begin MEASUREMENT B_sinwkwa "Fehlertyp: Zuordnung Auslassnockenwelle zur Kurbelwelle" UWORD B_TRUE 1 100 0 1 BIT_MASK 0x400 FORMAT "%13.11" ECU_ADDRESS 0x7FC9B6 /end MEASUREMENT
/begin MEASUREMENT B_sinwkwa2 "Fehlertyp: Zuordnung Auslassnockenwelle Bank 2 zur Kurbelwelle" UWORD B_TRUE 1 100 0 1 BIT_MASK 0x400 FORMAT "%13.11" ECU_ADDRESS 0x7FC9B8 /end MEASUREMENT
/begin MEASUREMENT B_sinwkwe "Fehlertyp: Zuordnung Einlassnockenwelle zur Kurbelwelle" UWORD B_TRUE 1 100 0 1 BIT_MASK 0x400 FORMAT "%13.11" ECU_ADDRESS 0x7FC9BA /end MEASUREMENT
/begin MEASUREMENT B_sinwkwe2 "Fehlertyp: Zuordnung Einlassnockenwelle Bank 2 zur Kurbelwelle" UWORD B_TRUE 1 100 0 1 BIT_MASK 0x400 FORMAT "%13.11" ECU_ADDRESS 0x7FC9BC /end MEASUREMENT
/begin MEASUREMENT B_sistae "Fehlertype: Leitungsabfall Endstufe Start Relais" UWORD B_TRUE 1 100 0 1 BIT_MASK 0x400 FORMAT "%13.11" ECU_ADDRESS 0x7FC9E8 /end MEASUREMENT
/begin MEASUREMENT B_sisue "Fehlerart: Leitungsabfall  an Endstufe f¸r Saugrohrumschaltung" UWORD B_TRUE 1 100 0 1 BIT_MASK 0x400 FORMAT "%13.11" ECU_ADDRESS 0x7FC9EA /end MEASUREMENT
/begin MEASUREMENT B_sitmki "Signalfehler K¸hlmitteltemperatur vom Kombiinstrument" UWORD B_TRUE 1 100 0 1 BIT_MASK 0x400 FORMAT "%13.11" ECU_ADDRESS 0x7FCA04 /end MEASUREMENT
/begin MEASUREMENT B_situm "Fehlerart: Signal Umgebungstemperatur inaktiv" UWORD B_TRUE 1 100 0 1 BIT_MASK 0x400 FORMAT "%13.11" ECU_ADDRESS 0x7FCA08 /end MEASUREMENT
/begin MEASUREMENT B_sivfz "Bedingung fehlendes Signal Fahrzeuggeschwindigkeit" UWORD B_TRUE 1 100 0 1 BIT_MASK 0x400 FORMAT "%13.11" ECU_ADDRESS 0x7FCA24 /end MEASUREMENT
/begin MEASUREMENT B_slsrdy "Bedingung SLS gepr¸ft f¸r 'ready-Byte'" UBYTE B_TRUE 1 100 0 1 BIT_MASK 0x8 FORMAT "%13.11" ECU_ADDRESS 0x7FC383 /end MEASUREMENT
/begin MEASUREMENT B_spdhrub "Bedingung Sperrung Diagnose DHRLSU wegen Spannungsversorgung" UBYTE B_TRUE 1 100 0 1 BIT_MASK 0x8 FORMAT "%13.11" ECU_ADDRESS 0x80117C /end MEASUREMENT
/begin MEASUREMENT B_tahrmn "Bedingung korregiertes Tastverh‰ltnis < Min-Schwelle f¸r l‰ngere Zeit" UBYTE B_TRUE 1 100 0 1 BIT_MASK 0x2 FORMAT "%13.11" ECU_ADDRESS 0x80117C /end MEASUREMENT
/begin MEASUREMENT B_tahrmn2 "Bedingung korregiertes Tastverh‰ltnis < Min.-Schwelle f¸r l‰ngere Zeit, Bank 2" UBYTE B_TRUE 1 100 0 1 BIT_MASK 0x2 FORMAT "%13.11" ECU_ADDRESS 0x80117D /end MEASUREMENT
/begin MEASUREMENT B_tahrmx "Bedingung korregiertes Tastverh‰ltnis =100% f¸r l‰ngere Zeit" UBYTE B_TRUE 1 100 0 1 BIT_MASK 0x4 FORMAT "%13.11" ECU_ADDRESS 0x80117C /end MEASUREMENT
/begin MEASUREMENT B_tahrmx2 "Bedingung korregiertes Tastverh‰ltnis =100% f¸r l‰ngere Zeit, Bank 2" UBYTE B_TRUE 1 100 0 1 BIT_MASK 0x4 FORMAT "%13.11" ECU_ADDRESS 0x80117D /end MEASUREMENT
/begin MEASUREMENT B_tank "Bedingung Tankvorgang" UBYTE B_TRUE 1 100 0 1 BIT_MASK 0x8 FORMAT "%13.11" ECU_ADDRESS 0x800C28 /end MEASUREMENT
/begin MEASUREMENT B_tesrdy "Bedingung TES gepr¸ft f¸r 'ready-Byte'" UBYTE B_TRUE 1 100 0 1 BIT_MASK 0x4 FORMAT "%13.11" ECU_ADDRESS 0x7FC383 /end MEASUREMENT
/begin MEASUREMENT cryhs "Counter f¸r Readinessbildung Sondenheizungs-Diagnose" UBYTE dez 1 100 0 255 FORMAT "%5.1" ECU_ADDRESS 0x7FC37E /end MEASUREMENT
/begin MEASUREMENT crykat "Counter f¸r Readinessbildung Katalysator-Diagnose" UBYTE dez 1 100 0 255 FORMAT "%5.1" ECU_ADDRESS 0x7FC37F /end MEASUREMENT
/begin MEASUREMENT cryls "Counter f¸r Readinessbildung Lambdasonden-Diagnose" UBYTE dez 1 100 0 255 FORMAT "%5.1" ECU_ADDRESS 0x7FC380 /end MEASUREMENT
/begin MEASUREMENT crysls "Counter f¸r Readinessbildung Sekund‰rluft-Diagnose" UBYTE dez 1 100 0 255 FORMAT "%5.1" ECU_ADDRESS 0x7FC381 /end MEASUREMENT
/begin MEASUREMENT crytes "Counter f¸r Readinessbildung Tankentl¸ftungs-Diagnose" UBYTE dez 1 100 0 255 FORMAT "%5.1" ECU_ADDRESS 0x7FC382 /end MEASUREMENT
/begin MEASUREMENT dfskv_w "Differenz verbrauchter Kraftstoff - Fuellstandsdifferenz" SWORD vol_q0p1_l 1 100 -3276.8 3276.7 FORMAT "%8.3" ECU_ADDRESS 0x800C2A /end MEASUREMENT
/begin MEASUREMENT DFSTTausbits "" UBYTE dez 1 100 0 255 FORMAT "%5.1" ECU_ADDRESS 0x800C28 /end MEASUREMENT
/begin MEASUREMENT DFSTTlokBits "" UWORD dez 1 100 0 65535 FORMAT "%8.2" ECU_ADDRESS 0x800C2C /end MEASUREMENT
/begin MEASUREMENT DFSTTlokBitsA "" UBYTE dez 1 100 0 255 FORMAT "%5.1" ECU_ADDRESS 0x7FC7B8 /end MEASUREMENT
/begin MEASUREMENT dfstt_w "Differenz Fuellstand Kraftstofftank" SWORD vol_q0p1_l 1 100 -3276.8 3276.7 FORMAT "%8.3" ECU_ADDRESS 0x800C2E /end MEASUREMENT
/begin MEASUREMENT DHRLSUausbits1 "" UBYTE dez 1 100 0 255 FORMAT "%5.1" ECU_ADDRESS 0x80117B /end MEASUREMENT
/begin MEASUREMENT DHRLSUlokbits1 "" UBYTE dez 1 100 0 255 FORMAT "%5.1" ECU_ADDRESS 0x80117C /end MEASUREMENT
/begin MEASUREMENT DHRLSUlokbits1_2 "" UBYTE dez 1 100 0 255 FORMAT "%5.1" ECU_ADDRESS 0x80117D /end MEASUREMENT
/begin MEASUREMENT diagtime "" UBYTE dez 1 100 0 255 FORMAT "%5.1" ECU_ADDRESS 0x800EC6 /end MEASUREMENT
/begin MEASUREMENT dkvb_w "Differenz verbrauchter Kraftstoff" SWORD vol_q0p1_l 1 100 -3276.8 3276.7 FORMAT "%8.3" ECU_ADDRESS 0x7FC7BA /end MEASUREMENT
/begin MEASUREMENT EAS_lsp1hk "" UBYTE B_TRUE 1 100 0 1 BIT_MASK 0x1 FORMAT "%13.11" ECU_ADDRESS 0x7FA96C /end MEASUREMENT
/begin MEASUREMENT EAS_lsp1ik "" UBYTE B_TRUE 1 100 0 1 BIT_MASK 0x1 FORMAT "%13.11" ECU_ADDRESS 0x7FA96D /end MEASUREMENT
/begin MEASUREMENT EAS_lsp2hk "" UBYTE B_TRUE 1 100 0 1 BIT_MASK 0x1 FORMAT "%13.11" ECU_ADDRESS 0x7FA96E /end MEASUREMENT
/begin MEASUREMENT EAS_lsp2ik "" UBYTE B_TRUE 1 100 0 1 BIT_MASK 0x1 FORMAT "%13.11" ECU_ADDRESS 0x7FA96F /end MEASUREMENT
/begin MEASUREMENT ebCtrNewT "" UBYTE dez 1 100 0 255 FORMAT "%5.1" ECU_ADDRESS 0x801055 /end MEASUREMENT
/begin MEASUREMENT ebCtrNewY "" UBYTE dez 1 100 0 255 FORMAT "%5.1" ECU_ADDRESS 0x801056 /end MEASUREMENT
/begin MEASUREMENT ebCtrOldT "" UBYTE dez 1 100 0 255 FORMAT "%5.1" ECU_ADDRESS 0x801057 /end MEASUREMENT
/begin MEASUREMENT ebCtrOldY "" UBYTE dez 1 100 0 255 FORMAT "%5.1" ECU_ADDRESS 0x801058 /end MEASUREMENT
/begin MEASUREMENT ebMissT "" UWORD dez 1 100 0 65535 FORMAT "%8.2" ECU_ADDRESS 0x801CA4 /end MEASUREMENT
/begin MEASUREMENT ebMissY "" UWORD dez 1 100 0 65535 FORMAT "%8.2" ECU_ADDRESS 0x801CA6 /end MEASUREMENT
/begin MEASUREMENT ES_dksf "" UBYTE B_TRUE 1 100 0 1 BIT_MASK 0x1 FORMAT "%13.11" ECU_ADDRESS 0x7FA970 /end MEASUREMENT
/begin MEASUREMENT ES_kl15 "" UBYTE B_TRUE 1 100 0 1 BIT_MASK 0x1 FORMAT "%13.11" ECU_ADDRESS 0x7FA971 /end MEASUREMENT
/begin MEASUREMENT ES_res1 "" UBYTE B_TRUE 1 100 0 1 BIT_MASK 0x1 FORMAT "%13.11" ECU_ADDRESS 0x7FA972 /end MEASUREMENT
/begin MEASUREMENT ES_res2 "" UBYTE B_TRUE 1 100 0 1 BIT_MASK 0x1 FORMAT "%13.11" ECU_ADDRESS 0x7FA973 /end MEASUREMENT
/begin MEASUREMENT ES_rge "" UBYTE B_TRUE 1 100 0 1 BIT_MASK 0x1 FORMAT "%13.11" ECU_ADDRESS 0x7FA974 /end MEASUREMENT
/begin MEASUREMENT ES_sfmdk "" UBYTE B_TRUE 1 100 0 1 BIT_MASK 0x1 FORMAT "%13.11" ECU_ADDRESS 0x7FA975 /end MEASUREMENT
/begin MEASUREMENT ES_wda "" UBYTE B_TRUE 1 100 0 1 BIT_MASK 0x1 FORMAT "%13.11" ECU_ADDRESS 0x7FA976 /end MEASUREMENT
/begin MEASUREMENT evsup1 "Funktionskennungsbyte f¸r Ausgabe SAE J1979 Mode2" UBYTE dez 1 100 0 255 FORMAT "%5.1" ECU_ADDRESS 0x80115F /end MEASUREMENT
/begin MEASUREMENT E_agre "Errorflag: ‹berwachung AGR-Endstufe" UWORD B_TRUE 1 100 0 1 BIT_MASK 0x1 FORMAT "%13.11" ECU_ADDRESS 0x7FC88A /end MEASUREMENT
/begin MEASUREMENT E_agrf "Errorflag: ‹berwachung AGR-FLOW" UWORD B_TRUE 1 100 0 1 BIT_MASK 0x1 FORMAT "%13.11" ECU_ADDRESS 0x7FC88C /end MEASUREMENT
/begin MEASUREMENT E_brems "Fehlerflag: BREMS (Bremsschalter)" UWORD B_TRUE 1 100 0 1 BIT_MASK 0x1 FORMAT "%13.11" ECU_ADDRESS 0x7FC8AE /end MEASUREMENT
/begin MEASUREMENT E_cas "Errorflag: CAN-Schnittstelle, Timeout ASC" UWORD B_TRUE 1 100 0 1 BIT_MASK 0x1 FORMAT "%13.11" ECU_ADDRESS 0x7FC8B2 /end MEASUREMENT
/begin MEASUREMENT E_cat "Errorflag: CAN-Schnittstelle, Timeout Bremsbotschaft setzen" UWORD B_TRUE 1 100 0 1 BIT_MASK 0x1 FORMAT "%13.11" ECU_ADDRESS 0x7FC8B4 /end MEASUREMENT
/begin MEASUREMENT E_cge "Errorflag: CAN-Schnittstelle, Timeout EGS" UWORD B_TRUE 1 100 0 1 BIT_MASK 0x1 FORMAT "%13.11" ECU_ADDRESS 0x7FC8B6 /end MEASUREMENT
/begin MEASUREMENT E_cif "Errorflag: CAN-Schnittstelle, interner Fehler" UWORD B_TRUE 1 100 0 1 BIT_MASK 0x1 FORMAT "%13.11" ECU_ADDRESS 0x7FC8B8 /end MEASUREMENT
/begin MEASUREMENT E_cins "Errorflag: CAN-Schnittstelle, Timeout Instrument" UWORD B_TRUE 1 100 0 1 BIT_MASK 0x1 FORMAT "%13.11" ECU_ADDRESS 0x7FC8BA /end MEASUREMENT
/begin MEASUREMENT E_cszl "Errorflag: CAN-Schnittstelle, Timeout SZL" UWORD B_TRUE 1 100 0 1 BIT_MASK 0x1 FORMAT "%13.11" ECU_ADDRESS 0x7FC8BE /end MEASUREMENT
/begin MEASUREMENT E_ddss "Errorflag: Differenzdrucksensor Saugrohr" UWORD B_TRUE 1 100 0 1 BIT_MASK 0x1 FORMAT "%13.11" ECU_ADDRESS 0x7FC8C0 /end MEASUREMENT
/begin MEASUREMENT E_dmtk "Errorflag: Tankentl¸ftungssystem Grob- oder Feinleck" UWORD B_TRUE 1 100 0 1 BIT_MASK 0x1 FORMAT "%13.11" ECU_ADDRESS 0x7FC8C8 /end MEASUREMENT
/begin MEASUREMENT E_dmtknm "Errorflag: Tankentl¸ftungssystem Kleinstleck (nicht MIL on)" UWORD B_TRUE 1 100 0 1 BIT_MASK 0x1 FORMAT "%13.11" ECU_ADDRESS 0x7FC8CA /end MEASUREMENT
/begin MEASUREMENT E_dmtl "Errorflag: DMTL-Modul" UWORD B_TRUE 1 100 0 1 BIT_MASK 0x1 FORMAT "%13.11" ECU_ADDRESS 0x7FC8CC /end MEASUREMENT
/begin MEASUREMENT E_dpl "Errorflag: Dauerplus" UWORD B_TRUE 1 100 0 1 BIT_MASK 0x1 FORMAT "%13.11" ECU_ADDRESS 0x7FC8CE /end MEASUREMENT
/begin MEASUREMENT E_fan "Errorflag : Motorl¸fterdrehzahl" UWORD B_TRUE 1 100 0 1 BIT_MASK 0x1 FORMAT "%13.11" ECU_ADDRESS 0x7FC912 /end MEASUREMENT
/begin MEASUREMENT E_hshe "Errorflag: Lambdasonden-Heizung hinter Katalysator (Endstufe)" UWORD B_TRUE 1 100 0 1 BIT_MASK 0x1 FORMAT "%13.11" ECU_ADDRESS 0x7FC92A /end MEASUREMENT
/begin MEASUREMENT E_hshe2 "Errorflag: Lambdasonden-Heizung hinter Katalysator Bank 2 (Endstufe)" UWORD B_TRUE 1 100 0 1 BIT_MASK 0x1 FORMAT "%13.11" ECU_ADDRESS 0x7FC92C /end MEASUREMENT
/begin MEASUREMENT E_hsvsa "Errorflag: reduzierte  LSU-Heizung oder LSU-Kennlinie abgeflacht" UWORD B_TRUE 1 100 0 1 BIT_MASK 0x1 FORMAT "%13.11" ECU_ADDRESS 0x7FC936 /end MEASUREMENT
/begin MEASUREMENT E_hsvsa2 "Errorflag: reduzierte  LSU_2-Heizung oder LSU_2-Kennlinie abgeflacht" UWORD B_TRUE 1 100 0 1 BIT_MASK 0x1 FORMAT "%13.11" ECU_ADDRESS 0x7FC938 /end MEASUREMENT
/begin MEASUREMENT E_kuppl "Fehlerflag: Gebergrˆﬂe Kupplung" UWORD B_TRUE 1 100 0 1 BIT_MASK 0x1 FORMAT "%13.11" ECU_ADDRESS 0x7FC952 /end MEASUREMENT
/begin MEASUREMENT E_ldp "Errorflag: Leckdiagnosemodul" UWORD B_TRUE 1 100 0 1 BIT_MASK 0x1 FORMAT "%13.11" ECU_ADDRESS 0x7FC962 /end MEASUREMENT
/begin MEASUREMENT E_lfse "Errorflag: LFS-Motor Endstufe" UWORD B_TRUE 1 100 0 1 BIT_MASK 0x1 FORMAT "%13.11" ECU_ADDRESS 0x7FC966 /end MEASUREMENT
/begin MEASUREMENT E_lsvv "Errorflag: Vertauschte Lambda-Sonden vor Kat" UWORD B_TRUE 1 100 0 1 BIT_MASK 0x1 FORMAT "%13.11" ECU_ADDRESS 0x7FC980 /end MEASUREMENT
/begin MEASUREMENT E_luea "Errorflag: L¸fterendstufe A" UWORD B_TRUE 1 100 0 1 BIT_MASK 0x1 FORMAT "%13.11" ECU_ADDRESS 0x7FC982 /end MEASUREMENT
/begin MEASUREMENT E_lueb "Errorflag: L¸fterendstufe B" UWORD B_TRUE 1 100 0 1 BIT_MASK 0x1 FORMAT "%13.11" ECU_ADDRESS 0x7FC984 /end MEASUREMENT
/begin MEASUREMENT E_luec "Errorflag: L¸fterendstufe C" UWORD B_TRUE 1 100 0 1 BIT_MASK 0x1 FORMAT "%13.11" ECU_ADDRESS 0x7FC986 /end MEASUREMENT
/begin MEASUREMENT E_mfa "Errorflag: MIL-fremdbestimmt" UWORD B_TRUE 1 100 0 1 BIT_MASK 0x1 FORMAT "%13.11" ECU_ADDRESS 0x7FC9A8 /end MEASUREMENT
/begin MEASUREMENT E_mile "Fehlerflag: MIL-Endstufe" UWORD B_TRUE 1 100 0 1 BIT_MASK 0x1 FORMAT "%13.11" ECU_ADDRESS 0x7FC9AA /end MEASUREMENT
/begin MEASUREMENT E_nwkw "Errorflag: Zuordnung Nockenwelle zu Kurbelwelle" UWORD B_TRUE 1 100 0 1 BIT_MASK 0x1 FORMAT "%13.11" ECU_ADDRESS 0x7FC9AE /end MEASUREMENT
/begin MEASUREMENT E_nwkw2 "Errorflag: Zuordnung Nockenwelle 2 zu Kurbelwelle" UWORD B_TRUE 1 100 0 1 BIT_MASK 0x1 FORMAT "%13.11" ECU_ADDRESS 0x7FC9B0 /end MEASUREMENT
/begin MEASUREMENT E_nwkw3 "Errorflag: Zuordnung Nockenwelle 3 zu Kurbelwelle" UWORD B_TRUE 1 100 0 1 BIT_MASK 0x1 FORMAT "%13.11" ECU_ADDRESS 0x7FC9B2 /end MEASUREMENT
/begin MEASUREMENT E_nwkw4 "Errorflag: Zuordnung Nockenwelle 4 zu Kurbelwelle" UWORD B_TRUE 1 100 0 1 BIT_MASK 0x1 FORMAT "%13.11" ECU_ADDRESS 0x7FC9B4 /end MEASUREMENT
/begin MEASUREMENT E_nwkwa "Fehler der Zuordnung Auslassnockenwelle zur Kurbelwelle" UWORD B_TRUE 1 100 0 1 BIT_MASK 0x1 FORMAT "%13.11" ECU_ADDRESS 0x7FC9B6 /end MEASUREMENT
/begin MEASUREMENT E_nwkwa2 "Fehlerflag der Zuordnung Auslassnockenwelle Bank 2 zur Kurbelwelle" UWORD B_TRUE 1 100 0 1 BIT_MASK 0x1 FORMAT "%13.11" ECU_ADDRESS 0x7FC9B8 /end MEASUREMENT
/begin MEASUREMENT E_nwkwe "Fehler der Zuordnung Einlassnockenwelle zur Kurbelwelle" UWORD B_TRUE 1 100 0 1 BIT_MASK 0x1 FORMAT "%13.11" ECU_ADDRESS 0x7FC9BA /end MEASUREMENT
/begin MEASUREMENT E_nwkwe2 "Fehler der Zuordnung Einlassnockenwelle Bank 2 zur Kurbelwelle" UWORD B_TRUE 1 100 0 1 BIT_MASK 0x1 FORMAT "%13.11" ECU_ADDRESS 0x7FC9BC /end MEASUREMENT
/begin MEASUREMENT E_nws "Errorflag: Nockenwellensteuerung" UWORD B_TRUE 1 100 0 1 BIT_MASK 0x1 FORMAT "%13.11" ECU_ADDRESS 0x7FC9BE /end MEASUREMENT
/begin MEASUREMENT E_pddss "Errorflag: Druck Differenzdrucksensor Saugrohr" UWORD B_TRUE 1 100 0 1 BIT_MASK 0x1 FORMAT "%13.11" ECU_ADDRESS 0x7FC9C2 /end MEASUREMENT
/begin MEASUREMENT E_salsu "Errorflag: Schubabgleich LSU" UWORD B_TRUE 1 100 0 1 BIT_MASK 0x1 FORMAT "%13.11" ECU_ADDRESS 0x7FC9D8 /end MEASUREMENT
/begin MEASUREMENT E_salsu2 "Errorflag: Schubabgleich LSU, Bank 2" UWORD B_TRUE 1 100 0 1 BIT_MASK 0x1 FORMAT "%13.11" ECU_ADDRESS 0x7FC9DA /end MEASUREMENT
/begin MEASUREMENT E_slpe "Errorflag: Sekund‰rluftpumpe (Endstufe)" UWORD B_TRUE 1 100 0 1 BIT_MASK 0x1 FORMAT "%13.11" ECU_ADDRESS 0x7FC9DC /end MEASUREMENT
/begin MEASUREMENT E_slve "Errorflag: Sekund‰rluftventil (Endstufe)" UWORD B_TRUE 1 100 0 1 BIT_MASK 0x1 FORMAT "%13.11" ECU_ADDRESS 0x7FC9E6 /end MEASUREMENT
/begin MEASUREMENT E_stae "Errorflag: Startautomatik" UWORD B_TRUE 1 100 0 1 BIT_MASK 0x1 FORMAT "%13.11" ECU_ADDRESS 0x7FC9E8 /end MEASUREMENT
/begin MEASUREMENT E_sue "Errorflag: Endstufe Saugrohrumschaltung" UWORD B_TRUE 1 100 0 1 BIT_MASK 0x1 FORMAT "%13.11" ECU_ADDRESS 0x7FC9EA /end MEASUREMENT
/begin MEASUREMENT E_svsfa "Errorflag: SVS-fremdbestimmt" UWORD B_TRUE 1 100 0 1 BIT_MASK 0x1 FORMAT "%13.11" ECU_ADDRESS 0x7FC9EC /end MEASUREMENT
/begin MEASUREMENT E_tesk "Errorflag: Tankentl¸ftungssystem Kleinstleck" UWORD B_TRUE 1 100 0 1 BIT_MASK 0x1 FORMAT "%13.11" ECU_ADDRESS 0x7FC9FA /end MEASUREMENT
/begin MEASUREMENT E_tkmi "" UWORD B_TRUE 1 100 0 1 BIT_MASK 0x1 FORMAT "%13.11" ECU_ADDRESS 0x7FCA04 /end MEASUREMENT
/begin MEASUREMENT E_tum "Errorflag:  Umgebungstemperatur tumg" UWORD B_TRUE 1 100 0 1 BIT_MASK 0x1 FORMAT "%13.11" ECU_ADDRESS 0x7FCA08 /end MEASUREMENT
/begin MEASUREMENT E_tx "Errorflag: Temperatur EBOX" UWORD B_TRUE 1 100 0 1 BIT_MASK 0x1 FORMAT "%13.11" ECU_ADDRESS 0x7FCA0A /end MEASUREMENT
/begin MEASUREMENT E_uvse "Errorflag: Endstufe Umluftventil Turbo" UWORD B_TRUE 1 100 0 1 BIT_MASK 0x1 FORMAT "%13.11" ECU_ADDRESS 0x7FCA22 /end MEASUREMENT
/begin MEASUREMENT E_vfz "Errorflag: Fahrzeug-Geschwindigkeit" UWORD B_TRUE 1 100 0 1 BIT_MASK 0x1 FORMAT "%13.11" ECU_ADDRESS 0x7FCA24 /end MEASUREMENT
/begin MEASUREMENT fst1stk_w "Prim‰rtank-Kraftstoffvolumen zu Beginn der Sensordefekt-Pr¸fung" UWORD vol_q0p1_l 1 100 0 6553.5 FORMAT "%8.3" ECU_ADDRESS 0x7FC7BC /end MEASUREMENT
/begin MEASUREMENT fst2stk_w "Sekund‰rtank-Kraftstoffvolumen zu Beginn der Sensordefekt-Pr¸fung" UWORD vol_q0p1_l 1 100 0 6553.5 FORMAT "%8.3" ECU_ADDRESS 0x7FC7BE /end MEASUREMENT
/begin MEASUREMENT fstercnt "Anzahl aufeinanderfolgender erwarteter Zweitank-F¸llstands-Plausibilit‰tsfehler" UBYTE dez 1 100 0 255 FORMAT "%5.1" ECU_ADDRESS 0x7FC7B9 /end MEASUREMENT
/begin MEASUREMENT fsterr_w "aufsummierte erwartete Zweitank-F¸llstands-Plausibilit‰tsfehler" SWORD vol_q0p1_l 1 100 -3276.8 3276.7 FORMAT "%8.3" ECU_ADDRESS 0x7FC7C0 /end MEASUREMENT
/begin MEASUREMENT fstold_w "Zweitank-Kraftstoffvolumen zu Beginn der Plausbilitaetspr¸fung" UWORD vol_q0p1_l 1 100 0 6553.5 FORMAT "%8.3" ECU_ADDRESS 0x7FC7C2 /end MEASUREMENT
/begin MEASUREMENT fstpler_w "Anzahl/Betrag erwarteter Zweitank-Kraftstoffvolumen-Plausibilit‰tsfehler" SWORD vol_q0p1_l 1 100 -3276.8 3276.7 FORMAT "%8.3" ECU_ADDRESS 0x800C30 /end MEASUREMENT
/begin MEASUREMENT fwmlhfm_w "gewichteter MLHFMMN in Abh‰ngigkeit von Faktor Hˆhe" SWORD m_q0p1 1 100 -3276.8 3276.7 FORMAT "%8.3" ECU_ADDRESS 0x800574 /end MEASUREMENT
/begin MEASUREMENT kvbold_w "Verbrauchtes Kraftstoffvolumen zu Beginn der Zweitank-F¸llstands-Plaus.-pr¸fung" SWORD vol_q0p0039 1 100 -128 127.996 FORMAT "%8.4" ECU_ADDRESS 0x800C32 /end MEASUREMENT
/begin MEASUREMENT mldko_w "Luftmassenschwelle zur Erkennung Kurzschluﬂ nach 5V in DHFM" SWORD m_q0p1 1 100 -3276.8 3276.7 FORMAT "%8.3" ECU_ADDRESS 0x8013BC /end MEASUREMENT
/begin MEASUREMENT mldmn_w "minimale Luftmasse aus Kennfeld KFMLDMN" SWORD m_q0p1 1 100 -3276.8 3276.7 FORMAT "%8.3" ECU_ADDRESS 0x800576 /end MEASUREMENT
/begin MEASUREMENT mldmx_w "maximale Luftmasse aus Kennfeld KFMLDMX" SWORD m_q0p1 1 100 -3276.8 3276.7 FORMAT "%8.3" ECU_ADDRESS 0x8013BE /end MEASUREMENT
/begin MEASUREMENT mlhfmf_w "gefilterter Luftmassen HFM-Mittelwert 16Bit-Wert" SWORD m_q0p1 1 100 -3276.8 3276.7 FORMAT "%8.3" ECU_ADDRESS 0x8013C0 /end MEASUREMENT
/begin MEASUREMENT phlsnhf "normierte Heizleistung der Lambdasonde hinter Kat, gefiltert" UBYTE fak_ub_q0p01 1 100 0 2.55 FORMAT "%5.3" ECU_ADDRESS 0x8008AC /end MEASUREMENT
/begin MEASUREMENT phlsnhf2 "normierte Heizleistung der Lambdasonde 2 hinter Kat, gefiltert" UBYTE fak_ub_q0p01 1 100 0 2.55 FORMAT "%5.3" ECU_ADDRESS 0x8008AD /end MEASUREMENT
/begin MEASUREMENT ready "readiness-Byte f¸r Ausgabe SAE J1979 Mode2" UBYTE dez 1 100 0 255 FORMAT "%5.1" ECU_ADDRESS 0x7FC383 /end MEASUREMENT
/begin MEASUREMENT rinkfh "Innenwiderstand Nernstzelle der Lambdasonde aus Kennfeld vor Kat" UBYTE r_q8 1 100 0 2040 FORMAT "%5.0" ECU_ADDRESS 0x8008AE /end MEASUREMENT
/begin MEASUREMENT rinkfh2 "Innenwiderstand Nernstzelle der Lambdasonde 2 aus Kennfeld vor Kat" UBYTE r_q8 1 100 0 2040 FORMAT "%5.0" ECU_ADDRESS 0x8008AF /end MEASUREMENT
/begin MEASUREMENT rinsh2_w "Grenzwert Innenwiderstand Nernstzelle der Lambdasonde 2 hinter Kat" UWORD r_uw_q2 1 100 0 131070 FORMAT "%8.1" ECU_ADDRESS 0x8008B0 /end MEASUREMENT
/begin MEASUREMENT rinsh_w "Grenzwert Innenwiderstand Nernstzelle der Lambdasonde hinter Kat" UWORD r_uw_q2 1 100 0 131070 FORMAT "%8.1" ECU_ADDRESS 0x8008B2 /end MEASUREMENT
/begin MEASUREMENT sfpagre "Status Fehlerpfad: AGR-Ventil Endstufe" UWORD dez 1 100 0 65535 FORMAT "%8.2" ECU_ADDRESS 0x7FC88A /end MEASUREMENT
/begin MEASUREMENT sfpagrf "Status Fehlerpfad: ‹berwachung AGR-Flow" UWORD dez 1 100 0 65535 FORMAT "%8.2" ECU_ADDRESS 0x7FC88C /end MEASUREMENT
/begin MEASUREMENT sfpbrems "Status Fehlerpfad BREMS: Bremsschalter" UWORD dez 1 100 0 65535 FORMAT "%8.2" ECU_ADDRESS 0x7FC8AE /end MEASUREMENT
/begin MEASUREMENT sfpcas "Status Fehlerpfad: Diagnose CAN-Timeout ASC-Schnittstelle" UWORD dez 1 100 0 65535 FORMAT "%8.2" ECU_ADDRESS 0x7FC8B2 /end MEASUREMENT
/begin MEASUREMENT sfpcat "Status Fehlerpfad: CAN-Schnittstelle, Timeout ASC" UWORD default 1 100 0 65535 FORMAT "%8.2" ECU_ADDRESS 0x7FC8B4 /end MEASUREMENT
/begin MEASUREMENT sfpcge "Status Fehlerpfad: Diagnose CAN-Timeout EGS-Schnittstelle" UWORD dez 1 100 0 65535 FORMAT "%8.2" ECU_ADDRESS 0x7FC8B6 /end MEASUREMENT
/begin MEASUREMENT sfpcif "Status Fehlerpfad: CAN im Zustand Bus-Off" UWORD default 1 100 0 65535 FORMAT "%8.2" ECU_ADDRESS 0x7FC8B8 /end MEASUREMENT
/begin MEASUREMENT sfpcins "Status Fehlerpfad: Diagnose CAN-Timeout Kombiinstr." UWORD dez 1 100 0 65535 FORMAT "%8.2" ECU_ADDRESS 0x7FC8BA /end MEASUREMENT
/begin MEASUREMENT sfpcszl "Status Fehlerpfad: Diagnose CAN-Timeout SZL-Schnittstelle" UWORD dez 1 100 0 65535 FORMAT "%8.2" ECU_ADDRESS 0x7FC8BE /end MEASUREMENT
/begin MEASUREMENT sfpddss "Status Fehlerpfad: Differenzdrucksensor Saugrohr" UWORD dez 1 100 0 65535 FORMAT "%8.2" ECU_ADDRESS 0x7FC8C0 /end MEASUREMENT
/begin MEASUREMENT sfpdmtk "Status Fehlerpfad: Modul DMTK" UWORD dez 1 100 0 65535 FORMAT "%8.2" ECU_ADDRESS 0x7FC8C8 /end MEASUREMENT
/begin MEASUREMENT sfpdmtknm "" UWORD dez 1 100 0 65535 FORMAT "%8.2" ECU_ADDRESS 0x7FC8CA /end MEASUREMENT
/begin MEASUREMENT sfpdmtl "Status Fehlerpfad: Modul DM-TL" UWORD dez 1 100 0 65535 FORMAT "%8.2" ECU_ADDRESS 0x7FC8CC /end MEASUREMENT
/begin MEASUREMENT sfpdpl "Status Fehlerpfad: Dauerplus" UWORD dez 1 100 0 65535 FORMAT "%8.2" ECU_ADDRESS 0x7FC8CE /end MEASUREMENT
/begin MEASUREMENT sfpfan "Status Fehlerpfad:  L¸fterdrehzahlsensor" UWORD dez 1 100 0 65535 FORMAT "%8.2" ECU_ADDRESS 0x7FC912 /end MEASUREMENT
/begin MEASUREMENT sfphshe "Status Fehlerpfad: Endstufe Heizung Lambdasonde hinter Kat" UWORD default 1 100 0 65535 FORMAT "%8.2" ECU_ADDRESS 0x7FC92A /end MEASUREMENT
/begin MEASUREMENT sfphshe2 "Status Fehlerpfad: Endstufe Heizung Lambdasonde 2 hinter Kat" UWORD default 1 100 0 65535 FORMAT "%8.2" ECU_ADDRESS 0x7FC92C /end MEASUREMENT
/begin MEASUREMENT sfphsvsa "Status Fehlerpfad: Heizung Lambdasonde vor Kat" UWORD dez 1 100 0 65535 FORMAT "%8.2" ECU_ADDRESS 0x7FC936 /end MEASUREMENT
/begin MEASUREMENT sfphsvsa2 "Status Fehlerpfad: Heizung Lambdasonde 2 vor Kat" UWORD dez 1 100 0 65535 FORMAT "%8.2" ECU_ADDRESS 0x7FC938 /end MEASUREMENT
/begin MEASUREMENT sfpkuppl "Status Fehlerpfad KUPPL: Gebergrˆﬂe Kupplung" UWORD dez 1 100 0 65535 FORMAT "%8.2" ECU_ADDRESS 0x7FC952 /end MEASUREMENT
/begin MEASUREMENT sfpldp "Status Fehlerpfad:Leckdiagnosemodul" UWORD dez 1 100 0 65535 FORMAT "%8.2" ECU_ADDRESS 0x7FC962 /end MEASUREMENT
/begin MEASUREMENT sfplfse "" UWORD dez 1 100 0 65535 FORMAT "%8.2" ECU_ADDRESS 0x7FC966 /end MEASUREMENT
/begin MEASUREMENT sfplsvv "Status Fehlerpfad: Diagnose Lambdasonde vertauscht vor Kat" UWORD dez 1 100 0 65535 FORMAT "%8.2" ECU_ADDRESS 0x7FC980 /end MEASUREMENT
/begin MEASUREMENT sfpluea "Status Fehlerpfad: Endstufe Motor L¸fter A" UWORD default 1 100 0 65535 FORMAT "%8.2" ECU_ADDRESS 0x7FC982 /end MEASUREMENT
/begin MEASUREMENT sfplueb "Status Fehlerpfad: Endstufe Motor L¸fter B" UWORD default 1 100 0 65535 FORMAT "%8.2" ECU_ADDRESS 0x7FC984 /end MEASUREMENT
/begin MEASUREMENT sfpluec "Status Fehlerpfad: Endstufe Motor L¸fter C" UWORD default 1 100 0 65535 FORMAT "%8.2" ECU_ADDRESS 0x7FC986 /end MEASUREMENT
/begin MEASUREMENT sfpmfa "Status Fehlerpfad: MIL-Fremdanforderung" UWORD dez 1 100 0 65535 FORMAT "%8.2" ECU_ADDRESS 0x7FC9A8 /end MEASUREMENT
/begin MEASUREMENT sfpmile "Status Fehlerpfad: Mil - Endstufe" UWORD default 1 100 0 65535 FORMAT "%8.2" ECU_ADDRESS 0x7FC9AA /end MEASUREMENT
/begin MEASUREMENT sfpnwkw "Status Fehlerpfad: Zuordnung Nockenwelle zu Kurbelwelle" UWORD default 1 100 0 65535 FORMAT "%8.2" ECU_ADDRESS 0x7FC9AE /end MEASUREMENT
/begin MEASUREMENT sfpnwkw2 "Status Fehlerpfad: Zuordnung Nockenwelle 2 zu Kurbelwelle" UWORD default 1 100 0 65535 FORMAT "%8.2" ECU_ADDRESS 0x7FC9B0 /end MEASUREMENT
/begin MEASUREMENT sfpnwkw3 "Status Fehlerpfad: Zuordnung Nockenwelle 3 zu Kurbelwelle" UWORD default 1 100 0 65535 FORMAT "%8.2" ECU_ADDRESS 0x7FC9B2 /end MEASUREMENT
/begin MEASUREMENT sfpnwkw4 "Status Fehlerpfad: Zuordnung Nockenwelle 4 zu Kurbelwelle" UWORD default 1 100 0 65535 FORMAT "%8.2" ECU_ADDRESS 0x7FC9B4 /end MEASUREMENT
/begin MEASUREMENT sfpnwkwa "Status Fehlerpfad: Zuordnung Auslassnockenwelle  zur Kurbelwelle" UWORD default 1 100 0 65535 FORMAT "%8.2" ECU_ADDRESS 0x7FC9B6 /end MEASUREMENT
/begin MEASUREMENT sfpnwkwa2 "Status Fehlerpfad: Zuordnung Auslassnockenwelle  Bank 2 zur Kurbelwelle" UWORD default 1 100 0 65535 FORMAT "%8.2" ECU_ADDRESS 0x7FC9B8 /end MEASUREMENT
/begin MEASUREMENT sfpnwkwe "Status Fehlerpfad: Zuordnung Einlassnockenwelle zur Kurbelwelle" UWORD default 1 100 0 65535 FORMAT "%8.2" ECU_ADDRESS 0x7FC9BA /end MEASUREMENT
/begin MEASUREMENT sfpnwkwe2 "Status Fehlerpfad: Zuordnung Einlassnockenwelle Bank 2 zur Kurbelwelle" UWORD default 1 100 0 65535 FORMAT "%8.2" ECU_ADDRESS 0x7FC9BC /end MEASUREMENT
/begin MEASUREMENT sfpnws "Status Fehlerpfad: Nockenwellensteuerung" UWORD dez 1 100 0 65535 FORMAT "%8.2" ECU_ADDRESS 0x7FC9BE /end MEASUREMENT
/begin MEASUREMENT sfppddss "" UWORD dez 1 100 0 65535 FORMAT "%8.2" ECU_ADDRESS 0x7FC9C2 /end MEASUREMENT
/begin MEASUREMENT sfpsalsu "Status Fehlerpfad: Diagnose Schubabgleich LSU" UWORD dez 1 100 0 65535 FORMAT "%8.2" ECU_ADDRESS 0x7FC9D8 /end MEASUREMENT
/begin MEASUREMENT sfpsalsu2 "Status Fehlerpfad: Diagnose Schubabgleich LSU, Bank 2" UWORD dez 1 100 0 65535 FORMAT "%8.2" ECU_ADDRESS 0x7FC9DA /end MEASUREMENT
/begin MEASUREMENT sfpslpe "Status Fehlerpfad: Sekund‰rluftpumpe Endstufe" UWORD default 1 100 0 65535 FORMAT "%8.2" ECU_ADDRESS 0x7FC9DC /end MEASUREMENT
/begin MEASUREMENT sfpslve "Status Fehlerpfad: Sekund‰rluftventil Endstufe" UWORD default 1 100 0 65535 FORMAT "%8.2" ECU_ADDRESS 0x7FC9E6 /end MEASUREMENT
/begin MEASUREMENT sfpstae "Status Fehlerpfad: Starter Endstufe" UWORD default 1 100 0 65535 FORMAT "%8.2" ECU_ADDRESS 0x7FC9E8 /end MEASUREMENT
/begin MEASUREMENT sfpsue "Status Fehlerpfad: Endstufe Saugrohrumschaltung" UWORD default 1 100 0 65535 FORMAT "%8.2" ECU_ADDRESS 0x7FC9EA /end MEASUREMENT
/begin MEASUREMENT sfpsvsfa "" UWORD dez 1 100 0 65535 FORMAT "%8.2" ECU_ADDRESS 0x7FC9EC /end MEASUREMENT
/begin MEASUREMENT sfptcm_par "" UWORD default 1 100 0 65535 FORMAT "%8.2" ECU_ADDRESS 0x7FC9F2 /end MEASUREMENT
/begin MEASUREMENT sfptcm_tgl "" UWORD default 1 100 0 65535 FORMAT "%8.2" ECU_ADDRESS 0x7FC9F4 /end MEASUREMENT
/begin MEASUREMENT sfptcm_trqreq "" UWORD default 1 100 0 65535 FORMAT "%8.2" ECU_ADDRESS 0x7FC9F6 /end MEASUREMENT
/begin MEASUREMENT sfptesk "Status Fehlerpfad: Tankdiagnose, Kleinstleck" UWORD dez 1 100 0 65535 FORMAT "%8.2" ECU_ADDRESS 0x7FC9FA /end MEASUREMENT
/begin MEASUREMENT sfptmki "Status Fehlerpfad: Motortemperatur aus Kombiinstrument TMKI" UWORD default 1 100 0 65535 FORMAT "%8.2" ECU_ADDRESS 0x7FCA04 /end MEASUREMENT
/begin MEASUREMENT sfptum "Status Fehlerpfad: Umgebungstemperatur TUM" UWORD default 1 100 0 65535 FORMAT "%8.2" ECU_ADDRESS 0x7FCA08 /end MEASUREMENT
/begin MEASUREMENT sfptx "Status Fehlerpfad: Temperatur EBOX" UWORD dez 1 100 0 65535 FORMAT "%8.2" ECU_ADDRESS 0x7FCA0A /end MEASUREMENT
/begin MEASUREMENT sfpuvse "Status Fehlerpfad: Endstufe Umluftventil Turbo" UWORD dez 1 100 0 65535 FORMAT "%8.2" ECU_ADDRESS 0x7FCA22 /end MEASUREMENT
/begin MEASUREMENT sfpvfz "Status Fehlerpfad: Fahrzeuggeschwindigkeit" UWORD dez 1 100 0 65535 FORMAT "%8.2" ECU_ADDRESS 0x7FCA24 /end MEASUREMENT
/begin MEASUREMENT sfpwws_brd "" UWORD default 1 100 0 65535 FORMAT "%8.2" ECU_ADDRESS 0x7FCA26 /end MEASUREMENT
/begin MEASUREMENT sfpwws_nopa "" UWORD default 1 100 0 65535 FORMAT "%8.2" ECU_ADDRESS 0x7FCA28 /end MEASUREMENT
/begin MEASUREMENT sfpwws_pa "" UWORD default 1 100 0 65535 FORMAT "%8.2" ECU_ADDRESS 0x7FCA2A /end MEASUREMENT
/begin MEASUREMENT S_kl15 "Schalter Klemme 15" UBYTE B_TRUE 1 100 0 1 BIT_MASK 0x1 FORMAT "%13.11" ECU_ADDRESS 0x7FA977 /end MEASUREMENT
/begin MEASUREMENT S_kupp1 "" UBYTE B_TRUE 1 100 0 1 BIT_MASK 0x1 FORMAT "%13.11" ECU_ADDRESS 0x7FA978 /end MEASUREMENT
/begin MEASUREMENT S_kupp2 "" UBYTE B_TRUE 1 100 0 1 BIT_MASK 0x1 FORMAT "%13.11" ECU_ADDRESS 0x7FA979 /end MEASUREMENT
/begin MEASUREMENT tahsomf2_w "gefilterte Abgastemperatur an Sonde hinter Kat aus Modell, Bank 2" UWORD temp_q0p0234_o273 1 100 -273.15 1262.83 FORMAT "%8.3" ECU_ADDRESS 0x8008B4 /end MEASUREMENT
/begin MEASUREMENT tahsomf_w "gefilterte Abgastemperatur an Sonde hinter Kat aus Modell" UWORD temp_q0p0234_o273 1 100 -273.15 1262.83 FORMAT "%8.3" ECU_ADDRESS 0x8008B6 /end MEASUREMENT
/begin MEASUREMENT twvsom2_w "Wandtemperatur vordere Sonde modelliert, Bank2" UWORD temp_q0p0234_o273 1 100 -273.15 1262.83 FORMAT "%8.3" ECU_ADDRESS 0x8009B4 /end MEASUREMENT
/begin MEASUREMENT twvsom_w "Wandtemperatur vordere Sonde modelliert" UWORD temp_q0p0234_o273 1 100 -273.15 1262.83 FORMAT "%8.3" ECU_ADDRESS 0x8009B6 /end MEASUREMENT
/begin MEASUREMENT TYP_brems "Fehlertyp: Gebergrˆﬂe Bremsschalter" UWORD B_TRUE 1 100 0 1 BIT_MASK 0xf00 FORMAT "%13.11" ECU_ADDRESS 0x7FC8AE /end MEASUREMENT
/begin MEASUREMENT TYP_cat "" UWORD B_TRUE 1 100 0 1 BIT_MASK 0xf00 FORMAT "%13.11" ECU_ADDRESS 0x7FC8B4 /end MEASUREMENT
/begin MEASUREMENT TYP_cif "Fehlertyp: CAN im Zustand Bus-Off" UWORD B_TRUE 1 100 0 1 BIT_MASK 0xf00 FORMAT "%13.11" ECU_ADDRESS 0x7FC8B8 /end MEASUREMENT
/begin MEASUREMENT TYP_hshe "Fehlertyp: Endstufe Heizung Lambdasonde 1 hinter Kat" UWORD B_TRUE 1 100 0 1 BIT_MASK 0xf00 FORMAT "%13.11" ECU_ADDRESS 0x7FC92A /end MEASUREMENT
/begin MEASUREMENT TYP_hshe2 "Fehlertyp: Endstufe Heizung Lambdasonde 2 hinter Kat" UWORD B_TRUE 1 100 0 1 BIT_MASK 0xf00 FORMAT "%13.11" ECU_ADDRESS 0x7FC92C /end MEASUREMENT
/begin MEASUREMENT TYP_hsvsa "" UWORD B_TRUE 1 100 0 1 BIT_MASK 0xf00 FORMAT "%13.11" ECU_ADDRESS 0x7FC936 /end MEASUREMENT
/begin MEASUREMENT TYP_hsvsa2 "" UWORD B_TRUE 1 100 0 1 BIT_MASK 0xf00 FORMAT "%13.11" ECU_ADDRESS 0x7FC938 /end MEASUREMENT
/begin MEASUREMENT TYP_kuppl "Fehlertyp: Gebergrˆﬂe Kupplungsschalter" UWORD B_TRUE 1 100 0 1 BIT_MASK 0xf00 FORMAT "%13.11" ECU_ADDRESS 0x7FC952 /end MEASUREMENT
/begin MEASUREMENT TYP_lfse "" UWORD B_TRUE 1 100 0 1 BIT_MASK 0xf00 FORMAT "%13.11" ECU_ADDRESS 0x7FC966 /end MEASUREMENT
/begin MEASUREMENT TYP_lsvv "" UWORD B_TRUE 1 100 0 1 BIT_MASK 0xf00 FORMAT "%13.11" ECU_ADDRESS 0x7FC980 /end MEASUREMENT
/begin MEASUREMENT TYP_luea "" UWORD B_TRUE 1 100 0 1 BIT_MASK 0xf00 FORMAT "%13.11" ECU_ADDRESS 0x7FC982 /end MEASUREMENT
/begin MEASUREMENT TYP_lueb "" UWORD B_TRUE 1 100 0 1 BIT_MASK 0xf00 FORMAT "%13.11" ECU_ADDRESS 0x7FC984 /end MEASUREMENT
/begin MEASUREMENT TYP_luec "" UWORD B_TRUE 1 100 0 1 BIT_MASK 0xf00 FORMAT "%13.11" ECU_ADDRESS 0x7FC986 /end MEASUREMENT
/begin MEASUREMENT TYP_mile "" UWORD B_TRUE 1 100 0 1 BIT_MASK 0xf00 FORMAT "%13.11" ECU_ADDRESS 0x7FC9AA /end MEASUREMENT
/begin MEASUREMENT TYP_nwkw "" UWORD B_TRUE 1 100 0 1 BIT_MASK 0xf00 FORMAT "%13.11" ECU_ADDRESS 0x7FC9AE /end MEASUREMENT
/begin MEASUREMENT TYP_nwkw2 "" UWORD B_TRUE 1 100 0 1 BIT_MASK 0xf00 FORMAT "%13.11" ECU_ADDRESS 0x7FC9B0 /end MEASUREMENT
/begin MEASUREMENT TYP_nwkw3 "" UWORD B_TRUE 1 100 0 1 BIT_MASK 0xf00 FORMAT "%13.11" ECU_ADDRESS 0x7FC9B2 /end MEASUREMENT
/begin MEASUREMENT TYP_nwkw4 "" UWORD B_TRUE 1 100 0 1 BIT_MASK 0xf00 FORMAT "%13.11" ECU_ADDRESS 0x7FC9B4 /end MEASUREMENT
/begin MEASUREMENT TYP_nwkwa "" UWORD B_TRUE 1 100 0 1 BIT_MASK 0xf00 FORMAT "%13.11" ECU_ADDRESS 0x7FC9B6 /end MEASUREMENT
/begin MEASUREMENT TYP_nwkwa2 "" UWORD B_TRUE 1 100 0 1 BIT_MASK 0xf00 FORMAT "%13.11" ECU_ADDRESS 0x7FC9B8 /end MEASUREMENT
/begin MEASUREMENT TYP_nwkwe "" UWORD B_TRUE 1 100 0 1 BIT_MASK 0xf00 FORMAT "%13.11" ECU_ADDRESS 0x7FC9BA /end MEASUREMENT
/begin MEASUREMENT TYP_nwkwe2 "" UWORD B_TRUE 1 100 0 1 BIT_MASK 0xf00 FORMAT "%13.11" ECU_ADDRESS 0x7FC9BC /end MEASUREMENT
/begin MEASUREMENT TYP_stae "" UWORD B_TRUE 1 100 0 1 BIT_MASK 0xf00 FORMAT "%13.11" ECU_ADDRESS 0x7FC9E8 /end MEASUREMENT
/begin MEASUREMENT TYP_sue "" UWORD B_TRUE 1 100 0 1 BIT_MASK 0xf00 FORMAT "%13.11" ECU_ADDRESS 0x7FC9EA /end MEASUREMENT
/begin MEASUREMENT TYP_tmki "" UWORD B_TRUE 1 100 0 1 BIT_MASK 0xf00 FORMAT "%13.11" ECU_ADDRESS 0x7FCA04 /end MEASUREMENT
/begin MEASUREMENT TYP_tum "" UWORD B_TRUE 1 100 0 1 BIT_MASK 0xf00 FORMAT "%13.11" ECU_ADDRESS 0x7FCA08 /end MEASUREMENT
/begin MEASUREMENT TYP_vfz "" UWORD B_TRUE 1 100 0 1 BIT_MASK 0xf00 FORMAT "%13.11" ECU_ADDRESS 0x7FCA24 /end MEASUREMENT
/begin MEASUREMENT wdkbadmx_w "Winkel-DK f¸r Adressierung von KFMLDMX" SWORD relDK_q0p02441 1 100 -800 799.976 FORMAT "%8.4" ECU_ADDRESS 0x8013C2 /end MEASUREMENT
/begin MEASUREMENT zatmwvs2_w "Zeitkonstante f¸r Rohrwandtemperatur, Bank2" UWORD zk200msxs_uw_b13107 1 100 0.2 13107 FORMAT "%10.4" ECU_ADDRESS 0x8009B8 /end MEASUREMENT
/begin MEASUREMENT zatmwvs_w "Zeitkonstante f¸r Rohrwandtemperatur" UWORD zk200msxs_uw_b13107 1 100 0.2 13107 FORMAT "%10.4" ECU_ADDRESS 0x8009BA /end MEASUREMENT
/begin MEASUREMENT Z_agre "Zyklusflag: Abgasr¸ckf¸hrungsventil Endstufe" UWORD B_TRUE 1 100 0 1 BIT_MASK 0x2 FORMAT "%13.11" ECU_ADDRESS 0x7FC88A /end MEASUREMENT
/begin MEASUREMENT Z_agrf "Zyklusflag: ‹berwachung AGR-FLOW" UWORD B_TRUE 1 100 0 1 BIT_MASK 0x2 FORMAT "%13.11" ECU_ADDRESS 0x7FC88C /end MEASUREMENT
/begin MEASUREMENT Z_brems "Zyklusflag: BREMS (Bremsschalter)" UWORD B_TRUE 1 100 0 1 BIT_MASK 0x2 FORMAT "%13.11" ECU_ADDRESS 0x7FC8AE /end MEASUREMENT
/begin MEASUREMENT Z_cas "Zyklusflag: CAN-Schnittstelle, Timeout ASC" UWORD B_TRUE 1 100 0 1 BIT_MASK 0x2 FORMAT "%13.11" ECU_ADDRESS 0x7FC8B2 /end MEASUREMENT
/begin MEASUREMENT Z_cat "Zyklusflag: CAN-Schnittstelle, Timeout Bremsbotschaft setzen" UWORD B_TRUE 1 100 0 1 BIT_MASK 0x2 FORMAT "%13.11" ECU_ADDRESS 0x7FC8B4 /end MEASUREMENT
/begin MEASUREMENT Z_cge "Zyklusflag: CAN-Schnittstelle, Timeout EGS" UWORD B_TRUE 1 100 0 1 BIT_MASK 0x2 FORMAT "%13.11" ECU_ADDRESS 0x7FC8B6 /end MEASUREMENT
/begin MEASUREMENT Z_cif "Zyklusflag: CAN-Schnittstelle, interner Fehler" UWORD B_TRUE 1 100 0 1 BIT_MASK 0x2 FORMAT "%13.11" ECU_ADDRESS 0x7FC8B8 /end MEASUREMENT
/begin MEASUREMENT Z_cins "Zyklusflag: CAN-Schnittstelle, Timeout Instrument" UWORD B_TRUE 1 100 0 1 BIT_MASK 0x2 FORMAT "%13.11" ECU_ADDRESS 0x7FC8BA /end MEASUREMENT
/begin MEASUREMENT Z_cszl "Zyklusflag: CAN-Schnittstelle, Timeout SZL" UWORD B_TRUE 1 100 0 1 BIT_MASK 0x2 FORMAT "%13.11" ECU_ADDRESS 0x7FC8BE /end MEASUREMENT
/begin MEASUREMENT Z_ddss "Zyklusflag: Differenzdrucksensor Saugrohr" UWORD B_TRUE 1 100 0 1 BIT_MASK 0x2 FORMAT "%13.11" ECU_ADDRESS 0x7FC8C0 /end MEASUREMENT
/begin MEASUREMENT Z_dmtk "Zyklusflag: Tankentl¸ftungssystem Kleinstleck" UWORD B_TRUE 1 100 0 1 BIT_MASK 0x2 FORMAT "%13.11" ECU_ADDRESS 0x7FC8C8 /end MEASUREMENT
/begin MEASUREMENT Z_dmtknm "Zyklusflag: Tankentl¸ftungssystem Kleinstleck (keine MIL on)" UWORD B_TRUE 1 100 0 1 BIT_MASK 0x2 FORMAT "%13.11" ECU_ADDRESS 0x7FC8CA /end MEASUREMENT
/begin MEASUREMENT Z_dmtl "Zyklusflag: DMTL-Modul" UWORD B_TRUE 1 100 0 1 BIT_MASK 0x2 FORMAT "%13.11" ECU_ADDRESS 0x7FC8CC /end MEASUREMENT
/begin MEASUREMENT Z_dpl "Zyklusflag:	Dauerplus" UWORD B_TRUE 1 100 0 1 BIT_MASK 0x2 FORMAT "%13.11" ECU_ADDRESS 0x7FC8CE /end MEASUREMENT
/begin MEASUREMENT Z_fan "Zyklusflag: Motorl¸ftersensordiagnose" UWORD B_TRUE 1 100 0 1 BIT_MASK 0x2 FORMAT "%13.11" ECU_ADDRESS 0x7FC912 /end MEASUREMENT
/begin MEASUREMENT Z_hshe "Zyklusflag:Lambdasonden-Heizung hinter Katalysator (Endstufe)" UWORD B_TRUE 1 100 0 1 BIT_MASK 0x2 FORMAT "%13.11" ECU_ADDRESS 0x7FC92A /end MEASUREMENT
/begin MEASUREMENT Z_hshe2 "Zyklusflag:Lambdasonden-Heizung hinter Katalysator, Bank2 (Endstufe)" UWORD B_TRUE 1 100 0 1 BIT_MASK 0x2 FORMAT "%13.11" ECU_ADDRESS 0x7FC92C /end MEASUREMENT
/begin MEASUREMENT Z_hsvsa "Zyklusflag:  reduzierte  LSU-Heizung oder LSU-Kennlinie abgeflacht" UWORD B_TRUE 1 100 0 1 BIT_MASK 0x2 FORMAT "%13.11" ECU_ADDRESS 0x7FC936 /end MEASUREMENT
/begin MEASUREMENT Z_hsvsa2 "Zyklusflag: reduzierte  LSU_2-Heizung oder LSU_2-Kennlinie abgeflacht" UWORD B_TRUE 1 100 0 1 BIT_MASK 0x2 FORMAT "%13.11" ECU_ADDRESS 0x7FC938 /end MEASUREMENT
/begin MEASUREMENT Z_kuppl "Zyklusflag: Kupplung betaetigt" UWORD B_TRUE 1 100 0 1 BIT_MASK 0x2 FORMAT "%13.11" ECU_ADDRESS 0x7FC952 /end MEASUREMENT
/begin MEASUREMENT Z_ldp "Zyklusflag: Leckdiagnosemodul" UWORD B_TRUE 1 100 0 1 BIT_MASK 0x2 FORMAT "%13.11" ECU_ADDRESS 0x7FC962 /end MEASUREMENT
/begin MEASUREMENT Z_lfse "Zyklusflag: LFS-Endstufe" UWORD B_TRUE 1 100 0 1 BIT_MASK 0x2 FORMAT "%13.11" ECU_ADDRESS 0x7FC966 /end MEASUREMENT
/begin MEASUREMENT Z_lsvv "Zyklusflag: Vertauschte Lambda-Sonden vor Kat" UWORD B_TRUE 1 100 0 1 BIT_MASK 0x2 FORMAT "%13.11" ECU_ADDRESS 0x7FC980 /end MEASUREMENT
/begin MEASUREMENT Z_luea "Zyklusflag: L¸fterendstufe A" UWORD B_TRUE 1 100 0 1 BIT_MASK 0x2 FORMAT "%13.11" ECU_ADDRESS 0x7FC982 /end MEASUREMENT
/begin MEASUREMENT Z_lueb "Zyklusflag: L¸fterendstufe B" UWORD B_TRUE 1 100 0 1 BIT_MASK 0x2 FORMAT "%13.11" ECU_ADDRESS 0x7FC984 /end MEASUREMENT
/begin MEASUREMENT Z_luec "Zyklusflag: L¸fterendstufe C" UWORD B_TRUE 1 100 0 1 BIT_MASK 0x2 FORMAT "%13.11" ECU_ADDRESS 0x7FC986 /end MEASUREMENT
/begin MEASUREMENT Z_mfa "Zyklusflag: MIL-fremdbestimmt" UWORD B_TRUE 1 100 0 1 BIT_MASK 0x2 FORMAT "%13.11" ECU_ADDRESS 0x7FC9A8 /end MEASUREMENT
/begin MEASUREMENT Z_mile "Zyklusflag: MIL-Endstufe" UWORD B_TRUE 1 100 0 1 BIT_MASK 0x2 FORMAT "%13.11" ECU_ADDRESS 0x7FC9AA /end MEASUREMENT
/begin MEASUREMENT Z_nwkw "Zyklusflag: Zuordnung Nockenwelle zu Kurbelwelle" UWORD B_TRUE 1 100 0 1 BIT_MASK 0x2 FORMAT "%13.11" ECU_ADDRESS 0x7FC9AE /end MEASUREMENT
/begin MEASUREMENT Z_nwkw2 "Zyklusflag: Zuordnung Nockenwelle 2 zu Kurbelwelle" UWORD B_TRUE 1 100 0 1 BIT_MASK 0x2 FORMAT "%13.11" ECU_ADDRESS 0x7FC9B0 /end MEASUREMENT
/begin MEASUREMENT Z_nwkw3 "Zyklusflag: Zuordnung Nockenwelle 3 zu Kurbelwelle" UWORD B_TRUE 1 100 0 1 BIT_MASK 0x2 FORMAT "%13.11" ECU_ADDRESS 0x7FC9B2 /end MEASUREMENT
/begin MEASUREMENT Z_nwkw4 "Zyklusflag: Zuordnung Nockenwelle 4 zu Kurbelwelle" UWORD B_TRUE 1 100 0 1 BIT_MASK 0x2 FORMAT "%13.11" ECU_ADDRESS 0x7FC9B4 /end MEASUREMENT
/begin MEASUREMENT Z_nwkwa "Zyklusflag: Zuordnung Auslassnockenwelle zur Kurbelwelle" UWORD B_TRUE 1 100 0 1 BIT_MASK 0x2 FORMAT "%13.11" ECU_ADDRESS 0x7FC9B6 /end MEASUREMENT
/begin MEASUREMENT Z_nwkwa2 "Zyklusflag: Zuordnung Auslassnockenwelle 2  zur Kurbelwelle" UWORD B_TRUE 1 100 0 1 BIT_MASK 0x2 FORMAT "%13.11" ECU_ADDRESS 0x7FC9B8 /end MEASUREMENT
/begin MEASUREMENT Z_nwkwe "Zyklusflag: Zuordnung Einlassnockenwelle zur Kurbelwelle" UWORD B_TRUE 1 100 0 1 BIT_MASK 0x2 FORMAT "%13.11" ECU_ADDRESS 0x7FC9BA /end MEASUREMENT
/begin MEASUREMENT Z_nwkwe2 "Zyklusflag: Zuordnung Einlassnockenwelle Bank 2 zur Kurbelwelle" UWORD B_TRUE 1 100 0 1 BIT_MASK 0x2 FORMAT "%13.11" ECU_ADDRESS 0x7FC9BC /end MEASUREMENT
/begin MEASUREMENT Z_nws "Zyklusflag: Nockenwellensteuerung" UWORD B_TRUE 1 100 0 1 BIT_MASK 0x2 FORMAT "%13.11" ECU_ADDRESS 0x7FC9BE /end MEASUREMENT
/begin MEASUREMENT Z_pddss "Zyklusflag: Druck Differenzdrucksensor Saugrohr" UWORD B_TRUE 1 100 0 1 BIT_MASK 0x2 FORMAT "%13.11" ECU_ADDRESS 0x7FC9C2 /end MEASUREMENT
/begin MEASUREMENT Z_salsu "Zyklusflag: Schubabgleich LSU" UWORD B_TRUE 1 100 0 1 BIT_MASK 0x2 FORMAT "%13.11" ECU_ADDRESS 0x7FC9D8 /end MEASUREMENT
/begin MEASUREMENT Z_salsu2 "Zyklusflag: Schubabgleich LSU, Bank 2" UWORD B_TRUE 1 100 0 1 BIT_MASK 0x2 FORMAT "%13.11" ECU_ADDRESS 0x7FC9DA /end MEASUREMENT
/begin MEASUREMENT Z_slpe "Zyklusflag: Sekund‰rluftpumpe (Endstufe)" UWORD B_TRUE 1 100 0 1 BIT_MASK 0x2 FORMAT "%13.11" ECU_ADDRESS 0x7FC9DC /end MEASUREMENT
/begin MEASUREMENT Z_slve "Zyklusflag:	Sekund‰rluftventil (Endstufe)" UWORD B_TRUE 1 100 0 1 BIT_MASK 0x2 FORMAT "%13.11" ECU_ADDRESS 0x7FC9E6 /end MEASUREMENT
/begin MEASUREMENT Z_stae "Zyklusflag: Startautomatik (Endstufe)" UWORD B_TRUE 1 100 0 1 BIT_MASK 0x2 FORMAT "%13.11" ECU_ADDRESS 0x7FC9E8 /end MEASUREMENT
/begin MEASUREMENT Z_sue "Zyklusflag: Endstufe Saugrohrumschaltung" UWORD B_TRUE 1 100 0 1 BIT_MASK 0x2 FORMAT "%13.11" ECU_ADDRESS 0x7FC9EA /end MEASUREMENT
/begin MEASUREMENT Z_svsfa "Zyklusflag: SVS-fremdbestimmt" UWORD B_TRUE 1 100 0 1 BIT_MASK 0x2 FORMAT "%13.11" ECU_ADDRESS 0x7FC9EC /end MEASUREMENT
/begin MEASUREMENT Z_tesk "Zyklusflag: Tankentl¸ftungssystem Kleinstleck" UWORD B_TRUE 1 100 0 1 BIT_MASK 0x2 FORMAT "%13.11" ECU_ADDRESS 0x7FC9FA /end MEASUREMENT
/begin MEASUREMENT Z_tmki "Zyklusflag: Motortemperatur aus Kombiinstrument" UWORD B_TRUE 1 100 0 1 BIT_MASK 0x2 FORMAT "%13.11" ECU_ADDRESS 0x7FCA04 /end MEASUREMENT
/begin MEASUREMENT Z_tum "Zyklusflag: Umgebungstemperatur TUM" UWORD B_TRUE 1 100 0 1 BIT_MASK 0x2 FORMAT "%13.11" ECU_ADDRESS 0x7FCA08 /end MEASUREMENT
/begin MEASUREMENT Z_tx "Zyklusflag: Temperatur EBOX" UWORD B_TRUE 1 100 0 1 BIT_MASK 0x2 FORMAT "%13.11" ECU_ADDRESS 0x7FCA0A /end MEASUREMENT
/begin MEASUREMENT Z_uvse "Zyklusflag: Endstufe Umluftventil Turbo" UWORD B_TRUE 1 100 0 1 BIT_MASK 0x2 FORMAT "%13.11" ECU_ADDRESS 0x7FCA22 /end MEASUREMENT
/begin MEASUREMENT Z_vfz "Zyklusflag: Fahrzeug-Geschwindigkeit" UWORD B_TRUE 1 100 0 1 BIT_MASK 0x2 FORMAT "%13.11" ECU_ADDRESS 0x7FCA24 /end MEASUREMENT
/begin FUNCTION DFPM_SWADP ""
 /begin DEF_CHARACTERISTIC CDCAGRE CDCAGRF CDCBREMS CDCCAS CDCCAT CDCCGE CDCCIF CDCCINS CDCCSZL CDCDDSS CDCDMTK CDCDMTKNM CDCDMTL CDCDPL CDCFAN CDCHSHE CDCHSHE2 CDCHSVSA CDCHSVSA2 CDCKUPPL CDCLDP CDCLFSE CDCLSVV CDCLUEA CDCLUEB CDCLUEC CDCMFA CDCMILE CDCNWKW CDCNWKW2 CDCNWKW3 CDCNWKW4 CDCNWKWA CDCNWKWA2 CDCNWKWE CDCNWKWE2 CDCNWS CDCPDDSS CDCSALSU CDCSALSU2 CDCSLPE CDCSLVE CDCSTAE CDCSUE CDCSVSFA CDCTESK CDCTMKI CDCTUM CDCTX CDCUVSE CDCVFZ CDKAGRE CDKAGRF CDKBREMS CDKCAS CDKCAT CDKCGE CDKCIF CDKCINS CDKCSZL CDKDDSS CDKDMTK CDKDMTKNM CDKDMTL CDKDPL CDKFAN CDKHSHE CDKHSHE2 CDKHSVSA CDKHSVSA2 CDKKUPPL CDKLDP CDKLFSE CDKLSVV CDKLUEA CDKLUEB CDKLUEC CDKMFA CDKMILE CDKNWKW CDKNWKW2 CDKNWKW3 CDKNWKW4 CDKNWKWA CDKNWKWA2 CDKNWKWE CDKNWKWE2 CDKNWS CDKPDDSS CDKSALSU CDKSALSU2 CDKSLPE CDKSLVE CDKSTAE CDKSUE CDKSVSFA CDKTESK CDKTMKI CDKTUM CDKTX CDKUVSE CDKVFZ CDTAGRE CDTAGRF CDTBREMS CDTCAS CDTCAT CDTCGE CDTCIF CDTCINS CDTCSZL CDTDDSS CDTDMTK CDTDMTKNM CDTDMTL CDTDPL CDTFAN CDTHSHE CDTHSHE2 CDTHSVSA CDTHSVSA2 CDTKUPPL CDTLDP CDTLFSE CDTLSVV CDTLUEA CDTLUEB CDTLUEC CDTMFA CDTMILE CDTNWKW CDTNWKW2 CDTNWKW3 CDTNWKW4 CDTNWKWA CDTNWKWA2 CDTNWKWE CDTNWKWE2 CDTNWS CDTPDDSS CDTSALSU CDTSALSU2 CDTSLPE CDTSLVE CDTSTAE CDTSUE CDTSVSFA CDTTESK CDTTMKI CDTTUM CDTTX CDTUVSE CDTVFZ CLAAGRE CLAAGRF CLABREMS CLACAS CLACAT CLACGE CLACIF CLACINS CLACSZL CLADDSS CLADMTK CLADMTKNM CLADMTL CLADPL CLAFAN CLAHSHE CLAHSHE2 CLAHSVSA CLAHSVSA2 CLAKUPPL CLALDP CLALFSE CLALSVV CLALUEA CLALUEB CLALUEC CLAMFA CLAMILE CLANWKW CLANWKW2 CLANWKW3 CLANWKW4 CLANWKWA CLANWKWA2 CLANWKWE CLANWKWE2 CLANWS CLAPDDSS CLASALSU CLASALSU2 CLASLPE CLASLVE CLASTAE CLASUE CLASVSFA CLATESK CLATMKI CLATUM CLATX CLAUVSE CLAVFZ FFTAGRE FFTAGRF FFTBREMS FFTCAS FFTCAT FFTCGE FFTCIF FFTCINS FFTCSZL FFTDDSS FFTDMTK FFTDMTKNM FFTDMTL FFTDPL FFTFAN FFTHSHE FFTHSHE2 FFTHSVSA FFTHSVSA2 FFTKUPPL FFTLDP FFTLFSE FFTLSVV FFTLUEA FFTLUEB FFTLUEC FFTMFA FFTMILE FFTNWKW FFTNWKW2 FFTNWKW3 FFTNWKW4 FFTNWKWA FFTNWKWA2 FFTNWKWE FFTNWKWE2 FFTNWS FFTPDDSS FFTSALSU FFTSALSU2 FFTSLPE FFTSLVE FFTSTAE FFTSUE FFTSVSFA FFTTESK FFTTMKI FFTTUM FFTTX FFTUVSE FFTVFZ TSFAGRE TSFAGRF TSFBREMS TSFCAS TSFCAT TSFCGE TSFCIF TSFCINS TSFCSZL TSFDDSS TSFDMTK TSFDMTKNM TSFDMTL TSFDPL TSFFAN TSFHSHE TSFHSHE2 TSFHSVSA TSFHSVSA2 TSFKUPPL TSFLDP TSFLFSE TSFLSVV TSFLUEA TSFLUEB TSFLUEC TSFMFA TSFMILE TSFNWKW TSFNWKW2 TSFNWKW3 TSFNWKW4 TSFNWKWA TSFNWKWA2 TSFNWKWE TSFNWKWE2 TSFNWS TSFPDDSS TSFSALSU TSFSALSU2 TSFSLPE TSFSLVE TSFSTAE TSFSUE TSFSVSFA TSFTESK TSFTMKI TSFTUM TSFTX TSFUVSE TSFVFZ /end DEF_CHARACTERISTIC
 /begin REF_CHARACTERISTIC /end REF_CHARACTERISTIC
 /begin IN_MEASUREMENT /end IN_MEASUREMENT
 /begin OUT_MEASUREMENT B_bebrems B_becat B_becif B_behshe B_behshe2 B_behsvsa B_behsvsa2 B_bekuppl B_belfse B_belsvv B_beluea B_belueb B_beluec B_bemile B_benwkw B_benwkw2 B_benwkw3 B_benwkw4 B_benwkwa B_benwkwa2 B_benwkwe B_benwkwe2 B_bestae B_besue B_betmki B_betum B_bevfz B_bkbrems B_bkcat B_bkcif B_bkhshe B_bkhshe2 B_bkhsvsa B_bkhsvsa2 B_bkkuppl B_bklfse B_bklsvv B_bkluea B_bklueb B_bkluec B_bkmile B_bknwkw B_bknwkw2 B_bknwkw3 B_bknwkw4 B_bknwkwa B_bknwkwa2 B_bknwkwe B_bknwkwe2 B_bkstae B_bksue B_bktmki B_bktum B_bkvfz B_clbrems B_clcat B_clcif B_clhshe B_clhshe2 B_clhsvsa B_clhsvsa2 B_clkuppl B_cllfse B_cllsvv B_clluea B_cllueb B_clluec B_clmile B_clnwkw B_clnwkw2 B_clnwkw3 B_clnwkw4 B_clnwkwa B_clnwkwa2 B_clnwkwe B_clnwkwe2 B_clstae B_clsue B_cltmki B_cltum B_clvfz B_ftbrems B_ftcat B_ftcif B_fthshe B_fthshe2 B_fthsvsa B_fthsvsa2 B_ftkuppl B_ftlfse B_ftlsvv B_ftluea B_ftlueb B_ftluec B_ftmile B_ftnwkw B_ftnwkw2 B_ftnwkw3 B_ftnwkw4 B_ftnwkwa B_ftnwkwa2 B_ftnwkwe B_ftnwkwe2 B_ftstae B_ftsue B_fttmki B_fttum B_ftvfz B_mnbrems B_mncat B_mncif B_mnhshe B_mnhshe2 B_mnhsvsa B_mnhsvsa2 B_mnkuppl B_mnlfse B_mnlsvv B_mnluea B_mnlueb B_mnluec B_mnmile B_mnnwkw B_mnnwkw2 B_mnnwkw3 B_mnnwkw4 B_mnnwkwa B_mnnwkwa2 B_mnnwkwe B_mnnwkwe2 B_mnstae B_mnsue B_mntmki B_mntum B_mnvfz B_mxbrems B_mxcat B_mxcif B_mxhshe B_mxhshe2 B_mxhsvsa B_mxhsvsa2 B_mxkuppl B_mxlfse B_mxlsvv B_mxluea B_mxlueb B_mxluec B_mxmile B_mxnwkw B_mxnwkw2 B_mxnwkw3 B_mxnwkw4 B_mxnwkwa B_mxnwkwa2 B_mxnwkwe B_mxnwkwe2 B_mxstae B_mxsue B_mxtmki B_mxtum B_mxvfz B_npbrems B_npcat B_npcif B_nphshe B_nphshe2 B_nphsvsa B_nphsvsa2 B_npkuppl B_nplfse B_nplsvv B_npluea B_nplueb B_npluec B_npmile B_npnwkw B_npnwkw2 B_npnwkw3 B_npnwkw4 B_npnwkwa B_npnwkwa2 B_npnwkwe B_npnwkwe2 B_npstae B_npsue B_nptmki B_nptum B_npvfz B_sibrems B_sicat B_sicif B_sihshe B_sihshe2 B_sihsvsa B_sihsvsa2 B_sikuppl B_silfse B_silsvv B_siluea B_silueb B_siluec B_simile B_sinwkw B_sinwkw2 B_sinwkw3 B_sinwkw4 B_sinwkwa B_sinwkwa2 B_sinwkwe B_sinwkwe2 B_sistae B_sisue B_sitmki B_situm B_sivfz E_agre E_agrf E_brems E_cas E_cat E_cge E_cif E_cins E_cszl E_ddss E_dmtk E_dmtknm E_dmtl E_dpl E_fan E_hshe E_hshe2 E_hsvsa E_hsvsa2 E_kuppl E_ldp E_lfse E_lsvv E_luea E_lueb E_luec E_mfa E_mile E_nwkw E_nwkw2 E_nwkw3 E_nwkw4 E_nwkwa E_nwkwa2 E_nwkwe E_nwkwe2 E_nws E_pddss E_salsu E_salsu2 E_slpe E_slve E_stae E_sue E_svsfa E_tesk E_tkmi E_tum E_tx E_uvse E_vfz sfpagre sfpagrf sfpbrems sfpcas sfpcat sfpcge sfpcif sfpcins sfpcszl sfpddss sfpdmtk sfpdmtknm sfpdmtl sfpdpl sfpfan sfphshe sfphshe2 sfphsvsa sfphsvsa2 sfpkuppl sfpldp sfplfse sfplsvv sfpluea sfplueb sfpluec sfpmfa sfpmile sfpnwkw sfpnwkw2 sfpnwkw3 sfpnwkw4 sfpnwkwa sfpnwkwa2 sfpnwkwe sfpnwkwe2 sfpnws sfppddss sfpsalsu sfpsalsu2 sfpslpe sfpslve sfpstae sfpsue sfpsvsfa sfptesk sfptmki sfptum sfptx sfpuvse sfpvfz TYP_brems TYP_cat TYP_cif TYP_hshe TYP_hshe2 TYP_hsvsa TYP_hsvsa2 TYP_kuppl TYP_lfse TYP_lsvv TYP_luea TYP_lueb TYP_luec TYP_mile TYP_nwkw TYP_nwkw2 TYP_nwkw3 TYP_nwkw4 TYP_nwkwa TYP_nwkwa2 TYP_nwkwe TYP_nwkwe2 TYP_stae TYP_sue TYP_tmki TYP_tum TYP_vfz Z_agre Z_agrf Z_brems Z_cas Z_cat Z_cge Z_cif Z_cins Z_cszl Z_ddss Z_dmtk Z_dmtknm Z_dmtl Z_dpl Z_fan Z_hshe Z_hshe2 Z_hsvsa Z_hsvsa2 Z_kuppl Z_ldp Z_lfse Z_lsvv Z_luea Z_lueb Z_luec Z_mfa Z_mile Z_nwkw Z_nwkw2 Z_nwkw3 Z_nwkw4 Z_nwkwa Z_nwkwa2 Z_nwkwe Z_nwkwe2 Z_nws Z_pddss Z_salsu Z_salsu2 Z_slpe Z_slve Z_stae Z_sue Z_svsfa Z_tesk Z_tmki Z_tum Z_tx Z_uvse Z_vfz /end OUT_MEASUREMENT
 /begin LOC_MEASUREMENT /end LOC_MEASUREMENT
 /begin SUB_FUNCTION /end SUB_FUNCTION
/end FUNCTION
/begin FUNCTION DFPM_TCM_Par ""
 /begin DEF_CHARACTERISTIC CDCTCM_Par CDKTCM_Par CDTTCM_Par CLATCM_Par FFTTCM_Par TSFTCM_Par /end DEF_CHARACTERISTIC
 /begin REF_CHARACTERISTIC /end REF_CHARACTERISTIC
 /begin IN_MEASUREMENT /end IN_MEASUREMENT
 /begin OUT_MEASUREMENT sfptcm_par /end OUT_MEASUREMENT
 /begin LOC_MEASUREMENT /end LOC_MEASUREMENT
 /begin SUB_FUNCTION /end SUB_FUNCTION
/end FUNCTION
/begin FUNCTION DFPM_TCM_Tgl ""
 /begin DEF_CHARACTERISTIC CDCTCM_Tgl CDKTCM_Tgl CDTTCM_Tgl CLATCM_Tgl FFTTCM_Tgl TSFTCM_Tgl /end DEF_CHARACTERISTIC
 /begin REF_CHARACTERISTIC /end REF_CHARACTERISTIC
 /begin IN_MEASUREMENT /end IN_MEASUREMENT
 /begin OUT_MEASUREMENT sfptcm_tgl /end OUT_MEASUREMENT
 /begin LOC_MEASUREMENT /end LOC_MEASUREMENT
 /begin SUB_FUNCTION /end SUB_FUNCTION
/end FUNCTION
/begin FUNCTION DFPM_TCM_TrqReq ""
 /begin DEF_CHARACTERISTIC CDCTCM_TrqReq CDKTCM_TrqReq CDTTCM_TrqReq CLATCM_TrqReq FFTTCM_TrqReq TSFTCM_TrqReq /end DEF_CHARACTERISTIC
 /begin REF_CHARACTERISTIC /end REF_CHARACTERISTIC
 /begin IN_MEASUREMENT /end IN_MEASUREMENT
 /begin OUT_MEASUREMENT sfptcm_trqreq /end OUT_MEASUREMENT
 /begin LOC_MEASUREMENT /end LOC_MEASUREMENT
 /begin SUB_FUNCTION /end SUB_FUNCTION
/end FUNCTION
/begin FUNCTION DFPM_WWS_BRD ""
 /begin DEF_CHARACTERISTIC CDCWWS_BRD CDKWWS_BRD CDTWWS_BRD CLAWWS_BRD FFTWWS_BRD TSFWWS_BRD /end DEF_CHARACTERISTIC
 /begin REF_CHARACTERISTIC /end REF_CHARACTERISTIC
 /begin IN_MEASUREMENT /end IN_MEASUREMENT
 /begin OUT_MEASUREMENT sfpwws_brd /end OUT_MEASUREMENT
 /begin LOC_MEASUREMENT /end LOC_MEASUREMENT
 /begin SUB_FUNCTION /end SUB_FUNCTION
/end FUNCTION
/begin FUNCTION DFPM_WWS_NoPA ""
 /begin DEF_CHARACTERISTIC CDCWWS_NoPA CDKWWS_NoPA CDTWWS_NoPA CLAWWS_NoPA FFTWWS_NoPA TSFWWS_NoPA /end DEF_CHARACTERISTIC
 /begin REF_CHARACTERISTIC /end REF_CHARACTERISTIC
 /begin IN_MEASUREMENT /end IN_MEASUREMENT
 /begin OUT_MEASUREMENT sfpwws_nopa /end OUT_MEASUREMENT
 /begin LOC_MEASUREMENT /end LOC_MEASUREMENT
 /begin SUB_FUNCTION /end SUB_FUNCTION
/end FUNCTION
/begin FUNCTION DFPM_WWS_PA ""
 /begin DEF_CHARACTERISTIC CDCWWS_PA CDKWWS_PA CDTWWS_PA CLAWWS_PA FFTWWS_PA TSFWWS_PA /end DEF_CHARACTERISTIC
 /begin REF_CHARACTERISTIC /end REF_CHARACTERISTIC
 /begin IN_MEASUREMENT /end IN_MEASUREMENT
 /begin OUT_MEASUREMENT sfpwws_pa /end OUT_MEASUREMENT
 /begin LOC_MEASUREMENT /end LOC_MEASUREMENT
 /begin SUB_FUNCTION /end SUB_FUNCTION
/end FUNCTION
/begin FUNCTION DFRZ "OBDII; Beschreibung 'freeze frame'" /begin DEF_CHARACTERISTIC /end DEF_CHARACTERISTIC /begin REF_CHARACTERISTIC /end REF_CHARACTERISTIC /begin IN_MEASUREMENT /end IN_MEASUREMENT /begin OUT_MEASUREMENT /end OUT_MEASUREMENT /begin LOC_MEASUREMENT /end LOC_MEASUREMENT /begin SUB_FUNCTION /end SUB_FUNCTION /end FUNCTION
/begin FUNCTION DFSTT "Diagnose Fullstandsgeber Tank"
 /begin DEF_CHARACTERISTIC CWFSTD DFSKVMN DFSKVMX DFSTTH DKVBTH FST1EMT FST1SKTH FST2SKTH FSTERNTH TVFSTD TVHATA UBDFSTMN UBDFSTMX UFST1MN UFST1MX UFST2MN UFST2MX ZFSTPLTH ZFSTSIHL ZFSTSITH /end DEF_CHARACTERISTIC
 /begin REF_CHARACTERISTIC FST2EST /end REF_CHARACTERISTIC
 /begin IN_MEASUREMENT B_fstdgv B_pwf B_stend fst1fdg_w fst2fdg_w fstfdg_w kvb_w ub ufst1_w ufst2_w vfzg /end IN_MEASUREMENT
 /begin OUT_MEASUREMENT B_fst1si B_fstt1 B_fstt2 B_fsttpro B_tank DFSTTausbits /end OUT_MEASUREMENT
 /begin LOC_MEASUREMENT B_dtankm B_fst1mn B_fst1mx B_fst1np B_fst1siok B_fst1sk B_fst2mn B_fst2mx B_fst2np B_fst2si B_fst2sk B_fstpler B_fstplok B_fstplre B_fstsok B_fsttden B_fsttnp B_fsttsen dfskv_w DFSTTlokBits DFSTTlokBitsA dfstt_w dkvb_w fst1stk_w fst2stk_w fstercnt fsterr_w fstold_w fstpler_w kvbold_w /end LOC_MEASUREMENT
 /begin SUB_FUNCTION /end SUB_FUNCTION
/end FUNCTION
/begin FUNCTION DHFM "Diagnose; Plausibilit‰tspr¸fung HFM"
 /begin DEF_CHARACTERISTIC FKPMHFMMN FKPMHFMMX TDEHFMMN TDEHFMMX TDEHFMNPL TDEHFMSG TDHEAHFMLM TDMLST TDUBHFM UBHFM /end DEF_CHARACTERISTIC
 /begin REF_CHARACTERISTIC /end REF_CHARACTERISTIC
 /begin IN_MEASUREMENT B_edhfmpl B_ehfm1 B_ehfmfe B_ehfmmn11 B_ehfmmx11 B_ehfmsg11 B_fgahfm B_fgdhfmst B_hdhfmpl B_hfmko B_hfmku B_zhfmfe fkpmhfm_w tnst_w ub /end IN_MEASUREMENT
 /begin OUT_MEASUREMENT B_ehfm B_ehfmmn B_ehfmmx B_ehfmnpl B_ehfmsg B_hehfm B_hfm B_kphfmnp /end OUT_MEASUREMENT
 /begin LOC_MEASUREMENT /end LOC_MEASUREMENT
 /begin SUB_FUNCTION /end SUB_FUNCTION
/end FUNCTION
/begin FUNCTION DHFMPL "Systemdiagnose HFM"
 /begin DEF_CHARACTERISTIC CWDHFM FMLDMXKO FWMLHFMMN KFMLDMN KFMLDMX MLDHFMKO MLDHFMKU MLHFMMN TDMLHFM UNWDHFM ZMLRO /end DEF_CHARACTERISTIC
 /begin REF_CHARACTERISTIC TDMLST TDUBHFM UBHFM /end REF_CHARACTERISTIC
 /begin IN_MEASUREMENT B_bvhfm B_dkpu B_edks B_ehfmfe B_zhfmfe fho_w mlsol_w mshfm1_w mshfms_w nmot nmot_w tnst_w ub uzkw_w wdkba_w /end IN_MEASUREMENT
 /begin OUT_MEASUREMENT B_edhfmpl B_ehfm1 B_ehfmasy B_fgahfm B_fgdhfmst B_hdhfmpl B_hehfmasy B_hfmko B_hfmku B_mnmld B_mxmld fwmlhfm_w mldmn_w mldmx_w /end OUT_MEASUREMENT
 /begin LOC_MEASUREMENT B_fgfshfm mldko_w mlhfmf_w wdkbadmx_w /end LOC_MEASUREMENT
 /begin SUB_FUNCTION /end SUB_FUNCTION
/end FUNCTION
/begin FUNCTION DHLSHK "Diagnose Sondenheizung hinter Kat"
 /begin DEF_CHARACTERISTIC FRINH1 FRINH2 KFRINH KFRINH2 TABSTHLS TADHMN TADHMXH TVFHS TVRI TVRIF UBDHLSMN UBDHLSMX UHDMN UHDMX ZKARIH ZKPRIH /end DEF_CHARACTERISTIC
 /begin REF_CHARACTERISTIC /end REF_CHARACTERISTIC
 /begin IN_MEASUREMENT B_atmtpk B_atmtpk2 B_bvhls B_cdhsh B_hshe B_hshe2 B_lsh B_lsh2 B_nmot B_rinh B_rinh2 B_stend phlsnh phlsnh2 rinh2_w rinh_w tabst_w tahsom2_w tahsom_w ub uhsh uhsh2 /end IN_MEASUREMENT
 /begin OUT_MEASUREMENT /end OUT_MEASUREMENT
 /begin LOC_MEASUREMENT B_ehsh B_ehsh2 B_enh B_enh2 B_hsokh B_hsokh2 B_mnfhsh B_mnfhsh2 B_mxfhsh B_mxfhsh2 B_npfhsh B_npfhsh2 B_sifhsh B_sifhsh2 phlsnhf phlsnhf2 rinkfh rinkfh2 rinsh2_w rinsh_w tahsomf2_w tahsomf_w /end LOC_MEASUREMENT
 /begin SUB_FUNCTION /end SUB_FUNCTION
/end FUNCTION
/begin FUNCTION DHRLSU "Diagnose Heizungsregelung LSU"
 /begin DEF_CHARACTERISTIC ATMRWT KRIVKMX RINDCMN RINLSUPMN TAVVDCMN TEHEHRLSU TEHRF TEHRLSUE TWVSOMOS UBHRLSUMN UBHRLSUMX ZATMRW /end DEF_CHARACTERISTIC
 /begin REF_CHARACTERISTIC /end REF_CHARACTERISTIC
 /begin IN_MEASUREMENT B_atmst B_cdhrlsu B_ehsve B_ehsve2 B_eiclsu B_eiclsu2 B_elsuwi B_elsuwi2 B_eshlsu B_eshlsu2 B_henrin B_henrin2 B_hlsumx B_hlsumx2 B_hrlsaus B_nmot krivk2_w krivk_w msabg2_w msabg_w rinlsu2_w rinlsu_w tahrlsu2_w tahrlsu_w tavvkm2_w tavvkm_w ub /end IN_MEASUREMENT
 /begin OUT_MEASUREMENT B_ehlsu B_ehlsu2 B_ricalf B_ricalf2 DHRLSUausbits1 twvsom2_w twvsom_w /end OUT_MEASUREMENT
 /begin LOC_MEASUREMENT B_rinnp B_rinnp2 B_spdhrub B_tahrmn B_tahrmn2 B_tahrmx B_tahrmx2 DHRLSUlokbits1 DHRLSUlokbits1_2 zatmwvs2_w zatmwvs_w /end LOC_MEASUREMENT
 /begin SUB_FUNCTION /end SUB_FUNCTION
/end FUNCTION
/begin FUNCTION DHRLSUE "Diagnose Heizungs-Endstufe f¸r Systeme mit CJxxx Diagnose-ES-Baustein" /begin DEF_CHARACTERISTIC /end DEF_CHARACTERISTIC /begin REF_CHARACTERISTIC UBHRLSUMN /end REF_CHARACTERISTIC
 /begin IN_MEASUREMENT B_atmtpa B_cdhrlsue B_hlsumx B_hlsumx2 B_hsvemn B_hsvemn2 B_hsvemx B_hsvemx2 B_hsvesi B_hsvesi2 B_nmot ub /end IN_MEASUREMENT
 /begin OUT_MEASUREMENT B_ehsve B_ehsve2 /end OUT_MEASUREMENT
 /begin LOC_MEASUREMENT B_hsveemn B_hsveemn2 B_hsveemx B_hsveemx2 B_hsveesi B_hsveesi2 /end LOC_MEASUREMENT
 /begin SUB_FUNCTION /end SUB_FUNCTION
/end FUNCTION
/begin FUNCTION DIAGTIME "Deaktivierung CAN-Betrieb ¸ber Tester" /begin DEF_CHARACTERISTIC /end DEF_CHARACTERISTIC /begin REF_CHARACTERISTIC /end REF_CHARACTERISTIC /begin IN_MEASUREMENT rememberP3Max /end IN_MEASUREMENT /begin OUT_MEASUREMENT B_canoff B_cdiagoff B_diagtimeout B_dtimer diagtime /end OUT_MEASUREMENT /begin LOC_MEASUREMENT /end LOC_MEASUREMENT /begin SUB_FUNCTION /end SUB_FUNCTION /end FUNCTION
/begin FUNCTION DIGIN "" /begin DEF_CHARACTERISTIC /end DEF_CHARACTERISTIC /begin REF_CHARACTERISTIC /end REF_CHARACTERISTIC /begin IN_MEASUREMENT /end IN_MEASUREMENT
 /begin OUT_MEASUREMENT EAS_lsp1hk EAS_lsp1ik EAS_lsp2hk EAS_lsp2ik ES_dksf ES_kl15 ES_res1 ES_res2 ES_rge ES_sfmdk ES_wda S_kl15 S_kupp1 S_kupp2 /end OUT_MEASUREMENT
 /begin LOC_MEASUREMENT /end LOC_MEASUREMENT
 /begin SUB_FUNCTION /end SUB_FUNCTION
/end FUNCTION
/begin FUNCTION DIGOUT "" /begin DEF_CHARACTERISTIC /end DEF_CHARACTERISTIC /begin REF_CHARACTERISTIC /end REF_CHARACTERISTIC
 /begin IN_MEASUREMENT AS_dimdk AS_hr AS_nl AS_psoff B_ausc_act B_ekp B_hfmsl B_hklvent B_hshe B_hshe2 B_slp B_slv B_sta B_su /end IN_MEASUREMENT
 /begin OUT_MEASUREMENT /end OUT_MEASUREMENT
 /begin LOC_MEASUREMENT /end LOC_MEASUREMENT
 /begin SUB_FUNCTION /end SUB_FUNCTION
/end FUNCTION
/begin FUNCTION DIMC "OBDII; inspection/maintenance-ready" /begin DEF_CHARACTERISTIC SRYAGR SRYHS SRYKAT SRYLS SRYSLS /end DEF_CHARACTERISTIC /begin REF_CHARACTERISTIC /end REF_CHARACTERISTIC
 /begin IN_MEASUREMENT B_cdagr B_cddmtl B_cdhsv B_cdkat B_cdldp B_cdlsv B_cdsls B_cdtes B_katfz B_pwf cd_bits1_w cd_bits2_w /end IN_MEASUREMENT
 /begin OUT_MEASUREMENT B_agrrdy B_hsrdy B_kathrdy B_katrdy B_kkrdy B_lsrdy B_slsrdy B_tesrdy evsup1 ready /end OUT_MEASUREMENT
 /begin LOC_MEASUREMENT cryhs crykat cryls crysls crytes /end LOC_MEASUREMENT
 /begin SUB_FUNCTION /end SUB_FUNCTION
/end FUNCTION
/begin FUNCTION DISTAB "" /begin DEF_CHARACTERISTIC EBEN EBMISS_T EBMISS_Y /end DEF_CHARACTERISTIC /begin REF_CHARACTERISTIC /end REF_CHARACTERISTIC /begin IN_MEASUREMENT /end IN_MEASUREMENT
 /begin OUT_MEASUREMENT B_ebDavT B_ebDavY ebCtrNewT ebCtrNewY ebCtrOldT ebCtrOldY ebMissT ebMissY /end OUT_MEASUREMENT
 /begin LOC_MEASUREMENT /end LOC_MEASUREMENT
 /begin SUB_FUNCTION /end SUB_FUNCTION
/end FUNCTION
/begin COMPU_METHOD B_TRUE "boolsche Zust‰nde, positive Logik" TAB_VERB "%6.3" "" COMPU_TAB_REF B_TRUE /end COMPU_METHOD
/begin COMPU_VTAB B_TRUE "boolsche Zust‰nde, positive Logik" TAB_VERB 2 0 "----" 1 "TRUE" /end COMPU_VTAB
/begin COMPU_METHOD dez "1 : 1 Umrechnug (dez/hex)" RAT_FUNC "%6.2" "" COEFFS 0 1 0 0 0 1 /end COMPU_METHOD
/begin COMPU_METHOD fak_ub_b64 "" RAT_FUNC "%6.3" "-" COEFFS 0 256 0 0 0 64 /end COMPU_METHOD
/begin COMPU_METHOD fak_ub_q0p01 "" RAT_FUNC "%6.4" "-" COEFFS 0 1 0 0 0 0.01 /end COMPU_METHOD
/begin COMPU_METHOD fak_uw_b1 "" RAT_FUNC "%7.6" "-" COEFFS 0 65536 0 0 0 1 /end COMPU_METHOD
/begin COMPU_METHOD fak_uw_b16 "" RAT_FUNC "%6.5" "-" COEFFS 0 65536 0 0 0 16 /end COMPU_METHOD
/begin COMPU_METHOD fak_uw_b2 "" RAT_FUNC "%7.6" "-" COEFFS 0 65536 0 0 0 2 /end COMPU_METHOD
/begin COMPU_METHOD fak_uw_b4 "" RAT_FUNC "%7.6" "-" COEFFS 0 65536 0 0 0 4 /end COMPU_METHOD
/begin COMPU_METHOD m_q0p1 "" RAT_FUNC "%6.3" "kg/h" COEFFS 0 10 0 0 0 1 /end COMPU_METHOD
/begin COMPU_METHOD m_uw_b6553p5 "" RAT_FUNC "%6.3" "kg/h" COEFFS 0 1 0 0 0 0.1 /end COMPU_METHOD
/begin COMPU_METHOD nmot_ub_q40 "" RAT_FUNC "%6.1" "1/min" COEFFS 0 1 0 0 0 40 /end COMPU_METHOD
/begin COMPU_METHOD relDK_q0p02441 "" RAT_FUNC "%6.4" "%DK" COEFFS 0 65536 0 0 0 1600 /end COMPU_METHOD
/begin COMPU_METHOD rel_uw_b100 "" RAT_FUNC "%6.4" "%" COEFFS 0 65536 0 0 0 100 /end COMPU_METHOD
/begin COMPU_METHOD r_q0p0391 "" RAT_FUNC "%6.4" "Ohm" COEFFS 0 65536 0 0 0 2560 /end COMPU_METHOD
/begin COMPU_METHOD r_q8 "" RAT_FUNC "%6.2" "Ohm" COEFFS 0 1 0 0 0 8 /end COMPU_METHOD
/begin COMPU_METHOD r_uw_q2 "" RAT_FUNC "%6.2" "Ohm" COEFFS 0 1 0 0 0 2 /end COMPU_METHOD
/begin COMPU_METHOD spg_ubatt "" RAT_FUNC "%6.3" "V" COEFFS 0 1 0 0 0 0.0942 /end COMPU_METHOD
/begin COMPU_METHOD spg_ub_b5 "" RAT_FUNC "%6.4" "V" COEFFS 0 256 0 0 0 5 /end COMPU_METHOD
/begin COMPU_METHOD t100msxs_uw_b6553p5 "" RAT_FUNC "%6.3" "s" COEFFS 0 1 0 0 0 0.1 /end COMPU_METHOD
/begin COMPU_METHOD t10msxs_ub_b2p55 "" RAT_FUNC "%6.4" "s" COEFFS 0 1 0 0 0 0.01 /end COMPU_METHOD
/begin COMPU_METHOD t1sxs_ub_b255 "" RAT_FUNC "%6.2" "s" COEFFS 0 1 0 0 0 1 /end COMPU_METHOD
/begin COMPU_METHOD t1sxs_uw_q1 "" RAT_FUNC "%6.2" "s" COEFFS 0 1 0 0 0 1 /end COMPU_METHOD
/begin COMPU_METHOD temp_q0p0234_o273 "" RAT_FUNC "%6.1" "Grad C" COEFFS 0 1 273.15 0 0 0.0234375 /end COMPU_METHOD
/begin COMPU_METHOD t_q0p1 "" RAT_FUNC "%6.3" "s" COEFFS 0 10 0 0 0 1 /end COMPU_METHOD
/begin COMPU_METHOD vol_q0p0039 "" RAT_FUNC "%6.4" "L" COEFFS 0 256 0 0 0 1 /end COMPU_METHOD
/begin COMPU_METHOD vol_q0p1_l "" RAT_FUNC "%6.3" "l" COEFFS 0 1 0 0 0 0.1 /end COMPU_METHOD
/begin COMPU_METHOD zk100msxs_uw_b6553 "" RAT_FUNC "%10.3" "s" COEFFS 0 0 65536 0 10 0 /end COMPU_METHOD
/begin COMPU_METHOD zk10msxs_ub_b2p55 "" RAT_FUNC "%6.4" "s" COEFFS 0 0 255 0 100 0 /end COMPU_METHOD
/begin COMPU_METHOD zk200msxs_uw_b13107 "" RAT_FUNC "%10.2" "s" COEFFS 0 0 13107 0 1 0 /end COMPU_METHOD
/begin COMPU_METHOD default "" RAT_FUNC "%6.2" "" COEFFS 0 1 0 0 0 1 /end COMPU_METHOD
/begin RECORD_LAYOUT KfAxUbAyUbSstxSwSstyUbWSw NO_AXIS_PTS_X 1 UBYTE NO_AXIS_PTS_Y 2 UBYTE AXIS_PTS_X 3 SWORD INDEX_INCR DIRECT AXIS_PTS_Y 4 UBYTE INDEX_INCR DIRECT FNC_VALUES 5 SWORD COLUMN_DIR DIRECT /end RECORD_LAYOUT
/begin RECORD_LAYOUT KfAxUbAyUbSstxUwSstyUbWUb NO_AXIS_PTS_X 1 UBYTE NO_AXIS_PTS_Y 2 UBYTE AXIS_PTS_X 3 UWORD INDEX_INCR DIRECT AXIS_PTS_Y 4 UBYTE INDEX_INCR DIRECT FNC_VALUES 5 UBYTE COLUMN_DIR DIRECT /end RECORD_LAYOUT
/begin RECORD_LAYOUT KlAUbSstUwWUb NO_AXIS_PTS_X 1 UBYTE AXIS_PTS_X 2 UWORD INDEX_INCR DIRECT FNC_VALUES 3 UBYTE COLUMN_DIR DIRECT /end RECORD_LAYOUT
/begin RECORD_LAYOUT KlAUwSstUwWUw NO_AXIS_PTS_X 1 UWORD AXIS_PTS_X 2 UWORD INDEX_INCR DIRECT FNC_VALUES 3 UWORD COLUMN_DIR DIRECT /end RECORD_LAYOUT
/begin RECORD_LAYOUT KwbUb FNC_VALUES 1 UBYTE COLUMN_DIR DIRECT /end RECORD_LAYOUT
/begin RECORD_LAYOUT KwbUw FNC_VALUES 1 UWORD COLUMN_DIR DIRECT /end RECORD_LAYOUT
/begin RECORD_LAYOUT KwbWU16 FNC_VALUES 1 UWORD COLUMN_DIR DIRECT /end RECORD_LAYOUT
/begin RECORD_LAYOUT KwbWU8 FNC_VALUES 1 UBYTE COLUMN_DIR DIRECT /end RECORD_LAYOUT
/begin RECORD_LAYOUT KwSw FNC_VALUES 1 SWORD COLUMN_DIR DIRECT /end RECORD_LAYOUT
/begin RECORD_LAYOUT KwUb FNC_VALUES 1 UBYTE COLUMN_DIR DIRECT /end RECORD_LAYOUT
/begin RECORD_LAYOUT KwUw FNC_VALUES 1 UWORD COLUMN_DIR DIRECT /end RECORD_LAYOUT
/begin RECORD_LAYOUT KwWU16 FNC_VALUES 1 UWORD COLUMN_DIR DIRECT /end RECORD_LAYOUT
/begin RECORD_LAYOUT KwWU8 FNC_VALUES 1 UBYTE COLUMN_DIR DIRECT /end RECORD_LAYOUT
/end MODULE
/end PROJECT
