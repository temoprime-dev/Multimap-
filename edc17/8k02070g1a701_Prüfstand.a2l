ASAP2_VERSION 1 3
/begin PROJECT _9702_071D00 "ME97"
/begin HEADER "" VERSION "_9702_071D00" PROJECT_NO _9702_071D00 /end HEADER
/begin MODULE DIM ""
/begin MOD_COMMON "" BYTE_ORDER MSB_FIRST ALIGNMENT_BYTE 1 ALIGNMENT_WORD 2 ALIGNMENT_LONG 2 ALIGNMENT_FLOAT32_IEEE 4 /end MOD_COMMON
/begin CHARACTERISTIC ATISLATM "Anzti-Schwelle zur Umschaltung von lamns_w auf lamwl_w" CURVE 0x1CC03C GklWUw 65535.00 dez 0.00 65535.00 FORMAT "%8.2"
 /begin AXIS_DESCR COM_AXIS tmst temp_ub_q0p75_o48 12 -48.00 143.3 AXIS_PTS_REF STS12ESUB /end AXIS_DESCR
/end CHARACTERISTIC
/begin CHARACTERISTIC ATIWKSTM "Anzti-Schwelle zur Umschaltung von lamns_w auf lamwl_w bei Wiederholkaltstart" CURVE 0x1CC054 GklWUw 65535.00 dez 0.00 65535.00 FORMAT "%8.2"
 /begin AXIS_DESCR COM_AXIS tmst temp_ub_q0p75_o48 12 -48.00 143.3 AXIS_PTS_REF STS12ESUB /end AXIS_DESCR
/end CHARACTERISTIC
/begin CHARACTERISTIC BFNSOL "N-Sollwert im Betrieb bei Fahrt als f(Motortemp.)" CURVE 0x1C6D58 GklWUb 2550. nmot_q10 0.00 2550. FORMAT "%5.0"
 /begin AXIS_DESCR COM_AXIS tmot temp_ub_q0p75_o48 6 -48.00 143.3 AXIS_PTS_REF STM06LLUB /end AXIS_DESCR
/end CHARACTERISTIC
/begin CHARACTERISTIC BNNSOL "N-Sollwert im Betrieb in Neutral als f(Motortemp.)" CURVE 0x1C6D60 GklWUb 2550. nmot_q10 0.00 2550. FORMAT "%5.0"
 /begin AXIS_DESCR COM_AXIS tmot temp_ub_q0p75_o48 6 -48.00 143.3 AXIS_PTS_REF STM06LLUB /end AXIS_DESCR
/end CHARACTERISTIC
/begin CHARACTERISTIC CNFKUPPL "Konfigurationsflag f¸r die Auswertung des Kuplg.schalters in der LLR" VALUE 0x1C6D30 KwUb 255.0 dez 0.00 255.0 FORMAT "%5.1" /end CHARACTERISTIC
/begin CHARACTERISTIC CNFLLRNS "Configurationsbyte f¸r die LL-Solldrehzahlfreigabe" VALUE 0x1CF704 KwUb 255.0 dez 0.00 255.0 FORMAT "%5.1" /end CHARACTERISTIC
/begin CHARACTERISTIC CWBBDSLS "Codeword f¸r %BBDSLS" VALUE 0x1CD046 KwWU8 255.0 dez 0.00 255.0 FORMAT "%5.1" /end CHARACTERISTIC
/begin CHARACTERISTIC CWBGDSLS "Codeword f¸r %BGDSLS" VALUE 0x1CD047 KwWU8 255.0 dez 0.00 255.0 FORMAT "%5.1" /end CHARACTERISTIC
/begin CHARACTERISTIC CWDLRIKL "" VALUE 0x1C3A30 KwUb 255.0 dez 0.00 255.0 FORMAT "%5.1" /end CHARACTERISTIC
/begin CHARACTERISTIC CWDSLS "Codeword zur Auswahl der DSLS (aktive oder passive Variante)" VALUE 0x1CD048 KwWU8 255.0 dez 0.00 255.0 FORMAT "%5.1" /end CHARACTERISTIC
/begin CHARACTERISTIC CWFAN "Codewort Drehzahlanforderung f¸r Bandendetest" VALUE 0x1CF6EE KwUb 255.0 dez 0.00 255.0 FORMAT "%5.1" /end CHARACTERISTIC
/begin CHARACTERISTIC CWKOSLKH "Codeword f¸r %KOSLKH" VALUE 0x1CD049 KwWU8 255.0 dez 0.00 255.0 FORMAT "%5.1" /end CHARACTERISTIC
/begin CHARACTERISTIC CWKRREF "Codewort: Verhalten Referenzpegelnachf¸hrung bei Drehzahldynamik" VALUE 0x1C65B8 KwWU8 1.000 dez 0.00 1.000 FORMAT "%5.3" /end CHARACTERISTIC
/begin CHARACTERISTIC CWKUPPL "Codewort f¸r Kupplung" VALUE 0x1C6F98 KwUb 255.0 dez 0.00 255.0 FORMAT "%5.1" /end CHARACTERISTIC
/begin CHARACTERISTIC CWLAMBTS "Codewort: Lambda Bauteileschutz" VALUE 0x1CBCAC KwUb 255.0 dez 0.00 255.0 FORMAT "%5.1" /end CHARACTERISTIC
/begin CHARACTERISTIC CWLAMFAW "Codeword LAMFAW" VALUE 0x1CF510 KwUb 255.0 dez 0.00 255.0 FORMAT "%5.1" /end CHARACTERISTIC
/begin CHARACTERISTIC CWLAMKH "Codewort Lambdakoordination bei Kat-heizen" VALUE 0x1C48EE KwUb 255.0 dez 0.00 255.0 FORMAT "%5.1" /end CHARACTERISTIC
/begin CHARACTERISTIC CWLBK "Codewort f¸r die Ladungsbewegungsklappe" VALUE 0x1CA6FA KwUb 255.0 dez 0.00 255.0 FORMAT "%5.1" /end CHARACTERISTIC
/begin CHARACTERISTIC CWLBKDC "Codewort Ladungsbewegungsklappe f¸r DC" VALUE 0x1CA6FB KwUb 255.0 dez 0.00 255.0 FORMAT "%5.1" /end CHARACTERISTIC
/begin CHARACTERISTIC CWLLDE "Codewort f¸r Drehzahleinbruch" VALUE 0x1CF7EC KwUb 255.0 dez 0.00 255.0 FORMAT "%5.1" /end CHARACTERISTIC
/begin CHARACTERISTIC CWNSTAT "Codewort zur nstat-Filterung" VALUE 0x1CF705 KwUb 255.0 dez 0.00 255.0 FORMAT "%5.1" /end CHARACTERISTIC
/begin CHARACTERISTIC CWREFI "Codewort: Neuinitialisierung von rkr mit REFINI bei Dynamik" VALUE 0x1C65B9 KwWU8 1.000 dez 0.00 1.000 FORMAT "%5.3" /end CHARACTERISTIC
/begin CHARACTERISTIC CWWL "Codewort f¸r Warmlaufsteuerung" VALUE 0x1C48F4 KwUb 255.0 dez 0.00 255.0 FORMAT "%5.1" /end CHARACTERISTIC
/begin CHARACTERISTIC DANTGESWNV "Schwelle Aktivierung D-Anteil (Geschwindigkeit) im unverst‰rkten Bereich" VALUE 0x1C3AE2 KwSw 1599.976 relDK_q0p02441 -800.0000 799.9756 FORMAT "%8.4" /end CHARACTERISTIC
/begin CHARACTERISTIC DANTGESWV "Schwelle Aktivierung D-Anteil (Geschwindigkeit) im verst‰rkten Bereich" VALUE 0x1C3AE4 KwSw 1599.976 relDK_q0p02441 -800.0000 799.9756 FORMAT "%8.4" /end CHARACTERISTIC
/begin CHARACTERISTIC DANTSCHWNV "Schwelle Aktivierung D-Anteil (Abweichung) im unverst‰rkten Bereich" VALUE 0x1C3AE6 KwSw 1599.976 relDK_q0p02441 -800.0000 799.9756 FORMAT "%8.4" /end CHARACTERISTIC
/begin CHARACTERISTIC DANTSCHWV "Schwelle Aktivierung D-Anteil (Abweichung) im verst‰rkten Bereich" VALUE 0x1C3AE8 KwSw 1599.976 relDK_q0p02441 -800.0000 799.9756 FORMAT "%8.4" /end CHARACTERISTIC
/begin CHARACTERISTIC DKLAGERT "zul‰ssige Fehlerzeit f¸r DK-Soll-/Istvergleich" VALUE 0x1C3A31 KwUb 5.100 t20msxs_ub_b5p1 0.00 5.100 FORMAT "%5.3" /end CHARACTERISTIC
/begin CHARACTERISTIC DLAMFAW "Schwellwert f¸r Aktivierung Anfettung ¸ber Fahrerwunsch" VALUE 0x1CF511 KwUb 1.992 fak_ub_b2 0.00 1.992 FORMAT "%5.3" /end CHARACTERISTIC
/begin CHARACTERISTIC DLAMNSWL "max. Abweichung f¸r lamnswl_w=1.0" VALUE 0x1C48F5 KwUb 0.9961 fak_ub_b1 0.00 0.9961 /end CHARACTERISTIC
/begin CHARACTERISTIC DLAMTANS "Lufttemperaturabh‰ngige Anfettung" CURVE 0x1CF5BB KlAUbSstUbWSb 1.992 fak_sb_b1 -1.000 0.9922 FORMAT "%5.3"
 /begin AXIS_DESCR STD_AXIS tans temp_ub_q0p75_o48 4 -48.00 143.3 FORMAT "%5.1" DEPOSIT ABSOLUTE /end AXIS_DESCR
/end CHARACTERISTIC
/begin CHARACTERISTIC DLRDWDKSS1 "DLR, obere Grenze zur Parameterumschaltung" VALUE 0x1C3AEA KwSw 99.99847 relDK_q0p00152 -50.00000 49.99847 FORMAT "%8.5" /end CHARACTERISTIC
/begin CHARACTERISTIC DLRDWDKSS2 "DLR, untere Grenze zur Parameterumschaltung" VALUE 0x1C3AEC KwSw 99.99847 relDK_q0p00152 -50.00000 49.99847 FORMAT "%8.5" /end CHARACTERISTIC
/begin CHARACTERISTIC DLRHAFTMN "min. notwendiger I-Anteil im Haftreibunsfall" VALUE 0x1CA8E2 KwSw 100.0000 rel_q0p1957 -100.0000 0.00 FORMAT "%8.4" /end CHARACTERISTIC
/begin CHARACTERISTIC DLRHAFTST "max. Sollwertgradient zur Aktivierung der Haftreibunsroutine" VALUE 0x1CA8E4 KwSw 99.99847 relDK_q0p00152 -50.00000 49.99847 FORMAT "%8.5" /end CHARACTERISTIC
/begin CHARACTERISTIC DLRIAMAXA "maximal zul‰ssiger I-Anteil" VALUE 0x1C3AEE KwUw 100.0000 rel_q0p1957 0.00 100.0000 FORMAT "%8.4" /end CHARACTERISTIC
/begin CHARACTERISTIC DLRIKLPAR "DLR, I-Klein Parameter" VALUE 0x1C3A32 KwUb 15.94 relDK_q0p0625 0.00 15.94 FORMAT "%5.2" /end CHARACTERISTIC
/begin CHARACTERISTIC DLRININI "I-Anteil bei Inititialisierung der NLP-Funktion" VALUE 0x1C3AF0 KwUw 100.0000 relDK_q0p1957 0.00 100.0000 FORMAT "%8.4" /end CHARACTERISTIC
/begin CHARACTERISTIC DLRKDONLP0 "DLR, D-Parameter ¸ber NLP" VALUE 0x1C3A33 KwUb 1020. relDK_q4 0.00 1020. FORMAT "%5.0" /end CHARACTERISTIC
/begin CHARACTERISTIC DLRKDUNLP0 "DLR, D-Parameter unter NLP (schwach)" VALUE 0x1C3A34 KwUb 1020. relDK_q4 0.00 1020. FORMAT "%5.0" /end CHARACTERISTIC
/begin CHARACTERISTIC DLRKDUNLP1 "DLR, D-Parameter unter NLP (mittel)" VALUE 0x1C3A35 KwUb 1020. relDK_q4 0.00 1020. FORMAT "%5.0" /end CHARACTERISTIC
/begin CHARACTERISTIC DLRKDUNLP2 "DLR, D-Parameter unter NLP (stark)" VALUE 0x1C3A36 KwUb 1020. relDK_q4 0.00 1020. FORMAT "%5.0" /end CHARACTERISTIC
/begin CHARACTERISTIC DLRKDUNLP3 "DLR, D-Parameter unter NLP (unverst‰rktes Poti)" VALUE 0x1C3A37 KwUb 1020. relDK_q4 0.00 1020. FORMAT "%5.0" /end CHARACTERISTIC
/begin CHARACTERISTIC DLRKIONLP0 "I-Anteil als f(abs(dwdkdlr_w)), ¸ber NLP" VAL_BLK 0x1C3A38 KwbUb 15.94 relDK_q0p0625 0.00 15.94 FORMAT "%5.2" NUMBER 32 /end CHARACTERISTIC
/begin CHARACTERISTIC DLRKIUNLP0 "I-Anteil als f(abs(dwdkdlr_w)), unter NLP (schwach)" VAL_BLK 0x1C3A58 KwbUb 15.94 relDK_q0p0625 0.00 15.94 FORMAT "%5.2" NUMBER 32 /end CHARACTERISTIC
/begin CHARACTERISTIC DLRKIUNLP1 "I-Anteil als f(abs(dwdkdlr_w)), unter NLP (mittel)" VAL_BLK 0x1C3A78 KwbUb 15.94 relDK_q0p0625 0.00 15.94 FORMAT "%5.2" NUMBER 32 /end CHARACTERISTIC
/begin CHARACTERISTIC DLRKIUNLP2 "I-Anteil als f(abs(dwdkdlr_w)), unter NLP (stark)" VAL_BLK 0x1C3A98 KwbUb 15.94 relDK_q0p0625 0.00 15.94 FORMAT "%5.2" NUMBER 32 /end CHARACTERISTIC
/begin CHARACTERISTIC DLRKIUNLP3 "I-Anteil als f(abs(dwdkdlr_w)), unter NLP (stark)" VAL_BLK 0x1C3AB8 KwbUb 15.94 relDK_q0p0625 0.00 15.94 FORMAT "%5.2" NUMBER 32 /end CHARACTERISTIC
/begin CHARACTERISTIC DLRKPONLP0 "DLR, P-Parameter ¸ber NLP" VALUE 0x1C3AD8 KwUb 255.0 relDK_q1 0.00 255.0 FORMAT "%5.1" /end CHARACTERISTIC
/begin CHARACTERISTIC DLRKPUNLP0 "DLR, P-Parameter unter NLP (schwach)" VALUE 0x1C3AD9 KwUb 255.0 relDK_q1 0.00 255.0 FORMAT "%5.1" /end CHARACTERISTIC
/begin CHARACTERISTIC DLRKPUNLP1 "DLR, P-Parameter unter NLP (mittel)" VALUE 0x1C3ADA KwUb 255.0 relDK_q1 0.00 255.0 FORMAT "%5.1" /end CHARACTERISTIC
/begin CHARACTERISTIC DLRKPUNLP2 "DLR, P-Parameter unter NLP (stark)" VALUE 0x1C3ADB KwUb 255.0 relDK_q1 0.00 255.0 FORMAT "%5.1" /end CHARACTERISTIC
/begin CHARACTERISTIC DLRKPUNLP3 "DLR, P-Parameter unter NLP (unverst‰rktes Poti)" VALUE 0x1C3ADC KwUb 255.0 relDK_q1 0.00 255.0 FORMAT "%5.1" /end CHARACTERISTIC
/begin CHARACTERISTIC DLRKREIS "DLR, Faktor Kreisverst‰rkung" VALUE 0x1CA8DC KwUb 1.992 fak_ub_b2 0.00 1.992 FORMAT "%5.3" /end CHARACTERISTIC
/begin CHARACTERISTIC DLRKREISST "DLR, Faktor Kreisverst‰rkung zur Zeit des Motorstarts" VALUE 0x1CA8DD KwUb 1.992 fak_ub_b2 0.00 1.992 FORMAT "%5.3" /end CHARACTERISTIC
/begin CHARACTERISTIC DLRNLPD "Unsch‰rfebereich f¸r DK-Notluftposition" VALUE 0x1C3AF2 KwUw 100.0000 relDK_uw_b100 0.00 100.0000 FORMAT "%8.4" /end CHARACTERISTIC
/begin CHARACTERISTIC DLRPID0T "Fehlerzeit f¸r DLR-Stellbereich im Anschlag zur erweiterten Stellertauscherkenng" VALUE 0x1C3AF4 KwUw 655.3500 t10msxs_uw_b655p35 0.00 655.3500 FORMAT "%8.4" /end CHARACTERISTIC
/begin CHARACTERISTIC DLRPID1T "zul‰ssige Fehlerzeit 1 f¸r DLR-Stellbereich am Anschlag" VALUE 0x1C3AF6 KwUw 655.3500 t10msxs_uw_b655p35 0.00 655.3500 FORMAT "%8.4" /end CHARACTERISTIC
/begin CHARACTERISTIC DLRPID2T "zul‰ssige Fehlerzeit 2 f¸r DLR-Stellbereich am Anschlag" VALUE 0x1C3AF8 KwUw 655.3500 t10msxs_uw_b655p35 0.00 655.3500 FORMAT "%8.4" /end CHARACTERISTIC
/begin CHARACTERISTIC DLRPIDMAX "max. zul‰ssiges PWM-Tastverh‰ltnis f¸r DLR" VALUE 0x1C3AFA KwUw 99.99847 rel_uw_b100 0.00 99.99847 FORMAT "%8.5" /end CHARACTERISTIC
/begin CHARACTERISTIC DLRPIDMIN "min. zul‰ssiges PWM-Tastverh‰ltnis f¸r DLR" VALUE 0x1C3AFC KwUw 99.99847 rel_uw_b100 0.00 99.99847 FORMAT "%8.5" /end CHARACTERISTIC
/begin CHARACTERISTIC DLRUBSOLL "DLR, Batterie Normalspannung" VALUE 0x1CA8DE KwUb 24.02 spg_ubatt 0.00 24.02 FORMAT "%5.2" /end CHARACTERISTIC
/begin CHARACTERISTIC DLRUMABAND "Unsicherheitsband bei Sprung aus UMA-Bereich" VALUE 0x1C3AFE KwUw 4.882813 relDK_q0p02441 0.00 4.882813 FORMAT "%8.6" /end CHARACTERISTIC
/begin CHARACTERISTIC DLRUMAIINI "Vorladewert I-Anteil bei Sprung aus UMA-Bereich" VALUE 0x1C3B00 KwSw 12824.85 relDK_q0p1957 -6412.524 6412.329 FORMAT "%8.3" /end CHARACTERISTIC
/begin CHARACTERISTIC DMRESLL "LLR: Abbaugeschwindigkeit der erhˆhten Drehmomentreserve" VALUE 0x1C6F99 KwUb 0.3891 rel_ub_q0p00153 0.00 0.3891 /end CHARACTERISTIC
/begin CHARACTERISTIC DMRESTM "Schrittweite zur Reduzierung der Momentenreserve nach Start" VALUE 0x1C6F9A KwUb 0.3891 rel_ub_q0p00153 0.00 0.3891 /end CHARACTERISTIC
/begin CHARACTERISTIC DMRKHST "Initialisierungswert f¸r Katheizmomentenreserve im Start" VALUE 0x1CCF9E KwWU16 99.99847 rel_uw_b100 0.00 99.99847 FORMAT "%8.5" /end CHARACTERISTIC
/begin CHARACTERISTIC DNLLR "Drehzahlband oberhalb nstat f¸r LLR-Freigabe" VALUE 0x1C6D31 KwUb 2550. nmot_ub_q10 0.00 2550. FORMAT "%5.0" /end CHARACTERISTIC
/begin CHARACTERISTIC DNLLRESW "LLR: Unterdrehzahlschwelle zur Erhˆhung der Momentenreserve im LL" VALUE 0x1C703C KwSw 16383.75 nmot_sw_q0p25 -8192.000 8191.750 FORMAT "%8.3" /end CHARACTERISTIC
/begin CHARACTERISTIC DNSNFST "Drehzahlschwelle f¸r nsol-Begrenzung im Start" VALUE 0x1CF706 KwUb 2550. nmot_q10 0.00 2550. FORMAT "%5.0" /end CHARACTERISTIC
/begin CHARACTERISTIC DNSNFX "Offset zur Bestimmung der oberen Grenze f¸r die Solldrehzahlnachf¸hrung" VALUE 0x1CF707 KwUb 2550. nmot_q10 0.00 2550. FORMAT "%5.0" /end CHARACTERISTIC
/begin CHARACTERISTIC DPSLV "minimale Druckdifferenz Sekund‰rluftventi" VALUE 0x1CD03A KwWU16 2559.961 p_uw_q0p039 0.00 2559.961 FORMAT "%8.3" /end CHARACTERISTIC
/begin CHARACTERISTIC DR10VK_T "Zeit f¸r Drivewechsel-Verzˆgerung, tmot < Schwelle" VALUE 0x1C6D66 KwUb 2.550 t10msxs_ub_b2p55 0.00 2.550 FORMAT "%5.3" /end CHARACTERISTIC
/begin CHARACTERISTIC DR10V_T "Zeit f¸r Drivewechsel-Verzˆgerung" VALUE 0x1C6D67 KwUb 2.550 t10msxs_ub_b2p55 0.00 2.550 FORMAT "%5.3" /end CHARACTERISTIC
/begin CHARACTERISTIC DTBTS "Temperaturhysterese f¸r Bauteileschutz" VALUE 0x1CBF02 KwUw 1279.980 temp_uw_q0p0195 0.00 1279.980 FORMAT "%8.3" /end CHARACTERISTIC
/begin CHARACTERISTIC DVEEST "Zeit f¸r Heilungsversuch der DV-E-Endstufe" VALUE 0x1C3ADD KwUb 2.550 t10msxs_ub_b2p55 0.00 2.550 FORMAT "%5.3" /end CHARACTERISTIC
/begin CHARACTERISTIC DWDKSBAMX "max. Soll-/Ist-DK-Winkel-Abweichung als f(dwdks)" CURVE 0x1C3B02 KlAUwSstUwWUw 100.0000 relDK_uw_b100 0.00 100.0000 FORMAT "%8.4"
 /begin AXIS_DESCR STD_AXIS gwdk_kge relDK_q0p00152 5 0.00 99.99847 FORMAT "%8.5" DEPOSIT ABSOLUTE /end AXIS_DESCR
/end CHARACTERISTIC
/begin CHARACTERISTIC DWDKSIKLS "Schwelle zur Aktivierung des I-Kleinanteils" VALUE 0x1C3B18 KwSw 1599.976 relDK_q0p02441 -800.0000 799.9756 FORMAT "%8.4" /end CHARACTERISTIC
/begin CHARACTERISTIC DWKRMSN "delta Winkel KR Abstand zur gemittelten Sp‰tverstellung" CURVE 0x1CE9B0 GklWS8 20.25 zw_sb_q0p75 -20.25 0.00 FORMAT "%5.2"
 /begin AXIS_DESCR COM_AXIS nmot nmot_ub_q40 16 0.00 10200. AXIS_PTS_REF SNM16KRUB /end AXIS_DESCR
/end CHARACTERISTIC
/begin CHARACTERISTIC DYADMX "Max. Wert des add. Dynamikvorhalts" VALUE 0x1C65A9 KwWS8 24.00 zw_sb_q0p75 -24.00 0.00 FORMAT "%5.2" /end CHARACTERISTIC
/begin CHARACTERISTIC DYADS "Add. Sp‰tverstellung pro Zyk. durch lern. Dyn." VALUE 0x1C65AA KwWS8 24.00 zw_sb_q0p75 -24.00 0.00 FORMAT "%5.2" /end CHARACTERISTIC
/begin CHARACTERISTIC DYAFVS "Stufenhˆhe f¸r Abregelung des Dynamikvorhalts" VALUE 0x1C65AB KwWS8 20.25 zw_sb_q0p75 0.00 20.25 FORMAT "%5.2" /end CHARACTERISTIC
/begin CHARACTERISTIC DYAMNV "Min. Wert des add. Dynamikvorhalts" VALUE 0x1C65AC KwWS8 24.00 zw_sb_q0p75 -24.00 0.00 FORMAT "%5.2" /end CHARACTERISTIC
/begin CHARACTERISTIC DYAVF "Abregelkonstante f¸r Dynamikvorhalt" VALUE 0x1C65AD KwWU8 254.0 dez 1.000 255.0 FORMAT "%5.1" /end CHARACTERISTIC
/begin CHARACTERISTIC DZA01V_T "Verzˆgerungzeit f¸r Ubatt unterhalb Schwelle f¸r Drehzahlanhebung" VALUE 0x1CF708 KwUb 25.50 t100msxs_ub_b25p5 0.00 25.50 FORMAT "%5.2" /end CHARACTERISTIC
/begin CHARACTERISTIC DZAEHB_T "Zeit nach Startende bis Drehzahlanhebung durch EHB zul‰ssig" VALUE 0x1CF709 KwUb 25.50 t100msxs_ub_b25p5 0.00 25.50 FORMAT "%5.2" /end CHARACTERISTIC
/begin CHARACTERISTIC DZAFGV_T "Drehzahlanhebungs-Freigabeverzˆgerungszeit" VALUE 0x1CF70A KwUb 25.50 t100msxs_ub_b25p5 0.00 25.50 FORMAT "%5.2" /end CHARACTERISTIC
/begin CHARACTERISTIC DZA_O_MT "obere Motortemperaturschwelle f¸r Drehzahlanhebung" VALUE 0x1CF70B KwUb 191.3 temp_ub_q0p75_o48 -48.00 143.3 FORMAT "%5.1" /end CHARACTERISTIC
/begin CHARACTERISTIC DZA_U_MT "untere Motortemperaturschwelle f¸r Drehzahlanhebung" VALUE 0x1CF70C KwUb 191.3 temp_ub_q0p75_o48 -48.00 143.3 FORMAT "%5.1" /end CHARACTERISTIC
/begin CHARACTERISTIC DZWTIN "delta-Z¸ndwinkel bei Tip in" CURVE 0x1CE8D4 GklWS8 24.00 zw_sb_q0p75 -24.00 0.00 FORMAT "%5.2"
 /begin AXIS_DESCR COM_AXIS nmot nmot_ub_q40 16 0.00 10200. AXIS_PTS_REF SNM16KRUB /end AXIS_DESCR
/end CHARACTERISTIC
/begin CHARACTERISTIC FBSTABGM "Faktor Bauteileschutz abh‰ngig von model. Abgastemperatur" CURVE 0x1CBF04 KlAUwSstUwWUw 1.999969 fak_uw_b2 0.00 1.999969 FORMAT "%8.6"
 /begin AXIS_DESCR STD_AXIS tabgbts_w temp_uw_q0p0195_o50 4 -50.00000 1229.980 FORMAT "%8.3" DEPOSIT ABSOLUTE /end AXIS_DESCR
/end CHARACTERISTIC
/begin CHARACTERISTIC FBSTMOT "Offset Bauteileschutz abh‰ngig von Motor-Temperatur" CURVE 0x1CBF16 KlAUbSstUbWSb 1.992 fak_sb_b1 -1.000 0.9922 FORMAT "%5.3"
 /begin AXIS_DESCR STD_AXIS tmot temp_ub_q0p75_o48 4 -48.00 143.3 FORMAT "%5.1" DEPOSIT ABSOLUTE /end AXIS_DESCR
/end CHARACTERISTIC
/begin CHARACTERISTIC FHOSLS "minimaler Hˆhenfaktor f¸r Sekund‰rlufteinblasung" VALUE 0x1CD03C KwWU16 3.999939 fak_uw_b4 0.00 3.999939 FORMAT "%8.6" /end CHARACTERISTIC
/begin CHARACTERISTIC FKEFMC "Korrekturfaktor f¸r Klopferkennungsschwelle bei Filtermittenfrequenzumschaltung" VALUE 0x1C65BA KwWU8 2.000 fak_ub_b16 0.00 2.000 FORMAT "%5.3" /end CHARACTERISTIC
/begin CHARACTERISTIC FKELDY "Korrekturfaktor f¸r Klopferkennungsschwelle bei Lastdynamik" VALUE 0x1C65BB KwWU8 2.000 fak_ub_b16 0.00 2.000 FORMAT "%5.3" /end CHARACTERISTIC
/begin CHARACTERISTIC FKELDYA "Korrekturfaktor f¸r Klopferkennungsschwelle bei Lastdynamikadaption" VALUE 0x1C65AE KwWU8 15.94 fak_ub_b16 0.00 15.94 FORMAT "%5.2" /end CHARACTERISTIC
/begin CHARACTERISTIC FKENDY "Korrekturfaktor f¸r Klopferkennungsschwelle bei Drehzahldynamik" VALUE 0x1C65BC KwWU8 2.000 fak_ub_b16 0.00 2.000 FORMAT "%5.3" /end CHARACTERISTIC
/begin CHARACTERISTIC FKRFTPFMC "Korrekturfaktor des Tiefpaﬂverhaltens bei Umschaltung der Filtermittenfrequenz" VALUE 0x1C65BD KwWU8 0.5000 fak_ub_b2 0.5000 1.000 FORMAT "%5.3" /end CHARACTERISTIC
/begin CHARACTERISTIC FLBE "Ersatzwert f¸r den Ist-LBK-Faktor" VALUE 0x1CA806 KwUw 0.9999847 fak_uw_b1 0.00 0.9999847 FORMAT "%9.7" /end CHARACTERISTIC
/begin CHARACTERISTIC FLBLBK "Umrechnung LBK-Klappenposition in Faktor Ladungsbewegung" CURVE 0x1CA808 KlAUwSstUwWUw 0.9999847 fak_uw_b1 0.00 0.9999847 FORMAT "%9.7"
 /begin AXIS_DESCR STD_AXIS lbkist_w rel_uw_b100 6 0.00 99.99847 FORMAT "%8.5" DEPOSIT ABSOLUTE /end AXIS_DESCR
/end CHARACTERISTIC
/begin CHARACTERISTIC FLBSAP "Applikationsvorgabe f¸r Faktor Ladungswegegung" VALUE 0x1CA6FC KwUb 0.9961 fak_ub_b1 0.00 0.9961 /end CHARACTERISTIC
/begin CHARACTERISTIC FLBSWSTART "Faktor Ladungsbewegung im Start" VALUE 0x1CA6FD KwUb 0.9961 fak_ub_b1 0.00 0.9961 /end CHARACTERISTIC
/begin CHARACTERISTIC FNSNF "Faktor f¸r Solldrehzahlnachf¸hrung" VALUE 0x1CF70D KwUb 0.9961 fak_ub_b1 0.00 0.9961 /end CHARACTERISTIC
/begin CHARACTERISTIC FNSSTKM "Faktor zur Wichtung der Solldrehzahl im Start bei Kat-Heizen" CURVE 0x1CF710 KlAUbSstUbWUb 1.992 fak_ub_b2 0.00 1.992 FORMAT "%5.3"
 /begin AXIS_DESCR STD_AXIS tmot temp_ub_q0p75_o48 6 -48.00 143.3 FORMAT "%5.1" DEPOSIT ABSOLUTE /end AXIS_DESCR
/end CHARACTERISTIC
/begin CHARACTERISTIC FNSSTM "Faktor zur Wichtung der Solldrehzahl im Start" CURVE 0x1CF720 KlAUbSstUbWUb 1.992 fak_ub_b2 0.00 1.992 FORMAT "%5.3"
 /begin AXIS_DESCR STD_AXIS tmot temp_ub_q0p75_o48 6 -48.00 143.3 FORMAT "%5.1" DEPOSIT ABSOLUTE /end AXIS_DESCR
/end CHARACTERISTIC
/begin CHARACTERISTIC FWLWHS "Lenkwinkel Hˆhenschwelle zur Abschaltung Klimakompressor" VALUE 0x1C86CE KwUw 3.999939 fak_uw_b4 0.00 3.999939 FORMAT "%8.6" /end CHARACTERISTIC
/begin CHARACTERISTIC FWVMIN "Untere Geschwindigkeitsschwelle f¸r v_lfr" VALUE 0x1C6D68 KwUb 63.75 vfzg_q0p25 0.00 63.75 FORMAT "%5.2" /end CHARACTERISTIC
/begin CHARACTERISTIC KDLRIDDVE "Identifizierung des DLR-Parametersatzes zu DV-E-Typ" VALUE 0x1CA8DF KwUb 255.0 dez 0.00 255.0 FORMAT "%5.1" /end CHARACTERISTIC
/begin CHARACTERISTIC KE1N "Klopferkennungsschwelle bei Zylinderz‰hler 1" CURVE 0x1CE924 GklWU8 3.500 fak_ub_b16 0.00 3.500 FORMAT "%5.3"
 /begin AXIS_DESCR COM_AXIS nmot nmot_ub_q40 16 0.00 10200. AXIS_PTS_REF SNM16KRUB /end AXIS_DESCR
/end CHARACTERISTIC
/begin CHARACTERISTIC KE2N "Klopferkennungsschwelle bei Zylinderz‰hler 2" CURVE 0x1CE934 GklWU8 3.500 fak_ub_b16 0.00 3.500 FORMAT "%5.3"
 /begin AXIS_DESCR COM_AXIS nmot nmot_ub_q40 16 0.00 10200. AXIS_PTS_REF SNM16KRUB /end AXIS_DESCR
/end CHARACTERISTIC
/begin CHARACTERISTIC KE3N "Klopferkennungsschwelle bei Zylinderz‰hler 3" CURVE 0x1CE944 GklWU8 3.500 fak_ub_b16 0.00 3.500 FORMAT "%5.3"
 /begin AXIS_DESCR COM_AXIS nmot nmot_ub_q40 16 0.00 10200. AXIS_PTS_REF SNM16KRUB /end AXIS_DESCR
/end CHARACTERISTIC
/begin CHARACTERISTIC KE4N "Klopferkennungsschwelle bei Zylinderz‰hler 4" CURVE 0x1CE954 GklWU8 3.500 fak_ub_b16 0.00 3.500 FORMAT "%5.3"
 /begin AXIS_DESCR COM_AXIS nmot nmot_ub_q40 16 0.00 10200. AXIS_PTS_REF SNM16KRUB /end AXIS_DESCR
/end CHARACTERISTIC
/begin CHARACTERISTIC KE5N "Klopferkennungsschwelle bei Zylinderz‰hler 5" CURVE 0x1CE964 GklWU8 3.500 fak_ub_b16 0.00 3.500 FORMAT "%5.3"
 /begin AXIS_DESCR COM_AXIS nmot nmot_ub_q40 16 0.00 10200. AXIS_PTS_REF SNM16KRUB /end AXIS_DESCR
/end CHARACTERISTIC
/begin CHARACTERISTIC KE6N "Klopferkennungsschwelle bei Zylinderz‰hler 6" CURVE 0x1CE974 GklWU8 3.500 fak_ub_b16 0.00 3.500 FORMAT "%5.3"
 /begin AXIS_DESCR COM_AXIS nmot nmot_ub_q40 16 0.00 10200. AXIS_PTS_REF SNM16KRUB /end AXIS_DESCR
/end CHARACTERISTIC
/begin CHARACTERISTIC KE7N "" CURVE 0x1CE984 GklWU8 3.500 fak_ub_b16 0.00 3.500 FORMAT "%5.3"
 /begin AXIS_DESCR COM_AXIS nmot nmot_ub_q40 16 0.00 10200. AXIS_PTS_REF SNM16KRUB /end AXIS_DESCR
/end CHARACTERISTIC
/begin CHARACTERISTIC KE8N "" CURVE 0x1CE994 GklWU8 3.500 fak_ub_b16 0.00 3.500 FORMAT "%5.3"
 /begin AXIS_DESCR COM_AXIS nmot nmot_ub_q40 16 0.00 10200. AXIS_PTS_REF SNM16KRUB /end AXIS_DESCR
/end CHARACTERISTIC
/begin CHARACTERISTIC KFDLBTS "Delta Lambdasoll f¸r Bauteileschutz" MAP 0x1CBF1F KfAxUbAyUbSstxUbSstyUbWSb 1.000 fak_sb_b1 -1.000 0.00 FORMAT "%5.3"
 /begin AXIS_DESCR STD_AXIS detazwbs rel_ub_b127p5 8 0.00 127.5 FORMAT "%5.1" DEPOSIT ABSOLUTE /end AXIS_DESCR
 /begin AXIS_DESCR STD_AXIS nmot nmot_ub_q40 4 0.00 10200. FORMAT "%5.0" DEPOSIT ABSOLUTE /end AXIS_DESCR
/end CHARACTERISTIC
/begin CHARACTERISTIC KFFDLBTS "Faktor Delta Lambdasoll f¸r Bauteileschutz" MAP 0x1CBCB0 GkfWUb 1.992 fak_ub_b2 0.00 1.992 FORMAT "%5.3"
 /begin AXIS_DESCR COM_AXIS rl_w rel_uw_q0p0234 12 0.00 1535.977 AXIS_PTS_REF SRL12GKUW /end AXIS_DESCR
 /begin AXIS_DESCR COM_AXIS nmot nmot_ub_q40 16 0.00 10200. AXIS_PTS_REF SNM16GKUB /end AXIS_DESCR
/end CHARACTERISTIC
/begin CHARACTERISTIC KFLAFWL "Offset Lambda-Motor-Soll" MAP 0x1CF514 GkfWSb 1.992 fak_sb_b1 -1.000 0.9922 FORMAT "%5.3"
 /begin AXIS_DESCR COM_AXIS tmot temp_ub_q0p75_o48 8 -48.00 143.3 AXIS_PTS_REF STM08GKUB /end AXIS_DESCR
 /begin AXIS_DESCR COM_AXIS rl rel_ub_q0p75 6 0.00 191.3 AXIS_PTS_REF SRL06GKUB /end AXIS_DESCR
/end CHARACTERISTIC
/begin CHARACTERISTIC KFLAMKR "Wichtungsfaktor f¸r Anfettung bei Z¸ndwinkelsp‰tverstellung" MAP 0x1CF544 GkfWUb 1.992 fak_ub_b2 0.00 1.992 FORMAT "%5.3"
 /begin AXIS_DESCR COM_AXIS nmot nmot_ub_q40 6 0.00 10200. AXIS_PTS_REF SNM06GKUB /end AXIS_DESCR
 /begin AXIS_DESCR COM_AXIS rl rel_ub_q0p75 6 0.00 191.3 AXIS_PTS_REF SRL06GKUB /end AXIS_DESCR
/end CHARACTERISTIC
/begin CHARACTERISTIC KFLAMKRL "Anfettung bei Z¸ndwinkelsp‰tverstellung" MAP 0x1CF568 GkfWUb 1.992 fak_ub_b2 0.00 1.992 FORMAT "%5.3"
 /begin AXIS_DESCR COM_AXIS dzwlamfaw zw_ub_qn0p75 6 -191.3 0.00 AXIS_PTS_REF SDZ06GKUB /end AXIS_DESCR
 /begin AXIS_DESCR COM_AXIS rl rel_ub_q0p75 6 0.00 191.3 AXIS_PTS_REF SRL06GKUB /end AXIS_DESCR
/end CHARACTERISTIC
/begin CHARACTERISTIC KFLANS "Kennfeld Lambda-Motor-Beschreibung im Nachstart" MAP 0x1C48F6 KfAxUbAyUbSstxUbSstyUwWUw 15.99976 fak_uw_b16 0.00 15.99976 FORMAT "%8.5"
 /begin AXIS_DESCR STD_AXIS tmst temp_ub_q0p75_o48 12 -48.00 143.3 FORMAT "%5.1" DEPOSIT ABSOLUTE /end AXIS_DESCR
 /begin AXIS_DESCR STD_AXIS anztib1_w dez 12 0.00 65535.00 FORMAT "%8.2" DEPOSIT ABSOLUTE /end AXIS_DESCR
/end CHARACTERISTIC
/begin CHARACTERISTIC KFLANSKH "Kennfeld Lambda-Motor-Vorgabe bei Katheizen im Nachstart" MAP 0x1C4F2C KfAxU8AyU8SstxU8SstyU16WU16 15.99976 fak_q0p000244 0.00 15.99976 FORMAT "%8.5"
 /begin AXIS_DESCR STD_AXIS tmst temp_ub_q0p75_o48 6 -48.00 143.3 FORMAT "%5.1" DEPOSIT ABSOLUTE /end AXIS_DESCR
 /begin AXIS_DESCR STD_AXIS anztib_w dez 12 0.00 65535.00 FORMAT "%8.2" DEPOSIT ABSOLUTE /end AXIS_DESCR
/end CHARACTERISTIC
/begin CHARACTERISTIC KFLASDSLS "Lambda-Abgas-Soll bei Sekund‰rluftadaption/Kurztest" MAP 0x1CCBF0 KfAxU8AyU8SstxU16SstyU16WU16 8.999756 fak_q0p000244 0.00 8.999756 FORMAT "%8.6"
 /begin AXIS_DESCR STD_AXIS nmot_w nmot_uw_q0p25 3 0.00 16383.75 FORMAT "%8.2" DEPOSIT ABSOLUTE /end AXIS_DESCR
 /begin AXIS_DESCR STD_AXIS rl_w rel_uw_q0p0234 3 0.00 1535.977 FORMAT "%8.3" DEPOSIT ABSOLUTE /end AXIS_DESCR
/end CHARACTERISTIC
/begin CHARACTERISTIC KFLASKH "Kennfeld Lambda-Abgas-Soll bei Katheizen" MAP 0x1CCC12 KfAxU8AyU8SstxU16SstyU16WU16 8.000000 fak_q0p000244 0.00 8.000000 FORMAT "%8.6"
 /begin AXIS_DESCR STD_AXIS nmot_w nmot_uw_q0p25 8 0.00 16383.75 FORMAT "%8.2" DEPOSIT ABSOLUTE /end AXIS_DESCR
 /begin AXIS_DESCR STD_AXIS rl_w rel_uw_q0p0234 8 0.00 1535.977 FORMAT "%8.3" DEPOSIT ABSOLUTE /end AXIS_DESCR
/end CHARACTERISTIC
/begin CHARACTERISTIC KFLASWLR "Kennfeld Lambda-Motor-Soll im Warmlauf bei aktiver LR" MAP 0x1CBFA0 GkfWUb 1.992 fak_ub_b2 0.00 1.992 FORMAT "%5.3"
 /begin AXIS_DESCR COM_AXIS tmot temp_ub_q0p75_o48 12 -48.00 143.3 AXIS_PTS_REF STM12ESUB /end AXIS_DESCR
 /begin AXIS_DESCR COM_AXIS tmst temp_ub_q0p75_o48 12 -48.00 143.3 AXIS_PTS_REF STS12ESUB /end AXIS_DESCR
/end CHARACTERISTIC
/begin CHARACTERISTIC KFLBKAPP "Kennfeld LBK-Sollwert zur Applikation" MAP 0x1CA700 KfAxUbAyUbSstxUwSstyUbWUb 0.9961 fak_ub_b1 0.00 0.9961
 /begin AXIS_DESCR STD_AXIS rk_w rel_uw_b3072 8 0.00 3071.953 FORMAT "%8.3" DEPOSIT ABSOLUTE /end AXIS_DESCR
 /begin AXIS_DESCR STD_AXIS nmot nmot_ub_q40 8 0.00 10200. FORMAT "%5.0" DEPOSIT ABSOLUTE /end AXIS_DESCR
/end CHARACTERISTIC
/begin CHARACTERISTIC KFLBKHOKHS "Kennfeld LBK-Sollwert im Homogenbetrieb w‰hrend Katheizen" MAP 0x1CA75A KfAxUbAyUbSstxUwSstyUbWUb 0.9961 fak_ub_b1 0.00 0.9961
 /begin AXIS_DESCR STD_AXIS milsol_w rel_uw_b100 6 0.00 99.99847 FORMAT "%8.5" DEPOSIT ABSOLUTE /end AXIS_DESCR
 /begin AXIS_DESCR STD_AXIS nmot nmot_ub_q40 6 0.00 10200. FORMAT "%5.0" DEPOSIT ABSOLUTE /end AXIS_DESCR
/end CHARACTERISTIC
/begin CHARACTERISTIC KFLBKHOMS "Kennfeld LBK-Sollwert im Homogenbetrieb" MAP 0x1CA792 KfAxUbAyUbSstxUwSstyUbWUb 0.9961 fak_ub_b1 0.00 0.9961
 /begin AXIS_DESCR STD_AXIS milsol_w rel_uw_b100 8 0.00 99.99847 FORMAT "%8.5" DEPOSIT ABSOLUTE /end AXIS_DESCR
 /begin AXIS_DESCR STD_AXIS nmot nmot_ub_q40 8 0.00 10200. FORMAT "%5.0" DEPOSIT ABSOLUTE /end AXIS_DESCR
/end CHARACTERISTIC
/begin CHARACTERISTIC KFLBTS "Lambdasoll f¸r Bauteileschutz" MAP 0x1CBD70 GkfWUb 1.992 fak_ub_b2 0.00 1.992 FORMAT "%5.3"
 /begin AXIS_DESCR COM_AXIS rl_w rel_uw_q0p0234 12 0.00 1535.977 AXIS_PTS_REF SRL12GKUW /end AXIS_DESCR
 /begin AXIS_DESCR COM_AXIS nmot nmot_ub_q40 16 0.00 10200. AXIS_PTS_REF SNM16GKUB /end AXIS_DESCR
/end CHARACTERISTIC
/begin CHARACTERISTIC KFLBTS2 "Lambdasoll f¸r Bauteileschutz" MAP 0x1CBE30 GkfWUb 1.992 fak_ub_b2 0.00 1.992 FORMAT "%5.3"
 /begin AXIS_DESCR COM_AXIS rl_w rel_uw_q0p0234 12 0.00 1535.977 AXIS_PTS_REF SRL12GKUW /end AXIS_DESCR
 /begin AXIS_DESCR COM_AXIS nmot nmot_ub_q40 16 0.00 10200. AXIS_PTS_REF SNM16GKUB /end AXIS_DESCR
/end CHARACTERISTIC
/begin CHARACTERISTIC KFLMSKH "Kennfeld Lambda-Motor-Soll bei Katheizen" MAP 0x1CCCB6 KfAxU8AyU8SstxU16SstyU16WU16 8.000000 fak_q0p000244 0.00 8.000000 FORMAT "%8.6"
 /begin AXIS_DESCR STD_AXIS nmot_w nmot_uw_q0p25 8 0.00 16383.75 FORMAT "%8.2" DEPOSIT ABSOLUTE /end AXIS_DESCR
 /begin AXIS_DESCR STD_AXIS rl_w rel_uw_q0p0234 8 0.00 1535.977 FORMAT "%8.3" DEPOSIT ABSOLUTE /end AXIS_DESCR
/end CHARACTERISTIC
/begin CHARACTERISTIC KFMIOPKH "Kennfeld optimales Motormoment" MAP 0x1CCD86 KfAxU8AyU8SstxU16SstyU16WU16 99.99847 rel_uw_b100 0.00 99.99847 FORMAT "%8.5"
 /begin AXIS_DESCR STD_AXIS nmot_w nmot_uw_q0p25 16 0.00 16383.75 FORMAT "%8.2" DEPOSIT ABSOLUTE /end AXIS_DESCR
 /begin AXIS_DESCR STD_AXIS rlistmr_w rel_uw_q0p0234 11 0.00 1535.977 FORMAT "%8.3" DEPOSIT ABSOLUTE /end AXIS_DESCR
/end CHARACTERISTIC
/begin CHARACTERISTIC KFMRDSLSAD "Kennfeld Drehmomentenreserve bei Aktivdiagnose-Sekund‰rluft" MAP 0x1CCFB6 KfAxU8AyU8SstxU16SstyU16WU16 99.99847 rel_uw_b100 0.00 99.99847 FORMAT "%8.5"
 /begin AXIS_DESCR STD_AXIS nmot_w nmot_uw_q0p25 4 0.00 16383.75 FORMAT "%8.2" DEPOSIT ABSOLUTE /end AXIS_DESCR
 /begin AXIS_DESCR STD_AXIS mifal_w rel_uw_b100 4 0.00 99.99847 FORMAT "%8.5" DEPOSIT ABSOLUTE /end AXIS_DESCR
/end CHARACTERISTIC
/begin CHARACTERISTIC KFMRDSLSFA "Kennfeld Drehmomentenreserve bei Testereingriff Sekund‰rluftdiagnose" MAP 0x1CCFEA KfAxU8AyU8SstxU16SstyU16WU16 99.99847 rel_uw_b100 0.00 99.99847 FORMAT "%8.5"
 /begin AXIS_DESCR STD_AXIS nmot_w nmot_uw_q0p25 4 0.00 16383.75 FORMAT "%8.2" DEPOSIT ABSOLUTE /end AXIS_DESCR
 /begin AXIS_DESCR STD_AXIS mifal_w rel_uw_b100 4 0.00 99.99847 FORMAT "%8.5" DEPOSIT ABSOLUTE /end AXIS_DESCR
/end CHARACTERISTIC
/begin CHARACTERISTIC KFMRES "LLR: Basis Momentenreserve im LL und ll-nahem Bereich" MAP 0x1C6F9C GkfWUb 24.90 rel_ub_b24p9 0.00 24.90 FORMAT "%5.2"
 /begin AXIS_DESCR COM_AXIS nmot nmot_ub_q40 6 0.00 10200. AXIS_PTS_REF SNM06LLUB /end AXIS_DESCR
 /begin AXIS_DESCR COM_AXIS mifa_w rel_uw_b100 4 0.00 99.99847 AXIS_PTS_REF SMI04LLUB /end AXIS_DESCR
/end CHARACTERISTIC
/begin CHARACTERISTIC KFMRESK "LLR: Basis Momentenreserve im LL und ll-nahem Bereich,ausgekuppelt" MAP 0x1C6FB4 GkfWUb 24.90 rel_ub_b24p9 0.00 24.90 FORMAT "%5.2"
 /begin AXIS_DESCR COM_AXIS nmot nmot_ub_q40 6 0.00 10200. AXIS_PTS_REF SNM06LLUB /end AXIS_DESCR
 /begin AXIS_DESCR COM_AXIS mifa_w rel_uw_b100 4 0.00 99.99847 AXIS_PTS_REF SMI04LLUB /end AXIS_DESCR
/end CHARACTERISTIC
/begin CHARACTERISTIC KFMRESKH "Momentenreserve bei Kat.heizen" MAP 0x1C6FCC GkfWUb 24.90 rel_ub_b24p9 0.00 24.90 FORMAT "%5.2"
 /begin AXIS_DESCR COM_AXIS dns nmotd_sb_q10 6 -1280. 1270. AXIS_PTS_REF SNS06LLSB /end AXIS_DESCR
 /begin AXIS_DESCR COM_AXIS tmot temp_ub_q0p75_o48 4 -48.00 143.3 AXIS_PTS_REF STM04SAUB /end AXIS_DESCR
/end CHARACTERISTIC
/begin CHARACTERISTIC KFMRESNL "Momentenreserve im nicht Leerlauf" MAP 0x1C6FE4 GkfWUb 24.90 rel_ub_b24p9 0.00 24.90 FORMAT "%5.2"
 /begin AXIS_DESCR COM_AXIS nmot nmot_ub_q40 6 0.00 10200. AXIS_PTS_REF SNM06LLUB /end AXIS_DESCR
 /begin AXIS_DESCR COM_AXIS mifa_w rel_uw_b100 4 0.00 99.99847 AXIS_PTS_REF SMI04LLUB /end AXIS_DESCR
/end CHARACTERISTIC
/begin CHARACTERISTIC KFMRESTA "Momentreserve abh‰ngig von tans" MAP 0x1C6FFC GkfWUb 24.90 rel_ub_b24p9 0.00 24.90 FORMAT "%5.2"
 /begin AXIS_DESCR COM_AXIS tans temp_ub_q0p75_o48 4 -48.00000 49103.25 AXIS_PTS_REF STA04LLUB /end AXIS_DESCR
 /begin AXIS_DESCR COM_AXIS mifa_w rel_uw_b100 4 0.00 99.99847 AXIS_PTS_REF SMI04LLUB /end AXIS_DESCR
/end CHARACTERISTIC
/begin CHARACTERISTIC KFNFSKHM "Leerlaufsolldrehzahl bei Katheizen mit eingelegter Fahrstufe" MAP 0x1CCF20 KfAxU8AyU8SstxU8SstyU16WU8 2550. nmot_q10 0.00 2550. FORMAT "%5.0"
 /begin AXIS_DESCR STD_AXIS tmot temp_ub_q0p75_o48 8 -48.00 143.3 FORMAT "%5.1" DEPOSIT ABSOLUTE /end AXIS_DESCR
 /begin AXIS_DESCR STD_AXIS frhokor_w fak_uw_b4 4 0.00 3.999939 FORMAT "%8.6" DEPOSIT ABSOLUTE /end AXIS_DESCR
/end CHARACTERISTIC
/begin CHARACTERISTIC KFNLLKHM "Leerlaufsolldrehzahl bei Kat.-Heizung" MAP 0x1CCF52 KfAxU8AyU8SstxU8SstyU16WU8 2550. nmot_q10 0.00 2550. FORMAT "%5.0"
 /begin AXIS_DESCR STD_AXIS tmot temp_ub_q0p75_o48 8 -48.00 143.3 FORMAT "%5.1" DEPOSIT ABSOLUTE /end AXIS_DESCR
 /begin AXIS_DESCR STD_AXIS frhokor_w fak_uw_b4 4 0.00 3.999939 FORMAT "%8.6" DEPOSIT ABSOLUTE /end AXIS_DESCR
/end CHARACTERISTIC
/begin CHARACTERISTIC KFZNSM "Zeitkonstante f¸r Solldrehzahlabregelung" MAP 0x1CF730 GkfWUb 5.08000 zk20msxs_ub_b5p1 0.0200000 5.10000 FORMAT "%7.5"
 /begin AXIS_DESCR COM_AXIS tmot temp_ub_q0p75_o48 6 -48.00 143.3 AXIS_PTS_REF STM06LLUB /end AXIS_DESCR
 /begin AXIS_DESCR COM_AXIS dns nmotd_sb_q10 6 -1280. 1270. AXIS_PTS_REF SNS06LLSB /end AXIS_DESCR
/end CHARACTERISTIC
/begin CHARACTERISTIC KFZWKH "Z¸ndwinkel bei Katheizen" MAP 0x1CCF84 KfAxU8AyU8SstxU8SstyU8WS8 191.3 zw_sb_q0p75 -96.00 95.25 FORMAT "%5.2"
 /begin AXIS_DESCR STD_AXIS nmot nmot_ub_q40 4 0.00 10200. FORMAT "%5.0" DEPOSIT ABSOLUTE /end AXIS_DESCR
 /begin AXIS_DESCR STD_AXIS rl rel_ub_q0p75 4 0.00 191.3 FORMAT "%5.1" DEPOSIT ABSOLUTE /end AXIS_DESCR
/end CHARACTERISTIC
/begin CHARACTERISTIC KLDNLLDE "Kennlinie: Drehmomentreserve f¸r Drehzahleinbruch" CURVE 0x1CF7F0 KlAUbSstSbWSb 25500. nmotg_sb_q100 -12800. 12700. FORMAT "%5.0"
 /begin AXIS_DESCR STD_AXIS dns nmotd_sb_q10 6 -1280. 1270. FORMAT "%5.0" DEPOSIT ABSOLUTE /end AXIS_DESCR
/end CHARACTERISTIC
/begin CHARACTERISTIC KLLAKHFH "Umgebungsdruckkorrektur Lambda Katheizen" CURVE 0x1CCD5A KlAxU8SstxU16WU16 1.999969 fak_uw_b2 0.00 1.999969 FORMAT "%8.6"
 /begin AXIS_DESCR STD_AXIS fho_w fak_uw_b4 4 0.00 3.999939 FORMAT "%8.6" DEPOSIT ABSOLUTE /end AXIS_DESCR
/end CHARACTERISTIC
/begin CHARACTERISTIC KLMRESTM "Kennlinie f¸r Momentenreserve im Nachstart" CURVE 0x1C700C KlAUbSstUbWUb 24.90 rel_ub_b24p9 0.00 24.90 FORMAT "%5.2"
 /begin AXIS_DESCR STD_AXIS tmot temp_ub_q0p75_o48 10 -48.00 143.3 FORMAT "%5.1" DEPOSIT ABSOLUTE /end AXIS_DESCR
/end CHARACTERISTIC
/begin CHARACTERISTIC KLMRHO "Kennlinie: Drehmomentreserve hˆhenabh‰ngig" CURVE 0x1C7024 KlAUbSstUbWUb 24.90 rel_ub_b24p9 0.00 24.90 FORMAT "%5.2"
 /begin AXIS_DESCR STD_AXIS fho fak_ub_b4 10 0.00 3.984 FORMAT "%5.3" DEPOSIT ABSOLUTE /end AXIS_DESCR
/end CHARACTERISTIC
/begin CHARACTERISTIC KNSNF "Sperrband f¸r Solldrehzahlnachf¸hrung" VALUE 0x1CF754 KwUb 2550. nmot_q10 0.00 2550. FORMAT "%5.0" /end CHARACTERISTIC
/begin CHARACTERISTIC KRDWA "Klopfregelung Differenz aktueller ZW zu Adaptionskennfeld" VALUE 0x1C65A6 KwWS8 6.000 zw_sb_q0p75 0.00 6.000 FORMAT "%5.3" /end CHARACTERISTIC
/begin CHARACTERISTIC KRDWKLA "Der SV-Lernbetrag f¸r die KR-Adaption nach einem erkannten Klopfereignis" VALUE 0x1C65A7 KwWS8 6.000 zw_sb_q0p75 -6.000 0.00 FORMAT "%5.3" /end CHARACTERISTIC
/begin CHARACTERISTIC KRDWSA "Der FV-Lernbetrag f¸r die KR-Adaption wenn wkra-wkr > KRDWA" VALUE 0x1C65A8 KwWS8 6.000 zw_sb_q0p75 0.00 6.000 FORMAT "%5.3" /end CHARACTERISTIC
/begin CHARACTERISTIC KRDWSN "Klopfregelung delta - Winkel Sicherheit" CURVE 0x1CE9C0 GklWS8 20.25 zw_sb_q0p75 -20.25 0.00 FORMAT "%5.2"
 /begin AXIS_DESCR COM_AXIS nmot nmot_ub_q40 16 0.00 10200. AXIS_PTS_REF SNM16KRUB /end AXIS_DESCR
/end CHARACTERISTIC
/begin CHARACTERISTIC KRFKN "Sp‰tverstellung pro Klopfereignis" CURVE 0x1CE9D0 GklWS8 6.000 zw_sb_q0p75 -6.000 0.00 FORMAT "%5.3"
 /begin AXIS_DESCR COM_AXIS nmot nmot_ub_q40 16 0.00 10200. AXIS_PTS_REF SNM16KRUB /end AXIS_DESCR
/end CHARACTERISTIC
/begin CHARACTERISTIC KRFTP1 "Tiefpassverhalten normal" VALUE 0x1C65BE KwWU8 24.00 dez 8.000 32.00 FORMAT "%5.2" /end CHARACTERISTIC
/begin CHARACTERISTIC KRFTP2 "Tiefpassverhalten bei Drehzahldynamik" VALUE 0x1C65BF KwWU8 14.00 dez 2.000 16.00 FORMAT "%5.2" /end CHARACTERISTIC
/begin CHARACTERISTIC KRFTP3 "Tiefpassverhalten bei Lastdynamik" VALUE 0x1C65C0 KwWU8 14.00 dez 2.000 16.00 FORMAT "%5.2" /end CHARACTERISTIC
/begin CHARACTERISTIC KRKFKS "Zuordnung der Kloperkennungskennlinie bei fehlender Zyl.-1-Erkennung" VALUE 0x1C65C1 KwWU8 7.000 dez 0.00 7.000 FORMAT "%5.3" /end CHARACTERISTIC
/begin CHARACTERISTIC KRMXN "maximale Sp‰tverstellung" CURVE 0x1CE9E0 GklWS8 20.25 zw_sb_q0p75 -20.25 0.00 FORMAT "%5.2"
 /begin AXIS_DESCR COM_AXIS nmot nmot_ub_q40 16 0.00 10200. AXIS_PTS_REF SNM16KRUB /end AXIS_DESCR
/end CHARACTERISTIC
/begin CHARACTERISTIC KRNLZAR "Zyl.individuelle Drehzahlschwelle, oberhalb der F¸hrung durch LZ aktiv ist" VAL_BLK 0x1CE9A4 KwbWU8 10200. nmot_ub_q40 0.00 10200. FORMAT "%5.0" NUMBER 8 /end CHARACTERISTIC
/begin CHARACTERISTIC KRUMOB "obere Umschaltschwelle f¸r die Verst‰rkungsregelung" VALUE 0x1C65B2 KwWU16 4.999924 spg_uw_q0p000076 0.00 4.999924 FORMAT "%8.6" /end CHARACTERISTIC
/begin CHARACTERISTIC KRUMUNT "untere Umschaltschwelle f¸r die Verst‰rkungsregelung" VALUE 0x1C65B4 KwWU16 4.999924 spg_uw_q0p000076 0.00 4.999924 FORMAT "%8.6" /end CHARACTERISTIC
/begin CHARACTERISTIC KRVFN "Anz. Z¸nd./Zyl., bzw. Zeitangabe von Fr¸hverst. zu Fr¸hverst. (Stufenbreite-KR)" CURVE 0x1CE9F0 GklWU8 254.0 dez 1.000 255.0 FORMAT "%5.1"
 /begin AXIS_DESCR COM_AXIS nmot nmot_ub_q40 16 0.00 10200. AXIS_PTS_REF SNM16KRUB /end AXIS_DESCR
/end CHARACTERISTIC
/begin CHARACTERISTIC KRVFSN "Anzahl Z¸ndungen/Zyl., oder Zeitangabe f¸r schnelle Fr¸hverstellung der KR" CURVE 0x1CEA00 GklWU8 254.0 dez 1.000 255.0 FORMAT "%5.1"
 /begin AXIS_DESCR COM_AXIS nmot nmot_ub_q40 16 0.00 10200. AXIS_PTS_REF SNM16KRUB /end AXIS_DESCR
/end CHARACTERISTIC
/begin CHARACTERISTIC KRVST "Verst‰rkung nach Start" VALUE 0x1C65C2 KwWU8 3.000 dez 0.00 3.000 FORMAT "%5.3" /end CHARACTERISTIC
/begin CHARACTERISTIC LAMFA "Lambda Fahrerwunsch" MAP 0x1CF5C4 KfAxUbAyUbSstxUbSstyUwWUb 1.992 fak_ub_b2 0.00 1.992 FORMAT "%5.3"
 /begin AXIS_DESCR STD_AXIS nmot nmot_ub_q40 15 0.00 10200. FORMAT "%5.0" DEPOSIT ABSOLUTE /end AXIS_DESCR
 /begin AXIS_DESCR STD_AXIS mrfa_w rel_uw_b200 6 0.00 199.9969 FORMAT "%8.4" DEPOSIT ABSOLUTE /end AXIS_DESCR
/end CHARACTERISTIC
/begin CHARACTERISTIC LAMFLGSL "Lambda Motorlaufgrenze  fett bei Sekund‰rlufteinblasung" CURVE 0x1CBF74 KlAUbSstUbWUb 1.992 fak_ub_b2 0.00 1.992 FORMAT "%5.3"
 /begin AXIS_DESCR STD_AXIS imlatm m_ub_b23p3 6 0.00 23.21 FORMAT "%5.2" DEPOSIT ABSOLUTE /end AXIS_DESCR
/end CHARACTERISTIC
/begin CHARACTERISTIC LAMLGFKT "Laufgrenze ""fett"" im Kurz Test" VALUE 0x1CBF81 KwUb 1.992 fak_ub_b2 0.00 1.992 FORMAT "%5.3" /end CHARACTERISTIC
/begin CHARACTERISTIC LAMLGFTM "Lambda Motorlaufgrenze fett" CURVE 0x1CBF84 GklWUb 1.992 fak_ub_b2 0.00 1.992 FORMAT "%5.3"
 /begin AXIS_DESCR COM_AXIS tmot temp_ub_q0p75_o48 12 -48.00 143.3 AXIS_PTS_REF STM12ESUB /end AXIS_DESCR
/end CHARACTERISTIC
/begin CHARACTERISTIC LAMLGMKT "Laufgrenze ""mager"" im Kurz Test" VALUE 0x1CBF90 KwUb 1.992 fak_ub_b2 0.00 1.992 FORMAT "%5.3" /end CHARACTERISTIC
/begin CHARACTERISTIC LAMLGMTM "Laufgrenze ""mager""" CURVE 0x1CBF94 GklWUb 1.992 fak_ub_b2 0.00 1.992 FORMAT "%5.3"
 /begin AXIS_DESCR COM_AXIS tmot temp_ub_q0p75_o48 12 -48.00 143.3 AXIS_PTS_REF STM12ESUB /end AXIS_DESCR
/end CHARACTERISTIC
/begin CHARACTERISTIC LAMRLMN "Lamdavorsteuerung bei rl < RLLAMMN zur Verbesserung der Brennbarkeit" VALUE 0x1CF58C KwUb 1.992 fak_ub_b2 0.00 1.992 FORMAT "%5.3" /end CHARACTERISTIC
/begin CHARACTERISTIC LAMSOSOF "Lambdasonde Soll Obergrenze f¸r 1.0-Fenster" VALUE 0x1C48F0 KwUw 15.99976 fak_uw_b16 0.00 15.99976 FORMAT "%8.5" /end CHARACTERISTIC
/begin CHARACTERISTIC LAMSOSUF "Lambdasonde Soll Untergrenze f¸r 1.0-Fenster" VALUE 0x1C48F2 KwUw 15.99976 fak_uw_b16 0.00 15.99976 FORMAT "%8.5" /end CHARACTERISTIC
/begin CHARACTERISTIC LASOAB "Lambdasollwert bei Bankabschaltung" VALUE 0x1C48EF KwUb 1.992 fak_ub_b2 0.00 1.992 FORMAT "%5.3" /end CHARACTERISTIC
/begin CHARACTERISTIC LASTMOT "Motortemp.-Korrektur von Lambda-Abgas-Soll" CURVE 0x1CCD6C KlAxU8SstxU8WU8 1.992 fak_ub_b2 0.00 1.992 FORMAT "%5.3"
 /begin AXIS_DESCR STD_AXIS tmot temp_ub_q0p75_o48 4 -48.00 143.3 FORMAT "%5.1" DEPOSIT ABSOLUTE /end AXIS_DESCR
/end CHARACTERISTIC
/begin CHARACTERISTIC LASWLTM "Offset Lambda-Motor-Soll bei inaktiver Lambdaregelung" CURVE 0x1CC030 GklWSb 1.992 fak_sb_b1 -1.000 0.9922 FORMAT "%5.3"
 /begin AXIS_DESCR COM_AXIS tmot temp_ub_q0p75_o48 12 -48.00 143.3 AXIS_PTS_REF STM12ESUB /end AXIS_DESCR
/end CHARACTERISTIC
/begin CHARACTERISTIC LBZO2 "Schwelle f¸r lbz zur Solldrehzahlanhebung im Leerlauf" VALUE 0x1CF755 KwUb 99.61 rel_ub_b99p6 0.00 99.61 FORMAT "%5.2" /end CHARACTERISTIC
/begin CHARACTERISTIC LIVFZDE "Geschwindigkeitsschwelle f¸r Drehzahleinbruch" VALUE 0x1CF7FD KwUb 318.8 vfzg_ub_q1p25 0.00 318.8 FORMAT "%5.1" /end CHARACTERISTIC
/begin CHARACTERISTIC LLRNSETP_T "Leerlauf-Nachstart-Entprellzeit" VALUE 0x1C6D69 KwUb 2.550 t10msxs_ub_b2p55 0.00 2.550 FORMAT "%5.3" /end CHARACTERISTIC
/begin CHARACTERISTIC LMSTMOT "Motortemp.-Korrektur von Lambda-Motor-Soll" CURVE 0x1CCD78 KlAxU8SstxU8WU8 1.992 fak_ub_b2 0.00 1.992 FORMAT "%5.3"
 /begin AXIS_DESCR STD_AXIS tmot temp_ub_q0p75_o48 4 -48.00 143.3 FORMAT "%5.1" DEPOSIT ABSOLUTE /end AXIS_DESCR
/end CHARACTERISTIC
/begin CHARACTERISTIC LZFUER "Festwerteblock: Leitzylinderzuordnung" VAL_BLK 0x1C65C4 KwbWU8 255.0 dez 0.00 255.0 FORMAT "%5.1" NUMBER 8 /end CHARACTERISTIC
/begin CHARACTERISTIC MAXANZSLP "maximale Einschaltzahl der SLP w‰hrend eines Fahrtzykluses" VALUE 0x1CD04A KwWU8 255.0 dez 0.00 255.0 FORMAT "%5.1" /end CHARACTERISTIC
/begin CHARACTERISTIC MINAKRLZ "minimale Anzahl mˆglicher KR-Leitzylinder" VALUE 0x1CE9AC KwWU8 255.0 dez 0.00 255.0 FORMAT "%5.1" /end CHARACTERISTIC
/begin CHARACTERISTIC MNDMRKH "minimale Momentenreserve w‰hrend Katheizen" VALUE 0x1CCFA0 KwWU16 99.99847 rel_uw_b100 0.00 99.99847 FORMAT "%8.5" /end CHARACTERISTIC
/begin CHARACTERISTIC MRESKH "Momentenreserve bei Kat.heizen" VALUE 0x1C703E KwUw 99.99847 rel_uw_b100 0.00 99.99847 FORMAT "%8.5" /end CHARACTERISTIC
/begin CHARACTERISTIC MRESLL "LLR: Erhˆhte Momentenreserve im LL nach Drehzahleinbruch" VALUE 0x1C7039 KwUb 24.90 rel_ub_b24p9 0.00 24.90 FORMAT "%5.2" /end CHARACTERISTIC
/begin CHARACTERISTIC MRESSL "Momentenreserve bei Servolenkung" VALUE 0x1C7040 KwUw 99.99847 rel_uw_b100 0.00 99.99847 FORMAT "%8.5" /end CHARACTERISTIC
/begin CHARACTERISTIC MXDMRKH "maximale Momentenreserve w‰hrend Katheizen" VALUE 0x1CCFA2 KwWU16 99.99847 rel_uw_b100 0.00 99.99847 FORMAT "%8.5" /end CHARACTERISTIC
/begin CHARACTERISTIC MXSLPKH "maximale Einschaltzahl der SLP w‰hrend des Katheizens" VALUE 0x1CD04B KwWU8 255.0 dez 0.00 255.0 FORMAT "%5.1" /end CHARACTERISTIC
/begin CHARACTERISTIC NDZAEHB "Drehzahlanhebung: EHB-Solldrehzahlvorgabe" VAL_BLK 0x1C6D6C KwbUb 2550. nmot_q10 0.00 2550. FORMAT "%5.0" NUMBER 6 /end CHARACTERISTIC
/begin CHARACTERISTIC NDZAKLIMA "N-Sollwert bei Drehzahlanhebung (Klima)" VAL_BLK 0x1C6D74 KwbUb 2550. nmot_q10 0.00 2550. FORMAT "%5.0" NUMBER 6 /end CHARACTERISTIC
/begin CHARACTERISTIC NDZAUB "N-Sollwert bei Batteriespannungs-Drehzahlanhebung" VAL_BLK 0x1C6D7C KwbUb 2550. nmot_q10 0.00 2550. FORMAT "%5.0" NUMBER 6 /end CHARACTERISTIC
/begin CHARACTERISTIC NGNSNF "Drehzahlgradientenschwelle zur Auslˆsung der Drehzahlnachf¸hrung" VALUE 0x1CF756 KwUb 25500. nmotg_ub_q100 0.00 25500. FORMAT "%5.0" /end CHARACTERISTIC
/begin CHARACTERISTIC NINJO "Drehzahlschwelle f¸r Laufzeitreduzierung Einspritzung" VALUE 0x1CD968 KwUb 10200. nmot_ub_q40 0.00 10200. FORMAT "%5.0" /end CHARACTERISTIC
/begin CHARACTERISTIC NKKMN "Untere Drehzahlschwelle f¸r Klimakompressorsteuerung" VALUE 0x1C86C8 KwUb 10200. nmot_ub_q40 0.00 10200. FORMAT "%5.0" /end CHARACTERISTIC
/begin CHARACTERISTIC NKKMX "Obere Drehzahlschwelle f¸r Klimakompressorsteuerung" VALUE 0x1C86C9 KwUb 10200. nmot_ub_q40 0.00 10200. FORMAT "%5.0" /end CHARACTERISTIC
/begin CHARACTERISTIC NLLAD "Leerlaufsolldrehzahl bei Aktivdiagnose-Sekund‰rluft" VALUE 0x1CCFB4 KwWU8 2550. nmot_q10 0.00 2550. FORMAT "%5.0" /end CHARACTERISTIC
/begin CHARACTERISTIC NLLKT "Leerlaufsolldrehzahl bei Kurztest Sekund‰rluftdiagnose" VALUE 0x1CCFB5 KwWU8 2550. nmot_q10 0.00 2550. FORMAT "%5.0" /end CHARACTERISTIC
/begin CHARACTERISTIC NLLREIN "Drehzahleinschaltschwelle f¸r Leerlaufregelung" VALUE 0x1CF6EC KwUw 2000.000 nmot_uw_q0p25 0.00 2000.000 FORMAT "%8.3" /end CHARACTERISTIC
/begin CHARACTERISTIC NSFNSOL "Solldrehzahl im Nachstart bei Fahrt" CURVE 0x1C6D84 GklWUb 2550. nmot_q10 0.00 2550. FORMAT "%5.0"
 /begin AXIS_DESCR COM_AXIS tmot temp_ub_q0p75_o48 6 -48.00 143.3 AXIS_PTS_REF STM06LLUB /end AXIS_DESCR
/end CHARACTERISTIC
/begin CHARACTERISTIC NSFNSOL1 "Solldrehzahl im Nachstart bei Fahrt (R¸ckw‰rtsgang eingelegt)" CURVE 0x1C6D8C GklWUb 2550. nmot_q10 0.00 2550. FORMAT "%5.0"
 /begin AXIS_DESCR COM_AXIS tmot temp_ub_q0p75_o48 6 -48.00 143.3 AXIS_PTS_REF STM06LLUB /end AXIS_DESCR
/end CHARACTERISTIC
/begin CHARACTERISTIC NSLFAA "Leerlaufdrehzahl bei Bandendetest (bei allgemeiner Anforderung)" VALUE 0x1CF6EF KwUb 2550. nmot_ub_q10 0.00 2550. FORMAT "%5.0" /end CHARACTERISTIC
/begin CHARACTERISTIC NSLFADY "Solldrehzahl bei Kurztrip Dynamikdiagnose der LSU" VALUE 0x1CF6F0 KwUb 2550. nmot_ub_q10 0.00 2550. FORMAT "%5.0" /end CHARACTERISTIC
/begin CHARACTERISTIC NSLFAEZLA "Solldrehzahl bei Kurztrip Einzelzylinder-Lambda-Regelung" VALUE 0x1CF6F1 KwUb 2550. nmot_ub_q10 0.00 2550. FORMAT "%5.0" /end CHARACTERISTIC
/begin CHARACTERISTIC NSLFAKAT "Solldrehzahl bei Kurztrip Katdiagnose" VALUE 0x1CF6F2 KwUb 2550. nmot_ub_q10 0.00 2550. FORMAT "%5.0" /end CHARACTERISTIC
/begin CHARACTERISTIC NSLFAKRS "Solldrehzahl bei Kurztrip Klopfsensor" VALUE 0x1CF6F3 KwUb 2550. nmot_ub_q10 0.00 2550. FORMAT "%5.0" /end CHARACTERISTIC
/begin CHARACTERISTIC NSLFALDP "Solldrehzahl bei Kurztrip Tankleckdiagnose" VALUE 0x1CF6F4 KwUb 2550. nmot_ub_q10 0.00 2550. FORMAT "%5.0" /end CHARACTERISTIC
/begin CHARACTERISTIC NSLFALSF "Solldrehzahl bei Kurztrip Lamdasonde hinter Front Kat" VALUE 0x1CF6F5 KwUb 2550. nmot_ub_q10 0.00 2550. FORMAT "%5.0" /end CHARACTERISTIC
/begin CHARACTERISTIC NSLFALSV "Solldrehzahl bei Kurztrip Lambdasonde vor Kat" VALUE 0x1CF6F6 KwUb 2550. nmot_ub_q10 0.00 2550. FORMAT "%5.0" /end CHARACTERISTIC
/begin CHARACTERISTIC NSLFASF "Solldrehzahl bei Kurztrip Schwingungspr¸fung hinter Front Kat" VALUE 0x1CF6F7 KwUb 2550. nmot_ub_q10 0.00 2550. FORMAT "%5.0" /end CHARACTERISTIC
/begin CHARACTERISTIC NSLFASH "Solldrehzahl bei Kurztrip Schwingungspr¸fung" VALUE 0x1CF6F8 KwUb 2550. nmot_ub_q10 0.00 2550. FORMAT "%5.0" /end CHARACTERISTIC
/begin CHARACTERISTIC NSLFASHV "Solldrehzahl bei Kurztrip Sodenvertauscherkennung" VALUE 0x1CF6F9 KwUb 2550. nmot_ub_q10 0.00 2550. FORMAT "%5.0" /end CHARACTERISTIC
/begin CHARACTERISTIC NSLFASKNO "Drehzahlanforderung f¸r Kurztrip: Diagnose Speicherkat" VALUE 0x1CF6FA KwUb 2550. nmot_ub_q10 0.00 2550. FORMAT "%5.0" /end CHARACTERISTIC
/begin CHARACTERISTIC NSLFASLS "Solldrehzahl bei Kurztrip Sekund‰rluft" VALUE 0x1CF6FB KwUb 2550. nmot_ub_q10 0.00 2550. FORMAT "%5.0" /end CHARACTERISTIC
/begin CHARACTERISTIC NSLFATES "Solldrehzahl bei Kurztrip Tankentl¸ftung" VALUE 0x1CF6FC KwUb 2550. nmot_ub_q10 0.00 2550. FORMAT "%5.0" /end CHARACTERISTIC
/begin CHARACTERISTIC NSLFATPE "Solldrehzahl bei Kurztrip Taupunktende" VALUE 0x1CF6FD KwUb 2550. nmot_ub_q10 0.00 2550. FORMAT "%5.0" /end CHARACTERISTIC
/begin CHARACTERISTIC NSLFAWSA "Leerlaufdrehzahl bei Kurztrip Auslaﬂ-NW" VALUE 0x1CF6FE KwUb 2550. nmot_ub_q10 0.00 2550. FORMAT "%5.0" /end CHARACTERISTIC
/begin CHARACTERISTIC NSLFAWSE "Leerlaufdrehzahl bei Kurztrip Einlaﬂ-NW" VALUE 0x1CF6FF KwUb 2550. nmot_ub_q10 0.00 2550. FORMAT "%5.0" /end CHARACTERISTIC
/begin CHARACTERISTIC NSLKVS "Solldrehzahl bei Kurztrip Diagnose Kraftstoffversorgung" VALUE 0x1CF700 KwUb 2550. nmot_ub_q10 0.00 2550. FORMAT "%5.0" /end CHARACTERISTIC
/begin CHARACTERISTIC NSLLSH "Solldrehzahl bei Kurztrip Lambdasonde hinter Kat" VALUE 0x1CF701 KwUb 2550. nmot_ub_q10 0.00 2550. FORMAT "%5.0" /end CHARACTERISTIC
/begin CHARACTERISTIC NSNNSOL "Solldrehzahl im Nachstart in Neutral" CURVE 0x1C6D94 GklWUb 2550. nmot_q10 0.00 2550. FORMAT "%5.0"
 /begin AXIS_DESCR COM_AXIS tmot temp_ub_q0p75_o48 6 -48.00 143.3 AXIS_PTS_REF STM06LLUB /end AXIS_DESCR
/end CHARACTERISTIC
/begin CHARACTERISTIC NSNNSOL1 "Solldrehzahl im Nachstart in Neutral mit Kat-Heizen" CURVE 0x1C6D9C GklWUb 2550. nmot_q10 0.00 2550. FORMAT "%5.0"
 /begin AXIS_DESCR COM_AXIS tmot temp_ub_q0p75_o48 6 -48.00 143.3 AXIS_PTS_REF STM06LLUB /end AXIS_DESCR
/end CHARACTERISTIC
/begin CHARACTERISTIC NSOLFX "Solldrehzahl, baureihenabh‰ngig, Fahrstufe, Kodierung 1" VAL_BLK 0x1C6DA4 KwbUb 2550. nmot_q10 0.00 2550. FORMAT "%5.0" NUMBER 6 /end CHARACTERISTIC
/begin CHARACTERISTIC NSOLFY "Solldrehzahl, baureihenabh‰ngig, Fahrstufe, Kodierung 2" VAL_BLK 0x1C6DAC KwbUb 2550. nmot_q10 0.00 2550. FORMAT "%5.0" NUMBER 6 /end CHARACTERISTIC
/begin CHARACTERISTIC NSOLMAX "maximale Solldrehzahl" VALUE 0x1C6DB2 KwUb 2550. nmot_q10 0.00 2550. FORMAT "%5.0" /end CHARACTERISTIC
/begin CHARACTERISTIC NSOLMIN "minimale Solldrehzahl" VALUE 0x1C6DB3 KwUb 2550. nmot_q10 0.00 2550. FORMAT "%5.0" /end CHARACTERISTIC
/begin CHARACTERISTIC NSOLMX "Maximalbegrenzung der Solldrehzahl" VALUE 0x1CF757 KwUb 2550. nmot_q10 0.00 2550. FORMAT "%5.0" /end CHARACTERISTIC
/begin CHARACTERISTIC NSOLNX "Solldrehzahl, baureihenabh‰ngig, neutral, Kodierung 1" VAL_BLK 0x1C6DB4 KwbUb 2550. nmot_q10 0.00 2550. FORMAT "%5.0" NUMBER 6 /end CHARACTERISTIC
/begin CHARACTERISTIC NSOLNY "Solldrehzahl, baureihenabh‰ngig, neutral, Kodierung 2" VAL_BLK 0x1C6DBC KwbUb 2550. nmot_q10 0.00 2550. FORMAT "%5.0" NUMBER 6 /end CHARACTERISTIC
/begin CHARACTERISTIC NSOL_EHRP "EHB-DZA-Hochrampwert" VALUE 0x1C6DC2 KwUb 2550. nmot_q10 0.00 2550. FORMAT "%5.0" /end CHARACTERISTIC
/begin CHARACTERISTIC NSOL_ENRP "EHB-DZA-Niederrampwert" VALUE 0x1C6DC3 KwUb 2550. nmot_q10 0.00 2550. FORMAT "%5.0" /end CHARACTERISTIC
/begin CHARACTERISTIC NSOL_HRP "DZA-Hochrampwert" VALUE 0x1C6DC4 KwUb 2550. nmot_q10 0.00 2550. FORMAT "%5.0" /end CHARACTERISTIC
/begin CHARACTERISTIC NSOL_NRP "DZA-Niederrampwert" VALUE 0x1C6DC5 KwUb 2550. nmot_q10 0.00 2550. FORMAT "%5.0" /end CHARACTERISTIC
/begin CHARACTERISTIC NSPLT "Nachstartplateauzeit (f¸r ECE)" CURVE 0x1CF758 KlAUbSstUbWUb 51.00 t200msxs_ub_b51 0.00 51.00 FORMAT "%5.2"
 /begin AXIS_DESCR STD_AXIS tmst temp_ub_q0p75_o48 8 -48.00 143.3 FORMAT "%5.1" DEPOSIT ABSOLUTE /end AXIS_DESCR
/end CHARACTERISTIC
/begin CHARACTERISTIC N_DZA "Solldrehzahl bei Drehzahlanhebung wegen Batterieladezustand" VALUE 0x1CF776 KwUw 16383.75 nmot_uw_q0p25 0.00 16383.75 FORMAT "%8.2" /end CHARACTERISTIC
/begin CHARACTERISTIC N_ST_KRA "Anzahl Drehzahlbereiche des KR-Adaptions-KF" VALUE 0x1C65AF KwWU8 254.0 dez 1.000 255.0 FORMAT "%5.1" /end CHARACTERISTIC
/begin CHARACTERISTIC PN10V_T "Zeit f¸r PN-Wechsel-Verzˆgerung" VALUE 0x1CF769 KwUb 25.50 t100msxs_ub_b25p5 0.00 25.50 FORMAT "%5.2" /end CHARACTERISTIC
/begin CHARACTERISTIC PNNSOL_N "Drehzahlschwelle f¸r Bildung von B_pnnsolns" VALUE 0x1C6DF6 KwUw 16383.75 nmot_uw_q0p25 0.00 16383.75 FORMAT "%8.2" /end CHARACTERISTIC
/begin CHARACTERISTIC PZWKRA "Prozentuale H‰ufigkeit der ZW-Ausgabe durch die KR w‰hrend Dynamikadaption" VALUE 0x1C65B0 KwWU8 99.61 rel_ub_b99p6 0.00 99.61 FORMAT "%5.2" /end CHARACTERISTIC
/begin CHARACTERISTIC REFINI "Startwert Referenzpegel bei Klopfregelung aktiv" VALUE 0x1C65B6 KwWU16 0.6999969 spg_uw_q0p000076 0.2999878 0.9999847 FORMAT "%9.7" /end CHARACTERISTIC
/begin CHARACTERISTIC RKRMX1N "Maximaler Referenzpegel f¸r Klopferkennungsschwelle Zyl.-gruppe 1" CURVE 0x1CE8E4 GklWU16 319.9902 spg_uw_q0p00488 0.004882813 319.9951 FORMAT "%8.4"
 /begin AXIS_DESCR COM_AXIS nmot nmot_ub_q40 16 0.00 10200. AXIS_PTS_REF SNM16KRUB /end AXIS_DESCR
/end CHARACTERISTIC
/begin CHARACTERISTIC RKRMX2N "Maximaler Referenzpegel f¸r Klopferkennungsschwelle Zyl.-gruppe 2" CURVE 0x1CE904 GklWU16 319.9902 spg_uw_q0p00488 0.004882813 319.9951 FORMAT "%8.4"
 /begin AXIS_DESCR COM_AXIS nmot nmot_ub_q40 16 0.00 10200. AXIS_PTS_REF SNM16KRUB /end AXIS_DESCR
/end CHARACTERISTIC
/begin CHARACTERISTIC RLLAMMN "RL-min Schwelle zur Anfettung wegen Brennbarkeit" CURVE 0x1CF590 GklWUb 191.3 rel_ub_q0p75 0.00 191.3 FORMAT "%5.1"
 /begin AXIS_DESCR COM_AXIS nmot nmot_ub_q40 6 0.00 10200. AXIS_PTS_REF SNM06GKUB /end AXIS_DESCR
/end CHARACTERISTIC
/begin AXIS_PTS SDZ06GKUB "St¸tzstellen KFLAMKRL" 0x1CF598 dzwlamfaw SstAUbSstUb 191.3 zw_ub_qn0p75 6 -191.3 0.00 FORMAT "%5.1" DEPOSIT ABSOLUTE /end AXIS_PTS
/begin CHARACTERISTIC SGWTMOT "Gangwechsel-Temperaturschwelle" VALUE 0x1C6DC6 KwUb 191.3 temp_ub_q0p75_o48 -48.00 143.3 FORMAT "%5.1" /end CHARACTERISTIC
/begin AXIS_PTS SMI04LLUB "St¸tzstellenverteilung: ind. Moment f¸r Momentenreserve" 0x1C68C8 mifa_w SstAUwSstUw 99.99847 rel_uw_b100 4 0.00 99.99847 FORMAT "%8.5" DEPOSIT ABSOLUTE /end AXIS_PTS
/begin AXIS_PTS SNM06GKUB "St¸tzstellen KFLAMKR, DLAMOB" 0x1CF5A0 nmot SstAUbSstUb 10200. nmot_ub_q40 6 0.00 10200. FORMAT "%5.0" DEPOSIT ABSOLUTE /end AXIS_PTS
/begin AXIS_PTS SNM06LLUB "S¸tzstellenverteilung f¸r Motordrehzahl" 0x1C6754 nmot SstAUbSstUb 10200. nmot_ub_q40 6 0.00 10200. FORMAT "%5.0" DEPOSIT ABSOLUTE /end AXIS_PTS
/begin AXIS_PTS SNM16GKUB "St¸tzstellenverteilung Gemischkontrolle 16 nmot St¸tzstellen" 0x1CBEF0 nmot SstAUbSstUb 10200. nmot_ub_q40 16 0.00 10200. FORMAT "%5.0" DEPOSIT ABSOLUTE /end AXIS_PTS
/begin AXIS_PTS SNM16KRUB "St¸tzstellenverteilung Drehzahl, 16 Sst." 0x1CEE10 nmot SstAUbSstUb 10200. nmot_ub_q40 16 0.00 10200. FORMAT "%5.0" DEPOSIT ABSOLUTE /end AXIS_PTS
/begin AXIS_PTS SNS06LLSB "St¸tzstellenvert., Solldrehzahlabw., 06 Sst., LL-Regel." 0x1CF76C dns SstAUbSstSb 2550. nmotd_sb_q10 6 -1280. 1270. FORMAT "%5.0" DEPOSIT ABSOLUTE /end AXIS_PTS
/begin AXIS_PTS SRL06GKUB "St¸tzstellen KFLAMKRL, KFLAFWL, KFLAMKR" 0x1CF5A8 rl SstAUbSstUb 191.3 rel_ub_q0p75 6 0.00 191.3 FORMAT "%5.1" DEPOSIT ABSOLUTE /end AXIS_PTS
/begin AXIS_PTS SRL12GKUW "St¸tzstellenverteilung Gemischkontrolle 12 rl_w St¸tzstellen" 0x1CBF4E rl_w SstAUwSstUw 1535.977 rel_uw_q0p0234 12 0.00 1535.977 FORMAT "%8.3" DEPOSIT ABSOLUTE /end AXIS_PTS
/begin AXIS_PTS STA04LLUB "St¸tzstellenverteilung: tans f¸r Momentenreserve" 0x1C6952 tans SstAUwSstUw 49151.25 temp_ub_q0p75_o48 4 -48.00000 49103.25 FORMAT "%8.2" DEPOSIT ABSOLUTE /end AXIS_PTS
/begin AXIS_PTS STM04SAUB "St¸tzstellenverteilung Motortemperatur, 4 Sst." 0x1C6874 tmot SstAUbSstUb 191.3 temp_ub_q0p75_o48 4 -48.00 143.3 FORMAT "%5.1" DEPOSIT ABSOLUTE /end AXIS_PTS
/begin AXIS_PTS STM06LLUB "St¸tzstellenverteilung Motortemperatur, 6 Sst." 0x1CEE88 tmot SstAUbSstUb 191.3 temp_ub_q0p75_o48 6 -48.00 143.3 FORMAT "%5.1" DEPOSIT ABSOLUTE /end AXIS_PTS
/begin AXIS_PTS STM08GKUB "8 Motortemperaturst¸tzstellen f¸r KFLAFWL" 0x1CF5B0 tmot SstAUbSstUb 191.3 temp_ub_q0p75_o48 8 -48.00 143.3 FORMAT "%5.1" DEPOSIT ABSOLUTE /end AXIS_PTS
/begin AXIS_PTS STM12ESUB "SST-Verteilung f¸r die Motortemperatur tmot" 0x1CEEC8 tmot SstAUbSstUb 191.3 temp_ub_q0p75_o48 12 -48.00 143.3 FORMAT "%5.1" DEPOSIT ABSOLUTE /end AXIS_PTS
/begin AXIS_PTS STS12ESUB "SST-Verteilung f¸r Motorstarttemperatur" 0x1C6888 tmst SstAUbSstUb 191.3 temp_ub_q0p75_o48 12 -48.00 143.3 FORMAT "%5.1" DEPOSIT ABSOLUTE /end AXIS_PTS
/begin CHARACTERISTIC TABGBTS "Abgastemperaturschwelle f¸r Bauteileschutz" VALUE 0x1CBF68 KwUw 1279.980 temp_uw_q0p0195_o50 -50.00000 1229.980 FORMAT "%8.3" /end CHARACTERISTIC
/begin CHARACTERISTIC TABGMAX "maximal zul‰ssige Abgastemperatur durch Doppeleinspritzung BDE" VALUE 0x1CCFA4 KwWU16 1535.977 temp_q0p0234 0.00 1535.977 FORMAT "%8.3" /end CHARACTERISTIC
/begin CHARACTERISTIC TASLMNDSLS "untere Ansauglufttemperaturschwelle f¸r Sekund‰rluftfreigabe bei Diagnose" VALUE 0x1CD04C KwWU8 191.3 temp_ub_q0p75_o48 -48.00 143.3 FORMAT "%5.1" /end CHARACTERISTIC
/begin CHARACTERISTIC TASLMXDSLS "obere Ansauglufttemperaturschwelle f¸r Sekund‰rluftfreigabe bei Diagnose" VALUE 0x1CD04D KwWU8 191.3 temp_ub_q0p75_o48 -48.00 143.3 FORMAT "%5.1" /end CHARACTERISTIC
/begin CHARACTERISTIC TASLSMNKH "untere Ansauglufttemperaturschwelle f¸r Sekund‰rluftfreigabe bei Katheizen" VALUE 0x1CD04E KwWU8 191.3 temp_ub_q0p75_o48 -48.00 143.3 FORMAT "%5.1" /end CHARACTERISTIC
/begin CHARACTERISTIC TASLSMXKH "obere Ansauglufttemperaturschwelle f¸r Sekund‰rluftfreigabe bei Katheizen" VALUE 0x1CD04F KwWU8 191.3 temp_ub_q0p75_o48 -48.00 143.3 FORMAT "%5.1" /end CHARACTERISTIC
/begin CHARACTERISTIC TDBKVKHN "Zeit, in der trotz B_bkvleer noch erhˆhte LL-Drehzahl gefordert wird" VALUE 0x1CCFA6 KwWU16 6553.500 t_q0p1 0.00 6553.500 FORMAT "%8.3" /end CHARACTERISTIC
/begin CHARACTERISTIC TDKLAGDE "Zeitdelta f¸r Fehlerz‰hlerlˆschung bei DK-Soll-/Istvergleich" VALUE 0x1C3ADE KwUb 5.100 t20msxs_ub_b5p1 0.00 5.100 FORMAT "%5.3" /end CHARACTERISTIC
/begin CHARACTERISTIC TDLAMBTS "einmalige Verzˆgerungszeit f¸r Freigabe Lambda-Bauteileschutz" VALUE 0x1CBF6A KwUw 6553.500 t100msxs_uw_b6553p5 0.00 6553.500 FORMAT "%8.3" /end CHARACTERISTIC
/begin CHARACTERISTIC TDLRHAFTMX "Verweildauer f¸r Aktivierung der Haftreibungsroutine" VALUE 0x1CA8E0 KwUb 12.75 t50msxs_q0p05 0.00 12.75 FORMAT "%5.2" /end CHARACTERISTIC
/begin CHARACTERISTIC TDLRPIDC "Zeitdelta zur Fehlerzeitdecrementierung bei DLR-Stellbereichs¸berwachung" VALUE 0x1C3B1A KwUw 655.3500 t10msxs_uw_b655p35 0.00 655.3500 FORMAT "%8.4" /end CHARACTERISTIC
/begin CHARACTERISTIC TDMRESLL "Sperrzeit f¸r die erhˆhte Momentenreserve nach dem Start" VALUE 0x1C703A KwUb 51.00 t200msxs_ub_b51 0.00 51.00 FORMAT "%5.2" /end CHARACTERISTIC
/begin CHARACTERISTIC TDODSLS "Dauer Sekund‰rlufteinblasung f¸r Optionaldiagnose" VALUE 0x1CD050 KwWU8 25.50 t_q0p1 0.00 25.50 FORMAT "%5.2" /end CHARACTERISTIC
/begin CHARACTERISTIC TDSLSFA "max.Zeit f¸r Sekund‰rluftpumpenbetrieb bei Testeransteuerung" VALUE 0x1CD051 KwWU8 25.50 t_q0p1 0.00 25.50 FORMAT "%5.2" /end CHARACTERISTIC
/begin CHARACTERISTIC TDSTFLBS "Zeit nach Startende solange LBK-Startwert ausgegeben wird" VALUE 0x1CA6FE KwUb 2.550 t10msxs_ub_b2p55 0.00 2.550 FORMAT "%5.3" /end CHARACTERISTIC
/begin CHARACTERISTIC TFGANFFA "Zeitverzˆgerung f¸r Freigabe der Sekund‰rluftanforderung durch FA" VALUE 0x1CD03E KwWU16 6553.500 t_q0p1 0.00 6553.500 FORMAT "%8.3" /end CHARACTERISTIC
/begin CHARACTERISTIC TFGANFODSL "Zeitverzˆgerung f¸r Freigabe der Sekund‰rluftanforderung durch Aktivdiagnose" VALUE 0x1CD040 KwWU16 6553.500 t_q0p1 0.00 6553.500 FORMAT "%8.3" /end CHARACTERISTIC
/begin CHARACTERISTIC TIKATBTS "Temperaturschwelle im Kat f¸r Bauteileschutz" VALUE 0x1CBF6C KwUw 1279.980 temp_uw_q0p0195_o50 -50.00000 1229.980 FORMAT "%8.3" /end CHARACTERISTIC
/begin CHARACTERISTIC TKATBTS "Kat-Temperaturschwelle f¸r Bauteileschutz" VALUE 0x1CBF6E KwUw 1279.980 temp_uw_q0p0195_o50 -50.00000 1229.980 FORMAT "%8.3" /end CHARACTERISTIC
/begin CHARACTERISTIC TKHFSAB "Entprellzeit f¸r Umschaltung auf Katheizdrehzahl bei Fahrstufe" VALUE 0x1CCFA8 KwWU16 6553.500 t_q0p1 0.00 6553.500 FORMAT "%8.3" /end CHARACTERISTIC
/begin CHARACTERISTIC TKHLLMX "Maximale Zeit f¸r angehobene Katheiz-Drehzahl" VALUE 0x1CCFAA KwWU16 6553.500 t100msxs_uw_b6553p5 0.00 6553.500 FORMAT "%8.3" /end CHARACTERISTIC
/begin CHARACTERISTIC TKHNAB "Zeitdauer Absteuern Katheizdrehzahl" VALUE 0x1CCFAC KwWU16 6553.50000 zk100msxs_uw_b6553 0.100001526 6553.60000 FORMAT "%10.5" /end CHARACTERISTIC
/begin CHARACTERISTIC TKKMAX "KK Max. Abschaltzeit f¸r Abschaltung des Klimakompressors" VALUE 0x1C86CA KwUb 25.50 t100msxs_ub_b25p5 0.00 25.50 FORMAT "%5.2" /end CHARACTERISTIC
/begin CHARACTERISTIC TKKMAXLW "KK-Notaus Max. Abschaltzeit f¸r Abschaltung Klimakompressor" VALUE 0x1C86D0 KwUw 6553.500 t_q0p1 0.00 6553.500 FORMAT "%8.3" /end CHARACTERISTIC
/begin CHARACTERISTIC TKKMIN "KK Min. Abschaltzeit f¸r Abschaltung des Klimakompressors" VALUE 0x1C86CB KwUb 25.50 t100msxs_ub_b25p5 0.00 25.50 FORMAT "%5.2" /end CHARACTERISTIC
/begin CHARACTERISTIC TKKMINLW "KK-Notaus Min. Abschaltzeit f¸r Abschaltung Klimakompressor" VALUE 0x1C86CC KwUb 25.50 t_q0p1 0.00 25.50 FORMAT "%5.2" /end CHARACTERISTIC
/begin CHARACTERISTIC TLAFA "Vezˆgerungszeit bis Lambda Fahrerwunsch aktiv" VALUE 0x1CF5B9 KwUb 25.50 t100msxs_ub_b25p5 0.00 25.50 FORMAT "%5.2" /end CHARACTERISTIC
/begin CHARACTERISTIC TMAXTH "Theoretisch erreichbare Temperatur durch Verbrennung ohne Moment zu erzeugen" VALUE 0x1CCFAE KwWU16 1572.000 temp_q0p0468_K 1000.031 2572.031 FORMAT "%8.3" /end CHARACTERISTIC
/begin CHARACTERISTIC TMFASLMN "Motortemperaturschwelle Testeranforderung Sekund‰rluftdiagnose" VALUE 0x1CD052 KwWU8 191.3 temp_ub_q0p75_o48 -48.00 143.3 FORMAT "%5.1" /end CHARACTERISTIC
/begin CHARACTERISTIC TMOTLBKSOL "tmot-Schwelle bis zu der das Katheizkennfeld verwendet wird (f¸r Warmlauf)" VALUE 0x1CA6FF KwUb 191.3 temp_ub_q0p75_o48 -48.00 143.3 FORMAT "%5.1" /end CHARACTERISTIC
/begin CHARACTERISTIC TMSLMNDSLS "untere Motottemperaturschwelle f¸r Sekund‰rluftfreigabe bei Diagnose" VALUE 0x1CD053 KwWU8 191.3 temp_ub_q0p75_o48 -48.00 143.3 FORMAT "%5.1" /end CHARACTERISTIC
/begin CHARACTERISTIC TMSLMXDSLS "obere Motottemperaturschwelle f¸r Sekund‰rluftfreigabe bei Diagnose" VALUE 0x1CD054 KwWU8 191.3 temp_ub_q0p75_o48 -48.00 143.3 FORMAT "%5.1" /end CHARACTERISTIC
/begin CHARACTERISTIC TMSLSMNKH "untere Motottemperaturschwelle f¸r Sekund‰rluftfreigabe bei Katheizen" VALUE 0x1CD055 KwWU8 191.3 temp_ub_q0p75_o48 -48.00 143.3 FORMAT "%5.1" /end CHARACTERISTIC
/begin CHARACTERISTIC TMSLSMXKH "obere Motottemperaturschwelle f¸r Sekund‰rluftfreigabe bei Katheizen" VALUE 0x1CD056 KwWU8 191.3 temp_ub_q0p75_o48 -48.00 143.3 FORMAT "%5.1" /end CHARACTERISTIC
/begin CHARACTERISTIC TNSLFA "Filterzeitkonstante f¸r nslfa" VALUE 0x1CF702 KwUb 5.08000 zk20msxs_ub_b5p1 0.0200000 5.10000 FORMAT "%7.5" /end CHARACTERISTIC
/begin CHARACTERISTIC TNSTKK "SPERRZEIT NACH START F‹R KOS" VALUE 0x1C86CD KwUb 25.50 t100msxs_ub_b25p5 0.00 25.50 FORMAT "%5.2" /end CHARACTERISTIC
/begin CHARACTERISTIC TPWRSV "Wartezeit bis DV-E Powersave aktiv wird" VALUE 0x1C3B1C KwUw 655.3500 t10msxs_uw_b655p35 0.00 655.3500 FORMAT "%8.4" /end CHARACTERISTIC
/begin CHARACTERISTIC TSLPMN "Mindesteinschaltdauer der Sekund‰rluftpumpe" VALUE 0x1CD057 KwWU8 25.50 t_q0p1 0.00 25.50 FORMAT "%5.2" /end CHARACTERISTIC
/begin CHARACTERISTIC TVDK "Verzˆgerungszeit nach Schlieﬂen der Drosselklappe" VALUE 0x1C6D32 KwUb 5.100 t20msxs_ub_b5p1 0.00 5.100 FORMAT "%5.3" /end CHARACTERISTIC
/begin CHARACTERISTIC TVFGSLPBB "Zeitverzˆgerung zur Freigabe der Betriebsbereitschaft der SLP" VALUE 0x1CD058 KwWU8 25.50 t_q0p1 0.00 25.50 FORMAT "%5.2" /end CHARACTERISTIC
/begin CHARACTERISTIC TVKUPPL "Verzˆgerungszeit f¸r die Information des Kupplungsschalter" VALUE 0x1C6D33 KwUb 5.100 t20msxs_ub_b5p1 0.00 5.100 FORMAT "%5.3" /end CHARACTERISTIC
/begin CHARACTERISTIC TVLBTS "Verzˆgerungszeit Lambdasoll Bauteileschutz" VALUE 0x1CBF01 KwUb 25.50 t100msxs_ub_b25p5 0.00 25.50 FORMAT "%5.2" /end CHARACTERISTIC
/begin CHARACTERISTIC TVLLR "Einschaltverzˆgerung: B_llri bei ‹berdrehzahl" VALUE 0x1C6D34 KwUb 5.100 t20msxs_ub_b5p1 0.00 5.100 FORMAT "%5.3" /end CHARACTERISTIC
/begin CHARACTERISTIC TVLLRI "Verzˆgerungszeit f¸r Freigabe I-Anteil nach Start" CURVE 0x1C6D38 KlAUbSstUbWUb 5.100 t20msxs_ub_b5p1 0.00 5.100 FORMAT "%5.3"
 /begin AXIS_DESCR STD_AXIS tmot temp_ub_q0p75_o48 6 -48.00 143.3 FORMAT "%5.1" DEPOSIT ABSOLUTE /end AXIS_DESCR
/end CHARACTERISTIC
/begin CHARACTERISTIC TVLLRPD "Maximale Verzˆgerungszeit f¸r Freigabe PD-Anteil nach Start" CURVE 0x1C6D48 KlAUbSstUbWUb 5.100 t20msxs_ub_b5p1 0.00 5.100 FORMAT "%5.3"
 /begin AXIS_DESCR STD_AXIS tmot temp_ub_q0p75_o48 6 -48.00 143.3 FORMAT "%5.1" DEPOSIT ABSOLUTE /end AXIS_DESCR
/end CHARACTERISTIC
/begin CHARACTERISTIC TVLLRSTE "Zwangsbedingung Leerlaufregelung nach B_stend" VALUE 0x1C6D55 KwUb 5.100 t20msxs_ub_b5p1 0.00 5.100 FORMAT "%5.3" /end CHARACTERISTIC
/begin CHARACTERISTIC TVRESLL "Haltezeit f¸r die erhˆhte Momentenrerserve nach Drehzahleinbruch" VALUE 0x1C7042 KwUw 1310.700 t20msxs_uw_q0p02 0.00 1310.700 FORMAT "%8.3" /end CHARACTERISTIC
/begin CHARACTERISTIC TVRESTM "Initialisierungsdauer: Momentenreserve nach Start" VALUE 0x1CF7FE KwUb 5.100 t20msxs_ub_b5p1 0.00 5.100 FORMAT "%5.3" /end CHARACTERISTIC
/begin CHARACTERISTIC TVSLPBB "Verweilzeit f¸r Sekund‰rluft- Abbruchbedingung" VALUE 0x1CD059 KwWU8 25.50 t_q0p1 0.00 25.50 FORMAT "%5.2" /end CHARACTERISTIC
/begin CHARACTERISTIC TVSLVOFF "Zeitverzˆgerung Schlieﬂen Sekund‰rluftventil" VALUE 0x1CD05A KwWU8 25.50 t_q0p1 0.00 25.50 FORMAT "%5.2" /end CHARACTERISTIC
/begin CHARACTERISTIC TVSLVON "Zeitverzˆgerung ÷ffnen Sekund‰rluftventil" VALUE 0x1CD05B KwWU8 25.50 t_q0p1 0.00 25.50 FORMAT "%5.2" /end CHARACTERISTIC
/begin CHARACTERISTIC UBSLSTMN "min.Spannung f¸r Sekund‰rluft ein im Start" VALUE 0x1CD042 KwWU16 25.59961 spg_q0p00039 0.00 25.59961 FORMAT "%8.5" /end CHARACTERISTIC
/begin CHARACTERISTIC UBSLSTMX "max.Spannung f¸r Sekund‰rluft ein im Start" VALUE 0x1CD044 KwWU16 25.59961 spg_q0p00039 0.00 25.59961 FORMAT "%8.5" /end CHARACTERISTIC
/begin CHARACTERISTIC UB_DZA "Batteriespannung unterhalb der die Drehzahlanhebung aktiv ist" VALUE 0x1CF773 KwUb 24.02 spg_ubatt 0.00 24.02 FORMAT "%5.2" /end CHARACTERISTIC
/begin CHARACTERISTIC UDKNLPTOL "zul‰ssige Potispannungs-Toleranz des NLP" VALUE 0x1C3B1E KwUw 80.08377 spg_uw_q0p001222 0.00 80.08377 FORMAT "%8.5" /end CHARACTERISTIC
/begin CHARACTERISTIC VANF "Geschwindigkeitsschwelle f¸r Anfahrhilfe" VALUE 0x1C703B KwUb 318.8 vfzg_ub_q1p25 0.00 318.8 FORMAT "%5.1" /end CHARACTERISTIC
/begin CHARACTERISTIC VLLR "Fahrzeuggeschwindigkeitsschwelle f¸r Leerlaufregelung" VALUE 0x1C6D56 KwUb 318.8 vfzg_ub_q1p25 0.00 318.8 FORMAT "%5.1" /end CHARACTERISTIC
/begin CHARACTERISTIC VNSOL "N-Sollwert als f(Fzg.-Geschwindigkeit)" CURVE 0x1C6DC8 KlAUbSstUbWUb 2550. nmot_q10 0.00 2550. FORMAT "%5.0"
 /begin AXIS_DESCR STD_AXIS v_lfr vfzg_q0p25 6 0.00 63.75 FORMAT "%5.2" DEPOSIT ABSOLUTE /end AXIS_DESCR
/end CHARACTERISTIC
/begin CHARACTERISTIC VNSOL1 "N-Sollwert als f(Fzg.-Geschwindigkeit); Variante 1" CURVE 0x1C6DD8 KlAUbSstUbWUb 2550. nmot_q10 0.00 2550. FORMAT "%5.0"
 /begin AXIS_DESCR STD_AXIS v_lfr vfzg_q0p25 6 0.00 63.75 FORMAT "%5.2" DEPOSIT ABSOLUTE /end AXIS_DESCR
/end CHARACTERISTIC
/begin CHARACTERISTIC VNSOLH "N-Sollwert als f(Fzg.-Geschwindigkeit); Handschalter" CURVE 0x1C6DE8 KlAUbSstUbWUb 2550. nmot_q10 0.00 2550. FORMAT "%5.0"
 /begin AXIS_DESCR STD_AXIS v_lfr vfzg_q0p25 6 0.00 63.75 FORMAT "%5.2" DEPOSIT ABSOLUTE /end AXIS_DESCR
/end CHARACTERISTIC
/begin CHARACTERISTIC VZWKR "Z¸ndwinkelverstellung durch VS100, INCA" VAL_BLK 0x1C65D4 KwbWS8 40.50 zw_sb_q0p75 -20.25 20.25 FORMAT "%5.2" NUMBER 8 /end CHARACTERISTIC
/begin CHARACTERISTIC WDKBEWS "Schwelle zur DK-Bewegungserkennung (I-Klein)" VALUE 0x1C3B20 KwSw 1599.976 relDK_q0p02441 -800.0000 799.9756 FORMAT "%8.4" /end CHARACTERISTIC
/begin CHARACTERISTIC WDKNLPTOL "zul‰ssige DK-Winkel-Toleranz des NLP" VALUE 0x1C3B22 KwUw 100.0000 relDK_uw_b100 0.00 100.0000 FORMAT "%8.4" /end CHARACTERISTIC
/begin CHARACTERISTIC WDKREIB "Haftreibungsanteil der DK f¸r I-Klein" VALUE 0x1C3ADF KwUb 0.9961 fak_ub_b1 0.00 0.9961 /end CHARACTERISTIC
/begin CHARACTERISTIC WDKSAPNOL "DK-Sollwert bei Applikationshilfe DK-Notluftfahren" VALUE 0x1C3B24 KwUw 99.99847 relDK_q0p00152 0.00 99.99847 FORMAT "%8.5" /end CHARACTERISTIC
/begin CHARACTERISTIC WDKSTFEIN "Schwelle zur Stationarit‰tserkennung (verst‰rkter Bereich)" VALUE 0x1C3B26 KwSw 1599.976 relDK_q0p02441 -800.0000 799.9756 FORMAT "%8.4" /end CHARACTERISTIC
/begin CHARACTERISTIC WDKSTGROB "Schwelle zur Stationarit‰tserkennung (unverst‰rkter Bereich)" VALUE 0x1C3B28 KwSw 1599.976 relDK_q0p02441 -800.0000 799.9756 FORMAT "%8.4" /end CHARACTERISTIC
/begin CHARACTERISTIC WFAN "Schwellwert f¸r Fahrpedalwinkel bei Bandendetest" VALUE 0x1CF703 KwUb 100.0 relPED_ub_b100 0.00 100.0 FORMAT "%5.1" /end CHARACTERISTIC
/begin CHARACTERISTIC WISTRLASKH "wistr_w-Schwelle f¸r ‹bergang auf Lambda-Abgas-Vorgabe" VALUE 0x1CCD82 KwWU16 0.9999847 fak_uw_b1 0.00 0.9999847 FORMAT "%9.7" /end CHARACTERISTIC
/begin CHARACTERISTIC WKRLZOF "Festwerteblock: ZW-Offset f¸r gef¸hrte Zylinder" VAL_BLK 0x1C65CC KwbWS8 12.00 zw_sb_q0p75 -12.00 0.00 FORMAT "%5.2" NUMBER 8 /end CHARACTERISTIC
/begin CHARACTERISTIC WKRLZOFEKS "ZW-Offset f¸r gef¸hrte Zylinder bei KS-Fehler" VALUE 0x1CE9AD KwWS8 12.00 zw_sb_q0p75 -12.00 0.00 FORMAT "%5.2" /end CHARACTERISTIC
/begin CHARACTERISTIC WLBKSOLFLB "Umrechnung Faktor Sollladungsbewegung in Soll-LB-Klappenposition" CURVE 0x1CA7EC KlAUwSstUwWUw 99.99847 rel_uw_b100 0.00 99.99847 FORMAT "%8.5"
 /begin AXIS_DESCR STD_AXIS flbs_w fak_uw_b1 6 0.00 0.9999847 FORMAT "%9.7" DEPOSIT ABSOLUTE /end AXIS_DESCR
/end CHARACTERISTIC
/begin CHARACTERISTIC WSISTSLSMN "minimal durchgesetzten W‰rmestrom f¸r Freigabe des Katheizens mit SLP" CURVE 0x1CD01E KlAxU8SstxU8WU16 0.9999847 fak_uw_b1 0.00 0.9999847 FORMAT "%9.7"
 /begin AXIS_DESCR STD_AXIS tmst temp_ub_q0p75_o48 4 -48.00 143.3 FORMAT "%5.1" DEPOSIT ABSOLUTE /end AXIS_DESCR
/end CHARACTERISTIC
/begin CHARACTERISTIC WSISTSLSMX "maximal durchgesetzten W‰rmestrom f¸r Freigabe des Katheizens mit SLP" CURVE 0x1CD02C KlAxU8SstxU8WU16 0.9999847 fak_uw_b1 0.00 0.9999847 FORMAT "%9.7"
 /begin AXIS_DESCR STD_AXIS tmst temp_ub_q0p75_o48 4 -48.00 143.3 FORMAT "%5.1" DEPOSIT ABSOLUTE /end AXIS_DESCR
/end CHARACTERISTIC
/begin CHARACTERISTIC ZDLBTS "Zeitkonstante Delta Lambda Bauteileschutz" VALUE 0x1CBF70 KwUw 6553.50000 zk100msxs_uw_b6553 0.100001526 6553.60000 FORMAT "%10.5" /end CHARACTERISTIC
/begin CHARACTERISTIC ZFLASKH "Zeitkonstante f¸r ‹bergang auf Lambda-Abgas-Vorgabe" VALUE 0x1CCD84 KwWU8 25.4996 zk100msxs_ub_b25p5 0.100392 25.6000 FORMAT "%7.4" /end CHARACTERISTIC
/begin CHARACTERISTIC ZKLAMFAW "Zeitkonstante Filterung Anfettung durch Fahrerwunsch" VALUE 0x1CF63C KwUw 6553.50000 zk100msxs_uw_b6553 0.100001526 6553.60000 FORMAT "%10.5" /end CHARACTERISTIC
/begin CHARACTERISTIC ZKLANSWL "Zeitkonstante Filterung lamnswl_w" VALUE 0x1C4A3C KwUw 655.350000 zk10msxs_uw_b655 0.0100001526 655.360000 FORMAT "%10.6" /end CHARACTERISTIC
/begin CHARACTERISTIC ZKMDKBKV "Filterzeitkonstante bei Wechsel f¸r Filterung dmrkh_w bei Anforderung BKV" VALUE 0x1CCFB0 KwWU16 6553.50000 zk100msxs_uw_b6553 0.100001526 6553.60000 FORMAT "%10.5" /end CHARACTERISTIC
/begin CHARACTERISTIC ZKMDKH "Filterzeitkonstante bei Wechsel von Teillast nach LL und umgekehrt" VALUE 0x1CCFB2 KwWU16 6553.50000 zk100msxs_uw_b6553 0.100001526 6553.60000 FORMAT "%10.5" /end CHARACTERISTIC
/begin CHARACTERISTIC ZKNS "Zeitkonstante f¸r Solldrehzahl bei Umschaltung" VALUE 0x1CF774 KwUb 5.09992 zk20msxs_ub_b5p12 0.0200784 5.12000 FORMAT "%7.5" /end CHARACTERISTIC
/begin CHARACTERISTIC ZKUBDLR "DLR, Zeitkonstante f¸r Filterung von Ubatt" VALUE 0x1CA8E1 KwUb 0.4980 fak_ub_b0p5 0.00 0.4980 /end CHARACTERISTIC
/begin CHARACTERISTIC ZKWDKSPT1 "Zeitkonstante f¸r Pr‰diktion DK-Winkel aus Sollwert" VALUE 0x1C3AE0 KwUb 0.6973 fak_q0p00273 0.00 0.6973 /end CHARACTERISTIC
/begin CHARACTERISTIC ZKWLAFWL "Zeitkonstante Wichtung Offset Lambda-Motor-Soll" VALUE 0x1CF5BA KwUb 25.4996 zk100msxs_ub_b25p5 0.100392 25.6000 FORMAT "%7.4" /end CHARACTERISTIC
/begin CHARACTERISTIC ZLBTS "Zeitkonstante Lambda Bauteileschutz" VALUE 0x1CBF72 KwUw 6553.50000 zk100msxs_uw_b6553 0.100001526 6553.60000 FORMAT "%10.5" /end CHARACTERISTIC
/begin CHARACTERISTIC ZYRKR "Zylinderzuordnung f¸r maximale Referenzpegelbegrenzung Klopfregelung" VALUE 0x1C65C3 KwWU8 255.0 dez 0.00 255.0 FORMAT "%5.1" /end CHARACTERISTIC
/begin MEASUREMENT abbwevz_w "Abbruchwinkel Einspritzung" SWORD kw_q1 1 100 -32768 32767 FORMAT "%8.2" ARRAY_SIZE 8 ECU_ADDRESS 0x801AAC /end MEASUREMENT
/begin MEASUREMENT akrgz "Anzahl gef¸hrter Zylinder" UBYTE dez 1 100 0 255 FORMAT "%5.1" ECU_ADDRESS 0x800C8C /end MEASUREMENT
/begin MEASUREMENT akrlz "Anzahl mˆglicher Leitzylinder" UBYTE dez 1 100 0 255 FORMAT "%5.1" ECU_ADDRESS 0x800C8D /end MEASUREMENT
/begin MEASUREMENT anfsls "Art der Anforderung der Sekund‰rluftsteuerung" UBYTE dez 1 100 0 255 FORMAT "%5.1" ECU_ADDRESS 0x800A28 /end MEASUREMENT
/begin MEASUREMENT anzerrab_w "" UWORD dez 1 100 0 65535 FORMAT "%8.2" ARRAY_SIZE 8 ECU_ADDRESS 0x801ABC /end MEASUREMENT
/begin MEASUREMENT anzslp "Einschaltanzahl der Sekund‰rluftpumpe w‰hrend eines Fahrtzykluses" UBYTE dez 1 100 0 255 FORMAT "%5.1" ECU_ADDRESS 0x800A29 /end MEASUREMENT
/begin MEASUREMENT anzslpkh "Einschaltanzahl der Sekund‰rluftpumpe w‰hrend der Katheizphase" UBYTE dez 1 100 0 255 FORMAT "%5.1" ECU_ADDRESS 0x800A2A /end MEASUREMENT
/begin MEASUREMENT anzti "ti-Einspritzz‰hler" UBYTE dez 1 100 0 255 FORMAT "%5.1" ECU_ADDRESS 0x800F40 /end MEASUREMENT
/begin MEASUREMENT anztib "Einspritzz‰hler begrenzt" UBYTE dez 1 100 0 255 FORMAT "%5.1" ECU_ADDRESS 0x800F41 /end MEASUREMENT
/begin MEASUREMENT anztib0_w "ti-Einspritzz‰hler bis Startende Einspritzung" UWORD dez 1 100 0 65535 FORMAT "%8.2" ECU_ADDRESS 0x801614 /end MEASUREMENT
/begin MEASUREMENT anztib1_w "ti-Einspritzz‰hler ab Startende Einspritzung" UWORD dez 1 100 0 65535 FORMAT "%8.2" ECU_ADDRESS 0x801616 /end MEASUREMENT
/begin MEASUREMENT anztib_w "ti-Einspritzz‰hler mit Begrenzung" UWORD dez 1 100 0 65535 FORMAT "%8.2" ECU_ADDRESS 0x801ACC /end MEASUREMENT
/begin MEASUREMENT anztisc_w "ti-Einspritzz‰hler im Start" UWORD dez 1 100 0 65535 FORMAT "%8.2" ECU_ADDRESS 0x801ACE /end MEASUREMENT
/begin MEASUREMENT anzti_w "ti-Einspritzz‰hler" UWORD dez 1 100 0 65535 FORMAT "%8.2" ECU_ADDRESS 0x801AD0 /end MEASUREMENT
/begin MEASUREMENT AS_dimdk "" UBYTE B_TRUE 1 100 0 1 BIT_MASK 0x1 FORMAT "%13.11" ECU_ADDRESS 0x7FA676 /end MEASUREMENT
/begin MEASUREMENT B_aflldsls "Freigabe Optionaldiagnose SLS nur w‰hrend des Leerlaufs" UBYTE B_TRUE 1 100 0 1 BIT_MASK 0x1 FORMAT "%13.11" ECU_ADDRESS 0x800A2B /end MEASUREMENT
/begin MEASUREMENT B_aktdsls "Freigabe der Sekund‰rluftdiagnose nicht w‰hrend dem Katheizen" UBYTE B_TRUE 1 100 0 1 BIT_MASK 0x2 FORMAT "%13.11" ECU_ADDRESS 0x800A2B /end MEASUREMENT
/begin MEASUREMENT B_anfodsls "Bedingung Anforderung einer Optionaldiagnose" UBYTE B_TRUE 1 100 0 1 BIT_MASK 0x20 FORMAT "%13.11" ECU_ADDRESS 0x800A2E /end MEASUREMENT
/begin MEASUREMENT B_awsalsu "Bedingung Bewertung Aktivdiagnose in Abh‰ngigkeit vom Schubabgleich" UBYTE B_TRUE 1 100 0 1 BIT_MASK 0x4 FORMAT "%13.11" ECU_ADDRESS 0x800A2B /end MEASUREMENT
/begin MEASUREMENT B_bkvkhab "Bedingung: KH abregeln, da nicht gen¸gend Unterdruck in BKV" UBYTE B_TRUE 1 100 0 1 BIT_MASK 0x1 FORMAT "%13.11" ECU_ADDRESS 0x800A20 /end MEASUREMENT
/begin MEASUREMENT B_cwdslty "Bedingung rdy-Flag ohne Z_slp bei aktiver Pr¸fung" UBYTE B_TRUE 1 100 0 1 BIT_MASK 0x2 FORMAT "%13.11" ECU_ADDRESS 0x800A2D /end MEASUREMENT
/begin MEASUREMENT B_dcdisfr "Bedingung: Disable DV-E-Endstufe durch den Funktionsrechner" UBYTE B_TRUE 1 100 0 1 BIT_MASK 0x1 FORMAT "%13.11" ECU_ADDRESS 0x7FA677 /end MEASUREMENT
/begin MEASUREMENT B_dkbew "Bedingung: DK hat sich bewegt" UBYTE B_TRUE 1 100 0 1 BIT_MASK 0x1 FORMAT "%13.11" ECU_ADDRESS 0x7FA678 /end MEASUREMENT
/begin MEASUREMENT B_dlrbe "Bedingung: DLR-Stellbereich wurde ¸berschritten" UBYTE B_TRUE 1 100 0 1 BIT_MASK 0x1 FORMAT "%13.11" ECU_ADDRESS 0x7FA679 /end MEASUREMENT
/begin MEASUREMENT B_dlrikla "Bedingung: DLR, I-Klein aktiv" UBYTE B_TRUE 1 100 0 1 BIT_MASK 0x1 FORMAT "%13.11" ECU_ADDRESS 0x7FA67A /end MEASUREMENT
/begin MEASUREMENT B_dlriklst "Bedingung: Erster Durchlauf I-Klein nach Start" UBYTE B_TRUE 1 100 0 1 BIT_MASK 0x1 FORMAT "%13.11" ECU_ADDRESS 0x7FA67B /end MEASUREMENT
/begin MEASUREMENT B_dlrparc "Bedingung: Sollgrˆﬂensprung steht an" UBYTE B_TRUE 1 100 0 1 BIT_MASK 0x1 FORMAT "%13.11" ECU_ADDRESS 0x7FA67C /end MEASUREMENT
/begin MEASUREMENT B_dlrpide "Bedingung: Fehler, DLR-Stellbereich am Anschlag" UBYTE B_TRUE 1 100 0 1 BIT_MASK 0x1 FORMAT "%13.11" ECU_ADDRESS 0x7FA67D /end MEASUREMENT
/begin MEASUREMENT B_dlrspid "Bedingung: DLR, Vorzeichen der Summe der PID-Anteile, =1: positiv, =0: negativ" UBYTE B_TRUE 1 100 0 1 BIT_MASK 0x1 FORMAT "%13.11" ECU_ADDRESS 0x7FA67E /end MEASUREMENT
/begin MEASUREMENT B_dlrumzu "Bedingung: NLP-Umladen zugelassen" UBYTE B_TRUE 1 100 0 1 BIT_MASK 0x1 FORMAT "%13.11" ECU_ADDRESS 0x7FA67F /end MEASUREMENT
/begin MEASUREMENT B_drstat "Drive-Zustand (verzˆgert)" UBYTE B_TRUE 1 100 0 1 BIT_MASK 0x1 FORMAT "%13.11" ECU_ADDRESS 0x7FA9B7 /end MEASUREMENT
/begin MEASUREMENT B_dslafa "Anfoderung Kurztest oder Adaption in DSLSXXX" UBYTE B_TRUE 1 100 0 1 BIT_MASK 0x1 FORMAT "%13.11" ECU_ADDRESS 0x7FA738 /end MEASUREMENT
/begin MEASUREMENT B_dslsvvt "Bedingung zur Ber¸cksichtigung spezifischer VVT-Anforderungen in der %DSLS" UBYTE B_TRUE 1 100 0 1 BIT_MASK 0x1 FORMAT "%13.11" ECU_ADDRESS 0x800A2E /end MEASUREMENT
/begin MEASUREMENT B_dveese "Bedingung: DV-E-Endstufen-Fehler" UBYTE B_TRUE 1 100 0 1 BIT_MASK 0x1 FORMAT "%13.11" ECU_ADDRESS 0x7FA680 /end MEASUREMENT
/begin MEASUREMENT B_dveesh "Bedingung: DV-E-Enstufen-Heilung" UBYTE B_TRUE 1 100 0 1 BIT_MASK 0x1 FORMAT "%13.11" ECU_ADDRESS 0x7FA681 /end MEASUREMENT
/begin MEASUREMENT B_dvete "Bedingung: Erweiterte Stellertauscherkennung" UBYTE B_TRUE 1 100 0 1 BIT_MASK 0x1 FORMAT "%13.11" ECU_ADDRESS 0x7FA682 /end MEASUREMENT
/begin MEASUREMENT B_dzaakt "LFR: Drehzahlanhebung aktiv" UBYTE B_TRUE 1 100 0 1 BIT_MASK 0x1 FORMAT "%13.11" ECU_ADDRESS 0x7FA9B8 /end MEASUREMENT
/begin MEASUREMENT B_dzaeakt "LFR: Drehzahlanhebung aktiv bei EHB Anforderung" UBYTE B_TRUE 1 100 0 1 BIT_MASK 0x1 FORMAT "%13.11" ECU_ADDRESS 0x801262 /end MEASUREMENT
/begin MEASUREMENT B_dzaefg "Drehzahlanhebungsfreigabe bei EHB-Anforderung" UBYTE B_TRUE 1 100 0 1 BIT_MASK 0x2 FORMAT "%13.11" ECU_ADDRESS 0x801262 /end MEASUREMENT
/begin MEASUREMENT B_dzakakt "Bedingung Drehzahlanhebung bei Klima aktiviert" UBYTE B_TRUE 1 100 0 1 BIT_MASK 0x4 FORMAT "%13.11" ECU_ADDRESS 0x801262 /end MEASUREMENT
/begin MEASUREMENT B_dzakfg "Bedingung Klima-Drehzahlanhebungs-Freigabe" UBYTE B_TRUE 1 100 0 1 BIT_MASK 0x8 FORMAT "%13.11" ECU_ADDRESS 0x801262 /end MEASUREMENT
/begin MEASUREMENT B_dzauakt "Drehzahlanhebung bei Batterieunterspannung aktiviert" UBYTE B_TRUE 1 100 0 1 BIT_MASK 0x10 FORMAT "%13.11" ECU_ADDRESS 0x801262 /end MEASUREMENT
/begin MEASUREMENT B_dzaufg "Drehzahlanhebung bei Batterieunterspannung freigegeben" UBYTE B_TRUE 1 100 0 1 BIT_MASK 0x20 FORMAT "%13.11" ECU_ADDRESS 0x801262 /end MEASUREMENT
/begin MEASUREMENT B_eksh "Hilfsbit: Klopfsensorfehler erkannt" UBYTE B_TRUE 1 100 0 1 BIT_MASK 0x1 FORMAT "%13.11" ECU_ADDRESS 0x7FA853 /end MEASUREMENT
/begin MEASUREMENT B_ekszk "" UBYTE B_TRUE 1 100 0 1 BIT_MASK 0x1 FORMAT "%13.11" ECU_ADDRESS 0x7FA854 /end MEASUREMENT
/begin MEASUREMENT B_elzmn "minimale Anzahl mˆglicher KR-Leitzylinder unterschritten" UBYTE B_TRUE 1 100 0 1 BIT_MASK 0x1 FORMAT "%13.11" ECU_ADDRESS 0x7FA855 /end MEASUREMENT
/begin MEASUREMENT B_enllri "Freigabe Leerlaufregelung: I-Anteil" UBYTE B_TRUE 1 100 0 1 BIT_MASK 0x1 FORMAT "%13.11" ECU_ADDRESS 0x7FA9AF /end MEASUREMENT
/begin MEASUREMENT B_ensol "" UBYTE B_TRUE 1 100 0 1 BIT_MASK 0x1 FORMAT "%13.11" ECU_ADDRESS 0x7FA9B0 /end MEASUREMENT
/begin MEASUREMENT B_erradsls "Bedingung Fehler Diagnose SLS darf nicht w‰hrend Katheizem gesetzt werden" UBYTE B_TRUE 1 100 0 1 BIT_MASK 0x8 FORMAT "%13.11" ECU_ADDRESS 0x800A2B /end MEASUREMENT
/begin MEASUREMENT B_fanfg "Freigabebit f¸r Drehzahlanforderung bei Bandendetest" UBYTE B_TRUE 1 100 0 1 BIT_MASK 0x1 FORMAT "%13.11" ECU_ADDRESS 0x80125F /end MEASUREMENT
/begin MEASUREMENT B_fasla "Bedingung: externe Anforderung an Sekund‰rluft aktiv" UBYTE B_TRUE 1 100 0 1 BIT_MASK 0x10 FORMAT "%13.11" ECU_ADDRESS 0x800A2B /end MEASUREMENT
/begin MEASUREMENT B_faslaon "Bedingung: Funktionsanforderung f¸r Sekund‰rluftdiagnose" UBYTE B_TRUE 1 100 0 1 BIT_MASK 0x1 FORMAT "%13.11" ECU_ADDRESS 0x800A2F /end MEASUREMENT
/begin MEASUREMENT B_fganfdsl "Freigabe Anforderung einer Aktivdiagnose ohne das SLP gelaufen war" UBYTE B_TRUE 1 100 0 1 BIT_MASK 0x10 FORMAT "%13.11" ECU_ADDRESS 0x800A2D /end MEASUREMENT
/begin MEASUREMENT B_fganfsls "Beding.f¸r Freigabe zur Bestimmung d. Art d. Anforderung d.Sekund‰rluftsteuerung" UBYTE B_TRUE 1 100 0 1 BIT_MASK 0x20 FORMAT "%13.11" ECU_ADDRESS 0x800A2B /end MEASUREMENT
/begin MEASUREMENT B_fgmslofs "Freigabe Korrektur der Sekund‰rluftbestimmung durch frm Auswertung" UBYTE B_TRUE 1 100 0 1 BIT_MASK 0x20 FORMAT "%13.11" ECU_ADDRESS 0x800A2D /end MEASUREMENT
/begin MEASUREMENT B_fgslpbb "Freigabe Betriebsbereitschaft f¸r Sekund‰rluftpumpe mit B_stemd oder B_nmot" UBYTE B_TRUE 1 100 0 1 BIT_MASK 0x10 FORMAT "%13.11" ECU_ADDRESS 0x800A2F /end MEASUREMENT
/begin MEASUREMENT B_fgslpteh "Bedindung Freigabe Sekund‰rluftansteuerung durch Motorstarttemp. und Hˆhe" UBYTE B_TRUE 1 100 0 1 BIT_MASK 0x20 FORMAT "%13.11" ECU_ADDRESS 0x800A2F /end MEASUREMENT
/begin MEASUREMENT B_fktanfsl "Bedingung Funktionsanforderung Sekund‰rluft" UBYTE B_TRUE 1 100 0 1 BIT_MASK 0x8 FORMAT "%13.11" ECU_ADDRESS 0x800A2F /end MEASUREMENT
/begin MEASUREMENT B_hsve "Bedingung Endstufe Sondenheizung vor Kat angesteuert" UBYTE B_TRUE 1 100 0 1 BIT_MASK 0x1 FORMAT "%13.11" ECU_ADDRESS 0x7FA727 /end MEASUREMENT
/begin MEASUREMENT B_hsve2 "Bedingung Endstufe Sondenheizung2 vor Kat angesteuert" UBYTE B_TRUE 1 100 0 1 BIT_MASK 0x1 FORMAT "%13.11" ECU_ADDRESS 0x7FA728 /end MEASUREMENT
/begin MEASUREMENT B_hsvemn "Bedingung: Kurzschluﬂ Heizer nach Masse" UBYTE B_TRUE 1 100 0 1 BIT_MASK 0x2 FORMAT "%13.11" ECU_ADDRESS 0x8009CC /end MEASUREMENT
/begin MEASUREMENT B_hsvemn2 "Bedingung: Kurzschluﬂ Heizer nach Masse, Bank 2" UBYTE B_TRUE 1 100 0 1 BIT_MASK 0x10 FORMAT "%13.11" ECU_ADDRESS 0x8009CC /end MEASUREMENT
/begin MEASUREMENT B_hsvemx "Bedingung: Kurzschluﬂ Heizer nach Ubat" UBYTE B_TRUE 1 100 0 1 BIT_MASK 0x4 FORMAT "%13.11" ECU_ADDRESS 0x8009CC /end MEASUREMENT
/begin MEASUREMENT B_hsvemx2 "Bedingung: Kurzschluﬂ Heizer nach Ubat, Bank 2" UBYTE B_TRUE 1 100 0 1 BIT_MASK 0x20 FORMAT "%13.11" ECU_ADDRESS 0x8009CC /end MEASUREMENT
/begin MEASUREMENT B_hsvesi "Bedingung: Lastabfall Heizer" UBYTE B_TRUE 1 100 0 1 BIT_MASK 0x1 FORMAT "%13.11" ECU_ADDRESS 0x8009CC /end MEASUREMENT
/begin MEASUREMENT B_hsvesi2 "Bedingung: Lastabfall Heizer, Bank 2" UBYTE B_TRUE 1 100 0 1 BIT_MASK 0x8 FORMAT "%13.11" ECU_ADDRESS 0x8009CC /end MEASUREMENT
/begin MEASUREMENT B_iklrest "Bedingung: Retriggerung I-Klein" UBYTE B_TRUE 1 100 0 1 BIT_MASK 0x1 FORMAT "%13.11" ECU_ADDRESS 0x7FA683 /end MEASUREMENT
/begin MEASUREMENT B_iklstar "Bedingung: I-Klein soll starten" UBYTE B_TRUE 1 100 0 1 BIT_MASK 0x1 FORMAT "%13.11" ECU_ADDRESS 0x7FA684 /end MEASUREMENT
/begin MEASUREMENT B_injmodst "" UBYTE B_TRUE 1 100 0 1 BIT_MASK 0x1 FORMAT "%13.11" ECU_ADDRESS 0x7F9864 /end MEASUREMENT
/begin MEASUREMENT B_injstop "" UBYTE B_TRUE 1 100 0 1 BIT_MASK 0x1 FORMAT "%13.11" ECU_ADDRESS 0x7F9865 /end MEASUREMENT
/begin MEASUREMENT B_khn "Bedingung Katheiz-Drehzahl" UBYTE B_TRUE 1 100 0 1 BIT_MASK 0x1 FORMAT "%13.11" ECU_ADDRESS 0x800A1F /end MEASUREMENT
/begin MEASUREMENT B_kl "Bedingung f¸r erkannte Klopfer" UBYTE B_TRUE 1 100 0 1 BIT_MASK 0x1 FORMAT "%13.11" ECU_ADDRESS 0x7FA852 /end MEASUREMENT
/begin MEASUREMENT B_kldynrm "Bedingung normales Klopfen bei adapt. Lastdynamik" UBYTE B_TRUE 1 100 0 1 BIT_MASK 0x1 FORMAT "%13.11" ECU_ADDRESS 0x7FA84F /end MEASUREMENT
/begin MEASUREMENT B_kldystk "Bedingung starkes Klopfen bei adapt. Lastdynamik" UBYTE B_TRUE 1 100 0 1 BIT_MASK 0x1 FORMAT "%13.11" ECU_ADDRESS 0x7FA850 /end MEASUREMENT
/begin MEASUREMENT B_koevab "Ev-Abschaltung durch Funktion KOEVAB aktiv" UBYTE B_TRUE 1 100 0 1 BIT_MASK 0x1 FORMAT "%13.11" ECU_ADDRESS 0x7FA817 /end MEASUREMENT
/begin MEASUREMENT B_kompbaus "Bedingung Klimakompressor Abschaltanforderung" UBYTE B_TRUE 1 100 0 1 BIT_MASK 0x1 FORMAT "%13.11" ECU_ADDRESS 0x80109A /end MEASUREMENT
/begin MEASUREMENT B_kompnaus "Bedingung Klimakompressor-Notaus-Abschaltbedingung" UBYTE B_TRUE 1 100 0 1 BIT_MASK 0x2 FORMAT "%13.11" ECU_ADDRESS 0x80109A /end MEASUREMENT
/begin MEASUREMENT B_krdwslz "Bedingung: Klopfregelung Sicherheitssp‰tverstellung von LZF gefordert" UBYTE B_TRUE 1 100 0 1 BIT_MASK 0x1 FORMAT "%13.11" ECU_ADDRESS 0x7FA856 /end MEASUREMENT
/begin MEASUREMENT B_krlz "KR-Leitzylinderfunktion aktiv" UBYTE B_TRUE 1 100 0 1 BIT_MASK 0x1 FORMAT "%13.11" ECU_ADDRESS 0x7FA857 /end MEASUREMENT
/begin MEASUREMENT B_krlzn "Drehzahlschwelle f¸r KR-Leitzylinderfunktion ¸berschritten" UBYTE B_TRUE 1 100 0 1 BIT_MASK 0x1 FORMAT "%13.11" ECU_ADDRESS 0x7FA858 /end MEASUREMENT
/begin MEASUREMENT B_krlz_old "" UBYTE B_TRUE 1 100 0 1 BIT_MASK 0x1 FORMAT "%13.11" ECU_ADDRESS 0x7FA859 /end MEASUREMENT
/begin MEASUREMENT B_krnllz "Notlauf Klopferkennung mit LZF bei Phasennotlauf und/oder Doppelz¸ndung" UBYTE B_TRUE 1 100 0 1 BIT_MASK 0x1 FORMAT "%13.11" ECU_ADDRESS 0x7FA85A /end MEASUREMENT
/begin MEASUREMENT B_krnlzdws "Bedingung Klopfregelung Sicherheitssp‰tverstellung aufgrund KR-Notlauf" UBYTE B_TRUE 1 100 0 1 BIT_MASK 0x1 FORMAT "%13.11" ECU_ADDRESS 0x7FA85B /end MEASUREMENT
/begin MEASUREMENT B_krnl_old "" UBYTE B_TRUE 1 100 0 1 BIT_MASK 0x1 FORMAT "%13.11" ECU_ADDRESS 0x7FA85C /end MEASUREMENT
/begin MEASUREMENT B_krvf "Bedingung f¸r Abregelung der KR-ZW-Sp‰tverstellung" UBYTE B_TRUE 1 100 0 1 BIT_MASK 0x1 FORMAT "%13.11" ECU_ADDRESS 0x7FA863 /end MEASUREMENT
/begin MEASUREMENT B_kuplaus "Motor ist ausgekuppelt; Kupllung ist getreten" UBYTE B_TRUE 1 100 0 1 BIT_MASK 0x1 FORMAT "%13.11" ECU_ADDRESS 0x7FA9BE /end MEASUREMENT
/begin MEASUREMENT B_lalgf "Bedingung Laufgrenze ""Lambda fett"" aktiv" UBYTE B_TRUE 1 100 0 1 BIT_MASK 0x1 FORMAT "%13.11" ECU_ADDRESS 0x7FA6B5 /end MEASUREMENT
/begin MEASUREMENT B_lalgf2 "Bedingung Laufgrenze ""Lambda fett"" aktiv" UBYTE B_TRUE 1 100 0 1 BIT_MASK 0x1 FORMAT "%13.11" ECU_ADDRESS 0x7FA6B6 /end MEASUREMENT
/begin MEASUREMENT B_lambts "Lambda f¸r Bauteileschutz ist aktiv" UBYTE B_TRUE 1 100 0 1 BIT_MASK 0x1 FORMAT "%13.11" ECU_ADDRESS 0x7FA6B7 /end MEASUREMENT
/begin MEASUREMENT B_lambts2 "Lambda f¸r Bauteileschutz ist aktiv (Bank2)" UBYTE B_TRUE 1 100 0 1 BIT_MASK 0x1 FORMAT "%13.11" ECU_ADDRESS 0x7FA6B8 /end MEASUREMENT
/begin MEASUREMENT B_lamdiag "Lambdasoll von Diagnosefunktionen angefordert" UBYTE B_TRUE 1 100 0 1 BIT_MASK 0x1 FORMAT "%13.11" ECU_ADDRESS 0x7FA6B9 /end MEASUREMENT
/begin MEASUREMENT B_lamdiag2 "Lambdasoll von Diagnosefunktionen angefordert Bank2" UBYTE B_TRUE 1 100 0 1 BIT_MASK 0x1 FORMAT "%13.11" ECU_ADDRESS 0x7FA6BA /end MEASUREMENT
/begin MEASUREMENT B_lamfas "Verbot  f¸r Lambda Fahrerwunsch Aktivierung" UBYTE B_TRUE 1 100 0 1 BIT_MASK 0x1 FORMAT "%13.11" ECU_ADDRESS 0x7FA999 /end MEASUREMENT
/begin MEASUREMENT B_lamkh "Bedingung Lambdasoll f¸r Katheizen aktiv" UBYTE B_TRUE 1 100 0 1 BIT_MASK 0x1 FORMAT "%13.11" ECU_ADDRESS 0x7FA6BB /end MEASUREMENT
/begin MEASUREMENT B_lamkhe "keine Lambdaanforderung seitens LAKH" UBYTE B_TRUE 1 100 0 1 BIT_MASK 0x1 FORMAT "%13.11" ECU_ADDRESS 0x8009EC /end MEASUREMENT
/begin MEASUREMENT B_lamnse "Bedingung Ende lamns_w-Berechnung" UBYTE B_TRUE 1 100 0 1 BIT_MASK 0x1 FORMAT "%13.11" ECU_ADDRESS 0x7FA6C0 /end MEASUREMENT
/begin MEASUREMENT B_lamnswl "Lambda-Motor-Soll f¸r Nachstart und Warmlauf aktiv" UBYTE B_TRUE 1 100 0 1 BIT_MASK 0x1 FORMAT "%13.11" ECU_ADDRESS 0x7FA6BC /end MEASUREMENT
/begin MEASUREMENT B_lamsdef "Bedingung : definierte Soll-Lambda" UBYTE B_TRUE 1 100 0 1 BIT_MASK 0x1 FORMAT "%13.11" ECU_ADDRESS 0x7FA6BD /end MEASUREMENT
/begin MEASUREMENT B_lawlon "lamwl_w ist aktiv" UBYTE B_TRUE 1 100 0 1 BIT_MASK 0x1 FORMAT "%13.11" ECU_ADDRESS 0x7FA6C1 /end MEASUREMENT
/begin MEASUREMENT B_lbkdenox "Bedingung: Sollwert wird bei B_denox=true nicht ge‰ndert" UBYTE B_TRUE 1 100 0 1 BIT_MASK 0x1 FORMAT "%13.11" ECU_ADDRESS 0x8010C3 /end MEASUREMENT
/begin MEASUREMENT B_lbksap "Bedingung f¸r LBK-Sollwertvorgabe durch Applikationswert" UBYTE B_TRUE 1 100 0 1 BIT_MASK 0x2 FORMAT "%13.11" ECU_ADDRESS 0x8010C3 /end MEASUREMENT
/begin MEASUREMENT B_lbksapkf "Bedingung: Applikation von flbs_w aus Kennfeld (rk und nmot)" UBYTE B_TRUE 1 100 0 1 BIT_MASK 0x10 FORMAT "%13.11" ECU_ADDRESS 0x8010C3 /end MEASUREMENT
/begin MEASUREMENT B_lbs "Bedingung LBK in Stellung Schicht fahren" UBYTE B_TRUE 1 100 0 1 BIT_MASK 0x1 FORMAT "%13.11" ECU_ADDRESS 0x8010C5 /end MEASUREMENT
/begin MEASUREMENT B_ldef "Bedingung : definierte Soll-Lambda Bank1" UBYTE B_TRUE 1 100 0 1 BIT_MASK 0x1 FORMAT "%13.11" ECU_ADDRESS 0x7FA6BE /end MEASUREMENT
/begin MEASUREMENT B_ldef2 "Bedingung : definierte Soll-Lambda Bank2" UBYTE B_TRUE 1 100 0 1 BIT_MASK 0x1 FORMAT "%13.11" ECU_ADDRESS 0x7FA6BF /end MEASUREMENT
/begin MEASUREMENT B_ldeffw "Bedingung : definiertes Soll-Lambda Bank1 durch Fahrerwunsch" UBYTE B_TRUE 1 100 0 1 BIT_MASK 0x1 FORMAT "%13.11" ECU_ADDRESS 0x7FA99A /end MEASUREMENT
/begin MEASUREMENT B_llde "Bedingung Drehzahleinbruch" UBYTE B_TRUE 1 100 0 1 BIT_MASK 0x1 FORMAT "%13.11" ECU_ADDRESS 0x7FA9BF /end MEASUREMENT
/begin MEASUREMENT B_llr "Bedingung Leerlaufregelung" UBYTE B_TRUE 1 100 0 1 BIT_MASK 0x1 FORMAT "%13.11" ECU_ADDRESS 0x7FA9B1 /end MEASUREMENT
/begin MEASUREMENT B_llrein "Bedingung LLR ist aktiv" UBYTE B_TRUE 1 100 0 1 BIT_MASK 0x1 FORMAT "%13.11" ECU_ADDRESS 0x7FA9B2 /end MEASUREMENT
/begin MEASUREMENT B_llri "Bedingung I-Anteil der LLR aktiv" UBYTE B_TRUE 1 100 0 1 BIT_MASK 0x1 FORMAT "%13.11" ECU_ADDRESS 0x7FA9B3 /end MEASUREMENT
/begin MEASUREMENT B_llrpd "Bedingung PD-Anteil der LLR aktiv" UBYTE B_TRUE 1 100 0 1 BIT_MASK 0x1 FORMAT "%13.11" ECU_ADDRESS 0x7FA9B4 /end MEASUREMENT
/begin MEASUREMENT B_lsuiamn "Bedingung: Lambdasensorsignal an Bond IA kleiner als Schwellwert" UBYTE B_TRUE 1 100 0 1 BIT_MASK 0x4 FORMAT "%13.11" ECU_ADDRESS 0x8009BC /end MEASUREMENT
/begin MEASUREMENT B_lsuiamn2 "Bedingung: Lambdasensorsignal an Bond IA kleiner als Schwellwert, Bank 2" UBYTE B_TRUE 1 100 0 1 BIT_MASK 0x4 FORMAT "%13.11" ECU_ADDRESS 0x8009BD /end MEASUREMENT
/begin MEASUREMENT B_lsuiamx "Bedingung: Lambdasensorsignal an Bond IA grˆﬂer als Schwellwert" UBYTE B_TRUE 1 100 0 1 BIT_MASK 0x20 FORMAT "%13.11" ECU_ADDRESS 0x8009BC /end MEASUREMENT
/begin MEASUREMENT B_lsuiamx2 "Bedingung: Lambdasensorsignal an Bond IA grˆﬂer als Schwellwert, Bank 2" UBYTE B_TRUE 1 100 0 1 BIT_MASK 0x20 FORMAT "%13.11" ECU_ADDRESS 0x8009BD /end MEASUREMENT
/begin MEASUREMENT B_lsuicif "Bedingung Schreibfehler auf INIT-Register des Auswerte IC der LSU" UBYTE B_TRUE 1 100 0 1 BIT_MASK 0x1 FORMAT "%13.11" ECU_ADDRESS 0x7FA729 /end MEASUREMENT
/begin MEASUREMENT B_lsuicif2 "Bedingung Schreibfehler auf INIT-Register des Auswerte IC der LSU, Bank 2" UBYTE B_TRUE 1 100 0 1 BIT_MASK 0x1 FORMAT "%13.11" ECU_ADDRESS 0x7FA72A /end MEASUREMENT
/begin MEASUREMENT B_lsuickf "Bedingung Kommunikationsfehler der SPI Schnittstelle zum Auswerte IC" UBYTE B_TRUE 1 100 0 1 BIT_MASK 0x1 FORMAT "%13.11" ECU_ADDRESS 0x7FA72B /end MEASUREMENT
/begin MEASUREMENT B_lsuickf2 "Bedingung Kommunikationsfehler der SPI Schnittstelle zum Auswerte IC, Bank 2" UBYTE B_TRUE 1 100 0 1 BIT_MASK 0x1 FORMAT "%13.11" ECU_ADDRESS 0x7FA72C /end MEASUREMENT
/begin MEASUREMENT B_lsuube "Bedingung Betriebsspannung am LSU-Auswerte-IC zu klein" UBYTE B_TRUE 1 100 0 1 BIT_MASK 0x40 FORMAT "%13.11" ECU_ADDRESS 0x8009BC /end MEASUREMENT
/begin MEASUREMENT B_lsuube2 "Bedingung Betriebsspannung am LSU-Auswerte-IC zu klein, Bank 2" UBYTE B_TRUE 1 100 0 1 BIT_MASK 0x40 FORMAT "%13.11" ECU_ADDRESS 0x8009BD /end MEASUREMENT
/begin MEASUREMENT B_lsuunmn "Bedingung: Lambdasensorsignal an Bond UN kleiner als Schwellwert" UBYTE B_TRUE 1 100 0 1 BIT_MASK 0x2 FORMAT "%13.11" ECU_ADDRESS 0x8009BC /end MEASUREMENT
/begin MEASUREMENT B_lsuunmn2 "Bedingung: Lambdasensorsignal an Bond UN kleiner als Schwellwert, Bank 2" UBYTE B_TRUE 1 100 0 1 BIT_MASK 0x2 FORMAT "%13.11" ECU_ADDRESS 0x8009BD /end MEASUREMENT
/begin MEASUREMENT B_lsuunmx "Bedingung: Lambdasensorsignal an Bond UN grˆﬂer als Schwellwert" UBYTE B_TRUE 1 100 0 1 BIT_MASK 0x10 FORMAT "%13.11" ECU_ADDRESS 0x8009BC /end MEASUREMENT
/begin MEASUREMENT B_lsuunmx2 "Bedingung: Lambdasensorsignal an Bond UN grˆﬂer als Schwellwert, Bank 2" UBYTE B_TRUE 1 100 0 1 BIT_MASK 0x10 FORMAT "%13.11" ECU_ADDRESS 0x8009BD /end MEASUREMENT
/begin MEASUREMENT B_lsuvmmn "Bedingung: Lambdasensorsignal an Bond VM kleiner als Schwellwert" UBYTE B_TRUE 1 100 0 1 BIT_MASK 0x1 FORMAT "%13.11" ECU_ADDRESS 0x8009BC /end MEASUREMENT
/begin MEASUREMENT B_lsuvmmn2 "Bedingung: Lambdasensorsignal an Bond VM kleiner als Schwellwert, Bank 2" UBYTE B_TRUE 1 100 0 1 BIT_MASK 0x1 FORMAT "%13.11" ECU_ADDRESS 0x8009BD /end MEASUREMENT
/begin MEASUREMENT B_lsuvmmx "Bedingung: Lambdasensorsignal an Bond VM grˆﬂer als Schwellwert" UBYTE B_TRUE 1 100 0 1 BIT_MASK 0x8 FORMAT "%13.11" ECU_ADDRESS 0x8009BC /end MEASUREMENT
/begin MEASUREMENT B_lsuvmmx2 "Bedingung: Lambdasensorsignal an Bond VM grˆﬂer als Schwellwert, Bank 2" UBYTE B_TRUE 1 100 0 1 BIT_MASK 0x8 FORMAT "%13.11" ECU_ADDRESS 0x8009BD /end MEASUREMENT
/begin MEASUREMENT B_lzfuer "" UBYTE B_TRUE 1 100 0 1 BIT_MASK 0x1 FORMAT "%13.11" ECU_ADDRESS 0x7FA85D /end MEASUREMENT
/begin MEASUREMENT B_lzup "lzist update" UBYTE B_TRUE 1 100 0 1 BIT_MASK 0x1 FORMAT "%13.11" ECU_ADDRESS 0x7FA85E /end MEASUREMENT
/begin MEASUREMENT B_msllamrg "Beding. gefilterte Sekund‰rluftmasse (Bank1+Bank2) eingeschwungen" UBYTE B_TRUE 1 100 0 1 BIT_MASK 0x8 FORMAT "%13.11" ECU_ADDRESS 0x800A2D /end MEASUREMENT
/begin MEASUREMENT B_mxslpkh "Bedingung maximale Anzahl von Sekund‰rluftl‰ufen w‰hrend Katheizens" UBYTE B_TRUE 1 100 0 1 BIT_MASK 0x10 FORMAT "%13.11" ECU_ADDRESS 0x800A2E /end MEASUREMENT
/begin MEASUREMENT B_nlpne "Bedingung: Bei gefordertem DK-Notluftfahren wurde NLP nicht erreicht" UBYTE B_TRUE 1 100 0 1 BIT_MASK 0x1 FORMAT "%13.11" ECU_ADDRESS 0x7FA685 /end MEASUREMENT
/begin MEASUREMENT B_nokatfz "Bedingung Nicht-KAT Fahrzeug" UBYTE B_TRUE 1 100 0 1 BIT_MASK 0x1 FORMAT "%13.11" ECU_ADDRESS 0x7FA888 /end MEASUREMENT
/begin MEASUREMENT B_novcan "keine CAN-Geschwindigkeit" UBYTE B_TRUE 1 100 0 1 BIT_MASK 0x2 FORMAT "%13.11" ECU_ADDRESS 0x801263 /end MEASUREMENT
/begin MEASUREMENT B_nstakt "Nachstart aktiv" UBYTE B_TRUE 1 100 0 1 BIT_MASK 0x1 FORMAT "%13.11" ECU_ADDRESS 0x7FA9B9 /end MEASUREMENT
/begin MEASUREMENT B_nstu "Umschaltung Drehzahl von nstat auf nmot nach Start" UBYTE B_TRUE 1 100 0 1 BIT_MASK 0x1 FORMAT "%13.11" ECU_ADDRESS 0x7FA9B5 /end MEASUREMENT
/begin MEASUREMENT B_pn10v "PN-Wechselverzˆgerung (N->D)" UBYTE B_TRUE 1 100 0 1 BIT_MASK 0x40 FORMAT "%13.11" ECU_ADDRESS 0x801262 /end MEASUREMENT
/begin MEASUREMENT B_pnnsolns "Bedingung P/N-Nachstartsolldrehzahl-Verbot" UBYTE B_TRUE 1 100 0 1 BIT_MASK 0x1 FORMAT "%13.11" ECU_ADDRESS 0x801263 /end MEASUREMENT
/begin MEASUREMENT B_prventil "Bedingung f¸r Durchf¸hrung des Ventildichtigkeitschecks" UBYTE B_TRUE 1 100 0 1 BIT_MASK 0x40 FORMAT "%13.11" ECU_ADDRESS 0x800A2B /end MEASUREMENT
/begin MEASUREMENT B_pwrsv "Bedingung: DV-E-powersave ist aktiv" UBYTE B_TRUE 1 100 0 1 BIT_MASK 0x1 FORMAT "%13.11" ECU_ADDRESS 0x7FA686 /end MEASUREMENT
/begin MEASUREMENT B_slp "Bedingung f¸r Sekund‰rluftpumpe" UBYTE B_TRUE 1 100 0 1 BIT_MASK 0x80 FORMAT "%13.11" ECU_ADDRESS 0x800A2B /end MEASUREMENT
/begin MEASUREMENT B_slpbb "Bedindung Sekund‰rluftpumpe Betriebsbereit" UBYTE B_TRUE 1 100 0 1 BIT_MASK 0x1 FORMAT "%13.11" ECU_ADDRESS 0x800A2C /end MEASUREMENT
/begin MEASUREMENT B_slpmn "Mindestbetriebszeit der Sekund‰rluftpumpe" UBYTE B_TRUE 1 100 0 1 BIT_MASK 0x4 FORMAT "%13.11" ECU_ADDRESS 0x800A2D /end MEASUREMENT
/begin MEASUREMENT B_sls "Bedingung Sekund‰rluft aktiv" UBYTE B_TRUE 1 100 0 1 BIT_MASK 0x2 FORMAT "%13.11" ECU_ADDRESS 0x800A2C /end MEASUREMENT
/begin MEASUREMENT B_slsanf "Bedingung Ansteuerung Sekund‰rluftsystem" UBYTE B_TRUE 1 100 0 1 BIT_MASK 0x4 FORMAT "%13.11" ECU_ADDRESS 0x800A2C /end MEASUREMENT
/begin MEASUREMENT B_slsapp "Sekund‰rluftanforderung ¸ber Codewort f¸r Applikationszwecke" UBYTE B_TRUE 1 100 0 1 BIT_MASK 0x8 FORMAT "%13.11" ECU_ADDRESS 0x800A2C /end MEASUREMENT
/begin MEASUREMENT B_slsdsls "Bedingung Ansteuerung Sekund‰rluftsystem f¸r Diagnose" UBYTE B_TRUE 1 100 0 1 BIT_MASK 0x10 FORMAT "%13.11" ECU_ADDRESS 0x800A2C /end MEASUREMENT
/begin MEASUREMENT B_slsfa "Bedingung Ansteuerung Sekund‰rluftsystem f¸r Kurztest" UBYTE B_TRUE 1 100 0 1 BIT_MASK 0x20 FORMAT "%13.11" ECU_ADDRESS 0x800A2C /end MEASUREMENT
/begin MEASUREMENT B_slskh "Bedingung Ansteuerung Sekund‰rluftsystem f¸r Katalysatorheizen" UBYTE B_TRUE 1 100 0 1 BIT_MASK 0x40 FORMAT "%13.11" ECU_ADDRESS 0x800A2C /end MEASUREMENT
/begin MEASUREMENT B_slsoab "Bedingung SLS ohne Abbruchkriterium durchgef¸hrt" UBYTE B_TRUE 1 100 0 1 BIT_MASK 0x40 FORMAT "%13.11" ECU_ADDRESS 0x800A2D /end MEASUREMENT
/begin MEASUREMENT B_slv "Bedingung f¸r Sekund‰rluftventil" UBYTE B_TRUE 1 100 0 1 BIT_MASK 0x80 FORMAT "%13.11" ECU_ADDRESS 0x800A2C /end MEASUREMENT
/begin MEASUREMENT B_stakt "Start aktiv" UBYTE B_TRUE 1 100 0 1 BIT_MASK 0x1 FORMAT "%13.11" ECU_ADDRESS 0x7FA9BA /end MEASUREMENT
/begin MEASUREMENT B_tabgbts "Bedingung Abgastemperatur f¸r Bauteileschutz ¸berschritten" UBYTE B_TRUE 1 100 0 1 BIT_MASK 0x1 FORMAT "%13.11" ECU_ADDRESS 0x801168 /end MEASUREMENT
/begin MEASUREMENT B_tatmbts "Bedingung: Temperatur aus ATM f¸r Bauteileschutz ¸berschritten" UBYTE B_TRUE 1 100 0 1 BIT_MASK 0x10 FORMAT "%13.11" ECU_ADDRESS 0x801168 /end MEASUREMENT
/begin MEASUREMENT B_tevtini "TEV timer wurde neu initialisiert" UBYTE B_TRUE 1 100 0 1 BIT_MASK 0x1 FORMAT "%13.11" ECU_ADDRESS 0x7FA7DC /end MEASUREMENT
/begin MEASUREMENT B_tikatbts "Bedingung Temperatur im Kat f¸r Bauteileschutz ¸berschritten" UBYTE B_TRUE 1 100 0 1 BIT_MASK 0x8 FORMAT "%13.11" ECU_ADDRESS 0x801168 /end MEASUREMENT
/begin MEASUREMENT B_tipin_old "" UBYTE B_TRUE 1 100 0 1 BIT_MASK 0x1 FORMAT "%13.11" ECU_ADDRESS 0x7FA851 /end MEASUREMENT
/begin MEASUREMENT B_tkatbts "Bedingung Katalysatortemperatur f¸r Bauteileschutz ¸berschritten" UBYTE B_TRUE 1 100 0 1 BIT_MASK 0x2 FORMAT "%13.11" ECU_ADDRESS 0x801168 /end MEASUREMENT
/begin MEASUREMENT B_trslsfa "Triggerbedingung f¸r Betriebszeit der SLP bei Funktionsanforderung" UBYTE B_TRUE 1 100 0 1 BIT_MASK 0x1 FORMAT "%13.11" ECU_ADDRESS 0x800A2D /end MEASUREMENT
/begin MEASUREMENT B_tslpdiag "Bedingung Motor- und Ansauglufttemp. im vorgegeb. Temp.-bereich f¸r Diag.SLS" UBYTE B_TRUE 1 100 0 1 BIT_MASK 0x2 FORMAT "%13.11" ECU_ADDRESS 0x800A2F /end MEASUREMENT
/begin MEASUREMENT B_tslskh "Bedingung Motor- und Ansauglufttemp. im vorgegeb. Temp.-bereich f¸r Kat.-heizen" UBYTE B_TRUE 1 100 0 1 BIT_MASK 0x4 FORMAT "%13.11" ECU_ADDRESS 0x800A2F /end MEASUREMENT
/begin MEASUREMENT B_twilabts "Bedingung Ladertemperatur f¸r Bauteileschutz ¸berschritten" UBYTE B_TRUE 1 100 0 1 BIT_MASK 0x20 FORMAT "%13.11" ECU_ADDRESS 0x801168 /end MEASUREMENT
/begin MEASUREMENT B_twistbts "Bedingung Stegtemperatur f¸r Bauteileschutz ¸berschritten" UBYTE B_TRUE 1 100 0 1 BIT_MASK 0x4 FORMAT "%13.11" ECU_ADDRESS 0x801168 /end MEASUREMENT
/begin MEASUREMENT B_ubdve "Bedingung: Batteriespannung f¸r DV-E-Ansteuerung i.O." UBYTE B_TRUE 1 100 0 1 BIT_MASK 0x1 FORMAT "%13.11" ECU_ADDRESS 0x7FA687 /end MEASUREMENT
/begin MEASUREMENT B_ubpvg "Bedingung Batteriespannung ausreichend f¸r 5V-Potiversorgung" UBYTE B_TRUE 1 100 0 1 BIT_MASK 0x1 FORMAT "%13.11" ECU_ADDRESS 0x7FA688 /end MEASUREMENT
/begin MEASUREMENT B_ub_ok "Batteriespannung o.k." UBYTE B_TRUE 1 100 0 1 BIT_MASK 0x1 FORMAT "%13.11" ECU_ADDRESS 0x7FA689 /end MEASUREMENT
/begin MEASUREMENT B_vllr "Bedingung Fahrzeug rollt mit eingelegtem Gang" UBYTE B_TRUE 1 100 0 1 BIT_MASK 0x1 FORMAT "%13.11" ECU_ADDRESS 0x7FA9B6 /end MEASUREMENT
/begin MEASUREMENT B_vstat "Fzg.-Geschwindigkeit Zustand" UBYTE B_TRUE 1 100 0 1 BIT_MASK 0x4 FORMAT "%13.11" ECU_ADDRESS 0x801263 /end MEASUREMENT
/begin MEASUREMENT B_wdksauf "Bedingung: DLR, Sollsprung in Richtung AUF" UBYTE B_TRUE 1 100 0 1 BIT_MASK 0x1 FORMAT "%13.11" ECU_ADDRESS 0x7FA68A /end MEASUREMENT
/begin MEASUREMENT B_wdksive "Bedingung: Fehler im Vergleich DK-Winkel-Sollwert/-Istwert" UBYTE B_TRUE 1 100 0 1 BIT_MASK 0x1 FORMAT "%13.11" ECU_ADDRESS 0x7FA68B /end MEASUREMENT
/begin MEASUREMENT B_zeffasla "Bedingung keine Ber¸cksichtigung von Z_hsvsa und E_hsvsa  bei einer FA" UBYTE B_TRUE 1 100 0 1 BIT_MASK 0x8 FORMAT "%13.11" ECU_ADDRESS 0x800A2E /end MEASUREMENT
/begin MEASUREMENT B_zefhsvsa "Bedingung keine Ber¸cksichtigung von Z_hsvsa und E_hsvsa  in  der %DSLS" UBYTE B_TRUE 1 100 0 1 BIT_MASK 0x2 FORMAT "%13.11" ECU_ADDRESS 0x800A2E /end MEASUREMENT
/begin MEASUREMENT B_zeflsv "Bedingung keine Ber¸cksichtigung von Z_lsv und E_lsv  in  der %DSLS" UBYTE B_TRUE 1 100 0 1 BIT_MASK 0x4 FORMAT "%13.11" ECU_ADDRESS 0x800A2E /end MEASUREMENT
/begin MEASUREMENT B_zfganzm "Bed. Auswertung des ZF ohne Ber¸ck. der Anzahl d. SLS-Messungen im Statistikteil" UBYTE B_TRUE 1 100 0 1 BIT_MASK 0x80 FORMAT "%13.11" ECU_ADDRESS 0x800A2D /end MEASUREMENT
/begin MEASUREMENT B_zwafh "Z¸ndwinkelfreigabe zur Anfahrhilfe" UBYTE B_TRUE 1 100 0 1 BIT_MASK 0x1 FORMAT "%13.11" ECU_ADDRESS 0x7FA9C0 /end MEASUREMENT
/begin MEASUREMENT caseVar "" UBYTE dez 1 100 0 255 FORMAT "%5.1" ECU_ADDRESS 0x801183 /end MEASUREMENT
/begin MEASUREMENT caseVar2 "" UBYTE dez 1 100 0 255 FORMAT "%5.1" ECU_ADDRESS 0x801184 /end MEASUREMENT
/begin MEASUREMENT chipErrCtr1 "" UBYTE dez 1 100 0 255 FORMAT "%5.1" ECU_ADDRESS 0x801185 /end MEASUREMENT
/begin MEASUREMENT chipErrCtr2 "" UBYTE dez 1 100 0 255 FORMAT "%5.1" ECU_ADDRESS 0x801186 /end MEASUREMENT
/begin MEASUREMENT clistmr_w "tats‰chlicher W‰rmekapazit‰tsstrom hinter AGR-Entnahmestelle in %KOMRH" UWORD qci_q0p096 1 100 0 6291.36 FORMAT "%8.3" ECU_ADDRESS 0x8009EE /end MEASUREMENT
/begin MEASUREMENT clmnomr_w "minimaler W‰rmekapazit‰tsstrom ohne Momentenreserve" UWORD qci_q0p096 1 100 0 6291.36 FORMAT "%8.3" ECU_ADDRESS 0x8009F0 /end MEASUREMENT
/begin MEASUREMENT clmxbkv_w "maximaler zul‰ssiger W‰rmekapazit‰tsstrom durch BKV" UWORD qci_q0p096 1 100 0 6291.36 FORMAT "%8.3" ECU_ADDRESS 0x8009F2 /end MEASUREMENT
/begin MEASUREMENT clmxmrbg_w "maximaler W‰rmekapazit‰tsstrom hinter AGR-Entnahmestelle in %KOMRH, begrenzt" UWORD qci_q0p096 1 100 0 6291.36 FORMAT "%8.3" ECU_ADDRESS 0x8009F4 /end MEASUREMENT
/begin MEASUREMENT clmxmr_w "maximaler W‰rmekapazit‰tsstrom bei max. Momentenreserve" UWORD qci_q0p096 1 100 0 6291.36 FORMAT "%8.3" ECU_ADDRESS 0x8009F6 /end MEASUREMENT
/begin MEASUREMENT clmxtabg_w "maximaler W‰rmekapazit‰tsstrom bei max. zul‰ssiger Abgastemperatur" UWORD qci_q0p096 1 100 0 6291.36 FORMAT "%8.3" ECU_ADDRESS 0x8009F8 /end MEASUREMENT
/begin MEASUREMENT data2_init2 "" UBYTE dez 1 100 0 255 FORMAT "%5.1" ECU_ADDRESS 0x801187 /end MEASUREMENT
/begin MEASUREMENT data2_s "" UBYTE dez 1 100 0 255 FORMAT "%5.1" ECU_ADDRESS 0x801188 /end MEASUREMENT
/begin MEASUREMENT data_init2 "" UBYTE dez 1 100 0 255 FORMAT "%5.1" ECU_ADDRESS 0x801189 /end MEASUREMENT
/begin MEASUREMENT data_s "" UBYTE dez 1 100 0 255 FORMAT "%5.1" ECU_ADDRESS 0x80118A /end MEASUREMENT
/begin MEASUREMENT dclmrws_w "Kapazit‰tsstromerhˆhung durch Abgasw‰rmestromforderung" UWORD qci_q0p096 1 100 0 6291.36 FORMAT "%8.3" ECU_ADDRESS 0x8009FA /end MEASUREMENT
/begin MEASUREMENT detazwbs "Delta ZW-Wirkungsgrad f¸r Bauteileschutz" UBYTE rel_ub_b127p5 1 100 0 127.5 FORMAT "%5.1" ECU_ADDRESS 0x8007E2 /end MEASUREMENT
/begin MEASUREMENT dhrlsue1_err "" UWORD dez 1 100 0 65535 FORMAT "%8.2" ECU_ADDRESS 0x8009CE /end MEASUREMENT
/begin MEASUREMENT dhrlsue2_err "" UWORD dez 1 100 0 65535 FORMAT "%8.2" ECU_ADDRESS 0x8009D0 /end MEASUREMENT
/begin MEASUREMENT dklagerc "Fehlerz‰hler DK-Lage¸berwachung" UBYTE t20msxs_ub_b5p1 1 100 0 5.1 FORMAT "%5.3" ECU_ADDRESS 0x8010E7 /end MEASUREMENT
/begin MEASUREMENT dlambts_w "Delta Lambda f¸r Bauteileschutz" SWORD fak_sw_b8 1 100 -8 7.99976 FORMAT "%8.6" ECU_ADDRESS 0x8007E6 /end MEASUREMENT
/begin MEASUREMENT dlbksi_w "Differenzbetrag zwischen Soll- und Istwert der LBK" UWORD rel_uw_b100 1 100 0 99.9985 FORMAT "%8.5" ECU_ADDRESS 0x801430 /end MEASUREMENT
/begin MEASUREMENT dlrd "DLR, D-Parameter" UBYTE relDK_q4 1 100 0 1020 FORMAT "%5.0" ECU_ADDRESS 0x7FAA0D /end MEASUREMENT
/begin MEASUREMENT dlrhaftak "Zeitz‰hler Haftreibungsroutine" SWORD relDK_q0p1957 1 100 -6412.52 6412.33 FORMAT "%8.3" ECU_ADDRESS 0x8005A6 /end MEASUREMENT
/begin MEASUREMENT dlri "DLR, I-Parameter" UBYTE relDK_q0p0625 1 100 0 15.9375 FORMAT "%5.2" ECU_ADDRESS 0x7FAA0E /end MEASUREMENT
/begin MEASUREMENT dlriamax "DLR, maximal mˆglicher I-Anteil" UWORD relDK_q0p1957 1 100 0 12824.9 FORMAT "%8.2" ECU_ADDRESS 0x7FAA3C /end MEASUREMENT
/begin MEASUREMENT dlriant_w "DLR, I-Anteil, highword von dlriant_l" SWORD rel_sw_q0p1953 1 100 -6400 6399.8 FORMAT "%8.3" ECU_ADDRESS 0x8014D4 /end MEASUREMENT
/begin MEASUREMENT dlrihaftc "DLR, Z‰hler f¸r DV-E in Haftreibung" UBYTE t50msxs_q0p05 1 100 0 12.75 FORMAT "%5.2" ECU_ADDRESS 0x8005A4 /end MEASUREMENT
/begin MEASUREMENT dlriklst_w "Vorladewert I-Kleinanteil" SWORD relDK_q0p1957 1 100 -6412.52 6412.33 FORMAT "%8.3" ECU_ADDRESS 0x8014D6 /end MEASUREMENT
/begin MEASUREMENT dlrikl_w "DLR, I-Kleinanteil" SWORD relDK_q0p1957 1 100 -6412.52 6412.33 FORMAT "%8.3" ECU_ADDRESS 0x7FAA3E /end MEASUREMENT
/begin MEASUREMENT dlrini_w "I-Anteil bei Initialisierung der NLP-Function" UWORD relDK_q0p1957 1 100 0 12824.9 FORMAT "%8.2" ECU_ADDRESS 0x7FAA40 /end MEASUREMENT
/begin MEASUREMENT dlrkomp "DLR, Faktor Kreisverst‰rkung" UBYTE fak_ub_b2 1 100 0 1.99219 FORMAT "%5.3" ECU_ADDRESS 0x7FAA0F /end MEASUREMENT
/begin MEASUREMENT dlrndif_w "Istwert aktuell - Istwert letzter f¸r D-Anteil des DLR" SWORD relDK_q0p02441 1 100 -800 799.976 FORMAT "%8.4" ECU_ADDRESS 0x7FAA42 /end MEASUREMENT
/begin MEASUREMENT dlrp "DLR, P-Parameter" UBYTE relDK_q1 1 100 0 255 FORMAT "%5.1" ECU_ADDRESS 0x7FAA10 /end MEASUREMENT
/begin MEASUREMENT dlrpidc "Fehlerz‰hler DLR-Stellbereichs¸berwachung" UWORD t10msxs_uw_b655p35 1 100 0 655.35 FORMAT "%8.4" ECU_ADDRESS 0x8014D8 /end MEASUREMENT
/begin MEASUREMENT dlrspid_w "DLR f¸r DV-E: Summe der PID-Anteile" UWORD rel_uw_b100 1 100 0 99.9985 FORMAT "%8.5" ECU_ADDRESS 0x7FAA44 /end MEASUREMENT
/begin MEASUREMENT dlsu1_ia_err "" UWORD dez 1 100 0 65535 FORMAT "%8.2" ECU_ADDRESS 0x8009BE /end MEASUREMENT
/begin MEASUREMENT dlsu1_un_err "" UWORD dez 1 100 0 65535 FORMAT "%8.2" ECU_ADDRESS 0x8009C0 /end MEASUREMENT
/begin MEASUREMENT dlsu1_vm_err "" UWORD dez 1 100 0 65535 FORMAT "%8.2" ECU_ADDRESS 0x8009C2 /end MEASUREMENT
/begin MEASUREMENT dlsu2_ia_err "" UWORD dez 1 100 0 65535 FORMAT "%8.2" ECU_ADDRESS 0x8009C4 /end MEASUREMENT
/begin MEASUREMENT dlsu2_un_err "" UWORD dez 1 100 0 65535 FORMAT "%8.2" ECU_ADDRESS 0x8009C6 /end MEASUREMENT
/begin MEASUREMENT dlsu2_vm_err "" UWORD dez 1 100 0 65535 FORMAT "%8.2" ECU_ADDRESS 0x8009C8 /end MEASUREMENT
/begin MEASUREMENT dmrdsls_w "Momentenreserve f¸r Diagnose Sekund‰rluft" UWORD rel_uw_b100 1 100 0 99.9985 FORMAT "%8.5" ECU_ADDRESS 0x800A26 /end MEASUREMENT
/begin MEASUREMENT dmresll_w "erhˆrte Momentenreserve im LL nach Drehzahleinbruch" UWORD rel_uw_b100 1 100 0 99.9985 FORMAT "%8.5" ECU_ADDRESS 0x8018DE /end MEASUREMENT
/begin MEASUREMENT dmrkh "Momenten-Reserve f¸r Katheizen" UBYTE rel_q0p39 1 100 0 99.6094 FORMAT "%5.2" ECU_ADDRESS 0x800A1C /end MEASUREMENT
/begin MEASUREMENT dmrkhf_w "" UWORD rel_uw_b100 1 100 0 99.9985 FORMAT "%8.5" ECU_ADDRESS 0x8009FC /end MEASUREMENT
/begin MEASUREMENT dmrkh_w "Momentenreserve f¸r Katheizen" UWORD rel_uw_b100 1 100 0 99.9985 FORMAT "%8.5" ECU_ADDRESS 0x8009FE /end MEASUREMENT
/begin MEASUREMENT dmrllr_w "Momenten-Reserve f¸r Leerlaufregelung" UWORD rel_uw_b100 1 100 0 99.9985 FORMAT "%8.5" ECU_ADDRESS 0x8018E0 /end MEASUREMENT
/begin MEASUREMENT dmrnwa_w "Momentenreserve zum Umschalten der Auslaﬂnockenwelle" UWORD rel_uw_b100 1 100 0 99.9985 FORMAT "%8.5" ECU_ADDRESS 0x8018E2 /end MEASUREMENT
/begin MEASUREMENT dmrnwe_w "Momentenreserve zum Umschalten der Einlaﬂnockenwelle" UWORD rel_uw_b100 1 100 0 99.9985 FORMAT "%8.5" ECU_ADDRESS 0x8018E4 /end MEASUREMENT
/begin MEASUREMENT dmvllrsu_w "Momentenreserve im Nachstart" UWORD rel_uw_b100 1 100 0 99.9985 FORMAT "%8.5" ECU_ADDRESS 0x8018E6 /end MEASUREMENT
/begin MEASUREMENT dns "LLR: Drehzahlabweichung zur station‰ren Solldrehzahl" SBYTE nmotd_sb_q10 1 100 -1280 1270 FORMAT "%5.0" ECU_ADDRESS 0x801261 /end MEASUREMENT
/begin MEASUREMENT dpwrsvc "Zeitz‰hler DV-E-Powersave" UWORD t10msxs_uw_b655p35 1 100 0 655.35 FORMAT "%8.4" ECU_ADDRESS 0x8014DA /end MEASUREMENT
/begin MEASUREMENT dveesc "Entprellz‰hler f¸r DV-E-Endstufe" UBYTE t10msxs_ub_b2p55 1 100 0 2.55 FORMAT "%5.3" ECU_ADDRESS 0x8010E8 /end MEASUREMENT
/begin MEASUREMENT dwdkdlr_w "Differenz-DK-Winkel Sollwert - Istwert (wdkdlr_w - wdkba_w)" SWORD relDK_q0p02441 1 100 -800 799.976 FORMAT "%8.4" ECU_ADDRESS 0x7FAA46 /end MEASUREMENT
/begin MEASUREMENT dwkr "zylinderindividuelle Z¸ndwinkelsp‰tverstellung KR" SBYTE zw_sb_q0p75 1 100 -96 95.25 FORMAT "%5.2" ECU_ADDRESS 0x800FDC /end MEASUREMENT
/begin MEASUREMENT dwkrmsw "aktueller Wert f¸r Mittelwertbegrenzung der Sp‰tverstellung" SBYTE zw_sb_q0p75 1 100 -96 95.25 FORMAT "%5.2" ECU_ADDRESS 0x800FDD /end MEASUREMENT
/begin MEASUREMENT dwkrz "zyl.ind. ZW-Sp‰tverstellung inkl. Dyn.vorhalt" SBYTE zw_sb_q0p75 1 100 -96 95.25 FORMAT "%5.2" ARRAY_SIZE 8 ECU_ADDRESS 0x800FE0 /end MEASUREMENT
/begin MEASUREMENT dzwg "Delta Z¸ndwinkel Grund-ZW zu Optimal-ZW" SBYTE zw_sb_q0p75 1 100 -96 95.25 FORMAT "%5.2" ECU_ADDRESS 0x8007E3 /end MEASUREMENT
/begin MEASUREMENT dzwkh "Delta Z¸ndwinkel w‰hrend KH" UBYTE zw_ub_q0p75 1 100 0 191.25 FORMAT "%5.1" ECU_ADDRESS 0x800A1D /end MEASUREMENT
/begin MEASUREMENT dzwlamfaw "Delta Z¸ndwinkel bei KR-Eingriff oder Warmlauf f¸r Anfettung ¸ber Lambda" UBYTE zw_ub_qn0p75 1 100 -191.25 0 FORMAT "%5.1" ECU_ADDRESS 0x800D78 /end MEASUREMENT
/begin MEASUREMENT Err_get_1 "" UWORD dez 1 100 0 65535 FORMAT "%8.2" ECU_ADDRESS 0x8016E6 /end MEASUREMENT
/begin MEASUREMENT Err_get_2 "" UWORD dez 1 100 0 65535 FORMAT "%8.2" ECU_ADDRESS 0x8016E8 /end MEASUREMENT
/begin MEASUREMENT Err_set_1 "" UWORD dez 1 100 0 65535 FORMAT "%8.2" ECU_ADDRESS 0x8016EA /end MEASUREMENT
/begin MEASUREMENT Err_set_2 "" UWORD dez 1 100 0 65535 FORMAT "%8.2" ECU_ADDRESS 0x8016EC /end MEASUREMENT
/begin MEASUREMENT esst_sdz06gkub "" ULONG dez 1 100 0 4.29497e+009 FORMAT "%13.2" ECU_ADDRESS 0x8020B8 /end MEASUREMENT
/begin MEASUREMENT esst_snm06gkub "" ULONG dez 1 100 0 4.29497e+009 FORMAT "%13.2" ECU_ADDRESS 0x8020BC /end MEASUREMENT
/begin MEASUREMENT esst_snm16gkub "" ULONG dez 1 100 0 4.29497e+009 FORMAT "%13.2" ECU_ADDRESS 0x801D60 /end MEASUREMENT
/begin MEASUREMENT esst_sns06llsb "" ULONG dez 1 100 0 4.29497e+009 FORMAT "%13.2" ECU_ADDRESS 0x8020D8 /end MEASUREMENT
/begin MEASUREMENT esst_srl06gkub "" ULONG dez 1 100 0 4.29497e+009 FORMAT "%13.2" ECU_ADDRESS 0x8020C0 /end MEASUREMENT
/begin MEASUREMENT esst_srl12gkuw "" ULONG dez 1 100 0 4.29497e+009 FORMAT "%13.2" ECU_ADDRESS 0x801D64 /end MEASUREMENT
/begin MEASUREMENT esst_stm08gkub "" ULONG dez 1 100 0 4.29497e+009 FORMAT "%13.2" ECU_ADDRESS 0x8020C4 /end MEASUREMENT
/begin MEASUREMENT etazwg "Wirkungsgrad beim Grundz¸ndwinkel" UBYTE rel_ub_b127p5 1 100 0 127.5 FORMAT "%5.1" ECU_ADDRESS 0x8007E4 /end MEASUREMENT
/begin MEASUREMENT etazwim "Gemittelter Wirkungsgrad beim Ist-Z¸ndwinkel" UBYTE rel_ub_b127p5 1 100 0 127.5 FORMAT "%5.1" ECU_ADDRESS 0x8007E5 /end MEASUREMENT
/begin MEASUREMENT etazwkh "Minimum-Z¸ndwinkelwirkungsgrad f¸r Katheizen" UBYTE rel_ub_b127p5 1 100 0.5 127.5 FORMAT "%5.1" ECU_ADDRESS 0x800A1E /end MEASUREMENT
/begin MEASUREMENT E_ks1h_old "" UWORD B_TRUE 1 100 0 1 BIT_MASK 0x1 FORMAT "%13.11" ECU_ADDRESS 0x7FA85F /end MEASUREMENT
/begin MEASUREMENT E_ks2h_old "" UWORD B_TRUE 1 100 0 1 BIT_MASK 0x1 FORMAT "%13.11" ECU_ADDRESS 0x7FA860 /end MEASUREMENT
/begin MEASUREMENT E_ks3h_old "" UWORD B_TRUE 1 100 0 1 BIT_MASK 0x1 FORMAT "%13.11" ECU_ADDRESS 0x7FA861 /end MEASUREMENT
/begin MEASUREMENT E_ks4h_old "" UWORD B_TRUE 1 100 0 1 BIT_MASK 0x1 FORMAT "%13.11" ECU_ADDRESS 0x7FA862 /end MEASUREMENT
/begin MEASUREMENT faucsmr_w "Faktor zur Umrechnung von relativer Luftf¸llung in Kapazit‰tsmassenstrom" UWORD fak1_q2p5Em4 1 100 0 16.3837 FORMAT "%8.5" ECU_ADDRESS 0x800A00 /end MEASUREMENT
/begin MEASUREMENT flaskh "Faktor ‹bergang zu Lambda-Abgas bei Sekund‰rluft" UBYTE fak_ub_b1 1 100 0 0.996094 ECU_ADDRESS 0x8009EA /end MEASUREMENT
/begin MEASUREMENT flb "Faktor Ladungsbewegung (8 bit)" UBYTE fak_ub_b1 1 100 0 0.996094 ECU_ADDRESS 0x8010C4 /end MEASUREMENT
/begin MEASUREMENT flbkhs_w "Faktor Ladungsbewegung bei Katheizen" UWORD fak_uw_b1 1 100 0 0.999985 FORMAT "%9.7" ECU_ADDRESS 0x800590 /end MEASUREMENT
/begin MEASUREMENT flbskf_w "Faktor Ladungsbewegung aus Kennfeld f¸r aktuelle Betriebsart" UWORD fak_uw_b1 1 100 0 0.999985 FORMAT "%9.7" ECU_ADDRESS 0x800592 /end MEASUREMENT
/begin MEASUREMENT flbs_w "Faktor Sollladungsbewegung" UWORD fak_uw_b1 1 100 0 0.999985 FORMAT "%9.7" ECU_ADDRESS 0x80142C /end MEASUREMENT
/begin MEASUREMENT flbts_w "Faktor Lambda Bauteileschutz" UWORD fak_uw_b2 1 100 0 1.99997 FORMAT "%8.6" ECU_ADDRESS 0x7F935A /end MEASUREMENT
/begin MEASUREMENT flb_w "Faktor Ladungsbewegung" UWORD fak_uw_b1 1 100 0 0.999985 FORMAT "%9.7" ECU_ADDRESS 0x801432 /end MEASUREMENT
/begin MEASUREMENT flmsslkh "Faktor Lambda-Motor-Soll-Sekund‰rluftanteil, resultierend" UBYTE fak_ub_b1 1 100 0 0.996094 ECU_ADDRESS 0x8009EB /end MEASUREMENT
/begin MEASUREMENT frhokor_w "Faktor zur Adressierung der Dichtekorrektur bei der Sekund‰rluft" UWORD fak_uw_b4 1 100 0 3.99994 FORMAT "%8.6" ECU_ADDRESS 0x800A02 /end MEASUREMENT
/begin MEASUREMENT frstinjcyl "Zylindernummer mit erster Einspritzung" UBYTE dez 1 100 0 255 FORMAT "%5.1" ECU_ADDRESS 0x800F42 /end MEASUREMENT
/begin MEASUREMENT gwdkdlr_w "ƒnderung des Drosselklappen-Sollwinkels, Betrag f¸r Kennlinieneingang" SWORD relDK_q0p00152 1 100 -50 49.9985 FORMAT "%8.5" ECU_ADDRESS 0x7FAA48 /end MEASUREMENT
/begin MEASUREMENT gwdk_kge "ƒnderung des Drosselklappen-Sollwinkels, Betrag f¸r Kennlinieneingang" UWORD relDK_q0p00152 1 100 0 99.9985 FORMAT "%8.5" ECU_ADDRESS 0x8014DC /end MEASUREMENT
/begin MEASUREMENT ignFadeStatBits "" UBYTE dez 1 100 0 255 FORMAT "%5.1" ECU_ADDRESS 0x800F44 /end MEASUREMENT
/begin MEASUREMENT ignfdostat "" UBYTE dez 1 100 0 255 FORMAT "%5.1" ECU_ADDRESS 0x800F45 /end MEASUREMENT
/begin MEASUREMENT ignFdReqStat "" UBYTE dez 1 100 0 255 FORMAT "%5.1" ECU_ADDRESS 0x800F46 /end MEASUREMENT
/begin MEASUREMENT ignStpStat "" UBYTE dez 1 100 0 255 FORMAT "%5.1" ECU_ADDRESS 0x800F47 /end MEASUREMENT
/begin MEASUREMENT ignsynstat "" UBYTE dez 1 100 0 255 FORMAT "%5.1" ECU_ADDRESS 0x7F866D /end MEASUREMENT
/begin MEASUREMENT ignzbgctr "" UBYTE dez 1 100 0 255 FORMAT "%5.1" ECU_ADDRESS 0x7F866F /end MEASUREMENT
/begin MEASUREMENT initErrCtr1 "" UBYTE dez 1 100 0 255 FORMAT "%5.1" ECU_ADDRESS 0x80118B /end MEASUREMENT
/begin MEASUREMENT initErrCtr2 "" UBYTE dez 1 100 0 255 FORMAT "%5.1" ECU_ADDRESS 0x80118C /end MEASUREMENT
/begin MEASUREMENT ke "Klopferkennungsschwelle aus Kennfeld" UBYTE fak_ub_b16 1 100 0 15.9375 FORMAT "%5.2" ARRAY_SIZE 8 ECU_ADDRESS 0x800FA8 /end MEASUREMENT
/begin MEASUREMENT kek "Klopferkennungsschwelle korrigiert" UBYTE fak_ub_b16 1 100 0 15.9375 FORMAT "%5.2" ARRAY_SIZE 8 ECU_ADDRESS 0x800FB0 /end MEASUREMENT
/begin MEASUREMENT kek_tst "Klopferkennungsschwelle korrigiert rollierend mit Zyl.z‰hler" UBYTE fak_ub_b16 1 100 0 15.9375 FORMAT "%5.2" ECU_ADDRESS 0x800FB8 /end MEASUREMENT
/begin MEASUREMENT komrkhAusBits "" UBYTE dez 1 100 0 255 FORMAT "%5.1" ECU_ADDRESS 0x800A1F /end MEASUREMENT
/begin MEASUREMENT komrkhLokBits "" UBYTE dez 1 100 0 255 FORMAT "%5.1" ECU_ADDRESS 0x800A20 /end MEASUREMENT
/begin MEASUREMENT koslkhAusBits1 "" UBYTE dez 1 100 0 255 FORMAT "%5.1" ECU_ADDRESS 0x800A2B /end MEASUREMENT
/begin MEASUREMENT koslkhAusBits2 "" UBYTE dez 1 100 0 255 FORMAT "%5.1" ECU_ADDRESS 0x800A2C /end MEASUREMENT
/begin MEASUREMENT koslkhAusBits3 "" UBYTE dez 1 100 0 255 FORMAT "%5.1" ECU_ADDRESS 0x800A2D /end MEASUREMENT
/begin MEASUREMENT koslkhAusBits4 "" UBYTE dez 1 100 0 255 FORMAT "%5.1" ECU_ADDRESS 0x800A2E /end MEASUREMENT
/begin MEASUREMENT koslkhLokBits "" UBYTE dez 1 100 0 255 FORMAT "%5.1" ECU_ADDRESS 0x800A2F /end MEASUREMENT
/begin MEASUREMENT krdwsw "aktueller KL-Wert der Sicherheitssp‰tverstellung" SBYTE zw_sb_q0p75 1 100 -96 95.25 FORMAT "%5.2" ECU_ADDRESS 0x800FE8 /end MEASUREMENT
/begin MEASUREMENT krfkw "Aktueller Wert aus KRFKN" SBYTE zw_sb_q0p75 1 100 -96 95.25 FORMAT "%5.2" ECU_ADDRESS 0x800FE9 /end MEASUREMENT
/begin MEASUREMENT krftpakt "aktuelles Tiefpaﬂverhalten" UBYTE dez 1 100 0 255 FORMAT "%5.1" ECU_ADDRESS 0x800FB9 /end MEASUREMENT
/begin MEASUREMENT krlzn "Bitmuster: zylinderindividuelle Drehzahlschwelle f¸r LZF ¸berschritten" UBYTE dez 1 100 0 255 FORMAT "%5.1" ECU_ADDRESS 0x800C8E /end MEASUREMENT
/begin MEASUREMENT krmxw "aktueller Wert f¸r Sp‰tbegrenzung der Sp‰tverstellung" SBYTE zw_sb_q0p75 1 100 -96 95.25 FORMAT "%5.2" ECU_ADDRESS 0x800FEA /end MEASUREMENT
/begin MEASUREMENT krvfsw "Initwert f¸r schnelle Fr¸hverstellung" UBYTE dez 1 100 0 255 FORMAT "%5.1" ECU_ADDRESS 0x800FEB /end MEASUREMENT
/begin MEASUREMENT krvfw "Initwert f¸r normale Fr¸hverstellung" UBYTE dez 1 100 0 255 FORMAT "%5.1" ECU_ADDRESS 0x800FEC /end MEASUREMENT
/begin MEASUREMENT kttahrlsu2_w "" UWORD dez 1 100 0 65535 FORMAT "%8.2" ECU_ADDRESS 0x801A9A /end MEASUREMENT
/begin MEASUREMENT kttahrlsu_w "" UWORD dez 1 100 0 65535 FORMAT "%8.2" ECU_ADDRESS 0x801A9C /end MEASUREMENT
/begin MEASUREMENT kttphrlsu_w "" UWORD vnstv_q0p01 1 100 0 655.35 FORMAT "%7.3" ECU_ADDRESS 0x801A9E /end MEASUREMENT
/begin MEASUREMENT kt_dhrlsue_bits "" UBYTE dez 1 100 0 255 FORMAT "%5.1" ECU_ADDRESS 0x8009CC /end MEASUREMENT
/begin MEASUREMENT kt_diclsu1_bits "" UBYTE dez 1 100 0 255 FORMAT "%5.1" ECU_ADDRESS 0x8009BC /end MEASUREMENT
/begin MEASUREMENT kt_diclsu2_bits "" UBYTE dez 1 100 0 255 FORMAT "%5.1" ECU_ADDRESS 0x8009BD /end MEASUREMENT
/begin MEASUREMENT kt_zuen_fdOutPattern_u8 "" UBYTE dez 1 100 0 255 FORMAT "%5.1" ECU_ADDRESS 0x800F48 /end MEASUREMENT
/begin MEASUREMENT kt_zuen_fdPatArray_u8 "" UBYTE dez 1 100 0 255 FORMAT "%5.1" ARRAY_SIZE 8 ECU_ADDRESS 0x800F4C /end MEASUREMENT
/begin MEASUREMENT kt_zuen_fdReq_u16 "" UWORD dez 1 100 0 65535 FORMAT "%8.2" ECU_ADDRESS 0x801AD6 /end MEASUREMENT
/begin MEASUREMENT kt_zuen_lastzkvek "" UBYTE dez 1 100 0 255 FORMAT "%5.1" ECU_ADDRESS 0x8011E6 /end MEASUREMENT
/begin MEASUREMENT kt_zuen_lastzzyl "" UBYTE dez 1 100 0 255 FORMAT "%5.1" ECU_ADDRESS 0x8011E7 /end MEASUREMENT
/begin MEASUREMENT kt_zuen_zkvek "" UBYTE dez 1 100 0 255 FORMAT "%5.1" ECU_ADDRESS 0x8011E8 /end MEASUREMENT
/begin MEASUREMENT lakhAusBits "" UBYTE dez 1 100 0 255 FORMAT "%5.1" ECU_ADDRESS 0x8009EC /end MEASUREMENT
/begin MEASUREMENT lambas "Basis-Lambda" UBYTE fak_ub_b2 1 100 0 1.99219 FORMAT "%5.3" ECU_ADDRESS 0x801169 /end MEASUREMENT
/begin MEASUREMENT lambts2_w "Lambda f¸r Bauteileschutz Bank2" UWORD fak_uw_b16 1 100 0 15.9998 FORMAT "%8.5" ECU_ADDRESS 0x8007E8 /end MEASUREMENT
/begin MEASUREMENT LAMBTSlokbits "" UBYTE dez 1 100 0 255 FORMAT "%5.1" ECU_ADDRESS 0x801168 /end MEASUREMENT
/begin MEASUREMENT lambts_w "Lambda f¸r Bauteileschutz" UWORD fak_uw_b16 1 100 0 15.9998 FORMAT "%8.5" ECU_ADDRESS 0x8007EA /end MEASUREMENT
/begin MEASUREMENT lamdiag2_w "Lambdasoll von Dignosefunktionen Bank2" UWORD fak_uw_b16 1 100 0 15.9998 FORMAT "%8.5" ECU_ADDRESS 0x8015F4 /end MEASUREMENT
/begin MEASUREMENT lamdiag_w "Lambdasoll von Dignosefunktionen" UWORD fak_uw_b16 1 100 0 15.9998 FORMAT "%8.5" ECU_ADDRESS 0x8015F6 /end MEASUREMENT
/begin MEASUREMENT lamfawkr_w "Lambdasoll Fahrerwunsch bei Z¸ndwinkelsp‰tverstellung KR, WL" UWORD fak_uw_b16 1 100 0 15.9998 FORMAT "%8.5" ECU_ADDRESS 0x800D7A /end MEASUREMENT
/begin MEASUREMENT lamfaws_w "Lambdasoll Fahrerwunsch station‰rer Anteil" UWORD fak_uw_b16 1 100 0 15.9998 FORMAT "%8.5" ECU_ADDRESS 0x800D7C /end MEASUREMENT
/begin MEASUREMENT lamfaw_w "Lambdasoll Fahrerwunsch Anteil aus Kennfeld LAMFA" UWORD fak_uw_b16 1 100 0 15.9998 FORMAT "%8.5" ECU_ADDRESS 0x800D7E /end MEASUREMENT
/begin MEASUREMENT lamfa_w "Lambdasoll Fahrerwunsch (word)" UWORD fak_uw_b16 1 100 0 15.9998 FORMAT "%8.5" ECU_ADDRESS 0x800D80 /end MEASUREMENT
/begin MEASUREMENT lamfwl_w "Offset Motor-Lambda-Soll im Warmlauf" UWORD fak_uw_b16 1 100 0 15.9998 FORMAT "%8.5" ECU_ADDRESS 0x800D82 /end MEASUREMENT
/begin MEASUREMENT lamkh2_w "Lambda-Motor-Soll bei Katheizen, Bank 2 (word)" UWORD fak_q0p000244 1 100 0 15.9998 FORMAT "%8.5" ECU_ADDRESS 0x801AA0 /end MEASUREMENT
/begin MEASUREMENT lamkhe2_w "Lambda-Motor-Soll bei Katheizen, effektiv, Bank 2" UWORD fak_uw_b16 1 100 0 15.9998 FORMAT "%8.5" ECU_ADDRESS 0x8015F8 /end MEASUREMENT
/begin MEASUREMENT lamkhe_w "Lambda-Motor-Soll bei Katheizen, effektiv" UWORD fak_uw_b16 1 100 0 15.9998 FORMAT "%8.5" ECU_ADDRESS 0x8015FA /end MEASUREMENT
/begin MEASUREMENT lamkhg2_w "Lambda-Motor-Soll bei Katheizen (word) gewichtet mit flakh, Bank 2" UWORD fak_q0p000244 1 100 0 15.9998 FORMAT "%8.5" ECU_ADDRESS 0x8009D4 /end MEASUREMENT
/begin MEASUREMENT lamkhg_w "Lambda-Motor-Soll bei Katheizen (word) gewichtet mit flakh" UWORD fak_q0p000244 1 100 0 15.9998 FORMAT "%8.5" ECU_ADDRESS 0x8009D6 /end MEASUREMENT
/begin MEASUREMENT lamkhr2_w "Lambda-Motor-Soll resultierend bei Katheizen, Bank 2 (word)" UWORD fak_q0p000244 1 100 0 15.9998 FORMAT "%8.5" ECU_ADDRESS 0x8009D8 /end MEASUREMENT
/begin MEASUREMENT lamkhr_w "Lambda-Motor-Soll resultierend bei Katheizen (word)" UWORD fak_q0p000244 1 100 0 15.9998 FORMAT "%8.5" ECU_ADDRESS 0x8009DA /end MEASUREMENT
/begin MEASUREMENT lamkh_w "Lambda-Motor-Soll bei Katheizen (word)" UWORD fak_q0p000244 1 100 0 15.9998 FORMAT "%8.5" ECU_ADDRESS 0x801AA2 /end MEASUREMENT
/begin MEASUREMENT lamlgfmn "Lambda Motorlaufgrenze fett" UBYTE fak_ub_b2 1 100 0 1.99219 FORMAT "%5.3" ECU_ADDRESS 0x8007F2 /end MEASUREMENT
/begin MEASUREMENT lamlgm "Laufgrenze ""Lambda mager""" UBYTE fak_ub_b2 1 100 0 1.99219 FORMAT "%5.3" ECU_ADDRESS 0x8007F3 /end MEASUREMENT
/begin MEASUREMENT lamnswl_w "Lambda-Motor-Soll f¸r Nachstart und Warmlauf" UWORD fak_uw_b16 1 100 0 15.9998 FORMAT "%8.5" ECU_ADDRESS 0x801618 /end MEASUREMENT
/begin MEASUREMENT lamns_w "Lambda-Motor-Soll f¸r Nachstart" UWORD fak_uw_b16 1 100 0 15.9998 FORMAT "%8.5" ECU_ADDRESS 0x80161A /end MEASUREMENT
/begin MEASUREMENT lamrlmn_w "Lambdasollvorsteuerung zur Verbesserung der Brennbarkeit bei kleinem rl" UWORD fak_uw_b16 1 100 0 15.9998 FORMAT "%8.5" ECU_ADDRESS 0x800D84 /end MEASUREMENT
/begin MEASUREMENT lams2_w "Lambdasoll (word)" UWORD fak_uw_b16 1 100 0 15.9998 FORMAT "%8.5" ECU_ADDRESS 0x8015FC /end MEASUREMENT
/begin MEASUREMENT lamsbg2_w "Lambdasoll Begrenzung (word) Bank2" UWORD fak_uw_b16 1 100 0 15.9998 FORMAT "%8.5" ECU_ADDRESS 0x8015FE /end MEASUREMENT
/begin MEASUREMENT lamsbg_w "Lambdasoll Begrenzung (word)" UWORD fak_uw_b16 1 100 0 15.9998 FORMAT "%8.5" ECU_ADDRESS 0x801600 /end MEASUREMENT
/begin MEASUREMENT lamsons2_w "Lambda-Sollwert bezogen auf Einbauort Lambda-Sensor Bank2" UWORD fak_uw_b16 1 100 0 15.9998 FORMAT "%8.5" ECU_ADDRESS 0x801602 /end MEASUREMENT
/begin MEASUREMENT lamsons_w "Lambda-Sollwert bezogen auf Einbauort Lambda-Sensor" UWORD fak_uw_b16 1 100 0 15.9998 FORMAT "%8.5" ECU_ADDRESS 0x801604 /end MEASUREMENT
/begin MEASUREMENT lamsos2_w "Lambda-Sollwert bezogen auf Einbauort Lambda-Sensor Bank2" UWORD fak_uw_b16 1 100 0 15.9998 FORMAT "%8.5" ECU_ADDRESS 0x801606 /end MEASUREMENT
/begin MEASUREMENT lamsos_w "Lambda-Sollwert bezogen auf Einbauort Lambda-Sensor" UWORD fak_uw_b16 1 100 0 15.9998 FORMAT "%8.5" ECU_ADDRESS 0x801608 /end MEASUREMENT
/begin MEASUREMENT lamsubg2_w "Lambdasoll unbegrenzt (word)" UWORD fak_uw_b16 1 100 0 15.9998 FORMAT "%8.5" ECU_ADDRESS 0x80160A /end MEASUREMENT
/begin MEASUREMENT lamsubg_w "Lambdasoll unbegrenzt (word)" UWORD fak_uw_b16 1 100 0 15.9998 FORMAT "%8.5" ECU_ADDRESS 0x80160C /end MEASUREMENT
/begin MEASUREMENT lams_w "Lambdasoll (word)" UWORD fak_uw_b16 1 100 0 15.9998 FORMAT "%8.5" ECU_ADDRESS 0x80160E /end MEASUREMENT
/begin MEASUREMENT lamvoa2_w "Lambdavorsteuerung ohne additive Anteile" UWORD fak_uw_b16 1 100 0 15.9998 FORMAT "%8.5" ECU_ADDRESS 0x801610 /end MEASUREMENT
/begin MEASUREMENT lamvoa_w "Lambdavorsteuerung ohne additive Anteile" UWORD fak_uw_b16 1 100 0 15.9998 FORMAT "%8.5" ECU_ADDRESS 0x801612 /end MEASUREMENT
/begin MEASUREMENT lamwl_w "Lambda-Motor-Soll f¸r Warmlauf" UWORD fak_uw_b16 1 100 0 15.9998 FORMAT "%8.5" ECU_ADDRESS 0x80161C /end MEASUREMENT
/begin MEASUREMENT lanskh_w "Lambda-Motor-Soll im Nachstart bei Katheizen" UWORD fak_q0p000244 1 100 0 15.9998 FORMAT "%8.5" ECU_ADDRESS 0x801AA4 /end MEASUREMENT
/begin MEASUREMENT lasdslg2_w "Lambda-Abgas-Soll f¸r Sekund‰rluftdiagnose Bank 2 gewichtet mit flamsl2" UWORD fak_q0p000244 1 100 0 15.9998 FORMAT "%8.5" ECU_ADDRESS 0x8009DC /end MEASUREMENT
/begin MEASUREMENT lasdslg_w "Lambda-Abgas-Soll f¸r Sekund‰rluftdiagnose gewichtet mit flamsl" UWORD fak_q0p000244 1 100 0 15.9998 FORMAT "%8.5" ECU_ADDRESS 0x8009DE /end MEASUREMENT
/begin MEASUREMENT lasdsl_w "Lambda-Abgas-Soll f¸r Sekund‰rluftdiagnose" UWORD fak_q0p000244 1 100 0 15.9998 FORMAT "%8.5" ECU_ADDRESS 0x8009E0 /end MEASUREMENT
/begin MEASUREMENT laskh_w "Lambda-Abgas-Soll bei Katheizen (word)" UWORD fak_q0p000244 1 100 0 15.9998 FORMAT "%8.5" ECU_ADDRESS 0x8009E2 /end MEASUREMENT
/begin MEASUREMENT lbksol "Sollwert f¸r die Ladungsbewegungsklappenposition" UBYTE rel_ub_b100 1 100 0 99.6094 FORMAT "%5.2" ECU_ADDRESS 0x8010C2 /end MEASUREMENT
/begin MEASUREMENT lbksol_w "Sollwert f¸r die Ladungsbewegungsklappenposition" UWORD rel_uw_b100 1 100 0 99.9985 FORMAT "%8.5" ECU_ADDRESS 0x80142E /end MEASUREMENT
/begin MEASUREMENT lbts2_w "Lambda f¸r Bauteileschutz aus Station‰rkennfeld Bank2" UWORD fak_uw_b16 1 100 0 15.9998 FORMAT "%8.5" ECU_ADDRESS 0x8007EC /end MEASUREMENT
/begin MEASUREMENT lbts_w "Lambda f¸r Bauteileschutz aus Station‰rkennfeld" UWORD fak_uw_b16 1 100 0 15.9998 FORMAT "%8.5" ECU_ADDRESS 0x8007EE /end MEASUREMENT
/begin MEASUREMENT lmskh_w "Lambda-Motor-Soll bei katheizen (word)" UWORD fak_q0p000244 1 100 0 15.9998 FORMAT "%8.5" ECU_ADDRESS 0x8009E4 /end MEASUREMENT
/begin MEASUREMENT lmssl2_w "Lambda-Motor-Soll wegen Sekund‰rluft bei Kathezen, Bank 2" UWORD fak_q0p000244 1 100 0 15.9998 FORMAT "%8.5" ECU_ADDRESS 0x8009E6 /end MEASUREMENT
/begin MEASUREMENT lmssl_w "Lambda-Motor-Soll wegen Sekund‰rluft bei Katheizen (word)" UWORD fak_q0p000244 1 100 0 15.9998 FORMAT "%8.5" ECU_ADDRESS 0x8009E8 /end MEASUREMENT
/begin MEASUREMENT maskeks "" UBYTE dez 1 100 0 255 FORMAT "%5.1" ECU_ADDRESS 0x800C8F /end MEASUREMENT
/begin MEASUREMENT maskgz "Maske: gef¸hrte Zylinder" UBYTE dez 1 100 0 255 FORMAT "%5.1" ECU_ADDRESS 0x800FC8 /end MEASUREMENT
/begin MEASUREMENT masklz "" UBYTE dez 1 100 0 255 FORMAT "%5.1" ECU_ADDRESS 0x800FC9 /end MEASUREMENT
/begin MEASUREMENT mizskhmx_w "Indiziertes max. Sollmoment f¸r ZW-Eingriff bei Katheizen" UWORD rel_uw_b100 1 100 0 99.9985 FORMAT "%8.5" ECU_ADDRESS 0x800A04 /end MEASUREMENT
/begin MEASUREMENT nfskh "Leerlaufdrehzahl Fahrstufe bei Katheizen" UBYTE nmot_q10 1 100 0 2550 FORMAT "%5.0" ECU_ADDRESS 0x800A21 /end MEASUREMENT
/begin MEASUREMENT nllkh "Leerlaufdrehzahl bei Katheizen" UBYTE nmot_q10 1 100 0 2550 FORMAT "%5.0" ECU_ADDRESS 0x800A22 /end MEASUREMENT
/begin MEASUREMENT nmaxllkh "maximale Leerlaufdrehzahl zum Katalysatorheizen" UBYTE nmot_q10 1 100 0 2550 FORMAT "%5.0" ECU_ADDRESS 0x800A23 /end MEASUREMENT
/begin MEASUREMENT nokatfz_flg "" UBYTE dez 1 100 0 255 FORMAT "%5.1" ECU_ADDRESS 0x7FC83B /end MEASUREMENT
/begin MEASUREMENT nslfa "Solldrehzahl bei Kurztrip" UBYTE nmot_ub_q10 1 100 0 2550 FORMAT "%5.0" ECU_ADDRESS 0x801260 /end MEASUREMENT
/begin MEASUREMENT nsnf "LLR: Nachgef¸hrte Solldrehzahl" UBYTE nmot_q10 1 100 0 2550 FORMAT "%5.0" ECU_ADDRESS 0x801264 /end MEASUREMENT
/begin MEASUREMENT nsol "Leerlaufsolldrehzahl" UBYTE nmot_q10 1 100 0 2550 FORMAT "%5.0" ECU_ADDRESS 0x801265 /end MEASUREMENT
/begin MEASUREMENT nsoldza "Drehzahlanhebungs-Solldrehzahl" UBYTE nmot_q10 1 100 0 2550 FORMAT "%5.0" ECU_ADDRESS 0x801266 /end MEASUREMENT
/begin MEASUREMENT nsolu "Solldrehzahl ohne DZA" UBYTE nmot_q10 1 100 0 2550 FORMAT "%5.0" ECU_ADDRESS 0x801267 /end MEASUREMENT
/begin MEASUREMENT nsol_dzae "Solldrehzahl bei EHB-DZA" UBYTE nmot_q10 1 100 0 2550 FORMAT "%5.0" ECU_ADDRESS 0x801268 /end MEASUREMENT
/begin MEASUREMENT nsol_dzaku "Solldrehzahl bei Unterspannung-DZA oder Klima-DZA" UBYTE nmot_q10 1 100 0 2550 FORMAT "%5.0" ECU_ADDRESS 0x801269 /end MEASUREMENT
/begin MEASUREMENT nsol_tmot "motortemperaturabh‰ngige Solldrehzahl" UBYTE nmot_q10 1 100 0 2550 FORMAT "%5.0" ECU_ADDRESS 0x80126A /end MEASUREMENT
/begin MEASUREMENT nsol_varko "Solldrehzahl aus Variantenkodierung" UBYTE nmot_q10 1 100 0 2550 FORMAT "%5.0" ECU_ADDRESS 0x80126B /end MEASUREMENT
/begin MEASUREMENT nsol_vlfr "geschwindigkeitsabh‰ngige Solldrehzahl" UBYTE nmot_q10 1 100 0 2550 FORMAT "%5.0" ECU_ADDRESS 0x80126C /end MEASUREMENT
/begin MEASUREMENT nsol_w "Leerlaufsolldrehzahl" UWORD nmot_uw_q0p25 1 100 0 16383.8 FORMAT "%8.2" ECU_ADDRESS 0x8018BC /end MEASUREMENT
/begin MEASUREMENT nsst "Initialisierungswert der Solldrehzahl im Start" UBYTE nmot_q10 1 100 0 2550 FORMAT "%5.0" ECU_ADDRESS 0x80126D /end MEASUREMENT
/begin MEASUREMENT nstat "Solldrehzahl station‰r" UBYTE nmot_q10 1 100 0 2550 FORMAT "%5.0" ECU_ADDRESS 0x80126E /end MEASUREMENT
/begin MEASUREMENT nstat2 "Stationn‰re Solldrehzahl nach Begrenzung" UBYTE nmot_q10 1 100 0 2550 FORMAT "%5.0" ECU_ADDRESS 0x80126F /end MEASUREMENT
/begin MEASUREMENT nstat3 "Stationn‰re Solldrehzahl vor Filterung" UBYTE nmot_q10 1 100 0 2550 FORMAT "%5.0" ECU_ADDRESS 0x801270 /end MEASUREMENT
/begin MEASUREMENT nstate "effektive station‰re Solldrehzahl" UBYTE nmot_q10 1 100 0 2550 FORMAT "%5.0" ECU_ADDRESS 0x801271 /end MEASUREMENT
/begin MEASUREMENT nstatfil "Solldrehzahl station‰r gefiltert" UBYTE nmot_q10 1 100 0 2550 FORMAT "%5.0" ECU_ADDRESS 0x801272 /end MEASUREMENT
/begin MEASUREMENT rkrmx1w_w "aktueller Wert der Kennlinie RKRMX1N, 16bit" UWORD spg_uw_q0p00488 1 100 0 319.995 FORMAT "%8.4" ECU_ADDRESS 0x801B7A /end MEASUREMENT
/begin MEASUREMENT rkrmx2w_w "aktueller Wert der Kennlinie RKRMX2N, 16bit" UWORD spg_uw_q0p00488 1 100 0 319.995 FORMAT "%8.4" ECU_ADDRESS 0x801B7C /end MEASUREMENT
/begin MEASUREMENT rkrmx_w "nach oben begrenzter Referenzpegel, 16bit" UWORD spg_uw_q0p000076 1 100 0 4.99992 FORMAT "%8.6" ECU_ADDRESS 0x801B7E /end MEASUREMENT
/begin MEASUREMENT rkrtp_w "Referenzpegel nach Tiefpaﬂ Klopfregelung, 16bit" UWORD spg_uw_q0p000076 1 100 0 4.99992 FORMAT "%8.6" ECU_ADDRESS 0x801B80 /end MEASUREMENT
/begin MEASUREMENT rkr_tst_w "Referenzpegel Klopfregelung rollierend mit Zyl.z‰hler, 16bit" UWORD spg_uw_q0p000076 1 100 0 4.99992 FORMAT "%8.6" ECU_ADDRESS 0x801B82 /end MEASUREMENT
/begin MEASUREMENT rkr_w "Referenzpegel Klopfregelung, 16bit" UWORD spg_uw_q0p000076 1 100 0 4.99992 FORMAT "%8.6" ARRAY_SIZE 8 ECU_ADDRESS 0x801B84 /end MEASUREMENT
/begin MEASUREMENT rlistmr_w "relative Luftf¸llung mit Momentenreserve zum Katalysatorheizen" UWORD rel_uw_q0p0234 1 100 0 1535.98 FORMAT "%8.3" ECU_ADDRESS 0x800A06 /end MEASUREMENT
/begin MEASUREMENT rlmnomr_w "minimal erreichbare F¸llung ohne Momentenreserve" UWORD rel_uw_q0p0234 1 100 0 1535.98 FORMAT "%8.3" ECU_ADDRESS 0x800A08 /end MEASUREMENT
/begin MEASUREMENT rlmxbkv_w "max. zul‰ssige F¸llung durch Bremskraftverst‰rker" UWORD rel_uw_q0p0234 1 100 0 1535.98 FORMAT "%8.3" ECU_ADDRESS 0x800A0A /end MEASUREMENT
/begin MEASUREMENT rlmxmr_w "maximal erreichbare F¸llung mit Momentenreserve" UWORD rel_uw_q0p0234 1 100 0.0234375 1535.98 FORMAT "%8.3" ECU_ADDRESS 0x800A0C /end MEASUREMENT
/begin MEASUREMENT SBC_IdleSpd_Req "" UBYTE nmot_q10 1 100 0 2550 FORMAT "%5.0" ECU_ADDRESS 0x801273 /end MEASUREMENT
/begin MEASUREMENT spiErrCtr1 "" UBYTE dez 1 100 0 255 FORMAT "%5.1" ECU_ADDRESS 0x80118D /end MEASUREMENT
/begin MEASUREMENT spiErrCtr2 "" UBYTE dez 1 100 0 255 FORMAT "%5.1" ECU_ADDRESS 0x80118E /end MEASUREMENT
/begin MEASUREMENT statmainj "" UBYTE B_TRUE 1 100 0 1 BIT_MASK 0x1 FORMAT "%13.11" ARRAY_SIZE 8 ECU_ADDRESS 0x7F986C /end MEASUREMENT
/begin MEASUREMENT tabgbts_w "Abgastemperatur f¸r Bauteileschutz" UWORD temp_uw_q0p0195_o50 1 100 -50 1229.98 FORMAT "%8.3" ECU_ADDRESS 0x8007F0 /end MEASUREMENT
/begin MEASUREMENT taikrstx_w "station‰re Abgastemperatur im Kr¸mmer mit maximaler Momentenreserve" UWORD temp_q0p0234 1 100 0 1535.98 FORMAT "%8.3" ECU_ADDRESS 0x800A0E /end MEASUREMENT
/begin MEASUREMENT takrnomr_w "station‰re Kr¸mmerabgastemperatur ohne Momentenreserve" UWORD temp_q0p0234 1 100 0 1535.98 FORMAT "%8.3" ECU_ADDRESS 0x800A10 /end MEASUREMENT
/begin MEASUREMENT tesum_l "Summe effektive Einspritzzeit long word" ULONG t1p0usxms 1 100 0 4.29497e+006 FORMAT "%13.5" ECU_ADDRESS 0x801D88 /end MEASUREMENT
/begin MEASUREMENT tistmr_w "Abgastemperatur im Kr¸mmer bei Katheizen mit Momentenreserve bz. auf Umgebung" UWORD temp_q0p0234 1 100 0 1535.98 FORMAT "%8.3" ECU_ADDRESS 0x800A12 /end MEASUREMENT
/begin MEASUREMENT tnst "Zeit nach Startende" UBYTE t1sxs_ub_b255 1 100 0 255 FORMAT "%5.1" ECU_ADDRESS 0x801274 /end MEASUREMENT
/begin MEASUREMENT tovkrmr_w "Temperaturerhˆhung vor Kr¸mmer durch Momentenreserve" UWORD temp_q0p0234 1 100 0 1535.98 FORMAT "%8.3" ECU_ADDRESS 0x800A14 /end MEASUREMENT
/begin MEASUREMENT urinlsu2_w "widerstandsproportionale Spannung des CJ120 der Nernstzelle LSU2 (ADC-Wert)" UWORD spg_uw_q0p00488 1 100 0 319.995 FORMAT "%8.4" ECU_ADDRESS 0x8016BE /end MEASUREMENT
/begin MEASUREMENT urinlsu_w "widerstandsproportionale Spannung des CJ120 der Nernstzelle LSU (ADC-Wert)" UWORD spg_uw_q0p00488 1 100 0 319.995 FORMAT "%8.4" ECU_ADDRESS 0x8016C0 /end MEASUREMENT
/begin MEASUREMENT uulsuv2_w "Sondenspannung vor Kat einer Breitbandlambdasonde Bank2 (ADC-Wert)" UWORD spg_uw_q0p00488 1 100 0 319.995 FORMAT "%8.4" ECU_ADDRESS 0x8016C2 /end MEASUREMENT
/begin MEASUREMENT uulsuv_w "Sondenspannung vor Kat einer Breitbandlambdasonde (ADC-Wert)" UWORD spg_uw_q0p00488 1 100 0 319.995 FORMAT "%8.4" ECU_ADDRESS 0x8016C4 /end MEASUREMENT
/begin MEASUREMENT uushk2_w "ADC-Spannung Lambdasonde hinter Katalysator Bank2 (Word)" UWORD spg_uw_q0p00488 1 100 0 319.995 FORMAT "%8.4" ECU_ADDRESS 0x801A6A /end MEASUREMENT
/begin MEASUREMENT uushk2_w_1ms "" UWORD spg_uw_q0p00488 1 100 0 319.995 FORMAT "%8.4" ECU_ADDRESS 0x801A6C /end MEASUREMENT
/begin MEASUREMENT uushk_w "ADC-Spannung Lambdasonde hinter Katalysator (Word)" UWORD spg_uw_q0p00488 1 100 0 319.995 FORMAT "%8.4" ECU_ADDRESS 0x801A6E /end MEASUREMENT
/begin MEASUREMENT uushk_w_1ms "" UWORD spg_uw_q0p00488 1 100 0 319.995 FORMAT "%8.4" ECU_ADDRESS 0x801A70 /end MEASUREMENT
/begin MEASUREMENT virkr "Verh‰ltnis Integrator / Referenzpegel Klopfregelung" UBYTE fak_ub_b16 1 100 0 15.9375 FORMAT "%5.2" ECU_ADDRESS 0x800FBA /end MEASUREMENT
/begin MEASUREMENT vkr "Verst‰rkungsstufe f¸r Eingangsverst‰rkung Klopf-IC" UBYTE dez 1 100 0 255 FORMAT "%5.1" ARRAY_SIZE 8 ECU_ADDRESS 0x800FBC /end MEASUREMENT
/begin MEASUREMENT vkr_tst "Verst‰rkungsstufe f¸r Eingangsverst‰rkung Klopf-IC rollierend mit Zyl.z‰hler" UBYTE dez 1 100 0 255 FORMAT "%5.1" ECU_ADDRESS 0x800FC4 /end MEASUREMENT
/begin MEASUREMENT vszwm "Mittelwert der ZW-Verstellung ¸ber VS2x" SBYTE zw_sb_q0p75 1 100 -96 95.25 FORMAT "%5.2" ECU_ADDRESS 0x800FED /end MEASUREMENT
/begin MEASUREMENT v_lfr "Fzg.-Geschwindigkeit f¸r LFR" UBYTE vfzg_q0p25 1 100 0 63.75 FORMAT "%5.2" ECU_ADDRESS 0x801275 /end MEASUREMENT
/begin MEASUREMENT wdkdlra_w "Alter Sollwert DK-Winkel in 12 Bit-Auflˆsung" UWORD relDK_q0p02441 1 100 0 1599.98 FORMAT "%8.3" ECU_ADDRESS 0x8014DE /end MEASUREMENT
/begin MEASUREMENT wdkdlr_w "Sollwert DK-Winkel in 12 Bit-Auflˆsung" UWORD relDK_q0p02441 1 100 0 1599.98 FORMAT "%8.3" ECU_ADDRESS 0x7FAA4A /end MEASUREMENT
/begin MEASUREMENT wdksfi_w "aus wdks_w pr‰dizierter DK-Winkel" SWORD relDK_q0p02441 1 100 -800 799.976 FORMAT "%8.4" ECU_ADDRESS 0x8014E0 /end MEASUREMENT
/begin MEASUREMENT weabm_w "" SWORD kw_q1 1 100 -32768 32767 FORMAT "%8.2" ECU_ADDRESS 0x7F986A /end MEASUREMENT
/begin MEASUREMENT weeabr_w "" UWORD kw_q1 1 100 0 65535 FORMAT "%8.2" ECU_ADDRESS 0x7F9868 /end MEASUREMENT
/begin MEASUREMENT wkr "zylinderindividuelle Z¸ndwinkelsp‰tverstellung KR" SBYTE zw_sb_q0p75 1 100 -96 95.25 FORMAT "%5.2" ARRAY_SIZE 8 ECU_ADDRESS 0x800FF0 /end MEASUREMENT
/begin MEASUREMENT wkra "last und drehzahlabh. Adaptionskennfeld f. wkr" SBYTE zw_sb_q0p75 1 100 -96 95.25 FORMAT "%5.2" ARRAY_SIZE 160 ECU_ADDRESS 0x802DF8 /end MEASUREMENT
/begin MEASUREMENT wkratst "wkra mit Synchro-Raster rollierend" SBYTE zw_sb_q0p75 1 100 -96 95.25 FORMAT "%5.2" ECU_ADDRESS 0x800FA2 /end MEASUREMENT
/begin MEASUREMENT wkra_aus "aktuell ausgegebene Adaptionswerte" SBYTE zw_sb_q0p75 1 100 -96 95.25 FORMAT "%5.2" ARRAY_SIZE 8 ECU_ADDRESS 0x800C90 /end MEASUREMENT
/begin MEASUREMENT wkrdy "Z¸ndwinkelsp‰tverstellung bei KR-Dynamik" SBYTE zw_sb_q0p75 1 100 -96 95.25 FORMAT "%5.2" ECU_ADDRESS 0x800FA3 /end MEASUREMENT
/begin MEASUREMENT wkrdya "adaptierter Z¸ndwinkel bei KR-Dynamik" SBYTE zw_sb_q0p75 1 100 -96 95.25 FORMAT "%5.2" ARRAY_SIZE 5 ECU_ADDRESS 0x7FC7CC /end MEASUREMENT
/begin MEASUREMENT wkrdyaa "adaptiver Anteil des Dynamikvorhalts" SBYTE zw_sb_q0p75 1 100 -96 95.25 FORMAT "%5.2" ECU_ADDRESS 0x800FA4 /end MEASUREMENT
/begin MEASUREMENT wkrdyti "tip in-Anteil des Dynamikvorhalts" SBYTE zw_sb_q0p75 1 100 -96 95.25 FORMAT "%5.2" ECU_ADDRESS 0x800FA5 /end MEASUREMENT
/begin MEASUREMENT wkrlz "Winkel KR Leitzylinder" SBYTE zw_sb_q0p75 1 100 -96 95.25 FORMAT "%5.2" ECU_ADDRESS 0x800FCA /end MEASUREMENT
/begin MEASUREMENT wkrlzofv "Z¸ndwinkeloffset f¸r gef¸hrten Zylinder" SBYTE zw_sb_q0p75 1 100 -96 95.25 FORMAT "%5.2" ARRAY_SIZE 8 ECU_ADDRESS 0x800FCC /end MEASUREMENT
/begin MEASUREMENT wkrm "Mittelwert der zylinderindividuellen ZW-Sp‰tverstellungen durch KR" SBYTE zw_sb_q0p75 1 100 -96 95.25 FORMAT "%5.2" ECU_ADDRESS 0x800FF8 /end MEASUREMENT
/begin MEASUREMENT wkrma "Mittelwert der ZW-Sp‰tverstellungen KR, allgemein (im Notlauf mit Sicherheit)" SBYTE zw_sb_q0p75 1 100 -96 95.25 FORMAT "%5.2" ECU_ADDRESS 0x800FF9 /end MEASUREMENT
/begin MEASUREMENT wkr_tst "zyl.ind. ZW-Sp‰tverstellung, rollierend" SBYTE zw_sb_q0p75 1 100 -96 95.25 FORMAT "%5.2" ECU_ADDRESS 0x800FFA /end MEASUREMENT
/begin MEASUREMENT wsgesmr_w "koordinierter Abgasenergiestrom gefordert f¸r Momentenreserve" UWORD leist_q2 1 100 0 131070 FORMAT "%8.1" ECU_ADDRESS 0x800A16 /end MEASUREMENT
/begin MEASUREMENT wsistmr_w "tats‰chlicher Abgasenergiestrom bei Momentenreserve" UWORD leist_q2 1 100 0 32768 FORMAT "%8.2" ECU_ADDRESS 0x800A18 /end MEASUREMENT
/begin MEASUREMENT wsnomr_w "Abgasw‰rmestrom ohne Momentenreserve" UWORD leist_q2 1 100 0 131070 FORMAT "%8.1" ECU_ADDRESS 0x800A1A /end MEASUREMENT
/begin MEASUREMENT w_ikrrkr "" UWORD spg_uw_q0p000076 1 100 0 4.99992 FORMAT "%8.6" ECU_ADDRESS 0x801B94 /end MEASUREMENT
/begin MEASUREMENT zaldy "Z¸ndungsz‰hler f¸r Abregelung Lastdynamik" UBYTE dez 1 100 0 255 FORMAT "%5.1" ECU_ADDRESS 0x800FA6 /end MEASUREMENT
/begin MEASUREMENT zkrvf "Z‰hler, bestimmt die Frequenz der zyl.-individuellen Z¸ndwinkelfr¸hverstellung" UBYTE dez 1 100 0 255 FORMAT "%5.1" ARRAY_SIZE 8 ECU_ADDRESS 0x800FFC /end MEASUREMENT
/begin MEASUREMENT zkvek_zbg "" UBYTE dez 1 100 0 255 FORMAT "%5.1" ECU_ADDRESS 0x7F866E /end MEASUREMENT
/begin MEASUREMENT zwkh "Z¸ndwinkelkorrektur beim Kat-Heizen" SBYTE zw_sb_q0p75 1 100 -96 95.25 FORMAT "%5.2" ECU_ADDRESS 0x800A24 /end MEASUREMENT
/begin MEASUREMENT zwoutar "Z¸ndwinkel-Ausgabe Array" SBYTE zw_sb_q0p75 1 100 -96 95.25 FORMAT "%5.2" ARRAY_SIZE 4 ECU_ADDRESS 0x7FAA14 /end MEASUREMENT
/begin MEASUREMENT zzprz "Prozentsatz von Verbrennungen w‰hrend Dynamik mit KR-bestimmtem ZW" UBYTE rel_ub_b99p6 1 100 0 99.6094 FORMAT "%5.2" ECU_ADDRESS 0x800FA7 /end MEASUREMENT
/begin MEASUREMENT zzwdykr_w "Z¸ndungsz‰hler bei gesetztem Bit B_zwkra=1 w‰hrend der KR-Dynamik" UWORD dez 1 100 0 65535 FORMAT "%8.2" ECU_ADDRESS 0x801B76 /end MEASUREMENT
/begin MEASUREMENT zzwdymd_w "Z¸ndungsz‰hler bei nicht gesetztem Bit B_zwkra=0 w‰hrend der KR-Dynamik" UWORD dez 1 100 0 65535 FORMAT "%8.2" ECU_ADDRESS 0x801B78 /end MEASUREMENT
/begin MEASUREMENT zzylkra "Zylinderzuordnung gef¸hrte Zylinder" UBYTE dez 1 100 0 255 FORMAT "%5.1" ARRAY_SIZE 8 ECU_ADDRESS 0x800FD4 /end MEASUREMENT
/begin MEASUREMENT zzylzue "SW-Zylinderz‰hler f¸r Z¸ndungsberechnung" UBYTE dez 1 100 0 255 FORMAT "%5.1" ECU_ADDRESS 0x8011E9 /end MEASUREMENT
/begin FUNCTION INDEX_DLSU "" /begin DEF_CHARACTERISTIC /end DEF_CHARACTERISTIC /begin REF_CHARACTERISTIC /end REF_CHARACTERISTIC /begin IN_MEASUREMENT /end IN_MEASUREMENT /begin OUT_MEASUREMENT /end OUT_MEASUREMENT /begin LOC_MEASUREMENT /end LOC_MEASUREMENT /begin SUB_FUNCTION /end SUB_FUNCTION /end FUNCTION
/begin FUNCTION INDEX_DMDMIL "DMDMIL.exported" /begin DEF_CHARACTERISTIC /end DEF_CHARACTERISTIC /begin REF_CHARACTERISTIC /end REF_CHARACTERISTIC /begin IN_MEASUREMENT /end IN_MEASUREMENT /begin OUT_MEASUREMENT /end OUT_MEASUREMENT /begin LOC_MEASUREMENT /end LOC_MEASUREMENT /begin SUB_FUNCTION /end SUB_FUNCTION /end FUNCTION
/begin FUNCTION INDEX_DNWSEAUS "" /begin DEF_CHARACTERISTIC /end DEF_CHARACTERISTIC /begin REF_CHARACTERISTIC /end REF_CHARACTERISTIC /begin IN_MEASUREMENT /end IN_MEASUREMENT /begin OUT_MEASUREMENT /end OUT_MEASUREMENT /begin LOC_MEASUREMENT /end LOC_MEASUREMENT /begin SUB_FUNCTION /end SUB_FUNCTION /end FUNCTION
/begin FUNCTION INDEX_DNWSEEIN "" /begin DEF_CHARACTERISTIC /end DEF_CHARACTERISTIC /begin REF_CHARACTERISTIC /end REF_CHARACTERISTIC /begin IN_MEASUREMENT /end IN_MEASUREMENT /begin OUT_MEASUREMENT /end OUT_MEASUREMENT /begin LOC_MEASUREMENT /end LOC_MEASUREMENT /begin SUB_FUNCTION /end SUB_FUNCTION /end FUNCTION
/begin FUNCTION INDEX_DPH "DPH." /begin DEF_CHARACTERISTIC /end DEF_CHARACTERISTIC /begin REF_CHARACTERISTIC /end REF_CHARACTERISTIC /begin IN_MEASUREMENT /end IN_MEASUREMENT /begin OUT_MEASUREMENT /end OUT_MEASUREMENT /begin LOC_MEASUREMENT /end LOC_MEASUREMENT /begin SUB_FUNCTION /end SUB_FUNCTION /end FUNCTION
/begin FUNCTION INDEX_DPN "" /begin DEF_CHARACTERISTIC /end DEF_CHARACTERISTIC /begin REF_CHARACTERISTIC /end REF_CHARACTERISTIC /begin IN_MEASUREMENT /end IN_MEASUREMENT /begin OUT_MEASUREMENT /end OUT_MEASUREMENT /begin LOC_MEASUREMENT /end LOC_MEASUREMENT /begin SUB_FUNCTION /end SUB_FUNCTION /end FUNCTION
/begin FUNCTION INDEX_DSELHFS "" /begin DEF_CHARACTERISTIC /end DEF_CHARACTERISTIC /begin REF_CHARACTERISTIC /end REF_CHARACTERISTIC /begin IN_MEASUREMENT /end IN_MEASUREMENT /begin OUT_MEASUREMENT /end OUT_MEASUREMENT /begin LOC_MEASUREMENT /end LOC_MEASUREMENT /begin SUB_FUNCTION /end SUB_FUNCTION /end FUNCTION
/begin FUNCTION INDEX_DSLS "" /begin DEF_CHARACTERISTIC /end DEF_CHARACTERISTIC /begin REF_CHARACTERISTIC /end REF_CHARACTERISTIC /begin IN_MEASUREMENT /end IN_MEASUREMENT /begin OUT_MEASUREMENT /end OUT_MEASUREMENT /begin LOC_MEASUREMENT /end LOC_MEASUREMENT /begin SUB_FUNCTION /end SUB_FUNCTION /end FUNCTION
/begin FUNCTION INDEX_DTEV "" /begin DEF_CHARACTERISTIC /end DEF_CHARACTERISTIC /begin REF_CHARACTERISTIC /end REF_CHARACTERISTIC /begin IN_MEASUREMENT /end IN_MEASUREMENT /begin OUT_MEASUREMENT /end OUT_MEASUREMENT /begin LOC_MEASUREMENT /end LOC_MEASUREMENT /begin SUB_FUNCTION /end SUB_FUNCTION /end FUNCTION
/begin FUNCTION INDEX_DTEVE "" /begin DEF_CHARACTERISTIC /end DEF_CHARACTERISTIC /begin REF_CHARACTERISTIC /end REF_CHARACTERISTIC /begin IN_MEASUREMENT /end IN_MEASUREMENT /begin OUT_MEASUREMENT /end OUT_MEASUREMENT /begin LOC_MEASUREMENT /end LOC_MEASUREMENT /begin SUB_FUNCTION /end SUB_FUNCTION /end FUNCTION
/begin FUNCTION INDEX_DTHM "" /begin DEF_CHARACTERISTIC /end DEF_CHARACTERISTIC /begin REF_CHARACTERISTIC /end REF_CHARACTERISTIC /begin IN_MEASUREMENT /end IN_MEASUREMENT /begin OUT_MEASUREMENT /end OUT_MEASUREMENT /begin LOC_MEASUREMENT /end LOC_MEASUREMENT /begin SUB_FUNCTION /end SUB_FUNCTION /end FUNCTION
/begin FUNCTION INDEX_DUF "" /begin DEF_CHARACTERISTIC /end DEF_CHARACTERISTIC /begin REF_CHARACTERISTIC /end REF_CHARACTERISTIC /begin IN_MEASUREMENT /end IN_MEASUREMENT /begin OUT_MEASUREMENT /end OUT_MEASUREMENT /begin LOC_MEASUREMENT /end LOC_MEASUREMENT /begin SUB_FUNCTION /end SUB_FUNCTION /end FUNCTION
/begin FUNCTION INDEX_DUR "" /begin DEF_CHARACTERISTIC /end DEF_CHARACTERISTIC /begin REF_CHARACTERISTIC /end REF_CHARACTERISTIC /begin IN_MEASUREMENT /end IN_MEASUREMENT /begin OUT_MEASUREMENT /end OUT_MEASUREMENT /begin LOC_MEASUREMENT /end LOC_MEASUREMENT /begin SUB_FUNCTION /end SUB_FUNCTION /end FUNCTION
/begin FUNCTION INDEX_EGFE "" /begin DEF_CHARACTERISTIC /end DEF_CHARACTERISTIC /begin REF_CHARACTERISTIC /end REF_CHARACTERISTIC /begin IN_MEASUREMENT /end IN_MEASUREMENT /begin OUT_MEASUREMENT /end OUT_MEASUREMENT /begin LOC_MEASUREMENT /end LOC_MEASUREMENT /begin SUB_FUNCTION /end SUB_FUNCTION /end FUNCTION
/begin FUNCTION INDEX_EHB_EnvCond "" /begin DEF_CHARACTERISTIC /end DEF_CHARACTERISTIC /begin REF_CHARACTERISTIC /end REF_CHARACTERISTIC /begin IN_MEASUREMENT /end IN_MEASUREMENT /begin OUT_MEASUREMENT /end OUT_MEASUREMENT /begin LOC_MEASUREMENT /end LOC_MEASUREMENT /begin SUB_FUNCTION /end SUB_FUNCTION /end FUNCTION
/begin FUNCTION INDEX_EHB_Par "" /begin DEF_CHARACTERISTIC /end DEF_CHARACTERISTIC /begin REF_CHARACTERISTIC /end REF_CHARACTERISTIC /begin IN_MEASUREMENT /end IN_MEASUREMENT /begin OUT_MEASUREMENT /end OUT_MEASUREMENT /begin LOC_MEASUREMENT /end LOC_MEASUREMENT /begin SUB_FUNCTION /end SUB_FUNCTION /end FUNCTION
/begin FUNCTION INDEX_EHB_Tgl "" /begin DEF_CHARACTERISTIC /end DEF_CHARACTERISTIC /begin REF_CHARACTERISTIC /end REF_CHARACTERISTIC /begin IN_MEASUREMENT /end IN_MEASUREMENT /begin OUT_MEASUREMENT /end OUT_MEASUREMENT /begin LOC_MEASUREMENT /end LOC_MEASUREMENT /begin SUB_FUNCTION /end SUB_FUNCTION /end FUNCTION
/begin FUNCTION INDEX_ESP_Par "" /begin DEF_CHARACTERISTIC /end DEF_CHARACTERISTIC /begin REF_CHARACTERISTIC /end REF_CHARACTERISTIC /begin IN_MEASUREMENT /end IN_MEASUREMENT /begin OUT_MEASUREMENT /end OUT_MEASUREMENT /begin LOC_MEASUREMENT /end LOC_MEASUREMENT /begin SUB_FUNCTION /end SUB_FUNCTION /end FUNCTION
/begin FUNCTION INDEX_ESP_Stat "" /begin DEF_CHARACTERISTIC /end DEF_CHARACTERISTIC /begin REF_CHARACTERISTIC /end REF_CHARACTERISTIC /begin IN_MEASUREMENT /end IN_MEASUREMENT /begin OUT_MEASUREMENT /end OUT_MEASUREMENT /begin LOC_MEASUREMENT /end LOC_MEASUREMENT /begin SUB_FUNCTION /end SUB_FUNCTION /end FUNCTION
/begin FUNCTION INDEX_ESP_Tgl "" /begin DEF_CHARACTERISTIC /end DEF_CHARACTERISTIC /begin REF_CHARACTERISTIC /end REF_CHARACTERISTIC /begin IN_MEASUREMENT /end IN_MEASUREMENT /begin OUT_MEASUREMENT /end OUT_MEASUREMENT /begin LOC_MEASUREMENT /end LOC_MEASUREMENT /begin SUB_FUNCTION /end SUB_FUNCTION /end FUNCTION
/begin FUNCTION INDEX_ESP_TrqReq "" /begin DEF_CHARACTERISTIC /end DEF_CHARACTERISTIC /begin REF_CHARACTERISTIC /end REF_CHARACTERISTIC /begin IN_MEASUREMENT /end IN_MEASUREMENT /begin OUT_MEASUREMENT /end OUT_MEASUREMENT /begin LOC_MEASUREMENT /end LOC_MEASUREMENT /begin SUB_FUNCTION /end SUB_FUNCTION /end FUNCTION
/begin FUNCTION INDEX_GGDSAC "" /begin DEF_CHARACTERISTIC /end DEF_CHARACTERISTIC /begin REF_CHARACTERISTIC /end REF_CHARACTERISTIC /begin IN_MEASUREMENT /end IN_MEASUREMENT /begin OUT_MEASUREMENT /end OUT_MEASUREMENT /begin LOC_MEASUREMENT /end LOC_MEASUREMENT /begin SUB_FUNCTION /end SUB_FUNCTION /end FUNCTION
/begin FUNCTION INDEX_GGDSU "" /begin DEF_CHARACTERISTIC /end DEF_CHARACTERISTIC /begin REF_CHARACTERISTIC /end REF_CHARACTERISTIC /begin IN_MEASUREMENT /end IN_MEASUREMENT /begin OUT_MEASUREMENT /end OUT_MEASUREMENT /begin LOC_MEASUREMENT /end LOC_MEASUREMENT /begin SUB_FUNCTION /end SUB_FUNCTION /end FUNCTION
/begin FUNCTION INDEX_GGTFA "" /begin DEF_CHARACTERISTIC /end DEF_CHARACTERISTIC /begin REF_CHARACTERISTIC /end REF_CHARACTERISTIC /begin IN_MEASUREMENT /end IN_MEASUREMENT /begin OUT_MEASUREMENT /end OUT_MEASUREMENT /begin LOC_MEASUREMENT /end LOC_MEASUREMENT /begin SUB_FUNCTION /end SUB_FUNCTION /end FUNCTION
/begin FUNCTION INDEX_GGTFM "" /begin DEF_CHARACTERISTIC /end DEF_CHARACTERISTIC /begin REF_CHARACTERISTIC /end REF_CHARACTERISTIC /begin IN_MEASUREMENT /end IN_MEASUREMENT /begin OUT_MEASUREMENT /end OUT_MEASUREMENT /begin LOC_MEASUREMENT /end LOC_MEASUREMENT /begin SUB_FUNCTION /end SUB_FUNCTION /end FUNCTION
/begin FUNCTION INDEX_GGTKA "" /begin DEF_CHARACTERISTIC /end DEF_CHARACTERISTIC /begin REF_CHARACTERISTIC /end REF_CHARACTERISTIC /begin IN_MEASUREMENT /end IN_MEASUREMENT /begin OUT_MEASUREMENT /end OUT_MEASUREMENT /begin LOC_MEASUREMENT /end LOC_MEASUREMENT /begin SUB_FUNCTION /end SUB_FUNCTION /end FUNCTION
/begin FUNCTION INDEX_GGTOL "" /begin DEF_CHARACTERISTIC /end DEF_CHARACTERISTIC /begin REF_CHARACTERISTIC /end REF_CHARACTERISTIC /begin IN_MEASUREMENT /end IN_MEASUREMENT /begin OUT_MEASUREMENT /end OUT_MEASUREMENT /begin LOC_MEASUREMENT /end LOC_MEASUREMENT /begin SUB_FUNCTION /end SUB_FUNCTION /end FUNCTION
/begin FUNCTION INDEX_GGUB "" /begin DEF_CHARACTERISTIC /end DEF_CHARACTERISTIC /begin REF_CHARACTERISTIC /end REF_CHARACTERISTIC /begin IN_MEASUREMENT /end IN_MEASUREMENT /begin OUT_MEASUREMENT /end OUT_MEASUREMENT /begin LOC_MEASUREMENT /end LOC_MEASUREMENT /begin SUB_FUNCTION /end SUB_FUNCTION /end FUNCTION
/begin FUNCTION INDEX_LZSR "" /begin DEF_CHARACTERISTIC /end DEF_CHARACTERISTIC /begin REF_CHARACTERISTIC /end REF_CHARACTERISTIC /begin IN_MEASUREMENT /end IN_MEASUREMENT /begin OUT_MEASUREMENT /end OUT_MEASUREMENT /begin LOC_MEASUREMENT /end LOC_MEASUREMENT /begin SUB_FUNCTION /end SUB_FUNCTION /end FUNCTION
/begin FUNCTION INDEX_MDKOG "" /begin DEF_CHARACTERISTIC /end DEF_CHARACTERISTIC /begin REF_CHARACTERISTIC /end REF_CHARACTERISTIC /begin IN_MEASUREMENT /end IN_MEASUREMENT /begin OUT_MEASUREMENT /end OUT_MEASUREMENT /begin LOC_MEASUREMENT /end LOC_MEASUREMENT /begin SUB_FUNCTION /end SUB_FUNCTION /end FUNCTION
/begin FUNCTION INDEX_SWADP "" /begin DEF_CHARACTERISTIC /end DEF_CHARACTERISTIC /begin REF_CHARACTERISTIC /end REF_CHARACTERISTIC /begin IN_MEASUREMENT /end IN_MEASUREMENT /begin OUT_MEASUREMENT /end OUT_MEASUREMENT /begin LOC_MEASUREMENT /end LOC_MEASUREMENT /begin SUB_FUNCTION /end SUB_FUNCTION /end FUNCTION
/begin FUNCTION INDEX_TCM_Par "" /begin DEF_CHARACTERISTIC /end DEF_CHARACTERISTIC /begin REF_CHARACTERISTIC /end REF_CHARACTERISTIC /begin IN_MEASUREMENT /end IN_MEASUREMENT /begin OUT_MEASUREMENT /end OUT_MEASUREMENT /begin LOC_MEASUREMENT /end LOC_MEASUREMENT /begin SUB_FUNCTION /end SUB_FUNCTION /end FUNCTION
/begin FUNCTION INDEX_TCM_Tgl "" /begin DEF_CHARACTERISTIC /end DEF_CHARACTERISTIC /begin REF_CHARACTERISTIC /end REF_CHARACTERISTIC /begin IN_MEASUREMENT /end IN_MEASUREMENT /begin OUT_MEASUREMENT /end OUT_MEASUREMENT /begin LOC_MEASUREMENT /end LOC_MEASUREMENT /begin SUB_FUNCTION /end SUB_FUNCTION /end FUNCTION
/begin FUNCTION INDEX_TCM_TrqReq "" /begin DEF_CHARACTERISTIC /end DEF_CHARACTERISTIC /begin REF_CHARACTERISTIC /end REF_CHARACTERISTIC /begin IN_MEASUREMENT /end IN_MEASUREMENT /begin OUT_MEASUREMENT /end OUT_MEASUREMENT /begin LOC_MEASUREMENT /end LOC_MEASUREMENT /begin SUB_FUNCTION /end SUB_FUNCTION /end FUNCTION
/begin FUNCTION INDEX_WWS_BRD "" /begin DEF_CHARACTERISTIC /end DEF_CHARACTERISTIC /begin REF_CHARACTERISTIC /end REF_CHARACTERISTIC /begin IN_MEASUREMENT /end IN_MEASUREMENT /begin OUT_MEASUREMENT /end OUT_MEASUREMENT /begin LOC_MEASUREMENT /end LOC_MEASUREMENT /begin SUB_FUNCTION /end SUB_FUNCTION /end FUNCTION
/begin FUNCTION INDEX_WWS_NoPA "" /begin DEF_CHARACTERISTIC /end DEF_CHARACTERISTIC /begin REF_CHARACTERISTIC /end REF_CHARACTERISTIC /begin IN_MEASUREMENT /end IN_MEASUREMENT /begin OUT_MEASUREMENT /end OUT_MEASUREMENT /begin LOC_MEASUREMENT /end LOC_MEASUREMENT /begin SUB_FUNCTION /end SUB_FUNCTION /end FUNCTION
/begin FUNCTION INDEX_WWS_PA "" /begin DEF_CHARACTERISTIC /end DEF_CHARACTERISTIC /begin REF_CHARACTERISTIC /end REF_CHARACTERISTIC /begin IN_MEASUREMENT /end IN_MEASUREMENT /begin OUT_MEASUREMENT /end OUT_MEASUREMENT /begin LOC_MEASUREMENT /end LOC_MEASUREMENT /begin SUB_FUNCTION /end SUB_FUNCTION /end FUNCTION
/begin FUNCTION KATV "Variantenerkennung (Fahrzeug mit/ohne Kat und Lambdasonden)" /begin DEF_CHARACTERISTIC /end DEF_CHARACTERISTIC /begin REF_CHARACTERISTIC CDHSV UHDMX /end REF_CHARACTERISTIC /begin IN_MEASUREMENT B_clkatfz B_pwf uhsv uhsv2 /end IN_MEASUREMENT /begin OUT_MEASUREMENT B_nokatfz nokatfz_flg /end OUT_MEASUREMENT /begin LOC_MEASUREMENT /end LOC_MEASUREMENT /begin SUB_FUNCTION /end SUB_FUNCTION /end FUNCTION
/begin FUNCTION KBK2SERVI "" /begin DEF_CHARACTERISTIC /end DEF_CHARACTERISTIC /begin REF_CHARACTERISTIC /end REF_CHARACTERISTIC /begin IN_MEASUREMENT nmot nmot_w /end IN_MEASUREMENT /begin OUT_MEASUREMENT /end OUT_MEASUREMENT /begin LOC_MEASUREMENT /end LOC_MEASUREMENT /begin SUB_FUNCTION /end SUB_FUNCTION /end FUNCTION
/begin FUNCTION KOEVAB "Koordination Ev-Abschaltung" /begin DEF_CHARACTERISTIC /end DEF_CHARACTERISTIC /begin REF_CHARACTERISTIC /end REF_CHARACTERISTIC /begin IN_MEASUREMENT B_ausc_act B_synnot B_wdaactiv /end IN_MEASUREMENT /begin OUT_MEASUREMENT B_koevab /end OUT_MEASUREMENT /begin LOC_MEASUREMENT /end LOC_MEASUREMENT /begin SUB_FUNCTION /end SUB_FUNCTION /end FUNCTION
/begin FUNCTION KOMRKH "Koordination Momentenreserve Katheizen (Saugrohreinspritzung)"
 /begin DEF_CHARACTERISTIC DMRKHST KFMIOPKH KFNFSKHM KFNLLKHM KFZWKH MNDMRKH MXDMRKH NLLAD NLLKT TABGMAX TDBKVKHN TKHFSAB TKHLLMX TKHNAB TMAXTH ZKMDKBKV ZKMDKH /end DEF_CHARACTERISTIC
 /begin REF_CHARACTERISTIC ETADZW KFATMKRH KFMIRL /end REF_CHARACTERISTIC
 /begin IN_MEASUREMENT anfsls B_bkvnkhab B_fs B_kh B_khan B_khmrfrho B_ll etazwmn fho_w frhol_w fupsrl_w mifal_w nmot nmot_w pirg_w psmxbkvg_w rl tansk_w tmot tnse_w umsrln_w wsanfkh_w wsanfkw_w wsistslf_w zwopt /end IN_MEASUREMENT
 /begin OUT_MEASUREMENT B_khn dmrkh dmrkh_w frhokor_w komrkhAusBits nfskh nllkh rlmxbkv_w tistmr_w tovkrmr_w wsistmr_w /end OUT_MEASUREMENT
 /begin LOC_MEASUREMENT B_bkvkhab clistmr_w clmnomr_w clmxbkv_w clmxmrbg_w clmxmr_w clmxtabg_w dclmrws_w dmrkhf_w dzwkh etazwkh faucsmr_w komrkhLokBits mizskhmx_w nmaxllkh rlistmr_w rlmnomr_w rlmxmr_w taikrstx_w takrnomr_w wsgesmr_w wsnomr_w zwkh /end LOC_MEASUREMENT
 /begin SUB_FUNCTION /end SUB_FUNCTION
/end FUNCTION
/begin FUNCTION KOS "Klimakompressor - Steuerung" /begin DEF_CHARACTERISTIC FWLWHS NKKMN NKKMX TKKMAX TKKMAXLW TKKMIN TKKMINLW TNSTKK /end DEF_CHARACTERISTIC /begin REF_CHARACTERISTIC /end REF_CHARACTERISTIC /begin IN_MEASUREMENT B_acmlf B_plw B_vl Cod_Func fho_w nmot tnse_w /end IN_MEASUREMENT /begin OUT_MEASUREMENT B_kompbaus B_kompnaus /end OUT_MEASUREMENT /begin LOC_MEASUREMENT /end LOC_MEASUREMENT /begin SUB_FUNCTION /end SUB_FUNCTION /end FUNCTION
/begin FUNCTION KOSLKH "Koordination der Sekund‰rlufteinblasung"
 /begin DEF_CHARACTERISTIC CWBBDSLS CWBGDSLS CWDSLS CWKOSLKH DPSLV FHOSLS KFMRDSLSAD KFMRDSLSFA MAXANZSLP MXSLPKH TASLMNDSLS TASLMXDSLS TASLSMNKH TASLSMXKH TDODSLS TDSLSFA TFGANFFA TFGANFODSL TMFASLMN TMSLMNDSLS TMSLMXDSLS TMSLSMNKH TMSLSMXKH TSLPMN TVFGSLPBB TVSLPBB TVSLVOFF TVSLVON UBSLSTMN UBSLSTMX WSISTSLSMN WSISTSLSMX /end DEF_CHARACTERISTIC
 /begin REF_CHARACTERISTIC /end REF_CHARACTERISTIC
 /begin IN_MEASUREMENT B_anfdslp B_anfdslv B_anstslp B_dsls B_fa B_fasls B_hag B_kh B_khan B_kwwsanf B_msllamr B_msllamr2 B_mslmn B_nmot B_phmess B_phstart B_rsdsls B_stend B_szsls B_szslv fho_w mifal_w nmot_w ps_w pu_w tans tmot tmst ubsqf_w wistr_w /end IN_MEASUREMENT
 /begin OUT_MEASUREMENT anfsls anzslp anzslpkh B_aflldsls B_aktdsls B_anfodsls B_awsalsu B_cwdslty B_dslsvvt B_erradsls B_fasla B_fganfdsl B_fganfsls B_fgmslofs B_msllamrg B_mxslpkh B_prventil B_slp B_slpbb B_slpmn B_sls B_slsanf B_slsapp B_slsdsls B_slsfa B_slskh B_slsoab B_slv B_trslsfa B_zeffasla B_zefhsvsa B_zeflsv B_zfganzm dmrdsls_w koslkhAusBits1 koslkhAusBits2 koslkhAusBits3 koslkhAusBits4 /end OUT_MEASUREMENT
 /begin LOC_MEASUREMENT B_faslaon B_fgslpbb B_fgslpteh B_fktanfsl B_tslpdiag B_tslskh koslkhLokBits /end LOC_MEASUREMENT
 /begin SUB_FUNCTION /end SUB_FUNCTION
/end FUNCTION
/begin FUNCTION KRADAP "Klopfregelung Station‰radaption" /begin DEF_CHARACTERISTIC KRDWA KRDWKLA KRDWSA /end DEF_CHARACTERISTIC /begin REF_CHARACTERISTIC /end REF_CHARACTERISTIC
 /begin IN_MEASUREMENT B_kl B_kr B_kradap B_krdws B_krvf B_pwf krmxw kr_monitor stkrax_w wkr zzylkr /end IN_MEASUREMENT
 /begin OUT_MEASUREMENT wkra wkratst /end OUT_MEASUREMENT
 /begin LOC_MEASUREMENT /end LOC_MEASUREMENT
 /begin SUB_FUNCTION /end SUB_FUNCTION
/end FUNCTION
/begin FUNCTION KRDY "Klopfregelung Dynamik"
 /begin DEF_CHARACTERISTIC DYADMX DYADS DYAFVS DYAMNV DYAVF DZWTIN FKELDYA N_ST_KRA PZWKRA /end DEF_CHARACTERISTIC
 /begin REF_CHARACTERISTIC SNM16KRUB /end REF_CHARACTERISTIC
 /begin IN_MEASUREMENT B_kl B_krldya B_krldyf B_krldyv B_krldyv_old B_krndy B_ladap B_pwf B_tipin B_tmkr B_zwkraa esst_snm16krub kek nmot stkrnx virkr zzylkr /end IN_MEASUREMENT
 /begin OUT_MEASUREMENT B_tipin_old wkrdy /end OUT_MEASUREMENT
 /begin LOC_MEASUREMENT B_kldynrm B_kldystk wkrdya wkrdyaa wkrdyti zaldy zzprz zzwdykr_w zzwdymd_w /end LOC_MEASUREMENT
 /begin SUB_FUNCTION /end SUB_FUNCTION
/end FUNCTION
/begin FUNCTION KRKE "Klopferkennung"
 /begin DEF_CHARACTERISTIC CWKRREF CWREFI FKEFMC FKELDY FKENDY FKRFTPFMC KE1N KE2N KE3N KE4N KE5N KE6N KE7N KE8N KRFTP1 KRFTP2 KRFTP3 KRKFKS KRUMOB KRUMUNT KRVST REFINI RKRMX1N RKRMX2N ZYRKR /end DEF_CHARACTERISTIC
 /begin REF_CHARACTERISTIC SNM16KRUB /end REF_CHARACTERISTIC
 /begin IN_MEASUREMENT B_c95ks3 B_dnt B_dntb B_dtp B_dtpb B_fmfkrc B_kr B_krldy B_krndy B_krnl B_stend esst_snm16krub ikrma_w ikrme_w ikr_w kr_monitor nmot vske zzylkr /end IN_MEASUREMENT
 /begin OUT_MEASUREMENT B_kl ke kek kek_tst krftpakt rkrmx1w_w rkrmx2w_w rkrmx_w rkrtp_w rkr_tst_w rkr_w virkr vkr vkr_tst w_ikrrkr /end OUT_MEASUREMENT
 /begin LOC_MEASUREMENT /end LOC_MEASUREMENT
 /begin SUB_FUNCTION /end SUB_FUNCTION
/end FUNCTION
/begin FUNCTION KRLZ "Klopfregelung Leitzylinderfunktion" /begin DEF_CHARACTERISTIC KRNLZAR LZFUER MINAKRLZ WKRLZOF WKRLZOFEKS /end DEF_CHARACTERISTIC /begin REF_CHARACTERISTIC CWKRNLR SENZZYL /end REF_CHARACTERISTIC /begin IN_MEASUREMENT B_eks B_kr B_krnl evz_aus E_ks1h E_ks2h nmot wkr /end IN_MEASUREMENT /begin OUT_MEASUREMENT B_krdwslz B_krlz maskgz wkrlzofv zzylkra /end OUT_MEASUREMENT
 /begin LOC_MEASUREMENT akrgz akrlz B_eksh B_ekszk B_elzmn B_krlzn B_krlz_old B_krnllz B_krnlzdws B_krnl_old B_lzfuer B_lzup E_ks1h_old E_ks2h_old E_ks3h_old E_ks4h_old krlzn maskeks masklz wkrlz /end LOC_MEASUREMENT
 /begin SUB_FUNCTION /end SUB_FUNCTION
/end FUNCTION
/begin FUNCTION KRREG "Klopfregelung: Station‰rregelung" /begin DEF_CHARACTERISTIC DWKRMSN KRDWSN KRFKN KRMXN KRVFN KRVFSN VZWKR /end DEF_CHARACTERISTIC /begin REF_CHARACTERISTIC SNM16KRUB WKRLZOF WKRLZOFEKS /end REF_CHARACTERISTIC
 /begin IN_MEASUREMENT B_eks B_kl B_kr B_krdws B_krgz B_krkez B_krlz B_wkral B_zwkraa B_zwkrum esst_snm16krub evz_aus kr_monitor maskgz nmot stkrax_w wkra wkrlzofv zwkrafld zzylkr zzylkra /end IN_MEASUREMENT
 /begin OUT_MEASUREMENT B_krvf dwkr dwkrz krmxw vszwm wkr wkrm wkrma wkr_tst /end OUT_MEASUREMENT
 /begin LOC_MEASUREMENT dwkrmsw krdwsw krfkw krvfsw krvfw lztemp wkra_aus zkrvf /end LOC_MEASUREMENT
 /begin SUB_FUNCTION /end SUB_FUNCTION
/end FUNCTION
/begin FUNCTION KT_ALSU "" /begin DEF_CHARACTERISTIC /end DEF_CHARACTERISTIC /begin REF_CHARACTERISTIC /end REF_CHARACTERISTIC /begin IN_MEASUREMENT tahrlsu2_w tahrlsu_w tphrlsu_w /end IN_MEASUREMENT /begin OUT_MEASUREMENT B_hsve B_hsve2 kttahrlsu2_w kttahrlsu_w kttphrlsu_w /end OUT_MEASUREMENT /begin LOC_MEASUREMENT /end LOC_MEASUREMENT /begin SUB_FUNCTION /end SUB_FUNCTION /end FUNCTION
/begin FUNCTION KT_DHRLSUE "" /begin DEF_CHARACTERISTIC /end DEF_CHARACTERISTIC /begin REF_CHARACTERISTIC /end REF_CHARACTERISTIC /begin IN_MEASUREMENT B_lsuicif B_lsuicif2 B_lsuickf B_lsuickf2 /end IN_MEASUREMENT /begin OUT_MEASUREMENT B_hsvemn B_hsvemn2 B_hsvemx B_hsvemx2 B_hsvesi B_hsvesi2 /end OUT_MEASUREMENT /begin LOC_MEASUREMENT dhrlsue1_err dhrlsue2_err kt_dhrlsue_bits /end LOC_MEASUREMENT /begin SUB_FUNCTION /end SUB_FUNCTION /end FUNCTION
/begin FUNCTION KT_DICLSU "" /begin DEF_CHARACTERISTIC /end DEF_CHARACTERISTIC /begin REF_CHARACTERISTIC /end REF_CHARACTERISTIC
 /begin IN_MEASUREMENT B_diagia B_diagia2 B_fklanf B_fklanf2 B_iclsabg B_iclsabg2 B_pusab B_pusab2 B_rinabg B_rinabg2 B_rineza B_rineza2 iprefanf iprefanf2 /end IN_MEASUREMENT
 /begin OUT_MEASUREMENT B_lsuiamn B_lsuiamn2 B_lsuiamx B_lsuiamx2 B_lsuicif B_lsuicif2 B_lsuickf B_lsuickf2 B_lsuube B_lsuube2 B_lsuunmn B_lsuunmn2 B_lsuunmx B_lsuunmx2 B_lsuvmmn B_lsuvmmn2 B_lsuvmmx B_lsuvmmx2 /end OUT_MEASUREMENT
 /begin LOC_MEASUREMENT caseVar caseVar2 chipErrCtr1 chipErrCtr2 data2_init2 data2_s data_init2 data_s dlsu1_ia_err dlsu1_un_err dlsu1_vm_err dlsu2_ia_err dlsu2_un_err dlsu2_vm_err Err_get_1 Err_get_2 Err_set_1 Err_set_2 initErrCtr1 initErrCtr2 kt_diclsu1_bits kt_diclsu2_bits spiErrCtr1 spiErrCtr2 /end LOC_MEASUREMENT
 /begin SUB_FUNCTION /end SUB_FUNCTION
/end FUNCTION
/begin FUNCTION KT_DVE ""
 /begin DEF_CHARACTERISTIC CWDLRIKL DANTGESWNV DANTGESWV DANTSCHWNV DANTSCHWV DKLAGERT DLRDWDKSS1 DLRDWDKSS2 DLRHAFTMN DLRHAFTST DLRIAMAXA DLRIKLPAR DLRININI DLRKDONLP0 DLRKDUNLP0 DLRKDUNLP1 DLRKDUNLP2 DLRKDUNLP3 DLRKIONLP0 DLRKIUNLP0 DLRKIUNLP1 DLRKIUNLP2 DLRKIUNLP3 DLRKPONLP0 DLRKPUNLP0 DLRKPUNLP1 DLRKPUNLP2 DLRKPUNLP3 DLRKREIS DLRKREISST DLRNLPD DLRPID0T DLRPID1T DLRPID2T DLRPIDMAX DLRPIDMIN DLRUBSOLL DLRUMABAND DLRUMAIINI DVEEST DWDKSBAMX DWDKSIKLS KDLRIDDVE TDKLAGDE TDLRHAFTMX TDLRPIDC TPWRSV UDKNLPTOL WDKBEWS WDKNLPTOL WDKREIB WDKSAPNOL WDKSTFEIN WDKSTGROB ZKUBDLR ZKWDKSPT1 /end DEF_CHARACTERISTIC
 /begin REF_CHARACTERISTIC /end REF_CHARACTERISTIC
 /begin IN_MEASUREMENT B_appnolu B_dcdisr B_dkaden B_dknolu B_dknot B_dkp1e B_dkp2e B_dkpiu B_dlrien B_ESrdy B_i_ska_um B_nmot B_st B_wdk1v B_wdk2sel dwdks_w ES_sfmdk nmot ub udknlp1 udknlp2 udkp1_w udkp2_w wdkada_w wdkba_w wdknlp_w wdks_w wped /end IN_MEASUREMENT
 /begin OUT_MEASUREMENT AS_dimdk B_dcdisfr B_dlrbe B_dlrparc B_dlrpide B_dlrspid B_dlrumzu B_dveese B_dvete B_nlpne B_pwrsv B_ubdve B_ubpvg B_ub_ok B_wdksive dklagerc dlrhaftak dlrini_w dlrpidc dlrspid_w dpwrsvc dveesc /end OUT_MEASUREMENT
 /begin LOC_MEASUREMENT B_dkbew B_dlrikla B_dlriklst B_dveesh B_iklrest B_iklstar B_wdksauf dlrd dlri dlriamax dlriant_w dlrihaftc dlriklst_w dlrikl_w dlrkomp dlrndif_w dlrp dwdkdlr_w gwdkdlr_w gwdk_kge wdkdlra_w wdkdlr_w wdksfi_w /end LOC_MEASUREMENT
 /begin SUB_FUNCTION /end SUB_FUNCTION
/end FUNCTION
/begin FUNCTION KT_GGLS "" /begin DEF_CHARACTERISTIC /end DEF_CHARACTERISTIC /begin REF_CHARACTERISTIC /end REF_CHARACTERISTIC /begin IN_MEASUREMENT B_priph B_priph2 /end IN_MEASUREMENT
 /begin OUT_MEASUREMENT urinlsu2_w urinlsu_w uulsuv2_w uulsuv_w uushk2_w uushk2_w_1ms uushk_w uushk_w_1ms /end OUT_MEASUREMENT
 /begin LOC_MEASUREMENT /end LOC_MEASUREMENT
 /begin SUB_FUNCTION /end SUB_FUNCTION
/end FUNCTION
/begin FUNCTION KT_INJEC "Komponententreiber Einspritzung ME 9" /begin DEF_CHARACTERISTIC NINJO /end DEF_CHARACTERISTIC /begin REF_CHARACTERISTIC DTEMN /end REF_CHARACTERISTIC
 /begin IN_MEASUREMENT B_esbnb B_esbst B_nmin B_stend nmot tez_l tvu_w wea wee wes zzyl /end IN_MEASUREMENT
 /begin OUT_MEASUREMENT anzerrab_w anzti anztib anztib_w anztisc_w anzti_w B_injmodst B_injstop frstinjcyl statmainj tesum_l weabm_w weeabr_w /end OUT_MEASUREMENT
 /begin LOC_MEASUREMENT abbwevz_w /end LOC_MEASUREMENT
 /begin SUB_FUNCTION /end SUB_FUNCTION
/end FUNCTION
/begin FUNCTION KT_PORTSOFF "" /begin DEF_CHARACTERISTIC /end DEF_CHARACTERISTIC /begin REF_CHARACTERISTIC /end REF_CHARACTERISTIC /begin IN_MEASUREMENT /end IN_MEASUREMENT /begin OUT_MEASUREMENT /end OUT_MEASUREMENT /begin LOC_MEASUREMENT /end LOC_MEASUREMENT /begin SUB_FUNCTION /end SUB_FUNCTION /end FUNCTION
/begin FUNCTION KT_TEV "" /begin DEF_CHARACTERISTIC /end DEF_CHARACTERISTIC /begin REF_CHARACTERISTIC /end REF_CHARACTERISTIC /begin IN_MEASUREMENT B_bttev B_tevet B_tevtstp tateout tatesoll_w tevper /end IN_MEASUREMENT /begin OUT_MEASUREMENT B_tevtini /end OUT_MEASUREMENT /begin LOC_MEASUREMENT /end LOC_MEASUREMENT /begin SUB_FUNCTION /end SUB_FUNCTION /end FUNCTION
/begin FUNCTION KT_ZUEN "Komponententreiber Z¸ndung Masterfunktion f¸r ME9" /begin DEF_CHARACTERISTIC /end DEF_CHARACTERISTIC /begin REF_CHARACTERISTIC /end REF_CHARACTERISTIC
 /begin IN_MEASUREMENT B_ff B_llrein B_nmin B_nmot frstinjcyl fubaanz offz_w synstate szfuba_w szout_w zwcalcar zzyl /end IN_MEASUREMENT
 /begin OUT_MEASUREMENT ignFadeStatBits ignfdostat ignFdReqStat ignStpStat ignsynstat ignzbgctr kt_zuen_fdOutPattern_u8 kt_zuen_fdPatArray_u8 kt_zuen_fdReq_u16 kt_zuen_lastzkvek kt_zuen_lastzzyl kt_zuen_zkvek zkvek_zbg zwoutar zzylzue /end OUT_MEASUREMENT
 /begin LOC_MEASUREMENT /end LOC_MEASUREMENT
 /begin SUB_FUNCTION /end SUB_FUNCTION
/end FUNCTION
/begin FUNCTION LAKH "Lambda-Koordination bei Katheizen"
 /begin DEF_CHARACTERISTIC KFLANSKH KFLASDSLS KFLASKH KFLMSKH KLLAKHFH LASTMOT LMSTMOT WISTRLASKH ZFLASKH /end DEF_CHARACTERISTIC
 /begin REF_CHARACTERISTIC /end REF_CHARACTERISTIC
 /begin IN_MEASUREMENT anztib_w B_kh B_slsdsls B_slsfa fho_w flakh flamsl2_w flamsl_w fmsldyn nmot_w rl_w tmot tmst wistr_w /end IN_MEASUREMENT
 /begin OUT_MEASUREMENT B_lamkhe lakhAusBits lamkh2_w lamkh_w /end OUT_MEASUREMENT
 /begin LOC_MEASUREMENT B_dslafa flaskh flmsslkh lamkhg2_w lamkhg_w lamkhr2_w lamkhr_w lanskh_w lasdslg2_w lasdslg_w lasdsl_w laskh_w lmskh_w lmssl2_w lmssl_w /end LOC_MEASUREMENT
 /begin SUB_FUNCTION /end SUB_FUNCTION
/end FUNCTION
/begin FUNCTION LAMBTS "Lambda Bauteileschutz"
 /begin DEF_CHARACTERISTIC CWLAMBTS DTBTS FBSTABGM FBSTMOT KFDLBTS KFFDLBTS KFLBTS KFLBTS2 SNM16GKUB SRL12GKUW TABGBTS TDLAMBTS TIKATBTS TKATBTS TVLBTS ZDLBTS ZLBTS /end DEF_CHARACTERISTIC
 /begin REF_CHARACTERISTIC ETADZW /end REF_CHARACTERISTIC
 /begin IN_MEASUREMENT B_dash B_gsaf dzw_kge etazwist nmot rl rl_w tabgm_w tikatm_w tkatm_w tmot zwgru zwopt /end IN_MEASUREMENT
 /begin OUT_MEASUREMENT esst_snm16gkub esst_srl12gkuw lambts2_w lambts_w /end OUT_MEASUREMENT
 /begin LOC_MEASUREMENT B_tabgbts B_tatmbts B_tikatbts B_tkatbts B_twilabts B_twistbts detazwbs dlambts_w dzwg etazwg etazwim flbts_w LAMBTSlokbits lbts2_w lbts_w tabgbts_w /end LOC_MEASUREMENT
 /begin SUB_FUNCTION /end SUB_FUNCTION
/end FUNCTION
/begin FUNCTION LAMFAW "Lambda Fahrerwunsch"
 /begin DEF_CHARACTERISTIC CWLAMFAW DLAMFAW DLAMTANS KFLAFWL KFLAMKR KFLAMKRL LAMFA LAMRLMN RLLAMMN SDZ06GKUB SNM06GKUB SRL06GKUB STM08GKUB TLAFA ZKLAMFAW ZKWLAFWL /end DEF_CHARACTERISTIC
 /begin REF_CHARACTERISTIC /end REF_CHARACTERISTIC
 /begin IN_MEASUREMENT B_sab B_stend dzwwl mifaagk_w milsol_w mrfa_w nmot rl tans tmot wkrma /end IN_MEASUREMENT
 /begin OUT_MEASUREMENT B_ldeffw esst_sdz06gkub esst_snm06gkub esst_srl06gkub esst_stm08gkub lamfa_w /end OUT_MEASUREMENT
 /begin LOC_MEASUREMENT B_lamfas dzwlamfaw lamfawkr_w lamfaws_w lamfaw_w lamfwl_w lamrlmn_w /end LOC_MEASUREMENT
 /begin SUB_FUNCTION /end SUB_FUNCTION
/end FUNCTION
/begin FUNCTION LAMKO "Lambdakoordination"
 /begin DEF_CHARACTERISTIC CWLAMKH LAMFLGSL LAMLGFKT LAMLGFTM LAMLGMKT LAMLGMTM LAMSOSOF LAMSOSUF LASOAB /end DEF_CHARACTERISTIC
 /begin REF_CHARACTERISTIC STM12ESUB /end REF_CHARACTERISTIC
 /begin IN_MEASUREMENT B_bevab B_bevab2 B_dsla B_fa B_falsh B_falsh2 B_fasla B_kh B_lamdkt B_lamdkt2 B_lamka B_lamka2 B_lamkhe B_lamlash B_lamlash2 B_lamnse B_ldeffw B_sls B_slsfz esst_stm12esub flamkh flamsl2_w flamsl_w imlatm lambts2_w lambts_w lamdkt2_w lamdkt_w lamelsh2_w lamelsh_w lamfa_w lamka2_w lamka_w lamkh2_w lamkh_w lamlash2_w lamlash_w lamnswl_w tmot /end IN_MEASUREMENT
 /begin OUT_MEASUREMENT B_lalgf B_lalgf2 B_lamdiag B_lamdiag2 B_lamsdef lambas lamdiag2_w lamdiag_w lamsbg2_w lamsbg_w lamsons2_w lamsons_w lamvoa2_w lamvoa_w /end OUT_MEASUREMENT
 /begin LOC_MEASUREMENT B_lambts B_lambts2 B_lamkh B_lamnswl B_ldef B_ldef2 lamkhe2_w lamkhe_w lamlgfmn lamlgm lams2_w lamsos2_w lamsos_w lamsubg2_w lamsubg_w lams_w /end LOC_MEASUREMENT
 /begin SUB_FUNCTION /end SUB_FUNCTION
/end FUNCTION
/begin FUNCTION LANSWL "Lambda Nachstart / Warmlauf"
 /begin DEF_CHARACTERISTIC ATISLATM ATIWKSTM CWWL DLAMNSWL KFLANS KFLASWLR LASWLTM ZKLANSWL /end DEF_CHARACTERISTIC
 /begin REF_CHARACTERISTIC STM12ESUB STS12ESUB /end REF_CHARACTERISTIC
 /begin IN_MEASUREMENT anztib_w B_lrnda B_lrnda2 B_stendes B_wks esst_stm12esub esst_sts12esub tmot tmst /end IN_MEASUREMENT
 /begin OUT_MEASUREMENT B_lamnse lamnswl_w lamns_w /end OUT_MEASUREMENT
 /begin LOC_MEASUREMENT anztib0_w anztib1_w B_lawlon lamwl_w /end LOC_MEASUREMENT
 /begin SUB_FUNCTION /end SUB_FUNCTION
/end FUNCTION
/begin FUNCTION LBKFGS "Freigabe des Schichtbetriebs durch die LBK" /begin DEF_CHARACTERISTIC FLBE FLBLBK /end DEF_CHARACTERISTIC /begin REF_CHARACTERISTIC /end REF_CHARACTERISTIC /begin IN_MEASUREMENT B_lbkg lbkist_w lbksol_w /end IN_MEASUREMENT /begin OUT_MEASUREMENT B_lbs dlbksi_w flb flb_w /end OUT_MEASUREMENT /begin LOC_MEASUREMENT /end LOC_MEASUREMENT /begin SUB_FUNCTION /end SUB_FUNCTION /end FUNCTION
/begin FUNCTION LBKSOL "Sollwertvorgabe f¸r die Ladungsbewegungsklappe"
 /begin DEF_CHARACTERISTIC CWLBK CWLBKDC FLBSAP FLBSWSTART KFLBKAPP KFLBKHOKHS KFLBKHOMS TDSTFLBS TMOTLBKSOL WLBKSOLFLB /end DEF_CHARACTERISTIC
 /begin REF_CHARACTERISTIC /end REF_CHARACTERISTIC
 /begin IN_MEASUREMENT B_homlbks B_kh B_khlbk B_lbkgrlef B_lbkoflef milsol_w nmot rk_w tmot tnst_w /end IN_MEASUREMENT
 /begin OUT_MEASUREMENT flbkhs_w flbs_w lbksol lbksol_w /end OUT_MEASUREMENT
 /begin LOC_MEASUREMENT B_lbkdenox B_lbksap B_lbksapkf flbskf_w /end LOC_MEASUREMENT
 /begin SUB_FUNCTION /end SUB_FUNCTION
/end FUNCTION
/begin FUNCTION LLRBB "Leerlaufregelung Betriebsbedingungen"
 /begin DEF_CHARACTERISTIC CNFKUPPL DNLLR NLLREIN TVDK TVKUPPL TVLLR TVLLRI TVLLRPD TVLLRSTE VLLR /end DEF_CHARACTERISTIC
 /begin REF_CHARACTERISTIC /end REF_CHARACTERISTIC
 /begin IN_MEASUREMENT B_dash B_fil B_fs B_kuppl B_ll B_mdein B_nllstab B_nmot B_sa B_sab B_stend dmllri_w dn_w gangi mill_w nmot nmotll nmot_w nsol nstat tmot vfzg /end IN_MEASUREMENT
 /begin OUT_MEASUREMENT B_enllri B_ensol B_llr B_llrein B_llri B_llrpd B_nstu B_vllr /end OUT_MEASUREMENT
 /begin LOC_MEASUREMENT /end LOC_MEASUREMENT
 /begin SUB_FUNCTION /end SUB_FUNCTION
/end FUNCTION
/begin FUNCTION LLRMR "Momentenreserve Leerlaufregelung"
 /begin DEF_CHARACTERISTIC CWKUPPL CWLLDE DMRESLL DMRESTM DNLLRESW KFMRES KFMRESK KFMRESKH KFMRESNL KFMRESTA KLDNLLDE KLMRESTM KLMRHO LIVFZDE MRESKH MRESLL MRESSL TDMRESLL TVRESLL TVRESTM VANF /end DEF_CHARACTERISTIC
 /begin REF_CHARACTERISTIC SMI04LLUB SNM06LLUB SNS06LLSB STA04LLUB STM04SAUB /end REF_CHARACTERISTIC
 /begin IN_MEASUREMENT B_kh B_kuppl B_ll B_sl B_st B_stend dmrac dmrlf dmrwan dns dn_w esst_smi04llub esst_snm06llub esst_sns06llsb esst_sta04llub esst_stm04saub fho mifa_w ngfil nmot tans tmot vfzg vstmdr /end IN_MEASUREMENT
 /begin OUT_MEASUREMENT B_llde B_zwafh dmrllr_w dmrnwa_w dmrnwe_w /end OUT_MEASUREMENT
 /begin LOC_MEASUREMENT B_kuplaus dmresll_w dmvllrsu_w /end LOC_MEASUREMENT
 /begin SUB_FUNCTION /end SUB_FUNCTION
/end FUNCTION
/begin FUNCTION LLRNFA "Solldrehzahlanhebung bei Kurztrip"
 /begin DEF_CHARACTERISTIC CWFAN NSLFAA NSLFADY NSLFAEZLA NSLFAKAT NSLFAKRS NSLFALDP NSLFALSF NSLFALSV NSLFASF NSLFASH NSLFASHV NSLFASKNO NSLFASLS NSLFATES NSLFATPE NSLFAWSA NSLFAWSE NSLKVS NSLLSH TNSLFA WFAN /end DEF_CHARACTERISTIC
 /begin REF_CHARACTERISTIC /end REF_CHARACTERISTIC
 /begin IN_MEASUREMENT B_autget B_brems B_faagr B_faan B_faatm B_fadylsu B_faezla B_fakat B_fakrs B_fakvs B_faldp B_falsf B_falsh B_falshv B_falsv B_fanwsa B_fanwse B_fasf B_fash B_faskno B_fasls B_fates B_fs B_ll vfzg wped /end IN_MEASUREMENT
 /begin OUT_MEASUREMENT B_fanfg nslfa /end OUT_MEASUREMENT
 /begin LOC_MEASUREMENT /end LOC_MEASUREMENT
 /begin SUB_FUNCTION /end SUB_FUNCTION
/end FUNCTION
/begin FUNCTION LLRNS "Leerlaufregelung-Solldrehzahl"
 /begin DEF_CHARACTERISTIC BFNSOL BNNSOL CNFLLRNS CWNSTAT DNSNFST DNSNFX DR10VK_T DR10V_T DZA01V_T DZAEHB_T DZAFGV_T DZA_O_MT DZA_U_MT FNSNF FNSSTKM FNSSTM FWVMIN KFZNSM KNSNF LBZO2 LLRNSETP_T NDZAEHB NDZAKLIMA NDZAUB NGNSNF NSFNSOL NSFNSOL1 NSNNSOL NSNNSOL1 NSOLFX NSOLFY NSOLMAX NSOLMIN NSOLMX NSOLNX NSOLNY NSOL_EHRP NSOL_ENRP NSOL_HRP NSOL_NRP NSPLT N_DZA PN10V_T PNNSOL_N SGWTMOT SNS06LLSB UB_DZA VNSOL VNSOL1 VNSOLH ZKNS /end DEF_CHARACTERISTIC
 /begin REF_CHARACTERISTIC STM06LLUB /end REF_CHARACTERISTIC
 /begin IN_MEASUREMENT ACC_ISRD_Mode ACS_410h_MsgLost_DeBnc_Mode B_dknolu B_dkpu B_faan B_fs B_hg B_khn B_ko B_ll B_llrein B_llrst B_nac B_nmin B_nswo1 B_spsmin B_stend Cod_Exh Cod_Func Cod_ModelRange ei_egs_fr esst_stm06llub e_vsig_up fzgtypz gangi KOP_NSOLF KOP_NSOLN lbz ngfil nllkh nmot nmotll nmot_w PNTgtGear_Mode SBC_ISRD_Req tmot tmst tnst_w Trans_OilTempHigh_Mode Trans_RvrsGearMTX_Mode ub Veh_Spd vfzg Whl_Spd_PALeft /end IN_MEASUREMENT
 /begin OUT_MEASUREMENT B_drstat B_dzaakt B_nstakt B_stakt dns esst_sns06llsb nsol nsol_w nsst nstat nstat2 nstat3 nstate nstatfil /end OUT_MEASUREMENT
 /begin LOC_MEASUREMENT B_dzaeakt B_dzaefg B_dzakakt B_dzakfg B_dzauakt B_dzaufg B_novcan B_pn10v B_pnnsolns B_vstat nsnf nsoldza nsolu nsol_dzae nsol_dzaku nsol_tmot nsol_varko nsol_vlfr SBC_IdleSpd_Req tnst v_lfr /end LOC_MEASUREMENT
 /begin SUB_FUNCTION /end SUB_FUNCTION
/end FUNCTION
/begin COMPU_METHOD B_TRUE "boolsche Zust‰nde, positive Logik" TAB_VERB "%6.3" "" COMPU_TAB_REF B_TRUE /end COMPU_METHOD
/begin COMPU_VTAB B_TRUE "boolsche Zust‰nde, positive Logik" TAB_VERB 2 0 "----" 1 "TRUE" /end COMPU_VTAB
/begin COMPU_METHOD dez "1 : 1 Umrechnug (dez/hex)" RAT_FUNC "%6.2" "" COEFFS 0 1 0 0 0 1 /end COMPU_METHOD
/begin COMPU_METHOD fak1_q2p5Em4 "" RAT_FUNC "%6.5" "J/%Ks" COEFFS 0 4000 0 0 0 1 /end COMPU_METHOD
/begin COMPU_METHOD fak_q0p000244 "" RAT_FUNC "%6.5" "-" COEFFS 0 65536 0 0 0 16 /end COMPU_METHOD
/begin COMPU_METHOD fak_q0p00273 "" RAT_FUNC "%6.4" "-" COEFFS 0 256 0 0 0 0.7 /end COMPU_METHOD
/begin COMPU_METHOD fak_sb_b1 "" RAT_FUNC "%6.4" "-" COEFFS 0 256 0 0 0 2 /end COMPU_METHOD
/begin COMPU_METHOD fak_sw_b8 "" RAT_FUNC "%6.5" "-" COEFFS 0 65536 0 0 0 16 /end COMPU_METHOD
/begin COMPU_METHOD fak_ub_b0p5 "" RAT_FUNC "%6.4" "-" COEFFS 0 256 0 0 0 0.5 /end COMPU_METHOD
/begin COMPU_METHOD fak_ub_b1 "" RAT_FUNC "%6.4" "-" COEFFS 0 256 0 0 0 1 /end COMPU_METHOD
/begin COMPU_METHOD fak_ub_b16 "" RAT_FUNC "%6.4" "-" COEFFS 0 256 0 0 0 16 /end COMPU_METHOD
/begin COMPU_METHOD fak_ub_b2 "" RAT_FUNC "%6.4" "-" COEFFS 0 256 0 0 0 2 /end COMPU_METHOD
/begin COMPU_METHOD fak_ub_b4 "" RAT_FUNC "%6.4" "-" COEFFS 0 256 0 0 0 4 /end COMPU_METHOD
/begin COMPU_METHOD fak_uw_b1 "" RAT_FUNC "%7.6" "-" COEFFS 0 65536 0 0 0 1 /end COMPU_METHOD
/begin COMPU_METHOD fak_uw_b16 "" RAT_FUNC "%6.5" "-" COEFFS 0 65536 0 0 0 16 /end COMPU_METHOD
/begin COMPU_METHOD fak_uw_b2 "" RAT_FUNC "%7.6" "-" COEFFS 0 65536 0 0 0 2 /end COMPU_METHOD
/begin COMPU_METHOD fak_uw_b4 "" RAT_FUNC "%7.6" "-" COEFFS 0 65536 0 0 0 4 /end COMPU_METHOD
/begin COMPU_METHOD kw_q1 "" RAT_FUNC "%6.2" "Grad KW" COEFFS 0 1 0 0 0 1 /end COMPU_METHOD
/begin COMPU_METHOD leist_q2 "" RAT_FUNC "%6.2" "W" COEFFS 0 1 0 0 0 2 /end COMPU_METHOD
/begin COMPU_METHOD m_ub_b23p3 "" RAT_FUNC "%6.3" "kg" COEFFS 0 2812.5 0 0 0 256 /end COMPU_METHOD
/begin COMPU_METHOD nmotd_sb_q10 "" RAT_FUNC "%6.1" "1/min" COEFFS 0 1 0 0 0 10 /end COMPU_METHOD
/begin COMPU_METHOD nmotg_sb_q100 "" RAT_FUNC "%6.0" "1/min/s" COEFFS 0 1 0 0 0 100 /end COMPU_METHOD
/begin COMPU_METHOD nmotg_ub_q100 "" RAT_FUNC "%6.0" "1/min/s" COEFFS 0 1 0 0 0 100 /end COMPU_METHOD
/begin COMPU_METHOD nmot_q10 "" RAT_FUNC "%6.1" "1/min" COEFFS 0 1 0 0 0 10 /end COMPU_METHOD
/begin COMPU_METHOD nmot_sw_q0p25 "" RAT_FUNC "%6.3" "1/min" COEFFS 0 1 0 0 0 0.25 /end COMPU_METHOD
/begin COMPU_METHOD nmot_ub_q10 "" RAT_FUNC "%6.1" "1/min" COEFFS 0 1 0 0 0 10 /end COMPU_METHOD
/begin COMPU_METHOD nmot_ub_q40 "" RAT_FUNC "%6.1" "1/min" COEFFS 0 1 0 0 0 40 /end COMPU_METHOD
/begin COMPU_METHOD nmot_uw_q0p25 "" RAT_FUNC "%6.3" "1/min" COEFFS 0 1 0 0 0 0.25 /end COMPU_METHOD
/begin COMPU_METHOD p_uw_q0p039 "" RAT_FUNC "%6.4" "hPa" COEFFS 0 256 0 0 0 10 /end COMPU_METHOD
/begin COMPU_METHOD qci_q0p096 "" RAT_FUNC "%6.3" "J/Ks" COEFFS 0 4000 0 0 0 384 /end COMPU_METHOD
/begin COMPU_METHOD relDK_q0p00152 "" RAT_FUNC "%6.4" "%DK" COEFFS 0 65536 0 0 0 100 /end COMPU_METHOD
/begin COMPU_METHOD relDK_q0p02441 "" RAT_FUNC "%6.4" "%DK" COEFFS 0 65536 0 0 0 1600 /end COMPU_METHOD
/begin COMPU_METHOD relDK_q0p0625 "" RAT_FUNC "%6.4" "%PWM/%DK" COEFFS 0 16 0 0 0 1 /end COMPU_METHOD
/begin COMPU_METHOD relDK_q0p1957 "" RAT_FUNC "%6.3" "%DK" COEFFS 0 511 0 0 0 100 /end COMPU_METHOD
/begin COMPU_METHOD relDK_q1 "" RAT_FUNC "%6.2" "%PWM/%DK" COEFFS 0 1 0 0 0 1 /end COMPU_METHOD
/begin COMPU_METHOD relDK_q4 "" RAT_FUNC "%6.2" "%" COEFFS 0 1 0 0 0 4 /end COMPU_METHOD
/begin COMPU_METHOD relDK_uw_b100 "" RAT_FUNC "%6.4" "%DK" COEFFS 0 65535 0 0 0 100 /end COMPU_METHOD
/begin COMPU_METHOD relPED_ub_b100 "" RAT_FUNC "%6.3" "%PED" COEFFS 0 255 0 0 0 100 /end COMPU_METHOD
/begin COMPU_METHOD rel_q0p1957 "" RAT_FUNC "%6.3" "%" COEFFS 0 511 0 0 0 100 /end COMPU_METHOD
/begin COMPU_METHOD rel_q0p39 "" RAT_FUNC "%6.3" "%" COEFFS 0 256 0 0 0 100 /end COMPU_METHOD
/begin COMPU_METHOD rel_sw_q0p1953 "" RAT_FUNC "%6.3" "%" COEFFS 0 65536 0 0 0 12800 /end COMPU_METHOD
/begin COMPU_METHOD rel_ub_b100 "" RAT_FUNC "%6.3" "%" COEFFS 0 256 0 0 0 100 /end COMPU_METHOD
/begin COMPU_METHOD rel_ub_b127p5 "" RAT_FUNC "%6.3" "%" COEFFS 0 2 0 0 0 1 /end COMPU_METHOD
/begin COMPU_METHOD rel_ub_b24p9 "" RAT_FUNC "%6.3" "%" COEFFS 0 255 0 0 0 24.9 /end COMPU_METHOD
/begin COMPU_METHOD rel_ub_b99p6 "" RAT_FUNC "%6.3" "%" COEFFS 0 256 0 0 0 100 /end COMPU_METHOD
/begin COMPU_METHOD rel_ub_q0p00153 "" RAT_FUNC "%6.4" "%" COEFFS 0 256 0 0 0 0.3906 /end COMPU_METHOD
/begin COMPU_METHOD rel_ub_q0p75 "" RAT_FUNC "%6.3" "%" COEFFS 0 1 0 0 0 0.75 /end COMPU_METHOD
/begin COMPU_METHOD rel_uw_b100 "" RAT_FUNC "%6.4" "%" COEFFS 0 65536 0 0 0 100 /end COMPU_METHOD
/begin COMPU_METHOD rel_uw_b200 "" RAT_FUNC "%6.4" "%" COEFFS 0 65536 0 0 0 200 /end COMPU_METHOD
/begin COMPU_METHOD rel_uw_b3072 "" RAT_FUNC "%6.4" "%" COEFFS 0 65536 0 0 0 3072 /end COMPU_METHOD
/begin COMPU_METHOD rel_uw_q0p0234 "" RAT_FUNC "%6.4" "%" COEFFS 0 32 0 0 0 0.75 /end COMPU_METHOD
/begin COMPU_METHOD spg_q0p00039 "" RAT_FUNC "%6.5" "V" COEFFS 0 1 0 0 0 0.000390625 /end COMPU_METHOD
/begin COMPU_METHOD spg_ubatt "" RAT_FUNC "%6.3" "V" COEFFS 0 1 0 0 0 0.0942 /end COMPU_METHOD
/begin COMPU_METHOD spg_uw_q0p000076 "" RAT_FUNC "%7.6" "V" COEFFS 0 65536 0 0 0 5 /end COMPU_METHOD
/begin COMPU_METHOD spg_uw_q0p001222 "" RAT_FUNC "%6.4" "V" COEFFS 0 1 0 0 0 0.001222 /end COMPU_METHOD
/begin COMPU_METHOD spg_uw_q0p00488 "" RAT_FUNC "%6.4" "V" COEFFS 0 1024 0 0 0 5 /end COMPU_METHOD
/begin COMPU_METHOD t100msxs_ub_b25p5 "" RAT_FUNC "%6.3" "s" COEFFS 0 1 0 0 0 0.1 /end COMPU_METHOD
/begin COMPU_METHOD t100msxs_uw_b6553p5 "" RAT_FUNC "%6.3" "s" COEFFS 0 1 0 0 0 0.1 /end COMPU_METHOD
/begin COMPU_METHOD t10msxs_ub_b2p55 "" RAT_FUNC "%6.4" "s" COEFFS 0 1 0 0 0 0.01 /end COMPU_METHOD
/begin COMPU_METHOD t10msxs_uw_b655p35 "" RAT_FUNC "%6.4" "s" COEFFS 0 1 0 0 0 0.01 /end COMPU_METHOD
/begin COMPU_METHOD t1p0usxms "" RAT_FUNC "%6.5" "ms" COEFFS 0 1000 0 0 0 1 /end COMPU_METHOD
/begin COMPU_METHOD t1sxs_ub_b255 "" RAT_FUNC "%6.2" "s" COEFFS 0 1 0 0 0 1 /end COMPU_METHOD
/begin COMPU_METHOD t200msxs_ub_b51 "" RAT_FUNC "%6.3" "s" COEFFS 0 1 0 0 0 0.2 /end COMPU_METHOD
/begin COMPU_METHOD t20msxs_ub_b5p1 "" RAT_FUNC "%6.4" "s" COEFFS 0 1 0 0 0 0.02 /end COMPU_METHOD
/begin COMPU_METHOD t20msxs_uw_q0p02 "" RAT_FUNC "%6.4" "s" COEFFS 0 1 0 0 0 0.02 /end COMPU_METHOD
/begin COMPU_METHOD t50msxs_q0p05 "" RAT_FUNC "%6.4" "s" COEFFS 0 1 0 0 0 0.05 /end COMPU_METHOD
/begin COMPU_METHOD temp_q0p0234 "" RAT_FUNC "%6.4" "K" COEFFS 0 256 0 0 0 6 /end COMPU_METHOD
/begin COMPU_METHOD temp_q0p0468_K "" RAT_FUNC "%6.4" "Grad K" COEFFS 0 256 0 0 0 12 /end COMPU_METHOD
/begin COMPU_METHOD temp_ub_q0p75_o48 "" RAT_FUNC "%6.2" "Grad C" COEFFS 0 1 48 0 0 0.75 /end COMPU_METHOD
/begin COMPU_METHOD temp_uw_q0p0195 "" RAT_FUNC "%6.4" "Grad C" COEFFS 0 256 0 0 0 5 /end COMPU_METHOD
/begin COMPU_METHOD temp_uw_q0p0195_o50 "" RAT_FUNC "%6.2" "Grad C" COEFFS 0 256 12800 0 0 5 /end COMPU_METHOD
/begin COMPU_METHOD t_q0p1 "" RAT_FUNC "%6.3" "s" COEFFS 0 10 0 0 0 1 /end COMPU_METHOD
/begin COMPU_METHOD vfzg_q0p25 "" RAT_FUNC "%6.3" "km/h" COEFFS 0 4 0 0 0 1 /end COMPU_METHOD
/begin COMPU_METHOD vfzg_ub_q1p25 "" RAT_FUNC "%6.2" "km/h" COEFFS 0 1 0 0 0 1.25 /end COMPU_METHOD
/begin COMPU_METHOD vnstv_q0p01 "" RAT_FUNC "%7.5" "%" COEFFS 0 100 0 0 0 1 /end COMPU_METHOD
/begin COMPU_METHOD zk100msxs_ub_b25p5 "" RAT_FUNC "%6.3" "s" COEFFS 0 0 256 0 10 0 /end COMPU_METHOD
/begin COMPU_METHOD zk100msxs_uw_b6553 "" RAT_FUNC "%10.3" "s" COEFFS 0 0 65536 0 10 0 /end COMPU_METHOD
/begin COMPU_METHOD zk10msxs_uw_b655 "" RAT_FUNC "%10.4" "s" COEFFS 0 0 65536 0 100 0 /end COMPU_METHOD
/begin COMPU_METHOD zk20msxs_ub_b5p1 "" RAT_FUNC "%6.4" "s" COEFFS 0 0 5.1 0 1 0 /end COMPU_METHOD
/begin COMPU_METHOD zk20msxs_ub_b5p12 "" RAT_FUNC "%6.4" "s" COEFFS 0 0 256 0 50 0 /end COMPU_METHOD
/begin COMPU_METHOD zw_sb_q0p75 "" RAT_FUNC "%6.3" "Grad KW" COEFFS 0 255 0 0 0 191.25 /end COMPU_METHOD
/begin COMPU_METHOD zw_ub_q0p75 "" RAT_FUNC "%6.3" "Grad KW" COEFFS 0 255 0 0 0 191.25 /end COMPU_METHOD
/begin COMPU_METHOD zw_ub_qn0p75 "" RAT_FUNC "%6.4" "Grad KW" COEFFS 0 1 0 0 0 -0.75 /end COMPU_METHOD
/begin RECORD_LAYOUT GkfWSb FNC_VALUES 1 SBYTE COLUMN_DIR DIRECT /end RECORD_LAYOUT
/begin RECORD_LAYOUT GkfWUb FNC_VALUES 1 UBYTE COLUMN_DIR DIRECT /end RECORD_LAYOUT
/begin RECORD_LAYOUT GklWS8 FNC_VALUES 1 SBYTE COLUMN_DIR DIRECT /end RECORD_LAYOUT
/begin RECORD_LAYOUT GklWSb FNC_VALUES 1 SBYTE COLUMN_DIR DIRECT /end RECORD_LAYOUT
/begin RECORD_LAYOUT GklWU16 FNC_VALUES 1 UWORD COLUMN_DIR DIRECT /end RECORD_LAYOUT
/begin RECORD_LAYOUT GklWU8 FNC_VALUES 1 UBYTE COLUMN_DIR DIRECT /end RECORD_LAYOUT
/begin RECORD_LAYOUT GklWUb FNC_VALUES 1 UBYTE COLUMN_DIR DIRECT /end RECORD_LAYOUT
/begin RECORD_LAYOUT GklWUw FNC_VALUES 1 UWORD COLUMN_DIR DIRECT /end RECORD_LAYOUT
/begin RECORD_LAYOUT KfAxU8AyU8SstxU16SstyU16WU16 NO_AXIS_PTS_X 1 UWORD NO_AXIS_PTS_Y 2 UWORD AXIS_PTS_X 3 UWORD INDEX_INCR DIRECT AXIS_PTS_Y 4 UWORD INDEX_INCR DIRECT FNC_VALUES 5 UWORD COLUMN_DIR DIRECT /end RECORD_LAYOUT
/begin RECORD_LAYOUT KfAxU8AyU8SstxU8SstyU16WU16 NO_AXIS_PTS_X 1 UBYTE NO_AXIS_PTS_Y 2 UBYTE AXIS_PTS_X 3 UBYTE INDEX_INCR DIRECT AXIS_PTS_Y 4 UWORD INDEX_INCR DIRECT FNC_VALUES 5 UWORD COLUMN_DIR DIRECT /end RECORD_LAYOUT
/begin RECORD_LAYOUT KfAxU8AyU8SstxU8SstyU16WU8 NO_AXIS_PTS_X 1 UBYTE NO_AXIS_PTS_Y 2 UBYTE AXIS_PTS_X 3 UBYTE INDEX_INCR DIRECT AXIS_PTS_Y 4 UWORD INDEX_INCR DIRECT FNC_VALUES 5 UBYTE COLUMN_DIR DIRECT /end RECORD_LAYOUT
/begin RECORD_LAYOUT KfAxU8AyU8SstxU8SstyU8WS8 NO_AXIS_PTS_X 1 UBYTE NO_AXIS_PTS_Y 2 UBYTE AXIS_PTS_X 3 UBYTE INDEX_INCR DIRECT AXIS_PTS_Y 4 UBYTE INDEX_INCR DIRECT FNC_VALUES 5 SBYTE COLUMN_DIR DIRECT /end RECORD_LAYOUT
/begin RECORD_LAYOUT KfAxUbAyUbSstxUbSstyUbWSb NO_AXIS_PTS_X 1 UBYTE NO_AXIS_PTS_Y 2 UBYTE AXIS_PTS_X 3 UBYTE INDEX_INCR DIRECT AXIS_PTS_Y 4 UBYTE INDEX_INCR DIRECT FNC_VALUES 5 SBYTE COLUMN_DIR DIRECT /end RECORD_LAYOUT
/begin RECORD_LAYOUT KfAxUbAyUbSstxUbSstyUwWUb NO_AXIS_PTS_X 1 UBYTE NO_AXIS_PTS_Y 2 UBYTE AXIS_PTS_X 3 UBYTE INDEX_INCR DIRECT AXIS_PTS_Y 4 UWORD INDEX_INCR DIRECT FNC_VALUES 5 UBYTE COLUMN_DIR DIRECT /end RECORD_LAYOUT
/begin RECORD_LAYOUT KfAxUbAyUbSstxUbSstyUwWUw NO_AXIS_PTS_X 1 UBYTE NO_AXIS_PTS_Y 2 UBYTE AXIS_PTS_X 3 UBYTE INDEX_INCR DIRECT AXIS_PTS_Y 4 UWORD INDEX_INCR DIRECT FNC_VALUES 5 UWORD COLUMN_DIR DIRECT /end RECORD_LAYOUT
/begin RECORD_LAYOUT KfAxUbAyUbSstxUwSstyUbWUb NO_AXIS_PTS_X 1 UBYTE NO_AXIS_PTS_Y 2 UBYTE AXIS_PTS_X 3 UWORD INDEX_INCR DIRECT AXIS_PTS_Y 4 UBYTE INDEX_INCR DIRECT FNC_VALUES 5 UBYTE COLUMN_DIR DIRECT /end RECORD_LAYOUT
/begin RECORD_LAYOUT KlAUbSstSbWSb NO_AXIS_PTS_X 1 UBYTE AXIS_PTS_X 2 SBYTE INDEX_INCR DIRECT FNC_VALUES 3 SBYTE COLUMN_DIR DIRECT /end RECORD_LAYOUT
/begin RECORD_LAYOUT KlAUbSstUbWSb NO_AXIS_PTS_X 1 UBYTE AXIS_PTS_X 2 UBYTE INDEX_INCR DIRECT FNC_VALUES 3 SBYTE COLUMN_DIR DIRECT /end RECORD_LAYOUT
/begin RECORD_LAYOUT KlAUbSstUbWUb NO_AXIS_PTS_X 1 UBYTE AXIS_PTS_X 2 UBYTE INDEX_INCR DIRECT FNC_VALUES 3 UBYTE COLUMN_DIR DIRECT /end RECORD_LAYOUT
/begin RECORD_LAYOUT KlAUwSstUwWUw NO_AXIS_PTS_X 1 UWORD AXIS_PTS_X 2 UWORD INDEX_INCR DIRECT FNC_VALUES 3 UWORD COLUMN_DIR DIRECT /end RECORD_LAYOUT
/begin RECORD_LAYOUT KlAxU8SstxU16WU16 NO_AXIS_PTS_X 1 UWORD AXIS_PTS_X 2 UWORD INDEX_INCR DIRECT FNC_VALUES 3 UWORD COLUMN_DIR DIRECT /end RECORD_LAYOUT
/begin RECORD_LAYOUT KlAxU8SstxU8WU16 NO_AXIS_PTS_X 1 UBYTE AXIS_PTS_X 2 UBYTE INDEX_INCR DIRECT FNC_VALUES 3 UWORD COLUMN_DIR DIRECT /end RECORD_LAYOUT
/begin RECORD_LAYOUT KlAxU8SstxU8WU8 NO_AXIS_PTS_X 1 UBYTE AXIS_PTS_X 2 UBYTE INDEX_INCR DIRECT FNC_VALUES 3 UBYTE COLUMN_DIR DIRECT /end RECORD_LAYOUT
/begin RECORD_LAYOUT KwbUb FNC_VALUES 1 UBYTE COLUMN_DIR DIRECT /end RECORD_LAYOUT
/begin RECORD_LAYOUT KwbWS8 FNC_VALUES 1 SBYTE COLUMN_DIR DIRECT /end RECORD_LAYOUT
/begin RECORD_LAYOUT KwbWU8 FNC_VALUES 1 UBYTE COLUMN_DIR DIRECT /end RECORD_LAYOUT
/begin RECORD_LAYOUT KwSw FNC_VALUES 1 SWORD COLUMN_DIR DIRECT /end RECORD_LAYOUT
/begin RECORD_LAYOUT KwUb FNC_VALUES 1 UBYTE COLUMN_DIR DIRECT /end RECORD_LAYOUT
/begin RECORD_LAYOUT KwUw FNC_VALUES 1 UWORD COLUMN_DIR DIRECT /end RECORD_LAYOUT
/begin RECORD_LAYOUT KwWS8 FNC_VALUES 1 SBYTE COLUMN_DIR DIRECT /end RECORD_LAYOUT
/begin RECORD_LAYOUT KwWU16 FNC_VALUES 1 UWORD COLUMN_DIR DIRECT /end RECORD_LAYOUT
/begin RECORD_LAYOUT KwWU8 FNC_VALUES 1 UBYTE COLUMN_DIR DIRECT /end RECORD_LAYOUT
/begin RECORD_LAYOUT SstAUbSstSb NO_AXIS_PTS_X 1 UBYTE AXIS_PTS_X 2 SBYTE INDEX_INCR DIRECT /end RECORD_LAYOUT
/begin RECORD_LAYOUT SstAUbSstUb NO_AXIS_PTS_X 1 UBYTE AXIS_PTS_X 2 UBYTE INDEX_INCR DIRECT /end RECORD_LAYOUT
/begin RECORD_LAYOUT SstAUwSstUw NO_AXIS_PTS_X 1 UWORD AXIS_PTS_X 2 UWORD INDEX_INCR DIRECT /end RECORD_LAYOUT
/end MODULE
/end PROJECT
