ASAP2_VERSION 1 3
/begin PROJECT _9702_071D00 "ME97"
/begin HEADER "" VERSION "_9702_071D00" PROJECT_NO _9702_071D00 /end HEADER
/begin MODULE DIM ""
/begin MOD_COMMON "" BYTE_ORDER MSB_FIRST ALIGNMENT_BYTE 1 ALIGNMENT_WORD 2 ALIGNMENT_LONG 2 ALIGNMENT_FLOAT32_IEEE 4 /end MOD_COMMON
/begin CHARACTERISTIC CDCANWSE "Codewort CARB: Auslaﬂnockenwelle- Endstufe" VAL_BLK 0x1D36CE KwbWU16 65535.00 dez 0.00 65535.00 FORMAT "%8.2" NUMBER 4 /end CHARACTERISTIC
/begin CHARACTERISTIC CDCANWSE2 "Codewort CARB: Auslaﬂnockenwelle- Endstufe Bank2" VAL_BLK 0x1D36D6 KwbWU16 65535.00 dez 0.00 65535.00 FORMAT "%8.2" NUMBER 4 /end CHARACTERISTIC
/begin CHARACTERISTIC CDCDSU "Codewort CARB: Drucksensor Umgebung" VAL_BLK 0x1D37BE KwbWU16 65535.00 dez 0.00 65535.00 FORMAT "%8.2" NUMBER 4 /end CHARACTERISTIC
/begin CHARACTERISTIC CDCEGFE "Codewort CARB: Lasterfassung" VAL_BLK 0x1D381E KwbUw 65535.00 dez 0.00 65535.00 FORMAT "%8.2" NUMBER 4 /end CHARACTERISTIC
/begin CHARACTERISTIC CDCEHB_EnvCond "" VAL_BLK 0x1D3826 KwbUw 65535.00 dez 0.00 65535.00 FORMAT "%8.2" NUMBER 4 /end CHARACTERISTIC
/begin CHARACTERISTIC CDCEHB_Par "" VAL_BLK 0x1D382E KwbUw 65535.00 dez 0.00 65535.00 FORMAT "%8.2" NUMBER 4 /end CHARACTERISTIC
/begin CHARACTERISTIC CDCEHB_Tgl "" VAL_BLK 0x1D3836 KwbUw 65535.00 dez 0.00 65535.00 FORMAT "%8.2" NUMBER 4 /end CHARACTERISTIC
/begin CHARACTERISTIC CDCENWSE "Codewort CARB: Einlaﬂnockenwelle- Endstufe" VAL_BLK 0x1D384E KwbWU16 65535.00 dez 0.00 65535.00 FORMAT "%8.2" NUMBER 4 /end CHARACTERISTIC
/begin CHARACTERISTIC CDCENWSE2 "Codewort CARB: Einlaﬂnockenwelle- Endstufe" VAL_BLK 0x1D3856 KwbWU16 65535.00 dez 0.00 65535.00 FORMAT "%8.2" NUMBER 4 /end CHARACTERISTIC
/begin CHARACTERISTIC CDCESP_Par "" VAL_BLK 0x1D385E KwbUw 65535.00 dez 0.00 65535.00 FORMAT "%8.2" NUMBER 4 /end CHARACTERISTIC
/begin CHARACTERISTIC CDCESP_Stat "" VAL_BLK 0x1D3866 KwbUw 65535.00 dez 0.00 65535.00 FORMAT "%8.2" NUMBER 4 /end CHARACTERISTIC
/begin CHARACTERISTIC CDCESP_Tgl "" VAL_BLK 0x1D386E KwbUw 65535.00 dez 0.00 65535.00 FORMAT "%8.2" NUMBER 4 /end CHARACTERISTIC
/begin CHARACTERISTIC CDCESP_TrqReq "" VAL_BLK 0x1D3876 KwbUw 65535.00 dez 0.00 65535.00 FORMAT "%8.2" NUMBER 4 /end CHARACTERISTIC
/begin CHARACTERISTIC CDCLM "Codewort CARB:	LMM/HLM/HFM" VAL_BLK 0x1D3A1E KwbUw 65535.00 dez 0.00 65535.00 FORMAT "%8.2" NUMBER 4 /end CHARACTERISTIC
/begin CHARACTERISTIC CDCLZSR "" VAL_BLK 0x1D3A9E KwbUw 65535.00 dez 0.00 65535.00 FORMAT "%8.2" NUMBER 4 /end CHARACTERISTIC
/begin CHARACTERISTIC CDCMDB "Codewort CARB: Momentbegrenzung Sollmoment" VAL_BLK 0x1D3B0E KwbUw 65535.00 dez 0.00 65535.00 FORMAT "%8.2" NUMBER 4 /end CHARACTERISTIC
/begin CHARACTERISTIC CDCPAC "Codewort CARB:	Druck in Klimasystem" VAL_BLK 0x1D3B76 KwbUw 65535.00 dez 0.00 65535.00 FORMAT "%8.2" NUMBER 4 /end CHARACTERISTIC
/begin CHARACTERISTIC CDCPH "Codewort CARB: Phasensensor" VAL_BLK 0x1D3B86 KwbWU16 65535.00 DEZ 0.00 65535.00 FORMAT "%8.2" NUMBER 4 /end CHARACTERISTIC
/begin CHARACTERISTIC CDCPH2 "Codewort CARB: Phasensensor Bank 2" VAL_BLK 0x1D3B8E KwbWU16 65535.00 DEZ 0.00 65535.00 FORMAT "%8.2" NUMBER 4 /end CHARACTERISTIC
/begin CHARACTERISTIC CDCPH3 "Codewort CARB: Phasensensor 3" VAL_BLK 0x1D3B96 KwbWU16 65535.00 DEZ 0.00 65535.00 FORMAT "%8.2" NUMBER 4 /end CHARACTERISTIC
/begin CHARACTERISTIC CDCPH4 "Codewort CARB: Phasensensor 4" VAL_BLK 0x1D3B9E KwbWU16 65535.00 DEZ 0.00 65535.00 FORMAT "%8.2" NUMBER 4 /end CHARACTERISTIC
/begin CHARACTERISTIC CDCPHM "Codewort CARB: Phasensensor MIL" VAL_BLK 0x1D3BA6 KwbWU16 65535.00 DEZ 0.00 65535.00 FORMAT "%8.2" NUMBER 4 /end CHARACTERISTIC
/begin CHARACTERISTIC CDCPN "Codewort CARB: P/N-Schalter" VAL_BLK 0x1D3BAE KwbUw 65535.00 dez 0.00 65535.00 FORMAT "%8.2" NUMBER 4 /end CHARACTERISTIC
/begin CHARACTERISTIC CDCSLS "Codewort CARB: Sekund‰rluft-System" VAL_BLK 0x1D3BEE KwbWU16 65535.00 dez 0.00 65535.00 FORMAT "%8.2" NUMBER 4 /end CHARACTERISTIC
/begin CHARACTERISTIC CDCSLS2 "Codewort CARB: Sekund‰rluft-System Bank 2" VAL_BLK 0x1D3BF6 KwbWU16 65535.00 dez 0.00 65535.00 FORMAT "%8.2" NUMBER 4 /end CHARACTERISTIC
/begin CHARACTERISTIC CDCSLV "Codewort CARB: Sekund‰rluftventil" VAL_BLK 0x1D3BFE KwbWU16 65535.00 dez 0.00 65535.00 FORMAT "%8.2" NUMBER 4 /end CHARACTERISTIC
/begin CHARACTERISTIC CDCSLV2 "Codewort CARB: Sekund‰rluftventil, Bank 2" VAL_BLK 0x1D3C06 KwbWU16 65535.00 dez 0.00 65535.00 FORMAT "%8.2" NUMBER 4 /end CHARACTERISTIC
/begin CHARACTERISTIC CDCTA "Codewort CARB: TANS" VAL_BLK 0x1D3C36 KwbUw 65535.00 dez 0.00 65535.00 FORMAT "%8.2" NUMBER 4 /end CHARACTERISTIC
/begin CHARACTERISTIC CDCTES "Codewort CARB: Tankentl¸ftungssystem" VAL_BLK 0x1D3C56 KwbUw 65535.00 dez 0.00 65535.00 FORMAT "%8.2" NUMBER 4 /end CHARACTERISTIC
/begin CHARACTERISTIC CDCTEVE "Codewort CARB:	Tankentl¸ftungsventil Endstufe" VAL_BLK 0x1D3C66 KwbWU16 65535.00 dez 0.00 65535.00 FORMAT "%8.2" NUMBER 4 /end CHARACTERISTIC
/begin CHARACTERISTIC CDCTHM "Codewort CARB: Thermostat-Diagnose THM" VAL_BLK 0x1D3C6E KwbUw 65535.00 dez 0.00 65535.00 FORMAT "%8.2" NUMBER 4 /end CHARACTERISTIC
/begin CHARACTERISTIC CDCTKA "Codewort CARB: Temperatur K¸hlerausgang" VAL_BLK 0x1D3C76 KwbUw 65535.00 dez 0.00 65535.00 FORMAT "%8.2" NUMBER 4 /end CHARACTERISTIC
/begin CHARACTERISTIC CDCTM "Codewort CARB: Motortemperatur TMOT" VAL_BLK 0x1D3C7E KwbUw 65535.00 dez 0.00 65535.00 FORMAT "%8.2" NUMBER 4 /end CHARACTERISTIC
/begin CHARACTERISTIC CDCTOL "Codewort CARB: ÷ltemperatur" VAL_BLK 0x1D3C8E KwbUw 65535.00 dez 0.00 65535.00 FORMAT "%8.2" NUMBER 4 /end CHARACTERISTIC
/begin CHARACTERISTIC CDCUB "Codewort CARB: Batteriespannung UB (Bordnetz)" VAL_BLK 0x1D3CA6 KwbWU16 65535.00 dez 0.00 65535.00 FORMAT "%8.2" NUMBER 4 /end CHARACTERISTIC
/begin CHARACTERISTIC CDCUFMV "Codewort CARB: Funktions¸berwachung: Momentenvergleich" VAL_BLK 0x1D3CAE KwbUw 65535.00 dez 0.00 65535.00 FORMAT "%8.2" NUMBER 4 /end CHARACTERISTIC
/begin CHARACTERISTIC CDCUFNC "Codewort CARB: Funktions¸berwachung: Drehzahlgeber-, Zuleitung- oder SG-Fehler" VAL_BLK 0x1D3CB6 KwbUw 65535.00 dez 0.00 65535.00 FORMAT "%8.2" NUMBER 4 /end CHARACTERISTIC
/begin CHARACTERISTIC CDCUFRLIP "Codewort CARB: Funktions¸berwachung: Lastsensor-, Zuleitung- oder SG-Fehler" VAL_BLK 0x1D3CBE KwbUw 65535.00 dez 0.00 65535.00 FORMAT "%8.2" NUMBER 4 /end CHARACTERISTIC
/begin CHARACTERISTIC CDCUFSGA "Codewort CARB: Funktions¸berwachung: Steuerger‰te-Fehler Gruppe a" VAL_BLK 0x1D3CC6 KwbUw 65535.00 dez 0.00 65535.00 FORMAT "%8.2" NUMBER 4 /end CHARACTERISTIC
/begin CHARACTERISTIC CDCUFSGB "Codewort CARB: Funktions¸berwachung: Steuerger‰te-Fehler Gruppe b" VAL_BLK 0x1D3CCE KwbUw 65535.00 dez 0.00 65535.00 FORMAT "%8.2" NUMBER 4 /end CHARACTERISTIC
/begin CHARACTERISTIC CDCUFSGC "Codewort CARB: Funktions¸berwachung: Steuerger‰te-Fehler Gruppe c" VAL_BLK 0x1D3CD6 KwbUw 65535.00 dez 0.00 65535.00 FORMAT "%8.2" NUMBER 4 /end CHARACTERISTIC
/begin CHARACTERISTIC CDCUFSPSC "Codewort CARB: Funktions¸berwachung: Pedalwertgeber-, Zuleitung- oder SG-Fehler" VAL_BLK 0x1D3CDE KwbUw 65535.00 dez 0.00 65535.00 FORMAT "%8.2" NUMBER 4 /end CHARACTERISTIC
/begin CHARACTERISTIC CDCURRAM "Codewort CARB: Rechner¸berwachung: RAM" VAL_BLK 0x1D3CE6 KwbUw 65535.00 dez 0.00 65535.00 FORMAT "%8.2" NUMBER 4 /end CHARACTERISTIC
/begin CHARACTERISTIC CDCURROM "Codewort CARB: Rechner¸berwachung: ROM" VAL_BLK 0x1D3CEE KwbUw 65535.00 dez 0.00 65535.00 FORMAT "%8.2" NUMBER 4 /end CHARACTERISTIC
/begin CHARACTERISTIC CDCURRST "Codewort CARB: Rechner¸berwachung: Reset" VAL_BLK 0x1D3CF6 KwbUw 65535.00 dez 0.00 65535.00 FORMAT "%8.2" NUMBER 4 /end CHARACTERISTIC
/begin CHARACTERISTIC CDKANWSE "Codewort Kunde:Auslaﬂnockenwelle- Endstufe" VALUE 0x1D3D48 KwWU16 65535.00 dez 0.00 65535.00 FORMAT "%8.2" /end CHARACTERISTIC
/begin CHARACTERISTIC CDKANWSE2 "Codewort Kunde:Auslaﬂnockenwelle- Endstufe Bank2" VALUE 0x1D3D4A KwWU16 65535.00 dez 0.00 65535.00 FORMAT "%8.2" /end CHARACTERISTIC
/begin CHARACTERISTIC CDKDSU "Codewort Kunde: Drucksensor Umgebung" VALUE 0x1D3D84 KwWU16 65535.00 dez 0.00 65535.00 FORMAT "%8.2" /end CHARACTERISTIC
/begin CHARACTERISTIC CDKEGFE "Codewort Kunde: Lasterfassung" VALUE 0x1D3D9C KwUw 65535.00 dez 0.00 65535.00 FORMAT "%8.2" /end CHARACTERISTIC
/begin CHARACTERISTIC CDKEHB_EnvCond "" VALUE 0x1D3D9E KwUw 65535.00 dez 0.00 65535.00 FORMAT "%8.2" /end CHARACTERISTIC
/begin CHARACTERISTIC CDKEHB_Par "" VALUE 0x1D3DA0 KwUw 65535.00 dez 0.00 65535.00 FORMAT "%8.2" /end CHARACTERISTIC
/begin CHARACTERISTIC CDKEHB_Tgl "" VALUE 0x1D3DA2 KwUw 65535.00 dez 0.00 65535.00 FORMAT "%8.2" /end CHARACTERISTIC
/begin CHARACTERISTIC CDKENWSE "Codewort Kunde: Einlaﬂnockenwelle- Endstufe" VALUE 0x1D3DA8 KwWU16 65535.00 dez 0.00 65535.00 FORMAT "%8.2" /end CHARACTERISTIC
/begin CHARACTERISTIC CDKENWSE2 "Codewort Kunde: Einlaﬂnockenwelle- Endstufe Bank2" VALUE 0x1D3DAA KwWU16 65535.00 dez 0.00 65535.00 FORMAT "%8.2" /end CHARACTERISTIC
/begin CHARACTERISTIC CDKESP_Par "" VALUE 0x1D3DAC KwUw 65535.00 dez 0.00 65535.00 FORMAT "%8.2" /end CHARACTERISTIC
/begin CHARACTERISTIC CDKESP_Stat "" VALUE 0x1D3DAE KwUw 65535.00 dez 0.00 65535.00 FORMAT "%8.2" /end CHARACTERISTIC
/begin CHARACTERISTIC CDKESP_Tgl "" VALUE 0x1D3DB0 KwUw 65535.00 dez 0.00 65535.00 FORMAT "%8.2" /end CHARACTERISTIC
/begin CHARACTERISTIC CDKESP_TrqReq "" VALUE 0x1D3DB2 KwUw 65535.00 dez 0.00 65535.00 FORMAT "%8.2" /end CHARACTERISTIC
/begin CHARACTERISTIC CDKLM "Codewort Kunde:	LMM/HLM/HFM" VALUE 0x1D3E1C KwUw 65535.00 dez 0.00 65535.00 FORMAT "%8.2" /end CHARACTERISTIC
/begin CHARACTERISTIC CDKLZSR "" VALUE 0x1D3E3C KwUw 65535.00 dez 0.00 65535.00 FORMAT "%8.2" /end CHARACTERISTIC
/begin CHARACTERISTIC CDKMDB "Codewort Kunde: Momentbegrenzung Sollmoment" VALUE 0x1D3E58 KwUw 65535.00 dez 0.00 65535.00 FORMAT "%8.2" /end CHARACTERISTIC
/begin CHARACTERISTIC CDKPAC "Codewort Kunde:	Druck in Klimasystem" VALUE 0x1D3E72 KwUw 65535.00 dez 0.00 65535.00 FORMAT "%8.2" /end CHARACTERISTIC
/begin CHARACTERISTIC CDKPH "Codewort Kunde: Phasensensor" VALUE 0x1D3E76 KwWU16 65535.00 DEZ 0.00 65535.00 FORMAT "%8.2" /end CHARACTERISTIC
/begin CHARACTERISTIC CDKPH2 "Codewort Kunde: Phasensensor 2" VALUE 0x1D3E78 KwWU16 65535.00 DEZ 0.00 65535.00 FORMAT "%8.2" /end CHARACTERISTIC
/begin CHARACTERISTIC CDKPH3 "Codewort Kunde: Phasensensor 3" VALUE 0x1D3E7A KwWU16 65535.00 DEZ 0.00 65535.00 FORMAT "%8.2" /end CHARACTERISTIC
/begin CHARACTERISTIC CDKPH4 "Codewort Kunde: Phasensensor 4" VALUE 0x1D3E7C KwWU16 65535.00 DEZ 0.00 65535.00 FORMAT "%8.2" /end CHARACTERISTIC
/begin CHARACTERISTIC CDKPHM "Codewort Kunde: Phasensensor MIL" VALUE 0x1D3E7E KwWU16 65535.00 DEZ 0.00 65535.00 FORMAT "%8.2" /end CHARACTERISTIC
/begin CHARACTERISTIC CDKPN "Codewort Kunde: P/N-Schalter" VALUE 0x1D3E80 KwUw 65535.00 dez 0.00 65535.00 FORMAT "%8.2" /end CHARACTERISTIC
/begin CHARACTERISTIC CDKSLS "Codewort Kunde: Sekund‰rluft-System" VALUE 0x1D3E90 KwWU16 65535.00 dez 0.00 65535.00 FORMAT "%8.2" /end CHARACTERISTIC
/begin CHARACTERISTIC CDKSLS2 "Codewort Kunde: Sekund‰rluft-System Bank 2" VALUE 0x1D3E92 KwWU16 65535.00 dez 0.00 65535.00 FORMAT "%8.2" /end CHARACTERISTIC
/begin CHARACTERISTIC CDKSLV "Codewort Kunde:	Sekund‰rluftventil" VALUE 0x1D3E94 KwWU16 65535.00 dez 0.00 65535.00 FORMAT "%8.2" /end CHARACTERISTIC
/begin CHARACTERISTIC CDKSLV2 "Codewort Kunde: Sekund‰rluftventil Bank 2" VALUE 0x1D3E96 KwWU16 65535.00 dez 0.00 65535.00 FORMAT "%8.2" /end CHARACTERISTIC
/begin CHARACTERISTIC CDKTA "Codewort Kunde:	TANS" VALUE 0x1D3EA2 KwUw 65535.00 dez 0.00 65535.00 FORMAT "%8.2" /end CHARACTERISTIC
/begin CHARACTERISTIC CDKTES "Codewort Kunde: Tankentl¸ftungssystem" VALUE 0x1D3EAA KwUw 65535.00 dez 0.00 65535.00 FORMAT "%8.2" /end CHARACTERISTIC
/begin CHARACTERISTIC CDKTEVE "Codewort Kunde:	Tankentl¸ftungsventil Endstufe" VALUE 0x1D3EAE KwWU16 65535.00 dez 0.00 65535.00 FORMAT "%8.2" /end CHARACTERISTIC
/begin CHARACTERISTIC CDKTHM "Codewort Kunde: Thermostat-Diagnose THM" VALUE 0x1D3EB0 KwUw 65535.00 dez 0.00 65535.00 FORMAT "%8.2" /end CHARACTERISTIC
/begin CHARACTERISTIC CDKTKA "Codewort Kunde: Temperatur am K¸hlerausgang" VALUE 0x1D3EB2 KwUw 65535.00 dez 0.00 65535.00 FORMAT "%8.2" /end CHARACTERISTIC
/begin CHARACTERISTIC CDKTM "Codewort Kunde: TMOT" VALUE 0x1D3EB4 KwUw 65535.00 dez 0.00 65535.00 FORMAT "%8.2" /end CHARACTERISTIC
/begin CHARACTERISTIC CDKTOL "Codewort Kunde: ÷ltemperatur" VALUE 0x1D3EB8 KwUw 65535.00 dez 0.00 65535.00 FORMAT "%8.2" /end CHARACTERISTIC
/begin CHARACTERISTIC CDKUB "Codewort Kunde:	UB" VALUE 0x1D3EBE KwWU16 65535.00 dez 0.00 65535.00 FORMAT "%8.2" /end CHARACTERISTIC
/begin CHARACTERISTIC CDKUFMV "Codewort Kunde: Funktions¸berwachung: Momentenvergleich" VALUE 0x1D3EC0 KwUw 65535.00 dez 0.00 65535.00 FORMAT "%8.2" /end CHARACTERISTIC
/begin CHARACTERISTIC CDKUFNC "Codewort Kunde: Funktions¸berwachung: Drehzahlgeber-, Zuleitung- oder SG-Fehler" VALUE 0x1D3EC2 KwUw 65535.00 dez 0.00 65535.00 FORMAT "%8.2" /end CHARACTERISTIC
/begin CHARACTERISTIC CDKUFRLIP "Codewort Kunde: Funktions¸berwachung: Lastsensor-, Zuleitung- oder SG-Fehler" VALUE 0x1D3EC4 KwUw 65535.00 dez 0.00 65535.00 FORMAT "%8.2" /end CHARACTERISTIC
/begin CHARACTERISTIC CDKUFSGA "Codewort Kunde: Funktions¸berwachung: Steuerger‰te-Fehler Gruppe a" VALUE 0x1D3EC6 KwUw 65535.00 dez 0.00 65535.00 FORMAT "%8.2" /end CHARACTERISTIC
/begin CHARACTERISTIC CDKUFSGB "Codewort Kunde: Funktions¸berwachung: Steuerger‰te-Fehler Gruppe b" VALUE 0x1D3EC8 KwUw 65535.00 dez 0.00 65535.00 FORMAT "%8.2" /end CHARACTERISTIC
/begin CHARACTERISTIC CDKUFSGC "Codewort Kunde: Funktions¸berwachung: Steuerger‰te-Fehler Gruppe c" VALUE 0x1D3ECA KwUw 65535.00 dez 0.00 65535.00 FORMAT "%8.2" /end CHARACTERISTIC
/begin CHARACTERISTIC CDKUFSPSC "Codewort Kunde: Funktions¸berwachung: Pedalwertgeber-, Zuleitung- oder SG-Fehler" VALUE 0x1D3ECC KwUw 65535.00 dez 0.00 65535.00 FORMAT "%8.2" /end CHARACTERISTIC
/begin CHARACTERISTIC CDKURRAM "Codewort Kunde: Rechner¸berwachung: RAM" VALUE 0x1D3ECE KwUw 65535.00 dez 0.00 65535.00 FORMAT "%8.2" /end CHARACTERISTIC
/begin CHARACTERISTIC CDKURROM "Codewort Kunde: Rechner¸berwachung: ROM" VALUE 0x1D3ED0 KwUw 65535.00 dez 0.00 65535.00 FORMAT "%8.2" /end CHARACTERISTIC
/begin CHARACTERISTIC CDKURRST "Codewort Kunde: Rechner¸berwachung: Reset" VALUE 0x1D3ED2 KwUw 65535.00 dez 0.00 65535.00 FORMAT "%8.2" /end CHARACTERISTIC
/begin CHARACTERISTIC CDTANWSE "Codewort Tester: Auslaﬂnockenwelle- Endstufe" VALUE 0x1D3EFA KwWU16 65535.00 dez 0.00 65535.00 FORMAT "%8.2" /end CHARACTERISTIC
/begin CHARACTERISTIC CDTANWSE2 "Codewort Tester: Auslaﬂnockenwelle- Endstufe Bank2" VALUE 0x1D3EFC KwWU16 65535.00 dez 0.00 65535.00 FORMAT "%8.2" /end CHARACTERISTIC
/begin CHARACTERISTIC CDTDSU "Codewort Tester: Drucksensor Umgebung" VALUE 0x1D3F36 KwWU16 65535.00 dez 0.00 65535.00 FORMAT "%8.2" /end CHARACTERISTIC
/begin CHARACTERISTIC CDTEGFE "Codeowort Tester: Eingangsgrˆﬂe F¸llungserfassung" VALUE 0x1D3F4E KwUw 65535.00 dez 0.00 65535.00 FORMAT "%8.2" /end CHARACTERISTIC
/begin CHARACTERISTIC CDTEHB_EnvCond "" VALUE 0x1D3F50 KwUw 65535.00 dez 0.00 65535.00 FORMAT "%8.2" /end CHARACTERISTIC
/begin CHARACTERISTIC CDTEHB_Par "" VALUE 0x1D3F52 KwUw 65535.00 dez 0.00 65535.00 FORMAT "%8.2" /end CHARACTERISTIC
/begin CHARACTERISTIC CDTEHB_Tgl "" VALUE 0x1D3F54 KwUw 65535.00 dez 0.00 65535.00 FORMAT "%8.2" /end CHARACTERISTIC
/begin CHARACTERISTIC CDTENWSE "Codewort Tester: Einlaﬂnockenwelle- Endstufe" VALUE 0x1D3F5A KwWU16 65535.00 dez 0.00 65535.00 FORMAT "%8.2" /end CHARACTERISTIC
/begin CHARACTERISTIC CDTENWSE2 "Codewort Tester: Einlaﬂnockenwelle- EndstufeBank2" VALUE 0x1D3F5C KwWU16 65535.00 dez 0.00 65535.00 FORMAT "%8.2" /end CHARACTERISTIC
/begin CHARACTERISTIC CDTESP_Par "" VALUE 0x1D3F5E KwUw 65535.00 dez 0.00 65535.00 FORMAT "%8.2" /end CHARACTERISTIC
/begin CHARACTERISTIC CDTESP_Stat "" VALUE 0x1D3F60 KwUw 65535.00 dez 0.00 65535.00 FORMAT "%8.2" /end CHARACTERISTIC
/begin CHARACTERISTIC CDTESP_Tgl "" VALUE 0x1D3F62 KwUw 65535.00 dez 0.00 65535.00 FORMAT "%8.2" /end CHARACTERISTIC
/begin CHARACTERISTIC CDTESP_TrqReq "" VALUE 0x1D3F64 KwUw 65535.00 dez 0.00 65535.00 FORMAT "%8.2" /end CHARACTERISTIC
/begin CHARACTERISTIC CDTLM "Codewort Tester: LMM/HLM/HFM" VALUE 0x1D3FCE KwUw 65535.00 dez 0.00 65535.00 FORMAT "%8.2" /end CHARACTERISTIC
/begin CHARACTERISTIC CDTLZSR "" VALUE 0x1D3FEE KwUw 65535.00 dez 0.00 65535.00 FORMAT "%8.2" /end CHARACTERISTIC
/begin CHARACTERISTIC CDTMDB "Codewort Tester: Momentbegrenzung Sollmoment" VALUE 0x1D400A KwUw 65535.00 dez 0.00 65535.00 FORMAT "%8.2" /end CHARACTERISTIC
/begin CHARACTERISTIC CDTPAC "Codewort Tester: Druck in Klimasystem" VALUE 0x1D4024 KwUw 65535.00 dez 0.00 65535.00 FORMAT "%8.2" /end CHARACTERISTIC
/begin CHARACTERISTIC CDTPH "Codewort Tester: Phasensensor" VALUE 0x1D4028 KwWU16 65535.00 DEZ 0.00 65535.00 FORMAT "%8.2" /end CHARACTERISTIC
/begin CHARACTERISTIC CDTPH2 "Codewort Tester: Phasensensor Bank 2" VALUE 0x1D402A KwWU16 65535.00 DEZ 0.00 65535.00 FORMAT "%8.2" /end CHARACTERISTIC
/begin CHARACTERISTIC CDTPH3 "Codewort Tester: Phasensensor 3" VALUE 0x1D402C KwWU16 65535.00 DEZ 0.00 65535.00 FORMAT "%8.2" /end CHARACTERISTIC
/begin CHARACTERISTIC CDTPH4 "Codewort Tester: Phasensensor 4" VALUE 0x1D402E KwWU16 65535.00 DEZ 0.00 65535.00 FORMAT "%8.2" /end CHARACTERISTIC
/begin CHARACTERISTIC CDTPHM "Codewort Tester: Phasensensor MIL" VALUE 0x1D4030 KwWU16 65535.00 DEZ 0.00 65535.00 FORMAT "%8.2" /end CHARACTERISTIC
/begin CHARACTERISTIC CDTPN "Codewort Tester: P/N-Schalter" VALUE 0x1D4032 KwUw 65535.00 dez 0.00 65535.00 FORMAT "%8.2" /end CHARACTERISTIC
/begin CHARACTERISTIC CDTSLS "Codewort Tester: Sekund‰rluft-System" VALUE 0x1D4042 KwWU16 65535.00 dez 0.00 65535.00 FORMAT "%8.2" /end CHARACTERISTIC
/begin CHARACTERISTIC CDTSLS2 "Codewort Tester: Sekund‰rluft-System, Bank 2" VALUE 0x1D4044 KwWU16 65535.00 dez 0.00 65535.00 FORMAT "%8.2" /end CHARACTERISTIC
/begin CHARACTERISTIC CDTSLV "Codewort Tester: Sekund‰rluftventil" VALUE 0x1D4046 KwWU16 65535.00 dez 0.00 65535.00 FORMAT "%8.2" /end CHARACTERISTIC
/begin CHARACTERISTIC CDTSLV2 "Codewort Tester: Sekund‰rluftventil, Bank 2" VALUE 0x1D4048 KwWU16 65535.00 dez 0.00 65535.00 FORMAT "%8.2" /end CHARACTERISTIC
/begin CHARACTERISTIC CDTTA "Codewort Tester: TANS" VALUE 0x1D4054 KwUw 65535.00 dez 0.00 65535.00 FORMAT "%8.2" /end CHARACTERISTIC
/begin CHARACTERISTIC CDTTES "Codewort Tester: Tankentl¸ftungssystem" VALUE 0x1D405C KwUw 65535.00 dez 0.00 65535.00 FORMAT "%8.2" /end CHARACTERISTIC
/begin CHARACTERISTIC CDTTEVE "Codewort Tester: Tankentl¸ftungsventil Endstufe" VALUE 0x1D4060 KwWU16 65535.00 dez 0.00 65535.00 FORMAT "%8.2" /end CHARACTERISTIC
/begin CHARACTERISTIC CDTTHM "Codewort Tester: Thermostat-Diagnose THM" VALUE 0x1D4062 KwUw 65535.00 dez 0.00 65535.00 FORMAT "%8.2" /end CHARACTERISTIC
/begin CHARACTERISTIC CDTTKA "Codewort Tester: Temperatur K¸hlerausgang" VALUE 0x1D4064 KwUw 65535.00 dez 0.00 65535.00 FORMAT "%8.2" /end CHARACTERISTIC
/begin CHARACTERISTIC CDTTM "Codewort Tester: TMOT" VALUE 0x1D4066 KwUw 65535.00 dez 0.00 65535.00 FORMAT "%8.2" /end CHARACTERISTIC
/begin CHARACTERISTIC CDTTOL "Codewort Tester: ÷ltemperatur" VALUE 0x1D406A KwUw 65535.00 dez 0.00 65535.00 FORMAT "%8.2" /end CHARACTERISTIC
/begin CHARACTERISTIC CDTUB "Codewort Tester: UB" VALUE 0x1D4070 KwWU16 65535.00 dez 0.00 65535.00 FORMAT "%8.2" /end CHARACTERISTIC
/begin CHARACTERISTIC CDTUFMV "Codewort Tester: Funktions¸berwachung: Momentenvergleich" VALUE 0x1D4072 KwUw 65535.00 dez 0.00 65535.00 FORMAT "%8.2" /end CHARACTERISTIC
/begin CHARACTERISTIC CDTUFNC "Codewort Tester: Fkt¸berwachung: Drehzahlgeber-, Zuleitung- oder SG-Fehler" VALUE 0x1D4074 KwUw 65535.00 dez 0.00 65535.00 FORMAT "%8.2" /end CHARACTERISTIC
/begin CHARACTERISTIC CDTUFRLIP "Codewort Tester: Fkt¸berwachung: Lastsensor-, Zuleitung- oder SG-Fehler" VALUE 0x1D4076 KwUw 65535.00 dez 0.00 65535.00 FORMAT "%8.2" /end CHARACTERISTIC
/begin CHARACTERISTIC CDTUFSGA "Codewort Tester: Funktions¸berwachung: Steuerger‰te-Fehler Gruppe a" VALUE 0x1D4078 KwUw 65535.00 dez 0.00 65535.00 FORMAT "%8.2" /end CHARACTERISTIC
/begin CHARACTERISTIC CDTUFSGB "Codewort Tester: Funktions¸berwachung: Steuerger‰te-Fehler Gruppe b" VALUE 0x1D407A KwUw 65535.00 dez 0.00 65535.00 FORMAT "%8.2" /end CHARACTERISTIC
/begin CHARACTERISTIC CDTUFSGC "Codewort Tester: Funktions¸berwachung: Steuerger‰te-Fehler Gruppe c" VALUE 0x1D407C KwUw 65535.00 dez 0.00 65535.00 FORMAT "%8.2" /end CHARACTERISTIC
/begin CHARACTERISTIC CDTUFSPSC "Codewort Tester: Fkt¸berwachung: Pedalwertgeber-, Zuleitung- oder SG-Fehler" VALUE 0x1D407E KwUw 65535.00 dez 0.00 65535.00 FORMAT "%8.2" /end CHARACTERISTIC
/begin CHARACTERISTIC CDTURRAM "Codewort Tester: Rechner¸berwachung: RAM" VALUE 0x1D4080 KwUw 65535.00 dez 0.00 65535.00 FORMAT "%8.2" /end CHARACTERISTIC
/begin CHARACTERISTIC CDTURROM "Codewort Tester: Rechner¸berwachung: ROM" VALUE 0x1D4082 KwUw 65535.00 dez 0.00 65535.00 FORMAT "%8.2" /end CHARACTERISTIC
/begin CHARACTERISTIC CDTURRST "Codewort Tester: Rechner¸berwachung: Reset" VALUE 0x1D4084 KwUw 65535.00 dez 0.00 65535.00 FORMAT "%8.2" /end CHARACTERISTIC
/begin CHARACTERISTIC CLAANWSE "Fehlerklasse: Auslaﬂnockenwelle- Endstufe" VALUE 0x1D315A KwWU8 255.0 dez 0.00 255.0 FORMAT "%5.1" /end CHARACTERISTIC
/begin CHARACTERISTIC CLAANWSE2 "Fehlerklasse: Auslaﬂnockenwelle- Endstufe Bank2" VALUE 0x1D315B KwWU8 255.0 dez 0.00 255.0 FORMAT "%5.1" /end CHARACTERISTIC
/begin CHARACTERISTIC CLADSU "Fehlerklasse: Umgebungsdrucksensor" VALUE 0x1D3178 KwWU8 255.0 dez 0.00 255.0 FORMAT "%5.1" /end CHARACTERISTIC
/begin CHARACTERISTIC CLAEGFE "Fehlerklasse: Lasterfassung" VALUE 0x1D3184 KwUb 255.0 dez 0.00 255.0 FORMAT "%5.1" /end CHARACTERISTIC
/begin CHARACTERISTIC CLAEHB_EnvCond "" VALUE 0x1D3185 KwUb 255.0 dez 0.00 255.0 FORMAT "%5.1" /end CHARACTERISTIC
/begin CHARACTERISTIC CLAEHB_Par "" VALUE 0x1D3186 KwUb 255.0 dez 0.00 255.0 FORMAT "%5.1" /end CHARACTERISTIC
/begin CHARACTERISTIC CLAEHB_Tgl "" VALUE 0x1D3187 KwUb 255.0 dez 0.00 255.0 FORMAT "%5.1" /end CHARACTERISTIC
/begin CHARACTERISTIC CLAENWSE "Fehlerklasse: Einlaﬂnockenwelle- Endstufe" VALUE 0x1D318A KwWU8 255.0 dez 0.00 255.0 FORMAT "%5.1" /end CHARACTERISTIC
/begin CHARACTERISTIC CLAENWSE2 "Fehlerklasse: Einlaﬂnockenwelle- Endstufe Bank2" VALUE 0x1D318B KwWU8 255.0 dez 0.00 255.0 FORMAT "%5.1" /end CHARACTERISTIC
/begin CHARACTERISTIC CLAESP_Par "" VALUE 0x1D318C KwUb 255.0 dez 0.00 255.0 FORMAT "%5.1" /end CHARACTERISTIC
/begin CHARACTERISTIC CLAESP_Stat "" VALUE 0x1D318D KwUb 255.0 dez 0.00 255.0 FORMAT "%5.1" /end CHARACTERISTIC
/begin CHARACTERISTIC CLAESP_Tgl "" VALUE 0x1D318E KwUb 255.0 dez 0.00 255.0 FORMAT "%5.1" /end CHARACTERISTIC
/begin CHARACTERISTIC CLAESP_TrqReq "" VALUE 0x1D318F KwUb 255.0 dez 0.00 255.0 FORMAT "%5.1" /end CHARACTERISTIC
/begin CHARACTERISTIC CLALM "Fehlerklasse: Hauptf¸llungssignal" VALUE 0x1D31C4 KwUb 255.0 dez 0.00 255.0 FORMAT "%5.1" /end CHARACTERISTIC
/begin CHARACTERISTIC CLALZSR "" VALUE 0x1D31D4 KwUb 255.0 dez 0.00 255.0 FORMAT "%5.1" /end CHARACTERISTIC
/begin CHARACTERISTIC CLAMDB "Fehlerklasse: Momentbgrenzung Sollmoment" VALUE 0x1D31E2 KwUb 255.0 dez 0.00 255.0 FORMAT "%5.1" /end CHARACTERISTIC
/begin CHARACTERISTIC CLAPAC "Fehlerklasse: AC-Drucksensor" VALUE 0x1D31EF KwUb 255.0 dez 0.00 255.0 FORMAT "%5.1" /end CHARACTERISTIC
/begin CHARACTERISTIC CLAPH "Fehlerklasse: Phasengeber" VALUE 0x1D31F1 KwWU8 255.0 DEZ 0.00 255.0 FORMAT "%5.1" /end CHARACTERISTIC
/begin CHARACTERISTIC CLAPH2 "Fehlerklasse: Phasengeber Bank 2" VALUE 0x1D31F2 KwWU8 255.0 DEZ 0.00 255.0 FORMAT "%5.1" /end CHARACTERISTIC
/begin CHARACTERISTIC CLAPH3 "Fehlerklasse: Phasengeber 3" VALUE 0x1D31F3 KwWU8 255.0 DEZ 0.00 255.0 FORMAT "%5.1" /end CHARACTERISTIC
/begin CHARACTERISTIC CLAPH4 "Fehlerklasse: Phasengeber 4" VALUE 0x1D31F4 KwWU8 255.0 DEZ 0.00 255.0 FORMAT "%5.1" /end CHARACTERISTIC
/begin CHARACTERISTIC CLAPHM "Fehlerklasse: Phasengeber MIL" VALUE 0x1D31F5 KwWU8 255.0 DEZ 0.00 255.0 FORMAT "%5.1" /end CHARACTERISTIC
/begin CHARACTERISTIC CLAPN "Fehlerklasse: P/N-Schalter" VALUE 0x1D31F6 KwUb 255.0 dez 0.00 255.0 FORMAT "%5.1" /end CHARACTERISTIC
/begin CHARACTERISTIC CLASLS "Fehlerklasse: Sekund‰rluftsystem" VALUE 0x1D31FE KwWU8 255.0 dez 0.00 255.0 FORMAT "%5.1" /end CHARACTERISTIC
/begin CHARACTERISTIC CLASLS2 "Fehlerklasse: Sekund‰rluftsystem, Bank 2" VALUE 0x1D31FF KwWU8 255.0 dez 0.00 255.0 FORMAT "%5.1" /end CHARACTERISTIC
/begin CHARACTERISTIC CLASLV "Fehlerklasse: Dichtheit Sekund‰rluftventil" VALUE 0x1D3200 KwWU8 255.0 dez 0.00 255.0 FORMAT "%5.1" /end CHARACTERISTIC
/begin CHARACTERISTIC CLASLV2 "Fehlerklasse: Dichtheit Sekund‰rluftventil, Bank 2" VALUE 0x1D3201 KwWU8 255.0 dez 0.00 255.0 FORMAT "%5.1" /end CHARACTERISTIC
/begin CHARACTERISTIC CLATA "Fehlerklasse: Ansauglufttemperatur TANS (/Ladeluft-)" VALUE 0x1D3207 KwUb 255.0 dez 0.00 255.0 FORMAT "%5.1" /end CHARACTERISTIC
/begin CHARACTERISTIC CLATES "Fehlerklasse: Tankdiagnose, TEV offen" VALUE 0x1D320B KwUb 255.0 dez 0.00 255.0 FORMAT "%5.1" /end CHARACTERISTIC
/begin CHARACTERISTIC CLATEVE "Fehlerklasse: Tankentl¸ftungsventil Endstufe" VALUE 0x1D320D KwWU8 255.0 dez 0.00 255.0 FORMAT "%5.1" /end CHARACTERISTIC
/begin CHARACTERISTIC CLATHM "Fehlerklasse: Thermostat-Diagnose THM" VALUE 0x1D320E KwUb 255.0 dez 0.00 255.0 FORMAT "%5.1" /end CHARACTERISTIC
/begin CHARACTERISTIC CLATKA "Fehlerklasse: Temperatur K¸hlerausgang" VALUE 0x1D320F KwUb 255.0 dez 0.00 255.0 FORMAT "%5.1" /end CHARACTERISTIC
/begin CHARACTERISTIC CLATM "Fehlerklasse: Motortemperatur TMOT" VALUE 0x1D3210 KwUb 255.0 dez 0.00 255.0 FORMAT "%5.1" /end CHARACTERISTIC
/begin CHARACTERISTIC CLATOL "Fehlerklasse: (Motor-) Oeltemperatur TOL" VALUE 0x1D3212 KwUb 255.0 dez 0.00 255.0 FORMAT "%5.1" /end CHARACTERISTIC
/begin CHARACTERISTIC CLAUB "Fehlerklasse: Batteriespannung UB (Bordnetz)" VALUE 0x1D3215 KwWU8 255.0 dez 0.00 255.0 FORMAT "%5.1" /end CHARACTERISTIC
/begin CHARACTERISTIC CLAUFMV "Fehlerklasse: Funktions¸berwachung: Momentenvergleich" VALUE 0x1D3216 KwUb 255.0 dez 0.00 255.0 FORMAT "%5.1" /end CHARACTERISTIC
/begin CHARACTERISTIC CLAUFNC "Fehlerklasse: Funktions¸berwachung: Drehzahlgeber-, Zuleitung- oder SG-Fehler" VALUE 0x1D3217 KwUb 255.0 dez 0.00 255.0 FORMAT "%5.1" /end CHARACTERISTIC
/begin CHARACTERISTIC CLAUFRLIP "Fehlerklasse: Funktions¸berwachung: Lastsensor-, Zuleitung- oder SG-Fehler" VALUE 0x1D3218 KwUb 255.0 dez 0.00 255.0 FORMAT "%5.1" /end CHARACTERISTIC
/begin CHARACTERISTIC CLAUFSGA "Fehlerklasse: Funktions¸berwachung: Steuerger‰te-Fehler Gruppe a" VALUE 0x1D3219 KwUb 255.0 dez 0.00 255.0 FORMAT "%5.1" /end CHARACTERISTIC
/begin CHARACTERISTIC CLAUFSGB "Fehlerklasse: Funktions¸berwachung: Steuerger‰te-Fehler Gruppe b" VALUE 0x1D321A KwUb 255.0 dez 0.00 255.0 FORMAT "%5.1" /end CHARACTERISTIC
/begin CHARACTERISTIC CLAUFSGC "Fehlerklasse: Funktions¸berwachung: Steuerger‰te-Fehler Gruppe c" VALUE 0x1D321B KwUb 255.0 dez 0.00 255.0 FORMAT "%5.1" /end CHARACTERISTIC
/begin CHARACTERISTIC CLAUFSPSC "Fehlerklasse: Funktions¸berwachung: Pedalwertgeber-, Zuleitung- oder SG-Fehler" VALUE 0x1D321C KwUb 255.0 dez 0.00 255.0 FORMAT "%5.1" /end CHARACTERISTIC
/begin CHARACTERISTIC CLAURRAM "Fehlerklasse: Rechner¸berwachung: RAM" VALUE 0x1D321D KwUb 255.0 dez 0.00 255.0 FORMAT "%5.1" /end CHARACTERISTIC
/begin CHARACTERISTIC CLAURROM "Fehlerklasse: Rechner¸berwachung: ROM" VALUE 0x1D321E KwUb 255.0 dez 0.00 255.0 FORMAT "%5.1" /end CHARACTERISTIC
/begin CHARACTERISTIC CLAURRST "Fehlerklasse: Rechner¸berwachung: Reset" VALUE 0x1D321F KwUb 255.0 dez 0.00 255.0 FORMAT "%5.1" /end CHARACTERISTIC
/begin CHARACTERISTIC FFTANWSE "Freeze Frame Tabelle: Auslaﬂnockenwelle- Endstufe" VAL_BLK 0x1D325C KwbWU8 255.0 dez 0.00 255.0 FORMAT "%5.1" NUMBER 4 /end CHARACTERISTIC
/begin CHARACTERISTIC FFTANWSE2 "Freeze Frame Tabelle: Auslaﬂnockenwelle- Endstufe Bank2" VAL_BLK 0x1D3260 KwbWU8 255.0 dez 0.00 255.0 FORMAT "%5.1" NUMBER 4 /end CHARACTERISTIC
/begin CHARACTERISTIC FFTDSU "Freeze Frame Tabelle: Umgebungsdrucksensor" VAL_BLK 0x1D32D4 KwbWU8 255.0 dez 0.00 255.0 FORMAT "%5.1" NUMBER 4 /end CHARACTERISTIC
/begin CHARACTERISTIC FFTEGFE "Freeze Frame Tabelle: Lasterfassung" VAL_BLK 0x1D3304 KwbUb 255.0 dez 0.00 255.0 FORMAT "%5.1" NUMBER 4 /end CHARACTERISTIC
/begin CHARACTERISTIC FFTEHB_EnvCond "" VAL_BLK 0x1D3308 KwbUb 255.0 dez 0.00 255.0 FORMAT "%5.1" NUMBER 4 /end CHARACTERISTIC
/begin CHARACTERISTIC FFTEHB_Par "" VAL_BLK 0x1D330C KwbUb 255.0 dez 0.00 255.0 FORMAT "%5.1" NUMBER 4 /end CHARACTERISTIC
/begin CHARACTERISTIC FFTEHB_Tgl "" VAL_BLK 0x1D3310 KwbUb 255.0 dez 0.00 255.0 FORMAT "%5.1" NUMBER 4 /end CHARACTERISTIC
/begin CHARACTERISTIC FFTENWSE "Freeze Frame Tabelle: Einlaﬂnockenwelle- Endstufe" VAL_BLK 0x1D331C KwbWU8 255.0 dez 0.00 255.0 FORMAT "%5.1" NUMBER 4 /end CHARACTERISTIC
/begin CHARACTERISTIC FFTENWSE2 "Freeze Frame Tabelle: Einlaﬂnockenwelle- Endstufe Bank2" VAL_BLK 0x1D3320 KwbWU8 255.0 dez 0.00 255.0 FORMAT "%5.1" NUMBER 4 /end CHARACTERISTIC
/begin CHARACTERISTIC FFTESP_Par "" VAL_BLK 0x1D3324 KwbUb 255.0 dez 0.00 255.0 FORMAT "%5.1" NUMBER 4 /end CHARACTERISTIC
/begin CHARACTERISTIC FFTESP_Stat "" VAL_BLK 0x1D3328 KwbUb 255.0 dez 0.00 255.0 FORMAT "%5.1" NUMBER 4 /end CHARACTERISTIC
/begin CHARACTERISTIC FFTESP_Tgl "" VAL_BLK 0x1D332C KwbUb 255.0 dez 0.00 255.0 FORMAT "%5.1" NUMBER 4 /end CHARACTERISTIC
/begin CHARACTERISTIC FFTESP_TrqReq "" VAL_BLK 0x1D3330 KwbUb 255.0 dez 0.00 255.0 FORMAT "%5.1" NUMBER 4 /end CHARACTERISTIC
/begin CHARACTERISTIC FFTLM "Freeze Frame Tabelle: Hauptf¸llungssensor" VAL_BLK 0x1D3404 KwbUb 255.0 dez 0.00 255.0 FORMAT "%5.1" NUMBER 4 /end CHARACTERISTIC
/begin CHARACTERISTIC FFTLZSR "" VAL_BLK 0x1D3444 KwbUb 255.0 dez 0.00 255.0 FORMAT "%5.1" NUMBER 4 /end CHARACTERISTIC
/begin CHARACTERISTIC FFTMDB "Freeze Frame Tabelle: Momentbegrenzung Sollmoment" VAL_BLK 0x1D347C KwbUb 255.0 dez 0.00 255.0 FORMAT "%5.1" NUMBER 4 /end CHARACTERISTIC
/begin CHARACTERISTIC FFTPAC "Freeze Frame Tabelle: AC-Drucksensor" VAL_BLK 0x1D34B0 KwbUb 255.0 dez 0.00 255.0 FORMAT "%5.1" NUMBER 4 /end CHARACTERISTIC
/begin CHARACTERISTIC FFTPH "Freeze Frame Tabelle: Phasensensor" VAL_BLK 0x1D34B8 KwbWU8 255.0 DEZ 0.00 255.0 FORMAT "%5.1" NUMBER 4 /end CHARACTERISTIC
/begin CHARACTERISTIC FFTPH2 "Freeze Frame Tabelle: Phasensensor Bank 2" VAL_BLK 0x1D34BC KwbWU8 255.0 DEZ 0.00 255.0 FORMAT "%5.1" NUMBER 4 /end CHARACTERISTIC
/begin CHARACTERISTIC FFTPH3 "Freeze Frame Tabelle: Phasensensor 3" VAL_BLK 0x1D34C0 KwbWU8 255.0 DEZ 0.00 255.0 FORMAT "%5.1" NUMBER 4 /end CHARACTERISTIC
/begin CHARACTERISTIC FFTPH4 "Freeze Frame Tabelle: Phasensensor 4" VAL_BLK 0x1D34C4 KwbWU8 255.0 DEZ 0.00 255.0 FORMAT "%5.1" NUMBER 4 /end CHARACTERISTIC
/begin CHARACTERISTIC FFTPHM "Freeze Frame Tabelle: Phasensensor MIL" VAL_BLK 0x1D34C8 KwbWU8 255.0 DEZ 0.00 255.0 FORMAT "%5.1" NUMBER 4 /end CHARACTERISTIC
/begin CHARACTERISTIC FFTPN "" VAL_BLK 0x1D34CC KwbUb 255.0 dez 0.00 255.0 FORMAT "%5.1" NUMBER 4 /end CHARACTERISTIC
/begin CHARACTERISTIC FFTSLS "Freeze Frame Tabelle: Sekund‰rluftsystem" VAL_BLK 0x1D34EC KwbWU8 255.0 dez 0.00 255.0 FORMAT "%5.1" NUMBER 4 /end CHARACTERISTIC
/begin CHARACTERISTIC FFTSLS2 "Freeze Frame Tabelle: Sekund‰rluftsystem, Bank 2" VAL_BLK 0x1D34F0 KwbWU8 255.0 dez 0.00 255.0 FORMAT "%5.1" NUMBER 4 /end CHARACTERISTIC
/begin CHARACTERISTIC FFTSLV "Freeze Frame Tabelle: Dichtheit Sekund‰rluftventil" VAL_BLK 0x1D34F4 KwbWU8 255.0 dez 0.00 255.0 FORMAT "%5.1" NUMBER 4 /end CHARACTERISTIC
/begin CHARACTERISTIC FFTSLV2 "Freeze Frame Tabelle: Dichtheit Sekund‰rluftventil, Bank 2" VAL_BLK 0x1D34F8 KwbWU8 255.0 dez 0.00 255.0 FORMAT "%5.1" NUMBER 4 /end CHARACTERISTIC
/begin CHARACTERISTIC FFTTA "Freeze Frame Tabelle: Ansauglufttemperatur TANS (/Ladeluft-)" VAL_BLK 0x1D3510 KwbUb 255.0 dez 0.00 255.0 FORMAT "%5.1" NUMBER 4 /end CHARACTERISTIC
/begin CHARACTERISTIC FFTTES "Freeze Frame Tabelle: Tankentl¸ftungsventil" VAL_BLK 0x1D3520 KwbUb 255.0 dez 0.00 255.0 FORMAT "%5.1" NUMBER 4 /end CHARACTERISTIC
/begin CHARACTERISTIC FFTTEVE "Freeze Frame Tabelle: Tankentl¸ftungsventil Endstufe" VAL_BLK 0x1D3528 KwbWU8 255.0 dez 0.00 255.0 FORMAT "%5.1" NUMBER 4 /end CHARACTERISTIC
/begin CHARACTERISTIC FFTTHM "Freeze Frame Tabelle: Thermostat-Diagnose THM" VAL_BLK 0x1D352C KwbUb 255.0 dez 0.00 255.0 FORMAT "%5.1" NUMBER 4 /end CHARACTERISTIC
/begin CHARACTERISTIC FFTTKA "Freeze Frame Tabelle: Temperatur K¸hlerausgang" VAL_BLK 0x1D3530 KwbUb 255.0 dez 0.00 255.0 FORMAT "%5.1" NUMBER 4 /end CHARACTERISTIC
/begin CHARACTERISTIC FFTTM "Freeze Frame Tabelle: Motortemperatur TMOT" VAL_BLK 0x1D3534 KwbUb 255.0 dez 0.00 255.0 FORMAT "%5.1" NUMBER 4 /end CHARACTERISTIC
/begin CHARACTERISTIC FFTTOL "Freeze Frame Tabelle: (Motor-) Oeltemperatur TOL" VAL_BLK 0x1D353C KwbUb 255.0 dez 0.00 255.0 FORMAT "%5.1" NUMBER 4 /end CHARACTERISTIC
/begin CHARACTERISTIC FFTUB "Freeze Frame Tabelle: Batteriespannung UB (Bordnetz)" VAL_BLK 0x1D3548 KwbWU8 255.0 dez 0.00 255.0 FORMAT "%5.1" NUMBER 4 /end CHARACTERISTIC
/begin CHARACTERISTIC FFTUFMV "Freeze Frame Tabelle: Funktions¸berwachung: Momentenvergleich" VAL_BLK 0x1D354C KwbUb 255.0 dez 0.00 255.0 FORMAT "%5.1" NUMBER 4 /end CHARACTERISTIC
/begin CHARACTERISTIC FFTUFNC "Freeze Frame Tabelle: Fkt¸berwachung: Drehzahlgeber-, Zuleitung- oder SG-Fehler" VAL_BLK 0x1D3550 KwbUb 255.0 dez 0.00 255.0 FORMAT "%5.1" NUMBER 4 /end CHARACTERISTIC
/begin CHARACTERISTIC FFTUFRLIP "Freeze Frame Tabelle: Fkt¸berwachung: Lastsensor-, Zuleitung- oder SG-Fehler" VAL_BLK 0x1D3554 KwbUb 255.0 dez 0.00 255.0 FORMAT "%5.1" NUMBER 4 /end CHARACTERISTIC
/begin CHARACTERISTIC FFTUFSGA "Freeze Frame Tabelle: Funktions¸berwachung: Steuerger‰te-Fehler Gruppe a" VAL_BLK 0x1D3558 KwbUb 255.0 dez 0.00 255.0 FORMAT "%5.1" NUMBER 4 /end CHARACTERISTIC
/begin CHARACTERISTIC FFTUFSGB "Freeze Frame Tabelle: Funktions¸berwachung: Steuerger‰te-Fehler Gruppe b" VAL_BLK 0x1D355C KwbUb 255.0 dez 0.00 255.0 FORMAT "%5.1" NUMBER 4 /end CHARACTERISTIC
/begin CHARACTERISTIC FFTUFSGC "Freeze Frame Tabelle: Funktions¸berwachung: Steuerger‰te-Fehler Gruppe c" VAL_BLK 0x1D3560 KwbUb 255.0 dez 0.00 255.0 FORMAT "%5.1" NUMBER 4 /end CHARACTERISTIC
/begin CHARACTERISTIC FFTUFSPSC "Freeze Frame Tabelle: Fkt¸berwachung: Pedalwertgeber-, Zuleitung- oder SG-Fehler" VAL_BLK 0x1D3564 KwbUb 255.0 dez 0.00 255.0 FORMAT "%5.1" NUMBER 4 /end CHARACTERISTIC
/begin CHARACTERISTIC FFTURRAM "Freeze Frame Tabelle: Rechner¸berwachung: RAM" VAL_BLK 0x1D3568 KwbUb 255.0 dez 0.00 255.0 FORMAT "%5.1" NUMBER 4 /end CHARACTERISTIC
/begin CHARACTERISTIC FFTURROM "Freeze Frame Tabelle: Rechner¸berwachung: ROM" VAL_BLK 0x1D356C KwbUb 255.0 dez 0.00 255.0 FORMAT "%5.1" NUMBER 4 /end CHARACTERISTIC
/begin CHARACTERISTIC FFTURRST "Freeze Frame Tabelle: Rechner¸berwachung: Reset" VAL_BLK 0x1D3570 KwbUb 255.0 dez 0.00 255.0 FORMAT "%5.1" NUMBER 4 /end CHARACTERISTIC
/begin CHARACTERISTIC TSFANWSE "Fehlersummenzeit: Auslaﬂnockenwelle- Endstufe" VALUE 0x1D3599 KwWU8 255.0 dez 0.00 255.0 FORMAT "%5.1" /end CHARACTERISTIC
/begin CHARACTERISTIC TSFANWSE2 "Fehlersummenzeit: Auslaﬂnockenwelle- Endstufe Bank2" VALUE 0x1D359A KwWU8 255.0 dez 0.00 255.0 FORMAT "%5.1" /end CHARACTERISTIC
/begin CHARACTERISTIC TSFDSU "Fehlersummenzeit: Drucksensor Umgebung" VALUE 0x1D35B7 KwWU8 255.0 dez 0.00 255.0 FORMAT "%5.1" /end CHARACTERISTIC
/begin CHARACTERISTIC TSFEGFE "Fehlersummenzeit: Eingangsgrˆﬂe F¸llunserfassung" VALUE 0x1D35C3 KwUb 255.0 dez 0.00 255.0 FORMAT "%5.1" /end CHARACTERISTIC
/begin CHARACTERISTIC TSFEHB_EnvCond "" VALUE 0x1D35C4 KwUb 255.0 dez 0.00 255.0 FORMAT "%5.1" /end CHARACTERISTIC
/begin CHARACTERISTIC TSFEHB_Par "" VALUE 0x1D35C5 KwUb 255.0 dez 0.00 255.0 FORMAT "%5.1" /end CHARACTERISTIC
/begin CHARACTERISTIC TSFEHB_Tgl "" VALUE 0x1D35C6 KwUb 255.0 dez 0.00 255.0 FORMAT "%5.1" /end CHARACTERISTIC
/begin CHARACTERISTIC TSFENWSE "Fehlersummenzeit: Einlaﬂnockenwelle- Endstufe" VALUE 0x1D35C9 KwWU8 255.0 dez 0.00 255.0 FORMAT "%5.1" /end CHARACTERISTIC
/begin CHARACTERISTIC TSFENWSE2 "Fehlersummenzeit: Einlaﬂnockenwelle- Endstufe Bank2" VALUE 0x1D35CA KwWU8 255.0 dez 0.00 255.0 FORMAT "%5.1" /end CHARACTERISTIC
/begin CHARACTERISTIC TSFESP_Par "" VALUE 0x1D35CB KwUb 255.0 dez 0.00 255.0 FORMAT "%5.1" /end CHARACTERISTIC
/begin CHARACTERISTIC TSFESP_Stat "" VALUE 0x1D35CC KwUb 255.0 dez 0.00 255.0 FORMAT "%5.1" /end CHARACTERISTIC
/begin CHARACTERISTIC TSFESP_Tgl "" VALUE 0x1D35CD KwUb 255.0 dez 0.00 255.0 FORMAT "%5.1" /end CHARACTERISTIC
/begin CHARACTERISTIC TSFESP_TrqReq "" VALUE 0x1D35CE KwUb 255.0 dez 0.00 255.0 FORMAT "%5.1" /end CHARACTERISTIC
/begin CHARACTERISTIC TSFLM "Fehlersummenzeit: LMM/HLM/HFM" VALUE 0x1D3603 KwUb 255.0 dez 0.00 255.0 FORMAT "%5.1" /end CHARACTERISTIC
/begin CHARACTERISTIC TSFLZSR "" VALUE 0x1D3613 KwUb 255.0 dez 0.00 255.0 FORMAT "%5.1" /end CHARACTERISTIC
/begin CHARACTERISTIC TSFMDB "Fehlersummenzeit: Momentbegrenzung Sollmoment" VALUE 0x1D3621 KwUb 255.0 dez 0.00 255.0 FORMAT "%5.1" /end CHARACTERISTIC
/begin CHARACTERISTIC TSFPAC "Fehlersummenzeit: Druck in Klimasystem" VALUE 0x1D362E KwUb 255.0 dez 0.00 255.0 FORMAT "%5.1" /end CHARACTERISTIC
/begin CHARACTERISTIC TSFPH "Fehlersummenzeit: Phasensensor" VALUE 0x1D3630 KwWU8 255.0 DEZ 0.00 255.0 FORMAT "%5.1" /end CHARACTERISTIC
/begin CHARACTERISTIC TSFPH2 "Fehlersummenzeit: Phasensensor 2" VALUE 0x1D3631 KwWU8 255.0 DEZ 0.00 255.0 FORMAT "%5.1" /end CHARACTERISTIC
/begin CHARACTERISTIC TSFPH3 "Fehlersummenzeit: Phasensensor 3" VALUE 0x1D3632 KwWU8 255.0 DEZ 0.00 255.0 FORMAT "%5.1" /end CHARACTERISTIC
/begin CHARACTERISTIC TSFPH4 "Fehlersummenzeit: Phasensensor 4" VALUE 0x1D3633 KwWU8 255.0 DEZ 0.00 255.0 FORMAT "%5.1" /end CHARACTERISTIC
/begin CHARACTERISTIC TSFPHM "Fehlersummenzeit: Phasensensor MIL" VALUE 0x1D3634 KwWU8 255.0 DEZ 0.00 255.0 FORMAT "%5.1" /end CHARACTERISTIC
/begin CHARACTERISTIC TSFPN "Fehlersummenzeit: P/N-Schalter" VALUE 0x1D3635 KwUb 255.0 dez 0.00 255.0 FORMAT "%5.1" /end CHARACTERISTIC
/begin CHARACTERISTIC TSFSLS "Fehlersummenzeit: Sekund‰rluft-System" VALUE 0x1D363D KwWU8 255.0 dez 0.00 255.0 FORMAT "%5.1" /end CHARACTERISTIC
/begin CHARACTERISTIC TSFSLS2 "Fehlersummenzeit: Sekund‰rluft-System Bank 2" VALUE 0x1D363E KwWU8 255.0 dez 0.00 255.0 FORMAT "%5.1" /end CHARACTERISTIC
/begin CHARACTERISTIC TSFSLV "Fehlersummenzeit: Sekund‰rluftventil" VALUE 0x1D363F KwWU8 255.0 dez 0.00 255.0 FORMAT "%5.1" /end CHARACTERISTIC
/begin CHARACTERISTIC TSFSLV2 "Fehlersummenzeit: Sekund‰rluftventil, Bank 2" VALUE 0x1D3640 KwWU8 255.0 dez 0.00 255.0 FORMAT "%5.1" /end CHARACTERISTIC
/begin CHARACTERISTIC TSFTA "Fehlersummenzeit: Ansauglufttemperatur TANS" VALUE 0x1D3646 KwUb 255.0 dez 0.00 255.0 FORMAT "%5.1" /end CHARACTERISTIC
/begin CHARACTERISTIC TSFTES "Fehlersummenzeit: Tankentl¸ftungssystem" VALUE 0x1D364A KwUb 255.0 dez 0.00 255.0 FORMAT "%5.1" /end CHARACTERISTIC
/begin CHARACTERISTIC TSFTEVE "Fehlersummenzeit: Tankentl¸ftungsventil Endstufe" VALUE 0x1D364C KwWU8 255.0 dez 0.00 255.0 FORMAT "%5.1" /end CHARACTERISTIC
/begin CHARACTERISTIC TSFTHM "Fehlersummenzeit: Thermostat-Diagnose THM" VALUE 0x1D364D KwUb 255.0 dez 0.00 255.0 FORMAT "%5.1" /end CHARACTERISTIC
/begin CHARACTERISTIC TSFTKA "Fehlersummenzeit: Temperatur K¸hlerausgang" VALUE 0x1D364E KwUb 255.0 dez 0.00 255.0 FORMAT "%5.1" /end CHARACTERISTIC
/begin CHARACTERISTIC TSFTM "Fehlersummenzeit: Motortemperatur TMOT" VALUE 0x1D364F KwUb 255.0 dez 0.00 255.0 FORMAT "%5.1" /end CHARACTERISTIC
/begin CHARACTERISTIC TSFTOL "Fehlersummenzeit: ÷ltemperatur" VALUE 0x1D3651 KwUb 255.0 dez 0.00 255.0 FORMAT "%5.1" /end CHARACTERISTIC
/begin CHARACTERISTIC TSFUB "Fehlersummenzeit: Batteriespannung UB (Bordnetz)" VALUE 0x1D3654 KwWU8 255.0 dez 0.00 255.0 FORMAT "%5.1" /end CHARACTERISTIC
/begin CHARACTERISTIC TSFUFMV "Fehlersummenzeit: Funktions¸berwachung: Momentenvergleich" VALUE 0x1D3655 KwUb 255.0 dez 0.00 255.0 FORMAT "%5.1" /end CHARACTERISTIC
/begin CHARACTERISTIC TSFUFNC "Fehlersummenzeit: Fkt¸berwachung: Drehzahlgeber-, Zuleitung- oder SG-Fehler" VALUE 0x1D3656 KwUb 255.0 dez 0.00 255.0 FORMAT "%5.1" /end CHARACTERISTIC
/begin CHARACTERISTIC TSFUFRLIP "Fehlersummenzeit: Fkt¸berwachung: Lastsensor-, Zuleitung- oder SG-Fehler" VALUE 0x1D3657 KwUb 255.0 dez 0.00 255.0 FORMAT "%5.1" /end CHARACTERISTIC
/begin CHARACTERISTIC TSFUFSGA "Fehlersummenzeit: Funktions¸berwachung: Steuerger‰te-Fehler Gruppe a" VALUE 0x1D3658 KwUb 255.0 dez 0.00 255.0 FORMAT "%5.1" /end CHARACTERISTIC
/begin CHARACTERISTIC TSFUFSGB "Fehlersummenzeit: Funktions¸berwachung: Steuerger‰te-Fehler Gruppe b" VALUE 0x1D3659 KwUb 255.0 dez 0.00 255.0 FORMAT "%5.1" /end CHARACTERISTIC
/begin CHARACTERISTIC TSFUFSGC "Fehlersummenzeit: Funktions¸berwachung: Steuerger‰te-Fehler Gruppe c" VALUE 0x1D365A KwUb 255.0 dez 0.00 255.0 FORMAT "%5.1" /end CHARACTERISTIC
/begin CHARACTERISTIC TSFUFSPSC "Fehlersummenzeit: Fkt¸berwachung: Pedalwertgeber-, Zuleitung- oder SG-Fehler" VALUE 0x1D365B KwUb 255.0 dez 0.00 255.0 FORMAT "%5.1" /end CHARACTERISTIC
/begin CHARACTERISTIC TSFURRAM "Fehlersummenzeit: Rechner¸berwachung: RAM" VALUE 0x1D365C KwUb 255.0 dez 0.00 255.0 FORMAT "%5.1" /end CHARACTERISTIC
/begin CHARACTERISTIC TSFURROM "Fehlersummenzeit: Rechner¸berwachung: ROM" VALUE 0x1D365D KwUb 255.0 dez 0.00 255.0 FORMAT "%5.1" /end CHARACTERISTIC
/begin CHARACTERISTIC TSFURRST "Fehlersummenzeit: Rechner¸berwachung: Reset" VALUE 0x1D365E KwUb 255.0 dez 0.00 255.0 FORMAT "%5.1" /end CHARACTERISTIC
/begin MEASUREMENT B_avpn "" UWORD B_TRUE 1 100 0 1 BIT_MASK 0x1000 FORMAT "%13.11" ECU_ADDRESS 0x7FC9CE /end MEASUREMENT
/begin MEASUREMENT B_avtes "Leckdiagnose ist aktiv" UWORD B_TRUE 1 100 0 1 BIT_MASK 0x1000 FORMAT "%13.11" ECU_ADDRESS 0x7FC9F8 /end MEASUREMENT
/begin MEASUREMENT B_beanwse "Bedingung Bandende-Funktionsanforderung NWS Endstufe (Bank1, Auslaﬂ)" UWORD B_TRUE 1 100 0 1 BIT_MASK 0x20 FORMAT "%13.11" ECU_ADDRESS 0x7FC896 /end MEASUREMENT
/begin MEASUREMENT B_beanwse2 "Bedingung Bandende-Funktionsanforderung NWS Endstufe (Bank2, Auslaﬂ)" UWORD B_TRUE 1 100 0 1 BIT_MASK 0x20 FORMAT "%13.11" ECU_ADDRESS 0x7FC898 /end MEASUREMENT
/begin MEASUREMENT B_bedsu "Bedingung: Bandende-Funktionsanforderung DSU" UWORD B_TRUE 1 100 0 1 BIT_MASK 0x20 FORMAT "%13.11" ECU_ADDRESS 0x7FC8D2 /end MEASUREMENT
/begin MEASUREMENT B_beegfe "Bedingung: Bandende-Anforderung bei Eingangsgrˆﬂen der F¸llungserfassung" UWORD B_TRUE 1 100 0 1 BIT_MASK 0x20 FORMAT "%13.11" ECU_ADDRESS 0x7FC8EA /end MEASUREMENT
/begin MEASUREMENT B_beenwse "Bedingung Bandende-Funktionsanforderung NWS Endstufe (Bank1, Einlaﬂ)" UWORD B_TRUE 1 100 0 1 BIT_MASK 0x20 FORMAT "%13.11" ECU_ADDRESS 0x7FC8F6 /end MEASUREMENT
/begin MEASUREMENT B_beenwse2 "Bedingung Bandende-Funktionsanforderung NWS Endstufe (Bank2, Einlaﬂ)" UWORD B_TRUE 1 100 0 1 BIT_MASK 0x20 FORMAT "%13.11" ECU_ADDRESS 0x7FC8F8 /end MEASUREMENT
/begin MEASUREMENT B_belm "Bedingung Bandende-Funktionsanforderung Luftmassensensor (HFM/DSS)" UWORD B_TRUE 1 100 0 1 BIT_MASK 0x20 FORMAT "%13.11" ECU_ADDRESS 0x7FC96A /end MEASUREMENT
/begin MEASUREMENT B_belzsr "Bedingung Bandende-Funktionsanforderung: Leck zum Saugrohr" UWORD B_TRUE 1 100 0 1 BIT_MASK 0x20 FORMAT "%13.11" ECU_ADDRESS 0x7FC98A /end MEASUREMENT
/begin MEASUREMENT B_bemdb "Bedingung Bandende-Funktionsanforderung MDB" UWORD B_TRUE 1 100 0 1 BIT_MASK 0x20 FORMAT "%13.11" ECU_ADDRESS 0x7FC9A6 /end MEASUREMENT
/begin MEASUREMENT B_bepac "Bedingung Bandendeanford. f¸r Fehler A/C-Drucksensor" UWORD B_TRUE 1 100 0 1 BIT_MASK 0x20 FORMAT "%13.11" ECU_ADDRESS 0x7FC9C0 /end MEASUREMENT
/begin MEASUREMENT B_beph "Bedingung: Bandendefunktionanford. f¸r Phasengeber" UWORD B_TRUE 1 100 0 1 BIT_MASK 0x20 FORMAT "%13.11" ECU_ADDRESS 0x7FC9C4 /end MEASUREMENT
/begin MEASUREMENT B_beph2 "Bedingung: Bandendefunktionanford. f¸r Phasengeber 2" UWORD B_TRUE 1 100 0 1 BIT_MASK 0x20 FORMAT "%13.11" ECU_ADDRESS 0x7FC9C6 /end MEASUREMENT
/begin MEASUREMENT B_beph3 "Bedingung: Bandendefunktionanford. f¸r Phasengeber 3" UWORD B_TRUE 1 100 0 1 BIT_MASK 0x20 FORMAT "%13.11" ECU_ADDRESS 0x7FC9C8 /end MEASUREMENT
/begin MEASUREMENT B_beph4 "Bedingung: Bandendefunktionanford. f¸r Phasengeber 4" UWORD B_TRUE 1 100 0 1 BIT_MASK 0x20 FORMAT "%13.11" ECU_ADDRESS 0x7FC9CA /end MEASUREMENT
/begin MEASUREMENT B_bephm "Bedingung: Bandendefunktionanford. f¸r Phasengeber MIL" UWORD B_TRUE 1 100 0 1 BIT_MASK 0x20 FORMAT "%13.11" ECU_ADDRESS 0x7FC9CC /end MEASUREMENT
/begin MEASUREMENT B_bepn "" UWORD B_TRUE 1 100 0 1 BIT_MASK 0x20 FORMAT "%13.11" ECU_ADDRESS 0x7FC9CE /end MEASUREMENT
/begin MEASUREMENT B_besls "Bedingung Bandende-Funktionsanforderung Sekund‰rluftsystem" UWORD B_TRUE 1 100 0 1 BIT_MASK 0x20 FORMAT "%13.11" ECU_ADDRESS 0x7FC9DE /end MEASUREMENT
/begin MEASUREMENT B_besls2 "Bedingung Bandende-Funktionsanforderung Sekund‰rluftsystem, Bank2" UWORD B_TRUE 1 100 0 1 BIT_MASK 0x20 FORMAT "%13.11" ECU_ADDRESS 0x7FC9E0 /end MEASUREMENT
/begin MEASUREMENT B_beslv "Bedingung Bandende-Funktionsanforderung SLS" UWORD B_TRUE 1 100 0 1 BIT_MASK 0x20 FORMAT "%13.11" ECU_ADDRESS 0x7FC9E2 /end MEASUREMENT
/begin MEASUREMENT B_beslv2 "Bedingung Bandende-Funktionsanforderung SLS, Bank2" UWORD B_TRUE 1 100 0 1 BIT_MASK 0x20 FORMAT "%13.11" ECU_ADDRESS 0x7FC9E4 /end MEASUREMENT
/begin MEASUREMENT B_beta "Bedingung Bandende-Funktionsanforderung Ansauglufttemperaturf¸hler" UWORD B_TRUE 1 100 0 1 BIT_MASK 0x20 FORMAT "%13.11" ECU_ADDRESS 0x7FC9F0 /end MEASUREMENT
/begin MEASUREMENT B_betes "Bedingung Bandende-Funktionsanforderung Tankentl¸ftungssystem" UWORD B_TRUE 1 100 0 1 BIT_MASK 0x20 FORMAT "%13.11" ECU_ADDRESS 0x7FC9F8 /end MEASUREMENT
/begin MEASUREMENT B_beteve "Bedingung Bandendeanford. f¸r Fehler Tanentl¸ftungsventil Endstufe" UWORD B_TRUE 1 100 0 1 BIT_MASK 0x20 FORMAT "%13.11" ECU_ADDRESS 0x7FC9FC /end MEASUREMENT
/begin MEASUREMENT B_bethm "Bedingung Bandendeanforderung f¸r Thermostatdiagnose" UWORD B_TRUE 1 100 0 1 BIT_MASK 0x20 FORMAT "%13.11" ECU_ADDRESS 0x7FC9FE /end MEASUREMENT
/begin MEASUREMENT B_betka "" UWORD B_TRUE 1 100 0 1 BIT_MASK 0x20 FORMAT "%13.11" ECU_ADDRESS 0x7FCA00 /end MEASUREMENT
/begin MEASUREMENT B_betm "Bedingung Bandende-Funktionsanforderung Motortemperaturf¸hler" UWORD B_TRUE 1 100 0 1 BIT_MASK 0x20 FORMAT "%13.11" ECU_ADDRESS 0x7FCA02 /end MEASUREMENT
/begin MEASUREMENT B_betol "Bedingung Bandende-Funktionsanforderung" UWORD B_TRUE 1 100 0 1 BIT_MASK 0x20 FORMAT "%13.11" ECU_ADDRESS 0x7FCA06 /end MEASUREMENT
/begin MEASUREMENT B_beub "Bedingung: Bandendefunktionanford. f¸r Batteriespannung (Bordnetz)" UWORD B_TRUE 1 100 0 1 BIT_MASK 0x20 FORMAT "%13.11" ECU_ADDRESS 0x7FCA0C /end MEASUREMENT
/begin MEASUREMENT B_beufmv "Bedingung Bandende:Fkt¸berwachung-Anforderung" UWORD B_TRUE 1 100 0 1 BIT_MASK 0x20 FORMAT "%13.11" ECU_ADDRESS 0x7FCA0E /end MEASUREMENT
/begin MEASUREMENT B_beufnc "Bedingung Bandende:Fkt¸berwachung-Anforderung" UWORD B_TRUE 1 100 0 1 BIT_MASK 0x20 FORMAT "%13.11" ECU_ADDRESS 0x7FCA10 /end MEASUREMENT
/begin MEASUREMENT B_beufrlip "Bedingung Bandende:Fkt¸berwachung-Anforderung" UWORD B_TRUE 1 100 0 1 BIT_MASK 0x20 FORMAT "%13.11" ECU_ADDRESS 0x7FCA12 /end MEASUREMENT
/begin MEASUREMENT B_beufsga "Bedingung Bandende:Fkt¸berwachung-Anforderung" UWORD B_TRUE 1 100 0 1 BIT_MASK 0x20 FORMAT "%13.11" ECU_ADDRESS 0x7FCA14 /end MEASUREMENT
/begin MEASUREMENT B_beufsgb "Bedingung Bandende:Fkt¸berwachung-Anforderung" UWORD B_TRUE 1 100 0 1 BIT_MASK 0x20 FORMAT "%13.11" ECU_ADDRESS 0x7FCA16 /end MEASUREMENT
/begin MEASUREMENT B_beufsgc "Bedingung Bandende:Fkt¸berwachung-Anforderung" UWORD B_TRUE 1 100 0 1 BIT_MASK 0x20 FORMAT "%13.11" ECU_ADDRESS 0x7FCA18 /end MEASUREMENT
/begin MEASUREMENT B_beufspsc "Bedingung Bandende:Fkt¸berwachung-Anforderung" UWORD B_TRUE 1 100 0 1 BIT_MASK 0x20 FORMAT "%13.11" ECU_ADDRESS 0x7FCA1A /end MEASUREMENT
/begin MEASUREMENT B_beurram "" UWORD B_TRUE 1 100 0 1 BIT_MASK 0x20 FORMAT "%13.11" ECU_ADDRESS 0x7FCA1C /end MEASUREMENT
/begin MEASUREMENT B_beurrom "" UWORD B_TRUE 1 100 0 1 BIT_MASK 0x20 FORMAT "%13.11" ECU_ADDRESS 0x7FCA1E /end MEASUREMENT
/begin MEASUREMENT B_beurrst "" UWORD B_TRUE 1 100 0 1 BIT_MASK 0x20 FORMAT "%13.11" ECU_ADDRESS 0x7FCA20 /end MEASUREMENT
/begin MEASUREMENT B_bkanwse "Bedingung Ersatzwert aktiv: NWS Endstufe (Bank1, Auslaﬂ)" UWORD B_TRUE 1 100 0 1 BIT_MASK 0x40 FORMAT "%13.11" ECU_ADDRESS 0x7FC896 /end MEASUREMENT
/begin MEASUREMENT B_bkanwse2 "Bedingung Ersatzwert aktiv: NWS Endstufe (Bank2, Auslaﬂ)" UWORD B_TRUE 1 100 0 1 BIT_MASK 0x40 FORMAT "%13.11" ECU_ADDRESS 0x7FC898 /end MEASUREMENT
/begin MEASUREMENT B_bkdsu "Bedingung: Umgebungsdrucksensor" UWORD B_TRUE 1 100 0 1 BIT_MASK 0x40 FORMAT "%13.11" ECU_ADDRESS 0x7FC8D2 /end MEASUREMENT
/begin MEASUREMENT B_bkegfe "Bedingung: Ersatzwert aktiv bei Eingangsgrˆﬂen der F¸llungserfassung" UWORD B_TRUE 1 100 0 1 BIT_MASK 0x40 FORMAT "%13.11" ECU_ADDRESS 0x7FC8EA /end MEASUREMENT
/begin MEASUREMENT B_bkenwse "Bedingung Ersatzwert aktiv: NWS Endstufe (Bank1, Einlaﬂ)" UWORD B_TRUE 1 100 0 1 BIT_MASK 0x40 FORMAT "%13.11" ECU_ADDRESS 0x7FC8F6 /end MEASUREMENT
/begin MEASUREMENT B_bkenwse2 "Bedingung Ersatzwert aktiv: NWS Endstufe (Bank2, Einlaﬂ)" UWORD B_TRUE 1 100 0 1 BIT_MASK 0x40 FORMAT "%13.11" ECU_ADDRESS 0x7FC8F8 /end MEASUREMENT
/begin MEASUREMENT B_bklm "Bedingung: Hauptlastsensor aktiv" UWORD B_TRUE 1 100 0 1 BIT_MASK 0x40 FORMAT "%13.11" ECU_ADDRESS 0x7FC96A /end MEASUREMENT
/begin MEASUREMENT B_bklzsr "Bedingung Ersatzwert aktiv: bei Leck zum Saugrohr" UWORD B_TRUE 1 100 0 1 BIT_MASK 0x40 FORMAT "%13.11" ECU_ADDRESS 0x7FC98A /end MEASUREMENT
/begin MEASUREMENT B_bkmdb "Bedingung: Momentan¸berwachung (bergrenzt dauerhaft) aktiv" UWORD B_TRUE 1 100 0 1 BIT_MASK 0x40 FORMAT "%13.11" ECU_ADDRESS 0x7FC9A6 /end MEASUREMENT
/begin MEASUREMENT B_bkpac "Bedingung Ersatzwert f¸r AC-Druck" UWORD B_TRUE 1 100 0 1 BIT_MASK 0x40 FORMAT "%13.11" ECU_ADDRESS 0x7FC9C0 /end MEASUREMENT
/begin MEASUREMENT B_bkph "Bedingung: Phasengeber aktiv" UWORD B_TRUE 1 100 0 1 BIT_MASK 0x40 FORMAT "%13.11" ECU_ADDRESS 0x7FC9C4 /end MEASUREMENT
/begin MEASUREMENT B_bkph2 "Bedingung: Phasengeber Bank 2 aktiv" UWORD B_TRUE 1 100 0 1 BIT_MASK 0x40 FORMAT "%13.11" ECU_ADDRESS 0x7FC9C6 /end MEASUREMENT
/begin MEASUREMENT B_bkph3 "Bedingung: Phasengeber 3 aktiv" UWORD B_TRUE 1 100 0 1 BIT_MASK 0x40 FORMAT "%13.11" ECU_ADDRESS 0x7FC9C8 /end MEASUREMENT
/begin MEASUREMENT B_bkph4 "Bedingung: Phasengeber 4 aktiv" UWORD B_TRUE 1 100 0 1 BIT_MASK 0x40 FORMAT "%13.11" ECU_ADDRESS 0x7FC9CA /end MEASUREMENT
/begin MEASUREMENT B_bkphm "Bedingung: Phasengeber MIL aktiv" UWORD B_TRUE 1 100 0 1 BIT_MASK 0x40 FORMAT "%13.11" ECU_ADDRESS 0x7FC9CC /end MEASUREMENT
/begin MEASUREMENT B_bkpn "" UWORD B_TRUE 1 100 0 1 BIT_MASK 0x40 FORMAT "%13.11" ECU_ADDRESS 0x7FC9CE /end MEASUREMENT
/begin MEASUREMENT B_bksls "Bedingung: Sekund‰rluftsystem aktiv" UWORD B_TRUE 1 100 0 1 BIT_MASK 0x40 FORMAT "%13.11" ECU_ADDRESS 0x7FC9DE /end MEASUREMENT
/begin MEASUREMENT B_bksls2 "Bedingung: Sekund‰rluftsystem Bank 2 aktiv" UWORD B_TRUE 1 100 0 1 BIT_MASK 0x40 FORMAT "%13.11" ECU_ADDRESS 0x7FC9E0 /end MEASUREMENT
/begin MEASUREMENT B_bkslv "Bedingung: Sekund‰rluftventil aktiv" UWORD B_TRUE 1 100 0 1 BIT_MASK 0x40 FORMAT "%13.11" ECU_ADDRESS 0x7FC9E2 /end MEASUREMENT
/begin MEASUREMENT B_bkslv2 "Bedingung: Sekund‰rluftventil Bank 2 aktiv" UWORD B_TRUE 1 100 0 1 BIT_MASK 0x40 FORMAT "%13.11" ECU_ADDRESS 0x7FC9E4 /end MEASUREMENT
/begin MEASUREMENT B_bkta "Bedingung Ersatzwert f¸r Ansauglufttemperatur (/Ladelufttemp.)" UWORD B_TRUE 1 100 0 1 BIT_MASK 0x40 FORMAT "%13.11" ECU_ADDRESS 0x7FC9F0 /end MEASUREMENT
/begin MEASUREMENT B_bktes "Bedingung Ersatzwert aktiv Tankdiagnose Tankentl¸ftungsventil offen" UWORD B_TRUE 1 100 0 1 BIT_MASK 0x40 FORMAT "%13.11" ECU_ADDRESS 0x7FC9F8 /end MEASUREMENT
/begin MEASUREMENT B_bkteve "Bedingung: Tankentl¸ftungsventil Endstufe aktiv" UWORD B_TRUE 1 100 0 1 BIT_MASK 0x40 FORMAT "%13.11" ECU_ADDRESS 0x7FC9FC /end MEASUREMENT
/begin MEASUREMENT B_bkthm "Bedingung Ersatzwert f¸r Thermostatfehler" UWORD B_TRUE 1 100 0 1 BIT_MASK 0x40 FORMAT "%13.11" ECU_ADDRESS 0x7FC9FE /end MEASUREMENT
/begin MEASUREMENT B_bktka "Bedingung Ersatzwert f¸r Temperatur K¸hlerausgang" UWORD B_TRUE 1 100 0 1 BIT_MASK 0x40 FORMAT "%13.11" ECU_ADDRESS 0x7FCA00 /end MEASUREMENT
/begin MEASUREMENT B_bktm "Bedingung Ersatzwert f¸r Motortemperatur" UWORD B_TRUE 1 100 0 1 BIT_MASK 0x40 FORMAT "%13.11" ECU_ADDRESS 0x7FCA02 /end MEASUREMENT
/begin MEASUREMENT B_bktol "Bedingung Ersatzwert f¸r (Motor-)Oel-Temperatur" UWORD B_TRUE 1 100 0 1 BIT_MASK 0x40 FORMAT "%13.11" ECU_ADDRESS 0x7FCA06 /end MEASUREMENT
/begin MEASUREMENT B_bkub "Bedingung Ersatzwert f¸r Batteriespannung (Bordnetz)" UWORD B_TRUE 1 100 0 1 BIT_MASK 0x40 FORMAT "%13.11" ECU_ADDRESS 0x7FCA0C /end MEASUREMENT
/begin MEASUREMENT B_bkufmv "Bedingung: Funktios¸berwachung Momentanvergleich aktiv" UWORD B_TRUE 1 100 0 1 BIT_MASK 0x40 FORMAT "%13.11" ECU_ADDRESS 0x7FCA0E /end MEASUREMENT
/begin MEASUREMENT B_bkufnc "Bedingung Ersatzwert aktiv:Funktions¸berwachung" UWORD B_TRUE 1 100 0 1 BIT_MASK 0x40 FORMAT "%13.11" ECU_ADDRESS 0x7FCA10 /end MEASUREMENT
/begin MEASUREMENT B_bkufrlip "Bedingung Ersatzwert aktiv:Funktions¸berwachung" UWORD B_TRUE 1 100 0 1 BIT_MASK 0x40 FORMAT "%13.11" ECU_ADDRESS 0x7FCA12 /end MEASUREMENT
/begin MEASUREMENT B_bkufsga "Bedingung Ersatzwert aktiv:Funktions¸berwachung" UWORD B_TRUE 1 100 0 1 BIT_MASK 0x40 FORMAT "%13.11" ECU_ADDRESS 0x7FCA14 /end MEASUREMENT
/begin MEASUREMENT B_bkufsgb "Bedingung Ersatzwert aktiv:Funktions¸berwachung" UWORD B_TRUE 1 100 0 1 BIT_MASK 0x40 FORMAT "%13.11" ECU_ADDRESS 0x7FCA16 /end MEASUREMENT
/begin MEASUREMENT B_bkufsgc "Bedingung Ersatzwert aktiv:Funktions¸berwachung" UWORD B_TRUE 1 100 0 1 BIT_MASK 0x40 FORMAT "%13.11" ECU_ADDRESS 0x7FCA18 /end MEASUREMENT
/begin MEASUREMENT B_bkufspsc "Bedingung Ersatzwert aktiv:Funktions¸berwachung" UWORD B_TRUE 1 100 0 1 BIT_MASK 0x40 FORMAT "%13.11" ECU_ADDRESS 0x7FCA1A /end MEASUREMENT
/begin MEASUREMENT B_bkurram "Bedingung: Rechner¸berwachung: RAM" UWORD B_TRUE 1 100 0 1 BIT_MASK 0x40 FORMAT "%13.11" ECU_ADDRESS 0x7FCA1C /end MEASUREMENT
/begin MEASUREMENT B_bkurrom "Bedingung: Rechner¸berwachung: ROM" UWORD B_TRUE 1 100 0 1 BIT_MASK 0x40 FORMAT "%13.11" ECU_ADDRESS 0x7FCA1E /end MEASUREMENT
/begin MEASUREMENT B_bkurrst "Bedingung: Rechner¸berwachung: RESET" UWORD B_TRUE 1 100 0 1 BIT_MASK 0x40 FORMAT "%13.11" ECU_ADDRESS 0x7FCA20 /end MEASUREMENT
/begin MEASUREMENT B_clanwse "Bedingung Fehlerpfad Nockenwellensteuerung Endstufe lˆschen (Bank1,Auslaﬂ)" UWORD B_TRUE 1 100 0 1 BIT_MASK 0x80 FORMAT "%13.11" ECU_ADDRESS 0x7FC896 /end MEASUREMENT
/begin MEASUREMENT B_clanwse2 "Bedingung Fehlerpfad Nockenwellensteuerung Endstufe lˆschen (Bank2,Auslaﬂ)" UWORD B_TRUE 1 100 0 1 BIT_MASK 0x80 FORMAT "%13.11" ECU_ADDRESS 0x7FC898 /end MEASUREMENT
/begin MEASUREMENT B_cldsu "Bedingung: Fehlerpfad Umgebungsdrucksensor lˆschen" UWORD B_TRUE 1 100 0 1 BIT_MASK 0x80 FORMAT "%13.11" ECU_ADDRESS 0x7FC8D2 /end MEASUREMENT
/begin MEASUREMENT B_clegfe "Bedingung Fehlerpfad EGFE lˆschen" UWORD B_TRUE 1 100 0 1 BIT_MASK 0x80 FORMAT "%13.11" ECU_ADDRESS 0x7FC8EA /end MEASUREMENT
/begin MEASUREMENT B_clenwse "Bedingung Fehlerpfad Nockenwellensteuerung Endstufe lˆschen (Bank1,Einlaﬂ)" UWORD B_TRUE 1 100 0 1 BIT_MASK 0x80 FORMAT "%13.11" ECU_ADDRESS 0x7FC8F6 /end MEASUREMENT
/begin MEASUREMENT B_clenwse2 "Bedingung Fehlerpfad Nockenwellensteuerung Endstufe lˆschen (Bank2,Einlaﬂ)" UWORD B_TRUE 1 100 0 1 BIT_MASK 0x80 FORMAT "%13.11" ECU_ADDRESS 0x7FC8F8 /end MEASUREMENT
/begin MEASUREMENT B_cllm "Bedingung: Fehlerpfad Hauptf¸llungssensor lˆschen" UWORD B_TRUE 1 100 0 1 BIT_MASK 0x80 FORMAT "%13.11" ECU_ADDRESS 0x7FC96A /end MEASUREMENT
/begin MEASUREMENT B_cllzsr "Bedingung Fehlerpfad LZSR lˆschen" UWORD B_TRUE 1 100 0 1 BIT_MASK 0x80 FORMAT "%13.11" ECU_ADDRESS 0x7FC98A /end MEASUREMENT
/begin MEASUREMENT B_clmdb "Flag f¸r Lˆschung: Momentenbegrenzung begrenzt dauerhaft" UWORD B_TRUE 1 100 0 1 BIT_MASK 0x80 FORMAT "%13.11" ECU_ADDRESS 0x7FC9A6 /end MEASUREMENT
/begin MEASUREMENT B_clpac "Bedingung Fehlerpfad AC-Drucksensor lˆschen" UWORD B_TRUE 1 100 0 1 BIT_MASK 0x80 FORMAT "%13.11" ECU_ADDRESS 0x7FC9C0 /end MEASUREMENT
/begin MEASUREMENT B_clph "Bedingung Fehlerpfad PH lˆschen" UWORD B_TRUE 1 100 0 1 BIT_MASK 0x80 FORMAT "%13.11" ECU_ADDRESS 0x7FC9C4 /end MEASUREMENT
/begin MEASUREMENT B_clph2 "Bedingung Fehlerpfad Phasengeber 2 lˆschen" UWORD B_TRUE 1 100 0 1 BIT_MASK 0x80 FORMAT "%13.11" ECU_ADDRESS 0x7FC9C6 /end MEASUREMENT
/begin MEASUREMENT B_clph3 "Bedingung Fehlerpfad Phasengeber 3 lˆschen" UWORD B_TRUE 1 100 0 1 BIT_MASK 0x80 FORMAT "%13.11" ECU_ADDRESS 0x7FC9C8 /end MEASUREMENT
/begin MEASUREMENT B_clph4 "Bedingung Fehlerpfad Phasengeber 4 lˆschen" UWORD B_TRUE 1 100 0 1 BIT_MASK 0x80 FORMAT "%13.11" ECU_ADDRESS 0x7FC9CA /end MEASUREMENT
/begin MEASUREMENT B_clphm "Bedingung Fehlerpfad Phasengeber MIL lˆschen" UWORD B_TRUE 1 100 0 1 BIT_MASK 0x80 FORMAT "%13.11" ECU_ADDRESS 0x7FC9CC /end MEASUREMENT
/begin MEASUREMENT B_clpn "Bedingung Fehlerflag ""P/N-Switch"" loeschen" UWORD B_TRUE 1 100 0 1 BIT_MASK 0x80 FORMAT "%13.11" ECU_ADDRESS 0x7FC9CE /end MEASUREMENT
/begin MEASUREMENT B_clsls "Bedingung: Fehler Sekund‰rluftsystem lˆschen" UWORD B_TRUE 1 100 0 1 BIT_MASK 0x80 FORMAT "%13.11" ECU_ADDRESS 0x7FC9DE /end MEASUREMENT
/begin MEASUREMENT B_clsls2 "Bedingung: Fehler Sekund‰rluftsystem lˆschen (Bank 2)" UWORD B_TRUE 1 100 0 1 BIT_MASK 0x80 FORMAT "%13.11" ECU_ADDRESS 0x7FC9E0 /end MEASUREMENT
/begin MEASUREMENT B_clslv "Bedingung: Fehler Sekund‰rluftventil lˆschen" UWORD B_TRUE 1 100 0 1 BIT_MASK 0x80 FORMAT "%13.11" ECU_ADDRESS 0x7FC9E2 /end MEASUREMENT
/begin MEASUREMENT B_clslv2 "Bedingung: Fehler Sekund‰rluftventil lˆschen (Bank 2)" UWORD B_TRUE 1 100 0 1 BIT_MASK 0x80 FORMAT "%13.11" ECU_ADDRESS 0x7FC9E4 /end MEASUREMENT
/begin MEASUREMENT B_clta "Bedingung Fehlerpfad Ansauglufttemperatur (/Ladeluft-) TANS lˆschen" UWORD B_TRUE 1 100 0 1 BIT_MASK 0x80 FORMAT "%13.11" ECU_ADDRESS 0x7FC9F0 /end MEASUREMENT
/begin MEASUREMENT B_cltes "Bedingung Fehlerflag ""Tankentl¸ftungssystem offen"" lˆschen" UWORD B_TRUE 1 100 0 1 BIT_MASK 0x80 FORMAT "%13.11" ECU_ADDRESS 0x7FC9F8 /end MEASUREMENT
/begin MEASUREMENT B_clteve "Bedingung Fehlerphad TEVE lˆschen" UWORD B_TRUE 1 100 0 1 BIT_MASK 0x80 FORMAT "%13.11" ECU_ADDRESS 0x7FC9FC /end MEASUREMENT
/begin MEASUREMENT B_clthm "Bedingung Fehlerpfad K¸hlwasserthermostat lˆschen" UWORD B_TRUE 1 100 0 1 BIT_MASK 0x80 FORMAT "%13.11" ECU_ADDRESS 0x7FC9FE /end MEASUREMENT
/begin MEASUREMENT B_cltka "Bedingung Fehlerpfad Temperatur K¸hlerausgang TKA lˆschen" UWORD B_TRUE 1 100 0 1 BIT_MASK 0x80 FORMAT "%13.11" ECU_ADDRESS 0x7FCA00 /end MEASUREMENT
/begin MEASUREMENT B_cltm "Bedingung Fehlerpfad Motortemperatur TMOT lˆschen" UWORD B_TRUE 1 100 0 1 BIT_MASK 0x80 FORMAT "%13.11" ECU_ADDRESS 0x7FCA02 /end MEASUREMENT
/begin MEASUREMENT B_cltol "Bedingung Fehlerpfad (Motor-)Oeltemperatur TOL lˆschen" UWORD B_TRUE 1 100 0 1 BIT_MASK 0x80 FORMAT "%13.11" ECU_ADDRESS 0x7FCA06 /end MEASUREMENT
/begin MEASUREMENT B_club "Bedingung Fehlerpfad Batteriespannung (Bordnetz) lˆschen" UWORD B_TRUE 1 100 0 1 BIT_MASK 0x80 FORMAT "%13.11" ECU_ADDRESS 0x7FCA0C /end MEASUREMENT
/begin MEASUREMENT B_clufmv "Flag f¸r Lˆschung: Funktions¸berwachung: Momentenvergleich" UWORD B_TRUE 1 100 0 1 BIT_MASK 0x80 FORMAT "%13.11" ECU_ADDRESS 0x7FCA0E /end MEASUREMENT
/begin MEASUREMENT B_clufnc "Flag f¸r Lˆschung: Fkt¸berwachung: Drehzahlgeber-, Zuleitung- oder SG-Fehler" UWORD B_TRUE 1 100 0 1 BIT_MASK 0x80 FORMAT "%13.11" ECU_ADDRESS 0x7FCA10 /end MEASUREMENT
/begin MEASUREMENT B_clufrlip "Flag f¸r Lˆschung: Fkt¸berwachung: Lastsensor-, Zuleitung- oder SG-Fehler" UWORD B_TRUE 1 100 0 1 BIT_MASK 0x80 FORMAT "%13.11" ECU_ADDRESS 0x7FCA12 /end MEASUREMENT
/begin MEASUREMENT B_clufsga "Flag f¸r Lˆschung: Funktions¸berwachung: Steuerger‰te-Fehler Gruppe a" UWORD B_TRUE 1 100 0 1 BIT_MASK 0x80 FORMAT "%13.11" ECU_ADDRESS 0x7FCA14 /end MEASUREMENT
/begin MEASUREMENT B_clufsgb "Flag f¸r Lˆschung: Funktions¸berwachung: Steuerger‰te-Fehler Gruppe b" UWORD B_TRUE 1 100 0 1 BIT_MASK 0x80 FORMAT "%13.11" ECU_ADDRESS 0x7FCA16 /end MEASUREMENT
/begin MEASUREMENT B_clufsgc "Flag f¸r Lˆschung: Funktions¸berwachung: Steuerger‰te-Fehler Gruppe c" UWORD B_TRUE 1 100 0 1 BIT_MASK 0x80 FORMAT "%13.11" ECU_ADDRESS 0x7FCA18 /end MEASUREMENT
/begin MEASUREMENT B_clufspsc "Flag f¸r Lˆschung: Fkt¸berwachung: Pedalwertgeber-, Zuleitung- oder SG-Fehler" UWORD B_TRUE 1 100 0 1 BIT_MASK 0x80 FORMAT "%13.11" ECU_ADDRESS 0x7FCA1A /end MEASUREMENT
/begin MEASUREMENT B_clurram "Flag f¸r Lˆschung: Rechner¸berwachung: RAM" UWORD B_TRUE 1 100 0 1 BIT_MASK 0x80 FORMAT "%13.11" ECU_ADDRESS 0x7FCA1C /end MEASUREMENT
/begin MEASUREMENT B_clurrom "Flag f¸r Lˆschung: Rechner¸berwachung: ROM" UWORD B_TRUE 1 100 0 1 BIT_MASK 0x80 FORMAT "%13.11" ECU_ADDRESS 0x7FCA1E /end MEASUREMENT
/begin MEASUREMENT B_clurrst "Flag f¸r Lˆschung: Rechner¸berwachung: Reset" UWORD B_TRUE 1 100 0 1 BIT_MASK 0x80 FORMAT "%13.11" ECU_ADDRESS 0x7FCA20 /end MEASUREMENT
/begin MEASUREMENT B_falm "" UWORD B_TRUE 1 100 0 1 BIT_MASK 0x10 FORMAT "%13.11" ECU_ADDRESS 0x7FC96A /end MEASUREMENT
/begin MEASUREMENT B_fapac "" UWORD B_TRUE 1 100 0 1 BIT_MASK 0x10 FORMAT "%13.11" ECU_ADDRESS 0x7FC9C0 /end MEASUREMENT
/begin MEASUREMENT B_ftanwse "Bedingung: Fehlereintrag durch Tester f¸r NWS Endstufe (Auslaﬂ, Bank1)" UWORD B_TRUE 1 100 0 1 BIT_MASK 0x10 FORMAT "%13.11" ECU_ADDRESS 0x7FC896 /end MEASUREMENT
/begin MEASUREMENT B_ftanwse2 "Bedingung: Fehlereintrag durch Tester f¸r NWS Endstufe (Auslaﬂ, Bank2)" UWORD B_TRUE 1 100 0 1 BIT_MASK 0x10 FORMAT "%13.11" ECU_ADDRESS 0x7FC898 /end MEASUREMENT
/begin MEASUREMENT B_ftdsu "Bedingung: Fehlereintrag durch Tester f¸r DSU" UWORD B_TRUE 1 100 0 1 BIT_MASK 0x10 FORMAT "%13.11" ECU_ADDRESS 0x7FC8D2 /end MEASUREMENT
/begin MEASUREMENT B_ftegfe "Bedingung: Fehlereintrag durch Tester f¸r DEGFE" UWORD B_TRUE 1 100 0 1 BIT_MASK 0x10 FORMAT "%13.11" ECU_ADDRESS 0x7FC8EA /end MEASUREMENT
/begin MEASUREMENT B_ftenwse "Bedingung: Fehlereintrag durch Tester f¸r NWS Endstufe (Einlaﬂ, Bank1)" UWORD B_TRUE 1 100 0 1 BIT_MASK 0x10 FORMAT "%13.11" ECU_ADDRESS 0x7FC8F6 /end MEASUREMENT
/begin MEASUREMENT B_ftenwse2 "Bedingung: Fehlereintrag durch Tester f¸r NWS Endstufe (Einlaﬂ, Bank2)" UWORD B_TRUE 1 100 0 1 BIT_MASK 0x10 FORMAT "%13.11" ECU_ADDRESS 0x7FC8F8 /end MEASUREMENT
/begin MEASUREMENT B_ftlzsr "Bedingung: Fehlereintrag durch Tester f¸r BGADAP, Fehlerpfad" UWORD B_TRUE 1 100 0 1 BIT_MASK 0x10 FORMAT "%13.11" ECU_ADDRESS 0x7FC98A /end MEASUREMENT
/begin MEASUREMENT B_ftmdb "Bedingung: Fehlereintrag durch Tester f¸r MDB" UWORD B_TRUE 1 100 0 1 BIT_MASK 0x10 FORMAT "%13.11" ECU_ADDRESS 0x7FC9A6 /end MEASUREMENT
/begin MEASUREMENT B_ftph "Bedingung Fehlereintrag durch Tester f¸r Phasensensor" UWORD B_TRUE 1 100 0 1 BIT_MASK 0x10 FORMAT "%13.11" ECU_ADDRESS 0x7FC9C4 /end MEASUREMENT
/begin MEASUREMENT B_ftph2 "Bedingung: Fehlereintrag durch Tester f¸r Phasengeber 2" UWORD B_TRUE 1 100 0 1 BIT_MASK 0x10 FORMAT "%13.11" ECU_ADDRESS 0x7FC9C6 /end MEASUREMENT
/begin MEASUREMENT B_ftph3 "Bedingung: Fehlereintrag durch Tester f¸r Phasengeber 3" UWORD B_TRUE 1 100 0 1 BIT_MASK 0x10 FORMAT "%13.11" ECU_ADDRESS 0x7FC9C8 /end MEASUREMENT
/begin MEASUREMENT B_ftph4 "Bedingung: Fehlereintrag durch Tester f¸r Phasengeber 4" UWORD B_TRUE 1 100 0 1 BIT_MASK 0x10 FORMAT "%13.11" ECU_ADDRESS 0x7FC9CA /end MEASUREMENT
/begin MEASUREMENT B_ftphm "Bedingung: Fehlereintrag durch Tester f¸r Phasengeber MIL" UWORD B_TRUE 1 100 0 1 BIT_MASK 0x10 FORMAT "%13.11" ECU_ADDRESS 0x7FC9CC /end MEASUREMENT
/begin MEASUREMENT B_ftpn "" UWORD B_TRUE 1 100 0 1 BIT_MASK 0x10 FORMAT "%13.11" ECU_ADDRESS 0x7FC9CE /end MEASUREMENT
/begin MEASUREMENT B_ftsls "Bedingung: Fehlereintrag durch Tester f¸r Katheizen" UWORD B_TRUE 1 100 0 1 BIT_MASK 0x10 FORMAT "%13.11" ECU_ADDRESS 0x7FC9DE /end MEASUREMENT
/begin MEASUREMENT B_ftsls2 "Bedingung: Fehlereintrag durch Tester f¸r SLS, Bank2" UWORD B_TRUE 1 100 0 1 BIT_MASK 0x10 FORMAT "%13.11" ECU_ADDRESS 0x7FC9E0 /end MEASUREMENT
/begin MEASUREMENT B_ftslv "Bedingung: Fehlereintrag durch Tester f¸r SLV" UWORD B_TRUE 1 100 0 1 BIT_MASK 0x10 FORMAT "%13.11" ECU_ADDRESS 0x7FC9E2 /end MEASUREMENT
/begin MEASUREMENT B_ftslv2 "Bedingung: Fehlereintrag durch Tester f¸r SLV, Bank2" UWORD B_TRUE 1 100 0 1 BIT_MASK 0x10 FORMAT "%13.11" ECU_ADDRESS 0x7FC9E4 /end MEASUREMENT
/begin MEASUREMENT B_ftta "Bedingung Fehlereintrag durch Tester Ansauglufttemperatur" UWORD B_TRUE 1 100 0 1 BIT_MASK 0x10 FORMAT "%13.11" ECU_ADDRESS 0x7FC9F0 /end MEASUREMENT
/begin MEASUREMENT B_fttes "Bedingung Fehlereintrag durch Tester f¸r TEV" UWORD B_TRUE 1 100 0 1 BIT_MASK 0x10 FORMAT "%13.11" ECU_ADDRESS 0x7FC9F8 /end MEASUREMENT
/begin MEASUREMENT B_ftteve "Bedingung Fehlereintrag durch Tester Tankentl¸ftungsventil Endstufe" UWORD B_TRUE 1 100 0 1 BIT_MASK 0x10 FORMAT "%13.11" ECU_ADDRESS 0x7FC9FC /end MEASUREMENT
/begin MEASUREMENT B_ftthm "Bedingung Fehlereintrag durch Tester Thermostat monitoring" UWORD B_TRUE 1 100 0 1 BIT_MASK 0x10 FORMAT "%13.11" ECU_ADDRESS 0x7FC9FE /end MEASUREMENT
/begin MEASUREMENT B_fttka "" UWORD B_TRUE 1 100 0 1 BIT_MASK 0x10 FORMAT "%13.11" ECU_ADDRESS 0x7FCA00 /end MEASUREMENT
/begin MEASUREMENT B_fttm "Bedingung Fehlereintrag durch Tester f¸r Motor-/K¸hlmittel-Temperatur" UWORD B_TRUE 1 100 0 1 BIT_MASK 0x10 FORMAT "%13.11" ECU_ADDRESS 0x7FCA02 /end MEASUREMENT
/begin MEASUREMENT B_fttol "Bedingung: Fehlereintrag durch Tester" UWORD B_TRUE 1 100 0 1 BIT_MASK 0x10 FORMAT "%13.11" ECU_ADDRESS 0x7FCA06 /end MEASUREMENT
/begin MEASUREMENT B_ftub "Bedingung Fehlereintrag durch Tester f¸r Batteriespannung (Bordnetz)" UWORD B_TRUE 1 100 0 1 BIT_MASK 0x10 FORMAT "%13.11" ECU_ADDRESS 0x7FCA0C /end MEASUREMENT
/begin MEASUREMENT B_ftufmv "Bedingung: Fehlereintrag durch Tester: Momentvergleich" UWORD B_TRUE 1 100 0 1 BIT_MASK 0x10 FORMAT "%13.11" ECU_ADDRESS 0x7FCA0E /end MEASUREMENT
/begin MEASUREMENT B_ftufnc "Bedingung: Fehlereintrag durch Tester:Drehzahlgeber-,Zuleitung oder SG-Fehler" UWORD B_TRUE 1 100 0 1 BIT_MASK 0x10 FORMAT "%13.11" ECU_ADDRESS 0x7FCA10 /end MEASUREMENT
/begin MEASUREMENT B_ftufrlip "Bedingung: Fehlereintrag durch Tester: Lastsensor-,Zuleitung- oder SG-Fehler" UWORD B_TRUE 1 100 0 1 BIT_MASK 0x10 FORMAT "%13.11" ECU_ADDRESS 0x7FCA12 /end MEASUREMENT
/begin MEASUREMENT B_ftufsga "Bedingung: Fehlereintrag durch Tester: SG-Fehler Gruppe a" UWORD B_TRUE 1 100 0 1 BIT_MASK 0x10 FORMAT "%13.11" ECU_ADDRESS 0x7FCA14 /end MEASUREMENT
/begin MEASUREMENT B_ftufsgb "Bedingung: Fehlereintrag durch Tester: SG-Fehler Gruppe b" UWORD B_TRUE 1 100 0 1 BIT_MASK 0x10 FORMAT "%13.11" ECU_ADDRESS 0x7FCA16 /end MEASUREMENT
/begin MEASUREMENT B_ftufsgc "Bedingung: Fehlereintrag durch Tester: SG-Fehler Gruppe c" UWORD B_TRUE 1 100 0 1 BIT_MASK 0x10 FORMAT "%13.11" ECU_ADDRESS 0x7FCA18 /end MEASUREMENT
/begin MEASUREMENT B_ftufspsc "Bedingung: Fehlereintrag durch Tester:Pedalwertgeber-,Zuleitung oder SG-Fehler" UWORD B_TRUE 1 100 0 1 BIT_MASK 0x10 FORMAT "%13.11" ECU_ADDRESS 0x7FCA1A /end MEASUREMENT
/begin MEASUREMENT B_fturram "" UWORD B_TRUE 1 100 0 1 BIT_MASK 0x10 FORMAT "%13.11" ECU_ADDRESS 0x7FCA1C /end MEASUREMENT
/begin MEASUREMENT B_fturrom "" UWORD B_TRUE 1 100 0 1 BIT_MASK 0x10 FORMAT "%13.11" ECU_ADDRESS 0x7FCA1E /end MEASUREMENT
/begin MEASUREMENT B_fturrst "" UWORD B_TRUE 1 100 0 1 BIT_MASK 0x10 FORMAT "%13.11" ECU_ADDRESS 0x7FCA20 /end MEASUREMENT
/begin MEASUREMENT B_mnanwse "Fehlerart: Kurzschluﬂ Masse Nockenwellensteuerungsventil Endstufe (Bank1,Auslaﬂ)" UWORD B_TRUE 1 100 0 1 BIT_MASK 0x200 FORMAT "%13.11" ECU_ADDRESS 0x7FC896 /end MEASUREMENT
/begin MEASUREMENT B_mnanwse2 "Fehlerart: Kurzschluﬂ Masse Nockenwellensteuerungsventil Endstufe (Bank2,Auslaﬂ)" UWORD B_TRUE 1 100 0 1 BIT_MASK 0x200 FORMAT "%13.11" ECU_ADDRESS 0x7FC898 /end MEASUREMENT
/begin MEASUREMENT B_mndsu "Bedingung: min-Fehler Umgebungsdrucksensor" UWORD B_TRUE 1 100 0 1 BIT_MASK 0x200 FORMAT "%13.11" ECU_ADDRESS 0x7FC8D2 /end MEASUREMENT
/begin MEASUREMENT B_mnegfe "Bedingung: MIN-Fehler Eingangsgrˆﬂen F¸llungserfassung" UWORD B_TRUE 1 100 0 1 BIT_MASK 0x200 FORMAT "%13.11" ECU_ADDRESS 0x7FC8EA /end MEASUREMENT
/begin MEASUREMENT B_mnenwse "Fehlerart: Kurzschluﬂ Masse Nockenwellensteuerungsventil Endstufe" UWORD B_TRUE 1 100 0 1 BIT_MASK 0x200 FORMAT "%13.11" ECU_ADDRESS 0x7FC8F6 /end MEASUREMENT
/begin MEASUREMENT B_mnenwse2 "Bedingung: min. Fehler Nockenwellensteuerung Endstufe (Bank2, Einlaﬂ)" UWORD B_TRUE 1 100 0 1 BIT_MASK 0x200 FORMAT "%13.11" ECU_ADDRESS 0x7FC8F8 /end MEASUREMENT
/begin MEASUREMENT B_mnlm "Bedingung: min-Fehler Hauptf¸llungssensor" UWORD B_TRUE 1 100 0 1 BIT_MASK 0x200 FORMAT "%13.11" ECU_ADDRESS 0x7FC96A /end MEASUREMENT
/begin MEASUREMENT B_mnlzsr "Bedingung: min. Fehler Leck zum Saugrohr" UWORD B_TRUE 1 100 0 1 BIT_MASK 0x200 FORMAT "%13.11" ECU_ADDRESS 0x7FC98A /end MEASUREMENT
/begin MEASUREMENT B_mnmdb "Fehlertyp min.: Momentan¸berwachung begrenzt dauerhaft" UWORD B_TRUE 1 100 0 1 BIT_MASK 0x200 FORMAT "%13.11" ECU_ADDRESS 0x7FC9A6 /end MEASUREMENT
/begin MEASUREMENT B_mnpac "Fehlertyp 'Minimalwert' AC-Druck-Sensor erkannt" UWORD B_TRUE 1 100 0 1 BIT_MASK 0x200 FORMAT "%13.11" ECU_ADDRESS 0x7FC9C0 /end MEASUREMENT
/begin MEASUREMENT B_mnph "Fehlerart: Kurzschluﬂ Masse Phasengeber" UWORD B_TRUE 1 100 0 1 BIT_MASK 0x200 FORMAT "%13.11" ECU_ADDRESS 0x7FC9C4 /end MEASUREMENT
/begin MEASUREMENT B_mnph2 "Fehlerart: Kurzschluﬂ Masse Phasengeber 2" UWORD B_TRUE 1 100 0 1 BIT_MASK 0x200 FORMAT "%13.11" ECU_ADDRESS 0x7FC9C6 /end MEASUREMENT
/begin MEASUREMENT B_mnph3 "Fehlerart: Kurzschluﬂ Masse Phasengeber 3" UWORD B_TRUE 1 100 0 1 BIT_MASK 0x200 FORMAT "%13.11" ECU_ADDRESS 0x7FC9C8 /end MEASUREMENT
/begin MEASUREMENT B_mnph4 "Fehlerart: Kurzschluﬂ Masse Phasengeber 4" UWORD B_TRUE 1 100 0 1 BIT_MASK 0x200 FORMAT "%13.11" ECU_ADDRESS 0x7FC9CA /end MEASUREMENT
/begin MEASUREMENT B_mnphm "Fehlerart: Minfehler Phasengeber MIL" UWORD B_TRUE 1 100 0 1 BIT_MASK 0x200 FORMAT "%13.11" ECU_ADDRESS 0x7FC9CC /end MEASUREMENT
/begin MEASUREMENT B_mnpn "" UWORD B_TRUE 1 100 0 1 BIT_MASK 0x200 FORMAT "%13.11" ECU_ADDRESS 0x7FC9CE /end MEASUREMENT
/begin MEASUREMENT B_mnsls "Fehlerart: Sekund‰rluftmasse zu gering" UWORD B_TRUE 1 100 0 1 BIT_MASK 0x200 FORMAT "%13.11" ECU_ADDRESS 0x7FC9DE /end MEASUREMENT
/begin MEASUREMENT B_mnsls2 "Fehlerart: Sekund‰rluftmasse zu gering, Bank 2" UWORD B_TRUE 1 100 0 1 BIT_MASK 0x200 FORMAT "%13.11" ECU_ADDRESS 0x7FC9E0 /end MEASUREMENT
/begin MEASUREMENT B_mnslv "Fehlerart:" UWORD B_TRUE 1 100 0 1 BIT_MASK 0x200 FORMAT "%13.11" ECU_ADDRESS 0x7FC9E2 /end MEASUREMENT
/begin MEASUREMENT B_mnslv2 "Fehlerart:" UWORD B_TRUE 1 100 0 1 BIT_MASK 0x200 FORMAT "%13.11" ECU_ADDRESS 0x7FC9E4 /end MEASUREMENT
/begin MEASUREMENT B_mnta "Fehlertyp: Minimalwertunterschreitung Ansauglufttemperatur TANS" UWORD B_TRUE 1 100 0 1 BIT_MASK 0x200 FORMAT "%13.11" ECU_ADDRESS 0x7FC9F0 /end MEASUREMENT
/begin MEASUREMENT B_mntes "Fehlertyp 'Minimalwert' erkannt" UWORD B_TRUE 1 100 0 1 BIT_MASK 0x200 FORMAT "%13.11" ECU_ADDRESS 0x7FC9F8 /end MEASUREMENT
/begin MEASUREMENT B_mnteve "Fehlertyp: Kurzschluﬂ Masse Tankentl¸ftungsventil Endstufe" UWORD B_TRUE 1 100 0 1 BIT_MASK 0x200 FORMAT "%13.11" ECU_ADDRESS 0x7FC9FC /end MEASUREMENT
/begin MEASUREMENT B_mnthm "Fehlerart: MIN-Fehler Thermostatdiagnose" UWORD B_TRUE 1 100 0 1 BIT_MASK 0x200 FORMAT "%13.11" ECU_ADDRESS 0x7FC9FE /end MEASUREMENT
/begin MEASUREMENT B_mntka "Fehlertyp: Minimalwertunterschreitung Temperatur K¸hlerausgang" UWORD B_TRUE 1 100 0 1 BIT_MASK 0x200 FORMAT "%13.11" ECU_ADDRESS 0x7FCA00 /end MEASUREMENT
/begin MEASUREMENT B_mntm "Fehlertyp: Minimalwertunterschreitung Motortemperatur" UWORD B_TRUE 1 100 0 1 BIT_MASK 0x200 FORMAT "%13.11" ECU_ADDRESS 0x7FCA02 /end MEASUREMENT
/begin MEASUREMENT B_mntol "Fehlertyp: Minimalwertunterschreitung (Motor-) Oeltemperatur" UWORD B_TRUE 1 100 0 1 BIT_MASK 0x200 FORMAT "%13.11" ECU_ADDRESS 0x7FCA06 /end MEASUREMENT
/begin MEASUREMENT B_mnub "Fehlertyp: Minimalwertunterschreitung Batteriespannung (Bordnetz)" UWORD B_TRUE 1 100 0 1 BIT_MASK 0x200 FORMAT "%13.11" ECU_ADDRESS 0x7FCA0C /end MEASUREMENT
/begin MEASUREMENT B_mnufmv "Fehlertyp min.: Funktions¸berwachung: Momentenvergleich" UWORD B_TRUE 1 100 0 1 BIT_MASK 0x200 FORMAT "%13.11" ECU_ADDRESS 0x7FCA0E /end MEASUREMENT
/begin MEASUREMENT B_mnufnc "Fehlertyp min.:Fkt¸berwachung:Drehzahlgeber-,Zuleitung- oder SG-Fehler" UWORD B_TRUE 1 100 0 1 BIT_MASK 0x200 FORMAT "%13.11" ECU_ADDRESS 0x7FCA10 /end MEASUREMENT
/begin MEASUREMENT B_mnufrlip "Fehlertyp min.: Fkt¸berw: Lastsensor-, Zuleitung- oder SG-Fehler (ei_dps_um)" UWORD B_TRUE 1 100 0 1 BIT_MASK 0x200 FORMAT "%13.11" ECU_ADDRESS 0x7FCA12 /end MEASUREMENT
/begin MEASUREMENT B_mnufsga "Fehlertyp min.: Funktions¸berwachung: Steuerger‰te-Fehler Gruppe a (ei_zwc_um)" UWORD B_TRUE 1 100 0 1 BIT_MASK 0x200 FORMAT "%13.11" ECU_ADDRESS 0x7FCA14 /end MEASUREMENT
/begin MEASUREMENT B_mnufsgb "Fehlertyp min.: Funktions¸berwachung: Steuerger‰te-Fehler Gruppe b (ei_rkti_um)" UWORD B_TRUE 1 100 0 1 BIT_MASK 0x200 FORMAT "%13.11" ECU_ADDRESS 0x7FCA16 /end MEASUREMENT
/begin MEASUREMENT B_mnufsgc "Fehlertyp min.:Fkt¸berwachung:SG-Fehler Gruppe c" UWORD B_TRUE 1 100 0 1 BIT_MASK 0x200 FORMAT "%13.11" ECU_ADDRESS 0x7FCA18 /end MEASUREMENT
/begin MEASUREMENT B_mnufspsc "Fehlertyp min.:Fkt¸berwachung:Pedalwertgeber-,Zuleitung- oder SG-Fehler" UWORD B_TRUE 1 100 0 1 BIT_MASK 0x200 FORMAT "%13.11" ECU_ADDRESS 0x7FCA1A /end MEASUREMENT
/begin MEASUREMENT B_mnurram "Fehlertyp min.: Rechner¸berwachung: RAM" UWORD B_TRUE 1 100 0 1 BIT_MASK 0x200 FORMAT "%13.11" ECU_ADDRESS 0x7FCA1C /end MEASUREMENT
/begin MEASUREMENT B_mnurrom "Fehlertyp min.: Rechner¸berwachung: ROM" UWORD B_TRUE 1 100 0 1 BIT_MASK 0x200 FORMAT "%13.11" ECU_ADDRESS 0x7FCA1E /end MEASUREMENT
/begin MEASUREMENT B_mnurrst "Fehlertyp min.: Rechner¸berwachung: Reset" UWORD B_TRUE 1 100 0 1 BIT_MASK 0x200 FORMAT "%13.11" ECU_ADDRESS 0x7FCA20 /end MEASUREMENT
/begin MEASUREMENT B_mxanwse "Fehlerart: Kurzschluﬂ Ubat Nockenwellensteuerungsventil Endstufe (Bank1, Auslaﬂ)" UWORD B_TRUE 1 100 0 1 BIT_MASK 0x100 FORMAT "%13.11" ECU_ADDRESS 0x7FC896 /end MEASUREMENT
/begin MEASUREMENT B_mxanwse2 "Fehlerart: Kurzschluﬂ Ubat Nockenwellensteuerungsventil Endstufe (Bank2, Auslaﬂ)" UWORD B_TRUE 1 100 0 1 BIT_MASK 0x100 FORMAT "%13.11" ECU_ADDRESS 0x7FC898 /end MEASUREMENT
/begin MEASUREMENT B_mxdsu "Bedingung: max-Fehler Umgebungsdrucksensor" UWORD B_TRUE 1 100 0 1 BIT_MASK 0x100 FORMAT "%13.11" ECU_ADDRESS 0x7FC8D2 /end MEASUREMENT
/begin MEASUREMENT B_mxegfe "Bedingung: MAX-Fehler Eingangsgrˆﬂen F¸llungserfassung" UWORD B_TRUE 1 100 0 1 BIT_MASK 0x100 FORMAT "%13.11" ECU_ADDRESS 0x7FC8EA /end MEASUREMENT
/begin MEASUREMENT B_mxenwse "Fehlerart: Kurzschluﬂ Ubat Nockenwellensteuerungsventil Endstufe" UWORD B_TRUE 1 100 0 1 BIT_MASK 0x100 FORMAT "%13.11" ECU_ADDRESS 0x7FC8F6 /end MEASUREMENT
/begin MEASUREMENT B_mxenwse2 "Bedingung: max. Fehler Nockenwellensteuerung Endstufe (Bank2, Einlaﬂ)" UWORD B_TRUE 1 100 0 1 BIT_MASK 0x100 FORMAT "%13.11" ECU_ADDRESS 0x7FC8F8 /end MEASUREMENT
/begin MEASUREMENT B_mxlm "Bedingung: max-Fehler Hauptf¸llungssensor" UWORD B_TRUE 1 100 0 1 BIT_MASK 0x100 FORMAT "%13.11" ECU_ADDRESS 0x7FC96A /end MEASUREMENT
/begin MEASUREMENT B_mxlzsr "Bedingung: max. Fehler Leck zum Saugrohr" UWORD B_TRUE 1 100 0 1 BIT_MASK 0x100 FORMAT "%13.11" ECU_ADDRESS 0x7FC98A /end MEASUREMENT
/begin MEASUREMENT B_mxmdb "Fehlerart: Maximal zul‰ssiges Sollmoment wird dauerhaft ¸berschritten" UWORD B_TRUE 1 100 0 1 BIT_MASK 0x100 FORMAT "%13.11" ECU_ADDRESS 0x7FC9A6 /end MEASUREMENT
/begin MEASUREMENT B_mxpac "Fehlertyp 'Maximalwert' AC-Druck-Sensor erkannt" UWORD B_TRUE 1 100 0 1 BIT_MASK 0x100 FORMAT "%13.11" ECU_ADDRESS 0x7FC9C0 /end MEASUREMENT
/begin MEASUREMENT B_mxph "Fehlerart: Kurzschluﬂ Ubat Phasengeber" UWORD B_TRUE 1 100 0 1 BIT_MASK 0x100 FORMAT "%13.11" ECU_ADDRESS 0x7FC9C4 /end MEASUREMENT
/begin MEASUREMENT B_mxph2 "Fehlerart: Kurzschluﬂ  Ubat Phasengeber 2" UWORD B_TRUE 1 100 0 1 BIT_MASK 0x100 FORMAT "%13.11" ECU_ADDRESS 0x7FC9C6 /end MEASUREMENT
/begin MEASUREMENT B_mxph3 "Fehlerart: Kurzschluﬂ  Ubat Phasengeber 3" UWORD B_TRUE 1 100 0 1 BIT_MASK 0x100 FORMAT "%13.11" ECU_ADDRESS 0x7FC9C8 /end MEASUREMENT
/begin MEASUREMENT B_mxph4 "Fehlerart: Kurzschluﬂ  Ubat Phasengeber 4" UWORD B_TRUE 1 100 0 1 BIT_MASK 0x100 FORMAT "%13.11" ECU_ADDRESS 0x7FC9CA /end MEASUREMENT
/begin MEASUREMENT B_mxphm "Fehlerart: Maxfehler Phasengeber MIL" UWORD B_TRUE 1 100 0 1 BIT_MASK 0x100 FORMAT "%13.11" ECU_ADDRESS 0x7FC9CC /end MEASUREMENT
/begin MEASUREMENT B_mxpn "" UWORD B_TRUE 1 100 0 1 BIT_MASK 0x100 FORMAT "%13.11" ECU_ADDRESS 0x7FC9CE /end MEASUREMENT
/begin MEASUREMENT B_mxsls "Fehlerart:Sekund‰rluftsystem" UWORD B_TRUE 1 100 0 1 BIT_MASK 0x100 FORMAT "%13.11" ECU_ADDRESS 0x7FC9DE /end MEASUREMENT
/begin MEASUREMENT B_mxsls2 "Fehlerart:Sekund‰rluftsystem Bank 2" UWORD B_TRUE 1 100 0 1 BIT_MASK 0x100 FORMAT "%13.11" ECU_ADDRESS 0x7FC9E0 /end MEASUREMENT
/begin MEASUREMENT B_mxslv "Fehlerart: Sekund‰rluftmasse bei Ventildichtheitspr¸fung zu groﬂ" UWORD B_TRUE 1 100 0 1 BIT_MASK 0x100 FORMAT "%13.11" ECU_ADDRESS 0x7FC9E2 /end MEASUREMENT
/begin MEASUREMENT B_mxslv2 "Fehlerart: Sekund‰rluftmasse bei Ventildichtheitspr¸fung zu groﬂ, Bank 2" UWORD B_TRUE 1 100 0 1 BIT_MASK 0x100 FORMAT "%13.11" ECU_ADDRESS 0x7FC9E4 /end MEASUREMENT
/begin MEASUREMENT B_mxta "Fehlertyp: Maximalwert¸berschreitung Ansauglufttemperatur TANS" UWORD B_TRUE 1 100 0 1 BIT_MASK 0x100 FORMAT "%13.11" ECU_ADDRESS 0x7FC9F0 /end MEASUREMENT
/begin MEASUREMENT B_mxtes "Fehlertyp 'Maximalwert' erkannt (Tankentl¸ftungsventil)" UWORD B_TRUE 1 100 0 1 BIT_MASK 0x100 FORMAT "%13.11" ECU_ADDRESS 0x7FC9F8 /end MEASUREMENT
/begin MEASUREMENT B_mxteve "Fehlertyp: Kurzschluﬂ Ubat Tankentl¸ftungsventil Endstufe" UWORD B_TRUE 1 100 0 1 BIT_MASK 0x100 FORMAT "%13.11" ECU_ADDRESS 0x7FC9FC /end MEASUREMENT
/begin MEASUREMENT B_mxthm "Fehlerart: MAX-Fehler Thermostatdiagnose" UWORD B_TRUE 1 100 0 1 BIT_MASK 0x100 FORMAT "%13.11" ECU_ADDRESS 0x7FC9FE /end MEASUREMENT
/begin MEASUREMENT B_mxtka "Fehlertyp: Maximalwert¸berschreitung Temperatur K¸hlerausgang" UWORD B_TRUE 1 100 0 1 BIT_MASK 0x100 FORMAT "%13.11" ECU_ADDRESS 0x7FCA00 /end MEASUREMENT
/begin MEASUREMENT B_mxtm "Fehlertyp: Maximalwert¸berschreitung Motortemperatur" UWORD B_TRUE 1 100 0 1 BIT_MASK 0x100 FORMAT "%13.11" ECU_ADDRESS 0x7FCA02 /end MEASUREMENT
/begin MEASUREMENT B_mxtol "Fehlertyp: Maximalwert¸berschreitung (Motor-) Oeltemperatur" UWORD B_TRUE 1 100 0 1 BIT_MASK 0x100 FORMAT "%13.11" ECU_ADDRESS 0x7FCA06 /end MEASUREMENT
/begin MEASUREMENT B_mxub "Fehlertyp: Maximalwert¸berschreitung Batteriespannung (Bordnetz)" UWORD B_TRUE 1 100 0 1 BIT_MASK 0x100 FORMAT "%13.11" ECU_ADDRESS 0x7FCA0C /end MEASUREMENT
/begin MEASUREMENT B_mxufmv "Fehlertyp max.: Funktions¸berwachung: Momentenvergleich" UWORD B_TRUE 1 100 0 1 BIT_MASK 0x100 FORMAT "%13.11" ECU_ADDRESS 0x7FCA0E /end MEASUREMENT
/begin MEASUREMENT B_mxufnc "Fehlertyp max.:Fkt¸berwachung:Drehzahlgeber-,Zuleitung- oder SG-Fehler" UWORD B_TRUE 1 100 0 1 BIT_MASK 0x100 FORMAT "%13.11" ECU_ADDRESS 0x7FCA10 /end MEASUREMENT
/begin MEASUREMENT B_mxufrlip "Fehlertyp max.:Fkt¸berwachung:Lastsensor-,Zuleitung oder SG-Fehler" UWORD B_TRUE 1 100 0 1 BIT_MASK 0x100 FORMAT "%13.11" ECU_ADDRESS 0x7FCA12 /end MEASUREMENT
/begin MEASUREMENT B_mxufsga "Fehlertyp max.: Funktions¸berwachung: Steuerger‰te-Fehler Gruppe a (ei_rlc_um)" UWORD B_TRUE 1 100 0 1 BIT_MASK 0x100 FORMAT "%13.11" ECU_ADDRESS 0x7FCA14 /end MEASUREMENT
/begin MEASUREMENT B_mxufsgb "Fehlertyp max.: Funktions¸berwachung: Steuerger‰te-Fehler Gruppe b (ei_gkc_um)" UWORD B_TRUE 1 100 0 1 BIT_MASK 0x100 FORMAT "%13.11" ECU_ADDRESS 0x7FCA16 /end MEASUREMENT
/begin MEASUREMENT B_mxufsgc "Fehlertyp max.: Funktions¸berwachung: Steuerger‰te-Fehler Gruppe c (ei_tpu_um)" UWORD B_TRUE 1 100 0 1 BIT_MASK 0x100 FORMAT "%13.11" ECU_ADDRESS 0x7FCA18 /end MEASUREMENT
/begin MEASUREMENT B_mxufspsc "Fehlertyp max.:Fkt¸berwachung:Pedalwergeber-,Zuleitung-oder SG-Fehler" UWORD B_TRUE 1 100 0 1 BIT_MASK 0x100 FORMAT "%13.11" ECU_ADDRESS 0x7FCA1A /end MEASUREMENT
/begin MEASUREMENT B_mxurram "Fehlertyp max.: Rechner¸berwachung: RAM" UWORD B_TRUE 1 100 0 1 BIT_MASK 0x100 FORMAT "%13.11" ECU_ADDRESS 0x7FCA1C /end MEASUREMENT
/begin MEASUREMENT B_mxurrom "Fehlertyp max.: Rechner¸berwachung: ROM" UWORD B_TRUE 1 100 0 1 BIT_MASK 0x100 FORMAT "%13.11" ECU_ADDRESS 0x7FCA1E /end MEASUREMENT
/begin MEASUREMENT B_mxurrst "Fehlertyp max.: Rechner¸berwachung: Reset" UWORD B_TRUE 1 100 0 1 BIT_MASK 0x100 FORMAT "%13.11" ECU_ADDRESS 0x7FCA20 /end MEASUREMENT
/begin MEASUREMENT B_npanwse "Fehlertyp unplaus.: Nockenwellensteuerung Endstufe (Auslaﬂ, Bank1)" UWORD B_TRUE 1 100 0 1 BIT_MASK 0x800 FORMAT "%13.11" ECU_ADDRESS 0x7FC896 /end MEASUREMENT
/begin MEASUREMENT B_npanwse2 "Fehlertyp unplaus.: Nockenwellensteuerung Endstufe (Auslaﬂ, Bank2)" UWORD B_TRUE 1 100 0 1 BIT_MASK 0x800 FORMAT "%13.11" ECU_ADDRESS 0x7FC898 /end MEASUREMENT
/begin MEASUREMENT B_npdsu "Bedingung: Umgebungsdrucksensor nicht plausibel" UWORD B_TRUE 1 100 0 1 BIT_MASK 0x800 FORMAT "%13.11" ECU_ADDRESS 0x7FC8D2 /end MEASUREMENT
/begin MEASUREMENT B_npegfe "Bedingung: unplausibler Wert bei den Eingangsgrˆﬂen der F¸llungserfassung" UWORD B_TRUE 1 100 0 1 BIT_MASK 0x800 FORMAT "%13.11" ECU_ADDRESS 0x7FC8EA /end MEASUREMENT
/begin MEASUREMENT B_npenwse "Fehlertyp unplaus.: Nockenwellensteuerung Endstufe (Einlaﬂ, Bank1)" UWORD B_TRUE 1 100 0 1 BIT_MASK 0x800 FORMAT "%13.11" ECU_ADDRESS 0x7FC8F6 /end MEASUREMENT
/begin MEASUREMENT B_npenwse2 "Fehlertyp unplaus.: Nockenwellensteuerung Endstufe (Einlaﬂ, Bank2)" UWORD B_TRUE 1 100 0 1 BIT_MASK 0x800 FORMAT "%13.11" ECU_ADDRESS 0x7FC8F8 /end MEASUREMENT
/begin MEASUREMENT B_nplm "Bedingung Plausfehler Hauptf¸llungssensor" UWORD B_TRUE 1 100 0 1 BIT_MASK 0x800 FORMAT "%13.11" ECU_ADDRESS 0x7FC96A /end MEASUREMENT
/begin MEASUREMENT B_nplzsr "Fehlertyp unplaus.: Leck zum Saugrohr" UWORD B_TRUE 1 100 0 1 BIT_MASK 0x800 FORMAT "%13.11" ECU_ADDRESS 0x7FC98A /end MEASUREMENT
/begin MEASUREMENT B_npmdb "Nicht plausibler Fehler: Momentan¸berwachung begrenzt dauerhaft" UWORD B_TRUE 1 100 0 1 BIT_MASK 0x800 FORMAT "%13.11" ECU_ADDRESS 0x7FC9A6 /end MEASUREMENT
/begin MEASUREMENT B_nppac "Fehlertyp 'Wert unplausibel' AC-Druck-Sensor erkannt" UWORD B_TRUE 1 100 0 1 BIT_MASK 0x800 FORMAT "%13.11" ECU_ADDRESS 0x7FC9C0 /end MEASUREMENT
/begin MEASUREMENT B_npph "Bedingung Phasengebersignal ist unplausibel (ph)" UWORD B_TRUE 1 100 0 1 BIT_MASK 0x800 FORMAT "%13.11" ECU_ADDRESS 0x7FC9C4 /end MEASUREMENT
/begin MEASUREMENT B_npph2 "Bedingung Phasengebersignal ist unplausibel (ph2)" UWORD B_TRUE 1 100 0 1 BIT_MASK 0x800 FORMAT "%13.11" ECU_ADDRESS 0x7FC9C6 /end MEASUREMENT
/begin MEASUREMENT B_npph3 "Bedingung Phasengebersignal ist unplausibel (ph3)" UWORD B_TRUE 1 100 0 1 BIT_MASK 0x800 FORMAT "%13.11" ECU_ADDRESS 0x7FC9C8 /end MEASUREMENT
/begin MEASUREMENT B_npph4 "Bedingung Phasengebersignal ist unplausibel (ph4)" UWORD B_TRUE 1 100 0 1 BIT_MASK 0x800 FORMAT "%13.11" ECU_ADDRESS 0x7FC9CA /end MEASUREMENT
/begin MEASUREMENT B_npphm "Fehlerart: nicht plausibel Phasengeber MIL" UWORD B_TRUE 1 100 0 1 BIT_MASK 0x800 FORMAT "%13.11" ECU_ADDRESS 0x7FC9CC /end MEASUREMENT
/begin MEASUREMENT B_nppn "" UWORD B_TRUE 1 100 0 1 BIT_MASK 0x800 FORMAT "%13.11" ECU_ADDRESS 0x7FC9CE /end MEASUREMENT
/begin MEASUREMENT B_npsls "Fehlerart: Offsetwert Sekund‰rluftmasse zu groﬂ" UWORD B_TRUE 1 100 0 1 BIT_MASK 0x800 FORMAT "%13.11" ECU_ADDRESS 0x7FC9DE /end MEASUREMENT
/begin MEASUREMENT B_npsls2 "Fehlerart: Offsetwert Sekund‰rluftmasse zu groﬂ, Bank 2" UWORD B_TRUE 1 100 0 1 BIT_MASK 0x800 FORMAT "%13.11" ECU_ADDRESS 0x7FC9E0 /end MEASUREMENT
/begin MEASUREMENT B_npslv "Fehlerart: Offsetwert Sekund‰rluftmasse zu groﬂ" UWORD B_TRUE 1 100 0 1 BIT_MASK 0x800 FORMAT "%13.11" ECU_ADDRESS 0x7FC9E2 /end MEASUREMENT
/begin MEASUREMENT B_npslv2 "Fehlerart: Offsetwert Sekund‰rluftmasse zu groﬂ, Bank 2" UWORD B_TRUE 1 100 0 1 BIT_MASK 0x800 FORMAT "%13.11" ECU_ADDRESS 0x7FC9E4 /end MEASUREMENT
/begin MEASUREMENT B_npta "Fehlertyp unplaus.: Ansauglufttemperatur TANS (-Ladeluft)" UWORD B_TRUE 1 100 0 1 BIT_MASK 0x800 FORMAT "%13.11" ECU_ADDRESS 0x7FC9F0 /end MEASUREMENT
/begin MEASUREMENT B_nptes "Fehlertyp 'unplausibles Pr¸fresultat' erkannt (TEV offen)" UWORD B_TRUE 1 100 0 1 BIT_MASK 0x800 FORMAT "%13.11" ECU_ADDRESS 0x7FC9F8 /end MEASUREMENT
/begin MEASUREMENT B_npteve "Nicht plausibler Fehler: Tankentl¸ftungsventil Endstufe" UWORD B_TRUE 1 100 0 1 BIT_MASK 0x800 FORMAT "%13.11" ECU_ADDRESS 0x7FC9FC /end MEASUREMENT
/begin MEASUREMENT B_npthm "Fehlerart: Motortemperatursignal nicht plausibel gg¸. Thermostat-Modellierung" UWORD B_TRUE 1 100 0 1 BIT_MASK 0x800 FORMAT "%13.11" ECU_ADDRESS 0x7FC9FE /end MEASUREMENT
/begin MEASUREMENT B_nptka "" UWORD B_TRUE 1 100 0 1 BIT_MASK 0x800 FORMAT "%13.11" ECU_ADDRESS 0x7FCA00 /end MEASUREMENT
/begin MEASUREMENT B_nptm "Fehlerart: Motortemperatursignal nicht plausibel gg¸. Modell" UWORD B_TRUE 1 100 0 1 BIT_MASK 0x800 FORMAT "%13.11" ECU_ADDRESS 0x7FCA02 /end MEASUREMENT
/begin MEASUREMENT B_nptol "Nicht plausibler Fehler: ÷ltemperatur" UWORD B_TRUE 1 100 0 1 BIT_MASK 0x800 FORMAT "%13.11" ECU_ADDRESS 0x7FCA06 /end MEASUREMENT
/begin MEASUREMENT B_npub "Fehlerart: Batteriespannungssignal nicht plausibel" UWORD B_TRUE 1 100 0 1 BIT_MASK 0x800 FORMAT "%13.11" ECU_ADDRESS 0x7FCA0C /end MEASUREMENT
/begin MEASUREMENT B_npufmv "Fehlertyp unplaus.: Funktions¸berwachung: Momentenvergleich" UWORD B_TRUE 1 100 0 1 BIT_MASK 0x800 FORMAT "%13.11" ECU_ADDRESS 0x7FCA0E /end MEASUREMENT
/begin MEASUREMENT B_npufnc "Fehlertyp unplaus.: Fkt¸berwachung: Drehzahlgeber-, Zuleitung- oder SG-Fehler" UWORD B_TRUE 1 100 0 1 BIT_MASK 0x800 FORMAT "%13.11" ECU_ADDRESS 0x7FCA10 /end MEASUREMENT
/begin MEASUREMENT B_npufrlip "Fehlertyp unplaus.: Fkt¸berw: Lastsensor-, Zuleitung-oder SG-Fehler (ei_rlip_um)" UWORD B_TRUE 1 100 0 1 BIT_MASK 0x800 FORMAT "%13.11" ECU_ADDRESS 0x7FCA12 /end MEASUREMENT
/begin MEASUREMENT B_npufsga "Fehlertyp unplaus.: Funktions¸berwach: Steuerger‰te-Fehler Gruppe a (ei_reac_um)" UWORD B_TRUE 1 100 0 1 BIT_MASK 0x800 FORMAT "%13.11" ECU_ADDRESS 0x7FCA14 /end MEASUREMENT
/begin MEASUREMENT B_npufsgb "Fehlertyp unplaus.: Funktions¸berwach: Steuerger‰te-Fehler Gruppe b (ei_ipa_um)" UWORD B_TRUE 1 100 0 1 BIT_MASK 0x800 FORMAT "%13.11" ECU_ADDRESS 0x7FCA16 /end MEASUREMENT
/begin MEASUREMENT B_npufsgc "Fehlertyp unplaus.:Funktions¸berwachung:SG-Fehler Gruppe c" UWORD B_TRUE 1 100 0 1 BIT_MASK 0x800 FORMAT "%13.11" ECU_ADDRESS 0x7FCA18 /end MEASUREMENT
/begin MEASUREMENT B_npufspsc "Fehlertyp unplaus.: Fkt¸berwachung: Pedalwertgeber-, Zuleitung- oder SG-Fehler" UWORD B_TRUE 1 100 0 1 BIT_MASK 0x800 FORMAT "%13.11" ECU_ADDRESS 0x7FCA1A /end MEASUREMENT
/begin MEASUREMENT B_npurram "Fehlertyp unplaus: Rechner¸berwachung: RAM" UWORD B_TRUE 1 100 0 1 BIT_MASK 0x800 FORMAT "%13.11" ECU_ADDRESS 0x7FCA1C /end MEASUREMENT
/begin MEASUREMENT B_npurrom "Fehlertyp unplaus.: Rechner¸berwachung: ROM" UWORD B_TRUE 1 100 0 1 BIT_MASK 0x800 FORMAT "%13.11" ECU_ADDRESS 0x7FCA1E /end MEASUREMENT
/begin MEASUREMENT B_npurrst "Fehlertyp unplaus: Rechner¸berwachung: Reset" UWORD B_TRUE 1 100 0 1 BIT_MASK 0x800 FORMAT "%13.11" ECU_ADDRESS 0x7FCA20 /end MEASUREMENT
/begin MEASUREMENT B_pypn "" UWORD B_TRUE 1 100 0 1 BIT_MASK 0x2000 FORMAT "%13.11" ECU_ADDRESS 0x7FC9CE /end MEASUREMENT
/begin MEASUREMENT B_pytes "Leckdiagnose ist physikalisch freigegeben" UWORD B_TRUE 1 100 0 1 BIT_MASK 0x2000 FORMAT "%13.11" ECU_ADDRESS 0x7FC9F8 /end MEASUREMENT
/begin MEASUREMENT B_scpn "" UWORD B_TRUE 1 100 0 1 BIT_MASK 0x4000 FORMAT "%13.11" ECU_ADDRESS 0x7FC9CE /end MEASUREMENT
/begin MEASUREMENT B_sctes "Leckdiagnose ist vom Scheduler freigegeben" UWORD B_TRUE 1 100 0 1 BIT_MASK 0x4000 FORMAT "%13.11" ECU_ADDRESS 0x7FC9F8 /end MEASUREMENT
/begin MEASUREMENT B_sianwse "Fehlerart: Leitungsabfall Nockenwellensteuerungsventil Endstufe (Bank1, Auslaﬂ)" UWORD B_TRUE 1 100 0 1 BIT_MASK 0x400 FORMAT "%13.11" ECU_ADDRESS 0x7FC896 /end MEASUREMENT
/begin MEASUREMENT B_sianwse2 "Fehlerart: Leitungsabfall Nockenwellensteuerungsventil Endstufe (Bank2, Auslaﬂ)" UWORD B_TRUE 1 100 0 1 BIT_MASK 0x400 FORMAT "%13.11" ECU_ADDRESS 0x7FC898 /end MEASUREMENT
/begin MEASUREMENT B_sidsu "Fehlerart: Umgebungsdrucksensor" UWORD B_TRUE 1 100 0 1 BIT_MASK 0x400 FORMAT "%13.11" ECU_ADDRESS 0x7FC8D2 /end MEASUREMENT
/begin MEASUREMENT B_siegfe "Bedingung: Signal Fehler bei den Eingangsgrˆﬂen der F¸llungserfassung" UWORD B_TRUE 1 100 0 1 BIT_MASK 0x400 FORMAT "%13.11" ECU_ADDRESS 0x7FC8EA /end MEASUREMENT
/begin MEASUREMENT B_sienwse "Fehlerart: Leitungsabfall Nockenwellensteuerungsventil Endstufe (Bank1, Einlaﬂ)" UWORD B_TRUE 1 100 0 1 BIT_MASK 0x400 FORMAT "%13.11" ECU_ADDRESS 0x7FC8F6 /end MEASUREMENT
/begin MEASUREMENT B_sienwse2 "Fehlerart: Nockenwellensteuerung Endstufe (Einlaﬂ, Bank2)" UWORD B_TRUE 1 100 0 1 BIT_MASK 0x400 FORMAT "%13.11" ECU_ADDRESS 0x7FC8F8 /end MEASUREMENT
/begin MEASUREMENT B_silm "Bedingung Signalfehler Hauptf¸llungssensor" UWORD B_TRUE 1 100 0 1 BIT_MASK 0x400 FORMAT "%13.11" ECU_ADDRESS 0x7FC96A /end MEASUREMENT
/begin MEASUREMENT B_silzsr "Fehlerart: Leck zum Saugrohr" UWORD B_TRUE 1 100 0 1 BIT_MASK 0x400 FORMAT "%13.11" ECU_ADDRESS 0x7FC98A /end MEASUREMENT
/begin MEASUREMENT B_simdb "Fehlertyp: Momentan¸berwachung begrenzt dauerhaft" UWORD B_TRUE 1 100 0 1 BIT_MASK 0x400 FORMAT "%13.11" ECU_ADDRESS 0x7FC9A6 /end MEASUREMENT
/begin MEASUREMENT B_sipac "Fehlertyp 'Signal fehlt' AC-Druck-Sensor erkannt" UWORD B_TRUE 1 100 0 1 BIT_MASK 0x400 FORMAT "%13.11" ECU_ADDRESS 0x7FC9C0 /end MEASUREMENT
/begin MEASUREMENT B_siph "Bedingung keine alternierende Phasenpegel PG in den Bezugsmarken" UWORD B_TRUE 1 100 0 1 BIT_MASK 0x400 FORMAT "%13.11" ECU_ADDRESS 0x7FC9C4 /end MEASUREMENT
/begin MEASUREMENT B_siph2 "Bedingung keine alternierende Phasenpegel PG2 in den Bezugsmarken" UWORD B_TRUE 1 100 0 1 BIT_MASK 0x400 FORMAT "%13.11" ECU_ADDRESS 0x7FC9C6 /end MEASUREMENT
/begin MEASUREMENT B_siph3 "Fehlerart: Phasenflanke von PG3 auﬂerhalb Toleranz" UWORD B_TRUE 1 100 0 1 BIT_MASK 0x400 FORMAT "%13.11" ECU_ADDRESS 0x7FC9C8 /end MEASUREMENT
/begin MEASUREMENT B_siph4 "Fehlerart: Phasenflanke von PG4 auﬂerhalb Toleranz" UWORD B_TRUE 1 100 0 1 BIT_MASK 0x400 FORMAT "%13.11" ECU_ADDRESS 0x7FC9CA /end MEASUREMENT
/begin MEASUREMENT B_siphm "Fehlerart: Kein Phasengeber im System verf¸gbar" UWORD B_TRUE 1 100 0 1 BIT_MASK 0x400 FORMAT "%13.11" ECU_ADDRESS 0x7FC9CC /end MEASUREMENT
/begin MEASUREMENT B_sipn "Signalfehler P/N-Switch" UWORD B_TRUE 1 100 0 1 BIT_MASK 0x400 FORMAT "%13.11" ECU_ADDRESS 0x7FC9CE /end MEASUREMENT
/begin MEASUREMENT B_sisls "Fehlertype: Sekund‰rluftsystem" UWORD B_TRUE 1 100 0 1 BIT_MASK 0x400 FORMAT "%13.11" ECU_ADDRESS 0x7FC9DE /end MEASUREMENT
/begin MEASUREMENT B_sisls2 "Fehlertyp:Sekund‰rluftsystem Bank 2" UWORD B_TRUE 1 100 0 1 BIT_MASK 0x400 FORMAT "%13.11" ECU_ADDRESS 0x7FC9E0 /end MEASUREMENT
/begin MEASUREMENT B_sislv "Fehlertyp: Sekund‰rluftventil" UWORD B_TRUE 1 100 0 1 BIT_MASK 0x400 FORMAT "%13.11" ECU_ADDRESS 0x7FC9E2 /end MEASUREMENT
/begin MEASUREMENT B_sislv2 "Fehlertyp: Sekund‰rluftventil Bank 2" UWORD B_TRUE 1 100 0 1 BIT_MASK 0x400 FORMAT "%13.11" ECU_ADDRESS 0x7FC9E4 /end MEASUREMENT
/begin MEASUREMENT B_sita "Fehlertyp: Ansauglufttemperatur TANS (-Ladeluft)" UWORD B_TRUE 1 100 0 1 BIT_MASK 0x400 FORMAT "%13.11" ECU_ADDRESS 0x7FC9F0 /end MEASUREMENT
/begin MEASUREMENT B_sites "Fehlerart: TEV offen" UWORD B_TRUE 1 100 0 1 BIT_MASK 0x400 FORMAT "%13.11" ECU_ADDRESS 0x7FC9F8 /end MEASUREMENT
/begin MEASUREMENT B_siteve "Fehlertyp: Leitungsabfall Tankentl¸ftungsventil Endstufe" UWORD B_TRUE 1 100 0 1 BIT_MASK 0x400 FORMAT "%13.11" ECU_ADDRESS 0x7FC9FC /end MEASUREMENT
/begin MEASUREMENT B_sithm "Fehlerart: Signalfehler Thermostatdiagnose" UWORD B_TRUE 1 100 0 1 BIT_MASK 0x400 FORMAT "%13.11" ECU_ADDRESS 0x7FC9FE /end MEASUREMENT
/begin MEASUREMENT B_sitka "" UWORD B_TRUE 1 100 0 1 BIT_MASK 0x400 FORMAT "%13.11" ECU_ADDRESS 0x7FCA00 /end MEASUREMENT
/begin MEASUREMENT B_sitm "Fehlerart: Motortemperaturschwelle f¸r Lambdaregelungsfreigabe nicht erreicht" UWORD B_TRUE 1 100 0 1 BIT_MASK 0x400 FORMAT "%13.11" ECU_ADDRESS 0x7FCA02 /end MEASUREMENT
/begin MEASUREMENT B_sitol "Fehlertyp: ÷ltemperatur" UWORD B_TRUE 1 100 0 1 BIT_MASK 0x400 FORMAT "%13.11" ECU_ADDRESS 0x7FCA06 /end MEASUREMENT
/begin MEASUREMENT B_siub "Fehlertyp: Umweltbedingungen" UWORD B_TRUE 1 100 0 1 BIT_MASK 0x400 FORMAT "%13.11" ECU_ADDRESS 0x7FCA0C /end MEASUREMENT
/begin MEASUREMENT B_siufmv "Fehlertyp sig.: Funktions¸berwachung: Momentenvergleich" UWORD B_TRUE 1 100 0 1 BIT_MASK 0x400 FORMAT "%13.11" ECU_ADDRESS 0x7FCA0E /end MEASUREMENT
/begin MEASUREMENT B_siufnc "Fehlertyp signal:Fkt¸berwachung:Drehzahlgeber-,Zuleitung oder SG-Fehler" UWORD B_TRUE 1 100 0 1 BIT_MASK 0x400 FORMAT "%13.11" ECU_ADDRESS 0x7FCA10 /end MEASUREMENT
/begin MEASUREMENT B_siufrlip "Fehlertyp sig.: Fkt¸berw: Lastsensor-, Zuleitung- oder SG-Fehler (ei_vvt_um)" UWORD B_TRUE 1 100 0 1 BIT_MASK 0x400 FORMAT "%13.11" ECU_ADDRESS 0x7FCA12 /end MEASUREMENT
/begin MEASUREMENT B_siufsga "Fehlertyp sig.: Funktions¸berwachung: Steuerger‰te-Fehler Gruppe a (ei_adcc_um)" UWORD B_TRUE 1 100 0 1 BIT_MASK 0x400 FORMAT "%13.11" ECU_ADDRESS 0x7FCA14 /end MEASUREMENT
/begin MEASUREMENT B_siufsgb "Fehlertyp sig.: Funktions¸berwachung: Steuerger‰te-Fehler Gruppe b (ei_varc_um)" UWORD B_TRUE 1 100 0 1 BIT_MASK 0x400 FORMAT "%13.11" ECU_ADDRESS 0x7FCA16 /end MEASUREMENT
/begin MEASUREMENT B_siufsgc "Fehlertyp signal:Fkt¸berwachung:SG-Fehler Gruppe c" UWORD B_TRUE 1 100 0 1 BIT_MASK 0x400 FORMAT "%13.11" ECU_ADDRESS 0x7FCA18 /end MEASUREMENT
/begin MEASUREMENT B_siufspsc "Fehlertyp signal:Fkt¸berwachung:Pedalwertgeber-,Zuleitung oder SG-Fehler" UWORD B_TRUE 1 100 0 1 BIT_MASK 0x400 FORMAT "%13.11" ECU_ADDRESS 0x7FCA1A /end MEASUREMENT
/begin MEASUREMENT B_siurram "Fehlertyp sig.: Rechner¸berwachung: RAM" UWORD B_TRUE 1 100 0 1 BIT_MASK 0x400 FORMAT "%13.11" ECU_ADDRESS 0x7FCA1C /end MEASUREMENT
/begin MEASUREMENT B_siurrom "Fehlertyp sig.: Rechner¸berwachung: ROM" UWORD B_TRUE 1 100 0 1 BIT_MASK 0x400 FORMAT "%13.11" ECU_ADDRESS 0x7FCA1E /end MEASUREMENT
/begin MEASUREMENT B_siurrst "Fehlertyp sig.: Rechner¸berwachung: Reset" UWORD B_TRUE 1 100 0 1 BIT_MASK 0x400 FORMAT "%13.11" ECU_ADDRESS 0x7FCA20 /end MEASUREMENT
/begin MEASUREMENT E_anwse "Errorflag: Nockenwellensteuerungsventil Endstufe (Bank1,Auslaﬂ)" UWORD B_TRUE 1 100 0 1 BIT_MASK 0x1 FORMAT "%13.11" ECU_ADDRESS 0x7FC896 /end MEASUREMENT
/begin MEASUREMENT E_anwse2 "Errorflag: Nockenwellensteuerungsventil Endstufe (Bank2,Auslaﬂ)" UWORD B_TRUE 1 100 0 1 BIT_MASK 0x1 FORMAT "%13.11" ECU_ADDRESS 0x7FC898 /end MEASUREMENT
/begin MEASUREMENT E_dsu "Errorflag: Umgebungsdrucksensor" UWORD B_TRUE 1 100 0 1 BIT_MASK 0x1 FORMAT "%13.11" ECU_ADDRESS 0x7FC8D2 /end MEASUREMENT
/begin MEASUREMENT E_egfe "Errorflag: Eingangsgrˆﬂen F¸llungserfassung" UWORD B_TRUE 1 100 0 1 BIT_MASK 0x1 FORMAT "%13.11" ECU_ADDRESS 0x7FC8EA /end MEASUREMENT
/begin MEASUREMENT E_enwse "Errorflag: Endstufe Nockenwellensteuerung (Einlaﬂ, Bank1)" UWORD B_TRUE 1 100 0 1 BIT_MASK 0x1 FORMAT "%13.11" ECU_ADDRESS 0x7FC8F6 /end MEASUREMENT
/begin MEASUREMENT E_enwse2 "Errorflag: Nockenwellensteuerungsventil Endstufe (Bank2,Einlaﬂ)" UWORD B_TRUE 1 100 0 1 BIT_MASK 0x1 FORMAT "%13.11" ECU_ADDRESS 0x7FC8F8 /end MEASUREMENT
/begin MEASUREMENT E_lm "Errorflag: Hauptlastsensor" UWORD B_TRUE 1 100 0 1 BIT_MASK 0x1 FORMAT "%13.11" ECU_ADDRESS 0x7FC96A /end MEASUREMENT
/begin MEASUREMENT E_lzsr "Fehlerflag: Leck zum Saugrohr" UWORD B_TRUE 1 100 0 1 BIT_MASK 0x1 FORMAT "%13.11" ECU_ADDRESS 0x7FC98A /end MEASUREMENT
/begin MEASUREMENT E_mdb "Errorflag: Momenten¸berwachung begrenzt dauerhaft" UWORD B_TRUE 1 100 0 1 BIT_MASK 0x1 FORMAT "%13.11" ECU_ADDRESS 0x7FC9A6 /end MEASUREMENT
/begin MEASUREMENT E_pac "Errorflag:	Druck in Klimasystem" UWORD B_TRUE 1 100 0 1 BIT_MASK 0x1 FORMAT "%13.11" ECU_ADDRESS 0x7FC9C0 /end MEASUREMENT
/begin MEASUREMENT E_ph "Errorflag: Phasensensor" UWORD B_TRUE 1 100 0 1 BIT_MASK 0x1 FORMAT "%13.11" ECU_ADDRESS 0x7FC9C4 /end MEASUREMENT
/begin MEASUREMENT E_ph2 "Errorflag: Phasensensor 2" UWORD B_TRUE 1 100 0 1 BIT_MASK 0x1 FORMAT "%13.11" ECU_ADDRESS 0x7FC9C6 /end MEASUREMENT
/begin MEASUREMENT E_ph3 "Errorflag: Phasensensor 3" UWORD B_TRUE 1 100 0 1 BIT_MASK 0x1 FORMAT "%13.11" ECU_ADDRESS 0x7FC9C8 /end MEASUREMENT
/begin MEASUREMENT E_ph4 "Errorflag: Phasensensor 4" UWORD B_TRUE 1 100 0 1 BIT_MASK 0x1 FORMAT "%13.11" ECU_ADDRESS 0x7FC9CA /end MEASUREMENT
/begin MEASUREMENT E_phm "Master-Errorflag f¸r Phasensensoren" UWORD B_TRUE 1 100 0 1 BIT_MASK 0x1 FORMAT "%13.11" ECU_ADDRESS 0x7FC9CC /end MEASUREMENT
/begin MEASUREMENT E_pn "Errorflag: P/N-Switch" UWORD B_TRUE 1 100 0 1 BIT_MASK 0x1 FORMAT "%13.11" ECU_ADDRESS 0x7FC9CE /end MEASUREMENT
/begin MEASUREMENT E_sls "Errorflag: Sekund‰rluft-System" UWORD B_TRUE 1 100 0 1 BIT_MASK 0x1 FORMAT "%13.11" ECU_ADDRESS 0x7FC9DE /end MEASUREMENT
/begin MEASUREMENT E_sls2 "Errorflag: Sekund‰rluft-System Bank 2" UWORD B_TRUE 1 100 0 1 BIT_MASK 0x1 FORMAT "%13.11" ECU_ADDRESS 0x7FC9E0 /end MEASUREMENT
/begin MEASUREMENT E_slv "Errorflag: Sekund‰rluftventil" UWORD B_TRUE 1 100 0 1 BIT_MASK 0x1 FORMAT "%13.11" ECU_ADDRESS 0x7FC9E2 /end MEASUREMENT
/begin MEASUREMENT E_slv2 "Errorflag: Sekund‰rluftventil Bank 2" UWORD B_TRUE 1 100 0 1 BIT_MASK 0x1 FORMAT "%13.11" ECU_ADDRESS 0x7FC9E4 /end MEASUREMENT
/begin MEASUREMENT E_ta "Errorflag: Ansauglufttemperatur" UWORD B_TRUE 1 100 0 1 BIT_MASK 0x1 FORMAT "%13.11" ECU_ADDRESS 0x7FC9F0 /end MEASUREMENT
/begin MEASUREMENT E_tes "Errorflag: Tankentl¸ftungssystem" UWORD B_TRUE 1 100 0 1 BIT_MASK 0x1 FORMAT "%13.11" ECU_ADDRESS 0x7FC9F8 /end MEASUREMENT
/begin MEASUREMENT E_teve "Errorflag: Tankentl¸ftungsventil Endstufe" UWORD B_TRUE 1 100 0 1 BIT_MASK 0x1 FORMAT "%13.11" ECU_ADDRESS 0x7FC9FC /end MEASUREMENT
/begin MEASUREMENT E_thm "Error_flag: K¸hlwasser-Thermostat" UWORD B_TRUE 1 100 0 1 BIT_MASK 0x1 FORMAT "%13.11" ECU_ADDRESS 0x7FC9FE /end MEASUREMENT
/begin MEASUREMENT E_TKA "Errorflag: Temperatur K¸hlerausgang" UWORD B_TRUE 1 100 0 1 BIT_MASK 0x1 FORMAT "%13.11" ECU_ADDRESS 0x7FCA00 /end MEASUREMENT
/begin MEASUREMENT E_tm "Errorflag: TMOT" UWORD B_TRUE 1 100 0 1 BIT_MASK 0x1 FORMAT "%13.11" ECU_ADDRESS 0x7FCA02 /end MEASUREMENT
/begin MEASUREMENT E_TOL "Errorflag: ÷ltemperatur" UWORD B_TRUE 1 100 0 1 BIT_MASK 0x1 FORMAT "%13.11" ECU_ADDRESS 0x7FCA06 /end MEASUREMENT
/begin MEASUREMENT E_ub "Errorflag: UB" UWORD B_TRUE 1 100 0 1 BIT_MASK 0x1 FORMAT "%13.11" ECU_ADDRESS 0x7FCA0C /end MEASUREMENT
/begin MEASUREMENT E_ufmv "Errorflag: Funktions¸berwachung: Momentenvergleich" UWORD B_TRUE 1 100 0 1 BIT_MASK 0x1 FORMAT "%13.11" ECU_ADDRESS 0x7FCA0E /end MEASUREMENT
/begin MEASUREMENT E_ufnc "Errorflag: Fkt¸berwachung: Drehzahlgeber-, Zuleitung- oder Steuerger‰te-Fehler" UWORD B_TRUE 1 100 0 1 BIT_MASK 0x1 FORMAT "%13.11" ECU_ADDRESS 0x7FCA10 /end MEASUREMENT
/begin MEASUREMENT E_ufrlip "Errorflag: Fkt¸berwachung: Lastsensor-, Zuleitung- oder Steuerger‰te-Fehler" UWORD B_TRUE 1 100 0 1 BIT_MASK 0x1 FORMAT "%13.11" ECU_ADDRESS 0x7FCA12 /end MEASUREMENT
/begin MEASUREMENT E_ufsga "Errorflag: Funktions¸berwachung: Steuerger‰te-Fehler Gruppe a" UWORD B_TRUE 1 100 0 1 BIT_MASK 0x1 FORMAT "%13.11" ECU_ADDRESS 0x7FCA14 /end MEASUREMENT
/begin MEASUREMENT E_ufsgb "Errorflag: Funktions¸berwachung: Steuerger‰te-Fehler Gruppe b" UWORD B_TRUE 1 100 0 1 BIT_MASK 0x1 FORMAT "%13.11" ECU_ADDRESS 0x7FCA16 /end MEASUREMENT
/begin MEASUREMENT E_ufsgc "Errorflag: Funktions¸berwachung: Steuerger‰te-Fehler Gruppe c" UWORD B_TRUE 1 100 0 1 BIT_MASK 0x1 FORMAT "%13.11" ECU_ADDRESS 0x7FCA18 /end MEASUREMENT
/begin MEASUREMENT E_ufspsc "Errorflag: Fkt¸berwachung: Pedalwertgeber-, Zuleitung- oder Steuerger‰te-Fehler" UWORD B_TRUE 1 100 0 1 BIT_MASK 0x1 FORMAT "%13.11" ECU_ADDRESS 0x7FCA1A /end MEASUREMENT
/begin MEASUREMENT E_urram "Errorflag: Rechner¸berwachung: RAM" UWORD B_TRUE 1 100 0 1 BIT_MASK 0x1 FORMAT "%13.11" ECU_ADDRESS 0x7FCA1C /end MEASUREMENT
/begin MEASUREMENT E_urrom "Errorflag: Rechner¸berwachung: ROM" UWORD B_TRUE 1 100 0 1 BIT_MASK 0x1 FORMAT "%13.11" ECU_ADDRESS 0x7FCA1E /end MEASUREMENT
/begin MEASUREMENT E_urrst "Errorflag: Rechner¸berwachung: Reset" UWORD B_TRUE 1 100 0 1 BIT_MASK 0x1 FORMAT "%13.11" ECU_ADDRESS 0x7FCA20 /end MEASUREMENT
/begin MEASUREMENT sfpanwse "Status Fehlerpfad: Nockenwellensteuerung Endstufe (Auslaﬂ, Bank1)" UWORD dez 1 100 0 65535 FORMAT "%8.2" ECU_ADDRESS 0x7FC896 /end MEASUREMENT
/begin MEASUREMENT sfpanwse2 "Status Fehlerpfad: Nockenwellensteuerung Endstufe (Auslaﬂ, Bank2)" UWORD dez 1 100 0 65535 FORMAT "%8.2" ECU_ADDRESS 0x7FC898 /end MEASUREMENT
/begin MEASUREMENT sfpdsu "Status Fehlerpfad: Umgebungsdrucksensor" UWORD dez 1 100 0 65535 FORMAT "%8.2" ECU_ADDRESS 0x7FC8D2 /end MEASUREMENT
/begin MEASUREMENT sfpegfe "Status Fehlerpfad: Diagose der Eingangsgrˆﬂen der F¸llungserfassung" UWORD dez 1 100 0 65535 FORMAT "%8.2" ECU_ADDRESS 0x7FC8EA /end MEASUREMENT
/begin MEASUREMENT sfpehb_envcond "" UWORD default 1 100 0 65535 FORMAT "%8.2" ECU_ADDRESS 0x7FC8EC /end MEASUREMENT
/begin MEASUREMENT sfpehb_par "" UWORD default 1 100 0 65535 FORMAT "%8.2" ECU_ADDRESS 0x7FC8EE /end MEASUREMENT
/begin MEASUREMENT sfpehb_tgl "" UWORD default 1 100 0 65535 FORMAT "%8.2" ECU_ADDRESS 0x7FC8F0 /end MEASUREMENT
/begin MEASUREMENT sfpenwse "Status Fehlerpfad: Nockenwellensteuerung Endstufe (Einlaﬂ, Bank1)" UWORD dez 1 100 0 65535 FORMAT "%8.2" ECU_ADDRESS 0x7FC8F6 /end MEASUREMENT
/begin MEASUREMENT sfpenwse2 "Status Fehlerpfad: Nockenwellensteuerung Endstufe (Einlaﬂ, Bank2)" UWORD dez 1 100 0 65535 FORMAT "%8.2" ECU_ADDRESS 0x7FC8F8 /end MEASUREMENT
/begin MEASUREMENT sfpesp_par "" UWORD default 1 100 0 65535 FORMAT "%8.2" ECU_ADDRESS 0x7FC8FA /end MEASUREMENT
/begin MEASUREMENT sfpesp_stat "" UWORD default 1 100 0 65535 FORMAT "%8.2" ECU_ADDRESS 0x7FC8FC /end MEASUREMENT
/begin MEASUREMENT sfpesp_tgl "" UWORD default 1 100 0 65535 FORMAT "%8.2" ECU_ADDRESS 0x7FC8FE /end MEASUREMENT
/begin MEASUREMENT sfpesp_trqreq "" UWORD default 1 100 0 65535 FORMAT "%8.2" ECU_ADDRESS 0x7FC900 /end MEASUREMENT
/begin MEASUREMENT sfplm "Status Fehlerpfad: Hauptf¸llungssensor" UWORD dez 1 100 0 65535 FORMAT "%8.2" ECU_ADDRESS 0x7FC96A /end MEASUREMENT
/begin MEASUREMENT sfplzsr "Status Fehlerpfad: Leck zum  Saugrohr" UWORD default 1 100 0 65535 FORMAT "%8.2" ECU_ADDRESS 0x7FC98A /end MEASUREMENT
/begin MEASUREMENT sfpmdb "Status Fehlerpfad: Momentan¸berwachung begrenzt dauerhaft" UWORD dez 1 100 0 65535 FORMAT "%8.2" ECU_ADDRESS 0x7FC9A6 /end MEASUREMENT
/begin MEASUREMENT sfppac "Status Fehlerpfad: AC-Drucksensor" UWORD dez 1 100 0 65535 FORMAT "%8.2" ECU_ADDRESS 0x7FC9C0 /end MEASUREMENT
/begin MEASUREMENT sfpph "Status Fehlerpfad: Phasengeber" UWORD dez 1 100 0 65535 FORMAT "%8.2" ECU_ADDRESS 0x7FC9C4 /end MEASUREMENT
/begin MEASUREMENT sfpph2 "Status Fehlerpfad: Phasengeber Bank 2" UWORD dez 1 100 0 65535 FORMAT "%8.2" ECU_ADDRESS 0x7FC9C6 /end MEASUREMENT
/begin MEASUREMENT sfpph3 "Status Fehlerpfad: Phasengeber 3" UWORD dez 1 100 0 65535 FORMAT "%8.2" ECU_ADDRESS 0x7FC9C8 /end MEASUREMENT
/begin MEASUREMENT sfpph4 "Status Fehlerpfad: Phasengeber 4" UWORD dez 1 100 0 65535 FORMAT "%8.2" ECU_ADDRESS 0x7FC9CA /end MEASUREMENT
/begin MEASUREMENT sfpphm "Status Fehlerpfad: Phasengeber MIL" UWORD dez 1 100 0 65535 FORMAT "%8.2" ECU_ADDRESS 0x7FC9CC /end MEASUREMENT
/begin MEASUREMENT sfppn "Status Fehlerpfad: P/N-Schalter" UWORD default 1 100 0 65535 FORMAT "%8.2" ECU_ADDRESS 0x7FC9CE /end MEASUREMENT
/begin MEASUREMENT sfpsls "Status Fehlerpfad: Diagnose Sekund‰rluftsystem" UWORD dez 1 100 0 65535 FORMAT "%8.2" ECU_ADDRESS 0x7FC9DE /end MEASUREMENT
/begin MEASUREMENT sfpsls2 "Status Fehlerpfad: Diagnose Sekund‰rluftsystem, Bank 2" UWORD dez 1 100 0 65535 FORMAT "%8.2" ECU_ADDRESS 0x7FC9E0 /end MEASUREMENT
/begin MEASUREMENT sfpslv "Status Fehlerpfad: Diagnose Sekund‰rluftventil" UWORD dez 1 100 0 65535 FORMAT "%8.2" ECU_ADDRESS 0x7FC9E2 /end MEASUREMENT
/begin MEASUREMENT sfpslv2 "Status Fehlerpfad: Diagnose Sekund‰rluftventil, Bank 2" UWORD dez 1 100 0 65535 FORMAT "%8.2" ECU_ADDRESS 0x7FC9E4 /end MEASUREMENT
/begin MEASUREMENT sfpta "Status Fehlerpfad: Ansauglufttemperatur (Ladeluft-) TANS" UWORD dez 1 100 0 65535 FORMAT "%8.2" ECU_ADDRESS 0x7FC9F0 /end MEASUREMENT
/begin MEASUREMENT sfptes "Status Fehlerpfad: Tankdiagnose, TEV defekt offen" UWORD default 1 100 0 65535 FORMAT "%8.2" ECU_ADDRESS 0x7FC9F8 /end MEASUREMENT
/begin MEASUREMENT sfpteve "Status Fehlerpfad: Tankl¸ftungsventil Endstufe" UWORD default 1 100 0 65535 FORMAT "%8.2" ECU_ADDRESS 0x7FC9FC /end MEASUREMENT
/begin MEASUREMENT sfpthm "Status Fehlerpfad: Thermostat Motor(-K¸hlung) THM" UWORD default 1 100 0 65535 FORMAT "%8.2" ECU_ADDRESS 0x7FC9FE /end MEASUREMENT
/begin MEASUREMENT sfptka "Status Fehlerpfad: Temperatur K¸hlerausgang" UWORD dez 1 100 0 65535 FORMAT "%8.2" ECU_ADDRESS 0x7FCA00 /end MEASUREMENT
/begin MEASUREMENT sfptm "Status Fehlerpfad: Motortemperatur TMOT" UWORD dez 1 100 0 65535 FORMAT "%8.2" ECU_ADDRESS 0x7FCA02 /end MEASUREMENT
/begin MEASUREMENT sfptol "Status Fehlerpfad: (Motor-) Oeltemperatur TOL" UWORD dez 1 100 0 65535 FORMAT "%8.2" ECU_ADDRESS 0x7FCA06 /end MEASUREMENT
/begin MEASUREMENT sfpub "Status Fehlerpfad: Batteriespannung UB (Bordnetz)" UWORD dez 1 100 0 65535 FORMAT "%8.2" ECU_ADDRESS 0x7FCA0C /end MEASUREMENT
/begin MEASUREMENT sfpufmv "Statuswort: Funktions¸berwachung: Momentenvergleich" UWORD dez 1 100 0 65535 FORMAT "%8.2" ECU_ADDRESS 0x7FCA0E /end MEASUREMENT
/begin MEASUREMENT sfpufnc "Statuswort: Funktions¸berwachung:Drehzahlgeber-,Zuleitung- oder SG-Fehler" UWORD dez 1 100 0 65535 FORMAT "%8.2" ECU_ADDRESS 0x7FCA10 /end MEASUREMENT
/begin MEASUREMENT sfpufrlip "Statuswort: Funktions¸berwachung:Lastsensor-,Zuleitung oder SG-Fehler" UWORD dez 1 100 0 65535 FORMAT "%8.2" ECU_ADDRESS 0x7FCA12 /end MEASUREMENT
/begin MEASUREMENT sfpufsga "Statuswort: Funktions¸berwachung:SG-Fehler Gruppe a" UWORD dez 1 100 0 65535 FORMAT "%8.2" ECU_ADDRESS 0x7FCA14 /end MEASUREMENT
/begin MEASUREMENT sfpufsgb "Statuswort: Funktions¸berwachung:SG-Fehler Gruppe b" UWORD dez 1 100 0 65535 FORMAT "%8.2" ECU_ADDRESS 0x7FCA16 /end MEASUREMENT
/begin MEASUREMENT sfpufsgc "Statuswort: Funktions¸berwachung:SG-Fehler Gruppe c" UWORD dez 1 100 0 65535 FORMAT "%8.2" ECU_ADDRESS 0x7FCA18 /end MEASUREMENT
/begin MEASUREMENT sfpufspsc "Statuswort: Funktions¸berwachung:Pedalwergeber-,Zuleitung-oder SG-Fehler" UWORD dez 1 100 0 65535 FORMAT "%8.2" ECU_ADDRESS 0x7FCA1A /end MEASUREMENT
/begin MEASUREMENT sfpurram "Statuswort: Rechner¸berwachung: RAM" UWORD dez 1 100 0 65535 FORMAT "%8.2" ECU_ADDRESS 0x7FCA1C /end MEASUREMENT
/begin MEASUREMENT sfpurrom "Statuswort: Rechner¸berwachung: ROM" UWORD dez 1 100 0 65535 FORMAT "%8.2" ECU_ADDRESS 0x7FCA1E /end MEASUREMENT
/begin MEASUREMENT sfpurrst "Statuswort: Rechner¸berwachung: Reset" UWORD dez 1 100 0 65535 FORMAT "%8.2" ECU_ADDRESS 0x7FCA20 /end MEASUREMENT
/begin MEASUREMENT TYP_anwse "" UWORD B_TRUE 1 100 0 1 BIT_MASK 0xf00 FORMAT "%13.11" ECU_ADDRESS 0x7FC896 /end MEASUREMENT
/begin MEASUREMENT TYP_anwse2 "" UWORD B_TRUE 1 100 0 1 BIT_MASK 0xf00 FORMAT "%13.11" ECU_ADDRESS 0x7FC898 /end MEASUREMENT
/begin MEASUREMENT TYP_dsu "" UWORD B_TRUE 1 100 0 1 BIT_MASK 0xf00 FORMAT "%13.11" ECU_ADDRESS 0x7FC8D2 /end MEASUREMENT
/begin MEASUREMENT TYP_egfe "" UWORD B_TRUE 1 100 0 1 BIT_MASK 0xf00 FORMAT "%13.11" ECU_ADDRESS 0x7FC8EA /end MEASUREMENT
/begin MEASUREMENT TYP_enwse "" UWORD B_TRUE 1 100 0 1 BIT_MASK 0xf00 FORMAT "%13.11" ECU_ADDRESS 0x7FC8F6 /end MEASUREMENT
/begin MEASUREMENT TYP_enwse2 "" UWORD B_TRUE 1 100 0 1 BIT_MASK 0xf00 FORMAT "%13.11" ECU_ADDRESS 0x7FC8F8 /end MEASUREMENT
/begin MEASUREMENT TYP_lm "" UWORD B_TRUE 1 100 0 1 BIT_MASK 0xf00 FORMAT "%13.11" ECU_ADDRESS 0x7FC96A /end MEASUREMENT
/begin MEASUREMENT TYP_lzsr "" UWORD B_TRUE 1 100 0 1 BIT_MASK 0xf00 FORMAT "%13.11" ECU_ADDRESS 0x7FC98A /end MEASUREMENT
/begin MEASUREMENT TYP_mdb "Fehlertyp: Momentenbegrenzung (begrenzt dauerhaft) aktiv" UWORD B_TRUE 1 100 0 1 BIT_MASK 0xf00 FORMAT "%13.11" ECU_ADDRESS 0x7FC9A6 /end MEASUREMENT
/begin MEASUREMENT TYP_pac "Fehlertyp: AC-Drucksensor" UWORD B_TRUE 1 100 0 1 BIT_MASK 0xf00 FORMAT "%13.11" ECU_ADDRESS 0x7FC9C0 /end MEASUREMENT
/begin MEASUREMENT TYP_ph "" UWORD B_TRUE 1 100 0 1 BIT_MASK 0xf00 FORMAT "%13.11" ECU_ADDRESS 0x7FC9C4 /end MEASUREMENT
/begin MEASUREMENT TYP_ph2 "" UWORD B_TRUE 1 100 0 1 BIT_MASK 0xf00 FORMAT "%13.11" ECU_ADDRESS 0x7FC9C6 /end MEASUREMENT
/begin MEASUREMENT TYP_ph3 "" UWORD B_TRUE 1 100 0 1 BIT_MASK 0xf00 FORMAT "%13.11" ECU_ADDRESS 0x7FC9C8 /end MEASUREMENT
/begin MEASUREMENT TYP_ph4 "" UWORD B_TRUE 1 100 0 1 BIT_MASK 0xf00 FORMAT "%13.11" ECU_ADDRESS 0x7FC9CA /end MEASUREMENT
/begin MEASUREMENT TYP_phm "" UWORD B_TRUE 1 100 0 1 BIT_MASK 0xf00 FORMAT "%13.11" ECU_ADDRESS 0x7FC9CC /end MEASUREMENT
/begin MEASUREMENT TYP_PN "" UWORD B_TRUE 1 100 0 1 BIT_MASK 0xf00 FORMAT "%13.11" ECU_ADDRESS 0x7FC9CE /end MEASUREMENT
/begin MEASUREMENT TYP_sls "Fehlertyp: Sekund‰rluftsystem" UWORD B_TRUE 1 100 0 1 BIT_MASK 0xf00 FORMAT "%13.11" ECU_ADDRESS 0x7FC9DE /end MEASUREMENT
/begin MEASUREMENT TYP_sls2 "Fehlertyp: Sekund‰rluftsystem, Bank 2" UWORD B_TRUE 1 100 0 1 BIT_MASK 0xf00 FORMAT "%13.11" ECU_ADDRESS 0x7FC9E0 /end MEASUREMENT
/begin MEASUREMENT TYP_slv "Fehlertyp: Dichtheit Sekund‰rluftventil" UWORD B_TRUE 1 100 0 1 BIT_MASK 0xf00 FORMAT "%13.11" ECU_ADDRESS 0x7FC9E2 /end MEASUREMENT
/begin MEASUREMENT TYP_slv2 "Fehlertyp: Dichtheit Sekund‰rluftventil, Bank 2" UWORD B_TRUE 1 100 0 1 BIT_MASK 0xf00 FORMAT "%13.11" ECU_ADDRESS 0x7FC9E4 /end MEASUREMENT
/begin MEASUREMENT TYP_ta "" UWORD B_TRUE 1 100 0 1 BIT_MASK 0xf00 FORMAT "%13.11" ECU_ADDRESS 0x7FC9F0 /end MEASUREMENT
/begin MEASUREMENT TYP_tes "Fehlertyp: Tankdiagnose, TEV offen" UWORD B_TRUE 1 100 0 1 BIT_MASK 0xf00 FORMAT "%13.11" ECU_ADDRESS 0x7FC9F8 /end MEASUREMENT
/begin MEASUREMENT TYP_teve "" UWORD B_TRUE 1 100 0 1 BIT_MASK 0xf00 FORMAT "%13.11" ECU_ADDRESS 0x7FC9FC /end MEASUREMENT
/begin MEASUREMENT TYP_thm "" UWORD B_TRUE 1 100 0 1 BIT_MASK 0xf00 FORMAT "%13.11" ECU_ADDRESS 0x7FC9FE /end MEASUREMENT
/begin MEASUREMENT TYP_tka "" UWORD B_TRUE 1 100 0 1 BIT_MASK 0xf00 FORMAT "%13.11" ECU_ADDRESS 0x7FCA00 /end MEASUREMENT
/begin MEASUREMENT TYP_tm "" UWORD B_TRUE 1 100 0 1 BIT_MASK 0xf00 FORMAT "%13.11" ECU_ADDRESS 0x7FCA02 /end MEASUREMENT
/begin MEASUREMENT TYP_tol "" UWORD B_TRUE 1 100 0 1 BIT_MASK 0xf00 FORMAT "%13.11" ECU_ADDRESS 0x7FCA06 /end MEASUREMENT
/begin MEASUREMENT TYP_ub "" UWORD B_TRUE 1 100 0 1 BIT_MASK 0xf00 FORMAT "%13.11" ECU_ADDRESS 0x7FCA0C /end MEASUREMENT
/begin MEASUREMENT TYP_ufmv "Fehlertyp: Funktions¸berwachung: Momentenvergleich" UWORD B_TRUE 1 100 0 1 BIT_MASK 0xf00 FORMAT "%13.11" ECU_ADDRESS 0x7FCA0E /end MEASUREMENT
/begin MEASUREMENT TYP_ufnc "" UWORD B_TRUE 1 100 0 1 BIT_MASK 0xf00 FORMAT "%13.11" ECU_ADDRESS 0x7FCA10 /end MEASUREMENT
/begin MEASUREMENT TYP_ufrlip "" UWORD B_TRUE 1 100 0 1 BIT_MASK 0xf00 FORMAT "%13.11" ECU_ADDRESS 0x7FCA12 /end MEASUREMENT
/begin MEASUREMENT TYP_ufsga "" UWORD B_TRUE 1 100 0 1 BIT_MASK 0xf00 FORMAT "%13.11" ECU_ADDRESS 0x7FCA14 /end MEASUREMENT
/begin MEASUREMENT TYP_ufsgb "" UWORD B_TRUE 1 100 0 1 BIT_MASK 0xf00 FORMAT "%13.11" ECU_ADDRESS 0x7FCA16 /end MEASUREMENT
/begin MEASUREMENT TYP_ufsgc "" UWORD B_TRUE 1 100 0 1 BIT_MASK 0xf00 FORMAT "%13.11" ECU_ADDRESS 0x7FCA18 /end MEASUREMENT
/begin MEASUREMENT TYP_ufspsc "" UWORD B_TRUE 1 100 0 1 BIT_MASK 0xf00 FORMAT "%13.11" ECU_ADDRESS 0x7FCA1A /end MEASUREMENT
/begin MEASUREMENT TYP_urram "Fehlertyp: Rechner¸berwachung: RAM" UWORD B_TRUE 1 100 0 1 BIT_MASK 0xf00 FORMAT "%13.11" ECU_ADDRESS 0x7FCA1C /end MEASUREMENT
/begin MEASUREMENT TYP_urrom "Fehlertyp: Rechner¸berwachung: ROM" UWORD B_TRUE 1 100 0 1 BIT_MASK 0xf00 FORMAT "%13.11" ECU_ADDRESS 0x7FCA1E /end MEASUREMENT
/begin MEASUREMENT TYP_urrst "Fehlertyp: Rechner¸berwachung: Reset" UWORD B_TRUE 1 100 0 1 BIT_MASK 0xf00 FORMAT "%13.11" ECU_ADDRESS 0x7FCA20 /end MEASUREMENT
/begin MEASUREMENT Z_anwse "Zyklusflag: Nockenwellensteuerungsventil Endstufe (Bank1,Auslaﬂ)" UWORD B_TRUE 1 100 0 1 BIT_MASK 0x2 FORMAT "%13.11" ECU_ADDRESS 0x7FC896 /end MEASUREMENT
/begin MEASUREMENT Z_anwse2 "Zyklusflag: Nockenwellensteuerungsventil Endstufe (Bank2,Auslaﬂ)" UWORD B_TRUE 1 100 0 1 BIT_MASK 0x2 FORMAT "%13.11" ECU_ADDRESS 0x7FC898 /end MEASUREMENT
/begin MEASUREMENT Z_dsu "Zyklusflag: Umgebungsdrucksensor" UWORD B_TRUE 1 100 0 1 BIT_MASK 0x2 FORMAT "%13.11" ECU_ADDRESS 0x7FC8D2 /end MEASUREMENT
/begin MEASUREMENT Z_egfe "Zyklusflag: Eingangsgrˆﬂen F¸llungserfassung" UWORD B_TRUE 1 100 0 1 BIT_MASK 0x2 FORMAT "%13.11" ECU_ADDRESS 0x7FC8EA /end MEASUREMENT
/begin MEASUREMENT Z_enwse "Zyklusflag: Nockenwellensteuerungsventil Endstufe (Bank1,Einlaﬂ)" UWORD B_TRUE 1 100 0 1 BIT_MASK 0x2 FORMAT "%13.11" ECU_ADDRESS 0x7FC8F6 /end MEASUREMENT
/begin MEASUREMENT Z_enwse2 "Zyklusflag: Nockenwellensteuerungsventil Endstufe (Bank2,Einlaﬂ)" UWORD B_TRUE 1 100 0 1 BIT_MASK 0x2 FORMAT "%13.11" ECU_ADDRESS 0x7FC8F8 /end MEASUREMENT
/begin MEASUREMENT Z_lm "Zyklusflag:	LMM/HLM/HFM" UWORD B_TRUE 1 100 0 1 BIT_MASK 0x2 FORMAT "%13.11" ECU_ADDRESS 0x7FC96A /end MEASUREMENT
/begin MEASUREMENT Z_lzsr "Zyklusflag: Leck zum Saugrohr" UWORD B_TRUE 1 100 0 1 BIT_MASK 0x2 FORMAT "%13.11" ECU_ADDRESS 0x7FC98A /end MEASUREMENT
/begin MEASUREMENT Z_mdb "Zyklusflag: Momentenbegrenzung begrenzt dauerhaft" UWORD B_TRUE 1 100 0 1 BIT_MASK 0x2 FORMAT "%13.11" ECU_ADDRESS 0x7FC9A6 /end MEASUREMENT
/begin MEASUREMENT Z_pac "Zyklusflag:	Druck in Klimasystem" UWORD B_TRUE 1 100 0 1 BIT_MASK 0x2 FORMAT "%13.11" ECU_ADDRESS 0x7FC9C0 /end MEASUREMENT
/begin MEASUREMENT Z_ph "Zyklusflag: Phasensensor" UWORD B_TRUE 1 100 0 1 BIT_MASK 0x2 FORMAT "%13.11" ECU_ADDRESS 0x7FC9C4 /end MEASUREMENT
/begin MEASUREMENT Z_ph2 "Zyklusflag: Phasensensor 2" UWORD B_TRUE 1 100 0 1 BIT_MASK 0x2 FORMAT "%13.11" ECU_ADDRESS 0x7FC9C6 /end MEASUREMENT
/begin MEASUREMENT Z_ph3 "Zyklusflag: Phasensensor 3" UWORD B_TRUE 1 100 0 1 BIT_MASK 0x2 FORMAT "%13.11" ECU_ADDRESS 0x7FC9C8 /end MEASUREMENT
/begin MEASUREMENT Z_ph4 "Zyklusflag: Phasensensor 4" UWORD B_TRUE 1 100 0 1 BIT_MASK 0x2 FORMAT "%13.11" ECU_ADDRESS 0x7FC9CA /end MEASUREMENT
/begin MEASUREMENT Z_phm "Master-Zyklusflag f¸r Phasensensoren" UWORD B_TRUE 1 100 0 1 BIT_MASK 0x2 FORMAT "%13.11" ECU_ADDRESS 0x7FC9CC /end MEASUREMENT
/begin MEASUREMENT Z_pn "Zyklusflag: P/N-Switch" UWORD B_TRUE 1 100 0 1 BIT_MASK 0x2 FORMAT "%13.11" ECU_ADDRESS 0x7FC9CE /end MEASUREMENT
/begin MEASUREMENT Z_sls "Zyklusflag: Sekund‰rluft-System" UWORD B_TRUE 1 100 0 1 BIT_MASK 0x2 FORMAT "%13.11" ECU_ADDRESS 0x7FC9DE /end MEASUREMENT
/begin MEASUREMENT Z_sls2 "Zyklusflag: Sekund‰rluft-System Bank 2" UWORD B_TRUE 1 100 0 1 BIT_MASK 0x2 FORMAT "%13.11" ECU_ADDRESS 0x7FC9E0 /end MEASUREMENT
/begin MEASUREMENT Z_slv "Zyklusflag: Sekund‰rluftventil" UWORD B_TRUE 1 100 0 1 BIT_MASK 0x2 FORMAT "%13.11" ECU_ADDRESS 0x7FC9E2 /end MEASUREMENT
/begin MEASUREMENT Z_slv2 "Zyklusflag: Sekund‰rluftventil, Bank 2" UWORD B_TRUE 1 100 0 1 BIT_MASK 0x2 FORMAT "%13.11" ECU_ADDRESS 0x7FC9E4 /end MEASUREMENT
/begin MEASUREMENT Z_ta "Zyklusflag: TANS" UWORD B_TRUE 1 100 0 1 BIT_MASK 0x2 FORMAT "%13.11" ECU_ADDRESS 0x7FC9F0 /end MEASUREMENT
/begin MEASUREMENT Z_tes "Zyklusflag: Tankentl¸ftungssystem" UWORD B_TRUE 1 100 0 1 BIT_MASK 0x2 FORMAT "%13.11" ECU_ADDRESS 0x7FC9F8 /end MEASUREMENT
/begin MEASUREMENT Z_teve "Zyklusflag:	Tankentl¸ftungsventil Endstufe" UWORD B_TRUE 1 100 0 1 BIT_MASK 0x2 FORMAT "%13.11" ECU_ADDRESS 0x7FC9FC /end MEASUREMENT
/begin MEASUREMENT Z_thm "Zyklusflg K¸hlwasser-Thermostat" UWORD B_TRUE 1 100 0 1 BIT_MASK 0x2 FORMAT "%13.11" ECU_ADDRESS 0x7FC9FE /end MEASUREMENT
/begin MEASUREMENT Z_TKA "Zyklusflag Temperatur K¸hlerausgang" UWORD B_TRUE 1 100 0 1 BIT_MASK 0x2 FORMAT "%13.11" ECU_ADDRESS 0x7FCA00 /end MEASUREMENT
/begin MEASUREMENT Z_tm "Zyklusflag:	TMOT" UWORD B_TRUE 1 100 0 1 BIT_MASK 0x2 FORMAT "%13.11" ECU_ADDRESS 0x7FCA02 /end MEASUREMENT
/begin MEASUREMENT Z_TOL "Zyklusflag: ÷ltemperatur" UWORD B_TRUE 1 100 0 1 BIT_MASK 0x2 FORMAT "%13.11" ECU_ADDRESS 0x7FCA06 /end MEASUREMENT
/begin MEASUREMENT Z_ub "Zyklusflag:	UB" UWORD B_TRUE 1 100 0 1 BIT_MASK 0x2 FORMAT "%13.11" ECU_ADDRESS 0x7FCA0C /end MEASUREMENT
/begin MEASUREMENT Z_ufmv "Zyklusflag: Funktions¸berwachung: Momentenvergleich" UWORD B_TRUE 1 100 0 1 BIT_MASK 0x2 FORMAT "%13.11" ECU_ADDRESS 0x7FCA0E /end MEASUREMENT
/begin MEASUREMENT Z_ufnc "Zyklusflag: Funktions¸berwachung: Drehzahlgeber-, Zuleitung- oder SG-Fehler" UWORD B_TRUE 1 100 0 1 BIT_MASK 0x2 FORMAT "%13.11" ECU_ADDRESS 0x7FCA10 /end MEASUREMENT
/begin MEASUREMENT Z_ufrlip "Zyklusflag: Funktions¸berwachung: Lastsensor-, Zuleitung- oder SG-Fehler" UWORD B_TRUE 1 100 0 1 BIT_MASK 0x2 FORMAT "%13.11" ECU_ADDRESS 0x7FCA12 /end MEASUREMENT
/begin MEASUREMENT Z_ufsga "Zyklusflag: Funktions¸berwachung: Steuerger‰te-Fehler Gruppe a" UWORD B_TRUE 1 100 0 1 BIT_MASK 0x2 FORMAT "%13.11" ECU_ADDRESS 0x7FCA14 /end MEASUREMENT
/begin MEASUREMENT Z_ufsgb "Zyklusflag: Funktions¸berwachung: Steuerger‰te-Fehler Gruppe b" UWORD B_TRUE 1 100 0 1 BIT_MASK 0x2 FORMAT "%13.11" ECU_ADDRESS 0x7FCA16 /end MEASUREMENT
/begin MEASUREMENT Z_ufsgc "Zyklusflag: Funktions¸berwachung: Steuerger‰te-Fehler Gruppe c" UWORD B_TRUE 1 100 0 1 BIT_MASK 0x2 FORMAT "%13.11" ECU_ADDRESS 0x7FCA18 /end MEASUREMENT
/begin MEASUREMENT Z_ufspsc "Zyklusflag: Funktions¸berwachung: Pedalwertgeber-, Zuleitung- oder SG-Fehler" UWORD B_TRUE 1 100 0 1 BIT_MASK 0x2 FORMAT "%13.11" ECU_ADDRESS 0x7FCA1A /end MEASUREMENT
/begin MEASUREMENT Z_urram "Zyklusflag: Rechner¸berwachung: RAM" UWORD B_TRUE 1 100 0 1 BIT_MASK 0x2 FORMAT "%13.11" ECU_ADDRESS 0x7FCA1C /end MEASUREMENT
/begin MEASUREMENT Z_urrom "Zyklusflag: Rechner¸berwachung: ROM" UWORD B_TRUE 1 100 0 1 BIT_MASK 0x2 FORMAT "%13.11" ECU_ADDRESS 0x7FCA1E /end MEASUREMENT
/begin MEASUREMENT Z_urrst "Zyklusflag: Rechner¸berwachung: Reset" UWORD B_TRUE 1 100 0 1 BIT_MASK 0x2 FORMAT "%13.11" ECU_ADDRESS 0x7FCA20 /end MEASUREMENT
/begin FUNCTION DFPM_DNWSEAUS ""
 /begin DEF_CHARACTERISTIC CDCANWSE CDCANWSE2 CDKANWSE CDKANWSE2 CDTANWSE CDTANWSE2 CLAANWSE CLAANWSE2 FFTANWSE FFTANWSE2 TSFANWSE TSFANWSE2 /end DEF_CHARACTERISTIC
 /begin REF_CHARACTERISTIC /end REF_CHARACTERISTIC
 /begin IN_MEASUREMENT /end IN_MEASUREMENT
 /begin OUT_MEASUREMENT B_beanwse B_beanwse2 B_bkanwse B_bkanwse2 B_clanwse B_clanwse2 B_ftanwse B_ftanwse2 B_mnanwse B_mnanwse2 B_mxanwse B_mxanwse2 B_npanwse B_npanwse2 B_sianwse B_sianwse2 E_anwse E_anwse2 sfpanwse sfpanwse2 TYP_anwse TYP_anwse2 Z_anwse Z_anwse2 /end OUT_MEASUREMENT
 /begin LOC_MEASUREMENT /end LOC_MEASUREMENT
 /begin SUB_FUNCTION /end SUB_FUNCTION
/end FUNCTION
/begin FUNCTION DFPM_DNWSEEIN ""
 /begin DEF_CHARACTERISTIC CDCENWSE CDCENWSE2 CDKENWSE CDKENWSE2 CDTENWSE CDTENWSE2 CLAENWSE CLAENWSE2 FFTENWSE FFTENWSE2 TSFENWSE TSFENWSE2 /end DEF_CHARACTERISTIC
 /begin REF_CHARACTERISTIC /end REF_CHARACTERISTIC
 /begin IN_MEASUREMENT /end IN_MEASUREMENT
 /begin OUT_MEASUREMENT B_beenwse B_beenwse2 B_bkenwse B_bkenwse2 B_clenwse B_clenwse2 B_ftenwse B_ftenwse2 B_mnenwse B_mnenwse2 B_mxenwse B_mxenwse2 B_npenwse B_npenwse2 B_sienwse B_sienwse2 E_enwse E_enwse2 sfpenwse sfpenwse2 TYP_enwse TYP_enwse2 Z_enwse Z_enwse2 /end OUT_MEASUREMENT
 /begin LOC_MEASUREMENT /end LOC_MEASUREMENT
 /begin SUB_FUNCTION /end SUB_FUNCTION
/end FUNCTION
/begin FUNCTION DFPM_DPH "DPH."
 /begin DEF_CHARACTERISTIC CDCPH CDCPH2 CDCPH3 CDCPH4 CDCPHM CDKPH CDKPH2 CDKPH3 CDKPH4 CDKPHM CDTPH CDTPH2 CDTPH3 CDTPH4 CDTPHM CLAPH CLAPH2 CLAPH3 CLAPH4 CLAPHM FFTPH FFTPH2 FFTPH3 FFTPH4 FFTPHM TSFPH TSFPH2 TSFPH3 TSFPH4 TSFPHM /end DEF_CHARACTERISTIC
 /begin REF_CHARACTERISTIC /end REF_CHARACTERISTIC
 /begin IN_MEASUREMENT /end IN_MEASUREMENT
 /begin OUT_MEASUREMENT B_beph B_beph2 B_beph3 B_beph4 B_bephm B_bkph B_bkph2 B_bkph3 B_bkph4 B_bkphm B_clph B_clph2 B_clph3 B_clph4 B_clphm B_ftph B_ftph2 B_ftph3 B_ftph4 B_ftphm B_mnph B_mnph2 B_mnph3 B_mnph4 B_mnphm B_mxph B_mxph2 B_mxph3 B_mxph4 B_mxphm B_npph B_npph2 B_npph3 B_npph4 B_npphm B_siph B_siph2 B_siph3 B_siph4 B_siphm E_ph E_ph2 E_ph3 E_ph4 E_phm sfpph sfpph2 sfpph3 sfpph4 sfpphm TYP_ph TYP_ph2 TYP_ph3 TYP_ph4 TYP_phm Z_ph Z_ph2 Z_ph3 Z_ph4 Z_phm /end OUT_MEASUREMENT
 /begin LOC_MEASUREMENT /end LOC_MEASUREMENT
 /begin SUB_FUNCTION /end SUB_FUNCTION
/end FUNCTION
/begin FUNCTION DFPM_DPN "" /begin DEF_CHARACTERISTIC CDCPN CDKPN CDTPN CLAPN FFTPN TSFPN /end DEF_CHARACTERISTIC /begin REF_CHARACTERISTIC /end REF_CHARACTERISTIC /begin IN_MEASUREMENT /end IN_MEASUREMENT
 /begin OUT_MEASUREMENT B_avpn B_bepn B_bkpn B_clpn B_ftpn B_mnpn B_mxpn B_nppn B_pypn B_scpn B_sipn E_pn sfppn TYP_PN Z_pn /end OUT_MEASUREMENT
 /begin LOC_MEASUREMENT /end LOC_MEASUREMENT
 /begin SUB_FUNCTION /end SUB_FUNCTION
/end FUNCTION
/begin FUNCTION DFPM_DSELHFS "" /begin DEF_CHARACTERISTIC CDCLM CDKLM CDTLM CLALM FFTLM TSFLM /end DEF_CHARACTERISTIC /begin REF_CHARACTERISTIC /end REF_CHARACTERISTIC /begin IN_MEASUREMENT /end IN_MEASUREMENT
 /begin OUT_MEASUREMENT B_belm B_bklm B_cllm B_falm B_mnlm B_mxlm B_nplm B_silm E_lm sfplm TYP_lm Z_lm /end OUT_MEASUREMENT
 /begin LOC_MEASUREMENT /end LOC_MEASUREMENT
 /begin SUB_FUNCTION /end SUB_FUNCTION
/end FUNCTION
/begin FUNCTION DFPM_DSLS ""
 /begin DEF_CHARACTERISTIC CDCSLS CDCSLS2 CDCSLV CDCSLV2 CDKSLS CDKSLS2 CDKSLV CDKSLV2 CDTSLS CDTSLS2 CDTSLV CDTSLV2 CLASLS CLASLS2 CLASLV CLASLV2 FFTSLS FFTSLS2 FFTSLV FFTSLV2 TSFSLS TSFSLS2 TSFSLV TSFSLV2 /end DEF_CHARACTERISTIC
 /begin REF_CHARACTERISTIC /end REF_CHARACTERISTIC
 /begin IN_MEASUREMENT /end IN_MEASUREMENT
 /begin OUT_MEASUREMENT B_besls B_besls2 B_beslv B_beslv2 B_bksls B_bksls2 B_bkslv B_bkslv2 B_clsls B_clsls2 B_clslv B_clslv2 B_ftsls B_ftsls2 B_ftslv B_ftslv2 B_mnsls B_mnsls2 B_mnslv B_mnslv2 B_mxsls B_mxsls2 B_mxslv B_mxslv2 B_npsls B_npsls2 B_npslv B_npslv2 B_sisls B_sisls2 B_sislv B_sislv2 E_sls E_sls2 E_slv E_slv2 sfpsls sfpsls2 sfpslv sfpslv2 TYP_sls TYP_sls2 TYP_slv TYP_slv2 Z_sls Z_sls2 Z_slv Z_slv2 /end OUT_MEASUREMENT
 /begin LOC_MEASUREMENT /end LOC_MEASUREMENT
 /begin SUB_FUNCTION /end SUB_FUNCTION
/end FUNCTION
/begin FUNCTION DFPM_DTEV "" /begin DEF_CHARACTERISTIC CDCTES CDKTES CDTTES CLATES FFTTES TSFTES /end DEF_CHARACTERISTIC /begin REF_CHARACTERISTIC /end REF_CHARACTERISTIC /begin IN_MEASUREMENT /end IN_MEASUREMENT
 /begin OUT_MEASUREMENT B_avtes B_betes B_bktes B_cltes B_fttes B_mntes B_mxtes B_nptes B_pytes B_sctes B_sites E_tes sfptes TYP_tes Z_tes /end OUT_MEASUREMENT
 /begin LOC_MEASUREMENT /end LOC_MEASUREMENT
 /begin SUB_FUNCTION /end SUB_FUNCTION
/end FUNCTION
/begin FUNCTION DFPM_DTEVE "" /begin DEF_CHARACTERISTIC CDCTEVE CDKTEVE CDTTEVE CLATEVE FFTTEVE TSFTEVE /end DEF_CHARACTERISTIC /begin REF_CHARACTERISTIC /end REF_CHARACTERISTIC /begin IN_MEASUREMENT /end IN_MEASUREMENT
 /begin OUT_MEASUREMENT B_beteve B_bkteve B_clteve B_ftteve B_mnteve B_mxteve B_npteve B_siteve E_teve sfpteve TYP_teve Z_teve /end OUT_MEASUREMENT
 /begin LOC_MEASUREMENT /end LOC_MEASUREMENT
 /begin SUB_FUNCTION /end SUB_FUNCTION
/end FUNCTION
/begin FUNCTION DFPM_DTHM "" /begin DEF_CHARACTERISTIC CDCTHM CDKTHM CDTTHM CLATHM FFTTHM TSFTHM /end DEF_CHARACTERISTIC /begin REF_CHARACTERISTIC /end REF_CHARACTERISTIC /begin IN_MEASUREMENT /end IN_MEASUREMENT
 /begin OUT_MEASUREMENT B_bethm B_bkthm B_clthm B_ftthm B_mnthm B_mxthm B_npthm B_sithm E_thm sfpthm TYP_thm Z_thm /end OUT_MEASUREMENT
 /begin LOC_MEASUREMENT /end LOC_MEASUREMENT
 /begin SUB_FUNCTION /end SUB_FUNCTION
/end FUNCTION
/begin FUNCTION DFPM_DUF ""
 /begin DEF_CHARACTERISTIC CDCUFMV CDCUFNC CDCUFRLIP CDCUFSGA CDCUFSGB CDCUFSGC CDCUFSPSC CDKUFMV CDKUFNC CDKUFRLIP CDKUFSGA CDKUFSGB CDKUFSGC CDKUFSPSC CDTUFMV CDTUFNC CDTUFRLIP CDTUFSGA CDTUFSGB CDTUFSGC CDTUFSPSC CLAUFMV CLAUFNC CLAUFRLIP CLAUFSGA CLAUFSGB CLAUFSGC CLAUFSPSC FFTUFMV FFTUFNC FFTUFRLIP FFTUFSGA FFTUFSGB FFTUFSGC FFTUFSPSC TSFUFMV TSFUFNC TSFUFRLIP TSFUFSGA TSFUFSGB TSFUFSGC TSFUFSPSC /end DEF_CHARACTERISTIC
 /begin REF_CHARACTERISTIC /end REF_CHARACTERISTIC
 /begin IN_MEASUREMENT /end IN_MEASUREMENT
 /begin OUT_MEASUREMENT B_beufmv B_beufnc B_beufrlip B_beufsga B_beufsgb B_beufsgc B_beufspsc B_bkufmv B_bkufnc B_bkufrlip B_bkufsga B_bkufsgb B_bkufsgc B_bkufspsc B_clufmv B_clufnc B_clufrlip B_clufsga B_clufsgb B_clufsgc B_clufspsc B_ftufmv B_ftufnc B_ftufrlip B_ftufsga B_ftufsgb B_ftufsgc B_ftufspsc B_mnufmv B_mnufnc B_mnufrlip B_mnufsga B_mnufsgb B_mnufsgc B_mnufspsc B_mxufmv B_mxufnc B_mxufrlip B_mxufsga B_mxufsgb B_mxufsgc B_mxufspsc B_npufmv B_npufnc B_npufrlip B_npufsga B_npufsgb B_npufsgc B_npufspsc B_siufmv B_siufnc B_siufrlip B_siufsga B_siufsgb B_siufsgc B_siufspsc E_ufmv E_ufnc E_ufrlip E_ufsga E_ufsgb E_ufsgc E_ufspsc sfpufmv sfpufnc sfpufrlip sfpufsga sfpufsgb sfpufsgc sfpufspsc TYP_ufmv TYP_ufnc TYP_ufrlip TYP_ufsga TYP_ufsgb TYP_ufsgc TYP_ufspsc Z_ufmv Z_ufnc Z_ufrlip Z_ufsga Z_ufsgb Z_ufsgc Z_ufspsc /end OUT_MEASUREMENT
 /begin LOC_MEASUREMENT /end LOC_MEASUREMENT
 /begin SUB_FUNCTION /end SUB_FUNCTION
/end FUNCTION
/begin FUNCTION DFPM_DUR ""
 /begin DEF_CHARACTERISTIC CDCURRAM CDCURROM CDCURRST CDKURRAM CDKURROM CDKURRST CDTURRAM CDTURROM CDTURRST CLAURRAM CLAURROM CLAURRST FFTURRAM FFTURROM FFTURRST TSFURRAM TSFURROM TSFURRST /end DEF_CHARACTERISTIC
 /begin REF_CHARACTERISTIC /end REF_CHARACTERISTIC
 /begin IN_MEASUREMENT /end IN_MEASUREMENT
 /begin OUT_MEASUREMENT B_beurram B_beurrom B_beurrst B_bkurram B_bkurrom B_bkurrst B_clurram B_clurrom B_clurrst B_fturram B_fturrom B_fturrst B_mnurram B_mnurrom B_mnurrst B_mxurram B_mxurrom B_mxurrst B_npurram B_npurrom B_npurrst B_siurram B_siurrom B_siurrst E_urram E_urrom E_urrst sfpurram sfpurrom sfpurrst TYP_urram TYP_urrom TYP_urrst Z_urram Z_urrom Z_urrst /end OUT_MEASUREMENT
 /begin LOC_MEASUREMENT /end LOC_MEASUREMENT
 /begin SUB_FUNCTION /end SUB_FUNCTION
/end FUNCTION
/begin FUNCTION DFPM_EGFE "" /begin DEF_CHARACTERISTIC CDCEGFE CDKEGFE CDTEGFE CLAEGFE FFTEGFE TSFEGFE /end DEF_CHARACTERISTIC /begin REF_CHARACTERISTIC /end REF_CHARACTERISTIC /begin IN_MEASUREMENT /end IN_MEASUREMENT
 /begin OUT_MEASUREMENT B_beegfe B_bkegfe B_clegfe B_ftegfe B_mnegfe B_mxegfe B_npegfe B_siegfe E_egfe sfpegfe TYP_egfe Z_egfe /end OUT_MEASUREMENT
 /begin LOC_MEASUREMENT /end LOC_MEASUREMENT
 /begin SUB_FUNCTION /end SUB_FUNCTION
/end FUNCTION
/begin FUNCTION DFPM_EHB_EnvCond ""
 /begin DEF_CHARACTERISTIC CDCEHB_EnvCond CDKEHB_EnvCond CDTEHB_EnvCond CLAEHB_EnvCond FFTEHB_EnvCond TSFEHB_EnvCond /end DEF_CHARACTERISTIC
 /begin REF_CHARACTERISTIC /end REF_CHARACTERISTIC
 /begin IN_MEASUREMENT /end IN_MEASUREMENT
 /begin OUT_MEASUREMENT sfpehb_envcond /end OUT_MEASUREMENT
 /begin LOC_MEASUREMENT /end LOC_MEASUREMENT
 /begin SUB_FUNCTION /end SUB_FUNCTION
/end FUNCTION
/begin FUNCTION DFPM_EHB_Par ""
 /begin DEF_CHARACTERISTIC CDCEHB_Par CDKEHB_Par CDTEHB_Par CLAEHB_Par FFTEHB_Par TSFEHB_Par /end DEF_CHARACTERISTIC
 /begin REF_CHARACTERISTIC /end REF_CHARACTERISTIC
 /begin IN_MEASUREMENT /end IN_MEASUREMENT
 /begin OUT_MEASUREMENT sfpehb_par /end OUT_MEASUREMENT
 /begin LOC_MEASUREMENT /end LOC_MEASUREMENT
 /begin SUB_FUNCTION /end SUB_FUNCTION
/end FUNCTION
/begin FUNCTION DFPM_EHB_Tgl ""
 /begin DEF_CHARACTERISTIC CDCEHB_Tgl CDKEHB_Tgl CDTEHB_Tgl CLAEHB_Tgl FFTEHB_Tgl TSFEHB_Tgl /end DEF_CHARACTERISTIC
 /begin REF_CHARACTERISTIC /end REF_CHARACTERISTIC
 /begin IN_MEASUREMENT /end IN_MEASUREMENT
 /begin OUT_MEASUREMENT sfpehb_tgl /end OUT_MEASUREMENT
 /begin LOC_MEASUREMENT /end LOC_MEASUREMENT
 /begin SUB_FUNCTION /end SUB_FUNCTION
/end FUNCTION
/begin FUNCTION DFPM_ESP_Par ""
 /begin DEF_CHARACTERISTIC CDCESP_Par CDKESP_Par CDTESP_Par CLAESP_Par FFTESP_Par TSFESP_Par /end DEF_CHARACTERISTIC
 /begin REF_CHARACTERISTIC /end REF_CHARACTERISTIC
 /begin IN_MEASUREMENT /end IN_MEASUREMENT
 /begin OUT_MEASUREMENT sfpesp_par /end OUT_MEASUREMENT
 /begin LOC_MEASUREMENT /end LOC_MEASUREMENT
 /begin SUB_FUNCTION /end SUB_FUNCTION
/end FUNCTION
/begin FUNCTION DFPM_ESP_Stat ""
 /begin DEF_CHARACTERISTIC CDCESP_Stat CDKESP_Stat CDTESP_Stat CLAESP_Stat FFTESP_Stat TSFESP_Stat /end DEF_CHARACTERISTIC
 /begin REF_CHARACTERISTIC /end REF_CHARACTERISTIC
 /begin IN_MEASUREMENT /end IN_MEASUREMENT
 /begin OUT_MEASUREMENT sfpesp_stat /end OUT_MEASUREMENT
 /begin LOC_MEASUREMENT /end LOC_MEASUREMENT
 /begin SUB_FUNCTION /end SUB_FUNCTION
/end FUNCTION
/begin FUNCTION DFPM_ESP_Tgl ""
 /begin DEF_CHARACTERISTIC CDCESP_Tgl CDKESP_Tgl CDTESP_Tgl CLAESP_Tgl FFTESP_Tgl TSFESP_Tgl /end DEF_CHARACTERISTIC
 /begin REF_CHARACTERISTIC /end REF_CHARACTERISTIC
 /begin IN_MEASUREMENT /end IN_MEASUREMENT
 /begin OUT_MEASUREMENT sfpesp_tgl /end OUT_MEASUREMENT
 /begin LOC_MEASUREMENT /end LOC_MEASUREMENT
 /begin SUB_FUNCTION /end SUB_FUNCTION
/end FUNCTION
/begin FUNCTION DFPM_ESP_TrqReq ""
 /begin DEF_CHARACTERISTIC CDCESP_TrqReq CDKESP_TrqReq CDTESP_TrqReq CLAESP_TrqReq FFTESP_TrqReq TSFESP_TrqReq /end DEF_CHARACTERISTIC
 /begin REF_CHARACTERISTIC /end REF_CHARACTERISTIC
 /begin IN_MEASUREMENT /end IN_MEASUREMENT
 /begin OUT_MEASUREMENT sfpesp_trqreq /end OUT_MEASUREMENT
 /begin LOC_MEASUREMENT /end LOC_MEASUREMENT
 /begin SUB_FUNCTION /end SUB_FUNCTION
/end FUNCTION
/begin FUNCTION DFPM_GGDSAC "" /begin DEF_CHARACTERISTIC CDCPAC CDKPAC CDTPAC CLAPAC FFTPAC TSFPAC /end DEF_CHARACTERISTIC /begin REF_CHARACTERISTIC /end REF_CHARACTERISTIC /begin IN_MEASUREMENT /end IN_MEASUREMENT
 /begin OUT_MEASUREMENT B_bepac B_bkpac B_clpac B_fapac B_mnpac B_mxpac B_nppac B_sipac E_pac sfppac TYP_pac Z_pac /end OUT_MEASUREMENT
 /begin LOC_MEASUREMENT /end LOC_MEASUREMENT
 /begin SUB_FUNCTION /end SUB_FUNCTION
/end FUNCTION
/begin FUNCTION DFPM_GGDSU "" /begin DEF_CHARACTERISTIC CDCDSU CDKDSU CDTDSU CLADSU FFTDSU TSFDSU /end DEF_CHARACTERISTIC /begin REF_CHARACTERISTIC /end REF_CHARACTERISTIC /begin IN_MEASUREMENT /end IN_MEASUREMENT
 /begin OUT_MEASUREMENT B_bedsu B_bkdsu B_cldsu B_ftdsu B_mndsu B_mxdsu B_npdsu B_sidsu E_dsu sfpdsu TYP_dsu Z_dsu /end OUT_MEASUREMENT
 /begin LOC_MEASUREMENT /end LOC_MEASUREMENT
 /begin SUB_FUNCTION /end SUB_FUNCTION
/end FUNCTION
/begin FUNCTION DFPM_GGTFA "" /begin DEF_CHARACTERISTIC CDCTA CDKTA CDTTA CLATA FFTTA TSFTA /end DEF_CHARACTERISTIC /begin REF_CHARACTERISTIC /end REF_CHARACTERISTIC /begin IN_MEASUREMENT /end IN_MEASUREMENT
 /begin OUT_MEASUREMENT B_beta B_bkta B_clta B_ftta B_mnta B_mxta B_npta B_sita E_ta sfpta TYP_ta Z_ta /end OUT_MEASUREMENT
 /begin LOC_MEASUREMENT /end LOC_MEASUREMENT
 /begin SUB_FUNCTION /end SUB_FUNCTION
/end FUNCTION
/begin FUNCTION DFPM_GGTFM "" /begin DEF_CHARACTERISTIC CDCTM CDKTM CDTTM CLATM FFTTM TSFTM /end DEF_CHARACTERISTIC /begin REF_CHARACTERISTIC /end REF_CHARACTERISTIC /begin IN_MEASUREMENT /end IN_MEASUREMENT
 /begin OUT_MEASUREMENT B_betm B_bktm B_cltm B_fttm B_mntm B_mxtm B_nptm B_sitm E_tm sfptm TYP_tm Z_tm /end OUT_MEASUREMENT
 /begin LOC_MEASUREMENT /end LOC_MEASUREMENT
 /begin SUB_FUNCTION /end SUB_FUNCTION
/end FUNCTION
/begin FUNCTION DFPM_GGTKA "" /begin DEF_CHARACTERISTIC CDCTKA CDKTKA CDTTKA CLATKA FFTTKA TSFTKA /end DEF_CHARACTERISTIC /begin REF_CHARACTERISTIC /end REF_CHARACTERISTIC /begin IN_MEASUREMENT /end IN_MEASUREMENT
 /begin OUT_MEASUREMENT B_betka B_bktka B_cltka B_fttka B_mntka B_mxtka B_nptka B_sitka E_TKA sfptka TYP_tka Z_TKA /end OUT_MEASUREMENT
 /begin LOC_MEASUREMENT /end LOC_MEASUREMENT
 /begin SUB_FUNCTION /end SUB_FUNCTION
/end FUNCTION
/begin FUNCTION DFPM_GGTOL "" /begin DEF_CHARACTERISTIC CDCTOL CDKTOL CDTTOL CLATOL FFTTOL TSFTOL /end DEF_CHARACTERISTIC /begin REF_CHARACTERISTIC /end REF_CHARACTERISTIC /begin IN_MEASUREMENT /end IN_MEASUREMENT
 /begin OUT_MEASUREMENT B_betol B_bktol B_cltol B_fttol B_mntol B_mxtol B_nptol B_sitol E_TOL sfptol TYP_tol Z_TOL /end OUT_MEASUREMENT
 /begin LOC_MEASUREMENT /end LOC_MEASUREMENT
 /begin SUB_FUNCTION /end SUB_FUNCTION
/end FUNCTION
/begin FUNCTION DFPM_GGUB "" /begin DEF_CHARACTERISTIC CDCUB CDKUB CDTUB CLAUB FFTUB TSFUB /end DEF_CHARACTERISTIC /begin REF_CHARACTERISTIC /end REF_CHARACTERISTIC /begin IN_MEASUREMENT /end IN_MEASUREMENT
 /begin OUT_MEASUREMENT B_beub B_bkub B_club B_ftub B_mnub B_mxub B_npub B_siub E_ub sfpub TYP_ub Z_ub /end OUT_MEASUREMENT
 /begin LOC_MEASUREMENT /end LOC_MEASUREMENT
 /begin SUB_FUNCTION /end SUB_FUNCTION
/end FUNCTION
/begin FUNCTION DFPM_LZSR "" /begin DEF_CHARACTERISTIC CDCLZSR CDKLZSR CDTLZSR CLALZSR FFTLZSR TSFLZSR /end DEF_CHARACTERISTIC /begin REF_CHARACTERISTIC /end REF_CHARACTERISTIC /begin IN_MEASUREMENT /end IN_MEASUREMENT
 /begin OUT_MEASUREMENT B_belzsr B_bklzsr B_cllzsr B_ftlzsr B_mnlzsr B_mxlzsr B_nplzsr B_silzsr E_lzsr sfplzsr TYP_lzsr Z_lzsr /end OUT_MEASUREMENT
 /begin LOC_MEASUREMENT /end LOC_MEASUREMENT
 /begin SUB_FUNCTION /end SUB_FUNCTION
/end FUNCTION
/begin FUNCTION DFPM_MDKOG "" /begin DEF_CHARACTERISTIC CDCMDB CDKMDB CDTMDB CLAMDB FFTMDB TSFMDB /end DEF_CHARACTERISTIC /begin REF_CHARACTERISTIC /end REF_CHARACTERISTIC /begin IN_MEASUREMENT /end IN_MEASUREMENT
 /begin OUT_MEASUREMENT B_bemdb B_bkmdb B_clmdb B_ftmdb B_mnmdb B_mxmdb B_npmdb B_simdb E_mdb sfpmdb TYP_mdb Z_mdb /end OUT_MEASUREMENT
 /begin LOC_MEASUREMENT /end LOC_MEASUREMENT
 /begin SUB_FUNCTION /end SUB_FUNCTION
/end FUNCTION
/begin COMPU_METHOD B_TRUE "boolsche Zust‰nde, positive Logik" TAB_VERB "%6.3" "" COMPU_TAB_REF B_TRUE /end COMPU_METHOD
/begin COMPU_VTAB B_TRUE "boolsche Zust‰nde, positive Logik" TAB_VERB 2 0 "----" 1 "TRUE" /end COMPU_VTAB
/begin COMPU_METHOD DEZ "1 : 1 Umrechnug (dez/hex)" RAT_FUNC "%6.2" "" COEFFS 0 1 0 0 0 1 /end COMPU_METHOD
/begin COMPU_METHOD dez "1 : 1 Umrechnug (dez/hex)" RAT_FUNC "%6.2" "" COEFFS 0 1 0 0 0 1 /end COMPU_METHOD
/begin COMPU_METHOD default "" RAT_FUNC "%6.2" "" COEFFS 0 1 0 0 0 1 /end COMPU_METHOD
/begin RECORD_LAYOUT KwbUb FNC_VALUES 1 UBYTE COLUMN_DIR DIRECT /end RECORD_LAYOUT
/begin RECORD_LAYOUT KwbUw FNC_VALUES 1 UWORD COLUMN_DIR DIRECT /end RECORD_LAYOUT
/begin RECORD_LAYOUT KwbWU16 FNC_VALUES 1 UWORD COLUMN_DIR DIRECT /end RECORD_LAYOUT
/begin RECORD_LAYOUT KwbWU8 FNC_VALUES 1 UBYTE COLUMN_DIR DIRECT /end RECORD_LAYOUT
/begin RECORD_LAYOUT KwUb FNC_VALUES 1 UBYTE COLUMN_DIR DIRECT /end RECORD_LAYOUT
/begin RECORD_LAYOUT KwUw FNC_VALUES 1 UWORD COLUMN_DIR DIRECT /end RECORD_LAYOUT
/begin RECORD_LAYOUT KwWU16 FNC_VALUES 1 UWORD COLUMN_DIR DIRECT /end RECORD_LAYOUT
/begin RECORD_LAYOUT KwWU8 FNC_VALUES 1 UBYTE COLUMN_DIR DIRECT /end RECORD_LAYOUT
/end MODULE
/end PROJECT
