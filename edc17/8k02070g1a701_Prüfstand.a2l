ASAP2_VERSION 1 3
/begin PROJECT _9702_071D00 "ME97"
/begin HEADER "" VERSION "_9702_071D00" PROJECT_NO _9702_071D00 /end HEADER
/begin MODULE DIM ""
/begin MOD_COMMON "" BYTE_ORDER MSB_FIRST ALIGNMENT_BYTE 1 ALIGNMENT_WORD 2 ALIGNMENT_LONG 2 ALIGNMENT_FLOAT32_IEEE 4 /end MOD_COMMON
/begin AXIS_PTS AdapAltitudeTempCorrV8 "" 0x1D15D0 AdapAltitudeTempCorr_Coef dc_SstAUwSstUw 1.99997 DC_FCTR_32768_U16 8 0.00 1.99997 FORMAT "%7.5" DEPOSIT ABSOLUTE /end AXIS_PTS
/begin CHARACTERISTIC ANZLVMXA "Maximale Anzahl Lˆseversuche bei verriegelter Nockenwelle Auslaﬂ" VALUE 0x1C3B4C KwUb 255.0 dez 0.00 255.0 FORMAT "%5.1" /end CHARACTERISTIC
/begin CHARACTERISTIC ANZLVMXE "Maximale Anzahl Lˆseversuche bei verriegelter Nockenwelle Einlaﬂ" VALUE 0x1C3B4D KwUb 255.0 dez 0.00 255.0 FORMAT "%5.1" /end CHARACTERISTIC
/begin AXIS_PTS AV08 "Beschleunigungsst¸tzstellen" 0x1D15E4 LongAccel dc_SstAUbSstSb 11.07 DC_UAFZ_S8 8 -5.555 5.512 FORMAT "%5.3" DEPOSIT ABSOLUTE /end AXIS_PTS
/begin CHARACTERISTIC CNFMDWAN "Codewort f¸r die Einberechnung von MDWAN in der LLR" VALUE 0x1C7048 KwUb 255.0 dez 0.00 255.0 FORMAT "%5.1" /end CHARACTERISTIC
/begin CHARACTERISTIC CNFSL "Codewort f¸r Einberechnung der Servolenkung in der LLR" VALUE 0x1CFC60 KwUb 255.0 dez 0.00 255.0 FORMAT "%5.1" /end CHARACTERISTIC
/begin CHARACTERISTIC CWMDRLKO "Codewort: Klimakompressormoment abh. von rl, nmot" VALUE 0x1CFC61 KwUb 255.0 dez 0.00 255.0 FORMAT "%5.1" /end CHARACTERISTIC
/begin CHARACTERISTIC CWMDZUL "Codewort MDZUL zur Ber¸cksichtigung der Verbraucher" VALUE 0x1C6B90 KwUb 255.0 dez 0.00 255.0 FORMAT "%5.1" /end CHARACTERISTIC
/begin CHARACTERISTIC CWNMXMD "Codewort f¸r Drehzahlbegrenzung" VALUE 0x1C6978 KwUb 255.0 dez 0.00 255.0 FORMAT "%5.1" /end CHARACTERISTIC
/begin CHARACTERISTIC CWNWEHOA "CW Umschaltung  f¸r Sollwertvorgabe bei Fehler  Auslassnockenwelle" VALUE 0x1C3B80 KwUb 255.0 dez 0.00 255.0 FORMAT "%5.1" /end CHARACTERISTIC
/begin CHARACTERISTIC CWNWEVO "Codewort: Eingeschr‰nkte Verstellung der Nockenwelle" VALUE 0x1C3B4E KwUb 255.0 dez 0.00 255.0 FORMAT "%5.1" /end CHARACTERISTIC
/begin CHARACTERISTIC CWNWFW "Codewort f¸r Umschaltung der Bildung Faktor Winkel Nockenwelle" VALUE 0x1CAB48 KwUb 255.0 dez 0.00 255.0 FORMAT "%5.1" /end CHARACTERISTIC
/begin CHARACTERISTIC CWSELV "Codewort: Berechnung mit Zusammenfassung aller elektr. Verbraucher." VALUE 0x1CFC62 KwUb 255.0 dez 0.00 255.0 FORMAT "%5.1" /end CHARACTERISTIC
/begin CHARACTERISTIC CWTUM "Codewort: Umgebungstemperatur f¸r Klimakompressor" VALUE 0x1CFC63 KwUb 255.0 dez 0.00 255.0 FORMAT "%5.1" /end CHARACTERISTIC
/begin CHARACTERISTIC DFH_EBG "Geschwindigkeits-Schwelle, unterhalb der die Einschaltbegrnz. aktiv ist" VALUE 0x1D1F1E dc_KwUw 256.0000 DC_VEHSPD_KMH_U16 0.00 256.0000 FORMAT "%8.4" /end CHARACTERISTIC
/begin CHARACTERISTIC DMAUFN "Delta-Moment Aufregelung nach Drehmomenteingriff" CURVE 0x1CFE70 KlAUwSstUwWUw 99.99847 rel_uw_b100 0.00 99.99847 FORMAT "%8.5"
 /begin AXIS_DESCR STD_AXIS nmot_w nmot_uw_q0p25 8 0.00 16383.75 FORMAT "%8.2" DEPOSIT ABSOLUTE /end AXIS_DESCR
/end CHARACTERISTIC
/begin CHARACTERISTIC DMDLWS "Lenkhilfelastmoment" CURVE 0x1CFD2E KlAUwSstSwWUw 49.99924 rel_q0p7629Em3 0.00 49.99924 FORMAT "%8.5"
 /begin AXIS_DESCR STD_AXIS lws_w lw_sw_q0p04375 6 -1434.044 1434.000 FORMAT "%8.3" DEPOSIT ABSOLUTE /end AXIS_DESCR
/end CHARACTERISTIC
/begin CHARACTERISTIC DMDRKO "Momentenreserve f¸r AC-Kompressor" VALUE 0x1CFC64 KwUb 99.61 rel_ub_b99p6 0.00 99.61 FORMAT "%5.2" /end CHARACTERISTIC
/begin CHARACTERISTIC DMDWANMX "Begrenzung des Wandlermoments f¸r Sicherheitskonzept" VALUE 0x1C7049 KwUb 100.0 rel_q0p392 0.00 100.0 FORMAT "%5.1" /end CHARACTERISTIC
/begin CHARACTERISTIC DMDWHYS "Hysterese f¸r Bildung D-Anteil-Wandlermoment" VALUE 0x1C704A KwUb 99.61 rel_ub_b99p6 0.00 99.61 FORMAT "%5.2" /end CHARACTERISTIC
/begin CHARACTERISTIC DMDWM "D-Anteil Wandlermoment bei Einlegen der Fahrstufe" CURVE 0x1CFDEC GklWUb 99.61 rel_ub_b99p6 0.00 99.61 FORMAT "%5.2"
 /begin AXIS_DESCR COM_AXIS twnd temp_ub_q0p75_o48 8 -48.00 143.3 AXIS_PTS_REF STW08MDUB /end AXIS_DESCR
/end CHARACTERISTIC
/begin CHARACTERISTIC DMKO "Begrenzung des Kompressormoments f¸r Sicherheitskonzept" VALUE 0x1CFC65 KwUb 99.61 rel_ub_b100 0.00 99.61 FORMAT "%5.2" /end CHARACTERISTIC
/begin CHARACTERISTIC DMLFS "Begrenzung des L¸ftermoments f¸r Sicherheitskonzept" VALUE 0x1CFC66 KwUb 99.61 rel_ub_b100 0.00 99.61 FORMAT "%5.2" /end CHARACTERISTIC
/begin CHARACTERISTIC DMRDNW "Momentenreserve f¸r Diagnose Nockenwelle ¸ber Tester" VALUE 0x1CAC72 KwUw 99.99847 rel_uw_b100 0.00 99.99847 FORMAT "%8.5" /end CHARACTERISTIC
/begin CHARACTERISTIC DMSERVL "Begrenzung des Moments der Servolenkung f¸r Sicherheitskonzept" VALUE 0x1CFC67 KwUb 99.61 rel_ub_b100 0.00 99.61 FORMAT "%5.2" /end CHARACTERISTIC
/begin CHARACTERISTIC DMSLP "Begrenzung des Moments der Sekund‰rluftpumpe f¸r Sicherheitskonzept" VALUE 0x1CFC68 KwUb 99.61 rel_ub_b100 0.00 99.61 FORMAT "%5.2" /end CHARACTERISTIC
/begin CHARACTERISTIC DNMAX "Zul‰ssige Verminderung der Maximaldrehzahl pro Rechenschritt" VALUE 0x1C698E KwUw 16383.75 nmot_uw_q0p25 0.00 16383.75 FORMAT "%8.2" /end CHARACTERISTIC
/begin CHARACTERISTIC DNSIAB "Delta zwischen Soll- und Istdrehzahl f¸r Abschaltung NMAX-Regelung" VALUE 0x1C6990 KwSw 8191.750 nmot_sw_q0p25 0.00 8191.750 FORMAT "%8.3" /end CHARACTERISTIC
/begin CHARACTERISTIC DNSLLSL "Drehzahloffset f¸r Momentenreserve Servo-Lenkung" VALUE 0x1CFD48 KwUw 16383.75 nmot_uw_q0p25 0.00 16383.75 FORMAT "%8.2" /end CHARACTERISTIC
/begin CHARACTERISTIC DNSOZW "Delta Drehzahl, bei der keine Z¸ndwinkeleingriff stattfindet" CURVE 0x1C6992 FklWUw 16383.75 nmot_uw_q0p25 0.00 16383.75 FORMAT "%8.2"
 /begin AXIS_DESCR FIX_AXIS gangi dez 8 0.00 7.000 FORMAT "%5.3" FIX_AXIS_PAR 0 0 8 /end AXIS_DESCR
/end CHARACTERISTIC
/begin CHARACTERISTIC DWNWABGA "Max-Winkel zur Berechnung der Sollwert‰nderungsbegrenzung Auslass Nockenwelle" CURVE 0x1CAC9E GklWUw 511.9922 kw_q0p0078 0.00 511.9922 FORMAT "%8.4"
 /begin AXIS_DESCR COM_AXIS nmot_w nmot_uw_q0p25 5 0.00 16383.75 AXIS_PTS_REF SNM05NWUW /end AXIS_DESCR
/end CHARACTERISTIC
/begin CHARACTERISTIC DWNWAMXA "Max-Winkel zur Abschaltung der Sollwert‰nderungsbegrenzung Auslass Nockenwelle" CURVE 0x1CACA8 GklWUw 511.9922 kw_q0p0078 0.00 511.9922 FORMAT "%8.4"
 /begin AXIS_DESCR COM_AXIS nmot_w nmot_uw_q0p25 5 0.00 16383.75 AXIS_PTS_REF SNM05NWUW /end AXIS_DESCR
/end CHARACTERISTIC
/begin CHARACTERISTIC DWNWESTPA "Winkelabweichung Einlaﬂnockenwelle f¸r Verstellstopp Auslaﬂ NW" MAP 0x1CAB0A GkfWSw 511.9922 kw_sw_q0p0078 -256.0000 255.9922 FORMAT "%8.4"
 /begin AXIS_DESCR COM_AXIS nmot_w nmot_uw_q0p25 5 0.00 16383.75 AXIS_PTS_REF SNM05NWUW /end AXIS_DESCR
 /begin AXIS_DESCR COM_AXIS toelk_w temp_q0p0234_o273 6 -273.1500 1262.827 AXIS_PTS_REF STO06NWUW /end AXIS_DESCR
/end CHARACTERISTIC
/begin CHARACTERISTIC DWNWSHKA "Maximaler Winkel f¸r Sch¸ttelhub Auslaﬂnockenwelle" VALUE 0x1C3B5A KwSw 512.0000 kw_sw_q0p0078 -256.0000 256.0000 FORMAT "%8.4" /end CHARACTERISTIC
/begin CHARACTERISTIC DWNWSHKE "Maximaler Winkel f¸r Sch¸ttelhub Einlaﬂnockenwelle" VALUE 0x1C3B5C KwSw 512.0000 kw_sw_q0p0078 -256.0000 256.0000 FORMAT "%8.4" /end CHARACTERISTIC
/begin CHARACTERISTIC DWNWSTPA "max Positionsabweichung f¸r Beginn Gleichlauf 2 Bank NW-Verstellung Auslaﬂ" VALUE 0x1C3B5E KwSw 512.0000 kw_sw_q0p0078 -256.0000 256.0000 FORMAT "%8.4" /end CHARACTERISTIC
/begin CHARACTERISTIC DWNWSTPE "max Positionsabweichung f¸r Beginn Gleichlauf 2 Bank NW-Verstellung Einlaﬂ" VALUE 0x1C3B60 KwSw 512.0000 kw_sw_q0p0078 -256.0000 256.0000 FORMAT "%8.4" /end CHARACTERISTIC
/begin CHARACTERISTIC DWNWSTPEA "max Positionsabweichung f¸r Ende Gleichlauf 2 Bank NW-Verstellung Auslaﬂ" VALUE 0x1C3B62 KwSw 512.0000 kw_sw_q0p0078 -256.0000 256.0000 FORMAT "%8.4" /end CHARACTERISTIC
/begin CHARACTERISTIC DWNWSTPEE "max Positionsabweichung f¸r Ende Gleichlauf 2 Bank NW-Verstellung Einlaﬂ" VALUE 0x1C3B64 KwSw 512.0000 kw_sw_q0p0078 -256.0000 256.0000 FORMAT "%8.4" /end CHARACTERISTIC
/begin CHARACTERISTIC DWNWSVPA "Sollwinkelbereich bei dem Verriegelunsposition sicher verlassen ist Auslaﬂ-NW" VALUE 0x1C3B66 KwSw 512.0000 kw_sw_q0p0078 -256.0000 256.0000 FORMAT "%8.4" /end CHARACTERISTIC
/begin CHARACTERISTIC DWNWSVPE "Sollwinkelbereich bei dem Verriegelunsposition sicher verlassen ist Einlaﬂ-NW" VALUE 0x1C3B68 KwSw 512.0000 kw_sw_q0p0078 -256.0000 256.0000 FORMAT "%8.4" /end CHARACTERISTIC
/begin CHARACTERISTIC DWNWVPA "Winkelbereich Langloch der Verriegelunsposition  Auslaﬂnockenwelle" VALUE 0x1C3B6A KwSw 512.0000 kw_sw_q0p0078 -256.0000 256.0000 FORMAT "%8.4" /end CHARACTERISTIC
/begin CHARACTERISTIC DWNWVPE "Winkelbereich Langloch der Verriegelunsposition  Einlaﬂnockenwelle" VALUE 0x1C3B6C KwSw 512.0000 kw_sw_q0p0078 -256.0000 256.0000 FORMAT "%8.4" /end CHARACTERISTIC
/begin CHARACTERISTIC DZWETA "Deltaz¸ndwinkel aus Wirkungsgrad" CURVE 0x1C7C30 FklWSb 191.3 zw_sb_q0p75 -96.00 95.25 FORMAT "%5.2"
 /begin AXIS_DESCR FIX_AXIS etazws rel_ub_b127p5 201 0.00 100.0 FORMAT "%5.1" FIX_AXIS_PAR 0 0 201 /end AXIS_DESCR
/end CHARACTERISTIC
/begin CHARACTERISTIC EBGAKT_T "Einschaltbegrenzungs-Aktivierungszeit (EGS)" VALUE 0x1D30DC dc_KwUb 2.550 DC_TQ10 0.00 2.550 FORMAT "%5.3" /end CHARACTERISTIC
/begin CHARACTERISTIC EBG_MAX "Einschaltbegrenzungs-Maximalmoment" VALUE 0x1D1F1C dc_KwUw 4095.938 DC_TRQ_S16 0.00 4095.938 FORMAT "%8.3" /end CHARACTERISTIC
/begin CHARACTERISTIC EBG_RP_KF "Rampensteigung Einschaltbegrenzung" CURVE 0x1D1EB8 dc_GKlWUw 4095.938 DC_TRQ_S16 0.00 4095.938 FORMAT "%8.3"
 /begin AXIS_DESCR COM_AXIS TransGuard_Cntr DC_CNTR_U8 2 0.00 255.0 AXIS_PTS_REF EBG_RP_SST /end AXIS_DESCR
/end CHARACTERISTIC
/begin AXIS_PTS EBG_RP_SST "St¸tzstellen der Kennlinie EBG_RP_KF Rampensteigungen" 0x1D1600 TransGuard_Cntr dc_SstAUbSstUb 255.0 DC_CNTR_U8 2 0.00 255.0 FORMAT "%5.1" DEPOSIT ABSOLUTE /end AXIS_PTS
/begin CHARACTERISTIC FABMDWA "Faktor zur Absteuerung des Wandlermoments abh‰ngig von nturb/nsol" CURVE 0x1C704C KlAUbSstUbWUb 0.9961 fak_ub_b1 0.00 0.9961
 /begin AXIS_DESCR STD_AXIS qntns fak_ub_b8 6 0.00 7.969 FORMAT "%5.3" DEPOSIT ABSOLUTE /end AXIS_DESCR
/end CHARACTERISTIC
/begin CHARACTERISTIC FDMDWAN "Wichtungsfaktor f¸r Einrechnung D-Anteil in Wandlermoment" VALUE 0x1C7059 KwUb 0.9961 fak_ub_b1 0.00 0.9961 /end CHARACTERISTIC
/begin CHARACTERISTIC FKOP_LSD "Faktor f¸r Bewertung des Lastschlags ausw‰hlbar aus Korrekturprogrammierung" CURVE 0x1D30E0 dc_ArrUb 1.992 DC_FKT128 0.00 1.992 FORMAT "%5.3"
 /begin AXIS_DESCR FIX_AXIS LTC_Coef DEZ 8 0.00 7.000 FORMAT "%5.3" FIX_AXIS_PAR 0 0 8 /end AXIS_DESCR
/end CHARACTERISTIC
/begin CHARACTERISTIC FMDWAT "Faktor zur Berechnung des Wandlermoments abh. von der ÷ltemperatur des Wandlers" CURVE 0x1CFDF4 GklWUb 0.000119850000 fak_ub_q4p7Em7 0.00 0.000119850000 FORMAT "%14.12"
 /begin AXIS_DESCR COM_AXIS twnd temp_ub_q0p75_o48 8 -48.00 143.3 AXIS_PTS_REF STW08MDUB /end AXIS_DESCR
/end CHARACTERISTIC
/begin CHARACTERISTIC FNRAD "Faktor zwischen Raddrehzahl und Geschwindigkeit f(Radumfang)" VALUE 0x1C705A KwUb 15.94 fak_ub_b16 0.00 15.94 FORMAT "%5.2" /end CHARACTERISTIC
/begin CHARACTERISTIC FNWSKRA "Faktor Nockenwellen-Sollwinkelkorrektur durch klopfende Verbrennungen Auslaﬂ" CURVE 0x1CAC78 KlAUbSstUbWUb 1.000 fak_ub_b2 0.00 1.000 FORMAT "%5.3"
 /begin AXIS_DESCR STD_AXIS wkrma zw_sb_q0p75 3 0.00 191.3 FORMAT "%5.1" DEPOSIT ABSOLUTE /end AXIS_DESCR
/end CHARACTERISTIC
/begin CHARACTERISTIC FVDMDWAN "Verst‰rkungsfaktor zur Bildung D-Ateil-Wandlermomnet" VALUE 0x1C705B KwUb 7.969 fak_ub_b8 0.00 7.969 FORMAT "%5.3" /end CHARACTERISTIC
/begin CHARACTERISTIC FWBBR1 "" VALUE 0x1D3117 dc_KwUb 255.0 DC_CNTR_U8 0.00 255.0 FORMAT "%5.1" /end CHARACTERISTIC
/begin CHARACTERISTIC FWBBR2 "" VALUE 0x1D3116 dc_KwUb 255.0 DC_CNTR_U8 0.00 255.0 FORMAT "%5.1" /end CHARACTERISTIC
/begin CHARACTERISTIC FWBBR3 "" VALUE 0x1D3115 dc_KwUb 255.0 DC_CNTR_U8 0.00 255.0 FORMAT "%5.1" /end CHARACTERISTIC
/begin CHARACTERISTIC FWBBR4 "" VALUE 0x1D3114 dc_KwUb 255.0 DC_CNTR_U8 0.00 255.0 FORMAT "%5.1" /end CHARACTERISTIC
/begin CHARACTERISTIC FWBPEDGR "Schwelle Pedalwertgradient Fahrervorgabemomentbegrenzung" VALUE 0x1D1FE6 dc_KwSw 200.0031 DC_PCT_S16 -100.0031 100.0000 FORMAT "%8.4" /end CHARACTERISTIC
/begin CHARACTERISTIC FWBTMOT "Motortemperaturschwelle Fahrervorgabemomentbegrenzung" VALUE 0x1D1FE8 dc_KwSw 4095.875 DC_TEMP_S16 0.00 4095.875 FORMAT "%8.3" /end CHARACTERISTIC
/begin CHARACTERISTIC FWBVO "untere Geschwindigkeitsschwelle Fahrervorgabemomentbegrenzung" VALUE 0x1D1FE4 dc_KwUw 300.0000 DC_VEHSPD_KMH_U16 0.00 300.0000 FORMAT "%8.4" /end CHARACTERISTIC
/begin CHARACTERISTIC FWBVU "untere  Geschwindigkeitsschwelle Fahrervorgabemomentbegrenzung" VALUE 0x1D1FEA dc_KwUw 300.0000 DC_VEHSPD_KMH_U16 0.00 300.0000 FORMAT "%8.4" /end CHARACTERISTIC
/begin CHARACTERISTIC FWDNGBT "Tiefpassfilter f¸r Gradient der Drehzahlabweichung bei NGB" VALUE 0x1D312E dc_KwUb 5.080 DC_TQ20 0.02000 5.100 FORMAT "%5.3" /end CHARACTERISTIC
/begin CHARACTERISTIC FWDPFILA "Zeikonstante f¸r DP-Filter Allrad" VALUE 0x1D30E9 dc_KwUb 2.550 DC_TQ10 0.00 2.550 FORMAT "%5.3" /end CHARACTERISTIC
/begin CHARACTERISTIC FWDPFILH "Zeikonstante f¸r DP-Filter Handschalter" VALUE 0x1D30EA dc_KwUb 2.550 DC_TQ10 0.00 2.550 FORMAT "%5.3" /end CHARACTERISTIC
/begin CHARACTERISTIC FWDTLSAS "Grenzmassenliefergraddelta FWDTLSAS f¸r Handschalter" VALUE 0x1D30EB dc_KwUb 127.5 DC_UFUELL 0.00 127.5 FORMAT "%5.1" /end CHARACTERISTIC
/begin CHARACTERISTIC FWDVNGB "D-Verst‰rkung des Drehzahl-PID-Reglers" VALUE 0x1D2394 dc_KwUw 1.0000 DC_FKT20480_U16DB 0.00 1.0000 FORMAT "%6.4" /end CHARACTERISTIC
/begin CHARACTERISTIC FWDVWF "D-Verst‰rkung des Drehzahl-PID-Reglers bei Wandlerfliehkraftschluss" VALUE 0x1D2396 dc_KwUw 1.0000 DC_FKT20480_U16DB 0.00 1.0000 FORMAT "%6.4" /end CHARACTERISTIC
/begin CHARACTERISTIC FWDWFT "PT1-Filterkonstante zum Drehzahlgradient ng_nhgb bei Wandlerfliehkraftschutz" VALUE 0x1D312F dc_KwUb 5.080 DC_TQ20 0.02000 5.100 FORMAT "%5.3" /end CHARACTERISTIC
/begin CHARACTERISTIC FWFVANF "" VALUE 0x1D311D dc_KwUb 255.0 DC_CNTR_U8 0.00 255.0 FORMAT "%5.1" /end CHARACTERISTIC
/begin CHARACTERISTIC FWIVFAK "Faktorisierung des I-Initialmoments zur Drehzahlbegrenzung" VALUE 0x1D3130 dc_KwUb 1.00000 DC_FKT255 0.00 1.00000 /end CHARACTERISTIC
/begin CHARACTERISTIC FWIVHGB "I-Verst‰rkung des PI-Reglers" VALUE 0x1D2398 dc_KwUw 127.9961 DC_FKT256L 0.00 127.9961 FORMAT "%8.4" /end CHARACTERISTIC
/begin CHARACTERISTIC FWIVNGBA "I-Verst‰rkung des Drehzahl- PI-Reglers bei NAG" VALUE 0x1D239A dc_KwUw 0.9999695 DC_FKT32768 0.00 0.9999695 FORMAT "%9.7" /end CHARACTERISTIC
/begin CHARACTERISTIC FWIVNGBH "I-Verst‰rkung des Drehzahl- PI-Reglers bei HS" VALUE 0x1D239C dc_KwUw 0.9999695 DC_FKT32768 0.00 0.9999695 FORMAT "%9.7" /end CHARACTERISTIC
/begin CHARACTERISTIC FWIVWF "I-Verst‰rkung des Drehzahl-PID-Reglers bei Wandlerfliehkraftschutz" VALUE 0x1D239E dc_KwUw 0.9999695 DC_FKT32768 0.00 0.9999695 FORMAT "%9.7" /end CHARACTERISTIC
/begin CHARACTERISTIC FWMINTOEL "Schwellwert f¸r ˆltemperaturabh‰ngigen Wandlerfliehkraftschutz" VALUE 0x1D23A0 dc_KwSw 8191.875 DC_TEMP_S16 -4096.000 4095.875 FORMAT "%8.3" /end CHARACTERISTIC
/begin CHARACTERISTIC FWNABSCHA "Differenz zw. Hˆchstdrehzahl. u. Abschaltschwelle bei Automat" VALUE 0x1D23A2 dc_KwSw 8000.00 DC_ROTSPD_S16 0.00 8000.00 FORMAT "%7.2" /end CHARACTERISTIC
/begin CHARACTERISTIC FWNABSCHH "Differenz zw. Hˆchstdrehzahl. u. Abschaltschwelle bei Handschalter" VALUE 0x1D23A4 dc_KwSw 8000.00 DC_ROTSPD_S16 0.00 8000.00 FORMAT "%7.2" /end CHARACTERISTIC
/begin CHARACTERISTIC FWNABSCHWF "Diff. zw. Hˆchstdrehz. u. Abschaltschwelle bei Wandlerfliehkraftschutz" VALUE 0x1D23A6 dc_KwSw 8000.00 DC_ROTSPD_S16 0.00 8000.00 FORMAT "%7.2" /end CHARACTERISTIC
/begin CHARACTERISTIC FWNGFIL "PT1-Filterkonstante zum Drehzahlgradient ng_nhgb" VALUE 0x1D3131 dc_KwUb 5.080 DC_TQ20 0.02000 5.100 FORMAT "%5.3" /end CHARACTERISTIC
/begin CHARACTERISTIC FWNIDLY "Zeit-Delay des I-Anteils bei Aktivierung der weichen Drehbegrenzung" VALUE 0x1D3132 dc_KwUb 5.100 DC_TQ20 0.00 5.100 FORMAT "%5.3" /end CHARACTERISTIC
/begin CHARACTERISTIC FWNIDLYWF "t-delay d. I- u. D-Ant. b. Aktiv. d. weichen Drehbegr. b. Wandlerfliehkr.schutz" VALUE 0x1D3133 dc_KwUb 5.100 DC_TQ20 0.00 5.100 FORMAT "%5.3" /end CHARACTERISTIC
/begin CHARACTERISTIC FWNMAXWF "Drehzahlbegrenzung f¸r weiche Drehzahlbegrenzung bei Wandlerfliehkraftschutz" VALUE 0x1D23A8 dc_KwSw 7500.00 DC_ROTSPD_S16 500.000 8000.00 FORMAT "%7.2" /end CHARACTERISTIC
/begin CHARACTERISTIC FWNOUTA "Differenz zw. Hˆchstdrehzahl. u. Deaktivierungsschwelle bei NAG" VALUE 0x1D23AA dc_KwSw 8000.00 DC_ROTSPD_S16 0.00 8000.00 FORMAT "%7.2" /end CHARACTERISTIC
/begin CHARACTERISTIC FWNOUTH "Differenz zw. Hˆchstdrehzahl. u. Deaktivierungsschwelle bei HS" VALUE 0x1D23AC dc_KwSw 8000.00 DC_ROTSPD_S16 0.00 8000.00 FORMAT "%7.2" /end CHARACTERISTIC
/begin CHARACTERISTIC FWNTOEL "Drehzahlbegrenzung bei Wandlerfliehkraftschutz und ÷ltemperaturbegrenzung" VALUE 0x1D23AE dc_KwSw 7500.00 DC_ROTSPD_S16 500.000 8000.00 FORMAT "%7.2" /end CHARACTERISTIC
/begin CHARACTERISTIC FWPVHGB "P-Verst‰rkung des PI-Reglers" VALUE 0x1D23B0 dc_KwUw 127.9961 DC_FKT256L 0.00 127.9961 FORMAT "%8.4" /end CHARACTERISTIC
/begin CHARACTERISTIC FWPVNGBA "P-Verst‰rkung des Drehzahl- PI-Reglers bei NAG" VALUE 0x1D23B2 dc_KwUw 0.9999695 DC_FKT32768 0.00 0.9999695 FORMAT "%9.7" /end CHARACTERISTIC
/begin CHARACTERISTIC FWPVNGBH "P-Verst‰rkung des Drehzahl- PI-Reglers bei HS" VALUE 0x1D23B4 dc_KwUw 0.9999695 DC_FKT32768 0.00 0.9999695 FORMAT "%9.7" /end CHARACTERISTIC
/begin CHARACTERISTIC FWPVWF "P-Verst‰rkung des Drehzahl-PID-Reglers bei Wandlerfliehkraftschutz" VALUE 0x1D23B6 dc_KwUw 0.9999695 DC_FKT32768 0.00 0.9999695 FORMAT "%9.7" /end CHARACTERISTIC
/begin CHARACTERISTIC FWTNMAXK "Zeitdauer der Maximaldrehzahlbegrenzung" VALUE 0x1D23B8 dc_KwUw 13.000 DC_TIME_20MS_U16 0.00 13.000 FORMAT "%6.3" /end CHARACTERISTIC
/begin CHARACTERISTIC FWTRAMP "Zeitdauer der Abrampung von Max- auf Dauerdrehzahlbegrenzung" VALUE 0x1D23BA dc_KwUw 15.000 DC_TIME_20MS_U16 0.00 15.000 FORMAT "%6.3" /end CHARACTERISTIC
/begin CHARACTERISTIC FWVABSCH "Differenz zw. Hˆchstgeschw. u. Abschaltschwelle" VALUE 0x1D23BC dc_KwUw 2000.000 DC_VEHSPD_KMH_U16 0.00 2000.000 FORMAT "%8.3" /end CHARACTERISTIC
/begin CHARACTERISTIC FWVLNB "Schwellwert vollastnaher Bereich" VALUE 0x1D22DC dc_KwUw 200.0031 DC_PER0327 0.00 200.0031 FORMAT "%8.4" /end CHARACTERISTIC
/begin CHARACTERISTIC FWVLNBHY "Hysterese vollastnaher Bereich" VALUE 0x1D22DE dc_KwUw 200.0031 DC_PER0327 0.00 200.0031 FORMAT "%8.4" /end CHARACTERISTIC
/begin CHARACTERISTIC FWVMAXD "Geschwindigkeitsschwelle f¸r Wandlerfliehkraftschutz in Drive" VALUE 0x1D23BE dc_KwUw 100.0000 DC_VEHSPD_KMH_U16 0.00 100.0000 FORMAT "%8.4" /end CHARACTERISTIC
/begin CHARACTERISTIC FWVMAXR "Geschwindigkeitsschwelle f¸r Wandlerfliehkraftschutz in Rueck" VALUE 0x1D23C0 dc_KwUw 100.0000 DC_VEHSPD_KMH_U16 0.00 100.0000 FORMAT "%8.4" /end CHARACTERISTIC
/begin CHARACTERISTIC FWVVORH "Differenz zw. Hˆchstgeschw. u. Vorhalteschwelle" VALUE 0x1D23C2 dc_KwUw 2000.000 DC_VEHSPD_KMH_U16 0.00 2000.000 FORMAT "%8.3" /end CHARACTERISTIC
/begin CHARACTERISTIC FWWNMAXD "Dauerdrehzahl f¸r weiche Drehzahlbegrenzung" VALUE 0x1D23C4 dc_KwSw 7500.00 DC_ROTSPD_S16 500.000 8000.00 FORMAT "%7.2" /end CHARACTERISTIC
/begin CHARACTERISTIC FWWNMAXKA "" VALUE 0x1D23C6 dc_KwSw 7500.00 DC_ROTSPD_S16 500.000 8000.00 FORMAT "%7.2" /end CHARACTERISTIC
/begin CHARACTERISTIC FWWNMAXKH "" VALUE 0x1D23C8 dc_KwSw 7500.00 DC_ROTSPD_S16 500.000 8000.00 FORMAT "%7.2" /end CHARACTERISTIC
/begin CHARACTERISTIC FWWNMAXR "Reset-Grenze f¸r Maximaldrehzahlbegrenzung" VALUE 0x1D23CA dc_KwSw 7550.00 DC_ROTSPD_S16 450.000 8000.00 FORMAT "%7.2" /end CHARACTERISTIC
/begin CHARACTERISTIC FW_ASGSME "Begrenzungs-Faktor Momentenabbau bei SME" VALUE 0x1D2384 dc_KwUw 1.00000 DC_FCTR_65535_U16 0.00 1.00000 FORMAT "%7.5" /end CHARACTERISTIC
/begin CHARACTERISTIC FW_EGSSME "Begrenzungs-Faktor zur Momentenerhˆhung bei sme" VALUE 0x1D2386 dc_KwUw 1.00000 DC_FCTR_65535_U16 0.00 1.00000 FORMAT "%7.5" /end CHARACTERISTIC
/begin CHARACTERISTIC FW_LSDAUSA "Momentenschwelle f¸r daktive Lastschlagd‰mpfung (Automat)" VALUE 0x1D1F66 dc_KwSw 4095.938 DC_TRQ_S16 -2048.000 2047.938 FORMAT "%8.3" /end CHARACTERISTIC
/begin CHARACTERISTIC FW_MMLOFFS "Reservemomenten-Offset (mech. Lader)" VALUE 0x1D2388 dc_KwSw 4095.938 DC_TRQ_S16 -2048.000 2047.938 FORMAT "%8.3" /end CHARACTERISTIC
/begin CHARACTERISTIC FW_TRGR "Triggerschwelle f¸r Gradientenerkennung" VALUE 0x1D1F20 dc_KwSw 312.5000 DC_TRQ_S16 0.00 312.5000 FORMAT "%8.4" /end CHARACTERISTIC
/begin CHARACTERISTIC FW_T_TLBOF "Schwelle f¸r Saugrohrevakuierung" VALUE 0x1D30ED dc_KwUb 2.550 DC_TQ10 0.00 2.550 FORMAT "%5.3" /end CHARACTERISTIC
/begin CHARACTERISTIC GANGNWLLPA "Gang Applikationswert Auslaﬂ-Nockenwelle bei Leerlauf" VALUE 0x1CAC7F KwUb 255.0 dez 0.00 255.0 FORMAT "%5.1" /end CHARACTERISTIC
/begin CHARACTERISTIC INMAXX "Maximalwert f¸r I-Anteil" VALUE 0x1C6979 KwUb 99.61 rel_ub_b99p6 0.00 99.61 FORMAT "%5.2" /end CHARACTERISTIC
/begin CHARACTERISTIC ITNMXH "Verweilzeit unterhalb unterer Drehzahlgrenze vor Aktivierung der oberen Grenze" VALUE 0x1CF0E2 KwUw 6553.500 t100msxs_uw_b6553p5 0.00 6553.500 FORMAT "%8.3" /end CHARACTERISTIC
/begin CHARACTERISTIC KFDDP_1 "Deltamoment f¸r Dashpot f¸r 1. Gang-Bereich" MAP 0x1D2FD4 dc_GKfWUb 255. DC_MMQ1_U8DB 0.00 255. FORMAT "%4.0"
 /begin AXIS_DESCR COM_AXIS TrqIndDashpLTC_Req DC_TRQ_S16 8 -2048.000 2047.938 AXIS_PTS_REF MV_DP /end AXIS_DESCR
 /begin AXIS_DESCR COM_AXIS Eng_Spd DC_ROTSPD_S16 8 -16384.0 16383.5 AXIS_PTS_REF NISTV08 /end AXIS_DESCR
/end CHARACTERISTIC
/begin CHARACTERISTIC KFDDP_2 "Deltamoment f¸r Dashpot f¸r 2. Gang-Bereich" MAP 0x1D3054 dc_GKfWUb 255. DC_MMQ1_U8DB 0.00 255. FORMAT "%4.0"
 /begin AXIS_DESCR COM_AXIS TrqIndDashpLTC_Req DC_TRQ_S16 8 -2048.000 2047.938 AXIS_PTS_REF MV_DP /end AXIS_DESCR
 /begin AXIS_DESCR COM_AXIS Eng_Spd DC_ROTSPD_S16 8 -16384.0 16383.5 AXIS_PTS_REF NISTV08 /end AXIS_DESCR
/end CHARACTERISTIC
/begin CHARACTERISTIC KFDDP_A "Deltamoment f¸r Dashpot" MAP 0x1D3014 dc_GKfWUb 255. DC_MMQ1_U8DB 0.00 255. FORMAT "%4.0"
 /begin AXIS_DESCR COM_AXIS TrqIndDashpLTC_Req DC_TRQ_S16 8 -2048.000 2047.938 AXIS_PTS_REF MV_DP /end AXIS_DESCR
 /begin AXIS_DESCR COM_AXIS Eng_Spd DC_ROTSPD_S16 8 -16384.0 16383.5 AXIS_PTS_REF NISTV08 /end AXIS_DESCR
/end CHARACTERISTIC
/begin CHARACTERISTIC KFDMDKOE "Anfangswert Momentenfilter bei Klimakompressor Einschalten" MAP 0x1CFC6C GkfWSb 99.60 rel_sb_q0p39 -50.00 49.61 FORMAT "%5.2"
 /begin AXIS_DESCR COM_AXIS nmot nmot_ub_q40 6 0.00 10200. AXIS_PTS_REF SNM06KOUB /end AXIS_DESCR
 /begin AXIS_DESCR COM_AXIS tlok temp_ub_q0p75_o48 6 -48.00 143.3 AXIS_PTS_REF STA06LLUB /end AXIS_DESCR
/end CHARACTERISTIC
/begin CHARACTERISTIC KFDMP "Kennfeld f¸r pedalabh‰ngigen Teil der Verlustmomente" MAP 0x1C6B94 GkfWUb 99.61 rel_ub_b99p6 0.00 99.61 FORMAT "%5.2"
 /begin AXIS_DESCR COM_AXIS wped relPED_ub_b100 8 0.00 100.0 AXIS_PTS_REF SWP08MFUB /end AXIS_DESCR
 /begin AXIS_DESCR COM_AXIS nmot nmot_ub_q40 8 0.00 10200. AXIS_PTS_REF SNM08MFUB /end AXIS_DESCR
/end CHARACTERISTIC
/begin CHARACTERISTIC KFDMT "Kennfeld zur Ber¸cksichtigung temperaturabh‰ngiger Momente (Ebene 1)" MAP 0x1C6BD4 GkfWUb 99.61 rel_ub_b99p6 0.00 99.61 FORMAT "%5.2"
 /begin AXIS_DESCR COM_AXIS tmotmn temp_ub_q0p75_o48 8 -48.00 143.3 AXIS_PTS_REF STM08MFUB /end AXIS_DESCR
 /begin AXIS_DESCR COM_AXIS nmot nmot_ub_q40 8 0.00 10200. AXIS_PTS_REF SNM08MFUB /end AXIS_DESCR
/end CHARACTERISTIC
/begin CHARACTERISTIC KFFNWE "Wichtung Nockenwelle Einlass" MAP 0x1CAB4C KfAxUbAyUbSstxUbSstyUbWUb 0.9961 fak_ub_b1 0.00 0.9961 /begin AXIS_DESCR STD_AXIS fnwue fak_ub_b1 6 0.00 0.9961 DEPOSIT ABSOLUTE /end AXIS_DESCR
 /begin AXIS_DESCR STD_AXIS rl rel_ub_q0p75 6 0.00 191.3 FORMAT "%5.1" DEPOSIT ABSOLUTE /end AXIS_DESCR
/end CHARACTERISTIC
/begin CHARACTERISTIC KFFVMN "Fahrervorgabemoment ¸ber Drehzahl" MAP 0x1D2060 dc_GKfWUw 1.99997 DC_FCTR_32768_U16 0.00 1.99997 FORMAT "%7.5"
 /begin AXIS_DESCR COM_AXIS APP_Char DC_PER0327 16 0.00 100.0000 AXIS_PTS_REF PWV /end AXIS_DESCR
 /begin AXIS_DESCR COM_AXIS Eng_Spd DC_ROTSPD_S16 16 -16384.0 16383.5 AXIS_PTS_REF NISTV17 /end AXIS_DESCR
/end CHARACTERISTIC
/begin CHARACTERISTIC KFMDDLWS "Lenkhilfelastmoment abh‰ngig von der Lenkwinkelgeschwindigkeit" MAP 0x1CFD4A KfAxSwAySwSstxSwSstySwWSw 99.99847 rel_uw_b100 -50.00000 49.99847 FORMAT "%8.5"
 /begin AXIS_DESCR STD_AXIS dlwsu_w dlw_sw_q0p04375 6 -1434.044 1434.000 FORMAT "%8.3" DEPOSIT ABSOLUTE /end AXIS_DESCR
 /begin AXIS_DESCR STD_AXIS lws_w lw_sw_q0p04375 6 -1434.044 1434.000 FORMAT "%8.3" DEPOSIT ABSOLUTE /end AXIS_DESCR
/end CHARACTERISTIC
/begin CHARACTERISTIC KFMDELMX "Drehmomentenaufnahme Generator" MAP 0x1CFDAE KfAxUbAyUbSstxUwSstyUwWUw 99.99847 rel_uw_b100 0.00 99.99847 FORMAT "%8.5"
 /begin AXIS_DESCR STD_AXIS nmot nmot_ub_q40 6 0.00 2621400. FORMAT "%8.0" DEPOSIT ABSOLUTE /end AXIS_DESCR
 /begin AXIS_DESCR STD_AXIS tans temp_ub_q0p75_o48 3 -48.00000 49103.25 FORMAT "%8.2" DEPOSIT ABSOLUTE /end AXIS_DESCR
/end CHARACTERISTIC
/begin CHARACTERISTIC KFMDKO "Drehmomentaufnahme Klimakompressor" MAP 0x1CFC90 GkfWUb 49.80 rel_q0p1953 0.00 49.80 FORMAT "%5.2"
 /begin AXIS_DESCR COM_AXIS nmot nmot_ub_q40 6 0.00 10200. AXIS_PTS_REF SNM06KOUB /end AXIS_DESCR
 /begin AXIS_DESCR COM_AXIS tlok temp_ub_q0p75_o48 6 -48.00 143.3 AXIS_PTS_REF STA06LLUB /end AXIS_DESCR
/end CHARACTERISTIC
/begin CHARACTERISTIC KFMDRKO "Kennfeld: Klimakompressormoment abh. von rl, nmot" MAP 0x1CFCB4 GkfWUb 49.80 rel_q0p1953 0.00 49.80 FORMAT "%5.2"
 /begin AXIS_DESCR COM_AXIS nmot nmot_ub_q40 6 0.00 10200. AXIS_PTS_REF SNM06KOUB /end AXIS_DESCR
 /begin AXIS_DESCR COM_AXIS rl rel_ub_q0p75 6 0.00 191.3 AXIS_PTS_REF SRL06KOUB /end AXIS_DESCR
/end CHARACTERISTIC
/begin CHARACTERISTIC KFMDRKOE "Kennfeld: Klimakompressormoment dyn. Anteil abh. von rl, nmot" MAP 0x1CFCD8 GkfWSb 99.60 rel_sb_q0p39 -50.00 49.61 FORMAT "%5.2"
 /begin AXIS_DESCR COM_AXIS nmot nmot_ub_q40 6 0.00 10200. AXIS_PTS_REF SNM06KOUB /end AXIS_DESCR
 /begin AXIS_DESCR COM_AXIS rl rel_ub_q0p75 6 0.00 191.3 AXIS_PTS_REF SRL06KOUB /end AXIS_DESCR
/end CHARACTERISTIC
/begin CHARACTERISTIC KFMDWMX "Max. Begrenzung f¸r Drehmomentaufnahme des Wandlers" MAP 0x1C705C KfAxUbAyUbSstxUbSstyUbWUb 99.61 rel_ub_b99p6 0.00 99.61 FORMAT "%5.2"
 /begin AXIS_DESCR STD_AXIS vfzg vfzg_ub_q1p25 6 0.00 318.8 FORMAT "%5.1" DEPOSIT ABSOLUTE /end AXIS_DESCR
 /begin AXIS_DESCR STD_AXIS tmot temp_ub_q0p75_o48 8 -48.00 143.3 FORMAT "%5.1" DEPOSIT ABSOLUTE /end AXIS_DESCR
/end CHARACTERISTIC
/begin CHARACTERISTIC KFMOF "Kennfeld f¸r Offset-Toleranz in Abh‰ngigkeit vom zul‰ssigen Moment (Ebene 1)" MAP 0x1C6C14 GkfWUb 99.61 rel_ub_b99p6 0.00 99.61 FORMAT "%5.2"
 /begin AXIS_DESCR COM_AXIS mizuvfil rel_ub_b99p6 8 0.00 99.61 AXIS_PTS_REF SMO08MFUB /end AXIS_DESCR
 /begin AXIS_DESCR COM_AXIS nmot nmot_ub_q40 8 0.00 10200. AXIS_PTS_REF SNM08MFUB /end AXIS_DESCR
/end CHARACTERISTIC
/begin CHARACTERISTIC KFNMAXKI "I-Anteil des NMAX-Reglers" MAP 0x1CF0A0 GkfWUb 4.864 relnmot_q0p01907 0.00 4.864 FORMAT "%5.3"
 /begin AXIS_DESCR COM_AXIS nsber nmot_q64 4 0.00 16320. AXIS_PTS_REF SNS04MDUB /end AXIS_DESCR
 /begin AXIS_DESCR COM_AXIS gangi dez 8 0.00 255.0 AXIS_PTS_REF SGA08MDUB /end AXIS_DESCR
/end CHARACTERISTIC
/begin CHARACTERISTIC KFNMAXKP "P-Anteil des NMAX-Reglers" MAP 0x1CF0C0 GkfWUb 0.7782 relnmot_q0p003052 0.00 0.7782
 /begin AXIS_DESCR COM_AXIS nsber nmot_q64 4 0.00 16320. AXIS_PTS_REF SNS04MDUB /end AXIS_DESCR
 /begin AXIS_DESCR COM_AXIS gangi dez 8 0.00 255.0 AXIS_PTS_REF SGA08MDUB /end AXIS_DESCR
/end CHARACTERISTIC
/begin CHARACTERISTIC KFNMREDA "Momentenvorhalt f¸r Drehzahlregelung bei Automat" MAP 0x1D23CC dc_GKfWUb 1020. DC_MMQ8_1024 0.00 1020. FORMAT "%5.0"
 /begin AXIS_DESCR COM_AXIS mist_roh DC_TRQ_S16 8 -100.0000 500.0000 AXIS_PTS_REF MIST16 /end AXIS_DESCR
 /begin AXIS_DESCR COM_AXIS ng_nhgb DC_NGRDQ10_S16DB 8 -327680. 327670. AXIS_PTS_REF NG08 /end AXIS_DESCR
/end CHARACTERISTIC
/begin CHARACTERISTIC KFNMREDH "Momentenvorhalt f¸r Drehzahlregelung bei Handschalter" MAP 0x1D240C dc_GKfWUb 1020. DC_MMQ8_1024 0.00 1020. FORMAT "%5.0"
 /begin AXIS_DESCR COM_AXIS mist_roh DC_TRQ_S16 8 -100.0000 500.0000 AXIS_PTS_REF MIST16 /end AXIS_DESCR
 /begin AXIS_DESCR COM_AXIS ng_nhgb DC_NGRDQ10_S16DB 8 -327680. 327670. AXIS_PTS_REF NG08 /end AXIS_DESCR
/end CHARACTERISTIC
/begin CHARACTERISTIC KFNWKHA "Kennfeld f¸r Nockenwellenspreizung bei Katheizen (Auslaﬂ)" MAP 0x1CACB2 GkfWSw 511.9922 kw_sw_q0p0078 -256.0000 255.9922 FORMAT "%8.4"
 /begin AXIS_DESCR COM_AXIS nmot_w nmot_uw_q0p25 16 0.00 16383.75 AXIS_PTS_REF SNM16NAUW /end AXIS_DESCR
 /begin AXIS_DESCR COM_AXIS rlnw_w rel_uw_q0p0234 8 0.00 1535.977 AXIS_PTS_REF SRL08NAUW /end AXIS_DESCR
/end CHARACTERISTIC
/begin CHARACTERISTIC KFNWKHLLA "Kennfeld f¸r Nockenwellenspreizung bei Katheizen und B_ll (Auslaﬂ)" MAP 0x1CADB2 GkfWSw 511.9922 kw_sw_q0p0078 -256.0000 255.9922 FORMAT "%8.4"
 /begin AXIS_DESCR COM_AXIS nmot_w nmot_uw_q0p25 5 0.00 16383.75 AXIS_PTS_REF SNM05NAUW /end AXIS_DESCR
 /begin AXIS_DESCR COM_AXIS rlnw_w rel_uw_q0p0234 5 0.00 1535.977 AXIS_PTS_REF SRL05NAUW /end AXIS_DESCR
/end CHARACTERISTIC
/begin CHARACTERISTIC KFNWKRA "Sollwinkel Nockenwelle  bei klopfender Verbrennung Auslaﬂ" MAP 0x1CADE4 GkfWSw 511.9922 kw_sw_q0p0078 -256.0000 255.9922 FORMAT "%8.4"
 /begin AXIS_DESCR COM_AXIS nmot_w nmot_uw_q0p25 16 0.00 16383.75 AXIS_PTS_REF SNM16NAUW /end AXIS_DESCR
 /begin AXIS_DESCR COM_AXIS rlnw_w rel_uw_q0p0234 8 0.00 1535.977 AXIS_PTS_REF SRL08NAUW /end AXIS_DESCR
/end CHARACTERISTIC
/begin CHARACTERISTIC KFNWLLA "Kennfeld f¸r Nockenwellenspreizung im Leerlauf (Auslaﬂ)" MAP 0x1CAEE4 GkfWSw 511.9922 kw_sw_q0p0078 -256.0000 255.9922 FORMAT "%8.4"
 /begin AXIS_DESCR COM_AXIS nmot_w nmot_uw_q0p25 5 0.00 16383.75 AXIS_PTS_REF SNM05NAUW /end AXIS_DESCR
 /begin AXIS_DESCR COM_AXIS rlnw_w rel_uw_q0p0234 5 0.00 1535.977 AXIS_PTS_REF SRL05NAUW /end AXIS_DESCR
/end CHARACTERISTIC
/begin CHARACTERISTIC KFNWSA "Kennfeld f¸r Nockenwellenspreizung (Auslaﬂ)" MAP 0x1CAF16 GkfWSw 511.9922 kw_sw_q0p0078 -256.0000 255.9922 FORMAT "%8.4"
 /begin AXIS_DESCR COM_AXIS nmot_w nmot_uw_q0p25 16 0.00 16383.75 AXIS_PTS_REF SNM16NAUW /end AXIS_DESCR
 /begin AXIS_DESCR COM_AXIS rlnw_w rel_uw_q0p0234 8 0.00 1535.977 AXIS_PTS_REF SRL08NAUW /end AXIS_DESCR
/end CHARACTERISTIC
/begin CHARACTERISTIC KFNWTMA "Faktor ‹bergang von Kalt- auf Warm-Kennfelder bei Nockenwellensollwinkeln Auslaﬂ" MAP 0x1CAC80 KfAxUbAyUbSstxUbSstyUbWUb 1.992 fak_ub_b2 0.00 1.992 FORMAT "%5.3"
 /begin AXIS_DESCR STD_AXIS tmot temp_ub_q0p75_o48 4 -48.00 143.3 FORMAT "%5.1" DEPOSIT ABSOLUTE /end AXIS_DESCR
 /begin AXIS_DESCR STD_AXIS tmst temp_ub_q0p75_o48 4 -48.00 143.3 FORMAT "%5.1" DEPOSIT ABSOLUTE /end AXIS_DESCR
/end CHARACTERISTIC
/begin CHARACTERISTIC KFNWWLA "Kennfeld f¸r Nockenwellenspreizung im Warmlauf (Auslaﬂ)" MAP 0x1CB016 GkfWSw 511.9922 kw_sw_q0p0078 -256.0000 255.9922 FORMAT "%8.4"
 /begin AXIS_DESCR COM_AXIS nmot_w nmot_uw_q0p25 16 0.00 16383.75 AXIS_PTS_REF SNM16NAUW /end AXIS_DESCR
 /begin AXIS_DESCR COM_AXIS rlnw_w rel_uw_q0p0234 8 0.00 1535.977 AXIS_PTS_REF SRL08NAUW /end AXIS_DESCR
/end CHARACTERISTIC
/begin CHARACTERISTIC KFNWWLLA "Kennfeld f¸r Nockenwellenspreizung im Warmlauf bei B_ll (Auslaﬂ)" MAP 0x1CB116 GkfWSw 511.9922 kw_sw_q0p0078 -256.0000 255.9922 FORMAT "%8.4"
 /begin AXIS_DESCR COM_AXIS nmot_w nmot_uw_q0p25 5 0.00 16383.75 AXIS_PTS_REF SNM05NAUW /end AXIS_DESCR
 /begin AXIS_DESCR COM_AXIS rlnw_w rel_uw_q0p0234 5 0.00 1535.977 AXIS_PTS_REF SRL05NAUW /end AXIS_DESCR
/end CHARACTERISTIC
/begin CHARACTERISTIC KFNWWUE "Kennfeld Basiswinkel f¸r Nockenwellenverstellung (Einlaﬂ)" MAP 0x1CAB7E KfAxUwAyUwSstxUwSstyUwWSw 511.9922 kw_sw_q0p0078 -256.0000 255.9922 FORMAT "%8.4"
 /begin AXIS_DESCR STD_AXIS nmot_w nmot_uw_q0p25 12 0.00 16383.75 FORMAT "%8.2" DEPOSIT ABSOLUTE /end AXIS_DESCR
 /begin AXIS_DESCR STD_AXIS rlnw_w rel_uw_q0p0234 8 0.00 1535.977 FORMAT "%8.3" DEPOSIT ABSOLUTE /end AXIS_DESCR
/end CHARACTERISTIC
/begin CHARACTERISTIC KFPZU "Kennfeld f¸r rel. zul.  Moment aus der Pedalstellung in der Momentenbegrenzung" MAP 0x1C6C54 GkfWUb 99.61 rel_ub_b99p6 0.00 99.61 FORMAT "%5.2"
 /begin AXIS_DESCR COM_AXIS wped relPED_ub_b100 8 0.00 100.0 AXIS_PTS_REF SWP08MFUB /end AXIS_DESCR
 /begin AXIS_DESCR COM_AXIS nmot nmot_ub_q40 8 0.00 10200. AXIS_PTS_REF SNM08MFUB /end AXIS_DESCR
/end CHARACTERISTIC
/begin CHARACTERISTIC KFWNWSAPA "Kennfeld f¸r Nockenwellenspreizung w‰hrend Applikationsphase Auslaﬂ" MAP 0x1CB148 KfAxUwAyUwSstxUwSstyUwWSw 511.9922 kw_sw_q0p0078 -256.0000 255.9922 FORMAT "%8.4"
 /begin AXIS_DESCR STD_AXIS nmot_w nmot_uw_q0p25 12 0.00 16383.75 FORMAT "%8.2" DEPOSIT ABSOLUTE /end AXIS_DESCR
 /begin AXIS_DESCR STD_AXIS rk_w rel_uw_b3072 8 0.00 3071.953 FORMAT "%8.3" DEPOSIT ABSOLUTE /end AXIS_DESCR
/end CHARACTERISTIC
/begin CHARACTERISTIC KLAMDRED "Umrechnung Beschleunigung in Reduziermoment" CURVE 0x1D2454 dc_GKlWSw 700.0000 DC_TRQ_S16 0.00 700.0000 FORMAT "%8.4"
 /begin AXIS_DESCR COM_AXIS LongAccel DC_UAFZ_S8 8 -5.555 5.512 AXIS_PTS_REF AV08 /end AXIS_DESCR
/end CHARACTERISTIC
/begin CHARACTERISTIC KLBD1 "" CURVE 0x1D2050 dc_ArrSw 2047.938 DC_TRQ_S16 0.00 2047.938 FORMAT "%8.3"
 /begin AXIS_DESCR FIX_AXIS ModelRange_Ix DC_CNTR_U8 5 0.00 4.000 FORMAT "%5.3" FIX_AXIS_PAR 0 0 5 /end AXIS_DESCR
/end CHARACTERISTIC
/begin CHARACTERISTIC KLBD2 "" CURVE 0x1D203C dc_ArrSw 2047.938 DC_TRQ_S16 0.00 2047.938 FORMAT "%8.3"
 /begin AXIS_DESCR FIX_AXIS ModelRange_Ix DC_CNTR_U8 5 0.00 4.000 FORMAT "%5.3" FIX_AXIS_PAR 0 0 5 /end AXIS_DESCR
/end CHARACTERISTIC
/begin CHARACTERISTIC KLBMAX "" CURVE 0x1D2046 dc_ArrSw 2047.938 DC_TRQ_S16 0.00 2047.938 FORMAT "%8.3"
 /begin AXIS_DESCR FIX_AXIS ModelRange_Ix DC_CNTR_U8 5 0.00 4.000 FORMAT "%5.3" FIX_AXIS_PAR 0 0 5 /end AXIS_DESCR
/end CHARACTERISTIC
/begin CHARACTERISTIC KLBNOA "" CURVE 0x1D2014 dc_ArrSw 16383.5 DC_ROTSPD_S16 0.00 16383.5 FORMAT "%7.1"
 /begin AXIS_DESCR FIX_AXIS ModelRange_Ix DC_CNTR_U8 5 0.00 4.000 FORMAT "%5.3" FIX_AXIS_PAR 0 0 5 /end AXIS_DESCR
/end CHARACTERISTIC
/begin CHARACTERISTIC KLBNOH "" CURVE 0x1D2000 dc_ArrSw 16383.5 DC_ROTSPD_S16 0.00 16383.5 FORMAT "%7.1"
 /begin AXIS_DESCR FIX_AXIS ModelRange_Ix DC_CNTR_U8 5 0.00 4.000 FORMAT "%5.3" FIX_AXIS_PAR 0 0 5 /end AXIS_DESCR
/end CHARACTERISTIC
/begin CHARACTERISTIC KLBNUA "" CURVE 0x1D200A dc_ArrSw 16383.5 DC_ROTSPD_S16 0.00 16383.5 FORMAT "%7.1"
 /begin AXIS_DESCR FIX_AXIS ModelRange_Ix DC_CNTR_U8 5 0.00 4.000 FORMAT "%5.3" FIX_AXIS_PAR 0 0 5 /end AXIS_DESCR
/end CHARACTERISTIC
/begin CHARACTERISTIC KLBNUH "" CURVE 0x1D1FF6 dc_ArrSw 16383.5 DC_ROTSPD_S16 0.00 16383.5 FORMAT "%7.1"
 /begin AXIS_DESCR FIX_AXIS ModelRange_Ix DC_CNTR_U8 5 0.00 4.000 FORMAT "%5.3" FIX_AXIS_PAR 0 0 5 /end AXIS_DESCR
/end CHARACTERISTIC
/begin CHARACTERISTIC KLBST "" CURVE 0x1D1FEC dc_ArrUw 655.35 DC_TIME_10MS_U16 0.00 655.35 FORMAT "%6.2"
 /begin AXIS_DESCR FIX_AXIS ModelRange_Ix DC_CNTR_U8 5 0.00 4.000 FORMAT "%5.3" FIX_AXIS_PAR 0 0 5 /end AXIS_DESCR
/end CHARACTERISTIC
/begin CHARACTERISTIC KLBTD1 "" CURVE 0x1D201E dc_ArrUw 655.35 DC_TIME_10MS_U16 0.00 655.35 FORMAT "%6.2"
 /begin AXIS_DESCR FIX_AXIS ModelRange_Ix DC_CNTR_U8 5 0.00 4.000 FORMAT "%5.3" FIX_AXIS_PAR 0 0 5 /end AXIS_DESCR
/end CHARACTERISTIC
/begin CHARACTERISTIC KLBTD2 "" CURVE 0x1D2028 dc_ArrUw 655.35 DC_TIME_10MS_U16 0.00 655.35 FORMAT "%6.2"
 /begin AXIS_DESCR FIX_AXIS ModelRange_Ix DC_CNTR_U8 5 0.00 4.000 FORMAT "%5.3" FIX_AXIS_PAR 0 0 5 /end AXIS_DESCR
/end CHARACTERISTIC
/begin CHARACTERISTIC KLBTGMIN "" CURVE 0x1D2032 dc_ArrUw 655.35 DC_TIME_10MS_U16 0.00 655.35 FORMAT "%6.2"
 /begin AXIS_DESCR FIX_AXIS ModelRange_Ix DC_CNTR_U8 5 0.00 4.000 FORMAT "%5.3" FIX_AXIS_PAR 0 0 5 /end AXIS_DESCR
/end CHARACTERISTIC
/begin CHARACTERISTIC KLBVAR "" CURVE 0x1D3118 dc_ArrUb 255.0 DC_CNTR_U8 0.00 255.0 FORMAT "%5.1"
 /begin AXIS_DESCR FIX_AXIS ModelRange_Ix DC_CNTR_U8 5 0.00 4.000 FORMAT "%5.3" FIX_AXIS_PAR 0 0 5 /end AXIS_DESCR
/end CHARACTERISTIC
/begin CHARACTERISTIC KLD1 "pedalwertcharakteristik vorw‰rts 1" CURVE 0x1D22E2 dc_GKlWUw 200.0031 DC_PER0327 0.00 200.0031 FORMAT "%8.4"
 /begin AXIS_DESCR COM_AXIS APP_ADD DC_PER0327 16 0.00 100.0000 AXIS_PTS_REF SWPEDV16 /end AXIS_DESCR
/end CHARACTERISTIC
/begin CHARACTERISTIC KLD2 "Pedalwertcharakteristik vorw‰rts 2" CURVE 0x1D2302 dc_GKlWUw 200.0031 DC_PER0327 0.00 200.0031 FORMAT "%8.4"
 /begin AXIS_DESCR COM_AXIS APP_ADD DC_PER0327 16 0.00 100.0000 AXIS_PTS_REF SWPEDV16 /end AXIS_DESCR
/end CHARACTERISTIC
/begin CHARACTERISTIC KLD3 "Pedalwertcharakteristik W163" CURVE 0x1D2322 dc_GKlWUw 200.0031 DC_PER0327 0.00 200.0031 FORMAT "%8.4"
 /begin AXIS_DESCR COM_AXIS APP_ADD DC_PER0327 16 0.00 100.0000 AXIS_PTS_REF SWPEDV16 /end AXIS_DESCR
/end CHARACTERISTIC
/begin CHARACTERISTIC KLD4 "Pedalwertcharakteristik vorw‰rts 4" CURVE 0x1D2342 dc_GKlWUw 200.0031 DC_PER0327 0.00 200.0031 FORMAT "%8.4"
 /begin AXIS_DESCR COM_AXIS APP_ADD DC_PER0327 16 0.00 100.0000 AXIS_PTS_REF SWPEDV16 /end AXIS_DESCR
/end CHARACTERISTIC
/begin CHARACTERISTIC KLDMDLF1 "Kennlinie Reservemoment L¸fter" CURVE 0x1CFCFC GklWUb 49.80 rel_q0p1953 0.00 49.80 FORMAT "%5.2"
 /begin AXIS_DESCR COM_AXIS nmot nmot_ub_q40 6 0.00 10200. AXIS_PTS_REF SNM06KOUB /end AXIS_DESCR
/end CHARACTERISTIC
/begin CHARACTERISTIC KLDMDLF2 "Kennlinie Reservemoment L¸fter 2" CURVE 0x1CFD04 GklWUb 49.80 rel_q0p1953 0.00 49.80 FORMAT "%5.2"
 /begin AXIS_DESCR COM_AXIS nmot nmot_ub_q40 6 0.00 10200. AXIS_PTS_REF SNM06KOUB /end AXIS_DESCR
/end CHARACTERISTIC
/begin CHARACTERISTIC KLDMMX "Maximal zul‰ssige Momentenreserven" CURVE 0x1C6C94 GklWUb 99.61 rel_ub_b99p6 0.00 99.61 FORMAT "%5.2"
 /begin AXIS_DESCR COM_AXIS nmot nmot_ub_q40 8 0.00 10200. AXIS_PTS_REF SNM08MFUB /end AXIS_DESCR
/end CHARACTERISTIC
/begin CHARACTERISTIC KLFNWA "Wichtung Nockenwelle Auslaﬂ" CURVE 0x1C3B70 KlAUbSstUbWUb 0.9961 fak_ub_b1 0.00 0.9961 /begin AXIS_DESCR STD_AXIS fnwua fak_ub_b1 6 0.00 0.9961 DEPOSIT ABSOLUTE /end AXIS_DESCR /end CHARACTERISTIC
/begin CHARACTERISTIC KLFVANF "" CURVE 0x1D2260 dc_GKlWUw 1.99997 DC_FCTR_32768_U16 0.00 1.99997 FORMAT "%7.5"
 /begin AXIS_DESCR COM_AXIS APP_Char DC_PER0327 16 0.00 100.0000 AXIS_PTS_REF PWV /end AXIS_DESCR
/end CHARACTERISTIC
/begin CHARACTERISTIC KLLLRZU "Kennlinie f¸r zul‰ssiges Moment der Leerlaufregelung" CURVE 0x1C6C9C GklWUb 99.61 rel_ub_b99p6 0.00 99.61 FORMAT "%5.2"
 /begin AXIS_DESCR COM_AXIS nmot nmot_ub_q40 8 0.00 10200. AXIS_PTS_REF SNM08MFUB /end AXIS_DESCR
/end CHARACTERISTIC
/begin CHARACTERISTIC KLMIMAX "Kennlinie f¸r maximales indiziertes Moment" CURVE 0x1C6CA4 GklWUb 99.61 rel_ub_b99p6 0.00 99.61 FORMAT "%5.2"
 /begin AXIS_DESCR COM_AXIS nmot nmot_ub_q40 8 0.00 10200. AXIS_PTS_REF SNM08MFUB /end AXIS_DESCR
/end CHARACTERISTIC
/begin CHARACTERISTIC KLMIMIN "Kennliie f¸r minimales indiziertes Moment" CURVE 0x1C6CEA GklWUw 99.99847 rel_uw_b100 0.00 99.99847 FORMAT "%8.5"
 /begin AXIS_DESCR COM_AXIS nmot nmot_ub_q40 8 0.00 10200. AXIS_PTS_REF SNM08MFUB /end AXIS_DESCR
/end CHARACTERISTIC
/begin CHARACTERISTIC KLMZUMN "Kennlinie f¸r drehzahlabh‰ngiges zul. Moment" CURVE 0x1C6CAC GklWUb 99.61 rel_ub_b99p6 0.00 99.61 FORMAT "%5.2"
 /begin AXIS_DESCR COM_AXIS nmot nmot_ub_q40 8 0.00 10200. AXIS_PTS_REF SNM08MFUB /end AXIS_DESCR
/end CHARACTERISTIC
/begin CHARACTERISTIC KLNREDWF "Umrechnung Drehzahlgradient in Reduziermoment f¸r WF-Schutz" CURVE 0x1D244C dc_GKlWSb 255.000 DC_MMQ1_S8DB -128.000 127.000
 /begin AXIS_DESCR COM_AXIS ng_nhgb DC_NGRDQ10_S16DB 8 -327680. 327670. AXIS_PTS_REF NGWF08 /end AXIS_DESCR
/end CHARACTERISTIC
/begin CHARACTERISTIC KLNVHWF "Drehzahlvorhalt f¸r Drehzahlregler-Aktivierung bei WF-Schutz" CURVE 0x1D2464 dc_GKlWSw 8000.00 DC_ROTSPD_S16 0.00 8000.00 FORMAT "%7.2"
 /begin AXIS_DESCR COM_AXIS ng_nhgb DC_NGRDQ10_S16DB 8 -327680. 327670. AXIS_PTS_REF NGWF08 /end AXIS_DESCR
/end CHARACTERISTIC
/begin CHARACTERISTIC KLNVORHA "Drehzahlvorhalt f¸r Drehzahlregler-Aktivierung bei NAG" CURVE 0x1D2474 dc_GKlWSw 8000.00 DC_ROTSPD_S16 0.00 8000.00 FORMAT "%7.2"
 /begin AXIS_DESCR COM_AXIS ng_nhgb DC_NGRDQ10_S16DB 8 -327680. 327670. AXIS_PTS_REF NG08 /end AXIS_DESCR
/end CHARACTERISTIC
/begin CHARACTERISTIC KLNVORHH "Drehzahlvorhalt f¸r Drehzahlregler-Aktivierung bei HS" CURVE 0x1D2484 dc_GKlWSw 8000.00 DC_ROTSPD_S16 0.00 8000.00 FORMAT "%7.2"
 /begin AXIS_DESCR COM_AXIS ng_nhgb DC_NGRDQ10_S16DB 8 -327680. 327670. AXIS_PTS_REF NG08 /end AXIS_DESCR
/end CHARACTERISTIC
/begin CHARACTERISTIC KLR "Pedalwertcharakteristik r¸ckw‰rts" CURVE 0x1D2362 dc_GKlWUw 100.0000 DC_PER0327 0.00 100.0000 FORMAT "%8.4"
 /begin AXIS_DESCR COM_AXIS APP_ADD DC_PER0327 16 0.00 100.0000 AXIS_PTS_REF SWPEDV16 /end AXIS_DESCR
/end CHARACTERISTIC
/begin CHARACTERISTIC KLTLSAS "Grenzmassenliefergradschwelle KLTLSAS" CURVE 0x1D3094 dc_GKlWUb 127.5 DC_UFUELL 0.00 127.5 FORMAT "%5.1"
 /begin AXIS_DESCR COM_AXIS Eng_Spd DC_ROTSPD_S16 8 -16384.0 16383.5 AXIS_PTS_REF NISTV08 /end AXIS_DESCR
/end CHARACTERISTIC
/begin CHARACTERISTIC KLTNMXPR "Zeit f¸r Drehzahlpr‰diktion der NMAX-Regelung" CURVE 0x1C697C FklWUb 5.100 t20msxs_ub_b5p1 0.00 5.100 FORMAT "%5.3"
 /begin AXIS_DESCR FIX_AXIS gangi dez 8 0.00 7.000 FORMAT "%5.3" FIX_AXIS_PAR 0 0 8 /end AXIS_DESCR
/end CHARACTERISTIC
/begin CHARACTERISTIC KL_FMIMA1 "Zeitkorrektur bei Automat als f (fdkha)" CURVE 0x1D30B4 dc_GKlWUb 1.992 DC_FKT128 0.00 1.992 FORMAT "%5.3"
 /begin AXIS_DESCR COM_AXIS AdapAltitudeTempCorr_Coef DC_FCTR_32768_U16 8 0.00 1.99997 AXIS_PTS_REF AdapAltitudeTempCorrV8 /end AXIS_DESCR
/end CHARACTERISTIC
/begin CHARACTERISTIC KL_FMIMH1 "Momentenkorrektur bei Handschalter als f (fdkha)" CURVE 0x1D30AC dc_GKlWUb 1.992 DC_FKT128 0.00 1.992 FORMAT "%5.3"
 /begin AXIS_DESCR COM_AXIS AdapAltitudeTempCorr_Coef DC_FCTR_32768_U16 8 0.00 1.99997 AXIS_PTS_REF AdapAltitudeTempCorrV8 /end AXIS_DESCR
/end CHARACTERISTIC
/begin CHARACTERISTIC KL_FMITA1 "Zeitkorrektur bei Automat als f (fdkha)" CURVE 0x1D30C4 dc_GKlWUb 1.992 DC_FKT128 0.00 1.992 FORMAT "%5.3"
 /begin AXIS_DESCR COM_AXIS AdapAltitudeTempCorr_Coef DC_FCTR_32768_U16 8 0.00 1.99997 AXIS_PTS_REF AdapAltitudeTempCorrV8 /end AXIS_DESCR
/end CHARACTERISTIC
/begin CHARACTERISTIC KL_FMITH1 "Zeitkorrektur bei Handschalter als f (fdkha)" CURVE 0x1D30BC dc_GKlWUb 1.992 DC_FKT128 0.00 1.992 FORMAT "%5.3"
 /begin AXIS_DESCR COM_AXIS AdapAltitudeTempCorr_Coef DC_FCTR_32768_U16 8 0.00 1.99997 AXIS_PTS_REF AdapAltitudeTempCorrV8 /end AXIS_DESCR
/end CHARACTERISTIC
/begin CHARACTERISTIC KL_LSDFACR "" CURVE 0x1D2FCC dc_GKlWUb 1.00000 DC_FKT255 0.00 1.00000
 /begin AXIS_DESCR COM_AXIS Eng_Spd DC_ROTSPD_S16 8 -16384.0 16383.5 AXIS_PTS_REF NISTV08 /end AXIS_DESCR
/end CHARACTERISTIC
/begin CHARACTERISTIC KL_LSDGRDR "" CURVE 0x1D1ECC dc_GKlWUw 4095.938 DC_TRQ_S16 0.00 4095.938 FORMAT "%8.3"
 /begin AXIS_DESCR COM_AXIS TrqIndDashpLTC_Req DC_TRQ_S16 8 -2048.000 2047.938 AXIS_PTS_REF MV_DP /end AXIS_DESCR
/end CHARACTERISTIC
/begin CHARACTERISTIC KL_LSDSTOP "" CURVE 0x1D1EBC dc_GKlWUw 4095.938 DC_TRQ_S16 0.00 4095.938 FORMAT "%8.3"
 /begin AXIS_DESCR COM_AXIS Eng_Spd DC_ROTSPD_S16 8 -16384.0 16383.5 AXIS_PTS_REF NISTV08 /end AXIS_DESCR
/end CHARACTERISTIC
/begin CHARACTERISTIC KL_MALL1 "Momentensprung pro Gangstufe" CURVE 0x1D1F46 dc_ArrUw 2047.938 DC_TRQ_S16 0.00 2047.938 FORMAT "%8.3"
 /begin AXIS_DESCR FIX_AXIS Gear_State DC_CNTR_U8 16 0.00 15.00 FORMAT "%5.2" FIX_AXIS_PAR 0 0 16 /end AXIS_DESCR
/end CHARACTERISTIC
/begin CHARACTERISTIC KL_MALL2 "Momentensprung pro Gangstufe" CURVE 0x1D1F26 dc_ArrUw 2047.938 DC_TRQ_S16 0.00 2047.938 FORMAT "%8.3"
 /begin AXIS_DESCR FIX_AXIS Gear_State DC_CNTR_U8 16 0.00 15.00 FORMAT "%5.2" FIX_AXIS_PAR 0 0 16 /end AXIS_DESCR
/end CHARACTERISTIC
/begin CHARACTERISTIC KL_MNLSDA "Moment-Offset f (nist) Allrad" CURVE 0x1D1EEC dc_GKlWUw 4095.938 DC_TRQ_S16 0.00 4095.938 FORMAT "%8.3"
 /begin AXIS_DESCR COM_AXIS Eng_Spd DC_ROTSPD_S16 8 -16384.0 16383.5 AXIS_PTS_REF NIST_LSD /end AXIS_DESCR
/end CHARACTERISTIC
/begin CHARACTERISTIC KL_MNLSDA2 "" CURVE 0x1D1EDC dc_GKlWUw 4095.938 DC_TRQ_S16 0.00 4095.938 FORMAT "%8.3"
 /begin AXIS_DESCR COM_AXIS Eng_Spd DC_ROTSPD_S16 8 -16384.0 16383.5 AXIS_PTS_REF NIST_LSD /end AXIS_DESCR
/end CHARACTERISTIC
/begin CHARACTERISTIC KL_MNLSDH "Moment-Offset f (nist) Handschalter" CURVE 0x1D1F0C dc_GKlWUw 4095.938 DC_TRQ_S16 0.00 4095.938 FORMAT "%8.3"
 /begin AXIS_DESCR COM_AXIS Eng_Spd DC_ROTSPD_S16 8 -16384.0 16383.5 AXIS_PTS_REF NIST_LSD /end AXIS_DESCR
/end CHARACTERISTIC
/begin CHARACTERISTIC KL_MNLSDH2 "" CURVE 0x1D1EFC dc_GKlWUw 4095.938 DC_TRQ_S16 0.00 4095.938 FORMAT "%8.3"
 /begin AXIS_DESCR COM_AXIS Eng_Spd DC_ROTSPD_S16 8 -16384.0 16383.5 AXIS_PTS_REF NIST_LSD /end AXIS_DESCR
/end CHARACTERISTIC
/begin CHARACTERISTIC KL_MRFKSG "Reserve-Momenten-Faktor ¸ber Drehzahl f¸r KSG" CURVE 0x1D238C dc_GKlWUb 1.99219 DC_FCTR_128_U8 0.00 1.99219
 /begin AXIS_DESCR COM_AXIS Eng_RelLoad rel_sw_q1p562Em2 8 -512.0000 511.9844 AXIS_PTS_REF TL8V08 /end AXIS_DESCR
/end CHARACTERISTIC
/begin CHARACTERISTIC KL_NMAXA "max. Drehzahl f¸r LSD pro Gangstufe Allrad" CURVE 0x1D1F68 dc_ArrSw 32767.5 DC_ROTSPD_S16 -16384.0 16383.5 FORMAT "%7.1"
 /begin AXIS_DESCR FIX_AXIS Gear_State DC_CNTR_U8 16 0.00 15.00 FORMAT "%5.2" FIX_AXIS_PAR 0 0 16 /end AXIS_DESCR
/end CHARACTERISTIC
/begin CHARACTERISTIC KL_NMINA "min. Drehzahl f¸r LSD Allrad pro Gangstufe" CURVE 0x1D1F88 dc_ArrSw 32767.5 DC_ROTSPD_S16 -16384.0 16383.5 FORMAT "%7.1"
 /begin AXIS_DESCR FIX_AXIS Gear_State DC_CNTR_U8 16 0.00 15.00 FORMAT "%5.2" FIX_AXIS_PAR 0 0 16 /end AXIS_DESCR
/end CHARACTERISTIC
/begin CHARACTERISTIC KL_TALL1 "Zeitdauer pro Gangstufe Allrad" CURVE 0x1D3100 dc_ArrUb 2.550 DC_TQ10 0.00 2.550 FORMAT "%5.3"
 /begin AXIS_DESCR FIX_AXIS Gear_State DC_CNTR_U8 16 0.00 15.00 FORMAT "%5.2" FIX_AXIS_PAR 0 0 16 /end AXIS_DESCR
/end CHARACTERISTIC
/begin CHARACTERISTIC KL_TALL2 "Zeitdauer pro Gangstufe und Phase 2 f¸r Allrad" CURVE 0x1D30F0 dc_ArrUb 2.550 DC_TQ10 0.00 2.550 FORMAT "%5.3"
 /begin AXIS_DESCR FIX_AXIS Gear_State DC_CNTR_U8 16 0.00 15.00 FORMAT "%5.2" FIX_AXIS_PAR 0 0 16 /end AXIS_DESCR
/end CHARACTERISTIC
/begin CHARACTERISTIC KL_TNLSDA "Zeit-Offset f (nist)" CURVE 0x1D30D4 dc_GKlWUb 2.550 DC_TQ10 0.00 2.550 FORMAT "%5.3"
 /begin AXIS_DESCR COM_AXIS Eng_Spd DC_ROTSPD_S16 8 -16384.0 16383.5 AXIS_PTS_REF NIST_LSD /end AXIS_DESCR
/end CHARACTERISTIC
/begin CHARACTERISTIC KL_TNLSDA2 "" CURVE 0x1D30CC dc_GKlWUb 2.550 DC_TQ10 0.00 2.550 FORMAT "%5.3"
 /begin AXIS_DESCR COM_AXIS Eng_Spd DC_ROTSPD_S16 8 -16384.0 16383.5 AXIS_PTS_REF NIST_LSD /end AXIS_DESCR
/end CHARACTERISTIC
/begin CHARACTERISTIC KL_TNLSDH "Zeit-Offset f (nist)" CURVE 0x1D30A4 dc_GKlWUb 2.550 DC_TQ10 0.00 2.550 FORMAT "%5.3"
 /begin AXIS_DESCR COM_AXIS Eng_Spd DC_ROTSPD_S16 8 -16384.0 16383.5 AXIS_PTS_REF NIST_LSD /end AXIS_DESCR
/end CHARACTERISTIC
/begin CHARACTERISTIC KL_TNLSDH2 "" CURVE 0x1D309C dc_GKlWUb 2.550 DC_TQ10 0.00 2.550 FORMAT "%5.3"
 /begin AXIS_DESCR COM_AXIS Eng_Spd DC_ROTSPD_S16 8 -16384.0 16383.5 AXIS_PTS_REF NIST_LSD /end AXIS_DESCR
/end CHARACTERISTIC
/begin CHARACTERISTIC KTNWSABGKA "Zeitkonstante f¸r Sollwert‰nderungsbegrenzung Auslaﬂnockenwelle kalt" MAP 0x1C3B84 GkfWUb 2.54000 zk10msxs_ub_b2p55 0.0100000 2.55000 FORMAT "%7.5"
 /begin AXIS_DESCR COM_AXIS nmot nmot_ub_q40 5 0.00 10200. AXIS_PTS_REF SNM05NWUB /end AXIS_DESCR
 /begin AXIS_DESCR COM_AXIS tmot temp_ub_q0p75_o48 5 -48.00 143.3 AXIS_PTS_REF STM05NWUB /end AXIS_DESCR
/end CHARACTERISTIC
/begin CHARACTERISTIC KTNWSNABGA "Zeitkonstante f¸r negative Sollwert‰nderungsbegrenzung Auslaﬂnockenwelle" MAP 0x1C3BA0 GkfWUb 2.54000 zk10msxs_ub_b2p55 0.0100000 2.55000 FORMAT "%7.5"
 /begin AXIS_DESCR COM_AXIS nmot nmot_ub_q40 5 0.00 10200. AXIS_PTS_REF SNM05NWUB /end AXIS_DESCR
 /begin AXIS_DESCR COM_AXIS tmot temp_ub_q0p75_o48 5 -48.00 143.3 AXIS_PTS_REF STM05NWUB /end AXIS_DESCR
/end CHARACTERISTIC
/begin CHARACTERISTIC KTNWSPABGA "Zeitkonstante f¸r positive Sollwert‰nderungsbegrenzung Auslaﬂnockenwelle" MAP 0x1C3BBC GkfWUb 2.54000 zk10msxs_ub_b2p55 0.0100000 2.55000 FORMAT "%7.5"
 /begin AXIS_DESCR COM_AXIS nmot nmot_ub_q40 5 0.00 10200. AXIS_PTS_REF SNM05NWUB /end AXIS_DESCR
 /begin AXIS_DESCR COM_AXIS tmot temp_ub_q0p75_o48 5 -48.00 143.3 AXIS_PTS_REF STM05NWUB /end AXIS_DESCR
/end CHARACTERISTIC
/begin CHARACTERISTIC KWFVNO "" VALUE 0x1D2286 dc_KwSw 32767.5 DC_ROTSPD_S16 -16384.0 16383.5 FORMAT "%7.1" /end CHARACTERISTIC
/begin CHARACTERISTIC KWFVNU "" VALUE 0x1D2284 dc_KwSw 32767.5 DC_ROTSPD_S16 -16384.0 16383.5 FORMAT "%7.1" /end CHARACTERISTIC
/begin CHARACTERISTIC KWFVVO "" VALUE 0x1D2280 dc_KwUw 4095.938 DC_VEHSPD_KMH_U16 0.00 4095.938 FORMAT "%8.3" /end CHARACTERISTIC
/begin CHARACTERISTIC KWFVVU "" VALUE 0x1D2282 dc_KwUw 4095.938 DC_VEHSPD_KMH_U16 0.00 4095.938 FORMAT "%8.3" /end CHARACTERISTIC
/begin CHARACTERISTIC LWSER "Lenkilfelastmoment bei fehlerhaftem Lenkwinkelsensor" VALUE 0x1CFD0A KwUb 49.80 rel_q0p1953 0.00 49.80 FORMAT "%5.2" /end CHARACTERISTIC
/begin CHARACTERISTIC MART_LL "ART-Leerlauf Momentenschwelle" VALUE 0x1D205C dc_KwSw 262.5000 DC_TRQ_S16 -200.0000 62.50000 FORMAT "%8.4" /end CHARACTERISTIC
/begin CHARACTERISTIC MDATNM "Drehmomentaufnahme AT-Getriebe in Fahrstufe N/P" CURVE 0x1CFE28 GklWSw 99.99695 rel_sw_b100 0.00 99.99695 FORMAT "%8.5"
 /begin AXIS_DESCR COM_AXIS twnd temp_ub_q0p75_o48 8 -48.00 143.3 AXIS_PTS_REF STW08MDUB /end AXIS_DESCR
/end CHARACTERISTIC
/begin CHARACTERISTIC MDATRM "Drehmomentanteil (Pumpenanteil) AT-Getriebe in Fahrstufe R" CURVE 0x1CFE38 GklWSw 99.99695 rel_sw_b100 0.00 99.99695 FORMAT "%8.5"
 /begin AXIS_DESCR COM_AXIS twnd temp_ub_q0p75_o48 8 -48.00 143.3 AXIS_PTS_REF STW08MDUB /end AXIS_DESCR
/end CHARACTERISTIC
/begin CHARACTERISTIC MDIMX "Maximales indiziertes Motormoment" VALUE 0x1C6984 KwUb 99.61 rel_ub_b99p6 0.00 99.61 FORMAT "%5.2" /end CHARACTERISTIC
/begin CHARACTERISTIC MDLF1 "station‰res Moment f¸r laufenden L¸fter 1" VALUE 0x1CFD0B KwUb 49.80 rel_q0p1953 0.00 49.80 FORMAT "%5.2" /end CHARACTERISTIC
/begin CHARACTERISTIC MDLF2 "station‰res Moment f¸r laufenden L¸fter 2" VALUE 0x1CFD0C KwUb 49.80 rel_q0p1953 0.00 49.80 FORMAT "%5.2" /end CHARACTERISTIC
/begin CHARACTERISTIC MDSL "Momentenanforderung der Servolenkung" VALUE 0x1CFD0D KwUb 49.80 rel_q0p1953 0.00 49.80 FORMAT "%5.2" /end CHARACTERISTIC
/begin CHARACTERISTIC MDSLP "Moment zur Kompensation der Sekund‰rluftpumpe (stat.)" VALUE 0x1CFD0E KwUb 99.61 rel_ub_b100 0.00 99.61 FORMAT "%5.2" /end CHARACTERISTIC
/begin CHARACTERISTIC MDSLPE "Moment zur Kompensation der Sekund‰rluftpumpe (Einschalten)" VALUE 0x1CFD0F KwSb 99.60 rel_sb_q0p39 -50.00 49.61 FORMAT "%5.2" /end CHARACTERISTIC
/begin CHARACTERISTIC MDWANER "Ersatzwert fur mdwan_w bei Fehler" VALUE 0x1C709C KwUb 99.61 rel_ub_b99p6 0.00 99.61 FORMAT "%5.2" /end CHARACTERISTIC
/begin AXIS_PTS MIST16 "ƒnderungsbegrenzung des Vorgabemoments" 0x1D1638 mist_roh dc_SstAUwSstSw 600.0000 DC_TRQ_S16 8 -100.0000 500.0000 FORMAT "%8.4" DEPOSIT ABSOLUTE /end AXIS_PTS
/begin AXIS_PTS MV_DP "ƒnderungsbegrenzung d. Vorgabemoments" 0x1D164A TrqIndDashpLTC_Req dc_SstAUwSstSw 4095.938 DC_TRQ_S16 8 -2048.000 2047.938 FORMAT "%8.3" DEPOSIT ABSOLUTE /end AXIS_PTS
/begin CHARACTERISTIC MZFFIL "Filter-Zeitkonstante f¸r verzˆgertes Moment in der Momentenbegrenzung" VALUE 0x1C6CFA KwUw 655.350000 zk10msxs_uw_b655 0.0100001526 655.360000 FORMAT "%10.6" /end CHARACTERISTIC
/begin CHARACTERISTIC MZFTV "Verzugszeit f¸r zul‰ssiges Moment in der Momentenbegrenzung" VALUE 0x1C6CFC KwUw 327.67000000 tz10msxs_uw_b327p68 0.010000000000 327.68000000 FORMAT "%12.8" /end CHARACTERISTIC
/begin CHARACTERISTIC NFANWS "Drehzahlschwelle f¸r Funktionsanforderung NWS" VALUE 0x1CAC6A KwUb 10200. nmot_ub_q40 0.00 10200. FORMAT "%5.0" /end CHARACTERISTIC
/begin AXIS_PTS NG08 "St¸tzstellenverteilung fuer ng_nhgb" 0x1D166E ng_nhgb dc_SstAUwSstSw 655350. DC_NGRDQ10_S16DB 8 -327680. 327670. FORMAT "%6.0" DEPOSIT ABSOLUTE /end AXIS_PTS
/begin AXIS_PTS NGWF08 "St¸tzstellenverteilung f¸r ng_nhgb" 0x1D1680 ng_nhgb dc_SstAUwSstSw 655350. DC_NGRDQ10_S16DB 8 -327680. 327670. FORMAT "%6.0" DEPOSIT ABSOLUTE /end AXIS_PTS
/begin AXIS_PTS NISTV08 "Drehzahlst¸tzstellenverteilung" 0x1D1692 Eng_Spd dc_SstAUwSstSw 32767.5 DC_ROTSPD_S16 8 -16384.0 16383.5 FORMAT "%7.1" DEPOSIT ABSOLUTE /end AXIS_PTS
/begin AXIS_PTS NISTV17 "Drehzahlst¸tzstellenverteilung" 0x1D16A4 Eng_Spd dc_SstAUwSstSw 32767.5 DC_ROTSPD_S16 16 -16384.0 16383.5 FORMAT "%7.1" DEPOSIT ABSOLUTE /end AXIS_PTS
/begin AXIS_PTS NIST_LSD "St¸tzstellenverteilung ATK" 0x1D16C6 Eng_Spd dc_SstAUwSstSw 32767.5 DC_ROTSPD_S16 8 -16384.0 16383.5 FORMAT "%7.1" DEPOSIT ABSOLUTE /end AXIS_PTS
/begin CHARACTERISTIC NLLSLF "Obere Drehzahlschwelle f¸r Momentenreserve Servo-Lenkung" VALUE 0x1CFDE8 KwUw 16383.75 nmot_uw_q0p25 0.00 16383.75 FORMAT "%8.2" /end CHARACTERISTIC
/begin CHARACTERISTIC NMAX "Drehzahlbegrenzung" VALUE 0x1C69A2 KwUw 16383.75 nmot_uw_q0p25 0.00 16383.75 FORMAT "%8.2" /end CHARACTERISTIC
/begin CHARACTERISTIC NMAXDV "Drehzahlbegrenzung bei Fehlererkennung Geschwindigkeitssignal" VALUE 0x1CF0E4 KwUw 16383.75 nmot_uw_q0p25 0.00 16383.75 FORMAT "%8.2" /end CHARACTERISTIC
/begin CHARACTERISTIC NMAXDVG "Drehzahlgrenze f¸r Automatik-Getriebe bei Fehler Geschwindigkeitssignal" CURVE 0x1CF0E6 FklWUw 16383.75 nmot_uw_q0p25 0.00 16383.75 FORMAT "%8.2"
 /begin AXIS_DESCR FIX_AXIS gangi dez 8 0.00 7.000 FORMAT "%5.3" FIX_AXIS_PAR 0 0 8 /end AXIS_DESCR
/end CHARACTERISTIC
/begin CHARACTERISTIC NMAXDZ "Drehzahlgrenze bei doppelter Z¸ndausgabe" VALUE 0x1CF0F6 KwUw 16383.75 nmot_uw_q0p25 0.00 16383.75 FORMAT "%8.2" /end CHARACTERISTIC
/begin CHARACTERISTIC NMAXGA "Maximal zul‰ssige Motordrehzahl (station‰r)" CURVE 0x1CF0F8 FklWUw 16383.75 nmot_uw_q0p25 0.00 16383.75 FORMAT "%8.2"
 /begin AXIS_DESCR FIX_AXIS gangi dez 8 0.00 7.000 FORMAT "%5.3" FIX_AXIS_PAR 0 0 8 /end AXIS_DESCR
/end CHARACTERISTIC
/begin CHARACTERISTIC NMAXKR "Drehzahlgrenze bei Sicherheitssp‰tverstellung der Klopfregelung" VALUE 0x1CF108 KwUw 16383.75 nmot_uw_q0p25 0.00 16383.75 FORMAT "%8.2" /end CHARACTERISTIC
/begin CHARACTERISTIC NMAXNL "Drehzahlgrenze bei Drehzahlgeber-Notlauf" VALUE 0x1CF10A KwUw 16383.75 nmot_uw_q0p25 0.00 16383.75 FORMAT "%8.2" /end CHARACTERISTIC
/begin CHARACTERISTIC NMAXOGGA "Maximal zul‰ssige Motordrehzahl (kurzzeitige ‹berhˆhung)" CURVE 0x1CF10C FklWUw 16383.75 nmot_uw_q0p25 0.00 16383.75 FORMAT "%8.2"
 /begin AXIS_DESCR FIX_AXIS gangi dez 8 0.00 7.000 FORMAT "%5.3" FIX_AXIS_PAR 0 0 8 /end AXIS_DESCR
/end CHARACTERISTIC
/begin CHARACTERISTIC NMAXTO "Drehzahlbegrenzung bei hoher ÷ltemperatur." CURVE 0x1CF11C KlAUwSstUwWUw 16383.75 nmot_uw_q0p25 0.00 16383.75 FORMAT "%8.2"
 /begin AXIS_DESCR STD_AXIS toelk_w temp_q0p0234_o273 4 -273.1500 1262.827 FORMAT "%8.3" DEPOSIT ABSOLUTE /end AXIS_DESCR
/end CHARACTERISTIC
/begin CHARACTERISTIC NMKFNWLLA "Drehzahlschwelle zur Aktivierung LL-Sollwinkelkennfelder bei Auslaﬂnockenwelle" VALUE 0x1CB234 KwUw 16383.75 nmot_uw_q0p25 0.00 16383.75 FORMAT "%8.2" /end CHARACTERISTIC
/begin CHARACTERISTIC NMOT_OFFS "Offset f¸r LL - Sollwert" VALUE 0x1D205A dc_KwSw 4000.00 DC_ROTSPD_S16 0.00 4000.00 FORMAT "%7.2" /end CHARACTERISTIC
/begin CHARACTERISTIC NNWGLEHA "Drehzahlschwelle Nockenwellengleichstellung bei Fehler in 2Bank-System Auslaﬂ" VALUE 0x1CB236 KwUw 16383.75 nmot_uw_q0p25 0.00 16383.75 FORMAT "%8.2" /end CHARACTERISTIC
/begin CHARACTERISTIC NNWSHKMN "min Motordrehzahl zur Freigabe Sch¸ttelfunktionalit‰t Nockenwelle" VALUE 0x1C3B4F KwUb 10200. nmot_ub_q40 0.00 10200. FORMAT "%5.0" /end CHARACTERISTIC
/begin CHARACTERISTIC NNWSHKMX "max Motordrehzahl zur Freigabe Sch¸ttelfunktionalit‰t Nockenwelle" VALUE 0x1C3B50 KwUb 10200. nmot_ub_q40 0.00 10200. FORMAT "%5.0" /end CHARACTERISTIC
/begin CHARACTERISTIC NSTART "Motordrehzahlschwelle f¸r Unterdrehzahl-Ausstieg bei Nachstartaufweitung" VALUE 0x1C6CB4 KwUb 10200. nmot_ub_q40 0.00 10200. FORMAT "%5.0" /end CHARACTERISTIC
/begin CHARACTERISTIC NSTEND "Motordrehzahlschwelle f¸r Start Ende bei Nachstartaufweitung" VALUE 0x1C6CB5 KwUb 10200. nmot_ub_q40 0.00 10200. FORMAT "%5.0" /end CHARACTERISTIC
/begin AXIS_PTS PWV "St¸tzstellenverteilung f¸r KFFVMN (Momentencharakteristik)" 0x1D1710 APP_Char dc_SstAUwSstUw 100.0000 DC_PER0327 16 0.00 100.0000 FORMAT "%8.4" DEPOSIT ABSOLUTE /end AXIS_PTS
/begin AXIS_PTS SGA08MDUB "St¸tzstellenverteilung Ist Gang 8 Sst." 0x1CEDC8 gangi SstAUbSstUb 255.0 dez 8 0.00 255.0 FORMAT "%5.1" DEPOSIT ABSOLUTE /end AXIS_PTS
/begin CHARACTERISTIC SHKNWMXA "Maximale Anzahl Sch¸ttelversuche Auslaﬂnockenwelle im Fahrzyklus" VALUE 0x1C3B51 KwUb 255.0 dez 0.00 255.0 FORMAT "%5.1" /end CHARACTERISTIC
/begin CHARACTERISTIC SHKNWMXE "Maximale Anzahl Sch¸ttelversuche Einlaﬂnockenwelle im Fahrzyklus" VALUE 0x1C3B52 KwUb 255.0 dez 0.00 255.0 FORMAT "%5.1" /end CHARACTERISTIC
/begin AXIS_PTS SMO08MFUB "St¸tzstellenverteilung f¸r zul‰ssiges Moment mizuvfil" 0x1C6CB8 mizuvfil SstAUbSstUb 99.61 rel_ub_b99p6 8 0.00 99.61 FORMAT "%5.2" DEPOSIT ABSOLUTE /end AXIS_PTS
/begin AXIS_PTS SNM05NAUW "Drehzahlst¸tzstellen Nockenwellensollwinkel Auslaﬂ" 0x1CB8A6 nmot_w SstAUwSstUw 16383.75 nmot_uw_q0p25 5 0.00 16383.75 FORMAT "%8.2" DEPOSIT ABSOLUTE /end AXIS_PTS
/begin AXIS_PTS SNM05NWUB "Drehzahlst¸tzstellen Nockenwellensollwinkel" 0x1CB898 nmot SstAUbSstUb 10200. nmot_ub_q40 5 0.00 10200. FORMAT "%5.0" DEPOSIT ABSOLUTE /end AXIS_PTS
/begin AXIS_PTS SNM05NWUW "Drehzahlst¸tzstellen Nockenwellensollwinkel" 0x1CB8BE nmot_w SstAUwSstUw 16383.75 nmot_uw_q0p25 5 0.00 16383.75 FORMAT "%8.2" DEPOSIT ABSOLUTE /end AXIS_PTS
/begin AXIS_PTS SNM06KOUB "Verteilung f¸r Klimakompressorkennlinien" 0x1CFD10 nmot SstAUbSstUb 10200. nmot_ub_q40 6 0.00 10200. FORMAT "%5.0" DEPOSIT ABSOLUTE /end AXIS_PTS
/begin AXIS_PTS SNM08MFUB "St¸tzstellenverteilung f¸r Motorderhzahl" 0x1C6CC4 nmot SstAUbSstUb 10200. nmot_ub_q40 8 0.00 10200. FORMAT "%5.0" DEPOSIT ABSOLUTE /end AXIS_PTS
/begin AXIS_PTS SNM16NAUW "Drehzahlst¸tzstellen Nockenwellensollwinkel Auslaﬂ" 0x1CB8D8 nmot_w SstAUwSstUw 16383.75 nmot_uw_q0p25 16 0.00 16383.75 FORMAT "%8.2" DEPOSIT ABSOLUTE /end AXIS_PTS
/begin AXIS_PTS SNS04MDUB "St¸tzstellenverteilung Solldrehzahl" 0x1C6988 nsber SstAUbSstUb 16320. nmot_q64 4 0.00 16320. FORMAT "%5.0" DEPOSIT ABSOLUTE /end AXIS_PTS
/begin AXIS_PTS SRL05NAUW "Lastst¸tzstellen Nockenwellensollwinkel Auslaﬂ" 0x1CB91C rlnw_w SstAUwSstUw 1535.977 rel_uw_q0p0234 5 0.00 1535.977 FORMAT "%8.3" DEPOSIT ABSOLUTE /end AXIS_PTS
/begin AXIS_PTS SRL06KOUB "St¸tzstellenverteilung Kompressormoment" 0x1CFD18 rl SstAUbSstUb 191.3 rel_ub_q0p75 6 0.00 191.3 FORMAT "%5.1" DEPOSIT ABSOLUTE /end AXIS_PTS
/begin AXIS_PTS SRL08NAUW "Lastst¸tzstellen Nockenwellensollwinkel Auslaﬂ" 0x1CB934 rlnw_w SstAUwSstUw 1535.977 rel_uw_q0p0234 8 0.00 1535.977 FORMAT "%8.3" DEPOSIT ABSOLUTE /end AXIS_PTS
/begin AXIS_PTS STA06LLUB "Temperatur: Ansaugluft bzw. PWM-Signal von AC/Kompressor" 0x1CFD20 tlok SstAUbSstUb 191.3 temp_ub_q0p75_o48 6 -48.00 143.3 FORMAT "%5.1" DEPOSIT ABSOLUTE /end AXIS_PTS
/begin AXIS_PTS STM05NWUB "Temperaturst¸tzstellen Nockenwellensollwinkel" 0x1CB8A0 tmot SstAUbSstUb 191.3 temp_ub_q0p75_o48 5 -48.00 143.3 FORMAT "%5.1" DEPOSIT ABSOLUTE /end AXIS_PTS
/begin AXIS_PTS STM08MFUB "St¸tzstellenverteilung f¸r Motortemperatur tmotmn" 0x1C6CD0 tmotmn SstAUbSstUb 191.3 temp_ub_q0p75_o48 8 -48.00 143.3 FORMAT "%5.1" DEPOSIT ABSOLUTE /end AXIS_PTS
/begin AXIS_PTS STO06NWUW "Gruppenst¸tzstellen" 0x1CB958 toelk_w SstAUwSstUw 1535.977 temp_q0p0234_o273 6 -273.1500 1262.827 FORMAT "%8.3" DEPOSIT ABSOLUTE /end AXIS_PTS
/begin AXIS_PTS STW08MDUB "St¸tzstellenverteilung  Temperatur des Drehmomentenwandlers" 0x1CFDFC twnd SstAUbSstUb 191.3 temp_ub_q0p75_o48 8 -48.00 143.3 FORMAT "%5.1" DEPOSIT ABSOLUTE /end AXIS_PTS
/begin AXIS_PTS SWP08MFUB "St¸tzstellenverteilung f¸r wped" 0x1C6CDC wped SstAUbSstUb 100.0 relPED_ub_b100 8 0.00 100.0 FORMAT "%5.1" DEPOSIT ABSOLUTE /end AXIS_PTS
/begin AXIS_PTS SWPEDV16 "St¸tzstellenverteilung f¸r Pedalwert" 0x1D1848 APP_ADD dc_SstAUwSstUw 100.0000 DC_PER0327 16 0.00 100.0000 FORMAT "%8.4" DEPOSIT ABSOLUTE /end AXIS_PTS
/begin CHARACTERISTIC SW_DPDIS "Pedalkennlinienschwelle f¸r Start der Dashpotabbruch-Verzˆgerungszeit" VALUE 0x1D1F22 dc_KwSw 4095.938 DC_TRQ_S16 -2048.000 2047.938 FORMAT "%8.3" /end CHARACTERISTIC
/begin CHARACTERISTIC SW_DPDIST "Zeitdauer f¸r Dashpot-Timer. Nach Ablauf wird Dashpot deaktiviert." VALUE 0x1D30E8 dc_KwUb 2.550 DC_TQ10 0.00 2.550 FORMAT "%5.3" /end CHARACTERISTIC
/begin CHARACTERISTIC SW_VG "Sollwertvorgabeschwelle f¸r Vollgasbit" VALUE 0x1D22E0 dc_KwUw 200.0031 DC_PER0327 0.00 200.0031 FORMAT "%8.4" /end CHARACTERISTIC
/begin CHARACTERISTIC TANSMN "Ansauglufttemperaturschwelle zur Nachstartaufweitung" VALUE 0x1C6CE5 KwUb 191.3 temp_ub_q0p75_o48 -48.00 143.3 FORMAT "%5.1" /end CHARACTERISTIC
/begin CHARACTERISTIC TDMKOW "Entprellzeit nach Momentenreserve: Klimakompressor" VALUE 0x1CFDEA KwUw 1310.700 t20msxs_uw_q0p02 0.00 1310.700 FORMAT "%8.3" /end CHARACTERISTIC
/begin AXIS_PTS TL8V08 "Lastst¸tzstellen" 0x1D186A Eng_RelLoad dc_SstAUwSstSw 1023.984 rel_sw_q1p562Em2 8 -512.0000 511.9844 FORMAT "%8.4" DEPOSIT ABSOLUTE /end AXIS_PTS
/begin CHARACTERISTIC TMBST "Zeitdauer spezielle Momentenbegrenzung w‰hrend Start und kurz nach Start" VALUE 0x1C6CE6 KwUb 2.550 t10msxs_ub_b2p55 0.00 2.550 FORMAT "%5.3" /end CHARACTERISTIC
/begin CHARACTERISTIC TMNSMN "Motortemperaturschwelle f¸r die Nachstartaufweitung" VALUE 0x1C6CE7 KwUb 191.3 temp_ub_q0p75_o48 -48.00 143.3 FORMAT "%5.1" /end CHARACTERISTIC
/begin CHARACTERISTIC TMNWLLKHA "Motortemperaturschwelle zur Aktivierung Katheiz KF im Leerlauf Auslaﬂnockenwelle" VALUE 0x1CAC9A KwUb 191.3 temp_ub_q0p75_o48 -48.00 143.3 FORMAT "%5.1" /end CHARACTERISTIC
/begin CHARACTERISTIC TMOMIN "Minimal mˆgliche Motortemperatur bei warmem Motor" VALUE 0x1C6CE8 KwUb 191.3 temp_ub_q0p75_o48 -48.00 143.3 FORMAT "%5.1" /end CHARACTERISTIC
/begin CHARACTERISTIC TMOTNMX "Motortemperatur-Schwelle f¸r Aktivierung der erhˆhten Drehzahlgrenze" VALUE 0x1CF0E0 KwUb 191.3 temp_ub_q0p75_o48 -48.00 143.3 FORMAT "%5.1" /end CHARACTERISTIC
/begin CHARACTERISTIC TMPFELLMD "Md - Schwelle zur Generierung von b_ll bei Tempomatf¸llungseingriff" VALUE 0x1D205E dc_KwSw 62.50000 DC_TRQ_S16 0.00 62.50000 /end CHARACTERISTIC
/begin CHARACTERISTIC TNLSGMN "Minimale Zeit f¸r SG-Nachlauf" VALUE 0x1CED96 KwUw 6553.300 t100msxs_uw_b6553p6 0.2000000 6553.500 FORMAT "%8.3" /end CHARACTERISTIC
/begin CHARACTERISTIC TNLSGMX "Maximale Zeit f¸r SG-Nachlauf" VALUE 0x1CED98 KwUw 6553.500 t100msxs_uw_b6553p6 0.00 6553.500 FORMAT "%8.3" /end CHARACTERISTIC
/begin CHARACTERISTIC TNMXH "Maximale Zeitdauer f¸r erhˆhte Drehzahlgrenze" VALUE 0x1CF12E KwUw 6553.500 t100msxs_uw_b6553p5 0.00 6553.500 FORMAT "%8.3" /end CHARACTERISTIC
/begin CHARACTERISTIC TNSC "Nachstart¸berwachungszeit" VALUE 0x1C6CFE KwUw 1310.700 t20msxs_uw_q0p02 0.00 1310.700 FORMAT "%8.3" /end CHARACTERISTIC
/begin CHARACTERISTIC TNSOF "Entprellzeit zur Abschaltung der Nachstartaufweitung" VALUE 0x1C6CE9 KwUb 5.100 t20msxs_ub_b5p1 0.00 5.100 FORMAT "%5.3" /end CHARACTERISTIC
/begin CHARACTERISTIC TNWAPTA "Zeit Auslassnockenwelle in Aktivposition bei Testereingriff" VALUE 0x1CAC6B KwUb 12.70 t50msxs_q0p05 0.05000 12.75 FORMAT "%5.2" /end CHARACTERISTIC
/begin CHARACTERISTIC TNWAPTE "Zeit Einlassnockenwelle in Aktivposition bei Testereingriff" VALUE 0x1CAC6C KwUb 12.70 t50msxs_q0p05 0.05000 12.75 FORMAT "%5.2" /end CHARACTERISTIC
/begin CHARACTERISTIC TNWFARA "Zeitkonstante f¸r Sollwinkelaufsteuerung der Auslassnockenwelle durch  Tester" VALUE 0x1CAC74 KwUw 3276.7499992 zk50msxs_uw_b3276p8 0.050000762951 3276.8000000 FORMAT "%12.7" /end CHARACTERISTIC
/begin CHARACTERISTIC TNWFARE "Zeitkonstante f¸r Sollwinkelaufsteuerung der Einlassnockenwelle durch  Tester" VALUE 0x1CAC76 KwUw 3276.7499992 zk50msxs_uw_b3276p8 0.050000762951 3276.8000000 FORMAT "%12.7" /end CHARACTERISTIC
/begin CHARACTERISTIC TNWLVA "Ansteuerzeit bis Verriegelungsposition sicher verlassen ist Auslaﬂnockenwelle" VALUE 0x1C3B53 KwUb 12.75 t50msxs_ub_b12p75 0.00 12.75 FORMAT "%5.2" /end CHARACTERISTIC
/begin CHARACTERISTIC TNWLVE "Ansteuerzeit bis Verriegelungsposition sicher verlassen ist Einlaﬂnockenwelle" VALUE 0x1C3B54 KwUb 12.75 t50msxs_ub_b12p75 0.00 12.75 FORMAT "%5.2" /end CHARACTERISTIC
/begin CHARACTERISTIC TNWLVRPA "Ansteuerzeit Richtung Referenzpos. zum lˆsen der Verriegelung  Auslaﬂnockenwelle" VALUE 0x1C3B55 KwUb 12.75 t50msxs_ub_b12p75 0.00 12.75 FORMAT "%5.2" /end CHARACTERISTIC
/begin CHARACTERISTIC TNWLVRPE "Ansteuerzeit Richtung Referenzpos. zum lˆsen der Verriegelung  Einlaﬂnockenwelle" VALUE 0x1C3B56 KwUb 12.75 t50msxs_ub_b12p75 0.00 12.75 FORMAT "%5.2" /end CHARACTERISTIC
/begin CHARACTERISTIC TNWPPTA "Zeit Auslassnockenwelle in Passivposition bei Testereingriff" VALUE 0x1CAC6D KwUb 12.70 t50msxs_q0p05 0.05000 12.75 FORMAT "%5.2" /end CHARACTERISTIC
/begin CHARACTERISTIC TNWPPTE "Zeit Einlassnockenwelle in Passivposition bei Testereingriff" VALUE 0x1CAC6E KwUb 12.70 t50msxs_q0p05 0.05000 12.75 FORMAT "%5.2" /end CHARACTERISTIC
/begin CHARACTERISTIC TNWSHK "Zeit f¸r Sch¸tteln Ein- oder Auslaﬂnockenwelle" VALUE 0x1CAB08 KwUb 12.75 t50msxs_ub_b12p75 0.00 12.75 FORMAT "%5.2" /end CHARACTERISTIC
/begin CHARACTERISTIC TNWSHKAA "Zeit f¸r Positionswechsel beim Sch¸tteln der Auslaﬂnockenwelle" VALUE 0x1C3B57 KwUb 12.75 t50msxs_ub_b12p75 0.00 12.75 FORMAT "%5.2" /end CHARACTERISTIC
/begin CHARACTERISTIC TNWSHKAE "Zeit f¸r Positionswechsel beim Sch¸tteln der Einlaﬂnockenwelle" VALUE 0x1C3B58 KwUb 12.75 t50msxs_ub_b12p75 0.00 12.75 FORMAT "%5.2" /end CHARACTERISTIC
/begin CHARACTERISTIC TNWSTPA "max Zeit  Positionsabweichung Einlaﬂnockenwelle bis Verstellstop Auslaﬂ aktiv" VALUE 0x1CAB09 KwUb 12.75 t50msxs_ub_b12p75 0.00 12.75 FORMAT "%5.2" /end CHARACTERISTIC
/begin CHARACTERISTIC TNWVBGNA "Zeit bis Verstellung der Auslassnockenwelle durch Tester beginnt" VALUE 0x1CAC6F KwUb 12.70 t50msxs_q0p05 0.05000 12.75 FORMAT "%5.2" /end CHARACTERISTIC
/begin CHARACTERISTIC TNWVBGNE "Zeit bis Verstellung der Einlassnockenwelle durch Tester beginnt" VALUE 0x1CAC70 KwUb 12.70 t50msxs_q0p05 0.05000 12.75 FORMAT "%5.2" /end CHARACTERISTIC
/begin CHARACTERISTIC TNWWSPA "Verweildauer in einer Position bei Sollwinkelspr¸ngen Auslaﬂnockenwelle" VALUE 0x1CAC9B KwUb 50.80 t200msxs_ub_b51 0.2000 51.00 FORMAT "%5.2" /end CHARACTERISTIC
/begin CHARACTERISTIC TVDNOZW "Zeit f¸r Delta Drehzahl, bei der keine Z¸ndwinkeleingriff stattfindet" VALUE 0x1C698D KwUb 2.550 t10msxs_ub_b2p55 0.00 2.550 FORMAT "%5.3" /end CHARACTERISTIC
/begin CHARACTERISTIC TVFSAM "Temperaturabh‰ngige Verzˆgerungszeit f¸r Fahrstufe AUS" CURVE 0x1CFE08 GklWUb 5.100 t20msxs_ub_b5p1 0.00 5.100 FORMAT "%5.3"
 /begin AXIS_DESCR COM_AXIS twnd temp_ub_q0p75_o48 8 -48.00 143.3 AXIS_PTS_REF STW08MDUB /end AXIS_DESCR
/end CHARACTERISTIC
/begin CHARACTERISTIC TVFSEM "Temperaturabh‰ngige Verzˆgerungszeit f¸r Fahrstufe EIN" CURVE 0x1CFE10 GklWUb 5.100 t20msxs_ub_b5p1 0.00 5.100 FORMAT "%5.3"
 /begin AXIS_DESCR COM_AXIS twnd temp_ub_q0p75_o48 8 -48.00 143.3 AXIS_PTS_REF STW08MDUB /end AXIS_DESCR
/end CHARACTERISTIC
/begin CHARACTERISTIC TVFSRAM "motortemperaturabh‰ngige Verzˆgerungszeit f¸r Fahrstufe aus (R)" CURVE 0x1CFE18 GklWUb 5.100 t20msxs_ub_b5p1 0.00 5.100 FORMAT "%5.3"
 /begin AXIS_DESCR COM_AXIS twnd temp_ub_q0p75_o48 8 -48.00 143.3 AXIS_PTS_REF STW08MDUB /end AXIS_DESCR
/end CHARACTERISTIC
/begin CHARACTERISTIC TVFSREM "motortemperaturabh‰ngige Verzˆgerungszeit f¸r Fahrstufe ein (R)" CURVE 0x1CFE20 GklWUb 5.100 t20msxs_ub_b5p1 0.00 5.100 FORMAT "%5.3"
 /begin AXIS_DESCR COM_AXIS twnd temp_ub_q0p75_o48 8 -48.00 143.3 AXIS_PTS_REF STW08MDUB /end AXIS_DESCR
/end CHARACTERISTIC
/begin CHARACTERISTIC TVFUE "Verzˆgerungszeit f¸r den Aufbau der F¸llung" VALUE 0x1C709D KwUb 5.100 t20msxs_ub_b5p1 0.00 5.100 FORMAT "%5.3" /end CHARACTERISTIC
/begin CHARACTERISTIC UBNLMN "Minimale Batterie-Sollspannung" VALUE 0x1CED94 KwUb 24.02 spg_ubatt 0.00 24.02 FORMAT "%5.2" /end CHARACTERISTIC
/begin CHARACTERISTIC UEVERG "‹bersetzungsverh‰ltnis abh. vom eingelegten Gang" CURVE 0x1C70A0 FklWUb 31.88 fak_ub_b32 0.00 31.88 FORMAT "%5.2"
 /begin AXIS_DESCR FIX_AXIS gangi dez 8 0.00 7.000 FORMAT "%5.3" FIX_AXIS_PAR 0 0 8 /end AXIS_DESCR
/end CHARACTERISTIC
/begin CHARACTERISTIC VMAXOG "Ermittlung der variantencodierten Hˆchstgeschw." CURVE 0x1D2494 dc_ArrUw 3935.938 DC_VEHSPD_KMH_U16 160.0000 4095.938 FORMAT "%8.3"
 /begin AXIS_DESCR FIX_AXIS Cod_Trans_SpdLim DC_CNTR_U8 8 0.00 7.000 FORMAT "%5.3" FIX_AXIS_PAR 0 0 8 /end AXIS_DESCR
/end CHARACTERISTIC
/begin CHARACTERISTIC VNMX "Geschwindigkeits-Schwelle f¸r Aktivierung der erhˆhten Drehzahlgrenze" VALUE 0x1CF0E1 KwUb 318.8 vfzg_ub_q1p25 0.00 318.8 FORMAT "%5.1" /end CHARACTERISTIC
/begin CHARACTERISTIC VNWLLPA "Applikationswert Geschwindigkeitsschwelle beim Leerlauf (Auslaﬂ)" VALUE 0x1CAC9C KwUb 318.8 vfzg_ub_q1p25 0.00 318.8 FORMAT "%5.1" /end CHARACTERISTIC
/begin CHARACTERISTIC WNWDSHKA "Deltasollwinkel Nockenwelle Korrektur Katheizen ¸ber Hˆhe Auslaﬂ" CURVE 0x1CB238 KlAUwSstUwWSw 511.9922 kw_sw_q0p0078 -256.0000 255.9922 FORMAT "%8.4"
 /begin AXIS_DESCR STD_AXIS fho_w fak_uw_b4 4 0.00 3.999939 FORMAT "%8.6" DEPOSIT ABSOLUTE /end AXIS_DESCR
/end CHARACTERISTIC
/begin CHARACTERISTIC WNWRAS "Winkel Auslassventil schlie in Referenzposition bezogen auf Ladungswechsel(LWOT)" VALUE 0x1CB24A KwSw 511.9922 kw_sw_q0p0078 -256.0000 255.9922 FORMAT "%8.4" /end CHARACTERISTIC
/begin CHARACTERISTIC WNWSAAPP "Applikationswert f¸r Auslaﬂ-Nockenwellensollwinkel" VALUE 0x1CB24C KwSw 511.9922 kw_sw_q0p0078 -256.0000 255.9922 FORMAT "%8.4" /end CHARACTERISTIC
/begin CHARACTERISTIC WNWSAPFA "Applikationswert Sollwinkel f¸r Fr¸hposition bei Spr¸ngen Auslaﬂnockenwelle" VALUE 0x1CB24E KwSw 511.9922 kw_sw_q0p0078 -256.0000 255.9922 FORMAT "%8.4" /end CHARACTERISTIC
/begin CHARACTERISTIC WNWSAPSA "Applikationswert Sollwinkel f¸r Sp‰tposition bei Spr¸ngen Auslaﬂnockenwelle" VALUE 0x1CB250 KwSw 511.9922 kw_sw_q0p0078 -256.0000 255.9922 FORMAT "%8.4" /end CHARACTERISTIC
/begin CHARACTERISTIC WNWSGLEHA "Sollwinkelschwelle Nockenwellengleichstellung bei Fehler in 2Bank-System Auslaﬂ" VALUE 0x1CB252 KwSw 511.9922 kw_sw_q0p0078 -256.0000 255.9922 FORMAT "%8.4" /end CHARACTERISTIC
/begin CHARACTERISTIC WNWSMNA "Minimal zul‰ssiger Sollwert f¸r Nockenwellenverstellung Auslass schliesst (LWOT)" VALUE 0x1CB254 KwSw 511.9922 kw_sw_q0p0078 -256.0000 255.9922 FORMAT "%8.4" /end CHARACTERISTIC
/begin CHARACTERISTIC WNWSMXA "Maximal zul‰ssiger Sollwert f¸r Nockenwellenverstellung Auslass schliesst (LWOT)" VALUE 0x1CB256 KwSw 511.9922 kw_sw_q0p0078 -256.0000 255.9922 FORMAT "%8.4" /end CHARACTERISTIC
/begin CHARACTERISTIC WNWSTA "Sollwinkel f¸r Auslaﬂnockenwellenposition w‰hrend Start" CURVE 0x1CB258 KlAUwSstUwWSw 511.9922 kw_sw_q0p0078 -256.0000 255.9922 FORMAT "%8.4"
 /begin AXIS_DESCR STD_AXIS tmot temp_ub_q0p75_o48 4 -48.00000 49103.25 FORMAT "%8.2" DEPOSIT ABSOLUTE /end AXIS_DESCR
/end CHARACTERISTIC
/begin CHARACTERISTIC WNWSWOFA "Sollwinkel f¸r Auslaﬂnockenwellenposition bei S_KL15 = aus" CURVE 0x1CB26A KlAUwSstUwWSw 511.9922 kw_sw_q0p0078 -256.0000 255.9922 FORMAT "%8.4"
 /begin AXIS_DESCR STD_AXIS tumg temp_ub_q0p75_o48 4 -48.00000 49103.25 FORMAT "%8.2" DEPOSIT ABSOLUTE /end AXIS_DESCR
/end CHARACTERISTIC
/begin CHARACTERISTIC ZKBLF1 "Zeitkonstante f¸r L¸fter 1." VALUE 0x1CFD27 KwUb 5.100 t_q0p02 0.00 5.100 FORMAT "%5.3" /end CHARACTERISTIC
/begin CHARACTERISTIC ZKBLF2 "Zeitkonstante f¸r L¸fter 2." VALUE 0x1CFD28 KwUb 5.100 t_q0p02 0.00 5.100 FORMAT "%5.3" /end CHARACTERISTIC
/begin CHARACTERISTIC ZKDMDW "Zeitkonstante f¸r Abregelung D-Anteil Wandlermoment" VALUE 0x1C70A8 KwUb 5.08000 zk20msxs_ub_b5p1 0.0200000 5.10000 FORMAT "%7.5" /end CHARACTERISTIC
/begin CHARACTERISTIC ZKMD1LF "Zeitfilter f¸r L¸ftermoment" VALUE 0x1CFD29 KwUb 5.08000 zk20msxs_ub_b5p1 0.0200000 5.10000 FORMAT "%7.5" /end CHARACTERISTIC
/begin CHARACTERISTIC ZKMDKO "Zeitkonstante Klimakompressor-Lastabregelung" VALUE 0x1CFD2A KwUb 5.09992 zk20msxs_ub_b5p12 0.0200784 5.12000 FORMAT "%7.5" /end CHARACTERISTIC
/begin CHARACTERISTIC ZKMDSEV "Zeitkonstante Elektrische-Verbraucher-Lastabregelung" VALUE 0x1CFD2B KwUb 25.4996 zk100msxs_ub_b25p5 0.100392 25.6000 FORMAT "%7.4" /end CHARACTERISTIC
/begin CHARACTERISTIC ZKMDSLP "Zeitkonstante zur Abregelung des Einschaltmomentes der Sek-Luftpumpe" VALUE 0x1CFD2C KwUb 5.09992 zk20msxs_ub_b5p12 0.0200784 5.12000 FORMAT "%7.5" /end CHARACTERISTIC
/begin CHARACTERISTIC ZKMDWAB "Zeitkonstante f¸r Abregelung der  Drehmomentaufnahme des Wandlers" VALUE 0x1C70A9 KwUb 5.08000 zk20msxs_ub_b5p1 0.0200000 5.10000 FORMAT "%7.5" /end CHARACTERISTIC
/begin CHARACTERISTIC ZKMDWAUF "Zeitkonstante f¸r Aufregelung der  Drehmomentaufnahme des Wandlers" VALUE 0x1C70AA KwUb 5.08000 zk20msxs_ub_b5p1 0.0200000 5.10000 FORMAT "%7.5" /end CHARACTERISTIC
/begin CHARACTERISTIC ZKMDWF "Zeitkonstante f¸r Filterung Wandlermoment zur Bildung D-Anteil" VALUE 0x1C70AB KwUb 5.08000 zk20msxs_ub_b5p1 0.0200000 5.10000 FORMAT "%7.5" /end CHARACTERISTIC
/begin CHARACTERISTIC ZKUEVERG "Filterzeitkonstante: Turbinendrehzahl bei Gangwechsel" VALUE 0x1C70AC KwUb 5.08000 zk20msxs_ub_b5p1 0.0200000 5.10000 FORMAT "%7.5" /end CHARACTERISTIC
/begin CHARACTERISTIC ZMDDLWS "Zeitkonstant f¸r Lenkhilfelastmoment" VALUE 0x1CFD2D KwUb 5.09992 zk20msxs_ub_b5p12 0.0200784 5.12000 FORMAT "%7.5" /end CHARACTERISTIC
/begin MEASUREMENT ACComprDsabl_Req "" UBYTE DEZ 1 100 0 255 FORMAT "%5.1" ECU_ADDRESS 0x800DB4 /end MEASUREMENT
/begin MEASUREMENT ACComprSo_Req "" UBYTE DEZ 1 100 0 255 FORMAT "%5.1" ECU_ADDRESS 0x800DB5 /end MEASUREMENT
/begin MEASUREMENT AdapAltitude_Coef "" UWORD dez_uw_q3p052Em5 1 100 0 1.99997 FORMAT "%8.6" ECU_ADDRESS 0x800DDC /end MEASUREMENT
/begin MEASUREMENT AMTCrwlRepDsabl_Mode "" UBYTE DEZ 1 100 0 255 FORMAT "%5.1" ECU_ADDRESS 0x800DB6 /end MEASUREMENT
/begin MEASUREMENT anzlvnwa "Anzahl der Lˆseversuche bei verriegelter Nockenwelle Auslaﬂ" UBYTE dez 1 100 0 255 FORMAT "%5.1" ECU_ADDRESS 0x8010EF /end MEASUREMENT
/begin MEASUREMENT anzlvnwa2 "Anzahl der Lˆseversuche bei verriegelter Nockenwelle Auslaﬂ 2" UBYTE dez 1 100 0 255 FORMAT "%5.1" ECU_ADDRESS 0x8010F0 /end MEASUREMENT
/begin MEASUREMENT anzlvnwe "Anzahl der Lˆseversuche bei verriegelter Nockenwelle Einlaﬂ" UBYTE dez 1 100 0 255 FORMAT "%5.1" ECU_ADDRESS 0x8010F1 /end MEASUREMENT
/begin MEASUREMENT anzlvnwe2 "Anzahl der Lˆseversuche bei verriegelter Nockenwelle Einlaﬂ 2" UBYTE dez 1 100 0 255 FORMAT "%5.1" ECU_ADDRESS 0x8010F2 /end MEASUREMENT
/begin MEASUREMENT APEmergOp_Mode_Req "" UBYTE DEZ 1 100 0 255 FORMAT "%5.1" ECU_ADDRESS 0x800DB7 /end MEASUREMENT
/begin MEASUREMENT APPoti_SupplyVolt "" SWORD spg_sw_q1p953Em3 1 100 -64 63.998 FORMAT "%8.5" ECU_ADDRESS 0x800DDE /end MEASUREMENT
/begin MEASUREMENT APP_ADD_Grdt "" SWORD DC_PCT_S16 1 100 -100.003 100 FORMAT "%8.4" ECU_ADDRESS 0x803410 /end MEASUREMENT
/begin MEASUREMENT APP_ADD_Mem "" UWORD DC_PER0327 1 100 0 200.003 FORMAT "%8.4" ECU_ADDRESS 0x803412 /end MEASUREMENT
/begin MEASUREMENT APP_Char "" UWORD DC_PER0327 1 100 0 200.003 FORMAT "%8.4" ECU_ADDRESS 0x803414 /end MEASUREMENT
/begin MEASUREMENT APP_Volt1 "Schleiferwert Poti Pedalwertgeber 1, 10 Bit 0..1023" UWORD rel_q0p0977 1 100 0 6399.9 FORMAT "%8.3" ECU_ADDRESS 0x80194C /end MEASUREMENT
/begin MEASUREMENT APP_Volt2 "Schleiferwert Poti Pedalwertgeber 2, 10 Bit 0..511" UWORD rel_q0p0977 1 100 0 6399.9 FORMAT "%8.3" ECU_ADDRESS 0x800DE0 /end MEASUREMENT
/begin MEASUREMENT Baro "" SWORD p_sw_q0p125 1 100 -4096 4095.88 FORMAT "%8.3" ECU_ADDRESS 0x800DE2 /end MEASUREMENT
/begin MEASUREMENT BatVoltState "" UBYTE DEZ 1 100 0 255 FORMAT "%5.1" ECU_ADDRESS 0x800DB8 /end MEASUREMENT
/begin MEASUREMENT Bat_Volt "" SWORD spg_sw_q1p953Em3 1 100 -64 63.998 FORMAT "%8.5" ECU_ADDRESS 0x800DE4 /end MEASUREMENT
/begin MEASUREMENT B_break1a "" UBYTE B_TRUE 1 100 0 1 BIT_MASK 0x1 FORMAT "%13.11" ECU_ADDRESS 0x8010F6 /end MEASUREMENT
/begin MEASUREMENT B_break1e "" UBYTE B_TRUE 1 100 0 1 BIT_MASK 0x4 FORMAT "%13.11" ECU_ADDRESS 0x8010F6 /end MEASUREMENT
/begin MEASUREMENT B_break2a "" UBYTE B_TRUE 1 100 0 1 BIT_MASK 0x2 FORMAT "%13.11" ECU_ADDRESS 0x8010F6 /end MEASUREMENT
/begin MEASUREMENT B_break2e "" UBYTE B_TRUE 1 100 0 1 BIT_MASK 0x8 FORMAT "%13.11" ECU_ADDRESS 0x8010F6 /end MEASUREMENT
/begin MEASUREMENT B_cnfwan "Bedingung : Drehmomentaufnahme des Wandlers ¸ber CAN" UBYTE B_TRUE 1 100 0 1 BIT_MASK 0x1 FORMAT "%13.11" ECU_ADDRESS 0x7FA9C1 /end MEASUREMENT
/begin MEASUREMENT B_dc_sls "Bedingung Sekund‰rluft aktiv, f¸r Applikationsword" UBYTE DEZ 1 100 0 255 FORMAT "%5.1" ECU_ADDRESS 0x800DB9 /end MEASUREMENT
/begin MEASUREMENT B_dmrwan "Bedingung Aufbau Momentenreserve f¸r Wandlermoment" UBYTE B_TRUE 1 100 0 1 BIT_MASK 0x1 FORMAT "%13.11" ECU_ADDRESS 0x7FA9C2 /end MEASUREMENT
/begin MEASUREMENT B_fanwsaa "Bedingung Funktionsanforderung Diagnose NWS aktiv (Auslaﬂ)" UBYTE B_TRUE 1 100 0 1 BIT_MASK 0x2 FORMAT "%13.11" ECU_ADDRESS 0x8005E0 /end MEASUREMENT
/begin MEASUREMENT B_fanwsea "Bedingung Funktionsanforderung Diagnose NWS aktiv (Einlaﬂ)" UBYTE B_TRUE 1 100 0 1 BIT_MASK 0x8 FORMAT "%13.11" ECU_ADDRESS 0x8005E0 /end MEASUREMENT
/begin MEASUREMENT B_fanwstaa "Umschaltung auf Sollwertvorgabe durch Tester bei Auslassnockenwelle" UBYTE B_TRUE 1 100 0 1 BIT_MASK 0x1 FORMAT "%13.11" ECU_ADDRESS 0x8005E0 /end MEASUREMENT
/begin MEASUREMENT B_fanwstae "Umschaltung auf Sollwertvorgabe durch Tester bei Einlassnockenwelle" UBYTE B_TRUE 1 100 0 1 BIT_MASK 0x4 FORMAT "%13.11" ECU_ADDRESS 0x8005E0 /end MEASUREMENT
/begin MEASUREMENT B_fsu "Bedingung Fahrstufe, Umschaltung" UBYTE B_TRUE 1 100 0 1 BIT_MASK 0x1 FORMAT "%13.11" ECU_ADDRESS 0x7FA9C3 /end MEASUREMENT
/begin MEASUREMENT B_inidtf "Bedingung Initialisierung Filter" UBYTE B_TRUE 1 100 0 1 BIT_MASK 0x1 FORMAT "%13.11" ECU_ADDRESS 0x7FA99B /end MEASUREMENT
/begin MEASUREMENT B_mbst "Bedingung spezielle Momentenbegrenzung w‰hrend Start und kurz nach Start" UBYTE B_TRUE 1 100 0 1 BIT_MASK 0x1 FORMAT "%13.11" ECU_ADDRESS 0x7FA99C /end MEASUREMENT
/begin MEASUREMENT B_mdbglst "Bedingung: St‰ndige Begrenzung milsol_w auf miszull_w im Schicht" UBYTE B_TRUE 1 100 0 1 BIT_MASK 0x1 FORMAT "%13.11" ECU_ADDRESS 0x7FA99D /end MEASUREMENT
/begin MEASUREMENT B_mdblst "Bedingung: St‰ndige Begrenzung des Luftsollmoments milsol_w auf miszull_w" UBYTE B_TRUE 1 100 0 1 BIT_MASK 0x1 FORMAT "%13.11" ECU_ADDRESS 0x7FA99E /end MEASUREMENT
/begin MEASUREMENT B_mdbresl "Bedingung: Restierung B_mibeg nur bei inaktiver Luftbegrenzung" UBYTE B_TRUE 1 100 0 1 BIT_MASK 0x1 FORMAT "%13.11" ECU_ADDRESS 0x7FA99F /end MEASUREMENT
/begin MEASUREMENT B_mdbza "Bedingung: Z¸ndwinkeleingriff bei B_mibeg freigegeben" UBYTE B_TRUE 1 100 0 1 BIT_MASK 0x1 FORMAT "%13.11" ECU_ADDRESS 0x7FA9A0 /end MEASUREMENT
/begin MEASUREMENT b_mminwf "WF-Drehzahlregelung aktiviert" UBYTE DC_FLAG_U8 1 100 0 1 BIT_MASK 0x1 FORMAT "%5.3" ECU_ADDRESS 0x8039C6 /end MEASUREMENT
/begin MEASUREMENT B_mzns "Nachstartaufweitung des zul. Moments aktiv" UBYTE B_TRUE 1 100 0 1 BIT_MASK 0x1 FORMAT "%13.11" ECU_ADDRESS 0x7FA9A1 /end MEASUREMENT
/begin MEASUREMENT b_nabsch "Drehzahlbegrenzung abschalten" UBYTE DC_FLAG_U8 1 100 0 1 BIT_MASK 0x1 FORMAT "%5.3" ECU_ADDRESS 0x8039C7 /end MEASUREMENT
/begin MEASUREMENT b_nabschwf "WF-Begrenzung abschalten" UBYTE DC_FLAG_U8 1 100 0 1 BIT_MASK 0x1 FORMAT "%5.3" ECU_ADDRESS 0x8039C8 /end MEASUREMENT
/begin MEASUREMENT B_nachl "Steuerung SG-Nachlauf" UWORD B_TRUE 1 100 0 1 BIT_MASK 0x8000 FORMAT "%13.11" ECU_ADDRESS 0x7FC83E /end MEASUREMENT
/begin MEASUREMENT B_nachlend "Bedingung SG-Nachlauf regul‰r beendet" UWORD B_TRUE 1 100 0 1 BIT_MASK 0x4000 FORMAT "%13.11" ECU_ADDRESS 0x7FC83E /end MEASUREMENT
/begin MEASUREMENT B_nachlram "Steuerung SG-Nachlauf mit Systemcheck" UBYTE B_TRUE 1 100 0 1 BIT_MASK 0x1 FORMAT "%13.11" ECU_ADDRESS 0x7FA889 /end MEASUREMENT
/begin MEASUREMENT b_nidly "NGB I-Regler Verzˆgerung aktiv" UBYTE DC_FLAG_U8 1 100 0 1 BIT_MASK 0x1 FORMAT "%5.3" ECU_ADDRESS 0x8039C9 /end MEASUREMENT
/begin MEASUREMENT b_nidlywf "WF I-Regler Verzˆgerung aktiv" UBYTE DC_FLAG_U8 1 100 0 1 BIT_MASK 0x1 FORMAT "%5.3" ECU_ADDRESS 0x8039CA /end MEASUREMENT
/begin MEASUREMENT B_nlacls "Anforderung Steuerger‰tenachlauf von AC-L¸ftersteuerung" UWORD B_TRUE 1 100 0 1 BIT_MASK 0x2 FORMAT "%13.11" ECU_ADDRESS 0x7FC83E /end MEASUREMENT
/begin MEASUREMENT B_nlale "Anforderung Steuerger‰tenachlauf von Funktion ALE" UWORD B_TRUE 1 100 0 1 BIT_MASK 0x1 FORMAT "%13.11" ECU_ADDRESS 0x7FC83E /end MEASUREMENT
/begin MEASUREMENT B_nlatm "Anforderung Steuerger‰tenachlauf f¸r Abgastemp.Modell Sondenschutz" UWORD B_TRUE 1 100 0 1 BIT_MASK 0x400 FORMAT "%13.11" ECU_ADDRESS 0x7FC83E /end MEASUREMENT
/begin MEASUREMENT B_nlcan "Bedingung f¸r SG-Nachlauf von CAN" UWORD B_TRUE 1 100 0 1 BIT_MASK 0x200 FORMAT "%13.11" ECU_ADDRESS 0x7FC83E /end MEASUREMENT
/begin MEASUREMENT B_nldte "Anforderung Steuerger‰tenachlauf Diagnose Tankentl¸ftung" UWORD B_TRUE 1 100 0 1 BIT_MASK 0x100 FORMAT "%13.11" ECU_ADDRESS 0x7FC83E /end MEASUREMENT
/begin MEASUREMENT B_nldval "Anforderung Steuerger‰te Nachlauf wegen DVAL (Validierung)" UBYTE B_TRUE 1 100 0 1 BIT_MASK 0x1 FORMAT "%13.11" ECU_ADDRESS 0x7FC83C /end MEASUREMENT
/begin MEASUREMENT B_nlEEPR "Bedingung Nachlauf EEPROM schreiben" UWORD B_TRUE 1 100 0 1 BIT_MASK 0x20 FORMAT "%13.11" ECU_ADDRESS 0x7FC83E /end MEASUREMENT
/begin MEASUREMENT B_nlmls "Anforderung Steuerger‰tenachlauf von Motor-L¸ftersteuerung" UWORD B_TRUE 1 100 0 1 BIT_MASK 0x8 FORMAT "%13.11" ECU_ADDRESS 0x7FC83E /end MEASUREMENT
/begin MEASUREMENT B_nlobd "Anforderung Steuerger‰tenachlauf von OBD" UWORD B_TRUE 1 100 0 1 BIT_MASK 0x10 FORMAT "%13.11" ECU_ADDRESS 0x7FC83E /end MEASUREMENT
/begin MEASUREMENT B_nlph "Bedingung kein Phasensignal von den Phasengebern" UBYTE B_TRUE 1 100 0 1 BIT_MASK 0x1 FORMAT "%13.11" ECU_ADDRESS 0x7FA87C /end MEASUREMENT
/begin MEASUREMENT B_nlsgls "Anforderung Steuerger‰tenachlauf von Steuerger‰te-L¸ftersteuerung" UWORD B_TRUE 1 100 0 1 BIT_MASK 0x40 FORMAT "%13.11" ECU_ADDRESS 0x7FC83E /end MEASUREMENT
/begin MEASUREMENT B_nlsiko "Bedingung Nachlauf EGAS-‹berwachung" UWORD B_TRUE 1 100 0 1 BIT_MASK 0x80 FORMAT "%13.11" ECU_ADDRESS 0x7FC83E /end MEASUREMENT
/begin MEASUREMENT B_nlthm "Anforderung Steuerger‰tenachlauf aus Thermomanagement" UBYTE B_TRUE 1 100 0 1 BIT_MASK 0x2 FORMAT "%13.11" ECU_ADDRESS 0x7FC83C /end MEASUREMENT
/begin MEASUREMENT B_nlwst "Anforderung Steuerger‰tenachlauf f¸r Wiederholstarterkennung" UWORD B_TRUE 1 100 0 1 BIT_MASK 0x4 FORMAT "%13.11" ECU_ADDRESS 0x7FC83E /end MEASUREMENT
/begin MEASUREMENT B_nmax "Bedingung Drehzahlbegrenzung aktiv" UBYTE B_TRUE 1 100 0 1 BIT_MASK 0x1 FORMAT "%13.11" ECU_ADDRESS 0x7FA97A /end MEASUREMENT
/begin MEASUREMENT B_nmaxd "Bedingung Drehzahlbegrenzung mit Einspritzausblendung an allen Zylindern" UBYTE B_TRUE 1 100 0 1 BIT_MASK 0x1 FORMAT "%13.11" ECU_ADDRESS 0x7FA97B /end MEASUREMENT
/begin MEASUREMENT b_nmaxk "Maximaldrehzahl aktiv" UBYTE DC_FLAG_U8 1 100 0 1 BIT_MASK 0x1 FORMAT "%5.3" ECU_ADDRESS 0x8039CB /end MEASUREMENT
/begin MEASUREMENT B_nmaxog "Bedingung kurzzeitige ‹berhˆhung der Drehzahlgrenze" UBYTE B_TRUE 1 100 0 1 BIT_MASK 0x1 FORMAT "%13.11" ECU_ADDRESS 0x801247 /end MEASUREMENT
/begin MEASUREMENT B_nmxkr "Bedingung Drehzahlbegrenzung bei Sicherheitssp‰tverstellung der Klopfregelung" UBYTE B_TRUE 1 100 0 1 BIT_MASK 0x2 FORMAT "%13.11" ECU_ADDRESS 0x801247 /end MEASUREMENT
/begin MEASUREMENT B_nmxozwe "Bedingung: kein Z¸ndwinkeleingriff der Drehmomentstruktur wegen NMAX-Begrenzung" UBYTE B_TRUE 1 100 0 1 BIT_MASK 0x1 FORMAT "%13.11" ECU_ADDRESS 0x7FA97C /end MEASUREMENT
/begin MEASUREMENT B_nmxred "reduzierte maximale Drehzahl" UBYTE B_TRUE 1 100 0 1 BIT_MASK 0x2 FORMAT "%13.11" ECU_ADDRESS 0x801246 /end MEASUREMENT
/begin MEASUREMENT b_nout "n-Regler-Deaktivierung unterschritten" UBYTE DC_FLAG_U8 1 100 0 1 BIT_MASK 0x1 FORMAT "%5.3" ECU_ADDRESS 0x8039CC /end MEASUREMENT
/begin MEASUREMENT B_nozwe "Bedingung kein Z¸ndwinkeleingriff der Drehmomentstruktur" UBYTE B_TRUE 1 100 0 1 BIT_MASK 0x1 FORMAT "%13.11" ECU_ADDRESS 0x7FAA09 /end MEASUREMENT
/begin MEASUREMENT b_nramp "Abrampung Max-Dauerdrehzahl aktiv" UBYTE DC_FLAG_U8 1 100 0 1 BIT_MASK 0x1 FORMAT "%5.3" ECU_ADDRESS 0x8039CD /end MEASUREMENT
/begin MEASUREMENT B_nsakt "Nachstart aktiv f¸r Nachstartaufweitung" UBYTE B_TRUE 1 100 0 1 BIT_MASK 0x1 FORMAT "%13.11" ECU_ADDRESS 0x7FA9A2 /end MEASUREMENT
/begin MEASUREMENT B_nsend "Nachstart¸berwachungszeit abgelaufen" UBYTE B_TRUE 1 100 0 1 BIT_MASK 0x1 FORMAT "%13.11" ECU_ADDRESS 0x7FA9A3 /end MEASUREMENT
/begin MEASUREMENT b_nvorh "NGB-Vorhalt ¸berschritten" UBYTE DC_FLAG_U8 1 100 0 1 BIT_MASK 0x1 FORMAT "%5.3" ECU_ADDRESS 0x8039CE /end MEASUREMENT
/begin MEASUREMENT b_nvorhwf "WF-Vorhalt ¸berschritten" UBYTE DC_FLAG_U8 1 100 0 1 BIT_MASK 0x1 FORMAT "%5.3" ECU_ADDRESS 0x8039CF /end MEASUREMENT
/begin MEASUREMENT B_nwgleha "Nockenwellengleichstellung  Auslaﬂ-NW bei 2Bank-System erlaubt bei Fehler Bank1" UBYTE B_TRUE 1 100 0 1 BIT_MASK 0x2 FORMAT "%13.11" ECU_ADDRESS 0x801100 /end MEASUREMENT
/begin MEASUREMENT B_nwgleha2 "Nockenwellengleichstellung  Auslaﬂ-NW bei 2Bank-System erlaubt bei Fehler Bank2" UBYTE B_TRUE 1 100 0 1 BIT_MASK 0x4 FORMAT "%13.11" ECU_ADDRESS 0x801100 /end MEASUREMENT
/begin MEASUREMENT B_nwllna "Anford. f¸r LL-Drehzahlanheb.  zur sicheren Verriegelung Nockenwelle" UBYTE B_TRUE 1 100 0 1 BIT_MASK 0x1 FORMAT "%13.11" ECU_ADDRESS 0x7FA696 /end MEASUREMENT
/begin MEASUREMENT B_nwlva "Bedingung:  Lˆsen der Nockenwellenverriegelung aktiv Auslaﬂ" UBYTE B_TRUE 1 100 0 1 BIT_MASK 0x4 FORMAT "%13.11" ECU_ADDRESS 0x8010F9 /end MEASUREMENT
/begin MEASUREMENT B_nwlva2 "Bedingung:  Lˆsen der Nockenwellenverriegelung aktiv Auslaﬂ 2" UBYTE B_TRUE 1 100 0 1 BIT_MASK 0x8 FORMAT "%13.11" ECU_ADDRESS 0x8010F9 /end MEASUREMENT
/begin MEASUREMENT B_nwlve "Bedingung:  Lˆsen der Nockenwellenverriegelung aktiv Einlaﬂ" UBYTE B_TRUE 1 100 0 1 BIT_MASK 0x1 FORMAT "%13.11" ECU_ADDRESS 0x8010F9 /end MEASUREMENT
/begin MEASUREMENT B_nwlve2 "Bedingung:  Lˆsen der Nockenwellenverriegelung aktiv Einlaﬂ 2" UBYTE B_TRUE 1 100 0 1 BIT_MASK 0x2 FORMAT "%13.11" ECU_ADDRESS 0x8010F9 /end MEASUREMENT
/begin MEASUREMENT B_nwsapspa "Bedingung: Sollwertumschaltung bei Sollwinkelspr¸ngen Ausaﬂnockenwelle" UBYTE B_TRUE 1 100 0 1 BIT_MASK 0x1 FORMAT "%13.11" ECU_ADDRESS 0x801100 /end MEASUREMENT
/begin MEASUREMENT B_nwseva "Eingeschr‰nkte Nockenwellenverstellung aktiv Auslassnockenwelle" UBYTE B_TRUE 1 100 0 1 BIT_MASK 0x1 FORMAT "%13.11" ECU_ADDRESS 0x7FA697 /end MEASUREMENT
/begin MEASUREMENT B_nwseva2 "Eingeschr‰nkte Nockenwellenverstellung aktiv Auslassnockenwelle 2" UBYTE B_TRUE 1 100 0 1 BIT_MASK 0x1 FORMAT "%13.11" ECU_ADDRESS 0x7FA698 /end MEASUREMENT
/begin MEASUREMENT B_nwseve "Eingeschr‰nkte Nockenwellenverstellung aktiv Einlassnockenwelle" UBYTE B_TRUE 1 100 0 1 BIT_MASK 0x1 FORMAT "%13.11" ECU_ADDRESS 0x7FA699 /end MEASUREMENT
/begin MEASUREMENT B_nwseve2 "Eingeschr‰nkte Nockenwellenverstellung aktiv Einlassnockenwelle 2" UBYTE B_TRUE 1 100 0 1 BIT_MASK 0x1 FORMAT "%13.11" ECU_ADDRESS 0x7FA69A /end MEASUREMENT
/begin MEASUREMENT B_nwshka "Sch¸tteln Auslaﬂnockenwelle angefordert" UBYTE B_TRUE 1 100 0 1 BIT_MASK 0x10 FORMAT "%13.11" ECU_ADDRESS 0x8010F6 /end MEASUREMENT
/begin MEASUREMENT B_nwshkaa "Sch¸tteln Auslaﬂnockenwelle aktiv" UBYTE B_TRUE 1 100 0 1 BIT_MASK 0x20 FORMAT "%13.11" ECU_ADDRESS 0x8010F6 /end MEASUREMENT
/begin MEASUREMENT B_nwshkae "Sch¸tteln Einlaﬂnockenwelle aktiv" UBYTE B_TRUE 1 100 0 1 BIT_MASK 0x40 FORMAT "%13.11" ECU_ADDRESS 0x8010F6 /end MEASUREMENT
/begin MEASUREMENT B_nwshkapa "Sch¸tteln der Auslaﬂnockenwelle am Fr¸hanschlag erlaubt" UBYTE B_TRUE 1 100 0 1 BIT_MASK 0x80 FORMAT "%13.11" ECU_ADDRESS 0x8010F6 /end MEASUREMENT
/begin MEASUREMENT B_nwshkape "Sch¸tteln der Einlaﬂnockenwelle am Fr¸hanschlag erlaubt" UBYTE B_TRUE 1 100 0 1 BIT_MASK 0x1 FORMAT "%13.11" ECU_ADDRESS 0x8010F7 /end MEASUREMENT
/begin MEASUREMENT B_nwshke "Sch¸tteln Einlaﬂnockenwelle angefordert" UBYTE B_TRUE 1 100 0 1 BIT_MASK 0x2 FORMAT "%13.11" ECU_ADDRESS 0x8010F7 /end MEASUREMENT
/begin MEASUREMENT B_nwshko "Umschaltbit f¸r Sch¸tteln Einlaﬂ- Auslaﬂnockenwelle 1: Einlaﬂ, 0: Auslaﬂ" UBYTE B_TRUE 1 100 0 1 BIT_MASK 0x4 FORMAT "%13.11" ECU_ADDRESS 0x8010F7 /end MEASUREMENT
/begin MEASUREMENT B_nwshkrpa "Sch¸tteln der Auslaﬂnockenwelle am Sp‰tanschlag erlaubt" UBYTE B_TRUE 1 100 0 1 BIT_MASK 0x8 FORMAT "%13.11" ECU_ADDRESS 0x8010F7 /end MEASUREMENT
/begin MEASUREMENT B_nwshkrpe "Sch¸tteln der Einlaﬂnockenwelle am Sp‰tanschlag erlaubt" UBYTE B_TRUE 1 100 0 1 BIT_MASK 0x10 FORMAT "%13.11" ECU_ADDRESS 0x8010F7 /end MEASUREMENT
/begin MEASUREMENT B_nwshkta "Sch¸tteln Auslaﬂnockenwelle ‹berwachungszeit l‰uft" UBYTE B_TRUE 1 100 0 1 BIT_MASK 0x20 FORMAT "%13.11" ECU_ADDRESS 0x8010F7 /end MEASUREMENT
/begin MEASUREMENT B_nwshkte "Sch¸tteln Einlaﬂnockenwelle ‹berwachungszeit l‰uft" UBYTE B_TRUE 1 100 0 1 BIT_MASK 0x40 FORMAT "%13.11" ECU_ADDRESS 0x8010F7 /end MEASUREMENT
/begin MEASUREMENT B_nwslla "Bed. Nockenwelle Sollwert Leerlauf Auslaﬂ" UBYTE B_TRUE 1 100 0 1 BIT_MASK 0x1 FORMAT "%13.11" ECU_ADDRESS 0x8010FF /end MEASUREMENT
/begin MEASUREMENT B_nwstpa "Vestellverbot f¸r Auslaﬂnockenwelle durch Verstellprobleme bei Einlaﬂ aktiv" UBYTE B_TRUE 1 100 0 1 BIT_MASK 0x1 FORMAT "%13.11" ECU_ADDRESS 0x8010F5 /end MEASUREMENT
/begin MEASUREMENT B_nwsyna "Verstellstop wegen Synchronisation 2Bank-Nockenwelle Auslaﬂ 1" UBYTE B_TRUE 1 100 0 1 BIT_MASK 0x1 FORMAT "%13.11" ECU_ADDRESS 0x7FA69B /end MEASUREMENT
/begin MEASUREMENT B_nwsyna2 "Verstellstop wegen Synchronisation 2Bank-Nockenwelle Auslaﬂ 2" UBYTE B_TRUE 1 100 0 1 BIT_MASK 0x1 FORMAT "%13.11" ECU_ADDRESS 0x7FA69C /end MEASUREMENT
/begin MEASUREMENT B_nwsyne "Verstellstop wegen Synchronisation 2Bank-Nockenwelle Einlaﬂ 1" UBYTE B_TRUE 1 100 0 1 BIT_MASK 0x1 FORMAT "%13.11" ECU_ADDRESS 0x7FA69D /end MEASUREMENT
/begin MEASUREMENT B_nwsyne2 "Verstellstop wegen Synchronisation 2Bank-Nockenwelle Einlaﬂ 2" UBYTE B_TRUE 1 100 0 1 BIT_MASK 0x1 FORMAT "%13.11" ECU_ADDRESS 0x7FA69E /end MEASUREMENT
/begin MEASUREMENT B_od2 "" UBYTE B_TRUE 1 100 0 1 BIT_MASK 0x2 FORMAT "%13.11" ECU_ADDRESS 0x80105C /end MEASUREMENT
/begin MEASUREMENT B_od3 "" UBYTE B_TRUE 1 100 0 1 BIT_MASK 0x1 FORMAT "%13.11" ECU_ADDRESS 0x80105C /end MEASUREMENT
/begin MEASUREMENT B_rgang "Bedingung R¸ckw‰rtsgang eingelegt" UBYTE B_TRUE 1 100 0 1 BIT_MASK 0x1 FORMAT "%13.11" ECU_ADDRESS 0x7FA9C4 /end MEASUREMENT
/begin MEASUREMENT B_shken "Sch¸tteln der Nockenwellen freigegeben" UBYTE B_TRUE 1 100 0 1 BIT_MASK 0x80 FORMAT "%13.11" ECU_ADDRESS 0x8010F7 /end MEASUREMENT
/begin MEASUREMENT B_stat1to2a "" UBYTE B_TRUE 1 100 0 1 BIT_MASK 0x1 FORMAT "%13.11" ECU_ADDRESS 0x8010F8 /end MEASUREMENT
/begin MEASUREMENT B_stat1to2e "" UBYTE B_TRUE 1 100 0 1 BIT_MASK 0x4 FORMAT "%13.11" ECU_ADDRESS 0x8010F8 /end MEASUREMENT
/begin MEASUREMENT B_stat2to1a "" UBYTE B_TRUE 1 100 0 1 BIT_MASK 0x2 FORMAT "%13.11" ECU_ADDRESS 0x8010F8 /end MEASUREMENT
/begin MEASUREMENT B_stat2to1e "" UBYTE B_TRUE 1 100 0 1 BIT_MASK 0x8 FORMAT "%13.11" ECU_ADDRESS 0x8010F8 /end MEASUREMENT
/begin MEASUREMENT B_stpsyna "Ende der Gleichlaufsynchronisation bei 2Bank Nockenwellenverstellung Auslaﬂ" UBYTE B_TRUE 1 100 0 1 BIT_MASK 0x1 FORMAT "%13.11" ECU_ADDRESS 0x7FA69F /end MEASUREMENT
/begin MEASUREMENT B_stpsyne "Ende der Gleichlaufsynchronisation bei 2Bank Nockenwellenverstellung Einlaﬂ" UBYTE B_TRUE 1 100 0 1 BIT_MASK 0x1 FORMAT "%13.11" ECU_ADDRESS 0x7FA6A0 /end MEASUREMENT
/begin MEASUREMENT B_tmnmax "Bedingung tmot erlaubt kurzzeitige ‹berhˆhung der Drehzahlgrenze" UBYTE B_TRUE 1 100 0 1 BIT_MASK 0x4 FORMAT "%13.11" ECU_ADDRESS 0x801247 /end MEASUREMENT
/begin MEASUREMENT b_toelup "÷ltemperatur ¸ber FWMINTOEL" UBYTE DC_FLAG_U8 1 100 0 1 BIT_MASK 0x1 FORMAT "%5.3" ECU_ADDRESS 0x8039D0 /end MEASUREMENT
/begin MEASUREMENT B_tostat1a "" UBYTE B_TRUE 1 100 0 1 BIT_MASK 0x10 FORMAT "%13.11" ECU_ADDRESS 0x8010F8 /end MEASUREMENT
/begin MEASUREMENT B_tostat1e "" UBYTE B_TRUE 1 100 0 1 BIT_MASK 0x40 FORMAT "%13.11" ECU_ADDRESS 0x8010F8 /end MEASUREMENT
/begin MEASUREMENT B_tostat2a "" UBYTE B_TRUE 1 100 0 1 BIT_MASK 0x20 FORMAT "%13.11" ECU_ADDRESS 0x8010F8 /end MEASUREMENT
/begin MEASUREMENT B_tostat2e "" UBYTE B_TRUE 1 100 0 1 BIT_MASK 0x80 FORMAT "%13.11" ECU_ADDRESS 0x8010F8 /end MEASUREMENT
/begin MEASUREMENT B_und "" UBYTE B_TRUE 1 100 0 1 BIT_MASK 0x8 FORMAT "%13.11" ECU_ADDRESS 0x80105C /end MEASUREMENT
/begin MEASUREMENT b_vabsch "HGB-Fkt. abschalten" UBYTE DC_FLAG_U8 1 100 0 1 BIT_MASK 0x1 FORMAT "%5.3" ECU_ADDRESS 0x8039D1 /end MEASUREMENT
/begin MEASUREMENT B_verg "" UBYTE B_TRUE 1 100 0 1 BIT_MASK 0x4 FORMAT "%13.11" ECU_ADDRESS 0x80105C /end MEASUREMENT
/begin MEASUREMENT b_vvorh "Flag, Vmax-Vorhaltschwelle ¸berschritten" UBYTE DC_FLAG_U8 1 100 0 1 BIT_MASK 0x1 FORMAT "%5.3" ECU_ADDRESS 0x8039D2 /end MEASUREMENT
/begin MEASUREMENT B_wechsler "" UBYTE B_TRUE 1 100 0 1 BIT_MASK 0x10 FORMAT "%13.11" ECU_ADDRESS 0x80105C /end MEASUREMENT
/begin MEASUREMENT B_wnstvha "" UBYTE B_TRUE 1 100 0 1 BIT_MASK 0x1 FORMAT "%13.11" ECU_ADDRESS 0x7FA6A1 /end MEASUREMENT
/begin MEASUREMENT B_wnstvhe "" UBYTE B_TRUE 1 100 0 1 BIT_MASK 0x1 FORMAT "%13.11" ECU_ADDRESS 0x7FA6A2 /end MEASUREMENT
/begin MEASUREMENT B_wnws02a "Bedingung NW-Sollwertvorgabe ist 0 (Bank2)" UBYTE B_TRUE 1 100 0 1 BIT_MASK 0x1 FORMAT "%13.11" ECU_ADDRESS 0x7FA6A3 /end MEASUREMENT
/begin MEASUREMENT B_wnws0a "Bedingung NW-Sollwertvorgabe ist 0" UBYTE B_TRUE 1 100 0 1 BIT_MASK 0x1 FORMAT "%13.11" ECU_ADDRESS 0x7FA6A4 /end MEASUREMENT
/begin MEASUREMENT B_wnws0a2 "Bedingung NW-Sollwertvorgabe ist 0 (Bank2, Auslaﬂ)" UBYTE B_TRUE 1 100 0 1 BIT_MASK 0x1 FORMAT "%13.11" ECU_ADDRESS 0x7FA6A5 /end MEASUREMENT
/begin MEASUREMENT B_zwvzm "" UBYTE B_TRUE 1 100 0 1 BIT_MASK 0x1 FORMAT "%13.11" ECU_ADDRESS 0x7FAA0A /end MEASUREMENT
/begin MEASUREMENT CatHead_Mode "" UBYTE DEZ 1 100 0 255 FORMAT "%5.1" ECU_ADDRESS 0x800DBA /end MEASUREMENT
/begin MEASUREMENT CodNew_Mode "" UBYTE DEZ 1 100 0 255 FORMAT "%5.1" ECU_ADDRESS 0x800DBB /end MEASUREMENT
/begin MEASUREMENT Convtr_TrqLoss "" SWORD md_sw_q0p0625 1 100 -2048 2047.94 FORMAT "%8.3" ECU_ADDRESS 0x800DE6 /end MEASUREMENT
/begin MEASUREMENT CPPSw "" UBYTE DEZ 1 100 0 255 FORMAT "%5.1" ECU_ADDRESS 0x800DBC /end MEASUREMENT
/begin MEASUREMENT CrsCtrl_Coor_Trq "" SWORD DC_TRQ_S16 1 100 -2048 2047.94 FORMAT "%8.3" ECU_ADDRESS 0x803418 /end MEASUREMENT
/begin MEASUREMENT ctrshknwa "Anzahl abgeschlossene Sch¸ttelvorg‰nge bei Auslaﬂnockenwelle" UBYTE dez 1 100 0 255 FORMAT "%5.1" ECU_ADDRESS 0x8010F3 /end MEASUREMENT
/begin MEASUREMENT ctrshknwe "Anzahl abgeschlossene Sch¸ttelvorg‰nge bei Einlaﬂnockenwelle" UBYTE dez 1 100 0 255 FORMAT "%5.1" ECU_ADDRESS 0x8010F4 /end MEASUREMENT
/begin MEASUREMENT CylBank1_FIRate_Rel "" UWORD rel_uw_b3072 1 100 0 3071.95 FORMAT "%8.3" ECU_ADDRESS 0x800DE8 /end MEASUREMENT
/begin MEASUREMENT CylBank2_FIRate_Rel "" UWORD rel_uw_b3072 1 100 0 3071.95 FORMAT "%8.3" ECU_ADDRESS 0x800DEA /end MEASUREMENT
/begin MEASUREMENT c_nidly "Z‰hler f¸r NGB I-Regler Verzˆgerung" UBYTE DC_TQ20 1 100 0 5.1 FORMAT "%5.3" ECU_ADDRESS 0x8039D3 /end MEASUREMENT
/begin MEASUREMENT c_nidlywf "Z‰hler f¸r WF I-Regler Verzˆgerung" UBYTE DC_TQ20 1 100 0 5.1 FORMAT "%5.3" ECU_ADDRESS 0x8039D4 /end MEASUREMENT
/begin MEASUREMENT c_nmaxk "Z‰hler f¸r Maximaldrehzahl" UWORD DC_TIME_20MS_U16 1 100 0 20 FORMAT "%6.3" ECU_ADDRESS 0x803438 /end MEASUREMENT
/begin MEASUREMENT DashpChrgIntv_Mode "" UBYTE DC_FLAG_U8 1 100 0 1 BIT_MASK 0x1 FORMAT "%5.3" ECU_ADDRESS 0x8038E1 /end MEASUREMENT
/begin MEASUREMENT DashpDsable_Mode "" UBYTE DC_FLAG_U8 1 100 0 1 BIT_MASK 0x1 FORMAT "%5.3" ECU_ADDRESS 0x8038DE /end MEASUREMENT
/begin MEASUREMENT DashpLTCTime_Coeff "" UBYTE DC_FKT128 1 100 0 1.99219 FORMAT "%5.3" ECU_ADDRESS 0x8038E4 /end MEASUREMENT
/begin MEASUREMENT DashpLTCTrq_Coeff "" UBYTE DC_FKT128 1 100 0 1.99219 FORMAT "%5.3" ECU_ADDRESS 0x8038E5 /end MEASUREMENT
/begin MEASUREMENT DashpLTC_RelLoadLimSprd_Mode "" UBYTE DC_FLAG_U8 1 100 0 1 BIT_MASK 0x1 FORMAT "%5.3" ECU_ADDRESS 0x8038DD /end MEASUREMENT
/begin MEASUREMENT Dashp_DeltaTrq "" SWORD DC_TRQ_S16 1 100 -2048 2047.94 FORMAT "%8.3" ECU_ADDRESS 0x80331C /end MEASUREMENT
/begin MEASUREMENT Dashp_Mode "" UBYTE DC_FLAG_U8 1 100 0 1 BIT_MASK 0x1 FORMAT "%5.3" ECU_ADDRESS 0x8038E2 /end MEASUREMENT
/begin MEASUREMENT Dashp_Trq "" SWORD DC_TRQ_S16 1 100 0 800 FORMAT "%8.4" ECU_ADDRESS 0x803310 /end MEASUREMENT
/begin MEASUREMENT DFSO_Mode "alle Einspritzventile abgeschaltet" UBYTE DEZ 1 100 0 255 FORMAT "%5.1" ECU_ADDRESS 0x800DBD /end MEASUREMENT
/begin MEASUREMENT dlwsl_w "berechnete Lenkwinkelgeschwindigkeit" SWORD dlw_sw_q0p04375 1 100 -1434.04 1434 FORMAT "%8.3" ECU_ADDRESS 0x8018FE /end MEASUREMENT
/begin MEASUREMENT dlwsu_w "Lenkwinkelgeschwindigkeit" SWORD dlw_sw_q0p04375 1 100 -1434.04 1434 FORMAT "%8.3" ECU_ADDRESS 0x801900 /end MEASUREMENT
/begin MEASUREMENT dmaufr_w "Delta Aufregelmoment" UWORD rel_uw_b100 1 100 0 99.9985 FORMAT "%8.5" ECU_ADDRESS 0x8019A6 /end MEASUREMENT
/begin MEASUREMENT dmdwan_w "" UWORD rel_uw_b200 1 100 0 199.997 FORMAT "%8.4" ECU_ADDRESS 0x801916 /end MEASUREMENT
/begin MEASUREMENT dmnmxi_w "Drehmoment aus Integralanteil der NMAX-Regelung" UWORD rel_uw_b100 1 100 0 99.9985 FORMAT "%8.5" ECU_ADDRESS 0x80184E /end MEASUREMENT
/begin MEASUREMENT dmnmxp_w "Drehmoment aus Proportionalanteil der NMAX-Regelung" SWORD rel_sw_b100 1 100 -100 99.9969 FORMAT "%8.4" ECU_ADDRESS 0x801850 /end MEASUREMENT
/begin MEASUREMENT dmrac "Reservemoment f¸r AC-Kompressor" UBYTE rel_ub_b99p6 1 100 0 99.6094 FORMAT "%5.2" ECU_ADDRESS 0x80127D /end MEASUREMENT
/begin MEASUREMENT dmrdnw_w "Momentenreserve f¸r Diagnose ¸ber Tester" UWORD rel_uw_b100 1 100 0 99.9985 FORMAT "%8.5" ECU_ADDRESS 0x8005E4 /end MEASUREMENT
/begin MEASUREMENT dmrlf "Momentreserve f¸r L¸fter" UBYTE rel_ub_b99p6 1 100 0 99.6094 FORMAT "%5.2" ECU_ADDRESS 0x80127E /end MEASUREMENT
/begin MEASUREMENT dmrlf1 "Momentreserve L¸fterstufe 1" UBYTE rel_ub_b99p6 1 100 0 99.6094 FORMAT "%5.2" ECU_ADDRESS 0x80127F /end MEASUREMENT
/begin MEASUREMENT dmrlf2 "Reservemoment L¸fterstufe 2" UBYTE rel_ub_b99p6 1 100 0 99.6094 FORMAT "%5.2" ECU_ADDRESS 0x801280 /end MEASUREMENT
/begin MEASUREMENT dmrlws_w "Momentreserve f¸r Servo-Lenkung" UWORD rel_uw_b100 1 100 0 99.9985 FORMAT "%8.5" ECU_ADDRESS 0x801902 /end MEASUREMENT
/begin MEASUREMENT dmrwan "Momentreserve f¸r Drehmomentaufnahme des Wandlers" UBYTE rel_ub_b99p6 1 100 0 99.6094 FORMAT "%5.2" ECU_ADDRESS 0x801282 /end MEASUREMENT
/begin MEASUREMENT dnsi_w "Differenz zwischen Soll- und Ist-Motordrehzahl" SWORD nmot_sw_q0p25 1 100 -8192 8191.75 FORMAT "%8.3" ECU_ADDRESS 0x801852 /end MEASUREMENT
/begin MEASUREMENT dnturb_w "Turbinendrehzahldifferenz des Wandlers" SWORD nmot_q0p1453421 1 100 -4762.57 4762.42 FORMAT "%8.3" ECU_ADDRESS 0x801918 /end MEASUREMENT
/begin MEASUREMENT DrCyc_Mode "" UBYTE DEZ 1 100 0 255 FORMAT "%5.1" ECU_ADDRESS 0x800DBE /end MEASUREMENT
/begin MEASUREMENT DrvrInput_APPDrOff_Fctr "" UWORD DC_FCTR_32768_U16 1 100 0 1.99997 FORMAT "%7.5" ECU_ADDRESS 0x803374 /end MEASUREMENT
/begin MEASUREMENT DrvrInput_APP_Fctr "" UWORD DC_FCTR_32768_U16 1 100 0 1.99997 FORMAT "%7.5" ECU_ADDRESS 0x803370 /end MEASUREMENT
/begin MEASUREMENT DrvrInput_DrOff_Effy "" UWORD DC_FCTR_32768_U16 1 100 0 1.99997 FORMAT "%7.5" ECU_ADDRESS 0x803376 /end MEASUREMENT
/begin MEASUREMENT DrvrInput_IndDiffTrq "" SWORD DC_TRQ_S16 1 100 -2048 2047.94 FORMAT "%8.3" ECU_ADDRESS 0x80336E /end MEASUREMENT
/begin MEASUREMENT DrvrInput_IndTrq_Req "" SWORD DC_TRQ_S16 1 100 -2048 2047.94 FORMAT "%8.3" ECU_ADDRESS 0x803372 /end MEASUREMENT
/begin MEASUREMENT DrvrInput_TrqLim_Actv "" UBYTE DC_FLAG_U8 1 100 0 1 BIT_MASK 0x1 FORMAT "%5.3" ECU_ADDRESS 0x803957 /end MEASUREMENT
/begin MEASUREMENT DrvrInput_TrqLim_ActvTrgr "" UBYTE DC_FLAG_U8 1 100 0 1 BIT_MASK 0x1 FORMAT "%5.3" ECU_ADDRESS 0x803956 /end MEASUREMENT
/begin MEASUREMENT DrvrInput_TrqLim_NomVal "" SWORD DC_TRQ_S16 1 100 -2048 2047.94 FORMAT "%8.3" ECU_ADDRESS 0x803366 /end MEASUREMENT
/begin MEASUREMENT DrvrInput_TrqLim_Req "" SWORD DC_TRQ_S16 1 100 -2048 2047.94 FORMAT "%8.3" ECU_ADDRESS 0x803360 /end MEASUREMENT
/begin MEASUREMENT DrvrInput_TrqLim_Trgr_Mode "" UBYTE DC_FLAG_U8 1 100 0 1 BIT_MASK 0x1 FORMAT "%5.3" ECU_ADDRESS 0x80395C /end MEASUREMENT
/begin MEASUREMENT DrvrInput_Trq_Req "" SWORD DC_TRQ_S16 1 100 -2048 2047.94 FORMAT "%8.3" ECU_ADDRESS 0x80336A /end MEASUREMENT
/begin MEASUREMENT Drvr_HighPwr_Mode "" UBYTE DC_FLAG_U8 1 100 0 1 BIT_MASK 0x1 FORMAT "%5.3" ECU_ADDRESS 0x8039AE /end MEASUREMENT
/begin MEASUREMENT Drvr_MaxPwr_Mode "" UBYTE DC_FLAG_U8 1 100 0 1 BIT_MASK 0x1 FORMAT "%5.3" ECU_ADDRESS 0x8039AF /end MEASUREMENT
/begin MEASUREMENT dwnwabga_w "Max-Winkel zur Berechnung der Sollwert‰nderungsbegrenzung Auslass Nockenwelle" UWORD kw_q0p0078 1 100 0 511.992 FORMAT "%8.4" ECU_ADDRESS 0x80153E /end MEASUREMENT
/begin MEASUREMENT dwnwamxa_w "Max-Winkel zur Abschaltung der Sollwert‰nderungsbegrenzung Auslass Nockenwelle" UWORD kw_q0p0078 1 100 0 511.992 FORMAT "%8.4" ECU_ADDRESS 0x801540 /end MEASUREMENT
/begin MEASUREMENT dwnwasa2_w "Abstand Auslaﬂnockenwelle 2 zur Sollposition" SWORD kw_sw_q0p0078 1 100 -256 255.992 FORMAT "%8.4" ECU_ADDRESS 0x8014F6 /end MEASUREMENT
/begin MEASUREMENT dwnwasa_w "Abstand Auslaﬂnockenwelle zur Sollposition" SWORD kw_sw_q0p0078 1 100 -256 255.992 FORMAT "%8.4" ECU_ADDRESS 0x8014F8 /end MEASUREMENT
/begin MEASUREMENT dwnwase2_w "Abstand Einlaﬂnockenwelle 2 zur Sollposition" SWORD kw_sw_q0p0078 1 100 -256 255.992 FORMAT "%8.4" ECU_ADDRESS 0x8014FA /end MEASUREMENT
/begin MEASUREMENT dwnwase_w "Abstand Einlaﬂnockenwelle zur Sollposition" SWORD kw_sw_q0p0078 1 100 -256 255.992 FORMAT "%8.4" ECU_ADDRESS 0x8014FC /end MEASUREMENT
/begin MEASUREMENT dwnwpasa_w "Positionsabweichung bei 2Bank Nockenwelle f¸r Gleichlaufaktivierung Auslaﬂ" SWORD kw_sw_q0p0078 1 100 -256 255.992 FORMAT "%8.4" ECU_ADDRESS 0x8014FE /end MEASUREMENT
/begin MEASUREMENT dwnwpase_w "Positionsabweichung bei 2Bank Nockenwelle f¸r Gleichlaufaktivierung Einlaﬂ" SWORD kw_sw_q0p0078 1 100 -256 255.992 FORMAT "%8.4" ECU_ADDRESS 0x801500 /end MEASUREMENT
/begin MEASUREMENT dwnwstpa_w "Winkelabweichung Einlaﬂnockenwelle f¸r Verstellstopp Auslaﬂ NW" SWORD kw_sw_q0p0078 1 100 -256 255.992 FORMAT "%8.4" ECU_ADDRESS 0x801502 /end MEASUREMENT
/begin MEASUREMENT dzws "Delta Z¸ndwinekl zwischen zwopt und zwsol" SBYTE zw_sb_q0p75 1 100 -96 95.25 FORMAT "%5.2" ECU_ADDRESS 0x8012C6 /end MEASUREMENT
/begin MEASUREMENT ECTIn "Linearisierte Motortemp., Eingang K¸hlkreislauf" SWORD temp_sw_q1p25Em1 1 100 -4096 4095.88 FORMAT "%8.3" ECU_ADDRESS 0x800DEC /end MEASUREMENT
/begin MEASUREMENT ECTOut "Linearisierte Motortemp., Ausgang K¸hlkreislauf" SWORD temp_sw_q1p25Em1 1 100 -4096 4095.88 FORMAT "%8.3" ECU_ADDRESS 0x800DEE /end MEASUREMENT
/begin MEASUREMENT EfficDP_HighLim "" UBYTE DEZ 1 100 0 255 FORMAT "%5.1" ECU_ADDRESS 0x800DBF /end MEASUREMENT
/begin MEASUREMENT EfficDP_LowLim "" UBYTE DEZ 1 100 0 255 FORMAT "%5.1" ECU_ADDRESS 0x800DC0 /end MEASUREMENT
/begin MEASUREMENT Effy_IgnAngl "" UWORD dez_uw_q3p052Em5 1 100 0 1.99997 FORMAT "%8.6" ECU_ADDRESS 0x800DF0 /end MEASUREMENT
/begin MEASUREMENT Effy_IgnAnglMin "" UWORD dez_uw_q3p052Em5 1 100 0 1.99997 FORMAT "%8.6" ECU_ADDRESS 0x800DF2 /end MEASUREMENT
/begin MEASUREMENT EmergAirOp_Mode_Req "" UBYTE DEZ 1 100 0 255 FORMAT "%5.1" ECU_ADDRESS 0x800DC1 /end MEASUREMENT
/begin MEASUREMENT EMSL_Mode "" UBYTE DC_FLAG_U8 1 100 0 1 BIT_MASK 0x1 FORMAT "%5.3" ECU_ADDRESS 0x8039D5 /end MEASUREMENT
/begin MEASUREMENT EMSL_Mode_Req "" UBYTE DC_FLAG_U8 1 100 0 1 BIT_MASK 0x1 FORMAT "%5.3" ECU_ADDRESS 0x8039D6 /end MEASUREMENT
/begin MEASUREMENT EngEmergOp_Spd_Req "" SWORD nmot_sw_q0p5 1 100 -16384 16383.5 FORMAT "%8.2" ECU_ADDRESS 0x800DF4 /end MEASUREMENT
/begin MEASUREMENT Eng_MaxSpd "" SWORD DC_ROTSPD_S16 1 100 0 8000 FORMAT "%7.2" ECU_ADDRESS 0x80343A /end MEASUREMENT
/begin MEASUREMENT Eng_RelLoad "" UWORD rel_sw_q1p562Em2 1 100 0 1023.98 FORMAT "%8.3" ECU_ADDRESS 0x800DF6 /end MEASUREMENT
/begin MEASUREMENT Eng_ResTrq_Req "" SWORD DC_TRQ_S16 1 100 -2048 2047.94 FORMAT "%8.3" ECU_ADDRESS 0x80341A /end MEASUREMENT
/begin MEASUREMENT Eng_Run_Mode "" UBYTE DEZ 1 100 0 255 FORMAT "%5.1" ECU_ADDRESS 0x800DC2 /end MEASUREMENT
/begin MEASUREMENT Eng_Spd_Unfiltd "" SWORD nmot_sw_q0p5 1 100 -16384 16383.5 FORMAT "%8.2" ECU_ADDRESS 0x80194E /end MEASUREMENT
/begin MEASUREMENT Eng_Trq "effektives Istmoment" SWORD md_sw_q0p0625 1 100 -2048 2047.94 FORMAT "%8.3" ECU_ADDRESS 0x800DF8 /end MEASUREMENT
/begin MEASUREMENT Eng_TrqMax "" SWORD md_sw_q0p0625 1 100 -2048 2047.94 FORMAT "%8.3" ECU_ADDRESS 0x800DFA /end MEASUREMENT
/begin MEASUREMENT Eng_TrqMaxKC "" SWORD md_sw_q0p0625 1 100 -2048 2047.94 FORMAT "%8.3" ECU_ADDRESS 0x800DFC /end MEASUREMENT
/begin MEASUREMENT Eng_TrqMin "" SWORD md_sw_q0p0625 1 100 -2048 2047.94 FORMAT "%8.3" ECU_ADDRESS 0x800DFE /end MEASUREMENT
/begin MEASUREMENT Eng_Trq_Loss "" SWORD md_sw_q0p0625 1 100 -2048 2047.94 FORMAT "%8.3" ECU_ADDRESS 0x800E00 /end MEASUREMENT
/begin MEASUREMENT Eng_Trq_Req "" SWORD DC_TRQ_S16 1 100 -2048 2047.94 FORMAT "%8.3" ECU_ADDRESS 0x8032FC /end MEASUREMENT
/begin MEASUREMENT ErrHFM_Mode "" UBYTE DEZ 1 100 0 255 FORMAT "%5.1" ECU_ADDRESS 0x800DC3 /end MEASUREMENT
/begin MEASUREMENT Err_FanMalf "" UBYTE DEZ 1 100 0 255 FORMAT "%5.1" ECU_ADDRESS 0x800DC4 /end MEASUREMENT
/begin MEASUREMENT esst_smo08mfub "" ULONG dez 1 100 0 4.29497e+009 FORMAT "%13.2" ECU_ADDRESS 0x8020C8 /end MEASUREMENT
/begin MEASUREMENT esst_snm06koub "" ULONG dez 1 100 0 4.29497e+009 FORMAT "%13.2" ECU_ADDRESS 0x8020E8 /end MEASUREMENT
/begin MEASUREMENT esst_snm08mfub "" ULONG dez 1 100 0 4.29497e+009 FORMAT "%13.2" ECU_ADDRESS 0x8020CC /end MEASUREMENT
/begin MEASUREMENT esst_sns04mdub "" ULONG dez 1 100 0 4.29497e+009 FORMAT "%13.2" ECU_ADDRESS 0x8020B0 /end MEASUREMENT
/begin MEASUREMENT esst_srl06koub "" ULONG dez 1 100 0 4.29497e+009 FORMAT "%13.2" ECU_ADDRESS 0x8020EC /end MEASUREMENT
/begin MEASUREMENT esst_sta06llub "" ULONG dez 1 100 0 4.29497e+009 FORMAT "%13.2" ECU_ADDRESS 0x8020F0 /end MEASUREMENT
/begin MEASUREMENT esst_stm08mfub "" ULONG dez 1 100 0 4.29497e+009 FORMAT "%13.2" ECU_ADDRESS 0x8020D0 /end MEASUREMENT
/begin MEASUREMENT esst_stw08mdub "" ULONG dez 1 100 0 4.29497e+009 FORMAT "%13.2" ECU_ADDRESS 0x8020F4 /end MEASUREMENT
/begin MEASUREMENT esst_swp08mfub "" ULONG dez 1 100 0 4.29497e+009 FORMAT "%13.2" ECU_ADDRESS 0x8020D4 /end MEASUREMENT
/begin MEASUREMENT etazws "Sollz¸ndwinkelwirkungsgrad" UBYTE rel_ub_b127p5 1 100 0 127.5 FORMAT "%5.1" ECU_ADDRESS 0x8012C7 /end MEASUREMENT
/begin MEASUREMENT ETCLine_Slct "" UBYTE DC_DEZ 1 100 0 255 FORMAT "%5.1" ECU_ADDRESS 0x8039B0 /end MEASUREMENT
/begin MEASUREMENT FanMalf_Mode "" UBYTE DEZ 1 100 0 255 FORMAT "%5.1" ECU_ADDRESS 0x800DC5 /end MEASUREMENT
/begin MEASUREMENT FirstStrt_Mode "" UBYTE DEZ 1 100 0 255 FORMAT "%5.1" ECU_ADDRESS 0x800DC6 /end MEASUREMENT
/begin MEASUREMENT fnwaa "Faktor Wichtung NW-Auslaﬂ" UBYTE fak_ub_b1 1 100 0 0.996094 ECU_ADDRESS 0x8010FD /end MEASUREMENT
/begin MEASUREMENT fnwea "Faktor Wichtung NW-Einlaﬂ" UBYTE fak_ub_b1 1 100 0 0.996094 ECU_ADDRESS 0x8010FE /end MEASUREMENT
/begin MEASUREMENT fnwwarma "Faktor Nockenwellensollwinkel ‹bergang kalt -> Warmkennfelder Auslaﬂ" UBYTE fak_ub_b2 1 100 0 1.99219 FORMAT "%5.3" ECU_ADDRESS 0x8005EA /end MEASUREMENT
/begin MEASUREMENT FTBU_Mode "" UBYTE DEZ 1 100 0 255 FORMAT "%5.1" ECU_ADDRESS 0x800DC7 /end MEASUREMENT
/begin MEASUREMENT Gear_LowLim_ReqDrvrInput "" UBYTE DC_CNTR_U8 1 100 0 255 FORMAT "%5.1" ECU_ADDRESS 0x803955 /end MEASUREMENT
/begin MEASUREMENT Gear_LowLim_ReqDrvrInput_Mode "" UBYTE DC_FLAG_U8 1 100 0 1 BIT_MASK 0x1 FORMAT "%5.3" ECU_ADDRESS 0x803958 /end MEASUREMENT
/begin MEASUREMENT IdleSpd_Req "" SWORD nmot_sw_q0p5 1 100 -16384 16383.5 FORMAT "%8.2" ECU_ADDRESS 0x800E02 /end MEASUREMENT
/begin MEASUREMENT Idle_ModeEnabl_Req "" UBYTE DC_FLAG_U8 1 100 0 1 BIT_MASK 0x1 FORMAT "%5.3" ECU_ADDRESS 0x803961 /end MEASUREMENT
/begin MEASUREMENT Idle_Mode_Req "" UBYTE DC_FLAG_U8 1 100 0 1 BIT_MASK 0x1 FORMAT "%5.3" ECU_ADDRESS 0x803963 /end MEASUREMENT
/begin MEASUREMENT IgnSwRun_Mode "" UBYTE DEZ 1 100 0 255 FORMAT "%5.1" ECU_ADDRESS 0x800DC8 /end MEASUREMENT
/begin MEASUREMENT IntkAir_Temp "" SWORD temp_sw_q1p25Em1 1 100 -4096 4095.88 FORMAT "%8.3" ECU_ADDRESS 0x800E04 /end MEASUREMENT
/begin MEASUREMENT IntkAir_Temp_CAN "" SWORD temp_sw_q1p25Em1 1 100 -4096 4095.88 FORMAT "%8.3" ECU_ADDRESS 0x800E06 /end MEASUREMENT
/begin MEASUREMENT ISC_TrqI_Req "" SWORD md_sw_q0p0625 1 100 -2048 2047.94 FORMAT "%8.3" ECU_ADDRESS 0x800E08 /end MEASUREMENT
/begin MEASUREMENT ISC_Trq_Req "" SWORD md_sw_q0p0625 1 100 -2048 2047.94 FORMAT "%8.3" ECU_ADDRESS 0x800E0A /end MEASUREMENT
/begin MEASUREMENT kinmx "Verst‰rkung Integralanteil der NMAX-Regelung" UBYTE relnmot_q0p01907 1 100 0 4.86374 FORMAT "%5.3" ECU_ADDRESS 0x801245 /end MEASUREMENT
/begin MEASUREMENT LH_Gear_LowLim_Req "" UBYTE rel_ub_q1 1 100 0 255 FORMAT "%5.1" ECU_ADDRESS 0x800DC9 /end MEASUREMENT
/begin MEASUREMENT LTCChrgIntv_Mode "" UBYTE DC_FLAG_U8 1 100 0 1 BIT_MASK 0x1 FORMAT "%5.3" ECU_ADDRESS 0x8038DF /end MEASUREMENT
/begin MEASUREMENT LTC_Cntr_Mode "" UBYTE DC_FLAG_U8 1 100 0 1 BIT_MASK 0x1 FORMAT "%5.3" ECU_ADDRESS 0x8038E9 /end MEASUREMENT
/begin MEASUREMENT LTC_Coef "" UBYTE DEZ 1 100 0 255 FORMAT "%5.1" ECU_ADDRESS 0x800DCA /end MEASUREMENT
/begin MEASUREMENT LTC_Mode "" UBYTE DC_FLAG_U8 1 100 0 1 BIT_MASK 0x1 FORMAT "%5.3" ECU_ADDRESS 0x8038E3 /end MEASUREMENT
/begin MEASUREMENT LTC_Time1 "" UBYTE DC_TQ10 1 100 0 2.55 FORMAT "%5.3" ECU_ADDRESS 0x8038EC /end MEASUREMENT
/begin MEASUREMENT LTC_Time2 "" UBYTE DC_TQ10 1 100 0 2.55 FORMAT "%5.3" ECU_ADDRESS 0x8038EB /end MEASUREMENT
/begin MEASUREMENT LTC_Trig_Mode "" UBYTE DC_FLAG_U8 1 100 0 1 BIT_MASK 0x1 FORMAT "%5.3" ECU_ADDRESS 0x8038ED /end MEASUREMENT
/begin MEASUREMENT MAF "" UWORD m_ub_q1p0 1 100 0 65535 FORMAT "%8.2" ECU_ADDRESS 0x800E0C /end MEASUREMENT
/begin MEASUREMENT mdatxm_w "Drehmomentaufnahme des Wandlers bei B_fs = false" UWORD rel_uw_b200 1 100 0 199.997 FORMAT "%8.4" ECU_ADDRESS 0x80191A /end MEASUREMENT
/begin MEASUREMENT mddlws_w "Lastmoment abh‰ngig vom Lenkwinkelgradient" UWORD rel_uw_b100 1 100 0 99.9985 FORMAT "%8.5" ECU_ADDRESS 0x801904 /end MEASUREMENT
/begin MEASUREMENT mdel_w "Momentenaufnahme elektrische Verbraucher" UWORD rel_uw_b100 1 100 0 99.9985 FORMAT "%8.5" ECU_ADDRESS 0x800DB0 /end MEASUREMENT
/begin MEASUREMENT mdgen_w "Generatormoment" UWORD rel_uw_b100 1 100 0 99.9985 FORMAT "%8.5" ECU_ADDRESS 0x801906 /end MEASUREMENT
/begin MEASUREMENT mdkoini "Kompressormoment beim Einschalten" UBYTE rel_ub_b99p6 1 100 0 99.6094 FORMAT "%5.2" ECU_ADDRESS 0x800DAC /end MEASUREMENT
/begin MEASUREMENT mdko_w "Momentenaufnahme Klimakompressor" UWORD rel_uw_b100 1 100 0 99.9985 FORMAT "%8.5" ECU_ADDRESS 0x801908 /end MEASUREMENT
/begin MEASUREMENT mdlfs_w "Momentenaufnahme des Motorl¸fters" UWORD rel_uw_b100 1 100 0 99.9985 FORMAT "%8.5" ECU_ADDRESS 0x80190A /end MEASUREMENT
/begin MEASUREMENT mdlws_w "Lastmoment abh‰ngig vom Lenkwinkel" UWORD rel_uw_b100 1 100 0 99.9985 FORMAT "%8.5" ECU_ADDRESS 0x80190C /end MEASUREMENT
/begin MEASUREMENT mdslpf_w "Momentenaufnahme der Sekund‰rluftpumpe" UWORD rel_uw_b100 1 100 0 99.9985 FORMAT "%8.5" ECU_ADDRESS 0x80190E /end MEASUREMENT
/begin MEASUREMENT mdswl_w "Verbrauchermoment: Servolenkung" UWORD rel_uw_b100 1 100 0 99.9985 FORMAT "%8.5" ECU_ADDRESS 0x801910 /end MEASUREMENT
/begin MEASUREMENT mdverb "Momentenbedarf der Nebenaggregate" UBYTE rel_ub_b100 1 100 0 99.6094 FORMAT "%5.2" ECU_ADDRESS 0x801281 /end MEASUREMENT
/begin MEASUREMENT mdverbmx_w "Maximales Motor-Verlustmoment" UWORD rel_uw_b100 1 100 0 99.9985 FORMAT "%8.5" ECU_ADDRESS 0x8018AA /end MEASUREMENT
/begin MEASUREMENT mdverb_w "Momentenbedarf der Nebenaggregate" UWORD rel_uw_b100 1 100 0 99.9985 FORMAT "%8.5" ECU_ADDRESS 0x801912 /end MEASUREMENT
/begin MEASUREMENT mdwancb_w "Drehmomentaufnahme des Wandlers ¸ber CAN nach Begrenzung" UWORD rel_uw_b200 1 100 0 199.997 FORMAT "%8.4" ECU_ADDRESS 0x80191C /end MEASUREMENT
/begin MEASUREMENT mdwanvf_w "Drehmomentaufnahme des Wandlers vor Filterung" UWORD rel_uw_b200 1 100 0 199.997 FORMAT "%8.4" ECU_ADDRESS 0x80191E /end MEASUREMENT
/begin MEASUREMENT mdwan_w "Drehmomentaufnahme des Wandlers" UWORD rel_uw_b200 1 100 0 199.997 FORMAT "%8.4" ECU_ADDRESS 0x801920 /end MEASUREMENT
/begin MEASUREMENT MfDiagDsabl_Mode "" UBYTE DEZ 1 100 0 255 FORMAT "%5.1" ECU_ADDRESS 0x800DCB /end MEASUREMENT
/begin MEASUREMENT mhgb "Md-Soll aus VMAX (plausibilisiert)" SWORD DC_TRQ_S16 1 100 -100 500 FORMAT "%8.4" ECU_ADDRESS 0x80343C /end MEASUREMENT
/begin MEASUREMENT mhgbr "Reduziermoment im HGB" SWORD DC_TRQ_S16 1 100 -100 500 FORMAT "%8.4" ECU_ADDRESS 0x80343E /end MEASUREMENT
/begin MEASUREMENT mhgbv "HGB-Momentenvorhalt" SWORD DC_TRQ_S16 1 100 -100 500 FORMAT "%8.4" ECU_ADDRESS 0x803440 /end MEASUREMENT
/begin MEASUREMENT mhgb_i "HGB-Momentenvorgabe, I-Anteil" SWORD DC_TRQ_S16 1 100 -100 500 FORMAT "%8.4" ECU_ADDRESS 0x803442 /end MEASUREMENT
/begin MEASUREMENT mhgb_p "HGB-Momentenvorgabe, P-Anteil" SWORD DC_TRQ_S16 1 100 -100 500 FORMAT "%8.4" ECU_ADDRESS 0x803444 /end MEASUREMENT
/begin MEASUREMENT MIL "Abk¸rzung f¸r Malfunction Indication Light" UBYTE DEZ 1 100 0 255 FORMAT "%5.1" ECU_ADDRESS 0x800DCC /end MEASUREMENT
/begin MEASUREMENT minmxl_w "indiziertes Soll-Moment f¸r NMAX-Begrenzung f¸r Luftadaptation" UWORD rel_uw_b100 1 100 0 99.9985 FORMAT "%8.5" ECU_ADDRESS 0x801854 /end MEASUREMENT
/begin MEASUREMENT minmx_w "Momentenanforderung der Drehzahlbegrenzung" UWORD rel_uw_b100 1 100 0 99.9985 FORMAT "%8.5" ECU_ADDRESS 0x801856 /end MEASUREMENT
/begin MEASUREMENT mist_roh "Ist-Moment ohne Einspritzventilausblendung" SWORD DC_TRQ_S16 1 100 -100 500 FORMAT "%8.4" ECU_ADDRESS 0x803446 /end MEASUREMENT
/begin MEASUREMENT miszullb_w "Maximal zul‰ssiges indiziertes Moment f¸r Luftpfad (begrenzt)" UWORD rel_uw_b100 1 100 0 99.9985 FORMAT "%8.5" ECU_ADDRESS 0x8018AC /end MEASUREMENT
/begin MEASUREMENT miszull_w "Maximal zul‰ssiges indiziertes Moment f¸r Luftpfad" UWORD rel_uw_b100 1 100 0 99.9985 FORMAT "%8.5" ECU_ADDRESS 0x8018AE /end MEASUREMENT
/begin MEASUREMENT miszul_w "Maximal zul‰ssiges indiziertes Moment" UWORD rel_uw_b100 1 100 0 99.9985 FORMAT "%8.5" ECU_ADDRESS 0x8018B0 /end MEASUREMENT
/begin MEASUREMENT mizufil_w "Zul‰ssiges indiziertes Moment nach Filter" UWORD rel_uw_b100 1 100 0 99.9985 FORMAT "%8.5" ECU_ADDRESS 0x8018B2 /end MEASUREMENT
/begin MEASUREMENT mizuofil "Zul‰ssiges indiziertes Moment ohne Filter" UBYTE rel_ub_b99p6 1 100 0 99.6094 FORMAT "%5.2" ECU_ADDRESS 0x801254 /end MEASUREMENT
/begin MEASUREMENT mizutmp_w "Temperaturabh‰ngiger Anteil des zul‰ssigen Moments" UWORD rel_uw_b100 1 100 0 99.9985 FORMAT "%8.5" ECU_ADDRESS 0x8018B4 /end MEASUREMENT
/begin MEASUREMENT mizuvfil "Zul‰ssiges indiziertes Moment vor Filter" UBYTE rel_ub_b99p6 1 100 0 99.6094 FORMAT "%5.2" ECU_ADDRESS 0x801255 /end MEASUREMENT
/begin MEASUREMENT mngb "Vorgabemoment aus Drehzahlregelung" SWORD DC_TRQ_S16 1 100 -100 500 FORMAT "%8.4" ECU_ADDRESS 0x803448 /end MEASUREMENT
/begin MEASUREMENT mngbr "Reduziermoment im NGB" SWORD DC_TRQ_S16 1 100 -2048 2047.94 FORMAT "%8.3" ECU_ADDRESS 0x80344A /end MEASUREMENT
/begin MEASUREMENT mngbr_8 "Reduziermoment im NGB auf Bytebasis" UBYTE DC_MMQ8_1024 1 100 0 1020 FORMAT "%5.0" ECU_ADDRESS 0x8039D7 /end MEASUREMENT
/begin MEASUREMENT mngbv "NGB-Momentenvorhalt" SWORD DC_TRQ_S16 1 100 -2048 2047.94 FORMAT "%8.3" ECU_ADDRESS 0x80344C /end MEASUREMENT
/begin MEASUREMENT mngb_d "NGB-Momentenvorgabe, D-Anteil" SWORD DC_TRQ_S16 1 100 -2048 2047.94 FORMAT "%8.3" ECU_ADDRESS 0x80344E /end MEASUREMENT
/begin MEASUREMENT mngb_i "NGB-Momentenvorgabe, I-Anteil" SWORD DC_TRQ_S16 1 100 -2048 2047.94 FORMAT "%8.3" ECU_ADDRESS 0x803450 /end MEASUREMENT
/begin MEASUREMENT mngb_p "NGB-Momentenvorgabe, P-Anteil" SWORD DC_TRQ_S16 1 100 -2048 2047.94 FORMAT "%8.3" ECU_ADDRESS 0x803452 /end MEASUREMENT
/begin MEASUREMENT ModelRange_Ix "" UBYTE DC_CNTR_U8 1 100 0 255 FORMAT "%5.1" ECU_ADDRESS 0x803954 /end MEASUREMENT
/begin MEASUREMENT Mon_SFSO_Mode "" UBYTE DEZ 1 100 0 255 FORMAT "%5.1" ECU_ADDRESS 0x800DCD /end MEASUREMENT
/begin MEASUREMENT mredwf "WF-Momentenvorhalt" SWORD DC_TRQ_S16 1 100 -2048 2047.94 FORMAT "%8.3" ECU_ADDRESS 0x803454 /end MEASUREMENT
/begin MEASUREMENT mredwf_8 "Reduziermoment im WF auf Bytebasis" SBYTE DC_MMQ1_S8DB 1 100 -128 127 ECU_ADDRESS 0x8039D8 /end MEASUREMENT
/begin MEASUREMENT MSL_Mode_Req "" UBYTE DC_FLAG_U8 1 100 0 1 BIT_MASK 0x1 FORMAT "%5.3" ECU_ADDRESS 0x8039D9 /end MEASUREMENT
/begin MEASUREMENT MSL_Stop "" UBYTE DC_FLAG_U8 1 100 0 1 BIT_MASK 0x1 FORMAT "%5.3" ECU_ADDRESS 0x8039DA /end MEASUREMENT
/begin MEASUREMENT MSL_Trq_Req "" SWORD DC_TRQ_S16 1 100 -100 500 FORMAT "%8.4" ECU_ADDRESS 0x803456 /end MEASUREMENT
/begin MEASUREMENT mwf "Vorgabemoment aus Wandlerschutzregelung" SWORD DC_TRQ_S16 1 100 -100 500 FORMAT "%8.4" ECU_ADDRESS 0x803458 /end MEASUREMENT
/begin MEASUREMENT mwf_d "WF-Momentenvorgabe, D-Anteil" SWORD DC_TRQ_S16 1 100 -2048 2047.94 FORMAT "%8.3" ECU_ADDRESS 0x80345A /end MEASUREMENT
/begin MEASUREMENT mwf_i "WF-Momentenvorgabe, I-Anteil" SWORD DC_TRQ_S16 1 100 -2048 2047.94 FORMAT "%8.3" ECU_ADDRESS 0x80345C /end MEASUREMENT
/begin MEASUREMENT mwf_p "WF-Momentenvorgabe, P-Anteil" SWORD DC_TRQ_S16 1 100 -2048 2047.94 FORMAT "%8.3" ECU_ADDRESS 0x80345E /end MEASUREMENT
/begin MEASUREMENT ndisc "Drehzahldifferenz zur Hˆchstdrehzahl" SWORD DC_ROTSPD_S16 1 100 -3500 3500 FORMAT "%7.2" ECU_ADDRESS 0x803460 /end MEASUREMENT
/begin MEASUREMENT ndiscwf "Drehzahldifferenz zur WF-Drehzahl" SWORD DC_ROTSPD_S16 1 100 -7000 7000 FORMAT "%7.2" ECU_ADDRESS 0x803462 /end MEASUREMENT
/begin MEASUREMENT ng_nhgb "gefilterter Drehzahlgradient fuer Drehzahlbegrenzung" SWORD DC_NGRDQ10_S16DB 1 100 -200000 200000 FORMAT "%6.0" ECU_ADDRESS 0x803464 /end MEASUREMENT
/begin MEASUREMENT nmaxga_w "Maximal zul‰ssige gangabh‰ngige Motordrehzahl" UWORD nmot_uw_q0p25 1 100 0 16383.8 FORMAT "%8.2" ECU_ADDRESS 0x801858 /end MEASUREMENT
/begin MEASUREMENT nmaxramp "Abrampung der Maximaldrehzahl" UWORD DC_NQ1_W 1 100 0 8000 FORMAT "%8.3" ECU_ADDRESS 0x803466 /end MEASUREMENT
/begin MEASUREMENT nmax_eff "aktuelle Maximal-Drehzahl" SWORD DC_ROTSPD_S16 1 100 0 8000 FORMAT "%7.2" ECU_ADDRESS 0x803468 /end MEASUREMENT
/begin MEASUREMENT nmax_w "Drehzahlgrenze ohne Ber¸cksichtigung von Drosselklappen-Fehlern" UWORD nmot_uw_q0p25 1 100 0 16383.8 FORMAT "%8.2" ECU_ADDRESS 0x80185A /end MEASUREMENT
/begin MEASUREMENT nmotpr_w "Pr‰dizierte Motordrehzahl f¸r NMAX-Regelung" UWORD nmot_uw_q0p25 1 100 0 16383.8 FORMAT "%8.2" ECU_ADDRESS 0x80185C /end MEASUREMENT
/begin MEASUREMENT nmxpr "Verst‰rkung Proportionalanteil der NMAX-Regelung" UBYTE relnmot_q0p003052 1 100 0 0.778198 ECU_ADDRESS 0x801248 /end MEASUREMENT
/begin MEASUREMENT nsber "Solldrehzahl f¸r NMAX-Regelung" UBYTE nmot_q64 1 100 0 16320 FORMAT "%5.0" ECU_ADDRESS 0x800D72 /end MEASUREMENT
/begin MEASUREMENT nsber_w "Solldrehzahl f¸r NMAX-Regelung" UWORD nmot_uw_q0p25 1 100 0 16383.8 FORMAT "%8.2" ECU_ADDRESS 0x80185E /end MEASUREMENT
/begin MEASUREMENT nturbv_w "Vorraussichtliche Turbinendrehzahl des Wandlers" UWORD nmot_q0p1453421 1 100 0 9524.99 FORMAT "%8.3" ECU_ADDRESS 0x801922 /end MEASUREMENT
/begin MEASUREMENT nturb_w "Turbinendrehzahl des Wandlers" UWORD nmot_q0p1453421 1 100 0 9524.99 FORMAT "%8.3" ECU_ADDRESS 0x801924 /end MEASUREMENT
/begin MEASUREMENT nvorh "Drehzahlvorhalt f¸r n-Regelung" SWORD DC_ROTSPD_S16 1 100 0 8000 FORMAT "%7.2" ECU_ADDRESS 0x7FC856 /end MEASUREMENT
/begin MEASUREMENT nvorhwf "Drehzahlvorhalt f¸r WF-Regelung" SWORD DC_ROTSPD_S16 1 100 0 8000 FORMAT "%7.2" ECU_ADDRESS 0x80346A /end MEASUREMENT
/begin MEASUREMENT nwsollalokbits "" UBYTE dez 1 100 0 255 FORMAT "%5.1" ECU_ADDRESS 0x801100 /end MEASUREMENT
/begin MEASUREMENT Oil_WAL "" UBYTE DEZ 1 100 0 255 FORMAT "%5.1" ECU_ADDRESS 0x800DCE /end MEASUREMENT
/begin MEASUREMENT OvrSpd_Mode "" UBYTE DEZ 1 100 0 255 FORMAT "%5.1" ECU_ADDRESS 0x800DCF /end MEASUREMENT
/begin MEASUREMENT OWRatio_Coef "" UBYTE DEZ 1 100 0 255 FORMAT "%5.1" ECU_ADDRESS 0x800DD0 /end MEASUREMENT
/begin MEASUREMENT PartFFR_Mode "" UBYTE DEZ 1 100 0 255 FORMAT "%5.1" ECU_ADDRESS 0x800DD1 /end MEASUREMENT
/begin MEASUREMENT Pwrtrn_IdleMTX_Mode_Req "" UBYTE DC_FLAG_U8 1 100 0 1 BIT_MASK 0x1 FORMAT "%5.3" ECU_ADDRESS 0x803962 /end MEASUREMENT
/begin MEASUREMENT qntns "Quotient aus Turbinendrehzahl des Wandlers und Solldrehzahl der LLR" UBYTE fak_ub_b8 1 100 0 7.96875 FORMAT "%5.3" ECU_ADDRESS 0x801283 /end MEASUREMENT
/begin MEASUREMENT RvrsGearHw "" UBYTE DEZ 1 100 0 255 FORMAT "%5.1" ECU_ADDRESS 0x800DD2 /end MEASUREMENT
/begin MEASUREMENT Sen_Oil_Lvl "" SWORD rel_sw_q0p015625 1 100 -512 511.984 FORMAT "%8.4" ECU_ADDRESS 0x800E0E /end MEASUREMENT
/begin MEASUREMENT Sen_Oil_Qual "" SWORD dez_sw_q7p812Em3 1 100 -256 255.992 FORMAT "%8.4" ECU_ADDRESS 0x800E10 /end MEASUREMENT
/begin MEASUREMENT Sen_Oil_Temp "" SWORD temp_sw_q1p25Em1 1 100 -4096 4095.88 FORMAT "%8.3" ECU_ADDRESS 0x800E12 /end MEASUREMENT
/begin MEASUREMENT SFSO_Mode "" UBYTE DEZ 1 100 0 255 FORMAT "%5.1" ECU_ADDRESS 0x800DD3 /end MEASUREMENT
/begin MEASUREMENT ShiftPoint_Disp_Req "" UBYTE DEZ 1 100 0 255 FORMAT "%5.1" ECU_ADDRESS 0x800DD4 /end MEASUREMENT
/begin MEASUREMENT statetnwa "Anzeige: aktueller Zustand bei Ansteuerung Auslaﬂnockenwelle durch Tester" UBYTE dez 1 100 0 255 FORMAT "%5.1" ECU_ADDRESS 0x8005E1 /end MEASUREMENT
/begin MEASUREMENT statetnwe "Anzeige: aktueller Zustand bei Ansteuerung Einlaﬂnockenwelle durch Tester" UBYTE dez 1 100 0 255 FORMAT "%5.1" ECU_ADDRESS 0x8005E2 /end MEASUREMENT
/begin MEASUREMENT statnwshka "Anzeige: aktueller Zustand Sch¸tteln Auslaﬂnockenwelle" UBYTE dez 1 100 0 255 FORMAT "%5.1" ECU_ADDRESS 0x8010FB /end MEASUREMENT
/begin MEASUREMENT statnwshke "Anzeige: aktueller Zustand Sch¸tteln Einlaﬂnockenwelle" UBYTE dez 1 100 0 255 FORMAT "%5.1" ECU_ADDRESS 0x8010FC /end MEASUREMENT
/begin MEASUREMENT Strtr_Mode "" UBYTE DEZ 1 100 0 255 FORMAT "%5.1" ECU_ADDRESS 0x800DD5 /end MEASUREMENT
/begin MEASUREMENT Strt_Mode "" UBYTE DEZ 1 100 0 255 FORMAT "%5.1" ECU_ADDRESS 0x800DD6 /end MEASUREMENT
/begin MEASUREMENT swOffD2Bits "" UBYTE dez 1 100 0 255 FORMAT "%5.1" ECU_ADDRESS 0x7FC83C /end MEASUREMENT
/begin MEASUREMENT swOffDlBits "" UWORD dez 1 100 0 65535 FORMAT "%8.2" ECU_ADDRESS 0x7FC83E /end MEASUREMENT
/begin MEASUREMENT ThrCurrless_Mode "" UBYTE DEZ 1 100 0 255 FORMAT "%5.1" ECU_ADDRESS 0x800DD7 /end MEASUREMENT
/begin MEASUREMENT tlok "Auﬂentemperatur als Lastinformation f¸r Klimakompressor" UBYTE temp_ub_q0p75_o48 1 100 -48 143.25 FORMAT "%5.1" ECU_ADDRESS 0x800DAD /end MEASUREMENT
/begin MEASUREMENT tmotmn "Minimal plausible Motortemperatur" UBYTE temp_ub_q0p75_o48 1 100 -48 143.25 FORMAT "%5.1" ECU_ADDRESS 0x801256 /end MEASUREMENT
/begin MEASUREMENT tnachl_w "SG-Nachlaufzeit" UWORD t100msxs_uw_b6553p6 1 100 0 6553.5 FORMAT "%8.3" ECU_ADDRESS 0x7FC840 /end MEASUREMENT
/begin MEASUREMENT tnscCtr_w "" UWORD t20msxs_uw_q0p02 1 100 0 1310.7 FORMAT "%8.3" ECU_ADDRESS 0x8018B6 /end MEASUREMENT
/begin MEASUREMENT tnsofCtr "" UBYTE t20msxs_ub_b5p1 1 100 0 5.1 FORMAT "%5.3" ECU_ADDRESS 0x801257 /end MEASUREMENT
/begin MEASUREMENT tnwsbga "Zeitkonstante f¸r Sollwert‰nderungsbegrenzung Auslassnockenwelle" UBYTE zk10msxs_ub_b2p55 1 100 0.01 2.55 FORMAT "%5.3" ECU_ADDRESS 0x801101 /end MEASUREMENT
/begin MEASUREMENT tnwsbga2 "Zeitkonstante f¸r Sollwert‰nderungsbegrenzung Auslassnockenwelle 2" UBYTE zk10msxs_ub_b2p55 1 100 0.01 2.55 FORMAT "%5.3" ECU_ADDRESS 0x801102 /end MEASUREMENT
/begin MEASUREMENT TransGuard_Mode "" UBYTE DC_FLAG_U8 1 100 0 1 BIT_MASK 0x1 FORMAT "%5.3" ECU_ADDRESS 0x8038E0 /end MEASUREMENT
/begin MEASUREMENT TrqCalcIVS_Coeff "" UBYTE dez_ub_q7p812Em3 1 100 0 1.99219 FORMAT "%5.3" ECU_ADDRESS 0x800DD8 /end MEASUREMENT
/begin MEASUREMENT TrqCoor_AdapCrsCtrl_Mode "" UBYTE DC_FLAG_U8 1 100 0 1 BIT_MASK 0x1 FORMAT "%5.3" ECU_ADDRESS 0x8039B3 /end MEASUREMENT
/begin MEASUREMENT TrqCoor_AdapCrsCtrl_Req "" SWORD DC_TRQ_S16 1 100 -2048 2047.94 FORMAT "%8.3" ECU_ADDRESS 0x80341C /end MEASUREMENT
/begin MEASUREMENT TrqCoor_CrsCtrlTot_Mode "" UBYTE DC_FLAG_U8 1 100 0 1 BIT_MASK 0x1 FORMAT "%5.3" ECU_ADDRESS 0x8039B4 /end MEASUREMENT
/begin MEASUREMENT TrqCoor_CrsCtrl_Mode "" UBYTE DC_FLAG_U8 1 100 0 1 BIT_MASK 0x1 FORMAT "%5.3" ECU_ADDRESS 0x8039B5 /end MEASUREMENT
/begin MEASUREMENT TrqCoor_DynMem_Mode "" UBYTE DC_FLAG_U8 1 100 0 1 BIT_MASK 0x1 FORMAT "%5.3" ECU_ADDRESS 0x8039B6 /end MEASUREMENT
/begin MEASUREMENT TrqCoor_ESPInternal_Req "" SWORD DC_TRQ_S16 1 100 -2048 2047.94 FORMAT "%8.3" ECU_ADDRESS 0x80341E /end MEASUREMENT
/begin MEASUREMENT TrqCoor_ESPOrMSL_Req "" SWORD DC_TRQ_S16 1 100 -2048 2047.94 FORMAT "%8.3" ECU_ADDRESS 0x803420 /end MEASUREMENT
/begin MEASUREMENT TrqCoor_ESP_Mode "" UBYTE DC_FLAG_U8 1 100 0 1 BIT_MASK 0x1 FORMAT "%5.3" ECU_ADDRESS 0x8039B7 /end MEASUREMENT
/begin MEASUREMENT TrqCoor_Info "" UBYTE DC_CNTR_U8 1 100 0 255 FORMAT "%5.1" ECU_ADDRESS 0x8039B8 /end MEASUREMENT
/begin MEASUREMENT TrqCoor_MSL_Mode "" UBYTE DC_FLAG_U8 1 100 0 1 BIT_MASK 0x1 FORMAT "%5.3" ECU_ADDRESS 0x8039B9 /end MEASUREMENT
/begin MEASUREMENT TrqCoor_MSL_Req "" SWORD DC_TRQ_S16 1 100 -2048 2047.94 FORMAT "%8.3" ECU_ADDRESS 0x803422 /end MEASUREMENT
/begin MEASUREMENT TrqCoor_TCM_Mode "" UBYTE DC_FLAG_U8 1 100 0 1 BIT_MASK 0x1 FORMAT "%5.3" ECU_ADDRESS 0x8039BA /end MEASUREMENT
/begin MEASUREMENT TrqCoor_TCM_Req "" SWORD DC_TRQ_S16 1 100 -2048 2047.94 FORMAT "%8.3" ECU_ADDRESS 0x803424 /end MEASUREMENT
/begin MEASUREMENT TrqCoor_TCM_Type "" UBYTE DC_FLAG_U8 1 100 0 1 BIT_MASK 0x1 FORMAT "%5.3" ECU_ADDRESS 0x8039BB /end MEASUREMENT
/begin MEASUREMENT TrqCoor_TransTrqLim_Mode "" UBYTE DC_FLAG_U8 1 100 0 1 BIT_MASK 0x1 FORMAT "%5.3" ECU_ADDRESS 0x8039BC /end MEASUREMENT
/begin MEASUREMENT TrqCoor_TransTrqLim_Req "" SWORD DC_TRQ_S16 1 100 -2048 2047.94 FORMAT "%8.3" ECU_ADDRESS 0x803426 /end MEASUREMENT
/begin MEASUREMENT TrqCoor_TrqRedAfterVSLReq_Mode "" UBYTE DC_FLAG_U8 1 100 0 1 BIT_MASK 0x1 FORMAT "%5.3" ECU_ADDRESS 0x8039BD /end MEASUREMENT
/begin MEASUREMENT TrqCoor_TrqSetRes_Buildup "" SWORD DC_TRQ_S16 1 100 -2048 2047.94 FORMAT "%8.3" ECU_ADDRESS 0x803428 /end MEASUREMENT
/begin MEASUREMENT TrqCoor_TrqSetRes_Buildup_Mode "" UBYTE DC_FLAG_U8 1 100 0 1 BIT_MASK 0x1 FORMAT "%5.3" ECU_ADDRESS 0x8039BE /end MEASUREMENT
/begin MEASUREMENT TrqCoor_TrqSetRes_Coef "" UWORD DC_FCTR_32768_U16 1 100 0 0.00778198 FORMAT "%10.8" ECU_ADDRESS 0x80342A /end MEASUREMENT
/begin MEASUREMENT TrqCoor_TrqSetRes_CoefCCL "" UBYTE DC_FCTR_128_U8 1 100 0 1.99219 ECU_ADDRESS 0x8039BF /end MEASUREMENT
/begin MEASUREMENT TrqCoor_TrqSetRes_Red "" SWORD DC_TRQ_S16 1 100 -2048 2047.94 FORMAT "%8.3" ECU_ADDRESS 0x80342C /end MEASUREMENT
/begin MEASUREMENT TrqCoor_TrqSetRes_Red_Mode "" UBYTE DC_FLAG_U8 1 100 0 1 BIT_MASK 0x1 FORMAT "%5.3" ECU_ADDRESS 0x8039C0 /end MEASUREMENT
/begin MEASUREMENT TrqCoor_TrqSetRes_Req "" SWORD DC_TRQ_S16 1 100 -2048 2047.94 FORMAT "%8.3" ECU_ADDRESS 0x80342E /end MEASUREMENT
/begin MEASUREMENT TrqCtrl_Mode "" UBYTE DC_FLAG_U8 1 100 0 1 BIT_MASK 0x1 FORMAT "%5.3" ECU_ADDRESS 0x8039C1 /end MEASUREMENT
/begin MEASUREMENT TrqIndCoor_MSL_Req "" SWORD DC_TRQ_S16 1 100 0 800 FORMAT "%8.4" ECU_ADDRESS 0x80330C /end MEASUREMENT
/begin MEASUREMENT TrqIndDashp1_Req "" SWORD DC_TRQ_S16 1 100 0 800 FORMAT "%8.4" ECU_ADDRESS 0x803312 /end MEASUREMENT
/begin MEASUREMENT TrqIndDashpLTCCoor_Req "" SWORD DC_TRQ_S16 1 100 0 800 FORMAT "%8.4" ECU_ADDRESS 0x803302 /end MEASUREMENT
/begin MEASUREMENT TrqIndDashpLTC_Req "" SWORD DC_TRQ_S16 1 100 0 800 FORMAT "%8.4" ECU_ADDRESS 0x803304 /end MEASUREMENT
/begin MEASUREMENT TrqIndDashp_Req "" SWORD DC_TRQ_S16 1 100 0 800 FORMAT "%8.4" ECU_ADDRESS 0x80330E /end MEASUREMENT
/begin MEASUREMENT TrqIndLTC1_Req "" SWORD DC_TRQ_S16 1 100 0 800 FORMAT "%8.4" ECU_ADDRESS 0x80331A /end MEASUREMENT
/begin MEASUREMENT TrqIndLTC2_Req "" SWORD DC_TRQ_S16 1 100 0 800 FORMAT "%8.4" ECU_ADDRESS 0x803318 /end MEASUREMENT
/begin MEASUREMENT TrqIndLTC_Req "" SWORD DC_TRQ_S16 1 100 0 800 FORMAT "%8.4" ECU_ADDRESS 0x803316 /end MEASUREMENT
/begin MEASUREMENT TrqIndReq_LV "" SWORD DC_TRQ_S16 1 100 0 800 FORMAT "%8.4" ECU_ADDRESS 0x80330A /end MEASUREMENT
/begin MEASUREMENT TrqReqConfirm_TCM_Mode "" UBYTE DC_FLAG_U8 1 100 0 1 BIT_MASK 0x1 FORMAT "%5.3" ECU_ADDRESS 0x8039C2 /end MEASUREMENT
/begin MEASUREMENT TrqReqLoutAdapCrsCtrl_Mode "" UBYTE DEZ 1 100 0 255 FORMAT "%5.1" ECU_ADDRESS 0x800DD9 /end MEASUREMENT
/begin MEASUREMENT TrqReqLoutESP_Mode "" UBYTE DEZ 1 100 0 255 FORMAT "%5.1" ECU_ADDRESS 0x800DDA /end MEASUREMENT
/begin MEASUREMENT TrqReqLoutTCM_Mode "" UBYTE DEZ 1 100 0 255 FORMAT "%5.1" ECU_ADDRESS 0x800DDB /end MEASUREMENT
/begin MEASUREMENT TrqSetIgn_Mode_Req "" UBYTE DC_FLAG_U8 1 100 0 1 BIT_MASK 0x1 FORMAT "%5.3" ECU_ADDRESS 0x8039C3 /end MEASUREMENT
/begin MEASUREMENT TrqSetMin_Mode "" UBYTE DC_FLAG_U8 1 100 0 1 BIT_MASK 0x1 FORMAT "%5.3" ECU_ADDRESS 0x8039C4 /end MEASUREMENT
/begin MEASUREMENT TrqSetRes_Mode_Req "" UBYTE DC_FLAG_U8 1 100 0 1 BIT_MASK 0x1 FORMAT "%5.3" ECU_ADDRESS 0x8039C5 /end MEASUREMENT
/begin MEASUREMENT Trq_Req "Md-Soll aus Momentenkoordination" SWORD DC_TRQ_S16 1 100 -2048 2047.94 FORMAT "%8.3" ECU_ADDRESS 0x8032FE /end MEASUREMENT
/begin MEASUREMENT twnd "Temperatur f¸r Wandlerˆl" UBYTE temp_ub_q0p75_o48 1 100 -48 143.25 FORMAT "%5.1" ECU_ADDRESS 0x800DB2 /end MEASUREMENT
/begin MEASUREMENT Veh_MaxSpd "" UWORD DC_VEHSPD_KMH_U16 1 100 0 4095.94 FORMAT "%8.3" ECU_ADDRESS 0x80346C /end MEASUREMENT
/begin MEASUREMENT VMSL_Mode_Req "" UBYTE DC_FLAG_U8 1 100 0 1 BIT_MASK 0x1 FORMAT "%5.3" ECU_ADDRESS 0x8039DB /end MEASUREMENT
/begin MEASUREMENT wdmdkoe "Momentenaufnahme Klimakompressor beim Einschalten" SBYTE rel_sb_q0p39 1 100 -49.9968 49.6062 FORMAT "%5.2" ECU_ADDRESS 0x800DAE /end MEASUREMENT
/begin MEASUREMENT wdnwsa2_w "Sollwinkeldifferenz am Eingang ƒnderungsbegrenzung Auslaﬂnockenwelle 2" SWORD kw_sw_q0p0078 1 100 -256 255.992 FORMAT "%8.4" ECU_ADDRESS 0x801542 /end MEASUREMENT
/begin MEASUREMENT wdnwsa_w "Sollwinkeldifferenz am Eingang ƒnderungsbegrenzung Auslaﬂnockenwelle" SWORD kw_sw_q0p0078 1 100 -256 255.992 FORMAT "%8.4" ECU_ADDRESS 0x801544 /end MEASUREMENT
/begin MEASUREMENT wkfmdko_w "Momentenaufnahme Klimakompressor vor Filter" UWORD rel_uw_b100 1 100 0 99.9985 FORMAT "%8.5" ECU_ADDRESS 0x801914 /end MEASUREMENT
/begin MEASUREMENT wnshkmna_w "Minimaler Sollwinkel Sch¸tteln Auslaﬂnockenwelle" SWORD kw_sw_q0p0078 1 100 -256 255.992 FORMAT "%8.4" ECU_ADDRESS 0x801504 /end MEASUREMENT
/begin MEASUREMENT wnshkmne_w "Minimaler Sollwinkel Sch¸tteln Einlaﬂnockenwelle" SWORD kw_sw_q0p0078 1 100 -256 255.992 FORMAT "%8.4" ECU_ADDRESS 0x801506 /end MEASUREMENT
/begin MEASUREMENT wnshkmxa_w "Maximaler Sollwinkel Sch¸tteln Auslaﬂnockenwelle" SWORD kw_sw_q0p0078 1 100 -256 255.992 FORMAT "%8.4" ECU_ADDRESS 0x801508 /end MEASUREMENT
/begin MEASUREMENT wnshkmxe_w "Maximaler Sollwinkel Sch¸tteln Einlaﬂnockenwelle" SWORD kw_sw_q0p0078 1 100 -256 255.992 FORMAT "%8.4" ECU_ADDRESS 0x80150A /end MEASUREMENT
/begin MEASUREMENT wnstvha2_w "Sollwinkel bei Verstellstop durch umschalten der Nockenhˆhe Auslassnockenwelle 2" SWORD kw_sw_q0p0078 1 100 -256 255.992 FORMAT "%8.4" ECU_ADDRESS 0x80150C /end MEASUREMENT
/begin MEASUREMENT wnstvha_w "Sollwinkel bei Verstellstop durch umschalten der Nockenhˆhe Auslassnockenwelle" SWORD kw_sw_q0p0078 1 100 -256 255.992 FORMAT "%8.4" ECU_ADDRESS 0x80150E /end MEASUREMENT
/begin MEASUREMENT wnstvhe2_w "Sollwinkel bei Verstellstop durch umschalten der Nockenhˆhe Einlassnockenwelle 2" SWORD kw_sw_q0p0078 1 100 -256 255.992 FORMAT "%8.4" ECU_ADDRESS 0x801510 /end MEASUREMENT
/begin MEASUREMENT wnstvhe_w "Sollwinkel bei Verstellstop durch umschalten der Nockenhˆhe Einlassnockenwelle" SWORD kw_sw_q0p0078 1 100 -256 255.992 FORMAT "%8.4" ECU_ADDRESS 0x801512 /end MEASUREMENT
/begin MEASUREMENT wnwahom_w "Vorsteuerwert f¸r NW-Sollwinkel im Homogenbetrieb Auslaﬂ" SWORD kw_sw_q0p0078 1 100 -256 255.992 FORMAT "%8.4" ECU_ADDRESS 0x8005EE /end MEASUREMENT
/begin MEASUREMENT wnwass "Sollwinkel Nockenwelle Auslaﬂ schliesst (Bank1)" UBYTE kw_ub_q0p5 1 100 0 127.5 FORMAT "%5.1" ECU_ADDRESS 0x8005EB /end MEASUREMENT
/begin MEASUREMENT wnwass2 "Sollwinkel Nockenwelle Auslaﬂ schliesst (Bank2)" UBYTE kw_ub_q0p5 1 100 0 127.5 FORMAT "%5.1" ECU_ADDRESS 0x8005EC /end MEASUREMENT
/begin MEASUREMENT wnwdshka_w "Deltasollwinkel Nockenwelle Auslaﬂ Hˆhenkorrektur bei Katheizen" SWORD kw_sw_q0p0078 1 100 -256 255.992 FORMAT "%8.4" ECU_ADDRESS 0x8005F0 /end MEASUREMENT
/begin MEASUREMENT wnwkha_w "Sollwinkel Nockenwelle Auslaﬂ bei Katheizen" SWORD kw_sw_q0p0078 1 100 -256 255.992 FORMAT "%8.4" ECU_ADDRESS 0x8005F2 /end MEASUREMENT
/begin MEASUREMENT wnwkhlla_w "Sollwinkel Nockenwelle Auslaﬂ bei Katheizen und B_ll" SWORD kw_sw_q0p0078 1 100 -256 255.992 FORMAT "%8.4" ECU_ADDRESS 0x8005F4 /end MEASUREMENT
/begin MEASUREMENT wnwsa2_w "Sollwinkel Nockenwelle Auslass 2 schlieﬂt" SWORD kw_sw_q0p0078 1 100 -256 255.992 FORMAT "%8.4" ECU_ADDRESS 0x801546 /end MEASUREMENT
/begin MEASUREMENT wnwsaa_w "aktiver Sollwinkel, der aus den verschiedenen Kennfeldern selektiert wurde Ausla" SWORD kw_sw_q0p0078 1 100 -256 255.992 FORMAT "%8.4" ECU_ADDRESS 0x8005F6 /end MEASUREMENT
/begin MEASUREMENT wnwsapa_w "Sollwinkel Auslassnockenwelle aus Kennfeld oder Festwert f¸r Applikationszwecke" SWORD kw_sw_q0p0078 1 100 -256 255.992 FORMAT "%8.4" ECU_ADDRESS 0x8005F8 /end MEASUREMENT
/begin MEASUREMENT wnwsa_w "Sollwinkel Nockenwelle Auslass schlieﬂt" SWORD kw_sw_q0p0078 1 100 -256 255.992 FORMAT "%8.4" ECU_ADDRESS 0x801548 /end MEASUREMENT
/begin MEASUREMENT wnwsbga2_w "Sollwert Nockewellenverstellung nach ƒnderungsbegrenzung Auslassnockenwelle 2" SWORD kw_sw_q0p0078 1 100 -256 255.992 FORMAT "%8.4" ECU_ADDRESS 0x80154A /end MEASUREMENT
/begin MEASUREMENT wnwsbga_w "Sollwert Nockewellenverstellung nach ƒnderungsbegrenzung Auslassnockenwelle" SWORD kw_sw_q0p0078 1 100 -256 255.992 FORMAT "%8.4" ECU_ADDRESS 0x80154C /end MEASUREMENT
/begin MEASUREMENT wnwseva2_w "Sollwinkel f¸r eingeschr‰nkte Nockenwellenverstellung Auslass 2" SWORD kw_sw_q0p0078 1 100 -256 255.992 FORMAT "%8.4" ECU_ADDRESS 0x801514 /end MEASUREMENT
/begin MEASUREMENT wnwseva_w "Sollwinkel f¸r eingeschr‰nkte Nockenwellenverstellung Auslass" SWORD kw_sw_q0p0078 1 100 -256 255.992 FORMAT "%8.4" ECU_ADDRESS 0x801516 /end MEASUREMENT
/begin MEASUREMENT wnwseve2_w "Sollwinkel f¸r eingeschr‰nkte Nockenwellenverstellung Einlass 2" SWORD kw_sw_q0p0078 1 100 -256 255.992 FORMAT "%8.4" ECU_ADDRESS 0x801518 /end MEASUREMENT
/begin MEASUREMENT wnwseve_w "Sollwinkel f¸r eingeschr‰nkte Nockenwellenverstellung Einlass" SWORD kw_sw_q0p0078 1 100 -256 255.992 FORMAT "%8.4" ECU_ADDRESS 0x80151A /end MEASUREMENT
/begin MEASUREMENT wnwsfaa_w "Sollwinkel bei Testereingriff Auslassnockenwelle" SWORD kw_sw_q0p0078 1 100 -256 255.992 FORMAT "%8.4" ECU_ADDRESS 0x8005E6 /end MEASUREMENT
/begin MEASUREMENT wnwsfae_w "Sollwinkel bei Testereingriff Einlassnockenwelle" SWORD kw_sw_q0p0078 1 100 -256 255.992 FORMAT "%8.4" ECU_ADDRESS 0x8005E8 /end MEASUREMENT
/begin MEASUREMENT wnwshka_w "Sollwinkel f¸r Sch¸tteln Auslaﬂnockenwelle" SWORD kw_sw_q0p0078 1 100 -256 255.992 FORMAT "%8.4" ECU_ADDRESS 0x80151C /end MEASUREMENT
/begin MEASUREMENT wnwshke_w "Sollwinkel f¸r Sch¸tteln Einlaﬂnockenwelle" SWORD kw_sw_q0p0078 1 100 -256 255.992 FORMAT "%8.4" ECU_ADDRESS 0x80151E /end MEASUREMENT
/begin MEASUREMENT wnwskwa_w "Sollwinkel Nockenwelle Auslaﬂ aus Kalt oder Warmkennfeld" SWORD kw_sw_q0p0078 1 100 -256 255.992 FORMAT "%8.4" ECU_ADDRESS 0x8005FA /end MEASUREMENT
/begin MEASUREMENT wnwskwka_w "Sollwinkel Nockenwelle Auslaﬂ aus Kalt oder Warmkennfeld mit Klopfeingriff" SWORD kw_sw_q0p0078 1 100 -256 255.992 FORMAT "%8.4" ECU_ADDRESS 0x8005FC /end MEASUREMENT
/begin MEASUREMENT wnwskwla_w "Sollwinkel Nockenwelle Auslaﬂ aus Kalt oder Warmkennfeld bei B_ll" SWORD kw_sw_q0p0078 1 100 -256 255.992 FORMAT "%8.4" ECU_ADDRESS 0x8005FE /end MEASUREMENT
/begin MEASUREMENT wnwslva2_w "Sollwinkel f¸r lˆsen der Nockenwellenverriegelung  Auslaﬂ 2" SWORD kw_sw_q0p0078 1 100 -256 255.992 FORMAT "%8.4" ECU_ADDRESS 0x801520 /end MEASUREMENT
/begin MEASUREMENT wnwslva_w "Sollwinkel f¸r lˆsen der Nockenwellenverriegelung  Auslaﬂ" SWORD kw_sw_q0p0078 1 100 -256 255.992 FORMAT "%8.4" ECU_ADDRESS 0x801522 /end MEASUREMENT
/begin MEASUREMENT wnwslve2_w "Sollwinkel f¸r lˆsen der Nockenwellenverriegelung  Einlaﬂ 2" SWORD kw_sw_q0p0078 1 100 -256 255.992 FORMAT "%8.4" ECU_ADDRESS 0x801524 /end MEASUREMENT
/begin MEASUREMENT wnwslve_w "Sollwinkel f¸r lˆsen der Nockenwellenverriegelung  Einlaﬂ" SWORD kw_sw_q0p0078 1 100 -256 255.992 FORMAT "%8.4" ECU_ADDRESS 0x801526 /end MEASUREMENT
/begin MEASUREMENT wnwsmna_w "minimaler Sollwinkel Nockenwelle Auslaﬂ schlieﬂt" SWORD kw_sw_q0p0078 1 100 -256 255.992 FORMAT "%8.4" ECU_ADDRESS 0x800600 /end MEASUREMENT
/begin MEASUREMENT wnwsmxa_w "maximaler Sollwinkel Nockenwelle Auslaﬂ schliesst" SWORD kw_sw_q0p0078 1 100 -256 255.992 FORMAT "%8.4" ECU_ADDRESS 0x800602 /end MEASUREMENT
/begin MEASUREMENT wnwsswa2_w "gespeicherter Nockenwellensollwinkel Auslaﬂ 2" SWORD kw_sw_q0p0078 1 100 -256 255.992 FORMAT "%8.4" ECU_ADDRESS 0x80154E /end MEASUREMENT
/begin MEASUREMENT wnwsswa_w "gespeicherter Nockenwellensollwinkel Auslaﬂ" SWORD kw_sw_q0p0078 1 100 -256 255.992 FORMAT "%8.4" ECU_ADDRESS 0x801550 /end MEASUREMENT
/begin MEASUREMENT wnwsta2_w "Sollwinkel bei aktivem Verstellstopp der Auslaﬂnockenwelle 2" SWORD kw_sw_q0p0078 1 100 -256 255.992 FORMAT "%8.4" ECU_ADDRESS 0x801528 /end MEASUREMENT
/begin MEASUREMENT wnwsta_w "Sollwinkel bei aktivem Verstellstopp der Auslaﬂnockenwelle" SWORD kw_sw_q0p0078 1 100 -256 255.992 FORMAT "%8.4" ECU_ADDRESS 0x80152A /end MEASUREMENT
/begin MEASUREMENT wnwstba_w "Sollwinkel Auslaﬂnockenwelle zu Beginn Verstellstop Bank1" SWORD kw_sw_q0p0078 1 100 -256 255.992 FORMAT "%8.4" ECU_ADDRESS 0x80152C /end MEASUREMENT
/begin MEASUREMENT wnwste2_w "Sollwinkel bei aktivem Verstellstopp der Einlaﬂnockenwelle 2" SWORD kw_sw_q0p0078 1 100 -256 255.992 FORMAT "%8.4" ECU_ADDRESS 0x80152E /end MEASUREMENT
/begin MEASUREMENT wnwste_w "Sollwinkel bei aktivem Verstellstopp der Einlaﬂnockenwelle" SWORD kw_sw_q0p0078 1 100 -256 255.992 FORMAT "%8.4" ECU_ADDRESS 0x801530 /end MEASUREMENT
/begin MEASUREMENT wnwstpa2_w "Sollwinkel bei aktivem Verstellstop durch die Funktionalit‰t STOPNWA Bank2" SWORD kw_sw_q0p0078 1 100 -256 255.992 FORMAT "%8.4" ECU_ADDRESS 0x801532 /end MEASUREMENT
/begin MEASUREMENT wnwstpa_w "Sollwinkel bei aktivem Verstellstop durch die Funktionalit‰t STOPNWA Bank1" SWORD kw_sw_q0p0078 1 100 -256 255.992 FORMAT "%8.4" ECU_ADDRESS 0x801534 /end MEASUREMENT
/begin MEASUREMENT wnwsyna2_w "Stopwinkel f¸r Syncronisation 2Bank-Nockenwelle Auslaﬂ 2" SWORD kw_sw_q0p0078 1 100 -256 255.992 FORMAT "%8.4" ECU_ADDRESS 0x801536 /end MEASUREMENT
/begin MEASUREMENT wnwsyna_w "Stopwinkel f¸r Syncronisation 2Bank-Nockenwelle Auslaﬂ 1" SWORD kw_sw_q0p0078 1 100 -256 255.992 FORMAT "%8.4" ECU_ADDRESS 0x801538 /end MEASUREMENT
/begin MEASUREMENT wnwsyne2_w "Stopwinkel f¸r Syncronisation 2Bank-Nockenwelle Einlaﬂ 2" SWORD kw_sw_q0p0078 1 100 -256 255.992 FORMAT "%8.4" ECU_ADDRESS 0x80153A /end MEASUREMENT
/begin MEASUREMENT wnwsyne_w "Stopwinkel f¸r Syncronisation 2Bank-Nockenwelle Einlaﬂ 1" SWORD kw_sw_q0p0078 1 100 -256 255.992 FORMAT "%8.4" ECU_ADDRESS 0x80153C /end MEASUREMENT
/begin MEASUREMENT zwsol "Soll-Z¸ndwinkel aus Momenteneingriff" SBYTE zw_sb_q0p75 1 100 -96 95.25 FORMAT "%5.2" ECU_ADDRESS 0x8012C8 /end MEASUREMENT
/begin FUNCTION MDVERB "Momentenbedarf der Nebenaggregate (z.B. Klimaanlage, sonst. Verbraucher)"
 /begin DEF_CHARACTERISTIC CNFSL CWMDRLKO CWSELV CWTUM DMDLWS DMDRKO DMKO DMLFS DMSERVL DMSLP DNSLLSL KFDMDKOE KFMDDLWS KFMDELMX KFMDKO KFMDRKO KFMDRKOE KLDMDLF1 KLDMDLF2 LWSER MDLF1 MDLF2 MDSL MDSLP MDSLPE NLLSLF SNM06KOUB SRL06KOUB STA06LLUB TDMKOW ZKBLF1 ZKBLF2 ZKMD1LF ZKMDKO ZKMDSEV ZKMDSLP ZMDDLWS /end DEF_CHARACTERISTIC
 /begin REF_CHARACTERISTIC /end REF_CHARACTERISTIC
 /begin IN_MEASUREMENT B_acres B_koe B_lf1nbres B_lf1s B_lf2nbres B_lf2s B_lwser B_sl B_slp B_stend lws_w nmot nmot_w rl tans tumg /end IN_MEASUREMENT
 /begin OUT_MEASUREMENT dmrac dmrlf dmrlws_w esst_snm06koub esst_srl06koub esst_sta06llub mdel_w mdgen_w mdko_w mdlfs_w mdslpf_w mdswl_w mdverb mdverb_w /end OUT_MEASUREMENT
 /begin LOC_MEASUREMENT dlwsl_w dlwsu_w dmrlf1 dmrlf2 mddlws_w mdkoini mdlws_w tlok wdmdkoe wkfmdko_w /end LOC_MEASUREMENT
 /begin SUB_FUNCTION /end SUB_FUNCTION
/end FUNCTION
/begin FUNCTION MDWAN "Drehmomentaufnahme des Wandlers"
 /begin DEF_CHARACTERISTIC CNFMDWAN DMDWANMX DMDWHYS DMDWM FABMDWA FDMDWAN FMDWAT FNRAD FVDMDWAN KFMDWMX MDATNM MDATRM MDWANER STW08MDUB TVFSAM TVFSEM TVFSRAM TVFSREM TVFUE UEVERG ZKDMDW ZKMDWAB ZKMDWAUF ZKMDWF ZKUEVERG /end DEF_CHARACTERISTIC
 /begin REF_CHARACTERISTIC /end REF_CHARACTERISTIC
 /begin IN_MEASUREMENT B_autget B_fs B_mdwaner gangi mdwancan nstat nturbc_w tmot vfzg vfzg_w /end IN_MEASUREMENT
 /begin OUT_MEASUREMENT B_dmrwan B_rgang dmdwan_w dmrwan mdwanvf_w mdwan_w /end OUT_MEASUREMENT
 /begin LOC_MEASUREMENT B_cnfwan B_fsu dnturb_w esst_stw08mdub mdatxm_w mdwancb_w nturbv_w nturb_w qntns twnd /end LOC_MEASUREMENT
 /begin SUB_FUNCTION /end SUB_FUNCTION
/end FUNCTION
/begin FUNCTION MDZUL "Maximal zul‰ssiges Moment"
 /begin DEF_CHARACTERISTIC CWMDZUL KFDMP KFDMT KFMOF KFPZU KLDMMX KLLLRZU KLMIMAX KLMIMIN KLMZUMN MZFFIL MZFTV NSTART NSTEND SMO08MFUB SNM08MFUB STM08MFUB SWP08MFUB TANSMN TMBST TMNSMN TMOMIN TNSC TNSOF /end DEF_CHARACTERISTIC
 /begin REF_CHARACTERISTIC MDIMX /end REF_CHARACTERISTIC
 /begin IN_MEASUREMENT B_fgr B_klmzu_um B_mrakt B_msr B_mzns_um B_sgs dmllrl_w dmrmx_w etazwbm etazwmn fnstab_w mdslw_w mdverf_w mdvervf_w nmot tans tmot tnst_w wped /end IN_MEASUREMENT
 /begin OUT_MEASUREMENT B_mdbglst B_mdblst B_mdbresl B_mdbza miszull_w miszul_w /end OUT_MEASUREMENT
 /begin LOC_MEASUREMENT B_inidtf B_mbst B_mzns B_nsakt B_nsend esst_smo08mfub esst_snm08mfub esst_stm08mfub esst_swp08mfub mdverbmx_w miszullb_w mizufil_w mizuofil mizutmp_w mizuvfil tmotmn tnscCtr_w tnsofCtr /end LOC_MEASUREMENT
 /begin SUB_FUNCTION /end SUB_FUNCTION
/end FUNCTION
/begin FUNCTION MDZW "Berechnung Moment in Sollz¸ndwinkel" /begin DEF_CHARACTERISTIC DMAUFN DZWETA /end DEF_CHARACTERISTIC /begin REF_CHARACTERISTIC /end REF_CHARACTERISTIC
 /begin IN_MEASUREMENT B_zwvs B_zwvz etazaist mibas_w miopt_w misol_w mizsol_w mizwmn_w nmot_w redist zwopt /end IN_MEASUREMENT
 /begin OUT_MEASUREMENT B_nozwe dmaufr_w etazws zwsol /end OUT_MEASUREMENT
 /begin LOC_MEASUREMENT B_zwvzm dzws /end LOC_MEASUREMENT
 /begin SUB_FUNCTION /end SUB_FUNCTION
/end FUNCTION
/begin FUNCTION ME2AGK "Schnittstellenadapter f¸r Grˆﬂen von ME9 zum AGK" /begin DEF_CHARACTERISTIC /end DEF_CHARACTERISTIC /begin REF_CHARACTERISTIC GANG_NFB MDNORM SWPEDNOT UPWGO UPWGU /end REF_CHARACTERISTIC
 /begin IN_MEASUREMENT B_dcdisfr B_dcy B_eslkl B_i_ska_fr B_i_ska_um B_kh B_kl15 B_kompbaus B_kompnaus B_mdstop B_mil B_nmax B_notlu_fr B_pwf B_sa B_sls B_sta B_stakt B_stend B_ub_ok dmllri_w ES_rge etazaist etazwist etazwmn evz_austot fho_w fsol gspsz mdverf_w mdverl_w mdwan_w mibgrl_w miist_w mimax_w mimin_w ml_w nmot_w nsber_w nsol pu_w qualol rk2_w rk_w rl_w S_kupp1 tans tka tmot toel toelk_w Trans_Emerg_Mode ub upwg1_w upwg2_w wped_w /end IN_MEASUREMENT
 /begin OUT_MEASUREMENT ACComprDsabl_Req ACComprSo_Req AdapAltitude_Coef AMTCrwlRepDsabl_Mode APEmergOp_Mode_Req APPoti_SupplyVolt APP_Volt1 APP_Volt2 Baro BatVoltState Bat_Volt B_dc_sls CatHead_Mode CodNew_Mode Convtr_TrqLoss CPPSw CylBank1_FIRate_Rel CylBank2_FIRate_Rel DFSO_Mode DrCyc_Mode ECTIn ECTOut EfficDP_HighLim EfficDP_LowLim Effy_IgnAngl Effy_IgnAnglMin EmergAirOp_Mode_Req EngEmergOp_Spd_Req Eng_RelLoad Eng_Run_Mode Eng_Spd_Unfiltd Eng_Trq Eng_TrqMax Eng_TrqMaxKC Eng_TrqMin Eng_Trq_Loss ErrHFM_Mode Err_FanMalf FanMalf_Mode FirstStrt_Mode FTBU_Mode IdleSpd_Req IgnSwRun_Mode IntkAir_Temp IntkAir_Temp_CAN ISC_TrqI_Req ISC_Trq_Req LH_Gear_LowLim_Req LTC_Coef MAF MfDiagDsabl_Mode MIL Mon_SFSO_Mode Oil_WAL OvrSpd_Mode OWRatio_Coef PartFFR_Mode RvrsGearHw Sen_Oil_Lvl Sen_Oil_Qual Sen_Oil_Temp SFSO_Mode ShiftPoint_Disp_Req Strtr_Mode Strt_Mode ThrCurrless_Mode TrqCalcIVS_Coeff TrqReqLoutAdapCrsCtrl_Mode TrqReqLoutESP_Mode TrqReqLoutTCM_Mode /end OUT_MEASUREMENT
 /begin LOC_MEASUREMENT B_od2 B_od3 B_und B_verg B_wechsler /end LOC_MEASUREMENT
 /begin SUB_FUNCTION /end SUB_FUNCTION
/end FUNCTION
/begin FUNCTION MFV "20.11     Fahrervorgabemoment" /begin DEF_CHARACTERISTIC FWVLNB FWVLNBHY KLD1 KLD2 KLD3 KLD4 KLR SW_VG /end DEF_CHARACTERISTIC /begin REF_CHARACTERISTIC SWPEDV16 /end REF_CHARACTERISTIC
 /begin IN_MEASUREMENT APP_ADD APP_ADD_Out Cod_Drvabl_AP sw_ped_r TransGuard_Mode Trans_Man_Cnfg Trans_Rvrs_Mode TrqCoor_CrsCtrlTot_Mode TrqCoor_TransTrqLim_Mode TrqCoor_TrqRedAfterVSLReq_Mode /end IN_MEASUREMENT
 /begin OUT_MEASUREMENT APP_ADD_Grdt APP_ADD_Mem APP_Char Drvr_HighPwr_Mode Drvr_MaxPwr_Mode ETCLine_Slct /end OUT_MEASUREMENT
 /begin LOC_MEASUREMENT /end LOC_MEASUREMENT
 /begin SUB_FUNCTION /end SUB_FUNCTION
/end FUNCTION
/begin FUNCTION MFVB "20.11     Moment Fahrervorgabe begrenzt"
 /begin DEF_CHARACTERISTIC FWBBR1 FWBBR2 FWBBR3 FWBBR4 FWBPEDGR FWBTMOT FWBVO FWBVU KLBD1 KLBD2 KLBMAX KLBNOA KLBNOH KLBNUA KLBNUH KLBST KLBTD1 KLBTD2 KLBTGMIN KLBVAR /end DEF_CHARACTERISTIC
 /begin REF_CHARACTERISTIC /end REF_CHARACTERISTIC
 /begin IN_MEASUREMENT AP_Grdt DrvrInput_Trq_Req Drvr_MaxPwr_Mode ECTIn Eng_Spd Gear_State Trans_Man_Cnfg TrqCoor_CrsCtrl_Mode Veh_Spd /end IN_MEASUREMENT
 /begin OUT_MEASUREMENT DrvrInput_TrqLim_Actv DrvrInput_TrqLim_ActvTrgr DrvrInput_TrqLim_NomVal DrvrInput_TrqLim_Req DrvrInput_TrqLim_Trgr_Mode Gear_LowLim_ReqDrvrInput Gear_LowLim_ReqDrvrInput_Mode ModelRange_Ix /end OUT_MEASUREMENT
 /begin LOC_MEASUREMENT /end LOC_MEASUREMENT
 /begin SUB_FUNCTION /end SUB_FUNCTION
/end FUNCTION
/begin FUNCTION MLLK "20.11     Leerlauf-Kontakt Nachbildung" /begin DEF_CHARACTERISTIC MART_LL NMOT_OFFS TMPFELLMD /end DEF_CHARACTERISTIC /begin REF_CHARACTERISTIC /end REF_CHARACTERISTIC
 /begin IN_MEASUREMENT AdapCrsCtrl_TrqMaxPls_Mode_Req AdapCrsCtrl_TrqPlaus_Req APP_Char DashpDsable_Mode Eng_MinTrqCmb_Req Eng_Spd ESP_TrqMaxPlaus_Mode_Req IdleDsablCrsCtrl_Mode_Req IdleSpd_Req Trans_Man_Cnfg TrqCoor_AdapCrsCtrl_Mode TrqCoor_CrsCtrlTot_Mode TrqCoor_ESP_Mode TrqCoor_Info TrqCoor_MSL_Mode TrqCoor_TCM_Mode Trq_Req VSL_DFSODsabl_Req /end IN_MEASUREMENT
 /begin OUT_MEASUREMENT Idle_ModeEnabl_Req Idle_Mode_Req Pwrtrn_IdleMTX_Mode_Req /end OUT_MEASUREMENT
 /begin LOC_MEASUREMENT /end LOC_MEASUREMENT
 /begin SUB_FUNCTION /end SUB_FUNCTION
/end FUNCTION
/begin FUNCTION MOTAUS "Motor-Abstellen" /begin DEF_CHARACTERISTIC TNLSGMN TNLSGMX UBNLMN /end DEF_CHARACTERISTIC /begin REF_CHARACTERISTIC /end REF_CHARACTERISTIC /begin IN_MEASUREMENT B_airbag B_kl15 B_nmin B_pwf ub /end IN_MEASUREMENT
 /begin OUT_MEASUREMENT B_nachl B_nachlend B_nlacls B_nlale B_nlatm B_nlcan B_nldte B_nldval B_nlEEPR B_nlmls B_nlobd B_nlsgls B_nlsiko B_nlthm B_nlwst swOffD2Bits swOffDlBits tnachl_w /end OUT_MEASUREMENT
 /begin LOC_MEASUREMENT B_nachlram /end LOC_MEASUREMENT
 /begin SUB_FUNCTION /end SUB_FUNCTION
/end FUNCTION
/begin FUNCTION MSS "20.11     Momentenschnittstelle" /begin DEF_CHARACTERISTIC FW_ASGSME FW_EGSSME FW_MMLOFFS KL_MRFKSG /end DEF_CHARACTERISTIC /begin REF_CHARACTERISTIC TL8V08 /end REF_CHARACTERISTIC
 /begin IN_MEASUREMENT AdapCrsCtrl_Dyn0Plaus_Mode_Req AdapCrsCtrl_TrqMaxPls_Mode_Req AdapCrsCtrl_TrqMinPls_Mode_Req AdapCrsCtrl_TrqPlaus_Req AMT_Mode CrsCtrl_Max_Mode CrsCtrl_Min_Mode CrsCtrl_Trq_Req ECU_TCMPlausErr Effy_IgnAngl Effy_IgnAnglMin Eng_MinTrqCmb_Req Eng_RelLoad Eng_Trq Eng_Trq_Loss ESP_Dyn0Plaus_Mode_Req ESP_Dyn1Plaus_Mode_Req ESP_TrqMaxPlaus_Mode_Req ESP_TrqMinPlaus_Mode_Req ESP_TrqPlaus_Req FTBU_Mode FTBU_Trq_Req ISC_TrqI_Req MSL_Mode_Req MSL_Trq_Req MTX_Mode SC_TrqSetRes_Mode_Req TCM_Dyn0Plaus_Mode_Req TCM_Dyn1Plaus_Mode_Req TCM_Enabl TCM_TrqMaxPlaus_Mode_Req TCM_TrqMinPlaus_Mode_Req TCM_TrqPlaus_Req tlst08 TransTrqLim_Mode_Req TransTrqLim_Req /end IN_MEASUREMENT
 /begin OUT_MEASUREMENT CrsCtrl_Coor_Trq Eng_ResTrq_Req TrqCoor_AdapCrsCtrl_Mode TrqCoor_AdapCrsCtrl_Req TrqCoor_CrsCtrlTot_Mode TrqCoor_CrsCtrl_Mode TrqCoor_DynMem_Mode TrqCoor_ESPInternal_Req TrqCoor_ESPOrMSL_Req TrqCoor_ESP_Mode TrqCoor_Info TrqCoor_MSL_Mode TrqCoor_MSL_Req TrqCoor_TCM_Mode TrqCoor_TCM_Req TrqCoor_TCM_Type TrqCoor_TransTrqLim_Mode TrqCoor_TransTrqLim_Req TrqCoor_TrqRedAfterVSLReq_Mode TrqCoor_TrqSetRes_Buildup TrqCoor_TrqSetRes_Buildup_Mode TrqCoor_TrqSetRes_Coef TrqCoor_TrqSetRes_CoefCCL TrqCoor_TrqSetRes_Red TrqCoor_TrqSetRes_Red_Mode TrqCoor_TrqSetRes_Req TrqCtrl_Mode TrqReqConfirm_TCM_Mode TrqSetIgn_Mode_Req TrqSetMin_Mode TrqSetRes_Mode_Req /end OUT_MEASUREMENT
 /begin LOC_MEASUREMENT /end LOC_MEASUREMENT
 /begin SUB_FUNCTION /end SUB_FUNCTION
/end FUNCTION
/begin FUNCTION MVFTV "20.11     Momentenvorgabe von Fahrer, Tempomat und variabler Geschwindigkeitsbegrenzung" /begin DEF_CHARACTERISTIC FWFVANF KFFVMN KLFVANF KWFVNO KWFVNU KWFVVO KWFVVU /end DEF_CHARACTERISTIC /begin REF_CHARACTERISTIC NISTV17 PWV /end REF_CHARACTERISTIC
 /begin IN_MEASUREMENT AMT_Mode APP_Char Eng_MinTrqCmb_Req Eng_Spd Eng_TrqMax_Effct MTX_Mode nist_1uf_r pw12r_r Veh_Spd /end IN_MEASUREMENT
 /begin OUT_MEASUREMENT DrvrInput_APPDrOff_Fctr DrvrInput_APP_Fctr DrvrInput_DrOff_Effy DrvrInput_IndDiffTrq DrvrInput_IndTrq_Req DrvrInput_Trq_Req /end OUT_MEASUREMENT
 /begin LOC_MEASUREMENT /end LOC_MEASUREMENT
 /begin SUB_FUNCTION /end SUB_FUNCTION
/end FUNCTION
/begin FUNCTION MZUEF "20.11     Zugkraft¸bertragungsfunktion"
 /begin DEF_CHARACTERISTIC DFH_EBG EBGAKT_T EBG_MAX EBG_RP_KF FKOP_LSD FWDPFILA FWDPFILH FWDTLSAS FW_LSDAUSA FW_TRGR FW_T_TLBOF KFDDP_1 KFDDP_2 KFDDP_A KLTLSAS KL_FMIMA1 KL_FMIMH1 KL_FMITA1 KL_FMITH1 KL_LSDFACR KL_LSDGRDR KL_LSDSTOP KL_MALL1 KL_MALL2 KL_MNLSDA KL_MNLSDA2 KL_MNLSDH KL_MNLSDH2 KL_NMAXA KL_NMINA KL_TALL1 KL_TALL2 KL_TNLSDA KL_TNLSDA2 KL_TNLSDH KL_TNLSDH2 SW_DPDIS SW_DPDIST /end DEF_CHARACTERISTIC
 /begin REF_CHARACTERISTIC AdapAltitudeTempCorrV8 EBG_RP_SST MV_DP NISTV08 NIST_LSD /end REF_CHARACTERISTIC
 /begin IN_MEASUREMENT ACCompr_Trq_Plaus AdapAltitudeTempCorr_Coef AMT_Mode Clutch_Mode Cod_Drvabl_Dashp Cod_Drvabl_LTC Cod_Trans_AWD ebg_rp_r Eng_MinTrqCmb_Req Eng_RelLoad Eng_Spd Eng_Trq fmiv08_r FTBU_RelLoadLimSprd_Mode Gear_State JumpStrt_Mode LTC_Coef MTX_Mode mv_dp_r nist_lsd_r nst08 PN_Mode TCM_218h_MsgLost_DeBnc_Mode Trans_Emerg_Mode TrqCoor_MSL_Mode TrqCoor_MSL_Req TrqCtrl_Mode Veh_Spd Veh_Spd_Err_Mode /end IN_MEASUREMENT
 /begin OUT_MEASUREMENT DashoLTCStop_Mode DashpChrgIntv_Mode DashpDsable_Mode DashpLTCTime_Coeff DashpLTCTrq_Coeff DashpLTC_Gear DashpLTC_RelLoadLimSprd_Mode Dashp_DeltaTrq Dashp_Mode Dashp_Trq Eng_Trq_Req LTCChrgIntv_Mode LTC_Cntr_Mode LTC_Mode LTC_Time1 LTC_Time2 LTC_Trig_Mode TransGuard_Cntr TransGuard_Mode TrqIndCoor_MSL_Req TrqIndDashp1_Req TrqIndDashpLTCCoor_Req TrqIndDashpLTC_Req TrqIndDashp_Req TrqIndLTC1_Req TrqIndLTC2_Req TrqIndLTC_Req TrqIndReq_LV Trq_Req /end OUT_MEASUREMENT
 /begin LOC_MEASUREMENT /end LOC_MEASUREMENT
 /begin SUB_FUNCTION /end SUB_FUNCTION
/end FUNCTION
/begin FUNCTION NHGB "20.11     Drehzahl- und Hˆchstgeschwindigkeitsbegrenzung"
 /begin DEF_CHARACTERISTIC FWDNGBT FWDVNGB FWDVWF FWDWFT FWIVFAK FWIVHGB FWIVNGBA FWIVNGBH FWIVWF FWMINTOEL FWNABSCHA FWNABSCHH FWNABSCHWF FWNGFIL FWNIDLY FWNIDLYWF FWNMAXWF FWNOUTA FWNOUTH FWNTOEL FWPVHGB FWPVNGBA FWPVNGBH FWPVWF FWTNMAXK FWTRAMP FWVABSCH FWVMAXD FWVMAXR FWVVORH FWWNMAXD FWWNMAXKA FWWNMAXKH FWWNMAXR KFNMREDA KFNMREDH KLAMDRED KLNREDWF KLNVHWF KLNVORHA KLNVORHH VMAXOG /end DEF_CHARACTERISTIC
 /begin REF_CHARACTERISTIC AV08 MIST16 NG08 NGWF08 /end REF_CHARACTERISTIC
 /begin IN_MEASUREMENT av08_r Cod_Trans_SpdLim EngEmergOp_Spd_Req Eng_MinTrqCmb_Req Eng_Spd Eng_Trq LongAccel mist16_r ng08_r ngwf08_r PN_Mode Sen_Oil_Temp Trans_Man_Cnfg Trans_Rvrs_Mode TrqCalcIVS_Coeff TrqCoor_MSL_Mode Veh_Spd Veh_Spd_Err_Mode /end IN_MEASUREMENT
 /begin OUT_MEASUREMENT b_mminwf b_nabsch b_nabschwf b_nidly b_nidlywf b_nmaxk b_nout b_nramp b_nvorh b_nvorhwf b_toelup b_vabsch b_vvorh c_nidly c_nidlywf c_nmaxk EMSL_Mode EMSL_Mode_Req Eng_MaxSpd mhgb mhgbr mhgbv mhgb_i mhgb_p mist_roh mngb mngbr mngbr_8 mngbv mngb_d mngb_i mngb_p mredwf mredwf_8 MSL_Mode_Req MSL_Stop MSL_Trq_Req mwf mwf_d mwf_i mwf_p ndisc ndiscwf ng_nhgb nmaxramp nmax_eff nvorh nvorhwf Veh_MaxSpd VMSL_Mode_Req /end OUT_MEASUREMENT
 /begin LOC_MEASUREMENT /end LOC_MEASUREMENT
 /begin SUB_FUNCTION /end SUB_FUNCTION
/end FUNCTION
/begin FUNCTION NLPH "Notlauf Phasengeber" /begin DEF_CHARACTERISTIC /end DEF_CHARACTERISTIC /begin REF_CHARACTERISTIC /end REF_CHARACTERISTIC /begin IN_MEASUREMENT B_nopg B_synph /end IN_MEASUREMENT /begin OUT_MEASUREMENT B_nlph /end OUT_MEASUREMENT /begin LOC_MEASUREMENT /end LOC_MEASUREMENT /begin SUB_FUNCTION /end SUB_FUNCTION /end FUNCTION
/begin FUNCTION NMAXMD "Drehzahlbegrenzung"
 /begin DEF_CHARACTERISTIC CWNMXMD DNMAX DNSIAB DNSOZW INMAXX ITNMXH KFNMAXKI KFNMAXKP KLTNMXPR MDIMX NMAX NMAXDV NMAXDVG NMAXDZ NMAXGA NMAXKR NMAXNL NMAXOGGA NMAXTO SNS04MDUB TMOTNMX TNMXH TVDNOZW VNMX /end DEF_CHARACTERISTIC
 /begin REF_CHARACTERISTIC DNMAXH SGA08MDUB /end REF_CHARACTERISTIC
 /begin IN_MEASUREMENT B_autget B_dopzue B_krdws B_nldg B_nmaxext esst_sga08mdub gangi mifab_w miistoar_w ndcdis_w ngfil_w nmaxext_w nmot_w tmot toelk_w vfzg /end IN_MEASUREMENT
 /begin OUT_MEASUREMENT B_nmax B_nmaxd B_nmxozwe esst_sns04mdub minmxl_w minmx_w nsber_w /end OUT_MEASUREMENT
 /begin LOC_MEASUREMENT B_nmaxog B_nmxkr B_nmxred B_tmnmax dmnmxi_w dmnmxp_w dnsi_w kinmx nmaxga_w nmax_w nmotpr_w nmxpr nsber /end LOC_MEASUREMENT
 /begin SUB_FUNCTION /end SUB_FUNCTION
/end FUNCTION
/begin FUNCTION NWEVO "Nockenwelle: eingeschr‰nkte Verstellmˆglichkeiten wegen ÷ldruck"
 /begin DEF_CHARACTERISTIC ANZLVMXA ANZLVMXE CWNWEVO DWNWESTPA DWNWSHKA DWNWSHKE DWNWSTPA DWNWSTPE DWNWSTPEA DWNWSTPEE DWNWSVPA DWNWSVPE DWNWVPA DWNWVPE NNWSHKMN NNWSHKMX SHKNWMXA SHKNWMXE TNWLVA TNWLVE TNWLVRPA TNWLVRPE TNWSHK TNWSHKAA TNWSHKAE TNWSTPA /end DEF_CHARACTERISTIC
 /begin REF_CHARACTERISTIC SNM05NWUW STO06NWUW WNWRAS WNWREO /end REF_CHARACTERISTIC
 /begin IN_MEASUREMENT B_brems B_enwsva B_enwsva2 B_enwsve B_enwsve2 B_kuppl B_nws B_sa esst_snm05nwuw esst_sto06nwuw nmot nmot_w toelk_w wnwa2_w wnwa_w wnwe2_w wnwe_w wnwsa2_w wnwsaa_w wnwsae_w wnwsa_w wnwse2_w wnwse_w wnwsmna_w wnwsmne_w wnwsmxa_w wnwsmxe_w /end IN_MEASUREMENT
 /begin OUT_MEASUREMENT B_nwllna B_nwseva B_nwseva2 B_nwseve B_nwseve2 B_nwstpa dwnwpasa_w dwnwpase_w wnwseva2_w wnwseva_w wnwseve2_w wnwseve_w /end OUT_MEASUREMENT
 /begin LOC_MEASUREMENT anzlvnwa anzlvnwa2 anzlvnwe anzlvnwe2 B_break1a B_break1e B_break2a B_break2e B_nwlva B_nwlva2 B_nwlve B_nwlve2 B_nwshka B_nwshkaa B_nwshkae B_nwshkapa B_nwshkape B_nwshke B_nwshko B_nwshkrpa B_nwshkrpe B_nwshkta B_nwshkte B_nwsyna B_nwsyna2 B_nwsyne B_nwsyne2 B_shken B_stat1to2a B_stat1to2e B_stat2to1a B_stat2to1e B_stpsyna B_stpsyne B_tostat1a B_tostat1e B_tostat2a B_tostat2e B_wnstvha B_wnstvhe ctrshknwa ctrshknwe dwnwasa2_w dwnwasa_w dwnwase2_w dwnwase_w dwnwstpa_w statnwshka statnwshke wnshkmna_w wnshkmne_w wnshkmxa_w wnshkmxe_w wnstvha2_w wnstvha_w wnstvhe2_w wnstvhe_w wnwshka_w wnwshke_w wnwslva2_w wnwslva_w wnwslve2_w wnwslve_w wnwsta2_w wnwsta_w wnwstba_w wnwste2_w wnwste_w wnwstpa2_w wnwstpa_w wnwsyna2_w wnwsyna_w wnwsyne2_w wnwsyne_w /end LOC_MEASUREMENT
 /begin SUB_FUNCTION /end SUB_FUNCTION
/end FUNCTION
/begin FUNCTION NWFW "Berechnung Faktor Winkel Nockenwelle" /begin DEF_CHARACTERISTIC CWNWFW KFFNWE KFNWWUE KLFNWA /end DEF_CHARACTERISTIC /begin REF_CHARACTERISTIC /end REF_CHARACTERISTIC /begin IN_MEASUREMENT fnwua fnwue nmot_w rl rlnw_w wnwsmxe_w wnwve_w /end IN_MEASUREMENT /begin OUT_MEASUREMENT fnwaa fnwea /end OUT_MEASUREMENT /begin LOC_MEASUREMENT /end LOC_MEASUREMENT /begin SUB_FUNCTION /end SUB_FUNCTION /end FUNCTION
/begin FUNCTION NWSFAT "Nockenwellensteuerung, Sollwertvorgabe durch Tester"
 /begin DEF_CHARACTERISTIC DMRDNW NFANWS TNWAPTA TNWAPTE TNWFARA TNWFARE TNWPPTA TNWPPTE TNWVBGNA TNWVBGNE /end DEF_CHARACTERISTIC
 /begin REF_CHARACTERISTIC /end REF_CHARACTERISTIC
 /begin IN_MEASUREMENT B_fa B_fanwsa B_fanwse nmot wnwsmna_w wnwsmne_w wnwsmxa_w wnwsmxe_w /end IN_MEASUREMENT
 /begin OUT_MEASUREMENT B_fanwsaa B_fanwsea B_fanwstaa B_fanwstae dmrdnw_w wnwsfaa_w wnwsfae_w /end OUT_MEASUREMENT
 /begin LOC_MEASUREMENT statetnwa statetnwe /end LOC_MEASUREMENT
 /begin SUB_FUNCTION /end SUB_FUNCTION
/end FUNCTION
/begin FUNCTION NWSOLLA "Sollwertvorgabe NWS (Auslaﬂseitig)"
 /begin DEF_CHARACTERISTIC CWNWEHOA DWNWABGA DWNWAMXA FNWSKRA GANGNWLLPA KFNWKHA KFNWKHLLA KFNWKRA KFNWLLA KFNWSA KFNWTMA KFNWWLA KFNWWLLA KFWNWSAPA KTNWSABGKA KTNWSNABGA KTNWSPABGA NMKFNWLLA NNWGLEHA TMNWLLKHA TNWWSPA VNWLLPA WNWDSHKA WNWRAS WNWSAAPP WNWSAPFA WNWSAPSA WNWSGLEHA WNWSMNA WNWSMXA WNWSTA WNWSWOFA /end DEF_CHARACTERISTIC
 /begin REF_CHARACTERISTIC SNM05NAUW SNM05NWUB SNM05NWUW SNM16NAUW SRL05NAUW SRL08NAUW STM05NWUB /end REF_CHARACTERISTIC
 /begin IN_MEASUREMENT B_dnwsa B_dnwsa2 B_enwsva B_enwsva2 B_fanwsaa B_fanwstaa B_fnwstva B_fnwstva2 B_ll B_nwrposa B_nws B_nwsapkfa B_nwsappa B_nwseva B_nwseva2 B_nwskflla B_nwssprga B_nwsst B_stpsyna B_wnwsmxfa esst_snm05nauw esst_snm05nwub esst_snm05nwuw esst_snm16nauw esst_srl05nauw esst_srl08nauw esst_stm05nwub fho_w fnwkha gangi nmot nmot_w rk_w rlnw_w tmot tmst tumg vfzg wkrma wnwa2_w wnwadmxa_w wnwa_w wnwseva2_w wnwseva_w wnwsfaa_w /end IN_MEASUREMENT
 /begin OUT_MEASUREMENT B_nwslla B_wnws02a B_wnws0a B_wnws0a2 wnwahom_w wnwass wnwass2 wnwsa2_w wnwsaa_w wnwsa_w wnwsmna_w wnwsmxa_w /end OUT_MEASUREMENT
 /begin LOC_MEASUREMENT B_nwgleha B_nwgleha2 B_nwsapspa dwnwabga_w dwnwamxa_w fnwwarma nwsollalokbits tnwsbga tnwsbga2 wdnwsa2_w wdnwsa_w wnwdshka_w wnwkha_w wnwkhlla_w wnwsapa_w wnwsbga2_w wnwsbga_w wnwskwa_w wnwskwka_w wnwskwla_w wnwsswa2_w wnwsswa_w /end LOC_MEASUREMENT
 /begin SUB_FUNCTION /end SUB_FUNCTION
/end FUNCTION
/begin COMPU_METHOD B_TRUE "boolsche Zust‰nde, positive Logik" TAB_VERB "%6.3" "" COMPU_TAB_REF B_TRUE /end COMPU_METHOD
/begin COMPU_VTAB B_TRUE "boolsche Zust‰nde, positive Logik" TAB_VERB 2 0 "----" 1 "TRUE" /end COMPU_VTAB
/begin COMPU_METHOD DC_CNTR_U8 "" RAT_FUNC "%6.2" "" COEFFS 0 1 0 0 0 1 /end COMPU_METHOD
/begin COMPU_METHOD DC_DEZ "" RAT_FUNC "%6.2" "" COEFFS 0 1 0 0 0 1 /end COMPU_METHOD
/begin COMPU_METHOD DC_FCTR_128_U8 "" RAT_FUNC "%7.5" "" COEFFS 0 128 0 0 0 1 /end COMPU_METHOD
/begin COMPU_METHOD DC_FCTR_32768_U16 "" RAT_FUNC "%8.7" "" COEFFS 0 32768 0 0 0 1 /end COMPU_METHOD
/begin COMPU_METHOD DC_FCTR_65535_U16 "" RAT_FUNC "%8.7" "" COEFFS 0 65535 0 0 0 1 /end COMPU_METHOD
/begin COMPU_METHOD DC_FKT128 "" RAT_FUNC "%6.4" "Faktor" COEFFS 0 128 0 0 0 1 /end COMPU_METHOD
/begin COMPU_METHOD DC_FKT20480_U16DB "" RAT_FUNC "%7.6" "Nm/(U/min/s)" COEFFS 0 20480 0 0 0 1 /end COMPU_METHOD
/begin COMPU_METHOD DC_FKT255 "" RAT_FUNC "%7.5" "Faktor" COEFFS 0 255 0 0 0 1 /end COMPU_METHOD
/begin COMPU_METHOD DC_FKT256L "" RAT_FUNC "%6.4" "Faktor" COEFFS 0 256 0 0 0 1 /end COMPU_METHOD
/begin COMPU_METHOD DC_FKT32768 "" RAT_FUNC "%7.6" "Faktor" COEFFS 0 32768 0 0 0 1 /end COMPU_METHOD
/begin COMPU_METHOD DC_FLAG_U8 "" RAT_FUNC "%6.2" "" COEFFS 0 1 0 0 0 1 /end COMPU_METHOD
/begin COMPU_METHOD DC_MMQ1_S8DB "" RAT_FUNC "%7.3" "Nm" COEFFS 0 1 0 0 0 1 /end COMPU_METHOD
/begin COMPU_METHOD DC_MMQ1_U8DB "" RAT_FUNC "%4.1" "Nm" COEFFS 0 1 0 0 0 1 /end COMPU_METHOD
/begin COMPU_METHOD DC_MMQ8_1024 "" RAT_FUNC "%6.2" "" COEFFS 0 1 0 0 0 4 /end COMPU_METHOD
/begin COMPU_METHOD DC_NGRDQ10_S16DB "" RAT_FUNC "%6.1" "U/min/s" COEFFS 0 1 0 0 0 10 /end COMPU_METHOD
/begin COMPU_METHOD DC_NQ1_W "" RAT_FUNC "%6.2" "Upm" COEFFS 0 1 0 0 0 1 /end COMPU_METHOD
/begin COMPU_METHOD DC_PCT_S16 "" RAT_FUNC "%8.5" "%" COEFFS 0 327.67 0 0 0 1 /end COMPU_METHOD
/begin COMPU_METHOD DC_PER0327 "" RAT_FUNC "%6.4" "%" COEFFS 0 327.67 0 0 0 1 /end COMPU_METHOD
/begin COMPU_METHOD DC_ROTSPD_S16 "" RAT_FUNC "%7.3" "1/min" COEFFS 0 2 0 0 0 1 /end COMPU_METHOD
/begin COMPU_METHOD DC_TEMP_S16 "" RAT_FUNC "%8.4" "Grad C" COEFFS 0 8 0 0 0 1 /end COMPU_METHOD
/begin COMPU_METHOD DC_TIME_10MS_U16 "" RAT_FUNC "%6.4" "s" COEFFS 0 100 0 0 0 1 /end COMPU_METHOD
/begin COMPU_METHOD DC_TIME_20MS_U16 "" RAT_FUNC "%6.4" "s" COEFFS 0 50 0 0 0 1 /end COMPU_METHOD
/begin COMPU_METHOD DC_TQ10 "" RAT_FUNC "%6.4" "sec" COEFFS 0 100 0 0 0 1 /end COMPU_METHOD
/begin COMPU_METHOD DC_TQ20 "" RAT_FUNC "%6.4" "sec" COEFFS 0 50 0 0 0 1 /end COMPU_METHOD
/begin COMPU_METHOD DC_TRQ_S16 "" RAT_FUNC "%8.5" "Nm" COEFFS 0 16 0 0 0 1 /end COMPU_METHOD
/begin COMPU_METHOD DC_UAFZ_S8 "" RAT_FUNC "%6.4" "m/(s*s)" COEFFS 0 1 0 0 0 0.0434 /end COMPU_METHOD
/begin COMPU_METHOD DC_UFUELL "" RAT_FUNC "%6.3" "%" COEFFS 0 255 0 0 0 127.5 /end COMPU_METHOD
/begin COMPU_METHOD DC_VEHSPD_KMH_U16 "" RAT_FUNC "%8.5" "km/h" COEFFS 0 16 0 0 0 1 /end COMPU_METHOD
/begin COMPU_METHOD DEZ "1 : 1 Umrechnug (dez/hex)" RAT_FUNC "%6.2" "" COEFFS 0 1 0 0 0 1 /end COMPU_METHOD
/begin COMPU_METHOD dez "1 : 1 Umrechnug (dez/hex)" RAT_FUNC "%6.2" "" COEFFS 0 1 0 0 0 1 /end COMPU_METHOD
/begin COMPU_METHOD dez_sw_q7p812Em3 "" RAT_FUNC "%6.4" "" COEFFS 0 128 0 0 0 1 /end COMPU_METHOD
/begin COMPU_METHOD dez_ub_q7p812Em3 "" RAT_FUNC "%6.4" "" COEFFS 0 128 0 0 0 1 /end COMPU_METHOD
/begin COMPU_METHOD dez_uw_q3p052Em5 "" RAT_FUNC "%7.6" "" COEFFS 0 32768 0 0 0 1 /end COMPU_METHOD
/begin COMPU_METHOD dlw_sw_q0p04375 "" RAT_FUNC "%6.4" "∞/s" COEFFS 0 32767 0 0 0 1434 /end COMPU_METHOD
/begin COMPU_METHOD fak_ub_b1 "" RAT_FUNC "%6.4" "-" COEFFS 0 256 0 0 0 1 /end COMPU_METHOD
/begin COMPU_METHOD fak_ub_b16 "" RAT_FUNC "%6.4" "-" COEFFS 0 256 0 0 0 16 /end COMPU_METHOD
/begin COMPU_METHOD fak_ub_b2 "" RAT_FUNC "%6.4" "-" COEFFS 0 256 0 0 0 2 /end COMPU_METHOD
/begin COMPU_METHOD fak_ub_b32 "" RAT_FUNC "%6.3" "-" COEFFS 0 256 0 0 0 32 /end COMPU_METHOD
/begin COMPU_METHOD fak_ub_b8 "" RAT_FUNC "%6.4" "-" COEFFS 0 256 0 0 0 8 /end COMPU_METHOD
/begin COMPU_METHOD fak_ub_q4p7Em7 "" RAT_FUNC "%11.10" "-" COEFFS 0 1 0 0 0 4.7e-007 /end COMPU_METHOD
/begin COMPU_METHOD fak_uw_b4 "" RAT_FUNC "%7.6" "-" COEFFS 0 65536 0 0 0 4 /end COMPU_METHOD
/begin COMPU_METHOD kw_q0p0078 "" RAT_FUNC "%6.4" "Grad KW" COEFFS 0 128 0 0 0 1 /end COMPU_METHOD
/begin COMPU_METHOD kw_sw_q0p0078 "" RAT_FUNC "%6.4" "Grad KW" COEFFS 0 128 0 0 0 1 /end COMPU_METHOD
/begin COMPU_METHOD kw_ub_q0p5 "" RAT_FUNC "%6.3" "Grad KW" COEFFS 0 256 0 0 0 128 /end COMPU_METHOD
/begin COMPU_METHOD lw_sw_q0p04375 "" RAT_FUNC "%6.4" "∞" COEFFS 0 32767 0 0 0 1434 /end COMPU_METHOD
/begin COMPU_METHOD md_sw_q0p0625 "" RAT_FUNC "%6.4" "Nm" COEFFS 0 16 0 0 0 1 /end COMPU_METHOD
/begin COMPU_METHOD m_ub_q1p0 "" RAT_FUNC "%6.2" "kg/h" COEFFS 0 1 0 0 0 1 /end COMPU_METHOD
/begin COMPU_METHOD nmot_q0p1453421 "" RAT_FUNC "%6.3" "U/min" COEFFS 0 1 0 0 0 0.145342 /end COMPU_METHOD
/begin COMPU_METHOD nmot_q64 "" RAT_FUNC "%6.1" "1/min" COEFFS 0 1 0 0 0 64 /end COMPU_METHOD
/begin COMPU_METHOD nmot_sw_q0p25 "" RAT_FUNC "%6.3" "1/min" COEFFS 0 1 0 0 0 0.25 /end COMPU_METHOD
/begin COMPU_METHOD nmot_sw_q0p5 "" RAT_FUNC "%6.3" "1/min" COEFFS 0 2 0 0 0 1 /end COMPU_METHOD
/begin COMPU_METHOD nmot_ub_q40 "" RAT_FUNC "%6.1" "1/min" COEFFS 0 1 0 0 0 40 /end COMPU_METHOD
/begin COMPU_METHOD nmot_uw_q0p25 "" RAT_FUNC "%6.3" "1/min" COEFFS 0 1 0 0 0 0.25 /end COMPU_METHOD
/begin COMPU_METHOD p_sw_q0p125 "" RAT_FUNC "%6.3" "hpa" COEFFS 0 8 0 0 0 1 /end COMPU_METHOD
/begin COMPU_METHOD relnmot_q0p003052 "" RAT_FUNC "%6.4" "%/(U/min)" COEFFS 0 8192 0 0 0 25 /end COMPU_METHOD
/begin COMPU_METHOD relnmot_q0p01907 "" RAT_FUNC "%6.4" "%/(U/min)/s" COEFFS 0 32768 0 0 0 625 /end COMPU_METHOD
/begin COMPU_METHOD relPED_ub_b100 "" RAT_FUNC "%6.3" "%PED" COEFFS 0 255 0 0 0 100 /end COMPU_METHOD
/begin COMPU_METHOD rel_q0p0977 "" RAT_FUNC "%6.3" "%" COEFFS 0 1024 0 0 0 100 /end COMPU_METHOD
/begin COMPU_METHOD rel_q0p1953 "" RAT_FUNC "%6.3" "%" COEFFS 0 256 0 0 0 50 /end COMPU_METHOD
/begin COMPU_METHOD rel_q0p392 "" RAT_FUNC "%6.3" "%" COEFFS 0 255 0 0 0 100 /end COMPU_METHOD
/begin COMPU_METHOD rel_q0p7629Em3 "" RAT_FUNC "%6.5" "%" COEFFS 0 65536 0 0 0 50 /end COMPU_METHOD
/begin COMPU_METHOD rel_sb_q0p39 "" RAT_FUNC "%6.3" "%" COEFFS 0 1 0 0 0 0.3906 /end COMPU_METHOD
/begin COMPU_METHOD rel_sw_b100 "" RAT_FUNC "%6.4" "%" COEFFS 0 32768 0 0 0 100 /end COMPU_METHOD
/begin COMPU_METHOD rel_sw_q0p015625 "" RAT_FUNC "%6.4" "%" COEFFS 0 64 0 0 0 1 /end COMPU_METHOD
/begin COMPU_METHOD rel_sw_q1p562Em2 "" RAT_FUNC "%6.4" "%" COEFFS 0 64 0 0 0 1 /end COMPU_METHOD
/begin COMPU_METHOD rel_ub_b100 "" RAT_FUNC "%6.3" "%" COEFFS 0 256 0 0 0 100 /end COMPU_METHOD
/begin COMPU_METHOD rel_ub_b127p5 "" RAT_FUNC "%6.3" "%" COEFFS 0 2 0 0 0 1 /end COMPU_METHOD
/begin COMPU_METHOD rel_ub_b99p6 "" RAT_FUNC "%6.3" "%" COEFFS 0 256 0 0 0 100 /end COMPU_METHOD
/begin COMPU_METHOD rel_ub_q0p75 "" RAT_FUNC "%6.3" "%" COEFFS 0 1 0 0 0 0.75 /end COMPU_METHOD
/begin COMPU_METHOD rel_ub_q1 "" RAT_FUNC "%6.2" "%" COEFFS 0 1 0 0 0 1 /end COMPU_METHOD
/begin COMPU_METHOD rel_uw_b100 "" RAT_FUNC "%6.4" "%" COEFFS 0 65536 0 0 0 100 /end COMPU_METHOD
/begin COMPU_METHOD rel_uw_b200 "" RAT_FUNC "%6.4" "%" COEFFS 0 65536 0 0 0 200 /end COMPU_METHOD
/begin COMPU_METHOD rel_uw_b3072 "" RAT_FUNC "%6.4" "%" COEFFS 0 65536 0 0 0 3072 /end COMPU_METHOD
/begin COMPU_METHOD rel_uw_q0p0234 "" RAT_FUNC "%6.4" "%" COEFFS 0 32 0 0 0 0.75 /end COMPU_METHOD
/begin COMPU_METHOD spg_sw_q1p953Em3 "" RAT_FUNC "%6.4" "V" COEFFS 0 512 0 0 0 1 /end COMPU_METHOD
/begin COMPU_METHOD spg_ubatt "" RAT_FUNC "%6.3" "V" COEFFS 0 1 0 0 0 0.0942 /end COMPU_METHOD
/begin COMPU_METHOD t100msxs_uw_b6553p5 "" RAT_FUNC "%6.3" "s" COEFFS 0 1 0 0 0 0.1 /end COMPU_METHOD
/begin COMPU_METHOD t100msxs_uw_b6553p6 "" RAT_FUNC "%6.3" "s" COEFFS 0 10 0 0 0 1 /end COMPU_METHOD
/begin COMPU_METHOD t10msxs_ub_b2p55 "" RAT_FUNC "%6.4" "s" COEFFS 0 1 0 0 0 0.01 /end COMPU_METHOD
/begin COMPU_METHOD t200msxs_ub_b51 "" RAT_FUNC "%6.3" "s" COEFFS 0 1 0 0 0 0.2 /end COMPU_METHOD
/begin COMPU_METHOD t20msxs_ub_b5p1 "" RAT_FUNC "%6.4" "s" COEFFS 0 1 0 0 0 0.02 /end COMPU_METHOD
/begin COMPU_METHOD t20msxs_uw_q0p02 "" RAT_FUNC "%6.4" "s" COEFFS 0 1 0 0 0 0.02 /end COMPU_METHOD
/begin COMPU_METHOD t50msxs_q0p05 "" RAT_FUNC "%6.4" "s" COEFFS 0 1 0 0 0 0.05 /end COMPU_METHOD
/begin COMPU_METHOD t50msxs_ub_b12p75 "" RAT_FUNC "%6.4" "s" COEFFS 0 1 0 0 0 0.05 /end COMPU_METHOD
/begin COMPU_METHOD temp_q0p0234_o273 "" RAT_FUNC "%6.1" "Grad C" COEFFS 0 1 273.15 0 0 0.0234375 /end COMPU_METHOD
/begin COMPU_METHOD temp_sw_q1p25Em1 "" RAT_FUNC "%6.3" "Grad C" COEFFS 0 8 0 0 0 1 /end COMPU_METHOD
/begin COMPU_METHOD temp_ub_q0p75_o48 "" RAT_FUNC "%6.2" "Grad C" COEFFS 0 1 48 0 0 0.75 /end COMPU_METHOD
/begin COMPU_METHOD tz10msxs_uw_b327p68 "" RAT_FUNC "%6.2" "s" COEFFS 0 0 327.68 0 1 0 /end COMPU_METHOD
/begin COMPU_METHOD t_q0p02 "" RAT_FUNC "%6.4" "s" COEFFS 0 100 0 0 0 2 /end COMPU_METHOD
/begin COMPU_METHOD vfzg_ub_q1p25 "" RAT_FUNC "%6.2" "km/h" COEFFS 0 1 0 0 0 1.25 /end COMPU_METHOD
/begin COMPU_METHOD zk100msxs_ub_b25p5 "" RAT_FUNC "%6.3" "s" COEFFS 0 0 256 0 10 0 /end COMPU_METHOD
/begin COMPU_METHOD zk10msxs_ub_b2p55 "" RAT_FUNC "%6.4" "s" COEFFS 0 0 255 0 100 0 /end COMPU_METHOD
/begin COMPU_METHOD zk10msxs_uw_b655 "" RAT_FUNC "%10.4" "s" COEFFS 0 0 65536 0 100 0 /end COMPU_METHOD
/begin COMPU_METHOD zk20msxs_ub_b5p1 "" RAT_FUNC "%6.4" "s" COEFFS 0 0 5.1 0 1 0 /end COMPU_METHOD
/begin COMPU_METHOD zk20msxs_ub_b5p12 "" RAT_FUNC "%6.4" "s" COEFFS 0 0 256 0 50 0 /end COMPU_METHOD
/begin COMPU_METHOD zk50msxs_uw_b3276p8 "" RAT_FUNC "%6.1" "s" COEFFS 0 0 65536 0 20 0 /end COMPU_METHOD
/begin COMPU_METHOD zw_sb_q0p75 "" RAT_FUNC "%6.3" "Grad KW" COEFFS 0 255 0 0 0 191.25 /end COMPU_METHOD
/begin RECORD_LAYOUT dc_ArrSw FNC_VALUES 1 SWORD COLUMN_DIR DIRECT /end RECORD_LAYOUT
/begin RECORD_LAYOUT dc_ArrUb FNC_VALUES 1 UBYTE COLUMN_DIR DIRECT /end RECORD_LAYOUT
/begin RECORD_LAYOUT dc_ArrUw FNC_VALUES 1 UWORD COLUMN_DIR DIRECT /end RECORD_LAYOUT
/begin RECORD_LAYOUT dc_GKfWUb FNC_VALUES 1 UBYTE COLUMN_DIR DIRECT /end RECORD_LAYOUT
/begin RECORD_LAYOUT dc_GKfWUw FNC_VALUES 1 UWORD COLUMN_DIR DIRECT /end RECORD_LAYOUT
/begin RECORD_LAYOUT dc_GKlWSb FNC_VALUES 1 SBYTE COLUMN_DIR DIRECT /end RECORD_LAYOUT
/begin RECORD_LAYOUT dc_GKlWSw FNC_VALUES 1 SWORD COLUMN_DIR DIRECT /end RECORD_LAYOUT
/begin RECORD_LAYOUT dc_GKlWUb FNC_VALUES 1 UBYTE COLUMN_DIR DIRECT /end RECORD_LAYOUT
/begin RECORD_LAYOUT dc_GKlWUw FNC_VALUES 1 UWORD COLUMN_DIR DIRECT /end RECORD_LAYOUT
/begin RECORD_LAYOUT dc_KwSw FNC_VALUES 1 SWORD COLUMN_DIR DIRECT /end RECORD_LAYOUT
/begin RECORD_LAYOUT dc_KwUb FNC_VALUES 1 UBYTE COLUMN_DIR DIRECT /end RECORD_LAYOUT
/begin RECORD_LAYOUT dc_KwUw FNC_VALUES 1 UWORD COLUMN_DIR DIRECT /end RECORD_LAYOUT
/begin RECORD_LAYOUT dc_SstAUbSstSb NO_AXIS_PTS_X 1 UBYTE AXIS_PTS_X 2 SBYTE INDEX_INCR DIRECT /end RECORD_LAYOUT
/begin RECORD_LAYOUT dc_SstAUbSstUb NO_AXIS_PTS_X 1 UBYTE AXIS_PTS_X 2 UBYTE INDEX_INCR DIRECT /end RECORD_LAYOUT
/begin RECORD_LAYOUT dc_SstAUwSstSw NO_AXIS_PTS_X 1 UWORD AXIS_PTS_X 2 SWORD INDEX_INCR DIRECT /end RECORD_LAYOUT
/begin RECORD_LAYOUT dc_SstAUwSstUw NO_AXIS_PTS_X 1 UWORD AXIS_PTS_X 2 UWORD INDEX_INCR DIRECT /end RECORD_LAYOUT
/begin RECORD_LAYOUT FklWSb FNC_VALUES 1 SBYTE COLUMN_DIR DIRECT /end RECORD_LAYOUT
/begin RECORD_LAYOUT FklWUb FNC_VALUES 1 UBYTE COLUMN_DIR DIRECT /end RECORD_LAYOUT
/begin RECORD_LAYOUT FklWUw FNC_VALUES 1 UWORD COLUMN_DIR DIRECT /end RECORD_LAYOUT
/begin RECORD_LAYOUT GkfWSb FNC_VALUES 1 SBYTE COLUMN_DIR DIRECT /end RECORD_LAYOUT
/begin RECORD_LAYOUT GkfWSw FNC_VALUES 1 SWORD COLUMN_DIR DIRECT /end RECORD_LAYOUT
/begin RECORD_LAYOUT GkfWUb FNC_VALUES 1 UBYTE COLUMN_DIR DIRECT /end RECORD_LAYOUT
/begin RECORD_LAYOUT GklWSw FNC_VALUES 1 SWORD COLUMN_DIR DIRECT /end RECORD_LAYOUT
/begin RECORD_LAYOUT GklWUb FNC_VALUES 1 UBYTE COLUMN_DIR DIRECT /end RECORD_LAYOUT
/begin RECORD_LAYOUT GklWUw FNC_VALUES 1 UWORD COLUMN_DIR DIRECT /end RECORD_LAYOUT
/begin RECORD_LAYOUT KfAxSwAySwSstxSwSstySwWSw NO_AXIS_PTS_X 1 SWORD NO_AXIS_PTS_Y 2 SWORD AXIS_PTS_X 3 SWORD INDEX_INCR DIRECT AXIS_PTS_Y 4 SWORD INDEX_INCR DIRECT FNC_VALUES 5 SWORD COLUMN_DIR DIRECT /end RECORD_LAYOUT
/begin RECORD_LAYOUT KfAxUbAyUbSstxUbSstyUbWUb NO_AXIS_PTS_X 1 UBYTE NO_AXIS_PTS_Y 2 UBYTE AXIS_PTS_X 3 UBYTE INDEX_INCR DIRECT AXIS_PTS_Y 4 UBYTE INDEX_INCR DIRECT FNC_VALUES 5 UBYTE COLUMN_DIR DIRECT /end RECORD_LAYOUT
/begin RECORD_LAYOUT KfAxUbAyUbSstxUwSstyUwWUw NO_AXIS_PTS_X 1 UWORD NO_AXIS_PTS_Y 2 UWORD AXIS_PTS_X 3 UWORD INDEX_INCR DIRECT AXIS_PTS_Y 4 UWORD INDEX_INCR DIRECT FNC_VALUES 5 UWORD COLUMN_DIR DIRECT /end RECORD_LAYOUT
/begin RECORD_LAYOUT KfAxUwAyUwSstxUwSstyUwWSw NO_AXIS_PTS_X 1 UWORD NO_AXIS_PTS_Y 2 UWORD AXIS_PTS_X 3 UWORD INDEX_INCR DIRECT AXIS_PTS_Y 4 UWORD INDEX_INCR DIRECT FNC_VALUES 5 SWORD COLUMN_DIR DIRECT /end RECORD_LAYOUT
/begin RECORD_LAYOUT KlAUbSstUbWUb NO_AXIS_PTS_X 1 UBYTE AXIS_PTS_X 2 UBYTE INDEX_INCR DIRECT FNC_VALUES 3 UBYTE COLUMN_DIR DIRECT /end RECORD_LAYOUT
/begin RECORD_LAYOUT KlAUwSstSwWUw NO_AXIS_PTS_X 1 UWORD AXIS_PTS_X 2 SWORD INDEX_INCR DIRECT FNC_VALUES 3 UWORD COLUMN_DIR DIRECT /end RECORD_LAYOUT
/begin RECORD_LAYOUT KlAUwSstUwWSw NO_AXIS_PTS_X 1 UWORD AXIS_PTS_X 2 UWORD INDEX_INCR DIRECT FNC_VALUES 3 SWORD COLUMN_DIR DIRECT /end RECORD_LAYOUT
/begin RECORD_LAYOUT KlAUwSstUwWUw NO_AXIS_PTS_X 1 UWORD AXIS_PTS_X 2 UWORD INDEX_INCR DIRECT FNC_VALUES 3 UWORD COLUMN_DIR DIRECT /end RECORD_LAYOUT
/begin RECORD_LAYOUT KwSb FNC_VALUES 1 SBYTE COLUMN_DIR DIRECT /end RECORD_LAYOUT
/begin RECORD_LAYOUT KwSw FNC_VALUES 1 SWORD COLUMN_DIR DIRECT /end RECORD_LAYOUT
/begin RECORD_LAYOUT KwUb FNC_VALUES 1 UBYTE COLUMN_DIR DIRECT /end RECORD_LAYOUT
/begin RECORD_LAYOUT KwUw FNC_VALUES 1 UWORD COLUMN_DIR DIRECT /end RECORD_LAYOUT
/begin RECORD_LAYOUT SstAUbSstUb NO_AXIS_PTS_X 1 UBYTE AXIS_PTS_X 2 UBYTE INDEX_INCR DIRECT /end RECORD_LAYOUT
/begin RECORD_LAYOUT SstAUwSstUw NO_AXIS_PTS_X 1 UWORD AXIS_PTS_X 2 UWORD INDEX_INCR DIRECT /end RECORD_LAYOUT
/end MODULE
/end PROJECT
