ASAP2_VERSION 1 3
/begin PROJECT _9702_071D00 "ME97"
/begin HEADER "" VERSION "_9702_071D00" PROJECT_NO _9702_071D00 /end HEADER
/begin MODULE DIM ""
/begin MOD_COMMON "" BYTE_ORDER MSB_FIRST ALIGNMENT_BYTE 1 ALIGNMENT_WORD 2 ALIGNMENT_LONG 2 ALIGNMENT_FLOAT32_IEEE 4 /end MOD_COMMON
/begin CHARACTERISTIC ANZTMN "Anzahl 10ms-Raster zur Berechnung des Drossselklappenwinkelgradient dwdktmn_w" VALUE 0x1C2D08 KwUb 3.000 dez 1.000 4.000 FORMAT "%5.3" /end CHARACTERISTIC
/begin CHARACTERISTIC CDCAAA "Dummy: Tabellenanfang" VAL_BLK 0x1D3666 KwbUw 65535.00 dez 0.00 65535.00 FORMAT "%8.2" NUMBER 4 /end CHARACTERISTIC
/begin CHARACTERISTIC CDCACCompr2_Trq "" VAL_BLK 0x1D366E KwbUw 65535.00 dez 0.00 65535.00 FORMAT "%8.2" NUMBER 4 /end CHARACTERISTIC
/begin CHARACTERISTIC CDCACComp_Press "" VAL_BLK 0x1D3676 KwbUw 65535.00 dez 0.00 65535.00 FORMAT "%8.2" NUMBER 4 /end CHARACTERISTIC
/begin CHARACTERISTIC CDCACComp_Trq "" VAL_BLK 0x1D367E KwbUw 65535.00 dez 0.00 65535.00 FORMAT "%8.2" NUMBER 4 /end CHARACTERISTIC
/begin CHARACTERISTIC CDCAdapCrsCtrl_Par "" VAL_BLK 0x1D3686 KwbUw 65535.00 dez 0.00 65535.00 FORMAT "%8.2" NUMBER 4 /end CHARACTERISTIC
/begin CHARACTERISTIC CDCAdapCrsCtrl_Tgl "" VAL_BLK 0x1D368E KwbUw 65535.00 dez 0.00 65535.00 FORMAT "%8.2" NUMBER 4 /end CHARACTERISTIC
/begin CHARACTERISTIC CDCAdapCrsCtrl_TrqReq "" VAL_BLK 0x1D3696 KwbUw 65535.00 dez 0.00 65535.00 FORMAT "%8.2" NUMBER 4 /end CHARACTERISTIC
/begin CHARACTERISTIC CDCAMT_EngEmOffEn "" VAL_BLK 0x1D36AE KwbUw 65535.00 dez 0.00 65535.00 FORMAT "%8.2" NUMBER 4 /end CHARACTERISTIC
/begin CHARACTERISTIC CDCAMT_EngEmOffFl "" VAL_BLK 0x1D36B6 KwbUw 65535.00 dez 0.00 65535.00 FORMAT "%8.2" NUMBER 4 /end CHARACTERISTIC
/begin CHARACTERISTIC CDCANWS "Codewort Carb: Nockenwellensteuerung Auslass Nockenwelle" VAL_BLK 0x1D36BE KwbUw 65535.00 dez 0.00 65535.00 FORMAT "%8.2" NUMBER 4 /end CHARACTERISTIC
/begin CHARACTERISTIC CDCANWS2 "Codewort Carb: Nockenwellensteuerung Auslass Nockenwelle 2" VAL_BLK 0x1D36C6 KwbUw 65535.00 dez 0.00 65535.00 FORMAT "%8.2" NUMBER 4 /end CHARACTERISTIC
/begin CHARACTERISTIC CDCAP_Pt1HiLim "" VAL_BLK 0x1D36DE KwbUw 65535.00 dez 0.00 65535.00 FORMAT "%8.2" NUMBER 4 /end CHARACTERISTIC
/begin CHARACTERISTIC CDCAP_Pt1LoLim "" VAL_BLK 0x1D36E6 KwbUw 65535.00 dez 0.00 65535.00 FORMAT "%8.2" NUMBER 4 /end CHARACTERISTIC
/begin CHARACTERISTIC CDCAP_Pt2HiLim "" VAL_BLK 0x1D36EE KwbUw 65535.00 dez 0.00 65535.00 FORMAT "%8.2" NUMBER 4 /end CHARACTERISTIC
/begin CHARACTERISTIC CDCAP_Pt2LoLim "" VAL_BLK 0x1D36F6 KwbUw 65535.00 dez 0.00 65535.00 FORMAT "%8.2" NUMBER 4 /end CHARACTERISTIC
/begin CHARACTERISTIC CDCAP_PtDiff "" VAL_BLK 0x1D36FE KwbUw 65535.00 dez 0.00 65535.00 FORMAT "%8.2" NUMBER 4 /end CHARACTERISTIC
/begin CHARACTERISTIC CDCAP_PtSupp "" VAL_BLK 0x1D3706 KwbUw 65535.00 dez 0.00 65535.00 FORMAT "%8.2" NUMBER 4 /end CHARACTERISTIC
/begin CHARACTERISTIC CDCBLS_Par "" VAL_BLK 0x1D370E KwbUw 65535.00 dez 0.00 65535.00 FORMAT "%8.2" NUMBER 4 /end CHARACTERISTIC
/begin CHARACTERISTIC CDCBLS_Tgl "" VAL_BLK 0x1D3716 KwbUw 65535.00 dez 0.00 65535.00 FORMAT "%8.2" NUMBER 4 /end CHARACTERISTIC
/begin CHARACTERISTIC CDCBLS_Undef "" VAL_BLK 0x1D371E KwbUw 65535.00 dez 0.00 65535.00 FORMAT "%8.2" NUMBER 4 /end CHARACTERISTIC
/begin CHARACTERISTIC CDCBM "Codewort CARB: Bezugsmarkengeber" VAL_BLK 0x1D3726 KwbUw 65535.00 dez 0.00 65535.00 FORMAT "%8.2" NUMBER 4 /end CHARACTERISTIC
/begin CHARACTERISTIC CDCCAN "" VAL_BLK 0x1D3736 KwbUw 65535.00 dez 0.00 65535.00 FORMAT "%8.2" NUMBER 4 /end CHARACTERISTIC
/begin CHARACTERISTIC CDCCoolFan_SpdReq "" VAL_BLK 0x1D3766 KwbUw 65535.00 dez 0.00 65535.00 FORMAT "%8.2" NUMBER 4 /end CHARACTERISTIC
/begin CHARACTERISTIC CDCDK "Codewort CARB:	DK - Potentiometer" VAL_BLK 0x1D377E KwbUw 65535.00 dez 0.00 65535.00 FORMAT "%8.2" NUMBER 4 /end CHARACTERISTIC
/begin CHARACTERISTIC CDCDK1P "Codewort CARB: Drosselklappe 1. Poti" VAL_BLK 0x1D3786 KwbUw 65535.00 dez 0.00 65535.00 FORMAT "%8.2" NUMBER 4 /end CHARACTERISTIC
/begin CHARACTERISTIC CDCDK2P "Codewort CARB: Drosselklappe 2. Poti" VAL_BLK 0x1D378E KwbUw 65535.00 dez 0.00 65535.00 FORMAT "%8.2" NUMBER 4 /end CHARACTERISTIC
/begin CHARACTERISTIC CDCDSS "Codewort CARB: Saugrohr-Drucksensor" VAL_BLK 0x1D37B6 KwbUw 65535.00 dez 0.00 65535.00 FORMAT "%8.2" NUMBER 4 /end CHARACTERISTIC
/begin CHARACTERISTIC CDCDVEE "Codewort CARB: DV-E Endstufe" VAL_BLK 0x1D37C6 KwbUw 65535.00 dez 0.00 65535.00 FORMAT "%8.2" NUMBER 4 /end CHARACTERISTIC
/begin CHARACTERISTIC CDCDVEF "Codewort CARB: DV-E Fehler bei Federpr¸fung" VAL_BLK 0x1D37CE KwbUw 65535.00 dez 0.00 65535.00 FORMAT "%8.2" NUMBER 4 /end CHARACTERISTIC
/begin CHARACTERISTIC CDCDVEFO "" VAL_BLK 0x1D37D6 KwbUw 65535.00 dez 0.00 65535.00 FORMAT "%8.2" NUMBER 4 /end CHARACTERISTIC
/begin CHARACTERISTIC CDCDVEL "Codewort CARB: DV-E Lageabweichung" VAL_BLK 0x1D37DE KwbUw 65535.00 dez 0.00 65535.00 FORMAT "%8.2" NUMBER 4 /end CHARACTERISTIC
/begin CHARACTERISTIC CDCDVEN "Codewort CARB: DV-E Fehler bei Pr¸fung Notluftposition" VAL_BLK 0x1D37E6 KwbUw 65535.00 dez 0.00 65535.00 FORMAT "%8.2" NUMBER 4 /end CHARACTERISTIC
/begin CHARACTERISTIC CDCDVER "Codewort CARB: DV-E Regelbereich" VAL_BLK 0x1D37EE KwbUw 65535.00 dez 0.00 65535.00 FORMAT "%8.2" NUMBER 4 /end CHARACTERISTIC
/begin CHARACTERISTIC CDCDVET "" VAL_BLK 0x1D37F6 KwbUw 65535.00 dez 0.00 65535.00 FORMAT "%8.2" NUMBER 4 /end CHARACTERISTIC
/begin CHARACTERISTIC CDCDVEU "Codewort CARB: DV-E Fehler beim UMA-Lernen" VAL_BLK 0x1D37FE KwbUw 65535.00 dez 0.00 65535.00 FORMAT "%8.2" NUMBER 4 /end CHARACTERISTIC
/begin CHARACTERISTIC CDCDVEUB "" VAL_BLK 0x1D3806 KwbUw 65535.00 dez 0.00 65535.00 FORMAT "%8.2" NUMBER 4 /end CHARACTERISTIC
/begin CHARACTERISTIC CDCDVEUW "" VAL_BLK 0x1D380E KwbUw 65535.00 dez 0.00 65535.00 FORMAT "%8.2" NUMBER 4 /end CHARACTERISTIC
/begin CHARACTERISTIC CDCDVEV "Codewort CARB: DV-E Fehler bei Verst‰rkerabgleich" VAL_BLK 0x1D3816 KwbUw 65535.00 dez 0.00 65535.00 FORMAT "%8.2" NUMBER 4 /end CHARACTERISTIC
/begin CHARACTERISTIC CDCENWS "Codewort Carb: Nockenwellensteuerung Einlass Nockenwelle" VAL_BLK 0x1D383E KwbUw 65535.00 dez 0.00 65535.00 FORMAT "%8.2" NUMBER 4 /end CHARACTERISTIC
/begin CHARACTERISTIC CDCENWS2 "Codewort Carb: Nockenwellensteuerung Einlass Nockenwelle 2" VAL_BLK 0x1D3846 KwbUw 65535.00 dez 0.00 65535.00 FORMAT "%8.2" NUMBER 4 /end CHARACTERISTIC
/begin CHARACTERISTIC CDCEV1 "Codewort CARB: EV von Zyl. 1" VAL_BLK 0x1D387E KwbWU16 65535.00 dez 0.00 65535.00 FORMAT "%8.2" NUMBER 4 /end CHARACTERISTIC
/begin CHARACTERISTIC CDCEV2 "Codewort CARB: EV von Zyl. 2" VAL_BLK 0x1D3886 KwbWU16 65535.00 dez 0.00 65535.00 FORMAT "%8.2" NUMBER 4 /end CHARACTERISTIC
/begin CHARACTERISTIC CDCEV3 "Codewort CARB: EV von Zyl. 3" VAL_BLK 0x1D388E KwbWU16 65535.00 dez 0.00 65535.00 FORMAT "%8.2" NUMBER 4 /end CHARACTERISTIC
/begin CHARACTERISTIC CDCEV4 "Codewort CARB: EV von Zyl. 4" VAL_BLK 0x1D3896 KwbWU16 65535.00 dez 0.00 65535.00 FORMAT "%8.2" NUMBER 4 /end CHARACTERISTIC
/begin CHARACTERISTIC CDCEV5 "Codewort CARB: EV von Zyl. 5" VAL_BLK 0x1D389E KwbWU16 65535.00 dez 0.00 65535.00 FORMAT "%8.2" NUMBER 4 /end CHARACTERISTIC
/begin CHARACTERISTIC CDCEV6 "Codewort CARB: EV von Zyl. 6" VAL_BLK 0x1D38A6 KwbWU16 65535.00 dez 0.00 65535.00 FORMAT "%8.2" NUMBER 4 /end CHARACTERISTIC
/begin CHARACTERISTIC CDCEV7 "Codewort CARB: EV von Zyl. 7" VAL_BLK 0x1D38AE KwbWU16 65535.00 dez 0.00 65535.00 FORMAT "%8.2" NUMBER 4 /end CHARACTERISTIC
/begin CHARACTERISTIC CDCEV8 "Codewort CARB: EV von Zyl. 8" VAL_BLK 0x1D38B6 KwbWU16 65535.00 dez 0.00 65535.00 FORMAT "%8.2" NUMBER 4 /end CHARACTERISTIC
/begin CHARACTERISTIC CDCKKUE "Codewort CARB: Kraftstoffkreislauf-Umschaltung Endstufe" VAL_BLK 0x1D398E KwbUw 65535.00 dez 0.00 65535.00 FORMAT "%8.2" NUMBER 4 /end CHARACTERISTIC
/begin CHARACTERISTIC CDCKPE "Codewort CARB: EKP-Relais Endstufe" VAL_BLK 0x1D3996 KwbWU16 65535.00 dez 0.00 65535.00 FORMAT "%8.2" NUMBER 4 /end CHARACTERISTIC
/begin CHARACTERISTIC CDCLDE "Codewort CARB: Ladedrucksteuerventil (Endstufe)" VAL_BLK 0x1D39F6 KwbUw 65535.00 dez 0.00 65535.00 FORMAT "%8.2" NUMBER 4 /end CHARACTERISTIC
/begin CHARACTERISTIC CDCLDPE "Codewort CARB: Leckdiagnosepumpe Endstufe" VAL_BLK 0x1D3A06 KwbUw 65535.00 dez 0.00 65535.00 FORMAT "%8.2" NUMBER 4 /end CHARACTERISTIC
/begin CHARACTERISTIC CDCLUVE "Codewort CARB: EV-Luftumfassungsventil Endstufe" VAL_BLK 0x1D3A96 KwbUw 65535.00 dez 0.00 65535.00 FORMAT "%8.2" NUMBER 4 /end CHARACTERISTIC
/begin CHARACTERISTIC CDCN "Codewort CARB: Drehzahlsignalgeber" VAL_BLK 0x1D3B26 KwbUw 65535.00 dez 0.00 65535.00 FORMAT "%8.2" NUMBER 4 /end CHARACTERISTIC
/begin CHARACTERISTIC CDCSWE "Codewort CARB:	Beschleunigungssensor der Schlechtwegeerkennung" VAL_BLK 0x1D3C2E KwbWU16 65535.00 dez 0.00 65535.00 FORMAT "%8.2" NUMBER 4 /end CHARACTERISTIC
/begin CHARACTERISTIC CDCZZZ "Dummy: Tabellenende" VAL_BLK 0x1D3D26 KwbUw 65535.00 dez 0.00 65535.00 FORMAT "%8.2" NUMBER 4 /end CHARACTERISTIC
/begin CHARACTERISTIC CDKAAA "Dummy: Tabellenanfang" VALUE 0x1D3D2E KwUw 65535.00 dez 0.00 65535.00 FORMAT "%8.2" /end CHARACTERISTIC
/begin CHARACTERISTIC CDKACCompr2_Trq "" VALUE 0x1D3D30 KwUw 65535.00 dez 0.00 65535.00 FORMAT "%8.2" /end CHARACTERISTIC
/begin CHARACTERISTIC CDKACComp_Press "" VALUE 0x1D3D32 KwUw 65535.00 dez 0.00 65535.00 FORMAT "%8.2" /end CHARACTERISTIC
/begin CHARACTERISTIC CDKACComp_Trq "" VALUE 0x1D3D34 KwUw 65535.00 dez 0.00 65535.00 FORMAT "%8.2" /end CHARACTERISTIC
/begin CHARACTERISTIC CDKAdapCrsCtrl_Par "" VALUE 0x1D3D36 KwUw 65535.00 dez 0.00 65535.00 FORMAT "%8.2" /end CHARACTERISTIC
/begin CHARACTERISTIC CDKAdapCrsCtrl_Tgl "" VALUE 0x1D3D38 KwUw 65535.00 dez 0.00 65535.00 FORMAT "%8.2" /end CHARACTERISTIC
/begin CHARACTERISTIC CDKAdapCrsCtrl_TrqReq "" VALUE 0x1D3D3A KwUw 65535.00 dez 0.00 65535.00 FORMAT "%8.2" /end CHARACTERISTIC
/begin CHARACTERISTIC CDKAMT_EngEmOffEn "" VALUE 0x1D3D40 KwUw 65535.00 dez 0.00 65535.00 FORMAT "%8.2" /end CHARACTERISTIC
/begin CHARACTERISTIC CDKAMT_EngEmOffFl "" VALUE 0x1D3D42 KwUw 65535.00 dez 0.00 65535.00 FORMAT "%8.2" /end CHARACTERISTIC
/begin CHARACTERISTIC CDKANWS "Codewort Kunde: Nockenwellensteuerung Auslass Nockenwelle" VALUE 0x1D3D44 KwUw 65535.00 dez 0.00 65535.00 FORMAT "%8.2" /end CHARACTERISTIC
/begin CHARACTERISTIC CDKANWS2 "Codewort Kunde: Nockenwellensteuerung Auslass Nockenwelle 2" VALUE 0x1D3D46 KwUw 65535.00 dez 0.00 65535.00 FORMAT "%8.2" /end CHARACTERISTIC
/begin CHARACTERISTIC CDKAP_Pt1HiLim "" VALUE 0x1D3D4C KwUw 65535.00 dez 0.00 65535.00 FORMAT "%8.2" /end CHARACTERISTIC
/begin CHARACTERISTIC CDKAP_Pt1LoLim "" VALUE 0x1D3D4E KwUw 65535.00 dez 0.00 65535.00 FORMAT "%8.2" /end CHARACTERISTIC
/begin CHARACTERISTIC CDKAP_Pt2HiLim "" VALUE 0x1D3D50 KwUw 65535.00 dez 0.00 65535.00 FORMAT "%8.2" /end CHARACTERISTIC
/begin CHARACTERISTIC CDKAP_Pt2LoLim "" VALUE 0x1D3D52 KwUw 65535.00 dez 0.00 65535.00 FORMAT "%8.2" /end CHARACTERISTIC
/begin CHARACTERISTIC CDKAP_PtDiff "" VALUE 0x1D3D54 KwUw 65535.00 dez 0.00 65535.00 FORMAT "%8.2" /end CHARACTERISTIC
/begin CHARACTERISTIC CDKAP_PtSupp "" VALUE 0x1D3D56 KwUw 65535.00 dez 0.00 65535.00 FORMAT "%8.2" /end CHARACTERISTIC
/begin CHARACTERISTIC CDKBLS_Par "" VALUE 0x1D3D58 KwUw 65535.00 dez 0.00 65535.00 FORMAT "%8.2" /end CHARACTERISTIC
/begin CHARACTERISTIC CDKBLS_Tgl "" VALUE 0x1D3D5A KwUw 65535.00 dez 0.00 65535.00 FORMAT "%8.2" /end CHARACTERISTIC
/begin CHARACTERISTIC CDKBLS_Undef "" VALUE 0x1D3D5C KwUw 65535.00 dez 0.00 65535.00 FORMAT "%8.2" /end CHARACTERISTIC
/begin CHARACTERISTIC CDKBM "Codewort Kunde: Bezugsmarkengeber" VALUE 0x1D3D5E KwUw 65535.00 dez 0.00 65535.00 FORMAT "%8.2" /end CHARACTERISTIC
/begin CHARACTERISTIC CDKCAN "" VALUE 0x1D3D62 KwUw 65535.00 dez 0.00 65535.00 FORMAT "%8.2" /end CHARACTERISTIC
/begin CHARACTERISTIC CDKCoolFan_SpdReq "" VALUE 0x1D3D6E KwUw 65535.00 dez 0.00 65535.00 FORMAT "%8.2" /end CHARACTERISTIC
/begin CHARACTERISTIC CDKDK "Codewort Kunde: DK - Potentiometer" VALUE 0x1D3D74 KwUw 65535.00 dez 0.00 65535.00 FORMAT "%8.2" /end CHARACTERISTIC
/begin CHARACTERISTIC CDKDK1P "Codewort Kunde: Drosselklappe 1. Poti" VALUE 0x1D3D76 KwUw 65535.00 dez 0.00 65535.00 FORMAT "%8.2" /end CHARACTERISTIC
/begin CHARACTERISTIC CDKDK2P "Codewort Kunde: Drosselklappenpotentiometer 2" VALUE 0x1D3D78 KwUw 65535.00 dez 0.00 65535.00 FORMAT "%8.2" /end CHARACTERISTIC
/begin CHARACTERISTIC CDKDSS "Codewort Kunde: Saugrohr-Drucksensor" VALUE 0x1D3D82 KwUw 65535.00 dez 0.00 65535.00 FORMAT "%8.2" /end CHARACTERISTIC
/begin CHARACTERISTIC CDKDVEE "Codewort Kunde: DV-E Endstufe" VALUE 0x1D3D86 KwUw 65535.00 dez 0.00 65535.00 FORMAT "%8.2" /end CHARACTERISTIC
/begin CHARACTERISTIC CDKDVEF "Codewort Kunde: DV-E Fehler bei Federpr¸fung" VALUE 0x1D3D88 KwUw 65535.00 dez 0.00 65535.00 FORMAT "%8.2" /end CHARACTERISTIC
/begin CHARACTERISTIC CDKDVEFO "" VALUE 0x1D3D8A KwUw 65535.00 dez 0.00 65535.00 FORMAT "%8.2" /end CHARACTERISTIC
/begin CHARACTERISTIC CDKDVEL "Codewort Kunde: DV-E Lageabweichung" VALUE 0x1D3D8C KwUw 65535.00 dez 0.00 65535.00 FORMAT "%8.2" /end CHARACTERISTIC
/begin CHARACTERISTIC CDKDVEN "Codewort Kunde: DV-E Fehler bei Pr¸fung Notlufposition" VALUE 0x1D3D8E KwUw 65535.00 dez 0.00 65535.00 FORMAT "%8.2" /end CHARACTERISTIC
/begin CHARACTERISTIC CDKDVER "Codewort Kunde: DV-E Regelbereich" VALUE 0x1D3D90 KwUw 65535.00 dez 0.00 65535.00 FORMAT "%8.2" /end CHARACTERISTIC
/begin CHARACTERISTIC CDKDVET "" VALUE 0x1D3D92 KwUw 65535.00 dez 0.00 65535.00 FORMAT "%8.2" /end CHARACTERISTIC
/begin CHARACTERISTIC CDKDVEU "Codewort Kunde: DV-E Fehler beim UMA-Lernen" VALUE 0x1D3D94 KwUw 65535.00 dez 0.00 65535.00 FORMAT "%8.2" /end CHARACTERISTIC
/begin CHARACTERISTIC CDKDVEUB "" VALUE 0x1D3D96 KwUw 65535.00 dez 0.00 65535.00 FORMAT "%8.2" /end CHARACTERISTIC
/begin CHARACTERISTIC CDKDVEUW "" VALUE 0x1D3D98 KwUw 65535.00 dez 0.00 65535.00 FORMAT "%8.2" /end CHARACTERISTIC
/begin CHARACTERISTIC CDKDVEV "Codewort Kunde: DV-E Fehler bei Verst‰rkerabgleich" VALUE 0x1D3D9A KwUw 65535.00 dez 0.00 65535.00 FORMAT "%8.2" /end CHARACTERISTIC
/begin CHARACTERISTIC CDKENWS "Codewort Kunde: Nockenwellensteuerung Einlass Nockenwelle" VALUE 0x1D3DA4 KwUw 65535.00 dez 0.00 65535.00 FORMAT "%8.2" /end CHARACTERISTIC
/begin CHARACTERISTIC CDKENWS2 "Codewort Kunde: Nockenwellensteuerung Einlass Nockenwelle 2" VALUE 0x1D3DA6 KwUw 65535.00 dez 0.00 65535.00 FORMAT "%8.2" /end CHARACTERISTIC
/begin CHARACTERISTIC CDKEV1 "Codewort Kunde: EV von Zyl. 1" VALUE 0x1D3DB4 KwWU16 65535.00 dez 0.00 65535.00 FORMAT "%8.2" /end CHARACTERISTIC
/begin CHARACTERISTIC CDKEV2 "Codewort Kunde: EV von Zyl. 2" VALUE 0x1D3DB6 KwWU16 65535.00 dez 0.00 65535.00 FORMAT "%8.2" /end CHARACTERISTIC
/begin CHARACTERISTIC CDKEV3 "Codewort Kunde: EV von Zyl. 3" VALUE 0x1D3DB8 KwWU16 65535.00 dez 0.00 65535.00 FORMAT "%8.2" /end CHARACTERISTIC
/begin CHARACTERISTIC CDKEV4 "Codewort Kunde: EV von Zyl. 4" VALUE 0x1D3DBA KwWU16 65535.00 dez 0.00 65535.00 FORMAT "%8.2" /end CHARACTERISTIC
/begin CHARACTERISTIC CDKEV5 "Codewort Kunde: EV von Zyl. 5" VALUE 0x1D3DBC KwWU16 65535.00 dez 0.00 65535.00 FORMAT "%8.2" /end CHARACTERISTIC
/begin CHARACTERISTIC CDKEV6 "Codewort Kunde: EV von Zyl. 6" VALUE 0x1D3DBE KwWU16 65535.00 dez 0.00 65535.00 FORMAT "%8.2" /end CHARACTERISTIC
/begin CHARACTERISTIC CDKEV7 "Codewort Kunde: EV von Zyl. 7" VALUE 0x1D3DC0 KwWU16 65535.00 dez 0.00 65535.00 FORMAT "%8.2" /end CHARACTERISTIC
/begin CHARACTERISTIC CDKEV8 "Codewort Kunde: EV von Zyl. 8" VALUE 0x1D3DC2 KwWU16 65535.00 dez 0.00 65535.00 FORMAT "%8.2" /end CHARACTERISTIC
/begin CHARACTERISTIC CDKKKUE "Codewort Kunde: Kraftstoffkreislauf-Umschaltung Endstufe" VALUE 0x1D3DF8 KwUw 65535.00 dez 0.00 65535.00 FORMAT "%8.2" /end CHARACTERISTIC
/begin CHARACTERISTIC CDKKPE "Codewort Kunde: EKP-Relais Endstufe" VALUE 0x1D3DFA KwWU16 65535.00 dez 0.00 65535.00 FORMAT "%8.2" /end CHARACTERISTIC
/begin CHARACTERISTIC CDKLDE "Codeword Kunde: Ladedrucksteuerventil (Endstufe)" VALUE 0x1D3E12 KwUw 65535.00 dez 0.00 65535.00 FORMAT "%8.2" /end CHARACTERISTIC
/begin CHARACTERISTIC CDKLDPE "Codewort Kunde: Leckdiagnosepumpe Endstufe" VALUE 0x1D3E16 KwUw 65535.00 dez 0.00 65535.00 FORMAT "%8.2" /end CHARACTERISTIC
/begin CHARACTERISTIC CDKLUVE "Codewort Kunde: EV-Luftumfassungsventil Endstufe" VALUE 0x1D3E3A KwUw 65535.00 dez 0.00 65535.00 FORMAT "%8.2" /end CHARACTERISTIC
/begin CHARACTERISTIC CDKN "Codewort Kunde: Drehzahlsignalgeber" VALUE 0x1D3E5E KwUw 65535.00 dez 0.00 65535.00 FORMAT "%8.2" /end CHARACTERISTIC
/begin CHARACTERISTIC CDKSWE "Codewort Kunde:	Beschleunigungssensor der Schlechtwegeerkennung" VALUE 0x1D3EA0 KwWU16 65535.00 dez 0.00 65535.00 FORMAT "%8.2" /end CHARACTERISTIC
/begin CHARACTERISTIC CDKZZZ "Dummy: Tabellenendeng" VALUE 0x1D3EDE KwUw 65535.00 dez 0.00 65535.00 FORMAT "%8.2" /end CHARACTERISTIC
/begin CHARACTERISTIC CDTAAA "Dummy: Tabellenanfang" VALUE 0x1D3EE0 KwUw 65535.00 dez 0.00 65535.00 FORMAT "%8.2" /end CHARACTERISTIC
/begin CHARACTERISTIC CDTACCompr2_Trq "" VALUE 0x1D3EE2 KwUw 65535.00 dez 0.00 65535.00 FORMAT "%8.2" /end CHARACTERISTIC
/begin CHARACTERISTIC CDTACComp_Press "" VALUE 0x1D3EE4 KwUw 65535.00 dez 0.00 65535.00 FORMAT "%8.2" /end CHARACTERISTIC
/begin CHARACTERISTIC CDTACComp_Trq "" VALUE 0x1D3EE6 KwUw 65535.00 dez 0.00 65535.00 FORMAT "%8.2" /end CHARACTERISTIC
/begin CHARACTERISTIC CDTAdapCrsCtrl_Par "" VALUE 0x1D3EE8 KwUw 65535.00 dez 0.00 65535.00 FORMAT "%8.2" /end CHARACTERISTIC
/begin CHARACTERISTIC CDTAdapCrsCtrl_Tgl "" VALUE 0x1D3EEA KwUw 65535.00 dez 0.00 65535.00 FORMAT "%8.2" /end CHARACTERISTIC
/begin CHARACTERISTIC CDTAdapCrsCtrl_TrqReq "" VALUE 0x1D3EEC KwUw 65535.00 dez 0.00 65535.00 FORMAT "%8.2" /end CHARACTERISTIC
/begin CHARACTERISTIC CDTAMT_EngEmOffEn "" VALUE 0x1D3EF2 KwUw 65535.00 dez 0.00 65535.00 FORMAT "%8.2" /end CHARACTERISTIC
/begin CHARACTERISTIC CDTAMT_EngEmOffFl "" VALUE 0x1D3EF4 KwUw 65535.00 dez 0.00 65535.00 FORMAT "%8.2" /end CHARACTERISTIC
/begin CHARACTERISTIC CDTANWS "Codewort Tester: Nockenwellensteuerung Auslass Nockenwelle" VALUE 0x1D3EF6 KwUw 65535.00 dez 0.00 65535.00 FORMAT "%8.2" /end CHARACTERISTIC
/begin CHARACTERISTIC CDTANWS2 "Codewort Tester: Nockenwellensteuerung Auslass Nockenwelle 2" VALUE 0x1D3EF8 KwUw 65535.00 dez 0.00 65535.00 FORMAT "%8.2" /end CHARACTERISTIC
/begin CHARACTERISTIC CDTAP_Pt1HiLim "" VALUE 0x1D3EFE KwUw 65535.00 dez 0.00 65535.00 FORMAT "%8.2" /end CHARACTERISTIC
/begin CHARACTERISTIC CDTAP_Pt1LoLim "" VALUE 0x1D3F00 KwUw 65535.00 dez 0.00 65535.00 FORMAT "%8.2" /end CHARACTERISTIC
/begin CHARACTERISTIC CDTAP_Pt2HiLim "" VALUE 0x1D3F02 KwUw 65535.00 dez 0.00 65535.00 FORMAT "%8.2" /end CHARACTERISTIC
/begin CHARACTERISTIC CDTAP_Pt2LoLim "" VALUE 0x1D3F04 KwUw 65535.00 dez 0.00 65535.00 FORMAT "%8.2" /end CHARACTERISTIC
/begin CHARACTERISTIC CDTAP_PtDiff "" VALUE 0x1D3F06 KwUw 65535.00 dez 0.00 65535.00 FORMAT "%8.2" /end CHARACTERISTIC
/begin CHARACTERISTIC CDTAP_PtSupp "" VALUE 0x1D3F08 KwUw 65535.00 dez 0.00 65535.00 FORMAT "%8.2" /end CHARACTERISTIC
/begin CHARACTERISTIC CDTBLS_Par "" VALUE 0x1D3F0A KwUw 65535.00 dez 0.00 65535.00 FORMAT "%8.2" /end CHARACTERISTIC
/begin CHARACTERISTIC CDTBLS_Tgl "" VALUE 0x1D3F0C KwUw 65535.00 dez 0.00 65535.00 FORMAT "%8.2" /end CHARACTERISTIC
/begin CHARACTERISTIC CDTBLS_Undef "" VALUE 0x1D3F0E KwUw 65535.00 dez 0.00 65535.00 FORMAT "%8.2" /end CHARACTERISTIC
/begin CHARACTERISTIC CDTBM "Codewort Tester: Bezugsmarkengeber" VALUE 0x1D3F10 KwUw 65535.00 dez 0.00 65535.00 FORMAT "%8.2" /end CHARACTERISTIC
/begin CHARACTERISTIC CDTCAN "" VALUE 0x1D3F14 KwUw 65535.00 dez 0.00 65535.00 FORMAT "%8.2" /end CHARACTERISTIC
/begin CHARACTERISTIC CDTCoolFan_SpdReq "" VALUE 0x1D3F20 KwUw 65535.00 dez 0.00 65535.00 FORMAT "%8.2" /end CHARACTERISTIC
/begin CHARACTERISTIC CDTDK "Codewort Tester: DK - Potentiometer" VALUE 0x1D3F26 KwUw 65535.00 dez 0.00 65535.00 FORMAT "%8.2" /end CHARACTERISTIC
/begin CHARACTERISTIC CDTDK1P "Codewort Tester: Drosselklappe 1. Poti" VALUE 0x1D3F28 KwUw 65535.00 dez 0.00 65535.00 FORMAT "%8.2" /end CHARACTERISTIC
/begin CHARACTERISTIC CDTDK2P "Codewort Tester: Drosselklappenpotentiometer 2" VALUE 0x1D3F2A KwUw 65535.00 dez 0.00 65535.00 FORMAT "%8.2" /end CHARACTERISTIC
/begin CHARACTERISTIC CDTDSS "Codewort Tester: Saugrohr-Drucksensor" VALUE 0x1D3F34 KwUw 65535.00 dez 0.00 65535.00 FORMAT "%8.2" /end CHARACTERISTIC
/begin CHARACTERISTIC CDTDVEE "Codewort Tester: DV-E Endstufe" VALUE 0x1D3F38 KwUw 65535.00 dez 0.00 65535.00 FORMAT "%8.2" /end CHARACTERISTIC
/begin CHARACTERISTIC CDTDVEF "Codewort Tester: DV-E Fehler bei Federpr¸fung" VALUE 0x1D3F3A KwUw 65535.00 dez 0.00 65535.00 FORMAT "%8.2" /end CHARACTERISTIC
/begin CHARACTERISTIC CDTDVEFO "" VALUE 0x1D3F3C KwUw 65535.00 dez 0.00 65535.00 FORMAT "%8.2" /end CHARACTERISTIC
/begin CHARACTERISTIC CDTDVEL "Codewort Tester: DV-E Lageabweichung" VALUE 0x1D3F3E KwUw 65535.00 dez 0.00 65535.00 FORMAT "%8.2" /end CHARACTERISTIC
/begin CHARACTERISTIC CDTDVEN "Codewort Tester: DV-E Fehler bei Pr¸fung Notlufposition" VALUE 0x1D3F40 KwUw 65535.00 dez 0.00 65535.00 FORMAT "%8.2" /end CHARACTERISTIC
/begin CHARACTERISTIC CDTDVER "Codewort Tester: DV-E Regelbereich" VALUE 0x1D3F42 KwUw 65535.00 dez 0.00 65535.00 FORMAT "%8.2" /end CHARACTERISTIC
/begin CHARACTERISTIC CDTDVET "" VALUE 0x1D3F44 KwUw 65535.00 dez 0.00 65535.00 FORMAT "%8.2" /end CHARACTERISTIC
/begin CHARACTERISTIC CDTDVEU "Codewort Tester: DV-E Fehler beim UMA-Lernen" VALUE 0x1D3F46 KwUw 65535.00 dez 0.00 65535.00 FORMAT "%8.2" /end CHARACTERISTIC
/begin CHARACTERISTIC CDTDVEUB "" VALUE 0x1D3F48 KwUw 65535.00 dez 0.00 65535.00 FORMAT "%8.2" /end CHARACTERISTIC
/begin CHARACTERISTIC CDTDVEUW "" VALUE 0x1D3F4A KwUw 65535.00 dez 0.00 65535.00 FORMAT "%8.2" /end CHARACTERISTIC
/begin CHARACTERISTIC CDTDVEV "Codewort Tester: DV-E Fehler bei Verst‰rkerabgleich" VALUE 0x1D3F4C KwUw 65535.00 dez 0.00 65535.00 FORMAT "%8.2" /end CHARACTERISTIC
/begin CHARACTERISTIC CDTENWS "Codewort Tester: Nockenwellensteuerung Einlass Nockenwelle" VALUE 0x1D3F56 KwUw 65535.00 dez 0.00 65535.00 FORMAT "%8.2" /end CHARACTERISTIC
/begin CHARACTERISTIC CDTENWS2 "Codewort Tester: Nockenwellensteuerung Einlass Nockenwelle 2" VALUE 0x1D3F58 KwUw 65535.00 dez 0.00 65535.00 FORMAT "%8.2" /end CHARACTERISTIC
/begin CHARACTERISTIC CDTEV1 "Codewort Tester: EV von Zyl. 1" VALUE 0x1D3F66 KwWU16 65535.00 dez 0.00 65535.00 FORMAT "%8.2" /end CHARACTERISTIC
/begin CHARACTERISTIC CDTEV2 "Codewort Tester: EV von Zyl. 2" VALUE 0x1D3F68 KwWU16 65535.00 dez 0.00 65535.00 FORMAT "%8.2" /end CHARACTERISTIC
/begin CHARACTERISTIC CDTEV3 "Codewort Tester: EV von Zyl. 3" VALUE 0x1D3F6A KwWU16 65535.00 dez 0.00 65535.00 FORMAT "%8.2" /end CHARACTERISTIC
/begin CHARACTERISTIC CDTEV4 "Codewort Tester: EV von Zyl. 4" VALUE 0x1D3F6C KwWU16 65535.00 dez 0.00 65535.00 FORMAT "%8.2" /end CHARACTERISTIC
/begin CHARACTERISTIC CDTEV5 "Codewort Tester: EV von Zyl. 5" VALUE 0x1D3F6E KwWU16 65535.00 dez 0.00 65535.00 FORMAT "%8.2" /end CHARACTERISTIC
/begin CHARACTERISTIC CDTEV6 "Codewort Tester: EV von Zyl. 6" VALUE 0x1D3F70 KwWU16 65535.00 dez 0.00 65535.00 FORMAT "%8.2" /end CHARACTERISTIC
/begin CHARACTERISTIC CDTEV7 "Codewort Tester: EV von Zyl. 7" VALUE 0x1D3F72 KwWU16 65535.00 dez 0.00 65535.00 FORMAT "%8.2" /end CHARACTERISTIC
/begin CHARACTERISTIC CDTEV8 "Codewort Tester: EV von Zyl. 8" VALUE 0x1D3F74 KwWU16 65535.00 dez 0.00 65535.00 FORMAT "%8.2" /end CHARACTERISTIC
/begin CHARACTERISTIC CDTKKUE "Codewort Tester: Kraftstoffkreislauf-Umschaltung Endstufe" VALUE 0x1D3FAA KwUw 65535.00 dez 0.00 65535.00 FORMAT "%8.2" /end CHARACTERISTIC
/begin CHARACTERISTIC CDTKPE "Codewort Tester: EKP-Relais Endstufe" VALUE 0x1D3FAC KwWU16 65535.00 dez 0.00 65535.00 FORMAT "%8.2" /end CHARACTERISTIC
/begin CHARACTERISTIC CDTLDE "Codewort Tester: Ladedrucksteuerventil (Endstufe)" VALUE 0x1D3FC4 KwUw 65535.00 dez 0.00 65535.00 FORMAT "%8.2" /end CHARACTERISTIC
/begin CHARACTERISTIC CDTLDPE "Codewort Tester: Leckdiagnosepumpe Endstufe" VALUE 0x1D3FC8 KwUw 65535.00 dez 0.00 65535.00 FORMAT "%8.2" /end CHARACTERISTIC
/begin CHARACTERISTIC CDTLUVE "Codewort Tester: EV-Luftumfassungsventil Endstufe" VALUE 0x1D3FEC KwUw 65535.00 dez 0.00 65535.00 FORMAT "%8.2" /end CHARACTERISTIC
/begin CHARACTERISTIC CDTN "Codewort Tester: Drehzahlsignalgeber" VALUE 0x1D4010 KwUw 65535.00 dez 0.00 65535.00 FORMAT "%8.2" /end CHARACTERISTIC
/begin CHARACTERISTIC CDTSWE "Codewort Tester: Beschleunigungssensor Schlechtwegeerk." VALUE 0x1D4052 KwWU16 65535.00 dez 0.00 65535.00 FORMAT "%8.2" /end CHARACTERISTIC
/begin CHARACTERISTIC CDTZZZ "Dummy: Tabellenende" VALUE 0x1D4090 KwUw 65535.00 dez 0.00 65535.00 FORMAT "%8.2" /end CHARACTERISTIC
/begin CHARACTERISTIC CLAAAA "Dummy: Tabellenanfang" VALUE 0x1D314D KwUb 255.0 dez 0.00 255.0 FORMAT "%5.1" /end CHARACTERISTIC
/begin CHARACTERISTIC CLAACCompr2_Trq "" VALUE 0x1D314E KwUb 255.0 dez 0.00 255.0 FORMAT "%5.1" /end CHARACTERISTIC
/begin CHARACTERISTIC CLAACComp_Press "" VALUE 0x1D314F KwUb 255.0 dez 0.00 255.0 FORMAT "%5.1" /end CHARACTERISTIC
/begin CHARACTERISTIC CLAACComp_Trq "" VALUE 0x1D3150 KwUb 255.0 dez 0.00 255.0 FORMAT "%5.1" /end CHARACTERISTIC
/begin CHARACTERISTIC CLAAdapCrsCtrl_Par "" VALUE 0x1D3151 KwUb 255.0 dez 0.00 255.0 FORMAT "%5.1" /end CHARACTERISTIC
/begin CHARACTERISTIC CLAAdapCrsCtrl_Tgl "" VALUE 0x1D3152 KwUb 255.0 dez 0.00 255.0 FORMAT "%5.1" /end CHARACTERISTIC
/begin CHARACTERISTIC CLAAdapCrsCtrl_TrqReq "" VALUE 0x1D3153 KwUb 255.0 dez 0.00 255.0 FORMAT "%5.1" /end CHARACTERISTIC
/begin CHARACTERISTIC CLAAMT_EngEmOffEn "" VALUE 0x1D3156 KwUb 255.0 dez 0.00 255.0 FORMAT "%5.1" /end CHARACTERISTIC
/begin CHARACTERISTIC CLAAMT_EngEmOffFl "" VALUE 0x1D3157 KwUb 255.0 dez 0.00 255.0 FORMAT "%5.1" /end CHARACTERISTIC
/begin CHARACTERISTIC CLAANWS "Fehlerklasse: Nockenwellensteuerung Auslass Nockenwelle" VALUE 0x1D3158 KwUb 255.0 dez 0.00 255.0 FORMAT "%5.1" /end CHARACTERISTIC
/begin CHARACTERISTIC CLAANWS2 "Fehlerklasse: Nockenwellensteuerung Auslass Nockenwelle 2" VALUE 0x1D3159 KwUb 255.0 dez 0.00 255.0 FORMAT "%5.1" /end CHARACTERISTIC
/begin CHARACTERISTIC CLAAP_Pt1HiLim "" VALUE 0x1D315C KwUb 255.0 dez 0.00 255.0 FORMAT "%5.1" /end CHARACTERISTIC
/begin CHARACTERISTIC CLAAP_Pt1LoLim "" VALUE 0x1D315D KwUb 255.0 dez 0.00 255.0 FORMAT "%5.1" /end CHARACTERISTIC
/begin CHARACTERISTIC CLAAP_Pt2HiLim "" VALUE 0x1D315E KwUb 255.0 dez 0.00 255.0 FORMAT "%5.1" /end CHARACTERISTIC
/begin CHARACTERISTIC CLAAP_Pt2LoLim "" VALUE 0x1D315F KwUb 255.0 dez 0.00 255.0 FORMAT "%5.1" /end CHARACTERISTIC
/begin CHARACTERISTIC CLAAP_PtDiff "" VALUE 0x1D3160 KwUb 255.0 dez 0.00 255.0 FORMAT "%5.1" /end CHARACTERISTIC
/begin CHARACTERISTIC CLAAP_PtSupp "" VALUE 0x1D3161 KwUb 255.0 dez 0.00 255.0 FORMAT "%5.1" /end CHARACTERISTIC
/begin CHARACTERISTIC CLABLS_Par "" VALUE 0x1D3162 KwUb 255.0 dez 0.00 255.0 FORMAT "%5.1" /end CHARACTERISTIC
/begin CHARACTERISTIC CLABLS_Tgl "" VALUE 0x1D3163 KwUb 255.0 dez 0.00 255.0 FORMAT "%5.1" /end CHARACTERISTIC
/begin CHARACTERISTIC CLABLS_Undef "" VALUE 0x1D3164 KwUb 255.0 dez 0.00 255.0 FORMAT "%5.1" /end CHARACTERISTIC
/begin CHARACTERISTIC CLABM "Fehlerklasse: Bezugsmarkengeber" VALUE 0x1D3165 KwUb 255.0 dez 0.00 255.0 FORMAT "%5.1" /end CHARACTERISTIC
/begin CHARACTERISTIC CLACAN "" VALUE 0x1D3167 KwUb 255.0 dez 0.00 255.0 FORMAT "%5.1" /end CHARACTERISTIC
/begin CHARACTERISTIC CLACoolFan_SpdReq "" VALUE 0x1D316D KwUb 255.0 dez 0.00 255.0 FORMAT "%5.1" /end CHARACTERISTIC
/begin CHARACTERISTIC CLADK "Fehlerklasse: DK- Potentiometer" VALUE 0x1D3170 KwUb 255.0 dez 0.00 255.0 FORMAT "%5.1" /end CHARACTERISTIC
/begin CHARACTERISTIC CLADK1P "Fehlerklassse: Drosselklappe 1. Poti" VALUE 0x1D3171 KwUb 255.0 dez 0.00 255.0 FORMAT "%5.1" /end CHARACTERISTIC
/begin CHARACTERISTIC CLADK2P "Fehlerklasse: Drosselklappenpotentiometer 2" VALUE 0x1D3172 KwUb 255.0 dez 0.00 255.0 FORMAT "%5.1" /end CHARACTERISTIC
/begin CHARACTERISTIC CLADSS "Fehlerklasse: Saugrohrdrucksensor" VALUE 0x1D3177 KwUb 255.0 dez 0.00 255.0 FORMAT "%5.1" /end CHARACTERISTIC
/begin CHARACTERISTIC CLADVEE "Fehlerklasse: DV-E Endstufe" VALUE 0x1D3179 KwUb 255.0 dez 0.00 255.0 FORMAT "%5.1" /end CHARACTERISTIC
/begin CHARACTERISTIC CLADVEF "Fehlerklasse: DV-E Fehler bei Federpr¸fung" VALUE 0x1D317A KwUb 255.0 dez 0.00 255.0 FORMAT "%5.1" /end CHARACTERISTIC
/begin CHARACTERISTIC CLADVEFO "" VALUE 0x1D317B KwUb 255.0 dez 0.00 255.0 FORMAT "%5.1" /end CHARACTERISTIC
/begin CHARACTERISTIC CLADVEL "Fehlerklasse: DV-E Lageabweichung" VALUE 0x1D317C KwUb 255.0 dez 0.00 255.0 FORMAT "%5.1" /end CHARACTERISTIC
/begin CHARACTERISTIC CLADVEN "Fehlerklasse: DV-E Fehler bei Pr¸fung Notluftposition" VALUE 0x1D317D KwUb 255.0 dez 0.00 255.0 FORMAT "%5.1" /end CHARACTERISTIC
/begin CHARACTERISTIC CLADVER "Fehlerklasse: DV-E Regelbereich" VALUE 0x1D317E KwUb 255.0 dez 0.00 255.0 FORMAT "%5.1" /end CHARACTERISTIC
/begin CHARACTERISTIC CLADVET "" VALUE 0x1D317F KwUb 255.0 dez 0.00 255.0 FORMAT "%5.1" /end CHARACTERISTIC
/begin CHARACTERISTIC CLADVEU "Fehlerklasse: DV-E Fehler beim UMA-Lernen" VALUE 0x1D3180 KwUb 255.0 dez 0.00 255.0 FORMAT "%5.1" /end CHARACTERISTIC
/begin CHARACTERISTIC CLADVEUB "" VALUE 0x1D3181 KwUb 255.0 dez 0.00 255.0 FORMAT "%5.1" /end CHARACTERISTIC
/begin CHARACTERISTIC CLADVEUW "" VALUE 0x1D3182 KwUb 255.0 dez 0.00 255.0 FORMAT "%5.1" /end CHARACTERISTIC
/begin CHARACTERISTIC CLADVEV "Fehlerklasse: DV-E Fehler bei Verst‰rkerabgleich" VALUE 0x1D3183 KwUb 255.0 dez 0.00 255.0 FORMAT "%5.1" /end CHARACTERISTIC
/begin CHARACTERISTIC CLAENWS "Fehlerklasse: Nockenwellensteuerung Einlass Nockenwelle" VALUE 0x1D3188 KwUb 255.0 dez 0.00 255.0 FORMAT "%5.1" /end CHARACTERISTIC
/begin CHARACTERISTIC CLAENWS2 "Fehlerklasse: Nockenwellensteuerung Einlass Nockenwelle 2" VALUE 0x1D3189 KwUb 255.0 dez 0.00 255.0 FORMAT "%5.1" /end CHARACTERISTIC
/begin CHARACTERISTIC CLAEV1 "Fehlerklasse: EV Endtsufe 1" VALUE 0x1D3190 KwWU8 255.0 dez 0.00 255.0 FORMAT "%5.1" /end CHARACTERISTIC
/begin CHARACTERISTIC CLAEV2 "Fehlerklasse: EV Endstufe 2" VALUE 0x1D3191 KwWU8 255.0 dez 0.00 255.0 FORMAT "%5.1" /end CHARACTERISTIC
/begin CHARACTERISTIC CLAEV3 "Fehlerklasse: EV Endstufe 3" VALUE 0x1D3192 KwWU8 255.0 dez 0.00 255.0 FORMAT "%5.1" /end CHARACTERISTIC
/begin CHARACTERISTIC CLAEV4 "Fehlerklasse: EV Endstufe 4" VALUE 0x1D3193 KwWU8 255.0 dez 0.00 255.0 FORMAT "%5.1" /end CHARACTERISTIC
/begin CHARACTERISTIC CLAEV5 "Fehlerklasse: EV Endstufe 5" VALUE 0x1D3194 KwWU8 255.0 dez 0.00 255.0 FORMAT "%5.1" /end CHARACTERISTIC
/begin CHARACTERISTIC CLAEV6 "Fehlerklasse: EV Endstufe 6" VALUE 0x1D3195 KwWU8 255.0 dez 0.00 255.0 FORMAT "%5.1" /end CHARACTERISTIC
/begin CHARACTERISTIC CLAEV7 "Fehlerklasse: EV Endstufe 7" VALUE 0x1D3196 KwWU8 255.0 dez 0.00 255.0 FORMAT "%5.1" /end CHARACTERISTIC
/begin CHARACTERISTIC CLAEV8 "Fehlerklasse: EV Endstufe 8" VALUE 0x1D3197 KwWU8 255.0 dez 0.00 255.0 FORMAT "%5.1" /end CHARACTERISTIC
/begin CHARACTERISTIC CLAKKUE "" VALUE 0x1D31B2 KwUb 255.0 dez 0.00 255.0 FORMAT "%5.1" /end CHARACTERISTIC
/begin CHARACTERISTIC CLAKPE "Fehlerklasse: EKP-Relais Endstufe" VALUE 0x1D31B3 KwWU8 255.0 dez 0.00 255.0 FORMAT "%5.1" /end CHARACTERISTIC
/begin CHARACTERISTIC CLALDE "Fehlerklasse: LDR-Taktventil Endstufe" VALUE 0x1D31BF KwUb 255.0 dez 0.00 255.0 FORMAT "%5.1" /end CHARACTERISTIC
/begin CHARACTERISTIC CLALDPE "Fehlerklasse: LDP  Endstufe" VALUE 0x1D31C1 KwUb 255.0 dez 0.00 255.0 FORMAT "%5.1" /end CHARACTERISTIC
/begin CHARACTERISTIC CLALUVE "Fehlerklasse: EV- Luftumfassungsventil Endstufe" VALUE 0x1D31D3 KwUb 255.0 dez 0.00 255.0 FORMAT "%5.1" /end CHARACTERISTIC
/begin CHARACTERISTIC CLAN "Fehlerklasse: Drehzahlgeber" VALUE 0x1D31E5 KwUb 255.0 dez 0.00 255.0 FORMAT "%5.1" /end CHARACTERISTIC
/begin CHARACTERISTIC CLASWE "Fehlerklasse: Beschleunigungssensor der Schlechtwegerkennung" VALUE 0x1D3206 KwWU8 255.0 dez 0.00 255.0 FORMAT "%5.1" /end CHARACTERISTIC
/begin CHARACTERISTIC CLAZZZ "Dummy: Tabellenende" VALUE 0x1D3225 KwUb 255.0 dez 0.00 255.0 FORMAT "%5.1" /end CHARACTERISTIC
/begin CHARACTERISTIC CWDEGFE "Codewort f¸r Abschaltung der Funktion %DEGFE" VALUE 0x1CA27E KwUb 255.0 dez 0.00 255.0 FORMAT "%5.1" /end CHARACTERISTIC
/begin CHARACTERISTIC CWPSEV "Codewort f¸r Endstufendiagnose EV" VAL_BLK 0x1C5520 KwbUb 255.0 dez 0.00 255.0 FORMAT "%5.1" NUMBER 8 /end CHARACTERISTIC
/begin CHARACTERISTIC CWPSKPE "Codewort f¸r Endstufendiagnose EKP" VALUE 0x1C56EE KwUb 255.0 dez 0.00 255.0 FORMAT "%5.1" /end CHARACTERISTIC
/begin CHARACTERISTIC DKGFILS "Schwelle f¸r Drosselklappengradient f¸r Diagnose Drucksensor" VALUE 0x1CA28A KwSw 1599.976 relDK_q0p02441 -800.0000 799.9756 FORMAT "%8.4" /end CHARACTERISTIC
/begin CHARACTERISTIC DPDDF "Delta Druck f¸r Diagnose Drucksensor (Aktivit‰tsnachweis)" VALUE 0x1CA28C KwUw 2559.961 p_uw_q0p039 0.00 2559.961 FORMAT "%8.3" /end CHARACTERISTIC
/begin CHARACTERISTIC EKPFA "Anzahl Verifikationen zur Fehlerentprellung in der Endstufendiagnose EKP-Relais" VALUE 0x1C56EF KwUb 255.0 dez 0.00 255.0 FORMAT "%5.1" /end CHARACTERISTIC
/begin CHARACTERISTIC EKPPA "Anzahl Pr¸fpulsausgaben in der Endstufendiagnose EKP-Relais" VALUE 0x1C56F0 KwUb 255.0 dez 0.00 255.0 FORMAT "%5.1" /end CHARACTERISTIC
/begin CHARACTERISTIC FFTAAA "Dummy: Tabellenanfang" VAL_BLK 0x1D3228 KwbUb 255.0 dez 0.00 255.0 FORMAT "%5.1" NUMBER 4 /end CHARACTERISTIC
/begin CHARACTERISTIC FFTACCompr2_Trq "" VAL_BLK 0x1D322C KwbUb 255.0 dez 0.00 255.0 FORMAT "%5.1" NUMBER 4 /end CHARACTERISTIC
/begin CHARACTERISTIC FFTACComp_Press "" VAL_BLK 0x1D3230 KwbUb 255.0 dez 0.00 255.0 FORMAT "%5.1" NUMBER 4 /end CHARACTERISTIC
/begin CHARACTERISTIC FFTACComp_Trq "" VAL_BLK 0x1D3234 KwbUb 255.0 dez 0.00 255.0 FORMAT "%5.1" NUMBER 4 /end CHARACTERISTIC
/begin CHARACTERISTIC FFTAdapCrsCtrl_Par "" VAL_BLK 0x1D3238 KwbUb 255.0 dez 0.00 255.0 FORMAT "%5.1" NUMBER 4 /end CHARACTERISTIC
/begin CHARACTERISTIC FFTAdapCrsCtrl_Tgl "" VAL_BLK 0x1D323C KwbUb 255.0 dez 0.00 255.0 FORMAT "%5.1" NUMBER 4 /end CHARACTERISTIC
/begin CHARACTERISTIC FFTAdapCrsCtrl_TrqReq "" VAL_BLK 0x1D3240 KwbUb 255.0 dez 0.00 255.0 FORMAT "%5.1" NUMBER 4 /end CHARACTERISTIC
/begin CHARACTERISTIC FFTAMT_EngEmOffEn "" VAL_BLK 0x1D324C KwbUb 255.0 dez 0.00 255.0 FORMAT "%5.1" NUMBER 4 /end CHARACTERISTIC
/begin CHARACTERISTIC FFTAMT_EngEmOffFl "" VAL_BLK 0x1D3250 KwbUb 255.0 dez 0.00 255.0 FORMAT "%5.1" NUMBER 4 /end CHARACTERISTIC
/begin CHARACTERISTIC FFTANWS "Freeze Frame Tabelle: Nockenwellensteuerung Auslass Nockenwelle" VAL_BLK 0x1D3254 KwbUb 255.0 dez 0.00 255.0 FORMAT "%5.1" NUMBER 4 /end CHARACTERISTIC
/begin CHARACTERISTIC FFTANWS2 "Freeze Frame Tabelle: Nockenwellensteuerung Auslass Nockenwelle 2" VAL_BLK 0x1D3258 KwbUb 255.0 dez 0.00 255.0 FORMAT "%5.1" NUMBER 4 /end CHARACTERISTIC
/begin CHARACTERISTIC FFTAP_Pt1HiLim "" VAL_BLK 0x1D3264 KwbUb 255.0 dez 0.00 255.0 FORMAT "%5.1" NUMBER 4 /end CHARACTERISTIC
/begin CHARACTERISTIC FFTAP_Pt1LoLim "" VAL_BLK 0x1D3268 KwbUb 255.0 dez 0.00 255.0 FORMAT "%5.1" NUMBER 4 /end CHARACTERISTIC
/begin CHARACTERISTIC FFTAP_Pt2HiLim "" VAL_BLK 0x1D326C KwbUb 255.0 dez 0.00 255.0 FORMAT "%5.1" NUMBER 4 /end CHARACTERISTIC
/begin CHARACTERISTIC FFTAP_Pt2LoLim "" VAL_BLK 0x1D3270 KwbUb 255.0 dez 0.00 255.0 FORMAT "%5.1" NUMBER 4 /end CHARACTERISTIC
/begin CHARACTERISTIC FFTAP_PtDiff "" VAL_BLK 0x1D3274 KwbUb 255.0 dez 0.00 255.0 FORMAT "%5.1" NUMBER 4 /end CHARACTERISTIC
/begin CHARACTERISTIC FFTAP_PtSupp "" VAL_BLK 0x1D3278 KwbUb 255.0 dez 0.00 255.0 FORMAT "%5.1" NUMBER 4 /end CHARACTERISTIC
/begin CHARACTERISTIC FFTBLS_Par "" VAL_BLK 0x1D327C KwbUb 255.0 dez 0.00 255.0 FORMAT "%5.1" NUMBER 4 /end CHARACTERISTIC
/begin CHARACTERISTIC FFTBLS_Tgl "" VAL_BLK 0x1D3280 KwbUb 255.0 dez 0.00 255.0 FORMAT "%5.1" NUMBER 4 /end CHARACTERISTIC
/begin CHARACTERISTIC FFTBLS_Undef "" VAL_BLK 0x1D3284 KwbUb 255.0 dez 0.00 255.0 FORMAT "%5.1" NUMBER 4 /end CHARACTERISTIC
/begin CHARACTERISTIC FFTBM "Freeze Frame Tabelle: Bezugsmarkengeber" VAL_BLK 0x1D3288 KwbUb 255.0 dez 0.00 255.0 FORMAT "%5.1" NUMBER 4 /end CHARACTERISTIC
/begin CHARACTERISTIC FFTCAN "" VAL_BLK 0x1D3290 KwbUb 255.0 dez 0.00 255.0 FORMAT "%5.1" NUMBER 4 /end CHARACTERISTIC
/begin CHARACTERISTIC FFTCoolFan_SpdReq "" VAL_BLK 0x1D32A8 KwbUb 255.0 dez 0.00 255.0 FORMAT "%5.1" NUMBER 4 /end CHARACTERISTIC
/begin CHARACTERISTIC FFTDK "Freeze Frame Tabelle: DK- Potentiometer" VAL_BLK 0x1D32B4 KwbUb 255.0 dez 0.00 255.0 FORMAT "%5.1" NUMBER 4 /end CHARACTERISTIC
/begin CHARACTERISTIC FFTDK1P "Freeze Frame Tabelle: Drosselklappe 1. Poti" VAL_BLK 0x1D32B8 KwbUb 255.0 dez 0.00 255.0 FORMAT "%5.1" NUMBER 4 /end CHARACTERISTIC
/begin CHARACTERISTIC FFTDK2P "Freeze Frame Tabelle: Drosselklappenpotentiometer 2" VAL_BLK 0x1D32BC KwbUb 255.0 dez 0.00 255.0 FORMAT "%5.1" NUMBER 4 /end CHARACTERISTIC
/begin CHARACTERISTIC FFTDSS "Freeze Frame Tabelle: Saugrohrdrucksensor" VAL_BLK 0x1D32D0 KwbUb 255.0 dez 0.00 255.0 FORMAT "%5.1" NUMBER 4 /end CHARACTERISTIC
/begin CHARACTERISTIC FFTDVEE "Freeze Frame Tabelle: DV-E Endstufe" VAL_BLK 0x1D32D8 KwbUb 255.0 dez 0.00 255.0 FORMAT "%5.1" NUMBER 4 /end CHARACTERISTIC
/begin CHARACTERISTIC FFTDVEF "Freeze Frame Tabelle: DV-E Fehler bei Federpr¸fung" VAL_BLK 0x1D32DC KwbUb 255.0 dez 0.00 255.0 FORMAT "%5.1" NUMBER 4 /end CHARACTERISTIC
/begin CHARACTERISTIC FFTDVEFO "" VAL_BLK 0x1D32E0 KwbUb 255.0 dez 0.00 255.0 FORMAT "%5.1" NUMBER 4 /end CHARACTERISTIC
/begin CHARACTERISTIC FFTDVEL "Freeze Frame Tabelle: DV-E Lageabweichung" VAL_BLK 0x1D32E4 KwbUb 255.0 dez 0.00 255.0 FORMAT "%5.1" NUMBER 4 /end CHARACTERISTIC
/begin CHARACTERISTIC FFTDVEN "Freeze Frame Tabelle: DV-E Fehler bei Pr¸fung Notluftposition" VAL_BLK 0x1D32E8 KwbUb 255.0 dez 0.00 255.0 FORMAT "%5.1" NUMBER 4 /end CHARACTERISTIC
/begin CHARACTERISTIC FFTDVER "Freeze Frame Tabelle: DV-E Regelbereich" VAL_BLK 0x1D32EC KwbUb 255.0 dez 0.00 255.0 FORMAT "%5.1" NUMBER 4 /end CHARACTERISTIC
/begin CHARACTERISTIC FFTDVET "" VAL_BLK 0x1D32F0 KwbUb 255.0 dez 0.00 255.0 FORMAT "%5.1" NUMBER 4 /end CHARACTERISTIC
/begin CHARACTERISTIC FFTDVEU "Freeze Frame Tabelle: DV-E Fehler beim UMA-Lernen" VAL_BLK 0x1D32F4 KwbUb 255.0 dez 0.00 255.0 FORMAT "%5.1" NUMBER 4 /end CHARACTERISTIC
/begin CHARACTERISTIC FFTDVEUB "" VAL_BLK 0x1D32F8 KwbUb 255.0 dez 0.00 255.0 FORMAT "%5.1" NUMBER 4 /end CHARACTERISTIC
/begin CHARACTERISTIC FFTDVEUW "" VAL_BLK 0x1D32FC KwbUb 255.0 dez 0.00 255.0 FORMAT "%5.1" NUMBER 4 /end CHARACTERISTIC
/begin CHARACTERISTIC FFTDVEV "Freeze Frame Tabelle: DV-E Fehler bei Verst‰rkerabgleich" VAL_BLK 0x1D3300 KwbUb 255.0 dez 0.00 255.0 FORMAT "%5.1" NUMBER 4 /end CHARACTERISTIC
/begin CHARACTERISTIC FFTENWS "Freeze Frame Tabelle: Nockenwellensteuerung Einlass Nockenwelle" VAL_BLK 0x1D3314 KwbUb 255.0 dez 0.00 255.0 FORMAT "%5.1" NUMBER 4 /end CHARACTERISTIC
/begin CHARACTERISTIC FFTENWS2 "Freeze Frame Tabelle: Nockenwellensteuerung Einlass Nockenwelle 2" VAL_BLK 0x1D3318 KwbUb 255.0 dez 0.00 255.0 FORMAT "%5.1" NUMBER 4 /end CHARACTERISTIC
/begin CHARACTERISTIC FFTEV1 "Freeze Frame Tabelle: EV Endstufe 1" VAL_BLK 0x1D3334 KwbWU8 255.0 dez 0.00 255.0 FORMAT "%5.1" NUMBER 4 /end CHARACTERISTIC
/begin CHARACTERISTIC FFTEV2 "Freeze Frame Tabelle: EV Endstufe 2" VAL_BLK 0x1D3338 KwbWU8 255.0 dez 0.00 255.0 FORMAT "%5.1" NUMBER 4 /end CHARACTERISTIC
/begin CHARACTERISTIC FFTEV3 "Freeze Frame Tabelle: EV Endstufe 3" VAL_BLK 0x1D333C KwbWU8 255.0 dez 0.00 255.0 FORMAT "%5.1" NUMBER 4 /end CHARACTERISTIC
/begin CHARACTERISTIC FFTEV4 "Freeze Frame Tabelle: EV Endstufe 4" VAL_BLK 0x1D3340 KwbWU8 255.0 dez 0.00 255.0 FORMAT "%5.1" NUMBER 4 /end CHARACTERISTIC
/begin CHARACTERISTIC FFTEV5 "Freeze Frame Tabelle: EV Endstufe 5" VAL_BLK 0x1D3344 KwbWU8 255.0 dez 0.00 255.0 FORMAT "%5.1" NUMBER 4 /end CHARACTERISTIC
/begin CHARACTERISTIC FFTEV6 "Freeze frame Tabelle: EV Endstufe 6" VAL_BLK 0x1D3348 KwbWU8 255.0 dez 0.00 255.0 FORMAT "%5.1" NUMBER 4 /end CHARACTERISTIC
/begin CHARACTERISTIC FFTEV7 "Freeze Frame Tabelle: EV Endstufe 7" VAL_BLK 0x1D334C KwbWU8 255.0 dez 0.00 255.0 FORMAT "%5.1" NUMBER 4 /end CHARACTERISTIC
/begin CHARACTERISTIC FFTEV8 "Freeze Frame Tabelle: EV Endstufe 8" VAL_BLK 0x1D3350 KwbWU8 255.0 dez 0.00 255.0 FORMAT "%5.1" NUMBER 4 /end CHARACTERISTIC
/begin CHARACTERISTIC FFTKKUE "" VAL_BLK 0x1D33BC KwbUb 255.0 dez 0.00 255.0 FORMAT "%5.1" NUMBER 4 /end CHARACTERISTIC
/begin CHARACTERISTIC FFTKPE "Freeze Frame Tabelle: EKP-Relais Endstufe" VAL_BLK 0x1D33C0 KwbWU8 255.0 dez 0.00 255.0 FORMAT "%5.1" NUMBER 4 /end CHARACTERISTIC
/begin CHARACTERISTIC FFTLDE "Freeze Frame Tabelle: LDR Taktventil Endstufe" VAL_BLK 0x1D33F0 KwbUb 255.0 dez 0.00 255.0 FORMAT "%5.1" NUMBER 4 /end CHARACTERISTIC
/begin CHARACTERISTIC FFTLDPE "Freeze Frame Tabelle: LDP Endstufe" VAL_BLK 0x1D33F8 KwbUb 255.0 dez 0.00 255.0 FORMAT "%5.1" NUMBER 4 /end CHARACTERISTIC
/begin CHARACTERISTIC FFTLUVE "Freeze Frame Tabelle: EV- Luftumfassungsventil Endstufe" VAL_BLK 0x1D3440 KwbUb 255.0 dez 0.00 255.0 FORMAT "%5.1" NUMBER 4 /end CHARACTERISTIC
/begin CHARACTERISTIC FFTN "Freeze Frame Tabelle: Drehzahlgeber" VAL_BLK 0x1D3488 KwbUb 255.0 dez 0.00 255.0 FORMAT "%5.1" NUMBER 4 /end CHARACTERISTIC
/begin CHARACTERISTIC FFTSWE "Freeze Frame Tabelle: Beschleunigungssensor Schlechtwegeerk." VAL_BLK 0x1D350C KwbWU8 255.0 dez 0.00 255.0 FORMAT "%5.1" NUMBER 4 /end CHARACTERISTIC
/begin CHARACTERISTIC FFTZZZ "Dummy: Tabellenende" VAL_BLK 0x1D3588 KwbUb 255.0 dez 0.00 255.0 FORMAT "%5.1" NUMBER 4 /end CHARACTERISTIC
/begin CHARACTERISTIC FPDAGRDSS "Korrekturfaktor f¸r agr-Partialdruck zur Saugrohrdruckdiagnose" VALUE 0x1CA28E KwUw 3.999939 fak_uw_b4 0.00 3.999939 FORMAT "%8.6" /end CHARACTERISTIC
/begin CHARACTERISTIC KFPSDMN "Druckschwelle f¸r B_nplm Diagnose DS-S" MAP 0x1CA290 KfAxUwAyUwSstxSwSstyUwWUw 2559.961 p_uw_q0p039 0.00 2559.961 FORMAT "%8.3"
 /begin AXIS_DESCR STD_AXIS wdkfmn_w relDK_q0p02441 8 -800.0000 799.9756 FORMAT "%8.4" DEPOSIT ABSOLUTE /end AXIS_DESCR
 /begin AXIS_DESCR STD_AXIS nmot_w nmot_uw_q0p25 8 0.00 16383.75 FORMAT "%8.2" DEPOSIT ABSOLUTE /end AXIS_DESCR
/end CHARACTERISTIC
/begin CHARACTERISTIC KFPSDMX "Druckschwelle f¸r B_nplm Diagnose DS-S" MAP 0x1CA334 KfAxUwAyUwSstxSwSstyUwWUw 2559.961 p_uw_q0p039 0.00 2559.961 FORMAT "%8.3"
 /begin AXIS_DESCR STD_AXIS wdkfmx_w relDK_q0p02441 8 -800.0000 799.9756 FORMAT "%8.4" DEPOSIT ABSOLUTE /end AXIS_DESCR
 /begin AXIS_DESCR STD_AXIS nmot_w nmot_uw_q0p25 8 0.00 16383.75 FORMAT "%8.2" DEPOSIT ABSOLUTE /end AXIS_DESCR
/end CHARACTERISTIC
/begin CHARACTERISTIC NDDFA "Drehzahlschwelle f¸r Diagnose Drucksensor (Schlauchabfall vor/bei Start)" VALUE 0x1CA3D8 KwUw 16383.75 nmot_uw_q0p25 0.00 16383.75 FORMAT "%8.2" /end CHARACTERISTIC
/begin CHARACTERISTIC NDECJ "Drehzahl-Schwelle f¸r CJ400-Endstufendiagnose" VALUE 0x1C3CCE KwUb 10200. nmot_ub_q40 0.00 10200. FORMAT "%5.0" /end CHARACTERISTIC
/begin CHARACTERISTIC NDSMNR "Drehzahlschwelle zum R¸cksetzen Min-Fehler f¸r Drucksensordiagnose" VALUE 0x1CA3DA KwUw 16383.75 nmot_uw_q0p25 0.00 16383.75 FORMAT "%8.2" /end CHARACTERISTIC
/begin CHARACTERISTIC NDSMXR "Drehzahlschwelle zum R¸cksetzen Max-Fehler f¸r Drucksensordiagnose" VALUE 0x1CA3DC KwUw 16383.75 nmot_uw_q0p25 0.00 16383.75 FORMAT "%8.2" /end CHARACTERISTIC
/begin CHARACTERISTIC PSHYSHL "Druckhysterese zur Fehlerheilung f¸r Diagnose Saugrohrdrucksensor" VALUE 0x1CA3DE KwUw 2559.961 p_uw_q0p039 0.00 2559.961 FORMAT "%8.3" /end CHARACTERISTIC
/begin CHARACTERISTIC PSINIPL "Wert f¸r Pr¸fung Saugrohr Initialisierungsdruck" VALUE 0x1CA3E0 KwUw 2559.961 p_uw_q0p039 0.00 2559.961 FORMAT "%8.3" /end CHARACTERISTIC
/begin CHARACTERISTIC TDDF "Entprellzeit DF-Fehlererkennung" VALUE 0x1CA284 KwUb 25.50 t100msxs_ub_b25p5 0.00 25.50 FORMAT "%5.2" /end CHARACTERISTIC
/begin CHARACTERISTIC TDDFZ "Wartezeit nach Startende bis DF-kein-Fehler g¸ltig" VALUE 0x1CA285 KwUb 25.20 t100msxs_ub_b25p5 0.3000 25.50 FORMAT "%5.2" /end CHARACTERISTIC
/begin CHARACTERISTIC TDEGFEMN "Zeitverzˆgerung f¸r Setzen des MIN-Fehlers" VALUE 0x1CA27F KwUb 25.50 t100msxs_ub_b25p5 0.00 25.50 FORMAT "%5.2" /end CHARACTERISTIC
/begin CHARACTERISTIC TDEGFEMX "Zeitverzˆgerung f¸r Setzen des MAX-Fehlers" VALUE 0x1CA280 KwUb 25.50 t100msxs_ub_b25p5 0.00 25.50 FORMAT "%5.2" /end CHARACTERISTIC
/begin CHARACTERISTIC TDEGFENO "Zeitverzˆgerung f¸r Setzen des NO-Fehlers" VALUE 0x1CA281 KwUb 25.50 t100msxs_ub_b25p5 0.00 25.50 FORMAT "%5.2" /end CHARACTERISTIC
/begin CHARACTERISTIC TDEGFEST "Zeitverzˆgerung nach Start" VALUE 0x1CA282 KwUb 25.50 t100msxs_ub_b25p5 0.00 25.50 FORMAT "%5.2" /end CHARACTERISTIC
/begin CHARACTERISTIC TDEVE "Entprellzeit Freigabe EV-Endstufendiagnose nach Ausblendung" VALUE 0x1C5528 KwUb 255.0 dez 0.00 255.0 FORMAT "%5.1" /end CHARACTERISTIC
/begin CHARACTERISTIC TEPCL "Zeit ab Motorlauf bis EPCL-Testansteuerung Ende" VALUE 0x1C3CD1 KwUb 51.00 t200msxs_ub_b51 0.00 51.00 FORMAT "%5.2" /end CHARACTERISTIC
/begin CHARACTERISTIC TEPCLI "Zeit ab INI bis EPCL-Testansteuerung Ende" VALUE 0x1C3CD2 KwUb 51.00 t200msxs_ub_b51 0.00 51.00 FORMAT "%5.2" /end CHARACTERISTIC
/begin CHARACTERISTIC TPNSE "Pr¸fzeit nach Startende f¸r DVE-Diagnose" VALUE 0x1CA868 KwUb 25.40 t100msxs_ub_b25p5 0.1000 25.50 FORMAT "%5.2" /end CHARACTERISTIC
/begin CHARACTERISTIC TSFAAA "Dummy: Tabellenanfang" VALUE 0x1D358C KwUb 255.0 dez 0.00 255.0 FORMAT "%5.1" /end CHARACTERISTIC
/begin CHARACTERISTIC TSFACCompr2_Trq "" VALUE 0x1D358D KwUb 255.0 dez 0.00 255.0 FORMAT "%5.1" /end CHARACTERISTIC
/begin CHARACTERISTIC TSFACComp_Press "" VALUE 0x1D358E KwUb 255.0 dez 0.00 255.0 FORMAT "%5.1" /end CHARACTERISTIC
/begin CHARACTERISTIC TSFACComp_Trq "" VALUE 0x1D358F KwUb 255.0 dez 0.00 255.0 FORMAT "%5.1" /end CHARACTERISTIC
/begin CHARACTERISTIC TSFAdapCrsCtrl_Par "" VALUE 0x1D3590 KwUb 255.0 dez 0.00 255.0 FORMAT "%5.1" /end CHARACTERISTIC
/begin CHARACTERISTIC TSFAdapCrsCtrl_Tgl "" VALUE 0x1D3591 KwUb 255.0 dez 0.00 255.0 FORMAT "%5.1" /end CHARACTERISTIC
/begin CHARACTERISTIC TSFAdapCrsCtrl_TrqReq "" VALUE 0x1D3592 KwUb 255.0 dez 0.00 255.0 FORMAT "%5.1" /end CHARACTERISTIC
/begin CHARACTERISTIC TSFAMT_EngEmOffEn "" VALUE 0x1D3595 KwUb 255.0 dez 0.00 255.0 FORMAT "%5.1" /end CHARACTERISTIC
/begin CHARACTERISTIC TSFAMT_EngEmOffFl "" VALUE 0x1D3596 KwUb 255.0 dez 0.00 255.0 FORMAT "%5.1" /end CHARACTERISTIC
/begin CHARACTERISTIC TSFANWS "Fehlersummenzeit: Nockenwellensteuerung Auslass Nockenwelle" VALUE 0x1D3597 KwUb 255.0 dez 0.00 255.0 FORMAT "%5.1" /end CHARACTERISTIC
/begin CHARACTERISTIC TSFANWS2 "Fehlersummenzeit: Nockenwellensteuerung Auslass Nockenwelle 2" VALUE 0x1D3598 KwUb 255.0 dez 0.00 255.0 FORMAT "%5.1" /end CHARACTERISTIC
/begin CHARACTERISTIC TSFAP_Pt1HiLim "" VALUE 0x1D359B KwUb 255.0 dez 0.00 255.0 FORMAT "%5.1" /end CHARACTERISTIC
/begin CHARACTERISTIC TSFAP_Pt1LoLim "" VALUE 0x1D359C KwUb 255.0 dez 0.00 255.0 FORMAT "%5.1" /end CHARACTERISTIC
/begin CHARACTERISTIC TSFAP_Pt2HiLim "" VALUE 0x1D359D KwUb 255.0 dez 0.00 255.0 FORMAT "%5.1" /end CHARACTERISTIC
/begin CHARACTERISTIC TSFAP_Pt2LoLim "" VALUE 0x1D359E KwUb 255.0 dez 0.00 255.0 FORMAT "%5.1" /end CHARACTERISTIC
/begin CHARACTERISTIC TSFAP_PtDiff "" VALUE 0x1D359F KwUb 255.0 dez 0.00 255.0 FORMAT "%5.1" /end CHARACTERISTIC
/begin CHARACTERISTIC TSFAP_PtSupp "" VALUE 0x1D35A0 KwUb 255.0 dez 0.00 255.0 FORMAT "%5.1" /end CHARACTERISTIC
/begin CHARACTERISTIC TSFBLS_Par "" VALUE 0x1D35A1 KwUb 255.0 dez 0.00 255.0 FORMAT "%5.1" /end CHARACTERISTIC
/begin CHARACTERISTIC TSFBLS_Tgl "" VALUE 0x1D35A2 KwUb 255.0 dez 0.00 255.0 FORMAT "%5.1" /end CHARACTERISTIC
/begin CHARACTERISTIC TSFBLS_Undef "" VALUE 0x1D35A3 KwUb 255.0 dez 0.00 255.0 FORMAT "%5.1" /end CHARACTERISTIC
/begin CHARACTERISTIC TSFBM "Fehlersummenzeit: Bezugsmarkengeber" VALUE 0x1D35A4 KwUb 255.0 dez 0.00 255.0 FORMAT "%5.1" /end CHARACTERISTIC
/begin CHARACTERISTIC TSFCAN "" VALUE 0x1D35A6 KwUb 255.0 dez 0.00 255.0 FORMAT "%5.1" /end CHARACTERISTIC
/begin CHARACTERISTIC TSFCoolFan_SpdReq "" VALUE 0x1D35AC KwUb 255.0 dez 0.00 255.0 FORMAT "%5.1" /end CHARACTERISTIC
/begin CHARACTERISTIC TSFDK "Fehlersummenzeit: DK - Potentiometer" VALUE 0x1D35AF KwUb 255.0 dez 0.00 255.0 FORMAT "%5.1" /end CHARACTERISTIC
/begin CHARACTERISTIC TSFDK1P "Fehlersummenzeit: Drosselklappe 1. Poti" VALUE 0x1D35B0 KwUb 255.0 dez 0.00 255.0 FORMAT "%5.1" /end CHARACTERISTIC
/begin CHARACTERISTIC TSFDK2P "Fehlersummenzeit: Drosselklappenpotentiometer 2" VALUE 0x1D35B1 KwUb 255.0 dez 0.00 255.0 FORMAT "%5.1" /end CHARACTERISTIC
/begin CHARACTERISTIC TSFDSS "Fehlersummenzeit: Saugrohr-Drucksensor" VALUE 0x1D35B6 KwUb 255.0 dez 0.00 255.0 FORMAT "%5.1" /end CHARACTERISTIC
/begin CHARACTERISTIC TSFDVEE "Fehlersummenzeit: DV-E Endstufe" VALUE 0x1D35B8 KwUb 255.0 dez 0.00 255.0 FORMAT "%5.1" /end CHARACTERISTIC
/begin CHARACTERISTIC TSFDVEF "Fehlersummenzeit: DV-E Fehler bei Federpr¸fung" VALUE 0x1D35B9 KwUb 255.0 dez 0.00 255.0 FORMAT "%5.1" /end CHARACTERISTIC
/begin CHARACTERISTIC TSFDVEFO "" VALUE 0x1D35BA KwUb 255.0 dez 0.00 255.0 FORMAT "%5.1" /end CHARACTERISTIC
/begin CHARACTERISTIC TSFDVEL "Fehlersummenzeit: DV-E Lageabweichung" VALUE 0x1D35BB KwUb 255.0 dez 0.00 255.0 FORMAT "%5.1" /end CHARACTERISTIC
/begin CHARACTERISTIC TSFDVEN "Fehlersummenzeit: DV-E Fehler bei Pr¸fung Notluftposition" VALUE 0x1D35BC KwUb 255.0 dez 0.00 255.0 FORMAT "%5.1" /end CHARACTERISTIC
/begin CHARACTERISTIC TSFDVER "Fehlersummenzeit: DV-E Regelbereich" VALUE 0x1D35BD KwUb 255.0 dez 0.00 255.0 FORMAT "%5.1" /end CHARACTERISTIC
/begin CHARACTERISTIC TSFDVET "" VALUE 0x1D35BE KwUb 255.0 dez 0.00 255.0 FORMAT "%5.1" /end CHARACTERISTIC
/begin CHARACTERISTIC TSFDVEU "Fehlersummenzeit: DV-E Fehler beim UMA-Lernen" VALUE 0x1D35BF KwUb 255.0 dez 0.00 255.0 FORMAT "%5.1" /end CHARACTERISTIC
/begin CHARACTERISTIC TSFDVEUB "" VALUE 0x1D35C0 KwUb 255.0 dez 0.00 255.0 FORMAT "%5.1" /end CHARACTERISTIC
/begin CHARACTERISTIC TSFDVEUW "" VALUE 0x1D35C1 KwUb 255.0 dez 0.00 255.0 FORMAT "%5.1" /end CHARACTERISTIC
/begin CHARACTERISTIC TSFDVEV "Fehlersummenzeit: DV-E Fehler bei Verst‰rkerabgleich" VALUE 0x1D35C2 KwUb 255.0 dez 0.00 255.0 FORMAT "%5.1" /end CHARACTERISTIC
/begin CHARACTERISTIC TSFENWS "Fehlersummenzeit: Nockenwellensteuerung Einlass Nockenwelle" VALUE 0x1D35C7 KwUb 255.0 dez 0.00 255.0 FORMAT "%5.1" /end CHARACTERISTIC
/begin CHARACTERISTIC TSFENWS2 "Fehlersummenzeit: Nockenwellensteuerung Einlass Nockenwelle 2" VALUE 0x1D35C8 KwUb 255.0 dez 0.00 255.0 FORMAT "%5.1" /end CHARACTERISTIC
/begin CHARACTERISTIC TSFEV1 "Fehlersummenzeit: EV von Zyl. 1" VALUE 0x1D35CF KwWU8 255.0 dez 0.00 255.0 FORMAT "%5.1" /end CHARACTERISTIC
/begin CHARACTERISTIC TSFEV2 "Fehlersummenzeit: EV von Zyl. 2" VALUE 0x1D35D0 KwWU8 255.0 dez 0.00 255.0 FORMAT "%5.1" /end CHARACTERISTIC
/begin CHARACTERISTIC TSFEV3 "Fehlersummenzeit: EV von Zyl. 3" VALUE 0x1D35D1 KwWU8 255.0 dez 0.00 255.0 FORMAT "%5.1" /end CHARACTERISTIC
/begin CHARACTERISTIC TSFEV4 "Fehlersummenzeit: EV von Zyl. 4" VALUE 0x1D35D2 KwWU8 255.0 dez 0.00 255.0 FORMAT "%5.1" /end CHARACTERISTIC
/begin CHARACTERISTIC TSFEV5 "Fehlersummenzeit: EV von Zyl. 5" VALUE 0x1D35D3 KwWU8 255.0 dez 0.00 255.0 FORMAT "%5.1" /end CHARACTERISTIC
/begin CHARACTERISTIC TSFEV6 "Fehlersummenzeit: EV von Zyl. 6" VALUE 0x1D35D4 KwWU8 255.0 dez 0.00 255.0 FORMAT "%5.1" /end CHARACTERISTIC
/begin CHARACTERISTIC TSFEV7 "Fehlersummenzeit: EV von Zyl. 7" VALUE 0x1D35D5 KwWU8 255.0 dez 0.00 255.0 FORMAT "%5.1" /end CHARACTERISTIC
/begin CHARACTERISTIC TSFEV8 "Fehlersummenzeit: EV von Zyl. 8" VALUE 0x1D35D6 KwWU8 255.0 dez 0.00 255.0 FORMAT "%5.1" /end CHARACTERISTIC
/begin CHARACTERISTIC TSFKKUE "Fehlersummenzeit: Kraftstoffkreislauf-Umschaltung Endstufe" VALUE 0x1D35F1 KwUb 255.0 dez 0.00 255.0 FORMAT "%5.1" /end CHARACTERISTIC
/begin CHARACTERISTIC TSFKPE "Fehlersummenzeit: EKP-Relais Endstufe" VALUE 0x1D35F2 KwWU8 255.0 dez 0.00 255.0 FORMAT "%5.1" /end CHARACTERISTIC
/begin CHARACTERISTIC TSFLDE "Fehlersummenzeit: Ladedrucksteuerventil (Endstufe)" VALUE 0x1D35FE KwUb 255.0 dez 0.00 255.0 FORMAT "%5.1" /end CHARACTERISTIC
/begin CHARACTERISTIC TSFLDPE "Fehlersummenzeit: Leckdiagnosepumpe Endstufe" VALUE 0x1D3600 KwUb 255.0 dez 0.00 255.0 FORMAT "%5.1" /end CHARACTERISTIC
/begin CHARACTERISTIC TSFLUVE "Fehlersummenzeit: EV-Luftumfassungsventil Endstufe" VALUE 0x1D3612 KwUb 255.0 dez 0.00 255.0 FORMAT "%5.1" /end CHARACTERISTIC
/begin CHARACTERISTIC TSFN "Fehlersummenzeit: Drehzahlgeber" VALUE 0x1D3624 KwUb 255.0 dez 0.00 255.0 FORMAT "%5.1" /end CHARACTERISTIC
/begin CHARACTERISTIC TSFSWE "Fehlersummenzeit: Beschleunigungssensor der Schlechtwegeerkennung" VALUE 0x1D3645 KwWU8 255.0 dez 0.00 255.0 FORMAT "%5.1" /end CHARACTERISTIC
/begin CHARACTERISTIC TSFZZZ "Dummy: Tabellenende" VALUE 0x1D3664 KwUb 255.0 dez 0.00 255.0 FORMAT "%5.1" /end CHARACTERISTIC
/begin CHARACTERISTIC UADPSMN "min. Spannungswert f¸r Diagnose Drucksensor" VALUE 0x1CA286 KwUb 4.980 spg_ub_b5 0.00 4.980 FORMAT "%5.3" /end CHARACTERISTIC
/begin CHARACTERISTIC UADPSMX "max. Spannungswert f¸r Diagnose Drucksensor" VALUE 0x1CA287 KwUb 4.980 spg_ub_b5 0.00 4.980 FORMAT "%5.3" /end CHARACTERISTIC
/begin CHARACTERISTIC UBCJMN "Minimale UBat-Schwelle f¸r Freigabe der CJ400-Endstufendiagnose" VALUE 0x1C3CCF KwUb 24.02 spg_ubatt 0.00 24.02 FORMAT "%5.2" /end CHARACTERISTIC
/begin CHARACTERISTIC UBCJMX "Maximale UBat-Schwelle f¸r Freigabe der CJ400-Endstufendiagnose" VALUE 0x1C3CD0 KwUb 24.02 spg_ubatt 0.00 24.02 FORMAT "%5.2" /end CHARACTERISTIC
/begin CHARACTERISTIC WDKBAST "Schwelle Drosselklappenwinkel Saugrohrdruckdiagnose im Start" VALUE 0x1CA3E2 KwSw 1599.976 relDK_q0p02441 -800.0000 799.9756 FORMAT "%8.4" /end CHARACTERISTIC
/begin CHARACTERISTIC WDSMNR "DK-Schwelle zum R¸cksetzen Min-Fehler f¸r Drucksensordiagnose" VALUE 0x1CA3E4 KwSw 400.0000 relDK_q0p02441 -200.0000 200.0000 FORMAT "%8.4" /end CHARACTERISTIC
/begin CHARACTERISTIC WDSMXR "DK-Schwelle zum R¸cksetzen Max-Fehler f¸r Drucksensordiagnose" VALUE 0x1CA3E6 KwSw 400.0000 relDK_q0p02441 -200.0000 200.0000 FORMAT "%8.4" /end CHARACTERISTIC
/begin CHARACTERISTIC ZWDKBA "Zeitkonstante f¸r WDKBA zur Diagnose Saugrohrdrucksensor" VALUE 0x1CA288 KwUb 5.08000 zk20msxs_ub_b5p1 0.0200000 5.10000 FORMAT "%7.5" /end CHARACTERISTIC
/begin MEASUREMENT addsu_u "AD-Messwert Umgebungsdrucksensor; DFPM Umweltbedingung" UBYTE dez 1 100 0 255 FORMAT "%5.1" ECU_ADDRESS 0x801118 /end MEASUREMENT
/begin MEASUREMENT adhfm_u "AD-Messwert Luftmassenmesser; DFPM Umweltbedingung" UBYTE dez 1 100 0 255 FORMAT "%5.1" ECU_ADDRESS 0x801119 /end MEASUREMENT
/begin MEASUREMENT adta_u "AD-Messwert Ansauglufttemperatur; DFPM Umweltbedingung" UBYTE dez 1 100 0 255 FORMAT "%5.1" ECU_ADDRESS 0x80111A /end MEASUREMENT
/begin MEASUREMENT adtka_u "AD-Messwert Temperatur K¸hlwasseraustritt; DFPM-Umweltbedingung" UBYTE dez 1 100 0 255 FORMAT "%5.1" ECU_ADDRESS 0x80111B /end MEASUREMENT
/begin MEASUREMENT adtm_u "AD-Messwert Motortemperatur; DFPM Umweltbedingung" UBYTE dez 1 100 0 255 FORMAT "%5.1" ECU_ADDRESS 0x80111C /end MEASUREMENT
/begin MEASUREMENT bbno "Byte f¸r Bedingung B_no  als Triggerevent in DCLA" UBYTE dez 1 100 0 255 FORMAT "%5.1" ECU_ADDRESS 0x7FC700 /end MEASUREMENT
/begin MEASUREMENT bbsp3 "Byte f¸r Bedingung B_sp3 als Triggerevent in DCLA" UBYTE dez 1 100 0 255 FORMAT "%5.1" ECU_ADDRESS 0x7FC701 /end MEASUREMENT
/begin MEASUREMENT bbtim "Byte f¸r Bedingung B_tim als Triggerevent in DCLA" UBYTE dez 1 100 0 255 FORMAT "%5.1" ECU_ADDRESS 0x801167 /end MEASUREMENT
/begin MEASUREMENT B_beanws "Bedingung Bandende-Funktionsanforderung NWS Endstufe (Bank1, Auslaﬂ)" UWORD B_TRUE 1 100 0 1 BIT_MASK 0x20 FORMAT "%13.11" ECU_ADDRESS 0x7FC892 /end MEASUREMENT
/begin MEASUREMENT B_beanws2 "Bedingung Bandende-Funktionsanforderung NWS Endstufe (Bank2, Auslaﬂ)" UWORD B_TRUE 1 100 0 1 BIT_MASK 0x20 FORMAT "%13.11" ECU_ADDRESS 0x7FC894 /end MEASUREMENT
/begin MEASUREMENT B_bebm "Bedingung Bandende-Funktionsanforderung Bezugsmarke erkannt" UWORD B_TRUE 1 100 0 1 BIT_MASK 0x20 FORMAT "%13.11" ECU_ADDRESS 0x7FC8AC /end MEASUREMENT
/begin MEASUREMENT B_becan "Bedingung Bandende Funktionsanforderung" UWORD B_TRUE 1 100 0 1 BIT_MASK 0x20 FORMAT "%13.11" ECU_ADDRESS 0x7FC8B0 /end MEASUREMENT
/begin MEASUREMENT B_bedk "Bedingung Bandende-Funktionsanforderung Drosselklappe" UWORD B_TRUE 1 100 0 1 BIT_MASK 0x20 FORMAT "%13.11" ECU_ADDRESS 0x7FC8C2 /end MEASUREMENT
/begin MEASUREMENT B_bedk1p "" UWORD B_TRUE 1 100 0 1 BIT_MASK 0x20 FORMAT "%13.11" ECU_ADDRESS 0x7FC8C4 /end MEASUREMENT
/begin MEASUREMENT B_bedk2p "" UWORD B_TRUE 1 100 0 1 BIT_MASK 0x20 FORMAT "%13.11" ECU_ADDRESS 0x7FC8C6 /end MEASUREMENT
/begin MEASUREMENT B_bedss "Bedingung Bandende-Funktionsanforderung DSS" UWORD B_TRUE 1 100 0 1 BIT_MASK 0x20 FORMAT "%13.11" ECU_ADDRESS 0x7FC8D0 /end MEASUREMENT
/begin MEASUREMENT B_bedvee "" UWORD B_TRUE 1 100 0 1 BIT_MASK 0x20 FORMAT "%13.11" ECU_ADDRESS 0x7FC8D4 /end MEASUREMENT
/begin MEASUREMENT B_bedvef "" UWORD B_TRUE 1 100 0 1 BIT_MASK 0x20 FORMAT "%13.11" ECU_ADDRESS 0x7FC8D6 /end MEASUREMENT
/begin MEASUREMENT B_bedvefo "" UWORD B_TRUE 1 100 0 1 BIT_MASK 0x20 FORMAT "%13.11" ECU_ADDRESS 0x7FC8D8 /end MEASUREMENT
/begin MEASUREMENT B_bedvel "" UWORD B_TRUE 1 100 0 1 BIT_MASK 0x20 FORMAT "%13.11" ECU_ADDRESS 0x7FC8DA /end MEASUREMENT
/begin MEASUREMENT B_bedven "" UWORD B_TRUE 1 100 0 1 BIT_MASK 0x20 FORMAT "%13.11" ECU_ADDRESS 0x7FC8DC /end MEASUREMENT
/begin MEASUREMENT B_bedver "" UWORD B_TRUE 1 100 0 1 BIT_MASK 0x20 FORMAT "%13.11" ECU_ADDRESS 0x7FC8DE /end MEASUREMENT
/begin MEASUREMENT B_bedvet "" UWORD B_TRUE 1 100 0 1 BIT_MASK 0x20 FORMAT "%13.11" ECU_ADDRESS 0x7FC8E0 /end MEASUREMENT
/begin MEASUREMENT B_bedveu "" UWORD B_TRUE 1 100 0 1 BIT_MASK 0x20 FORMAT "%13.11" ECU_ADDRESS 0x7FC8E2 /end MEASUREMENT
/begin MEASUREMENT B_bedveub "" UWORD B_TRUE 1 100 0 1 BIT_MASK 0x20 FORMAT "%13.11" ECU_ADDRESS 0x7FC8E4 /end MEASUREMENT
/begin MEASUREMENT B_bedveuw "" UWORD B_TRUE 1 100 0 1 BIT_MASK 0x20 FORMAT "%13.11" ECU_ADDRESS 0x7FC8E6 /end MEASUREMENT
/begin MEASUREMENT B_bedvev "" UWORD B_TRUE 1 100 0 1 BIT_MASK 0x20 FORMAT "%13.11" ECU_ADDRESS 0x7FC8E8 /end MEASUREMENT
/begin MEASUREMENT B_beenws "Bedingung Bandende-Funktionsanforderung NWS (Einlass,Bank1)" UWORD B_TRUE 1 100 0 1 BIT_MASK 0x20 FORMAT "%13.11" ECU_ADDRESS 0x7FC8F2 /end MEASUREMENT
/begin MEASUREMENT B_beenws2 "Bedingung Bandende-Funktionsanforderung NWS2 (Einlass,Bank2)" UWORD B_TRUE 1 100 0 1 BIT_MASK 0x20 FORMAT "%13.11" ECU_ADDRESS 0x7FC8F4 /end MEASUREMENT
/begin MEASUREMENT B_beev1 "Bedingung Bandendeanforderung  f¸r Fehler Endstufe EV1" UWORD B_TRUE 1 100 0 1 BIT_MASK 0x20 FORMAT "%13.11" ECU_ADDRESS 0x7FC902 /end MEASUREMENT
/begin MEASUREMENT B_beev2 "Bedingung Bandendeanforderung  f¸r Fehler Endstufe EV2" UWORD B_TRUE 1 100 0 1 BIT_MASK 0x20 FORMAT "%13.11" ECU_ADDRESS 0x7FC904 /end MEASUREMENT
/begin MEASUREMENT B_beev3 "Bedingung Bandendeanforderung  f¸r Fehler Endstufe EV3" UWORD B_TRUE 1 100 0 1 BIT_MASK 0x20 FORMAT "%13.11" ECU_ADDRESS 0x7FC906 /end MEASUREMENT
/begin MEASUREMENT B_beev4 "Bedingung Bandendeanforderung  f¸r Fehler Endstufe EV4" UWORD B_TRUE 1 100 0 1 BIT_MASK 0x20 FORMAT "%13.11" ECU_ADDRESS 0x7FC908 /end MEASUREMENT
/begin MEASUREMENT B_beev5 "Bedingung Bandendeanforderung  f¸r Fehler Endstufe EV5" UWORD B_TRUE 1 100 0 1 BIT_MASK 0x20 FORMAT "%13.11" ECU_ADDRESS 0x7FC90A /end MEASUREMENT
/begin MEASUREMENT B_beev6 "Bedingung Bandendeanforderung  f¸r Fehler Endstufe EV6" UWORD B_TRUE 1 100 0 1 BIT_MASK 0x20 FORMAT "%13.11" ECU_ADDRESS 0x7FC90C /end MEASUREMENT
/begin MEASUREMENT B_beev7 "Bedingung Bandendeanforderung  f¸r Fehler Endstufe EV7" UWORD B_TRUE 1 100 0 1 BIT_MASK 0x20 FORMAT "%13.11" ECU_ADDRESS 0x7FC90E /end MEASUREMENT
/begin MEASUREMENT B_beev8 "Bedingung Bandendeanforderung  f¸r Fehler Endstufe EV8" UWORD B_TRUE 1 100 0 1 BIT_MASK 0x20 FORMAT "%13.11" ECU_ADDRESS 0x7FC910 /end MEASUREMENT
/begin MEASUREMENT B_bekkue "" UWORD B_TRUE 1 100 0 1 BIT_MASK 0x20 FORMAT "%13.11" ECU_ADDRESS 0x7FC946 /end MEASUREMENT
/begin MEASUREMENT B_bekpe "Bedingung Bandendeanforderung f¸r Fehler Endstufe EKP" UWORD B_TRUE 1 100 0 1 BIT_MASK 0x20 FORMAT "%13.11" ECU_ADDRESS 0x7FC948 /end MEASUREMENT
/begin MEASUREMENT B_belde "Bedingung: Fehlereintrag  LDR-Taktventil (Bandende)" UWORD B_TRUE 1 100 0 1 BIT_MASK 0x20 FORMAT "%13.11" ECU_ADDRESS 0x7FC960 /end MEASUREMENT
/begin MEASUREMENT B_beldpe "" UWORD B_TRUE 1 100 0 1 BIT_MASK 0x20 FORMAT "%13.11" ECU_ADDRESS 0x7FC964 /end MEASUREMENT
/begin MEASUREMENT B_beluve "" UWORD B_TRUE 1 100 0 1 BIT_MASK 0x20 FORMAT "%13.11" ECU_ADDRESS 0x7FC988 /end MEASUREMENT
/begin MEASUREMENT B_ben "" UWORD B_TRUE 1 100 0 1 BIT_MASK 0x20 FORMAT "%13.11" ECU_ADDRESS 0x7FC9AC /end MEASUREMENT
/begin MEASUREMENT B_beswe "Bedingung Bandende-Funktionsanforderung Beschleunigungss. f Schlechtwegerkennung" UWORD B_TRUE 1 100 0 1 BIT_MASK 0x20 FORMAT "%13.11" ECU_ADDRESS 0x7FC9EE /end MEASUREMENT
/begin MEASUREMENT B_bkanws "Bedingung Ersatzwert aktiv: NWS (Bank1, Auslaﬂ)" UWORD B_TRUE 1 100 0 1 BIT_MASK 0x40 FORMAT "%13.11" ECU_ADDRESS 0x7FC892 /end MEASUREMENT
/begin MEASUREMENT B_bkanws2 "Bedingung Ersatzwert aktiv: NWS (Bank2, Auslaﬂ)" UWORD B_TRUE 1 100 0 1 BIT_MASK 0x40 FORMAT "%13.11" ECU_ADDRESS 0x7FC894 /end MEASUREMENT
/begin MEASUREMENT B_bkbm "Bedingung Ersatzwert aktiv: Bezugsmarke" UWORD B_TRUE 1 100 0 1 BIT_MASK 0x40 FORMAT "%13.11" ECU_ADDRESS 0x7FC8AC /end MEASUREMENT
/begin MEASUREMENT B_bkcan "Bedingung Ersatzwert aktiv" UWORD B_TRUE 1 100 0 1 BIT_MASK 0x40 FORMAT "%13.11" ECU_ADDRESS 0x7FC8B0 /end MEASUREMENT
/begin MEASUREMENT B_bkdk "Bedingung Eratzwert aktiv: Fehler Drosselklappenpoti lˆschen" UWORD B_TRUE 1 100 0 1 BIT_MASK 0x40 FORMAT "%13.11" ECU_ADDRESS 0x7FC8C2 /end MEASUREMENT
/begin MEASUREMENT B_bkdk1p "Bedingung Ersatzwert aktiv: Drosselklappe 1.Poti" UWORD B_TRUE 1 100 0 1 BIT_MASK 0x40 FORMAT "%13.11" ECU_ADDRESS 0x7FC8C4 /end MEASUREMENT
/begin MEASUREMENT B_bkdk2p "Bedingung Ersatzwert aktiv: Drosselklappe 2.Poti" UWORD B_TRUE 1 100 0 1 BIT_MASK 0x40 FORMAT "%13.11" ECU_ADDRESS 0x7FC8C6 /end MEASUREMENT
/begin MEASUREMENT B_bkdss "Bedingung Ersatzwert aktiv: DSS" UWORD B_TRUE 1 100 0 1 BIT_MASK 0x40 FORMAT "%13.11" ECU_ADDRESS 0x7FC8D0 /end MEASUREMENT
/begin MEASUREMENT B_bkdvee "Bedingung: DV-E Endstufe" UWORD B_TRUE 1 100 0 1 BIT_MASK 0x40 FORMAT "%13.11" ECU_ADDRESS 0x7FC8D4 /end MEASUREMENT
/begin MEASUREMENT B_bkdvef "Bedingung: DV-E Fehler bei Federpr¸fung" UWORD B_TRUE 1 100 0 1 BIT_MASK 0x40 FORMAT "%13.11" ECU_ADDRESS 0x7FC8D6 /end MEASUREMENT
/begin MEASUREMENT B_bkdvefo "" UWORD B_TRUE 1 100 0 1 BIT_MASK 0x40 FORMAT "%13.11" ECU_ADDRESS 0x7FC8D8 /end MEASUREMENT
/begin MEASUREMENT B_bkdvel "Bedingung: DV-E Lageabweichung" UWORD B_TRUE 1 100 0 1 BIT_MASK 0x40 FORMAT "%13.11" ECU_ADDRESS 0x7FC8DA /end MEASUREMENT
/begin MEASUREMENT B_bkdven "Ersatzwert aktiv: DV-E Notluftposition" UWORD B_TRUE 1 100 0 1 BIT_MASK 0x40 FORMAT "%13.11" ECU_ADDRESS 0x7FC8DC /end MEASUREMENT
/begin MEASUREMENT B_bkdver "Bedingung: DV-E Regelbereich" UWORD B_TRUE 1 100 0 1 BIT_MASK 0x40 FORMAT "%13.11" ECU_ADDRESS 0x7FC8DE /end MEASUREMENT
/begin MEASUREMENT B_bkdvet "" UWORD B_TRUE 1 100 0 1 BIT_MASK 0x40 FORMAT "%13.11" ECU_ADDRESS 0x7FC8E0 /end MEASUREMENT
/begin MEASUREMENT B_bkdveu "Ersatzwert aktiv: DV-E UMA-Lernen" UWORD B_TRUE 1 100 0 1 BIT_MASK 0x40 FORMAT "%13.11" ECU_ADDRESS 0x7FC8E2 /end MEASUREMENT
/begin MEASUREMENT B_bkdveub "" UWORD B_TRUE 1 100 0 1 BIT_MASK 0x40 FORMAT "%13.11" ECU_ADDRESS 0x7FC8E4 /end MEASUREMENT
/begin MEASUREMENT B_bkdveuw "Bedingung Ersatzwert aktiv: Fehler bei UMA-Wiederlernen" UWORD B_TRUE 1 100 0 1 BIT_MASK 0x40 FORMAT "%13.11" ECU_ADDRESS 0x7FC8E6 /end MEASUREMENT
/begin MEASUREMENT B_bkdvev "Ersatzwert aktiv: DV-E Verst‰rkerabgleich" UWORD B_TRUE 1 100 0 1 BIT_MASK 0x40 FORMAT "%13.11" ECU_ADDRESS 0x7FC8E8 /end MEASUREMENT
/begin MEASUREMENT B_bkenws "Bedingung Ersatzwert aktiv: NWS (Einlass,Bank1)" UWORD B_TRUE 1 100 0 1 BIT_MASK 0x40 FORMAT "%13.11" ECU_ADDRESS 0x7FC8F2 /end MEASUREMENT
/begin MEASUREMENT B_bkenws2 "Bedingung Ersatzwert aktiv: NWS2 (Einlass,Bank2)" UWORD B_TRUE 1 100 0 1 BIT_MASK 0x40 FORMAT "%13.11" ECU_ADDRESS 0x7FC8F4 /end MEASUREMENT
/begin MEASUREMENT B_bkev1 "Bedingung: Einspritzventil 1 aktiv" UWORD B_TRUE 1 100 0 1 BIT_MASK 0x40 FORMAT "%13.11" ECU_ADDRESS 0x7FC902 /end MEASUREMENT
/begin MEASUREMENT B_bkev2 "Bedingung: Einspritzventil 2 aktiv" UWORD B_TRUE 1 100 0 1 BIT_MASK 0x40 FORMAT "%13.11" ECU_ADDRESS 0x7FC904 /end MEASUREMENT
/begin MEASUREMENT B_bkev3 "Bedingung: Einspritzventil 3 aktiv" UWORD B_TRUE 1 100 0 1 BIT_MASK 0x40 FORMAT "%13.11" ECU_ADDRESS 0x7FC906 /end MEASUREMENT
/begin MEASUREMENT B_bkev4 "Bedingung: Einspritzventil 4 aktiv" UWORD B_TRUE 1 100 0 1 BIT_MASK 0x40 FORMAT "%13.11" ECU_ADDRESS 0x7FC908 /end MEASUREMENT
/begin MEASUREMENT B_bkev5 "Bedingung: Einspritzventil 5 aktiv" UWORD B_TRUE 1 100 0 1 BIT_MASK 0x40 FORMAT "%13.11" ECU_ADDRESS 0x7FC90A /end MEASUREMENT
/begin MEASUREMENT B_bkev6 "Bedingung: Einspritzventil 6 aktiv" UWORD B_TRUE 1 100 0 1 BIT_MASK 0x40 FORMAT "%13.11" ECU_ADDRESS 0x7FC90C /end MEASUREMENT
/begin MEASUREMENT B_bkev7 "Bedingung: Einspritzventil 7 aktiv" UWORD B_TRUE 1 100 0 1 BIT_MASK 0x40 FORMAT "%13.11" ECU_ADDRESS 0x7FC90E /end MEASUREMENT
/begin MEASUREMENT B_bkev8 "Bedingung: Einspritzventil 8 aktiv" UWORD B_TRUE 1 100 0 1 BIT_MASK 0x40 FORMAT "%13.11" ECU_ADDRESS 0x7FC910 /end MEASUREMENT
/begin MEASUREMENT B_bkkkue "" UWORD B_TRUE 1 100 0 1 BIT_MASK 0x40 FORMAT "%13.11" ECU_ADDRESS 0x7FC946 /end MEASUREMENT
/begin MEASUREMENT B_bkkpe "Bedingung Ersatzwert f¸r EKP-Relais Endstufe" UWORD B_TRUE 1 100 0 1 BIT_MASK 0x40 FORMAT "%13.11" ECU_ADDRESS 0x7FC948 /end MEASUREMENT
/begin MEASUREMENT B_bklde "Bedingung: Ladedrucksteuerventil Endstufe aktiv" UWORD B_TRUE 1 100 0 1 BIT_MASK 0x40 FORMAT "%13.11" ECU_ADDRESS 0x7FC960 /end MEASUREMENT
/begin MEASUREMENT B_bkldpe "Bedingung: Leckdiagnosemodul Endstufe aktiv" UWORD B_TRUE 1 100 0 1 BIT_MASK 0x40 FORMAT "%13.11" ECU_ADDRESS 0x7FC964 /end MEASUREMENT
/begin MEASUREMENT B_bkluve "Bedingung: EV-Luftumfassungsventil Endstufe" UWORD B_TRUE 1 100 0 1 BIT_MASK 0x40 FORMAT "%13.11" ECU_ADDRESS 0x7FC988 /end MEASUREMENT
/begin MEASUREMENT B_bkn "Bedingung: Drehzahlsignalgeber aktiv" UWORD B_TRUE 1 100 0 1 BIT_MASK 0x40 FORMAT "%13.11" ECU_ADDRESS 0x7FC9AC /end MEASUREMENT
/begin MEASUREMENT B_bkswe "Bedingung Ersatzwert aktiv: Schlechtwegerkennung" UWORD B_TRUE 1 100 0 1 BIT_MASK 0x40 FORMAT "%13.11" ECU_ADDRESS 0x7FC9EE /end MEASUREMENT
/begin MEASUREMENT B_clanws "Bedingung Fehlerpfad Nockenwellensteuerung (Auslaﬂ,Bank1) lˆschen" UWORD B_TRUE 1 100 0 1 BIT_MASK 0x80 FORMAT "%13.11" ECU_ADDRESS 0x7FC892 /end MEASUREMENT
/begin MEASUREMENT B_clanws2 "Bedingung Fehlerpfad Nockenwellensteuerung (Auslaﬂ,Bank2) lˆschen" UWORD B_TRUE 1 100 0 1 BIT_MASK 0x80 FORMAT "%13.11" ECU_ADDRESS 0x7FC894 /end MEASUREMENT
/begin MEASUREMENT B_clbm "Bedingung Fehlerpfad Bezugsmarkengeber lˆschen" UWORD B_TRUE 1 100 0 1 BIT_MASK 0x80 FORMAT "%13.11" ECU_ADDRESS 0x7FC8AC /end MEASUREMENT
/begin MEASUREMENT B_clcan "Bedingung Fehlerpfad CAN lˆschen" UWORD B_TRUE 1 100 0 1 BIT_MASK 0x80 FORMAT "%13.11" ECU_ADDRESS 0x7FC8B0 /end MEASUREMENT
/begin MEASUREMENT B_cldk "Bedingung Fehlerpfad DK (Drosselklappen-Poti) lˆschen" UWORD B_TRUE 1 100 0 1 BIT_MASK 0x80 FORMAT "%13.11" ECU_ADDRESS 0x7FC8C2 /end MEASUREMENT
/begin MEASUREMENT B_cldk1p "Bedingung Fehlerpfad DK1P (Drosselklappen-Poti 1) lˆschen" UWORD B_TRUE 1 100 0 1 BIT_MASK 0x80 FORMAT "%13.11" ECU_ADDRESS 0x7FC8C4 /end MEASUREMENT
/begin MEASUREMENT B_cldk2p "Bedingung Fehlerpfad DK2P (Drosselklappen-Poti 2) lˆschen" UWORD B_TRUE 1 100 0 1 BIT_MASK 0x80 FORMAT "%13.11" ECU_ADDRESS 0x7FC8C6 /end MEASUREMENT
/begin MEASUREMENT B_cldss "Bedingung: Fehlerpfad Saugrohrdrucksensor lˆschen" UWORD B_TRUE 1 100 0 1 BIT_MASK 0x80 FORMAT "%13.11" ECU_ADDRESS 0x7FC8D0 /end MEASUREMENT
/begin MEASUREMENT B_cldvee "Flag f¸r Lˆschmaﬂnahmen: DV-E Endstufe" UWORD B_TRUE 1 100 0 1 BIT_MASK 0x80 FORMAT "%13.11" ECU_ADDRESS 0x7FC8D4 /end MEASUREMENT
/begin MEASUREMENT B_cldvef "Flag f¸r Lˆschung: DV-E Fehler bei Federpr¸fung" UWORD B_TRUE 1 100 0 1 BIT_MASK 0x80 FORMAT "%13.11" ECU_ADDRESS 0x7FC8D6 /end MEASUREMENT
/begin MEASUREMENT B_cldvefo "Flag f¸r Lˆschung: Fehler bei Federpr¸fung ""÷ffnen""" UWORD B_TRUE 1 100 0 1 BIT_MASK 0x80 FORMAT "%13.11" ECU_ADDRESS 0x7FC8D8 /end MEASUREMENT
/begin MEASUREMENT B_cldvel "Flag f¸r Lˆschmaﬂnahmen: DV-E Lageabweichung" UWORD B_TRUE 1 100 0 1 BIT_MASK 0x80 FORMAT "%13.11" ECU_ADDRESS 0x7FC8DA /end MEASUREMENT
/begin MEASUREMENT B_cldven "Flag f¸r Lˆschung: DV-E Fehler bei Pr¸fung Notluftposition" UWORD B_TRUE 1 100 0 1 BIT_MASK 0x80 FORMAT "%13.11" ECU_ADDRESS 0x7FC8DC /end MEASUREMENT
/begin MEASUREMENT B_cldver "Flag f¸r Lˆschmaﬂnahmen: DV-E Regelabweichung" UWORD B_TRUE 1 100 0 1 BIT_MASK 0x80 FORMAT "%13.11" ECU_ADDRESS 0x7FC8DE /end MEASUREMENT
/begin MEASUREMENT B_cldvet "Flag f¸r Lˆschung: DV-E-Tauscherkennung ohne Adaption" UWORD B_TRUE 1 100 0 1 BIT_MASK 0x80 FORMAT "%13.11" ECU_ADDRESS 0x7FC8E0 /end MEASUREMENT
/begin MEASUREMENT B_cldveu "Flag f¸r Lˆschung: DV-E Fehler beim UMA-Lernen" UWORD B_TRUE 1 100 0 1 BIT_MASK 0x80 FORMAT "%13.11" ECU_ADDRESS 0x7FC8E2 /end MEASUREMENT
/begin MEASUREMENT B_cldveub "Flag f¸r Lˆschung: DV-E-Adaption Abbruch wg. Umweltbedingung" UWORD B_TRUE 1 100 0 1 BIT_MASK 0x80 FORMAT "%13.11" ECU_ADDRESS 0x7FC8E4 /end MEASUREMENT
/begin MEASUREMENT B_cldveuw "Flag f¸r Lˆschung: Fehler bei UMA-Wiederlernen" UWORD B_TRUE 1 100 0 1 BIT_MASK 0x80 FORMAT "%13.11" ECU_ADDRESS 0x7FC8E6 /end MEASUREMENT
/begin MEASUREMENT B_cldvev "Flag f¸r Lˆschung: DV-E Fehler bei Verst‰rkerabgleich" UWORD B_TRUE 1 100 0 1 BIT_MASK 0x80 FORMAT "%13.11" ECU_ADDRESS 0x7FC8E8 /end MEASUREMENT
/begin MEASUREMENT B_clenws "Bedingung Fehlerpfad Nockenwellensteuerung (Einlaﬂ,Bank1) lˆschen" UWORD B_TRUE 1 100 0 1 BIT_MASK 0x80 FORMAT "%13.11" ECU_ADDRESS 0x7FC8F2 /end MEASUREMENT
/begin MEASUREMENT B_clenws2 "Bedingung Fehlerpfad Nockenwellensteuerung (Einlaﬂ,Bank2) lˆschen" UWORD B_TRUE 1 100 0 1 BIT_MASK 0x80 FORMAT "%13.11" ECU_ADDRESS 0x7FC8F4 /end MEASUREMENT
/begin MEASUREMENT B_clev1 "Bedingung Fehlerpfad EV 1 lˆschen" UWORD B_TRUE 1 100 0 1 BIT_MASK 0x80 FORMAT "%13.11" ECU_ADDRESS 0x7FC902 /end MEASUREMENT
/begin MEASUREMENT B_clev2 "Bedingung Fehlerpfad EV 2 lˆschen" UWORD B_TRUE 1 100 0 1 BIT_MASK 0x80 FORMAT "%13.11" ECU_ADDRESS 0x7FC904 /end MEASUREMENT
/begin MEASUREMENT B_clev3 "Bedingung Fehlerpfad EV 3 lˆschen" UWORD B_TRUE 1 100 0 1 BIT_MASK 0x80 FORMAT "%13.11" ECU_ADDRESS 0x7FC906 /end MEASUREMENT
/begin MEASUREMENT B_clev4 "Bedingung Fehlerpfad EV 4 lˆschen" UWORD B_TRUE 1 100 0 1 BIT_MASK 0x80 FORMAT "%13.11" ECU_ADDRESS 0x7FC908 /end MEASUREMENT
/begin MEASUREMENT B_clev5 "Bedingung Fehlerpfad EV 5 lˆschen" UWORD B_TRUE 1 100 0 1 BIT_MASK 0x80 FORMAT "%13.11" ECU_ADDRESS 0x7FC90A /end MEASUREMENT
/begin MEASUREMENT B_clev6 "Bedingung Fehlerpfad EV 6 lˆschen" UWORD B_TRUE 1 100 0 1 BIT_MASK 0x80 FORMAT "%13.11" ECU_ADDRESS 0x7FC90C /end MEASUREMENT
/begin MEASUREMENT B_clev7 "Bedingung Fehlerpfad EV 7 lˆschen" UWORD B_TRUE 1 100 0 1 BIT_MASK 0x80 FORMAT "%13.11" ECU_ADDRESS 0x7FC90E /end MEASUREMENT
/begin MEASUREMENT B_clev8 "Bedingung Fehlerpfad EV 8 lˆschen" UWORD B_TRUE 1 100 0 1 BIT_MASK 0x80 FORMAT "%13.11" ECU_ADDRESS 0x7FC910 /end MEASUREMENT
/begin MEASUREMENT B_clkkue "" UWORD B_TRUE 1 100 0 1 BIT_MASK 0x80 FORMAT "%13.11" ECU_ADDRESS 0x7FC946 /end MEASUREMENT
/begin MEASUREMENT B_clkpe "Bedingung Fehlerpfad EKP-Relais Endstufe lˆschen" UWORD B_TRUE 1 100 0 1 BIT_MASK 0x80 FORMAT "%13.11" ECU_ADDRESS 0x7FC948 /end MEASUREMENT
/begin MEASUREMENT B_cllde "Bedingung Fehlerpfad LDE lˆschen" UWORD B_TRUE 1 100 0 1 BIT_MASK 0x80 FORMAT "%13.11" ECU_ADDRESS 0x7FC960 /end MEASUREMENT
/begin MEASUREMENT B_clldpe "Bedingung: Fehlerpfad Endstufe LDP lˆschen" UWORD B_TRUE 1 100 0 1 BIT_MASK 0x80 FORMAT "%13.11" ECU_ADDRESS 0x7FC964 /end MEASUREMENT
/begin MEASUREMENT B_clluve "Bedingung EV-Luftumfassungsventil Endstufe lˆschen" UWORD B_TRUE 1 100 0 1 BIT_MASK 0x80 FORMAT "%13.11" ECU_ADDRESS 0x7FC988 /end MEASUREMENT
/begin MEASUREMENT B_cln "Bedingung Fehlerpfad Drehzahlgeber lˆschen" UWORD B_TRUE 1 100 0 1 BIT_MASK 0x80 FORMAT "%13.11" ECU_ADDRESS 0x7FC9AC /end MEASUREMENT
/begin MEASUREMENT B_clswe "Flag : Fehlerpfad Diagnose Beschleunigungssensor lˆschen" UWORD B_TRUE 1 100 0 1 BIT_MASK 0x80 FORMAT "%13.11" ECU_ADDRESS 0x7FC9EE /end MEASUREMENT
/begin MEASUREMENT B_desee "Diagnose Endstufe: Eingangsbedingungen erf¸llt" UBYTE B_TRUE 1 100 0 1 BIT_MASK 0x1 FORMAT "%13.11" ECU_ADDRESS 0x7FA6A6 /end MEASUREMENT
/begin MEASUREMENT B_dssg "Bedingung  Saugrohrdrucksensor  g¸ltig" UBYTE B_TRUE 1 100 0 1 BIT_MASK 0x1 FORMAT "%13.11" ECU_ADDRESS 0x800570 /end MEASUREMENT
/begin MEASUREMENT B_edss "Bedingung Fehler DSS (ohne Entprellung)" UBYTE B_TRUE 1 100 0 1 BIT_MASK 0x1 FORMAT "%13.11" ECU_ADDRESS 0x7FC317 /end MEASUREMENT
/begin MEASUREMENT B_eev "Bedingung Endstufenfehler EV" UBYTE B_TRUE 1 100 0 1 BIT_MASK 0x1 FORMAT "%13.11" ECU_ADDRESS 0x7FA78F /end MEASUREMENT
/begin MEASUREMENT B_ehfmfe "Bedingung: Fehler HFM aus DEGFE" UBYTE B_TRUE 1 100 0 1 BIT_MASK 0x1 FORMAT "%13.11" ECU_ADDRESS 0x80056E /end MEASUREMENT
/begin MEASUREMENT B_epcl "Bedingung f¸r Ansteuerung EGAS-Fehlerlampe" UBYTE B_TRUE 1 100 0 1 BIT_MASK 0x1 FORMAT "%13.11" ECU_ADDRESS 0x7FA6A7 /end MEASUREMENT
/begin MEASUREMENT B_epclloc "Bedingung f¸r Ansteuerung EGAS-Fehlerlampe loc." UBYTE B_TRUE 1 100 0 1 BIT_MASK 0x1 FORMAT "%13.11" ECU_ADDRESS 0x7FA6A8 /end MEASUREMENT
/begin MEASUREMENT B_erelrmax "Bedingung Fehler Drucksensor maximale Spannung" UBYTE B_TRUE 1 100 0 1 BIT_MASK 0x8 FORMAT "%13.11" ECU_ADDRESS 0x80109F /end MEASUREMENT
/begin MEASUREMENT B_erelrmin "Bedingung Fehler Drucksensor minimale Spannung" UBYTE B_TRUE 1 100 0 1 BIT_MASK 0x10 FORMAT "%13.11" ECU_ADDRESS 0x80109F /end MEASUREMENT
/begin MEASUREMENT B_errpllm "Bedingung  Fehler f¸r Drucksensorplausibilisierung" UBYTE B_TRUE 1 100 0 1 BIT_MASK 0x20 FORMAT "%13.11" ECU_ADDRESS 0x80109F /end MEASUREMENT
/begin MEASUREMENT B_ftanws "Bedingung: Fehlereintrag durch Tester f¸r NWS (Auslaﬂ, Bank1)" UWORD B_TRUE 1 100 0 1 BIT_MASK 0x10 FORMAT "%13.11" ECU_ADDRESS 0x7FC892 /end MEASUREMENT
/begin MEASUREMENT B_ftanws2 "Bedingung: Fehlereintrag durch Tester f¸r NWS (Auslaﬂ, Bank2)" UWORD B_TRUE 1 100 0 1 BIT_MASK 0x10 FORMAT "%13.11" ECU_ADDRESS 0x7FC894 /end MEASUREMENT
/begin MEASUREMENT B_ftbm "" UWORD B_TRUE 1 100 0 1 BIT_MASK 0x10 FORMAT "%13.11" ECU_ADDRESS 0x7FC8AC /end MEASUREMENT
/begin MEASUREMENT B_ftcan "Bedingung Fehlereintag durch Tester" UWORD B_TRUE 1 100 0 1 BIT_MASK 0x10 FORMAT "%13.11" ECU_ADDRESS 0x7FC8B0 /end MEASUREMENT
/begin MEASUREMENT B_ftdk "" UWORD B_TRUE 1 100 0 1 BIT_MASK 0x10 FORMAT "%13.11" ECU_ADDRESS 0x7FC8C2 /end MEASUREMENT
/begin MEASUREMENT B_ftdk1p "" UWORD B_TRUE 1 100 0 1 BIT_MASK 0x10 FORMAT "%13.11" ECU_ADDRESS 0x7FC8C4 /end MEASUREMENT
/begin MEASUREMENT B_ftdk2p "" UWORD B_TRUE 1 100 0 1 BIT_MASK 0x10 FORMAT "%13.11" ECU_ADDRESS 0x7FC8C6 /end MEASUREMENT
/begin MEASUREMENT B_ftdss "Bedingung: Fehlereintrag durch Tester f¸r DSS" UWORD B_TRUE 1 100 0 1 BIT_MASK 0x10 FORMAT "%13.11" ECU_ADDRESS 0x7FC8D0 /end MEASUREMENT
/begin MEASUREMENT B_ftdvee "" UWORD B_TRUE 1 100 0 1 BIT_MASK 0x10 FORMAT "%13.11" ECU_ADDRESS 0x7FC8D4 /end MEASUREMENT
/begin MEASUREMENT B_ftdvef "" UWORD B_TRUE 1 100 0 1 BIT_MASK 0x10 FORMAT "%13.11" ECU_ADDRESS 0x7FC8D6 /end MEASUREMENT
/begin MEASUREMENT B_ftdvefo "" UWORD B_TRUE 1 100 0 1 BIT_MASK 0x10 FORMAT "%13.11" ECU_ADDRESS 0x7FC8D8 /end MEASUREMENT
/begin MEASUREMENT B_ftdvel "" UWORD B_TRUE 1 100 0 1 BIT_MASK 0x10 FORMAT "%13.11" ECU_ADDRESS 0x7FC8DA /end MEASUREMENT
/begin MEASUREMENT B_ftdven "" UWORD B_TRUE 1 100 0 1 BIT_MASK 0x10 FORMAT "%13.11" ECU_ADDRESS 0x7FC8DC /end MEASUREMENT
/begin MEASUREMENT B_ftdver "" UWORD B_TRUE 1 100 0 1 BIT_MASK 0x10 FORMAT "%13.11" ECU_ADDRESS 0x7FC8DE /end MEASUREMENT
/begin MEASUREMENT B_ftdvet "" UWORD B_TRUE 1 100 0 1 BIT_MASK 0x10 FORMAT "%13.11" ECU_ADDRESS 0x7FC8E0 /end MEASUREMENT
/begin MEASUREMENT B_ftdveu "" UWORD B_TRUE 1 100 0 1 BIT_MASK 0x10 FORMAT "%13.11" ECU_ADDRESS 0x7FC8E2 /end MEASUREMENT
/begin MEASUREMENT B_ftdveub "" UWORD B_TRUE 1 100 0 1 BIT_MASK 0x10 FORMAT "%13.11" ECU_ADDRESS 0x7FC8E4 /end MEASUREMENT
/begin MEASUREMENT B_ftdveuw "" UWORD B_TRUE 1 100 0 1 BIT_MASK 0x10 FORMAT "%13.11" ECU_ADDRESS 0x7FC8E6 /end MEASUREMENT
/begin MEASUREMENT B_ftdvev "" UWORD B_TRUE 1 100 0 1 BIT_MASK 0x10 FORMAT "%13.11" ECU_ADDRESS 0x7FC8E8 /end MEASUREMENT
/begin MEASUREMENT B_ftenws "Bedingung: Fehlereintrag durch Tester f¸r NWS (Einlaﬂ, Bank1)" UWORD B_TRUE 1 100 0 1 BIT_MASK 0x10 FORMAT "%13.11" ECU_ADDRESS 0x7FC8F2 /end MEASUREMENT
/begin MEASUREMENT B_ftenws2 "Bedingung: Fehlereintrag durch Tester f¸r NWS2 (Einlass, Bank2)" UWORD B_TRUE 1 100 0 1 BIT_MASK 0x10 FORMAT "%13.11" ECU_ADDRESS 0x7FC8F4 /end MEASUREMENT
/begin MEASUREMENT B_ftev1 "Bedingung: Fehlereintrag durch Tester f¸r Endstufendiagnose EV1" UWORD B_TRUE 1 100 0 1 BIT_MASK 0x10 FORMAT "%13.11" ECU_ADDRESS 0x7FC902 /end MEASUREMENT
/begin MEASUREMENT B_ftev2 "Bedingung: Fehlereintrag durch Tester f¸r Endstufendiagnose EV2" UWORD B_TRUE 1 100 0 1 BIT_MASK 0x10 FORMAT "%13.11" ECU_ADDRESS 0x7FC904 /end MEASUREMENT
/begin MEASUREMENT B_ftev3 "Bedingung: Fehlereintrag durch Tester f¸r Endstufendiagnose EV3" UWORD B_TRUE 1 100 0 1 BIT_MASK 0x10 FORMAT "%13.11" ECU_ADDRESS 0x7FC906 /end MEASUREMENT
/begin MEASUREMENT B_ftev4 "Bedingung: Fehlereintrag durch Tester f¸r Endstufendiagnose EV4" UWORD B_TRUE 1 100 0 1 BIT_MASK 0x10 FORMAT "%13.11" ECU_ADDRESS 0x7FC908 /end MEASUREMENT
/begin MEASUREMENT B_ftev5 "Bedingung: Fehlereintrag durch Tester f¸r Endstufendiagnose EV5" UWORD B_TRUE 1 100 0 1 BIT_MASK 0x10 FORMAT "%13.11" ECU_ADDRESS 0x7FC90A /end MEASUREMENT
/begin MEASUREMENT B_ftev6 "Bedingung: Fehlereintrag durch Tester f¸r Endstufendiagnose EV6" UWORD B_TRUE 1 100 0 1 BIT_MASK 0x10 FORMAT "%13.11" ECU_ADDRESS 0x7FC90C /end MEASUREMENT
/begin MEASUREMENT B_ftev7 "Bedingung: Fehlereintrag durch Tester f¸r Endstufendiagnose EV7" UWORD B_TRUE 1 100 0 1 BIT_MASK 0x10 FORMAT "%13.11" ECU_ADDRESS 0x7FC90E /end MEASUREMENT
/begin MEASUREMENT B_ftev8 "Bedingung: Fehlereintrag durch Tester f¸r Endstufendiagnose EV8" UWORD B_TRUE 1 100 0 1 BIT_MASK 0x10 FORMAT "%13.11" ECU_ADDRESS 0x7FC910 /end MEASUREMENT
/begin MEASUREMENT B_ftkkue "" UWORD B_TRUE 1 100 0 1 BIT_MASK 0x10 FORMAT "%13.11" ECU_ADDRESS 0x7FC946 /end MEASUREMENT
/begin MEASUREMENT B_ftkpe "Bedingung: Fehlereintrag durch Tester f¸r Endstufendiagnose EKP" UWORD B_TRUE 1 100 0 1 BIT_MASK 0x10 FORMAT "%13.11" ECU_ADDRESS 0x7FC948 /end MEASUREMENT
/begin MEASUREMENT B_ftlde "Bedingung: Fehlereintrag durch Ladedrucksteuerventil (Tester)" UWORD B_TRUE 1 100 0 1 BIT_MASK 0x10 FORMAT "%13.11" ECU_ADDRESS 0x7FC960 /end MEASUREMENT
/begin MEASUREMENT B_ftldpe "" UWORD B_TRUE 1 100 0 1 BIT_MASK 0x10 FORMAT "%13.11" ECU_ADDRESS 0x7FC964 /end MEASUREMENT
/begin MEASUREMENT B_ftluve "" UWORD B_TRUE 1 100 0 1 BIT_MASK 0x10 FORMAT "%13.11" ECU_ADDRESS 0x7FC988 /end MEASUREMENT
/begin MEASUREMENT B_ftn "" UWORD B_TRUE 1 100 0 1 BIT_MASK 0x10 FORMAT "%13.11" ECU_ADDRESS 0x7FC9AC /end MEASUREMENT
/begin MEASUREMENT B_ftswe "Bedingung Fehlereintrag durch Tester:  Schlechtwegerkennung" UWORD B_TRUE 1 100 0 1 BIT_MASK 0x10 FORMAT "%13.11" ECU_ADDRESS 0x7FC9EE /end MEASUREMENT
/begin MEASUREMENT B_headsslm "Bedingung Fehlerheilung Saugrohrdrucksensor (f¸r %DSELHFS)" UBYTE B_TRUE 1 100 0 1 BIT_MASK 0x2 FORMAT "%13.11" ECU_ADDRESS 0x800570 /end MEASUREMENT
/begin MEASUREMENT B_mnanws "Bed. Nockenwellenverstellung hat Fr¸hposition nicht erreicht (Auslaﬂ,Bank1)" UWORD B_TRUE 1 100 0 1 BIT_MASK 0x200 FORMAT "%13.11" ECU_ADDRESS 0x7FC892 /end MEASUREMENT
/begin MEASUREMENT B_mnanws2 "Bed. Nockenwellenverstellung hat Fr¸hposition nicht erreicht (Auslaﬂ,Bank2)" UWORD B_TRUE 1 100 0 1 BIT_MASK 0x200 FORMAT "%13.11" ECU_ADDRESS 0x7FC894 /end MEASUREMENT
/begin MEASUREMENT B_mnbm "Fehlertyp: h‰ufige Korrektur bei einem Zahn zuwenig" UWORD B_TRUE 1 100 0 1 BIT_MASK 0x200 FORMAT "%13.11" ECU_ADDRESS 0x7FC8AC /end MEASUREMENT
/begin MEASUREMENT B_mncan "Fehlerart: CAN Min-Fehler" UWORD B_TRUE 1 100 0 1 BIT_MASK 0x200 FORMAT "%13.11" ECU_ADDRESS 0x7FC8B0 /end MEASUREMENT
/begin MEASUREMENT B_mndk "Fehlertype: Kurzschluﬂ nach Masse Drosselklappenpoti" UWORD B_TRUE 1 100 0 1 BIT_MASK 0x200 FORMAT "%13.11" ECU_ADDRESS 0x7FC8C2 /end MEASUREMENT
/begin MEASUREMENT B_mndk1p "Fehlertyp min.: Drosselklappe 1. Poti" UWORD B_TRUE 1 100 0 1 BIT_MASK 0x200 FORMAT "%13.11" ECU_ADDRESS 0x7FC8C4 /end MEASUREMENT
/begin MEASUREMENT B_mndk2p "Fehlertyp min.: Drosselklappe 2. Poti" UWORD B_TRUE 1 100 0 1 BIT_MASK 0x200 FORMAT "%13.11" ECU_ADDRESS 0x7FC8C6 /end MEASUREMENT
/begin MEASUREMENT B_mndss "Bedingung: min-Fehler Saugrohrdrucksensor" UWORD B_TRUE 1 100 0 1 BIT_MASK 0x200 FORMAT "%13.11" ECU_ADDRESS 0x7FC8D0 /end MEASUREMENT
/begin MEASUREMENT B_mndsslm "Bedingung: min-Fehler Saugrohrdrucksensor (f¸r %DSELHFS)" UBYTE B_TRUE 1 100 0 1 BIT_MASK 0x4 FORMAT "%13.11" ECU_ADDRESS 0x800570 /end MEASUREMENT
/begin MEASUREMENT B_mndvee "Fehlerzyp min.: DV-E Endstufe" UWORD B_TRUE 1 100 0 1 BIT_MASK 0x200 FORMAT "%13.11" ECU_ADDRESS 0x7FC8D4 /end MEASUREMENT
/begin MEASUREMENT B_mndvef "Fehlertyp min.: DV-E Fehler bei Pr¸fung der ˆffnenden Feder" UWORD B_TRUE 1 100 0 1 BIT_MASK 0x200 FORMAT "%13.11" ECU_ADDRESS 0x7FC8D6 /end MEASUREMENT
/begin MEASUREMENT B_mndvefo "Fehlertyp min.: Fehler bei Federpr¸fung ""÷ffnen""" UWORD B_TRUE 1 100 0 1 BIT_MASK 0x200 FORMAT "%13.11" ECU_ADDRESS 0x7FC8D8 /end MEASUREMENT
/begin MEASUREMENT B_mndvel "Fehlertyp min.: DV-E Lageabweichung" UWORD B_TRUE 1 100 0 1 BIT_MASK 0x200 FORMAT "%13.11" ECU_ADDRESS 0x7FC8DA /end MEASUREMENT
/begin MEASUREMENT B_mndven "Fehlertyp min.: DV-E Fehler bei Pr¸fung Notluftposition" UWORD B_TRUE 1 100 0 1 BIT_MASK 0x200 FORMAT "%13.11" ECU_ADDRESS 0x7FC8DC /end MEASUREMENT
/begin MEASUREMENT B_mndver "Fehlerzyp min.: DV-E Regelbereich, kurzfristig ¸berschritten" UWORD B_TRUE 1 100 0 1 BIT_MASK 0x200 FORMAT "%13.11" ECU_ADDRESS 0x7FC8DE /end MEASUREMENT
/begin MEASUREMENT B_mndvet "" UWORD B_TRUE 1 100 0 1 BIT_MASK 0x200 FORMAT "%13.11" ECU_ADDRESS 0x7FC8E0 /end MEASUREMENT
/begin MEASUREMENT B_mndveu "Fehlertyp min.: DV-E Fehler beim UMA-Lernen" UWORD B_TRUE 1 100 0 1 BIT_MASK 0x200 FORMAT "%13.11" ECU_ADDRESS 0x7FC8E2 /end MEASUREMENT
/begin MEASUREMENT B_mndveub "Fehlertyp min.: DV-E-Adaption Abbruch wg. Umweltbed/Unterspng" UWORD B_TRUE 1 100 0 1 BIT_MASK 0x200 FORMAT "%13.11" ECU_ADDRESS 0x7FC8E4 /end MEASUREMENT
/begin MEASUREMENT B_mndveuw "" UWORD B_TRUE 1 100 0 1 BIT_MASK 0x200 FORMAT "%13.11" ECU_ADDRESS 0x7FC8E6 /end MEASUREMENT
/begin MEASUREMENT B_mndvev "Fehlertyp min.: DV-E Fehler bei Verst‰rkerabgleich" UWORD B_TRUE 1 100 0 1 BIT_MASK 0x200 FORMAT "%13.11" ECU_ADDRESS 0x7FC8E8 /end MEASUREMENT
/begin MEASUREMENT B_mnenws "Bed. Nockenwellenverstellung hat Fr¸hposition nicht erreicht (Einlaﬂ,Bank1)" UWORD B_TRUE 1 100 0 1 BIT_MASK 0x200 FORMAT "%13.11" ECU_ADDRESS 0x7FC8F2 /end MEASUREMENT
/begin MEASUREMENT B_mnenws2 "Bed. Nockenwellenverstellung hat Fr¸hposition nicht erreicht (Einlaﬂ,Bank2)" UWORD B_TRUE 1 100 0 1 BIT_MASK 0x200 FORMAT "%13.11" ECU_ADDRESS 0x7FC8F4 /end MEASUREMENT
/begin MEASUREMENT B_mnev1 "Fehlerart: Kurzschluﬂ Masse an Endstufe EV1" UWORD B_TRUE 1 100 0 1 BIT_MASK 0x200 FORMAT "%13.11" ECU_ADDRESS 0x7FC902 /end MEASUREMENT
/begin MEASUREMENT B_mnev2 "Fehlerart: Kurzschluﬂ Masse an Endstufe EV2" UWORD B_TRUE 1 100 0 1 BIT_MASK 0x200 FORMAT "%13.11" ECU_ADDRESS 0x7FC904 /end MEASUREMENT
/begin MEASUREMENT B_mnev3 "Fehlerart: Kurzschluﬂ Masse an Endstufe EV3" UWORD B_TRUE 1 100 0 1 BIT_MASK 0x200 FORMAT "%13.11" ECU_ADDRESS 0x7FC906 /end MEASUREMENT
/begin MEASUREMENT B_mnev4 "Fehlerart: Kurzschluﬂ Masse an Endstufe EV4" UWORD B_TRUE 1 100 0 1 BIT_MASK 0x200 FORMAT "%13.11" ECU_ADDRESS 0x7FC908 /end MEASUREMENT
/begin MEASUREMENT B_mnev5 "Fehlerart: Kurzschluﬂ Masse an Endstufe EV5" UWORD B_TRUE 1 100 0 1 BIT_MASK 0x200 FORMAT "%13.11" ECU_ADDRESS 0x7FC90A /end MEASUREMENT
/begin MEASUREMENT B_mnev6 "Fehlerart: Kurzschluﬂ Masse an Endstufe EV6" UWORD B_TRUE 1 100 0 1 BIT_MASK 0x200 FORMAT "%13.11" ECU_ADDRESS 0x7FC90C /end MEASUREMENT
/begin MEASUREMENT B_mnev7 "Fehlerart: Kurzschluﬂ Masse an Endstufe EV7" UWORD B_TRUE 1 100 0 1 BIT_MASK 0x200 FORMAT "%13.11" ECU_ADDRESS 0x7FC90E /end MEASUREMENT
/begin MEASUREMENT B_mnev8 "Fehlerart: Kurzschluﬂ Masse an Endstufe EV8" UWORD B_TRUE 1 100 0 1 BIT_MASK 0x200 FORMAT "%13.11" ECU_ADDRESS 0x7FC910 /end MEASUREMENT
/begin MEASUREMENT B_mnkkue "" UWORD B_TRUE 1 100 0 1 BIT_MASK 0x200 FORMAT "%13.11" ECU_ADDRESS 0x7FC946 /end MEASUREMENT
/begin MEASUREMENT B_mnkpe "Bedingung f¸r Fehlertyp Kurzschluﬂ nach Masse f¸r EKP-Relais Endstufe erkannt" UWORD B_TRUE 1 100 0 1 BIT_MASK 0x200 FORMAT "%13.11" ECU_ADDRESS 0x7FC948 /end MEASUREMENT
/begin MEASUREMENT B_mnlde "Fehlertyp: Kurzschluﬂ Masse LDR-Taktventil" UWORD B_TRUE 1 100 0 1 BIT_MASK 0x200 FORMAT "%13.11" ECU_ADDRESS 0x7FC960 /end MEASUREMENT
/begin MEASUREMENT B_mnldpe "Fehlertype: Kurzschluﬂ nach Masse LDP-Endstufe" UWORD B_TRUE 1 100 0 1 BIT_MASK 0x200 FORMAT "%13.11" ECU_ADDRESS 0x7FC964 /end MEASUREMENT
/begin MEASUREMENT B_mnluve "Fehlertyp min.: EV-Luftumfassungsventil Endstufe" UWORD B_TRUE 1 100 0 1 BIT_MASK 0x200 FORMAT "%13.11" ECU_ADDRESS 0x7FC988 /end MEASUREMENT
/begin MEASUREMENT B_mnn "Fehlerart: Synchronisationsmarke h‰ufig nicht gefunden" UWORD B_TRUE 1 100 0 1 BIT_MASK 0x200 FORMAT "%13.11" ECU_ADDRESS 0x7FC9AC /end MEASUREMENT
/begin MEASUREMENT B_mnswe "Beschleunigungssensorsignal kleiner als Plausibilit‰tsschwelle" UWORD B_TRUE 1 100 0 1 BIT_MASK 0x200 FORMAT "%13.11" ECU_ADDRESS 0x7FC9EE /end MEASUREMENT
/begin MEASUREMENT B_mxanws "Bed. Nockenwellenverstellung hat Sp‰tposition nicht erreicht (Auslaﬂ,Bank1)" UWORD B_TRUE 1 100 0 1 BIT_MASK 0x100 FORMAT "%13.11" ECU_ADDRESS 0x7FC892 /end MEASUREMENT
/begin MEASUREMENT B_mxanws2 "Bed. Nockenwellenverstellung hat Sp‰tposition nicht erreicht (Auslaﬂ,Bank2)" UWORD B_TRUE 1 100 0 1 BIT_MASK 0x100 FORMAT "%13.11" ECU_ADDRESS 0x7FC894 /end MEASUREMENT
/begin MEASUREMENT B_mxbm "Fehlertyp: h‰ufige Korrektur bei einem Zahn zuviel" UWORD B_TRUE 1 100 0 1 BIT_MASK 0x100 FORMAT "%13.11" ECU_ADDRESS 0x7FC8AC /end MEASUREMENT
/begin MEASUREMENT B_mxcan "Fehlerart: CAN Max-Fehler" UWORD B_TRUE 1 100 0 1 BIT_MASK 0x100 FORMAT "%13.11" ECU_ADDRESS 0x7FC8B0 /end MEASUREMENT
/begin MEASUREMENT B_mxdk "Fehlertype: Kurzschluﬂ nach Ubat Drosselklappenpoti" UWORD B_TRUE 1 100 0 1 BIT_MASK 0x100 FORMAT "%13.11" ECU_ADDRESS 0x7FC8C2 /end MEASUREMENT
/begin MEASUREMENT B_mxdk1p "Fehlertyp max.: Drosselklappe 1. Poti" UWORD B_TRUE 1 100 0 1 BIT_MASK 0x100 FORMAT "%13.11" ECU_ADDRESS 0x7FC8C4 /end MEASUREMENT
/begin MEASUREMENT B_mxdk2p "Fehlertyp max.: Drosselklappe 2. Poti" UWORD B_TRUE 1 100 0 1 BIT_MASK 0x100 FORMAT "%13.11" ECU_ADDRESS 0x7FC8C6 /end MEASUREMENT
/begin MEASUREMENT B_mxdss "Bedingung: max-Fehler Saugrohrdrucksensor" UWORD B_TRUE 1 100 0 1 BIT_MASK 0x100 FORMAT "%13.11" ECU_ADDRESS 0x7FC8D0 /end MEASUREMENT
/begin MEASUREMENT B_mxdsslm "Bedingung: max-Fehler Saugrohrdrucksensor (f¸r %DSELHFS)" UBYTE B_TRUE 1 100 0 1 BIT_MASK 0x8 FORMAT "%13.11" ECU_ADDRESS 0x800570 /end MEASUREMENT
/begin MEASUREMENT B_mxdvee "Fehlertyp max.: DV-E Endstufe" UWORD B_TRUE 1 100 0 1 BIT_MASK 0x100 FORMAT "%13.11" ECU_ADDRESS 0x7FC8D4 /end MEASUREMENT
/begin MEASUREMENT B_mxdvef "Fehlertyp max.: DV-E Fehler bei Pr¸fung der R¸ckstellfeder" UWORD B_TRUE 1 100 0 1 BIT_MASK 0x100 FORMAT "%13.11" ECU_ADDRESS 0x7FC8D6 /end MEASUREMENT
/begin MEASUREMENT B_mxdvefo "Fehlertyp max.: Fehler bei Federpr¸fung ""÷ffnen""" UWORD B_TRUE 1 100 0 1 BIT_MASK 0x100 FORMAT "%13.11" ECU_ADDRESS 0x7FC8D8 /end MEASUREMENT
/begin MEASUREMENT B_mxdvel "Fehlerzyp max.: DV-E Lageabweichung" UWORD B_TRUE 1 100 0 1 BIT_MASK 0x100 FORMAT "%13.11" ECU_ADDRESS 0x7FC8DA /end MEASUREMENT
/begin MEASUREMENT B_mxdven "Fehlertyp max.: DV-E Fehler bei Pr¸fung Notluftposition" UWORD B_TRUE 1 100 0 1 BIT_MASK 0x100 FORMAT "%13.11" ECU_ADDRESS 0x7FC8DC /end MEASUREMENT
/begin MEASUREMENT B_mxdver "Fehlertyp max.: DV-E Regelbereich, langfristig verletzt" UWORD B_TRUE 1 100 0 1 BIT_MASK 0x100 FORMAT "%13.11" ECU_ADDRESS 0x7FC8DE /end MEASUREMENT
/begin MEASUREMENT B_mxdvet "" UWORD B_TRUE 1 100 0 1 BIT_MASK 0x100 FORMAT "%13.11" ECU_ADDRESS 0x7FC8E0 /end MEASUREMENT
/begin MEASUREMENT B_mxdveu "Fehlertyp max.: DV-E Fehler beim UMA-Lernen" UWORD B_TRUE 1 100 0 1 BIT_MASK 0x100 FORMAT "%13.11" ECU_ADDRESS 0x7FC8E2 /end MEASUREMENT
/begin MEASUREMENT B_mxdveub "Fehlertyp max.: DV-E-Adaption Abbruch wg. Umweltbedingung" UWORD B_TRUE 1 100 0 1 BIT_MASK 0x100 FORMAT "%13.11" ECU_ADDRESS 0x7FC8E4 /end MEASUREMENT
/begin MEASUREMENT B_mxdveuw "" UWORD B_TRUE 1 100 0 1 BIT_MASK 0x100 FORMAT "%13.11" ECU_ADDRESS 0x7FC8E6 /end MEASUREMENT
/begin MEASUREMENT B_mxdvev "Fehlertyp max.: DV-E Fehler bei Verst‰rkerabgleich" UWORD B_TRUE 1 100 0 1 BIT_MASK 0x100 FORMAT "%13.11" ECU_ADDRESS 0x7FC8E8 /end MEASUREMENT
/begin MEASUREMENT B_mxenws "Bed. Nockenwellenverstellung hat Sp‰tposition nicht erreicht (Einlaﬂ,Bank1)" UWORD B_TRUE 1 100 0 1 BIT_MASK 0x100 FORMAT "%13.11" ECU_ADDRESS 0x7FC8F2 /end MEASUREMENT
/begin MEASUREMENT B_mxenws2 "Bed. Nockenwellenverstellung hat Sp‰tposition nicht erreicht (Einlaﬂ,Bank2)" UWORD B_TRUE 1 100 0 1 BIT_MASK 0x100 FORMAT "%13.11" ECU_ADDRESS 0x7FC8F4 /end MEASUREMENT
/begin MEASUREMENT B_mxev1 "Fehlerart: Kurzschluﬂ UBat an Endstufe EV1" UWORD B_TRUE 1 100 0 1 BIT_MASK 0x100 FORMAT "%13.11" ECU_ADDRESS 0x7FC902 /end MEASUREMENT
/begin MEASUREMENT B_mxev2 "Fehlerart: Kurzschluﬂ UBat an Endstufe EV2" UWORD B_TRUE 1 100 0 1 BIT_MASK 0x100 FORMAT "%13.11" ECU_ADDRESS 0x7FC904 /end MEASUREMENT
/begin MEASUREMENT B_mxev3 "Fehlerart: Kurzschluﬂ UBat an Endstufe EV3" UWORD B_TRUE 1 100 0 1 BIT_MASK 0x100 FORMAT "%13.11" ECU_ADDRESS 0x7FC906 /end MEASUREMENT
/begin MEASUREMENT B_mxev4 "Fehlerart: Kurzschluﬂ UBat an Endstufe EV4" UWORD B_TRUE 1 100 0 1 BIT_MASK 0x100 FORMAT "%13.11" ECU_ADDRESS 0x7FC908 /end MEASUREMENT
/begin MEASUREMENT B_mxev5 "Fehlerart: Kurzschluﬂ UBat an Endstufe EV5" UWORD B_TRUE 1 100 0 1 BIT_MASK 0x100 FORMAT "%13.11" ECU_ADDRESS 0x7FC90A /end MEASUREMENT
/begin MEASUREMENT B_mxev6 "Fehlerart: Kurzschluﬂ UBat an Endstufe EV6" UWORD B_TRUE 1 100 0 1 BIT_MASK 0x100 FORMAT "%13.11" ECU_ADDRESS 0x7FC90C /end MEASUREMENT
/begin MEASUREMENT B_mxev7 "Fehlerart: Kurzschluﬂ UBat an Endstufe EV7" UWORD B_TRUE 1 100 0 1 BIT_MASK 0x100 FORMAT "%13.11" ECU_ADDRESS 0x7FC90E /end MEASUREMENT
/begin MEASUREMENT B_mxev8 "Fehlerart: Kurzschluﬂ UBat an Endstufe EV8" UWORD B_TRUE 1 100 0 1 BIT_MASK 0x100 FORMAT "%13.11" ECU_ADDRESS 0x7FC910 /end MEASUREMENT
/begin MEASUREMENT B_mxkkue "" UWORD B_TRUE 1 100 0 1 BIT_MASK 0x100 FORMAT "%13.11" ECU_ADDRESS 0x7FC946 /end MEASUREMENT
/begin MEASUREMENT B_mxkpe "Fehlertyp Kurzschluﬂ nach Ubat f¸r EKP-Relais Endstufe erkannt" UWORD B_TRUE 1 100 0 1 BIT_MASK 0x100 FORMAT "%13.11" ECU_ADDRESS 0x7FC948 /end MEASUREMENT
/begin MEASUREMENT B_mxlde "Fehlertyp: Kurzschluﬂ Ubat LDR-Taktventil" UWORD B_TRUE 1 100 0 1 BIT_MASK 0x100 FORMAT "%13.11" ECU_ADDRESS 0x7FC960 /end MEASUREMENT
/begin MEASUREMENT B_mxldpe "Fehlertype: Kurzschluﬂ nach Ubatt Endstufe LDP" UWORD B_TRUE 1 100 0 1 BIT_MASK 0x100 FORMAT "%13.11" ECU_ADDRESS 0x7FC964 /end MEASUREMENT
/begin MEASUREMENT B_mxluve "Fehlertyp max.: EV-Luftumfassungsventil Endstufe" UWORD B_TRUE 1 100 0 1 BIT_MASK 0x100 FORMAT "%13.11" ECU_ADDRESS 0x7FC988 /end MEASUREMENT
/begin MEASUREMENT B_mxn "Fehlerart: h‰ufiger L¸ckenverlust beim L¸ckencheck" UWORD B_TRUE 1 100 0 1 BIT_MASK 0x100 FORMAT "%13.11" ECU_ADDRESS 0x7FC9AC /end MEASUREMENT
/begin MEASUREMENT B_mxswe "Beschleunigungssensorsignal grˆﬂer als Plausibilit‰tsschwelle" UWORD B_TRUE 1 100 0 1 BIT_MASK 0x100 FORMAT "%13.11" ECU_ADDRESS 0x7FC9EE /end MEASUREMENT
/begin MEASUREMENT B_no "unendlich-Trigger f¸r Fehlerpfadmanagement" UBYTE B_TRUE 1 100 0 1 BIT_MASK 0x1 FORMAT "%13.11" ECU_ADDRESS 0x7FC700 /end MEASUREMENT
/begin MEASUREMENT B_npanws "Bed. Nockenwellenverstellung hat unplausible Position (Auslaﬂ,Bank1)" UWORD B_TRUE 1 100 0 1 BIT_MASK 0x800 FORMAT "%13.11" ECU_ADDRESS 0x7FC892 /end MEASUREMENT
/begin MEASUREMENT B_npanws2 "Bed. Nockenwellenverstellung hat unplausible Position (Auslaﬂ,Bank2)" UWORD B_TRUE 1 100 0 1 BIT_MASK 0x800 FORMAT "%13.11" ECU_ADDRESS 0x7FC894 /end MEASUREMENT
/begin MEASUREMENT B_npbm "Fehlertyp: Bezugsmarkenfehler beim L¸ckencheck" UWORD B_TRUE 1 100 0 1 BIT_MASK 0x800 FORMAT "%13.11" ECU_ADDRESS 0x7FC8AC /end MEASUREMENT
/begin MEASUREMENT B_npcan "Fehlerart: CAN Signal nicht plausibel" UWORD B_TRUE 1 100 0 1 BIT_MASK 0x800 FORMAT "%13.11" ECU_ADDRESS 0x7FC8B0 /end MEASUREMENT
/begin MEASUREMENT B_npdk "Bedingung unplausible Potisignale von der Drosselklappe" UWORD B_TRUE 1 100 0 1 BIT_MASK 0x800 FORMAT "%13.11" ECU_ADDRESS 0x7FC8C2 /end MEASUREMENT
/begin MEASUREMENT B_npdk1p "Fehlertyp unplaus.: Drosselklappe 1. Poti" UWORD B_TRUE 1 100 0 1 BIT_MASK 0x800 FORMAT "%13.11" ECU_ADDRESS 0x7FC8C4 /end MEASUREMENT
/begin MEASUREMENT B_npdk2p "Fehlertyp unplaus.: Drosselklappe 2. Poti" UWORD B_TRUE 1 100 0 1 BIT_MASK 0x800 FORMAT "%13.11" ECU_ADDRESS 0x7FC8C6 /end MEASUREMENT
/begin MEASUREMENT B_npdss "Bedingung Plausfehler Drucksensor" UWORD B_TRUE 1 100 0 1 BIT_MASK 0x800 FORMAT "%13.11" ECU_ADDRESS 0x7FC8D0 /end MEASUREMENT
/begin MEASUREMENT B_npdvee "Fehlerzyp unplaus.: DV-E Endstufe" UWORD B_TRUE 1 100 0 1 BIT_MASK 0x800 FORMAT "%13.11" ECU_ADDRESS 0x7FC8D4 /end MEASUREMENT
/begin MEASUREMENT B_npdvef "Fehlertyp unplaus.: DV-E Fehler bei Federpr¸fung" UWORD B_TRUE 1 100 0 1 BIT_MASK 0x800 FORMAT "%13.11" ECU_ADDRESS 0x7FC8D6 /end MEASUREMENT
/begin MEASUREMENT B_npdvefo "" UWORD B_TRUE 1 100 0 1 BIT_MASK 0x800 FORMAT "%13.11" ECU_ADDRESS 0x7FC8D8 /end MEASUREMENT
/begin MEASUREMENT B_npdvel "Fehlerzyp unplaus.: DV-E Lageabweichung" UWORD B_TRUE 1 100 0 1 BIT_MASK 0x800 FORMAT "%13.11" ECU_ADDRESS 0x7FC8DA /end MEASUREMENT
/begin MEASUREMENT B_npdven "Fehlertyp unplaus.: DV-E Fehler bei Pr¸fung Notluftposition" UWORD B_TRUE 1 100 0 1 BIT_MASK 0x800 FORMAT "%13.11" ECU_ADDRESS 0x7FC8DC /end MEASUREMENT
/begin MEASUREMENT B_npdver "Fehlerzyp unplaus.: DV-E Regelbereich" UWORD B_TRUE 1 100 0 1 BIT_MASK 0x800 FORMAT "%13.11" ECU_ADDRESS 0x7FC8DE /end MEASUREMENT
/begin MEASUREMENT B_npdvet "Fehlertyp ""unplausibel"": DV-E-Tauscherkennung ohne Adaption" UWORD B_TRUE 1 100 0 1 BIT_MASK 0x800 FORMAT "%13.11" ECU_ADDRESS 0x7FC8E0 /end MEASUREMENT
/begin MEASUREMENT B_npdveu "Fehlertyp unplaus.: DV-E Fehler beim UMA-Lernen" UWORD B_TRUE 1 100 0 1 BIT_MASK 0x800 FORMAT "%13.11" ECU_ADDRESS 0x7FC8E2 /end MEASUREMENT
/begin MEASUREMENT B_npdveub "" UWORD B_TRUE 1 100 0 1 BIT_MASK 0x800 FORMAT "%13.11" ECU_ADDRESS 0x7FC8E4 /end MEASUREMENT
/begin MEASUREMENT B_npdveuw "Fehlertyp ""unplausibel"" bei UMA-Wiederlernen" UWORD B_TRUE 1 100 0 1 BIT_MASK 0x800 FORMAT "%13.11" ECU_ADDRESS 0x7FC8E6 /end MEASUREMENT
/begin MEASUREMENT B_npdvev "Fehlertyp unplaus.: DV-E Fehler bei Verst‰rkerabgleich" UWORD B_TRUE 1 100 0 1 BIT_MASK 0x800 FORMAT "%13.11" ECU_ADDRESS 0x7FC8E8 /end MEASUREMENT
/begin MEASUREMENT B_npenws "Bed. Nockenwellenverstellung hat unplausible Position (Einlaﬂ,Bank1)" UWORD B_TRUE 1 100 0 1 BIT_MASK 0x800 FORMAT "%13.11" ECU_ADDRESS 0x7FC8F2 /end MEASUREMENT
/begin MEASUREMENT B_npenws2 "Bed. Nockenwellenverstellung hat unplausible Position (Einlaﬂ,Bank2)" UWORD B_TRUE 1 100 0 1 BIT_MASK 0x800 FORMAT "%13.11" ECU_ADDRESS 0x7FC8F4 /end MEASUREMENT
/begin MEASUREMENT B_npev1 "Fehlerart: Zustand nicht plausibel EV1" UWORD B_TRUE 1 100 0 1 BIT_MASK 0x800 FORMAT "%13.11" ECU_ADDRESS 0x7FC902 /end MEASUREMENT
/begin MEASUREMENT B_npev2 "Fehlerart: Zustand nicht plausibel EV2" UWORD B_TRUE 1 100 0 1 BIT_MASK 0x800 FORMAT "%13.11" ECU_ADDRESS 0x7FC904 /end MEASUREMENT
/begin MEASUREMENT B_npev3 "Fehlerart: Zustand nicht plausibel EV3" UWORD B_TRUE 1 100 0 1 BIT_MASK 0x800 FORMAT "%13.11" ECU_ADDRESS 0x7FC906 /end MEASUREMENT
/begin MEASUREMENT B_npev4 "Fehlerart: Zustand nicht plausibel EV4" UWORD B_TRUE 1 100 0 1 BIT_MASK 0x800 FORMAT "%13.11" ECU_ADDRESS 0x7FC908 /end MEASUREMENT
/begin MEASUREMENT B_npev5 "Fehlerart: Zustand nicht plausibel EV5" UWORD B_TRUE 1 100 0 1 BIT_MASK 0x800 FORMAT "%13.11" ECU_ADDRESS 0x7FC90A /end MEASUREMENT
/begin MEASUREMENT B_npev6 "Fehlerart: Zustand nicht plausibel EV6" UWORD B_TRUE 1 100 0 1 BIT_MASK 0x800 FORMAT "%13.11" ECU_ADDRESS 0x7FC90C /end MEASUREMENT
/begin MEASUREMENT B_npev7 "Fehlerart: Zustand nicht plausibel EV7" UWORD B_TRUE 1 100 0 1 BIT_MASK 0x800 FORMAT "%13.11" ECU_ADDRESS 0x7FC90E /end MEASUREMENT
/begin MEASUREMENT B_npev8 "Fehlerart: Zustand nicht plausibel EV8" UWORD B_TRUE 1 100 0 1 BIT_MASK 0x800 FORMAT "%13.11" ECU_ADDRESS 0x7FC910 /end MEASUREMENT
/begin MEASUREMENT B_npkkue "" UWORD B_TRUE 1 100 0 1 BIT_MASK 0x800 FORMAT "%13.11" ECU_ADDRESS 0x7FC946 /end MEASUREMENT
/begin MEASUREMENT B_npkpe "Bedingung f¸r Fehlertyp 'Wert unplausibel' f¸r EKP-Relais Endstufe erkannt" UWORD B_TRUE 1 100 0 1 BIT_MASK 0x800 FORMAT "%13.11" ECU_ADDRESS 0x7FC948 /end MEASUREMENT
/begin MEASUREMENT B_nplde "Nicht plausibler Fehler: Ladedrucksteuerventil Endstufe" UWORD B_TRUE 1 100 0 1 BIT_MASK 0x800 FORMAT "%13.11" ECU_ADDRESS 0x7FC960 /end MEASUREMENT
/begin MEASUREMENT B_npldpe "Nicht plausibler Fehler: Leckdiagnosemodul Endstufe" UWORD B_TRUE 1 100 0 1 BIT_MASK 0x800 FORMAT "%13.11" ECU_ADDRESS 0x7FC964 /end MEASUREMENT
/begin MEASUREMENT B_npldsslm "Bedingung Plausfehler Drucksensor (f¸r %DSELHFS)" UBYTE B_TRUE 1 100 0 1 BIT_MASK 0x10 FORMAT "%13.11" ECU_ADDRESS 0x800570 /end MEASUREMENT
/begin MEASUREMENT B_npluve "Fehlerart: EV-Luftumfassungsventil Endstufe" UWORD B_TRUE 1 100 0 1 BIT_MASK 0x800 FORMAT "%13.11" ECU_ADDRESS 0x7FC988 /end MEASUREMENT
/begin MEASUREMENT B_npn "Fehlerart: h‰ufiger Bezugsmarkenfehler beim L¸ckencheck" UWORD B_TRUE 1 100 0 1 BIT_MASK 0x800 FORMAT "%13.11" ECU_ADDRESS 0x7FC9AC /end MEASUREMENT
/begin MEASUREMENT B_npswe "Beschleunigungssensorsignal ist nicht plausibel" UWORD B_TRUE 1 100 0 1 BIT_MASK 0x800 FORMAT "%13.11" ECU_ADDRESS 0x7FC9EE /end MEASUREMENT
/begin MEASUREMENT B_resmaxpl "Bedingung Plausibilit‰t maximaler Drosselklappenfehler" UBYTE B_TRUE 1 100 0 1 BIT_MASK 0x40 FORMAT "%13.11" ECU_ADDRESS 0x80109F /end MEASUREMENT
/begin MEASUREMENT B_resminpl "Bedingung Plausibilit‰t minimaler Drosselklappenwinkel" UBYTE B_TRUE 1 100 0 1 BIT_MASK 0x80 FORMAT "%13.11" ECU_ADDRESS 0x80109F /end MEASUREMENT
/begin MEASUREMENT B_sianws "Fehlerart: Leitungsabfall Nockenwellensteuerungsventil (Bank1, Auslaﬂ)" UWORD B_TRUE 1 100 0 1 BIT_MASK 0x400 FORMAT "%13.11" ECU_ADDRESS 0x7FC892 /end MEASUREMENT
/begin MEASUREMENT B_sianws2 "Fehlerart: Leitungsabfall Nockenwellensteuerungsventil (Bank2, Auslaﬂ)" UWORD B_TRUE 1 100 0 1 BIT_MASK 0x400 FORMAT "%13.11" ECU_ADDRESS 0x7FC894 /end MEASUREMENT
/begin MEASUREMENT B_sibm "Fehlertyp: keine Bezugsmarke im Start gefunden" UWORD B_TRUE 1 100 0 1 BIT_MASK 0x400 FORMAT "%13.11" ECU_ADDRESS 0x7FC8AC /end MEASUREMENT
/begin MEASUREMENT B_sican "Fehlerart: CAN Mute Fehler" UWORD B_TRUE 1 100 0 1 BIT_MASK 0x400 FORMAT "%13.11" ECU_ADDRESS 0x7FC8B0 /end MEASUREMENT
/begin MEASUREMENT B_sidk "Fehlertyp signal: Drosselklappenpoti" UWORD B_TRUE 1 100 0 1 BIT_MASK 0x400 FORMAT "%13.11" ECU_ADDRESS 0x7FC8C2 /end MEASUREMENT
/begin MEASUREMENT B_sidk1p "Fehlendes Signal: Drosselklappe 1. Poti" UWORD B_TRUE 1 100 0 1 BIT_MASK 0x400 FORMAT "%13.11" ECU_ADDRESS 0x7FC8C4 /end MEASUREMENT
/begin MEASUREMENT B_sidk2p "Fehlendes Signal: Drosselklappe 2. Poti" UWORD B_TRUE 1 100 0 1 BIT_MASK 0x400 FORMAT "%13.11" ECU_ADDRESS 0x7FC8C6 /end MEASUREMENT
/begin MEASUREMENT B_sidss "Bedingung Signalfehler Drucksensor" UWORD B_TRUE 1 100 0 1 BIT_MASK 0x400 FORMAT "%13.11" ECU_ADDRESS 0x7FC8D0 /end MEASUREMENT
/begin MEASUREMENT B_sidsslm "Bedingung Signalfehler Drucksensor (f¸r %DSELHFS)" UBYTE B_TRUE 1 100 0 1 BIT_MASK 0x20 FORMAT "%13.11" ECU_ADDRESS 0x800570 /end MEASUREMENT
/begin MEASUREMENT B_sidvee "Fehlertyp sig.: DV-E Endstufe" UWORD B_TRUE 1 100 0 1 BIT_MASK 0x400 FORMAT "%13.11" ECU_ADDRESS 0x7FC8D4 /end MEASUREMENT
/begin MEASUREMENT B_sidvef "Fehlertyp sig.: DV-E Fehler bei Federpr¸fung" UWORD B_TRUE 1 100 0 1 BIT_MASK 0x400 FORMAT "%13.11" ECU_ADDRESS 0x7FC8D6 /end MEASUREMENT
/begin MEASUREMENT B_sidvefo "" UWORD B_TRUE 1 100 0 1 BIT_MASK 0x400 FORMAT "%13.11" ECU_ADDRESS 0x7FC8D8 /end MEASUREMENT
/begin MEASUREMENT B_sidvel "Fehlertyp sig.: DV-E Lageabweichung" UWORD B_TRUE 1 100 0 1 BIT_MASK 0x400 FORMAT "%13.11" ECU_ADDRESS 0x7FC8DA /end MEASUREMENT
/begin MEASUREMENT B_sidven "Fehlertyp sig.: DV-E Fehler bei Pr¸fung Notluftposition" UWORD B_TRUE 1 100 0 1 BIT_MASK 0x400 FORMAT "%13.11" ECU_ADDRESS 0x7FC8DC /end MEASUREMENT
/begin MEASUREMENT B_sidver "Fehlertyp sig.: DV-E Regelbereich" UWORD B_TRUE 1 100 0 1 BIT_MASK 0x400 FORMAT "%13.11" ECU_ADDRESS 0x7FC8DE /end MEASUREMENT
/begin MEASUREMENT B_sidvet "" UWORD B_TRUE 1 100 0 1 BIT_MASK 0x400 FORMAT "%13.11" ECU_ADDRESS 0x7FC8E0 /end MEASUREMENT
/begin MEASUREMENT B_sidveu "Fehlertyp sig.: DV-E Fehler beim UMA-Lernen" UWORD B_TRUE 1 100 0 1 BIT_MASK 0x400 FORMAT "%13.11" ECU_ADDRESS 0x7FC8E2 /end MEASUREMENT
/begin MEASUREMENT B_sidveub "" UWORD B_TRUE 1 100 0 1 BIT_MASK 0x400 FORMAT "%13.11" ECU_ADDRESS 0x7FC8E4 /end MEASUREMENT
/begin MEASUREMENT B_sidveuw "" UWORD B_TRUE 1 100 0 1 BIT_MASK 0x400 FORMAT "%13.11" ECU_ADDRESS 0x7FC8E6 /end MEASUREMENT
/begin MEASUREMENT B_sidvev "Fehlertyp sig.: DV-E Fehler bei Verst‰rkerabgleich" UWORD B_TRUE 1 100 0 1 BIT_MASK 0x400 FORMAT "%13.11" ECU_ADDRESS 0x7FC8E8 /end MEASUREMENT
/begin MEASUREMENT B_sienws "Fehlerart: Leitungsabfall Nockenwellensteuerungsventil (Bank1, Einlaﬂ)" UWORD B_TRUE 1 100 0 1 BIT_MASK 0x400 FORMAT "%13.11" ECU_ADDRESS 0x7FC8F2 /end MEASUREMENT
/begin MEASUREMENT B_sienws2 "Fehlerart: Leitungsabfall Nockenwellensteuerungsventil (Bank2, Einlaﬂ)" UWORD B_TRUE 1 100 0 1 BIT_MASK 0x400 FORMAT "%13.11" ECU_ADDRESS 0x7FC8F4 /end MEASUREMENT
/begin MEASUREMENT B_siev1 "Fehlerart: Unterbrechung an Endstufe EV1" UWORD B_TRUE 1 100 0 1 BIT_MASK 0x400 FORMAT "%13.11" ECU_ADDRESS 0x7FC902 /end MEASUREMENT
/begin MEASUREMENT B_siev2 "Fehlerart: Unterbrechung an Endstufe EV2" UWORD B_TRUE 1 100 0 1 BIT_MASK 0x400 FORMAT "%13.11" ECU_ADDRESS 0x7FC904 /end MEASUREMENT
/begin MEASUREMENT B_siev3 "Fehlerart: Unterbrechung an Endstufe EV3" UWORD B_TRUE 1 100 0 1 BIT_MASK 0x400 FORMAT "%13.11" ECU_ADDRESS 0x7FC906 /end MEASUREMENT
/begin MEASUREMENT B_siev4 "Fehlerart: Unterbrechung an Endstufe EV4" UWORD B_TRUE 1 100 0 1 BIT_MASK 0x400 FORMAT "%13.11" ECU_ADDRESS 0x7FC908 /end MEASUREMENT
/begin MEASUREMENT B_siev5 "Fehlerart: Unterbrechung an Endstufe EV5" UWORD B_TRUE 1 100 0 1 BIT_MASK 0x400 FORMAT "%13.11" ECU_ADDRESS 0x7FC90A /end MEASUREMENT
/begin MEASUREMENT B_siev6 "Fehlerart: Unterbrechung an Endstufe EV6" UWORD B_TRUE 1 100 0 1 BIT_MASK 0x400 FORMAT "%13.11" ECU_ADDRESS 0x7FC90C /end MEASUREMENT
/begin MEASUREMENT B_siev7 "Fehlerart: Unterbrechung an Endstufe EV7" UWORD B_TRUE 1 100 0 1 BIT_MASK 0x400 FORMAT "%13.11" ECU_ADDRESS 0x7FC90E /end MEASUREMENT
/begin MEASUREMENT B_siev8 "Fehlerart: Unterbrechung an Endstufe EV8" UWORD B_TRUE 1 100 0 1 BIT_MASK 0x400 FORMAT "%13.11" ECU_ADDRESS 0x7FC910 /end MEASUREMENT
/begin MEASUREMENT B_siglmini "Bedingung  Signalfehler nach Initalisierung" UBYTE B_TRUE 1 100 0 1 BIT_MASK 0x2 FORMAT "%13.11" ECU_ADDRESS 0x80109F /end MEASUREMENT
/begin MEASUREMENT B_siglmn "Bedingung Signalfehler bei Drehzahlschwellen¸berschreitung" UBYTE B_TRUE 1 100 0 1 BIT_MASK 0x4 FORMAT "%13.11" ECU_ADDRESS 0x80109F /end MEASUREMENT
/begin MEASUREMENT B_sikkue "" UWORD B_TRUE 1 100 0 1 BIT_MASK 0x400 FORMAT "%13.11" ECU_ADDRESS 0x7FC946 /end MEASUREMENT
/begin MEASUREMENT B_sikpe "Bedingung f¸r Fehlertyp Leitungsabfall f¸r EKP-Relais Endstufe erkannt" UWORD B_TRUE 1 100 0 1 BIT_MASK 0x400 FORMAT "%13.11" ECU_ADDRESS 0x7FC948 /end MEASUREMENT
/begin MEASUREMENT B_silde "Fehlertyp: Leitungsabfall LDR-Taktventil" UWORD B_TRUE 1 100 0 1 BIT_MASK 0x400 FORMAT "%13.11" ECU_ADDRESS 0x7FC960 /end MEASUREMENT
/begin MEASUREMENT B_sildpe "Fehlertype: Leitungsabfall Endstufe Leckage Pumpe" UWORD B_TRUE 1 100 0 1 BIT_MASK 0x400 FORMAT "%13.11" ECU_ADDRESS 0x7FC964 /end MEASUREMENT
/begin MEASUREMENT B_siluve "Fehlerart: EV-Luftumfassungsventil Endstufe" UWORD B_TRUE 1 100 0 1 BIT_MASK 0x400 FORMAT "%13.11" ECU_ADDRESS 0x7FC988 /end MEASUREMENT
/begin MEASUREMENT B_sin "Fehlertyp: kein Drehzahlsignal vorhanden" UWORD B_TRUE 1 100 0 1 BIT_MASK 0x400 FORMAT "%13.11" ECU_ADDRESS 0x7FC9AC /end MEASUREMENT
/begin MEASUREMENT B_siswe "Fehlertyp: Geschwindigkeitssignal nicht vorhanden" UWORD B_TRUE 1 100 0 1 BIT_MASK 0x400 FORMAT "%13.11" ECU_ADDRESS 0x7FC9EE /end MEASUREMENT
/begin MEASUREMENT B_sp3 "Spezial-Bereichs-Trigger der Diagnose Kraftstoffversorgungssystem" UBYTE B_TRUE 1 100 0 1 BIT_MASK 0x1 FORMAT "%13.11" ECU_ADDRESS 0x7FC701 /end MEASUREMENT
/begin MEASUREMENT B_tddfz "Bedingung Zeitverzˆgerung TDDFZ abgelaufen" UBYTE B_TRUE 1 100 0 1 BIT_MASK 0x1 FORMAT "%13.11" ECU_ADDRESS 0x80109F /end MEASUREMENT
/begin MEASUREMENT B_tepvb "Bedingung Tankentl¸ftungsphase verboten" UBYTE B_TRUE 1 100 0 1 BIT_MASK 0x4 FORMAT "%13.11" ECU_ADDRESS 0x80056E /end MEASUREMENT
/begin MEASUREMENT B_tim "Zeit-Trigger f¸r Fehlerpfadmanagement" UBYTE B_TRUE 1 100 0 1 BIT_MASK 0x1 FORMAT "%13.11" ECU_ADDRESS 0x801167 /end MEASUREMENT
/begin MEASUREMENT B_zhfmfe "Bedingung: Fehler HFM aus DEGFE g¸ltig" UBYTE B_TRUE 1 100 0 1 BIT_MASK 0x2 FORMAT "%13.11" ECU_ADDRESS 0x80056E /end MEASUREMENT
/begin MEASUREMENT DDSSbits0 "" UBYTE dez 1 100 0 255 FORMAT "%5.1" ECU_ADDRESS 0x800570 /end MEASUREMENT
/begin MEASUREMENT DDSSintbits "" UBYTE dez 1 100 0 255 FORMAT "%5.1" ECU_ADDRESS 0x80109F /end MEASUREMENT
/begin MEASUREMENT DDSS_NVbits "" UBYTE dez 1 100 0 255 FORMAT "%5.1" ECU_ADDRESS 0x7FC317 /end MEASUREMENT
/begin MEASUREMENT DEGFEausbits "" UBYTE dez 1 100 0 255 FORMAT "%5.1" ECU_ADDRESS 0x80056E /end MEASUREMENT
/begin MEASUREMENT dfcmFcm "" UBYTE dez 1 100 0 255 FORMAT "%5.1" ECU_ADDRESS 0x7FC702 /end MEASUREMENT
/begin MEASUREMENT dfcmNo "" UBYTE dez 1 100 0 255 FORMAT "%5.1" ECU_ADDRESS 0x7FC703 /end MEASUREMENT
/begin MEASUREMENT dfcmSfp "" UBYTE dez 1 100 0 255 FORMAT "%5.1" ECU_ADDRESS 0x7FC704 /end MEASUREMENT
/begin MEASUREMENT dfpmEpclState "" UWORD dez 1 100 0 65535 FORMAT "%8.2" ECU_ADDRESS 0x7FC6FF /end MEASUREMENT
/begin MEASUREMENT dfpmMilState "" UWORD dez 1 100 0 65535 FORMAT "%8.2" ECU_ADDRESS 0x7FC6FE /end MEASUREMENT
/begin MEASUREMENT dfpnlarray "Array f¸r Fehlerpfade die im Nachlauf gesondert behandelt werden m¸ssen" UWORD dez 1 100 0 65535 FORMAT "%8.2" ARRAY_SIZE 3 ECU_ADDRESS 0x800668 /end MEASUREMENT
/begin MEASUREMENT dfpr_ACCompr2_Trq "" UBYTE dez 1 100 0 255 FORMAT "%5.1" ECU_ADDRESS 0x80128C /end MEASUREMENT
/begin MEASUREMENT dfpr_ACComp_Press "" UBYTE dez 1 100 0 255 FORMAT "%5.1" ECU_ADDRESS 0x80128D /end MEASUREMENT
/begin MEASUREMENT dfpr_ACComp_Trq "" UBYTE dez 1 100 0 255 FORMAT "%5.1" ECU_ADDRESS 0x80128E /end MEASUREMENT
/begin MEASUREMENT dfpr_AdapCrsCtrl_Par "" UBYTE dez 1 100 0 255 FORMAT "%5.1" ECU_ADDRESS 0x80128F /end MEASUREMENT
/begin MEASUREMENT dfpr_AdapCrsCtrl_Tgl "" UBYTE dez 1 100 0 255 FORMAT "%5.1" ECU_ADDRESS 0x801290 /end MEASUREMENT
/begin MEASUREMENT dfpr_AdapCrsCtrl_TrqReq "" UBYTE dez 1 100 0 255 FORMAT "%5.1" ECU_ADDRESS 0x801291 /end MEASUREMENT
/begin MEASUREMENT dfpr_AMT_EngEmOffEn "" UBYTE dez 1 100 0 255 FORMAT "%5.1" ECU_ADDRESS 0x801292 /end MEASUREMENT
/begin MEASUREMENT dfpr_AMT_EngEmOffFlt "" UBYTE dez 1 100 0 255 FORMAT "%5.1" ECU_ADDRESS 0x801293 /end MEASUREMENT
/begin MEASUREMENT dfpr_AP_Pt1HiLim "" UBYTE dez 1 100 0 255 FORMAT "%5.1" ECU_ADDRESS 0x801294 /end MEASUREMENT
/begin MEASUREMENT dfpr_AP_Pt1LoLim "" UBYTE dez 1 100 0 255 FORMAT "%5.1" ECU_ADDRESS 0x801295 /end MEASUREMENT
/begin MEASUREMENT dfpr_AP_Pt2HiLim "" UBYTE dez 1 100 0 255 FORMAT "%5.1" ECU_ADDRESS 0x801296 /end MEASUREMENT
/begin MEASUREMENT dfpr_AP_Pt2LoLim "" UBYTE dez 1 100 0 255 FORMAT "%5.1" ECU_ADDRESS 0x801297 /end MEASUREMENT
/begin MEASUREMENT dfpr_AP_PtDiff "" UBYTE dez 1 100 0 255 FORMAT "%5.1" ECU_ADDRESS 0x801298 /end MEASUREMENT
/begin MEASUREMENT dfpr_AP_PtSupp "" UBYTE dez 1 100 0 255 FORMAT "%5.1" ECU_ADDRESS 0x801299 /end MEASUREMENT
/begin MEASUREMENT dfpr_BLS_Par "" UBYTE dez 1 100 0 255 FORMAT "%5.1" ECU_ADDRESS 0x80129A /end MEASUREMENT
/begin MEASUREMENT dfpr_BLS_Tgl "" UBYTE dez 1 100 0 255 FORMAT "%5.1" ECU_ADDRESS 0x80129B /end MEASUREMENT
/begin MEASUREMENT dfpr_BLS_Undef "" UBYTE dez 1 100 0 255 FORMAT "%5.1" ECU_ADDRESS 0x80129C /end MEASUREMENT
/begin MEASUREMENT dfpr_CoolFan_SpdReq "" UBYTE dez 1 100 0 255 FORMAT "%5.1" ECU_ADDRESS 0x80129D /end MEASUREMENT
/begin MEASUREMENT dfpr_EHB_EnvCond "" UBYTE dez 1 100 0 255 FORMAT "%5.1" ECU_ADDRESS 0x80129E /end MEASUREMENT
/begin MEASUREMENT dfpr_EHB_Par "" UBYTE dez 1 100 0 255 FORMAT "%5.1" ECU_ADDRESS 0x80129F /end MEASUREMENT
/begin MEASUREMENT dfpr_EHB_Tgl "" UBYTE dez 1 100 0 255 FORMAT "%5.1" ECU_ADDRESS 0x8012A0 /end MEASUREMENT
/begin MEASUREMENT dfpr_ESP_Par "" UBYTE dez 1 100 0 255 FORMAT "%5.1" ECU_ADDRESS 0x8012A1 /end MEASUREMENT
/begin MEASUREMENT dfpr_ESP_Stat "" UBYTE dez 1 100 0 255 FORMAT "%5.1" ECU_ADDRESS 0x8012A2 /end MEASUREMENT
/begin MEASUREMENT dfpr_ESP_Tgl "" UBYTE dez 1 100 0 255 FORMAT "%5.1" ECU_ADDRESS 0x8012A3 /end MEASUREMENT
/begin MEASUREMENT dfpr_ESP_TrqReq "" UBYTE dez 1 100 0 255 FORMAT "%5.1" ECU_ADDRESS 0x8012A4 /end MEASUREMENT
/begin MEASUREMENT dfpr_TCM_Par "" UBYTE dez 1 100 0 255 FORMAT "%5.1" ECU_ADDRESS 0x8012A5 /end MEASUREMENT
/begin MEASUREMENT dfpr_TCM_Tgl "" UBYTE dez 1 100 0 255 FORMAT "%5.1" ECU_ADDRESS 0x8012A6 /end MEASUREMENT
/begin MEASUREMENT dfpr_TCM_TrqReq "" UBYTE dez 1 100 0 255 FORMAT "%5.1" ECU_ADDRESS 0x8012A7 /end MEASUREMENT
/begin MEASUREMENT dfpr_WWS_BRD "" UBYTE dez 1 100 0 255 FORMAT "%5.1" ECU_ADDRESS 0x8012A8 /end MEASUREMENT
/begin MEASUREMENT dfpr_WWS_NoPA "" UBYTE dez 1 100 0 255 FORMAT "%5.1" ECU_ADDRESS 0x8012A9 /end MEASUREMENT
/begin MEASUREMENT dfpr_WWS_PA "" UBYTE dez 1 100 0 255 FORMAT "%5.1" ECU_ADDRESS 0x8012AA /end MEASUREMENT
/begin MEASUREMENT dfp_ap "" UBYTE dez 1 100 0 255 FORMAT "%5.1" ECU_ADDRESS 0x7FC705 /end MEASUREMENT
/begin MEASUREMENT dlahi2_u "I-Anteil der stetigen LRHK Bank2 (Byte)" SBYTE fak_q4p883Em4 1 100 -0.0625 0.0620117 FORMAT "%7.5" ECU_ADDRESS 0x80111D /end MEASUREMENT
/begin MEASUREMENT dlahi_u "I-Anteil der stetigen LRHK (Byte)" SBYTE fak_q4p883Em4 1 100 -0.0625 0.0620117 FORMAT "%7.5" ECU_ADDRESS 0x80111E /end MEASUREMENT
/begin MEASUREMENT dwdktmn_w "Drosselklappengradient von delta t-n 10ms Raster" SWORD relDK_q0p02441 1 100 -200 200 FORMAT "%8.4" ECU_ADDRESS 0x8013AC /end MEASUREMENT
/begin MEASUREMENT dynlsu2_u "Dynamikwert der LSU Bank2 (Byte)" UBYTE fak_ub_b4 1 100 0 3.98438 FORMAT "%5.3" ECU_ADDRESS 0x80111F /end MEASUREMENT
/begin MEASUREMENT dynlsu_u "Dynamikwert der LSU (Byte)" UBYTE fak_ub_b4 1 100 0 3.98438 FORMAT "%5.3" ECU_ADDRESS 0x801120 /end MEASUREMENT
/begin MEASUREMENT E_anws "Errorflag: Nockenwellensteuerung (Auslaﬂ,Bank1)" UWORD B_TRUE 1 100 0 1 BIT_MASK 0x1 FORMAT "%13.11" ECU_ADDRESS 0x7FC892 /end MEASUREMENT
/begin MEASUREMENT E_anws2 "Errorflag: Nockenwellensteuerung (Auslaﬂ,Bank2)" UWORD B_TRUE 1 100 0 1 BIT_MASK 0x1 FORMAT "%13.11" ECU_ADDRESS 0x7FC894 /end MEASUREMENT
/begin MEASUREMENT E_bm "Errorflag: Bezugsmarkengeber" UWORD B_TRUE 1 100 0 1 BIT_MASK 0x1 FORMAT "%13.11" ECU_ADDRESS 0x7FC8AC /end MEASUREMENT
/begin MEASUREMENT E_can "Errorflag: CAN-Schnittstelle" UWORD B_TRUE 1 100 0 1 BIT_MASK 0x1 FORMAT "%13.11" ECU_ADDRESS 0x7FC8B0 /end MEASUREMENT
/begin MEASUREMENT E_dk "Errorflag: DK - Potentiometer" UWORD B_TRUE 1 100 0 1 BIT_MASK 0x1 FORMAT "%13.11" ECU_ADDRESS 0x7FC8C2 /end MEASUREMENT
/begin MEASUREMENT E_dk1p "Errorflag: Drosselklappe 1. Poti" UWORD B_TRUE 1 100 0 1 BIT_MASK 0x1 FORMAT "%13.11" ECU_ADDRESS 0x7FC8C4 /end MEASUREMENT
/begin MEASUREMENT E_dk2p "Errorflag: Drosselklappe 2. Poti" UWORD B_TRUE 1 100 0 1 BIT_MASK 0x1 FORMAT "%13.11" ECU_ADDRESS 0x7FC8C6 /end MEASUREMENT
/begin MEASUREMENT E_dss "Errorflag: Saugrohr-Drucksensor" UWORD B_TRUE 1 100 0 1 BIT_MASK 0x1 FORMAT "%13.11" ECU_ADDRESS 0x7FC8D0 /end MEASUREMENT
/begin MEASUREMENT E_dvee "Errorflag: DV-E Endstufe" UWORD B_TRUE 1 100 0 1 BIT_MASK 0x1 FORMAT "%13.11" ECU_ADDRESS 0x7FC8D4 /end MEASUREMENT
/begin MEASUREMENT E_dvef "Errorflag: DV-E Fehler bei Federpr¸fung" UWORD B_TRUE 1 100 0 1 BIT_MASK 0x1 FORMAT "%13.11" ECU_ADDRESS 0x7FC8D6 /end MEASUREMENT
/begin MEASUREMENT E_dvefo "Errorflag: DV-E-Fehler bei Federpr¸fung ""÷ffnen""" UWORD B_TRUE 1 100 0 1 BIT_MASK 0x1 FORMAT "%13.11" ECU_ADDRESS 0x7FC8D8 /end MEASUREMENT
/begin MEASUREMENT E_dvel "Errorflag: DV-E Lageabweichung" UWORD B_TRUE 1 100 0 1 BIT_MASK 0x1 FORMAT "%13.11" ECU_ADDRESS 0x7FC8DA /end MEASUREMENT
/begin MEASUREMENT E_dven "Errorflag: DV-E Fehler bei Pr¸fung Notluftposition" UWORD B_TRUE 1 100 0 1 BIT_MASK 0x1 FORMAT "%13.11" ECU_ADDRESS 0x7FC8DC /end MEASUREMENT
/begin MEASUREMENT E_dver "Errorflag: DV-E Regelbereich" UWORD B_TRUE 1 100 0 1 BIT_MASK 0x1 FORMAT "%13.11" ECU_ADDRESS 0x7FC8DE /end MEASUREMENT
/begin MEASUREMENT E_dvet "Errorflag: DV-E-Tauscherkennung ohne Adaption" UWORD B_TRUE 1 100 0 1 BIT_MASK 0x1 FORMAT "%13.11" ECU_ADDRESS 0x7FC8E0 /end MEASUREMENT
/begin MEASUREMENT E_dveu "Errorflag: DV-E Fehler beim UMA-Lernen" UWORD B_TRUE 1 100 0 1 BIT_MASK 0x1 FORMAT "%13.11" ECU_ADDRESS 0x7FC8E2 /end MEASUREMENT
/begin MEASUREMENT E_dveub "Errorflag: DV-E-Adaption Abbruch wg. Umweltbedingung" UWORD B_TRUE 1 100 0 1 BIT_MASK 0x1 FORMAT "%13.11" ECU_ADDRESS 0x7FC8E4 /end MEASUREMENT
/begin MEASUREMENT E_dveuw "Errorflag: Fehler bei UMA-Wiederlernen" UWORD B_TRUE 1 100 0 1 BIT_MASK 0x1 FORMAT "%13.11" ECU_ADDRESS 0x7FC8E6 /end MEASUREMENT
/begin MEASUREMENT E_dvev "Errorflag: DV-E Fehler bei Verst‰rkerabgleich" UWORD B_TRUE 1 100 0 1 BIT_MASK 0x1 FORMAT "%13.11" ECU_ADDRESS 0x7FC8E8 /end MEASUREMENT
/begin MEASUREMENT E_enws "Errorflag: Nockenwellensteuerung (Einlaﬂ,Bank1)" UWORD B_TRUE 1 100 0 1 BIT_MASK 0x1 FORMAT "%13.11" ECU_ADDRESS 0x7FC8F2 /end MEASUREMENT
/begin MEASUREMENT E_enws2 "Errorflag: Nockenwellensteuerung (Einlaﬂ,Bank2)" UWORD B_TRUE 1 100 0 1 BIT_MASK 0x1 FORMAT "%13.11" ECU_ADDRESS 0x7FC8F4 /end MEASUREMENT
/begin MEASUREMENT E_ev1 "Errorflag: EV von Zyl. 1" UWORD B_TRUE 1 100 0 1 BIT_MASK 0x1 FORMAT "%13.11" ECU_ADDRESS 0x7FC902 /end MEASUREMENT
/begin MEASUREMENT E_ev2 "Errorflag: EV von Zyl. 2" UWORD B_TRUE 1 100 0 1 BIT_MASK 0x1 FORMAT "%13.11" ECU_ADDRESS 0x7FC904 /end MEASUREMENT
/begin MEASUREMENT E_ev3 "Errorflag: EV von Zyl. 3" UWORD B_TRUE 1 100 0 1 BIT_MASK 0x1 FORMAT "%13.11" ECU_ADDRESS 0x7FC906 /end MEASUREMENT
/begin MEASUREMENT E_ev4 "Errorflag: EV von Zyl. 4" UWORD B_TRUE 1 100 0 1 BIT_MASK 0x1 FORMAT "%13.11" ECU_ADDRESS 0x7FC908 /end MEASUREMENT
/begin MEASUREMENT E_ev5 "Errorflag: EV von Zyl. 5" UWORD B_TRUE 1 100 0 1 BIT_MASK 0x1 FORMAT "%13.11" ECU_ADDRESS 0x7FC90A /end MEASUREMENT
/begin MEASUREMENT E_ev6 "Errorflag: EV von Zyl. 6" UWORD B_TRUE 1 100 0 1 BIT_MASK 0x1 FORMAT "%13.11" ECU_ADDRESS 0x7FC90C /end MEASUREMENT
/begin MEASUREMENT E_ev7 "Errorflag: EV von Zyl. 7" UWORD B_TRUE 1 100 0 1 BIT_MASK 0x1 FORMAT "%13.11" ECU_ADDRESS 0x7FC90E /end MEASUREMENT
/begin MEASUREMENT E_ev8 "Errorflag: EV von Zyl. 8" UWORD B_TRUE 1 100 0 1 BIT_MASK 0x1 FORMAT "%13.11" ECU_ADDRESS 0x7FC910 /end MEASUREMENT
/begin MEASUREMENT E_kkue "Errorflag: Kraftstoffkreislauf-Umschaltung Endstufe" UWORD B_TRUE 1 100 0 1 BIT_MASK 0x1 FORMAT "%13.11" ECU_ADDRESS 0x7FC946 /end MEASUREMENT
/begin MEASUREMENT E_kpe "Errorflag: EKP-Relais Endstufe" UWORD B_TRUE 1 100 0 1 BIT_MASK 0x1 FORMAT "%13.11" ECU_ADDRESS 0x7FC948 /end MEASUREMENT
/begin MEASUREMENT E_lde "Errorflag: Ladedrucksteuerventil (Endstufe)" UWORD B_TRUE 1 100 0 1 BIT_MASK 0x1 FORMAT "%13.11" ECU_ADDRESS 0x7FC960 /end MEASUREMENT
/begin MEASUREMENT E_ldpe "Errorflag: Leckdiagnosepumpe Endstufe" UWORD B_TRUE 1 100 0 1 BIT_MASK 0x1 FORMAT "%13.11" ECU_ADDRESS 0x7FC964 /end MEASUREMENT
/begin MEASUREMENT E_luve "Errorflag: EV-Luftumfassungsventil Endstufe" UWORD B_TRUE 1 100 0 1 BIT_MASK 0x1 FORMAT "%13.11" ECU_ADDRESS 0x7FC988 /end MEASUREMENT
/begin MEASUREMENT E_n "Errorflag: Drehzahlsignalgeber" UWORD B_TRUE 1 100 0 1 BIT_MASK 0x1 FORMAT "%13.11" ECU_ADDRESS 0x7FC9AC /end MEASUREMENT
/begin MEASUREMENT E_swe "Errorflag: Beschleunigungssensor der Schlechtwegeerkennung" UWORD B_TRUE 1 100 0 1 BIT_MASK 0x1 FORMAT "%13.11" ECU_ADDRESS 0x7FC9EE /end MEASUREMENT
/begin MEASUREMENT fcmcla_0_A "" UBYTE default 1 100 0 255 FORMAT "%5.1" ECU_ADDRESS 0x7FBFA0 /end MEASUREMENT
/begin MEASUREMENT fcmcla_1_A "" UBYTE default 1 100 0 255 FORMAT "%5.1" ECU_ADDRESS 0x7FBFC8 /end MEASUREMENT
/begin MEASUREMENT fcmcla_2_A "" UBYTE default 1 100 0 255 FORMAT "%5.1" ECU_ADDRESS 0x7FBFF0 /end MEASUREMENT
/begin MEASUREMENT fcmcla_3_A "" UBYTE default 1 100 0 255 FORMAT "%5.1" ECU_ADDRESS 0x7FC018 /end MEASUREMENT
/begin MEASUREMENT fcmcla_4_A "" UBYTE default 1 100 0 255 FORMAT "%5.1" ECU_ADDRESS 0x7FC040 /end MEASUREMENT
/begin MEASUREMENT fcmdfp_0_A "" UBYTE default 1 100 0 255 FORMAT "%5.1" ECU_ADDRESS 0x7FBF9C /end MEASUREMENT
/begin MEASUREMENT fcmdfp_1_A "" UBYTE default 1 100 0 255 FORMAT "%5.1" ECU_ADDRESS 0x7FBFC4 /end MEASUREMENT
/begin MEASUREMENT fcmdfp_2_A "" UBYTE default 1 100 0 255 FORMAT "%5.1" ECU_ADDRESS 0x7FBFEC /end MEASUREMENT
/begin MEASUREMENT fcmdfp_3_A "" UBYTE default 1 100 0 255 FORMAT "%5.1" ECU_ADDRESS 0x7FC014 /end MEASUREMENT
/begin MEASUREMENT fcmdfp_4_A "" UBYTE default 1 100 0 255 FORMAT "%5.1" ECU_ADDRESS 0x7FC03C /end MEASUREMENT
/begin MEASUREMENT fcmdlc_0_A "" UBYTE default 1 100 0 255 FORMAT "%5.1" ECU_ADDRESS 0x7FBFA4 /end MEASUREMENT
/begin MEASUREMENT fcmdlc_1_A "" UBYTE default 1 100 0 255 FORMAT "%5.1" ECU_ADDRESS 0x7FBFCC /end MEASUREMENT
/begin MEASUREMENT fcmdlc_2_A "" UBYTE default 1 100 0 255 FORMAT "%5.1" ECU_ADDRESS 0x7FBFF4 /end MEASUREMENT
/begin MEASUREMENT fcmdlc_3_A "" UBYTE default 1 100 0 255 FORMAT "%5.1" ECU_ADDRESS 0x7FC01C /end MEASUREMENT
/begin MEASUREMENT fcmdlc_4_A "" UBYTE default 1 100 0 255 FORMAT "%5.1" ECU_ADDRESS 0x7FC044 /end MEASUREMENT
/begin MEASUREMENT fcmEnd "Anzahl Eintr‰ge im Fehlerspeicher" UBYTE dez 1 100 0 255 FORMAT "%5.1" ECU_ADDRESS 0x7FC706 /end MEASUREMENT
/begin MEASUREMENT fcmfes_0_A "" UBYTE default 1 100 0 255 FORMAT "%5.1" ECU_ADDRESS 0x7FBFA1 /end MEASUREMENT
/begin MEASUREMENT fcmfes_1_A "" UBYTE default 1 100 0 255 FORMAT "%5.1" ECU_ADDRESS 0x7FBFC9 /end MEASUREMENT
/begin MEASUREMENT fcmfes_2_A "" UBYTE default 1 100 0 255 FORMAT "%5.1" ECU_ADDRESS 0x7FBFF1 /end MEASUREMENT
/begin MEASUREMENT fcmfes_3_A "" UBYTE default 1 100 0 255 FORMAT "%5.1" ECU_ADDRESS 0x7FC019 /end MEASUREMENT
/begin MEASUREMENT fcmfes_4_A "" UBYTE default 1 100 0 255 FORMAT "%5.1" ECU_ADDRESS 0x7FC041 /end MEASUREMENT
/begin MEASUREMENT fcmflc_0_A "" UBYTE default 1 100 0 255 FORMAT "%5.1" ECU_ADDRESS 0x7FBFA2 /end MEASUREMENT
/begin MEASUREMENT fcmflc_1_A "" UBYTE default 1 100 0 255 FORMAT "%5.1" ECU_ADDRESS 0x7FBFCA /end MEASUREMENT
/begin MEASUREMENT fcmflc_2_A "" UBYTE default 1 100 0 255 FORMAT "%5.1" ECU_ADDRESS 0x7FBFF2 /end MEASUREMENT
/begin MEASUREMENT fcmflc_3_A "" UBYTE default 1 100 0 255 FORMAT "%5.1" ECU_ADDRESS 0x7FC01A /end MEASUREMENT
/begin MEASUREMENT fcmflc_4_A "" UBYTE default 1 100 0 255 FORMAT "%5.1" ECU_ADDRESS 0x7FC042 /end MEASUREMENT
/begin MEASUREMENT fcmfps_0_A "" UBYTE default 1 100 0 255 FORMAT "%5.1" ECU_ADDRESS 0x7FBF9F /end MEASUREMENT
/begin MEASUREMENT fcmfps_1_A "" UBYTE default 1 100 0 255 FORMAT "%5.1" ECU_ADDRESS 0x7FBFC7 /end MEASUREMENT
/begin MEASUREMENT fcmfps_2_A "" UBYTE default 1 100 0 255 FORMAT "%5.1" ECU_ADDRESS 0x7FBFEF /end MEASUREMENT
/begin MEASUREMENT fcmfps_3_A "" UBYTE default 1 100 0 255 FORMAT "%5.1" ECU_ADDRESS 0x7FC017 /end MEASUREMENT
/begin MEASUREMENT fcmfps_4_A "" UBYTE default 1 100 0 255 FORMAT "%5.1" ECU_ADDRESS 0x7FC03F /end MEASUREMENT
/begin MEASUREMENT fcmfrz0_0_A "" UBYTE default 1 100 0 255 FORMAT "%5.1" ECU_ADDRESS 0x7FBFA5 /end MEASUREMENT
/begin MEASUREMENT fcmfrz0_1_A "" UBYTE default 1 100 0 255 FORMAT "%5.1" ECU_ADDRESS 0x7FBFCD /end MEASUREMENT
/begin MEASUREMENT fcmfrz0_2_A "" UBYTE default 1 100 0 255 FORMAT "%5.1" ECU_ADDRESS 0x7FBFF5 /end MEASUREMENT
/begin MEASUREMENT fcmfrz0_3_A "" UBYTE default 1 100 0 255 FORMAT "%5.1" ECU_ADDRESS 0x7FC01D /end MEASUREMENT
/begin MEASUREMENT fcmfrz0_4_A "" UBYTE default 1 100 0 255 FORMAT "%5.1" ECU_ADDRESS 0x7FC045 /end MEASUREMENT
/begin MEASUREMENT fcmfrz1_0_A "" UBYTE default 1 100 0 255 FORMAT "%5.1" ECU_ADDRESS 0x7FBFA6 /end MEASUREMENT
/begin MEASUREMENT fcmfrz1_1_A "" UBYTE default 1 100 0 255 FORMAT "%5.1" ECU_ADDRESS 0x7FBFCE /end MEASUREMENT
/begin MEASUREMENT fcmfrz1_2_A "" UBYTE default 1 100 0 255 FORMAT "%5.1" ECU_ADDRESS 0x7FBFF6 /end MEASUREMENT
/begin MEASUREMENT fcmfrz1_3_A "" UBYTE default 1 100 0 255 FORMAT "%5.1" ECU_ADDRESS 0x7FC01E /end MEASUREMENT
/begin MEASUREMENT fcmfrz1_4_A "" UBYTE default 1 100 0 255 FORMAT "%5.1" ECU_ADDRESS 0x7FC046 /end MEASUREMENT
/begin MEASUREMENT fcmfrz10_0_A "" UBYTE default 1 100 0 255 FORMAT "%5.1" ECU_ADDRESS 0x7FBFAF /end MEASUREMENT
/begin MEASUREMENT fcmfrz10_1_A "" UBYTE default 1 100 0 255 FORMAT "%5.1" ECU_ADDRESS 0x7FBFD7 /end MEASUREMENT
/begin MEASUREMENT fcmfrz10_2_A "" UBYTE default 1 100 0 255 FORMAT "%5.1" ECU_ADDRESS 0x7FBFFF /end MEASUREMENT
/begin MEASUREMENT fcmfrz10_3_A "" UBYTE default 1 100 0 255 FORMAT "%5.1" ECU_ADDRESS 0x7FC027 /end MEASUREMENT
/begin MEASUREMENT fcmfrz10_4_A "" UBYTE default 1 100 0 255 FORMAT "%5.1" ECU_ADDRESS 0x7FC04F /end MEASUREMENT
/begin MEASUREMENT fcmfrz2_0_A "" UBYTE default 1 100 0 255 FORMAT "%5.1" ECU_ADDRESS 0x7FBFA7 /end MEASUREMENT
/begin MEASUREMENT fcmfrz2_1_A "" UBYTE default 1 100 0 255 FORMAT "%5.1" ECU_ADDRESS 0x7FBFCF /end MEASUREMENT
/begin MEASUREMENT fcmfrz2_2_A "" UBYTE default 1 100 0 255 FORMAT "%5.1" ECU_ADDRESS 0x7FBFF7 /end MEASUREMENT
/begin MEASUREMENT fcmfrz2_3_A "" UBYTE default 1 100 0 255 FORMAT "%5.1" ECU_ADDRESS 0x7FC01F /end MEASUREMENT
/begin MEASUREMENT fcmfrz2_4_A "" UBYTE default 1 100 0 255 FORMAT "%5.1" ECU_ADDRESS 0x7FC047 /end MEASUREMENT
/begin MEASUREMENT fcmfrz3_0_A "" UBYTE default 1 100 0 255 FORMAT "%5.1" ECU_ADDRESS 0x7FBFA8 /end MEASUREMENT
/begin MEASUREMENT fcmfrz3_1_A "" UBYTE default 1 100 0 255 FORMAT "%5.1" ECU_ADDRESS 0x7FBFD0 /end MEASUREMENT
/begin MEASUREMENT fcmfrz3_2_A "" UBYTE default 1 100 0 255 FORMAT "%5.1" ECU_ADDRESS 0x7FBFF8 /end MEASUREMENT
/begin MEASUREMENT fcmfrz3_3_A "" UBYTE default 1 100 0 255 FORMAT "%5.1" ECU_ADDRESS 0x7FC020 /end MEASUREMENT
/begin MEASUREMENT fcmfrz3_4_A "" UBYTE default 1 100 0 255 FORMAT "%5.1" ECU_ADDRESS 0x7FC048 /end MEASUREMENT
/begin MEASUREMENT fcmfrz4_0_A "" UBYTE default 1 100 0 255 FORMAT "%5.1" ECU_ADDRESS 0x7FBFA9 /end MEASUREMENT
/begin MEASUREMENT fcmfrz4_1_A "" UBYTE default 1 100 0 255 FORMAT "%5.1" ECU_ADDRESS 0x7FBFD1 /end MEASUREMENT
/begin MEASUREMENT fcmfrz4_2_A "" UBYTE default 1 100 0 255 FORMAT "%5.1" ECU_ADDRESS 0x7FBFF9 /end MEASUREMENT
/begin MEASUREMENT fcmfrz4_3_A "" UBYTE default 1 100 0 255 FORMAT "%5.1" ECU_ADDRESS 0x7FC021 /end MEASUREMENT
/begin MEASUREMENT fcmfrz4_4_A "" UBYTE default 1 100 0 255 FORMAT "%5.1" ECU_ADDRESS 0x7FC049 /end MEASUREMENT
/begin MEASUREMENT fcmfrz5_0_A "" UBYTE default 1 100 0 255 FORMAT "%5.1" ECU_ADDRESS 0x7FBFAA /end MEASUREMENT
/begin MEASUREMENT fcmfrz5_1_A "" UBYTE default 1 100 0 255 FORMAT "%5.1" ECU_ADDRESS 0x7FBFD2 /end MEASUREMENT
/begin MEASUREMENT fcmfrz5_2_A "" UBYTE default 1 100 0 255 FORMAT "%5.1" ECU_ADDRESS 0x7FBFFA /end MEASUREMENT
/begin MEASUREMENT fcmfrz5_3_A "" UBYTE default 1 100 0 255 FORMAT "%5.1" ECU_ADDRESS 0x7FC022 /end MEASUREMENT
/begin MEASUREMENT fcmfrz5_4_A "" UBYTE default 1 100 0 255 FORMAT "%5.1" ECU_ADDRESS 0x7FC04A /end MEASUREMENT
/begin MEASUREMENT fcmfrz6_0_A "" UBYTE default 1 100 0 255 FORMAT "%5.1" ECU_ADDRESS 0x7FBFAB /end MEASUREMENT
/begin MEASUREMENT fcmfrz6_1_A "" UBYTE default 1 100 0 255 FORMAT "%5.1" ECU_ADDRESS 0x7FBFD3 /end MEASUREMENT
/begin MEASUREMENT fcmfrz6_2_A "" UBYTE default 1 100 0 255 FORMAT "%5.1" ECU_ADDRESS 0x7FBFFB /end MEASUREMENT
/begin MEASUREMENT fcmfrz6_3_A "" UBYTE default 1 100 0 255 FORMAT "%5.1" ECU_ADDRESS 0x7FC023 /end MEASUREMENT
/begin MEASUREMENT fcmfrz6_4_A "" UBYTE default 1 100 0 255 FORMAT "%5.1" ECU_ADDRESS 0x7FC04B /end MEASUREMENT
/begin MEASUREMENT fcmfrz7_0_A "" UBYTE default 1 100 0 255 FORMAT "%5.1" ECU_ADDRESS 0x7FBFAC /end MEASUREMENT
/begin MEASUREMENT fcmfrz7_1_A "" UBYTE default 1 100 0 255 FORMAT "%5.1" ECU_ADDRESS 0x7FBFD4 /end MEASUREMENT
/begin MEASUREMENT fcmfrz7_2_A "" UBYTE default 1 100 0 255 FORMAT "%5.1" ECU_ADDRESS 0x7FBFFC /end MEASUREMENT
/begin MEASUREMENT fcmfrz7_3_A "" UBYTE default 1 100 0 255 FORMAT "%5.1" ECU_ADDRESS 0x7FC024 /end MEASUREMENT
/begin MEASUREMENT fcmfrz7_4_A "" UBYTE default 1 100 0 255 FORMAT "%5.1" ECU_ADDRESS 0x7FC04C /end MEASUREMENT
/begin MEASUREMENT fcmfrz8_0_A "" UBYTE default 1 100 0 255 FORMAT "%5.1" ECU_ADDRESS 0x7FBFAD /end MEASUREMENT
/begin MEASUREMENT fcmfrz8_1_A "" UBYTE default 1 100 0 255 FORMAT "%5.1" ECU_ADDRESS 0x7FBFD5 /end MEASUREMENT
/begin MEASUREMENT fcmfrz8_2_A "" UBYTE default 1 100 0 255 FORMAT "%5.1" ECU_ADDRESS 0x7FBFFD /end MEASUREMENT
/begin MEASUREMENT fcmfrz8_3_A "" UBYTE default 1 100 0 255 FORMAT "%5.1" ECU_ADDRESS 0x7FC025 /end MEASUREMENT
/begin MEASUREMENT fcmfrz8_4_A "" UBYTE default 1 100 0 255 FORMAT "%5.1" ECU_ADDRESS 0x7FC04D /end MEASUREMENT
/begin MEASUREMENT fcmfrz9_0_A "" UBYTE default 1 100 0 255 FORMAT "%5.1" ECU_ADDRESS 0x7FBFAE /end MEASUREMENT
/begin MEASUREMENT fcmfrz9_1_A "" UBYTE default 1 100 0 255 FORMAT "%5.1" ECU_ADDRESS 0x7FBFD6 /end MEASUREMENT
/begin MEASUREMENT fcmfrz9_2_A "" UBYTE default 1 100 0 255 FORMAT "%5.1" ECU_ADDRESS 0x7FBFFE /end MEASUREMENT
/begin MEASUREMENT fcmfrz9_3_A "" UBYTE default 1 100 0 255 FORMAT "%5.1" ECU_ADDRESS 0x7FC026 /end MEASUREMENT
/begin MEASUREMENT fcmfrz9_4_A "" UBYTE default 1 100 0 255 FORMAT "%5.1" ECU_ADDRESS 0x7FC04E /end MEASUREMENT
/begin MEASUREMENT fcmhlc_0_A "" UBYTE default 1 100 0 255 FORMAT "%5.1" ECU_ADDRESS 0x7FBFA3 /end MEASUREMENT
/begin MEASUREMENT fcmhlc_1_A "" UBYTE default 1 100 0 255 FORMAT "%5.1" ECU_ADDRESS 0x7FBFCB /end MEASUREMENT
/begin MEASUREMENT fcmhlc_2_A "" UBYTE default 1 100 0 255 FORMAT "%5.1" ECU_ADDRESS 0x7FBFF3 /end MEASUREMENT
/begin MEASUREMENT fcmhlc_3_A "" UBYTE default 1 100 0 255 FORMAT "%5.1" ECU_ADDRESS 0x7FC01B /end MEASUREMENT
/begin MEASUREMENT fcmhlc_4_A "" UBYTE default 1 100 0 255 FORMAT "%5.1" ECU_ADDRESS 0x7FC043 /end MEASUREMENT
/begin MEASUREMENT fcmhz_0_A "" UBYTE default 1 100 0 255 FORMAT "%5.1" ECU_ADDRESS 0x7FBFC2 /end MEASUREMENT
/begin MEASUREMENT fcmhz_1_A "" UBYTE default 1 100 0 255 FORMAT "%5.1" ECU_ADDRESS 0x7FBFEA /end MEASUREMENT
/begin MEASUREMENT fcmhz_2_A "" UBYTE default 1 100 0 255 FORMAT "%5.1" ECU_ADDRESS 0x7FC012 /end MEASUREMENT
/begin MEASUREMENT fcmhz_3_A "" UBYTE default 1 100 0 255 FORMAT "%5.1" ECU_ADDRESS 0x7FC03A /end MEASUREMENT
/begin MEASUREMENT fcmhz_4_A "" UBYTE default 1 100 0 255 FORMAT "%5.1" ECU_ADDRESS 0x7FC062 /end MEASUREMENT
/begin MEASUREMENT FCMTab "" UWORD dez 1 100 0 65535 FORMAT "%8.2" ECU_ADDRESS 0x7FBF9C /end MEASUREMENT
/begin MEASUREMENT fcmtsf_0_A "" UBYTE default 1 100 0 255 FORMAT "%5.1" ECU_ADDRESS 0x7FBF9D /end MEASUREMENT
/begin MEASUREMENT fcmtsf_1_A "" UBYTE default 1 100 0 255 FORMAT "%5.1" ECU_ADDRESS 0x7FBFC5 /end MEASUREMENT
/begin MEASUREMENT fcmtsf_2_A "" UBYTE default 1 100 0 255 FORMAT "%5.1" ECU_ADDRESS 0x7FBFED /end MEASUREMENT
/begin MEASUREMENT fcmtsf_3_A "" UBYTE default 1 100 0 255 FORMAT "%5.1" ECU_ADDRESS 0x7FC015 /end MEASUREMENT
/begin MEASUREMENT fcmtsf_4_A "" UBYTE default 1 100 0 255 FORMAT "%5.1" ECU_ADDRESS 0x7FC03D /end MEASUREMENT
/begin MEASUREMENT fcmtyp_0_A "" UBYTE default 1 100 0 255 FORMAT "%5.1" ECU_ADDRESS 0x7FBF9E /end MEASUREMENT
/begin MEASUREMENT fcmtyp_1_A "" UBYTE default 1 100 0 255 FORMAT "%5.1" ECU_ADDRESS 0x7FBFC6 /end MEASUREMENT
/begin MEASUREMENT fcmtyp_2_A "" UBYTE default 1 100 0 255 FORMAT "%5.1" ECU_ADDRESS 0x7FBFEE /end MEASUREMENT
/begin MEASUREMENT fcmtyp_3_A "" UBYTE default 1 100 0 255 FORMAT "%5.1" ECU_ADDRESS 0x7FC016 /end MEASUREMENT
/begin MEASUREMENT fcmtyp_4_A "" UBYTE default 1 100 0 255 FORMAT "%5.1" ECU_ADDRESS 0x7FC03E /end MEASUREMENT
/begin MEASUREMENT fr2_u "Lambda-Regler-Ausgang; Bank2 (Byte)" UBYTE fak_ub_b2 1 100 0 1.99219 FORMAT "%5.3" ECU_ADDRESS 0x801121 /end MEASUREMENT
/begin MEASUREMENT fra2_u "multiplikative Gemischkorrektur der Gemischadaption (Byte)" UBYTE fak_ub_b2 1 100 0 1.99219 FORMAT "%5.3" ECU_ADDRESS 0x801122 /end MEASUREMENT
/begin MEASUREMENT frau2_u "multipl. Gemischadaptionsfaktor unterer mult. Bereich der Bank 2 (Byte)" UBYTE fak_ub_b2 1 100 0 1.99219 FORMAT "%5.3" ECU_ADDRESS 0x801123 /end MEASUREMENT
/begin MEASUREMENT frau_u "multiplikativer Gemischadaptionsfaktor unterer mult. Bereich (Byte)" UBYTE fak_ub_b2 1 100 0 1.99219 FORMAT "%5.3" ECU_ADDRESS 0x801124 /end MEASUREMENT
/begin MEASUREMENT fra_u "multiplikative Gemischkorrektur der Gemischadaption (Byte)" UBYTE fak_ub_b2 1 100 0 1.99219 FORMAT "%5.3" ECU_ADDRESS 0x801125 /end MEASUREMENT
/begin MEASUREMENT frhol_u "Umweltwert: Faktor Luftdichte f(Ansauglufttemp., Hˆhe) 8-Bit" UBYTE fak_ub_b2 1 100 0 1.99219 FORMAT "%5.3" ECU_ADDRESS 0x801126 /end MEASUREMENT
/begin MEASUREMENT frm2_u "schneller Mittelwert des Lambdaregelfaktors Bank 2 (1 Byte f¸r Tester)" UBYTE fak_ub_b2 1 100 0 1.99219 FORMAT "%5.3" ECU_ADDRESS 0x801127 /end MEASUREMENT
/begin MEASUREMENT frm_u "schneller Mittelwert des Lambdaregelfaktors ( 1 Byte f¸r Tester )" UBYTE fak_ub_b2 1 100 0 1.99219 FORMAT "%5.3" ECU_ADDRESS 0x801128 /end MEASUREMENT
/begin MEASUREMENT fr_u "Lambda-Regler-Ausgang (Byte)" UBYTE fak_ub_b2 1 100 0 1.99219 FORMAT "%5.3" ECU_ADDRESS 0x801129 /end MEASUREMENT
/begin MEASUREMENT igod_u "Integratorgradient f¸r Nulltest-Diagnose Klopfregelung (1 Byte f¸r Tester)" SBYTE spgg_sb_b3052 1 100 -3052.01 3028.16 FORMAT "%5.0" ECU_ADDRESS 0x80112A /end MEASUREMENT
/begin MEASUREMENT igokr_u "Integratorgradient f¸r Offsetkorrektur Klopfregelung (Byte)" SBYTE spgg_sb_b3052 1 100 -3052.01 3028.16 FORMAT "%5.0" ECU_ADDRESS 0x80112B /end MEASUREMENT
/begin MEASUREMENT kpe_error "Fehlerstatus aus Error Trace Buffer" UBYTE dez 1 100 0 255 FORMAT "%5.1" ECU_ADDRESS 0x8011D7 /end MEASUREMENT
/begin MEASUREMENT kusvk2_u "Korrekturwert der LSU-Spannung vor Kat Bank2 (Byte)" SBYTE spg_sw_q0p00488 1 100 -0.625 0.620117 ECU_ADDRESS 0x80112C /end MEASUREMENT
/begin MEASUREMENT kusvk_u "Korrekturwert der LSU-Spannung vor Kat (Byte)" SBYTE spg_sw_q0p00488 1 100 -0.625 0.620117 ECU_ADDRESS 0x80112D /end MEASUREMENT
/begin MEASUREMENT ladiff2_u "Regelabweichung Lambda;Bank2  (Byte)" SBYTE fak_q0p00195 1 100 -0.25 0.248047 ECU_ADDRESS 0x80112E /end MEASUREMENT
/begin MEASUREMENT ladiff_u "Regelabweichung Lambda (Byte)" SBYTE fak_q0p00195 1 100 -0.25 0.248047 ECU_ADDRESS 0x80112F /end MEASUREMENT
/begin MEASUREMENT lamsam2_u "Lambdaamplitude nach Filterung Bank 2  (Byte)" SBYTE fak_q0p00195 1 100 -0.25 0.248047 ECU_ADDRESS 0x801130 /end MEASUREMENT
/begin MEASUREMENT lamsam_u "Lambdaamplitude nach Filterung  (Byte)" SBYTE fak_q0p00195 1 100 -0.25 0.248047 ECU_ADDRESS 0x801131 /end MEASUREMENT
/begin MEASUREMENT lamsoni2_u "Lambda-Istwert Bank2 (Byte)" UBYTE fak_q0p0625 1 100 0 15.9375 FORMAT "%5.2" ECU_ADDRESS 0x801132 /end MEASUREMENT
/begin MEASUREMENT lamsoni_u "Lambda-Istwert (Byte)" UBYTE fak_q0p0625 1 100 0 15.9375 FORMAT "%5.2" ECU_ADDRESS 0x801133 /end MEASUREMENT
/begin MEASUREMENT lamsons2_u "Lambda-Sollwert bezogen auf Einbauort Lambda-Sensor Bank2 (1 Byte f¸r Tester)" UBYTE fak_ub_b16 1 100 0 15.9375 FORMAT "%5.2" ECU_ADDRESS 0x801134 /end MEASUREMENT
/begin MEASUREMENT lamsons_u "Lambda-Sollwert bezogen auf Einbauort Lambda-Sensor (1 Byte f¸r Tester)" UBYTE fak_ub_b16 1 100 0 15.9375 FORMAT "%5.2" ECU_ADDRESS 0x801135 /end MEASUREMENT
/begin MEASUREMENT palsu2_u "Absolutdruck Abgassystem 2   (Byte)" UBYTE p_ub_q10 1 100 0 2550 FORMAT "%5.0" ECU_ADDRESS 0x801136 /end MEASUREMENT
/begin MEASUREMENT palsu_u "Absolutdruck Abgassystem  (Byte)" UBYTE p_ub_q10 1 100 0 2550 FORMAT "%5.0" ECU_ADDRESS 0x801137 /end MEASUREMENT
/begin MEASUREMENT pdkagrds_w "Korrigierter AGR-Partialdruck f¸r Saugrohrdruckdiagnose" UWORD p_uw_q0p039 1 100 0 2559.96 FORMAT "%8.3" ECU_ADDRESS 0x8013AE /end MEASUREMENT
/begin MEASUREMENT psdmn_w "Kennfeldausgangswert f¸r minimale Druckplausibilit‰t" UWORD p_uw_q0p039 1 100 0 2559.96 FORMAT "%8.3" ECU_ADDRESS 0x8013B0 /end MEASUREMENT
/begin MEASUREMENT psdmxvg_w "maximale Druckplausibilit‰t incl. AGR-Partialdruck" UWORD p_uw_q0p039 1 100 0 2559.96 FORMAT "%8.3" ECU_ADDRESS 0x8013B2 /end MEASUREMENT
/begin MEASUREMENT psdmx_w "Kennfeldausgangswert f¸r maximale Druckplausibilit‰t" UWORD p_uw_q0p039 1 100 0 2559.96 FORMAT "%8.3" ECU_ADDRESS 0x8013B4 /end MEASUREMENT
/begin MEASUREMENT psdsst20_w "Saugrohrdruck psdss umkopiert ins 20ms Raster" UWORD p_uw_q0p039 1 100 0 2559.96 FORMAT "%8.3" ECU_ADDRESS 0x8013B6 /end MEASUREMENT
/begin MEASUREMENT psini_w "Saugrohrdruck bei nmot=0" UWORD p_uw_q0p039 1 100 0 2559.96 FORMAT "%8.3" ECU_ADDRESS 0x800572 /end MEASUREMENT
/begin MEASUREMENT rinh2_u "Istwert (Byte) Innenwiderstand Ri-Nernstzelle der Lambdasonde hinter KAT Bank2" UBYTE r_ub_q64 1 100 0 16320 FORMAT "%5.0" ECU_ADDRESS 0x801138 /end MEASUREMENT
/begin MEASUREMENT rinh_u "Istwert (Byte) Innenwiderstand Ri-Nernstzelle der Lambdasonde hinter KAT" UBYTE r_ub_q64 1 100 0 16320 FORMAT "%5.0" ECU_ADDRESS 0x801139 /end MEASUREMENT
/begin MEASUREMENT rinv2_u "Istwert (Byte) Innenwiderstand Ri-Nernstzelle der Lambdasonde vor KAT Bank2" UBYTE r_ub_q64 1 100 0 16320 FORMAT "%5.0" ECU_ADDRESS 0x80113A /end MEASUREMENT
/begin MEASUREMENT rinv_u "Istwert (Byte) Innenwiderstand Ri-Nernstzelle der Lambdasonde vor KAT" UBYTE r_ub_q64 1 100 0 16320 FORMAT "%5.0" ECU_ADDRESS 0x80113B /end MEASUREMENT
/begin MEASUREMENT rkrn_u "" UBYTE spg_q0p625 1 100 0 159.375 FORMAT "%5.1" ARRAY_SIZE 8 ECU_ADDRESS 0x80113C /end MEASUREMENT
/begin MEASUREMENT rl_u "relative Luftf¸llung (Byte) f¸r Fehlerspeicher-Umwelten" UBYTE rel_ub_b100 1 100 0 99.6094 FORMAT "%5.2" ECU_ADDRESS 0x801144 /end MEASUREMENT
/begin MEASUREMENT sfpaaa "Status Fehlerpfad: Tabellenanfang" UWORD dez 1 100 0 65535 FORMAT "%8.2" ECU_ADDRESS 0x7FC87C /end MEASUREMENT
/begin MEASUREMENT sfpaccompr2_trq "" UWORD default 1 100 0 65535 FORMAT "%8.2" ECU_ADDRESS 0x7FC87E /end MEASUREMENT
/begin MEASUREMENT sfpaccomp_press "" UWORD default 1 100 0 65535 FORMAT "%8.2" ECU_ADDRESS 0x7FC880 /end MEASUREMENT
/begin MEASUREMENT sfpaccomp_trq "" UWORD default 1 100 0 65535 FORMAT "%8.2" ECU_ADDRESS 0x7FC882 /end MEASUREMENT
/begin MEASUREMENT sfpadapcrsctrl_par "" UWORD default 1 100 0 65535 FORMAT "%8.2" ECU_ADDRESS 0x7FC884 /end MEASUREMENT
/begin MEASUREMENT sfpadapcrsctrl_tgl "" UWORD default 1 100 0 65535 FORMAT "%8.2" ECU_ADDRESS 0x7FC886 /end MEASUREMENT
/begin MEASUREMENT sfpadapcrsctrl_trqreq "" UWORD default 1 100 0 65535 FORMAT "%8.2" ECU_ADDRESS 0x7FC888 /end MEASUREMENT
/begin MEASUREMENT sfpamt_engemoffen "" UWORD default 1 100 0 65535 FORMAT "%8.2" ECU_ADDRESS 0x7FC88E /end MEASUREMENT
/begin MEASUREMENT sfpamt_engemofffl "" UWORD default 1 100 0 65535 FORMAT "%8.2" ECU_ADDRESS 0x7FC890 /end MEASUREMENT
/begin MEASUREMENT sfpanws "Status Fehlerpfad: Nockenwellensteuerung (Auslaﬂ, Bank1)" UWORD dez 1 100 0 65535 FORMAT "%8.2" ECU_ADDRESS 0x7FC892 /end MEASUREMENT
/begin MEASUREMENT sfpanws2 "Status Fehlerpfad: Nockenwellensteuerung (Auslaﬂ, Bank2)" UWORD dez 1 100 0 65535 FORMAT "%8.2" ECU_ADDRESS 0x7FC894 /end MEASUREMENT
/begin MEASUREMENT sfpap_pt1hilim "" UWORD default 1 100 0 65535 FORMAT "%8.2" ECU_ADDRESS 0x7FC89A /end MEASUREMENT
/begin MEASUREMENT sfpap_pt1lolim "" UWORD default 1 100 0 65535 FORMAT "%8.2" ECU_ADDRESS 0x7FC89C /end MEASUREMENT
/begin MEASUREMENT sfpap_pt2hilim "" UWORD default 1 100 0 65535 FORMAT "%8.2" ECU_ADDRESS 0x7FC89E /end MEASUREMENT
/begin MEASUREMENT sfpap_pt2lolim "" UWORD default 1 100 0 65535 FORMAT "%8.2" ECU_ADDRESS 0x7FC8A0 /end MEASUREMENT
/begin MEASUREMENT sfpap_ptdiff "" UWORD default 1 100 0 65535 FORMAT "%8.2" ECU_ADDRESS 0x7FC8A2 /end MEASUREMENT
/begin MEASUREMENT sfpap_ptsupp "" UWORD default 1 100 0 65535 FORMAT "%8.2" ECU_ADDRESS 0x7FC8A4 /end MEASUREMENT
/begin MEASUREMENT sfpbls_par "" UWORD default 1 100 0 65535 FORMAT "%8.2" ECU_ADDRESS 0x7FC8A6 /end MEASUREMENT
/begin MEASUREMENT sfpbls_tgl "" UWORD default 1 100 0 65535 FORMAT "%8.2" ECU_ADDRESS 0x7FC8A8 /end MEASUREMENT
/begin MEASUREMENT sfpbls_undef "" UWORD default 1 100 0 65535 FORMAT "%8.2" ECU_ADDRESS 0x7FC8AA /end MEASUREMENT
/begin MEASUREMENT sfpbm "Status Fehlerpfad: Bezugsmarkengeber" UWORD dez 1 100 0 65535 FORMAT "%8.2" ECU_ADDRESS 0x7FC8AC /end MEASUREMENT
/begin MEASUREMENT sfpcan "Status Fehlerpfad: CAN Fehler" UWORD dez 1 100 0 65535 FORMAT "%8.2" ECU_ADDRESS 0x7FC8B0 /end MEASUREMENT
/begin MEASUREMENT sfpcoolfan_spdreq "" UWORD default 1 100 0 65535 FORMAT "%8.2" ECU_ADDRESS 0x7FC8BC /end MEASUREMENT
/begin MEASUREMENT sfpdk "Status Fehlerpfad DK: Drosselklappe" UWORD dez 1 100 0 65535 FORMAT "%8.2" ECU_ADDRESS 0x7FC8C2 /end MEASUREMENT
/begin MEASUREMENT sfpdk1p "Status Fehlerpfad DK1P: Drosselklappe 1. Poti" UWORD dez 1 100 0 65535 FORMAT "%8.2" ECU_ADDRESS 0x7FC8C4 /end MEASUREMENT
/begin MEASUREMENT sfpdk2p "Status Fehlerpfad DK2P: Drosselklappe 2. Poti" UWORD dez 1 100 0 65535 FORMAT "%8.2" ECU_ADDRESS 0x7FC8C6 /end MEASUREMENT
/begin MEASUREMENT sfpdss "Status Fehlerpfad: DSS" UWORD default 1 100 0 65535 FORMAT "%8.2" ECU_ADDRESS 0x7FC8D0 /end MEASUREMENT
/begin MEASUREMENT sfpdvee "Statuswort: DV-E Endstufe" UWORD dez 1 100 0 65535 FORMAT "%8.2" ECU_ADDRESS 0x7FC8D4 /end MEASUREMENT
/begin MEASUREMENT sfpdvef "Statuswort: DV-E Fehler bei Federpr¸fung" UWORD dez 1 100 0 65535 FORMAT "%8.2" ECU_ADDRESS 0x7FC8D6 /end MEASUREMENT
/begin MEASUREMENT sfpdvefo "Status Fehlerpfad: DV-E-Fehler bei Federpr¸fung ""÷ffnen""" UWORD dez 1 100 0 65535 FORMAT "%8.2" ECU_ADDRESS 0x7FC8D8 /end MEASUREMENT
/begin MEASUREMENT sfpdvel "Statuswort: DV-E Lageabweichung" UWORD dez 1 100 0 65535 FORMAT "%8.2" ECU_ADDRESS 0x7FC8DA /end MEASUREMENT
/begin MEASUREMENT sfpdven "Statuswort: DV-E Fehler bei Pr¸fung Notluftposition" UWORD dez 1 100 0 65535 FORMAT "%8.2" ECU_ADDRESS 0x7FC8DC /end MEASUREMENT
/begin MEASUREMENT sfpdver "Statuswort: DV-E Regelbereich" UWORD dez 1 100 0 65535 FORMAT "%8.2" ECU_ADDRESS 0x7FC8DE /end MEASUREMENT
/begin MEASUREMENT sfpdvet "Status Fehlerpfad: DV-E-Tauchserkennung ohne Adaption" UWORD dez 1 100 0 65535 FORMAT "%8.2" ECU_ADDRESS 0x7FC8E0 /end MEASUREMENT
/begin MEASUREMENT sfpdveu "Statuswort: DV-E Fehler beim UMA-Lernen" UWORD dez 1 100 0 65535 FORMAT "%8.2" ECU_ADDRESS 0x7FC8E2 /end MEASUREMENT
/begin MEASUREMENT sfpdveub "Status Fehlerpfad: DV-E-Adaption Abbruch wg. Umweltbedingung" UWORD dez 1 100 0 65535 FORMAT "%8.2" ECU_ADDRESS 0x7FC8E4 /end MEASUREMENT
/begin MEASUREMENT sfpdveuw "Status Fehlerpfad: UMA-Wiederlernen" UWORD dez 1 100 0 65535 FORMAT "%8.2" ECU_ADDRESS 0x7FC8E6 /end MEASUREMENT
/begin MEASUREMENT sfpdvev "Statuswort: DV-E Fehler bei Verst‰rkerabgleich" UWORD dez 1 100 0 65535 FORMAT "%8.2" ECU_ADDRESS 0x7FC8E8 /end MEASUREMENT
/begin MEASUREMENT sfpenws "Status Fehlerpfad: Nockenwellensteuerung (Einlaﬂ, Bank1)" UWORD dez 1 100 0 65535 FORMAT "%8.2" ECU_ADDRESS 0x7FC8F2 /end MEASUREMENT
/begin MEASUREMENT sfpenws2 "Status Fehlerpfad: Nockenwellensteuerung (Einlaﬂ, Bank2)" UWORD dez 1 100 0 65535 FORMAT "%8.2" ECU_ADDRESS 0x7FC8F4 /end MEASUREMENT
/begin MEASUREMENT sfpev1 "Status Fehlerpfad: EV1" UWORD default 1 100 0 65535 FORMAT "%8.2" ECU_ADDRESS 0x7FC902 /end MEASUREMENT
/begin MEASUREMENT sfpev2 "Status Fehlerpfad: EV2" UWORD default 1 100 0 65535 FORMAT "%8.2" ECU_ADDRESS 0x7FC904 /end MEASUREMENT
/begin MEASUREMENT sfpev3 "Status Fehlerpfad: EV3" UWORD default 1 100 0 65535 FORMAT "%8.2" ECU_ADDRESS 0x7FC906 /end MEASUREMENT
/begin MEASUREMENT sfpev4 "Status Fehlerpfad: EV4" UWORD default 1 100 0 65535 FORMAT "%8.2" ECU_ADDRESS 0x7FC908 /end MEASUREMENT
/begin MEASUREMENT sfpev5 "Status Fehlerpfad: EV5" UWORD default 1 100 0 65535 FORMAT "%8.2" ECU_ADDRESS 0x7FC90A /end MEASUREMENT
/begin MEASUREMENT sfpev6 "Status Fehlerpfad: EV6" UWORD default 1 100 0 65535 FORMAT "%8.2" ECU_ADDRESS 0x7FC90C /end MEASUREMENT
/begin MEASUREMENT sfpev7 "Status Fehlerpfad: EV7" UWORD default 1 100 0 65535 FORMAT "%8.2" ECU_ADDRESS 0x7FC90E /end MEASUREMENT
/begin MEASUREMENT sfpev8 "Status Fehlerpfad: EV8" UWORD default 1 100 0 65535 FORMAT "%8.2" ECU_ADDRESS 0x7FC910 /end MEASUREMENT
/begin MEASUREMENT sfpkkue "" UWORD default 1 100 0 65535 FORMAT "%8.2" ECU_ADDRESS 0x7FC946 /end MEASUREMENT
/begin MEASUREMENT sfpkpe "Status Fehlerpfad: EKP-Relais Endstufe" UWORD default 1 100 0 65535 FORMAT "%8.2" ECU_ADDRESS 0x7FC948 /end MEASUREMENT
/begin MEASUREMENT sfplde "Status Fehlerpfad: Ladedrucksteuerventil Endstufe" UWORD default 1 100 0 65535 FORMAT "%8.2" ECU_ADDRESS 0x7FC960 /end MEASUREMENT
/begin MEASUREMENT sfpldpe "Status Fehlerpfad: Leckdiagnosepumpe - Endstufe" UWORD default 1 100 0 65535 FORMAT "%8.2" ECU_ADDRESS 0x7FC964 /end MEASUREMENT
/begin MEASUREMENT sfpluve "Status Fehlerpfad: EV-Luftumfassungsventil Endstufe" UWORD default 1 100 0 65535 FORMAT "%8.2" ECU_ADDRESS 0x7FC988 /end MEASUREMENT
/begin MEASUREMENT sfpn "Status Fehlerpfad: Drehzahlgeber" UWORD dez 1 100 0 65535 FORMAT "%8.2" ECU_ADDRESS 0x7FC9AC /end MEASUREMENT
/begin MEASUREMENT sfpswe "Status Fehlerpfad: Schlechtwegerkennung" UWORD dez 1 100 0 65535 FORMAT "%8.2" ECU_ADDRESS 0x7FC9EE /end MEASUREMENT
/begin MEASUREMENT sfpzzz "Dummy: Tabellenende" UWORD dez 1 100 0 65535 FORMAT "%8.2" ECU_ADDRESS 0x7FCA2C /end MEASUREMENT
/begin MEASUREMENT tabst_u "Abstellzeit (Byte)" UBYTE t_q256 1 100 0 65280 FORMAT "%5.0" ECU_ADDRESS 0x801145 /end MEASUREMENT
/begin MEASUREMENT tmot_u "Motor-Temperatur mit def. Quantisierung f¸r FSP-Umwelten" UBYTE temp_ub_q1_o40 1 100 -40 215 FORMAT "%5.1" ECU_ADDRESS 0x801146 /end MEASUREMENT
/begin MEASUREMENT tnse_u "Zeit nach Startende Byte" UBYTE t25p6sxs_ub_b6528 1 100 0 6528 FORMAT "%5.0" ECU_ADDRESS 0x801147 /end MEASUREMENT
/begin MEASUREMENT tpsvkmf2_u "gefilterter Periodendauerwert des Sondensignals vor Kat, Bank2 (Byte)" UBYTE t10msxs_ub_b10p2 1 100 0 10.2 FORMAT "%5.2" ECU_ADDRESS 0x801148 /end MEASUREMENT
/begin MEASUREMENT tpsvkmf_u "gefilterter Periodendauerwert des Sondensignals vor Kat. (Byte)" UBYTE t10msxs_ub_b10p2 1 100 0 10.2 FORMAT "%5.2" ECU_ADDRESS 0x801149 /end MEASUREMENT
/begin MEASUREMENT TYP_anws "" UWORD B_TRUE 1 100 0 1 BIT_MASK 0xf00 FORMAT "%13.11" ECU_ADDRESS 0x7FC892 /end MEASUREMENT
/begin MEASUREMENT TYP_anws2 "" UWORD B_TRUE 1 100 0 1 BIT_MASK 0xf00 FORMAT "%13.11" ECU_ADDRESS 0x7FC894 /end MEASUREMENT
/begin MEASUREMENT TYP_bm "" UWORD B_TRUE 1 100 0 1 BIT_MASK 0xf00 FORMAT "%13.11" ECU_ADDRESS 0x7FC8AC /end MEASUREMENT
/begin MEASUREMENT TYP_can "" UWORD B_TRUE 1 100 0 1 BIT_MASK 0xf00 FORMAT "%13.11" ECU_ADDRESS 0x7FC8B0 /end MEASUREMENT
/begin MEASUREMENT TYP_dk "" UWORD B_TRUE 1 100 0 1 BIT_MASK 0xf00 FORMAT "%13.11" ECU_ADDRESS 0x7FC8C2 /end MEASUREMENT
/begin MEASUREMENT TYP_dk1p "" UWORD B_TRUE 1 100 0 1 BIT_MASK 0xf00 FORMAT "%13.11" ECU_ADDRESS 0x7FC8C4 /end MEASUREMENT
/begin MEASUREMENT TYP_dk2p "" UWORD B_TRUE 1 100 0 1 BIT_MASK 0xf00 FORMAT "%13.11" ECU_ADDRESS 0x7FC8C6 /end MEASUREMENT
/begin MEASUREMENT TYP_dss "" UWORD B_TRUE 1 100 0 1 BIT_MASK 0xf00 FORMAT "%13.11" ECU_ADDRESS 0x7FC8D0 /end MEASUREMENT
/begin MEASUREMENT TYP_dvee "Fehlertyp: DV-E Endstufe" UWORD B_TRUE 1 100 0 1 BIT_MASK 0xf00 FORMAT "%13.11" ECU_ADDRESS 0x7FC8D4 /end MEASUREMENT
/begin MEASUREMENT TYP_dvef "Fehlertyp: DV-E Fehler bei Federpr¸fung" UWORD B_TRUE 1 100 0 1 BIT_MASK 0xf00 FORMAT "%13.11" ECU_ADDRESS 0x7FC8D6 /end MEASUREMENT
/begin MEASUREMENT TYP_dvefo "" UWORD B_TRUE 1 100 0 1 BIT_MASK 0xf00 FORMAT "%13.11" ECU_ADDRESS 0x7FC8D8 /end MEASUREMENT
/begin MEASUREMENT TYP_dvel "Fehlertyp: DV-E Lageabweichung" UWORD B_TRUE 1 100 0 1 BIT_MASK 0xf00 FORMAT "%13.11" ECU_ADDRESS 0x7FC8DA /end MEASUREMENT
/begin MEASUREMENT TYP_dven "Fehlertyp: DV-E Fehler bei Pr¸fung Notluftposition" UWORD B_TRUE 1 100 0 1 BIT_MASK 0xf00 FORMAT "%13.11" ECU_ADDRESS 0x7FC8DC /end MEASUREMENT
/begin MEASUREMENT TYP_dver "Fehlertyp: DV-E Regelbereich" UWORD B_TRUE 1 100 0 1 BIT_MASK 0xf00 FORMAT "%13.11" ECU_ADDRESS 0x7FC8DE /end MEASUREMENT
/begin MEASUREMENT TYP_dvet "" UWORD B_TRUE 1 100 0 1 BIT_MASK 0xf00 FORMAT "%13.11" ECU_ADDRESS 0x7FC8E0 /end MEASUREMENT
/begin MEASUREMENT TYP_dveu "Fehlertyp: DV-E Fehler beim UMA-Lernen" UWORD B_TRUE 1 100 0 1 BIT_MASK 0xf00 FORMAT "%13.11" ECU_ADDRESS 0x7FC8E2 /end MEASUREMENT
/begin MEASUREMENT TYP_dveub "" UWORD B_TRUE 1 100 0 1 BIT_MASK 0xf00 FORMAT "%13.11" ECU_ADDRESS 0x7FC8E4 /end MEASUREMENT
/begin MEASUREMENT TYP_dveuw "" UWORD B_TRUE 1 100 0 1 BIT_MASK 0xf00 FORMAT "%13.11" ECU_ADDRESS 0x7FC8E6 /end MEASUREMENT
/begin MEASUREMENT TYP_dvev "Fehlertyp: DV-E Fehler bei Verst‰rkerabgleich" UWORD B_TRUE 1 100 0 1 BIT_MASK 0xf00 FORMAT "%13.11" ECU_ADDRESS 0x7FC8E8 /end MEASUREMENT
/begin MEASUREMENT TYP_enws "" UWORD B_TRUE 1 100 0 1 BIT_MASK 0xf00 FORMAT "%13.11" ECU_ADDRESS 0x7FC8F2 /end MEASUREMENT
/begin MEASUREMENT TYP_enws2 "" UWORD B_TRUE 1 100 0 1 BIT_MASK 0xf00 FORMAT "%13.11" ECU_ADDRESS 0x7FC8F4 /end MEASUREMENT
/begin MEASUREMENT TYP_ev1 "" UWORD B_TRUE 1 100 0 1 BIT_MASK 0xf00 FORMAT "%13.11" ECU_ADDRESS 0x7FC902 /end MEASUREMENT
/begin MEASUREMENT TYP_ev2 "" UWORD B_TRUE 1 100 0 1 BIT_MASK 0xf00 FORMAT "%13.11" ECU_ADDRESS 0x7FC904 /end MEASUREMENT
/begin MEASUREMENT TYP_ev3 "" UWORD B_TRUE 1 100 0 1 BIT_MASK 0xf00 FORMAT "%13.11" ECU_ADDRESS 0x7FC906 /end MEASUREMENT
/begin MEASUREMENT TYP_ev4 "" UWORD B_TRUE 1 100 0 1 BIT_MASK 0xf00 FORMAT "%13.11" ECU_ADDRESS 0x7FC908 /end MEASUREMENT
/begin MEASUREMENT TYP_ev5 "" UWORD B_TRUE 1 100 0 1 BIT_MASK 0xf00 FORMAT "%13.11" ECU_ADDRESS 0x7FC90A /end MEASUREMENT
/begin MEASUREMENT TYP_ev6 "" UWORD B_TRUE 1 100 0 1 BIT_MASK 0xf00 FORMAT "%13.11" ECU_ADDRESS 0x7FC90C /end MEASUREMENT
/begin MEASUREMENT TYP_ev7 "" UWORD B_TRUE 1 100 0 1 BIT_MASK 0xf00 FORMAT "%13.11" ECU_ADDRESS 0x7FC90E /end MEASUREMENT
/begin MEASUREMENT TYP_ev8 "" UWORD B_TRUE 1 100 0 1 BIT_MASK 0xf00 FORMAT "%13.11" ECU_ADDRESS 0x7FC910 /end MEASUREMENT
/begin MEASUREMENT TYP_kkue "" UWORD B_TRUE 1 100 0 1 BIT_MASK 0xf00 FORMAT "%13.11" ECU_ADDRESS 0x7FC946 /end MEASUREMENT
/begin MEASUREMENT TYP_kpe "Fehlertyp: EKP-Relais Endstufe" UWORD B_TRUE 1 100 0 1 BIT_MASK 0xf00 FORMAT "%13.11" ECU_ADDRESS 0x7FC948 /end MEASUREMENT
/begin MEASUREMENT TYP_lde "" UWORD B_TRUE 1 100 0 1 BIT_MASK 0xf00 FORMAT "%13.11" ECU_ADDRESS 0x7FC960 /end MEASUREMENT
/begin MEASUREMENT TYP_ldpe "" UWORD B_TRUE 1 100 0 1 BIT_MASK 0xf00 FORMAT "%13.11" ECU_ADDRESS 0x7FC964 /end MEASUREMENT
/begin MEASUREMENT TYP_luve "" UWORD B_TRUE 1 100 0 1 BIT_MASK 0xf00 FORMAT "%13.11" ECU_ADDRESS 0x7FC988 /end MEASUREMENT
/begin MEASUREMENT TYP_n "" UWORD B_TRUE 1 100 0 1 BIT_MASK 0xf00 FORMAT "%13.11" ECU_ADDRESS 0x7FC9AC /end MEASUREMENT
/begin MEASUREMENT TYP_swe "" UWORD B_TRUE 1 100 0 1 BIT_MASK 0xf00 FORMAT "%13.11" ECU_ADDRESS 0x7FC9EE /end MEASUREMENT
/begin MEASUREMENT udkp1a_u "Spannung Drosselklappen-Poti 1 am (unteren) Anschlag (Byte)" UBYTE spg_ub_b5 1 100 0 4.98047 FORMAT "%5.3" ECU_ADDRESS 0x80114A /end MEASUREMENT
/begin MEASUREMENT udkp1_u "Spannung Drosselklappen-Poti 1 (Byte)" UBYTE spg_ub_b5 1 100 0 4.98047 FORMAT "%5.3" ECU_ADDRESS 0x80114B /end MEASUREMENT
/begin MEASUREMENT udkp2_u "Spannung Drosselklappen-Poti 2 (Byte)" UBYTE spg_ub_b5 1 100 0 4.98047 FORMAT "%5.3" ECU_ADDRESS 0x80114C /end MEASUREMENT
/begin MEASUREMENT upwg1_u "Spannung PWG-Poti 1 (Byte)" UBYTE spg_ub_b5 1 100 0 4.98047 FORMAT "%5.3" ECU_ADDRESS 0x80114D /end MEASUREMENT
/begin MEASUREMENT upwg2d_u "Verdoppelte PWG-Poti-2-Spannung (Byte)" UBYTE spg_ub_b5 1 100 0 4.98047 FORMAT "%5.3" ECU_ADDRESS 0x80114E /end MEASUREMENT
/begin MEASUREMENT upwg2_u "Spannung PWG-Poti 2 (Byte)" UBYTE spg_ub_b5 1 100 0 4.98047 FORMAT "%5.3" ECU_ADDRESS 0x80114F /end MEASUREMENT
/begin MEASUREMENT usvkk2_u "LSU-Spannung vor Kat, korrigiert Bank2 (Byte)" UBYTE spg_ub_b5 1 100 0 4.98047 FORMAT "%5.3" ECU_ADDRESS 0x801150 /end MEASUREMENT
/begin MEASUREMENT usvkk_u "LSU-Spannung vor Kat, korrigiert (Byte)" UBYTE spg_ub_b5 1 100 0 4.98047 FORMAT "%5.3" ECU_ADDRESS 0x801151 /end MEASUREMENT
/begin MEASUREMENT uulsuf2_u "gefilterte Sondenspannung vor Kat einer Breitbandlambdasonde Bank2  (Byte)" UBYTE spg_ub_b5 1 100 0 4.98047 FORMAT "%5.3" ECU_ADDRESS 0x801152 /end MEASUREMENT
/begin MEASUREMENT uulsuf_u "gefilterte Sondenspannung vor Kat einer Breitbandlambdasonde (Byte)" UBYTE spg_ub_b5 1 100 0 4.98047 FORMAT "%5.3" ECU_ADDRESS 0x801153 /end MEASUREMENT
/begin MEASUREMENT uulsuv2_u "Sondenspannung vor Kat einer Breitbandlambdasonde Bank2 (ADC-Wert) (Byte)" UBYTE spg_ub_b5 1 100 0 4.98047 FORMAT "%5.3" ECU_ADDRESS 0x801154 /end MEASUREMENT
/begin MEASUREMENT uulsuv_u "Sondenspannung vor Kat einer Breitbandlambdasonde (ADC-Wert) (Byte)" UBYTE spg_ub_b5 1 100 0 4.98047 FORMAT "%5.3" ECU_ADDRESS 0x801155 /end MEASUREMENT
/begin MEASUREMENT uushk2_u "ADC-Spannung Lambdasonde hinter Katalysator Bank2 (Byte)" UBYTE spg_ub_b5 1 100 0 4.98047 FORMAT "%5.3" ECU_ADDRESS 0x801156 /end MEASUREMENT
/begin MEASUREMENT uushk_u "ADC-Spannung Lambdasonde hinter Katalysator (Byte)" UBYTE spg_ub_b5 1 100 0 4.98047 FORMAT "%5.3" ECU_ADDRESS 0x801157 /end MEASUREMENT
/begin MEASUREMENT uusvk2_u "ADC-Spannung Lambdasonde vor Katalysator 2 (Byte)" UBYTE spg_ub_b5 1 100 0 4.98047 FORMAT "%5.3" ECU_ADDRESS 0x801158 /end MEASUREMENT
/begin MEASUREMENT uusvk_u "ADC-Spannung Lambdasonde vor Katalysator (Byte)" UBYTE spg_ub_b5 1 100 0 4.98047 FORMAT "%5.3" ECU_ADDRESS 0x801159 /end MEASUREMENT
/begin MEASUREMENT vfzg_u "Fahrzeuggeschwindigkeit, mit def. Quantisierung f¸r Tester" UBYTE vfzg_q1p0 1 100 0 255 FORMAT "%5.1" ECU_ADDRESS 0x80115A /end MEASUREMENT
/begin MEASUREMENT wdkfmn_w "Minimalwert Drosselklappenwinkel von min Auswahl" SWORD relDK_q0p02441 1 100 -200 200 FORMAT "%8.4" ECU_ADDRESS 0x8013B8 /end MEASUREMENT
/begin MEASUREMENT wdkfmx_w "Maximalwert Drosselklappenwinkel von max Auswahl" SWORD relDK_q0p02441 1 100 -200 200 FORMAT "%8.4" ECU_ADDRESS 0x8013BA /end MEASUREMENT
/begin MEASUREMENT wdknlpr_u "" UBYTE relDK_ub_b100 1 100 0 100 FORMAT "%5.1" ECU_ADDRESS 0x80115B /end MEASUREMENT
/begin MEASUREMENT wdknlp_u "DK-Winkel der Notluftposition (byte)" UBYTE relDK_ub_b100 1 100 0 100 FORMAT "%5.1" ECU_ADDRESS 0x80115C /end MEASUREMENT
/begin MEASUREMENT wnwi1_u "" SBYTE wkw_sb_b128 1 100 -128 127 FORMAT "%2.0" ECU_ADDRESS 0x80115D /end MEASUREMENT
/begin MEASUREMENT wnwi2_u "Istwinkel f¸r Nockenwelle 2 (Byte)" SBYTE wkw_sb_b128 1 100 -128 127 FORMAT "%2.0" ECU_ADDRESS 0x80115E /end MEASUREMENT
/begin MEASUREMENT Z_anws "Zyklusflag: Nockenwellensteuerung (Auslaﬂ,Bank1)" UWORD B_TRUE 1 100 0 1 BIT_MASK 0x2 FORMAT "%13.11" ECU_ADDRESS 0x7FC892 /end MEASUREMENT
/begin MEASUREMENT Z_anws2 "Zyklusflag: Nockenwellensteuerung (Auslaﬂ,Bank2)" UWORD B_TRUE 1 100 0 1 BIT_MASK 0x2 FORMAT "%13.11" ECU_ADDRESS 0x7FC894 /end MEASUREMENT
/begin MEASUREMENT Z_bm "Zyklusflag: Bezugsmarkengeber" UWORD B_TRUE 1 100 0 1 BIT_MASK 0x2 FORMAT "%13.11" ECU_ADDRESS 0x7FC8AC /end MEASUREMENT
/begin MEASUREMENT Z_can "Zyklusflag: CAN Zustand" UWORD B_TRUE 1 100 0 1 BIT_MASK 0x2 FORMAT "%13.11" ECU_ADDRESS 0x7FC8B0 /end MEASUREMENT
/begin MEASUREMENT Z_dk "Zyklusflag:	DK - Potentiometer" UWORD B_TRUE 1 100 0 1 BIT_MASK 0x2 FORMAT "%13.11" ECU_ADDRESS 0x7FC8C2 /end MEASUREMENT
/begin MEASUREMENT Z_dk1p "Zyklusflag: Drosselklappe 1. Poti" UWORD B_TRUE 1 100 0 1 BIT_MASK 0x2 FORMAT "%13.11" ECU_ADDRESS 0x7FC8C4 /end MEASUREMENT
/begin MEASUREMENT Z_dk2p "Zyklusflag: Drosselklappe 2. Poti" UWORD B_TRUE 1 100 0 1 BIT_MASK 0x2 FORMAT "%13.11" ECU_ADDRESS 0x7FC8C6 /end MEASUREMENT
/begin MEASUREMENT Z_dss "Zyklusflag: Saugrohr-Drucksensor" UWORD B_TRUE 1 100 0 1 BIT_MASK 0x2 FORMAT "%13.11" ECU_ADDRESS 0x7FC8D0 /end MEASUREMENT
/begin MEASUREMENT Z_dvee "Zyklusflag: DV-E Endstufe" UWORD B_TRUE 1 100 0 1 BIT_MASK 0x2 FORMAT "%13.11" ECU_ADDRESS 0x7FC8D4 /end MEASUREMENT
/begin MEASUREMENT Z_dvef "Zyklusflag: DV-E Fehler bei Federpr¸fung" UWORD B_TRUE 1 100 0 1 BIT_MASK 0x2 FORMAT "%13.11" ECU_ADDRESS 0x7FC8D6 /end MEASUREMENT
/begin MEASUREMENT Z_dvefo "Zyklusflag: DV-E-Fehler bei Federpr¸fung ""÷ffnen""" UWORD B_TRUE 1 100 0 1 BIT_MASK 0x2 FORMAT "%13.11" ECU_ADDRESS 0x7FC8D8 /end MEASUREMENT
/begin MEASUREMENT Z_dvel "Zyklusflag: DV-E Lageabweichung" UWORD B_TRUE 1 100 0 1 BIT_MASK 0x2 FORMAT "%13.11" ECU_ADDRESS 0x7FC8DA /end MEASUREMENT
/begin MEASUREMENT Z_dven "Zyklusflag: DV-E Fehler bei Pr¸fung Notluftposition" UWORD B_TRUE 1 100 0 1 BIT_MASK 0x2 FORMAT "%13.11" ECU_ADDRESS 0x7FC8DC /end MEASUREMENT
/begin MEASUREMENT Z_dver "Zyklusflag: DV-E Regelbereich" UWORD B_TRUE 1 100 0 1 BIT_MASK 0x2 FORMAT "%13.11" ECU_ADDRESS 0x7FC8DE /end MEASUREMENT
/begin MEASUREMENT Z_dvet "Zyklusflag: DV-E-Tauscherkennung ohne Adaption" UWORD B_TRUE 1 100 0 1 BIT_MASK 0x2 FORMAT "%13.11" ECU_ADDRESS 0x7FC8E0 /end MEASUREMENT
/begin MEASUREMENT Z_dveu "Zyklusflag: DV-E Fehler beim UMA-Lernen" UWORD B_TRUE 1 100 0 1 BIT_MASK 0x2 FORMAT "%13.11" ECU_ADDRESS 0x7FC8E2 /end MEASUREMENT
/begin MEASUREMENT Z_dveub "Zyklusflag: DV-E-Adaption Abbruch wg. Umweltbedingung" UWORD B_TRUE 1 100 0 1 BIT_MASK 0x2 FORMAT "%13.11" ECU_ADDRESS 0x7FC8E4 /end MEASUREMENT
/begin MEASUREMENT Z_dveuw "Zyklusflag: Fehler bei UMA-Wiederlernen" UWORD B_TRUE 1 100 0 1 BIT_MASK 0x2 FORMAT "%13.11" ECU_ADDRESS 0x7FC8E6 /end MEASUREMENT
/begin MEASUREMENT Z_dvev "Zyklusflag: DV-E Fehler bei Verst‰rkerabgleich" UWORD B_TRUE 1 100 0 1 BIT_MASK 0x2 FORMAT "%13.11" ECU_ADDRESS 0x7FC8E8 /end MEASUREMENT
/begin MEASUREMENT Z_enws "Zyklusflag: Nockenwellensteuerung (Einlaﬂ,Bank1)" UWORD B_TRUE 1 100 0 1 BIT_MASK 0x2 FORMAT "%13.11" ECU_ADDRESS 0x7FC8F2 /end MEASUREMENT
/begin MEASUREMENT Z_enws2 "Zyklusflag: Nockenwellensteuerung (Einlaﬂ,Bank2)" UWORD B_TRUE 1 100 0 1 BIT_MASK 0x2 FORMAT "%13.11" ECU_ADDRESS 0x7FC8F4 /end MEASUREMENT
/begin MEASUREMENT Z_ev1 "Zyklusflag: EV von Zyl. 1" UWORD B_TRUE 1 100 0 1 BIT_MASK 0x2 FORMAT "%13.11" ECU_ADDRESS 0x7FC902 /end MEASUREMENT
/begin MEASUREMENT Z_ev2 "Zyklusflag:	EV von Zyl. 2" UWORD B_TRUE 1 100 0 1 BIT_MASK 0x2 FORMAT "%13.11" ECU_ADDRESS 0x7FC904 /end MEASUREMENT
/begin MEASUREMENT Z_ev3 "Zyklusflag:	EV von Zyl. 3" UWORD B_TRUE 1 100 0 1 BIT_MASK 0x2 FORMAT "%13.11" ECU_ADDRESS 0x7FC906 /end MEASUREMENT
/begin MEASUREMENT Z_ev4 "Zyklusflag:	EV von Zyl. 4" UWORD B_TRUE 1 100 0 1 BIT_MASK 0x2 FORMAT "%13.11" ECU_ADDRESS 0x7FC908 /end MEASUREMENT
/begin MEASUREMENT Z_ev5 "Zyklusflag:	EV von Zyl. 5" UWORD B_TRUE 1 100 0 1 BIT_MASK 0x2 FORMAT "%13.11" ECU_ADDRESS 0x7FC90A /end MEASUREMENT
/begin MEASUREMENT Z_ev6 "Zyklusflag:	EV von Zyl. 6" UWORD B_TRUE 1 100 0 1 BIT_MASK 0x2 FORMAT "%13.11" ECU_ADDRESS 0x7FC90C /end MEASUREMENT
/begin MEASUREMENT Z_ev7 "Zyklusflag:	EV von Zyl. 7" UWORD B_TRUE 1 100 0 1 BIT_MASK 0x2 FORMAT "%13.11" ECU_ADDRESS 0x7FC90E /end MEASUREMENT
/begin MEASUREMENT Z_ev8 "Zyklusflag:	EV von Zyl. 8" UWORD B_TRUE 1 100 0 1 BIT_MASK 0x2 FORMAT "%13.11" ECU_ADDRESS 0x7FC910 /end MEASUREMENT
/begin MEASUREMENT Z_kkue "Zyklusflag: Kraftstoffkreislauf-Umschaltung Endstufe" UWORD B_TRUE 1 100 0 1 BIT_MASK 0x2 FORMAT "%13.11" ECU_ADDRESS 0x7FC946 /end MEASUREMENT
/begin MEASUREMENT Z_kpe "Zyklusflag: EKP-Relais Endstufe" UWORD B_TRUE 1 100 0 1 BIT_MASK 0x2 FORMAT "%13.11" ECU_ADDRESS 0x7FC948 /end MEASUREMENT
/begin MEASUREMENT Z_lde "Zyklusflag: Ladedrucksteuerventil (Endstufe)" UWORD B_TRUE 1 100 0 1 BIT_MASK 0x2 FORMAT "%13.11" ECU_ADDRESS 0x7FC960 /end MEASUREMENT
/begin MEASUREMENT Z_ldpe "Zyklusflag: Leckdiagnosepumpe Endstufe" UWORD B_TRUE 1 100 0 1 BIT_MASK 0x2 FORMAT "%13.11" ECU_ADDRESS 0x7FC964 /end MEASUREMENT
/begin MEASUREMENT Z_luve "Zyklusflag: EV-Luftumfassungsventil Endstufe" UWORD B_TRUE 1 100 0 1 BIT_MASK 0x2 FORMAT "%13.11" ECU_ADDRESS 0x7FC988 /end MEASUREMENT
/begin MEASUREMENT Z_n "Zyklusflag: Drehzahlsignalgeber" UWORD B_TRUE 1 100 0 1 BIT_MASK 0x2 FORMAT "%13.11" ECU_ADDRESS 0x7FC9AC /end MEASUREMENT
/begin MEASUREMENT Z_swe "Zyklusflag: Beschleunigungssensor der Schlechtwegeerkennung" UWORD B_TRUE 1 100 0 1 BIT_MASK 0x2 FORMAT "%13.11" ECU_ADDRESS 0x7FC9EE /end MEASUREMENT
/begin FUNCTION DDSS "Diagnose; Drucksensor im  Saugrohr"
 /begin DEF_CHARACTERISTIC ANZTMN DKGFILS DPDDF FPDAGRDSS KFPSDMN KFPSDMX NDDFA NDSMNR NDSMXR PSHYSHL PSINIPL TDDF TDDFZ UADPSMN UADPSMX WDKBAST WDSMNR WDSMXR ZWDKBA /end DEF_CHARACTERISTIC
 /begin REF_CHARACTERISTIC /end REF_CHARACTERISTIC
 /begin IN_MEASUREMENT B_agr B_cdedss B_dsseg B_edks B_ll B_nmot B_sa B_stend B_wst nmot_w psdssi_w udsm_w wdkba_w /end IN_MEASUREMENT
 /begin OUT_MEASUREMENT B_dssg B_edss B_erelrmax B_erelrmin B_errpllm B_headsslm B_mndsslm B_mxdsslm B_npldsslm B_resmaxpl B_resminpl B_sidsslm B_siglmini B_siglmn B_tddfz DDSSbits0 DDSSintbits DDSS_NVbits /end OUT_MEASUREMENT
 /begin LOC_MEASUREMENT dwdktmn_w pdkagrds_w psdmn_w psdmxvg_w psdmx_w psdsst20_w psini_w wdkfmn_w wdkfmx_w /end LOC_MEASUREMENT
 /begin SUB_FUNCTION /end SUB_FUNCTION
/end FUNCTION
/begin FUNCTION DDVE "Diagnose: EGAS-Steller DV-E" /begin DEF_CHARACTERISTIC TPNSE /end DEF_CHARACTERISTIC /begin REF_CHARACTERISTIC /end REF_CHARACTERISTIC
 /begin IN_MEASUREMENT B_abgle B_dkaden B_dkp1e B_dkp1mn B_dkp1mx B_dkp1np B_dkp2e B_dkp2mn B_dkp2mx B_dkp2np B_dlrbe B_dlrpide B_dveese B_fproab B_fproe B_fprook B_fprordy B_fprovb B_fprrdy B_fprzab B_fprze B_fprzvb B_lrnakt B_lrnerf B_lrnrdy B_lrnvb B_lrnws B_nlpe B_nlperf B_nlpnew B_pwf B_stend B_umae B_umauab B_wdksive dveadchst fprstep_c lrnstep_c /end IN_MEASUREMENT
 /begin OUT_MEASUREMENT /end OUT_MEASUREMENT
 /begin LOC_MEASUREMENT /end LOC_MEASUREMENT
 /begin SUB_FUNCTION /end SUB_FUNCTION
/end FUNCTION
/begin FUNCTION DECJ "Diagnose; Endstufe CJ4x/9x" /begin DEF_CHARACTERISTIC NDECJ UBCJMN UBCJMX /end DEF_CHARACTERISTIC /begin REF_CHARACTERISTIC /end REF_CHARACTERISTIC /begin IN_MEASUREMENT nmot ub /end IN_MEASUREMENT /begin OUT_MEASUREMENT B_desee /end OUT_MEASUREMENT /begin LOC_MEASUREMENT /end LOC_MEASUREMENT /begin SUB_FUNCTION /end SUB_FUNCTION /end FUNCTION
/begin FUNCTION DEGFE "Diagnose der Eingangsgrˆﬂen F¸llungserfassung" /begin DEF_CHARACTERISTIC CWDEGFE TDEGFEMN TDEGFEMX TDEGFENO TDEGFEST /end DEF_CHARACTERISTIC /begin REF_CHARACTERISTIC /end REF_CHARACTERISTIC /begin IN_MEASUREMENT B_fkmsmn B_fkmsmx B_fkpvmn B_fkpvmx B_stend /end IN_MEASUREMENT /begin OUT_MEASUREMENT B_ehfmfe B_tepvb B_zhfmfe DEGFEausbits /end OUT_MEASUREMENT /begin LOC_MEASUREMENT /end LOC_MEASUREMENT /begin SUB_FUNCTION /end SUB_FUNCTION /end FUNCTION
/begin FUNCTION DEKPE "Diagnose; Elektrokraftstoffpumpe Endstufe" /begin DEF_CHARACTERISTIC CWPSKPE EKPFA EKPPA /end DEF_CHARACTERISTIC /begin REF_CHARACTERISTIC /end REF_CHARACTERISTIC /begin IN_MEASUREMENT B_desee /end IN_MEASUREMENT /begin OUT_MEASUREMENT kpe_error /end OUT_MEASUREMENT /begin LOC_MEASUREMENT /end LOC_MEASUREMENT /begin SUB_FUNCTION /end SUB_FUNCTION /end FUNCTION
/begin FUNCTION DEPCL "Diagnose; Elektronik Powertrain Control Lampe" /begin DEF_CHARACTERISTIC TEPCL TEPCLI /end DEF_CHARACTERISTIC /begin REF_CHARACTERISTIC /end REF_CHARACTERISTIC /begin IN_MEASUREMENT B_bt B_bteepcl B_btepcl B_nmot dfpmEpclState /end IN_MEASUREMENT /begin OUT_MEASUREMENT B_epcl /end OUT_MEASUREMENT /begin LOC_MEASUREMENT B_epclloc /end LOC_MEASUREMENT /begin SUB_FUNCTION /end SUB_FUNCTION /end FUNCTION
/begin FUNCTION DEVE "Diagnose; Einspritzventil - Endstufe" /begin DEF_CHARACTERISTIC CWPSEV TDEVE /end DEF_CHARACTERISTIC /begin REF_CHARACTERISTIC /end REF_CHARACTERISTIC /begin IN_MEASUREMENT B_desee B_sa B_stend evz_austot /end IN_MEASUREMENT /begin OUT_MEASUREMENT B_eev /end OUT_MEASUREMENT /begin LOC_MEASUREMENT /end LOC_MEASUREMENT /begin SUB_FUNCTION /end SUB_FUNCTION /end FUNCTION
/begin FUNCTION DFFT "Diagnose; Freeze Frame Auswahltabelle" /begin DEF_CHARACTERISTIC /end DEF_CHARACTERISTIC /begin REF_CHARACTERISTIC /end REF_CHARACTERISTIC
 /begin IN_MEASUREMENT egaspfad flglrs flglrs2 fr2_u fra2_u fra_u fr_u gangi mizuvfil mi_duf mi_um ml mpfad nmot psdss_u pu rinh2_u rinh_u rinv2_u rinv_u rl rl_u rstpfad skapfad tabgm tabgm2 tans tfst tkatm tkatm2 tmew tmot tmotlin tmot_u tmrw tpsvkmf2_u tpsvkmf_u tumg ub udkp1_u udkp2_u uhsh uhsh2 uhsv uhsv2 upwg1_u upwg2d_u upwg2_u ushk ushk2 usvk usvk2 vfzg_u wdkba wdks wped /end IN_MEASUREMENT
 /begin OUT_MEASUREMENT /end OUT_MEASUREMENT
 /begin LOC_MEASUREMENT /end LOC_MEASUREMENT
 /begin SUB_FUNCTION /end SUB_FUNCTION
/end FUNCTION
/begin FUNCTION DFFTCNV "Diagnose; Freeze Frame Tabelle, Konvertierung zu Bytes" /begin DEF_CHARACTERISTIC /end DEF_CHARACTERISTIC /begin REF_CHARACTERISTIC NMAX /end REF_CHARACTERISTIC
 /begin IN_MEASUREMENT dlahi2_w dlahi_w dynlsu2_w dynlsu_w fr2_w fra2_w frau2_w frau_w fra_w frhol_w frm2_w frm_w fr_w igod_w igokr_w kusvk2_w kusvk_w ladiff2_w ladiff_w lamsam2_w lamsam_w lamsoni2_w lamsoni_w lamsons2_w lamsons_w nmot_w palsu2_w palsu_w rinh2_w rinh_w rinv2_w rinv_w rkrn_w rlugd_w rl_w tabst_w tmotlin tnse_w tpsvkmf2_w tpsvkmf_w udkp1a_w udkp1_w udkp2_w udsu_w uhfm_w upwg1_w upwg2d_w upwg2_w usvkk2_w usvkk_w uulsuf2_w uulsuf_w uulsuv2_w uulsuv_w uushk2_w uushk_w uusvk2_w uusvk_w vfzg wdknlpr_w wdknlp_w wnwi_w wtans wtka wtmot /end IN_MEASUREMENT
 /begin OUT_MEASUREMENT addsu_u adhfm_u adta_u adtka_u adtm_u dlahi2_u dlahi_u dynlsu2_u dynlsu_u fr2_u fra2_u frau2_u frau_u fra_u frhol_u frm2_u frm_u fr_u igod_u igokr_u kusvk2_u kusvk_u ladiff2_u ladiff_u lamsam2_u lamsam_u lamsoni2_u lamsoni_u lamsons2_u lamsons_u palsu2_u palsu_u rinh2_u rinh_u rinv2_u rinv_u rkrn_u rl_u tabst_u tmot_u tnse_u tpsvkmf2_u tpsvkmf_u udkp1a_u udkp1_u udkp2_u upwg1_u upwg2d_u upwg2_u usvkk2_u usvkk_u uulsuf2_u uulsuf_u uulsuv2_u uulsuv_u uushk2_u uushk_u uusvk2_u uusvk_u vfzg_u wdknlpr_u wdknlp_u wnwi1_u wnwi2_u /end OUT_MEASUREMENT
 /begin LOC_MEASUREMENT /end LOC_MEASUREMENT
 /begin SUB_FUNCTION /end SUB_FUNCTION
/end FUNCTION
/begin FUNCTION DFFTK "Diagnose; Kundenspezifische Auswahlliste f¸r Freeze Frame-Werte" /begin DEF_CHARACTERISTIC /end DEF_CHARACTERISTIC /begin REF_CHARACTERISTIC /end REF_CHARACTERISTIC
 /begin IN_MEASUREMENT addsu_u adhfm_u adta_u adtka_u adtm_u ahkat ahkat2 dlahi2_u dlahi_u dynlsu2_u dynlsu_u flgtiab frau2_u frau_u frhol_u frm2_u frm_u igod_u igokr_u kusvk2_u kusvk_u ladiff2_u ladiff_u lamsam2_u lamsam_u lamsoni2_u lamsoni_u lamsons2_u lamsons_u lsunpstat lsunpstat2 msabg msabg2 nmot palsu2_u palsu_u phlsnh phlsnh2 rkrn_u tabst_u talsuf talsuf2 taml tanwrhf tkatmf tkatmf2 tmst tnse_u u5ref1 u5ref2 udkp1a_u usvkk2_u usvkk_u uulsuf2_u uulsuf_u uulsuv2_u uulsuv_u uushk2_u uushk_u uusvk2_u uusvk_u vfzg2 wdknlpr_u wdknlp_u wnwi1_u wnwi2_u /end IN_MEASUREMENT
 /begin OUT_MEASUREMENT /end OUT_MEASUREMENT
 /begin LOC_MEASUREMENT /end LOC_MEASUREMENT
 /begin SUB_FUNCTION /end SUB_FUNCTION
/end FUNCTION
/begin FUNCTION dfpdc "" /begin DEF_CHARACTERISTIC /end DEF_CHARACTERISTIC /begin REF_CHARACTERISTIC /end REF_CHARACTERISTIC /begin IN_MEASUREMENT /end IN_MEASUREMENT
 /begin OUT_MEASUREMENT dfpr_ACCompr2_Trq dfpr_ACComp_Press dfpr_ACComp_Trq dfpr_AdapCrsCtrl_Par dfpr_AdapCrsCtrl_Tgl dfpr_AdapCrsCtrl_TrqReq dfpr_AMT_EngEmOffEn dfpr_AMT_EngEmOffFlt dfpr_AP_Pt1HiLim dfpr_AP_Pt1LoLim dfpr_AP_Pt2HiLim dfpr_AP_Pt2LoLim dfpr_AP_PtDiff dfpr_AP_PtSupp dfpr_BLS_Par dfpr_BLS_Tgl dfpr_BLS_Undef dfpr_CoolFan_SpdReq dfpr_EHB_EnvCond dfpr_EHB_Par dfpr_EHB_Tgl dfpr_ESP_Par dfpr_ESP_Stat dfpr_ESP_Tgl dfpr_ESP_TrqReq dfpr_TCM_Par dfpr_TCM_Tgl dfpr_TCM_TrqReq dfpr_WWS_BRD dfpr_WWS_NoPA dfpr_WWS_PA /end OUT_MEASUREMENT
 /begin LOC_MEASUREMENT /end LOC_MEASUREMENT
 /begin SUB_FUNCTION /end SUB_FUNCTION
/end FUNCTION
/begin FUNCTION DFPM "OBDII; Fehlerpfadmanager" /begin DEF_CHARACTERISTIC /end DEF_CHARACTERISTIC /begin REF_CHARACTERISTIC /end REF_CHARACTERISTIC
 /begin IN_MEASUREMENT bbwuc B_pwf egaspfad mi_duf mpfad nmot rstpfad skapfad tans tmot tmotlin top_w ushk ushk2 usvk usvk2 vfzg /end IN_MEASUREMENT
 /begin OUT_MEASUREMENT bbno bbsp3 bbtim B_no B_sp3 B_tim dfcmFcm dfcmNo dfcmSfp dfpmEpclState dfpmMilState dfp_ap fcmcla_0_A fcmcla_1_A fcmcla_2_A fcmcla_3_A fcmcla_4_A fcmdfp_0_A fcmdfp_1_A fcmdfp_2_A fcmdfp_3_A fcmdfp_4_A fcmdlc_0_A fcmdlc_1_A fcmdlc_2_A fcmdlc_3_A fcmdlc_4_A fcmEnd fcmfes_0_A fcmfes_1_A fcmfes_2_A fcmfes_3_A fcmfes_4_A fcmflc_0_A fcmflc_1_A fcmflc_2_A fcmflc_3_A fcmflc_4_A fcmfps_0_A fcmfps_1_A fcmfps_2_A fcmfps_3_A fcmfps_4_A fcmfrz0_0_A fcmfrz0_1_A fcmfrz0_2_A fcmfrz0_3_A fcmfrz0_4_A fcmfrz1_0_A fcmfrz1_1_A fcmfrz1_2_A fcmfrz1_3_A fcmfrz1_4_A fcmfrz10_0_A fcmfrz10_1_A fcmfrz10_2_A fcmfrz10_3_A fcmfrz10_4_A fcmfrz2_0_A fcmfrz2_1_A fcmfrz2_2_A fcmfrz2_3_A fcmfrz2_4_A fcmfrz3_0_A fcmfrz3_1_A fcmfrz3_2_A fcmfrz3_3_A fcmfrz3_4_A fcmfrz4_0_A fcmfrz4_1_A fcmfrz4_2_A fcmfrz4_3_A fcmfrz4_4_A fcmfrz5_0_A fcmfrz5_1_A fcmfrz5_2_A fcmfrz5_3_A fcmfrz5_4_A fcmfrz6_0_A fcmfrz6_1_A fcmfrz6_2_A fcmfrz6_3_A fcmfrz6_4_A fcmfrz7_0_A fcmfrz7_1_A fcmfrz7_2_A fcmfrz7_3_A fcmfrz7_4_A fcmfrz8_0_A fcmfrz8_1_A fcmfrz8_2_A fcmfrz8_3_A fcmfrz8_4_A fcmfrz9_0_A fcmfrz9_1_A fcmfrz9_2_A fcmfrz9_3_A fcmfrz9_4_A fcmhlc_0_A fcmhlc_1_A fcmhlc_2_A fcmhlc_3_A fcmhlc_4_A fcmhz_0_A fcmhz_1_A fcmhz_2_A fcmhz_3_A fcmhz_4_A FCMTab fcmtsf_0_A fcmtsf_1_A fcmtsf_2_A fcmtsf_3_A fcmtsf_4_A fcmtyp_0_A fcmtyp_1_A fcmtyp_2_A fcmtyp_3_A fcmtyp_4_A /end OUT_MEASUREMENT
 /begin LOC_MEASUREMENT /end LOC_MEASUREMENT
 /begin SUB_FUNCTION /end SUB_FUNCTION
/end FUNCTION
/begin FUNCTION DFPMNL "Diagnose Fehlerpfadmanagement im Nachlauf" /begin DEF_CHARACTERISTIC /end DEF_CHARACTERISTIC /begin REF_CHARACTERISTIC /end REF_CHARACTERISTIC /begin IN_MEASUREMENT B_nldte B_nlobd fcmEnd /end IN_MEASUREMENT /begin OUT_MEASUREMENT dfpnlarray /end OUT_MEASUREMENT /begin LOC_MEASUREMENT /end LOC_MEASUREMENT /begin SUB_FUNCTION /end SUB_FUNCTION /end FUNCTION
/begin FUNCTION DFPMOVF "Diagnose Fehlerpfadmanagement, Memory Overflow" /begin DEF_CHARACTERISTIC /end DEF_CHARACTERISTIC /begin REF_CHARACTERISTIC /end REF_CHARACTERISTIC /begin IN_MEASUREMENT fcmEnd /end IN_MEASUREMENT /begin OUT_MEASUREMENT /end OUT_MEASUREMENT /begin LOC_MEASUREMENT /end LOC_MEASUREMENT /begin SUB_FUNCTION /end SUB_FUNCTION /end FUNCTION
/begin FUNCTION DFPM_ACCompr2_Trq ""
 /begin DEF_CHARACTERISTIC CDCACCompr2_Trq CDKACCompr2_Trq CDTACCompr2_Trq CLAACCompr2_Trq FFTACCompr2_Trq TSFACCompr2_Trq /end DEF_CHARACTERISTIC
 /begin REF_CHARACTERISTIC /end REF_CHARACTERISTIC
 /begin IN_MEASUREMENT /end IN_MEASUREMENT
 /begin OUT_MEASUREMENT sfpaccompr2_trq /end OUT_MEASUREMENT
 /begin LOC_MEASUREMENT /end LOC_MEASUREMENT
 /begin SUB_FUNCTION /end SUB_FUNCTION
/end FUNCTION
/begin FUNCTION DFPM_ACComp_Press ""
 /begin DEF_CHARACTERISTIC CDCACComp_Press CDKACComp_Press CDTACComp_Press CLAACComp_Press FFTACComp_Press TSFACComp_Press /end DEF_CHARACTERISTIC
 /begin REF_CHARACTERISTIC /end REF_CHARACTERISTIC
 /begin IN_MEASUREMENT /end IN_MEASUREMENT
 /begin OUT_MEASUREMENT sfpaccomp_press /end OUT_MEASUREMENT
 /begin LOC_MEASUREMENT /end LOC_MEASUREMENT
 /begin SUB_FUNCTION /end SUB_FUNCTION
/end FUNCTION
/begin FUNCTION DFPM_ACComp_Trq ""
 /begin DEF_CHARACTERISTIC CDCACComp_Trq CDKACComp_Trq CDTACComp_Trq CLAACComp_Trq FFTACComp_Trq TSFACComp_Trq /end DEF_CHARACTERISTIC
 /begin REF_CHARACTERISTIC /end REF_CHARACTERISTIC
 /begin IN_MEASUREMENT /end IN_MEASUREMENT
 /begin OUT_MEASUREMENT sfpaccomp_trq /end OUT_MEASUREMENT
 /begin LOC_MEASUREMENT /end LOC_MEASUREMENT
 /begin SUB_FUNCTION /end SUB_FUNCTION
/end FUNCTION
/begin FUNCTION DFPM_AdapCrsCtrl_Par ""
 /begin DEF_CHARACTERISTIC CDCAdapCrsCtrl_Par CDKAdapCrsCtrl_Par CDTAdapCrsCtrl_Par CLAAdapCrsCtrl_Par FFTAdapCrsCtrl_Par TSFAdapCrsCtrl_Par /end DEF_CHARACTERISTIC
 /begin REF_CHARACTERISTIC /end REF_CHARACTERISTIC
 /begin IN_MEASUREMENT /end IN_MEASUREMENT
 /begin OUT_MEASUREMENT sfpadapcrsctrl_par /end OUT_MEASUREMENT
 /begin LOC_MEASUREMENT /end LOC_MEASUREMENT
 /begin SUB_FUNCTION /end SUB_FUNCTION
/end FUNCTION
/begin FUNCTION DFPM_AdapCrsCtrl_Tgl ""
 /begin DEF_CHARACTERISTIC CDCAdapCrsCtrl_Tgl CDKAdapCrsCtrl_Tgl CDTAdapCrsCtrl_Tgl CLAAdapCrsCtrl_Tgl FFTAdapCrsCtrl_Tgl TSFAdapCrsCtrl_Tgl /end DEF_CHARACTERISTIC
 /begin REF_CHARACTERISTIC /end REF_CHARACTERISTIC
 /begin IN_MEASUREMENT /end IN_MEASUREMENT
 /begin OUT_MEASUREMENT sfpadapcrsctrl_tgl /end OUT_MEASUREMENT
 /begin LOC_MEASUREMENT /end LOC_MEASUREMENT
 /begin SUB_FUNCTION /end SUB_FUNCTION
/end FUNCTION
/begin FUNCTION DFPM_AdapCrsCtrl_TrqReq ""
 /begin DEF_CHARACTERISTIC CDCAdapCrsCtrl_TrqReq CDKAdapCrsCtrl_TrqReq CDTAdapCrsCtrl_TrqReq CLAAdapCrsCtrl_TrqReq FFTAdapCrsCtrl_TrqReq TSFAdapCrsCtrl_TrqReq /end DEF_CHARACTERISTIC
 /begin REF_CHARACTERISTIC /end REF_CHARACTERISTIC
 /begin IN_MEASUREMENT /end IN_MEASUREMENT
 /begin OUT_MEASUREMENT sfpadapcrsctrl_trqreq /end OUT_MEASUREMENT
 /begin LOC_MEASUREMENT /end LOC_MEASUREMENT
 /begin SUB_FUNCTION /end SUB_FUNCTION
/end FUNCTION
/begin FUNCTION DFPM_AGK2ME "" /begin DEF_CHARACTERISTIC CDCCAN CDKCAN CDTCAN CLACAN FFTCAN TSFCAN /end DEF_CHARACTERISTIC /begin REF_CHARACTERISTIC /end REF_CHARACTERISTIC /begin IN_MEASUREMENT /end IN_MEASUREMENT
 /begin OUT_MEASUREMENT B_becan B_bkcan B_clcan B_ftcan B_mncan B_mxcan B_npcan B_sican E_can sfpcan TYP_can Z_can /end OUT_MEASUREMENT
 /begin LOC_MEASUREMENT /end LOC_MEASUREMENT
 /begin SUB_FUNCTION /end SUB_FUNCTION
/end FUNCTION
/begin FUNCTION DFPM_AMT_EngEmOffEn ""
 /begin DEF_CHARACTERISTIC CDCAMT_EngEmOffEn CDKAMT_EngEmOffEn CDTAMT_EngEmOffEn CLAAMT_EngEmOffEn FFTAMT_EngEmOffEn TSFAMT_EngEmOffEn /end DEF_CHARACTERISTIC
 /begin REF_CHARACTERISTIC /end REF_CHARACTERISTIC
 /begin IN_MEASUREMENT /end IN_MEASUREMENT
 /begin OUT_MEASUREMENT sfpamt_engemoffen /end OUT_MEASUREMENT
 /begin LOC_MEASUREMENT /end LOC_MEASUREMENT
 /begin SUB_FUNCTION /end SUB_FUNCTION
/end FUNCTION
/begin FUNCTION DFPM_AMT_EngEmOffFl ""
 /begin DEF_CHARACTERISTIC CDCAMT_EngEmOffFl CDKAMT_EngEmOffFl CDTAMT_EngEmOffFl CLAAMT_EngEmOffFl FFTAMT_EngEmOffFl TSFAMT_EngEmOffFl /end DEF_CHARACTERISTIC
 /begin REF_CHARACTERISTIC /end REF_CHARACTERISTIC
 /begin IN_MEASUREMENT /end IN_MEASUREMENT
 /begin OUT_MEASUREMENT sfpamt_engemofffl /end OUT_MEASUREMENT
 /begin LOC_MEASUREMENT /end LOC_MEASUREMENT
 /begin SUB_FUNCTION /end SUB_FUNCTION
/end FUNCTION
/begin FUNCTION DFPM_AP_Pt1HiLim ""
 /begin DEF_CHARACTERISTIC CDCAP_Pt1HiLim CDKAP_Pt1HiLim CDTAP_Pt1HiLim CLAAP_Pt1HiLim FFTAP_Pt1HiLim TSFAP_Pt1HiLim /end DEF_CHARACTERISTIC
 /begin REF_CHARACTERISTIC /end REF_CHARACTERISTIC
 /begin IN_MEASUREMENT /end IN_MEASUREMENT
 /begin OUT_MEASUREMENT sfpap_pt1hilim /end OUT_MEASUREMENT
 /begin LOC_MEASUREMENT /end LOC_MEASUREMENT
 /begin SUB_FUNCTION /end SUB_FUNCTION
/end FUNCTION
/begin FUNCTION DFPM_AP_Pt1LoLim ""
 /begin DEF_CHARACTERISTIC CDCAP_Pt1LoLim CDKAP_Pt1LoLim CDTAP_Pt1LoLim CLAAP_Pt1LoLim FFTAP_Pt1LoLim TSFAP_Pt1LoLim /end DEF_CHARACTERISTIC
 /begin REF_CHARACTERISTIC /end REF_CHARACTERISTIC
 /begin IN_MEASUREMENT /end IN_MEASUREMENT
 /begin OUT_MEASUREMENT sfpap_pt1lolim /end OUT_MEASUREMENT
 /begin LOC_MEASUREMENT /end LOC_MEASUREMENT
 /begin SUB_FUNCTION /end SUB_FUNCTION
/end FUNCTION
/begin FUNCTION DFPM_AP_Pt2HiLim ""
 /begin DEF_CHARACTERISTIC CDCAP_Pt2HiLim CDKAP_Pt2HiLim CDTAP_Pt2HiLim CLAAP_Pt2HiLim FFTAP_Pt2HiLim TSFAP_Pt2HiLim /end DEF_CHARACTERISTIC
 /begin REF_CHARACTERISTIC /end REF_CHARACTERISTIC
 /begin IN_MEASUREMENT /end IN_MEASUREMENT
 /begin OUT_MEASUREMENT sfpap_pt2hilim /end OUT_MEASUREMENT
 /begin LOC_MEASUREMENT /end LOC_MEASUREMENT
 /begin SUB_FUNCTION /end SUB_FUNCTION
/end FUNCTION
/begin FUNCTION DFPM_AP_Pt2LoLim ""
 /begin DEF_CHARACTERISTIC CDCAP_Pt2LoLim CDKAP_Pt2LoLim CDTAP_Pt2LoLim CLAAP_Pt2LoLim FFTAP_Pt2LoLim TSFAP_Pt2LoLim /end DEF_CHARACTERISTIC
 /begin REF_CHARACTERISTIC /end REF_CHARACTERISTIC
 /begin IN_MEASUREMENT /end IN_MEASUREMENT
 /begin OUT_MEASUREMENT sfpap_pt2lolim /end OUT_MEASUREMENT
 /begin LOC_MEASUREMENT /end LOC_MEASUREMENT
 /begin SUB_FUNCTION /end SUB_FUNCTION
/end FUNCTION
/begin FUNCTION DFPM_AP_PtDiff ""
 /begin DEF_CHARACTERISTIC CDCAP_PtDiff CDKAP_PtDiff CDTAP_PtDiff CLAAP_PtDiff FFTAP_PtDiff TSFAP_PtDiff /end DEF_CHARACTERISTIC
 /begin REF_CHARACTERISTIC /end REF_CHARACTERISTIC
 /begin IN_MEASUREMENT /end IN_MEASUREMENT
 /begin OUT_MEASUREMENT sfpap_ptdiff /end OUT_MEASUREMENT
 /begin LOC_MEASUREMENT /end LOC_MEASUREMENT
 /begin SUB_FUNCTION /end SUB_FUNCTION
/end FUNCTION
/begin FUNCTION DFPM_AP_PtSupp ""
 /begin DEF_CHARACTERISTIC CDCAP_PtSupp CDKAP_PtSupp CDTAP_PtSupp CLAAP_PtSupp FFTAP_PtSupp TSFAP_PtSupp /end DEF_CHARACTERISTIC
 /begin REF_CHARACTERISTIC /end REF_CHARACTERISTIC
 /begin IN_MEASUREMENT /end IN_MEASUREMENT
 /begin OUT_MEASUREMENT sfpap_ptsupp /end OUT_MEASUREMENT
 /begin LOC_MEASUREMENT /end LOC_MEASUREMENT
 /begin SUB_FUNCTION /end SUB_FUNCTION
/end FUNCTION
/begin FUNCTION DFPM_BGRBS "" /begin DEF_CHARACTERISTIC CDCSWE CDKSWE CDTSWE CLASWE FFTSWE TSFSWE /end DEF_CHARACTERISTIC /begin REF_CHARACTERISTIC /end REF_CHARACTERISTIC /begin IN_MEASUREMENT /end IN_MEASUREMENT
 /begin OUT_MEASUREMENT B_beswe B_bkswe B_clswe B_ftswe B_mnswe B_mxswe B_npswe B_siswe E_swe sfpswe TYP_swe Z_swe /end OUT_MEASUREMENT
 /begin LOC_MEASUREMENT /end LOC_MEASUREMENT
 /begin SUB_FUNCTION /end SUB_FUNCTION
/end FUNCTION
/begin FUNCTION DFPM_BLS_Par ""
 /begin DEF_CHARACTERISTIC CDCBLS_Par CDKBLS_Par CDTBLS_Par CLABLS_Par FFTBLS_Par TSFBLS_Par /end DEF_CHARACTERISTIC
 /begin REF_CHARACTERISTIC /end REF_CHARACTERISTIC
 /begin IN_MEASUREMENT /end IN_MEASUREMENT
 /begin OUT_MEASUREMENT sfpbls_par /end OUT_MEASUREMENT
 /begin LOC_MEASUREMENT /end LOC_MEASUREMENT
 /begin SUB_FUNCTION /end SUB_FUNCTION
/end FUNCTION
/begin FUNCTION DFPM_BLS_Tgl ""
 /begin DEF_CHARACTERISTIC CDCBLS_Tgl CDKBLS_Tgl CDTBLS_Tgl CLABLS_Tgl FFTBLS_Tgl TSFBLS_Tgl /end DEF_CHARACTERISTIC
 /begin REF_CHARACTERISTIC /end REF_CHARACTERISTIC
 /begin IN_MEASUREMENT /end IN_MEASUREMENT
 /begin OUT_MEASUREMENT sfpbls_tgl /end OUT_MEASUREMENT
 /begin LOC_MEASUREMENT /end LOC_MEASUREMENT
 /begin SUB_FUNCTION /end SUB_FUNCTION
/end FUNCTION
/begin FUNCTION DFPM_BLS_Undef ""
 /begin DEF_CHARACTERISTIC CDCBLS_Undef CDKBLS_Undef CDTBLS_Undef CLABLS_Undef FFTBLS_Undef TSFBLS_Undef /end DEF_CHARACTERISTIC
 /begin REF_CHARACTERISTIC /end REF_CHARACTERISTIC
 /begin IN_MEASUREMENT /end IN_MEASUREMENT
 /begin OUT_MEASUREMENT sfpbls_undef /end OUT_MEASUREMENT
 /begin LOC_MEASUREMENT /end LOC_MEASUREMENT
 /begin SUB_FUNCTION /end SUB_FUNCTION
/end FUNCTION
/begin FUNCTION DFPM_CoolFan_SpdReq ""
 /begin DEF_CHARACTERISTIC CDCCoolFan_SpdReq CDKCoolFan_SpdReq CDTCoolFan_SpdReq CLACoolFan_SpdReq FFTCoolFan_SpdReq TSFCoolFan_SpdReq /end DEF_CHARACTERISTIC
 /begin REF_CHARACTERISTIC /end REF_CHARACTERISTIC
 /begin IN_MEASUREMENT /end IN_MEASUREMENT
 /begin OUT_MEASUREMENT sfpcoolfan_spdreq /end OUT_MEASUREMENT
 /begin LOC_MEASUREMENT /end LOC_MEASUREMENT
 /begin SUB_FUNCTION /end SUB_FUNCTION
/end FUNCTION
/begin FUNCTION DFPM_DANWS ""
 /begin DEF_CHARACTERISTIC CDCANWS CDCANWS2 CDKANWS CDKANWS2 CDTANWS CDTANWS2 CLAANWS CLAANWS2 FFTANWS FFTANWS2 TSFANWS TSFANWS2 /end DEF_CHARACTERISTIC
 /begin REF_CHARACTERISTIC /end REF_CHARACTERISTIC
 /begin IN_MEASUREMENT /end IN_MEASUREMENT
 /begin OUT_MEASUREMENT B_beanws B_beanws2 B_bkanws B_bkanws2 B_clanws B_clanws2 B_ftanws B_ftanws2 B_mnanws B_mnanws2 B_mxanws B_mxanws2 B_npanws B_npanws2 B_sianws B_sianws2 E_anws E_anws2 sfpanws sfpanws2 TYP_anws TYP_anws2 Z_anws Z_anws2 /end OUT_MEASUREMENT
 /begin LOC_MEASUREMENT /end LOC_MEASUREMENT
 /begin SUB_FUNCTION /end SUB_FUNCTION
/end FUNCTION
/begin FUNCTION DFPM_DDG ""
 /begin DEF_CHARACTERISTIC CDCBM CDCN CDKBM CDKN CDTBM CDTN CLABM CLAN FFTBM FFTN TSFBM TSFN /end DEF_CHARACTERISTIC
 /begin REF_CHARACTERISTIC /end REF_CHARACTERISTIC
 /begin IN_MEASUREMENT /end IN_MEASUREMENT
 /begin OUT_MEASUREMENT B_bebm B_ben B_bkbm B_bkn B_clbm B_cln B_ftbm B_ftn B_mnbm B_mnn B_mxbm B_mxn B_npbm B_npn B_sibm B_sin E_bm E_n sfpbm sfpn TYP_bm TYP_n Z_bm Z_n /end OUT_MEASUREMENT
 /begin LOC_MEASUREMENT /end LOC_MEASUREMENT
 /begin SUB_FUNCTION /end SUB_FUNCTION
/end FUNCTION
/begin FUNCTION DFPM_DDSS "" /begin DEF_CHARACTERISTIC CDCDSS CDKDSS CDTDSS CLADSS FFTDSS TSFDSS /end DEF_CHARACTERISTIC /begin REF_CHARACTERISTIC /end REF_CHARACTERISTIC /begin IN_MEASUREMENT /end IN_MEASUREMENT
 /begin OUT_MEASUREMENT B_bedss B_bkdss B_cldss B_ftdss B_mndss B_mxdss B_npdss B_sidss E_dss sfpdss TYP_dss Z_dss /end OUT_MEASUREMENT
 /begin LOC_MEASUREMENT /end LOC_MEASUREMENT
 /begin SUB_FUNCTION /end SUB_FUNCTION
/end FUNCTION
/begin FUNCTION DFPM_DDVE ""
 /begin DEF_CHARACTERISTIC CDCDK CDCDK1P CDCDK2P CDCDVEE CDCDVEF CDCDVEFO CDCDVEL CDCDVEN CDCDVER CDCDVET CDCDVEU CDCDVEUB CDCDVEUW CDCDVEV CDKDK CDKDK1P CDKDK2P CDKDVEE CDKDVEF CDKDVEFO CDKDVEL CDKDVEN CDKDVER CDKDVET CDKDVEU CDKDVEUB CDKDVEUW CDKDVEV CDTDK CDTDK1P CDTDK2P CDTDVEE CDTDVEF CDTDVEFO CDTDVEL CDTDVEN CDTDVER CDTDVET CDTDVEU CDTDVEUB CDTDVEUW CDTDVEV CLADK CLADK1P CLADK2P CLADVEE CLADVEF CLADVEFO CLADVEL CLADVEN CLADVER CLADVET CLADVEU CLADVEUB CLADVEUW CLADVEV FFTDK FFTDK1P FFTDK2P FFTDVEE FFTDVEF FFTDVEFO FFTDVEL FFTDVEN FFTDVER FFTDVET FFTDVEU FFTDVEUB FFTDVEUW FFTDVEV TSFDK TSFDK1P TSFDK2P TSFDVEE TSFDVEF TSFDVEFO TSFDVEL TSFDVEN TSFDVER TSFDVET TSFDVEU TSFDVEUB TSFDVEUW TSFDVEV /end DEF_CHARACTERISTIC
 /begin REF_CHARACTERISTIC /end REF_CHARACTERISTIC
 /begin IN_MEASUREMENT /end IN_MEASUREMENT
 /begin OUT_MEASUREMENT B_bedk B_bedk1p B_bedk2p B_bedvee B_bedvef B_bedvefo B_bedvel B_bedven B_bedver B_bedvet B_bedveu B_bedveub B_bedveuw B_bedvev B_bkdk B_bkdk1p B_bkdk2p B_bkdvee B_bkdvef B_bkdvefo B_bkdvel B_bkdven B_bkdver B_bkdvet B_bkdveu B_bkdveub B_bkdveuw B_bkdvev B_cldk B_cldk1p B_cldk2p B_cldvee B_cldvef B_cldvefo B_cldvel B_cldven B_cldver B_cldvet B_cldveu B_cldveub B_cldveuw B_cldvev B_ftdk B_ftdk1p B_ftdk2p B_ftdvee B_ftdvef B_ftdvefo B_ftdvel B_ftdven B_ftdver B_ftdvet B_ftdveu B_ftdveub B_ftdveuw B_ftdvev B_mndk B_mndk1p B_mndk2p B_mndvee B_mndvef B_mndvefo B_mndvel B_mndven B_mndver B_mndvet B_mndveu B_mndveub B_mndveuw B_mndvev B_mxdk B_mxdk1p B_mxdk2p B_mxdvee B_mxdvef B_mxdvefo B_mxdvel B_mxdven B_mxdver B_mxdvet B_mxdveu B_mxdveub B_mxdveuw B_mxdvev B_npdk B_npdk1p B_npdk2p B_npdvee B_npdvef B_npdvefo B_npdvel B_npdven B_npdver B_npdvet B_npdveu B_npdveub B_npdveuw B_npdvev B_sidk B_sidk1p B_sidk2p B_sidvee B_sidvef B_sidvefo B_sidvel B_sidven B_sidver B_sidvet B_sidveu B_sidveub B_sidveuw B_sidvev E_dk E_dk1p E_dk2p E_dvee E_dvef E_dvefo E_dvel E_dven E_dver E_dvet E_dveu E_dveub E_dveuw E_dvev sfpdk sfpdk1p sfpdk2p sfpdvee sfpdvef sfpdvefo sfpdvel sfpdven sfpdver sfpdvet sfpdveu sfpdveub sfpdveuw sfpdvev TYP_dk TYP_dk1p TYP_dk2p TYP_dvee TYP_dvef TYP_dvefo TYP_dvel TYP_dven TYP_dver TYP_dvet TYP_dveu TYP_dveub TYP_dveuw TYP_dvev Z_dk Z_dk1p Z_dk2p Z_dvee Z_dvef Z_dvefo Z_dvel Z_dven Z_dver Z_dvet Z_dveu Z_dveub Z_dveuw Z_dvev /end OUT_MEASUREMENT
 /begin LOC_MEASUREMENT /end LOC_MEASUREMENT
 /begin SUB_FUNCTION /end SUB_FUNCTION
/end FUNCTION
/begin FUNCTION DFPM_DEKON ""
 /begin DEF_CHARACTERISTIC CDCKKUE CDCLDE CDCLDPE CDCLUVE CDKKKUE CDKLDE CDKLDPE CDKLUVE CDTKKUE CDTLDE CDTLDPE CDTLUVE CLAKKUE CLALDE CLALDPE CLALUVE FFTKKUE FFTLDE FFTLDPE FFTLUVE TSFKKUE TSFLDE TSFLDPE TSFLUVE /end DEF_CHARACTERISTIC
 /begin REF_CHARACTERISTIC /end REF_CHARACTERISTIC
 /begin IN_MEASUREMENT /end IN_MEASUREMENT
 /begin OUT_MEASUREMENT B_bekkue B_belde B_beldpe B_beluve B_bkkkue B_bklde B_bkldpe B_bkluve B_clkkue B_cllde B_clldpe B_clluve B_ftkkue B_ftlde B_ftldpe B_ftluve B_mnkkue B_mnlde B_mnldpe B_mnluve B_mxkkue B_mxlde B_mxldpe B_mxluve B_npkkue B_nplde B_npldpe B_npluve B_sikkue B_silde B_sildpe B_siluve E_kkue E_lde E_ldpe E_luve sfpkkue sfplde sfpldpe sfpluve TYP_kkue TYP_lde TYP_ldpe TYP_luve Z_kkue Z_lde Z_ldpe Z_luve /end OUT_MEASUREMENT
 /begin LOC_MEASUREMENT /end LOC_MEASUREMENT
 /begin SUB_FUNCTION /end SUB_FUNCTION
/end FUNCTION
/begin FUNCTION DFPM_DEKPE "" /begin DEF_CHARACTERISTIC CDCKPE CDKKPE CDTKPE CLAKPE FFTKPE TSFKPE /end DEF_CHARACTERISTIC /begin REF_CHARACTERISTIC /end REF_CHARACTERISTIC /begin IN_MEASUREMENT /end IN_MEASUREMENT
 /begin OUT_MEASUREMENT B_bekpe B_bkkpe B_clkpe B_ftkpe B_mnkpe B_mxkpe B_npkpe B_sikpe E_kpe sfpkpe TYP_kpe Z_kpe /end OUT_MEASUREMENT
 /begin LOC_MEASUREMENT /end LOC_MEASUREMENT
 /begin SUB_FUNCTION /end SUB_FUNCTION
/end FUNCTION
/begin FUNCTION DFPM_DENWS ""
 /begin DEF_CHARACTERISTIC CDCENWS CDCENWS2 CDKENWS CDKENWS2 CDTENWS CDTENWS2 CLAENWS CLAENWS2 FFTENWS FFTENWS2 TSFENWS TSFENWS2 /end DEF_CHARACTERISTIC
 /begin REF_CHARACTERISTIC /end REF_CHARACTERISTIC
 /begin IN_MEASUREMENT /end IN_MEASUREMENT
 /begin OUT_MEASUREMENT B_beenws B_beenws2 B_bkenws B_bkenws2 B_clenws B_clenws2 B_ftenws B_ftenws2 B_mnenws B_mnenws2 B_mxenws B_mxenws2 B_npenws B_npenws2 B_sienws B_sienws2 E_enws E_enws2 sfpenws sfpenws2 TYP_enws TYP_enws2 Z_enws Z_enws2 /end OUT_MEASUREMENT
 /begin LOC_MEASUREMENT /end LOC_MEASUREMENT
 /begin SUB_FUNCTION /end SUB_FUNCTION
/end FUNCTION
/begin FUNCTION DFPM_DEVE ""
 /begin DEF_CHARACTERISTIC CDCEV1 CDCEV2 CDCEV3 CDCEV4 CDCEV5 CDCEV6 CDCEV7 CDCEV8 CDKEV1 CDKEV2 CDKEV3 CDKEV4 CDKEV5 CDKEV6 CDKEV7 CDKEV8 CDTEV1 CDTEV2 CDTEV3 CDTEV4 CDTEV5 CDTEV6 CDTEV7 CDTEV8 CLAEV1 CLAEV2 CLAEV3 CLAEV4 CLAEV5 CLAEV6 CLAEV7 CLAEV8 FFTEV1 FFTEV2 FFTEV3 FFTEV4 FFTEV5 FFTEV6 FFTEV7 FFTEV8 TSFEV1 TSFEV2 TSFEV3 TSFEV4 TSFEV5 TSFEV6 TSFEV7 TSFEV8 /end DEF_CHARACTERISTIC
 /begin REF_CHARACTERISTIC /end REF_CHARACTERISTIC
 /begin IN_MEASUREMENT /end IN_MEASUREMENT
 /begin OUT_MEASUREMENT B_beev1 B_beev2 B_beev3 B_beev4 B_beev5 B_beev6 B_beev7 B_beev8 B_bkev1 B_bkev2 B_bkev3 B_bkev4 B_bkev5 B_bkev6 B_bkev7 B_bkev8 B_clev1 B_clev2 B_clev3 B_clev4 B_clev5 B_clev6 B_clev7 B_clev8 B_ftev1 B_ftev2 B_ftev3 B_ftev4 B_ftev5 B_ftev6 B_ftev7 B_ftev8 B_mnev1 B_mnev2 B_mnev3 B_mnev4 B_mnev5 B_mnev6 B_mnev7 B_mnev8 B_mxev1 B_mxev2 B_mxev3 B_mxev4 B_mxev5 B_mxev6 B_mxev7 B_mxev8 B_npev1 B_npev2 B_npev3 B_npev4 B_npev5 B_npev6 B_npev7 B_npev8 B_siev1 B_siev2 B_siev3 B_siev4 B_siev5 B_siev6 B_siev7 B_siev8 E_ev1 E_ev2 E_ev3 E_ev4 E_ev5 E_ev6 E_ev7 E_ev8 sfpev1 sfpev2 sfpev3 sfpev4 sfpev5 sfpev6 sfpev7 sfpev8 TYP_ev1 TYP_ev2 TYP_ev3 TYP_ev4 TYP_ev5 TYP_ev6 TYP_ev7 TYP_ev8 Z_ev1 Z_ev2 Z_ev3 Z_ev4 Z_ev5 Z_ev6 Z_ev7 Z_ev8 /end OUT_MEASUREMENT
 /begin LOC_MEASUREMENT /end LOC_MEASUREMENT
 /begin SUB_FUNCTION /end SUB_FUNCTION
/end FUNCTION
/begin FUNCTION DFPM_DFPM ""
 /begin DEF_CHARACTERISTIC CDCAAA CDCZZZ CDKAAA CDKZZZ CDTAAA CDTZZZ CLAAAA CLAZZZ FFTAAA FFTZZZ TSFAAA TSFZZZ /end DEF_CHARACTERISTIC
 /begin REF_CHARACTERISTIC /end REF_CHARACTERISTIC
 /begin IN_MEASUREMENT /end IN_MEASUREMENT
 /begin OUT_MEASUREMENT sfpaaa sfpzzz /end OUT_MEASUREMENT
 /begin LOC_MEASUREMENT /end LOC_MEASUREMENT
 /begin SUB_FUNCTION /end SUB_FUNCTION
/end FUNCTION
/begin COMPU_METHOD B_TRUE "boolsche Zust‰nde, positive Logik" TAB_VERB "%6.3" "" COMPU_TAB_REF B_TRUE /end COMPU_METHOD
/begin COMPU_VTAB B_TRUE "boolsche Zust‰nde, positive Logik" TAB_VERB 2 0 "----" 1 "TRUE" /end COMPU_VTAB
/begin COMPU_METHOD dez "1 : 1 Umrechnug (dez/hex)" RAT_FUNC "%6.2" "" COEFFS 0 1 0 0 0 1 /end COMPU_METHOD
/begin COMPU_METHOD fak_q0p00195 "" RAT_FUNC "%6.4" "-" COEFFS 0 65536 0 0 0 128 /end COMPU_METHOD
/begin COMPU_METHOD fak_q0p0625 "" RAT_FUNC "%6.4" "-" COEFFS 0 16 0 0 0 1 /end COMPU_METHOD
/begin COMPU_METHOD fak_q4p883Em4 "" RAT_FUNC "%6.5" "-" COEFFS 0 65536 0 0 0 32 /end COMPU_METHOD
/begin COMPU_METHOD fak_ub_b16 "" RAT_FUNC "%6.4" "-" COEFFS 0 256 0 0 0 16 /end COMPU_METHOD
/begin COMPU_METHOD fak_ub_b2 "" RAT_FUNC "%6.4" "-" COEFFS 0 256 0 0 0 2 /end COMPU_METHOD
/begin COMPU_METHOD fak_ub_b4 "" RAT_FUNC "%6.4" "-" COEFFS 0 256 0 0 0 4 /end COMPU_METHOD
/begin COMPU_METHOD fak_uw_b4 "" RAT_FUNC "%7.6" "-" COEFFS 0 65536 0 0 0 4 /end COMPU_METHOD
/begin COMPU_METHOD nmot_ub_q40 "" RAT_FUNC "%6.1" "1/min" COEFFS 0 1 0 0 0 40 /end COMPU_METHOD
/begin COMPU_METHOD nmot_uw_q0p25 "" RAT_FUNC "%6.3" "1/min" COEFFS 0 1 0 0 0 0.25 /end COMPU_METHOD
/begin COMPU_METHOD p_ub_q10 "" RAT_FUNC "%6.1" "hPa" COEFFS 0 1 0 0 0 10 /end COMPU_METHOD
/begin COMPU_METHOD p_uw_q0p039 "" RAT_FUNC "%6.4" "hPa" COEFFS 0 256 0 0 0 10 /end COMPU_METHOD
/begin COMPU_METHOD relDK_q0p02441 "" RAT_FUNC "%6.4" "%DK" COEFFS 0 65536 0 0 0 1600 /end COMPU_METHOD
/begin COMPU_METHOD relDK_ub_b100 "" RAT_FUNC "%6.3" "%DK" COEFFS 0 255 0 0 0 100 /end COMPU_METHOD
/begin COMPU_METHOD rel_ub_b100 "" RAT_FUNC "%6.3" "%" COEFFS 0 256 0 0 0 100 /end COMPU_METHOD
/begin COMPU_METHOD r_ub_q64 "" RAT_FUNC "%6.1" "Ohm" COEFFS 0 1 0 0 0 64 /end COMPU_METHOD
/begin COMPU_METHOD spgg_sb_b3052 "" RAT_FUNC "%6.1" "V/s" COEFFS 0 1 0 0 0 23.8438 /end COMPU_METHOD
/begin COMPU_METHOD spg_q0p625 "" RAT_FUNC "%6.3" "V" COEFFS 0 8 0 0 0 5 /end COMPU_METHOD
/begin COMPU_METHOD spg_sw_q0p00488 "" RAT_FUNC "%6.4" "V" COEFFS 0 1024 0 0 0 5 /end COMPU_METHOD
/begin COMPU_METHOD spg_ubatt "" RAT_FUNC "%6.3" "V" COEFFS 0 1 0 0 0 0.0942 /end COMPU_METHOD
/begin COMPU_METHOD spg_ub_b5 "" RAT_FUNC "%6.4" "V" COEFFS 0 256 0 0 0 5 /end COMPU_METHOD
/begin COMPU_METHOD t100msxs_ub_b25p5 "" RAT_FUNC "%6.3" "s" COEFFS 0 1 0 0 0 0.1 /end COMPU_METHOD
/begin COMPU_METHOD t10msxs_ub_b10p2 "" RAT_FUNC "%6.4" "s" COEFFS 0 1 0 0 0 0.04 /end COMPU_METHOD
/begin COMPU_METHOD t200msxs_ub_b51 "" RAT_FUNC "%6.3" "s" COEFFS 0 1 0 0 0 0.2 /end COMPU_METHOD
/begin COMPU_METHOD t25p6sxs_ub_b6528 "" RAT_FUNC "%6.1" "s" COEFFS 0 1 0 0 0 25.6 /end COMPU_METHOD
/begin COMPU_METHOD temp_ub_q1_o40 "" RAT_FUNC "%6.2" "Grad C" COEFFS 0 1 40 0 0 1 /end COMPU_METHOD
/begin COMPU_METHOD t_q256 "" RAT_FUNC "%6.0" "s" COEFFS 0 1 0 0 0 256 /end COMPU_METHOD
/begin COMPU_METHOD vfzg_q1p0 "" RAT_FUNC "%6.2" "km/h" COEFFS 0 1 0 0 0 1 /end COMPU_METHOD
/begin COMPU_METHOD wkw_sb_b128 "" RAT_FUNC "%3.1" "Grad KW" COEFFS 0 1 0 0 0 1 /end COMPU_METHOD
/begin COMPU_METHOD zk20msxs_ub_b5p1 "" RAT_FUNC "%6.4" "s" COEFFS 0 0 5.1 0 1 0 /end COMPU_METHOD
/begin COMPU_METHOD default "" RAT_FUNC "%6.2" "" COEFFS 0 1 0 0 0 1 /end COMPU_METHOD
/begin RECORD_LAYOUT KfAxUwAyUwSstxSwSstyUwWUw NO_AXIS_PTS_X 1 UWORD NO_AXIS_PTS_Y 2 UWORD AXIS_PTS_X 3 SWORD INDEX_INCR DIRECT AXIS_PTS_Y 4 UWORD INDEX_INCR DIRECT FNC_VALUES 5 UWORD COLUMN_DIR DIRECT /end RECORD_LAYOUT
/begin RECORD_LAYOUT KwbUb FNC_VALUES 1 UBYTE COLUMN_DIR DIRECT /end RECORD_LAYOUT
/begin RECORD_LAYOUT KwbUw FNC_VALUES 1 UWORD COLUMN_DIR DIRECT /end RECORD_LAYOUT
/begin RECORD_LAYOUT KwbWU16 FNC_VALUES 1 UWORD COLUMN_DIR DIRECT /end RECORD_LAYOUT
/begin RECORD_LAYOUT KwbWU8 FNC_VALUES 1 UBYTE COLUMN_DIR DIRECT /end RECORD_LAYOUT
/begin RECORD_LAYOUT KwSw FNC_VALUES 1 SWORD COLUMN_DIR DIRECT /end RECORD_LAYOUT
/begin RECORD_LAYOUT KwUb FNC_VALUES 1 UBYTE COLUMN_DIR DIRECT /end RECORD_LAYOUT
/begin RECORD_LAYOUT KwUw FNC_VALUES 1 UWORD COLUMN_DIR DIRECT /end RECORD_LAYOUT
/begin RECORD_LAYOUT KwWU16 FNC_VALUES 1 UWORD COLUMN_DIR DIRECT /end RECORD_LAYOUT
/begin RECORD_LAYOUT KwWU8 FNC_VALUES 1 UBYTE COLUMN_DIR DIRECT /end RECORD_LAYOUT
/end MODULE
/end PROJECT
