ASAP2_VERSION 1 3
/begin PROJECT _9702_071D00 "ME97"
/begin HEADER "" VERSION "_9702_071D00" PROJECT_NO _9702_071D00 /end HEADER
/begin MODULE DIM ""
/begin MOD_COMMON "" BYTE_ORDER MSB_FIRST ALIGNMENT_BYTE 1 ALIGNMENT_WORD 2 ALIGNMENT_LONG 2 ALIGNMENT_FLOAT32_IEEE 4 /end MOD_COMMON
/begin CHARACTERISTIC AGRRMAX "maximal mˆgliche AGR-Rate" VALUE 0x1C70F8 KwUb 99.61 rel_ub_b99p6 0.00 99.61 FORMAT "%5.2" /end CHARACTERISTIC
/begin CHARACTERISTIC CLRHKZP "Codewort Modus continuierlich oder Zweipunkt" VALUE 0x1C507A KwWU8 255.0 dez 0.00 255.0 FORMAT "%5.1" /end CHARACTERISTIC
/begin CHARACTERISTIC CLRS "Codewort f¸r Betriebsmodi LRS" VALUE 0x1C4A40 KwUb 255.0 dez 0.00 255.0 FORMAT "%5.1" /end CHARACTERISTIC
/begin CHARACTERISTIC CLRSHK "Codewort f¸r Freigabe LRSHK und Auswahl Initialisierung" VALUE 0x1CD34A KwWU8 255.0 dez 0.00 255.0 FORMAT "%5.1" /end CHARACTERISTIC
/begin CHARACTERISTIC CLRSHKEB "Codewort f¸r Freigabe LRSHKEB" VALUE 0x1CD34B KwWU8 255.0 dez 0.00 255.0 FORMAT "%5.1" /end CHARACTERISTIC
/begin CHARACTERISTIC CLRSKA "Code-Wort Funktionsart Kat-Ausr‰umen" VALUE 0x1C4D2C KwWU8 255.0 dez 0.00 255.0 FORMAT "%5.1" /end CHARACTERISTIC
/begin CHARACTERISTIC CLRZWTMS "Codewort Zwangseinschaltung LR gem‰ﬂ CARB-Forderung" VALUE 0x1CC390 KwUb 255.0 dez 0.00 255.0 FORMAT "%5.1" /end CHARACTERISTIC
/begin CHARACTERISTIC CNFMDVER "Codewort zur Konfiguration von MDVER" VALUE 0x1CF90C KwUb 255.0 dez 0.00 255.0 FORMAT "%5.1" /end CHARACTERISTIC
/begin CHARACTERISTIC CREDSTU "Codewort f¸r Reduzierstufe ein/aus" VALUE 0x1C7C26 KwUb 255.0 dez 0.00 255.0 FORMAT "%5.1" /end CHARACTERISTIC
/begin CHARACTERISTIC CWGALSV "Codewort f¸r zur¸cksetzen von Adaptionswerte bei Error E_LSV" VALUE 0x1CDC0C KwUb 255.0 dez 0.00 255.0 FORMAT "%5.1" /end CHARACTERISTIC
/begin CHARACTERISTIC CWLLRPA "Codewort zur Auswahl des Parametersatzes des P-Anteils" VALUE 0x1CF778 KwUb 255.0 dez 0.00 255.0 FORMAT "%5.1" /end CHARACTERISTIC
/begin CHARACTERISTIC CWLLRRM "Codeword f¸r die LLRRM" VALUE 0x1CF779 KwUb 255.0 dez 0.00 255.0 FORMAT "%5.1" /end CHARACTERISTIC
/begin CHARACTERISTIC CWMDBAS "Codewort Einrechnung der ZW-Korrektur f¸r AGR-Betrieb" VALUE 0x1C70F9 KwUb 255.0 dez 0.00 255.0 FORMAT "%5.1" /end CHARACTERISTIC
/begin CHARACTERISTIC CWMDFILM "Codewort f¸r MDFILM" VALUE 0x1C70AE KwUb 255.0 dez 0.00 255.0 FORMAT "%5.1" /end CHARACTERISTIC
/begin CHARACTERISTIC CWMDKOG "Codewort MDKOG: Z¸ndwinkelsp‰tverstellung bei Unterdruckbegrenzung" VALUE 0x1C70EE KwUb 255.0 dez 0.00 255.0 FORMAT "%5.1" /end CHARACTERISTIC
/begin CHARACTERISTIC CWMDKOL "Codeword MDKOL: Momentenbegrenzung" VALUE 0x1C70F6 KwUb 255.0 dez 0.00 255.0 FORMAT "%5.1" /end CHARACTERISTIC
/begin CHARACTERISTIC CWMDMIN "Codewort MDMIN" VALUE 0x1C7044 KwUb 255.0 dez 0.00 255.0 FORMAT "%5.1" /end CHARACTERISTIC
/begin CHARACTERISTIC CWMDNSTAB "Codewort f¸r Funktion MDNSTAB" VALUE 0x1CF8EC KwUb 255.0 dez 0.00 255.0 FORMAT "%5.1" /end CHARACTERISTIC
/begin CHARACTERISTIC DDMSAWEN "Delta-Momentschwelle f¸rs Abwerfen des Filters FILSAWE" CURVE 0x1C70B0 KlAUwSstUwWUw 99.99847 rel_uw_b100 0.00 99.99847 FORMAT "%8.5"
 /begin AXIS_DESCR STD_AXIS nmot_w nmot_uw_q0p25 4 0.00 16383.75 FORMAT "%8.2" DEPOSIT ABSOLUTE /end AXIS_DESCR
/end CHARACTERISTIC
/begin CHARACTERISTIC DELRL "Delta relative Luftf¸llung f¸r Freigabe ZW-Eingriff" VALUE 0x1C70EF KwUb 5.977 rel_q0p02344 0.00 5.977 FORMAT "%5.3" /end CHARACTERISTIC
/begin CHARACTERISTIC DLAHINI "Initwert Integrator dlahi der stetigen LRHK" VALUE 0x1CD2F6 KwWS16 1.999969 fak_sw_b1 -1.000000 0.9999695 FORMAT "%8.6" /end CHARACTERISTIC
/begin CHARACTERISTIC DLAHINI2 "Initwert Integrator dlahi der stetigen LRHK, Bank2" VALUE 0x1CD2F8 KwWS16 1.999969 fak_sw_b1 -1.000000 0.9999695 FORMAT "%8.6" /end CHARACTERISTIC
/begin CHARACTERISTIC DLAMXSA "max Regeldifferenz, f¸r die nach SA die LRS gesperrt bleibt" VALUE 0x1C4CC4 KwUw 15.99976 fak_uw_b16 0.00 15.99976 FORMAT "%8.5" /end CHARACTERISTIC
/begin CHARACTERISTIC DMADFK "Maximal adaptierbares Delta-Verlustmoment pro Adaptionsphase Fahrst.+Kompr." VALUE 0x1CFC48 KwUb 24.90 rel_ub_b24p9 0.00 24.90 FORMAT "%5.2" /end CHARACTERISTIC
/begin CHARACTERISTIC DMADFS "Maximal adaptierbares Delta-Verlustmoment pro Adaptionsphase mit Fahrstufe ein" VALUE 0x1CFC49 KwUb 24.90 rel_ub_b24p9 0.00 24.90 FORMAT "%5.2" /end CHARACTERISTIC
/begin CHARACTERISTIC DMADKO "Maximal adaptierbares Delta-Verlustmoment pro Adaptionsphase Kompr.ein" VALUE 0x1CFC4A KwUb 24.90 rel_ub_b24p9 0.00 24.90 FORMAT "%5.2" /end CHARACTERISTIC
/begin CHARACTERISTIC DMADLL "Maximal adaptierbares Delta-Verlustmoment pro Adaptionsphase ohne Last" VALUE 0x1CFC4B KwUb 24.90 rel_ub_b24p9 0.00 24.90 FORMAT "%5.2" /end CHARACTERISTIC
/begin CHARACTERISTIC DMADMNFK "Minimal adaptierbares Delta-Verlustmoment Fahrstufe eingelegt + Kompressor ein" VALUE 0x1CFC4C KwUb 24.90 rel_ub_bn24p9 -24.90 0.00 FORMAT "%5.2" /end CHARACTERISTIC
/begin CHARACTERISTIC DMADMNFS "Minimal adaptierbares Delta-Verlustmoment Fahrstufe eingelegt" VALUE 0x1CFC4D KwUb 24.90 rel_ub_bn24p9 -24.90 0.00 FORMAT "%5.2" /end CHARACTERISTIC
/begin CHARACTERISTIC DMADMNKO "Minimal adaptierbares Delta-Verlustmoment Klimakompressor ein" VALUE 0x1CFC4E KwUb 24.90 rel_ub_bn24p9 -24.90 0.00 FORMAT "%5.2" /end CHARACTERISTIC
/begin CHARACTERISTIC DMADMNLL "Minimal adaptierbares Delta-Verlustmoment ohne Last" VALUE 0x1CFC4F KwUb 24.90 rel_ub_bn24p9 -24.90 0.00 FORMAT "%5.2" /end CHARACTERISTIC
/begin CHARACTERISTIC DMADMXFK "Maximal adaptierbares Delta-Verlustmoment Farstufe + Klimakompressor ein" VALUE 0x1CFC50 KwUb 24.90 rel_ub_b24p9 0.00 24.90 FORMAT "%5.2" /end CHARACTERISTIC
/begin CHARACTERISTIC DMADMXFS "Maximal adaptierbares Delta-Verlustmoment Farstufe ein" VALUE 0x1CFC51 KwUb 24.90 rel_ub_b24p9 0.00 24.90 FORMAT "%5.2" /end CHARACTERISTIC
/begin CHARACTERISTIC DMADMXKO "Maximal adaptierbares Delta-Verlustmoment Klimakompressor ein" VALUE 0x1CFC52 KwUb 24.90 rel_ub_b24p9 0.00 24.90 FORMAT "%5.2" /end CHARACTERISTIC
/begin CHARACTERISTIC DMADMXLL "Maximal adaptierbares Delta-Verlustmoment ohne Last" VALUE 0x1CFC53 KwUb 24.90 rel_ub_b24p9 0.00 24.90 FORMAT "%5.2" /end CHARACTERISTIC
/begin CHARACTERISTIC DMDNSM "Delta Moment zur Nachstartkompensation" CURVE 0x1CF910 KlAUbSstUbWUb 99.61 rel_ub_b99p6 0.00 99.61 FORMAT "%5.2"
 /begin AXIS_DESCR STD_AXIS tmot temp_ub_q0p75_o48 8 -48.00 143.3 FORMAT "%5.1" DEPOSIT ABSOLUTE /end AXIS_DESCR
/end CHARACTERISTIC
/begin CHARACTERISTIC DMIUMSCH "Deltamoment f¸r Betriebsartenumschaltung" VALUE 0x1C78AC KwUw 99.99847 rel_uw_b100 0.00 99.99847 FORMAT "%8.5" /end CHARACTERISTIC
/begin CHARACTERISTIC DMLLNGEZ "LLR: D-Verst‰rkung abh. von ngasf f¸r Luftpfad" MAP 0x1C6EFC KfAxUbAyUbSstxSwSstyUbWSw 199.9841 rel_q0p00305 -99.99360 99.99055 FORMAT "%8.5"
 /begin AXIS_DESCR STD_AXIS ngasf_w nmotg_sw_q0p39 6 -12800.16 12799.77 FORMAT "%8.2" DEPOSIT ABSOLUTE /end AXIS_DESCR
 /begin AXIS_DESCR STD_AXIS etazws rel_ub_b127p5 4 0.00 127.5 FORMAT "%5.1" DEPOSIT ABSOLUTE /end AXIS_DESCR
/end CHARACTERISTIC
/begin CHARACTERISTIC DMLLNGEZV "LLR: D-Verst‰rkung abh. von ngasf f¸r Luftpfad" MAP 0x1C6F3E KfAxUbAyUbSstxSwSstyUbWSw 199.9841 rel_q0p00305 -99.99360 99.99055 FORMAT "%8.5"
 /begin AXIS_DESCR STD_AXIS ngasf_w nmotg_sw_q0p39 6 -12800.16 12799.77 FORMAT "%8.2" DEPOSIT ABSOLUTE /end AXIS_DESCR
 /begin AXIS_DESCR STD_AXIS etazws rel_ub_b127p5 4 0.00 127.5 FORMAT "%5.1" DEPOSIT ABSOLUTE /end AXIS_DESCR
/end CHARACTERISTIC
/begin CHARACTERISTIC DMLLRLMNF "Untere Begrenzung f¸r dmllrl" VALUE 0x1CF77A KwSb 50.00 rel_sb_q0p39 -50.00 0.00 FORMAT "%5.2" /end CHARACTERISTIC
/begin CHARACTERISTIC DMLLRLMNN "Untere Begrenzung f¸r dmllrl" CURVE 0x1C6DF8 GklWSb 50.00 rel_sb_q0p39 -50.00 0.00 FORMAT "%5.2"
 /begin AXIS_DESCR COM_AXIS nmot nmot_ub_q40 6 0.00 10200. AXIS_PTS_REF SNM06LLUB /end AXIS_DESCR
/end CHARACTERISTIC
/begin CHARACTERISTIC DMLLRLMXF "Sicherheitskonzept: obere Begrenzung f¸r dmllrl" VALUE 0x1CF77B KwUb 99.61 rel_ub_b99p6 0.00 99.61 FORMAT "%5.2" /end CHARACTERISTIC
/begin CHARACTERISTIC DMLLRLMXN "Sicherheitskonzept: obere Begrenzung f¸r dmllrl" CURVE 0x1C6E00 GklWUb 99.61 rel_ub_b99p6 0.00 99.61 FORMAT "%5.2"
 /begin AXIS_DESCR COM_AXIS nmot nmot_ub_q40 6 0.00 10200. AXIS_PTS_REF SNM06LLUB /end AXIS_DESCR
/end CHARACTERISTIC
/begin CHARACTERISTIC DMLLRMNN "Untere Begrenzung f¸r dmllr_w" CURVE 0x1C6E08 GklWSb 50.00 rel_sb_q0p39 -50.00 0.00 FORMAT "%5.2"
 /begin AXIS_DESCR COM_AXIS nmot nmot_ub_q40 6 0.00 10200. AXIS_PTS_REF SNM06LLUB /end AXIS_DESCR
/end CHARACTERISTIC
/begin CHARACTERISTIC DMLLRMNNK "Untere Begrenzung f¸r dmllr_w im Kurztrip" CURVE 0x1C6E10 GklWSb 50.00 rel_sb_q0p39 -50.00 0.00 FORMAT "%5.2"
 /begin AXIS_DESCR COM_AXIS nmot nmot_ub_q40 6 0.00 10200. AXIS_PTS_REF SNM06LLUB /end AXIS_DESCR
/end CHARACTERISTIC
/begin CHARACTERISTIC DMLLRMXN "Sicherheitskonzept: obere Begrenzung f¸r dmllr" CURVE 0x1C6E18 GklWUb 99.61 rel_ub_b99p6 0.00 99.61 FORMAT "%5.2"
 /begin AXIS_DESCR COM_AXIS nmot nmot_ub_q40 6 0.00 10200. AXIS_PTS_REF SNM06LLUB /end AXIS_DESCR
/end CHARACTERISTIC
/begin CHARACTERISTIC DMLLRMXNK "Sicherheitskonzept: obere Begrenzung f¸r dmllr im Kurztrip" CURVE 0x1C6E20 GklWUb 99.61 rel_ub_b99p6 0.00 99.61 FORMAT "%5.2"
 /begin AXIS_DESCR COM_AXIS nmot nmot_ub_q40 6 0.00 10200. AXIS_PTS_REF SNM06LLUB /end AXIS_DESCR
/end CHARACTERISTIC
/begin CHARACTERISTIC DMRAA "allgemeine Momentenreserve Kurztrip" VALUE 0x1CF090 KwUw 99.99847 rel_uw_b100 0.00 99.99847 FORMAT "%8.5" /end CHARACTERISTIC
/begin CHARACTERISTIC DMRTMKI "Inkrement f¸r Regelfaktor Momentenbegrenzung ¸ber Motortemperatur" VALUE 0x1CF024 KwUb 1.992 fak_ub_b2 0.00 1.992 FORMAT "%5.3" /end CHARACTERISTIC
/begin CHARACTERISTIC DMVERLMN "minimale Verlustmomentschwelle" VALUE 0x1CF922 KwUw 99.99847 rel_uw_b100 0.00 99.99847 FORMAT "%8.5" /end CHARACTERISTIC
/begin CHARACTERISTIC DNLLRIST "‹berdrehzahlschwelle f¸r Integratorreset" VALUE 0x1C6E26 KwSb 2550. nmotd_sb_q10 -1280. 1270. FORMAT "%5.0" /end CHARACTERISTIC
/begin CHARACTERISTIC DNLLST "Drehzahlschwelle zum Deaktivieren der P-Verst‰rkung im Start" VALUE 0x1C6E27 KwUb 255.0 nmot_q1 0.00 255.0 FORMAT "%5.1" /end CHARACTERISTIC
/begin CHARACTERISTIC DNMNI "Kleinstmˆglicher Wert f¸r dn beim I-Anteil" VALUE 0x1C6E28 KwSb 2550. nmotd_sb_q10 -1280. 1270. FORMAT "%5.0" /end CHARACTERISTIC
/begin CHARACTERISTIC DNNSTAB "Schwelle ‹bergabe an nstat zur Bestimmung Stabilit‰tsfaktor" VALUE 0x1CF8EE KwUw 2550.000 nmot_uw_q0p25 0.00 2550.000 FORMAT "%8.3" /end CHARACTERISTIC
/begin CHARACTERISTIC DRLLRHKO "positive Delta-rl-Schwelle f¸r Ausblendung I-Anteil" VALUE 0x1CD338 KwWS16 1535.977 relNWU_q0p0234 -768.0000 767.9766 FORMAT "%8.4" /end CHARACTERISTIC
/begin CHARACTERISTIC DRLLRHKU "negative Delta-rl-Schwelle f¸r Ausblendung I-Anteil" VALUE 0x1CD33A KwWS16 1535.977 relNWU_q0p0234 -768.0000 767.9766 FORMAT "%8.4" /end CHARACTERISTIC
/begin CHARACTERISTIC DTMIBG "Delta temperatur f¸r Hysterese Breite" VALUE 0x1CF025 KwUb 191.3 temp_ub_q0p75_o48 -48.00 143.3 FORMAT "%5.1" /end CHARACTERISTIC
/begin CHARACTERISTIC DTMR "Hysterese f¸r Einschaltschwelle" VALUE 0x1C4C9C KwUb 191.3 temp_ub_b191p25 0.00 191.3 FORMAT "%5.1" /end CHARACTERISTIC
/begin CHARACTERISTIC DTMTMRW "Temperaturdiff.-Schwelle f¸r die Pr¸fung, ob Zwangseinschaltung LR nˆtig (CARB)" VALUE 0x1CC391 KwSb 191.3 temp_sb_q0p75 -96.00 95.25 FORMAT "%5.2" /end CHARACTERISTIC
/begin CHARACTERISTIC DVNG "LLR: D-Verst‰rkung abh. von ngfil bei stehendem Fahrzeug" CURVE 0x1CF77C GklWUb 0.1245 rel_qn0p000488 -0.1245 0.00 FORMAT "%6.4"
 /begin AXIS_DESCR COM_AXIS ngfil nmotg_sb_q100 6 -12800. 12700. AXIS_PTS_REF SNG06LLSB /end AXIS_DESCR
/end CHARACTERISTIC
/begin CHARACTERISTIC DVNGKH "LLR: D-Verst‰rkung abh. von ngfil bei stehendem Fahrzeug (Kat-Heizung)" CURVE 0x1CF784 GklWUb 0.1245 rel_qn0p000488 -0.1245 0.00 FORMAT "%6.4"
 /begin AXIS_DESCR COM_AXIS ngfil nmotg_sb_q100 6 -12800. 12700. AXIS_PTS_REF SNG06LLSB /end AXIS_DESCR
/end CHARACTERISTIC
/begin CHARACTERISTIC DVNGV "LLR: D-Verst‰rkung abh. von ngfil bei roolendem Fahrzeug" CURVE 0x1C6E2C GklWUb 0.1245 rel_qn0p000488 -0.1245 0.00 FORMAT "%6.4"
 /begin AXIS_DESCR COM_AXIS ngfil nmotg_sb_q100 6 -12800. 12700. AXIS_PTS_REF SNG06LLSB /end AXIS_DESCR
/end CHARACTERISTIC
/begin CHARACTERISTIC DZFLBK "Delta Faktor f¸r Z¸ndwinkelfreigabe bei Stellen Ladungsbewegungsklappe" VALUE 0x1C70F4 KwUw 0.9999847 fak_uw_b1 0.00 0.9999847 FORMAT "%9.7" /end CHARACTERISTIC
/begin CHARACTERISTIC DZWOLA "Lambda-Abh‰ngigkeit des optimalen Z¸ndwinkels bezogen auf Lambda 1" CURVE 0x1C7714 KlAUbSstUbWSb 191.3 zw_sb_q0p75 -96.00 95.25 FORMAT "%5.2"
 /begin AXIS_DESCR STD_AXIS lambas fak_ub_b2 10 0.00 1.992 FORMAT "%5.3" DEPOSIT ABSOLUTE /end AXIS_DESCR
/end CHARACTERISTIC
/begin CHARACTERISTIC DZWOM "temperaturabh‰ngiger Offset des optimalen ZW" CURVE 0x1C7729 KlAUbSstUbWSb 191.3 zw_sb_q0p75 -96.00 95.25 FORMAT "%5.2"
 /begin AXIS_DESCR STD_AXIS tmot temp_ub_q0p75_o48 5 -48.00 143.3 FORMAT "%5.1" DEPOSIT ABSOLUTE /end AXIS_DESCR
/end CHARACTERISTIC
/begin CHARACTERISTIC ETADZW "ZW-Wirkungsgrad in Abh‰ngigkeit von delta ZW" CURVE 0x1C70FC FklWUb 127.5 rel_ub_b127p5 0.00 127.5 FORMAT "%5.1"
 /begin AXIS_DESCR FIX_AXIS dzw_kge zw_sb_q0p75 127 0.00 94.50 FORMAT "%5.2" FIX_AXIS_PAR 0 0 127 /end AXIS_DESCR
/end CHARACTERISTIC
/begin CHARACTERISTIC ETALAM "Lambda-Wirkungsgrad" CURVE 0x1C717C KlAUbSstUbWUb 127.5 rel_ub_b127p5 0.00 127.5 FORMAT "%5.1"
 /begin AXIS_DESCR STD_AXIS lambas fak_ub_b2 10 0.00 1.992 FORMAT "%5.3" DEPOSIT ABSOLUTE /end AXIS_DESCR
/end CHARACTERISTIC
/begin CHARACTERISTIC FBZFRAT "Bewertungsfaktor f¸r Integrationsgeschwindigkeit KFFRAT als f(abo)" CURVE 0x1CDC10 KlAUbSstUbWUb 0.9961 fak_ub_b1 0.00 0.9961
 /begin AXIS_DESCR STD_AXIS abo dez 5 0.00 255.0 FORMAT "%5.1" DEPOSIT ABSOLUTE /end AXIS_DESCR
/end CHARACTERISTIC
/begin CHARACTERISTIC FDDN "LLR: Gewichtungsfaktor f¸r D-Verst‰rkung" CURVE 0x1C6E34 GklWUb 0.9961 fak_ub_b1 0.00 0.9961
 /begin AXIS_DESCR COM_AXIS dns nmotd_sb_q10 6 -1280. 1270. AXIS_PTS_REF SNS06LLSB /end AXIS_DESCR
/end CHARACTERISTIC
/begin CHARACTERISTIC FDFRMIN "Default-Wert untere Schranke dfr_w" VALUE 0x1C4A41 KwSb 1.992 fak_sb_b1 -1.000 0.9922 FORMAT "%5.3" /end CHARACTERISTIC
/begin CHARACTERISTIC FDNIKOR "Faktor f¸r Korrektur auif I-Anteil ¸ber dn" VALUE 0x1C6E3A KwUb 1.992 fak_ub_b2 0.00 1.992 FORMAT "%5.3" /end CHARACTERISTIC
/begin CHARACTERISTIC FKAXAVKAT "Gewichtungsfaktor Sauerstoffspeicher in Abh‰ngigkeit von avkatf" CURVE 0x1CC3F4 KlAxU8SstxU8WU8 0.9961 fak_ub_b1 0.00 0.9961 /begin AXIS_DESCR STD_AXIS avkatf fak_ub_b1 3 0.00 0.9961 DEPOSIT ABSOLUTE /end AXIS_DESCR /end CHARACTERISTIC
/begin CHARACTERISTIC FKAXAVKAT2 "Gewichtungsfaktor Sauerstoffspeicher in Abh‰ngigkeit von avkatf, Bank 2" CURVE 0x1CC3FC KlAxU8SstxU8WU8 0.9961 fak_ub_b1 0.00 0.9961 /begin AXIS_DESCR STD_AXIS avkatf2 fak_ub_b1 3 0.00 0.9961 DEPOSIT ABSOLUTE /end AXIS_DESCR /end CHARACTERISTIC
/begin CHARACTERISTIC FLMLKAMA "Faktor zur Bewertung Schwellwert integr. Fettfl. f. Abbruch Kat-Ausr. Pre/Main" VALUE 0x1C4D2D KwWU8 7.969 fak_ub_b8 0.00 7.969 FORMAT "%5.3" /end CHARACTERISTIC
/begin CHARACTERISTIC FLMLKAMA2 "Fakt. zur Bewert. Schwellw. integr. Fettfl. f. Abbruch Kat-Ausr. Pre/Main, Bank2" VALUE 0x1C4D2E KwWU8 7.969 fak_ub_b8 0.00 7.969 FORMAT "%5.3" /end CHARACTERISTIC
/begin CHARACTERISTIC FLRSG2K "Korrekturfaktor f¸r Reglerparameter G2 bei temperaturabh‰ngiger Reglereinstellug" VALUE 0x1CC06C KwUb 1.992 fak_ub_b2 0.00 1.992 FORMAT "%5.3" /end CHARACTERISTIC
/begin CHARACTERISTIC FMIVL "Faktor Korrektur maximales Moment bei VL" VALUE 0x1CF63E KwUb 1.992 fak_ub_b2 0.00 1.992 FORMAT "%5.3" /end CHARACTERISTIC
/begin CHARACTERISTIC FNSTABNV "Faktor zur Drehzahlstabilisierung durch Drehmoment" CURVE 0x1CF8F0 KlAUwSstUwWUw 7.999878 fak_uw_b8 0.00 7.999878 FORMAT "%8.6"
 /begin AXIS_DESCR STD_AXIS nver_w fak_uw_b8 6 0.00 7.999878 FORMAT "%8.6" DEPOSIT ABSOLUTE /end AXIS_DESCR
/end CHARACTERISTIC
/begin CHARACTERISTIC FRAOMN "untere Begrenzung des Korrekturfaktors frao" VALUE 0x1CDC1B KwUb 1.992 fak_ub_b2 0.00 1.992 FORMAT "%5.3" /end CHARACTERISTIC
/begin CHARACTERISTIC FRAOMX "obere Begrenzung des Korrekturfaktors frao" VALUE 0x1CDC1C KwUb 1.992 fak_ub_b2 0.00 1.992 FORMAT "%5.3" /end CHARACTERISTIC
/begin CHARACTERISTIC FRAORN "untere reduzierte Schwelle des Korrekturfaktors frao" VALUE 0x1CDC1D KwUb 1.992 fak_ub_b2 0.00 1.992 FORMAT "%5.3" /end CHARACTERISTIC
/begin CHARACTERISTIC FRAORX "obere reduzierte Schwelle des Korrekturfaktors frao" VALUE 0x1CDC1E KwUb 1.992 fak_ub_b2 0.00 1.992 FORMAT "%5.3" /end CHARACTERISTIC
/begin CHARACTERISTIC FRATMN "untere Begrenzung des Korrekturfaktors frat" VALUE 0x1CDC1F KwUb 1.992 fak_ub_b2 0.00 1.992 FORMAT "%5.3" /end CHARACTERISTIC
/begin CHARACTERISTIC FRATMX "obere Begrenzung des Korrekturfaktors frat" VALUE 0x1CDC20 KwUb 1.992 fak_ub_b2 0.00 1.992 FORMAT "%5.3" /end CHARACTERISTIC
/begin CHARACTERISTIC FRAUMN "untere Begrenzung des Korrekturfaktors frau" VALUE 0x1CDC21 KwUb 1.992 fak_ub_b2 0.00 1.992 FORMAT "%5.3" /end CHARACTERISTIC
/begin CHARACTERISTIC FRAUMX "obere Begrenzung des Korrekturfaktors frau" VALUE 0x1CDC22 KwUb 1.992 fak_ub_b2 0.00 1.992 FORMAT "%5.3" /end CHARACTERISTIC
/begin CHARACTERISTIC FRAURN "untere reduzierte Schwelle des Korrekturfaktors frau" VALUE 0x1CDC23 KwUb 1.992 fak_ub_b2 0.00 1.992 FORMAT "%5.3" /end CHARACTERISTIC
/begin CHARACTERISTIC FRAURX "obere reduzierte Schwelle des Korrekturfaktors frau" VALUE 0x1CDC24 KwUb 1.992 fak_ub_b2 0.00 1.992 FORMAT "%5.3" /end CHARACTERISTIC
/begin CHARACTERISTIC FRMAX "obere Regelbereichsgrenze" VALUE 0x1C4B0E KwUw 1.999969 fak_uw_b2 0.00 1.999969 FORMAT "%8.6" /end CHARACTERISTIC
/begin CHARACTERISTIC FRMINKH "Magerbegrenzung Lambdaregelung bei KH mit SL" VALUE 0x1C4B10 KwUw 1.999969 fak_uw_b2 0.00 1.999969 FORMAT "%8.6" /end CHARACTERISTIC
/begin CHARACTERISTIC FWDMVAD "Faktor zur Wichtung von dmvad_w in %MDMIN" CURVE 0x1CF800 KlAUwSstUwWUw 0.9999847 fak_uw_b1 0.00 0.9999847 FORMAT "%9.7"
 /begin AXIS_DESCR STD_AXIS nver_w fak_uw_b8 8 0.00 7.999878 FORMAT "%8.6" DEPOSIT ABSOLUTE /end AXIS_DESCR
/end CHARACTERISTIC
/begin CHARACTERISTIC FZAB2 "Verst‰rkungsfaktor f¸r Zwangsamplitude auf Bank 2 gegen¸ber Bank 1" VALUE 0x1C4A42 KwSb 15.94 fak_q0p0625 -8.000 7.938 FORMAT "%5.3" /end CHARACTERISTIC
/begin CHARACTERISTIC GFDLDN "LLR: Gewichtungsfaktor f¸r D-Verst‰rkung auf Luftpfad" CURVE 0x1C6E3C GklWUb 0.9961 rel_ub_b1p0 0.00 0.9961
 /begin AXIS_DESCR COM_AXIS dns nmotd_sb_q10 6 -1280. 1270. AXIS_PTS_REF SNS06LLSB /end AXIS_DESCR
/end CHARACTERISTIC
/begin CHARACTERISTIC ILMLKAXTK "Schwelle Fettfl‰che Kat-Ausr‰umen nach SA, Funktion der Kat-Temperatur" CURVE 0x1CC3C8 KlAxU8SstxU16WU16 291.2667 m_uw_b291p25 0.00 291.2667 FORMAT "%8.4"
 /begin AXIS_DESCR STD_AXIS tikatm_w temp_uw_q0p0195_o50 5 -50.00000 1229.980 FORMAT "%8.3" DEPOSIT ABSOLUTE /end AXIS_DESCR
/end CHARACTERISTIC
/begin CHARACTERISTIC ILMLKAXTK2 "Schwelle Fettfl‰che Kat-Ausr‰umen nach SA, Funktion der Kat-Temperartur" CURVE 0x1CC3DE KlAxU8SstxU16WU16 291.2667 m_uw_b291p25 0.00 291.2667 FORMAT "%8.4"
 /begin AXIS_DESCR STD_AXIS tikatm2_w temp_uw_q0p0195_o50 5 -50.00000 1229.980 FORMAT "%8.3" DEPOSIT ABSOLUTE /end AXIS_DESCR
/end CHARACTERISTIC
/begin CHARACTERISTIC IMLEVABS "Schwelle Luftmassenintegral vor Freigabe Lambdaregelung nach Zylinderausblendung" VALUE 0x1C4CC6 KwUw 4660.267 m_uw_b4660 0.00 4660.267 FORMAT "%8.3" /end CHARACTERISTIC
/begin CHARACTERISTIC IMLEVABS2 "Schwelle Luftmassenintegral vor Freigabe Lambdareg. nach Zyl.ausblendung, Bank 2" VALUE 0x1C4CC8 KwUw 4660.267 m_uw_b4660 0.00 4660.267 FORMAT "%8.3" /end CHARACTERISTIC
/begin CHARACTERISTIC IMLKAMN "Schwellwert integr. Luftmasse f. Mindestdauer Katalysator-Ausr‰umen" VALUE 0x1C4D16 KwWU16 291.2667 m_uw_b291p25 0.00 291.2667 FORMAT "%8.4" /end CHARACTERISTIC
/begin CHARACTERISTIC IMLKAMN2 "Schwellwert integr. Luftmasse f. Mindestdauer Katalysator-Ausr‰umen Bank2" VALUE 0x1C4D18 KwWU16 291.2667 m_uw_b291p25 0.00 291.2667 FORMAT "%8.4" /end CHARACTERISTIC
/begin CHARACTERISTIC IMLRLHKX "Luftmassenschwelle f¸r Ausblendung I-Anteil nach Auslˆsung  Delta-rl-Schwelle" VALUE 0x1CD33C KwWU16 7281.667 m_uw_b7281 0.00 7281.667 FORMAT "%8.3" /end CHARACTERISTIC
/begin CHARACTERISTIC IMLSALR "Schwellwert integr. Luftmasse f. Einschaltverzˆgerung LR nach SA" VALUE 0x1C4CCA KwUw 4660.267 m_uw_b4660 0.00 4660.267 FORMAT "%8.3" /end CHARACTERISTIC
/begin CHARACTERISTIC IVDNDTEH "I-Reglerparameter bei aktiver DTEV im Homogenbetrieb" CURVE 0x1CF78C GklWUb 0.6076 rel_q0p002383 0.00 0.6076
 /begin AXIS_DESCR COM_AXIS dn_w nmot_sw_q0p25 10 -8192.000 8191.750 AXIS_PTS_REF SDN10LLSW /end AXIS_DESCR
/end CHARACTERISTIC
/begin CHARACTERISTIC IVDNHOM "I-Reglerparameter bei Homogenbetrieb" CURVE 0x1CF798 GklWUb 0.6076 rel_q0p002383 0.00 0.6076
 /begin AXIS_DESCR COM_AXIS dn_w nmot_sw_q0p25 10 -8192.000 8191.750 AXIS_PTS_REF SDN10LLSW /end AXIS_DESCR
/end CHARACTERISTIC
/begin CHARACTERISTIC IVDNHOMV "I-Reglerparameter bei Homogenbetrieb und Kraftschluﬂ" CURVE 0x1CF7A4 GklWUb 0.6076 rel_q0p002383 0.00 0.6076
 /begin AXIS_DESCR COM_AXIS dn_w nmot_sw_q0p25 10 -8192.000 8191.750 AXIS_PTS_REF SDN10LLSW /end AXIS_DESCR
/end CHARACTERISTIC
/begin CHARACTERISTIC KDLASHKI "Kennlinie ¸ber dlashkm, Bewertungsfaktor f¸r I-Anteil in der LRHK" CURVE 0x1CD268 GklWS16 1.999969 fak_sw_b1 -1.000000 0.9999695 FORMAT "%8.6"
 /begin AXIS_DESCR COM_AXIS dlashkm_w fak_sw_b1 9 -1.000000 0.9999695 AXIS_PTS_REF SM109LHSW /end AXIS_DESCR
/end CHARACTERISTIC
/begin CHARACTERISTIC KDLASHKI2 "Kennlinie ¸ber dlashkm, Bewertungsfaktor f¸r I-Anteil in der LRHK, Bank 2" CURVE 0x1CD27A GklWS16 1.999969 fak_sw_b1 -1.000000 0.9999695 FORMAT "%8.6"
 /begin AXIS_DESCR COM_AXIS dlashkm2_w fak_sw_b1 9 -1.000000 0.9999695 AXIS_PTS_REF SM209LHSW /end AXIS_DESCR
/end CHARACTERISTIC
/begin CHARACTERISTIC KDLASHKP "Kennlinie ¸ber dlashkm_w, Bewertungsfaktor f¸r P-Anteil in der LRHK" CURVE 0x1C4FDC GklWS16 1.999969 fak_sw_b1 -1.000000 0.9999695 FORMAT "%8.6"
 /begin AXIS_DESCR COM_AXIS dlashkm_w fak_sw_b1 9 -1.000000 0.9999695 AXIS_PTS_REF SM109LHSW /end AXIS_DESCR
/end CHARACTERISTIC
/begin CHARACTERISTIC KDLASHKP2 "Kennlinie ¸ber dlashkm, Bewertungsfaktor f¸r P-Anteil in der LRHK, Bank 2" CURVE 0x1C4FEE GklWS16 1.999969 fak_sw_b1 -1.000000 0.9999695 FORMAT "%8.6"
 /begin AXIS_DESCR COM_AXIS dlashkm2_w fak_sw_b1 9 -1.000000 0.9999695 AXIS_PTS_REF SM209LHSW /end AXIS_DESCR
/end CHARACTERISTIC
/begin CHARACTERISTIC KFDLASO "Kennfeld Lambdasollwert-Korrektur f¸r stetigen Lambdaregler" MAP 0x1C4A44 GkfWSb 0.06226 fak_sb_b0p03125 -0.03125 0.03101 FORMAT "%7.5"
 /begin AXIS_DESCR COM_AXIS nmot nmot_ub_q40 10 0.00 10200. AXIS_PTS_REF SNM10LSUB /end AXIS_DESCR
 /begin AXIS_DESCR COM_AXIS rl rel_ub_q0p75 10 0.00 191.3 AXIS_PTS_REF SRL10LSUB /end AXIS_DESCR
/end CHARACTERISTIC
/begin CHARACTERISTIC KFDLASO2 "Kennfeld Lambdasollwert-Korrektur f¸r stetigen Lambdaregler, Bank2" MAP 0x1C4AA8 GkfWSb 0.06226 fak_sb_b0p03125 -0.03125 0.03101 FORMAT "%7.5"
 /begin AXIS_DESCR COM_AXIS nmot nmot_ub_q40 10 0.00 10200. AXIS_PTS_REF SNM10LSUB /end AXIS_DESCR
 /begin AXIS_DESCR COM_AXIS rl rel_ub_q0p75 10 0.00 191.3 AXIS_PTS_REF SRL10LSUB /end AXIS_DESCR
/end CHARACTERISTIC
/begin CHARACTERISTIC KFFRMIN "untere Regelbereichsgrenze" MAP 0x1C4B12 KfAxUwAyUwSstxUwSstyUwWUw 1.999969 fak_uw_b2 0.00 1.999969 FORMAT "%8.6"
 /begin AXIS_DESCR STD_AXIS tmot temp_ub_q0p75_o48 5 -48.00000 49103.25 FORMAT "%8.2" DEPOSIT ABSOLUTE /end AXIS_DESCR
 /begin AXIS_DESCR STD_AXIS tnst_w t10msxs_uw_b655p35 4 0.00 655.3500 FORMAT "%8.4" DEPOSIT ABSOLUTE /end AXIS_DESCR
/end CHARACTERISTIC
/begin CHARACTERISTIC KFFRTMKI "Faktor fur Moment Begrenzung abh‰ngig auf Drehzahl und gang" MAP 0x1CF028 KfAxUbAyUbSstxUbSstyUbWUb 1.992 fak_ub_b2 0.00 1.992 FORMAT "%5.3"
 /begin AXIS_DESCR STD_AXIS nmot nmot_ub_q40 6 0.00 10200. FORMAT "%5.0" DEPOSIT ABSOLUTE /end AXIS_DESCR
 /begin AXIS_DESCR STD_AXIS gangi dez 8 0.00 255.0 FORMAT "%5.1" DEPOSIT ABSOLUTE /end AXIS_DESCR
/end CHARACTERISTIC
/begin CHARACTERISTIC KFLRSG1 "Kennfeld Reglerparameter g1 stetiger Lambdaregler" MAP 0x1CC07E GkfWSw 63.99902 fak_sw_b32 -32.00000 31.99902 FORMAT "%8.5"
 /begin AXIS_DESCR COM_AXIS nmot_w nmot_uw_q0p25 7 0.00 16383.75 AXIS_PTS_REF SNM07LSUW /end AXIS_DESCR
 /begin AXIS_DESCR COM_AXIS rl_w rel_uw_q0p0234 8 0.00 1535.977 AXIS_PTS_REF SRL08LSUW /end AXIS_DESCR
/end CHARACTERISTIC
/begin CHARACTERISTIC KFLRSG2 "Kennfeld Reglerparameter g2 stetiger Lambdaregler" MAP 0x1CC0EE GkfWUw 63.99902 fak_uw_b64 0.00 63.99902 FORMAT "%8.5"
 /begin AXIS_DESCR COM_AXIS nmot_w nmot_uw_q0p25 7 0.00 16383.75 AXIS_PTS_REF SNM07LSUW /end AXIS_DESCR
 /begin AXIS_DESCR COM_AXIS rl_w rel_uw_q0p0234 8 0.00 1535.977 AXIS_PTS_REF SRL08LSUW /end AXIS_DESCR
/end CHARACTERISTIC
/begin CHARACTERISTIC KFLRSG4 "Kennfeld Reglerparameter g4 stetiger Lambdaregler" MAP 0x1CC15E GkfWSw 3.999939 fak_sw_b2 -2.000000 1.999939 FORMAT "%8.6"
 /begin AXIS_DESCR COM_AXIS nmot_w nmot_uw_q0p25 7 0.00 16383.75 AXIS_PTS_REF SNM07LSUW /end AXIS_DESCR
 /begin AXIS_DESCR COM_AXIS rl_w rel_uw_q0p0234 8 0.00 1535.977 AXIS_PTS_REF SRL08LSUW /end AXIS_DESCR
/end CHARACTERISTIC
/begin CHARACTERISTIC KFLRSP1 "Kennfeld Reglerparameter p1 stetiger Lambdaregler" MAP 0x1CC1CE GkfWUw 127.9980 fak_uw_b128 0.00 127.9980 FORMAT "%8.4"
 /begin AXIS_DESCR COM_AXIS nmot_w nmot_uw_q0p25 7 0.00 16383.75 AXIS_PTS_REF SNM07LSUW /end AXIS_DESCR
 /begin AXIS_DESCR COM_AXIS rl_w rel_uw_q0p0234 8 0.00 1535.977 AXIS_PTS_REF SRL08LSUW /end AXIS_DESCR
/end CHARACTERISTIC
/begin CHARACTERISTIC KFLRSP2 "Kennfeld Reglerparameter p2 stetiger Lambdaregler" MAP 0x1CC23E GkfWUw 127.9980 fak_uw_b128 0.00 127.9980 FORMAT "%8.4"
 /begin AXIS_DESCR COM_AXIS nmot_w nmot_uw_q0p25 7 0.00 16383.75 AXIS_PTS_REF SNM07LSUW /end AXIS_DESCR
 /begin AXIS_DESCR COM_AXIS rl_w rel_uw_q0p0234 8 0.00 1535.977 AXIS_PTS_REF SRL08LSUW /end AXIS_DESCR
/end CHARACTERISTIC
/begin CHARACTERISTIC KFLRSP3 "Kennfeld Reglerparameter p3 stetiger Lambdaregler" MAP 0x1CC2AE GkfWUw 127.9980 fak_uw_b128 0.00 127.9980 FORMAT "%8.4"
 /begin AXIS_DESCR COM_AXIS nmot_w nmot_uw_q0p25 7 0.00 16383.75 AXIS_PTS_REF SNM07LSUW /end AXIS_DESCR
 /begin AXIS_DESCR COM_AXIS rl_w rel_uw_q0p0234 8 0.00 1535.977 AXIS_PTS_REF SRL08LSUW /end AXIS_DESCR
/end CHARACTERISTIC
/begin CHARACTERISTIC KFLRSP4 "Kennfeld Reglerparameter p4 stetiger Lambdaregler" MAP 0x1CC31E GkfWSw 127.9980 fak_sw_b64 -64.00000 63.99805 FORMAT "%8.5"
 /begin AXIS_DESCR COM_AXIS nmot_w nmot_uw_q0p25 7 0.00 16383.75 AXIS_PTS_REF SNM07LSUW /end AXIS_DESCR
 /begin AXIS_DESCR COM_AXIS rl_w rel_uw_q0p0234 8 0.00 1535.977 AXIS_PTS_REF SRL08LSUW /end AXIS_DESCR
/end CHARACTERISTIC
/begin CHARACTERISTIC KFLRST "Kennfeld Streckentotzeit" MAP 0x1C4B50 KfAxUwAyUwSstxUwSstyUwWUw 327.67000000 tz10msxs_uw_b327p68 0.010000000000 327.68000000 FORMAT "%12.8"
 /begin AXIS_DESCR STD_AXIS nmot_w nmot_uw_q0p25 7 0.00 16383.75 FORMAT "%8.2" DEPOSIT ABSOLUTE /end AXIS_DESCR
 /begin AXIS_DESCR STD_AXIS rl_w rel_uw_q0p0234 8 0.00 1535.977 FORMAT "%8.3" DEPOSIT ABSOLUTE /end AXIS_DESCR
/end CHARACTERISTIC
/begin CHARACTERISTIC KFLRSZ "Kennfeld Streckenzeitkonstante der LRS, 16-Bit" MAP 0x1C4BE2 KfAxUwAyUwSstxUwSstyUwWUw 655.350000 zk10msxs_uw_b655 0.0100001526 655.360000 FORMAT "%10.6"
 /begin AXIS_DESCR STD_AXIS nmot_w nmot_uw_q0p25 7 0.00 16383.75 FORMAT "%8.2" DEPOSIT ABSOLUTE /end AXIS_DESCR
 /begin AXIS_DESCR STD_AXIS rl_w rel_uw_q0p0234 8 0.00 1535.977 FORMAT "%8.3" DEPOSIT ABSOLUTE /end AXIS_DESCR
/end CHARACTERISTIC
/begin CHARACTERISTIC KFMDS "Schleppmoment Drehzahl- und Lastabh‰ngigkeit" MAP 0x1CF924 GkfWUw 99.99847 rel_uw_b100 0.00 99.99847 FORMAT "%8.5"
 /begin AXIS_DESCR COM_AXIS nmot_w nmot_uw_q0p25 16 0.00 16383.75 AXIS_PTS_REF SNM16OPUW /end AXIS_DESCR
 /begin AXIS_DESCR COM_AXIS rl_w rel_uw_q0p0234 11 0.00 1535.977 AXIS_PTS_REF SRL11OPUW /end AXIS_DESCR
/end CHARACTERISTIC
/begin CHARACTERISTIC KFMDSNW "Schleppmoment Drehzahl- ‹berschneidungswinkel und Lastabh‰ngigkeit" MAP 0x1CFA84 GkfWUw 99.99847 rel_uw_b100 0.00 99.99847 FORMAT "%8.5"
 /begin AXIS_DESCR COM_AXIS nmot_w nmot_uw_q0p25 16 0.00 16383.75 AXIS_PTS_REF SNM16OPUW /end AXIS_DESCR
 /begin AXIS_DESCR COM_AXIS rl_w rel_uw_q0p0234 11 0.00 1535.977 AXIS_PTS_REF SRL11OPUW /end AXIS_DESCR
/end CHARACTERISTIC
/begin CHARACTERISTIC KFMIMN "Minimales Schubmoment" MAP 0x1CF822 KfAxUbAyUbSstxUbSstyUwWUw 99.99847 rel_uw_b100 0.00 99.99847 FORMAT "%8.5"
 /begin AXIS_DESCR STD_AXIS gangi dez 8 0.00 255.0 FORMAT "%5.1" DEPOSIT ABSOLUTE /end AXIS_DESCR
 /begin AXIS_DESCR STD_AXIS nmot_w nmot_uw_q0p25 8 0.00 16383.75 FORMAT "%8.2" DEPOSIT ABSOLUTE /end AXIS_DESCR
/end CHARACTERISTIC
/begin CHARACTERISTIC KFMIOP "Kennfeld optimales Motormoment" MAP 0x1C7734 GkfWUw 99.99847 rel_uw_b100 0.00 99.99847 FORMAT "%8.5"
 /begin AXIS_DESCR COM_AXIS nmot_w nmot_uw_q0p25 16 0.00 16383.75 AXIS_PTS_REF SNM16OPUW /end AXIS_DESCR
 /begin AXIS_DESCR COM_AXIS rl_w rel_uw_q0p0234 11 0.00 1535.977 AXIS_PTS_REF SRL11OPUW /end AXIS_DESCR
/end CHARACTERISTIC
/begin CHARACTERISTIC KFMIRL "Kennfeld f¸r Berechnung Sollf¸llung" MAP 0x1C78AE KfAxUwAyUwSstxUwSstyUwWUw 1535.977 rel_uw_q0p0234 0.00 1535.977 FORMAT "%8.3"
 /begin AXIS_DESCR STD_AXIS nmot_w nmot_uw_q0p25 16 0.00 16383.75 FORMAT "%8.2" DEPOSIT ABSOLUTE /end AXIS_DESCR
 /begin AXIS_DESCR STD_AXIS misopl1_w rel_uw_b100 12 0.00 99.99847 FORMAT "%8.5" DEPOSIT ABSOLUTE /end AXIS_DESCR
/end CHARACTERISTIC
/begin CHARACTERISTIC KFMIRLS "Kennfeld f¸r Berechnung Sollf¸llung f¸r Schichtbetrieb" MAP 0x1C7A6A KfAxUwAyUwSstxUwSstyUwWUw 1535.977 rel_uw_q0p0234 0.00 1535.977 FORMAT "%8.3"
 /begin AXIS_DESCR STD_AXIS nmot_w nmot_uw_q0p25 16 0.00 16383.75 FORMAT "%8.2" DEPOSIT ABSOLUTE /end AXIS_DESCR
 /begin AXIS_DESCR STD_AXIS misophos_w rel_uw_b100 12 0.00 99.99847 FORMAT "%8.5" DEPOSIT ABSOLUTE /end AXIS_DESCR
/end CHARACTERISTIC
/begin CHARACTERISTIC KFRAT "F¸llungabh‰ngige Integrationsteigung f¸r FRAT" CURVE 0x1CDC36 KlAUbSstUbWUw 0.1999664 fak_uw_b5 0.00 0.1999664 FORMAT "%9.7"
 /begin AXIS_DESCR STD_AXIS dlrfrat fak_q0p0625 5 0.00 15.94 FORMAT "%5.2" DEPOSIT ABSOLUTE /end AXIS_DESCR
/end CHARACTERISTIC
/begin CHARACTERISTIC KFUSHK "Sondenspannungssollwert f¸r Regelung hinter Kat. (statt KFUSRHK f¸r Variantenk.)" MAP 0x1CD29C KfAxU8AyU8SstxU8SstyU8WU8 1.330 spg_ub_q0p0052_o0p2 -0.2000 1.130 FORMAT "%5.3"
 /begin AXIS_DESCR STD_AXIS nmot nmot_ub_q40 6 0.00 10200. FORMAT "%5.0" DEPOSIT ABSOLUTE /end AXIS_DESCR
 /begin AXIS_DESCR STD_AXIS rl rel_ub_q0p75 6 0.00 191.3 FORMAT "%5.1" DEPOSIT ABSOLUTE /end AXIS_DESCR
/end CHARACTERISTIC
/begin CHARACTERISTIC KFVERST "Gewichtungskennfeld f¸r Reibmomentenaufsteuerung" MAP 0x1CF8BC KfAxUwAyUwSstxUwSstyUwWUw 7.999878 fak_uw_b8 0.00 7.999878 FORMAT "%8.6"
 /begin AXIS_DESCR STD_AXIS wped_w relPED_uw_b100 3 0.00 100.0000 FORMAT "%8.4" DEPOSIT ABSOLUTE /end AXIS_DESCR
 /begin AXIS_DESCR STD_AXIS nmot_w nmot_uw_q0p25 3 0.00 16383.75 FORMAT "%8.2" DEPOSIT ABSOLUTE /end AXIS_DESCR
/end CHARACTERISTIC
/begin CHARACTERISTIC KFZWOP "optimaler Z¸ndwinkel" MAP 0x1C7194 GkfWSb 191.3 zw_sb_q0p75 -96.00 95.25 FORMAT "%5.2"
 /begin AXIS_DESCR COM_AXIS nmot_w nmot_uw_q0p25 16 0.00 16383.75 AXIS_PTS_REF SNM16OPUW /end AXIS_DESCR
 /begin AXIS_DESCR COM_AXIS rl_w rel_uw_q0p0234 11 0.00 1535.977 AXIS_PTS_REF SRL11OPUW /end AXIS_DESCR
/end CHARACTERISTIC
/begin CHARACTERISTIC KFZWOP2 "optimaler Z¸ndwinkel Variante 2" MAP 0x1C7244 GkfWSb 191.3 zw_sb_q0p75 -96.00 95.25 FORMAT "%5.2"
 /begin AXIS_DESCR COM_AXIS nmot_w nmot_uw_q0p25 16 0.00 16383.75 AXIS_PTS_REF SNM16OPUW /end AXIS_DESCR
 /begin AXIS_DESCR COM_AXIS rl_w rel_uw_q0p0234 11 0.00 1535.977 AXIS_PTS_REF SRL11OPUW /end AXIS_DESCR
/end CHARACTERISTIC
/begin CHARACTERISTIC KFZWOP3 "optimaler Z¸ndwinkel Variante 3" MAP 0x1C72F4 GkfWSb 191.3 zw_sb_q0p75 -96.00 95.25 FORMAT "%5.2"
 /begin AXIS_DESCR COM_AXIS nmot_w nmot_uw_q0p25 16 0.00 16383.75 AXIS_PTS_REF SNM16OPUW /end AXIS_DESCR
 /begin AXIS_DESCR COM_AXIS rl_w rel_uw_q0p0234 11 0.00 1535.977 AXIS_PTS_REF SRL11OPUW /end AXIS_DESCR
/end CHARACTERISTIC
/begin CHARACTERISTIC KFZWOP4 "optimaler Z¸ndwinkel Varainte 4" MAP 0x1C73A4 GkfWSb 191.3 zw_sb_q0p75 -96.00 95.25 FORMAT "%5.2"
 /begin AXIS_DESCR COM_AXIS nmot_w nmot_uw_q0p25 16 0.00 16383.75 AXIS_PTS_REF SNM16OPUW /end AXIS_DESCR
 /begin AXIS_DESCR COM_AXIS rl_w rel_uw_q0p0234 11 0.00 1535.977 AXIS_PTS_REF SRL11OPUW /end AXIS_DESCR
/end CHARACTERISTIC
/begin CHARACTERISTIC KFZWOPA "optimaler Z¸ndwinkel, Auslaﬂnockenwelle max. verstellt" MAP 0x1C7454 GkfWSb 191.3 zw_sb_q0p75 -96.00 95.25 FORMAT "%5.2"
 /begin AXIS_DESCR COM_AXIS nmot_w nmot_uw_q0p25 16 0.00 16383.75 AXIS_PTS_REF SNM16OPUW /end AXIS_DESCR
 /begin AXIS_DESCR COM_AXIS rl_w rel_uw_q0p0234 11 0.00 1535.977 AXIS_PTS_REF SRL11OPUW /end AXIS_DESCR
/end CHARACTERISTIC
/begin CHARACTERISTIC KFZWOPA2 "optimaler Z¸ndwinkel, Auslaﬂnockenwelle max. verstellt, Var. 2" MAP 0x1C7504 GkfWSb 191.3 zw_sb_q0p75 -96.00 95.25 FORMAT "%5.2"
 /begin AXIS_DESCR COM_AXIS nmot_w nmot_uw_q0p25 16 0.00 16383.75 AXIS_PTS_REF SNM16OPUW /end AXIS_DESCR
 /begin AXIS_DESCR COM_AXIS rl_w rel_uw_q0p0234 11 0.00 1535.977 AXIS_PTS_REF SRL11OPUW /end AXIS_DESCR
/end CHARACTERISTIC
/begin CHARACTERISTIC KFZWOPA3 "optimaler Z¸ndwinkel, Auslaﬂnockenwelle verstellt , Var. 3" MAP 0x1C75B4 GkfWSb 191.3 zw_sb_q0p75 -96.00 95.25 FORMAT "%5.2"
 /begin AXIS_DESCR COM_AXIS nmot_w nmot_uw_q0p25 16 0.00 16383.75 AXIS_PTS_REF SNM16OPUW /end AXIS_DESCR
 /begin AXIS_DESCR COM_AXIS rl_w rel_uw_q0p0234 11 0.00 1535.977 AXIS_PTS_REF SRL11OPUW /end AXIS_DESCR
/end CHARACTERISTIC
/begin CHARACTERISTIC KFZWOPA4 "optimaler Z¸ndwinkel, Auslaﬂnockenwelle verstellt , Var. 4" MAP 0x1C7664 GkfWSb 191.3 zw_sb_q0p75 -96.00 95.25 FORMAT "%5.2"
 /begin AXIS_DESCR COM_AXIS nmot_w nmot_uw_q0p25 16 0.00 16383.75 AXIS_PTS_REF SNM16OPUW /end AXIS_DESCR
 /begin AXIS_DESCR COM_AXIS rl_w rel_uw_q0p0234 11 0.00 1535.977 AXIS_PTS_REF SRL11OPUW /end AXIS_DESCR
/end CHARACTERISTIC
/begin CHARACTERISTIC KILRHML "I-Anteil fuer stetige LRHK" CURVE 0x1CD28C GklWU8 0.04980 freq_ub_b0p05 0.00 0.04980 FORMAT "%7.5" /begin AXIS_DESCR COM_AXIS ml m_ub_b1020 8 0.00 1020. AXIS_PTS_REF SML08LHUB /end AXIS_DESCR /end CHARACTERISTIC
/begin CHARACTERISTIC KLFRTMKI "Kennlinie Regelfaktor aus Motortemperatur" CURVE 0x1CF068 KlAUbSstUbWUb 1.992 fak_ub_b2 0.00 1.992 FORMAT "%5.3"
 /begin AXIS_DESCR STD_AXIS tmot temp_ub_q0p75_o48 4 -48.00 143.3 FORMAT "%5.1" DEPOSIT ABSOLUTE /end AXIS_DESCR
/end CHARACTERISTIC
/begin CHARACTERISTIC KLMIMNH "hˆhenabh‰ngige Korrektur des minimalen  Moments" CURVE 0x1CF8DE KlAUbSstUbWSb 49.80 rel_sb_b25 -25.00 24.80 FORMAT "%5.2"
 /begin AXIS_DESCR STD_AXIS fho fak_ub_b4 6 0.00 3.984 FORMAT "%5.3" DEPOSIT ABSOLUTE /end AXIS_DESCR
/end CHARACTERISTIC
/begin CHARACTERISTIC KLMRKFHO "Korrekturfaktor Drehmomentreseve hˆhenabh‰ngig" CURVE 0x1CF092 KlAUwSstUwWUb 15.94 fak_ub_b16 0.00 15.94 FORMAT "%5.2"
 /begin AXIS_DESCR STD_AXIS fho_w fak_uw_b4 3 0.00 3.999939 FORMAT "%8.6" DEPOSIT ABSOLUTE /end AXIS_DESCR
/end CHARACTERISTIC
/begin CHARACTERISTIC KPLRHML "P-Anteil fuer stetige LRHK" CURVE 0x1CD294 GklWU8 3.984 fak_ub_b4 0.00 3.984 FORMAT "%5.3" /begin AXIS_DESCR COM_AXIS ml m_ub_b1020 8 0.00 1020. AXIS_PTS_REF SML08LHUB /end AXIS_DESCR /end CHARACTERISTIC
/begin CHARACTERISTIC KVZAF "Verst‰rkungsfaktor Zusatzamplitudenfilter" VALUE 0x1C4B0C KwSb 3.984 fak_sb_b2 -2.000 1.984 FORMAT "%5.3" /end CHARACTERISTIC
/begin CHARACTERISTIC LALIUSHK "Lambdalinearisierung, Sonde hinter Katalysator, Quantisierung 0...<2" CURVE 0x1C5000 KlAxU8SstxU16WU16 1.999969 fak_uw_b2 0.00 1.999969 FORMAT "%8.6"
 /begin AXIS_DESCR STD_AXIS usxhk_w spg_uw_q0p00488_o1 10 -1.000000 318.9951 FORMAT "%8.4" DEPOSIT ABSOLUTE /end AXIS_DESCR
/end CHARACTERISTIC
/begin CHARACTERISTIC LALIUSHK2 "Lambdalinearisierung, Sonde hinter Katalysator, Quantisierung 0...<2, Bank 2" CURVE 0x1C502A KlAxU8SstxU16WU16 1.999969 fak_uw_b2 0.00 1.999969 FORMAT "%8.6"
 /begin AXIS_DESCR STD_AXIS usxhk2_w spg_uw_q0p00488_o1 10 -1.000000 318.9951 FORMAT "%8.4" DEPOSIT ABSOLUTE /end AXIS_DESCR
/end CHARACTERISTIC
/begin CHARACTERISTIC LALIUSMN "minimales, ueber LALIUS (%GGLSU) messbares Lambda" VALUE 0x1C4C74 KwUw 15.99976 fak_uw_b16 0.00 15.99976 FORMAT "%8.5" /end CHARACTERISTIC
/begin CHARACTERISTIC LAMBRSMN "Lambda-Schwelle Min. f¸r Auslˆsung Sperre I-Anteil" VALUE 0x1CD33E KwWU16 15.99976 fak_uw_b16 0.00 15.99976 FORMAT "%8.5" /end CHARACTERISTIC
/begin CHARACTERISTIC LAMBRSMX "Lambda-Schwelle Max. f¸r Auslˆsung Sperre I-Anteil" VALUE 0x1CD340 KwWU16 15.99976 fak_uw_b16 0.00 15.99976 FORMAT "%8.5" /end CHARACTERISTIC
/begin CHARACTERISTIC LAMKADEF "Defaultwert Lambda f¸r Katausr‰umen inaktiv" VALUE 0x1C4D1A KwWU16 15.99976 fak_uw_b16 0.00 15.99976 FORMAT "%8.5" /end CHARACTERISTIC
/begin CHARACTERISTIC LAMKAMLW "Lambdasollwert f¸r Katalysator-Ausr‰umen (luftmassenabh‰ngig)" CURVE 0x1C4D00 KlAxU8SstxU16WU16 15.99976 fak_uw_b16 0.00 15.99976 FORMAT "%8.5"
 /begin AXIS_DESCR STD_AXIS ml_w m_uw_b6553p5 5 0.00 6553.500 FORMAT "%8.3" DEPOSIT ABSOLUTE /end AXIS_DESCR
/end CHARACTERISTIC
/begin CHARACTERISTIC LAMLRAMN "minimale Lambda-Schwelle, bei der die Gemischadaption aktiv sein kann" VALUE 0x1CDCBA KwUw 15.99976 fak_uw_b16 0.00 15.99976 FORMAT "%8.5" /end CHARACTERISTIC
/begin CHARACTERISTIC LAMLRAMX "maximale Lambda-Schwelle, bei der die Gemischadaption aktiv sein kann" VALUE 0x1CDCBC KwUw 15.99976 fak_uw_b16 0.00 15.99976 FORMAT "%8.5" /end CHARACTERISTIC
/begin CHARACTERISTIC LAMSKAMX "Lambda-Ist vor Kat f¸r Erkennung Magerbedingung Kat-Ausr‰umen" VALUE 0x1C4D1C KwWU16 15.99976 fak_uw_b16 0.00 15.99976 FORMAT "%8.5" /end CHARACTERISTIC
/begin CHARACTERISTIC LAMSKAMX2 "Lambda-Ist vor Kat f¸r Erkennung Magerbedingung Kat-Ausr‰umen, Bank2" VALUE 0x1C4D1E KwWU16 15.99976 fak_uw_b16 0.00 15.99976 FORMAT "%8.5" /end CHARACTERISTIC
/begin CHARACTERISTIC LASHKAB "Startwert f¸r dynamische Sollwertanhebung (lamsolh) in der LRHK" VALUE 0x1C5076 KwWS16 1.999969 fak_sw_b1 -1.000000 0.9999695 FORMAT "%8.6" /end CHARACTERISTIC
/begin CHARACTERISTIC LIMN "Untere Integratorbegrenzung bei stehendem Fahrzeug" VALUE 0x1C6E42 KwUb 24.90 rel_ub_bn24p9 -24.90 0.00 FORMAT "%5.2" /end CHARACTERISTIC
/begin CHARACTERISTIC LIMNDLLR "Untere Integratorbegrenzung bei Diagnose Leerlaufregelung" VALUE 0x1C6E43 KwUb 24.90 rel_ub_bn24p9 -24.90 0.00 FORMAT "%5.2" /end CHARACTERISTIC
/begin CHARACTERISTIC LIMNDTES "Untere Integratorbegrenzung bei DTES" VALUE 0x1C6E44 KwUb 24.90 rel_ub_bn24p9 -24.90 0.00 FORMAT "%5.2" /end CHARACTERISTIC
/begin CHARACTERISTIC LIMNV "Untere Integratorbegrenzung bei rollendem Fahrzeug" VALUE 0x1C6E45 KwUb 24.90 rel_ub_bn24p9 -24.90 0.00 FORMAT "%5.2" /end CHARACTERISTIC
/begin CHARACTERISTIC LIMXDNS "Obere Integratorbegrenzung bei stehendem Fahrzeug" CURVE 0x1CF7B0 GklWUb 24.90 rel_ub_b24p9 0.00 24.90 FORMAT "%5.2"
 /begin AXIS_DESCR COM_AXIS dns nmotd_sb_q10 6 -1280. 1270. AXIS_PTS_REF SNS206LLSB /end AXIS_DESCR
/end CHARACTERISTIC
/begin CHARACTERISTIC LIMXVDNS "Obere Integratorbegrenzung bei rollendem Fahrzeug" CURVE 0x1CF7B8 GklWUb 24.90 rel_ub_b24p9 0.00 24.90 FORMAT "%5.2"
 /begin AXIS_DESCR COM_AXIS dns nmotd_sb_q10 6 -1280. 1270. AXIS_PTS_REF SNS206LLSB /end AXIS_DESCR
/end CHARACTERISTIC
/begin CHARACTERISTIC LISTM "Wert des Leerlaufintegrators im Start" CURVE 0x1CF7C0 GklWUb 24.90 rel_ub_b24p9 0.00 24.90 FORMAT "%5.2"
 /begin AXIS_DESCR COM_AXIS tmot temp_ub_q0p75_o48 6 -48.00 143.3 AXIS_PTS_REF STM06LLUB /end AXIS_DESCR
/end CHARACTERISTIC
/begin CHARACTERISTIC LLRICNF "Configurationsbyte f¸r LLR Integrator" VALUE 0x1C6E46 KwUb 255.0 dez 0.00 255.0 FORMAT "%5.1" /end CHARACTERISTIC
/begin CHARACTERISTIC LRHIMN "minimale Integratorgrenze der stetigen LRHK" VALUE 0x1CD2FA KwWS16 1.999969 fak_sw_b1 -1.000000 0.9999695 FORMAT "%8.6" /end CHARACTERISTIC
/begin CHARACTERISTIC LRHIMX "maximale Integratorgrenze der stetigen LRHK" VALUE 0x1CD2FC KwWS16 1.999969 fak_sw_b1 -1.000000 0.9999695 FORMAT "%8.6" /end CHARACTERISTIC
/begin CHARACTERISTIC LRSGKTM "Korrekturkennlinie der Reglerparameter bei tiefen Motortemperaturen" CURVE 0x1CC070 KlAUbSstUbWUb 1.992 fak_ub_b2 0.00 1.992 FORMAT "%5.3"
 /begin AXIS_DESCR STD_AXIS tmot temp_ub_q0p75_o48 6 -48.00 143.3 FORMAT "%5.1" DEPOSIT ABSOLUTE /end AXIS_DESCR
/end CHARACTERISTIC
/begin CHARACTERISTIC LRSTPZA "Periodendauer der LRS-Zwangsamplitude" VALUE 0x1C4C76 KwUw 655.3500 t10msxs_uw_b655p35 0.00 655.3500 FORMAT "%8.4" /end CHARACTERISTIC
/begin CHARACTERISTIC LRSZAWML "Kennlinie Amplitude der LRS-Zwangsamplitude" CURVE 0x1C4C78 KlAUwSstUwWUb 0.249023438 fak_ub_b0p25 0.00 0.249023438 FORMAT "%11.9"
 /begin AXIS_DESCR STD_AXIS ml_w m_uw_b6553p5 6 0.00 6553.500 FORMAT "%8.3" DEPOSIT ABSOLUTE /end AXIS_DESCR
/end CHARACTERISTIC
/begin CHARACTERISTIC MDGAT "Kennlinie Momenten begrenzung bei zu hoher Abgastemperatur" CURVE 0x1CF076 KlAUwSstUwWUw 99.99847 rel_uw_b100 0.00 99.99847 FORMAT "%8.5"
 /begin AXIS_DESCR STD_AXIS nmot nmot_ub_q40 6 0.00 2621400. FORMAT "%8.0" DEPOSIT ABSOLUTE /end AXIS_DESCR
/end CHARACTERISTIC
/begin CHARACTERISTIC MDHYEZ "Momenten-Hysterese bei Entscheidung der Zylinderausblendung" VALUE 0x1C7C27 KwUb 99.61 rel_ub_b99p6 0.00 99.61 FORMAT "%5.2" /end CHARACTERISTIC
/begin CHARACTERISTIC MDSH "Hˆhenabh‰ngiger Anteil des Schleppmomentes" CURVE 0x1CFBE4 KlAUbSstUbWSb 49.90 rel_q0p1957 -25.05 24.85 FORMAT "%5.2"
 /begin AXIS_DESCR STD_AXIS fho fak_ub_b4 6 0.00 3.984 FORMAT "%5.3" DEPOSIT ABSOLUTE /end AXIS_DESCR
/end CHARACTERISTIC
/begin CHARACTERISTIC MDSM "Schleppmoment Temperaturanteil" CURVE 0x1CFBF2 GklWUw 99.99847 rel_uw_b100 0.00 99.99847 FORMAT "%8.5"
 /begin AXIS_DESCR COM_AXIS tmot temp_ub_q0p75_o48 10 -48.00 143.3 AXIS_PTS_REF STM10__UB /end AXIS_DESCR
/end CHARACTERISTIC
/begin CHARACTERISTIC MDSMNW "Schleppmoment Temperaturanteil bei NW-Verstellung" CURVE 0x1CFC06 GklWUw 99.99847 rel_uw_b100 0.00 99.99847 FORMAT "%8.5"
 /begin AXIS_DESCR COM_AXIS tmot temp_ub_q0p75_o48 10 -48.00 143.3 AXIS_PTS_REF STM10__UB /end AXIS_DESCR
/end CHARACTERISTIC
/begin CHARACTERISTIC MDVGLW "Momentenbedarf der Vorgelegewelle" CURVE 0x1CFC1A KlAUbSstUbWUw 99.99847 rel_uw_b100 0.00 99.99847 FORMAT "%8.5"
 /begin AXIS_DESCR STD_AXIS tmot temp_ub_q0p75_o48 6 -48.00 143.3 FORMAT "%5.1" DEPOSIT ABSOLUTE /end AXIS_DESCR
/end CHARACTERISTIC
/begin CHARACTERISTIC MIKOKSAP "Applikationswert" VALUE 0x1C70C2 KwUw 99.99847 rel_uw_b100 0.00 99.99847 FORMAT "%8.5" /end CHARACTERISTIC
/begin CHARACTERISTIC MLNKAX "Luftmassenschwelle f¸r Einschaltbereitschaft LRSHK I-Anteil" VALUE 0x1CD342 KwWU16 7281.667 m_uw_b7281 0.00 7281.667 FORMAT "%8.3" /end CHARACTERISTIC
/begin CHARACTERISTIC MLNKAX2 "Luftmassenschwelle f¸r Einschaltbereitschaft LRSHK, Bank 2" VALUE 0x1CD344 KwWU16 7281.667 m_uw_b7281 0.00 7281.667 FORMAT "%8.3" /end CHARACTERISTIC
/begin CHARACTERISTIC MLO1 "obere Luftmengenschwelle Bereich 1" VALUE 0x1CDC46 KwUw 6553.500 m_uw_b6553p5 0.00 6553.500 FORMAT "%8.3" /end CHARACTERISTIC
/begin CHARACTERISTIC MLO1AC "obere Luftmengenschwelle Bereich 1 mit Kompressor" VALUE 0x1CDC48 KwUw 6553.500 m_uw_b6553p5 0.00 6553.500 FORMAT "%8.3" /end CHARACTERISTIC
/begin CHARACTERISTIC MLO2 "obere Luftmengenschwelle Bereich 2" VALUE 0x1C5670 KwUw 6553.500 m_uw_b6553p5 0.00 6553.500 FORMAT "%8.3" /end CHARACTERISTIC
/begin CHARACTERISTIC MLO3 "obere Luftmengenschwelle Bereich 3" VALUE 0x1CDC4A KwUw 6553.500 m_uw_b6553p5 0.00 6553.500 FORMAT "%8.3" /end CHARACTERISTIC
/begin CHARACTERISTIC MLO3AC "obere Luftmengenschwelle Bereich 3 mit Kompressor" VALUE 0x1CDC4C KwUw 6553.500 m_uw_b6553p5 0.00 6553.500 FORMAT "%8.3" /end CHARACTERISTIC
/begin CHARACTERISTIC MLU2 "untere Luftmengenschwelle Bereich 2" VALUE 0x1CDC4E KwUw 6553.500 m_uw_b6553p5 0.00 6553.500 FORMAT "%8.3" /end CHARACTERISTIC
/begin CHARACTERISTIC MLU2AC "untere Luftmengenschwelle Bereich 2 mit Kompressor" VALUE 0x1CDC50 KwUw 6553.500 m_uw_b6553p5 0.00 6553.500 FORMAT "%8.3" /end CHARACTERISTIC
/begin CHARACTERISTIC MLU2FA "untere Luftmengenschwelle bei Funktionsanforderung B_faan Bereich 2" VALUE 0x1CDC52 KwUw 6553.500 m_uw_b6553p5 0.00 6553.500 FORMAT "%8.3" /end CHARACTERISTIC
/begin CHARACTERISTIC MLU4 "untere Luftmengenschwelle Bereich 4" VALUE 0x1C5672 KwUw 6553.500 m_uw_b6553p5 0.00 6553.500 FORMAT "%8.3" /end CHARACTERISTIC
/begin CHARACTERISTIC MLU4AC "untere Luftmengenschwelle Bereich 4 mit Kompressor" VALUE 0x1C5674 KwUw 6553.500 m_uw_b6553p5 0.00 6553.500 FORMAT "%8.3" /end CHARACTERISTIC
/begin CHARACTERISTIC N0 "Umrechnungskonstante f¸r Einrechnung Gemischkorrektur rkat" VALUE 0x1C566E KwUb 10200. nmot_ub_q40 0.00 10200. FORMAT "%5.0" /end CHARACTERISTIC
/begin CHARACTERISTIC NGFSAWE "Schwelle Drehzahlgradient f¸r Sperrung Filter SA/WE" VALUE 0x1C70C4 KwSw 25599.94 nmotg_sw_q0p39 -12800.16 12799.77 FORMAT "%8.2" /end CHARACTERISTIC
/begin CHARACTERISTIC NLLRRI "‹berdrehzahlschwelle f¸r Integratorreset (Kurztrip)" VALUE 0x1CF7EA KwUw 16384.00 nmot_uw_q0p25 0.00 16384.00 FORMAT "%8.2" /end CHARACTERISTIC
/begin CHARACTERISTIC NLRHO "obere Drehzahlgrenze f¸r Regelung hinter Kat" VALUE 0x1CD34C KwWU8 10200. nmot_ub_q40 0.00 10200. FORMAT "%5.0" /end CHARACTERISTIC
/begin CHARACTERISTIC NLRHU "untere Drehzahlgrenze f¸r Regelung hinter Kat" VALUE 0x1CD34D KwWU8 10200. nmot_ub_q40 0.00 10200. FORMAT "%5.0" /end CHARACTERISTIC
/begin CHARACTERISTIC NLRKA "Drehzahlschwelle f¸r Unterdr¸cken gesteuertes Kat-Ausr‰umen" VALUE 0x1C4D2F KwWU8 10200. nmot_ub_q40 0.00 10200. FORMAT "%5.0" /end CHARACTERISTIC
/begin CHARACTERISTIC NLRSHB "Drehzahlschwelle, Abschalten LR bei Schub, in Verbindung mit LL und TLLRSHB" VALUE 0x1C4C9D KwUb 10200. nmot_ub_q40 0.00 10200. FORMAT "%5.0" /end CHARACTERISTIC
/begin CHARACTERISTIC NMOTZFLBK "Drehzahlschwelle f¸r Z¸ndwinkelfreigabe bei Stellen Ladungsbewegungsklappe" VALUE 0x1C70F0 KwUb 10200. nmot_ub_q40 0.00 10200. FORMAT "%5.0" /end CHARACTERISTIC
/begin CHARACTERISTIC NO1 "obere Drehzahlschwelle Bereich 1" VALUE 0x1CDC25 KwUb 10200. nmot_ub_q40 0.00 10200. FORMAT "%5.0" /end CHARACTERISTIC
/begin CHARACTERISTIC NO2 "obere Drehzahlschwelle Bereich 2" VALUE 0x1CDC26 KwUb 10200. nmot_ub_q40 0.00 10200. FORMAT "%5.0" /end CHARACTERISTIC
/begin CHARACTERISTIC NOLRA "Codewort f¸r Adaptionsfreigabe" VALUE 0x1CDC27 KwUb 255.0 dez 0.00 255.0 FORMAT "%5.1" /end CHARACTERISTIC
/begin CHARACTERISTIC NRKAB "Mindestdrehzahl f¸r Begrenzung Stelleingriff rkat bei niedrigen Drehzahlen" VALUE 0x1C566F KwUb 10200. nmot_ub_q40 0.00 10200. FORMAT "%5.0" /end CHARACTERISTIC
/begin CHARACTERISTIC NU2 "untere Drehzahlschwelle Bereich 2" VALUE 0x1CDC28 KwUb 10200. nmot_ub_q40 0.00 10200. FORMAT "%5.0" /end CHARACTERISTIC
/begin CHARACTERISTIC NU3 "untere Drehzahlschwelle Bereich 3" VALUE 0x1CDC29 KwUb 10200. nmot_ub_q40 0.00 10200. FORMAT "%5.0" /end CHARACTERISTIC
/begin CHARACTERISTIC PLRHAV "Wichtungsfaktor des P-Anteils in der LRHK ¸ber KAT-Alterung" CURVE 0x1CD2D0 KlAxU8SstxU8WU8 0.9961 fak_ub_b1 0.00 0.9961 /begin AXIS_DESCR STD_AXIS avkatf fak_ub_b1 8 0.00 0.9961 DEPOSIT ABSOLUTE /end AXIS_DESCR /end CHARACTERISTIC
/begin CHARACTERISTIC PLRHAV2 "Wichtungsfaktor des P-Anteils in der LRHK ¸ber KAT-Alterung Bank 2" CURVE 0x1CD2E4 KlAxU8SstxU8WU8 0.9961 fak_ub_b1 0.00 0.9961 /begin AXIS_DESCR STD_AXIS avkatf2 fak_ub_b1 8 0.00 0.9961 DEPOSIT ABSOLUTE /end AXIS_DESCR /end CHARACTERISTIC
/begin CHARACTERISTIC PVDNHOM "P-Reglerparameter bei Homogenbetrieb" CURVE 0x1C6E48 GklWUb 0.3891 fak_q0p00153 0.00 0.3891
 /begin AXIS_DESCR COM_AXIS dn_w nmot_sw_q0p25 10 -8192.000 8191.750 AXIS_PTS_REF SDN10LLSW /end AXIS_DESCR
/end CHARACTERISTIC
/begin CHARACTERISTIC PVDNHOMV "P-Reglerparamter bei Homogenbetrieb und Kraftschluﬂ" CURVE 0x1C6E54 GklWUb 0.3891 fak_q0p00153 0.00 0.3891
 /begin AXIS_DESCR COM_AXIS dn_w nmot_sw_q0p25 10 -8192.000 8191.750 AXIS_PTS_REF SDN10LLSW /end AXIS_DESCR
/end CHARACTERISTIC
/begin CHARACTERISTIC PVDNKFKH "LLR: P-Verst‰rkung bei stehendem Fahrzeug (Kat-heizung)" MAP 0x1CF7C6 KfAxUbAyUbSstxSbSstyUbWUb 0.3891 fak_q0p00153 0.00 0.3891
 /begin AXIS_DESCR STD_AXIS dns nmotd_sb_q10 6 -1280. 1270. FORMAT "%5.0" DEPOSIT ABSOLUTE /end AXIS_DESCR
 /begin AXIS_DESCR STD_AXIS nmotll nmot_ub_q10 4 0.00 2550. FORMAT "%5.0" DEPOSIT ABSOLUTE /end AXIS_DESCR
/end CHARACTERISTIC
/begin CHARACTERISTIC PVDNSTW "Kennlinie P-Verst‰rkung bei Start" CURVE 0x1C6E60 GklWUb 0.3891 fak_q0p00153 0.00 0.3891
 /begin AXIS_DESCR COM_AXIS dn_w nmot_sw_q0p25 10 -8192.000 8191.750 AXIS_PTS_REF SDN10LLSW /end AXIS_DESCR
/end CHARACTERISTIC
/begin CHARACTERISTIC PVLDNEZ "LLR: P-Verst‰rkung bei stehendem Fahrzeug (Luftanteil)" MAP 0x1C6E6C GkfWUb 0.3891 fak_q0p00153 0.00 0.3891
 /begin AXIS_DESCR COM_AXIS dn_w nmot_sw_q0p25 10 -8192.000 8191.750 AXIS_PTS_REF SDN10LLSW /end AXIS_DESCR
 /begin AXIS_DESCR COM_AXIS etazws rel_ub_b127p5 4 0.00 127.5 AXIS_PTS_REF SEZ04LLUB /end AXIS_DESCR
/end CHARACTERISTIC
/begin CHARACTERISTIC PVLDNEZKH "P-Anteil der LLR auf dem Luftpfad bei Katheizen" MAP 0x1C6E94 GkfWUb 0.3891 fak_q0p00153 0.00 0.3891
 /begin AXIS_DESCR COM_AXIS dn_w nmot_sw_q0p25 10 -8192.000 8191.750 AXIS_PTS_REF SDN10LLSW /end AXIS_DESCR
 /begin AXIS_DESCR COM_AXIS etazws rel_ub_b127p5 4 0.00 127.5 AXIS_PTS_REF SEZ04LLUB /end AXIS_DESCR
/end CHARACTERISTIC
/begin CHARACTERISTIC PVLDNEZV "LLR: P-Verst‰rkung bei stehendem Fahrzeug (Luftanteil)" MAP 0x1C6EBC GkfWUb 0.3891 fak_q0p00153 0.00 0.3891
 /begin AXIS_DESCR COM_AXIS dn_w nmot_sw_q0p25 10 -8192.000 8191.750 AXIS_PTS_REF SDN10LLSW /end AXIS_DESCR
 /begin AXIS_DESCR COM_AXIS etazws rel_ub_b127p5 4 0.00 127.5 AXIS_PTS_REF SEZ04LLUB /end AXIS_DESCR
/end CHARACTERISTIC
/begin CHARACTERISTIC REDHYOC "Hysterese der Reduzierstufe bei grˆﬂerer Soll-Reduzierstufe als Ist-Wert" VALUE 0x1C7C28 KwSb 3.984 fak_sb_b2 -2.000 1.984 FORMAT "%5.3" /end CHARACTERISTIC
/begin CHARACTERISTIC REDHYUC "Hysterese der Reduzierstufe bei kleinerer Soll-Reduzierstufe als Ist-Wert" VALUE 0x1C7C29 KwSb 3.984 fak_sb_b2 -2.000 1.984 FORMAT "%5.3" /end CHARACTERISTIC
/begin CHARACTERISTIC REDMXSA "maximale Reduzierstufe bei sequentieller Schubabschaltung" VALUE 0x1C7C2A KwUb 255.0 dez 0.00 255.0 FORMAT "%5.1" /end CHARACTERISTIC
/begin CHARACTERISTIC REDNMX "maximale Reduzierstufe bei sequentieller Schubabschaltung, Drehzahlbegrenzung" VALUE 0x1C7C2B KwUb 255.0 dez 0.00 255.0 FORMAT "%5.1" /end CHARACTERISTIC
/begin CHARACTERISTIC REDZEM "Schwelle zwischen Z¸ndeingriff und Einspritzausblendung" CURVE 0x1CFE50 KlAUbSstUbWUb 255.0 dez 0.00 255.0 FORMAT "%5.1"
 /begin AXIS_DESCR STD_AXIS tmot temp_ub_q0p75_o48 5 -48.00 143.3 FORMAT "%5.1" DEPOSIT ABSOLUTE /end AXIS_DESCR
/end CHARACTERISTIC
/begin CHARACTERISTIC REDZEMNL "Schwelle zwischen Z¸ndeingriff und Einspritzausblendung, Notlauf" CURVE 0x1CFE5C KlAUbSstUbWUb 255.0 dez 0.00 255.0 FORMAT "%5.1"
 /begin AXIS_DESCR STD_AXIS tmot temp_ub_q0p75_o48 5 -48.00 143.3 FORMAT "%5.1" DEPOSIT ABSOLUTE /end AXIS_DESCR
/end CHARACTERISTIC
/begin CHARACTERISTIC RKATMN "untere Schwelle additive Korrektur pro Zeit" VALUE 0x1CDC54 KwSw 383.9941 rel_sw_b192 -192.0000 191.9941 FORMAT "%8.4" /end CHARACTERISTIC
/begin CHARACTERISTIC RKATMX "obere Schwelle additive Korrektur pro Zeit" VALUE 0x1CDC56 KwSw 383.9941 rel_sw_b192 -192.0000 191.9941 FORMAT "%8.4" /end CHARACTERISTIC
/begin CHARACTERISTIC RKATRN "reduzierte untere Schwelle additive Korrektur pro Zeit" VALUE 0x1CDC58 KwSw 383.9941 rel_sw_b192 -192.0000 191.9941 FORMAT "%8.4" /end CHARACTERISTIC
/begin CHARACTERISTIC RKATRX "reduzierte obere Schwelle additive Korrektur pro Zeit" VALUE 0x1CDC5A KwSw 383.9941 rel_sw_b192 -192.0000 191.9941 FORMAT "%8.4" /end CHARACTERISTIC
/begin CHARACTERISTIC RKAZMN "untere Schwelle additive Korrektur pro Z¸ndung" VALUE 0x1CDC5C KwSw 383.9941 rel_sw_b192 -192.0000 191.9941 FORMAT "%8.4" /end CHARACTERISTIC
/begin CHARACTERISTIC RKAZMX "obere Schwelle additive Korrektur pro Z¸ndung" VALUE 0x1CDC5E KwSw 383.9941 rel_sw_b192 -192.0000 191.9941 FORMAT "%8.4" /end CHARACTERISTIC
/begin CHARACTERISTIC RKAZRN "reduzierte untere Schwelle additive Korrektur pro Z¸ndung" VALUE 0x1CDC60 KwSw 383.9941 rel_sw_b192 -192.0000 191.9941 FORMAT "%8.4" /end CHARACTERISTIC
/begin CHARACTERISTIC RKAZRX "reduzierte obere Schwelle additive Korrektur pro Z¸ndung" VALUE 0x1CDC62 KwSw 383.9941 rel_sw_b192 -192.0000 191.9941 FORMAT "%8.4" /end CHARACTERISTIC
/begin CHARACTERISTIC RLLRHON "Kennlinie ¸ber nmot, obere rL Regelgrenze f¸r Regler hinter KAT" CURVE 0x1CD328 GklWU8 191.3 rel_ub_q0p75 0.00 191.3 FORMAT "%5.1"
 /begin AXIS_DESCR COM_AXIS nmot nmot_ub_q40 8 0.00 10200. AXIS_PTS_REF SNM08LHUB /end AXIS_DESCR
/end CHARACTERISTIC
/begin CHARACTERISTIC RLLRHUN "Kennlinie ¸ber nmot, untere rL Regelgrenze f¸r Regler hinter KAT" CURVE 0x1CD330 GklWU8 191.3 rel_ub_q0p75 0.00 191.3 FORMAT "%5.1"
 /begin AXIS_DESCR COM_AXIS nmot nmot_ub_q40 8 0.00 10200. AXIS_PTS_REF SNM08LHUB /end AXIS_DESCR
/end CHARACTERISTIC
/begin CHARACTERISTIC RLLRSHB "relative Lastschwelle, Abschalten LR bei SLS, in Verbindung mit LL und NLRSHB" VALUE 0x1C4C9E KwUb 191.3 rel_ub_q0p75 0.00 191.3 FORMAT "%5.1" /end CHARACTERISTIC
/begin CHARACTERISTIC RLLRUN "Kennlinie ¸ber nmot, untere rL Regelgrenze f¸r Regler vor KAT" CURVE 0x1C4CA0 KlAUbSstUbWUb 191.3 rel_ub_q0p75 0.00 191.3 FORMAT "%5.1"
 /begin AXIS_DESCR STD_AXIS nmot nmot_ub_q40 8 0.00 10200. FORMAT "%5.0" DEPOSIT ABSOLUTE /end AXIS_DESCR
/end CHARACTERISTIC
/begin CHARACTERISTIC RLO2 "obere Lastschwelle Bereich 2" VALUE 0x1CDC2A KwUb 191.3 rel_ub_q0p75 0.00 191.3 FORMAT "%5.1" /end CHARACTERISTIC
/begin CHARACTERISTIC RLO3 "obere rl - Schwelle Bereich 3" VALUE 0x1CDC2B KwUb 191.3 rel_ub_q0p75 0.00 191.3 FORMAT "%5.1" /end CHARACTERISTIC
/begin CHARACTERISTIC RLO3AC "obere rl - Schwelle Bereich 3 mit kompressor" VALUE 0x1CDC2C KwUb 191.3 rel_ub_q0p75 0.00 191.3 FORMAT "%5.1" /end CHARACTERISTIC
/begin CHARACTERISTIC RLSLSMN "min. rl f¸r Freigabe Regelung w‰hrend Sekund‰rluft" CURVE 0x1C4CB4 KlAUbSstUbWUb 191.3 rel_ub_q0p75 0.00 191.3 FORMAT "%5.1"
 /begin AXIS_DESCR STD_AXIS nmot nmot_ub_q40 4 0.00 10200. FORMAT "%5.0" DEPOSIT ABSOLUTE /end AXIS_DESCR
/end CHARACTERISTIC
/begin CHARACTERISTIC RLU2 "untere rl - Schwelle Bereich 2" VALUE 0x1CDC2D KwUb 191.3 rel_ub_q0p75 0.00 191.3 FORMAT "%5.1" /end CHARACTERISTIC
/begin CHARACTERISTIC RLU2AC "untere rl - Schwelle Bereich 2 mit Kompressor" VALUE 0x1CDC2E KwUb 191.3 rel_ub_q0p75 0.00 191.3 FORMAT "%5.1" /end CHARACTERISTIC
/begin CHARACTERISTIC RLU3 "untere rl - Schwelle Bereich 3" VALUE 0x1CDC2F KwUb 191.3 rel_ub_q0p75 0.00 191.3 FORMAT "%5.1" /end CHARACTERISTIC
/begin CHARACTERISTIC RLU4 "untere rl -Schwelle oberer multiplikativer Bereich" VALUE 0x1CDC30 KwUb 191.3 rel_ub_q0p75 0.00 191.3 FORMAT "%5.1" /end CHARACTERISTIC
/begin CHARACTERISTIC RLU4AC "untere rl -Schwelle oberer multiplikativer Bereich mit Kompressor" VALUE 0x1CDC31 KwUb 191.3 rel_ub_q0p75 0.00 191.3 FORMAT "%5.1" /end CHARACTERISTIC
/begin AXIS_PTS SDN10LLSW "St¸tzstellenverteilung Addressierung Leerlaufregelparameter" 0x1C6F80 dn_w SstASwSstSw 16383.75 nmot_sw_q0p25 10 -8192.000 8191.750 FORMAT "%8.3" DEPOSIT ABSOLUTE /end AXIS_PTS
/begin AXIS_PTS SEZ04LLUB "St¸tzstellenverteilung Z¸ndwinkelwirkungsgrad f¸r PD-Regler" 0x1C6EE4 etazws SstAUbSstUb 127.5 rel_ub_b127p5 4 0.00 127.5 FORMAT "%5.1" DEPOSIT ABSOLUTE /end AXIS_PTS
/begin AXIS_PTS SM109LHSW "dlashk_w abh‰ngige St¸tzstellen (Anzahl 9)" 0x1CD2FE dlashkm_w SstAU8SstS16 1.999969 fak_sw_b1 9 -1.000000 0.9999695 FORMAT "%8.6" DEPOSIT ABSOLUTE /end AXIS_PTS
/begin AXIS_PTS SM209LHSW "dlashk2_w abh‰ngige St¸tzstellen (Anzahl 9)" 0x1CD312 dlashkm2_w SstAU8SstS16 1.999969 fak_sw_b1 9 -1.000000 0.9999695 FORMAT "%8.6" DEPOSIT ABSOLUTE /end AXIS_PTS
/begin AXIS_PTS SML08LHUB "ml abh‰ngige St¸tzstellen (Anzahl 8)" 0x1CEDDC ml SstAUbSstUb 1020. m_ub_b1020 8 0.00 1020. FORMAT "%5.0" DEPOSIT ABSOLUTE /end AXIS_PTS
/begin AXIS_PTS SNG06LLSB "St¸tzstellenverteilung Drehzahlgradient, 6 Sst." 0x1C674C ngfil SstAUbSstSb 25500. nmotg_sb_q100 6 -12800. 12700. FORMAT "%5.0" DEPOSIT ABSOLUTE /end AXIS_PTS
/begin AXIS_PTS SNM06LLUB "S¸tzstellenverteilung f¸r Motordrehzahl" 0x1C6754 nmot SstAUbSstUb 10200. nmot_ub_q40 6 0.00 10200. FORMAT "%5.0" DEPOSIT ABSOLUTE /end AXIS_PTS
/begin AXIS_PTS SNM07LSUW "St¸tzstellenverteilung Reglerparameter LRS" 0x1C68D2 nmot_w SstAUwSstUw 16383.75 nmot_uw_q0p25 7 0.00 16383.75 FORMAT "%8.2" DEPOSIT ABSOLUTE /end AXIS_PTS
/begin AXIS_PTS SNM08LHUB "nmot abh‰ngige St¸tzstellen (Anzahl 8)" 0x1CEDF8 nmot SstAUbSstUb 10200. nmot_ub_q40 8 0.00 10200. FORMAT "%5.0" DEPOSIT ABSOLUTE /end AXIS_PTS
/begin AXIS_PTS SNM10LSUB "St¸tzstellenverteilung Kat-Vorsteuerwert LRS" 0x1C6794 nmot SstAUbSstUb 10200. nmot_ub_q40 10 0.00 10200. FORMAT "%5.0" DEPOSIT ABSOLUTE /end AXIS_PTS
/begin AXIS_PTS SNM16OPUW "St¸tzstellenverteilung Drehzahl" 0x1C68E2 nmot_w SstAUwSstUw 16383.75 nmot_uw_q0p25 16 0.00 16383.75 FORMAT "%8.2" DEPOSIT ABSOLUTE /end AXIS_PTS
/begin AXIS_PTS SNS06LLSB "St¸tzstellenvert., Solldrehzahlabw., 06 Sst., LL-Regel." 0x1CF76C dns SstAUbSstSb 2550. nmotd_sb_q10 6 -1280. 1270. FORMAT "%5.0" DEPOSIT ABSOLUTE /end AXIS_PTS
/begin AXIS_PTS SNS206LLSB "" 0x1C6EEC dns SstAUbSstSb 2550. nmotd_sb_q10 6 -1280. 1270. FORMAT "%5.0" DEPOSIT ABSOLUTE /end AXIS_PTS
/begin CHARACTERISTIC SRKTEVS "Saugrohrkonstante bei Schlieﬂen des Tankentl¸ftungsventil" VALUE 0x1C6EF3 KwUb 5.080 t20msxs_ub_b5p1 0.02000 5.100 FORMAT "%5.3" /end CHARACTERISTIC
/begin AXIS_PTS SRL08LSUW "St¸tzstellenverteilung Reglerparameter" 0x1C6926 rl_w SstAUwSstUw 1535.977 rel_uw_q0p0234 8 0.00 1535.977 FORMAT "%8.3" DEPOSIT ABSOLUTE /end AXIS_PTS
/begin AXIS_PTS SRL10LSUB "St¸tzstellenverteilung Kat-Vorsteuerwert LRS" 0x1C6814 rl SstAUbSstUb 191.3 rel_ub_q0p75 10 0.00 191.3 FORMAT "%5.1" DEPOSIT ABSOLUTE /end AXIS_PTS
/begin AXIS_PTS SRL11OPUW "St¸tzstellenverteilung relative Luftf¸llung" 0x1C7894 rl_w SstAUwSstUw 1535.977 rel_uw_q0p0234 11 0.00 1535.977 FORMAT "%8.3" DEPOSIT ABSOLUTE /end AXIS_PTS
/begin AXIS_PTS STM06LLUB "St¸tzstellenverteilung Motortemperatur, 6 Sst." 0x1CEE88 tmot SstAUbSstUb 191.3 temp_ub_q0p75_o48 6 -48.00 143.3 FORMAT "%5.1" DEPOSIT ABSOLUTE /end AXIS_PTS
/begin AXIS_PTS STM10__UB "" 0x1CEEBC tmot SstAUbSstUb 191.3 temp_ub_q0p75_o48 10 -48.00 143.3 FORMAT "%5.1" DEPOSIT ABSOLUTE /end AXIS_PTS
/begin CHARACTERISTIC TAGAT "Zeitkonstante Abregelung Momenten begrenzung" VALUE 0x1CF071 KwUb 25.4996 zk100msxs_ub_b25p5 0.100392 25.6000 FORMAT "%7.4" /end CHARACTERISTIC
/begin CHARACTERISTIC TARA "Temperaturschwelle Ansaugluft" VALUE 0x1C5676 KwUb 191.3 temp_ub_q0p75_o48 -48.00 143.3 FORMAT "%5.1" /end CHARACTERISTIC
/begin CHARACTERISTIC TARAU "Ansauglufttemperaturschwelle f¸r Einschalten der Lambda - Regelung" VALUE 0x1C4CBD KwUb 191.3 temp_ub_q0p75_o48 -48.00 143.3 FORMAT "%5.1" /end CHARACTERISTIC
/begin CHARACTERISTIC TASHS "Schwelle Ansauglufttemp. f¸r Auslˆsung TLRHS - Sperrzeit LR bei Heiﬂstart" VALUE 0x1C4CBE KwUb 191.3 temp_ub_q0p75_o48 -48.00 143.3 FORMAT "%5.1" /end CHARACTERISTIC
/begin CHARACTERISTIC TAUIDEC "Zeitkonstante Absteuern Integralanteil bei Grenzwertregelung LRS" VALUE 0x1C4C8C KwUw 655.350000 zk10msxs_uw_b655 0.0100001526 655.360000 FORMAT "%10.6" /end CHARACTERISTIC
/begin CHARACTERISTIC TBLRH "Sperrzeit f¸r Regelung hinter Kat nach Freigabe durch Regelung vor Kat" VALUE 0x1CD34E KwWU8 25.50 t100msxs_ub_b25p5 0.00 25.50 FORMAT "%5.2" /end CHARACTERISTIC
/begin CHARACTERISTIC TBLRH2 "Sperrzeit f¸r Regelung hinter Kat nach Freigabe durch Regelung vor Kat Bank 2" VALUE 0x1CD34F KwWU8 25.50 t100msxs_ub_b25p5 0.00 25.50 FORMAT "%5.2" /end CHARACTERISTIC
/begin CHARACTERISTIC TDLAKAD "Absteuerzeit von lamka_w f¸r gesteuertes Katalysator-Ausr‰umen" VALUE 0x1C4D20 KwWU16 1310.680 t20msxs_uw_q0p02 0.02000000 1310.700 FORMAT "%8.3" /end CHARACTERISTIC
/begin CHARACTERISTIC TDLAKAU "Aufsteuerzeit von lamka_w f¸r gesteuertes Katalysator-Ausr‰umen" VALUE 0x1C4D22 KwWU16 1310.680 t20msxs_uw_q0p02 0.02000000 1310.700 FORMAT "%8.3" /end CHARACTERISTIC
/begin CHARACTERISTIC TDMFBSA "Zeitkonstante PT1-Filter beim Schubabschalten" VALUE 0x1C70C6 KwUw 655.350000 zk10msxs_uw_b655 0.0100001526 655.360000 FORMAT "%10.6" /end CHARACTERISTIC
/begin CHARACTERISTIC TDMFBWE "Zeitkonstante PT1-Filter beim weichen Wiedereinsetzen" VALUE 0x1C70C8 KwUw 655.350000 zk10msxs_uw_b655 0.0100001526 655.360000 FORMAT "%10.6" /end CHARACTERISTIC
/begin CHARACTERISTIC TDMFWEMI "Filterzeitkonstante beim harten Wiedereinsetzen" CURVE 0x1C70CA KlAUwSstUwWUw 655.349999 zk10msxs_uw_b655 0.0100009156 655.360000 FORMAT "%10.6"
 /begin AXIS_DESCR STD_AXIS miagkbe_w rel_uw_b100 8 0.00 99.99847 FORMAT "%8.5" DEPOSIT ABSOLUTE /end AXIS_DESCR
/end CHARACTERISTIC
/begin CHARACTERISTIC TDRLLRHKX "Entprellzeit Delta-rl-Bedingung  f¸r Ausblendung I-Anteil" VALUE 0x1CD350 KwWU8 25.50 t100msxs_ub_b25p5 0.00 25.50 FORMAT "%5.2" /end CHARACTERISTIC
/begin CHARACTERISTIC TGAALTWR "Zeit Zeitkonstante f¸rs R¸cksetzen  der Gemischkorrektur auf letzten Tripwert" VALUE 0x1CDC64 KwUw 4.999924 zk200msxs_uw_b5 0.00 4.999924 FORMAT "%8.6" /end CHARACTERISTIC
/begin CHARACTERISTIC THDMB "Heilungs-Entprellzeit des Fehleintrags f¸r dauerhafte Momentbegrenzung" VALUE 0x1CFE4C KwUw 65535.00 t1sxs_uw_b65535 0.00 65535.00 FORMAT "%8.2" /end CHARACTERISTIC
/begin CHARACTERISTIC TKATMLRH "Einschaltschwelle Kat-Modelltemperatur  f¸r Lambdaregelung hinter Kat" VALUE 0x1CD346 KwWU16 1535.977 temp_q0p0234_o273 -273.1500 1262.827 FORMAT "%8.3" /end CHARACTERISTIC
/begin CHARACTERISTIC TKATMLRH2 "Einschaltschwelle Kat-Modelltemperatur  f¸r Lambdaregelung hinter Kat, Bank 2" VALUE 0x1CD348 KwWU16 1535.977 temp_q0p0234_o273 -273.1500 1262.827 FORMAT "%8.3" /end CHARACTERISTIC
/begin CHARACTERISTIC TKATSZA "Kat-Temperaturschwelle f¸r Freigabe der Zwangsamplitude" VALUE 0x1C4C8E KwUw 1279.980 temp_uw_q0p0195_o50 -50.00000 1229.980 FORMAT "%8.3" /end CHARACTERISTIC
/begin CHARACTERISTIC TKATSZA2 "Kat-Temperaturschwelle f¸r Freigabe der Zwangsamplitude, Bank 2" VALUE 0x1C4C90 KwUw 1279.980 temp_uw_q0p0195_o50 -50.00000 1229.980 FORMAT "%8.3" /end CHARACTERISTIC
/begin CHARACTERISTIC TKIHKM2RED "Temperaturschwelle f¸r zylinderindividuelle Einspritzausblendung, Hauptkat Bank2" VALUE 0x1CFE68 KwUw 1535.977 temp_q0p0234_o273 -273.1500 1262.827 FORMAT "%8.3" /end CHARACTERISTIC
/begin CHARACTERISTIC TKIHKMRED "Temperaturschwelle f¸r zylinderindividuelle Einspritzausblendung, Hauptkat" VALUE 0x1CFE6A KwUw 1535.977 temp_q0p0234_o273 -273.1500 1262.827 FORMAT "%8.3" /end CHARACTERISTIC
/begin CHARACTERISTIC TKIVKM2RED "Temperaturschwelle f¸r zylinderindividuelle Einspritzausblendung, Vorkat Bank2" VALUE 0x1CFE6C KwUw 1535.977 temp_q0p0234_o273 -273.1500 1262.827 FORMAT "%8.3" /end CHARACTERISTIC
/begin CHARACTERISTIC TKIVKMRED "Temperaturschwelle f¸r zylinderindividuelle Einspritzausblendung, Vorkat" VALUE 0x1CFE6E KwUw 1535.977 temp_q0p0234_o273 -273.1500 1262.827 FORMAT "%8.3" /end CHARACTERISTIC
/begin CHARACTERISTIC TLAKAMN "Mindestdauer Bed. lamsbrs_w oder lamsons_w > 1.0 f¸r Funktion Kat.-Ausr‰umen" VALUE 0x1C4D30 KwWU8 5.100 t20msxs_ub_b5p1 0.00 5.100 FORMAT "%5.3" /end CHARACTERISTIC
/begin CHARACTERISTIC TLAKAMN2 "Min. Dauer Bed. lamsbrs2_w or lamsons2_w > 1.0 f¸r Funktion Kat.-Ausr‰umen" VALUE 0x1C4D31 KwWU8 5.100 t20msxs_ub_b5p1 0.00 5.100 FORMAT "%5.3" /end CHARACTERISTIC
/begin CHARACTERISTIC TLAMSBRS "Entprellzeit  Sperre I-Anteil nach Auslˆsung durch Lambda-Bedingung" VALUE 0x1CD351 KwWU8 25.50 t100msxs_ub_b25p5 0.00 25.50 FORMAT "%5.2" /end CHARACTERISTIC
/begin CHARACTERISTIC TLRBAM "Sperrzeit f¸r Einschalten LR nach BA" CURVE 0x1C4CCC KlAUbSstUbWUw 655.3500 t10msxs_uw_b655p35 0.00 655.3500 FORMAT "%8.4"
 /begin AXIS_DESCR STD_AXIS tmot temp_ub_q0p75_o48 8 -48.00 143.3 FORMAT "%5.1" DEPOSIT ABSOLUTE /end AXIS_DESCR
/end CHARACTERISTIC
/begin CHARACTERISTIC TLRHS "Sperrzeit LR bei Heiﬂstart, ausgelˆst ¸ber Schwellen TASHS und TMSHS" VALUE 0x1CC392 KwUb 25.50 t100msxs_ub_b25p5 0.00 25.50 FORMAT "%5.2" /end CHARACTERISTIC
/begin CHARACTERISTIC TLRSZWSA "Zeitdauer f¸r LRS-Zwangseinschaltung nach Schubabschneiden" VALUE 0x1CC3A6 KwUw 6553.500 t100msxs_uw_b6553p5 0.00 6553.500 FORMAT "%8.3" /end CHARACTERISTIC
/begin CHARACTERISTIC TLRTMS "Sperrzeit LR nach Start, abh‰ngig von der Motortemperatur bei Start" CURVE 0x1CC3A8 KlAUbSstUbWUw 6553.500 t100msxs_uw_b6553p5 0.00 6553.500 FORMAT "%8.3"
 /begin AXIS_DESCR STD_AXIS tmst temp_ub_q0p75_o48 5 -48.00 143.3 FORMAT "%5.1" DEPOSIT ABSOLUTE /end AXIS_DESCR
/end CHARACTERISTIC
/begin CHARACTERISTIC TLRVAM "Sperrzeit f¸r Einschalten LR nach VA" CURVE 0x1C4CE6 KlAUbSstUbWUw 655.3500 t10msxs_uw_b655p35 0.00 655.3500 FORMAT "%8.4"
 /begin AXIS_DESCR STD_AXIS tmot temp_ub_q0p75_o48 8 -48.00 143.3 FORMAT "%5.1" DEPOSIT ABSOLUTE /end AXIS_DESCR
/end CHARACTERISTIC
/begin CHARACTERISTIC TLRZWTMS "Zeit f¸r Zwangseinschaltung LR (CARB-Forderung) nach Start" CURVE 0x1CC3B8 KlAUbSstUbWUw 6553.500 t100msxs_uw_b6553p5 0.00 6553.500 FORMAT "%8.3"
 /begin AXIS_DESCR STD_AXIS tmst temp_ub_q0p75_o48 4 -48.00 143.3 FORMAT "%5.1" DEPOSIT ABSOLUTE /end AXIS_DESCR
/end CHARACTERISTIC
/begin CHARACTERISTIC TMAXSAWE "Maximale zul‰ssige Zeit f¸r zylinder individualle ausblendung" VALUE 0x1C7C2C KwUb 25.50 t100msxs_ub_b25p5 0.00 25.50 FORMAT "%5.2" /end CHARACTERISTIC
/begin CHARACTERISTIC TMAXZFLBK "maximale Zeit f¸r Z¸ndwinkelfreigabe durch Ladungsbewegungsklappe" VALUE 0x1C70F1 KwUb 25.50 t_q0p1 0.00 25.50 FORMAT "%5.2" /end CHARACTERISTIC
/begin CHARACTERISTIC TMDMAD "Motortemperaturschwelle f¸r Freigabe der Adaption des Verlustmoments" VALUE 0x1CFC54 KwUb 191.3 temp_ub_q0p75_o48 -48.00 143.3 FORMAT "%5.1" /end CHARACTERISTIC
/begin CHARACTERISTIC TMEWRAA "Einschalttemperatur LRA bezogen auf die modellierte Motortemperatur" VALUE 0x1CDCA0 KwUb 191.3 temp_ub_q0p75_o48 -48.00 143.3 FORMAT "%5.1" /end CHARACTERISTIC
/begin CHARACTERISTIC TMFRATMN "minimale Temperatur bei der ftklra_w = 1 ist" VALUE 0x1CDC32 KwUb 191.3 temp_ub_q0p75_o48 -48.00 143.3 FORMAT "%5.1" /end CHARACTERISTIC
/begin CHARACTERISTIC TMFRATUB "untere Temperaturschwelle  bei der ftklra_w Konstant bleibt" VALUE 0x1CDC33 KwUb 191.3 temp_ub_q0p75_o48 -48.00 143.3 FORMAT "%5.1" /end CHARACTERISTIC
/begin CHARACTERISTIC TMLRZAMN "Minimale Motortemperatur f¸r Zusatzamplitude" VALUE 0x1C4B0D KwUb 191.3 temp_ub_q0p75_o48 -48.00 143.3 FORMAT "%5.1" /end CHARACTERISTIC
/begin CHARACTERISTIC TMRA1 "Ausschaltbedingung (S_LL = 0)" VALUE 0x1C4CBF KwUb 191.3 temp_ub_q0p75_o48 -48.00 143.3 FORMAT "%5.1" /end CHARACTERISTIC
/begin CHARACTERISTIC TMRA2 "Ausschaltbedingung (S_LL = 1)" VALUE 0x1C4CC0 KwUb 191.3 temp_ub_q0p75_o48 -48.00 143.3 FORMAT "%5.1" /end CHARACTERISTIC
/begin CHARACTERISTIC TMRAA "Einschalttemperatur LRA" VALUE 0x1CDCA1 KwUb 191.3 temp_ub_q0p75_o48 -48.00 143.3 FORMAT "%5.1" /end CHARACTERISTIC
/begin CHARACTERISTIC TMRAK "Ausschaltschwelle der Lambda - Regelung bei niedriger Starttemperatur" VALUE 0x1C4CC1 KwUb 191.3 temp_ub_q0p75_o48 -48.00 143.3 FORMAT "%5.1" /end CHARACTERISTIC
/begin CHARACTERISTIC TMSHS "Schwelle Motortemp. f¸r Auslˆsung TLRHS - Sperrzeit LR bei Heiﬂstart" VALUE 0x1C4CC2 KwUb 191.3 temp_ub_q0p75_o48 -48.00 143.3 FORMAT "%5.1" /end CHARACTERISTIC
/begin CHARACTERISTIC TMVER "Entprellzeit zur Erkennung einer dauerhaften Momentenbegrenzung" VALUE 0x1CFE4E KwUw 65535.00 t1sxs_uw_b65535 0.00 65535.00 FORMAT "%8.2" /end CHARACTERISTIC
/begin CHARACTERISTIC TMXMIBG "Maximal Motor Temperatur f¸r Moment Begrenzung" VALUE 0x1CF072 KwUb 191.3 temp_ub_q0p75_o48 -48.00 143.3 FORMAT "%5.1" /end CHARACTERISTIC
/begin CHARACTERISTIC TNGAT "Zeitkonstante Eingriff Momenten begrenzung Abgastemperatur" VALUE 0x1CF073 KwUb 25.4996 zk100msxs_ub_b25p5 0.100392 25.6000 FORMAT "%7.4" /end CHARACTERISTIC
/begin CHARACTERISTIC TRAU "‹berwachungszeit f¸r untere Lastschwelle der Lambdaregelung" VALUE 0x1CC393 KwUb 25.50 t100msxs_ub_b25p5 0.00 25.50 FORMAT "%5.2" /end CHARACTERISTIC
/begin CHARACTERISTIC TSAKAMN "Mindestdauer SA f¸r Funktion Katalysator-Ausr‰umen" VALUE 0x1C4D32 KwWU8 5.100 t20msxs_ub_b5p1 0.00 5.100 FORMAT "%5.3" /end CHARACTERISTIC
/begin CHARACTERISTIC TSAKAMN2 "Mindestdauer SA f¸r Funktion Katalysator-Ausr‰umen Bank2" VALUE 0x1C4D33 KwWU8 5.100 t20msxs_ub_b5p1 0.00 5.100 FORMAT "%5.3" /end CHARACTERISTIC
/begin CHARACTERISTIC TVFSAWE "Verzˆgerungszeit f¸r R¸cksetzen von B_fil" VALUE 0x1C70EC KwUw 655.3500 t10msxs_uw_b655p35 0.00 655.3500 FORMAT "%8.4" /end CHARACTERISTIC
/begin CHARACTERISTIC TVGAT "Verzˆgerung Momenten begrenzung Abgastemperatur" VALUE 0x1CF074 KwUb 25.50 t100msxs_ub_b25p5 0.00 25.50 FORMAT "%5.2" /end CHARACTERISTIC
/begin CHARACTERISTIC TVLISTU "Verbotszeit f¸r negativen Integratoranteil nach Start" VALUE 0x1C6EF4 KwUb 5.100 t20msxs_ub_b5p1 0.00 5.100 FORMAT "%5.3" /end CHARACTERISTIC
/begin CHARACTERISTIC TVLLRPST "Zeitverzˆgerung nach Start zum Deaktivieren der P-Verst‰rkung im Start" VALUE 0x1C6EF5 KwUb 51.00 t200msxs_ub_b51 0.00 51.00 FORMAT "%5.2" /end CHARACTERISTIC
/begin CHARACTERISTIC TVLLRST "Verzˆgerung nach Vorgabe Startsolldrehzahl zum Deakt. der P-Verst‰rkung im Start" VALUE 0x1C6EF6 KwUb 5.100 t20msxs_ub_b5p1 0.00 5.100 FORMAT "%5.3" /end CHARACTERISTIC
/begin CHARACTERISTIC TVLRA "Verzˆgerungszeit f¸r Aktivierung Gemischadaption nach Lambdaregelung aktiv" VALUE 0x1CDCA2 KwUb 25.40 t100msxs_ub_b25p5 0.1000 25.50 FORMAT "%5.2" /end CHARACTERISTIC
/begin CHARACTERISTIC TVMIBEG "Entprellzeit f¸r Z¸ndwinkelfreigabe bei Momentenbegrenzung" VALUE 0x1C70F2 KwUb 2.550 t10msxs_ub_b2p55 0.00 2.550 FORMAT "%5.3" /end CHARACTERISTIC
/begin CHARACTERISTIC TVPKH "Zeitverzˆgerung: P-Verst‰rkung bei Katheizen aktiv" VALUE 0x1C6F96 KwUw 13107.00 t200msxs_uw_q0p2 0.00 13107.00 FORMAT "%8.2" /end CHARACTERISTIC
/begin CHARACTERISTIC TVSLR "Dauer LRS-Ausschaltung ¸ber Ventilhubsteuerung" CURVE 0x1CC394 KlAUbSstUbWUb 2.550 t10msxs_ub_b2p55 0.00 2.550 FORMAT "%5.3"
 /begin AXIS_DESCR STD_AXIS nmot nmot_ub_q40 8 0.00 10200. FORMAT "%5.0" DEPOSIT ABSOLUTE /end AXIS_DESCR
/end CHARACTERISTIC
/begin CHARACTERISTIC TWDMAD "Wartezeit bis Freigabe der Adaption des Verlustmoments" VALUE 0x1CFC55 KwUb 51.00 t200msxs_ub_b51 0.00 51.00 FORMAT "%5.2" /end CHARACTERISTIC
/begin CHARACTERISTIC USHKAMNW "Sondenspannung hinter Kat f¸r Erkennung Kat ist mit O2 gef¸llt (Word)" VALUE 0x1C4D24 KwWU16 319.9951 spg_uw_q0p00488_o1 -1.000000 318.9951 FORMAT "%8.4" /end CHARACTERISTIC
/begin CHARACTERISTIC USHKAMNW2 "Sondenspannung hinter Kat f¸r Erkennung Kat ist mit O2 gef¸llt, Bank 2 (Word)" VALUE 0x1C4D26 KwWU16 319.9951 spg_uw_q0p00488_o1 -1.000000 318.9951 FORMAT "%8.4" /end CHARACTERISTIC
/begin CHARACTERISTIC USHKAMXW "Sondenspannung hinter Kat f¸r Abbruch Kat-Ausr‰umen (Word)" VALUE 0x1C4D28 KwWU16 319.9951 spg_uw_q0p00488_o1 -1.000000 318.9951 FORMAT "%8.4" /end CHARACTERISTIC
/begin CHARACTERISTIC USHKAMXW2 "Sondenspannung hinter Kat f¸r Abbruch Kat-Ausr‰umen Bank2 (Word)" VALUE 0x1C4D2A KwWU16 319.9951 spg_uw_q0p00488_o1 -1.000000 318.9951 FORMAT "%8.4" /end CHARACTERISTIC
/begin CHARACTERISTIC VFZGSAWE "Fahrzeugsgeschwindigkeitsschwelle f¸rs Abwerfen des Filters FILSAWE" VALUE 0x1C70AF KwUb 318.8 vfzg_ub_q1p25 0.00 318.8 FORMAT "%5.1" /end CHARACTERISTIC
/begin CHARACTERISTIC WDKARN "DK-Winkel-Schwelle f¸r Gemischadaption aktiv" CURVE 0x1CDCA4 KlAUbSstUbWUb 100.0 relDK_ub_b100 0.00 100.0 FORMAT "%5.1"
 /begin AXIS_DESCR STD_AXIS nmot nmot_ub_q40 10 0.00 10200. FORMAT "%5.0" DEPOSIT ABSOLUTE /end AXIS_DESCR
/end CHARACTERISTIC
/begin CHARACTERISTIC WIMAX "ObererSchranke interne Reglerzust‰nde stetige Lambdaregelung" VALUE 0x1C4C92 KwSw 7.999878 fak_sw_b4 -4.000000 3.999878 FORMAT "%8.6" /end CHARACTERISTIC
/begin CHARACTERISTIC WIMIN "Untere Schranke interne Reglerzustaende stetige Lambdaregelung" VALUE 0x1C4C94 KwSw 7.999878 fak_sw_b4 -4.000000 3.999878 FORMAT "%8.6" /end CHARACTERISTIC
/begin CHARACTERISTIC XIMAX "ObererSchranke interne Reglerzust‰nde stetige Lambdaregelung" VALUE 0x1C4C96 KwSw 1.999969 fak_sw_b1 -1.000000 0.9999695 FORMAT "%8.6" /end CHARACTERISTIC
/begin CHARACTERISTIC XIMIN "Untere [Bhranke interne Reglerzustaende stetige Lambdaregelung" VALUE 0x1C4C98 KwSw 1.999969 fak_sw_b1 -1.000000 0.9999695 FORMAT "%8.6" /end CHARACTERISTIC
/begin CHARACTERISTIC Y2MAX "Obere Schranke Integralanteil LRS" VALUE 0x1C4C9A KwSw 1.999969 fak_sw_b1 -1.000000 0.9999695 FORMAT "%8.6" /end CHARACTERISTIC
/begin CHARACTERISTIC ZFLLRPL "Zeitkonstante: Aufregeln des P-Anteils auf dem Luftpfad" VALUE 0x1C6EF7 KwUb 5.08000 zk20msxs_ub_b5p1 0.0200000 5.10000 FORMAT "%7.5" /end CHARACTERISTIC
/begin CHARACTERISTIC ZFMDVERL "Zeitkonstante f¸r Filterung Verlustmoment" VALUE 0x1C7045 KwUb 2.53000 zk20msxs_ub_b5p1 0.0200000 2.55000 FORMAT "%7.5" /end CHARACTERISTIC
/begin CHARACTERISTIC ZKDMADFK "Zeitkonstante f¸r Adaption des Verlustmoments Fahrstufe und Kompressor ein" VALUE 0x1CFC56 KwUw 815.987549 zk200msxs_uw_b13107 3.19995117 819.187500 FORMAT "%10.6" /end CHARACTERISTIC
/begin CHARACTERISTIC ZKDMADFS "Zeitkonstante f¸r Adaption des Verlustmoments Fahrstufe ein" VALUE 0x1CFC58 KwUw 815.987549 zk200msxs_uw_b13107 3.19995117 819.187500 FORMAT "%10.6" /end CHARACTERISTIC
/begin CHARACTERISTIC ZKDMADKO "Zeitkonstante f¸r Adaption des Verlustmoments Klimakompressor ein" VALUE 0x1CFC5A KwUw 815.987549 zk200msxs_uw_b13107 3.19995117 819.187500 FORMAT "%10.6" /end CHARACTERISTIC
/begin CHARACTERISTIC ZKDMADLL "Zeitkonstante f¸r Adaption des Verlustmoments ohne Last" VALUE 0x1CFC5C KwUw 815.987549 zk200msxs_uw_b13107 3.19995117 819.187500 FORMAT "%10.6" /end CHARACTERISTIC
/begin CHARACTERISTIC ZKFRAOA "Zeitkonstante f¸r frao-Integrator, f(Anzahl Starts mit ÷lverd¸nnung)" CURVE 0x1CDC66 KlAUwSstUwWUw 4.999924 zk200msxs_uw_b5 0.00 4.999924 FORMAT "%8.6"
 /begin AXIS_DESCR STD_AXIS abo dez 3 0.00 65535.00 FORMAT "%8.2" DEPOSIT ABSOLUTE /end AXIS_DESCR
/end CHARACTERISTIC
/begin CHARACTERISTIC ZKFRAUA "Zeitkonstante f¸r frau-Integrator, f(Anzahl Stats mit ÷lverd¸nnung)" CURVE 0x1CDC74 KlAUwSstUwWUw 4.999924 zk200msxs_uw_b5 0.00 4.999924 FORMAT "%8.6"
 /begin AXIS_DESCR STD_AXIS abo dez 3 0.00 65535.00 FORMAT "%8.2" DEPOSIT ABSOLUTE /end AXIS_DESCR
/end CHARACTERISTIC
/begin CHARACTERISTIC ZKLLRD "Zeitkonstante f¸r die Abregelung des D-Anteils" VALUE 0x1C6EF8 KwUb 5.08000 zk20msxs_ub_b5p1 0.0200000 5.10000 FORMAT "%7.5" /end CHARACTERISTIC
/begin CHARACTERISTIC ZKRKATA "Integrationsgeschwindigkeit Integrator rkat, f(abo)" CURVE 0x1CDC82 KlAUwSstUwWUw 959.9854 zk200msxs_uw_b960 0.00 959.9854 FORMAT "%8.4"
 /begin AXIS_DESCR STD_AXIS abo dez 3 0.00 65535.00 FORMAT "%8.2" DEPOSIT ABSOLUTE /end AXIS_DESCR
/end CHARACTERISTIC
/begin CHARACTERISTIC ZKRKAZA "Integrationsgeschwindigkeit Integrator rkaz, f(abo)" CURVE 0x1CDC90 KlAUwSstUwWUw 959.9854 zk200msxs_uw_b960 0.00 959.9854 FORMAT "%8.4"
 /begin AXIS_DESCR STD_AXIS abo dez 3 0.00 65535.00 FORMAT "%8.2" DEPOSIT ABSOLUTE /end AXIS_DESCR
/end CHARACTERISTIC
/begin CHARACTERISTIC ZLASHKAB "Zeitkonstante f¸r Abregelung der dyn. Sollwertanhebung (dlasohkab) rin der LRHK" VALUE 0x1C5078 KwWU16 655.3400 t10msxs_uw_b655p35 0.01000000 655.3500 FORMAT "%8.4" /end CHARACTERISTIC
/begin CHARACTERISTIC ZLASOHML "Zeitkonstante f¸r PT1-Filter des Pseudo-Lambda hinter Kat" CURVE 0x1C5054 KlAxU8SstxU16WU16 655.3400 t10msxs_uw_b655p35 0.01000000 655.3500 FORMAT "%8.4"
 /begin AXIS_DESCR STD_AXIS ml_w m_uw_b6553p5 8 0.00 6553.500 FORMAT "%8.3" DEPOSIT ABSOLUTE /end AXIS_DESCR
/end CHARACTERISTIC
/begin CHARACTERISTIC ZLIBG "Filterzeitkonstante f¸r die Nachf¸hrung der Integratorgrenzen" VALUE 0x1C6EF9 KwUb 5.08000 zk20msxs_ub_b5p1 0.0200000 5.10000 FORMAT "%7.5" /end CHARACTERISTIC
/begin CHARACTERISTIC ZMDNSM "Zeitkonstante zur Abrgelung des Nachstart-Momentenoffset" CURVE 0x1CFC2E KlAUbSstUbWUw 51.149999237 zk50msxs_uw_b3276p8 0.050000762951 51.200000000 FORMAT "%12.9"
 /begin AXIS_DESCR STD_AXIS tmot temp_ub_q0p75_o48 8 -48.00 143.3 FORMAT "%5.1" DEPOSIT ABSOLUTE /end AXIS_DESCR
/end CHARACTERISTIC
/begin CHARACTERISTIC ZNFNGLL "Filterzeitkonstante f¸r Drehzahlgradient auf Luftpfad (LLR)" VALUE 0x1C6EFA KwUb 5.08000 zk20msxs_ub_b5p1 0.0200000 5.10000 FORMAT "%7.5" /end CHARACTERISTIC
/begin CHARACTERISTIC ZRLFRAT "Filterzeitkonstante f¸r die Berechnung der Zeitkonstante der FRAT-Adaption" VALUE 0x1CDC34 KwUb 3.73846 zk200msxs_ub_b51p2 0.200000 3.93846 FORMAT "%7.5" /end CHARACTERISTIC
/begin MEASUREMENT B_abgy "Kennung Y-Konfiguration des  Abgassystems" UBYTE B_TRUE 1 100 0 1 BIT_MASK 0x1 FORMAT "%13.11" ECU_ADDRESS 0x800E7F /end MEASUREMENT
/begin MEASUREMENT B_adwfk "Bedingung Adaptionswert Fahrstufe und Kompressor ein verwenden" UBYTE B_TRUE 1 100 0 1 BIT_MASK 0x10 FORMAT "%13.11" ECU_ADDRESS 0x80127C /end MEASUREMENT
/begin MEASUREMENT B_adwfs "Bedingung Adaptionswert Fahrstufe ein verwenden" UBYTE B_TRUE 1 100 0 1 BIT_MASK 0x20 FORMAT "%13.11" ECU_ADDRESS 0x80127C /end MEASUREMENT
/begin MEASUREMENT B_adwko "Bedingung Adaptionswert Klimakompressor ein verwenden" UBYTE B_TRUE 1 100 0 1 BIT_MASK 0x40 FORMAT "%13.11" ECU_ADDRESS 0x80127C /end MEASUREMENT
/begin MEASUREMENT B_blrka "Bedingung gesteuertes Katalysator-Ausr‰umen angefordert" UBYTE B_TRUE 1 100 0 1 BIT_MASK 0x1 FORMAT "%13.11" ECU_ADDRESS 0x800F30 /end MEASUREMENT
/begin MEASUREMENT B_blrka2 "Bedingung gesteuertes Katalysator-Ausr‰umen angefordert, Bank 2" UBYTE B_TRUE 1 100 0 1 BIT_MASK 0x2 FORMAT "%13.11" ECU_ADDRESS 0x800F30 /end MEASUREMENT
/begin MEASUREMENT B_dlahini "Bedingung Intiliasierung Integralanteil LRSHK" UBYTE B_TRUE 1 100 0 1 BIT_MASK 0x1 FORMAT "%13.11" ECU_ADDRESS 0x800B1E /end MEASUREMENT
/begin MEASUREMENT B_dlahini2 "Bedingung Intiliasierung Integralanteil LRSHK, Bank2" UBYTE B_TRUE 1 100 0 1 BIT_MASK 0x2 FORMAT "%13.11" ECU_ADDRESS 0x800B1E /end MEASUREMENT
/begin MEASUREMENT B_dmverlin "Bedingung dmverl = 0" UBYTE B_TRUE 1 100 0 1 BIT_MASK 0x1 FORMAT "%13.11" ECU_ADDRESS 0x80127B /end MEASUREMENT
/begin MEASUREMENT B_enmdsawe "Bedingung Enable Schubabschalten und Wiedereinsetzen ¸ber Momenteneingriff" UBYTE B_TRUE 1 100 0 1 BIT_MASK 0x1 FORMAT "%13.11" ECU_ADDRESS 0x7FA9FF /end MEASUREMENT
/begin MEASUREMENT B_eobdlr "OBDII-Summenfehler. sperrt die LR" UBYTE B_TRUE 1 100 0 1 BIT_MASK 0x1 FORMAT "%13.11" ECU_ADDRESS 0x7FA6D2 /end MEASUREMENT
/begin MEASUREMENT B_eobdlr2 "OBDII-Summenfehler. sperrt die LR, Bank 2" UBYTE B_TRUE 1 100 0 1 BIT_MASK 0x1 FORMAT "%13.11" ECU_ADDRESS 0x7FA6D3 /end MEASUREMENT
/begin MEASUREMENT B_fil "Bedingung PT1-Filter f¸r SAWE aktiv" UBYTE B_TRUE 1 100 0 1 BIT_MASK 0x1 FORMAT "%13.11" ECU_ADDRESS 0x7FA9EA /end MEASUREMENT
/begin MEASUREMENT B_flrsres "Bedingung Regler-Resetierung in Abh‰ngigkeit von B_lrsresf" UBYTE B_TRUE 1 100 0 1 BIT_MASK 0x1 FORMAT "%13.11" ECU_ADDRESS 0x7FA6C2 /end MEASUREMENT
/begin MEASUREMENT B_frao "Einschaltbedingung f¸r Adaption von frao" UBYTE B_TRUE 1 100 0 1 BIT_MASK 0x1 FORMAT "%13.11" ECU_ADDRESS 0x7FA795 /end MEASUREMENT
/begin MEASUREMENT B_fraor "Bedingung frao-Integrator auﬂerhalb reduzierter Bereich" UBYTE B_TRUE 1 100 0 1 BIT_MASK 0x1 FORMAT "%13.11" ECU_ADDRESS 0x7FA796 /end MEASUREMENT
/begin MEASUREMENT B_fraor2 "Bedingung frao2-Integrator auﬂerhalb reduzierter Bereich" UBYTE B_TRUE 1 100 0 1 BIT_MASK 0x1 FORMAT "%13.11" ECU_ADDRESS 0x7FA797 /end MEASUREMENT
/begin MEASUREMENT B_frat "Einschaltbedingung f¸r Adaption von frat" UBYTE B_TRUE 1 100 0 1 BIT_MASK 0x1 FORMAT "%13.11" ECU_ADDRESS 0x7FA798 /end MEASUREMENT
/begin MEASUREMENT B_frau "Einschaltbedingung f¸r Adaption von frau" UBYTE B_TRUE 1 100 0 1 BIT_MASK 0x1 FORMAT "%13.11" ECU_ADDRESS 0x7FA799 /end MEASUREMENT
/begin MEASUREMENT B_fraur "Bedingung frau-Integrator auﬂerhalb reduzierter Bereich" UBYTE B_TRUE 1 100 0 1 BIT_MASK 0x1 FORMAT "%13.11" ECU_ADDRESS 0x7FA79A /end MEASUREMENT
/begin MEASUREMENT B_fraur2 "Bedingung frau2-Integrator auﬂerhalb reduzierter Bereich" UBYTE B_TRUE 1 100 0 1 BIT_MASK 0x1 FORMAT "%13.11" ECU_ADDRESS 0x7FA79B /end MEASUREMENT
/begin MEASUREMENT B_frini "Bedingung Regelfaktor fr initialisieren" UBYTE B_TRUE 1 100 0 1 BIT_MASK 0x1 FORMAT "%13.11" ECU_ADDRESS 0x7FA6E9 /end MEASUREMENT
/begin MEASUREMENT B_frini2 "Bedingung Regelfaktor fr initialisieren, Bank 2" UBYTE B_TRUE 1 100 0 1 BIT_MASK 0x1 FORMAT "%13.11" ECU_ADDRESS 0x7FA6EA /end MEASUREMENT
/begin MEASUREMENT B_frmax "Lambda-Regelung setzt Bit sobald FR am Anschlag FRMAX" UBYTE B_TRUE 1 100 0 1 BIT_MASK 0x1 FORMAT "%13.11" ECU_ADDRESS 0x7FA6C3 /end MEASUREMENT
/begin MEASUREMENT B_frmax2 "Lambda-Regelung setzt Bit sobald FR am Anschlag FRMAX, Bank 2" UBYTE B_TRUE 1 100 0 1 BIT_MASK 0x1 FORMAT "%13.11" ECU_ADDRESS 0x7FA6C4 /end MEASUREMENT
/begin MEASUREMENT B_frmin "Lambda-Regelung setzt Bit sobald FR am Anschlag FRMIN" UBYTE B_TRUE 1 100 0 1 BIT_MASK 0x1 FORMAT "%13.11" ECU_ADDRESS 0x7FA6C5 /end MEASUREMENT
/begin MEASUREMENT B_frmin2 "Lambda-Regelung setzt Bit sobald FR am Anschlag FRMIN, Bank 2" UBYTE B_TRUE 1 100 0 1 BIT_MASK 0x1 FORMAT "%13.11" ECU_ADDRESS 0x7FA6C6 /end MEASUREMENT
/begin MEASUREMENT B_gasp "Bedingung Grundadaption gesperrt" UBYTE B_TRUE 1 100 0 1 BIT_MASK 0x1 FORMAT "%13.11" ECU_ADDRESS 0x7FA7A9 /end MEASUREMENT
/begin MEASUREMENT B_homhmmf "BDE-Sollbetriebsart homogen mager f¸r F¸llungseingriffe w‰hrend homogen" UBYTE B_TRUE 1 100 0 1 BIT_MASK 0x1 FORMAT "%13.11" ECU_ADDRESS 0x7FA9FB /end MEASUREMENT
/begin MEASUREMENT B_homschf "BDE-Sollbetriebsart Schicht f¸r F¸llungseingriffe w‰hrend homogen" UBYTE B_TRUE 1 100 0 1 BIT_MASK 0x1 FORMAT "%13.11" ECU_ADDRESS 0x7FA9FC /end MEASUREMENT
/begin MEASUREMENT B_idecay "Bedingung Grenzwertreg. auf fettes Soll-Lambda mit Absteuern Integralanteil LRS" UBYTE B_TRUE 1 100 0 1 BIT_MASK 0x1 FORMAT "%13.11" ECU_ADDRESS 0x7FA6C7 /end MEASUREMENT
/begin MEASUREMENT B_idecay2 "Bedingung mit Absteuern Integralanteil LRS, Bank 2" UBYTE B_TRUE 1 100 0 1 BIT_MASK 0x1 FORMAT "%13.11" ECU_ADDRESS 0x7FA6C8 /end MEASUREMENT
/begin MEASUREMENT B_iehshk "lokales Flag f¸r Abfrage HSH-Fehlerpfad gem‰ﬂ Abfrage SY_NOHK" UBYTE B_TRUE 1 100 0 1 BIT_MASK 0x2 FORMAT "%13.11" ECU_ADDRESS 0x800B2B /end MEASUREMENT
/begin MEASUREMENT B_iekat "lokales Flag f¸r Abfrage DKAT-Fehlerpfad gem‰ﬂ Abfrage SY_BDE" UBYTE B_TRUE 1 100 0 1 BIT_MASK 0x4 FORMAT "%13.11" ECU_ADDRESS 0x800B2B /end MEASUREMENT
/begin MEASUREMENT B_iekat2 "lokales Flag f¸r Abfrage DKAT-Fehlerpfad gem‰ﬂ Abfrage SY_BDE, Bank 2" UBYTE B_TRUE 1 100 0 1 BIT_MASK 0x1 FORMAT "%13.11" ECU_ADDRESS 0x800B2E /end MEASUREMENT
/begin MEASUREMENT B_iekati "Flag f¸r Freigabe DKAT-Fehlerpfad f¸r I-Anteil gem‰ﬂ Abfrage SY_BDE" UBYTE B_TRUE 1 100 0 1 BIT_MASK 0x8 FORMAT "%13.11" ECU_ADDRESS 0x800B2B /end MEASUREMENT
/begin MEASUREMENT B_iekati2 "Flag f¸r Freigabe DKAT-Fehlerpfad f¸r I-Anteil Bank 2 gem‰ﬂ  Abfrage SY_BDE" UBYTE B_TRUE 1 100 0 1 BIT_MASK 0x2 FORMAT "%13.11" ECU_ADDRESS 0x800B2E /end MEASUREMENT
/begin MEASUREMENT B_ielsh "lokales Flag f¸r Abfrage LSH-Fehlerpfad gem‰ﬂ Abfrage SY_BDE" UBYTE B_TRUE 1 100 0 1 BIT_MASK 0x10 FORMAT "%13.11" ECU_ADDRESS 0x800B2B /end MEASUREMENT
/begin MEASUREMENT B_ielsh2 "lokales Flag f¸r Abfrage LSH-Fehlerpfad gem‰ﬂ Abfrage SY_BDE, Bank 2" UBYTE B_TRUE 1 100 0 1 BIT_MASK 0x4 FORMAT "%13.11" ECU_ADDRESS 0x800B2E /end MEASUREMENT
/begin MEASUREMENT B_iesls "lokales Flag f¸r Abfrage SLS-Fehlerpfad gem‰ﬂ Abfrage SY_SLS" UBYTE B_TRUE 1 100 0 1 BIT_MASK 0x20 FORMAT "%13.11" ECU_ADDRESS 0x800B2B /end MEASUREMENT
/begin MEASUREMENT B_iesls2 "lokales Flag f¸r Abfrage SLS-Fehlerpfad gem‰ﬂ Abfrage SY_SLS, Bank 2" UBYTE B_TRUE 1 100 0 1 BIT_MASK 0x8 FORMAT "%13.11" ECU_ADDRESS 0x800B2E /end MEASUREMENT
/begin MEASUREMENT B_ieteve2 "lokales Flag f¸r Abfrage TEV-Fehlerpfad gem‰ﬂ Abfrage SY_2TEV, Bank 2" UBYTE B_TRUE 1 100 0 1 BIT_MASK 0x10 FORMAT "%13.11" ECU_ADDRESS 0x800B2E /end MEASUREMENT
/begin MEASUREMENT B_lamka "Lambda f¸r Kat-Ausr‰umen aktiv" UBYTE B_TRUE 1 100 0 1 BIT_MASK 0x4 FORMAT "%13.11" ECU_ADDRESS 0x800F2F /end MEASUREMENT
/begin MEASUREMENT B_lamka2 "Lambda f¸r Kat-Ausr‰umen aktiv" UBYTE B_TRUE 1 100 0 1 BIT_MASK 0x8 FORMAT "%13.11" ECU_ADDRESS 0x800F2F /end MEASUREMENT
/begin MEASUREMENT B_llrpkh "P-Verst‰rkung f¸r Katheizen aktiv" UBYTE B_TRUE 1 100 0 1 BIT_MASK 0x1 FORMAT "%13.11" ECU_ADDRESS 0x7FA9BB /end MEASUREMENT
/begin MEASUREMENT B_llrpst "P-Anteil: Parameter f¸r Start aktiv" UBYTE B_TRUE 1 100 0 1 BIT_MASK 0x1 FORMAT "%13.11" ECU_ADDRESS 0x7FA9BC /end MEASUREMENT
/begin MEASUREMENT B_llrst "Drehzahl erreicht nstat im Nachstart" UBYTE B_TRUE 1 100 0 1 BIT_MASK 0x1 FORMAT "%13.11" ECU_ADDRESS 0x7FA9BD /end MEASUREMENT
/begin MEASUREMENT B_lr "LREB: Bedingung Lambdaregelung (vor Kat); (Bank 1)" UBYTE B_TRUE 1 100 0 1 BIT_MASK 0x1 FORMAT "%13.11" ECU_ADDRESS 0x7FA6D4 /end MEASUREMENT
/begin MEASUREMENT B_lr2 "Bedingung Lambdaregelung (vor Kat); Bank 2" UBYTE B_TRUE 1 100 0 1 BIT_MASK 0x1 FORMAT "%13.11" ECU_ADDRESS 0x7FA6D5 /end MEASUREMENT
/begin MEASUREMENT B_lr2s "CARB FREEZE FRAME, Bank1 bit 1, LR: Regelbetrieb mit zwei Sonden" UBYTE B_TRUE 1 100 0 1 BIT_MASK 0x2 FORMAT "%13.11" ECU_ADDRESS 0x80116E /end MEASUREMENT
/begin MEASUREMENT B_lr2s2 "CARB FREEZE FRAME, Bank2 Bit 1, LR: Regelbetrieb mit zwei Sonden" UBYTE B_TRUE 1 100 0 1 BIT_MASK 0x2 FORMAT "%13.11" ECU_ADDRESS 0x80116F /end MEASUREMENT
/begin MEASUREMENT B_lra "Bedingung Gemischadaption freigegeben" UBYTE B_TRUE 1 100 0 1 BIT_MASK 0x1 FORMAT "%13.11" ECU_ADDRESS 0x7FA7AA /end MEASUREMENT
/begin MEASUREMENT B_lra2 "Bedingung Gemischadaption 2 freigegeben" UBYTE B_TRUE 1 100 0 1 BIT_MASK 0x1 FORMAT "%13.11" ECU_ADDRESS 0x7FA7AB /end MEASUREMENT
/begin MEASUREMENT B_lraen "Bedingung Gemischadaption freigegeben" UBYTE B_TRUE 1 100 0 1 BIT_MASK 0x1 FORMAT "%13.11" ECU_ADDRESS 0x7FA7AC /end MEASUREMENT
/begin MEASUREMENT B_lrare "Bedingung Reset LRA" UBYTE B_TRUE 1 100 0 1 BIT_MASK 0x1 FORMAT "%13.11" ECU_ADDRESS 0x7FA79C /end MEASUREMENT
/begin MEASUREMENT B_lrare2 "Bedingung Reset LRA Bank 2" UBYTE B_TRUE 1 100 0 1 BIT_MASK 0x1 FORMAT "%13.11" ECU_ADDRESS 0x7FA79D /end MEASUREMENT
/begin MEASUREMENT B_lrareb "Bedingung Resetbereitschaft LRA" UBYTE B_TRUE 1 100 0 1 BIT_MASK 0x1 FORMAT "%13.11" ECU_ADDRESS 0x7FA79E /end MEASUREMENT
/begin MEASUREMENT B_lrat "Bedingung Gemischadaption temperaturabh‰ngig freigegeben" UBYTE B_TRUE 1 100 0 1 BIT_MASK 0x1 FORMAT "%13.11" ECU_ADDRESS 0x7FA7AD /end MEASUREMENT
/begin MEASUREMENT B_lrdel "Bedingung Lambdaregelung (vor Kat) verzoegert; (Bank 1)" UBYTE B_TRUE 1 100 0 1 BIT_MASK 0x40 FORMAT "%13.11" ECU_ADDRESS 0x800B2B /end MEASUREMENT
/begin MEASUREMENT B_lrdel2 "Bedingung Lambdaregelung (vor Kat) verzoegert; (Bank 2)" UBYTE B_TRUE 1 100 0 1 BIT_MASK 0x20 FORMAT "%13.11" ECU_ADDRESS 0x800B2E /end MEASUREMENT
/begin MEASUREMENT B_lrhk "Bedingung Lambdaregelung hinter Kat" UBYTE B_TRUE 1 100 0 1 BIT_MASK 0x1 FORMAT "%13.11" ECU_ADDRESS 0x800B28 /end MEASUREMENT
/begin MEASUREMENT B_lrhk2 "Bedingung Lambdaregelung hinter Kat (Bank 2)" UBYTE B_TRUE 1 100 0 1 BIT_MASK 0x1 FORMAT "%13.11" ECU_ADDRESS 0x800B2A /end MEASUREMENT
/begin MEASUREMENT B_lrhkb "Bedingung Lambdaregelung h. Kat, bankspez. Parameter Bank 1" UBYTE B_TRUE 1 100 0 1 BIT_MASK 0x80 FORMAT "%13.11" ECU_ADDRESS 0x800B2B /end MEASUREMENT
/begin MEASUREMENT B_lrhkb2 "LRHK: Bedingung Lambdaregelung h. Kat, bankspez. Parameter Bank 2" UBYTE B_TRUE 1 100 0 1 BIT_MASK 0x40 FORMAT "%13.11" ECU_ADDRESS 0x800B2E /end MEASUREMENT
/begin MEASUREMENT B_lrhkbv "Bank 1 bezogene Freigabebedingung, die  auf der Regelung vor Kat basieren" UBYTE B_TRUE 1 100 0 1 BIT_MASK 0x1 FORMAT "%13.11" ECU_ADDRESS 0x800B2C /end MEASUREMENT
/begin MEASUREMENT B_lrhkbv2 "Bank 2 bezogene Freigabebedingung, die  auf der Regelung vor Kat basieren" UBYTE B_TRUE 1 100 0 1 BIT_MASK 0x80 FORMAT "%13.11" ECU_ADDRESS 0x800B2E /end MEASUREMENT
/begin MEASUREMENT B_lrhkg "bankunabh‰ngige Bedingung Lambdaregelung hinter Kat" UBYTE B_TRUE 1 100 0 1 BIT_MASK 0x1 FORMAT "%13.11" ECU_ADDRESS 0x800B2B /end MEASUREMENT
/begin MEASUREMENT B_lrhkgi "bankunabh‰ngige Bedingung I-Anteil Lambdaregelung hinter Kat" UBYTE B_TRUE 1 100 0 1 BIT_MASK 0x2 FORMAT "%13.11" ECU_ADDRESS 0x800B2C /end MEASUREMENT
/begin MEASUREMENT B_lrhkp "LRHK: Freigabebedingung P-Anteil Lambdaregelung hinter Kat" UBYTE B_TRUE 1 100 0 1 BIT_MASK 0x2 FORMAT "%13.11" ECU_ADDRESS 0x800B28 /end MEASUREMENT
/begin MEASUREMENT B_lrhkp2 "LRHK Bank2: Freigabebedingung P-Anteil Lambdaregelung hinter Kat" UBYTE B_TRUE 1 100 0 1 BIT_MASK 0x2 FORMAT "%13.11" ECU_ADDRESS 0x800B2A /end MEASUREMENT
/begin MEASUREMENT B_lrhkpzp "Freigabebedingung P-Anteil Lambdaregelung hinter Kat, Zwei-Punkt-Variante" UBYTE B_TRUE 1 100 0 1 BIT_MASK 0x4 FORMAT "%13.11" ECU_ADDRESS 0x800B28 /end MEASUREMENT
/begin MEASUREMENT B_lrhkpzp2 "Freigabebedingung P-Anteil LRHK, Zwei-Punkt-Variante, Bank 2" UBYTE B_TRUE 1 100 0 1 BIT_MASK 0x4 FORMAT "%13.11" ECU_ADDRESS 0x800B2A /end MEASUREMENT
/begin MEASUREMENT B_lrhkzp "Bedingung Lambdaregelung hinter Kat, Zweipunkt-Variante" UBYTE B_TRUE 1 100 0 1 BIT_MASK 0x8 FORMAT "%13.11" ECU_ADDRESS 0x800B28 /end MEASUREMENT
/begin MEASUREMENT B_lrhkzp2 "Bedingung Lambdaregelung hinter Kat, Zweipunkt-Variante, Bank 2" UBYTE B_TRUE 1 100 0 1 BIT_MASK 0x8 FORMAT "%13.11" ECU_ADDRESS 0x800B2A /end MEASUREMENT
/begin MEASUREMENT B_lrka "Bedingung Katalysator-Ausr‰umen" UBYTE B_TRUE 1 100 0 1 BIT_MASK 0x1 FORMAT "%13.11" ECU_ADDRESS 0x800F2F /end MEASUREMENT
/begin MEASUREMENT B_lrka2 "Bedingung Katalysator-Ausr‰umen f¸r Stereo-LR Bank 2" UBYTE B_TRUE 1 100 0 1 BIT_MASK 0x2 FORMAT "%13.11" ECU_ADDRESS 0x800F2F /end MEASUREMENT
/begin MEASUREMENT B_lrkaa "Bedingung Katalysator-Ausr‰umen auf-/abregeln" UBYTE B_TRUE 1 100 0 1 BIT_MASK 0x10 FORMAT "%13.11" ECU_ADDRESS 0x800F30 /end MEASUREMENT
/begin MEASUREMENT B_lrkaa2 "Bedingung Katalysator-Ausr‰umen auf-/abregeln, Bank 2" UBYTE B_TRUE 1 100 0 1 BIT_MASK 0x20 FORMAT "%13.11" ECU_ADDRESS 0x800F30 /end MEASUREMENT
/begin MEASUREMENT B_lrkae "Bedingung gesteuertes Katalysator-Ausr‰umen mˆglich" UBYTE B_TRUE 1 100 0 1 BIT_MASK 0x4 FORMAT "%13.11" ECU_ADDRESS 0x800F30 /end MEASUREMENT
/begin MEASUREMENT B_lrkae2 "Bedingung gesteuertes Katalysator-Ausr‰umen mˆglich, Bank 2" UBYTE B_TRUE 1 100 0 1 BIT_MASK 0x8 FORMAT "%13.11" ECU_ADDRESS 0x800F30 /end MEASUREMENT
/begin MEASUREMENT B_lrkaint "Lokale Bedingung Katalysator-Ausr‰umen umgesetzt auf 100ms-Raster" UBYTE B_TRUE 1 100 0 1 BIT_MASK 0x4 FORMAT "%13.11" ECU_ADDRESS 0x800B2C /end MEASUREMENT
/begin MEASUREMENT B_lrkaint2 "Lokale Bedingung Katalysator-Ausr‰umen umgesetzt auf 100ms-Raster, Bank 2" UBYTE B_TRUE 1 100 0 1 BIT_MASK 0x1 FORMAT "%13.11" ECU_ADDRESS 0x800B2D /end MEASUREMENT
/begin MEASUREMENT B_lrmsbs "Bedingung Abmagerungsverbot f¸r stetige Regelung, Bank 1" UBYTE B_TRUE 1 100 0 1 BIT_MASK 0x1 FORMAT "%13.11" ECU_ADDRESS 0x7FA6D6 /end MEASUREMENT
/begin MEASUREMENT B_lrmsbs2 "Bedingung Abmagerungsverbot f¸r stetige Regelung, Bank 2" UBYTE B_TRUE 1 100 0 1 BIT_MASK 0x1 FORMAT "%13.11" ECU_ADDRESS 0x7FA6D7 /end MEASUREMENT
/begin MEASUREMENT B_lrnda "LR Bank1 aktiv bei Bedingungen : B_lrpspa & B_lrkasn & !E_obdlr" UBYTE B_TRUE 1 100 0 1 BIT_MASK 0x1 FORMAT "%13.11" ECU_ADDRESS 0x7FA6D8 /end MEASUREMENT
/begin MEASUREMENT B_lrnda2 "LR Bank2 aktiv bei Bedingungen : B_lrpspa & B_lrkasn & !E_obdlr" UBYTE B_TRUE 1 100 0 1 BIT_MASK 0x1 FORMAT "%13.11" ECU_ADDRESS 0x7FA6D9 /end MEASUREMENT
/begin MEASUREMENT B_lrrl "LREB: Von Last abh‰ngige Bedingung Lambdaregelung (vor Kat)" UBYTE B_TRUE 1 100 0 1 BIT_MASK 0x1 FORMAT "%13.11" ECU_ADDRESS 0x7FA6DA /end MEASUREMENT
/begin MEASUREMENT B_lrs "LRSEB: Bedingung Lambdaregelung intern (vor Kat), Bank 1" UBYTE B_TRUE 1 100 0 1 BIT_MASK 0x1 FORMAT "%13.11" ECU_ADDRESS 0x7FA6DB /end MEASUREMENT
/begin MEASUREMENT B_lrs2 "LRSEB: Bedingung Lambdaregelung intern (vor Kat), Bank 2" UBYTE B_TRUE 1 100 0 1 BIT_MASK 0x1 FORMAT "%13.11" ECU_ADDRESS 0x7FA6DC /end MEASUREMENT
/begin MEASUREMENT B_lrsrems "Bedingung fr-reset bei Abmagerungsverbot f¸r Bank 1" UBYTE B_TRUE 1 100 0 1 BIT_MASK 0x1 FORMAT "%13.11" ECU_ADDRESS 0x7FA6DD /end MEASUREMENT
/begin MEASUREMENT B_lrsrems2 "Bedingung fr-reset bei Abmagerungsverbot f¸r Bank 2" UBYTE B_TRUE 1 100 0 1 BIT_MASK 0x1 FORMAT "%13.11" ECU_ADDRESS 0x7FA6DE /end MEASUREMENT
/begin MEASUREMENT B_lrsresf "Bedingung Fr-Reset bei lamsons<LALIUSMN" UBYTE B_TRUE 1 100 0 1 BIT_MASK 0x1 FORMAT "%13.11" ECU_ADDRESS 0x7FA6DF /end MEASUREMENT
/begin MEASUREMENT B_lrssa "LRSEB: Einschaltbed. f¸r Lambdareg. nach Schub bei langsamer Sonde" UBYTE B_TRUE 1 100 0 1 BIT_MASK 0x1 FORMAT "%13.11" ECU_ADDRESS 0x7FA6E0 /end MEASUREMENT
/begin MEASUREMENT B_lrssa2 "Einschaltbed. f¸r Lambdareg. nach Schub bei langsamer Sonde, Bank2" UBYTE B_TRUE 1 100 0 1 BIT_MASK 0x1 FORMAT "%13.11" ECU_ADDRESS 0x7FA6E1 /end MEASUREMENT
/begin MEASUREMENT B_lrssp "Lamda-Regelung setzt Bit, wenn Zusatzamplitude Vorzeichenwechsel" UBYTE B_TRUE 1 100 0 1 BIT_MASK 0x1 FORMAT "%13.11" ECU_ADDRESS 0x7FA6C9 /end MEASUREMENT
/begin MEASUREMENT B_lrvk "CARB FREEZE FRAME, Bank1 Bit 4, LR: Regelung nur mit einer Sonde (vor KAT)" UBYTE B_TRUE 1 100 0 1 BIT_MASK 0x10 FORMAT "%13.11" ECU_ADDRESS 0x80116E /end MEASUREMENT
/begin MEASUREMENT B_lrvk2 "CARB FREEZE FRAME, Bank2 Bit 4, LR: Regelung nur mit einer Sonde (vor KAT)" UBYTE B_TRUE 1 100 0 1 BIT_MASK 0x10 FORMAT "%13.11" ECU_ADDRESS 0x80116F /end MEASUREMENT
/begin MEASUREMENT B_madakt "Verlustmomentenadaption aktiv" UBYTE B_TRUE 1 100 0 1 BIT_MASK 0x80 FORMAT "%13.11" ECU_ADDRESS 0x80127C /end MEASUREMENT
/begin MEASUREMENT B_madfk "Bedingung Momentenadaption Fahrstufe und Klimakompressor ein" UBYTE B_TRUE 1 100 0 1 BIT_MASK 0x1 FORMAT "%13.11" ECU_ADDRESS 0x80127C /end MEASUREMENT
/begin MEASUREMENT B_madfs "Bedingung Momentenadaption Fahrstufe ein" UBYTE B_TRUE 1 100 0 1 BIT_MASK 0x2 FORMAT "%13.11" ECU_ADDRESS 0x80127C /end MEASUREMENT
/begin MEASUREMENT B_madko "Bedingung Momentenadaption Klimakompressor ein" UBYTE B_TRUE 1 100 0 1 BIT_MASK 0x4 FORMAT "%13.11" ECU_ADDRESS 0x80127C /end MEASUREMENT
/begin MEASUREMENT B_madll "Bedingung Momentenadaption ohne Last" UBYTE B_TRUE 1 100 0 1 BIT_MASK 0x8 FORMAT "%13.11" ECU_ADDRESS 0x80127C /end MEASUREMENT
/begin MEASUREMENT B_mdee "Bedingung Momentenreduzierung ¸ber Einspritzausblendung erlaubt" UBYTE B_TRUE 1 100 0 1 BIT_MASK 0x1 FORMAT "%13.11" ECU_ADDRESS 0x7FAA00 /end MEASUREMENT
/begin MEASUREMENT B_mdeemx "Bedingung Momentenreduzierung ¸ber Einspritzausblendung erlaubt, Drehzahlgrenz" UBYTE B_TRUE 1 100 0 1 BIT_MASK 0x1 FORMAT "%13.11" ECU_ADDRESS 0x7FAA01 /end MEASUREMENT
/begin MEASUREMENT B_mdeenf "Bedingung Momentenreduzierung ¸ber Einspritzausblendung erlaubt, Normalfahrt" UBYTE B_TRUE 1 100 0 1 BIT_MASK 0x1 FORMAT "%13.11" ECU_ADDRESS 0x7FAA02 /end MEASUREMENT
/begin MEASUREMENT B_mdeenl "Bedingung Momentenreduzierung ¸ber Einspritzausblendung erlaubt, Notlauf" UBYTE B_TRUE 1 100 0 1 BIT_MASK 0x1 FORMAT "%13.11" ECU_ADDRESS 0x7FAA03 /end MEASUREMENT
/begin MEASUREMENT B_mdeetk "Bedingung Momentenreduzierung ¸ber Einspritzausblendung erlaubt, Kat.-Temperatur" UBYTE B_TRUE 1 100 0 1 BIT_MASK 0x1 FORMAT "%13.11" ECU_ADDRESS 0x7FAA04 /end MEASUREMENT
/begin MEASUREMENT B_mdein "Bedingung Momenteneingriff aktiv" UBYTE B_TRUE 1 100 0 1 BIT_MASK 0x1 FORMAT "%13.11" ECU_ADDRESS 0x7FA9EB /end MEASUREMENT
/begin MEASUREMENT B_mdeinint "Bedingung interner Momenteneingriff aktiv" UBYTE B_TRUE 1 100 0 1 BIT_MASK 0x1 FORMAT "%13.11" ECU_ADDRESS 0x7FA9EC /end MEASUREMENT
/begin MEASUREMENT B_mdnstab "Bedingung Drehzahlstabilisierung aktiv" UBYTE B_TRUE 1 100 0 1 BIT_MASK 0x1 FORMAT "%13.11" ECU_ADDRESS 0x80127A /end MEASUREMENT
/begin MEASUREMENT B_mdnste "Bestimmung des Stabilt‰tsfaktors w‰hrend des Starts" UBYTE B_TRUE 1 100 0 1 BIT_MASK 0x2 FORMAT "%13.11" ECU_ADDRESS 0x80127A /end MEASUREMENT
/begin MEASUREMENT B_mdsawe "Bedingung Schubabschalten und Wiedereinsetzen ¸ber Momenteneingriff" UBYTE B_TRUE 1 100 0 1 BIT_MASK 0x1 FORMAT "%13.11" ECU_ADDRESS 0x7FAA05 /end MEASUREMENT
/begin MEASUREMENT B_mibeg "Bedingung Momentenbegrenzung ist aktiv" UBYTE B_TRUE 1 100 0 1 BIT_MASK 0x1 FORMAT "%13.11" ECU_ADDRESS 0x7FA9F0 /end MEASUREMENT
/begin MEASUREMENT B_mibegl "Bedingung Momentenbegrenzung F¸llungspfad aktiv" UBYTE B_TRUE 1 100 0 1 BIT_MASK 0x1 FORMAT "%13.11" ECU_ADDRESS 0x7FA9F9 /end MEASUREMENT
/begin MEASUREMENT B_mlevab "Bit Lambdaregelung bei/nach Zylinderausblendung" UBYTE B_TRUE 1 100 0 1 BIT_MASK 0x1 FORMAT "%13.11" ECU_ADDRESS 0x7FA6E2 /end MEASUREMENT
/begin MEASUREMENT B_mlevab2 "Bit Lambdaregelung bei/nach Zylinderausblendung, Bank 2" UBYTE B_TRUE 1 100 0 1 BIT_MASK 0x1 FORMAT "%13.11" ECU_ADDRESS 0x7FA6E3 /end MEASUREMENT
/begin MEASUREMENT B_mlnka "Bedingung Luftmassenschwelle nach Kat-Ausr‰umen ¸berschritten; (Bank 1)" UBYTE B_TRUE 1 100 0 1 BIT_MASK 0x8 FORMAT "%13.11" ECU_ADDRESS 0x800B2C /end MEASUREMENT
/begin MEASUREMENT B_mlnka2 "Bedingung Luftmassenschwelle nach Kat-Ausr‰umen ¸berschritten; (Bank 2)" UBYTE B_TRUE 1 100 0 1 BIT_MASK 0x2 FORMAT "%13.11" ECU_ADDRESS 0x800B2D /end MEASUREMENT
/begin MEASUREMENT B_mlrsa "LRSEB: Ausschaltbed. f¸r Lambdareg. auf bei und nach Schub ¸ber Luftmassenschw." UBYTE B_TRUE 1 100 0 1 BIT_MASK 0x1 FORMAT "%13.11" ECU_ADDRESS 0x7FA6E4 /end MEASUREMENT
/begin MEASUREMENT B_mrakt "Bedingung: Momentenreserve aktiv" UBYTE B_TRUE 1 100 0 1 BIT_MASK 0x1 FORMAT "%13.11" ECU_ADDRESS 0x7FA9FA /end MEASUREMENT
/begin MEASUREMENT B_nofra "Bedingung Sperren der multiplikativen Gemischkorrektur" UBYTE B_TRUE 1 100 0 1 BIT_MASK 0x1 FORMAT "%13.11" ECU_ADDRESS 0x7FA79F /end MEASUREMENT
/begin MEASUREMENT B_nofrat "Bedingung Sperren der temperaturabh‰ngige Gemischkorrektur" UBYTE B_TRUE 1 100 0 1 BIT_MASK 0x1 FORMAT "%13.11" ECU_ADDRESS 0x7FA7A0 /end MEASUREMENT
/begin MEASUREMENT B_nolrb "CARB FREEZE FRAME, Bank1 Bit 2, LR: Steuerbetrieb durch Betriebsbedingungen" UBYTE B_TRUE 1 100 0 1 BIT_MASK 0x4 FORMAT "%13.11" ECU_ADDRESS 0x80116E /end MEASUREMENT
/begin MEASUREMENT B_nolrb2 "CARB FREEZE FRAME, Bank2 Bit 2, LR: Steuerung durch Betriebsbedingung" UBYTE B_TRUE 1 100 0 1 BIT_MASK 0x4 FORMAT "%13.11" ECU_ADDRESS 0x80116F /end MEASUREMENT
/begin MEASUREMENT B_nolre "CARB FREEZE FRAME, Bank1 Bit 3, LR: Steuerung nach Systemfehler" UBYTE B_TRUE 1 100 0 1 BIT_MASK 0x8 FORMAT "%13.11" ECU_ADDRESS 0x80116E /end MEASUREMENT
/begin MEASUREMENT B_nolre2 "CARB FREEZE FRAME, Bank2 Bit 3, LR: Steuerung nach Systemfehler" UBYTE B_TRUE 1 100 0 1 BIT_MASK 0x8 FORMAT "%13.11" ECU_ADDRESS 0x80116F /end MEASUREMENT
/begin MEASUREMENT B_nolrw "CARB FREEZE FRAME, Bank1 Bit 0, LR: Steuerbetrieb, Startbed. noch nicht erf¸llt" UBYTE B_TRUE 1 100 0 1 BIT_MASK 0x1 FORMAT "%13.11" ECU_ADDRESS 0x80116E /end MEASUREMENT
/begin MEASUREMENT B_nolrw2 "CARB FREEZE FRAME, Bank2 Bit 0, LR: Steuerbetrieb, Startbed. noch nicht erf¸llt" UBYTE B_TRUE 1 100 0 1 BIT_MASK 0x1 FORMAT "%13.11" ECU_ADDRESS 0x80116F /end MEASUREMENT
/begin MEASUREMENT B_norkat "Bedingung additive Korrektur der Gemischadaption pro Zeit abgeschaltet" UBYTE B_TRUE 1 100 0 1 BIT_MASK 0x1 FORMAT "%13.11" ECU_ADDRESS 0x7FA7A1 /end MEASUREMENT
/begin MEASUREMENT B_norkaz "Bedingung additive Korrektur der Gemischadaption pro Z¸ndung abgeschaltet" UBYTE B_TRUE 1 100 0 1 BIT_MASK 0x1 FORMAT "%13.11" ECU_ADDRESS 0x7FA7A2 /end MEASUREMENT
/begin MEASUREMENT B_pspaus "Bedingung LR inaktiv bei projektspez. AUS-Bedingungen" UBYTE B_TRUE 1 100 0 1 BIT_MASK 0x1 FORMAT "%13.11" ECU_ADDRESS 0x7FA6E5 /end MEASUREMENT
/begin MEASUREMENT B_pspwl "Bedingung LR inaktiv bei projektspez. Warmlauf-Bedingungen" UBYTE B_TRUE 1 100 0 1 BIT_MASK 0x1 FORMAT "%13.11" ECU_ADDRESS 0x7FA6E6 /end MEASUREMENT
/begin MEASUREMENT B_rkat "Bedingung Lernbereich additive Korrektur pro Zeit aktiv" UBYTE B_TRUE 1 100 0 1 BIT_MASK 0x1 FORMAT "%13.11" ECU_ADDRESS 0x7FA7A3 /end MEASUREMENT
/begin MEASUREMENT B_rkatr "Bedingung rkat-Integrator auﬂerhalb reduzierten Bereich" UBYTE B_TRUE 1 100 0 1 BIT_MASK 0x1 FORMAT "%13.11" ECU_ADDRESS 0x7FA7A4 /end MEASUREMENT
/begin MEASUREMENT B_rkatr2 "Bedingung rkat2-Integrator auﬂerhalb reduzierten Bereich" UBYTE B_TRUE 1 100 0 1 BIT_MASK 0x1 FORMAT "%13.11" ECU_ADDRESS 0x7FA7A5 /end MEASUREMENT
/begin MEASUREMENT B_rkaz "Bedingung Lernbereich additive Korrektur pro Z¸ndung aktiv" UBYTE B_TRUE 1 100 0 1 BIT_MASK 0x1 FORMAT "%13.11" ECU_ADDRESS 0x7FA7A6 /end MEASUREMENT
/begin MEASUREMENT B_rkazr "Bedingung rkaz-Integrator auﬂerhalb reduzierten Bereich" UBYTE B_TRUE 1 100 0 1 BIT_MASK 0x1 FORMAT "%13.11" ECU_ADDRESS 0x7FA7A7 /end MEASUREMENT
/begin MEASUREMENT B_rkazr2 "Bedingung rkaz2-Integrator auﬂerhalb reduzierten Bereich" UBYTE B_TRUE 1 100 0 1 BIT_MASK 0x1 FORMAT "%13.11" ECU_ADDRESS 0x7FA7A8 /end MEASUREMENT
/begin MEASUREMENT B_sa "Bedingung Schubabschalten" UBYTE B_TRUE 1 100 0 1 BIT_MASK 0x1 FORMAT "%13.11" ECU_ADDRESS 0x7FAA06 /end MEASUREMENT
/begin MEASUREMENT B_sabmee "Bedingung Momentenreduzierung mit B_sab ¸ber Einspritzausblendung erlaubt" UBYTE B_TRUE 1 100 0 1 BIT_MASK 0x1 FORMAT "%13.11" ECU_ADDRESS 0x7FAA07 /end MEASUREMENT
/begin MEASUREMENT B_sbbhktmp "lokale Bedingung Sonde betriebsbereit hinter Kat, Y-Konfiguration" UBYTE B_TRUE 1 100 0 1 BIT_MASK 0x40 FORMAT "%13.11" ECU_ADDRESS 0x800F30 /end MEASUREMENT
/begin MEASUREMENT B_sbbnhhk "Bedingung Sonde hinter Haupt-Kat betriebsbereit" UBYTE B_TRUE 1 100 0 1 BIT_MASK 0x1 FORMAT "%13.11" ECU_ADDRESS 0x800E80 /end MEASUREMENT
/begin MEASUREMENT B_tarau "LREB: Bedingung Start bei niedrigen Ansauglufttemperaturen" UBYTE B_TRUE 1 100 0 1 BIT_MASK 0x1 FORMAT "%13.11" ECU_ADDRESS 0x7FA6E7 /end MEASUREMENT
/begin MEASUREMENT B_tmlr "LREB: Von Motortemp. abh‰ngige Bedingungen Lambdaregelung (vor Kat)" UBYTE B_TRUE 1 100 0 1 BIT_MASK 0x1 FORMAT "%13.11" ECU_ADDRESS 0x7FA6E8 /end MEASUREMENT
/begin MEASUREMENT B_update "B_update = false    kein Update der Zustandsgroessen in der LRS" UBYTE B_TRUE 1 100 0 1 BIT_MASK 0x1 FORMAT "%13.11" ECU_ADDRESS 0x7FA6CA /end MEASUREMENT
/begin MEASUREMENT B_update2 "B_update2= false    kein Update der Zustandsgroessen in der LRS, Bank2" UBYTE B_TRUE 1 100 0 1 BIT_MASK 0x1 FORMAT "%13.11" ECU_ADDRESS 0x7FA6CB /end MEASUREMENT
/begin MEASUREMENT B_vormdred "Bedingung Voraussetzung f¸r Drehmomentreduktion ¸ber Reduzierstufen" UBYTE B_TRUE 1 100 0 1 BIT_MASK 0x1 FORMAT "%13.11" ECU_ADDRESS 0x7FAA08 /end MEASUREMENT
/begin MEASUREMENT B_y2max "Integralanteil der LRS hat obere Schranke erreicht" UBYTE B_TRUE 1 100 0 1 BIT_MASK 0x1 FORMAT "%13.11" ECU_ADDRESS 0x7FA6CC /end MEASUREMENT
/begin MEASUREMENT B_y2max2 "Integralanteil der LRS hat obere Schranke erreicht, Bank2" UBYTE B_TRUE 1 100 0 1 BIT_MASK 0x1 FORMAT "%13.11" ECU_ADDRESS 0x7FA6CD /end MEASUREMENT
/begin MEASUREMENT B_y2min "Integralanteil der LRS hat untere Schranke erreicht" UBYTE B_TRUE 1 100 0 1 BIT_MASK 0x1 FORMAT "%13.11" ECU_ADDRESS 0x7FA6CE /end MEASUREMENT
/begin MEASUREMENT B_y2min2 "Integralanteil der LRS hat untere Schranke erreicht, Bank2" UBYTE B_TRUE 1 100 0 1 BIT_MASK 0x1 FORMAT "%13.11" ECU_ADDRESS 0x7FA6CF /end MEASUREMENT
/begin MEASUREMENT B_za "Bedingung Zwangsamplitude" UBYTE B_TRUE 1 100 0 1 BIT_MASK 0x1 FORMAT "%13.11" ECU_ADDRESS 0x7FA6D0 /end MEASUREMENT
/begin MEASUREMENT B_za2 "Bedingung Zwangsamplitude, Bank2" UBYTE B_TRUE 1 100 0 1 BIT_MASK 0x1 FORMAT "%13.11" ECU_ADDRESS 0x7FA6D1 /end MEASUREMENT
/begin MEASUREMENT B_zwdmr "Z¸ndwinkeleingriff durch Momentenreserve" UBYTE B_TRUE 1 100 0 1 BIT_MASK 0x1 FORMAT "%13.11" ECU_ADDRESS 0x7FA9F1 /end MEASUREMENT
/begin MEASUREMENT B_zwfa "Z¸ndwinkeleingriff durch aktiven Komfortfilter" UBYTE B_TRUE 1 100 0 1 BIT_MASK 0x1 FORMAT "%13.11" ECU_ADDRESS 0x7FA9F2 /end MEASUREMENT
/begin MEASUREMENT B_zwfe "Z¸ndwinkeleingriff durch F¸llungserfassung" UBYTE B_TRUE 1 100 0 1 BIT_MASK 0x1 FORMAT "%13.11" ECU_ADDRESS 0x7FA9F3 /end MEASUREMENT
/begin MEASUREMENT B_zwme "Z¸ndwinkeleingriff durch Momenteneingriff" UBYTE B_TRUE 1 100 0 1 BIT_MASK 0x1 FORMAT "%13.11" ECU_ADDRESS 0x7FA9F4 /end MEASUREMENT
/begin MEASUREMENT B_zwpp "Z¸ndwinkeleingriff durch Pedalposition" UBYTE B_TRUE 1 100 0 1 BIT_MASK 0x1 FORMAT "%13.11" ECU_ADDRESS 0x7FA9F5 /end MEASUREMENT
/begin MEASUREMENT B_zwvs "Bedingung f¸r schnellen ‰uﬂeren ZW-Eingriff der Momentenschnittstelle" UBYTE B_TRUE 1 100 0 1 BIT_MASK 0x1 FORMAT "%13.11" ECU_ADDRESS 0x7FA9F6 /end MEASUREMENT
/begin MEASUREMENT B_zwvz "Bedingung f¸r Z¸ndwinkeleingriff der Momentenschnittstelle" UBYTE B_TRUE 1 100 0 1 BIT_MASK 0x1 FORMAT "%13.11" ECU_ADDRESS 0x7FA9F7 /end MEASUREMENT
/begin MEASUREMENT B_zwvzvb "Bedingung f¸r Z¸ndwinkeleingriff der Momentenschnittstelle vor Begrenzung" UBYTE B_TRUE 1 100 0 1 BIT_MASK 0x1 FORMAT "%13.11" ECU_ADDRESS 0x7FA9F8 /end MEASUREMENT
/begin MEASUREMENT cmibeg_w "Z‰hler aktiver Begrenzungen des inneren Moments" UWORD dez 1 100 0 65535 FORMAT "%8.2" ECU_ADDRESS 0x7FC850 /end MEASUREMENT
/begin MEASUREMENT ddmsawe_w "Delta-Moment f¸rs Abwerfen des FIilters FILSAWE" UWORD rel_uw_b100 1 100 0 99.9985 FORMAT "%8.5" ECU_ADDRESS 0x801950 /end MEASUREMENT
/begin MEASUREMENT dfr2_w "Delta Lambdaregler (Faktor ), Bank2" SWORD fak_sw_b1 1 100 -1 0.999969 FORMAT "%8.6" ECU_ADDRESS 0x80161E /end MEASUREMENT
/begin MEASUREMENT dfrm2_w "Abweichung schneller Mittelwert des Lambdareglers von 1.0 (Word)" SWORD fak_sw_b1 1 100 -1 0.999969 FORMAT "%8.6" ECU_ADDRESS 0x800B88 /end MEASUREMENT
/begin MEASUREMENT dfrmin2_w "Untergrenze von dfr_w bei Abmagerungsverbot (B_lrms=true), Bank2" SWORD fak_sw_b1 1 100 -1 0.999969 FORMAT "%8.6" ECU_ADDRESS 0x801620 /end MEASUREMENT
/begin MEASUREMENT dfrmin_w "Untergrenze von dfr_w bei Abmagerungsverbot (B_lrms=true)" SWORD fak_sw_b1 1 100 -1 0.999969 FORMAT "%8.6" ECU_ADDRESS 0x801622 /end MEASUREMENT
/begin MEASUREMENT dfrmt2_w "Abweichung schneller Mittelwert des Lambdareglers von 1.0 (Word)" SWORD fak_sw_b1 1 100 -1 0.999969 FORMAT "%8.6" ECU_ADDRESS 0x800B8A /end MEASUREMENT
/begin MEASUREMENT dfrmt_w "Abweichung schneller Mittelwert des Lambdareglers von 1.0 (Word)" SWORD fak_sw_b1 1 100 -1 0.999969 FORMAT "%8.6" ECU_ADDRESS 0x800B8C /end MEASUREMENT
/begin MEASUREMENT dfrm_w "Abweichung schneller Mittelwert des Lambdareglers von 1.0 (Word)" SWORD fak_sw_b1 1 100 -1 0.999969 FORMAT "%8.6" ECU_ADDRESS 0x800B8E /end MEASUREMENT
/begin MEASUREMENT dfrpr2_w "Delta Lambdaregler (Faktor); vorl‰ufiger Wert vor Abfrage auf Magerschutz, Bank2" SWORD fak_sw_b1 1 100 -1 0.999969 FORMAT "%8.6" ECU_ADDRESS 0x801624 /end MEASUREMENT
/begin MEASUREMENT dfrpr_w "Delta Lambdaregler (Faktor); vorl‰ufiger Wert vor Abfrage auf Magerschutz" SWORD fak_sw_b1 1 100 -1 0.999969 FORMAT "%8.6" ECU_ADDRESS 0x801626 /end MEASUREMENT
/begin MEASUREMENT dfrza2_w "LRS-Zwangsamplitude, Bank 2" SWORD fak_sw_b1 1 100 -1 0.999969 FORMAT "%8.6" ECU_ADDRESS 0x801628 /end MEASUREMENT
/begin MEASUREMENT dfrzaf2_w "LRS-Zwangsamplitude, gefiltert, Bank 2" SWORD fak_sw_b1 1 100 -1 0.999969 FORMAT "%8.6" ECU_ADDRESS 0x80162A /end MEASUREMENT
/begin MEASUREMENT dfrzaf_w "LRS-Zwangsamplitude, gefiltert" SWORD fak_sw_b1 1 100 -1 0.999969 FORMAT "%8.6" ECU_ADDRESS 0x80162C /end MEASUREMENT
/begin MEASUREMENT dfrza_w "LRS-Zwangsamplitude" SWORD fak_sw_b1 1 100 -1 0.999969 FORMAT "%8.6" ECU_ADDRESS 0x80162E /end MEASUREMENT
/begin MEASUREMENT dfr_w "Delta Lambdaregler (Faktor )" SWORD fak_sw_b1 1 100 -1 0.999969 FORMAT "%8.6" ECU_ADDRESS 0x801630 /end MEASUREMENT
/begin MEASUREMENT dlahi2_w "I-Anteil der stetigen LRHK2" SWORD fak_sw_b1 1 100 -1 0.999969 FORMAT "%8.6" ECU_ADDRESS 0x801A44 /end MEASUREMENT
/begin MEASUREMENT dlahico2_w "I-Anteil der stetigen LRSHK Variante kontinuierlich, Bank 2" SWORD fak_sw_b1 1 100 -1 0.999969 FORMAT "%8.6" ECU_ADDRESS 0x7FC76A /end MEASUREMENT
/begin MEASUREMENT dlahico_w "I-Anteil der stetigen LRSHK Variante kontinuierlich" SWORD fak_sw_b1 1 100 -1 0.999969 FORMAT "%8.6" ECU_ADDRESS 0x7FC76C /end MEASUREMENT
/begin MEASUREMENT dlahini2_w "Intialisierungswert f¸r Integralanteil LRSHK, Bank2" SWORD fak_sw_b1 1 100 -1 0.999969 FORMAT "%8.6" ECU_ADDRESS 0x800AF2 /end MEASUREMENT
/begin MEASUREMENT dlahini_w "Intialisierungswert f¸r Integralanteil LRSHK" SWORD fak_sw_b1 1 100 -1 0.999969 FORMAT "%8.6" ECU_ADDRESS 0x800AF4 /end MEASUREMENT
/begin MEASUREMENT dlahi_w "I-Anteil der stetigen LRHK" SWORD fak_sw_b1 1 100 -1 0.999969 FORMAT "%8.6" ECU_ADDRESS 0x801A46 /end MEASUREMENT
/begin MEASUREMENT dlahkab2_w "Dynamische ‹berhˆhung des Pseudo Lambda-Sollwertes hinter Kat, Bank2" SWORD fak_sw_b1 1 100 -1 0.999969 FORMAT "%8.6" ECU_ADDRESS 0x801AA8 /end MEASUREMENT
/begin MEASUREMENT dlahkab_w "Dynamische ‹berhˆhung des Pseudo Lambda-Sollwertes hinter Kat" SWORD fak_sw_b1 1 100 -1 0.999969 FORMAT "%8.6" ECU_ADDRESS 0x801AAA /end MEASUREMENT
/begin MEASUREMENT dlahp2_w "P-Anteil der stetigen LRHK2" SWORD fak_sw_b1 1 100 -1 0.999969 FORMAT "%8.6" ECU_ADDRESS 0x801A48 /end MEASUREMENT
/begin MEASUREMENT dlahpco2_w "P-Anteil der stetigen LRSHK Variante kontinuierlich, Bank 2" SWORD fak_sw_b1 1 100 -1 0.999969 FORMAT "%8.6" ECU_ADDRESS 0x800AF6 /end MEASUREMENT
/begin MEASUREMENT dlahpco_w "P-Anteil der stetigen LRSHK Variante kontinuierlich" SWORD fak_sw_b1 1 100 -1 0.999969 FORMAT "%8.6" ECU_ADDRESS 0x800AF8 /end MEASUREMENT
/begin MEASUREMENT dlahp_w "P-Anteil der stetigen LRHK" SWORD fak_sw_b1 1 100 -1 0.999969 FORMAT "%8.6" ECU_ADDRESS 0x801A4A /end MEASUREMENT
/begin MEASUREMENT dlamka2_w "Delta-Lambda: Hilfsgrˆsse f¸r Auf-/Abregeln von lamka2_w f¸r Bank 2" SWORD fak_sw_b8 1 100 -1 1 FORMAT "%8.6" ECU_ADDRESS 0x801A4E /end MEASUREMENT
/begin MEASUREMENT dlamka_w "Delta-Lambda: Hilfsgrˆsse f¸r Auf-/Abregeln von lamka_w" SWORD fak_sw_b8 1 100 -1 1 FORMAT "%8.6" ECU_ADDRESS 0x801A50 /end MEASUREMENT
/begin MEASUREMENT dlashki2_w "Delta-Lambda gewichtet f¸r I-Anteil LRSHK, Bank2" SWORD fak_sw_b1 1 100 -1 0.999969 FORMAT "%8.6" ECU_ADDRESS 0x800AFA /end MEASUREMENT
/begin MEASUREMENT dlashki_w "Delta-Lambda gewichtet f¸r I-Anteil LRSHK" SWORD fak_sw_b1 1 100 -1 0.999969 FORMAT "%8.6" ECU_ADDRESS 0x800AFC /end MEASUREMENT
/begin MEASUREMENT dlashkm2_w "Delta-Lambda aus Lambdaregelung hinter Kat (Ist-Wert fr-synchron gemittelt), Ba2" SWORD fak_sw_b1 1 100 -1 0.999969 FORMAT "%8.6" ECU_ADDRESS 0x800AFE /end MEASUREMENT
/begin MEASUREMENT dlashkm_w "Delta-Lambda aus Lambdaregelung hinter Kat (Ist-Wert fr-synchron gemittelt)" SWORD fak_sw_b1 1 100 -1 0.999969 FORMAT "%8.6" ECU_ADDRESS 0x800B00 /end MEASUREMENT
/begin MEASUREMENT dlashkp2_w "Delta-Lambda gewichtet f¸r P-Anteil LRSHK5.30, Bank2" SWORD fak_sw_b1 1 100 -1 0.999969 FORMAT "%8.6" ECU_ADDRESS 0x800B02 /end MEASUREMENT
/begin MEASUREMENT dlashkp_w "Delta-Lambda gewichtet f¸r P-Anteil LRSHK5.30" SWORD fak_sw_b1 1 100 -1 0.999969 FORMAT "%8.6" ECU_ADDRESS 0x800B04 /end MEASUREMENT
/begin MEASUREMENT dlaso "Korrekturwert Lambda-Sollwert f¸r stetigen Lambdaregler, 8 Bit" SBYTE fak_sb_b0p03125 1 100 -0.03125 0.0310059 FORMAT "%7.5" ECU_ADDRESS 0x80116A /end MEASUREMENT
/begin MEASUREMENT dlaso2 "Korrekturwert Lambda-Sollwert f¸r stetigen Lambdaregler, 8 Bit, Bank 2" SBYTE fak_sb_b0p03125 1 100 -0.03125 0.0310059 FORMAT "%7.5" ECU_ADDRESS 0x80116B /end MEASUREMENT
/begin MEASUREMENT dlrfrat "Delta rl f¸r die Berechnug der Zeitkonstante der FRAT-Adaption" UWORD fak_q0p0625 1 100 0 4095.94 FORMAT "%8.3" ECU_ADDRESS 0x800B90 /end MEASUREMENT
/begin MEASUREMENT dmllrdl_w "geforderte Drehmoment‰nderung von der LLR (D-Anteil Luftpfad)" SWORD rel_sw_b100 1 100 -100 99.9969 FORMAT "%8.4" ECU_ADDRESS 0x8018BE /end MEASUREMENT
/begin MEASUREMENT dmllrd_w "geforderte Drehmoment‰nderung von der LLR (D-Anteil)" SWORD rel_sw_b100 1 100 -100 99.9969 FORMAT "%8.4" ECU_ADDRESS 0x8018C0 /end MEASUREMENT
/begin MEASUREMENT dmllrib_w "I-Anteil des Masters" SWORD rel_sw_b100 1 100 -100 99.9969 FORMAT "%8.4" ECU_ADDRESS 0x8018C2 /end MEASUREMENT
/begin MEASUREMENT dmllrii_w "I-Anteil bei Betrieb ohne DTEV" SWORD rel_sw_b100 1 100 -100 99.9969 FORMAT "%8.4" ECU_ADDRESS 0x8018C4 /end MEASUREMENT
/begin MEASUREMENT dmllriz_w "I-Anteil bei Beginn der DTEV" SWORD rel_sw_b100 1 100 -100 99.9969 FORMAT "%8.4" ECU_ADDRESS 0x8018C6 /end MEASUREMENT
/begin MEASUREMENT dmllri_w "geforderte Drehmoment‰nderung von der LLR (I-Anteil)" SWORD rel_sw_b100 1 100 -100 99.9969 FORMAT "%8.4" ECU_ADDRESS 0x8018C8 /end MEASUREMENT
/begin MEASUREMENT dmllrl_w "geforderte Drehmoment‰nderung von der LLR (Anteil Luftpfad)" SWORD rel_sw_b100 1 100 -100 99.9969 FORMAT "%8.4" ECU_ADDRESS 0x8018CA /end MEASUREMENT
/begin MEASUREMENT dmllrpl_w "geforderte Drehmoment‰nderung von der LLR (P-Anteil Luftpfad)" SWORD rel_sw_b100 1 100 -100 99.9969 FORMAT "%8.4" ECU_ADDRESS 0x8018CC /end MEASUREMENT
/begin MEASUREMENT dmllrp_w "geforderte Drehmoment‰nderung von der LLR (P-Anteil)" SWORD rel_sw_b100 1 100 -100 99.9969 FORMAT "%8.4" ECU_ADDRESS 0x8018CE /end MEASUREMENT
/begin MEASUREMENT dmllr_w "geforderte Drehmoment‰nderung von der LLR (PD-Anteil)" SWORD rel_sw_b100 1 100 -100 99.9969 FORMAT "%8.4" ECU_ADDRESS 0x8018D0 /end MEASUREMENT
/begin MEASUREMENT dmlms_w "Abstand des Sollmoments vom zul‰ssigen Moment f¸r F¸llungspfad" SWORD rel_sw_b100 1 100 -100 99.9969 FORMAT "%8.4" ECU_ADDRESS 0x80196A /end MEASUREMENT
/begin MEASUREMENT dmlwhs_w "Deltamoment Ladungswechsel zwischen Homogen- und Schicht-Betrieb" SWORD rel_sw_b50 1 100 -50 49.9985 FORMAT "%8.5" ECU_ADDRESS 0x800E14 /end MEASUREMENT
/begin MEASUREMENT dmrkt_w "Momentenreserve im Kurztrip" UWORD rel_uw_b100 1 100 0 99.9985 FORMAT "%8.5" ECU_ADDRESS 0x800D70 /end MEASUREMENT
/begin MEASUREMENT dmrmx_w "Delta-Moment F¸llung durch Momentenreserve" UWORD rel_uw_b100 1 100 0 99.9985 FORMAT "%8.5" ECU_ADDRESS 0x80196C /end MEASUREMENT
/begin MEASUREMENT dmvadfk_w "Delta-Motordrehmoment aus Verlustmoment-Adaption (B_fs=1 & B_ko=1)" SWORD rel_sw_b100 1 100 -100 99.9969 FORMAT "%8.4" ECU_ADDRESS 0x7FC848 /end MEASUREMENT
/begin MEASUREMENT dmvadfs_w "Delta-Motordrehmoment aus Verlustmoment-Adaption (B_fs=1)" SWORD rel_sw_b100 1 100 -100 99.9969 FORMAT "%8.4" ECU_ADDRESS 0x7FC84A /end MEASUREMENT
/begin MEASUREMENT dmvadko_w "Delta-Motordrehmoment aus Verlustmoment-Adaption (B_ko=1)" SWORD rel_sw_b100 1 100 -100 99.9969 FORMAT "%8.4" ECU_ADDRESS 0x7FC84C /end MEASUREMENT
/begin MEASUREMENT dmvadll_w "Delta-Motordrehmoment aus Verlustmoment-Adaption (B_ll=1)" SWORD rel_sw_b100 1 100 -100 99.9969 FORMAT "%8.4" ECU_ADDRESS 0x7FC84E /end MEASUREMENT
/begin MEASUREMENT dmvad_w "Delta-Motordrehmoment aus Verlustmoment-Adaption" SWORD rel_sw_b100 1 100 -100 99.9969 FORMAT "%8.4" ECU_ADDRESS 0x800D9A /end MEASUREMENT
/begin MEASUREMENT dmvamnfk_w "Minimalbegrenzung der Verlustmomentadaption (B_fs=1 & B_ko=1)" SWORD rel_sw_b100 1 100 -100 99.9969 FORMAT "%8.4" ECU_ADDRESS 0x800D9C /end MEASUREMENT
/begin MEASUREMENT dmvamnfs_w "Minimalbegrenzung der Verlustmomentadaption (B_fs=1)" SWORD rel_sw_b100 1 100 -100 99.9969 FORMAT "%8.4" ECU_ADDRESS 0x800D9E /end MEASUREMENT
/begin MEASUREMENT dmvamnko_w "Minimalbegrenzung der Verlustmomentadaption (B_ko=1)" SWORD rel_sw_b100 1 100 -100 99.9969 FORMAT "%8.4" ECU_ADDRESS 0x800DA0 /end MEASUREMENT
/begin MEASUREMENT dmvamnll_w "Minimalbegrenzung der Verlustmomentadaption (B_ll=1)" SWORD rel_sw_b100 1 100 -100 99.9969 FORMAT "%8.4" ECU_ADDRESS 0x800DA2 /end MEASUREMENT
/begin MEASUREMENT dmvamxfk_w "0aximalbegrenzung der Verlustmomentadaption (B_fs=1 & B_ko=1)" SWORD rel_sw_b100 1 100 -100 99.9969 FORMAT "%8.4" ECU_ADDRESS 0x800DA4 /end MEASUREMENT
/begin MEASUREMENT dmvamxfs_w "Maximalbegrenzung der Verlustmomentadaption (B_fs=1)" SWORD rel_sw_b100 1 100 -100 99.9969 FORMAT "%8.4" ECU_ADDRESS 0x800DA6 /end MEASUREMENT
/begin MEASUREMENT dmvamxko_w "Maximalbegrenzung der Verlustmomentadaption (B_ko=1)" SWORD rel_sw_b100 1 100 -100 99.9969 FORMAT "%8.4" ECU_ADDRESS 0x800DA8 /end MEASUREMENT
/begin MEASUREMENT dmvamxll_w "Maximalbegrenzung der Verlustmomentadaption (B_ll=1)" SWORD rel_sw_b100 1 100 -100 99.9969 FORMAT "%8.4" ECU_ADDRESS 0x800DAA /end MEASUREMENT
/begin MEASUREMENT dmverl_w "Verlustmoment nach DT1-Filter" SWORD rel_sw_b100 1 100 -100 99.9969 FORMAT "%8.4" ECU_ADDRESS 0x8018F0 /end MEASUREMENT
/begin MEASUREMENT dmzms_w "Abstand des indizierten Sollmoments vom zul‰ssigen Sollmoment" SWORD rel_sw_b100 1 100 -100 99.9969 FORMAT "%8.4" ECU_ADDRESS 0x80195A /end MEASUREMENT
/begin MEASUREMENT dn "Drehzahlabweichung bei Leerlaufregelung" SBYTE nmotd_sb_q10 1 100 -1280 1270 FORMAT "%5.0" ECU_ADDRESS 0x801276 /end MEASUREMENT
/begin MEASUREMENT dnbi_w "Verh‰ltnis nsol_w / nmotbi_w" SWORD nmot_sw_q0p25 1 100 -8192 8191.75 FORMAT "%8.3" ECU_ADDRESS 0x8018D2 /end MEASUREMENT
/begin MEASUREMENT dnikorr_w "Korrekturwert auf den Integrator nach Diagnose" UWORD nmot_uw_q0p25 1 100 0 16383.8 FORMAT "%8.2" ECU_ADDRESS 0x8018D4 /end MEASUREMENT
/begin MEASUREMENT dn_w "Drehzahlabweichung bei Leerlaufregelung" SWORD nmot_sw_q0p25 1 100 -8192 8191.75 FORMAT "%8.3" ECU_ADDRESS 0x8018D6 /end MEASUREMENT
/begin MEASUREMENT dzwb "Differenz BasisZW optimaler Z¸ndwinkel" SBYTE zw_sb_q0p75 1 100 -96 95.25 FORMAT "%5.2" ECU_ADDRESS 0x8012AD /end MEASUREMENT
/begin MEASUREMENT dzwi "Delta Z¸ndwinkel zwischen zwopt und zwout" SBYTE zw_sb_q0p75 1 100 -96 95.25 FORMAT "%5.2" ECU_ADDRESS 0x8012BE /end MEASUREMENT
/begin MEASUREMENT dzwoag "abgasr¸ckf¸hrratenabh. Z¸ndwinkelkorrektur des optimalen ZW" SBYTE zw_sb_q0p75 1 100 -96 95.25 FORMAT "%5.2" ECU_ADDRESS 0x8012AE /end MEASUREMENT
/begin MEASUREMENT dzwol "lambdaabh. Z¸ndwinkelkorrektur des optimalen ZW" SBYTE zw_sb_q0p75 1 100 -96 95.25 FORMAT "%5.2" ECU_ADDRESS 0x8012AF /end MEASUREMENT
/begin MEASUREMENT dzwotm "temperaturabh‰ngige Z¸ndwinkelkorrektur des optimalen ZW" SBYTE zw_sb_q0p75 1 100 -96 95.25 FORMAT "%5.2" ECU_ADDRESS 0x8012B0 /end MEASUREMENT
/begin MEASUREMENT dzw_kge "Eingang Delta-Z¸ndwinkel f¸r mehrfach verwendete Kenngrˆﬂen" SBYTE zw_sb_q0p75 1 100 -96 95.25 FORMAT "%5.2" ECU_ADDRESS 0x8012B1 /end MEASUREMENT
/begin MEASUREMENT esst_sdn10llsw "" ULONG dez 1 100 0 4.29497e+009 FORMAT "%13.2" ECU_ADDRESS 0x8020DC /end MEASUREMENT
/begin MEASUREMENT esst_sez04llub "" ULONG dez 1 100 0 4.29497e+009 FORMAT "%13.2" ECU_ADDRESS 0x8020E0 /end MEASUREMENT
/begin MEASUREMENT esst_sm109lhsw "" ULONG dez 1 100 0 4.29497e+009 FORMAT "%13.2" ECU_ADDRESS 0x801D78 /end MEASUREMENT
/begin MEASUREMENT esst_sm209lhsw "" ULONG dez 1 100 0 4.29497e+009 FORMAT "%13.2" ECU_ADDRESS 0x801D7C /end MEASUREMENT
/begin MEASUREMENT esst_sns206llsb "" ULONG dez 1 100 0 4.29497e+009 FORMAT "%13.2" ECU_ADDRESS 0x8020E4 /end MEASUREMENT
/begin MEASUREMENT esst_srl11opuw "" ULONG dez 1 100 0 4.29497e+009 FORMAT "%13.2" ECU_ADDRESS 0x8020F8 /end MEASUREMENT
/begin MEASUREMENT etalab "Lambda-Wirkungsgrad ohne Eingriff bezogen auf optimales Moment bei Lambda=1" UBYTE rel_ub_b127p5 1 100 0 127.5 FORMAT "%5.1" ECU_ADDRESS 0x8012B2 /end MEASUREMENT
/begin MEASUREMENT etatrmn "minimaler Wert in der Wirkungsgradtrommel" UBYTE rel_ub_b127p5 1 100 0 127.5 FORMAT "%5.1" ECU_ADDRESS 0x8012B3 /end MEASUREMENT
/begin MEASUREMENT etazaist "Ist-Zylinderausblendungswirkungsgrad" UBYTE rel_ub_b127p5 1 100 0 127.5 FORMAT "%5.1" ECU_ADDRESS 0x8012BF /end MEASUREMENT
/begin MEASUREMENT etazas_w "Sollwirkungsgrad f¸r Zylinderausblendung" UWORD rel_uw_b200 1 100 0 199.997 FORMAT "%8.4" ECU_ADDRESS 0x8019A0 /end MEASUREMENT
/begin MEASUREMENT etazwb "Z¸ndwinkelwirkungsgrad des Basisz¸ndwinkels" UBYTE rel_ub_b127p5 1 100 0 127.5 FORMAT "%5.1" ECU_ADDRESS 0x8012B4 /end MEASUREMENT
/begin MEASUREMENT etazwbm "gemittelter Z¸ndwinkelwirkungsgrad des Basisz¸ndwinkels" UBYTE rel_ub_b127p5 1 100 0 127.5 FORMAT "%5.1" ECU_ADDRESS 0x8012B5 /end MEASUREMENT
/begin MEASUREMENT etazwist "Ist-Z¸ndwinkelwirkungsgrad" UBYTE rel_ub_b127p5 1 100 0 127.5 FORMAT "%5.1" ECU_ADDRESS 0x8012C0 /end MEASUREMENT
/begin MEASUREMENT favkatmx "Gewichtungsfaktor Sauerstoffspeicher ¸ber avkatf" UBYTE fak_ub_b1 1 100 0 0.996094 ECU_ADDRESS 0x8007FE /end MEASUREMENT
/begin MEASUREMENT favkatmx2 "Gewichtungsfaktor Sauerstoffspeicher ¸ber avkatf, Bank 2" UBYTE fak_ub_b1 1 100 0 0.996094 ECU_ADDRESS 0x8007FF /end MEASUREMENT
/begin MEASUREMENT flglrs "CARB FREEZE FRAME Byte, Bank 1, f¸r LR" UBYTE dez 1 100 0 255 FORMAT "%5.1" ECU_ADDRESS 0x80116E /end MEASUREMENT
/begin MEASUREMENT flglrs2 "CARB FREEZE FRAME Byte, Bank 2, f¸r LR" UBYTE dez 1 100 0 255 FORMAT "%5.1" ECU_ADDRESS 0x80116F /end MEASUREMENT
/begin MEASUREMENT fnstab_w "Faktor zur Stabilisierung mittels Drehzahlquotient" UWORD fak_uw_b8 1 100 0 7.99988 FORMAT "%8.6" ECU_ADDRESS 0x800D8C /end MEASUREMENT
/begin MEASUREMENT fr2_w "Lambda-Regler-Ausgang; Bank2 (Word)" UWORD fak_uw_b2 1 100 0 1.99997 FORMAT "%8.6" ECU_ADDRESS 0x801632 /end MEASUREMENT
/begin MEASUREMENT fra2_w "multiplikative Gemischkorrektur der Gemischadaption (Word)" UWORD fak_uw_b2 1 100 0 1.99997 FORMAT "%8.6" ECU_ADDRESS 0x801754 /end MEASUREMENT
/begin MEASUREMENT frao2_w "multipl. Gemischadaptionsfaktor oberer Lastbereich Bank 2 (Word)" UWORD fak_uw_b2 1 100 0 1.99997 FORMAT "%8.6" ECU_ADDRESS 0x800B92 /end MEASUREMENT
/begin MEASUREMENT fraolt2_w "multiplikative Gemischkorrektur  frao von dem letzten Trip 2. Bank" UWORD fak_uw_b2 1 100 0 1.99997 FORMAT "%8.6" ECU_ADDRESS 0x800B94 /end MEASUREMENT
/begin MEASUREMENT fraolt_w "multiplikative Gemischkorrektur  frao von dem letzten Trip" UWORD fak_uw_b2 1 100 0 1.99997 FORMAT "%8.6" ECU_ADDRESS 0x800B96 /end MEASUREMENT
/begin MEASUREMENT frao_w "multiplikativer Gemischadaptionsfaktor oberer Lastbereich (Word)" UWORD fak_uw_b2 1 100 0 1.99997 FORMAT "%8.6" ECU_ADDRESS 0x800B98 /end MEASUREMENT
/begin MEASUREMENT frat2_w "temperaturabh‰ngige Gemischadaptionsfaktor (2. Bank)" UWORD fak_uw_b2 1 100 0 1.99997 FORMAT "%8.6" ECU_ADDRESS 0x800B9A /end MEASUREMENT
/begin MEASUREMENT frati2_w "temperaturabh‰ngige Gemischadaptionfaktor Integralwert (2. Bank)" UWORD fak_uw_b2 1 100 0 1.99997 FORMAT "%8.6" ECU_ADDRESS 0x801756 /end MEASUREMENT
/begin MEASUREMENT frati_w "temperaturabh‰ngige Gemischadaptionfaktor Integralwert" UWORD fak_uw_b2 1 100 0 1.99997 FORMAT "%8.6" ECU_ADDRESS 0x800B9C /end MEASUREMENT
/begin MEASUREMENT frat_w "temperaturabh‰ngige Gemischadaptionsfaktor" UWORD fak_uw_b2 1 100 0 1.99997 FORMAT "%8.6" ECU_ADDRESS 0x800B9E /end MEASUREMENT
/begin MEASUREMENT frau2_w "multipl. Gemischadaptionsfaktor unterer mult. Bereich der Bank 2 (Word)" UWORD fak_uw_b2 1 100 0 1.99997 FORMAT "%8.6" ECU_ADDRESS 0x800BA0 /end MEASUREMENT
/begin MEASUREMENT frault2_w "multiplikative Gemischkorrektur  frau von dem letzten Trip 2. Bank" UWORD fak_uw_b2 1 100 0 1.99997 FORMAT "%8.6" ECU_ADDRESS 0x800BA2 /end MEASUREMENT
/begin MEASUREMENT frault_w "multiplikative Gemischkorrektur  frau von dem letzten Trip" UWORD fak_uw_b2 1 100 0 1.99997 FORMAT "%8.6" ECU_ADDRESS 0x800BA4 /end MEASUREMENT
/begin MEASUREMENT frau_w "multiplikativer Gemischadaptionsfaktor unterer mult. Bereich (Word)" UWORD fak_uw_b2 1 100 0 1.99997 FORMAT "%8.6" ECU_ADDRESS 0x800BA6 /end MEASUREMENT
/begin MEASUREMENT fra_w "multiplikative Gemischkorrektur der Gemischadaption (Word)" UWORD fak_uw_b2 1 100 0 1.99997 FORMAT "%8.6" ECU_ADDRESS 0x801758 /end MEASUREMENT
/begin MEASUREMENT frini2_w "Initialisierungswert f¸r Regelfaktor Lambdaregelung, Bank 2" UWORD fak_uw_b2 1 100 0 1.99997 FORMAT "%8.6" ECU_ADDRESS 0x80168A /end MEASUREMENT
/begin MEASUREMENT frini_w "Initialisierungswert f¸r Regelfaktor Lambdaregelung" UWORD fak_uw_b2 1 100 0 1.99997 FORMAT "%8.6" ECU_ADDRESS 0x80168C /end MEASUREMENT
/begin MEASUREMENT frm2_w "schneller Mittelwert des Lambdaregelfaktors Bank 2(Word)" UWORD fak_uw_b2 1 100 0 1.99997 FORMAT "%8.6" ECU_ADDRESS 0x801634 /end MEASUREMENT
/begin MEASUREMENT frmn_w "Lambda-Regler-Ausgang Minimalwert" UWORD fak_uw_b2 1 100 0 1.99997 FORMAT "%8.6" ECU_ADDRESS 0x801636 /end MEASUREMENT
/begin MEASUREMENT frmx_w "LR mit Integratorstop : Max. Begrenzung Integrator fr,; FRMAX / angehoben d.DSLS" UWORD fak_uw_b2 1 100 0 1.99997 FORMAT "%8.6" ECU_ADDRESS 0x801638 /end MEASUREMENT
/begin MEASUREMENT frm_w "schneller Mittelwert des Lambdaregelfaktors (Word)" UWORD fak_uw_b2 1 100 0 1.99997 FORMAT "%8.6" ECU_ADDRESS 0x80163A /end MEASUREMENT
/begin MEASUREMENT froza2_w "Lambda-Regler-Ausgang ohne Zwangsanregung; Bank2" UWORD fak_uw_b2 1 100 0 1.99997 FORMAT "%8.6" ECU_ADDRESS 0x80163C /end MEASUREMENT
/begin MEASUREMENT froza_w "Lambda-Regler-Ausgang ohne Zwangsanregung" UWORD fak_uw_b2 1 100 0 1.99997 FORMAT "%8.6" ECU_ADDRESS 0x80163E /end MEASUREMENT
/begin MEASUREMENT frtmki "Regelfaktor f¸r Momentenbegrenzung aus Motortemperatur" UBYTE fak_ub_b2 1 100 0 1.99219 FORMAT "%5.3" ECU_ADDRESS 0x800D68 /end MEASUREMENT
/begin MEASUREMENT fr_w "Lambda-Regler-Ausgang (Word)" UWORD fak_uw_b2 1 100 0 1.99997 FORMAT "%8.6" ECU_ADDRESS 0x801640 /end MEASUREMENT
/begin MEASUREMENT ftklra_w "Korrekturfaktor f¸r temperaturabh‰ngigen Adaptionsfaktor" UWORD fak_uw_b2 1 100 0 1.99997 FORMAT "%8.6" ECU_ADDRESS 0x800BA8 /end MEASUREMENT
/begin MEASUREMENT g1korr "Korrekturfaktor f¸r Reglerparameter G1" UBYTE fak_ub_b2 1 100 0 1.99219 FORMAT "%5.3" ECU_ADDRESS 0x80116C /end MEASUREMENT
/begin MEASUREMENT g2korr "Korrekturfaktor f¸r Reglerparameter G2" UBYTE fak_ub_b2 1 100 0 1.99219 FORMAT "%5.3" ECU_ADDRESS 0x8007F4 /end MEASUREMENT
/begin MEASUREMENT iftkavx2_w "Fettfl‰chenschwelle = f(tikatm2_w,avkatf2), Bank 2" UWORD m_uw_b291p25 1 100 0 291.267 FORMAT "%8.4" ECU_ADDRESS 0x8007F6 /end MEASUREMENT
/begin MEASUREMENT iftkavx_w "Fettfl‰chenschwelle = f(tikatm_w,avkatf)" UWORD m_uw_b291p25 1 100 0 291.267 FORMAT "%8.4" ECU_ADDRESS 0x8007F8 /end MEASUREMENT
/begin MEASUREMENT ilmlka2_w "Integrator Fettfl‰che f¸r Katalysator-Ausr‰umen, Bank 2" UWORD m_uw_b4660 1 100 0 4660.27 FORMAT "%8.3" ECU_ADDRESS 0x801A52 /end MEASUREMENT
/begin MEASUREMENT ilmlka_w "Integrator Fettfl‰che f¸r Katalysator-Ausr‰umen" UWORD m_uw_b4660 1 100 0 4660.27 FORMAT "%8.3" ECU_ADDRESS 0x801A54 /end MEASUREMENT
/begin MEASUREMENT ilmltkx2_w "Ausgang Kennlinie ILMLKAXTK2" UWORD m_uw_b291p25 1 100 0 291.267 FORMAT "%8.4" ECU_ADDRESS 0x8007FA /end MEASUREMENT
/begin MEASUREMENT ilmltkx_w "Ausgang Kennlinie ILMLKAXTK" UWORD m_uw_b291p25 1 100 0 291.267 FORMAT "%8.4" ECU_ADDRESS 0x8007FC /end MEASUREMENT
/begin MEASUREMENT imlevab2_w "Luftmasse nach Zylinderausblendung f¸r stetige Lambdaregelung, Bank 2" UWORD m_uw_b4660 1 100 0 4660.27 FORMAT "%8.3" ECU_ADDRESS 0x801684 /end MEASUREMENT
/begin MEASUREMENT imlevab_w "Luftmasse nach Zylinderausblendung f¸r stetige Lambdaregelung" UWORD m_uw_b4660 1 100 0 4660.27 FORMAT "%8.3" ECU_ADDRESS 0x801686 /end MEASUREMENT
/begin MEASUREMENT imlka2_w "Integrator Luftmasse f¸r Katalysator-Ausr‰umen f¸r Stereo-LR Bank 2" UWORD m_uw_b291p25 1 100 0 291.267 FORMAT "%8.4" ECU_ADDRESS 0x801A56 /end MEASUREMENT
/begin MEASUREMENT imlka_w "Integrator Luftmasse f¸r Katalysator-Ausr‰umen" UWORD m_uw_b291p25 1 100 0 291.267 FORMAT "%8.4" ECU_ADDRESS 0x801A58 /end MEASUREMENT
/begin MEASUREMENT imllaka2_w "Integrator Fettfl‰che f¸r Katalysator-Ausr‰umen Bank2" UWORD m_uw_b291p25 1 100 0 291.267 FORMAT "%8.4" ECU_ADDRESS 0x801A5A /end MEASUREMENT
/begin MEASUREMENT imllaka_w "Integrator Fettfl‰che f¸r Katalysator-Ausr‰umen" UWORD m_uw_b291p25 1 100 0 291.267 FORMAT "%8.4" ECU_ADDRESS 0x801A5C /end MEASUREMENT
/begin MEASUREMENT imlrlhk_w "Luftmasse nach Instation‰rbetrieb (drlas_w > DRLLRHKO ODER drlas < DRLLRHKU)" UWORD m_uw_b7281 1 100 0 7281.67 FORMAT "%8.3" ECU_ADDRESS 0x800B22 /end MEASUREMENT
/begin MEASUREMENT imlrsa_w "Luftmasse nach SA f¸r stetige Lambdaregelung" UWORD m_uw_b4660 1 100 0 4660.27 FORMAT "%8.3" ECU_ADDRESS 0x801688 /end MEASUREMENT
/begin MEASUREMENT iver "Integratorverst‰rkung" UBYTE rel_q0p002383 1 100 0 0.607617 ECU_ADDRESS 0x801277 /end MEASUREMENT
/begin MEASUREMENT kfmdsnw_w "Schleppmoment Drehzahl-, ‹berschneidungswinkel  und Lastabh‰ngigkeit" UWORD rel_uw_b100 1 100 0 99.9985 FORMAT "%8.5" ECU_ADDRESS 0x800D90 /end MEASUREMENT
/begin MEASUREMENT ladiff2_w "Regelabweichung Lambda;Bank2" SWORD fak_sw_b1 1 100 -1 0.999969 FORMAT "%8.6" ECU_ADDRESS 0x801642 /end MEASUREMENT
/begin MEASUREMENT ladiff_w "Regelabweichung Lambda" SWORD fak_sw_b1 1 100 -1 0.999969 FORMAT "%8.6" ECU_ADDRESS 0x801644 /end MEASUREMENT
/begin MEASUREMENT lahkf2_w "Pseudolinearisietes Lambda hinter Kat, PT1-gefiltert, Auflˆsung 0 ... <2, Bank 2" UWORD fak_uw_b2 1 100 0 1.99997 FORMAT "%8.6" ECU_ADDRESS 0x800B06 /end MEASUREMENT
/begin MEASUREMENT lahkf_w "Pseudolinearisietes Lambda hinter Kat, PT1-gefiltert, Word, Auflˆsung 0 ... <2" UWORD fak_uw_b2 1 100 0 1.99997 FORMAT "%8.6" ECU_ADDRESS 0x800B08 /end MEASUREMENT
/begin MEASUREMENT lahkm2_w "fr-synchron gemittelter Pseudo Lambda-Istwert gem. mit Nernst-Sonde h.Kat, Bnk2" UWORD fak_uw_b2 1 100 0 1.99997 FORMAT "%8.6" ECU_ADDRESS 0x800B0A /end MEASUREMENT
/begin MEASUREMENT lahkmz "Zustandsbyte des Automaten: fr-synchrone Mittelung Pseodo-Lambda hinter Kat" UBYTE DEZ 1 100 0 255 FORMAT "%5.1" ECU_ADDRESS 0x800F36 /end MEASUREMENT
/begin MEASUREMENT lahkmz2 "Zustandsbyte des Automaten: fr-synchrone Mittelung Pseodo-Lambda h. Kat, Bank 2" UBYTE DEZ 1 100 0 255 FORMAT "%5.1" ECU_ADDRESS 0x800F37 /end MEASUREMENT
/begin MEASUREMENT lahkm_w "fr-synchron gemittelter Pseudo Lambda-Istwert gem.  Nernst-Sonde h.Kat" UWORD fak_uw_b2 1 100 0 1.99997 FORMAT "%8.6" ECU_ADDRESS 0x800B0C /end MEASUREMENT
/begin MEASUREMENT lamka2_w "Lambdasollwert Katausr‰umen, Bank2" UWORD fak_uw_b16 1 100 0 15.9998 FORMAT "%8.5" ECU_ADDRESS 0x801A5E /end MEASUREMENT
/begin MEASUREMENT lamka_w "Lambdasollwert Katausr‰umen" UWORD fak_uw_b16 1 100 0 15.9998 FORMAT "%8.5" ECU_ADDRESS 0x801A60 /end MEASUREMENT
/begin MEASUREMENT lamsbgt2_w "Lambdasoll bezogen auf Brennraum Bank 2, totzeitverschoben" UWORD fak_uw_b16 1 100 0 15.9998 FORMAT "%8.5" ECU_ADDRESS 0x801646 /end MEASUREMENT
/begin MEASUREMENT lamsbgt_w "Lambdasoll bezogen auf Brennraum, totzeitverschoben" UWORD fak_uw_b16 1 100 0 15.9998 FORMAT "%8.5" ECU_ADDRESS 0x801648 /end MEASUREMENT
/begin MEASUREMENT lamsbpr2_w "Lambda-Soll-Wert vor Begrenzung nach unten, Bank 2" UWORD fak_uw_b16 1 100 0 15.9998 FORMAT "%8.5" ECU_ADDRESS 0x80164A /end MEASUREMENT
/begin MEASUREMENT lamsbpr_w "Lambda-Soll-Wert vor Begrenzung nach unten" UWORD fak_uw_b16 1 100 0 15.9998 FORMAT "%8.5" ECU_ADDRESS 0x80164C /end MEASUREMENT
/begin MEASUREMENT lamzak2_w "Lambdasondenistwert, korrigiert um Zusatzamplitude, Bank2" UWORD fak_uw_b16 1 100 0 15.9998 FORMAT "%8.5" ECU_ADDRESS 0x80164E /end MEASUREMENT
/begin MEASUREMENT lamzak_w "Lambdasondenistwert, korrigiert um Zusatzamplitude" UWORD fak_uw_b16 1 100 0 15.9998 FORMAT "%8.5" ECU_ADDRESS 0x801650 /end MEASUREMENT
/begin MEASUREMENT lamzapr2_w "Lambda-Ist-Wert bereinigt um Zwangsamplitude vor Begrenzung nach unten, Bank 2" UWORD fak_uw_b16 1 100 0 15.9998 FORMAT "%8.5" ECU_ADDRESS 0x801652 /end MEASUREMENT
/begin MEASUREMENT lamzapr_w "Lambda-Ist-Wert bereinigt um Zwangsamplitude vor Begrenzung nach unten" UWORD fak_uw_b16 1 100 0 15.9998 FORMAT "%8.5" ECU_ADDRESS 0x801654 /end MEASUREMENT
/begin MEASUREMENT lasolhk2_w "Pseudo Lambda-Sollwert hinter Kat, Quantisierung 0 ... <2, Bank 2" UWORD fak_uw_b2 1 100 0 1.99997 FORMAT "%8.6" ECU_ADDRESS 0x800B0E /end MEASUREMENT
/begin MEASUREMENT lasolhk_w "Pseudo Lambda-Sollwert hinter Kat, Quantisierung 0 ... <2" UWORD fak_uw_b2 1 100 0 1.99997 FORMAT "%8.6" ECU_ADDRESS 0x800B10 /end MEASUREMENT
/begin MEASUREMENT lasonhk2_w "Pseudo Lambda-Istwert gemessen mit Nernst-Sonde hinter Kat, Aufl. 0 .. <2,Bank2" UWORD fak_uw_b2 1 100 0 1.99997 FORMAT "%8.6" ECU_ADDRESS 0x800B12 /end MEASUREMENT
/begin MEASUREMENT lasonhk_w "Pseudo Lambda-Istwert gemessen mit Nernst-Sonde hinter Kat, Aufl. 0 .. <2" UWORD fak_uw_b2 1 100 0 1.99997 FORMAT "%8.6" ECU_ADDRESS 0x800B14 /end MEASUREMENT
/begin MEASUREMENT limax_w "LLR-Integrator-Maximalwert" SWORD rel_sw_b100 1 100 -100 99.9969 FORMAT "%8.4" ECU_ADDRESS 0x8018D8 /end MEASUREMENT
/begin MEASUREMENT limin_w "LLR-Integrator-Minimalwert" SWORD rel_sw_b100 1 100 -100 99.9969 FORMAT "%8.4" ECU_ADDRESS 0x8018DA /end MEASUREMENT
/begin MEASUREMENT limnst "LLR-Integrator-Minimalwert w‰hrend Nachstart" UBYTE rel_ub_b24p9 1 100 0 24.9 FORMAT "%5.2" ECU_ADDRESS 0x801278 /end MEASUREMENT
/begin MEASUREMENT lrkaz "Zustandsbyte des Automaten Kat-Ausr‰umen" UBYTE dez 1 100 0 255 FORMAT "%5.1" ECU_ADDRESS 0x800F2D /end MEASUREMENT
/begin MEASUREMENT lrkaz2 "Zustandsbyte des Automaten Kat-Ausr‰umen f¸r Stereo-LR Bank 2" UBYTE dez 1 100 0 255 FORMAT "%5.1" ECU_ADDRESS 0x800F2E /end MEASUREMENT
/begin MEASUREMENT lrsg1_w "Interner Reglerkoeffizient stetige Lambdaregelung" SWORD fak_sw_b32 1 100 -32 31.999 FORMAT "%8.5" ECU_ADDRESS 0x801656 /end MEASUREMENT
/begin MEASUREMENT lrsg2_w "Interner Reglerkoeffizient stetige Lambdaregelung" UWORD fak_uw_b64 1 100 0 63.999 FORMAT "%8.5" ECU_ADDRESS 0x801658 /end MEASUREMENT
/begin MEASUREMENT lrsg4_w "Interner Reglerkoeffizient stetige Lambdaregelung" SWORD fak_sw_b2 1 100 -2 1.99994 FORMAT "%8.6" ECU_ADDRESS 0x80165A /end MEASUREMENT
/begin MEASUREMENT LRSHKCBits1_100ms "" UBYTE dez 1 100 0 255 FORMAT "%5.1" ECU_ADDRESS 0x800B1E /end MEASUREMENT
/begin MEASUREMENT lrshkebAusBits "" UBYTE dez 1 100 0 255 FORMAT "%5.1" ECU_ADDRESS 0x800B28 /end MEASUREMENT
/begin MEASUREMENT lrshkebAusBits10ms "" UBYTE dez 1 100 0 255 FORMAT "%5.1" ECU_ADDRESS 0x800B29 /end MEASUREMENT
/begin MEASUREMENT lrshkebAusBits_2 "" UBYTE dez 1 100 0 255 FORMAT "%5.1" ECU_ADDRESS 0x800B2A /end MEASUREMENT
/begin MEASUREMENT lrshkebLokBits "" UBYTE dez 1 100 0 255 FORMAT "%5.1" ECU_ADDRESS 0x800B2B /end MEASUREMENT
/begin MEASUREMENT lrshkebLokBits1 "" UBYTE dez 1 100 0 255 FORMAT "%5.1" ECU_ADDRESS 0x800B2C /end MEASUREMENT
/begin MEASUREMENT lrshkebLokBits1_2 "" UBYTE dez 1 100 0 255 FORMAT "%5.1" ECU_ADDRESS 0x800B2D /end MEASUREMENT
/begin MEASUREMENT lrshkebLokBits_2 "" UBYTE dez 1 100 0 255 FORMAT "%5.1" ECU_ADDRESS 0x800B2E /end MEASUREMENT
/begin MEASUREMENT lrskaBits1_20ms "" UBYTE dez 1 100 0 255 FORMAT "%5.1" ECU_ADDRESS 0x800F2F /end MEASUREMENT
/begin MEASUREMENT lrskaBits_20ms "" UBYTE dez 1 100 0 255 FORMAT "%5.1" ECU_ADDRESS 0x800F30 /end MEASUREMENT
/begin MEASUREMENT lrsp1_w "Interner Reglerkoeffizient stetige Lambdaregelung" UWORD fak_uw_b128 1 100 0 127.998 FORMAT "%8.4" ECU_ADDRESS 0x80165C /end MEASUREMENT
/begin MEASUREMENT lrsp2_w "Interner Reglerkoeffizient stetige Lambdaregelung" UWORD fak_uw_b128 1 100 0 127.998 FORMAT "%8.4" ECU_ADDRESS 0x80165E /end MEASUREMENT
/begin MEASUREMENT lrsp3_w "Interner Reglerkoeffizient stetige Lambdaregelung" UWORD fak_uw_b128 1 100 0 127.998 FORMAT "%8.4" ECU_ADDRESS 0x801660 /end MEASUREMENT
/begin MEASUREMENT lrsp4_w "Interner Reglerkoeffizient stetige Lambdaregelung" SWORD fak_sw_b64 1 100 -64 63.998 FORMAT "%8.5" ECU_ADDRESS 0x801662 /end MEASUREMENT
/begin MEASUREMENT lrsw12_w "Interner Reglerzustand stetige Lambdaregelung;Bank2" SWORD fak_sw_b4 1 100 -4 3.99988 FORMAT "%8.6" ECU_ADDRESS 0x801664 /end MEASUREMENT
/begin MEASUREMENT lrsw1_w "Interner Reglerzustand stetige Lambdaregelung" SWORD fak_sw_b4 1 100 -4 3.99988 FORMAT "%8.6" ECU_ADDRESS 0x801666 /end MEASUREMENT
/begin MEASUREMENT lrsw22_w "Interner Reglerzustand stetige Lambdaregelung;Bank2" SWORD fak_sw_b4 1 100 -4 3.99988 FORMAT "%8.6" ECU_ADDRESS 0x801668 /end MEASUREMENT
/begin MEASUREMENT lrsw2_w "Interner Reglerzustand stetige Lambdaregelung" SWORD fak_sw_b4 1 100 -4 3.99988 FORMAT "%8.6" ECU_ADDRESS 0x80166A /end MEASUREMENT
/begin MEASUREMENT lrsxk12_w "Interner Reglerzustand stetige Lambdaregelung;Bank 2" SWORD fak_sw_b1 1 100 -1 0.999969 FORMAT "%8.6" ECU_ADDRESS 0x80166C /end MEASUREMENT
/begin MEASUREMENT lrsxk1_w "Interner Reglerzustand stetige Lambdaregelung" SWORD fak_sw_b1 1 100 -1 0.999969 FORMAT "%8.6" ECU_ADDRESS 0x80166E /end MEASUREMENT
/begin MEASUREMENT lrsxk32_w "Interner Reglerzustand stetige Lambdaregelung;Bank2" SWORD fak_sw_b1 1 100 -1 0.999969 FORMAT "%8.6" ECU_ADDRESS 0x801670 /end MEASUREMENT
/begin MEASUREMENT lrsxk3_w "Interner Reglerzustand stetige Lambdaregelung" SWORD fak_sw_b1 1 100 -1 0.999969 FORMAT "%8.6" ECU_ADDRESS 0x801672 /end MEASUREMENT
/begin MEASUREMENT lrsxk42_w "Interner Reglerzustand stetige Lambdaregelung;Bank2" SWORD fak_sw_b1 1 100 -1 0.999969 FORMAT "%8.6" ECU_ADDRESS 0x801674 /end MEASUREMENT
/begin MEASUREMENT lrsxk4_w "Interner Reglerzustand stetige Lambdaregelung" SWORD fak_sw_b1 1 100 -1 0.999969 FORMAT "%8.6" ECU_ADDRESS 0x801676 /end MEASUREMENT
/begin MEASUREMENT lrsy22_w "Interner Reglerzustand stetige Lambdaregelung;Bank2" SWORD fak_sw_b1 1 100 -1 0.999969 FORMAT "%8.6" ECU_ADDRESS 0x801678 /end MEASUREMENT
/begin MEASUREMENT lrsy2_w "Interner Reglerzustand stetige Lambdaregelung" SWORD fak_sw_b1 1 100 -1 0.999969 FORMAT "%8.6" ECU_ADDRESS 0x80167A /end MEASUREMENT
/begin MEASUREMENT lrsy42_w "Interner Reglerzustand stetige Lambdaregelung;Bank2" SWORD fak_sw_b8 1 100 -8 7.99976 FORMAT "%8.6" ECU_ADDRESS 0x80167C /end MEASUREMENT
/begin MEASUREMENT lrsy4_w "Interner Reglerzustand stetige Lambdaregelung" SWORD fak_sw_b8 1 100 -8 7.99976 FORMAT "%8.6" ECU_ADDRESS 0x80167E /end MEASUREMENT
/begin MEASUREMENT lrsza "Amplitude erzwungener Lambdamodulation" UBYTE fak_ub_b0p25 1 100 0 0.249023 FORMAT "%11.9" ECU_ADDRESS 0x8007F5 /end MEASUREMENT
/begin MEASUREMENT mdindg_w "indiziertes Motormoment Hochdruckphase wenn alle Zylinder befeuert" UWORD rel_uw_b100 1 100 0 99.9985 FORMAT "%8.5" ECU_ADDRESS 0x80199A /end MEASUREMENT
/begin MEASUREMENT mdns_w "Nachstartmoment" UWORD rel_uw_b100 1 100 0 99.9985 FORMAT "%8.5" ECU_ADDRESS 0x800D92 /end MEASUREMENT
/begin MEASUREMENT mdsh_w "Hˆhenabh‰ngiger Anteil Schleppmoment" SWORD rel_sw_b50 1 100 -50 49.9985 FORMAT "%8.5" ECU_ADDRESS 0x800D94 /end MEASUREMENT
/begin MEASUREMENT mdsmnw_w "Schleppmoment bei NW-Verstellung Temperatur-Anteil" UWORD rel_uw_b100 1 100 0 99.9985 FORMAT "%8.5" ECU_ADDRESS 0x800D96 /end MEASUREMENT
/begin MEASUREMENT mdsm_w "Schleppmoment Temperatur-Anteil" UWORD rel_uw_b100 1 100 0 99.9985 FORMAT "%8.5" ECU_ADDRESS 0x800D98 /end MEASUREMENT
/begin MEASUREMENT mdssta_w "Motortemperaturabh‰ngiger Anteil nach Start f¸r Schleppmoment" UWORD rel_uw_b100 1 100 0 99.9985 FORMAT "%8.5" ECU_ADDRESS 0x8018F2 /end MEASUREMENT
/begin MEASUREMENT mds_w "Motorschleppmoment" UWORD rel_uw_b100 1 100 0 99.9985 FORMAT "%8.5" ECU_ADDRESS 0x8018F4 /end MEASUREMENT
/begin MEASUREMENT MDVERADlokbits "" UBYTE dez 1 100 0 255 FORMAT "%5.1" ECU_ADDRESS 0x80127C /end MEASUREMENT
/begin MEASUREMENT mdverf_w "Gefiltertes Verlustmoment" UWORD rel_uw_b100 1 100 0 99.9985 FORMAT "%8.5" ECU_ADDRESS 0x8018F6 /end MEASUREMENT
/begin MEASUREMENT mdverl_w "Motor-Verlustmoment" UWORD rel_uw_b100 1 100 0 99.9985 FORMAT "%8.5" ECU_ADDRESS 0x8018F8 /end MEASUREMENT
/begin MEASUREMENT mdvervf_w "ungefiltertes Verlustmoment" SWORD rel_sw_b100 1 100 -100 99.9969 FORMAT "%8.4" ECU_ADDRESS 0x8018FA /end MEASUREMENT
/begin MEASUREMENT mdvglw_w "Momentenbedarf der Vorgelegewelle" UWORD rel_uw_b100 1 100 0 99.9985 FORMAT "%8.5" ECU_ADDRESS 0x8018FC /end MEASUREMENT
/begin MEASUREMENT miagkbe_w "aufbereitetes koordiniertes indiziertes Moment AGK" UWORD rel_uw_b100 1 100 0 99.9985 FORMAT "%8.5" ECU_ADDRESS 0x801952 /end MEASUREMENT
/begin MEASUREMENT miagknbe_w "koordiniertes indiziertes Moment nach ƒnderungsbegrenzung" UWORD rel_uw_b100 1 100 0 99.9985 FORMAT "%8.5" ECU_ADDRESS 0x801954 /end MEASUREMENT
/begin MEASUREMENT miatbgr_w "Momentenbegrenzung bei zu hoher Abgastemperatur" UWORD rel_uw_b100 1 100 0 99.9985 FORMAT "%8.5" ECU_ADDRESS 0x800D6A /end MEASUREMENT
/begin MEASUREMENT mibas_w "indiziertes Basis-Moment" UWORD rel_uw_b100 1 100 0 99.9985 FORMAT "%8.5" ECU_ADDRESS 0x801978 /end MEASUREMENT
/begin MEASUREMENT mibgrl_w "indiziertes soll-Moment f¸r Momentbegrenzung Luftpfad" UWORD rel_uw_b100 1 100 0 99.9985 FORMAT "%8.5" ECU_ADDRESS 0x800D6C /end MEASUREMENT
/begin MEASUREMENT migef_w "Gefiltertes indiziertes Fahrerwunschmoment" UWORD rel_uw_b100 1 100 0 99.9985 FORMAT "%8.5" ECU_ADDRESS 0x801956 /end MEASUREMENT
/begin MEASUREMENT miistoal_w "Istmoment ohne Antiruckel und Leerlaufregelung" UWORD rel_uw_b100 1 100 0 99.9985 FORMAT "%8.5" ECU_ADDRESS 0x800E16 /end MEASUREMENT
/begin MEASUREMENT miistoa_w "Istmoment ohne Antiruckel" UWORD rel_uw_b100 1 100 0 99.9985 FORMAT "%8.5" ECU_ADDRESS 0x80199E /end MEASUREMENT
/begin MEASUREMENT miist_w "indiziertes Motormoment Hochdruckphase Istwert" UWORD rel_uw_b100 1 100 0 99.9985 FORMAT "%8.5" ECU_ADDRESS 0x80199C /end MEASUREMENT
/begin MEASUREMENT mikoks_w "Koordiniertes indiziertes Sollmoment an kurbelwellensynchronen pfad" UWORD rel_uw_b100 1 100 0 99.9985 FORMAT "%8.5" ECU_ADDRESS 0x801958 /end MEASUREMENT
/begin MEASUREMENT mikols_w "Koordiniertes indiziertes Sollmoment an Luftpfad" UWORD rel_uw_b100 1 100 0 99.9985 FORMAT "%8.5" ECU_ADDRESS 0x80196E /end MEASUREMENT
/begin MEASUREMENT mildmis_w "Koordiniertes indiziertes Sollmoment an Luftpfad inklusive Deltamomente" UWORD rel_uw_b100 1 100 0 99.9985 FORMAT "%8.5" ECU_ADDRESS 0x801970 /end MEASUREMENT
/begin MEASUREMENT mill_w "Indiziertes Motormoment im Leerlauf" UWORD rel_uw_b100 1 100 0 99.9985 FORMAT "%8.5" ECU_ADDRESS 0x8018E8 /end MEASUREMENT
/begin MEASUREMENT milres_w "Momentenanforderung f¸r Luftpfad mit allen Reserven" UWORD rel_uw_b100 1 100 0 99.9985 FORMAT "%8.5" ECU_ADDRESS 0x801972 /end MEASUREMENT
/begin MEASUREMENT milsol_w "Fahrermomentenwunsch f¸r F¸llung" UWORD rel_uw_b100 1 100 0 99.9985 FORMAT "%8.5" ECU_ADDRESS 0x801974 /end MEASUREMENT
/begin MEASUREMENT mimax_w "maximal erreichbares indiziertes Moment" UWORD rel_uw_b100 1 100 0 99.9985 FORMAT "%8.5" ECU_ADDRESS 0x800D86 /end MEASUREMENT
/begin MEASUREMENT miminds_w "gewichtetes Verlustmoment bei ASG" UWORD rel_uw_b100 1 100 0 99.9985 FORMAT "%8.5" ECU_ADDRESS 0x8018EA /end MEASUREMENT
/begin MEASUREMENT mimins_w "minimales Schubmoment" UWORD rel_uw_b100 1 100 0 99.9985 FORMAT "%8.5" ECU_ADDRESS 0x8018EC /end MEASUREMENT
/begin MEASUREMENT mimin_w "Minimales Motor-Moment" UWORD rel_uw_b100 1 100 0 99.9985 FORMAT "%8.5" ECU_ADDRESS 0x8018EE /end MEASUREMENT
/begin MEASUREMENT mimnl_w "indiziertes Moment aus Minimumauswahl des Luftpfades" UWORD rel_uw_b100 1 100 0 99.9985 FORMAT "%8.5" ECU_ADDRESS 0x801976 /end MEASUREMENT
/begin MEASUREMENT mimxl1_w "Maximales optimales Moment bei Lambda = 1" UWORD rel_uw_b100 1 100 0 99.9985 FORMAT "%8.5" ECU_ADDRESS 0x800D88 /end MEASUREMENT
/begin MEASUREMENT mioptl1_w "optimales indiziertes Motormoment bei Lambda = 1" UWORD rel_uw_b100 1 100 0 99.9985 FORMAT "%8.5" ECU_ADDRESS 0x80197A /end MEASUREMENT
/begin MEASUREMENT miopt_w "optimales indiziertes Moment" UWORD rel_uw_b100 1 100 0 99.9985 FORMAT "%8.5" ECU_ADDRESS 0x80197C /end MEASUREMENT
/begin MEASUREMENT mismnskh_w "min. Solluftmoment in Betriebsart Schicht-Katheizen" UWORD rel_uw_b100 1 100 0 99.9985 FORMAT "%8.5" ECU_ADDRESS 0x80197E /end MEASUREMENT
/begin MEASUREMENT misol "Indiziertes resultierendes Sollmoment" UBYTE rel_ub_b100 1 100 0 99.6094 FORMAT "%5.2" ECU_ADDRESS 0x8012AC /end MEASUREMENT
/begin MEASUREMENT misolbv_w "Indiziertes Sollmoment mit Begrenzung f¸r Einspritzausblendung vor Begrenzung" UWORD rel_uw_b100 1 100 0 99.9985 FORMAT "%8.5" ECU_ADDRESS 0x80195C /end MEASUREMENT
/begin MEASUREMENT misoldlr_w "Indiziertes resultierendes Sollmoment inkl. Deltamoment LLR" UWORD rel_uw_b100 1 100 0 99.9985 FORMAT "%8.5" ECU_ADDRESS 0x80195E /end MEASUREMENT
/begin MEASUREMENT misolp_w "Indiziertes Sollmoment vor Momentenbegrenzung, lokale Grˆﬂe" UWORD rel_uw_b100 1 100 0 99.9985 FORMAT "%8.5" ECU_ADDRESS 0x801960 /end MEASUREMENT
/begin MEASUREMENT misolv_w "Indiziertes resultierendes Sollmoment vor Momentenbegrenzung" UWORD rel_uw_b100 1 100 0 99.9985 FORMAT "%8.5" ECU_ADDRESS 0x801962 /end MEASUREMENT
/begin MEASUREMENT misol_w "Indiziertes resultierendes Sollmoment" UWORD rel_uw_b100 1 100 0 99.9985 FORMAT "%8.5" ECU_ADDRESS 0x801964 /end MEASUREMENT
/begin MEASUREMENT misophmm_w "max. Solluftmoment in Betriebsart Homogen mager" UWORD rel_uw_b100 1 100 0 99.9985 FORMAT "%8.5" ECU_ADDRESS 0x801980 /end MEASUREMENT
/begin MEASUREMENT misophos_w "max. Solluftmoment in Betriebsart Homogen schicht" UWORD rel_uw_b100 1 100 0 99.9985 FORMAT "%8.5" ECU_ADDRESS 0x801982 /end MEASUREMENT
/begin MEASUREMENT misopl1u_w "Solluftmoment, r¸ckgerechnet auf Lambda=1 und zwopt bei Umschaltung" UWORD rel_uw_b100 1 100 0 99.9985 FORMAT "%8.5" ECU_ADDRESS 0x801984 /end MEASUREMENT
/begin MEASUREMENT misopl1_w "Solluftmoment, r¸ckgerechnet auf Lambda=1 und zwopt" UWORD rel_uw_b100 1 100 0 99.9985 FORMAT "%8.5" ECU_ADDRESS 0x801986 /end MEASUREMENT
/begin MEASUREMENT misopsch_w "max. Solluftmoment in Betriebsart Schicht" UWORD rel_uw_b100 1 100 0 99.9985 FORMAT "%8.5" ECU_ADDRESS 0x801988 /end MEASUREMENT
/begin MEASUREMENT misopskh_w "max. Solluftmoment in Betriebsart Schicht-Katheizen" UWORD rel_uw_b100 1 100 0 99.9985 FORMAT "%8.5" ECU_ADDRESS 0x80198A /end MEASUREMENT
/begin MEASUREMENT mitmbgr_w "Momentenbegrenzung durch erhˆhte Motortemperatur" UWORD rel_uw_b100 1 100 0 99.9985 FORMAT "%8.5" ECU_ADDRESS 0x800D6E /end MEASUREMENT
/begin MEASUREMENT mizsolv_w "Indiziertes resultierendes Sollmoment f¸r ZW-Eingriff vor Momentenbegrenzung" UWORD rel_uw_b100 1 100 0 99.9985 FORMAT "%8.5" ECU_ADDRESS 0x801966 /end MEASUREMENT
/begin MEASUREMENT mizsol_w "Indiziertes resultierendes Sollmoment f¸r ZW-Eingriff" UWORD rel_uw_b100 1 100 0 99.9985 FORMAT "%8.5" ECU_ADDRESS 0x801968 /end MEASUREMENT
/begin MEASUREMENT mizwmn_w "indiziertes Motormoment beim sp‰testen Z¸ndwinkel" UWORD rel_uw_b100 1 100 0 99.9985 FORMAT "%8.5" ECU_ADDRESS 0x8019A2 /end MEASUREMENT
/begin MEASUREMENT mlnka2_w "Luftmasse nach Kat-Ausr‰umen, Bank 2" UWORD m_uw_b7281 1 100 0 7281.67 FORMAT "%8.3" ECU_ADDRESS 0x800B24 /end MEASUREMENT
/begin MEASUREMENT mlnka_w "Luftmasse nach Kat-Ausr‰umen" UWORD m_uw_b7281 1 100 0 7281.67 FORMAT "%8.3" ECU_ADDRESS 0x800B26 /end MEASUREMENT
/begin MEASUREMENT ngasf_w "Drehzahlgradient ¸ber ein Arbeitsspiel (gefiltert)" SWORD nmotg_sw_q0p39 1 100 -12800.2 12799.8 FORMAT "%8.2" ECU_ADDRESS 0x8018DC /end MEASUREMENT
/begin MEASUREMENT nver_w "Drehzahlverh‰ltnis" UWORD fak_uw_b8 1 100 0 7.99988 FORMAT "%8.6" ECU_ADDRESS 0x800D8E /end MEASUREMENT
/begin MEASUREMENT pvdnkhl "geforderte Drehmoment‰nderung (Kat-heizung) von der LLR (P-Anteil)" UBYTE fak_q0p00153 1 100 0 0.389099 ECU_ADDRESS 0x801279 /end MEASUREMENT
/begin MEASUREMENT redeta_w "Reduzierstufe aus Ausblendungswirkungsgrad" SWORD rel_sw_b32 1 100 -32 31.999 FORMAT "%8.5" ECU_ADDRESS 0x8019A4 /end MEASUREMENT
/begin MEASUREMENT redhyst "Reduzierstufenhysterese" SBYTE fak_sb_b2 1 100 -2 1.98438 FORMAT "%5.3" ECU_ADDRESS 0x8012C1 /end MEASUREMENT
/begin MEASUREMENT redneu "neu berechnete Reduzierstufe" UBYTE dez 1 100 0 255 FORMAT "%5.1" ECU_ADDRESS 0x8012C2 /end MEASUREMENT
/begin MEASUREMENT redsol "Berechnete Soll-Reduzierstufe" UBYTE dez 1 100 0 255 FORMAT "%5.1" ECU_ADDRESS 0x8012C3 /end MEASUREMENT
/begin MEASUREMENT redze "Schwelle in Reduzierstufe zwischen Z¸nd- und Einspritzeingriff" UBYTE dez 1 100 0 255 FORMAT "%5.1" ECU_ADDRESS 0x8012C4 /end MEASUREMENT
/begin MEASUREMENT redzenl "Schwelle in Reduzierstufe zwischen Z¸nd- und Einspritzeingriff, Notlauf" UBYTE dez 1 100 0 255 FORMAT "%5.1" ECU_ADDRESS 0x8012C5 /end MEASUREMENT
/begin MEASUREMENT rka2_w "Additive adaptive Korrektur der relativen Kraftstoffmasse" SWORD rel_sw_b1536 1 100 -1536 1535.95 FORMAT "%8.3" ECU_ADDRESS 0x80175A /end MEASUREMENT
/begin MEASUREMENT rkat2_w "additive Gemischkorrektur (pro Zeit) der Gemischadaption Bank 2 (Word)" SWORD rel_sw_b1536 1 100 -1536 1535.95 FORMAT "%8.3" ECU_ADDRESS 0x800BAA /end MEASUREMENT
/begin MEASUREMENT rkatlt2_w "additive Gemischkorrektur von der letzten Trip (HFM 2. Bank)" SWORD rel_sw_b1536 1 100 -1536 1535.95 FORMAT "%8.3" ECU_ADDRESS 0x800BAC /end MEASUREMENT
/begin MEASUREMENT rkatlt_w "additive Gemischkorrektur von der letzten Trip (HFM)" SWORD rel_sw_b1536 1 100 -1536 1535.95 FORMAT "%8.3" ECU_ADDRESS 0x800BAE /end MEASUREMENT
/begin MEASUREMENT rkat_w "additive Gemischkorrektur (pro Zeit) der Gemischdaption (Word)" SWORD rel_sw_b1536 1 100 -1536 1535.95 FORMAT "%8.3" ECU_ADDRESS 0x800BB0 /end MEASUREMENT
/begin MEASUREMENT rkaz2_w "additive Gemischkorrektur (pro Z¸ndung) der Gemischadaption Bank2 (Word)" SWORD rel_sw_b1536 1 100 -1536 1535.95 FORMAT "%8.3" ECU_ADDRESS 0x800BB2 /end MEASUREMENT
/begin MEASUREMENT rkazlt2_w "additive Gemischkorrektur von der letzten Trip (P-System 2. Bank)" SWORD rel_sw_b1536 1 100 -1536 1535.95 FORMAT "%8.3" ECU_ADDRESS 0x800BB4 /end MEASUREMENT
/begin MEASUREMENT rkazlt_w "additive Gemischkorrektur von der letzten Trip (P-System)" SWORD rel_sw_b1536 1 100 -1536 1535.95 FORMAT "%8.3" ECU_ADDRESS 0x800BB6 /end MEASUREMENT
/begin MEASUREMENT rkaz_w "additive Gemischkorrektur (pro Z¸ndung) der Gemischadaption" SWORD rel_sw_b1536 1 100 -1536 1535.95 FORMAT "%8.3" ECU_ADDRESS 0x800BB8 /end MEASUREMENT
/begin MEASUREMENT rka_w "Additive adaptive Korrektur der relativen Kraftstoffmasse" SWORD rel_sw_b1536 1 100 -1536 1535.95 FORMAT "%8.3" ECU_ADDRESS 0x80175C /end MEASUREMENT
/begin MEASUREMENT rlmdhmms_w "Relative Sollf¸llung aus Momentenanforderung f¸r Betriebsart Homogen mager" UWORD rel_uw_q0p0234 1 100 0 1535.98 FORMAT "%8.3" ECU_ADDRESS 0x80198C /end MEASUREMENT
/begin MEASUREMENT rlmdhoms_w "Relative Sollf¸llung aus Momentenanforderung f¸r Betriebsart Homogen" UWORD rel_uw_q0p0234 1 100 0 1535.98 FORMAT "%8.3" ECU_ADDRESS 0x80198E /end MEASUREMENT
/begin MEASUREMENT rlmdhoss_w "Relative Sollf¸llung aus Momentenanforderung f¸r Betriebsart Homogen/Schicht" UWORD rel_uw_q0p0234 1 100 0 1535.98 FORMAT "%8.3" ECU_ADDRESS 0x801990 /end MEASUREMENT
/begin MEASUREMENT rlmdmxh_w "Relative maximale Sollf¸llung aus Momentenanforderung f¸r Betriebsart Homogen" UWORD rel_uw_q0p0234 1 100 0 1535.98 FORMAT "%8.3" ECU_ADDRESS 0x801992 /end MEASUREMENT
/begin MEASUREMENT rlmdschs_w "Relative Sollf¸llung aus Momentenanforderung f¸r Betriebsart Schicht" UWORD rel_uw_q0p0234 1 100 0 1535.98 FORMAT "%8.3" ECU_ADDRESS 0x801994 /end MEASUREMENT
/begin MEASUREMENT rlmdskhs_w "Relative Sollf¸llung aus Momentenanforderung f¸r Betriebsart Schicht/Katheizen" UWORD rel_uw_q0p0234 1 100 0 1535.98 FORMAT "%8.3" ECU_ADDRESS 0x801996 /end MEASUREMENT
/begin MEASUREMENT rlmnskhs_w "momentenabh‰ngige minimale Luftf¸llung bei Betriebsart skh" UWORD rel_uw_q0p0234 1 100 0 1535.98 FORMAT "%8.3" ECU_ADDRESS 0x801998 /end MEASUREMENT
/begin MEASUREMENT tansst "Ansaugluft-Temperatur bei Start" UBYTE temp_ub_q0p75_o48 1 100 -48 143.25 FORMAT "%5.1" ECU_ADDRESS 0x801170 /end MEASUREMENT
/begin MEASUREMENT tlrs_w "Totzeit der Lambdaregelstrecke" UWORD tz10msxs_uw_b327p68 1 100 0.00500008 327.68 FORMAT "%8.4" ECU_ADDRESS 0x801680 /end MEASUREMENT
/begin MEASUREMENT tsaka "Timer Schubdauer f¸r Katalysator-Ausr‰umen" UBYTE t20msxs_ub_b5p1 1 100 0 5.1 FORMAT "%5.3" ECU_ADDRESS 0x800F31 /end MEASUREMENT
/begin MEASUREMENT tsaka2 "Timer Schubdauer f¸r Katalysator-Ausr‰umen f¸r Stereo_LR Bank 2" UBYTE t20msxs_ub_b5p1 1 100 0 5.1 FORMAT "%5.3" ECU_ADDRESS 0x800F32 /end MEASUREMENT
/begin MEASUREMENT ushktmp_w "rangierte Spannung Lambdasonde (4.88mV/LSB) hinter Hauptkatalysator gem. SY_ABGY" UWORD spg_uw_q0p00488_o1 1 100 -1 318.995 FORMAT "%8.4" ECU_ADDRESS 0x801A62 /end MEASUREMENT
/begin MEASUREMENT usnhhk_w "Spannung Lambdasonde (4.88mV/LSB) hinter Hauptkatalysator" UWORD spg_uw_q0p00488_o1 1 100 -1 318.995 FORMAT "%8.4" ECU_ADDRESS 0x801A4C /end MEASUREMENT
/begin MEASUREMENT usrhk "aktuelle Regelschwelle Lambdasignal h.K." UBYTE spg_ub_q0p0052_o0p2 1 100 -0.2 1.13 FORMAT "%5.3" ECU_ADDRESS 0x800B1F /end MEASUREMENT
/begin MEASUREMENT usrhk2 "aktuelle Regelschwelle Lambdasignal h.K., Bank 2" UBYTE spg_ub_q0p0052_o0p2 1 100 -0.2 1.13 FORMAT "%5.3" ECU_ADDRESS 0x800B20 /end MEASUREMENT
/begin MEASUREMENT usrhk2_w "aktuelle Regelschwelle Lambdasignal hinter KAT (word) Bank2" UWORD spg_uw_q0p00488_o1 1 100 -1 318.995 FORMAT "%8.4" ECU_ADDRESS 0x800B16 /end MEASUREMENT
/begin MEASUREMENT usrhk_w "aktuelle Regelschwelle Lambdasignal hinter KAT (word)" UWORD spg_uw_q0p00488_o1 1 100 -1 318.995 FORMAT "%8.4" ECU_ADDRESS 0x800B18 /end MEASUREMENT
/begin MEASUREMENT ustmp "lokale Spannung Lambdasonde hinter Katalysator, Y-Konfiguration" UWORD spg_uw_q0p00488_o1 1 100 -1 318.995 FORMAT "%8.4" ECU_ADDRESS 0x801A64 /end MEASUREMENT
/begin MEASUREMENT usxhk2_w "KL-Source:  Spannung Lambdasonde hinter Katalysator, Bank 2" UWORD spg_uw_q0p00488_o1 1 100 -1 318.995 FORMAT "%8.4" ECU_ADDRESS 0x800B1A /end MEASUREMENT
/begin MEASUREMENT usxhk_w "KL-Source:  Spannung Lambdasonde hinter Katalysator" UWORD spg_uw_q0p00488_o1 1 100 -1 318.995 FORMAT "%8.4" ECU_ADDRESS 0x800B1C /end MEASUREMENT
/begin MEASUREMENT xtkikm2_w "Source f¸r Kennlinie ILMLKATKX2; wird gem‰ss Systemkonstante SY_BDE beschrieben" UWORD temp_q0p0234_o273 1 100 -273.15 1262.83 FORMAT "%8.3" ECU_ADDRESS 0x801A66 /end MEASUREMENT
/begin MEASUREMENT xtkikm_w "Source f¸r Kennlinie ILMLKATKX; wird gem‰ss Systemkonstante SY_BDE beschrieben" UWORD temp_q0p0234_o273 1 100 -273.15 1262.83 FORMAT "%8.3" ECU_ADDRESS 0x801A68 /end MEASUREMENT
/begin MEASUREMENT zkfrat_w "Zeitkonstante der FRAT-Adaption" UWORD fak_uw_b5 1 100 0 4.99992 FORMAT "%8.6" ECU_ADDRESS 0x800BBA /end MEASUREMENT
/begin MEASUREMENT zlrs "Verzˆgerungszeitkonstante der Lambdaregelstrecke" UBYTE zk10msxs_ub_b2p55 1 100 0.01 2.55 FORMAT "%5.3" ECU_ADDRESS 0x80116D /end MEASUREMENT
/begin MEASUREMENT zlrs_w "Verzˆgerungszeitkonstante der Lambdaregelstrecke, 16 bit" UWORD zk10msxs_uw_b655 1 100 0.0100002 655.36 FORMAT "%10.6" ECU_ADDRESS 0x801682 /end MEASUREMENT
/begin MEASUREMENT zwlocal1 "lokaler optimaler Z¸ndwinkel bei Lambda=1" SBYTE zw_sb_q0p75 1 100 -96 95.25 FORMAT "%5.2" ECU_ADDRESS 0x8012B6 /end MEASUREMENT
/begin MEASUREMENT zwlocal2 "lokaler optimaler Z¸ndwinkel bei Lambda=1" SBYTE zw_sb_q0p75 1 100 -96 95.25 FORMAT "%5.2" ECU_ADDRESS 0x8012B7 /end MEASUREMENT
/begin MEASUREMENT zwlocal3 "lokaler optimaler Z¸ndwinkel bei Lambda=1" SBYTE zw_sb_q0p75 1 100 -96 95.25 FORMAT "%5.2" ECU_ADDRESS 0x8012B8 /end MEASUREMENT
/begin MEASUREMENT zwlocal4 "lokaler optimaler Z¸ndwinkel bei Lambda=1" SBYTE zw_sb_q0p75 1 100 -96 95.25 FORMAT "%5.2" ECU_ADDRESS 0x8012B9 /end MEASUREMENT
/begin MEASUREMENT zwlocal5 "lokaler optimaler Z¸ndwinkel bei Lambda=1" SBYTE zw_sb_q0p75 1 100 -96 95.25 FORMAT "%5.2" ECU_ADDRESS 0x8012BA /end MEASUREMENT
/begin MEASUREMENT zwlocal6 "lokaler optimaler Z¸ndwinkel bei Lambda=1" SBYTE zw_sb_q0p75 1 100 -96 95.25 FORMAT "%5.2" ECU_ADDRESS 0x8012BB /end MEASUREMENT
/begin MEASUREMENT zwopt "optimaler Z¸ndwinkel" SBYTE zw_sb_q0p75 1 100 -96 95.25 FORMAT "%5.2" ECU_ADDRESS 0x8012BC /end MEASUREMENT
/begin MEASUREMENT zwoptl1 "optimaler Z¸ndwinkel bei Lambda=1" SBYTE zw_sb_q0p75 1 100 -96 95.25 FORMAT "%5.2" ECU_ADDRESS 0x8012BD /end MEASUREMENT
/begin FUNCTION LLRRM "Leerlaufregelung Reglereingriff Drehmoment"
 /begin DEF_CHARACTERISTIC CWLLRPA CWLLRRM DMLLNGEZ DMLLNGEZV DMLLRLMNF DMLLRLMNN DMLLRLMXF DMLLRLMXN DMLLRMNN DMLLRMNNK DMLLRMXN DMLLRMXNK DNLLRIST DNLLST DNMNI DVNG DVNGKH DVNGV FDDN FDNIKOR GFDLDN IVDNDTEH IVDNHOM IVDNHOMV LIMN LIMNDLLR LIMNDTES LIMNV LIMXDNS LIMXVDNS LISTM LLRICNF NLLRRI PVDNHOM PVDNHOMV PVDNKFKH PVDNSTW PVLDNEZ PVLDNEZKH PVLDNEZV SDN10LLSW SEZ04LLUB SNS206LLSB SRKTEVS TVLISTU TVLLRPST TVLLRST TVPKH ZFLLRPL ZKLLRD ZLIBG ZNFNGLL /end DEF_CHARACTERISTIC
 /begin REF_CHARACTERISTIC SNG06LLSB SNM06LLUB SNS06LLSB STM06LLUB /end REF_CHARACTERISTIC
 /begin IN_MEASUREMENT B_dllr B_dteaam B_dtes B_dtest B_faan B_kh B_kha B_llde B_llr B_llrein B_llri B_llrpd B_mdmin B_nsolst B_nswo1 B_st B_stend B_temin B_trkh B_vllr dns esst_sng06llsb esst_snm06llub esst_sns06llsb esst_stm06llub etazws ngas_w ngfil nmot nmotll nmot_w nsol_w nstat tmot /end IN_MEASUREMENT
 /begin OUT_MEASUREMENT B_llrst dmllrdl_w dmllrd_w dmllri_w dmllrl_w dmllrpl_w dmllrp_w dmllr_w dn dn_w esst_sdn10llsw esst_sez04llub esst_sns206llsb limax_w limin_w /end OUT_MEASUREMENT
 /begin LOC_MEASUREMENT B_llrpkh B_llrpst dmllrib_w dmllrii_w dmllriz_w dnbi_w dnikorr_w iver limnst ngasf_w pvdnkhl /end LOC_MEASUREMENT
 /begin SUB_FUNCTION /end SUB_FUNCTION
/end FUNCTION
/begin FUNCTION LRA "Adaptive Vorsteuerung f¸r Lambdaregelung"
 /begin DEF_CHARACTERISTIC CWGALSV FBZFRAT FRAOMN FRAOMX FRAORN FRAORX FRATMN FRATMX FRAUMN FRAUMX FRAURN FRAURX KFRAT MLO1 MLO1AC MLO2 MLO3 MLO3AC MLU2 MLU2AC MLU2FA MLU4 MLU4AC N0 NO1 NO2 NOLRA NRKAB NU2 NU3 RKATMN RKATMX RKATRN RKATRX RKAZMN RKAZMX RKAZRN RKAZRX RLO2 RLO3 RLO3AC RLU2 RLU2AC RLU3 RLU4 RLU4AC TGAALTWR TMFRATMN TMFRATUB ZKFRAOA ZKFRAUA ZKRKATA ZKRKAZA ZRLFRAT /end DEF_CHARACTERISTIC
 /begin REF_CHARACTERISTIC TMRAA /end REF_CHARACTERISTIC
 /begin IN_MEASUREMENT abo B_abor B_edkvs B_edkvs2 B_fa B_faan B_fakvs B_koe B_lr B_lr2 B_lra B_lra2 B_lrat B_lsvvsp B_pwf B_stend frm2_w frm_w ml_w nmot rl tmot /end IN_MEASUREMENT
 /begin OUT_MEASUREMENT B_frao B_fraor B_fraor2 B_frat B_frau B_fraur B_fraur2 B_lrare B_lrare2 B_nofra B_nofrat B_norkat B_norkaz B_rkat B_rkatr B_rkatr2 B_rkaz B_rkazr B_rkazr2 fra2_w frao2_w frao_w frat2_w frati2_w frati_w frat_w frau2_w frau_w fra_w ftklra_w rka2_w rkat2_w rkat_w rkaz2_w rkaz_w rka_w /end OUT_MEASUREMENT
 /begin LOC_MEASUREMENT B_lrareb dfrm2_w dfrmt2_w dfrmt_w dfrm_w dlrfrat fraolt2_w fraolt_w frault2_w frault_w rkatlt2_w rkatlt_w rkazlt2_w rkazlt_w zkfrat_w /end LOC_MEASUREMENT
 /begin SUB_FUNCTION /end SUB_FUNCTION
/end FUNCTION
/begin FUNCTION LRAEB "Einschaltbedingungen Gemischadaption" /begin DEF_CHARACTERISTIC LAMLRAMN LAMLRAMX TARA TMEWRAA TMRAA TVLRA WDKARN /end DEF_CHARACTERISTIC /begin REF_CHARACTERISTIC /end REF_CHARACTERISTIC
 /begin IN_MEASUREMENT B_agrlrasp B_brems B_dsls B_dteaa B_dtest B_enws B_fa B_falra B_fates B_gap B_lr B_lr2 B_lrasp B_lrasp2 B_mdarv B_nldg B_sls B_te B_ukg B_vl lamsons_w nmot tans tmew tmot wdkba /end IN_MEASUREMENT
 /begin OUT_MEASUREMENT B_gasp B_lra B_lra2 B_lrat /end OUT_MEASUREMENT
 /begin LOC_MEASUREMENT B_lraen /end LOC_MEASUREMENT
 /begin SUB_FUNCTION /end SUB_FUNCTION
/end FUNCTION
/begin FUNCTION LRS "Stetige Lambdaregelung"
 /begin DEF_CHARACTERISTIC CLRS FDFRMIN FLRSG2K FRMAX FRMINKH FZAB2 KFDLASO KFDLASO2 KFFRMIN KFLRSG1 KFLRSG2 KFLRSG4 KFLRSP1 KFLRSP2 KFLRSP3 KFLRSP4 KFLRST KFLRSZ KVZAF LALIUSMN LRSGKTM LRSTPZA LRSZAWML TAUIDEC TKATSZA TKATSZA2 TMLRZAMN WIMAX WIMIN XIMAX XIMIN Y2MAX /end DEF_CHARACTERISTIC
 /begin REF_CHARACTERISTIC SNM07LSUW SNM10LSUB SRL08LSUW SRL10LSUB /end REF_CHARACTERISTIC
 /begin IN_MEASUREMENT azlrdkt B_dktlp B_frini B_frini2 B_kh B_lrka B_lrka2 B_lrmsbs B_lrmsbs2 B_lrs B_lrs2 B_lrsrems B_lrsrems2 B_lrsresf B_nswo1 B_sls dlahi2_w dlahi_w dlahp2_w dlahp_w esst_snm07lsuw esst_snm10lsub esst_srl08lsuw esst_srl10lsub frini2_w frini_w lamsbg2_w lamsbg_w lamsoni2_w lamsoni_w lamsons2_w lamsons_w mlbb2_w mlbb_w ml_w msl msl2 nmot nmot_w rl rl_w tkatm2_w tkatm_w tmot tnst_w tzlrdkt_w /end IN_MEASUREMENT
 /begin OUT_MEASUREMENT B_frmax B_frmax2 B_frmin B_frmin2 B_lrssp B_za B_za2 dfrzaf_w fr2_w frm2_w frmn_w frmx_w frm_w fr_w ladiff2_w ladiff_w lamsbgt2_w lamsbgt_w lamsbpr2_w lamsbpr_w lamzak2_w lamzak_w lamzapr2_w lamzapr_w tlrs_w zlrs zlrs_w /end OUT_MEASUREMENT
 /begin LOC_MEASUREMENT B_flrsres B_idecay B_idecay2 B_update B_update2 B_y2max B_y2max2 B_y2min B_y2min2 dfr2_w dfrmin2_w dfrmin_w dfrpr2_w dfrpr_w dfrza2_w dfrzaf2_w dfrza_w dfr_w dlaso dlaso2 froza2_w froza_w g1korr g2korr lrsg1_w lrsg2_w lrsg4_w lrsp1_w lrsp2_w lrsp3_w lrsp4_w lrsw12_w lrsw1_w lrsw22_w lrsw2_w lrsxk12_w lrsxk1_w lrsxk32_w lrsxk3_w lrsxk42_w lrsxk4_w lrsy22_w lrsy2_w lrsy42_w lrsy4_w lrsza /end LOC_MEASUREMENT
 /begin SUB_FUNCTION /end SUB_FUNCTION
/end FUNCTION
/begin FUNCTION LRSBSEL "LRSBSEL.exportedKoordination der durch die Y-Konfig. betroffenen Ein-/Ausg‰nge der LRS-Fktn." /begin DEF_CHARACTERISTIC /end DEF_CHARACTERISTIC /begin REF_CHARACTERISTIC CWKONFLS /end REF_CHARACTERISTIC
 /begin IN_MEASUREMENT B_sbbhk B_sbbhk2 dlahico2_w dlahico_w dlahpco2_w dlahpco_w ushk2_w ushk_w /end IN_MEASUREMENT
 /begin OUT_MEASUREMENT B_abgy B_sbbnhhk dlahi2_w dlahi_w dlahp2_w dlahp_w usnhhk_w /end OUT_MEASUREMENT
 /begin LOC_MEASUREMENT /end LOC_MEASUREMENT
 /begin SUB_FUNCTION /end SUB_FUNCTION
/end FUNCTION
/begin FUNCTION LRSEB "Einschaltbedingungen stetige Lambdaregelung"
 /begin DEF_CHARACTERISTIC CLRZWTMS DLAMXSA DTMR DTMTMRW IMLEVABS IMLEVABS2 IMLSALR NLRSHB RLLRSHB RLLRUN RLSLSMN TARAU TASHS TLRBAM TLRHS TLRSZWSA TLRTMS TLRVAM TLRZWTMS TMRA1 TMRA2 TMRAK TMSHS TRAU TVSLR /end DEF_CHARACTERISTIC
 /begin REF_CHARACTERISTIC CLRS LALIUSMN /end REF_CHARACTERISTIC
 /begin IN_MEASUREMENT B_bag B_bevab B_bevab2 B_craus B_dsla B_dslsk B_eev B_esls B_fa B_falr B_ll B_mdarv B_mdkat B_sa B_sbblsu B_sbblsu2 B_slsoff B_st B_stend B_temin B_temin2 B_vag B_vlsuftb B_vlsuftb2 B_vs lamsoni2_w lamsoni_w lamsons2_w lamsons_w ml_w nmot rl tans tmot tmotlin tmrw tmst /end IN_MEASUREMENT
 /begin OUT_MEASUREMENT B_eobdlr B_eobdlr2 B_lr B_lr2 B_lr2s B_lr2s2 B_lrmsbs B_lrmsbs2 B_lrnda B_lrnda2 B_lrs B_lrs2 B_lrsrems B_lrsrems2 B_lrsresf B_lrssa B_lrssa2 B_lrvk B_lrvk2 B_mlevab B_mlevab2 B_mlrsa B_nolrb B_nolrb2 B_nolre B_nolre2 B_nolrw B_nolrw2 B_tmlr flglrs flglrs2 /end OUT_MEASUREMENT
 /begin LOC_MEASUREMENT B_lrrl B_pspaus B_pspwl B_tarau imlevab2_w imlevab_w imlrsa_w tansst /end LOC_MEASUREMENT
 /begin SUB_FUNCTION /end SUB_FUNCTION
/end FUNCTION
/begin FUNCTION LRSHKC "2.30      Lambdaregelung hinter Kat stetig , Version kontinuierlich"
 /begin DEF_CHARACTERISTIC DLAHINI DLAHINI2 KDLASHKI KDLASHKI2 KDLASHKP KDLASHKP2 KFUSHK KILRHML KPLRHML LALIUSHK LALIUSHK2 LASHKAB LRHIMN LRHIMX PLRHAV PLRHAV2 SM109LHSW SM209LHSW ZLASHKAB ZLASOHML /end DEF_CHARACTERISTIC
 /begin REF_CHARACTERISTIC CLRHKZP CLRSHK SML08LHUB /end REF_CHARACTERISTIC
 /begin IN_MEASUREMENT avkatf avkatf2 B_lr B_lr2 B_lrhk B_lrhk2 B_lrhkp B_lrhkp2 B_lrka B_lrka2 B_lrssp B_pwf B_st esst_sml08lhub ml ml_w nmot rl ushk2_w ushk_w /end IN_MEASUREMENT
 /begin OUT_MEASUREMENT dlahico2_w dlahico_w dlahpco2_w dlahpco_w dlashkm2_w dlashkm_w lasolhk2_w lasolhk_w lasonhk2_w lasonhk_w LRSHKCBits1_100ms usrhk usrhk2 usrhk2_w usrhk_w /end OUT_MEASUREMENT
 /begin LOC_MEASUREMENT B_dlahini B_dlahini2 dlahini2_w dlahini_w dlahkab2_w dlahkab_w dlashki2_w dlashki_w dlashkp2_w dlashkp_w esst_sm109lhsw esst_sm209lhsw lahkf2_w lahkf_w lahkm2_w lahkmz lahkmz2 lahkm_w usxhk2_w usxhk_w /end LOC_MEASUREMENT
 /begin SUB_FUNCTION /end SUB_FUNCTION
/end FUNCTION
/begin FUNCTION LRSHKEB "2.40      Einschaltbedingungen Lambdaregelung (stetig) hinter Katalysator"
 /begin DEF_CHARACTERISTIC CLRHKZP CLRSHK CLRSHKEB DRLLRHKO DRLLRHKU IMLRLHKX LAMBRSMN LAMBRSMX MLNKAX MLNKAX2 NLRHO NLRHU RLLRHON RLLRHUN TBLRH TBLRH2 TDRLLRHKX TKATMLRH TKATMLRH2 TLAMSBRS /end DEF_CHARACTERISTIC
 /begin REF_CHARACTERISTIC CWKONFLS SNM08LHUB /end REF_CHARACTERISTIC
 /begin IN_MEASUREMENT B_edkvs B_edkvs2 B_falsh B_falsh2 B_lr B_lr2 B_lrka B_lrka2 B_mdarv B_sbbhk B_sbbhk2 drlas_w esst_snm08lhub lamsbrs2_w lamsbrs_w lamsons2_w lamsons_w ml nmot rl tkihkm2_w tkihkm_w /end IN_MEASUREMENT
 /begin OUT_MEASUREMENT B_lrhk B_lrhk2 B_lrhkp B_lrhkp2 B_lrhkpzp B_lrhkpzp2 B_lrhkzp B_lrhkzp2 lrshkebAusBits lrshkebAusBits10ms lrshkebAusBits_2 lrshkebLokBits lrshkebLokBits1 lrshkebLokBits1_2 lrshkebLokBits_2 /end OUT_MEASUREMENT
 /begin LOC_MEASUREMENT B_iehshk B_iekat B_iekat2 B_iekati B_iekati2 B_ielsh B_ielsh2 B_iesls B_iesls2 B_ieteve2 B_lrdel B_lrdel2 B_lrhkb B_lrhkb2 B_lrhkbv B_lrhkbv2 B_lrhkg B_lrhkgi B_lrkaint B_lrkaint2 B_mlnka B_mlnka2 imlrlhk_w mlnka2_w mlnka_w /end LOC_MEASUREMENT
 /begin SUB_FUNCTION /end SUB_FUNCTION
/end FUNCTION
/begin FUNCTION LRSINI "Stetige Lambdaregelung, Koordination der Initialisierung" /begin DEF_CHARACTERISTIC /end DEF_CHARACTERISTIC /begin REF_CHARACTERISTIC /end REF_CHARACTERISTIC /begin IN_MEASUREMENT B_dtefrr frdter_w /end IN_MEASUREMENT /begin OUT_MEASUREMENT B_frini B_frini2 frini2_w frini_w /end OUT_MEASUREMENT /begin LOC_MEASUREMENT /end LOC_MEASUREMENT /begin SUB_FUNCTION /end SUB_FUNCTION /end FUNCTION
/begin FUNCTION lrska "6.80      Stetige Lambdaregelung Zusatzfunktion Katalysator-Ausr‰umen"
 /begin DEF_CHARACTERISTIC CLRSKA FKAXAVKAT FKAXAVKAT2 FLMLKAMA FLMLKAMA2 ILMLKAXTK ILMLKAXTK2 IMLKAMN IMLKAMN2 LAMKADEF LAMKAMLW LAMSKAMX LAMSKAMX2 NLRKA TDLAKAD TDLAKAU TLAKAMN TLAKAMN2 TSAKAMN TSAKAMN2 USHKAMNW USHKAMNW2 USHKAMXW USHKAMXW2 /end DEF_CHARACTERISTIC
 /begin REF_CHARACTERISTIC /end REF_CHARACTERISTIC
 /begin IN_MEASUREMENT avkatf avkatf2 B_bevab B_bevab2 B_lamdkt B_sbbhk B_sbbhk2 B_sbbvk B_sbbvk2 lamsoni2_w lamsoni_w lamsons2_w lamsons_w ml ml_w nmot tikatm2_w tikatm_w tkiuem2_w tkiuem_w ushk2_w ushk_w /end IN_MEASUREMENT
 /begin OUT_MEASUREMENT B_lamka B_lamka2 B_lrka B_lrka2 ilmlka2_w ilmlka_w ilmltkx2_w ilmltkx_w imllaka2_w imllaka_w lamka2_w lamka_w lrskaBits1_20ms lrskaBits_20ms /end OUT_MEASUREMENT
 /begin LOC_MEASUREMENT B_blrka B_blrka2 B_lrkaa B_lrkaa2 B_lrkae B_lrkae2 B_sbbhktmp dlamka2_w dlamka_w favkatmx favkatmx2 iftkavx2_w iftkavx_w imlka2_w imlka_w lrkaz lrkaz2 tsaka tsaka2 ushktmp_w ustmp xtkikm2_w xtkikm_w /end LOC_MEASUREMENT
 /begin SUB_FUNCTION /end SUB_FUNCTION
/end FUNCTION
/begin FUNCTION MDBAS "Berechnung der Basisgrˆﬂen f¸r Momentenschnittstelle"
 /begin DEF_CHARACTERISTIC AGRRMAX CWMDBAS DZWOLA DZWOM ETADZW ETALAM KFMIOP KFZWOP KFZWOP2 KFZWOP3 KFZWOP4 KFZWOPA KFZWOPA2 KFZWOPA3 KFZWOPA4 SRL11OPUW /end DEF_CHARACTERISTIC
 /begin REF_CHARACTERISTIC SNM16OPUW /end REF_CHARACTERISTIC
 /begin IN_MEASUREMENT B_fnwea B_fnwea2 B_fnwea3 esst_snm16opuw fnwaa fnwea fnwea2 fnwea3 lambas nmot nmot_w rl_w tmot zwbas /end IN_MEASUREMENT
 /begin OUT_MEASUREMENT dzwoag dzwol dzw_kge esst_srl11opuw etalab etatrmn etazwb etazwbm mibas_w miopt_w zwopt /end OUT_MEASUREMENT
 /begin LOC_MEASUREMENT dzwb dzwotm mioptl1_w zwlocal1 zwlocal2 zwlocal3 zwlocal4 zwlocal5 zwlocal6 zwoptl1 /end LOC_MEASUREMENT
 /begin SUB_FUNCTION /end SUB_FUNCTION
/end FUNCTION
/begin FUNCTION MDBGRG "Momentenbegrenzung nach oben"
 /begin DEF_CHARACTERISTIC DMRTMKI DTMIBG KFFRTMKI KLFRTMKI MDGAT TAGAT TMXMIBG TNGAT TVGAT /end DEF_CHARACTERISTIC
 /begin REF_CHARACTERISTIC /end REF_CHARACTERISTIC
 /begin IN_MEASUREMENT B_krdws gangi mimax_w mitibgr_w nmot tmot /end IN_MEASUREMENT
 /begin OUT_MEASUREMENT mibgrl_w mitmbgr_w /end OUT_MEASUREMENT
 /begin LOC_MEASUREMENT frtmki miatbgr_w /end LOC_MEASUREMENT
 /begin SUB_FUNCTION /end SUB_FUNCTION
/end FUNCTION
/begin FUNCTION MDFILM "Motorseitige Sollmomentenfilterung"
 /begin DEF_CHARACTERISTIC CWMDFILM DDMSAWEN MIKOKSAP NGFSAWE TDMFBSA TDMFBWE TDMFWEMI TVFSAWE VFZGSAWE /end DEF_CHARACTERISTIC
 /begin REF_CHARACTERISTIC MDIMX /end REF_CHARACTERISTIC
 /begin IN_MEASUREMENT B_dash B_kuppl B_ll B_lsd B_sa B_sab B_sabfg dmverl_w miagk_w mibas_w miistoar_w mimax_w mizwmn_w ngfil_w nmot_w vfzg /end IN_MEASUREMENT
 /begin OUT_MEASUREMENT B_fil dmlwhs_w mikoks_w /end OUT_MEASUREMENT
 /begin LOC_MEASUREMENT ddmsawe_w miagkbe_w miagknbe_w migef_w /end LOC_MEASUREMENT
 /begin SUB_FUNCTION /end SUB_FUNCTION
/end FUNCTION
/begin FUNCTION MDFUE "Sollwertvorgabe f¸r Luftmasse aus Sollmoment" /begin DEF_CHARACTERISTIC DMIUMSCH KFMIRL KFMIRLS /end DEF_CHARACTERISTIC /begin REF_CHARACTERISTIC /end REF_CHARACTERISTIC
 /begin IN_MEASUREMENT B_hksv B_hmmfes B_hom B_homfes B_hosfes B_hspmd B_mdvur B_schfes B_skhfes dmlwhs_w elamnhmm_w elamnhos_w elamnsch_w elamnskh_w elamxskh_w etaaufte etalab etazwbm etazwmn fmvurh_w fmvurs_w milsol_w nmot_w /end IN_MEASUREMENT
 /begin OUT_MEASUREMENT B_homhmmf B_homschf rlmdhmms_w rlmdhoms_w rlmdhoss_w rlmdmxh_w rlmdschs_w rlmdskhs_w rlmnskhs_w /end OUT_MEASUREMENT
 /begin LOC_MEASUREMENT mismnskh_w misophmm_w misophos_w misopl1u_w misopl1_w misopsch_w misopskh_w /end LOC_MEASUREMENT
 /begin SUB_FUNCTION /end SUB_FUNCTION
/end FUNCTION
/begin FUNCTION MDIST "Motormomentenberechnung" /begin DEF_CHARACTERISTIC /end DEF_CHARACTERISTIC /begin REF_CHARACTERISTIC ETADZW /end REF_CHARACTERISTIC /begin IN_MEASUREMENT dzw_kge miopt_w redist zwist zwopt /end IN_MEASUREMENT /begin OUT_MEASUREMENT etazaist etazwist miist_w /end OUT_MEASUREMENT /begin LOC_MEASUREMENT dzwi mdindg_w /end LOC_MEASUREMENT /begin SUB_FUNCTION /end SUB_FUNCTION /end FUNCTION
/begin FUNCTION MDISTOA "Berechnung inneres Istmoment ohne Antiruckel" /begin DEF_CHARACTERISTIC /end DEF_CHARACTERISTIC /begin REF_CHARACTERISTIC /end REF_CHARACTERISTIC
 /begin IN_MEASUREMENT B_evakt B_mdee B_nmax B_sa B_zwvz dmaufr_w dmllr_w mibas_w misolp_w miszul_w mizwmn_w /end IN_MEASUREMENT
 /begin OUT_MEASUREMENT miistoal_w miistoa_w /end OUT_MEASUREMENT
 /begin LOC_MEASUREMENT /end LOC_MEASUREMENT
 /begin SUB_FUNCTION /end SUB_FUNCTION
/end FUNCTION
/begin FUNCTION MDKOG "Drehmomentenkoordination f¸r Gesamteingriffe"
 /begin DEF_CHARACTERISTIC CWMDKOG DELRL DZFLBK NMOTZFLBK THDMB TMAXZFLBK TMVER TVMIBEG /end DEF_CHARACTERISTIC
 /begin REF_CHARACTERISTIC CWMDKOL CWTEZW MDIMX /end REF_CHARACTERISTIC
 /begin IN_MEASUREMENT B_fil B_hom B_kh B_kupplv B_ll B_llrein B_mdeinext B_mdmin B_mibegl B_nmaxd B_nmxozwe B_sa B_stend B_zwfgagk dmar_w dmllr_w dmrkh_w dmrkt_w dmrllr_w etazwb flbs_w mibas_w mibgr_w mibmn_w mibmx_w midstn_w mikoks_w milres_w minmx_w miopt_w miszul_w mitebg_w nmot rlmin_w rl_w wped_w /end IN_MEASUREMENT
 /begin OUT_MEASUREMENT B_mdein B_mibeg B_zwvs B_zwvz B_zwvzvb cmibeg_w misol misoldlr_w misolp_w misolv_w misol_w mizsol_w /end OUT_MEASUREMENT
 /begin LOC_MEASUREMENT B_mdeinint B_zwdmr B_zwfa B_zwfe B_zwme B_zwpp dmzms_w misolbv_w mizsolv_w /end LOC_MEASUREMENT
 /begin SUB_FUNCTION /end SUB_FUNCTION
/end FUNCTION
/begin FUNCTION MDKOL "Momentenkoordination auf F¸llungsebene" /begin DEF_CHARACTERISTIC CWMDKOL /end DEF_CHARACTERISTIC /begin REF_CHARACTERISTIC MDIMX /end REF_CHARACTERISTIC
 /begin IN_MEASUREMENT B_llrein B_mdresagk B_mibeg dmllrl_w dmrkh_w dmrkt_w dmrllr_w etazwbm etazwmn miagkres_w miagk_w mibgrl_w minmxl_w miszull_w mitebg_w vsdmr /end IN_MEASUREMENT
 /begin OUT_MEASUREMENT B_mibegl B_mrakt dmrmx_w mildmis_w milres_w milsol_w mimnl_w /end OUT_MEASUREMENT
 /begin LOC_MEASUREMENT dmlms_w mikols_w /end LOC_MEASUREMENT
 /begin SUB_FUNCTION /end SUB_FUNCTION
/end FUNCTION
/begin FUNCTION MDMAX "Berechnung maximales indiziertes Motormoment" /begin DEF_CHARACTERISTIC FMIVL /end DEF_CHARACTERISTIC /begin REF_CHARACTERISTIC KFMIOP SNM16OPUW SRL11OPUW /end REF_CHARACTERISTIC /begin IN_MEASUREMENT esst_snm16opuw esst_srl11opuw nmot_w rlmxs_w rl_w /end IN_MEASUREMENT /begin OUT_MEASUREMENT mimax_w /end OUT_MEASUREMENT /begin LOC_MEASUREMENT mimxl1_w /end LOC_MEASUREMENT /begin SUB_FUNCTION /end SUB_FUNCTION /end FUNCTION
/begin FUNCTION MDMIN "Minimales Motormoment Koordination" /begin DEF_CHARACTERISTIC CWMDMIN FWDMVAD KFMIMN KFVERST KLMIMNH /end DEF_CHARACTERISTIC /begin REF_CHARACTERISTIC /end REF_CHARACTERISTIC
 /begin IN_MEASUREMENT B_kupplv B_sab dmvad_w fho fnstab_w gangi mdverf_w nmot_w nver_w wped_w /end IN_MEASUREMENT
 /begin OUT_MEASUREMENT mill_w miminds_w mimins_w mimin_w /end OUT_MEASUREMENT
 /begin LOC_MEASUREMENT /end LOC_MEASUREMENT
 /begin SUB_FUNCTION /end SUB_FUNCTION
/end FUNCTION
/begin FUNCTION MDNSTAB "Drehmoment: Drehzahlstabilisierung" /begin DEF_CHARACTERISTIC CWMDNSTAB DNNSTAB FNSTABNV /end DEF_CHARACTERISTIC /begin REF_CHARACTERISTIC /end REF_CHARACTERISTIC /begin IN_MEASUREMENT B_llrein B_nmot nmot_w nsol_w nstat /end IN_MEASUREMENT /begin OUT_MEASUREMENT fnstab_w nver_w /end OUT_MEASUREMENT /begin LOC_MEASUREMENT B_mdnstab B_mdnste /end LOC_MEASUREMENT /begin SUB_FUNCTION /end SUB_FUNCTION /end FUNCTION
/begin FUNCTION MDRED "Berechnung Reduzierstufe aus Momentenanforderung"
 /begin DEF_CHARACTERISTIC CREDSTU MDHYEZ REDHYOC REDHYUC REDMXSA REDNMX REDZEM REDZEMNL TKIHKM2RED TKIHKMRED TKIVKM2RED TKIVKMRED TMAXSAWE /end DEF_CHARACTERISTIC
 /begin REF_CHARACTERISTIC /end REF_CHARACTERISTIC
 /begin IN_MEASUREMENT B_dknolu B_dkpu B_evakt B_fil B_mdeeagk B_msr B_nmax B_sab B_sgs B_stend etazwmn mibas_w miopt_w misol_w redist tkihkm2_w tkihkm_w tkivkm2_w tkivkm_w tmot /end IN_MEASUREMENT
 /begin OUT_MEASUREMENT B_enmdsawe B_mdee B_sa mizwmn_w redsol /end OUT_MEASUREMENT
 /begin LOC_MEASUREMENT B_mdeemx B_mdeenf B_mdeenl B_mdeetk B_mdsawe B_sabmee B_vormdred etazas_w redeta_w redhyst redneu redze redzenl /end LOC_MEASUREMENT
 /begin SUB_FUNCTION /end SUB_FUNCTION
/end FUNCTION
/begin FUNCTION MDTRIP "Berechnung der Momentenreserve im Kurztrip" /begin DEF_CHARACTERISTIC DMRAA KLMRKFHO /end DEF_CHARACTERISTIC /begin REF_CHARACTERISTIC /end REF_CHARACTERISTIC /begin IN_MEASUREMENT B_faam dmrdkt_w dmrdnw_w dmrdsls_w dmrlsv_w fho_w /end IN_MEASUREMENT /begin OUT_MEASUREMENT dmrkt_w /end OUT_MEASUREMENT /begin LOC_MEASUREMENT /end LOC_MEASUREMENT /begin SUB_FUNCTION /end SUB_FUNCTION /end FUNCTION
/begin FUNCTION MDVER "Motor-Verlustmoment"
 /begin DEF_CHARACTERISTIC CNFMDVER DMDNSM DMVERLMN KFMDS KFMDSNW MDSH MDSM MDSMNW MDVGLW ZFMDVERL ZMDNSM /end DEF_CHARACTERISTIC
 /begin REF_CHARACTERISTIC SNM16OPUW SRL11OPUW STM10__UB /end REF_CHARACTERISTIC
 /begin IN_MEASUREMENT B_kuppl B_llrein B_sa dmvad_w esst_snm16opuw esst_srl11opuw esst_stm10__ub fho fnstab_w fnwue mdverb_w mdwan_w nmotll nmot_w nsol rl_w tmot /end IN_MEASUREMENT
 /begin OUT_MEASUREMENT dmverl_w mdns_w mdsh_w mdsm_w mdssta_w mdverf_w mdverl_w mdvervf_w mdvglw_w /end OUT_MEASUREMENT
 /begin LOC_MEASUREMENT B_dmverlin kfmdsnw_w mdsmnw_w mds_w /end LOC_MEASUREMENT
 /begin SUB_FUNCTION /end SUB_FUNCTION
/end FUNCTION
/begin FUNCTION MDVERAD "Adaption Verlustmoment"
 /begin DEF_CHARACTERISTIC DMADFK DMADFS DMADKO DMADLL DMADMNFK DMADMNFS DMADMNKO DMADMNLL DMADMXFK DMADMXFS DMADMXKO DMADMXLL TMDMAD TWDMAD ZKDMADFK ZKDMADFS ZKDMADKO ZKDMADLL /end DEF_CHARACTERISTIC
 /begin REF_CHARACTERISTIC CDWVERAD /end REF_CHARACTERISTIC
 /begin IN_MEASUREMENT B_dtes B_fs B_koe B_llr B_llrein B_nswo1 B_pwf B_vllr dmllri_w tmot /end IN_MEASUREMENT
 /begin OUT_MEASUREMENT dmvad_w /end OUT_MEASUREMENT
 /begin LOC_MEASUREMENT B_adwfk B_adwfs B_adwko B_madakt B_madfk B_madfs B_madko B_madll dmvadfk_w dmvadfs_w dmvadko_w dmvadll_w dmvamnfk_w dmvamnfs_w dmvamnko_w dmvamnll_w dmvamxfk_w dmvamxfs_w dmvamxko_w dmvamxll_w MDVERADlokbits /end LOC_MEASUREMENT
 /begin SUB_FUNCTION /end SUB_FUNCTION
/end FUNCTION
/begin COMPU_METHOD B_TRUE "boolsche Zust‰nde, positive Logik" TAB_VERB "%6.3" "" COMPU_TAB_REF B_TRUE /end COMPU_METHOD
/begin COMPU_VTAB B_TRUE "boolsche Zust‰nde, positive Logik" TAB_VERB 2 0 "----" 1 "TRUE" /end COMPU_VTAB
/begin COMPU_METHOD DEZ "1 : 1 Umrechnug (dez/hex)" RAT_FUNC "%6.2" "" COEFFS 0 1 0 0 0 1 /end COMPU_METHOD
/begin COMPU_METHOD dez "1 : 1 Umrechnug (dez/hex)" RAT_FUNC "%6.2" "" COEFFS 0 1 0 0 0 1 /end COMPU_METHOD
/begin COMPU_METHOD fak_q0p00153 "" RAT_FUNC "%6.4" "-" COEFFS 0 256 0 0 0 0.390625 /end COMPU_METHOD
/begin COMPU_METHOD fak_q0p0625 "" RAT_FUNC "%6.4" "-" COEFFS 0 16 0 0 0 1 /end COMPU_METHOD
/begin COMPU_METHOD fak_sb_b0p03125 "" RAT_FUNC "%6.5" "-" COEFFS 0 256 0 0 0 0.0625 /end COMPU_METHOD
/begin COMPU_METHOD fak_sb_b1 "" RAT_FUNC "%6.4" "-" COEFFS 0 256 0 0 0 2 /end COMPU_METHOD
/begin COMPU_METHOD fak_sb_b2 "" RAT_FUNC "%6.4" "-" COEFFS 0 256 0 0 0 4 /end COMPU_METHOD
/begin COMPU_METHOD fak_sw_b1 "" RAT_FUNC "%7.6" "-" COEFFS 0 65536 0 0 0 2 /end COMPU_METHOD
/begin COMPU_METHOD fak_sw_b2 "" RAT_FUNC "%7.6" "-" COEFFS 0 65536 0 0 0 4 /end COMPU_METHOD
/begin COMPU_METHOD fak_sw_b32 "" RAT_FUNC "%6.5" "-" COEFFS 0 65536 0 0 0 64 /end COMPU_METHOD
/begin COMPU_METHOD fak_sw_b4 "" RAT_FUNC "%6.5" "-" COEFFS 0 65536 0 0 0 8 /end COMPU_METHOD
/begin COMPU_METHOD fak_sw_b64 "" RAT_FUNC "%6.4" "-" COEFFS 0 65536 0 0 0 128 /end COMPU_METHOD
/begin COMPU_METHOD fak_sw_b8 "" RAT_FUNC "%6.5" "-" COEFFS 0 65536 0 0 0 16 /end COMPU_METHOD
/begin COMPU_METHOD fak_ub_b0p25 "" RAT_FUNC "%10.7" "-" COEFFS 0 256 0 0 0 0.25 /end COMPU_METHOD
/begin COMPU_METHOD fak_ub_b1 "" RAT_FUNC "%6.4" "-" COEFFS 0 256 0 0 0 1 /end COMPU_METHOD
/begin COMPU_METHOD fak_ub_b16 "" RAT_FUNC "%6.4" "-" COEFFS 0 256 0 0 0 16 /end COMPU_METHOD
/begin COMPU_METHOD fak_ub_b2 "" RAT_FUNC "%6.4" "-" COEFFS 0 256 0 0 0 2 /end COMPU_METHOD
/begin COMPU_METHOD fak_ub_b4 "" RAT_FUNC "%6.4" "-" COEFFS 0 256 0 0 0 4 /end COMPU_METHOD
/begin COMPU_METHOD fak_ub_b8 "" RAT_FUNC "%6.4" "-" COEFFS 0 256 0 0 0 8 /end COMPU_METHOD
/begin COMPU_METHOD fak_uw_b1 "" RAT_FUNC "%7.6" "-" COEFFS 0 65536 0 0 0 1 /end COMPU_METHOD
/begin COMPU_METHOD fak_uw_b128 "" RAT_FUNC "%6.4" "-" COEFFS 0 65536 0 0 0 128 /end COMPU_METHOD
/begin COMPU_METHOD fak_uw_b16 "" RAT_FUNC "%6.5" "-" COEFFS 0 65536 0 0 0 16 /end COMPU_METHOD
/begin COMPU_METHOD fak_uw_b2 "" RAT_FUNC "%7.6" "-" COEFFS 0 65536 0 0 0 2 /end COMPU_METHOD
/begin COMPU_METHOD fak_uw_b4 "" RAT_FUNC "%7.6" "-" COEFFS 0 65536 0 0 0 4 /end COMPU_METHOD
/begin COMPU_METHOD fak_uw_b5 "" RAT_FUNC "%7.6" "-" COEFFS 0 65536 0 0 0 5 /end COMPU_METHOD
/begin COMPU_METHOD fak_uw_b64 "" RAT_FUNC "%6.5" "-" COEFFS 0 65536 0 0 0 64 /end COMPU_METHOD
/begin COMPU_METHOD fak_uw_b8 "" RAT_FUNC "%6.5" "-" COEFFS 0 65536 0 0 0 8 /end COMPU_METHOD
/begin COMPU_METHOD freq_ub_b0p05 "" RAT_FUNC "%6.5" "1/s" COEFFS 0 256 0 0 0 0.05 /end COMPU_METHOD
/begin COMPU_METHOD m_ub_b1020 "" RAT_FUNC "%6.2" "kg/h" COEFFS 0 1 0 0 0 4 /end COMPU_METHOD
/begin COMPU_METHOD m_uw_b291p25 "" RAT_FUNC "%6.4" "g" COEFFS 0 225 0 0 0 1 /end COMPU_METHOD
/begin COMPU_METHOD m_uw_b4660 "" RAT_FUNC "%6.4" "g" COEFFS 0 3600 0 0 0 256 /end COMPU_METHOD
/begin COMPU_METHOD m_uw_b6553p5 "" RAT_FUNC "%6.3" "kg/h" COEFFS 0 1 0 0 0 0.1 /end COMPU_METHOD
/begin COMPU_METHOD m_uw_b7281 "" RAT_FUNC "%6.3" "g" COEFFS 0 9 0 0 0 1 /end COMPU_METHOD
/begin COMPU_METHOD nmotd_sb_q10 "" RAT_FUNC "%6.1" "1/min" COEFFS 0 1 0 0 0 10 /end COMPU_METHOD
/begin COMPU_METHOD nmotg_sb_q100 "" RAT_FUNC "%6.0" "1/min/s" COEFFS 0 1 0 0 0 100 /end COMPU_METHOD
/begin COMPU_METHOD nmotg_sw_q0p39 "" RAT_FUNC "%6.3" "1/min/s" COEFFS 0 1 0 0 0 0.39063 /end COMPU_METHOD
/begin COMPU_METHOD nmot_q1 "" RAT_FUNC "%6.2" "1/min" COEFFS 0 1 0 0 0 1 /end COMPU_METHOD
/begin COMPU_METHOD nmot_sw_q0p25 "" RAT_FUNC "%6.3" "1/min" COEFFS 0 1 0 0 0 0.25 /end COMPU_METHOD
/begin COMPU_METHOD nmot_ub_q10 "" RAT_FUNC "%6.1" "1/min" COEFFS 0 1 0 0 0 10 /end COMPU_METHOD
/begin COMPU_METHOD nmot_ub_q40 "" RAT_FUNC "%6.1" "1/min" COEFFS 0 1 0 0 0 40 /end COMPU_METHOD
/begin COMPU_METHOD nmot_uw_q0p25 "" RAT_FUNC "%6.3" "1/min" COEFFS 0 1 0 0 0 0.25 /end COMPU_METHOD
/begin COMPU_METHOD relDK_ub_b100 "" RAT_FUNC "%6.3" "%DK" COEFFS 0 255 0 0 0 100 /end COMPU_METHOD
/begin COMPU_METHOD relNWU_q0p0234 "" RAT_FUNC "%6.4" "%/NWU" COEFFS 0 32 0 0 0 0.75 /end COMPU_METHOD
/begin COMPU_METHOD relPED_uw_b100 "" RAT_FUNC "%6.4" "%PED" COEFFS 0 65535 0 0 0 100 /end COMPU_METHOD
/begin COMPU_METHOD rel_q0p002383 "" RAT_FUNC "%6.4" "%/(s*1/min)" COEFFS 0 256 0 0 0 0.61 /end COMPU_METHOD
/begin COMPU_METHOD rel_q0p00305 "" RAT_FUNC "%6.4" "%/(1/min)" COEFFS 0 256 0 0 0 0.7812 /end COMPU_METHOD
/begin COMPU_METHOD rel_q0p02344 "" RAT_FUNC "%6.4" "%" COEFFS 0 32 0 0 0 0.75 /end COMPU_METHOD
/begin COMPU_METHOD rel_q0p1957 "" RAT_FUNC "%6.3" "%" COEFFS 0 511 0 0 0 100 /end COMPU_METHOD
/begin COMPU_METHOD rel_qn0p000488 "" RAT_FUNC "%8.7" "(%*s)/(1/min)" COEFFS 0 -256 0 0 0 0.125 /end COMPU_METHOD
/begin COMPU_METHOD rel_sb_b25 "" RAT_FUNC "%6.3" "%" COEFFS 0 128 0 0 0 25 /end COMPU_METHOD
/begin COMPU_METHOD rel_sb_q0p39 "" RAT_FUNC "%6.3" "%" COEFFS 0 1 0 0 0 0.3906 /end COMPU_METHOD
/begin COMPU_METHOD rel_sw_b100 "" RAT_FUNC "%6.4" "%" COEFFS 0 32768 0 0 0 100 /end COMPU_METHOD
/begin COMPU_METHOD rel_sw_b1536 "" RAT_FUNC "%6.4" "%" COEFFS 0 65536 0 0 0 3072 /end COMPU_METHOD
/begin COMPU_METHOD rel_sw_b192 "" RAT_FUNC "%6.4" "%" COEFFS 0 65536 0 0 0 384 /end COMPU_METHOD
/begin COMPU_METHOD rel_sw_b32 "" RAT_FUNC "%6.5" "%" COEFFS 0 65536 0 0 0 64 /end COMPU_METHOD
/begin COMPU_METHOD rel_sw_b50 "" RAT_FUNC "%6.4" "%" COEFFS 0 65536 0 0 0 100 /end COMPU_METHOD
/begin COMPU_METHOD rel_ub_b100 "" RAT_FUNC "%6.3" "%" COEFFS 0 256 0 0 0 100 /end COMPU_METHOD
/begin COMPU_METHOD rel_ub_b127p5 "" RAT_FUNC "%6.3" "%" COEFFS 0 2 0 0 0 1 /end COMPU_METHOD
/begin COMPU_METHOD rel_ub_b1p0 "" RAT_FUNC "%6.4" "%" COEFFS 0 256 0 0 0 1 /end COMPU_METHOD
/begin COMPU_METHOD rel_ub_b24p9 "" RAT_FUNC "%6.3" "%" COEFFS 0 255 0 0 0 24.9 /end COMPU_METHOD
/begin COMPU_METHOD rel_ub_b99p6 "" RAT_FUNC "%6.3" "%" COEFFS 0 256 0 0 0 100 /end COMPU_METHOD
/begin COMPU_METHOD rel_ub_bn24p9 "" RAT_FUNC "%6.5" "%" COEFFS 0 -255 0 0 0 24.9 /end COMPU_METHOD
/begin COMPU_METHOD rel_ub_q0p75 "" RAT_FUNC "%6.3" "%" COEFFS 0 1 0 0 0 0.75 /end COMPU_METHOD
/begin COMPU_METHOD rel_uw_b100 "" RAT_FUNC "%6.4" "%" COEFFS 0 65536 0 0 0 100 /end COMPU_METHOD
/begin COMPU_METHOD rel_uw_b200 "" RAT_FUNC "%6.4" "%" COEFFS 0 65536 0 0 0 200 /end COMPU_METHOD
/begin COMPU_METHOD rel_uw_q0p0234 "" RAT_FUNC "%6.4" "%" COEFFS 0 32 0 0 0 0.75 /end COMPU_METHOD
/begin COMPU_METHOD spg_ub_q0p0052_o0p2 "" RAT_FUNC "%6.3" "V" COEFFS 0 255 51 0 0 1.33 /end COMPU_METHOD
/begin COMPU_METHOD spg_uw_q0p00488_o1 "" RAT_FUNC "%6.3" "V" COEFFS 0 1024 1024 0 0 5 /end COMPU_METHOD
/begin COMPU_METHOD t100msxs_ub_b25p5 "" RAT_FUNC "%6.3" "s" COEFFS 0 1 0 0 0 0.1 /end COMPU_METHOD
/begin COMPU_METHOD t100msxs_uw_b6553p5 "" RAT_FUNC "%6.3" "s" COEFFS 0 1 0 0 0 0.1 /end COMPU_METHOD
/begin COMPU_METHOD t10msxs_ub_b2p55 "" RAT_FUNC "%6.4" "s" COEFFS 0 1 0 0 0 0.01 /end COMPU_METHOD
/begin COMPU_METHOD t10msxs_uw_b655p35 "" RAT_FUNC "%6.4" "s" COEFFS 0 1 0 0 0 0.01 /end COMPU_METHOD
/begin COMPU_METHOD t1sxs_uw_b65535 "" RAT_FUNC "%6.2" "s" COEFFS 0 1 0 0 0 1 /end COMPU_METHOD
/begin COMPU_METHOD t200msxs_ub_b51 "" RAT_FUNC "%6.3" "s" COEFFS 0 1 0 0 0 0.2 /end COMPU_METHOD
/begin COMPU_METHOD t200msxs_uw_q0p2 "" RAT_FUNC "%6.3" "s" COEFFS 0 1 0 0 0 0.2 /end COMPU_METHOD
/begin COMPU_METHOD t20msxs_ub_b5p1 "" RAT_FUNC "%6.4" "s" COEFFS 0 1 0 0 0 0.02 /end COMPU_METHOD
/begin COMPU_METHOD t20msxs_uw_q0p02 "" RAT_FUNC "%6.4" "s" COEFFS 0 1 0 0 0 0.02 /end COMPU_METHOD
/begin COMPU_METHOD temp_q0p0234_o273 "" RAT_FUNC "%6.1" "Grad C" COEFFS 0 1 273.15 0 0 0.0234375 /end COMPU_METHOD
/begin COMPU_METHOD temp_sb_q0p75 "" RAT_FUNC "%6.3" "Grad C" COEFFS 0 1 0 0 0 0.75 /end COMPU_METHOD
/begin COMPU_METHOD temp_ub_b191p25 "" RAT_FUNC "%6.3" "Grad C" COEFFS 0 1 0 0 0 0.75 /end COMPU_METHOD
/begin COMPU_METHOD temp_ub_q0p75_o48 "" RAT_FUNC "%6.2" "Grad C" COEFFS 0 1 48 0 0 0.75 /end COMPU_METHOD
/begin COMPU_METHOD temp_uw_q0p0195_o50 "" RAT_FUNC "%6.2" "Grad C" COEFFS 0 256 12800 0 0 5 /end COMPU_METHOD
/begin COMPU_METHOD tz10msxs_uw_b327p68 "" RAT_FUNC "%6.2" "s" COEFFS 0 0 327.68 0 1 0 /end COMPU_METHOD
/begin COMPU_METHOD t_q0p1 "" RAT_FUNC "%6.3" "s" COEFFS 0 10 0 0 0 1 /end COMPU_METHOD
/begin COMPU_METHOD vfzg_ub_q1p25 "" RAT_FUNC "%6.2" "km/h" COEFFS 0 1 0 0 0 1.25 /end COMPU_METHOD
/begin COMPU_METHOD zk100msxs_ub_b25p5 "" RAT_FUNC "%6.3" "s" COEFFS 0 0 256 0 10 0 /end COMPU_METHOD
/begin COMPU_METHOD zk10msxs_ub_b2p55 "" RAT_FUNC "%6.4" "s" COEFFS 0 0 255 0 100 0 /end COMPU_METHOD
/begin COMPU_METHOD zk10msxs_uw_b655 "" RAT_FUNC "%10.4" "s" COEFFS 0 0 65536 0 100 0 /end COMPU_METHOD
/begin COMPU_METHOD zk200msxs_ub_b51p2 "" RAT_FUNC "%6.3" "s" COEFFS 0 0 51.2 0 1 0 /end COMPU_METHOD
/begin COMPU_METHOD zk200msxs_uw_b13107 "" RAT_FUNC "%10.2" "s" COEFFS 0 0 13107 0 1 0 /end COMPU_METHOD
/begin COMPU_METHOD zk200msxs_uw_b5 "" RAT_FUNC "%7.6" "1/s" COEFFS 0 65536 0 0 0 5 /end COMPU_METHOD
/begin COMPU_METHOD zk200msxs_uw_b960 "" RAT_FUNC "%6.4" "%/s" COEFFS 0 65536 0 0 0 960 /end COMPU_METHOD
/begin COMPU_METHOD zk20msxs_ub_b5p1 "" RAT_FUNC "%6.4" "s" COEFFS 0 0 5.1 0 1 0 /end COMPU_METHOD
/begin COMPU_METHOD zk50msxs_uw_b3276p8 "" RAT_FUNC "%6.1" "s" COEFFS 0 0 65536 0 20 0 /end COMPU_METHOD
/begin COMPU_METHOD zw_sb_q0p75 "" RAT_FUNC "%6.3" "Grad KW" COEFFS 0 255 0 0 0 191.25 /end COMPU_METHOD
/begin RECORD_LAYOUT FklWUb FNC_VALUES 1 UBYTE COLUMN_DIR DIRECT /end RECORD_LAYOUT
/begin RECORD_LAYOUT GkfWSb FNC_VALUES 1 SBYTE COLUMN_DIR DIRECT /end RECORD_LAYOUT
/begin RECORD_LAYOUT GkfWSw FNC_VALUES 1 SWORD COLUMN_DIR DIRECT /end RECORD_LAYOUT
/begin RECORD_LAYOUT GkfWUb FNC_VALUES 1 UBYTE COLUMN_DIR DIRECT /end RECORD_LAYOUT
/begin RECORD_LAYOUT GkfWUw FNC_VALUES 1 UWORD COLUMN_DIR DIRECT /end RECORD_LAYOUT
/begin RECORD_LAYOUT GklWS16 FNC_VALUES 1 SWORD COLUMN_DIR DIRECT /end RECORD_LAYOUT
/begin RECORD_LAYOUT GklWSb FNC_VALUES 1 SBYTE COLUMN_DIR DIRECT /end RECORD_LAYOUT
/begin RECORD_LAYOUT GklWU8 FNC_VALUES 1 UBYTE COLUMN_DIR DIRECT /end RECORD_LAYOUT
/begin RECORD_LAYOUT GklWUb FNC_VALUES 1 UBYTE COLUMN_DIR DIRECT /end RECORD_LAYOUT
/begin RECORD_LAYOUT GklWUw FNC_VALUES 1 UWORD COLUMN_DIR DIRECT /end RECORD_LAYOUT
/begin RECORD_LAYOUT KfAxU8AyU8SstxU8SstyU8WU8 NO_AXIS_PTS_X 1 UBYTE NO_AXIS_PTS_Y 2 UBYTE AXIS_PTS_X 3 UBYTE INDEX_INCR DIRECT AXIS_PTS_Y 4 UBYTE INDEX_INCR DIRECT FNC_VALUES 5 UBYTE COLUMN_DIR DIRECT /end RECORD_LAYOUT
/begin RECORD_LAYOUT KfAxUbAyUbSstxSbSstyUbWUb NO_AXIS_PTS_X 1 UBYTE NO_AXIS_PTS_Y 2 UBYTE AXIS_PTS_X 3 SBYTE INDEX_INCR DIRECT AXIS_PTS_Y 4 UBYTE INDEX_INCR DIRECT FNC_VALUES 5 UBYTE COLUMN_DIR DIRECT /end RECORD_LAYOUT
/begin RECORD_LAYOUT KfAxUbAyUbSstxSwSstyUbWSw NO_AXIS_PTS_X 1 UBYTE NO_AXIS_PTS_Y 2 UBYTE AXIS_PTS_X 3 SWORD INDEX_INCR DIRECT AXIS_PTS_Y 4 UBYTE INDEX_INCR DIRECT FNC_VALUES 5 SWORD COLUMN_DIR DIRECT /end RECORD_LAYOUT
/begin RECORD_LAYOUT KfAxUbAyUbSstxUbSstyUbWUb NO_AXIS_PTS_X 1 UBYTE NO_AXIS_PTS_Y 2 UBYTE AXIS_PTS_X 3 UBYTE INDEX_INCR DIRECT AXIS_PTS_Y 4 UBYTE INDEX_INCR DIRECT FNC_VALUES 5 UBYTE COLUMN_DIR DIRECT /end RECORD_LAYOUT
/begin RECORD_LAYOUT KfAxUbAyUbSstxUbSstyUwWUw NO_AXIS_PTS_X 1 UBYTE NO_AXIS_PTS_Y 2 UBYTE AXIS_PTS_X 3 UBYTE INDEX_INCR DIRECT AXIS_PTS_Y 4 UWORD INDEX_INCR DIRECT FNC_VALUES 5 UWORD COLUMN_DIR DIRECT /end RECORD_LAYOUT
/begin RECORD_LAYOUT KfAxUwAyUwSstxUwSstyUwWUw NO_AXIS_PTS_X 1 UWORD NO_AXIS_PTS_Y 2 UWORD AXIS_PTS_X 3 UWORD INDEX_INCR DIRECT AXIS_PTS_Y 4 UWORD INDEX_INCR DIRECT FNC_VALUES 5 UWORD COLUMN_DIR DIRECT /end RECORD_LAYOUT
/begin RECORD_LAYOUT KlAUbSstUbWSb NO_AXIS_PTS_X 1 UBYTE AXIS_PTS_X 2 UBYTE INDEX_INCR DIRECT FNC_VALUES 3 SBYTE COLUMN_DIR DIRECT /end RECORD_LAYOUT
/begin RECORD_LAYOUT KlAUbSstUbWUb NO_AXIS_PTS_X 1 UBYTE AXIS_PTS_X 2 UBYTE INDEX_INCR DIRECT FNC_VALUES 3 UBYTE COLUMN_DIR DIRECT /end RECORD_LAYOUT
/begin RECORD_LAYOUT KlAUbSstUbWUw NO_AXIS_PTS_X 1 UBYTE AXIS_PTS_X 2 UBYTE INDEX_INCR DIRECT FNC_VALUES 3 UWORD COLUMN_DIR DIRECT /end RECORD_LAYOUT
/begin RECORD_LAYOUT KlAUwSstUwWUb NO_AXIS_PTS_X 1 UWORD AXIS_PTS_X 2 UWORD INDEX_INCR DIRECT FNC_VALUES 3 UBYTE COLUMN_DIR DIRECT /end RECORD_LAYOUT
/begin RECORD_LAYOUT KlAUwSstUwWUw NO_AXIS_PTS_X 1 UWORD AXIS_PTS_X 2 UWORD INDEX_INCR DIRECT FNC_VALUES 3 UWORD COLUMN_DIR DIRECT /end RECORD_LAYOUT
/begin RECORD_LAYOUT KlAxU8SstxU16WU16 NO_AXIS_PTS_X 1 UWORD AXIS_PTS_X 2 UWORD INDEX_INCR DIRECT FNC_VALUES 3 UWORD COLUMN_DIR DIRECT /end RECORD_LAYOUT
/begin RECORD_LAYOUT KlAxU8SstxU8WU8 NO_AXIS_PTS_X 1 UBYTE AXIS_PTS_X 2 UBYTE INDEX_INCR DIRECT FNC_VALUES 3 UBYTE COLUMN_DIR DIRECT /end RECORD_LAYOUT
/begin RECORD_LAYOUT KwSb FNC_VALUES 1 SBYTE COLUMN_DIR DIRECT /end RECORD_LAYOUT
/begin RECORD_LAYOUT KwSw FNC_VALUES 1 SWORD COLUMN_DIR DIRECT /end RECORD_LAYOUT
/begin RECORD_LAYOUT KwUb FNC_VALUES 1 UBYTE COLUMN_DIR DIRECT /end RECORD_LAYOUT
/begin RECORD_LAYOUT KwUw FNC_VALUES 1 UWORD COLUMN_DIR DIRECT /end RECORD_LAYOUT
/begin RECORD_LAYOUT KwWS16 FNC_VALUES 1 SWORD COLUMN_DIR DIRECT /end RECORD_LAYOUT
/begin RECORD_LAYOUT KwWU16 FNC_VALUES 1 UWORD COLUMN_DIR DIRECT /end RECORD_LAYOUT
/begin RECORD_LAYOUT KwWU8 FNC_VALUES 1 UBYTE COLUMN_DIR DIRECT /end RECORD_LAYOUT
/begin RECORD_LAYOUT SstASwSstSw NO_AXIS_PTS_X 1 SWORD AXIS_PTS_X 2 SWORD INDEX_INCR DIRECT /end RECORD_LAYOUT
/begin RECORD_LAYOUT SstAU8SstS16 NO_AXIS_PTS_X 1 SWORD AXIS_PTS_X 2 SWORD INDEX_INCR DIRECT /end RECORD_LAYOUT
/begin RECORD_LAYOUT SstAUbSstSb NO_AXIS_PTS_X 1 UBYTE AXIS_PTS_X 2 SBYTE INDEX_INCR DIRECT /end RECORD_LAYOUT
/begin RECORD_LAYOUT SstAUbSstUb NO_AXIS_PTS_X 1 UBYTE AXIS_PTS_X 2 UBYTE INDEX_INCR DIRECT /end RECORD_LAYOUT
/begin RECORD_LAYOUT SstAUwSstUw NO_AXIS_PTS_X 1 UWORD AXIS_PTS_X 2 UWORD INDEX_INCR DIRECT /end RECORD_LAYOUT
/end MODULE
/end PROJECT
