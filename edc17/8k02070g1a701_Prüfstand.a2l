ASAP2_VERSION 1 3
/begin PROJECT _9702_071D00 "ME97"
/begin HEADER "" VERSION "_9702_071D00" PROJECT_NO _9702_071D00 /end HEADER
/begin MODULE DIM ""
/begin MOD_COMMON "" BYTE_ORDER MSB_FIRST ALIGNMENT_BYTE 1 ALIGNMENT_WORD 2 ALIGNMENT_LONG 2 ALIGNMENT_FLOAT32_IEEE 4 /end MOD_COMMON
/begin CHARACTERISTIC ANZRIBEH "Anzahl der Ri-Berechnungen hinter KAT" VALUE 0x1C4D44 KwUb 255.0 dez 0.00 255.0 FORMAT "%5.1" /end CHARACTERISTIC
/begin CHARACTERISTIC CWANW "Codewort: Anzahl der Nockenwellen" VALUE 0x1C662A KwWU8 3.000 dez 2.000 5.000 FORMAT "%5.3" /end CHARACTERISTIC
/begin CHARACTERISTIC CWGGLSH "Codeword f¸r Ri-Auswertung f¸r Sonde hinter KAT" VALUE 0x1CCA4E KwUb 255.0 dez 0.00 255.0 FORMAT "%5.1" /end CHARACTERISTIC
/begin CHARACTERISTIC CWGGLSU "Codewort f¸r GGLSU" VALUE 0x1C4DB2 KwWU8 255.0 dez 0.00 255.0 FORMAT "%5.1" /end CHARACTERISTIC
/begin CHARACTERISTIC CWHFMPUKL1 "Codewort zur Auswahl der Verstellelement 1 f¸r HFM-Pulsations-KF" VALUE 0x1C2DC4 KwUb 255.0 dez 0.00 255.0 FORMAT "%5.1" /end CHARACTERISTIC
/begin CHARACTERISTIC CWHFMPUKL2 "Codewort zur Auswahl der Verstellelement 2 f¸r HFM-Pulsations-KF" VALUE 0x1C2DC5 KwUb 255.0 dez 0.00 255.0 FORMAT "%5.1" /end CHARACTERISTIC
/begin CHARACTERISTIC CWHTNWS "Codewort HT2KTNWS" VALUE 0x1CAB07 KwUb 255.0 dez 0.00 255.0 FORMAT "%5.1" /end CHARACTERISTIC
/begin CHARACTERISTIC CWKONGTM "Codewort f¸r Konfiguration Grˆﬂe Temperatur Motor TMOT" VALUE 0x1CEB04 KwUb 255.0 dez 0.00 255.0 FORMAT "%5.1" /end CHARACTERISTIC
/begin CHARACTERISTIC CWKRAPP "Codewort f¸r Applikation KR" VALUE 0x1C65A0 KwWU8 255.0 dez 0.00 255.0 FORMAT "%5.1" /end CHARACTERISTIC
/begin CHARACTERISTIC CWKRINT "Codewort Klopfregelung: Bildung des Klopferkennungsmerkmales" VALUE 0x1C65A1 KwWU8 255.0 dez 0.00 255.0 FORMAT "%5.1" /end CHARACTERISTIC
/begin CHARACTERISTIC CWKRSHIFT "Systemkonstante Klopfreglung Integrationsergebnis" VALUE 0x1C65A5 KwUb 255.0 dez 0.00 255.0 FORMAT "%5.1" /end CHARACTERISTIC
/begin CHARACTERISTIC CWPG1 "Codewort f¸r Eigenschaften des Nockenwellensignals PG1" VALUE 0x1C6636 KwWU16 65535.00 dez 0.00 65535.00 FORMAT "%8.2" /end CHARACTERISTIC
/begin CHARACTERISTIC CWPG2 "Codewort f¸r Eigenschaften des Nockenwellensignals PG2" VALUE 0x1C6638 KwWU16 65535.00 dez 0.00 65535.00 FORMAT "%8.2" /end CHARACTERISTIC
/begin CHARACTERISTIC CWPG3 "Codewort f¸r Eigenschaften des Nockenwellensignals PG3" VALUE 0x1C663A KwWU16 65535.00 dez 0.00 65535.00 FORMAT "%8.2" /end CHARACTERISTIC
/begin CHARACTERISTIC CWPG4 "Codewort f¸r Eigenschaften des Nockenwellensignals PG4" VALUE 0x1C663C KwWU16 65535.00 dez 0.00 65535.00 FORMAT "%8.2" /end CHARACTERISTIC
/begin CHARACTERISTIC CW_TABST "" VALUE 0x1CEB05 KwUb 255.0 dez 0.00 255.0 FORMAT "%5.1" /end CHARACTERISTIC
/begin CHARACTERISTIC DFH_FIL "EGAS: PT1-Filterkonstante zur Fzg-Geschw.berechnung hinten" VALUE 0x1D3124 dc_KwUb 1.275 DC_TQ5 0.00 1.275 FORMAT "%5.3" /end CHARACTERISTIC
/begin CHARACTERISTIC DFV_FIL "EGAS: PT1-Filterkonstante zur Fzg-Geschw.berechnung vorne" VALUE 0x1D3125 dc_KwUb 1.275 DC_TQ5 0.00 1.275 FORMAT "%5.3" /end CHARACTERISTIC
/begin CHARACTERISTIC DF_ROH_UP "G¸ltigkeitsgrenze f¸r Raddrehzahlen ¸ber CAN auf Inkrementebene" VALUE 0x1D22C4 dc_KwUw 32767.50 DC_URD_05 0.00 32767.50 FORMAT "%8.2" /end CHARACTERISTIC
/begin CHARACTERISTIC DMAKRLA "Korrektur Meﬂfensteranfang lambdaabh‰ngig" CURVE 0x1CE8B2 KlAxU8SstxU16WS16 60.00000 zw_sb_q0p75 -30.00000 30.00000 FORMAT "%8.5"
 /begin AXIS_DESCR STD_AXIS lamsbg_w fak_uw_b16 8 0.00 15.99976 FORMAT "%8.5" DEPOSIT ABSOLUTE /end AXIS_DESCR
/end CHARACTERISTIC
/begin CHARACTERISTIC DPHFLFR1 "Maximale Abweichung der Phasenflanke von PG1 nach fr¸h" VALUE 0x1C662B KwWU8 255.0 kw_q1 0.00 255.0 FORMAT "%5.1" /end CHARACTERISTIC
/begin CHARACTERISTIC DPHFLFR2 "Maximale Abweichung der Phasenflanke von PG2 nach fr¸h" VALUE 0x1C662C KwWU8 255.0 kw_q1 0.00 255.0 FORMAT "%5.1" /end CHARACTERISTIC
/begin CHARACTERISTIC DPHFLFR3 "Maximale Abweichung der Phasenflanke von PG3 nach fr¸h" VALUE 0x1C662D KwWU8 255.0 kw_q1 0.00 255.0 FORMAT "%5.1" /end CHARACTERISTIC
/begin CHARACTERISTIC DPHFLFR4 "Maximale Abweichung der Phasenflanke von PG4 nach fr¸h" VALUE 0x1C662E KwWU8 255.0 kw_q1 0.00 255.0 FORMAT "%5.1" /end CHARACTERISTIC
/begin CHARACTERISTIC DPHFLSP1 "Maximale Abweichung der Phasenflanke von PG1 nach sp‰t" VALUE 0x1C662F KwWU8 255.0 kw_q1 0.00 255.0 FORMAT "%5.1" /end CHARACTERISTIC
/begin CHARACTERISTIC DPHFLSP2 "Maximale Abweichung der Phasenflanke von PG2 nach sp‰t" VALUE 0x1C6630 KwWU8 255.0 kw_q1 0.00 255.0 FORMAT "%5.1" /end CHARACTERISTIC
/begin CHARACTERISTIC DPHFLSP3 "Maximale Abweichung der Phasenflanke von PG3 nach sp‰t" VALUE 0x1C6631 KwWU8 255.0 kw_q1 0.00 255.0 FORMAT "%5.1" /end CHARACTERISTIC
/begin CHARACTERISTIC DPHFLSP4 "Maximale Abweichung der Phasenflanke von PG4 nach sp‰t" VALUE 0x1C6632 KwWU8 255.0 kw_q1 0.00 255.0 FORMAT "%5.1" /end CHARACTERISTIC
/begin CHARACTERISTIC DPRHLSU "Relative Heizleistungs‰nderung (delta) pro Zeit w‰hrend der Aufheizphase" VALUE 0x1CCB8A KwWS16 99.99998 rel_q0p0061 0.00 99.99998 FORMAT "%8.4" /end CHARACTERISTIC
/begin CHARACTERISTIC DRILSUSTA "Max. zul‰ssige Widerstandsabweichung vom Sollwert f¸r Heizerstatus A" VALUE 0x1CCB8C KwWS16 2559.961 r_q0p0391 -1280.000 1279.961 FORMAT "%8.3" /end CHARACTERISTIC
/begin CHARACTERISTIC DRILSUSTB "Max. zul‰ssige Widerstandsabweichung vom Sollwert f¸r Heizerstatus B" VALUE 0x1CCB8E KwWS16 2559.961 r_q0p0391 -1280.000 1279.961 FORMAT "%8.3" /end CHARACTERISTIC
/begin CHARACTERISTIC DRMX "oberer Plausibilit‰tsschwellwert f¸r Raddrehzahl" VALUE 0x1D22C6 dc_KwUw 32767.50 DC_URD_05 0.00 32767.50 FORMAT "%8.2" /end CHARACTERISTIC
/begin CHARACTERISTIC DTLRTML "Bewertungsfaktor Zeitdekrementierung f¸r Erreichen tmot-Einschaltschwelle LR" CURVE 0x1CEB08 KlAUbSstUbWUb 99.61 rel_ub_b99p6 0.00 99.61 FORMAT "%5.2"
 /begin AXIS_DESCR STD_AXIS mll1 m_ub_b1020 7 0.00 1020. FORMAT "%5.0" DEPOSIT ABSOLUTE /end AXIS_DESCR
/end CHARACTERISTIC
/begin CHARACTERISTIC DTMABDTMN "Min. Differenz Motortemperatur zwischen Abstellen und Neustart f¸r Diagnose TMOT" VALUE 0x1CEB17 KwUb 191.3 temp_ub_b191p25 0.00 191.3 FORMAT "%5.1" /end CHARACTERISTIC
/begin CHARACTERISTIC DTMDMA "Abstand Motortemperaturmodell zur Starttemperatur" VALUE 0x1CEB18 KwUb 191.3 temp_ub_b191p25 0.00 191.3 FORMAT "%5.1" /end CHARACTERISTIC
/begin CHARACTERISTIC DTMDNPO "Abstand Motortemperaturmodell zur oberen Unplausibilit‰tsschwelle" VALUE 0x1CEB19 KwUb 191.3 temp_ub_b191p25 0.00 191.3 FORMAT "%5.1" /end CHARACTERISTIC
/begin CHARACTERISTIC DTMSRT "Delta Motortemp.zu Starttemp. f.Retrigg. Modelle (Blockheater-Erkennung)" VALUE 0x1CEB1A KwUb 191.3 temp_ub_b191p25 0.00 191.3 FORMAT "%5.1" /end CHARACTERISTIC
/begin CHARACTERISTIC DUDKP1HY "Offset f¸r Hysterese bei Umschaltung auf verst‰rktes Signal von DK-Poti 1" VALUE 0x1C3A2C KwUw 80.08377 spg_uw_q0p001222 0.00 80.08377 FORMAT "%8.5" /end CHARACTERISTIC
/begin CHARACTERISTIC DURINLSU "maximal zul‰ssige Spannungs‰nderung f¸r Berechnung rinlsu_w" VALUE 0x1C4E52 KwWU16 319.9951 spg_q0p00488 0.00 319.9951 FORMAT "%8.4" /end CHARACTERISTIC
/begin CHARACTERISTIC DUSRIH "Delta Sondenspannung hinter Kat zwischen Neu-und Altwert  f¸r Ri-Messung" VALUE 0x1C4D48 KwSw 319.9951 spg_sw_q0p00488 -160.0000 159.9951 FORMAT "%8.4" /end CHARACTERISTIC
/begin CHARACTERISTIC DUSSPH "Delta Sondensp. hinter Kat zwischen Neu-und 2 Altwerten f¸r Sonden Sprungmessung" VALUE 0x1C4D4A KwSw 319.9951 spg_sw_q0p00488 -160.0000 159.9951 FORMAT "%8.4" /end CHARACTERISTIC
/begin CHARACTERISTIC DWDK12O "Maximal zul‰ssige Abweichung zwischen den DK-Winkeln aus Poti 1 und 2" VALUE 0x1C3A0C KwUb 100.0 relDK_ub_b100 0.00 100.0 FORMAT "%5.1" /end CHARACTERISTIC
/begin CHARACTERISTIC DWDK13O "Maximal zul‰ssige Abweichung zwischen DK-Winkel aus Poti 1 und Ersatzwert" VALUE 0x1C3A0D KwUb 100.0 relDK_ub_b100 0.00 100.0 FORMAT "%5.1" /end CHARACTERISTIC
/begin CHARACTERISTIC DWDK23O "Maximal zul‰ssige Abweichung zwischen DK-Winkel aus Poti 2 und Ersatzwert" VALUE 0x1C3A0E KwUb 100.0 relDK_ub_b100 0.00 100.0 FORMAT "%5.1" /end CHARACTERISTIC
/begin CHARACTERISTIC DZZST "Anzahl Z‰hne bei Zahnunterdr¸ckung im Start" VALUE 0x1C6642 KwWU8 249.0 dez 6.000 255.0 FORMAT "%5.1" /end CHARACTERISTIC
/begin CHARACTERISTIC FABSTT "Faktor Abstellzeit f¸r Modelltemparatur" CURVE 0x1CEB5E KlAUwSstUwWUw 1.999969 fak_uw_b2 0.00 1.999969 FORMAT "%8.6"
 /begin AXIS_DESCR STD_AXIS tabst_w t1sxs_uw_q1 5 0.00 65535.00 FORMAT "%8.2" DEPOSIT ABSOLUTE /end AXIS_DESCR
/end CHARACTERISTIC
/begin CHARACTERISTIC FARIN "Umrechnungsfaktor f¸r Innenwiderstand Nernstzelle LSU" VALUE 0x1C4E54 KwWU16 1023.984 rpspg_q0p0156 0.00 1023.984 FORMAT "%8.3" /end CHARACTERISTIC
/begin CHARACTERISTIC FIPLSU "Faktor f¸r Umrechnung Spannung in Pumpstrom" VALUE 0x1C4DA2 KwWU16 16383.75 ispg_q0p25 0.00 16383.75 FORMAT "%8.2" /end CHARACTERISTIC
/begin CHARACTERISTIC FIPREFLSU "Bewertungsfaktor f¸r den Pumpstrom" VALUE 0x1C4DB3 KwWU8 31.88 i_q0p125_uA 0.00 31.88 FORMAT "%5.2" /end CHARACTERISTIC
/begin CHARACTERISTIC FLAMPFT "Druck-Korrekturfaktor f¸r Lambda fett" CURVE 0x1CCB14 KlAxU8SstxU16WU16 1.999969 fak_uw_b2 0.00 1.999969 FORMAT "%8.6"
 /begin AXIS_DESCR STD_AXIS palsu_w p_uw_q0p039 10 0.00 2559.961 FORMAT "%8.3" DEPOSIT ABSOLUTE /end AXIS_DESCR
/end CHARACTERISTIC
/begin CHARACTERISTIC FLAMPMR "Druck-Korrekturfaktor f¸r Lambda mager" CURVE 0x1CCB3E KlAxU8SstxU16WU16 1.999969 fak_uw_b2 0.00 1.999969 FORMAT "%8.6"
 /begin AXIS_DESCR STD_AXIS palsu_w p_uw_q0p039 10 0.00 2559.961 FORMAT "%8.3" DEPOSIT ABSOLUTE /end AXIS_DESCR
/end CHARACTERISTIC
/begin CHARACTERISTIC FLBKPUHFM "Schaltschwelle des Faktors der LBK f¸r Pulsationskorrektur des HFM" VALUE 0x1C2DC6 KwUb 0.9961 fak_ub_b1 0.00 0.9961 /end CHARACTERISTIC
/begin CHARACTERISTIC FLSUFTKL "Faktor zur Spannungsumrechung bei Verwendung der v=8-Kennlinie" VALUE 0x1C4DA4 KwWU16 3.999939 fak_uw_b4 0.00 3.999939 FORMAT "%8.6" /end CHARACTERISTIC
/begin CHARACTERISTIC FMFKRZN "Filterauswahl Klopfregelung" MAP 0x1C6140 KfAxU8AyU8SstxU16SstyU16WU16 4096.000 dez 0.00 4096.000 FORMAT "%8.3"
 /begin AXIS_DESCR STD_AXIS stkrfmf dez 4 0.00 65535.00 FORMAT "%8.2" DEPOSIT ABSOLUTE /end AXIS_DESCR
 /begin AXIS_DESCR STD_AXIS zzylkr_int dez 8 0.00 65535.00 FORMAT "%8.2" DEPOSIT ABSOLUTE /end AXIS_DESCR
/end CHARACTERISTIC
/begin CHARACTERISTIC FNWUEPUHFM "Schaltschwelle des Faktors der NWS f¸r Pulsationskorrektur des HFM" VALUE 0x1C2DC7 KwUb 0.9961 fak_ub_b1 0.00 0.9961 /end CHARACTERISTIC
/begin CHARACTERISTIC FRINOF "Faktor f¸r Bewertung alter Ri-Wert ohne Filter" VALUE 0x1C4D45 KwUb 15.94 fak_ub_b16 0.00 15.94 FORMAT "%5.2" /end CHARACTERISTIC
/begin CHARACTERISTIC FST1FULL "Prim‰rtank-Kraftstoffvolumen 'voll'-Schwelle zur Statusberechnung" VALUE 0x1CE20E KwUw 6553.500 vol_q0p1_l 0.00 6553.500 FORMAT "%8.3" /end CHARACTERISTIC
/begin CHARACTERISTIC FST1RTC "Prim‰rtank-Kraftstoffvolumen Nennkapazitaet" VALUE 0x1CE210 KwUw 6553.500 vol_q0p1_l 0.00 6553.500 FORMAT "%8.3" /end CHARACTERISTIC
/begin CHARACTERISTIC FST1UNU "Prim‰rtank 'nichtverwendbares' Volumen" VALUE 0x1CE212 KwUw 6553.500 vol_q0p1_l 0.00 6553.500 FORMAT "%8.3" /end CHARACTERISTIC
/begin CHARACTERISTIC FST2EMT "Sekund‰rtank-Kraftstoffvolumen 'leer'-Schwelle zur Statusberechnung" VALUE 0x1CE214 KwUw 6553.500 vol_q0p1_l 0.00 6553.500 FORMAT "%8.3" /end CHARACTERISTIC
/begin CHARACTERISTIC FST2EST "Erwartete Sekund‰rtank-Kraftstoffvolumen-Schwelle zur Statusberechnung" VALUE 0x1CE216 KwUw 6553.500 vol_q0p1_l 0.00 6553.500 FORMAT "%8.3" /end CHARACTERISTIC
/begin CHARACTERISTIC FST2UNU "Sekund‰rtank 'nichtverwendbares' Volumen" VALUE 0x1CE218 KwUw 6553.500 vol_q0p1_l 0.00 6553.500 FORMAT "%8.3" /end CHARACTERISTIC
/begin CHARACTERISTIC FSTEMT "Zweitank-Volumenschwelle f¸r 'leerer Tank' Erkennung" VALUE 0x1CE21A KwUw 6553.500 vol_q0p1_l 0.00 6553.500 FORMAT "%8.3" /end CHARACTERISTIC
/begin CHARACTERISTIC FSTFFHI "Zweitank-Volumenschwelle (HI Hyst-Paar) f¸r Schnellfilterung" VALUE 0x1CE21C KwUw 6553.500 vol_q0p1_l 0.00 6553.500 FORMAT "%8.3" /end CHARACTERISTIC
/begin CHARACTERISTIC FSTFFLO "Zweitank-Volumenschwelle (LO Hyst-Paar) f¸r Schnellfilterung" VALUE 0x1CE21E KwUw 6553.500 vol_q0p1_l 0.00 6553.500 FORMAT "%8.3" /end CHARACTERISTIC
/begin CHARACTERISTIC FSTGRNT "gangi-Wert f¸r Gangschalter in Neutralstellung" VALUE 0x1CE204 KwUb 255.0 dez 0.00 255.0 FORMAT "%5.1" /end CHARACTERISTIC
/begin CHARACTERISTIC FSTGRPK "gangi-Wert f¸r Gangschalter in Parkstellung" VALUE 0x1CE205 KwUb 255.0 dez 0.00 255.0 FORMAT "%5.1" /end CHARACTERISTIC
/begin CHARACTERISTIC FSTTMX "maximaler Tankinhalt" VALUE 0x1CE220 KwUw 319.9951 vol_q4p8828Em3_l 0.00 319.9951 FORMAT "%8.4" /end CHARACTERISTIC
/begin CHARACTERISTIC FSYNDEL "Prozentueller Segmentanteil f¸r erstes Zwangssynchro" VALUE 0x1C6643 KwWU8 50.00 rel_ub_b100 0.00 50.00 FORMAT "%5.2" /end CHARACTERISTIC
/begin CHARACTERISTIC FWADAPINI "Initialisierung von dfa_para ¸ber Bedatung" VALUE 0x1D3126 dc_KwUb 1.000 DC_CNTR_U8 0.00 1.000 FORMAT "%5.3" /end CHARACTERISTIC
/begin CHARACTERISTIC FWADAPMAX "oberer Hysterese-Schwellwert der Radadaption" VALUE 0x1D22C8 dc_KwUw 4.166614 DC_UDFCPARL 0.00 4.166614 FORMAT "%8.6" /end CHARACTERISTIC
/begin CHARACTERISTIC FWADAPMIN "unterer Hysterese-Schwellwert der Radadaption" VALUE 0x1D22CA dc_KwUw 4.166614 DC_UDFCPARL 0.00 4.166614 FORMAT "%8.6" /end CHARACTERISTIC
/begin CHARACTERISTIC FWADAPPL "Inkrement der Radadaption" VALUE 0x1D22CC dc_KwUw 4.166614 DC_UDFCPARL 0.00 4.166614 FORMAT "%8.6" /end CHARACTERISTIC
/begin CHARACTERISTIC FWBSFIL " PT1-Filterkonstante zur Fzg-Beschleunigung bs_hgb" VALUE 0x1D3127 dc_KwUb 5.100 DC_TQ20 0.00 5.100 FORMAT "%5.3" /end CHARACTERISTIC
/begin CHARACTERISTIC FWBSMAX "oberer Beschleunigungs-Schwellwert zur Radadaptionsfreigabe" VALUE 0x1D3128 dc_KwSb 11.07 DC_UAFZ_S8 -5.555 5.512 FORMAT "%5.3" /end CHARACTERISTIC
/begin CHARACTERISTIC FWBSMIN "unterer Beschleunigungs-Schwellwert zur Radadaptionsfreigabe" VALUE 0x1D3129 dc_KwSb 11.07 DC_UAFZ_S8 -5.555 5.512 FORMAT "%5.3" /end CHARACTERISTIC
/begin CHARACTERISTIC FWDADAP "Inkrement der Radadaption" VALUE 0x1D22CE dc_KwUw 4.166614 DC_UDFCPARL 0.00 4.166614 FORMAT "%8.6" /end CHARACTERISTIC
/begin CHARACTERISTIC FWGANGMAX "oberer Gangschwellwert zur Radadaptionsfreigabe" VALUE 0x1D312A dc_KwUb 255.0 DC_CNTR_U8 0.00 255.0 FORMAT "%5.1" /end CHARACTERISTIC
/begin CHARACTERISTIC FWGANGMIN "unterer Gangschwellwert zur Radadaptionsfreigabe" VALUE 0x1D312B dc_KwUb 255.0 DC_CNTR_U8 0.00 255.0 FORMAT "%5.1" /end CHARACTERISTIC
/begin CHARACTERISTIC FWMISTMAX "oberer Istmomenten-Schwellwert zur Radadaptionsfreigabe" VALUE 0x1D22D0 dc_KwSw 2047.938 DC_TRQ_S16 0.00 2047.938 FORMAT "%8.3" /end CHARACTERISTIC
/begin CHARACTERISTIC FWMISTMIN "unterer Istmomenten-Schwellwert zur Radadaptionsfreigabe" VALUE 0x1D22D2 dc_KwSw 2047.938 DC_TRQ_S16 0.00 2047.938 FORMAT "%8.3" /end CHARACTERISTIC
/begin CHARACTERISTIC FWNADAP "Maximaldrehzahl zur Freigebe der Radadaption" VALUE 0x1D22D4 dc_KwSw 32767.5 DC_ROTSPD_S16 -16384.0 16383.5 FORMAT "%7.1" /end CHARACTERISTIC
/begin CHARACTERISTIC FWTNDR "Entprellzeit f¸r Drehzahlsensor-Fehler" VALUE 0x1D312C dc_KwUb 5.100 DC_TQ20 0.00 5.100 FORMAT "%5.3" /end CHARACTERISTIC
/begin CHARACTERISTIC FWVADAP "Minimalgeschwindigkeit zur Freigabe der Radadaption" VALUE 0x1D22D6 dc_KwUw 4095.938 DC_VEHSPD_KMH_U16 0.00 4095.938 FORMAT "%8.3" /end CHARACTERISTIC
/begin CHARACTERISTIC FWVDIFF "zul‰ssige Geschwindigkeitsdifferenz pro Achse" VALUE 0x1D22D8 dc_KwUw 4095.938 DC_VEHSPD_KMH_U16 0.00 4095.938 FORMAT "%8.3" /end CHARACTERISTIC
/begin CHARACTERISTIC FW_TMVDBS "" VALUE 0x1D312D dc_KwUb 5.100 DC_TQ20 0.00 5.100 FORMAT "%5.3" /end CHARACTERISTIC
/begin CHARACTERISTIC FW_VASRM "" VALUE 0x1D22DA dc_KwUw 4095.938 DC_VEHSPD_KMH_U16 0.00 4095.938 FORMAT "%8.3" /end CHARACTERISTIC
/begin CHARACTERISTIC GSPAKTIV "Maximalzeit nach der Funktion GSP abgebrochen wird" VALUE 0x1CCAB8 KwUw 6553.500 t_q0p1 0.00 6553.500 FORMAT "%8.3" /end CHARACTERISTIC
/begin CHARACTERISTIC GSPL1ASG "Schaltschwelle f¸r Phase 1 der GSP im LL f¸r ASG" CURVE 0x1CCA50 GklWU8 255.0 dez 0.00 255.0 FORMAT "%5.1"
 /begin AXIS_DESCR COM_AXIS tmst temp_ub_q0p75_o48 8 -48.00 143.3 AXIS_PTS_REF STS08COUB /end AXIS_DESCR
/end CHARACTERISTIC
/begin CHARACTERISTIC GSPL1ASG1 "Schaltschwelle f¸r Phase 1 der GSP im LL f¸r ASG (Variante)" CURVE 0x1CCA58 GklWU8 255.0 dez 0.00 255.0 FORMAT "%5.1"
 /begin AXIS_DESCR COM_AXIS tmst temp_ub_q0p75_o48 8 -48.00 143.3 AXIS_PTS_REF STS08COUB /end AXIS_DESCR
/end CHARACTERISTIC
/begin CHARACTERISTIC GSPL1M "Schaltschwelle f¸r Phase 1 der GSP im LL" CURVE 0x1CCA60 GklWU8 255.0 dez 0.00 255.0 FORMAT "%5.1"
 /begin AXIS_DESCR COM_AXIS tmst temp_ub_q0p75_o48 8 -48.00 143.3 AXIS_PTS_REF STS08COUB /end AXIS_DESCR
/end CHARACTERISTIC
/begin CHARACTERISTIC GSPL1M1 "Schaltschwelle f¸r Phase 1 der GSP im LL (Variante)" CURVE 0x1CCA68 GklWU8 255.0 dez 0.00 255.0 FORMAT "%5.1"
 /begin AXIS_DESCR COM_AXIS tmst temp_ub_q0p75_o48 8 -48.00 143.3 AXIS_PTS_REF STS08COUB /end AXIS_DESCR
/end CHARACTERISTIC
/begin CHARACTERISTIC GSPS2ASG "Schaltschwelle f¸r Phase 2 der GSP (TL) f¸r ASG" CURVE 0x1CCA70 GklWU8 255.0 dez 0.00 255.0 FORMAT "%5.1"
 /begin AXIS_DESCR COM_AXIS tmst temp_ub_q0p75_o48 8 -48.00 143.3 AXIS_PTS_REF STS08COUB /end AXIS_DESCR
/end CHARACTERISTIC
/begin CHARACTERISTIC GSPS2ASG1 "Schaltschwelle f¸r Phase 2 der GSP (TL) f¸r ASG (Variante)" CURVE 0x1CCA78 GklWU8 255.0 dez 0.00 255.0 FORMAT "%5.1"
 /begin AXIS_DESCR COM_AXIS tmst temp_ub_q0p75_o48 8 -48.00 143.3 AXIS_PTS_REF STS08COUB /end AXIS_DESCR
/end CHARACTERISTIC
/begin CHARACTERISTIC GSPS2M "Schaltschwelle f¸r Phase 2 der GSP (TL)" CURVE 0x1CCA80 GklWU8 255.0 dez 0.00 255.0 FORMAT "%5.1"
 /begin AXIS_DESCR COM_AXIS tmst temp_ub_q0p75_o48 8 -48.00 143.3 AXIS_PTS_REF STS08COUB /end AXIS_DESCR
/end CHARACTERISTIC
/begin CHARACTERISTIC GSPS2M1 "Schaltschwelle f¸r Phase 2 der GSP (TL)  (Variante)" CURVE 0x1CCA88 GklWU8 255.0 dez 0.00 255.0 FORMAT "%5.1"
 /begin AXIS_DESCR COM_AXIS tmst temp_ub_q0p75_o48 8 -48.00 143.3 AXIS_PTS_REF STS08COUB /end AXIS_DESCR
/end CHARACTERISTIC
/begin CHARACTERISTIC GSPT1ASG "Schaltschwelle f¸r Phase 1 der GSP in der TL f¸r ASG" CURVE 0x1CCA90 GklWU8 255.0 dez 0.00 255.0 FORMAT "%5.1"
 /begin AXIS_DESCR COM_AXIS tmst temp_ub_q0p75_o48 8 -48.00 143.3 AXIS_PTS_REF STS08COUB /end AXIS_DESCR
/end CHARACTERISTIC
/begin CHARACTERISTIC GSPT1ASG1 "Schaltschwelle f¸r Phase 1 der GSP in der TL f¸r ASG (Variante)" CURVE 0x1CCA98 GklWU8 255.0 dez 0.00 255.0 FORMAT "%5.1"
 /begin AXIS_DESCR COM_AXIS tmst temp_ub_q0p75_o48 8 -48.00 143.3 AXIS_PTS_REF STS08COUB /end AXIS_DESCR
/end CHARACTERISTIC
/begin CHARACTERISTIC GSPT1M "Schaltschwelle f¸r Phase 1 der GSP in der TL" CURVE 0x1CCAA0 GklWU8 255.0 dez 0.00 255.0 FORMAT "%5.1"
 /begin AXIS_DESCR COM_AXIS tmst temp_ub_q0p75_o48 8 -48.00 143.3 AXIS_PTS_REF STS08COUB /end AXIS_DESCR
/end CHARACTERISTIC
/begin CHARACTERISTIC GSPT1M1 "Schaltschwelle f¸r Phase 1 der GSP in der TL (Variante)" CURVE 0x1CCAA8 GklWU8 255.0 dez 0.00 255.0 FORMAT "%5.1"
 /begin AXIS_DESCR COM_AXIS tmst temp_ub_q0p75_o48 8 -48.00 143.3 AXIS_PTS_REF STS08COUB /end AXIS_DESCR
/end CHARACTERISTIC
/begin CHARACTERISTIC GVDTMX "Gasvolumen Doppelt-Tank maximal" VALUE 0x1CE222 KwUw 6553.500 vol_q0p1_l 0.00 6553.500 FORMAT "%8.3" /end CHARACTERISTIC
/begin CHARACTERISTIC KDHRLSU "D-Verst‰rkungsfaktor des PID-Reglers f¸r %HRLSU" VALUE 0x1CCB90 KwWU16 2.083302 reltemp_q3p179Em5 0.00 2.083302 FORMAT "%8.6" /end CHARACTERISTIC
/begin CHARACTERISTIC KEMLN "Messfensterl‰nge f¸r Klopfregelung" CURVE 0x1C6130 GklWS8 86.25 zw_sb_q0p75 9.750 96.00 FORMAT "%5.2"
 /begin AXIS_DESCR COM_AXIS nmot nmot_ub_q40 16 0.00 10200. AXIS_PTS_REF SNM16KRUB /end AXIS_DESCR
/end CHARACTERISTIC
/begin CHARACTERISTIC KFBS "Kennfeld f¸r banksel. Gemischfaktor" MAP 0x1CD863 KfAxUbAyUbSstxUbSstyUbWSb 0.4980 fak_sb_b0p25 -0.2500 0.2480
 /begin AXIS_DESCR STD_AXIS nmot nmot_ub_q40 8 0.00 10200. FORMAT "%5.0" DEPOSIT ABSOLUTE /end AXIS_DESCR
 /begin AXIS_DESCR STD_AXIS rl rel_ub_q0p75 8 0.00 191.3 FORMAT "%5.1" DEPOSIT ABSOLUTE /end AXIS_DESCR
/end CHARACTERISTIC
/begin CHARACTERISTIC KFDTMRS "Kennfeld Motortemperatur-Gradient im Schub f¸r Referenzmodell" MAP 0x1CEB74 KfAxUbAyUbSstxUbSstyUbWSb 0.1868 temp_sb_b0p093 -0.09375 0.09302 FORMAT "%7.5"
 /begin AXIS_DESCR STD_AXIS mll1 m_ub_b1020 5 0.00 1020. FORMAT "%5.0" DEPOSIT ABSOLUTE /end AXIS_DESCR
 /begin AXIS_DESCR STD_AXIS tmrw temp_ub_q0p75_o48 4 -48.00 143.3 FORMAT "%5.1" DEPOSIT ABSOLUTE /end AXIS_DESCR
/end CHARACTERISTIC
/begin CHARACTERISTIC KFDTMTE "Kennfeld Motortemperaturgradient f¸r Ersatztemperatur" MAP 0x1CEB93 KfAxUbAyUbSstxUbSstyUbWSb 0.1868 temp_sb_b0p093 -0.09375 0.09302 FORMAT "%7.5"
 /begin AXIS_DESCR STD_AXIS mll1 m_ub_b1020 5 0.00 1020. FORMAT "%5.0" DEPOSIT ABSOLUTE /end AXIS_DESCR
 /begin AXIS_DESCR STD_AXIS tmew temp_ub_q0p75_o48 4 -48.00 143.3 FORMAT "%5.1" DEPOSIT ABSOLUTE /end AXIS_DESCR
/end CHARACTERISTIC
/begin CHARACTERISTIC KFDTMTR "Kennfeld Motortemperaturgradient f¸r Referenztemperatur" MAP 0x1CEBB2 KfAxUbAyUbSstxUbSstyUbWSb 0.1868 temp_sb_b0p093 -0.09375 0.09302 FORMAT "%7.5"
 /begin AXIS_DESCR STD_AXIS mll1 m_ub_b1020 5 0.00 1020. FORMAT "%5.0" DEPOSIT ABSOLUTE /end AXIS_DESCR
 /begin AXIS_DESCR STD_AXIS tmrw temp_ub_q0p75_o48 4 -48.00 143.3 FORMAT "%5.1" DEPOSIT ABSOLUTE /end AXIS_DESCR
/end CHARACTERISTIC
/begin CHARACTERISTIC KFDTMTU "Kennfeld Korrekturgradient Motortemperatur bei geringer Erw‰rmung" MAP 0x1CEBD1 KfAxUbAyUbSstxUbSstyUbWSb 0.1868 temp_sb_b0p093 -0.09375 0.09302 FORMAT "%7.5"
 /begin AXIS_DESCR STD_AXIS mll1 m_ub_b1020 5 0.00 1020. FORMAT "%5.0" DEPOSIT ABSOLUTE /end AXIS_DESCR
 /begin AXIS_DESCR STD_AXIS tumginp temp_ub_q0p75_o48 4 -48.00 143.3 FORMAT "%5.1" DEPOSIT ABSOLUTE /end AXIS_DESCR
/end CHARACTERISTIC
/begin CHARACTERISTIC KFKHFM "Korrekturkennfeld f¸r HFM" MAP 0x1C2DC8 KfAxUbAyUbSstxUbSstyUbWUb 1.992 fak_ub_b2 0.00 1.992 FORMAT "%5.3"
 /begin AXIS_DESCR STD_AXIS nmot nmot_ub_q40 14 0.00 10200. FORMAT "%5.0" DEPOSIT ABSOLUTE /end AXIS_DESCR
 /begin AXIS_DESCR STD_AXIS rl rel_ub_q0p75 14 0.00 191.3 FORMAT "%5.1" DEPOSIT ABSOLUTE /end AXIS_DESCR
/end CHARACTERISTIC
/begin CHARACTERISTIC KFKHFMDY "Korrekturkennfeld f¸r HFM in der Dynamik" MAP 0x1C2EAC KfAxUbAyUbSstxUbSstyUbWUb 1.992 fak_ub_b2 0.00 1.992 FORMAT "%5.3"
 /begin AXIS_DESCR STD_AXIS nmot nmot_ub_q40 8 0.00 10200. FORMAT "%5.0" DEPOSIT ABSOLUTE /end AXIS_DESCR
 /begin AXIS_DESCR STD_AXIS mlhfmofs m_ub_b1020 8 0.00 1020. FORMAT "%5.0" DEPOSIT ABSOLUTE /end AXIS_DESCR
/end CHARACTERISTIC
/begin CHARACTERISTIC KFMAKR "Kennfeld Meﬂfensteranfang Klopfregelung" MAP 0x1C60F0 GkfWS8 33.75 zw_sb_q0p75 0.7500 34.50 FORMAT "%5.2"
 /begin AXIS_DESCR COM_AXIS nmot nmot_ub_q40 16 0.00 10200. AXIS_PTS_REF SNM16KRUB /end AXIS_DESCR
 /begin AXIS_DESCR COM_AXIS rl rel_ub_q0p75 4 0.00 191.3 AXIS_PTS_REF SRL04KRUB /end AXIS_DESCR
/end CHARACTERISTIC
/begin CHARACTERISTIC KFPU "Pulsations - Kennfeld" MAP 0x1C2F00 KfAxUbAyUbSstxUbSstyUbWUb 1.992 fak_ub_b2 0.00 1.992 FORMAT "%5.3"
 /begin AXIS_DESCR STD_AXIS nmotkor nmot_ub_q40 14 0.00 10200. FORMAT "%5.0" DEPOSIT ABSOLUTE /end AXIS_DESCR
 /begin AXIS_DESCR STD_AXIS wdkba relDK_ub_b100 14 0.00 100.0 FORMAT "%5.1" DEPOSIT ABSOLUTE /end AXIS_DESCR
/end CHARACTERISTIC
/begin CHARACTERISTIC KFPUKLP1 "Pulsationskennfeld bei aktiver aktiven Verstellelement 1" MAP 0x1C2FE4 KfAxUbAyUbSstxUbSstyUbWUb 1.992 fak_ub_b2 0.00 1.992 FORMAT "%5.3"
 /begin AXIS_DESCR STD_AXIS nmotkor nmot_ub_q40 14 0.00 10200. FORMAT "%5.0" DEPOSIT ABSOLUTE /end AXIS_DESCR
 /begin AXIS_DESCR STD_AXIS wdkba relDK_ub_b100 14 0.00 100.0 FORMAT "%5.1" DEPOSIT ABSOLUTE /end AXIS_DESCR
/end CHARACTERISTIC
/begin CHARACTERISTIC KFPUKLP12 "Pulsationskennfeld bei aktiver aktiven Verstellelement 1 und 2" MAP 0x1C30C8 KfAxUbAyUbSstxUbSstyUbWUb 1.992 fak_ub_b2 0.00 1.992 FORMAT "%5.3"
 /begin AXIS_DESCR STD_AXIS nmotkor nmot_ub_q40 14 0.00 10200. FORMAT "%5.0" DEPOSIT ABSOLUTE /end AXIS_DESCR
 /begin AXIS_DESCR STD_AXIS wdkba relDK_ub_b100 14 0.00 100.0 FORMAT "%5.1" DEPOSIT ABSOLUTE /end AXIS_DESCR
/end CHARACTERISTIC
/begin CHARACTERISTIC KFPUKLP2 "Pulsationskennfeld bei aktiver aktiven Verstellelement 2" MAP 0x1C31AC KfAxUbAyUbSstxUbSstyUbWUb 1.992 fak_ub_b2 0.00 1.992 FORMAT "%5.3"
 /begin AXIS_DESCR STD_AXIS nmotkor nmot_ub_q40 14 0.00 10200. FORMAT "%5.0" DEPOSIT ABSOLUTE /end AXIS_DESCR
 /begin AXIS_DESCR STD_AXIS wdkba relDK_ub_b100 14 0.00 100.0 FORMAT "%5.1" DEPOSIT ABSOLUTE /end AXIS_DESCR
/end CHARACTERISTIC
/begin CHARACTERISTIC KIHRLSU "I-Verst‰rkungsfaktor des PID-Reglers f¸r %HRLSU" VALUE 0x1CCB92 KwWU16 1.302063 reltempgrd_q1p987Em5 0.00 1.302063 FORMAT "%8.6" /end CHARACTERISTIC
/begin CHARACTERISTIC KLFST1VL "Kennlinie: F¸llstandssignal --> Prim‰rtank-Volumen" CURVE 0x1CE224 KlAUwSstUwWUw 6553.500 vol_q0p1_l 0.00 6553.500 FORMAT "%8.3"
 /begin AXIS_DESCR STD_AXIS ufst1fdp_w rel_uw_b100 32 0.00 99.99847 FORMAT "%8.5" DEPOSIT ABSOLUTE /end AXIS_DESCR
/end CHARACTERISTIC
/begin CHARACTERISTIC KLFST2VL "Kennlinie: F¸llstandssignal --> Sekund‰rtankvolumen" CURVE 0x1CE2A6 KlAUwSstUwWUw 6553.500 vol_q0p1_l 0.00 6553.500 FORMAT "%8.3"
 /begin AXIS_DESCR STD_AXIS ufst2fdp_w rel_uw_b100 32 0.00 99.99847 FORMAT "%8.5" DEPOSIT ABSOLUTE /end AXIS_DESCR
/end CHARACTERISTIC
/begin CHARACTERISTIC KLITHMS "Kennlinie integrierte Luftmassenschwelle f¸r Thermostat-Monitoring THM" CURVE 0x1CEB1C KlAUbSstUbWUb 23.21 m_ub_b23p3 0.00 23.21 FORMAT "%5.2"
 /begin AXIS_DESCR STD_AXIS tmst temp_ub_q0p75_o48 4 -48.00 143.3 FORMAT "%5.1" DEPOSIT ABSOLUTE /end AXIS_DESCR
/end CHARACTERISTIC
/begin CHARACTERISTIC KLKTKVK "Kennlinie: Proportionalit‰tsfaktor zw. T-Abweichung der LSU und Korrekturfaktor" CURVE 0x1C4DCA KlAxU8SstxS16WU16 1.999969 fak_uw_b2 0.00 1.999969 FORMAT "%8.6"
 /begin AXIS_DESCR STD_AXIS rdtklsu_w temp_q0p0234 11 -768.0000 767.9766 FORMAT "%8.4" DEPOSIT ABSOLUTE /end AXIS_DESCR
/end CHARACTERISTIC
/begin CHARACTERISTIC KLPRHLSU "Initialisierungs-Kennlinie f¸r relative Heizleistung" CURVE 0x1CCB78 KlAxU8SstxU16WS16 99.99998 rel_q0p0061 0.00 99.99998 FORMAT "%8.4"
 /begin AXIS_DESCR STD_AXIS tatuk_w temp_q0p0234_o273 4 -273.1500 1262.827 FORMAT "%8.3" DEPOSIT ABSOLUTE /end AXIS_DESCR
/end CHARACTERISTIC
/begin CHARACTERISTIC KLRTLSU "Kennlinie Transformation Innenwiderstand der Nernstzelle in Temperatur" CURVE 0x1C4DF8 KlAxU8SstxU16WU16 1535.977 temp_q0p0234_o273 -273.1500 1262.827 FORMAT "%8.3"
 /begin AXIS_DESCR STD_AXIS rinlsu_w r_q0p0391 22 0.00 2559.961 FORMAT "%8.3" DEPOSIT ABSOLUTE /end AXIS_DESCR
/end CHARACTERISTIC
/begin CHARACTERISTIC KLTHMDTMS "Delta Motorstart-Temperatur f¸r Verifikation/Heilung Thermostatdiagnose" CURVE 0x1CEB28 KlAUbSstUbWUb 191.3 temp_ub_b191p25 0.00 191.3 FORMAT "%5.1"
 /begin AXIS_DESCR STD_AXIS tmst temp_ub_q0p75_o48 5 -48.00 143.3 FORMAT "%5.1" DEPOSIT ABSOLUTE /end AXIS_DESCR
/end CHARACTERISTIC
/begin CHARACTERISTIC KPHRLSU "P-Verst‰rkungsfaktor des PID-Reglers f¸r %HRLSU" VALUE 0x1CCB94 KwWU16 2.083302 reltemp_q3p179Em5 0.00 2.083302 FORMAT "%8.6" /end CHARACTERISTIC
/begin CHARACTERISTIC KRKOEFF "Klopfregelung: Filterkoeffizienten" VAL_BLK 0x1C619C KwbWU16 65535.00 dez 0.00 65535.00 FORMAT "%8.2" NUMBER 510 /end CHARACTERISTIC
/begin CHARACTERISTIC MFST1FDG "Filterkoeffizient f¸r Prim‰rf¸llstandssignal TP-Filterung f¸r Diagnose" VALUE 0x1CE206 KwUb 0.9961 rel_ub_b1p0 0.00 0.9961 /end CHARACTERISTIC
/begin CHARACTERISTIC MFST1FDP "Filter-Koeffizient f¸r Prim‰rf¸llstandssignal TP-Filterung f¸r Anzeige" VALUE 0x1CE207 KwUb 0.9961 rel_ub_b1p0 0.00 0.9961 /end CHARACTERISTIC
/begin CHARACTERISTIC MFST2FDG "Filterkoeffizient f¸r Sekund‰rf¸llstandssignal TP-Filterung f¸r Diagnose" VALUE 0x1CE208 KwUb 0.9961 rel_ub_b1p0 0.00 0.9961 /end CHARACTERISTIC
/begin CHARACTERISTIC MFST2FDP "Filterkoeffizient f¸r Sekund‰rf¸llstandssignal TP-Filterung f¸r Anzeige" VALUE 0x1CE209 KwUb 0.9961 rel_ub_b1p0 0.00 0.9961 /end CHARACTERISTIC
/begin CHARACTERISTIC MFSTEDG "Filter-Koeff. f¸r Zweitank-Kraftstoffvol. TP-Filterung f¸r Verdampfungsdiagnose" VALUE 0x1CE20A KwUb 0.9961 rel_ub_b1p0 0.00 0.9961 /end CHARACTERISTIC
/begin CHARACTERISTIC MFSTFFDP "Filter-Koeffizient f¸r Zweitank-Kraftstoffvolumen Schnellfilterung f¸r Anzeige" VALUE 0x1CE20B KwUb 0.9961 rel_ub_b1p0 0.00 0.9961 /end CHARACTERISTIC
/begin CHARACTERISTIC MFSTNFDP "Filter-Koeffizient f¸r Zweitank-Kraftstoffvolumen Normal-Filterung f¸r Anzeige" VALUE 0x1CE20C KwUb 0.9961 rel_ub_b1p0 0.00 0.9961 /end CHARACTERISTIC
/begin CHARACTERISTIC MFSTSHF "Filter-Koeffizient f¸r Zweitank-Kraftstoffvolumen TP-Filterung f¸r Ablagerungen" VALUE 0x1CE20D KwUb 0.9961 rel_ub_b1p0 0.00 0.9961 /end CHARACTERISTIC
/begin CHARACTERISTIC MLMIN "minimale HFM-Luftmasse" VALUE 0x1C328E KwSw 6553.500 m_sw_b3276p8 -3276.800 3276.700 FORMAT "%8.3" /end CHARACTERISTIC
/begin CHARACTERISTIC MSHFMTP "Massenstrom aus HFM in abh‰ngigkeit von Periodendauer" CURVE 0x1C3290 FklWSw 6553.500 m_sw_b3276p8 -3276.800 3276.700 FORMAT "%8.3"
 /begin AXIS_DESCR FIX_AXIS tpkmhfm_w t_q0p1_us 128 0.00 819.1000 FORMAT "%8.4" FIX_AXIS_PAR 0 6 128 /end AXIS_DESCR
/end CHARACTERISTIC
/begin CHARACTERISTIC NDKPPU "Minimaldrehzahl f¸r Plausibilisierung DK-Poti 2 nach unten im Normalbetrieb" VALUE 0x1C3A0F KwUb 10000. nmot_ub_q40 200.0 10200. FORMAT "%5.0" /end CHARACTERISTIC
/begin CHARACTERISTIC NDTHMMX "Max. Motordrehzahl f¸r Freigabe Thermostat-Diagnose (‹berdr¸cken)" VALUE 0x1CEB33 KwUb 10200. nmot_ub_q40 0.00 10200. FORMAT "%5.0" /end CHARACTERISTIC
/begin CHARACTERISTIC NKRFM1 "Drehzahlschwelle f¸r Filtermittenfrequenz Bereich1" VALUE 0x1C65A2 KwWU8 10200. nmot_ub_q40 0.00 10200. FORMAT "%5.0" /end CHARACTERISTIC
/begin CHARACTERISTIC NKRFM2 "Drehzahlschwelle f¸r Filtermittenfrequenz Bereich 2" VALUE 0x1C65A3 KwWU8 10200. nmot_ub_q40 0.00 10200. FORMAT "%5.0" /end CHARACTERISTIC
/begin CHARACTERISTIC NKRFM3 "Drehzahlschwelle f¸r Filtermittenfrequenz Bereich 3" VALUE 0x1C65A4 KwWU8 10200. nmot_ub_q40 0.00 10200. FORMAT "%5.0" /end CHARACTERISTIC
/begin CHARACTERISTIC NMIN "Minimal Drehzahl" VALUE 0x1C6644 KwWU8 235.0 nmot_q1 20.00 255.0 FORMAT "%5.1" /end CHARACTERISTIC
/begin CHARACTERISTIC NMOTQSYN "Motordrehzahlschwelle zur Freigabe des Schnellstarts ¸ber PG Schnellstart" VALUE 0x1C663E KwWU16 600.0000 nmot_q1 0.00 600.0000 FORMAT "%8.4" /end CHARACTERISTIC
/begin CHARACTERISTIC NMXPHPOS "Drehzahlschwelle f¸r des ‹berpr¸fung Geberradeinbaus" VALUE 0x1C6633 KwWU8 10200. nmot_ub_q40 0.00 10200. FORMAT "%5.0" /end CHARACTERISTIC
/begin CHARACTERISTIC NNPTMMX "Max. Motordrehzahl f¸r Freigabe Unplausibilit‰tspr¸fung tmot-Signa (‹berdr¸cken)" VALUE 0x1CEB34 KwUb 10200. nmot_ub_q40 0.00 10200. FORMAT "%5.0" /end CHARACTERISTIC
/begin CHARACTERISTIC NWDK3 "Minimaldrehzahl f¸r Berechnung DK-Winkel-Ersatzwert aus F¸llungssignal" VALUE 0x1C3A10 KwUb 10000. nmot_ub_q40 200.0 10200. FORMAT "%5.0" /end CHARACTERISTIC
/begin CHARACTERISTIC NWOFFSET "Offset der ersten positiven Flanke des NW-Signals zu SW-BM Zyl. 1" VAL_BLK 0x1C6614 KwbWU8 255.0 dez 0.00 255.0 FORMAT "%5.1" NUMBER 4 /end CHARACTERISTIC
/begin CHARACTERISTIC NWSIGNAL "Ablageschema der Nockenwelle" VAL_BLK 0x1C6618 KwbWU8 255.0 dez 0.00 255.0 FORMAT "%5.1" NUMBER 9 /end CHARACTERISTIC
/begin CHARACTERISTIC NWSIGTOL "Toleranz der Nockenwellenflanken auf KW Zahnbasis" VALUE 0x1C6634 KwWU8 255.0 dez 0.00 255.0 FORMAT "%5.1" /end CHARACTERISTIC
/begin CHARACTERISTIC O2VK "Umrechnung  Spannung / O2, LSU-Sonde vor Katalysator" CURVE 0x1C4D60 KlAxU8SstxS16WS16 63.99902 relO2_q9p765Em4 -32.00000 31.99902 FORMAT "%8.5"
 /begin AXIS_DESCR STD_AXIS ipktk_w i_q1_uA 16 -32768.00 32767.00 FORMAT "%8.2" DEPOSIT ABSOLUTE /end AXIS_DESCR
/end CHARACTERISTIC
/begin CHARACTERISTIC OFQSYNADAP "Offset zwischen adaptierter Phasenflanke und Phasenflanke im Start" VALUE 0x1C6645 KwWS8 255.0 kw_q1 -128.0 127.0 FORMAT "%5.1" /end CHARACTERISTIC
/begin CHARACTERISTIC PHLSNHMN "Heizleistung f¸r ausreichende Sondenheizung" VALUE 0x1CCAC6 KwUb 2.550 fak_ub_q0p01 0.00 2.550 FORMAT "%5.3" /end CHARACTERISTIC
/begin CHARACTERISTIC PRHLSUL "Kleine relative Heizleistung bis zum Erreichen der Bedingung Taupunktende" VALUE 0x1CCB96 KwWU16 199.9969 rel_uw_b200 0.00 199.9969 FORMAT "%8.4" /end CHARACTERISTIC
/begin CHARACTERISTIC PUKANS "Pulsationskorrektur abh‰ngig von Ansauglufttemperatur" CURVE 0x1CA4E0 KlAUbSstUbWUb 1.992 fak_ub_b2 0.00 1.992 FORMAT "%5.3"
 /begin AXIS_DESCR STD_AXIS tans temp_ub_q0p75_o48 8 -48.00 143.3 FORMAT "%5.1" DEPOSIT ABSOLUTE /end AXIS_DESCR
/end CHARACTERISTIC
/begin CHARACTERISTIC RBEL "Belastungswiderstand f¸r Pumpstrom-Erzeugung" VALUE 0x1C4D4C KwUw 131070.0 r_uw_q2 0.00 131070.0 FORMAT "%8.1" /end CHARACTERISTIC
/begin CHARACTERISTIC RINCAL "Kalibrierwiderstand f¸r Innenwiderstand Nernstzelle" VALUE 0x1C4E56 KwWU16 2559.961 r_q0p0391 0.00 2559.961 FORMAT "%8.3" /end CHARACTERISTIC
/begin CHARACTERISTIC RINHMX "Innenwiderstand Ri der Nernstsonde hinter KAT auf Maximalwert begrenzen" VALUE 0x1C4D4E KwUw 131070.0 r_uw_q2 0.00 131070.0 FORMAT "%8.1" /end CHARACTERISTIC
/begin CHARACTERISTIC RININI "Initialisierungswert von rinlsu_w ( Widerstandswert der Nernstzelle LSU)" VALUE 0x1C4E58 KwWU16 2559.961 r_q0p0391 0.00 2559.961 FORMAT "%8.3" /end CHARACTERISTIC
/begin CHARACTERISTIC RINLSUS "Sollwert f¸r Heizungsregelung" VALUE 0x1CCB98 KwWU16 2559.961 r_q0p0391 0.00 2559.961 FORMAT "%8.3" /end CHARACTERISTIC
/begin CHARACTERISTIC RKSP "Widerstand zwischen kongurierende Spannung und Sondensignal" VALUE 0x1C4D50 KwUw 131070.0 r_uw_q2 0.00 131070.0 FORMAT "%8.1" /end CHARACTERISTIC
/begin CHARACTERISTIC SENZZYL "Klopfsensoren f¸r SW-Zylinderz‰hler 0-7" VAL_BLK 0x1C6598 KwbWU8 3.000 dezsub1 1.000 4.000 FORMAT "%5.3" NUMBER 8 /end CHARACTERISTIC
/begin AXIS_PTS SNM16KRUB "St¸tzstellenverteilung Drehzahl, 16 Sst." 0x1CEE10 nmot SstAUbSstUb 10200. nmot_ub_q40 16 0.00 10200. FORMAT "%5.0" DEPOSIT ABSOLUTE /end AXIS_PTS
/begin AXIS_PTS SRL04KRUB "St¸tzstellenverteilung relative F¸llung, 4 Sst." 0x1CEE24 rl SstAUbSstUb 191.3 rel_ub_q0p75 4 0.00 191.3 FORMAT "%5.1" DEPOSIT ABSOLUTE /end AXIS_PTS
/begin CHARACTERISTIC STNSG1 "St¸tzstellenverteilung nmot-1 SG-Temperaturhistogramm" VALUE 0x1CED0C KwUb 10200. nmot_ub_q40 0.00 10200. FORMAT "%5.0" /end CHARACTERISTIC
/begin CHARACTERISTIC STNSG2 "St¸tzstellenverteilung nmot-2 SG-Temperaturhistogramm" VALUE 0x1CED0D KwUb 10200. nmot_ub_q40 0.00 10200. FORMAT "%5.0" /end CHARACTERISTIC
/begin CHARACTERISTIC STNSG3 "St¸tzstellenverteilung nmot-3 SG-Temperaturhistogramm" VALUE 0x1CED0E KwUb 10200. nmot_ub_q40 0.00 10200. FORMAT "%5.0" /end CHARACTERISTIC
/begin CHARACTERISTIC STNSG4 "St¸tzstellenverteilung nmot-4 SG-Temperaturhistogramm" VALUE 0x1CED0F KwUb 10200. nmot_ub_q40 0.00 10200. FORMAT "%5.0" /end CHARACTERISTIC
/begin CHARACTERISTIC STNSG5 "St¸tzstellenverteilung nmot-5 SG-Temperaturhistogramm" VALUE 0x1CED10 KwUb 10200. nmot_ub_q40 0.00 10200. FORMAT "%5.0" /end CHARACTERISTIC
/begin AXIS_PTS STS08COUB "SST-Verteilung f¸r Motorstarttemperatur tmst" 0x1CEED8 tmst SstAUbSstUb 191.3 temp_ub_q0p75_o48 8 -48.00 143.3 FORMAT "%5.1" DEPOSIT ABSOLUTE /end AXIS_PTS
/begin CHARACTERISTIC STTSG1 "St¸tzstellenverteilung 1 tsg  SG-Temperaturhistogramm" VALUE 0x1CED11 KwUb 191.3 temp_ub_q0p75_o48 -48.00 143.3 FORMAT "%5.1" /end CHARACTERISTIC
/begin CHARACTERISTIC STTSG2 "St¸tzstellenverteilung 2 tsg  SG-Temperaturhistogramm" VALUE 0x1CED12 KwUb 191.3 temp_ub_q0p75_o48 -48.00 143.3 FORMAT "%5.1" /end CHARACTERISTIC
/begin CHARACTERISTIC STTSG3 "St¸tzstellenverteilung 3 tsg  SG-Temperaturhistogramm" VALUE 0x1CED13 KwUb 191.3 temp_ub_q0p75_o48 -48.00 143.3 FORMAT "%5.1" /end CHARACTERISTIC
/begin CHARACTERISTIC STTSG4 "St¸tzstellenverteilung 4 tsg  SG-Temperaturhistogramm" VALUE 0x1CED14 KwUb 191.3 temp_ub_q0p75_o48 -48.00 143.3 FORMAT "%5.1" /end CHARACTERISTIC
/begin CHARACTERISTIC STTSG5 "St¸tzstellenverteilung 5 tsg  SG-Temperaturhistogramm" VALUE 0x1CED15 KwUb 191.3 temp_ub_q0p75_o48 -48.00 143.3 FORMAT "%5.1" /end CHARACTERISTIC
/begin CHARACTERISTIC TABGL "Zeit f¸r LSU-Abgleich" VALUE 0x1C4DA6 KwWU16 655.3500 t10msxs_uw_b655p35 0.00 655.3500 FORMAT "%8.4" /end CHARACTERISTIC
/begin CHARACTERISTIC TABGS "Zeit nach Start f¸r LSU-Abgleich" VALUE 0x1C4DA8 KwWU16 655.3500 t10msxs_uw_b655p35 0.00 655.3500 FORMAT "%8.4" /end CHARACTERISTIC
/begin CHARACTERISTIC TABSMADTM "Abstellzeit bis Abk¸hlung Motor f¸r Diagnose TMOT" VALUE 0x1CEBF0 KwUw 65535.00 t1sxs_uw_q1 0.00 65535.00 FORMAT "%8.2" /end CHARACTERISTIC
/begin CHARACTERISTIC TABSTHLSU "Mindestabstellzeit f¸r Wiederholstart Heizung LSU" VALUE 0x1CCB9A KwWU16 65535.00 t1sxs_uw_b65535 0.00 65535.00 FORMAT "%8.2" /end CHARACTERISTIC
/begin CHARACTERISTIC TADE "Ersatzgrˆﬂe Lufttemperatur im Fehlerfall" VALUE 0x1CEAAA KwUb 191.3 temp_ub_q0p75_o48 -48.00 143.3 FORMAT "%5.1" /end CHARACTERISTIC
/begin CHARACTERISTIC TADMM "1. Stufenbreite (Zeit) f¸r Motortemperaturmodell" VALUE 0x1CEBF2 KwUw 6553.500 t100msxs_uw_b6553p5 0.00 6553.500 FORMAT "%8.3" /end CHARACTERISTIC
/begin CHARACTERISTIC TADMN "Ansauglufttemperatur min." VALUE 0x1CEAAB KwUb 191.3 temp_ub_q0p75_o48 -48.00 143.3 FORMAT "%5.1" /end CHARACTERISTIC
/begin CHARACTERISTIC TADMX "Ansauglufttemperatur max." VALUE 0x1CEAAC KwUb 191.3 temp_ub_q0p75_o48 -48.00 143.3 FORMAT "%5.1" /end CHARACTERISTIC
/begin CHARACTERISTIC TANHKMMN "Kat-Temperatur f¸r ausreichende Sondenheizung" VALUE 0x1CCACE KwUw 1535.977 temp_q0p0234_o273 -273.1500 1262.827 FORMAT "%8.3" /end CHARACTERISTIC
/begin CHARACTERISTIC TANSHFMTP "Tans aus HFM6 in Abh‰ngigkeit von PWM-Signal" CURVE 0x1CEAB0 KlAUwSstUwWUw 249.9962 temp_q0p0038_o75 -75.00000 174.9962 FORMAT "%8.4"
 /begin AXIS_DESCR STD_AXIS tvtahfm_w fak_q1p526Em5 20 0.00 0.9999847 FORMAT "%9.7" DEPOSIT ABSOLUTE /end AXIS_DESCR
/end CHARACTERISTIC
/begin CHARACTERISTIC TANWERA "Tastverh‰ltnis zur Entriegelung der Auslassnockenwelle" VALUE 0x1C3B48 KwUw 100.0000 tv_uw_b100 0.00 100.0000 FORMAT "%8.4" /end CHARACTERISTIC
/begin CHARACTERISTIC TANWERE "Tastverh‰ltnis zur Entriegelung der Einlassnockenwelle" VALUE 0x1C3B4A KwUw 100.0000 tv_uw_b100 0.00 100.0000 FORMAT "%8.4" /end CHARACTERISTIC
/begin CHARACTERISTIC TDKPAW "Zeit f¸r DK-Poti-Auswahl" VALUE 0x1C3A11 KwUb 2.540 t10msxs_ub_b2p55 0.01000 2.550 FORMAT "%5.3" /end CHARACTERISTIC
/begin CHARACTERISTIC TDNDTHMF "Zeitverzˆgerung Freigabe Thermostatdiagnose nach Drehzahlunterschreitung" VALUE 0x1CEB35 KwUb 25.50 t100msxs_ub_b25p5 0.00 25.50 FORMAT "%5.2" /end CHARACTERISTIC
/begin CHARACTERISTIC TDNDTHMS "Zeitverzˆgerung Sperrung Thermostatdiagnose nach Drehzahl¸berschreitung" VALUE 0x1CEB36 KwUb 25.50 t100msxs_ub_b25p5 0.00 25.50 FORMAT "%5.2" /end CHARACTERISTIC
/begin CHARACTERISTIC TDNNPTMF "Zeitverzˆgerung Freigabe tmot-Unplausibilit‰t nach Drehzahlunterschreitung" VALUE 0x1CEB37 KwUb 25.50 t100msxs_ub_b25p5 0.00 25.50 FORMAT "%5.2" /end CHARACTERISTIC
/begin CHARACTERISTIC TDNNPTMS "Zeitverzˆgerung Sperrung tmot-Unplausibilit‰tspr¸fg. nach Drehzahl¸berschreitung" VALUE 0x1CEB38 KwUb 25.50 t100msxs_ub_b25p5 0.00 25.50 FORMAT "%5.2" /end CHARACTERISTIC
/begin CHARACTERISTIC TDNSTA "Auspufferw‰rmzeit ab Start, f¸r TANS - Diagnose" VALUE 0x1CEAAD KwUb 255.0 t1sxs_ub_b255 0.00 255.0 FORMAT "%5.1" /end CHARACTERISTIC
/begin CHARACTERISTIC TDNSUB "Batterie - Erholzeit ab Start, f¸r UBATT - Diagnose" VALUE 0x1C65DC KwUb 255.0 t100msxs_ub_b255 0.00 255.0 FORMAT "%5.1" /end CHARACTERISTIC
/begin CHARACTERISTIC TDTA "Entprellzeit Fehlererkennung TANS" VALUE 0x1CEAAE KwUb 25.50 t100msxs_ub_b25p5 0.00 25.50 FORMAT "%5.2" /end CHARACTERISTIC
/begin CHARACTERISTIC TDTAL "TANS Fehlererkennung / Zeitsperre ab B_LL = 1" VALUE 0x1CEAAF KwUb 255.0 t1sxs_ub_b255 0.00 255.0 FORMAT "%5.1" /end CHARACTERISTIC
/begin CHARACTERISTIC TDTKAUS "Entprellzeit Fehlererkennung Temperatur K¸hlerausgang" VALUE 0x1CECAC KwUb 25.50 t100msxs_ub_b25p5 0.00 25.50 FORMAT "%5.2" /end CHARACTERISTIC
/begin CHARACTERISTIC TDTM "Entprellzeit Fehlererkennung TMOT" VALUE 0x1CEBF4 KwUw 6553.500 t100msxs_uw_b6553p5 0.00 6553.500 FORMAT "%8.3" /end CHARACTERISTIC
/begin CHARACTERISTIC TDTMMA "Verzˆgerungszeit Anfangswert Motortemperaturmodell" VALUE 0x1C664E KwUw 6553.500 t100msxs_uw_b6553p5 0.00 6553.500 FORMAT "%8.3" /end CHARACTERISTIC
/begin CHARACTERISTIC TDTMNPO "Entprellzeit Fehlererkennung Unplausibilit‰t oben TMOT" VALUE 0x1CEB39 KwUb 25.50 t100msxs_ub_b25p5 0.00 25.50 FORMAT "%5.2" /end CHARACTERISTIC
/begin CHARACTERISTIC TDTMPOG "Entprellzeit Pr¸fung obere Unplausibilit‰t g¸ltig TMOT" VALUE 0x1CEB3A KwUb 25.50 t100msxs_ub_b25p5 0.00 25.50 FORMAT "%5.2" /end CHARACTERISTIC
/begin CHARACTERISTIC TDTOL "Entprellzeit Fehlererkennung TOL (Motor-)Oeltemperatur" VALUE 0x1CECDC KwUb 25.50 t100msxs_ub_b25p5 0.00 25.50 FORMAT "%5.2" /end CHARACTERISTIC
/begin CHARACTERISTIC TDUB "Wartezeit f¸r UBATT-Diagnose" VALUE 0x1C65DD KwUb 25.50 t100msxs_ub_b25p5 0.00 25.50 FORMAT "%5.2" /end CHARACTERISTIC
/begin CHARACTERISTIC TFWDKPN "Zeitkonstante f¸r Filterung der DK-Winkel vor Vergl. mit Ersatzwert aus F¸llung" CURVE 0x1C3A14 KlAUbSstUbWUb 2.54000 zk10msxs_ub_b2p55 0.0100000 2.55000 FORMAT "%7.5"
 /begin AXIS_DESCR STD_AXIS nmot nmot_ub_q40 6 0.00 10200. FORMAT "%5.0" DEPOSIT ABSOLUTE /end AXIS_DESCR
/end CHARACTERISTIC
/begin CHARACTERISTIC TGGLS "Zeitdauer f¸r ADC nach Interrupt im Funktionsrechner (Asic)" VALUE 0x1C4D46 KwUb 2.000 t1msxms_q1 3.000 5.000 FORMAT "%5.3" /end CHARACTERISTIC
/begin CHARACTERISTIC THHA "Auszeit f¸r Reduzierung der Heizleistung Sonde hinter Kat bei 13V" VALUE 0x1CCAC7 KwUb 2.550 t10msxs_q0p01_o0p05 -0.05000 2.500 FORMAT "%5.3" /end CHARACTERISTIC
/begin CHARACTERISTIC THHA2 "Auszeit f¸r Reduzierung der Heizleistung Sonde2 hinter Kat bei 13V" VALUE 0x1CCAC8 KwUb 2.550 t10msxs_q0p01_o0p05 -0.05000 2.500 FORMAT "%5.3" /end CHARACTERISTIC
/begin CHARACTERISTIC THHAWU "Ausschaltzeit w‰hrend Leistungsreduzierung Sondenheizung hinter Kat" VALUE 0x1CCAC9 KwUb 2.550 t10msxs_ub_b2p55 0.00 2.550 FORMAT "%5.3" /end CHARACTERISTIC
/begin CHARACTERISTIC THLSUHR "Verzˆgerungszeit zum Setzen der Bedingung B_henrin nach Einschalten der Heizung" VALUE 0x1CCBA0 KwWU8 25.50 t100msxs_ub_b25p5 0.00 25.50 FORMAT "%5.2" /end CHARACTERISTIC
/begin CHARACTERISTIC THSHA "Verzˆgerungszeit f¸r Sonde ausreichend beheizt" VALUE 0x1CCACA KwUb 25.50 t100msxs_ub_b25p5 0.00 25.50 FORMAT "%5.2" /end CHARACTERISTIC
/begin CHARACTERISTIC THSHKTK "Kennlinie f¸r die Ausschaltdauer der Sondenheizung abh. v.d. Abgastemp. h.Kat" CURVE 0x1CCAD0 KlAUwSstUwWUw 655.3500 t10msxs_q0p01_o0p05 -0.05000000 655.3000 FORMAT "%8.4"
 /begin AXIS_DESCR STD_AXIS tanhkm_w temp_q0p0234_o273 8 -273.1500 1262.827 FORMAT "%8.3" DEPOSIT ABSOLUTE /end AXIS_DESCR
/end CHARACTERISTIC
/begin CHARACTERISTIC THSHKTK2 "Kennlinie f¸r die Ausschaltdauer der Sondenheizung2 abh. v.d. Abgastemp. h.Kat" CURVE 0x1CCAF2 KlAUwSstUwWUw 655.3500 t10msxs_q0p01_o0p05 -0.05000000 655.3000 FORMAT "%8.4"
 /begin AXIS_DESCR STD_AXIS tanhkm2_w temp_q0p0234_o273 8 -273.1500 1262.827 FORMAT "%8.3" DEPOSIT ABSOLUTE /end AXIS_DESCR
/end CHARACTERISTIC
/begin CHARACTERISTIC THSRIH "Zeitverzˆg. Bereitschaft der Ri-Messung nach eingesch. Sondenheizung hinter KAT" VALUE 0x1C4D52 KwUw 655.3500 t10msxs_uw_b655p35 0.00 655.3500 FORMAT "%8.4" /end CHARACTERISTIC
/begin CHARACTERISTIC TKAELI "Temperatur K¸hlerausgang Erfassung und Linearisierung" CURVE 0x1CECB0 KlAUbSstUbWUb 191.3 temp_ub_q0p75_o48 -48.00 143.3 FORMAT "%5.1"
 /begin AXIS_DESCR STD_AXIS wtka spg_uw_q0p00488 20 0.00 1.245 FORMAT "%5.3" DEPOSIT ABSOLUTE /end AXIS_DESCR
/end CHARACTERISTIC
/begin CHARACTERISTIC TKAUSDE "Ersatzgrˆﬂe Temperatur K¸hlerausgang im Fehlerfall" VALUE 0x1CECD9 KwUb 191.3 temp_ub_q0p75_o48 -48.00 143.3 FORMAT "%5.1" /end CHARACTERISTIC
/begin CHARACTERISTIC TKAUSDMN "Min. Temperatur K¸hlerausgang" VALUE 0x1CECDA KwUb 191.3 temp_ub_q0p75_o48 -48.00 143.3 FORMAT "%5.1" /end CHARACTERISTIC
/begin CHARACTERISTIC TKAUSDMX "Max. Temperatur K¸hlerausgang" VALUE 0x1CECDB KwUb 191.3 temp_ub_q0p75_o48 -48.00 143.3 FORMAT "%5.1" /end CHARACTERISTIC
/begin CHARACTERISTIC TKERENSCUN "Einschaltschwelle f¸r Diagnose an UN des Auswerte-ICs (auf Temperaturbasis)" VALUE 0x1C4E5A KwWU16 1535.977 temp_q0p0234_o273 -273.1500 1262.827 FORMAT "%8.3" /end CHARACTERISTIC
/begin CHARACTERISTIC TKERLSPSF "Einschaltschwelle f¸r Pumpstromregler des Auswerte-ICs (auf Temperaturbasis)" VALUE 0x1C4E5C KwWU16 1535.977 temp_q0p0234_o273 -273.1500 1262.827 FORMAT "%8.3" /end CHARACTERISTIC
/begin CHARACTERISTIC TKERLSUS "Keramiksolltemperatur f¸r LSU" VALUE 0x1CCB9C KwWU16 1535.977 temp_q0p0234_o273 -273.1500 1262.827 FORMAT "%8.3" /end CHARACTERISTIC
/begin CHARACTERISTIC TKERLSUST "Keramiktemperaturgrenzwert zum Abbruch der Startsteuerung" VALUE 0x1CCB9E KwWU16 1535.977 temp_q0p0234_o273 -273.1500 1262.827 FORMAT "%8.3" /end CHARACTERISTIC
/begin CHARACTERISTIC TLSUVH "Zeit f¸r LSU vorheizen" VALUE 0x1CCBA1 KwWU8 25.50 t100msxs_ub_b25p5 0.00 25.50 FORMAT "%5.2" /end CHARACTERISTIC
/begin CHARACTERISTIC TMABDTMN "Minimalschwelle der Motorabstelltemperatur f¸r Diagnose TMOT" VALUE 0x1CEB3B KwUb 103.5 temp_ub_q0p75_o48 39.75 143.3 FORMAT "%5.1" /end CHARACTERISTIC
/begin CHARACTERISTIC TMDMMA "Anfangstemperatur f¸r Motortemperaturmodell" VALUE 0x1CEB3C KwUb 191.3 temp_ub_q0p75_o48 -48.00 143.3 FORMAT "%5.1" /end CHARACTERISTIC
/begin CHARACTERISTIC TMDMMAT "Ersatztemperatur abh. Abstellzeit w‰hrend TDTMMA" CURVE 0x1CEBF6 KlAUwSstUwWUw 191.2500 temp_ub_q0p75_o48 -48.00000 143.2500 FORMAT "%8.4"
 /begin AXIS_DESCR STD_AXIS tabst_w t1sxs_uw_q1 3 0.00 65535.00 FORMAT "%8.2" DEPOSIT ABSOLUTE /end AXIS_DESCR
/end CHARACTERISTIC
/begin CHARACTERISTIC TMDMMAU "Unterster Anfangswert aus tans f¸r Motortemperaturmodell" VALUE 0x1CEB3D KwUb 191.3 temp_ub_q0p75_o48 -48.00 143.3 FORMAT "%5.1" /end CHARACTERISTIC
/begin CHARACTERISTIC TMDMMEE "Endtemperatur f¸r Ersatzwert Motortemperatur" VALUE 0x1CEB3E KwUb 191.3 temp_ub_q0p75_o48 -48.00 143.3 FORMAT "%5.1" /end CHARACTERISTIC
/begin CHARACTERISTIC TMDMMER "Endtemperatur f¸r Referenzwert Motortemperatur" VALUE 0x1CEB3F KwUb 191.3 temp_ub_q0p75_o48 -48.00 143.3 FORMAT "%5.1" /end CHARACTERISTIC
/begin CHARACTERISTIC TMDMN "Motortemperatur min." VALUE 0x1CEB40 KwUb 191.3 temp_ub_q0p75_o48 -48.00 143.3 FORMAT "%5.1" /end CHARACTERISTIC
/begin CHARACTERISTIC TMDMX "Motortemperatur max." VALUE 0x1CEB41 KwUb 191.3 temp_ub_q0p75_o48 -48.00 143.3 FORMAT "%5.1" /end CHARACTERISTIC
/begin CHARACTERISTIC TMELIPU1 "Motor-Temperatur: Erfassung u. Linearisierung, Inverskennlinie 1, pullup aktiv" CURVE 0x1CEC04 KlAUwSstUwWUw 191.9971 temp_uw_q0p0029_o48 -48.00000 143.9971 FORMAT "%8.4"
 /begin AXIS_DESCR STD_AXIS wtmot_w spg_uw_q0p00488 20 0.00 319.9951 FORMAT "%8.4" DEPOSIT ABSOLUTE /end AXIS_DESCR
/end CHARACTERISTIC
/begin CHARACTERISTIC TMLRTMS "Motortemperaturschwelle f¸r LR ein abh. von Starttemperatur" CURVE 0x1CEB44 KlAUbSstUbWUb 191.3 temp_ub_q0p75_o48 -48.00 143.3 FORMAT "%5.1"
 /begin AXIS_DESCR STD_AXIS tmst temp_ub_q0p75_o48 4 -48.00 143.3 FORMAT "%5.1" DEPOSIT ABSOLUTE /end AXIS_DESCR
/end CHARACTERISTIC
/begin CHARACTERISTIC TMMXRT "max. Motortemperatur f. Retrigg. Modelle (Blockheater-Erkennung)" VALUE 0x1CEB4D KwUb 191.3 temp_ub_q0p75_o48 -48.00 143.3 FORMAT "%5.1" /end CHARACTERISTIC
/begin CHARACTERISTIC TMOTELI "Temperatur Motor Erfassung u. Linearisierung, Inverskennlinie" CURVE 0x1CEC56 KlAUwSstUwWUw 191.9971 temp_uw_q0p0029_o48 -48.00000 143.9971 FORMAT "%8.4"
 /begin AXIS_DESCR STD_AXIS wtmot_w spg_uw_q0p00488 20 0.00 319.9951 FORMAT "%8.4" DEPOSIT ABSOLUTE /end AXIS_DESCR
/end CHARACTERISTIC
/begin CHARACTERISTIC TMPUPOFF "untere Motortemperaturschwelle f¸r pullup-Abschaltung" VALUE 0x1CEB4E KwUb 191.3 temp_ub_q0p75_o48 -48.00 143.3 FORMAT "%5.1" /end CHARACTERISTIC
/begin CHARACTERISTIC TMPUPON "obere Motortemperaturschwelle f¸r pullup-Zuschaltung" VALUE 0x1CEB4F KwUb 191.3 temp_ub_q0p75_o48 -48.00 143.3 FORMAT "%5.1" /end CHARACTERISTIC
/begin CHARACTERISTIC TMSDTHMO "obere Motorstart-Temp.-Schwelle f¸r Thermostatdiagnose" VALUE 0x1CEB50 KwUb 191.3 temp_ub_q0p75_o48 -48.00 143.3 FORMAT "%5.1" /end CHARACTERISTIC
/begin CHARACTERISTIC TNLETM "Nachlaufzeitverlaengerung fuer E_tm" VALUE 0x1CECA8 KwUw 65535.00 t1sxs_uw_q1 0.00 65535.00 FORMAT "%8.2" /end CHARACTERISTIC
/begin CHARACTERISTIC TNSRT "Max.-Zeit ab Start f¸r Retriggerung Berechnung Motortemperaturmodell" VALUE 0x1CEB51 KwUb 255.0 t1sxs_ub_b255 0.00 255.0 FORMAT "%5.1" /end CHARACTERISTIC
/begin CHARACTERISTIC TOLDE "Ersatzgrˆﬂe ÷ltemperatur im Fehlerfall" VALUE 0x1CECDD KwUb 191.3 temp_ub_q0p75_o48 -48.00 143.3 FORMAT "%5.1" /end CHARACTERISTIC
/begin CHARACTERISTIC TOLDMN "÷ltemperatur min." VALUE 0x1CECDE KwUb 191.3 temp_ub_q0p75_o48 -48.00 143.3 FORMAT "%5.1" /end CHARACTERISTIC
/begin CHARACTERISTIC TOLDMX "÷ltemperatur max." VALUE 0x1CECDF KwUb 191.3 temp_ub_q0p75_o48 -48.00 143.3 FORMAT "%5.1" /end CHARACTERISTIC
/begin CHARACTERISTIC TOLELI "(Motor-)Oeltemperatur Erfassung u. Linearisierung, Inverskennlinie" CURVE 0x1CECE0 KlAUbSstUbWUb 191.3 temp_ub_q0p75_o48 -48.00 143.3 FORMAT "%5.1"
 /begin AXIS_DESCR STD_AXIS wtol spg_ub_b5 20 0.00 4.980 FORMAT "%5.3" DEPOSIT ABSOLUTE /end AXIS_DESCR
/end CHARACTERISTIC
/begin CHARACTERISTIC TPREL "Zahnentprellzeit in der Initialisierung" VALUE 0x1C6646 KwWU8 255.0 t1msxms_q1 0.00 255.0 FORMAT "%5.1" /end CHARACTERISTIC
/begin CHARACTERISTIC TPSOLL "Soll Periodendauer" VALUE 0x1C3390 KwUw 131.0700 t_q0p002_ms 0.00 131.0700 FORMAT "%8.4" /end CHARACTERISTIC
/begin CHARACTERISTIC TRIAKTH "Zeitdauer f¸r Ri-Berechnung aktuell hinter KAT" VALUE 0x1C4D54 KwUw 6553.500 t100msxs_uw_b6553p5 0.00 6553.500 FORMAT "%8.3" /end CHARACTERISTIC
/begin CHARACTERISTIC TRIIMPH "Zeitdauer f¸r Pumpimpuls f¸r beide B‰nke hinter KAT" VALUE 0x1C4D56 KwUw 655.3500 t10msxs_uw_b655p35 0.00 655.3500 FORMAT "%8.4" /end CHARACTERISTIC
/begin CHARACTERISTIC TSGELI "Temperatur Steuerger‰t- Erfassung und Linearisierung" CURVE 0x1CED18 KlAUbSstUbWUb 191.3 temp_ub_q0p75_o48 -48.00 143.3 FORMAT "%5.1"
 /begin AXIS_DESCR STD_AXIS wtsg spg_ub_b5 18 0.00 4.980 FORMAT "%5.3" DEPOSIT ABSOLUTE /end AXIS_DESCR
/end CHARACTERISTIC
/begin CHARACTERISTIC TSTSG "Zeitintervall f¸r Erfassung SG-Temperatur-Histogramm" VALUE 0x1CED3D KwUb 254.0 t1sxs_ub_b255 1.000 255.0 FORMAT "%5.1" /end CHARACTERISTIC
/begin CHARACTERISTIC TUMDETM "Umgebungslufttemperatur-Ersatzwert f¸r Motortemperatur-Modell" VALUE 0x1CEB52 KwUb 191.3 temp_ub_q0p75_o48 -48.00 143.3 FORMAT "%5.1" /end CHARACTERISTIC
/begin CHARACTERISTIC TUMTO "Totzeit f¸r Umschaltung CJ120" VALUE 0x1C4E5E KwWU16 655.3500 t10msxs_uw_b655p35 0.00 655.3500 FORMAT "%8.4" /end CHARACTERISTIC
/begin CHARACTERISTIC TUSBELH "Zeit f¸r Festhaltung der Sondenspannung nach Impulsbelastung  hinter KAT" VALUE 0x1C4D47 KwUb 2.550 t10msxs_ub_b2p55 0.00 2.550 FORMAT "%5.3" /end CHARACTERISTIC
/begin CHARACTERISTIC TVABGL "Verzˆgerungszeit f¸r LSU-Abgleich" VALUE 0x1C4DAA KwWU16 655.3500 t10msxs_uw_b655p35 0.00 655.3500 FORMAT "%8.4" /end CHARACTERISTIC
/begin CHARACTERISTIC TVERA "Zeitdauer f¸r Entriegelungstastverh‰ltnis Auslassnockenwelle" VALUE 0x1C3B46 KwUb 2.550 t10msxs_ub_b2p55 0.00 2.550 FORMAT "%5.3" /end CHARACTERISTIC
/begin CHARACTERISTIC TVERE "Zeitdauer f¸r Entriegelungstastverh‰ltnis Einlassnockenwelle" VALUE 0x1C3B47 KwUb 2.550 t10msxs_ub_b2p55 0.00 2.550 FORMAT "%5.3" /end CHARACTERISTIC
/begin CHARACTERISTIC TVHSH "Einschaltverzˆgerung der Sondenheizung hinter Kat" VALUE 0x1CCACB KwUb 25.50 t100msxs_ub_b25p5 0.00 25.50 FORMAT "%5.2" /end CHARACTERISTIC
/begin CHARACTERISTIC TVPDKP1 "Fehlertoleranzzeit bei Bereichspr¸fung DK-Poti 1" VALUE 0x1C3A21 KwUb 2.540 t10msxs_ub_b2p55 0.01000 2.550 FORMAT "%5.3" /end CHARACTERISTIC
/begin CHARACTERISTIC TVPDKP2 "Fehlertoleranzzeit bei Bereichspr¸fung DK-Poti 2" VALUE 0x1C3A22 KwUb 2.540 t10msxs_ub_b2p55 0.01000 2.550 FORMAT "%5.3" /end CHARACTERISTIC
/begin CHARACTERISTIC TVPLBKP "Fehlertoleranzzeit bei Bereichs¸berschreitung LBK-Poti" VALUE 0x1C345A KwUb 2.550 t10msxs_ub_b2p55 0.00 2.550 FORMAT "%5.3" /end CHARACTERISTIC
/begin CHARACTERISTIC TVPWDK12 "Fehlertoleranzzeit bei Gleichlaufpr¸fung der DK-Potis" VALUE 0x1C3A23 KwUb 2.540 t10msxs_ub_b2p55 0.01000 2.550 FORMAT "%5.3" /end CHARACTERISTIC
/begin CHARACTERISTIC TVPWDK13 "Fehlertoleranzzeit bei Gleichlaufpr¸fung DK-Poti 1 und Ersatzwert aus F¸llung" VALUE 0x1C3A24 KwUb 2.540 t10msxs_ub_b2p55 0.01000 2.550 FORMAT "%5.3" /end CHARACTERISTIC
/begin CHARACTERISTIC TVPWDK23 "Fehlertoleranzzeit bei Gleichlaufpr¸fung DK-Poti 2 und Ersatzwert aus F¸llung" VALUE 0x1C3A25 KwUb 2.540 t10msxs_ub_b2p55 0.01000 2.550 FORMAT "%5.3" /end CHARACTERISTIC
/begin CHARACTERISTIC TVSABGL "Verzˆgerungszeit f¸r LSU-Abgleich nach Start" VALUE 0x1C4E60 KwWU16 655.3500 t10msxs_uw_b655p35 0.00 655.3500 FORMAT "%8.4" /end CHARACTERISTIC
/begin CHARACTERISTIC TWLRTMS "Wartezeit f¸r Diagnose TMOT-Einschaltbedingung lambda-Regelung" CURVE 0x1CEB54 KlAUbSstUbWUb 5100.0000 t100msxs_ub_q20 0.00 5100.0000 FORMAT "%9.4"
 /begin AXIS_DESCR STD_AXIS tmst temp_ub_q0p75_o48 4 -48.00 143.3 FORMAT "%5.1" DEPOSIT ABSOLUTE /end AXIS_DESCR
/end CHARACTERISTIC
/begin CHARACTERISTIC TZGSP2MX "Maximalzeit Gang 2 d. GSP" VALUE 0x1CCABA KwUw 6553.500 t_q0p1 0.00 6553.500 FORMAT "%8.3" /end CHARACTERISTIC
/begin CHARACTERISTIC TZGSP2MX1 "Maximalzeit Gang 2 d. GSP (Variante)" VALUE 0x1CCABC KwUw 6553.500 t_q0p1 0.00 6553.500 FORMAT "%8.3" /end CHARACTERISTIC
/begin CHARACTERISTIC UBDE "Ubatt - Ersatzwert bei defektem AD - Kanal" VALUE 0x1C65DE KwUb 24.02 spg_ubatt 0.00 24.02 FORMAT "%5.2" /end CHARACTERISTIC
/begin CHARACTERISTIC UBDMN1 "Batteriespannung min. (Netz)" VALUE 0x1C65DF KwUb 24.02 spg_ubatt 0.00 24.02 FORMAT "%5.2" /end CHARACTERISTIC
/begin CHARACTERISTIC UBDMN2 "Batteriespannung min. (ADC)" VALUE 0x1C65E0 KwUb 24.02 spg_ubatt 0.00 24.02 FORMAT "%5.2" /end CHARACTERISTIC
/begin CHARACTERISTIC UBDMX "Batteriespannung max." VALUE 0x1C65E1 KwUb 24.02 spg_ubatt 0.00 24.02 FORMAT "%5.2" /end CHARACTERISTIC
/begin CHARACTERISTIC UBHS "Batteriespannungsschwelle f¸r Abschalten der Sondenheizung" VALUE 0x1CCACC KwUb 24.02 spg_ubatt 0.00 24.02 FORMAT "%5.2" /end CHARACTERISTIC
/begin CHARACTERISTIC UBMNPUP "Mindest-Bordspannung f¸r pullup-Ansteuerung" VALUE 0x1CEB5D KwUb 25.50 spg_q0p1 0.00 25.50 FORMAT "%5.2" /end CHARACTERISTIC
/begin CHARACTERISTIC UBVDKPO "Batteriespannungsschwelle f¸r Umschaltung auf verst‰rktes Signal von DK-Poti 1" VALUE 0x1C3A26 KwUb 24.02 spg_ubatt 0.00 24.02 FORMAT "%5.2" /end CHARACTERISTIC
/begin CHARACTERISTIC UBVDKPU "Batteriespannungsschwelle f¸r Umschaltung auf unverst‰rktes Signal von DK-Poti 1" VALUE 0x1C3A27 KwUb 24.02 spg_ubatt 0.00 24.02 FORMAT "%5.2" /end CHARACTERISTIC
/begin CHARACTERISTIC UDKP1O "Maximale zul‰ssige Spannung von DK-Poti 1" VALUE 0x1C3A28 KwUb 4.980 spg_ub_b5 0.00 4.980 FORMAT "%5.3" /end CHARACTERISTIC
/begin CHARACTERISTIC UDKP1U "Minimale zul‰ssige Spannung von DK-Poti 1" VALUE 0x1C3A29 KwUb 4.980 spg_ub_b5 0.00 4.980 FORMAT "%5.3" /end CHARACTERISTIC
/begin CHARACTERISTIC UDKP2O "Maximale zul‰ssige Spannung von DK-Poti 2" VALUE 0x1C3A2A KwUb 4.980 spg_ub_b5 0.00 4.980 FORMAT "%5.3" /end CHARACTERISTIC
/begin CHARACTERISTIC UDKP2U "Minimale zul‰ssige Spannung von DK-Poti 2" VALUE 0x1C3A2B KwUb 4.980 spg_ub_b5 0.00 4.980 FORMAT "%5.3" /end CHARACTERISTIC
/begin CHARACTERISTIC UHSN "Nennspannung f¸r die Sondenheizung" VALUE 0x1CCACD KwUb 24.02 spg_ubatt 0.00 24.02 FORMAT "%5.2" /end CHARACTERISTIC
/begin CHARACTERISTIC ULBKMN "min. Schwelle der LBK-Lager¸ckmeldung" VALUE 0x1C345C KwUw 319.9951 spg_uw_q0p00488 0.00 319.9951 FORMAT "%8.4" /end CHARACTERISTIC
/begin CHARACTERISTIC ULBKMX "max. Schwelle der LBK-Lager¸ckmeldung" VALUE 0x1C345E KwUw 319.9951 spg_uw_q0p00488 0.00 319.9951 FORMAT "%8.4" /end CHARACTERISTIC
/begin CHARACTERISTIC URINOFF "CJ120-Spannung bei LSU-Nernstwiderstand rinlsu_w = 0" VALUE 0x1C4E62 KwWU16 5.000000 spg_q0p00488 0.00 5.000000 FORMAT "%8.6" /end CHARACTERISTIC
/begin CHARACTERISTIC USABGL "LSU-Spannung bei Pumpstrom Null" VALUE 0x1C4DAC KwWU16 31.99951 spg_q4p88Em4 0.00 31.99951 FORMAT "%8.5" /end CHARACTERISTIC
/begin CHARACTERISTIC USRIMINH "Mindest Spannungs-Schwelle f¸r Ri-Messung der Sonde hinter KAT" VALUE 0x1C4D58 KwUw 319.9951 spg_uw_q0p00488_o1 -1.000000 318.9951 FORMAT "%8.4" /end CHARACTERISTIC
/begin CHARACTERISTIC USRIOH "Obere Spannungs-Schwelle f¸r Ri-Messung der Sonde hinter KAT" VALUE 0x1C4D5A KwUw 319.9951 spg_uw_q0p00488_o1 -1.000000 318.9951 FORMAT "%8.4" /end CHARACTERISTIC
/begin CHARACTERISTIC USRIUH "Untere Spannungs-Schwelle f¸r Ri-Messung der Sonde hinter KAT" VALUE 0x1C4D5C KwUw 319.9951 spg_uw_q0p00488_o1 -1.000000 318.9951 FORMAT "%8.4" /end CHARACTERISTIC
/begin CHARACTERISTIC VGSP "Geschwindigkeitsschwelle f¸r GSP" VALUE 0x1CCAB0 KwUb 318.8 vfzg_ub_q1p25 0.00 318.8 FORMAT "%5.1" /end CHARACTERISTIC
/begin CHARACTERISTIC VGSP1L "obere Geschwindigkeitsschwelle f¸r Phase 1 der GSP im LL" VALUE 0x1CCAB1 KwUb 318.8 vfzg_ub_q1p25 0.00 318.8 FORMAT "%5.1" /end CHARACTERISTIC
/begin CHARACTERISTIC VGSP1L1 "obere Geschwindigkeitsschwelle f¸r Phase 1 d. GSP im LL (Variante)" VALUE 0x1CCAB2 KwUb 318.8 vfzg_ub_q1p25 0.00 318.8 FORMAT "%5.1" /end CHARACTERISTIC
/begin CHARACTERISTIC VGSP1T "obere Geschwindigkeitsschwelle f¸r Phase 1 der GSP in der TL" VALUE 0x1CCAB3 KwUb 318.8 vfzg_ub_q1p25 0.00 318.8 FORMAT "%5.1" /end CHARACTERISTIC
/begin CHARACTERISTIC VGSP1T1 "obere Geschwindigkeitsschwelle f¸r Phase 1 d. GSP in d. TL (Variante)" VALUE 0x1CCAB4 KwUb 318.8 vfzg_ub_q1p25 0.00 318.8 FORMAT "%5.1" /end CHARACTERISTIC
/begin CHARACTERISTIC VGSP2 "obere Geschwindigkeitsschwelle der GSP f¸r Fz. ohne Kat" VALUE 0x1CCAB5 KwUb 318.8 vfzg_ub_q1p25 0.00 318.8 FORMAT "%5.1" /end CHARACTERISTIC
/begin CHARACTERISTIC VGSP2T "obere Geschwindigkeitsschwelle f¸r Phase 2 der GSP" VALUE 0x1CCAB6 KwUb 318.8 vfzg_ub_q1p25 0.00 318.8 FORMAT "%5.1" /end CHARACTERISTIC
/begin CHARACTERISTIC VGSP2T1 "obere Geschwindigkeitsschwelle f¸r Phase 2 der GSP (Variante)" VALUE 0x1CCAB7 KwUb 318.8 vfzg_ub_q1p25 0.00 318.8 FORMAT "%5.1" /end CHARACTERISTIC
/begin CHARACTERISTIC VMDUB "Geschwindigkeitsschwelle min. f¸r Batteriespannungs-Diagnose" VALUE 0x1C65E2 KwUb 318.8 vfzg_ub_q1p25 0.00 318.8 FORMAT "%5.1" /end CHARACTERISTIC
/begin CHARACTERISTIC WKWALETEST "Testwert f¸r Start ¸ber Auslauferkennung" VALUE 0x1C6640 KwWU16 6553.500 kw_q0p1 0.00 6553.500 FORMAT "%8.3" /end CHARACTERISTIC
/begin CHARACTERISTIC WNWSPG1 "Sollwinkel der 1. negativen Nockenwellenflanke von PG1" VALUE 0x1C6622 KwWU16 6553.500 kw_q0p1 0.00 6553.500 FORMAT "%8.3" /end CHARACTERISTIC
/begin CHARACTERISTIC WNWSPG2 "Sollwinkel der 1. negativen Nockenwellenflanke von PG2" VALUE 0x1C6624 KwWU16 6553.500 kw_q0p1 0.00 6553.500 FORMAT "%8.3" /end CHARACTERISTIC
/begin CHARACTERISTIC WNWSPG3 "Sollwinkel der 1. negativen Nockenwellenflanke von PG3" VALUE 0x1C6626 KwWU16 6553.500 kw_q0p1 0.00 6553.500 FORMAT "%8.3" /end CHARACTERISTIC
/begin CHARACTERISTIC WNWSPG4 "Sollwinkel der 1. negativen Nockenwellenflanke von PG4" VALUE 0x1C6628 KwWU16 6553.500 kw_q0p1 0.00 6553.500 FORMAT "%8.3" /end CHARACTERISTIC
/begin CHARACTERISTIC ZFDUSVK "Filterzeitkonstante f¸r LSU-Spannungsabgleich vor Kat" VALUE 0x1C4DAE KwWU16 655.3400 t10msxs_uw_b655p35 0.01000000 655.3500 FORMAT "%8.4" /end CHARACTERISTIC
/begin CHARACTERISTIC ZFRIH "Abschw‰chungsfaktor f¸r Innenwiderstand Ri-Nernst-Filter hinter KAT" VALUE 0x1C4D5E KwUw 0.9999847 fak_uw_b1 0.00 0.9999847 FORMAT "%9.7" /end CHARACTERISTIC
/begin CHARACTERISTIC ZFRIN "Zeitkonstante f¸r Filter rinlsu_w" VALUE 0x1C4E64 KwWU16 655.3400 t10msxs_uw_b655p35 0.01000000 655.3500 FORMAT "%8.4" /end CHARACTERISTIC
/begin CHARACTERISTIC ZFRINCAL "Zeitkonstante f¸r Filter krivk_w" VALUE 0x1C4E66 KwWU16 655.3400 t10msxs_uw_b655p35 0.01000000 655.3500 FORMAT "%8.4" /end CHARACTERISTIC
/begin CHARACTERISTIC ZFSTFFDP "Aktive Zeit nach Motorstart f¸r Zweitank-F¸llstands-Schnellfilterung" VALUE 0x1CE328 KwUw 13107.00 t200msxs_uw_q0p2 0.00 13107.00 FORMAT "%8.2" /end CHARACTERISTIC
/begin CHARACTERISTIC ZFSTLODP "Zeitschwelle f¸r Freigabebedingung der Zweitank-F¸llstands-Schnellfilterung" VALUE 0x1CE32A KwUw 13107.00 t200msxs_uw_q0p2 0.00 13107.00 FORMAT "%8.2" /end CHARACTERISTIC
/begin CHARACTERISTIC ZFSTMNGR "Wartezeit nach gangi-neutral f¸r schnell-filterung (nur Handschalter-auto)" VALUE 0x1CE32C KwUw 13107.00 t200msxs_uw_q0p2 0.00 13107.00 FORMAT "%8.2" /end CHARACTERISTIC
/begin CHARACTERISTIC ZFSTSTDG "Stabilisierungs-Zeitschwelle f¸r F¸llstands-Statusaenderung f¸r Diagnose" VALUE 0x1CE32E KwUw 6553.500 t100msxs_uw_b6553p5 0.00 6553.500 FORMAT "%8.3" /end CHARACTERISTIC
/begin CHARACTERISTIC ZFSTSTDP "Stabilisierungs-Zeitschwelle f¸r F¸llstands-Statusaenderung f¸r Anzeige" VALUE 0x1CE330 KwUw 13107.00 t200msxs_uw_q0p2 0.00 13107.00 FORMAT "%8.2" /end CHARACTERISTIC
/begin CHARACTERISTIC ZFTANS "Zeitkonstante Tiefpaﬂfilter Ansauglufttemperatur" VALUE 0x1CEB02 KwUw 6553.50000 zk100msxs_uw_b6553 0.100001526 6553.60000 FORMAT "%10.5" /end CHARACTERISTIC
/begin CHARACTERISTIC ZFUULSU "Filterzeitkonstante f¸r Lambda" VALUE 0x1C4DB0 KwWU16 655.3400 t10msxs_uw_b655p35 0.01000000 655.3500 FORMAT "%8.4" /end CHARACTERISTIC
/begin CHARACTERISTIC ZGSP1T "max. Stand des Z‰hlers zgsp in Phase 1 der GSP" VALUE 0x1CCABE KwUw 6553.500 t_q0p1 0.00 6553.500 FORMAT "%8.3" /end CHARACTERISTIC
/begin CHARACTERISTIC ZGSP1T1 "max. Stand des Z‰hlers zgsp in Phase 1 der GSP (Variante)" VALUE 0x1CCAC0 KwUw 6553.500 t_q0p1 0.00 6553.500 FORMAT "%8.3" /end CHARACTERISTIC
/begin CHARACTERISTIC ZGSP2T "max. Stand des Z‰hlers zgsp in Phase 2 der GSP" VALUE 0x1CCAC2 KwUw 6553.500 t_q0p1 0.00 6553.500 FORMAT "%8.3" /end CHARACTERISTIC
/begin CHARACTERISTIC ZGSP2T1 "max. Stand des Z‰hlers zgsp in Phase 2 der GSP (Variante)" VALUE 0x1CCAC4 KwUw 6553.500 t_q0p1 0.00 6553.500 FORMAT "%8.3" /end CHARACTERISTIC
/begin CHARACTERISTIC ZTPREL "Anzahl Z‰hne w‰hrend der Starterkennung" VALUE 0x1C6647 KwWU8 252.0 dez 3.000 255.0 FORMAT "%5.1" /end CHARACTERISTIC
/begin MEASUREMENT anzhfma_w "Anzahl der HFM-Abtastungen ¸ber ein Synchro" UWORD dez 1 100 0 65535 FORMAT "%8.2" ECU_ADDRESS 0x7FAA24 /end MEASUREMENT
/begin MEASUREMENT b_adap "Radadaption freigegeben" UBYTE DC_FLAG_U8 1 100 0 1 BIT_MASK 0x1 FORMAT "%5.3" ECU_ADDRESS 0x8039A1 /end MEASUREMENT
/begin MEASUREMENT b_adapok "Bedingung Adaption erfolgreich abgeschlossen" UBYTE DC_FLAG_U8 1 100 0 1 BIT_MASK 0x1 FORMAT "%5.3" ECU_ADDRESS 0x8039A2 /end MEASUREMENT
/begin MEASUREMENT B_bm "Bedingung Bezugsmarke erkannt" UBYTE B_TRUE 1 100 0 1 BIT_MASK 0x1 FORMAT "%13.11" ECU_ADDRESS 0x7FA877 /end MEASUREMENT
/begin MEASUREMENT B_checkpg "Freigabe zur ‹berpr¸fung der Nockenwellenflankenposition von PG" UBYTE B_TRUE 1 100 0 1 BIT_MASK 0x1 FORMAT "%13.11" ECU_ADDRESS 0x7FA86F /end MEASUREMENT
/begin MEASUREMENT B_checkpg2 "Freigabe zur ‹berpr¸fung der Nockenwellenflankenposition von PG2" UBYTE B_TRUE 1 100 0 1 BIT_MASK 0x1 FORMAT "%13.11" ECU_ADDRESS 0x7FA870 /end MEASUREMENT
/begin MEASUREMENT B_checkpg3 "Freigabe zur ‹berpr¸fung der Nockenwellenflankenposition von PG3" UBYTE B_TRUE 1 100 0 1 BIT_MASK 0x1 FORMAT "%13.11" ECU_ADDRESS 0x7FA871 /end MEASUREMENT
/begin MEASUREMENT B_checkpg4 "Freigabe zur ‹berpr¸fung der Nockenwellenflankenposition von PG4" UBYTE B_TRUE 1 100 0 1 BIT_MASK 0x1 FORMAT "%13.11" ECU_ADDRESS 0x7FA872 /end MEASUREMENT
/begin MEASUREMENT B_ckrivk "Bedingung:  Berechnung von krivk" UBYTE B_TRUE 1 100 0 1 BIT_MASK 0x1 FORMAT "%13.11" ECU_ADDRESS 0x80097E /end MEASUREMENT
/begin MEASUREMENT B_ckrivk2 "Bedingung:  Berechnung von krivk, Bank 2" UBYTE B_TRUE 1 100 0 1 BIT_MASK 0x2 FORMAT "%13.11" ECU_ADDRESS 0x80097E /end MEASUREMENT
/begin MEASUREMENT B_dkp1e "Bedingung Fehler DK-Poti 1" UBYTE B_TRUE 1 100 0 1 BIT_MASK 0x1 FORMAT "%13.11" ECU_ADDRESS 0x7FA661 /end MEASUREMENT
/begin MEASUREMENT B_dkp1ev "Bedingung Vorl‰ufige Bereichsverletzung DK-Poti 1" UBYTE B_TRUE 1 100 0 1 BIT_MASK 0x1 FORMAT "%13.11" ECU_ADDRESS 0x7FA662 /end MEASUREMENT
/begin MEASUREMENT B_dkp1mn "Bedingung Bereichsverletzung DK-Poti 1 nach unten" UBYTE B_TRUE 1 100 0 1 BIT_MASK 0x1 FORMAT "%13.11" ECU_ADDRESS 0x7FA663 /end MEASUREMENT
/begin MEASUREMENT B_dkp1mx "Bedingung Bereichsverletzung DK-Poti 1 nach oben" UBYTE B_TRUE 1 100 0 1 BIT_MASK 0x1 FORMAT "%13.11" ECU_ADDRESS 0x7FA664 /end MEASUREMENT
/begin MEASUREMENT B_dkp1np "Bedingung DK-Poti 1 unplausibel zu Ersatzwert aus F¸llung" UBYTE B_TRUE 1 100 0 1 BIT_MASK 0x1 FORMAT "%13.11" ECU_ADDRESS 0x7FA665 /end MEASUREMENT
/begin MEASUREMENT B_dkp2e "Bedingung Fehler DK-Poti 2" UBYTE B_TRUE 1 100 0 1 BIT_MASK 0x1 FORMAT "%13.11" ECU_ADDRESS 0x7FA666 /end MEASUREMENT
/begin MEASUREMENT B_dkp2ev "Bedingung Vorl‰ufige Bereichsverletzung DK-Poti 2" UBYTE B_TRUE 1 100 0 1 BIT_MASK 0x1 FORMAT "%13.11" ECU_ADDRESS 0x7FA667 /end MEASUREMENT
/begin MEASUREMENT B_dkp2mn "Bedingung Bereichsverletzung DK-Poti 2 nach unten" UBYTE B_TRUE 1 100 0 1 BIT_MASK 0x1 FORMAT "%13.11" ECU_ADDRESS 0x7FA668 /end MEASUREMENT
/begin MEASUREMENT B_dkp2mx "Bedingung Bereichsverletzung DK-Poti 2 nach oben" UBYTE B_TRUE 1 100 0 1 BIT_MASK 0x1 FORMAT "%13.11" ECU_ADDRESS 0x7FA669 /end MEASUREMENT
/begin MEASUREMENT B_dkp2np "Bedingung DK-Poti 2 unplausibel zu Ersatzwert aus F¸llung" UBYTE B_TRUE 1 100 0 1 BIT_MASK 0x1 FORMAT "%13.11" ECU_ADDRESS 0x7FA66A /end MEASUREMENT
/begin MEASUREMENT B_dkpaw "Bedingung DK-Poti-Auswahl f¸r DK-Sensor-Ersatzbetrieb" UBYTE B_TRUE 1 100 0 1 BIT_MASK 0x1 FORMAT "%13.11" ECU_ADDRESS 0x7FA66B /end MEASUREMENT
/begin MEASUREMENT B_dksbeg "Bedingung DK-Sollwertbegrenzung" UBYTE B_TRUE 1 100 0 1 BIT_MASK 0x1 FORMAT "%13.11" ECU_ADDRESS 0x7FA66C /end MEASUREMENT
/begin MEASUREMENT B_edks "Bedingung Fehler Drosselklappen-Sensor" UBYTE B_TRUE 1 100 0 1 BIT_MASK 0x1 FORMAT "%13.11" ECU_ADDRESS 0x7FA66D /end MEASUREMENT
/begin MEASUREMENT B_ehfmmn11 "Bedingung f¸r Komponenten-Fehler HFM  minimal auf Leitung 1 von HFM 1" UBYTE B_TRUE 1 100 0 1 BIT_MASK 0x1 FORMAT "%13.11" ECU_ADDRESS 0x8010A7 /end MEASUREMENT
/begin MEASUREMENT B_ehfmmn21 "Bedingung f¸r Komponenten-Fehler HFM  minimal auf Leitung 2 von HFM 1" UBYTE B_TRUE 1 100 0 1 BIT_MASK 0x8 FORMAT "%13.11" ECU_ADDRESS 0x8010A7 /end MEASUREMENT
/begin MEASUREMENT B_ehfmmx11 "Bedingung f¸r Komponenten-Fehler HFM  maximal auf Leitung 1 von HFM 1" UBYTE B_TRUE 1 100 0 1 BIT_MASK 0x2 FORMAT "%13.11" ECU_ADDRESS 0x8010A7 /end MEASUREMENT
/begin MEASUREMENT B_ehfmmx21 "Bedingung f¸r Komponenten-Fehler HFM  maximal auf Leitung 2 von HFM 1" UBYTE B_TRUE 1 100 0 1 BIT_MASK 0x10 FORMAT "%13.11" ECU_ADDRESS 0x8010A7 /end MEASUREMENT
/begin MEASUREMENT B_ehfmsg11 "Bedingung f¸r Komponenten-Fehler HFM Signal auf Leitung 1 von HFM 1" UBYTE B_TRUE 1 100 0 1 BIT_MASK 0x4 FORMAT "%13.11" ECU_ADDRESS 0x8010A7 /end MEASUREMENT
/begin MEASUREMENT B_ehfmsg21 "Bedingung f¸r Komponenten-Fehler HFM Signal auf Leitung 2 von HFM 1" UBYTE B_TRUE 1 100 0 1 BIT_MASK 0x20 FORMAT "%13.11" ECU_ADDRESS 0x8010A7 /end MEASUREMENT
/begin MEASUREMENT B_endthm "Bedingung:  Freigabe Thermostatdiagnose" UBYTE B_TRUE 1 100 0 1 BIT_MASK 0x10 FORMAT "%13.11" ECU_ADDRESS 0x800CB2 /end MEASUREMENT
/begin MEASUREMENT B_enhlshk "Bedingung Freigabe Heizung Lambdasonde hinter Katalysator" UBYTE B_TRUE 1 100 0 1 BIT_MASK 0x1 FORMAT "%13.11" ECU_ADDRESS 0x7FA710 /end MEASUREMENT
/begin MEASUREMENT B_ennptm "Bedingung:  Freigabe Unplausibilit‰tspr¸fung Motortemperatursignal" UBYTE B_TRUE 1 100 0 1 BIT_MASK 0x20 FORMAT "%13.11" ECU_ADDRESS 0x800CB2 /end MEASUREMENT
/begin MEASUREMENT B_enrinh "Bedingung enable f¸r Ri-Nernst mit Filter hinter KAT" UBYTE B_TRUE 1 100 0 1 BIT_MASK 0x1 FORMAT "%13.11" ECU_ADDRESS 0x7FA6F4 /end MEASUREMENT
/begin MEASUREMENT B_enrinh2 "Bedingung enable f¸r Ri-Nernst mit Filter hinter KAT Bank2" UBYTE B_TRUE 1 100 0 1 BIT_MASK 0x1 FORMAT "%13.11" ECU_ADDRESS 0x7FA6F5 /end MEASUREMENT
/begin MEASUREMENT B_enscun "Bedingung: Kurzschluﬂ nach Ubat-Erkennung an UN des CJ125 eingeschaltet" UBYTE B_TRUE 1 100 0 1 BIT_MASK 0x4 FORMAT "%13.11" ECU_ADDRESS 0x80097C /end MEASUREMENT
/begin MEASUREMENT B_enscun2 "Bedingung: Kurzschluﬂ nach Ubat-Erkennung an UN des CJ125 eingeschaltet, Bank 2" UBYTE B_TRUE 1 100 0 1 BIT_MASK 0x4 FORMAT "%13.11" ECU_ADDRESS 0x80097D /end MEASUREMENT
/begin MEASUREMENT B_erinofh "Bedingung enable f¸r Ri-Nernst ohne Filter hinter KAT" UBYTE B_TRUE 1 100 0 1 BIT_MASK 0x1 FORMAT "%13.11" ECU_ADDRESS 0x7FA6F6 /end MEASUREMENT
/begin MEASUREMENT B_erinofh2 "Bedingung enable f¸r Ri-Nernst ohne Filter hinter KAT Bank2" UBYTE B_TRUE 1 100 0 1 BIT_MASK 0x1 FORMAT "%13.11" ECU_ADDRESS 0x7FA6F7 /end MEASUREMENT
/begin MEASUREMENT B_eshlsu "Bedingung Ende Startsteuerung in %HRLSU" UBYTE B_TRUE 1 100 0 1 BIT_MASK 0x1 FORMAT "%13.11" ECU_ADDRESS 0x8009A6 /end MEASUREMENT
/begin MEASUREMENT B_eshlsu2 "Bedingung Ende Startsteuerung in %HRLSU, Bank 2" UBYTE B_TRUE 1 100 0 1 BIT_MASK 0x1 FORMAT "%13.11" ECU_ADDRESS 0x8009A7 /end MEASUREMENT
/begin MEASUREMENT B_fhsvt "Bedingung Freigabe der Heizungsregelung bez¸glich Wasserschlaggefahr" UBYTE B_TRUE 1 100 0 1 BIT_MASK 0x1 FORMAT "%13.11" ECU_ADDRESS 0x8009A8 /end MEASUREMENT
/begin MEASUREMENT B_fhsvt2 "Bedingung Freigabe der Heizungsregelung bez¸glich Wasserschlaggefahr, Bank 2" UBYTE B_TRUE 1 100 0 1 BIT_MASK 0x1 FORMAT "%13.11" ECU_ADDRESS 0x8009A9 /end MEASUREMENT
/begin MEASUREMENT B_fklanf "Bedingung Anforderung Verst‰rkungsumschaltung Fettkennlinie LSU/CJ120" UBYTE B_TRUE 1 100 0 1 BIT_MASK 0x1 FORMAT "%13.11" ECU_ADDRESS 0x800F33 /end MEASUREMENT
/begin MEASUREMENT B_fklanf2 "Bedingung Anforderung Verst‰rkungsumschaltung Fettkennlinie LSU2/CJ120" UBYTE B_TRUE 1 100 0 1 BIT_MASK 0x1 FORMAT "%13.11" ECU_ADDRESS 0x800F34 /end MEASUREMENT
/begin MEASUREMENT B_fklanfs "Bedingung Anforderung Verst‰rkungsumschaltung Fettkennlinie LSU/CJ120 nach Start" UBYTE B_TRUE 1 100 0 1 BIT_MASK 0x1 FORMAT "%13.11" ECU_ADDRESS 0x800F35 /end MEASUREMENT
/begin MEASUREMENT B_fmfkrc "Filtermittenfrequenz des CC195/CC650 umgeschaltet" UBYTE B_TRUE 1 100 0 1 BIT_MASK 0x1 FORMAT "%13.11" ECU_ADDRESS 0x7FA84A /end MEASUREMENT
/begin MEASUREMENT B_fstdgv "Bedingung: Status d. Fuellst.bereiches fuer Diagnose stabil" UBYTE B_TRUE 1 100 0 1 BIT_MASK 0x1 FORMAT "%13.11" ECU_ADDRESS 0x800C3C /end MEASUREMENT
/begin MEASUREMENT B_fstdpv "Bedingung: Status d. F¸llst.bereiches f¸r Anzeige ist stabil" UBYTE B_TRUE 1 100 0 1 BIT_MASK 0x2 FORMAT "%13.11" ECU_ADDRESS 0x800C3C /end MEASUREMENT
/begin MEASUREMENT B_fstffdp "Bedingung: Schnellfilterung des Zweitank-F¸llstandes f¸r die Diagnose ist aktiv" UBYTE B_TRUE 1 100 0 1 BIT_MASK 0x1 FORMAT "%13.11" ECU_ADDRESS 0x800C3D /end MEASUREMENT
/begin MEASUREMENT B_gspph1 "Phase 1 der Getriebeschaltpunktsteuerung" UBYTE B_TRUE 1 100 0 1 BIT_MASK 0x1 FORMAT "%13.11" ECU_ADDRESS 0x801179 /end MEASUREMENT
/begin MEASUREMENT B_gspph2 "Phase 2 der Getriebeschaltpunktsteuerung" UBYTE B_TRUE 1 100 0 1 BIT_MASK 0x2 FORMAT "%13.11" ECU_ADDRESS 0x801179 /end MEASUREMENT
/begin MEASUREMENT B_henrin "Bedingung Ri-Messung darf aus Sicht der Heizungsregelung eingeschaltet werden" UBYTE B_TRUE 1 100 0 1 BIT_MASK 0x2 FORMAT "%13.11" ECU_ADDRESS 0x8009A6 /end MEASUREMENT
/begin MEASUREMENT B_henrin2 "Bedingung Ri-Messung darf aus Sicht der Heizungsregelung eingeschaltet werden,B2" UBYTE B_TRUE 1 100 0 1 BIT_MASK 0x2 FORMAT "%13.11" ECU_ADDRESS 0x8009A7 /end MEASUREMENT
/begin MEASUREMENT B_hlsuaru "Bedingung I-Anteil der Temp.-Regelung ist angehalten" UBYTE B_TRUE 1 100 0 1 BIT_MASK 0x2 FORMAT "%13.11" ECU_ADDRESS 0x8009A8 /end MEASUREMENT
/begin MEASUREMENT B_hlsuaru2 "Bedingung I-Anteil der Temp.-Regelung ist angehalten, Bank 2" UBYTE B_TRUE 1 100 0 1 BIT_MASK 0x2 FORMAT "%13.11" ECU_ADDRESS 0x8009A9 /end MEASUREMENT
/begin MEASUREMENT B_hsha "Bedingung Sonde hinter Kat ausreichend beheizt" UBYTE B_TRUE 1 100 0 1 BIT_MASK 0x1 FORMAT "%13.11" ECU_ADDRESS 0x7FA711 /end MEASUREMENT
/begin MEASUREMENT B_hsha2 "Bedingung Sonde 2 hinter Kat ausreichend beheizt" UBYTE B_TRUE 1 100 0 1 BIT_MASK 0x1 FORMAT "%13.11" ECU_ADDRESS 0x7FA712 /end MEASUREMENT
/begin MEASUREMENT B_hshe "Bedingung Endstufe Sondenheizung hinter Kat angesteuert" UBYTE B_TRUE 1 100 0 1 BIT_MASK 0x1 FORMAT "%13.11" ECU_ADDRESS 0x7FA713 /end MEASUREMENT
/begin MEASUREMENT B_hshe2 "Bedingung Endstufe Sondenheizung2 hinter Kat angesteuert" UBYTE B_TRUE 1 100 0 1 BIT_MASK 0x1 FORMAT "%13.11" ECU_ADDRESS 0x7FA714 /end MEASUREMENT
/begin MEASUREMENT B_hstlsua "Bedingung: Heizerstatus A liegt vor, Sonde ist ausreichend aufgeheizt" UBYTE B_TRUE 1 100 0 1 BIT_MASK 0x4 FORMAT "%13.11" ECU_ADDRESS 0x8009A6 /end MEASUREMENT
/begin MEASUREMENT B_hstlsua2 "Bedingung: Heizerstatus A liegt vor, Sonde ist ausreichend aufgeheizt, Bank2" UBYTE B_TRUE 1 100 0 1 BIT_MASK 0x4 FORMAT "%13.11" ECU_ADDRESS 0x8009A7 /end MEASUREMENT
/begin MEASUREMENT B_hstlsub "Bedingung: Heizerstatus B liegt vor, Schubabgleich darf durchgef¸hrt werden" UBYTE B_TRUE 1 100 0 1 BIT_MASK 0x8 FORMAT "%13.11" ECU_ADDRESS 0x8009A6 /end MEASUREMENT
/begin MEASUREMENT B_hstlsub2 "Bedingung: Heizerstatus B liegt vor, Schubabgleich darf durchgef¸hrt werden,b2" UBYTE B_TRUE 1 100 0 1 BIT_MASK 0x8 FORMAT "%13.11" ECU_ADDRESS 0x8009A7 /end MEASUREMENT
/begin MEASUREMENT B_hsv "Bedingung Heizung Sonde vor Kat einschaltbereit" UBYTE B_TRUE 1 100 0 1 BIT_MASK 0x10 FORMAT "%13.11" ECU_ADDRESS 0x8009A6 /end MEASUREMENT
/begin MEASUREMENT B_hsv2 "Bedingung Heizung Sonde2 vor Kat einschaltbereit" UBYTE B_TRUE 1 100 0 1 BIT_MASK 0x10 FORMAT "%13.11" ECU_ADDRESS 0x8009A7 /end MEASUREMENT
/begin MEASUREMENT B_iclsabg "Bedingung: Anforderung/Durchf¸hrung  des elektrischen Abgleiches der LSU" UBYTE B_TRUE 1 100 0 1 BIT_MASK 0x2 FORMAT "%13.11" ECU_ADDRESS 0x800F33 /end MEASUREMENT
/begin MEASUREMENT B_iclsabg2 "Bedingung: Anforderung/Durchf¸hrung  des elektrischen Abgleiches der LSU, Bank 2" UBYTE B_TRUE 1 100 0 1 BIT_MASK 0x2 FORMAT "%13.11" ECU_ADDRESS 0x800F34 /end MEASUREMENT
/begin MEASUREMENT B_krkoer "Fehler bei ‹bertragung Filterkoeffizienten Klopfregelung" UBYTE B_TRUE 1 100 0 1 BIT_MASK 0x1 FORMAT "%13.11" ECU_ADDRESS 0x7FA84B /end MEASUREMENT
/begin MEASUREMENT B_krkoueb "‹bertragung der Filterkoeffizienten Klopfregung aktiv" UBYTE B_TRUE 1 100 0 1 BIT_MASK 0x1 FORMAT "%13.11" ECU_ADDRESS 0x7FA84C /end MEASUREMENT
/begin MEASUREMENT B_krmfok "Bedingung: Berechnung des Messfensters abgeschlossen" UBYTE B_TRUE 1 100 0 1 BIT_MASK 0x1 FORMAT "%13.11" ECU_ADDRESS 0x7FA84D /end MEASUREMENT
/begin MEASUREMENT B_krpar "Parity-Check Klopfregelung freigegeben" UBYTE B_TRUE 1 100 0 1 BIT_MASK 0x1 FORMAT "%13.11" ECU_ADDRESS 0x7FA84E /end MEASUREMENT
/begin MEASUREMENT B_lbkpe "Bedingung Fehler LBK Potentiometer" UBYTE B_TRUE 1 100 0 1 BIT_MASK 0x1 FORMAT "%13.11" ECU_ADDRESS 0x7FA635 /end MEASUREMENT
/begin MEASUREMENT B_lbkpev "Bedingung vorl‰ufiger Fehler LBK Potentiometer" UBYTE B_TRUE 1 100 0 1 BIT_MASK 0x1 FORMAT "%13.11" ECU_ADDRESS 0x7FA636 /end MEASUREMENT
/begin MEASUREMENT B_lbkpmn "Bedingung Bereichsverletzung LBK Potentiometer am unteren Spannungslimit" UBYTE B_TRUE 1 100 0 1 BIT_MASK 0x1 FORMAT "%13.11" ECU_ADDRESS 0x7FA637 /end MEASUREMENT
/begin MEASUREMENT B_lbkpmx "Bedingung Bereichsverletzung LBK Potentiometer am oberen Spannungslimit" UBYTE B_TRUE 1 100 0 1 BIT_MASK 0x1 FORMAT "%13.11" ECU_ADDRESS 0x7FA638 /end MEASUREMENT
/begin MEASUREMENT B_nletm "Bedingung Nachlauf tmot-Fehler" UBYTE B_TRUE 1 100 0 1 BIT_MASK 0x1 FORMAT "%13.11" ECU_ADDRESS 0x7FA87F /end MEASUREMENT
/begin MEASUREMENT B_npotm "Bedingung: Motortemperatursignal im oberen Bereich nicht plausibel" UBYTE B_TRUE 1 100 0 1 BIT_MASK 0x2 FORMAT "%13.11" ECU_ADDRESS 0x800CB2 /end MEASUREMENT
/begin MEASUREMENT B_nputm "Bedingung: Motortemperatursignal im unteren Bereich nicht plausibel gg¸. Modell" UBYTE B_TRUE 1 100 0 1 BIT_MASK 0x8 FORMAT "%13.11" ECU_ADDRESS 0x800CB2 /end MEASUREMENT
/begin MEASUREMENT B_pg1limsw "Bereichs¸berschreitung bei Grenzen f¸r Nockenwellenflanke von PG" UBYTE B_TRUE 1 100 0 1 BIT_MASK 0x1 FORMAT "%13.11" ECU_ADDRESS 0x7FA873 /end MEASUREMENT
/begin MEASUREMENT B_pg2limsw "Bereichs¸berschreitung bei Grenzen f¸r Nockenwellenflanke von PG2" UBYTE B_TRUE 1 100 0 1 BIT_MASK 0x1 FORMAT "%13.11" ECU_ADDRESS 0x7FA874 /end MEASUREMENT
/begin MEASUREMENT B_pg3limsw "Bereichs¸berschreitung bei Grenzen f¸r Nockenwellenflanke von PG3" UBYTE B_TRUE 1 100 0 1 BIT_MASK 0x1 FORMAT "%13.11" ECU_ADDRESS 0x7FA875 /end MEASUREMENT
/begin MEASUREMENT B_pg4limsw "Bereichs¸berschreitung bei Grenzen f¸r Nockenwellenflanke von PG4" UBYTE B_TRUE 1 100 0 1 BIT_MASK 0x1 FORMAT "%13.11" ECU_ADDRESS 0x7FA876 /end MEASUREMENT
/begin MEASUREMENT B_priph "Bedingung Port schalten f¸r Pumpimpuls hinter KAT" UBYTE B_TRUE 1 100 0 1 BIT_MASK 0x1 FORMAT "%13.11" ECU_ADDRESS 0x7FA6F8 /end MEASUREMENT
/begin MEASUREMENT B_priph2 "Bedingung Port schalten f¸r Pumpimpuls hinter KAT Bank2" UBYTE B_TRUE 1 100 0 1 BIT_MASK 0x1 FORMAT "%13.11" ECU_ADDRESS 0x7FA6F9 /end MEASUREMENT
/begin MEASUREMENT B_puklp1 "Umschaltung auf Pulsationskennfeld bei aktiven Verstellelement 1" UBYTE B_TRUE 1 100 0 1 BIT_MASK 0x1 FORMAT "%13.11" ECU_ADDRESS 0x7FA629 /end MEASUREMENT
/begin MEASUREMENT B_puklp2 "Umschaltung auf Pulsationskennfeld bei aktiven Verstellelement 2" UBYTE B_TRUE 1 100 0 1 BIT_MASK 0x1 FORMAT "%13.11" ECU_ADDRESS 0x7FA62A /end MEASUREMENT
/begin MEASUREMENT B_pullup "Bedingung Pullup-Widerstand f¸r NTC zugeschaltet" UBYTE B_TRUE 1 100 0 1 BIT_MASK 0x1 FORMAT "%13.11" ECU_ADDRESS 0x800CB2 /end MEASUREMENT
/begin MEASUREMENT B_pump "Bedingung Starten des Timers TTGLS" UBYTE B_TRUE 1 100 0 1 BIT_MASK 0x1 FORMAT "%13.11" ECU_ADDRESS 0x7FA6FA /end MEASUREMENT
/begin MEASUREMENT B_pusab "Bedingung Abschaltung der Pumpspannung f¸r LSU" UBYTE B_TRUE 1 100 0 1 BIT_MASK 0x1 FORMAT "%13.11" ECU_ADDRESS 0x80097C /end MEASUREMENT
/begin MEASUREMENT B_pusab2 "Bedingung Abschaltung der Pumpspannung f¸r LSU 2, Bank 2" UBYTE B_TRUE 1 100 0 1 BIT_MASK 0x1 FORMAT "%13.11" ECU_ADDRESS 0x80097D /end MEASUREMENT
/begin MEASUREMENT b_radini "Radadaption im Initialdurchlauf" UBYTE DC_FLAG_U8 1 100 0 1 BIT_MASK 0x1 FORMAT "%5.3" ECU_ADDRESS 0x8039A3 /end MEASUREMENT
/begin MEASUREMENT B_rehs "Restart Sondenheizung" UBYTE B_TRUE 1 100 0 1 BIT_MASK 0x1 FORMAT "%13.11" ECU_ADDRESS 0x7FA715 /end MEASUREMENT
/begin MEASUREMENT B_resabg "Bedingung f¸r R¸cksetzen Abgleich CJ125" UBYTE B_TRUE 1 100 0 1 BIT_MASK 0x4 FORMAT "%13.11" ECU_ADDRESS 0x800F35 /end MEASUREMENT
/begin MEASUREMENT B_resabg2 "Bedingung f¸r R¸cksetzen Abgleich CJ125 Bank 2" UBYTE B_TRUE 1 100 0 1 BIT_MASK 0x8 FORMAT "%13.11" ECU_ADDRESS 0x800F35 /end MEASUREMENT
/begin MEASUREMENT B_riakh "Bedingung f¸r Strom-Pumpen aktualisiert hinter KAT" UBYTE B_TRUE 1 100 0 1 BIT_MASK 0x1 FORMAT "%13.11" ECU_ADDRESS 0x7FA6FB /end MEASUREMENT
/begin MEASUREMENT B_riakh2 "Bedingung f¸r Strom-Pumpen aktualisiert hinter KAT Bank2" UBYTE B_TRUE 1 100 0 1 BIT_MASK 0x1 FORMAT "%13.11" ECU_ADDRESS 0x7FA6FC /end MEASUREMENT
/begin MEASUREMENT B_ribeh "Bedingung Innenwiderstand Ri berechnen f¸r Sonde hinter KAT" UBYTE B_TRUE 1 100 0 1 BIT_MASK 0x1 FORMAT "%13.11" ECU_ADDRESS 0x7FA6FD /end MEASUREMENT
/begin MEASUREMENT B_ribeh2 "Bedingung Innenwiderstand Ri berechnen f¸r Sonde hinter KAT Bank2" UBYTE B_TRUE 1 100 0 1 BIT_MASK 0x1 FORMAT "%13.11" ECU_ADDRESS 0x7FA6FE /end MEASUREMENT
/begin MEASUREMENT B_riibh "Bedingung Sondenspannung im zul‰ssigen Band f¸r Strompumpen hinter KAT" UBYTE B_TRUE 1 100 0 1 BIT_MASK 0x1 FORMAT "%13.11" ECU_ADDRESS 0x7FA6FF /end MEASUREMENT
/begin MEASUREMENT B_riibh2 "Bedingung Sondenspannung im zul‰ssigen Band f¸r Strompumpen hinter KAT Bank2" UBYTE B_TRUE 1 100 0 1 BIT_MASK 0x1 FORMAT "%13.11" ECU_ADDRESS 0x7FA700 /end MEASUREMENT
/begin MEASUREMENT B_riimph "Bedingung Impuls f¸r Strom-Pumpen hinter KAT" UBYTE B_TRUE 1 100 0 1 BIT_MASK 0x1 FORMAT "%13.11" ECU_ADDRESS 0x7FA701 /end MEASUREMENT
/begin MEASUREMENT B_rimh "Bedingung (ADC-Trigger) f¸r Messen belastete Sondenspannung hinter KAT" UBYTE B_TRUE 1 100 0 1 BIT_MASK 0x1 FORMAT "%13.11" ECU_ADDRESS 0x7FA702 /end MEASUREMENT
/begin MEASUREMENT B_rimh2 "Bedingung (ADC-Trigger) f¸r Messen belastete Sondenspannung hinter KAT Bank2" UBYTE B_TRUE 1 100 0 1 BIT_MASK 0x1 FORMAT "%13.11" ECU_ADDRESS 0x7FA703 /end MEASUREMENT
/begin MEASUREMENT B_rinabg "Bedingung Abgleich Innenwiderstand Nernstzelle von LSU" UBYTE B_TRUE 1 100 0 1 BIT_MASK 0x2 FORMAT "%13.11" ECU_ADDRESS 0x80097C /end MEASUREMENT
/begin MEASUREMENT B_rinabg2 "Bedingung Abgleich Innenwiderstand Nernstzelle von LSU , Bank 2" UBYTE B_TRUE 1 100 0 1 BIT_MASK 0x2 FORMAT "%13.11" ECU_ADDRESS 0x80097D /end MEASUREMENT
/begin MEASUREMENT B_rinh "Bedingung Innenwiderstand Ri-Messung der Nernstsonde aktiv hinter Kat" UBYTE B_TRUE 1 100 0 1 BIT_MASK 0x1 FORMAT "%13.11" ECU_ADDRESS 0x7FA704 /end MEASUREMENT
/begin MEASUREMENT B_rinh2 "Bedingung Innenwiderstand Ri-Messung der Nernstsonde aktiv hinter KAT Bank2" UBYTE B_TRUE 1 100 0 1 BIT_MASK 0x1 FORMAT "%13.11" ECU_ADDRESS 0x7FA705 /end MEASUREMENT
/begin MEASUREMENT B_ripuh "Bedingung Strom-Pumpen f¸r Sonde hinter KAT" UBYTE B_TRUE 1 100 0 1 BIT_MASK 0x1 FORMAT "%13.11" ECU_ADDRESS 0x7FA706 /end MEASUREMENT
/begin MEASUREMENT B_ripuh2 "Bedingung Strom-Pumpen f¸r Sonde hinter KAT Bank2" UBYTE B_TRUE 1 100 0 1 BIT_MASK 0x1 FORMAT "%13.11" ECU_ADDRESS 0x7FA707 /end MEASUREMENT
/begin MEASUREMENT B_rireh "Bedingung Resultat f¸r Innenwiderstand Ri f¸r Sonde hinter KAT" UBYTE B_TRUE 1 100 0 1 BIT_MASK 0x1 FORMAT "%13.11" ECU_ADDRESS 0x7FA708 /end MEASUREMENT
/begin MEASUREMENT B_rireh2 "Bedingung Resultat f¸r Innenwiderstand Ri f¸r Sonde hinter KAT Bank2" UBYTE B_TRUE 1 100 0 1 BIT_MASK 0x1 FORMAT "%13.11" ECU_ADDRESS 0x7FA709 /end MEASUREMENT
/begin MEASUREMENT B_risph "Bedingung Sondensprung hinter KAT" UBYTE B_TRUE 1 100 0 1 BIT_MASK 0x1 FORMAT "%13.11" ECU_ADDRESS 0x7FA70A /end MEASUREMENT
/begin MEASUREMENT B_risph2 "Bedingung Sondensprung hinter KAT Bank2" UBYTE B_TRUE 1 100 0 1 BIT_MASK 0x1 FORMAT "%13.11" ECU_ADDRESS 0x7FA70B /end MEASUREMENT
/begin MEASUREMENT B_shuerf "Bedingung Sondenspannung hinter KAT erfassen" UBYTE B_TRUE 1 100 0 1 BIT_MASK 0x1 FORMAT "%13.11" ECU_ADDRESS 0x7FA70C /end MEASUREMENT
/begin MEASUREMENT B_shuerf2 "Bedingung Sondenspannung hinter KAT erfassen Bank2" UBYTE B_TRUE 1 100 0 1 BIT_MASK 0x1 FORMAT "%13.11" ECU_ADDRESS 0x7FA70D /end MEASUREMENT
/begin MEASUREMENT B_sphrlsu "Bedingung: Stop Heizungsregelung wegen Fehler an der LSU" UBYTE B_TRUE 1 100 0 1 BIT_MASK 0x4 FORMAT "%13.11" ECU_ADDRESS 0x8009A8 /end MEASUREMENT
/begin MEASUREMENT B_sphrlsu2 "Bedingung: Stop Heizungsregelung wegen Fehler an der LSU, Bank 2" UBYTE B_TRUE 1 100 0 1 BIT_MASK 0x4 FORMAT "%13.11" ECU_ADDRESS 0x8009A9 /end MEASUREMENT
/begin MEASUREMENT B_stprel "Bedingung Entprellung von Drehzahlgebersignal gestartet" UBYTE B_TRUE 1 100 0 1 BIT_MASK 0x1 FORMAT "%13.11" ECU_ADDRESS 0x7FA878 /end MEASUREMENT
/begin MEASUREMENT b_swean "Fehler Beschleunigungssensor erkannt" UBYTE DC_FLAG_U8 1 100 0 1 BIT_MASK 0x1 FORMAT "%5.3" ECU_ADDRESS 0x8039A4 /end MEASUREMENT
/begin MEASUREMENT b_sweaus "Fehler Beschleunigungssensor aus" UBYTE DC_FLAG_U8 1 100 0 1 BIT_MASK 0x1 FORMAT "%5.3" ECU_ADDRESS 0x8039A5 /end MEASUREMENT
/begin MEASUREMENT B_tabgs "Bedingung Abgleich stetige Lambda-Sonde LSU nach Start" UBYTE B_TRUE 1 100 0 1 BIT_MASK 0x2 FORMAT "%13.11" ECU_ADDRESS 0x800F35 /end MEASUREMENT
/begin MEASUREMENT B_tal "Bedingung Tank leer bzw. Reserve" UBYTE B_TRUE 1 100 0 1 BIT_MASK 0x4 FORMAT "%13.11" ECU_ADDRESS 0x800C3C /end MEASUREMENT
/begin MEASUREMENT B_talval "Bedingung : Bit Tank leer g¸ltig" UBYTE B_TRUE 1 100 0 1 BIT_MASK 0x8 FORMAT "%13.11" ECU_ADDRESS 0x800C3C /end MEASUREMENT
/begin MEASUREMENT B_tanwera "Bedingung: Zeitdauer f¸r Entriegelungstastverh‰ltnis Auslassnockenwelle" UBYTE B_TRUE 1 100 0 1 BIT_MASK 0x1 FORMAT "%13.11" ECU_ADDRESS 0x7FA694 /end MEASUREMENT
/begin MEASUREMENT B_tanwere "Bedingung: Zeitdauer f¸r Entriegelungstastverh‰ltnis Einlassnockenwelle" UBYTE B_TRUE 1 100 0 1 BIT_MASK 0x1 FORMAT "%13.11" ECU_ADDRESS 0x7FA695 /end MEASUREMENT
/begin MEASUREMENT B_tmmn "Bedingung: Blockheater erkannt" UBYTE B_TRUE 1 100 0 1 BIT_MASK 0x1 FORMAT "%13.11" ECU_ADDRESS 0x7FA880 /end MEASUREMENT
/begin MEASUREMENT B_tmsrt "Bedingung Retriggerung Motortemperaturmodell nach Start" UBYTE B_TRUE 1 100 0 1 BIT_MASK 0x1 FORMAT "%13.11" ECU_ADDRESS 0x7FA881 /end MEASUREMENT
/begin MEASUREMENT B_tprel "Bedingung Zeitentprellung abgeschlossen" UBYTE B_TRUE 1 100 0 1 BIT_MASK 0x1 FORMAT "%13.11" ECU_ADDRESS 0x7FA879 /end MEASUREMENT
/begin MEASUREMENT B_ubvdkp "Bedingung Batteriespannung ausreichend f¸r Verst‰rkung von DK-Poti 1" UBYTE B_TRUE 1 100 0 1 BIT_MASK 0x1 FORMAT "%13.11" ECU_ADDRESS 0x7FA66E /end MEASUREMENT
/begin MEASUREMENT B_udk1nv "Bedingung Spannung DK-Poti 1 oberhalb des Verst‰rkungsbereichs" UBYTE B_TRUE 1 100 0 1 BIT_MASK 0x1 FORMAT "%13.11" ECU_ADDRESS 0x7FA66F /end MEASUREMENT
/begin MEASUREMENT B_usbeh "Bedingung f¸r Zeitz‰hler zur Ausblendung der Sondenbelastung hinter KAT" UBYTE B_TRUE 1 100 0 1 BIT_MASK 0x1 FORMAT "%13.11" ECU_ADDRESS 0x7FA70E /end MEASUREMENT
/begin MEASUREMENT B_usbeh2 "Bedingung f¸r Zeitz‰hler zur Ausblendung der Sondenbelastung hinter KAT Bank2" UBYTE B_TRUE 1 100 0 1 BIT_MASK 0x1 FORMAT "%13.11" ECU_ADDRESS 0x7FA70F /end MEASUREMENT
/begin MEASUREMENT B_vhlsu "Bedingung: Vorheizen der LSU nach Kaltstart" UBYTE B_TRUE 1 100 0 1 BIT_MASK 0x8 FORMAT "%13.11" ECU_ADDRESS 0x8009A8 /end MEASUREMENT
/begin MEASUREMENT B_vhlsu2 "Bedingung: Vorheizen der LSU nach Kaltstart, Bank 2" UBYTE B_TRUE 1 100 0 1 BIT_MASK 0x8 FORMAT "%13.11" ECU_ADDRESS 0x8009A9 /end MEASUREMENT
/begin MEASUREMENT B_wdk12ev "Bedingung Vorl‰ufiger Gleichlauffehler der DK-Potis" UBYTE B_TRUE 1 100 0 1 BIT_MASK 0x1 FORMAT "%13.11" ECU_ADDRESS 0x7FA670 /end MEASUREMENT
/begin MEASUREMENT B_wdk13ev "Bedingung Vorl‰ufige Unplausibilit‰t zw. DK-Poti 1 und Ersatzwert aus F¸llung" UBYTE B_TRUE 1 100 0 1 BIT_MASK 0x1 FORMAT "%13.11" ECU_ADDRESS 0x7FA671 /end MEASUREMENT
/begin MEASUREMENT B_wdk1v "Bedingung Berechnung des DK-Winkels aus verst‰rktem Signal von Poti 1" UBYTE B_TRUE 1 100 0 1 BIT_MASK 0x1 FORMAT "%13.11" ECU_ADDRESS 0x7FA672 /end MEASUREMENT
/begin MEASUREMENT B_wdk23ev "Bedingung Vorl‰ufige Unplausibilit‰t zw. DK-Poti 2 und Ersatzwert aus F¸llung" UBYTE B_TRUE 1 100 0 1 BIT_MASK 0x1 FORMAT "%13.11" ECU_ADDRESS 0x7FA673 /end MEASUREMENT
/begin MEASUREMENT B_wdk2sel "Bedingung DK-Winkel-Berechnung f¸r Lageregler aus Poti 2" UBYTE B_TRUE 1 100 0 1 BIT_MASK 0x1 FORMAT "%13.11" ECU_ADDRESS 0x7FA674 /end MEASUREMENT
/begin MEASUREMENT B_wdk2st "Bedingung DK-Winkel-Berechnung f¸r Lageregler tempor‰r aus Poti 2" UBYTE B_TRUE 1 100 0 1 BIT_MASK 0x1 FORMAT "%13.11" ECU_ADDRESS 0x7FA675 /end MEASUREMENT
/begin MEASUREMENT B_zoptm "Bedingung: Zyklusfreigabe von Unplausibilit‰tspr¸fung oben TMOT-Signal" UBYTE B_TRUE 1 100 0 1 BIT_MASK 0x4 FORMAT "%13.11" ECU_ADDRESS 0x800CB2 /end MEASUREMENT
/begin MEASUREMENT B_zprel "Bedingung Zahnentprellung erfolgt" UBYTE B_TRUE 1 100 0 1 BIT_MASK 0x1 FORMAT "%13.11" ECU_ADDRESS 0x7FA87A /end MEASUREMENT
/begin MEASUREMENT B_zsynchro "Bedingung f¸r einmaliges Auslˆsen eines virtuellen Zwangssynchros im Start" UBYTE B_TRUE 1 100 0 1 BIT_MASK 0x1 FORMAT "%13.11" ECU_ADDRESS 0x7FA87B /end MEASUREMENT
/begin MEASUREMENT camstate "Array mit Status des Nockenwelle-Treibers f¸r jede NW" UBYTE dez 1 100 0 255 FORMAT "%5.1" ARRAY_SIZE 4 ECU_ADDRESS 0x80103C /end MEASUREMENT
/begin MEASUREMENT cpaw1 "Z‰hler f¸r Poti 1 bei DK-Poti-Auswahl" UBYTE dez 1 100 0 255 FORMAT "%5.1" ECU_ADDRESS 0x8010D9 /end MEASUREMENT
/begin MEASUREMENT cpaw2 "Z‰hler f¸r Poti 2 bei DK-Poti-Auswahl" UBYTE dez 1 100 0 255 FORMAT "%5.1" ECU_ADDRESS 0x8010DA /end MEASUREMENT
/begin MEASUREMENT crankstate "Status des Kurbelwellentreibers" UBYTE dez 1 100 0 255 FORMAT "%5.1" ECU_ADDRESS 0x801044 /end MEASUREMENT
/begin MEASUREMENT ctdkp1 "Fehlerzeitz‰hler f¸r Bereichspr¸fung DK-Poti 1" UBYTE t10msxs_ub_b2p55 1 100 0 2.55 FORMAT "%5.3" ECU_ADDRESS 0x8010DB /end MEASUREMENT
/begin MEASUREMENT ctdkp2 "Fehlerzeitz‰hler f¸r Bereichspr¸fung DK-Poti 2" UBYTE t10msxs_ub_b2p55 1 100 0 2.55 FORMAT "%5.3" ECU_ADDRESS 0x8010DC /end MEASUREMENT
/begin MEASUREMENT ctdkpaw "Zeitz‰hler f¸r DK-Poti-Auswahl" UBYTE t10msxs_ub_b2p55 1 100 0 2.55 FORMAT "%5.3" ECU_ADDRESS 0x8010DD /end MEASUREMENT
/begin MEASUREMENT ctwdk12 "Fehlerzeitz‰hler f¸r Gleichlaufpr¸fung der DK-Potis" UBYTE t10msxs_ub_b2p55 1 100 0 2.55 FORMAT "%5.3" ECU_ADDRESS 0x8010DE /end MEASUREMENT
/begin MEASUREMENT ctwdk13 "Fehlerzeitz‰hler f¸r Plausibilit‰tspr¸fung DK-Poti 1 mit Ersatzwert aus F¸llung" UBYTE t10msxs_ub_b2p55 1 100 0 2.55 FORMAT "%5.3" ECU_ADDRESS 0x8010DF /end MEASUREMENT
/begin MEASUREMENT ctwdk23 "Fehlerzeitz‰hler f¸r Plausibilit‰tspr¸fung DK-Poti 2 mit Ersatzwert aus F¸llung" UBYTE t10msxs_ub_b2p55 1 100 0 2.55 FORMAT "%5.3" ECU_ADDRESS 0x8010E0 /end MEASUREMENT
/begin MEASUREMENT ddh "maximaler Raddrehzahlgradient vorne" UWORD DC_URD_05 1 100 0 8191.5 FORMAT "%8.3" ECU_ADDRESS 0x803384 /end MEASUREMENT
/begin MEASUREMENT ddhl "Absolutwert Raddrehzahlgradient hinten links" UWORD DC_URD_05 1 100 0 8191.5 FORMAT "%8.3" ECU_ADDRESS 0x803386 /end MEASUREMENT
/begin MEASUREMENT ddhr "Absolutwert Raddrehzahlgradient hinten rechts" UWORD DC_URD_05 1 100 0 8191.5 FORMAT "%8.3" ECU_ADDRESS 0x803388 /end MEASUREMENT
/begin MEASUREMENT ddv "maximaler Raddrehzahlgradient Vorderachse" UWORD DC_URD_05 1 100 0 8191.5 FORMAT "%8.3" ECU_ADDRESS 0x80338A /end MEASUREMENT
/begin MEASUREMENT ddvl "Absolutwert Raddrehzahlgradientvorne links" UWORD DC_URD_05 1 100 0 8191.5 FORMAT "%8.3" ECU_ADDRESS 0x80338C /end MEASUREMENT
/begin MEASUREMENT ddvr "Absolutwert Raddrehzahlgradient vorne rechts" UWORD DC_URD_05 1 100 0 32767.5 FORMAT "%8.2" ECU_ADDRESS 0x80338E /end MEASUREMENT
/begin MEASUREMENT dfh_unfil "Fahrzeuggeschwindigkeit hinten, ungefiltert in km/h" UWORD DC_VEHSPD_KMH_U16 1 100 0 300 FORMAT "%8.4" ECU_ADDRESS 0x803390 /end MEASUREMENT
/begin MEASUREMENT dfv_diff "Radgeschwindigkeits-Gradient vorne" SWORD DC_VQV16_S16 1 100 -5 5 FORMAT "%8.6" ECU_ADDRESS 0x803392 /end MEASUREMENT
/begin MEASUREMENT dfv_unfil "Fahrzeuggeschwindigkeit vorn, ungefiltert in km/h" UWORD DC_VEHSPD_KMH_U16 1 100 0 300 FORMAT "%8.4" ECU_ADDRESS 0x803394 /end MEASUREMENT
/begin MEASUREMENT dhr_uv "ungefilterte Radgeschwindigkeit hinten rechts" UWORD DC_VEHSPD_KMH_U16 1 100 0 300 FORMAT "%8.4" ECU_ADDRESS 0x803396 /end MEASUREMENT
/begin MEASUREMENT dhr_v "gefilterte Radgeschwindigkeit hinten rechts" UWORD DC_VEHSPD_KMH_U16 1 100 0 300 FORMAT "%8.4" ECU_ADDRESS 0x803398 /end MEASUREMENT
/begin MEASUREMENT drinlsu2_w "Differenz zwischen Soll- und Istwert f¸r RICAL w‰hrend des Abgleiches, Bank 2" SWORD r_q0p0391 1 100 -1280 1279.96 FORMAT "%8.3" ECU_ADDRESS 0x800960 /end MEASUREMENT
/begin MEASUREMENT drinlsu_w "Differenz zwischen Soll- und Istwert f¸r RICAL w‰hrend des Abgleiches" SWORD r_q0p0391 1 100 -1280 1279.96 FORMAT "%8.3" ECU_ADDRESS 0x800962 /end MEASUREMENT
/begin MEASUREMENT dua10g2_w "Verst‰rkung korrigierte Sondenspannung vor Kat einer Breitbandlambdasonde Bank 2" SWORD spg_q4p88Em4 1 100 -16 15.9995 FORMAT "%8.5" ECU_ADDRESS 0x801A72 /end MEASUREMENT
/begin MEASUREMENT dua10g_w "Verst‰rkung korrigierte Sondenspannung vor Kat einer Breitbandlambdasonde" SWORD spg_q4p88Em4 1 100 -16 15.9995 FORMAT "%8.5" ECU_ADDRESS 0x801A74 /end MEASUREMENT
/begin MEASUREMENT dvl_aus "Auswahl aus dvl und dfv_roh" UWORD DC_URD_05 1 100 0 8191.5 FORMAT "%8.3" ECU_ADDRESS 0x80339A /end MEASUREMENT
/begin MEASUREMENT dvl_n "plausibilisierte Raddrehzahl vorne" UWORD DC_URD_05 1 100 0 8191.5 FORMAT "%8.3" ECU_ADDRESS 0x80339C /end MEASUREMENT
/begin MEASUREMENT dvl_v "gefilterte Radgeschwindigkeit vorne linls" UWORD DC_VEHSPD_KMH_U16 1 100 0 300 FORMAT "%8.4" ECU_ADDRESS 0x80339E /end MEASUREMENT
/begin MEASUREMENT dvr_uv "ungefilterte Radgeschwindigkeit vorne rechts" UWORD DC_VEHSPD_KMH_U16 1 100 0 300 FORMAT "%8.4" ECU_ADDRESS 0x8033A0 /end MEASUREMENT
/begin MEASUREMENT dvr_v "gefilterte Radgeschwindigkeit vorne rechts" UWORD DC_VEHSPD_KMH_U16 1 100 0 300 FORMAT "%8.4" ECU_ADDRESS 0x8033A2 /end MEASUREMENT
/begin MEASUREMENT dwdkba_w "Gradient DK-Winkel" SWORD relDK_q0p02441 1 100 -800 799.976 FORMAT "%8.4" ECU_ADDRESS 0x8014CE /end MEASUREMENT
/begin MEASUREMENT fkhfm "HFM-Korrekturfaktor" UBYTE fak_ub_b2 1 100 0 1.99219 FORMAT "%5.3" ECU_ADDRESS 0x8010AA /end MEASUREMENT
/begin MEASUREMENT fkpmhfm_w "Korrekturfaktor Periodendauer f¸r Massenstrom aus HFM" UWORD fak_uw_b2 1 100 0 1.99997 FORMAT "%8.6" ECU_ADDRESS 0x7FC318 /end MEASUREMENT
/begin MEASUREMENT fmfkrako_w "alte Filterauswahl Klopfregelung" UWORD dez 1 100 0 65535 FORMAT "%8.2" ARRAY_SIZE 8 ECU_ADDRESS 0x801AF6 /end MEASUREMENT
/begin MEASUREMENT fmfkrakt_w "Filterauswahl f¸r Klopfregelung" UWORD dez 1 100 0 65535 FORMAT "%8.2" ECU_ADDRESS 0x801B06 /end MEASUREMENT
/begin MEASUREMENT fmfkrc "Filtermittenfrequenz des CC195/CC650 umgeschaltet" UBYTE dez 1 100 0 255 FORMAT "%5.1" ECU_ADDRESS 0x800F74 /end MEASUREMENT
/begin MEASUREMENT fpuk "HFM-Korrekturfaktor im Pulsationsbereich" UBYTE fak_ub_b2 1 100 0 1.99219 FORMAT "%5.3" ECU_ADDRESS 0x8010AB /end MEASUREMENT
/begin MEASUREMENT fst1fdg_w "Gefilterter Prim‰rtank-F¸llstand f¸r Diagnose" UWORD vol_q0p1_l 1 100 0 6553.5 FORMAT "%8.3" ECU_ADDRESS 0x800C40 /end MEASUREMENT
/begin MEASUREMENT fst1fdp_w "Gefilterter Prim‰rtank-F¸llstand f¸r Anzeige" UWORD vol_q0p1_l 1 100 0 6553.5 FORMAT "%8.3" ECU_ADDRESS 0x800C42 /end MEASUREMENT
/begin MEASUREMENT fst2fdg_w "Gefilterter Sekund‰rtank-F¸llstand f¸r Diagnose" UWORD vol_q0p1_l 1 100 0 6553.5 FORMAT "%8.3" ECU_ADDRESS 0x800C44 /end MEASUREMENT
/begin MEASUREMENT fst2fdp_w "Gefilterter Sekund‰rtank-F¸llstand f¸r Anzeige" UWORD vol_q0p1_l 1 100 0 6553.5 FORMAT "%8.3" ECU_ADDRESS 0x800C46 /end MEASUREMENT
/begin MEASUREMENT fstadg_w "Akkumuliertes Kraftstoffvolumen im Status 2 f¸r Diagnose" UWORD vol_q0p1_l 1 100 0 6553.5 FORMAT "%8.3" ECU_ADDRESS 0x7FC7C4 /end MEASUREMENT
/begin MEASUREMENT fstadp_w "Akkumuliertes Kraftstoffvolumen im Status 2 f¸r Anzeige" UWORD vol_q0p1_l 1 100 0 6553.5 FORMAT "%8.3" ECU_ADDRESS 0x7FC7C6 /end MEASUREMENT
/begin MEASUREMENT fstfdg_w "Gefiltertes Zweitank-Kraftstoffvolumen f¸r Diagnose" UWORD vol_q0p1_l 1 100 0 6553.5 FORMAT "%8.3" ECU_ADDRESS 0x800C48 /end MEASUREMENT
/begin MEASUREMENT fstfdp "Gefiltertes Zweitank-Kraftstoffvolumen f¸r Anzeige" UBYTE vol_q0p5_l 1 100 0 127.5 FORMAT "%5.1" ECU_ADDRESS 0x800C34 /end MEASUREMENT
/begin MEASUREMENT fstgv_w "Luftvolumen im Doppeltank f¸r Diagnose" UWORD vol_q0p1_l 1 100 0 6553.5 FORMAT "%8.3" ECU_ADDRESS 0x800C4A /end MEASUREMENT
/begin MEASUREMENT fstkvbdg_w "ƒquivalenter Kraftstoffverbrauch zu Beginn von Status 2 f¸r Diagnose" SWORD vol_q0p0039 1 100 -128 127.996 FORMAT "%8.4" ECU_ADDRESS 0x800C4C /end MEASUREMENT
/begin MEASUREMENT fstkvbdp_w "ƒquivalenter Kraftstoffverbrauch zu Beginn von Status 2 f¸r Anzeige" SWORD vol_q0p0039 1 100 -128 127.996 FORMAT "%8.4" ECU_ADDRESS 0x800C4E /end MEASUREMENT
/begin MEASUREMENT fststdg "Aktuelle Statusnummer des F¸llstandes f¸r Diagnose" UBYTE dez 1 100 0 255 FORMAT "%5.1" ECU_ADDRESS 0x800C35 /end MEASUREMENT
/begin MEASUREMENT fststdgp "Temporaere Statusnummer des F¸llstandes f¸r Diagnose" UBYTE dez 1 100 0 255 FORMAT "%5.1" ECU_ADDRESS 0x800C36 /end MEASUREMENT
/begin MEASUREMENT fststdp "Aktuelle Statusnummer des F¸llstandes f¸r Anzeige" UBYTE dez 1 100 0 255 FORMAT "%5.1" ECU_ADDRESS 0x800C37 /end MEASUREMENT
/begin MEASUREMENT fststdpp "Temporaere Statusnummer des F¸llstandes f¸r Anzeige" UBYTE dez 1 100 0 255 FORMAT "%5.1" ECU_ADDRESS 0x800C38 /end MEASUREMENT
/begin MEASUREMENT fstt1 "ungefilterter Fuellstand Kraftstofftank 1" UBYTE vol_q0p5_l 1 100 0 127.5 FORMAT "%5.1" ECU_ADDRESS 0x800C39 /end MEASUREMENT
/begin MEASUREMENT fstt2 "ungefilterter Fuellstand Kraftstofftank2" UBYTE vol_q0p5_l 1 100 0 127.5 FORMAT "%5.1" ECU_ADDRESS 0x800C3A /end MEASUREMENT
/begin MEASUREMENT fsttdg_w "Ungefiltertes Zweitank-Kraftstoffvolumen f¸r Diagnose" UWORD vol_q0p1_l 1 100 0 6553.5 FORMAT "%8.3" ECU_ADDRESS 0x800C50 /end MEASUREMENT
/begin MEASUREMENT fsttdp_w "Ungefiltertes Zweitank-Kraftstoffvolumen f¸r Anzeige" UWORD vol_q0p1_l 1 100 0 6553.5 FORMAT "%8.3" ECU_ADDRESS 0x800C52 /end MEASUREMENT
/begin MEASUREMENT fsttmax "Tank-Kapazitaet" UBYTE vol_q0p5_l 1 100 0 127.5 FORMAT "%5.1" ECU_ADDRESS 0x8011D8 /end MEASUREMENT
/begin MEASUREMENT fsttmax_w "Tank-Kapazitaet" UWORD vol_q0p1_l 1 100 0 6553.5 FORMAT "%8.3" ECU_ADDRESS 0x8017AA /end MEASUREMENT
/begin MEASUREMENT fsttpro "Tankfuellstand in Prozent" UBYTE rel_ub_b100 1 100 0 99.6094 FORMAT "%5.2" ECU_ADDRESS 0x800C3B /end MEASUREMENT
/begin MEASUREMENT fstu_w "Tankf¸llstand (16-Bit)" UWORD vol_q0p1_l 1 100 0 6553.5 FORMAT "%8.3" ECU_ADDRESS 0x800C54 /end MEASUREMENT
/begin MEASUREMENT fvst_w "Faktor Vorsteuerung" UWORD fak_uw_b64 1 100 0 63.999 FORMAT "%8.5" ECU_ADDRESS 0x80173A /end MEASUREMENT
/begin MEASUREMENT ggo2lsuAusBits10ms "" UBYTE dez 1 100 0 255 FORMAT "%5.1" ECU_ADDRESS 0x800F33 /end MEASUREMENT
/begin MEASUREMENT ggo2lsuAusBits10ms_2 "" UBYTE dez 1 100 0 255 FORMAT "%5.1" ECU_ADDRESS 0x800F34 /end MEASUREMENT
/begin MEASUREMENT ggo2lsuLokBits10ms "" UBYTE dez 1 100 0 255 FORMAT "%5.1" ECU_ADDRESS 0x800F35 /end MEASUREMENT
/begin MEASUREMENT ggrtlsuAusBits10ms "" UBYTE dez 1 100 0 255 FORMAT "%5.1" ECU_ADDRESS 0x80097C /end MEASUREMENT
/begin MEASUREMENT ggrtlsuAusBits10ms_2 "" UBYTE dez 1 100 0 255 FORMAT "%5.1" ECU_ADDRESS 0x80097D /end MEASUREMENT
/begin MEASUREMENT ggrtlsuLokBits10ms "" UBYTE dez 1 100 0 255 FORMAT "%5.1" ECU_ADDRESS 0x80097E /end MEASUREMENT
/begin MEASUREMENT gspsz "Schaltzahl an elektron. GS ¸ber CAN" UBYTE dez 1 100 0 255 FORMAT "%5.1" ECU_ADDRESS 0x8008FA /end MEASUREMENT
/begin MEASUREMENT hfm6_m_state_ub "" UBYTE dez 1 100 0 255 FORMAT "%5.1" ECU_ADDRESS 0x8010A5 /end MEASUREMENT
/begin MEASUREMENT hfm6_T_state_ub "" UBYTE dez 1 100 0 255 FORMAT "%5.1" ECU_ADDRESS 0x8010A6 /end MEASUREMENT
/begin MEASUREMENT hrlsuAusBits "" UBYTE dez 1 100 0 255 FORMAT "%5.1" ECU_ADDRESS 0x8009A6 /end MEASUREMENT
/begin MEASUREMENT hrlsuAusBits_2 "" UBYTE dez 1 100 0 255 FORMAT "%5.1" ECU_ADDRESS 0x8009A7 /end MEASUREMENT
/begin MEASUREMENT hrlsuLokBits "" UBYTE dez 1 100 0 255 FORMAT "%5.1" ECU_ADDRESS 0x8009A8 /end MEASUREMENT
/begin MEASUREMENT hrlsuLokBits_2 "" UBYTE dez 1 100 0 255 FORMAT "%5.1" ECU_ADDRESS 0x8009A9 /end MEASUREMENT
/begin MEASUREMENT iintpid2_w "Initialisierungswert f¸r den Integrator INTPID2 des PID-Reglers, Bank 2" UWORD rel_uw_b200 1 100 0 99.9969 FORMAT "%8.5" ECU_ADDRESS 0x800984 /end MEASUREMENT
/begin MEASUREMENT iintpid_w "Initialisierungswert f¸r den Integrator INTPID des PID-Reglers" UWORD rel_uw_b200 1 100 0 99.9969 FORMAT "%8.5" ECU_ADDRESS 0x800986 /end MEASUREMENT
/begin MEASUREMENT ikrmen_w "Integratorwert Klopfregelung Meﬂfensterende Nulltest" UWORD spg_uw_q0p000076 1 100 0 4.99992 FORMAT "%8.6" ECU_ADDRESS 0x801B08 /end MEASUREMENT
/begin MEASUREMENT ikrmet_w "Integratorwert Klopfregelung Meﬂfensterende Testimpuls" UWORD spg_uw_q0p000076 1 100 0 4.99992 FORMAT "%8.6" ECU_ADDRESS 0x801B0A /end MEASUREMENT
/begin MEASUREMENT ikr_tst_w "Integratorwert Klopfregelung offsetkorregiert rollierend mit Zyl.z‰hler" UWORD spg_uw_q0p000076 1 100 0 4.99992 FORMAT "%8.6" ECU_ADDRESS 0x801B0C /end MEASUREMENT
/begin MEASUREMENT ikr_w "Integratorwert Klopfregelung offsetkorrigiert" UWORD spg_uw_q0p000076 1 100 0 4.99992 FORMAT "%8.6" ARRAY_SIZE 8 ECU_ADDRESS 0x801B0E /end MEASUREMENT
/begin MEASUREMENT ipiprk2_w "Pumpstrom IP LSU 2, korrigiert um Referenzpumpstrom" SWORD i_q1_uA 1 100 -32768 32767 FORMAT "%8.2" ECU_ADDRESS 0x801A7A /end MEASUREMENT
/begin MEASUREMENT ipiprk_w "Pumpstrom IP LSU, korrigiert um Referenzpumpstrom" SWORD i_q1_uA 1 100 -32768 32767 FORMAT "%8.2" ECU_ADDRESS 0x801A7C /end MEASUREMENT
/begin MEASUREMENT ipkorp2_w "Pumpstrom IP LSU 2, druckkorrigiert" SWORD i_q1_uA 1 100 -32768 32767 FORMAT "%8.2" ECU_ADDRESS 0x801A7E /end MEASUREMENT
/begin MEASUREMENT ipkorp_w "Pumpstrom IP LSU, druckkorrigiert" SWORD i_q1_uA 1 100 -32768 32767 FORMAT "%8.2" ECU_ADDRESS 0x801A80 /end MEASUREMENT
/begin MEASUREMENT ipktk2_w "Pumpstrom IP LSU 2, temperaturkorrigiert" SWORD i_q1_uA 1 100 -32768 32767 FORMAT "%8.2" ECU_ADDRESS 0x801A82 /end MEASUREMENT
/begin MEASUREMENT ipktk_w "Pumpstrom IP LSU, temperaturkorrigiert" SWORD i_q1_uA 1 100 -32768 32767 FORMAT "%8.2" ECU_ADDRESS 0x801A84 /end MEASUREMENT
/begin MEASUREMENT iplsuvj2_w "Pumpstrom IP LSU2" UWORD dez 1 100 0 65535 FORMAT "%8.2" ECU_ADDRESS 0x80094C /end MEASUREMENT
/begin MEASUREMENT iplsuvj_w "Pumpstrom IP LSU" UWORD dez 1 100 0 65535 FORMAT "%8.2" ECU_ADDRESS 0x80094E /end MEASUREMENT
/begin MEASUREMENT iproh2_w "Pumpstrom IP LSU 2, Rohwert" SWORD i_q1_uA 1 100 -32768 32767 FORMAT "%8.2" ECU_ADDRESS 0x801A86 /end MEASUREMENT
/begin MEASUREMENT iproh_w "Pumpstrom IP LSU, Rohwert" SWORD i_q1_uA 1 100 -32768 32767 FORMAT "%8.2" ECU_ADDRESS 0x801A88 /end MEASUREMENT
/begin MEASUREMENT koeffadr_w "Filterkoeffizientenadresse Klopfregelung" UWORD dez 1 100 0 499 FORMAT "%8.4" ECU_ADDRESS 0x801B1E /end MEASUREMENT
/begin MEASUREMENT korrfak "" UBYTE fak_ub_b2 1 100 0 1.99219 FORMAT "%5.3" ECU_ADDRESS 0x800CB3 /end MEASUREMENT
/begin MEASUREMENT krdizust "Diagnosezustand Klopfregelung" UBYTE dez 1 100 0 11 FORMAT "%5.2" ECU_ADDRESS 0x800F75 /end MEASUREMENT
/begin MEASUREMENT kricdiag "Zustand Diagnose SPI-Kommunikation Klopfregelung" UBYTE dez 1 100 0 7 FORMAT "%5.3" ECU_ADDRESS 0x800F76 /end MEASUREMENT
/begin MEASUREMENT kricstat "Statuswort Klopfsensorauswerte-IC" UBYTE dez 1 100 0 255 FORMAT "%5.1" ECU_ADDRESS 0x800F77 /end MEASUREMENT
/begin MEASUREMENT krintka1_w "Integratorergebnis Kanal 1" UWORD spg_uw_q0p000076 1 100 0 4.99992 FORMAT "%8.6" ARRAY_SIZE 8 ECU_ADDRESS 0x801B20 /end MEASUREMENT
/begin MEASUREMENT krintka2_w "Integratorergebnis Kanal 2" UWORD spg_uw_q0p000076 1 100 0 4.99992 FORMAT "%8.6" ARRAY_SIZE 8 ECU_ADDRESS 0x801B30 /end MEASUREMENT
/begin MEASUREMENT krintka3_w "Integrationsergebnis Kanal 3" UWORD spg_uw_q0p000076 1 100 0 4.99992 FORMAT "%8.6" ARRAY_SIZE 8 ECU_ADDRESS 0x801B40 /end MEASUREMENT
/begin MEASUREMENT krivk2_w "Korrekturwert f¸r den Innenwiderstand der Nernstzelle der LSU 2" SWORD r_q0p0391 1 100 -1280 1279.96 FORMAT "%8.3" ECU_ADDRESS 0x7FC74E /end MEASUREMENT
/begin MEASUREMENT krivk_w "Korrekturwert f¸r den Innenwiderstand der Nernstzelle der LSU" SWORD r_q0p0391 1 100 -1280 1279.96 FORMAT "%8.3" ECU_ADDRESS 0x7FC750 /end MEASUREMENT
/begin MEASUREMENT krkserr "Status Klopfsensor Kurzschluﬂerkennung CC196" UBYTE dez 1 100 0 255 FORMAT "%5.1" ECU_ADDRESS 0x800F78 /end MEASUREMENT
/begin MEASUREMENT krreadr_w "Klopfregelung: Adresse des fehlerhaften Koeffizienten" UWORD dez 1 100 0 499 FORMAT "%8.4" ECU_ADDRESS 0x801B50 /end MEASUREMENT
/begin MEASUREMENT krrein1_l "Integratorergebnis Kanal 1 CC196" ULONG dez 1 100 0 4.29497e+009 FORMAT "%13.2" ECU_ADDRESS 0x801DD8 /end MEASUREMENT
/begin MEASUREMENT krrein2_l "Integrationsergebnis Kanal 2 CC196" ULONG dez 1 100 0 4.29497e+009 FORMAT "%13.2" ECU_ADDRESS 0x801DDC /end MEASUREMENT
/begin MEASUREMENT krrein3_l "Integrationsergebnis Kanal 3 CC196" ULONG dez 1 100 0 4.29497e+009 FORMAT "%13.2" ECU_ADDRESS 0x801DE0 /end MEASUREMENT
/begin MEASUREMENT krreko "Klopfregelung: Ergebnis der Koeffizienten¸bertragung" UBYTE dez 1 100 0 1 FORMAT "%5.3" ECU_ADDRESS 0x800F79 /end MEASUREMENT
/begin MEASUREMENT krrest "Klopfregelung: Ergebnis ‹bertragung der Steuerdaten" UBYTE dez 1 100 0 1 FORMAT "%5.3" ECU_ADDRESS 0x800F7A /end MEASUREMENT
/begin MEASUREMENT krseappl "Botschaft Klopfregelung Applikationsschnittstelle CC196" UBYTE dez 1 100 0 1 FORMAT "%5.3" ECU_ADDRESS 0x800F7B /end MEASUREMENT
/begin MEASUREMENT krsefmf_w "Botschaft Klopfregelung Filterauswahl" UWORD dez 1 100 0 65535 FORMAT "%8.2" ECU_ADDRESS 0x801B52 /end MEASUREMENT
/begin MEASUREMENT krsekoanz "Botschaft Klopfregelung: Anzahl der Koeffizienten" UBYTE dez 1 100 0 10 FORMAT "%5.2" ECU_ADDRESS 0x800F7C /end MEASUREMENT
/begin MEASUREMENT krsekoeff_w "" UWORD dez 1 100 0 499 FORMAT "%8.4" ECU_ADDRESS 0x801B54 /end MEASUREMENT
/begin MEASUREMENT krsemode "Botschaft Klopfregelung: CC196 modus" UBYTE dez 1 100 0 3 FORMAT "%5.3" ECU_ADDRESS 0x800F7D /end MEASUREMENT
/begin MEASUREMENT krsemux "Botschaft Klopfregelung: Multiplexereinstellung" UBYTE dez 1 100 0 4 FORMAT "%5.3" ECU_ADDRESS 0x800F7E /end MEASUREMENT
/begin MEASUREMENT krsevkr "Botschaft Klopfregelung: Verst‰rkereintstellung" UBYTE dez 1 100 0 3 FORMAT "%5.3" ECU_ADDRESS 0x800F7F /end MEASUREMENT
/begin MEASUREMENT krsperr "Z‰hler f¸r die Sperrung der Klopferkennung" UBYTE dez 1 100 0 7 FORMAT "%5.3" ECU_ADDRESS 0x800F80 /end MEASUREMENT
/begin MEASUREMENT kr_koanz "Anzahl der  zu ¸bertragenden Koeffizienten" UBYTE dez 1 100 0 10 FORMAT "%5.2" ECU_ADDRESS 0x800F81 /end MEASUREMENT
/begin MEASUREMENT kr_mode "Modus des CC196" UBYTE dez 1 100 0 7 FORMAT "%5.3" ECU_ADDRESS 0x800F82 /end MEASUREMENT
/begin MEASUREMENT kr_monitor "Aktivierung von KR-Funktionen; Anzeige des Ist-Zustandes" UBYTE dez 1 100 0 7 FORMAT "%5.3" ECU_ADDRESS 0x800F83 /end MEASUREMENT
/begin MEASUREMENT ks_sym "Eingang des Klopfauswerte-IC" UBYTE dez 1 100 0 7 FORMAT "%5.3" ARRAY_SIZE 4 ECU_ADDRESS 0x800C88 /end MEASUREMENT
/begin MEASUREMENT ktkvk2_w "Pumpstromkorrekturfaktor in Abh‰ngigkeit der Keramiktemperatur der LSU, Bank 2" UWORD fak_uw_b2 1 100 0 1.99997 FORMAT "%8.6" ECU_ADDRESS 0x800968 /end MEASUREMENT
/begin MEASUREMENT ktkvk_w "Pumpstromkorrekturfaktor in Abh‰ngigkeit der Keramiktemperatur der LSU" UWORD fak_uw_b2 1 100 0 1.99997 FORMAT "%8.6" ECU_ADDRESS 0x80096A /end MEASUREMENT
/begin MEASUREMENT kusvk2_w "Korrekturwert der LSU-Spannung vor Kat Bank2" SWORD spg_q4p88Em4 1 100 -16 15.9995 FORMAT "%8.5" ECU_ADDRESS 0x7FC742 /end MEASUREMENT
/begin MEASUREMENT kusvkft2_w "Korrekturwert der LSU-Spannung vor Kat f¸r Fettkennlinie, Bank 2" SWORD spg_q4p88Em4 1 100 -16 15.9995 FORMAT "%8.5" ECU_ADDRESS 0x7FC744 /end MEASUREMENT
/begin MEASUREMENT kusvkft_w "Korrekturwert der LSU-Spannung vor Kat f¸r Fettkennlinie" SWORD spg_q4p88Em4 1 100 -16 15.9995 FORMAT "%8.5" ECU_ADDRESS 0x7FC746 /end MEASUREMENT
/begin MEASUREMENT kusvk_w "Korrekturwert der LSU-Spannung vor Kat" SWORD spg_q4p88Em4 1 100 -16 15.9995 FORMAT "%8.5" ECU_ADDRESS 0x7FC748 /end MEASUREMENT
/begin MEASUREMENT lbkist "Iststellung der Ladungsbewegungsklappenposition" UBYTE rel_q0p39 1 100 0 99.6094 FORMAT "%5.2" ECU_ADDRESS 0x8010C1 /end MEASUREMENT
/begin MEASUREMENT lbkistu_w "LBK Ist-Position ohne Beschr‰nkung auf Bereich 0-100%" SWORD rel_sw_q0p02441 1 100 -800 799.976 FORMAT "%8.4" ECU_ADDRESS 0x801428 /end MEASUREMENT
/begin MEASUREMENT lbkist_w "Iststellung der Ladungsbewegungsklappenposition (word)" UWORD rel_uw_b100 1 100 0 99.9985 FORMAT "%8.5" ECU_ADDRESS 0x80142A /end MEASUREMENT
/begin MEASUREMENT LongAccel "" SBYTE DC_UAFZ_S8 1 100 -5.5552 5.5118 FORMAT "%5.3" ECU_ADDRESS 0x8039A6 /end MEASUREMENT
/begin MEASUREMENT LongAccel_BRD "" UBYTE DC_UBESCH 1 100 0 255 FORMAT "%5.1" ECU_ADDRESS 0x8039A7 /end MEASUREMENT
/begin MEASUREMENT lsukorp2_w "Faktor f¸r Druckkorrektur LSU 2" UWORD fak_uw_b2 1 100 0 1.99997 FORMAT "%8.6" ECU_ADDRESS 0x800950 /end MEASUREMENT
/begin MEASUREMENT lsukorp_w "Faktor f¸r Druckkorrektur LSU" UWORD fak_uw_b2 1 100 0 1.99997 FORMAT "%8.6" ECU_ADDRESS 0x800952 /end MEASUREMENT
/begin MEASUREMENT mlhfmofs "Luftmasse HFM-Mittelwert inklusive Offset ohne Korrekturfaktoren" UBYTE m_ub_b1020 1 100 0 1020 FORMAT "%5.0" ECU_ADDRESS 0x8010AC /end MEASUREMENT
/begin MEASUREMENT mll1 "Luftmassenfluﬂ bezogen auf lambda=1" UBYTE m_ub_b1020 1 100 0 1020 FORMAT "%5.0" ECU_ADDRESS 0x800CB4 /end MEASUREMENT
/begin MEASUREMENT MsgLost_NoPA_Mode "" UBYTE DC_FLAG_U8 1 100 0 1 BIT_MASK 0x1 FORMAT "%5.3" ECU_ADDRESS 0x8039A8 /end MEASUREMENT
/begin MEASUREMENT MsgLost_PA_Mode "" UBYTE DC_FLAG_U8 1 100 0 1 BIT_MASK 0x1 FORMAT "%5.3" ECU_ADDRESS 0x8039A9 /end MEASUREMENT
/begin MEASUREMENT mshfm1_w "Massenstrom HFM 16-Bit Grˆﬂe (1.HFM)" SWORD m_sw_b3276p8 1 100 -3276.8 3276.7 FORMAT "%8.3" ECU_ADDRESS 0x7FAA26 /end MEASUREMENT
/begin MEASUREMENT mshfma_w "Luftmassenabtastwert von HFM 16-Bit" SWORD m_sw_b3276p8 1 100 -3276.8 3276.7 FORMAT "%8.3" ECU_ADDRESS 0x7FAA28 /end MEASUREMENT
/begin MEASUREMENT mshfmm_w "Luftmassen HFM-Mittelwert 16Bit-Wert" SWORD m_sw_b3276p8 1 100 -3276.8 3276.7 FORMAT "%8.3" ECU_ADDRESS 0x7FAA2A /end MEASUREMENT
/begin MEASUREMENT mshfms_w "Massenstrom HFM (signed Grˆﬂe)" SWORD m_sw_b3276p8 1 100 -3276.8 3276.7 FORMAT "%8.3" ECU_ADDRESS 0x7FAA2C /end MEASUREMENT
/begin MEASUREMENT mshfm_w "Massenstrom HFM 16-Bit Grˆﬂe" UWORD m_uw_b6553p5 1 100 0 6553.5 FORMAT "%8.3" ECU_ADDRESS 0x7FAA2E /end MEASUREMENT
/begin MEASUREMENT nmotkor "Motordrehzahl ansaugluftkorrigiert (zur Pulsationskorrektur)" UBYTE nmot_ub_q40 1 100 0 10200 FORMAT "%5.0" ECU_ADDRESS 0x8010AD /end MEASUREMENT
/begin MEASUREMENT o2vk2_w "O2- ‹berschuss bzw. _O2- Mangel der LSU 2 im Abgas bezogen auf Lambda = 1" SWORD relO2_q9p765Em4 1 100 -32 31.999 FORMAT "%8.5" ECU_ADDRESS 0x801A8A /end MEASUREMENT
/begin MEASUREMENT o2vk_w "O2- ‹berschuss bzw. _O2- Mangel der LSU im Abgas bezogen auf Lambda = 1" SWORD relO2_q9p765Em4 1 100 -32 31.999 FORMAT "%8.5" ECU_ADDRESS 0x801A8C /end MEASUREMENT
/begin MEASUREMENT palsu2_w "Absolutdruck Abgassystem 2" UWORD p_uw_q0p039 1 100 0 2559.96 FORMAT "%8.3" ECU_ADDRESS 0x800954 /end MEASUREMENT
/begin MEASUREMENT palsu_w "Absolutdruck Abgassystem" UWORD p_uw_q0p039 1 100 0 2559.96 FORMAT "%8.3" ECU_ADDRESS 0x800956 /end MEASUREMENT
/begin MEASUREMENT pg1limfr_w "Maximale Fr¸hposition der Nockenwellenflanke 0 von PG" UWORD kw_q0p1 1 100 0 6553.5 FORMAT "%8.3" ECU_ADDRESS 0x801C24 /end MEASUREMENT
/begin MEASUREMENT pg1limsp_w "Maximale Sp‰tposition der Nockenwellenflanke 0 von PG" UWORD kw_q0p1 1 100 0 6553.5 FORMAT "%8.3" ECU_ADDRESS 0x801C26 /end MEASUREMENT
/begin MEASUREMENT pg2limfr_w "Maximale Fr¸hposition der Nockenwellenflanke 0 von PG2" UWORD kw_q0p1 1 100 0 6553.5 FORMAT "%8.3" ECU_ADDRESS 0x801C28 /end MEASUREMENT
/begin MEASUREMENT pg2limsp_w "Maximale Sp‰tposition der Nockenwellenflanke 0 von PG2" UWORD kw_q0p1 1 100 0 6553.5 FORMAT "%8.3" ECU_ADDRESS 0x801C2A /end MEASUREMENT
/begin MEASUREMENT pg3limfr_w "Maximale Fr¸hposition der Nockenwellenflanke 0 von PG3" UWORD kw_q0p1 1 100 0 6553.5 FORMAT "%8.3" ECU_ADDRESS 0x801C2C /end MEASUREMENT
/begin MEASUREMENT pg3limsp_w "Maximale Sp‰tposition der Nockenwellenflanke 0 von PG3" UWORD kw_q0p1 1 100 0 6553.5 FORMAT "%8.3" ECU_ADDRESS 0x801C2E /end MEASUREMENT
/begin MEASUREMENT pg4limfr_w "Maximale Fr¸hposition der Nockenwellenflanke 0 von PG4" UWORD kw_q0p1 1 100 0 6553.5 FORMAT "%8.3" ECU_ADDRESS 0x801C30 /end MEASUREMENT
/begin MEASUREMENT pg4limsp_w "Maximale Sp‰tposition der Nockenwellenflanke 0 von PG4" UWORD kw_q0p1 1 100 0 6553.5 FORMAT "%8.3" ECU_ADDRESS 0x801C32 /end MEASUREMENT
/begin MEASUREMENT phlsnh "normierte Heizleistung der Lambdasonde hinter Kat" UBYTE fak_ub_q0p01 1 100 0 2.55 FORMAT "%5.3" ECU_ADDRESS 0x800900 /end MEASUREMENT
/begin MEASUREMENT phlsnh2 "normierte Heizleistung der Lambdasonde 2 hinter Kat" UBYTE fak_ub_q0p01 1 100 0 2.55 FORMAT "%5.3" ECU_ADDRESS 0x800901 /end MEASUREMENT
/begin MEASUREMENT prhlsub2_w "Relative Leistung f¸r Lambdasondenheizung zu Beginn der Aufheizphase, Bank 2" UWORD rel_uw_b200 1 100 0 199.997 FORMAT "%8.4" ECU_ADDRESS 0x800988 /end MEASUREMENT
/begin MEASUREMENT prhlsub_w "Relative Leistung f¸r Lambdasondenheizung zu Beginn der Aufheizphase" UWORD rel_uw_b200 1 100 0 199.997 FORMAT "%8.4" ECU_ADDRESS 0x80098A /end MEASUREMENT
/begin MEASUREMENT prhlsud2_w "D-Anteil der Stellgrˆﬂe des PID-Reglers aus %HRLSU, Bank 2" SWORD rel_sw_b100 1 100 -100 99.9969 FORMAT "%8.4" ECU_ADDRESS 0x80098C /end MEASUREMENT
/begin MEASUREMENT prhlsud_w "D-Anteil der Stellgrˆﬂe des PID-Reglers aus %HRLSU" SWORD rel_sw_b100 1 100 -100 99.9969 FORMAT "%8.4" ECU_ADDRESS 0x80098E /end MEASUREMENT
/begin MEASUREMENT prhlsui2_w "I-Anteil der Stellgrˆﬂe des PID-Reglers aus %HRLSU, Bank 2" SWORD rel_sw_b100 1 100 -100 99.9969 FORMAT "%8.4" ECU_ADDRESS 0x800990 /end MEASUREMENT
/begin MEASUREMENT prhlsuin_w "Relative Initialisierungsheizleistung f¸r Lambdasondenheizung" SWORD rel_q0p0061 1 100 0 100 FORMAT "%8.4" ECU_ADDRESS 0x800992 /end MEASUREMENT
/begin MEASUREMENT prhlsui_w "I-Anteil der Stellgrˆﬂe des PID-Reglers aus %HRLSU" SWORD rel_sw_b100 1 100 -100 99.9969 FORMAT "%8.4" ECU_ADDRESS 0x800994 /end MEASUREMENT
/begin MEASUREMENT prhlsup2_w "P-Anteil der Stellgrˆﬂe des PID-Reglers aus %HRLSU, Bank 2" SWORD rel_sw_b100 1 100 -100 99.9969 FORMAT "%8.4" ECU_ADDRESS 0x800996 /end MEASUREMENT
/begin MEASUREMENT prhlsup_w "P-Anteil der Stellgrˆﬂe des PID-Reglers aus %HRLSU" SWORD rel_sw_b100 1 100 -100 99.9969 FORMAT "%8.4" ECU_ADDRESS 0x800998 /end MEASUREMENT
/begin MEASUREMENT prhlsur2_w "Relative Heizleistung f¸r Lambdasondenheizung w‰hrend der Regelphase, Bank 2" UWORD rel_uw_b200 1 100 0 199.997 FORMAT "%8.4" ECU_ADDRESS 0x80099A /end MEASUREMENT
/begin MEASUREMENT prhlsur_w "Relative Heizleistung f¸r Lambdasondenheizung w‰hrend der Regelphase" UWORD rel_uw_b200 1 100 0 199.997 FORMAT "%8.4" ECU_ADDRESS 0x80099C /end MEASUREMENT
/begin MEASUREMENT prhrlsu2_w "Relative Heizleistungsanforderung f¸r Lambdasondenheizung, Bank 2" UWORD rel_uw_b200 1 100 0 199.997 FORMAT "%8.4" ECU_ADDRESS 0x80099E /end MEASUREMENT
/begin MEASUREMENT prhrlsu_w "Relative Heizleistungsanforderung f¸r Lambdasondenheizung" UWORD rel_uw_b200 1 100 0 199.997 FORMAT "%8.4" ECU_ADDRESS 0x8009A0 /end MEASUREMENT
/begin MEASUREMENT puans "Pulsationskorrektur in Abh‰ngigkeit von tans" UBYTE fak_ub_b2 1 100 0 1.99219 FORMAT "%5.3" ECU_ADDRESS 0x80058E /end MEASUREMENT
/begin MEASUREMENT qstartinf "Infomartionsbyte f¸r aktivierte Schnellstartmethoden" UBYTE dez 1 100 0 255 FORMAT "%5.1" ECU_ADDRESS 0x801045 /end MEASUREMENT
/begin MEASUREMENT rad_diff "Differenzumfang Vor- zu Hinterrrad" SWORD DC_UDFCPAR_S16DB 1 100 -2.08334 2.08328 FORMAT "%8.6" ECU_ADDRESS 0x8033A4 /end MEASUREMENT
/begin MEASUREMENT rdtklsu2_w "Regeldifferenz der Temperaturregelung f¸r die LSU, Bank 2" SWORD temp_q0p0234 1 100 -768 767.977 FORMAT "%8.4" ECU_ADDRESS 0x8009A2 /end MEASUREMENT
/begin MEASUREMENT rdtklsu_w "Regeldifferenz der Temperaturregelung f¸r die LSU" SWORD temp_q0p0234 1 100 -768 767.977 FORMAT "%8.4" ECU_ADDRESS 0x8009A4 /end MEASUREMENT
/begin MEASUREMENT rfstdg "Relativer Zweitank-F¸llstand f¸r Diagnose" UBYTE rel_ub_b100 1 100 0 99.6094 FORMAT "%5.2" ECU_ADDRESS 0x800C3E /end MEASUREMENT
/begin MEASUREMENT rfstsh "Relativer Zweitank Kraftstoff/Ablagerungs-Level f¸r Diagnose" UBYTE rel_ub_b100 1 100 0 99.6094 FORMAT "%5.2" ECU_ADDRESS 0x800C3F /end MEASUREMENT
/begin MEASUREMENT rinh2_w "Istwert (word) Innenwiderstand Ri-Nernstzelle der Lambdasonde hinter KAT Bank2" UWORD r_uw_q2 1 100 0 131070 FORMAT "%8.1" ECU_ADDRESS 0x801692 /end MEASUREMENT
/begin MEASUREMENT rinh_w "Istwert (word) Innenwiderstand Ri-Nernstzelle der Lambdasonde hinter KAT" UWORD r_uw_q2 1 100 0 131070 FORMAT "%8.1" ECU_ADDRESS 0x801694 /end MEASUREMENT
/begin MEASUREMENT rinlsu2_w "Innenwiderstand der Nernstzelle der LSU, Bank 2" UWORD r_q0p0391 1 100 0 2559.96 FORMAT "%8.3" ECU_ADDRESS 0x80096C /end MEASUREMENT
/begin MEASUREMENT rinlsuk2_w "Innenwiderstand der Nernstzelle der LSU 2, nicht gefiltert" UWORD r_q0p0391 1 100 0 2559.96 FORMAT "%8.3" ECU_ADDRESS 0x80096E /end MEASUREMENT
/begin MEASUREMENT rinlsuk_w "Innenwiderstand der Nernstzelle der LSU, nicht gefiltert" UWORD r_q0p0391 1 100 0 2559.96 FORMAT "%8.3" ECU_ADDRESS 0x800970 /end MEASUREMENT
/begin MEASUREMENT rinlsu_w "Innenwiderstand der Nernstzelle der LSU" UWORD r_q0p0391 1 100 0 2559.96 FORMAT "%8.3" ECU_ADDRESS 0x800972 /end MEASUREMENT
/begin MEASUREMENT rinofh2_w "Innenwiderstand (word) Ri Nernst ohne Filterung hinter KAT Bank2" UWORD r_uw_q2 1 100 0 131070 FORMAT "%8.1" ECU_ADDRESS 0x801696 /end MEASUREMENT
/begin MEASUREMENT rinofha2_w "Innenwiderstand (word) Ri Nernst (alter Wert) ohne Filterung hinter KAT Bank2" UWORD r_uw_q2 1 100 0 131070 FORMAT "%8.1" ECU_ADDRESS 0x801698 /end MEASUREMENT
/begin MEASUREMENT rinofha_w "Innenwiderstand (word) Ri Nernst (alter Wert) ohne Filterung hinter KAT" UWORD r_uw_q2 1 100 0 131070 FORMAT "%8.1" ECU_ADDRESS 0x80169A /end MEASUREMENT
/begin MEASUREMENT rinofh_w "Innenwiderstand (word) Ri Nernst ohne Filterung hinter KAT" UWORD r_uw_q2 1 100 0 131070 FORMAT "%8.1" ECU_ADDRESS 0x80169C /end MEASUREMENT
/begin MEASUREMENT rk2_w "relative Kraftstoffmasse Bank2" UWORD rel_uw_b3072 1 100 0 3071.95 FORMAT "%8.3" ECU_ADDRESS 0x80173C /end MEASUREMENT
/begin MEASUREMENT rkg2_w "relative Kraftstoffmasse gesamt, Bank2" UWORD rel_uw_b3072 1 100 0 3071.95 FORMAT "%8.3" ECU_ADDRESS 0x80173E /end MEASUREMENT
/begin MEASUREMENT rkg_w "relative Kraftstoffmasse gesamt" UWORD rel_uw_b3072 1 100 0 3071.95 FORMAT "%8.3" ECU_ADDRESS 0x801740 /end MEASUREMENT
/begin MEASUREMENT rk_w "relative Kraftstoffmasse" UWORD rel_uw_b3072 1 100 0 3071.95 FORMAT "%8.3" ECU_ADDRESS 0x801742 /end MEASUREMENT
/begin MEASUREMENT rllaso2_w "Relative F¸llung f¸r Lambdasollberechnung, Bank 2" UWORD rel_uw_q0p0234 1 100 0 1535.98 FORMAT "%8.3" ECU_ADDRESS 0x801744 /end MEASUREMENT
/begin MEASUREMENT rllaso_w "Relative F¸llung f¸r Lambdasollberechnung" UWORD rel_uw_q0p0234 1 100 0 1535.98 FORMAT "%8.3" ECU_ADDRESS 0x801746 /end MEASUREMENT
/begin MEASUREMENT rrinlsu2_w "Innenwiderstand der Nernstzelle der LSU 2, nicht korrigiert" UWORD r_q0p0391 1 100 0 2559.96 FORMAT "%8.3" ECU_ADDRESS 0x800974 /end MEASUREMENT
/begin MEASUREMENT rrinlsu_w "Innenwiderstand der Nernstzelle der LSU, nicht korrigiert" UWORD r_q0p0391 1 100 0 2559.96 FORMAT "%8.3" ECU_ADDRESS 0x800976 /end MEASUREMENT
/begin MEASUREMENT sen_c96 "Klopfsensoreingang am Klopfauswerte-IC" UBYTE dez 1 100 0 7 FORMAT "%5.3" ARRAY_SIZE 8 ECU_ADDRESS 0x800F84 /end MEASUREMENT
/begin MEASUREMENT state_line_m "" UBYTE dez 1 100 0 255 FORMAT "%5.1" ECU_ADDRESS 0x8010A8 /end MEASUREMENT
/begin MEASUREMENT state_line_T "" UBYTE dez 1 100 0 255 FORMAT "%5.1" ECU_ADDRESS 0x8010A9 /end MEASUREMENT
/begin MEASUREMENT stkrfmf "Index f¸r nmot-abh‰ngige Filtermittenfrequenz" UBYTE dez 1 100 0 3 FORMAT "%5.3" ECU_ADDRESS 0x800F8C /end MEASUREMENT
/begin MEASUREMENT sync_level "Meldung Synchronisations-Level des HWT" UBYTE dez 1 100 0 255 FORMAT "%5.1" ECU_ADDRESS 0x801046 /end MEASUREMENT
/begin MEASUREMENT tans "Ansaugluft - Temperatur" UBYTE temp_ub_q0p75_o48 1 100 -48 143.25 FORMAT "%5.1" ECU_ADDRESS 0x801213 /end MEASUREMENT
/begin MEASUREMENT tansab "Ansauglufttemperatur beim Abstellen" UBYTE temp_ub_q0p75_o48 1 100 -48 143.25 FORMAT "%5.1" ECU_ADDRESS 0x7FC7E4 /end MEASUREMENT
/begin MEASUREMENT tansabk_w "Ansauglufttemperatur beim Abstellen intern in Kelvin" UWORD temp_q0p0234_o273 1 100 -273.15 1262.83 FORMAT "%8.3" ECU_ADDRESS 0x7FC7E6 /end MEASUREMENT
/begin MEASUREMENT tansk_w "Ansaugluft - Temperatur in GrdC,  intern in Kelvin gerechnet" UWORD temp_q0p0234_o273 1 100 -273.15 1262.83 FORMAT "%8.3" ECU_ADDRESS 0x8017CC /end MEASUREMENT
/begin MEASUREMENT tanstv "Ansauglufttemperatur, umgerechnet aus Tastverh‰ltnis HFM6" UBYTE temp_ub_q0p75_o48 1 100 -48 143.25 FORMAT "%5.1" ECU_ADDRESS 0x800CAE /end MEASUREMENT
/begin MEASUREMENT tanstv_w "Ansauglufttemperatur, umgerechnet aus Tastverh‰ltnis HFM6" UWORD temp_q0p0038_o75 1 100 -75 174.996 FORMAT "%8.4" ECU_ADDRESS 0x800CB0 /end MEASUREMENT
/begin MEASUREMENT tdlrtm_w "Diagnosezeit f¸r ‹berschreitung Motortemperaturschwelle f¸r Lambda-Regelung" UWORD t100msxs_uw_b6553p5 1 100 0 6553.5 FORMAT "%8.3" ECU_ADDRESS 0x800CBC /end MEASUREMENT
/begin MEASUREMENT thhaist "Auszeit f¸r Sondenheizung hinter Kat" UBYTE t10msxs_ub_b2p55 1 100 0 2.55 FORMAT "%5.3" ECU_ADDRESS 0x800902 /end MEASUREMENT
/begin MEASUREMENT thhaist2 "Auszeit f¸r Sondenheizung2 hinter Kat" UBYTE t10msxs_ub_b2p55 1 100 0 2.55 FORMAT "%5.3" ECU_ADDRESS 0x800903 /end MEASUREMENT
/begin MEASUREMENT thhat "unkorrigierte Ausschaltzeit der Sondenheizung hinter Kat" UBYTE t10msxs_q0p01_o0p05 1 100 -0.05 2.5 FORMAT "%5.3" ECU_ADDRESS 0x800904 /end MEASUREMENT
/begin MEASUREMENT thhat2 "unkorrigierte Ausschaltzeit der Sondenheizung 2 hinter Kat" UBYTE t10msxs_q0p01_o0p05 1 100 -0.05 2.5 FORMAT "%5.3" ECU_ADDRESS 0x800905 /end MEASUREMENT
/begin MEASUREMENT tka "Temperatur Motork¸hlerausgang (K¸hlmittel)" UBYTE temp_ub_q0p75_o48 1 100 -48 143.25 FORMAT "%5.1" ECU_ADDRESS 0x801215 /end MEASUREMENT
/begin MEASUREMENT tkalin "Temperatur K¸hlerausgang linearisiert und umgerechnet" UBYTE temp_ub_q0p75_o48 1 100 -48 143.25 FORMAT "%5.1" ECU_ADDRESS 0x801216 /end MEASUREMENT
/begin MEASUREMENT tkerlsu2_w "Keramiktemperatur der LSU, Bank 2" UWORD temp_q0p0234_o273 1 100 -273.15 1262.83 FORMAT "%8.3" ECU_ADDRESS 0x800978 /end MEASUREMENT
/begin MEASUREMENT tkerlsu_w "Keramiktemperatur der LSU" UWORD temp_q0p0234_o273 1 100 -273.15 1262.83 FORMAT "%8.3" ECU_ADDRESS 0x80097A /end MEASUREMENT
/begin MEASUREMENT tmew "Motortemperatur-Ersatzwert aus Modell" UBYTE temp_ub_q0p75_o48 1 100 -48 143.25 FORMAT "%5.1" ECU_ADDRESS 0x800CB5 /end MEASUREMENT
/begin MEASUREMENT tmewab "Motortemperatur-Ersatzwert aus Modell beim Abstellen" UBYTE temp_ub_q0p75_o48 1 100 -48 143.25 FORMAT "%5.1" ECU_ADDRESS 0x7FC7E9 /end MEASUREMENT
/begin MEASUREMENT tmflt_w "Meﬂfensterl‰nge Klopfregelung Testimpuls" UWORD tus_uw_q3p2 1 100 0 100000 FORMAT "%8.1" ECU_ADDRESS 0x801B56 /end MEASUREMENT
/begin MEASUREMENT tmfl_w "Meﬂfensterl‰nge Klopfregelung" UWORD tus_uw_q3p2 1 100 0 100000 FORMAT "%8.1" ECU_ADDRESS 0x801B58 /end MEASUREMENT
/begin MEASUREMENT tmot "Motor-Temperatur" UBYTE temp_ub_q0p75_o48 1 100 -48 143.25 FORMAT "%5.1" ECU_ADDRESS 0x801214 /end MEASUREMENT
/begin MEASUREMENT tmotab "Motortemperatur beim Abstellen" UBYTE temp_ub_q0p75_o48 1 100 -48 143.25 FORMAT "%5.1" ECU_ADDRESS 0x7FC7EA /end MEASUREMENT
/begin MEASUREMENT tmotlin "Motortemperatur, linearisiert und umgerechnet" UBYTE temp_ub_q0p75_o48 1 100 -48 143.25 FORMAT "%5.1" ECU_ADDRESS 0x800CB6 /end MEASUREMENT
/begin MEASUREMENT tmotlinab "gemessene Motor-Abstelltemperatur, linearisiert und umgerechnet" UBYTE temp_ub_q0p75_o48 1 100 -48 143.25 FORMAT "%5.1" ECU_ADDRESS 0x7FC7E8 /end MEASUREMENT
/begin MEASUREMENT tmotlin_w "Motortemperatur, linearisiert und umgerechnet, 16Bit-Wort" UWORD temp_uw_q0p0029_o48 1 100 -48 143.997 FORMAT "%8.4" ECU_ADDRESS 0x800CBE /end MEASUREMENT
/begin MEASUREMENT tmotvt "Motortemperatur vor Tiefpaﬂfilter" UBYTE temp_ub_q0p75_o48 1 100 -48 143.25 FORMAT "%5.1" ECU_ADDRESS 0x800CB7 /end MEASUREMENT
/begin MEASUREMENT tmrw "Motortemperatur-Referenzwert aus Modell" UBYTE temp_ub_q0p75_o48 1 100 -48 143.25 FORMAT "%5.1" ECU_ADDRESS 0x800CB8 /end MEASUREMENT
/begin MEASUREMENT tmrwend "Endwert f¸r Referenzwert Motortemperatur-Modell" UBYTE temp_ub_q0p75_o48 1 100 -48 143.25 FORMAT "%5.1" ECU_ADDRESS 0x800CB9 /end MEASUREMENT
/begin MEASUREMENT tmst "Motorstarttemperatur" UBYTE temp_ub_q0p75_o48 1 100 -48 143.25 FORMAT "%5.1" ECU_ADDRESS 0x800CBA /end MEASUREMENT
/begin MEASUREMENT tn2 "Segmentzeit pro Z¸ndung" UWORD tus_uw_q3p2 1 100 0 209712 FORMAT "%8.1" ECU_ADDRESS 0x801B5A /end MEASUREMENT
/begin MEASUREMENT tnwia2_l "Zeit eines Systemtimers bei Eintreffen einer genutzten Ph.-flanke (Auslaﬂ,Bank2)" ULONG t_q1p024_ms 1 100 0 4.39805e+009 FORMAT "%13.2" ECU_ADDRESS 0x801E50 /end MEASUREMENT
/begin MEASUREMENT tnwia_l "Zeit eines Systemtimers bei Eintreffen einer genutzten Ph.-flanke (Auslaﬂ)" ULONG t_q1p024_ms 1 100 0 4.39805e+009 FORMAT "%13.2" ECU_ADDRESS 0x801E54 /end MEASUREMENT
/begin MEASUREMENT tnwie2_l "Zeit eines Systemtimers bei Eintreffen einer genutzten Ph.-flanke (Einlaﬂ,Bank2)" ULONG t_q1p024_ms 1 100 0 4.39805e+009 FORMAT "%13.2" ECU_ADDRESS 0x801E58 /end MEASUREMENT
/begin MEASUREMENT tnwie_l "Zeit eines Systemtimers bei Eintreffen einer genutzten Phasenflanke" ULONG t_q1p024_ms 1 100 0 4.39805e+009 FORMAT "%13.2" ECU_ADDRESS 0x801E5C /end MEASUREMENT
/begin MEASUREMENT tol "Motor-÷L-Temperatur" UBYTE temp_ub_q0p75_o48 1 100 -48 143.25 FORMAT "%5.1" ECU_ADDRESS 0x801217 /end MEASUREMENT
/begin MEASUREMENT tollin "(Motor-)Oeltemperatur, linearisiert und umgerechnet" UBYTE temp_ub_q0p75_o48 1 100 -48 143.25 FORMAT "%5.1" ECU_ADDRESS 0x801218 /end MEASUREMENT
/begin MEASUREMENT tpkhfm_w "Periodendauer f¸r Korrekturfaktor aus HFM" UWORD t_q0p002_ms 1 100 0 131.07 FORMAT "%8.4" ECU_ADDRESS 0x80058C /end MEASUREMENT
/begin MEASUREMENT tpkmhfm_w "Korrigierte Periodendauer f¸r Massenstrom aus HFM" UWORD t_q0p1_us 1 100 0 6553.5 FORMAT "%8.3" ECU_ADDRESS 0x7FAA30 /end MEASUREMENT
/begin MEASUREMENT tpmshfm_w "Peridendauer f¸r Massenstrom aus HFM" UWORD t_q0p1_us 1 100 0 6553.5 FORMAT "%8.3" ECU_ADDRESS 0x8013CC /end MEASUREMENT
/begin MEASUREMENT tpnt_aktiv "Aktivierung von KR-Funktionen" UBYTE dez 1 100 0 7 FORMAT "%5.3" ECU_ADDRESS 0x800F8D /end MEASUREMENT
/begin MEASUREMENT tseg_l "Winkel-Segmentzeit" ULONG t_q0p0001_ms 1 100 0 429497 FORMAT "%13.6" ECU_ADDRESS 0x801E70 /end MEASUREMENT
/begin MEASUREMENT tsg "Steuerger‰tetemperatur" UBYTE temp_ub_q0p75_o48 1 100 -48 143.25 FORMAT "%5.1" ECU_ADDRESS 0x800CC0 /end MEASUREMENT
/begin MEASUREMENT tumginp "Umgebungstemperatur als Eingangsgrˆﬂe f¸r Kennfeld KFDTMTU" UBYTE temp_ub_q0p75_o48 1 100 -48 143.25 FORMAT "%5.1" ECU_ADDRESS 0x800CBB /end MEASUREMENT
/begin MEASUREMENT tvtahfm_w "Tastverh‰ltnis f¸r Tans aus HFM6" UWORD fak_q1p526Em5 1 100 0 0.999985 FORMAT "%9.7" ECU_ADDRESS 0x8013CE /end MEASUREMENT
/begin MEASUREMENT ua10mo2_w "Offset korrigierte Sondenspannung vor Kat einer Breitbandlambdasonde Bank 2" UWORD spg_q4p88Em4 1 100 0 31.9995 FORMAT "%8.5" ECU_ADDRESS 0x801A8E /end MEASUREMENT
/begin MEASUREMENT ua10mo_w "Offset korrigierte Sondenspannung vor Kat einer Breitbandlambdasonde" UWORD spg_q4p88Em4 1 100 0 31.9995 FORMAT "%8.5" ECU_ADDRESS 0x801A90 /end MEASUREMENT
/begin MEASUREMENT ua10ms2_w "Sondenspannung vor Kat einer Breitbandlambdasonde Bank2 (Mittelwert ¸ber 10ms)" UWORD spg_q4p88Em4 1 100 0 31.9995 FORMAT "%8.5" ECU_ADDRESS 0x801A92 /end MEASUREMENT
/begin MEASUREMENT ua10msm2_w "Sondenspannung vor Kat einer Breitbandlambdasonde Bank2 (Mittelwert ¸ber 10ms)" UWORD spg_q4p88Em4 1 100 0 31.9995 FORMAT "%8.5" ECU_ADDRESS 0x801A94 /end MEASUREMENT
/begin MEASUREMENT ua10msm_w "Sondenspannung vor Kat einer Breitbandlambdasonde (Mittelwert ¸ber 10ms)" UWORD spg_q4p88Em4 1 100 0 31.9995 FORMAT "%8.5" ECU_ADDRESS 0x801A96 /end MEASUREMENT
/begin MEASUREMENT ua10ms_w "Sondenspannung vor Kat einer Breitbandlambdasonde (Mittelwert ¸ber 10ms)" UWORD spg_q4p88Em4 1 100 0 31.9995 FORMAT "%8.5" ECU_ADDRESS 0x801A98 /end MEASUREMENT
/begin MEASUREMENT ub "Batteriespannung" UBYTE spg_ubatt 1 100 0 24.021 FORMAT "%5.2" ECU_ADDRESS 0x80120B /end MEASUREMENT
/begin MEASUREMENT ubsq "Bordnetzspannung, umgerechnet in Standard-Quantisierung" UBYTE spg_q0p1 1 100 0 25.5 FORMAT "%5.2" ECU_ADDRESS 0x80120C /end MEASUREMENT
/begin MEASUREMENT ubsqf "Bordnetzspannung, umgerechnet in Standard-Quantisierung und gefiltert" UBYTE spg_q0p1 1 100 0 25.5 FORMAT "%5.2" ECU_ADDRESS 0x80120D /end MEASUREMENT
/begin MEASUREMENT ubsqf_w "Bordnetzspannung, umgerechnet in Standard-Quantisierung und gefiltert" UWORD spg_q0p00039 1 100 0 25.5996 FORMAT "%8.5" ECU_ADDRESS 0x8017BA /end MEASUREMENT
/begin MEASUREMENT ubsq_w "Bordnetzspannung, umgerechnet in Standard-Quantisierung" UWORD spg_q0p00039 1 100 0 25.5996 FORMAT "%8.5" ECU_ADDRESS 0x8017BC /end MEASUREMENT
/begin MEASUREMENT ub_w "Batteriespannung" UWORD spg_ubatt 1 100 0 6173.4 FORMAT "%8.3" ECU_ADDRESS 0x8017BE /end MEASUREMENT
/begin MEASUREMENT ufst1fdg_w "Gefiltertes Prim‰rtank-F¸llstandssensorsignal (% von 5V) f¸r Diagnose" UWORD rel_uw_b100 1 100 0 99.9985 FORMAT "%8.5" ECU_ADDRESS 0x800C56 /end MEASUREMENT
/begin MEASUREMENT ufst1fdp_w "Gefiltertes Prim‰rtank-F¸llstandssensorsignal (% von 5V) f¸r Anzeige" UWORD rel_uw_b100 1 100 0 99.9985 FORMAT "%8.5" ECU_ADDRESS 0x800C58 /end MEASUREMENT
/begin MEASUREMENT ufst2fdg_w "Gefiltertes Sekund‰rtank-F¸llstandssensorsignal (% von 5V) f¸r Diagnose" UWORD rel_uw_b100 1 100 0 99.9985 FORMAT "%8.5" ECU_ADDRESS 0x800C5A /end MEASUREMENT
/begin MEASUREMENT ufst2fdp_w "Gefiltertes Sekund‰rtank-F¸llstandssensorsignal (% von 5V) f¸r Anzeige" UWORD rel_uw_b100 1 100 0 99.9985 FORMAT "%8.5" ECU_ADDRESS 0x800C5C /end MEASUREMENT
/begin MEASUREMENT usbeh2_w "Spannung (word) Lambdasonde mit Widerstand belastet hinter KAT Bank2" UWORD spg_uw_q0p00488_o1 1 100 -1 318.995 FORMAT "%8.4" ECU_ADDRESS 0x80169E /end MEASUREMENT
/begin MEASUREMENT usbeh_w "Spannung (word) Lambdasonde mit Widerstand belastet hinter KAT" UWORD spg_uw_q0p00488_o1 1 100 -1 318.995 FORMAT "%8.4" ECU_ADDRESS 0x8016A0 /end MEASUREMENT
/begin MEASUREMENT ushb2_w "Spannung (word) Lambdasonde mit Widerstand belastet hinter KAT Bank2" UWORD spg_uw_q0p00488_o1 1 100 -1 318.995 FORMAT "%8.4" ECU_ADDRESS 0x8016A2 /end MEASUREMENT
/begin MEASUREMENT ushb_w "Spannung (word) Lambdasonde mit Widerstand belastet hinter KAT" UWORD spg_uw_q0p00488_o1 1 100 -1 318.995 FORMAT "%8.4" ECU_ADDRESS 0x8016A4 /end MEASUREMENT
/begin MEASUREMENT ushk "Spannung Lambdasonde hinter Katalysator" UBYTE spg_ub_q0p0052_o0p2 1 100 -0.2 1.13 FORMAT "%5.3" ECU_ADDRESS 0x801175 /end MEASUREMENT
/begin MEASUREMENT ushk2 "Spannung Lambdasonde hinter Katalysator 2" UBYTE spg_ub_q0p0052_o0p2 1 100 -0.2 1.13 FORMAT "%5.3" ECU_ADDRESS 0x801176 /end MEASUREMENT
/begin MEASUREMENT ushk2_w "Spannung Lambdasonde (4.88mV/LSB) hinter Katalysator 2" UWORD spg_uw_q0p00488_o1 1 100 -1 318.995 FORMAT "%8.4" ECU_ADDRESS 0x8016A6 /end MEASUREMENT
/begin MEASUREMENT ushkr2_w "Spannung (word) Lambdasonde Rohwert hinter KAT Bank2" UWORD spg_uw_q0p00488_o1 1 100 -1 318.995 FORMAT "%8.4" ECU_ADDRESS 0x8016A8 /end MEASUREMENT
/begin MEASUREMENT ushkr_w "Spannung (word) Lambdasonde Rohwert hinter KAT" UWORD spg_uw_q0p00488_o1 1 100 -1 318.995 FORMAT "%8.4" ECU_ADDRESS 0x8016AA /end MEASUREMENT
/begin MEASUREMENT ushk_w "Spannung Lambdasonde (4.88mV/LSB) hinter Katalysator" UWORD spg_uw_q0p00488_o1 1 100 -1 318.995 FORMAT "%8.4" ECU_ADDRESS 0x8016AC /end MEASUREMENT
/begin MEASUREMENT ushmb2_w "Spannung (word,10 ms-Raster) Lambdasonde mit Widerst. belastet hinter KAT Bank2" UWORD spg_uw_q0p00488_o1 1 100 -1 318.995 FORMAT "%8.4" ECU_ADDRESS 0x8016AE /end MEASUREMENT
/begin MEASUREMENT ushmb_w "Spannung (word, 10 ms-Raster) Lambdasonde mit Widerstand belastet hinter KAT" UWORD spg_uw_q0p00488_o1 1 100 -1 318.995 FORMAT "%8.4" ECU_ADDRESS 0x8016B0 /end MEASUREMENT
/begin MEASUREMENT ushob2_w "Spannung (word, 10 ms-Raster) Lambdasonde ohne Belastung hinter KAT Bank2" UWORD spg_uw_q0p00488_o1 1 100 -1 318.995 FORMAT "%8.4" ECU_ADDRESS 0x8016B2 /end MEASUREMENT
/begin MEASUREMENT ushob_w "Spannung (word, 10 ms-Raster) Lambdasonde ohne Belastung hinter KAT" UWORD spg_uw_q0p00488_o1 1 100 -1 318.995 FORMAT "%8.4" ECU_ADDRESS 0x8016B4 /end MEASUREMENT
/begin MEASUREMENT usobh2_w "Spannung (word) Lambdasonde ohne Belastung hinter KAT Bank2" UWORD spg_uw_q0p00488_o1 1 100 -1 318.995 FORMAT "%8.4" ECU_ADDRESS 0x8016B6 /end MEASUREMENT
/begin MEASUREMENT usobh_w "Spannung (word) Lambdasonde ohne Belastung hinter KAT" UWORD spg_uw_q0p00488_o1 1 100 -1 318.995 FORMAT "%8.4" ECU_ADDRESS 0x8016B8 /end MEASUREMENT
/begin MEASUREMENT uushmb2_w "Spannung (word,1 ms-Raster) Lambdasonde mit Widerstand belastet hinter KAT Bank2" UWORD spg_uw_q0p00488 1 100 0 319.995 FORMAT "%8.4" ECU_ADDRESS 0x7FAA4C /end MEASUREMENT
/begin MEASUREMENT uushmb_w "Spannung (word, 1 ms-Raster) Lambdasonde mit Widerstand belastet hinter KAT" UWORD spg_uw_q0p00488 1 100 0 319.995 FORMAT "%8.4" ECU_ADDRESS 0x7FAA4E /end MEASUREMENT
/begin MEASUREMENT uushob2_w "ADC-Spannung (word, 1 ms-Raster) Sonde ohne Belastung hinter Katalysator Bank2" UWORD spg_uw_q0p00488 1 100 0 319.995 FORMAT "%8.4" ECU_ADDRESS 0x7FAA50 /end MEASUREMENT
/begin MEASUREMENT uushob_w "ADC-Spannung (word, 1 ms-Raster) Sonde ohne Belastung hinter Katalysator" UWORD spg_uw_q0p00488 1 100 0 319.995 FORMAT "%8.4" ECU_ADDRESS 0x7FAA52 /end MEASUREMENT
/begin MEASUREMENT Veh_Spd "" UWORD DC_VEHSPD_KMH_U16 1 100 0 300 FORMAT "%8.4" ECU_ADDRESS 0x8033A6 /end MEASUREMENT
/begin MEASUREMENT Veh_Spd_Err_Mode "" UBYTE DC_FLAG_U8 1 100 0 1 BIT_MASK 0x1 FORMAT "%5.3" ECU_ADDRESS 0x8039AA /end MEASUREMENT
/begin MEASUREMENT wdk1 "Drosselklappenwinkel aus Poti 1" UBYTE relDK_ub_b100 1 100 0 100 FORMAT "%5.1" ECU_ADDRESS 0x8010E1 /end MEASUREMENT
/begin MEASUREMENT wdk1g "DK-Winkel aus Poti 1 begrenzt u. gefiltert f¸r Vergl. mit Ersatzwert aus F¸llung" UBYTE relDK_ub_b100 1 100 0 100 FORMAT "%5.1" ECU_ADDRESS 0x8010E2 /end MEASUREMENT
/begin MEASUREMENT wdk1_w "DK-Winkel aus Poti 1" SWORD relDK_q0p02441 1 100 -800 799.976 FORMAT "%8.4" ECU_ADDRESS 0x8014D0 /end MEASUREMENT
/begin MEASUREMENT wdk2 "Drosselklappenwinkel aus Poti 2" UBYTE relDK_ub_b100 1 100 0 100 FORMAT "%5.1" ECU_ADDRESS 0x8010E3 /end MEASUREMENT
/begin MEASUREMENT wdk2g "DK-Winkel aus Poti 2 begrenzt u. gefiltert f¸r Vergl. mit Ersatzwert aus F¸llung" UBYTE relDK_ub_b100 1 100 0 100 FORMAT "%5.1" ECU_ADDRESS 0x8010E4 /end MEASUREMENT
/begin MEASUREMENT wdk2_w "DK-Winkel aus Poti 2" SWORD relDK_q0p02441 1 100 -800 799.976 FORMAT "%8.4" ECU_ADDRESS 0x8014D2 /end MEASUREMENT
/begin MEASUREMENT wdk3g "Gefilterter Drosselklappenwinkel berechnet aus Hauptf¸llungssignal" UBYTE relDK_ub_b100 1 100 0 100 FORMAT "%5.1" ECU_ADDRESS 0x8010E5 /end MEASUREMENT
/begin MEASUREMENT wdkba "Drosselklappenwinkel bezogen auf unteren Anschlag" UBYTE relDK_ub_b100 1 100 0 100 FORMAT "%5.1" ECU_ADDRESS 0x8010E6 /end MEASUREMENT
/begin MEASUREMENT wdkba_w "Drosselklappenwinkel bezogen auf unteren Anschlag" SWORD relDK_q0p02441 1 100 -800 799.976 FORMAT "%8.4" ECU_ADDRESS 0x7FAA3A /end MEASUREMENT
/begin MEASUREMENT WhlNoPA_Circumfer "" UWORD DC_UDFCPARL 1 100 0 4.16661 FORMAT "%8.6" ECU_ADDRESS 0x8033A8 /end MEASUREMENT
/begin MEASUREMENT WhlPA_Circumfer "" UWORD DC_UDFCPARL 1 100 0 4.16661 FORMAT "%8.6" ECU_ADDRESS 0x8033AA /end MEASUREMENT
/begin MEASUREMENT Whl_Circumfer_Adap "" UWORD DC_UDFCPARL 1 100 0 4.16661 FORMAT "%8.6" ECU_ADDRESS 0x7FC854 /end MEASUREMENT
/begin MEASUREMENT Whl_Spd_PALeft "" UWORD DC_VEHSPD_KMH_U16 1 100 0 300 FORMAT "%8.4" ECU_ADDRESS 0x8033AC /end MEASUREMENT
/begin MEASUREMENT wkwalest_w "Startwinkel aus Motor-Abstellposition berechnet" UWORD kw_q0p1 1 100 0 6553.5 FORMAT "%8.3" ECU_ADDRESS 0x801C44 /end MEASUREMENT
/begin MEASUREMENT wkwas_w "Winkel Kurbelwelle im Arbeitsspiel" UWORD kw_q0p1 1 100 0 6553.5 FORMAT "%8.3" ECU_ADDRESS 0x801C46 /end MEASUREMENT
/begin MEASUREMENT wmfa "Meﬂfensteranfang in Grad Kurbelwinkel" SBYTE zw_sb_q0p75 1 100 -96 95.25 FORMAT "%5.2" ECU_ADDRESS 0x800F8E /end MEASUREMENT
/begin MEASUREMENT wmfa_new "Meﬂfensteranfang: aktueller Wert aus KL/KF" SBYTE zw_sb_q0p75 1 100 -96 95.25 FORMAT "%5.2" ECU_ADDRESS 0x800F8F /end MEASUREMENT
/begin MEASUREMENT wmfl "Meﬂfensterl‰nge in Grad Kurbelwinkel" SBYTE zw_sb_q0p75 1 100 -96 95.25 FORMAT "%5.2" ECU_ADDRESS 0x800F90 /end MEASUREMENT
/begin MEASUREMENT wmfl_new "Meﬂfensterl‰nge: aktueller Wert aus KL/KF" SBYTE zw_sb_q0p75 1 100 -96 95.25 FORMAT "%5.2" ECU_ADDRESS 0x800F91 /end MEASUREMENT
/begin MEASUREMENT wnwkwa2_w "Winkel der Auslaﬂ-NW-Flanken von Bank 2 relativ zur Kurbelwelle" UWORD kw_q0p1 1 100 0 6553.5 FORMAT "%8.3" ECU_ADDRESS 0x801C34 /end MEASUREMENT
/begin MEASUREMENT wnwkwa_w "Winkel der Auslaﬂ-NW-Flanken relativ zur Kurbelwelle" UWORD kw_q0p1 1 100 0 6553.5 FORMAT "%8.3" ECU_ADDRESS 0x801C36 /end MEASUREMENT
/begin MEASUREMENT wnwkwe2_w "Winkel der Einlaﬂ-NW-Flanken von Bank 2relativ zur Kurbelwelle" UWORD kw_q0p1 1 100 0 6553.5 FORMAT "%8.3" ECU_ADDRESS 0x801C38 /end MEASUREMENT
/begin MEASUREMENT wnwkwe_w "Winkel der Einlaﬂ-NW-Flanken relativ zur Kurbelwelle" UWORD kw_q0p1 1 100 0 6553.5 FORMAT "%8.3" ECU_ADDRESS 0x801C3A /end MEASUREMENT
/begin MEASUREMENT WSSNoPA_Flt_Mode "" UBYTE DC_FLAG_U8 1 100 0 1 BIT_MASK 0x1 FORMAT "%5.3" ECU_ADDRESS 0x8039AB /end MEASUREMENT
/begin MEASUREMENT WSSPA_Flt_Mode "" UBYTE DC_FLAG_U8 1 100 0 1 BIT_MASK 0x1 FORMAT "%5.3" ECU_ADDRESS 0x8039AC /end MEASUREMENT
/begin MEASUREMENT WSS_NoPALeft "" UWORD DC_URD_05 1 100 0 8191.5 FORMAT "%8.3" ECU_ADDRESS 0x8033AE /end MEASUREMENT
/begin MEASUREMENT WSS_NoPARight "" UWORD DC_URD_05 1 100 0 8191.5 FORMAT "%8.3" ECU_ADDRESS 0x8033B0 /end MEASUREMENT
/begin MEASUREMENT WSS_PALeft "" UWORD DC_URD_05 1 100 0 8191.5 FORMAT "%8.3" ECU_ADDRESS 0x8033B2 /end MEASUREMENT
/begin MEASUREMENT WSS_PALeft_Err_Mode "" UBYTE DC_FLAG_U8 1 100 0 1 BIT_MASK 0x1 FORMAT "%5.3" ECU_ADDRESS 0x8039AD /end MEASUREMENT
/begin MEASUREMENT WSS_PALeft_Plaus "" UWORD DC_URD_05 1 100 0 8191.5 FORMAT "%8.3" ECU_ADDRESS 0x8033B4 /end MEASUREMENT
/begin MEASUREMENT WSS_PARight "" UWORD DC_URD_05 1 100 0 8191.5 FORMAT "%8.3" ECU_ADDRESS 0x8033B6 /end MEASUREMENT
/begin MEASUREMENT zakrpar_w "Z‰hler Klopfregelung: Anzahl der Parity-Fehler gesamt" UWORD dez 1 100 0 65535 FORMAT "%8.2" ECU_ADDRESS 0x801B5C /end MEASUREMENT
/begin MEASUREMENT zakrspi_w "Z‰hler Klopfregelung:  Anzahl der SPI-Fehler gesamt" UWORD dez 1 100 0 65535 FORMAT "%8.2" ECU_ADDRESS 0x801B5E /end MEASUREMENT
/begin MEASUREMENT zdkrpar "Z‰hler Klopfregelung: Anzahl der Parity-Fehler im Beobachtungszeitraum" UWORD dez 1 100 0 65535 FORMAT "%8.2" ECU_ADDRESS 0x801B60 /end MEASUREMENT
/begin MEASUREMENT zdkrspi "Z‰hler Klopfregelung: Anzahl der SPI-Fehler im Beobachtungszeitraum" UWORD dez 1 100 0 65535 FORMAT "%8.2" ECU_ADDRESS 0x801B62 /end MEASUREMENT
/begin MEASUREMENT zgspg2_w "Zeitz‰hler Gang 2 f¸r GSP" UWORD t_q0p1 1 100 0 6553.5 FORMAT "%8.3" ECU_ADDRESS 0x8008FC /end MEASUREMENT
/begin MEASUREMENT zgsp_w "Z‰hler f¸r Getriebeschaltpunktsteuerung" UWORD t_q0p1 1 100 0 6553.5 FORMAT "%8.3" ECU_ADDRESS 0x8008FE /end MEASUREMENT
/begin MEASUREMENT zkrdia_w "Z‰hler f¸r den Beobachtungszeitraum der  Parity und SPI-‹berwachung" UWORD dez 1 100 0 65535 FORMAT "%8.2" ECU_ADDRESS 0x801B64 /end MEASUREMENT
/begin MEASUREMENT zkrfmu "Z‰hler Filtermittenfrequenzumschaltung, KR" UBYTE dez 1 100 0 255 FORMAT "%5.1" ARRAY_SIZE 8 ECU_ADDRESS 0x800F94 /end MEASUREMENT
/begin MEASUREMENT zkrkserr_w "Z‰hler Klopfregelung: Anzahl der erkannten KS-Kurzschl¸ﬂe gesamt" UWORD dez 1 100 0 65535 FORMAT "%8.2" ARRAY_SIZE 8 ECU_ADDRESS 0x801B66 /end MEASUREMENT
/begin MEASUREMENT zkrpar "Z‰hler f¸r KR-Diagnose: Anzahl der Parity-Fehler im Beobachtungszeitraum" UBYTE dez 1 100 0 255 FORMAT "%5.1" ECU_ADDRESS 0x800F9C /end MEASUREMENT
/begin MEASUREMENT zkrspi "Z‰hler KR-Diagnose: Anzahl der SPI-Fehler im Beobachtungszeitraum" UBYTE dez 1 100 0 255 FORMAT "%5.1" ECU_ADDRESS 0x800F9D /end MEASUREMENT
/begin MEASUREMENT zphfl "Z‰hler ‰quidistante Phasenflanken" SBYTE dez 1 100 -128 127 FORMAT "%5.1" ECU_ADDRESS 0x801040 /end MEASUREMENT
/begin MEASUREMENT zphfl2 "Z‰hler ‰quidistante Phasenflanken 2" SBYTE dez 1 100 -128 127 FORMAT "%5.1" ECU_ADDRESS 0x801041 /end MEASUREMENT
/begin MEASUREMENT zphfl2ct_w "Z‰hler f¸r Fehler bei zphfl2 Bestimmung" UWORD dez 1 100 0 65535 FORMAT "%8.2" ECU_ADDRESS 0x801C3C /end MEASUREMENT
/begin MEASUREMENT zphfl3 "Z‰hler ‰quidistante Phasenflanken 3" SBYTE dez 1 100 -128 127 FORMAT "%5.1" ECU_ADDRESS 0x801042 /end MEASUREMENT
/begin MEASUREMENT zphfl3ct_w "Z‰hler f¸r Fehler bei zphfl3 Bestimmung" UWORD dez 1 100 0 65535 FORMAT "%8.2" ECU_ADDRESS 0x801C3E /end MEASUREMENT
/begin MEASUREMENT zphfl4 "Z‰hler ‰quidistante Phasenflanken 4" SBYTE dez 1 100 -128 127 FORMAT "%5.1" ECU_ADDRESS 0x801043 /end MEASUREMENT
/begin MEASUREMENT zphfl4ct_w "Z‰hler f¸r Fehler bei zphfl4 Bestimmung" UWORD dez 1 100 0 65535 FORMAT "%8.2" ECU_ADDRESS 0x801C40 /end MEASUREMENT
/begin MEASUREMENT zphflct_w "Z‰hler f¸r Fehler bei zphfl Bestimmung" UWORD dez 1 100 0 65535 FORMAT "%8.2" ECU_ADDRESS 0x801C42 /end MEASUREMENT
/begin MEASUREMENT zriberh "Ri-Berechnungsz‰hler nach Start hinter KAT" UBYTE dez 1 100 0 255 FORMAT "%5.1" ECU_ADDRESS 0x801177 /end MEASUREMENT
/begin MEASUREMENT zriberh2 "Ri-Berechnungsz‰hler nach Start hinter KAT Bank2" UBYTE dez 1 100 0 255 FORMAT "%5.1" ECU_ADDRESS 0x801178 /end MEASUREMENT
/begin MEASUREMENT zrinh2_w "Zeitz‰hler zur Bereitstellung der aktuellen Bedingung Ri-Nernst hinter KAT Bank2" UWORD t100msxs_uw_b6553p5 1 100 0 6553.5 FORMAT "%8.3" ECU_ADDRESS 0x8016BA /end MEASUREMENT
/begin MEASUREMENT zrinh_w "Zeitz‰hler zur Bereitstellung der aktuellen Bedingung Ri-Nernst hinter KAT" UWORD t100msxs_uw_b6553p5 1 100 0 6553.5 FORMAT "%8.3" ECU_ADDRESS 0x8016BC /end MEASUREMENT
/begin MEASUREMENT zrph2_l "Z‰hler Raster Phasensignal 2" ULONG dez 1 100 0 4.29497e+009 FORMAT "%13.2" ECU_ADDRESS 0x801E60 /end MEASUREMENT
/begin MEASUREMENT zrph3_l "Z‰hler Raster Phasensignal 3" ULONG dez 1 100 0 4.29497e+009 FORMAT "%13.2" ECU_ADDRESS 0x801E64 /end MEASUREMENT
/begin MEASUREMENT zrph4_l "Z‰hler Raster Phasensignal 4" ULONG dez 1 100 0 4.29497e+009 FORMAT "%13.2" ECU_ADDRESS 0x801E68 /end MEASUREMENT
/begin MEASUREMENT zrph_l "Z‰hler Raster Phasensignal" ULONG dez 1 100 0 4.29497e+009 FORMAT "%13.2" ECU_ADDRESS 0x801E6C /end MEASUREMENT
/begin MEASUREMENT ztpnt_a "KR: Z‰hler f¸r die Freigabe von Nulltest oder Testimpuls" UBYTE dez 1 100 0 255 FORMAT "%5.1" ECU_ADDRESS 0x800F9E /end MEASUREMENT
/begin MEASUREMENT zzkwas_w "Zahnz‰hler Kurbelwelle im Arbeitsspiel" UWORD dez 1 100 0 65535 FORMAT "%8.2" ECU_ADDRESS 0x801C48 /end MEASUREMENT
/begin MEASUREMENT zzvirt "virtueller Zahnz‰hler im Start bis zur Synchronisation" UBYTE dez 1 100 0 255 FORMAT "%5.1" ECU_ADDRESS 0x801047 /end MEASUREMENT
/begin MEASUREMENT zzyl "SW-Zylinderz‰hler" UBYTE dez 1 100 0 255 FORMAT "%5.1" ECU_ADDRESS 0x801048 /end MEASUREMENT
/begin MEASUREMENT zzylkr "Zylinderz‰hler der Klopfregelung" UBYTE dez 1 100 0 255 FORMAT "%5.1" ECU_ADDRESS 0x800F9F /end MEASUREMENT
/begin MEASUREMENT zzylkr_int "Zylinderz‰hler Klopfregelung f¸r die Bereitstellung von Steuerdaten" UBYTE dez 1 100 0 255 FORMAT "%5.1" ECU_ADDRESS 0x800FA0 /end MEASUREMENT
/begin MEASUREMENT zzylkr_neu "Zwischenspeicher f¸r den KR-Zylinderz‰hler" UBYTE dez 1 100 0 255 FORMAT "%5.1" ECU_ADDRESS 0x800FA1 /end MEASUREMENT
/begin FUNCTION GGDVE "Gebergrˆﬂen Drosselklappensteller"
 /begin DEF_CHARACTERISTIC DUDKP1HY DWDK12O DWDK13O DWDK23O NDKPPU NWDK3 TDKPAW TFWDKPN TVPDKP1 TVPDKP2 TVPWDK12 TVPWDK13 TVPWDK23 UBVDKPO UBVDKPU UDKP1O UDKP1U UDKP2O UDKP2U /end DEF_CHARACTERISTIC
 /begin REF_CHARACTERISTIC /end REF_CHARACTERISTIC
 /begin IN_MEASUREMENT B_dkpu B_ehfs B_st B_ubpvg B_wdkhfu dkpstg_w nmot ub udkp1a_w udkp1sv udkp1vo_w udkp1vv_w udkp1v_w udkp1_w udkp2a_w udkp2_w wdkhf_w /end IN_MEASUREMENT
 /begin OUT_MEASUREMENT B_dkp1e B_dkp1mn B_dkp1mx B_dkp1np B_dkp2e B_dkp2mn B_dkp2mx B_dkp2np B_dkpaw B_dksbeg B_edks B_wdk2sel dwdkba_w wdk1_w wdk2_w wdkba wdkba_w /end OUT_MEASUREMENT
 /begin LOC_MEASUREMENT B_dkp1ev B_dkp2ev B_ubvdkp B_udk1nv B_wdk12ev B_wdk13ev B_wdk1v B_wdk23ev B_wdk2st cpaw1 cpaw2 ctdkp1 ctdkp2 ctdkpaw ctwdk12 ctwdk13 ctwdk23 wdk1 wdk1g wdk2 wdk2g wdk3g /end LOC_MEASUREMENT
 /begin SUB_FUNCTION /end SUB_FUNCTION
/end FUNCTION
/begin FUNCTION GGFSTT "Gebergroesse Fuellstandsgeber Tank"
 /begin DEF_CHARACTERISTIC FST1FULL FST1RTC FST1UNU FST2EMT FST2EST FST2UNU FSTEMT FSTFFHI FSTFFLO FSTGRNT FSTGRPK FSTTMX GVDTMX KLFST1VL KLFST2VL MFST1FDG MFST1FDP MFST2FDG MFST2FDP MFSTEDG MFSTFFDP MFSTNFDP MFSTSHF ZFSTFFDP ZFSTLODP ZFSTMNGR ZFSTSTDG ZFSTSTDP /end DEF_CHARACTERISTIC
 /begin REF_CHARACTERISTIC /end REF_CHARACTERISTIC
 /begin IN_MEASUREMENT B_autget B_fst1si B_pwf B_sifst B_stend gangi kvb_w ufst1_w ufst2_w /end IN_MEASUREMENT
 /begin OUT_MEASUREMENT B_fstdgv B_fstdpv B_tal B_talval fst1fdg_w fst2fdg_w fstfdg_w fstfdp fstgv_w fstt1 fstt2 fsttmax fsttmax_w fsttpro fstu_w rfstdg rfstsh /end OUT_MEASUREMENT
 /begin LOC_MEASUREMENT B_fstffdp fst1fdp_w fst2fdp_w fstadg_w fstadp_w fstkvbdg_w fstkvbdp_w fststdg fststdgp fststdp fststdpp fsttdg_w fsttdp_w ufst1fdg_w ufst1fdp_w ufst2fdg_w ufst2fdp_w /end LOC_MEASUREMENT
 /begin SUB_FUNCTION /end SUB_FUNCTION
/end FUNCTION
/begin FUNCTION GGHFM "Gebersignal HFM"
 /begin DEF_CHARACTERISTIC CWHFMPUKL1 CWHFMPUKL2 FLBKPUHFM FNWUEPUHFM KFKHFM KFKHFMDY KFPU KFPUKLP1 KFPUKLP12 KFPUKLP2 MLMIN MSHFMTP PUKANS TPSOLL /end DEF_CHARACTERISTIC
 /begin REF_CHARACTERISTIC /end REF_CHARACTERISTIC
 /begin IN_MEASUREMENT B_kphfmnp B_nswo1 B_pwf B_su flb_w fnwue nmot rl tans tpkhfm_w tpmshfm_w wdkba /end IN_MEASUREMENT
 /begin OUT_MEASUREMENT fkpmhfm_w mshfm1_w mshfma_w mshfmm_w mshfms_w mshfm_w tpkmhfm_w /end OUT_MEASUREMENT
 /begin LOC_MEASUREMENT anzhfma_w B_puklp1 B_puklp2 fkhfm fpuk mlhfmofs nmotkor puans /end LOC_MEASUREMENT
 /begin SUB_FUNCTION /end SUB_FUNCTION
/end FUNCTION
/begin FUNCTION GGKR "Gebergrˆﬂen Klopfregelung mit CC196"
 /begin DEF_CHARACTERISTIC CWKRAPP CWKRINT CWKRSHIFT DMAKRLA FMFKRZN KEMLN KFMAKR KRKOEFF NKRFM1 NKRFM2 NKRFM3 SENZZYL /end DEF_CHARACTERISTIC
 /begin REF_CHARACTERISTIC CWDKRTP KRANH SNM16KRUB SRL04KRUB /end REF_CHARACTERISTIC
 /begin IN_MEASUREMENT B_krldy B_krndy B_krntfv B_krtpfv B_tmkr esst_snm16krub esst_srl04krub krftpakt lamsbg_w nmot rl tseg_l vkr zzyl /end IN_MEASUREMENT
 /begin OUT_MEASUREMENT B_fmfkrc B_krkoer B_krkoueb ikrmen_w ikrmet_w ikr_w krdizust kricdiag krkserr kr_monitor ks_sym stkrfmf tmflt_w tn2 tpnt_aktiv zkrpar zkrspi zzylkr /end OUT_MEASUREMENT
 /begin LOC_MEASUREMENT B_krmfok B_krpar dmakrl fmfkrako_w fmfkrakt_w fmfkrc ikr_tst_w koeffadr_w kricstat krintka1_w krintka2_w krintka3_w krreadr_w krrein1_l krrein2_l krrein3_l krreko krrest krseappl krsefmf_w krseintanz krsekoanz krsekoeff_w krsemode krsemux krsevkr krsperr kr_koanz kr_mode sen_c96 tmfl_w wmfa wmfa_new wmfl wmfl_new zakrpar_w zakrspi_w zdkrpar zdkrspi zkrdia_w zkrfmu zkrkserr_w ztpnt_a zzylkr_int zzylkr_neu /end LOC_MEASUREMENT
 /begin SUB_FUNCTION /end SUB_FUNCTION
/end FUNCTION
/begin FUNCTION GGLBK "Gebergrˆﬂe der Ladungsbewegungsklappe" /begin DEF_CHARACTERISTIC TVPLBKP ULBKMN ULBKMX /end DEF_CHARACTERISTIC /begin REF_CHARACTERISTIC /end REF_CHARACTERISTIC /begin IN_MEASUREMENT lbkpstg_w ulbkisto_w ulbkist_w /end IN_MEASUREMENT
 /begin OUT_MEASUREMENT B_lbkpe B_lbkpev B_lbkpmn B_lbkpmx lbkist lbkistu_w lbkist_w /end OUT_MEASUREMENT
 /begin LOC_MEASUREMENT /end LOC_MEASUREMENT
 /begin SUB_FUNCTION /end SUB_FUNCTION
/end FUNCTION
/begin FUNCTION GGLSH "Gebergrˆﬂe Lambdasondensignal (Nernst-Type) hinter Kat"
 /begin DEF_CHARACTERISTIC ANZRIBEH CWGGLSH DUSRIH DUSSPH FRINOF RBEL RINHMX RKSP TGGLS THSRIH TRIAKTH TRIIMPH TUSBELH USRIMINH USRIOH USRIUH ZFRIH /end DEF_CHARACTERISTIC
 /begin REF_CHARACTERISTIC /end REF_CHARACTERISTIC
 /begin IN_MEASUREMENT B_lsh B_lsh2 B_lsv B_lsv2 B_ripuv B_ripuv2 B_sa B_svuerf B_svuerf2 B_ttbmhh B_ttbmhh2 uushk2_w uushk2_w_1ms uushk_w uushk_w_1ms uusvmb2_w uusvmb_w uusvob2_w uusvob_w /end IN_MEASUREMENT
 /begin OUT_MEASUREMENT B_priph B_priph2 B_pump B_rinh B_rinh2 B_shuerf B_shuerf2 rinh2_w rinh_w ushk ushk2 ushk2_w ushk_w /end OUT_MEASUREMENT
 /begin LOC_MEASUREMENT B_enrinh B_enrinh2 B_erinofh B_erinofh2 B_riakh B_riakh2 B_ribeh B_ribeh2 B_riibh B_riibh2 B_riimph B_rimh B_rimh2 B_ripuh B_ripuh2 B_rireh B_rireh2 B_risph B_risph2 B_usbeh B_usbeh2 rinofh2_w rinofha2_w rinofha_w rinofh_w usbeh2_w usbeh_w ushb2_w ushb_w ushkr2_w ushkr_w ushmb2_w ushmb_w ushob2_w ushob_w usobh2_w usobh_w uushmb2_w uushmb_w uushob2_w uushob_w zriberh zriberh2 zrinh2_w zrinh_w /end LOC_MEASUREMENT
 /begin SUB_FUNCTION /end SUB_FUNCTION
/end FUNCTION
/begin FUNCTION GGO2LSU "4.10      Gebergrˆﬂe Sauerstoffsignal LSU"
 /begin DEF_CHARACTERISTIC CWGGLSU FIPLSU FIPREFLSU FLAMPFT FLAMPMR FLSUFTKL O2VK TABGL TABGS TVABGL USABGL ZFDUSVK ZFUULSU /end DEF_CHARACTERISTIC
 /begin REF_CHARACTERISTIC TUMTO /end REF_CHARACTERISTIC
 /begin IN_MEASUREMENT B_eiclsu B_eiclsu2 B_elsuwi B_elsuwi2 B_fklsol B_fklsol2 B_llr B_pwf B_st B_stend iprefanf iprefanf2 ktkvk2_w ktkvk_w pabvtl2_w pabvtl_w pabvvk2_w pabvvk_w tnst_w uulsuv2_w uulsuv_w /end IN_MEASUREMENT
 /begin OUT_MEASUREMENT B_fklanf B_fklanf2 B_iclsabg B_iclsabg2 dua10g2_w dua10g_w ggo2lsuAusBits10ms ggo2lsuAusBits10ms_2 ggo2lsuLokBits10ms iplsuvj2_w iplsuvj_w kusvk2_w kusvkft2_w kusvkft_w kusvk_w o2vk2_w o2vk_w palsu2_w palsu_w ua10ms2_w ua10ms_w /end OUT_MEASUREMENT
 /begin LOC_MEASUREMENT B_fklanfs B_resabg B_resabg2 B_tabgs ipiprk2_w ipiprk_w ipkorp2_w ipkorp_w ipktk2_w ipktk_w iproh2_w iproh_w lsukorp2_w lsukorp_w ua10mo2_w ua10mo_w ua10msm2_w ua10msm_w /end LOC_MEASUREMENT
 /begin SUB_FUNCTION /end SUB_FUNCTION
/end FUNCTION
/begin FUNCTION GGRTLSU "Gebergrˆﬂe Widerstand und Temperatur der LSU"
 /begin DEF_CHARACTERISTIC DURINLSU FARIN KLKTKVK KLRTLSU RINCAL RININI TKERENSCUN TKERLSPSF TUMTO TVSABGL URINOFF ZFRIN ZFRINCAL /end DEF_CHARACTERISTIC
 /begin REF_CHARACTERISTIC /end REF_CHARACTERISTIC
 /begin IN_MEASUREMENT B_ehsve B_ehsve2 B_eiclsu B_eiclsu2 B_elsuwi B_elsuwi2 B_henrin B_henrin2 B_iclsabg B_iclsabg2 B_nmot B_pwf B_spf3k B_spf3k2 B_st B_stend rdtklsu2_w rdtklsu_w ubsq_w urinlsu2_w urinlsu_w /end IN_MEASUREMENT
 /begin OUT_MEASUREMENT B_enscun B_enscun2 B_pusab B_pusab2 B_rinabg B_rinabg2 ggrtlsuAusBits10ms ggrtlsuAusBits10ms_2 krivk2_w krivk_w ktkvk2_w ktkvk_w rinlsu2_w rinlsu_w tkerlsu2_w tkerlsu_w /end OUT_MEASUREMENT
 /begin LOC_MEASUREMENT B_ckrivk B_ckrivk2 drinlsu2_w drinlsu_w ggrtlsuLokBits10ms rinlsuk2_w rinlsuk_w rrinlsu2_w rrinlsu_w /end LOC_MEASUREMENT
 /begin SUB_FUNCTION /end SUB_FUNCTION
/end FUNCTION
/begin FUNCTION GGTFA "Gebergrˆﬂe TFA Temperaturf¸hler Ansaugluft" /begin DEF_CHARACTERISTIC TADE TADMN TADMX TANSHFMTP TDNSTA TDTA TDTAL ZFTANS /end DEF_CHARACTERISTIC /begin REF_CHARACTERISTIC /end REF_CHARACTERISTIC /begin IN_MEASUREMENT B_ll B_pwf B_sa B_stend tvtahfm_w /end IN_MEASUREMENT /begin OUT_MEASUREMENT tans tansab tansabk_w tansk_w tanstv tanstv_w /end OUT_MEASUREMENT /begin LOC_MEASUREMENT /end LOC_MEASUREMENT /begin SUB_FUNCTION /end SUB_FUNCTION /end FUNCTION
/begin FUNCTION GGTFM "Gebergrˆﬂe TFM Temperaturf¸hler Motor (/-K¸hlmittel)"
 /begin DEF_CHARACTERISTIC CWKONGTM CW_TABST DTLRTML DTMABDTMN DTMDMA DTMDNPO DTMSRT FABSTT KFDTMRS KFDTMTE KFDTMTR KFDTMTU KLITHMS KLTHMDTMS NDTHMMX NNPTMMX TABSMADTM TADMM TDNDTHMF TDNDTHMS TDNNPTMF TDNNPTMS TDTM TDTMMA TDTMNPO TDTMPOG TMABDTMN TMDMMA TMDMMAT TMDMMAU TMDMMEE TMDMMER TMDMN TMDMX TMELIPU1 TMLRTMS TMMXRT TMOTELI TMPUPOFF TMPUPON TMSDTHMO TNLETM TNSRT TUMDETM TWLRTMS UBMNPUP /end DEF_CHARACTERISTIC
 /begin REF_CHARACTERISTIC TC6CTHM TMSDTHMU /end REF_CHARACTERISTIC
 /begin IN_MEASUREMENT B_abstgp B_abstnlgp B_kl15 B_nmin B_nmot B_nokatfz B_pwf B_sa B_st B_stend imlatm ml nmot tabst_w tans tansab tmki ubsq wtmot_w /end IN_MEASUREMENT
 /begin OUT_MEASUREMENT B_endthm B_ennptm B_nletm B_npotm B_nputm B_tmmn B_tmsrt korrfak tdlrtm_w tmew tmewab tmot tmotab tmotlin tmotlinab tmotlin_w tmotvt tmrw tmrwend tmst tumginp /end OUT_MEASUREMENT
 /begin LOC_MEASUREMENT B_pullup B_zoptm mll1 /end LOC_MEASUREMENT
 /begin SUB_FUNCTION /end SUB_FUNCTION
/end FUNCTION
/begin FUNCTION GGTKA "Gebergrˆﬂe TKA Temperatur K¸hlerausgang" /begin DEF_CHARACTERISTIC TDTKAUS TKAELI TKAUSDE TKAUSDMN TKAUSDMX /end DEF_CHARACTERISTIC /begin REF_CHARACTERISTIC /end REF_CHARACTERISTIC /begin IN_MEASUREMENT wtka /end IN_MEASUREMENT /begin OUT_MEASUREMENT tka tkalin /end OUT_MEASUREMENT /begin LOC_MEASUREMENT /end LOC_MEASUREMENT /begin SUB_FUNCTION /end SUB_FUNCTION /end FUNCTION
/begin FUNCTION GGTOL "Gebergrˆﬂe TOL Temperatur ÷l" /begin DEF_CHARACTERISTIC TDTOL TOLDE TOLDMN TOLDMX TOLELI /end DEF_CHARACTERISTIC /begin REF_CHARACTERISTIC /end REF_CHARACTERISTIC /begin IN_MEASUREMENT wtol /end IN_MEASUREMENT /begin OUT_MEASUREMENT tol tollin /end OUT_MEASUREMENT /begin LOC_MEASUREMENT /end LOC_MEASUREMENT /begin SUB_FUNCTION /end SUB_FUNCTION /end FUNCTION
/begin FUNCTION GGTSG "Gebergrˆﬂe und Dokumentation Temperatur Steuerger‰t"
 /begin DEF_CHARACTERISTIC STNSG1 STNSG2 STNSG3 STNSG4 STNSG5 STTSG1 STTSG2 STTSG3 STTSG4 STTSG5 TSGELI TSTSG /end DEF_CHARACTERISTIC
 /begin REF_CHARACTERISTIC /end REF_CHARACTERISTIC
 /begin IN_MEASUREMENT nmot wtsg /end IN_MEASUREMENT
 /begin OUT_MEASUREMENT tsg /end OUT_MEASUREMENT
 /begin LOC_MEASUREMENT /end LOC_MEASUREMENT
 /begin SUB_FUNCTION /end SUB_FUNCTION
/end FUNCTION
/begin FUNCTION GGUB "8.10      Gebergrˆﬂe Batteriespannung, inkl.Diagnose" /begin DEF_CHARACTERISTIC TDNSUB TDUB UBDE UBDMN1 UBDMN2 UBDMX VMDUB /end DEF_CHARACTERISTIC /begin REF_CHARACTERISTIC /end REF_CHARACTERISTIC /begin IN_MEASUREMENT B_stend vfzg wub /end IN_MEASUREMENT /begin OUT_MEASUREMENT ub ubsq ubsqf ubsqf_w ubsq_w ub_w /end OUT_MEASUREMENT /begin LOC_MEASUREMENT /end LOC_MEASUREMENT /begin SUB_FUNCTION /end SUB_FUNCTION /end FUNCTION
/begin FUNCTION GGVFZ "20.11     Gebergrˆﬂe Fahrzeuggeschwindigkeit"
 /begin DEF_CHARACTERISTIC DFH_FIL DFV_FIL DF_ROH_UP DRMX FWADAPINI FWADAPMAX FWADAPMIN FWADAPPL FWBSFIL FWBSMAX FWBSMIN FWDADAP FWGANGMAX FWGANGMIN FWMISTMAX FWMISTMIN FWNADAP FWTNDR FWVADAP FWVDIFF FW_TMVDBS FW_VASRM /end DEF_CHARACTERISTIC
 /begin REF_CHARACTERISTIC /end REF_CHARACTERISTIC
 /begin IN_MEASUREMENT CodNew_Mode Cod_Trans2_FWD Cod_Trans_AWD drdfh drdfv drswe Eng_Run_Mode Eng_Spd Eng_Trq ESP_200h_MsgLost_DeBnc_Mode ESP_208h_MsgLost_DeBnc_Mode ESP_InfoBit0 ESP_InfoBit1 Gear_State MTX_Mode TrqCoor_ESP_Mode Veh_Spd_Raw WhlFront_Circumfer WhlRear_Circumfer WhlSpdFrontLeft WhlSpdFrontRight WhlSpdRearLeft WhlSpdRearRight /end IN_MEASUREMENT
 /begin OUT_MEASUREMENT b_adap b_adapok b_radini b_swean b_sweaus ddh ddhl ddhr ddv ddvl ddvr dfh_unfil dfv_diff dfv_unfil dhr_uv dhr_v dvl_aus dvl_n dvl_v dvr_uv dvr_v LongAccel LongAccel_BRD MsgLost_NoPA_Mode MsgLost_PA_Mode rad_diff Veh_Spd Veh_Spd_Err_Mode WhlNoPA_Circumfer WhlPA_Circumfer Whl_Circumfer_Adap Whl_Spd_PALeft WSSNoPA_Flt_Mode WSSPA_Flt_Mode WSS_NoPALeft WSS_NoPARight WSS_PALeft WSS_PALeft_Err_Mode WSS_PALeft_Plaus WSS_PARight /end OUT_MEASUREMENT
 /begin LOC_MEASUREMENT /end LOC_MEASUREMENT
 /begin SUB_FUNCTION /end SUB_FUNCTION
/end FUNCTION
/begin FUNCTION GK "Gemischkontrolle" /begin DEF_CHARACTERISTIC KFBS /end DEF_CHARACTERISTIC /begin REF_CHARACTERISTIC CWWL /end REF_CHARACTERISTIC
 /begin IN_MEASUREMENT B_stendes fgru fnswl_w fr2_w fra2_w fra_w fr_w fst_w fwe lamns_w lamsbg2_w lamsbg_w nmot rka2_w rka_w rkte_w rkukg_w rl rlp_w /end IN_MEASUREMENT
 /begin OUT_MEASUREMENT rk2_w rkg2_w rkg_w rk_w rllaso2_w rllaso_w /end OUT_MEASUREMENT
 /begin LOC_MEASUREMENT fvst_w /end LOC_MEASUREMENT
 /begin SUB_FUNCTION /end SUB_FUNCTION
/end FUNCTION
/begin FUNCTION GSP "Getriebeschaltpunktsteuerung"
 /begin DEF_CHARACTERISTIC GSPAKTIV GSPL1ASG GSPL1ASG1 GSPL1M GSPL1M1 GSPS2ASG GSPS2ASG1 GSPS2M GSPS2M1 GSPT1ASG GSPT1ASG1 GSPT1M GSPT1M1 TZGSP2MX TZGSP2MX1 VGSP VGSP1L VGSP1L1 VGSP1T VGSP1T1 VGSP2 VGSP2T VGSP2T1 ZGSP1T ZGSP1T1 ZGSP2T ZGSP2T1 /end DEF_CHARACTERISTIC
 /begin REF_CHARACTERISTIC STS08COUB /end REF_CHARACTERISTIC
 /begin IN_MEASUREMENT B_espanf B_ll B_stend B_wst Cod_Exh Cod_Trans1 esst_sts08coub gangi tmst tnse_w vfzg /end IN_MEASUREMENT
 /begin OUT_MEASUREMENT B_gspph1 B_gspph2 gspsz /end OUT_MEASUREMENT
 /begin LOC_MEASUREMENT zgspg2_w zgsp_w /end LOC_MEASUREMENT
 /begin SUB_FUNCTION /end SUB_FUNCTION
/end FUNCTION
/begin FUNCTION HLSHK "Sondenheizung hinter Kat"
 /begin DEF_CHARACTERISTIC PHLSNHMN TANHKMMN THHA THHA2 THHAWU THSHA THSHKTK THSHKTK2 TVHSH UBHS UHSN /end DEF_CHARACTERISTIC
 /begin REF_CHARACTERISTIC /end REF_CHARACTERISTIC
 /begin IN_MEASUREMENT B_atmtpk B_atmtpk2 B_atmtpl B_atmtpl2 B_stend tanhkm2_w tanhkm_w ub /end IN_MEASUREMENT
 /begin OUT_MEASUREMENT B_hsha B_hsha2 B_hshe B_hshe2 phlsnh phlsnh2 /end OUT_MEASUREMENT
 /begin LOC_MEASUREMENT B_enhlshk B_rehs thhaist thhaist2 thhat thhat2 /end LOC_MEASUREMENT
 /begin SUB_FUNCTION /end SUB_FUNCTION
/end FUNCTION
/begin FUNCTION HRLSU "4.30      Heizungsregelung stetige Lambdasonde LSU"
 /begin DEF_CHARACTERISTIC DPRHLSU DRILSUSTA DRILSUSTB KDHRLSU KIHRLSU KLPRHLSU KPHRLSU PRHLSUL RINLSUS TABSTHLSU THLSUHR TKERLSUS TKERLSUST TLSUVH /end DEF_CHARACTERISTIC
 /begin REF_CHARACTERISTIC CWHRLSU /end REF_CHARACTERISTIC
 /begin IN_MEASUREMENT B_atmtpa B_atmtpa2 B_ehsve B_ehsve2 B_eiclsu B_eiclsu2 B_elsuwi B_elsuwi2 B_hlsumx B_hlsumx2 B_hrlsaus B_nmot B_rinabg B_rinabg2 B_rineza B_rineza2 B_trkh rinlsu2_w rinlsu_w tabst_w tatuk_w tkerlsu2_w tkerlsu_w /end IN_MEASUREMENT
 /begin OUT_MEASUREMENT B_eshlsu B_eshlsu2 B_henrin B_henrin2 B_hstlsua B_hstlsua2 B_hstlsub B_hstlsub2 B_hsv B_hsv2 hrlsuAusBits hrlsuAusBits_2 hrlsuLokBits hrlsuLokBits_2 prhrlsu2_w prhrlsu_w rdtklsu2_w rdtklsu_w /end OUT_MEASUREMENT
 /begin LOC_MEASUREMENT B_fhsvt B_fhsvt2 B_hlsuaru B_hlsuaru2 B_sphrlsu B_sphrlsu2 B_vhlsu B_vhlsu2 iintpid2_w iintpid_w prhlsub2_w prhlsub_w prhlsud2_w prhlsud_w prhlsui2_w prhlsuin_w prhlsui_w prhlsup2_w prhlsup_w prhlsur2_w prhlsur_w /end LOC_MEASUREMENT
 /begin SUB_FUNCTION /end SUB_FUNCTION
/end FUNCTION
/begin FUNCTION HT2KTCWT "" /begin DEF_CHARACTERISTIC /end DEF_CHARACTERISTIC /begin REF_CHARACTERISTIC /end REF_CHARACTERISTIC /begin IN_MEASUREMENT tatherm /end IN_MEASUREMENT /begin OUT_MEASUREMENT /end OUT_MEASUREMENT /begin LOC_MEASUREMENT /end LOC_MEASUREMENT /begin SUB_FUNCTION /end SUB_FUNCTION /end FUNCTION
/begin FUNCTION HT2KTHFM "Schnittstelle Hardwaretreiber - Komponententreiber HFM" /begin DEF_CHARACTERISTIC /end DEF_CHARACTERISTIC /begin REF_CHARACTERISTIC /end REF_CHARACTERISTIC /begin IN_MEASUREMENT /end IN_MEASUREMENT
 /begin OUT_MEASUREMENT B_ehfmmn11 B_ehfmmn21 B_ehfmmx11 B_ehfmmx21 B_ehfmsg11 B_ehfmsg21 hfm6_m_state_ub hfm6_T_state_ub state_line_m state_line_T tpkhfm_w tpmshfm_w tvtahfm_w /end OUT_MEASUREMENT
 /begin LOC_MEASUREMENT /end LOC_MEASUREMENT
 /begin SUB_FUNCTION /end SUB_FUNCTION
/end FUNCTION
/begin FUNCTION HT2KTKJ "" /begin DEF_CHARACTERISTIC /end DEF_CHARACTERISTIC /begin REF_CHARACTERISTIC /end REF_CHARACTERISTIC /begin IN_MEASUREMENT tajal /end IN_MEASUREMENT /begin OUT_MEASUREMENT /end OUT_MEASUREMENT /begin LOC_MEASUREMENT /end LOC_MEASUREMENT /begin SUB_FUNCTION /end SUB_FUNCTION /end FUNCTION
/begin FUNCTION HT2KTLBK "Schnittstelle Hardwaretreiber - Komponententreiber LBK" /begin DEF_CHARACTERISTIC /end DEF_CHARACTERISTIC /begin REF_CHARACTERISTIC /end REF_CHARACTERISTIC /begin IN_MEASUREMENT talbks_w /end IN_MEASUREMENT /begin OUT_MEASUREMENT /end OUT_MEASUREMENT /begin LOC_MEASUREMENT /end LOC_MEASUREMENT /begin SUB_FUNCTION /end SUB_FUNCTION /end FUNCTION
/begin FUNCTION HT2KTLBKZ "" /begin DEF_CHARACTERISTIC /end DEF_CHARACTERISTIC /begin REF_CHARACTERISTIC /end REF_CHARACTERISTIC /begin IN_MEASUREMENT lbksol_w /end IN_MEASUREMENT /begin OUT_MEASUREMENT /end OUT_MEASUREMENT /begin LOC_MEASUREMENT /end LOC_MEASUREMENT /begin SUB_FUNCTION /end SUB_FUNCTION /end FUNCTION
/begin FUNCTION HT2KTLFS "" /begin DEF_CHARACTERISTIC /end DEF_CHARACTERISTIC /begin REF_CHARACTERISTIC /end REF_CHARACTERISTIC /begin IN_MEASUREMENT taml /end IN_MEASUREMENT /begin OUT_MEASUREMENT /end OUT_MEASUREMENT /begin LOC_MEASUREMENT /end LOC_MEASUREMENT /begin SUB_FUNCTION /end SUB_FUNCTION /end FUNCTION
/begin FUNCTION HT2KTNWS "Schnittstelle Hardwaretreiber - Komponententreiber NWS" /begin DEF_CHARACTERISTIC CWHTNWS TANWERA TANWERE TVERA TVERE /end DEF_CHARACTERISTIC /begin REF_CHARACTERISTIC /end REF_CHARACTERISTIC
 /begin IN_MEASUREMENT B_nwrposa B_nwrpose B_nws B_phada B_phade tanwraa2_w tanwraa_w tanwree2_w tanwree_w /end IN_MEASUREMENT
 /begin OUT_MEASUREMENT B_tanwera B_tanwere /end OUT_MEASUREMENT
 /begin LOC_MEASUREMENT /end LOC_MEASUREMENT
 /begin SUB_FUNCTION /end SUB_FUNCTION
/end FUNCTION
/begin FUNCTION HT2KTPH "Umsetzungsschicht Hardewaretreiber zu Komponententreiber Nockenwelle"
 /begin DEF_CHARACTERISTIC CWANW DPHFLFR1 DPHFLFR2 DPHFLFR3 DPHFLFR4 DPHFLSP1 DPHFLSP2 DPHFLSP3 DPHFLSP4 NMXPHPOS NWOFFSET NWSIGNAL NWSIGTOL WNWSPG1 WNWSPG2 WNWSPG3 WNWSPG4 /end DEF_CHARACTERISTIC
 /begin REF_CHARACTERISTIC /end REF_CHARACTERISTIC
 /begin IN_MEASUREMENT inisynmon nmot pgmaster synstate /end IN_MEASUREMENT
 /begin OUT_MEASUREMENT B_checkpg B_checkpg2 B_checkpg3 B_checkpg4 tnwia2_l tnwia_l tnwie2_l tnwie_l wnwkwa2_w wnwkwa_w wnwkwe2_w wnwkwe_w zphfl zphfl2 zphfl2ct_w zphfl3 zphfl3ct_w zphfl4 zphfl4ct_w zphflct_w zrph2_l zrph3_l zrph4_l zrph_l /end OUT_MEASUREMENT
 /begin LOC_MEASUREMENT B_pg1limsw B_pg2limsw B_pg3limsw B_pg4limsw camstate pg1limfr_w pg1limsp_w pg2limfr_w pg2limsp_w pg3limfr_w pg3limsp_w pg4limfr_w pg4limsp_w /end LOC_MEASUREMENT
 /begin SUB_FUNCTION /end SUB_FUNCTION
/end FUNCTION
/begin FUNCTION HT2KTWNE "Umsetzungsschicht Hardwaretreiber zu Komponententreiber Kurbelwelle"
 /begin DEF_CHARACTERISTIC CWPG1 CWPG2 CWPG3 CWPG4 DZZST FSYNDEL NMIN NMOTQSYN OFQSYNADAP TPREL WKWALETEST ZTPREL /end DEF_CHARACTERISTIC
 /begin REF_CHARACTERISTIC CWALE NWOFFSET /end REF_CHARACTERISTIC
 /begin IN_MEASUREMENT B_ale inisynmon pgmaster synstate wkwstop_w /end IN_MEASUREMENT
 /begin OUT_MEASUREMENT B_bm B_stprel B_tprel B_zprel B_zsynchro crankstate qstartinf sync_level tseg_l wkwas_w zzkwas_w zzvirt zzyl /end OUT_MEASUREMENT
 /begin LOC_MEASUREMENT wkwalest_w /end LOC_MEASUREMENT
 /begin SUB_FUNCTION /end SUB_FUNCTION
/end FUNCTION
/begin FUNCTION INDEX_ACCompr2_Trq "" /begin DEF_CHARACTERISTIC /end DEF_CHARACTERISTIC /begin REF_CHARACTERISTIC /end REF_CHARACTERISTIC /begin IN_MEASUREMENT /end IN_MEASUREMENT /begin OUT_MEASUREMENT /end OUT_MEASUREMENT /begin LOC_MEASUREMENT /end LOC_MEASUREMENT /begin SUB_FUNCTION /end SUB_FUNCTION /end FUNCTION
/begin FUNCTION INDEX_ACComp_Press "" /begin DEF_CHARACTERISTIC /end DEF_CHARACTERISTIC /begin REF_CHARACTERISTIC /end REF_CHARACTERISTIC /begin IN_MEASUREMENT /end IN_MEASUREMENT /begin OUT_MEASUREMENT /end OUT_MEASUREMENT /begin LOC_MEASUREMENT /end LOC_MEASUREMENT /begin SUB_FUNCTION /end SUB_FUNCTION /end FUNCTION
/begin FUNCTION INDEX_ACComp_Trq "" /begin DEF_CHARACTERISTIC /end DEF_CHARACTERISTIC /begin REF_CHARACTERISTIC /end REF_CHARACTERISTIC /begin IN_MEASUREMENT /end IN_MEASUREMENT /begin OUT_MEASUREMENT /end OUT_MEASUREMENT /begin LOC_MEASUREMENT /end LOC_MEASUREMENT /begin SUB_FUNCTION /end SUB_FUNCTION /end FUNCTION
/begin FUNCTION INDEX_AdapCrsCtrl_Par "" /begin DEF_CHARACTERISTIC /end DEF_CHARACTERISTIC /begin REF_CHARACTERISTIC /end REF_CHARACTERISTIC /begin IN_MEASUREMENT /end IN_MEASUREMENT /begin OUT_MEASUREMENT /end OUT_MEASUREMENT /begin LOC_MEASUREMENT /end LOC_MEASUREMENT /begin SUB_FUNCTION /end SUB_FUNCTION /end FUNCTION
/begin FUNCTION INDEX_AdapCrsCtrl_Tgl "" /begin DEF_CHARACTERISTIC /end DEF_CHARACTERISTIC /begin REF_CHARACTERISTIC /end REF_CHARACTERISTIC /begin IN_MEASUREMENT /end IN_MEASUREMENT /begin OUT_MEASUREMENT /end OUT_MEASUREMENT /begin LOC_MEASUREMENT /end LOC_MEASUREMENT /begin SUB_FUNCTION /end SUB_FUNCTION /end FUNCTION
/begin FUNCTION INDEX_AdapCrsCtrl_TrqReq "" /begin DEF_CHARACTERISTIC /end DEF_CHARACTERISTIC /begin REF_CHARACTERISTIC /end REF_CHARACTERISTIC /begin IN_MEASUREMENT /end IN_MEASUREMENT /begin OUT_MEASUREMENT /end OUT_MEASUREMENT /begin LOC_MEASUREMENT /end LOC_MEASUREMENT /begin SUB_FUNCTION /end SUB_FUNCTION /end FUNCTION
/begin FUNCTION INDEX_AGK2ME "" /begin DEF_CHARACTERISTIC /end DEF_CHARACTERISTIC /begin REF_CHARACTERISTIC /end REF_CHARACTERISTIC /begin IN_MEASUREMENT /end IN_MEASUREMENT /begin OUT_MEASUREMENT /end OUT_MEASUREMENT /begin LOC_MEASUREMENT /end LOC_MEASUREMENT /begin SUB_FUNCTION /end SUB_FUNCTION /end FUNCTION
/begin FUNCTION INDEX_AMT_EngEmOffEn "" /begin DEF_CHARACTERISTIC /end DEF_CHARACTERISTIC /begin REF_CHARACTERISTIC /end REF_CHARACTERISTIC /begin IN_MEASUREMENT /end IN_MEASUREMENT /begin OUT_MEASUREMENT /end OUT_MEASUREMENT /begin LOC_MEASUREMENT /end LOC_MEASUREMENT /begin SUB_FUNCTION /end SUB_FUNCTION /end FUNCTION
/begin FUNCTION INDEX_AMT_EngEmOffFl "" /begin DEF_CHARACTERISTIC /end DEF_CHARACTERISTIC /begin REF_CHARACTERISTIC /end REF_CHARACTERISTIC /begin IN_MEASUREMENT /end IN_MEASUREMENT /begin OUT_MEASUREMENT /end OUT_MEASUREMENT /begin LOC_MEASUREMENT /end LOC_MEASUREMENT /begin SUB_FUNCTION /end SUB_FUNCTION /end FUNCTION
/begin FUNCTION INDEX_AP_Pt1HiLim "" /begin DEF_CHARACTERISTIC /end DEF_CHARACTERISTIC /begin REF_CHARACTERISTIC /end REF_CHARACTERISTIC /begin IN_MEASUREMENT /end IN_MEASUREMENT /begin OUT_MEASUREMENT /end OUT_MEASUREMENT /begin LOC_MEASUREMENT /end LOC_MEASUREMENT /begin SUB_FUNCTION /end SUB_FUNCTION /end FUNCTION
/begin FUNCTION INDEX_AP_Pt1LoLim "" /begin DEF_CHARACTERISTIC /end DEF_CHARACTERISTIC /begin REF_CHARACTERISTIC /end REF_CHARACTERISTIC /begin IN_MEASUREMENT /end IN_MEASUREMENT /begin OUT_MEASUREMENT /end OUT_MEASUREMENT /begin LOC_MEASUREMENT /end LOC_MEASUREMENT /begin SUB_FUNCTION /end SUB_FUNCTION /end FUNCTION
/begin FUNCTION INDEX_AP_Pt2HiLim "" /begin DEF_CHARACTERISTIC /end DEF_CHARACTERISTIC /begin REF_CHARACTERISTIC /end REF_CHARACTERISTIC /begin IN_MEASUREMENT /end IN_MEASUREMENT /begin OUT_MEASUREMENT /end OUT_MEASUREMENT /begin LOC_MEASUREMENT /end LOC_MEASUREMENT /begin SUB_FUNCTION /end SUB_FUNCTION /end FUNCTION
/begin FUNCTION INDEX_AP_Pt2LoLim "" /begin DEF_CHARACTERISTIC /end DEF_CHARACTERISTIC /begin REF_CHARACTERISTIC /end REF_CHARACTERISTIC /begin IN_MEASUREMENT /end IN_MEASUREMENT /begin OUT_MEASUREMENT /end OUT_MEASUREMENT /begin LOC_MEASUREMENT /end LOC_MEASUREMENT /begin SUB_FUNCTION /end SUB_FUNCTION /end FUNCTION
/begin FUNCTION INDEX_AP_PtDiff "" /begin DEF_CHARACTERISTIC /end DEF_CHARACTERISTIC /begin REF_CHARACTERISTIC /end REF_CHARACTERISTIC /begin IN_MEASUREMENT /end IN_MEASUREMENT /begin OUT_MEASUREMENT /end OUT_MEASUREMENT /begin LOC_MEASUREMENT /end LOC_MEASUREMENT /begin SUB_FUNCTION /end SUB_FUNCTION /end FUNCTION
/begin FUNCTION INDEX_AP_PtSupp "" /begin DEF_CHARACTERISTIC /end DEF_CHARACTERISTIC /begin REF_CHARACTERISTIC /end REF_CHARACTERISTIC /begin IN_MEASUREMENT /end IN_MEASUREMENT /begin OUT_MEASUREMENT /end OUT_MEASUREMENT /begin LOC_MEASUREMENT /end LOC_MEASUREMENT /begin SUB_FUNCTION /end SUB_FUNCTION /end FUNCTION
/begin FUNCTION INDEX_BGRBS "" /begin DEF_CHARACTERISTIC /end DEF_CHARACTERISTIC /begin REF_CHARACTERISTIC /end REF_CHARACTERISTIC /begin IN_MEASUREMENT /end IN_MEASUREMENT /begin OUT_MEASUREMENT /end OUT_MEASUREMENT /begin LOC_MEASUREMENT /end LOC_MEASUREMENT /begin SUB_FUNCTION /end SUB_FUNCTION /end FUNCTION
/begin FUNCTION INDEX_BLS_Par "" /begin DEF_CHARACTERISTIC /end DEF_CHARACTERISTIC /begin REF_CHARACTERISTIC /end REF_CHARACTERISTIC /begin IN_MEASUREMENT /end IN_MEASUREMENT /begin OUT_MEASUREMENT /end OUT_MEASUREMENT /begin LOC_MEASUREMENT /end LOC_MEASUREMENT /begin SUB_FUNCTION /end SUB_FUNCTION /end FUNCTION
/begin FUNCTION INDEX_BLS_Tgl "" /begin DEF_CHARACTERISTIC /end DEF_CHARACTERISTIC /begin REF_CHARACTERISTIC /end REF_CHARACTERISTIC /begin IN_MEASUREMENT /end IN_MEASUREMENT /begin OUT_MEASUREMENT /end OUT_MEASUREMENT /begin LOC_MEASUREMENT /end LOC_MEASUREMENT /begin SUB_FUNCTION /end SUB_FUNCTION /end FUNCTION
/begin FUNCTION INDEX_BLS_Undef "" /begin DEF_CHARACTERISTIC /end DEF_CHARACTERISTIC /begin REF_CHARACTERISTIC /end REF_CHARACTERISTIC /begin IN_MEASUREMENT /end IN_MEASUREMENT /begin OUT_MEASUREMENT /end OUT_MEASUREMENT /begin LOC_MEASUREMENT /end LOC_MEASUREMENT /begin SUB_FUNCTION /end SUB_FUNCTION /end FUNCTION
/begin FUNCTION INDEX_CoolFan_SpdReq "" /begin DEF_CHARACTERISTIC /end DEF_CHARACTERISTIC /begin REF_CHARACTERISTIC /end REF_CHARACTERISTIC /begin IN_MEASUREMENT /end IN_MEASUREMENT /begin OUT_MEASUREMENT /end OUT_MEASUREMENT /begin LOC_MEASUREMENT /end LOC_MEASUREMENT /begin SUB_FUNCTION /end SUB_FUNCTION /end FUNCTION
/begin FUNCTION INDEX_DANWS "" /begin DEF_CHARACTERISTIC /end DEF_CHARACTERISTIC /begin REF_CHARACTERISTIC /end REF_CHARACTERISTIC /begin IN_MEASUREMENT /end IN_MEASUREMENT /begin OUT_MEASUREMENT /end OUT_MEASUREMENT /begin LOC_MEASUREMENT /end LOC_MEASUREMENT /begin SUB_FUNCTION /end SUB_FUNCTION /end FUNCTION
/begin FUNCTION INDEX_DDG "" /begin DEF_CHARACTERISTIC /end DEF_CHARACTERISTIC /begin REF_CHARACTERISTIC /end REF_CHARACTERISTIC /begin IN_MEASUREMENT /end IN_MEASUREMENT /begin OUT_MEASUREMENT /end OUT_MEASUREMENT /begin LOC_MEASUREMENT /end LOC_MEASUREMENT /begin SUB_FUNCTION /end SUB_FUNCTION /end FUNCTION
/begin FUNCTION INDEX_DDSS "" /begin DEF_CHARACTERISTIC /end DEF_CHARACTERISTIC /begin REF_CHARACTERISTIC /end REF_CHARACTERISTIC /begin IN_MEASUREMENT /end IN_MEASUREMENT /begin OUT_MEASUREMENT /end OUT_MEASUREMENT /begin LOC_MEASUREMENT /end LOC_MEASUREMENT /begin SUB_FUNCTION /end SUB_FUNCTION /end FUNCTION
/begin FUNCTION INDEX_DDVE "" /begin DEF_CHARACTERISTIC /end DEF_CHARACTERISTIC /begin REF_CHARACTERISTIC /end REF_CHARACTERISTIC /begin IN_MEASUREMENT /end IN_MEASUREMENT /begin OUT_MEASUREMENT /end OUT_MEASUREMENT /begin LOC_MEASUREMENT /end LOC_MEASUREMENT /begin SUB_FUNCTION /end SUB_FUNCTION /end FUNCTION
/begin FUNCTION INDEX_DEKON "" /begin DEF_CHARACTERISTIC /end DEF_CHARACTERISTIC /begin REF_CHARACTERISTIC /end REF_CHARACTERISTIC /begin IN_MEASUREMENT /end IN_MEASUREMENT /begin OUT_MEASUREMENT /end OUT_MEASUREMENT /begin LOC_MEASUREMENT /end LOC_MEASUREMENT /begin SUB_FUNCTION /end SUB_FUNCTION /end FUNCTION
/begin FUNCTION INDEX_DEKPE "" /begin DEF_CHARACTERISTIC /end DEF_CHARACTERISTIC /begin REF_CHARACTERISTIC /end REF_CHARACTERISTIC /begin IN_MEASUREMENT /end IN_MEASUREMENT /begin OUT_MEASUREMENT /end OUT_MEASUREMENT /begin LOC_MEASUREMENT /end LOC_MEASUREMENT /begin SUB_FUNCTION /end SUB_FUNCTION /end FUNCTION
/begin FUNCTION INDEX_DENWS "" /begin DEF_CHARACTERISTIC /end DEF_CHARACTERISTIC /begin REF_CHARACTERISTIC /end REF_CHARACTERISTIC /begin IN_MEASUREMENT /end IN_MEASUREMENT /begin OUT_MEASUREMENT /end OUT_MEASUREMENT /begin LOC_MEASUREMENT /end LOC_MEASUREMENT /begin SUB_FUNCTION /end SUB_FUNCTION /end FUNCTION
/begin FUNCTION INDEX_DEVE "" /begin DEF_CHARACTERISTIC /end DEF_CHARACTERISTIC /begin REF_CHARACTERISTIC /end REF_CHARACTERISTIC /begin IN_MEASUREMENT /end IN_MEASUREMENT /begin OUT_MEASUREMENT /end OUT_MEASUREMENT /begin LOC_MEASUREMENT /end LOC_MEASUREMENT /begin SUB_FUNCTION /end SUB_FUNCTION /end FUNCTION
/begin FUNCTION INDEX_DFPM "" /begin DEF_CHARACTERISTIC /end DEF_CHARACTERISTIC /begin REF_CHARACTERISTIC /end REF_CHARACTERISTIC /begin IN_MEASUREMENT /end IN_MEASUREMENT /begin OUT_MEASUREMENT /end OUT_MEASUREMENT /begin LOC_MEASUREMENT /end LOC_MEASUREMENT /begin SUB_FUNCTION /end SUB_FUNCTION /end FUNCTION
/begin FUNCTION INDEX_DFSTT "" /begin DEF_CHARACTERISTIC /end DEF_CHARACTERISTIC /begin REF_CHARACTERISTIC /end REF_CHARACTERISTIC /begin IN_MEASUREMENT /end IN_MEASUREMENT /begin OUT_MEASUREMENT /end OUT_MEASUREMENT /begin LOC_MEASUREMENT /end LOC_MEASUREMENT /begin SUB_FUNCTION /end SUB_FUNCTION /end FUNCTION
/begin FUNCTION INDEX_DHFM "" /begin DEF_CHARACTERISTIC /end DEF_CHARACTERISTIC /begin REF_CHARACTERISTIC /end REF_CHARACTERISTIC /begin IN_MEASUREMENT /end IN_MEASUREMENT /begin OUT_MEASUREMENT /end OUT_MEASUREMENT /begin LOC_MEASUREMENT /end LOC_MEASUREMENT /begin SUB_FUNCTION /end SUB_FUNCTION /end FUNCTION
/begin FUNCTION INDEX_DHLSHK "" /begin DEF_CHARACTERISTIC /end DEF_CHARACTERISTIC /begin REF_CHARACTERISTIC /end REF_CHARACTERISTIC /begin IN_MEASUREMENT /end IN_MEASUREMENT /begin OUT_MEASUREMENT /end OUT_MEASUREMENT /begin LOC_MEASUREMENT /end LOC_MEASUREMENT /begin SUB_FUNCTION /end SUB_FUNCTION /end FUNCTION
/begin FUNCTION INDEX_DHRLSU "" /begin DEF_CHARACTERISTIC /end DEF_CHARACTERISTIC /begin REF_CHARACTERISTIC /end REF_CHARACTERISTIC /begin IN_MEASUREMENT /end IN_MEASUREMENT /begin OUT_MEASUREMENT /end OUT_MEASUREMENT /begin LOC_MEASUREMENT /end LOC_MEASUREMENT /begin SUB_FUNCTION /end SUB_FUNCTION /end FUNCTION
/begin FUNCTION INDEX_DHRLSUE "" /begin DEF_CHARACTERISTIC /end DEF_CHARACTERISTIC /begin REF_CHARACTERISTIC /end REF_CHARACTERISTIC /begin IN_MEASUREMENT /end IN_MEASUREMENT /begin OUT_MEASUREMENT /end OUT_MEASUREMENT /begin LOC_MEASUREMENT /end LOC_MEASUREMENT /begin SUB_FUNCTION /end SUB_FUNCTION /end FUNCTION
/begin FUNCTION INDEX_DKATSP "DKATSP." /begin DEF_CHARACTERISTIC /end DEF_CHARACTERISTIC /begin REF_CHARACTERISTIC /end REF_CHARACTERISTIC /begin IN_MEASUREMENT /end IN_MEASUREMENT /begin OUT_MEASUREMENT /end OUT_MEASUREMENT /begin LOC_MEASUREMENT /end LOC_MEASUREMENT /begin SUB_FUNCTION /end SUB_FUNCTION /end FUNCTION
/begin FUNCTION INDEX_DKRIC "" /begin DEF_CHARACTERISTIC /end DEF_CHARACTERISTIC /begin REF_CHARACTERISTIC /end REF_CHARACTERISTIC /begin IN_MEASUREMENT /end IN_MEASUREMENT /begin OUT_MEASUREMENT /end OUT_MEASUREMENT /begin LOC_MEASUREMENT /end LOC_MEASUREMENT /begin SUB_FUNCTION /end SUB_FUNCTION /end FUNCTION
/begin FUNCTION INDEX_DKRS "" /begin DEF_CHARACTERISTIC /end DEF_CHARACTERISTIC /begin REF_CHARACTERISTIC /end REF_CHARACTERISTIC /begin IN_MEASUREMENT /end IN_MEASUREMENT /begin OUT_MEASUREMENT /end OUT_MEASUREMENT /begin LOC_MEASUREMENT /end LOC_MEASUREMENT /begin SUB_FUNCTION /end SUB_FUNCTION /end FUNCTION
/begin FUNCTION INDEX_DKRSPI "" /begin DEF_CHARACTERISTIC /end DEF_CHARACTERISTIC /begin REF_CHARACTERISTIC /end REF_CHARACTERISTIC /begin IN_MEASUREMENT /end IN_MEASUREMENT /begin OUT_MEASUREMENT /end OUT_MEASUREMENT /begin LOC_MEASUREMENT /end LOC_MEASUREMENT /begin SUB_FUNCTION /end SUB_FUNCTION /end FUNCTION
/begin FUNCTION INDEX_DKVS "" /begin DEF_CHARACTERISTIC /end DEF_CHARACTERISTIC /begin REF_CHARACTERISTIC /end REF_CHARACTERISTIC /begin IN_MEASUREMENT /end IN_MEASUREMENT /begin OUT_MEASUREMENT /end OUT_MEASUREMENT /begin LOC_MEASUREMENT /end LOC_MEASUREMENT /begin SUB_FUNCTION /end SUB_FUNCTION /end FUNCTION
/begin FUNCTION INDEX_DLBK "" /begin DEF_CHARACTERISTIC /end DEF_CHARACTERISTIC /begin REF_CHARACTERISTIC /end REF_CHARACTERISTIC /begin IN_MEASUREMENT /end IN_MEASUREMENT /begin OUT_MEASUREMENT /end OUT_MEASUREMENT /begin LOC_MEASUREMENT /end LOC_MEASUREMENT /begin SUB_FUNCTION /end SUB_FUNCTION /end FUNCTION
/begin FUNCTION INDEX_DLLR "" /begin DEF_CHARACTERISTIC /end DEF_CHARACTERISTIC /begin REF_CHARACTERISTIC /end REF_CHARACTERISTIC /begin IN_MEASUREMENT /end IN_MEASUREMENT /begin OUT_MEASUREMENT /end OUT_MEASUREMENT /begin LOC_MEASUREMENT /end LOC_MEASUREMENT /begin SUB_FUNCTION /end SUB_FUNCTION /end FUNCTION
/begin FUNCTION INDEX_DLSAHK "" /begin DEF_CHARACTERISTIC /end DEF_CHARACTERISTIC /begin REF_CHARACTERISTIC /end REF_CHARACTERISTIC /begin IN_MEASUREMENT /end IN_MEASUREMENT /begin OUT_MEASUREMENT /end OUT_MEASUREMENT /begin LOC_MEASUREMENT /end LOC_MEASUREMENT /begin SUB_FUNCTION /end SUB_FUNCTION /end FUNCTION
/begin FUNCTION INDEX_DLSH "" /begin DEF_CHARACTERISTIC /end DEF_CHARACTERISTIC /begin REF_CHARACTERISTIC /end REF_CHARACTERISTIC /begin IN_MEASUREMENT /end IN_MEASUREMENT /begin OUT_MEASUREMENT /end OUT_MEASUREMENT /begin LOC_MEASUREMENT /end LOC_MEASUREMENT /begin SUB_FUNCTION /end SUB_FUNCTION /end FUNCTION
/begin COMPU_METHOD B_TRUE "boolsche Zust‰nde, positive Logik" TAB_VERB "%6.3" "" COMPU_TAB_REF B_TRUE /end COMPU_METHOD
/begin COMPU_VTAB B_TRUE "boolsche Zust‰nde, positive Logik" TAB_VERB 2 0 "----" 1 "TRUE" /end COMPU_VTAB
/begin COMPU_METHOD DC_CNTR_U8 "" RAT_FUNC "%6.2" "" COEFFS 0 1 0 0 0 1 /end COMPU_METHOD
/begin COMPU_METHOD DC_FLAG_U8 "" RAT_FUNC "%6.2" "" COEFFS 0 1 0 0 0 1 /end COMPU_METHOD
/begin COMPU_METHOD DC_ROTSPD_S16 "" RAT_FUNC "%7.3" "1/min" COEFFS 0 2 0 0 0 1 /end COMPU_METHOD
/begin COMPU_METHOD DC_TQ20 "" RAT_FUNC "%6.4" "sec" COEFFS 0 50 0 0 0 1 /end COMPU_METHOD
/begin COMPU_METHOD DC_TQ5 "" RAT_FUNC "%6.4" "sec" COEFFS 0 200 0 0 0 1 /end COMPU_METHOD
/begin COMPU_METHOD DC_TRQ_S16 "" RAT_FUNC "%8.5" "Nm" COEFFS 0 16 0 0 0 1 /end COMPU_METHOD
/begin COMPU_METHOD DC_UAFZ_S8 "" RAT_FUNC "%6.4" "m/(s*s)" COEFFS 0 1 0 0 0 0.0434 /end COMPU_METHOD
/begin COMPU_METHOD DC_UBESCH "" RAT_FUNC "%6.2" "m/s*s" COEFFS 0 1 0 0 0 1 /end COMPU_METHOD
/begin COMPU_METHOD DC_UDFCPARL "" RAT_FUNC "%7.6" "m" COEFFS 0 15728.6 0 0 0 1 /end COMPU_METHOD
/begin COMPU_METHOD DC_UDFCPAR_S16DB "" RAT_FUNC "%7.6" "m" COEFFS 0 15728.6 0 0 0 1 /end COMPU_METHOD
/begin COMPU_METHOD DC_URD_05 "" RAT_FUNC "%8.4" "1/min" COEFFS 0 1 0 0 0 0.5 /end COMPU_METHOD
/begin COMPU_METHOD DC_VEHSPD_KMH_U16 "" RAT_FUNC "%8.5" "km/h" COEFFS 0 16 0 0 0 1 /end COMPU_METHOD
/begin COMPU_METHOD DC_VQV16_S16 "" RAT_FUNC "%6.4" "km/h" COEFFS 0 16 0 0 0 1 /end COMPU_METHOD
/begin COMPU_METHOD dez "1 : 1 Umrechnug (dez/hex)" RAT_FUNC "%6.2" "" COEFFS 0 1 0 0 0 1 /end COMPU_METHOD
/begin COMPU_METHOD dezsub1 "" RAT_FUNC "%6.2" "-" COEFFS 0 1 -1 0 0 1 /end COMPU_METHOD
/begin COMPU_METHOD fak_q1p526Em5 "" RAT_FUNC "%7.6" "-" COEFFS 0 65536 0 0 0 1 /end COMPU_METHOD
/begin COMPU_METHOD fak_sb_b0p25 "" RAT_FUNC "%6.4" "-" COEFFS 0 256 0 0 0 0.5 /end COMPU_METHOD
/begin COMPU_METHOD fak_ub_b1 "" RAT_FUNC "%6.4" "-" COEFFS 0 256 0 0 0 1 /end COMPU_METHOD
/begin COMPU_METHOD fak_ub_b16 "" RAT_FUNC "%6.4" "-" COEFFS 0 256 0 0 0 16 /end COMPU_METHOD
/begin COMPU_METHOD fak_ub_b2 "" RAT_FUNC "%6.4" "-" COEFFS 0 256 0 0 0 2 /end COMPU_METHOD
/begin COMPU_METHOD fak_ub_q0p01 "" RAT_FUNC "%6.4" "-" COEFFS 0 1 0 0 0 0.01 /end COMPU_METHOD
/begin COMPU_METHOD fak_uw_b1 "" RAT_FUNC "%7.6" "-" COEFFS 0 65536 0 0 0 1 /end COMPU_METHOD
/begin COMPU_METHOD fak_uw_b16 "" RAT_FUNC "%6.5" "-" COEFFS 0 65536 0 0 0 16 /end COMPU_METHOD
/begin COMPU_METHOD fak_uw_b2 "" RAT_FUNC "%7.6" "-" COEFFS 0 65536 0 0 0 2 /end COMPU_METHOD
/begin COMPU_METHOD fak_uw_b4 "" RAT_FUNC "%7.6" "-" COEFFS 0 65536 0 0 0 4 /end COMPU_METHOD
/begin COMPU_METHOD fak_uw_b64 "" RAT_FUNC "%6.5" "-" COEFFS 0 65536 0 0 0 64 /end COMPU_METHOD
/begin COMPU_METHOD ispg_q0p25 "" RAT_FUNC "%6.3" "uA/V" COEFFS 0 4 0 0 0 1 /end COMPU_METHOD
/begin COMPU_METHOD i_q0p125_uA "" RAT_FUNC "%6.3" "uA" COEFFS 0 8 0 0 0 1 /end COMPU_METHOD
/begin COMPU_METHOD i_q1_uA "" RAT_FUNC "%6.2" "uA" COEFFS 0 1 0 0 0 1 /end COMPU_METHOD
/begin COMPU_METHOD kw_q0p1 "" RAT_FUNC "%6.3" "Grad KW" COEFFS 0 10 0 0 0 1 /end COMPU_METHOD
/begin COMPU_METHOD kw_q1 "" RAT_FUNC "%6.2" "Grad KW" COEFFS 0 1 0 0 0 1 /end COMPU_METHOD
/begin COMPU_METHOD m_sw_b3276p8 "" RAT_FUNC "%6.3" "kg/h" COEFFS 0 1 0 0 0 0.1 /end COMPU_METHOD
/begin COMPU_METHOD m_ub_b1020 "" RAT_FUNC "%6.2" "kg/h" COEFFS 0 1 0 0 0 4 /end COMPU_METHOD
/begin COMPU_METHOD m_ub_b23p3 "" RAT_FUNC "%6.3" "kg" COEFFS 0 2812.5 0 0 0 256 /end COMPU_METHOD
/begin COMPU_METHOD m_uw_b6553p5 "" RAT_FUNC "%6.3" "kg/h" COEFFS 0 1 0 0 0 0.1 /end COMPU_METHOD
/begin COMPU_METHOD nmot_q1 "" RAT_FUNC "%6.2" "1/min" COEFFS 0 1 0 0 0 1 /end COMPU_METHOD
/begin COMPU_METHOD nmot_ub_q40 "" RAT_FUNC "%6.1" "1/min" COEFFS 0 1 0 0 0 40 /end COMPU_METHOD
/begin COMPU_METHOD p_uw_q0p039 "" RAT_FUNC "%6.4" "hPa" COEFFS 0 256 0 0 0 10 /end COMPU_METHOD
/begin COMPU_METHOD relDK_q0p02441 "" RAT_FUNC "%6.4" "%DK" COEFFS 0 65536 0 0 0 1600 /end COMPU_METHOD
/begin COMPU_METHOD relDK_ub_b100 "" RAT_FUNC "%6.3" "%DK" COEFFS 0 255 0 0 0 100 /end COMPU_METHOD
/begin COMPU_METHOD relO2_q9p765Em4 "" RAT_FUNC "%6.5" "% O2" COEFFS 0 1024 0 0 0 1 /end COMPU_METHOD
/begin COMPU_METHOD reltempgrd_q1p987Em5 "" RAT_FUNC "%7.6" "%/(K*s)" COEFFS 0 1.00663e+008 0 0 0 2000 /end COMPU_METHOD
/begin COMPU_METHOD reltemp_q3p179Em5 "" RAT_FUNC "%7.6" "%/K" COEFFS 0 786432 0 0 0 25 /end COMPU_METHOD
/begin COMPU_METHOD rel_q0p0061 "" RAT_FUNC "%6.4" "" COEFFS 0 1 0 0 0 0.00609756 /end COMPU_METHOD
/begin COMPU_METHOD rel_q0p39 "" RAT_FUNC "%6.3" "%" COEFFS 0 256 0 0 0 100 /end COMPU_METHOD
/begin COMPU_METHOD rel_sw_b100 "" RAT_FUNC "%6.4" "%" COEFFS 0 32768 0 0 0 100 /end COMPU_METHOD
/begin COMPU_METHOD rel_sw_q0p02441 "" RAT_FUNC "%6.4" "%" COEFFS 0 65536 0 0 0 1600 /end COMPU_METHOD
/begin COMPU_METHOD rel_ub_b100 "" RAT_FUNC "%6.3" "%" COEFFS 0 256 0 0 0 100 /end COMPU_METHOD
/begin COMPU_METHOD rel_ub_b1p0 "" RAT_FUNC "%6.4" "%" COEFFS 0 256 0 0 0 1 /end COMPU_METHOD
/begin COMPU_METHOD rel_ub_b99p6 "" RAT_FUNC "%6.3" "%" COEFFS 0 256 0 0 0 100 /end COMPU_METHOD
/begin COMPU_METHOD rel_ub_q0p75 "" RAT_FUNC "%6.3" "%" COEFFS 0 1 0 0 0 0.75 /end COMPU_METHOD
/begin COMPU_METHOD rel_uw_b100 "" RAT_FUNC "%6.4" "%" COEFFS 0 65536 0 0 0 100 /end COMPU_METHOD
/begin COMPU_METHOD rel_uw_b200 "" RAT_FUNC "%6.4" "%" COEFFS 0 65536 0 0 0 200 /end COMPU_METHOD
/begin COMPU_METHOD rel_uw_b3072 "" RAT_FUNC "%6.4" "%" COEFFS 0 65536 0 0 0 3072 /end COMPU_METHOD
/begin COMPU_METHOD rel_uw_q0p0234 "" RAT_FUNC "%6.4" "%" COEFFS 0 32 0 0 0 0.75 /end COMPU_METHOD
/begin COMPU_METHOD rpspg_q0p0156 "" RAT_FUNC "%6.4" "Ohm/V" COEFFS 0 65536 0 0 0 1024 /end COMPU_METHOD
/begin COMPU_METHOD r_q0p0391 "" RAT_FUNC "%6.4" "Ohm" COEFFS 0 65536 0 0 0 2560 /end COMPU_METHOD
/begin COMPU_METHOD r_uw_q2 "" RAT_FUNC "%6.2" "Ohm" COEFFS 0 1 0 0 0 2 /end COMPU_METHOD
/begin COMPU_METHOD spg_q0p00039 "" RAT_FUNC "%6.5" "V" COEFFS 0 1 0 0 0 0.000390625 /end COMPU_METHOD
/begin COMPU_METHOD spg_q0p00488 "" RAT_FUNC "%6.4" "V" COEFFS 0 1024 0 0 0 5 /end COMPU_METHOD
/begin COMPU_METHOD spg_q0p1 "" RAT_FUNC "%6.3" "V" COEFFS 0 1 0 0 0 0.1 /end COMPU_METHOD
/begin COMPU_METHOD spg_q4p88Em4 "" RAT_FUNC "%6.5" "V" COEFFS 0 2048 0 0 0 1 /end COMPU_METHOD
/begin COMPU_METHOD spg_sw_q0p00488 "" RAT_FUNC "%6.4" "V" COEFFS 0 1024 0 0 0 5 /end COMPU_METHOD
/begin COMPU_METHOD spg_ubatt "" RAT_FUNC "%6.3" "V" COEFFS 0 1 0 0 0 0.0942 /end COMPU_METHOD
/begin COMPU_METHOD spg_ub_b5 "" RAT_FUNC "%6.4" "V" COEFFS 0 256 0 0 0 5 /end COMPU_METHOD
/begin COMPU_METHOD spg_ub_q0p0052_o0p2 "" RAT_FUNC "%6.3" "V" COEFFS 0 255 51 0 0 1.33 /end COMPU_METHOD
/begin COMPU_METHOD spg_uw_q0p000076 "" RAT_FUNC "%7.6" "V" COEFFS 0 65536 0 0 0 5 /end COMPU_METHOD
/begin COMPU_METHOD spg_uw_q0p001222 "" RAT_FUNC "%6.4" "V" COEFFS 0 1 0 0 0 0.001222 /end COMPU_METHOD
/begin COMPU_METHOD spg_uw_q0p00488 "" RAT_FUNC "%6.4" "V" COEFFS 0 1024 0 0 0 5 /end COMPU_METHOD
/begin COMPU_METHOD spg_uw_q0p00488_o1 "" RAT_FUNC "%6.3" "V" COEFFS 0 1024 1024 0 0 5 /end COMPU_METHOD
/begin COMPU_METHOD t100msxs_ub_b255 "" RAT_FUNC "%6.2" "s" COEFFS 0 1 0 0 0 1 /end COMPU_METHOD
/begin COMPU_METHOD t100msxs_ub_b25p5 "" RAT_FUNC "%6.3" "s" COEFFS 0 1 0 0 0 0.1 /end COMPU_METHOD
/begin COMPU_METHOD t100msxs_ub_q20 "" RAT_FUNC "%9.3" "s" COEFFS 0 1 0 0 0 20 /end COMPU_METHOD
/begin COMPU_METHOD t100msxs_uw_b6553p5 "" RAT_FUNC "%6.3" "s" COEFFS 0 1 0 0 0 0.1 /end COMPU_METHOD
/begin COMPU_METHOD t10msxs_q0p01_o0p05 "" RAT_FUNC "%6.4" "s" COEFFS 0 1 0.05 0 0 0.01 /end COMPU_METHOD
/begin COMPU_METHOD t10msxs_ub_b2p55 "" RAT_FUNC "%6.4" "s" COEFFS 0 1 0 0 0 0.01 /end COMPU_METHOD
/begin COMPU_METHOD t10msxs_uw_b655p35 "" RAT_FUNC "%6.4" "s" COEFFS 0 1 0 0 0 0.01 /end COMPU_METHOD
/begin COMPU_METHOD t1msxms_q1 "" RAT_FUNC "%6.2" "ms" COEFFS 0 1 0 0 0 1 /end COMPU_METHOD
/begin COMPU_METHOD t1sxs_ub_b255 "" RAT_FUNC "%6.2" "s" COEFFS 0 1 0 0 0 1 /end COMPU_METHOD
/begin COMPU_METHOD t1sxs_uw_b65535 "" RAT_FUNC "%6.2" "s" COEFFS 0 1 0 0 0 1 /end COMPU_METHOD
/begin COMPU_METHOD t1sxs_uw_q1 "" RAT_FUNC "%6.2" "s" COEFFS 0 1 0 0 0 1 /end COMPU_METHOD
/begin COMPU_METHOD t200msxs_uw_q0p2 "" RAT_FUNC "%6.3" "s" COEFFS 0 1 0 0 0 0.2 /end COMPU_METHOD
/begin COMPU_METHOD temp_q0p0038_o75 "" RAT_FUNC "%6.2" "Grad C" COEFFS 0 256 19200 0 0 0.976563 /end COMPU_METHOD
/begin COMPU_METHOD temp_q0p0234 "" RAT_FUNC "%6.4" "K" COEFFS 0 256 0 0 0 6 /end COMPU_METHOD
/begin COMPU_METHOD temp_q0p0234_o273 "" RAT_FUNC "%6.1" "Grad C" COEFFS 0 1 273.15 0 0 0.0234375 /end COMPU_METHOD
/begin COMPU_METHOD temp_sb_b0p093 "" RAT_FUNC "%6.5" "Grad C" COEFFS 0 512 0 0 0 0.375 /end COMPU_METHOD
/begin COMPU_METHOD temp_ub_b191p25 "" RAT_FUNC "%6.3" "Grad C" COEFFS 0 1 0 0 0 0.75 /end COMPU_METHOD
/begin COMPU_METHOD temp_ub_q0p75_o48 "" RAT_FUNC "%6.2" "Grad C" COEFFS 0 1 48 0 0 0.75 /end COMPU_METHOD
/begin COMPU_METHOD temp_uw_q0p0029_o48 "" RAT_FUNC "%6.2" "Grad C" COEFFS 0 256 12288 0 0 0.75 /end COMPU_METHOD
/begin COMPU_METHOD tus_uw_q3p2 "" RAT_FUNC "%6.2" "us" COEFFS 0 1 0 0 0 3.2 /end COMPU_METHOD
/begin COMPU_METHOD tv_uw_b100 "" RAT_FUNC "%6.4" "%TV" COEFFS 0 65535 0 0 0 100 /end COMPU_METHOD
/begin COMPU_METHOD t_q0p0001_ms "" RAT_FUNC "%7.6" "ms" COEFFS 0 1 0 0 0 0.0001 /end COMPU_METHOD
/begin COMPU_METHOD t_q0p002_ms "" RAT_FUNC "%6.4" "ms" COEFFS 0 1 0 0 0 0.002 /end COMPU_METHOD
/begin COMPU_METHOD t_q0p1 "" RAT_FUNC "%6.3" "s" COEFFS 0 10 0 0 0 1 /end COMPU_METHOD
/begin COMPU_METHOD t_q0p1_us "" RAT_FUNC "%6.3" "us" COEFFS 0 10 0 0 0 1 /end COMPU_METHOD
/begin COMPU_METHOD t_q1p024_ms "" RAT_FUNC "%6.2" "ms" COEFFS 0 1 0 0 0 1.024 /end COMPU_METHOD
/begin COMPU_METHOD vfzg_ub_q1p25 "" RAT_FUNC "%6.2" "km/h" COEFFS 0 1 0 0 0 1.25 /end COMPU_METHOD
/begin COMPU_METHOD vol_q0p0039 "" RAT_FUNC "%6.4" "L" COEFFS 0 256 0 0 0 1 /end COMPU_METHOD
/begin COMPU_METHOD vol_q0p1_l "" RAT_FUNC "%6.3" "l" COEFFS 0 1 0 0 0 0.1 /end COMPU_METHOD
/begin COMPU_METHOD vol_q0p5_l "" RAT_FUNC "%6.3" "L" COEFFS 0 1 0 0 0 0.5 /end COMPU_METHOD
/begin COMPU_METHOD vol_q4p8828Em3_l "" RAT_FUNC "%6.4" "l" COEFFS 0 65536 0 0 0 320 /end COMPU_METHOD
/begin COMPU_METHOD zk100msxs_uw_b6553 "" RAT_FUNC "%10.3" "s" COEFFS 0 0 65536 0 10 0 /end COMPU_METHOD
/begin COMPU_METHOD zk10msxs_ub_b2p55 "" RAT_FUNC "%6.4" "s" COEFFS 0 0 255 0 100 0 /end COMPU_METHOD
/begin COMPU_METHOD zw_sb_q0p75 "" RAT_FUNC "%6.3" "Grad KW" COEFFS 0 255 0 0 0 191.25 /end COMPU_METHOD
/begin RECORD_LAYOUT dc_KwSb FNC_VALUES 1 SBYTE COLUMN_DIR DIRECT /end RECORD_LAYOUT
/begin RECORD_LAYOUT dc_KwSw FNC_VALUES 1 SWORD COLUMN_DIR DIRECT /end RECORD_LAYOUT
/begin RECORD_LAYOUT dc_KwUb FNC_VALUES 1 UBYTE COLUMN_DIR DIRECT /end RECORD_LAYOUT
/begin RECORD_LAYOUT dc_KwUw FNC_VALUES 1 UWORD COLUMN_DIR DIRECT /end RECORD_LAYOUT
/begin RECORD_LAYOUT FklWSw FNC_VALUES 1 SWORD COLUMN_DIR DIRECT /end RECORD_LAYOUT
/begin RECORD_LAYOUT GkfWS8 FNC_VALUES 1 SBYTE COLUMN_DIR DIRECT /end RECORD_LAYOUT
/begin RECORD_LAYOUT GklWS8 FNC_VALUES 1 SBYTE COLUMN_DIR DIRECT /end RECORD_LAYOUT
/begin RECORD_LAYOUT GklWU8 FNC_VALUES 1 UBYTE COLUMN_DIR DIRECT /end RECORD_LAYOUT
/begin RECORD_LAYOUT KfAxU8AyU8SstxU16SstyU16WU16 NO_AXIS_PTS_X 1 UWORD NO_AXIS_PTS_Y 2 UWORD AXIS_PTS_X 3 UWORD INDEX_INCR DIRECT AXIS_PTS_Y 4 UWORD INDEX_INCR DIRECT FNC_VALUES 5 UWORD COLUMN_DIR DIRECT /end RECORD_LAYOUT
/begin RECORD_LAYOUT KfAxUbAyUbSstxUbSstyUbWSb NO_AXIS_PTS_X 1 UBYTE NO_AXIS_PTS_Y 2 UBYTE AXIS_PTS_X 3 UBYTE INDEX_INCR DIRECT AXIS_PTS_Y 4 UBYTE INDEX_INCR DIRECT FNC_VALUES 5 SBYTE COLUMN_DIR DIRECT /end RECORD_LAYOUT
/begin RECORD_LAYOUT KfAxUbAyUbSstxUbSstyUbWUb NO_AXIS_PTS_X 1 UBYTE NO_AXIS_PTS_Y 2 UBYTE AXIS_PTS_X 3 UBYTE INDEX_INCR DIRECT AXIS_PTS_Y 4 UBYTE INDEX_INCR DIRECT FNC_VALUES 5 UBYTE COLUMN_DIR DIRECT /end RECORD_LAYOUT
/begin RECORD_LAYOUT KlAUbSstUbWUb NO_AXIS_PTS_X 1 UBYTE AXIS_PTS_X 2 UBYTE INDEX_INCR DIRECT FNC_VALUES 3 UBYTE COLUMN_DIR DIRECT /end RECORD_LAYOUT
/begin RECORD_LAYOUT KlAUwSstUwWUw NO_AXIS_PTS_X 1 UWORD AXIS_PTS_X 2 UWORD INDEX_INCR DIRECT FNC_VALUES 3 UWORD COLUMN_DIR DIRECT /end RECORD_LAYOUT
/begin RECORD_LAYOUT KlAxU8SstxS16WS16 NO_AXIS_PTS_X 1 SWORD AXIS_PTS_X 2 SWORD INDEX_INCR DIRECT FNC_VALUES 3 SWORD COLUMN_DIR DIRECT /end RECORD_LAYOUT
/begin RECORD_LAYOUT KlAxU8SstxS16WU16 NO_AXIS_PTS_X 1 UWORD AXIS_PTS_X 2 SWORD INDEX_INCR DIRECT FNC_VALUES 3 UWORD COLUMN_DIR DIRECT /end RECORD_LAYOUT
/begin RECORD_LAYOUT KlAxU8SstxU16WS16 NO_AXIS_PTS_X 1 UWORD AXIS_PTS_X 2 UWORD INDEX_INCR DIRECT FNC_VALUES 3 SWORD COLUMN_DIR DIRECT /end RECORD_LAYOUT
/begin RECORD_LAYOUT KlAxU8SstxU16WU16 NO_AXIS_PTS_X 1 UWORD AXIS_PTS_X 2 UWORD INDEX_INCR DIRECT FNC_VALUES 3 UWORD COLUMN_DIR DIRECT /end RECORD_LAYOUT
/begin RECORD_LAYOUT KwbWU16 FNC_VALUES 1 UWORD COLUMN_DIR DIRECT /end RECORD_LAYOUT
/begin RECORD_LAYOUT KwbWU8 FNC_VALUES 1 UBYTE COLUMN_DIR DIRECT /end RECORD_LAYOUT
/begin RECORD_LAYOUT KwSw FNC_VALUES 1 SWORD COLUMN_DIR DIRECT /end RECORD_LAYOUT
/begin RECORD_LAYOUT KwUb FNC_VALUES 1 UBYTE COLUMN_DIR DIRECT /end RECORD_LAYOUT
/begin RECORD_LAYOUT KwUw FNC_VALUES 1 UWORD COLUMN_DIR DIRECT /end RECORD_LAYOUT
/begin RECORD_LAYOUT KwWS16 FNC_VALUES 1 SWORD COLUMN_DIR DIRECT /end RECORD_LAYOUT
/begin RECORD_LAYOUT KwWS8 FNC_VALUES 1 SBYTE COLUMN_DIR DIRECT /end RECORD_LAYOUT
/begin RECORD_LAYOUT KwWU16 FNC_VALUES 1 UWORD COLUMN_DIR DIRECT /end RECORD_LAYOUT
/begin RECORD_LAYOUT KwWU8 FNC_VALUES 1 UBYTE COLUMN_DIR DIRECT /end RECORD_LAYOUT
/begin RECORD_LAYOUT SstAUbSstUb NO_AXIS_PTS_X 1 UBYTE AXIS_PTS_X 2 UBYTE INDEX_INCR DIRECT /end RECORD_LAYOUT
/end MODULE
/end PROJECT
