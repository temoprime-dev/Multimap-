ASAP2_VERSION 1 51
/begin PROJECT ZHBC8600 "Gen2_BMW_System_Supplier_Lib"
/begin MODULE CPP ""
/begin MOD_COMMON "" BYTE_ORDER MSB_FIRST ALIGNMENT_BYTE 1 ALIGNMENT_WORD 2 ALIGNMENT_LONG 4 ALIGNMENT_FLOAT32_IEEE 4 ALIGNMENT_FLOAT64_IEEE 1 /end MOD_COMMON
/begin COMPU_VTAB _CNV_S_4_Enum_EFGRB_58_S2 "" TAB_VERB 4 0 "A_AGS" 1 "S_AGS" 2 "A_AGS_BERG" 3 "S_AGS_BERG" DEFAULT_VALUE "" /end COMPU_VTAB
/begin COMPU_VTAB _CNV_S_5_Enum_ZDRIV_159_S2 "" TAB_VERB 5 0 "D_DRIVE" 1 "S_DRIVE" 2 "M_DRIVE" 3 "TID_DRIVE" 4 "LMODE_DRIVE" DEFAULT_VALUE "" /end COMPU_VTAB
/begin COMPU_VTAB _CNV_S_6_Enum_EFWSI_178_S2 "" TAB_VERB 6 0 "KeinBerg" 1 "A1" 2 "A2" 3 "A3" 4 "A4" 5 "A5" DEFAULT_VALUE "" /end COMPU_VTAB
/begin COMPU_VTAB _CNV_S_6_Enum_ELDMB_60_S2 "" TAB_VERB 6 0 "LDM_A" 1 "LDM_S" 2 "LDM_A_BERG1" 3 "LDM_S_BERG1" 4 "LDM_A_BERG2" 5 "LDM_S_BERG2" DEFAULT_VALUE "" /end COMPU_VTAB
/begin COMPU_VTAB _CNV_S_8_Enum_EFGR_59_S2 "" TAB_VERB 8 0 "FGR_PASSIV" 1 "FGR_AKTIV_KONSTANTFAHRT" 2 "FGR_ACC_REGELUNG_STANDARD" 3 "FGR_AKTIV_WIEDERAUFNAHME" 4 "FGR_ACC_REGELUNG_ERH_DYNAMIK" 5 "FGR_AKTIV_SETZEN_BESCHL" 6 "FGR_ACC_REGELUNG_ABSCHALTUNG" 7 "FGR_AKTIV_VERZOEGERN" DEFAULT_VALUE "" /end COMPU_VTAB
/begin COMPU_VTAB _CNV_S_9_Enum_EPOSL_81_S2 "" TAB_VERB 9 0 "POSL_1" 1 "POSL_2" 2 "POSL_3" 3 "POSL_4" 4 "POSL_5" 5 "POSL_6" 6 "POSL_7" 7 "POSL_8" 8 "POSL_9" DEFAULT_VALUE "" /end COMPU_VTAB
/begin COMPU_METHOD _CNV_S_4_Enum_EFGRB_58_CM_S2 "" TAB_VERB "%6.3" "" COMPU_TAB_REF _CNV_S_4_Enum_EFGRB_58_S2 /end COMPU_METHOD
/begin COMPU_METHOD _CNV_S_5_Enum_ZDRIV_159_CM_S2 "" TAB_VERB "%6.3" "" COMPU_TAB_REF _CNV_S_5_Enum_ZDRIV_159_S2 /end COMPU_METHOD
/begin COMPU_METHOD _CNV_S_6_Enum_EFWSI_178_CM_S2 "" TAB_VERB "%6.3" "" COMPU_TAB_REF _CNV_S_6_Enum_EFWSI_178_S2 /end COMPU_METHOD
/begin COMPU_METHOD _CNV_S_6_Enum_ELDMB_60_CM_S2 "" TAB_VERB "%6.3" "" COMPU_TAB_REF _CNV_S_6_Enum_ELDMB_60_S2 /end COMPU_METHOD
/begin COMPU_METHOD _CNV_S_8_Enum_EFGR_59_CM_S2 "" TAB_VERB "%6.3" "" COMPU_TAB_REF _CNV_S_8_Enum_EFGR_59_S2 /end COMPU_METHOD
/begin COMPU_METHOD _CNV_S_9_Enum_EPOSL_81_CM_S2 "" TAB_VERB "%6.3" "" COMPU_TAB_REF _CNV_S_9_Enum_EPOSL_81_S2 /end COMPU_METHOD
/begin COMPU_METHOD SAB2_1PROZENT_S3_S3 "int = ((phys * 1) / 1) - (0) %" RAT_FUNC "%1.0" "%" COEFFS 0 1 0 0 0 1 /end COMPU_METHOD
/begin COMPU_METHOD SAB2_C_CGT_1CEL_M40_S3_S3 "int = ((phys * 1) / 1) - (-40) Grad Celsius" RAT_FUNC "%1.0" "Grad Celsius" COEFFS 0 1 40 0 0 1 /end COMPU_METHOD
/begin COMPU_METHOD SAB2_K8_S3_S3 "int = ((phys * 8) / 1) - (0) -" RAT_FUNC "%4.3" "-" COEFFS 0 8 0 0 0 1 /end COMPU_METHOD
/begin COMPU_METHOD SAB2_M_1NM_S3_S3 "int = ((phys * 1) / 1) - (0) Nm" RAT_FUNC "%1.0" "Nm" COEFFS 0 1 0 0 0 1 /end COMPU_METHOD
/begin COMPU_METHOD SAB2_MINTEGRAL_1NMS_S3_S3 "int = ((phys * 1) / 1) - (0) Nms" RAT_FUNC "%1.0" "Nms" COEFFS 0 1 0 0 0 1 /end COMPU_METHOD
/begin COMPU_METHOD SAB2_N_1RPM_S3_S3 "int = ((phys * 1) / 1) - (0) 1/min" RAT_FUNC "%1.0" "1/min" COEFFS 0 1 0 0 0 1 /end COMPU_METHOD
/begin COMPU_METHOD SAB2_STANDARD_S3_S3 "int = ((phys * 1) / 1) - (0) -" RAT_FUNC "%1.0" "-" COEFFS 0 1 0 0 0 1 /end COMPU_METHOD
/begin COMPU_METHOD SAB2_T_10MS_S3_S3 "int = ((phys * 1) / 10) - (0) ms" RAT_FUNC "%4.3" "ms" COEFFS 0 0.1 0 0 0 1 /end COMPU_METHOD
/begin COMPU_METHOD SAB2_T_TIMER_10MS_S3_S3 "int = ((phys * 1) / 10) - (0) ms" RAT_FUNC "%4.3" "ms" COEFFS 0 0.1 0 0 0 1 /end COMPU_METHOD
/begin COMPU_METHOD SAB2_V_1KMH_S3_S3 "int = ((phys * 1) / 1) - (0) km/h" RAT_FUNC "%1.0" "km/h" COEFFS 0 1 0 0 0 1 /end COMPU_METHOD
/begin COMPU_METHOD SAB_1004PROZENT2550_S2_S3 "int = ((phys * 2550) / 1004) - (0) %" RAT_FUNC "%4.3" "%" COEFFS 0 2.53984063745 0 0 0 1 /end COMPU_METHOD
/begin COMPU_METHOD SAB_1PROZENT_S2_S3 "int = ((phys * 1) / 1) - (0) %" RAT_FUNC "%1.0" "%" COEFFS 0 1 0 0 0 1 /end COMPU_METHOD
/begin COMPU_METHOD SAB_C_1CEL_S2_S3 "int = ((phys * 1) / 1) - (0) Grad Celsius" RAT_FUNC "%1.0" "Grad Celsius" COEFFS 0 1 0 0 0 1 /end COMPU_METHOD
/begin COMPU_METHOD SAB_C_CGT_1CEL_M40_S2_S3 "int = ((phys * 1) / 1) - (-40) Grad Celsius" RAT_FUNC "%1.0" "Grad Celsius" COEFFS 0 1 40 0 0 1 /end COMPU_METHOD
/begin COMPU_METHOD SAB_C_CMO_1CEL_M48_S2_S3 "int = ((phys * 1) / 1) - (-48) Grad Celsius" RAT_FUNC "%1.0" "Grad Celsius" COEFFS 0 1 48 0 0 1 /end COMPU_METHOD
/begin COMPU_METHOD SAB_FRQ_1HZ_S2_S3 "int = ((phys * 1) / 1) - (0) Hz" RAT_FUNC "%1.0" "Hz" COEFFS 0 1 0 0 0 1 /end COMPU_METHOD
/begin COMPU_METHOD SAB_I_MA10_S2_S3 "int = ((phys * 10) / 1) - (0) mA" RAT_FUNC "%4.3" "mA" COEFFS 0 10 0 0 0 1 /end COMPU_METHOD
/begin COMPU_METHOD SAB_K100_S2_S3 "int = ((phys * 100) / 1) - (0) -" RAT_FUNC "%4.3" "-" COEFFS 0 100 0 0 0 1 /end COMPU_METHOD
/begin COMPU_METHOD SAB_M_1NM_S2_S3 "int = ((phys * 1) / 1) - (0) Nm" RAT_FUNC "%1.0" "Nm" COEFFS 0 1 0 0 0 1 /end COMPU_METHOD
/begin COMPU_METHOD SAB_N_1RPM_S2_S3 "int = ((phys * 1) / 1) - (0) 1/min" RAT_FUNC "%1.0" "1/min" COEFFS 0 1 0 0 0 1 /end COMPU_METHOD
/begin COMPU_METHOD SAB_P_BAR2_S2_S3 "int = ((phys * 2) / 1) - (0) bar" RAT_FUNC "%4.3" "bar" COEFFS 0 2 0 0 0 1 /end COMPU_METHOD
/begin COMPU_METHOD SAB_STANDARD_S2_S3 "int = ((phys * 1) / 1) - (0) -" RAT_FUNC "%1.0" "-" COEFFS 0 1 0 0 0 1 /end COMPU_METHOD
/begin COMPU_METHOD SAB_T_10MS_S2_S3 "int = ((phys * 1) / 10) - (0) ms" RAT_FUNC "%4.3" "ms" COEFFS 0 0.1 0 0 0 1 /end COMPU_METHOD
/begin COMPU_METHOD SAB_T_10S_S2_S3 "int = ((phys * 1) / 10) - (0) s" RAT_FUNC "%4.3" "s" COEFFS 0 0.1 0 0 0 1 /end COMPU_METHOD
/begin COMPU_METHOD SAB_T_TIMER_100MS_S2_S3 "int = ((phys * 1) / 100) - (0) ms" RAT_FUNC "%4.3" "ms" COEFFS 0 0.01 0 0 0 1 /end COMPU_METHOD
/begin COMPU_METHOD SAB_T_TIMER_10MS_S2_S3 "int = ((phys * 1) / 10) - (0) ms" RAT_FUNC "%4.3" "ms" COEFFS 0 0.1 0 0 0 1 /end COMPU_METHOD
/begin COMPU_METHOD SAB_T_TIMER_1S_S2_S3 "int = ((phys * 1) / 1) - (0) s" RAT_FUNC "%1.0" "s" COEFFS 0 1 0 0 0 1 /end COMPU_METHOD
/begin COMPU_METHOD SAB_T_TIMER_1US_S2_S3 "int = ((phys * 1) / 1) - (0) us" RAT_FUNC "%1.0" "us" COEFFS 0 1 0 0 0 1 /end COMPU_METHOD
/begin COMPU_METHOD SAB_T_TIMER_5MS_S2_S3 "int = ((phys * 1) / 5) - (0) ms" RAT_FUNC "%4.3" "ms" COEFFS 0 0.2 0 0 0 1 /end COMPU_METHOD
/begin COMPU_METHOD SAB_T_TIMER_S10_S2_S3 "int = ((phys * 10) / 1) - (0) s" RAT_FUNC "%4.3" "s" COEFFS 0 10 0 0 0 1 /end COMPU_METHOD
/begin COMPU_METHOD SAB_U_1VOLT1000_S2_S3 "int = ((phys * 1000) / 1) - (0) Volt" RAT_FUNC "%4.3" "Volt" COEFFS 0 1000 0 0 0 1 /end COMPU_METHOD
/begin COMPU_METHOD SAB_U_1VOLT_S2_S3 "int = ((phys * 1) / 1) - (0) Volt" RAT_FUNC "%1.0" "Volt" COEFFS 0 1 0 0 0 1 /end COMPU_METHOD
/begin COMPU_METHOD SAB_U_VOLT1000_S2_S3 "int = ((phys * 1000) / 1) - (0) V" RAT_FUNC "%4.3" "V" COEFFS 0 1000 0 0 0 1 /end COMPU_METHOD
/begin COMPU_METHOD SAB_V_1KMH_S2_S3 "int = ((phys * 1) / 1) - (0) km/h" RAT_FUNC "%1.0" "km/h" COEFFS 0 1 0 0 0 1 /end COMPU_METHOD
/begin COMPU_METHOD SAB_V_KMH16_S2_S3 "int = ((phys * 16) / 1) - (0) km/h" RAT_FUNC "%4.3" "km/h" COEFFS 0 16 0 0 0 1 /end COMPU_METHOD
/begin COMPU_METHOD UMR___1_100_0_S5_S3 "int = ((phys * 100) / 1) - (0) [-]" RAT_FUNC "%3.2" "[-]" COEFFS 0 100 0 0 0 1 /end COMPU_METHOD
/begin COMPU_METHOD UMR___1_1_0_S5_S3 "int = ((phys * 1) / 1) - (0) [-]" RAT_FUNC "%1.0" "[-]" COEFFS 0 1 0 0 0 1 /end COMPU_METHOD
/begin COMPU_METHOD UMR_BAR__1_1000_0_S5_S3 "int = ((phys * 1000) / 1) - (0) [bar]" RAT_FUNC "%4.3" "[bar]" COEFFS 0 1000 0 0 0 1 /end COMPU_METHOD
/begin COMPU_METHOD UMR_BAR__1_1_0_S5_S3 "int = ((phys * 1) / 1) - (0) [bar]" RAT_FUNC "%1.0" "[bar]" COEFFS 0 1 0 0 0 1 /end COMPU_METHOD
/begin COMPU_METHOD UMR_GRAD__1_3_M128_S5_S3 "int = ((phys * 3) / 1) - (-128) [Grad]" RAT_FUNC "%4.3" "[Grad]" COEFFS 0 3 128 0 0 1 /end COMPU_METHOD
/begin COMPU_METHOD UMR_GRADC__1_1_0_S5_S3 "int = ((phys * 1) / 1) - (0) [°C]" RAT_FUNC "%1.0" "[°C]" COEFFS 0 1 0 0 0 1 /end COMPU_METHOD
/begin COMPU_METHOD UMR_GRADC__1_1_M40_S5_S3 "int = ((phys * 1) / 1) - (-40) [°C]" RAT_FUNC "%1.0" "[°C]" COEFFS 0 1 40 0 0 1 /end COMPU_METHOD
/begin COMPU_METHOD UMR_GRADC__1_1_M48_S5_S3 "int = ((phys * 1) / 1) - (-48) [°C]" RAT_FUNC "%1.0" "[°C]" COEFFS 0 1 48 0 0 1 /end COMPU_METHOD
/begin COMPU_METHOD UMR_KGM2__1_1000_0_S5_S3 "int = ((phys * 1000) / 1) - (0) [kg*m^2]" RAT_FUNC "%4.3" "[kg*m^2]" COEFFS 0 1000 0 0 0 1 /end COMPU_METHOD
/begin COMPU_METHOD UMR_MA__1_10_0_S5_S3 "int = ((phys * 10) / 1) - (0) [mA]" RAT_FUNC "%2.1" "[mA]" COEFFS 0 10 0 0 0 1 /end COMPU_METHOD
/begin COMPU_METHOD UMR_MSEC__10_1_0_S5_S3 "int = ((phys * 1) / 10) - (0) [ms]" RAT_FUNC "%1.0" "[ms]" COEFFS 0 0.1 0 0 0 1 /end COMPU_METHOD
/begin COMPU_METHOD UMR_MSEC__1_1_0_S5_S3 "int = ((phys * 1) / 1) - (0) [ms]" RAT_FUNC "%1.0" "[ms]" COEFFS 0 1 0 0 0 1 /end COMPU_METHOD
/begin COMPU_METHOD UMR_MSEC__30_1_0_S5_S3 "int = ((phys * 1) / 30) - (0) [ms]" RAT_FUNC "%1.0" "[ms]" COEFFS 0 0.0333333333333 0 0 0 1 /end COMPU_METHOD
/begin COMPU_METHOD UMR_NM__1_10_0_S5_S3 "int = ((phys * 10) / 1) - (0) [Nm]" RAT_FUNC "%2.1" "[Nm]" COEFFS 0 10 0 0 0 1 /end COMPU_METHOD
/begin COMPU_METHOD UMR_NM__1_1_0_S5_S3 "int = ((phys * 1) / 1) - (0) [Nm]" RAT_FUNC "%1.0" "[Nm]" COEFFS 0 1 0 0 0 1 /end COMPU_METHOD
/begin COMPU_METHOD UMR_NM__6_1_M34_S5_S3 "int = ((phys * 1) / 6) - (-34) [Nm]" RAT_FUNC "%1.0" "[Nm]" COEFFS 0 0.166666666667 34 0 0 1 /end COMPU_METHOD
/begin COMPU_METHOD UMR_PROZENT__20_51_0_S5_S3 "int = ((phys * 51) / 20) - (0) [%]" RAT_FUNC "%5.4" "[%]" COEFFS 0 2.55 0 0 0 1 /end COMPU_METHOD
/begin COMPU_METHOD UMR_U_MIN_1_1_0_S5_S3 "int = ((phys * 1) / 1) - (0) [U/min]" RAT_FUNC "%1.0" "[U/min]" COEFFS 0 1 0 0 0 1 /end COMPU_METHOD
/begin COMPU_METHOD UMR_U_MIN_32_1_0_S5_S3 "int = ((phys * 1) / 32) - (0) [U/min]" RAT_FUNC "%1.0" "[U/min]" COEFFS 0 0.03125 0 0 0 1 /end COMPU_METHOD
/begin COMPU_METHOD UMR_U_MINSEC_10_1_0_S5_S3 "int = ((phys * 1) / 10) - (0) [U/(min*s)]" RAT_FUNC "%1.0" "[U/(min*s)]" COEFFS 0 0.1 0 0 0 1 /end COMPU_METHOD
/begin CHARACTERISTIC CCH_HMHYS "Hysterese fuer Chiptemperatur" VALUE 0x1D73DD ZF_kw_ui8_S5_S3 100 UMR_GRADC__1_1_0_S5_S3 0 100 /end CHARACTERISTIC
/begin CHARACTERISTIC CCH_HMME "Chiptemperaturschwelle fuer Anforderung Momentenreduzierung" VALUE 0x1D73DB ZF_kw_ui8_S5_S3 240 UMR_GRADC__1_1_M40_S5_S3 -40 200 /end CHARACTERISTIC
/begin CHARACTERISTIC CCH_HOTMODE "Chiptemperaturschwelle fuer Anforderung Hot-Mode" VALUE 0x1D73D9 ZF_kw_ui8_S5_S3 240 UMR_GRADC__1_1_M40_S5_S3 -40 200 /end CHARACTERISTIC
/begin CHARACTERISTIC CCH_KUEHL1MAX "Chiptemperaturschwelle fuer Anforderung max. Kuehlleistung" VALUE 0x1D73D5 ZF_kw_ui8_S5_S3 240 UMR_GRADC__1_1_M40_S5_S3 -40 200 /end CHARACTERISTIC
/begin CHARACTERISTIC CCH_KUEHL2MAX "Chiptemperaturschwelle fuer Anforderung max. Kuehlleistung" VALUE 0x1D73D7 ZF_kw_ui8_S5_S3 240 UMR_GRADC__1_1_M40_S5_S3 -40 200 /end CHARACTERISTIC
/begin CHARACTERISTIC CGT_HMHYS "Hysterese fuer Getriebtemperatur" VALUE 0x1D73DC ZF_kw_ui8_S5_S3 100 UMR_GRADC__1_1_0_S5_S3 0 100 /end CHARACTERISTIC
/begin CHARACTERISTIC CGT_HMME "Getriebtemperaturschwelle fuer Anforderung Momentenreduzierung" VALUE 0x1D73DA ZF_kw_ui8_S5_S3 240 UMR_GRADC__1_1_M40_S5_S3 -40 200 /end CHARACTERISTIC
/begin CHARACTERISTIC CGT_HOTMODE "Getriebtemperaturschwelle fuer Anforderung Hot-Mode" VALUE 0x1D73D8 ZF_kw_ui8_S5_S3 240 UMR_GRADC__1_1_M40_S5_S3 -40 200 /end CHARACTERISTIC
/begin CHARACTERISTIC CGT_KUEHL1MAX "Getriebtemperaturschwelle fuer Anforderung max. Kuehlleistung" VALUE 0x1D73D4 ZF_kw_ui8_S5_S3 240 UMR_GRADC__1_1_M40_S5_S3 -40 200 /end CHARACTERISTIC
/begin CHARACTERISTIC CGT_KUEHL2MAX "Getriebtemperaturschwelle fuer Anforderung max. Kuehlleistung" VALUE 0x1D73D6 ZF_kw_ui8_S5_S3 240 UMR_GRADC__1_1_M40_S5_S3 -40 200 /end CHARACTERISTIC
/begin CHARACTERISTIC CIAE_HMHYS "Hysterese fuer IAE-Temperatur" VALUE 0x1D73DE ZF_kw_ui8_S5_S3 100 UMR_GRADC__1_1_0_S5_S3 0 100 /end CHARACTERISTIC
/begin CHARACTERISTIC CIAE_KUEHL1MAX "IAE-Temperaturschwelle für Anforderung max.Kühlerstufe" VALUE 0x1D8076 ZF_kw_ui16_S5_S3 340 UMR_GRADC__1_1_M40_S5_S3 -40 300 /end CHARACTERISTIC
/begin CHARACTERISTIC CIAE_KUEHL2MAX "IAE-Temperaturschwelle für Anforderung max.Kühlerstufe" VALUE 0x1D8078 ZF_kw_ui16_S5_S3 340 UMR_GRADC__1_1_M40_S5_S3 -40 300 /end CHARACTERISTIC
/begin CHARACTERISTIC CS_ADPULSHYS "Hysterese fuer Chiptemperatur" VALUE 0x1D775D ZF_kw_ui8_S5_S3 50 UMR_GRADC__1_1_0_S5_S3 0 50 /end CHARACTERISTIC
/begin CHARACTERISTIC CS_KUPPLMAXSPSAS "Temperaturschwelle zur Aktivierung der Beeinflussung der Spontanitätsstufe über Maxauswahl der Kupplungstemperatur" VALUE 0x1D82C2 ZF_kw_si16_S5_S3 500 UMR_GRADC__1_1_0_S5_S3 0 500 /end CHARACTERISTIC
/begin CHARACTERISTIC CS_KUPPL_1 "Temperaturschwelle 1 zur Aktivierung der zugeordneten Schutzmaßnahmen" VALUE 0x1D82BC ZF_kw_si16_S5_S3 500 UMR_GRADC__1_1_0_S5_S3 0 500 /end CHARACTERISTIC
/begin CHARACTERISTIC CS_KUPPL_2 "Temperaturschwelle 2 zur Aktivierung der zugeordneten Schutzmaßnahmen" VALUE 0x1D82BE ZF_kw_si16_S5_S3 500 UMR_GRADC__1_1_0_S5_S3 0 500 /end CHARACTERISTIC
/begin CHARACTERISTIC CS_KUPPL_3 "Temperaturschwelle 3 zur Aktivierung der zugeordneten Schutzmaßnahmen" VALUE 0x1D82C0 ZF_kw_si16_S5_S3 500 UMR_GRADC__1_1_0_S5_S3 0 500 /end CHARACTERISTIC
/begin CHARACTERISTIC CS_SCHALTUNG_URL "Temperaturschwelle Sonderfunktion Urluftdetektion" VALUE 0x1D775E ZF_kw_ui8_S5_S3 190 UMR_GRADC__1_1_M40_S5_S3 -40 150 /end CHARACTERISTIC
/begin CHARACTERISTIC DKIS_STALL "DKI-Schwelle fuer gefuehrte Getriebeschutz im Stallspeed" VALUE 0x1D777C ZF_kw_ui8_S5_S3 100 UMR_PROZENT__20_51_0_S5_S3 0 100 /end CHARACTERISTIC
/begin CHARACTERISTIC DKI_ADPULS "Maximale Lastaenderung waehrend Befuellpruefung" VALUE 0x1D7757 ZF_kw_ui8_S5_S3 100 UMR_PROZENT__20_51_0_S5_S3 0 100 /end CHARACTERISTIC
/begin CHARACTERISTIC D_BitmaskNIC "Bitmask for NIC" VALUE 0x191A14 ZF_KW_NAT16_S2_S3 65535 SAB_STANDARD_S2_S3 0 65535 /end CHARACTERISTIC
/begin CHARACTERISTIC D_CAN1BusBitmask "Bits to decide if the errocode for a BusOff or ErrorPassive on the CANBus must be set (bit0 allows to set the error in case of BusOff and Bit2 allows to set the error in case of ErrorPassive)" VALUE 0x191BED ZF_KW_NAT8_S2_S3 255 SAB_STANDARD_S2_S3 0 255 /end CHARACTERISTIC
/begin CHARACTERISTIC D_CAN2BusBitmask "Bits to decide if the errocode for a BusOff or ErrorPassive on the A-CANBus must be set (bit0 allows to set the error in case of BusOff and Bit2 allows to set the error in case of ErrorPassive)" VALUE 0x191BEE ZF_KW_NAT8_S2_S3 255 SAB_STANDARD_S2_S3 0 255 /end CHARACTERISTIC
/begin CHARACTERISTIC D_CAN_GROUP_FC "information about which message belongs to a group error code or to the same ECU" VAL_BLK 0x191F58 ZF_TAB_NAT8_S2_S3 20 SAB_STANDARD_S2_S3 0 20 MATRIX_DIM 64 1 1 /end CHARACTERISTIC
/begin CHARACTERISTIC D_CodingApp "Bitmask for bitwise activation of Sport button if selected by D_CodingVehOrCodingApp" VALUE 0x191A16 ZF_KW_NAT16_S2_S3 65535 SAB_STANDARD_S2_S3 0 65535 /end CHARACTERISTIC
/begin CHARACTERISTIC D_CodingElectrical "Bitmask for bitwise activation of NIC if selected by D_CodingVehOrCodingElectrical" VALUE 0x191A18 ZF_KW_NAT16_S2_S3 65535 SAB_STANDARD_S2_S3 0 65535 /end CHARACTERISTIC
/begin CHARACTERISTIC D_CodingVehOrCodingApp "Bitmask for bitwise selection of input signal iv_CodingAppl: bitx=0 bit x is taken from input signal iv_CodingAppl --- bitx=1 bit x is taken from D_CodingApp" VALUE 0x191A1A ZF_KW_NAT16_S2_S3 65535 SAB_STANDARD_S2_S3 0 65535 /end CHARACTERISTIC
/begin CHARACTERISTIC D_CodingVehOrCodingElectrical "Bitmask for bitwise selection of input signal iv_CodingElectrical: bitx=0 bit x is taken from input signal iv_CodingElectrical --- bitx=1 bit x is taken from D_CodingElectrical" VALUE 0x191A1C ZF_KW_NAT16_S2_S3 65535 SAB_STANDARD_S2_S3 0 65535 /end CHARACTERISTIC
/begin CHARACTERISTIC D_DCM_DIAGOBD_IDENT1 "Application parameter 1 for diagnosis of logistic data. 0+1:OBD MY or hash value 2:Country variant bit coded 3:Identification of the variant in decimal 4:Revision of DCM in decimal 5:Labelindex in ASCII 6+7:Release level in decimal" VAL_BLK 0x191FA4 ZF_TAB_NAT8_S2_S3 255 SAB_STANDARD_S2_S3 0 255 MATRIX_DIM 8 1 1 /end CHARACTERISTIC
/begin CHARACTERISTIC D_DCM_DIAGOBD_IDENT2 "Application parameter 1 for diagnosis of logistic data. 0+1:OBD MY or hash value 2:Country variant bit coded 3:Identification of the variant in decimal 4:Revision of DCM in decimal 5:Labelindex in ASCII 6+7: Release level in decimal" VAL_BLK 0x191FB0 ZF_TAB_NAT8_S2_S3 255 SAB_STANDARD_S2_S3 0 255 MATRIX_DIM 8 1 1 /end CHARACTERISTIC
/begin CHARACTERISTIC D_DcEPumpTh1 "First threshold of the pulse duty factor (PWM) from E-Pump" VALUE 0x191BD6 ZF_KW_NAT8_S2_S3 20 SAB_1PROZENT_S2_S3 0 20 /end CHARACTERISTIC
/begin CHARACTERISTIC D_DcEPumpTh2 "Second threshold of the pulse duty factor (PWM) from E-Pump" VALUE 0x191BD7 ZF_KW_NAT8_S2_S3 90 SAB_1PROZENT_S2_S3 0 90 /end CHARACTERISTIC
/begin CHARACTERISTIC D_DcEPumpTh3 "Third threshold of the pulse duty factor (PWM) from E-Pump" VALUE 0x191BD8 ZF_KW_NAT8_S2_S3 40 SAB_1PROZENT_S2_S3 60 100 /end CHARACTERISTIC
/begin CHARACTERISTIC D_EI_PosRealizedLThPErrMem "Treshold for recognize that pos. EI is too weak. Used for record in Primary-Error memory." VALUE 0x191BA4 ZF_KW_INT16_S3_S3 2000 SAB2_1PROZENT_S3_S3 -1000 1000 /end CHARACTERISTIC
/begin CHARACTERISTIC D_EI_PosRealizedLThSErrMem "Treshold for recognize that pos. EI is too weak. Used for record in Shadow-Error memory." VALUE 0x191B9C ZF_KW_INT16_S3_S3 2000 SAB2_1PROZENT_S3_S3 -1000 1000 /end CHARACTERISTIC
/begin CHARACTERISTIC D_EI_PosRealizedUThPErrMem "Treshold for recognize that pos. EI is too strong. Used for record in Primary-Error memory." VALUE 0x191BA6 ZF_KW_INT16_S3_S3 2000 SAB2_1PROZENT_S3_S3 -1000 1000 /end CHARACTERISTIC
/begin CHARACTERISTIC D_EI_PosRealizedUThSErrMem "Treshold for recognize that pos. EI is too strong. Used for record in Shadow-Error memory." VALUE 0x191B9E ZF_KW_INT16_S3_S3 2000 SAB2_1PROZENT_S3_S3 -1000 1000 /end CHARACTERISTIC
/begin CHARACTERISTIC D_EI_RedRealizedLThPErrMem "Treshold for recognize that red. EI is too weak. Used for record in Primary-Error memory." VALUE 0x191BA0 ZF_KW_INT16_S3_S3 2000 SAB2_1PROZENT_S3_S3 -1000 1000 /end CHARACTERISTIC
/begin CHARACTERISTIC D_EI_RedRealizedLThSErrMem "Treshold for recognize that red. EI is too weak. Used for record in Shadow-Error memory." VALUE 0x191B98 ZF_KW_INT16_S3_S3 2000 SAB2_1PROZENT_S3_S3 -1000 1000 /end CHARACTERISTIC
/begin CHARACTERISTIC D_EI_RedRealizedUThPErrMem "Treshold for recognize that red. EI is too strong. Used for record in Primary-Error memory." VALUE 0x191BA2 ZF_KW_INT16_S3_S3 2000 SAB2_1PROZENT_S3_S3 -1000 1000 /end CHARACTERISTIC
/begin CHARACTERISTIC D_EI_RedRealizedUThSErrMem "Treshold for recognize that red. EI is too strong. Used for record in Shadow-Error memory." VALUE 0x191B9A ZF_KW_INT16_S3_S3 2000 SAB2_1PROZENT_S3_S3 -1000 1000 /end CHARACTERISTIC
/begin CHARACTERISTIC D_EngInterventionNegTol "accepted tolerance range for neg. engine intervention" VALUE 0x191CCC ZF_KW_NAT8_S3_S3 100 SAB2_M_1NM_S3_S3 0 100 /end CHARACTERISTIC
/begin CHARACTERISTIC D_EngInterventionTol "accepted tolerance range for pos. engine intervention" VALUE 0x191CCB ZF_KW_NAT8_S3_S3 100 SAB2_M_1NM_S3_S3 0 100 /end CHARACTERISTIC
/begin CHARACTERISTIC D_EngIntervention_LM_EZA "Application parameter to adjust whether the engine intervention shall be realised via air intervention or by switching of cylinders" VALUE 0x191CC8 ZF_KW_NAT8_S3_S3 2 SAB2_STANDARD_S3_S3 0 2 /end CHARACTERISTIC
/begin CHARACTERISTIC D_Filt_v_WheelActiveAvgNew "Application parameter weighting the current value of v_WheelActiveAvg in filter algorithm" VALUE 0x191C3D ZF_KW_NAT8_S2_S3 31 SAB_STANDARD_S2_S3 0 31 /end CHARACTERISTIC
/begin CHARACTERISTIC D_Filt_v_WheelActiveAvgOld "Application parameter weighting the former value of v_WheelActiveAvg in filter algorithm" VALUE 0x191C3E ZF_KW_NAT8_S2_S3 31 SAB_STANDARD_S2_S3 0 31 /end CHARACTERISTIC
/begin CHARACTERISTIC D_GbxReinforcementMax "Application parameter for maximal value of gearbox reinforcement" VALUE 0x191BBA ZF_KW_NAT16_S3_S3 127 SAB2_K8_S3_S3 0 127 /end CHARACTERISTIC
/begin CHARACTERISTIC D_GbxReinforcementMin "Application parameter for minimal value of gearbox reinforcement" VALUE 0x191BB8 ZF_KW_NAT16_S3_S3 127 SAB2_K8_S3_S3 0 127 /end CHARACTERISTIC
/begin CHARACTERISTIC D_GearboxReinforcementDef "Substitute value if no valid input." VALUE 0x191BBC ZF_KW_NAT16_S3_S3 8191.88 SAB2_K8_S3_S3 0 8191.875 /end CHARACTERISTIC
/begin CHARACTERISTIC D_GearboxReinforcementDefSts "Status substitute value if no valid input." VALUE 0x191CD3 ZF_KW_NAT8_S3_S3 2 SAB2_STANDARD_S3_S3 0 2 /end CHARACTERISTIC
/begin CHARACTERISTIC D_GearboxReinforcementErr "Error value for invalid input signal." VALUE 0x191BBE ZF_KW_NAT16_S3_S3 8191.88 SAB2_K8_S3_S3 0 8191.875 /end CHARACTERISTIC
/begin CHARACTERISTIC D_GearboxReinforcementFactor "Application parameter to change output quantization factor of gearbox reinforcement" VALUE 0x191BB6 ZF_KW_NAT16_S3_S3 7158 SAB2_STANDARD_S3_S3 10 7168 /end CHARACTERISTIC
/begin CHARACTERISTIC D_IG_HA_Default "Application parameter for default value of rear axle ratio if learning function passiv" VALUE 0x191AE2 ZF_KW_NAT16_S2_S3 9.99 SAB_K100_S2_S3 0.01 10 /end CHARACTERISTIC
/begin CHARACTERISTIC D_IG_HA_Tab "Application parameter field filled with possible values for RearAxleRatio" VAL_BLK 0x191FBC ZF_TAB_NAT16_S2_S3 4.27 SAB_K100_S2_S3 0 4.27 MATRIX_DIM 20 1 1 /end CHARACTERISTIC
/begin CHARACTERISTIC D_KMN_DiagnosticFunctCAN1 "Parameter to define which error measures codes between 0 and 31 lead to: K0 is not open" VALUE 0x192608 ZF_KW_NAT32_S3_S3 4294970000 SAB2_STANDARD_S3_S3 0 4294967295 /end CHARACTERISTIC
/begin CHARACTERISTIC D_KMN_DiagnosticFunctCAN2 "Parameter to define which error measures codes between 0 and 31 lead to: K0 is not close" VALUE 0x192610 ZF_KW_NAT32_S3_S3 4294970000 SAB2_STANDARD_S3_S3 0 4294967295 /end CHARACTERISTIC
/begin CHARACTERISTIC D_KMN_DiagnosticFunctCAN5 "Parameter to define which error measures codes between 0 and 31 lead to: HAS run impossible" VALUE 0x192618 ZF_KW_NAT32_S3_S3 4294970000 SAB2_STANDARD_S3_S3 0 4294967295 /end CHARACTERISTIC
/begin CHARACTERISTIC D_KMN_DiagnosticFunctCAN8 "Parameter to define which error measures codes between 0 and 31 lead to: by-passed run" VALUE 0x192620 ZF_KW_NAT32_S3_S3 4294970000 SAB2_STANDARD_S3_S3 0 4294967295 /end CHARACTERISTIC
/begin CHARACTERISTIC D_KMN_DiagnosticFunctCANHi1 "Parameter to define which error measures codes between 32 and 63 lead to: K0 is not open" VALUE 0x19260C ZF_KW_NAT32_S3_S3 4294970000 SAB2_STANDARD_S3_S3 0 4294967295 /end CHARACTERISTIC
/begin CHARACTERISTIC D_KMN_DiagnosticFunctCANHi2 "Parameter to define which error measures codes between 32 and 63 lead to: K0 is not close / slip monitoring" VALUE 0x192614 ZF_KW_NAT32_S3_S3 4294970000 SAB2_STANDARD_S3_S3 0 4294967295 /end CHARACTERISTIC
/begin CHARACTERISTIC D_KMN_DiagnosticFunctCANHi5 "Parameter to define which error measures codes between 32 and 63 lead to: HAS run impossible" VALUE 0x19261C ZF_KW_NAT32_S3_S3 4294970000 SAB2_STANDARD_S3_S3 0 4294967295 /end CHARACTERISTIC
/begin CHARACTERISTIC D_KMN_DiagnosticFunctCANHi8 "Parameter to define which error measures codes between 32 and 63 lead to: by-passed run" VALUE 0x192624 ZF_KW_NAT32_S3_S3 4294970000 SAB2_STANDARD_S3_S3 0 4294967295 /end CHARACTERISTIC
/begin CHARACTERISTIC D_KplHyb "Application Field of torque converter states" MAP 0x192638 ZF_TAB2D_NAT8_S3_S3 7 SAB2_STANDARD_S3_S3 0 7
 /begin AXIS_DESCR FIX_AXIS NO_INPUT_QUANTITY SAB2_STANDARD_S3_S3 3 1 3 READ_ONLY FIX_AXIS_PAR_DIST 1 1 3 /end AXIS_DESCR
 /begin AXIS_DESCR FIX_AXIS NO_INPUT_QUANTITY SAB2_STANDARD_S3_S3 9 1 9 READ_ONLY FIX_AXIS_PAR_DIST 1 1 9 /end AXIS_DESCR
/end CHARACTERISTIC
/begin CHARACTERISTIC D_KplHybShifting "Parameter of torque converter state 'release gear'" VALUE 0x191CD8 ZF_KW_NAT8_S3_S3 7 SAB2_STANDARD_S3_S3 0 7 /end CHARACTERISTIC
/begin CHARACTERISTIC D_ManualPreAdapService "manual start/stop Preadaption Service 0==deactivated 1==start" VALUE 0x191C47 ZF_KW_NAT8_S2_S3 1 SAB_STANDARD_S2_S3 0 1 /end CHARACTERISTIC
/begin CHARACTERISTIC D_MappingAbortPreadaption "Mapping table tester service SOC and costumer abort reason" MAP 0x191FE8 ZF_TAB2D_NAT8_S2_S3 255 SAB_STANDARD_S2_S3 0 255
 /begin AXIS_DESCR FIX_AXIS NO_INPUT_QUANTITY SAB_STANDARD_S2_S3 32 0 31 READ_ONLY FIX_AXIS_PAR_DIST 0 1 32 /end AXIS_DESCR
 /begin AXIS_DESCR FIX_AXIS NO_INPUT_QUANTITY SAB_STANDARD_S2_S3 3 0 2 READ_ONLY FIX_AXIS_PAR_DIST 0 1 3 /end AXIS_DESCR
/end CHARACTERISTIC
/begin CHARACTERISTIC D_NAB_PulseWidthTolBw "tolerance of the backward-pulsewidth for NAB" VALUE 0x191C35 ZF_KW_NAT8_S2_S3 255 SAB_T_TIMER_1US_S2_S3 0 255 /end CHARACTERISTIC
/begin CHARACTERISTIC D_NAB_PulseWidthTolFw "tolerance of the forward-pulsewidth for NAB" VALUE 0x191C34 ZF_KW_NAT8_S2_S3 255 SAB_T_TIMER_1US_S2_S3 0 255 /end CHARACTERISTIC
/begin CHARACTERISTIC D_NAB_PulseWidthTypBw "typical pulsewidth for the direction backward for NAB" VALUE 0x191C33 ZF_KW_NAT8_S2_S3 255 SAB_T_TIMER_1US_S2_S3 0 255 /end CHARACTERISTIC
/begin CHARACTERISTIC D_NAB_PulseWidthTypFw "typical pulsewidth for the direction forward for NAB" VALUE 0x191C32 ZF_KW_NAT8_S2_S3 255 SAB_T_TIMER_1US_S2_S3 0 255 /end CHARACTERISTIC
/begin CHARACTERISTIC D_NT_PulseWidthTolBw "tolerance of the backward-pulsewidth for NT" VALUE 0x191C39 ZF_KW_NAT8_S2_S3 255 SAB_T_TIMER_1US_S2_S3 0 255 /end CHARACTERISTIC
/begin CHARACTERISTIC D_NT_PulseWidthTolFw "tolerance of the forward-pulsewidth for NT" VALUE 0x191C38 ZF_KW_NAT8_S2_S3 255 SAB_T_TIMER_1US_S2_S3 0 255 /end CHARACTERISTIC
/begin CHARACTERISTIC D_NT_PulseWidthTypBw "typical pulsewidth for the direction backward for NT" VALUE 0x191C37 ZF_KW_NAT8_S2_S3 255 SAB_T_TIMER_1US_S2_S3 0 255 /end CHARACTERISTIC
/begin CHARACTERISTIC D_NT_PulseWidthTypFw "typical pulsewidth for the direction forward for NT" VALUE 0x191C36 ZF_KW_NAT8_S2_S3 255 SAB_T_TIMER_1US_S2_S3 0 255 /end CHARACTERISTIC
/begin CHARACTERISTIC D_PreadaptionState "Output value of WK when idle is active" VALUE 0x191CD9 ZF_KW_NAT8_S3_S3 15 SAB2_STANDARD_S3_S3 0 15 /end CHARACTERISTIC
/begin CHARACTERISTIC D_RzNinCruise_KMN_Hi "The Bitmap defines the higher bits which has to be evaluated for relevant KMNs" VALUE 0x191D14 ZF_KW_NAT32_S2_S3 4294970000 SAB_STANDARD_S2_S3 0 4294967295 /end CHARACTERISTIC
/begin CHARACTERISTIC D_RzNinCruise_KMN_Lo "The Bitmap defines the lower bits which has to be evaluated for relevant KMNs" VALUE 0x191D10 ZF_KW_NAT32_S2_S3 4294970000 SAB_STANDARD_S2_S3 0 4294967295 /end CHARACTERISTIC
/begin CHARACTERISTIC D_Status_K0_Array "Table of output values of sv_status_k0" VAL_BLK 0x192628 ZF_TAB_NAT8_S3_S3 63 SAB2_STANDARD_S3_S3 0 63 MATRIX_DIM 12 1 1 /end CHARACTERISTIC
/begin CHARACTERISTIC D_TX_ValueForLimphome "Coding of mechanical limphome" VALUE 0x191CCE ZF_KW_NAT8_S3_S3 255 SAB2_STANDARD_S3_S3 0 255 /end CHARACTERISTIC
/begin CHARACTERISTIC D_TabRzNinCruiseCnt_KFC "List of relevant KFCs that should be checked after a RzN reset. If one of those KFC is still active the reset failed" CURVE 0x191D90 ZF_KL_NAT16_S2_S3 65535 SAB_STANDARD_S2_S3 0 65535
 /begin AXIS_DESCR STD_AXIS NO_INPUT_QUANTITY SAB_STANDARD_S2_S3 29 0 65535 DEPOSIT ABSOLUTE /end AXIS_DESCR
/end CHARACTERISTIC
/begin CHARACTERISTIC D_TabRzNinCruise_KFC "List of relevant KFCs that could lead to a KMN" CURVE 0x191D18 ZF_KL_NAT16_S2_S3 65535 SAB_STANDARD_S2_S3 0 65535
 /begin AXIS_DESCR STD_AXIS NO_INPUT_QUANTITY SAB_STANDARD_S2_S3 29 0 65535 DEPOSIT ABSOLUTE /end AXIS_DESCR
/end CHARACTERISTIC
/begin CHARACTERISTIC D_Tab_Azgkng "Application parameter for TCU-identifier/EGS-Kennung (0-200: Inhalt aus D_Tab_Azgkng wird als ASCII-Zeichen in die EGS-Kennung uebernommen; 201-224: Position eines Zeichens aus der 43-Softwarestandskennung (SW_STAND_ZFF) = applizierter_Wert minus 201)" VAL_BLK 0x191CFC ZF_TAB_NAT8_S2_S3 255 SAB_STANDARD_S2_S3 0 255 MATRIX_DIM 14 1 1 /end CHARACTERISTIC
/begin CHARACTERISTIC D_ThrottlePosition "Substitute value for ThrottleBlade" VALUE 0x191C08 ZF_KW_NAT8_S2_S3 100.006 SAB_1004PROZENT2550_S2_S3 0 100.00627451 /end CHARACTERISTIC
/begin CHARACTERISTIC D_ThrottlePositionVirt "Substitute value for virtual ThrottleBlade" VALUE 0x191C0A ZF_KW_NAT8_S2_S3 100.006 SAB_1004PROZENT2550_S2_S3 0 100.00627451 /end CHARACTERISTIC
/begin CHARACTERISTIC D_ThrottlePositionVirt_Raw100 "Raw value for 100% virtual ThrottleBlade" VALUE 0x191C09 ZF_KW_NAT8_S2_S3 199 SAB_1PROZENT_S2_S3 1 200 /end CHARACTERISTIC
/begin CHARACTERISTIC D_ThrottlePosition_Raw100 "Raw value for 100% ThrottleBlade" VALUE 0x191C07 ZF_KW_NAT8_S2_S3 199 SAB_1PROZENT_S2_S3 1 200 /end CHARACTERISTIC
/begin CHARACTERISTIC D_c_ChipOffset "offset between chiptemperature and oil temperature" VALUE 0x191C17 ZF_KW_NAT8_S2_S3 25 SAB_C_1CEL_S2_S3 0 25 /end CHARACTERISTIC
/begin CHARACTERISTIC D_c_Eng "Application parameter replacement value for engine temperature" VALUE 0x191C00 ZF_KW_NAT8_S2_S3 190 SAB_C_CMO_1CEL_M48_S2_S3 -48 142 /end CHARACTERISTIC
/begin CHARACTERISTIC D_c_OilHys_CGTLEV2 "Temperature difference to cancel a temperature jump" VALUE 0x191C53 ZF_KW_NAT8_S2_S3 215 SAB_C_1CEL_S2_S3 0 215 /end CHARACTERISTIC
/begin CHARACTERISTIC D_c_OilMax_CGTLEV2 "Temperature difference for detecting a temperature jump" VALUE 0x191C52 ZF_KW_NAT8_S2_S3 215 SAB_C_1CEL_S2_S3 0 215 /end CHARACTERISTIC
/begin CHARACTERISTIC D_c_OilTransSubst "replacement value of gearbox oil temperature" VALUE 0x191C18 ZF_KW_NAT8_S2_S3 255 SAB_C_CGT_1CEL_M40_S2_S3 -40 215 /end CHARACTERISTIC
/begin CHARACTERISTIC D_c_OilTrans_EIMon "Minimal value of gear oil temperature for activation of EI monitoring." VALUE 0x191CC0 ZF_KW_NAT8_S3_S3 255 SAB2_C_CGT_1CEL_M40_S3_S3 -40 215 /end CHARACTERISTIC
/begin CHARACTERISTIC D_c_Th_CCHIP12LEV2 "Schwelle Plaisibilisierung der CChip Sensor" VALUE 0x191C57 ZF_KW_NAT8_S2_S3 215 SAB_C_1CEL_S2_S3 0 215 /end CHARACTERISTIC
/begin CHARACTERISTIC D_c_TolCheck_CGTLEV2 "Schwelle in der sich die Temperatur bewegen darf damit auf das kleine Temperaturband umgeschaltet werden kann" VALUE 0x191C56 ZF_KW_NAT8_S2_S3 215 SAB_C_1CEL_S2_S3 0 215 /end CHARACTERISTIC
/begin CHARACTERISTIC D_c_TolClose_CGTLEV2 "Small tolerance for iv_c_OilTrans at major temperature gradients" VALUE 0x191C55 ZF_KW_NAT8_S2_S3 215 SAB_C_1CEL_S2_S3 0 215 /end CHARACTERISTIC
/begin CHARACTERISTIC D_c_TolWide_CGTLEV2 "Wide tolerance for iv_c_OilTrans at major temperature gradients" VALUE 0x191C54 ZF_KW_NAT8_S2_S3 215 SAB_C_1CEL_S2_S3 0 215 /end CHARACTERISTIC
/begin CHARACTERISTIC D_cdmaxGrad "adapt supply temp of model sampling points x: SAB_C_1CEL_M40 and sampling points y: Grad C/10s" CURVE 0x192050 ZF_KL_NAT8_S2_S3 255 SAB_C_1CEL_S2_S3 0 255
 /begin AXIS_DESCR STD_AXIS NO_INPUT_QUANTITY SAB_C_CGT_1CEL_M40_S2_S3 6 -40 215 DEPOSIT ABSOLUTE /end AXIS_DESCR
/end CHARACTERISTIC
/begin CHARACTERISTIC D_cnt_LimphomeRst "Maximum number of resets" VALUE 0x191BE4 ZF_KW_NAT8_S2_S3 255 SAB_STANDARD_S2_S3 0 255 /end CHARACTERISTIC
/begin CHARACTERISTIC D_ctl_GearLimit "gears to be suppressed when gear suppression is active" VALUE 0x191C0E ZF_KW_NAT8_S2_S3 63 SAB_STANDARD_S2_S3 0 63 /end CHARACTERISTIC
/begin CHARACTERISTIC D_frq_HoldDirection "defined frequency threshold value of the speedsensor to hold the direction if frequency is higher than this value" VALUE 0x191AD6 ZF_KW_NAT16_S2_S3 15000 SAB_FRQ_1HZ_S2_S3 0 15000 /end CHARACTERISTIC
/begin CHARACTERISTIC D_i_EdsTolTh "Tolerance value of pressure regulator control current - if all currents are in the tolerance range the gear ratio is calculated" VALUE 0x191A9A ZF_KW_NAT16_S2_S3 250 SAB_I_MA10_S2_S3 0 250 /end CHARACTERISTIC
/begin CHARACTERISTIC D_k_AbNew_CAN "filtering-factor of n_AbFilt" VALUE 0x191C63 ZF_KW_NAT8_S2_S3 19 SAB_STANDARD_S2_S3 1 20 /end CHARACTERISTIC
/begin CHARACTERISTIC D_k_AbNew_HALearn "Applikationsgroesse Filter" VALUE 0x191C3F ZF_KW_NAT8_S2_S3 19 SAB_STANDARD_S2_S3 1 20 /end CHARACTERISTIC
/begin CHARACTERISTIC D_k_AbOld_CAN "filtering-factor of n_AbFilt" VALUE 0x191C62 ZF_KW_NAT8_S2_S3 20 SAB_STANDARD_S2_S3 0 20 /end CHARACTERISTIC
/begin CHARACTERISTIC D_k_AbOld_HALearn "Applikationsgroesse Filter" VALUE 0x191C40 ZF_KW_NAT8_S2_S3 20 SAB_STANDARD_S2_S3 0 20 /end CHARACTERISTIC
/begin CHARACTERISTIC D_k_MtoP "constant for aproximating the brakepressure signal" VALUE 0x191BEA ZF_KW_NAT8_S2_S3 254 SAB_STANDARD_S2_S3 1 255 /end CHARACTERISTIC
/begin CHARACTERISTIC D_k_Ntu "scaling-factor for GET_NTU_CAN" VALUE 0x191C68 ZF_KW_NAT8_S2_S3 7 SAB_STANDARD_S2_S3 1 8 /end CHARACTERISTIC
/begin CHARACTERISTIC D_k_TuNew "filtering-factor of GET_NTU_FILTER" VALUE 0x191C65 ZF_KW_NAT8_S2_S3 19 SAB_STANDARD_S2_S3 1 20 /end CHARACTERISTIC
/begin CHARACTERISTIC D_k_TuNew_CAN "filtering-factor of GET_NTU_CAN" VALUE 0x191C67 ZF_KW_NAT8_S2_S3 19 SAB_STANDARD_S2_S3 1 20 /end CHARACTERISTIC
/begin CHARACTERISTIC D_k_TuOld "filtering-factor of GET_NTU_FILTER" VALUE 0x191C64 ZF_KW_NAT8_S2_S3 20 SAB_STANDARD_S2_S3 0 20 /end CHARACTERISTIC
/begin CHARACTERISTIC D_k_TuOld_CAN "filtering-factor of GET_NTU_CAN" VALUE 0x191C66 ZF_KW_NAT8_S2_S3 20 SAB_STANDARD_S2_S3 0 20 /end CHARACTERISTIC
/begin CHARACTERISTIC D_k_m_MaxK0NewCan "Filtration degree of sv_m_MaxK0" VALUE 0x191CD4 ZF_KW_NAT8_S3_S3 19 SAB2_STANDARD_S3_S3 1 20 /end CHARACTERISTIC
/begin CHARACTERISTIC D_k_m_MaxK0OldCan "Filtration degree of sv_m_MaxK0" VALUE 0x191CD5 ZF_KW_NAT8_S3_S3 20 SAB2_STANDARD_S3_S3 0 20 /end CHARACTERISTIC
/begin CHARACTERISTIC D_mIntegral_EIMonTh "Minimal absolute value of mIntegral_EI_requestedRelative to decide if the monitoring have a sense; [0] - Pos Me + Up Shifting; [1] - Pos Me + Down Shifting; [2] - Red Me + Up Shifting; [3] - Red Me + Down Shifting;" VAL_BLK 0x192600 ZF_TAB_NAT8_S3_S3 50 SAB2_MINTEGRAL_1NMS_S3_S3 0 50 MATRIX_DIM 4 1 1 /end CHARACTERISTIC
/begin CHARACTERISTIC D_m_EIMonTh "Minimal value of requested EI for activation of EI monitoring." VALUE 0x191B96 ZF_KW_INT16_S3_S3 65535 SAB2_M_1NM_S3_S3 -32768 32767 /end CHARACTERISTIC
/begin CHARACTERISTIC D_m_EngInterventionLth "Application parameter for low threshold for reduced ATSYS-EI; for cases when n_t failure is set." VALUE 0x191BAE ZF_KW_INT16_S3_S3 65535 SAB2_M_1NM_S3_S3 -32768 32767 /end CHARACTERISTIC
/begin CHARACTERISTIC D_m_EngMaxError "Application parameter of engine torque treshold - Overrun causes an error." VALUE 0x191BAC ZF_KW_INT16_S3_S3 65535 SAB2_M_1NM_S3_S3 -32768 32767 /end CHARACTERISTIC
/begin CHARACTERISTIC D_m_EngMaxLTh "Application parameter of lower limitation of max. allowed engine torque." VALUE 0x191BAA ZF_KW_INT16_S3_S3 65535 SAB2_M_1NM_S3_S3 -32768 32767 /end CHARACTERISTIC
/begin CHARACTERISTIC D_m_GearboxGuardActiveHys "Hysteresis changing active to inactive gearbox guard" VALUE 0x191BA8 ZF_KW_NAT16_S3_S3 1000 SAB2_M_1NM_S3_S3 0 1000 /end CHARACTERISTIC
/begin CHARACTERISTIC D_m_IstEM1 "Substituted value for m_IstEM1" VALUE 0x191BF3 ZF_KW_INT8_S2_S3 30 SAB_M_1NM_S2_S3 -15 15 /end CHARACTERISTIC
/begin CHARACTERISTIC D_m_IstVM_Default "Substituted value for m_IstVM" VALUE 0x191A28 ZF_KW_NAT16_S2_S3 1640 SAB_M_1NM_S2_S3 0 1640 /end CHARACTERISTIC
/begin CHARACTERISTIC D_m_Reserve "Application parameter replacement value for actual torque reserve" VALUE 0x191B06 ZF_KW_INT16_S2_S3 1000 SAB_M_1NM_S2_S3 0 1000 /end CHARACTERISTIC
/begin CHARACTERISTIC D_me_Luft_Reserve "Application parameter for overweighting the air intervention" VALUE 0x191CC9 ZF_KW_NAT8_S3_S3 255 SAB2_M_1NM_S3_S3 0 255 /end CHARACTERISTIC
/begin CHARACTERISTIC D_n6WheelTh "Activation threshold for f_n6WheelErr" VALUE 0x191A96 ZF_KW_NAT16_S2_S3 11000 SAB_N_1RPM_S2_S3 0 11000 /end CHARACTERISTIC
/begin CHARACTERISTIC D_n6WheelThRtn "Deactivation threshold for f_n6WheelErr" VALUE 0x191A98 ZF_KW_NAT16_S2_S3 11000 SAB_N_1RPM_S2_S3 0 11000 /end CHARACTERISTIC
/begin CHARACTERISTIC D_n_AbDeactLth_VUNPLAUSILEV2 "Drehzahlschwelle zur Deaktivierung sv_v_unplausi" VALUE 0x191AF2 ZF_KW_NAT16_S2_S3 11000 SAB_N_1RPM_S2_S3 0 11000 /end CHARACTERISTIC
/begin CHARACTERISTIC D_n_AbDif "Application parameter for max difference of n_Ab during time D_tmr_IG_HA_LearnDif" VALUE 0x191C3C ZF_KW_NAT8_S2_S3 255 SAB_N_1RPM_S2_S3 0 255 /end CHARACTERISTIC
/begin CHARACTERISTIC D_n_AbDirection "above this value check if the direction fits to the gearlevers position" VALUE 0x191ACE ZF_KW_NAT16_S2_S3 11000 SAB_N_1RPM_S2_S3 0 11000 /end CHARACTERISTIC
/begin CHARACTERISTIC D_n_AbGraThRtn_VUNPLAUSILEV2 "Drehzahlschwelle zur Erkennung Raederhochlauf" VALUE 0x191AEE ZF_KW_NAT16_S2_S3 11000 SAB_N_1RPM_S2_S3 0 11000 /end CHARACTERISTIC
/begin CHARACTERISTIC D_n_AbGraTh_VUNPLAUSILEV2 "Drehzahlschwelle zur Erkennung unzulaessig negativer Gradient" VALUE 0x191AEC ZF_KW_NAT16_S2_S3 11000 SAB_N_1RPM_S2_S3 0 11000 /end CHARACTERISTIC
/begin CHARACTERISTIC D_n_AbLearnLth "No description available" VALUE 0x191ADA ZF_KW_NAT16_S2_S3 65535 SAB_N_1RPM_S2_S3 0 65535 /end CHARACTERISTIC
/begin CHARACTERISTIC D_n_AbLth "lower threshold of n_ab" VALUE 0x191A8A ZF_KW_NAT16_S2_S3 11000 SAB_N_1RPM_S2_S3 0 11000 /end CHARACTERISTIC
/begin CHARACTERISTIC D_n_AbLth_ENGSIGEM "Test condition to ensure that vehicle has stopped - after a stop has been recogniced the error KFC_ENGSIGEM/KFA_FUNCSPEC01 might be switched to passive if also lever-position is switched to P - to enable driving with combustion engine with a closed K0 eve" VALUE 0x191A76 ZF_KW_NAT16_S2_S3 11000 SAB_N_1RPM_S2_S3 0 11000 /end CHARACTERISTIC
/begin CHARACTERISTIC D_n_AbLth_NWHEELPLAUSILEV2 "A detected error is valid only if the vehicle speed is higher than this threshold" VALUE 0x191AC2 ZF_KW_NAT16_S2_S3 11000 SAB_N_1RPM_S2_S3 0 11000 /end CHARACTERISTIC
/begin CHARACTERISTIC D_n_AbLth_SENSORLEV2 "Activation threshold for rpm plausibility check - below this speed the wheels may turn in different directions and leed to a wrong nWheelAvg" VALUE 0x191AC4 ZF_KW_NAT16_S2_S3 11000 SAB_N_1RPM_S2_S3 0 11000 /end CHARACTERISTIC
/begin CHARACTERISTIC D_n_AbLth_VUNPLAUSILEV2 "Drehzahlschwelle zur Aktivierung sv_v_unplausi" VALUE 0x191AF0 ZF_KW_NAT16_S2_S3 11000 SAB_N_1RPM_S2_S3 0 11000 /end CHARACTERISTIC
/begin CHARACTERISTIC D_n_AbMin "minimal sensable output speed - reinit necessary to apply" VALUE 0x191AC8 ZF_KW_NAT16_S2_S3 16535 SAB_N_1RPM_S2_S3 0 16535 /end CHARACTERISTIC
/begin CHARACTERISTIC D_n_AbNoTeeth "number of trigger-wheels teeth - reinit necessary to apply" VALUE 0x191C30 ZF_KW_NAT8_S2_S3 254 SAB_STANDARD_S2_S3 1 255 /end CHARACTERISTIC
/begin CHARACTERISTIC D_n_AbOffsetLevel "applicable RPM which is used after sensing the first tooth until more teeth are sensed or D_t_n_AbOffset is elapsed" VALUE 0x191ACC ZF_KW_NAT16_S2_S3 65535 SAB_N_1RPM_S2_S3 0 65535 /end CHARACTERISTIC
/begin CHARACTERISTIC D_n_AbRzNinCruise "Minimum rpm of transmission output to allow RzN" VALUE 0x191A06 ZF_KW_NAT16_S2_S3 11000 SAB_N_1RPM_S2_S3 0 11000 /end CHARACTERISTIC
/begin CHARACTERISTIC D_n_AbUThGearSubst1 "NAB-Threshold for (TYPE_UI8) 26)" VALUE 0x191A3E ZF_KW_NAT16_S2_S3 65535 SAB_N_1RPM_S2_S3 0 65535 /end CHARACTERISTIC
/begin CHARACTERISTIC D_n_AbUThGearSubst2 "NAB-Threshold for (TYPE_UI8) 27)" VALUE 0x191A40 ZF_KW_NAT16_S2_S3 65535 SAB_N_1RPM_S2_S3 0 65535 /end CHARACTERISTIC
/begin CHARACTERISTIC D_n_AbUThGearSubst3 "NAB-Threshold for (TYPE_UI8) 28)" VALUE 0x191A42 ZF_KW_NAT16_S2_S3 65535 SAB_N_1RPM_S2_S3 0 65535 /end CHARACTERISTIC
/begin CHARACTERISTIC D_n_AbUThGearSubst4 "NAB-Threshold for (TYPE_UI8) 29)" VALUE 0x191A44 ZF_KW_NAT16_S2_S3 65535 SAB_N_1RPM_S2_S3 0 65535 /end CHARACTERISTIC
/begin CHARACTERISTIC D_n_AbUThGearSubst5 "NAB-Threshold for (TYPE_UI8) 30)" VALUE 0x191A46 ZF_KW_NAT16_S2_S3 65535 SAB_N_1RPM_S2_S3 0 65535 /end CHARACTERISTIC
/begin CHARACTERISTIC D_n_AbUThGearSubst6 "NAB-Threshold for (TYPE_UI8) 31)" VALUE 0x191A48 ZF_KW_NAT16_S2_S3 65535 SAB_N_1RPM_S2_S3 0 65535 /end CHARACTERISTIC
/begin CHARACTERISTIC D_n_AbUth "upper threshold of n_ab" VALUE 0x191A8C ZF_KW_NAT16_S2_S3 11000 SAB_N_1RPM_S2_S3 0 11000 /end CHARACTERISTIC
/begin CHARACTERISTIC D_n_AbWheelTh "Activation threshold for f_n_AbWheelErr" VALUE 0x191A8E ZF_KW_NAT16_S2_S3 11000 SAB_N_1RPM_S2_S3 0 11000 /end CHARACTERISTIC
/begin CHARACTERISTIC D_n_AbWheelThRtn "Deactivation threshold for f_n_AbWheelErr" VALUE 0x191A90 ZF_KW_NAT16_S2_S3 11000 SAB_N_1RPM_S2_S3 0 11000 /end CHARACTERISTIC
/begin CHARACTERISTIC D_n_Ab_CalcMethodLth "Application parameter for upper threshold of gearbox reinforcement above n_Tu/n_Ab ratio is used" VALUE 0x191BB2 ZF_KW_NAT16_S3_S3 65535 SAB2_N_1RPM_S3_S3 0 65535 /end CHARACTERISTIC
/begin CHARACTERISTIC D_n_Ab_CalcMethodUth "Application parameter for lower threshold of gearbox reinforcement below n_Tu/n_Ab ratio is used" VALUE 0x191BB4 ZF_KW_NAT16_S3_S3 65535 SAB2_N_1RPM_S3_S3 0 65535 /end CHARACTERISTIC
/begin CHARACTERISTIC D_n_Ab_PowerDownLth "lower threshold for n_Ab Powerdown condition - if n_Ab is lower this threshold the SBW may informed to enable the shutdown. - if n_Ab is greater this threshold the power down gets blocked." VALUE 0x191AB8 ZF_KW_NAT16_S2_S3 10000 SAB_N_1RPM_S2_S3 0 10000 /end CHARACTERISTIC
/begin CHARACTERISTIC D_n_Ab_PreConTh "Communication Precondition Transmission Output Speed Threshold" VALUE 0x191A22 ZF_KW_NAT16_S2_S3 65535 SAB_N_1RPM_S2_S3 0 65535 /end CHARACTERISTIC
/begin CHARACTERISTIC D_n_Abn6Th "Activation threshold for f_n_Abn6Err" VALUE 0x191A92 ZF_KW_NAT16_S2_S3 11000 SAB_N_1RPM_S2_S3 0 11000 /end CHARACTERISTIC
/begin CHARACTERISTIC D_n_Abn6ThRtn "Deactivation threshold for f_n_Abn6Err" VALUE 0x191A94 ZF_KW_NAT16_S2_S3 11000 SAB_N_1RPM_S2_S3 0 11000 /end CHARACTERISTIC
/begin CHARACTERISTIC D_n_EEPromDataAgs "Size of layer AGS data area in 32-Bit words" VALUE 0x191BF8 ZF_KW_NAT8_S2_S3 254 SAB_STANDARD_S2_S3 0 254 /end CHARACTERISTIC
/begin CHARACTERISTIC D_n_EnTh1 "Engine threshold for (TYPE_UI8) 26)" VALUE 0x191A56 ZF_KW_NAT16_S2_S3 11000 SAB_N_1RPM_S2_S3 0 11000 /end CHARACTERISTIC
/begin CHARACTERISTIC D_n_EnTh2 "Engine threshold for (TYPE_UI8) 27)" VALUE 0x191A58 ZF_KW_NAT16_S2_S3 11000 SAB_N_1RPM_S2_S3 0 11000 /end CHARACTERISTIC
/begin CHARACTERISTIC D_n_EnTh3 "Engine threshold for (TYPE_UI8) 28) and KMN_G3FIX" VALUE 0x191A5A ZF_KW_NAT16_S2_S3 11000 SAB_N_1RPM_S2_S3 0 11000 /end CHARACTERISTIC
/begin CHARACTERISTIC D_n_EnTh4 "Engine threshold for (TYPE_UI8) 29) and KMN_G4FIX" VALUE 0x191A5C ZF_KW_NAT16_S2_S3 11000 SAB_N_1RPM_S2_S3 0 11000 /end CHARACTERISTIC
/begin CHARACTERISTIC D_n_EnTh5 "Engine threshold for (TYPE_UI8) 30) and KMN_G5FIX" VALUE 0x191A5E ZF_KW_NAT16_S2_S3 11000 SAB_N_1RPM_S2_S3 0 11000 /end CHARACTERISTIC
/begin CHARACTERISTIC D_n_EnTh6 "Engine threshold for (TYPE_UI8) 30)" VALUE 0x191A60 ZF_KW_NAT16_S2_S3 11000 SAB_N_1RPM_S2_S3 0 11000 /end CHARACTERISTIC
/begin CHARACTERISTIC D_n_EnUTh "Upper threshold of Engine-RPM" VALUE 0x191A6E ZF_KW_NAT16_S2_S3 10000 SAB_N_1RPM_S2_S3 0 10000 /end CHARACTERISTIC
/begin CHARACTERISTIC D_n_EngForceLearnRearAxleRatioOn "Engine speed threshold - needed to start forced learn" VALUE 0x191AE0 ZF_KW_NAT16_S2_S3 20000 SAB_N_1RPM_S2_S3 0 20000 /end CHARACTERISTIC
/begin CHARACTERISTIC D_n_EngIdleInit "Applicative init value for desired engine idle speed" VALUE 0x191A72 ZF_KW_NAT16_S2_S3 20000 SAB_N_1RPM_S2_S3 0 20000 /end CHARACTERISTIC
/begin CHARACTERISTIC D_n_EngLth_SABLev2 "Application parameter for value of motor rotation speed limit." VALUE 0x191BB0 ZF_KW_NAT16_S3_S3 11000 SAB2_STANDARD_S3_S3 0 11000 /end CHARACTERISTIC
/begin CHARACTERISTIC D_n_EngLth_SENSORLEV2 "Activation threshold for rpm plausibility check - below this threshold the oil pressure is not sufficient to activate clutches - iGang is not reliable" VALUE 0x191AC6 ZF_KW_NAT16_S2_S3 11000 SAB_N_1RPM_S2_S3 0 11000 /end CHARACTERISTIC
/begin CHARACTERISTIC D_n_EngOSModeTh "RPM Threshold for Engine" VALUE 0x191AAE ZF_KW_NAT16_S2_S3 65535 SAB_N_1RPM_S2_S3 0 65535 /end CHARACTERISTIC
/begin CHARACTERISTIC D_n_EngPlausi_CGTLEV2_CCHIP12LEV2 "engine / turbine speed threshold for inspection of plausibility" VALUE 0x191AA2 ZF_KW_NAT16_S2_S3 11000 SAB_N_1RPM_S2_S3 0 11000 /end CHARACTERISTIC
/begin CHARACTERISTIC D_n_EngRedHigh "Engine speed reduction threshold - severely reduced" VALUE 0x191A7C ZF_KW_NAT16_S2_S3 10000 SAB_N_1RPM_S2_S3 0 10000 /end CHARACTERISTIC
/begin CHARACTERISTIC D_n_EngRedNormal "Engine speed reduction threshold - not reduced" VALUE 0x191A78 ZF_KW_NAT16_S2_S3 10000 SAB_N_1RPM_S2_S3 0 10000 /end CHARACTERISTIC
/begin CHARACTERISTIC D_n_EngRedShort "Engine speed reduction threshold - minor reduced" VALUE 0x191A7A ZF_KW_NAT16_S2_S3 10000 SAB_N_1RPM_S2_S3 0 10000 /end CHARACTERISTIC
/begin CHARACTERISTIC D_n_EngThTuPlausi "Activation threshold for turbine speed plausibility check - below this threshold the oil pressure is not sufficient to activate clutches - iGang is not reliable" VALUE 0x191A9C ZF_KW_NAT16_S2_S3 11000 SAB_N_1RPM_S2_S3 0 11000 /end CHARACTERISTIC
/begin CHARACTERISTIC D_n_EngTh_SystemPressure "Threshold for engine sppeed - below this threshold the oil pressure is not sufficient to activate clutches - gearbox is not ready to drive" VALUE 0x191AA6 ZF_KW_NAT16_S2_S3 65535 SAB_N_1RPM_S2_S3 0 65535 /end CHARACTERISTIC
/begin CHARACTERISTIC D_n_EngTh_SystemPressureHys "Hysteresis values for D_n_EngTh_SystemPressure" VALUE 0x191AA8 ZF_KW_NAT16_S2_S3 65535 SAB_N_1RPM_S2_S3 0 65535 /end CHARACTERISTIC
/begin CHARACTERISTIC D_n_EngTolTh "Allowed tolerance value of n_TuVirtLev2 to n_EM =n_Eng -- used in state IAE over pressure for a n6 plausibility check" VALUE 0x191A9E ZF_KW_NAT16_S2_S3 11000 SAB_N_1RPM_S2_S3 0 11000 /end CHARACTERISTIC
/begin CHARACTERISTIC D_n_EngTuLth_CCHIP "Upper threshold of motor speed or turbine speed" VALUE 0x191AF6 ZF_KW_NAT16_S2_S3 65535 SAB_N_1RPM_S2_S3 0 65535 /end CHARACTERISTIC
/begin CHARACTERISTIC D_n_Eng_EIMon "Minimal value of engine speed for activation of EI monitoring." VALUE 0x191B94 ZF_KW_NAT16_S3_S3 10000 SAB2_N_1RPM_S3_S3 0 10000 /end CHARACTERISTIC
/begin CHARACTERISTIC D_n_Eng_PreConTh "Communication Precondition Engine Speed Threshold" VALUE 0x191A1E ZF_KW_NAT16_S2_S3 65535 SAB_N_1RPM_S2_S3 0 65535 /end CHARACTERISTIC
/begin CHARACTERISTIC D_n_Init_AbFilt_CAN "Init value of N_AB which is sent over CAN" VALUE 0x191B0A ZF_KW_NAT16_S2_S3 65535 SAB_N_1RPM_S2_S3 0 65535 /end CHARACTERISTIC
/begin CHARACTERISTIC D_n_Init_TuFilt_CAN "Init value of N_Tu which is sent over CAN" VALUE 0x191B0E ZF_KW_NAT16_S2_S3 65535 SAB_N_1RPM_S2_S3 0 65535 /end CHARACTERISTIC
/begin CHARACTERISTIC D_n_TuDir "applicable direction for n_Tu for the start-up case when car accelerates to 1 pulse per sampling cycle 0=undefined 1=forward 2=backward 3=standstill 4=out of pulse wide range 5=implausible signal" VALUE 0x191C3A ZF_KW_NAT8_S2_S3 5 SAB_STANDARD_S2_S3 0 5 /end CHARACTERISTIC
/begin CHARACTERISTIC D_n_TuMin "minimal sensable turbine speed - reinit necessary to apply" VALUE 0x191AD0 ZF_KW_NAT16_S2_S3 16535 SAB_N_1RPM_S2_S3 0 16535 /end CHARACTERISTIC
/begin CHARACTERISTIC D_n_TuNoTeeth "number of teeth of turbine speed impulse wheel" VALUE 0x191C31 ZF_KW_NAT8_S2_S3 254 SAB_STANDARD_S2_S3 1 255 /end CHARACTERISTIC
/begin CHARACTERISTIC D_n_TuOSModeTh "RPM Threshold for Turbine" VALUE 0x191AB0 ZF_KW_NAT16_S2_S3 65535 SAB_N_1RPM_S2_S3 0 65535 /end CHARACTERISTIC
/begin CHARACTERISTIC D_n_TuOffsetLevel "applicable RPM which is used after sensing the first tooth until more teeth are sensed or D_t_n_TuOffset is elapsed" VALUE 0x191AD4 ZF_KW_NAT16_S2_S3 65535 SAB_N_1RPM_S2_S3 0 65535 /end CHARACTERISTIC
/begin CHARACTERISTIC D_n_TuTh1 "Turbine threshold for (TYPE_UI8) 26)" VALUE 0x191A62 ZF_KW_NAT16_S2_S3 11000 SAB_N_1RPM_S2_S3 0 11000 /end CHARACTERISTIC
/begin CHARACTERISTIC D_n_TuTh2 "Turbine threshold for (TYPE_UI8) 27)" VALUE 0x191A64 ZF_KW_NAT16_S2_S3 11000 SAB_N_1RPM_S2_S3 0 11000 /end CHARACTERISTIC
/begin CHARACTERISTIC D_n_TuTh3 "Turbine threshold for (TYPE_UI8) 28) and KMN_G3FIX" VALUE 0x191A66 ZF_KW_NAT16_S2_S3 11000 SAB_N_1RPM_S2_S3 0 11000 /end CHARACTERISTIC
/begin CHARACTERISTIC D_n_TuTh4 "Turbine threshold for (TYPE_UI8) 29) and KMN_G4FIX" VALUE 0x191A68 ZF_KW_NAT16_S2_S3 11000 SAB_N_1RPM_S2_S3 0 11000 /end CHARACTERISTIC
/begin CHARACTERISTIC D_n_TuTh5 "Turbine threshold for (TYPE_UI8) 30) and KMN_G5FIX" VALUE 0x191A6A ZF_KW_NAT16_S2_S3 11000 SAB_N_1RPM_S2_S3 0 11000 /end CHARACTERISTIC
/begin CHARACTERISTIC D_n_TuTh6 "Turbine threshold for (TYPE_UI8) 31)" VALUE 0x191A6C ZF_KW_NAT16_S2_S3 11000 SAB_N_1RPM_S2_S3 0 11000 /end CHARACTERISTIC
/begin CHARACTERISTIC D_n_TuTolTh "Allowed tolerance value of n_TuVirtLev2 to n_TuVirt Lev1" VALUE 0x191AA0 ZF_KW_NAT16_S2_S3 11000 SAB_N_1RPM_S2_S3 0 11000 /end CHARACTERISTIC
/begin CHARACTERISTIC D_n_Turbine_PreConTh "Communication Precondition Turbine Speed Threshold" VALUE 0x191A20 ZF_KW_NAT16_S2_S3 65535 SAB_N_1RPM_S2_S3 0 65535 /end CHARACTERISTIC
/begin CHARACTERISTIC D_n_iGangAb_GearSubstC0Hys "description" VALUE 0x191A3C ZF_KW_NAT16_S2_S3 11000 SAB_N_1RPM_S2_S3 0 11000 /end CHARACTERISTIC
/begin CHARACTERISTIC D_n_iGangAb_GearSubstC0LTh "description" VALUE 0x191A38 ZF_KW_NAT16_S2_S3 11000 SAB_N_1RPM_S2_S3 0 11000 /end CHARACTERISTIC
/begin CHARACTERISTIC D_n_iGangAb_GearSubstC0Th "description" VALUE 0x191A3A ZF_KW_NAT16_S2_S3 11000 SAB_N_1RPM_S2_S3 0 11000 /end CHARACTERISTIC
/begin CHARACTERISTIC D_n_iGangAb_GearSubstIEPTh "description" VALUE 0x191A36 ZF_KW_NAT16_S2_S3 11000 SAB_N_1RPM_S2_S3 0 11000 /end CHARACTERISTIC
/begin CHARACTERISTIC D_n_iGangAb_GearSubstTh "VM Abwuergeschwelle" VALUE 0x191A32 ZF_KW_NAT16_S2_S3 11000 SAB_N_1RPM_S2_S3 0 11000 /end CHARACTERISTIC
/begin CHARACTERISTIC D_n_iGangAb_GearSubstUth "Gangeinlegeschwelle bei der der VM noch nicht gedrueckt wird" VALUE 0x191A34 ZF_KW_NAT16_S2_S3 11000 SAB_N_1RPM_S2_S3 0 11000 /end CHARACTERISTIC
/begin CHARACTERISTIC D_p_BrakeTh "pressure threshold for Lev2 output value" VALUE 0x191BE9 ZF_KW_NAT8_S2_S3 127.5 SAB_P_BAR2_S2_S3 0 127.5 /end CHARACTERISTIC
/begin CHARACTERISTIC D_t_CAN1BusDiagDelay "Delay time of A-CAN diagnosis after: ingition on or voltage out of range or bus disturbance." VALUE 0x191A10 ZF_KW_NAT16_S2_S3 655350 SAB_T_TIMER_10MS_S2_S3 0 655350 /end CHARACTERISTIC
/begin CHARACTERISTIC D_t_CAN2BusDiagDelay "Delay time of SBW-CAN diagnosis after: ingition on or voltage out of range or bus disturbance." VALUE 0x191A12 ZF_KW_NAT16_S2_S3 655350 SAB_T_TIMER_10MS_S2_S3 0 655350 /end CHARACTERISTIC
/begin CHARACTERISTIC D_t_CANDiagDelay "Diagnosis delay time for each CAN message after change of sv_KL15 Off to On" VAL_BLK 0x191E90 ZF_TAB_NAT16_S2_S3 655350 SAB_T_TIMER_10MS_S2_S3 0 655350 MATRIX_DIM 64 1 1 /end CHARACTERISTIC
/begin CHARACTERISTIC D_t_CANPaddleReceive "shows how often a valid can paddle signal has to be received" VALUE 0x191C5E ZF_KW_NAT8_S2_S3 25500 SAB_T_TIMER_100MS_S2_S3 0 25500 /end CHARACTERISTIC
/begin CHARACTERISTIC D_t_Currentconst "After this time has elapsed in a fixed gear the plausibility check is activated" VALUE 0x191C10 ZF_KW_NAT8_S2_S3 2550 SAB_T_TIMER_10MS_S2_S3 0 2550 /end CHARACTERISTIC
/begin CHARACTERISTIC D_t_DefaultEGSOFF "Default EGS Off time value if calculation failed" VALUE 0x192060 ZF_KW_NAT32_S2_S3 4294970000 SAB_T_TIMER_1S_S2_S3 0 4294967295 /end CHARACTERISTIC
/begin CHARACTERISTIC D_t_DelayBrake_VUNPLAUSILEV2 "Entprellzeit zur Erkennung -Bremse geloest-" VALUE 0x191C4A ZF_KW_NAT8_S2_S3 2550 SAB_T_TIMER_10MS_S2_S3 0 2550 /end CHARACTERISTIC
/begin CHARACTERISTIC D_t_DelayDeactGra_VUNPLAUSILEV2 "Entprellzeit zur Erkennung einer plausiblen Geschwindigkeit" VALUE 0x191C4B ZF_KW_NAT8_S2_S3 2550 SAB_T_TIMER_10MS_S2_S3 0 2550 /end CHARACTERISTIC
/begin CHARACTERISTIC D_t_DelayGra_VUNPLAUSILEV2 "Entprellzeit fuer die Gradientenerkennung" VALUE 0x191C49 ZF_KW_NAT8_S2_S3 2550 SAB_T_TIMER_10MS_S2_S3 0 2550 /end CHARACTERISTIC
/begin CHARACTERISTIC D_t_DelayNAbMaxCalc "debounce timer after unplausi before MAX selection is used" VALUE 0x191C61 ZF_KW_NAT8_S2_S3 1275 SAB_T_TIMER_5MS_S2_S3 0 1275 /end CHARACTERISTIC
/begin CHARACTERISTIC D_t_DelayTo_VUNPLAUSILEV2 "Timeoutzeit zur Deaktivierung sv_v_unplausi" VALUE 0x191AF4 ZF_KW_NAT16_S2_S3 255000 SAB_T_TIMER_10MS_S2_S3 0 255000 /end CHARACTERISTIC
/begin CHARACTERISTIC D_t_DiagDelayRtn_CCHIP12LEV2 "time for backward filtering of the plausibility flags" VALUE 0x191B02 ZF_KW_NAT16_S2_S3 6553.5 SAB_T_TIMER_S10_S2_S3 0 6553.5 /end CHARACTERISTIC
/begin CHARACTERISTIC D_t_DiagDelay_CCHIP12LEV2 "Zeit in der eine Abweischung zwischen den CChip Sensoren vorhanden sein muss" VALUE 0x191B00 ZF_KW_NAT16_S2_S3 6553.5 SAB_T_TIMER_S10_S2_S3 0 6553.5 /end CHARACTERISTIC
/begin CHARACTERISTIC D_t_EIMonActivDelay "Delay for end of EI integration after the f_EIMonActiv fall from 1 to 0." VALUE 0x191CC2 ZF_KW_NAT8_S3_S3 250 SAB2_T_10MS_S3_S3 0 250 /end CHARACTERISTIC
/begin CHARACTERISTIC D_t_EIMonDelay "Delay for start of EI integration; because of delay between request and realization of EI." VALUE 0x191CC1 ZF_KW_NAT8_S3_S3 250 SAB2_T_10MS_S3_S3 0 250 /end CHARACTERISTIC
/begin CHARACTERISTIC D_t_EI_IntegrationMin "Minimal duration of EI integration to admission of computed values." VALUE 0x191CC3 ZF_KW_NAT8_S3_S3 250 SAB2_T_10MS_S3_S3 0 250 /end CHARACTERISTIC
/begin CHARACTERISTIC D_t_EPumpTh1 "Threshold for the filtering of the permanent shut down of E-Pump" VALUE 0x191BD9 ZF_KW_NAT8_S2_S3 2550 SAB_T_TIMER_10MS_S2_S3 0 2550 /end CHARACTERISTIC
/begin CHARACTERISTIC D_t_EPumpTh2 "Threshold for the filtering of shut down of alive signal" VALUE 0x191BDA ZF_KW_NAT8_S2_S3 25.5 SAB_T_TIMER_S10_S2_S3 0 25.5 /end CHARACTERISTIC
/begin CHARACTERISTIC D_t_EPumpTh3 "Threshold for the filtering of the temporary shut down of E-Pump" VALUE 0x191BDB ZF_KW_NAT8_S2_S3 2550 SAB_T_TIMER_10MS_S2_S3 0 2550 /end CHARACTERISTIC
/begin CHARACTERISTIC D_t_ForceLearnRearAxleRatio "Application parameter for Force Learn timer - set LearnedFlag when elapsed" VALUE 0x191C44 ZF_KW_NAT8_S2_S3 2550 SAB_T_10S_S2_S3 0 2550 /end CHARACTERISTIC
/begin CHARACTERISTIC D_t_ForwardFilter_LIMPHOMECAN "Delay to announce an error" VALUE 0x191CCF ZF_KW_NAT8_S3_S3 2550 SAB2_T_TIMER_10MS_S3_S3 0 2550 /end CHARACTERISTIC
/begin CHARACTERISTIC D_t_HoldDirection "Delay time to inhibit undef driving direction; 0 ms = without inhibit" VALUE 0x191BF7 ZF_KW_NAT8_S2_S3 2550 SAB_T_TIMER_10MS_S2_S3 0 2550 /end CHARACTERISTIC
/begin CHARACTERISTIC D_t_HssOff "delay time for detection mechanischer Notlauf aktiv" VALUE 0x191A82 ZF_KW_NAT16_S2_S3 2550 SAB_T_TIMER_10MS_S2_S3 0 2550 /end CHARACTERISTIC
/begin CHARACTERISTIC D_t_IAEClose "This is the maximum time for a over pressure request of IAE" VALUE 0x191C12 ZF_KW_NAT8_S2_S3 2550 SAB_T_TIMER_10MS_S2_S3 0 2550 /end CHARACTERISTIC
/begin CHARACTERISTIC D_t_IAECloseDelay "If this time has elapsed it is assumed that the over pressure state has been reached by IAE" VALUE 0x191C13 ZF_KW_NAT8_S2_S3 2550 SAB_T_TIMER_10MS_S2_S3 0 2550 /end CHARACTERISTIC
/begin CHARACTERISTIC D_t_IEP_ShutdownDelay "IEP shutdown delay time" VALUE 0x191BE6 ZF_KW_NAT8_S2_S3 200 SAB_T_TIMER_10MS_S2_S3 0 200 /end CHARACTERISTIC
/begin CHARACTERISTIC D_t_IgnDelayPin "Minimum value of the system timer to allow Kl15 PIN on" VALUE 0x191C1F ZF_KW_NAT8_S2_S3 2550 SAB_T_TIMER_10MS_S2_S3 0 2550 /end CHARACTERISTIC
/begin CHARACTERISTIC D_t_IgnFilter "dropout delay time of the terminal 15 pin- after switching off terminal 15 f_KL15_Pin keeps on for this amount of time" VALUE 0x191C1B ZF_KW_NAT8_S2_S3 1000 SAB_T_TIMER_10MS_S2_S3 0 1000 /end CHARACTERISTIC
/begin CHARACTERISTIC D_t_IgnPlausiDelay "Time to delay Kl15 CAN on after TCU startup" VALUE 0x191C20 ZF_KW_NAT8_S2_S3 2550 SAB_T_TIMER_10MS_S2_S3 0 2550 /end CHARACTERISTIC
/begin CHARACTERISTIC D_t_IgnPlausiTol "maximum time that allows a difference between CAN and hardware signal on state change ON_OFF" VALUE 0x191C1E ZF_KW_NAT8_S2_S3 2550 SAB_T_TIMER_10MS_S2_S3 0 2550 /end CHARACTERISTIC
/begin CHARACTERISTIC D_t_PlausiMaxErrRtn_CGTLEV2 "time for backward filtering of the plausibility flags" VALUE 0x191AFE ZF_KW_NAT16_S2_S3 6553.5 SAB_T_TIMER_S10_S2_S3 0 6553.5 /end CHARACTERISTIC
/begin CHARACTERISTIC D_t_PlausiMaxErr_CGTLEV2 "Threshold value for error filtering" VALUE 0x191AFC ZF_KW_NAT16_S2_S3 6553.5 SAB_T_TIMER_S10_S2_S3 0 6553.5 /end CHARACTERISTIC
/begin CHARACTERISTIC D_t_Plausi_CGTLEV2_CCHIP12LEV2 "engine / turbine speed threshold for inspection of plausibility" VALUE 0x191AA4 ZF_KW_NAT16_S2_S3 6553.5 SAB_T_TIMER_S10_S2_S3 0 6553.5 /end CHARACTERISTIC
/begin CHARACTERISTIC D_t_PosZMax_PARK "Maximum allowed time of iv_PSens1 and iv_PSens2 to be 0 at the same time" VALUE 0x191C28 ZF_KW_NAT8_S2_S3 2550 SAB_T_TIMER_10MS_S2_S3 0 2550 /end CHARACTERISTIC
/begin CHARACTERISTIC D_t_ToStartVM "Time to debounce VehicleReadyToDrive in case of an electrical engine defect" VALUE 0x191C1A ZF_KW_NAT8_S2_S3 2550 SAB_T_TIMER_10MS_S2_S3 0 2550 /end CHARACTERISTIC
/begin CHARACTERISTIC D_t_TolCheck1_CGTLEV2 "Time interval for adapting of cnt_Tolerance to the respective temperature range reduction" VALUE 0x191AF8 ZF_KW_NAT16_S2_S3 6553.5 SAB_T_TIMER_S10_S2_S3 0 6553.5 /end CHARACTERISTIC
/begin CHARACTERISTIC D_t_TolCheck2_CGTLEV2 "Time interval for adapting of cnt_Tolerance to the respective temperature range extention" VALUE 0x191AFA ZF_KW_NAT16_S2_S3 6553.5 SAB_T_TIMER_S10_S2_S3 0 6553.5 /end CHARACTERISTIC
/begin CHARACTERISTIC D_t_debounceAnalogTip "debounce time of the analog tip signal" VALUE 0x191C5C ZF_KW_NAT8_S2_S3 150 SAB_T_TIMER_10MS_S2_S3 0 150 /end CHARACTERISTIC
/begin CHARACTERISTIC D_t_debounceLearnAnalogTip "Time the electrical status of the analog tip paddle must be constant valid - to recognize the analog tip paddle as learned" VALUE 0x191C5D ZF_KW_NAT8_S2_S3 2550 SAB_T_TIMER_10MS_S2_S3 0 2550 /end CHARACTERISTIC
/begin CHARACTERISTIC D_t_delay_1SENSORLEV2 "a detected error is valid only if this timer has elapsed" VALUE 0x191C2C ZF_KW_NAT8_S2_S3 2550 SAB_T_TIMER_10MS_S2_S3 0 2550 /end CHARACTERISTIC
/begin CHARACTERISTIC D_t_delay_Limphome "Delay before the reset takes places when a relevant KFC is still active" VALUE 0x191BE3 ZF_KW_NAT8_S2_S3 255 SAB_T_TIMER_1S_S2_S3 0 255 /end CHARACTERISTIC
/begin CHARACTERISTIC D_t_delay_LimphomeCnt "Delay before the global reset counters for failed or successful RzN resets will be incremented" VALUE 0x191BE5 ZF_KW_NAT8_S2_S3 2550 SAB_T_10MS_S2_S3 0 2550 /end CHARACTERISTIC
/begin CHARACTERISTIC D_t_delay_N6LEV2 "A detected error is valid only if this timer is not active anymore" VALUE 0x191C2A ZF_KW_NAT8_S2_S3 2550 SAB_T_TIMER_10MS_S2_S3 0 2550 /end CHARACTERISTIC
/begin CHARACTERISTIC D_t_delay_N6PLAUSILEV2 "A detected error is valide only if this timer is not active anymore" VALUE 0x191C2B ZF_KW_NAT8_S2_S3 2550 SAB_T_TIMER_10MS_S2_S3 0 2550 /end CHARACTERISTIC
/begin CHARACTERISTIC D_t_delay_NTUVIRTLEV2 "A detected error is valid only if this time has elapsed" VALUE 0x191C2E ZF_KW_NAT8_S2_S3 2550 SAB_T_TIMER_10MS_S2_S3 0 2550 /end CHARACTERISTIC
/begin CHARACTERISTIC D_t_delay_SENSORLEV2 "a detected error is valid only if this timer has elapsed" VALUE 0x191C2D ZF_KW_NAT8_S2_S3 2550 SAB_T_TIMER_10MS_S2_S3 0 2550 /end CHARACTERISTIC
/begin CHARACTERISTIC D_t_delay_USENS "A detected error is valid only if this timer is not active anymore" VALUE 0x191C48 ZF_KW_NAT8_S2_S3 2550 SAB_T_TIMER_10MS_S2_S3 0 2550 /end CHARACTERISTIC
/begin CHARACTERISTIC D_t_freeze_mgt_Aufn_CAN "Debounce time for signal states" VALUE 0x191BC0 ZF_KW_NAT16_S3_S3 655000 SAB2_T_TIMER_10MS_S3_S3 0 655000 /end CHARACTERISTIC
/begin CHARACTERISTIC D_t_hillholdDelay "start value for Delay-Timer of Hillhold function" VALUE 0x191C45 ZF_KW_NAT8_S2_S3 2550 SAB_T_TIMER_10MS_S2_S3 0 2550 /end CHARACTERISTIC
/begin CHARACTERISTIC D_t_holdStateVehicleReadyToDrive "Maximum time the vehicle ready to drive bit has to be hold" VALUE 0x191C19 ZF_KW_NAT8_S2_S3 25.5 SAB_T_TIMER_S10_S2_S3 0 25.5 /end CHARACTERISTIC
/begin CHARACTERISTIC D_t_nDiagDelay "After KL15 is switched to ON and this time has elapsed the plausibility check of - CAN provided - wheel speed signal is activated" VALUE 0x191C11 ZF_KW_NAT8_S2_S3 2550 SAB_T_TIMER_10MS_S2_S3 0 2550 /end CHARACTERISTIC
/begin CHARACTERISTIC D_t_nTuVirtLev2Delay "Diagnose delay for plausibility check of n_TuVirt level_1 (iv_n_Tu) to level_2 (n_TuVirtLev2)" VALUE 0x191C14 ZF_KW_NAT8_S2_S3 2550 SAB_T_TIMER_10MS_S2_S3 0 2550 /end CHARACTERISTIC
/begin CHARACTERISTIC D_t_nTuVirtPlausiErrDelay "Diagnose delay for setting of f_n_TuVirtPlausiErr flag on a too big difference of n_TuVirt level_1 (iv_n_Tu) to level_2 (n_TuVirtLev2)" VALUE 0x191C15 ZF_KW_NAT8_S2_S3 2550 SAB_T_TIMER_10MS_S2_S3 0 2550 /end CHARACTERISTIC
/begin CHARACTERISTIC D_t_n_AbOffset "timer for startup state to hold applicable RPM value D_n_AbOffsetLevel" VALUE 0x191ACA ZF_KW_NAT16_S2_S3 25500 SAB_T_TIMER_10MS_S2_S3 0 25500 /end CHARACTERISTIC
/begin CHARACTERISTIC D_t_n_TuOffset "timer for startup state to hold applicable RPM value D_n_TuOffsetLevel" VALUE 0x191AD2 ZF_KW_NAT16_S2_S3 25500 SAB_T_TIMER_10MS_S2_S3 0 25500 /end CHARACTERISTIC
/begin CHARACTERISTIC D_tmr_CAN_Hys "This hysteresis time determines how long the FACan stays primary CAN after the ACAN is valid again" VALUE 0x191BF0 ZF_KW_NAT8_S2_S3 2550 SAB_T_TIMER_10MS_S2_S3 0 2550 /end CHARACTERISTIC
/begin CHARACTERISTIC D_tmr_Delay_TurbineSpeedTx "timer to delay the the tx signal in error case" VALUE 0x191C69 ZF_KW_NAT8_S2_S3 2550 SAB_T_TIMER_10MS_S2_S3 0 2550 /end CHARACTERISTIC
/begin CHARACTERISTIC D_tmr_GearSubst "minimum time of forced N during D-substitute function Elektrisches Notprogramm 1. - 8. Gear" VALUE 0x191A2E ZF_KW_NAT16_S2_S3 655350 SAB_T_TIMER_10MS_S2_S3 0 655350 /end CHARACTERISTIC
/begin CHARACTERISTIC D_tmr_GearSubst1 "minimum time of forced N during D-substitute function Elektrisches Notprogramm KMN_ENPGxFIX" VALUE 0x191A30 ZF_KW_NAT16_S2_S3 655350 SAB_T_TIMER_10MS_S2_S3 0 655350 /end CHARACTERISTIC
/begin CHARACTERISTIC D_tmr_IEP_Test_LS1 "test time for IEP test power level 1" VALUE 0x191AE6 ZF_KW_NAT16_S2_S3 655350 SAB_T_TIMER_10MS_S2_S3 0 655350 /end CHARACTERISTIC
/begin CHARACTERISTIC D_tmr_IEP_Test_LS2 "test time for IEP test power level 2" VALUE 0x191AE8 ZF_KW_NAT16_S2_S3 655350 SAB_T_TIMER_10MS_S2_S3 0 655350 /end CHARACTERISTIC
/begin CHARACTERISTIC D_tmr_IEP_Test_LS3 "test time for IEP test power level 3" VALUE 0x191AEA ZF_KW_NAT16_S2_S3 655350 SAB_T_TIMER_10MS_S2_S3 0 655350 /end CHARACTERISTIC
/begin CHARACTERISTIC D_tmr_IG_HA_LearnDif "Application parameter for time during which n_Ab must not change for more than D_n_AbDif" VALUE 0x191AD8 ZF_KW_NAT16_S2_S3 655350 SAB_T_TIMER_10MS_S2_S3 0 655350 /end CHARACTERISTIC
/begin CHARACTERISTIC D_tmr_Init_n_AbFilt_aktiv "time how long the init value of N_AB is sent over CAN" VALUE 0x191B08 ZF_KW_NAT16_S2_S3 2000 SAB_T_TIMER_10MS_S2_S3 0 2000 /end CHARACTERISTIC
/begin CHARACTERISTIC D_tmr_Init_n_TuFilt_aktiv "time how long the init value of N_Tu is sent over CAN" VALUE 0x191B0C ZF_KW_NAT16_S2_S3 2000 SAB_T_TIMER_10MS_S2_S3 0 2000 /end CHARACTERISTIC
/begin CHARACTERISTIC D_tmr_PowerDown "delay time for powerdown condition. Delays the powerdown after ignition off. - this delay time occures before SBW gets informed to enable the shutdown." VALUE 0x191ABA ZF_KW_NAT16_S2_S3 65000 SAB_T_10MS_S2_S3 0 65000 /end CHARACTERISTIC
/begin CHARACTERISTIC D_tmr_PowerDown_IEP "delay time for _SET_IEP_SHUTDOWN" VALUE 0x191C29 ZF_KW_NAT8_S2_S3 2550 SAB_T_10MS_S2_S3 0 2550 /end CHARACTERISTIC
/begin CHARACTERISTIC D_tmr_PreadaptionSOC0x80 "threshold time for accepted undefined Preadaption status" VALUE 0x191AE4 ZF_KW_NAT16_S2_S3 655350 SAB_T_TIMER_10MS_S2_S3 0 655350 /end CHARACTERISTIC
/begin CHARACTERISTIC D_u_BattLimphomeLth "lower battery-voltage threshold for GearboxState" VALUE 0x191A7E ZF_KW_NAT16_S2_S3 24 SAB_U_1VOLT1000_S2_S3 0 24 /end CHARACTERISTIC
/begin CHARACTERISTIC D_u_BattLimphomeUth "upper battery-voltage threshold for GearboxState" VALUE 0x191A80 ZF_KW_NAT16_S2_S3 24 SAB_U_1VOLT1000_S2_S3 0 24 /end CHARACTERISTIC
/begin CHARACTERISTIC D_u_BattLth_BRAKEx "battery-voltage threshold for Diagnosis of KFC_BRAKEF" VALUE 0x191A08 ZF_KW_NAT16_S2_S3 24 SAB_U_1VOLT1000_S2_S3 0 24 /end CHARACTERISTIC
/begin CHARACTERISTIC D_u_BattLth_DOOR "battery-voltage threshold" VALUE 0x191A2A ZF_KW_NAT16_S2_S3 20 SAB_U_1VOLT1000_S2_S3 0 20 /end CHARACTERISTIC
/begin CHARACTERISTIC D_u_BattLth_ENGSIG "Test condition battery-voltage threshold for the Diagnosis of Engine signals" VALUE 0x191A74 ZF_KW_NAT16_S2_S3 20 SAB_U_1VOLT1000_S2_S3 0 20 /end CHARACTERISTIC
/begin CHARACTERISTIC D_u_BattLth_IEP "If the battery voltage is upper than this threshold one part of the testcondition of error code KFC_IEP is fullfilled" VALUE 0x191A02 ZF_KW_NAT16_S2_S3 20 SAB_U_1VOLT1000_S2_S3 0 20 /end CHARACTERISTIC
/begin CHARACTERISTIC D_u_BattLth_INFOHOT1 "batterie voltage threshold as testcondition for (TYPE_UI8) 139)" VALUE 0x191C50 ZF_KW_NAT8_S2_S3 24 SAB_U_1VOLT_S2_S3 0 24 /end CHARACTERISTIC
/begin CHARACTERISTIC D_u_BattLth_INFOHOT2 "batterie voltage threshold as testcondition for (TYPE_UI8) 140)" VALUE 0x191C51 ZF_KW_NAT8_S2_S3 24 SAB_U_1VOLT_S2_S3 0 24 /end CHARACTERISTIC
/begin CHARACTERISTIC D_u_BattLth_NMOFLL "If the battery voltage is higher than this threshold an error code (KFC_NMOFLL) is forward filtering" VALUE 0x191A70 ZF_KW_NAT16_S2_S3 24 SAB_U_1VOLT1000_S2_S3 0 24 /end CHARACTERISTIC
/begin CHARACTERISTIC D_u_BattLth_NWHEELLEV2 "Low battery threshold to detect the trouble code KFC_NWHEELLEV2" VALUE 0x191ABC ZF_KW_NAT16_S2_S3 20 SAB_U_1VOLT1000_S2_S3 0 20 /end CHARACTERISTIC
/begin CHARACTERISTIC D_u_BattLth_NWHEELPLAUSILEV2 "A detected error is valid only if battery voltage is higher than this threshold" VALUE 0x191AC0 ZF_KW_NAT16_S2_S3 20 SAB_U_1VOLT1000_S2_S3 0 20 /end CHARACTERISTIC
/begin CHARACTERISTIC D_u_BattLth_OBDCYCLES "Low battery threshold to detect the fault code KFC_OBDCYCLES" VALUE 0x191AAC ZF_KW_NAT16_S2_S3 20 SAB_U_1VOLT1000_S2_S3 0 20 /end CHARACTERISTIC
/begin CHARACTERISTIC D_u_BattLth_PARKASSIST "Battery-voltage as threshold for (TYPE_UI8) 189)" VALUE 0x191AB6 ZF_KW_NAT16_S2_S3 24 SAB_U_VOLT1000_S2_S3 0 24 /end CHARACTERISTIC
/begin CHARACTERISTIC D_u_BattLth_PINFO "battery-voltage threshold for KFC_PINFO" VALUE 0x191A84 ZF_KW_NAT16_S2_S3 20 SAB_U_1VOLT1000_S2_S3 0 20 /end CHARACTERISTIC
/begin CHARACTERISTIC D_u_BattLth_POSINFO1 "battery-voltage threshold" VALUE 0x191A88 ZF_KW_NAT16_S2_S3 20 SAB_U_1VOLT1000_S2_S3 0 20 /end CHARACTERISTIC
/begin CHARACTERISTIC D_u_BattLth_POSINFO2 "battery-voltage threshold" VALUE 0x191A86 ZF_KW_NAT16_S2_S3 20 SAB_U_1VOLT1000_S2_S3 0 20 /end CHARACTERISTIC
/begin CHARACTERISTIC D_u_BattLth_SEAT "battery-voltage threshold" VALUE 0x191A2C ZF_KW_NAT16_S2_S3 20 SAB_U_1VOLT1000_S2_S3 0 20 /end CHARACTERISTIC
/begin CHARACTERISTIC D_u_BattLth_TIPP "battery-voltage threshold" VALUE 0x191B04 ZF_KW_NAT16_S2_S3 20 SAB_U_1VOLT1000_S2_S3 0 20 /end CHARACTERISTIC
/begin CHARACTERISTIC D_u_BattOSModeLth "If the battery voltage is lower than this threshold it is not possible to switch from OSMode Standby to OSMode Cruse" VALUE 0x191AB4 ZF_KW_NAT16_S2_S3 65.535 SAB_U_1VOLT1000_S2_S3 0 65.535 /end CHARACTERISTIC
/begin CHARACTERISTIC D_u_BattOSModeUth "If the battery voltage is upper than this threshold it is not possible to switch from OSMode Standby to OSMode Cruse" VALUE 0x191AB2 ZF_KW_NAT16_S2_S3 65.535 SAB_U_1VOLT1000_S2_S3 0 65.535 /end CHARACTERISTIC
/begin CHARACTERISTIC D_u_BattUth_IEP "If the battery voltage is lower than this threshold one part of the testcondition of error code KFC_IEP is fullfilled" VALUE 0x191A04 ZF_KW_NAT16_S2_S3 20 SAB_U_1VOLT1000_S2_S3 0 20 /end CHARACTERISTIC
/begin CHARACTERISTIC D_u_BattUth_NWHEELLEV2 "Upper battery threshold to detect the trouble code KFC_NWHEELLEV2" VALUE 0x191ABE ZF_KW_NAT16_S2_S3 20 SAB_U_1VOLT1000_S2_S3 0 20 /end CHARACTERISTIC
/begin CHARACTERISTIC D_u_CanDiagHTh "if voltage gets above the threshold value the CAN diagnosis gets stopped" VALUE 0x191A0E ZF_KW_NAT16_S2_S3 60 SAB_U_1VOLT1000_S2_S3 0 60 /end CHARACTERISTIC
/begin CHARACTERISTIC D_u_CanDiagLTh "if voltage gets below the threshold value the CAN diagnosis gets stopped" VALUE 0x191A0C ZF_KW_NAT16_S2_S3 60 SAB_U_1VOLT1000_S2_S3 0 60 /end CHARACTERISTIC
/begin CHARACTERISTIC D_u_Diag "threshold voltage for CAN diagnosis" VALUE 0x191A0A ZF_KW_NAT16_S2_S3 20 SAB_U_1VOLT1000_S2_S3 0 20 /end CHARACTERISTIC
/begin CHARACTERISTIC D_u_KL15_PinLth "lower threshold to determine the f_KL15Pin on - if iv_u_KL15_Pin is lower D_u_KL15_PinLth then f_KL15Pin = (nat8)0) else f_KL15Pin = (nat8)1)" VALUE 0x191AAA ZF_KW_NAT16_S2_S3 65.535 SAB_U_1VOLT1000_S2_S3 0 65.535 /end CHARACTERISTIC
/begin CHARACTERISTIC D_v_Fzg_LIMPHOMECAN "Minimal speed to activate control function" VALUE 0x191CD0 ZF_KW_NAT8_S3_S3 255 SAB2_V_1KMH_S3_S3 0 255 /end CHARACTERISTIC
/begin CHARACTERISTIC D_v_ThGearSubst1 "Speed threshold for (TYPE_UI8) 26)" VALUE 0x191A4A ZF_KW_NAT16_S2_S3 500 SAB_V_1KMH_S2_S3 0 500 /end CHARACTERISTIC
/begin CHARACTERISTIC D_v_ThGearSubst2 "Speed threshold for (TYPE_UI8) 27)" VALUE 0x191A4C ZF_KW_NAT16_S2_S3 500 SAB_V_1KMH_S2_S3 0 500 /end CHARACTERISTIC
/begin CHARACTERISTIC D_v_ThGearSubst3 "Speed threshold for (TYPE_UI8) 28) and KMN_G3FIX" VALUE 0x191A4E ZF_KW_NAT16_S2_S3 500 SAB_V_1KMH_S2_S3 0 500 /end CHARACTERISTIC
/begin CHARACTERISTIC D_v_ThGearSubst4 "Speed threshold for (TYPE_UI8) 29) and KMN_G4FIX" VALUE 0x191A50 ZF_KW_NAT16_S2_S3 500 SAB_V_1KMH_S2_S3 0 500 /end CHARACTERISTIC
/begin CHARACTERISTIC D_v_ThGearSubst5 "Speed threshold for (TYPE_UI8) 30) and KMN_G5FIX" VALUE 0x191A52 ZF_KW_NAT16_S2_S3 500 SAB_V_1KMH_S2_S3 0 500 /end CHARACTERISTIC
/begin CHARACTERISTIC D_v_ThGearSubst6 "Speed threshold for (TYPE_UI8) 31)" VALUE 0x191A54 ZF_KW_NAT16_S2_S3 500 SAB_V_1KMH_S2_S3 0 500 /end CHARACTERISTIC
/begin CHARACTERISTIC D_v_Veh_PreConTh "Communication Precondition Vehicle Speed Threshold" VALUE 0x191A24 ZF_KW_NAT16_S2_S3 65535 SAB_V_1KMH_S2_S3 0 65535 /end CHARACTERISTIC
/begin CHARACTERISTIC D_v_WheelDif "Application parameter for max difference of filtered v_WheelActiveAvg during time D_tmr_IG_HA_LearnDif" VALUE 0x191ADC ZF_KW_NAT16_S2_S3 12.5 SAB_V_KMH16_S2_S3 0 12.5 /end CHARACTERISTIC
/begin CHARACTERISTIC FI_ADANEU "Filteranzahl f.Gewichtung des neuen ADA-Werts" VALUE 0x1D775B ZF_kw_ui8_S5_S3 9 UMR___1_1_0_S5_S3 1 10 /end CHARACTERISTIC
/begin CHARACTERISTIC FI_NABALT "Filteranzahl n_ab alter Wert" VALUE 0x1D776F ZF_kw_ui8_S5_S3 10 UMR___1_1_0_S5_S3 0 10 /end CHARACTERISTIC
/begin CHARACTERISTIC FI_NABNEU "Filteranzahl n_ab neuer Wert" VALUE 0x1D776E ZF_kw_ui8_S5_S3 9 UMR___1_1_0_S5_S3 1 10 /end CHARACTERISTIC
/begin CHARACTERISTIC FI_NADAALT "Filteranzahl n_ab & n_t alter Wert" VALUE 0x1D73D3 ZF_kw_ui8_S5_S3 10 UMR___1_1_0_S5_S3 0 10 /end CHARACTERISTIC
/begin CHARACTERISTIC FI_NADANEU "Filteranzahl n_ab & n_t neuer Wert" VALUE 0x1D73D2 ZF_kw_ui8_S5_S3 9 UMR___1_1_0_S5_S3 1 10 /end CHARACTERISTIC
/begin CHARACTERISTIC FI_NTALT "Filteranzahl n_t alter Wert" VALUE 0x1D7771 ZF_kw_ui8_S5_S3 10 UMR___1_1_0_S5_S3 0 10 /end CHARACTERISTIC
/begin CHARACTERISTIC FI_NTNEU "Filteranzahl n_t neuer Wert" VALUE 0x1D7770 ZF_kw_ui8_S5_S3 9 UMR___1_1_0_S5_S3 1 10 /end CHARACTERISTIC
/begin CHARACTERISTIC HYS_CKUPPLMASS "Hysterese auf Temperaturschwellen für Schutzmaßnahmen bei der der Fehlereintrag wiede zurück genommen wird" VALUE 0x1D776A ZF_kw_ui8_S5_S3 100 UMR_GRADC__1_1_0_S5_S3 0 100 /end CHARACTERISTIC
/begin CHARACTERISTIC HYS_CKUPPLMAXSPSAS "Hysterese auf Temperaturschwellen zur Aktivierung der Beeinflussung der Spontanitätsstufe über Maxauswahl der Kupplungstemperatur" VALUE 0x1D776B ZF_kw_ui8_S5_S3 100 UMR_GRADC__1_1_0_S5_S3 0 100 /end CHARACTERISTIC
/begin CHARACTERISTIC HYS_NSMOTPUMPE "Hysterese der Motordrehzahl fuer Pumpendruck" VALUE 0x1D806C ZF_kw_si16_S5_S3 1000 UMR_U_MIN_1_1_0_S5_S3 0 1000 /end CHARACTERISTIC
/begin CHARACTERISTIC I_AGEX "Extrapolierschritte in die Zukunft" VALUE 0x1D73D1 ZF_kw_ui8_S5_S3 16 UMR___1_1_0_S5_S3 0 16 /end CHARACTERISTIC
/begin CHARACTERISTIC I_AGLAENGE "Laenge der Ausgleichsgeraden" VALUE 0x1D73D0 ZF_kw_ui8_S5_S3 68 UMR___1_1_0_S5_S3 3 71 /end CHARACTERISTIC
/begin CHARACTERISTIC I_MAX "Maximalstrom" VALUE 0x1D82CE ZF_kw_ui16_S5_S3 200 UMR_MA__1_10_0_S5_S3 700 900 READ_ONLY /end CHARACTERISTIC
/begin CHARACTERISTIC I_MIN "Minimalstrom" VALUE 0x1D82CC ZF_kw_ui16_S5_S3 200 UMR_MA__1_10_0_S5_S3 0 200 READ_ONLY /end CHARACTERISTIC
/begin CHARACTERISTIC J_MOT "Traegheitsmoment Motor" VALUE 0x1D82EA ZF_kw_ui16_S5_S3 10 UMR_KGM2__1_1000_0_S5_S3 0 10 /end CHARACTERISTIC
/begin CHARACTERISTIC J_MOT_EL "Traegheitsmoment Motor" VALUE 0x1D82EC ZF_kw_ui16_S5_S3 10 UMR_KGM2__1_1000_0_S5_S3 0 10 /end CHARACTERISTIC
/begin CHARACTERISTIC KF_MESCHLUPFAS "Kennfeld zur Momentenreduzierung in Abhängigkeit von Schlupf und Motormoment" MAP 0x19AACC ZF_kf_si16_S5_S3 1300 UMR_NM__1_1_0_S5_S3 0 1300
 /begin AXIS_DESCR STD_AXIS iBihMobef.nd_synschutz UMR_U_MIN_1_1_0_S5_S3 4 0 8160 DEPOSIT ABSOLUTE /end AXIS_DESCR
 /begin AXIS_DESCR STD_AXIS iItfInput.m_t UMR_NM__1_1_0_S5_S3 4 -200 1300 DEPOSIT ABSOLUTE /end AXIS_DESCR
/end CHARACTERISTIC
/begin CHARACTERISTIC KF_MGETRMAXCK "Kennfeld für zul. Getriebeeingangsmomente von c_kupplung" MAP 0x19A9AC ZF_kf_si16_S5_S3 1300 UMR_NM__1_1_0_S5_S3 0 1300
 /begin AXIS_DESCR STD_AXIS zff_atsys._.iSignale._.obj.sig_istgang UMR___1_1_0_S5_S3 8 -1 8 DEPOSIT ABSOLUTE /end AXIS_DESCR
 /begin AXIS_DESCR STD_AXIS NO_INPUT_QUANTITY UMR_GRADC__1_1_0_S5_S3 3 -40 500 DEPOSIT ABSOLUTE /end AXIS_DESCR
/end CHARACTERISTIC
/begin CHARACTERISTIC KF_MMOTMAXGE_1 "Max. Motormoment GE fuer gefuehrter Getriebeschutz" MAP 0x19AB50 ZF_kf_si16_S5_S3 1500 UMR_NM__1_1_0_S5_S3 -200 1300
 /begin AXIS_DESCR STD_AXIS zff_atsys._.iSignale._.obj.sig_n_mot UMR_U_MIN_1_1_0_S5_S3 4 0 8160 DEPOSIT ABSOLUTE /end AXIS_DESCR
 /begin AXIS_DESCR STD_AXIS iBihMobef.nd_synmmotmax UMR_U_MIN_1_1_0_S5_S3 4 -7000 7000 DEPOSIT ABSOLUTE /end AXIS_DESCR
/end CHARACTERISTIC
/begin CHARACTERISTIC KF_MMOTMAXGE_2 "Max. Motormoment GE fuer gefuehrter Getriebeschutz" MAP 0x19AB88 ZF_kf_si16_S5_S3 1500 UMR_NM__1_1_0_S5_S3 -200 1300
 /begin AXIS_DESCR STD_AXIS zff_atsys._.iSignale._.obj.sig_n_mot UMR_U_MIN_1_1_0_S5_S3 4 0 8160 DEPOSIT ABSOLUTE /end AXIS_DESCR
 /begin AXIS_DESCR STD_AXIS iBihMobef.nd_synmmotmax UMR_U_MIN_1_1_0_S5_S3 4 -7000 7000 DEPOSIT ABSOLUTE /end AXIS_DESCR
/end CHARACTERISTIC
/begin CHARACTERISTIC KF_MMOTMAXGE_3 "Max. Motormoment GE fuer gefuehrter Getriebeschutz" MAP 0x19ABC0 ZF_kf_si16_S5_S3 1500 UMR_NM__1_1_0_S5_S3 -200 1300
 /begin AXIS_DESCR STD_AXIS zff_atsys._.iSignale._.obj.sig_n_mot UMR_U_MIN_1_1_0_S5_S3 4 0 8160 DEPOSIT ABSOLUTE /end AXIS_DESCR
 /begin AXIS_DESCR STD_AXIS iBihMobef.nd_synmmotmax UMR_U_MIN_1_1_0_S5_S3 4 -7000 7000 DEPOSIT ABSOLUTE /end AXIS_DESCR
/end CHARACTERISTIC
/begin CHARACTERISTIC KF_MMOTMAXGE_4 "Max. Motormoment GE fuer gefuehrter Getriebeschutz" MAP 0x19ABF8 ZF_kf_si16_S5_S3 1500 UMR_NM__1_1_0_S5_S3 -200 1300
 /begin AXIS_DESCR STD_AXIS zff_atsys._.iSignale._.obj.sig_n_mot UMR_U_MIN_1_1_0_S5_S3 4 0 8160 DEPOSIT ABSOLUTE /end AXIS_DESCR
 /begin AXIS_DESCR STD_AXIS iBihMobef.nd_synmmotmax UMR_U_MIN_1_1_0_S5_S3 4 -7000 7000 DEPOSIT ABSOLUTE /end AXIS_DESCR
/end CHARACTERISTIC
/begin CHARACTERISTIC KF_MMOTMAXGE_5 "Max. Motormoment GE fuer gefuehrter Getriebeschutz" MAP 0x19AC30 ZF_kf_si16_S5_S3 1500 UMR_NM__1_1_0_S5_S3 -200 1300
 /begin AXIS_DESCR STD_AXIS zff_atsys._.iSignale._.obj.sig_n_mot UMR_U_MIN_1_1_0_S5_S3 4 0 8160 DEPOSIT ABSOLUTE /end AXIS_DESCR
 /begin AXIS_DESCR STD_AXIS iBihMobef.nd_synmmotmax UMR_U_MIN_1_1_0_S5_S3 4 -7000 7000 DEPOSIT ABSOLUTE /end AXIS_DESCR
/end CHARACTERISTIC
/begin CHARACTERISTIC KF_MMOTMAXGE_6 "Max. Motormoment GE fuer gefuehrter Getriebeschutz" MAP 0x19AC68 ZF_kf_si16_S5_S3 1500 UMR_NM__1_1_0_S5_S3 -200 1300
 /begin AXIS_DESCR STD_AXIS zff_atsys._.iSignale._.obj.sig_n_mot UMR_U_MIN_1_1_0_S5_S3 4 0 8160 DEPOSIT ABSOLUTE /end AXIS_DESCR
 /begin AXIS_DESCR STD_AXIS iBihMobef.nd_synmmotmax UMR_U_MIN_1_1_0_S5_S3 4 -7000 7000 DEPOSIT ABSOLUTE /end AXIS_DESCR
/end CHARACTERISTIC
/begin CHARACTERISTIC KF_MMOTMAXGE_7 "Max. Motormoment GE fuer gefuehrter Getriebeschutz" MAP 0x19ACA0 ZF_kf_si16_S5_S3 1500 UMR_NM__1_1_0_S5_S3 -200 1300
 /begin AXIS_DESCR STD_AXIS zff_atsys._.iSignale._.obj.sig_n_mot UMR_U_MIN_1_1_0_S5_S3 4 0 8160 DEPOSIT ABSOLUTE /end AXIS_DESCR
 /begin AXIS_DESCR STD_AXIS iBihMobef.nd_synmmotmax UMR_U_MIN_1_1_0_S5_S3 4 -7000 7000 DEPOSIT ABSOLUTE /end AXIS_DESCR
/end CHARACTERISTIC
/begin CHARACTERISTIC KF_MMOTMAXGE_8 "Max. Motormoment GE fuer gefuehrter Getriebeschutz" MAP 0x19ACD8 ZF_kf_si16_S5_S3 1500 UMR_NM__1_1_0_S5_S3 -200 1300
 /begin AXIS_DESCR STD_AXIS zff_atsys._.iSignale._.obj.sig_n_mot UMR_U_MIN_1_1_0_S5_S3 4 0 8160 DEPOSIT ABSOLUTE /end AXIS_DESCR
 /begin AXIS_DESCR STD_AXIS iBihMobef.nd_synmmotmax UMR_U_MIN_1_1_0_S5_S3 4 -7000 7000 DEPOSIT ABSOLUTE /end AXIS_DESCR
/end CHARACTERISTIC
/begin CHARACTERISTIC KF_MMOTMAXGE_R "Max. Motormoment GE fuer gefuehrter Getriebeschutz" MAP 0x19AB18 ZF_kf_si16_S5_S3 1500 UMR_NM__1_1_0_S5_S3 -200 1300
 /begin AXIS_DESCR STD_AXIS zff_atsys._.iSignale._.obj.sig_n_mot UMR_U_MIN_1_1_0_S5_S3 4 0 8160 DEPOSIT ABSOLUTE /end AXIS_DESCR
 /begin AXIS_DESCR STD_AXIS iBihMobef.nd_synmmotmax UMR_U_MIN_1_1_0_S5_S3 4 -7000 7000 DEPOSIT ABSOLUTE /end AXIS_DESCR
/end CHARACTERISTIC
/begin CHARACTERISTIC KF_MPUAUF "Pumpenaufnahmemoment" MAP 0x19AD20 ZF_kf_ui16_S5_S3 1000 UMR_NM__1_10_0_S5_S3 0 1000
 /begin AXIS_DESCR STD_AXIS iBihMomen.n_mot_pu UMR_U_MIN_1_1_0_S5_S3 3 0 8160 DEPOSIT ABSOLUTE /end AXIS_DESCR
 /begin AXIS_DESCR STD_AXIS iSasPsyst.p_mod UMR_BAR__1_1000_0_S5_S3 2 0 20 DEPOSIT ABSOLUTE /end AXIS_DESCR
/end CHARACTERISTIC
/begin CHARACTERISTIC KF_MVERLMTNTCGT100_1 "Getriebeverlustmoment ohne. Oelpumpe fuer Gang" MAP 0x19AEE4 ZF_kf_ui8_S5_S3 150 UMR_NM__1_1_0_S5_S3 0 150
 /begin AXIS_DESCR STD_AXIS zff_atsys._.iSignale._.obj.sig_m_t8 UMR_NM__6_1_M34_S5_S3 6 -204 1326 DEPOSIT ABSOLUTE /end AXIS_DESCR
 /begin AXIS_DESCR STD_AXIS zff_atsys._.iSignale._.obj.sig_n_t8 UMR_U_MIN_32_1_0_S5_S3 6 0 8160 DEPOSIT ABSOLUTE /end AXIS_DESCR
/end CHARACTERISTIC
/begin CHARACTERISTIC KF_MVERLMTNTCGT100_2 "Getriebeverlustmoment ohne. Oelpumpe fuer Gang" MAP 0x19AFA0 ZF_kf_ui8_S5_S3 150 UMR_NM__1_1_0_S5_S3 0 150
 /begin AXIS_DESCR STD_AXIS zff_atsys._.iSignale._.obj.sig_m_t8 UMR_NM__6_1_M34_S5_S3 6 -204 1326 DEPOSIT ABSOLUTE /end AXIS_DESCR
 /begin AXIS_DESCR STD_AXIS zff_atsys._.iSignale._.obj.sig_n_t8 UMR_U_MIN_32_1_0_S5_S3 6 0 8160 DEPOSIT ABSOLUTE /end AXIS_DESCR
/end CHARACTERISTIC
/begin CHARACTERISTIC KF_MVERLMTNTCGT100_3 "Getriebeverlustmoment ohne. Oelpumpe fuer Gang" MAP 0x19B05C ZF_kf_ui8_S5_S3 150 UMR_NM__1_1_0_S5_S3 0 150
 /begin AXIS_DESCR STD_AXIS zff_atsys._.iSignale._.obj.sig_m_t8 UMR_NM__6_1_M34_S5_S3 6 -204 1326 DEPOSIT ABSOLUTE /end AXIS_DESCR
 /begin AXIS_DESCR STD_AXIS zff_atsys._.iSignale._.obj.sig_n_t8 UMR_U_MIN_32_1_0_S5_S3 6 0 8160 DEPOSIT ABSOLUTE /end AXIS_DESCR
/end CHARACTERISTIC
/begin CHARACTERISTIC KF_MVERLMTNTCGT100_4 "Getriebeverlustmoment ohne. Oelpumpe fuer Gang" MAP 0x19B118 ZF_kf_ui8_S5_S3 150 UMR_NM__1_1_0_S5_S3 0 150
 /begin AXIS_DESCR STD_AXIS zff_atsys._.iSignale._.obj.sig_m_t8 UMR_NM__6_1_M34_S5_S3 6 -204 1326 DEPOSIT ABSOLUTE /end AXIS_DESCR
 /begin AXIS_DESCR STD_AXIS zff_atsys._.iSignale._.obj.sig_n_t8 UMR_U_MIN_32_1_0_S5_S3 6 0 8160 DEPOSIT ABSOLUTE /end AXIS_DESCR
/end CHARACTERISTIC
/begin CHARACTERISTIC KF_MVERLMTNTCGT100_5 "Getriebeverlustmoment ohne. Oelpumpe fuer Gang" MAP 0x19B1D4 ZF_kf_ui8_S5_S3 150 UMR_NM__1_1_0_S5_S3 0 150
 /begin AXIS_DESCR STD_AXIS zff_atsys._.iSignale._.obj.sig_m_t8 UMR_NM__6_1_M34_S5_S3 6 -204 1326 DEPOSIT ABSOLUTE /end AXIS_DESCR
 /begin AXIS_DESCR STD_AXIS zff_atsys._.iSignale._.obj.sig_n_t8 UMR_U_MIN_32_1_0_S5_S3 6 0 8160 DEPOSIT ABSOLUTE /end AXIS_DESCR
/end CHARACTERISTIC
/begin CHARACTERISTIC KF_MVERLMTNTCGT100_6 "Getriebeverlustmoment ohne. Oelpumpe fuer Gang" MAP 0x19B290 ZF_kf_ui8_S5_S3 150 UMR_NM__1_1_0_S5_S3 0 150
 /begin AXIS_DESCR STD_AXIS zff_atsys._.iSignale._.obj.sig_m_t8 UMR_NM__6_1_M34_S5_S3 6 -204 1326 DEPOSIT ABSOLUTE /end AXIS_DESCR
 /begin AXIS_DESCR STD_AXIS zff_atsys._.iSignale._.obj.sig_n_t8 UMR_U_MIN_32_1_0_S5_S3 6 0 8160 DEPOSIT ABSOLUTE /end AXIS_DESCR
/end CHARACTERISTIC
/begin CHARACTERISTIC KF_MVERLMTNTCGT100_7 "Getriebeverlustmoment ohne. Oelpumpe fuer Gang" MAP 0x19B34C ZF_kf_ui8_S5_S3 150 UMR_NM__1_1_0_S5_S3 0 150
 /begin AXIS_DESCR STD_AXIS zff_atsys._.iSignale._.obj.sig_m_t8 UMR_NM__6_1_M34_S5_S3 6 -204 1326 DEPOSIT ABSOLUTE /end AXIS_DESCR
 /begin AXIS_DESCR STD_AXIS zff_atsys._.iSignale._.obj.sig_n_t8 UMR_U_MIN_32_1_0_S5_S3 6 0 8160 DEPOSIT ABSOLUTE /end AXIS_DESCR
/end CHARACTERISTIC
/begin CHARACTERISTIC KF_MVERLMTNTCGT100_8 "Getriebeverlustmoment ohne. Oelpumpe fuer Gang" MAP 0x19B408 ZF_kf_ui8_S5_S3 150 UMR_NM__1_1_0_S5_S3 0 150
 /begin AXIS_DESCR STD_AXIS zff_atsys._.iSignale._.obj.sig_m_t8 UMR_NM__6_1_M34_S5_S3 6 -204 1326 DEPOSIT ABSOLUTE /end AXIS_DESCR
 /begin AXIS_DESCR STD_AXIS zff_atsys._.iSignale._.obj.sig_n_t8 UMR_U_MIN_32_1_0_S5_S3 6 0 8160 DEPOSIT ABSOLUTE /end AXIS_DESCR
/end CHARACTERISTIC
/begin CHARACTERISTIC KF_MVERLMTNTCGT100_K0 "Getriebeverlustmoment ohne. Oelpumpe fuer Gang K0" MAP 0x19AD80 ZF_kf_ui8_S5_S3 150 UMR_NM__1_1_0_S5_S3 0 150
 /begin AXIS_DESCR STD_AXIS zff_atsys._.iSignale._.obj.sig_m_t8 UMR_NM__6_1_M34_S5_S3 6 -204 1326 DEPOSIT ABSOLUTE /end AXIS_DESCR
 /begin AXIS_DESCR STD_AXIS zff_atsys._.iSignale._.obj.sig_n_t8 UMR_U_MIN_32_1_0_S5_S3 6 0 8160 DEPOSIT ABSOLUTE /end AXIS_DESCR
/end CHARACTERISTIC
/begin CHARACTERISTIC KF_MVERLMTNTCGT100_R "Getriebeverlustmoment ohne. Oelpumpe fuer Gang" MAP 0x19AE28 ZF_kf_ui8_S5_S3 150 UMR_NM__1_1_0_S5_S3 0 150
 /begin AXIS_DESCR STD_AXIS zff_atsys._.iSignale._.obj.sig_m_t8 UMR_NM__6_1_M34_S5_S3 6 -204 1326 DEPOSIT ABSOLUTE /end AXIS_DESCR
 /begin AXIS_DESCR STD_AXIS zff_atsys._.iSignale._.obj.sig_n_t8 UMR_U_MIN_32_1_0_S5_S3 6 0 8160 DEPOSIT ABSOLUTE /end AXIS_DESCR
/end CHARACTERISTIC
/begin CHARACTERISTIC KF_MVERLMTNTCGT40_1 "Getriebeverlustmoment ohne. Oelpumpe fuer Gang" MAP 0x19AF54 ZF_kf_ui8_S5_S3 150 UMR_NM__1_1_0_S5_S3 0 150
 /begin AXIS_DESCR STD_AXIS zff_atsys._.iSignale._.obj.sig_m_t8 UMR_NM__6_1_M34_S5_S3 6 -204 1326 DEPOSIT ABSOLUTE /end AXIS_DESCR
 /begin AXIS_DESCR STD_AXIS zff_atsys._.iSignale._.obj.sig_n_t8 UMR_U_MIN_32_1_0_S5_S3 6 0 8160 DEPOSIT ABSOLUTE /end AXIS_DESCR
/end CHARACTERISTIC
/begin CHARACTERISTIC KF_MVERLMTNTCGT40_2 "Getriebeverlustmoment ohne. Oelpumpe fuer Gang" MAP 0x19B010 ZF_kf_ui8_S5_S3 150 UMR_NM__1_1_0_S5_S3 0 150
 /begin AXIS_DESCR STD_AXIS zff_atsys._.iSignale._.obj.sig_m_t8 UMR_NM__6_1_M34_S5_S3 6 -204 1326 DEPOSIT ABSOLUTE /end AXIS_DESCR
 /begin AXIS_DESCR STD_AXIS zff_atsys._.iSignale._.obj.sig_n_t8 UMR_U_MIN_32_1_0_S5_S3 6 0 8160 DEPOSIT ABSOLUTE /end AXIS_DESCR
/end CHARACTERISTIC
/begin CHARACTERISTIC KF_MVERLMTNTCGT40_3 "Getriebeverlustmoment ohne. Oelpumpe fuer Gang" MAP 0x19B0CC ZF_kf_ui8_S5_S3 150 UMR_NM__1_1_0_S5_S3 0 150
 /begin AXIS_DESCR STD_AXIS zff_atsys._.iSignale._.obj.sig_m_t8 UMR_NM__6_1_M34_S5_S3 6 -204 1326 DEPOSIT ABSOLUTE /end AXIS_DESCR
 /begin AXIS_DESCR STD_AXIS zff_atsys._.iSignale._.obj.sig_n_t8 UMR_U_MIN_32_1_0_S5_S3 6 0 8160 DEPOSIT ABSOLUTE /end AXIS_DESCR
/end CHARACTERISTIC
/begin CHARACTERISTIC KF_MVERLMTNTCGT40_4 "Getriebeverlustmoment ohne. Oelpumpe fuer Gang" MAP 0x19B188 ZF_kf_ui8_S5_S3 150 UMR_NM__1_1_0_S5_S3 0 150
 /begin AXIS_DESCR STD_AXIS zff_atsys._.iSignale._.obj.sig_m_t8 UMR_NM__6_1_M34_S5_S3 6 -204 1326 DEPOSIT ABSOLUTE /end AXIS_DESCR
 /begin AXIS_DESCR STD_AXIS zff_atsys._.iSignale._.obj.sig_n_t8 UMR_U_MIN_32_1_0_S5_S3 6 0 8160 DEPOSIT ABSOLUTE /end AXIS_DESCR
/end CHARACTERISTIC
/begin CHARACTERISTIC KF_MVERLMTNTCGT40_5 "Getriebeverlustmoment ohne. Oelpumpe fuer Gang" MAP 0x19B244 ZF_kf_ui8_S5_S3 150 UMR_NM__1_1_0_S5_S3 0 150
 /begin AXIS_DESCR STD_AXIS zff_atsys._.iSignale._.obj.sig_m_t8 UMR_NM__6_1_M34_S5_S3 6 -204 1326 DEPOSIT ABSOLUTE /end AXIS_DESCR
 /begin AXIS_DESCR STD_AXIS zff_atsys._.iSignale._.obj.sig_n_t8 UMR_U_MIN_32_1_0_S5_S3 6 0 8160 DEPOSIT ABSOLUTE /end AXIS_DESCR
/end CHARACTERISTIC
/begin CHARACTERISTIC KF_MVERLMTNTCGT40_6 "Getriebeverlustmoment ohne. Oelpumpe fuer Gang" MAP 0x19B300 ZF_kf_ui8_S5_S3 150 UMR_NM__1_1_0_S5_S3 0 150
 /begin AXIS_DESCR STD_AXIS zff_atsys._.iSignale._.obj.sig_m_t8 UMR_NM__6_1_M34_S5_S3 6 -204 1326 DEPOSIT ABSOLUTE /end AXIS_DESCR
 /begin AXIS_DESCR STD_AXIS zff_atsys._.iSignale._.obj.sig_n_t8 UMR_U_MIN_32_1_0_S5_S3 6 0 8160 DEPOSIT ABSOLUTE /end AXIS_DESCR
/end CHARACTERISTIC
/begin CHARACTERISTIC KF_MVERLMTNTCGT40_7 "Getriebeverlustmoment ohne. Oelpumpe fuer Gang" MAP 0x19B3BC ZF_kf_ui8_S5_S3 150 UMR_NM__1_1_0_S5_S3 0 150
 /begin AXIS_DESCR STD_AXIS zff_atsys._.iSignale._.obj.sig_m_t8 UMR_NM__6_1_M34_S5_S3 6 -204 1326 DEPOSIT ABSOLUTE /end AXIS_DESCR
 /begin AXIS_DESCR STD_AXIS zff_atsys._.iSignale._.obj.sig_n_t8 UMR_U_MIN_32_1_0_S5_S3 6 0 8160 DEPOSIT ABSOLUTE /end AXIS_DESCR
/end CHARACTERISTIC
/begin CHARACTERISTIC KF_MVERLMTNTCGT40_8 "Getriebeverlustmoment ohne. Oelpumpe fuer Gang" MAP 0x19B478 ZF_kf_ui8_S5_S3 150 UMR_NM__1_1_0_S5_S3 0 150
 /begin AXIS_DESCR STD_AXIS zff_atsys._.iSignale._.obj.sig_m_t8 UMR_NM__6_1_M34_S5_S3 6 -204 1326 DEPOSIT ABSOLUTE /end AXIS_DESCR
 /begin AXIS_DESCR STD_AXIS zff_atsys._.iSignale._.obj.sig_n_t8 UMR_U_MIN_32_1_0_S5_S3 6 0 8160 DEPOSIT ABSOLUTE /end AXIS_DESCR
/end CHARACTERISTIC
/begin CHARACTERISTIC KF_MVERLMTNTCGT40_K0 "Getriebeverlustmoment ohne. Oelpumpe fuer Gang, K0" MAP 0x19ADF0 ZF_kf_ui8_S5_S3 150 UMR_NM__1_1_0_S5_S3 0 150
 /begin AXIS_DESCR STD_AXIS zff_atsys._.iSignale._.obj.sig_m_t8 UMR_NM__6_1_M34_S5_S3 6 -204 1326 DEPOSIT ABSOLUTE /end AXIS_DESCR
 /begin AXIS_DESCR STD_AXIS zff_atsys._.iSignale._.obj.sig_n_t8 UMR_U_MIN_32_1_0_S5_S3 6 0 8160 DEPOSIT ABSOLUTE /end AXIS_DESCR
/end CHARACTERISTIC
/begin CHARACTERISTIC KF_MVERLMTNTCGT40_R "Getriebeverlustmoment ohne. Oelpumpe fuer Gang" MAP 0x19AE98 ZF_kf_ui8_S5_S3 150 UMR_NM__1_1_0_S5_S3 0 150
 /begin AXIS_DESCR STD_AXIS zff_atsys._.iSignale._.obj.sig_m_t8 UMR_NM__6_1_M34_S5_S3 6 -204 1326 DEPOSIT ABSOLUTE /end AXIS_DESCR
 /begin AXIS_DESCR STD_AXIS zff_atsys._.iSignale._.obj.sig_n_t8 UMR_U_MIN_32_1_0_S5_S3 6 0 8160 DEPOSIT ABSOLUTE /end AXIS_DESCR
/end CHARACTERISTIC
/begin CHARACTERISTIC KF_MVERLMTNTCGT60_1 "Getriebeverlustmoment ohne. Oelpumpe fuer Gang" MAP 0x19AF1C ZF_kf_ui8_S5_S3 150 UMR_NM__1_1_0_S5_S3 0 150
 /begin AXIS_DESCR STD_AXIS zff_atsys._.iSignale._.obj.sig_m_t8 UMR_NM__6_1_M34_S5_S3 6 -204 1326 DEPOSIT ABSOLUTE /end AXIS_DESCR
 /begin AXIS_DESCR STD_AXIS zff_atsys._.iSignale._.obj.sig_n_t8 UMR_U_MIN_32_1_0_S5_S3 6 0 8160 DEPOSIT ABSOLUTE /end AXIS_DESCR
/end CHARACTERISTIC
/begin CHARACTERISTIC KF_MVERLMTNTCGT60_2 "Getriebeverlustmoment ohne. Oelpumpe fuer Gang" MAP 0x19AFD8 ZF_kf_ui8_S5_S3 150 UMR_NM__1_1_0_S5_S3 0 150
 /begin AXIS_DESCR STD_AXIS zff_atsys._.iSignale._.obj.sig_m_t8 UMR_NM__6_1_M34_S5_S3 6 -204 1326 DEPOSIT ABSOLUTE /end AXIS_DESCR
 /begin AXIS_DESCR STD_AXIS zff_atsys._.iSignale._.obj.sig_n_t8 UMR_U_MIN_32_1_0_S5_S3 6 0 8160 DEPOSIT ABSOLUTE /end AXIS_DESCR
/end CHARACTERISTIC
/begin CHARACTERISTIC KF_MVERLMTNTCGT60_3 "Getriebeverlustmoment ohne. Oelpumpe fuer Gang" MAP 0x19B094 ZF_kf_ui8_S5_S3 150 UMR_NM__1_1_0_S5_S3 0 150
 /begin AXIS_DESCR STD_AXIS zff_atsys._.iSignale._.obj.sig_m_t8 UMR_NM__6_1_M34_S5_S3 6 -204 1326 DEPOSIT ABSOLUTE /end AXIS_DESCR
 /begin AXIS_DESCR STD_AXIS zff_atsys._.iSignale._.obj.sig_n_t8 UMR_U_MIN_32_1_0_S5_S3 6 0 8160 DEPOSIT ABSOLUTE /end AXIS_DESCR
/end CHARACTERISTIC
/begin CHARACTERISTIC KF_MVERLMTNTCGT60_4 "Getriebeverlustmoment ohne. Oelpumpe fuer Gang" MAP 0x19B150 ZF_kf_ui8_S5_S3 150 UMR_NM__1_1_0_S5_S3 0 150
 /begin AXIS_DESCR STD_AXIS zff_atsys._.iSignale._.obj.sig_m_t8 UMR_NM__6_1_M34_S5_S3 6 -204 1326 DEPOSIT ABSOLUTE /end AXIS_DESCR
 /begin AXIS_DESCR STD_AXIS zff_atsys._.iSignale._.obj.sig_n_t8 UMR_U_MIN_32_1_0_S5_S3 6 0 8160 DEPOSIT ABSOLUTE /end AXIS_DESCR
/end CHARACTERISTIC
/begin CHARACTERISTIC KF_MVERLMTNTCGT60_5 "Getriebeverlustmoment ohne. Oelpumpe fuer Gang" MAP 0x19B20C ZF_kf_ui8_S5_S3 150 UMR_NM__1_1_0_S5_S3 0 150
 /begin AXIS_DESCR STD_AXIS zff_atsys._.iSignale._.obj.sig_m_t8 UMR_NM__6_1_M34_S5_S3 6 -204 1326 DEPOSIT ABSOLUTE /end AXIS_DESCR
 /begin AXIS_DESCR STD_AXIS zff_atsys._.iSignale._.obj.sig_n_t8 UMR_U_MIN_32_1_0_S5_S3 6 0 8160 DEPOSIT ABSOLUTE /end AXIS_DESCR
/end CHARACTERISTIC
/begin CHARACTERISTIC KF_MVERLMTNTCGT60_6 "Getriebeverlustmoment ohne. Oelpumpe fuer Gang" MAP 0x19B2C8 ZF_kf_ui8_S5_S3 150 UMR_NM__1_1_0_S5_S3 0 150
 /begin AXIS_DESCR STD_AXIS zff_atsys._.iSignale._.obj.sig_m_t8 UMR_NM__6_1_M34_S5_S3 6 -204 1326 DEPOSIT ABSOLUTE /end AXIS_DESCR
 /begin AXIS_DESCR STD_AXIS zff_atsys._.iSignale._.obj.sig_n_t8 UMR_U_MIN_32_1_0_S5_S3 6 0 8160 DEPOSIT ABSOLUTE /end AXIS_DESCR
/end CHARACTERISTIC
/begin CHARACTERISTIC KF_MVERLMTNTCGT60_7 "Getriebeverlustmoment ohne. Oelpumpe fuer Gang" MAP 0x19B384 ZF_kf_ui8_S5_S3 150 UMR_NM__1_1_0_S5_S3 0 150
 /begin AXIS_DESCR STD_AXIS zff_atsys._.iSignale._.obj.sig_m_t8 UMR_NM__6_1_M34_S5_S3 6 -204 1326 DEPOSIT ABSOLUTE /end AXIS_DESCR
 /begin AXIS_DESCR STD_AXIS zff_atsys._.iSignale._.obj.sig_n_t8 UMR_U_MIN_32_1_0_S5_S3 6 0 8160 DEPOSIT ABSOLUTE /end AXIS_DESCR
/end CHARACTERISTIC
/begin CHARACTERISTIC KF_MVERLMTNTCGT60_8 "Getriebeverlustmoment ohne. Oelpumpe fuer Gang" MAP 0x19B440 ZF_kf_ui8_S5_S3 150 UMR_NM__1_1_0_S5_S3 0 150
 /begin AXIS_DESCR STD_AXIS zff_atsys._.iSignale._.obj.sig_m_t8 UMR_NM__6_1_M34_S5_S3 6 -204 1326 DEPOSIT ABSOLUTE /end AXIS_DESCR
 /begin AXIS_DESCR STD_AXIS zff_atsys._.iSignale._.obj.sig_n_t8 UMR_U_MIN_32_1_0_S5_S3 6 0 8160 DEPOSIT ABSOLUTE /end AXIS_DESCR
/end CHARACTERISTIC
/begin CHARACTERISTIC KF_MVERLMTNTCGT60_K0 "Getriebeverlustmoment ohne. Oelpumpe fuer Gang, K0" MAP 0x19ADB8 ZF_kf_ui8_S5_S3 150 UMR_NM__1_1_0_S5_S3 0 150
 /begin AXIS_DESCR STD_AXIS zff_atsys._.iSignale._.obj.sig_m_t8 UMR_NM__6_1_M34_S5_S3 6 -204 1326 DEPOSIT ABSOLUTE /end AXIS_DESCR
 /begin AXIS_DESCR STD_AXIS zff_atsys._.iSignale._.obj.sig_n_t8 UMR_U_MIN_32_1_0_S5_S3 6 0 8160 DEPOSIT ABSOLUTE /end AXIS_DESCR
/end CHARACTERISTIC
/begin CHARACTERISTIC KF_MVERLMTNTCGT60_R "Getriebeverlustmoment ohne. Oelpumpe fuer Gang" MAP 0x19AE60 ZF_kf_ui8_S5_S3 150 UMR_NM__1_1_0_S5_S3 0 150
 /begin AXIS_DESCR STD_AXIS zff_atsys._.iSignale._.obj.sig_m_t8 UMR_NM__6_1_M34_S5_S3 6 -204 1326 DEPOSIT ABSOLUTE /end AXIS_DESCR
 /begin AXIS_DESCR STD_AXIS zff_atsys._.iSignale._.obj.sig_n_t8 UMR_U_MIN_32_1_0_S5_S3 6 0 8160 DEPOSIT ABSOLUTE /end AXIS_DESCR
/end CHARACTERISTIC
/begin CHARACTERISTIC KF_POFNABCGKPLBINN "Kennfeld fuer Druckoffset fuer Kupplung B in Neutral (N1) (gilt auch in P)" MAP 0x19A93C ZF_kf_ui16_S5_S3 1 UMR_BAR__1_1000_0_S5_S3 0 1
 /begin AXIS_DESCR STD_AXIS zff_atsys._.iSignale._.obj.sig_n_ab UMR_U_MIN_1_1_0_S5_S3 2 0 8200 DEPOSIT ABSOLUTE /end AXIS_DESCR
 /begin AXIS_DESCR STD_AXIS zff_atsys._.iSignale._.obj.sig_c_getr UMR_GRADC__1_1_M40_S5_S3 4 -40 150 DEPOSIT ABSOLUTE /end AXIS_DESCR
/end CHARACTERISTIC
/begin CHARACTERISTIC KL_CS_PFADPULSUN_A "minimale Temp. Grenze fuer PF- Pulsada abhaenig BPZ" CURVE 0x19A3A4 ZF_kl_ui16_S5_S3 190 UMR_GRADC__1_1_M40_S5_S3 -40 150
 /begin AXIS_DESCR STD_AXIS NO_INPUT_QUANTITY UMR___1_1_0_S5_S3 3 0 65535 DEPOSIT ABSOLUTE /end AXIS_DESCR
/end CHARACTERISTIC
/begin CHARACTERISTIC KL_CS_PFADPULSUN_B "minimale Temp. Grenze fuer PF- Pulsada abhaenig BPZ" CURVE 0x19A3C4 ZF_kl_ui16_S5_S3 190 UMR_GRADC__1_1_M40_S5_S3 -40 150
 /begin AXIS_DESCR STD_AXIS NO_INPUT_QUANTITY UMR___1_1_0_S5_S3 3 0 65535 DEPOSIT ABSOLUTE /end AXIS_DESCR
/end CHARACTERISTIC
/begin CHARACTERISTIC KL_CS_PFADPULSUN_C "minimale Temp. Grenze fuer PF- Pulsada abhaenig BPZ" CURVE 0x19A3E4 ZF_kl_ui16_S5_S3 190 UMR_GRADC__1_1_M40_S5_S3 -40 150
 /begin AXIS_DESCR STD_AXIS NO_INPUT_QUANTITY UMR___1_1_0_S5_S3 3 0 65535 DEPOSIT ABSOLUTE /end AXIS_DESCR
/end CHARACTERISTIC
/begin CHARACTERISTIC KL_CS_PFADPULSUN_D "minimale Temp. Grenze fuer PF- Pulsada abhaenig BPZ" CURVE 0x19A404 ZF_kl_ui16_S5_S3 190 UMR_GRADC__1_1_M40_S5_S3 -40 150
 /begin AXIS_DESCR STD_AXIS NO_INPUT_QUANTITY UMR___1_1_0_S5_S3 3 0 65535 DEPOSIT ABSOLUTE /end AXIS_DESCR
/end CHARACTERISTIC
/begin CHARACTERISTIC KL_CS_PFADPULSUN_E "minimale Temp. Grenze fuer PF- Pulsada abhaenig BPZ" CURVE 0x19A424 ZF_kl_ui16_S5_S3 190 UMR_GRADC__1_1_M40_S5_S3 -40 150
 /begin AXIS_DESCR STD_AXIS NO_INPUT_QUANTITY UMR___1_1_0_S5_S3 3 0 65535 DEPOSIT ABSOLUTE /end AXIS_DESCR
/end CHARACTERISTIC
/begin CHARACTERISTIC KL_CS_PFADPULSUN_K0 "minimale Temp. Grenze fuer PF- Pulsada abhaenig BPZ" CURVE 0x19A444 ZF_kl_ui16_S5_S3 190 UMR_GRADC__1_1_M40_S5_S3 -40 150
 /begin AXIS_DESCR STD_AXIS NO_INPUT_QUANTITY UMR___1_1_0_S5_S3 3 0 65535 DEPOSIT ABSOLUTE /end AXIS_DESCR
/end CHARACTERISTIC
/begin CHARACTERISTIC KL_CS_TSFADPULSUN_A "minimale Temp. Grenze fuer TSF- Pulsada abhaenig BPZ" CURVE 0x19A3B4 ZF_kl_ui16_S5_S3 190 UMR_GRADC__1_1_M40_S5_S3 -40 150
 /begin AXIS_DESCR STD_AXIS NO_INPUT_QUANTITY UMR___1_1_0_S5_S3 3 0 65535 DEPOSIT ABSOLUTE /end AXIS_DESCR
/end CHARACTERISTIC
/begin CHARACTERISTIC KL_CS_TSFADPULSUN_B "minimale Temp. Grenze fuer TSF- Pulsada abhaenig BPZ" CURVE 0x19A3D4 ZF_kl_ui16_S5_S3 190 UMR_GRADC__1_1_M40_S5_S3 -40 150
 /begin AXIS_DESCR STD_AXIS NO_INPUT_QUANTITY UMR___1_1_0_S5_S3 3 0 65535 DEPOSIT ABSOLUTE /end AXIS_DESCR
/end CHARACTERISTIC
/begin CHARACTERISTIC KL_CS_TSFADPULSUN_C "minimale Temp. Grenze fuer TSF- Pulsada abhaenig BPZ" CURVE 0x19A3F4 ZF_kl_ui16_S5_S3 190 UMR_GRADC__1_1_M40_S5_S3 -40 150
 /begin AXIS_DESCR STD_AXIS NO_INPUT_QUANTITY UMR___1_1_0_S5_S3 3 0 65535 DEPOSIT ABSOLUTE /end AXIS_DESCR
/end CHARACTERISTIC
/begin CHARACTERISTIC KL_CS_TSFADPULSUN_D "minimale Temp. Grenze fuer TSF- Pulsada abhaenig BPZ" CURVE 0x19A414 ZF_kl_ui16_S5_S3 190 UMR_GRADC__1_1_M40_S5_S3 -40 150
 /begin AXIS_DESCR STD_AXIS NO_INPUT_QUANTITY UMR___1_1_0_S5_S3 3 0 65535 DEPOSIT ABSOLUTE /end AXIS_DESCR
/end CHARACTERISTIC
/begin CHARACTERISTIC KL_CS_TSFADPULSUN_E "minimale Temp. Grenze fuer TSF- Pulsada abhaenig BPZ" CURVE 0x19A434 ZF_kl_ui16_S5_S3 190 UMR_GRADC__1_1_M40_S5_S3 -40 150
 /begin AXIS_DESCR STD_AXIS NO_INPUT_QUANTITY UMR___1_1_0_S5_S3 3 0 65535 DEPOSIT ABSOLUTE /end AXIS_DESCR
/end CHARACTERISTIC
/begin CHARACTERISTIC KL_CS_TSFADPULSUN_K0 "minimale Temp. Grenze fuer TSF- Pulsada abhaenig BPZ" CURVE 0x19A454 ZF_kl_ui16_S5_S3 190 UMR_GRADC__1_1_M40_S5_S3 -40 150
 /begin AXIS_DESCR STD_AXIS NO_INPUT_QUANTITY UMR___1_1_0_S5_S3 3 0 65535 DEPOSIT ABSOLUTE /end AXIS_DESCR
/end CHARACTERISTIC
/begin CHARACTERISTIC KL_FGMMOTMDMOTPSYS "Gewichtungsfaktor f.Momentenberechng m_motkor_psys" CURVE 0x19AD54 ZF_kl_si16_S5_S3 100 UMR_PROZENT__20_51_0_S5_S3 0 100
 /begin AXIS_DESCR STD_AXIS iBihMomen.md_motsollist UMR_NM__1_1_0_S5_S3 4 -1500 1500 DEPOSIT ABSOLUTE /end AXIS_DESCR
/end CHARACTERISTIC
/begin CHARACTERISTIC KL_FGMMOTMDMOT_1 "Gewichtungsfaktor f.Momentenberechng m_motkor" CURVE 0x19AF8C ZF_kl_si16_S5_S3 100 UMR_PROZENT__20_51_0_S5_S3 0 100
 /begin AXIS_DESCR STD_AXIS iBihMomen.md_motsollist UMR_NM__1_1_0_S5_S3 4 -1500 1500 DEPOSIT ABSOLUTE /end AXIS_DESCR
/end CHARACTERISTIC
/begin CHARACTERISTIC KL_FGMMOTMDMOT_2 "Gewichtungsfaktor f.Momentenberechng m_motkor" CURVE 0x19B048 ZF_kl_si16_S5_S3 100 UMR_PROZENT__20_51_0_S5_S3 0 100
 /begin AXIS_DESCR STD_AXIS iBihMomen.md_motsollist UMR_NM__1_1_0_S5_S3 4 -1500 1500 DEPOSIT ABSOLUTE /end AXIS_DESCR
/end CHARACTERISTIC
/begin CHARACTERISTIC KL_FGMMOTMDMOT_3 "Gewichtungsfaktor f.Momentenberechng m_motkor" CURVE 0x19B104 ZF_kl_si16_S5_S3 100 UMR_PROZENT__20_51_0_S5_S3 0 100
 /begin AXIS_DESCR STD_AXIS iBihMomen.md_motsollist UMR_NM__1_1_0_S5_S3 4 -1500 1500 DEPOSIT ABSOLUTE /end AXIS_DESCR
/end CHARACTERISTIC
/begin CHARACTERISTIC KL_FGMMOTMDMOT_4 "Gewichtungsfaktor f.Momentenberechng m_motkor" CURVE 0x19B1C0 ZF_kl_si16_S5_S3 100 UMR_PROZENT__20_51_0_S5_S3 0 100
 /begin AXIS_DESCR STD_AXIS iBihMomen.md_motsollist UMR_NM__1_1_0_S5_S3 4 -1500 1500 DEPOSIT ABSOLUTE /end AXIS_DESCR
/end CHARACTERISTIC
/begin CHARACTERISTIC KL_FGMMOTMDMOT_5 "Gewichtungsfaktor f.Momentenberechng m_motkor" CURVE 0x19B27C ZF_kl_si16_S5_S3 100 UMR_PROZENT__20_51_0_S5_S3 0 100
 /begin AXIS_DESCR STD_AXIS iBihMomen.md_motsollist UMR_NM__1_1_0_S5_S3 4 -1500 1500 DEPOSIT ABSOLUTE /end AXIS_DESCR
/end CHARACTERISTIC
/begin CHARACTERISTIC KL_FGMMOTMDMOT_6 "Gewichtungsfaktor f.Momentenberechng m_motkor" CURVE 0x19B338 ZF_kl_si16_S5_S3 100 UMR_PROZENT__20_51_0_S5_S3 0 100
 /begin AXIS_DESCR STD_AXIS iBihMomen.md_motsollist UMR_NM__1_1_0_S5_S3 4 -1500 1500 DEPOSIT ABSOLUTE /end AXIS_DESCR
/end CHARACTERISTIC
/begin CHARACTERISTIC KL_FGMMOTMDMOT_7 "Gewichtungsfaktor f.Momentenberechng m_motkor" CURVE 0x19B3F4 ZF_kl_si16_S5_S3 100 UMR_PROZENT__20_51_0_S5_S3 0 100
 /begin AXIS_DESCR STD_AXIS iBihMomen.md_motsollist UMR_NM__1_1_0_S5_S3 4 -1500 1500 DEPOSIT ABSOLUTE /end AXIS_DESCR
/end CHARACTERISTIC
/begin CHARACTERISTIC KL_FGMMOTMDMOT_8 "Gewichtungsfaktor f.Momentenberechng m_motkor" CURVE 0x19B4B0 ZF_kl_si16_S5_S3 100 UMR_PROZENT__20_51_0_S5_S3 0 100
 /begin AXIS_DESCR STD_AXIS iBihMomen.md_motsollist UMR_NM__1_1_0_S5_S3 4 -1500 1500 DEPOSIT ABSOLUTE /end AXIS_DESCR
/end CHARACTERISTIC
/begin CHARACTERISTIC KL_FGMMOTMDMOT_R "Gewichtungsfaktor f.Momentenberechng m_motkor" CURVE 0x19AED0 ZF_kl_si16_S5_S3 100 UMR_PROZENT__20_51_0_S5_S3 0 100
 /begin AXIS_DESCR STD_AXIS iBihMomen.md_motsollist UMR_NM__1_1_0_S5_S3 4 -1500 1500 DEPOSIT ABSOLUTE /end AXIS_DESCR
/end CHARACTERISTIC
/begin CHARACTERISTIC KL_FIADAAKT_NPRUEFZYKL_NEG "Filteranzahl f.Gewichtung des alten ADA-Werts bei pos. Abweichung" CURVE 0x19A340 ZF_kl_ui8_S5_S3 10 UMR___1_1_0_S5_S3 0 10
 /begin AXIS_DESCR STD_AXIS NO_INPUT_QUANTITY UMR___1_1_0_S5_S3 3 0 255 DEPOSIT ABSOLUTE /end AXIS_DESCR
/end CHARACTERISTIC
/begin CHARACTERISTIC KL_FIADAAKT_NPRUEFZYKL_POS "Filteranzahl f.Gewichtung des alten ADA-Werts bei neg. Abweichung" CURVE 0x19A334 ZF_kl_ui8_S5_S3 10 UMR___1_1_0_S5_S3 0 10
 /begin AXIS_DESCR STD_AXIS NO_INPUT_QUANTITY UMR___1_1_0_S5_S3 3 0 255 DEPOSIT ABSOLUTE /end AXIS_DESCR
/end CHARACTERISTIC
/begin CHARACTERISTIC KL_FMMOTCM "Kennlinie Korrektur Motormotormoment" CURVE 0x19AD10 ZF_kl_ui8_S5_S3 2.55 UMR___1_100_0_S5_S3 0 2.55
 /begin AXIS_DESCR STD_AXIS zff_atsys._.iSignale._.obj.sig_c_mot UMR_GRADC__1_1_M48_S5_S3 6 -48 144 DEPOSIT ABSOLUTE /end AXIS_DESCR
/end CHARACTERISTIC
/begin CHARACTERISTIC KL_IEDSOFPSV "Stromoffset für Umschaltpunkt Parksperrenventil" CURVE 0x19A960 ZF_kl_ui16_S5_S3 250 UMR_MA__1_10_0_S5_S3 0 250
 /begin AXIS_DESCR STD_AXIS zff_atsys._.iSignale._.obj.sig_c_getr UMR_GRADC__1_1_M40_S5_S3 4 -40 215 DEPOSIT ABSOLUTE /end AXIS_DESCR
/end CHARACTERISTIC
/begin CHARACTERISTIC KL_KCGMPUAUF "Kennlinie Korrektur Pumpenaufnahmemoment" CURVE 0x19AD40 ZF_kl_si16_S5_S3 20 UMR___1_100_0_S5_S3 0 20
 /begin AXIS_DESCR STD_AXIS zff_atsys._.iSignale._.obj.sig_c_getr UMR_GRADC__1_1_M40_S5_S3 4 -40 150 DEPOSIT ABSOLUTE /end AXIS_DESCR
/end CHARACTERISTIC
/begin CHARACTERISTIC KL_KMMOTMAXCM "Korrekturwert Max. Motormoment fuer gefuehrter Getriebeschutz" CURVE 0x19A974 ZF_kl_ui16_S5_S3 10 UMR___1_100_0_S5_S3 0 10
 /begin AXIS_DESCR STD_AXIS zff_atsys._.iSignale._.obj.sig_c_mot UMR_GRADC__1_1_M48_S5_S3 7 -48 152 DEPOSIT ABSOLUTE /end AXIS_DESCR
/end CHARACTERISTIC
/begin CHARACTERISTIC KL_MHOTMODEMAX_1 "Kennlinie Momentenbegrenzung aus der Hot-Mode-Funktion" CURVE 0x19B4D8 ZF_kl_si16_S5_S3 1500 UMR_NM__1_1_0_S5_S3 -200 1300
 /begin AXIS_DESCR STD_AXIS iBihSigna.c_maxhotmode UMR_GRADC__1_1_M40_S5_S3 4 -40 150 DEPOSIT ABSOLUTE /end AXIS_DESCR
/end CHARACTERISTIC
/begin CHARACTERISTIC KL_MHOTMODEMAX_2 "Kennlinie Momentenbegrenzung aus der Hot-Mode-Funktion" CURVE 0x19B4EC ZF_kl_si16_S5_S3 1500 UMR_NM__1_1_0_S5_S3 -200 1300
 /begin AXIS_DESCR STD_AXIS iBihSigna.c_maxhotmode UMR_GRADC__1_1_M40_S5_S3 4 -40 150 DEPOSIT ABSOLUTE /end AXIS_DESCR
/end CHARACTERISTIC
/begin CHARACTERISTIC KL_MHOTMODEMAX_3 "Kennlinie Momentenbegrenzung aus der Hot-Mode-Funktion" CURVE 0x19B500 ZF_kl_si16_S5_S3 1500 UMR_NM__1_1_0_S5_S3 -200 1300
 /begin AXIS_DESCR STD_AXIS iBihSigna.c_maxhotmode UMR_GRADC__1_1_M40_S5_S3 4 -40 150 DEPOSIT ABSOLUTE /end AXIS_DESCR
/end CHARACTERISTIC
/begin CHARACTERISTIC KL_MHOTMODEMAX_4 "Kennlinie Momentenbegrenzung aus der Hot-Mode-Funktion" CURVE 0x19B514 ZF_kl_si16_S5_S3 1500 UMR_NM__1_1_0_S5_S3 -200 1300
 /begin AXIS_DESCR STD_AXIS iBihSigna.c_maxhotmode UMR_GRADC__1_1_M40_S5_S3 4 -40 150 DEPOSIT ABSOLUTE /end AXIS_DESCR
/end CHARACTERISTIC
/begin CHARACTERISTIC KL_MHOTMODEMAX_5 "Kennlinie Momentenbegrenzung aus der Hot-Mode-Funktion" CURVE 0x19B528 ZF_kl_si16_S5_S3 1500 UMR_NM__1_1_0_S5_S3 -200 1300
 /begin AXIS_DESCR STD_AXIS iBihSigna.c_maxhotmode UMR_GRADC__1_1_M40_S5_S3 4 -40 150 DEPOSIT ABSOLUTE /end AXIS_DESCR
/end CHARACTERISTIC
/begin CHARACTERISTIC KL_MHOTMODEMAX_6 "Kennlinie Momentenbegrenzung aus der Hot-Mode-Funktion" CURVE 0x19B53C ZF_kl_si16_S5_S3 1500 UMR_NM__1_1_0_S5_S3 -200 1300
 /begin AXIS_DESCR STD_AXIS iBihSigna.c_maxhotmode UMR_GRADC__1_1_M40_S5_S3 4 -40 150 DEPOSIT ABSOLUTE /end AXIS_DESCR
/end CHARACTERISTIC
/begin CHARACTERISTIC KL_MHOTMODEMAX_7 "Kennlinie Momentenbegrenzung aus der Hot-Mode-Funktion" CURVE 0x19B550 ZF_kl_si16_S5_S3 1500 UMR_NM__1_1_0_S5_S3 -200 1300
 /begin AXIS_DESCR STD_AXIS iBihSigna.c_maxhotmode UMR_GRADC__1_1_M40_S5_S3 4 -40 150 DEPOSIT ABSOLUTE /end AXIS_DESCR
/end CHARACTERISTIC
/begin CHARACTERISTIC KL_MHOTMODEMAX_8 "Kennlinie Momentenbegrenzung aus der Hot-Mode-Funktion" CURVE 0x19B564 ZF_kl_si16_S5_S3 1500 UMR_NM__1_1_0_S5_S3 -200 1300
 /begin AXIS_DESCR STD_AXIS iBihSigna.c_maxhotmode UMR_GRADC__1_1_M40_S5_S3 4 -40 150 DEPOSIT ABSOLUTE /end AXIS_DESCR
/end CHARACTERISTIC
/begin CHARACTERISTIC KL_MHOTMODEMAX_R "Kennlinie Momentenbegrenzung aus der Hot-Mode-Funktion" CURVE 0x19B4C4 ZF_kl_si16_S5_S3 1500 UMR_NM__1_1_0_S5_S3 -200 1300
 /begin AXIS_DESCR STD_AXIS iBihSigna.c_maxhotmode UMR_GRADC__1_1_M40_S5_S3 4 -40 150 DEPOSIT ABSOLUTE /end AXIS_DESCR
/end CHARACTERISTIC
/begin CHARACTERISTIC KL_NPRUEFZYKL_KBP "Anzahl Pruefdurchlaeufe abhaengig von den Befuellpruefzaehlern" CURVE 0x19A310 ZF_kl_ui8_S5_S3 9 UMR___1_1_0_S5_S3 1 10
 /begin AXIS_DESCR STD_AXIS NO_INPUT_QUANTITY UMR___1_1_0_S5_S3 2 0 255 DEPOSIT ABSOLUTE /end AXIS_DESCR
/end CHARACTERISTIC
/begin CHARACTERISTIC KL_RGANGLIMIT "Kennlinie zur Momentenreduzierung in Abhängigkeit von der Turbinendrehzahl" CURVE 0x19AB04 ZF_kl_si16_S5_S3 1300 UMR_NM__1_1_0_S5_S3 0 1300
 /begin AXIS_DESCR STD_AXIS iItfInput.n_t UMR_U_MIN_1_1_0_S5_S3 4 0 8160 DEPOSIT ABSOLUTE /end AXIS_DESCR
/end CHARACTERISTIC
/begin CHARACTERISTIC KL_TVCG_GE_STADA "Wartezeit Stillstands-Ada nach GE" CURVE 0x19A930 ZF_kl_ui8_S5_S3 2550 UMR_MSEC__10_1_0_S5_S3 0 2550
 /begin AXIS_DESCR STD_AXIS iItfInput.c_getr UMR_GRADC__1_1_M40_S5_S3 4 -40 215 DEPOSIT ABSOLUTE /end AXIS_DESCR
/end CHARACTERISTIC
/begin CHARACTERISTIC KL_ZS "Z/S Kl. ausserhalb von Schalt." CURVE 0x1971AC ZF_kl_si16_S5_S3 1500 UMR_NM__1_1_0_S5_S3 -200 1300
 /begin AXIS_DESCR STD_AXIS zff_atsys._.iSignale._.obj.sig_n_mot UMR_U_MIN_1_1_0_S5_S3 6 0 8165 DEPOSIT ABSOLUTE /end AXIS_DESCR
/end CHARACTERISTIC
/begin CHARACTERISTIC KL_ZS21 "Z/S Kl. fuer 2-1Rueckschaltungen" CURVE 0x197104 ZF_kl_si16_S5_S3 1500 UMR_NM__1_1_0_S5_S3 -200 1300
 /begin AXIS_DESCR STD_AXIS zff_atsys._.iSignale._.obj.sig_n_mot UMR_U_MIN_1_1_0_S5_S3 6 0 8165 DEPOSIT ABSOLUTE /end AXIS_DESCR
/end CHARACTERISTIC
/begin CHARACTERISTIC KL_ZSHS "Z/S Kl. fuer Hochschaltungen" CURVE 0x197174 ZF_kl_si16_S5_S3 1500 UMR_NM__1_1_0_S5_S3 -200 1300
 /begin AXIS_DESCR STD_AXIS zff_atsys._.iSignale._.obj.sig_n_mot UMR_U_MIN_1_1_0_S5_S3 6 0 8165 DEPOSIT ABSOLUTE /end AXIS_DESCR
/end CHARACTERISTIC
/begin CHARACTERISTIC KL_ZSMRS "Z/S Kl. fuer Doppelrueckschalt." CURVE 0x19713C ZF_kl_si16_S5_S3 1500 UMR_NM__1_1_0_S5_S3 -200 1300
 /begin AXIS_DESCR STD_AXIS zff_atsys._.iSignale._.obj.sig_n_mot UMR_U_MIN_1_1_0_S5_S3 6 0 8165 DEPOSIT ABSOLUTE /end AXIS_DESCR
/end CHARACTERISTIC
/begin CHARACTERISTIC KL_ZSOCMOT "Korr.off. Z/S Abhaeng.C_MOT" CURVE 0x197190 ZF_kl_si16_S5_S3 1500 UMR_NM__1_1_0_S5_S3 -200 1300
 /begin AXIS_DESCR STD_AXIS zff_atsys._.iSignale._.obj.sig_c_mot UMR_GRADC__1_1_M48_S5_S3 6 -48 144 DEPOSIT ABSOLUTE /end AXIS_DESCR
/end CHARACTERISTIC
/begin CHARACTERISTIC KL_ZSOCMOTMRS "Korr.off. Z/S Abhaeng.C_MOT MRS" CURVE 0x197158 ZF_kl_si16_S5_S3 1500 UMR_NM__1_1_0_S5_S3 -200 1300
 /begin AXIS_DESCR STD_AXIS zff_atsys._.iSignale._.obj.sig_c_mot UMR_GRADC__1_1_M48_S5_S3 6 -48 144 DEPOSIT ABSOLUTE /end AXIS_DESCR
/end CHARACTERISTIC
/begin CHARACTERISTIC KL_ZSRS "Z/S Kl. fuer Rueckschaltungen" CURVE 0x197120 ZF_kl_si16_S5_S3 1500 UMR_NM__1_1_0_S5_S3 -200 1300
 /begin AXIS_DESCR STD_AXIS zff_atsys._.iSignale._.obj.sig_n_mot UMR_U_MIN_1_1_0_S5_S3 6 0 8165 DEPOSIT ABSOLUTE /end AXIS_DESCR
/end CHARACTERISTIC
/begin CHARACTERISTIC MAX_BEW_ABSCHALTKPAD "Mindest-MAX-Wert von n_guete f.Bewertgsablauf" VALUE 0x1D82B0 ZF_kw_ui16_S5_S3 8000 UMR_U_MIN_1_1_0_S5_S3 0 8000 /end CHARACTERISTIC
/begin CHARACTERISTIC MIN_BEW_ABSCHALTKPAD "Mindest-MIN-Wert von n_guete f.Bewertgsablauf" VALUE 0x1D82AE ZF_kw_ui16_S5_S3 8000 UMR_U_MIN_1_1_0_S5_S3 0 8000 /end CHARACTERISTIC
/begin CHARACTERISTIC MPT_MPUAUF "PT1- Filterzeitkonstante für m_puauf" VALUE 0x1D7780 ZF_kw_ui8_S5_S3 0.99 UMR___1_100_0_S5_S3 0.01 1 /end CHARACTERISTIC
/begin CHARACTERISTIC MPT_URL "PT1 Filter für Drehzahlgradienenfilterung Sonderfunktion Urluftdetektion" VALUE 0x1D7761 ZF_kw_ui8_S5_S3 0.99 UMR___1_100_0_S5_S3 0.01 1 /end CHARACTERISTIC
/begin CHARACTERISTIC MS_GETRVERL "Momentenschwelle zur Begrenzung des Getriebeverlustmomentes nach oben" VALUE 0x1D7781 ZF_kw_ui8_S5_S3 200 UMR_NM__1_1_0_S5_S3 0 200 /end CHARACTERISTIC
/begin CHARACTERISTIC MS_MOTIST_URL "Schwelle für Istmomentänderung Sonderfunktion Urluftdetektion" VALUE 0x1D82BA ZF_kw_si16_S5_S3 1000 UMR_NM__1_1_0_S5_S3 0 1000 /end CHARACTERISTIC
/begin CHARACTERISTIC MT_ADPULS "Maximale m_t-Aenderung waehrend Befuellpruefung" VALUE 0x1D82A6 ZF_kw_si16_S5_S3 1500 UMR_NM__1_1_0_S5_S3 -200 1300 /end CHARACTERISTIC
/begin CHARACTERISTIC M_ABDYNERR "Ersatzwert fuer dynamisches Abtriebsmoment" VALUE 0x1D82EE ZF_kw_si16_S5_S3 65535 UMR_NM__1_1_0_S5_S3 -32768 32767 /end CHARACTERISTIC
/begin CHARACTERISTIC M_ERSMOTMAXGE "Ersatzwert Max. Motormoment bei GE fuer gef. Getriebeschutz" VALUE 0x1D82D6 ZF_kw_si16_S5_S3 1300 UMR_NM__1_1_0_S5_S3 0 1300 /end CHARACTERISTIC
/begin CHARACTERISTIC M_GETRMAXSTALL "Motormaximalmoment für Stallspeedfunktion" VALUE 0x1D82E8 ZF_kw_si16_S5_S3 1300 UMR_NM__1_1_0_S5_S3 0 1300 /end CHARACTERISTIC
/begin CHARACTERISTIC M_HOTMODEMAXDEC "Motormomentenreduzierung pro Task fuer Hot-Mode-Funktion" VALUE 0x1D8074 ZF_kw_si16_S5_S3 1300 UMR_NM__1_1_0_S5_S3 0 1300 /end CHARACTERISTIC
/begin CHARACTERISTIC M_HOTMODEMAXINC "Motormomentenerhoehung pro Task fuer Hot-Mode-Funktion" VALUE 0x1D8072 ZF_kw_si16_S5_S3 1300 UMR_NM__1_1_0_S5_S3 0 1300 /end CHARACTERISTIC
/begin CHARACTERISTIC M_MOTMAXINC "Incrementwert Motoraufregelrampe gef. Getriebeschutz im Stallspeed" VALUE 0x1D82E2 ZF_kw_si16_S5_S3 1300 UMR_NM__1_1_0_S5_S3 0 1300 /end CHARACTERISTIC
/begin CHARACTERISTIC M_MOTORMAX "Maximal zulässiges Motormoment fuer gef. Getriebeschutz" VALUE 0x1D82D8 ZF_kw_si16_S5_S3 1300 UMR_NM__1_1_0_S5_S3 0 1300 /end CHARACTERISTIC
/begin CHARACTERISTIC M_MOTSCHLUPF "Motormomentengrenze zum Einstieg in die Funktion gef. Getreiebschutz bei Schlupf" VALUE 0x1D82DC ZF_kw_si16_S5_S3 1300 UMR_NM__1_1_0_S5_S3 0 1300 /end CHARACTERISTIC
/begin CHARACTERISTIC ND_SYNMESCHLUPF "Schlupfschwelle zum Einstieg in die Funktion gef. Getriebeschutz bei Schlupf" VALUE 0x1D82DA ZF_kw_ui16_S5_S3 8000 UMR_U_MIN_1_1_0_S5_S3 0 8000 /end CHARACTERISTIC
/begin CHARACTERISTIC NEIGUNG_HYS_PAUS "Neigungshysterese zur Rücksetzung der Anforderung Drehzahlerhöhung bei Auslegen P" VALUE 0x1D8082 ZF_kw_si16_S5_S3 42 UMR_GRAD__1_3_M128_S5_S3 -42 0 /end CHARACTERISTIC
/begin CHARACTERISTIC NEIGUNG_PAUS "Neigungsschwelle zur Anforderung Drehzahlerhöhung bei Auslegen P" VALUE 0x1D73E5 ZF_kw_ui8_S5_S3 42 UMR_GRAD__1_3_M128_S5_S3 0 42 /end CHARACTERISTIC
/begin CHARACTERISTIC NEIG_ERSATZ "Ersatzwert fuer Neigungssignal" VALUE 0x1D73E3 ZF_kw_ui8_S5_S3 84.6667 UMR_GRAD__1_3_M128_S5_S3 -42.6666666667 42 /end CHARACTERISTIC
/begin CHARACTERISTIC NEIG_INI "Initialisierung des Filters Neigungssignal" VALUE 0x1D73E4 ZF_kw_ui8_S5_S3 84.6667 UMR_GRAD__1_3_M128_S5_S3 -42.6666666667 42 /end CHARACTERISTIC
/begin CHARACTERISTIC NEIG_MAX "Maximale Hangneigung Begrenzung" VALUE 0x1D73E2 ZF_kw_ui8_S5_S3 84.6667 UMR_GRAD__1_3_M128_S5_S3 -42.6666666667 42 /end CHARACTERISTIC
/begin CHARACTERISTIC NEIG_MIN "Minimale Hangneigung Begrenzung" VALUE 0x1D73E1 ZF_kw_ui8_S5_S3 84.6667 UMR_GRAD__1_3_M128_S5_S3 -42.6666666667 42 /end CHARACTERISTIC
/begin CHARACTERISTIC NS_ABMEDA "Abtriebsdrehzahlschwelle Dauermotoreingriff" VALUE 0x1D82D4 ZF_kw_ui16_S5_S3 8200 UMR_U_MIN_1_1_0_S5_S3 0 8200 /end CHARACTERISTIC
/begin CHARACTERISTIC NS_ABPULS "Abtriebsdrehzahlschwelle" VALUE 0x1D829E ZF_kw_ui16_S5_S3 1000 UMR_U_MIN_1_1_0_S5_S3 0 1000 /end CHARACTERISTIC
/begin CHARACTERISTIC NS_ABSCHLUPF "Abtriebsdrehzahl Schwelle fuer Schlupferkennung" VALUE 0x1D82E0 ZF_kw_ui16_S5_S3 8000 UMR_U_MIN_1_1_0_S5_S3 0 8000 /end CHARACTERISTIC
/begin CHARACTERISTIC NS_EMSOLLEERPULS "Mindestdrehzahl E- Maschine" VALUE 0x1D82A0 ZF_kw_ui16_S5_S3 1000 UMR_U_MIN_1_1_0_S5_S3 0 1000 /end CHARACTERISTIC
/begin CHARACTERISTIC NS_HYS_EMSOLLEERPULS "Hys.Mindestdrehzahl E- Maschine" VALUE 0x1D82A2 ZF_kw_ui16_S5_S3 500 UMR_U_MIN_1_1_0_S5_S3 0 500 /end CHARACTERISTIC
/begin CHARACTERISTIC NS_MOTIMIN "Drehzahlschwelle für Ansteuerung Minimalbestromung" VALUE 0x1D8068 ZF_kw_ui16_S5_S3 8000 UMR_U_MIN_1_1_0_S5_S3 0 8000 /end CHARACTERISTIC
/begin CHARACTERISTIC NS_MOTPUMPE "Motordrehzahlschwelle fuer Pumpendruck" VALUE 0x1D806A ZF_kw_ui16_S5_S3 8000 UMR_U_MIN_1_1_0_S5_S3 0 8000 /end CHARACTERISTIC
/begin CHARACTERISTIC NS_MOTSTALL "Motordrehzahlschwelle fuer gefuehrter Getriebeschutz im Stallspeed" VALUE 0x1D82E4 ZF_kw_ui16_S5_S3 8000 UMR_U_MIN_1_1_0_S5_S3 0 8000 /end CHARACTERISTIC
/begin CHARACTERISTIC NS_NEIGFILTER1 "Abtriebsdrehzahlschwellwert fuer Filtereinstieg" VALUE 0x1D807A ZF_kw_ui16_S5_S3 2500 UMR_U_MIN_1_1_0_S5_S3 0 2500 /end CHARACTERISTIC
/begin CHARACTERISTIC NS_NEIGFILTER2 "Abtriebsdrehzahlschwellwert fuer Filtereinstieg" VALUE 0x1D807C ZF_kw_ui16_S5_S3 2500 UMR_U_MIN_1_1_0_S5_S3 0 2500 /end CHARACTERISTIC
/begin CHARACTERISTIC NS_TPUMPE "Turbinendrehzahlschwelle fuer Pumpendruck" VALUE 0x1D806E ZF_kw_ui16_S5_S3 8000 UMR_U_MIN_1_1_0_S5_S3 0 8000 /end CHARACTERISTIC
/begin CHARACTERISTIC NS_TSTALL "Turbinendrehzahlschwelle fuer gefuehrter Getriebeschutz im Stallspeed" VALUE 0x1D82E6 ZF_kw_ui16_S5_S3 8000 UMR_U_MIN_1_1_0_S5_S3 0 8000 /end CHARACTERISTIC
/begin CHARACTERISTIC NS_VMPULS "Drehzahlschwelle Verbrennungsmotor" VALUE 0x1D82A4 ZF_kw_ui16_S5_S3 1000 UMR_U_MIN_1_1_0_S5_S3 0 1000 /end CHARACTERISTIC
/begin CHARACTERISTIC N_PULSGRENZ "max. Anzahl Pulse pro Pruefzyklus" VALUE 0x1D7758 ZF_kw_ui8_S5_S3 251 UMR___1_1_0_S5_S3 4 255 /end CHARACTERISTIC
/begin CHARACTERISTIC N_PULSGRENZSTART "max. Anzahl Pulse pro Pruefzyklus zu Beginn der Getriebelaufzeit" VALUE 0x1D775A ZF_kw_ui8_S5_S3 255 UMR___1_1_0_S5_S3 0 255 /end CHARACTERISTIC
/begin CHARACTERISTIC POS_BEW_ABSCHALTKPAD "Mindest-POS-Wert von n_guete f.Bewertgsablauf" VALUE 0x1D82B2 ZF_kw_ui16_S5_S3 8000 UMR_U_MIN_1_1_0_S5_S3 0 8000 /end CHARACTERISTIC
/begin CHARACTERISTIC PO_SFSTUFE_B "Offset auf minimalen Fuelldruck fuer Druckstufe" VALUE 0x1D828C ZF_kw_si16_S5_S3 6 UMR_BAR__1_1000_0_S5_S3 0 6 /end CHARACTERISTIC
/begin CHARACTERISTIC PO_SFSTUFE_C "Offset auf minimalen Fuelldruck fuer Druckstufe" VALUE 0x1D8290 ZF_kw_si16_S5_S3 6 UMR_BAR__1_1000_0_S5_S3 0 6 /end CHARACTERISTIC
/begin CHARACTERISTIC PO_SFSTUFE_D "Offset auf minimalen Fuelldruck fuer Druckstufe" VALUE 0x1D8294 ZF_kw_si16_S5_S3 6 UMR_BAR__1_1000_0_S5_S3 0 6 /end CHARACTERISTIC
/begin CHARACTERISTIC PO_SFSTUFE_E "Offset auf minimalen Fuelldruck fuer Druckstufe" VALUE 0x1D8298 ZF_kw_si16_S5_S3 6 UMR_BAR__1_1000_0_S5_S3 0 6 /end CHARACTERISTIC
/begin CHARACTERISTIC PO_SFSTUFE_K0 "Offset auf minimalen Fuelldruck fuer Druckstufe" VALUE 0x1D829C ZF_kw_si16_S5_S3 6 UMR_BAR__1_1000_0_S5_S3 0 6 /end CHARACTERISTIC
/begin CHARACTERISTIC PS_BREMS "Bremsdruckschwelle für Bremsbedingung" VALUE 0x1D8084 ZF_kw_ui16_S5_S3 99 UMR_BAR__1_1_0_S5_S3 1 100 /end CHARACTERISTIC
/begin CHARACTERISTIC PS_BREMSHYS "Hysterese auf Bremsdruckschwelle für Bremsbedingung" VALUE 0x1D8086 ZF_kw_ui16_S5_S3 19 UMR_BAR__1_1_0_S5_S3 1 20 /end CHARACTERISTIC
/begin CHARACTERISTIC PS_SCHALTUNG_URL "Bremsdruckschwelle Sonderfunktion Urluftdetektion" VALUE 0x1D775F ZF_kw_ui8_S5_S3 100 UMR_BAR__1_1_0_S5_S3 0 100 /end CHARACTERISTIC
/begin CHARACTERISTIC P_OF1KPLBINN "Druckoffset für Kupplung B in Neutral nach Neustart" VALUE 0x1D82D0 ZF_kw_si16_S5_S3 1 UMR_BAR__1_1000_0_S5_S3 0 1 /end CHARACTERISTIC
/begin CHARACTERISTIC SICH_MMOTMAX "Sicherheitsfaktor Berechnung max. zul. Motormoment" VALUE 0x1D7777 ZF_kw_ui8_S5_S3 100 UMR_PROZENT__20_51_0_S5_S3 0 100 /end CHARACTERISTIC
/begin CHARACTERISTIC SWI_ABSOff_VUNPLAUSILEV2 "Schalter zum Deaktiven des ABS-Signals" VALUE 0x191C4C ZF_KW_NAT8_S2_S3 1 SAB_STANDARD_S2_S3 0 1 /end CHARACTERISTIC
/begin CHARACTERISTIC SWI_ACAN_FACAN "Application Parameter to switch between which CAN is used A(0) FA(1) both faulty (3)" VALUE 0x191BF1 ZF_KW_NAT8_S2_S3 3 SAB_STANDARD_S2_S3 0 3 /end CHARACTERISTIC
/begin CHARACTERISTIC SWI_BrakeDiag_BRAKEx "Switch for Diagnosis of Brake Torque Signal" VALUE 0x191BEB ZF_KW_NAT8_S2_S3 1 SAB_STANDARD_S2_S3 0 1 /end CHARACTERISTIC
/begin CHARACTERISTIC SWI_Brake_Intervention "this switch determines whether the external brake intervention input signals are used or not. if they are not used the output variables are set to 0" VALUE 0x191BE7 ZF_KW_NAT8_S2_S3 1 SAB_STANDARD_S2_S3 0 1 /end CHARACTERISTIC
/begin CHARACTERISTIC SWI_Brakelight_BRAKEx "Switch for Diagnosis of KFC_BRAKEF according to f_BrakeErr 0 = diag off 1 = diag breaklight on 2 = diag breaksignal on" VALUE 0x191BE8 ZF_KW_NAT8_S2_S3 3 SAB_STANDARD_S2_S3 0 3 /end CHARACTERISTIC
/begin CHARACTERISTIC SWI_CANControlMonitoring "Bits to control monitoring for CAN message(Bit0=Timeout,Bit1=Checksum,Bit2=Alive counter)" VAL_BLK 0x191E08 ZF_TAB_NAT8_S2_S3 255 SAB_STANDARD_S2_S3 0 255 MATRIX_DIM 64 1 1 /end CHARACTERISTIC
/begin CHARACTERISTIC SWI_CANDiagDelay "stop diagnosis for CAN message (0=sv_KL15 1=Sleep Indication bit is set)" VAL_BLK 0x191E4C ZF_TAB_NAT8_S2_S3 1 SAB_STANDARD_S2_S3 0 1 MATRIX_DIM 64 1 1 /end CHARACTERISTIC
/begin CHARACTERISTIC SWI_CANLearnID "One Switch for each CAN message(0= always monitored;1=only monitored,when message was learned)" VAL_BLK 0x191F14 ZF_TAB_NAT8_S2_S3 1 SAB_STANDARD_S2_S3 0 1 MATRIX_DIM 64 1 1 /end CHARACTERISTIC
/begin CHARACTERISTIC SWI_CGT_CCHIP "switch to select the desired output for the temprature over CAN SWI_CGT_CCHIP == 1: Chip SWI_CGT_CCHIP == 0: CGT" VALUE 0x191C16 ZF_KW_NAT8_S2_S3 1 SAB_STANDARD_S2_S3 0 1 /end CHARACTERISTIC
/begin CHARACTERISTIC SWI_CKMAX_SPSAS "Aktivierung der Beeinflussung der Spontanitätsstufe über Maxauswahl der Kupplungstemperatur" VALUE 0x1D7768 ZF_kw_bool8_S5_S3 1 UMR___1_1_0_S5_S3 0 1 /end CHARACTERISTIC
/begin CHARACTERISTIC SWI_CK_KEINTIPP "Aktiviert das Verbieten von manuellen Schaltungen." VALUE 0x1D7764 ZF_kw_ui8_S5_S3 3 UMR___1_1_0_S5_S3 0 3 /end CHARACTERISTIC
/begin CHARACTERISTIC SWI_CK_MMOTMAX "Aktiviert die Reduzierung des max. Motormoments." VALUE 0x1D7763 ZF_kw_ui8_S5_S3 3 UMR___1_1_0_S5_S3 0 3 /end CHARACTERISTIC
/begin CHARACTERISTIC SWI_CK_SCHALTBEEIN "Aktiviert die Schaltungbeeinflussung." VALUE 0x1D7766 ZF_kw_ui8_S5_S3 3 UMR___1_1_0_S5_S3 0 3 /end CHARACTERISTIC
/begin CHARACTERISTIC SWI_CK_SCHALTVERH "Aktiviert das Verhindern von Schaltungen." VALUE 0x1D7765 ZF_kw_ui8_S5_S3 3 UMR___1_1_0_S5_S3 0 3 /end CHARACTERISTIC
/begin CHARACTERISTIC SWI_CK_SPSAS "Aktiviert die Erhöhung des Spontanitätsindex." VALUE 0x1D7762 ZF_kw_ui8_S5_S3 3 UMR___1_1_0_S5_S3 0 3 /end CHARACTERISTIC
/begin CHARACTERISTIC SWI_CONSIDER_EPB "Schalter zur Aktivierung der Bed. mit Feststellbremse" VALUE 0x1D7779 ZF_kw_bool8_S5_S3 1 UMR___1_1_0_S5_S3 0 1 /end CHARACTERISTIC
/begin CHARACTERISTIC SWI_CalAbForEMSubVal "Schalter um als weiteren Ersatzwert fuer die EM Drehzahl die rueckgerechnete Abtriebsdrehzahl bereitzustellen" VALUE 0x191C04 ZF_KW_NAT8_S2_S3 1 SAB_STANDARD_S2_S3 0 1 /end CHARACTERISTIC
/begin CHARACTERISTIC SWI_CalcMinMom "switch to change the calculation of the output macros GET_M_MOT and GET_M_MOT_STATUS" VALUE 0x191C06 ZF_KW_NAT8_S2_S3 1 SAB_STANDARD_S2_S3 0 1 /end CHARACTERISTIC
/begin CHARACTERISTIC SWI_Calc_CanMsgErrorBitmask_cyclic "Switch to calc the st_CanMsgErrorBitmask in each cycle (=1) or triggerd by AmbConditions (enter of a KFC) (=0)" VALUE 0x191BEF ZF_KW_NAT8_S2_S3 1 SAB_STANDARD_S2_S3 0 1 /end CHARACTERISTIC
/begin CHARACTERISTIC SWI_ChangeOfGear "Switch to deactivate RPM equality check during gear change" VALUE 0x191CD7 ZF_KW_NAT8_S3_S3 1 SAB2_STANDARD_S3_S3 0 1 /end CHARACTERISTIC
/begin CHARACTERISTIC SWI_ClearLearnedMsgStatus "Switch to clean the learned CAN messages 0-no request 1- reset learned messages" VALUE 0x191BEC ZF_KW_NAT8_S2_S3 1 SAB_STANDARD_S2_S3 0 1 /end CHARACTERISTIC
/begin CHARACTERISTIC SWI_DeactivateTipSourceSBW "deactivates the using of SBW tip signals" VALUE 0x191C5B ZF_KW_NAT8_S2_S3 1 SAB_STANDARD_S2_S3 0 1 /end CHARACTERISTIC
/begin CHARACTERISTIC SWI_DontLearnInvalidSignal "deactivates: CAN Paddle Learning if the signal is invalid" VALUE 0x191C58 ZF_KW_NAT8_S2_S3 1 SAB_STANDARD_S2_S3 0 1 /end CHARACTERISTIC
/begin CHARACTERISTIC SWI_DoorD "Switch to select primary or secondary input signal of DoorD" VALUE 0x191BF5 ZF_KW_NAT8_S2_S3 1 SAB_STANDARD_S2_S3 0 1 /end CHARACTERISTIC
/begin CHARACTERISTIC SWI_DriveDirByNabOrNwheel "Switch for selection of source of driving direction 0=Prio 1: nAb; 1=Prio 1: Wheels; 2=just nAb; 3=only Wheels" VALUE 0x191BF6 ZF_KW_NAT8_S2_S3 3 SAB_N_1RPM_S2_S3 0 3 /end CHARACTERISTIC
/begin CHARACTERISTIC SWI_EIMon_PErrMem "Switch which activates records to the Primary-Error memory. 0: records disabled; 1: records enabled" VALUE 0x191CC5 ZF_KW_NAT8_S3_S3 1 SAB2_STANDARD_S3_S3 0 1 /end CHARACTERISTIC
/begin CHARACTERISTIC SWI_EIMon_SErrMem "Switch which activates records to the Shadow-Error memory. 0: records disabled; 1: records enabled" VALUE 0x191CC4 ZF_KW_NAT8_S3_S3 1 SAB2_STANDARD_S3_S3 0 1 /end CHARACTERISTIC
/begin CHARACTERISTIC SWI_EdsCharacteristic "Bitmask for hydraulic specific pressure regulator chracteristics 0-decreasing 1-increasing" VALUE 0x191C0F ZF_KW_NAT8_S2_S3 255 SAB_STANDARD_S2_S3 0 255 /end CHARACTERISTIC
/begin CHARACTERISTIC SWI_EngMonitor_1ENGSIGTRQ "Datafield to switch on/off monitoring torque-failure" VALUE 0x191C02 ZF_KW_NAT8_S2_S3 255 SAB_STANDARD_S2_S3 0 255 /end CHARACTERISTIC
/begin CHARACTERISTIC SWI_EngMonitor_2ENGSIGTRQ "Datafield to switch on/off monitoring torque-failure" VALUE 0x191C03 ZF_KW_NAT8_S2_S3 255 SAB_STANDARD_S2_S3 0 255 /end CHARACTERISTIC
/begin CHARACTERISTIC SWI_EpumpConsiderAliveSignal "Switch for activating the Alive-Signal" VALUE 0x191BDC ZF_KW_NAT8_S2_S3 1 SAB_STANDARD_S2_S3 0 1 /end CHARACTERISTIC
/begin CHARACTERISTIC SWI_EpumpConsiderAliveSignalDP "Switch for activating the Alive-Signal diagnosis at duty point 1 2 or 3" VALUE 0x191BDD ZF_KW_NAT8_S2_S3 1 SAB_STANDARD_S2_S3 0 1 /end CHARACTERISTIC
/begin CHARACTERISTIC SWI_FSTBREMSE "Schalter, ob Feststellbremse fuer Bremsbedingung ausgewertet werden soll (true, dann erfolgt Auswertung)" VALUE 0x1D73E6 ZF_kw_bool8_S5_S3 1 UMR___1_1_0_S5_S3 0 1 /end CHARACTERISTIC
/begin CHARACTERISTIC SWI_FaultSourceLEV2 "Appplication switch for switching the error handling for flag errors and complement errors" VALUE 0x191CC6 ZF_KW_NAT8_S3_S3 255 SAB2_STANDARD_S3_S3 0 255 /end CHARACTERISTIC
/begin CHARACTERISTIC SWI_ForceLearnRearAxleRatio "Appplication switch for activating Forced Learn (0=activated; 0xA5=deactivated)" VALUE 0x191C43 ZF_KW_NAT8_S2_S3 255 SAB_STANDARD_S2_S3 0 255 /end CHARACTERISTIC
/begin CHARACTERISTIC SWI_GWS_DriveLogic "Switch if Sport-Wippen are available or not" VALUE 0x191C4E ZF_KW_NAT8_S2_S3 1 SAB_STANDARD_S2_S3 0 1 /end CHARACTERISTIC
/begin CHARACTERISTIC SWI_GWS_S_Button "Switch if Sport-Button from GWS is monitored" VALUE 0x191C4F ZF_KW_NAT8_S2_S3 1 SAB_STANDARD_S2_S3 0 1 /end CHARACTERISTIC
/begin CHARACTERISTIC SWI_GearLimitSubst_H "4-higher bytes of bitmask to check if GearLimit must be set" VALUE 0x191FA0 ZF_KW_NAT32_S2_S3 4294970000 SAB_STANDARD_S2_S3 0 4294967295 /end CHARACTERISTIC
/begin CHARACTERISTIC SWI_GearLimitSubst_L "4-lower bytes of bitmask to check if GearLimit must be set" VALUE 0x191F9C ZF_KW_NAT32_S2_S3 4294970000 SAB_STANDARD_S2_S3 0 4294967295 /end CHARACTERISTIC
/begin CHARACTERISTIC SWI_GearboxReinforcementCalculation "Switch between types of gearbox reinforcement calculation." VALUE 0x191CD2 ZF_KW_NAT8_S3_S3 1 SAB2_STANDARD_S3_S3 0 1 /end CHARACTERISTIC
/begin CHARACTERISTIC SWI_GearboxReinforcement_Err "Application parameter to activate error check" VALUE 0x191CD1 ZF_KW_NAT8_S3_S3 15 SAB2_STANDARD_S3_S3 0 15 /end CHARACTERISTIC
/begin CHARACTERISTIC SWI_HA_Learn_Reset "Appplication switch for reseting rear axle ratio learning function (0xA5 = reset)" VALUE 0x191C42 ZF_KW_NAT8_S2_S3 255 SAB_STANDARD_S2_S3 0 255 /end CHARACTERISTIC
/begin CHARACTERISTIC SWI_HIS_verbaut "Schalter fuer die Aktivierung des HIS Lernmodus. 0: HIS Learnmodus 1: HIS Ein 2: HIS Aus" VALUE 0x191C24 ZF_KW_NAT8_S2_S3 2 SAB_STANDARD_S2_S3 0 2 /end CHARACTERISTIC
/begin CHARACTERISTIC SWI_ICM_S_Button "Switch if Sport-Button from ICM is monitored" VALUE 0x191C4D ZF_KW_NAT8_S2_S3 1 SAB_STANDARD_S2_S3 0 1 /end CHARACTERISTIC
/begin CHARACTERISTIC SWI_IG_HA_Learn "Appplication switch for activating rear axle ratio learning function (0 = deactivated 1 = activated)" VALUE 0x191C3B ZF_KW_NAT8_S2_S3 1 SAB_STANDARD_S2_S3 0 1 /end CHARACTERISTIC
/begin CHARACTERISTIC SWI_IgnPlausiActive "flag to activate or deactivate the plausible check for CAN signal against hardware signal" VALUE 0x191C1D ZF_KW_NAT8_S2_S3 1 SAB_STANDARD_S2_S3 0 1 /end CHARACTERISTIC
/begin CHARACTERISTIC SWI_Inclination "0: keine Beruecksichtigung des CAN Signals 1: Beruecksichtigung des CAN Signals" VALUE 0x191C21 ZF_KW_NAT8_S2_S3 1 SAB_STANDARD_S2_S3 0 1 /end CHARACTERISTIC
/begin CHARACTERISTIC SWI_InclinationSignalNegated "0: leave CAN-signal 1: negate CAN-signal" VALUE 0x191C22 ZF_KW_NAT8_S2_S3 1 SAB_STANDARD_S2_S3 0 1 /end CHARACTERISTIC
/begin CHARACTERISTIC SWI_LTog_PARK "Toggle event for backward filter KFC_PARK Bit 0: L3 Bit 1: L4" VALUE 0x191C27 ZF_KW_NAT8_S2_S3 3 SAB_STANDARD_S2_S3 0 3 /end CHARACTERISTIC
/begin CHARACTERISTIC SWI_LearnTip "switches: learning or using fix of tip sources Bit3 = learn Bit2 = reserviert Bit1 = Analog Bit0 = CAN" VALUE 0x191C5A ZF_KW_NAT8_S2_S3 15 SAB_STANDARD_S2_S3 0 15 /end CHARACTERISTIC
/begin CHARACTERISTIC SWI_LeverType "Parameter for type-selection of lever (automatic/sport/IEX E70) SWI_LeverType == 0 relative signal SWI_LeverType == 1 absolute signal" VALUE 0x191C0B ZF_KW_NAT8_S2_S3 2 SAB_STANDARD_S2_S3 0 2 /end CHARACTERISTIC
/begin CHARACTERISTIC SWI_MASS_CKMAX "Schalter zur auswahl ob Massnahme für die aktive Schaltung oder abhängig von Maxauswahl der Kupplungstemperaturausgeführt wird." VALUE 0x1D7769 ZF_kw_bool8_S5_S3 1 UMR___1_1_0_S5_S3 0 1 /end CHARACTERISTIC
/begin CHARACTERISTIC SWI_MEUW "Switch Motoreingriffsueberwachung" VALUE 0x1D7775 ZF_kw_bool8_S5_S3 1 UMR___1_1_0_S5_S3 0 1 /end CHARACTERISTIC
/begin CHARACTERISTIC SWI_ME_Anforderung_alt_neu "Decision for usage of old or USAGE_IS_NOT_ALLOWED engine intervention calculation" VALUE 0x191CC7 ZF_KW_NAT8_S3_S3 1 SAB2_STANDARD_S3_S3 0 1 /end CHARACTERISTIC
/begin CHARACTERISTIC SWI_ME_Anforderung_alt_neu_2 "Decision for usage of old or USAGE_IS_NOT_ALLOWED engine intervention calculation for Change Request 803" VALUE 0x191CCA ZF_KW_NAT8_S3_S3 1 SAB2_STANDARD_S3_S3 0 1 /end CHARACTERISTIC
/begin CHARACTERISTIC SWI_NMOTMPUAUF "Schalter für die Umschaltung der Eingangsgröße für die Pumpenaufnahmeberechnung 0: n_mot_pu 1: n_mot" VALUE 0x1D777F ZF_kw_bool8_S5_S3 1 UMR___1_1_0_S5_S3 0 1 /end CHARACTERISTIC
/begin CHARACTERISTIC SWI_NTNAB_URL "Schalter zur Auswahl n_t bzw. n_ab zur Gradientenberechnung Sonderfunktion Urluftdetektion" VALUE 0x1D7760 ZF_kw_ui8_S5_S3 1 UMR___1_1_0_S5_S3 0 1 /end CHARACTERISTIC
/begin CHARACTERISTIC SWI_PBR "Schalter, ob Bremsdruckschwelle fuer Bremsbedingung ausgewertet werden soll (true, dann erfolgt Auswertung)" VALUE 0x1D73E7 ZF_kw_bool8_S5_S3 1 UMR___1_1_0_S5_S3 0 1 /end CHARACTERISTIC
/begin CHARACTERISTIC SWI_PButtonSignal "Parameter for Park-taster-selection SWI_PButtonSignal == 0:use the both raw signals for parktaster SWI_PButtonSignal == 1:use the lever raw signal and the respective complement signal" VALUE 0x191C0C ZF_KW_NAT8_S2_S3 1 SAB_STANDARD_S2_S3 0 1 /end CHARACTERISTIC
/begin CHARACTERISTIC SWI_PMA_RCP_FunctionActive "SWI to deactivate or activate the PMA function; 0: PMA function deactivated; 1: PMA function activated; 2: Activate PMA function from CAN" VALUE 0x191C26 ZF_KW_NAT8_S2_S3 2 SAB_STANDARD_S2_S3 0 2 /end CHARACTERISTIC
/begin CHARACTERISTIC SWI_POSPULS "Schalter zur Berücksichtigung der Wahlhebelposition in den Grundbedingungen 0=N, 1=D," VALUE 0x1D7756 ZF_kw_ui8_S5_S3 1 UMR___1_1_0_S5_S3 0 1 /end CHARACTERISTIC
/begin CHARACTERISTIC SWI_PREADAPTION_START_STADA "Manipulation der Schnittstelle GET_PREADAPTION_START zu Testzwecken" VALUE 0x1D73E8 ZF_kw_ui8_S5_S3 2 UMR___1_1_0_S5_S3 0 2 /end CHARACTERISTIC
/begin CHARACTERISTIC SWI_PreConditions "SWI for deactivating conditions (set condition fulfilled): Bit0=EngineSpeed Bit1=TurbineSpeed Bit2=TransmissionOutputSpeed Bit3=VehicleSpeed Bit4=Pos Bit5=KL15PIN Bit6=KL15CAN Bit7=DriveState Bit8=EWS Bit9=Ignition Bit10-15 notused" VALUE 0x191A26 ZF_KW_NAT16_S2_S3 65535 SAB_STANDARD_S2_S3 0 65535 /end CHARACTERISTIC
/begin CHARACTERISTIC SWI_PuCalc "Application switch for calculation of m_PumpCensored (0 = calculation off 1 calculation on)" VALUE 0x191CD6 ZF_KW_NAT8_S3_S3 1 SAB2_STANDARD_S3_S3 0 1 /end CHARACTERISTIC
/begin CHARACTERISTIC SWI_RCControlStoppNRC0x24 "SWI to activate ckeck stop during state Basic setting not running" VALUE 0x191C46 ZF_KW_NAT8_S2_S3 1 SAB_STANDARD_S2_S3 0 1 /end CHARACTERISTIC
/begin CHARACTERISTIC SWI_ResetPaddleLearned "set f_CANPaddleLearned and f_AnalogPaddleLearned to zero and reset corresponding timer if available" VALUE 0x191C59 ZF_KW_NAT8_S2_S3 1 SAB_STANDARD_S2_S3 0 1 /end CHARACTERISTIC
/begin CHARACTERISTIC SWI_RpmDynOut "Switch for enabling dynamic revolution counter data" VALUE 0x191C23 ZF_KW_NAT8_S2_S3 1 SAB_STANDARD_S2_S3 0 1 /end CHARACTERISTIC
/begin CHARACTERISTIC SWI_SPSAS_DEF "Spontanitätsindex der bei der Massnahme Beeinflussung Spontanitätsindex gesetzt wird." VALUE 0x1D7767 ZF_kw_ui8_S5_S3 2 UMR___1_1_0_S5_S3 0 2 /end CHARACTERISTIC
/begin CHARACTERISTIC SWI_SetOut2_DitherActive "0 = Switching off the dither amplitude frequency is generated by the hardware supplier. (default if the interface is never called) 1 = Switching on the dither amplitude frequency and amplitude are generated by the hardware supplier" VALUE 0x191BDE ZF_KW_NAT8_S2_S3 1 SAB_STANDARD_S2_S3 0 1 /end CHARACTERISTIC
/begin CHARACTERISTIC SWI_SetOut5_DitherActive "0 = Switching off the dither amplitude frequency is generated by the hardware supplier. (default if the interface is never called) 1 = Switching on the dither amplitude frequency and amplitude are generated by the hardware supplier" VALUE 0x191BDF ZF_KW_NAT8_S2_S3 1 SAB_STANDARD_S2_S3 0 1 /end CHARACTERISTIC
/begin CHARACTERISTIC SWI_SignalSource "parameter to switch between S1 and S2-Data" VALUE 0x191C0D ZF_KW_NAT8_S2_S3 3 SAB_STANDARD_S2_S3 0 3 /end CHARACTERISTIC
/begin CHARACTERISTIC SWI_SmokeCalc "Appplication switch for consideration of smoke limitation (0 = no consideration 1 = consideration)" VALUE 0x191BF4 ZF_KW_NAT8_S2_S3 1 SAB_STANDARD_S2_S3 0 1 /end CHARACTERISTIC
/begin CHARACTERISTIC SWI_Source_Nab_NWheel "switch to choose the n_Ab output source" VALUE 0x191C5F ZF_KW_NAT8_S2_S3 2 SAB_STANDARD_S2_S3 0 2 /end CHARACTERISTIC
/begin CHARACTERISTIC SWI_SwapHighLowByte_Inputs "0=do nothing --- 1=swaps the high byte with the low byte of the input values" VALUE 0x191BF2 ZF_KW_NAT8_S2_S3 1 SAB_STANDARD_S2_S3 0 1 /end CHARACTERISTIC
/begin CHARACTERISTIC SWI_UMSCHALTDKI "Über den Schalter SWI_UMSCHALTDKI wird die Eingangsgröße für verschiedene Label ausgewählt. Es kann zwischen dki (0) und m_motsoll_mod (1) gewählt werden" VALUE 0x1D73E9 ZF_kw_bool8_S5_S3 1 UMR___1_1_0_S5_S3 0 1 /end CHARACTERISTIC
/begin CHARACTERISTIC SWI_UseQualifier "1 = the diversity can signal is used 0 = the diversity can signal is not used" VALUE 0x191C1C ZF_KW_NAT8_S2_S3 1 SAB_STANDARD_S2_S3 0 1 /end CHARACTERISTIC
/begin CHARACTERISTIC SWI_ValuesToDetectLimphome "Parameter to define FAT control state" VALUE 0x191CCD ZF_KW_NAT8_S3_S3 255 SAB2_STANDARD_S3_S3 0 255 /end CHARACTERISTIC
/begin CHARACTERISTIC SWI_Zf_Application_Can "switch for the AZG activation 1 = AZG active; 0 = AZG inactive" VALUE 0x191BE0 ZF_KW_NAT8_S2_S3 1 SAB_STANDARD_S2_S3 0 1 /end CHARACTERISTIC
/begin CHARACTERISTIC SWI_Zf_Edicmobil_Can "switch for the EDIC activation 1 = EDIC active; 0 = EDIC inactive" VALUE 0x191BE2 ZF_KW_NAT8_S2_S3 1 SAB_STANDARD_S2_S3 0 1 /end CHARACTERISTIC
/begin CHARACTERISTIC SWI_extended_analyse "Activation for analysis of message special coding with 0 = inactiv 1 = activ" VALUE 0x191C25 ZF_KW_NAT8_S2_S3 1 SAB_STANDARD_S2_S3 0 1 /end CHARACTERISTIC
/begin CHARACTERISTIC SWI_morethan255KFCs "use at the initialisation of user-specific error-codes for textual error display one or two bytes (AZGcmd 0x0E)(1 = read error codes with 2 bytes; 0 = provide AZG text for max 255 error codes)" VALUE 0x191BE1 ZF_KW_NAT8_S2_S3 1 SAB_STANDARD_S2_S3 0 1 /end CHARACTERISTIC
/begin CHARACTERISTIC SWI_n_AbMaxCalc "switch to choose between Max Selection Variants 0=GET_NAB_MAX = GET_NAB 1=GET_NAB_MAX = MAX Select outside a defined gear and a difference between n_Ab and n_WheelAvg 2=GET_NAB_MAX = MAX Select always" VALUE 0x191C60 ZF_KW_NAT8_S2_S3 2 SAB_STANDARD_S2_S3 0 2 /end CHARACTERISTIC
/begin CHARACTERISTIC SWI_n_AbTuPlausi_SENSORLEV2 "Switch to enable check of a nTu-nAb error while a the rear axle ratio is not learned 0=Disabled 1=Enabled" VALUE 0x191C2F ZF_KW_NAT8_S2_S3 1 SAB_STANDARD_S2_S3 0 1 /end CHARACTERISTIC
/begin CHARACTERISTIC SWI_n_AbUThGearSubst1 "Switch to chose between calculated or Fix NAB for 1. Gear" VALUE 0x191BF9 ZF_KW_NAT8_S2_S3 1 SAB_STANDARD_S2_S3 0 1 /end CHARACTERISTIC
/begin CHARACTERISTIC SWI_n_AbUThGearSubst2 "Switch to chose between calculated or Fix NAB for 2. Gear" VALUE 0x191BFA ZF_KW_NAT8_S2_S3 1 SAB_STANDARD_S2_S3 0 1 /end CHARACTERISTIC
/begin CHARACTERISTIC SWI_n_AbUThGearSubst3 "Switch to chose between calculated or Fix NAB for 3. Gear" VALUE 0x191BFB ZF_KW_NAT8_S2_S3 1 SAB_STANDARD_S2_S3 0 1 /end CHARACTERISTIC
/begin CHARACTERISTIC SWI_n_AbUThGearSubst4 "Switch to chose between calculated or Fix NAB for 4. Gear" VALUE 0x191BFC ZF_KW_NAT8_S2_S3 1 SAB_STANDARD_S2_S3 0 1 /end CHARACTERISTIC
/begin CHARACTERISTIC SWI_n_AbUThGearSubst5 "Switch to chose between calculated or Fix NAB for 5. Gear" VALUE 0x191BFD ZF_KW_NAT8_S2_S3 1 SAB_STANDARD_S2_S3 0 1 /end CHARACTERISTIC
/begin CHARACTERISTIC SWI_n_AbUThGearSubst6 "Switch to chose between calculated or Fix NAB for 6. Gear" VALUE 0x191BFE ZF_KW_NAT8_S2_S3 1 SAB_STANDARD_S2_S3 0 1 /end CHARACTERISTIC
/begin CHARACTERISTIC SWI_n_EnUTh "Switch to chose between calculated or Fix Engine-Limitation-RPM" VALUE 0x191BFF ZF_KW_NAT8_S2_S3 1 SAB_STANDARD_S2_S3 0 1 /end CHARACTERISTIC
/begin CHARACTERISTIC SWI_n_EngIdle "Application switch to select input signal: 0 = use both iv_n_EngIdle and iv_n_EngIdleExt 1 = use iv_n_EngIdle 2 = use iv_n_EngIdleExt" VALUE 0x191C01 ZF_KW_NAT8_S2_S3 2 SAB_STANDARD_S2_S3 0 2 /end CHARACTERISTIC
/begin CHARACTERISTIC SWI_n_EngMaxRed "selector switch for sv_n_EngRed and sv_n_EngMaxRed calculation method" VALUE 0x191C05 ZF_KW_NAT8_S2_S3 3 SAB_STANDARD_S2_S3 0 3 /end CHARACTERISTIC
/begin CHARACTERISTIC T1_BEW_ABSCHALTKPAD "Ende Bewertgsfenster z.Erkenng MIN-Wert von n_guete" VALUE 0x1D82B4 ZF_kw_ui16_S5_S3 2500 UMR_MSEC__10_1_0_S5_S3 0 2500 /end CHARACTERISTIC
/begin CHARACTERISTIC T2_BEW_ABSCHALTKPAD "Ende Bewertgsfenster z.Erkenng MAX-Wert von n_guete" VALUE 0x1D82B6 ZF_kw_ui16_S5_S3 2500 UMR_MSEC__10_1_0_S5_S3 0 2500 /end CHARACTERISTIC
/begin CHARACTERISTIC TAB_CSGVBMRS "Tabelle Getriebetemperaturschwelle Verbot MRS" MAP 0x19A8C4 ZF_tab2d_ui8_S5_S3 255 UMR_GRADC__1_1_M40_S5_S3 -40 215
 /begin AXIS_DESCR FIX_AXIS zff_atsys._.iSignale._.obj.sig_istgang UMR___1_1_0_S5_S3 10 -1 8 READ_ONLY FIX_AXIS_PAR_DIST -1 1 10 /end AXIS_DESCR
 /begin AXIS_DESCR FIX_AXIS zff_atsys._.iSignale._.obj.sig_zielgang_sas UMR___1_1_0_S5_S3 10 -1 8 READ_ONLY FIX_AXIS_PAR_DIST -1 1 10 /end AXIS_DESCR
/end CHARACTERISTIC
/begin CHARACTERISTIC TAB_CS_ADPULSOB "Obere c_getr-Schwelle fuer Pulsadapton" CURVE 0x19A358 ZF_tab_ui8_S5_S3 190 UMR_GRADC__1_1_M40_S5_S3 -40 150
 /begin AXIS_DESCR FIX_AXIS iAdaPulzs.kup_puls UMR___1_1_0_S5_S3 6 1 6 READ_ONLY FIX_AXIS_PAR_DIST 1 1 6 /end AXIS_DESCR
/end CHARACTERISTIC
/begin CHARACTERISTIC TAB_JGETR "Traegheitsmoment Getriebe" CURVE 0x19AD68 ZF_tab_ui16_S5_S3 10 UMR_KGM2__1_1000_0_S5_S3 0 10
 /begin AXIS_DESCR FIX_AXIS zff_atsys._.iSignale._.obj.sig_zielgang UMR___1_1_0_S5_S3 10 -1 8 READ_ONLY FIX_AXIS_PAR_DIST -1 1 10 /end AXIS_DESCR
/end CHARACTERISTIC
/begin CHARACTERISTIC TAB_KUPPULS1 "Tabelle zu pulsende Kupplung Prio1" CURVE 0x19A384 ZF_tab_ui8_S5_S3 6 UMR___1_1_0_S5_S3 0 6
 /begin AXIS_DESCR FIX_AXIS zff_atsys._.iSignale._.obj.sig_istgang UMR___1_1_0_S5_S3 10 -1 8 READ_ONLY FIX_AXIS_PAR_DIST -1 1 10 /end AXIS_DESCR
/end CHARACTERISTIC
/begin CHARACTERISTIC TAB_KUPPULS2 "Tabelle zu pulsende Kupplung Prio2" CURVE 0x19A394 ZF_tab_ui8_S5_S3 6 UMR___1_1_0_S5_S3 0 6
 /begin AXIS_DESCR FIX_AXIS zff_atsys._.iSignale._.obj.sig_istgang UMR___1_1_0_S5_S3 10 -1 8 READ_ONLY FIX_AXIS_PAR_DIST -1 1 10 /end AXIS_DESCR
/end CHARACTERISTIC
/begin CHARACTERISTIC TAB_MGETRMAX "Tabelle fuer zul. Getriebeeingangsmoment" CURVE 0x19A994 ZF_tab_si16_S5_S3 1300 UMR_NM__1_1_0_S5_S3 0 1300
 /begin AXIS_DESCR FIX_AXIS zff_atsys._.iSignale._.obj.sig_zielgang UMR___1_1_0_S5_S3 10 -1 8 READ_ONLY FIX_AXIS_PAR_DIST -1 1 10 /end AXIS_DESCR
/end CHARACTERISTIC
/begin CHARACTERISTIC TAB_MGETRMAXSHIFT "Tabelle fuer zul. Getriebeeingangsmoment in Hochschaltung" MAP 0x19A9FC ZF_tab2d_si16_S5_S3 1300 UMR_NM__1_1_0_S5_S3 0 1300
 /begin AXIS_DESCR FIX_AXIS zff_atsys._.iSignale._.obj.sig_istgang UMR___1_1_0_S5_S3 10 -1 8 READ_ONLY FIX_AXIS_PAR_DIST -1 1 10 /end AXIS_DESCR
 /begin AXIS_DESCR FIX_AXIS zff_atsys._.iSignale._.obj.sig_zielgang UMR___1_1_0_S5_S3 10 -1 8 READ_ONLY FIX_AXIS_PAR_DIST -1 1 10 /end AXIS_DESCR
/end CHARACTERISTIC
/begin CHARACTERISTIC TAB_MSTVB "Tabelle m_t-Schwelle fuer Momentenschutz Schaltverbot" MAP 0x19A584 ZF_tab2d_si16_S5_S3 1500 UMR_NM__1_1_0_S5_S3 -200 1300
 /begin AXIS_DESCR FIX_AXIS zff_atsys._.iSignale._.obj.sig_istgang UMR___1_1_0_S5_S3 10 -1 8 READ_ONLY FIX_AXIS_PAR_DIST -1 1 10 /end AXIS_DESCR
 /begin AXIS_DESCR FIX_AXIS zff_atsys._.iSignale._.obj.sig_zielgang_sas UMR___1_1_0_S5_S3 10 -1 8 READ_ONLY FIX_AXIS_PAR_DIST -1 1 10 /end AXIS_DESCR
/end CHARACTERISTIC
/begin CHARACTERISTIC TAB_MT_ADPULSOB "obere Turbinenmomentschwelle f.Befuellpruefg" CURVE 0x19A2A8 ZF_tab_si16_S5_S3 1500 UMR_NM__1_1_0_S5_S3 -200 1300
 /begin AXIS_DESCR FIX_AXIS iAdaPulzs.kup_puls UMR___1_1_0_S5_S3 6 1 6 READ_ONLY FIX_AXIS_PAR_DIST 1 1 6 /end AXIS_DESCR
/end CHARACTERISTIC
/begin CHARACTERISTIC TAB_MT_ADPULSUN "untere Turbinenmomentschwelle f.Befuellpruefg" CURVE 0x19A298 ZF_tab_si16_S5_S3 1500 UMR_NM__1_1_0_S5_S3 -200 1300
 /begin AXIS_DESCR FIX_AXIS iAdaPulzs.kup_puls UMR___1_1_0_S5_S3 6 1 6 READ_ONLY FIX_AXIS_PAR_DIST 1 1 6 /end AXIS_DESCR
/end CHARACTERISTIC
/begin CHARACTERISTIC TAB_ND_ADABBR "ND-Schwelle fuer Abbruch Befuellpruefung gangabhaengig" CURVE 0x19A2F8 ZF_tab_si16_S5_S3 2000 UMR_U_MIN_1_1_0_S5_S3 -1000 1000
 /begin AXIS_DESCR FIX_AXIS zff_atsys._.iSignale._.obj.sig_istgang UMR___1_1_0_S5_S3 10 -1 8 READ_ONLY FIX_AXIS_PAR_DIST -1 1 10 /end AXIS_DESCR
/end CHARACTERISTIC
/begin CHARACTERISTIC TAB_NGUETE_KUPADA_URL "Tabelle zur Bewertung von n_guete während Pulsprüfung bei aktiver Sonderfunktion Urluftdetektion" CURVE 0x19A488 ZF_tab_ui16_S5_S3 1000 UMR_U_MIN_1_1_0_S5_S3 0 1000
 /begin AXIS_DESCR FIX_AXIS NO_INPUT_QUANTITY UMR___1_1_0_S5_S3 6 1 6 READ_ONLY FIX_AXIS_PAR_DIST 1 1 6 /end AXIS_DESCR
/end CHARACTERISTIC
/begin CHARACTERISTIC TAB_NG_SCHALTUNG_URL "Tabelle zur Bewertung des Drehzahlgradienten während Schaltung bei aktiver Sonderfunktion Urluftdetektion" CURVE 0x19A4A4 ZF_tab_ui16_S5_S3 10000 UMR_U_MINSEC_10_1_0_S5_S3 0 10000
 /begin AXIS_DESCR FIX_AXIS NO_INPUT_QUANTITY UMR___1_1_0_S5_S3 5 1 5 READ_ONLY FIX_AXIS_PAR_DIST 1 1 5 /end AXIS_DESCR
/end CHARACTERISTIC
/begin CHARACTERISTIC TAB_NMOT_ADPULSOB "Obere n_mot-Schwelle fuer Befuellpruefung" CURVE 0x19A2B8 ZF_tab_si16_S5_S3 8200 UMR_U_MIN_1_1_0_S5_S3 0 8200
 /begin AXIS_DESCR FIX_AXIS iAdaPulzs.kup_puls UMR___1_1_0_S5_S3 6 1 6 READ_ONLY FIX_AXIS_PAR_DIST 1 1 6 /end AXIS_DESCR
/end CHARACTERISTIC
/begin CHARACTERISTIC TAB_NMOT_ADPULSUN "Untere n_mot-Schwelle fuer Befuellpruefung" CURVE 0x19A2C8 ZF_tab_si16_S5_S3 8200 UMR_U_MIN_1_1_0_S5_S3 0 8200
 /begin AXIS_DESCR FIX_AXIS iAdaPulzs.kup_puls UMR___1_1_0_S5_S3 6 1 6 READ_ONLY FIX_AXIS_PAR_DIST 1 1 6 /end AXIS_DESCR
/end CHARACTERISTIC
/begin CHARACTERISTIC TAB_NSABRSV "Tabelle Rueckschaltverhinderung, Abtriebsdrehzahlschwelle fuer Rueckschaltungen" MAP 0x19A7F4 ZF_tab2d_ui16_S5_S3 8160 UMR_U_MIN_1_1_0_S5_S3 0 8160
 /begin AXIS_DESCR FIX_AXIS zff_atsys._.iSignale._.obj.sig_istgang UMR___1_1_0_S5_S3 10 -1 8 READ_ONLY FIX_AXIS_PAR_DIST -1 1 10 /end AXIS_DESCR
 /begin AXIS_DESCR FIX_AXIS zff_atsys._.iSignale._.obj.sig_zielgang_sas UMR___1_1_0_S5_S3 10 -1 8 READ_ONLY FIX_AXIS_PAR_DIST -1 1 10 /end AXIS_DESCR
/end CHARACTERISTIC
/begin CHARACTERISTIC TAB_NSABVB "Tabelle n_ab-Schwelle fuer Momentenschutz Schaltverbot" MAP 0x19A4B4 ZF_tab2d_ui16_S5_S3 8160 UMR_U_MIN_1_1_0_S5_S3 0 8160
 /begin AXIS_DESCR FIX_AXIS zff_atsys._.iSignale._.obj.sig_istgang UMR___1_1_0_S5_S3 10 -1 8 READ_ONLY FIX_AXIS_PAR_DIST -1 1 10 /end AXIS_DESCR
 /begin AXIS_DESCR FIX_AXIS zff_atsys._.iSignale._.obj.sig_zielgang_sas UMR___1_1_0_S5_S3 10 -1 8 READ_ONLY FIX_AXIS_PAR_DIST -1 1 10 /end AXIS_DESCR
/end CHARACTERISTIC
/begin CHARACTERISTIC TAB_NSMOTRSV "Tabelle Rueckschaltverhinderung, Motordrehzahlschwelle fuer Rueckschaltungen" MAP 0x19A724 ZF_tab2d_ui16_S5_S3 8160 UMR_U_MIN_1_1_0_S5_S3 0 8160
 /begin AXIS_DESCR FIX_AXIS zff_atsys._.iSignale._.obj.sig_istgang UMR___1_1_0_S5_S3 10 -1 8 READ_ONLY FIX_AXIS_PAR_DIST -1 1 10 /end AXIS_DESCR
 /begin AXIS_DESCR FIX_AXIS zff_atsys._.iSignale._.obj.sig_zielgang_sas UMR___1_1_0_S5_S3 10 -1 8 READ_ONLY FIX_AXIS_PAR_DIST -1 1 10 /end AXIS_DESCR
/end CHARACTERISTIC
/begin CHARACTERISTIC TAB_NSTARTWERTE_KPAD "Anzahl der Pruefdurchlaeufe mit erw. Werten" CURVE 0x19A328 ZF_tab_ui8_S5_S3 99 UMR___1_1_0_S5_S3 1 100
 /begin AXIS_DESCR FIX_AXIS iAdaPulzs.kup_puls UMR___1_1_0_S5_S3 6 1 6 READ_ONLY FIX_AXIS_PAR_DIST 1 1 6 /end AXIS_DESCR
/end CHARACTERISTIC
/begin CHARACTERISTIC TAB_NSTRSV "Tabelle Rueckschaltverhinderung, Turbinendrehzahlschwelle fuer Rueckschaltungen" MAP 0x19A654 ZF_tab2d_ui16_S5_S3 8160 UMR_U_MIN_1_1_0_S5_S3 0 8160
 /begin AXIS_DESCR FIX_AXIS zff_atsys._.iSignale._.obj.sig_istgang UMR___1_1_0_S5_S3 10 -1 8 READ_ONLY FIX_AXIS_PAR_DIST -1 1 10 /end AXIS_DESCR
 /begin AXIS_DESCR FIX_AXIS zff_atsys._.iSignale._.obj.sig_zielgang_sas UMR___1_1_0_S5_S3 10 -1 8 READ_ONLY FIX_AXIS_PAR_DIST -1 1 10 /end AXIS_DESCR
/end CHARACTERISTIC
/begin CHARACTERISTIC TAB_NTHSU "Maximale Turbinendrehzahl zum aktivieren der Hochschaltverh. von der Pulsadaption" CURVE 0x19A318 ZF_tab_ui16_S5_S3 8200 UMR_U_MIN_1_1_0_S5_S3 0 8200
 /begin AXIS_DESCR FIX_AXIS iAdaPulzs.kup_puls UMR___1_1_0_S5_S3 6 1 6 READ_ONLY FIX_AXIS_PAR_DIST 1 1 6 /end AXIS_DESCR
/end CHARACTERISTIC
/begin CHARACTERISTIC TAB_NT_ADPULSOB "Obere n_t-Schwelle fuer Befuellpruefung" CURVE 0x19A2D8 ZF_tab_si16_S5_S3 8200 UMR_U_MIN_1_1_0_S5_S3 0 8200
 /begin AXIS_DESCR FIX_AXIS iAdaPulzs.kup_puls UMR___1_1_0_S5_S3 6 1 6 READ_ONLY FIX_AXIS_PAR_DIST 1 1 6 /end AXIS_DESCR
/end CHARACTERISTIC
/begin CHARACTERISTIC TAB_NT_ADPULSUN "Untere n_t-Schwelle fuer Befuellpruefung" CURVE 0x19A2E8 ZF_tab_si16_S5_S3 8200 UMR_U_MIN_1_1_0_S5_S3 0 8200
 /begin AXIS_DESCR FIX_AXIS iAdaPulzs.kup_puls UMR___1_1_0_S5_S3 6 1 6 READ_ONLY FIX_AXIS_PAR_DIST 1 1 6 /end AXIS_DESCR
/end CHARACTERISTIC
/begin CHARACTERISTIC TAB_PRUEFTSF_KUPADA_URL "Anzahl Befüllprüfungen bis zur Deaktivierung der Sonderfunktion Urluftdetektion" CURVE 0x19A470 ZF_tab_ui8_S5_S3 100 UMR___1_1_0_S5_S3 0 100
 /begin AXIS_DESCR FIX_AXIS NO_INPUT_QUANTITY UMR___1_1_0_S5_S3 6 1 6 READ_ONLY FIX_AXIS_PAR_DIST 1 1 6 /end AXIS_DESCR
/end CHARACTERISTIC
/begin CHARACTERISTIC TAB_SEKKUPPULS_PF "Tabelle zu pulsende Kupplung Sekundaere-PF" CURVE 0x19A374 ZF_tab_ui8_S5_S3 6 UMR___1_1_0_S5_S3 0 6
 /begin AXIS_DESCR FIX_AXIS zff_atsys._.iSignale._.obj.sig_istgang UMR___1_1_0_S5_S3 10 -1 8 READ_ONLY FIX_AXIS_PAR_DIST -1 1 10 /end AXIS_DESCR
/end CHARACTERISTIC
/begin CHARACTERISTIC TAB_SEKKUPPULS_TSF "Tabelle zu pulsende Kupplung Sekundaere-TSF" CURVE 0x19A364 ZF_tab_ui8_S5_S3 6 UMR___1_1_0_S5_S3 0 6
 /begin AXIS_DESCR FIX_AXIS zff_atsys._.iSignale._.obj.sig_istgang UMR___1_1_0_S5_S3 10 -1 8 READ_ONLY FIX_AXIS_PAR_DIST -1 1 10 /end AXIS_DESCR
/end CHARACTERISTIC
/begin CHARACTERISTIC TAB_SWI_ADPULSEFAHREN "Aktivierung Pulsadaption in Abhängigkeit vom Betriebsmode 0=H/E Faheren,1=E Fahren,2=H Fahren" MAP 0x19A258 ZF_tab2d_ui8_S5_S3 2 UMR___1_1_0_S5_S3 0 2
 /begin AXIS_DESCR FIX_AXIS iAdaPulzs.kup_puls UMR___1_1_0_S5_S3 6 1 6 READ_ONLY FIX_AXIS_PAR_DIST 1 1 6 /end AXIS_DESCR
 /begin AXIS_DESCR FIX_AXIS zff_atsys._.iSignale._.obj.sig_istgang_vorw UMR___1_1_0_S5_S3 9 0 8 READ_ONLY FIX_AXIS_PAR_DIST 0 1 9 /end AXIS_DESCR
/end CHARACTERISTIC
/begin CHARACTERISTIC TAB_SWI_BEW_ABSCHALTKPAD "Switch um Abschalt-Bewertgskriterium f.jede Kupplung auszuwaehlen 0=aus, 1=ein" CURVE 0x19A34C ZF_tab_bool8_S5_S3 1 UMR___1_1_0_S5_S3 0 1
 /begin AXIS_DESCR FIX_AXIS iAdaPulzs.kup_puls UMR___1_1_0_S5_S3 6 1 6 READ_ONLY FIX_AXIS_PAR_DIST 1 1 6 /end AXIS_DESCR
/end CHARACTERISTIC
/begin CHARACTERISTIC TAB_SWI_NAGL "Switch f.Auswahl Eing.groesse Ausgleichsgerade 4=n_6, 3=n_mot, 2=Mittelwert, 1=n_t, 0=n_ab" CURVE 0x1970F4 ZF_tab_ui8_S5_S3 4 UMR___1_1_0_S5_S3 0 4
 /begin AXIS_DESCR FIX_AXIS zff_atsys._.iSignale._.obj.sig_istgang UMR___1_1_0_S5_S3 10 -1 8 READ_ONLY FIX_AXIS_PAR_DIST -1 1 10 /end AXIS_DESCR
/end CHARACTERISTIC
/begin CHARACTERISTIC TAB_SWI_PULSADTEMP "Switch zur Abschaltung der Pulsadaption wenn die Kup. länger inaktiv war" CURVE 0x19A24C ZF_tab_bool8_S5_S3 1 UMR___1_1_0_S5_S3 0 1
 /begin AXIS_DESCR FIX_AXIS iAdaPulzs.kup_puls UMR___1_1_0_S5_S3 6 1 6 READ_ONLY FIX_AXIS_PAR_DIST 1 1 6 /end AXIS_DESCR
/end CHARACTERISTIC
/begin CHARACTERISTIC TAB_SWI_STILLSTANDPULS "Schalter zur Aktivierung Grundbedingungen für Stillstandadaption" CURVE 0x19A240 ZF_tab_bool8_S5_S3 1 UMR___1_1_0_S5_S3 0 1
 /begin AXIS_DESCR FIX_AXIS iAdaPulzs.kup_puls UMR___1_1_0_S5_S3 6 1 6 READ_ONLY FIX_AXIS_PAR_DIST 1 1 6 /end AXIS_DESCR
/end CHARACTERISTIC
/begin CHARACTERISTIC TAB_SWI_URL "Tabelle zur Aktivierung der Sonderfunktion Urluftdetektion KUP A-E(F)(K0): 0=keine, 1=Puls, 2=Schaltung, 3=Puls und Schaltung" CURVE 0x19A464 ZF_tab_ui8_S5_S3 3 UMR___1_1_0_S5_S3 0 3
 /begin AXIS_DESCR FIX_AXIS NO_INPUT_QUANTITY UMR___1_1_0_S5_S3 6 1 6 READ_ONLY FIX_AXIS_PAR_DIST 1 1 6 /end AXIS_DESCR
/end CHARACTERISTIC
/begin CHARACTERISTIC TAB_TBEW_KUPADA_URL "Bewertungsfenster für Sonderfunktion Urluftdetektion" CURVE 0x19A47C ZF_tab_ui8_S5_S3 1500 UMR_MSEC__10_1_0_S5_S3 0 1500
 /begin AXIS_DESCR FIX_AXIS NO_INPUT_QUANTITY UMR___1_1_0_S5_S3 6 1 6 READ_ONLY FIX_AXIS_PAR_DIST 1 1 6 /end AXIS_DESCR
/end CHARACTERISTIC
/begin CHARACTERISTIC TAB_TBEW_SCHALTUNG_URL "Bewertungsfenster für Sonderfunktion Urluftdetektion" CURVE 0x19A498 ZF_tab_ui8_S5_S3 1500 UMR_MSEC__10_1_0_S5_S3 0 1500
 /begin AXIS_DESCR FIX_AXIS NO_INPUT_QUANTITY UMR___1_1_0_S5_S3 5 1 5 READ_ONLY FIX_AXIS_PAR_DIST 1 1 5 /end AXIS_DESCR
/end CHARACTERISTIC
/begin CHARACTERISTIC TO_SFNACHADA_B "Offset auf SF-Puls nach Adaption" VALUE 0x1D7733 ZF_kw_si8_S5_S3 2000 UMR_MSEC__10_1_0_S5_S3 -1000 1000 /end CHARACTERISTIC
/begin CHARACTERISTIC TO_SFNACHADA_C "Offset auf SF-Puls nach Adaption" VALUE 0x1D773A ZF_kw_si8_S5_S3 2000 UMR_MSEC__10_1_0_S5_S3 -1000 1000 /end CHARACTERISTIC
/begin CHARACTERISTIC TO_SFNACHADA_D "Offset auf SF-Puls nach Adaption" VALUE 0x1D7741 ZF_kw_si8_S5_S3 2000 UMR_MSEC__10_1_0_S5_S3 -1000 1000 /end CHARACTERISTIC
/begin CHARACTERISTIC TO_SFNACHADA_E "Offset auf SF-Puls nach Adaption" VALUE 0x1D7748 ZF_kw_si8_S5_S3 2000 UMR_MSEC__10_1_0_S5_S3 -1000 1000 /end CHARACTERISTIC
/begin CHARACTERISTIC TO_SFNACHADA_K0 "Offset auf SF-Puls nach Adaption" VALUE 0x1D774F ZF_kw_si8_S5_S3 2000 UMR_MSEC__10_1_0_S5_S3 -1000 1000 /end CHARACTERISTIC
/begin CHARACTERISTIC TO_SFRED_K0 "Offset zur TSF Reduktion während PF Prüfpuls" VALUE 0x1D82B8 ZF_kw_si16_S5_S3 2000 UMR_MSEC__1_1_0_S5_S3 -1000 1000 /end CHARACTERISTIC
/begin CHARACTERISTIC TO_SFVORADA_B "Offset auf SF-Puls bei 1.Puls" VALUE 0x1D828A ZF_kw_si16_S5_S3 2000 UMR_MSEC__1_1_0_S5_S3 -1000 1000 /end CHARACTERISTIC
/begin CHARACTERISTIC TO_SFVORADA_C "Offset auf SF-Puls bei 1.Puls" VALUE 0x1D828E ZF_kw_si16_S5_S3 2000 UMR_MSEC__1_1_0_S5_S3 -1000 1000 /end CHARACTERISTIC
/begin CHARACTERISTIC TO_SFVORADA_D "Offset auf SF-Puls bei 1.Puls" VALUE 0x1D8292 ZF_kw_si16_S5_S3 2000 UMR_MSEC__1_1_0_S5_S3 -1000 1000 /end CHARACTERISTIC
/begin CHARACTERISTIC TO_SFVORADA_E "Offset auf SF-Puls bei 1.Puls" VALUE 0x1D8296 ZF_kw_si16_S5_S3 2000 UMR_MSEC__1_1_0_S5_S3 -1000 1000 /end CHARACTERISTIC
/begin CHARACTERISTIC TO_SFVORADA_K0 "Offset auf SF-Puls bei 1.Puls" VALUE 0x1D829A ZF_kw_si16_S5_S3 2000 UMR_MSEC__1_1_0_S5_S3 -1000 1000 /end CHARACTERISTIC
/begin CHARACTERISTIC TS_SYNMESCHLUPF "Zeitschwelle für Geführten Getriebeschutz bei Schlupferkennung" VALUE 0x1D777B ZF_kw_ui8_S5_S3 500 UMR_MSEC__10_1_0_S5_S3 0 500 /end CHARACTERISTIC
/begin CHARACTERISTIC T_FDKIG "Filterzeit fuer Drosselklappengradient" VALUE 0x1D82F0 ZF_kw_ui16_S5_S3 999 UMR_MSEC__1_1_0_S5_S3 1 1000 /end CHARACTERISTIC
/begin CHARACTERISTIC T_FILTERNEIG1 "Filterzeit Phase 1" VALUE 0x1D807E ZF_kw_ui16_S5_S3 999 UMR_MSEC__1_1_0_S5_S3 1 1000 /end CHARACTERISTIC
/begin CHARACTERISTIC T_FILTERNEIG2 "Filterzeit Phase 2 und 3" VALUE 0x1D8080 ZF_kw_ui16_S5_S3 999 UMR_MSEC__1_1_0_S5_S3 1 1000 /end CHARACTERISTIC
/begin CHARACTERISTIC T_FNGAB "Filterzeit fuer Abtriebsdrehzahlgradient" VALUE 0x1D82CA ZF_kw_ui16_S5_S3 999 UMR_MSEC__1_1_0_S5_S3 1 1000 /end CHARACTERISTIC
/begin CHARACTERISTIC T_FNGMOT "Filterzeit fuer Gradientenfilter n_mot" VALUE 0x1D82C8 ZF_kw_ui16_S5_S3 999 UMR_MSEC__1_1_0_S5_S3 1 1000 /end CHARACTERISTIC
/begin CHARACTERISTIC T_FNGT "Filterzeit fuer Gradientenfilter n_t" VALUE 0x1D82C6 ZF_kw_ui16_S5_S3 999 UMR_MSEC__1_1_0_S5_S3 1 1000 /end CHARACTERISTIC
/begin CHARACTERISTIC T_FNUEG "Filterzeit fuer Gradientenberechnung nue" VALUE 0x1D82C4 ZF_kw_ui16_S5_S3 999 UMR_MSEC__1_1_0_S5_S3 1 1000 /end CHARACTERISTIC
/begin CHARACTERISTIC T_IEDSOFPSV "Zeit fuer Stromoffset auf Umschaltpunkt Parksperrenventil" VALUE 0x1D7774 ZF_kw_ui8_S5_S3 2540 UMR_MSEC__10_1_0_S5_S3 0 2540 /end CHARACTERISTIC
/begin CHARACTERISTIC T_MEMAXGL "maximale Motoreingriffszeit" VALUE 0x1D82D2 ZF_kw_ui16_S5_S3 60000 UMR_MSEC__10_1_0_S5_S3 0 60000 /end CHARACTERISTIC
/begin CHARACTERISTIC T_MESCHLUPFASMMOT "Rampenzeit in der die Momentenbegrenzung wegen Schlupf aufgehoben wird" VALUE 0x1D777A ZF_kw_ui8_S5_S3 2550 UMR_MSEC__10_1_0_S5_S3 0 2550 /end CHARACTERISTIC
/begin CHARACTERISTIC T_MESCHLUPFASMRED "Zeit während der die Momentenreduzierung bei Schupf aktiv bleibt" VALUE 0x1D82DE ZF_kw_ui16_S5_S3 650000 UMR_MSEC__10_1_0_S5_S3 0 650000 /end CHARACTERISTIC
/begin CHARACTERISTIC T_METOT "Motoreingriffsunterbrechungszeit" VALUE 0x1D7776 ZF_kw_ui8_S5_S3 2000 UMR_MSEC__10_1_0_S5_S3 0 2000 /end CHARACTERISTIC
/begin CHARACTERISTIC T_MMOTMAXAB "Rampenzeit fuer die Erniedrigung des max. zulaessigen Motormoments" VALUE 0x1D777D ZF_kw_ui8_S5_S3 2540 UMR_MSEC__10_1_0_S5_S3 0 2540 /end CHARACTERISTIC
/begin CHARACTERISTIC T_MMOTMAXAUF "Rampenzeit fuer die Erhoehung des max. zulaessigen Motormoments" VALUE 0x1D7778 ZF_kw_ui8_S5_S3 2540 UMR_MSEC__10_1_0_S5_S3 0 2540 /end CHARACTERISTIC
/begin CHARACTERISTIC T_MVERL_K0 "Zeit zur Auf-/Abschaltung von Momentverlusen von K0" VALUE 0x1D82F2 ZF_kw_ui16_S5_S3 2520 UMR_MSEC__30_1_0_S5_S3 0 2520 /end CHARACTERISTIC
/begin CHARACTERISTIC T_NEIG1 "Neigungssignal Zeitschwelle Uebergang Phase 1->2" VALUE 0x1D73DF ZF_kw_ui8_S5_S3 2500 UMR_MSEC__10_1_0_S5_S3 0 2500 /end CHARACTERISTIC
/begin CHARACTERISTIC T_NEIG2 "Neigungssignal Zeitschwelle Uebergang Phase 2->3" VALUE 0x1D73E0 ZF_kw_ui8_S5_S3 2500 UMR_MSEC__10_1_0_S5_S3 0 2500 /end CHARACTERISTIC
/begin CHARACTERISTIC T_POF1KPLBINN "Zeitdauer für Druckoffset für Kupplung B in Neutral nach Neustart" VALUE 0x1D7772 ZF_kw_ui8_S5_S3 2550 UMR_MSEC__10_1_0_S5_S3 0 2550 /end CHARACTERISTIC
/begin CHARACTERISTIC T_SFSTUFE_B "Zeitdauer Druckstufe nach SF-Puls" VALUE 0x1D7734 ZF_kw_ui8_S5_S3 2550 UMR_MSEC__10_1_0_S5_S3 0 2550 /end CHARACTERISTIC
/begin CHARACTERISTIC T_SFSTUFE_C "Zeitdauer Druckstufe nach SF-Puls" VALUE 0x1D773B ZF_kw_ui8_S5_S3 2550 UMR_MSEC__10_1_0_S5_S3 0 2550 /end CHARACTERISTIC
/begin CHARACTERISTIC T_SFSTUFE_D "Zeitdauer Druckstufe nach SF-Puls" VALUE 0x1D7742 ZF_kw_ui8_S5_S3 2550 UMR_MSEC__10_1_0_S5_S3 0 2550 /end CHARACTERISTIC
/begin CHARACTERISTIC T_SFSTUFE_E "Zeitdauer Druckstufe nach SF-Puls" VALUE 0x1D7749 ZF_kw_ui8_S5_S3 2550 UMR_MSEC__10_1_0_S5_S3 0 2550 /end CHARACTERISTIC
/begin CHARACTERISTIC T_SFSTUFE_K0 "Zeitdauer Druckstufe nach SF-Puls" VALUE 0x1D7750 ZF_kw_ui8_S5_S3 2550 UMR_MSEC__10_1_0_S5_S3 0 2550 /end CHARACTERISTIC
/begin CHARACTERISTIC T_SPNACHREAKTION "Sperrzeit fuer Befuellpruefung nach erkannter Reakt bei Puls 1" VALUE 0x1D82AC ZF_kw_ui16_S5_S3 65000 UMR_MSEC__10_1_0_S5_S3 0 65000 /end CHARACTERISTIC
/begin CHARACTERISTIC T_SPPULS "Maximale Restsperrzeit zum aktivieren der Hochschaltverh. von der Pulsadaption" VALUE 0x1D7759 ZF_kw_ui8_S5_S3 2550 UMR_MSEC__10_1_0_S5_S3 0 2550 /end CHARACTERISTIC
/begin CHARACTERISTIC T_SPTSFPULS "Sperrzeit nach letzter Schaltung oder Pruefung" VALUE 0x1D82AA ZF_kw_ui16_S5_S3 25000 UMR_MSEC__10_1_0_S5_S3 0 25000 /end CHARACTERISTIC
/begin CHARACTERISTIC T_UEAMPTSF_B "Zeitfenster f.Erkennung Amplitude" VALUE 0x1D7739 ZF_kw_ui8_S5_S3 2500 UMR_MSEC__10_1_0_S5_S3 0 2500 /end CHARACTERISTIC
/begin CHARACTERISTIC T_UEAMPTSF_C "Zeitfenster f.Erkennung Amplitude" VALUE 0x1D7740 ZF_kw_ui8_S5_S3 2500 UMR_MSEC__10_1_0_S5_S3 0 2500 /end CHARACTERISTIC
/begin CHARACTERISTIC T_UEAMPTSF_D "Zeitfenster f.Erkennung Amplitude" VALUE 0x1D7747 ZF_kw_ui8_S5_S3 2500 UMR_MSEC__10_1_0_S5_S3 0 2500 /end CHARACTERISTIC
/begin CHARACTERISTIC T_UEAMPTSF_E "Zeitfenster f.Erkennung Amplitude" VALUE 0x1D774E ZF_kw_ui8_S5_S3 2500 UMR_MSEC__10_1_0_S5_S3 0 2500 /end CHARACTERISTIC
/begin CHARACTERISTIC T_UEAMPTSF_K0 "Zeitfenster f.Erkennung Amplitude" VALUE 0x1D7755 ZF_kw_ui8_S5_S3 2500 UMR_MSEC__10_1_0_S5_S3 0 2500 /end CHARACTERISTIC
/begin CHARACTERISTIC T_UEBEWNEGBTSF_B "Start negatives Ueberwachungsfenster" VALUE 0x1D7735 ZF_kw_ui8_S5_S3 2500 UMR_MSEC__10_1_0_S5_S3 0 2500 /end CHARACTERISTIC
/begin CHARACTERISTIC T_UEBEWNEGBTSF_C "Start negatives Ueberwachungsfenster" VALUE 0x1D773C ZF_kw_ui8_S5_S3 2500 UMR_MSEC__10_1_0_S5_S3 0 2500 /end CHARACTERISTIC
/begin CHARACTERISTIC T_UEBEWNEGBTSF_D "Start negatives Ueberwachungsfenster" VALUE 0x1D7743 ZF_kw_ui8_S5_S3 2500 UMR_MSEC__10_1_0_S5_S3 0 2500 /end CHARACTERISTIC
/begin CHARACTERISTIC T_UEBEWNEGBTSF_E "Start negatives Ueberwachungsfenster" VALUE 0x1D774A ZF_kw_ui8_S5_S3 2500 UMR_MSEC__10_1_0_S5_S3 0 2500 /end CHARACTERISTIC
/begin CHARACTERISTIC T_UEBEWNEGBTSF_K0 "Start negatives Ueberwachungsfenster" VALUE 0x1D7751 ZF_kw_ui8_S5_S3 2500 UMR_MSEC__10_1_0_S5_S3 0 2500 /end CHARACTERISTIC
/begin CHARACTERISTIC T_UEBEWNEGETSF_B "Ende negatives Ueberwachungsfenster" VALUE 0x1D7736 ZF_kw_ui8_S5_S3 2500 UMR_MSEC__10_1_0_S5_S3 0 2500 /end CHARACTERISTIC
/begin CHARACTERISTIC T_UEBEWNEGETSF_C "Ende negatives Ueberwachungsfenster" VALUE 0x1D773D ZF_kw_ui8_S5_S3 2500 UMR_MSEC__10_1_0_S5_S3 0 2500 /end CHARACTERISTIC
/begin CHARACTERISTIC T_UEBEWNEGETSF_D "Ende negatives Ueberwachungsfenster" VALUE 0x1D7744 ZF_kw_ui8_S5_S3 2500 UMR_MSEC__10_1_0_S5_S3 0 2500 /end CHARACTERISTIC
/begin CHARACTERISTIC T_UEBEWNEGETSF_E "Ende negatives Ueberwachungsfenster" VALUE 0x1D774B ZF_kw_ui8_S5_S3 2500 UMR_MSEC__10_1_0_S5_S3 0 2500 /end CHARACTERISTIC
/begin CHARACTERISTIC T_UEBEWNEGETSF_K0 "Ende negatives Ueberwachungsfenster" VALUE 0x1D7752 ZF_kw_ui8_S5_S3 2500 UMR_MSEC__10_1_0_S5_S3 0 2500 /end CHARACTERISTIC
/begin CHARACTERISTIC T_UEBEWPOSBTSF_B "Start positives Ueberwachungsfenster" VALUE 0x1D7737 ZF_kw_ui8_S5_S3 2500 UMR_MSEC__10_1_0_S5_S3 0 2500 /end CHARACTERISTIC
/begin CHARACTERISTIC T_UEBEWPOSBTSF_C "Start positives Ueberwachungsfenster" VALUE 0x1D773E ZF_kw_ui8_S5_S3 2500 UMR_MSEC__10_1_0_S5_S3 0 2500 /end CHARACTERISTIC
/begin CHARACTERISTIC T_UEBEWPOSBTSF_D "Start positives Ueberwachungsfenster" VALUE 0x1D7745 ZF_kw_ui8_S5_S3 2500 UMR_MSEC__10_1_0_S5_S3 0 2500 /end CHARACTERISTIC
/begin CHARACTERISTIC T_UEBEWPOSBTSF_E "Start positives Ueberwachungsfenster" VALUE 0x1D774C ZF_kw_ui8_S5_S3 2500 UMR_MSEC__10_1_0_S5_S3 0 2500 /end CHARACTERISTIC
/begin CHARACTERISTIC T_UEBEWPOSBTSF_K0 "Start positives Ueberwachungsfenster" VALUE 0x1D7753 ZF_kw_ui8_S5_S3 2500 UMR_MSEC__10_1_0_S5_S3 0 2500 /end CHARACTERISTIC
/begin CHARACTERISTIC T_UEBEWPOSETSF_B "Ende positives Ueberwachungsfenster" VALUE 0x1D7738 ZF_kw_ui8_S5_S3 2500 UMR_MSEC__10_1_0_S5_S3 0 2500 /end CHARACTERISTIC
/begin CHARACTERISTIC T_UEBEWPOSETSF_C "Ende positives Ueberwachungsfenster" VALUE 0x1D773F ZF_kw_ui8_S5_S3 2500 UMR_MSEC__10_1_0_S5_S3 0 2500 /end CHARACTERISTIC
/begin CHARACTERISTIC T_UEBEWPOSETSF_D "Ende positives Ueberwachungsfenster" VALUE 0x1D7746 ZF_kw_ui8_S5_S3 2500 UMR_MSEC__10_1_0_S5_S3 0 2500 /end CHARACTERISTIC
/begin CHARACTERISTIC T_UEBEWPOSETSF_E "Ende positives Ueberwachungsfenster" VALUE 0x1D774D ZF_kw_ui8_S5_S3 2500 UMR_MSEC__10_1_0_S5_S3 0 2500 /end CHARACTERISTIC
/begin CHARACTERISTIC T_UEBEWPOSETSF_K0 "Ende positives Ueberwachungsfenster" VALUE 0x1D7754 ZF_kw_ui8_S5_S3 2500 UMR_MSEC__10_1_0_S5_S3 0 2500 /end CHARACTERISTIC
/begin CHARACTERISTIC T_VCKKEINTIPP "Verzögerungszeit für manuelle Schaltung für Kupplungschutz." VALUE 0x1D776D ZF_kw_ui8_S5_S3 2540 UMR_MSEC__10_1_0_S5_S3 0 2540 /end CHARACTERISTIC
/begin CHARACTERISTIC T_VCKSCHALTVERH "Verzögerungszeit für Schaltungen für Kupplungschutz." VALUE 0x1D776C ZF_kw_ui8_S5_S3 2540 UMR_MSEC__10_1_0_S5_S3 0 2540 /end CHARACTERISTIC
/begin CHARACTERISTIC T_VGEINIT "Verzoegerung Gangeinlegen nach Initialisierung(Motorstart)" VALUE 0x1D7773 ZF_kw_ui8_S5_S3 2360 UMR_MSEC__10_1_0_S5_S3 180 2540 /end CHARACTERISTIC
/begin CHARACTERISTIC T_VHSUABBRUCH "Verzugszeit für das Beenden der Hochschaltverh. von der Pulsadaption" VALUE 0x1D82A8 ZF_kw_ui16_S5_S3 10000 UMR_MSEC__10_1_0_S5_S3 0 10000 /end CHARACTERISTIC
/begin CHARACTERISTIC T_VPSYSPULS "Wartezeit für Systemdruckanhebung vor Puls" VALUE 0x1D775C ZF_kw_ui8_S5_S3 1000 UMR_MSEC__10_1_0_S5_S3 0 1000 /end CHARACTERISTIC
/begin CHARACTERISTIC T_VSTALL "Verzögerungszeit für den Einstieg in die Fkt. zur Vermeidung von Bauteilschäden im Antriebsstrang" VALUE 0x1D777E ZF_kw_ui8_S5_S3 2540 UMR_MSEC__10_1_0_S5_S3 0 2540 /end CHARACTERISTIC
/begin CHARACTERISTIC ZS_HYS "Hysterese Zug/Schub fuer alle Z/S Kennlinien gueltig" VALUE 0x1D8070 ZF_kw_si16_S5_S3 1500 UMR_NM__1_1_0_S5_S3 -200 1300 /end CHARACTERISTIC
/begin CHARACTERISTIC s_mmm "Application parameter for the maximal allowed jitter of the torque signal mmm. This parameter defines the offset in min and max direction as well" VALUE 0x191ADE ZF_KW_NAT16_S2_S3 65535 SAB_M_1NM_S2_S3 0 65535 /end CHARACTERISTIC
/begin CHARACTERISTIC xha_Wert_Nummax "Application parameter for max number of calculated RearAxleRatio values paramters will also be used by SABeeprom class" VALUE 0x191C41 ZF_KW_NAT8_S2_S3 30 SAB_STANDARD_S2_S3 0 30 /end CHARACTERISTIC
/begin FUNCTION jAdaPulsfKB_Fktn "Applikationesgroessen Instanz jAdaPulsfKB"
 /begin DEF_CHARACTERISTIC PO_SFSTUFE_B TO_SFNACHADA_B TO_SFVORADA_B T_SFSTUFE_B T_UEAMPTSF_B T_UEBEWNEGBTSF_B T_UEBEWNEGETSF_B T_UEBEWPOSBTSF_B T_UEBEWPOSETSF_B /end DEF_CHARACTERISTIC
/end FUNCTION
/begin FUNCTION jAdaPulsfKC_Fktn "Applikationesgroessen Instanz jAdaPulsfKC"
 /begin DEF_CHARACTERISTIC PO_SFSTUFE_C TO_SFNACHADA_C TO_SFVORADA_C T_SFSTUFE_C T_UEAMPTSF_C T_UEBEWNEGBTSF_C T_UEBEWNEGETSF_C T_UEBEWPOSBTSF_C T_UEBEWPOSETSF_C /end DEF_CHARACTERISTIC
/end FUNCTION
/begin FUNCTION jAdaPulsfKD_Fktn "Applikationesgroessen Instanz jAdaPulsfKD"
 /begin DEF_CHARACTERISTIC PO_SFSTUFE_D TO_SFNACHADA_D TO_SFVORADA_D T_SFSTUFE_D T_UEAMPTSF_D T_UEBEWNEGBTSF_D T_UEBEWNEGETSF_D T_UEBEWPOSBTSF_D T_UEBEWPOSETSF_D /end DEF_CHARACTERISTIC
/end FUNCTION
/begin FUNCTION jAdaPulsfKE_Fktn "Applikationesgroessen Instanz jAdaPulsfKE"
 /begin DEF_CHARACTERISTIC PO_SFSTUFE_E TO_SFNACHADA_E TO_SFVORADA_E T_SFSTUFE_E T_UEAMPTSF_E T_UEBEWNEGBTSF_E T_UEBEWNEGETSF_E T_UEBEWPOSBTSF_E T_UEBEWPOSETSF_E /end DEF_CHARACTERISTIC
/end FUNCTION
/begin FUNCTION jAdaPulsfKK0_Fktn "Applikationesgroessen Instanz jAdaPulsfKK0"
 /begin DEF_CHARACTERISTIC PO_SFSTUFE_K0 TO_SFNACHADA_K0 TO_SFVORADA_K0 T_SFSTUFE_K0 T_UEAMPTSF_K0 T_UEBEWNEGBTSF_K0 T_UEBEWNEGETSF_K0 T_UEBEWPOSBTSF_K0 T_UEBEWPOSETSF_K0 /end DEF_CHARACTERISTIC
/end FUNCTION
/begin FUNCTION jAdaPulzs_Fktn "Applikationesgroessen Instanz jAdaPulzs"
 /begin DEF_CHARACTERISTIC CS_ADPULSHYS DKI_ADPULS FI_ADANEU KL_FIADAAKT_NPRUEFZYKL_NEG KL_FIADAAKT_NPRUEFZYKL_POS KL_NPRUEFZYKL_KBP MAX_BEW_ABSCHALTKPAD MIN_BEW_ABSCHALTKPAD MT_ADPULS NS_ABPULS NS_EMSOLLEERPULS NS_HYS_EMSOLLEERPULS NS_VMPULS N_PULSGRENZ N_PULSGRENZSTART POS_BEW_ABSCHALTKPAD SWI_POSPULS T1_BEW_ABSCHALTKPAD T2_BEW_ABSCHALTKPAD TAB_CS_ADPULSOB TAB_KUPPULS1 TAB_KUPPULS2 TAB_MT_ADPULSOB TAB_MT_ADPULSUN TAB_ND_ADABBR TAB_NMOT_ADPULSOB TAB_NMOT_ADPULSUN TAB_NSTARTWERTE_KPAD TAB_NTHSU TAB_NT_ADPULSOB TAB_NT_ADPULSUN TAB_SEKKUPPULS_PF TAB_SEKKUPPULS_TSF TAB_SWI_ADPULSEFAHREN TAB_SWI_BEW_ABSCHALTKPAD TAB_SWI_PULSADTEMP TAB_SWI_STILLSTANDPULS TO_SFRED_K0 T_SPNACHREAKTION T_SPPULS T_SPTSFPULS T_VHSUABBRUCH T_VPSYSPULS /end DEF_CHARACTERISTIC
/end FUNCTION
/begin FUNCTION jAdaPulzsKA_Fktn "Applikationesgroessen Instanz jAdaPulzsKA" /begin DEF_CHARACTERISTIC KL_CS_PFADPULSUN_A KL_CS_TSFADPULSUN_A /end DEF_CHARACTERISTIC /end FUNCTION
/begin FUNCTION jAdaPulzsKB_Fktn "Applikationesgroessen Instanz jAdaPulzsKB" /begin DEF_CHARACTERISTIC KL_CS_PFADPULSUN_B KL_CS_TSFADPULSUN_B /end DEF_CHARACTERISTIC /end FUNCTION
/begin FUNCTION jAdaPulzsKC_Fktn "Applikationesgroessen Instanz jAdaPulzsKC" /begin DEF_CHARACTERISTIC KL_CS_PFADPULSUN_C KL_CS_TSFADPULSUN_C /end DEF_CHARACTERISTIC /end FUNCTION
/begin FUNCTION jAdaPulzsKD_Fktn "Applikationesgroessen Instanz jAdaPulzsKD" /begin DEF_CHARACTERISTIC KL_CS_PFADPULSUN_D KL_CS_TSFADPULSUN_D /end DEF_CHARACTERISTIC /end FUNCTION
/begin FUNCTION jAdaPulzsKE_Fktn "Applikationesgroessen Instanz jAdaPulzsKE" /begin DEF_CHARACTERISTIC KL_CS_PFADPULSUN_E KL_CS_TSFADPULSUN_E /end DEF_CHARACTERISTIC /end FUNCTION
/begin FUNCTION jAdaPulzsKK0_Fktn "Applikationesgroessen Instanz jAdaPulzsKK0" /begin DEF_CHARACTERISTIC KL_CS_PFADPULSUN_K0 KL_CS_TSFADPULSUN_K0 /end DEF_CHARACTERISTIC /end FUNCTION
/begin FUNCTION jAdaUrlufterk_Fktn "Applikationesgroessen Instanz jAdaUrlufterk" /begin DEF_CHARACTERISTIC TAB_SWI_URL /end DEF_CHARACTERISTIC /end FUNCTION
/begin FUNCTION jAdaUrlufterkPuls_Fktn "Applikationesgroessen Instanz jAdaUrlufterkPuls"
 /begin DEF_CHARACTERISTIC TAB_NGUETE_KUPADA_URL TAB_PRUEFTSF_KUPADA_URL TAB_TBEW_KUPADA_URL /end DEF_CHARACTERISTIC
/end FUNCTION
/begin FUNCTION jAdaUrlufterkSchaltung_Fktn "Applikationesgroessen Instanz jAdaUrlufterkSchaltung"
 /begin DEF_CHARACTERISTIC CS_SCHALTUNG_URL MPT_URL MS_MOTIST_URL PS_SCHALTUNG_URL SWI_NTNAB_URL TAB_NG_SCHALTUNG_URL TAB_TBEW_SCHALTUNG_URL /end DEF_CHARACTERISTIC
/end FUNCTION
/begin FUNCTION jAzsGangb_Fktn "Applikationesgroessen Instanz jAzsGangb"
 /begin DEF_CHARACTERISTIC KL_TVCG_GE_STADA TAB_CSGVBMRS TAB_MSTVB TAB_NSABRSV TAB_NSABVB TAB_NSMOTRSV TAB_NSTRSV /end DEF_CHARACTERISTIC
/end FUNCTION
/begin FUNCTION jAzsManko_Fktn "Applikationesgroessen Instanz jAzsManko"
 /begin DEF_CHARACTERISTIC CS_KUPPLMAXSPSAS CS_KUPPL_1 CS_KUPPL_2 CS_KUPPL_3 HYS_CKUPPLMASS HYS_CKUPPLMAXSPSAS SWI_CKMAX_SPSAS SWI_CK_KEINTIPP SWI_CK_MMOTMAX SWI_CK_SCHALTBEEIN SWI_CK_SCHALTVERH SWI_CK_SPSAS SWI_MASS_CKMAX SWI_SPSAS_DEF T_VCKKEINTIPP T_VCKSCHALTVERH /end DEF_CHARACTERISTIC
/end FUNCTION
/begin FUNCTION jBibAglex_Fktn "Applikationesgroessen Instanz jBibAglex" /begin DEF_CHARACTERISTIC FI_NADAALT FI_NADANEU I_AGEX I_AGLAENGE TAB_SWI_NAGL /end DEF_CHARACTERISTIC /end FUNCTION
/begin FUNCTION jBihDrehz_Fktn "Applikationesgroessen Instanz jBihDrehz"
 /begin DEF_CHARACTERISTIC FI_NABALT FI_NABNEU FI_NTALT FI_NTNEU T_FNGAB T_FNGMOT T_FNGT T_FNUEG /end DEF_CHARACTERISTIC
/end FUNCTION
/begin FUNCTION jBihHydra_Fktn "Applikationesgroessen Instanz jBihHydra"
 /begin DEF_CHARACTERISTIC I_MAX I_MIN KF_POFNABCGKPLBINN KL_IEDSOFPSV P_OF1KPLBINN T_IEDSOFPSV T_POF1KPLBINN T_VGEINIT /end DEF_CHARACTERISTIC
/end FUNCTION
/begin FUNCTION jBihMobef_Fktn "Applikationesgroessen Instanz jBihMobef"
 /begin DEF_CHARACTERISTIC DKIS_STALL KF_MESCHLUPFAS KF_MGETRMAXCK KL_KMMOTMAXCM KL_RGANGLIMIT M_ERSMOTMAXGE M_GETRMAXSTALL M_MOTMAXINC M_MOTORMAX M_MOTSCHLUPF ND_SYNMESCHLUPF NS_ABMEDA NS_ABSCHLUPF NS_MOTSTALL NS_TSTALL SICH_MMOTMAX SWI_CONSIDER_EPB SWI_MEUW TAB_MGETRMAX TAB_MGETRMAXSHIFT TS_SYNMESCHLUPF T_MEMAXGL T_MESCHLUPFASMMOT T_MESCHLUPFASMRED T_METOT T_MMOTMAXAB T_MMOTMAXAUF T_VSTALL /end DEF_CHARACTERISTIC
/end FUNCTION
/begin FUNCTION jBihMobefG1_Fktn "Applikationesgroessen Instanz jBihMobefG1" /begin DEF_CHARACTERISTIC KF_MMOTMAXGE_1 /end DEF_CHARACTERISTIC /end FUNCTION
/begin FUNCTION jBihMobefG2_Fktn "Applikationesgroessen Instanz jBihMobefG2" /begin DEF_CHARACTERISTIC KF_MMOTMAXGE_2 /end DEF_CHARACTERISTIC /end FUNCTION
/begin FUNCTION jBihMobefG3_Fktn "Applikationesgroessen Instanz jBihMobefG3" /begin DEF_CHARACTERISTIC KF_MMOTMAXGE_3 /end DEF_CHARACTERISTIC /end FUNCTION
/begin FUNCTION jBihMobefG4_Fktn "Applikationesgroessen Instanz jBihMobefG4" /begin DEF_CHARACTERISTIC KF_MMOTMAXGE_4 /end DEF_CHARACTERISTIC /end FUNCTION
/begin FUNCTION jBihMobefG5_Fktn "Applikationesgroessen Instanz jBihMobefG5" /begin DEF_CHARACTERISTIC KF_MMOTMAXGE_5 /end DEF_CHARACTERISTIC /end FUNCTION
/begin FUNCTION jBihMobefG6_Fktn "Applikationesgroessen Instanz jBihMobefG6" /begin DEF_CHARACTERISTIC KF_MMOTMAXGE_6 /end DEF_CHARACTERISTIC /end FUNCTION
/begin FUNCTION jBihMobefG7_Fktn "Applikationesgroessen Instanz jBihMobefG7" /begin DEF_CHARACTERISTIC KF_MMOTMAXGE_7 /end DEF_CHARACTERISTIC /end FUNCTION
/begin FUNCTION jBihMobefG8_Fktn "Applikationesgroessen Instanz jBihMobefG8" /begin DEF_CHARACTERISTIC KF_MMOTMAXGE_8 /end DEF_CHARACTERISTIC /end FUNCTION
/begin FUNCTION jBihMobefGR_Fktn "Applikationesgroessen Instanz jBihMobefGR" /begin DEF_CHARACTERISTIC KF_MMOTMAXGE_R /end DEF_CHARACTERISTIC /end FUNCTION
/begin FUNCTION jBihMomen_Fktn "Applikationesgroessen Instanz jBihMomen"
 /begin DEF_CHARACTERISTIC J_MOT J_MOT_EL KF_MPUAUF KF_MVERLMTNTCGT100_K0 KF_MVERLMTNTCGT40_K0 KF_MVERLMTNTCGT60_K0 KL_FGMMOTMDMOTPSYS KL_FMMOTCM KL_KCGMPUAUF MPT_MPUAUF MS_GETRVERL M_ABDYNERR SWI_NMOTMPUAUF TAB_JGETR T_FDKIG T_MVERL_K0 /end DEF_CHARACTERISTIC
/end FUNCTION
/begin FUNCTION jBihMomenG1_Fktn "Applikationesgroessen Instanz jBihMomenG1"
 /begin DEF_CHARACTERISTIC KF_MVERLMTNTCGT100_1 KF_MVERLMTNTCGT40_1 KF_MVERLMTNTCGT60_1 KL_FGMMOTMDMOT_1 /end DEF_CHARACTERISTIC
/end FUNCTION
/begin FUNCTION jBihMomenG2_Fktn "Applikationesgroessen Instanz jBihMomenG2"
 /begin DEF_CHARACTERISTIC KF_MVERLMTNTCGT100_2 KF_MVERLMTNTCGT40_2 KF_MVERLMTNTCGT60_2 KL_FGMMOTMDMOT_2 /end DEF_CHARACTERISTIC
/end FUNCTION
/begin FUNCTION jBihMomenG3_Fktn "Applikationesgroessen Instanz jBihMomenG3"
 /begin DEF_CHARACTERISTIC KF_MVERLMTNTCGT100_3 KF_MVERLMTNTCGT40_3 KF_MVERLMTNTCGT60_3 KL_FGMMOTMDMOT_3 /end DEF_CHARACTERISTIC
/end FUNCTION
/begin FUNCTION jBihMomenG4_Fktn "Applikationesgroessen Instanz jBihMomenG4"
 /begin DEF_CHARACTERISTIC KF_MVERLMTNTCGT100_4 KF_MVERLMTNTCGT40_4 KF_MVERLMTNTCGT60_4 KL_FGMMOTMDMOT_4 /end DEF_CHARACTERISTIC
/end FUNCTION
/begin FUNCTION jBihMomenG5_Fktn "Applikationesgroessen Instanz jBihMomenG5"
 /begin DEF_CHARACTERISTIC KF_MVERLMTNTCGT100_5 KF_MVERLMTNTCGT40_5 KF_MVERLMTNTCGT60_5 KL_FGMMOTMDMOT_5 /end DEF_CHARACTERISTIC
/end FUNCTION
/begin FUNCTION jBihMomenG6_Fktn "Applikationesgroessen Instanz jBihMomenG6"
 /begin DEF_CHARACTERISTIC KF_MVERLMTNTCGT100_6 KF_MVERLMTNTCGT40_6 KF_MVERLMTNTCGT60_6 KL_FGMMOTMDMOT_6 /end DEF_CHARACTERISTIC
/end FUNCTION
/begin FUNCTION jBihMomenG7_Fktn "Applikationesgroessen Instanz jBihMomenG7"
 /begin DEF_CHARACTERISTIC KF_MVERLMTNTCGT100_7 KF_MVERLMTNTCGT40_7 KF_MVERLMTNTCGT60_7 KL_FGMMOTMDMOT_7 /end DEF_CHARACTERISTIC
/end FUNCTION
/begin FUNCTION jBihMomenG8_Fktn "Applikationesgroessen Instanz jBihMomenG8"
 /begin DEF_CHARACTERISTIC KF_MVERLMTNTCGT100_8 KF_MVERLMTNTCGT40_8 KF_MVERLMTNTCGT60_8 KL_FGMMOTMDMOT_8 /end DEF_CHARACTERISTIC
/end FUNCTION
/begin FUNCTION jBihMomenGR_Fktn "Applikationesgroessen Instanz jBihMomenGR"
 /begin DEF_CHARACTERISTIC KF_MVERLMTNTCGT100_R KF_MVERLMTNTCGT40_R KF_MVERLMTNTCGT60_R KL_FGMMOTMDMOT_R /end DEF_CHARACTERISTIC
/end FUNCTION
/begin FUNCTION jBihSigna_Fktn "Applikationesgroessen Instanz jBihSigna"
 /begin DEF_CHARACTERISTIC CCH_HMHYS CCH_HMME CCH_HOTMODE CCH_KUEHL1MAX CCH_KUEHL2MAX CGT_HMHYS CGT_HMME CGT_HOTMODE CGT_KUEHL1MAX CGT_KUEHL2MAX CIAE_HMHYS CIAE_KUEHL1MAX CIAE_KUEHL2MAX HYS_NSMOTPUMPE KL_ZS KL_ZS21 KL_ZSHS KL_ZSMRS KL_ZSOCMOT KL_ZSOCMOTMRS KL_ZSRS M_HOTMODEMAXDEC M_HOTMODEMAXINC NEIGUNG_HYS_PAUS NEIGUNG_PAUS NEIG_ERSATZ NEIG_INI NEIG_MAX NEIG_MIN NS_MOTIMIN NS_MOTPUMPE NS_NEIGFILTER1 NS_NEIGFILTER2 NS_TPUMPE PS_BREMS PS_BREMSHYS SWI_FSTBREMSE SWI_PBR SWI_PREADAPTION_START_STADA SWI_UMSCHALTDKI T_FILTERNEIG1 T_FILTERNEIG2 T_NEIG1 T_NEIG2 ZS_HYS /end DEF_CHARACTERISTIC
/end FUNCTION
/begin FUNCTION jBihSignaG1_Fktn "Applikationesgroessen Instanz jBihSignaG1" /begin DEF_CHARACTERISTIC KL_MHOTMODEMAX_1 /end DEF_CHARACTERISTIC /end FUNCTION
/begin FUNCTION jBihSignaG2_Fktn "Applikationesgroessen Instanz jBihSignaG2" /begin DEF_CHARACTERISTIC KL_MHOTMODEMAX_2 /end DEF_CHARACTERISTIC /end FUNCTION
/begin FUNCTION jBihSignaG3_Fktn "Applikationesgroessen Instanz jBihSignaG3" /begin DEF_CHARACTERISTIC KL_MHOTMODEMAX_3 /end DEF_CHARACTERISTIC /end FUNCTION
/begin FUNCTION jBihSignaG4_Fktn "Applikationesgroessen Instanz jBihSignaG4" /begin DEF_CHARACTERISTIC KL_MHOTMODEMAX_4 /end DEF_CHARACTERISTIC /end FUNCTION
/begin FUNCTION jBihSignaG5_Fktn "Applikationesgroessen Instanz jBihSignaG5" /begin DEF_CHARACTERISTIC KL_MHOTMODEMAX_5 /end DEF_CHARACTERISTIC /end FUNCTION
/begin FUNCTION jBihSignaG6_Fktn "Applikationesgroessen Instanz jBihSignaG6" /begin DEF_CHARACTERISTIC KL_MHOTMODEMAX_6 /end DEF_CHARACTERISTIC /end FUNCTION
/begin FUNCTION jBihSignaG7_Fktn "Applikationesgroessen Instanz jBihSignaG7" /begin DEF_CHARACTERISTIC KL_MHOTMODEMAX_7 /end DEF_CHARACTERISTIC /end FUNCTION
/begin FUNCTION jBihSignaG8_Fktn "Applikationesgroessen Instanz jBihSignaG8" /begin DEF_CHARACTERISTIC KL_MHOTMODEMAX_8 /end DEF_CHARACTERISTIC /end FUNCTION
/begin FUNCTION jBihSignaGR_Fktn "Applikationesgroessen Instanz jBihSignaGR" /begin DEF_CHARACTERISTIC KL_MHOTMODEMAX_R /end DEF_CHARACTERISTIC /end FUNCTION
/begin FUNCTION jData_zf_SAB2_EngineInterventionMonitoringOut_Fktn "Calibration values of the Instance jData_zf_SAB2_EngineInterventionMonitoringOut"
 /begin DEF_CHARACTERISTIC D_EI_PosRealizedLThPErrMem D_EI_PosRealizedLThSErrMem D_EI_PosRealizedUThPErrMem D_EI_PosRealizedUThSErrMem D_EI_RedRealizedLThPErrMem D_EI_RedRealizedLThSErrMem D_EI_RedRealizedUThPErrMem D_EI_RedRealizedUThSErrMem D_c_OilTrans_EIMon D_mIntegral_EIMonTh D_m_EIMonTh D_n_Eng_EIMon D_t_EIMonActivDelay D_t_EIMonDelay D_t_EI_IntegrationMin SWI_EIMon_PErrMem SWI_EIMon_SErrMem /end DEF_CHARACTERISTIC
/end FUNCTION
/begin FUNCTION jData_zf_SAB2_EngineInterventionOut_Fktn "Calibration values of the Instance jData_zf_SAB2_EngineInterventionOut"
 /begin DEF_CHARACTERISTIC D_EngInterventionNegTol D_EngInterventionTol D_EngIntervention_LM_EZA D_m_EngInterventionLth D_m_EngMaxError D_m_EngMaxLTh D_m_GearboxGuardActiveHys D_me_Luft_Reserve D_n_EngLth_SABLev2 SWI_FaultSourceLEV2 SWI_ME_Anforderung_alt_neu SWI_ME_Anforderung_alt_neu_2 /end DEF_CHARACTERISTIC
/end FUNCTION
/begin FUNCTION jData_zf_SAB2_ErrorEntryOut_Fktn "Calibration values of the Instance jData_zf_SAB2_ErrorEntryOut"
 /begin DEF_CHARACTERISTIC D_KMN_DiagnosticFunctCAN1 D_KMN_DiagnosticFunctCAN2 D_KMN_DiagnosticFunctCAN5 D_KMN_DiagnosticFunctCAN8 D_KMN_DiagnosticFunctCANHi1 D_KMN_DiagnosticFunctCANHi2 D_KMN_DiagnosticFunctCANHi5 D_KMN_DiagnosticFunctCANHi8 D_TX_ValueForLimphome D_t_ForwardFilter_LIMPHOMECAN D_v_Fzg_LIMPHOMECAN SWI_ValuesToDetectLimphome /end DEF_CHARACTERISTIC
/end FUNCTION
/begin FUNCTION jData_zf_SAB2_GearboxReinforcementOut_Fktn "Calibration values of the Instance jData_zf_SAB2_GearboxReinforcementOut"
 /begin DEF_CHARACTERISTIC D_GbxReinforcementMax D_GbxReinforcementMin D_GearboxReinforcementDef D_GearboxReinforcementDefSts D_GearboxReinforcementErr D_GearboxReinforcementFactor D_n_Ab_CalcMethodLth D_n_Ab_CalcMethodUth SWI_GearboxReinforcementCalculation SWI_GearboxReinforcement_Err /end DEF_CHARACTERISTIC
/end FUNCTION
/begin FUNCTION jData_zf_SAB2_GearboxTorqueOut_Fktn "Calibration values of the Instance jData_zf_SAB2_GearboxTorqueOut" /begin DEF_CHARACTERISTIC D_t_freeze_mgt_Aufn_CAN /end DEF_CHARACTERISTIC /end FUNCTION
/begin FUNCTION jData_zf_SAB2_HybridSignalsOut_Fktn "Calibration values of the Instance jData_zf_SAB2_HybridSignalsOut" /begin DEF_CHARACTERISTIC D_Status_K0_Array D_k_m_MaxK0NewCan D_k_m_MaxK0OldCan /end DEF_CHARACTERISTIC /end FUNCTION
/begin FUNCTION jData_zf_SAB2_PumpIntakeTorqueOut_Fktn "Calibration values of the Instance jData_zf_SAB2_PumpIntakeTorqueOut" /begin DEF_CHARACTERISTIC SWI_PuCalc /end DEF_CHARACTERISTIC /end FUNCTION
/begin FUNCTION jData_zf_SAB2_ShiftingActiveOut_Fktn "Calibration values of the Instance jData_zf_SAB2_ShiftingActiveOut" /begin DEF_CHARACTERISTIC SWI_ChangeOfGear /end DEF_CHARACTERISTIC /end FUNCTION
/begin FUNCTION jData_zf_SAB2_TorqueConverterOut_Fktn "Calibration values of the Instance jData_zf_SAB2_TorqueConverterOut" /begin DEF_CHARACTERISTIC D_KplHyb D_KplHybShifting D_PreadaptionState /end DEF_CHARACTERISTIC /end FUNCTION
/begin FUNCTION jData_zf_SAB_ActuatorSignalsIn_Fktn "Calibration values of the Instance jData_zf_SAB_ActuatorSignalsIn"
 /begin DEF_CHARACTERISTIC D_DcEPumpTh1 D_DcEPumpTh2 D_DcEPumpTh3 D_t_EPumpTh1 D_t_EPumpTh2 D_t_EPumpTh3 D_u_BattLth_IEP D_u_BattUth_IEP SWI_EpumpConsiderAliveSignal SWI_EpumpConsiderAliveSignalDP SWI_SetOut2_DitherActive SWI_SetOut5_DitherActive /end DEF_CHARACTERISTIC
/end FUNCTION
/begin FUNCTION jData_zf_SAB_AzgDriver_Fktn "Calibration values of the Instance jData_zf_SAB_AzgDriver"
 /begin DEF_CHARACTERISTIC D_Tab_Azgkng SWI_Zf_Application_Can SWI_Zf_Edicmobil_Can SWI_morethan255KFCs /end DEF_CHARACTERISTIC
/end FUNCTION
/begin FUNCTION jData_zf_SAB_BackToNormalFunctionViaReset_Fktn "Calibration values of the Instance jData_zf_SAB_BackToNormalFunctionViaReset"
 /begin DEF_CHARACTERISTIC D_RzNinCruise_KMN_Hi D_RzNinCruise_KMN_Lo D_TabRzNinCruiseCnt_KFC D_TabRzNinCruise_KFC D_cnt_LimphomeRst D_n_AbRzNinCruise D_t_delay_Limphome D_t_delay_LimphomeCnt /end DEF_CHARACTERISTIC
/end FUNCTION
/begin FUNCTION jData_zf_SAB_BootJump_Fktn "Calibration values of the Instance jData_zf_SAB_BootJump" /begin DEF_CHARACTERISTIC D_t_IEP_ShutdownDelay /end DEF_CHARACTERISTIC /end FUNCTION
/begin FUNCTION jData_zf_SAB_BrakePedalIn_Fktn "Calibration values of the Instance jData_zf_SAB_BrakePedalIn" /begin DEF_CHARACTERISTIC D_p_BrakeTh D_u_BattLth_BRAKEx SWI_Brakelight_BRAKEx /end DEF_CHARACTERISTIC /end FUNCTION
/begin FUNCTION jData_zf_SAB_BrakeTorqueIn_Fktn "Calibration values of the Instance jData_zf_SAB_BrakeTorqueIn" /begin DEF_CHARACTERISTIC D_k_MtoP SWI_BrakeDiag_BRAKEx /end DEF_CHARACTERISTIC /end FUNCTION
/begin FUNCTION jData_zf_SAB_CAN_Handling_Fktn "Calibration values of the Instance jData_zf_SAB_CAN_Handling"
 /begin DEF_CHARACTERISTIC D_CAN1BusBitmask D_CAN2BusBitmask D_CAN_GROUP_FC D_t_CAN1BusDiagDelay D_t_CAN2BusDiagDelay D_t_CANDiagDelay D_u_CanDiagHTh D_u_CanDiagLTh D_u_Diag SWI_CANControlMonitoring SWI_CANDiagDelay SWI_CANLearnID SWI_Calc_CanMsgErrorBitmask_cyclic SWI_ClearLearnedMsgStatus /end DEF_CHARACTERISTIC
/end FUNCTION
/begin FUNCTION jData_zf_SAB_CAN_SwitchingIn_Fktn "Calibration values of the Instance jData_zf_SAB_CAN_SwitchingIn" /begin DEF_CHARACTERISTIC D_tmr_CAN_Hys SWI_ACAN_FACAN /end DEF_CHARACTERISTIC /end FUNCTION
/begin FUNCTION jData_zf_SAB_Coding_Fktn "Calibration values of the Instance jData_zf_SAB_Coding"
 /begin DEF_CHARACTERISTIC D_BitmaskNIC D_CodingApp D_CodingElectrical D_CodingVehOrCodingApp D_CodingVehOrCodingElectrical SWI_SwapHighLowByte_Inputs /end DEF_CHARACTERISTIC
/end FUNCTION
/begin FUNCTION jData_zf_SAB_ComConditionsIn_Fktn "Calibration values of the Instance jData_zf_SAB_ComConditionsIn"
 /begin DEF_CHARACTERISTIC D_n_Ab_PreConTh D_n_Eng_PreConTh D_n_Turbine_PreConTh D_v_Veh_PreConTh SWI_PreConditions /end DEF_CHARACTERISTIC
/end FUNCTION
/begin FUNCTION jData_zf_SAB_CrankShaftCurTorqueIn_Fktn "Calibration values of the Instance jData_zf_SAB_CrankShaftCurTorqueIn" /begin DEF_CHARACTERISTIC D_m_IstEM1 D_m_IstVM_Default /end DEF_CHARACTERISTIC /end FUNCTION
/begin FUNCTION jData_zf_SAB_DesiredTorqueIn_Fktn "Calibration values of the Instance jData_zf_SAB_DesiredTorqueIn" /begin DEF_CHARACTERISTIC SWI_SmokeCalc /end DEF_CHARACTERISTIC /end FUNCTION
/begin FUNCTION jData_zf_SAB_DoorStatusIn_Fktn "Calibration values of the Instance jData_zf_SAB_DoorStatusIn" /begin DEF_CHARACTERISTIC D_u_BattLth_DOOR SWI_DoorD /end DEF_CHARACTERISTIC /end FUNCTION
/begin FUNCTION jData_zf_SAB_DriverSeatStatusIn_Fktn "Calibration values of the Instance jData_zf_SAB_DriverSeatStatusIn" /begin DEF_CHARACTERISTIC D_u_BattLth_SEAT /end DEF_CHARACTERISTIC /end FUNCTION
/begin FUNCTION jData_zf_SAB_DrivingDirectionIn_Fktn "Calibration values of the Instance jData_zf_SAB_DrivingDirectionIn" /begin DEF_CHARACTERISTIC D_t_HoldDirection SWI_DriveDirByNabOrNwheel /end DEF_CHARACTERISTIC /end FUNCTION
/begin FUNCTION jData_zf_SAB_EEpromZentralHandler_Fktn "Calibration values of the Instance jData_zf_SAB_EEpromZentralHandler" /begin DEF_CHARACTERISTIC D_n_EEPromDataAgs /end DEF_CHARACTERISTIC /end FUNCTION
/begin FUNCTION jData_zf_SAB_EmergencyGearInfo_Fktn "Calibration values of the Instance jData_zf_SAB_EmergencyGearInfo"
 /begin DEF_CHARACTERISTIC D_n_AbUThGearSubst1 D_n_AbUThGearSubst2 D_n_AbUThGearSubst3 D_n_AbUThGearSubst4 D_n_AbUThGearSubst5 D_n_AbUThGearSubst6 D_n_EnTh1 D_n_EnTh2 D_n_EnTh3 D_n_EnTh4 D_n_EnTh5 D_n_EnTh6 D_n_EnUTh D_n_TuTh1 D_n_TuTh2 D_n_TuTh3 D_n_TuTh4 D_n_TuTh5 D_n_TuTh6 D_n_iGangAb_GearSubstC0Hys D_n_iGangAb_GearSubstC0LTh D_n_iGangAb_GearSubstC0Th D_n_iGangAb_GearSubstIEPTh D_n_iGangAb_GearSubstTh D_n_iGangAb_GearSubstUth D_tmr_GearSubst D_tmr_GearSubst1 D_v_ThGearSubst1 D_v_ThGearSubst2 D_v_ThGearSubst3 D_v_ThGearSubst4 D_v_ThGearSubst5 D_v_ThGearSubst6 SWI_n_AbUThGearSubst1 SWI_n_AbUThGearSubst2 SWI_n_AbUThGearSubst3 SWI_n_AbUThGearSubst4 SWI_n_AbUThGearSubst5 SWI_n_AbUThGearSubst6 SWI_n_EnUTh /end DEF_CHARACTERISTIC
/end FUNCTION
/begin FUNCTION jData_zf_SAB_EngineCoolantTempIn_Fktn "Calibration values of the Instance jData_zf_SAB_EngineCoolantTempIn" /begin DEF_CHARACTERISTIC D_c_Eng /end DEF_CHARACTERISTIC /end FUNCTION
/begin FUNCTION jData_zf_SAB_EngineIdleSpeedReqIn_Fktn "Calibration values of the Instance jData_zf_SAB_EngineIdleSpeedReqIn" /begin DEF_CHARACTERISTIC D_n_EngIdleInit D_u_BattLth_NMOFLL SWI_n_EngIdle /end DEF_CHARACTERISTIC /end FUNCTION
/begin FUNCTION jData_zf_SAB_EngineSignalDiagnosis_Fktn "Calibration values of the Instance jData_zf_SAB_EngineSignalDiagnosis"
 /begin DEF_CHARACTERISTIC D_n_AbLth_ENGSIGEM D_u_BattLth_ENGSIG SWI_EngMonitor_1ENGSIGTRQ SWI_EngMonitor_2ENGSIGTRQ /end DEF_CHARACTERISTIC
/end FUNCTION
/begin FUNCTION jData_zf_SAB_EngineSpeedIn_Fktn "Calibration values of the Instance jData_zf_SAB_EngineSpeedIn" /begin DEF_CHARACTERISTIC SWI_CalAbForEMSubVal /end DEF_CHARACTERISTIC /end FUNCTION
/begin FUNCTION jData_zf_SAB_EngineSpeedRedIn_Fktn "Calibration values of the Instance jData_zf_SAB_EngineSpeedRedIn"
 /begin DEF_CHARACTERISTIC D_n_EngRedHigh D_n_EngRedNormal D_n_EngRedShort SWI_n_EngMaxRed /end DEF_CHARACTERISTIC
/end FUNCTION
/begin FUNCTION jData_zf_SAB_EngineTorqueIn_Fktn "Calibration values of the Instance jData_zf_SAB_EngineTorqueIn" /begin DEF_CHARACTERISTIC SWI_CalcMinMom /end DEF_CHARACTERISTIC /end FUNCTION
/begin FUNCTION jData_zf_SAB_ExtBrakeInterventionIn_Fktn "Calibration values of the Instance jData_zf_SAB_ExtBrakeInterventionIn" /begin DEF_CHARACTERISTIC SWI_Brake_Intervention /end DEF_CHARACTERISTIC /end FUNCTION
/begin FUNCTION jData_zf_SAB_FpDkVpIn_Fktn "Calibration values of the Instance jData_zf_SAB_FpDkVpIn"
 /begin DEF_CHARACTERISTIC D_ThrottlePosition D_ThrottlePositionVirt D_ThrottlePositionVirt_Raw100 D_ThrottlePosition_Raw100 /end DEF_CHARACTERISTIC
/end FUNCTION
/begin FUNCTION jData_zf_SAB_GearBoxState_Fktn "Calibration values of the Instance jData_zf_SAB_GearBoxState" /begin DEF_CHARACTERISTIC D_t_HssOff D_u_BattLimphomeLth D_u_BattLimphomeUth /end DEF_CHARACTERISTIC /end FUNCTION
/begin FUNCTION jData_zf_SAB_GearboxTempIn_Fktn "Calibration values of the Instance jData_zf_SAB_GearboxTempIn"
 /begin DEF_CHARACTERISTIC D_c_ChipOffset D_c_OilTransSubst D_n_EngPlausi_CGTLEV2_CCHIP12LEV2 D_t_Plausi_CGTLEV2_CCHIP12LEV2 SWI_CGT_CCHIP /end DEF_CHARACTERISTIC
/end FUNCTION
/begin FUNCTION jData_zf_SAB_GearLeverDiagnosis_Fktn "Calibration values of the Instance jData_zf_SAB_GearLeverDiagnosis" /begin DEF_CHARACTERISTIC D_u_BattLth_PINFO /end DEF_CHARACTERISTIC /end FUNCTION
/begin FUNCTION jData_zf_SAB_GearLeverIn_Fktn "Calibration values of the Instance jData_zf_SAB_GearLeverIn"
 /begin DEF_CHARACTERISTIC D_u_BattLth_POSINFO1 D_u_BattLth_POSINFO2 SWI_LeverType SWI_PButtonSignal SWI_SignalSource /end DEF_CHARACTERISTIC
/end FUNCTION
/begin FUNCTION jData_zf_SAB_GearLimitation_Fktn "Calibration values of the Instance jData_zf_SAB_GearLimitation"
 /begin DEF_CHARACTERISTIC D_ctl_GearLimit D_n_AbLth D_n_AbUth SWI_GearLimitSubst_H SWI_GearLimitSubst_L /end DEF_CHARACTERISTIC
/end FUNCTION
/begin FUNCTION jData_zf_SAB_GearRatioByCurrents_Fktn "Calibration values of the Instance jData_zf_SAB_GearRatioByCurrents"
 /begin DEF_CHARACTERISTIC D_i_EdsTolTh D_n6WheelTh D_n6WheelThRtn D_n_AbWheelTh D_n_AbWheelThRtn D_n_Abn6Th D_n_Abn6ThRtn D_n_EngThTuPlausi D_n_EngTolTh D_n_TuTolTh D_t_Currentconst D_t_IAEClose D_t_IAECloseDelay D_t_nDiagDelay D_t_nTuVirtLev2Delay D_t_nTuVirtPlausiErrDelay SWI_EdsCharacteristic /end DEF_CHARACTERISTIC
/end FUNCTION
/begin FUNCTION jData_zf_SAB_HybridGearboxReadyToDriveIn_Fktn "Calibration values of the Instance jData_zf_SAB_HybridGearboxReadyToDriveIn" /begin DEF_CHARACTERISTIC D_n_EngTh_SystemPressure D_n_EngTh_SystemPressureHys /end DEF_CHARACTERISTIC /end FUNCTION
/begin FUNCTION jData_zf_SAB_HybridVehicleReadyToDriveIn_Fktn "Calibration values of the Instance jData_zf_SAB_HybridVehicleReadyToDriveIn" /begin DEF_CHARACTERISTIC D_t_ToStartVM D_t_holdStateVehicleReadyToDrive /end DEF_CHARACTERISTIC /end FUNCTION
/begin FUNCTION jData_zf_SAB_IgnitionStatusIn_Fktn "Calibration values of the Instance jData_zf_SAB_IgnitionStatusIn"
 /begin DEF_CHARACTERISTIC D_t_IgnDelayPin D_t_IgnFilter D_t_IgnPlausiDelay D_t_IgnPlausiTol D_u_KL15_PinLth SWI_IgnPlausiActive SWI_UseQualifier /end DEF_CHARACTERISTIC
/end FUNCTION
/begin FUNCTION jData_zf_SAB_InclinationIn_Fktn "Calibration values of the Instance jData_zf_SAB_InclinationIn" /begin DEF_CHARACTERISTIC SWI_Inclination SWI_InclinationSignalNegated /end DEF_CHARACTERISTIC /end FUNCTION
/begin FUNCTION jData_zf_SAB_LayerAGS_Fktn "Calibration values of the Instance jData_zf_SAB_LayerAGS" /begin DEF_CHARACTERISTIC SWI_RpmDynOut /end DEF_CHARACTERISTIC /end FUNCTION
/begin FUNCTION jData_zf_SAB_MSAIn_Fktn "Calibration values of the Instance jData_zf_SAB_MSAIn" /begin DEF_CHARACTERISTIC SWI_HIS_verbaut /end DEF_CHARACTERISTIC /end FUNCTION
/begin FUNCTION jData_zf_SAB_OBD_CyclesIn_Fktn "Calibration values of the Instance jData_zf_SAB_OBD_CyclesIn" /begin DEF_CHARACTERISTIC D_u_BattLth_OBDCYCLES SWI_extended_analyse /end DEF_CHARACTERISTIC /end FUNCTION
/begin FUNCTION jData_zf_SAB_OSModeSwitchingOut_Fktn "Calibration values of the Instance jData_zf_SAB_OSModeSwitchingOut"
 /begin DEF_CHARACTERISTIC D_n_EngOSModeTh D_n_TuOSModeTh D_u_BattOSModeLth D_u_BattOSModeUth /end DEF_CHARACTERISTIC
/end FUNCTION
/begin FUNCTION jData_zf_SAB_ParklockSensorIn_Fktn "Calibration values of the Instance jData_zf_SAB_ParklockSensorIn" /begin DEF_CHARACTERISTIC D_t_PosZMax_PARK SWI_LTog_PARK /end DEF_CHARACTERISTIC /end FUNCTION
/begin FUNCTION jData_zf_SAB_ParkManeuverAssistant_Fktn "Calibration values of the Instance jData_zf_SAB_ParkManeuverAssistant" /begin DEF_CHARACTERISTIC SWI_PMA_RCP_FunctionActive /end DEF_CHARACTERISTIC /end FUNCTION
/begin FUNCTION jData_zf_SAB_PMA_ErrorHandling_Fktn "Calibration values of the Instance jData_zf_SAB_PMA_ErrorHandling" /begin DEF_CHARACTERISTIC D_u_BattLth_PARKASSIST /end DEF_CHARACTERISTIC /end FUNCTION
/begin FUNCTION jData_zf_SAB_PowerdownIn_Fktn "Calibration values of the Instance jData_zf_SAB_PowerdownIn" /begin DEF_CHARACTERISTIC D_n_Ab_PowerDownLth D_tmr_PowerDown D_tmr_PowerDown_IEP /end DEF_CHARACTERISTIC /end FUNCTION
/begin FUNCTION jData_zf_SAB_ReadECUIdentification_Fktn "Calibration values of the Instance jData_zf_SAB_ReadECUIdentification" /begin DEF_CHARACTERISTIC D_DCM_DIAGOBD_IDENT1 D_DCM_DIAGOBD_IDENT2 /end DEF_CHARACTERISTIC /end FUNCTION
/begin FUNCTION jData_zf_SAB_RearAxleRatioIn_Fktn "Calibration values of the Instance jData_zf_SAB_RearAxleRatioIn"
 /begin DEF_CHARACTERISTIC D_Filt_v_WheelActiveAvgNew D_Filt_v_WheelActiveAvgOld D_IG_HA_Default D_IG_HA_Tab D_k_AbNew_HALearn D_k_AbOld_HALearn D_n_AbDif D_n_AbLearnLth D_n_EngForceLearnRearAxleRatioOn D_t_ForceLearnRearAxleRatio D_tmr_IG_HA_LearnDif D_v_WheelDif SWI_ForceLearnRearAxleRatio SWI_HA_Learn_Reset SWI_IG_HA_Learn s_mmm xha_Wert_Nummax /end DEF_CHARACTERISTIC
/end FUNCTION
/begin FUNCTION jData_zf_SAB_RollPreventIn_Fktn "Calibration values of the Instance jData_zf_SAB_RollPreventIn" /begin DEF_CHARACTERISTIC D_t_hillholdDelay /end DEF_CHARACTERISTIC /end FUNCTION
/begin FUNCTION jData_zf_SAB_RoutineControl_UDS_Fktn "Calibration values of the Instance jData_zf_SAB_RoutineControl_UDS"
 /begin DEF_CHARACTERISTIC D_ManualPreAdapService D_MappingAbortPreadaption D_tmr_IEP_Test_LS1 D_tmr_IEP_Test_LS2 D_tmr_IEP_Test_LS3 D_tmr_PreadaptionSOC0x80 SWI_RCControlStoppNRC0x24 /end DEF_CHARACTERISTIC
/end FUNCTION
/begin FUNCTION jData_zf_SAB_RPM_Diagnosis_Fktn "Calibration values of the Instance jData_zf_SAB_RPM_Diagnosis"
 /begin DEF_CHARACTERISTIC D_n_AbLth_NWHEELPLAUSILEV2 D_n_AbLth_SENSORLEV2 D_n_EngLth_SENSORLEV2 D_t_delay_1SENSORLEV2 D_t_delay_N6LEV2 D_t_delay_N6PLAUSILEV2 D_t_delay_NTUVIRTLEV2 D_t_delay_SENSORLEV2 D_u_BattLth_NWHEELLEV2 D_u_BattLth_NWHEELPLAUSILEV2 D_u_BattUth_NWHEELLEV2 SWI_n_AbTuPlausi_SENSORLEV2 /end DEF_CHARACTERISTIC
/end FUNCTION
/begin FUNCTION jData_zf_SAB_RPM_SensingIn_Fktn "Calibration values of the Instance jData_zf_SAB_RPM_SensingIn"
 /begin DEF_CHARACTERISTIC D_NAB_PulseWidthTolBw D_NAB_PulseWidthTolFw D_NAB_PulseWidthTypBw D_NAB_PulseWidthTypFw D_NT_PulseWidthTolBw D_NT_PulseWidthTolFw D_NT_PulseWidthTypBw D_NT_PulseWidthTypFw D_frq_HoldDirection D_n_AbDirection D_n_AbMin D_n_AbNoTeeth D_n_AbOffsetLevel D_n_TuDir D_n_TuMin D_n_TuNoTeeth D_n_TuOffsetLevel D_t_n_AbOffset D_t_n_TuOffset /end DEF_CHARACTERISTIC
/end FUNCTION
/begin FUNCTION jData_zf_SAB_SensorSupplyMonitoring_Fktn "Calibration values of the Instance jData_zf_SAB_SensorSupplyMonitoring" /begin DEF_CHARACTERISTIC D_t_delay_USENS /end DEF_CHARACTERISTIC /end FUNCTION
/begin FUNCTION jData_zf_SAB_SpeedPlausibilityIn_Fktn "Calibration values of the Instance jData_zf_SAB_SpeedPlausibilityIn"
 /begin DEF_CHARACTERISTIC D_n_AbDeactLth_VUNPLAUSILEV2 D_n_AbGraThRtn_VUNPLAUSILEV2 D_n_AbGraTh_VUNPLAUSILEV2 D_n_AbLth_VUNPLAUSILEV2 D_t_DelayBrake_VUNPLAUSILEV2 D_t_DelayDeactGra_VUNPLAUSILEV2 D_t_DelayGra_VUNPLAUSILEV2 D_t_DelayTo_VUNPLAUSILEV2 SWI_ABSOff_VUNPLAUSILEV2 /end DEF_CHARACTERISTIC
/end FUNCTION
/begin FUNCTION jData_zf_SAB_SportButtonIn_Fktn "Calibration values of the Instance jData_zf_SAB_SportButtonIn" /begin DEF_CHARACTERISTIC SWI_GWS_DriveLogic SWI_GWS_S_Button SWI_ICM_S_Button /end DEF_CHARACTERISTIC /end FUNCTION
/begin FUNCTION jData_zf_SAB_SubstTempIn_Fktn "Calibration values of the Instance jData_zf_SAB_SubstTempIn"
 /begin DEF_CHARACTERISTIC D_n_EngTuLth_CCHIP D_u_BattLth_INFOHOT1 D_u_BattLth_INFOHOT2 /end DEF_CHARACTERISTIC
/end FUNCTION
/begin FUNCTION jData_zf_SAB_TempDiagnosis_Fktn "Calibration values of the Instance jData_zf_SAB_TempDiagnosis"
 /begin DEF_CHARACTERISTIC D_c_OilHys_CGTLEV2 D_c_OilMax_CGTLEV2 D_c_Th_CCHIP12LEV2 D_c_TolCheck_CGTLEV2 D_c_TolClose_CGTLEV2 D_c_TolWide_CGTLEV2 D_cdmaxGrad D_t_DiagDelayRtn_CCHIP12LEV2 D_t_DiagDelay_CCHIP12LEV2 D_t_PlausiMaxErrRtn_CGTLEV2 D_t_PlausiMaxErr_CGTLEV2 D_t_TolCheck1_CGTLEV2 D_t_TolCheck2_CGTLEV2 /end DEF_CHARACTERISTIC
/end FUNCTION
/begin FUNCTION jData_zf_SAB_TimeEGSOffIn_Fktn "Calibration values of the Instance jData_zf_SAB_TimeEGSOffIn" /begin DEF_CHARACTERISTIC D_t_DefaultEGSOFF /end DEF_CHARACTERISTIC /end FUNCTION
/begin FUNCTION jData_zf_SAB_TipTasterIn_Fktn "Calibration values of the Instance jData_zf_SAB_TipTasterIn"
 /begin DEF_CHARACTERISTIC D_t_CANPaddleReceive D_t_debounceAnalogTip D_t_debounceLearnAnalogTip D_u_BattLth_TIPP SWI_DeactivateTipSourceSBW SWI_DontLearnInvalidSignal SWI_LearnTip SWI_ResetPaddleLearned /end DEF_CHARACTERISTIC
/end FUNCTION
/begin FUNCTION jData_zf_SAB_TorqueReserveIn_Fktn "Calibration values of the Instance jData_zf_SAB_TorqueReserveIn" /begin DEF_CHARACTERISTIC D_m_Reserve /end DEF_CHARACTERISTIC /end FUNCTION
/begin FUNCTION jData_zf_SAB_TransmissionOutputSpeedIn_Fktn "Calibration values of the Instance jData_zf_SAB_TransmissionOutputSpeedIn"
 /begin DEF_CHARACTERISTIC D_k_AbNew_CAN D_k_AbOld_CAN D_n_Init_AbFilt_CAN D_t_DelayNAbMaxCalc D_tmr_Init_n_AbFilt_aktiv SWI_Source_Nab_NWheel SWI_n_AbMaxCalc /end DEF_CHARACTERISTIC
/end FUNCTION
/begin FUNCTION jData_zf_SAB_TurbineSpeedIn_Fktn "Calibration values of the Instance jData_zf_SAB_TurbineSpeedIn"
 /begin DEF_CHARACTERISTIC D_k_Ntu D_k_TuNew D_k_TuNew_CAN D_k_TuOld D_k_TuOld_CAN D_n_Init_TuFilt_CAN D_tmr_Delay_TurbineSpeedTx D_tmr_Init_n_TuFilt_aktiv /end DEF_CHARACTERISTIC
/end FUNCTION
/begin RECORD_LAYOUT ZF_kf_si16_S5_S3 FNC_VALUES 5 SWORD ROW_DIR DIRECT AXIS_PTS_X 3 SWORD INDEX_INCR DIRECT AXIS_PTS_Y 4 SWORD INDEX_INCR DIRECT NO_AXIS_PTS_X 1 ULONG NO_AXIS_PTS_Y 2 ULONG /end RECORD_LAYOUT
/begin RECORD_LAYOUT ZF_kf_ui16_S5_S3 FNC_VALUES 5 UWORD ROW_DIR DIRECT AXIS_PTS_X 3 UWORD INDEX_INCR DIRECT AXIS_PTS_Y 4 UWORD INDEX_INCR DIRECT NO_AXIS_PTS_X 1 ULONG NO_AXIS_PTS_Y 2 ULONG /end RECORD_LAYOUT
/begin RECORD_LAYOUT ZF_kf_ui8_S5_S3 FNC_VALUES 5 UBYTE ROW_DIR DIRECT AXIS_PTS_X 3 UBYTE INDEX_INCR DIRECT AXIS_PTS_Y 4 UBYTE INDEX_INCR DIRECT NO_AXIS_PTS_X 1 ULONG NO_AXIS_PTS_Y 2 ULONG /end RECORD_LAYOUT
/begin RECORD_LAYOUT ZF_KL_NAT16_S2_S3 FNC_VALUES 3 UWORD COLUMN_DIR DIRECT AXIS_PTS_X 2 UWORD INDEX_INCR DIRECT NO_AXIS_PTS_X 1 ULONG /end RECORD_LAYOUT
/begin RECORD_LAYOUT ZF_KL_NAT8_S2_S3 FNC_VALUES 3 UBYTE COLUMN_DIR DIRECT AXIS_PTS_X 2 UBYTE INDEX_INCR DIRECT NO_AXIS_PTS_X 1 ULONG /end RECORD_LAYOUT
/begin RECORD_LAYOUT ZF_kl_si16_S5_S3 FNC_VALUES 3 SWORD COLUMN_DIR DIRECT AXIS_PTS_X 2 SWORD INDEX_INCR DIRECT NO_AXIS_PTS_X 1 ULONG /end RECORD_LAYOUT
/begin RECORD_LAYOUT ZF_kl_ui16_S5_S3 FNC_VALUES 3 UWORD COLUMN_DIR DIRECT AXIS_PTS_X 2 UWORD INDEX_INCR DIRECT NO_AXIS_PTS_X 1 ULONG /end RECORD_LAYOUT
/begin RECORD_LAYOUT ZF_kl_ui8_S5_S3 FNC_VALUES 3 UBYTE COLUMN_DIR DIRECT AXIS_PTS_X 2 UBYTE INDEX_INCR DIRECT NO_AXIS_PTS_X 1 ULONG /end RECORD_LAYOUT
/begin RECORD_LAYOUT ZF_kw_bool8_S5_S3 FNC_VALUES 1 UBYTE COLUMN_DIR DIRECT /end RECORD_LAYOUT
/begin RECORD_LAYOUT ZF_KW_INT16_S2_S3 FNC_VALUES 1 SWORD COLUMN_DIR DIRECT /end RECORD_LAYOUT
/begin RECORD_LAYOUT ZF_KW_INT16_S3_S3 FNC_VALUES 1 SWORD COLUMN_DIR DIRECT /end RECORD_LAYOUT
/begin RECORD_LAYOUT ZF_KW_INT8_S2_S3 FNC_VALUES 1 SBYTE COLUMN_DIR DIRECT /end RECORD_LAYOUT
/begin RECORD_LAYOUT ZF_KW_NAT16_S2_S3 FNC_VALUES 1 UWORD COLUMN_DIR DIRECT /end RECORD_LAYOUT
/begin RECORD_LAYOUT ZF_KW_NAT16_S3_S3 FNC_VALUES 1 UWORD COLUMN_DIR DIRECT /end RECORD_LAYOUT
/begin RECORD_LAYOUT ZF_KW_NAT32_S2_S3 FNC_VALUES 1 ULONG COLUMN_DIR DIRECT /end RECORD_LAYOUT
/begin RECORD_LAYOUT ZF_KW_NAT32_S3_S3 FNC_VALUES 1 ULONG COLUMN_DIR DIRECT /end RECORD_LAYOUT
/begin RECORD_LAYOUT ZF_KW_NAT8_S2_S3 FNC_VALUES 1 UBYTE COLUMN_DIR DIRECT /end RECORD_LAYOUT
/begin RECORD_LAYOUT ZF_KW_NAT8_S3_S3 FNC_VALUES 1 UBYTE COLUMN_DIR DIRECT /end RECORD_LAYOUT
/begin RECORD_LAYOUT ZF_kw_si16_S5_S3 FNC_VALUES 1 SWORD COLUMN_DIR DIRECT /end RECORD_LAYOUT
/begin RECORD_LAYOUT ZF_kw_si8_S5_S3 FNC_VALUES 1 SBYTE COLUMN_DIR DIRECT /end RECORD_LAYOUT
/begin RECORD_LAYOUT ZF_kw_ui16_S5_S3 FNC_VALUES 1 UWORD COLUMN_DIR DIRECT /end RECORD_LAYOUT
/begin RECORD_LAYOUT ZF_kw_ui8_S5_S3 FNC_VALUES 1 UBYTE COLUMN_DIR DIRECT /end RECORD_LAYOUT
/begin RECORD_LAYOUT ZF_TAB2D_NAT8_S2_S3 FNC_VALUES 3 UBYTE ROW_DIR DIRECT NO_AXIS_PTS_X 1 ULONG NO_AXIS_PTS_Y 2 ULONG /end RECORD_LAYOUT
/begin RECORD_LAYOUT ZF_TAB2D_NAT8_S3_S3 FNC_VALUES 3 UBYTE ROW_DIR DIRECT NO_AXIS_PTS_X 1 ULONG NO_AXIS_PTS_Y 2 ULONG /end RECORD_LAYOUT
/begin RECORD_LAYOUT ZF_tab2d_si16_S5_S3 FNC_VALUES 3 SWORD ROW_DIR DIRECT NO_AXIS_PTS_X 1 ULONG NO_AXIS_PTS_Y 2 ULONG /end RECORD_LAYOUT
/begin RECORD_LAYOUT ZF_tab2d_ui16_S5_S3 FNC_VALUES 3 UWORD ROW_DIR DIRECT NO_AXIS_PTS_X 1 ULONG NO_AXIS_PTS_Y 2 ULONG /end RECORD_LAYOUT
/begin RECORD_LAYOUT ZF_tab2d_ui8_S5_S3 FNC_VALUES 3 UBYTE ROW_DIR DIRECT NO_AXIS_PTS_X 1 ULONG NO_AXIS_PTS_Y 2 ULONG /end RECORD_LAYOUT
/begin RECORD_LAYOUT ZF_tab_bool8_S5_S3 FNC_VALUES 2 UBYTE COLUMN_DIR DIRECT NO_AXIS_PTS_X 1 ULONG /end RECORD_LAYOUT
/begin RECORD_LAYOUT ZF_TAB_NAT16_S2_S3 FNC_VALUES 2 UWORD COLUMN_DIR DIRECT NO_AXIS_PTS_X 1 ULONG /end RECORD_LAYOUT
/begin RECORD_LAYOUT ZF_TAB_NAT8_S2_S3 FNC_VALUES 2 UBYTE COLUMN_DIR DIRECT NO_AXIS_PTS_X 1 ULONG /end RECORD_LAYOUT
/begin RECORD_LAYOUT ZF_TAB_NAT8_S3_S3 FNC_VALUES 2 UBYTE COLUMN_DIR DIRECT NO_AXIS_PTS_X 1 ULONG /end RECORD_LAYOUT
/begin RECORD_LAYOUT ZF_tab_si16_S5_S3 FNC_VALUES 2 SWORD COLUMN_DIR DIRECT NO_AXIS_PTS_X 1 ULONG /end RECORD_LAYOUT
/begin RECORD_LAYOUT ZF_tab_ui16_S5_S3 FNC_VALUES 2 UWORD COLUMN_DIR DIRECT NO_AXIS_PTS_X 1 ULONG /end RECORD_LAYOUT
/begin RECORD_LAYOUT ZF_tab_ui8_S5_S3 FNC_VALUES 2 UBYTE COLUMN_DIR DIRECT NO_AXIS_PTS_X 1 ULONG /end RECORD_LAYOUT
/end MODULE
/end PROJECT
