ASAP2_VERSION 1 51
/begin PROJECT ZHBC8600 "Gen2_BMW_System_Supplier_Lib"
/begin MODULE CPP ""
/begin MOD_COMMON "" BYTE_ORDER MSB_FIRST ALIGNMENT_BYTE 1 ALIGNMENT_WORD 2 ALIGNMENT_LONG 4 ALIGNMENT_FLOAT32_IEEE 4 ALIGNMENT_FLOAT64_IEEE 1 /end MOD_COMMON
/begin COMPU_VTAB CONV_TAB_E_FEHLERIEP_S6_S3 "Conversion table" TAB_VERB 2 0 "NORMALBETRIEB" 1 "FEHLER" DEFAULT_VALUE "" /end COMPU_VTAB
/begin COMPU_VTAB CONV_TAB_E_HYBFKT_S6_S3 "Conversion table" TAB_VERB 16 0 "PASSIV" 1 "ANKOPPELN_VM" 2 "ABKOPPELN_VM" 3 "GANGEINLEGEN" 4 "GANGAUSLEGEN" 5 "OHNABLAUFFKT" 6 "DIREKTSTART" 7 "VM_ZUSTART" 8 "ABSTELLEN_VM" 9 "NICHTDEFINIERT_4" 10 "VM_SCHLEPPSTART" 11 "VM_NOTSTART" 12 "VM_EIN" 13 "VM_AUS" 14 "NICHTDEFINIERT_3" 15 "FEHLER" DEFAULT_VALUE "" /end COMPU_VTAB
/begin COMPU_VTAB CONV_TAB_E_POS_S6_S3 "Conversion table" TAB_VERB 9 0 "D1" 1 "D2" 2 "D3" 3 "D4" 4 "D5" 5 "D" 6 "N" 7 "R" 8 "P" DEFAULT_VALUE "" /end COMPU_VTAB
/begin COMPU_VTAB CONV_TAB_E_SIGSTATUS_S6_S3 "Conversion table" TAB_VERB 3 0 "SIGNAL_OK" 1 "ERSATZWERT" 2 "SIGNAL_FEHLER" DEFAULT_VALUE "" /end COMPU_VTAB
/begin COMPU_VTAB CONV_TAB_E_STATUSADA_S6_S3 "Conversion table" TAB_VERB 3 0 "KEINADAPTION" 1 "TOUCHPOINT_ADAPTION" 2 "REIBWERT_ADAPTION" DEFAULT_VALUE "" /end COMPU_VTAB
/begin COMPU_VTAB CONV_TAB_E_STATUSIAE_S6_S3 "Conversion table" TAB_VERB 9 0 "NICHTDEFINIERT" 1 "OFFEN" 2 "ANGELEGT" 3 "ANFAHREN" 4 "ENTKOPPELT" 5 "ENTKOPPELT_ANFAHREN" 6 "SYNCHRONISIEREN" 7 "GESCHLOSSEN" 8 "OEFFNEN" DEFAULT_VALUE "" /end COMPU_VTAB
/begin COMPU_VTAB CONV_TAB_E_STATUSIEP_S6_S3 "Conversion table" TAB_VERB 5 0 "AUS" 1 "SLEEP" 2 "LP1" 3 "LP2" 4 "LP3" DEFAULT_VALUE "" /end COMPU_VTAB
/begin COMPU_VTAB CONV_TAB_E_STATUSK0_S6_S3 "Conversion table" TAB_VERB 6 0 "OFFEN" 1 "ANGELEGT" 2 "DRUCKSTELLUNG" 3 "SCHLUPFGEREGELT" 4 "GEREGELTGESCHL" 5 "GESCHLOSSEN" DEFAULT_VALUE "" /end COMPU_VTAB
/begin COMPU_VTAB CONV_TAB_E_STATUSKSL_S6_S3 "Conversion table" TAB_VERB 7 0 "KEIN_KRAFTSCHLUSS" 1 "VORW_AUF_ABBAUEND" 2 "VORWAERTS" 3 "RUECKW_AUF_ABBAUEND" 4 "RUECKWAERTS" 5 "VORWAERTS_SCHLUPF" 6 "RUECKWAERTS_SCHLUPF" DEFAULT_VALUE "" /end COMPU_VTAB
/begin COMPU_VTAB CONV_TAB_E_STATUSPSY_S6_S3 "Conversion table" TAB_VERB 5 0 "AUS" 1 "NICHTDEFINIERT" 2 "LP1" 3 "LP2" 4 "LP3" DEFAULT_VALUE "" /end COMPU_VTAB
/begin COMPU_VTAB CONV_TAB_E_STBZHAS_S6_S3 "Conversion table" TAB_VERB 16 0 "INIT_INAKTIV" 1 "ANGEKOPPELT" 2 "ENTKOPPELT" 3 "EFAHREN" 4 "STOP" 5 "LADEN" 6 "ENTK_VMEIN" 7 "EFAHREN_VMEIN" 8 "HYBRID" 9 "NICHTDEFINIERT_1" 10 "NICHTDEFINIERT_2" 11 "NICHTDEFINIERT_3" 12 "NICHTDEFINIERT_4" 13 "NICHTDEFINIERT_5" 14 "INIT_KL15" 15 "FEHLER" DEFAULT_VALUE "" /end COMPU_VTAB
/begin COMPU_VTAB CONV_TAB_E_ZIEP_S6_S3 "Conversion table" TAB_VERB 5 0 "AUS" 1 "SLEEP" 2 "LP1" 3 "LP2" 4 "LP3" DEFAULT_VALUE "" /end COMPU_VTAB
/begin COMPU_VTAB CONV_TAB_E_ZK0_S6_S3 "Conversion table" TAB_VERB 6 0 "OEFFNENSW" 1 "BEFUELLEN" 2 "DRUCKSTELLUNG" 3 "SCHLUPFREGELUNG" 4 "GEREGELTGESCHL" 5 "GESCHLOSSEN" DEFAULT_VALUE "" /end COMPU_VTAB
/begin COMPU_VTAB CONV_TAB_E_ZK0FSTIN_S6_S3 "Conversion table" TAB_VERB 4 0 "OFFEN" 1 "SCHLUPFGEREGELT" 2 "GEREGELTGESCHL" 3 "GESCHLOSSEN" DEFAULT_VALUE "" /end COMPU_VTAB
/begin COMPU_VTAB CONV_TAB_E_ZMODUSIAE_S6_S3 "Conversion table" TAB_VERB 3 0 "EFAHREN_SCHLUPF" 1 "EFAHREN_KRAFTSCHL" 2 "HYBRIDFAHREN" DEFAULT_VALUE "" /end COMPU_VTAB
/begin COMPU_VTAB CONV_TAB_E_ZMODUSIEP_S6_S3 "Conversion table" TAB_VERB 5 0 "KEINVORGABE" 1 "AUS" 2 "LP1" 3 "LP2" 4 "LP3" DEFAULT_VALUE "" /end COMPU_VTAB
/begin COMPU_VTAB CONV_TAB_E_ZNLLSOLL_S6_S3 "Conversion table" TAB_VERB 3 0 "KEINANF" 1 "ANF_ADAP" 2 "ANF_ALLG" DEFAULT_VALUE "" /end COMPU_VTAB
/begin COMPU_METHOD b_int_S6_S3 "Bit Feld" RAT_FUNC "%10.0" "-" COEFFS 0 1 0 0 0 1 /end COMPU_METHOD
/begin COMPU_METHOD c_int_S6_S3 "Temperatur" RAT_FUNC "%12.6" "°C" COEFFS 0 1 0 0 0 1 /end COMPU_METHOD
/begin COMPU_METHOD E_FEHLERIEP_S6_S3 "" TAB_VERB "%12.6" "" COMPU_TAB_REF CONV_TAB_E_FEHLERIEP_S6_S3 /end COMPU_METHOD
/begin COMPU_METHOD E_HYBFKT_S6_S3 "" TAB_VERB "%12.6" "" COMPU_TAB_REF CONV_TAB_E_HYBFKT_S6_S3 /end COMPU_METHOD
/begin COMPU_METHOD E_POS_S6_S3 "" TAB_VERB "%12.6" "" COMPU_TAB_REF CONV_TAB_E_POS_S6_S3 /end COMPU_METHOD
/begin COMPU_METHOD E_SIGSTATUS_S6_S3 "" TAB_VERB "%12.6" "" COMPU_TAB_REF CONV_TAB_E_SIGSTATUS_S6_S3 /end COMPU_METHOD
/begin COMPU_METHOD E_STATUSADA_S6_S3 "" TAB_VERB "%12.6" "" COMPU_TAB_REF CONV_TAB_E_STATUSADA_S6_S3 /end COMPU_METHOD
/begin COMPU_METHOD E_STATUSIAE_S6_S3 "" TAB_VERB "%12.6" "" COMPU_TAB_REF CONV_TAB_E_STATUSIAE_S6_S3 /end COMPU_METHOD
/begin COMPU_METHOD E_STATUSIEP_S6_S3 "" TAB_VERB "%12.6" "" COMPU_TAB_REF CONV_TAB_E_STATUSIEP_S6_S3 /end COMPU_METHOD
/begin COMPU_METHOD E_STATUSK0_S6_S3 "" TAB_VERB "%12.6" "" COMPU_TAB_REF CONV_TAB_E_STATUSK0_S6_S3 /end COMPU_METHOD
/begin COMPU_METHOD E_STATUSKSL_S6_S3 "" TAB_VERB "%12.6" "" COMPU_TAB_REF CONV_TAB_E_STATUSKSL_S6_S3 /end COMPU_METHOD
/begin COMPU_METHOD E_STATUSPSY_S6_S3 "" TAB_VERB "%12.6" "" COMPU_TAB_REF CONV_TAB_E_STATUSPSY_S6_S3 /end COMPU_METHOD
/begin COMPU_METHOD E_STBZHAS_S6_S3 "" TAB_VERB "%12.6" "" COMPU_TAB_REF CONV_TAB_E_STBZHAS_S6_S3 /end COMPU_METHOD
/begin COMPU_METHOD E_ZIEP_S6_S3 "" TAB_VERB "%12.6" "" COMPU_TAB_REF CONV_TAB_E_ZIEP_S6_S3 /end COMPU_METHOD
/begin COMPU_METHOD E_ZK0_S6_S3 "" TAB_VERB "%12.6" "" COMPU_TAB_REF CONV_TAB_E_ZK0_S6_S3 /end COMPU_METHOD
/begin COMPU_METHOD E_ZK0FSTIN_S6_S3 "" TAB_VERB "%12.6" "" COMPU_TAB_REF CONV_TAB_E_ZK0FSTIN_S6_S3 /end COMPU_METHOD
/begin COMPU_METHOD E_ZMODUSIAE_S6_S3 "" TAB_VERB "%12.6" "" COMPU_TAB_REF CONV_TAB_E_ZMODUSIAE_S6_S3 /end COMPU_METHOD
/begin COMPU_METHOD E_ZMODUSIEP_S6_S3 "" TAB_VERB "%12.6" "" COMPU_TAB_REF CONV_TAB_E_ZMODUSIEP_S6_S3 /end COMPU_METHOD
/begin COMPU_METHOD E_ZNLLSOLL_S6_S3 "" TAB_VERB "%12.6" "" COMPU_TAB_REF CONV_TAB_E_ZNLLSOLL_S6_S3 /end COMPU_METHOD
/begin COMPU_METHOD n_fl_S6_S3 "Drehzahl" RAT_FUNC "%12.6" "1/min" COEFFS 0 1 0 0 0 1 /end COMPU_METHOD
/begin COMPU_METHOD n_int_S6_S3 "Drehzahl" RAT_FUNC "%5.0" "1/min" COEFFS 0 1 0 0 0 1 /end COMPU_METHOD
/begin COMPU_METHOD ng_fl_S6_S3 "Drehzahlgradient" RAT_FUNC "%12.6" "1/min/s" COEFFS 0 1 0 0 0 1 /end COMPU_METHOD
/begin COMPU_METHOD ng_int_S6_S3 "Drehzahlgradient" RAT_FUNC "%5.0" "1/min/s" COEFFS 0 1 0 0 0 1 /end COMPU_METHOD
/begin COMPU_METHOD p_fl_S6_S3 "Druck" RAT_FUNC "%12.6" "bar" COEFFS 0 1 0 0 0 1 /end COMPU_METHOD
/begin COMPU_METHOD ratio_int_S6_S3 "Übersetzungsverhaeltnis" RAT_FUNC "%6.3" "-" COEFFS 0 1000 0 0 0 1 /end COMPU_METHOD
/begin COMPU_METHOD SAB2_C_1CEL_S3_S3 "int = ((phys * 1) / 1) - (0) Grad Celsius" RAT_FUNC "%1.0" "Grad Celsius" COEFFS 0 1 0 0 0 1 /end COMPU_METHOD
/begin COMPU_METHOD SAB2_C_CEL2_M100_S3_S3 "int = ((phys * 2) / 1) - (-100) Grad Celsius" RAT_FUNC "%4.3" "Grad Celsius" COEFFS 0 2 100 0 0 1 /end COMPU_METHOD
/begin COMPU_METHOD SAB2_C_CGT_1CEL_M50_S3_S3 "int = ((phys * 1) / 1) - (-50) Grad Celsius" RAT_FUNC "%1.0" "Grad Celsius" COEFFS 0 1 50 0 0 1 /end COMPU_METHOD
/begin COMPU_METHOD SAB2_C_CMO_1CEL_M48_S3_S3 "int = ((phys * 1) / 1) - (-48) Grad Celsius" RAT_FUNC "%1.0" "Grad Celsius" COEFFS 0 1 48 0 0 1 /end COMPU_METHOD
/begin COMPU_METHOD t_fl_S6_S3 "Zeit" RAT_FUNC "%12.6" "s" COEFFS 0 1 0 0 0 1 /end COMPU_METHOD
/begin COMPU_METHOD t_int_d_S6_S3 "Zeit" RAT_FUNC "%4.2" "s" COEFFS 0 100 0 0 0 1 /end COMPU_METHOD
/begin COMPU_METHOD t_int_h_S6_S3 "Zeit" RAT_FUNC "%6.2" "s" COEFFS 0 100 0 0 0 1 /end COMPU_METHOD
/begin COMPU_METHOD t_int_S6_S3 "Zeit" RAT_FUNC "%11.2" "s" COEFFS 0 100 0 0 0 1 /end COMPU_METHOD
/begin COMPU_METHOD trq_fl_a_S6_S3 "Moment" RAT_FUNC "%12.6" "Nm" COEFFS 0 1 0 0 0 1 /end COMPU_METHOD
/begin COMPU_METHOD trq_fl_j_S6_S3 "Moment" RAT_FUNC "%3.0" "Nm" COEFFS 0 1 0 0 0 1 /end COMPU_METHOD
/begin COMPU_METHOD trq_fl_S6_S3 "Moment" RAT_FUNC "%5.0" "Nm" COEFFS 0 1 0 0 0 1 /end COMPU_METHOD
/begin COMPU_METHOD trqg_fl_c_S6_S3 "Momentengradient" RAT_FUNC "%12.6" "Nm/s" COEFFS 0 1 0 0 0 1 /end COMPU_METHOD
/begin COMPU_METHOD v_fl_S6_S3 "Geschwindigkeit" RAT_FUNC "%12.6" "km/h" COEFFS 0 1 0 0 0 1 /end COMPU_METHOD
/begin COMPU_METHOD vg_fl_S6_S3 "Geschwindigkeitsgradient" RAT_FUNC "%12.6" "km/h/s" COEFFS 0 1 0 0 0 1 /end COMPU_METHOD
/begin COMPU_METHOD void_fl_S6_S3 "ohne Umrechnung" RAT_FUNC "%12.6" "-" COEFFS 0 1 0 0 0 1 /end COMPU_METHOD
/begin COMPU_METHOD void_int_b_S6_S3 "ohne Umrechnung" RAT_FUNC "%5.0" "-" COEFFS 0 1 0 0 0 1 /end COMPU_METHOD
/begin COMPU_METHOD void_int_e_S6_S3 "ohne Umrechnung" RAT_FUNC "%1.0" "-" COEFFS 0 1 0 0 0 1 /end COMPU_METHOD
/begin COMPU_METHOD void_int_S6_S3 "ohne Umrechnung" RAT_FUNC "%3.0" "-" COEFFS 0 1 0 0 0 1 /end COMPU_METHOD
/begin COMPU_METHOD VOID_SCALING_f_S6_S3 "Void scaling for unscaled variables" RAT_FUNC "%12.6" "" COEFFS 0 1 0 0 0 1 /end COMPU_METHOD
/begin COMPU_METHOD VOID_SCALING_S6_S3 "Void scaling for unscaled variables" RAT_FUNC "%1.0" "" COEFFS 0 1 0 0 0 1 /end COMPU_METHOD
/begin CHARACTERISTIC AKTIV "" VALUE 0x1D7597 UBYTE_COL_DIRECT_S6_S3 0 void_int_S6_S3 0 255 /end CHARACTERISTIC
/begin CHARACTERISTIC BM_ERSFKTHI_EMFEHLER_FRK_HAS "Bitmaske zur Festlegung der Diagnose Ersatzfunktionen die zur Anzeige einer EM Fehlfunktion (HI-32bit) in der HAS führt" VALUE 0x1971C8 ULONG_COL_DIRECT_S6_S3 0 b_int_S6_S3 0 4294967295 /end CHARACTERISTIC
/begin CHARACTERISTIC BM_ERSFKT_EMFEHLER_FRK_HAS "Bitmaske zur Festlegung der Diagnose Ersatzfunktionen die zur Anzeige einer EM Fehlfunktion in der HAS führt" VALUE 0x1971CC ULONG_COL_DIRECT_S6_S3 0 b_int_S6_S3 0 4294967295 /end CHARACTERISTIC
/begin CHARACTERISTIC BitAbortActive "Flag für Abbruch Aktiv" VALUE 0x19727C ULONG_COL_DIRECT_S6_S3 0 b_int_S6_S3 0 4294967295 /end CHARACTERISTIC
/begin CHARACTERISTIC CS_GETRK0OEFFNICHT_DIHO "Maximale Getriebe-Temperatur zur Erkennung K0 öffnet nicht." VALUE 0x1971D0 FLOAT32_IEEE_COL_DIRECT_S6_S3 0 c_int_S6_S3 -100 200 /end CHARACTERISTIC
/begin CHARACTERISTIC FK_NMINPSYSEM_1_HAS "Filterkoeffzient " VALUE 0x1975F4 FLOAT32_IEEE_COL_DIRECT_S6_S3 0 void_fl_S6_S3 -3.40282e+038 3.40282e+038 /end CHARACTERISTIC
/begin CHARACTERISTIC FK_NMINPSYSEM_2_HAS "Maximaler Drehzahlgradient der minimalen EM-Drehzahl zur Sicherstellung der Ölversorgung der HAS" VALUE 0x1975F8 FLOAT32_IEEE_COL_DIRECT_S6_S3 0 void_fl_S6_S3 -3.40282e+038 3.40282e+038 /end CHARACTERISTIC
/begin CHARACTERISTIC INIT "" VALUE 0x1D7598 UBYTE_COL_DIRECT_S6_S3 0 void_int_S6_S3 0 255 /end CHARACTERISTIC
/begin CHARACTERISTIC I_FIX_ERSATZ_MEMSTOER_HAS_L2 "(Überwachung EM-Störmoment)" VALUE 0x1D8E46 UWORD_COL_DIRECT_S6_S3 0 ratio_int_S6_S3 0 5 /end CHARACTERISTIC
/begin CHARACTERISTIC I_FIX_ERSATZ_NEMMIN_HAS_L2 "(Überwachung EM-Störmoment)" VALUE 0x1D8E48 UWORD_COL_DIRECT_S6_S3 0 ratio_int_S6_S3 0 5 /end CHARACTERISTIC
/begin CHARACTERISTIC I_FIX_ERSATZ_NEMSOLL_HAS_L2 "Uebersetzungsverhaeltnis zur Verwendung als Ersatzwert bei sehr niedrigen Abtriebsdrehzahlen" VALUE 0x1D8E4A UWORD_COL_DIRECT_S6_S3 0 ratio_int_S6_S3 0 5 /end CHARACTERISTIC
/begin CHARACTERISTIC I_FIX_ERSATZ_NVMSOLL_HAS_L2 "(Überwachung EM-Störmoment)" VALUE 0x1D8E4C UWORD_COL_DIRECT_S6_S3 0 ratio_int_S6_S3 0 5 /end CHARACTERISTIC
/begin CHARACTERISTIC KF_INITTVSTATUSIEP_SBE_W "Initialisierung der Verzögerungszeit von status_psysem_has" MAP 0x1D75A1 UBYTE_COL_DIRECT_S6_S3 0 trq_fl_j_S6_S3 0 255
 /begin AXIS_DESCR COM_AXIS status_iep_in void_int_S6_S3 5 0 255 DEPOSIT ABSOLUTE AXIS_PTS_REF KF_INITTVSTATUSIEP_SBE_X /end AXIS_DESCR
 /begin AXIS_DESCR COM_AXIS NO_INPUT_QUANTITY void_int_S6_S3 5 0 255 DEPOSIT ABSOLUTE AXIS_PTS_REF KF_INITTVSTATUSIEP_SBE_Y /end AXIS_DESCR
/end CHARACTERISTIC
/begin AXIS_PTS KF_INITTVSTATUSIEP_SBE_X "X-Achse: status_iep" 0x1D75BA status_iep_in UBYTE_X_INCR_DIRECT_S6_S3 0 void_int_S6_S3 5 0 255 DEPOSIT ABSOLUTE /end AXIS_PTS
/begin AXIS_PTS KF_INITTVSTATUSIEP_SBE_Y "Y-Achse: status_iep_alt" 0x1D75BF NO_INPUT_QUANTITY UBYTE_X_INCR_DIRECT_S6_S3 0 void_int_S6_S3 5 0 255 DEPOSIT ABSOLUTE /end AXIS_PTS
/begin CHARACTERISTIC KF_TVSTATUSIEPSST_SBE_W "Verzögerungszeit für status_psysem_has bei Erkennung Erststart" MAP 0x197668 FLOAT32_IEEE_COL_DIRECT_S6_S3 0 t_fl_S6_S3 -3.40282e+038 3.40282e+038
 /begin AXIS_DESCR COM_AXIS status_iep_in void_int_S6_S3 5 0 255 DEPOSIT ABSOLUTE AXIS_PTS_REF KF_TVSTATUSIEPSST_SBE_X /end AXIS_DESCR
 /begin AXIS_DESCR COM_AXIS NO_INPUT_QUANTITY void_int_S6_S3 5 0 255 DEPOSIT ABSOLUTE AXIS_PTS_REF KF_TVSTATUSIEPSST_SBE_Y /end AXIS_DESCR
/end CHARACTERISTIC
/begin AXIS_PTS KF_TVSTATUSIEPSST_SBE_X "X-Achse: status_iep" 0x1D75C4 status_iep_in UBYTE_X_INCR_DIRECT_S6_S3 0 void_int_S6_S3 5 0 255 DEPOSIT ABSOLUTE /end AXIS_PTS
/begin AXIS_PTS KF_TVSTATUSIEPSST_SBE_Y "Y-Achse: status_iep_alt" 0x1D75C9 NO_INPUT_QUANTITY UBYTE_X_INCR_DIRECT_S6_S3 0 void_int_S6_S3 5 0 255 DEPOSIT ABSOLUTE /end AXIS_PTS
/begin CHARACTERISTIC KF_TVSTATUSIEP_SBE_W "Verzögerungszeit für status_psysem_has" MAP 0x1976CC FLOAT32_IEEE_COL_DIRECT_S6_S3 0 t_fl_S6_S3 -3.40282e+038 3.40282e+038
 /begin AXIS_DESCR COM_AXIS status_iep_in void_int_S6_S3 5 0 255 DEPOSIT ABSOLUTE AXIS_PTS_REF KF_TVSTATUSIEP_SBE_X /end AXIS_DESCR
 /begin AXIS_DESCR COM_AXIS NO_INPUT_QUANTITY void_int_S6_S3 5 0 255 DEPOSIT ABSOLUTE AXIS_PTS_REF KF_TVSTATUSIEP_SBE_Y /end AXIS_DESCR
/end CHARACTERISTIC
/begin AXIS_PTS KF_TVSTATUSIEP_SBE_X "X-Achse: status_iep" 0x1D75CE status_iep_in UBYTE_X_INCR_DIRECT_S6_S3 0 void_int_S6_S3 5 0 255 DEPOSIT ABSOLUTE /end AXIS_PTS
/begin AXIS_PTS KF_TVSTATUSIEP_SBE_Y "Y-Achse: status_iep_alt" 0x1D75D3 NO_INPUT_QUANTITY UBYTE_X_INCR_DIRECT_S6_S3 0 void_int_S6_S3 5 0 255 DEPOSIT ABSOLUTE /end AXIS_PTS
/begin AXIS_PTS KL_MO_NEMSOLL_HAS_L2_X "X-Achse: gangabhaengiger Toleranzmomentenoffset, um welches das EM-Istmoment das Fahrerwunschmoment uebersteigen darf" 0x1D8E78 NO_INPUT_QUANTITY UWORD_X_INCR_DIRECT_S6_S3 0 ratio_int_S6_S3 9 0 5 DEPOSIT ABSOLUTE /end AXIS_PTS
/begin CHARACTERISTIC KL_MO_NEMSOLL_HAS_L2_Y "Y-Achse: gangabhaengiger Toleranzmomentenoffset, um welches das EM-Istmoment das Fahrerwunschmoment uebersteigen darf" CURVE 0x1D8E8A SWORD_COL_DIRECT_S6_S3 0 trq_fl_S6_S3 -200 500
 /begin AXIS_DESCR COM_AXIS NO_INPUT_QUANTITY ratio_int_S6_S3 9 0 5 DEPOSIT ABSOLUTE AXIS_PTS_REF KL_MO_NEMSOLL_HAS_L2_X /end AXIS_DESCR
/end CHARACTERISTIC
/begin AXIS_PTS KL_MS_MEMSTOER_HAS_L2_X "X: i_dyn_memstoer_has_l2" 0x1D7330 NO_INPUT_QUANTITY UWORD_X_INCR_DIRECT_S6_S3 0 ratio_int_S6_S3 10 0 5 DEPOSIT ABSOLUTE /end AXIS_PTS
/begin CHARACTERISTIC KL_MS_MEMSTOER_HAS_L2_Y "Y: Offset" CURVE 0x1D7344 UWORD_COL_DIRECT_S6_S3 0 trq_fl_S6_S3 0 500
 /begin AXIS_DESCR COM_AXIS NO_INPUT_QUANTITY ratio_int_S6_S3 10 0 5 DEPOSIT ABSOLUTE AXIS_PTS_REF KL_MS_MEMSTOER_HAS_L2_X /end AXIS_DESCR
/end CHARACTERISTIC
/begin AXIS_PTS KL_MS_NEMMIN_HAS_L2_X "X: i_dyn_nemmin_has_l2" 0x1D7358 NO_INPUT_QUANTITY UWORD_X_INCR_DIRECT_S6_S3 0 ratio_int_S6_S3 10 0 5 DEPOSIT ABSOLUTE /end AXIS_PTS
/begin CHARACTERISTIC KL_MS_NEMMIN_HAS_L2_Y "Y: Toleranzmomentenschwelle" CURVE 0x1D736C UWORD_COL_DIRECT_S6_S3 0 trq_fl_S6_S3 0 500
 /begin AXIS_DESCR COM_AXIS NO_INPUT_QUANTITY ratio_int_S6_S3 10 0 5 DEPOSIT ABSOLUTE AXIS_PTS_REF KL_MS_NEMMIN_HAS_L2_X /end AXIS_DESCR
/end CHARACTERISTIC
/begin AXIS_PTS KL_MS_NVMSOLL_HAS_L2_X "X: i_dyn_nvmsoll_has_l2" 0x1D7380 NO_INPUT_QUANTITY UWORD_X_INCR_DIRECT_S6_S3 0 ratio_int_S6_S3 10 0 5 DEPOSIT ABSOLUTE /end AXIS_PTS
/begin CHARACTERISTIC KL_MS_NVMSOLL_HAS_L2_Y "Y: Toleranzmomentenschwelle" CURVE 0x1D7394 UWORD_COL_DIRECT_S6_S3 0 trq_fl_S6_S3 0 500
 /begin AXIS_DESCR COM_AXIS NO_INPUT_QUANTITY ratio_int_S6_S3 10 0 5 DEPOSIT ABSOLUTE AXIS_PTS_REF KL_MS_NVMSOLL_HAS_L2_X /end AXIS_DESCR
/end CHARACTERISTIC
/begin AXIS_PTS KL_MS_VM_NVMSOLL_HAS_L2_X "X: i_dyn_nvmsoll_has_l2" 0x1D73A8 NO_INPUT_QUANTITY UWORD_X_INCR_DIRECT_S6_S3 0 ratio_int_S6_S3 10 0 5 DEPOSIT ABSOLUTE /end AXIS_PTS
/begin CHARACTERISTIC KL_MS_VM_NVMSOLL_HAS_L2_Y "Y: Toleranzmomentenschwelle fuer das VM Istmoment" CURVE 0x1D73BC UWORD_COL_DIRECT_S6_S3 0 trq_fl_S6_S3 0 1000
 /begin AXIS_DESCR COM_AXIS NO_INPUT_QUANTITY ratio_int_S6_S3 10 0 5 DEPOSIT ABSOLUTE AXIS_PTS_REF KL_MS_VM_NVMSOLL_HAS_L2_X /end AXIS_DESCR
/end CHARACTERISTIC
/begin AXIS_PTS KL_NMIN_PSYS_EM_HAS_X "" 0x197770 c_getriebe_egs_in FLOAT32_IEEE_X_INCR_DIRECT_S6_S3 0 c_int_S6_S3 8 -3.40282e+038 3.40282e+038 DEPOSIT ABSOLUTE /end AXIS_PTS
/begin CHARACTERISTIC KL_NMIN_PSYS_EM_HAS_Y "" CURVE 0x197790 FLOAT32_IEEE_COL_DIRECT_S6_S3 0 n_fl_S6_S3 -3.40282e+038 3.40282e+038
 /begin AXIS_DESCR COM_AXIS c_getriebe_egs_in c_int_S6_S3 8 -3.40282e+038 3.40282e+038 DEPOSIT ABSOLUTE AXIS_PTS_REF KL_NMIN_PSYS_EM_HAS_X /end AXIS_DESCR
/end CHARACTERISTIC
/begin AXIS_PTS KL_NO_NMIN_EM_PBREMSE_HAS_X "" 0x1977B0 p_bremse_fzg_in FLOAT32_IEEE_X_INCR_DIRECT_S6_S3 0 void_fl_S6_S3 5 -3.40282e+038 3.40282e+038 DEPOSIT ABSOLUTE /end AXIS_PTS
/begin CHARACTERISTIC KL_NO_NMIN_EM_PBREMSE_HAS_Y "" CURVE 0x1977C4 FLOAT32_IEEE_COL_DIRECT_S6_S3 0 n_fl_S6_S3 -3.40282e+038 3.40282e+038
 /begin AXIS_DESCR COM_AXIS p_bremse_fzg_in void_fl_S6_S3 5 -3.40282e+038 3.40282e+038 DEPOSIT ABSOLUTE AXIS_PTS_REF KL_NO_NMIN_EM_PBREMSE_HAS_X /end AXIS_DESCR
/end CHARACTERISTIC
/begin AXIS_PTS KL_TVSTATUSPSYSEM_LP3_HAS_X "Verzögerungszeit zum Setzten des Leistungspunkts 2 der Ölversorgung aus EM-Drehzahl in Abhängigkeit der Getrieböltemperatur" 0x197858 c_getriebe_egs_in FLOAT32_IEEE_X_INCR_DIRECT_S6_S3 0 c_int_S6_S3 8 -3.40282e+038 3.40282e+038 DEPOSIT ABSOLUTE /end AXIS_PTS
/begin CHARACTERISTIC KL_TVSTATUSPSYSEM_LP3_HAS_Y "Verzögerungszeit zum Setzten des Leistungspunkts 2 der Ölversorgung aus EM-Drehzahl in Abhängigkeit der Getrieböltemperatur" CURVE 0x197878 FLOAT32_IEEE_COL_DIRECT_S6_S3 0 t_fl_S6_S3 -3.40282e+038 3.40282e+038
 /begin AXIS_DESCR COM_AXIS c_getriebe_egs_in c_int_S6_S3 8 -3.40282e+038 3.40282e+038 DEPOSIT ABSOLUTE AXIS_PTS_REF KL_TVSTATUSPSYSEM_LP3_HAS_X /end AXIS_DESCR
/end CHARACTERISTIC
/begin CHARACTERISTIC K_SVH_RESET_LAU_ABK "Rücksetzen einer Schaltverhinderung während Abkoppeln im Zustand Last Uebernahme  (255 = alle Arten von Schaltungen zurücksetzen, 0 = keine Schaltung zurücksetzen) -> Bit-Codierung siehe Handbuch" VALUE 0x1D7C99 UBYTE_COL_DIRECT_S6_S3 0 void_int_S6_S3 0 255 /end CHARACTERISTIC
/begin CHARACTERISTIC K_SVH_RESET_SAK_ABK "Rücksetzen einer Schaltverhinderung während VM-Abkoppeln im Zustand 'Schaltung Aktiv' (255 = alle Arten von Schaltungen zurücksetzen, 0 = keine Schaltung zurücksetzen) -> Bit-Codierung siehe Handbuch" VALUE 0x1D7C9A UBYTE_COL_DIRECT_S6_S3 0 void_int_S6_S3 0 255 /end CHARACTERISTIC
/begin CHARACTERISTIC K_SVH_RESET_SRT_ABK "Rücksetzen einer Schaltverhinderung während Abkoppeln im Zustand Start  (255 = alle Arten von Schaltungen zurücksetzen, 0 = keine Schaltung zurücksetzen) -> Bit-Codierung siehe Handbuch" VALUE 0x1D7C9B UBYTE_COL_DIRECT_S6_S3 0 void_int_S6_S3 0 255 /end CHARACTERISTIC
/begin CHARACTERISTIC K_SVH_RESET_UAB_ABK "Rücksetzen einer Schaltverhinderung während Abkoppeln im Zustand Uebergabe Abbruch  (255 = alle Arten von Schaltungen zurücksetzen, 0 = keine Schaltung zurücksetzen) -> Bit-Codierung siehe Handbuch" VALUE 0x1D7C9C UBYTE_COL_DIRECT_S6_S3 0 void_int_S6_S3 0 255 /end CHARACTERISTIC
/begin CHARACTERISTIC K_SVH_RESET_UEB_ABK "Rücksetzen einer Schaltverhinderung während Abkoppeln im Zustand Uebergabe  (255 = alle Arten von Schaltungen zurücksetzen, 0 = keine Schaltung zurücksetzen) -> Bit-Codierung siehe Handbuch" VALUE 0x1D7C9D UBYTE_COL_DIRECT_S6_S3 0 void_int_S6_S3 0 255 /end CHARACTERISTIC
/begin CHARACTERISTIC MO_K0OEFFNENBED_LAU_ABK "Offset auf das K0 Sollmoment zur Abfrage des K0-Moments als Übergangsbedingung nach 'K0-Öffnen' im Zustand 'Last-Übernahme' beim Abkoppeln" VALUE 0x1CFDBC FLOAT32_IEEE_COL_DIRECT_S6_S3 0 trq_fl_a_S6_S3 -1000 1000 /end CHARACTERISTIC
/begin CHARACTERISTIC MO_TOL_MEMSTOER_HAS_L2 "Momentenoffset, welcher bei Beruecksichtigung des VM-Hochlaufs in der Momentenueberwachung zusaetzlich toleriert wird (Energieaufnahme des Motors)" VALUE 0x1D8E4E SWORD_COL_DIRECT_S6_S3 0 trq_fl_S6_S3 -100 100 /end CHARACTERISTIC
/begin CHARACTERISTIC MS_K0OEFFNENBED_LAU_ABK "K0-Momentschwelle als Übergangsbedingung nach 'K0-Öffnen' im Zustand 'Last-Übernahme' beim Abkoppeln" VALUE 0x1CFDC8 FLOAT32_IEEE_COL_DIRECT_S6_S3 0 trq_fl_a_S6_S3 -1000 1000 /end CHARACTERISTIC
/begin CHARACTERISTIC MS_MIN_NEMMIN_HAS_L2 "Mindestmomentenschwelle, ab der eine Ueberwachung der Momente erfolgt" VALUE 0x1D8E50 SWORD_COL_DIRECT_S6_S3 0 trq_fl_S6_S3 -100 100 /end CHARACTERISTIC
/begin CHARACTERISTIC MS_MOTMAX_HAS_L2 "maximale Momentenschwelle, unterhalb der ein Fehler erkannt wird" VALUE 0x1D8E52 SWORD_COL_DIRECT_S6_S3 0 trq_fl_S6_S3 -200 200 /end CHARACTERISTIC
/begin CHARACTERISTIC MS_MOTSOLL_NVMSOLL_HAS_L2 "Momentenschwelle, die vom Fahrerwunschmoment ueberschritten sein muss, um die Momentenbilanzierung zu modifizieren" VALUE 0x1D8E54 SWORD_COL_DIRECT_S6_S3 0 trq_fl_S6_S3 -200 500 /end CHARACTERISTIC
/begin CHARACTERISTIC M_K0MODMIN_SAK_ABK "Minimalwert des modifizierten K0-Moments im Zustand 'Schaltung aktiv' beim Abkoppeln" VALUE 0x1CFDD8 FLOAT32_IEEE_COL_DIRECT_S6_S3 0 trq_fl_a_S6_S3 -1000 1000 /end CHARACTERISTIC
/begin CHARACTERISTIC M_K0MODMIN_SRT_ABK "Minimalwert des modifizierten K0-Moments im Zustand 'Start' beim Abkoppeln" VALUE 0x1CFDDC FLOAT32_IEEE_COL_DIRECT_S6_S3 0 trq_fl_a_S6_S3 -1000 1000 /end CHARACTERISTIC
/begin CHARACTERISTIC NDS_GETR_NEMSOLL_HAS_L2 "Differenzdrehzahlschwelle, ab der das Getriebe als schlupfend angesehen wird" VALUE 0x1D8E56 SWORD_COL_DIRECT_S6_S3 0 n_int_S6_S3 0 32767 /end CHARACTERISTIC
/begin CHARACTERISTIC NGS_VM_MEMSTOER_HAS_L2 "VM-Drehzahlgradientenschwelle, ab welcher der VM-Hochlauf bei der Momentenueberwachung zusaetzlich toleriert wird (Energieaufnahme des Motors)" VALUE 0x1D8E58 SWORD_COL_DIRECT_S6_S3 0 ng_int_S6_S3 0 20000 /end CHARACTERISTIC
/begin CHARACTERISTIC NG_MINPSYSEMHASMAX_HAS "Maximaler Drehzahlgradient der minimalen EM-Drehzahl zur Sicherstellung der Ölversorgung der HAS" VALUE 0x19760C FLOAT32_IEEE_COL_DIRECT_S6_S3 0 ng_fl_S6_S3 -3.40282e+038 3.40282e+038 /end CHARACTERISTIC
/begin CHARACTERISTIC NG_MINPSYSEMHASMIN_HAS "Minimaler Drehzahlgradient der minimalen EM-Drehzahl zur Sicherstellung der Ölversorgung der HAS" VALUE 0x197610 FLOAT32_IEEE_COL_DIRECT_S6_S3 0 ng_fl_S6_S3 -3.40282e+038 3.40282e+038 /end CHARACTERISTIC
/begin CHARACTERISTIC NO_EMOELVERSFEHLER_ERK_HAS "Drehzahloffset auf die EM-Istdrehzahl, das bei der Ölversorgungsüberwachung tolleriert wird." VALUE 0x1971F4 FLOAT32_IEEE_COL_DIRECT_S6_S3 0 n_fl_S6_S3 0 10000 /end CHARACTERISTIC
/begin CHARACTERISTIC NO_MIN_EM_PN_HAS "" VALUE 0x197614 FLOAT32_IEEE_COL_DIRECT_S6_S3 0 n_fl_S6_S3 -3.40282e+038 3.40282e+038 /end CHARACTERISTIC
/begin CHARACTERISTIC NO_NMIN_PSYS_EM_L1AUS "" VALUE 0x197618 FLOAT32_IEEE_COL_DIRECT_S6_S3 0 n_fl_S6_S3 -3.40282e+038 3.40282e+038 /end CHARACTERISTIC
/begin CHARACTERISTIC NO_NMIN_PSYS_EM_L1L3 "Drehzahloffset zur Umschaltung des Status Pumpendruck von LP1 nach LP3" VALUE 0x19761C FLOAT32_IEEE_COL_DIRECT_S6_S3 0 n_fl_S6_S3 0 1000 /end CHARACTERISTIC
/begin CHARACTERISTIC NO_NMIN_PSYS_EM_L3L1 "Drehzahloffset zur Umschaltung des Status Pumpendruck von LP3 nach LP1" VALUE 0x197620 FLOAT32_IEEE_COL_DIRECT_S6_S3 0 n_fl_S6_S3 0 1000 /end CHARACTERISTIC
/begin CHARACTERISTIC NS_AB_MIN_NEMSOLL_HAS_L2 "Drehzahlschwelle, unterhalb welcher die Abtriebsdrehzahl zu Null angenommen wird" VALUE 0x1D8E5A UWORD_COL_DIRECT_S6_S3 0 n_int_S6_S3 0 65535 /end CHARACTERISTIC
/begin CHARACTERISTIC NS_EMANF_PVU_HAS "EM-Drehzahlschwelle des Timers der Maximal-zeit der Aktivierung der Überwachung durch die Diagnose bei der Unterstützung der Positions-ventil-Überwachung der HAS" VALUE 0x197624 FLOAT32_IEEE_COL_DIRECT_S6_S3 0 n_fl_S6_S3 0 10000 /end CHARACTERISTIC
/begin CHARACTERISTIC NS_EMOELVERSFEHLERKALT_ERK_HAS "Drehzahlschwelle, die die EM während Zustartablauf in Kaltstartvariante mindestens erreichen muss, bei Öl-versorgungsüberwachung" VALUE 0x1971FC FLOAT32_IEEE_COL_DIRECT_S6_S3 0 n_fl_S6_S3 0 10000 /end CHARACTERISTIC
/begin CHARACTERISTIC NS_EM_NVMSOLL_HAS_L2 "Toleranzdrehzahlschwelle ueber EM-Istdrehzahl bei Signalstoerung" VALUE 0x1D8E5C UWORD_COL_DIRECT_S6_S3 0 n_int_S6_S3 0 1000 /end CHARACTERISTIC
/begin CHARACTERISTIC NS_LIM_NEMMIN_HAS_L2 "Begrenzungsdrehzahl" VALUE 0x1D8E5E UWORD_COL_DIRECT_S6_S3 0 n_int_S6_S3 0 2500 /end CHARACTERISTIC
/begin CHARACTERISTIC NS_LIM_NEMSOLL_HAS_L2 "Drehzahlbegrenzung" VALUE 0x1D8E60 UWORD_COL_DIRECT_S6_S3 0 n_int_S6_S3 0 10000 /end CHARACTERISTIC
/begin CHARACTERISTIC NS_NEMMIN_HAS_L2 "Toleranzdrehzahlschwelle" VALUE 0x1D8E62 UWORD_COL_DIRECT_S6_S3 0 n_int_S6_S3 0 1000 /end CHARACTERISTIC
/begin CHARACTERISTIC NS_NMIN_EM_L1_HAS "" VALUE 0x197628 FLOAT32_IEEE_COL_DIRECT_S6_S3 0 n_fl_S6_S3 -3.40282e+038 3.40282e+038 /end CHARACTERISTIC
/begin CHARACTERISTIC NS_NVMSOLL_HAS_L2 "Toleranzdrehzahlschwelle" VALUE 0x1D8E64 UWORD_COL_DIRECT_S6_S3 0 n_int_S6_S3 0 1000 /end CHARACTERISTIC
/begin MEASUREMENT SFHC27_xp_ "" FLOAT32_IEEE VOID_SCALING_f_S6_S3 1 100 -3.40282e+038 3.40282e+038 ECU_ADDRESS 0xFFF9640C /end MEASUREMENT
/begin MEASUREMENT SFHC53_AND "" UBYTE VOID_SCALING_S6_S3 1 100 0 1 ECU_ADDRESS 0xFFF96D58 /end MEASUREMENT
/begin MEASUREMENT SFHC94_x2_ "" FLOAT32_IEEE VOID_SCALING_f_S6_S3 1 100 -3.40282e+038 3.40282e+038 ECU_ADDRESS 0xFFF96470 /end MEASUREMENT
/begin MEASUREMENT SFOp_ABK105_isActive_ "" UBYTE VOID_SCALING_S6_S3 1 100 0 1 ECU_ADDRESS 0xFFF8629E /end MEASUREMENT
/begin CHARACTERISTIC STATUS_ABL_ABBRUCH_AKTIV "Status Ablauf Abbruch aktiv" VALUE 0x1D7428 UBYTE_COL_DIRECT_S6_S3 0 void_int_S6_S3 0 255 /end CHARACTERISTIC
/begin CHARACTERISTIC STATUS_ABL_ABBRUCH_FERTIG "Status Ablauf Abbruch fertig" VALUE 0x1D7429 UBYTE_COL_DIRECT_S6_S3 0 void_int_S6_S3 0 255 /end CHARACTERISTIC
/begin CHARACTERISTIC STATUS_ABL_SAK_ABK "Projektspezifische Statusrückmeldung an HST im Zustand 'Schaltung aktiv' beim Abkoppeln" VALUE 0x1D7CA0 UBYTE_COL_DIRECT_S6_S3 0 void_int_S6_S3 0 255 /end CHARACTERISTIC
/begin CHARACTERISTIC STATUS_ABL_SRT_ABK "Projektspezifische Statusrückmeldung an HST im Zustand 'Start' beim Abkoppeln" VALUE 0x1D7CA1 UBYTE_COL_DIRECT_S6_S3 0 void_int_S6_S3 0 255 /end CHARACTERISTIC
/begin CHARACTERISTIC SWI_ABSTSTATTABK_OML_HAS "Schalter fuer die Auswahl der Hybridfunktion beim Zustandsuebergang von BZ 5 nach BZ 6 und von BZ 8 nach BZ 7 der Hybrid-Zustandssteuerung der HAS - FALSE = ABK, TRUE = ABST" VALUE 0x1D7422 UBYTE_COL_DIRECT_S6_S3 0 void_int_S6_S3 0 1 /end CHARACTERISTIC
/begin CHARACTERISTIC SWI_EXTDEAK_NEMMIN_HAS_L2 "Schalter, ob eine externe (OEM) Deaktivierung der Momentenplausibilisierung erlaubt ist" VALUE 0x1D8057 UBYTE_COL_DIRECT_S6_S3 0 void_int_S6_S3 0 1 /end CHARACTERISTIC
/begin CHARACTERISTIC SWI_EXTDEAK_NVMSOLL_HAS_L2 "Schalter, ob eine externe (OEM) Deaktivierung der Momentenplausibilisierung erlaubt ist" VALUE 0x1D8058 UBYTE_COL_DIRECT_S6_S3 0 void_int_S6_S3 0 1 /end CHARACTERISTIC
/begin CHARACTERISTIC SWI_KOMP_FEHLER_1_HAS_UL2 "Schalter zum provozieren eines Komplementefehlers" VALUE 0x1D8E66 UWORD_COL_DIRECT_S6_S3 0 void_int_b_S6_S3 0 65535 /end CHARACTERISTIC
/begin CHARACTERISTIC SWI_KOMP_FEHLER_2_HAS_UL2 "Schalter zum provozieren eines Komplementfehlers" VALUE 0x1D8E68 UWORD_COL_DIRECT_S6_S3 0 void_int_b_S6_S3 0 65535 /end CHARACTERISTIC
/begin CHARACTERISTIC SWI_MEMSTOER_HAS_L2 "Schalter zur De-/Aktivierung der Funktion" VALUE 0x1D8059 UBYTE_COL_DIRECT_S6_S3 0 void_int_S6_S3 0 1 /end CHARACTERISTIC
/begin CHARACTERISTIC SWI_MODUS_NMINPSYS_HAS "Schalter zur Auswahl des Modus zur Bestimmung der minimalen EM-Drehzahl zur Sicherstellung der Ölversorgung - 0 =  Bestimmung ohne Berücksichtigung des IEP-Status , 1 =  Bestimmung mit Berücksichtigung des IEP-Status" VALUE 0x1D7599 UBYTE_COL_DIRECT_S6_S3 0 void_int_S6_S3 0 1 /end CHARACTERISTIC
/begin CHARACTERISTIC SWI_MOD_NVMSOLL_HAS_L2 "Schalter zur De-/Aktivierung der Modifizierung der Momentenbilanzierung" VALUE 0x1D805A UBYTE_COL_DIRECT_S6_S3 0 void_int_S6_S3 0 1 /end CHARACTERISTIC
/begin CHARACTERISTIC SWI_MOTMAX_HAS_L2 "Schalter zur De-/Aktivierung der Funktion" VALUE 0x1D805B UBYTE_COL_DIRECT_S6_S3 0 void_int_S6_S3 0 1 /end CHARACTERISTIC
/begin CHARACTERISTIC SWI_MOTVERLUST_NEMMIN_HAS_L2 "Schalter zur Beruecksichtigung des Motorverlustmoments" VALUE 0x1D805C UBYTE_COL_DIRECT_S6_S3 0 void_int_S6_S3 0 1 /end CHARACTERISTIC
/begin CHARACTERISTIC SWI_MOTVERLUST_NEMSOLL_HAS_L2 "Schalter zur Beruecksichtigung des Motorverlustmoments" VALUE 0x1D805D UBYTE_COL_DIRECT_S6_S3 0 void_int_S6_S3 0 1 /end CHARACTERISTIC
/begin CHARACTERISTIC SWI_MOTVERLUST_NVMSOLL_HAS_L2 "Schalter zur Beruecksichtigung des Motorverlustmoments" VALUE 0x1D805E UBYTE_COL_DIRECT_S6_S3 0 void_int_S6_S3 0 1 /end CHARACTERISTIC
/begin CHARACTERISTIC SWI_NEMMIN_HAS_L2 "Schalterzu De-/Aktivierung der Funktion" VALUE 0x1D805F UBYTE_COL_DIRECT_S6_S3 0 void_int_S6_S3 0 1 /end CHARACTERISTIC
/begin CHARACTERISTIC SWI_NEMSOLL_HAS_L2 "Schalter zur De-/Aktivierung der Funktion" VALUE 0x1D8060 UBYTE_COL_DIRECT_S6_S3 0 void_int_S6_S3 0 1 /end CHARACTERISTIC
/begin CHARACTERISTIC SWI_NMINPSYSEM_HAS "Schalter zur Auswahl der minimalen EM-Drehzahl zur Sicherstellung der Ölversorgung - 0 = Vorgabe Wert 0, 1 = Vorgabe ASIS-Wert, 2 = Vorgabe ensprechend IEP-Status" VALUE 0x1D759A UBYTE_COL_DIRECT_S6_S3 0 void_int_S6_S3 0 2 /end CHARACTERISTIC
/begin CHARACTERISTIC SWI_NVMSOLL_HAS_L2 "Schalter zur De-/Aktivierung der Funktion" VALUE 0x1D8061 UBYTE_COL_DIRECT_S6_S3 0 void_int_S6_S3 0 1 /end CHARACTERISTIC
/begin CHARACTERISTIC SWI_PAK_FEHLER_HAS_UL2 "PAK-Testschalter" VALUE 0x1D8E6A UWORD_COL_DIRECT_S6_S3 0 void_int_b_S6_S3 0 65535 /end CHARACTERISTIC
/begin CHARACTERISTIC SWI_PDEAK_OELVERSFEHLER_ERK_HAS "Schalter, mit dem die Ölversorgungs-überwachung in Wählhebelposition P deaktiviert werden kann" VALUE 0x1D7418 UBYTE_COL_DIRECT_S6_S3 0 void_int_e_S6_S3 0 1 /end CHARACTERISTIC
/begin CHARACTERISTIC SWI_POS_NEMSOLL_HAS_L2 "Schalter, ob Positionsabfrage != {N,P}" VALUE 0x1D8062 UBYTE_COL_DIRECT_S6_S3 0 void_int_S6_S3 0 1 /end CHARACTERISTIC
/begin CHARACTERISTIC SWI_PVU_STATUSPSYS_HAS "Schalter zur Berücksichtigung der Aktivierung der Unterstützung der Positionsventil-Überwachung bei der Bestimmung des Pumpendruckstatus der HAS " VALUE 0x1D759C UBYTE_COL_DIRECT_S6_S3 0 void_int_S6_S3 0 1 /end CHARACTERISTIC
/begin CHARACTERISTIC SWI_SIGSTS_MEMSTOER_HAS_L2 "(Überwachung EM-Störmoment)" VALUE 0x1D8063 UBYTE_COL_DIRECT_S6_S3 0 void_int_S6_S3 0 1 /end CHARACTERISTIC
/begin CHARACTERISTIC SWI_SIGSTS_NEMSOLL_HAS_L2 "(Überwachung EM-Störmoment)" VALUE 0x1D8064 UBYTE_COL_DIRECT_S6_S3 0 void_int_S6_S3 0 1 /end CHARACTERISTIC
/begin CHARACTERISTIC SWI_SIGSTS_NVMSOLL_HAS_L2 "(Überwachung EM-Störmoment)" VALUE 0x1D8065 UBYTE_COL_DIRECT_S6_S3 0 void_int_S6_S3 0 1 /end CHARACTERISTIC
/begin CHARACTERISTIC SWI_STATUSPSYS_MPS_HAS "Schalter, ob die Modifikation des Pumpendruckstatus bei der Bestimmung desselben berücksichtigt werden soll" VALUE 0x1D759D UBYTE_COL_DIRECT_S6_S3 0 void_int_S6_S3 0 1 /end CHARACTERISTIC
/begin CHARACTERISTIC SWI_TESTMODE "Einschalten des TESTMODE" VALUE 0x1D7424 UBYTE_COL_DIRECT_S6_S3 0 void_int_S6_S3 0 1 /end CHARACTERISTIC
/begin CHARACTERISTIC SWI_TESTMODE_HS_STAPS "Einschalten des TESTMODE" VALUE 0x1D7425 UBYTE_COL_DIRECT_S6_S3 0 void_int_S6_S3 0 1 /end CHARACTERISTIC
/begin CHARACTERISTIC SWI_VAR_NEMSOLL_HAS_L2 "Schalter zur Auswahl der Ueberwachungsvariante" VALUE 0x1D8066 UBYTE_COL_DIRECT_S6_S3 0 void_int_S6_S3 1 2 /end CHARACTERISTIC
/begin CHARACTERISTIC SWI_VMSTARTANF_PVU_HAS "Schalter zur Aktivierung der Berücksichtigung der Anforderung eines VM Starts bei der Unter-stützung der Positionsventil-Überwachung der HAS" VALUE 0x1D759E UBYTE_COL_DIRECT_S6_S3 0 void_int_S6_S3 0 1 /end CHARACTERISTIC
/begin CHARACTERISTIC SWI_ZNMINIEP_HAS "Schalter um die Mindestdrehzahl bei der low Spec IEP zu aktivieren" VALUE 0x1D759F UBYTE_COL_DIRECT_S6_S3 0 void_int_S6_S3 0 1 /end CHARACTERISTIC
/begin CHARACTERISTIC SWI_ZPHYSK0_UAB_ABK "Schalter zur Beeinflussung  der K0-Hysterese ZPHYSK0" VALUE 0x1D7CA9 UBYTE_COL_DIRECT_S6_S3 0 void_int_e_S6_S3 0 1 /end CHARACTERISTIC
/begin CHARACTERISTIC SWI_ZPONRABBRAKTIV_HAS "Schalter zur Aktivierung der Beruecksichtigung des Umkehrgrenzpunkts der Hybridfunktionen bei der Abbruchsteuerung der Hybrid-Zustandssteuerung der HAS" VALUE 0x1D7426 UBYTE_COL_DIRECT_S6_S3 0 void_int_e_S6_S3 0 1 /end CHARACTERISTIC
/begin CHARACTERISTIC SWI_ZUSSTATTANK_OML_HAS "Schalter fuer die Auswahl der Hybridfunktion beim Zustandsuebergang von BZ 6 nach BZ 5 und von BZ 7 nach BZ 8 der Hybrid-Zustandssteuerung der HAS - FALSE = ANK, TRUE = ZUS" VALUE 0x1D7427 UBYTE_COL_DIRECT_S6_S3 0 void_int_S6_S3 0 1 /end CHARACTERISTIC
/begin AXIS_PTS TAB_ABBRUCHKODIERUNG_X "ID fuer die ein Abbruch definiert ist" 0x197280 NO_INPUT_QUANTITY ULONG_X_INCR_DIRECT_S6_S3 0 b_int_S6_S3 96 0 4294967295 DEPOSIT ABSOLUTE /end AXIS_PTS
/begin CHARACTERISTIC TAB_ABBRUCHKODIERUNG_Y "Kodierung zur Steurung der Abbrueche" CURVE 0x197400 ULONG_COL_DIRECT_S6_S3 0 b_int_S6_S3 0 4294967295
 /begin AXIS_DESCR COM_AXIS NO_INPUT_QUANTITY b_int_S6_S3 96 0 4294967295 DEPOSIT ABSOLUTE AXIS_PTS_REF TAB_ABBRUCHKODIERUNG_X /end AXIS_DESCR
/end CHARACTERISTIC
/begin CHARACTERISTIC TAB_IG_NEMSOLL_HAS_L2 "vorzeichenlose Uebersetzungsverhaeltnisse der einzelnen Gangstufen in aufsteigender Reihenfolge" VAL_BLK 0x1D8E34 UWORD_COL_DIRECT_S6_S3 0 ratio_int_S6_S3 0 5 MATRIX_DIM 9 1 1 /end CHARACTERISTIC
/begin CHARACTERISTIC TAB_STATUSIEP_HAS "Beeinflussung Start Timer mit der Zeit aus KL_TVSTATUSPSYSEM_LP3_HAS als =f(status_iep_in)" VAL_BLK 0x1D758D UBYTE_COL_DIRECT_S6_S3 0 void_int_S6_S3 0 255 MATRIX_DIM 5 1 1 /end CHARACTERISTIC
/begin CHARACTERISTIC TAB_STATUSPSYSEM_HAS "Beeinflussung Start Timer mit der Zeit aus KL_TVSTATUSPSYSEM_LP3_HAS als =f(status_psys_em_has)" VAL_BLK 0x1D7592 UBYTE_COL_DIRECT_S6_S3 0 void_int_S6_S3 0 255 MATRIX_DIM 5 1 1 /end CHARACTERISTIC
/begin CHARACTERISTIC TS_AKTIV_PVU_HAS "Zeitraum nach Erkennung der Betriebsbereitschaft des Hybridsystems in dem die Unterstuetzung der Positionsventilueberwachung durch die HAS aktiv ist." VALUE 0x197630 FLOAT32_IEEE_COL_DIRECT_S6_S3 0 t_fl_S6_S3 0 5 /end CHARACTERISTIC
/begin CHARACTERISTIC TS_ANFMAX_PVU_HAS "Maximaler Zeitraum nach Überschreiten der EM-Drehzahlschwelle zur Aktivierung der Ü-berwachung durch die Diagnose bei der Unter-stützung der Positionsventil-Überwachung der HAS" VALUE 0x197634 FLOAT32_IEEE_COL_DIRECT_S6_S3 0 t_fl_S6_S3 0 5 /end CHARACTERISTIC
/begin CHARACTERISTIC TS_MAX_PVU_HAS "Maximaler Zeitraum nach Erkennung der Betriebsbereitschaft des Hybridsystems in dem die Unterstuetzung der Positionsventilueberwachung durch die HAS aktiv ist. - Wert 0 deaktiviert den Timer.
" VALUE 0x197638 FLOAT32_IEEE_COL_DIRECT_S6_S3 0 t_fl_S6_S3 0 10 /end CHARACTERISTIC
/begin CHARACTERISTIC T_BETRIEBKALTSTARTMAX_PVU_HAS "Maximale Betriebsdauer im Falle einer Kalt-start-Anforderung zur Zwangsaktivierung der Unterstützung der Positionsventil-Überwachung der HAS" VALUE 0x19763C FLOAT32_IEEE_COL_DIRECT_S6_S3 0 t_fl_S6_S3 0 1000000 /end CHARACTERISTIC
/begin CHARACTERISTIC T_BETRIEBMAX_PVU_HAS "Maximale Betriebsdauer zur Zwangsaktivierung der Unterstützung der Positionsventil-Überwachung der HAS" VALUE 0x197640 FLOAT32_IEEE_COL_DIRECT_S6_S3 0 t_fl_S6_S3 0 1000000 /end CHARACTERISTIC
/begin CHARACTERISTIC T_MAX_SAK_ABK "Maximale Verweildauer im Zustand 'Schaltung Aktiv' beim Abkoppeln" VALUE 0x1CFDFC FLOAT32_IEEE_COL_DIRECT_S6_S3 0 t_fl_S6_S3 0 10 /end CHARACTERISTIC
/begin CHARACTERISTIC T_MEMSTOER_HAS_L2 "Fehlerfilterungstimer" VALUE 0x1D8E6C UWORD_COL_DIRECT_S6_S3 0 t_int_h_S6_S3 0 2.5 /end CHARACTERISTIC
/begin CHARACTERISTIC T_MOTMAX_HAS_L2 "max. Wert des Fehlerfilterungstimer" VALUE 0x1D8E6E UWORD_COL_DIRECT_S6_S3 0 t_int_h_S6_S3 0 2.5 /end CHARACTERISTIC
/begin CHARACTERISTIC T_NEMMIN_HAS_L2 "Fehlerfilterungstimer" VALUE 0x1D8E70 UWORD_COL_DIRECT_S6_S3 0 t_int_h_S6_S3 0 2.5 /end CHARACTERISTIC
/begin CHARACTERISTIC T_NEMSOLL_HAS_L2 "max. Wert des Fehlerfilterungstimer" VALUE 0x1D8E72 UWORD_COL_DIRECT_S6_S3 0 t_int_h_S6_S3 0 2.5 /end CHARACTERISTIC
/begin CHARACTERISTIC T_NGVM_MEMSTOER_HAS_L2 "Filterzeit fur ng_vm Ermittlung" VALUE 0x1D8E74 UWORD_COL_DIRECT_S6_S3 0 t_int_h_S6_S3 0 5 /end CHARACTERISTIC
/begin CHARACTERISTIC T_NVMSOLL_HAS_L2 "Fehlerfilterungstimer" VALUE 0x1D8E76 UWORD_COL_DIRECT_S6_S3 0 t_int_h_S6_S3 0 2.5 /end CHARACTERISTIC
/begin CHARACTERISTIC T_VBRE_NMINPSYSEM_HAS "Verzögerungszeit zum Rücksetzen der minimalen EM Drehzahl zur Sicherstellung Ölversorgung beim Abbremsen - Beachte: Wert Null deaktiviert die Funktion" VALUE 0x197644 FLOAT32_IEEE_COL_DIRECT_S6_S3 0 t_fl_S6_S3 0 10 /end CHARACTERISTIC
/begin CHARACTERISTIC T_VNMINPSYSEM_KL50_HAS "Verzögerungszeit nach Erkennung Betriebsbereitschaft zur Aktivierung der Ausgabe der minimalen EM Drehzahl zur Sicherstellung Ölversorgung" VALUE 0x19764C FLOAT32_IEEE_COL_DIRECT_S6_S3 0 t_fl_S6_S3 0 1 /end CHARACTERISTIC
/begin CHARACTERISTIC T_VSCHALTUNGAKTIV_HAS "Timer zum Zürücksetzen des status_schaltung_egs nach Schaltung bei anstehender Schaltungsanforderung durch fst" VALUE 0x197654 FLOAT32_IEEE_COL_DIRECT_S6_S3 0 t_fl_S6_S3 -3.40282e+038 3.40282e+038 /end CHARACTERISTIC
/begin CHARACTERISTIC VGS_FBRE1_NMINPSYSEM_HAS "Fahrzeuggeschwindigkeitsgradientenschwelle zum Setzen der minimalen EM Dreh-zahl zur Sicherstellung Ölversorgung beim Abbremsen" VALUE 0x197658 FLOAT32_IEEE_COL_DIRECT_S6_S3 0 v_fl_S6_S3 -100 100 /end CHARACTERISTIC
/begin CHARACTERISTIC VGS_FBRE2_NMINPSYSEM_HAS "Fahrzeuggeschwindigkeitsgradientenschwelle zum Rücksetzen der minimalen EM Drehzahl zur Sicherstellung Ölversorgung beim Abbremsen" VALUE 0x19765C FLOAT32_IEEE_COL_DIRECT_S6_S3 0 v_fl_S6_S3 -100 100 /end CHARACTERISTIC
/begin CHARACTERISTIC VS_FBRE_NMINPSYSEM_HAS "Fahrzeuggeschwindigkeitsschwelle zum Setzen bzw. Rücksetzen der minimalen EM Drehzahl zur Sicherstellung Ölversorgung beim Abbremsen" VALUE 0x197660 FLOAT32_IEEE_COL_DIRECT_S6_S3 0 v_fl_S6_S3 0 500 /end CHARACTERISTIC
/begin CHARACTERISTIC Z_ABLAUFVAR_KALTNEM_PVU_HAS "Wert der Anforderung eines Kaltstart-Ablaufs mit abgesenkter EM-Drehzahl durch die HAS Zustandssteuerung der Funktion zur Unterstüt-zung der Positionsventil- Überwachung der HAS" VALUE 0x1D75A0 UBYTE_COL_DIRECT_S6_S3 0 void_int_S6_S3 0 100 /end CHARACTERISTIC
/begin MEASUREMENT abstellpos_vm_in "Abstellposition VM vor nächstem ZOT" UBYTE void_int_S6_S3 1 100 0 180 ECU_ADDRESS 0xFFF86698 /end MEASUREMENT
/begin MEASUREMENT abstellpos_vm_status_in "Status Abstellposition VM" UBYTE void_int_S6_S3 1 100 0 2 ECU_ADDRESS 0xFFF86699 /end MEASUREMENT
/begin MEASUREMENT bErrorHybrid "" UBYTE void_int_S6_S3 1 100 0 15 ECU_ADDRESS 0xFFF86666 /end MEASUREMENT
/begin MEASUREMENT bExceptionHybrid "" UBYTE void_int_S6_S3 1 100 0 15 ECU_ADDRESS 0xFFF86667 /end MEASUREMENT
/begin MEASUREMENT bQuitAbort_azg "Abbruch wird abgebrochen" UBYTE void_int_e_S6_S3 1 100 0 1 ECU_ADDRESS 0xFFF96D59 /end MEASUREMENT
/begin MEASUREMENT c_getriebe_egs_in "" FLOAT32_IEEE c_int_S6_S3 1 100 -40 215 ECU_ADDRESS 0xFFF85DDC /end MEASUREMENT
/begin MEASUREMENT c_vm_in "" FLOAT32_IEEE c_int_S6_S3 1 100 -3.40282e+038 3.40282e+038 ECU_ADDRESS 0xFFF85E38 /end MEASUREMENT
/begin MEASUREMENT f_akt_err_memstoer_fl_has_l2 "Flag, ob Fehler aktiv ist (FPU-Pfad)" FLOAT32_IEEE void_fl_S6_S3 1 100 -3.40282e+038 3.40282e+038 ECU_ADDRESS 0xFFF85E5C /end MEASUREMENT
/begin MEASUREMENT f_akt_err_memstoer_has_l2 "Flag, ob Fehler aktiv ist" UBYTE void_int_S6_S3 1 100 0 255 ECU_ADDRESS 0xFFF866A2 /end MEASUREMENT
/begin MEASUREMENT f_akt_err_motmax_fl_has_l2 "Flag, ob ein Fehler aktiv ist (FPU-Pfad) (Ueberwachung max. Summenmoment)" FLOAT32_IEEE void_fl_S6_S3 1 100 -3.40282e+038 3.40282e+038 ECU_ADDRESS 0xFFF85E60 /end MEASUREMENT
/begin MEASUREMENT f_akt_err_motmax_has_l2 "Flag, ob ein Fehler aktiv ist (Ueberwachung max. Summenmoment)" UBYTE void_int_S6_S3 1 100 0 255 ECU_ADDRESS 0xFFF866A3 /end MEASUREMENT
/begin MEASUREMENT f_akt_err_nemmin_fl_has_l2 "Flag, fuer aktiven Fehler (FPU-Pfad)" FLOAT32_IEEE void_fl_S6_S3 1 100 -3.40282e+038 3.40282e+038 ECU_ADDRESS 0xFFF85E64 /end MEASUREMENT
/begin MEASUREMENT f_akt_err_nemmin_has_l2 "Flag, fuer aktiven Fehler" UBYTE void_int_S6_S3 1 100 0 255 ECU_ADDRESS 0xFFF866A4 /end MEASUREMENT
/begin MEASUREMENT f_akt_err_nemsoll_fl_has_l2 "Flag, ob Fehler aktiv ist (FPU-Pfad)" FLOAT32_IEEE void_fl_S6_S3 1 100 -3.40282e+038 3.40282e+038 ECU_ADDRESS 0xFFF85E68 /end MEASUREMENT
/begin MEASUREMENT f_akt_err_nemsoll_has_l2 "Flag, ob Fehler aktiv ist" UBYTE void_int_S6_S3 1 100 0 255 ECU_ADDRESS 0xFFF866A5 /end MEASUREMENT
/begin MEASUREMENT f_akt_err_nvmsoll_fl_has_l2 "Flag. ob Fehler aktiv ist (FPU-Pfad)" FLOAT32_IEEE void_fl_S6_S3 1 100 -3.40282e+038 3.40282e+038 ECU_ADDRESS 0xFFF85E6C /end MEASUREMENT
/begin MEASUREMENT f_akt_err_nvmsoll_has_l2 "Flag. ob Fehler aktiv ist" UBYTE void_int_S6_S3 1 100 0 255 ECU_ADDRESS 0xFFF866A6 /end MEASUREMENT
/begin MEASUREMENT f_extdeak_fl_has_l2 "Flag, ob Momentenplausiblisierung aufgrunde externer (OEM) Anforderung deaktiviert werden soll" FLOAT32_IEEE void_fl_S6_S3 1 100 -3.40282e+038 3.40282e+038 ECU_ADDRESS 0xFFF85E70 /end MEASUREMENT
/begin MEASUREMENT f_extdeak_has_l2 "Flag, ob Momentenplausiblisierung aufgrunde externer (OEM) Anforderung deaktiviert werden soll" UBYTE void_int_S6_S3 1 100 0 255 ECU_ADDRESS 0xFFF866A7 /end MEASUREMENT
/begin MEASUREMENT f_m_akt_err_memstoer_fl_has_l2 "Flag, ob Momentfehler aktiv ist (FPU-Pfad)" FLOAT32_IEEE void_fl_S6_S3 1 100 -3.40282e+038 3.40282e+038 ECU_ADDRESS 0xFFF85E74 /end MEASUREMENT
/begin MEASUREMENT f_m_akt_err_memstoer_has_l2 "Flag, ob Momentfehler aktiv ist" UBYTE void_int_S6_S3 1 100 0 255 ECU_ADDRESS 0xFFF866A8 /end MEASUREMENT
/begin MEASUREMENT f_m_akt_err_motmax_fl_has_l2 "Flag, ob Momentenfehler aktiv ist (FPU-Pfad)" FLOAT32_IEEE void_fl_S6_S3 1 100 -3.40282e+038 3.40282e+038 ECU_ADDRESS 0xFFF85E78 /end MEASUREMENT
/begin MEASUREMENT f_m_akt_err_motmax_has_l2 "Flag, ob Momentenfehler aktiv ist" UBYTE void_int_S6_S3 1 100 0 255 ECU_ADDRESS 0xFFF866A9 /end MEASUREMENT
/begin MEASUREMENT f_m_akt_err_nemmin_fl_has_l2 "Flag, ob Momentenfehler aktiv ist (FPU-Pfad)" FLOAT32_IEEE void_fl_S6_S3 1 100 -3.40282e+038 3.40282e+038 ECU_ADDRESS 0xFFF85E7C /end MEASUREMENT
/begin MEASUREMENT f_m_akt_err_nemmin_has_l2 "Flag, ob Momentenfehler aktiv ist" UBYTE void_int_S6_S3 1 100 0 255 ECU_ADDRESS 0xFFF866AA /end MEASUREMENT
/begin MEASUREMENT f_m_akt_err_nvmsoll_fl_has_l2 "Flag, ob Momentenfehler aktiv ist (FPU-Pfad)" FLOAT32_IEEE void_fl_S6_S3 1 100 -3.40282e+038 3.40282e+038 ECU_ADDRESS 0xFFF85E80 /end MEASUREMENT
/begin MEASUREMENT f_m_akt_err_nvmsoll_has_l2 "Flag, ob Momentenfehler aktiv ist" UBYTE void_int_S6_S3 1 100 0 255 ECU_ADDRESS 0xFFF866AB /end MEASUREMENT
/begin MEASUREMENT f_m_err_memstoer_fl_has_l2 "Flag, ob Fehlerereignis aufgrund Momentenüberschreitung vorliegt (FPU-Pfad)" FLOAT32_IEEE void_fl_S6_S3 1 100 -3.40282e+038 3.40282e+038 ECU_ADDRESS 0xFFF85E84 /end MEASUREMENT
/begin MEASUREMENT f_m_err_memstoer_has_l2 "Flag, ob Fehlerereignis aufgrund Momentenüberschreitung vorliegt" UBYTE void_int_S6_S3 1 100 0 255 ECU_ADDRESS 0xFFF866AC /end MEASUREMENT
/begin MEASUREMENT f_m_err_motmax_fl_has_l2 "Flag, ob Fehlerereignis aufgrund Momentenunterschreitung vorliegt (FPU-Pfad)" FLOAT32_IEEE void_fl_S6_S3 1 100 -3.40282e+038 3.40282e+038 ECU_ADDRESS 0xFFF85E88 /end MEASUREMENT
/begin MEASUREMENT f_m_err_motmax_has_l2 "Flag, ob Fehlerereignis aufgrund Momentenunterschreitung vorliegt" UBYTE void_int_S6_S3 1 100 0 255 ECU_ADDRESS 0xFFF866AD /end MEASUREMENT
/begin MEASUREMENT f_m_err_nemmin_fl_has_l2 "Flag, ob Fehlerereignis aufgrund Momentenüberschreitung vorliegt (FPU-Pfad)" FLOAT32_IEEE void_fl_S6_S3 1 100 -3.40282e+038 3.40282e+038 ECU_ADDRESS 0xFFF85E8C /end MEASUREMENT
/begin MEASUREMENT f_m_err_nemmin_has_l2 "Flag, ob Fehlerereignis aufgrund Momentenüberschreitung vorliegt" UBYTE void_int_S6_S3 1 100 0 255 ECU_ADDRESS 0xFFF866AE /end MEASUREMENT
/begin MEASUREMENT f_m_err_nvmsoll_fl_has_l2 "Flag, ob Fehlerereignis aufgrund Momentenüberschreitung vorliegt (FPU-Pfad)" FLOAT32_IEEE void_fl_S6_S3 1 100 -3.40282e+038 3.40282e+038 ECU_ADDRESS 0xFFF85E90 /end MEASUREMENT
/begin MEASUREMENT f_m_err_nvmsoll_has_l2 "Flag, ob Fehlerereignis aufgrund Momentenüberschreitung vorliegt" UBYTE void_int_S6_S3 1 100 0 255 ECU_ADDRESS 0xFFF866AF /end MEASUREMENT
/begin MEASUREMENT f_n_akt_err_nemmin_fl_has_l2 "Flag, ob Drehzahlfehler aktiv ist (FPU-Pfad)" FLOAT32_IEEE void_fl_S6_S3 1 100 -3.40282e+038 3.40282e+038 ECU_ADDRESS 0xFFF85E94 /end MEASUREMENT
/begin MEASUREMENT f_n_akt_err_nemmin_has_l2 "Flag, ob Drehzahlfehler aktiv ist" UBYTE void_int_S6_S3 1 100 0 255 ECU_ADDRESS 0xFFF866B0 /end MEASUREMENT
/begin MEASUREMENT f_n_akt_err_nemsoll_fl_has_l2 "Flag, ob Drehzahlfehler aktiv ist (FPU-Pfad)" FLOAT32_IEEE void_fl_S6_S3 1 100 -3.40282e+038 3.40282e+038 ECU_ADDRESS 0xFFF85E98 /end MEASUREMENT
/begin MEASUREMENT f_n_akt_err_nemsoll_has_l2 "Flag, ob Drehzahlfehler aktiv ist" UBYTE void_int_S6_S3 1 100 0 255 ECU_ADDRESS 0xFFF866B1 /end MEASUREMENT
/begin MEASUREMENT f_n_err_nemmin_fl_has_l2 "Flag, ob Fehlerereignis aufgrund Drehzahlüberschreitung vorliegt (FPU-Pfad)" FLOAT32_IEEE void_fl_S6_S3 1 100 -3.40282e+038 3.40282e+038 ECU_ADDRESS 0xFFF85E9C /end MEASUREMENT
/begin MEASUREMENT f_n_err_nemmin_has_l2 "Flag, ob Fehlerereignis aufgrund Drehzahlüberschreitung vorliegt" UBYTE void_int_S6_S3 1 100 0 255 ECU_ADDRESS 0xFFF866B2 /end MEASUREMENT
/begin MEASUREMENT f_n_err_nemsoll_fl_has_l2 "Flag, ob Fehlerereignis aufgrund Drehzahlüberschreitung vorliegt (FPU-Pfad)" FLOAT32_IEEE void_fl_S6_S3 1 100 -3.40282e+038 3.40282e+038 ECU_ADDRESS 0xFFF85EA0 /end MEASUREMENT
/begin MEASUREMENT f_n_err_nemsoll_has_l2 "Flag, ob Fehlerereignis aufgrund Drehzahlüberschreitung vorliegt" UBYTE void_int_S6_S3 1 100 0 255 ECU_ADDRESS 0xFFF866B3 /end MEASUREMENT
/begin MEASUREMENT f_pos_akt_err_nemsoll_fl_has_l2 "Flag, ob Positionsfehler aktiv ist (FPU-Pfad)" FLOAT32_IEEE void_fl_S6_S3 1 100 -3.40282e+038 3.40282e+038 ECU_ADDRESS 0xFFF85EA4 /end MEASUREMENT
/begin MEASUREMENT f_pos_akt_err_nemsoll_has_l2 "Flag, ob Positionsfehler aktiv ist" UBYTE void_int_S6_S3 1 100 0 255 ECU_ADDRESS 0xFFF866B4 /end MEASUREMENT
/begin MEASUREMENT f_pos_err_nemsoll_fl_has_l2 "Flag, ob Fehlerereignis aufgrund falscher Positionshebelstellung vorliegt (FPU-Pfad)" FLOAT32_IEEE void_fl_S6_S3 1 100 -3.40282e+038 3.40282e+038 ECU_ADDRESS 0xFFF85EA8 /end MEASUREMENT
/begin MEASUREMENT f_pos_err_nemsoll_has_l2 "Flag, ob Fehlerereignis aufgrund falscher Positionshebelstellung vorliegt" UBYTE void_int_S6_S3 1 100 0 255 ECU_ADDRESS 0xFFF866B5 /end MEASUREMENT
/begin MEASUREMENT f_s_akt_err_nemsoll_fl_has_l2 "Flag, ob Schlupffehler vorliegt (FPU-Pfad)" FLOAT32_IEEE void_fl_S6_S3 1 100 -3.40282e+038 3.40282e+038 ECU_ADDRESS 0xFFF85EAC /end MEASUREMENT
/begin MEASUREMENT f_s_akt_err_nemsoll_has_l2 "Flag, ob Schlupffehler vorliegt" UBYTE void_int_S6_S3 1 100 0 255 ECU_ADDRESS 0xFFF866B6 /end MEASUREMENT
/begin MEASUREMENT f_s_err_nemsoll_fl_has_l2 "Flag, ob Fehlerereignis aufgrund eines nicht schlupfenden Getriebes vorliegt (FPU-Pfad)" FLOAT32_IEEE void_fl_S6_S3 1 100 -3.40282e+038 3.40282e+038 ECU_ADDRESS 0xFFF85EB0 /end MEASUREMENT
/begin MEASUREMENT f_s_err_nemsoll_has_l2 "Flag, ob Fehlerereignis aufgrund eines nicht schlupfenden Getriebes vorliegt " UBYTE void_int_S6_S3 1 100 0 255 ECU_ADDRESS 0xFFF866B7 /end MEASUREMENT
/begin MEASUREMENT f_sig_akt_err_nvmsoll_fl_has_l2 "Flag, ob Signalfehler aktiv ist (FPU-Pfad)" FLOAT32_IEEE void_fl_S6_S3 1 100 -3.40282e+038 3.40282e+038 ECU_ADDRESS 0xFFF85EB4 /end MEASUREMENT
/begin MEASUREMENT f_sig_akt_err_nvmsoll_has_l2 "Flag, ob Signalfehler aktiv ist" UBYTE void_int_S6_S3 1 100 0 255 ECU_ADDRESS 0xFFF866B8 /end MEASUREMENT
/begin MEASUREMENT f_sig_err_nvmsoll_fl_has_l2 "Flag, ob Fehlerereignis aufgrund Signalstoerung aktiv ist (FPU-Pfad)" FLOAT32_IEEE void_fl_S6_S3 1 100 -3.40282e+038 3.40282e+038 ECU_ADDRESS 0xFFF85EB8 /end MEASUREMENT
/begin MEASUREMENT f_sig_err_nvmsoll_has_l2 "Flag, ob Fehlerereignis aufgrund Signalstoerung aktiv ist" UBYTE void_int_S6_S3 1 100 0 255 ECU_ADDRESS 0xFFF866B9 /end MEASUREMENT
/begin MEASUREMENT f_z_akt_err_memstoer_fl_has_l2 "Flag, ob Vorgabefehler aktiv ist (FPU-Pfad)" FLOAT32_IEEE void_fl_S6_S3 1 100 -3.40282e+038 3.40282e+038 ECU_ADDRESS 0xFFF85EBC /end MEASUREMENT
/begin MEASUREMENT f_z_akt_err_memstoer_has_l2 "Flag, ob Vorgabefehler aktiv ist" UBYTE void_int_S6_S3 1 100 0 255 ECU_ADDRESS 0xFFF866BA /end MEASUREMENT
/begin MEASUREMENT f_z_akt_err_nemsoll_fl_has_l2 "Flag, ob Vorgabefehler vorliegt (FPU-Pfad)" FLOAT32_IEEE void_fl_S6_S3 1 100 -3.40282e+038 3.40282e+038 ECU_ADDRESS 0xFFF85EC0 /end MEASUREMENT
/begin MEASUREMENT f_z_akt_err_nemsoll_has_l2 "Flag, ob Vorgabefehler vorliegt" UBYTE void_int_S6_S3 1 100 0 255 ECU_ADDRESS 0xFFF866BB /end MEASUREMENT
/begin MEASUREMENT f_z_akt_err_nvmsoll_fl_has_l2 "Flag, ob Vorgabefehler aktiv ist (FPU-Pfad)" FLOAT32_IEEE void_fl_S6_S3 1 100 -3.40282e+038 3.40282e+038 ECU_ADDRESS 0xFFF85EC4 /end MEASUREMENT
/begin MEASUREMENT f_z_akt_err_nvmsoll_has_l2 "Flag, ob Vorgabefehler aktiv ist" UBYTE void_int_S6_S3 1 100 0 255 ECU_ADDRESS 0xFFF866BC /end MEASUREMENT
/begin MEASUREMENT f_z_err_memstoer_fl_has_l2 "Flag, ob Fehlerereignis aufgrund Vorgabefehler vorliegt (FPU-Pfad)" FLOAT32_IEEE void_fl_S6_S3 1 100 -3.40282e+038 3.40282e+038 ECU_ADDRESS 0xFFF85EC8 /end MEASUREMENT
/begin MEASUREMENT f_z_err_memstoer_has_l2 "Flag, ob Fehlerereignis aufgrund Vorgabefehler vorliegt" UBYTE void_int_S6_S3 1 100 0 255 ECU_ADDRESS 0xFFF866BD /end MEASUREMENT
/begin MEASUREMENT f_z_err_nemsoll_fl_has_l2 "Flag, ob Fehlerereignis aufgrund Drehzahlvorgabe ohne Anforderung vorliegt (FPU-Pfad)" FLOAT32_IEEE void_fl_S6_S3 1 100 -3.40282e+038 3.40282e+038 ECU_ADDRESS 0xFFF85ECC /end MEASUREMENT
/begin MEASUREMENT f_z_err_nemsoll_has_l2 "Flag, ob Fehlerereignis aufgrund Drehzahlvorgabe ohne Anforderung vorliegt" UBYTE void_int_S6_S3 1 100 0 255 ECU_ADDRESS 0xFFF866BE /end MEASUREMENT
/begin MEASUREMENT f_z_err_nvmsoll_fl_has_l2 "Flag, ob Fehlerereignis aufgrund Drehzahlvorgabe ohne Anforderung vorliegt (FPU-Pfad)" FLOAT32_IEEE void_fl_S6_S3 1 100 -3.40282e+038 3.40282e+038 ECU_ADDRESS 0xFFF85ED0 /end MEASUREMENT
/begin MEASUREMENT f_z_err_nvmsoll_has_l2 "Flag, ob Fehlerereignis aufgrund Drehzahlvorgabe ohne Anforderung vorliegt" UBYTE void_int_S6_S3 1 100 0 255 ECU_ADDRESS 0xFFF866BF /end MEASUREMENT
/begin MEASUREMENT gangwechsel_egs_in "Flag während laufender Schaltung, bei synchron verlassen bis synchron erreicht" UBYTE void_int_S6_S3 1 100 0 1 ECU_ADDRESS 0xFFF86677 /end MEASUREMENT
/begin MEASUREMENT i_dyn_memstoer_fl_has_l2 "dynamisches Uebersetzungsverhaeltnis (FPU-Pfad)" FLOAT32_IEEE void_fl_S6_S3 1 100 -3.40282e+038 3.40282e+038 ECU_ADDRESS 0xFFF85ED4 /end MEASUREMENT
/begin MEASUREMENT i_dyn_memstoer_has_l2 "dynamisches Uebersetzungsverhaeltnis" UWORD ratio_int_S6_S3 1 100 0 65.535 ECU_ADDRESS 0xFFF860D8 /end MEASUREMENT
/begin MEASUREMENT i_dyn_nemmin_fl_has_l2 "dynamisches Uebersetzungsverhaeltnis (FPU-Pfad)" FLOAT32_IEEE void_fl_S6_S3 1 100 -3.40282e+038 3.40282e+038 ECU_ADDRESS 0xFFF85ED8 /end MEASUREMENT
/begin MEASUREMENT i_dyn_nemmin_has_l2 "dynamisches Uebersetzungsverhaeltnis" UWORD ratio_int_S6_S3 1 100 0 65.535 ECU_ADDRESS 0xFFF860DA /end MEASUREMENT
/begin MEASUREMENT i_dyn_nemsoll_fl_has_l2 "dynamisches Uebersetzungsverhaeltnis (FPU-Pfad)" FLOAT32_IEEE void_fl_S6_S3 1 100 -3.40282e+038 3.40282e+038 ECU_ADDRESS 0xFFF85EDC /end MEASUREMENT
/begin MEASUREMENT i_dyn_nemsoll_has_l2 "dynamisches Uebersetzungsverhaeltnis" UWORD ratio_int_S6_S3 1 100 0 65.535 ECU_ADDRESS 0xFFF860DC /end MEASUREMENT
/begin MEASUREMENT i_dyn_nvmsoll_fl_has_l2 "dynamisches Uebersetzungsverhaeltnis (FPU-Pfad)" FLOAT32_IEEE void_fl_S6_S3 1 100 -3.40282e+038 3.40282e+038 ECU_ADDRESS 0xFFF85EE0 /end MEASUREMENT
/begin MEASUREMENT i_dyn_nvmsoll_has_l2 "dynamisches Uebersetzungsverhaeltnis" UWORD ratio_int_S6_S3 1 100 0 65.535 ECU_ADDRESS 0xFFF860DE /end MEASUREMENT
/begin MEASUREMENT i_fix_nemsoll_fl_has_l2 "ermitteltes Uebersetzungsverhaeltnis (Istganguebersetzung) (FPU-Pfad)" FLOAT32_IEEE void_fl_S6_S3 1 100 -3.40282e+038 3.40282e+038 ECU_ADDRESS 0xFFF85EE4 /end MEASUREMENT
/begin MEASUREMENT i_fix_nemsoll_has_l2 "ermitteltes Uebersetzungsverhaeltnis (Istganguebersetzung)" UWORD ratio_int_S6_S3 1 100 0 65.535 ECU_ADDRESS 0xFFF860E0 /end MEASUREMENT
/begin MEASUREMENT i_istgang_egs "" FLOAT32_IEEE void_fl_S6_S3 1 100 0 8 ECU_ADDRESS 0xFFF85D8C /end MEASUREMENT
/begin MEASUREMENT i_zielgang_egs "" FLOAT32_IEEE void_fl_S6_S3 1 100 0 8 ECU_ADDRESS 0xFFF85D90 /end MEASUREMENT
/begin MEASUREMENT istgang_egs_in "" SBYTE void_int_S6_S3 1 100 -128 127 ECU_ADDRESS 0xFFF86678 /end MEASUREMENT
/begin MEASUREMENT iv_f_extdeak_fl_has_l2 "Flag, ob Momentenplausiblisierung aufgrunde externer (OEM) Anforderung deaktiviert werden soll" FLOAT32_IEEE void_fl_S6_S3 1 100 -3.40282e+038 3.40282e+038 ECU_ADDRESS 0xFFF85EE8 /end MEASUREMENT
/begin MEASUREMENT iv_f_extdeak_has_l2 "Flag, ob Momentenplausiblisierung aufgrunde externer (OEM) Anforderung deaktiviert werden soll" UBYTE void_int_S6_S3 1 100 0 255 ECU_ADDRESS 0xFFF866C0 /end MEASUREMENT
/begin MEASUREMENT iv_m_fahrerwunsch_fl_has_l2 "Fahrerwunschmoment aus Fahrpedalinterpretation (FPU-Pfad)" FLOAT32_IEEE trq_fl_a_S6_S3 1 100 -3.40282e+038 3.40282e+038 ECU_ADDRESS 0xFFF85EEC /end MEASUREMENT
/begin MEASUREMENT iv_m_fahrerwunsch_has_l2 "Fahrerwunschmoment aus Fahrpedalinterpretation" SWORD trq_fl_S6_S3 1 100 -32768 32767 ECU_ADDRESS 0xFFF860E2 /end MEASUREMENT
/begin MEASUREMENT iv_m_ist_em_fl_has_l2 "EM-Istmoment" FLOAT32_IEEE trq_fl_a_S6_S3 1 100 -3.40282e+038 3.40282e+038 ECU_ADDRESS 0xFFF85EF0 /end MEASUREMENT
/begin MEASUREMENT iv_m_ist_em_has_l2 "EM-Istmoment" SWORD trq_fl_S6_S3 1 100 -32768 32767 ECU_ADDRESS 0xFFF860E4 /end MEASUREMENT
/begin MEASUREMENT iv_m_ist_vm_fl_has_l2 "VM-Istmoment" FLOAT32_IEEE trq_fl_a_S6_S3 1 100 -3.40282e+038 3.40282e+038 ECU_ADDRESS 0xFFF85EF4 /end MEASUREMENT
/begin MEASUREMENT iv_m_ist_vm_has_l2 "VM-Istmoment" SWORD trq_fl_S6_S3 1 100 -32768 32767 ECU_ADDRESS 0xFFF860E6 /end MEASUREMENT
/begin MEASUREMENT iv_m_me_red_fl_has_l2 "Drehmoment des Motoreingriffs" FLOAT32_IEEE trq_fl_a_S6_S3 1 100 -3.40282e+038 3.40282e+038 ECU_ADDRESS 0xFFF85EF8 /end MEASUREMENT
/begin MEASUREMENT iv_m_me_red_has_l2 "Drehmoment des Motoreingriffs" SWORD trq_fl_S6_S3 1 100 -32768 32767 ECU_ADDRESS 0xFFF860E8 /end MEASUREMENT
/begin MEASUREMENT iv_m_motmax_fl_has_l2 "Max. zulaessiges Motormoment fuer Hybridantriebsstrang (gefuehrter Getriebeschutz) (FPU-Pfad)" FLOAT32_IEEE trq_fl_a_S6_S3 1 100 -3.40282e+038 3.40282e+038 ECU_ADDRESS 0xFFF85EFC /end MEASUREMENT
/begin MEASUREMENT iv_m_motmax_has_l2 "Max. zulaessiges Motormoment fuer Hybridantriebsstrang (gefuehrter Getriebeschutz)" SWORD trq_fl_S6_S3 1 100 -32768 32767 ECU_ADDRESS 0xFFF860EA /end MEASUREMENT
/begin MEASUREMENT iv_m_motsoll_fl_has_l2 "Motorsollmomentensumme (Fahrerwunsch)" FLOAT32_IEEE trq_fl_a_S6_S3 1 100 -3.40282e+038 3.40282e+038 ECU_ADDRESS 0xFFF85F00 /end MEASUREMENT
/begin MEASUREMENT iv_m_motsoll_has_l2 "Motorsollmomentensumme (Fahrerwunsch)" SWORD trq_fl_S6_S3 1 100 -32768 32767 ECU_ADDRESS 0xFFF860EC /end MEASUREMENT
/begin MEASUREMENT iv_m_motverlust_fl_has_l2 "Motorverlustmoment (FPU-Pfad)" FLOAT32_IEEE trq_fl_a_S6_S3 1 100 -3.40282e+038 3.40282e+038 ECU_ADDRESS 0xFFF85F04 /end MEASUREMENT
/begin MEASUREMENT iv_m_motverlust_has_l2 "Motorverlustmoment" UWORD trq_fl_S6_S3 1 100 0 65535 ECU_ADDRESS 0xFFF860EE /end MEASUREMENT
/begin MEASUREMENT iv_m_soll_em_fl_has_l2 "EM-Momenteneingriff von der HAS" FLOAT32_IEEE trq_fl_a_S6_S3 1 100 -3.40282e+038 3.40282e+038 ECU_ADDRESS 0xFFF85F08 /end MEASUREMENT
/begin MEASUREMENT iv_m_soll_em_has_l2 "EM-Momenteneingriff von der HAS" SWORD trq_fl_S6_S3 1 100 -32768 32767 ECU_ADDRESS 0xFFF860F0 /end MEASUREMENT
/begin MEASUREMENT iv_n_ist_ab_fl_has_l2 "Abtriebsistdrehzahl" FLOAT32_IEEE n_fl_S6_S3 1 100 -3.40282e+038 3.40282e+038 ECU_ADDRESS 0xFFF85F0C /end MEASUREMENT
/begin MEASUREMENT iv_n_ist_ab_has_l2 "Abtriebsistdrehzahl" UWORD n_int_S6_S3 1 100 0 65535 ECU_ADDRESS 0xFFF860F2 /end MEASUREMENT
/begin MEASUREMENT iv_n_ist_em_fl_has_l2 "EM-Istdrehzahl" FLOAT32_IEEE n_fl_S6_S3 1 100 -3.40282e+038 3.40282e+038 ECU_ADDRESS 0xFFF85F10 /end MEASUREMENT
/begin MEASUREMENT iv_n_ist_em_has_l2 "EM-Istdrehzahl" UWORD n_int_S6_S3 1 100 0 65535 ECU_ADDRESS 0xFFF860F4 /end MEASUREMENT
/begin MEASUREMENT iv_n_ist_tu_fl_has_l2 "Turbinendrehzahl (Getriebeeingang nach Entkopplungselement)" FLOAT32_IEEE n_fl_S6_S3 1 100 -3.40282e+038 3.40282e+038 ECU_ADDRESS 0xFFF85F14 /end MEASUREMENT
/begin MEASUREMENT iv_n_ist_tu_has_l2 "Turbinendrehzahl (Getriebeeingang nach Entkopplungselement)" UWORD n_int_S6_S3 1 100 0 65535 ECU_ADDRESS 0xFFF860F6 /end MEASUREMENT
/begin MEASUREMENT iv_n_ist_vm_fl_has_l2 "VM-Istdrehzahl" FLOAT32_IEEE n_fl_S6_S3 1 100 -3.40282e+038 3.40282e+038 ECU_ADDRESS 0xFFF85F18 /end MEASUREMENT
/begin MEASUREMENT iv_n_ist_vm_has_l2 "VM-Istdrehzahl" UWORD n_int_S6_S3 1 100 0 65535 ECU_ADDRESS 0xFFF860F8 /end MEASUREMENT
/begin MEASUREMENT iv_n_mot_llsoll_fl_has_l2 "EM-Minimaldrehzahl von der HAS" FLOAT32_IEEE void_fl_S6_S3 1 100 -3.40282e+038 3.40282e+038 ECU_ADDRESS 0xFFF85F1C /end MEASUREMENT
/begin MEASUREMENT iv_n_mot_llsoll_has_l2 "EM-Minimaldrehzahl von der HAS" UBYTE void_int_S6_S3 1 100 0 255 ECU_ADDRESS 0xFFF866C1 /end MEASUREMENT
/begin MEASUREMENT iv_n_soll_em_fl_has_l2 "EM-Solldrehzahl von der HAS" FLOAT32_IEEE n_fl_S6_S3 1 100 -3.40282e+038 3.40282e+038 ECU_ADDRESS 0xFFF85F20 /end MEASUREMENT
/begin MEASUREMENT iv_n_soll_em_has_l2 "EM-Solldrehzahl von der HAS" UWORD n_int_S6_S3 1 100 0 65535 ECU_ADDRESS 0xFFF860FA /end MEASUREMENT
/begin MEASUREMENT iv_n_soll_vm_fl_has_l2 "VM-Solldrehzahl von der HAS" FLOAT32_IEEE n_fl_S6_S3 1 100 -3.40282e+038 3.40282e+038 ECU_ADDRESS 0xFFF85F24 /end MEASUREMENT
/begin MEASUREMENT iv_n_soll_vm_has_l2 "VM-Solldrehzahl von der HAS" UWORD n_int_S6_S3 1 100 0 65535 ECU_ADDRESS 0xFFF860FC /end MEASUREMENT
/begin MEASUREMENT iv_st_m_fahrerwunsch_fl_has_l2 "Status des Signals des Fahrer-wunschmomentes (FPU-Pfad)" FLOAT32_IEEE void_fl_S6_S3 1 100 0 2 ECU_ADDRESS 0xFFF85F28 /end MEASUREMENT
/begin MEASUREMENT iv_st_m_fahrerwunsch_has_l2 "Status des Signals des Fahrer-wunschmomentes" UBYTE void_int_S6_S3 1 100 0 2 ECU_ADDRESS 0xFFF866C2 /end MEASUREMENT
/begin MEASUREMENT iv_st_m_ist_em_fl_has_l2 "Status des EM-Istmomentensignals" FLOAT32_IEEE void_fl_S6_S3 1 100 -3.40282e+038 3.40282e+038 ECU_ADDRESS 0xFFF85F2C /end MEASUREMENT
/begin MEASUREMENT iv_st_m_ist_em_has_l2 "Status des EM-Istmomentensignals" UBYTE void_int_S6_S3 1 100 0 255 ECU_ADDRESS 0xFFF866C3 /end MEASUREMENT
/begin MEASUREMENT iv_st_m_ist_vm_fl_has_l2 "Status des VM-Istmomentensignals" FLOAT32_IEEE void_fl_S6_S3 1 100 -3.40282e+038 3.40282e+038 ECU_ADDRESS 0xFFF85F30 /end MEASUREMENT
/begin MEASUREMENT iv_st_m_ist_vm_has_l2 "Status des VM-Istmomentensignals" UBYTE void_int_S6_S3 1 100 0 255 ECU_ADDRESS 0xFFF866C4 /end MEASUREMENT
/begin MEASUREMENT iv_st_m_me_red_fl_has_l2 "Status des Motoreingriffs" FLOAT32_IEEE void_fl_S6_S3 1 100 -3.40282e+038 3.40282e+038 ECU_ADDRESS 0xFFF85F34 /end MEASUREMENT
/begin MEASUREMENT iv_st_m_me_red_has_l2 "Status des Motoreingriffs" UBYTE void_int_S6_S3 1 100 0 255 ECU_ADDRESS 0xFFF866C5 /end MEASUREMENT
/begin MEASUREMENT iv_st_m_motsoll_fl_has_l2 "Status des Signals der Motorsollmomentensumme (Fahrerwunsch)" FLOAT32_IEEE void_fl_S6_S3 1 100 -3.40282e+038 3.40282e+038 ECU_ADDRESS 0xFFF85F38 /end MEASUREMENT
/begin MEASUREMENT iv_st_m_motsoll_has_l2 "Status des Signals der Motorsollmomentensumme (Fahrerwunsch)" UBYTE void_int_S6_S3 1 100 0 255 ECU_ADDRESS 0xFFF866C6 /end MEASUREMENT
/begin MEASUREMENT iv_st_m_motverlust_fl_has_l2 "Status des Motorverlustmomentensignals (FPU-Pfad)" FLOAT32_IEEE void_fl_S6_S3 1 100 -3.40282e+038 3.40282e+038 ECU_ADDRESS 0xFFF85F3C /end MEASUREMENT
/begin MEASUREMENT iv_st_m_motverlust_has_l2 "Status des Motorverlustmomentensignals (FPU-Pfad)" UBYTE void_int_S6_S3 1 100 0 255 ECU_ADDRESS 0xFFF866C7 /end MEASUREMENT
/begin MEASUREMENT iv_st_m_soll_em_fl_has_l2 "Status des EM-Momenteneingriffs von der HAS" FLOAT32_IEEE void_fl_S6_S3 1 100 -3.40282e+038 3.40282e+038 ECU_ADDRESS 0xFFF85F40 /end MEASUREMENT
/begin MEASUREMENT iv_st_m_soll_em_has_l2 "Status des EM-Momenteneingriffs von der HAS" UBYTE void_int_S6_S3 1 100 0 255 ECU_ADDRESS 0xFFF866C8 /end MEASUREMENT
/begin MEASUREMENT iv_st_n_ist_ab_fl_has_l2 "Status des Abtriebssdrehzahlsignals" FLOAT32_IEEE void_fl_S6_S3 1 100 -3.40282e+038 3.40282e+038 ECU_ADDRESS 0xFFF85F44 /end MEASUREMENT
/begin MEASUREMENT iv_st_n_ist_ab_has_l2 "Status des Abtriebssdrehzahlsignals" UBYTE void_int_S6_S3 1 100 0 255 ECU_ADDRESS 0xFFF866C9 /end MEASUREMENT
/begin MEASUREMENT iv_st_n_ist_em_fl_has_l2 "Status des EM-Istdrehzahlsignals" FLOAT32_IEEE void_fl_S6_S3 1 100 -3.40282e+038 3.40282e+038 ECU_ADDRESS 0xFFF85F48 /end MEASUREMENT
/begin MEASUREMENT iv_st_n_ist_em_has_l2 "Status des EM-Istdrehzahlsignals" UBYTE void_int_S6_S3 1 100 0 255 ECU_ADDRESS 0xFFF866CA /end MEASUREMENT
/begin MEASUREMENT iv_st_n_ist_tu_fl_has_l2 "Status des Turbinendrehzahlsignals" FLOAT32_IEEE void_fl_S6_S3 1 100 -3.40282e+038 3.40282e+038 ECU_ADDRESS 0xFFF85F4C /end MEASUREMENT
/begin MEASUREMENT iv_st_n_ist_tu_has_l2 "Status des Turbinendrehzahlsignals" UBYTE void_int_S6_S3 1 100 0 255 ECU_ADDRESS 0xFFF866CB /end MEASUREMENT
/begin MEASUREMENT iv_st_n_ist_vm_fl_has_l2 "Status des VM-Istdrehzahlsignals" FLOAT32_IEEE void_fl_S6_S3 1 100 -3.40282e+038 3.40282e+038 ECU_ADDRESS 0xFFF85F50 /end MEASUREMENT
/begin MEASUREMENT iv_st_n_ist_vm_has_l2 "Status des VM-Istdrehzahlsignals" UBYTE void_int_S6_S3 1 100 0 255 ECU_ADDRESS 0xFFF866CC /end MEASUREMENT
/begin MEASUREMENT iv_st_n_soll_em_fl_has_l2 "Status der EM-Solldrehzahlvorgabe von der HAS" FLOAT32_IEEE void_fl_S6_S3 1 100 -3.40282e+038 3.40282e+038 ECU_ADDRESS 0xFFF85F54 /end MEASUREMENT
/begin MEASUREMENT iv_st_n_soll_em_has_l2 "Status der EM-Solldrehzahlvorgabe von der HAS" UBYTE void_int_S6_S3 1 100 0 255 ECU_ADDRESS 0xFFF866CD /end MEASUREMENT
/begin MEASUREMENT iv_st_n_soll_vm_fl_has_l2 "Status der VM-Solldrehzahlvorgabe von der HAS" FLOAT32_IEEE void_fl_S6_S3 1 100 -3.40282e+038 3.40282e+038 ECU_ADDRESS 0xFFF85F58 /end MEASUREMENT
/begin MEASUREMENT iv_st_n_soll_vm_has_l2 "Status der VM-Solldrehzahlvorgabe von der HAS" UBYTE void_int_S6_S3 1 100 0 255 ECU_ADDRESS 0xFFF866CE /end MEASUREMENT
/begin MEASUREMENT iv_z_pos_fl_has_l2 "aktuelle Stellung des Positionshebels" FLOAT32_IEEE void_fl_S6_S3 1 100 -3.40282e+038 3.40282e+038 ECU_ADDRESS 0xFFF85F5C /end MEASUREMENT
/begin MEASUREMENT iv_z_pos_has_l2 "aktuelle Stellung des Positionshebels" UBYTE void_int_S6_S3 1 100 0 255 ECU_ADDRESS 0xFFF866CF /end MEASUREMENT
/begin MEASUREMENT m_em_in "" FLOAT32_IEEE trq_fl_a_S6_S3 1 100 -1024 1024 ECU_ADDRESS 0xFFF85DE0 /end MEASUREMENT
/begin MEASUREMENT m_fahrerwunsch_fl_has_l2 "Fahrerwunschmoment aus Fahrpedalinterpretation (FPU-Pfad)" FLOAT32_IEEE trq_fl_a_S6_S3 1 100 -3.40282e+038 3.40282e+038 ECU_ADDRESS 0xFFF85F60 /end MEASUREMENT
/begin MEASUREMENT m_fahrerwunsch_has_l2 "Fahrerwunschmoment aus Fahrpedalinterpretation" SWORD trq_fl_S6_S3 1 100 -32768 32767 ECU_ADDRESS 0xFFF860FE /end MEASUREMENT
/begin MEASUREMENT m_iae_in "" FLOAT32_IEEE trq_fl_a_S6_S3 1 100 -32768 32767 ECU_ADDRESS 0xFFF85DE4 /end MEASUREMENT
/begin MEASUREMENT m_ist_em_fl_has_l2 "EM-Istmoment" FLOAT32_IEEE trq_fl_a_S6_S3 1 100 -3.40282e+038 3.40282e+038 ECU_ADDRESS 0xFFF85F64 /end MEASUREMENT
/begin MEASUREMENT m_ist_em_has_l2 "EM-Istmoment" SWORD trq_fl_S6_S3 1 100 -32768 32767 ECU_ADDRESS 0xFFF86100 /end MEASUREMENT
/begin MEASUREMENT m_ist_vm_fl_has_l2 "VM-Istmoment" FLOAT32_IEEE trq_fl_a_S6_S3 1 100 -3.40282e+038 3.40282e+038 ECU_ADDRESS 0xFFF85F68 /end MEASUREMENT
/begin MEASUREMENT m_ist_vm_has_l2 "VM-Istmoment" SWORD trq_fl_S6_S3 1 100 -32768 32767 ECU_ADDRESS 0xFFF86102 /end MEASUREMENT
/begin MEASUREMENT m_k0_fkt "" FLOAT32_IEEE trq_fl_a_S6_S3 1 100 -1200 1200 ECU_ADDRESS 0xFFF85D48 /end MEASUREMENT
/begin MEASUREMENT m_k0_in "" FLOAT32_IEEE trq_fl_a_S6_S3 1 100 -32768 32767 ECU_ADDRESS 0xFFF85DE8 /end MEASUREMENT
/begin MEASUREMENT m_k0_mber_has_sbe "K0-Moment der HAS zur Motormomentbegrenzung in der SAB" FLOAT32_IEEE trq_fl_a_S6_S3 1 100 -3.40282e+038 3.40282e+038 ECU_ADDRESS 0xFFF85DC4 /end MEASUREMENT
/begin MEASUREMENT m_k0_mod_has_fkt "" FLOAT32_IEEE trq_fl_a_S6_S3 1 100 -1200 1200 ECU_ADDRESS 0xFFF85D4C /end MEASUREMENT
/begin MEASUREMENT m_max_dyn_em_in "" FLOAT32_IEEE trq_fl_a_S6_S3 1 100 -32768 32767 ECU_ADDRESS 0xFFF85DEC /end MEASUREMENT
/begin MEASUREMENT m_max_em_has_fkt "" FLOAT32_IEEE trq_fl_a_S6_S3 1 100 -1200 1200 ECU_ADDRESS 0xFFF85D50 /end MEASUREMENT
/begin MEASUREMENT m_max_iae_has_fkt "" FLOAT32_IEEE trq_fl_a_S6_S3 1 100 -1200 1200 ECU_ADDRESS 0xFFF85D54 /end MEASUREMENT
/begin MEASUREMENT m_me_red_fl_has_l2 "Drehmoment des Motoreingriffs" FLOAT32_IEEE trq_fl_a_S6_S3 1 100 -3.40282e+038 3.40282e+038 ECU_ADDRESS 0xFFF85F6C /end MEASUREMENT
/begin MEASUREMENT m_me_red_has_l2 "Drehmoment des Motoreingriffs" SWORD trq_fl_S6_S3 1 100 -32768 32767 ECU_ADDRESS 0xFFF86104 /end MEASUREMENT
/begin MEASUREMENT m_min_dyn_em_in "" FLOAT32_IEEE trq_fl_a_S6_S3 1 100 -3.40282e+038 3.40282e+038 ECU_ADDRESS 0xFFF85DF0 /end MEASUREMENT
/begin MEASUREMENT m_min_em_has_fkt "" FLOAT32_IEEE trq_fl_a_S6_S3 1 100 -1200 1200 ECU_ADDRESS 0xFFF85D58 /end MEASUREMENT
/begin MEASUREMENT m_min_vm_in "" FLOAT32_IEEE trq_fl_a_S6_S3 1 100 -3.40282e+038 3.40282e+038 ECU_ADDRESS 0xFFF85E3C /end MEASUREMENT
/begin MEASUREMENT m_mot_in "" FLOAT32_IEEE trq_fl_a_S6_S3 1 100 -1024 1024 ECU_ADDRESS 0xFFF85DF4 /end MEASUREMENT
/begin MEASUREMENT m_motmax_fl_has_l2 "Max. zulaessiges Motormoment fuer Hybridantriebsstrang (gefuehrter Getriebeschutz) (FPU-Pfad)" FLOAT32_IEEE trq_fl_a_S6_S3 1 100 -3.40282e+038 3.40282e+038 ECU_ADDRESS 0xFFF85F70 /end MEASUREMENT
/begin MEASUREMENT m_motmax_has "" FLOAT32_IEEE trq_fl_a_S6_S3 1 100 -1200 1200 ECU_ADDRESS 0xFFF85DC8 /end MEASUREMENT
/begin MEASUREMENT m_motmax_has_l2 "Max. zulaessiges Motormoment fuer Hybridantriebsstrang (gefuehrter Getriebeschutz)" SWORD trq_fl_S6_S3 1 100 -32768 32767 ECU_ADDRESS 0xFFF86106 /end MEASUREMENT
/begin MEASUREMENT m_motsoll_fl_has_l2 "Motorsollmomentensumme (Fahrerwunsch)" FLOAT32_IEEE trq_fl_a_S6_S3 1 100 -3.40282e+038 3.40282e+038 ECU_ADDRESS 0xFFF85F74 /end MEASUREMENT
/begin MEASUREMENT m_motsoll_has_l2 "Motorsollmomentensumme (Fahrerwunsch)" SWORD trq_fl_S6_S3 1 100 -32768 32767 ECU_ADDRESS 0xFFF86108 /end MEASUREMENT
/begin MEASUREMENT m_motverlust_fl_has_l2 "Motorverlustmoment (FPU-Pfad)" FLOAT32_IEEE trq_fl_a_S6_S3 1 100 -3.40282e+038 3.40282e+038 ECU_ADDRESS 0xFFF85F78 /end MEASUREMENT
/begin MEASUREMENT m_motverlust_has_l2 "Motorverlustmoment" UWORD trq_fl_S6_S3 1 100 0 65535 ECU_ADDRESS 0xFFF8610A /end MEASUREMENT
/begin MEASUREMENT m_soll_em_fl_has_l2 "EM-Momenteneingriff von der HAS (FPU-Pfad)" FLOAT32_IEEE trq_fl_a_S6_S3 1 100 -3.40282e+038 3.40282e+038 ECU_ADDRESS 0xFFF85F7C /end MEASUREMENT
/begin MEASUREMENT m_soll_em_has_fkt "" FLOAT32_IEEE trq_fl_a_S6_S3 1 100 -1200 1200 ECU_ADDRESS 0xFFF85D5C /end MEASUREMENT
/begin MEASUREMENT m_soll_em_has_l2 "EM-Momenteneingriff von der HAS" SWORD trq_fl_S6_S3 1 100 -32768 32767 ECU_ADDRESS 0xFFF8610C /end MEASUREMENT
/begin MEASUREMENT m_soll_em_hst_in "" FLOAT32_IEEE trq_fl_a_S6_S3 1 100 -32768 32767 ECU_ADDRESS 0xFFF85DF8 /end MEASUREMENT
/begin MEASUREMENT m_soll_k0_has_fkt "" FLOAT32_IEEE trq_fl_a_S6_S3 1 100 -1200 1200 ECU_ADDRESS 0xFFF85D60 /end MEASUREMENT
/begin MEASUREMENT m_soll_res_em_bas_sbe "" FLOAT32_IEEE trq_fl_a_S6_S3 1 100 -3.40282e+038 3.40282e+038 ECU_ADDRESS 0xFFF85DCC /end MEASUREMENT
/begin MEASUREMENT m_soll_res_em_has_fkt "" FLOAT32_IEEE trq_fl_a_S6_S3 1 100 -1200 1200 ECU_ADDRESS 0xFFF85D64 /end MEASUREMENT
/begin MEASUREMENT m_soll_res_em_has_sbe "" FLOAT32_IEEE trq_fl_a_S6_S3 1 100 -3.40282e+038 3.40282e+038 ECU_ADDRESS 0xFFF85DD0 /end MEASUREMENT
/begin MEASUREMENT m_soll_vm_has_fkt "" FLOAT32_IEEE trq_fl_a_S6_S3 1 100 -1200 1200 ECU_ADDRESS 0xFFF85D68 /end MEASUREMENT
/begin MEASUREMENT m_soll_vm_hst_in "" FLOAT32_IEEE trq_fl_a_S6_S3 1 100 -32768 32767 ECU_ADDRESS 0xFFF85DFC /end MEASUREMENT
/begin MEASUREMENT m_soll_vm_l_has_fkt "" FLOAT32_IEEE trq_fl_a_S6_S3 1 100 -1200 1200 ECU_ADDRESS 0xFFF85D6C /end MEASUREMENT
/begin MEASUREMENT m_soll_vm_l_hst_in "" FLOAT32_IEEE trq_fl_a_S6_S3 1 100 -3.40282e+038 3.40282e+038 ECU_ADDRESS 0xFFF85E40 /end MEASUREMENT
/begin MEASUREMENT m_verlust_nemmin_fl_has_l2 "Motorverlustmoment  (FPU-Pfad)" FLOAT32_IEEE trq_fl_a_S6_S3 1 100 0 1023 ECU_ADDRESS 0xFFF85F80 /end MEASUREMENT
/begin MEASUREMENT m_verlust_nemmin_has_l2 "Motorverlustmoment" UWORD trq_fl_S6_S3 1 100 0 1023 ECU_ADDRESS 0xFFF8610E /end MEASUREMENT
/begin MEASUREMENT m_verlust_nemsoll_fl_has_l2 "Motorverlustmoment  (FPU-Pfad)" FLOAT32_IEEE trq_fl_a_S6_S3 1 100 0 1023 ECU_ADDRESS 0xFFF85F84 /end MEASUREMENT
/begin MEASUREMENT m_verlust_nemsoll_has_l2 "Motorverlustmoment" UWORD trq_fl_S6_S3 1 100 0 1023 ECU_ADDRESS 0xFFF86110 /end MEASUREMENT
/begin MEASUREMENT m_verlust_nvmsoll_fl_has_l2 "Motorverlustmoment  (FPU-Pfad)" FLOAT32_IEEE trq_fl_a_S6_S3 1 100 0 1023 ECU_ADDRESS 0xFFF85F88 /end MEASUREMENT
/begin MEASUREMENT m_verlust_nvmsoll_has_l2 "Motorverlustmoment" UWORD trq_fl_S6_S3 1 100 0 1023 ECU_ADDRESS 0xFFF86112 /end MEASUREMENT
/begin MEASUREMENT m_vm_in "" FLOAT32_IEEE trq_fl_a_S6_S3 1 100 -1024 1023.5 ECU_ADDRESS 0xFFF85E00 /end MEASUREMENT
/begin MEASUREMENT m_vm_start_in "" FLOAT32_IEEE trq_fl_a_S6_S3 1 100 -1024 1023.5 ECU_ADDRESS 0xFFF85E04 /end MEASUREMENT
/begin MEASUREMENT m_wunsch_fpw_hst_fil "" FLOAT32_IEEE trqg_fl_c_S6_S3 1 100 -2000 2000 ECU_ADDRESS 0xFFF85D94 /end MEASUREMENT
/begin MEASUREMENT m_wunsch_fpw_hst_in "" FLOAT32_IEEE trq_fl_a_S6_S3 1 100 -3.40282e+038 3.40282e+038 ECU_ADDRESS 0xFFF85E44 /end MEASUREMENT
/begin MEASUREMENT m_wunsch_fpw_in "" FLOAT32_IEEE trq_fl_a_S6_S3 1 100 -32768 32767 ECU_ADDRESS 0xFFF85E08 /end MEASUREMENT
/begin MEASUREMENT mg_max_em_has_fkt "" FLOAT32_IEEE trqg_fl_c_S6_S3 1 100 -3000 3000 ECU_ADDRESS 0xFFF85D70 /end MEASUREMENT
/begin MEASUREMENT mg_min_em_has_fkt "" FLOAT32_IEEE trqg_fl_c_S6_S3 1 100 -3000 3000 ECU_ADDRESS 0xFFF85D74 /end MEASUREMENT
/begin MEASUREMENT mg_soll_k0_has_fkt "" FLOAT32_IEEE trqg_fl_c_S6_S3 1 100 -3000 3000 ECU_ADDRESS 0xFFF85D7C /end MEASUREMENT
/begin MEASUREMENT mg_wunsch_fpw "" FLOAT32_IEEE trqg_fl_c_S6_S3 1 100 -2000 2000 ECU_ADDRESS 0xFFF85D98 /end MEASUREMENT
/begin MEASUREMENT mg_wunsch_fpw_hst "" FLOAT32_IEEE trqg_fl_c_S6_S3 1 100 -2000 2000 ECU_ADDRESS 0xFFF85D9C /end MEASUREMENT
/begin MEASUREMENT mo_mered_nemmin_fl_has_l2 "Drehmoment des Motoreingriffs  (FPU-Pfad)" FLOAT32_IEEE trq_fl_a_S6_S3 1 100 -32767 32768 ECU_ADDRESS 0xFFF85F8C /end MEASUREMENT
/begin MEASUREMENT mo_mered_nemmin_has_l2 "Drehmoment des Motoreingriffs" SWORD trq_fl_S6_S3 1 100 -32768 32767 ECU_ADDRESS 0xFFF86114 /end MEASUREMENT
/begin MEASUREMENT mo_mered_nvmsoll_fl_has_l2 "Drehmoment des Motoreingriffs  (FPU-Pfad)" FLOAT32_IEEE trq_fl_a_S6_S3 1 100 -3.40282e+038 3.40282e+038 ECU_ADDRESS 0xFFF85F90 /end MEASUREMENT
/begin MEASUREMENT mo_mered_nvmsoll_has_l2 "Drehmoment des Motoreingriffs" SWORD trq_fl_S6_S3 1 100 -32768 32767 ECU_ADDRESS 0xFFF86116 /end MEASUREMENT
/begin MEASUREMENT mo_tolem_memstoer_fl_has_l2 "Momentenoffset, der bei Beruecksichtigung des VM-Motorhochlaufs zusaetzlich toleriert wird (FPU-Pfad)" FLOAT32_IEEE trq_fl_a_S6_S3 1 100 -3.40282e+038 3.40282e+038 ECU_ADDRESS 0xFFF85F94 /end MEASUREMENT
/begin MEASUREMENT mo_tolem_memstoer_has_l2 "Momentenoffset, der bei Beruecksichtigung des VM-Motorhochlaufs zusaetzlich toleriert wird" SWORD trq_fl_S6_S3 1 100 -32768 32767 ECU_ADDRESS 0xFFF86118 /end MEASUREMENT
/begin MEASUREMENT mod_K0_fkt "" UBYTE void_int_S6_S3 1 100 0 50 ECU_ADDRESS 0xFFF8663A /end MEASUREMENT
/begin MEASUREMENT n_ab_egs_in "" FLOAT32_IEEE n_fl_S6_S3 1 100 0 65535 ECU_ADDRESS 0xFFF85E0C /end MEASUREMENT
/begin MEASUREMENT n_em_in "" FLOAT32_IEEE n_fl_S6_S3 1 100 -3.40282e+038 3.40282e+038 ECU_ADDRESS 0xFFF85E10 /end MEASUREMENT
/begin MEASUREMENT n_ist_ab_fl_has_l2 "Abtriebsistdrehzahl (FPU-Pfad)" FLOAT32_IEEE n_fl_S6_S3 1 100 -3.40282e+038 3.40282e+038 ECU_ADDRESS 0xFFF85F98 /end MEASUREMENT
/begin MEASUREMENT n_ist_ab_has_l2 "Abtriebsistdrehzahl" UWORD n_int_S6_S3 1 100 0 65535 ECU_ADDRESS 0xFFF8611A /end MEASUREMENT
/begin MEASUREMENT n_ist_em_fl_has_l2 "EM-Istdrehzahl" FLOAT32_IEEE n_fl_S6_S3 1 100 -3.40282e+038 3.40282e+038 ECU_ADDRESS 0xFFF85F9C /end MEASUREMENT
/begin MEASUREMENT n_ist_em_has_l2 "EM-Istdrehzahl" UWORD n_int_S6_S3 1 100 0 65535 ECU_ADDRESS 0xFFF8611C /end MEASUREMENT
/begin MEASUREMENT n_ist_tu_fl_has_l2 "Turbinendrehzahl (Getriebeeingang nach Entkopplungselement) (FPU-Pfad)" FLOAT32_IEEE n_fl_S6_S3 1 100 -3.40282e+038 3.40282e+038 ECU_ADDRESS 0xFFF85FA0 /end MEASUREMENT
/begin MEASUREMENT n_ist_tu_has_l2 "Turbinendrehzahl (Getriebeeingang nach Entkopplungselement)" UWORD n_int_S6_S3 1 100 0 65535 ECU_ADDRESS 0xFFF8611E /end MEASUREMENT
/begin MEASUREMENT n_ist_vm_fl_has_l2 "VM-Istdrehzahl (FPU-Pfad)" FLOAT32_IEEE n_fl_S6_S3 1 100 -3.40282e+038 3.40282e+038 ECU_ADDRESS 0xFFF85FA4 /end MEASUREMENT
/begin MEASUREMENT n_ist_vm_has_l2 "VM-Istdrehzahl" UWORD n_int_S6_S3 1 100 0 65535 ECU_ADDRESS 0xFFF86120 /end MEASUREMENT
/begin MEASUREMENT n_min_em_has_sbe "Minimale EM Drehzahl der Leerlaufsimulation der HAS (LLS)" FLOAT32_IEEE n_fl_S6_S3 1 100 -32767 32767 ECU_ADDRESS 0xFFF85DD4 /end MEASUREMENT
/begin MEASUREMENT n_min_psys_em_has_bas "Basiswert der minimalen EM Drehlzahl zur Sicherstellung Ölversorgung" FLOAT32_IEEE n_fl_S6_S3 1 100 0 10000 ECU_ADDRESS 0xFFF9647C /end MEASUREMENT
/begin MEASUREMENT n_min_psys_em_has_mod "Modifizierter Basiswert der minimalen EM Drehlzahl zur Sicherstellung Ölversorgung" FLOAT32_IEEE n_fl_S6_S3 1 100 0 10000 ECU_ADDRESS 0xFFF96480 /end MEASUREMENT
/begin MEASUREMENT n_min_psys_em_has_ngbegr "Nicht gradientenbegrenzter, modifizierter Modifizierter Basiswert der minimalen EM Drehlzahl zur Sicherstellung Ölversorgung" FLOAT32_IEEE n_fl_S6_S3 1 100 0 10000 ECU_ADDRESS 0xFFF96484 /end MEASUREMENT
/begin MEASUREMENT n_min_psys_em_has_ref "Referenzwert der minimalen EM Drehlzahl zur Sicherstellung Ölversorgung" FLOAT32_IEEE n_fl_S6_S3 1 100 0 10000 ECU_ADDRESS 0xFFF96488 /end MEASUREMENT
/begin MEASUREMENT n_min_psys_em_has_sbe "Minimale EM Drehzahl zur Sicherstellung Ölversorgung" FLOAT32_IEEE n_fl_S6_S3 1 100 -32767 32767 ECU_ADDRESS 0xFFF85DA0 /end MEASUREMENT
/begin MEASUREMENT n_mot_llsoll_fl_has_l2 "EM-Minimaldrehzahl von der HAS" FLOAT32_IEEE n_fl_S6_S3 1 100 -3.40282e+038 3.40282e+038 ECU_ADDRESS 0xFFF85FA8 /end MEASUREMENT
/begin MEASUREMENT n_mot_llsoll_has_l2 "EM-Minimaldrehzahl von der HAS" UWORD n_int_S6_S3 1 100 0 65535 ECU_ADDRESS 0xFFF86122 /end MEASUREMENT
/begin MEASUREMENT n_mot_soll_iae_in "" FLOAT32_IEEE n_fl_S6_S3 1 100 -3.40282e+038 3.40282e+038 ECU_ADDRESS 0xFFF85E14 /end MEASUREMENT
/begin MEASUREMENT n_sec_iae "" FLOAT32_IEEE n_fl_S6_S3 1 100 -10000 10000 ECU_ADDRESS 0xFFF85DA4 /end MEASUREMENT
/begin MEASUREMENT n_soll_em_fl_has_l2 "EM-Solldrehzahl von der HAS" FLOAT32_IEEE n_fl_S6_S3 1 100 -3.40282e+038 3.40282e+038 ECU_ADDRESS 0xFFF85FAC /end MEASUREMENT
/begin MEASUREMENT n_soll_em_has_fkt "" FLOAT32_IEEE n_fl_S6_S3 1 100 0 8000 ECU_ADDRESS 0xFFF85D80 /end MEASUREMENT
/begin MEASUREMENT n_soll_em_has_l2 "EM-Solldrehzahl von der HAS" UWORD n_int_S6_S3 1 100 0 65535 ECU_ADDRESS 0xFFF86124 /end MEASUREMENT
/begin MEASUREMENT n_soll_em_hst_in "" FLOAT32_IEEE n_fl_S6_S3 1 100 -3.40282e+038 3.40282e+038 ECU_ADDRESS 0xFFF85E48 /end MEASUREMENT
/begin MEASUREMENT n_soll_ll_vm_in "" FLOAT32_IEEE n_fl_S6_S3 1 100 0 2540 ECU_ADDRESS 0xFFF85E18 /end MEASUREMENT
/begin MEASUREMENT n_soll_vm_fl_has_l2 "VM-Solldrehzahl von der HAS" FLOAT32_IEEE n_fl_S6_S3 1 100 -3.40282e+038 3.40282e+038 ECU_ADDRESS 0xFFF85FB0 /end MEASUREMENT
/begin MEASUREMENT n_soll_vm_has_fkt "" FLOAT32_IEEE n_fl_S6_S3 1 100 0 8000 ECU_ADDRESS 0xFFF85D84 /end MEASUREMENT
/begin MEASUREMENT n_soll_vm_has_l2 "VM-Solldrehzahl von der HAS" UWORD n_int_S6_S3 1 100 0 65535 ECU_ADDRESS 0xFFF86126 /end MEASUREMENT
/begin MEASUREMENT n_t_egs_in "" FLOAT32_IEEE n_fl_S6_S3 1 100 0 65535 ECU_ADDRESS 0xFFF85E1C /end MEASUREMENT
/begin MEASUREMENT n_vm_in "" FLOAT32_IEEE n_fl_S6_S3 1 100 0 65535 ECU_ADDRESS 0xFFF85E20 /end MEASUREMENT
/begin MEASUREMENT nd_getr_nemsoll_fl_has_l2 "berechneter Getriebeschlupf (FPU-Pfad)" FLOAT32_IEEE n_fl_S6_S3 1 100 -3.40282e+038 3.40282e+038 ECU_ADDRESS 0xFFF85FB4 /end MEASUREMENT
/begin MEASUREMENT nd_getr_nemsoll_has_l2 "berechneter Getriebeschlupf" SWORD n_int_S6_S3 1 100 -32768 32767 ECU_ADDRESS 0xFFF86128 /end MEASUREMENT
/begin MEASUREMENT nd_iae "" FLOAT32_IEEE n_fl_S6_S3 1 100 -10000 10000 ECU_ADDRESS 0xFFF85DA8 /end MEASUREMENT
/begin MEASUREMENT nd_k0_in "" FLOAT32_IEEE n_fl_S6_S3 1 100 -10000 10000 ECU_ADDRESS 0xFFF85DAC /end MEASUREMENT
/begin MEASUREMENT nd_soll_iae_fkt "Differenzdrehzahl der Anfahrkupplung" FLOAT32_IEEE ng_fl_S6_S3 1 100 -8000 8000 ECU_ADDRESS 0xFFF85D88 /end MEASUREMENT
/begin MEASUREMENT ndg_k0_in "" FLOAT32_IEEE ng_fl_S6_S3 1 100 -10000 10000 ECU_ADDRESS 0xFFF85DB0 /end MEASUREMENT
/begin MEASUREMENT ng_ist_vm_memstoer_fl_has_l2 "berechneter VM-Dehzhalgradient (FPU-Pfad)" FLOAT32_IEEE ng_fl_S6_S3 1 100 -3.40282e+038 3.40282e+038 ECU_ADDRESS 0xFFF85FB8 /end MEASUREMENT
/begin MEASUREMENT ng_ist_vm_memstoer_has_l2 "berechneter VM-Dehzhalgradient" SWORD ng_int_S6_S3 1 100 -32768 32767 ECU_ADDRESS 0xFFF8612A /end MEASUREMENT
/begin MEASUREMENT ng_vm "" FLOAT32_IEEE ng_fl_S6_S3 1 100 -10000 10000 ECU_ADDRESS 0xFFF85DB4 /end MEASUREMENT
/begin MEASUREMENT no_ndgetr_nemsoll_fl_has_l2 "Drehzahloffset zur Berechnung des Getriebeschlupfes, dass von der EM-Istdrehzahl subtrahiert wird" FLOAT32_IEEE n_fl_S6_S3 1 100 0 65535 ECU_ADDRESS 0xFFF85FBC /end MEASUREMENT
/begin MEASUREMENT no_ndgetr_nemsoll_has_l2 "Drehzahloffset zur Berechnung des Getriebeschlupfes, dass von der EM-Istdrehzahl subtrahiert wird" UWORD n_int_S6_S3 1 100 0 65535 ECU_ADDRESS 0xFFF8612C /end MEASUREMENT
/begin MEASUREMENT osmode_next_in "" UBYTE void_int_S6_S3 1 100 1 3 ECU_ADDRESS 0xFFF86679 /end MEASUREMENT
/begin MEASUREMENT p_bremse_fzg_in "" FLOAT32_IEEE p_fl_S6_S3 1 100 -32000 0 ECU_ADDRESS 0xFFF85E24 /end MEASUREMENT
/begin MEASUREMENT phi_neigung_in "Fahrzeug-Neigungswinkel" FLOAT32_IEEE void_fl_S6_S3 1 100 -3.40282e+038 3.40282e+038 ECU_ADDRESS 0xFFF85E28 /end MEASUREMENT
/begin MEASUREMENT pos_egs_in "Waehlhebelposition" UBYTE E_POS_S6_S3 1 100 0 8 ECU_ADDRESS 0xFFF8667A /end MEASUREMENT
/begin MEASUREMENT sollgang_egs_in "" SBYTE void_int_S6_S3 1 100 -128 127 ECU_ADDRESS 0xFFF8667B /end MEASUREMENT
/begin MEASUREMENT st_OMLID_act_stg "Innere Zustände der OML" UWORD void_int_b_S6_S3 1 100 0 4999 ECU_ADDRESS 0xFFF860CA /end MEASUREMENT
/begin MEASUREMENT st_ablauf_fkt "Phase des Ablauf" UWORD void_int_b_S6_S3 1 100 0 65535 ECU_ADDRESS 0xFFF860CC /end MEASUREMENT
/begin MEASUREMENT st_ist_bz_has_stg "Istzustand OML" UBYTE E_STBZHAS_S6_S3 1 100 0 15 ECU_ADDRESS 0xFFF86635 /end MEASUREMENT
/begin MEASUREMENT st_ist_bz_hst_sta "Ist-Betriebszustand aus der Startegieanpassung als Eingangsgroesse der Hybridzustandssteuerung (OML)" UBYTE E_STBZHAS_S6_S3 1 100 0 15 ECU_ADDRESS 0xFFF86668 /end MEASUREMENT
/begin MEASUREMENT st_m_fahrerwunsch_fl_has_l2 "Status des Signals des Fahrer-wunschmomentes (FPU-Pfad)" FLOAT32_IEEE void_fl_S6_S3 1 100 0 2 ECU_ADDRESS 0xFFF85FC0 /end MEASUREMENT
/begin MEASUREMENT st_m_fahrerwunsch_has_l2 "Status des Signals des Fahrer-wunschmomentes" UBYTE void_int_S6_S3 1 100 0 2 ECU_ADDRESS 0xFFF866D0 /end MEASUREMENT
/begin MEASUREMENT st_m_ist_em_fl_has_l2 "Status des EM-Istmomentensignals" FLOAT32_IEEE void_fl_S6_S3 1 100 -3.40282e+038 3.40282e+038 ECU_ADDRESS 0xFFF85FC4 /end MEASUREMENT
/begin MEASUREMENT st_m_ist_em_has_l2 "Status des EM-Istmomentensignals" UBYTE void_int_S6_S3 1 100 0 255 ECU_ADDRESS 0xFFF866D1 /end MEASUREMENT
/begin MEASUREMENT st_m_ist_vm_fl_has_l2 "Status des VM-Istmomentensignals" FLOAT32_IEEE void_fl_S6_S3 1 100 -3.40282e+038 3.40282e+038 ECU_ADDRESS 0xFFF85FC8 /end MEASUREMENT
/begin MEASUREMENT st_m_ist_vm_has_l2 "Status des VM-Istmomentensignals" UBYTE void_int_S6_S3 1 100 0 255 ECU_ADDRESS 0xFFF866D2 /end MEASUREMENT
/begin MEASUREMENT st_m_me_red_fl_has_l2 "Status des Motoreingriffs" FLOAT32_IEEE void_fl_S6_S3 1 100 -3.40282e+038 3.40282e+038 ECU_ADDRESS 0xFFF85FCC /end MEASUREMENT
/begin MEASUREMENT st_m_me_red_has_l2 "Status des Motoreingriffs" UBYTE void_int_S6_S3 1 100 0 255 ECU_ADDRESS 0xFFF866D3 /end MEASUREMENT
/begin MEASUREMENT st_m_motsoll_fl_has_l2 "Status des Signals der Motorsollmomentensumme (Fahrerwunsch)" FLOAT32_IEEE void_fl_S6_S3 1 100 -3.40282e+038 3.40282e+038 ECU_ADDRESS 0xFFF85FD0 /end MEASUREMENT
/begin MEASUREMENT st_m_motsoll_has_l2 "Status des Signals der Motorsollmomentensumme (Fahrerwunsch)" UBYTE void_int_S6_S3 1 100 0 255 ECU_ADDRESS 0xFFF866D4 /end MEASUREMENT
/begin MEASUREMENT st_m_motverlust_fl_has_l2 "Status des Motorverlustmomentensignals (FPU-Pfad)" FLOAT32_IEEE void_fl_S6_S3 1 100 -3.40282e+038 3.40282e+038 ECU_ADDRESS 0xFFF85FD4 /end MEASUREMENT
/begin MEASUREMENT st_m_motverlust_has_l2 "Status des Motorverlustmomentensignals (FPU-Pfad)" UBYTE void_int_S6_S3 1 100 0 255 ECU_ADDRESS 0xFFF866D5 /end MEASUREMENT
/begin MEASUREMENT st_m_soll_em_fl_has_l2 "Status des EM-Momenteneingriffs von der HAS (FPU-Pfad)" FLOAT32_IEEE void_fl_S6_S3 1 100 -3.40282e+038 3.40282e+038 ECU_ADDRESS 0xFFF85FD8 /end MEASUREMENT
/begin MEASUREMENT st_m_soll_em_has_l2 "Status des EM-Momenteneingriffs von der HAS" UBYTE void_int_S6_S3 1 100 0 255 ECU_ADDRESS 0xFFF866D6 /end MEASUREMENT
/begin MEASUREMENT st_n_ist_ab_fl_has_l2 "Status des Abtriebsdrehzahlsignals (FPU-Pfad)" FLOAT32_IEEE void_fl_S6_S3 1 100 -3.40282e+038 3.40282e+038 ECU_ADDRESS 0xFFF85FDC /end MEASUREMENT
/begin MEASUREMENT st_n_ist_ab_has_l2 "Status des Abtriebsdrehzahlsignals" UBYTE void_int_S6_S3 1 100 0 255 ECU_ADDRESS 0xFFF866D7 /end MEASUREMENT
/begin MEASUREMENT st_n_ist_em_fl_has_l2 "Status des EM-Istdrehzahlsignals" FLOAT32_IEEE void_fl_S6_S3 1 100 -3.40282e+038 3.40282e+038 ECU_ADDRESS 0xFFF85FE0 /end MEASUREMENT
/begin MEASUREMENT st_n_ist_em_has_l2 "Status des EM-Istdrehzahlsignals" UBYTE void_int_S6_S3 1 100 0 255 ECU_ADDRESS 0xFFF866D8 /end MEASUREMENT
/begin MEASUREMENT st_n_ist_tu_fl_has_l2 "Status des Turbinendrehzahlsignals (FPU-Pfad)" FLOAT32_IEEE void_fl_S6_S3 1 100 -3.40282e+038 3.40282e+038 ECU_ADDRESS 0xFFF85FE4 /end MEASUREMENT
/begin MEASUREMENT st_n_ist_tu_has_l2 "Status des Turbinendrehzahlsignals" UBYTE void_int_S6_S3 1 100 0 255 ECU_ADDRESS 0xFFF866D9 /end MEASUREMENT
/begin MEASUREMENT st_n_ist_vm_fl_has_l2 "Status des VM-Istdrehzahlsignals" FLOAT32_IEEE void_fl_S6_S3 1 100 -3.40282e+038 3.40282e+038 ECU_ADDRESS 0xFFF85FE8 /end MEASUREMENT
/begin MEASUREMENT st_n_ist_vm_has_l2 "Status des VM-Istdrehzahlsignals" UBYTE void_int_S6_S3 1 100 0 255 ECU_ADDRESS 0xFFF866DA /end MEASUREMENT
/begin MEASUREMENT st_n_soll_em_fl_has_l2 "Status der EM-Solldrehzahlvorgabe von der HAS" FLOAT32_IEEE void_fl_S6_S3 1 100 -3.40282e+038 3.40282e+038 ECU_ADDRESS 0xFFF85FEC /end MEASUREMENT
/begin MEASUREMENT st_n_soll_em_has_l2 "Status der EM-Solldrehzahlvorgabe von der HAS" UBYTE void_int_S6_S3 1 100 0 255 ECU_ADDRESS 0xFFF866DB /end MEASUREMENT
/begin MEASUREMENT st_n_soll_vm_fl_has_l2 "Status der VM-Solldrehzahlvorgabe von der HAS" FLOAT32_IEEE void_fl_S6_S3 1 100 -3.40282e+038 3.40282e+038 ECU_ADDRESS 0xFFF85FF0 /end MEASUREMENT
/begin MEASUREMENT st_n_soll_vm_has_l2 "Status der VM-Solldrehzahlvorgabe von der HAS" UBYTE void_int_S6_S3 1 100 0 255 ECU_ADDRESS 0xFFF866DC /end MEASUREMENT
/begin MEASUREMENT st_soll_bz_has_hst "interner HST Soll-Betriebszustand der Strategieanpassung (variantenunabhaengig)" UBYTE void_int_S6_S3 1 100 0 1 ECU_ADDRESS 0xFFF8669A /end MEASUREMENT
/begin MEASUREMENT st_soll_bz_hst_sta "Soll-Betriebszustand aus der Startegieanpassung als Eingangsgroesse der Hybridzustandssteuerung (OML)" UBYTE E_STBZHAS_S6_S3 1 100 0 15 ECU_ADDRESS 0xFFF86669 /end MEASUREMENT
/begin MEASUREMENT st_testmode_hs_azg "Testmode" UBYTE void_int_S6_S3 1 100 0 255 ECU_ADDRESS 0xFFF96D5E /end MEASUREMENT
/begin MEASUREMENT st_ziel_bz_has_stg "Zielzustand OML" UBYTE E_STBZHAS_S6_S3 1 100 0 15 ECU_ADDRESS 0xFFF86636 /end MEASUREMENT
/begin MEASUREMENT st_ziel_bz_hst_mod_azg "Modifizierter Antriebsstrang Ziel-Zustand" UBYTE void_int_S6_S3 1 100 0 255 ECU_ADDRESS 0xFFF96D61 /end MEASUREMENT
/begin MEASUREMENT status_ablauf_has_fkt "" UBYTE void_int_S6_S3 1 100 0 50 ECU_ADDRESS 0xFFF8663B /end MEASUREMENT
/begin MEASUREMENT status_alaengs_adaoff_in "Information, ob die Adaptionen aufgrund erkannter Laengsbeschleunigung deaktiviert wird. 0 = Adaption aktiv aufgrund erkannter Laengsbeschleunigung
1 = Adaption inaktiv aufgrund nicht erkannter Laengsbeschleunigung" UBYTE void_int_S6_S3 1 100 0 1 ECU_ADDRESS 0xFFF8667C /end MEASUREMENT
/begin MEASUREMENT status_betriebsbereit_hst_in "" UBYTE void_int_S6_S3 1 100 0 1 ECU_ADDRESS 0xFFF8669B /end MEASUREMENT
/begin MEASUREMENT status_efahren_has_sbe "Status E-Fahren der HAS zur Festlegung der entsprechenden Portout-Größe in der HAS Signalaufbereitung_Out" UBYTE void_int_S6_S3 1 100 0 1 ECU_ADDRESS 0xFFF8665A /end MEASUREMENT
/begin MEASUREMENT status_fehler15_eh_diagin "Info vom Errorhandler ob Ersatzfkt. aktiv" UBYTE void_int_S6_S3 1 100 0 1 ECU_ADDRESS 0xFFF8662E /end MEASUREMENT
/begin MEASUREMENT status_fehler_iep_in "" UBYTE E_FEHLERIEP_S6_S3 1 100 0 1 ECU_ADDRESS 0xFFF8667D /end MEASUREMENT
/begin MEASUREMENT status_iae_adap_in "Status der Adaption des Integrierten Anfahrelements IAE" UBYTE E_STATUSADA_S6_S3 1 100 0 2 ECU_ADDRESS 0xFFF8667E /end MEASUREMENT
/begin MEASUREMENT status_iae_in "" UBYTE E_STATUSIAE_S6_S3 1 100 0 8 ECU_ADDRESS 0xFFF8667F /end MEASUREMENT
/begin MEASUREMENT status_iep_in "" UBYTE E_STATUSIEP_S6_S3 1 100 0 4 ECU_ADDRESS 0xFFF86680 /end MEASUREMENT
/begin MEASUREMENT status_k0_adap_in "" UBYTE E_STATUSADA_S6_S3 1 100 0 2 ECU_ADDRESS 0xFFF86681 /end MEASUREMENT
/begin MEASUREMENT status_k0_in "" UBYTE E_STATUSK0_S6_S3 1 100 0 5 ECU_ADDRESS 0xFFF86682 /end MEASUREMENT
/begin MEASUREMENT status_kl15_in "" UBYTE void_int_S6_S3 1 100 0 1 ECU_ADDRESS 0xFFF8669C /end MEASUREMENT
/begin MEASUREMENT status_kolbenpos_k0_in "" UBYTE void_int_S6_S3 1 100 0 255 ECU_ADDRESS 0xFFF86683 /end MEASUREMENT
/begin MEASUREMENT status_kraftfluss_egs_in "" UBYTE E_STATUSKSL_S6_S3 1 100 0 6 ECU_ADDRESS 0xFFF86684 /end MEASUREMENT
/begin MEASUREMENT status_kraftfluss_egs_roh_in "" UBYTE void_int_S6_S3 1 100 0 255 ECU_ADDRESS 0xFFF86685 /end MEASUREMENT
/begin MEASUREMENT status_ll_vm_in "" UBYTE void_int_S6_S3 1 100 0 255 ECU_ADDRESS 0xFFF86686 /end MEASUREMENT
/begin MEASUREMENT status_nem_in "Status zur Drehzahl E-Motor" UBYTE E_SIGSTATUS_S6_S3 1 100 0 2 ECU_ADDRESS 0xFFF86687 /end MEASUREMENT
/begin MEASUREMENT status_nreg_em_hst_in "Status E-Motor Drehzahlregelung der HST" UBYTE void_int_S6_S3 1 100 0 255 ECU_ADDRESS 0xFFF8669D /end MEASUREMENT
/begin MEASUREMENT status_nvm_in "Status zur Drehzahl VM-Motor" UBYTE E_SIGSTATUS_S6_S3 1 100 0 2 ECU_ADDRESS 0xFFF86688 /end MEASUREMENT
/begin MEASUREMENT status_posvueb_in "Erkennung PosV Diagnose" UBYTE void_int_S6_S3 1 100 0 255 ECU_ADDRESS 0xFFF86689 /end MEASUREMENT
/begin MEASUREMENT status_psys_em_has_nverz "status_psys_em_has_nverz" UBYTE E_STATUSPSY_S6_S3 1 100 0 4 ECU_ADDRESS 0xFFF96D71 /end MEASUREMENT
/begin MEASUREMENT status_psys_has_sbe "" UBYTE E_STATUSPSY_S6_S3 1 100 0 4 ECU_ADDRESS 0xFFF86654 /end MEASUREMENT
/begin MEASUREMENT status_sa_vm_in "00 Keine Beeinflussung; 01 Schubabschaltung aktiv; 10 Nicht stellbarer Bereich; 11 Signal ungültig" UBYTE void_int_S6_S3 1 100 0 3 ECU_ADDRESS 0xFFF8669E /end MEASUREMENT
/begin MEASUREMENT status_schaltart_svh_has_sbe "Schaltart der angeforderten Schaltung der Schaltverhinderung der HAS (0 = keine Schaltung angefordert) - Bit-Codierung (m/oL=mit/ohne Lanstanh.)=: bit0=ZRSmL,1=ZHSmL,2=SRSmL,3=SHSmL,4=ZRSoL,5=ZHSoL,6=SRSoL,7=SHSoL" UBYTE void_int_S6_S3 1 100 0 255 ECU_ADDRESS 0xFFF8665B /end MEASUREMENT
/begin MEASUREMENT status_schaltung_egs_in "" SBYTE void_int_S6_S3 1 100 -9 9 ECU_ADDRESS 0xFFF86655 /end MEASUREMENT
/begin MEASUREMENT status_sync_schaltung_sbe "Anzeige der Synchronerkennung der aktuellen Schaltung innerhalb der HAS" UBYTE void_int_S6_S3 1 100 0 1 ECU_ADDRESS 0xFFF86656 /end MEASUREMENT
/begin MEASUREMENT status_waschstr_in "" UBYTE void_int_S6_S3 1 100 0 255 ECU_ADDRESS 0xFFF8668A /end MEASUREMENT
/begin MEASUREMENT status_zug_svh_sbe "Status für Anzeige Zug/Schub" UBYTE void_int_S6_S3 1 100 0 1 ECU_ADDRESS 0xFFF8665C /end MEASUREMENT
/begin MEASUREMENT swi_komp_fehler_1_has_l2 "Schalter, um einen Komplementfehler zu provozieren" UWORD void_int_b_S6_S3 1 100 0 65535 ECU_ADDRESS 0xFFF8612E /end MEASUREMENT
/begin MEASUREMENT swi_komp_fehler_2_has_l2 "Schalter, um einen Komplementfehler zu provozieren" UWORD void_int_b_S6_S3 1 100 0 65535 ECU_ADDRESS 0xFFF86130 /end MEASUREMENT
/begin MEASUREMENT t_aktiv_pvu_has "Timer fuer Zeitraum nach Erkennung der Betriebsbereitschaft des Hybridsystems in dem die Unterstuetzung der Positionsventilueberwachung durch die HAS aktiv ist." FLOAT32_IEEE t_fl_S6_S3 1 100 -3.40282e+038 3.40282e+038 ECU_ADDRESS 0xFFF96494 /end MEASUREMENT
/begin MEASUREMENT t_anfmax_pvu_has "Timer für den maximaler Zeitraum nach Überschreiten der EM-Drehzahlschwelle zur Aktivierung der Überwachung durch die Diagnose bei der Unterstützung der Positionsventil-Überwachung der HAS" FLOAT32_IEEE t_fl_S6_S3 1 100 0 5 ECU_ADDRESS 0xFFF8521C /end MEASUREMENT
/begin MEASUREMENT t_betrieb_pvu_has_ee_in "" ULONG t_int_S6_S3 1 100 0 10000 ECU_ADDRESS 0xFFF85E2C /end MEASUREMENT
/begin MEASUREMENT t_betrieb_pvu_has_sbe "Betriebsdauer seit dem letzten Ablauf der Diagnosefunktion \"Positionsventil-Überwachung\" der Funktion zur Unterstüt-zung der Positionsventil-Überwachung der HAS" FLOAT32_IEEE t_fl_S6_S3 1 100 0 1000000 ECU_ADDRESS 0xFFF85DB8 /end MEASUREMENT
/begin MEASUREMENT t_bre_nminpsysem_has "Timer der Verzögerungszeit zum Rücksetzen der minimalen EM Drehzahl zur Sicherstellung Ölversorgung beim Abbremsen" FLOAT32_IEEE t_fl_S6_S3 1 100 -3.40282e+038 3.40282e+038 ECU_ADDRESS 0xFFF96498 /end MEASUREMENT
/begin MEASUREMENT t_m_err_memstoer_fl_has_l2 "Fehlerfilterungstimer für Momentenfehlerereignis (FPU-Pfad) [10 ms]" FLOAT32_IEEE void_fl_S6_S3 1 100 -3.40282e+038 3.40282e+038 ECU_ADDRESS 0xFFF85FF4 /end MEASUREMENT
/begin MEASUREMENT t_m_err_memstoer_has_l2 "Fehlerfilterungstimer für Momentenfehlerereignis" UWORD t_int_h_S6_S3 1 100 0 655.35 ECU_ADDRESS 0xFFF86132 /end MEASUREMENT
/begin MEASUREMENT t_m_err_motmax_fl_has_l2 "Fehlerfilterungstimer für Momentenfehlerereignis (FPU-Pfad) [10 ms]" FLOAT32_IEEE void_fl_S6_S3 1 100 -3.40282e+038 3.40282e+038 ECU_ADDRESS 0xFFF85FF8 /end MEASUREMENT
/begin MEASUREMENT t_m_err_motmax_has_l2 "Fehlerfilterungstimer für Momentenfehlerereignis" UWORD t_int_h_S6_S3 1 100 0 655.35 ECU_ADDRESS 0xFFF86134 /end MEASUREMENT
/begin MEASUREMENT t_m_err_nemmin_fl_has_l2 "Fehlerfilterungstimer für Momentenfehlerereignis (FPU-Pfad) [10ms]" FLOAT32_IEEE void_fl_S6_S3 1 100 -3.40282e+038 3.40282e+038 ECU_ADDRESS 0xFFF85FFC /end MEASUREMENT
/begin MEASUREMENT t_m_err_nemmin_has_l2 "Fehlerfilterungstimer für Momentenfehlerereignis" UWORD t_int_h_S6_S3 1 100 0 655.35 ECU_ADDRESS 0xFFF86136 /end MEASUREMENT
/begin MEASUREMENT t_m_err_nvmsoll_fl_has_l2 "Fehlerfilterungstimer für Momentenfehlerereignis (FPU-Pfad) [10 ms]" FLOAT32_IEEE void_fl_S6_S3 1 100 -3.40282e+038 3.40282e+038 ECU_ADDRESS 0xFFF86000 /end MEASUREMENT
/begin MEASUREMENT t_m_err_nvmsoll_has_l2 "Fehlerfilterungstimer für Momentenfehlerereignis" UWORD t_int_h_S6_S3 1 100 0 655.35 ECU_ADDRESS 0xFFF86138 /end MEASUREMENT
/begin MEASUREMENT t_max_pvu_has "Timer fuer den maximalen Zeitraum nach Erkennung der Betriebsbereitschaft des Hybridsystems in dem die Unterstuetzung der Positionsventilueberwachung durch die HAS aktiv ist. .
" FLOAT32_IEEE t_fl_S6_S3 1 100 -3.40282e+038 3.40282e+038 ECU_ADDRESS 0xFFF9649C /end MEASUREMENT
/begin MEASUREMENT t_maxbed_sak_abk "Timer zur Überwachung der maximalen Verweildauer im Zustand 'Schaltung aktiv' beim Abkoppeln" UWORD t_int_h_S6_S3 1 100 0 10 ECU_ADDRESS 0xFFF96EFC /end MEASUREMENT
/begin MEASUREMENT t_n_err_nemmin_fl_has_l2 "Fehlerfilterungstimer für Drehzahlfehlerereignis (FPU-Pfad) [10ms]" FLOAT32_IEEE void_fl_S6_S3 1 100 -3.40282e+038 3.40282e+038 ECU_ADDRESS 0xFFF86004 /end MEASUREMENT
/begin MEASUREMENT t_n_err_nemmin_has_l2 "Fehlerfilterungstimer für Drehzahlfehlerereignis" UWORD t_int_h_S6_S3 1 100 0 655.35 ECU_ADDRESS 0xFFF8613A /end MEASUREMENT
/begin MEASUREMENT t_n_err_nemsoll_fl_has_l2 "Fehlerfilterungstimer für Drehzahlfehlerereignis (FPU-Pfad) [10 ms]" FLOAT32_IEEE void_fl_S6_S3 1 100 -3.40282e+038 3.40282e+038 ECU_ADDRESS 0xFFF86008 /end MEASUREMENT
/begin MEASUREMENT t_n_err_nemsoll_has_l2 "Fehlerfilterungstimer für Drehzahlfehlerereignis" UWORD t_int_h_S6_S3 1 100 0 655.35 ECU_ADDRESS 0xFFF8613C /end MEASUREMENT
/begin MEASUREMENT t_pos_err_nemsoll_fl_has_l2 "Fehlerfilterungstimer für Positionsfehlerereignis (FPU-Pfad) [10 ms]" FLOAT32_IEEE void_fl_S6_S3 1 100 -3.40282e+038 3.40282e+038 ECU_ADDRESS 0xFFF8600C /end MEASUREMENT
/begin MEASUREMENT t_pos_err_nemsoll_has_l2 "Fehlerfilterungstimer für Positionsfehlerereignis" UWORD t_int_h_S6_S3 1 100 0 655.35 ECU_ADDRESS 0xFFF8613E /end MEASUREMENT
/begin MEASUREMENT t_s_err_nemsoll_fl_has_l2 "Fehlerfilterungstimer für Schluffehlerereignis (FPU-Pfad) [10 ms]" FLOAT32_IEEE void_fl_S6_S3 1 100 -3.40282e+038 3.40282e+038 ECU_ADDRESS 0xFFF86010 /end MEASUREMENT
/begin MEASUREMENT t_s_err_nemsoll_has_l2 "Fehlerfilterungstimer für Schlupffehlerereignis" UWORD t_int_h_S6_S3 1 100 0 655.35 ECU_ADDRESS 0xFFF86140 /end MEASUREMENT
/begin MEASUREMENT t_sig_err_nvmsoll_fl_has_l2 "Fehlerfilterungstimer für Signalfehlerereignis (FPU-Pfad) [10 ms]" FLOAT32_IEEE void_fl_S6_S3 1 100 -3.40282e+038 3.40282e+038 ECU_ADDRESS 0xFFF86014 /end MEASUREMENT
/begin MEASUREMENT t_sig_err_nvmsoll_has_l2 "Fehlerfilterungstimer für Signalfehlerereignis" UWORD t_int_h_S6_S3 1 100 0 655.35 ECU_ADDRESS 0xFFF86142 /end MEASUREMENT
/begin MEASUREMENT t_vstatuspsysem_lp3 "Timer der Verzögerungszeit zum Setzten des Leistungspunkts 3 der Ölversorgung aus EM-Drehzahl" FLOAT32_IEEE t_fl_S6_S3 1 100 -3.40282e+038 3.40282e+038 ECU_ADDRESS 0xFFF964A0 /end MEASUREMENT
/begin MEASUREMENT t_z_err_memstoer_fl_has_l2 "Fehlerfilterungstimer für Vorgabefehlerereignis (FPU-Pfad) [10 ms]" FLOAT32_IEEE void_fl_S6_S3 1 100 -3.40282e+038 3.40282e+038 ECU_ADDRESS 0xFFF86018 /end MEASUREMENT
/begin MEASUREMENT t_z_err_memstoer_has_l2 "Fehlerfilterungstimer für Vorgabefehlerereignis" UWORD t_int_h_S6_S3 1 100 0 655.35 ECU_ADDRESS 0xFFF86144 /end MEASUREMENT
/begin MEASUREMENT t_z_err_nemsoll_fl_has_l2 "Fehlerfilterungstimer für Vorgabefehlerereignis (FPU-Pfad) [10 ms]" FLOAT32_IEEE void_fl_S6_S3 1 100 -3.40282e+038 3.40282e+038 ECU_ADDRESS 0xFFF8601C /end MEASUREMENT
/begin MEASUREMENT t_z_err_nemsoll_has_l2 "Fehlerfilterungstimer für Vorgabefehlerereignis" UWORD t_int_h_S6_S3 1 100 0 655.35 ECU_ADDRESS 0xFFF86146 /end MEASUREMENT
/begin MEASUREMENT t_z_err_nvmsoll_fl_has_l2 "Fehlerfilterungstimer für Vorgabefehlerereignis (FPU-Pfad) [10 ms]" FLOAT32_IEEE void_fl_S6_S3 1 100 -3.40282e+038 3.40282e+038 ECU_ADDRESS 0xFFF86020 /end MEASUREMENT
/begin MEASUREMENT t_z_err_nvmsoll_has_l2 "Fehlerfilterungstimer für Vorgabefehlerereignis" UWORD t_int_h_S6_S3 1 100 0 655.35 ECU_ADDRESS 0xFFF86148 /end MEASUREMENT
/begin MEASUREMENT timer_pumpready_aktiv_fkt "" UBYTE t_int_d_S6_S3 1 100 0 1 ECU_ADDRESS 0xFFF8663C /end MEASUREMENT
/begin MEASUREMENT v_f_sbe "Fahrzeuggeschwindigkeit auf Basis der Getriebeabtriebsdrehzahl in der  Hybridablaufsteuerung" FLOAT32_IEEE v_fl_S6_S3 1 100 -3.40282e+038 3.40282e+038 ECU_ADDRESS 0xFFF85DBC /end MEASUREMENT
/begin MEASUREMENT vg_f_sbe "Fahrzeuggeschwindigkeitsgradient auf Basis der Getriebeabtriebsdrehzahl in der  Hybridablaufsteuerung" FLOAT32_IEEE vg_fl_S6_S3 1 100 -3.40282e+038 3.40282e+038 ECU_ADDRESS 0xFFF85DC0 /end MEASUREMENT
/begin MEASUREMENT z_ablauf_has_hst_in "" UBYTE void_int_S6_S3 1 100 0 15 ECU_ADDRESS 0xFFF8668B /end MEASUREMENT
/begin MEASUREMENT z_ablauf_has_stg "Zusaetzliche Steuergroesse zur Ablaufsteuerung" UBYTE void_int_S6_S3 1 100 0 15 ECU_ADDRESS 0xFFF86637 /end MEASUREMENT
/begin MEASUREMENT z_ablauf_svh_reset_has_fkt "" UBYTE void_int_S6_S3 1 100 0 255 ECU_ADDRESS 0xFFF8663D /end MEASUREMENT
/begin MEASUREMENT z_ablaufreinit_frk_dihi "Zeigt an, dass der aktuelle HAS-Ablauf erneut begonnen werden soll" UBYTE void_int_S6_S3 1 100 0 1 ECU_ADDRESS 0xFFF8662F /end MEASUREMENT
/begin MEASUREMENT z_ablaufvariante_has_hst_in "" UBYTE void_int_S6_S3 1 100 0 15 ECU_ADDRESS 0xFFF8668C /end MEASUREMENT
/begin MEASUREMENT z_ablaufvariante_has_stg "Ablaufvariante, die  die OML ausgibt" UBYTE void_int_S6_S3 1 100 0 99 ECU_ADDRESS 0xFFF86638 /end MEASUREMENT
/begin MEASUREMENT z_ablaufvariante_kalt_zus "Anzeige der aktiven Ablaufvariante Kaltstart beim Zustart - 0 = kein Kaltstart, 1 = Kaltstart mit abgesenkter EM-Drehzahl" UBYTE void_int_S6_S3 1 100 0 255 ECU_ADDRESS 0xFFF8663E /end MEASUREMENT
/begin MEASUREMENT z_ba_has_k0_hst_in "" UBYTE void_int_S6_S3 1 100 0 1 ECU_ADDRESS 0xFFF8669F /end MEASUREMENT
/begin MEASUREMENT z_ba_has_vm_hst_in "" UBYTE void_int_S6_S3 1 100 0 1 ECU_ADDRESS 0xFFF866A0 /end MEASUREMENT
/begin MEASUREMENT z_diag_ersfkt_has_in "Funktionsschnittstelle zur Ermittlung ob irgendeine Ersatzmaßnahme in der Diagnoseverwaltung aktiv ist" ULONG b_int_S6_S3 1 100 0 4294967295 ECU_ADDRESS 0xFFF85E30 /end MEASUREMENT
/begin MEASUREMENT z_diag_ersfkt_hi_has_in "Funktionsschnittstelle zur Ermittlung ob irgendeine Ersatzmaßnahme in der Diagnoseverwaltung aktiv ist" ULONG b_int_S6_S3 1 100 0 4294967295 ECU_ADDRESS 0xFFF85E34 /end MEASUREMENT
/begin MEASUREMENT z_diag_notgang_has_in "Notganginformation" UBYTE void_int_S6_S3 1 100 0 255 ECU_ADDRESS 0xFFF8668D /end MEASUREMENT
/begin MEASUREMENT z_emaktiv_fuw_zus_fkt "Anzeige der EM Fehlfuntion der Funktionsüberwachung der EM beim Zustart" UBYTE void_int_S6_S3 1 100 0 1 ECU_ADDRESS 0xFFF8663F /end MEASUREMENT
/begin MEASUREMENT z_emfehler_frk_dihi "Zeigt an, dass eine EM Fehlfunktion erkannt wurde, die in der HAS ausgewertet werden soll" UBYTE void_int_S6_S3 1 100 0 1 ECU_ADDRESS 0xFFF86630 /end MEASUREMENT
/begin MEASUREMENT z_fehler15_eh_fkt "" UBYTE void_int_S6_S3 1 100 0 1 ECU_ADDRESS 0xFFF86640 /end MEASUREMENT
/begin MEASUREMENT z_freigabe_pvu_has_sbe "Freigabe zur Aktivierung der Diagnosefunktion \"Positionsventil-Überwachung\" der Funktion zur Unterstützung der Positi-onsventil-Überwachung der HAS" UBYTE void_int_S6_S3 1 100 0 1 ECU_ADDRESS 0xFFF86657 /end MEASUREMENT
/begin MEASUREMENT z_fuwdeakt_frk_dihi "Zeigt an, dass die FUW-Funktion nicht aktiviert werden darf" UBYTE void_int_S6_S3 1 100 0 1 ECU_ADDRESS 0xFFF86631 /end MEASUREMENT
/begin MEASUREMENT z_hybfkt_stg "Anforderung der Aktivierung einer Hybridfunktion durch die Hyrid-Zustandssteuerung" UBYTE E_HYBFKT_S6_S3 1 100 0 15 ECU_ADDRESS 0xFFF86639 /end MEASUREMENT
/begin MEASUREMENT z_iep_in "" UBYTE E_ZIEP_S6_S3 1 100 0 4 ECU_ADDRESS 0xFFF8668E /end MEASUREMENT
/begin MEASUREMENT z_init_fkt "" UBYTE void_int_S6_S3 1 100 0 1 ECU_ADDRESS 0xFFF86641 /end MEASUREMENT
/begin MEASUREMENT z_init_sta "Anforderung der Initialisierung der Zustandssteuerung (OML) durch die Strategieanpassung" UBYTE void_int_S6_S3 1 100 0 15 ECU_ADDRESS 0xFFF8666A /end MEASUREMENT
/begin MEASUREMENT z_k0_befuellopt_has_fkt "" UBYTE void_int_S6_S3 1 100 0 1 ECU_ADDRESS 0xFFF86642 /end MEASUREMENT
/begin MEASUREMENT z_k0_fst_in "" UBYTE E_ZK0FSTIN_S6_S3 1 100 0 3 ECU_ADDRESS 0xFFF8668F /end MEASUREMENT
/begin MEASUREMENT z_k0_has_fkt "" UBYTE E_ZK0_S6_S3 1 100 0 5 ECU_ADDRESS 0xFFF86643 /end MEASUREMENT
/begin MEASUREMENT z_k0_has_sbe "" UBYTE E_ZK0_S6_S3 1 100 0 5 ECU_ADDRESS 0xFFF8665D /end MEASUREMENT
/begin MEASUREMENT z_k0syncmk0erh_frk_dihi "Zeigt an, dass eine K0-Zwangsynchronisation mittels Erhöhung des K0-Moments erfolgen soll" UBYTE void_int_S6_S3 1 100 0 1 ECU_ADDRESS 0xFFF86632 /end MEASUREMENT
/begin MEASUREMENT z_kps_stada_in "Sollvorgabe für die Trennkupplung K0 durch die Stillstandsadaption" UBYTE void_int_S6_S3 1 100 0 255 ECU_ADDRESS 0xFFF86690 /end MEASUREMENT
/begin MEASUREMENT z_m_begr_em_has_fkt "" UBYTE void_int_S6_S3 1 100 0 50 ECU_ADDRESS 0xFFF86644 /end MEASUREMENT
/begin MEASUREMENT z_m_max_iae_has_fkt "" UBYTE void_int_S6_S3 1 100 0 50 ECU_ADDRESS 0xFFF86645 /end MEASUREMENT
/begin MEASUREMENT z_m_soll_em_has_fkt "" UBYTE void_int_S6_S3 1 100 0 50 ECU_ADDRESS 0xFFF86646 /end MEASUREMENT
/begin MEASUREMENT z_m_soll_vm_has_fkt "" UBYTE void_int_S6_S3 1 100 0 50 ECU_ADDRESS 0xFFF86647 /end MEASUREMENT
/begin MEASUREMENT z_modus_em_hst_in "" UBYTE void_int_S6_S3 1 100 0 255 ECU_ADDRESS 0xFFF86691 /end MEASUREMENT
/begin MEASUREMENT z_modus_iae_has_fkt "" UBYTE E_ZMODUSIAE_S6_S3 1 100 0 2 ECU_ADDRESS 0xFFF86648 /end MEASUREMENT
/begin MEASUREMENT z_modus_iae_has_sbe "" UBYTE E_ZMODUSIAE_S6_S3 1 100 0 2 ECU_ADDRESS 0xFFF8665E /end MEASUREMENT
/begin MEASUREMENT z_modus_iep_has_sbe "Vorgabe des Betriebsmodus der IEP durch die HAS" UBYTE E_ZMODUSIEP_S6_S3 1 100 0 4 ECU_ADDRESS 0xFFF8665F /end MEASUREMENT
/begin MEASUREMENT z_msa_avh_moni_has_sbe "Anforderung einer Schaltverhinderung der HAS" UBYTE void_int_S6_S3 1 100 0 255 ECU_ADDRESS 0xFFF86660 /end MEASUREMENT
/begin MEASUREMENT z_msa_eaf_moni_has_sbe "Anforderung einer Schaltverhinderung der HAS" UBYTE void_int_S6_S3 1 100 0 255 ECU_ADDRESS 0xFFF86661 /end MEASUREMENT
/begin MEASUREMENT z_msa_fst_in "Anforderung einer Abschaltverhinderung durch die Fahrstrategie ASIS" UBYTE void_int_S6_S3 1 100 0 255 ECU_ADDRESS 0xFFF86692 /end MEASUREMENT
/begin MEASUREMENT z_msa_has_sbe "Anforderung der Beeinflussung der MSA-Funktionalität durch die Hybridablaufsteuerung - Codierung: bit0 = AVZ, bit1 = AVH, bit2 = EAF, bit3 = EVH, bit4 = Deaktivierung, bit7 = Störungsbedingt" UBYTE void_int_S6_S3 1 100 0 255 ECU_ADDRESS 0xFFF86662 /end MEASUREMENT
/begin MEASUREMENT z_msa_stada_in "" UBYTE void_int_S6_S3 1 100 0 6 ECU_ADDRESS 0xFFF866A1 /end MEASUREMENT
/begin MEASUREMENT z_n_min_em_parksp_has_in "Anforderung einer EM-Drehzahlanhebung beim Auslegen der Parksperre infolge unzureichender Ölversorgung" UBYTE void_int_S6_S3 1 100 0 1 ECU_ADDRESS 0xFFF86693 /end MEASUREMENT
/begin MEASUREMENT z_n_min_iep_in "Anforderung Ausgabe EM-Mindestdrehzahl zur Sicherstellung der Ölversorgung durch die IEP" UBYTE void_int_S6_S3 1 100 0 1 ECU_ADDRESS 0xFFF86694 /end MEASUREMENT
/begin MEASUREMENT z_n_soll_em_has_fkt "" UBYTE void_int_S6_S3 1 100 0 50 ECU_ADDRESS 0xFFF86649 /end MEASUREMENT
/begin MEASUREMENT z_n_soll_vm_has_fkt "" UBYTE void_int_S6_S3 1 100 0 50 ECU_ADDRESS 0xFFF8664A /end MEASUREMENT
/begin MEASUREMENT z_nllsoll_iae_in "Anforderung der IAE, dass eine definierte LL-Drehzahl durch den Motor eingestellt werden soll" UBYTE E_ZNLLSOLL_S6_S3 1 100 0 2 ECU_ADDRESS 0xFFF86695 /end MEASUREMENT
/begin MEASUREMENT z_nminemnull_frk_dihi "Zeigt an, dass die Ausgabe der minimalen EM Drehzahl der HAS unterdrückt werden soll." UBYTE void_int_S6_S3 1 100 0 1 ECU_ADDRESS 0xFFF86633 /end MEASUREMENT
/begin MEASUREMENT z_nvmsollbegr_frk_dihi "Zeigt an, dass die VM-Solldrehzahl auf die EM-Istdrehzahl be-grenzt werden soll" UBYTE void_int_S6_S3 1 100 0 1 ECU_ADDRESS 0xFFF86634 /end MEASUREMENT
/begin MEASUREMENT z_p_hys_k0_has_fkt "Hysteresekompensation" UBYTE void_int_S6_S3 1 100 0 1 ECU_ADDRESS 0xFFF8664B /end MEASUREMENT
/begin MEASUREMENT z_ponr_fkt "point of no return" UBYTE void_int_S6_S3 1 100 0 1 ECU_ADDRESS 0xFFF8664C /end MEASUREMENT
/begin MEASUREMENT z_pos_fl_has_l2 "aktuelle Stellung des Positionshebels" FLOAT32_IEEE void_fl_S6_S3 1 100 -3.40282e+038 3.40282e+038 ECU_ADDRESS 0xFFF86024 /end MEASUREMENT
/begin MEASUREMENT z_pos_has_l2 "aktuelle Stellung des Positionshebels" UBYTE void_int_S6_S3 1 100 0 255 ECU_ADDRESS 0xFFF866DD /end MEASUREMENT
/begin MEASUREMENT z_pvu_has_sbe "Beeinflussung des Hybridsystems zur Unterstützung der Positionsventil- Überwachung der HAS-Codierung: 0 = keine Beeinflussung, 1 = Beeinflussung Stufe 1, 2 = Beeinflussung Stufe 2" UBYTE void_int_S6_S3 1 100 0 2 ECU_ADDRESS 0xFFF86658 /end MEASUREMENT
/begin MEASUREMENT z_saf_has_fkt "Schaltanforderung 1...aktiv" UBYTE void_int_S6_S3 1 100 0 1 ECU_ADDRESS 0xFFF8664D /end MEASUREMENT
/begin MEASUREMENT z_sas_has_sbe "Ändert im Wahrheitsfall die KupplungsBefüllreihenfolge" UBYTE void_int_S6_S3 1 100 0 1 ECU_ADDRESS 0xFFF86663 /end MEASUREMENT
/begin MEASUREMENT z_sbe_has_fkt "Schaltbeeinflussung  1...aktiv" UBYTE void_int_S6_S3 1 100 0 1 ECU_ADDRESS 0xFFF8664E /end MEASUREMENT
/begin MEASUREMENT z_standby_em_has_fkt "" UBYTE void_int_S6_S3 1 100 0 1 ECU_ADDRESS 0xFFF8664F /end MEASUREMENT
/begin MEASUREMENT z_start_modus_has_sbe "Anforderung eines Anlasserstarts" UBYTE void_int_S6_S3 1 100 0 255 ECU_ADDRESS 0xFFF86664 /end MEASUREMENT
/begin MEASUREMENT z_status_psys_mps_sbe "Flag, das eine Modifikation des Pumpendruckstatus anzeigt" UBYTE void_int_S6_S3 1 100 0 1 ECU_ADDRESS 0xFFF86659 /end MEASUREMENT
/begin MEASUREMENT z_svh_has_sbe "Anforderung einer Schaltverhinderung der HAS" UBYTE void_int_S6_S3 1 100 0 1 ECU_ADDRESS 0xFFF86665 /end MEASUREMENT
/begin MEASUREMENT z_timer_pumpready_fkt "" UBYTE void_int_S6_S3 1 100 0 1 ECU_ADDRESS 0xFFF86650 /end MEASUREMENT
/begin MEASUREMENT z_tmin_fehler15_fkt "Status Timer für Verweilzeit in Fehler15" UBYTE void_int_S6_S3 1 100 0 255 ECU_ADDRESS 0xFFF86651 /end MEASUREMENT
/begin MEASUREMENT z_vmkaltstart_pvu_has "Erkennung der Anforderung eines VM Kaltstarts der Funktion zur Unterstützung der Positionsventil-Überwachung der HAS" UBYTE void_int_S6_S3 1 100 0 1 ECU_ADDRESS 0xFFF8623D /end MEASUREMENT
/begin MEASUREMENT z_vmstart_pvu_has "Erkennung der Anforderung eines VM Starts der Funktion zur  Unterstützung der Positionsventil-Überwachung der HAS" UBYTE void_int_S6_S3 1 100 0 1 ECU_ADDRESS 0xFFF96D72 /end MEASUREMENT
/begin MEASUREMENT z_ziel_kraftfluss_egs_in "" UBYTE void_int_S6_S3 1 100 0 255 ECU_ADDRESS 0xFFF86696 /end MEASUREMENT
/begin MEASUREMENT z_zuendfreigabe_vm_fkt "" UBYTE void_int_S6_S3 1 100 0 1 ECU_ADDRESS 0xFFF86652 /end MEASUREMENT
/begin MEASUREMENT z_zuendfreigabe_vm_has_fkt "" UBYTE void_int_S6_S3 1 100 0 1 ECU_ADDRESS 0xFFF86653 /end MEASUREMENT
/begin MEASUREMENT zielgang_egs_in "" SBYTE void_int_S6_S3 1 100 -128 127 ECU_ADDRESS 0xFFF86697 /end MEASUREMENT
/begin FUNCTION Run_UL2_UeberwachungL2 ""
 /begin DEF_CHARACTERISTIC I_FIX_ERSATZ_MEMSTOER_HAS_L2 I_FIX_ERSATZ_NEMMIN_HAS_L2 I_FIX_ERSATZ_NEMSOLL_HAS_L2 I_FIX_ERSATZ_NVMSOLL_HAS_L2 KL_MO_NEMSOLL_HAS_L2_X KL_MO_NEMSOLL_HAS_L2_Y KL_MS_MEMSTOER_HAS_L2_X KL_MS_MEMSTOER_HAS_L2_Y KL_MS_NEMMIN_HAS_L2_X KL_MS_NEMMIN_HAS_L2_Y KL_MS_NVMSOLL_HAS_L2_X KL_MS_NVMSOLL_HAS_L2_Y KL_MS_VM_NVMSOLL_HAS_L2_X KL_MS_VM_NVMSOLL_HAS_L2_Y MO_TOL_MEMSTOER_HAS_L2 MS_MIN_NEMMIN_HAS_L2 MS_MOTMAX_HAS_L2 MS_MOTSOLL_NVMSOLL_HAS_L2 NDS_GETR_NEMSOLL_HAS_L2 NGS_VM_MEMSTOER_HAS_L2 NS_AB_MIN_NEMSOLL_HAS_L2 NS_EM_NVMSOLL_HAS_L2 NS_LIM_NEMMIN_HAS_L2 NS_LIM_NEMSOLL_HAS_L2 NS_NEMMIN_HAS_L2 NS_NVMSOLL_HAS_L2 SWI_EXTDEAK_NEMMIN_HAS_L2 SWI_EXTDEAK_NVMSOLL_HAS_L2 SWI_KOMP_FEHLER_1_HAS_UL2 SWI_KOMP_FEHLER_2_HAS_UL2 SWI_MEMSTOER_HAS_L2 SWI_MOD_NVMSOLL_HAS_L2 SWI_MOTMAX_HAS_L2 SWI_MOTVERLUST_NEMMIN_HAS_L2 SWI_MOTVERLUST_NEMSOLL_HAS_L2 SWI_MOTVERLUST_NVMSOLL_HAS_L2 SWI_NEMMIN_HAS_L2 SWI_NEMSOLL_HAS_L2 SWI_NVMSOLL_HAS_L2 SWI_PAK_FEHLER_HAS_UL2 SWI_POS_NEMSOLL_HAS_L2 SWI_SIGSTS_MEMSTOER_HAS_L2 SWI_SIGSTS_NEMSOLL_HAS_L2 SWI_SIGSTS_NVMSOLL_HAS_L2 SWI_VAR_NEMSOLL_HAS_L2 TAB_IG_NEMSOLL_HAS_L2 T_MEMSTOER_HAS_L2 T_MOTMAX_HAS_L2 T_NEMMIN_HAS_L2 T_NEMSOLL_HAS_L2 T_NGVM_MEMSTOER_HAS_L2 T_NVMSOLL_HAS_L2 /end DEF_CHARACTERISTIC
 /begin LOC_MEASUREMENT f_akt_err_memstoer_fl_has_l2 f_akt_err_memstoer_has_l2 f_akt_err_motmax_fl_has_l2 f_akt_err_motmax_has_l2 f_akt_err_nemmin_fl_has_l2 f_akt_err_nemmin_has_l2 f_akt_err_nemsoll_fl_has_l2 f_akt_err_nemsoll_has_l2 f_akt_err_nvmsoll_fl_has_l2 f_akt_err_nvmsoll_has_l2 f_extdeak_fl_has_l2 f_extdeak_has_l2 f_m_akt_err_memstoer_fl_has_l2 f_m_akt_err_memstoer_has_l2 f_m_akt_err_motmax_fl_has_l2 f_m_akt_err_motmax_has_l2 f_m_akt_err_nemmin_fl_has_l2 f_m_akt_err_nemmin_has_l2 f_m_akt_err_nvmsoll_fl_has_l2 f_m_akt_err_nvmsoll_has_l2 f_m_err_memstoer_fl_has_l2 f_m_err_memstoer_has_l2 f_m_err_motmax_fl_has_l2 f_m_err_motmax_has_l2 f_m_err_nemmin_fl_has_l2 f_m_err_nemmin_has_l2 f_m_err_nvmsoll_fl_has_l2 f_m_err_nvmsoll_has_l2 f_n_akt_err_nemmin_fl_has_l2 f_n_akt_err_nemmin_has_l2 f_n_akt_err_nemsoll_fl_has_l2 f_n_akt_err_nemsoll_has_l2 f_n_err_nemmin_fl_has_l2 f_n_err_nemmin_has_l2 f_n_err_nemsoll_fl_has_l2 f_n_err_nemsoll_has_l2 f_pos_akt_err_nemsoll_fl_has_l2 f_pos_akt_err_nemsoll_has_l2 f_pos_err_nemsoll_fl_has_l2 f_pos_err_nemsoll_has_l2 f_s_akt_err_nemsoll_fl_has_l2 f_s_akt_err_nemsoll_has_l2 f_s_err_nemsoll_fl_has_l2 f_s_err_nemsoll_has_l2 f_sig_akt_err_nvmsoll_fl_has_l2 f_sig_akt_err_nvmsoll_has_l2 f_sig_err_nvmsoll_fl_has_l2 f_sig_err_nvmsoll_has_l2 f_z_akt_err_memstoer_fl_has_l2 f_z_akt_err_memstoer_has_l2 f_z_akt_err_nemsoll_fl_has_l2 f_z_akt_err_nemsoll_has_l2 f_z_akt_err_nvmsoll_fl_has_l2 f_z_akt_err_nvmsoll_has_l2 f_z_err_memstoer_fl_has_l2 f_z_err_memstoer_has_l2 f_z_err_nemsoll_fl_has_l2 f_z_err_nemsoll_has_l2 f_z_err_nvmsoll_fl_has_l2 f_z_err_nvmsoll_has_l2 i_dyn_memstoer_fl_has_l2 i_dyn_memstoer_has_l2 i_dyn_nemmin_fl_has_l2 i_dyn_nemmin_has_l2 i_dyn_nemsoll_fl_has_l2 i_dyn_nemsoll_has_l2 i_dyn_nvmsoll_fl_has_l2 i_dyn_nvmsoll_has_l2 i_fix_nemsoll_fl_has_l2 i_fix_nemsoll_has_l2 iv_f_extdeak_fl_has_l2 iv_f_extdeak_has_l2 iv_m_fahrerwunsch_fl_has_l2 iv_m_fahrerwunsch_has_l2 iv_m_ist_em_fl_has_l2 iv_m_ist_em_has_l2 iv_m_ist_vm_fl_has_l2 iv_m_ist_vm_has_l2 iv_m_me_red_fl_has_l2 iv_m_me_red_has_l2 iv_m_motmax_fl_has_l2 iv_m_motmax_has_l2 iv_m_motsoll_fl_has_l2 iv_m_motsoll_has_l2 iv_m_motverlust_fl_has_l2 iv_m_motverlust_has_l2 iv_m_soll_em_fl_has_l2 iv_m_soll_em_has_l2 iv_n_ist_ab_fl_has_l2 iv_n_ist_ab_has_l2 iv_n_ist_em_fl_has_l2 iv_n_ist_em_has_l2 iv_n_ist_tu_fl_has_l2 iv_n_ist_tu_has_l2 iv_n_ist_vm_fl_has_l2 iv_n_ist_vm_has_l2 iv_n_mot_llsoll_fl_has_l2 iv_n_mot_llsoll_has_l2 iv_n_soll_em_fl_has_l2 iv_n_soll_em_has_l2 iv_n_soll_vm_fl_has_l2 iv_n_soll_vm_has_l2 iv_st_m_fahrerwunsch_fl_has_l2 iv_st_m_fahrerwunsch_has_l2 iv_st_m_ist_em_fl_has_l2 iv_st_m_ist_em_has_l2 iv_st_m_ist_vm_fl_has_l2 iv_st_m_ist_vm_has_l2 iv_st_m_me_red_fl_has_l2 iv_st_m_me_red_has_l2 iv_st_m_motsoll_fl_has_l2 iv_st_m_motsoll_has_l2 iv_st_m_motverlust_fl_has_l2 iv_st_m_motverlust_has_l2 iv_st_m_soll_em_fl_has_l2 iv_st_m_soll_em_has_l2 iv_st_n_ist_ab_fl_has_l2 iv_st_n_ist_ab_has_l2 iv_st_n_ist_em_fl_has_l2 iv_st_n_ist_em_has_l2 iv_st_n_ist_tu_fl_has_l2 iv_st_n_ist_tu_has_l2 iv_st_n_ist_vm_fl_has_l2 iv_st_n_ist_vm_has_l2 iv_st_n_soll_em_fl_has_l2 iv_st_n_soll_em_has_l2 iv_st_n_soll_vm_fl_has_l2 iv_st_n_soll_vm_has_l2 iv_z_pos_fl_has_l2 iv_z_pos_has_l2 m_fahrerwunsch_fl_has_l2 m_fahrerwunsch_has_l2 m_ist_em_fl_has_l2 m_ist_em_has_l2 m_ist_vm_fl_has_l2 m_ist_vm_has_l2 m_me_red_fl_has_l2 m_me_red_has_l2 m_motmax_fl_has_l2 m_motmax_has_l2 m_motsoll_fl_has_l2 m_motsoll_has_l2 m_motverlust_fl_has_l2 m_motverlust_has_l2 m_soll_em_fl_has_l2 m_soll_em_has_l2 m_verlust_nemmin_fl_has_l2 m_verlust_nemmin_has_l2 m_verlust_nemsoll_fl_has_l2 m_verlust_nemsoll_has_l2 m_verlust_nvmsoll_fl_has_l2 m_verlust_nvmsoll_has_l2 mo_mered_nemmin_fl_has_l2 mo_mered_nemmin_has_l2 mo_mered_nvmsoll_fl_has_l2 mo_mered_nvmsoll_has_l2 mo_tolem_memstoer_fl_has_l2 mo_tolem_memstoer_has_l2 n_ist_ab_fl_has_l2 n_ist_ab_has_l2 n_ist_em_fl_has_l2 n_ist_em_has_l2 n_ist_tu_fl_has_l2 n_ist_tu_has_l2 n_ist_vm_fl_has_l2 n_ist_vm_has_l2 n_mot_llsoll_fl_has_l2 n_mot_llsoll_has_l2 n_soll_em_fl_has_l2 n_soll_em_has_l2 n_soll_vm_fl_has_l2 n_soll_vm_has_l2 nd_getr_nemsoll_fl_has_l2 nd_getr_nemsoll_has_l2 ng_ist_vm_memstoer_fl_has_l2 ng_ist_vm_memstoer_has_l2 no_ndgetr_nemsoll_fl_has_l2 no_ndgetr_nemsoll_has_l2 st_m_fahrerwunsch_fl_has_l2 st_m_fahrerwunsch_has_l2 st_m_ist_em_fl_has_l2 st_m_ist_em_has_l2 st_m_ist_vm_fl_has_l2 st_m_ist_vm_has_l2 st_m_me_red_fl_has_l2 st_m_me_red_has_l2 st_m_motsoll_fl_has_l2 st_m_motsoll_has_l2 st_m_motverlust_fl_has_l2 st_m_motverlust_has_l2 st_m_soll_em_fl_has_l2 st_m_soll_em_has_l2 st_n_ist_ab_fl_has_l2 st_n_ist_ab_has_l2 st_n_ist_em_fl_has_l2 st_n_ist_em_has_l2 st_n_ist_tu_fl_has_l2 st_n_ist_tu_has_l2 st_n_ist_vm_fl_has_l2 st_n_ist_vm_has_l2 st_n_soll_em_fl_has_l2 st_n_soll_em_has_l2 st_n_soll_vm_fl_has_l2 st_n_soll_vm_has_l2 swi_komp_fehler_1_has_l2 swi_komp_fehler_2_has_l2 t_m_err_memstoer_fl_has_l2 t_m_err_memstoer_has_l2 t_m_err_motmax_fl_has_l2 t_m_err_motmax_has_l2 t_m_err_nemmin_fl_has_l2 t_m_err_nemmin_has_l2 t_m_err_nvmsoll_fl_has_l2 t_m_err_nvmsoll_has_l2 t_n_err_nemmin_fl_has_l2 t_n_err_nemmin_has_l2 t_n_err_nemsoll_fl_has_l2 t_n_err_nemsoll_has_l2 t_pos_err_nemsoll_fl_has_l2 t_pos_err_nemsoll_has_l2 t_s_err_nemsoll_fl_has_l2 t_s_err_nemsoll_has_l2 t_sig_err_nvmsoll_fl_has_l2 t_sig_err_nvmsoll_has_l2 t_z_err_memstoer_fl_has_l2 t_z_err_memstoer_has_l2 t_z_err_nemsoll_fl_has_l2 t_z_err_nemsoll_has_l2 t_z_err_nvmsoll_fl_has_l2 t_z_err_nvmsoll_has_l2 z_pos_fl_has_l2 z_pos_has_l2 /end LOC_MEASUREMENT
/end FUNCTION
/begin FUNCTION SAS "Das Paket SAS enthält alle Klassen und Funktionalitäten, welche zur Koordination des Schaltablaufs notwendig sind."
 /begin SUB_FUNCTION GEA SAS_REGELUNG SAS_ZENTRAL SAS_SYSTEMDRUCK TCI SAS_KOORDINATOR SAS_SONDERFKT SAS_MOTOREINGRIFF /end SUB_FUNCTION
/end FUNCTION
/begin FUNCTION SAS_KOORDINATOR "In SAS_KOORDINATOR sind die Koordinationsfunktionen des Schaltablaufs enthalten"
 /begin IN_MEASUREMENT iKorSaste.kup_ge1 iKorSaste.kup_ge2 iKorSaste.kup_ge3 iKorSaste.kup_kab iKorSaste.kup_kabvkzu iKorSaste.kup_kzu iKorSaste.kup_vkab iKorSaste.kup_vkzu iKorSaste.m_t_mepos iKorSaste.me_sas_status iKorSaste.n_motmax iKorSaste.n_tmax iKorSaste.schaltungsabbruch_durch_ga iKorSaste.timer_ende_ga iKorSaste.zielgang_vorb_angefordert iKorSaste.zielgang_vorbereitung /end IN_MEASUREMENT
/end FUNCTION
/begin FUNCTION SAS_MOTOREINGRIFF "In SAS_MOTOREINGRIFF sind die Klassen zur Steuerung des Motoreingriffs während Schaltablauf enthalten"
 /begin IN_MEASUREMENT iMoeMesaf.f_neuber_startz_hme_hs_angef iMoeMesaf.f_neuber_startz_hme_hs_erfolgt iMoeMesaf.f_unterdr_me iMoeMesaf.filter_spez_me.letzter_ms_timer iMoeMesaf.filter_spez_me.start_wert iMoeMesaf.filter_spez_me.x iMoeMesaf.flag_me_haupt_aktiv iMoeMesaf.flag_schaltung_mes_aktiv iMoeMesaf.me_sas iMoeMesaf.me_sas0_mee iMoeMesaf.me_sas_gesp iMoeMesaf.me_sas_gesp_kf iMoeMesaf.me_sas_int iMoeMesaf.me_sas_pos_vor iMoeMesaf.me_sas_pos_vor_stat iMoeMesaf.me_sas_start_nach_me iMoeMesaf.me_sas_zwme_max iMoeMesaf.momentenerhoehung_erlaubt iMoeMesaf.momentenerhoehung_erlaubt_alt iMoeMesaf.nachme_rs_losgelaufen iMoeMesaf.ng_abmesas iMoeMesaf.offset_n_motsolleer iMoeMesaf.schalttyp_mes iMoeMesaf.t_ramee iMoeMesaf.t_zmes iMoeMesaf.timer_maxzeit_mes iMoeMesaf.timer_ramee iMoeMesaf.timer_rampe_pos iMoeMesaf.timer_schaltung_mes iMoeMesaf.timer_zmes iMoeMesaf.verbot_sas_fkt_alt iMoeMesaf.z_mes iMoeMesaf.zaehler_zmes iMoeMesaf.zust_haupt_me_gestartet /end IN_MEASUREMENT
/end FUNCTION
/begin FUNCTION SAS_REGELUNG "In SAS_REGELUNG sind Methoden für die Regelung (z.B. GLS)"
 /begin IN_MEASUREMENT iSasAnGls.filter_wngtgls.letzter_ms_timer iSasAnGls.filter_wngtgls.x iSasAnGls.filter_wngtgls_gestartet iSasAnGls.gls_aktiv iSasAnGls.gls_mindruck iSasAnGls.gls_para.cBibRegle._.faktor_d iSasAnGls.gls_para.cBibRegle._.faktor_i iSasAnGls.gls_para.cBibRegle._.faktor_p iSasAnGls.gls_para.cBibRegle._.faktor_t1 iSasAnGls.gls_para.cBibRegle._.regel_diff_alt iSasAnGls.gls_para.cBibRegle._.stell_max iSasAnGls.gls_para.cBibRegle._.stell_min iSasAnGls.gls_para.cBibRegle._.stellgr_alt iSasAnGls.gls_para.cBibRegle._.stellgr_d_alt iSasAnGls.gls_para.cBibRegle._.stellgr_i_alt iSasAnGls.gls_para.cBibRegle._.stellgr_i_modulo iSasAnGls.n_tmaxge iSasAnGls.ng_tgls iSasAnGls.p_gls iSasAnGls.p_gls_kab iSasAnGls.p_gls_kzu iSasAnGls.p_i_gls iSasAnGls.p_maxgls iSasAnGls.p_mingls iSasAnGls.reg_gls_gestartet iSasAnGls.schalttyp_gls iSasAnGls.schaltung_gls iSasAnGls.t_sgls iSasAnGls.t_zgls iSasAnGls.timer_sgls iSasAnGls.timer_vglskab iSasAnGls.timer_vglskzu iSasAnGls.timer_zgls iSasAnGls.verz_gls_gestartet iSasAnGls.w_ngtgls iSasAnGls.w_ngtnomgls iSasAnGls.w_tsgls iSasAnGls.wechsel_normal_kurz iSasAnGls.z_gls iSasAnGls.z_gls_regler iSasAnGls.zaehler_zgls iSasAnGls.zug_schub_gls /end IN_MEASUREMENT
/end FUNCTION
/begin FUNCTION SAS_SONDERFKT "In SAS_SONDERFKT sind Sonderfunktionen zum Schaltablauf enthalten"
 /begin IN_MEASUREMENT iSasKflwe.kup1_kflw iSasKflwe.kup2_kflw iSasKflwe.nd_nmot_nt_skw iSasKflwe.p_kab1_kflw iSasKflwe.p_kab2_kflw iSasKflwe.p_kab_kflw2_speicher.letzter_ms_timer iSasKflwe.p_kab_kflw2_speicher.letzter_wert iSasKflwe.p_kab_kflw2_speicher.maximum iSasKflwe.p_kab_kflw2_speicher.minimum iSasKflwe.p_kab_kflw_speicher.letzter_ms_timer iSasKflwe.p_kab_kflw_speicher.letzter_wert iSasKflwe.p_kab_kflw_speicher.maximum iSasKflwe.p_kab_kflw_speicher.minimum iSasStrat.ber_red_durch_sf_notwendig iSasStrat.f_nmot_ts_estart iSasStrat.f_sltsf_estart iSasStrat.flag_opt_bef_aush_sch_angef iSasStrat.flag_opt_bef_inh_sch_angef iSasStrat.flag_red_bef_aush_sch_angef iSasStrat.flag_red_bef_inh_sch_angef iSasStrat.q_fuellred iSasStrat.q_verfuegbar_rest iSasStrat.timer_sltsf_estart iSasStrat.timer_sltsf_ts_estart /end IN_MEASUREMENT
/end FUNCTION
/begin FUNCTION SAS_SYSTEMDRUCK "In SAS_SYSTEMDRUCK sind Klassen zur Steuerung des Systemdrucks während des Schaltablaufs enthalten"
 /begin IN_MEASUREMENT iSasPsyst.f_auframpen_mg_psysminpuls_gest iSasPsyst.f_einstiegsbed_p_sysiae_erf iSasPsyst.f_psys_kupschutz_anst_laeuft iSasPsyst.f_zeit_max_psys_abgelaufen iSasPsyst.f_zeit_max_psys_anst_laeuft iSasPsyst.filter_p_sysist.letzter_ms_timer iSasPsyst.filter_p_sysist.x iSasPsyst.fkt_druckvorgabe_psys iSasPsyst.p_iep_sys iSasPsyst.p_mod iSasPsyst.p_pumpe_sys iSasPsyst.p_sys iSasPsyst.p_sysist iSasPsyst.rampe_p_sysiae.letzter_ms_timer iSasPsyst.rampe_p_sysiae.letzter_wert iSasPsyst.rampe_p_sysiae.maximum iSasPsyst.rampe_p_sysiae.minimum iSasPsyst.rampe_p_syspulsada.letzter_ms_timer iSasPsyst.rampe_p_syspulsada.letzter_wert iSasPsyst.rampe_p_syspulsada.maximum iSasPsyst.rampe_p_syspulsada.minimum iSasPsyst.timer_max_psys_anst /end IN_MEASUREMENT
/end FUNCTION
/begin FUNCTION SAS_ZENTRAL "In SAS_ZENTRAL sind Klassen zur Steuerung des Schaltablaufs enthalten"
 /begin IN_MEASUREMENT iSasZentr.abbruchsart_hs_gls_erlaubt iSasZentr.abbruchsart_ist iSasZentr.abbruchsart_soll iSasZentr.c_getr_sas iSasZentr.event_sf_erkannt iSasZentr.f_eco_mode iSasZentr.f_einstiegsbed_erfuellt iSasZentr.f_red_mmotmax_angefordert iSasZentr.f_schaltung_normal_beendet iSasZentr.flag_ge_dnr_aktiv iSasZentr.flag_ge_rnd_aktiv iSasZentr.flag_sync_verlassen_me iSasZentr.folgeschaltung iSasZentr.gangwechsel iSasZentr.iSchaltend.aktuelle_schaltung iSasZentr.iSchaltend.erste_schaltung iSasZentr.iSchaltend.f_verb_ada_erste_bef iSasZentr.iSchaltend.fkt_halten_in_sync_verboten iSasZentr.iSchaltend.iKab.ende_kab_gestartet iSasZentr.iSchaltend.iKab.f_best_poffkab_in_syn_erfolgt iSasZentr.iSchaltend.iKab.f_ende_verz_kab_erlaubt iSasZentr.iSchaltend.iKab.f_rueckf_pozustartk0_aktiv iSasZentr.iSchaltend.iKab.f_warten_auf_sf_k0_aktiv iSasZentr.iSchaltend.iKab.gls_hs_kab_gestartet iSasZentr.iSchaltend.iKab.halten_in_syn_kab_gestartet iSasZentr.iSchaltend.iKab.kab_nicht_befuellt iSasZentr.iSchaltend.iKab.kup_kab iSasZentr.iSchaltend.iKab.m_motsoll0_sas iSasZentr.iSchaltend.iKab.md_motsoll_sas iSasZentr.iSchaltend.iKab.p_0stkab iSasZentr.iSchaltend.iKab.p_adaptkab iSasZentr.iSchaltend.iKab.p_kab iSasZentr.iSchaltend.iKab.p_kfkab iSasZentr.iSchaltend.iKab.p_offkab iSasZentr.iSchaltend.iKab.p_stkab iSasZentr.iSchaltend.iKab.pgo_kab_speicher.cBibRampeGradSi16._.letzter_ms_timer iSasZentr.iSchaltend.iKab.pgo_kab_speicher.cBibRampeGradSi16._.letzter_wert iSasZentr.iSchaltend.iKab.pgo_kab_speicher.cBibRampeGradSi16._.maximum iSasZentr.iSchaltend.iKab.pgo_kab_speicher.cBibRampeGradSi16._.minimum iSasZentr.iSchaltend.iKab.pkf_rs_kab_ausgegeben iSasZentr.iSchaltend.iKab.pkf_rs_kab_gestartet iSasZentr.iSchaltend.iKab.po_0zustartk0 iSasZentr.iSchaltend.iKab.po_mtkab iSasZentr.iSchaltend.iKab.po_zustartk0 iSasZentr.iSchaltend.iKab.ps_hs_kab_gestartet iSasZentr.iSchaltend.iKab.ra1_kab_gestartet iSasZentr.iSchaltend.iKab.ra_sd_hs_kab_gestartet iSasZentr.iSchaltend.iKab.ra_sd_rs_kab_gestartet iSasZentr.iSchaltend.iKab.raph_kab_speicher.letzter_timer iSasZentr.iSchaltend.iKab.raph_kab_speicher.letzter_wert iSasZentr.iSchaltend.iKab.raps_kab_speicher.letzter_timer iSasZentr.iSchaltend.iKab.raps_kab_speicher.letzter_wert iSasZentr.iSchaltend.iKab.schalttyp_kab iSasZentr.iSchaltend.iKab.statisch_kab iSasZentr.iSchaltend.iKab.t_0kab iSasZentr.iSchaltend.iKab.t_ph_rs iSasZentr.iSchaltend.iKab.t_ra_kab_vor_ra1_kzu iSasZentr.iSchaltend.iKab.t_verz_ph_rs iSasZentr.iSchaltend.iKab.t_zkab iSasZentr.iSchaltend.iKab.timer_hinsyn iSasZentr.iSchaltend.iKab.timer_pozustartk0 iSasZentr.iSchaltend.iKab.timer_zkab iSasZentr.iSchaltend.iKab.ueb_rs_kab_gestartet iSasZentr.iSchaltend.iKab.z_kab iSasZentr.iSchaltend.iKab.zaehler_zkab iSasZentr.iSchaltend.iKzu.dauer_fa_hsrs_kzu iSasZentr.iSchaltend.iKzu.dauer_ra1_hsrs_kzu iSasZentr.iSchaltend.iKzu.f_hinsyn_kzu_gestartet iSasZentr.iSchaltend.iKzu.f_ngs_abflare_unterschritten iSasZentr.iSchaltend.iKzu.f_pokzufol_erlaubt iSasZentr.iSchaltend.iKzu.f_rampenzeitberechnung_fertig iSasZentr.iSchaltend.iKzu.f_schnellfuellung_war_aktiv iSasZentr.iSchaltend.iKzu.fa_kzu_gestartet iSasZentr.iSchaltend.iKzu.flag_pomekzu_erlaubt iSasZentr.iSchaltend.iKzu.kup_kzu iSasZentr.iSchaltend.iKzu.md_motsoll_sas iSasZentr.iSchaltend.iKzu.p_0stkzu iSasZentr.iSchaltend.iKzu.p_adaptkzu iSasZentr.iSchaltend.iKzu.p_fkzu iSasZentr.iSchaltend.iKzu.p_fkzu_gueltig iSasZentr.iSchaltend.iKzu.p_kzu iSasZentr.iSchaltend.iKzu.p_offkzu iSasZentr.iSchaltend.iKzu.p_stkzu iSasZentr.iSchaltend.iKzu.pgo_kzu_speicher.cBibRampeGradSi16._.letzter_ms_timer iSasZentr.iSchaltend.iKzu.pgo_kzu_speicher.cBibRampeGradSi16._.letzter_wert iSasZentr.iSchaltend.iKzu.pgo_kzu_speicher.cBibRampeGradSi16._.maximum iSasZentr.iSchaltend.iKzu.pgo_kzu_speicher.cBibRampeGradSi16._.minimum iSasZentr.iSchaltend.iKzu.po_kzuflare iSasZentr.iSchaltend.iKzu.po_mekzu iSasZentr.iSchaltend.iKzu.po_mtkzu iSasZentr.iSchaltend.iKzu.ra1_hsrs_kzu_gestartet iSasZentr.iSchaltend.iKzu.ra2_hsrs_kzu_gestartet iSasZentr.iSchaltend.iKzu.ra3_hsrs_kzu_gestartet iSasZentr.iSchaltend.iKzu.raph_kzu_speicher.letzter_timer iSasZentr.iSchaltend.iKzu.raph_kzu_speicher.letzter_wert iSasZentr.iSchaltend.iKzu.schalttyp_kzu iSasZentr.iSchaltend.iKzu.schliessen_kzu iSasZentr.iSchaltend.iKzu.statisch_kzu iSasZentr.iSchaltend.iKzu.t_0kzu iSasZentr.iSchaltend.iKzu.t_berechnungszeitpunkt iSasZentr.iSchaltend.iKzu.t_besfhsrskzu iSasZentr.iSchaltend.iKzu.t_eff_ra1_hsrs_kzu iSasZentr.iSchaltend.iKzu.t_ig_change iSasZentr.iSchaltend.iKzu.t_vkabr_abgelaufen iSasZentr.iSchaltend.iKzu.t_zkzu iSasZentr.iSchaltend.iKzu.timer16_ra1_hsrs_kzu iSasZentr.iSchaltend.iKzu.timer_ab_ende_sf_kzu iSasZentr.iSchaltend.iKzu.timer_seit_start_schaltung iSasZentr.iSchaltend.iKzu.timer_start_fa_kzu iSasZentr.iSchaltend.iKzu.timer_zkzu iSasZentr.iSchaltend.iKzu.z_kzu iSasZentr.iSchaltend.iKzu.zaehler_zkzu iSasZentr.iSchaltend.index_spsas iSasZentr.iSchaltend.istgang_sas iSasZentr.iSchaltend.kup_schutz_massnahme_aktiv iSasZentr.iSchaltend.m_motsoll0_sas iSasZentr.iSchaltend.n_tkf iSasZentr.iSchaltend.n_tsyn iSasZentr.iSchaltend.nd_syn iSasZentr.iSchaltend.nd_synistgang iSasZentr.iSchaltend.nd_vsyn_betr iSasZentr.iSchaltend.ng_dsynzielgang iSasZentr.iSchaltend.p_kab_letzte_schaltung iSasZentr.iSchaltend.p_kzu_letzte_schaltung iSasZentr.iSchaltend.schaltinfo_sas iSasZentr.iSchaltend.schaltinfo_sas_vor_folge iSasZentr.iSchaltend.schaltinfo_syn iSasZentr.iSchaltend.schnellfuellung_beendet iSasZentr.iSchaltend.schnellfuellung_gestartet iSasZentr.iSchaltend.sp_ngdsynzielgang.letzter_ms_timer iSasZentr.iSchaltend.sp_ngdsynzielgang.n_f iSasZentr.iSchaltend.synchron iSasZentr.iSchaltend.synchron_verboten iSasZentr.iSchaltend.t_maxsas iSasZentr.iSchaltend.t_syn iSasZentr.iSchaltend.t_timeout iSasZentr.iSchaltend.timeout iSasZentr.iSchaltend.timer16_sas iSasZentr.iSchaltend.z_kurze_schaltung iSasZentr.iSchaltend.zielgang_sas iSasZentr.iSchaltend.zwangssynchron iSasZentr.iVorbereitend.aktuelle_schaltung iSasZentr.iVorbereitend.erste_schaltung iSasZentr.iVorbereitend.f_verb_ada_erste_bef iSasZentr.iVorbereitend.fkt_halten_in_sync_verboten iSasZentr.iVorbereitend.iKab.ende_kab_gestartet iSasZentr.iVorbereitend.iKab.f_best_poffkab_in_syn_erfolgt iSasZentr.iVorbereitend.iKab.f_ende_verz_kab_erlaubt iSasZentr.iVorbereitend.iKab.f_rueckf_pozustartk0_aktiv iSasZentr.iVorbereitend.iKab.f_warten_auf_sf_k0_aktiv iSasZentr.iVorbereitend.iKab.gls_hs_kab_gestartet iSasZentr.iVorbereitend.iKab.halten_in_syn_kab_gestartet iSasZentr.iVorbereitend.iKab.kab_nicht_befuellt iSasZentr.iVorbereitend.iKab.kup_kab iSasZentr.iVorbereitend.iKab.m_motsoll0_sas iSasZentr.iVorbereitend.iKab.md_motsoll_sas iSasZentr.iVorbereitend.iKab.p_0stkab iSasZentr.iVorbereitend.iKab.p_adaptkab iSasZentr.iVorbereitend.iKab.p_kab iSasZentr.iVorbereitend.iKab.p_kfkab iSasZentr.iVorbereitend.iKab.p_offkab iSasZentr.iVorbereitend.iKab.p_stkab iSasZentr.iVorbereitend.iKab.pgo_kab_speicher.cBibRampeGradSi16._.letzter_ms_timer iSasZentr.iVorbereitend.iKab.pgo_kab_speicher.cBibRampeGradSi16._.letzter_wert iSasZentr.iVorbereitend.iKab.pgo_kab_speicher.cBibRampeGradSi16._.maximum iSasZentr.iVorbereitend.iKab.pgo_kab_speicher.cBibRampeGradSi16._.minimum iSasZentr.iVorbereitend.iKab.pkf_rs_kab_ausgegeben iSasZentr.iVorbereitend.iKab.pkf_rs_kab_gestartet iSasZentr.iVorbereitend.iKab.po_0zustartk0 iSasZentr.iVorbereitend.iKab.po_mtkab iSasZentr.iVorbereitend.iKab.po_zustartk0 iSasZentr.iVorbereitend.iKab.ps_hs_kab_gestartet iSasZentr.iVorbereitend.iKab.ra1_kab_gestartet iSasZentr.iVorbereitend.iKab.ra_sd_hs_kab_gestartet iSasZentr.iVorbereitend.iKab.ra_sd_rs_kab_gestartet iSasZentr.iVorbereitend.iKab.raph_kab_speicher.letzter_timer iSasZentr.iVorbereitend.iKab.raph_kab_speicher.letzter_wert iSasZentr.iVorbereitend.iKab.raps_kab_speicher.letzter_timer iSasZentr.iVorbereitend.iKab.raps_kab_speicher.letzter_wert iSasZentr.iVorbereitend.iKab.schalttyp_kab iSasZentr.iVorbereitend.iKab.statisch_kab iSasZentr.iVorbereitend.iKab.t_0kab iSasZentr.iVorbereitend.iKab.t_ph_rs iSasZentr.iVorbereitend.iKab.t_ra_kab_vor_ra1_kzu iSasZentr.iVorbereitend.iKab.t_verz_ph_rs iSasZentr.iVorbereitend.iKab.t_zkab iSasZentr.iVorbereitend.iKab.timer_hinsyn iSasZentr.iVorbereitend.iKab.timer_pozustartk0 iSasZentr.iVorbereitend.iKab.timer_zkab iSasZentr.iVorbereitend.iKab.ueb_rs_kab_gestartet iSasZentr.iVorbereitend.iKab.z_kab iSasZentr.iVorbereitend.iKab.zaehler_zkab iSasZentr.iVorbereitend.iKzu.dauer_fa_hsrs_kzu iSasZentr.iVorbereitend.iKzu.dauer_ra1_hsrs_kzu iSasZentr.iVorbereitend.iKzu.f_hinsyn_kzu_gestartet iSasZentr.iVorbereitend.iKzu.f_ngs_abflare_unterschritten iSasZentr.iVorbereitend.iKzu.f_pokzufol_erlaubt iSasZentr.iVorbereitend.iKzu.f_rampenzeitberechnung_fertig iSasZentr.iVorbereitend.iKzu.f_schnellfuellung_war_aktiv iSasZentr.iVorbereitend.iKzu.fa_kzu_gestartet iSasZentr.iVorbereitend.iKzu.flag_pomekzu_erlaubt iSasZentr.iVorbereitend.iKzu.kup_kzu iSasZentr.iVorbereitend.iKzu.md_motsoll_sas iSasZentr.iVorbereitend.iKzu.p_0stkzu iSasZentr.iVorbereitend.iKzu.p_adaptkzu iSasZentr.iVorbereitend.iKzu.p_fkzu iSasZentr.iVorbereitend.iKzu.p_fkzu_gueltig iSasZentr.iVorbereitend.iKzu.p_kzu iSasZentr.iVorbereitend.iKzu.p_offkzu iSasZentr.iVorbereitend.iKzu.p_stkzu iSasZentr.iVorbereitend.iKzu.pgo_kzu_speicher.cBibRampeGradSi16._.letzter_ms_timer iSasZentr.iVorbereitend.iKzu.pgo_kzu_speicher.cBibRampeGradSi16._.letzter_wert iSasZentr.iVorbereitend.iKzu.pgo_kzu_speicher.cBibRampeGradSi16._.maximum iSasZentr.iVorbereitend.iKzu.pgo_kzu_speicher.cBibRampeGradSi16._.minimum iSasZentr.iVorbereitend.iKzu.po_kzuflare iSasZentr.iVorbereitend.iKzu.po_mekzu iSasZentr.iVorbereitend.iKzu.po_mtkzu iSasZentr.iVorbereitend.iKzu.ra1_hsrs_kzu_gestartet iSasZentr.iVorbereitend.iKzu.ra2_hsrs_kzu_gestartet iSasZentr.iVorbereitend.iKzu.ra3_hsrs_kzu_gestartet iSasZentr.iVorbereitend.iKzu.raph_kzu_speicher.letzter_timer iSasZentr.iVorbereitend.iKzu.raph_kzu_speicher.letzter_wert iSasZentr.iVorbereitend.iKzu.schalttyp_kzu iSasZentr.iVorbereitend.iKzu.schliessen_kzu iSasZentr.iVorbereitend.iKzu.statisch_kzu iSasZentr.iVorbereitend.iKzu.t_0kzu iSasZentr.iVorbereitend.iKzu.t_berechnungszeitpunkt iSasZentr.iVorbereitend.iKzu.t_besfhsrskzu iSasZentr.iVorbereitend.iKzu.t_eff_ra1_hsrs_kzu iSasZentr.iVorbereitend.iKzu.t_ig_change iSasZentr.iVorbereitend.iKzu.t_vkabr_abgelaufen iSasZentr.iVorbereitend.iKzu.t_zkzu iSasZentr.iVorbereitend.iKzu.timer16_ra1_hsrs_kzu iSasZentr.iVorbereitend.iKzu.timer_ab_ende_sf_kzu iSasZentr.iVorbereitend.iKzu.timer_seit_start_schaltung iSasZentr.iVorbereitend.iKzu.timer_start_fa_kzu iSasZentr.iVorbereitend.iKzu.timer_zkzu iSasZentr.iVorbereitend.iKzu.z_kzu iSasZentr.iVorbereitend.iKzu.zaehler_zkzu iSasZentr.iVorbereitend.index_spsas iSasZentr.iVorbereitend.istgang_sas iSasZentr.iVorbereitend.kup_schutz_massnahme_aktiv iSasZentr.iVorbereitend.m_motsoll0_sas iSasZentr.iVorbereitend.n_tkf iSasZentr.iVorbereitend.n_tsyn iSasZentr.iVorbereitend.nd_syn iSasZentr.iVorbereitend.nd_synistgang iSasZentr.iVorbereitend.nd_vsyn_betr iSasZentr.iVorbereitend.ng_dsynzielgang iSasZentr.iVorbereitend.p_kab_letzte_schaltung iSasZentr.iVorbereitend.p_kzu_letzte_schaltung iSasZentr.iVorbereitend.schaltinfo_sas iSasZentr.iVorbereitend.schaltinfo_sas_vor_folge iSasZentr.iVorbereitend.schaltinfo_syn iSasZentr.iVorbereitend.schnellfuellung_beendet iSasZentr.iVorbereitend.schnellfuellung_gestartet iSasZentr.iVorbereitend.sp_ngdsynzielgang.letzter_ms_timer iSasZentr.iVorbereitend.sp_ngdsynzielgang.n_f iSasZentr.iVorbereitend.synchron iSasZentr.iVorbereitend.synchron_verboten iSasZentr.iVorbereitend.t_maxsas iSasZentr.iVorbereitend.t_syn iSasZentr.iVorbereitend.t_timeout iSasZentr.iVorbereitend.timeout iSasZentr.iVorbereitend.timer16_sas iSasZentr.iVorbereitend.z_kurze_schaltung iSasZentr.iVorbereitend.zielgang_sas iSasZentr.iVorbereitend.zwangssynchron iSasZentr.kup_kzu_ada iSasZentr.kup_nkraftloesend2_letztes_ga iSasZentr.m_motmax_kupschtz iSasZentr.m_motmax_sas iSasZentr.m_motmax_vers iSasZentr.m_tpgrasyn iSasZentr.md_tpgrasyn iSasZentr.mg_wert_gesp iSasZentr.nd_nmot_nt iSasZentr.ng_absas iSasZentr.schaltart_sas iSasZentr.schalttyp iSasZentr.schalttyp_sas iSasZentr.schaltung_abgebrochen iSasZentr.schaltung_sas iSasZentr.schaltung_ueber_kzu iSasZentr.schaltungsende_durch_ge_ga iSasZentr.schrittschaltung iSasZentr.start_wert_grad iSasZentr.sync_istgang_verlassen iSasZentr.sync_istgang_verlassen_me iSasZentr.sync_ziel_erreicht iSasZentr.t_schaltverzug iSasZentr.t_z_m_motmax_kupschtz iSasZentr.timer16_nsyn iSasZentr.timer_hold_sync_ziel iSasZentr.timer_in_synchron iSasZentr.timer_m_motmax_kupschtz iSasZentr.timer_zug_sas iSasZentr.vorbereitung_im_vordergrund iSasZentr.wechsel_normal_kurz iSasZentr.z_m_motmax_kupschtz iSasZentr.z_m_motmax_sas iSasZentr.z_sync_ziel iSasZentr.zaehler_z_m_motmax_kupschtz iSasZentr.zaehler_z_m_motmax_sas iSasZentr.zs_wechsel_verboten iSasZentr.zug_schub_sas /end IN_MEASUREMENT
/end FUNCTION
/begin FUNCTION SDIAGi15_Bitwise_AND_ui32_ "" /begin DEF_CHARACTERISTIC BM_ERSFKT_EMFEHLER_FRK_HAS /end DEF_CHARACTERISTIC /begin LOC_MEASUREMENT z_diag_ersfkt_has_in /end LOC_MEASUREMENT /end FUNCTION
/begin FUNCTION SDIAGi16_Bitwise_AND_ui32_1 "" /begin DEF_CHARACTERISTIC BM_ERSFKTHI_EMFEHLER_FRK_HAS /end DEF_CHARACTERISTIC /begin LOC_MEASUREMENT z_diag_ersfkt_hi_has_in /end LOC_MEASUREMENT /end FUNCTION
/begin FUNCTION SDIAGo34_Ankoppeln_VM "" /begin LOC_MEASUREMENT st_ablauf_fkt /end LOC_MEASUREMENT /end FUNCTION
/begin FUNCTION SDIAGo35_Zustart "" /begin LOC_MEASUREMENT st_ablauf_fkt /end LOC_MEASUREMENT /end FUNCTION
/begin FUNCTION SDIAGo52_Subsystem "" /begin DEF_CHARACTERISTIC CS_GETRK0OEFFNICHT_DIHO /end DEF_CHARACTERISTIC /begin LOC_MEASUREMENT c_getriebe_egs_in /end LOC_MEASUREMENT /end FUNCTION
/begin FUNCTION SDIAGo53_Subsystem1 "" /begin DEF_CHARACTERISTIC CS_GETRK0OEFFNICHT_DIHO /end DEF_CHARACTERISTIC /begin LOC_MEASUREMENT c_getriebe_egs_in /end LOC_MEASUREMENT /end FUNCTION
/begin FUNCTION SDIAGo70_Fehler_liegt_nicht_vor "" /begin DEF_CHARACTERISTIC NS_EMOELVERSFEHLERKALT_ERK_HAS /end DEF_CHARACTERISTIC /begin LOC_MEASUREMENT n_em_in /end LOC_MEASUREMENT /end FUNCTION
/begin FUNCTION SDIAGo71_Fehle__t_vor_Kaltstart "" /begin DEF_CHARACTERISTIC NO_EMOELVERSFEHLER_ERK_HAS SWI_PDEAK_OELVERSFEHLER_ERK_HAS /end DEF_CHARACTERISTIC
 /begin LOC_MEASUREMENT n_em_in n_min_em_has_sbe n_min_psys_em_has_sbe pos_egs_in status_betriebsbereit_hst_in /end LOC_MEASUREMENT
/end FUNCTION
/begin FUNCTION SFHC106_n_min_psys_em_has_mod_1 "" /begin SUB_FUNCTION SFHC108_IfActionSubsystem3 SFHC107_IfActionSubsystem2 /end SUB_FUNCTION /begin LOC_MEASUREMENT p_bremse_fzg_in status_kraftfluss_egs_in /end LOC_MEASUREMENT /end FUNCTION
/begin FUNCTION SFHC107_IfActionSubsystem2 "" /begin DEF_CHARACTERISTIC NO_MIN_EM_PN_HAS /end DEF_CHARACTERISTIC /end FUNCTION
/begin FUNCTION SFHC108_IfActionSubsystem3 "" /begin DEF_CHARACTERISTIC KL_NO_NMIN_EM_PBREMSE_HAS_X KL_NO_NMIN_EM_PBREMSE_HAS_Y /end DEF_CHARACTERISTIC /begin LOC_MEASUREMENT p_bremse_fzg_in /end LOC_MEASUREMENT /end FUNCTION
/begin FUNCTION SFHC10_cN_Min_Psys_EM "" /begin SUB_FUNCTION SFHC72_Status_Psys SFHC71_Berechnung SFHC70_Ausgabe /end SUB_FUNCTION
 /begin LOC_MEASUREMENT c_getriebe_egs_in n_em_in p_bremse_fzg_in st_ist_bz_has_stg st_ziel_bz_has_stg status_betriebsbereit_hst_in status_fehler_iep_in status_iep_in status_kraftfluss_egs_in z_diag_ersfkt_hi_has_in z_iep_in z_n_min_iep_in /end LOC_MEASUREMENT
/end FUNCTION
/begin FUNCTION SFHC114_Verzoe__tus_psys_em_has "" /begin SUB_FUNCTION SFHC117_then SFHC116_else /end SUB_FUNCTION /begin DEF_CHARACTERISTIC TAB_STATUSIEP_HAS TAB_STATUSPSYSEM_HAS /end DEF_CHARACTERISTIC /begin LOC_MEASUREMENT c_getriebe_egs_in status_iep_in /end LOC_MEASUREMENT /end FUNCTION
/begin FUNCTION SFHC116_else "" /begin SUB_FUNCTION Run_SFHC118_cT__tatuspsysem_lp3 /end SUB_FUNCTION /begin LOC_MEASUREMENT t_vstatuspsysem_lp3 /end LOC_MEASUREMENT /end FUNCTION
/begin FUNCTION SFHC117_then "" /begin DEF_CHARACTERISTIC KL_TVSTATUSPSYSEM_LP3_HAS_X KL_TVSTATUSPSYSEM_LP3_HAS_Y /end DEF_CHARACTERISTIC /begin LOC_MEASUREMENT c_getriebe_egs_in /end LOC_MEASUREMENT /end FUNCTION
/begin FUNCTION SFHC121_Subsystem "" /begin LOC_MEASUREMENT status_iep_in /end LOC_MEASUREMENT /end FUNCTION
/begin FUNCTION SFHC12_Anforderung_PVU "" /begin SUB_FUNCTION Run_SFHC16_cTimer_trigger_ /end SUB_FUNCTION /begin DEF_CHARACTERISTIC NS_EMANF_PVU_HAS TS_ANFMAX_PVU_HAS /end DEF_CHARACTERISTIC /begin LOC_MEASUREMENT n_em_in status_posvueb_in t_anfmax_pvu_has /end LOC_MEASUREMENT /end FUNCTION
/begin FUNCTION SFHC13_Beeinflussung_PVU ""
 /begin DEF_CHARACTERISTIC SWI_VMSTARTANF_PVU_HAS TS_MAX_PVU_HAS T_BETRIEBKALTSTARTMAX_PVU_HAS T_BETRIEBMAX_PVU_HAS /end DEF_CHARACTERISTIC
 /begin LOC_MEASUREMENT status_betriebsbereit_hst_in status_posvueb_in /end LOC_MEASUREMENT
/end FUNCTION
/begin FUNCTION SFHC14_Timer_BFI ""
 /begin SUB_FUNCTION Run_SFHC20_cTi___zsashasmax_bbr Run_SFHC19_cTi__sashasaktiv_bbr /end SUB_FUNCTION
 /begin DEF_CHARACTERISTIC TS_AKTIV_PVU_HAS TS_MAX_PVU_HAS /end DEF_CHARACTERISTIC
 /begin LOC_MEASUREMENT status_betriebsbereit_hst_in status_posvueb_in t_aktiv_pvu_has t_betrieb_pvu_has_ee_in t_max_pvu_has /end LOC_MEASUREMENT
/end FUNCTION
/begin FUNCTION SFHC15_VMStart_PVU "" /begin DEF_CHARACTERISTIC Z_ABLAUFVAR_KALTNEM_PVU_HAS /end DEF_CHARACTERISTIC
 /begin LOC_MEASUREMENT st_ziel_bz_has_stg status_betriebsbereit_hst_in z_ablaufvariante_has_stg z_vmkaltstart_pvu_has z_vmstart_pvu_has /end LOC_MEASUREMENT
/end FUNCTION
/begin FUNCTION SFHC16_Abbruch__rung_NormalMode ""
 /begin SUB_FUNCTION SFHC45_Einbind__angsbedingungen SFHC44_Einbind__angsbedingungen SFHC43_Einbind__ittsbedingungen SFHC42_Einbind__ittsbedingungen SFHC18_Abbruchermittlung /end SUB_FUNCTION
 /begin DEF_CHARACTERISTIC BitAbortActive /end DEF_CHARACTERISTIC
 /begin LOC_MEASUREMENT st_ist_bz_hst_sta st_soll_bz_hst_sta status_ablauf_has_fkt z_ablauf_has_hst_in z_ablaufvariante_has_hst_in /end LOC_MEASUREMENT
/end FUNCTION
/begin FUNCTION SFHC18_Abbruchermittlung "" /begin SUB_FUNCTION SFHC21_Detekti__arer_Uebrgaenge /end SUB_FUNCTION /begin LOC_MEASUREMENT st_soll_bz_hst_sta z_ablaufvariante_has_hst_in /end LOC_MEASUREMENT /end FUNCTION
/begin FUNCTION SFHC21_Detekti__arer_Uebrgaenge ""
 /begin SUB_FUNCTION SFHC32_Check_A__ntenunabhaengig SFHC31_Check_A__ID_mit_Variante /end SUB_FUNCTION
 /begin LOC_MEASUREMENT st_soll_bz_hst_sta z_ablaufvariante_has_hst_in /end LOC_MEASUREMENT
/end FUNCTION
/begin FUNCTION SFHC31_Check_A__ID_mit_Variante ""
 /begin SUB_FUNCTION SFHC35_Variant__ruch_detektiert SFHC33_Generie__Abbruchvariante /end SUB_FUNCTION
 /begin LOC_MEASUREMENT st_soll_bz_hst_sta z_ablaufvariante_has_hst_in /end LOC_MEASUREMENT
/end FUNCTION
/begin FUNCTION SFHC32_Check_A__ntenunabhaengig "" /begin DEF_CHARACTERISTIC TAB_ABBRUCHKODIERUNG_X TAB_ABBRUCHKODIERUNG_Y /end DEF_CHARACTERISTIC /end FUNCTION
/begin FUNCTION SFHC33_Generie__Abbruchvariante "" /begin LOC_MEASUREMENT z_ablaufvariante_has_hst_in /end LOC_MEASUREMENT /end FUNCTION
/begin FUNCTION SFHC35_Variant__ruch_detektiert "" /begin DEF_CHARACTERISTIC TAB_ABBRUCHKODIERUNG_X TAB_ABBRUCHKODIERUNG_Y /end DEF_CHARACTERISTIC /end FUNCTION
/begin FUNCTION SFHC42_Einbind__ittsbedingungen "" /begin LOC_MEASUREMENT status_ablauf_has_fkt /end LOC_MEASUREMENT /end FUNCTION
/begin FUNCTION SFHC43_Einbind__ittsbedingungen "" /begin DEF_CHARACTERISTIC STATUS_ABL_ABBRUCH_FERTIG /end DEF_CHARACTERISTIC
 /begin LOC_MEASUREMENT st_ist_bz_hst_sta st_soll_bz_hst_sta status_ablauf_has_fkt z_ablauf_has_hst_in /end LOC_MEASUREMENT
/end FUNCTION
/begin FUNCTION SFHC44_Einbind__angsbedingungen "" /begin SUB_FUNCTION SFHC46_Ueberga__dingungen_HST_1 /end SUB_FUNCTION /begin LOC_MEASUREMENT z_ablauf_has_hst_in z_ablaufvariante_has_hst_in /end LOC_MEASUREMENT /end FUNCTION
/begin FUNCTION SFHC45_Einbind__angsbedingungen "" /begin SUB_FUNCTION SFHC47_Ueberga__dingungen_HST_2 /end SUB_FUNCTION /begin LOC_MEASUREMENT status_ablauf_has_fkt /end LOC_MEASUREMENT /end FUNCTION
/begin FUNCTION SFHC46_Ueberga__dingungen_HST_1 "" /begin DEF_CHARACTERISTIC STATUS_ABL_ABBRUCH_AKTIV STATUS_ABL_ABBRUCH_FERTIG /end DEF_CHARACTERISTIC /begin LOC_MEASUREMENT z_ablauf_has_hst_in /end LOC_MEASUREMENT /end FUNCTION
/begin FUNCTION SFHC47_Ueberga__dingungen_HST_2 "" /begin LOC_MEASUREMENT status_ablauf_has_fkt /end LOC_MEASUREMENT /end FUNCTION
/begin FUNCTION SFHC52_Optiona__ufruf_Erkennung "" /begin DEF_CHARACTERISTIC SWI_ABSTSTATTABK_OML_HAS SWI_ZUSSTATTANK_OML_HAS /end DEF_CHARACTERISTIC /begin LOC_MEASUREMENT SFHC53_AND st_ziel_bz_hst_mod_azg /end LOC_MEASUREMENT /end FUNCTION
/begin FUNCTION SFHC53_IfActionSubsystem "" /begin LOC_MEASUREMENT istgang_egs_in zielgang_egs_in /end LOC_MEASUREMENT /end FUNCTION
/begin FUNCTION SFHC54_IfActionSubsystem2 "" /begin SUB_FUNCTION Run_SFHC56_cTi__tatus_Schaltung /end SUB_FUNCTION /begin DEF_CHARACTERISTIC T_VSCHALTUNGAKTIV_HAS /end DEF_CHARACTERISTIC /begin LOC_MEASUREMENT istgang_egs_in sollgang_egs_in /end LOC_MEASUREMENT /end FUNCTION
/begin FUNCTION SFHC56_Zustandsautomat_Emul_HS "" /begin SUB_FUNCTION SFHC57_Zustand__omat_Emul_HS_SF /end SUB_FUNCTION /begin DEF_CHARACTERISTIC SWI_TESTMODE /end DEF_CHARACTERISTIC /begin LOC_MEASUREMENT status_ablauf_has_fkt status_kl15_in /end LOC_MEASUREMENT /end FUNCTION
/begin FUNCTION SFHC57_Zustand__omat_Emul_HS_SF "" /begin DEF_CHARACTERISTIC SWI_TESTMODE_HS_STAPS /end DEF_CHARACTERISTIC /begin LOC_MEASUREMENT st_testmode_hs_azg status_ablauf_has_fkt /end LOC_MEASUREMENT /end FUNCTION
/begin FUNCTION SFHC5_Abbruchsteuerung "" /begin SUB_FUNCTION SFHC16_Abbruch__rung_NormalMode /end SUB_FUNCTION /begin DEF_CHARACTERISTIC SWI_ZPONRABBRAKTIV_HAS /end DEF_CHARACTERISTIC
 /begin LOC_MEASUREMENT bQuitAbort_azg st_ist_bz_hst_sta st_soll_bz_hst_sta status_ablauf_has_fkt z_ablauf_has_hst_in z_ablaufvariante_has_hst_in z_ponr_fkt /end LOC_MEASUREMENT
/end FUNCTION
/begin FUNCTION SFHC6_Unterstu__tilueberwachung ""
 /begin SUB_FUNCTION SFHC15_VMStart_PVU SFHC14_Timer_BFI SFHC13_Beeinflussung_PVU SFHC12_Anforderung_PVU /end SUB_FUNCTION
 /begin LOC_MEASUREMENT n_em_in st_ziel_bz_has_stg status_betriebsbereit_hst_in status_posvueb_in t_betrieb_pvu_has_ee_in z_ablaufvariante_has_stg /end LOC_MEASUREMENT
/end FUNCTION
/begin FUNCTION SFHC70_Ausgabe ""
 /begin SUB_FUNCTION SFHC76_NULL_ Run_SFHC103_cTimer_trigger_ Run_SFHC94_cPT1_NMinPsys_2 Run_SFHC93_cPT1_NMinPsys_1 Run_SFHC92_cLi__adient_NMinPsys SFHC73_Betriebsbereit_aktiv /end SUB_FUNCTION
 /begin DEF_CHARACTERISTIC FK_NMINPSYSEM_1_HAS FK_NMINPSYSEM_2_HAS NG_MINPSYSEMHASMAX_HAS NG_MINPSYSEMHASMIN_HAS SWI_NMINPSYSEM_HAS T_VBRE_NMINPSYSEM_HAS VGS_FBRE1_NMINPSYSEM_HAS VGS_FBRE2_NMINPSYSEM_HAS VS_FBRE_NMINPSYSEM_HAS /end DEF_CHARACTERISTIC
 /begin LOC_MEASUREMENT SFHC27_xp_ SFHC94_x2_ n_min_psys_em_has_ngbegr n_min_psys_em_has_ref st_ist_bz_has_stg st_ziel_bz_has_stg status_betriebsbereit_hst_in status_fehler_iep_in status_iep_in t_bre_nminpsysem_has z_diag_ersfkt_hi_has_in z_iep_in z_n_min_iep_in /end LOC_MEASUREMENT
/end FUNCTION
/begin FUNCTION SFHC71_Berechnung "" /begin SUB_FUNCTION SFHC106_n_min_psys_em_has_mod_1 /end SUB_FUNCTION /begin DEF_CHARACTERISTIC KL_NMIN_PSYS_EM_HAS_X KL_NMIN_PSYS_EM_HAS_Y /end DEF_CHARACTERISTIC
 /begin LOC_MEASUREMENT c_getriebe_egs_in n_min_psys_em_has_bas n_min_psys_em_has_mod p_bremse_fzg_in status_kraftfluss_egs_in /end LOC_MEASUREMENT
/end FUNCTION
/begin FUNCTION SFHC72_Status_Psys ""
 /begin SUB_FUNCTION Run_SFHC122_cT__ger_psysem_verz SFHC121_Subsystem SFHC114_Verzoe__tus_psys_em_has /end SUB_FUNCTION
 /begin DEF_CHARACTERISTIC KF_INITTVSTATUSIEP_SBE_W KF_INITTVSTATUSIEP_SBE_X KF_INITTVSTATUSIEP_SBE_Y KF_TVSTATUSIEPSST_SBE_W KF_TVSTATUSIEPSST_SBE_X KF_TVSTATUSIEPSST_SBE_Y KF_TVSTATUSIEP_SBE_W KF_TVSTATUSIEP_SBE_X KF_TVSTATUSIEP_SBE_Y NO_NMIN_PSYS_EM_L1AUS NO_NMIN_PSYS_EM_L1L3 NO_NMIN_PSYS_EM_L3L1 NS_NMIN_EM_L1_HAS SWI_PVU_STATUSPSYS_HAS SWI_STATUSPSYS_MPS_HAS /end DEF_CHARACTERISTIC
 /begin LOC_MEASUREMENT c_getriebe_egs_in n_em_in status_betriebsbereit_hst_in status_iep_in status_psys_em_has_nverz /end LOC_MEASUREMENT
/end FUNCTION
/begin FUNCTION SFHC73_Betriebsbereit_aktiv ""
 /begin SUB_FUNCTION Run_SFHC82_cTimer_kl50_ein_has SFHC81_Timer_kl50_inaktiv SFHC80_NULL /end SUB_FUNCTION
 /begin DEF_CHARACTERISTIC T_VNMINPSYSEM_KL50_HAS /end DEF_CHARACTERISTIC
 /begin LOC_MEASUREMENT st_ist_bz_has_stg st_ziel_bz_has_stg status_fehler_iep_in status_iep_in z_diag_ersfkt_hi_has_in z_iep_in z_n_min_iep_in /end LOC_MEASUREMENT
/end FUNCTION
/begin FUNCTION SFHC76_NULL_ "" /begin DEF_CHARACTERISTIC INIT /end DEF_CHARACTERISTIC /end FUNCTION
/begin FUNCTION SFHC80_NULL "" /begin DEF_CHARACTERISTIC INIT /end DEF_CHARACTERISTIC /end FUNCTION
/begin FUNCTION SFHC81_Timer_kl50_inaktiv "" /begin SUB_FUNCTION SFHC84_BEST_OHNE_STATUS_IEP SFHC83_BEST_MIT_STATUS_IEP /end SUB_FUNCTION /begin DEF_CHARACTERISTIC SWI_MODUS_NMINPSYS_HAS /end DEF_CHARACTERISTIC
 /begin LOC_MEASUREMENT st_ist_bz_has_stg st_ziel_bz_has_stg status_fehler_iep_in status_iep_in z_diag_ersfkt_hi_has_in z_iep_in z_n_min_iep_in /end LOC_MEASUREMENT
/end FUNCTION
/begin FUNCTION SFHC83_BEST_MIT_STATUS_IEP "" /begin SUB_FUNCTION SFHC86_IEP_aus_n_min_aktiv SFHC85_IEP_Status /end SUB_FUNCTION /begin DEF_CHARACTERISTIC SWI_ZNMINIEP_HAS /end DEF_CHARACTERISTIC /begin LOC_MEASUREMENT status_fehler_iep_in status_iep_in z_iep_in z_n_min_iep_in /end LOC_MEASUREMENT /end FUNCTION
/begin FUNCTION SFHC84_BEST_OHNE_STATUS_IEP "" /begin SUB_FUNCTION SFHC89_Bitwise_AND_ui32_ /end SUB_FUNCTION /begin DEF_CHARACTERISTIC AKTIV SWI_ZNMINIEP_HAS /end DEF_CHARACTERISTIC
 /begin LOC_MEASUREMENT st_ist_bz_has_stg st_ziel_bz_has_stg status_fehler_iep_in z_diag_ersfkt_hi_has_in z_n_min_iep_in /end LOC_MEASUREMENT
/end FUNCTION
/begin FUNCTION SFHC85_IEP_Status "" /begin SUB_FUNCTION SFHC88_IEP_aus /end SUB_FUNCTION /begin DEF_CHARACTERISTIC INIT /end DEF_CHARACTERISTIC /begin LOC_MEASUREMENT status_iep_in /end LOC_MEASUREMENT /end FUNCTION
/begin FUNCTION SFHC86_IEP_aus_n_min_aktiv "" /begin DEF_CHARACTERISTIC AKTIV /end DEF_CHARACTERISTIC /end FUNCTION
/begin FUNCTION SFHC88_IEP_aus "" /begin DEF_CHARACTERISTIC AKTIV /end DEF_CHARACTERISTIC /end FUNCTION
/begin FUNCTION SFHC89_Bitwise_AND_ui32_ "" /begin LOC_MEASUREMENT z_diag_ersfkt_hi_has_in /end LOC_MEASUREMENT /end FUNCTION
/begin FUNCTION SFOp10_FOp_Gangeinlegen "" /begin SUB_FUNCTION Action_FOp_GAE /end SUB_FUNCTION
 /begin LOC_MEASUREMENT abstellpos_vm_in abstellpos_vm_status_in c_getriebe_egs_in c_vm_in gangwechsel_egs_in i_istgang_egs i_zielgang_egs istgang_egs_in m_em_in m_iae_in m_k0_in m_k0_mber_has_sbe m_max_dyn_em_in m_min_dyn_em_in m_min_vm_in m_mot_in m_motmax_has m_soll_em_hst_in m_soll_res_em_bas_sbe m_soll_res_em_has_sbe m_soll_vm_hst_in m_soll_vm_l_hst_in m_vm_in m_vm_start_in m_wunsch_fpw_hst_fil m_wunsch_fpw_hst_in m_wunsch_fpw_in mg_wunsch_fpw mg_wunsch_fpw_hst n_ab_egs_in n_em_in n_min_em_has_sbe n_min_psys_em_has_sbe n_mot_soll_iae_in n_sec_iae n_soll_em_hst_in n_soll_ll_vm_in n_t_egs_in n_vm_in nd_iae nd_k0_in ndg_k0_in ng_vm osmode_next_in p_bremse_fzg_in phi_neigung_in pos_egs_in sollgang_egs_in st_OMLID_act_stg st_ablauf_fkt st_ist_bz_has_stg st_soll_bz_has_hst st_ziel_bz_has_stg status_ablauf_has_fkt status_alaengs_adaoff_in status_betriebsbereit_hst_in status_efahren_has_sbe status_fehler15_eh_diagin status_fehler_iep_in status_iae_adap_in status_iae_in status_iep_in status_k0_adap_in status_k0_in status_kl15_in status_kolbenpos_k0_in status_kraftfluss_egs_in status_kraftfluss_egs_roh_in status_ll_vm_in status_nem_in status_nreg_em_hst_in status_nvm_in status_posvueb_in status_psys_has_sbe status_sa_vm_in status_schaltart_svh_has_sbe status_schaltung_egs_in status_sync_schaltung_sbe status_waschstr_in status_zug_svh_sbe t_betrieb_pvu_has_ee_in t_betrieb_pvu_has_sbe v_f_sbe vg_f_sbe z_ablauf_has_hst_in z_ablauf_has_stg z_ablaufreinit_frk_dihi z_ablaufvariante_has_hst_in z_ablaufvariante_has_stg z_ba_has_k0_hst_in z_ba_has_vm_hst_in z_diag_ersfkt_has_in z_diag_ersfkt_hi_has_in z_diag_notgang_has_in z_emfehler_frk_dihi z_freigabe_pvu_has_sbe z_fuwdeakt_frk_dihi z_hybfkt_stg z_iep_in z_k0_fst_in z_k0_has_sbe z_k0syncmk0erh_frk_dihi z_kps_stada_in z_modus_em_hst_in z_modus_iae_has_sbe z_modus_iep_has_sbe z_msa_avh_moni_has_sbe z_msa_eaf_moni_has_sbe z_msa_fst_in z_msa_has_sbe z_msa_stada_in z_n_min_em_parksp_has_in z_n_min_iep_in z_nllsoll_iae_in z_nminemnull_frk_dihi z_nvmsollbegr_frk_dihi z_pvu_has_sbe z_sas_has_sbe z_start_modus_has_sbe z_status_psys_mps_sbe z_svh_has_sbe z_ziel_kraftfluss_egs_in zielgang_egs_in /end LOC_MEASUREMENT
/end FUNCTION
/begin FUNCTION SFOp12_FOp_Notstart "" /begin SUB_FUNCTION Action_FOp_NOS /end SUB_FUNCTION
 /begin LOC_MEASUREMENT abstellpos_vm_in abstellpos_vm_status_in c_getriebe_egs_in c_vm_in gangwechsel_egs_in i_istgang_egs i_zielgang_egs istgang_egs_in m_em_in m_iae_in m_k0_in m_k0_mber_has_sbe m_k0_mod_has_fkt m_max_dyn_em_in m_min_dyn_em_in m_min_vm_in m_mot_in m_motmax_has m_soll_em_hst_in m_soll_k0_has_fkt m_soll_res_em_bas_sbe m_soll_res_em_has_sbe m_soll_vm_hst_in m_soll_vm_l_hst_in m_vm_in m_vm_start_in m_wunsch_fpw_hst_fil m_wunsch_fpw_hst_in m_wunsch_fpw_in mg_wunsch_fpw mg_wunsch_fpw_hst n_ab_egs_in n_em_in n_min_em_has_sbe n_min_psys_em_has_sbe n_mot_soll_iae_in n_sec_iae n_soll_em_hst_in n_soll_ll_vm_in n_t_egs_in n_vm_in nd_iae nd_k0_in ndg_k0_in ng_vm osmode_next_in p_bremse_fzg_in phi_neigung_in pos_egs_in sollgang_egs_in st_OMLID_act_stg st_ablauf_fkt st_ist_bz_has_stg st_soll_bz_has_hst st_ziel_bz_has_stg status_ablauf_has_fkt status_alaengs_adaoff_in status_betriebsbereit_hst_in status_efahren_has_sbe status_fehler15_eh_diagin status_fehler_iep_in status_iae_adap_in status_iae_in status_iep_in status_k0_adap_in status_k0_in status_kl15_in status_kolbenpos_k0_in status_kraftfluss_egs_in status_kraftfluss_egs_roh_in status_ll_vm_in status_nem_in status_nreg_em_hst_in status_nvm_in status_posvueb_in status_psys_has_sbe status_sa_vm_in status_schaltart_svh_has_sbe status_schaltung_egs_in status_sync_schaltung_sbe status_waschstr_in status_zug_svh_sbe t_betrieb_pvu_has_ee_in t_betrieb_pvu_has_sbe v_f_sbe vg_f_sbe z_ablauf_has_hst_in z_ablauf_has_stg z_ablaufreinit_frk_dihi z_ablaufvariante_has_hst_in z_ablaufvariante_has_stg z_ba_has_k0_hst_in z_ba_has_vm_hst_in z_diag_ersfkt_has_in z_diag_ersfkt_hi_has_in z_diag_notgang_has_in z_emfehler_frk_dihi z_freigabe_pvu_has_sbe z_fuwdeakt_frk_dihi z_hybfkt_stg z_iep_in z_k0_fst_in z_k0_has_fkt z_k0_has_sbe z_k0syncmk0erh_frk_dihi z_kps_stada_in z_modus_em_hst_in z_modus_iae_has_sbe z_modus_iep_has_sbe z_msa_avh_moni_has_sbe z_msa_eaf_moni_has_sbe z_msa_fst_in z_msa_has_sbe z_msa_stada_in z_n_min_em_parksp_has_in z_n_min_iep_in z_nllsoll_iae_in z_nminemnull_frk_dihi z_nvmsollbegr_frk_dihi z_p_hys_k0_has_fkt z_pvu_has_sbe z_sas_has_sbe z_start_modus_has_sbe z_status_psys_mps_sbe z_svh_has_sbe z_ziel_kraftfluss_egs_in z_zuendfreigabe_vm_fkt zielgang_egs_in /end LOC_MEASUREMENT
/end FUNCTION
/begin FUNCTION SFOp13_FOp_OhneAblauffkt "" /begin SUB_FUNCTION Action_FOp_OhneAblauffkt /end SUB_FUNCTION
 /begin LOC_MEASUREMENT c_getriebe_egs_in gangwechsel_egs_in istgang_egs_in m_em_in m_iae_in m_k0_in m_max_dyn_em_in m_min_dyn_em_in m_mot_in m_soll_em_hst_in m_soll_vm_hst_in m_vm_in m_vm_start_in m_wunsch_fpw_in n_ab_egs_in n_em_in n_mot_soll_iae_in n_soll_ll_vm_in n_t_egs_in n_vm_in osmode_next_in p_bremse_fzg_in phi_neigung_in pos_egs_in sollgang_egs_in status_alaengs_adaoff_in status_fehler_iep_in status_iae_adap_in status_iae_in status_iep_in status_k0_adap_in status_k0_in status_kolbenpos_k0_in status_kraftfluss_egs_in status_kraftfluss_egs_roh_in status_ll_vm_in status_nem_in status_nvm_in status_posvueb_in status_waschstr_in t_betrieb_pvu_has_ee_in z_ablauf_has_hst_in z_ablaufvariante_has_hst_in z_diag_ersfkt_has_in z_diag_ersfkt_hi_has_in z_diag_notgang_has_in z_iep_in z_k0_fst_in z_kps_stada_in z_modus_em_hst_in z_msa_fst_in z_n_min_em_parksp_has_in z_n_min_iep_in z_nllsoll_iae_in z_ziel_kraftfluss_egs_in zielgang_egs_in /end LOC_MEASUREMENT
/end FUNCTION
/begin FUNCTION SFOp14_FOp_Passiv "" /begin SUB_FUNCTION Action_FOp_Passiv /end SUB_FUNCTION
 /begin LOC_MEASUREMENT abstellpos_vm_in abstellpos_vm_status_in c_getriebe_egs_in c_vm_in gangwechsel_egs_in i_istgang_egs i_zielgang_egs istgang_egs_in m_em_in m_iae_in m_k0_in m_k0_mber_has_sbe m_k0_mod_has_fkt m_max_dyn_em_in m_max_iae_has_fkt m_min_dyn_em_in m_min_vm_in m_mot_in m_motmax_has m_soll_em_has_fkt m_soll_em_hst_in m_soll_k0_has_fkt m_soll_res_em_bas_sbe m_soll_res_em_has_sbe m_soll_vm_has_fkt m_soll_vm_hst_in m_soll_vm_l_has_fkt m_soll_vm_l_hst_in m_vm_in m_vm_start_in m_wunsch_fpw_hst_fil m_wunsch_fpw_hst_in m_wunsch_fpw_in mg_max_em_has_fkt mg_min_em_has_fkt mg_soll_k0_has_fkt mg_wunsch_fpw mg_wunsch_fpw_hst n_ab_egs_in n_em_in n_min_em_has_sbe n_min_psys_em_has_sbe n_mot_soll_iae_in n_sec_iae n_soll_em_has_fkt n_soll_em_hst_in n_soll_ll_vm_in n_soll_vm_has_fkt n_t_egs_in n_vm_in nd_iae nd_k0_in ndg_k0_in ng_vm osmode_next_in p_bremse_fzg_in phi_neigung_in pos_egs_in sollgang_egs_in st_OMLID_act_stg st_ablauf_fkt st_ist_bz_has_stg st_soll_bz_has_hst st_ziel_bz_has_stg status_ablauf_has_fkt status_alaengs_adaoff_in status_betriebsbereit_hst_in status_efahren_has_sbe status_fehler15_eh_diagin status_fehler_iep_in status_iae_adap_in status_iae_in status_iep_in status_k0_adap_in status_k0_in status_kl15_in status_kolbenpos_k0_in status_kraftfluss_egs_in status_kraftfluss_egs_roh_in status_ll_vm_in status_nem_in status_nreg_em_hst_in status_nvm_in status_posvueb_in status_psys_has_sbe status_sa_vm_in status_schaltart_svh_has_sbe status_schaltung_egs_in status_sync_schaltung_sbe status_waschstr_in status_zug_svh_sbe t_betrieb_pvu_has_ee_in t_betrieb_pvu_has_sbe v_f_sbe vg_f_sbe z_ablauf_has_hst_in z_ablauf_has_stg z_ablauf_svh_reset_has_fkt z_ablaufreinit_frk_dihi z_ablaufvariante_has_hst_in z_ablaufvariante_has_stg z_ba_has_k0_hst_in z_ba_has_vm_hst_in z_diag_ersfkt_has_in z_diag_ersfkt_hi_has_in z_diag_notgang_has_in z_emaktiv_fuw_zus_fkt z_emfehler_frk_dihi z_fehler15_eh_fkt z_freigabe_pvu_has_sbe z_fuwdeakt_frk_dihi z_hybfkt_stg z_iep_in z_k0_fst_in z_k0_has_fkt z_k0_has_sbe z_k0syncmk0erh_frk_dihi z_kps_stada_in z_m_max_iae_has_fkt z_m_soll_em_has_fkt z_m_soll_vm_has_fkt z_modus_em_hst_in z_modus_iae_has_sbe z_modus_iep_has_sbe z_msa_avh_moni_has_sbe z_msa_eaf_moni_has_sbe z_msa_fst_in z_msa_has_sbe z_msa_stada_in z_n_min_em_parksp_has_in z_n_min_iep_in z_n_soll_em_has_fkt z_n_soll_vm_has_fkt z_nllsoll_iae_in z_nminemnull_frk_dihi z_nvmsollbegr_frk_dihi z_p_hys_k0_has_fkt z_ponr_fkt z_pvu_has_sbe z_sas_has_sbe z_start_modus_has_sbe z_status_psys_mps_sbe z_svh_has_sbe z_ziel_kraftfluss_egs_in z_zuendfreigabe_vm_has_fkt zielgang_egs_in /end LOC_MEASUREMENT
/end FUNCTION
/begin FUNCTION SFOp15_FOp_Schleppstart "" /begin SUB_FUNCTION Action_FOp_SCHLST /end SUB_FUNCTION
 /begin LOC_MEASUREMENT abstellpos_vm_in abstellpos_vm_status_in bErrorHybrid bExceptionHybrid c_getriebe_egs_in c_vm_in gangwechsel_egs_in i_istgang_egs i_zielgang_egs istgang_egs_in m_em_in m_iae_in m_k0_in m_k0_mber_has_sbe m_k0_mod_has_fkt m_max_dyn_em_in m_max_em_has_fkt m_max_iae_has_fkt m_min_dyn_em_in m_min_em_has_fkt m_min_vm_in m_mot_in m_motmax_has m_soll_em_has_fkt m_soll_em_hst_in m_soll_k0_has_fkt m_soll_res_em_bas_sbe m_soll_res_em_has_fkt m_soll_res_em_has_sbe m_soll_vm_hst_in m_soll_vm_l_hst_in m_vm_in m_vm_start_in m_wunsch_fpw_hst_fil m_wunsch_fpw_hst_in m_wunsch_fpw_in mg_soll_k0_has_fkt mg_wunsch_fpw mg_wunsch_fpw_hst n_ab_egs_in n_em_in n_min_em_has_sbe n_min_psys_em_has_sbe n_mot_soll_iae_in n_sec_iae n_soll_em_has_fkt n_soll_em_hst_in n_soll_ll_vm_in n_soll_vm_has_fkt n_t_egs_in n_vm_in nd_iae nd_k0_in ndg_k0_in ng_vm osmode_next_in p_bremse_fzg_in phi_neigung_in pos_egs_in sollgang_egs_in st_OMLID_act_stg st_ablauf_fkt st_ist_bz_has_stg st_ist_bz_hst_sta st_soll_bz_has_hst st_soll_bz_hst_sta st_ziel_bz_has_stg status_ablauf_has_fkt status_alaengs_adaoff_in status_betriebsbereit_hst_in status_efahren_has_sbe status_fehler15_eh_diagin status_fehler_iep_in status_iae_adap_in status_iae_in status_iep_in status_k0_adap_in status_k0_in status_kl15_in status_kolbenpos_k0_in status_kraftfluss_egs_in status_kraftfluss_egs_roh_in status_ll_vm_in status_nem_in status_nreg_em_hst_in status_nvm_in status_posvueb_in status_psys_has_sbe status_sa_vm_in status_schaltart_svh_has_sbe status_schaltung_egs_in status_sync_schaltung_sbe status_waschstr_in status_zug_svh_sbe t_betrieb_pvu_has_ee_in t_betrieb_pvu_has_sbe v_f_sbe vg_f_sbe z_ablauf_has_hst_in z_ablauf_has_stg z_ablauf_svh_reset_has_fkt z_ablaufreinit_frk_dihi z_ablaufvariante_has_hst_in z_ablaufvariante_has_stg z_ba_has_k0_hst_in z_ba_has_vm_hst_in z_diag_ersfkt_has_in z_diag_ersfkt_hi_has_in z_diag_notgang_has_in z_emfehler_frk_dihi z_freigabe_pvu_has_sbe z_fuwdeakt_frk_dihi z_hybfkt_stg z_iep_in z_init_sta z_k0_befuellopt_has_fkt z_k0_fst_in z_k0_has_fkt z_k0_has_sbe z_k0syncmk0erh_frk_dihi z_kps_stada_in z_m_max_iae_has_fkt z_m_soll_em_has_fkt z_modus_em_hst_in z_modus_iae_has_sbe z_modus_iep_has_sbe z_msa_avh_moni_has_sbe z_msa_eaf_moni_has_sbe z_msa_fst_in z_msa_has_sbe z_msa_stada_in z_n_min_em_parksp_has_in z_n_min_iep_in z_n_soll_em_has_fkt z_n_soll_vm_has_fkt z_nllsoll_iae_in z_nminemnull_frk_dihi z_nvmsollbegr_frk_dihi z_p_hys_k0_has_fkt z_pvu_has_sbe z_saf_has_fkt z_sas_has_sbe z_start_modus_has_sbe z_status_psys_mps_sbe z_svh_has_sbe z_ziel_kraftfluss_egs_in zielgang_egs_in /end LOC_MEASUREMENT
/end FUNCTION
/begin FUNCTION SFOp16_FOp_VMaus "" /begin SUB_FUNCTION Action_FOp_VMaus /end SUB_FUNCTION
 /begin LOC_MEASUREMENT abstellpos_vm_in abstellpos_vm_status_in c_getriebe_egs_in c_vm_in gangwechsel_egs_in i_istgang_egs i_zielgang_egs istgang_egs_in m_em_in m_iae_in m_k0_in m_k0_mber_has_sbe m_max_dyn_em_in m_min_dyn_em_in m_min_vm_in m_mot_in m_motmax_has m_soll_em_hst_in m_soll_res_em_bas_sbe m_soll_res_em_has_sbe m_soll_vm_hst_in m_soll_vm_l_hst_in m_vm_in m_vm_start_in m_wunsch_fpw_hst_fil m_wunsch_fpw_hst_in m_wunsch_fpw_in mg_wunsch_fpw mg_wunsch_fpw_hst n_ab_egs_in n_em_in n_min_em_has_sbe n_min_psys_em_has_sbe n_mot_soll_iae_in n_sec_iae n_soll_em_hst_in n_soll_ll_vm_in n_t_egs_in n_vm_in nd_iae nd_k0_in ndg_k0_in ng_vm osmode_next_in p_bremse_fzg_in phi_neigung_in pos_egs_in sollgang_egs_in st_OMLID_act_stg st_ablauf_fkt st_ist_bz_has_stg st_soll_bz_has_hst st_ziel_bz_has_stg status_ablauf_has_fkt status_alaengs_adaoff_in status_betriebsbereit_hst_in status_efahren_has_sbe status_fehler15_eh_diagin status_fehler_iep_in status_iae_adap_in status_iae_in status_iep_in status_k0_adap_in status_k0_in status_kl15_in status_kolbenpos_k0_in status_kraftfluss_egs_in status_kraftfluss_egs_roh_in status_ll_vm_in status_nem_in status_nreg_em_hst_in status_nvm_in status_posvueb_in status_psys_has_sbe status_sa_vm_in status_schaltart_svh_has_sbe status_schaltung_egs_in status_sync_schaltung_sbe status_waschstr_in status_zug_svh_sbe t_betrieb_pvu_has_ee_in t_betrieb_pvu_has_sbe v_f_sbe vg_f_sbe z_ablauf_has_hst_in z_ablauf_has_stg z_ablauf_svh_reset_has_fkt z_ablaufreinit_frk_dihi z_ablaufvariante_has_hst_in z_ablaufvariante_has_stg z_ba_has_k0_hst_in z_ba_has_vm_hst_in z_diag_ersfkt_has_in z_diag_ersfkt_hi_has_in z_diag_notgang_has_in z_emfehler_frk_dihi z_freigabe_pvu_has_sbe z_fuwdeakt_frk_dihi z_hybfkt_stg z_iep_in z_k0_fst_in z_k0_has_sbe z_k0syncmk0erh_frk_dihi z_kps_stada_in z_modus_em_hst_in z_modus_iae_has_sbe z_modus_iep_has_sbe z_msa_avh_moni_has_sbe z_msa_eaf_moni_has_sbe z_msa_fst_in z_msa_has_sbe z_msa_stada_in z_n_min_em_parksp_has_in z_n_min_iep_in z_nllsoll_iae_in z_nminemnull_frk_dihi z_nvmsollbegr_frk_dihi z_pvu_has_sbe z_sas_has_sbe z_start_modus_has_sbe z_status_psys_mps_sbe z_svh_has_sbe z_ziel_kraftfluss_egs_in z_zuendfreigabe_vm_has_fkt zielgang_egs_in /end LOC_MEASUREMENT
/end FUNCTION
/begin FUNCTION SFOp17_FOp_VMein "" /begin SUB_FUNCTION Action_FOp_VMein /end SUB_FUNCTION
 /begin LOC_MEASUREMENT abstellpos_vm_in abstellpos_vm_status_in c_getriebe_egs_in c_vm_in gangwechsel_egs_in i_istgang_egs i_zielgang_egs istgang_egs_in m_em_in m_iae_in m_k0_in m_k0_mber_has_sbe m_max_dyn_em_in m_min_dyn_em_in m_min_vm_in m_mot_in m_motmax_has m_soll_em_hst_in m_soll_res_em_bas_sbe m_soll_res_em_has_sbe m_soll_vm_hst_in m_soll_vm_l_hst_in m_vm_in m_vm_start_in m_wunsch_fpw_hst_fil m_wunsch_fpw_hst_in m_wunsch_fpw_in mg_wunsch_fpw mg_wunsch_fpw_hst n_ab_egs_in n_em_in n_min_em_has_sbe n_min_psys_em_has_sbe n_mot_soll_iae_in n_sec_iae n_soll_em_hst_in n_soll_ll_vm_in n_t_egs_in n_vm_in nd_iae nd_k0_in ndg_k0_in ng_vm osmode_next_in p_bremse_fzg_in phi_neigung_in pos_egs_in sollgang_egs_in st_OMLID_act_stg st_ablauf_fkt st_ist_bz_has_stg st_soll_bz_has_hst st_ziel_bz_has_stg status_ablauf_has_fkt status_alaengs_adaoff_in status_betriebsbereit_hst_in status_efahren_has_sbe status_fehler15_eh_diagin status_fehler_iep_in status_iae_adap_in status_iae_in status_iep_in status_k0_adap_in status_k0_in status_kl15_in status_kolbenpos_k0_in status_kraftfluss_egs_in status_kraftfluss_egs_roh_in status_ll_vm_in status_nem_in status_nreg_em_hst_in status_nvm_in status_posvueb_in status_psys_has_sbe status_sa_vm_in status_schaltart_svh_has_sbe status_schaltung_egs_in status_sync_schaltung_sbe status_waschstr_in status_zug_svh_sbe t_betrieb_pvu_has_ee_in t_betrieb_pvu_has_sbe v_f_sbe vg_f_sbe z_ablauf_has_hst_in z_ablauf_has_stg z_ablauf_svh_reset_has_fkt z_ablaufreinit_frk_dihi z_ablaufvariante_has_hst_in z_ablaufvariante_has_stg z_ba_has_k0_hst_in z_ba_has_vm_hst_in z_diag_ersfkt_has_in z_diag_ersfkt_hi_has_in z_diag_notgang_has_in z_emfehler_frk_dihi z_freigabe_pvu_has_sbe z_fuwdeakt_frk_dihi z_hybfkt_stg z_iep_in z_k0_fst_in z_k0_has_sbe z_k0syncmk0erh_frk_dihi z_kps_stada_in z_modus_em_hst_in z_modus_iae_has_sbe z_modus_iep_has_sbe z_msa_avh_moni_has_sbe z_msa_eaf_moni_has_sbe z_msa_fst_in z_msa_has_sbe z_msa_stada_in z_n_min_em_parksp_has_in z_n_min_iep_in z_nllsoll_iae_in z_nminemnull_frk_dihi z_nvmsollbegr_frk_dihi z_pvu_has_sbe z_sas_has_sbe z_start_modus_has_sbe z_status_psys_mps_sbe z_svh_has_sbe z_ziel_kraftfluss_egs_in z_zuendfreigabe_vm_has_fkt zielgang_egs_in /end LOC_MEASUREMENT
/end FUNCTION
/begin FUNCTION SFOp18_FOp_Zustart "" /begin SUB_FUNCTION Action_FOp_ZUST /end SUB_FUNCTION
 /begin LOC_MEASUREMENT abstellpos_vm_in abstellpos_vm_status_in c_getriebe_egs_in c_vm_in gangwechsel_egs_in i_istgang_egs i_zielgang_egs istgang_egs_in m_em_in m_iae_in m_k0_in m_k0_mber_has_sbe m_k0_mod_has_fkt m_max_dyn_em_in m_max_iae_has_fkt m_min_dyn_em_in m_min_vm_in m_mot_in m_motmax_has m_soll_em_has_fkt m_soll_em_hst_in m_soll_k0_has_fkt m_soll_res_em_bas_sbe m_soll_res_em_has_fkt m_soll_res_em_has_sbe m_soll_vm_has_fkt m_soll_vm_hst_in m_soll_vm_l_hst_in m_vm_in m_vm_start_in m_wunsch_fpw_hst_fil m_wunsch_fpw_hst_in m_wunsch_fpw_in mg_wunsch_fpw mg_wunsch_fpw_hst n_ab_egs_in n_em_in n_min_em_has_sbe n_min_psys_em_has_sbe n_mot_soll_iae_in n_sec_iae n_soll_em_has_fkt n_soll_em_hst_in n_soll_ll_vm_in n_soll_vm_has_fkt n_t_egs_in n_vm_in nd_iae nd_k0_in ndg_k0_in ng_vm osmode_next_in p_bremse_fzg_in phi_neigung_in pos_egs_in sollgang_egs_in st_OMLID_act_stg st_ablauf_fkt st_ist_bz_has_stg st_soll_bz_has_hst st_ziel_bz_has_stg status_ablauf_has_fkt status_alaengs_adaoff_in status_betriebsbereit_hst_in status_efahren_has_sbe status_fehler15_eh_diagin status_fehler_iep_in status_iae_adap_in status_iae_in status_iep_in status_k0_adap_in status_k0_in status_kl15_in status_kolbenpos_k0_in status_kraftfluss_egs_in status_kraftfluss_egs_roh_in status_ll_vm_in status_nem_in status_nreg_em_hst_in status_nvm_in status_posvueb_in status_psys_has_sbe status_sa_vm_in status_schaltart_svh_has_sbe status_schaltung_egs_in status_sync_schaltung_sbe status_waschstr_in status_zug_svh_sbe t_betrieb_pvu_has_ee_in t_betrieb_pvu_has_sbe v_f_sbe vg_f_sbe z_ablauf_has_hst_in z_ablauf_has_stg z_ablauf_svh_reset_has_fkt z_ablaufreinit_frk_dihi z_ablaufvariante_has_hst_in z_ablaufvariante_has_stg z_ablaufvariante_kalt_zus z_ba_has_k0_hst_in z_ba_has_vm_hst_in z_diag_ersfkt_has_in z_diag_ersfkt_hi_has_in z_diag_notgang_has_in z_emaktiv_fuw_zus_fkt z_emfehler_frk_dihi z_freigabe_pvu_has_sbe z_fuwdeakt_frk_dihi z_hybfkt_stg z_iep_in z_k0_fst_in z_k0_has_fkt z_k0_has_sbe z_k0syncmk0erh_frk_dihi z_kps_stada_in z_m_max_iae_has_fkt z_m_soll_em_has_fkt z_m_soll_vm_has_fkt z_modus_em_hst_in z_modus_iae_has_sbe z_modus_iep_has_sbe z_msa_avh_moni_has_sbe z_msa_eaf_moni_has_sbe z_msa_fst_in z_msa_has_sbe z_msa_stada_in z_n_min_em_parksp_has_in z_n_min_iep_in z_n_soll_em_has_fkt z_n_soll_vm_has_fkt z_nllsoll_iae_in z_nminemnull_frk_dihi z_nvmsollbegr_frk_dihi z_p_hys_k0_has_fkt z_ponr_fkt z_pvu_has_sbe z_saf_has_fkt z_sas_has_sbe z_start_modus_has_sbe z_status_psys_mps_sbe z_svh_has_sbe z_ziel_kraftfluss_egs_in z_zuendfreigabe_vm_has_fkt zielgang_egs_in /end LOC_MEASUREMENT
/end FUNCTION
/begin FUNCTION SFOp19_DS_Read ""
 /begin LOC_MEASUREMENT m_k0_fkt m_k0_mod_has_fkt m_max_em_has_fkt m_max_iae_has_fkt m_min_em_has_fkt m_soll_em_has_fkt m_soll_k0_has_fkt m_soll_res_em_has_fkt m_soll_vm_has_fkt m_soll_vm_l_has_fkt mg_max_em_has_fkt mg_min_em_has_fkt mg_soll_k0_has_fkt mod_K0_fkt n_soll_em_has_fkt n_soll_vm_has_fkt nd_soll_iae_fkt st_ablauf_fkt status_ablauf_has_fkt timer_pumpready_aktiv_fkt z_ablauf_svh_reset_has_fkt z_ablaufvariante_kalt_zus z_emaktiv_fuw_zus_fkt z_fehler15_eh_fkt z_init_fkt z_k0_befuellopt_has_fkt z_k0_has_fkt z_m_begr_em_has_fkt z_m_max_iae_has_fkt z_m_soll_em_has_fkt z_m_soll_vm_has_fkt z_modus_iae_has_fkt z_n_soll_em_has_fkt z_n_soll_vm_has_fkt z_p_hys_k0_has_fkt z_ponr_fkt z_saf_has_fkt z_sbe_has_fkt z_standby_em_has_fkt z_timer_pumpready_fkt z_tmin_fehler15_fkt z_zuendfreigabe_vm_has_fkt /end LOC_MEASUREMENT
/end FUNCTION
/begin FUNCTION SFOp20_DS_Write ""
 /begin SUB_FUNCTION SFOp36_OPZustartMerge SFOp35_OPVMeinMerge SFOp34_OPVMausMerge SFOp33_OPSchleppstart SFOp32_OPPassivMerge SFOp31_OPOhneAblaufFktMerge SFOp30_OPNotstart SFOp29_OPGangEinlegenMerge SFOp28_OPGangAuslegenMerge SFOp27_OPFehler15Merge SFOp26_OPDirektstartMerge SFOp25_OPAnkoppelnMerge SFOp24_OPAbste__ptimierungMerge SFOp23_OPAbstellenMerge SFOp22_OPAbkoppelnMerge /end SUB_FUNCTION
 /begin LOC_MEASUREMENT m_k0_mod_has_fkt m_max_em_has_fkt m_max_iae_has_fkt m_min_em_has_fkt m_soll_em_has_fkt m_soll_k0_has_fkt m_soll_res_em_has_fkt m_soll_vm_has_fkt m_soll_vm_l_has_fkt mg_max_em_has_fkt mg_min_em_has_fkt mg_soll_k0_has_fkt n_soll_em_has_fkt n_soll_vm_has_fkt st_ablauf_fkt status_ablauf_has_fkt z_ablauf_svh_reset_has_fkt z_ablaufvariante_kalt_zus z_emaktiv_fuw_zus_fkt z_fehler15_eh_fkt z_hybfkt_stg z_k0_befuellopt_has_fkt z_k0_has_fkt z_m_max_iae_has_fkt z_m_soll_em_has_fkt z_m_soll_vm_has_fkt z_n_soll_em_has_fkt z_n_soll_vm_has_fkt z_p_hys_k0_has_fkt z_ponr_fkt z_saf_has_fkt z_tmin_fehler15_fkt z_zuendfreigabe_vm_fkt z_zuendfreigabe_vm_has_fkt /end LOC_MEASUREMENT
/end FUNCTION
/begin FUNCTION SFOp22_OPAbkoppelnMerge ""
 /begin LOC_MEASUREMENT m_k0_mod_has_fkt m_soll_em_has_fkt m_soll_k0_has_fkt m_soll_vm_has_fkt n_soll_em_has_fkt n_soll_vm_has_fkt st_ablauf_fkt status_ablauf_has_fkt z_ablauf_svh_reset_has_fkt z_k0_has_fkt z_m_soll_em_has_fkt z_m_soll_vm_has_fkt z_n_soll_em_has_fkt z_n_soll_vm_has_fkt z_p_hys_k0_has_fkt z_zuendfreigabe_vm_has_fkt /end LOC_MEASUREMENT
/end FUNCTION
/begin FUNCTION SFOp23_OPAbstellenMerge ""
 /begin LOC_MEASUREMENT m_k0_mod_has_fkt m_max_em_has_fkt m_min_em_has_fkt m_soll_em_has_fkt m_soll_k0_has_fkt m_soll_vm_has_fkt m_soll_vm_l_has_fkt mg_max_em_has_fkt mg_min_em_has_fkt n_soll_em_has_fkt st_ablauf_fkt status_ablauf_has_fkt z_ablauf_svh_reset_has_fkt z_k0_has_fkt z_m_soll_em_has_fkt z_m_soll_vm_has_fkt z_n_soll_em_has_fkt z_n_soll_vm_has_fkt z_p_hys_k0_has_fkt z_ponr_fkt z_zuendfreigabe_vm_has_fkt /end LOC_MEASUREMENT
/end FUNCTION
/begin FUNCTION SFOp24_OPAbste__ptimierungMerge ""
 /begin LOC_MEASUREMENT m_soll_em_has_fkt m_soll_k0_has_fkt m_soll_res_em_has_fkt mg_soll_k0_has_fkt st_ablauf_fkt status_ablauf_has_fkt z_k0_befuellopt_has_fkt z_k0_has_fkt z_m_soll_em_has_fkt z_p_hys_k0_has_fkt /end LOC_MEASUREMENT
/end FUNCTION
/begin FUNCTION SFOp25_OPAnkoppelnMerge ""
 /begin LOC_MEASUREMENT m_k0_mod_has_fkt m_soll_em_has_fkt m_soll_k0_has_fkt m_soll_vm_has_fkt n_soll_em_has_fkt n_soll_vm_has_fkt st_ablauf_fkt status_ablauf_has_fkt z_ablauf_svh_reset_has_fkt z_k0_has_fkt z_m_soll_em_has_fkt z_m_soll_vm_has_fkt z_n_soll_em_has_fkt z_n_soll_vm_has_fkt z_p_hys_k0_has_fkt z_saf_has_fkt z_zuendfreigabe_vm_fkt /end LOC_MEASUREMENT
/end FUNCTION
/begin FUNCTION SFOp26_OPDirektstartMerge ""
 /begin LOC_MEASUREMENT m_soll_k0_has_fkt st_ablauf_fkt status_ablauf_has_fkt z_k0_has_fkt z_p_hys_k0_has_fkt /end LOC_MEASUREMENT
/end FUNCTION
/begin FUNCTION SFOp27_OPFehler15Merge ""
 /begin LOC_MEASUREMENT m_soll_em_has_fkt n_soll_em_has_fkt n_soll_vm_has_fkt st_ablauf_fkt status_ablauf_has_fkt z_fehler15_eh_fkt z_k0_has_fkt z_m_soll_em_has_fkt z_n_soll_em_has_fkt z_n_soll_vm_has_fkt z_tmin_fehler15_fkt /end LOC_MEASUREMENT
/end FUNCTION
/begin FUNCTION SFOp28_OPGangAuslegenMerge "" /begin LOC_MEASUREMENT st_ablauf_fkt status_ablauf_has_fkt /end LOC_MEASUREMENT /end FUNCTION
/begin FUNCTION SFOp29_OPGangEinlegenMerge "" /begin LOC_MEASUREMENT st_ablauf_fkt status_ablauf_has_fkt /end LOC_MEASUREMENT /end FUNCTION
/begin FUNCTION SFOp30_OPNotstart ""
 /begin LOC_MEASUREMENT m_k0_mod_has_fkt m_soll_k0_has_fkt st_ablauf_fkt status_ablauf_has_fkt z_k0_has_fkt z_p_hys_k0_has_fkt z_zuendfreigabe_vm_fkt /end LOC_MEASUREMENT
/end FUNCTION
/begin FUNCTION SFOp31_OPOhneAblaufFktMerge "" /begin LOC_MEASUREMENT status_ablauf_has_fkt /end LOC_MEASUREMENT /end FUNCTION
/begin FUNCTION SFOp32_OPPassivMerge ""
 /begin LOC_MEASUREMENT m_k0_mod_has_fkt m_max_iae_has_fkt m_soll_em_has_fkt m_soll_k0_has_fkt m_soll_vm_has_fkt m_soll_vm_l_has_fkt mg_max_em_has_fkt mg_min_em_has_fkt mg_soll_k0_has_fkt n_soll_em_has_fkt n_soll_vm_has_fkt st_ablauf_fkt status_ablauf_has_fkt z_ablauf_svh_reset_has_fkt z_emaktiv_fuw_zus_fkt z_fehler15_eh_fkt z_k0_has_fkt z_m_max_iae_has_fkt z_m_soll_em_has_fkt z_m_soll_vm_has_fkt z_n_soll_em_has_fkt z_n_soll_vm_has_fkt z_p_hys_k0_has_fkt z_ponr_fkt z_zuendfreigabe_vm_has_fkt /end LOC_MEASUREMENT
/end FUNCTION
/begin FUNCTION SFOp33_OPSchleppstart ""
 /begin LOC_MEASUREMENT m_k0_mod_has_fkt m_max_em_has_fkt m_max_iae_has_fkt m_min_em_has_fkt m_soll_em_has_fkt m_soll_k0_has_fkt m_soll_res_em_has_fkt mg_soll_k0_has_fkt n_soll_em_has_fkt n_soll_vm_has_fkt st_ablauf_fkt status_ablauf_has_fkt z_ablauf_svh_reset_has_fkt z_k0_befuellopt_has_fkt z_k0_has_fkt z_m_max_iae_has_fkt z_m_soll_em_has_fkt z_n_soll_em_has_fkt z_n_soll_vm_has_fkt z_p_hys_k0_has_fkt z_saf_has_fkt /end LOC_MEASUREMENT
/end FUNCTION
/begin FUNCTION SFOp34_OPVMausMerge ""
 /begin LOC_MEASUREMENT st_ablauf_fkt status_ablauf_has_fkt z_ablauf_svh_reset_has_fkt z_zuendfreigabe_vm_has_fkt /end LOC_MEASUREMENT
/end FUNCTION
/begin FUNCTION SFOp35_OPVMeinMerge ""
 /begin LOC_MEASUREMENT st_ablauf_fkt status_ablauf_has_fkt z_ablauf_svh_reset_has_fkt z_zuendfreigabe_vm_has_fkt /end LOC_MEASUREMENT
/end FUNCTION
/begin FUNCTION SFOp36_OPZustartMerge ""
 /begin LOC_MEASUREMENT m_k0_mod_has_fkt m_max_iae_has_fkt m_soll_em_has_fkt m_soll_k0_has_fkt m_soll_res_em_has_fkt m_soll_vm_has_fkt n_soll_em_has_fkt n_soll_vm_has_fkt st_ablauf_fkt status_ablauf_has_fkt z_ablauf_svh_reset_has_fkt z_ablaufvariante_kalt_zus z_emaktiv_fuw_zus_fkt z_k0_has_fkt z_m_max_iae_has_fkt z_m_soll_em_has_fkt z_m_soll_vm_has_fkt z_n_soll_em_has_fkt z_n_soll_vm_has_fkt z_p_hys_k0_has_fkt z_ponr_fkt z_saf_has_fkt z_zuendfreigabe_vm_has_fkt /end LOC_MEASUREMENT
/end FUNCTION
/begin FUNCTION SFOp3_FOp_Abkoppeln "" /begin SUB_FUNCTION Action_FOp_ABK /end SUB_FUNCTION
 /begin LOC_MEASUREMENT abstellpos_vm_in abstellpos_vm_status_in c_getriebe_egs_in c_vm_in gangwechsel_egs_in i_istgang_egs i_zielgang_egs istgang_egs_in m_em_in m_iae_in m_k0_in m_k0_mber_has_sbe m_k0_mod_has_fkt m_max_dyn_em_in m_min_dyn_em_in m_min_vm_in m_mot_in m_motmax_has m_soll_em_has_fkt m_soll_em_hst_in m_soll_k0_has_fkt m_soll_res_em_bas_sbe m_soll_res_em_has_sbe m_soll_vm_has_fkt m_soll_vm_hst_in m_soll_vm_l_hst_in m_vm_in m_vm_start_in m_wunsch_fpw_hst_fil m_wunsch_fpw_hst_in m_wunsch_fpw_in mg_wunsch_fpw mg_wunsch_fpw_hst n_ab_egs_in n_em_in n_min_em_has_sbe n_min_psys_em_has_sbe n_mot_soll_iae_in n_sec_iae n_soll_em_has_fkt n_soll_em_hst_in n_soll_ll_vm_in n_soll_vm_has_fkt n_t_egs_in n_vm_in nd_iae nd_k0_in ndg_k0_in ng_vm osmode_next_in p_bremse_fzg_in phi_neigung_in pos_egs_in sollgang_egs_in st_OMLID_act_stg st_ablauf_fkt st_ist_bz_has_stg st_soll_bz_has_hst st_ziel_bz_has_stg status_ablauf_has_fkt status_alaengs_adaoff_in status_betriebsbereit_hst_in status_efahren_has_sbe status_fehler15_eh_diagin status_fehler_iep_in status_iae_adap_in status_iae_in status_iep_in status_k0_adap_in status_k0_in status_kl15_in status_kolbenpos_k0_in status_kraftfluss_egs_in status_kraftfluss_egs_roh_in status_ll_vm_in status_nem_in status_nreg_em_hst_in status_nvm_in status_posvueb_in status_psys_has_sbe status_sa_vm_in status_schaltart_svh_has_sbe status_schaltung_egs_in status_sync_schaltung_sbe status_waschstr_in status_zug_svh_sbe t_betrieb_pvu_has_ee_in t_betrieb_pvu_has_sbe v_f_sbe vg_f_sbe z_ablauf_has_hst_in z_ablauf_has_stg z_ablauf_svh_reset_has_fkt z_ablaufreinit_frk_dihi z_ablaufvariante_has_hst_in z_ablaufvariante_has_stg z_ba_has_k0_hst_in z_ba_has_vm_hst_in z_diag_ersfkt_has_in z_diag_ersfkt_hi_has_in z_diag_notgang_has_in z_emfehler_frk_dihi z_freigabe_pvu_has_sbe z_fuwdeakt_frk_dihi z_hybfkt_stg z_iep_in z_k0_fst_in z_k0_has_fkt z_k0_has_sbe z_k0syncmk0erh_frk_dihi z_kps_stada_in z_m_soll_em_has_fkt z_m_soll_vm_has_fkt z_modus_em_hst_in z_modus_iae_has_sbe z_modus_iep_has_sbe z_msa_avh_moni_has_sbe z_msa_eaf_moni_has_sbe z_msa_fst_in z_msa_has_sbe z_msa_stada_in z_n_min_em_parksp_has_in z_n_min_iep_in z_n_soll_em_has_fkt z_n_soll_vm_has_fkt z_nllsoll_iae_in z_nminemnull_frk_dihi z_nvmsollbegr_frk_dihi z_p_hys_k0_has_fkt z_pvu_has_sbe z_sas_has_sbe z_start_modus_has_sbe z_status_psys_mps_sbe z_svh_has_sbe z_ziel_kraftfluss_egs_in z_zuendfreigabe_vm_has_fkt zielgang_egs_in /end LOC_MEASUREMENT
/end FUNCTION
/begin FUNCTION SFOp4_FOp_Abo "" /begin SUB_FUNCTION Action_FOp_ABO /end SUB_FUNCTION
 /begin LOC_MEASUREMENT abstellpos_vm_in abstellpos_vm_status_in c_getriebe_egs_in c_vm_in gangwechsel_egs_in i_istgang_egs i_zielgang_egs istgang_egs_in m_em_in m_iae_in m_k0_in m_k0_mber_has_sbe m_max_dyn_em_in m_min_dyn_em_in m_min_vm_in m_mot_in m_motmax_has m_soll_em_has_fkt m_soll_em_hst_in m_soll_k0_has_fkt m_soll_res_em_bas_sbe m_soll_res_em_has_fkt m_soll_res_em_has_sbe m_soll_vm_hst_in m_soll_vm_l_hst_in m_vm_in m_vm_start_in m_wunsch_fpw_hst_fil m_wunsch_fpw_hst_in m_wunsch_fpw_in mg_soll_k0_has_fkt mg_wunsch_fpw mg_wunsch_fpw_hst n_ab_egs_in n_em_in n_min_em_has_sbe n_min_psys_em_has_sbe n_mot_soll_iae_in n_sec_iae n_soll_em_hst_in n_soll_ll_vm_in n_t_egs_in n_vm_in nd_iae nd_k0_in ndg_k0_in ng_vm osmode_next_in p_bremse_fzg_in phi_neigung_in pos_egs_in sollgang_egs_in st_OMLID_act_stg st_ablauf_fkt st_ist_bz_has_stg st_soll_bz_has_hst st_ziel_bz_has_stg status_ablauf_has_fkt status_alaengs_adaoff_in status_betriebsbereit_hst_in status_efahren_has_sbe status_fehler15_eh_diagin status_fehler_iep_in status_iae_adap_in status_iae_in status_iep_in status_k0_adap_in status_k0_in status_kl15_in status_kolbenpos_k0_in status_kraftfluss_egs_in status_kraftfluss_egs_roh_in status_ll_vm_in status_nem_in status_nreg_em_hst_in status_nvm_in status_posvueb_in status_psys_has_sbe status_sa_vm_in status_schaltart_svh_has_sbe status_schaltung_egs_in status_sync_schaltung_sbe status_waschstr_in status_zug_svh_sbe t_betrieb_pvu_has_ee_in t_betrieb_pvu_has_sbe v_f_sbe vg_f_sbe z_ablauf_has_hst_in z_ablauf_has_stg z_ablaufreinit_frk_dihi z_ablaufvariante_has_hst_in z_ablaufvariante_has_stg z_ba_has_k0_hst_in z_ba_has_vm_hst_in z_diag_ersfkt_has_in z_diag_ersfkt_hi_has_in z_diag_notgang_has_in z_emfehler_frk_dihi z_freigabe_pvu_has_sbe z_fuwdeakt_frk_dihi z_hybfkt_stg z_iep_in z_k0_befuellopt_has_fkt z_k0_fst_in z_k0_has_fkt z_k0_has_sbe z_k0syncmk0erh_frk_dihi z_kps_stada_in z_m_soll_em_has_fkt z_modus_em_hst_in z_modus_iae_has_sbe z_modus_iep_has_sbe z_msa_avh_moni_has_sbe z_msa_eaf_moni_has_sbe z_msa_fst_in z_msa_has_sbe z_msa_stada_in z_n_min_em_parksp_has_in z_n_min_iep_in z_nllsoll_iae_in z_nminemnull_frk_dihi z_nvmsollbegr_frk_dihi z_p_hys_k0_has_fkt z_pvu_has_sbe z_sas_has_sbe z_start_modus_has_sbe z_status_psys_mps_sbe z_svh_has_sbe z_ziel_kraftfluss_egs_in zielgang_egs_in /end LOC_MEASUREMENT
/end FUNCTION
/begin FUNCTION SFOp5_FOp_Abstellen "" /begin SUB_FUNCTION Action_FOp_ABST /end SUB_FUNCTION
 /begin LOC_MEASUREMENT abstellpos_vm_in abstellpos_vm_status_in c_getriebe_egs_in c_vm_in gangwechsel_egs_in i_istgang_egs i_zielgang_egs istgang_egs_in m_em_in m_iae_in m_k0_in m_k0_mber_has_sbe m_k0_mod_has_fkt m_max_dyn_em_in m_max_em_has_fkt m_min_dyn_em_in m_min_em_has_fkt m_min_vm_in m_mot_in m_motmax_has m_soll_em_has_fkt m_soll_em_hst_in m_soll_k0_has_fkt m_soll_res_em_bas_sbe m_soll_res_em_has_sbe m_soll_vm_has_fkt m_soll_vm_hst_in m_soll_vm_l_has_fkt m_soll_vm_l_hst_in m_vm_in m_vm_start_in m_wunsch_fpw_hst_fil m_wunsch_fpw_hst_in m_wunsch_fpw_in mg_max_em_has_fkt mg_min_em_has_fkt mg_wunsch_fpw mg_wunsch_fpw_hst n_ab_egs_in n_em_in n_min_em_has_sbe n_min_psys_em_has_sbe n_mot_soll_iae_in n_sec_iae n_soll_em_has_fkt n_soll_em_hst_in n_soll_ll_vm_in n_t_egs_in n_vm_in nd_iae nd_k0_in ndg_k0_in ng_vm osmode_next_in p_bremse_fzg_in phi_neigung_in pos_egs_in sollgang_egs_in st_OMLID_act_stg st_ablauf_fkt st_ist_bz_has_stg st_soll_bz_has_hst st_ziel_bz_has_stg status_ablauf_has_fkt status_alaengs_adaoff_in status_betriebsbereit_hst_in status_efahren_has_sbe status_fehler15_eh_diagin status_fehler_iep_in status_iae_adap_in status_iae_in status_iep_in status_k0_adap_in status_k0_in status_kl15_in status_kolbenpos_k0_in status_kraftfluss_egs_in status_kraftfluss_egs_roh_in status_ll_vm_in status_nem_in status_nreg_em_hst_in status_nvm_in status_posvueb_in status_psys_has_sbe status_sa_vm_in status_schaltart_svh_has_sbe status_schaltung_egs_in status_sync_schaltung_sbe status_waschstr_in status_zug_svh_sbe t_betrieb_pvu_has_ee_in t_betrieb_pvu_has_sbe v_f_sbe vg_f_sbe z_ablauf_has_hst_in z_ablauf_has_stg z_ablauf_svh_reset_has_fkt z_ablaufreinit_frk_dihi z_ablaufvariante_has_hst_in z_ablaufvariante_has_stg z_ba_has_k0_hst_in z_ba_has_vm_hst_in z_diag_ersfkt_has_in z_diag_ersfkt_hi_has_in z_diag_notgang_has_in z_emfehler_frk_dihi z_freigabe_pvu_has_sbe z_fuwdeakt_frk_dihi z_hybfkt_stg z_iep_in z_k0_fst_in z_k0_has_fkt z_k0_has_sbe z_k0syncmk0erh_frk_dihi z_kps_stada_in z_m_soll_em_has_fkt z_m_soll_vm_has_fkt z_modus_em_hst_in z_modus_iae_has_sbe z_modus_iep_has_sbe z_msa_avh_moni_has_sbe z_msa_eaf_moni_has_sbe z_msa_fst_in z_msa_has_sbe z_msa_stada_in z_n_min_em_parksp_has_in z_n_min_iep_in z_n_soll_em_has_fkt z_n_soll_vm_has_fkt z_nllsoll_iae_in z_nminemnull_frk_dihi z_nvmsollbegr_frk_dihi z_p_hys_k0_has_fkt z_ponr_fkt z_pvu_has_sbe z_sas_has_sbe z_start_modus_has_sbe z_status_psys_mps_sbe z_svh_has_sbe z_ziel_kraftfluss_egs_in z_zuendfreigabe_vm_has_fkt zielgang_egs_in /end LOC_MEASUREMENT
/end FUNCTION
/begin FUNCTION SFOp6_FOp_Ankoppeln "" /begin SUB_FUNCTION Run_Action_FOp_ANK /end SUB_FUNCTION
 /begin LOC_MEASUREMENT abstellpos_vm_in abstellpos_vm_status_in c_getriebe_egs_in c_vm_in gangwechsel_egs_in i_istgang_egs i_zielgang_egs istgang_egs_in m_em_in m_iae_in m_k0_in m_k0_mber_has_sbe m_k0_mod_has_fkt m_max_dyn_em_in m_min_dyn_em_in m_min_vm_in m_mot_in m_motmax_has m_soll_em_has_fkt m_soll_em_hst_in m_soll_k0_has_fkt m_soll_res_em_bas_sbe m_soll_res_em_has_sbe m_soll_vm_has_fkt m_soll_vm_hst_in m_soll_vm_l_hst_in m_vm_in m_vm_start_in m_wunsch_fpw_hst_fil m_wunsch_fpw_hst_in m_wunsch_fpw_in mg_wunsch_fpw mg_wunsch_fpw_hst n_ab_egs_in n_em_in n_min_em_has_sbe n_min_psys_em_has_sbe n_mot_soll_iae_in n_sec_iae n_soll_em_has_fkt n_soll_em_hst_in n_soll_ll_vm_in n_soll_vm_has_fkt n_t_egs_in n_vm_in nd_iae nd_k0_in ndg_k0_in ng_vm osmode_next_in p_bremse_fzg_in phi_neigung_in pos_egs_in sollgang_egs_in st_OMLID_act_stg st_ablauf_fkt st_ist_bz_has_stg st_soll_bz_has_hst st_ziel_bz_has_stg status_ablauf_has_fkt status_alaengs_adaoff_in status_betriebsbereit_hst_in status_efahren_has_sbe status_fehler15_eh_diagin status_fehler_iep_in status_iae_adap_in status_iae_in status_iep_in status_k0_adap_in status_k0_in status_kl15_in status_kolbenpos_k0_in status_kraftfluss_egs_in status_kraftfluss_egs_roh_in status_ll_vm_in status_nem_in status_nreg_em_hst_in status_nvm_in status_posvueb_in status_psys_has_sbe status_sa_vm_in status_schaltart_svh_has_sbe status_schaltung_egs_in status_sync_schaltung_sbe status_waschstr_in status_zug_svh_sbe t_betrieb_pvu_has_ee_in t_betrieb_pvu_has_sbe v_f_sbe vg_f_sbe z_ablauf_has_hst_in z_ablauf_has_stg z_ablauf_svh_reset_has_fkt z_ablaufreinit_frk_dihi z_ablaufvariante_has_hst_in z_ablaufvariante_has_stg z_ba_has_k0_hst_in z_ba_has_vm_hst_in z_diag_ersfkt_has_in z_diag_ersfkt_hi_has_in z_diag_notgang_has_in z_emfehler_frk_dihi z_freigabe_pvu_has_sbe z_fuwdeakt_frk_dihi z_hybfkt_stg z_iep_in z_k0_fst_in z_k0_has_fkt z_k0_has_sbe z_k0syncmk0erh_frk_dihi z_kps_stada_in z_m_soll_em_has_fkt z_m_soll_vm_has_fkt z_modus_em_hst_in z_modus_iae_has_sbe z_modus_iep_has_sbe z_msa_avh_moni_has_sbe z_msa_eaf_moni_has_sbe z_msa_fst_in z_msa_has_sbe z_msa_stada_in z_n_min_em_parksp_has_in z_n_min_iep_in z_n_soll_em_has_fkt z_n_soll_vm_has_fkt z_nllsoll_iae_in z_nminemnull_frk_dihi z_nvmsollbegr_frk_dihi z_p_hys_k0_has_fkt z_pvu_has_sbe z_saf_has_fkt z_sas_has_sbe z_start_modus_has_sbe z_status_psys_mps_sbe z_svh_has_sbe z_ziel_kraftfluss_egs_in z_zuendfreigabe_vm_fkt zielgang_egs_in /end LOC_MEASUREMENT
/end FUNCTION
/begin FUNCTION SFOp7_FOp_Direktstart "" /begin SUB_FUNCTION Action_FOp_DRS /end SUB_FUNCTION
 /begin LOC_MEASUREMENT abstellpos_vm_in abstellpos_vm_status_in c_getriebe_egs_in c_vm_in gangwechsel_egs_in i_istgang_egs i_zielgang_egs istgang_egs_in m_em_in m_iae_in m_k0_in m_k0_mber_has_sbe m_max_dyn_em_in m_min_dyn_em_in m_min_vm_in m_mot_in m_motmax_has m_soll_em_hst_in m_soll_k0_has_fkt m_soll_res_em_bas_sbe m_soll_res_em_has_sbe m_soll_vm_hst_in m_soll_vm_l_hst_in m_vm_in m_vm_start_in m_wunsch_fpw_hst_fil m_wunsch_fpw_hst_in m_wunsch_fpw_in mg_wunsch_fpw mg_wunsch_fpw_hst n_ab_egs_in n_em_in n_min_em_has_sbe n_min_psys_em_has_sbe n_mot_soll_iae_in n_sec_iae n_soll_em_hst_in n_soll_ll_vm_in n_t_egs_in n_vm_in nd_iae nd_k0_in ndg_k0_in ng_vm osmode_next_in p_bremse_fzg_in phi_neigung_in pos_egs_in sollgang_egs_in st_OMLID_act_stg st_ablauf_fkt st_ist_bz_has_stg st_soll_bz_has_hst st_ziel_bz_has_stg status_ablauf_has_fkt status_alaengs_adaoff_in status_betriebsbereit_hst_in status_efahren_has_sbe status_fehler15_eh_diagin status_fehler_iep_in status_iae_adap_in status_iae_in status_iep_in status_k0_adap_in status_k0_in status_kl15_in status_kolbenpos_k0_in status_kraftfluss_egs_in status_kraftfluss_egs_roh_in status_ll_vm_in status_nem_in status_nreg_em_hst_in status_nvm_in status_posvueb_in status_psys_has_sbe status_sa_vm_in status_schaltart_svh_has_sbe status_schaltung_egs_in status_sync_schaltung_sbe status_waschstr_in status_zug_svh_sbe t_betrieb_pvu_has_ee_in t_betrieb_pvu_has_sbe v_f_sbe vg_f_sbe z_ablauf_has_hst_in z_ablauf_has_stg z_ablaufreinit_frk_dihi z_ablaufvariante_has_hst_in z_ablaufvariante_has_stg z_ba_has_k0_hst_in z_ba_has_vm_hst_in z_diag_ersfkt_has_in z_diag_ersfkt_hi_has_in z_diag_notgang_has_in z_emfehler_frk_dihi z_freigabe_pvu_has_sbe z_fuwdeakt_frk_dihi z_hybfkt_stg z_iep_in z_k0_fst_in z_k0_has_fkt z_k0_has_sbe z_k0syncmk0erh_frk_dihi z_kps_stada_in z_modus_em_hst_in z_modus_iae_has_sbe z_modus_iep_has_sbe z_msa_avh_moni_has_sbe z_msa_eaf_moni_has_sbe z_msa_fst_in z_msa_has_sbe z_msa_stada_in z_n_min_em_parksp_has_in z_n_min_iep_in z_nllsoll_iae_in z_nminemnull_frk_dihi z_nvmsollbegr_frk_dihi z_p_hys_k0_has_fkt z_pvu_has_sbe z_sas_has_sbe z_start_modus_has_sbe z_status_psys_mps_sbe z_svh_has_sbe z_ziel_kraftfluss_egs_in zielgang_egs_in /end LOC_MEASUREMENT
/end FUNCTION
/begin FUNCTION SFOp8_FOp_Fehler15 "" /begin SUB_FUNCTION Action_FOp_Fehler15 /end SUB_FUNCTION
 /begin LOC_MEASUREMENT c_getriebe_egs_in gangwechsel_egs_in istgang_egs_in m_em_in m_iae_in m_k0_in m_max_dyn_em_in m_min_dyn_em_in m_mot_in m_soll_em_has_fkt m_soll_em_hst_in m_soll_vm_hst_in m_vm_in m_vm_start_in m_wunsch_fpw_in n_ab_egs_in n_em_in n_mot_soll_iae_in n_soll_em_has_fkt n_soll_ll_vm_in n_soll_vm_has_fkt n_t_egs_in n_vm_in osmode_next_in p_bremse_fzg_in phi_neigung_in pos_egs_in sollgang_egs_in st_ablauf_fkt status_ablauf_has_fkt status_alaengs_adaoff_in status_fehler_iep_in status_iae_adap_in status_iae_in status_iep_in status_k0_adap_in status_k0_in status_kolbenpos_k0_in status_kraftfluss_egs_in status_kraftfluss_egs_roh_in status_ll_vm_in status_nem_in status_nvm_in status_posvueb_in status_waschstr_in t_betrieb_pvu_has_ee_in z_ablauf_has_hst_in z_ablaufvariante_has_hst_in z_diag_ersfkt_has_in z_diag_ersfkt_hi_has_in z_diag_notgang_has_in z_fehler15_eh_fkt z_iep_in z_k0_fst_in z_k0_has_fkt z_kps_stada_in z_m_soll_em_has_fkt z_modus_em_hst_in z_msa_fst_in z_n_min_em_parksp_has_in z_n_min_iep_in z_n_soll_em_has_fkt z_n_soll_vm_has_fkt z_nllsoll_iae_in z_tmin_fehler15_fkt z_ziel_kraftfluss_egs_in zielgang_egs_in /end LOC_MEASUREMENT
/end FUNCTION
/begin FUNCTION SFOp9_FOp_Gangauslegen "" /begin SUB_FUNCTION Action_FOp_GAA /end SUB_FUNCTION
 /begin LOC_MEASUREMENT abstellpos_vm_in abstellpos_vm_status_in bErrorHybrid bExceptionHybrid c_getriebe_egs_in c_vm_in gangwechsel_egs_in i_istgang_egs i_zielgang_egs istgang_egs_in m_em_in m_iae_in m_k0_in m_k0_mber_has_sbe m_max_dyn_em_in m_min_dyn_em_in m_min_vm_in m_mot_in m_motmax_has m_soll_em_hst_in m_soll_res_em_bas_sbe m_soll_res_em_has_sbe m_soll_vm_hst_in m_soll_vm_l_hst_in m_vm_in m_vm_start_in m_wunsch_fpw_hst_fil m_wunsch_fpw_hst_in m_wunsch_fpw_in mg_wunsch_fpw mg_wunsch_fpw_hst n_ab_egs_in n_em_in n_min_em_has_sbe n_min_psys_em_has_sbe n_mot_soll_iae_in n_sec_iae n_soll_em_hst_in n_soll_ll_vm_in n_t_egs_in n_vm_in nd_iae nd_k0_in ndg_k0_in ng_vm osmode_next_in p_bremse_fzg_in phi_neigung_in pos_egs_in sollgang_egs_in st_OMLID_act_stg st_ablauf_fkt st_ist_bz_has_stg st_ist_bz_hst_sta st_soll_bz_has_hst st_soll_bz_hst_sta st_ziel_bz_has_stg status_ablauf_has_fkt status_alaengs_adaoff_in status_betriebsbereit_hst_in status_efahren_has_sbe status_fehler15_eh_diagin status_fehler_iep_in status_iae_adap_in status_iae_in status_iep_in status_k0_adap_in status_k0_in status_kl15_in status_kolbenpos_k0_in status_kraftfluss_egs_in status_kraftfluss_egs_roh_in status_ll_vm_in status_nem_in status_nreg_em_hst_in status_nvm_in status_posvueb_in status_psys_has_sbe status_sa_vm_in status_schaltart_svh_has_sbe status_schaltung_egs_in status_sync_schaltung_sbe status_waschstr_in status_zug_svh_sbe t_betrieb_pvu_has_ee_in t_betrieb_pvu_has_sbe v_f_sbe vg_f_sbe z_ablauf_has_hst_in z_ablauf_has_stg z_ablaufreinit_frk_dihi z_ablaufvariante_has_hst_in z_ablaufvariante_has_stg z_ba_has_k0_hst_in z_ba_has_vm_hst_in z_diag_ersfkt_has_in z_diag_ersfkt_hi_has_in z_diag_notgang_has_in z_emfehler_frk_dihi z_freigabe_pvu_has_sbe z_fuwdeakt_frk_dihi z_hybfkt_stg z_iep_in z_init_sta z_k0_fst_in z_k0_has_sbe z_k0syncmk0erh_frk_dihi z_kps_stada_in z_modus_em_hst_in z_modus_iae_has_sbe z_modus_iep_has_sbe z_msa_avh_moni_has_sbe z_msa_eaf_moni_has_sbe z_msa_fst_in z_msa_has_sbe z_msa_stada_in z_n_min_em_parksp_has_in z_n_min_iep_in z_nllsoll_iae_in z_nminemnull_frk_dihi z_nvmsollbegr_frk_dihi z_pvu_has_sbe z_sas_has_sbe z_start_modus_has_sbe z_status_psys_mps_sbe z_svh_has_sbe z_ziel_kraftfluss_egs_in zielgang_egs_in /end LOC_MEASUREMENT
/end FUNCTION
/begin FUNCTION SFOp_ABK101_ac__ng_aktiv_abk_en "" /begin DEF_CHARACTERISTIC STATUS_ABL_SAK_ABK /end DEF_CHARACTERISTIC /end FUNCTION
/begin FUNCTION SFOp_ABK102_ac__aktiv_abk_en_st "" /begin SUB_FUNCTION Run_SFOp_ABK105_cTimer_trigger_ /end SUB_FUNCTION /begin DEF_CHARACTERISTIC K_SVH_RESET_SAK_ABK M_K0MODMIN_SAK_ABK T_MAX_SAK_ABK /end DEF_CHARACTERISTIC
 /begin LOC_MEASUREMENT SFOp_ABK105_isActive_ m_k0_in status_schaltung_egs_in t_maxbed_sak_abk /end LOC_MEASUREMENT
/end FUNCTION
/begin FUNCTION SFOp_ABK108_Entry "" /begin DEF_CHARACTERISTIC K_SVH_RESET_UEB_ABK /end DEF_CHARACTERISTIC /end FUNCTION
/begin FUNCTION SFOp_ABK10_St_Start "" /begin SUB_FUNCTION SFOp_ABK114_Entry /end SUB_FUNCTION /begin DEF_CHARACTERISTIC STATUS_ABL_SRT_ABK /end DEF_CHARACTERISTIC /end FUNCTION
/begin FUNCTION SFOp_ABK111_Entry ""
 /begin DEF_CHARACTERISTIC K_SVH_RESET_UAB_ABK STATUS_ABL_ABBRUCH_FERTIG SWI_ZPHYSK0_UAB_ABK /end DEF_CHARACTERISTIC
/end FUNCTION
/begin FUNCTION SFOp_ABK114_Entry "" /begin DEF_CHARACTERISTIC K_SVH_RESET_SRT_ABK M_K0MODMIN_SRT_ABK STATUS_ABL_SRT_ABK /end DEF_CHARACTERISTIC
 /begin LOC_MEASUREMENT m_k0_in m_soll_vm_hst_in m_soll_vm_l_hst_in m_vm_in n_em_in n_soll_em_hst_in nd_k0_in status_k0_in status_sa_vm_in status_schaltart_svh_has_sbe status_schaltung_egs_in z_ablauf_has_hst_in z_ablauf_has_stg z_ablaufvariante_has_stg /end LOC_MEASUREMENT
/end FUNCTION
/begin FUNCTION SFOp_ABK19_Var_2 "" /begin DEF_CHARACTERISTIC MO_K0OEFFNENBED_LAU_ABK MS_K0OEFFNENBED_LAU_ABK /end DEF_CHARACTERISTIC /end FUNCTION
/begin FUNCTION SFOp_ABK20_Bitwise_AND_ui8_ "" /begin DEF_CHARACTERISTIC K_SVH_RESET_LAU_ABK /end DEF_CHARACTERISTIC /end FUNCTION
/begin RECORD_LAYOUT FLOAT32_IEEE_COL_DIRECT_S6_S3 FNC_VALUES 1 FLOAT32_IEEE COLUMN_DIR DIRECT /end RECORD_LAYOUT
/begin RECORD_LAYOUT FLOAT32_IEEE_X_INCR_DIRECT_S6_S3 AXIS_PTS_X 1 FLOAT32_IEEE INDEX_INCR DIRECT /end RECORD_LAYOUT
/begin RECORD_LAYOUT SWORD_COL_DIRECT_S6_S3 FNC_VALUES 1 SWORD COLUMN_DIR DIRECT /end RECORD_LAYOUT
/begin RECORD_LAYOUT UBYTE_COL_DIRECT_S6_S3 FNC_VALUES 1 UBYTE COLUMN_DIR DIRECT /end RECORD_LAYOUT
/begin RECORD_LAYOUT UBYTE_X_INCR_DIRECT_S6_S3 AXIS_PTS_X 1 UBYTE INDEX_INCR DIRECT /end RECORD_LAYOUT
/begin RECORD_LAYOUT ULONG_COL_DIRECT_S6_S3 FNC_VALUES 1 ULONG COLUMN_DIR DIRECT /end RECORD_LAYOUT
/begin RECORD_LAYOUT ULONG_X_INCR_DIRECT_S6_S3 AXIS_PTS_X 1 ULONG INDEX_INCR DIRECT /end RECORD_LAYOUT
/begin RECORD_LAYOUT UWORD_COL_DIRECT_S6_S3 FNC_VALUES 1 UWORD COLUMN_DIR DIRECT /end RECORD_LAYOUT
/begin RECORD_LAYOUT UWORD_X_INCR_DIRECT_S6_S3 AXIS_PTS_X 1 UWORD INDEX_INCR DIRECT /end RECORD_LAYOUT
/end MODULE
/end PROJECT
