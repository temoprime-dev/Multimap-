ASAP2_VERSION 1 51
/begin PROJECT ZHBC8600 "Gen2_BMW_System_Supplier_Lib"
/begin MODULE CPP ""
/begin MOD_COMMON "" BYTE_ORDER MSB_FIRST ALIGNMENT_BYTE 1 ALIGNMENT_WORD 2 ALIGNMENT_LONG 4 ALIGNMENT_FLOAT32_IEEE 4 ALIGNMENT_FLOAT64_IEEE 1 /end MOD_COMMON
/begin COMPU_VTAB Conv.cAdaGlast._.adaps_status_S5_S3 "Umrechnung fuer Messgroesse cAdaGlast::adaps_status" TAB_VERB 12 400 "Default" 410 "Warten auf GLS-Beginn" 415 "Beginn GLS" 420 "Warten bis GLS beendet" 425 "GLS beendet" 440 "Warten bis Regelung K-Ab beendet" 450 "Warten bis Schaltung beendet" 470 "Abbruchbedingung eingetreten" 477 "Zustandsfehler" 480 "Bewertung verboten wegen Diagnose" 490 "Bewertung verboten da die Schaltung nicht ueber SAS beendet wurde" 499 "4000 + x   x = Ausgabe mittlerer Regeldruck" DEFAULT_VALUE "" /end COMPU_VTAB
/begin COMPU_VTAB Conv.cAdaGlast._.bew_kennfeld_lesen_S5_S3 "Umrechnung fuer Messgroesse cAdaGlast::bew_kennfeld_lesen" TAB_VERB 3 0 "nicht definiert" 1 "ADA-GLS-Kennfeld 1" 2 "ADA-GLS-Kennfeld 2" DEFAULT_VALUE "" /end COMPU_VTAB
/begin COMPU_VTAB Conv.cAdaGlast._.bew_kennfeld_S5_S3 "Umrechnung fuer Messgroesse cAdaGlast::bew_kennfeld" TAB_VERB 3 0 "nicht definiert" 1 "ADA-GLS-Kennfeld 1" 2 "ADA-GLS-Kennfeld 2" DEFAULT_VALUE "" /end COMPU_VTAB
/begin COMPU_VTAB Conv.cAdaGlast._.bew_kup_S5_S3 "Umrechnung fuer Messgroesse cAdaGlast::bew_kup" TAB_VERB 6 0 "KEINE" 1 "K_A" 2 "K_B" 3 "K_C" 4 "K_D" 5 "K_E" DEFAULT_VALUE "" /end COMPU_VTAB
/begin COMPU_VTAB Conv.cAdaGlast._.bew_schalttyp_lesen_S5_S3 "Umrechnung fuer Messgroesse cAdaGlast::bew_schalttyp_lesen" TAB_VERB 5 0 "Einzel Hochschaltung" 1 "Einzel Rueckschaltung" 2 "Doppel Hochschaltung" 3 "Doppel Rueckschaltung" 4 "N-fach Rueckschaltung" DEFAULT_VALUE "" /end COMPU_VTAB
/begin COMPU_VTAB Conv.cAdaGlast._.bew_schalttyp_S5_S3 "Umrechnung fuer Messgroesse cAdaGlast::bew_schalttyp" TAB_VERB 5 0 "Einzel Hochschaltung" 1 "Einzel Rueckschaltung" 2 "Doppel Hochschaltung" 3 "Doppel Rueckschaltung" 4 "N-fach Rueckschaltung" DEFAULT_VALUE "" /end COMPU_VTAB
/begin COMPU_VTAB Conv.cAdaGlast._.gls_ada_state_S5_S3 "Umrechnung fuer Messgroesse cAdaGlast::gls_ada_state" TAB_VERB 8 1 "PSA_PASSIV" 2 "PSA_START" 3 "WARTEN_GLS" 4 "GLS_KAB_AKTIV" 5 "GLS_KZU_AKTIV" 6 "GLS_WARTEN_SE" 7 "GLS_WARTEN_ENDE_KAB" 8 "Z_GLS_ABBRUCH" DEFAULT_VALUE "" /end COMPU_VTAB
/begin COMPU_VTAB Conv.cAdaGlast._.gls_flag_abbruch_wg_adapfn_S5_S3 "Umrechnung fuer Messgroesse cAdaGlast::gls_flag_abbruch_wg_adapfn" TAB_VERB 2 0 "false" 1 "true" DEFAULT_VALUE "" /end COMPU_VTAB
/begin COMPU_VTAB Conv.cAdaGlast._.gls_trimm_gang_S5_S3 "Umrechnung fuer Messgroesse cAdaGlast::gls_trimm_gang" TAB_VERB 10 -1 "GR1" 0 "KEIN_GANG" 1 "G1" 2 "G2" 3 "G3" 4 "G4" 5 "G5" 6 "G6" 7 "G7" 8 "G8" DEFAULT_VALUE "" /end COMPU_VTAB
/begin COMPU_VTAB Conv.cAdaGlast._.gls_trimm_spont_beeinflussung_S5_S3 "Umrechnung fuer Messgroesse cAdaGlast::gls_trimm_spont_beeinflussung" TAB_VERB 2 0 "PASSIV" 1 "AKTIV" DEFAULT_VALUE "" /end COMPU_VTAB
/begin COMPU_VTAB Conv.cAdaGlast._.gls_trimm_verbot_versch_rs_S5_S3 "Umrechnung fuer Messgroesse cAdaGlast::gls_trimm_verbot_versch_rs" TAB_VERB 2 0 "PASSIV" 1 "AKTIV" DEFAULT_VALUE "" /end COMPU_VTAB
/begin COMPU_VTAB Conv.cAdaGlast._.status_ausgabe_verzoegern_S5_S3 "Umrechnung fuer Messgroesse cAdaGlast::status_ausgabe_verzoegern" TAB_VERB 2 0 "FALSE" 1 "TRUE" DEFAULT_VALUE "" /end COMPU_VTAB
/begin COMPU_VTAB Conv.cAdaGloku._.puls_lock_S5_S3 "Umrechnung fuer Messgroesse cAdaGloku::puls_lock" TAB_VERB 2 0 "kein Abbruch" 1 "Abbruch" DEFAULT_VALUE "" /end COMPU_VTAB
/begin COMPU_VTAB Conv.cAdaGlosc._.ada_iae_info_S5_S3 "Umrechnung fuer Messgroesse cAdaGlosc::ada_iae_info" TAB_VERB 3 0 "KEINE_IAE_ADAPTION_AKTIV" 1 "IAE_AP_ADA" 2 "IAE_UF_ADA" DEFAULT_VALUE "" /end COMPU_VTAB
/begin COMPU_VTAB Conv.cAdaGlosc._.ada_istgang_S5_S3 "Umrechnung fuer Messgroesse cAdaGlosc::ada_istgang" TAB_VERB 9 0 "KEIN_GANG" 1 "G1" 2 "G2" 3 "G3" 4 "G4" 5 "G5" 6 "G6" 7 "G7" 8 "G8" DEFAULT_VALUE "" /end COMPU_VTAB
/begin COMPU_VTAB Conv.cAdaGlosc._.ada_k_zu_S5_S3 "Umrechnung fuer Messgroesse cAdaGlosc::ada_k_zu" TAB_VERB 6 0 "KEINE" 1 "K_A" 2 "K_B" 3 "K_C" 4 "K_D" 5 "K_E" DEFAULT_VALUE "" /end COMPU_VTAB
/begin COMPU_VTAB Conv.cAdaGlosc._.ada_schaltart_S5_S3 "Umrechnung fuer Messgroesse cAdaGlosc::ada_schaltart" TAB_VERB 3 0 "nicht definiert" 1 "Hochschaltung" 2 "Rueckschaltung" DEFAULT_VALUE "" /end COMPU_VTAB
/begin COMPU_VTAB Conv.cAdaGlosc._.ada_schaltung_kzu_S5_S3 "Umrechnung fuer Messgroesse cAdaGlosc::ada_schaltung_kzu" TAB_VERB 2 0 "Schaltung nicht ueber KZU" 1 "Schaltung ueber KZU" DEFAULT_VALUE "" /end COMPU_VTAB
/begin COMPU_VTAB Conv.cAdaGlosc._.ada_schaltungs_index_S5_S3 "Umrechnung fuer Messgroesse cAdaGlosc::ada_schaltungs_index" TAB_VERB 3 0 "IND_KURZSAS_NORMAL" 1 "IND_KURZSAS_SP" 2 "IND_KURZSAS_SPORT" DEFAULT_VALUE "" /end COMPU_VTAB
/begin COMPU_VTAB Conv.cAdaGlosc._.ada_synchron_S5_S3 "Umrechnung fuer Messgroesse cAdaGlosc::ada_synchron" TAB_VERB 2 0 "Synchronpunkt noch nicht erreicht" 1 "Synchronpunkt erreicht" DEFAULT_VALUE "" /end COMPU_VTAB
/begin COMPU_VTAB Conv.cAdaGlosc._.ada_zielgang_S5_S3 "Umrechnung fuer Messgroesse cAdaGlosc::ada_zielgang" TAB_VERB 9 0 "KEIN_GANG" 1 "G1" 2 "G2" 3 "G3" 4 "G4" 5 "G5" 6 "G6" 7 "G7" 8 "G8" DEFAULT_VALUE "" /end COMPU_VTAB
/begin COMPU_VTAB Conv.cAdaGlosc._.bew_verbot_laengs_beschl_S5_S3 "Umrechnung fuer Messgroesse cAdaGlosc::bew_verbot_laengs_beschl" TAB_VERB 3 0 "Bewertung verboten" 1 "Bewertung erlaubt" 2 "Bewertung erlaubt und Zuendung <> EIN erkannt" DEFAULT_VALUE "" /end COMPU_VTAB
/begin COMPU_VTAB Conv.cAdaGlosc._.f_ada_bew_verboten_S5_S3 "Umrechnung fuer Messgroesse cAdaGlosc::f_ada_bew_verboten" TAB_VERB 2 0 "FALSE" 1 "TRUE" DEFAULT_VALUE "" /end COMPU_VTAB
/begin COMPU_VTAB Conv.cAdaGlosc._.f_aenderung_adaram_daten_S5_S3 "Umrechnung fuer Messgroesse cAdaGlosc::f_aenderung_adaram_daten" TAB_VERB 2 0 "keine Aenderung ADARAM-Daten" 1 "vermutlich Aenderung ADARAM-Daten" DEFAULT_VALUE "" /end COMPU_VTAB
/begin COMPU_VTAB Conv.cAdaGlosc._.f_letzte_schaltung_rs_S5_S3 "Umrechnung fuer Messgroesse cAdaGlosc::f_letzte_schaltung_rs" TAB_VERB 2 0 "FALSE" 1 "TRUE" DEFAULT_VALUE "" /end COMPU_VTAB
/begin COMPU_VTAB Conv.cAdaGlosc._.flag_alaengs_adaoff_S5_S3 "Umrechnung fuer Messgroesse cAdaGlosc::flag_alaengs_adaoff" TAB_VERB 2 0 "FALSE" 1 "TRUE" DEFAULT_VALUE "" /end COMPU_VTAB
/begin COMPU_VTAB Conv.cAdaGlosc._.flag_allada_del_S5_S3 "Umrechnung fuer Messgroesse cAdaGlosc::flag_allada_del" TAB_VERB 2 0 "FALSE" 1 "TRUE" DEFAULT_VALUE "" /end COMPU_VTAB
/begin COMPU_VTAB Conv.cAdaGlosc._.init_mit_azg_S5_S3 "Umrechnung fuer Messgroesse cAdaGlosc::init_mit_azg" TAB_VERB 29 0 "Initialwert" 2 "AZG-Init.-Wert fuer K0-Ada komplett" 4 "AZG-Init.-Wert fuer GLS-Ada komplett" 8 "AZG-Init.-Wert fuer GE-Ada" 11 "AZG-Init.-Wert fuer Fusspunkt-Ada" 13 "AZG-Init.-Wert fuer IAE-AP Ada" 14 "AZG-Init.-Wert fuer IAE-UF Ada" 15 "AZG-Init.-Wert fuer TeachIn-Funktion" 16 "AZG-Init.-Wert fuer alle Adaptionswerte" 18 "AZG-Init.-Wert fuer GLS ERS Kennfeld 1" 19 "AZG-Init.-Wert fuer GLS ERS Kennfeld 2" 20 "AZG-Init.-Wert fuer GLS DRS Kennfeld 1" 21 "AZG-Init.-Wert fuer GLS DRS Kennfeld 2" 22 "AZG-Init.-Wert fuer GLS Mehrfach RS" 23 "AZG-Init.-Wert fuer GLS EHS Kennfeld 1" 24 "AZG-Init.-Wert fuer GLS EHS Kennfeld 2" 25 "AZG-Init.-Wert fuer Schnellfuellzeit Ada Werte" 32 "AZG-Init.-Wert fuer Fuelldruck Ada Werte" 33 "AZG-Init.-Wert fuer interne Pulsadaptionswerte" 40 "AZG-Init.-Wert fuer Schnellfuellzeit Ada Speicher loeschen" 41 "AZG-Init.-Wert fuer CSC-Ada" 85 "AZG-Init.-Wert fuer Info Speicher" 96 "AZG-Init.-Wert fuer Schnellfuellzeit Ada Werte K0" 97 "AZG-Init.-Wert fuer Fuelldruck Ada Werte K0" 98 "AZG-Init.-Wert fuer Schnellfuellzeit-BPZ K0" 99 "AZG-Init.-Wert fuer Fuelldruck-BPZ K0" 114 "AZG-Init.-Wert fuer Schnellfuellzeit-BPZ WK" 115 "AZG-Init.-Wert fuer interne Pulsadaptionswerte WK" 128 "AZG-Init.-Wert fuer GLS DHS" DEFAULT_VALUE "" /end COMPU_VTAB
/begin COMPU_VTAB Conv.cAdaGlosc._.z_ada_schaltung_S5_S3 "Umrechnung fuer Messgroesse cAdaGlosc::z_ada_schaltung" TAB_VERB 3 0 "keine Schaltung" 1 "bewertbare Standardschaltung" 2 "Wechsel-Schaltung" DEFAULT_VALUE "" /end COMPU_VTAB
/begin COMPU_VTAB Conv.cAdaIaeap._.abbruch_bit_ada_iae_S5_S3 "Umrechnung fuer Messgroesse cAdaIaeap::abbruch_bit_ada_iae" TAB_VERB 27 0 "KEIN_ABBRUCH_BIT" 1 "ABBRUCH_BIT_PASSIV_ADA_IAE_AUS" 2 "ABBRUCH_BIT_PASSIV_CTR" 4 "ABBRUCH_BIT_PASSIV_C_DELTA" 8 "ABBRUCH_BIT_PASSIV_Z_IAE_PREV" 16 "ABBRUCH_BIT_PASSIV_ALLG_ADA" 256 "ABBRUCH_BIT_WS_DKI" 512 "ABBRUCH_BIT_WS_STATUS_HAS" 1024 "ABBRUCH_BIT_WS_K0" 2048 "ABBRUCH_BIT_WS_Z_MODUS_IAE" 4096 "ABBRUCH_BIT_WS_ALLG_ADA" 8192 "ABBRUCH_BIT_GLOBAL_DKI" 16384 "ABBRUCH_BIT_GLOBAL_M_MOT" 32768 "ABBRUCH_BIT_GLOBAL_MG_MOT" 65536 "ABBRUCH_BIT_GLOBAL_NG_MOT" 131072 "ABBRUCH_BIT_GLOBAL_N_AB" 262144 "ABBRUCH_BIT_GLOBAL_P_BREMS" 524288 "ABBRUCH_BIT_GLOBAL_PG_BREMS" 1048576 "ABBRUCH_BIT_GLOBAL_ISTGANG" 2097152 "ABBRUCH_BIT_GLOBAL_KFL" 4194304 "ABBRUCH_BIT_GLOBAL_N_MOT_SOLL" 8388608 "ABBRUCH_BIT_GLOBAL_STATUS_HAS" 16777216 "ABBRUCH_BIT_GLOBAL_IEP" 33554432 "ABBRUCH_BIT_GLOBAL_K0" 67108864 "ABBRUCH_BIT_GLOBAL_Z_MODUS_IAE" 134217728 "ABBRUCH_BIT_GLOBAL_M_STELL" 268435456 "ABBRUCH_BIT_GLOBAL_ALLG_ADA" DEFAULT_VALUE "" /end COMPU_VTAB
/begin COMPU_VTAB Conv.cAdaIaeap._.f_abbruch_global_iae_S5_S3 "Umrechnung fuer Messgroesse cAdaIaeap::f_abbruch_global_iae" TAB_VERB 2 0 "FALSE" 1 "TRUE" DEFAULT_VALUE "" /end COMPU_VTAB
/begin COMPU_VTAB Conv.cAdaIaeap._.f_ada_iae_ein_S5_S3 "Umrechnung fuer Messgroesse cAdaIaeap::f_ada_iae_ein" TAB_VERB 2 0 "FALSE" 1 "TRUE" DEFAULT_VALUE "" /end COMPU_VTAB
/begin COMPU_VTAB Conv.cAdaIaeap._.f_angelegt_mmot_iae_S5_S3 "Umrechnung fuer Messgroesse cAdaIaeap::f_angelegt_mmot_iae" TAB_VERB 2 0 "FALSE" 1 "TRUE" DEFAULT_VALUE "" /end COMPU_VTAB
/begin COMPU_VTAB Conv.cAdaIaeap._.f_angelegt_nmot_iae_S5_S3 "Umrechnung fuer Messgroesse cAdaIaeap::f_angelegt_nmot_iae" TAB_VERB 2 0 "FALSE" 1 "TRUE" DEFAULT_VALUE "" /end COMPU_VTAB
/begin COMPU_VTAB Conv.cAdaIaeap._.f_bew_verboten_iae_S5_S3 "Umrechnung fuer Messgroesse cAdaIaeap::f_bew_verboten_iae" TAB_VERB 2 0 "FALSE" 1 "TRUE" DEFAULT_VALUE "" /end COMPU_VTAB
/begin COMPU_VTAB Conv.cAdaIaeap._.f_gmmot_begrenzungs_rampe_S5_S3 "Umrechnung fuer Messgroesse cAdaIaeap::f_gmmot_begrenzungs_rampe" TAB_VERB 2 0 "FALSE" 1 "TRUE" DEFAULT_VALUE "" /end COMPU_VTAB
/begin COMPU_VTAB Conv.cAdaIaeap._.f_rampinit_iae_S5_S3 "Umrechnung fuer Messgroesse cAdaIaeap::f_rampinit_iae" TAB_VERB 2 0 "FALSE" 1 "TRUE" DEFAULT_VALUE "" /end COMPU_VTAB
/begin COMPU_VTAB Conv.cAdaIaeap._.req_n_mot_llsoll_iae_S5_S3 "Umrechnung fuer Messgroesse cAdaIaeap::req_n_mot_llsoll_iae" TAB_VERB 2 0 "FALSE" 1 "TRUE" DEFAULT_VALUE "" /end COMPU_VTAB
/begin COMPU_VTAB Conv.cAdaIaeap._.z_apada_iae_S5_S3 "Umrechnung fuer Messgroesse cAdaIaeap::z_apada_iae" TAB_VERB 15 0 "Z_ADA_IAE_PASSIV" 1 "Z_ADA_IAE_EINSTIEG_PRUEFEN" 2 "Z_ADA_IAE_WARTEN_SPERRZEIT" 3 "Z_ADA_IAE_WARTEN_STAT_BED" 4 "Z_ADA_IAE_ABSENKEN_START" 5 "Z_ADA_IAE_ABSENKEN_KONST" 6 "Z_ADA_IAE_ABSENKEN_UEF" 7 "Z_ADA_IAE_PRUEFRAMPE" 8 "Z_ADA_IAE_HYS_SCHLEIFE_AB" 9 "Z_ADA_IAE_HYS_SCHLEIFE_KONST" 10 "Z_ADA_IAE_HYS_SCHLEIFE_AUF" 11 "Z_ADA_IAE_WARTEN_MMOT_PRUEFUNG" 12 "Z_ADA_IAE_MMOT_PRUEFUNG" 13 "Z_ADA_IAE_ABBRUCH_RAMPE" 14 "Z_ADA_IAE_ENDE" DEFAULT_VALUE "" /end COMPU_VTAB
/begin COMPU_VTAB Conv.cAdaIaeuf._.f_ada_sperren_werteuebername_S5_S3 "Umrechnung fuer Messgroesse cAdaIaeuf::f_ada_sperren_werteuebername" TAB_VERB 2 0 "FALSE" 1 "TRUE" DEFAULT_VALUE "" /end COMPU_VTAB
/begin COMPU_VTAB Conv.cAdaIaeuf._.f_read_kf_gueltig_S5_S3 "Umrechnung fuer Messgroesse cAdaIaeuf::f_read_kf_gueltig" TAB_VERB 2 0 "FALSE" 1 "TRUE" DEFAULT_VALUE "" /end COMPU_VTAB
/begin COMPU_VTAB Conv.cAdaPfusf._.adapfn_status_S5_S3 "Umrechnung fuer Messgroesse cAdaPfusf::adapfn_status" TAB_VERB 16 0 "Passiv" 1 "Start" 2 "Warten auf Ende von Schnell-Fuellung" 3 "Warten auf Ende der Verzoegerungs-Zeit (HS)" 4 "Beobachten des Drehzahl-Einzuges (HS)" 5 "Beobachten Verlassen von Synchron (RS)" 6 "Warten auf Schaltungsende" 7 "Bewertung" 8 "Bewertung durchgefuehrt" 9 "Bewertung verboten" 10 "Abbruch durch SAS" 11 "Abbruchbedingung eingetreten" 12 "Abbruch durch Schaltungsende" 13 "Zustandsfehler" 14 "Warten auf Synchron neuer Gang (RS nur ADA SFT)" 15 "Schaltung wurde nicht von SAS beendet" DEFAULT_VALUE "" /end COMPU_VTAB
/begin COMPU_VTAB Conv.cAdaPfusf._.adkl_pfad_S5_S3 "Umrechnung fuer Messgroesse cAdaPfusf::adkl_pfad" TAB_VERB 6 0 "KEINE" 1 "K_A" 2 "K_B" 3 "K_C" 4 "K_D" 5 "K_E" DEFAULT_VALUE "" /end COMPU_VTAB
/begin COMPU_VTAB Conv.cAdaPfusf._.f_max_flare_erreicht_hs_pfad_S5_S3 "Umrechnung fuer Messgroesse cAdaPfusf::f_max_flare_erreicht_hs_pfad" TAB_VERB 2 0 "nein" 1 "Flare erreicht" DEFAULT_VALUE "" /end COMPU_VTAB
/begin COMPU_VTAB Conv.cAdaPfusf._.f_mt_krit_aktiv_pfad_S5_S3 "Umrechnung fuer Messgroesse cAdaPfusf::f_mt_krit_aktiv_pfad" TAB_VERB 2 0 "nein" 1 "ja" DEFAULT_VALUE "" /end COMPU_VTAB
/begin COMPU_VTAB Conv.cAdaPfusf._.pm_gls_status_S5_S3 "Umrechnung fuer Messgroesse cAdaPfusf::pm_gls_status" TAB_VERB 5 10 "PASSIV_GLS_PFAD" 11 "START_GLS_PFAD" 12 "WARTEN_AUF_GLS_PFAD" 13 "AKTIV_GLS_KZU_PFAD" 14 "PM_OK_PFAD" DEFAULT_VALUE "" /end COMPU_VTAB
/begin COMPU_VTAB Conv.cAdaPfusf._.schaltart_pfad_S5_S3 "Umrechnung fuer Messgroesse cAdaPfusf::schaltart_pfad" TAB_VERB 3 0 "KS" 1 "HS" 2 "RS" DEFAULT_VALUE "" /end COMPU_VTAB
/begin COMPU_VTAB Conv.cAdaPfusf._.schaltcode_pfad_S5_S3 "Umrechnung fuer Messgroesse cAdaPfusf::schaltcode_pfad" TAB_VERB 17 0 "keine adaptionsrelevante Schaltung" 1 "Schalt-Code 12" 2 "Schalt-Code 23" 3 "Schalt-Code 34" 4 "Schalt-Code 45" 5 "Schalt-Code 56" 6 "Schalt-Code 67" 7 "Schalt-Code 78" 8 "Schalt-Code 89" 10 "Schalt-Code 21" 11 "Schalt-Code 32" 12 "Schalt-Code 43" 13 "Schalt-Code 54" 14 "Schalt-Code 65" 15 "Schalt-Code 76" 16 "Schalt-Code 87" 17 "Schalt-Code 98" DEFAULT_VALUE "" /end COMPU_VTAB
/begin COMPU_VTAB Conv.cAdaPstbw._.neg_rea_stada_S5_S3 "Umrechnung fuer Messgroesse cAdaPstbw::neg_rea_stada" TAB_VERB 3 0 "Keine Reaktion erkannt" 1 "ND_TSF/PFPULSNEG erkannt" 2 "ND_TSF/PFPULSZWNEG erkannt" DEFAULT_VALUE "" /end COMPU_VTAB
/begin COMPU_VTAB Conv.cAdaPstbw._.pos_rea_stada_S5_S3 "Umrechnung fuer Messgroesse cAdaPstbw::pos_rea_stada" TAB_VERB 3 0 "Keine Reaktion erkannt" 1 "ND_TSF/PFPULSPOS erkannt" 2 "ND_TSF/PFPULSZWPOS erkannt" DEFAULT_VALUE "" /end COMPU_VTAB
/begin COMPU_VTAB Conv.cAdaPstbw._.rea_amplitude_stada_S5_S3 "Umrechnung fuer Messgroesse cAdaPstbw::rea_amplitude_stada" TAB_VERB 2 0 "Keine Reaktion erkannt" 1 "ND_TSF/PFPULSAMP erkannt" DEFAULT_VALUE "" /end COMPU_VTAB
/begin COMPU_VTAB Conv.cAdaPstbw._.testresultat_stada_S5_S3 "Umrechnung fuer Messgroesse cAdaPstbw::testresultat_stada" TAB_VERB 5 0 "Keine Reaktion" 1 "Reaktion zu klein" 2 "Reaktion erwartet" 3 "Reaktion zu gross" 4 "Reaktion viel zu gross" DEFAULT_VALUE "" /end COMPU_VTAB
/begin COMPU_VTAB Conv.cAdaPstbw._.zustand_stada_S5_S3 "Umrechnung fuer Messgroesse cAdaPstbw::zustand_stada" TAB_VERB 5 0 "Kein Beobachtungsablauf aktiv" 1 "Es wird die Reaktion bestimmt" 2 "Es wird bewertet" 3 "Die Bewertung ist abgeschlossen" 4 "Es ist ein Fehler aufgetreten" DEFAULT_VALUE "" /end COMPU_VTAB
/begin COMPU_VTAB Conv.cAdaPstbwFenster._.f_aktiv_stada_S5_S3 "Umrechnung fuer Messgroesse cAdaPstbwFenster::f_aktiv_stada" TAB_VERB 2 0 "FALSE" 1 "TRUE" DEFAULT_VALUE "" /end COMPU_VTAB
/begin COMPU_VTAB Conv.cAdaPstbwFenster._.f_beenden_stada_S5_S3 "Umrechnung fuer Messgroesse cAdaPstbwFenster::f_beenden_stada" TAB_VERB 2 0 "FALSE" 1 "TRUE" DEFAULT_VALUE "" /end COMPU_VTAB
/begin COMPU_VTAB Conv.cAdaPstbwFenster._.f_starten_stada_S5_S3 "Umrechnung fuer Messgroesse cAdaPstbwFenster::f_starten_stada" TAB_VERB 2 0 "FALSE" 1 "TRUE" DEFAULT_VALUE "" /end COMPU_VTAB
/begin COMPU_VTAB Conv.cAdaPstCondition._.preadaption_condition_stada_int_S5_S3 "Umrechnung fuer Messgroesse cAdaPstCondition::preadaption_condition_stada_int" TAB_VERB 17 0 "PREADA_COND_DEF" 1 "PREADA_COND_BED_IO" 2 "PREADA_COND_BEREITS_DURCH" 3 "PREADA_COND_CGETR_UN_NIO" 4 "PREADA_COND_CGETR_OB_NIO" 5 "PREADA_COND_PBED_NIO" 6 "PREADA_COND_POS_NIO" 7 "PREADA_COND_FP_NIO" 8 "PREADA_COND_NAB_NIO" 9 "PREADA_COND_NMOT_NIO" 10 "PREADA_COND_PBREMSE_NIO" 11 "PREADA_COND_ALGADA_NIO" 12 "PREADA_COND_FEHLE_PULS_NIO" 100 "PREADA_COND_E_FAHREN_NIO" 101 "PREADA_COND_POS_NP_NIO" 102 "PREADA_COND_K0_GESCHLOSSEN_NIO" 255 "PREADA_COND_BED_ALLG_NIO" DEFAULT_VALUE "" /end COMPU_VTAB
/begin COMPU_VTAB Conv.cAdaPstCondition._.preadaption_condition_stada_S5_S3 "Umrechnung fuer Messgroesse cAdaPstCondition::preadaption_condition_stada" TAB_VERB 17 0 "PREADA_COND_DEF" 1 "PREADA_COND_BED_IO" 2 "PREADA_COND_BEREITS_DURCH" 3 "PREADA_COND_CGETR_UN_NIO" 4 "PREADA_COND_CGETR_OB_NIO" 5 "PREADA_COND_PBED_NIO" 6 "PREADA_COND_POS_NIO" 7 "PREADA_COND_FP_NIO" 8 "PREADA_COND_NAB_NIO" 9 "PREADA_COND_NMOT_NIO" 10 "PREADA_COND_PBREMSE_NIO" 11 "PREADA_COND_ALGADA_NIO" 12 "PREADA_COND_FEHLE_PULS_NIO" 100 "PREADA_COND_E_FAHREN_NIO" 101 "PREADA_COND_POS_NP_NIO" 102 "PREADA_COND_K0_GESCHLOSSEN_NIO" 255 "PREADA_COND_BED_ALLG_NIO" DEFAULT_VALUE "" /end COMPU_VTAB
/begin COMPU_VTAB Conv.cAdaPstpf._.fenster_nach_sf_stada_S5_S3 "Umrechnung fuer Messgroesse cAdaPstpf::fenster_nach_sf_stada" TAB_VERB 2 0 "Abfrage auf ND_ADABBR erlaubt" 1 "Abfrage auf ND_ADABBR ist verboten" DEFAULT_VALUE "" /end COMPU_VTAB
/begin COMPU_VTAB Conv.cAdaPstpf._.fenster_sf_stada_S5_S3 "Umrechnung fuer Messgroesse cAdaPstpf::fenster_sf_stada" TAB_VERB 2 0 "Abfrage auf ND_ADABBR erlaubt" 1 "Abfrage auf ND_ADABBR ist verboten" DEFAULT_VALUE "" /end COMPU_VTAB
/begin COMPU_VTAB Conv.cAdaPstpf._.zustand_stada_S5_S3 "Umrechnung fuer Messgroesse cAdaPstpf::zustand_stada" TAB_VERB 8 0 "STDAD_PF_KEINE_PRUEFUNG" 1 "STDAD_PF_WARTEN_AUF_SF" 2 "STDAD_PF_SF_AKTIV" 3 "STDAD_PF_FD_AKTIV" 4 "STDAD_PF_FD_PULS_AKTIV" 5 "STDAD_PF_UEBERWACHUNG_AKTIV" 6 "STDAD_PF_ENDE" 7 "STDAD_PF_FEHLER_BEI_PRUEFUNG" DEFAULT_VALUE "" /end COMPU_VTAB
/begin COMPU_VTAB Conv.cAdaPstsf._.zustand_stada_S5_S3 "Umrechnung fuer Messgroesse cAdaPstsf::zustand_stada" TAB_VERB 7 0 "STDAD_TSF_KEINE_PRUEFUNG" 1 "STDAD_TSF_WARTEN_AUF_SF" 2 "STDAD_TSF_SF_AKTIV" 3 "STDAD_TSF_FD_AKTIV" 4 "STDAD_TSF_UEBERWACHUNG_AKTIV" 5 "STDAD_TSF_ENDE" 6 "STDAD_TSF_FEHLER_BEI_PRUEFUNG" DEFAULT_VALUE "" /end COMPU_VTAB
/begin COMPU_VTAB Conv.cAdaPstState._.preadaption_state_stada_S5_S3 "Umrechnung fuer Messgroesse cAdaPstState::preadaption_state_stada" TAB_VERB 5 0 "PREADA_STATE_NICHT_GEST" 1 "PREADA_STATE_INIT" 2 "PREADA_STATE_LAEUFT" 3 "PREADA_STATE_BEENDET" 4 "PREADA_STATE_ABGEBROCHEN" DEFAULT_VALUE "" /end COMPU_VTAB
/begin COMPU_VTAB Conv.cAdaPstUserinfo._.preadaption_userinfo_stada_S5_S3 "Umrechnung fuer Messgroesse cAdaPstUserinfo::preadaption_userinfo_stada" TAB_VERB 2 0 "PREADA_USERINFO_KEINE_BED_ANW" 255 "PREADA_USERINFO_ABGEBROCHEN" DEFAULT_VALUE "" /end COMPU_VTAB
/begin COMPU_VTAB Conv.cAdaPstzs._.akt_ada_S5_S3 "Umrechnung fuer Messgroesse cAdaPstzs::akt_ada" TAB_VERB 3 0 "AKT_ADA_KEINE" 1 "AKT_ADA_KUP" 2 "AKT_ADA_K0" DEFAULT_VALUE "" /end COMPU_VTAB
/begin COMPU_VTAB Conv.cAdaPstzs._.anz_kup_puls_stada_S5_S3 "Umrechnung fuer Messgroesse cAdaPstzs::anz_kup_puls_stada" TAB_VERB 7 0 "KEINE_KUPPLUNG" 1 "K_A" 2 "K_B" 3 "K_C" 4 "K_D" 5 "K_E" 6 "K_K0" DEFAULT_VALUE "" /end COMPU_VTAB
/begin COMPU_VTAB Conv.cAdaPstzs._.anz_pf_durchgefuehrt_stada_S5_S3 "Umrechnung fuer Messgroesse cAdaPstzs::anz_pf_durchgefuehrt_stada" TAB_VERB 3 0 "STDAD_PRUEFUNG_INAKTIV" 1 "STDAD_PRUEFUNG_AKTIV" 2 "STDAD_PRUEFUNG_BEENDET" DEFAULT_VALUE "" /end COMPU_VTAB
/begin COMPU_VTAB Conv.cAdaPstzs._.anz_prueftyp_stada_S5_S3 "Umrechnung fuer Messgroesse cAdaPstzs::anz_prueftyp_stada" TAB_VERB 4 0 "STDAD_KEINE_PRUEFUNG_AKTIV" 1 "STDAD_SF_PRUEFUNG_AKTIV" 2 "STDAD_PF_PRUEFUNG_AKTIV" 3 "STDAD_DURCHGEFUEHRT" DEFAULT_VALUE "" /end COMPU_VTAB
/begin COMPU_VTAB Conv.cAdaPstzs._.anz_pulsid_stada_S5_S3 "Umrechnung fuer Messgroesse cAdaPstzs::anz_pulsid_stada" TAB_VERB 5 0 "STDAD_KEIN_PULS" 1 "STDAD_PULSID_1" 2 "STDAD_PULSID_2" 3 "STDAD_PULSID_3" 4 "STDAD_PULSID_4" DEFAULT_VALUE "" /end COMPU_VTAB
/begin COMPU_VTAB Conv.cAdaPstzs._.anz_tsf_durchgefuehrt_stada_S5_S3 "Umrechnung fuer Messgroesse cAdaPstzs::anz_tsf_durchgefuehrt_stada" TAB_VERB 3 0 "STDAD_PRUEFUNG_INAKTIV" 1 "STDAD_PRUEFUNG_AKTIV" 2 "STDAD_PRUEFUNG_BEENDET" DEFAULT_VALUE "" /end COMPU_VTAB
/begin COMPU_VTAB Conv.cAdaPstzs._.druck_statisch_stada_S5_S3 "Umrechnung fuer Messgroesse cAdaPstzs::druck_statisch_stada" TAB_VERB 2 0 "FALSE" 1 "TRUE" DEFAULT_VALUE "" /end COMPU_VTAB
/begin COMPU_VTAB Conv.cAdaPstzs._.f_deaktivierung_erkannt_S5_S3 "Umrechnung fuer Messgroesse cAdaPstzs::f_deaktivierung_erkannt" TAB_VERB 2 0 "FALSE" 1 "TRUE" DEFAULT_VALUE "" /end COMPU_VTAB
/begin COMPU_VTAB Conv.cAdaPstzs._.f_nmotsoll_stada_em_S5_S3 "Umrechnung fuer Messgroesse cAdaPstzs::f_nmotsoll_stada_em" TAB_VERB 2 0 "FALSE" 1 "TRUE" DEFAULT_VALUE "" /end COMPU_VTAB
/begin COMPU_VTAB Conv.cAdaPstzs._.fzg_stillstand_k0_stada_S5_S3 "Umrechnung fuer Messgroesse cAdaPstzs::fzg_stillstand_k0_stada" TAB_VERB 2 0 "FALSE" 1 "TRUE" DEFAULT_VALUE "" /end COMPU_VTAB
/begin COMPU_VTAB Conv.cAdaPstzs._.fzg_stillstand_stada_S5_S3 "Umrechnung fuer Messgroesse cAdaPstzs::fzg_stillstand_stada" TAB_VERB 2 0 "FALSE" 1 "TRUE" DEFAULT_VALUE "" /end COMPU_VTAB
/begin COMPU_VTAB Conv.cAdaPstzs._.gang_zzs_stada_S5_S3 "Umrechnung fuer Messgroesse cAdaPstzs::gang_zzs_stada" TAB_VERB 10 -1 "GR1" 0 "KEIN_GANG" 1 "G1" 2 "G2" 3 "G3" 4 "G4" 5 "G5" 6 "G6" 7 "G7" 8 "G8" DEFAULT_VALUE "" /end COMPU_VTAB
/begin COMPU_VTAB Conv.cAdaPstzs._.grundbedingung_erfuellt_einmalig_k0_stada_S5_S3 "Umrechnung fuer Messgroesse cAdaPstzs::grundbedingung_erfuellt_einmalig_k0_stada" TAB_VERB 2 0 "FALSE" 1 "TRUE" DEFAULT_VALUE "" /end COMPU_VTAB
/begin COMPU_VTAB Conv.cAdaPstzs._.grundbedingung_erfuellt_einmalig_stada_S5_S3 "Umrechnung fuer Messgroesse cAdaPstzs::grundbedingung_erfuellt_einmalig_stada" TAB_VERB 2 0 "FALSE" 1 "TRUE" DEFAULT_VALUE "" /end COMPU_VTAB
/begin COMPU_VTAB Conv.cAdaPstzs._.grundbedingung_erfuellt_zyklisch_k0_stada_S5_S3 "Umrechnung fuer Messgroesse cAdaPstzs::grundbedingung_erfuellt_zyklisch_k0_stada" TAB_VERB 2 0 "FALSE" 1 "TRUE" DEFAULT_VALUE "" /end COMPU_VTAB
/begin COMPU_VTAB Conv.cAdaPstzs._.grundbedingung_erfuellt_zyklisch_stada_S5_S3 "Umrechnung fuer Messgroesse cAdaPstzs::grundbedingung_erfuellt_zyklisch_stada" TAB_VERB 2 0 "FALSE" 1 "TRUE" DEFAULT_VALUE "" /end COMPU_VTAB
/begin COMPU_VTAB Conv.cAdaPstzs._.kup_pruefpuls_ausgabe_stada_S5_S3 "Umrechnung fuer Messgroesse cAdaPstzs::kup_pruefpuls_ausgabe_stada" TAB_VERB 7 0 "KEINE_KUPPLUNG" 1 "K_A" 2 "K_B" 3 "K_C" 4 "K_D" 5 "K_E" 6 "K_K0" DEFAULT_VALUE "" /end COMPU_VTAB
/begin COMPU_VTAB Conv.cAdaPstzs._.kup_puls_stada_S5_S3 "Umrechnung fuer Messgroesse cAdaPstzs::kup_puls_stada" TAB_VERB 7 0 "KEINE_KUPPLUNG" 1 "K_A" 2 "K_B" 3 "K_C" 4 "K_D" 5 "K_E" 6 "K_K0" DEFAULT_VALUE "" /end COMPU_VTAB
/begin COMPU_VTAB Conv.cAdaPstzs._.pre_ada_zustand_stada_S5_S3 "Umrechnung fuer Messgroesse cAdaPstzs::pre_ada_zustand_stada" TAB_VERB 16 0 "STDAD_ZUST_PASSIV_INIT" 1 "STDAD_ZUST_PASSIV" 2 "STDAD_ZUST_TESTER_AKTIV_INIT" 3 "STDAD_ZUST_TESTER_AKTIV" 4 "STDAD_ZUST_TESTFALL" 5 "STDAD_SYSTEMKONDITIONIERUNG" 6 "STDAD_ZUST_ZYKLUS_STARTEN_INIT" 7 "STDAD_ZUST_PULS_STARTEN_INIT" 8 "STDAD_ZUST_PULS_STARTEN" 9 "STDAD_ZUST_PULS_INIT" 10 "STDAD_ZUST_PULS" 11 "STDAD_ZUST_BEENDT" 12 "STDAD_ZUST_SYSTKONDIT_ABBAU_INIT" 13 "STDAD_ZUST_SYSTKONDIT_ABBAU_WARTEN" 14 "STDAD_ZUST_SYSTKONDIT_ABBAU_BEENDET" 15 "STDAD_ZUST_WART_TESTER_DEAK" DEFAULT_VALUE "" /end COMPU_VTAB
/begin COMPU_VTAB Conv.cAdaPstzs._.pulsid_stada_S5_S3 "Umrechnung fuer Messgroesse cAdaPstzs::pulsid_stada" TAB_VERB 5 0 "STDAD_KEIN_PULS" 1 "STDAD_PULSID_1" 2 "STDAD_PULSID_2" 3 "STDAD_PULSID_3" 4 "STDAD_PULSID_4" DEFAULT_VALUE "" /end COMPU_VTAB
/begin COMPU_VTAB Conv.cAdaPstzs._.pulszyklus_beenden_stada_S5_S3 "Umrechnung fuer Messgroesse cAdaPstzs::pulszyklus_beenden_stada" TAB_VERB 4 0 "STDAD_ZYKLUS_NICHT_BEENDEN" 1 "STDAD_ZYKL_BEENDEN_WG_PULS_4" 2 "STDAD_ZYKL_BEENDEN_WG_PULSGRENZ" 3 "STDAD_ZYKL_BEENDEN_WG_ZWSP" DEFAULT_VALUE "" /end COMPU_VTAB
/begin COMPU_VTAB Conv.cAdaPstzs._.sal_eng_start_req_S5_S3 "Umrechnung fuer Messgroesse cAdaPstzs::sal_eng_start_req" TAB_VERB 2 0 "FALSE" 1 "TRUE" DEFAULT_VALUE "" /end COMPU_VTAB
/begin COMPU_VTAB Conv.cAdaPstzs._.sal_eng_stop_disable_S5_S3 "Umrechnung fuer Messgroesse cAdaPstzs::sal_eng_stop_disable" TAB_VERB 2 0 "FALSE" 1 "TRUE" DEFAULT_VALUE "" /end COMPU_VTAB
/begin COMPU_VTAB Conv.cAdaPstzs._.schnellfuellung_aktiv_stada_S5_S3 "Umrechnung fuer Messgroesse cAdaPstzs::schnellfuellung_aktiv_stada" TAB_VERB 2 0 "FALSE" 1 "TRUE" DEFAULT_VALUE "" /end COMPU_VTAB
/begin COMPU_VTAB Conv.cAdaPstzs._.testfall_gang_stada_S5_S3 "Umrechnung fuer Messgroesse cAdaPstzs::testfall_gang_stada" TAB_VERB 10 -1 "GR1" 0 "KEIN_GANG" 1 "G1" 2 "G2" 3 "G3" 4 "G4" 5 "G5" 6 "G6" 7 "G7" 8 "G8" DEFAULT_VALUE "" /end COMPU_VTAB
/begin COMPU_VTAB Conv.cAdaPstzs._.testfall_ind_stada_S5_S3 "Umrechnung fuer Messgroesse cAdaPstzs::testfall_ind_stada" TAB_VERB 13 0 "Test0" 1 "Test1" 2 "Test2" 3 "Test3" 4 "Test4" 5 "Test5" 6 "Test6" 7 "Test7" 8 "Test8" 9 "Test9" 10 "Test10" 11 "Test11" 12 "Test12" DEFAULT_VALUE "" /end COMPU_VTAB
/begin COMPU_VTAB Conv.cAdaPstzs._.testfall_kup_ind_stada_S5_S3 "Umrechnung fuer Messgroesse cAdaPstzs::testfall_kup_ind_stada" TAB_VERB 2 0 "Prio1 Kupplung" 1 "Prio2 Kupplung" DEFAULT_VALUE "" /end COMPU_VTAB
/begin COMPU_VTAB Conv.cAdaPstzs._.testfall_prueftyp_stada_S5_S3 "Umrechnung fuer Messgroesse cAdaPstzs::testfall_prueftyp_stada" TAB_VERB 4 0 "STDAD_KEINE_PRUEFUNG_AKTIV" 1 "STDAD_SF_PRUEFUNG_AKTIV" 2 "STDAD_PF_PRUEFUNG_AKTIV" 3 "STDAD_DURCHGEFUEHRT" DEFAULT_VALUE "" /end COMPU_VTAB
/begin COMPU_VTAB Conv.cAdaPstzs._.z_k0_stada_S5_S3 "Umrechnung fuer Messgroesse cAdaPstzs::z_k0_stada" TAB_VERB 2 0 "Z_K0_STADA_KEINE" 1 "Z_K0_STADA_GESCHLOSSEN" DEFAULT_VALUE "" /end COMPU_VTAB
/begin COMPU_VTAB Conv.cAdaPstzs._.z_systemkondit_agl_S5_S3 "Umrechnung fuer Messgroesse cAdaPstzs::z_systemkondit_agl" TAB_VERB 5 0 "SYSTEMKONDIT_AGL_PASSIV" 1 "SYSTEMKONDIT_AGL_AKTIVIEREN" 2 "SYSTEMKONDIT_AGL_WARTEN" 3 "SYSTEMKONDIT_AGL_ABGESCHLOSSEN" 4 "SYSTEMKONDIT_AGL_FEHLER" DEFAULT_VALUE "" /end COMPU_VTAB
/begin COMPU_VTAB Conv.cAdaPstzs._.z_systemkondit_funkdeakt_S5_S3 "Umrechnung fuer Messgroesse cAdaPstzs::z_systemkondit_funkdeakt" TAB_VERB 9 0 "SYSTEMKONDIT_FUNKDEAKT_PASSIV" 1 "SYSTEMKONDIT_FUNKDEAKT_AKTIVIEREN" 2 "SYSTEMKONDIT_FUNKDEAKT_WARTEN" 3 "SYSTEMKONDIT_FUNKDEAKT_AKTIV" 4 "SYSTEMKONDIT_FUNKDEAKT_ABGESCHLOSSEN" 5 "SYSTEMKONDIT_FUNKDEAKT_DEAKTIVIEREN" 6 "SYSTEMKONDIT_FUNKDEAKT_DEAKTIVIEREN_WARTEN" 7 "SYSTEMKONDIT_FUNKDEAKT_DEAKTIVIEREN_ABGESCHLOSSEN" 8 "SYSTEMKONDIT_FUNKDEAKT_FEHLER" DEFAULT_VALUE "" /end COMPU_VTAB
/begin COMPU_VTAB Conv.cAdaPstzs._.z_systemkondit_nmot_S5_S3 "Umrechnung fuer Messgroesse cAdaPstzs::z_systemkondit_nmot" TAB_VERB 9 0 "SYSTEMKONDIT_NMOT_PASSIV" 1 "SYSTEMKONDIT_NMOT_AKTIVIEREN" 2 "SYSTEMKONDIT_NMOT_WARTEN_ZZS" 3 "SYSTEMKONDIT_NMOT_WARTEN_ZEIT" 4 "SYSTEMKONDIT_NMOT_AKTIV" 5 "SYSTEMKONDIT_NMOT_ABGESCHLOSSEN" 6 "SYSTEMKONDIT_NMOT_DEAKTIVIEREN" 7 "SYSTEMKONDIT_NMOT_DEAKTIVIEREN_ABGESCHLOSSEN" 8 "SYSTEMKONDIT_NMOT_FEHLER" DEFAULT_VALUE "" /end COMPU_VTAB
/begin COMPU_VTAB Conv.cAdaPstzs._.z_systemkondit_zzs_S5_S3 "Umrechnung fuer Messgroesse cAdaPstzs::z_systemkondit_zzs" TAB_VERB 12 0 "SYSTEMKONDIT_ZZS_PASSIV" 1 "SYSTEMKONDIT_ZZS_N_AKTIVIEREN" 2 "SYSTEMKONDIT_ZZS_N_WARTEN" 3 "SYSTEMKONDIT_ZZS_N_AKTIV" 4 "SYSTEMKONDIT_ZZS_GANG_VORG" 5 "SYSTEMKONDIT_ZZS_GANG_WARTEN" 6 "SYSTEMKONDIT_ZZS_GANG_AKTIV" 7 "SYSTEMKONDIT_ZZS_ABGESCHLOSSEN" 8 "SYSTEMKONDIT_ZZS_DEAKTIVIEREN" 9 "SYSTEMKONDIT_ZZS_DEAKTIVIEREN_WARTEN" 10 "SYSTEMKONDIT_ZZS_DEAKTIVIEREN_ABGESCHLOSSEN" 11 "SYSTEMKONDIT_ZZS_FEHLER" DEFAULT_VALUE "" /end COMPU_VTAB
/begin COMPU_VTAB Conv.cAdaPstzs._.zustand_stada_S5_S3 "Umrechnung fuer Messgroesse cAdaPstzs::zustand_stada" TAB_VERB 9 0 "STDAD_INAKTIV" 1 "STDAD_SPERRZEITEN_AKTIV" 2 "STDAD_PASSIV" 3 "STDAD_START" 4 "STDAD_WARTEN" 5 "STDAD_SCHNELLFUELLUNG" 6 "STDAD_FUELLDRUCK" 7 "STDAD_PULSENDE_BEWERTUNG_AKTIV" 8 "STDAD_FEHLER_BEI_PRUEFUNG" DEFAULT_VALUE "" /end COMPU_VTAB
/begin COMPU_VTAB Conv.cAdaPulbw._.f_start_t_sperrt_nach_reak_S5_S3 "Umrechnung fuer Messgroesse cAdaPulbw::f_start_t_sperrt_nach_reak" TAB_VERB 2 0 "Reaktion erkannt" 1 "Keine Reaktion erkannt" DEFAULT_VALUE "" /end COMPU_VTAB
/begin COMPU_VTAB Conv.cAdaPulbw._.neg_rea_S5_S3 "Umrechnung fuer Messgroesse cAdaPulbw::neg_rea" TAB_VERB 3 0 "Keine Reaktion erkannt" 1 "ND_TSF/PFPULSNEG erkannt" 2 "ND_TSF/PFPULSZWNEG erkannt" DEFAULT_VALUE "" /end COMPU_VTAB
/begin COMPU_VTAB Conv.cAdaPulbw._.pos_rea_S5_S3 "Umrechnung fuer Messgroesse cAdaPulbw::pos_rea" TAB_VERB 3 0 "Keine Reaktion erkannt" 1 "ND_TSF/PFPULSPOS erkannt" 2 "ND_TSF/PFPULSZWPOS erkannt" DEFAULT_VALUE "" /end COMPU_VTAB
/begin COMPU_VTAB Conv.cAdaPulbw._.rea_amplitude_S5_S3 "Umrechnung fuer Messgroesse cAdaPulbw::rea_amplitude" TAB_VERB 2 0 "Keine Reaktion erkannt" 1 "ND_TSF/PFPULSAMP erkannt" DEFAULT_VALUE "" /end COMPU_VTAB
/begin COMPU_VTAB Conv.cAdaPulbw._.testresultat_S5_S3 "Umrechnung fuer Messgroesse cAdaPulbw::testresultat" TAB_VERB 5 0 "Keine Reaktion" 1 "Reaktion zu klein" 2 "Reaktion erwartet" 3 "Reaktion zu gross" 4 "Reaktion viel zu gross" DEFAULT_VALUE "" /end COMPU_VTAB
/begin COMPU_VTAB Conv.cAdaPulbw._.z_n_verlauf_S5_S3 "Umrechnung fuer Messgroesse cAdaPulbw::z_n_verlauf" TAB_VERB 6 0 "Keine Drehzahlverlaufspruefg aktiv" 1 "Pruefe minimalen Wert von n_guete" 2 "Pruefe maximalen Wert/Gradient von n_guete" 3 "Pruefe positiven Ausschlag auf n_guete" 4 "Bewertg. weil Puls anhand des Drehzahlverlaufs erkannt" 5 "Abbruch der Drehzahlverlaufspruefung" DEFAULT_VALUE "" /end COMPU_VTAB
/begin COMPU_VTAB Conv.cAdaPulbw._.zustand_S5_S3 "Umrechnung fuer Messgroesse cAdaPulbw::zustand" TAB_VERB 7 0 "Kein Beobachtungsablauf aktiv" 1 "Es wird die Reaktion bestimmt" 2 "Es wird bewertet" 3 "Die Bewertung ist abgeschlossen" 4 "Das Kriterium ND_ABBR ist nicht erfuellt" 5 "Es hat waehrend dem Puls eine Schaltung stattgefunden" 6 "Es ist ein Fehler aufgetreten" DEFAULT_VALUE "" /end COMPU_VTAB
/begin COMPU_VTAB Conv.cAdaPulbwFenster._.f_aktiv_S5_S3 "Umrechnung fuer Messgroesse cAdaPulbwFenster::f_aktiv" TAB_VERB 2 0 "FALSE" 1 "TRUE" DEFAULT_VALUE "" /end COMPU_VTAB
/begin COMPU_VTAB Conv.cAdaPulbwFenster._.f_beenden_S5_S3 "Umrechnung fuer Messgroesse cAdaPulbwFenster::f_beenden" TAB_VERB 2 0 "FALSE" 1 "TRUE" DEFAULT_VALUE "" /end COMPU_VTAB
/begin COMPU_VTAB Conv.cAdaPulbwFenster._.f_starten_S5_S3 "Umrechnung fuer Messgroesse cAdaPulbwFenster::f_starten" TAB_VERB 2 0 "FALSE" 1 "TRUE" DEFAULT_VALUE "" /end COMPU_VTAB
/begin COMPU_VTAB Conv.cAdaPulhv._.hs_verzoegerung_S5_S3 "Umrechnung fuer Messgroesse cAdaPulhv::hs_verzoegerung" TAB_VERB 3 0 "HS_VERZOEGERUNG_NICHT_GEFORDERT" 1 "HS_VERZOEGERUNG_MEDIUM_PRIO" 2 "HS_VERZOEGERUNG_HIGH_PRIO" DEFAULT_VALUE "" /end COMPU_VTAB
/begin COMPU_VTAB Conv.cAdaPulhv._.zustand_S5_S3 "Umrechnung fuer Messgroesse cAdaPulhv::zustand" TAB_VERB 3 0 "KPAD_HSV_PASSIV" 1 "KPAD_HSV_NICHT_AKTIV" 2 "KPAD_HSV_TIMER_AKTIV" DEFAULT_VALUE "" /end COMPU_VTAB
/begin COMPU_VTAB Conv.cAdaPulKr._.aktive_pulspruefung_S5_S3 "Umrechnung fuer Messgroesse cAdaPulKr::aktive_pulspruefung" TAB_VERB 3 0 "ADAPULS_AKTIV_KEIN_PULS" 1 "ADAPULS_AKTIV_STADA" 2 "ADAPULS_AKTIV_STD_PULSADA" DEFAULT_VALUE "" /end COMPU_VTAB
/begin COMPU_VTAB Conv.cAdaPulpf._.fenster_nach_sf_S5_S3 "Umrechnung fuer Messgroesse cAdaPulpf::fenster_nach_sf" TAB_VERB 2 0 "Abfrage auf ND_ADABBR erlaubt" 1 "Abfrage auf ND_ADABBR ist verboten" DEFAULT_VALUE "" /end COMPU_VTAB
/begin COMPU_VTAB Conv.cAdaPulpf._.zustand_S5_S3 "Umrechnung fuer Messgroesse cAdaPulpf::zustand" TAB_VERB 10 0 "KPAD_PF_KEINE_PRUEFUNG" 1 "KPAD_PF_WARTEN_AUF_SF" 2 "KPAD_PF_SF_AKTIV" 3 "KPAD_PF_FD_AKTIV" 4 "KPAD_PF_FD_PULS_AKTIV" 5 "KPAD_PF_UEBERWACHUNG_AKTIV" 6 "KPAD_PF_ENDE" 7 "KPAD_PF_ND_ABBR_NICHT_ERFUELLT" 8 "KPAD_PF_ABBRUCH_WG_SCHALTUNG" 9 "KPAD_PF_FEHLER_BEI_PRUEFUNG" DEFAULT_VALUE "" /end COMPU_VTAB
/begin COMPU_VTAB Conv.cAdaPulsf._.zustand_S5_S3 "Umrechnung fuer Messgroesse cAdaPulsf::zustand" TAB_VERB 9 0 "KPAD_TSF_KEINE_PRUEFUNG" 1 "KPAD_TSF_WARTEN_AUF_SF" 2 "KPAD_TSF_SF_AKTIV" 3 "KPAD_TSF_FD_AKTIV" 4 "KPAD_TSF_UEBERWACHUNG_AKTIV" 5 "KPAD_TSF_ENDE" 6 "KPAD_TSF_ND_ABBR_NICHT_ERFUELLT" 7 "KPAD_TSF_ABBRUCH_WG_SCHALTUNG" 8 "KPAD_TSF_FEHLER_BEI_PRUEFUNG" DEFAULT_VALUE "" /end COMPU_VTAB
/begin COMPU_VTAB Conv.cAdaPulzs._.anz_kup_puls_S5_S3 "Umrechnung fuer Messgroesse cAdaPulzs::anz_kup_puls" TAB_VERB 7 0 "KEINE_KUPPLUNG" 1 "K_A" 2 "K_B" 3 "K_C" 4 "K_D" 5 "K_E" 6 "K_K0" DEFAULT_VALUE "" /end COMPU_VTAB
/begin COMPU_VTAB Conv.cAdaPulzs._.anz_prueftyp_S5_S3 "Umrechnung fuer Messgroesse cAdaPulzs::anz_prueftyp" TAB_VERB 3 0 "KPAD_KEINE_PRUEFUNG_AKTIV" 1 "KPAD_SF_PRUEFUNG_AKTIV" 2 "KPAD_PF_PRUEFUNG_AKTIV" DEFAULT_VALUE "" /end COMPU_VTAB
/begin COMPU_VTAB Conv.cAdaPulzs._.anz_pulsid_S5_S3 "Umrechnung fuer Messgroesse cAdaPulzs::anz_pulsid" TAB_VERB 5 0 "KPAD_KEIN_PULS" 1 "KPAD_PULSID_1" 2 "KPAD_PULSID_2" 3 "KPAD_PULSID_3" 4 "KPAD_PULSID_4" DEFAULT_VALUE "" /end COMPU_VTAB
/begin COMPU_VTAB Conv.cAdaPulzs._.druck_statisch_S5_S3 "Umrechnung fuer Messgroesse cAdaPulzs::druck_statisch" TAB_VERB 2 0 "FALSE" 1 "TRUE" DEFAULT_VALUE "" /end COMPU_VTAB
/begin COMPU_VTAB Conv.cAdaPulzs._.f_in_gang_fertig_S5_S3 "Umrechnung fuer Messgroesse cAdaPulzs::f_in_gang_fertig" TAB_VERB 2 0 "FALSE" 1 "TRUE" DEFAULT_VALUE "" /end COMPU_VTAB
/begin COMPU_VTAB Conv.cAdaPulzs._.f_ndabbr_verletzt_S5_S3 "Umrechnung fuer Messgroesse cAdaPulzs::f_ndabbr_verletzt" TAB_VERB 2 0 "FALSE" 1 "TRUE" DEFAULT_VALUE "" /end COMPU_VTAB
/begin COMPU_VTAB Conv.cAdaPulzs._.f_nmotsoll_em_S5_S3 "Umrechnung fuer Messgroesse cAdaPulzs::f_nmotsoll_em" TAB_VERB 2 0 "FALSE" 1 "TRUE" DEFAULT_VALUE "" /end COMPU_VTAB
/begin COMPU_VTAB Conv.cAdaPulzs._.f_schubabschaltung_aktiv_start_S5_S3 "Umrechnung fuer Messgroesse cAdaPulzs::f_schubabschaltung_aktiv_start" TAB_VERB 2 0 "FALSE" 1 "TRUE" DEFAULT_VALUE "" /end COMPU_VTAB
/begin COMPU_VTAB Conv.cAdaPulzs._.f_startpruefung_aktiv_S5_S3 "Umrechnung fuer Messgroesse cAdaPulzs::f_startpruefung_aktiv" TAB_VERB 2 0 "FALSE" 1 "TRUE" DEFAULT_VALUE "" /end COMPU_VTAB
/begin COMPU_VTAB Conv.cAdaPulzs._.f_startpuls_nguete_S5_S3 "Umrechnung fuer Messgroesse cAdaPulzs::f_startpuls_nguete" TAB_VERB 2 0 "FALSE" 1 "TRUE" DEFAULT_VALUE "" /end COMPU_VTAB
/begin COMPU_VTAB Conv.cAdaPulzs._.kup_puls_alt_S5_S3 "Umrechnung fuer Messgroesse cAdaPulzs::kup_puls_alt" TAB_VERB 7 0 "KEINE_KUPPLUNG" 1 "K_A" 2 "K_B" 3 "K_C" 4 "K_D" 5 "K_E" 6 "K_K0" DEFAULT_VALUE "" /end COMPU_VTAB
/begin COMPU_VTAB Conv.cAdaPulzs._.kup_puls_neu_S5_S3 "Umrechnung fuer Messgroesse cAdaPulzs::kup_puls_neu" TAB_VERB 7 0 "KEINE_KUPPLUNG" 1 "K_A" 2 "K_B" 3 "K_C" 4 "K_D" 5 "K_E" 6 "K_K0" DEFAULT_VALUE "" /end COMPU_VTAB
/begin COMPU_VTAB Conv.cAdaPulzs._.kup_puls_S5_S3 "Umrechnung fuer Messgroesse cAdaPulzs::kup_puls" TAB_VERB 7 0 "KEINE_KUPPLUNG" 1 "K_A" 2 "K_B" 3 "K_C" 4 "K_D" 5 "K_E" 6 "K_K0" DEFAULT_VALUE "" /end COMPU_VTAB
/begin COMPU_VTAB Conv.cAdaPulzs._.prueftyp_alt_S5_S3 "Umrechnung fuer Messgroesse cAdaPulzs::prueftyp_alt" TAB_VERB 3 0 "KPAD_KEINE_PRUEFUNG_AKTIV" 1 "KPAD_SF_PRUEFUNG_AKTIV" 2 "KPAD_PF_PRUEFUNG_AKTIV" DEFAULT_VALUE "" /end COMPU_VTAB
/begin COMPU_VTAB Conv.cAdaPulzs._.prueftyp_S5_S3 "Umrechnung fuer Messgroesse cAdaPulzs::prueftyp" TAB_VERB 3 0 "KPAD_KEINE_PRUEFUNG_AKTIV" 1 "KPAD_SF_PRUEFUNG_AKTIV" 2 "KPAD_PF_PRUEFUNG_AKTIV" DEFAULT_VALUE "" /end COMPU_VTAB
/begin COMPU_VTAB Conv.cAdaPulzs._.pruefung_kup_fertig_S5_S3 "Umrechnung fuer Messgroesse cAdaPulzs::pruefung_kup_fertig" TAB_VERB 2 0 "FALSE" 1 "TRUE" DEFAULT_VALUE "" /end COMPU_VTAB
/begin COMPU_VTAB Conv.cAdaPulzs._.pulsid_S5_S3 "Umrechnung fuer Messgroesse cAdaPulzs::pulsid" TAB_VERB 5 0 "KPAD_KEIN_PULS" 1 "KPAD_PULSID_1" 2 "KPAD_PULSID_2" 3 "KPAD_PULSID_3" 4 "KPAD_PULSID_4" DEFAULT_VALUE "" /end COMPU_VTAB
/begin COMPU_VTAB Conv.cAdaPulzs._.pulszyklus_beenden_S5_S3 "Umrechnung fuer Messgroesse cAdaPulzs::pulszyklus_beenden" TAB_VERB 4 0 "KPAD_ZYKLUS_NICHT_BEENDEN" 1 "KPAD_ZYKL_BEENDEN_WG_PULS_4" 2 "KPAD_ZYKL_BEENDEN_WG_PULSGRENZ" 3 "KPAD_ZYKL_BEENDEN_WG_ZWSP" DEFAULT_VALUE "" /end COMPU_VTAB
/begin COMPU_VTAB Conv.cAdaPulzs._.schnellfuellung_aktiv_S5_S3 "Umrechnung fuer Messgroesse cAdaPulzs::schnellfuellung_aktiv" TAB_VERB 2 0 "FALSE" 1 "TRUE" DEFAULT_VALUE "" /end COMPU_VTAB
/begin COMPU_VTAB Conv.cAdaPulzs._.startinfo_index_S5_S3 "Umrechnung fuer Messgroesse cAdaPulzs::startinfo_index" TAB_VERB 7 0 "KPAD_PRIO_INDEX_KEINE" 1 "KPAD_SEK_TSF" 2 "KPAD_SEK_PF" 3 "KPAD_PRIO_INDEX_1_TSF" 4 "KPAD_PRIO_INDEX_1_PF" 5 "KPAD_PRIO_INDEX_2_TSF" 6 "KPAD_PRIO_INDEX_2_PF" DEFAULT_VALUE "" /end COMPU_VTAB
/begin COMPU_VTAB Conv.cAdaPulzs._.zustand_S5_S3 "Umrechnung fuer Messgroesse cAdaPulzs::zustand" TAB_VERB 12 0 "KPAD_KEINE_AGL_BERECHNUNG" 1 "KPAD_WARTEN_AGL_GUELTIG" 2 "KPAD_SPERRZEITEN_AKTIV" 3 "KPAD_PASSIV" 4 "KPAD_START" 5 "KPAD_WARTEN" 6 "KPAD_SCHNELLFUELLUNG" 7 "KPAD_FUELLDRUCK" 8 "KPAD_PULSENDE_BEWERTUNG_AKTIV" 9 "KPAD_ND_ABBR_NICHT_ERFUELLT" 10 "KPAD_ABBRUCH_WG_SCHALTUNG" 11 "KPAD_FEHLER_BEI_PRUEFUNG" DEFAULT_VALUE "" /end COMPU_VTAB
/begin COMPU_VTAB Conv.cAdaUrlufterkPuls._.istgang_start_S5_S3 "Umrechnung fuer Messgroesse cAdaUrlufterkPuls::istgang_start" TAB_VERB 10 -1 "GR1" 0 "KEIN_GANG" 1 "G1" 2 "G2" 3 "G3" 4 "G4" 5 "G5" 6 "G6" 7 "G7" 8 "G8" DEFAULT_VALUE "" /end COMPU_VTAB
/begin COMPU_VTAB Conv.cAdaUrlufterkPuls._.kfl_ist_start_S5_S3 "Umrechnung fuer Messgroesse cAdaUrlufterkPuls::kfl_ist_start" TAB_VERB 3 0 "KEIN_KFL" 1 "KFL_VORWAERTS" 2 "KFL_RUECKWAERTS" DEFAULT_VALUE "" /end COMPU_VTAB
/begin COMPU_VTAB Conv.cAdaUrlufterkPuls._.kup_S5_S3 "Umrechnung fuer Messgroesse cAdaUrlufterkPuls::kup" TAB_VERB 7 0 "KEINE_KUPPLUNG" 1 "K_A" 2 "K_B" 3 "K_C" 4 "K_D" 5 "K_E" 6 "K_K0" DEFAULT_VALUE "" /end COMPU_VTAB
/begin COMPU_VTAB Conv.cAdaUrlufterkPuls._.zustand_S5_S3 "Umrechnung fuer Messgroesse cAdaUrlufterkPuls::zustand" TAB_VERB 2 0 "Z_PULS_URL_PASSIV" 1 "Z_PULS_URL_BEOBACHTUNG" DEFAULT_VALUE "" /end COMPU_VTAB
/begin COMPU_VTAB Conv.cAdaUrlufterkPulsAnz._.f_loeschen_puls_url_S5_S3 "Umrechnung fuer Messgroesse cAdaUrlufterkPulsAnz::f_loeschen_puls_url" TAB_VERB 2 0 "FALSE" 1 "TRUE" DEFAULT_VALUE "" /end COMPU_VTAB
/begin COMPU_VTAB Conv.cAdaUrlufterkPulsAnz._.kup_puls_url_S5_S3 "Umrechnung fuer Messgroesse cAdaUrlufterkPulsAnz::kup_puls_url" TAB_VERB 7 0 "KEINE_KUPPLUNG" 1 "K_A" 2 "K_B" 3 "K_C" 4 "K_D" 5 "K_E" 6 "K_K0" DEFAULT_VALUE "" /end COMPU_VTAB
/begin COMPU_VTAB Conv.cAdaUrlufterkSchaltung._.kup_S5_S3 "Umrechnung fuer Messgroesse cAdaUrlufterkSchaltung::kup" TAB_VERB 6 0 "KEINE" 1 "K_A" 2 "K_B" 3 "K_C" 4 "K_D" 5 "K_E" DEFAULT_VALUE "" /end COMPU_VTAB
/begin COMPU_VTAB Conv.cAdaUrlufterkSchaltung._.zustand_S5_S3 "Umrechnung fuer Messgroesse cAdaUrlufterkSchaltung::zustand" TAB_VERB 2 0 "Z_SCHALT_URL_PASSIV" 1 "Z_SCHALT_URL_BEOBACHTUNG" DEFAULT_VALUE "" /end COMPU_VTAB
/begin COMPU_VTAB Conv.cAdaUrlufterkSchaltungAnz._.f_loeschen_schalung_url_S5_S3 "Umrechnung fuer Messgroesse cAdaUrlufterkSchaltungAnz::f_loeschen_schalung_url" TAB_VERB 2 0 "FALSE" 1 "TRUE" DEFAULT_VALUE "" /end COMPU_VTAB
/begin COMPU_VTAB Conv.cAdaUrlufterkSchaltungAnz._.kup_schaltung_url_S5_S3 "Umrechnung fuer Messgroesse cAdaUrlufterkSchaltungAnz::kup_schaltung_url" TAB_VERB 6 0 "KEINE" 1 "K_A" 2 "K_B" 3 "K_C" 4 "K_D" 5 "K_E" DEFAULT_VALUE "" /end COMPU_VTAB
/begin COMPU_VTAB Conv.cAdaUrlufterkSchaltungSignal._.f_grad_inti_S5_S3 "Umrechnung fuer Messgroesse cAdaUrlufterkSchaltungSignal::f_grad_inti" TAB_VERB 2 0 "Init notwendig" 1 "Init erfolgt" DEFAULT_VALUE "" /end COMPU_VTAB
/begin COMPU_VTAB Conv.cAdaUrlufterkSchaltungSignal._.f_pt1_inti_S5_S3 "Umrechnung fuer Messgroesse cAdaUrlufterkSchaltungSignal::f_pt1_inti" TAB_VERB 2 0 "Init notwendig" 1 "Init erfolgt" DEFAULT_VALUE "" /end COMPU_VTAB
/begin COMPU_VTAB Conv.cAdaUrlufterkSchaltungSignal._.f_signal_ungueltig_S5_S3 "Umrechnung fuer Messgroesse cAdaUrlufterkSchaltungSignal::f_signal_ungueltig" TAB_VERB 2 0 "FALSE" 1 "TRUE" DEFAULT_VALUE "" /end COMPU_VTAB
/begin COMPU_VTAB Conv.cAdaUrlufterkSchaltungSignal._.signal_quelle_alt_S5_S3 "Umrechnung fuer Messgroesse cAdaUrlufterkSchaltungSignal::signal_quelle_alt" TAB_VERB 2 0 "SWI_NTNAB_URL_NT" 1 "SWI_NTNAB_URL_NAB" DEFAULT_VALUE "" /end COMPU_VTAB
/begin COMPU_VTAB Conv.cAdaUrlufterkSchaltungSignal._.signal_quelle_S5_S3 "Umrechnung fuer Messgroesse cAdaUrlufterkSchaltungSignal::signal_quelle" TAB_VERB 2 0 "SWI_NTNAB_URL_NT" 1 "SWI_NTNAB_URL_NAB" DEFAULT_VALUE "" /end COMPU_VTAB
/begin COMPU_VTAB Conv.cAzsIstGang._.f_saf_abbruch_invers_S5_S3 "Umrechnung fuer Messgroesse cAzsIstGang::f_saf_abbruch_invers" TAB_VERB 2 0 "FALSE" 1 "TRUE" DEFAULT_VALUE "" /end COMPU_VTAB
/begin COMPU_VTAB Conv.cAzsIstGang._.f_saf_folgeschaltung_S5_S3 "Umrechnung fuer Messgroesse cAzsIstGang::f_saf_folgeschaltung" TAB_VERB 2 0 "FALSE" 1 "TRUE" DEFAULT_VALUE "" /end COMPU_VTAB
/begin COMPU_VTAB Conv.cAzsIstGang._.f_saf_freigegeben_S5_S3 "Umrechnung fuer Messgroesse cAzsIstGang::f_saf_freigegeben" TAB_VERB 2 0 "FALSE" 1 "TRUE" DEFAULT_VALUE "" /end COMPU_VTAB
/begin COMPU_VTAB Conv.cAzsIstGang._.istgang_S5_S3 "Umrechnung fuer Messgroesse cAzsIstGang::istgang" TAB_VERB 10 -1 "GR1" 0 "KEIN_GANG" 1 "G1" 2 "G2" 3 "G3" 4 "G4" 5 "G5" 6 "G6" 7 "G7" 8 "G8" DEFAULT_VALUE "" /end COMPU_VTAB
/begin COMPU_VTAB Conv.cAzsKflIst._.kfl_ist_S5_S3 "Umrechnung fuer Messgroesse cAzsKflIst::kfl_ist" TAB_VERB 3 0 "KEIN_KFL" 1 "KFL_VORWAERTS" 2 "KFL_RUECKWAERTS" DEFAULT_VALUE "" /end COMPU_VTAB
/begin COMPU_VTAB Conv.cAzsKflSoll._.kfl_soll_S5_S3 "Umrechnung fuer Messgroesse cAzsKflSoll::kfl_soll" TAB_VERB 3 0 "KEIN_KFL" 1 "KFL_VORWAERTS" 2 "KFL_RUECKWAERTS" DEFAULT_VALUE "" /end COMPU_VTAB
/begin COMPU_VTAB Conv.cAzsKflZiel._.kfl_ziel_S5_S3 "Umrechnung fuer Messgroesse cAzsKflZiel::kfl_ziel" TAB_VERB 3 0 "KEIN_KFL" 1 "KFL_VORWAERTS" 2 "KFL_RUECKWAERTS" DEFAULT_VALUE "" /end COMPU_VTAB
/begin COMPU_VTAB Conv.cAzsKorgl._.f_abbruch_schaltung_durch_ga_S5_S3 "Umrechnung fuer Messgroesse cAzsKorgl::f_abbruch_schaltung_durch_ga" TAB_VERB 2 0 "FALSE" 1 "TRUE" DEFAULT_VALUE "" /end COMPU_VTAB
/begin COMPU_VTAB Conv.cAzsKorgl._.f_kfl_direkt_S5_S3 "Umrechnung fuer Messgroesse cAzsKorgl::f_kfl_direkt" TAB_VERB 2 0 "FALSE" 1 "TRUE" DEFAULT_VALUE "" /end COMPU_VTAB
/begin COMPU_METHOD Conv.cAdaGlast._.adaps_status_S5_S3 "Umrechnung fuer Messgroesse cAdaGlast::adaps_status" TAB_VERB "%4.0" "" COMPU_TAB_REF Conv.cAdaGlast._.adaps_status_S5_S3 /end COMPU_METHOD
/begin COMPU_METHOD Conv.cAdaGlast._.bew_kennfeld_lesen_S5_S3 "Umrechnung fuer Messgroesse cAdaGlast::bew_kennfeld_lesen" TAB_VERB "%4.0" "" COMPU_TAB_REF Conv.cAdaGlast._.bew_kennfeld_lesen_S5_S3 /end COMPU_METHOD
/begin COMPU_METHOD Conv.cAdaGlast._.bew_kennfeld_S5_S3 "Umrechnung fuer Messgroesse cAdaGlast::bew_kennfeld" TAB_VERB "%4.0" "" COMPU_TAB_REF Conv.cAdaGlast._.bew_kennfeld_S5_S3 /end COMPU_METHOD
/begin COMPU_METHOD Conv.cAdaGlast._.bew_kup_S5_S3 "Umrechnung fuer Messgroesse cAdaGlast::bew_kup" TAB_VERB "%4.0" "" COMPU_TAB_REF Conv.cAdaGlast._.bew_kup_S5_S3 /end COMPU_METHOD
/begin COMPU_METHOD Conv.cAdaGlast._.bew_schalttyp_lesen_S5_S3 "Umrechnung fuer Messgroesse cAdaGlast::bew_schalttyp_lesen" TAB_VERB "%4.0" "" COMPU_TAB_REF Conv.cAdaGlast._.bew_schalttyp_lesen_S5_S3 /end COMPU_METHOD
/begin COMPU_METHOD Conv.cAdaGlast._.bew_schalttyp_S5_S3 "Umrechnung fuer Messgroesse cAdaGlast::bew_schalttyp" TAB_VERB "%4.0" "" COMPU_TAB_REF Conv.cAdaGlast._.bew_schalttyp_S5_S3 /end COMPU_METHOD
/begin COMPU_METHOD Conv.cAdaGlast._.gls_ada_state_S5_S3 "Umrechnung fuer Messgroesse cAdaGlast::gls_ada_state" TAB_VERB "%4.0" "" COMPU_TAB_REF Conv.cAdaGlast._.gls_ada_state_S5_S3 /end COMPU_METHOD
/begin COMPU_METHOD Conv.cAdaGlast._.gls_flag_abbruch_wg_adapfn_S5_S3 "Umrechnung fuer Messgroesse cAdaGlast::gls_flag_abbruch_wg_adapfn" TAB_VERB "%4.0" "" COMPU_TAB_REF Conv.cAdaGlast._.gls_flag_abbruch_wg_adapfn_S5_S3 /end COMPU_METHOD
/begin COMPU_METHOD Conv.cAdaGlast._.gls_trimm_gang_S5_S3 "Umrechnung fuer Messgroesse cAdaGlast::gls_trimm_gang" TAB_VERB "%4.0" "" COMPU_TAB_REF Conv.cAdaGlast._.gls_trimm_gang_S5_S3 /end COMPU_METHOD
/begin COMPU_METHOD Conv.cAdaGlast._.gls_trimm_spont_beeinflussung_S5_S3 "Umrechnung fuer Messgroesse cAdaGlast::gls_trimm_spont_beeinflussung" TAB_VERB "%4.0" "" COMPU_TAB_REF Conv.cAdaGlast._.gls_trimm_spont_beeinflussung_S5_S3 /end COMPU_METHOD
/begin COMPU_METHOD Conv.cAdaGlast._.gls_trimm_verbot_versch_rs_S5_S3 "Umrechnung fuer Messgroesse cAdaGlast::gls_trimm_verbot_versch_rs" TAB_VERB "%4.0" "" COMPU_TAB_REF Conv.cAdaGlast._.gls_trimm_verbot_versch_rs_S5_S3 /end COMPU_METHOD
/begin COMPU_METHOD Conv.cAdaGlast._.status_ausgabe_verzoegern_S5_S3 "Umrechnung fuer Messgroesse cAdaGlast::status_ausgabe_verzoegern" TAB_VERB "%4.0" "" COMPU_TAB_REF Conv.cAdaGlast._.status_ausgabe_verzoegern_S5_S3 /end COMPU_METHOD
/begin COMPU_METHOD Conv.cAdaGloku._.puls_lock_S5_S3 "Umrechnung fuer Messgroesse cAdaGloku::puls_lock" TAB_VERB "%4.0" "" COMPU_TAB_REF Conv.cAdaGloku._.puls_lock_S5_S3 /end COMPU_METHOD
/begin COMPU_METHOD Conv.cAdaGlosc._.ada_iae_info_S5_S3 "Umrechnung fuer Messgroesse cAdaGlosc::ada_iae_info" TAB_VERB "%4.0" "" COMPU_TAB_REF Conv.cAdaGlosc._.ada_iae_info_S5_S3 /end COMPU_METHOD
/begin COMPU_METHOD Conv.cAdaGlosc._.ada_istgang_S5_S3 "Umrechnung fuer Messgroesse cAdaGlosc::ada_istgang" TAB_VERB "%4.0" "" COMPU_TAB_REF Conv.cAdaGlosc._.ada_istgang_S5_S3 /end COMPU_METHOD
/begin COMPU_METHOD Conv.cAdaGlosc._.ada_k_zu_S5_S3 "Umrechnung fuer Messgroesse cAdaGlosc::ada_k_zu" TAB_VERB "%4.0" "" COMPU_TAB_REF Conv.cAdaGlosc._.ada_k_zu_S5_S3 /end COMPU_METHOD
/begin COMPU_METHOD Conv.cAdaGlosc._.ada_schaltart_S5_S3 "Umrechnung fuer Messgroesse cAdaGlosc::ada_schaltart" TAB_VERB "%4.0" "" COMPU_TAB_REF Conv.cAdaGlosc._.ada_schaltart_S5_S3 /end COMPU_METHOD
/begin COMPU_METHOD Conv.cAdaGlosc._.ada_schaltung_kzu_S5_S3 "Umrechnung fuer Messgroesse cAdaGlosc::ada_schaltung_kzu" TAB_VERB "%4.0" "" COMPU_TAB_REF Conv.cAdaGlosc._.ada_schaltung_kzu_S5_S3 /end COMPU_METHOD
/begin COMPU_METHOD Conv.cAdaGlosc._.ada_schaltungs_index_S5_S3 "Umrechnung fuer Messgroesse cAdaGlosc::ada_schaltungs_index" TAB_VERB "%4.0" "" COMPU_TAB_REF Conv.cAdaGlosc._.ada_schaltungs_index_S5_S3 /end COMPU_METHOD
/begin COMPU_METHOD Conv.cAdaGlosc._.ada_synchron_S5_S3 "Umrechnung fuer Messgroesse cAdaGlosc::ada_synchron" TAB_VERB "%4.0" "" COMPU_TAB_REF Conv.cAdaGlosc._.ada_synchron_S5_S3 /end COMPU_METHOD
/begin COMPU_METHOD Conv.cAdaGlosc._.ada_zielgang_S5_S3 "Umrechnung fuer Messgroesse cAdaGlosc::ada_zielgang" TAB_VERB "%4.0" "" COMPU_TAB_REF Conv.cAdaGlosc._.ada_zielgang_S5_S3 /end COMPU_METHOD
/begin COMPU_METHOD Conv.cAdaGlosc._.bew_verbot_laengs_beschl_S5_S3 "Umrechnung fuer Messgroesse cAdaGlosc::bew_verbot_laengs_beschl" TAB_VERB "%4.0" "" COMPU_TAB_REF Conv.cAdaGlosc._.bew_verbot_laengs_beschl_S5_S3 /end COMPU_METHOD
/begin COMPU_METHOD Conv.cAdaGlosc._.f_ada_bew_verboten_S5_S3 "Umrechnung fuer Messgroesse cAdaGlosc::f_ada_bew_verboten" TAB_VERB "%4.0" "" COMPU_TAB_REF Conv.cAdaGlosc._.f_ada_bew_verboten_S5_S3 /end COMPU_METHOD
/begin COMPU_METHOD Conv.cAdaGlosc._.f_aenderung_adaram_daten_S5_S3 "Umrechnung fuer Messgroesse cAdaGlosc::f_aenderung_adaram_daten" TAB_VERB "%4.0" "" COMPU_TAB_REF Conv.cAdaGlosc._.f_aenderung_adaram_daten_S5_S3 /end COMPU_METHOD
/begin COMPU_METHOD Conv.cAdaGlosc._.f_letzte_schaltung_rs_S5_S3 "Umrechnung fuer Messgroesse cAdaGlosc::f_letzte_schaltung_rs" TAB_VERB "%4.0" "" COMPU_TAB_REF Conv.cAdaGlosc._.f_letzte_schaltung_rs_S5_S3 /end COMPU_METHOD
/begin COMPU_METHOD Conv.cAdaGlosc._.flag_alaengs_adaoff_S5_S3 "Umrechnung fuer Messgroesse cAdaGlosc::flag_alaengs_adaoff" TAB_VERB "%4.0" "" COMPU_TAB_REF Conv.cAdaGlosc._.flag_alaengs_adaoff_S5_S3 /end COMPU_METHOD
/begin COMPU_METHOD Conv.cAdaGlosc._.flag_allada_del_S5_S3 "Umrechnung fuer Messgroesse cAdaGlosc::flag_allada_del" TAB_VERB "%4.0" "" COMPU_TAB_REF Conv.cAdaGlosc._.flag_allada_del_S5_S3 /end COMPU_METHOD
/begin COMPU_METHOD Conv.cAdaGlosc._.init_mit_azg_S5_S3 "Umrechnung fuer Messgroesse cAdaGlosc::init_mit_azg" TAB_VERB "%4.0" "" COMPU_TAB_REF Conv.cAdaGlosc._.init_mit_azg_S5_S3 /end COMPU_METHOD
/begin COMPU_METHOD Conv.cAdaGlosc._.z_ada_schaltung_S5_S3 "Umrechnung fuer Messgroesse cAdaGlosc::z_ada_schaltung" TAB_VERB "%4.0" "" COMPU_TAB_REF Conv.cAdaGlosc._.z_ada_schaltung_S5_S3 /end COMPU_METHOD
/begin COMPU_METHOD Conv.cAdaIaeap._.abbruch_bit_ada_iae_S5_S3 "Umrechnung fuer Messgroesse cAdaIaeap::abbruch_bit_ada_iae" TAB_VERB "%4.0" "" COMPU_TAB_REF Conv.cAdaIaeap._.abbruch_bit_ada_iae_S5_S3 /end COMPU_METHOD
/begin COMPU_METHOD Conv.cAdaIaeap._.f_abbruch_global_iae_S5_S3 "Umrechnung fuer Messgroesse cAdaIaeap::f_abbruch_global_iae" TAB_VERB "%4.0" "" COMPU_TAB_REF Conv.cAdaIaeap._.f_abbruch_global_iae_S5_S3 /end COMPU_METHOD
/begin COMPU_METHOD Conv.cAdaIaeap._.f_ada_iae_ein_S5_S3 "Umrechnung fuer Messgroesse cAdaIaeap::f_ada_iae_ein" TAB_VERB "%4.0" "" COMPU_TAB_REF Conv.cAdaIaeap._.f_ada_iae_ein_S5_S3 /end COMPU_METHOD
/begin COMPU_METHOD Conv.cAdaIaeap._.f_angelegt_mmot_iae_S5_S3 "Umrechnung fuer Messgroesse cAdaIaeap::f_angelegt_mmot_iae" TAB_VERB "%4.0" "" COMPU_TAB_REF Conv.cAdaIaeap._.f_angelegt_mmot_iae_S5_S3 /end COMPU_METHOD
/begin COMPU_METHOD Conv.cAdaIaeap._.f_angelegt_nmot_iae_S5_S3 "Umrechnung fuer Messgroesse cAdaIaeap::f_angelegt_nmot_iae" TAB_VERB "%4.0" "" COMPU_TAB_REF Conv.cAdaIaeap._.f_angelegt_nmot_iae_S5_S3 /end COMPU_METHOD
/begin COMPU_METHOD Conv.cAdaIaeap._.f_bew_verboten_iae_S5_S3 "Umrechnung fuer Messgroesse cAdaIaeap::f_bew_verboten_iae" TAB_VERB "%4.0" "" COMPU_TAB_REF Conv.cAdaIaeap._.f_bew_verboten_iae_S5_S3 /end COMPU_METHOD
/begin COMPU_METHOD Conv.cAdaIaeap._.f_gmmot_begrenzungs_rampe_S5_S3 "Umrechnung fuer Messgroesse cAdaIaeap::f_gmmot_begrenzungs_rampe" TAB_VERB "%4.0" "" COMPU_TAB_REF Conv.cAdaIaeap._.f_gmmot_begrenzungs_rampe_S5_S3 /end COMPU_METHOD
/begin COMPU_METHOD Conv.cAdaIaeap._.f_rampinit_iae_S5_S3 "Umrechnung fuer Messgroesse cAdaIaeap::f_rampinit_iae" TAB_VERB "%4.0" "" COMPU_TAB_REF Conv.cAdaIaeap._.f_rampinit_iae_S5_S3 /end COMPU_METHOD
/begin COMPU_METHOD Conv.cAdaIaeap._.req_n_mot_llsoll_iae_S5_S3 "Umrechnung fuer Messgroesse cAdaIaeap::req_n_mot_llsoll_iae" TAB_VERB "%4.0" "" COMPU_TAB_REF Conv.cAdaIaeap._.req_n_mot_llsoll_iae_S5_S3 /end COMPU_METHOD
/begin COMPU_METHOD Conv.cAdaIaeap._.z_apada_iae_S5_S3 "Umrechnung fuer Messgroesse cAdaIaeap::z_apada_iae" TAB_VERB "%4.0" "" COMPU_TAB_REF Conv.cAdaIaeap._.z_apada_iae_S5_S3 /end COMPU_METHOD
/begin COMPU_METHOD Conv.cAdaIaeuf._.f_ada_sperren_werteuebername_S5_S3 "Umrechnung fuer Messgroesse cAdaIaeuf::f_ada_sperren_werteuebername" TAB_VERB "%4.0" "" COMPU_TAB_REF Conv.cAdaIaeuf._.f_ada_sperren_werteuebername_S5_S3 /end COMPU_METHOD
/begin COMPU_METHOD Conv.cAdaIaeuf._.f_read_kf_gueltig_S5_S3 "Umrechnung fuer Messgroesse cAdaIaeuf::f_read_kf_gueltig" TAB_VERB "%4.0" "" COMPU_TAB_REF Conv.cAdaIaeuf._.f_read_kf_gueltig_S5_S3 /end COMPU_METHOD
/begin COMPU_METHOD Conv.cAdaPfusf._.adapfn_status_S5_S3 "Umrechnung fuer Messgroesse cAdaPfusf::adapfn_status" TAB_VERB "%4.0" "" COMPU_TAB_REF Conv.cAdaPfusf._.adapfn_status_S5_S3 /end COMPU_METHOD
/begin COMPU_METHOD Conv.cAdaPfusf._.adkl_pfad_S5_S3 "Umrechnung fuer Messgroesse cAdaPfusf::adkl_pfad" TAB_VERB "%4.0" "" COMPU_TAB_REF Conv.cAdaPfusf._.adkl_pfad_S5_S3 /end COMPU_METHOD
/begin COMPU_METHOD Conv.cAdaPfusf._.f_max_flare_erreicht_hs_pfad_S5_S3 "Umrechnung fuer Messgroesse cAdaPfusf::f_max_flare_erreicht_hs_pfad" TAB_VERB "%4.0" "" COMPU_TAB_REF Conv.cAdaPfusf._.f_max_flare_erreicht_hs_pfad_S5_S3 /end COMPU_METHOD
/begin COMPU_METHOD Conv.cAdaPfusf._.f_mt_krit_aktiv_pfad_S5_S3 "Umrechnung fuer Messgroesse cAdaPfusf::f_mt_krit_aktiv_pfad" TAB_VERB "%4.0" "" COMPU_TAB_REF Conv.cAdaPfusf._.f_mt_krit_aktiv_pfad_S5_S3 /end COMPU_METHOD
/begin COMPU_METHOD Conv.cAdaPfusf._.pm_gls_status_S5_S3 "Umrechnung fuer Messgroesse cAdaPfusf::pm_gls_status" TAB_VERB "%4.0" "" COMPU_TAB_REF Conv.cAdaPfusf._.pm_gls_status_S5_S3 /end COMPU_METHOD
/begin COMPU_METHOD Conv.cAdaPfusf._.schaltart_pfad_S5_S3 "Umrechnung fuer Messgroesse cAdaPfusf::schaltart_pfad" TAB_VERB "%4.0" "" COMPU_TAB_REF Conv.cAdaPfusf._.schaltart_pfad_S5_S3 /end COMPU_METHOD
/begin COMPU_METHOD Conv.cAdaPfusf._.schaltcode_pfad_S5_S3 "Umrechnung fuer Messgroesse cAdaPfusf::schaltcode_pfad" TAB_VERB "%4.0" "" COMPU_TAB_REF Conv.cAdaPfusf._.schaltcode_pfad_S5_S3 /end COMPU_METHOD
/begin COMPU_METHOD Conv.cAdaPstbw._.neg_rea_stada_S5_S3 "Umrechnung fuer Messgroesse cAdaPstbw::neg_rea_stada" TAB_VERB "%4.0" "" COMPU_TAB_REF Conv.cAdaPstbw._.neg_rea_stada_S5_S3 /end COMPU_METHOD
/begin COMPU_METHOD Conv.cAdaPstbw._.pos_rea_stada_S5_S3 "Umrechnung fuer Messgroesse cAdaPstbw::pos_rea_stada" TAB_VERB "%4.0" "" COMPU_TAB_REF Conv.cAdaPstbw._.pos_rea_stada_S5_S3 /end COMPU_METHOD
/begin COMPU_METHOD Conv.cAdaPstbw._.rea_amplitude_stada_S5_S3 "Umrechnung fuer Messgroesse cAdaPstbw::rea_amplitude_stada" TAB_VERB "%4.0" "" COMPU_TAB_REF Conv.cAdaPstbw._.rea_amplitude_stada_S5_S3 /end COMPU_METHOD
/begin COMPU_METHOD Conv.cAdaPstbw._.testresultat_stada_S5_S3 "Umrechnung fuer Messgroesse cAdaPstbw::testresultat_stada" TAB_VERB "%4.0" "" COMPU_TAB_REF Conv.cAdaPstbw._.testresultat_stada_S5_S3 /end COMPU_METHOD
/begin COMPU_METHOD Conv.cAdaPstbw._.zustand_stada_S5_S3 "Umrechnung fuer Messgroesse cAdaPstbw::zustand_stada" TAB_VERB "%4.0" "" COMPU_TAB_REF Conv.cAdaPstbw._.zustand_stada_S5_S3 /end COMPU_METHOD
/begin COMPU_METHOD Conv.cAdaPstbwFenster._.f_aktiv_stada_S5_S3 "Umrechnung fuer Messgroesse cAdaPstbwFenster::f_aktiv_stada" TAB_VERB "%4.0" "" COMPU_TAB_REF Conv.cAdaPstbwFenster._.f_aktiv_stada_S5_S3 /end COMPU_METHOD
/begin COMPU_METHOD Conv.cAdaPstbwFenster._.f_beenden_stada_S5_S3 "Umrechnung fuer Messgroesse cAdaPstbwFenster::f_beenden_stada" TAB_VERB "%4.0" "" COMPU_TAB_REF Conv.cAdaPstbwFenster._.f_beenden_stada_S5_S3 /end COMPU_METHOD
/begin COMPU_METHOD Conv.cAdaPstbwFenster._.f_starten_stada_S5_S3 "Umrechnung fuer Messgroesse cAdaPstbwFenster::f_starten_stada" TAB_VERB "%4.0" "" COMPU_TAB_REF Conv.cAdaPstbwFenster._.f_starten_stada_S5_S3 /end COMPU_METHOD
/begin COMPU_METHOD Conv.cAdaPstCondition._.preadaption_condition_stada_int_S5_S3 "Umrechnung fuer Messgroesse cAdaPstCondition::preadaption_condition_stada_int" TAB_VERB "%4.0" "" COMPU_TAB_REF Conv.cAdaPstCondition._.preadaption_condition_stada_int_S5_S3 /end COMPU_METHOD
/begin COMPU_METHOD Conv.cAdaPstCondition._.preadaption_condition_stada_S5_S3 "Umrechnung fuer Messgroesse cAdaPstCondition::preadaption_condition_stada" TAB_VERB "%4.0" "" COMPU_TAB_REF Conv.cAdaPstCondition._.preadaption_condition_stada_S5_S3 /end COMPU_METHOD
/begin COMPU_METHOD Conv.cAdaPstpf._.fenster_nach_sf_stada_S5_S3 "Umrechnung fuer Messgroesse cAdaPstpf::fenster_nach_sf_stada" TAB_VERB "%4.0" "" COMPU_TAB_REF Conv.cAdaPstpf._.fenster_nach_sf_stada_S5_S3 /end COMPU_METHOD
/begin COMPU_METHOD Conv.cAdaPstpf._.fenster_sf_stada_S5_S3 "Umrechnung fuer Messgroesse cAdaPstpf::fenster_sf_stada" TAB_VERB "%4.0" "" COMPU_TAB_REF Conv.cAdaPstpf._.fenster_sf_stada_S5_S3 /end COMPU_METHOD
/begin COMPU_METHOD Conv.cAdaPstpf._.zustand_stada_S5_S3 "Umrechnung fuer Messgroesse cAdaPstpf::zustand_stada" TAB_VERB "%4.0" "" COMPU_TAB_REF Conv.cAdaPstpf._.zustand_stada_S5_S3 /end COMPU_METHOD
/begin COMPU_METHOD Conv.cAdaPstsf._.zustand_stada_S5_S3 "Umrechnung fuer Messgroesse cAdaPstsf::zustand_stada" TAB_VERB "%4.0" "" COMPU_TAB_REF Conv.cAdaPstsf._.zustand_stada_S5_S3 /end COMPU_METHOD
/begin COMPU_METHOD Conv.cAdaPstState._.preadaption_state_stada_S5_S3 "Umrechnung fuer Messgroesse cAdaPstState::preadaption_state_stada" TAB_VERB "%4.0" "" COMPU_TAB_REF Conv.cAdaPstState._.preadaption_state_stada_S5_S3 /end COMPU_METHOD
/begin COMPU_METHOD Conv.cAdaPstUserinfo._.preadaption_userinfo_stada_S5_S3 "Umrechnung fuer Messgroesse cAdaPstUserinfo::preadaption_userinfo_stada" TAB_VERB "%4.0" "" COMPU_TAB_REF Conv.cAdaPstUserinfo._.preadaption_userinfo_stada_S5_S3 /end COMPU_METHOD
/begin COMPU_METHOD Conv.cAdaPstzs._.akt_ada_S5_S3 "Umrechnung fuer Messgroesse cAdaPstzs::akt_ada" TAB_VERB "%4.0" "" COMPU_TAB_REF Conv.cAdaPstzs._.akt_ada_S5_S3 /end COMPU_METHOD
/begin COMPU_METHOD Conv.cAdaPstzs._.anz_kup_puls_stada_S5_S3 "Umrechnung fuer Messgroesse cAdaPstzs::anz_kup_puls_stada" TAB_VERB "%4.0" "" COMPU_TAB_REF Conv.cAdaPstzs._.anz_kup_puls_stada_S5_S3 /end COMPU_METHOD
/begin COMPU_METHOD Conv.cAdaPstzs._.anz_pf_durchgefuehrt_stada_S5_S3 "Umrechnung fuer Messgroesse cAdaPstzs::anz_pf_durchgefuehrt_stada" TAB_VERB "%4.0" "" COMPU_TAB_REF Conv.cAdaPstzs._.anz_pf_durchgefuehrt_stada_S5_S3 /end COMPU_METHOD
/begin COMPU_METHOD Conv.cAdaPstzs._.anz_prueftyp_stada_S5_S3 "Umrechnung fuer Messgroesse cAdaPstzs::anz_prueftyp_stada" TAB_VERB "%4.0" "" COMPU_TAB_REF Conv.cAdaPstzs._.anz_prueftyp_stada_S5_S3 /end COMPU_METHOD
/begin COMPU_METHOD Conv.cAdaPstzs._.anz_pulsid_stada_S5_S3 "Umrechnung fuer Messgroesse cAdaPstzs::anz_pulsid_stada" TAB_VERB "%4.0" "" COMPU_TAB_REF Conv.cAdaPstzs._.anz_pulsid_stada_S5_S3 /end COMPU_METHOD
/begin COMPU_METHOD Conv.cAdaPstzs._.anz_tsf_durchgefuehrt_stada_S5_S3 "Umrechnung fuer Messgroesse cAdaPstzs::anz_tsf_durchgefuehrt_stada" TAB_VERB "%4.0" "" COMPU_TAB_REF Conv.cAdaPstzs._.anz_tsf_durchgefuehrt_stada_S5_S3 /end COMPU_METHOD
/begin COMPU_METHOD Conv.cAdaPstzs._.druck_statisch_stada_S5_S3 "Umrechnung fuer Messgroesse cAdaPstzs::druck_statisch_stada" TAB_VERB "%4.0" "" COMPU_TAB_REF Conv.cAdaPstzs._.druck_statisch_stada_S5_S3 /end COMPU_METHOD
/begin COMPU_METHOD Conv.cAdaPstzs._.f_deaktivierung_erkannt_S5_S3 "Umrechnung fuer Messgroesse cAdaPstzs::f_deaktivierung_erkannt" TAB_VERB "%4.0" "" COMPU_TAB_REF Conv.cAdaPstzs._.f_deaktivierung_erkannt_S5_S3 /end COMPU_METHOD
/begin COMPU_METHOD Conv.cAdaPstzs._.f_nmotsoll_stada_em_S5_S3 "Umrechnung fuer Messgroesse cAdaPstzs::f_nmotsoll_stada_em" TAB_VERB "%4.0" "" COMPU_TAB_REF Conv.cAdaPstzs._.f_nmotsoll_stada_em_S5_S3 /end COMPU_METHOD
/begin COMPU_METHOD Conv.cAdaPstzs._.fzg_stillstand_k0_stada_S5_S3 "Umrechnung fuer Messgroesse cAdaPstzs::fzg_stillstand_k0_stada" TAB_VERB "%4.0" "" COMPU_TAB_REF Conv.cAdaPstzs._.fzg_stillstand_k0_stada_S5_S3 /end COMPU_METHOD
/begin COMPU_METHOD Conv.cAdaPstzs._.fzg_stillstand_stada_S5_S3 "Umrechnung fuer Messgroesse cAdaPstzs::fzg_stillstand_stada" TAB_VERB "%4.0" "" COMPU_TAB_REF Conv.cAdaPstzs._.fzg_stillstand_stada_S5_S3 /end COMPU_METHOD
/begin COMPU_METHOD Conv.cAdaPstzs._.gang_zzs_stada_S5_S3 "Umrechnung fuer Messgroesse cAdaPstzs::gang_zzs_stada" TAB_VERB "%4.0" "" COMPU_TAB_REF Conv.cAdaPstzs._.gang_zzs_stada_S5_S3 /end COMPU_METHOD
/begin COMPU_METHOD Conv.cAdaPstzs._.grundbedingung_erfuellt_einmalig_k0_stada_S5_S3 "Umrechnung fuer Messgroesse cAdaPstzs::grundbedingung_erfuellt_einmalig_k0_stada" TAB_VERB "%4.0" "" COMPU_TAB_REF Conv.cAdaPstzs._.grundbedingung_erfuellt_einmalig_k0_stada_S5_S3 /end COMPU_METHOD
/begin COMPU_METHOD Conv.cAdaPstzs._.grundbedingung_erfuellt_einmalig_stada_S5_S3 "Umrechnung fuer Messgroesse cAdaPstzs::grundbedingung_erfuellt_einmalig_stada" TAB_VERB "%4.0" "" COMPU_TAB_REF Conv.cAdaPstzs._.grundbedingung_erfuellt_einmalig_stada_S5_S3 /end COMPU_METHOD
/begin COMPU_METHOD Conv.cAdaPstzs._.grundbedingung_erfuellt_zyklisch_k0_stada_S5_S3 "Umrechnung fuer Messgroesse cAdaPstzs::grundbedingung_erfuellt_zyklisch_k0_stada" TAB_VERB "%4.0" "" COMPU_TAB_REF Conv.cAdaPstzs._.grundbedingung_erfuellt_zyklisch_k0_stada_S5_S3 /end COMPU_METHOD
/begin COMPU_METHOD Conv.cAdaPstzs._.grundbedingung_erfuellt_zyklisch_stada_S5_S3 "Umrechnung fuer Messgroesse cAdaPstzs::grundbedingung_erfuellt_zyklisch_stada" TAB_VERB "%4.0" "" COMPU_TAB_REF Conv.cAdaPstzs._.grundbedingung_erfuellt_zyklisch_stada_S5_S3 /end COMPU_METHOD
/begin COMPU_METHOD Conv.cAdaPstzs._.kup_pruefpuls_ausgabe_stada_S5_S3 "Umrechnung fuer Messgroesse cAdaPstzs::kup_pruefpuls_ausgabe_stada" TAB_VERB "%4.0" "" COMPU_TAB_REF Conv.cAdaPstzs._.kup_pruefpuls_ausgabe_stada_S5_S3 /end COMPU_METHOD
/begin COMPU_METHOD Conv.cAdaPstzs._.kup_puls_stada_S5_S3 "Umrechnung fuer Messgroesse cAdaPstzs::kup_puls_stada" TAB_VERB "%4.0" "" COMPU_TAB_REF Conv.cAdaPstzs._.kup_puls_stada_S5_S3 /end COMPU_METHOD
/begin COMPU_METHOD Conv.cAdaPstzs._.pre_ada_zustand_stada_S5_S3 "Umrechnung fuer Messgroesse cAdaPstzs::pre_ada_zustand_stada" TAB_VERB "%4.0" "" COMPU_TAB_REF Conv.cAdaPstzs._.pre_ada_zustand_stada_S5_S3 /end COMPU_METHOD
/begin COMPU_METHOD Conv.cAdaPstzs._.pulsid_stada_S5_S3 "Umrechnung fuer Messgroesse cAdaPstzs::pulsid_stada" TAB_VERB "%4.0" "" COMPU_TAB_REF Conv.cAdaPstzs._.pulsid_stada_S5_S3 /end COMPU_METHOD
/begin COMPU_METHOD Conv.cAdaPstzs._.pulszyklus_beenden_stada_S5_S3 "Umrechnung fuer Messgroesse cAdaPstzs::pulszyklus_beenden_stada" TAB_VERB "%4.0" "" COMPU_TAB_REF Conv.cAdaPstzs._.pulszyklus_beenden_stada_S5_S3 /end COMPU_METHOD
/begin COMPU_METHOD Conv.cAdaPstzs._.sal_eng_start_req_S5_S3 "Umrechnung fuer Messgroesse cAdaPstzs::sal_eng_start_req" TAB_VERB "%4.0" "" COMPU_TAB_REF Conv.cAdaPstzs._.sal_eng_start_req_S5_S3 /end COMPU_METHOD
/begin COMPU_METHOD Conv.cAdaPstzs._.sal_eng_stop_disable_S5_S3 "Umrechnung fuer Messgroesse cAdaPstzs::sal_eng_stop_disable" TAB_VERB "%4.0" "" COMPU_TAB_REF Conv.cAdaPstzs._.sal_eng_stop_disable_S5_S3 /end COMPU_METHOD
/begin COMPU_METHOD Conv.cAdaPstzs._.schnellfuellung_aktiv_stada_S5_S3 "Umrechnung fuer Messgroesse cAdaPstzs::schnellfuellung_aktiv_stada" TAB_VERB "%4.0" "" COMPU_TAB_REF Conv.cAdaPstzs._.schnellfuellung_aktiv_stada_S5_S3 /end COMPU_METHOD
/begin COMPU_METHOD Conv.cAdaPstzs._.testfall_gang_stada_S5_S3 "Umrechnung fuer Messgroesse cAdaPstzs::testfall_gang_stada" TAB_VERB "%4.0" "" COMPU_TAB_REF Conv.cAdaPstzs._.testfall_gang_stada_S5_S3 /end COMPU_METHOD
/begin COMPU_METHOD Conv.cAdaPstzs._.testfall_ind_stada_S5_S3 "Umrechnung fuer Messgroesse cAdaPstzs::testfall_ind_stada" TAB_VERB "%4.0" "" COMPU_TAB_REF Conv.cAdaPstzs._.testfall_ind_stada_S5_S3 /end COMPU_METHOD
/begin COMPU_METHOD Conv.cAdaPstzs._.testfall_kup_ind_stada_S5_S3 "Umrechnung fuer Messgroesse cAdaPstzs::testfall_kup_ind_stada" TAB_VERB "%4.0" "" COMPU_TAB_REF Conv.cAdaPstzs._.testfall_kup_ind_stada_S5_S3 /end COMPU_METHOD
/begin COMPU_METHOD Conv.cAdaPstzs._.testfall_prueftyp_stada_S5_S3 "Umrechnung fuer Messgroesse cAdaPstzs::testfall_prueftyp_stada" TAB_VERB "%4.0" "" COMPU_TAB_REF Conv.cAdaPstzs._.testfall_prueftyp_stada_S5_S3 /end COMPU_METHOD
/begin COMPU_METHOD Conv.cAdaPstzs._.z_k0_stada_S5_S3 "Umrechnung fuer Messgroesse cAdaPstzs::z_k0_stada" TAB_VERB "%4.0" "" COMPU_TAB_REF Conv.cAdaPstzs._.z_k0_stada_S5_S3 /end COMPU_METHOD
/begin COMPU_METHOD Conv.cAdaPstzs._.z_systemkondit_agl_S5_S3 "Umrechnung fuer Messgroesse cAdaPstzs::z_systemkondit_agl" TAB_VERB "%4.0" "" COMPU_TAB_REF Conv.cAdaPstzs._.z_systemkondit_agl_S5_S3 /end COMPU_METHOD
/begin COMPU_METHOD Conv.cAdaPstzs._.z_systemkondit_funkdeakt_S5_S3 "Umrechnung fuer Messgroesse cAdaPstzs::z_systemkondit_funkdeakt" TAB_VERB "%4.0" "" COMPU_TAB_REF Conv.cAdaPstzs._.z_systemkondit_funkdeakt_S5_S3 /end COMPU_METHOD
/begin COMPU_METHOD Conv.cAdaPstzs._.z_systemkondit_nmot_S5_S3 "Umrechnung fuer Messgroesse cAdaPstzs::z_systemkondit_nmot" TAB_VERB "%4.0" "" COMPU_TAB_REF Conv.cAdaPstzs._.z_systemkondit_nmot_S5_S3 /end COMPU_METHOD
/begin COMPU_METHOD Conv.cAdaPstzs._.z_systemkondit_zzs_S5_S3 "Umrechnung fuer Messgroesse cAdaPstzs::z_systemkondit_zzs" TAB_VERB "%4.0" "" COMPU_TAB_REF Conv.cAdaPstzs._.z_systemkondit_zzs_S5_S3 /end COMPU_METHOD
/begin COMPU_METHOD Conv.cAdaPstzs._.zustand_stada_S5_S3 "Umrechnung fuer Messgroesse cAdaPstzs::zustand_stada" TAB_VERB "%4.0" "" COMPU_TAB_REF Conv.cAdaPstzs._.zustand_stada_S5_S3 /end COMPU_METHOD
/begin COMPU_METHOD Conv.cAdaPulbw._.f_start_t_sperrt_nach_reak_S5_S3 "Umrechnung fuer Messgroesse cAdaPulbw::f_start_t_sperrt_nach_reak" TAB_VERB "%4.0" "" COMPU_TAB_REF Conv.cAdaPulbw._.f_start_t_sperrt_nach_reak_S5_S3 /end COMPU_METHOD
/begin COMPU_METHOD Conv.cAdaPulbw._.neg_rea_S5_S3 "Umrechnung fuer Messgroesse cAdaPulbw::neg_rea" TAB_VERB "%4.0" "" COMPU_TAB_REF Conv.cAdaPulbw._.neg_rea_S5_S3 /end COMPU_METHOD
/begin COMPU_METHOD Conv.cAdaPulbw._.pos_rea_S5_S3 "Umrechnung fuer Messgroesse cAdaPulbw::pos_rea" TAB_VERB "%4.0" "" COMPU_TAB_REF Conv.cAdaPulbw._.pos_rea_S5_S3 /end COMPU_METHOD
/begin COMPU_METHOD Conv.cAdaPulbw._.rea_amplitude_S5_S3 "Umrechnung fuer Messgroesse cAdaPulbw::rea_amplitude" TAB_VERB "%4.0" "" COMPU_TAB_REF Conv.cAdaPulbw._.rea_amplitude_S5_S3 /end COMPU_METHOD
/begin COMPU_METHOD Conv.cAdaPulbw._.testresultat_S5_S3 "Umrechnung fuer Messgroesse cAdaPulbw::testresultat" TAB_VERB "%4.0" "" COMPU_TAB_REF Conv.cAdaPulbw._.testresultat_S5_S3 /end COMPU_METHOD
/begin COMPU_METHOD Conv.cAdaPulbw._.z_n_verlauf_S5_S3 "Umrechnung fuer Messgroesse cAdaPulbw::z_n_verlauf" TAB_VERB "%4.0" "" COMPU_TAB_REF Conv.cAdaPulbw._.z_n_verlauf_S5_S3 /end COMPU_METHOD
/begin COMPU_METHOD Conv.cAdaPulbw._.zustand_S5_S3 "Umrechnung fuer Messgroesse cAdaPulbw::zustand" TAB_VERB "%4.0" "" COMPU_TAB_REF Conv.cAdaPulbw._.zustand_S5_S3 /end COMPU_METHOD
/begin COMPU_METHOD Conv.cAdaPulbwFenster._.f_aktiv_S5_S3 "Umrechnung fuer Messgroesse cAdaPulbwFenster::f_aktiv" TAB_VERB "%4.0" "" COMPU_TAB_REF Conv.cAdaPulbwFenster._.f_aktiv_S5_S3 /end COMPU_METHOD
/begin COMPU_METHOD Conv.cAdaPulbwFenster._.f_beenden_S5_S3 "Umrechnung fuer Messgroesse cAdaPulbwFenster::f_beenden" TAB_VERB "%4.0" "" COMPU_TAB_REF Conv.cAdaPulbwFenster._.f_beenden_S5_S3 /end COMPU_METHOD
/begin COMPU_METHOD Conv.cAdaPulbwFenster._.f_starten_S5_S3 "Umrechnung fuer Messgroesse cAdaPulbwFenster::f_starten" TAB_VERB "%4.0" "" COMPU_TAB_REF Conv.cAdaPulbwFenster._.f_starten_S5_S3 /end COMPU_METHOD
/begin COMPU_METHOD Conv.cAdaPulhv._.hs_verzoegerung_S5_S3 "Umrechnung fuer Messgroesse cAdaPulhv::hs_verzoegerung" TAB_VERB "%4.0" "" COMPU_TAB_REF Conv.cAdaPulhv._.hs_verzoegerung_S5_S3 /end COMPU_METHOD
/begin COMPU_METHOD Conv.cAdaPulhv._.zustand_S5_S3 "Umrechnung fuer Messgroesse cAdaPulhv::zustand" TAB_VERB "%4.0" "" COMPU_TAB_REF Conv.cAdaPulhv._.zustand_S5_S3 /end COMPU_METHOD
/begin COMPU_METHOD Conv.cAdaPulKr._.aktive_pulspruefung_S5_S3 "Umrechnung fuer Messgroesse cAdaPulKr::aktive_pulspruefung" TAB_VERB "%4.0" "" COMPU_TAB_REF Conv.cAdaPulKr._.aktive_pulspruefung_S5_S3 /end COMPU_METHOD
/begin COMPU_METHOD Conv.cAdaPulpf._.fenster_nach_sf_S5_S3 "Umrechnung fuer Messgroesse cAdaPulpf::fenster_nach_sf" TAB_VERB "%4.0" "" COMPU_TAB_REF Conv.cAdaPulpf._.fenster_nach_sf_S5_S3 /end COMPU_METHOD
/begin COMPU_METHOD Conv.cAdaPulpf._.zustand_S5_S3 "Umrechnung fuer Messgroesse cAdaPulpf::zustand" TAB_VERB "%4.0" "" COMPU_TAB_REF Conv.cAdaPulpf._.zustand_S5_S3 /end COMPU_METHOD
/begin COMPU_METHOD Conv.cAdaPulsf._.zustand_S5_S3 "Umrechnung fuer Messgroesse cAdaPulsf::zustand" TAB_VERB "%4.0" "" COMPU_TAB_REF Conv.cAdaPulsf._.zustand_S5_S3 /end COMPU_METHOD
/begin COMPU_METHOD Conv.cAdaPulzs._.anz_kup_puls_S5_S3 "Umrechnung fuer Messgroesse cAdaPulzs::anz_kup_puls" TAB_VERB "%4.0" "" COMPU_TAB_REF Conv.cAdaPulzs._.anz_kup_puls_S5_S3 /end COMPU_METHOD
/begin COMPU_METHOD Conv.cAdaPulzs._.anz_prueftyp_S5_S3 "Umrechnung fuer Messgroesse cAdaPulzs::anz_prueftyp" TAB_VERB "%4.0" "" COMPU_TAB_REF Conv.cAdaPulzs._.anz_prueftyp_S5_S3 /end COMPU_METHOD
/begin COMPU_METHOD Conv.cAdaPulzs._.anz_pulsid_S5_S3 "Umrechnung fuer Messgroesse cAdaPulzs::anz_pulsid" TAB_VERB "%4.0" "" COMPU_TAB_REF Conv.cAdaPulzs._.anz_pulsid_S5_S3 /end COMPU_METHOD
/begin COMPU_METHOD Conv.cAdaPulzs._.druck_statisch_S5_S3 "Umrechnung fuer Messgroesse cAdaPulzs::druck_statisch" TAB_VERB "%4.0" "" COMPU_TAB_REF Conv.cAdaPulzs._.druck_statisch_S5_S3 /end COMPU_METHOD
/begin COMPU_METHOD Conv.cAdaPulzs._.f_in_gang_fertig_S5_S3 "Umrechnung fuer Messgroesse cAdaPulzs::f_in_gang_fertig" TAB_VERB "%4.0" "" COMPU_TAB_REF Conv.cAdaPulzs._.f_in_gang_fertig_S5_S3 /end COMPU_METHOD
/begin COMPU_METHOD Conv.cAdaPulzs._.f_ndabbr_verletzt_S5_S3 "Umrechnung fuer Messgroesse cAdaPulzs::f_ndabbr_verletzt" TAB_VERB "%4.0" "" COMPU_TAB_REF Conv.cAdaPulzs._.f_ndabbr_verletzt_S5_S3 /end COMPU_METHOD
/begin COMPU_METHOD Conv.cAdaPulzs._.f_nmotsoll_em_S5_S3 "Umrechnung fuer Messgroesse cAdaPulzs::f_nmotsoll_em" TAB_VERB "%4.0" "" COMPU_TAB_REF Conv.cAdaPulzs._.f_nmotsoll_em_S5_S3 /end COMPU_METHOD
/begin COMPU_METHOD Conv.cAdaPulzs._.f_schubabschaltung_aktiv_start_S5_S3 "Umrechnung fuer Messgroesse cAdaPulzs::f_schubabschaltung_aktiv_start" TAB_VERB "%4.0" "" COMPU_TAB_REF Conv.cAdaPulzs._.f_schubabschaltung_aktiv_start_S5_S3 /end COMPU_METHOD
/begin COMPU_METHOD Conv.cAdaPulzs._.f_startpruefung_aktiv_S5_S3 "Umrechnung fuer Messgroesse cAdaPulzs::f_startpruefung_aktiv" TAB_VERB "%4.0" "" COMPU_TAB_REF Conv.cAdaPulzs._.f_startpruefung_aktiv_S5_S3 /end COMPU_METHOD
/begin COMPU_METHOD Conv.cAdaPulzs._.f_startpuls_nguete_S5_S3 "Umrechnung fuer Messgroesse cAdaPulzs::f_startpuls_nguete" TAB_VERB "%4.0" "" COMPU_TAB_REF Conv.cAdaPulzs._.f_startpuls_nguete_S5_S3 /end COMPU_METHOD
/begin COMPU_METHOD Conv.cAdaPulzs._.kup_puls_alt_S5_S3 "Umrechnung fuer Messgroesse cAdaPulzs::kup_puls_alt" TAB_VERB "%4.0" "" COMPU_TAB_REF Conv.cAdaPulzs._.kup_puls_alt_S5_S3 /end COMPU_METHOD
/begin COMPU_METHOD Conv.cAdaPulzs._.kup_puls_neu_S5_S3 "Umrechnung fuer Messgroesse cAdaPulzs::kup_puls_neu" TAB_VERB "%4.0" "" COMPU_TAB_REF Conv.cAdaPulzs._.kup_puls_neu_S5_S3 /end COMPU_METHOD
/begin COMPU_METHOD Conv.cAdaPulzs._.kup_puls_S5_S3 "Umrechnung fuer Messgroesse cAdaPulzs::kup_puls" TAB_VERB "%4.0" "" COMPU_TAB_REF Conv.cAdaPulzs._.kup_puls_S5_S3 /end COMPU_METHOD
/begin COMPU_METHOD Conv.cAdaPulzs._.prueftyp_alt_S5_S3 "Umrechnung fuer Messgroesse cAdaPulzs::prueftyp_alt" TAB_VERB "%4.0" "" COMPU_TAB_REF Conv.cAdaPulzs._.prueftyp_alt_S5_S3 /end COMPU_METHOD
/begin COMPU_METHOD Conv.cAdaPulzs._.prueftyp_S5_S3 "Umrechnung fuer Messgroesse cAdaPulzs::prueftyp" TAB_VERB "%4.0" "" COMPU_TAB_REF Conv.cAdaPulzs._.prueftyp_S5_S3 /end COMPU_METHOD
/begin COMPU_METHOD Conv.cAdaPulzs._.pruefung_kup_fertig_S5_S3 "Umrechnung fuer Messgroesse cAdaPulzs::pruefung_kup_fertig" TAB_VERB "%4.0" "" COMPU_TAB_REF Conv.cAdaPulzs._.pruefung_kup_fertig_S5_S3 /end COMPU_METHOD
/begin COMPU_METHOD Conv.cAdaPulzs._.pulsid_S5_S3 "Umrechnung fuer Messgroesse cAdaPulzs::pulsid" TAB_VERB "%4.0" "" COMPU_TAB_REF Conv.cAdaPulzs._.pulsid_S5_S3 /end COMPU_METHOD
/begin COMPU_METHOD Conv.cAdaPulzs._.pulszyklus_beenden_S5_S3 "Umrechnung fuer Messgroesse cAdaPulzs::pulszyklus_beenden" TAB_VERB "%4.0" "" COMPU_TAB_REF Conv.cAdaPulzs._.pulszyklus_beenden_S5_S3 /end COMPU_METHOD
/begin COMPU_METHOD Conv.cAdaPulzs._.schnellfuellung_aktiv_S5_S3 "Umrechnung fuer Messgroesse cAdaPulzs::schnellfuellung_aktiv" TAB_VERB "%4.0" "" COMPU_TAB_REF Conv.cAdaPulzs._.schnellfuellung_aktiv_S5_S3 /end COMPU_METHOD
/begin COMPU_METHOD Conv.cAdaPulzs._.startinfo_index_S5_S3 "Umrechnung fuer Messgroesse cAdaPulzs::startinfo_index" TAB_VERB "%4.0" "" COMPU_TAB_REF Conv.cAdaPulzs._.startinfo_index_S5_S3 /end COMPU_METHOD
/begin COMPU_METHOD Conv.cAdaPulzs._.zustand_S5_S3 "Umrechnung fuer Messgroesse cAdaPulzs::zustand" TAB_VERB "%4.0" "" COMPU_TAB_REF Conv.cAdaPulzs._.zustand_S5_S3 /end COMPU_METHOD
/begin COMPU_METHOD Conv.cAdaUrlufterkPuls._.istgang_start_S5_S3 "Umrechnung fuer Messgroesse cAdaUrlufterkPuls::istgang_start" TAB_VERB "%4.0" "" COMPU_TAB_REF Conv.cAdaUrlufterkPuls._.istgang_start_S5_S3 /end COMPU_METHOD
/begin COMPU_METHOD Conv.cAdaUrlufterkPuls._.kfl_ist_start_S5_S3 "Umrechnung fuer Messgroesse cAdaUrlufterkPuls::kfl_ist_start" TAB_VERB "%4.0" "" COMPU_TAB_REF Conv.cAdaUrlufterkPuls._.kfl_ist_start_S5_S3 /end COMPU_METHOD
/begin COMPU_METHOD Conv.cAdaUrlufterkPuls._.kup_S5_S3 "Umrechnung fuer Messgroesse cAdaUrlufterkPuls::kup" TAB_VERB "%4.0" "" COMPU_TAB_REF Conv.cAdaUrlufterkPuls._.kup_S5_S3 /end COMPU_METHOD
/begin COMPU_METHOD Conv.cAdaUrlufterkPuls._.zustand_S5_S3 "Umrechnung fuer Messgroesse cAdaUrlufterkPuls::zustand" TAB_VERB "%4.0" "" COMPU_TAB_REF Conv.cAdaUrlufterkPuls._.zustand_S5_S3 /end COMPU_METHOD
/begin COMPU_METHOD Conv.cAdaUrlufterkPulsAnz._.f_loeschen_puls_url_S5_S3 "Umrechnung fuer Messgroesse cAdaUrlufterkPulsAnz::f_loeschen_puls_url" TAB_VERB "%4.0" "" COMPU_TAB_REF Conv.cAdaUrlufterkPulsAnz._.f_loeschen_puls_url_S5_S3 /end COMPU_METHOD
/begin COMPU_METHOD Conv.cAdaUrlufterkPulsAnz._.kup_puls_url_S5_S3 "Umrechnung fuer Messgroesse cAdaUrlufterkPulsAnz::kup_puls_url" TAB_VERB "%4.0" "" COMPU_TAB_REF Conv.cAdaUrlufterkPulsAnz._.kup_puls_url_S5_S3 /end COMPU_METHOD
/begin COMPU_METHOD Conv.cAdaUrlufterkSchaltung._.kup_S5_S3 "Umrechnung fuer Messgroesse cAdaUrlufterkSchaltung::kup" TAB_VERB "%4.0" "" COMPU_TAB_REF Conv.cAdaUrlufterkSchaltung._.kup_S5_S3 /end COMPU_METHOD
/begin COMPU_METHOD Conv.cAdaUrlufterkSchaltung._.zustand_S5_S3 "Umrechnung fuer Messgroesse cAdaUrlufterkSchaltung::zustand" TAB_VERB "%4.0" "" COMPU_TAB_REF Conv.cAdaUrlufterkSchaltung._.zustand_S5_S3 /end COMPU_METHOD
/begin COMPU_METHOD Conv.cAdaUrlufterkSchaltungAnz._.f_loeschen_schalung_url_S5_S3 "Umrechnung fuer Messgroesse cAdaUrlufterkSchaltungAnz::f_loeschen_schalung_url" TAB_VERB "%4.0" "" COMPU_TAB_REF Conv.cAdaUrlufterkSchaltungAnz._.f_loeschen_schalung_url_S5_S3 /end COMPU_METHOD
/begin COMPU_METHOD Conv.cAdaUrlufterkSchaltungAnz._.kup_schaltung_url_S5_S3 "Umrechnung fuer Messgroesse cAdaUrlufterkSchaltungAnz::kup_schaltung_url" TAB_VERB "%4.0" "" COMPU_TAB_REF Conv.cAdaUrlufterkSchaltungAnz._.kup_schaltung_url_S5_S3 /end COMPU_METHOD
/begin COMPU_METHOD Conv.cAdaUrlufterkSchaltungSignal._.f_grad_inti_S5_S3 "Umrechnung fuer Messgroesse cAdaUrlufterkSchaltungSignal::f_grad_inti" TAB_VERB "%4.0" "" COMPU_TAB_REF Conv.cAdaUrlufterkSchaltungSignal._.f_grad_inti_S5_S3 /end COMPU_METHOD
/begin COMPU_METHOD Conv.cAdaUrlufterkSchaltungSignal._.f_pt1_inti_S5_S3 "Umrechnung fuer Messgroesse cAdaUrlufterkSchaltungSignal::f_pt1_inti" TAB_VERB "%4.0" "" COMPU_TAB_REF Conv.cAdaUrlufterkSchaltungSignal._.f_pt1_inti_S5_S3 /end COMPU_METHOD
/begin COMPU_METHOD Conv.cAdaUrlufterkSchaltungSignal._.f_signal_ungueltig_S5_S3 "Umrechnung fuer Messgroesse cAdaUrlufterkSchaltungSignal::f_signal_ungueltig" TAB_VERB "%4.0" "" COMPU_TAB_REF Conv.cAdaUrlufterkSchaltungSignal._.f_signal_ungueltig_S5_S3 /end COMPU_METHOD
/begin COMPU_METHOD Conv.cAdaUrlufterkSchaltungSignal._.signal_quelle_alt_S5_S3 "Umrechnung fuer Messgroesse cAdaUrlufterkSchaltungSignal::signal_quelle_alt" TAB_VERB "%4.0" "" COMPU_TAB_REF Conv.cAdaUrlufterkSchaltungSignal._.signal_quelle_alt_S5_S3 /end COMPU_METHOD
/begin COMPU_METHOD Conv.cAdaUrlufterkSchaltungSignal._.signal_quelle_S5_S3 "Umrechnung fuer Messgroesse cAdaUrlufterkSchaltungSignal::signal_quelle" TAB_VERB "%4.0" "" COMPU_TAB_REF Conv.cAdaUrlufterkSchaltungSignal._.signal_quelle_S5_S3 /end COMPU_METHOD
/begin COMPU_METHOD Conv.cAzsIstGang._.f_saf_abbruch_invers_S5_S3 "Umrechnung fuer Messgroesse cAzsIstGang::f_saf_abbruch_invers" TAB_VERB "%4.0" "" COMPU_TAB_REF Conv.cAzsIstGang._.f_saf_abbruch_invers_S5_S3 /end COMPU_METHOD
/begin COMPU_METHOD Conv.cAzsIstGang._.f_saf_folgeschaltung_S5_S3 "Umrechnung fuer Messgroesse cAzsIstGang::f_saf_folgeschaltung" TAB_VERB "%4.0" "" COMPU_TAB_REF Conv.cAzsIstGang._.f_saf_folgeschaltung_S5_S3 /end COMPU_METHOD
/begin COMPU_METHOD Conv.cAzsIstGang._.f_saf_freigegeben_S5_S3 "Umrechnung fuer Messgroesse cAzsIstGang::f_saf_freigegeben" TAB_VERB "%4.0" "" COMPU_TAB_REF Conv.cAzsIstGang._.f_saf_freigegeben_S5_S3 /end COMPU_METHOD
/begin COMPU_METHOD Conv.cAzsIstGang._.istgang_S5_S3 "Umrechnung fuer Messgroesse cAzsIstGang::istgang" TAB_VERB "%4.0" "" COMPU_TAB_REF Conv.cAzsIstGang._.istgang_S5_S3 /end COMPU_METHOD
/begin COMPU_METHOD Conv.cAzsKflIst._.kfl_ist_S5_S3 "Umrechnung fuer Messgroesse cAzsKflIst::kfl_ist" TAB_VERB "%4.0" "" COMPU_TAB_REF Conv.cAzsKflIst._.kfl_ist_S5_S3 /end COMPU_METHOD
/begin COMPU_METHOD Conv.cAzsKflSoll._.kfl_soll_S5_S3 "Umrechnung fuer Messgroesse cAzsKflSoll::kfl_soll" TAB_VERB "%4.0" "" COMPU_TAB_REF Conv.cAzsKflSoll._.kfl_soll_S5_S3 /end COMPU_METHOD
/begin COMPU_METHOD Conv.cAzsKflZiel._.kfl_ziel_S5_S3 "Umrechnung fuer Messgroesse cAzsKflZiel::kfl_ziel" TAB_VERB "%4.0" "" COMPU_TAB_REF Conv.cAzsKflZiel._.kfl_ziel_S5_S3 /end COMPU_METHOD
/begin COMPU_METHOD Conv.cAzsKorgl._.f_abbruch_schaltung_durch_ga_S5_S3 "Umrechnung fuer Messgroesse cAzsKorgl::f_abbruch_schaltung_durch_ga" TAB_VERB "%4.0" "" COMPU_TAB_REF Conv.cAzsKorgl._.f_abbruch_schaltung_durch_ga_S5_S3 /end COMPU_METHOD
/begin COMPU_METHOD Conv.cAzsKorgl._.f_kfl_direkt_S5_S3 "Umrechnung fuer Messgroesse cAzsKorgl::f_kfl_direkt" TAB_VERB "%4.0" "" COMPU_TAB_REF Conv.cAzsKorgl._.f_kfl_direkt_S5_S3 /end COMPU_METHOD
/begin COMPU_METHOD EH_STANDARD_S4_S3 "int = ((phys * 1) / 1) - (0) -" RAT_FUNC "%1.0" "-" COEFFS 0 1 0 0 0 1 /end COMPU_METHOD
/begin COMPU_METHOD EH_T_1S_S4_S3 "int = ((phys * 1) / 1) - (0) s" RAT_FUNC "%1.0" "s" COEFFS 0 1 0 0 0 1 /end COMPU_METHOD
/begin COMPU_METHOD UMR___1_1_0_S5_S3 "int = ((phys * 1) / 1) - (0) [-]" RAT_FUNC "%1.0" "[-]" COEFFS 0 1 0 0 0 1 /end COMPU_METHOD
/begin COMPU_METHOD UMR___1_300_0_S5_S3 "int = ((phys * 300) / 1) - (0) [-]" RAT_FUNC "%6.5" "[-]" COEFFS 0 300 0 0 0 1 /end COMPU_METHOD
/begin COMPU_METHOD UMR_BAR__1_1000_0_S5_S3 "int = ((phys * 1000) / 1) - (0) [bar]" RAT_FUNC "%4.3" "[bar]" COEFFS 0 1000 0 0 0 1 /end COMPU_METHOD
/begin COMPU_METHOD UMR_BAR__1_100_0_S5_S3 "int = ((phys * 100) / 1) - (0) [bar]" RAT_FUNC "%3.2" "[bar]" COEFFS 0 100 0 0 0 1 /end COMPU_METHOD
/begin COMPU_METHOD UMR_BAR_SEC_1_10_0_S5_S3 "int = ((phys * 10) / 1) - (0) [bar/s]" RAT_FUNC "%2.1" "[bar/s]" COEFFS 0 10 0 0 0 1 /end COMPU_METHOD
/begin COMPU_METHOD UMR_GRADC__1_1_M40_S5_S3 "int = ((phys * 1) / 1) - (-40) [°C]" RAT_FUNC "%1.0" "[°C]" COEFFS 0 1 40 0 0 1 /end COMPU_METHOD
/begin COMPU_METHOD UMR_M_SEC2_1_32_0_S5_S3 "int = ((phys * 32) / 1) - (0) [m/s^2]" RAT_FUNC "%3.2" "[m/s^2]" COEFFS 0 32 0 0 0 1 /end COMPU_METHOD
/begin COMPU_METHOD UMR_MBAR__10_1_0_S5_S3 "int = ((phys * 1) / 10) - (0) [mbar]" RAT_FUNC "%1.0" "[mbar]" COEFFS 0 0.1 0 0 0 1 /end COMPU_METHOD
/begin COMPU_METHOD UMR_MSEC__10_1_0_S5_S3 "int = ((phys * 1) / 10) - (0) [ms]" RAT_FUNC "%1.0" "[ms]" COEFFS 0 0.1 0 0 0 1 /end COMPU_METHOD
/begin COMPU_METHOD UMR_MSEC__1_1_0_S5_S3 "int = ((phys * 1) / 1) - (0) [ms]" RAT_FUNC "%1.0" "[ms]" COEFFS 0 1 0 0 0 1 /end COMPU_METHOD
/begin COMPU_METHOD UMR_NM__1_100_0_S5_S3 "int = ((phys * 100) / 1) - (0) [Nm]" RAT_FUNC "%3.2" "[Nm]" COEFFS 0 100 0 0 0 1 /end COMPU_METHOD
/begin COMPU_METHOD UMR_NM__1_1_0_S5_S3 "int = ((phys * 1) / 1) - (0) [Nm]" RAT_FUNC "%1.0" "[Nm]" COEFFS 0 1 0 0 0 1 /end COMPU_METHOD
/begin COMPU_METHOD UMR_NM_SEC_1_1_0_S5_S3 "int = ((phys * 1) / 1) - (0) [Nm/s]" RAT_FUNC "%1.0" "[Nm/s]" COEFFS 0 1 0 0 0 1 /end COMPU_METHOD
/begin COMPU_METHOD UMR_NMMINSEC__1_1_0_S5_S3 "int = ((phys * 1) / 1) - (0) [0,16Nm/(1/(min*s))]" RAT_FUNC "%1.0" "[0,16Nm/(1/(min*s))]" COEFFS 0 1 0 0 0 1 /end COMPU_METHOD
/begin COMPU_METHOD UMR_PROZENT__1_10_0_S5_S3 "int = ((phys * 10) / 1) - (0) [%]" RAT_FUNC "%2.1" "[%]" COEFFS 0 10 0 0 0 1 /end COMPU_METHOD
/begin COMPU_METHOD UMR_PROZENT__20_51_0_S5_S3 "int = ((phys * 51) / 20) - (0) [%]" RAT_FUNC "%5.4" "[%]" COEFFS 0 2.55 0 0 0 1 /end COMPU_METHOD
/begin COMPU_METHOD UMR_PROZENT__4_10_0_S5_S3 "int = ((phys * 10) / 4) - (0) [%]" RAT_FUNC "%2.1" "[%]" COEFFS 0 2.5 0 0 0 1 /end COMPU_METHOD
/begin COMPU_METHOD UMR_PROZENT_SEC_1_10_0_S5_S3 "int = ((phys * 10) / 1) - (0) [%/s]" RAT_FUNC "%2.1" "[%/s]" COEFFS 0 10 0 0 0 1 /end COMPU_METHOD
/begin COMPU_METHOD UMR_PROZENT_SEC_1_1_0_S5_S3 "int = ((phys * 1) / 1) - (0) [%/s]" RAT_FUNC "%1.0" "[%/s]" COEFFS 0 1 0 0 0 1 /end COMPU_METHOD
/begin COMPU_METHOD UMR_SEC__10000_1_0_S5_S3 "int = ((phys * 1) / 10000) - (0) [s]" RAT_FUNC "%1.0" "[s]" COEFFS 0 0.0001 0 0 0 1 /end COMPU_METHOD
/begin COMPU_METHOD UMR_SEC__1000_1_0_S5_S3 "int = ((phys * 1) / 1000) - (0) [s]" RAT_FUNC "%1.0" "[s]" COEFFS 0 0.001 0 0 0 1 /end COMPU_METHOD
/begin COMPU_METHOD UMR_SEC__100_1_0_S5_S3 "int = ((phys * 1) / 100) - (0) [s]" RAT_FUNC "%1.0" "[s]" COEFFS 0 0.01 0 0 0 1 /end COMPU_METHOD
/begin COMPU_METHOD UMR_SEC__10_1_0_S5_S3 "int = ((phys * 1) / 10) - (0) [s]" RAT_FUNC "%1.0" "[s]" COEFFS 0 0.1 0 0 0 1 /end COMPU_METHOD
/begin COMPU_METHOD UMR_SEC__1_100_0_S5_S3 "int = ((phys * 100) / 1) - (0) [s]" RAT_FUNC "%3.2" "[s]" COEFFS 0 100 0 0 0 1 /end COMPU_METHOD
/begin COMPU_METHOD UMR_SEC__5_1_0_S5_S3 "int = ((phys * 1) / 5) - (0) [s]" RAT_FUNC "%1.0" "[s]" COEFFS 0 0.2 0 0 0 1 /end COMPU_METHOD
/begin COMPU_METHOD UMR_STUNDE__1_1_0_S5_S3 "int = ((phys * 1) / 1) - (0) [stunde]" RAT_FUNC "%1.0" "[stunde]" COEFFS 0 1 0 0 0 1 /end COMPU_METHOD
/begin COMPU_METHOD UMR_U_MIN_1_100_0_S5_S3 "int = ((phys * 100) / 1) - (0) [U/min]" RAT_FUNC "%3.2" "[U/min]" COEFFS 0 100 0 0 0 1 /end COMPU_METHOD
/begin COMPU_METHOD UMR_U_MIN_1_1_0_S5_S3 "int = ((phys * 1) / 1) - (0) [U/min]" RAT_FUNC "%1.0" "[U/min]" COEFFS 0 1 0 0 0 1 /end COMPU_METHOD
/begin COMPU_METHOD UMR_U_MINMSEC_1000_1_0_S5_S3 "int = ((phys * 1) / 1000) - (0) [U/(min*ms)]" RAT_FUNC "%3.2" "[U/(min*ms)]" COEFFS 0 0.001 0 0 0 1 /end COMPU_METHOD
/begin COMPU_METHOD UMR_U_MINSEC_10_1_0_S5_S3 "int = ((phys * 1) / 10) - (0) [U/(min*s)]" RAT_FUNC "%1.0" "[U/(min*s)]" COEFFS 0 0.1 0 0 0 1 /end COMPU_METHOD
/begin COMPU_METHOD UMR_U_MINSEC_1_100_0_S5_S3 "int = ((phys * 100) / 1) - (0) [U/(min*s)]" RAT_FUNC "%3.2" "[U/(min*s)]" COEFFS 0 100 0 0 0 1 /end COMPU_METHOD
/begin COMPU_METHOD UMR_U_MINSEC_1_1_0_S5_S3 "int = ((phys * 1) / 1) - (0) [U/(min*s)]" RAT_FUNC "%1.0" "[U/(min*s)]" COEFFS 0 1 0 0 0 1 /end COMPU_METHOD
/begin COMPU_METHOD UMR_W__1_10_0_S5_S3 "int = ((phys * 10) / 1) - (0) [W]" RAT_FUNC "%2.1" "[W]" COEFFS 0 10 0 0 0 1 /end COMPU_METHOD
/begin COMPU_METHOD UMR_W_K_1_10_0_S5_S3 "int = ((phys * 10) / 1) - (0) [W/K]" RAT_FUNC "%6.5" "[W/K]" COEFFS 0 10 0 0 0 1 /end COMPU_METHOD
/begin COMPU_METHOD UMR_W_MM2_1_1000_0_S5_S3 "int = ((phys * 1000) / 1) - (0) [W/(mm^2)]" RAT_FUNC "%4.3" "[W/(mm^2)]" COEFFS 0 1000 0 0 0 1 /end COMPU_METHOD
/begin COMPU_METHOD UMR_W_MM2_1_1_0_S5_S3 "int = ((phys * 1) / 1) - (0) [W/(mm^2)]" RAT_FUNC "%1.0" "[W/(mm^2)]" COEFFS 0 1 0 0 0 1 /end COMPU_METHOD
/begin MEASUREMENT di_filter_max_val[156] "maximum reached filter value of error code [0 .. 254-1]" UWORD EH_STANDARD_S4_S3 1 100 0 65535 ECU_ADDRESS 0xFFF8A6D0 /end MEASUREMENT
/begin MEASUREMENT di_filter_max_val[157] "maximum reached filter value of error code [0 .. 254-1]" UWORD EH_STANDARD_S4_S3 1 100 0 65535 ECU_ADDRESS 0xFFF8A6D2 /end MEASUREMENT
/begin MEASUREMENT di_filter_max_val[158] "maximum reached filter value of error code [0 .. 254-1]" UWORD EH_STANDARD_S4_S3 1 100 0 65535 ECU_ADDRESS 0xFFF8A6D4 /end MEASUREMENT
/begin MEASUREMENT di_filter_max_val[159] "maximum reached filter value of error code [0 .. 254-1]" UWORD EH_STANDARD_S4_S3 1 100 0 65535 ECU_ADDRESS 0xFFF8A6D6 /end MEASUREMENT
/begin MEASUREMENT di_filter_max_val[15] "maximum reached filter value of error code [0 .. 254-1]" UWORD EH_STANDARD_S4_S3 1 100 0 65535 ECU_ADDRESS 0xFFF8A5B6 /end MEASUREMENT
/begin MEASUREMENT di_filter_max_val[160] "maximum reached filter value of error code [0 .. 254-1]" UWORD EH_STANDARD_S4_S3 1 100 0 65535 ECU_ADDRESS 0xFFF8A6D8 /end MEASUREMENT
/begin MEASUREMENT di_filter_max_val[161] "maximum reached filter value of error code [0 .. 254-1]" UWORD EH_STANDARD_S4_S3 1 100 0 65535 ECU_ADDRESS 0xFFF8A6DA /end MEASUREMENT
/begin MEASUREMENT di_filter_max_val[162] "maximum reached filter value of error code [0 .. 254-1]" UWORD EH_STANDARD_S4_S3 1 100 0 65535 ECU_ADDRESS 0xFFF8A6DC /end MEASUREMENT
/begin MEASUREMENT di_filter_max_val[163] "maximum reached filter value of error code [0 .. 254-1]" UWORD EH_STANDARD_S4_S3 1 100 0 65535 ECU_ADDRESS 0xFFF8A6DE /end MEASUREMENT
/begin MEASUREMENT di_filter_max_val[164] "maximum reached filter value of error code [0 .. 254-1]" UWORD EH_STANDARD_S4_S3 1 100 0 65535 ECU_ADDRESS 0xFFF8A6E0 /end MEASUREMENT
/begin MEASUREMENT di_filter_max_val[165] "maximum reached filter value of error code [0 .. 254-1]" UWORD EH_STANDARD_S4_S3 1 100 0 65535 ECU_ADDRESS 0xFFF8A6E2 /end MEASUREMENT
/begin MEASUREMENT di_filter_max_val[166] "maximum reached filter value of error code [0 .. 254-1]" UWORD EH_STANDARD_S4_S3 1 100 0 65535 ECU_ADDRESS 0xFFF8A6E4 /end MEASUREMENT
/begin MEASUREMENT di_filter_max_val[167] "maximum reached filter value of error code [0 .. 254-1]" UWORD EH_STANDARD_S4_S3 1 100 0 65535 ECU_ADDRESS 0xFFF8A6E6 /end MEASUREMENT
/begin MEASUREMENT di_filter_max_val[168] "maximum reached filter value of error code [0 .. 254-1]" UWORD EH_STANDARD_S4_S3 1 100 0 65535 ECU_ADDRESS 0xFFF8A6E8 /end MEASUREMENT
/begin MEASUREMENT di_filter_max_val[169] "maximum reached filter value of error code [0 .. 254-1]" UWORD EH_STANDARD_S4_S3 1 100 0 65535 ECU_ADDRESS 0xFFF8A6EA /end MEASUREMENT
/begin MEASUREMENT di_filter_max_val[16] "maximum reached filter value of error code [0 .. 254-1]" UWORD EH_STANDARD_S4_S3 1 100 0 65535 ECU_ADDRESS 0xFFF8A5B8 /end MEASUREMENT
/begin MEASUREMENT di_filter_max_val[170] "maximum reached filter value of error code [0 .. 254-1]" UWORD EH_STANDARD_S4_S3 1 100 0 65535 ECU_ADDRESS 0xFFF8A6EC /end MEASUREMENT
/begin MEASUREMENT di_filter_max_val[171] "maximum reached filter value of error code [0 .. 254-1]" UWORD EH_STANDARD_S4_S3 1 100 0 65535 ECU_ADDRESS 0xFFF8A6EE /end MEASUREMENT
/begin MEASUREMENT di_filter_max_val[172] "maximum reached filter value of error code [0 .. 254-1]" UWORD EH_STANDARD_S4_S3 1 100 0 65535 ECU_ADDRESS 0xFFF8A6F0 /end MEASUREMENT
/begin MEASUREMENT di_filter_max_val[173] "maximum reached filter value of error code [0 .. 254-1]" UWORD EH_STANDARD_S4_S3 1 100 0 65535 ECU_ADDRESS 0xFFF8A6F2 /end MEASUREMENT
/begin MEASUREMENT di_filter_max_val[174] "maximum reached filter value of error code [0 .. 254-1]" UWORD EH_STANDARD_S4_S3 1 100 0 65535 ECU_ADDRESS 0xFFF8A6F4 /end MEASUREMENT
/begin MEASUREMENT di_filter_max_val[175] "maximum reached filter value of error code [0 .. 254-1]" UWORD EH_STANDARD_S4_S3 1 100 0 65535 ECU_ADDRESS 0xFFF8A6F6 /end MEASUREMENT
/begin MEASUREMENT di_filter_max_val[176] "maximum reached filter value of error code [0 .. 254-1]" UWORD EH_STANDARD_S4_S3 1 100 0 65535 ECU_ADDRESS 0xFFF8A6F8 /end MEASUREMENT
/begin MEASUREMENT di_filter_max_val[177] "maximum reached filter value of error code [0 .. 254-1]" UWORD EH_STANDARD_S4_S3 1 100 0 65535 ECU_ADDRESS 0xFFF8A6FA /end MEASUREMENT
/begin MEASUREMENT di_filter_max_val[178] "maximum reached filter value of error code [0 .. 254-1]" UWORD EH_STANDARD_S4_S3 1 100 0 65535 ECU_ADDRESS 0xFFF8A6FC /end MEASUREMENT
/begin MEASUREMENT di_filter_max_val[179] "maximum reached filter value of error code [0 .. 254-1]" UWORD EH_STANDARD_S4_S3 1 100 0 65535 ECU_ADDRESS 0xFFF8A6FE /end MEASUREMENT
/begin MEASUREMENT di_filter_max_val[17] "maximum reached filter value of error code [0 .. 254-1]" UWORD EH_STANDARD_S4_S3 1 100 0 65535 ECU_ADDRESS 0xFFF8A5BA /end MEASUREMENT
/begin MEASUREMENT di_filter_max_val[180] "maximum reached filter value of error code [0 .. 254-1]" UWORD EH_STANDARD_S4_S3 1 100 0 65535 ECU_ADDRESS 0xFFF8A700 /end MEASUREMENT
/begin MEASUREMENT di_filter_max_val[181] "maximum reached filter value of error code [0 .. 254-1]" UWORD EH_STANDARD_S4_S3 1 100 0 65535 ECU_ADDRESS 0xFFF8A702 /end MEASUREMENT
/begin MEASUREMENT di_filter_max_val[182] "maximum reached filter value of error code [0 .. 254-1]" UWORD EH_STANDARD_S4_S3 1 100 0 65535 ECU_ADDRESS 0xFFF8A704 /end MEASUREMENT
/begin MEASUREMENT di_filter_max_val[183] "maximum reached filter value of error code [0 .. 254-1]" UWORD EH_STANDARD_S4_S3 1 100 0 65535 ECU_ADDRESS 0xFFF8A706 /end MEASUREMENT
/begin MEASUREMENT di_filter_max_val[184] "maximum reached filter value of error code [0 .. 254-1]" UWORD EH_STANDARD_S4_S3 1 100 0 65535 ECU_ADDRESS 0xFFF8A708 /end MEASUREMENT
/begin MEASUREMENT di_filter_max_val[185] "maximum reached filter value of error code [0 .. 254-1]" UWORD EH_STANDARD_S4_S3 1 100 0 65535 ECU_ADDRESS 0xFFF8A70A /end MEASUREMENT
/begin MEASUREMENT di_filter_max_val[186] "maximum reached filter value of error code [0 .. 254-1]" UWORD EH_STANDARD_S4_S3 1 100 0 65535 ECU_ADDRESS 0xFFF8A70C /end MEASUREMENT
/begin MEASUREMENT di_filter_max_val[187] "maximum reached filter value of error code [0 .. 254-1]" UWORD EH_STANDARD_S4_S3 1 100 0 65535 ECU_ADDRESS 0xFFF8A70E /end MEASUREMENT
/begin MEASUREMENT di_filter_max_val[188] "maximum reached filter value of error code [0 .. 254-1]" UWORD EH_STANDARD_S4_S3 1 100 0 65535 ECU_ADDRESS 0xFFF8A710 /end MEASUREMENT
/begin MEASUREMENT di_filter_max_val[189] "maximum reached filter value of error code [0 .. 254-1]" UWORD EH_STANDARD_S4_S3 1 100 0 65535 ECU_ADDRESS 0xFFF8A712 /end MEASUREMENT
/begin MEASUREMENT di_filter_max_val[18] "maximum reached filter value of error code [0 .. 254-1]" UWORD EH_STANDARD_S4_S3 1 100 0 65535 ECU_ADDRESS 0xFFF8A5BC /end MEASUREMENT
/begin MEASUREMENT di_filter_max_val[190] "maximum reached filter value of error code [0 .. 254-1]" UWORD EH_STANDARD_S4_S3 1 100 0 65535 ECU_ADDRESS 0xFFF8A714 /end MEASUREMENT
/begin MEASUREMENT di_filter_max_val[191] "maximum reached filter value of error code [0 .. 254-1]" UWORD EH_STANDARD_S4_S3 1 100 0 65535 ECU_ADDRESS 0xFFF8A716 /end MEASUREMENT
/begin MEASUREMENT di_filter_max_val[192] "maximum reached filter value of error code [0 .. 254-1]" UWORD EH_STANDARD_S4_S3 1 100 0 65535 ECU_ADDRESS 0xFFF8A718 /end MEASUREMENT
/begin MEASUREMENT di_filter_max_val[193] "maximum reached filter value of error code [0 .. 254-1]" UWORD EH_STANDARD_S4_S3 1 100 0 65535 ECU_ADDRESS 0xFFF8A71A /end MEASUREMENT
/begin MEASUREMENT di_filter_max_val[194] "maximum reached filter value of error code [0 .. 254-1]" UWORD EH_STANDARD_S4_S3 1 100 0 65535 ECU_ADDRESS 0xFFF8A71C /end MEASUREMENT
/begin MEASUREMENT di_filter_max_val[195] "maximum reached filter value of error code [0 .. 254-1]" UWORD EH_STANDARD_S4_S3 1 100 0 65535 ECU_ADDRESS 0xFFF8A71E /end MEASUREMENT
/begin MEASUREMENT di_filter_max_val[196] "maximum reached filter value of error code [0 .. 254-1]" UWORD EH_STANDARD_S4_S3 1 100 0 65535 ECU_ADDRESS 0xFFF8A720 /end MEASUREMENT
/begin MEASUREMENT di_filter_max_val[197] "maximum reached filter value of error code [0 .. 254-1]" UWORD EH_STANDARD_S4_S3 1 100 0 65535 ECU_ADDRESS 0xFFF8A722 /end MEASUREMENT
/begin MEASUREMENT di_filter_max_val[198] "maximum reached filter value of error code [0 .. 254-1]" UWORD EH_STANDARD_S4_S3 1 100 0 65535 ECU_ADDRESS 0xFFF8A724 /end MEASUREMENT
/begin MEASUREMENT di_filter_max_val[199] "maximum reached filter value of error code [0 .. 254-1]" UWORD EH_STANDARD_S4_S3 1 100 0 65535 ECU_ADDRESS 0xFFF8A726 /end MEASUREMENT
/begin MEASUREMENT di_filter_max_val[19] "maximum reached filter value of error code [0 .. 254-1]" UWORD EH_STANDARD_S4_S3 1 100 0 65535 ECU_ADDRESS 0xFFF8A5BE /end MEASUREMENT
/begin MEASUREMENT di_filter_max_val[1] "maximum reached filter value of error code [0 .. 254-1]" UWORD EH_STANDARD_S4_S3 1 100 0 65535 ECU_ADDRESS 0xFFF8A59A /end MEASUREMENT
/begin MEASUREMENT di_filter_max_val[200] "maximum reached filter value of error code [0 .. 254-1]" UWORD EH_STANDARD_S4_S3 1 100 0 65535 ECU_ADDRESS 0xFFF8A728 /end MEASUREMENT
/begin MEASUREMENT di_filter_max_val[201] "maximum reached filter value of error code [0 .. 254-1]" UWORD EH_STANDARD_S4_S3 1 100 0 65535 ECU_ADDRESS 0xFFF8A72A /end MEASUREMENT
/begin MEASUREMENT di_filter_max_val[202] "maximum reached filter value of error code [0 .. 254-1]" UWORD EH_STANDARD_S4_S3 1 100 0 65535 ECU_ADDRESS 0xFFF8A72C /end MEASUREMENT
/begin MEASUREMENT di_filter_max_val[203] "maximum reached filter value of error code [0 .. 254-1]" UWORD EH_STANDARD_S4_S3 1 100 0 65535 ECU_ADDRESS 0xFFF8A72E /end MEASUREMENT
/begin MEASUREMENT di_filter_max_val[204] "maximum reached filter value of error code [0 .. 254-1]" UWORD EH_STANDARD_S4_S3 1 100 0 65535 ECU_ADDRESS 0xFFF8A730 /end MEASUREMENT
/begin MEASUREMENT di_filter_max_val[205] "maximum reached filter value of error code [0 .. 254-1]" UWORD EH_STANDARD_S4_S3 1 100 0 65535 ECU_ADDRESS 0xFFF8A732 /end MEASUREMENT
/begin MEASUREMENT di_filter_max_val[206] "maximum reached filter value of error code [0 .. 254-1]" UWORD EH_STANDARD_S4_S3 1 100 0 65535 ECU_ADDRESS 0xFFF8A734 /end MEASUREMENT
/begin MEASUREMENT di_filter_max_val[207] "maximum reached filter value of error code [0 .. 254-1]" UWORD EH_STANDARD_S4_S3 1 100 0 65535 ECU_ADDRESS 0xFFF8A736 /end MEASUREMENT
/begin MEASUREMENT di_filter_max_val[208] "maximum reached filter value of error code [0 .. 254-1]" UWORD EH_STANDARD_S4_S3 1 100 0 65535 ECU_ADDRESS 0xFFF8A738 /end MEASUREMENT
/begin MEASUREMENT di_filter_max_val[209] "maximum reached filter value of error code [0 .. 254-1]" UWORD EH_STANDARD_S4_S3 1 100 0 65535 ECU_ADDRESS 0xFFF8A73A /end MEASUREMENT
/begin MEASUREMENT di_filter_max_val[20] "maximum reached filter value of error code [0 .. 254-1]" UWORD EH_STANDARD_S4_S3 1 100 0 65535 ECU_ADDRESS 0xFFF8A5C0 /end MEASUREMENT
/begin MEASUREMENT di_filter_max_val[210] "maximum reached filter value of error code [0 .. 254-1]" UWORD EH_STANDARD_S4_S3 1 100 0 65535 ECU_ADDRESS 0xFFF8A73C /end MEASUREMENT
/begin MEASUREMENT di_filter_max_val[211] "maximum reached filter value of error code [0 .. 254-1]" UWORD EH_STANDARD_S4_S3 1 100 0 65535 ECU_ADDRESS 0xFFF8A73E /end MEASUREMENT
/begin MEASUREMENT di_filter_max_val[212] "maximum reached filter value of error code [0 .. 254-1]" UWORD EH_STANDARD_S4_S3 1 100 0 65535 ECU_ADDRESS 0xFFF8A740 /end MEASUREMENT
/begin MEASUREMENT di_filter_max_val[213] "maximum reached filter value of error code [0 .. 254-1]" UWORD EH_STANDARD_S4_S3 1 100 0 65535 ECU_ADDRESS 0xFFF8A742 /end MEASUREMENT
/begin MEASUREMENT di_filter_max_val[214] "maximum reached filter value of error code [0 .. 254-1]" UWORD EH_STANDARD_S4_S3 1 100 0 65535 ECU_ADDRESS 0xFFF8A744 /end MEASUREMENT
/begin MEASUREMENT di_filter_max_val[215] "maximum reached filter value of error code [0 .. 254-1]" UWORD EH_STANDARD_S4_S3 1 100 0 65535 ECU_ADDRESS 0xFFF8A746 /end MEASUREMENT
/begin MEASUREMENT di_filter_max_val[216] "maximum reached filter value of error code [0 .. 254-1]" UWORD EH_STANDARD_S4_S3 1 100 0 65535 ECU_ADDRESS 0xFFF8A748 /end MEASUREMENT
/begin MEASUREMENT di_filter_max_val[217] "maximum reached filter value of error code [0 .. 254-1]" UWORD EH_STANDARD_S4_S3 1 100 0 65535 ECU_ADDRESS 0xFFF8A74A /end MEASUREMENT
/begin MEASUREMENT di_filter_max_val[218] "maximum reached filter value of error code [0 .. 254-1]" UWORD EH_STANDARD_S4_S3 1 100 0 65535 ECU_ADDRESS 0xFFF8A74C /end MEASUREMENT
/begin MEASUREMENT di_filter_max_val[219] "maximum reached filter value of error code [0 .. 254-1]" UWORD EH_STANDARD_S4_S3 1 100 0 65535 ECU_ADDRESS 0xFFF8A74E /end MEASUREMENT
/begin MEASUREMENT di_filter_max_val[21] "maximum reached filter value of error code [0 .. 254-1]" UWORD EH_STANDARD_S4_S3 1 100 0 65535 ECU_ADDRESS 0xFFF8A5C2 /end MEASUREMENT
/begin MEASUREMENT di_filter_max_val[220] "maximum reached filter value of error code [0 .. 254-1]" UWORD EH_STANDARD_S4_S3 1 100 0 65535 ECU_ADDRESS 0xFFF8A750 /end MEASUREMENT
/begin MEASUREMENT di_filter_max_val[221] "maximum reached filter value of error code [0 .. 254-1]" UWORD EH_STANDARD_S4_S3 1 100 0 65535 ECU_ADDRESS 0xFFF8A752 /end MEASUREMENT
/begin MEASUREMENT di_filter_max_val[222] "maximum reached filter value of error code [0 .. 254-1]" UWORD EH_STANDARD_S4_S3 1 100 0 65535 ECU_ADDRESS 0xFFF8A754 /end MEASUREMENT
/begin MEASUREMENT di_filter_max_val[223] "maximum reached filter value of error code [0 .. 254-1]" UWORD EH_STANDARD_S4_S3 1 100 0 65535 ECU_ADDRESS 0xFFF8A756 /end MEASUREMENT
/begin MEASUREMENT di_filter_max_val[224] "maximum reached filter value of error code [0 .. 254-1]" UWORD EH_STANDARD_S4_S3 1 100 0 65535 ECU_ADDRESS 0xFFF8A758 /end MEASUREMENT
/begin MEASUREMENT di_filter_max_val[225] "maximum reached filter value of error code [0 .. 254-1]" UWORD EH_STANDARD_S4_S3 1 100 0 65535 ECU_ADDRESS 0xFFF8A75A /end MEASUREMENT
/begin MEASUREMENT di_filter_max_val[226] "maximum reached filter value of error code [0 .. 254-1]" UWORD EH_STANDARD_S4_S3 1 100 0 65535 ECU_ADDRESS 0xFFF8A75C /end MEASUREMENT
/begin MEASUREMENT di_filter_max_val[227] "maximum reached filter value of error code [0 .. 254-1]" UWORD EH_STANDARD_S4_S3 1 100 0 65535 ECU_ADDRESS 0xFFF8A75E /end MEASUREMENT
/begin MEASUREMENT di_filter_max_val[228] "maximum reached filter value of error code [0 .. 254-1]" UWORD EH_STANDARD_S4_S3 1 100 0 65535 ECU_ADDRESS 0xFFF8A760 /end MEASUREMENT
/begin MEASUREMENT di_filter_max_val[229] "maximum reached filter value of error code [0 .. 254-1]" UWORD EH_STANDARD_S4_S3 1 100 0 65535 ECU_ADDRESS 0xFFF8A762 /end MEASUREMENT
/begin MEASUREMENT di_filter_max_val[22] "maximum reached filter value of error code [0 .. 254-1]" UWORD EH_STANDARD_S4_S3 1 100 0 65535 ECU_ADDRESS 0xFFF8A5C4 /end MEASUREMENT
/begin MEASUREMENT di_filter_max_val[230] "maximum reached filter value of error code [0 .. 254-1]" UWORD EH_STANDARD_S4_S3 1 100 0 65535 ECU_ADDRESS 0xFFF8A764 /end MEASUREMENT
/begin MEASUREMENT di_filter_max_val[231] "maximum reached filter value of error code [0 .. 254-1]" UWORD EH_STANDARD_S4_S3 1 100 0 65535 ECU_ADDRESS 0xFFF8A766 /end MEASUREMENT
/begin MEASUREMENT di_filter_max_val[232] "maximum reached filter value of error code [0 .. 254-1]" UWORD EH_STANDARD_S4_S3 1 100 0 65535 ECU_ADDRESS 0xFFF8A768 /end MEASUREMENT
/begin MEASUREMENT di_filter_max_val[233] "maximum reached filter value of error code [0 .. 254-1]" UWORD EH_STANDARD_S4_S3 1 100 0 65535 ECU_ADDRESS 0xFFF8A76A /end MEASUREMENT
/begin MEASUREMENT di_filter_max_val[234] "maximum reached filter value of error code [0 .. 254-1]" UWORD EH_STANDARD_S4_S3 1 100 0 65535 ECU_ADDRESS 0xFFF8A76C /end MEASUREMENT
/begin MEASUREMENT di_filter_max_val[235] "maximum reached filter value of error code [0 .. 254-1]" UWORD EH_STANDARD_S4_S3 1 100 0 65535 ECU_ADDRESS 0xFFF8A76E /end MEASUREMENT
/begin MEASUREMENT di_filter_max_val[236] "maximum reached filter value of error code [0 .. 254-1]" UWORD EH_STANDARD_S4_S3 1 100 0 65535 ECU_ADDRESS 0xFFF8A770 /end MEASUREMENT
/begin MEASUREMENT di_filter_max_val[237] "maximum reached filter value of error code [0 .. 254-1]" UWORD EH_STANDARD_S4_S3 1 100 0 65535 ECU_ADDRESS 0xFFF8A772 /end MEASUREMENT
/begin MEASUREMENT di_filter_max_val[238] "maximum reached filter value of error code [0 .. 254-1]" UWORD EH_STANDARD_S4_S3 1 100 0 65535 ECU_ADDRESS 0xFFF8A774 /end MEASUREMENT
/begin MEASUREMENT di_filter_max_val[239] "maximum reached filter value of error code [0 .. 254-1]" UWORD EH_STANDARD_S4_S3 1 100 0 65535 ECU_ADDRESS 0xFFF8A776 /end MEASUREMENT
/begin MEASUREMENT di_filter_max_val[23] "maximum reached filter value of error code [0 .. 254-1]" UWORD EH_STANDARD_S4_S3 1 100 0 65535 ECU_ADDRESS 0xFFF8A5C6 /end MEASUREMENT
/begin MEASUREMENT di_filter_max_val[240] "maximum reached filter value of error code [0 .. 254-1]" UWORD EH_STANDARD_S4_S3 1 100 0 65535 ECU_ADDRESS 0xFFF8A778 /end MEASUREMENT
/begin MEASUREMENT di_filter_max_val[241] "maximum reached filter value of error code [0 .. 254-1]" UWORD EH_STANDARD_S4_S3 1 100 0 65535 ECU_ADDRESS 0xFFF8A77A /end MEASUREMENT
/begin MEASUREMENT di_filter_max_val[242] "maximum reached filter value of error code [0 .. 254-1]" UWORD EH_STANDARD_S4_S3 1 100 0 65535 ECU_ADDRESS 0xFFF8A77C /end MEASUREMENT
/begin MEASUREMENT di_filter_max_val[243] "maximum reached filter value of error code [0 .. 254-1]" UWORD EH_STANDARD_S4_S3 1 100 0 65535 ECU_ADDRESS 0xFFF8A77E /end MEASUREMENT
/begin MEASUREMENT di_filter_max_val[244] "maximum reached filter value of error code [0 .. 254-1]" UWORD EH_STANDARD_S4_S3 1 100 0 65535 ECU_ADDRESS 0xFFF8A780 /end MEASUREMENT
/begin MEASUREMENT di_filter_max_val[245] "maximum reached filter value of error code [0 .. 254-1]" UWORD EH_STANDARD_S4_S3 1 100 0 65535 ECU_ADDRESS 0xFFF8A782 /end MEASUREMENT
/begin MEASUREMENT di_filter_max_val[246] "maximum reached filter value of error code [0 .. 254-1]" UWORD EH_STANDARD_S4_S3 1 100 0 65535 ECU_ADDRESS 0xFFF8A784 /end MEASUREMENT
/begin MEASUREMENT di_filter_max_val[247] "maximum reached filter value of error code [0 .. 254-1]" UWORD EH_STANDARD_S4_S3 1 100 0 65535 ECU_ADDRESS 0xFFF8A786 /end MEASUREMENT
/begin MEASUREMENT di_filter_max_val[248] "maximum reached filter value of error code [0 .. 254-1]" UWORD EH_STANDARD_S4_S3 1 100 0 65535 ECU_ADDRESS 0xFFF8A788 /end MEASUREMENT
/begin MEASUREMENT di_filter_max_val[249] "maximum reached filter value of error code [0 .. 254-1]" UWORD EH_STANDARD_S4_S3 1 100 0 65535 ECU_ADDRESS 0xFFF8A78A /end MEASUREMENT
/begin MEASUREMENT di_filter_max_val[24] "maximum reached filter value of error code [0 .. 254-1]" UWORD EH_STANDARD_S4_S3 1 100 0 65535 ECU_ADDRESS 0xFFF8A5C8 /end MEASUREMENT
/begin MEASUREMENT di_filter_max_val[250] "maximum reached filter value of error code [0 .. 254-1]" UWORD EH_STANDARD_S4_S3 1 100 0 65535 ECU_ADDRESS 0xFFF8A78C /end MEASUREMENT
/begin MEASUREMENT di_filter_max_val[251] "maximum reached filter value of error code [0 .. 254-1]" UWORD EH_STANDARD_S4_S3 1 100 0 65535 ECU_ADDRESS 0xFFF8A78E /end MEASUREMENT
/begin MEASUREMENT di_filter_max_val[252] "maximum reached filter value of error code [0 .. 254-1]" UWORD EH_STANDARD_S4_S3 1 100 0 65535 ECU_ADDRESS 0xFFF8A790 /end MEASUREMENT
/begin MEASUREMENT di_filter_max_val[253] "maximum reached filter value of error code [0 .. 254-1]" UWORD EH_STANDARD_S4_S3 1 100 0 65535 ECU_ADDRESS 0xFFF8A792 /end MEASUREMENT
/begin MEASUREMENT di_filter_max_val[25] "maximum reached filter value of error code [0 .. 254-1]" UWORD EH_STANDARD_S4_S3 1 100 0 65535 ECU_ADDRESS 0xFFF8A5CA /end MEASUREMENT
/begin MEASUREMENT di_filter_max_val[26] "maximum reached filter value of error code [0 .. 254-1]" UWORD EH_STANDARD_S4_S3 1 100 0 65535 ECU_ADDRESS 0xFFF8A5CC /end MEASUREMENT
/begin MEASUREMENT di_filter_max_val[27] "maximum reached filter value of error code [0 .. 254-1]" UWORD EH_STANDARD_S4_S3 1 100 0 65535 ECU_ADDRESS 0xFFF8A5CE /end MEASUREMENT
/begin MEASUREMENT di_filter_max_val[28] "maximum reached filter value of error code [0 .. 254-1]" UWORD EH_STANDARD_S4_S3 1 100 0 65535 ECU_ADDRESS 0xFFF8A5D0 /end MEASUREMENT
/begin MEASUREMENT di_filter_max_val[29] "maximum reached filter value of error code [0 .. 254-1]" UWORD EH_STANDARD_S4_S3 1 100 0 65535 ECU_ADDRESS 0xFFF8A5D2 /end MEASUREMENT
/begin MEASUREMENT di_filter_max_val[2] "maximum reached filter value of error code [0 .. 254-1]" UWORD EH_STANDARD_S4_S3 1 100 0 65535 ECU_ADDRESS 0xFFF8A59C /end MEASUREMENT
/begin MEASUREMENT di_filter_max_val[30] "maximum reached filter value of error code [0 .. 254-1]" UWORD EH_STANDARD_S4_S3 1 100 0 65535 ECU_ADDRESS 0xFFF8A5D4 /end MEASUREMENT
/begin MEASUREMENT di_filter_max_val[31] "maximum reached filter value of error code [0 .. 254-1]" UWORD EH_STANDARD_S4_S3 1 100 0 65535 ECU_ADDRESS 0xFFF8A5D6 /end MEASUREMENT
/begin MEASUREMENT di_filter_max_val[32] "maximum reached filter value of error code [0 .. 254-1]" UWORD EH_STANDARD_S4_S3 1 100 0 65535 ECU_ADDRESS 0xFFF8A5D8 /end MEASUREMENT
/begin MEASUREMENT di_filter_max_val[33] "maximum reached filter value of error code [0 .. 254-1]" UWORD EH_STANDARD_S4_S3 1 100 0 65535 ECU_ADDRESS 0xFFF8A5DA /end MEASUREMENT
/begin MEASUREMENT di_filter_max_val[34] "maximum reached filter value of error code [0 .. 254-1]" UWORD EH_STANDARD_S4_S3 1 100 0 65535 ECU_ADDRESS 0xFFF8A5DC /end MEASUREMENT
/begin MEASUREMENT di_filter_max_val[35] "maximum reached filter value of error code [0 .. 254-1]" UWORD EH_STANDARD_S4_S3 1 100 0 65535 ECU_ADDRESS 0xFFF8A5DE /end MEASUREMENT
/begin MEASUREMENT di_filter_max_val[36] "maximum reached filter value of error code [0 .. 254-1]" UWORD EH_STANDARD_S4_S3 1 100 0 65535 ECU_ADDRESS 0xFFF8A5E0 /end MEASUREMENT
/begin MEASUREMENT di_filter_max_val[37] "maximum reached filter value of error code [0 .. 254-1]" UWORD EH_STANDARD_S4_S3 1 100 0 65535 ECU_ADDRESS 0xFFF8A5E2 /end MEASUREMENT
/begin MEASUREMENT di_filter_max_val[38] "maximum reached filter value of error code [0 .. 254-1]" UWORD EH_STANDARD_S4_S3 1 100 0 65535 ECU_ADDRESS 0xFFF8A5E4 /end MEASUREMENT
/begin MEASUREMENT di_filter_max_val[39] "maximum reached filter value of error code [0 .. 254-1]" UWORD EH_STANDARD_S4_S3 1 100 0 65535 ECU_ADDRESS 0xFFF8A5E6 /end MEASUREMENT
/begin MEASUREMENT di_filter_max_val[3] "maximum reached filter value of error code [0 .. 254-1]" UWORD EH_STANDARD_S4_S3 1 100 0 65535 ECU_ADDRESS 0xFFF8A59E /end MEASUREMENT
/begin MEASUREMENT di_filter_max_val[40] "maximum reached filter value of error code [0 .. 254-1]" UWORD EH_STANDARD_S4_S3 1 100 0 65535 ECU_ADDRESS 0xFFF8A5E8 /end MEASUREMENT
/begin MEASUREMENT di_filter_max_val[41] "maximum reached filter value of error code [0 .. 254-1]" UWORD EH_STANDARD_S4_S3 1 100 0 65535 ECU_ADDRESS 0xFFF8A5EA /end MEASUREMENT
/begin MEASUREMENT di_filter_max_val[42] "maximum reached filter value of error code [0 .. 254-1]" UWORD EH_STANDARD_S4_S3 1 100 0 65535 ECU_ADDRESS 0xFFF8A5EC /end MEASUREMENT
/begin MEASUREMENT di_filter_max_val[43] "maximum reached filter value of error code [0 .. 254-1]" UWORD EH_STANDARD_S4_S3 1 100 0 65535 ECU_ADDRESS 0xFFF8A5EE /end MEASUREMENT
/begin MEASUREMENT di_filter_max_val[44] "maximum reached filter value of error code [0 .. 254-1]" UWORD EH_STANDARD_S4_S3 1 100 0 65535 ECU_ADDRESS 0xFFF8A5F0 /end MEASUREMENT
/begin MEASUREMENT di_filter_max_val[45] "maximum reached filter value of error code [0 .. 254-1]" UWORD EH_STANDARD_S4_S3 1 100 0 65535 ECU_ADDRESS 0xFFF8A5F2 /end MEASUREMENT
/begin MEASUREMENT di_filter_max_val[46] "maximum reached filter value of error code [0 .. 254-1]" UWORD EH_STANDARD_S4_S3 1 100 0 65535 ECU_ADDRESS 0xFFF8A5F4 /end MEASUREMENT
/begin MEASUREMENT di_filter_max_val[47] "maximum reached filter value of error code [0 .. 254-1]" UWORD EH_STANDARD_S4_S3 1 100 0 65535 ECU_ADDRESS 0xFFF8A5F6 /end MEASUREMENT
/begin MEASUREMENT di_filter_max_val[48] "maximum reached filter value of error code [0 .. 254-1]" UWORD EH_STANDARD_S4_S3 1 100 0 65535 ECU_ADDRESS 0xFFF8A5F8 /end MEASUREMENT
/begin MEASUREMENT di_filter_max_val[49] "maximum reached filter value of error code [0 .. 254-1]" UWORD EH_STANDARD_S4_S3 1 100 0 65535 ECU_ADDRESS 0xFFF8A5FA /end MEASUREMENT
/begin MEASUREMENT di_filter_max_val[4] "maximum reached filter value of error code [0 .. 254-1]" UWORD EH_STANDARD_S4_S3 1 100 0 65535 ECU_ADDRESS 0xFFF8A5A0 /end MEASUREMENT
/begin MEASUREMENT di_filter_max_val[50] "maximum reached filter value of error code [0 .. 254-1]" UWORD EH_STANDARD_S4_S3 1 100 0 65535 ECU_ADDRESS 0xFFF8A5FC /end MEASUREMENT
/begin MEASUREMENT di_filter_max_val[51] "maximum reached filter value of error code [0 .. 254-1]" UWORD EH_STANDARD_S4_S3 1 100 0 65535 ECU_ADDRESS 0xFFF8A5FE /end MEASUREMENT
/begin MEASUREMENT di_filter_max_val[52] "maximum reached filter value of error code [0 .. 254-1]" UWORD EH_STANDARD_S4_S3 1 100 0 65535 ECU_ADDRESS 0xFFF8A600 /end MEASUREMENT
/begin MEASUREMENT di_filter_max_val[53] "maximum reached filter value of error code [0 .. 254-1]" UWORD EH_STANDARD_S4_S3 1 100 0 65535 ECU_ADDRESS 0xFFF8A602 /end MEASUREMENT
/begin MEASUREMENT di_filter_max_val[54] "maximum reached filter value of error code [0 .. 254-1]" UWORD EH_STANDARD_S4_S3 1 100 0 65535 ECU_ADDRESS 0xFFF8A604 /end MEASUREMENT
/begin MEASUREMENT di_filter_max_val[55] "maximum reached filter value of error code [0 .. 254-1]" UWORD EH_STANDARD_S4_S3 1 100 0 65535 ECU_ADDRESS 0xFFF8A606 /end MEASUREMENT
/begin MEASUREMENT di_filter_max_val[56] "maximum reached filter value of error code [0 .. 254-1]" UWORD EH_STANDARD_S4_S3 1 100 0 65535 ECU_ADDRESS 0xFFF8A608 /end MEASUREMENT
/begin MEASUREMENT di_filter_max_val[57] "maximum reached filter value of error code [0 .. 254-1]" UWORD EH_STANDARD_S4_S3 1 100 0 65535 ECU_ADDRESS 0xFFF8A60A /end MEASUREMENT
/begin MEASUREMENT di_filter_max_val[58] "maximum reached filter value of error code [0 .. 254-1]" UWORD EH_STANDARD_S4_S3 1 100 0 65535 ECU_ADDRESS 0xFFF8A60C /end MEASUREMENT
/begin MEASUREMENT di_filter_max_val[59] "maximum reached filter value of error code [0 .. 254-1]" UWORD EH_STANDARD_S4_S3 1 100 0 65535 ECU_ADDRESS 0xFFF8A60E /end MEASUREMENT
/begin MEASUREMENT di_filter_max_val[5] "maximum reached filter value of error code [0 .. 254-1]" UWORD EH_STANDARD_S4_S3 1 100 0 65535 ECU_ADDRESS 0xFFF8A5A2 /end MEASUREMENT
/begin MEASUREMENT di_filter_max_val[60] "maximum reached filter value of error code [0 .. 254-1]" UWORD EH_STANDARD_S4_S3 1 100 0 65535 ECU_ADDRESS 0xFFF8A610 /end MEASUREMENT
/begin MEASUREMENT di_filter_max_val[61] "maximum reached filter value of error code [0 .. 254-1]" UWORD EH_STANDARD_S4_S3 1 100 0 65535 ECU_ADDRESS 0xFFF8A612 /end MEASUREMENT
/begin MEASUREMENT di_filter_max_val[62] "maximum reached filter value of error code [0 .. 254-1]" UWORD EH_STANDARD_S4_S3 1 100 0 65535 ECU_ADDRESS 0xFFF8A614 /end MEASUREMENT
/begin MEASUREMENT di_filter_max_val[63] "maximum reached filter value of error code [0 .. 254-1]" UWORD EH_STANDARD_S4_S3 1 100 0 65535 ECU_ADDRESS 0xFFF8A616 /end MEASUREMENT
/begin MEASUREMENT di_filter_max_val[64] "maximum reached filter value of error code [0 .. 254-1]" UWORD EH_STANDARD_S4_S3 1 100 0 65535 ECU_ADDRESS 0xFFF8A618 /end MEASUREMENT
/begin MEASUREMENT di_filter_max_val[65] "maximum reached filter value of error code [0 .. 254-1]" UWORD EH_STANDARD_S4_S3 1 100 0 65535 ECU_ADDRESS 0xFFF8A61A /end MEASUREMENT
/begin MEASUREMENT di_filter_max_val[66] "maximum reached filter value of error code [0 .. 254-1]" UWORD EH_STANDARD_S4_S3 1 100 0 65535 ECU_ADDRESS 0xFFF8A61C /end MEASUREMENT
/begin MEASUREMENT di_filter_max_val[67] "maximum reached filter value of error code [0 .. 254-1]" UWORD EH_STANDARD_S4_S3 1 100 0 65535 ECU_ADDRESS 0xFFF8A61E /end MEASUREMENT
/begin MEASUREMENT di_filter_max_val[68] "maximum reached filter value of error code [0 .. 254-1]" UWORD EH_STANDARD_S4_S3 1 100 0 65535 ECU_ADDRESS 0xFFF8A620 /end MEASUREMENT
/begin MEASUREMENT di_filter_max_val[69] "maximum reached filter value of error code [0 .. 254-1]" UWORD EH_STANDARD_S4_S3 1 100 0 65535 ECU_ADDRESS 0xFFF8A622 /end MEASUREMENT
/begin MEASUREMENT di_filter_max_val[6] "maximum reached filter value of error code [0 .. 254-1]" UWORD EH_STANDARD_S4_S3 1 100 0 65535 ECU_ADDRESS 0xFFF8A5A4 /end MEASUREMENT
/begin MEASUREMENT di_filter_max_val[70] "maximum reached filter value of error code [0 .. 254-1]" UWORD EH_STANDARD_S4_S3 1 100 0 65535 ECU_ADDRESS 0xFFF8A624 /end MEASUREMENT
/begin MEASUREMENT di_filter_max_val[71] "maximum reached filter value of error code [0 .. 254-1]" UWORD EH_STANDARD_S4_S3 1 100 0 65535 ECU_ADDRESS 0xFFF8A626 /end MEASUREMENT
/begin MEASUREMENT di_filter_max_val[72] "maximum reached filter value of error code [0 .. 254-1]" UWORD EH_STANDARD_S4_S3 1 100 0 65535 ECU_ADDRESS 0xFFF8A628 /end MEASUREMENT
/begin MEASUREMENT di_filter_max_val[73] "maximum reached filter value of error code [0 .. 254-1]" UWORD EH_STANDARD_S4_S3 1 100 0 65535 ECU_ADDRESS 0xFFF8A62A /end MEASUREMENT
/begin MEASUREMENT di_filter_max_val[74] "maximum reached filter value of error code [0 .. 254-1]" UWORD EH_STANDARD_S4_S3 1 100 0 65535 ECU_ADDRESS 0xFFF8A62C /end MEASUREMENT
/begin MEASUREMENT di_filter_max_val[75] "maximum reached filter value of error code [0 .. 254-1]" UWORD EH_STANDARD_S4_S3 1 100 0 65535 ECU_ADDRESS 0xFFF8A62E /end MEASUREMENT
/begin MEASUREMENT di_filter_max_val[76] "maximum reached filter value of error code [0 .. 254-1]" UWORD EH_STANDARD_S4_S3 1 100 0 65535 ECU_ADDRESS 0xFFF8A630 /end MEASUREMENT
/begin MEASUREMENT di_filter_max_val[77] "maximum reached filter value of error code [0 .. 254-1]" UWORD EH_STANDARD_S4_S3 1 100 0 65535 ECU_ADDRESS 0xFFF8A632 /end MEASUREMENT
/begin MEASUREMENT di_filter_max_val[78] "maximum reached filter value of error code [0 .. 254-1]" UWORD EH_STANDARD_S4_S3 1 100 0 65535 ECU_ADDRESS 0xFFF8A634 /end MEASUREMENT
/begin MEASUREMENT di_filter_max_val[79] "maximum reached filter value of error code [0 .. 254-1]" UWORD EH_STANDARD_S4_S3 1 100 0 65535 ECU_ADDRESS 0xFFF8A636 /end MEASUREMENT
/begin MEASUREMENT di_filter_max_val[7] "maximum reached filter value of error code [0 .. 254-1]" UWORD EH_STANDARD_S4_S3 1 100 0 65535 ECU_ADDRESS 0xFFF8A5A6 /end MEASUREMENT
/begin MEASUREMENT di_filter_max_val[80] "maximum reached filter value of error code [0 .. 254-1]" UWORD EH_STANDARD_S4_S3 1 100 0 65535 ECU_ADDRESS 0xFFF8A638 /end MEASUREMENT
/begin MEASUREMENT di_filter_max_val[81] "maximum reached filter value of error code [0 .. 254-1]" UWORD EH_STANDARD_S4_S3 1 100 0 65535 ECU_ADDRESS 0xFFF8A63A /end MEASUREMENT
/begin MEASUREMENT di_filter_max_val[82] "maximum reached filter value of error code [0 .. 254-1]" UWORD EH_STANDARD_S4_S3 1 100 0 65535 ECU_ADDRESS 0xFFF8A63C /end MEASUREMENT
/begin MEASUREMENT di_filter_max_val[83] "maximum reached filter value of error code [0 .. 254-1]" UWORD EH_STANDARD_S4_S3 1 100 0 65535 ECU_ADDRESS 0xFFF8A63E /end MEASUREMENT
/begin MEASUREMENT di_filter_max_val[84] "maximum reached filter value of error code [0 .. 254-1]" UWORD EH_STANDARD_S4_S3 1 100 0 65535 ECU_ADDRESS 0xFFF8A640 /end MEASUREMENT
/begin MEASUREMENT di_filter_max_val[85] "maximum reached filter value of error code [0 .. 254-1]" UWORD EH_STANDARD_S4_S3 1 100 0 65535 ECU_ADDRESS 0xFFF8A642 /end MEASUREMENT
/begin MEASUREMENT di_filter_max_val[86] "maximum reached filter value of error code [0 .. 254-1]" UWORD EH_STANDARD_S4_S3 1 100 0 65535 ECU_ADDRESS 0xFFF8A644 /end MEASUREMENT
/begin MEASUREMENT di_filter_max_val[87] "maximum reached filter value of error code [0 .. 254-1]" UWORD EH_STANDARD_S4_S3 1 100 0 65535 ECU_ADDRESS 0xFFF8A646 /end MEASUREMENT
/begin MEASUREMENT di_filter_max_val[88] "maximum reached filter value of error code [0 .. 254-1]" UWORD EH_STANDARD_S4_S3 1 100 0 65535 ECU_ADDRESS 0xFFF8A648 /end MEASUREMENT
/begin MEASUREMENT di_filter_max_val[89] "maximum reached filter value of error code [0 .. 254-1]" UWORD EH_STANDARD_S4_S3 1 100 0 65535 ECU_ADDRESS 0xFFF8A64A /end MEASUREMENT
/begin MEASUREMENT di_filter_max_val[8] "maximum reached filter value of error code [0 .. 254-1]" UWORD EH_STANDARD_S4_S3 1 100 0 65535 ECU_ADDRESS 0xFFF8A5A8 /end MEASUREMENT
/begin MEASUREMENT di_filter_max_val[90] "maximum reached filter value of error code [0 .. 254-1]" UWORD EH_STANDARD_S4_S3 1 100 0 65535 ECU_ADDRESS 0xFFF8A64C /end MEASUREMENT
/begin MEASUREMENT di_filter_max_val[91] "maximum reached filter value of error code [0 .. 254-1]" UWORD EH_STANDARD_S4_S3 1 100 0 65535 ECU_ADDRESS 0xFFF8A64E /end MEASUREMENT
/begin MEASUREMENT di_filter_max_val[92] "maximum reached filter value of error code [0 .. 254-1]" UWORD EH_STANDARD_S4_S3 1 100 0 65535 ECU_ADDRESS 0xFFF8A650 /end MEASUREMENT
/begin MEASUREMENT di_filter_max_val[93] "maximum reached filter value of error code [0 .. 254-1]" UWORD EH_STANDARD_S4_S3 1 100 0 65535 ECU_ADDRESS 0xFFF8A652 /end MEASUREMENT
/begin MEASUREMENT di_filter_max_val[94] "maximum reached filter value of error code [0 .. 254-1]" UWORD EH_STANDARD_S4_S3 1 100 0 65535 ECU_ADDRESS 0xFFF8A654 /end MEASUREMENT
/begin MEASUREMENT di_filter_max_val[95] "maximum reached filter value of error code [0 .. 254-1]" UWORD EH_STANDARD_S4_S3 1 100 0 65535 ECU_ADDRESS 0xFFF8A656 /end MEASUREMENT
/begin MEASUREMENT di_filter_max_val[96] "maximum reached filter value of error code [0 .. 254-1]" UWORD EH_STANDARD_S4_S3 1 100 0 65535 ECU_ADDRESS 0xFFF8A658 /end MEASUREMENT
/begin MEASUREMENT di_filter_max_val[97] "maximum reached filter value of error code [0 .. 254-1]" UWORD EH_STANDARD_S4_S3 1 100 0 65535 ECU_ADDRESS 0xFFF8A65A /end MEASUREMENT
/begin MEASUREMENT di_filter_max_val[98] "maximum reached filter value of error code [0 .. 254-1]" UWORD EH_STANDARD_S4_S3 1 100 0 65535 ECU_ADDRESS 0xFFF8A65C /end MEASUREMENT
/begin MEASUREMENT di_filter_max_val[99] "maximum reached filter value of error code [0 .. 254-1]" UWORD EH_STANDARD_S4_S3 1 100 0 65535 ECU_ADDRESS 0xFFF8A65E /end MEASUREMENT
/begin MEASUREMENT di_filter_max_val[9] "maximum reached filter value of error code [0 .. 254-1]" UWORD EH_STANDARD_S4_S3 1 100 0 65535 ECU_ADDRESS 0xFFF8A5AA /end MEASUREMENT
/begin MEASUREMENT di_obd_norm_trip_B "OBD norm trip B for erasing permanent faults (0=norm trip B does not exist 1=norm trip B exists)" UBYTE EH_STANDARD_S4_S3 1 100 0 255 ECU_ADDRESS 0xFFF89427 /end MEASUREMENT
/begin MEASUREMENT di_obd_vehicleIdleTime "vehicle idle time for erasing permanent faults" UWORD EH_T_1S_S4_S3 1 100 0 65535 ECU_ADDRESS 0xFFF8D6A6 /end MEASUREMENT
/begin MEASUREMENT di_obd_vehicleOperationTime "vehicle operation time for erasing permanent faults" UWORD EH_T_1S_S4_S3 1 100 0 65535 ECU_ADDRESS 0xFFF8D6A2 /end MEASUREMENT
/begin MEASUREMENT drehz_anhebung_has "Flags zur Aktivierung der Drehzahlanhebung HAS" UBYTE UMR___1_1_0_S5_S3 1 100 0 1 BIT_MASK 0x1 ECU_ADDRESS 0xFFF893CD /end MEASUREMENT
/begin MEASUREMENT f_min_emdrehzahl_iae "Flags zur Aktivierung der EM-Drehzahlanhebung IAE" UBYTE UMR___1_1_0_S5_S3 1 100 0 1 BIT_MASK 0x1 ECU_ADDRESS 0xFFF893CF /end MEASUREMENT
/begin MEASUREMENT hochtemp_betrieb_sps "Hochtemperaturbetieb Schaltpunktsteuerung anfordern" UBYTE UMR___1_1_0_S5_S3 1 100 0 2 ECU_ADDRESS 0xFFF893CC /end MEASUREMENT
/begin MEASUREMENT iAdaGlast.adaps_status "Anzeigegroesse Ablauf Schaltdruckadaption" UWORD Conv.cAdaGlast._.adaps_status_S5_S3 1 100 400 499 ECU_ADDRESS 0xFFF8B07A DISPLAY_IDENTIFIER adaps_status.iAdaGlast /end MEASUREMENT
/begin MEASUREMENT iAdaGlast.bew_kennfeld "welches Kennfeld wird von GLS-ADA beschrieben" UBYTE Conv.cAdaGlast._.bew_kennfeld_S5_S3 1 100 0 2 ECU_ADDRESS 0xFFF8B083 DISPLAY_IDENTIFIER bew_kennfeld.iAdaGlast /end MEASUREMENT
/begin MEASUREMENT iAdaGlast.bew_kennfeld_lesen "aus welchem Kennfeld wird von GLS-ADA gelesen" UBYTE Conv.cAdaGlast._.bew_kennfeld_lesen_S5_S3 1 100 0 2 ECU_ADDRESS 0xFFF8B084 DISPLAY_IDENTIFIER bew_kennfeld_lesen.iAdaGlast /end MEASUREMENT
/begin MEASUREMENT iAdaGlast.bew_kup "Kupplung die beobachtet/bewertet wird" UBYTE Conv.cAdaGlast._.bew_kup_S5_S3 1 100 0 5 ECU_ADDRESS 0xFFF8B080 DISPLAY_IDENTIFIER bew_kup.iAdaGlast /end MEASUREMENT
/begin MEASUREMENT iAdaGlast.bew_schaltcode "Schaltcode innerhalb des aktuellen Schalttyps fuer GLS-Adaption" UBYTE UMR___1_1_0_S5_S3 1 100 0 7 ECU_ADDRESS 0xFFF8B081 DISPLAY_IDENTIFIER bew_schaltcode.iAdaGlast /end MEASUREMENT
/begin MEASUREMENT iAdaGlast.bew_schaltcode_lesen "Schaltcode innerhalb des aktuellen Schalttyps fuer GLS-Adaption beim Lesen" UBYTE UMR___1_1_0_S5_S3 1 100 0 7 ECU_ADDRESS 0xFFF8B082 DISPLAY_IDENTIFIER bew_schaltcode_lesen.iAdaGlast /end MEASUREMENT
/begin MEASUREMENT iAdaGlast.bew_schalttyp "Typ der Schaltung aus Sicht GLS-Ada" UBYTE Conv.cAdaGlast._.bew_schalttyp_S5_S3 1 100 0 4 ECU_ADDRESS 0xFFF8B085 DISPLAY_IDENTIFIER bew_schalttyp.iAdaGlast /end MEASUREMENT
/begin MEASUREMENT iAdaGlast.bew_schalttyp_lesen "Typ der Schaltung aus Sicht GLS-Ada beim Lesezugriff" UBYTE Conv.cAdaGlast._.bew_schalttyp_lesen_S5_S3 1 100 0 4 ECU_ADDRESS 0xFFF8B086 DISPLAY_IDENTIFIER bew_schalttyp_lesen.iAdaGlast /end MEASUREMENT
/begin MEASUREMENT iAdaGlast.con_cycle_count "Zaehler fuer GLS-Reglertakte" UWORD UMR___1_1_0_S5_S3 1 100 0 65535 ECU_ADDRESS 0xFFF8B090 DISPLAY_IDENTIFIER con_cycle_count.iAdaGlast /end MEASUREMENT
/begin MEASUREMENT iAdaGlast.dki_abbrschwelle "DKI-Schwelle Adaptionsabbruch" UBYTE UMR_PROZENT__20_51_0_S5_S3 1 100 0 100 ECU_ADDRESS 0xFFF8B088 DISPLAY_IDENTIFIER dki_abbrschwelle.iAdaGlast /end MEASUREMENT
/begin MEASUREMENT iAdaGlast.f_e_fahren_aktiv_schaltbeginn "Flag e_fahren_aktiv zu Schaltbeginn" UBYTE UMR___1_1_0_S5_S3 1 100 0 1 ECU_ADDRESS 0xFFF8B095 DISPLAY_IDENTIFIER f_e_fahren_aktiv_schaltbeginn.iAdaGlast /end MEASUREMENT
/begin MEASUREMENT iAdaGlast.gls_ada_state "gls_ada_state" UBYTE Conv.cAdaGlast._.gls_ada_state_S5_S3 1 100 1 8 ECU_ADDRESS 0xFFF8B099 DISPLAY_IDENTIFIER gls_ada_state.iAdaGlast /end MEASUREMENT
/begin MEASUREMENT iAdaGlast.gls_adbr "Adaptionsbereich der GLS-Adaption" SWORD UMR___1_1_0_S5_S3 1 100 0 1170 ECU_ADDRESS 0xFFF8B078 DISPLAY_IDENTIFIER gls_adbr.iAdaGlast /end MEASUREMENT
/begin MEASUREMENT iAdaGlast.gls_dki_schaltbeginn "DKI zu Schaltbeginn" UBYTE UMR_PROZENT__20_51_0_S5_S3 1 100 0 100 ECU_ADDRESS 0xFFF8B094 DISPLAY_IDENTIFIER gls_dki_schaltbeginn.iAdaGlast /end MEASUREMENT
/begin MEASUREMENT iAdaGlast.gls_flag_abbruch_wg_adapfn "Flag fuer Abbruch GLS-Ada wegen PF-HS-Ada" UBYTE Conv.cAdaGlast._.gls_flag_abbruch_wg_adapfn_S5_S3 1 100 0 1 BIT_MASK 0x1 ECU_ADDRESS 0xFFF8B076 DISPLAY_IDENTIFIER gls_flag_abbruch_wg_adapfn.iAdaGlast /end MEASUREMENT
/begin MEASUREMENT iAdaGlast.gls_trimm_gang "eine Vorgabegang Beeinflussung durch die GLS-Trimm Funktion wird auf dieser Messgroesse angezeigt" SBYTE Conv.cAdaGlast._.gls_trimm_gang_S5_S3 1 100 -1 8 ECU_ADDRESS 0xFFF8B096 DISPLAY_IDENTIFIER gls_trimm_gang.iAdaGlast /end MEASUREMENT
/begin MEASUREMENT iAdaGlast.gls_trimm_spont_beeinflussung "Beeinflussung der Spontanitaet durch GLS Trimm Funktion" UBYTE Conv.cAdaGlast._.gls_trimm_spont_beeinflussung_S5_S3 1 100 0 1 BIT_MASK 0x1 ECU_ADDRESS 0xFFF8B098 DISPLAY_IDENTIFIER gls_trimm_spont_beeinflussung.iAdaGlast /end MEASUREMENT
/begin MEASUREMENT iAdaGlast.gls_trimm_verbot_versch_rs "Verbot von verschachtelten RS durch GLS Trimm Funktion" UBYTE Conv.cAdaGlast._.gls_trimm_verbot_versch_rs_S5_S3 1 100 0 1 BIT_MASK 0x1 ECU_ADDRESS 0xFFF8B097 DISPLAY_IDENTIFIER gls_trimm_verbot_versch_rs.iAdaGlast /end MEASUREMENT
/begin MEASUREMENT iAdaGlast.glsbew_fuer_adbr "Merker f. zu bewertende Adbr" SWORD UMR___1_1_0_S5_S3 1 100 -32768 32767 ECU_ADDRESS 0xFFF8B092 DISPLAY_IDENTIFIER glsbew_fuer_adbr.iAdaGlast /end MEASUREMENT
/begin MEASUREMENT iAdaGlast.n_tsyn_gls "n_tsyn als Eingangsgroesse in GLS-Bewertungs-KF" SWORD UMR_U_MIN_1_1_0_S5_S3 1 100 0 8200 ECU_ADDRESS 0xFFF8B07E DISPLAY_IDENTIFIER n_tsyn_gls.iAdaGlast /end MEASUREMENT
/begin MEASUREMENT iAdaGlast.pgls_speicher "Regelflaeche der GLS" SLONG UMR___1_1_0_S5_S3 1 100 -2147483648 2147483647 ECU_ADDRESS 0xFFF8B08C DISPLAY_IDENTIFIER pgls_speicher.iAdaGlast /end MEASUREMENT
/begin MEASUREMENT iAdaGlast.pm_gls "mittlere Regeleingriff" SWORD UMR_BAR__1_100_0_S5_S3 1 100 -1.25 1.25 ECU_ADDRESS 0xFFF8B07C DISPLAY_IDENTIFIER pm_gls.iAdaGlast /end MEASUREMENT
/begin MEASUREMENT iAdaGlast.ps_adadruck "Ausgegebener Adaptionsschaltdruck" SWORD UMR_BAR__1_1000_0_S5_S3 1 100 -1.25 1.25 ECU_ADDRESS 0xFFF8B074 DISPLAY_IDENTIFIER ps_adadruck.iAdaGlast /end MEASUREMENT
/begin MEASUREMENT iAdaGlast.status_ausgabe_verzoegern "status_ausgabe_verzoegern" UBYTE Conv.cAdaGlast._.status_ausgabe_verzoegern_S5_S3 1 100 0 1 BIT_MASK 0x1 ECU_ADDRESS 0xFFF8B087 DISPLAY_IDENTIFIER status_ausgabe_verzoegern.iAdaGlast /end MEASUREMENT
/begin MEASUREMENT iAdaGloku.kup_beeinfluss_ada_delta_wert "interne Groesse fuer Beeinflussungsadaption" SWORD UMR___1_1_0_S5_S3 1 100 -32768 32767 ECU_ADDRESS 0xFFF8D6D0 DISPLAY_IDENTIFIER kup_beeinfluss_ada_delta_wert.iAdaGloku /end MEASUREMENT
/begin MEASUREMENT iAdaGloku.kup_beeinfluss_ada_typ "interne Groesse fuer Beeinflussungsadaption" UBYTE UMR___1_1_0_S5_S3 1 100 0 255 ECU_ADDRESS 0xFFF8D6D2 DISPLAY_IDENTIFIER kup_beeinfluss_ada_typ.iAdaGloku /end MEASUREMENT
/begin MEASUREMENT iAdaGloku.kup_beeinfluss_d_ada_wert "delta-Wert, der mit Faktor versehen in BE-ADAs eingeht" SWORD UMR_BAR__1_1000_0_S5_S3 1 100 -32.768 32.767 ECU_ADDRESS 0xFFF8D6CC DISPLAY_IDENTIFIER kup_beeinfluss_d_ada_wert.iAdaGloku /end MEASUREMENT
/begin MEASUREMENT iAdaGloku.pre_timer_lock "Vorzaehler fuer Lock-Timer im EEPROM" UBYTE UMR_MSEC__10_1_0_S5_S3 1 100 0 1000 ECU_ADDRESS 0xFFF8D6D3 DISPLAY_IDENTIFIER pre_timer_lock.iAdaGloku /end MEASUREMENT
/begin MEASUREMENT iAdaGloku.pre_timer_max_lock "Vorzaehler fuer Max-Lock-Timer im EEPROM" UBYTE UMR_MSEC__10_1_0_S5_S3 1 100 0 1000 ECU_ADDRESS 0xFFF8D6D4 DISPLAY_IDENTIFIER pre_timer_max_lock.iAdaGloku /end MEASUREMENT
/begin MEASUREMENT iAdaGloku.puls_lock "Abbruch der Puls-Ada (K0) wegen Urluft-Lock" UBYTE Conv.cAdaGloku._.puls_lock_S5_S3 1 100 0 1 BIT_MASK 0x1 ECU_ADDRESS 0xFFF8D6CE DISPLAY_IDENTIFIER puls_lock.iAdaGloku /end MEASUREMENT
/begin MEASUREMENT iAdaGlosc.FiAxRefAdaOff.x "Filterwert" SLONG UMR___1_300_0_S5_S3 1 100 -7158278.82667 7158278.82333 ECU_ADDRESS 0xFFF8B0E4 DISPLAY_IDENTIFIER FiAxRefAdaOff.iAdaGlosc /end MEASUREMENT
/begin MEASUREMENT iAdaGlosc.ada_iae_info "Variable zur Klassifizierung der aktuell aktiven IAE Adaption" UBYTE Conv.cAdaGlosc._.ada_iae_info_S5_S3 1 100 0 2 ECU_ADDRESS 0xFFF8B0D6 DISPLAY_IDENTIFIER ada_iae_info.iAdaGlosc /end MEASUREMENT
/begin MEASUREMENT iAdaGlosc.ada_istgang "Istgang fuer Adaptionsfunktionen" UBYTE Conv.cAdaGlosc._.ada_istgang_S5_S3 1 100 0 8 ECU_ADDRESS 0xFFF8B0C8 DISPLAY_IDENTIFIER ada_istgang.iAdaGlosc /end MEASUREMENT
/begin MEASUREMENT iAdaGlosc.ada_k_zu "zuschaltende Kupplung, die von der PF-Adaption beobachtet wird" UBYTE Conv.cAdaGlosc._.ada_k_zu_S5_S3 1 100 0 5 ECU_ADDRESS 0xFFF8B0D4 DISPLAY_IDENTIFIER ada_k_zu.iAdaGlosc /end MEASUREMENT
/begin MEASUREMENT iAdaGlosc.ada_p_gls_kab "Druck GLS Regelung der KAB" SLONG UMR_MBAR__10_1_0_S5_S3 1 100 -21474836480 21474836470 ECU_ADDRESS 0xFFF8B0D0 DISPLAY_IDENTIFIER ada_p_gls_kab.iAdaGlosc /end MEASUREMENT
/begin MEASUREMENT iAdaGlosc.ada_p_gls_kzu "Druck GLS Regelung der KZU" SLONG UMR_MBAR__10_1_0_S5_S3 1 100 -320000 320000 ECU_ADDRESS 0xFFF8B0CC DISPLAY_IDENTIFIER ada_p_gls_kzu.iAdaGlosc /end MEASUREMENT
/begin MEASUREMENT iAdaGlosc.ada_schaltart "Variable zur Klassifizierung der aktuellen Schaltung aus ADA Sicht" UBYTE Conv.cAdaGlosc._.ada_schaltart_S5_S3 1 100 0 2 ECU_ADDRESS 0xFFF8B0D5 DISPLAY_IDENTIFIER ada_schaltart.iAdaGlosc /end MEASUREMENT
/begin MEASUREMENT iAdaGlosc.ada_schaltung_kzu "Flag: Schaltung ueber KZU" UBYTE Conv.cAdaGlosc._.ada_schaltung_kzu_S5_S3 1 100 0 1 BIT_MASK 0x1 ECU_ADDRESS 0xFFF8B0C5 DISPLAY_IDENTIFIER ada_schaltung_kzu.iAdaGlosc /end MEASUREMENT
/begin MEASUREMENT iAdaGlosc.ada_schaltungs_index "Klassifizierung aktuellen Schaltung (normal, spontan, sportlich, amax) aus ADA Sicht" UBYTE Conv.cAdaGlosc._.ada_schaltungs_index_S5_S3 1 100 0 4 ECU_ADDRESS 0xFFF8B0D8 DISPLAY_IDENTIFIER ada_schaltungs_index.iAdaGlosc /end MEASUREMENT
/begin MEASUREMENT iAdaGlosc.ada_synchron "FLAG: Synchronpunkt erreicht" UBYTE Conv.cAdaGlosc._.ada_synchron_S5_S3 1 100 0 1 BIT_MASK 0x1 ECU_ADDRESS 0xFFF8B0C4 DISPLAY_IDENTIFIER ada_synchron.iAdaGlosc /end MEASUREMENT
/begin MEASUREMENT iAdaGlosc.ada_zielgang "Zielgang fuer Adaptionsfunktionen" UBYTE Conv.cAdaGlosc._.ada_zielgang_S5_S3 1 100 0 8 ECU_ADDRESS 0xFFF8B0C7 DISPLAY_IDENTIFIER ada_zielgang.iAdaGlosc /end MEASUREMENT
/begin MEASUREMENT iAdaGlosc.adabew_verbot_sas "Flag: Bewertungsverbot durch Schaltablauf" UBYTE UMR___1_1_0_S5_S3 1 100 0 1 BIT_MASK 0x1 ECU_ADDRESS 0xFFF8B0C3 DISPLAY_IDENTIFIER adabew_verbot_sas.iAdaGlosc /end MEASUREMENT
/begin MEASUREMENT iAdaGlosc.adaption_counter "Allgemeiner Adaptionszaehler" UWORD UMR___1_1_0_S5_S3 1 100 0 65535 ECU_ADDRESS 0xFFF8B0C0 DISPLAY_IDENTIFIER adaption_counter.iAdaGlosc /end MEASUREMENT
/begin MEASUREMENT iAdaGlosc.ax_ref_gef_ada "Laengsbeschleunigung gefiltert fuer Adaptionen" SWORD UMR_M_SEC2_1_32_0_S5_S3 1 100 -1024 1023.96875 ECU_ADDRESS 0xFFF8B0DE DISPLAY_IDENTIFIER ax_ref_gef_ada.iAdaGlosc /end MEASUREMENT
/begin MEASUREMENT iAdaGlosc.bew_verbot_laengs_beschl "Zustandsgroesse ob Adas wegen Laengsbeschleunigung verboten sind" UBYTE Conv.cAdaGlosc._.bew_verbot_laengs_beschl_S5_S3 1 100 0 2 ECU_ADDRESS 0xFFF8B0DC DISPLAY_IDENTIFIER bew_verbot_laengs_beschl.iAdaGlosc /end MEASUREMENT
/begin MEASUREMENT iAdaGlosc.f_ada_bew_verboten "Ein globales Ada-Abbruch-Kriterium hat zugeschlagen" UBYTE Conv.cAdaGlosc._.f_ada_bew_verboten_S5_S3 1 100 0 1 BIT_MASK 0x1 ECU_ADDRESS 0xFFF8B0D9 DISPLAY_IDENTIFIER f_ada_bew_verboten.iAdaGlosc /end MEASUREMENT
/begin MEASUREMENT iAdaGlosc.f_aenderung_adaram_daten "Wird nach Aufruf der ADA-Bewertungsfunktionen gesetzt" UBYTE Conv.cAdaGlosc._.f_aenderung_adaram_daten_S5_S3 1 100 0 1 BIT_MASK 0x1 ECU_ADDRESS 0xFFF8B0C2 DISPLAY_IDENTIFIER f_aenderung_adaram_daten.iAdaGlosc /end MEASUREMENT
/begin MEASUREMENT iAdaGlosc.f_letzte_schaltung_rs "letzte Schaltung war eine RS (auch kein GE/GA)" UBYTE Conv.cAdaGlosc._.f_letzte_schaltung_rs_S5_S3 1 100 0 1 BIT_MASK 0x1 ECU_ADDRESS 0xFFF8B0DA DISPLAY_IDENTIFIER f_letzte_schaltung_rs.iAdaGlosc /end MEASUREMENT
/begin MEASUREMENT iAdaGlosc.flag_alaengs_adaoff "Abbruch von Adaptionen aufgrund von Längbeschleunigung" UBYTE Conv.cAdaGlosc._.flag_alaengs_adaoff_S5_S3 1 100 0 1 BIT_MASK 0x1 ECU_ADDRESS 0xFFF8B0DB DISPLAY_IDENTIFIER flag_alaengs_adaoff.iAdaGlosc /end MEASUREMENT
/begin MEASUREMENT iAdaGlosc.flag_allada_del "interne Groesse zum Loeschen von Adaptionsdaten" UBYTE Conv.cAdaGlosc._.flag_allada_del_S5_S3 1 100 0 1 BIT_MASK 0x1 ECU_ADDRESS 0xFFF8B0E0 DISPLAY_IDENTIFIER flag_allada_del.iAdaGlosc /end MEASUREMENT
/begin MEASUREMENT iAdaGlosc.init_mit_azg "Init. der Adaptionssp. mit AZG" UBYTE Conv.cAdaGlosc._.init_mit_azg_S5_S3 1 100 0 255 ECU_ADDRESS 0xFFF8B0C6 DISPLAY_IDENTIFIER init_mit_azg.iAdaGlosc /end MEASUREMENT
/begin MEASUREMENT iAdaGlosc.z_ada_schaltung "Klassifizierung der aktuellen Schaltung aus ADA Sicht" UBYTE Conv.cAdaGlosc._.z_ada_schaltung_S5_S3 1 100 0 2 ECU_ADDRESS 0xFFF8B0D7 DISPLAY_IDENTIFIER z_ada_schaltung.iAdaGlosc /end MEASUREMENT
/begin MEASUREMENT iAdaIaeap.FiMGMotIstIntern.Pt1Si16.x "Filterwert" SLONG UMR___1_300_0_S5_S3 1 100 -7158278.82667 7158278.82333 ECU_ADDRESS 0xFFF8B13C DISPLAY_IDENTIFIER Pt1Si16.FiMGMotIstIntern.iAdaIaeap /end MEASUREMENT
/begin MEASUREMENT iAdaIaeap.FiMGMotIstIntern.xp "Ableitung vom Eingangswert" SWORD UMR___1_1_0_S5_S3 1 100 -32768 32767 ECU_ADDRESS 0xFFF8B138 DISPLAY_IDENTIFIER FiMGMotIstIntern.iAdaIaeap /end MEASUREMENT
/begin MEASUREMENT iAdaIaeap.FiMMotIstIntern.x "Filterwert" SLONG UMR___1_300_0_S5_S3 1 100 -7158278.82667 7158278.82333 ECU_ADDRESS 0xFFF8B12C DISPLAY_IDENTIFIER FiMMotIstIntern.iAdaIaeap /end MEASUREMENT
/begin MEASUREMENT iAdaIaeap.FiNGMotIntern.Pt1Si16.x "Filterwert" SLONG UMR___1_300_0_S5_S3 1 100 -7158278.82667 7158278.82333 ECU_ADDRESS 0xFFF8B134 DISPLAY_IDENTIFIER Pt1Si16.FiNGMotIntern.iAdaIaeap /end MEASUREMENT
/begin MEASUREMENT iAdaIaeap.FiNGMotIntern.xp "Ableitung vom Eingangswert" SWORD UMR___1_1_0_S5_S3 1 100 -32768 32767 ECU_ADDRESS 0xFFF8B130 DISPLAY_IDENTIFIER FiNGMotIntern.iAdaIaeap /end MEASUREMENT
/begin MEASUREMENT iAdaIaeap.FiNMotIntern.x "Filterwert" SLONG UMR___1_300_0_S5_S3 1 100 -7158278.82667 7158278.82333 ECU_ADDRESS 0xFFF8B128 DISPLAY_IDENTIFIER FiNMotIntern.iAdaIaeap /end MEASUREMENT
/begin MEASUREMENT iAdaIaeap.RampeAdaIae.letzter_ms_timer "Speichert den letzten BS-Timer" UWORD UMR_MSEC__1_1_0_S5_S3 1 100 0 65535 ECU_ADDRESS 0xFFF8B14C DISPLAY_IDENTIFIER letzter_ms_timer.RampeAdaIae.iAdaIaeap /end MEASUREMENT
/begin MEASUREMENT iAdaIaeap.RampeAdaIae.letzter_wert "Speichert den letzten Eingangswert" FLOAT32_IEEE UMR___1_1_0_S5_S3 1 100 -1e+037 1e+037 ECU_ADDRESS 0xFFF8B148 FORMAT "%3.2" DISPLAY_IDENTIFIER letzter_wert.RampeAdaIae.iAdaIaeap /end MEASUREMENT
/begin MEASUREMENT iAdaIaeap.RampeAdaIae.maximum "Maximum Begrenzung" FLOAT32_IEEE UMR___1_1_0_S5_S3 1 100 -1e+037 1e+037 ECU_ADDRESS 0xFFF8B154 FORMAT "%3.2" DISPLAY_IDENTIFIER maximum.RampeAdaIae.iAdaIaeap /end MEASUREMENT
/begin MEASUREMENT iAdaIaeap.RampeAdaIae.minimum "Minimum Begrenzung" FLOAT32_IEEE UMR___1_1_0_S5_S3 1 100 -1e+037 1e+037 ECU_ADDRESS 0xFFF8B150 FORMAT "%3.2" DISPLAY_IDENTIFIER minimum.RampeAdaIae.iAdaIaeap /end MEASUREMENT
/begin MEASUREMENT iAdaIaeap.TimerAdaIae.time "Zeit des Timers" UWORD UMR_SEC__1_100_0_S5_S3 1 100 0 655.35 ECU_ADDRESS 0xFFF8B142 DISPLAY_IDENTIFIER TimerAdaIae.iAdaIaeap /end MEASUREMENT
/begin MEASUREMENT iAdaIaeap.TimerKriterienAdaIae.time "Zeit des Timers" UWORD UMR_SEC__1_100_0_S5_S3 1 100 0 655.35 ECU_ADDRESS 0xFFF8B144 DISPLAY_IDENTIFIER TimerKriterienAdaIae.iAdaIaeap /end MEASUREMENT
/begin MEASUREMENT iAdaIaeap.TimerMaxWartenAdaIae.time "Zeit des Timers" UWORD UMR_SEC__1_100_0_S5_S3 1 100 0 655.35 ECU_ADDRESS 0xFFF8B140 DISPLAY_IDENTIFIER TimerMaxWartenAdaIae.iAdaIaeap /end MEASUREMENT
/begin MEASUREMENT iAdaIaeap.abbruch_bit_ada_iae "Info zu globalen Abbruchkriterien und Abbruch aus Warten Sperrzeit" ULONG Conv.cAdaIaeap._.abbruch_bit_ada_iae_S5_S3 1 100 0 268435456 ECU_ADDRESS 0xFFF8B0E8 DISPLAY_IDENTIFIER abbruch_bit_ada_iae.iAdaIaeap /end MEASUREMENT
/begin MEASUREMENT iAdaIaeap.ada_wert_iae "aktueller Adaptionswert der IAE-Ada" SWORD UMR_BAR__1_1000_0_S5_S3 1 100 -1 12.75 ECU_ADDRESS 0xFFF8B0F8 DISPLAY_IDENTIFIER ada_wert_iae.iAdaIaeap /end MEASUREMENT
/begin MEASUREMENT iAdaIaeap.ada_wert_in_n_iae "aktueller Adaptionswert der IAE-Ada fuer Druckansteuerung in N" SWORD UMR_BAR__1_1000_0_S5_S3 1 100 -1 12.75 ECU_ADDRESS 0xFFF8B0FA DISPLAY_IDENTIFIER ada_wert_in_n_iae.iAdaIaeap /end MEASUREMENT
/begin MEASUREMENT iAdaIaeap.c_getr_ref_iae "Temperatur bei Beginn Prueframpe (zum Festhalten des Ada-Wertes)" UBYTE UMR_GRADC__1_1_M40_S5_S3 1 100 -40 215 ECU_ADDRESS 0xFFF8B0F5 DISPLAY_IDENTIFIER c_getr_ref_iae.iAdaIaeap /end MEASUREMENT
/begin MEASUREMENT iAdaIaeap.delta_anlege_druck_iae "Aenderung des Anlege-Drucks als Eingang in Ada-Speicher Aenderung - Hinweis: PO_APERK_IAE wurde schon abgezogen" SWORD UMR_BAR__1_1000_0_S5_S3 1 100 -1 12.75 ECU_ADDRESS 0xFFF8B102 DISPLAY_IDENTIFIER delta_anlege_druck_iae.iAdaIaeap /end MEASUREMENT
/begin MEASUREMENT iAdaIaeap.f_abbruch_global_iae "Globales Abbruch-Kriterium ist eingetreten - in Zustand Hys-Schleife wird nicht sofort abgebrochen" UBYTE Conv.cAdaIaeap._.f_abbruch_global_iae_S5_S3 1 100 0 1 BIT_MASK 0x1 ECU_ADDRESS 0xFFF8B0F2 DISPLAY_IDENTIFIER f_abbruch_global_iae.iAdaIaeap /end MEASUREMENT
/begin MEASUREMENT iAdaIaeap.f_ada_iae_ein "IAE-ADA eingeschalten und einige Grundbedingungen (Temperatur) erfuellt" UBYTE Conv.cAdaIaeap._.f_ada_iae_ein_S5_S3 1 100 0 1 BIT_MASK 0x1 ECU_ADDRESS 0xFFF8B0ED DISPLAY_IDENTIFIER f_ada_iae_ein.iAdaIaeap /end MEASUREMENT
/begin MEASUREMENT iAdaIaeap.f_angelegt_mmot_iae "IAE-ADA Momenten-Kriterium erkannt" UBYTE Conv.cAdaIaeap._.f_angelegt_mmot_iae_S5_S3 1 100 0 1 BIT_MASK 0x1 ECU_ADDRESS 0xFFF8B0EF DISPLAY_IDENTIFIER f_angelegt_mmot_iae.iAdaIaeap /end MEASUREMENT
/begin MEASUREMENT iAdaIaeap.f_angelegt_nmot_iae "IAE-ADA Drehzahl-Kriterium erkannt" UBYTE Conv.cAdaIaeap._.f_angelegt_nmot_iae_S5_S3 1 100 0 1 BIT_MASK 0x1 ECU_ADDRESS 0xFFF8B0EE DISPLAY_IDENTIFIER f_angelegt_nmot_iae.iAdaIaeap /end MEASUREMENT
/begin MEASUREMENT iAdaIaeap.f_bew_verboten_iae "Adaptions-Bewertung durch globale Ada-Abbruch kriterien verboten" UBYTE Conv.cAdaIaeap._.f_bew_verboten_iae_S5_S3 1 100 0 1 BIT_MASK 0x1 ECU_ADDRESS 0xFFF8B0F1 DISPLAY_IDENTIFIER f_bew_verboten_iae.iAdaIaeap /end MEASUREMENT
/begin MEASUREMENT iAdaIaeap.f_gmmot_begrenzungs_rampe "im Zustand Passiv soll die m_mot-Gradient Begrenzung zurueckgerampt werden" UBYTE Conv.cAdaIaeap._.f_gmmot_begrenzungs_rampe_S5_S3 1 100 0 1 BIT_MASK 0x1 ECU_ADDRESS 0xFFF8B0F3 DISPLAY_IDENTIFIER f_gmmot_begrenzungs_rampe.iAdaIaeap /end MEASUREMENT
/begin MEASUREMENT iAdaIaeap.f_rampinit_iae "IAE-ADA Initphase der Prueframpe erkannt" UBYTE Conv.cAdaIaeap._.f_rampinit_iae_S5_S3 1 100 0 1 BIT_MASK 0x1 ECU_ADDRESS 0xFFF8B0F0 DISPLAY_IDENTIFIER f_rampinit_iae.iAdaIaeap /end MEASUREMENT
/begin MEASUREMENT iAdaIaeap.m_mot_ref_ada_iae "Referenzmotormoment der IAE-Adaption" SLONG UMR_NM__1_100_0_S5_S3 1 100 -1200 1200 ECU_ADDRESS 0xFFF8B10C DISPLAY_IDENTIFIER m_mot_ref_ada_iae.iAdaIaeap /end MEASUREMENT
/begin MEASUREMENT iAdaIaeap.m_motist_intern "Interner gefilteter Wert der IAE-Adaption" SWORD UMR_NM__1_1_0_S5_S3 1 100 -200 1300 ECU_ADDRESS 0xFFF8B116 DISPLAY_IDENTIFIER m_motist_intern.iAdaIaeap /end MEASUREMENT
/begin MEASUREMENT iAdaIaeap.m_mw_motist_aperk_iae "reine Anzeigegroesse nur fuer die Erprobung benoetigt" SWORD UMR_NM__1_1_0_S5_S3 1 100 -200 1300 ECU_ADDRESS 0xFFF8B124 DISPLAY_IDENTIFIER m_mw_motist_aperk_iae.iAdaIaeap /end MEASUREMENT
/begin MEASUREMENT iAdaIaeap.m_stell_start_ada_iae "m_stell_iae wahrend Uebergang nach -Warten auf Stat Bedingungen-" SLONG UMR_NM__1_1_0_S5_S3 1 100 -200 1300 ECU_ADDRESS 0xFFF8B110 DISPLAY_IDENTIFIER m_stell_start_ada_iae.iAdaIaeap /end MEASUREMENT
/begin MEASUREMENT iAdaIaeap.mg_motist_intern "Interner gefilteter Wert der IAE-Adaption" SWORD UMR_NM_SEC_1_1_0_S5_S3 1 100 -10000 10000 ECU_ADDRESS 0xFFF8B11A DISPLAY_IDENTIFIER mg_motist_intern.iAdaIaeap /end MEASUREMENT
/begin MEASUREMENT iAdaIaeap.n_mot_intern "Interner gefilteter Wert der IAE-Adaption" UWORD UMR_U_MIN_1_1_0_S5_S3 1 100 0 8160 ECU_ADDRESS 0xFFF8B114 DISPLAY_IDENTIFIER n_mot_intern.iAdaIaeap /end MEASUREMENT
/begin MEASUREMENT iAdaIaeap.n_mot_ref_ada_iae "Referenzmotordrehzahl der IAE-Adaption" SLONG UMR_U_MIN_1_100_0_S5_S3 1 100 0 81600 ECU_ADDRESS 0xFFF8B108 DISPLAY_IDENTIFIER n_mot_ref_ada_iae.iAdaIaeap /end MEASUREMENT
/begin MEASUREMENT iAdaIaeap.n_mot_soll_ada_iae "n_mot_soll abhaengig von z_modus_iae" UWORD UMR_U_MIN_1_1_0_S5_S3 1 100 0 8200 ECU_ADDRESS 0xFFF8B11E DISPLAY_IDENTIFIER n_mot_soll_ada_iae.iAdaIaeap /end MEASUREMENT
/begin MEASUREMENT iAdaIaeap.n_mot_soll_leer_start "n_mot_soll_leer wahrend Uebergang nach -Warten auf Stat Bedingungen-" UWORD UMR_U_MIN_1_1_0_S5_S3 1 100 0 8200 ECU_ADDRESS 0xFFF8B11C DISPLAY_IDENTIFIER n_mot_soll_leer_start.iAdaIaeap /end MEASUREMENT
/begin MEASUREMENT iAdaIaeap.ng_mot_intern "Interner gefilteter Wert der IAE-Adaption" SWORD UMR_U_MINSEC_1_1_0_S5_S3 1 100 -10000 10000 ECU_ADDRESS 0xFFF8B118 DISPLAY_IDENTIFIER ng_mot_intern.iAdaIaeap /end MEASUREMENT
/begin MEASUREMENT iAdaIaeap.pg_rampe_ada_iae "Rampendruckgradient (Aussnahme Prueframpe) der der IAE-Anlegepunktadaption" SWORD UMR_BAR_SEC_1_10_0_S5_S3 1 100 -100 100 ECU_ADDRESS 0xFFF8B104 DISPLAY_IDENTIFIER pg_rampe_ada_iae.iAdaIaeap /end MEASUREMENT
/begin MEASUREMENT iAdaIaeap.po_ada_iae "Druck-Offset der ansteuernden IAE-Adaption" SWORD UMR_BAR__1_1000_0_S5_S3 1 100 -1 12.75 ECU_ADDRESS 0xFFF8B0F6 DISPLAY_IDENTIFIER po_ada_iae.iAdaIaeap /end MEASUREMENT
/begin MEASUREMENT iAdaIaeap.po_rampen_init "Startwert der Prueframpe" SWORD UMR_BAR__1_1000_0_S5_S3 1 100 -1 12.75 ECU_ADDRESS 0xFFF8B0FC DISPLAY_IDENTIFIER po_rampen_init.iAdaIaeap /end MEASUREMENT
/begin MEASUREMENT iAdaIaeap.po_uef_start "Startwert der Ueberfuehrungs-Fkt." SWORD UMR_BAR__1_1000_0_S5_S3 1 100 -1 12.75 ECU_ADDRESS 0xFFF8B0FE DISPLAY_IDENTIFIER po_uef_start.iAdaIaeap /end MEASUREMENT
/begin MEASUREMENT iAdaIaeap.po_uef_ziel "Zielwert der Ueberfuehrungs-Fkt." SWORD UMR_BAR__1_1000_0_S5_S3 1 100 -1 12.75 ECU_ADDRESS 0xFFF8B100 DISPLAY_IDENTIFIER po_uef_ziel.iAdaIaeap /end MEASUREMENT
/begin MEASUREMENT iAdaIaeap.req_n_mot_llsoll_iae "Anforderung einer Leerlaufdrehzahl durch Iae" UBYTE Conv.cAdaIaeap._.req_n_mot_llsoll_iae_S5_S3 1 100 0 1 BIT_MASK 0x1 ECU_ADDRESS 0xFFF8B0F4 DISPLAY_IDENTIFIER req_n_mot_llsoll_iae.iAdaIaeap /end MEASUREMENT
/begin MEASUREMENT iAdaIaeap.summe_m_motist_intern "Summe ueber m_motist_intern waehrend WARTEN_STAT_BED" SLONG UMR_NM__1_1_0_S5_S3 1 100 -2147483648 2147483647 ECU_ADDRESS 0xFFF8B120 DISPLAY_IDENTIFIER summe_m_motist_intern.iAdaIaeap /end MEASUREMENT
/begin MEASUREMENT iAdaIaeap.z_apada_iae "Zustand der IAE Anlegepunkt-Adaption" UBYTE Conv.cAdaIaeap._.z_apada_iae_S5_S3 1 100 0 14 ECU_ADDRESS 0xFFF8B0EC DISPLAY_IDENTIFIER z_apada_iae.iAdaIaeap /end MEASUREMENT
/begin MEASUREMENT iAdaIaeuf.adbr_lesen "Index des Berichs zwichen den Stuezstellen" UBYTE UMR___1_1_0_S5_S3 1 100 0 49 ECU_ADDRESS 0xFFF8B15E DISPLAY_IDENTIFIER adbr_lesen.iAdaIaeuf /end MEASUREMENT
/begin MEASUREMENT iAdaIaeuf.adbr_schreiben "Index des Berichs zwichen den Stuezstellen" UBYTE UMR___1_1_0_S5_S3 1 100 0 49 ECU_ADDRESS 0xFFF8B15F DISPLAY_IDENTIFIER adbr_schreiben.iAdaIaeuf /end MEASUREMENT
/begin MEASUREMENT iAdaIaeuf.f_ada_sperren_werteuebername "Flag zur Freigabe der Adaption. Damit wird die Adaption solange verboten bis die neu Adaptierten Werte auch von der IAE verwendet werden" UBYTE Conv.cAdaIaeuf._.f_ada_sperren_werteuebername_S5_S3 1 100 0 1 BIT_MASK 0x1 ECU_ADDRESS 0xFFF8B15D DISPLAY_IDENTIFIER f_ada_sperren_werteuebername.iAdaIaeuf /end MEASUREMENT
/begin MEASUREMENT iAdaIaeuf.f_read_kf_gueltig "Kopie der Adaptionsdaten ist gueltig und kann verwendet werden" UBYTE Conv.cAdaIaeuf._.f_read_kf_gueltig_S5_S3 1 100 0 1 BIT_MASK 0x1 ECU_ADDRESS 0xFFF8B15C DISPLAY_IDENTIFIER f_read_kf_gueltig.iAdaIaeuf /end MEASUREMENT
/begin MEASUREMENT iAdaPfusf.ada_wert_pfad "Adaptionswert (nur delta) neue Fuelldruckada." SWORD UMR_BAR__1_1000_0_S5_S3 1 100 -1.024 1.024 ECU_ADDRESS 0xFFF8CACC DISPLAY_IDENTIFIER ada_wert_pfad.iAdaPfusf /end MEASUREMENT
/begin MEASUREMENT iAdaPfusf.adapfn_status "Status der neuen Fuelldruckadaption" UBYTE Conv.cAdaPfusf._.adapfn_status_S5_S3 1 100 0 30 ECU_ADDRESS 0xFFF8CAC8 DISPLAY_IDENTIFIER adapfn_status.iAdaPfusf /end MEASUREMENT
/begin MEASUREMENT iAdaPfusf.adkl_pfad "Adaptionsklasse der Fuelldruckadaption" UBYTE Conv.cAdaPfusf._.adkl_pfad_S5_S3 1 100 0 5 ECU_ADDRESS 0xFFF8CAC9 DISPLAY_IDENTIFIER adkl_pfad.iAdaPfusf /end MEASUREMENT
/begin MEASUREMENT iAdaPfusf.bew_fuer_adkl_pfad "-" UBYTE UMR___1_1_0_S5_S3 1 100 0 255 ECU_ADDRESS 0xFFF8CAE9 DISPLAY_IDENTIFIER bew_fuer_adkl_pfad.iAdaPfusf /end MEASUREMENT
/begin MEASUREMENT iAdaPfusf.cycle_count_pfad "Zaehler fuer Takte" UWORD UMR___1_1_0_S5_S3 1 100 0 65535 ECU_ADDRESS 0xFFF8CAF0 DISPLAY_IDENTIFIER cycle_count_pfad.iAdaPfusf /end MEASUREMENT
/begin MEASUREMENT iAdaPfusf.dki_pfad "DKI zu Schaltungsbeginn bei HS - neue Fuelldruckada" UBYTE UMR_PROZENT__20_51_0_S5_S3 1 100 0 100 ECU_ADDRESS 0xFFF8CAE8 DISPLAY_IDENTIFIER dki_pfad.iAdaPfusf /end MEASUREMENT
/begin MEASUREMENT iAdaPfusf.f_max_flare_erreicht_hs_pfad "Flag: nd_synistgang groesser Schwelle - waehrend Beoabachtungszeitraum bei HS PFAD verwenden" UBYTE Conv.cAdaPfusf._.f_max_flare_erreicht_hs_pfad_S5_S3 1 100 0 1 BIT_MASK 0x1 ECU_ADDRESS 0xFFF8CADA DISPLAY_IDENTIFIER f_max_flare_erreicht_hs_pfad.iAdaPfusf /end MEASUREMENT
/begin MEASUREMENT iAdaPfusf.f_mt_krit_aktiv_pfad "Flag: Turbinenmoment Kriterium bei RS PFAD verwenden" UBYTE Conv.cAdaPfusf._.f_mt_krit_aktiv_pfad_S5_S3 1 100 0 1 BIT_MASK 0x1 ECU_ADDRESS 0xFFF8CAD0 DISPLAY_IDENTIFIER f_mt_krit_aktiv_pfad.iAdaPfusf /end MEASUREMENT
/begin MEASUREMENT iAdaPfusf.m_t_pfad "Moment zum Zeitpunkt der Bewertung" SWORD UMR_NM__1_1_0_S5_S3 1 100 -200 1300 ECU_ADDRESS 0xFFF8CAE0 DISPLAY_IDENTIFIER m_t_pfad.iAdaPfusf /end MEASUREMENT
/begin MEASUREMENT iAdaPfusf.n_f_alt.letzter_ms_timer "letzter Timerwert" UWORD UMR___1_1_0_S5_S3 1 100 0 65535 ECU_ADDRESS 0xFFF8CAF8 DISPLAY_IDENTIFIER letzter_ms_timer.n_f_alt.iAdaPfusf /end MEASUREMENT
/begin MEASUREMENT iAdaPfusf.n_f_alt.n_f "letzter Wert" SLONG UMR___1_1_0_S5_S3 1 100 -2147483648 2147483647 ECU_ADDRESS 0xFFF8CAF4 DISPLAY_IDENTIFIER n_f.n_f_alt.iAdaPfusf /end MEASUREMENT
/begin MEASUREMENT iAdaPfusf.n_tsync_pfad "Synchrondrehzahl alter Gang + ND_PFADRSxy bzw. -ND_PFADHS" UWORD UMR_U_MIN_1_1_0_S5_S3 1 100 0 8160 ECU_ADDRESS 0xFFF8CAE6 DISPLAY_IDENTIFIER n_tsync_pfad.iAdaPfusf /end MEASUREMENT
/begin MEASUREMENT iAdaPfusf.nd_syn_istgang_min_pfad "Minimale Differenzdrehzahl n_t zu synchron PFN-Adaption" SWORD UMR_U_MIN_1_1_0_S5_S3 1 100 -32768 32767 ECU_ADDRESS 0xFFF8CADC DISPLAY_IDENTIFIER nd_syn_istgang_min_pfad.iAdaPfusf /end MEASUREMENT
/begin MEASUREMENT iAdaPfusf.nd_syn_istgang_pfad "Differenzdrehzahl n_t zu synchron PFN-Adaption" SWORD UMR_U_MIN_1_1_0_S5_S3 1 100 -32768 32767 ECU_ADDRESS 0xFFF8CAD8 DISPLAY_IDENTIFIER nd_syn_istgang_pfad.iAdaPfusf /end MEASUREMENT
/begin MEASUREMENT iAdaPfusf.ng_ab_pfad "Abtriebsdrehzahlgradient neue Fuelldruck-Ada" SWORD UMR_U_MINSEC_1_1_0_S5_S3 1 100 -1000 1000 ECU_ADDRESS 0xFFF8CACA DISPLAY_IDENTIFIER ng_ab_pfad.iAdaPfusf /end MEASUREMENT
/begin MEASUREMENT iAdaPfusf.pgls_speicher_pfad "Regelflaeche von p_kzu" SLONG UMR___1_1_0_S5_S3 1 100 -2147483648 2147483647 ECU_ADDRESS 0xFFF8CAEC DISPLAY_IDENTIFIER pgls_speicher_pfad.iAdaPfusf /end MEASUREMENT
/begin MEASUREMENT iAdaPfusf.pm_gls_pfad "mittlere Regeleingriff PFAD" SWORD UMR_BAR__1_100_0_S5_S3 1 100 -1.25 1.24 ECU_ADDRESS 0xFFF8CADE DISPLAY_IDENTIFIER pm_gls_pfad.iAdaPfusf /end MEASUREMENT
/begin MEASUREMENT iAdaPfusf.pm_gls_status "eigener Zustandsgraph" UBYTE Conv.cAdaPfusf._.pm_gls_status_S5_S3 1 100 0 255 ECU_ADDRESS 0xFFF8CAF2 DISPLAY_IDENTIFIER pm_gls_status.iAdaPfusf /end MEASUREMENT
/begin MEASUREMENT iAdaPfusf.schaltart_pfad "Schaltart neue Fuelldruckadaption 0=KS, 1=HS, 2=RS" UBYTE Conv.cAdaPfusf._.schaltart_pfad_S5_S3 1 100 0 2 ECU_ADDRESS 0xFFF8CACE DISPLAY_IDENTIFIER schaltart_pfad.iAdaPfusf /end MEASUREMENT
/begin MEASUREMENT iAdaPfusf.schaltcode_pfad "Schaltcode neue Fuelldruckadaption (Maximalausbau: bei 8-Gang Projekten, die Schaltungen in 9. Gang ignorieren)" UBYTE Conv.cAdaPfusf._.schaltcode_pfad_S5_S3 1 100 0 17 ECU_ADDRESS 0xFFF8CACF DISPLAY_IDENTIFIER schaltcode_pfad.iAdaPfusf /end MEASUREMENT
/begin MEASUREMENT iAdaPfusf.t_bezug_pfad "Bezugspunkt: Ende Rampe1 Anm: -99990 steht f. unbestimmt" SWORD UMR_MSEC__10_1_0_S5_S3 1 100 0 3000 ECU_ADDRESS 0xFFF8CAE2 DISPLAY_IDENTIFIER t_bezug_pfad.iAdaPfusf /end MEASUREMENT
/begin MEASUREMENT iAdaPfusf.t_mess_pfad "Messpunkt: Verlassen Synchron Anm: -99990 steht f. unbestimmt" SWORD UMR_MSEC__10_1_0_S5_S3 1 100 0 3000 ECU_ADDRESS 0xFFF8CAE4 DISPLAY_IDENTIFIER t_mess_pfad.iAdaPfusf /end MEASUREMENT
/begin MEASUREMENT iAdaPfusf.td_pfad "Differenzzeit fuer PF bei HS - ADAPFN" SWORD UMR_MSEC__10_1_0_S5_S3 1 100 -3000 3000 ECU_ADDRESS 0xFFF8CAD4 DISPLAY_IDENTIFIER td_pfad.iAdaPfusf /end MEASUREMENT
/begin MEASUREMENT iAdaPfusf.td_pfadtsyn "Differenzzeit fuer PF bei RS - ADAPFN" SWORD UMR_MSEC__10_1_0_S5_S3 1 100 -300 300 ECU_ADDRESS 0xFFF8CAD6 DISPLAY_IDENTIFIER td_pfadtsyn.iAdaPfusf /end MEASUREMENT
/begin MEASUREMENT iAdaPfusf.timer_pfad "Timer f. Neue Fuelldruckadaption" UWORD UMR_MSEC__10_1_0_S5_S3 1 100 0 5000 ECU_ADDRESS 0xFFF8CAD2 DISPLAY_IDENTIFIER timer_pfad.iAdaPfusf /end MEASUREMENT
/begin MEASUREMENT iAdaPstCondition.preadaption_condition_stada "Status Einstiegsbedingungen wir auf Schnittsetlle ausgegeben" UBYTE Conv.cAdaPstCondition._.preadaption_condition_stada_S5_S3 1 100 0 255 ECU_ADDRESS 0xFFF8D6D7 DISPLAY_IDENTIFIER preadaption_condition_stada.iAdaPstCondition /end MEASUREMENT
/begin MEASUREMENT iAdaPstCondition.preadaption_condition_stada_int "Status Einstiegsbedingungen nur Intern wird bei Update auf Schnittsetlle kopiert" UBYTE Conv.cAdaPstCondition._.preadaption_condition_stada_int_S5_S3 1 100 0 255 ECU_ADDRESS 0xFFF8D6D6 DISPLAY_IDENTIFIER preadaption_condition_stada_int.iAdaPstCondition /end MEASUREMENT
/begin MEASUREMENT iAdaPstState.preadaption_state_stada "Zustand der Stillstandsadaption" UBYTE Conv.cAdaPstState._.preadaption_state_stada_S5_S3 1 100 0 4 ECU_ADDRESS 0xFFF89450 DISPLAY_IDENTIFIER preadaption_state_stada.iAdaPstState /end MEASUREMENT
/begin MEASUREMENT iAdaPstUserinfo.preadaption_userinfo_stada "Benutzerinformationen" UBYTE Conv.cAdaPstUserinfo._.preadaption_userinfo_stada_S5_S3 1 100 0 255 ECU_ADDRESS 0xFFF89451 DISPLAY_IDENTIFIER preadaption_userinfo_stada.iAdaPstUserinfo /end MEASUREMENT
/begin MEASUREMENT iAdaPstzs.akt_ada "ID der Momentan aktiven Adaption" UBYTE Conv.cAdaPstzs._.akt_ada_S5_S3 1 100 0 2 ECU_ADDRESS 0xFFF8B1F7 DISPLAY_IDENTIFIER akt_ada.iAdaPstzs /end MEASUREMENT
/begin MEASUREMENT iAdaPstzs.anz_kup_puls_stada "Kupplung deren Werte angezeigt werden" UBYTE Conv.cAdaPstzs._.anz_kup_puls_stada_S5_S3 1 100 0 6 ECU_ADDRESS 0xFFF8B211 DISPLAY_IDENTIFIER anz_kup_puls_stada.iAdaPstzs /end MEASUREMENT
/begin MEASUREMENT iAdaPstzs.anz_n_pruefschleife_stada "Anzahl der Schleifendurchlaeufe bei Puls 3 von kup_puls" UBYTE UMR___1_1_0_S5_S3 1 100 0 10 ECU_ADDRESS 0xFFF8B215 DISPLAY_IDENTIFIER anz_n_pruefschleife_stada.iAdaPstzs /end MEASUREMENT
/begin MEASUREMENT iAdaPstzs.anz_n_pulsgrenz_stada "Anzahl Pulse auf Kupplung in diesem Pruefzyklus von kup_puls" UBYTE UMR___1_1_0_S5_S3 1 100 0 255 ECU_ADDRESS 0xFFF8B214 DISPLAY_IDENTIFIER anz_n_pulsgrenz_stada.iAdaPstzs /end MEASUREMENT
/begin MEASUREMENT iAdaPstzs.anz_pf_adawert_stada "Adaptionswert kupplungsbez. PF-Adaption von kup_puls" SWORD UMR_BAR__1_1000_0_S5_S3 1 100 -5 5 ECU_ADDRESS 0xFFF8B21C DISPLAY_IDENTIFIER anz_pf_adawert_stada.iAdaPstzs /end MEASUREMENT
/begin MEASUREMENT iAdaPstzs.anz_pf_counter_stada "Adaptionsdurchläufe PF Stada" UBYTE UMR___1_1_0_S5_S3 1 100 0 255 ECU_ADDRESS 0xFFF8B221 DISPLAY_IDENTIFIER anz_pf_counter_stada.iAdaPstzs /end MEASUREMENT
/begin MEASUREMENT iAdaPstzs.anz_pf_durchgefuehrt_stada "Adaptonszustand anz_kup_puls" UBYTE Conv.cAdaPstzs._.anz_pf_durchgefuehrt_stada_S5_S3 1 100 0 2 ECU_ADDRESS 0xFFF8B21F DISPLAY_IDENTIFIER anz_pf_durchgefuehrt_stada.iAdaPstzs /end MEASUREMENT
/begin MEASUREMENT iAdaPstzs.anz_prueftyp_stada "Momentaner Adaptionstyp der Pulsadaption von kup_puls" UBYTE Conv.cAdaPstzs._.anz_prueftyp_stada_S5_S3 1 100 0 3 ECU_ADDRESS 0xFFF8B212 DISPLAY_IDENTIFIER anz_prueftyp_stada.iAdaPstzs /end MEASUREMENT
/begin MEASUREMENT iAdaPstzs.anz_pulsid_stada "Momentan ausgefuehrter Puls von TSF/PF-Pruefung von kup_puls" UBYTE Conv.cAdaPstzs._.anz_pulsid_stada_S5_S3 1 100 0 4 ECU_ADDRESS 0xFFF8B213 DISPLAY_IDENTIFIER anz_pulsid_stada.iAdaPstzs /end MEASUREMENT
/begin MEASUREMENT iAdaPstzs.anz_tsf_adawert_stada "Adaptionswert kupplungsbez. TSF-Adaption von kup_puls" SWORD UMR_MSEC__1_1_0_S5_S3 1 100 -2000 2000 ECU_ADDRESS 0xFFF8B21A DISPLAY_IDENTIFIER anz_tsf_adawert_stada.iAdaPstzs /end MEASUREMENT
/begin MEASUREMENT iAdaPstzs.anz_tsf_counter_stada "Adaptionsdurchläufe TSF Stada" UBYTE UMR___1_1_0_S5_S3 1 100 0 255 ECU_ADDRESS 0xFFF8B220 DISPLAY_IDENTIFIER anz_tsf_counter_stada.iAdaPstzs /end MEASUREMENT
/begin MEASUREMENT iAdaPstzs.anz_tsf_durchgefuehrt_stada "Adaptonszustand anz_kup_puls" UBYTE Conv.cAdaPstzs._.anz_tsf_durchgefuehrt_stada_S5_S3 1 100 0 2 ECU_ADDRESS 0xFFF8B21E DISPLAY_IDENTIFIER anz_tsf_durchgefuehrt_stada.iAdaPstzs /end MEASUREMENT
/begin MEASUREMENT iAdaPstzs.anz_zwsp_pf_stada "PF-Zwischenspeicherwert Pulsada von kup_puls" SWORD UMR_BAR__1_1000_0_S5_S3 1 100 -5 5 ECU_ADDRESS 0xFFF8B218 DISPLAY_IDENTIFIER anz_zwsp_pf_stada.iAdaPstzs /end MEASUREMENT
/begin MEASUREMENT iAdaPstzs.anz_zwsp_tsf_stada "TSF-Zwischenspeicherwert Pulsada von kup_puls" SWORD UMR_MSEC__1_1_0_S5_S3 1 100 -2000 2000 ECU_ADDRESS 0xFFF8B216 DISPLAY_IDENTIFIER anz_zwsp_tsf_stada.iAdaPstzs /end MEASUREMENT
/begin MEASUREMENT iAdaPstzs.druck_statisch_stada "Flag für statische Druckausgabe" UBYTE Conv.cAdaPstzs._.druck_statisch_stada_S5_S3 1 100 0 1 BIT_MASK 0x1 ECU_ADDRESS 0xFFF8B1E5 DISPLAY_IDENTIFIER druck_statisch_stada.iAdaPstzs /end MEASUREMENT
/begin MEASUREMENT iAdaPstzs.f_deaktivierung_erkannt "Singalisiert das ein Laufendes STADA Ablauf Abgebrochen wurde" UBYTE Conv.cAdaPstzs._.f_deaktivierung_erkannt_S5_S3 1 100 0 1 BIT_MASK 0x1 ECU_ADDRESS 0xFFF8B1F8 DISPLAY_IDENTIFIER f_deaktivierung_erkannt.iAdaPstzs /end MEASUREMENT
/begin MEASUREMENT iAdaPstzs.f_nmotsoll_stada_em "anforderung E- Maschienenmindestdrehzahl durch Adaption" UBYTE Conv.cAdaPstzs._.f_nmotsoll_stada_em_S5_S3 1 100 0 1 BIT_MASK 0x1 ECU_ADDRESS 0xFFF8B1E7 DISPLAY_IDENTIFIER f_nmotsoll_stada_em.iAdaPstzs /end MEASUREMENT
/begin MEASUREMENT iAdaPstzs.fzg_stillstand_k0_stada "True wenn das Fahrzeug steht und festgebremst ist" UBYTE Conv.cAdaPstzs._.fzg_stillstand_k0_stada_S5_S3 1 100 0 1 BIT_MASK 0x1 ECU_ADDRESS 0xFFF8B225 DISPLAY_IDENTIFIER fzg_stillstand_k0_stada.iAdaPstzs /end MEASUREMENT
/begin MEASUREMENT iAdaPstzs.fzg_stillstand_stada "True wenn das Fahrzeug steht und festgebremst ist" UBYTE Conv.cAdaPstzs._.fzg_stillstand_stada_S5_S3 1 100 0 1 BIT_MASK 0x1 ECU_ADDRESS 0xFFF8B222 DISPLAY_IDENTIFIER fzg_stillstand_stada.iAdaPstzs /end MEASUREMENT
/begin MEASUREMENT iAdaPstzs.gang_zzs_stada "Gang der eingelegt werden soll um eine Pulspruefung zu starten" SBYTE Conv.cAdaPstzs._.gang_zzs_stada_S5_S3 1 100 -1 8 ECU_ADDRESS 0xFFF8B1EF DISPLAY_IDENTIFIER gang_zzs_stada.iAdaPstzs /end MEASUREMENT
/begin MEASUREMENT iAdaPstzs.grundbedingung_erfuellt_einmalig_k0_stada "Dedektiert ob die Adaption gestartet werden kann. Wenn die STADA gestartet ist ist der Wert nicht relevant" UBYTE Conv.cAdaPstzs._.grundbedingung_erfuellt_einmalig_k0_stada_S5_S3 1 100 0 1 BIT_MASK 0x1 ECU_ADDRESS 0xFFF8B227 DISPLAY_IDENTIFIER grundbedingung_erfuellt_einmalig_k0_stada.iAdaPstzs /end MEASUREMENT
/begin MEASUREMENT iAdaPstzs.grundbedingung_erfuellt_einmalig_stada "Dedektiert ob die Adaption gestartet werden kann. Wenn die STADA gestartet ist ist der Wert nicht relevant" UBYTE Conv.cAdaPstzs._.grundbedingung_erfuellt_einmalig_stada_S5_S3 1 100 0 1 BIT_MASK 0x1 ECU_ADDRESS 0xFFF8B224 DISPLAY_IDENTIFIER grundbedingung_erfuellt_einmalig_stada.iAdaPstzs /end MEASUREMENT
/begin MEASUREMENT iAdaPstzs.grundbedingung_erfuellt_zyklisch_k0_stada "True wenn ein die STADA generel durchgefuehrt werden darf z.B. Testeranforderung muss aktiv sein" UBYTE Conv.cAdaPstzs._.grundbedingung_erfuellt_zyklisch_k0_stada_S5_S3 1 100 0 1 BIT_MASK 0x1 ECU_ADDRESS 0xFFF8B226 DISPLAY_IDENTIFIER grundbedingung_erfuellt_zyklisch_k0_stada.iAdaPstzs /end MEASUREMENT
/begin MEASUREMENT iAdaPstzs.grundbedingung_erfuellt_zyklisch_stada "True wenn ein die STADA generel durchgefuehrt werden darf z.B. Testeranforderung muss aktiv sein" UBYTE Conv.cAdaPstzs._.grundbedingung_erfuellt_zyklisch_stada_S5_S3 1 100 0 1 BIT_MASK 0x1 ECU_ADDRESS 0xFFF8B223 DISPLAY_IDENTIFIER grundbedingung_erfuellt_zyklisch_stada.iAdaPstzs /end MEASUREMENT
/begin MEASUREMENT iAdaPstzs.iBew.amplitude_ss_stada "Drehzahlwert f.Amplitude spitze-spitze" SWORD UMR_U_MIN_1_1_0_S5_S3 1 100 -100 100 ECU_ADDRESS 0xFFF8B1A6 DISPLAY_IDENTIFIER amplitude_ss_stada.iBew.iAdaPstzs /end MEASUREMENT
/begin MEASUREMENT iAdaPstzs.iBew.iFensterNeg.f_aktiv_stada "Zustand des Fensters" UBYTE Conv.cAdaPstbwFenster._.f_aktiv_stada_S5_S3 1 100 0 1 BIT_MASK 0x1 ECU_ADDRESS 0xFFF8B18A DISPLAY_IDENTIFIER f_aktiv_stada.iFensterNeg.iBew.iAdaPstzs /end MEASUREMENT
/begin MEASUREMENT iAdaPstzs.iBew.iFensterNeg.f_beenden_stada "Fenster soll beendet werden" UBYTE Conv.cAdaPstbwFenster._.f_beenden_stada_S5_S3 1 100 0 1 BIT_MASK 0x1 ECU_ADDRESS 0xFFF8B18C DISPLAY_IDENTIFIER f_beenden_stada.iFensterNeg.iBew.iAdaPstzs /end MEASUREMENT
/begin MEASUREMENT iAdaPstzs.iBew.iFensterNeg.f_starten_stada "Fenster soll aktiviert werden" UBYTE Conv.cAdaPstbwFenster._.f_starten_stada_S5_S3 1 100 0 1 BIT_MASK 0x1 ECU_ADDRESS 0xFFF8B18B DISPLAY_IDENTIFIER f_starten_stada.iFensterNeg.iBew.iAdaPstzs /end MEASUREMENT
/begin MEASUREMENT iAdaPstzs.iBew.iFensterNeg.iTimerBeenden.timer "Der aktuelle Timerwert" UBYTE UMR_MSEC__10_1_0_S5_S3 1 100 0 2550 ECU_ADDRESS 0xFFF8B189 DISPLAY_IDENTIFIER iTimerBeenden.iFensterNeg.iBew.iAdaPstzs /end MEASUREMENT
/begin MEASUREMENT iAdaPstzs.iBew.iFensterNeg.iTimerStarten.timer "Der aktuelle Timerwert" UBYTE UMR_MSEC__10_1_0_S5_S3 1 100 0 2550 ECU_ADDRESS 0xFFF8B188 DISPLAY_IDENTIFIER iTimerStarten.iFensterNeg.iBew.iAdaPstzs /end MEASUREMENT
/begin MEASUREMENT iAdaPstzs.iBew.iFensterPos.f_aktiv_stada "Zustand des Fensters" UBYTE Conv.cAdaPstbwFenster._.f_aktiv_stada_S5_S3 1 100 0 1 BIT_MASK 0x1 ECU_ADDRESS 0xFFF8B18F DISPLAY_IDENTIFIER f_aktiv_stada.iFensterPos.iBew.iAdaPstzs /end MEASUREMENT
/begin MEASUREMENT iAdaPstzs.iBew.iFensterPos.f_beenden_stada "Fenster soll beendet werden" UBYTE Conv.cAdaPstbwFenster._.f_beenden_stada_S5_S3 1 100 0 1 BIT_MASK 0x1 ECU_ADDRESS 0xFFF8B191 DISPLAY_IDENTIFIER f_beenden_stada.iFensterPos.iBew.iAdaPstzs /end MEASUREMENT
/begin MEASUREMENT iAdaPstzs.iBew.iFensterPos.f_starten_stada "Fenster soll aktiviert werden" UBYTE Conv.cAdaPstbwFenster._.f_starten_stada_S5_S3 1 100 0 1 BIT_MASK 0x1 ECU_ADDRESS 0xFFF8B190 DISPLAY_IDENTIFIER f_starten_stada.iFensterPos.iBew.iAdaPstzs /end MEASUREMENT
/begin MEASUREMENT iAdaPstzs.iBew.iFensterPos.iTimerBeenden.timer "Der aktuelle Timerwert" UBYTE UMR_MSEC__10_1_0_S5_S3 1 100 0 2550 ECU_ADDRESS 0xFFF8B18E DISPLAY_IDENTIFIER iTimerBeenden.iFensterPos.iBew.iAdaPstzs /end MEASUREMENT
/begin MEASUREMENT iAdaPstzs.iBew.iFensterPos.iTimerStarten.timer "Der aktuelle Timerwert" UBYTE UMR_MSEC__10_1_0_S5_S3 1 100 0 2550 ECU_ADDRESS 0xFFF8B18D DISPLAY_IDENTIFIER iTimerStarten.iFensterPos.iBew.iAdaPstzs /end MEASUREMENT
/begin MEASUREMENT iAdaPstzs.iBew.iTimerAmp.timer "Der aktuelle Timerwert" UBYTE UMR_MSEC__10_1_0_S5_S3 1 100 0 2550 ECU_ADDRESS 0xFFF8B192 DISPLAY_IDENTIFIER iTimerAmp.iBew.iAdaPstzs /end MEASUREMENT
/begin MEASUREMENT iAdaPstzs.iBew.max_adawert_stada "Der Maximale Adaptionswert" SWORD UMR___1_1_0_S5_S3 1 100 -32768 32767 ECU_ADDRESS 0xFFF8B1AC DISPLAY_IDENTIFIER max_adawert_stada.iBew.iAdaPstzs /end MEASUREMENT
/begin MEASUREMENT iAdaPstzs.iBew.n_guete_min_stada "Minimum der Drehzahlsignalguete f. Amplitudenbest." SWORD UMR_U_MIN_1_1_0_S5_S3 1 100 -2048 2048 ECU_ADDRESS 0xFFF8B1A4 DISPLAY_IDENTIFIER n_guete_min_stada.iBew.iAdaPstzs /end MEASUREMENT
/begin MEASUREMENT iAdaPstzs.iBew.nd_pulsamp_stada "Schwelle TAB_ND_PULSAMP..." SWORD UMR_U_MIN_1_1_0_S5_S3 1 100 0 1000 ECU_ADDRESS 0xFFF8B19A DISPLAY_IDENTIFIER nd_pulsamp_stada.iBew.iAdaPstzs /end MEASUREMENT
/begin MEASUREMENT iAdaPstzs.iBew.nd_pulsneg_stada "Schwelle TAB_ND_PULSNEG..." SWORD UMR_U_MIN_1_1_0_S5_S3 1 100 0 1000 ECU_ADDRESS 0xFFF8B19C DISPLAY_IDENTIFIER nd_pulsneg_stada.iBew.iAdaPstzs /end MEASUREMENT
/begin MEASUREMENT iAdaPstzs.iBew.nd_pulspos_stada "Schwelle TAB_ND_PULSPOS..." SWORD UMR_U_MIN_1_1_0_S5_S3 1 100 0 1000 ECU_ADDRESS 0xFFF8B19E DISPLAY_IDENTIFIER nd_pulspos_stada.iBew.iAdaPstzs /end MEASUREMENT
/begin MEASUREMENT iAdaPstzs.iBew.nd_pulszwneg_stada "Schwelle TAB_ND_PULSZWNEG..." SWORD UMR_U_MIN_1_1_0_S5_S3 1 100 0 1000 ECU_ADDRESS 0xFFF8B196 DISPLAY_IDENTIFIER nd_pulszwneg_stada.iBew.iAdaPstzs /end MEASUREMENT
/begin MEASUREMENT iAdaPstzs.iBew.nd_pulszwpos_stada "Schwelle TAB_ND_PULSZWPOS..." SWORD UMR_U_MIN_1_1_0_S5_S3 1 100 0 1000 ECU_ADDRESS 0xFFF8B198 DISPLAY_IDENTIFIER nd_pulszwpos_stada.iBew.iAdaPstzs /end MEASUREMENT
/begin MEASUREMENT iAdaPstzs.iBew.neg_rea_stada "ND-Reaktion auf PF- oder SF-Puls" UBYTE Conv.cAdaPstbw._.neg_rea_stada_S5_S3 1 100 0 2 ECU_ADDRESS 0xFFF8B1A0 DISPLAY_IDENTIFIER neg_rea_stada.iBew.iAdaPstzs /end MEASUREMENT
/begin MEASUREMENT iAdaPstzs.iBew.pos_rea_stada "ND-Reaktion nach PF- oder SF-Puls" UBYTE Conv.cAdaPstbw._.pos_rea_stada_S5_S3 1 100 0 2 ECU_ADDRESS 0xFFF8B1A1 DISPLAY_IDENTIFIER pos_rea_stada.iBew.iAdaPstzs /end MEASUREMENT
/begin MEASUREMENT iAdaPstzs.iBew.rea_amplitude_stada "ND-Reaktion nach Puls als Amplitude spitze-spitze" UBYTE Conv.cAdaPstbw._.rea_amplitude_stada_S5_S3 1 100 0 1 ECU_ADDRESS 0xFFF8B1A2 DISPLAY_IDENTIFIER rea_amplitude_stada.iBew.iAdaPstzs /end MEASUREMENT
/begin MEASUREMENT iAdaPstzs.iBew.testresultat_stada "Testresultat Befuellpruefung" UBYTE Conv.cAdaPstbw._.testresultat_stada_S5_S3 1 100 0 4 ECU_ADDRESS 0xFFF8B194 DISPLAY_IDENTIFIER testresultat_stada.iBew.iAdaPstzs /end MEASUREMENT
/begin MEASUREMENT iAdaPstzs.iBew.zeit_erk_amp_stada "Die Zeit für die Erkennung der Amplitude" UBYTE UMR_MSEC__10_1_0_S5_S3 1 100 0 2500 ECU_ADDRESS 0xFFF8B1AE DISPLAY_IDENTIFIER zeit_erk_amp_stada.iBew.iAdaPstzs /end MEASUREMENT
/begin MEASUREMENT iAdaPstzs.iBew.zustand_stada "Zustand Bewertung des Bewertungsablaufes" UBYTE Conv.cAdaPstbw._.zustand_stada_S5_S3 1 100 0 4 ECU_ADDRESS 0xFFF8B193 DISPLAY_IDENTIFIER zustand_stada.iBew.iAdaPstzs /end MEASUREMENT
/begin MEASUREMENT iAdaPstzs.iPf.fenster_nach_sf_stada "Flag fuer Verbot auf Abfrage ND_ADABBR nach SF" UBYTE Conv.cAdaPstpf._.fenster_nach_sf_stada_S5_S3 1 100 0 1 BIT_MASK 0x1 ECU_ADDRESS 0xFFF8B1C2 DISPLAY_IDENTIFIER fenster_nach_sf_stada.iPf.iAdaPstzs /end MEASUREMENT
/begin MEASUREMENT iAdaPstzs.iPf.fenster_sf_stada "Flag fuer Verbot auf Abfrage ND_ADABBR waehrnd SF" UBYTE Conv.cAdaPstpf._.fenster_sf_stada_S5_S3 1 100 0 1 BIT_MASK 0x1 ECU_ADDRESS 0xFFF8B1C6 DISPLAY_IDENTIFIER fenster_sf_stada.iPf.iAdaPstzs /end MEASUREMENT
/begin MEASUREMENT iAdaPstzs.iPf.iZustandstimerStada.timer "Der aktuelle Timerwert" UWORD UMR_MSEC__10_1_0_S5_S3 1 100 0 655350 ECU_ADDRESS 0xFFF8B1BC DISPLAY_IDENTIFIER iZustandstimerStada.iPf.iAdaPstzs /end MEASUREMENT
/begin MEASUREMENT iAdaPstzs.iPf.t_fenster_nach_sf_stada "Verbotszeit fuer die Abfrage ND_ADABBR nach SF" UWORD UMR_MSEC__10_1_0_S5_S3 1 100 0 2500 ECU_ADDRESS 0xFFF8B1C0 DISPLAY_IDENTIFIER t_fenster_nach_sf_stada.iPf.iAdaPstzs /end MEASUREMENT
/begin MEASUREMENT iAdaPstzs.iPf.t_fenster_sf_stada "Verbotszeit fuer die Abfrage ND_ADABBR waehrnd SF" UWORD UMR_MSEC__10_1_0_S5_S3 1 100 0 2500 ECU_ADDRESS 0xFFF8B1C4 DISPLAY_IDENTIFIER t_fenster_sf_stada.iPf.iAdaPstzs /end MEASUREMENT
/begin MEASUREMENT iAdaPstzs.iPf.zustand_stada "Zustand Fuelldruckpruefung" UBYTE Conv.cAdaPstpf._.zustand_stada_S5_S3 1 100 0 7 ECU_ADDRESS 0xFFF8B1BE DISPLAY_IDENTIFIER zustand_stada.iPf.iAdaPstzs /end MEASUREMENT
/begin MEASUREMENT iAdaPstzs.iTMaxInitStada.timer "Der aktuelle Timerwert" ULONG UMR_MSEC__10_1_0_S5_S3 1 100 0 42949672950 ECU_ADDRESS 0xFFF8B1CC DISPLAY_IDENTIFIER iTMaxInitStada.iAdaPstzs /end MEASUREMENT
/begin MEASUREMENT iAdaPstzs.iTSf.zustand_stada "Zustand Schnellfuellpruefung" UBYTE Conv.cAdaPstsf._.zustand_stada_S5_S3 1 100 0 6 ECU_ADDRESS 0xFFF8B1B4 DISPLAY_IDENTIFIER zustand_stada.iTSf.iAdaPstzs /end MEASUREMENT
/begin MEASUREMENT iAdaPstzs.iTimerNmotleersollAktivStada.timer "Der aktuelle Timerwert" UWORD UMR_MSEC__10_1_0_S5_S3 1 100 0 655350 ECU_ADDRESS 0xFFF8B1CA DISPLAY_IDENTIFIER iTimerNmotleersollAktivStada.iAdaPstzs /end MEASUREMENT
/begin MEASUREMENT iAdaPstzs.iZustandstimerStada.timer "Der aktuelle Timerwert" UWORD UMR_MSEC__10_1_0_S5_S3 1 100 0 655350 ECU_ADDRESS 0xFFF8B1C8 DISPLAY_IDENTIFIER iZustandstimerStada.iAdaPstzs /end MEASUREMENT
/begin MEASUREMENT iAdaPstzs.kup_pruefpuls_ausgabe_stada "Kupplung die aktuell geprueft wird" UBYTE Conv.cAdaPstzs._.kup_pruefpuls_ausgabe_stada_S5_S3 1 100 0 6 ECU_ADDRESS 0xFFF8B1DB DISPLAY_IDENTIFIER kup_pruefpuls_ausgabe_stada.iAdaPstzs /end MEASUREMENT
/begin MEASUREMENT iAdaPstzs.kup_puls_stada "Kupplung die aktuell geprueft werden soll" UBYTE Conv.cAdaPstzs._.kup_puls_stada_S5_S3 1 100 0 6 ECU_ADDRESS 0xFFF8B1DA DISPLAY_IDENTIFIER kup_puls_stada.iAdaPstzs /end MEASUREMENT
/begin MEASUREMENT iAdaPstzs.n_mot_start "n_mot-Wert zu Beginn des Pulses" UWORD UMR_U_MIN_1_1_0_S5_S3 1 100 0 65535 ECU_ADDRESS 0xFFF8B1E2 DISPLAY_IDENTIFIER n_mot_start.iAdaPstzs /end MEASUREMENT
/begin MEASUREMENT iAdaPstzs.n_pruefschleife_stada "Zaehler f. erkannte Drehzahlreaktion bei Puls3/Puls4" UBYTE UMR___1_1_0_S5_S3 1 100 0 2 ECU_ADDRESS 0xFFF8B1D4 DISPLAY_IDENTIFIER n_pruefschleife_stada.iAdaPstzs /end MEASUREMENT
/begin MEASUREMENT iAdaPstzs.n_pulsgrenz_stada "Zaehler f. Anzahl Pulse einer Kupplung" UBYTE UMR___1_1_0_S5_S3 1 100 0 255 ECU_ADDRESS 0xFFF8B1D3 DISPLAY_IDENTIFIER n_pulsgrenz_stada.iAdaPstzs /end MEASUREMENT
/begin MEASUREMENT iAdaPstzs.p_pulsausgabe_stada "Druck Pruefpuls (Offset auf minimalen FD)" SWORD UMR_BAR__1_1000_0_S5_S3 1 100 -3 3 ECU_ADDRESS 0xFFF8B1E0 DISPLAY_IDENTIFIER p_pulsausgabe_stada.iAdaPstzs /end MEASUREMENT
/begin MEASUREMENT iAdaPstzs.pre_ada_zustand_stada "Zustand der Testeradaption" UBYTE Conv.cAdaPstzs._.pre_ada_zustand_stada_S5_S3 1 100 0 15 ECU_ADDRESS 0xFFF8B1F2 DISPLAY_IDENTIFIER pre_ada_zustand_stada.iAdaPstzs /end MEASUREMENT
/begin MEASUREMENT iAdaPstzs.pulsid_stada "Der aktuelle Pruefpuls (Nummer)" UBYTE Conv.cAdaPstzs._.pulsid_stada_S5_S3 1 100 0 4 ECU_ADDRESS 0xFFF8B1D2 DISPLAY_IDENTIFIER pulsid_stada.iAdaPstzs /end MEASUREMENT
/begin MEASUREMENT iAdaPstzs.pulszyklus_beenden_stada "Flag, ob Pulszyklus beendet werden soll" UBYTE Conv.cAdaPstzs._.pulszyklus_beenden_stada_S5_S3 1 100 0 3 ECU_ADDRESS 0xFFF8B1E6 DISPLAY_IDENTIFIER pulszyklus_beenden_stada.iAdaPstzs /end MEASUREMENT
/begin MEASUREMENT iAdaPstzs.sal_eng_start_req "Startanforderung an den Verbrennungsmotor" UBYTE Conv.cAdaPstzs._.sal_eng_start_req_S5_S3 1 100 0 1 BIT_MASK 0x1 ECU_ADDRESS 0xFFF8B1E8 DISPLAY_IDENTIFIER sal_eng_start_req.iAdaPstzs /end MEASUREMENT
/begin MEASUREMENT iAdaPstzs.sal_eng_stop_disable "Verhinderung Motor-Stopp wird hierueber angefordert" UBYTE Conv.cAdaPstzs._.sal_eng_stop_disable_S5_S3 1 100 0 1 BIT_MASK 0x1 ECU_ADDRESS 0xFFF8B1E9 DISPLAY_IDENTIFIER sal_eng_stop_disable.iAdaPstzs /end MEASUREMENT
/begin MEASUREMENT iAdaPstzs.schnellfuellung_aktiv_stada "Flag Schnellfuellung aktiv" UBYTE Conv.cAdaPstzs._.schnellfuellung_aktiv_stada_S5_S3 1 100 0 1 BIT_MASK 0x1 ECU_ADDRESS 0xFFF8B1E4 DISPLAY_IDENTIFIER schnellfuellung_aktiv_stada.iAdaPstzs /end MEASUREMENT
/begin MEASUREMENT iAdaPstzs.testfall_counter_stada "Zähler aus dem testfall_ind_stada und testfall_kup_ind_stada bestimmt werden" UWORD UMR___1_1_0_S5_S3 1 100 0 65535 ECU_ADDRESS 0xFFF8B1EC DISPLAY_IDENTIFIER testfall_counter_stada.iAdaPstzs /end MEASUREMENT
/begin MEASUREMENT iAdaPstzs.testfall_gang_stada "Gang der eingelegt werden soll um eine Pulspruefung zu starten" SBYTE Conv.cAdaPstzs._.testfall_gang_stada_S5_S3 1 100 -1 8 ECU_ADDRESS 0xFFF8B1F0 DISPLAY_IDENTIFIER testfall_gang_stada.iAdaPstzs /end MEASUREMENT
/begin MEASUREMENT iAdaPstzs.testfall_ind_stada "Index der Zeile aus Testmatrix darus wird test_gang_stada ermittelt" UBYTE Conv.cAdaPstzs._.testfall_ind_stada_S5_S3 1 100 0 12 ECU_ADDRESS 0xFFF8B1EE DISPLAY_IDENTIFIER testfall_ind_stada.iAdaPstzs /end MEASUREMENT
/begin MEASUREMENT iAdaPstzs.testfall_kup_ind_stada "Prio der zu Pulsenden Kupplung" UBYTE Conv.cAdaPstzs._.testfall_kup_ind_stada_S5_S3 1 100 0 1 ECU_ADDRESS 0xFFF8B1F1 DISPLAY_IDENTIFIER testfall_kup_ind_stada.iAdaPstzs /end MEASUREMENT
/begin MEASUREMENT iAdaPstzs.testfall_prueftyp_stada "aktiver Prueftyp der Pulsadaption" UBYTE Conv.cAdaPstzs._.testfall_prueftyp_stada_S5_S3 1 100 0 3 ECU_ADDRESS 0xFFF8B1D1 DISPLAY_IDENTIFIER testfall_prueftyp_stada.iAdaPstzs /end MEASUREMENT
/begin MEASUREMENT iAdaPstzs.z_k0_stada "Sollvorgabe für die Trennkupplung K0 durch die Stillstandsadaption" UBYTE Conv.cAdaPstzs._.z_k0_stada_S5_S3 1 100 0 1 ECU_ADDRESS 0xFFF8B1EA DISPLAY_IDENTIFIER z_k0_stada.iAdaPstzs /end MEASUREMENT
/begin MEASUREMENT iAdaPstzs.z_systemkondit_agl "Zustand der Testeradaption" UBYTE Conv.cAdaPstzs._.z_systemkondit_agl_S5_S3 1 100 0 4 ECU_ADDRESS 0xFFF8B1F4 DISPLAY_IDENTIFIER z_systemkondit_agl.iAdaPstzs /end MEASUREMENT
/begin MEASUREMENT iAdaPstzs.z_systemkondit_funkdeakt "Zustand der Funktionsdeaktivierung" UBYTE Conv.cAdaPstzs._.z_systemkondit_funkdeakt_S5_S3 1 100 0 8 ECU_ADDRESS 0xFFF8B1F6 DISPLAY_IDENTIFIER z_systemkondit_funkdeakt.iAdaPstzs /end MEASUREMENT
/begin MEASUREMENT iAdaPstzs.z_systemkondit_nmot "Zustand der Testeradaption" UBYTE Conv.cAdaPstzs._.z_systemkondit_nmot_S5_S3 1 100 0 8 ECU_ADDRESS 0xFFF8B1F5 DISPLAY_IDENTIFIER z_systemkondit_nmot.iAdaPstzs /end MEASUREMENT
/begin MEASUREMENT iAdaPstzs.z_systemkondit_zzs "Zustand der Testeradaption" UBYTE Conv.cAdaPstzs._.z_systemkondit_zzs_S5_S3 1 100 0 11 ECU_ADDRESS 0xFFF8B1F3 DISPLAY_IDENTIFIER z_systemkondit_zzs.iAdaPstzs /end MEASUREMENT
/begin MEASUREMENT iAdaPstzs.zeit_sf_10ms_stada "Die Schnellfuellzeit der Pulsadaption in 10ms" UWORD UMR_MSEC__10_1_0_S5_S3 1 100 0 1000 ECU_ADDRESS 0xFFF8B1DE DISPLAY_IDENTIFIER zeit_sf_10ms_stada.iAdaPstzs /end MEASUREMENT
/begin MEASUREMENT iAdaPstzs.zeit_sf_1ms_stada "Die Schnellfuellzeit der Pulsadaption in 1ms" UWORD UMR_MSEC__1_1_0_S5_S3 1 100 0 1000 ECU_ADDRESS 0xFFF8B1DC DISPLAY_IDENTIFIER zeit_sf_1ms_stada.iAdaPstzs /end MEASUREMENT
/begin MEASUREMENT iAdaPstzs.zustand_stada "Zustand des Pruefpulsablaufes" UBYTE Conv.cAdaPstzs._.zustand_stada_S5_S3 1 100 0 8 ECU_ADDRESS 0xFFF8B1D0 DISPLAY_IDENTIFIER zustand_stada.iAdaPstzs /end MEASUREMENT
/begin MEASUREMENT iAdaPstzs.zwsp_pf_stada "Zwischenspeicherwert PF-Druck KPAD" SWORD UMR_BAR__1_1000_0_S5_S3 1 100 -5 5 ECU_ADDRESS 0xFFF8B1D8 DISPLAY_IDENTIFIER zwsp_pf_stada.iAdaPstzs /end MEASUREMENT
/begin MEASUREMENT iAdaPstzs.zwsp_tsf_stada "Zwischenspeicherwert SF-Zeit kupplungsbez. Adaption" SWORD UMR_MSEC__1_1_0_S5_S3 1 100 -2000 2000 ECU_ADDRESS 0xFFF8B1D6 DISPLAY_IDENTIFIER zwsp_tsf_stada.iAdaPstzs /end MEASUREMENT
/begin MEASUREMENT iAdaPulKr.aktive_pulspruefung "Momentan aktive Pulsadaptionsvariante" UBYTE Conv.cAdaPulKr._.aktive_pulspruefung_S5_S3 1 100 0 2 ECU_ADDRESS 0xFFF89452 DISPLAY_IDENTIFIER aktive_pulspruefung.iAdaPulKr /end MEASUREMENT
/begin MEASUREMENT iAdaPulzs.anz_kup_puls "Kupplung deren Werte angezeigt werden" UBYTE Conv.cAdaPulzs._.anz_kup_puls_S5_S3 1 100 0 6 ECU_ADDRESS 0xFFF8B2C5 DISPLAY_IDENTIFIER anz_kup_puls.iAdaPulzs /end MEASUREMENT
/begin MEASUREMENT iAdaPulzs.anz_n_pruefschleife "Anzahl der Schleifendurchlaeufe bei Puls 3 /4 von kup_puls" UBYTE UMR___1_1_0_S5_S3 1 100 0 10 ECU_ADDRESS 0xFFF8B2CA DISPLAY_IDENTIFIER anz_n_pruefschleife.iAdaPulzs /end MEASUREMENT
/begin MEASUREMENT iAdaPulzs.anz_n_pruefzyklen "Anzahl der Zyklen (Puls 1-4) von kup_puls" UBYTE UMR___1_1_0_S5_S3 1 100 0 10 ECU_ADDRESS 0xFFF8B2C8 DISPLAY_IDENTIFIER anz_n_pruefzyklen.iAdaPulzs /end MEASUREMENT
/begin MEASUREMENT iAdaPulzs.anz_n_pulsgrenz "Anzahl Pulse auf Kupplung in diesem Pruefzyklus von kup_puls" UBYTE UMR___1_1_0_S5_S3 1 100 0 255 ECU_ADDRESS 0xFFF8B2C9 DISPLAY_IDENTIFIER anz_n_pulsgrenz.iAdaPulzs /end MEASUREMENT
/begin MEASUREMENT iAdaPulzs.anz_pf_adawert "Adaptionswert kupplungsbez. PF-Adaption von kup_puls" SWORD UMR_BAR__1_1000_0_S5_S3 1 100 -5 5 ECU_ADDRESS 0xFFF8B2D2 DISPLAY_IDENTIFIER anz_pf_adawert.iAdaPulzs /end MEASUREMENT
/begin MEASUREMENT iAdaPulzs.anz_prueftyp "Momentaner Adaptionstyp der Pulsadaption von kup_puls" UBYTE Conv.cAdaPulzs._.anz_prueftyp_S5_S3 1 100 0 2 ECU_ADDRESS 0xFFF8B2C6 DISPLAY_IDENTIFIER anz_prueftyp.iAdaPulzs /end MEASUREMENT
/begin MEASUREMENT iAdaPulzs.anz_pulsid "Momentan ausgefuehrter Puls von TSF/PF-Pruefung von kup_puls" UBYTE Conv.cAdaPulzs._.anz_pulsid_S5_S3 1 100 0 4 ECU_ADDRESS 0xFFF8B2C7 DISPLAY_IDENTIFIER anz_pulsid.iAdaPulzs /end MEASUREMENT
/begin MEASUREMENT iAdaPulzs.anz_tsf_adawert "Adaptionswert kupplungsbez. TSF-Adaption von kup_puls" SWORD UMR_MSEC__1_1_0_S5_S3 1 100 -2000 2000 ECU_ADDRESS 0xFFF8B2D0 DISPLAY_IDENTIFIER anz_tsf_adawert.iAdaPulzs /end MEASUREMENT
/begin MEASUREMENT iAdaPulzs.anz_zwsp_pf "PF-Zwischenspeicherwert Pulsada von kup_puls" SWORD UMR_BAR__1_1000_0_S5_S3 1 100 -5 5 ECU_ADDRESS 0xFFF8B2CE DISPLAY_IDENTIFIER anz_zwsp_pf.iAdaPulzs /end MEASUREMENT
/begin MEASUREMENT iAdaPulzs.anz_zwsp_tsf "TSF-Zwischenspeicherwert Pulsada von kup_puls" SWORD UMR_MSEC__1_1_0_S5_S3 1 100 -2000 2000 ECU_ADDRESS 0xFFF8B2CC DISPLAY_IDENTIFIER anz_zwsp_tsf.iAdaPulzs /end MEASUREMENT
/begin MEASUREMENT iAdaPulzs.dki_start "dki-Wert zu Beginn des Pulses" UBYTE UMR_PROZENT__20_51_0_S5_S3 1 100 0 100 ECU_ADDRESS 0xFFF8B2BC DISPLAY_IDENTIFIER dki_start.iAdaPulzs /end MEASUREMENT
/begin MEASUREMENT iAdaPulzs.druck_statisch "Flag für statische Druckausgabe" UBYTE Conv.cAdaPulzs._.druck_statisch_S5_S3 1 100 0 1 BIT_MASK 0x1 ECU_ADDRESS 0xFFF8B2BF DISPLAY_IDENTIFIER druck_statisch.iAdaPulzs /end MEASUREMENT
/begin MEASUREMENT iAdaPulzs.f_in_gang_fertig "Flag Pulsadaptionen in diesem Gang fertig" UBYTE Conv.cAdaPulzs._.f_in_gang_fertig_S5_S3 1 100 0 1 BIT_MASK 0x1 ECU_ADDRESS 0xFFF8B2B4 DISPLAY_IDENTIFIER f_in_gang_fertig.iAdaPulzs /end MEASUREMENT
/begin MEASUREMENT iAdaPulzs.f_ndabbr_verletzt "Flag für Verletzung von n_guete" UBYTE Conv.cAdaPulzs._.f_ndabbr_verletzt_S5_S3 1 100 0 1 BIT_MASK 0x1 ECU_ADDRESS 0xFFF8B2B6 DISPLAY_IDENTIFIER f_ndabbr_verletzt.iAdaPulzs /end MEASUREMENT
/begin MEASUREMENT iAdaPulzs.f_nmotsoll_em "anforderung E- Maschienenmindestdrehzahl durch Adaption" UBYTE Conv.cAdaPulzs._.f_nmotsoll_em_S5_S3 1 100 0 1 BIT_MASK 0x1 ECU_ADDRESS 0xFFF8B2C1 DISPLAY_IDENTIFIER f_nmotsoll_em.iAdaPulzs /end MEASUREMENT
/begin MEASUREMENT iAdaPulzs.f_schubabschaltung_aktiv_start "Schubabschaltungsflag zu Beginn des Pulses" UBYTE Conv.cAdaPulzs._.f_schubabschaltung_aktiv_start_S5_S3 1 100 0 1 BIT_MASK 0x1 ECU_ADDRESS 0xFFF8B2B8 DISPLAY_IDENTIFIER f_schubabschaltung_aktiv_start.iAdaPulzs /end MEASUREMENT
/begin MEASUREMENT iAdaPulzs.f_startpruefung_aktiv "Flag für Umschaltung Applikationsparameter waehrend Beginn der Getriebelaufzeit" UBYTE Conv.cAdaPulzs._.f_startpruefung_aktiv_S5_S3 1 100 0 1 BIT_MASK 0x1 ECU_ADDRESS 0xFFF8B2B7 DISPLAY_IDENTIFIER f_startpruefung_aktiv.iAdaPulzs /end MEASUREMENT
/begin MEASUREMENT iAdaPulzs.f_startpuls_nguete "Flag für Einstiegsbedingung außer n_guete erfüllt und Puls notwendig" UBYTE Conv.cAdaPulzs._.f_startpuls_nguete_S5_S3 1 100 0 1 BIT_MASK 0x1 ECU_ADDRESS 0xFFF8B2B5 DISPLAY_IDENTIFIER f_startpuls_nguete.iAdaPulzs /end MEASUREMENT
/begin MEASUREMENT iAdaPulzs.iBew.amplitude_ss "Drehzahlwert f.Amplitude spitze-spitze" SWORD UMR_U_MIN_1_1_0_S5_S3 1 100 -100 100 ECU_ADDRESS 0xFFF8B27C DISPLAY_IDENTIFIER amplitude_ss.iBew.iAdaPulzs /end MEASUREMENT
/begin MEASUREMENT iAdaPulzs.iBew.f_start_t_sperrt_nach_reak "Flag, ob Reaktion auf Puls 1 erkannt wurde." UBYTE Conv.cAdaPulbw._.f_start_t_sperrt_nach_reak_S5_S3 1 100 0 1 BIT_MASK 0x1 ECU_ADDRESS 0xFFF8B279 DISPLAY_IDENTIFIER f_start_t_sperrt_nach_reak.iBew.iAdaPulzs /end MEASUREMENT
/begin MEASUREMENT iAdaPulzs.iBew.iFensterNeg.f_aktiv "Zustand des Fensters" UBYTE Conv.cAdaPulbwFenster._.f_aktiv_S5_S3 1 100 0 1 BIT_MASK 0x1 ECU_ADDRESS 0xFFF8B25E DISPLAY_IDENTIFIER f_aktiv.iFensterNeg.iBew.iAdaPulzs /end MEASUREMENT
/begin MEASUREMENT iAdaPulzs.iBew.iFensterNeg.f_beenden "Fenster soll beendet werden" UBYTE Conv.cAdaPulbwFenster._.f_beenden_S5_S3 1 100 0 1 BIT_MASK 0x1 ECU_ADDRESS 0xFFF8B260 DISPLAY_IDENTIFIER f_beenden.iFensterNeg.iBew.iAdaPulzs /end MEASUREMENT
/begin MEASUREMENT iAdaPulzs.iBew.iFensterNeg.f_starten "Fenster soll aktiviert werden" UBYTE Conv.cAdaPulbwFenster._.f_starten_S5_S3 1 100 0 1 BIT_MASK 0x1 ECU_ADDRESS 0xFFF8B25F DISPLAY_IDENTIFIER f_starten.iFensterNeg.iBew.iAdaPulzs /end MEASUREMENT
/begin MEASUREMENT iAdaPulzs.iBew.iFensterNeg.iTimerBeenden.timer "Der aktuelle Timerwert" UBYTE UMR_MSEC__10_1_0_S5_S3 1 100 0 2550 ECU_ADDRESS 0xFFF8B25D DISPLAY_IDENTIFIER iTimerBeenden.iFensterNeg.iBew.iAdaPulzs /end MEASUREMENT
/begin MEASUREMENT iAdaPulzs.iBew.iFensterNeg.iTimerStarten.timer "Der aktuelle Timerwert" UBYTE UMR_MSEC__10_1_0_S5_S3 1 100 0 2550 ECU_ADDRESS 0xFFF8B25C DISPLAY_IDENTIFIER iTimerStarten.iFensterNeg.iBew.iAdaPulzs /end MEASUREMENT
/begin MEASUREMENT iAdaPulzs.iBew.iFensterPos.f_aktiv "Zustand des Fensters" UBYTE Conv.cAdaPulbwFenster._.f_aktiv_S5_S3 1 100 0 1 BIT_MASK 0x1 ECU_ADDRESS 0xFFF8B263 DISPLAY_IDENTIFIER f_aktiv.iFensterPos.iBew.iAdaPulzs /end MEASUREMENT
/begin MEASUREMENT iAdaPulzs.iBew.iFensterPos.f_beenden "Fenster soll beendet werden" UBYTE Conv.cAdaPulbwFenster._.f_beenden_S5_S3 1 100 0 1 BIT_MASK 0x1 ECU_ADDRESS 0xFFF8B265 DISPLAY_IDENTIFIER f_beenden.iFensterPos.iBew.iAdaPulzs /end MEASUREMENT
/begin MEASUREMENT iAdaPulzs.iBew.iFensterPos.f_starten "Fenster soll aktiviert werden" UBYTE Conv.cAdaPulbwFenster._.f_starten_S5_S3 1 100 0 1 BIT_MASK 0x1 ECU_ADDRESS 0xFFF8B264 DISPLAY_IDENTIFIER f_starten.iFensterPos.iBew.iAdaPulzs /end MEASUREMENT
/begin MEASUREMENT iAdaPulzs.iBew.iFensterPos.iTimerBeenden.timer "Der aktuelle Timerwert" UBYTE UMR_MSEC__10_1_0_S5_S3 1 100 0 2550 ECU_ADDRESS 0xFFF8B262 DISPLAY_IDENTIFIER iTimerBeenden.iFensterPos.iBew.iAdaPulzs /end MEASUREMENT
/begin MEASUREMENT iAdaPulzs.iBew.iFensterPos.iTimerStarten.timer "Der aktuelle Timerwert" UBYTE UMR_MSEC__10_1_0_S5_S3 1 100 0 2550 ECU_ADDRESS 0xFFF8B261 DISPLAY_IDENTIFIER iTimerStarten.iFensterPos.iBew.iAdaPulzs /end MEASUREMENT
/begin MEASUREMENT iAdaPulzs.iBew.iTimerAmp.timer "Der aktuelle Timerwert" UBYTE UMR_MSEC__10_1_0_S5_S3 1 100 0 2550 ECU_ADDRESS 0xFFF8B268 DISPLAY_IDENTIFIER iTimerAmp.iBew.iAdaPulzs /end MEASUREMENT
/begin MEASUREMENT iAdaPulzs.iBew.iTimerNVerlauf.timer "Der aktuelle Timerwert" UWORD UMR_MSEC__10_1_0_S5_S3 1 100 0 655350 ECU_ADDRESS 0xFFF8B266 DISPLAY_IDENTIFIER iTimerNVerlauf.iBew.iAdaPulzs /end MEASUREMENT
/begin MEASUREMENT iAdaPulzs.iBew.max_adawert "Der Maximale Adaptionswert" SWORD UMR___1_1_0_S5_S3 1 100 -32768 32767 ECU_ADDRESS 0xFFF8B284 DISPLAY_IDENTIFIER max_adawert.iBew.iAdaPulzs /end MEASUREMENT
/begin MEASUREMENT iAdaPulzs.iBew.n_guete_min "Minimum der Drehzahlsignalguete f. Amplitudenbest." SWORD UMR_U_MIN_1_1_0_S5_S3 1 100 -2048 2048 ECU_ADDRESS 0xFFF8B27A DISPLAY_IDENTIFIER n_guete_min.iBew.iAdaPulzs /end MEASUREMENT
/begin MEASUREMENT iAdaPulzs.iBew.nd_pulsamp "Schwelle TAB_ND_PULSAMP..." SWORD UMR_U_MIN_1_1_0_S5_S3 1 100 0 1000 ECU_ADDRESS 0xFFF8B270 DISPLAY_IDENTIFIER nd_pulsamp.iBew.iAdaPulzs /end MEASUREMENT
/begin MEASUREMENT iAdaPulzs.iBew.nd_pulsneg "Schwelle TAB_ND_PULSNEG..." SWORD UMR_U_MIN_1_1_0_S5_S3 1 100 0 1000 ECU_ADDRESS 0xFFF8B272 DISPLAY_IDENTIFIER nd_pulsneg.iBew.iAdaPulzs /end MEASUREMENT
/begin MEASUREMENT iAdaPulzs.iBew.nd_pulspos "Schwelle TAB_ND_PULSPOS..." SWORD UMR_U_MIN_1_1_0_S5_S3 1 100 0 1000 ECU_ADDRESS 0xFFF8B274 DISPLAY_IDENTIFIER nd_pulspos.iBew.iAdaPulzs /end MEASUREMENT
/begin MEASUREMENT iAdaPulzs.iBew.nd_pulszwneg "Schwelle TAB_ND_PULSZWNEG..." SWORD UMR_U_MIN_1_1_0_S5_S3 1 100 0 1000 ECU_ADDRESS 0xFFF8B26C DISPLAY_IDENTIFIER nd_pulszwneg.iBew.iAdaPulzs /end MEASUREMENT
/begin MEASUREMENT iAdaPulzs.iBew.nd_pulszwpos "Schwelle TAB_ND_PULSZWPOS..." SWORD UMR_U_MIN_1_1_0_S5_S3 1 100 0 1000 ECU_ADDRESS 0xFFF8B26E DISPLAY_IDENTIFIER nd_pulszwpos.iBew.iAdaPulzs /end MEASUREMENT
/begin MEASUREMENT iAdaPulzs.iBew.neg_rea "ND-Reaktion auf PF- oder SF-Puls" UBYTE Conv.cAdaPulbw._.neg_rea_S5_S3 1 100 0 2 ECU_ADDRESS 0xFFF8B276 DISPLAY_IDENTIFIER neg_rea.iBew.iAdaPulzs /end MEASUREMENT
/begin MEASUREMENT iAdaPulzs.iBew.pos_rea "ND-Reaktion nach PF- oder SF-Puls" UBYTE Conv.cAdaPulbw._.pos_rea_S5_S3 1 100 0 2 ECU_ADDRESS 0xFFF8B277 DISPLAY_IDENTIFIER pos_rea.iBew.iAdaPulzs /end MEASUREMENT
/begin MEASUREMENT iAdaPulzs.iBew.rea_amplitude "ND-Reaktion nach Puls als Amplitude spitze-spitze" UBYTE Conv.cAdaPulbw._.rea_amplitude_S5_S3 1 100 0 1 ECU_ADDRESS 0xFFF8B278 DISPLAY_IDENTIFIER rea_amplitude.iBew.iAdaPulzs /end MEASUREMENT
/begin MEASUREMENT iAdaPulzs.iBew.testresultat "Testresultat Befuellpruefung" UBYTE Conv.cAdaPulbw._.testresultat_S5_S3 1 100 0 4 ECU_ADDRESS 0xFFF8B26B DISPLAY_IDENTIFIER testresultat.iBew.iAdaPulzs /end MEASUREMENT
/begin MEASUREMENT iAdaPulzs.iBew.z_n_verlauf "Zustand Bewertung des Drehzahlverlaufs" UBYTE Conv.cAdaPulbw._.z_n_verlauf_S5_S3 1 100 0 10 ECU_ADDRESS 0xFFF8B26A DISPLAY_IDENTIFIER z_n_verlauf.iBew.iAdaPulzs /end MEASUREMENT
/begin MEASUREMENT iAdaPulzs.iBew.zeit_erk_amp "Die Zeit für die Erkennung der Amplitude" UBYTE UMR_MSEC__10_1_0_S5_S3 1 100 0 2500 ECU_ADDRESS 0xFFF8B286 DISPLAY_IDENTIFIER zeit_erk_amp.iBew.iAdaPulzs /end MEASUREMENT
/begin MEASUREMENT iAdaPulzs.iBew.zustand "Zustand Bewertung des Bewertungsablaufes" UBYTE Conv.cAdaPulbw._.zustand_S5_S3 1 100 0 10 ECU_ADDRESS 0xFFF8B269 DISPLAY_IDENTIFIER zustand.iBew.iAdaPulzs /end MEASUREMENT
/begin MEASUREMENT iAdaPulzs.iHsv.hs_verzoegerung "Es soll eine verzögerung angefordert werden." UBYTE Conv.cAdaPulhv._.hs_verzoegerung_S5_S3 1 100 0 2 ECU_ADDRESS 0xFFF8B256 DISPLAY_IDENTIFIER hs_verzoegerung.iHsv.iAdaPulzs /end MEASUREMENT
/begin MEASUREMENT iAdaPulzs.iHsv.iAbbruch.timer "Der aktuelle Timerwert" UWORD UMR_MSEC__10_1_0_S5_S3 1 100 0 655350 ECU_ADDRESS 0xFFF8B250 DISPLAY_IDENTIFIER iAbbruch.iHsv.iAdaPulzs /end MEASUREMENT
/begin MEASUREMENT iAdaPulzs.iHsv.t_bis_puls "Zeit bis Puls startet" UWORD UMR_MSEC__10_1_0_S5_S3 1 100 0 65000 ECU_ADDRESS 0xFFF8B254 DISPLAY_IDENTIFIER t_bis_puls.iHsv.iAdaPulzs /end MEASUREMENT
/begin MEASUREMENT iAdaPulzs.iHsv.zustand "Zustand der Hochschaltverhinderung" UBYTE Conv.cAdaPulhv._.zustand_S5_S3 1 100 0 2 ECU_ADDRESS 0xFFF8B252 DISPLAY_IDENTIFIER zustand.iHsv.iAdaPulzs /end MEASUREMENT
/begin MEASUREMENT iAdaPulzs.iPf.fenster_nach_sf "Flag fuer Verbot auf Abfrage ND_ADABBR nach SF" UBYTE Conv.cAdaPulpf._.fenster_nach_sf_S5_S3 1 100 0 1 BIT_MASK 0x1 ECU_ADDRESS 0xFFF8B29A DISPLAY_IDENTIFIER fenster_nach_sf.iPf.iAdaPulzs /end MEASUREMENT
/begin MEASUREMENT iAdaPulzs.iPf.iZustandstimer.timer "Der aktuelle Timerwert" UWORD UMR_MSEC__10_1_0_S5_S3 1 100 0 655350 ECU_ADDRESS 0xFFF8B294 DISPLAY_IDENTIFIER iZustandstimer.iPf.iAdaPulzs /end MEASUREMENT
/begin MEASUREMENT iAdaPulzs.iPf.t_fenster_nach_sf "Verbotszeit fuer die Abfrage ND_ADABBR nach SF" UWORD UMR_MSEC__10_1_0_S5_S3 1 100 0 2500 ECU_ADDRESS 0xFFF8B298 DISPLAY_IDENTIFIER t_fenster_nach_sf.iPf.iAdaPulzs /end MEASUREMENT
/begin MEASUREMENT iAdaPulzs.iPf.zustand "Zustand Fuelldruckpruefung" UBYTE Conv.cAdaPulpf._.zustand_S5_S3 1 100 0 9 ECU_ADDRESS 0xFFF8B296 DISPLAY_IDENTIFIER zustand.iPf.iAdaPulzs /end MEASUREMENT
/begin MEASUREMENT iAdaPulzs.iTSf.zustand "Zustand Schnellfuellpruefung" UBYTE Conv.cAdaPulsf._.zustand_S5_S3 1 100 0 8 ECU_ADDRESS 0xFFF8B28C DISPLAY_IDENTIFIER zustand.iTSf.iAdaPulzs /end MEASUREMENT
/begin MEASUREMENT iAdaPulzs.iTimerSpzNRea.timer "Der aktuelle Timerwert" UWORD UMR_MSEC__10_1_0_S5_S3 1 100 0 655350 ECU_ADDRESS 0xFFF8B29E DISPLAY_IDENTIFIER iTimerSpzNRea.iAdaPulzs /end MEASUREMENT
/begin MEASUREMENT iAdaPulzs.iZustandstimer.timer "Der aktuelle Timerwert" UWORD UMR_MSEC__10_1_0_S5_S3 1 100 0 655350 ECU_ADDRESS 0xFFF8B29C DISPLAY_IDENTIFIER iZustandstimer.iAdaPulzs /end MEASUREMENT
/begin MEASUREMENT iAdaPulzs.kup_puls "Kupplung die aktuell geprueft wird" UBYTE Conv.cAdaPulzs._.kup_puls_S5_S3 1 100 0 6 ECU_ADDRESS 0xFFF8B2AC DISPLAY_IDENTIFIER kup_puls.iAdaPulzs /end MEASUREMENT
/begin MEASUREMENT iAdaPulzs.kup_puls_alt "Die zuletzt gepulste Kupplung" UBYTE Conv.cAdaPulzs._.kup_puls_alt_S5_S3 1 100 0 6 ECU_ADDRESS 0xFFF8B2C2 DISPLAY_IDENTIFIER kup_puls_alt.iAdaPulzs /end MEASUREMENT
/begin MEASUREMENT iAdaPulzs.kup_puls_neu "Die demnächst zu pulsende Kupplung" UBYTE Conv.cAdaPulzs._.kup_puls_neu_S5_S3 1 100 0 6 ECU_ADDRESS 0xFFF8B2C3 DISPLAY_IDENTIFIER kup_puls_neu.iAdaPulzs /end MEASUREMENT
/begin MEASUREMENT iAdaPulzs.m_t_start "m_t-Wert zu Beginn des Pulses" SWORD UMR_NM__1_1_0_S5_S3 1 100 -200 1300 ECU_ADDRESS 0xFFF8B2BA DISPLAY_IDENTIFIER m_t_start.iAdaPulzs /end MEASUREMENT
/begin MEASUREMENT iAdaPulzs.n_pruefschleife "Zaehler f. erkannte Drehzahlreaktion bei Puls3/Puls4" UBYTE UMR___1_1_0_S5_S3 1 100 0 2 ECU_ADDRESS 0xFFF8B2A6 DISPLAY_IDENTIFIER n_pruefschleife.iAdaPulzs /end MEASUREMENT
/begin MEASUREMENT iAdaPulzs.n_pruefzyklen "Zaehler fuer momentanen Pulspruefzyklus einer Kupplung" UBYTE UMR___1_1_0_S5_S3 1 100 0 255 ECU_ADDRESS 0xFFF8B2A4 DISPLAY_IDENTIFIER n_pruefzyklen.iAdaPulzs /end MEASUREMENT
/begin MEASUREMENT iAdaPulzs.n_pulsgrenz "Zaehler f. Anzahl Pulse einer Kupplung" UBYTE UMR___1_1_0_S5_S3 1 100 0 255 ECU_ADDRESS 0xFFF8B2A5 DISPLAY_IDENTIFIER n_pulsgrenz.iAdaPulzs /end MEASUREMENT
/begin MEASUREMENT iAdaPulzs.p_pulsausgabe "Druck Pruefpuls (Offset auf minimalen FD)" SWORD UMR_BAR__1_1000_0_S5_S3 1 100 -3 3 ECU_ADDRESS 0xFFF8B2B0 DISPLAY_IDENTIFIER p_pulsausgabe.iAdaPulzs /end MEASUREMENT
/begin MEASUREMENT iAdaPulzs.prueftyp "aktiver Prueftyp der Pulsadaption" UBYTE Conv.cAdaPulzs._.prueftyp_S5_S3 1 100 0 10 ECU_ADDRESS 0xFFF8B2A1 DISPLAY_IDENTIFIER prueftyp.iAdaPulzs /end MEASUREMENT
/begin MEASUREMENT iAdaPulzs.prueftyp_alt "Prueftyp des letzten Pulses" UBYTE Conv.cAdaPulzs._.prueftyp_alt_S5_S3 1 100 0 10 ECU_ADDRESS 0xFFF8B2A2 DISPLAY_IDENTIFIER prueftyp_alt.iAdaPulzs /end MEASUREMENT
/begin MEASUREMENT iAdaPulzs.pruefung_kup_fertig "Flag Pruefzyklus (PF/TSF) abgeschlossen" UBYTE Conv.cAdaPulzs._.pruefung_kup_fertig_S5_S3 1 100 0 1 BIT_MASK 0x1 ECU_ADDRESS 0xFFF8B2BD DISPLAY_IDENTIFIER pruefung_kup_fertig.iAdaPulzs /end MEASUREMENT
/begin MEASUREMENT iAdaPulzs.pulsid "Der aktuelle Pruefpuls (Nummer)" UBYTE Conv.cAdaPulzs._.pulsid_S5_S3 1 100 0 4 ECU_ADDRESS 0xFFF8B2A3 DISPLAY_IDENTIFIER pulsid.iAdaPulzs /end MEASUREMENT
/begin MEASUREMENT iAdaPulzs.pulszyklus_beenden "Flag, ob Pulszyklus beendet werden soll" UBYTE Conv.cAdaPulzs._.pulszyklus_beenden_S5_S3 1 100 0 3 ECU_ADDRESS 0xFFF8B2C0 DISPLAY_IDENTIFIER pulszyklus_beenden.iAdaPulzs /end MEASUREMENT
/begin MEASUREMENT iAdaPulzs.schnellfuellung_aktiv "Flag Schnellfuellung aktiv" UBYTE Conv.cAdaPulzs._.schnellfuellung_aktiv_S5_S3 1 100 0 1 BIT_MASK 0x1 ECU_ADDRESS 0xFFF8B2BE DISPLAY_IDENTIFIER schnellfuellung_aktiv.iAdaPulzs /end MEASUREMENT
/begin MEASUREMENT iAdaPulzs.startinfo_index "Der interne Index der zu startenden Kupplung" UBYTE Conv.cAdaPulzs._.startinfo_index_S5_S3 1 100 0 6 ECU_ADDRESS 0xFFF8B2C4 DISPLAY_IDENTIFIER startinfo_index.iAdaPulzs /end MEASUREMENT
/begin MEASUREMENT iAdaPulzs.timer_fenster "Timer fue die Ueberwachungsfenster neg./pos." UWORD UMR_MSEC__10_1_0_S5_S3 1 100 0 5000 ECU_ADDRESS 0xFFF8B2B2 DISPLAY_IDENTIFIER timer_fenster.iAdaPulzs /end MEASUREMENT
/begin MEASUREMENT iAdaPulzs.zeit_sf_1ms "Die Schnellfuellzeit der Pulsadaption in 1ms" UWORD UMR_MSEC__1_1_0_S5_S3 1 100 0 1000 ECU_ADDRESS 0xFFF8B2AE DISPLAY_IDENTIFIER zeit_sf_1ms.iAdaPulzs /end MEASUREMENT
/begin MEASUREMENT iAdaPulzs.zustand "Zustand des Pruefpulsablaufes" UBYTE Conv.cAdaPulzs._.zustand_S5_S3 1 100 0 11 ECU_ADDRESS 0xFFF8B2A0 DISPLAY_IDENTIFIER zustand.iAdaPulzs /end MEASUREMENT
/begin MEASUREMENT iAdaPulzs.zwsp_pf "Zwischenspeicherwert PF-Druck KPAD" SWORD UMR_BAR__1_1000_0_S5_S3 1 100 -5 5 ECU_ADDRESS 0xFFF8B2AA DISPLAY_IDENTIFIER zwsp_pf.iAdaPulzs /end MEASUREMENT
/begin MEASUREMENT iAdaPulzs.zwsp_tsf "Zwischenspeicherwert SF-Zeit kupplungsbez. Adaption" SWORD UMR_MSEC__1_1_0_S5_S3 1 100 -2000 2000 ECU_ADDRESS 0xFFF8B2A8 DISPLAY_IDENTIFIER zwsp_tsf.iAdaPulzs /end MEASUREMENT
/begin MEASUREMENT iAdaUrlufterkPuls.iZeitfenster.timer "Der aktuelle Timerwert" UBYTE UMR_MSEC__10_1_0_S5_S3 1 100 0 2550 ECU_ADDRESS 0xFFF89457 DISPLAY_IDENTIFIER iZeitfenster.iAdaUrlufterkPuls /end MEASUREMENT
/begin MEASUREMENT iAdaUrlufterkPuls.istgang_start "Ist-Gang" SBYTE Conv.cAdaUrlufterkPuls._.istgang_start_S5_S3 1 100 -1 8 ECU_ADDRESS 0xFFF89456 DISPLAY_IDENTIFIER istgang_start.iAdaUrlufterkPuls /end MEASUREMENT
/begin MEASUREMENT iAdaUrlufterkPuls.kfl_ist_start "kfl_ist" UBYTE Conv.cAdaUrlufterkPuls._.kfl_ist_start_S5_S3 1 100 0 2 ECU_ADDRESS 0xFFF89455 DISPLAY_IDENTIFIER kfl_ist_start.iAdaUrlufterkPuls /end MEASUREMENT
/begin MEASUREMENT iAdaUrlufterkPuls.kup "Kupplung die aktuell geprueft wird" UBYTE Conv.cAdaUrlufterkPuls._.kup_S5_S3 1 100 0 6 ECU_ADDRESS 0xFFF89454 DISPLAY_IDENTIFIER kup.iAdaUrlufterkPuls /end MEASUREMENT
/begin MEASUREMENT iAdaUrlufterkPuls.zustand "Zustände in der sich die Urluferkennung befinden kann" UBYTE Conv.cAdaUrlufterkPuls._.zustand_S5_S3 1 100 0 1 ECU_ADDRESS 0xFFF89453 DISPLAY_IDENTIFIER zustand.iAdaUrlufterkPuls /end MEASUREMENT
/begin MEASUREMENT iAdaUrlufterkPulsAnz.f_loeschen_puls_url "Fehler wurde erkannt und der TSF Ada Speicher geloescht" UBYTE Conv.cAdaUrlufterkPulsAnz._.f_loeschen_puls_url_S5_S3 1 100 0 1 BIT_MASK 0x1 ECU_ADDRESS 0xFFF8B2DA DISPLAY_IDENTIFIER f_loeschen_puls_url.iAdaUrlufterkPulsAnz /end MEASUREMENT
/begin MEASUREMENT iAdaUrlufterkPulsAnz.kup_puls_url "Kupplung die aktuell geprueft wird" UBYTE Conv.cAdaUrlufterkPulsAnz._.kup_puls_url_S5_S3 1 100 0 6 ECU_ADDRESS 0xFFF8B2D4 DISPLAY_IDENTIFIER kup_puls_url.iAdaUrlufterkPulsAnz /end MEASUREMENT
/begin MEASUREMENT iAdaUrlufterkPulsAnz.n_guete_puls_url "Guete des Bewerteten Signals." SWORD UMR_U_MIN_1_1_0_S5_S3 1 100 -32768 32767 ECU_ADDRESS 0xFFF8B2D8 DISPLAY_IDENTIFIER n_guete_puls_url.iAdaUrlufterkPulsAnz /end MEASUREMENT
/begin MEASUREMENT iAdaUrlufterkPulsAnz.t_zeitfenster_puls_url "Ueberwachungszeitraum der Urlufterkennung" UWORD UMR_MSEC__10_1_0_S5_S3 1 100 0 10000 ECU_ADDRESS 0xFFF8B2D6 DISPLAY_IDENTIFIER t_zeitfenster_puls_url.iAdaUrlufterkPulsAnz /end MEASUREMENT
/begin MEASUREMENT iAdaUrlufterkSchaltung.iSignal.f_grad_inti "Anforderung an die Gradientenberechung sich beim naechsten Aufruf zu Initialisieren" UBYTE Conv.cAdaUrlufterkSchaltungSignal._.f_grad_inti_S5_S3 1 100 0 1 BIT_MASK 0x1 ECU_ADDRESS 0xFFF8B2E7 DISPLAY_IDENTIFIER f_grad_inti.iSignal.iAdaUrlufterkSchaltung /end MEASUREMENT
/begin MEASUREMENT iAdaUrlufterkSchaltung.iSignal.f_pt1_inti "Anforderung an den PT1 Filter sich beim naechsten Aufruf zu Initialisieren" UBYTE Conv.cAdaUrlufterkSchaltungSignal._.f_pt1_inti_S5_S3 1 100 0 1 BIT_MASK 0x1 ECU_ADDRESS 0xFFF8B2E6 DISPLAY_IDENTIFIER f_pt1_inti.iSignal.iAdaUrlufterkSchaltung /end MEASUREMENT
/begin MEASUREMENT iAdaUrlufterkSchaltung.iSignal.f_signal_ungueltig "Status der Singalberechung" UBYTE Conv.cAdaUrlufterkSchaltungSignal._.f_signal_ungueltig_S5_S3 1 100 0 1 BIT_MASK 0x1 ECU_ADDRESS 0xFFF8B2E0 DISPLAY_IDENTIFIER f_signal_ungueltig.iSignal.iAdaUrlufterkSchaltung /end MEASUREMENT
/begin MEASUREMENT iAdaUrlufterkSchaltung.iSignal.filt_gradient "PT1- Gefilterter Gradient" SWORD UMR_U_MINSEC_10_1_0_S5_S3 1 100 -327680 327670 ECU_ADDRESS 0xFFF8B2F2 DISPLAY_IDENTIFIER filt_gradient.iSignal.iAdaUrlufterkSchaltung /end MEASUREMENT
/begin MEASUREMENT iAdaUrlufterkSchaltung.iSignal.iPt1.x "Filterwert" SLONG UMR___1_300_0_S5_S3 1 100 -7158278.82667 7158278.82333 ECU_ADDRESS 0xFFF8B2F4 DISPLAY_IDENTIFIER iPt1.iSignal.iAdaUrlufterkSchaltung /end MEASUREMENT
/begin MEASUREMENT iAdaUrlufterkSchaltung.iSignal.rowert_gradient "Gradient von rowert_signal" SWORD UMR_U_MINSEC_10_1_0_S5_S3 1 100 -327680 327670 ECU_ADDRESS 0xFFF8B2F0 DISPLAY_IDENTIFIER rowert_gradient.iSignal.iAdaUrlufterkSchaltung /end MEASUREMENT
/begin MEASUREMENT iAdaUrlufterkSchaltung.iSignal.rowert_signal "Signalwert der ausgewaehlten Quelle" SWORD UMR_U_MIN_1_1_0_S5_S3 1 100 -32768 32767 ECU_ADDRESS 0xFFF8B2E4 DISPLAY_IDENTIFIER rowert_signal.iSignal.iAdaUrlufterkSchaltung /end MEASUREMENT
/begin MEASUREMENT iAdaUrlufterkSchaltung.iSignal.sig_grad "Eingangssignal in Gradientenberechung" SWORD UMR_U_MIN_1_1_0_S5_S3 1 100 -32768 32767 ECU_ADDRESS 0xFFF8B2E8 DISPLAY_IDENTIFIER sig_grad.iSignal.iAdaUrlufterkSchaltung /end MEASUREMENT
/begin MEASUREMENT iAdaUrlufterkSchaltung.iSignal.sig_grad_alt "Eingangssignal in Gradientenberechung aus letztem Zyklus" SWORD UMR_U_MIN_1_1_0_S5_S3 1 100 -32768 32767 ECU_ADDRESS 0xFFF8B2EA DISPLAY_IDENTIFIER sig_grad_alt.iSignal.iAdaUrlufterkSchaltung /end MEASUREMENT
/begin MEASUREMENT iAdaUrlufterkSchaltung.iSignal.sig_grad_diff "Aenderung des Eingangssignals" SLONG UMR_U_MIN_1_1_0_S5_S3 1 100 -2147483648 2147483647 ECU_ADDRESS 0xFFF8B2EC DISPLAY_IDENTIFIER sig_grad_diff.iSignal.iAdaUrlufterkSchaltung /end MEASUREMENT
/begin MEASUREMENT iAdaUrlufterkSchaltung.iSignal.signal_quelle "ausgewählte Signalquelle" UBYTE Conv.cAdaUrlufterkSchaltungSignal._.signal_quelle_S5_S3 1 100 0 1 ECU_ADDRESS 0xFFF8B2E1 DISPLAY_IDENTIFIER signal_quelle.iSignal.iAdaUrlufterkSchaltung /end MEASUREMENT
/begin MEASUREMENT iAdaUrlufterkSchaltung.iSignal.signal_quelle_alt "ausgewählte Signalquelle aus letztr Berechung" UBYTE Conv.cAdaUrlufterkSchaltungSignal._.signal_quelle_alt_S5_S3 1 100 0 1 ECU_ADDRESS 0xFFF8B2E2 DISPLAY_IDENTIFIER signal_quelle_alt.iSignal.iAdaUrlufterkSchaltung /end MEASUREMENT
/begin MEASUREMENT iAdaUrlufterkSchaltung.iZeitfenster.timer "Der aktuelle Timerwert" UBYTE UMR_MSEC__10_1_0_S5_S3 1 100 0 2550 ECU_ADDRESS 0xFFF8B2F8 DISPLAY_IDENTIFIER iZeitfenster.iAdaUrlufterkSchaltung /end MEASUREMENT
/begin MEASUREMENT iAdaUrlufterkSchaltung.kup "Kupplung die aktuell geprueft wird" UBYTE Conv.cAdaUrlufterkSchaltung._.kup_S5_S3 1 100 0 5 ECU_ADDRESS 0xFFF8B2DD DISPLAY_IDENTIFIER kup.iAdaUrlufterkSchaltung /end MEASUREMENT
/begin MEASUREMENT iAdaUrlufterkSchaltung.m_motist_start "Kurbelwellenistmoment" SWORD UMR_NM__1_1_0_S5_S3 1 100 -200 1300 ECU_ADDRESS 0xFFF8B2DE DISPLAY_IDENTIFIER m_motist_start.iAdaUrlufterkSchaltung /end MEASUREMENT
/begin MEASUREMENT iAdaUrlufterkSchaltung.zustand "" UBYTE Conv.cAdaUrlufterkSchaltung._.zustand_S5_S3 1 100 0 1 ECU_ADDRESS 0xFFF8B2DC DISPLAY_IDENTIFIER zustand.iAdaUrlufterkSchaltung /end MEASUREMENT
/begin MEASUREMENT iAdaUrlufterkSchaltungAnz.f_loeschen_schalung_url "Fehler wurde erkannt und der TSF Ada Speicher geloescht" UBYTE Conv.cAdaUrlufterkSchaltungAnz._.f_loeschen_schalung_url_S5_S3 1 100 0 1 BIT_MASK 0x1 ECU_ADDRESS 0xFFF8D6E0 DISPLAY_IDENTIFIER f_loeschen_schalung_url.iAdaUrlufterkSchaltungAnz /end MEASUREMENT
/begin MEASUREMENT iAdaUrlufterkSchaltungAnz.kup_schaltung_url "Kupplung die aktuell geprueft wird" UBYTE Conv.cAdaUrlufterkSchaltungAnz._.kup_schaltung_url_S5_S3 1 100 0 5 ECU_ADDRESS 0xFFF8D6D8 DISPLAY_IDENTIFIER kup_schaltung_url.iAdaUrlufterkSchaltungAnz /end MEASUREMENT
/begin MEASUREMENT iAdaUrlufterkSchaltungAnz.m_motist_start_schaltung_url "Kurbelwellenistmoment" SWORD UMR_NM__1_1_0_S5_S3 1 100 -200 1300 ECU_ADDRESS 0xFFF8D6DA DISPLAY_IDENTIFIER m_motist_start_schaltung_url.iAdaUrlufterkSchaltungAnz /end MEASUREMENT
/begin MEASUREMENT iAdaUrlufterkSchaltungAnz.ng_schaltung_url "PT1- Gefilterter Gradient" SWORD UMR_U_MINSEC_10_1_0_S5_S3 1 100 -327680 327670 ECU_ADDRESS 0xFFF8D6DE DISPLAY_IDENTIFIER ng_schaltung_url.iAdaUrlufterkSchaltungAnz /end MEASUREMENT
/begin MEASUREMENT iAdaUrlufterkSchaltungAnz.t_zeitfenster_schaltung_url "Die Schnellfuellzeit der Pulsadaption in 1ms" UWORD UMR_MSEC__10_1_0_S5_S3 1 100 0 10000 ECU_ADDRESS 0xFFF8D6DC DISPLAY_IDENTIFIER t_zeitfenster_schaltung_url.iAdaUrlufterkSchaltungAnz /end MEASUREMENT
/begin MEASUREMENT iAzsIstgang.f_saf_abbruch_invers "Anforderung einer inversen und Abbruch der laufenden Schaltung" UBYTE Conv.cAzsIstGang._.f_saf_abbruch_invers_S5_S3 1 100 0 1 BIT_MASK 0x1 ECU_ADDRESS 0xFFF8CAFD DISPLAY_IDENTIFIER f_saf_abbruch_invers.iAzsIstgang /end MEASUREMENT
/begin MEASUREMENT iAzsIstgang.f_saf_folgeschaltung "Folge-Schaltung (bereits freigegeben)" UBYTE Conv.cAzsIstGang._.f_saf_folgeschaltung_S5_S3 1 100 0 1 BIT_MASK 0x1 ECU_ADDRESS 0xFFF8CAFE DISPLAY_IDENTIFIER f_saf_folgeschaltung.iAzsIstgang /end MEASUREMENT
/begin MEASUREMENT iAzsIstgang.f_saf_freigegeben "Schaltungsanforderung ist freigegeben" UBYTE Conv.cAzsIstGang._.f_saf_freigegeben_S5_S3 1 100 0 1 BIT_MASK 0x1 ECU_ADDRESS 0xFFF8CAFF DISPLAY_IDENTIFIER f_saf_freigegeben.iAzsIstgang /end MEASUREMENT
/begin MEASUREMENT iAzsIstgang.istgang "Ist-Gang" SBYTE Conv.cAzsIstGang._.istgang_S5_S3 1 100 -1 8 ECU_ADDRESS 0xFFF8CAFC DISPLAY_IDENTIFIER istgang.iAzsIstgang /end MEASUREMENT
/begin MEASUREMENT iAzsKflIst.kfl_ist "kfl_ist" UBYTE Conv.cAzsKflIst._.kfl_ist_S5_S3 1 100 0 2 ECU_ADDRESS 0xFFF89744 DISPLAY_IDENTIFIER kfl_ist.iAzsKflIst /end MEASUREMENT
/begin MEASUREMENT iAzsKflSoll.kfl_soll "kfl_soll" UBYTE Conv.cAzsKflSoll._.kfl_soll_S5_S3 1 100 0 2 ECU_ADDRESS 0xFFF89458 DISPLAY_IDENTIFIER kfl_soll.iAzsKflSoll /end MEASUREMENT
/begin MEASUREMENT iAzsKflZiel.kfl_ziel "kfl_ziel" UBYTE Conv.cAzsKflZiel._.kfl_ziel_S5_S3 1 100 0 2 ECU_ADDRESS 0xFFF89459 DISPLAY_IDENTIFIER kfl_ziel.iAzsKflZiel /end MEASUREMENT
/begin MEASUREMENT iAzsKorgl.f_abbruch_schaltung_durch_ga "Soll die laufende Schaltung aufgrund eines Gang-Auslegen beendet werden - Hinweis: auf Messgroesse ist dieses Ereignis nicht sichtbar" UBYTE Conv.cAzsKorgl._.f_abbruch_schaltung_durch_ga_S5_S3 1 100 0 1 BIT_MASK 0x1 ECU_ADDRESS 0xFFF89460 DISPLAY_IDENTIFIER f_abbruch_schaltung_durch_ga.iAzsKorgl /end MEASUREMENT
/begin MEASUREMENT iAzsKorgl.f_kfl_direkt "Soll ein Kraftfluss-Wechsel direkt durchgefuert werden" UBYTE Conv.cAzsKorgl._.f_kfl_direkt_S5_S3 1 100 0 1 BIT_MASK 0x1 ECU_ADDRESS 0xFFF8945C DISPLAY_IDENTIFIER f_kfl_direkt.iAzsKorgl /end MEASUREMENT
/begin RECORD_LAYOUT ZF_KF_INT16_S1_S3 FNC_VALUES 5 SWORD ROW_DIR DIRECT AXIS_PTS_X 3 SWORD INDEX_INCR DIRECT AXIS_PTS_Y 4 SWORD INDEX_INCR DIRECT NO_AXIS_PTS_X 1 ULONG NO_AXIS_PTS_Y 2 ULONG /end RECORD_LAYOUT
/begin RECORD_LAYOUT ZF_KF_INT16_S2_S3 FNC_VALUES 5 SWORD ROW_DIR DIRECT AXIS_PTS_X 3 SWORD INDEX_INCR DIRECT AXIS_PTS_Y 4 SWORD INDEX_INCR DIRECT NO_AXIS_PTS_X 1 ULONG NO_AXIS_PTS_Y 2 ULONG /end RECORD_LAYOUT
/begin RECORD_LAYOUT ZF_KF_INT16_S3_S3 FNC_VALUES 5 SWORD ROW_DIR DIRECT AXIS_PTS_X 3 SWORD INDEX_INCR DIRECT AXIS_PTS_Y 4 SWORD INDEX_INCR DIRECT NO_AXIS_PTS_X 1 ULONG NO_AXIS_PTS_Y 2 ULONG /end RECORD_LAYOUT
/begin RECORD_LAYOUT ZF_KF_INT16_S4_S3 FNC_VALUES 5 SWORD ROW_DIR DIRECT AXIS_PTS_X 3 SWORD INDEX_INCR DIRECT AXIS_PTS_Y 4 SWORD INDEX_INCR DIRECT NO_AXIS_PTS_X 1 ULONG NO_AXIS_PTS_Y 2 ULONG /end RECORD_LAYOUT
/begin RECORD_LAYOUT ZF_KF_INT32_S1_S3 FNC_VALUES 5 SLONG ROW_DIR DIRECT AXIS_PTS_X 3 SLONG INDEX_INCR DIRECT AXIS_PTS_Y 4 SLONG INDEX_INCR DIRECT NO_AXIS_PTS_X 1 ULONG NO_AXIS_PTS_Y 2 ULONG /end RECORD_LAYOUT
/begin RECORD_LAYOUT ZF_KF_INT32_S2_S3 FNC_VALUES 5 SLONG ROW_DIR DIRECT AXIS_PTS_X 3 SLONG INDEX_INCR DIRECT AXIS_PTS_Y 4 SLONG INDEX_INCR DIRECT NO_AXIS_PTS_X 1 ULONG NO_AXIS_PTS_Y 2 ULONG /end RECORD_LAYOUT
/begin RECORD_LAYOUT ZF_KF_INT32_S3_S3 FNC_VALUES 5 SLONG ROW_DIR DIRECT AXIS_PTS_X 3 SLONG INDEX_INCR DIRECT AXIS_PTS_Y 4 SLONG INDEX_INCR DIRECT NO_AXIS_PTS_X 1 ULONG NO_AXIS_PTS_Y 2 ULONG /end RECORD_LAYOUT
/end MODULE
/end PROJECT
