ASAP2_VERSION 1 51
/begin PROJECT ZHBC8600 "Gen2_BMW_System_Supplier_Lib"
/begin MODULE CPP ""
/begin MOD_COMMON "" BYTE_ORDER MSB_FIRST ALIGNMENT_BYTE 1 ALIGNMENT_WORD 2 ALIGNMENT_LONG 4 ALIGNMENT_FLOAT32_IEEE 4 ALIGNMENT_FLOAT64_IEEE 1 /end MOD_COMMON
/begin COMPU_VTAB B_TRUE_M "boolean states, positive logic" TAB_VERB 2 0 "FALSE" 1 "TRUE" DEFAULT_VALUE "xxxxx" /end COMPU_VTAB
/begin COMPU_VTAB CONV_TAB_E_FEHLERIEP_S6_S3 "Conversion table" TAB_VERB 2 0 "NORMALBETRIEB" 1 "FEHLER" DEFAULT_VALUE "" /end COMPU_VTAB
/begin COMPU_VTAB CONV_TAB_E_HYBFKT_S6_S3 "Conversion table" TAB_VERB 16 0 "PASSIV" 1 "ANKOPPELN_VM" 2 "ABKOPPELN_VM" 3 "GANGEINLEGEN" 4 "GANGAUSLEGEN" 5 "OHNABLAUFFKT" 6 "DIREKTSTART" 7 "VM_ZUSTART" 8 "ABSTELLEN_VM" 9 "NICHTDEFINIERT_4" 10 "VM_SCHLEPPSTART" 11 "VM_NOTSTART" 12 "VM_EIN" 13 "VM_AUS" 14 "NICHTDEFINIERT_3" 15 "FEHLER" DEFAULT_VALUE "" /end COMPU_VTAB
/begin COMPU_VTAB CONV_TAB_E_POS_S6_S3 "Conversion table" TAB_VERB 9 0 "D1" 1 "D2" 2 "D3" 3 "D4" 4 "D5" 5 "D" 6 "N" 7 "R" 8 "P" DEFAULT_VALUE "" /end COMPU_VTAB
/begin COMPU_VTAB CONV_TAB_E_SIGSTATUS_S6_S3 "Conversion table" TAB_VERB 3 0 "SIGNAL_OK" 1 "ERSATZWERT" 2 "SIGNAL_FEHLER" DEFAULT_VALUE "" /end COMPU_VTAB
/begin COMPU_VTAB CONV_TAB_E_STATUSADA_S6_S3 "Conversion table" TAB_VERB 3 0 "KEINADAPTION" 1 "TOUCHPOINT_ADAPTION" 2 "REIBWERT_ADAPTION" DEFAULT_VALUE "" /end COMPU_VTAB
/begin COMPU_VTAB CONV_TAB_E_STATUSIAE_S6_S3 "Conversion table" TAB_VERB 9 0 "NICHTDEFINIERT" 1 "OFFEN" 2 "ANGELEGT" 3 "ANFAHREN" 4 "ENTKOPPELT" 5 "ENTKOPPELT_ANFAHREN" 6 "SYNCHRONISIEREN" 7 "GESCHLOSSEN" 8 "OEFFNEN" DEFAULT_VALUE "" /end COMPU_VTAB
/begin COMPU_VTAB CONV_TAB_E_STATUSIEP_S6_S3 "Conversion table" TAB_VERB 5 0 "AUS" 1 "SLEEP" 2 "LP1" 3 "LP2" 4 "LP3" DEFAULT_VALUE "" /end COMPU_VTAB
/begin COMPU_VTAB CONV_TAB_E_STATUSK0_S6_S3 "Conversion table" TAB_VERB 6 0 "OFFEN" 1 "ANGELEGT" 2 "DRUCKSTELLUNG" 3 "SCHLUPFGEREGELT" 4 "GEREGELTGESCHL" 5 "GESCHLOSSEN" DEFAULT_VALUE "" /end COMPU_VTAB
/begin COMPU_VTAB CONV_TAB_E_STATUSKSL_S6_S3 "Conversion table" TAB_VERB 7 0 "KEIN_KRAFTSCHLUSS" 1 "VORW_AUF_ABBAUEND" 2 "VORWAERTS" 3 "RUECKW_AUF_ABBAUEND" 4 "RUECKWAERTS" 5 "VORWAERTS_SCHLUPF" 6 "RUECKWAERTS_SCHLUPF" DEFAULT_VALUE "" /end COMPU_VTAB
/begin COMPU_VTAB CONV_TAB_E_STATUSPSY_S6_S3 "Conversion table" TAB_VERB 5 0 "AUS" 1 "NICHTDEFINIERT" 2 "LP1" 3 "LP2" 4 "LP3" DEFAULT_VALUE "" /end COMPU_VTAB
/begin COMPU_VTAB CONV_TAB_E_STBZHAS_S6_S3 "Conversion table" TAB_VERB 16 0 "INIT_INAKTIV" 1 "ANGEKOPPELT" 2 "ENTKOPPELT" 3 "EFAHREN" 4 "STOP" 5 "LADEN" 6 "ENTK_VMEIN" 7 "EFAHREN_VMEIN" 8 "HYBRID" 9 "NICHTDEFINIERT_1" 10 "NICHTDEFINIERT_2" 11 "NICHTDEFINIERT_3" 12 "NICHTDEFINIERT_4" 13 "NICHTDEFINIERT_5" 14 "INIT_KL15" 15 "FEHLER" DEFAULT_VALUE "" /end COMPU_VTAB
/begin COMPU_VTAB CONV_TAB_E_ZIEP_S6_S3 "Conversion table" TAB_VERB 5 0 "AUS" 1 "SLEEP" 2 "LP1" 3 "LP2" 4 "LP3" DEFAULT_VALUE "" /end COMPU_VTAB
/begin COMPU_VTAB CONV_TAB_E_ZK0_S6_S3 "Conversion table" TAB_VERB 6 0 "OEFFNENSW" 1 "BEFUELLEN" 2 "DRUCKSTELLUNG" 3 "SCHLUPFREGELUNG" 4 "GEREGELTGESCHL" 5 "GESCHLOSSEN" DEFAULT_VALUE "" /end COMPU_VTAB
/begin COMPU_VTAB CONV_TAB_E_ZK0FSTIN_S6_S3 "Conversion table" TAB_VERB 4 0 "OFFEN" 1 "SCHLUPFGEREGELT" 2 "GEREGELTGESCHL" 3 "GESCHLOSSEN" DEFAULT_VALUE "" /end COMPU_VTAB
/begin COMPU_VTAB CONV_TAB_E_ZMODUSIAE_S6_S3 "Conversion table" TAB_VERB 3 0 "EFAHREN_SCHLUPF" 1 "EFAHREN_KRAFTSCHL" 2 "HYBRIDFAHREN" DEFAULT_VALUE "" /end COMPU_VTAB
/begin COMPU_VTAB CONV_TAB_E_ZMODUSIEP_S6_S3 "Conversion table" TAB_VERB 5 0 "KEINVORGABE" 1 "AUS" 2 "LP1" 3 "LP2" 4 "LP3" DEFAULT_VALUE "" /end COMPU_VTAB
/begin COMPU_VTAB CONV_TAB_E_ZNLLSOLL_S6_S3 "Conversion table" TAB_VERB 3 0 "KEINANF" 1 "ANF_ADAP" 2 "ANF_ALLG" DEFAULT_VALUE "" /end COMPU_VTAB
/begin COMPU_METHOD b_int_S6_S3 "Bit Feld" RAT_FUNC "%10.0" "-" COEFFS 0 1 0 0 0 1 /end COMPU_METHOD
/begin COMPU_METHOD B_TRUE_M "boolean states, positive logic" TAB_VERB "%6.3" "" COMPU_TAB_REF B_TRUE_M /end COMPU_METHOD
/begin COMPU_METHOD c_int_l_S6_S3 "Temperatur" RAT_FUNC "%5.0" "°C" COEFFS 0 1 0 0 0 1 /end COMPU_METHOD
/begin COMPU_METHOD c_int_m_S6_S3 "Temperatur" RAT_FUNC "%3.0" "°C" COEFFS 0 1 0 0 0 1 /end COMPU_METHOD
/begin COMPU_METHOD c_int_S6_S3 "Temperatur" RAT_FUNC "%12.6" "°C" COEFFS 0 1 0 0 0 1 /end COMPU_METHOD
/begin COMPU_METHOD E_FEHLERIEP_S6_S3 "" TAB_VERB "%12.6" "" COMPU_TAB_REF CONV_TAB_E_FEHLERIEP_S6_S3 /end COMPU_METHOD
/begin COMPU_METHOD E_HYBFKT_S6_S3 "" TAB_VERB "%12.6" "" COMPU_TAB_REF CONV_TAB_E_HYBFKT_S6_S3 /end COMPU_METHOD
/begin COMPU_METHOD E_POS_S6_S3 "" TAB_VERB "%12.6" "" COMPU_TAB_REF CONV_TAB_E_POS_S6_S3 /end COMPU_METHOD
/begin COMPU_METHOD E_SIGSTATUS_S6_S3 "" TAB_VERB "%12.6" "" COMPU_TAB_REF CONV_TAB_E_SIGSTATUS_S6_S3 /end COMPU_METHOD
/begin COMPU_METHOD E_STATUSADA_S6_S3 "" TAB_VERB "%12.6" "" COMPU_TAB_REF CONV_TAB_E_STATUSADA_S6_S3 /end COMPU_METHOD
/begin COMPU_METHOD E_STATUSIAE_S6_S3 "" TAB_VERB "%12.6" "" COMPU_TAB_REF CONV_TAB_E_STATUSIAE_S6_S3 /end COMPU_METHOD
/begin COMPU_METHOD E_STATUSIEP_S6_S3 "" TAB_VERB "%12.6" "" COMPU_TAB_REF CONV_TAB_E_STATUSIEP_S6_S3 /end COMPU_METHOD
/begin COMPU_METHOD E_STATUSK0_S6_S3 "" TAB_VERB "%12.6" "" COMPU_TAB_REF CONV_TAB_E_STATUSK0_S6_S3 /end COMPU_METHOD
/begin COMPU_METHOD E_STATUSKSL_S6_S3 "" TAB_VERB "%12.6" "" COMPU_TAB_REF CONV_TAB_E_STATUSKSL_S6_S3 /end COMPU_METHOD
/begin COMPU_METHOD E_STATUSPSY_S6_S3 "" TAB_VERB "%12.6" "" COMPU_TAB_REF CONV_TAB_E_STATUSPSY_S6_S3 /end COMPU_METHOD
/begin COMPU_METHOD E_STBZHAS_S6_S3 "" TAB_VERB "%12.6" "" COMPU_TAB_REF CONV_TAB_E_STBZHAS_S6_S3 /end COMPU_METHOD
/begin COMPU_METHOD E_ZIEP_S6_S3 "" TAB_VERB "%12.6" "" COMPU_TAB_REF CONV_TAB_E_ZIEP_S6_S3 /end COMPU_METHOD
/begin COMPU_METHOD E_ZK0_S6_S3 "" TAB_VERB "%12.6" "" COMPU_TAB_REF CONV_TAB_E_ZK0_S6_S3 /end COMPU_METHOD
/begin COMPU_METHOD E_ZK0FSTIN_S6_S3 "" TAB_VERB "%12.6" "" COMPU_TAB_REF CONV_TAB_E_ZK0FSTIN_S6_S3 /end COMPU_METHOD
/begin COMPU_METHOD E_ZMODUSIAE_S6_S3 "" TAB_VERB "%12.6" "" COMPU_TAB_REF CONV_TAB_E_ZMODUSIAE_S6_S3 /end COMPU_METHOD
/begin COMPU_METHOD E_ZMODUSIEP_S6_S3 "" TAB_VERB "%12.6" "" COMPU_TAB_REF CONV_TAB_E_ZMODUSIEP_S6_S3 /end COMPU_METHOD
/begin COMPU_METHOD E_ZNLLSOLL_S6_S3 "" TAB_VERB "%12.6" "" COMPU_TAB_REF CONV_TAB_E_ZNLLSOLL_S6_S3 /end COMPU_METHOD
/begin COMPU_METHOD n_fl_S6_S3 "Drehzahl" RAT_FUNC "%12.6" "1/min" COEFFS 0 1 0 0 0 1 /end COMPU_METHOD
/begin COMPU_METHOD n_int_n_S6_S3 "Drehzahl" RAT_FUNC "%3.0" "1/min" COEFFS 0 1 0 0 0 1 /end COMPU_METHOD
/begin COMPU_METHOD n_int_S6_S3 "Drehzahl" RAT_FUNC "%5.0" "1/min" COEFFS 0 1 0 0 0 1 /end COMPU_METHOD
/begin COMPU_METHOD ng_fl_S6_S3 "Drehzahlgradient" RAT_FUNC "%12.6" "1/min/s" COEFFS 0 1 0 0 0 1 /end COMPU_METHOD
/begin COMPU_METHOD p_fl_S6_S3 "Druck" RAT_FUNC "%12.6" "bar" COEFFS 0 1 0 0 0 1 /end COMPU_METHOD
/begin COMPU_METHOD SAB2_A_00478MPSS_M24_S3_S3 "int = ((phys * 10000) / 478) - (-512) m/s^2" RAT_FUNC "%4.3" "m/s^2" COEFFS 0 20.9205020921 512 0 0 1 /end COMPU_METHOD
/begin COMPU_METHOD SAB2_A_15G1000_M120_S3_S3 "int = ((phys * 1000) / 15) - (-120) g" RAT_FUNC "%4.3" "g" COEFFS 0 66.6666666667 120 0 0 1 /end COMPU_METHOD
/begin COMPU_METHOD SAB2_A_1MPSS40_M2048_S3_S3 "int = ((phys * 40) / 1) - (-2048) m/s^2" RAT_FUNC "%4.3" "m/s^2" COEFFS 0 40 2048 0 0 1 /end COMPU_METHOD
/begin COMPU_METHOD SAB2_A_204G100000_M2049_S3_S3 "int = ((phys * 100000) / 204) - (-2049) g" RAT_FUNC "%4.3" "g" COEFFS 0 490.196078431 2049 0 0 1 /end COMPU_METHOD
/begin COMPU_METHOD t_fl_S6_S3 "Zeit" RAT_FUNC "%12.6" "s" COEFFS 0 1 0 0 0 1 /end COMPU_METHOD
/begin COMPU_METHOD t_int_d_S6_S3 "Zeit" RAT_FUNC "%4.2" "s" COEFFS 0 100 0 0 0 1 /end COMPU_METHOD
/begin COMPU_METHOD t_int_S6_S3 "Zeit" RAT_FUNC "%11.2" "s" COEFFS 0 100 0 0 0 1 /end COMPU_METHOD
/begin COMPU_METHOD trq_fl_a_S6_S3 "Moment" RAT_FUNC "%12.6" "Nm" COEFFS 0 1 0 0 0 1 /end COMPU_METHOD
/begin COMPU_METHOD trq_fl_S6_S3 "Moment" RAT_FUNC "%5.0" "Nm" COEFFS 0 1 0 0 0 1 /end COMPU_METHOD
/begin COMPU_METHOD trqg_fl_c_S6_S3 "Momentengradient" RAT_FUNC "%12.6" "Nm/s" COEFFS 0 1 0 0 0 1 /end COMPU_METHOD
/begin COMPU_METHOD trqg_fl_S6_S3 "Momentengradient" RAT_FUNC "%5.0" "Nm/s" COEFFS 0 1 0 0 0 1 /end COMPU_METHOD
/begin COMPU_METHOD UMR___1_1000_0_S5_S3 "int = ((phys * 1000) / 1) - (0) [-]" RAT_FUNC "%4.3" "[-]" COEFFS 0 1000 0 0 0 1 /end COMPU_METHOD
/begin COMPU_METHOD UMR___1_100_0_S5_S3 "int = ((phys * 100) / 1) - (0) [-]" RAT_FUNC "%3.2" "[-]" COEFFS 0 100 0 0 0 1 /end COMPU_METHOD
/begin COMPU_METHOD UMR___1_1_0_S5_S3 "int = ((phys * 1) / 1) - (0) [-]" RAT_FUNC "%1.0" "[-]" COEFFS 0 1 0 0 0 1 /end COMPU_METHOD
/begin COMPU_METHOD UMR_GRADC__1_1_M40_S5_S3 "int = ((phys * 1) / 1) - (-40) [°C]" RAT_FUNC "%1.0" "[°C]" COEFFS 0 1 40 0 0 1 /end COMPU_METHOD
/begin COMPU_METHOD UMR_MA__1_10_0_S5_S3 "int = ((phys * 10) / 1) - (0) [mA]" RAT_FUNC "%2.1" "[mA]" COEFFS 0 10 0 0 0 1 /end COMPU_METHOD
/begin COMPU_METHOD UMR_NM__1_1_0_S5_S3 "int = ((phys * 1) / 1) - (0) [Nm]" RAT_FUNC "%1.0" "[Nm]" COEFFS 0 1 0 0 0 1 /end COMPU_METHOD
/begin COMPU_METHOD UMR_U_MIN_1_1_0_S5_S3 "int = ((phys * 1) / 1) - (0) [U/min]" RAT_FUNC "%1.0" "[U/min]" COEFFS 0 1 0 0 0 1 /end COMPU_METHOD
/begin COMPU_METHOD UMR_U_MINTASK_1_100_0_S5_S3 "int = ((phys * 100) / 1) - (0) [U/(min*task)]" RAT_FUNC "%3.2" "[U/(min*task)]" COEFFS 0 100 0 0 0 1 /end COMPU_METHOD
/begin COMPU_METHOD v_fl_S6_S3 "Geschwindigkeit" RAT_FUNC "%12.6" "km/h" COEFFS 0 1 0 0 0 1 /end COMPU_METHOD
/begin COMPU_METHOD vg_fl_S6_S3 "Geschwindigkeitsgradient" RAT_FUNC "%12.6" "km/h/s" COEFFS 0 1 0 0 0 1 /end COMPU_METHOD
/begin COMPU_METHOD void_fl_S6_S3 "ohne Umrechnung" RAT_FUNC "%12.6" "-" COEFFS 0 1 0 0 0 1 /end COMPU_METHOD
/begin COMPU_METHOD void_int_b_S6_S3 "ohne Umrechnung" RAT_FUNC "%5.0" "-" COEFFS 0 1 0 0 0 1 /end COMPU_METHOD
/begin COMPU_METHOD void_int_e_S6_S3 "ohne Umrechnung" RAT_FUNC "%1.0" "-" COEFFS 0 1 0 0 0 1 /end COMPU_METHOD
/begin COMPU_METHOD void_int_S6_S3 "ohne Umrechnung" RAT_FUNC "%3.0" "-" COEFFS 0 1 0 0 0 1 /end COMPU_METHOD
/begin COMPU_METHOD VOID_SCALING_f_S6_S3 "Void scaling for unscaled variables" RAT_FUNC "%12.6" "" COEFFS 0 1 0 0 0 1 /end COMPU_METHOD
/begin COMPU_METHOD VOID_SCALING_S6_S3 "Void scaling for unscaled variables" RAT_FUNC "%1.0" "" COEFFS 0 1 0 0 0 1 /end COMPU_METHOD
/begin COMPU_METHOD X1_M "[1] no unit" RAT_FUNC "%6.2" "" COEFFS 0 1 0 0 0 1 /end COMPU_METHOD
/begin CHARACTERISTIC ANALYSE_HAS_BYP_VECTOR "Vector für Bypass-Grösse analyse_has_byp" VALUE 0x1D73ED UBYTE_COL_DIRECT_S6_S3 0 void_int_S6_S3 0 255 /end CHARACTERISTIC
/begin CHARACTERISTIC BM_ERSFKTHI_EMFEHLER_FRK_HAS "Bitmaske zur Festlegung der Diagnose Ersatzfunktionen die zur Anzeige einer EM Fehlfunktion (HI-32bit) in der HAS führt" VALUE 0x1971C8 ULONG_COL_DIRECT_S6_S3 0 b_int_S6_S3 0 4294967295 /end CHARACTERISTIC
/begin CHARACTERISTIC BM_ERSFKT_EMFEHLER_FRK_HAS "Bitmaske zur Festlegung der Diagnose Ersatzfunktionen die zur Anzeige einer EM Fehlfunktion in der HAS führt" VALUE 0x1971CC ULONG_COL_DIRECT_S6_S3 0 b_int_S6_S3 0 4294967295 /end CHARACTERISTIC
/begin CHARACTERISTIC BM_ERSFKT_HI_ZUST_HALTEN_HAS "Bitmaske zur Festlegung der Diagnose Ersatzfunktionen (HI-Byte) die zum Halten des aktuellen Soll-Betriebszustands der Hybrid-Zustandssteuerung führen" VALUE 0x197584 ULONG_COL_DIRECT_S6_S3 0 b_int_S6_S3 0 4294967295 /end CHARACTERISTIC
/begin CHARACTERISTIC BM_ERSFKT_HI_ZUST_INIT_HAS "Bitmaske zur Festlegung der Diagnose Ersatzfunktionen (HI-Byte) die zum Rücksprung des Soll-Betriebszustands der Hybrid-Zustandssteuerung in den Initialisierungszustand führen" VALUE 0x197588 ULONG_COL_DIRECT_S6_S3 0 b_int_S6_S3 0 4294967295 /end CHARACTERISTIC
/begin CHARACTERISTIC BM_ERSFKT_ZUST_HALTEN_HAS "Bitmaske zur Festlegung der Diagnose Ersatzfunktionen die zum Halten des aktuellen Soll-Betriebszustands der Hybrid-Zustandssteuerung führen" VALUE 0x19758C ULONG_COL_DIRECT_S6_S3 0 b_int_S6_S3 0 4294967295 /end CHARACTERISTIC
/begin CHARACTERISTIC BM_ERSFKT_ZUST_INIT_HAS "Bitmaske zur Festlegung der Diagnose Ersatzfunktionen die zum Rücksprung des Soll-Betriebszustands der Hybrid-Zustandssteuerung in den Initialisierungszustand führen" VALUE 0x197590 ULONG_COL_DIRECT_S6_S3 0 b_int_S6_S3 0 4294967295 /end CHARACTERISTIC
/begin CHARACTERISTIC BYP_VNR_HAS_BYP_VECTOR "Vector für Bypass-Grösse byp_vnr_has_byp" VALUE 0x1D73EE UBYTE_COL_DIRECT_S6_S3 0 void_int_S6_S3 0 255 /end CHARACTERISTIC
/begin MEASUREMENT DD_SDIAGo2_CC_Diagout "" UBYTE void_int_S6_S3 1 100 0 255 ECU_ADDRESS 0xFFF96D50 /end MEASUREMENT
/begin MEASUREMENT DD_SDIAGo2_CC_Diagout_a "HAS-Diagnose: Fehlerflag zur Überwachung (Anfilterung) VM-Drehzahl fällt nicht auf 0 1/min beim K0 öffnen" UBYTE void_int_S6_S3 1 100 0 255 ECU_ADDRESS 0xFFF96D51 /end MEASUREMENT
/begin MEASUREMENT DD_SDIAGo2_CC_Diagout_b "Fehlerflag: kfc_c0noclose wird gesetzt" UBYTE void_int_S6_S3 1 100 0 255 ECU_ADDRESS 0xFFF96D52 /end MEASUREMENT
/begin MEASUREMENT DD_SDIAGo2_CC_Diagout_c "Fehlerflag: Zeigt an, ob ein Ölversorgungsfehler mindestens für die Filterzeit vorlag." UBYTE void_int_S6_S3 1 100 0 255 ECU_ADDRESS 0xFFF96D53 /end MEASUREMENT
/begin MEASUREMENT DD_SDIAGo2_CC_Diagout_d "Fehlerflag: Zeigt an, ob das Fehlerereignis, dass der VM aus ist, mindestens für die Filterzeit vorlag." UBYTE void_int_S6_S3 1 100 0 255 ECU_ADDRESS 0xFFF96D54 /end MEASUREMENT
/begin MEASUREMENT DD_SDIAGo2_CC_Diagout_e "Fehlerflag: Zeigt an, ob das Fehlerereignis, dass die EM-Istdrehzahl zu klein ist, mindestens für die Filterzeit vorlag." UBYTE void_int_S6_S3 1 100 0 255 ECU_ADDRESS 0xFFF96D55 /end MEASUREMENT
/begin MEASUREMENT DD_SDIAGo2_CC_Diagout_f "Fehlerflag: Zeigt an, ob das Fehlerereignis, dass die K0-Differenzdrehzahl zu groß ist, mindestens für die Filterzeit vorlag." UBYTE void_int_S6_S3 1 100 0 255 ECU_ADDRESS 0xFFF96D56 /end MEASUREMENT
/begin MEASUREMENT DD_SDIAGo2_CC_Diagout_g "Fehlerflag: kfc_c0noclose Pruefbedingung erfuellt" UBYTE void_int_S6_S3 1 100 0 255 ECU_ADDRESS 0xFFF96D57 /end MEASUREMENT
/begin CHARACTERISTIC FK_MGWUNSCHFPW "Filterkoeffizient zur Berechnung Gradient Fahrsollmoment" VALUE 0x1975E8 FLOAT32_IEEE_COL_DIRECT_S6_S3 0 void_fl_S6_S3 -3.40282e+038 3.40282e+038 /end CHARACTERISTIC
/begin CHARACTERISTIC FK_NDGK0 "Filterkoeffizient zu Berechnung Gradient Differenzdrehzahl K0" VALUE 0x1975EC FLOAT32_IEEE_COL_DIRECT_S6_S3 0 void_fl_S6_S3 -3.40282e+038 3.40282e+038 /end CHARACTERISTIC
/begin CHARACTERISTIC FK_NGVM_HAS "Filterkoeffizient zu Berechnung Gradient Differenzdrehzahl VM" VALUE 0x1975F0 FLOAT32_IEEE_COL_DIRECT_S6_S3 0 void_fl_S6_S3 -3.40282e+038 3.40282e+038 /end CHARACTERISTIC
/begin CHARACTERISTIC FK_NMINPSYSEM_1_HAS "Filterkoeffzient " VALUE 0x1975F4 FLOAT32_IEEE_COL_DIRECT_S6_S3 0 void_fl_S6_S3 -3.40282e+038 3.40282e+038 /end CHARACTERISTIC
/begin CHARACTERISTIC FK_NMINPSYSEM_2_HAS "Maximaler Drehzahlgradient der minimalen EM-Drehzahl zur Sicherstellung der Ölversorgung der HAS" VALUE 0x1975F8 FLOAT32_IEEE_COL_DIRECT_S6_S3 0 void_fl_S6_S3 -3.40282e+038 3.40282e+038 /end CHARACTERISTIC
/begin CHARACTERISTIC FK_VGF_HAS "Filterkoeffizient zur Berechnung des Fahrzeuggeschwindigkeitsgradienten in der Hybridablaufsteuerung" VALUE 0x1975FC FLOAT32_IEEE_COL_DIRECT_S6_S3 0 void_fl_S6_S3 0 1 /end CHARACTERISTIC
/begin CHARACTERISTIC FSF1 "No Description" VALUE 0x197580 FLOAT32_IEEE_COL_DIRECT_S6_S3 0 void_fl_S6_S3 -3.40282e+038 3.40282e+038 /end CHARACTERISTIC
/begin MEASUREMENT FSFSig1 "" FLOAT32_IEEE void_fl_S6_S3 1 100 0 10 ECU_ADDRESS 0xFFF96CD4 /end MEASUREMENT
/begin MEASUREMENT FSFSig2 "" FLOAT32_IEEE trq_fl_a_S6_S3 1 100 0 10 ECU_ADDRESS 0xFFF96CD8 /end MEASUREMENT
/begin CHARACTERISTIC F_NMOTUEB "LEVEL2: Faktor Abregeldrehzahl für die Motordrehzahlueberwachung" VALUE 0x1D7C91 ZF_kw_ui8_S5_S3 0.1 UMR___1_100_0_S5_S3 1 1.1 /end CHARACTERISTIC
/begin CHARACTERISTIC HAS_AKTIV_HAS_BYP_VECTOR "Vector für Bypass-Grösse has_aktiv_has_byp" VALUE 0x1D73EF UBYTE_COL_DIRECT_S6_S3 0 void_int_S6_S3 0 255 /end CHARACTERISTIC
/begin CHARACTERISTIC KF_IEDSMINMMOTCGLOGIKUEB_C "Minimale Druckreglerstromschwelle fuer EDS" MAP 0x1CF98C ZF_kf_si16_S5_S3 1200 UMR_MA__1_10_0_S5_S3 0 1200
 /begin AXIS_DESCR STD_AXIS iUl2ItfipInt.m_mot_l2 UMR_NM__1_1_0_S5_S3 4 -200 1300 DEPOSIT ABSOLUTE /end AXIS_DESCR
 /begin AXIS_DESCR STD_AXIS iUl2ItfipInt.c_getr_l2 UMR_GRADC__1_1_M40_S5_S3 4 -40 215 DEPOSIT ABSOLUTE /end AXIS_DESCR
/end CHARACTERISTIC
/begin CHARACTERISTIC KF_IEDSMINMMOTCGLOGIKUEB_D "Minimale Druckreglerstromschwelle fuer EDS" MAP 0x1CFA90 ZF_kf_si16_S5_S3 1200 UMR_MA__1_10_0_S5_S3 0 1200
 /begin AXIS_DESCR STD_AXIS iUl2ItfipInt.m_mot_l2 UMR_NM__1_1_0_S5_S3 4 -200 1300 DEPOSIT ABSOLUTE /end AXIS_DESCR
 /begin AXIS_DESCR STD_AXIS iUl2ItfipInt.c_getr_l2 UMR_GRADC__1_1_M40_S5_S3 4 -40 215 DEPOSIT ABSOLUTE /end AXIS_DESCR
/end CHARACTERISTIC
/begin CHARACTERISTIC KF_IEDSMINMMOTCGLOGIKUEB_E "Minimale Druckreglerstromschwelle fuer EDS" MAP 0x1CFB94 ZF_kf_si16_S5_S3 1200 UMR_MA__1_10_0_S5_S3 0 1200
 /begin AXIS_DESCR STD_AXIS iUl2ItfipInt.m_mot_l2 UMR_NM__1_1_0_S5_S3 4 -200 1300 DEPOSIT ABSOLUTE /end AXIS_DESCR
 /begin AXIS_DESCR STD_AXIS iUl2ItfipInt.c_getr_l2 UMR_GRADC__1_1_M40_S5_S3 4 -40 215 DEPOSIT ABSOLUTE /end AXIS_DESCR
/end CHARACTERISTIC
/begin CHARACTERISTIC KF_IEDSMINOFFMMOTCGLOGIKUEB_C "Minimale Druckreglerstromschwelle fuer EDS" MAP 0x1CF9C4 ZF_kf_si16_S5_S3 1200 UMR_MA__1_10_0_S5_S3 0 1200
 /begin AXIS_DESCR STD_AXIS iUl2ItfipInt.m_mot_l2 UMR_NM__1_1_0_S5_S3 4 -200 1300 DEPOSIT ABSOLUTE /end AXIS_DESCR
 /begin AXIS_DESCR STD_AXIS iUl2ItfipInt.c_getr_l2 UMR_GRADC__1_1_M40_S5_S3 4 -40 215 DEPOSIT ABSOLUTE /end AXIS_DESCR
/end CHARACTERISTIC
/begin CHARACTERISTIC KF_IEDSMINOFFMMOTCGLOGIKUEB_D "Minimale Druckreglerstromschwelle fuer EDS" MAP 0x1CFAC8 ZF_kf_si16_S5_S3 1200 UMR_MA__1_10_0_S5_S3 0 1200
 /begin AXIS_DESCR STD_AXIS iUl2ItfipInt.m_mot_l2 UMR_NM__1_1_0_S5_S3 4 -200 1300 DEPOSIT ABSOLUTE /end AXIS_DESCR
 /begin AXIS_DESCR STD_AXIS iUl2ItfipInt.c_getr_l2 UMR_GRADC__1_1_M40_S5_S3 4 -40 215 DEPOSIT ABSOLUTE /end AXIS_DESCR
/end CHARACTERISTIC
/begin CHARACTERISTIC KF_IEDSMINOFFMMOTCGLOGIKUEB_E "Minimale Druckreglerstromschwelle fuer EDS" MAP 0x1CFBCC ZF_kf_si16_S5_S3 1200 UMR_MA__1_10_0_S5_S3 0 1200
 /begin AXIS_DESCR STD_AXIS iUl2ItfipInt.m_mot_l2 UMR_NM__1_1_0_S5_S3 4 -200 1300 DEPOSIT ABSOLUTE /end AXIS_DESCR
 /begin AXIS_DESCR STD_AXIS iUl2ItfipInt.c_getr_l2 UMR_GRADC__1_1_M40_S5_S3 4 -40 215 DEPOSIT ABSOLUTE /end AXIS_DESCR
/end CHARACTERISTIC
/begin CHARACTERISTIC KF_MAXSTOERCGDELTAI_EDSLOGIK_C "Minimale Druckreglerstromschwelle fuer EDS" MAP 0x1CFA18 ZF_kf_si16_S5_S3 255 UMR___1_1_0_S5_S3 0 255
 /begin AXIS_DESCR STD_AXIS iUl2ItfipInt.c_getr_l2 UMR_GRADC__1_1_M40_S5_S3 6 -40 215 DEPOSIT ABSOLUTE /end AXIS_DESCR
 /begin AXIS_DESCR STD_AXIS NO_INPUT_QUANTITY UMR_MA__1_10_0_S5_S3 6 0 1000 DEPOSIT ABSOLUTE /end AXIS_DESCR
/end CHARACTERISTIC
/begin CHARACTERISTIC KF_MAXSTOERCGDELTAI_EDSLOGIK_D "Minimale Druckreglerstromschwelle fuer EDS" MAP 0x1CFB1C ZF_kf_si16_S5_S3 255 UMR___1_1_0_S5_S3 0 255
 /begin AXIS_DESCR STD_AXIS iUl2ItfipInt.c_getr_l2 UMR_GRADC__1_1_M40_S5_S3 6 -40 215 DEPOSIT ABSOLUTE /end AXIS_DESCR
 /begin AXIS_DESCR STD_AXIS NO_INPUT_QUANTITY UMR_MA__1_10_0_S5_S3 6 0 1000 DEPOSIT ABSOLUTE /end AXIS_DESCR
/end CHARACTERISTIC
/begin CHARACTERISTIC KF_MAXSTOERCGDELTAI_EDSLOGIK_E "Minimale Druckreglerstromschwelle fuer EDS" MAP 0x1CFC20 ZF_kf_si16_S5_S3 255 UMR___1_1_0_S5_S3 0 255
 /begin AXIS_DESCR STD_AXIS iUl2ItfipInt.c_getr_l2 UMR_GRADC__1_1_M40_S5_S3 6 -40 215 DEPOSIT ABSOLUTE /end AXIS_DESCR
 /begin AXIS_DESCR STD_AXIS NO_INPUT_QUANTITY UMR_MA__1_10_0_S5_S3 6 0 1000 DEPOSIT ABSOLUTE /end AXIS_DESCR
/end CHARACTERISTIC
/begin CHARACTERISTIC KF_NGPOSMEUEB "Schwellwert für zulässigen Gradient bei posME bei Übersetzungswechsel" MAP 0x1CFCF8 ZF_kf_ui16_S5_S3 100 UMR_U_MINTASK_1_100_0_S5_S3 0 100
 /begin AXIS_DESCR STD_AXIS NO_INPUT_QUANTITY UMR___1_1000_0_S5_S3 8 0 65.535 DEPOSIT ABSOLUTE /end AXIS_DESCR
 /begin AXIS_DESCR STD_AXIS NO_INPUT_QUANTITY UMR_NM__1_1_0_S5_S3 4 0 65535 DEPOSIT ABSOLUTE /end AXIS_DESCR
/end CHARACTERISTIC
/begin CHARACTERISTIC KL_IEDSMINOFFCG_BEF1_C "Offset auf Stromschwelle zur Erkennung eines EDS-Logik-Fehlers bei 1. Befüllung" CURVE 0x1CF9FC ZF_kl_si16_S5_S3 1200 UMR_MA__1_10_0_S5_S3 0 1200
 /begin AXIS_DESCR STD_AXIS iUl2ItfipInt.c_getr_l2 UMR_GRADC__1_1_M40_S5_S3 6 -40 215 DEPOSIT ABSOLUTE /end AXIS_DESCR
/end CHARACTERISTIC
/begin CHARACTERISTIC KL_IEDSMINOFFCG_BEF1_D "Offset auf Stromschwelle zur Erkennung eines EDS-Logik-Fehlers bei 1. Befüllung" CURVE 0x1CFB00 ZF_kl_si16_S5_S3 1200 UMR_MA__1_10_0_S5_S3 0 1200
 /begin AXIS_DESCR STD_AXIS iUl2ItfipInt.c_getr_l2 UMR_GRADC__1_1_M40_S5_S3 6 -40 215 DEPOSIT ABSOLUTE /end AXIS_DESCR
/end CHARACTERISTIC
/begin CHARACTERISTIC KL_IEDSMINOFFCG_BEF1_E "Offset auf Stromschwelle zur Erkennung eines EDS-Logik-Fehlers bei 1. Befüllung" CURVE 0x1CFC04 ZF_kl_si16_S5_S3 1200 UMR_MA__1_10_0_S5_S3 0 1200
 /begin AXIS_DESCR STD_AXIS iUl2ItfipInt.c_getr_l2 UMR_GRADC__1_1_M40_S5_S3 6 -40 215 DEPOSIT ABSOLUTE /end AXIS_DESCR
/end CHARACTERISTIC
/begin CHARACTERISTIC KL_MAX_STOEROFFCG_BEF1_C "Minimale Druckreglerstromschwelle fuer EDS" CURVE 0x1CFA80 ZF_kl_ui8_S5_S3 255 UMR___1_1_0_S5_S3 0 255
 /begin AXIS_DESCR STD_AXIS iUl2ItfipInt.c_getr_l2 UMR_GRADC__1_1_M40_S5_S3 6 -40 215 DEPOSIT ABSOLUTE /end AXIS_DESCR
/end CHARACTERISTIC
/begin CHARACTERISTIC KL_MAX_STOEROFFCG_BEF1_D "Minimale Druckreglerstromschwelle fuer EDS" CURVE 0x1CFB84 ZF_kl_ui8_S5_S3 255 UMR___1_1_0_S5_S3 0 255
 /begin AXIS_DESCR STD_AXIS iUl2ItfipInt.c_getr_l2 UMR_GRADC__1_1_M40_S5_S3 6 -40 215 DEPOSIT ABSOLUTE /end AXIS_DESCR
/end CHARACTERISTIC
/begin CHARACTERISTIC KL_MAX_STOEROFFCG_BEF1_E "Minimale Druckreglerstromschwelle fuer EDS" CURVE 0x1CFC88 ZF_kl_ui8_S5_S3 255 UMR___1_1_0_S5_S3 0 255
 /begin AXIS_DESCR STD_AXIS iUl2ItfipInt.c_getr_l2 UMR_GRADC__1_1_M40_S5_S3 6 -40 215 DEPOSIT ABSOLUTE /end AXIS_DESCR
/end CHARACTERISTIC
/begin AXIS_PTS KL_MK0SCHLNICHTMVM_DIHO_X "Minimales K0-Moment in Abhängigkeit der VM-Öl-Temperatur zur Erkennung, dass die K0 nicht schliesst." 0x19723C c_vm_in FLOAT32_IEEE_X_INCR_DIRECT_S6_S3 0 trq_fl_a_S6_S3 8 -1000 1000 DEPOSIT ABSOLUTE /end AXIS_PTS
/begin CHARACTERISTIC KL_MK0SCHLNICHTMVM_DIHO_Y "Minimales K0-Moment in Abhängigkeit der VM-Öl-Temperatur zur Erkennung, dass die K0 nicht schliesst." CURVE 0x19725C FLOAT32_IEEE_COL_DIRECT_S6_S3 0 trq_fl_a_S6_S3 -1000 1000
 /begin AXIS_DESCR COM_AXIS c_vm_in trq_fl_a_S6_S3 8 -1000 1000 DEPOSIT ABSOLUTE AXIS_PTS_REF KL_MK0SCHLNICHTMVM_DIHO_X /end AXIS_DESCR
/end CHARACTERISTIC
/begin CHARACTERISTIC KL_MMOTUEBNEGME1 "Schwellwert 1 fuer nicht zul. Ausgabe NEGME in Abh. von der Uebersetzung" CURVE 0x1CFD58 ZF_kl_ui16_S5_S3 1300 UMR_NM__1_1_0_S5_S3 0 1300
 /begin AXIS_DESCR STD_AXIS NO_INPUT_QUANTITY UMR___1_1000_0_S5_S3 8 0 65.535 DEPOSIT ABSOLUTE /end AXIS_DESCR
/end CHARACTERISTIC
/begin CHARACTERISTIC KL_MMOTUEBNEGME2 "Schwellwert 2 fuer nicht zul. Ausgabe NEGME in Abh. von der Uebersetzung" CURVE 0x1CFD7C ZF_kl_si16_S5_S3 1300 UMR_NM__1_1_0_S5_S3 -1300 0
 /begin AXIS_DESCR STD_AXIS NO_INPUT_QUANTITY UMR___1_1000_0_S5_S3 8 -32.768 32.767 DEPOSIT ABSOLUTE /end AXIS_DESCR
/end CHARACTERISTIC
/begin CHARACTERISTIC KL_MMOTUEBPOSME1 "Schwellwert 1 fuer nicht zul. Ausgabe POSME in Abh. von der Uebersetzung" CURVE 0x1CFCB0 ZF_kl_ui16_S5_S3 1300 UMR_NM__1_1_0_S5_S3 0 1300
 /begin AXIS_DESCR STD_AXIS NO_INPUT_QUANTITY UMR___1_1000_0_S5_S3 8 0 65.535 DEPOSIT ABSOLUTE /end AXIS_DESCR
/end CHARACTERISTIC
/begin CHARACTERISTIC KL_MMOTUEBPOSME2 "Schwellwert 2 fuer nicht zul. Ausgabe POSME in Abh. von der Uebersetzung" CURVE 0x1CFCD4 ZF_kl_ui16_S5_S3 1300 UMR_NM__1_1_0_S5_S3 0 1300
 /begin AXIS_DESCR STD_AXIS NO_INPUT_QUANTITY UMR___1_1000_0_S5_S3 8 0 65.535 DEPOSIT ABSOLUTE /end AXIS_DESCR
/end CHARACTERISTIC
/begin CHARACTERISTIC MAX_STOER_NMOTUEB "LEVEL2: Maximaler Grenzwert des Störzählers fuer NMOT-Uew." VALUE 0x1D7C92 ZF_kw_ui8_S5_S3 99 UMR___1_1_0_S5_S3 1 100 /end CHARACTERISTIC
/begin CHARACTERISTIC MG_K0MODHAS_LAU_ABK "Gradient zum Abbau des modifizierten K0-Moments im Zustand 'Last-Übernahme' beim Abkoppeln" VALUE 0x1CFDB4 FLOAT32_IEEE_COL_DIRECT_S6_S3 0 trqg_fl_c_S6_S3 -10000 0 /end CHARACTERISTIC
/begin CHARACTERISTIC MG_SOLL_K0_NEG_HAS_BYP_VECTOR "Vector für Bypass-Grösse mg_soll_k0_neg_has_byp" VALUE 0x1D73F0 UBYTE_COL_DIRECT_S6_S3 0 void_int_S6_S3 0 255 /end CHARACTERISTIC
/begin CHARACTERISTIC MG_SOLL_K0_POS_HAS_BYP_VECTOR "Vector für Bypass-Grösse mg_soll_k0_pos_has_byp" VALUE 0x1D73F1 UBYTE_COL_DIRECT_S6_S3 0 void_int_S6_S3 0 255 /end CHARACTERISTIC
/begin CHARACTERISTIC MO_MOD_EM_HST_HAS_BYP_VECTOR "Vector für Bypass-Grösse mo_mod_em_hst_has_byp" VALUE 0x1D73F2 UBYTE_COL_DIRECT_S6_S3 0 void_int_S6_S3 0 255 /end CHARACTERISTIC
/begin CHARACTERISTIC MPT_MWUNSCHFPWHST "Filterkoeffizient Fahrerwunschmoment" VALUE 0x197604 FLOAT32_IEEE_COL_DIRECT_S6_S3 0 trq_fl_a_S6_S3 -3.40282e+038 3.40282e+038 /end CHARACTERISTIC
/begin CHARACTERISTIC MS_K0NDSK0ZUGROSS_ERK_AUW_HAS "K0-Sollmomentenschwelle bei deren Überschreiten von einer nicht erfolgreichen VM-Zwangsankopplung ausgegangen wird." VALUE 0x1971D4 FLOAT32_IEEE_COL_DIRECT_S6_S3 0 trq_fl_a_S6_S3 -1000 1000 /end CHARACTERISTIC
/begin CHARACTERISTIC MS_K0OEFFNICHT_DIHO "Maximales K0-Moment zur Erkennung K0 öffnet nicht" VALUE 0x1971D8 FLOAT32_IEEE_COL_DIRECT_S6_S3 0 trq_fl_a_S6_S3 -1000 1000 /end CHARACTERISTIC
/begin CHARACTERISTIC MS_K0SCHLNICHTPB_DIHO "" VALUE 0x1971DC FLOAT32_IEEE_COL_DIRECT_S6_S3 0 trq_fl_a_S6_S3 -1000 1000 /end CHARACTERISTIC
/begin CHARACTERISTIC MS_VMK0OEFFNICHT_DIHO "Maximales VM-Moment zur Erkennung K0 öffnet nicht" VALUE 0x1971E0 FLOAT32_IEEE_COL_DIRECT_S6_S3 0 trq_fl_a_S6_S3 -1000 1000 /end CHARACTERISTIC
/begin CHARACTERISTIC M_K0_HAS_BYP_VECTOR "Vector für Bypass-Grösse m_k0_has_byp" VALUE 0x1D73F3 UBYTE_COL_DIRECT_S6_S3 0 void_int_S6_S3 0 255 /end CHARACTERISTIC
/begin CHARACTERISTIC M_K0_MBER_HAS_BYP_VECTOR "Vector für Bypass-Grösse m_k0_mber_has_byp" VALUE 0x1D73F4 UBYTE_COL_DIRECT_S6_S3 0 void_int_S6_S3 0 255 /end CHARACTERISTIC
/begin CHARACTERISTIC M_MAX_EM_HAS_BYP_VECTOR "Vector für Bypass-Grösse m_max_em_has_byp" VALUE 0x1D73F5 UBYTE_COL_DIRECT_S6_S3 0 void_int_S6_S3 0 255 /end CHARACTERISTIC
/begin CHARACTERISTIC M_MAX_IAE_HAS_BYP_VECTOR "Vector für Bypass-Grösse m_max_iae_has_byp" VALUE 0x1D73F6 UBYTE_COL_DIRECT_S6_S3 0 void_int_S6_S3 0 255 /end CHARACTERISTIC
/begin CHARACTERISTIC M_MERED_MIN "Überwachungsschwelle für die Statusüberwachung des negativen Motoreingriffs" VALUE 0x1D8C1E ZF_kw_ui16_S5_S3 1000 UMR_NM__1_1_0_S5_S3 0 1000 /end CHARACTERISTIC
/begin CHARACTERISTIC M_MIN_EM_HAS_BYP_VECTOR "Vector für Bypass-Grösse m_min_em_has_byp" VALUE 0x1D73F7 UBYTE_COL_DIRECT_S6_S3 0 void_int_S6_S3 0 255 /end CHARACTERISTIC
/begin CHARACTERISTIC M_MOTMAXNEGINT "Deckelung des negativen Motoristmoments" VALUE 0x1D8C1C ZF_kw_si16_S5_S3 255 UMR_NM__1_1_0_S5_S3 -255 0 /end CHARACTERISTIC
/begin CHARACTERISTIC M_MOTMAX_HAS_BYP_VECTOR "Vector für Bypass-Grösse z_svh_has_byp" VALUE 0x1D73F8 UBYTE_COL_DIRECT_S6_S3 0 void_int_S6_S3 0 255 /end CHARACTERISTIC
/begin CHARACTERISTIC M_MOTMININT "Mindestmotormoment zum Einstieg in die Ueberwachung" VALUE 0x1D7C96 ZF_kw_ui8_S5_S3 255 UMR_NM__1_1_0_S5_S3 0 255 /end CHARACTERISTIC
/begin CHARACTERISTIC M_SOLL_EM_HAS_BYP_VECTOR "Vector für Bypass-Grösse m_soll_em_has_byp" VALUE 0x1D73F9 UBYTE_COL_DIRECT_S6_S3 0 void_int_S6_S3 0 255 /end CHARACTERISTIC
/begin CHARACTERISTIC M_SOLL_K0_HAS_BYP_VECTOR "Vector für Bypass-Grösse m_soll_k0_has_byp" VALUE 0x1D73FA UBYTE_COL_DIRECT_S6_S3 0 void_int_S6_S3 0 255 /end CHARACTERISTIC
/begin CHARACTERISTIC M_SOLL_RES_EM_HAS_BYP_VECTOR "Vector für Bypass-Grösse m_soll_res_em_has_byp" VALUE 0x1D73FB UBYTE_COL_DIRECT_S6_S3 0 void_int_S6_S3 0 255 /end CHARACTERISTIC
/begin CHARACTERISTIC NDS_K0K0OEFFNICHT_DIHO "K0-Differenzdrehzahlschwelle als Bedingung zur Anfilterung Fehler K0 oeffnet nicht (nd_k0 = Schwelle)" VALUE 0x1971E4 FLOAT32_IEEE_COL_DIRECT_S6_S3 0 n_fl_S6_S3 0 10000 /end CHARACTERISTIC
/begin CHARACTERISTIC NDS_K0ZUGROSS_ERK_AUW_HAS "Schwelle, oberhalb der erkannt wird, dass die K0-Differenzdrehzahl zu hoch ist." VALUE 0x1971E8 FLOAT32_IEEE_COL_DIRECT_S6_S3 0 n_fl_S6_S3 0 10000 /end CHARACTERISTIC
/begin CHARACTERISTIC ND_MIN_SAF_HAS_BYP_VECTOR "Vector für Bypass-Grösse dn_min_saf_has_byp" VALUE 0x1D8088 UWORD_COL_DIRECT_S6_S3 0 void_int_b_S6_S3 0 65535 /end CHARACTERISTIC
/begin CHARACTERISTIC NGS_VMK0OEFFNICHT_DIHO "Minimaler VM-Gradient zur Erkennung K0 öffnet nicht" VALUE 0x1971EC FLOAT32_IEEE_COL_DIRECT_S6_S3 0 ng_fl_S6_S3 -10000 10000 /end CHARACTERISTIC
/begin CHARACTERISTIC NG_MINPSYSEMHASMAX_HAS "Maximaler Drehzahlgradient der minimalen EM-Drehzahl zur Sicherstellung der Ölversorgung der HAS" VALUE 0x19760C FLOAT32_IEEE_COL_DIRECT_S6_S3 0 ng_fl_S6_S3 -3.40282e+038 3.40282e+038 /end CHARACTERISTIC
/begin CHARACTERISTIC NG_MINPSYSEMHASMIN_HAS "Minimaler Drehzahlgradient der minimalen EM-Drehzahl zur Sicherstellung der Ölversorgung der HAS" VALUE 0x197610 FLOAT32_IEEE_COL_DIRECT_S6_S3 0 ng_fl_S6_S3 -3.40282e+038 3.40282e+038 /end CHARACTERISTIC
/begin CHARACTERISTIC NO_EMK0OEFFNICHT_DIHO "" VALUE 0x1971F0 FLOAT32_IEEE_COL_DIRECT_S6_S3 0 n_fl_S6_S3 -10000 10000 /end CHARACTERISTIC
/begin CHARACTERISTIC NS_EMK0SCHLNICHT_DIHO "Minimale EM-Drehzahl zur Erkennung, dass die K0 nicht schließt" VALUE 0x1971F8 FLOAT32_IEEE_COL_DIRECT_S6_S3 0 n_fl_S6_S3 -10000 10000 /end CHARACTERISTIC
/begin CHARACTERISTIC NS_EMZUKLEIN_ERK_AUW_HAS "Schwelle, unterhalb der erkannt wird, dass die EM-Istdrehzahl zu gering ist." VALUE 0x197200 FLOAT32_IEEE_COL_DIRECT_S6_S3 0 n_fl_S6_S3 0 10000 /end CHARACTERISTIC
/begin CHARACTERISTIC NS_VMAUS_ERK_AUW_HAS "VM_istdrehzahlschwelle, unterhalb der der VM als ausgeschaltet betrachtet wird" VALUE 0x197204 FLOAT32_IEEE_COL_DIRECT_S6_S3 0 n_fl_S6_S3 0 10000 /end CHARACTERISTIC
/begin CHARACTERISTIC NS_VMK0OEFFNICHT_DIHO "Minimale VM-Drehzahl zur Erkennung K0 öffnet nicht" VALUE 0x197208 FLOAT32_IEEE_COL_DIRECT_S6_S3 0 n_fl_S6_S3 -10000 10000 /end CHARACTERISTIC
/begin CHARACTERISTIC NS_VMK0SCHLNICHT_DIHO "Maximale VM-Drehzahl zur Erkennung, dass die K0 nicht schließt" VALUE 0x19720C FLOAT32_IEEE_COL_DIRECT_S6_S3 0 n_fl_S6_S3 -10000 10000 /end CHARACTERISTIC
/begin CHARACTERISTIC N_DIFFMAXINT "Differenzdrehzahlschwelle zum Einstieg in die Funktion" VALUE 0x1D8C1A ZF_kw_si16_S5_S3 10000 UMR_U_MIN_1_1_0_S5_S3 -5000 5000 /end CHARACTERISTIC
/begin CHARACTERISTIC N_FNGABMEUEB "Filterzähler für Abtriebsdrehzahlgradient Überwachung posME" VALUE 0x1D7C95 ZF_kw_ui8_S5_S3 255 UMR___1_1_0_S5_S3 0 255 /end CHARACTERISTIC
/begin CHARACTERISTIC N_FNGTMEUEB "Filterzähler für Turbinendrehzahlgradient Überwachung posME" VALUE 0x1D7C94 ZF_kw_ui8_S5_S3 255 UMR___1_1_0_S5_S3 0 255 /end CHARACTERISTIC
/begin CHARACTERISTIC N_MAXSTOERNEGMEAUS "Schwellwert für die Fehlerreaktion (unerlaubter NEGME)" VALUE 0x1D8C18 ZF_kw_ui16_S5_S3 2000 UMR___1_1_0_S5_S3 0 2000 /end CHARACTERISTIC
/begin CHARACTERISTIC N_MAXSTOERNEGMEINT1 "Schwellwert 1 für die Fehlerreaktion (Intensitaet NEGME)" VALUE 0x1D8C16 ZF_kw_ui16_S5_S3 1000 UMR___1_1_0_S5_S3 0 1000 /end CHARACTERISTIC
/begin CHARACTERISTIC N_MAXSTOERPOSMEAUS "Schwellwert für die Fehlerreaktion (unerlaubter POSME)" VALUE 0x1D8C0C ZF_kw_ui16_S5_S3 2000 UMR___1_1_0_S5_S3 0 2000 /end CHARACTERISTIC
/begin CHARACTERISTIC N_MAXSTOERPOSMEGRADIENT "Schwellwert für die Fehlerreaktion Gradient posME" VALUE 0x1D8C14 ZF_kw_ui16_S5_S3 1000 UMR___1_1_0_S5_S3 0 1000 /end CHARACTERISTIC
/begin CHARACTERISTIC N_MAXSTOERPOSMEINT1 "Schwellwert 1 für die Fehlerreaktion (Intensitaet POSME)" VALUE 0x1D8C0E ZF_kw_ui16_S5_S3 1000 UMR___1_1_0_S5_S3 0 1000 /end CHARACTERISTIC
/begin CHARACTERISTIC N_MAXSTOERPOSMEINT2 "Schwellwert 2 für die Fehlerreaktion (Intensitaet POSME)" VALUE 0x1D8C10 ZF_kw_ui16_S5_S3 1000 UMR___1_1_0_S5_S3 0 1000 /end CHARACTERISTIC
/begin CHARACTERISTIC N_MIN_EM_HAS_SBE_HAS_BYP_VECTOR "Vector für Bypass-Grösse n_min_em_has_sbe_has_byp" VALUE 0x1D73FC UBYTE_COL_DIRECT_S6_S3 0 void_int_S6_S3 0 255 /end CHARACTERISTIC
/begin CHARACTERISTIC N_MOTABREGEL_OFFSET "LEVEL2: Drehzahloffset auf Motordrehzahlminimum für die Abregeldrehzahlnachführung bei Reduzierung der Vorgabe" VALUE 0x1D8C0A ZF_kw_ui16_S5_S3 2000 UMR_U_MIN_1_1_0_S5_S3 0 2000 /end CHARACTERISTIC
/begin CHARACTERISTIC N_NMOTABREGEL_VORGABE "LEVEL2: Zählerschwelle für Absenkung der Abregeldrehzahlschwelle nach einer Reduzierung der Vorgabe" VALUE 0x1D8C08 ZF_kw_ui16_S5_S3 999 UMR___1_1_0_S5_S3 1 1000 /end CHARACTERISTIC
/begin CHARACTERISTIC N_OFFSET_ME "Offset zw. gem. Turbinendrehzahl und errechneter zur Schaltungserkennung Posme Überw." VALUE 0x1D8C12 ZF_kw_ui16_S5_S3 1000 UMR_U_MIN_1_1_0_S5_S3 0 1000 /end CHARACTERISTIC
/begin CHARACTERISTIC N_SOLL_EM_HAS_BYP_VECTOR "Vector für Bypass-Grösse n_soll_em_has_byp" VALUE 0x1D73FD UBYTE_COL_DIRECT_S6_S3 0 void_int_S6_S3 0 255 /end CHARACTERISTIC
/begin CHARACTERISTIC N_SOLL_VM_HAS_BYP_VECTOR "Vector für Bypass-Grösse n_soll_vm_has_byp" VALUE 0x1D73FE UBYTE_COL_DIRECT_S6_S3 0 void_int_S6_S3 0 255 /end CHARACTERISTIC
/begin CHARACTERISTIC PC_OK_HAS_BYP_VECTOR "Vector für Bypass-Grösse pc_ok_has_byp" VALUE 0x1D73FF UBYTE_COL_DIRECT_S6_S3 0 void_int_S6_S3 0 255 /end CHARACTERISTIC
/begin MEASUREMENT RMN_bTskErr "F1630: Flag task error detected" UBYTE B_TRUE_M 1 100 0 1 ECU_ADDRESS 0xFFF936B1 FORMAT "%13.11" /end MEASUREMENT
/begin CHARACTERISTIC RRT_swtRstMax_C "F1620: Calibration switch to reset max. values of runtime measurement" VALUE 0x191881 AblGLKWub_M 2 X1_M 0 2 FORMAT "%5.3" /end CHARACTERISTIC
/begin MEASUREMENT SAoEEP1 "" FLOAT32_IEEE void_fl_S6_S3 1 100 0 15 ECU_ADDRESS 0xFFF85E4C /end MEASUREMENT
/begin MEASUREMENT SAoEEP2 "" FLOAT32_IEEE void_fl_S6_S3 1 100 0 15 ECU_ADDRESS 0xFFF85E50 /end MEASUREMENT
/begin MEASUREMENT SAoEH1 "" FLOAT32_IEEE void_fl_S6_S3 1 100 -3.40282e+038 3.40282e+038 ECU_ADDRESS 0xFFF85E54 /end MEASUREMENT
/begin MEASUREMENT SAoEH2 "" FLOAT32_IEEE void_fl_S6_S3 1 100 -3.40282e+038 3.40282e+038 ECU_ADDRESS 0xFFF85E58 /end MEASUREMENT
/begin MEASUREMENT SDIAGo16_Unit_Delay "" FLOAT32_IEEE VOID_SCALING_f_S6_S3 1 100 -3.40282e+038 3.40282e+038 ECU_ADDRESS 0xFFF9635C /end MEASUREMENT
/begin MEASUREMENT SDIAGo16_isActive_ "" UBYTE VOID_SCALING_S6_S3 1 100 0 1 ECU_ADDRESS 0xFFF8617B /end MEASUREMENT
/begin MEASUREMENT SDIAGo16_t_left_ "" FLOAT32_IEEE VOID_SCALING_f_S6_S3 1 100 -3.40282e+038 3.40282e+038 ECU_ADDRESS 0xFFF850BC /end MEASUREMENT
/begin MEASUREMENT SDIAGo19_Unit_Delay "" FLOAT32_IEEE VOID_SCALING_f_S6_S3 1 100 -3.40282e+038 3.40282e+038 ECU_ADDRESS 0xFFF96360 /end MEASUREMENT
/begin MEASUREMENT SDIAGo19_isActive_ "" UBYTE VOID_SCALING_S6_S3 1 100 0 1 ECU_ADDRESS 0xFFF8617C /end MEASUREMENT
/begin MEASUREMENT SDIAGo19_t_left_ "" FLOAT32_IEEE VOID_SCALING_f_S6_S3 1 100 -3.40282e+038 3.40282e+038 ECU_ADDRESS 0xFFF850C0 /end MEASUREMENT
/begin MEASUREMENT SDIAGo20_Unit_Delay "" FLOAT32_IEEE VOID_SCALING_f_S6_S3 1 100 -3.40282e+038 3.40282e+038 ECU_ADDRESS 0xFFF96364 /end MEASUREMENT
/begin MEASUREMENT SDIAGo20_isActive_ "" UBYTE VOID_SCALING_S6_S3 1 100 0 1 ECU_ADDRESS 0xFFF8617D /end MEASUREMENT
/begin MEASUREMENT SDIAGo20_t_left_ "" FLOAT32_IEEE VOID_SCALING_f_S6_S3 1 100 -3.40282e+038 3.40282e+038 ECU_ADDRESS 0xFFF850C4 /end MEASUREMENT
/begin MEASUREMENT SDIAGo21_Unit_Delay "" FLOAT32_IEEE VOID_SCALING_f_S6_S3 1 100 -3.40282e+038 3.40282e+038 ECU_ADDRESS 0xFFF96368 /end MEASUREMENT
/begin MEASUREMENT SDIAGo21_isActive_ "" UBYTE VOID_SCALING_S6_S3 1 100 0 1 ECU_ADDRESS 0xFFF8617E /end MEASUREMENT
/begin MEASUREMENT SDIAGo21_t_left_ "" FLOAT32_IEEE VOID_SCALING_f_S6_S3 1 100 -3.40282e+038 3.40282e+038 ECU_ADDRESS 0xFFF850C8 /end MEASUREMENT
/begin MEASUREMENT SDIAGo22_Unit_Delay "" FLOAT32_IEEE VOID_SCALING_f_S6_S3 1 100 -3.40282e+038 3.40282e+038 ECU_ADDRESS 0xFFF9636C /end MEASUREMENT
/begin MEASUREMENT SDIAGo22_isActive_ "" UBYTE VOID_SCALING_S6_S3 1 100 0 1 ECU_ADDRESS 0xFFF8617F /end MEASUREMENT
/begin MEASUREMENT SDIAGo22_t_left_ "" FLOAT32_IEEE VOID_SCALING_f_S6_S3 1 100 -3.40282e+038 3.40282e+038 ECU_ADDRESS 0xFFF850CC /end MEASUREMENT
/begin MEASUREMENT SDIAGo23_Unit_Delay "" FLOAT32_IEEE VOID_SCALING_f_S6_S3 1 100 -3.40282e+038 3.40282e+038 ECU_ADDRESS 0xFFF96370 /end MEASUREMENT
/begin MEASUREMENT SDIAGo23_isActive_ "" UBYTE VOID_SCALING_S6_S3 1 100 0 1 ECU_ADDRESS 0xFFF86180 /end MEASUREMENT
/begin MEASUREMENT SDIAGo23_t_left_ "" FLOAT32_IEEE VOID_SCALING_f_S6_S3 1 100 -3.40282e+038 3.40282e+038 ECU_ADDRESS 0xFFF850D0 /end MEASUREMENT
/begin MEASUREMENT SDIAGo54_Unit_Delay "" FLOAT32_IEEE VOID_SCALING_f_S6_S3 1 100 -3.40282e+038 3.40282e+038 ECU_ADDRESS 0xFFF96374 /end MEASUREMENT
/begin MEASUREMENT SDIAGo54_isActive_ "" UBYTE VOID_SCALING_S6_S3 1 100 0 1 ECU_ADDRESS 0xFFF86181 /end MEASUREMENT
/begin MEASUREMENT SDIAGo54_t_left_ "" FLOAT32_IEEE VOID_SCALING_f_S6_S3 1 100 -3.40282e+038 3.40282e+038 ECU_ADDRESS 0xFFF850D4 /end MEASUREMENT
/begin MEASUREMENT SDIAGo63_Unit_Delay "" FLOAT32_IEEE VOID_SCALING_f_S6_S3 1 100 -3.40282e+038 3.40282e+038 ECU_ADDRESS 0xFFF96378 /end MEASUREMENT
/begin MEASUREMENT SDIAGo63_isActive_ "" UBYTE VOID_SCALING_S6_S3 1 100 0 1 ECU_ADDRESS 0xFFF86182 /end MEASUREMENT
/begin MEASUREMENT SDIAGo63_t_left_ "" FLOAT32_IEEE VOID_SCALING_f_S6_S3 1 100 -3.40282e+038 3.40282e+038 ECU_ADDRESS 0xFFF850D8 /end MEASUREMENT
/begin MEASUREMENT SDIAGo64_Unit_Delay "" FLOAT32_IEEE VOID_SCALING_f_S6_S3 1 100 -3.40282e+038 3.40282e+038 ECU_ADDRESS 0xFFF9637C /end MEASUREMENT
/begin MEASUREMENT SDIAGo64_isActive_ "" UBYTE VOID_SCALING_S6_S3 1 100 0 1 ECU_ADDRESS 0xFFF86183 /end MEASUREMENT
/begin MEASUREMENT SDIAGo64_t_left_ "" FLOAT32_IEEE VOID_SCALING_f_S6_S3 1 100 -3.40282e+038 3.40282e+038 ECU_ADDRESS 0xFFF850DC /end MEASUREMENT
/begin MEASUREMENT SDIAGo72_Unit_Delay "" FLOAT32_IEEE VOID_SCALING_f_S6_S3 1 100 -3.40282e+038 3.40282e+038 ECU_ADDRESS 0xFFF96380 /end MEASUREMENT
/begin MEASUREMENT SDIAGo72_isActive_ "" UBYTE VOID_SCALING_S6_S3 1 100 0 1 ECU_ADDRESS 0xFFF86184 /end MEASUREMENT
/begin MEASUREMENT SDIAGo72_t_left_ "" FLOAT32_IEEE VOID_SCALING_f_S6_S3 1 100 -3.40282e+038 3.40282e+038 ECU_ADDRESS 0xFFF850E0 /end MEASUREMENT
/begin MEASUREMENT SDIAGo73_Unit_Delay "" FLOAT32_IEEE VOID_SCALING_f_S6_S3 1 100 -3.40282e+038 3.40282e+038 ECU_ADDRESS 0xFFF96384 /end MEASUREMENT
/begin MEASUREMENT SDIAGo73_isActive_ "" UBYTE VOID_SCALING_S6_S3 1 100 0 1 ECU_ADDRESS 0xFFF86185 /end MEASUREMENT
/begin MEASUREMENT SDIAGo73_t_left_ "" FLOAT32_IEEE VOID_SCALING_f_S6_S3 1 100 -3.40282e+038 3.40282e+038 ECU_ADDRESS 0xFFF850E4 /end MEASUREMENT
/begin MEASUREMENT SFHC103_Unit_Delay "" FLOAT32_IEEE VOID_SCALING_f_S6_S3 1 100 -3.40282e+038 3.40282e+038 ECU_ADDRESS 0xFFF963DC /end MEASUREMENT
/begin MEASUREMENT SFHC103_isActive_ "" UBYTE VOID_SCALING_S6_S3 1 100 0 1 ECU_ADDRESS 0xFFF86238 /end MEASUREMENT
/begin MEASUREMENT SFHC103_t_left_ "" FLOAT32_IEEE VOID_SCALING_f_S6_S3 1 100 -3.40282e+038 3.40282e+038 ECU_ADDRESS 0xFFF85208 /end MEASUREMENT
/begin MEASUREMENT SFHC118_Unit_Delay "" FLOAT32_IEEE VOID_SCALING_f_S6_S3 1 100 -3.40282e+038 3.40282e+038 ECU_ADDRESS 0xFFF963E0 /end MEASUREMENT
/begin MEASUREMENT SFHC118_isActive_ "" UBYTE VOID_SCALING_S6_S3 1 100 0 1 ECU_ADDRESS 0xFFF96D6C /end MEASUREMENT
/begin MEASUREMENT SFHC118_t_left_ "" FLOAT32_IEEE VOID_SCALING_f_S6_S3 1 100 -3.40282e+038 3.40282e+038 ECU_ADDRESS 0xFFF963E4 /end MEASUREMENT
/begin MEASUREMENT SFHC122_Unit_Delay "" FLOAT32_IEEE VOID_SCALING_f_S6_S3 1 100 -3.40282e+038 3.40282e+038 ECU_ADDRESS 0xFFF963E8 /end MEASUREMENT
/begin MEASUREMENT SFHC122_isActive_ "" UBYTE VOID_SCALING_S6_S3 1 100 0 1 ECU_ADDRESS 0xFFF86239 /end MEASUREMENT
/begin MEASUREMENT SFHC122_t_left_ "" FLOAT32_IEEE VOID_SCALING_f_S6_S3 1 100 -3.40282e+038 3.40282e+038 ECU_ADDRESS 0xFFF8520C /end MEASUREMENT
/begin MEASUREMENT SFHC16_Unit_Delay "" FLOAT32_IEEE VOID_SCALING_f_S6_S3 1 100 -3.40282e+038 3.40282e+038 ECU_ADDRESS 0xFFF963EC /end MEASUREMENT
/begin MEASUREMENT SFHC16_isActive_ "" UBYTE VOID_SCALING_S6_S3 1 100 0 1 ECU_ADDRESS 0xFFF8623A /end MEASUREMENT
/begin MEASUREMENT SFHC16_t_left_ "" FLOAT32_IEEE VOID_SCALING_f_S6_S3 1 100 -3.40282e+038 3.40282e+038 ECU_ADDRESS 0xFFF85210 /end MEASUREMENT
/begin MEASUREMENT SFHC19_Unit_Delay "" FLOAT32_IEEE VOID_SCALING_f_S6_S3 1 100 -3.40282e+038 3.40282e+038 ECU_ADDRESS 0xFFF963F0 /end MEASUREMENT
/begin MEASUREMENT SFHC19_isActive_ "" UBYTE VOID_SCALING_S6_S3 1 100 0 1 ECU_ADDRESS 0xFFF8623B /end MEASUREMENT
/begin MEASUREMENT SFHC19_t_left_ "" FLOAT32_IEEE VOID_SCALING_f_S6_S3 1 100 -3.40282e+038 3.40282e+038 ECU_ADDRESS 0xFFF85214 /end MEASUREMENT
/begin MEASUREMENT SFHC20_Unit_Delay "" FLOAT32_IEEE VOID_SCALING_f_S6_S3 1 100 -3.40282e+038 3.40282e+038 ECU_ADDRESS 0xFFF963F4 /end MEASUREMENT
/begin MEASUREMENT SFHC20_isActive_ "" UBYTE VOID_SCALING_S6_S3 1 100 0 1 ECU_ADDRESS 0xFFF8623C /end MEASUREMENT
/begin MEASUREMENT SFHC20_t_left_ "" FLOAT32_IEEE VOID_SCALING_f_S6_S3 1 100 -3.40282e+038 3.40282e+038 ECU_ADDRESS 0xFFF85218 /end MEASUREMENT
/begin MEASUREMENT SFHC25_x_filter_ "" FLOAT32_IEEE VOID_SCALING_f_S6_S3 1 100 -3.40282e+038 3.40282e+038 ECU_ADDRESS 0xFFF963F8 /end MEASUREMENT
/begin MEASUREMENT SFHC25_xp_ "" FLOAT32_IEEE VOID_SCALING_f_S6_S3 1 100 -3.40282e+038 3.40282e+038 ECU_ADDRESS 0xFFF963FC /end MEASUREMENT
/begin MEASUREMENT SFHC26_x_filter_ "" FLOAT32_IEEE VOID_SCALING_f_S6_S3 1 100 -3.40282e+038 3.40282e+038 ECU_ADDRESS 0xFFF96400 /end MEASUREMENT
/begin MEASUREMENT SFHC26_xp_ "" FLOAT32_IEEE VOID_SCALING_f_S6_S3 1 100 -3.40282e+038 3.40282e+038 ECU_ADDRESS 0xFFF96404 /end MEASUREMENT
/begin MEASUREMENT SFHC27_x_filter_ "" FLOAT32_IEEE VOID_SCALING_f_S6_S3 1 100 -3.40282e+038 3.40282e+038 ECU_ADDRESS 0xFFF96408 /end MEASUREMENT
/begin MEASUREMENT SFHC27_xp_ "" FLOAT32_IEEE VOID_SCALING_f_S6_S3 1 100 -3.40282e+038 3.40282e+038 ECU_ADDRESS 0xFFF9640C /end MEASUREMENT
/begin MEASUREMENT SFHC28_out_ "" FLOAT32_IEEE VOID_SCALING_f_S6_S3 1 100 -3.40282e+038 3.40282e+038 ECU_ADDRESS 0xFFF96410 /end MEASUREMENT
/begin MEASUREMENT SFHC29_out_ "" FLOAT32_IEEE VOID_SCALING_f_S6_S3 1 100 -3.40282e+038 3.40282e+038 ECU_ADDRESS 0xFFF96414 /end MEASUREMENT
/begin MEASUREMENT SFHC32_Unit_Delay2 "" FLOAT32_IEEE VOID_SCALING_f_S6_S3 1 100 -3.40282e+038 3.40282e+038 ECU_ADDRESS 0xFFF96418 /end MEASUREMENT
/begin MEASUREMENT SFHC35_Unit_Delay2 "" FLOAT32_IEEE VOID_SCALING_f_S6_S3 1 100 -3.40282e+038 3.40282e+038 ECU_ADDRESS 0xFFF9641C /end MEASUREMENT
/begin MEASUREMENT SFHC38_Unit_Delay2 "" FLOAT32_IEEE VOID_SCALING_f_S6_S3 1 100 -3.40282e+038 3.40282e+038 ECU_ADDRESS 0xFFF96420 /end MEASUREMENT
/begin MEASUREMENT SFHC42_Unit_Delay1 "" UBYTE void_int_S6_S3 1 100 0 255 ECU_ADDRESS 0xFFF96D6D /end MEASUREMENT
/begin MEASUREMENT SFHC45_Unit_Delay1 "" UBYTE void_int_S6_S3 1 100 0 255 ECU_ADDRESS 0xFFF96D6E /end MEASUREMENT
/begin MEASUREMENT SFHC47_Unit_Delay2 "" FLOAT32_IEEE VOID_SCALING_f_S6_S3 1 100 -3.40282e+038 3.40282e+038 ECU_ADDRESS 0xFFF96424 /end MEASUREMENT
/begin MEASUREMENT SFHC47_x_ "" FLOAT32_IEEE VOID_SCALING_f_S6_S3 1 100 -3.40282e+038 3.40282e+038 ECU_ADDRESS 0xFFF96428 /end MEASUREMENT
/begin MEASUREMENT SFHC56_Unit_Delay "" FLOAT32_IEEE VOID_SCALING_f_S6_S3 1 100 -3.40282e+038 3.40282e+038 ECU_ADDRESS 0xFFF9642C /end MEASUREMENT
/begin MEASUREMENT SFHC56_isActive_ "" UBYTE VOID_SCALING_S6_S3 1 100 0 1 ECU_ADDRESS 0xFFF96D6F /end MEASUREMENT
/begin MEASUREMENT SFHC56_t_left_ "" FLOAT32_IEEE VOID_SCALING_f_S6_S3 1 100 -3.40282e+038 3.40282e+038 ECU_ADDRESS 0xFFF96430 /end MEASUREMENT
/begin MEASUREMENT SFHC59_x_filter_ "" FLOAT32_IEEE VOID_SCALING_f_S6_S3 1 100 -3.40282e+038 3.40282e+038 ECU_ADDRESS 0xFFF96434 /end MEASUREMENT
/begin MEASUREMENT SFHC59_xp_ "" FLOAT32_IEEE VOID_SCALING_f_S6_S3 1 100 -3.40282e+038 3.40282e+038 ECU_ADDRESS 0xFFF96438 /end MEASUREMENT
/begin MEASUREMENT SFHC60_x_filter_ "" FLOAT32_IEEE VOID_SCALING_f_S6_S3 1 100 -3.40282e+038 3.40282e+038 ECU_ADDRESS 0xFFF9643C /end MEASUREMENT
/begin MEASUREMENT SFHC60_xp_ "" FLOAT32_IEEE VOID_SCALING_f_S6_S3 1 100 -3.40282e+038 3.40282e+038 ECU_ADDRESS 0xFFF96440 /end MEASUREMENT
/begin MEASUREMENT SFHC61_Unit_Delay2 "" FLOAT32_IEEE VOID_SCALING_f_S6_S3 1 100 -3.40282e+038 3.40282e+038 ECU_ADDRESS 0xFFF96444 /end MEASUREMENT
/begin MEASUREMENT SFHC61_x_ "" FLOAT32_IEEE VOID_SCALING_f_S6_S3 1 100 -3.40282e+038 3.40282e+038 ECU_ADDRESS 0xFFF96448 /end MEASUREMENT
/begin MEASUREMENT SFHC62_Unit_Delay2 "" FLOAT32_IEEE VOID_SCALING_f_S6_S3 1 100 -3.40282e+038 3.40282e+038 ECU_ADDRESS 0xFFF9644C /end MEASUREMENT
/begin MEASUREMENT SFHC65_Unit_Delay2 "" FLOAT32_IEEE VOID_SCALING_f_S6_S3 1 100 -3.40282e+038 3.40282e+038 ECU_ADDRESS 0xFFF96450 /end MEASUREMENT
/begin MEASUREMENT SFHC82_Unit_Delay "" FLOAT32_IEEE VOID_SCALING_f_S6_S3 1 100 -3.40282e+038 3.40282e+038 ECU_ADDRESS 0xFFF96454 /end MEASUREMENT
/begin MEASUREMENT SFHC82_isActive_ "" UBYTE VOID_SCALING_S6_S3 1 100 0 1 ECU_ADDRESS 0xFFF96D70 /end MEASUREMENT
/begin MEASUREMENT SFHC82_t_left_ "" FLOAT32_IEEE VOID_SCALING_f_S6_S3 1 100 -3.40282e+038 3.40282e+038 ECU_ADDRESS 0xFFF96458 /end MEASUREMENT
/begin MEASUREMENT SFHC92_Unit_Delay "" FLOAT32_IEEE VOID_SCALING_f_S6_S3 1 100 -3.40282e+038 3.40282e+038 ECU_ADDRESS 0xFFF9645C /end MEASUREMENT
/begin MEASUREMENT SFHC92_out_ "" FLOAT32_IEEE VOID_SCALING_f_S6_S3 1 100 -3.40282e+038 3.40282e+038 ECU_ADDRESS 0xFFF96460 /end MEASUREMENT
/begin MEASUREMENT SFHC93_Unit_Delay2 "" FLOAT32_IEEE VOID_SCALING_f_S6_S3 1 100 -3.40282e+038 3.40282e+038 ECU_ADDRESS 0xFFF96464 /end MEASUREMENT
/begin MEASUREMENT SFHC93_x2_ "" FLOAT32_IEEE VOID_SCALING_f_S6_S3 1 100 -3.40282e+038 3.40282e+038 ECU_ADDRESS 0xFFF96468 /end MEASUREMENT
/begin MEASUREMENT SFHC94_Unit_Delay2 "" FLOAT32_IEEE VOID_SCALING_f_S6_S3 1 100 -3.40282e+038 3.40282e+038 ECU_ADDRESS 0xFFF9646C /end MEASUREMENT
/begin MEASUREMENT SFHC94_x2_ "" FLOAT32_IEEE VOID_SCALING_f_S6_S3 1 100 -3.40282e+038 3.40282e+038 ECU_ADDRESS 0xFFF96470 /end MEASUREMENT
/begin MEASUREMENT SFOp_ABK105_Unit_Delay "" FLOAT32_IEEE VOID_SCALING_f_S6_S3 1 100 -3.40282e+038 3.40282e+038 ECU_ADDRESS 0xFFF965B0 /end MEASUREMENT
/begin MEASUREMENT SFOp_ABK105_isActive_ "" UBYTE VOID_SCALING_S6_S3 1 100 0 1 ECU_ADDRESS 0xFFF8629E /end MEASUREMENT
/begin MEASUREMENT SFOp_ABK105_t_left_ "" FLOAT32_IEEE VOID_SCALING_f_S6_S3 1 100 -3.40282e+038 3.40282e+038 ECU_ADDRESS 0xFFF85394 /end MEASUREMENT
/begin MEASUREMENT SFOp_ABK69_Unit_Delay "" FLOAT32_IEEE VOID_SCALING_f_S6_S3 1 100 -3.40282e+038 3.40282e+038 ECU_ADDRESS 0xFFF965B4 /end MEASUREMENT
/begin MEASUREMENT SFOp_ABK69_out_ "" FLOAT32_IEEE VOID_SCALING_f_S6_S3 1 100 -3.40282e+038 3.40282e+038 ECU_ADDRESS 0xFFF965B8 /end MEASUREMENT
/begin MEASUREMENT SFOp_ABK70_Unit_Delay "" FLOAT32_IEEE VOID_SCALING_f_S6_S3 1 100 -3.40282e+038 3.40282e+038 ECU_ADDRESS 0xFFF965BC /end MEASUREMENT
/begin MEASUREMENT SFOp_ABK70_isActive_ "" UBYTE VOID_SCALING_S6_S3 1 100 0 1 ECU_ADDRESS 0xFFF8629F /end MEASUREMENT
/begin MEASUREMENT SFOp_ABK70_t_left_ "" FLOAT32_IEEE VOID_SCALING_f_S6_S3 1 100 -3.40282e+038 3.40282e+038 ECU_ADDRESS 0xFFF85398 /end MEASUREMENT
/begin MEASUREMENT SFOp_ABK81_Unit_Delay "" FLOAT32_IEEE VOID_SCALING_f_S6_S3 1 100 -3.40282e+038 3.40282e+038 ECU_ADDRESS 0xFFF965C0 /end MEASUREMENT
/begin MEASUREMENT SFOp_ABK81_isActive_ "" UBYTE VOID_SCALING_S6_S3 1 100 0 1 ECU_ADDRESS 0xFFF862A0 /end MEASUREMENT
/begin MEASUREMENT SFOp_ABK81_t_left_ "" FLOAT32_IEEE VOID_SCALING_f_S6_S3 1 100 -3.40282e+038 3.40282e+038 ECU_ADDRESS 0xFFF8539C /end MEASUREMENT
/begin MEASUREMENT SFOp_ABK90_Unit_Delay "" FLOAT32_IEEE VOID_SCALING_f_S6_S3 1 100 -3.40282e+038 3.40282e+038 ECU_ADDRESS 0xFFF965C4 /end MEASUREMENT
/begin MEASUREMENT SFOp_ABK90_isActive_ "" UBYTE VOID_SCALING_S6_S3 1 100 0 1 ECU_ADDRESS 0xFFF862A1 /end MEASUREMENT
/begin MEASUREMENT SFOp_ABK90_t_left_ "" FLOAT32_IEEE VOID_SCALING_f_S6_S3 1 100 -3.40282e+038 3.40282e+038 ECU_ADDRESS 0xFFF853A0 /end MEASUREMENT
/begin MEASUREMENT SFOp_ABK91_Unit_Delay "" FLOAT32_IEEE VOID_SCALING_f_S6_S3 1 100 -3.40282e+038 3.40282e+038 ECU_ADDRESS 0xFFF965C8 /end MEASUREMENT
/begin MEASUREMENT SFOp_ABK91_out_ "" FLOAT32_IEEE VOID_SCALING_f_S6_S3 1 100 -3.40282e+038 3.40282e+038 ECU_ADDRESS 0xFFF965CC /end MEASUREMENT
/begin MEASUREMENT SFOp_ABK92_Unit_Delay "" FLOAT32_IEEE VOID_SCALING_f_S6_S3 1 100 -3.40282e+038 3.40282e+038 ECU_ADDRESS 0xFFF965D0 /end MEASUREMENT
/begin MEASUREMENT SFOp_ABK92_isActive_ "" UBYTE VOID_SCALING_S6_S3 1 100 0 1 ECU_ADDRESS 0xFFF862A2 /end MEASUREMENT
/begin MEASUREMENT SFOp_ABK92_t_left_ "" FLOAT32_IEEE VOID_SCALING_f_S6_S3 1 100 -3.40282e+038 3.40282e+038 ECU_ADDRESS 0xFFF853A4 /end MEASUREMENT
/begin MEASUREMENT SFOp_ABO28_Unit_Delay2 "" FLOAT32_IEEE VOID_SCALING_f_S6_S3 1 100 -3.40282e+038 3.40282e+038 ECU_ADDRESS 0xFFF965F4 /end MEASUREMENT
/begin MEASUREMENT SFOp_ABO28_x2_ "" FLOAT32_IEEE VOID_SCALING_f_S6_S3 1 100 -3.40282e+038 3.40282e+038 ECU_ADDRESS 0xFFF965F8 /end MEASUREMENT
/begin MEASUREMENT SFOp_ABO29_Unit_Delay2 "" FLOAT32_IEEE VOID_SCALING_f_S6_S3 1 100 -3.40282e+038 3.40282e+038 ECU_ADDRESS 0xFFF965FC /end MEASUREMENT
/begin MEASUREMENT SFOp_ABO29_x2_ "" FLOAT32_IEEE VOID_SCALING_f_S6_S3 1 100 -3.40282e+038 3.40282e+038 ECU_ADDRESS 0xFFF96600 /end MEASUREMENT
/begin MEASUREMENT SFOp_ABO30_Unit_Delay "" FLOAT32_IEEE VOID_SCALING_f_S6_S3 1 100 -3.40282e+038 3.40282e+038 ECU_ADDRESS 0xFFF96604 /end MEASUREMENT
/begin MEASUREMENT SFOp_ABO30_isActive_ "" UBYTE VOID_SCALING_S6_S3 1 100 0 1 ECU_ADDRESS 0xFFF862F9 /end MEASUREMENT
/begin MEASUREMENT SFOp_ABO30_t_left_ "" FLOAT32_IEEE VOID_SCALING_f_S6_S3 1 100 -3.40282e+038 3.40282e+038 ECU_ADDRESS 0xFFF85448 /end MEASUREMENT
/begin MEASUREMENT SFOp_ABO49_Unit_Delay "" FLOAT32_IEEE VOID_SCALING_f_S6_S3 1 100 -3.40282e+038 3.40282e+038 ECU_ADDRESS 0xFFF96608 /end MEASUREMENT
/begin MEASUREMENT SFOp_ABO49_isActive_ "" UBYTE VOID_SCALING_S6_S3 1 100 0 1 ECU_ADDRESS 0xFFF862FA /end MEASUREMENT
/begin MEASUREMENT SFOp_ABO49_t_left_ "" FLOAT32_IEEE VOID_SCALING_f_S6_S3 1 100 -3.40282e+038 3.40282e+038 ECU_ADDRESS 0xFFF8544C /end MEASUREMENT
/begin MEASUREMENT SFOp_ABO65_Unit_Delay "" FLOAT32_IEEE VOID_SCALING_f_S6_S3 1 100 -3.40282e+038 3.40282e+038 ECU_ADDRESS 0xFFF9660C /end MEASUREMENT
/begin MEASUREMENT SFOp_ABO65_isActive_ "" UBYTE VOID_SCALING_S6_S3 1 100 0 1 ECU_ADDRESS 0xFFF96DA3 /end MEASUREMENT
/begin MEASUREMENT SFOp_ABO65_t_left_ "" FLOAT32_IEEE VOID_SCALING_f_S6_S3 1 100 -3.40282e+038 3.40282e+038 ECU_ADDRESS 0xFFF96610 /end MEASUREMENT
/begin MEASUREMENT SFOp_ABO71_Unit_Delay "" FLOAT32_IEEE VOID_SCALING_f_S6_S3 1 100 -3.40282e+038 3.40282e+038 ECU_ADDRESS 0xFFF96614 /end MEASUREMENT
/begin MEASUREMENT SFOp_ABO71_out_ "" FLOAT32_IEEE VOID_SCALING_f_S6_S3 1 100 -3.40282e+038 3.40282e+038 ECU_ADDRESS 0xFFF96618 /end MEASUREMENT
/begin MEASUREMENT SFOp_ABO72_Unit_Delay "" FLOAT32_IEEE VOID_SCALING_f_S6_S3 1 100 -3.40282e+038 3.40282e+038 ECU_ADDRESS 0xFFF9661C /end MEASUREMENT
/begin MEASUREMENT SFOp_ABO72_isActive_ "" UBYTE VOID_SCALING_S6_S3 1 100 0 1 ECU_ADDRESS 0xFFF862FB /end MEASUREMENT
/begin MEASUREMENT SFOp_ABO72_t_left_ "" FLOAT32_IEEE VOID_SCALING_f_S6_S3 1 100 -3.40282e+038 3.40282e+038 ECU_ADDRESS 0xFFF85450 /end MEASUREMENT
/begin MEASUREMENT SFOp_ABO85_Unit_Delay "" FLOAT32_IEEE VOID_SCALING_f_S6_S3 1 100 -3.40282e+038 3.40282e+038 ECU_ADDRESS 0xFFF96620 /end MEASUREMENT
/begin MEASUREMENT SFOp_ABO85_isActive_ "" UBYTE VOID_SCALING_S6_S3 1 100 0 1 ECU_ADDRESS 0xFFF862FC /end MEASUREMENT
/begin MEASUREMENT SFOp_ABO85_t_left_ "" FLOAT32_IEEE VOID_SCALING_f_S6_S3 1 100 -3.40282e+038 3.40282e+038 ECU_ADDRESS 0xFFF85454 /end MEASUREMENT
/begin MEASUREMENT SFOp_ABO88_Unit_Delay "" FLOAT32_IEEE VOID_SCALING_f_S6_S3 1 100 -3.40282e+038 3.40282e+038 ECU_ADDRESS 0xFFF96624 /end MEASUREMENT
/begin MEASUREMENT SFOp_ABO88_out_ "" FLOAT32_IEEE VOID_SCALING_f_S6_S3 1 100 -3.40282e+038 3.40282e+038 ECU_ADDRESS 0xFFF96628 /end MEASUREMENT
/begin MEASUREMENT SFOp_ABST109_Unit_Delay "" FLOAT32_IEEE VOID_SCALING_f_S6_S3 1 100 -3.40282e+038 3.40282e+038 ECU_ADDRESS 0xFFF9664C /end MEASUREMENT
/begin MEASUREMENT SFOp_ABST109_isActive_ "" UBYTE VOID_SCALING_S6_S3 1 100 0 1 ECU_ADDRESS 0xFFF86326 /end MEASUREMENT
/begin MEASUREMENT SFOp_ABST109_t_left_ "" FLOAT32_IEEE VOID_SCALING_f_S6_S3 1 100 -3.40282e+038 3.40282e+038 ECU_ADDRESS 0xFFF854BC /end MEASUREMENT
/begin MEASUREMENT SFOp_ABST120_Unit_Delay "" FLOAT32_IEEE VOID_SCALING_f_S6_S3 1 100 -3.40282e+038 3.40282e+038 ECU_ADDRESS 0xFFF96650 /end MEASUREMENT
/begin MEASUREMENT SFOp_ABST120_out_ "" FLOAT32_IEEE VOID_SCALING_f_S6_S3 1 100 -3.40282e+038 3.40282e+038 ECU_ADDRESS 0xFFF96654 /end MEASUREMENT
/begin MEASUREMENT SFOp_ABST121_Unit_Delay "" FLOAT32_IEEE VOID_SCALING_f_S6_S3 1 100 -3.40282e+038 3.40282e+038 ECU_ADDRESS 0xFFF96658 /end MEASUREMENT
/begin MEASUREMENT SFOp_ABST121_isActive_ "" UBYTE VOID_SCALING_S6_S3 1 100 0 1 ECU_ADDRESS 0xFFF86327 /end MEASUREMENT
/begin MEASUREMENT SFOp_ABST121_t_left_ "" FLOAT32_IEEE VOID_SCALING_f_S6_S3 1 100 -3.40282e+038 3.40282e+038 ECU_ADDRESS 0xFFF854C0 /end MEASUREMENT
/begin MEASUREMENT SFOp_ABST132_Unit_Delay "" FLOAT32_IEEE VOID_SCALING_f_S6_S3 1 100 -3.40282e+038 3.40282e+038 ECU_ADDRESS 0xFFF9665C /end MEASUREMENT
/begin MEASUREMENT SFOp_ABST132_isActive_ "" UBYTE VOID_SCALING_S6_S3 1 100 0 1 ECU_ADDRESS 0xFFF86328 /end MEASUREMENT
/begin MEASUREMENT SFOp_ABST132_t_left_ "" FLOAT32_IEEE VOID_SCALING_f_S6_S3 1 100 -3.40282e+038 3.40282e+038 ECU_ADDRESS 0xFFF854C4 /end MEASUREMENT
/begin MEASUREMENT SFOp_ABST142_Unit_Delay "" FLOAT32_IEEE VOID_SCALING_f_S6_S3 1 100 -3.40282e+038 3.40282e+038 ECU_ADDRESS 0xFFF96660 /end MEASUREMENT
/begin MEASUREMENT SFOp_ABST142_isActive_ "" UBYTE VOID_SCALING_S6_S3 1 100 0 1 ECU_ADDRESS 0xFFF86329 /end MEASUREMENT
/begin MEASUREMENT SFOp_ABST142_t_left_ "" FLOAT32_IEEE VOID_SCALING_f_S6_S3 1 100 -3.40282e+038 3.40282e+038 ECU_ADDRESS 0xFFF854C8 /end MEASUREMENT
/begin MEASUREMENT SFOp_ABST143_Unit_Delay "" FLOAT32_IEEE VOID_SCALING_f_S6_S3 1 100 -3.40282e+038 3.40282e+038 ECU_ADDRESS 0xFFF96664 /end MEASUREMENT
/begin MEASUREMENT SFOp_ABST143_out_ "" FLOAT32_IEEE VOID_SCALING_f_S6_S3 1 100 -3.40282e+038 3.40282e+038 ECU_ADDRESS 0xFFF96668 /end MEASUREMENT
/begin MEASUREMENT SFOp_ABST144_Unit_Delay "" FLOAT32_IEEE VOID_SCALING_f_S6_S3 1 100 -3.40282e+038 3.40282e+038 ECU_ADDRESS 0xFFF9666C /end MEASUREMENT
/begin MEASUREMENT SFOp_ABST144_isActive_ "" UBYTE VOID_SCALING_S6_S3 1 100 0 1 ECU_ADDRESS 0xFFF8632A /end MEASUREMENT
/begin MEASUREMENT SFOp_ABST144_t_left_ "" FLOAT32_IEEE VOID_SCALING_f_S6_S3 1 100 -3.40282e+038 3.40282e+038 ECU_ADDRESS 0xFFF854CC /end MEASUREMENT
/begin MEASUREMENT SFOp_ABST157_Unit_Delay "" FLOAT32_IEEE VOID_SCALING_f_S6_S3 1 100 -3.40282e+038 3.40282e+038 ECU_ADDRESS 0xFFF96670 /end MEASUREMENT
/begin MEASUREMENT SFOp_ABST157_isActive_ "" UBYTE VOID_SCALING_S6_S3 1 100 0 1 ECU_ADDRESS 0xFFF8632B /end MEASUREMENT
/begin MEASUREMENT SFOp_ABST157_t_left_ "" FLOAT32_IEEE VOID_SCALING_f_S6_S3 1 100 -3.40282e+038 3.40282e+038 ECU_ADDRESS 0xFFF854D0 /end MEASUREMENT
/begin CHARACTERISTIC STATUS_ABLAUFAKTIV_BYP_VECTOR "Vector für Bypass-Grösse ablauf_aktiv_has_byp" VALUE 0x1D7400 UBYTE_COL_DIRECT_S6_S3 0 void_int_S6_S3 0 255 /end CHARACTERISTIC
/begin CHARACTERISTIC STATUS_ABLAUF_HAS_BYP_VECTOR "Vector für Bypass-Grösse status_ablauf_has_fkt_byp" VALUE 0x1D7401 UBYTE_COL_DIRECT_S6_S3 0 void_int_S6_S3 0 255 /end CHARACTERISTIC
/begin CHARACTERISTIC STATUS_ABL_ABBRUCH_AKTIV "Status Ablauf Abbruch aktiv" VALUE 0x1D7428 UBYTE_COL_DIRECT_S6_S3 0 void_int_S6_S3 0 255 /end CHARACTERISTIC
/begin CHARACTERISTIC STATUS_ABL_ABBRUCH_FERTIG "Status Ablauf Abbruch fertig" VALUE 0x1D7429 UBYTE_COL_DIRECT_S6_S3 0 void_int_S6_S3 0 255 /end CHARACTERISTIC
/begin CHARACTERISTIC STATUS_EFAHREN_HAS_BYP_VECTOR "Vector für Bypass-Grösse status_efahren_has_byp" VALUE 0x1D7402 UBYTE_COL_DIRECT_S6_S3 0 void_int_S6_S3 0 255 /end CHARACTERISTIC
/begin CHARACTERISTIC STATUS_MOTORSTB_HAS_BYP_VECTOR "Vector für Bypass-Grösse status_motorstandby_has_byp" VALUE 0x1D7403 UBYTE_COL_DIRECT_S6_S3 0 void_int_S6_S3 0 255 /end CHARACTERISTIC
/begin CHARACTERISTIC STATUS_ZIEL_BZ_HAS_BYP_VECTOR "Vector für Bypass-Grösse status_ziel_bz_has_byp" VALUE 0x1D7404 UBYTE_COL_DIRECT_S6_S3 0 void_int_S6_S3 0 255 /end CHARACTERISTIC
/begin CHARACTERISTIC ST_IST_BZ_HAS_BYP_VECTOR "Vector für Bypass-Grösse st_ist_bz_has_byp" VALUE 0x1D7405 UBYTE_COL_DIRECT_S6_S3 0 void_int_S6_S3 0 255 /end CHARACTERISTIC
/begin CHARACTERISTIC ST_ZIEL_BZ_HAS_BYP_VECTOR "Vector für Bypass-Grösse st_ziel_bz_has_byp" VALUE 0x1D7406 UBYTE_COL_DIRECT_S6_S3 0 void_int_S6_S3 0 255 /end CHARACTERISTIC
/begin CHARACTERISTIC SWI_ABSTSTATTABK_OML_HAS "Schalter fuer die Auswahl der Hybridfunktion beim Zustandsuebergang von BZ 5 nach BZ 6 und von BZ 8 nach BZ 7 der Hybrid-Zustandssteuerung der HAS - FALSE = ABK, TRUE = ABST" VALUE 0x1D7422 UBYTE_COL_DIRECT_S6_S3 0 void_int_S6_S3 0 1 /end CHARACTERISTIC
/begin CHARACTERISTIC SWI_AKTPASSIVABB_OML "" VALUE 0x1D7423 UBYTE_COL_DIRECT_S6_S3 0 void_int_e_S6_S3 0 1 /end CHARACTERISTIC
/begin CHARACTERISTIC SWI_FLAGOFFPOSME "Schalter fuer internes Prüfflag immer auf 0" VALUE 0x1D7C93 ZF_kw_ui8_S5_S3 1 UMR___1_1_0_S5_S3 0 1 /end CHARACTERISTIC
/begin CHARACTERISTIC SWI_PDEAK_OELVERSFEHLER_ERK_HAS "Schalter, mit dem die Ölversorgungs-überwachung in Wählhebelposition P deaktiviert werden kann" VALUE 0x1D7418 UBYTE_COL_DIRECT_S6_S3 0 void_int_e_S6_S3 0 1 /end CHARACTERISTIC
/begin CHARACTERISTIC SWI_RESPSCHLE_SCHALT_ANS "Schalter zum aktivieren des Response Schleppstarts" VALUE 0x1D742A UBYTE_COL_DIRECT_S6_S3 0 void_int_S6_S3 0 255 /end CHARACTERISTIC
/begin CHARACTERISTIC SWI_ZEMAKTIVFUWZUS_DIHO "Schalter zur Aktivierung des Infospeicher-eintrags aufgrund EM-Fehlfunktion (FUW) während Zustart" VALUE 0x1D7419 UBYTE_COL_DIRECT_S6_S3 0 void_int_e_S6_S3 0 1 /end CHARACTERISTIC
/begin CHARACTERISTIC SWI_ZUSSTATTANK_OML_HAS "Schalter fuer die Auswahl der Hybridfunktion beim Zustandsuebergang von BZ 6 nach BZ 5 und von BZ 7 nach BZ 8 der Hybrid-Zustandssteuerung der HAS - FALSE = ANK, TRUE = ZUS" VALUE 0x1D7427 UBYTE_COL_DIRECT_S6_S3 0 void_int_S6_S3 0 1 /end CHARACTERISTIC
/begin CHARACTERISTIC SWI_Z_K0OEFFNICHTPB_ERSATZ_HAS "Ersatzwertumschaltung, 0 Funktionswert kommt durch, 1 Ersatzwert kommt durch" VALUE 0x1D741A UBYTE_COL_DIRECT_S6_S3 0 void_int_e_S6_S3 0 1 /end CHARACTERISTIC
/begin CHARACTERISTIC SWI_Z_K0OEFFNICHT_ERSATZ_HAS "Ersatzwertumschaltung, 0 Funktionswert kommt durch, 1 Ersatzwert kommt durch" VALUE 0x1D741B UBYTE_COL_DIRECT_S6_S3 0 void_int_e_S6_S3 0 1 /end CHARACTERISTIC
/begin CHARACTERISTIC SWI_Z_K0SCHLNICHTPB_ERSATZ_HAS "Ersatzwertumschaltung, 0 Funktionswert kommt durch, 1 Ersatzwert kommt durch" VALUE 0x1D741C UBYTE_COL_DIRECT_S6_S3 0 void_int_e_S6_S3 0 1 /end CHARACTERISTIC
/begin CHARACTERISTIC SWI_Z_K0SCHLNICHT_ERSATZ_HAS "Ersatzwertumschaltung 0 Funktionswert kommt durch, 1 Ersatzwert kommt durch" VALUE 0x1D741D UBYTE_COL_DIRECT_S6_S3 0 void_int_e_S6_S3 0 1 /end CHARACTERISTIC
/begin CHARACTERISTIC TAB_NMOTUEBDSCOFF "gangabhängige Tab. für die Vorgabe der Maxi.drehzahl bei DSC-Ausfall" CURVE 0x1CFC98 ZF_tab_ui16_S5_S3 10000 UMR___1_1_0_S5_S3 0 10000
 /begin AXIS_DESCR FIX_AXIS zff_atsys._.iSignale._.obj.sig_zielgang UMR___1_1_0_S5_S3 10 -1 8 READ_ONLY FIX_AXIS_PAR_DIST -1 1 10 /end AXIS_DESCR
/end CHARACTERISTIC
/begin CHARACTERISTIC TAB_ZDIAGNOTGANGFUW_FRK_HAS "Tabelle zur Festlegung der Zahlenwerte der Notgang-Information der Diagnose die zu einer Unterbindung der FUW-Aktivierung führen - Wert 0: keine Unterbindung aktiv" VAL_BLK 0x1D808A UBYTE_COL_DIRECT_S6_S3 0 void_int_S6_S3 0 255 MATRIX_DIM 10 1 1 /end CHARACTERISTIC
/begin CHARACTERISTIC TAB_ZDIAGNOTGANG_FRK_HAS "Tabelle zur Festlegung der Zahlenwerte der Notgang-Information der Diagnose die zu einer Unterdrückung der Ausgabe der minimalen EM-Drehzahl führen - Wert 0: keine Unterdrückung aktiv" VAL_BLK 0x1D8094 UBYTE_COL_DIRECT_S6_S3 0 void_int_S6_S3 0 255 MATRIX_DIM 10 1 1 /end CHARACTERISTIC
/begin CHARACTERISTIC TS_AKTIV_PVU_HAS "Zeitraum nach Erkennung der Betriebsbereitschaft des Hybridsystems in dem die Unterstuetzung der Positionsventilueberwachung durch die HAS aktiv ist." VALUE 0x197630 FLOAT32_IEEE_COL_DIRECT_S6_S3 0 t_fl_S6_S3 0 5 /end CHARACTERISTIC
/begin CHARACTERISTIC TS_ANFMAX_PVU_HAS "Maximaler Zeitraum nach Überschreiten der EM-Drehzahlschwelle zur Aktivierung der Ü-berwachung durch die Diagnose bei der Unter-stützung der Positionsventil-Überwachung der HAS" VALUE 0x197634 FLOAT32_IEEE_COL_DIRECT_S6_S3 0 t_fl_S6_S3 0 5 /end CHARACTERISTIC
/begin CHARACTERISTIC TS_MAX_PVU_HAS "Maximaler Zeitraum nach Erkennung der Betriebsbereitschaft des Hybridsystems in dem die Unterstuetzung der Positionsventilueberwachung durch die HAS aktiv ist. - Wert 0 deaktiviert den Timer.
" VALUE 0x197638 FLOAT32_IEEE_COL_DIRECT_S6_S3 0 t_fl_S6_S3 0 10 /end CHARACTERISTIC
/begin CHARACTERISTIC T_K0SCHLNICHTPB_DIHO "Anfilterzeit zur Erkennung der Pruefbedingung bei K0 schleißt nicht" VALUE 0x197210 FLOAT32_IEEE_COL_DIRECT_S6_S3 0 t_fl_S6_S3 0 10 /end CHARACTERISTIC
/begin CHARACTERISTIC T_MAX_AND_ABO "Zeit für Füllausgleichsphase K0" VALUE 0x1CFE84 FLOAT32_IEEE_COL_DIRECT_S6_S3 0 t_fl_S6_S3 -3.40282e+038 3.40282e+038 /end CHARACTERISTIC
/begin CHARACTERISTIC T_MAX_GAB_ABST "Maximale Verweildauer im Zustand 'VM geführt Abstellen' beim VM Abstellen" VALUE 0x1D0DA0 FLOAT32_IEEE_COL_DIRECT_S6_S3 0 t_fl_S6_S3 0 10 /end CHARACTERISTIC
/begin CHARACTERISTIC T_MAX_KOE_ABK "Maximale Verweildauer im Zustand 'K0-Öffnen' beim Abkoppeln" VALUE 0x1CFDF0 FLOAT32_IEEE_COL_DIRECT_S6_S3 0 t_fl_S6_S3 0 10 /end CHARACTERISTIC
/begin CHARACTERISTIC T_MAX_KOE_ABO "Maximalzeit im Zustand SLST Abbr." VALUE 0x1CFE88 FLOAT32_IEEE_COL_DIRECT_S6_S3 0 t_fl_S6_S3 0 10 /end CHARACTERISTIC
/begin CHARACTERISTIC T_MAX_KOE_ABST "Maximale Verweildauer im Zustand K0-Öffnen beim VM Abstellen" VALUE 0x1D0DA8 FLOAT32_IEEE_COL_DIRECT_S6_S3 0 t_fl_S6_S3 0 10 /end CHARACTERISTIC
/begin CHARACTERISTIC T_MAX_KSA_ABK "Maximale Verweildauer im Zustand 'K0-Schließen Abbruch' beim Abkoppeln" VALUE 0x1CFDF4 FLOAT32_IEEE_COL_DIRECT_S6_S3 0 t_fl_S6_S3 0 10 /end CHARACTERISTIC
/begin CHARACTERISTIC T_MAX_KSA_ABST "Maximale Verweildauer im Zustand K0-Schließen Abbruch beim VM Abstellen" VALUE 0x1D0DAC FLOAT32_IEEE_COL_DIRECT_S6_S3 0 t_fl_S6_S3 0 10 /end CHARACTERISTIC
/begin CHARACTERISTIC T_MAX_LAU_ABK "Maximale Verweildauer im Zustand 'Last-Übernahme' beim Abkoppeln" VALUE 0x1CFDF8 FLOAT32_IEEE_COL_DIRECT_S6_S3 0 t_fl_S6_S3 0 10 /end CHARACTERISTIC
/begin CHARACTERISTIC T_MAX_LAU_ABST "Maximale Verweildauer im Zustand Last-Übernahme beim VM Abstellen" VALUE 0x1D0DB0 FLOAT32_IEEE_COL_DIRECT_S6_S3 0 t_fl_S6_S3 0 10 /end CHARACTERISTIC
/begin CHARACTERISTIC T_MAX_SAK_ABK "Maximale Verweildauer im Zustand 'Schaltung Aktiv' beim Abkoppeln" VALUE 0x1CFDFC FLOAT32_IEEE_COL_DIRECT_S6_S3 0 t_fl_S6_S3 0 10 /end CHARACTERISTIC
/begin CHARACTERISTIC T_MAX_SAK_ABST "Maximale Verweildauer im Zustand 'Schaltung Aktiv' beim VM Abstellen" VALUE 0x1D0DB4 FLOAT32_IEEE_COL_DIRECT_S6_S3 0 t_fl_S6_S3 0 10 /end CHARACTERISTIC
/begin CHARACTERISTIC T_MK0STARTRAMPE_AND_ABO "Timer zur Aktivierung der Rampe" VALUE 0x1CFE8C FLOAT32_IEEE_COL_DIRECT_S6_S3 0 t_fl_S6_S3 -3.40282e+038 3.40282e+038 /end CHARACTERISTIC
/begin CHARACTERISTIC T_MSOLLEMAKTIV_ABO "Überwachung Ausgabe m_soll_em_has (Max.-Zeit)" VALUE 0x1CFE90 FLOAT32_IEEE_COL_DIRECT_S6_S3 0 t_fl_S6_S3 -3.40282e+038 3.40282e+038 /end CHARACTERISTIC
/begin CHARACTERISTIC T_VBRE_NMINPSYSEM_HAS "Verzögerungszeit zum Rücksetzen der minimalen EM Drehzahl zur Sicherstellung Ölversorgung beim Abbremsen - Beachte: Wert Null deaktiviert die Funktion" VALUE 0x197644 FLOAT32_IEEE_COL_DIRECT_S6_S3 0 t_fl_S6_S3 0 10 /end CHARACTERISTIC
/begin CHARACTERISTIC T_VK0NDK0ZUGROSS_FILT_AUW_HAS "Entprellzeit, zur Filterung des Fehlerereignisses, dass die VM-Zwangsankopplung nicht erfolgreich war." VALUE 0x197214 FLOAT32_IEEE_COL_DIRECT_S6_S3 0 t_fl_S6_S3 0 300 /end CHARACTERISTIC
/begin CHARACTERISTIC T_VK0OEFFNEN_LAU_ABST "Verzögerungszeit als Übergangsbedingung nach K0-Öffnen im Zustand Last-Übernahme beim VM Abstellen" VALUE 0x1D0DBC FLOAT32_IEEE_COL_DIRECT_S6_S3 0 t_fl_S6_S3 0 5 /end CHARACTERISTIC
/begin CHARACTERISTIC T_VK0OEFFNICHT_ERK_DIHO "Anfilterzeit zur Erkennung eines Fehlers bei K0 öffnet nicht." VALUE 0x197218 FLOAT32_IEEE_COL_DIRECT_S6_S3 0 t_fl_S6_S3 0 10 /end CHARACTERISTIC
/begin CHARACTERISTIC T_VK0SCHLNICHT_ERK_AUW_HAS "Zeit, in der das Schließen der K0 erkannt werden soll" VALUE 0x19721C FLOAT32_IEEE_COL_DIRECT_S6_S3 0 t_fl_S6_S3 0 300 /end CHARACTERISTIC
/begin CHARACTERISTIC T_VK0SCHLNICHT_ERK_DIHO "Anfilterzeit zur Erkennung eines Fehlers bei K0 schließt nicht" VALUE 0x197220 FLOAT32_IEEE_COL_DIRECT_S6_S3 0 t_fl_S6_S3 0 10 /end CHARACTERISTIC
/begin CHARACTERISTIC T_VK0SCHLNICHT_FILT_AUW_HAS "Entprellzeit, zur Filterung des Fehlerereignisses, dass die K0 nicht schliesst." VALUE 0x197224 FLOAT32_IEEE_COL_DIRECT_S6_S3 0 t_fl_S6_S3 0 300 /end CHARACTERISTIC
/begin CHARACTERISTIC T_VNDK0ZUGROSS_FILT_AUW_HAS "Entprellzeit, zur Filterung des Fehlerereignisses, dass die K0-Differenzdrehzahl zu hoch ist." VALUE 0x197228 FLOAT32_IEEE_COL_DIRECT_S6_S3 0 t_fl_S6_S3 0 300 /end CHARACTERISTIC
/begin CHARACTERISTIC T_VNEMNDK0_HAS "Verzögerungszeit der EM-Drehzahl für die Berechnung der K0-Differenzdrehzahl" VALUE 0x197648 FLOAT32_IEEE_COL_DIRECT_S6_S3 0 t_fl_S6_S3 0 0.15 /end CHARACTERISTIC
/begin CHARACTERISTIC T_VNEMZUKLEIN_FILT_AUW_HAS "Entprellzeit, zur Filterung des Fehlerereignisses, dass die EM-Istdrehzahl zu gering ist." VALUE 0x19722C FLOAT32_IEEE_COL_DIRECT_S6_S3 0 t_fl_S6_S3 0 300 /end CHARACTERISTIC
/begin CHARACTERISTIC T_VNMINPSYSEM_KL50_HAS "Verzögerungszeit nach Erkennung Betriebsbereitschaft zur Aktivierung der Ausgabe der minimalen EM Drehzahl zur Sicherstellung Ölversorgung" VALUE 0x19764C FLOAT32_IEEE_COL_DIRECT_S6_S3 0 t_fl_S6_S3 0 1 /end CHARACTERISTIC
/begin CHARACTERISTIC T_VNVMNDK0_HAS "Verzögerungszeit der VM-Drehzahl für die Berechnung der K0-Differenzdrehzahl" VALUE 0x197650 FLOAT32_IEEE_COL_DIRECT_S6_S3 0 t_fl_S6_S3 0 0.15 /end CHARACTERISTIC
/begin CHARACTERISTIC T_VOELVERSFEHLERKALT_FILT_HAS "Entprellzeit zur Filterung des Fehlerereignisses, dass ein Ölversorgungsfehler vorliegt" VALUE 0x197230 FLOAT32_IEEE_COL_DIRECT_S6_S3 0 t_fl_S6_S3 0 300 /end CHARACTERISTIC
/begin CHARACTERISTIC T_VOELVERSFEHLER_FILT_HAS "Entprellzeit zur Filterung des Fehlerereignisses, dass ein Ölversorgungsfehler vorliegt" VALUE 0x197234 FLOAT32_IEEE_COL_DIRECT_S6_S3 0 t_fl_S6_S3 0 60 /end CHARACTERISTIC
/begin CHARACTERISTIC T_VSCHALTUNGAKTIV_HAS "Timer zum Zürücksetzen des status_schaltung_egs nach Schaltung bei anstehender Schaltungsanforderung durch fst" VALUE 0x197654 FLOAT32_IEEE_COL_DIRECT_S6_S3 0 t_fl_S6_S3 -3.40282e+038 3.40282e+038 /end CHARACTERISTIC
/begin CHARACTERISTIC T_VVMAUS_FILT_AUW_HAS "Entprellzeit, zur Filterung des Fehlerereignisses, dass der VM aus ist." VALUE 0x197238 FLOAT32_IEEE_COL_DIRECT_S6_S3 0 t_fl_S6_S3 0 300 /end CHARACTERISTIC
/begin CHARACTERISTIC T_VZABLAUFREINIT_HAS "Verzögerungszeit zur Bestimmung des Soll-Betriebszustands der Hybrid-Zustandssteuerung bei Anforderung eines Neustarts durch die HAS Diagnose" VALUE 0x197594 FLOAT32_IEEE_COL_DIRECT_S6_S3 0 t_fl_S6_S3 0 1 /end CHARACTERISTIC
/begin CHARACTERISTIC T_VZK0OEFFNEN_LAU_ABK "Verzögerungszeit als Übergangsbedingung nach 'K0-Öffnen' im Zustand 'Last-Übernahme' beim Abkoppeln" VALUE 0x1CFE00 FLOAT32_IEEE_COL_DIRECT_S6_S3 0 t_fl_S6_S3 0 5 /end CHARACTERISTIC
/begin CHARACTERISTIC XP_MAX "" VALUE 0x197664 FLOAT32_IEEE_COL_DIRECT_S6_S3 0 void_fl_S6_S3 -3.40282e+038 3.40282e+038 /end CHARACTERISTIC
/begin CHARACTERISTIC Z_ABLVAR_KST_MPS_HAS "Angeforderte HAS-Ablaufvariante von der HST zur Kenn-zeichnung eines Kalt-SST" VALUE 0x1D742B UBYTE_COL_DIRECT_S6_S3 0 void_int_S6_S3 0 99 /end CHARACTERISTIC
/begin CHARACTERISTIC Z_GLSBE_HAS_BYP_VECTOR "Vector für Bypass-Grösse z_glsbe_has_byp" VALUE 0x1D7407 UBYTE_COL_DIRECT_S6_S3 0 void_int_S6_S3 0 255 /end CHARACTERISTIC
/begin CHARACTERISTIC Z_K0OEFFNICHTPB_ERSATZ_HAS "Ersatzwert der Pruefbedingung zur Uebergabe an den Errorhandler zur Ueberwachung VM-Drehzahl faellt bei einer geöffneten K0 nicht ab" VALUE 0x1D741E UBYTE_COL_DIRECT_S6_S3 0 void_int_S6_S3 0 1 /end CHARACTERISTIC
/begin CHARACTERISTIC Z_K0OEFFNICHT_ERSATZ_HAS "Ersatzwert zur Übergabean den Errorhandler zur Überwachung VM-Drehzahl fällt bei einer geöffneten K0 nicht ab" VALUE 0x1D741F UBYTE_COL_DIRECT_S6_S3 0 void_int_S6_S3 0 1 /end CHARACTERISTIC
/begin CHARACTERISTIC Z_K0SCHLNICHTPB_ERSATZ_HAS "Ersatzwert der Pruefbedingung Uebergabe an den Errorhandler zur Ueberwachung der maximalen Dauer der K0-Ansteuerung in Druckstellung beim schließen der K0 im Schleppstart." VALUE 0x1D7420 UBYTE_COL_DIRECT_S6_S3 0 void_int_S6_S3 0 1 /end CHARACTERISTIC
/begin CHARACTERISTIC Z_K0SCHLNICHT_ERSATZ_HAS "Ersatzwert der Übergabe an den Erroshandler zur Überwachung der maximalen Dauer der K0-Anstuerung in Druckstellung beim schließen der K0 im Schleppstart" VALUE 0x1D7421 UBYTE_COL_DIRECT_S6_S3 0 void_int_S6_S3 0 1 /end CHARACTERISTIC
/begin CHARACTERISTIC Z_K0_BEFUELLOPT_HAS_BYP_VECTOR "Vector für Bypass-Grösse z_k0_befuellopt_has_byp" VALUE 0x1D7408 UBYTE_COL_DIRECT_S6_S3 0 void_int_S6_S3 0 255 /end CHARACTERISTIC
/begin CHARACTERISTIC Z_K0_HAS_BYP_VECTOR "Vector für Bypass-Grösse z_k0_has_byp" VALUE 0x1D7409 UBYTE_COL_DIRECT_S6_S3 0 void_int_S6_S3 0 255 /end CHARACTERISTIC
/begin CHARACTERISTIC Z_MODUS_IAE_HAS_BYP_VECTOR "Vector für Bypass-Grösse z_modus_iae_has_byp" VALUE 0x1D740A UBYTE_COL_DIRECT_S6_S3 0 void_int_S6_S3 0 255 /end CHARACTERISTIC
/begin CHARACTERISTIC Z_MODUS_IEP_HAS_BYP_VECTOR "Vector für Bypass-Grösse z_modus_iep_has_byp" VALUE 0x1D740B UBYTE_COL_DIRECT_S6_S3 0 void_int_S6_S3 0 255 /end CHARACTERISTIC
/begin CHARACTERISTIC Z_MSA_HAS_BYP_VECTOR "Vector für Bypass-Grösse z_msa_deaktivierer_has_byp" VALUE 0x1D740C UBYTE_COL_DIRECT_S6_S3 0 void_int_S6_S3 0 255 /end CHARACTERISTIC
/begin CHARACTERISTIC Z_M_MAX_IAE_HAS_BYP_VECTOR "Vector für Bypass-Grösse z_m_max_iae_has_byp" VALUE 0x1D740D UBYTE_COL_DIRECT_S6_S3 0 void_int_S6_S3 0 255 /end CHARACTERISTIC
/begin CHARACTERISTIC Z_M_SOLL_EM_HAS_BYP_VECTOR "Vector für Bypass-Grösse" VALUE 0x1D740E UBYTE_COL_DIRECT_S6_S3 0 void_int_S6_S3 0 255 /end CHARACTERISTIC
/begin CHARACTERISTIC Z_N_SOLL_EM_HAS_BYP_VECTOR "Vector für Bypass-Grösse z_n_soll_em_has_byp" VALUE 0x1D740F UBYTE_COL_DIRECT_S6_S3 0 void_int_S6_S3 0 255 /end CHARACTERISTIC
/begin CHARACTERISTIC Z_N_SOLL_VM_HAS_BYP_VECTOR "Vector für Bypass-Grösse z_n_soll_vm_has_byp" VALUE 0x1D7410 UBYTE_COL_DIRECT_S6_S3 0 void_int_S6_S3 0 255 /end CHARACTERISTIC
/begin CHARACTERISTIC Z_P_HYS_K0_HAS_BYP_VECTOR "Vector für Bypass-Grösse z_p_hys_k0_has_byp" VALUE 0x1D7411 UBYTE_COL_DIRECT_S6_S3 0 void_int_S6_S3 0 255 /end CHARACTERISTIC
/begin CHARACTERISTIC Z_SAF_HAS_BYP_VECTOR "Vector für Bypass-Grösse z_saf_has_byp" VALUE 0x1D7412 UBYTE_COL_DIRECT_S6_S3 0 void_int_S6_S3 0 255 /end CHARACTERISTIC
/begin CHARACTERISTIC Z_SAS_HAS_BYP_VECTOR "Vector für Bypass-Grösse z_sas_has_byp" VALUE 0x1D7413 UBYTE_COL_DIRECT_S6_S3 0 void_int_S6_S3 0 255 /end CHARACTERISTIC
/begin CHARACTERISTIC Z_SBE_HAS_BYP_VECTOR "Vector für Bypass-Grösse flag_verbot_schalt_aktiv_has_byp" VALUE 0x1D7414 UBYTE_COL_DIRECT_S6_S3 0 void_int_S6_S3 0 255 /end CHARACTERISTIC
/begin CHARACTERISTIC Z_START_MODUS_HAS_BYP_VECTOR "Vector für Bypass-Grösse z_start_modus_has_byp" VALUE 0x1D7415 UBYTE_COL_DIRECT_S6_S3 0 void_int_S6_S3 0 255 /end CHARACTERISTIC
/begin CHARACTERISTIC Z_STATUS_PSYS_MPS_HAS_BYP_VECTOR "Vector für Bypass-Grösse z_status_psys_mps_has_byp" VALUE 0x1D7416 UBYTE_COL_DIRECT_S6_S3 0 void_int_S6_S3 0 255 /end CHARACTERISTIC
/begin CHARACTERISTIC Z_SVH_HAS_BYP_VECTOR "Vector für Bypass-Grösse z_svh_has_byp" VALUE 0x1D7417 UBYTE_COL_DIRECT_S6_S3 0 void_int_S6_S3 0 255 /end CHARACTERISTIC
/begin MEASUREMENT abstellpos_vm_in "Abstellposition VM vor nächstem ZOT" UBYTE void_int_S6_S3 1 100 0 180 ECU_ADDRESS 0xFFF86698 /end MEASUREMENT
/begin MEASUREMENT abstellpos_vm_portin "Abstellposition VM vor nächstem ZOT" UBYTE void_int_S6_S3 1 100 0 180 ECU_ADDRESS 0xFFF8666B /end MEASUREMENT
/begin MEASUREMENT abstellpos_vm_status_in "Status Abstellposition VM" UBYTE void_int_S6_S3 1 100 0 2 ECU_ADDRESS 0xFFF86699 /end MEASUREMENT
/begin MEASUREMENT abstellpos_vm_status_portin "Status Abstellposition VM" UBYTE void_int_S6_S3 1 100 0 2 ECU_ADDRESS 0xFFF8666C /end MEASUREMENT
/begin MEASUREMENT analyse_has_byp "" UBYTE void_int_S6_S3 1 100 0 255 ECU_ADDRESS 0xFFF96DED /end MEASUREMENT
/begin MEASUREMENT analyse_has_portout "" UBYTE void_int_S6_S3 1 100 0 8 ECU_ADDRESS 0xFFF86216 /end MEASUREMENT
/begin MEASUREMENT bErrorHybrid "" UBYTE void_int_S6_S3 1 100 0 15 ECU_ADDRESS 0xFFF86666 /end MEASUREMENT
/begin MEASUREMENT bExceptionHybrid "" UBYTE void_int_S6_S3 1 100 0 15 ECU_ADDRESS 0xFFF86667 /end MEASUREMENT
/begin MEASUREMENT bReInitNormalMode_azg "Reinitialisierung NormalMode" UBYTE void_int_S6_S3 1 100 0 255 ECU_ADDRESS 0xFFF96D5A /end MEASUREMENT
/begin MEASUREMENT byp_vnr_has_byp "" UBYTE void_int_S6_S3 1 100 0 255 ECU_ADDRESS 0xFFF96DEE /end MEASUREMENT
/begin MEASUREMENT bypass_has_aktiv "" UBYTE void_int_S6_S3 1 100 0 255 ECU_ADDRESS 0xFFF96DEF /end MEASUREMENT
/begin MEASUREMENT c_getriebe_egs_in "" FLOAT32_IEEE c_int_S6_S3 1 100 -40 215 ECU_ADDRESS 0xFFF85DDC /end MEASUREMENT
/begin MEASUREMENT c_getriebe_egs_portin "" UBYTE c_int_m_S6_S3 1 100 0 255 ECU_ADDRESS 0xFFF861EE /end MEASUREMENT
/begin MEASUREMENT c_iep_portin "" SWORD c_int_l_S6_S3 1 100 -32768 32767 ECU_ADDRESS 0xFFF8604A /end MEASUREMENT
/begin MEASUREMENT c_vm_in "" FLOAT32_IEEE c_int_S6_S3 1 100 -3.40282e+038 3.40282e+038 ECU_ADDRESS 0xFFF85E38 /end MEASUREMENT
/begin MEASUREMENT c_vm_portin "" UBYTE c_int_m_S6_S3 1 100 0 255 ECU_ADDRESS 0xFFF8666D /end MEASUREMENT
/begin MEASUREMENT ctrlAbortOp_req_azg "Ausgangsgroessen im Abbruchszustand (codiert)" ULONG b_int_S6_S3 1 100 0 4294967295 ECU_ADDRESS 0xFFF96390 /end MEASUREMENT
/begin MEASUREMENT err_n_soll_em_has_komp_portout "" UBYTE void_int_S6_S3 1 100 254 255 ECU_ADDRESS 0xFFF86217 /end MEASUREMENT
/begin MEASUREMENT err_n_soll_em_has_portout "" UBYTE void_int_S6_S3 1 100 0 1 ECU_ADDRESS 0xFFF86218 /end MEASUREMENT
/begin MEASUREMENT err_n_soll_vm_has_komp_portout "" UBYTE void_int_S6_S3 1 100 254 255 ECU_ADDRESS 0xFFF86219 /end MEASUREMENT
/begin MEASUREMENT err_n_soll_vm_has_portout "" UBYTE void_int_S6_S3 1 100 0 1 ECU_ADDRESS 0xFFF8621A /end MEASUREMENT
/begin MEASUREMENT gangwechsel_egs_in "Flag während laufender Schaltung, bei synchron verlassen bis synchron erreicht" UBYTE void_int_S6_S3 1 100 0 1 ECU_ADDRESS 0xFFF86677 /end MEASUREMENT
/begin MEASUREMENT gangwechsel_egs_portin "Flag während laufender Schaltung, bei synchron verlassen bis synchron erreicht" UBYTE void_int_S6_S3 1 100 0 1 ECU_ADDRESS 0xFFF861EF /end MEASUREMENT
/begin MEASUREMENT has_aktiv_has_byp "" UBYTE void_int_S6_S3 1 100 0 255 ECU_ADDRESS 0xFFF96DF0 /end MEASUREMENT
/begin MEASUREMENT i_istgang_egs "" FLOAT32_IEEE void_fl_S6_S3 1 100 0 8 ECU_ADDRESS 0xFFF85D8C /end MEASUREMENT
/begin MEASUREMENT i_zielgang_egs "" FLOAT32_IEEE void_fl_S6_S3 1 100 0 8 ECU_ADDRESS 0xFFF85D90 /end MEASUREMENT
/begin MEASUREMENT iep_soll_has_portout "" UBYTE E_ZMODUSIEP_S6_S3 1 100 0 4 ECU_ADDRESS 0xFFF8621B /end MEASUREMENT
/begin MEASUREMENT istgang_egs "" SBYTE void_int_S6_S3 1 100 0 15 ECU_ADDRESS 0xFFF86676 /end MEASUREMENT
/begin MEASUREMENT istgang_egs_in "" SBYTE void_int_S6_S3 1 100 -128 127 ECU_ADDRESS 0xFFF86678 /end MEASUREMENT
/begin MEASUREMENT istgang_egs_portin "" SBYTE void_int_S6_S3 1 100 -128 127 ECU_ADDRESS 0xFFF861F0 /end MEASUREMENT
/begin MEASUREMENT m_em_in "" FLOAT32_IEEE trq_fl_a_S6_S3 1 100 -1024 1024 ECU_ADDRESS 0xFFF85DE0 /end MEASUREMENT
/begin MEASUREMENT m_em_portin "" SWORD trq_fl_S6_S3 1 100 -32768 32767 ECU_ADDRESS 0xFFF8604C /end MEASUREMENT
/begin MEASUREMENT m_iae_in "" FLOAT32_IEEE trq_fl_a_S6_S3 1 100 -32768 32767 ECU_ADDRESS 0xFFF85DE4 /end MEASUREMENT
/begin MEASUREMENT m_iae_portin "" SWORD trq_fl_S6_S3 1 100 -32768 32767 ECU_ADDRESS 0xFFF8604E /end MEASUREMENT
/begin MEASUREMENT m_k0_fkt "" FLOAT32_IEEE trq_fl_a_S6_S3 1 100 -1200 1200 ECU_ADDRESS 0xFFF85D48 /end MEASUREMENT
/begin MEASUREMENT m_k0_has_byp "" SWORD trq_fl_S6_S3 1 100 -32768 32767 ECU_ADDRESS 0xFFF96EFE /end MEASUREMENT
/begin MEASUREMENT m_k0_has_portout "" SWORD trq_fl_S6_S3 1 100 0 1000 ECU_ADDRESS 0xFFF86072 /end MEASUREMENT
/begin MEASUREMENT m_k0_in "" FLOAT32_IEEE trq_fl_a_S6_S3 1 100 -32768 32767 ECU_ADDRESS 0xFFF85DE8 /end MEASUREMENT
/begin MEASUREMENT m_k0_mber_has_byp "" SWORD trq_fl_S6_S3 1 100 -32768 32767 ECU_ADDRESS 0xFFF96F00 /end MEASUREMENT
/begin MEASUREMENT m_k0_mber_has_portout "" SWORD trq_fl_S6_S3 1 100 -32768 32767 ECU_ADDRESS 0xFFF86090 /end MEASUREMENT
/begin MEASUREMENT m_k0_mber_has_sbe "K0-Moment der HAS zur Motormomentbegrenzung in der SAB" FLOAT32_IEEE trq_fl_a_S6_S3 1 100 -3.40282e+038 3.40282e+038 ECU_ADDRESS 0xFFF85DC4 /end MEASUREMENT
/begin MEASUREMENT m_k0_mod_has_fkt "" FLOAT32_IEEE trq_fl_a_S6_S3 1 100 -1200 1200 ECU_ADDRESS 0xFFF85D4C /end MEASUREMENT
/begin MEASUREMENT m_k0_portin "" SWORD trq_fl_S6_S3 1 100 -32768 32767 ECU_ADDRESS 0xFFF86050 /end MEASUREMENT
/begin MEASUREMENT m_max_dyn_em_in "" FLOAT32_IEEE trq_fl_a_S6_S3 1 100 -32768 32767 ECU_ADDRESS 0xFFF85DEC /end MEASUREMENT
/begin MEASUREMENT m_max_dyn_em_portin "" SWORD trq_fl_S6_S3 1 100 -32768 32767 ECU_ADDRESS 0xFFF86052 /end MEASUREMENT
/begin MEASUREMENT m_max_em_has_byp "" SWORD trq_fl_S6_S3 1 100 -32768 32767 ECU_ADDRESS 0xFFF96F02 /end MEASUREMENT
/begin MEASUREMENT m_max_em_has_fkt "" FLOAT32_IEEE trq_fl_a_S6_S3 1 100 -1200 1200 ECU_ADDRESS 0xFFF85D50 /end MEASUREMENT
/begin MEASUREMENT m_max_em_has_portout "" SWORD trq_fl_S6_S3 1 100 -32768 32767 ECU_ADDRESS 0xFFF86092 /end MEASUREMENT
/begin MEASUREMENT m_max_iae_has_byp "" SWORD trq_fl_S6_S3 1 100 -32768 32767 ECU_ADDRESS 0xFFF96F04 /end MEASUREMENT
/begin MEASUREMENT m_max_iae_has_fkt "" FLOAT32_IEEE trq_fl_a_S6_S3 1 100 -1200 1200 ECU_ADDRESS 0xFFF85D54 /end MEASUREMENT
/begin MEASUREMENT m_max_iae_has_portout "" SWORD trq_fl_S6_S3 1 100 -200 1300 ECU_ADDRESS 0xFFF86074 /end MEASUREMENT
/begin MEASUREMENT m_max_vm_portin "" SWORD trq_fl_S6_S3 1 100 -32767 32767 ECU_ADDRESS 0xFFF860CE /end MEASUREMENT
/begin MEASUREMENT m_min_dyn_em_in "" FLOAT32_IEEE trq_fl_a_S6_S3 1 100 -3.40282e+038 3.40282e+038 ECU_ADDRESS 0xFFF85DF0 /end MEASUREMENT
/begin MEASUREMENT m_min_dyn_em_portin "" SWORD trq_fl_S6_S3 1 100 -32768 32767 ECU_ADDRESS 0xFFF86054 /end MEASUREMENT
/begin MEASUREMENT m_min_em_has_byp "" SWORD trq_fl_S6_S3 1 100 -32768 32767 ECU_ADDRESS 0xFFF96F06 /end MEASUREMENT
/begin MEASUREMENT m_min_em_has_fkt "" FLOAT32_IEEE trq_fl_a_S6_S3 1 100 -1200 1200 ECU_ADDRESS 0xFFF85D58 /end MEASUREMENT
/begin MEASUREMENT m_min_em_has_portout "" SWORD trq_fl_S6_S3 1 100 -32768 32767 ECU_ADDRESS 0xFFF86094 /end MEASUREMENT
/begin MEASUREMENT m_min_vm_in "" FLOAT32_IEEE trq_fl_a_S6_S3 1 100 -3.40282e+038 3.40282e+038 ECU_ADDRESS 0xFFF85E3C /end MEASUREMENT
/begin MEASUREMENT m_min_vm_portin "" UWORD trq_fl_S6_S3 1 100 0 65535 ECU_ADDRESS 0xFFF860D0 /end MEASUREMENT
/begin MEASUREMENT m_mot_in "" FLOAT32_IEEE trq_fl_a_S6_S3 1 100 -1024 1024 ECU_ADDRESS 0xFFF85DF4 /end MEASUREMENT
/begin MEASUREMENT m_mot_portin "" SWORD trq_fl_S6_S3 1 100 -1024 1024 ECU_ADDRESS 0xFFF86056 /end MEASUREMENT
/begin MEASUREMENT m_motmax_has "" FLOAT32_IEEE trq_fl_a_S6_S3 1 100 -1200 1200 ECU_ADDRESS 0xFFF85DC8 /end MEASUREMENT
/begin MEASUREMENT m_motmax_has_byp "" SWORD trq_fl_S6_S3 1 100 -32768 32767 ECU_ADDRESS 0xFFF96F08 /end MEASUREMENT
/begin MEASUREMENT m_motmax_has_komp_portout "Komplement zu geführtem Getriebeschutz " SWORD trq_fl_S6_S3 1 100 -32768 32767 ECU_ADDRESS 0xFFF86076 /end MEASUREMENT
/begin MEASUREMENT m_motmax_has_portout "" SWORD trq_fl_S6_S3 1 100 -32768 32767 ECU_ADDRESS 0xFFF86078 /end MEASUREMENT
/begin MEASUREMENT m_soll_em_has_byp "" SWORD trq_fl_S6_S3 1 100 -32768 32767 ECU_ADDRESS 0xFFF96F0A /end MEASUREMENT
/begin MEASUREMENT m_soll_em_has_fkt "" FLOAT32_IEEE trq_fl_a_S6_S3 1 100 -1200 1200 ECU_ADDRESS 0xFFF85D5C /end MEASUREMENT
/begin MEASUREMENT m_soll_em_has_komp_portout "" SWORD trq_fl_S6_S3 1 100 -32768 32767 ECU_ADDRESS 0xFFF8607A /end MEASUREMENT
/begin MEASUREMENT m_soll_em_has_portout "" SWORD trq_fl_S6_S3 1 100 -32768 32767 ECU_ADDRESS 0xFFF8607C /end MEASUREMENT
/begin MEASUREMENT m_soll_em_hst_in "" FLOAT32_IEEE trq_fl_a_S6_S3 1 100 -32768 32767 ECU_ADDRESS 0xFFF85DF8 /end MEASUREMENT
/begin MEASUREMENT m_soll_em_hst_portin "" SWORD trq_fl_S6_S3 1 100 -32768 32767 ECU_ADDRESS 0xFFF86058 /end MEASUREMENT
/begin MEASUREMENT m_soll_k0_has_byp "" SWORD trq_fl_S6_S3 1 100 -32768 32767 ECU_ADDRESS 0xFFF96F0C /end MEASUREMENT
/begin MEASUREMENT m_soll_k0_has_fkt "" FLOAT32_IEEE trq_fl_a_S6_S3 1 100 -1200 1200 ECU_ADDRESS 0xFFF85D60 /end MEASUREMENT
/begin MEASUREMENT m_soll_k0_has_portout "" SWORD trq_fl_S6_S3 1 100 -32768 32767 ECU_ADDRESS 0xFFF8607E /end MEASUREMENT
/begin MEASUREMENT m_soll_res_em_bas_sbe "" FLOAT32_IEEE trq_fl_a_S6_S3 1 100 -3.40282e+038 3.40282e+038 ECU_ADDRESS 0xFFF85DCC /end MEASUREMENT
/begin MEASUREMENT m_soll_res_em_has_byp "" SWORD trq_fl_S6_S3 1 100 -32768 32767 ECU_ADDRESS 0xFFF96F0E /end MEASUREMENT
/begin MEASUREMENT m_soll_res_em_has_fkt "" FLOAT32_IEEE trq_fl_a_S6_S3 1 100 -1200 1200 ECU_ADDRESS 0xFFF85D64 /end MEASUREMENT
/begin MEASUREMENT m_soll_res_em_has_portout "" SWORD trq_fl_S6_S3 1 100 0 1000 ECU_ADDRESS 0xFFF86080 /end MEASUREMENT
/begin MEASUREMENT m_soll_res_em_has_sbe "" FLOAT32_IEEE trq_fl_a_S6_S3 1 100 -3.40282e+038 3.40282e+038 ECU_ADDRESS 0xFFF85DD0 /end MEASUREMENT
/begin MEASUREMENT m_soll_vm_has_fkt "" FLOAT32_IEEE trq_fl_a_S6_S3 1 100 -1200 1200 ECU_ADDRESS 0xFFF85D68 /end MEASUREMENT
/begin MEASUREMENT m_soll_vm_hst_in "" FLOAT32_IEEE trq_fl_a_S6_S3 1 100 -32768 32767 ECU_ADDRESS 0xFFF85DFC /end MEASUREMENT
/begin MEASUREMENT m_soll_vm_hst_portin "" SWORD trq_fl_S6_S3 1 100 -32768 32767 ECU_ADDRESS 0xFFF8605A /end MEASUREMENT
/begin MEASUREMENT m_soll_vm_l_has_fkt "" FLOAT32_IEEE trq_fl_a_S6_S3 1 100 -1200 1200 ECU_ADDRESS 0xFFF85D6C /end MEASUREMENT
/begin MEASUREMENT m_soll_vm_l_hst_in "" FLOAT32_IEEE trq_fl_a_S6_S3 1 100 -3.40282e+038 3.40282e+038 ECU_ADDRESS 0xFFF85E40 /end MEASUREMENT
/begin MEASUREMENT m_soll_vm_l_hst_portin "Sollfüllungsmoment V-Motor (Luftpfad) der Hybridstrategie" SWORD trq_fl_S6_S3 1 100 -32767 32767 ECU_ADDRESS 0xFFF860D2 /end MEASUREMENT
/begin MEASUREMENT m_vm "" FLOAT32_IEEE void_fl_S6_S3 1 100 0 15 ECU_ADDRESS 0xFFF85DD8 /end MEASUREMENT
/begin MEASUREMENT m_vm_in "" FLOAT32_IEEE trq_fl_a_S6_S3 1 100 -1024 1023.5 ECU_ADDRESS 0xFFF85E00 /end MEASUREMENT
/begin MEASUREMENT m_vm_portin "" SWORD trq_fl_S6_S3 1 100 -32768 32767 ECU_ADDRESS 0xFFF8605C /end MEASUREMENT
/begin MEASUREMENT m_vm_start_in "" FLOAT32_IEEE trq_fl_a_S6_S3 1 100 -1024 1023.5 ECU_ADDRESS 0xFFF85E04 /end MEASUREMENT
/begin MEASUREMENT m_vm_start_portin "" SWORD trq_fl_S6_S3 1 100 -32768 32767 ECU_ADDRESS 0xFFF8605E /end MEASUREMENT
/begin MEASUREMENT m_wunsch_fpw_hst_fil "" FLOAT32_IEEE trqg_fl_c_S6_S3 1 100 -2000 2000 ECU_ADDRESS 0xFFF85D94 /end MEASUREMENT
/begin MEASUREMENT m_wunsch_fpw_hst_in "" FLOAT32_IEEE trq_fl_a_S6_S3 1 100 -3.40282e+038 3.40282e+038 ECU_ADDRESS 0xFFF85E44 /end MEASUREMENT
/begin MEASUREMENT m_wunsch_fpw_hst_portin "gefiltertes Motorsollmoment inklusive aller Momenteneingriffe exkl. Getriebe-Me" SWORD trq_fl_S6_S3 1 100 -32768 32767 ECU_ADDRESS 0xFFF860D4 /end MEASUREMENT
/begin MEASUREMENT m_wunsch_fpw_in "" FLOAT32_IEEE trq_fl_a_S6_S3 1 100 -32768 32767 ECU_ADDRESS 0xFFF85E08 /end MEASUREMENT
/begin MEASUREMENT m_wunsch_fpw_portin "" SWORD trq_fl_S6_S3 1 100 -32768 32767 ECU_ADDRESS 0xFFF86060 /end MEASUREMENT
/begin MEASUREMENT mg_max_em_has_fkt "" FLOAT32_IEEE trqg_fl_c_S6_S3 1 100 -3000 3000 ECU_ADDRESS 0xFFF85D70 /end MEASUREMENT
/begin MEASUREMENT mg_min_em_has_fkt "" FLOAT32_IEEE trqg_fl_c_S6_S3 1 100 -3000 3000 ECU_ADDRESS 0xFFF85D74 /end MEASUREMENT
/begin MEASUREMENT mg_soll_K0_fkt "" FLOAT32_IEEE trqg_fl_c_S6_S3 1 100 -3000 3000 ECU_ADDRESS 0xFFF85D78 /end MEASUREMENT
/begin MEASUREMENT mg_soll_k0_has_fkt "" FLOAT32_IEEE trqg_fl_c_S6_S3 1 100 -3000 3000 ECU_ADDRESS 0xFFF85D7C /end MEASUREMENT
/begin MEASUREMENT mg_soll_k0_neg_has_byp "" SWORD trqg_fl_S6_S3 1 100 -32768 32767 ECU_ADDRESS 0xFFF96F10 /end MEASUREMENT
/begin MEASUREMENT mg_soll_k0_neg_has_portout "" SWORD trqg_fl_S6_S3 1 100 -10000 0 ECU_ADDRESS 0xFFF86082 /end MEASUREMENT
/begin MEASUREMENT mg_soll_k0_pos_has_byp "" SWORD trqg_fl_S6_S3 1 100 -32768 32767 ECU_ADDRESS 0xFFF96F12 /end MEASUREMENT
/begin MEASUREMENT mg_soll_k0_pos_has_portout "" SWORD trqg_fl_S6_S3 1 100 0 10000 ECU_ADDRESS 0xFFF86084 /end MEASUREMENT
/begin MEASUREMENT mg_wunsch_fpw "" FLOAT32_IEEE trqg_fl_c_S6_S3 1 100 -2000 2000 ECU_ADDRESS 0xFFF85D98 /end MEASUREMENT
/begin MEASUREMENT mg_wunsch_fpw_hst "" FLOAT32_IEEE trqg_fl_c_S6_S3 1 100 -2000 2000 ECU_ADDRESS 0xFFF85D9C /end MEASUREMENT
/begin MEASUREMENT mo_mod_em_hst_has_byp "" SWORD trq_fl_S6_S3 1 100 -32768 32767 ECU_ADDRESS 0xFFF96F14 /end MEASUREMENT
/begin MEASUREMENT mo_mod_em_hst_has_portout "" SWORD trq_fl_S6_S3 1 100 -32768 32767 ECU_ADDRESS 0xFFF86096 /end MEASUREMENT
/begin MEASUREMENT mod_K0_fkt "" UBYTE void_int_S6_S3 1 100 0 50 ECU_ADDRESS 0xFFF8663A /end MEASUREMENT
/begin MEASUREMENT n_ab_egs_in "" FLOAT32_IEEE n_fl_S6_S3 1 100 0 65535 ECU_ADDRESS 0xFFF85E0C /end MEASUREMENT
/begin MEASUREMENT n_ab_egs_portin "" UWORD n_int_S6_S3 1 100 0 65535 ECU_ADDRESS 0xFFF86062 /end MEASUREMENT
/begin MEASUREMENT n_em_in "" FLOAT32_IEEE n_fl_S6_S3 1 100 -3.40282e+038 3.40282e+038 ECU_ADDRESS 0xFFF85E10 /end MEASUREMENT
/begin MEASUREMENT n_em_portin "" UWORD n_int_S6_S3 1 100 0 65535 ECU_ADDRESS 0xFFF86064 /end MEASUREMENT
/begin MEASUREMENT n_min_em_has_sbe "Minimale EM Drehzahl der Leerlaufsimulation der HAS (LLS)" FLOAT32_IEEE n_fl_S6_S3 1 100 -32767 32767 ECU_ADDRESS 0xFFF85DD4 /end MEASUREMENT
/begin MEASUREMENT n_min_em_has_sbe_has_byp "" SWORD n_int_S6_S3 1 100 -32768 32767 ECU_ADDRESS 0xFFF96F16 /end MEASUREMENT
/begin MEASUREMENT n_min_psys_em_has_ngbegr "Nicht gradientenbegrenzter, modifizierter Modifizierter Basiswert der minimalen EM Drehlzahl zur Sicherstellung Ölversorgung" FLOAT32_IEEE n_fl_S6_S3 1 100 0 10000 ECU_ADDRESS 0xFFF96484 /end MEASUREMENT
/begin MEASUREMENT n_min_psys_em_has_sbe "Minimale EM Drehzahl zur Sicherstellung Ölversorgung" FLOAT32_IEEE n_fl_S6_S3 1 100 -32767 32767 ECU_ADDRESS 0xFFF85DA0 /end MEASUREMENT
/begin MEASUREMENT n_mot_llsoll_has_komp_portout "" UBYTE n_int_n_S6_S3 1 100 0 255 ECU_ADDRESS 0xFFF8621C /end MEASUREMENT
/begin MEASUREMENT n_mot_llsoll_has_portout "" UBYTE n_int_n_S6_S3 1 100 0 255 ECU_ADDRESS 0xFFF8621D /end MEASUREMENT
/begin MEASUREMENT n_mot_soll_iae_in "" FLOAT32_IEEE n_fl_S6_S3 1 100 -3.40282e+038 3.40282e+038 ECU_ADDRESS 0xFFF85E14 /end MEASUREMENT
/begin MEASUREMENT n_mot_soll_iae_portin "Soll-Anfahrdrehzahl der IAE" UWORD n_int_S6_S3 1 100 0 65535 ECU_ADDRESS 0xFFF86066 /end MEASUREMENT
/begin MEASUREMENT n_sec_iae "" FLOAT32_IEEE n_fl_S6_S3 1 100 -10000 10000 ECU_ADDRESS 0xFFF85DA4 /end MEASUREMENT
/begin MEASUREMENT n_sec_iae_mod "Sekundärdrehzahl IAE" FLOAT32_IEEE n_fl_S6_S3 1 100 -3.40282e+038 3.40282e+038 ECU_ADDRESS 0xFFF9648C /end MEASUREMENT
/begin MEASUREMENT n_soll_em_has_byp "" SWORD n_int_S6_S3 1 100 -32768 32767 ECU_ADDRESS 0xFFF96F18 /end MEASUREMENT
/begin MEASUREMENT n_soll_em_has_fkt "" FLOAT32_IEEE n_fl_S6_S3 1 100 0 8000 ECU_ADDRESS 0xFFF85D80 /end MEASUREMENT
/begin MEASUREMENT n_soll_em_has_komp_portout "" UWORD n_int_S6_S3 1 100 57535 65535 ECU_ADDRESS 0xFFF86086 /end MEASUREMENT
/begin MEASUREMENT n_soll_em_has_portout "" UWORD n_int_S6_S3 1 100 0 8000 ECU_ADDRESS 0xFFF86088 /end MEASUREMENT
/begin MEASUREMENT n_soll_em_hst_in "" FLOAT32_IEEE n_fl_S6_S3 1 100 -3.40282e+038 3.40282e+038 ECU_ADDRESS 0xFFF85E48 /end MEASUREMENT
/begin MEASUREMENT n_soll_em_hst_portin "" UWORD n_int_S6_S3 1 100 0 65535 ECU_ADDRESS 0xFFF860D6 /end MEASUREMENT
/begin MEASUREMENT n_soll_ll_vm_in "" FLOAT32_IEEE n_fl_S6_S3 1 100 0 2540 ECU_ADDRESS 0xFFF85E18 /end MEASUREMENT
/begin MEASUREMENT n_soll_ll_vm_portin "" UWORD n_int_S6_S3 1 100 0 65535 ECU_ADDRESS 0xFFF86068 /end MEASUREMENT
/begin MEASUREMENT n_soll_vm_has_byp "" SWORD n_int_S6_S3 1 100 -32768 32767 ECU_ADDRESS 0xFFF96F1A /end MEASUREMENT
/begin MEASUREMENT n_soll_vm_has_fkt "" FLOAT32_IEEE n_fl_S6_S3 1 100 0 8000 ECU_ADDRESS 0xFFF85D84 /end MEASUREMENT
/begin MEASUREMENT n_soll_vm_has_komp_portout "" UWORD n_int_S6_S3 1 100 57535 65535 ECU_ADDRESS 0xFFF8608A /end MEASUREMENT
/begin MEASUREMENT n_soll_vm_has_portout "" UWORD n_int_S6_S3 1 100 0 8000 ECU_ADDRESS 0xFFF8608C /end MEASUREMENT
/begin MEASUREMENT n_t_egs_in "" FLOAT32_IEEE n_fl_S6_S3 1 100 0 65535 ECU_ADDRESS 0xFFF85E1C /end MEASUREMENT
/begin MEASUREMENT n_t_egs_portin "" UWORD n_int_S6_S3 1 100 0 65535 ECU_ADDRESS 0xFFF8606A /end MEASUREMENT
/begin MEASUREMENT n_vm_in "" FLOAT32_IEEE n_fl_S6_S3 1 100 0 65535 ECU_ADDRESS 0xFFF85E20 /end MEASUREMENT
/begin MEASUREMENT n_vm_portin "" UWORD n_int_S6_S3 1 100 0 65535 ECU_ADDRESS 0xFFF8606C /end MEASUREMENT
/begin MEASUREMENT nd_iae "" FLOAT32_IEEE n_fl_S6_S3 1 100 -10000 10000 ECU_ADDRESS 0xFFF85DA8 /end MEASUREMENT
/begin MEASUREMENT nd_k0_in "" FLOAT32_IEEE n_fl_S6_S3 1 100 -10000 10000 ECU_ADDRESS 0xFFF85DAC /end MEASUREMENT
/begin MEASUREMENT nd_min_saf_has_byp "" UWORD n_int_S6_S3 1 100 0 65535 ECU_ADDRESS 0xFFF96F1C /end MEASUREMENT
/begin MEASUREMENT nd_min_saf_has_portout "" UWORD n_int_S6_S3 1 100 0 1000 ECU_ADDRESS 0xFFF8608E /end MEASUREMENT
/begin MEASUREMENT nd_soll_iae_fkt "Differenzdrehzahl der Anfahrkupplung" FLOAT32_IEEE ng_fl_S6_S3 1 100 -8000 8000 ECU_ADDRESS 0xFFF85D88 /end MEASUREMENT
/begin MEASUREMENT ndg_k0_in "" FLOAT32_IEEE ng_fl_S6_S3 1 100 -10000 10000 ECU_ADDRESS 0xFFF85DB0 /end MEASUREMENT
/begin MEASUREMENT ng_vm "" FLOAT32_IEEE ng_fl_S6_S3 1 100 -10000 10000 ECU_ADDRESS 0xFFF85DB4 /end MEASUREMENT
/begin MEASUREMENT osmode_next_in "" UBYTE void_int_S6_S3 1 100 1 3 ECU_ADDRESS 0xFFF86679 /end MEASUREMENT
/begin MEASUREMENT osmode_next_portin "" UBYTE void_int_S6_S3 1 100 0 255 ECU_ADDRESS 0xFFF861F1 /end MEASUREMENT
/begin MEASUREMENT p_bremse_fzg_in "" FLOAT32_IEEE p_fl_S6_S3 1 100 -32000 0 ECU_ADDRESS 0xFFF85E24 /end MEASUREMENT
/begin MEASUREMENT p_bremse_fzg_portin "" UWORD void_int_b_S6_S3 1 100 0 65535 ECU_ADDRESS 0xFFF8606E /end MEASUREMENT
/begin MEASUREMENT pc_ok_has_byp "" UBYTE void_int_S6_S3 1 100 0 255 ECU_ADDRESS 0xFFF96DF1 /end MEASUREMENT
/begin MEASUREMENT phi_neigung_in "Fahrzeug-Neigungswinkel" FLOAT32_IEEE void_fl_S6_S3 1 100 -3.40282e+038 3.40282e+038 ECU_ADDRESS 0xFFF85E28 /end MEASUREMENT
/begin MEASUREMENT phi_neigung_portin "" UBYTE void_int_S6_S3 1 100 0 255 ECU_ADDRESS 0xFFF861F2 /end MEASUREMENT
/begin MEASUREMENT pos_egs_in "Waehlhebelposition" UBYTE E_POS_S6_S3 1 100 0 8 ECU_ADDRESS 0xFFF8667A /end MEASUREMENT
/begin MEASUREMENT pos_egs_portin "Wählhebelposition" UBYTE E_POS_S6_S3 1 100 0 8 ECU_ADDRESS 0xFFF861F3 /end MEASUREMENT
/begin MEASUREMENT posv_timer_portin "Flag ob Timerbedingungen für PosV Diagnose erfüllt sind" UBYTE void_int_S6_S3 1 100 0 255 ECU_ADDRESS 0xFFF861F4 /end MEASUREMENT
/begin MEASUREMENT posvueb_aktiv_portin "Anforderung der  PosV Diagnose einer Drehzahlanhebung und der Deaktivierung der IEP " UBYTE void_int_S6_S3 1 100 0 255 ECU_ADDRESS 0xFFF861F5 /end MEASUREMENT
/begin MEASUREMENT sollgang_egs_in "" SBYTE void_int_S6_S3 1 100 -128 127 ECU_ADDRESS 0xFFF8667B /end MEASUREMENT
/begin MEASUREMENT sollgang_egs_portin "" SBYTE void_int_S6_S3 1 100 -128 127 ECU_ADDRESS 0xFFF861F6 /end MEASUREMENT
/begin MEASUREMENT st_OMLID_act_stg "Innere Zustände der OML" UWORD void_int_b_S6_S3 1 100 0 4999 ECU_ADDRESS 0xFFF860CA /end MEASUREMENT
/begin MEASUREMENT st_ablauf_fkt "Phase des Ablauf" UWORD void_int_b_S6_S3 1 100 0 65535 ECU_ADDRESS 0xFFF860CC /end MEASUREMENT
/begin MEASUREMENT st_ist_bz_has_byp "" UBYTE void_int_S6_S3 1 100 0 255 ECU_ADDRESS 0xFFF96DF2 /end MEASUREMENT
/begin MEASUREMENT st_ist_bz_has_portout "Ist-Betriebszustand der HAS" UBYTE void_int_S6_S3 1 100 0 255 ECU_ADDRESS 0xFFF8621E /end MEASUREMENT
/begin MEASUREMENT st_ist_bz_has_stg "Istzustand OML" UBYTE E_STBZHAS_S6_S3 1 100 0 15 ECU_ADDRESS 0xFFF86635 /end MEASUREMENT
/begin MEASUREMENT st_ist_bz_has_stg_azg "AZG-Signal für st_ist_bz_has_stg" UBYTE void_int_S6_S3 1 100 0 255 ECU_ADDRESS 0xFFF96D5B /end MEASUREMENT
/begin MEASUREMENT st_ist_bz_hst_in_azg "Istwert der Strategie fürs Handshake, nach Ersatzwert" UBYTE void_int_S6_S3 1 100 0 255 ECU_ADDRESS 0xFFF96D5C /end MEASUREMENT
/begin MEASUREMENT st_ist_bz_hst_mod_azg "Modifizierter Antriebsstrang Ist-Zustand" UBYTE void_int_S6_S3 1 100 0 255 ECU_ADDRESS 0xFFF96D5D /end MEASUREMENT
/begin MEASUREMENT st_ist_bz_hst_sta "Ist-Betriebszustand aus der Startegieanpassung als Eingangsgroesse der Hybridzustandssteuerung (OML)" UBYTE E_STBZHAS_S6_S3 1 100 0 15 ECU_ADDRESS 0xFFF86668 /end MEASUREMENT
/begin MEASUREMENT st_soll_bz_has_hst "interner HST Soll-Betriebszustand der Strategieanpassung (variantenunabhaengig)" UBYTE void_int_S6_S3 1 100 0 1 ECU_ADDRESS 0xFFF8669A /end MEASUREMENT
/begin MEASUREMENT st_soll_bz_hst_sta "Soll-Betriebszustand aus der Startegieanpassung als Eingangsgroesse der Hybridzustandssteuerung (OML)" UBYTE E_STBZHAS_S6_S3 1 100 0 15 ECU_ADDRESS 0xFFF86669 /end MEASUREMENT
/begin MEASUREMENT st_ziel_bz_has_byp "" UBYTE void_int_S6_S3 1 100 0 255 ECU_ADDRESS 0xFFF96DF3 /end MEASUREMENT
/begin MEASUREMENT st_ziel_bz_has_portout "Ziel-Betriebszustand der HAS" UBYTE void_int_S6_S3 1 100 0 255 ECU_ADDRESS 0xFFF8621F /end MEASUREMENT
/begin MEASUREMENT st_ziel_bz_has_stg "Zielzustand OML" UBYTE E_STBZHAS_S6_S3 1 100 0 15 ECU_ADDRESS 0xFFF86636 /end MEASUREMENT
/begin MEASUREMENT st_ziel_bz_has_stg_azg "AZG-Signal für st_ziel_bz_has_stg" UBYTE void_int_S6_S3 1 100 0 255 ECU_ADDRESS 0xFFF96D5F /end MEASUREMENT
/begin MEASUREMENT st_ziel_bz_hst_in_azg "Zielwert der Strategie fürs Handshake, nach Ersatzwert" UBYTE void_int_S6_S3 1 100 0 255 ECU_ADDRESS 0xFFF96D60 /end MEASUREMENT
/begin MEASUREMENT st_ziel_bz_hst_mod_azg "Modifizierter Antriebsstrang Ziel-Zustand" UBYTE void_int_S6_S3 1 100 0 255 ECU_ADDRESS 0xFFF96D61 /end MEASUREMENT
/begin MEASUREMENT status_ablauf_has_fkt "" UBYTE void_int_S6_S3 1 100 0 50 ECU_ADDRESS 0xFFF8663B /end MEASUREMENT
/begin MEASUREMENT status_ablauf_has_fkt_byp "" UBYTE void_int_S6_S3 1 100 0 255 ECU_ADDRESS 0xFFF96DF4 /end MEASUREMENT
/begin MEASUREMENT status_ablauf_has_portout "" UBYTE void_int_S6_S3 1 100 0 15 ECU_ADDRESS 0xFFF86220 /end MEASUREMENT
/begin MEASUREMENT status_ablaufaktiv_has_byp "" UBYTE void_int_S6_S3 1 100 0 255 ECU_ADDRESS 0xFFF96DF5 /end MEASUREMENT
/begin MEASUREMENT status_ablaufaktiv_has_portout "" UBYTE void_int_S6_S3 1 100 0 255 ECU_ADDRESS 0xFFF86221 /end MEASUREMENT
/begin MEASUREMENT status_alaengs_adaoff_in "Information, ob die Adaptionen aufgrund erkannter Laengsbeschleunigung deaktiviert wird. 0 = Adaption aktiv aufgrund erkannter Laengsbeschleunigung
1 = Adaption inaktiv aufgrund nicht erkannter Laengsbeschleunigung" UBYTE void_int_S6_S3 1 100 0 1 ECU_ADDRESS 0xFFF8667C /end MEASUREMENT
/begin MEASUREMENT status_alaengs_adaoff_portin "Information, ob die Adaptionen aufgrund erkannter Laengsbeschleunigung deaktiviert wird. 0 = Adaption aktiv aufgrund erkannter Laengsbeschleunigung
1 = Adaption inaktiv aufgrund nicht erkannter Laengsbeschleunigung" UBYTE void_int_S6_S3 1 100 0 1 ECU_ADDRESS 0xFFF861F7 /end MEASUREMENT
/begin MEASUREMENT status_betriebsber_hst_portin "Status Fahrbereitschaft (Hybridsystem)" UBYTE void_int_S6_S3 1 100 0 15 ECU_ADDRESS 0xFFF8666E /end MEASUREMENT
/begin MEASUREMENT status_betriebsbereit_hst_in "" UBYTE void_int_S6_S3 1 100 0 1 ECU_ADDRESS 0xFFF8669B /end MEASUREMENT
/begin MEASUREMENT status_ee_busy_portin "" UBYTE void_int_S6_S3 1 100 0 1 ECU_ADDRESS 0xFFF861F8 /end MEASUREMENT
/begin MEASUREMENT status_efahren_has_byp "" UBYTE void_int_S6_S3 1 100 0 255 ECU_ADDRESS 0xFFF96DF6 /end MEASUREMENT
/begin MEASUREMENT status_efahren_has_portout "" UBYTE void_int_S6_S3 1 100 0 1 ECU_ADDRESS 0xFFF86222 /end MEASUREMENT
/begin MEASUREMENT status_efahren_has_sbe "Status E-Fahren der HAS zur Festlegung der entsprechenden Portout-Größe in der HAS Signalaufbereitung_Out" UBYTE void_int_S6_S3 1 100 0 1 ECU_ADDRESS 0xFFF8665A /end MEASUREMENT
/begin MEASUREMENT status_fehler15_eh_diagin "Info vom Errorhandler ob Ersatzfkt. aktiv" UBYTE void_int_S6_S3 1 100 0 1 ECU_ADDRESS 0xFFF8662E /end MEASUREMENT
/begin MEASUREMENT status_fehler15_eh_in "Info vom Errorhandler ob Ersatzfkt. aktiv" UBYTE void_int_S6_S3 1 100 0 1 ECU_ADDRESS 0xFFF96D4E /end MEASUREMENT
/begin MEASUREMENT status_fehler_iep_in "" UBYTE E_FEHLERIEP_S6_S3 1 100 0 1 ECU_ADDRESS 0xFFF8667D /end MEASUREMENT
/begin MEASUREMENT status_fehler_iep_portin "" UBYTE E_FEHLERIEP_S6_S3 1 100 0 1 ECU_ADDRESS 0xFFF861F9 /end MEASUREMENT
/begin MEASUREMENT status_fehler_k0_portin "" UBYTE void_int_S6_S3 1 100 0 255 ECU_ADDRESS 0xFFF8666F /end MEASUREMENT
/begin MEASUREMENT status_iae_adap_in "Status der Adaption des Integrierten Anfahrelements IAE" UBYTE E_STATUSADA_S6_S3 1 100 0 2 ECU_ADDRESS 0xFFF8667E /end MEASUREMENT
/begin MEASUREMENT status_iae_adap_portin "Status der Adaption des Integrierten Anfahrelements IAE" UBYTE E_STATUSADA_S6_S3 1 100 0 2 ECU_ADDRESS 0xFFF861FA /end MEASUREMENT
/begin MEASUREMENT status_iae_in "" UBYTE E_STATUSIAE_S6_S3 1 100 0 8 ECU_ADDRESS 0xFFF8667F /end MEASUREMENT
/begin MEASUREMENT status_iae_portin "" UBYTE E_STATUSIAE_S6_S3 1 100 0 8 ECU_ADDRESS 0xFFF861FB /end MEASUREMENT
/begin MEASUREMENT status_iep_in "" UBYTE E_STATUSIEP_S6_S3 1 100 0 4 ECU_ADDRESS 0xFFF86680 /end MEASUREMENT
/begin MEASUREMENT status_iep_portin "" UBYTE E_STATUSIEP_S6_S3 1 100 0 4 ECU_ADDRESS 0xFFF861FC /end MEASUREMENT
/begin MEASUREMENT status_k0_adap_in "" UBYTE E_STATUSADA_S6_S3 1 100 0 2 ECU_ADDRESS 0xFFF86681 /end MEASUREMENT
/begin MEASUREMENT status_k0_adap_portin "Status der Adaption der Trennkupplung K0" UBYTE E_STATUSADA_S6_S3 1 100 0 2 ECU_ADDRESS 0xFFF861FD /end MEASUREMENT
/begin MEASUREMENT status_k0_in "" UBYTE E_STATUSK0_S6_S3 1 100 0 5 ECU_ADDRESS 0xFFF86682 /end MEASUREMENT
/begin MEASUREMENT status_k0_portin "" UBYTE E_STATUSK0_S6_S3 1 100 0 5 ECU_ADDRESS 0xFFF861FE /end MEASUREMENT
/begin MEASUREMENT status_kl15_in "" UBYTE void_int_S6_S3 1 100 0 1 ECU_ADDRESS 0xFFF8669C /end MEASUREMENT
/begin MEASUREMENT status_kolbenpos_k0_in "" UBYTE void_int_S6_S3 1 100 0 255 ECU_ADDRESS 0xFFF86683 /end MEASUREMENT
/begin MEASUREMENT status_kolbenpos_k0_portin "" UWORD void_int_b_S6_S3 1 100 0 65535 ECU_ADDRESS 0xFFF86070 /end MEASUREMENT
/begin MEASUREMENT status_kraftfluss_egs_in "" UBYTE E_STATUSKSL_S6_S3 1 100 0 6 ECU_ADDRESS 0xFFF86684 /end MEASUREMENT
/begin MEASUREMENT status_kraftfluss_egs_roh_in "" UBYTE void_int_S6_S3 1 100 0 255 ECU_ADDRESS 0xFFF86685 /end MEASUREMENT
/begin MEASUREMENT status_kraftschl_atsys_portin "" UBYTE E_STATUSKSL_S6_S3 1 100 0 6 ECU_ADDRESS 0xFFF861FF /end MEASUREMENT
/begin MEASUREMENT status_ll_vm_in "" UBYTE void_int_S6_S3 1 100 0 255 ECU_ADDRESS 0xFFF86686 /end MEASUREMENT
/begin MEASUREMENT status_modus_em_portin "" UBYTE void_int_S6_S3 1 100 0 255 ECU_ADDRESS 0xFFF86670 /end MEASUREMENT
/begin MEASUREMENT status_motorstandby_has_byp "" UBYTE void_int_S6_S3 1 100 0 255 ECU_ADDRESS 0xFFF96DF7 /end MEASUREMENT
/begin MEASUREMENT status_nem_in "Status zur Drehzahl E-Motor" UBYTE E_SIGSTATUS_S6_S3 1 100 0 2 ECU_ADDRESS 0xFFF86687 /end MEASUREMENT
/begin MEASUREMENT status_nem_portin "Status zur Drehzahl E-Motor" UBYTE E_SIGSTATUS_S6_S3 1 100 0 2 ECU_ADDRESS 0xFFF86200 /end MEASUREMENT
/begin MEASUREMENT status_nreg_em_hst_in "Status E-Motor Drehzahlregelung der HST" UBYTE void_int_S6_S3 1 100 0 255 ECU_ADDRESS 0xFFF8669D /end MEASUREMENT
/begin MEASUREMENT status_nreg_em_hst_portin "Status E-Motor Drehzahlregelung der HST" UBYTE void_int_S6_S3 1 100 0 255 ECU_ADDRESS 0xFFF86671 /end MEASUREMENT
/begin MEASUREMENT status_nvm_in "Status zur Drehzahl VM-Motor" UBYTE E_SIGSTATUS_S6_S3 1 100 0 2 ECU_ADDRESS 0xFFF86688 /end MEASUREMENT
/begin MEASUREMENT status_nvm_portin "Status zur Drehzahl VM-Motor" UBYTE E_SIGSTATUS_S6_S3 1 100 0 2 ECU_ADDRESS 0xFFF86201 /end MEASUREMENT
/begin MEASUREMENT status_phineigung_portin "Signalstatus für den Fahrzeug-Neigungswinkel" UBYTE void_int_S6_S3 1 100 0 1 ECU_ADDRESS 0xFFF86202 /end MEASUREMENT
/begin MEASUREMENT status_posvueb_in "Erkennung PosV Diagnose" UBYTE void_int_S6_S3 1 100 0 255 ECU_ADDRESS 0xFFF86689 /end MEASUREMENT
/begin MEASUREMENT status_psys_has_sbe "" UBYTE E_STATUSPSY_S6_S3 1 100 0 4 ECU_ADDRESS 0xFFF86654 /end MEASUREMENT
/begin MEASUREMENT status_sa_vm_in "00 Keine Beeinflussung; 01 Schubabschaltung aktiv; 10 Nicht stellbarer Bereich; 11 Signal ungültig" UBYTE void_int_S6_S3 1 100 0 3 ECU_ADDRESS 0xFFF8669E /end MEASUREMENT
/begin MEASUREMENT status_sa_vm_portin "00 Keine Beeinflussung; 01 Schubabschaltung aktiv; 10 Nicht stellbarer Bereich; 11 Signal ungültig" UBYTE void_int_S6_S3 1 100 0 3 ECU_ADDRESS 0xFFF86672 /end MEASUREMENT
/begin MEASUREMENT status_schaltart_svh_has_sbe "Schaltart der angeforderten Schaltung der Schaltverhinderung der HAS (0 = keine Schaltung angefordert) - Bit-Codierung (m/oL=mit/ohne Lanstanh.)=: bit0=ZRSmL,1=ZHSmL,2=SRSmL,3=SHSmL,4=ZRSoL,5=ZHSoL,6=SRSoL,7=SHSoL" UBYTE void_int_S6_S3 1 100 0 255 ECU_ADDRESS 0xFFF8665B /end MEASUREMENT
/begin MEASUREMENT status_schaltung_egs_in "" SBYTE void_int_S6_S3 1 100 -9 9 ECU_ADDRESS 0xFFF86655 /end MEASUREMENT
/begin MEASUREMENT status_sync_schaltung_sbe "Anzeige der Synchronerkennung der aktuellen Schaltung innerhalb der HAS" UBYTE void_int_S6_S3 1 100 0 1 ECU_ADDRESS 0xFFF86656 /end MEASUREMENT
/begin MEASUREMENT status_waschstr_in "" UBYTE void_int_S6_S3 1 100 0 255 ECU_ADDRESS 0xFFF8668A /end MEASUREMENT
/begin MEASUREMENT status_waschstr_portin "Zustand der N-Halte-Phase" UBYTE void_int_S6_S3 1 100 0 255 ECU_ADDRESS 0xFFF86203 /end MEASUREMENT
/begin MEASUREMENT status_zug_svh_sbe "Status für Anzeige Zug/Schub" UBYTE void_int_S6_S3 1 100 0 1 ECU_ADDRESS 0xFFF8665C /end MEASUREMENT
/begin MEASUREMENT t_betrieb_pvu_has_ee_in "" ULONG t_int_S6_S3 1 100 0 10000 ECU_ADDRESS 0xFFF85E2C /end MEASUREMENT
/begin MEASUREMENT t_betrieb_pvu_has_ee_portin "" ULONG t_int_S6_S3 1 100 0 42949672.95 ECU_ADDRESS 0xFFF85174 /end MEASUREMENT
/begin MEASUREMENT t_betrieb_pvu_has_portout "Timer fuer Diagnose Positionsventil" ULONG t_int_S6_S3 1 100 0 42949672.95 ECU_ADDRESS 0xFFF85200 /end MEASUREMENT
/begin MEASUREMENT t_betrieb_pvu_has_sbe "Betriebsdauer seit dem letzten Ablauf der Diagnosefunktion \"Positionsventil-Überwachung\" der Funktion zur Unterstüt-zung der Positionsventil-Überwachung der HAS" FLOAT32_IEEE t_fl_S6_S3 1 100 0 1000000 ECU_ADDRESS 0xFFF85DB8 /end MEASUREMENT
/begin MEASUREMENT t_k0_ndk0zugross_filt_auw_has "Timer zur Filterung des Fehlerereignisses, dass eine VM-Zwangsankopplung bei zu großer K0-Differenzdrehzahl keine Verbesserung erzielte" FLOAT32_IEEE t_fl_S6_S3 1 100 0 300 ECU_ADDRESS 0xFFF850E8 /end MEASUREMENT
/begin MEASUREMENT t_k0oeffnicht_has "HAS- Diagnose: Timer zur Überwachung (Anfilterung) VM-Drehzahl fällt nicht auf 0 1/min beim K0 öffnen." FLOAT32_IEEE t_fl_S6_S3 1 100 0 10 ECU_ADDRESS 0xFFF850EC /end MEASUREMENT
/begin MEASUREMENT t_k0schlnicht_erk_auw_has "Timer zur Erkennung, dass die K0 nicht schließt" FLOAT32_IEEE t_fl_S6_S3 1 100 0 300 ECU_ADDRESS 0xFFF850F0 /end MEASUREMENT
/begin MEASUREMENT t_k0schlnicht_filt_auw_has "Timer zur Filterung des Fehlerereignisses, dass die K0 nicht schließt" FLOAT32_IEEE t_fl_S6_S3 1 100 0 300 ECU_ADDRESS 0xFFF850F4 /end MEASUREMENT
/begin MEASUREMENT t_k0schlnicht_has "HAS-Diagnose: Timer zur Überwachung der maximalen Dauer der K0-Ansteuerung in Drickstellung schließen der K0 im Schleppstart." FLOAT32_IEEE t_fl_S6_S3 1 100 0 10 ECU_ADDRESS 0xFFF850F8 /end MEASUREMENT
/begin MEASUREMENT t_k0schlnichtpb_has "HAS-Diagnose: Timer zur Anfilterung der Prüfbedingung der K0-Ansteuerung in Druckstellung beim Schließen der K0 im Schleppstart." FLOAT32_IEEE t_fl_S6_S3 1 100 0 10 ECU_ADDRESS 0xFFF850FC /end MEASUREMENT
/begin MEASUREMENT t_ndk0zugross_filt_auw_has "Timer zur Filterung des Fehlerereignisses, dass die K0- Differenzdrehzahl zu groß ist" FLOAT32_IEEE t_fl_S6_S3 1 100 0 300 ECU_ADDRESS 0xFFF85100 /end MEASUREMENT
/begin MEASUREMENT t_nemzuklein_filt_auw_has "Timer zur Filterung des Fehlererignisses, dass die EM-Drehzahl zu gering ist" FLOAT32_IEEE t_fl_S6_S3 1 100 0 300 ECU_ADDRESS 0xFFF85104 /end MEASUREMENT
/begin MEASUREMENT t_oelversfehler_filt_has "Timer zur Filterung des Fehlerereignisses, dass ein Ölversorgungsfehler vorlag." FLOAT32_IEEE t_fl_S6_S3 1 100 0 1 ECU_ADDRESS 0xFFF85108 /end MEASUREMENT
/begin MEASUREMENT t_oelversfehlerkalt_filt_has "Timer zur Filterung des Fehlerereignisses, dass ein Ölversorgungsfehler vorlag." FLOAT32_IEEE t_fl_S6_S3 1 100 0 1 ECU_ADDRESS 0xFFF8510C /end MEASUREMENT
/begin MEASUREMENT t_vmaus_filt_auw_has "Timer zur Filterung des Fehlerereignisses, dass der VM aus ist" FLOAT32_IEEE t_fl_S6_S3 1 100 0 300 ECU_ADDRESS 0xFFF85110 /end MEASUREMENT
/begin MEASUREMENT timer_pumpready_aktiv_fkt "" UBYTE t_int_d_S6_S3 1 100 0 1 ECU_ADDRESS 0xFFF8663C /end MEASUREMENT
/begin MEASUREMENT v_f_sbe "Fahrzeuggeschwindigkeit auf Basis der Getriebeabtriebsdrehzahl in der  Hybridablaufsteuerung" FLOAT32_IEEE v_fl_S6_S3 1 100 -3.40282e+038 3.40282e+038 ECU_ADDRESS 0xFFF85DBC /end MEASUREMENT
/begin MEASUREMENT vg_f_sbe "Fahrzeuggeschwindigkeitsgradient auf Basis der Getriebeabtriebsdrehzahl in der  Hybridablaufsteuerung" FLOAT32_IEEE vg_fl_S6_S3 1 100 -3.40282e+038 3.40282e+038 ECU_ADDRESS 0xFFF85DC0 /end MEASUREMENT
/begin MEASUREMENT z_ablauf_has_hst_in "" UBYTE void_int_S6_S3 1 100 0 15 ECU_ADDRESS 0xFFF8668B /end MEASUREMENT
/begin MEASUREMENT z_ablauf_has_hst_portin "" UBYTE void_int_S6_S3 1 100 0 255 ECU_ADDRESS 0xFFF86204 /end MEASUREMENT
/begin MEASUREMENT z_ablauf_has_stg "Zusaetzliche Steuergroesse zur Ablaufsteuerung" UBYTE void_int_S6_S3 1 100 0 15 ECU_ADDRESS 0xFFF86637 /end MEASUREMENT
/begin MEASUREMENT z_ablauf_svh_reset_has_fkt "" UBYTE void_int_S6_S3 1 100 0 255 ECU_ADDRESS 0xFFF8663D /end MEASUREMENT
/begin MEASUREMENT z_ablaufreinit_frk_dihi "Zeigt an, dass der aktuelle HAS-Ablauf erneut begonnen werden soll" UBYTE void_int_S6_S3 1 100 0 1 ECU_ADDRESS 0xFFF8662F /end MEASUREMENT
/begin MEASUREMENT z_ablaufvariante_has_hst_in "" UBYTE void_int_S6_S3 1 100 0 15 ECU_ADDRESS 0xFFF8668C /end MEASUREMENT
/begin MEASUREMENT z_ablaufvariante_has_hst_portin "" UBYTE void_int_S6_S3 1 100 0 255 ECU_ADDRESS 0xFFF86205 /end MEASUREMENT
/begin MEASUREMENT z_ablaufvariante_has_stg "Ablaufvariante, die  die OML ausgibt" UBYTE void_int_S6_S3 1 100 0 99 ECU_ADDRESS 0xFFF86638 /end MEASUREMENT
/begin MEASUREMENT z_ablaufvariante_kalt_zus "Anzeige der aktiven Ablaufvariante Kaltstart beim Zustart - 0 = kein Kaltstart, 1 = Kaltstart mit abgesenkter EM-Drehzahl" UBYTE void_int_S6_S3 1 100 0 255 ECU_ADDRESS 0xFFF8663E /end MEASUREMENT
/begin MEASUREMENT z_ba__st_drv_veh_portin "" UBYTE void_int_S6_S3 1 100 0 15 ECU_ADDRESS 0xFFF86673 /end MEASUREMENT
/begin MEASUREMENT z_ba_has_k0_hst_in "" UBYTE void_int_S6_S3 1 100 0 1 ECU_ADDRESS 0xFFF8669F /end MEASUREMENT
/begin MEASUREMENT z_ba_has_k0_hst_portin "Anforderung K0 Betriebsart der HAS durch die HST" UBYTE void_int_S6_S3 1 100 0 15 ECU_ADDRESS 0xFFF86674 /end MEASUREMENT
/begin MEASUREMENT z_ba_has_vm_hst_in "" UBYTE void_int_S6_S3 1 100 0 1 ECU_ADDRESS 0xFFF866A0 /end MEASUREMENT
/begin MEASUREMENT z_ba_has_vm_hst_portin "Anforderung VM Betriebsart der HAS durch die HST" UBYTE void_int_S6_S3 1 100 0 15 ECU_ADDRESS 0xFFF86675 /end MEASUREMENT
/begin MEASUREMENT z_captargetnvm_ehi_has "Zeigt an, ob die Ersatzmaßnahme KMN_CAPTARGETNVM aktiv ist" UBYTE void_int_S6_S3 1 100 0 1 ECU_ADDRESS 0xFFF96D4F /end MEASUREMENT
/begin MEASUREMENT z_diag_ersfkt_has_in "Funktionsschnittstelle zur Ermittlung ob irgendeine Ersatzmaßnahme in der Diagnoseverwaltung aktiv ist" ULONG b_int_S6_S3 1 100 0 4294967295 ECU_ADDRESS 0xFFF85E30 /end MEASUREMENT
/begin MEASUREMENT z_diag_ersfkt_has_portin "Funktionsschnittstelle zur Ermittlung ob irgendeine Ersatzmaßnahme in der Diagnoseverwaltung aktiv ist" ULONG b_int_S6_S3 1 100 0 4294967295 ECU_ADDRESS 0xFFF85178 /end MEASUREMENT
/begin MEASUREMENT z_diag_ersfkt_hi_has_in "Funktionsschnittstelle zur Ermittlung ob irgendeine Ersatzmaßnahme in der Diagnoseverwaltung aktiv ist" ULONG b_int_S6_S3 1 100 0 4294967295 ECU_ADDRESS 0xFFF85E34 /end MEASUREMENT
/begin MEASUREMENT z_diag_ersfkt_hi_has_portin "Funktionsschnittstelle zur Ermittlung ob irgendeine Ersatzmaßnahme in der Diagnoseverwaltung aktiv ist" ULONG b_int_S6_S3 1 100 0 4294967295 ECU_ADDRESS 0xFFF8517C /end MEASUREMENT
/begin MEASUREMENT z_diag_notgang_has_in "Notganginformation" UBYTE void_int_S6_S3 1 100 0 255 ECU_ADDRESS 0xFFF8668D /end MEASUREMENT
/begin MEASUREMENT z_diag_notgang_has_portin "Notganginformation" UBYTE void_int_S6_S3 1 100 0 255 ECU_ADDRESS 0xFFF86206 /end MEASUREMENT
/begin MEASUREMENT z_emaktiv_fuw_zus_fkt "Anzeige der EM Fehlfuntion der Funktionsüberwachung der EM beim Zustart" UBYTE void_int_S6_S3 1 100 0 1 ECU_ADDRESS 0xFFF8663F /end MEASUREMENT
/begin MEASUREMENT z_emaktivfuwzus_diho "" UBYTE void_int_S6_S3 1 100 0 1 ECU_ADDRESS 0xFFF86186 /end MEASUREMENT
/begin MEASUREMENT z_emfehler_frk_dihi "Zeigt an, dass eine EM Fehlfunktion erkannt wurde, die in der HAS ausgewertet werden soll" UBYTE void_int_S6_S3 1 100 0 1 ECU_ADDRESS 0xFFF86630 /end MEASUREMENT
/begin MEASUREMENT z_fehler15_eh_fkt "" UBYTE void_int_S6_S3 1 100 0 1 ECU_ADDRESS 0xFFF86640 /end MEASUREMENT
/begin MEASUREMENT z_freigabe_pvu_has_portout "Freigabe für die Diagnose Positionsventil" UBYTE void_int_S6_S3 1 100 0 1 ECU_ADDRESS 0xFFF86223 /end MEASUREMENT
/begin MEASUREMENT z_freigabe_pvu_has_sbe "Freigabe zur Aktivierung der Diagnosefunktion \"Positionsventil-Überwachung\" der Funktion zur Unterstützung der Positi-onsventil-Überwachung der HAS" UBYTE void_int_S6_S3 1 100 0 1 ECU_ADDRESS 0xFFF86657 /end MEASUREMENT
/begin MEASUREMENT z_fuwdeakt_frk_dihi "Zeigt an, dass die FUW-Funktion nicht aktiviert werden darf" UBYTE void_int_S6_S3 1 100 0 1 ECU_ADDRESS 0xFFF86631 /end MEASUREMENT
/begin MEASUREMENT z_fuwkalt_aktiv_auw_has "Aktivierungsflag: Zeigt an, ob die Überwachung bei aktiver FUW oder bei Kaltstart aktiv ist." UBYTE void_int_S6_S3 1 100 0 1 ECU_ADDRESS 0xFFF86187 /end MEASUREMENT
/begin MEASUREMENT z_glsbe_has_byp "" UBYTE void_int_S6_S3 1 100 0 255 ECU_ADDRESS 0xFFF96DF8 /end MEASUREMENT
/begin MEASUREMENT z_glsbe_has_portout "" UBYTE void_int_S6_S3 1 100 0 1 ECU_ADDRESS 0xFFF86224 /end MEASUREMENT
/begin MEASUREMENT z_hascycreinit_ehi_has "Zeigt an, ob die Ersatzmaßnahme KMN_HASCYCREINIT aktiv ist" UBYTE void_int_S6_S3 1 100 0 1 ECU_ADDRESS 0xFFF86178 /end MEASUREMENT
/begin MEASUREMENT z_hasforcesync0_ehi_has "Zeigt an, ob die Ersatzmaßnahme KMN_HASFORCESYNC0 aktiv ist" UBYTE void_int_S6_S3 1 100 0 1 ECU_ADDRESS 0xFFF86179 /end MEASUREMENT
/begin MEASUREMENT z_hss1off_ehi_has "Zeigt an, ob die Ersmaßnahme KMN_CAPTARGETNVM aktiv ist" UBYTE void_int_S6_S3 1 100 0 1 ECU_ADDRESS 0xFFF8617A /end MEASUREMENT
/begin MEASUREMENT z_hybfkt_stg "Anforderung der Aktivierung einer Hybridfunktion durch die Hyrid-Zustandssteuerung" UBYTE E_HYBFKT_S6_S3 1 100 0 15 ECU_ADDRESS 0xFFF86639 /end MEASUREMENT
/begin MEASUREMENT z_iep_in "" UBYTE E_ZIEP_S6_S3 1 100 0 4 ECU_ADDRESS 0xFFF8668E /end MEASUREMENT
/begin MEASUREMENT z_iep_portin "" UBYTE E_ZIEP_S6_S3 1 100 0 4 ECU_ADDRESS 0xFFF86207 /end MEASUREMENT
/begin MEASUREMENT z_init_fkt "" UBYTE void_int_S6_S3 1 100 0 1 ECU_ADDRESS 0xFFF86641 /end MEASUREMENT
/begin MEASUREMENT z_init_sta "Anforderung der Initialisierung der Zustandssteuerung (OML) durch die Strategieanpassung" UBYTE void_int_S6_S3 1 100 0 15 ECU_ADDRESS 0xFFF8666A /end MEASUREMENT
/begin MEASUREMENT z_k0_befuellopt_has_byp "" UBYTE void_int_S6_S3 1 100 0 255 ECU_ADDRESS 0xFFF96DF9 /end MEASUREMENT
/begin MEASUREMENT z_k0_befuellopt_has_fkt "" UBYTE void_int_S6_S3 1 100 0 1 ECU_ADDRESS 0xFFF86642 /end MEASUREMENT
/begin MEASUREMENT z_k0_befuellopt_has_portout "" UBYTE void_int_S6_S3 1 100 0 2 ECU_ADDRESS 0xFFF86225 /end MEASUREMENT
/begin MEASUREMENT z_k0_fst_in "" UBYTE E_ZK0FSTIN_S6_S3 1 100 0 3 ECU_ADDRESS 0xFFF8668F /end MEASUREMENT
/begin MEASUREMENT z_k0_fst_portin "" UBYTE E_ZK0FSTIN_S6_S3 1 100 0 3 ECU_ADDRESS 0xFFF86208 /end MEASUREMENT
/begin MEASUREMENT z_k0_has_byp "" UBYTE void_int_S6_S3 1 100 0 255 ECU_ADDRESS 0xFFF96DFA /end MEASUREMENT
/begin MEASUREMENT z_k0_has_fkt "" UBYTE E_ZK0_S6_S3 1 100 0 5 ECU_ADDRESS 0xFFF86643 /end MEASUREMENT
/begin MEASUREMENT z_k0_has_portout "" UBYTE E_ZK0_S6_S3 1 100 0 5 ECU_ADDRESS 0xFFF86226 /end MEASUREMENT
/begin MEASUREMENT z_k0_has_sbe "" UBYTE E_ZK0_S6_S3 1 100 0 5 ECU_ADDRESS 0xFFF8665D /end MEASUREMENT
/begin MEASUREMENT z_k0_ndk0zugross_auw_diho "Fehlerflag: Zeigt an, ob das Fehlerereignis, dass die VM-Zwangsankopplung bei zu großer K0-Differenzdrehzahl nicht erfolgreich war, mindestens für die Filterzeit vorlag." UBYTE void_int_S6_S3 1 100 0 1 ECU_ADDRESS 0xFFF86188 /end MEASUREMENT
/begin MEASUREMENT z_k0_ndk0zugross_erk_auw_has "Fehlerereignisflag: Zeigt an, die VM-Zwangsankopplung bei zu großer K0-Differenzdrehzahl nicht erfolgreich ist" UBYTE void_int_S6_S3 1 100 0 1 ECU_ADDRESS 0xFFF86189 /end MEASUREMENT
/begin MEASUREMENT z_k0oeffnichtfehler_has "HAS-Diagnose: Fehlerflag zur Aktivierung der Diagnose  VM-Drehzahl fällt nicht auf 0 1/min beim K0 öffnen." UBYTE void_int_S6_S3 1 100 0 1 ECU_ADDRESS 0xFFF8618A /end MEASUREMENT
/begin MEASUREMENT z_k0oeffnichtinit_has "HAS-Diagnose: Flag zur Initialisierung der Diagnose  VM-Drehzahl fällt nicht auf 0 1/min beim K0 öffnen." UBYTE void_int_S6_S3 1 100 0 1 ECU_ADDRESS 0xFFF8618B /end MEASUREMENT
/begin MEASUREMENT z_k0oeffnichtpb_diho "HAS-Diagnose: Pruefbedingung zur Übergabe an den Errorhandler  VM-Drehzahl fällt nicht auf 0 1/min beim K0 öffnen." UBYTE void_int_S6_S3 1 100 0 1 ECU_ADDRESS 0xFFF8618C /end MEASUREMENT
/begin MEASUREMENT z_k0oeffnichtpb_has "HAS-Diagnose: Pruefbedingung Diagnose VM-Drehzahl fällt nicht auf 0 1/min beim K0 öffnen." UBYTE void_int_S6_S3 1 100 0 1 ECU_ADDRESS 0xFFF8618D /end MEASUREMENT
/begin MEASUREMENT z_k0schlnicht_erk_auw_has "Fehlerereignisflag: Zeigt an, ob erkannt wurde, dass die K0 nicht schliesst" UBYTE void_int_S6_S3 1 100 0 1 ECU_ADDRESS 0xFFF8618E /end MEASUREMENT
/begin MEASUREMENT z_k0schlnichtfehler_has "HAS-Diagnose: Fehlerflag zur Aktivierung der Diagnose K0-Ansteuerung in Druckstellung beim schließen der K0 im Schleppstart." UBYTE void_int_S6_S3 1 100 0 1 ECU_ADDRESS 0xFFF8618F /end MEASUREMENT
/begin MEASUREMENT z_k0schlnichtinit_has "HAS-Diagnose Flag zur Initialisierung der Pruefbedingung der K0-Ansteuerung in Druckstellung beim schließen der K0 im Schleppstart." UBYTE void_int_S6_S3 1 100 0 1 ECU_ADDRESS 0xFFF86190 /end MEASUREMENT
/begin MEASUREMENT z_k0schlnichtpb_diho "HAS-Diagnose: Pruefbedingung zur Übergabe an den Errorhandler zur Überwachung der maximalen Dauer der K0-Ansteuerung in Druckstellung beim schließen der K0 im Schleppstart." UBYTE void_int_S6_S3 1 100 0 1 ECU_ADDRESS 0xFFF86191 /end MEASUREMENT
/begin MEASUREMENT z_k0schlnichtpb_has "HAS-Diagnose: Flag zur Bestimmung der Pruefbedingung der K0-Ansteuerung in Druckstellung beim Schließen der K0 im Schleppstart." UBYTE void_int_S6_S3 1 100 0 1 ECU_ADDRESS 0xFFF86192 /end MEASUREMENT
/begin MEASUREMENT z_k0syncmk0erh_frk_dihi "Zeigt an, dass eine K0-Zwangsynchronisation mittels Erhöhung des K0-Moments erfolgen soll" UBYTE void_int_S6_S3 1 100 0 1 ECU_ADDRESS 0xFFF86632 /end MEASUREMENT
/begin MEASUREMENT z_kps_stada_in "Sollvorgabe für die Trennkupplung K0 durch die Stillstandsadaption" UBYTE void_int_S6_S3 1 100 0 255 ECU_ADDRESS 0xFFF86690 /end MEASUREMENT
/begin MEASUREMENT z_kps_stada_portin "Sollvorgabe für die Trennkupplung K0 durch die Stillstandsadaption" UBYTE void_int_S6_S3 1 100 0 255 ECU_ADDRESS 0xFFF86209 /end MEASUREMENT
/begin MEASUREMENT z_m_begr_em_has_fkt "" UBYTE void_int_S6_S3 1 100 0 50 ECU_ADDRESS 0xFFF86644 /end MEASUREMENT
/begin MEASUREMENT z_m_max_iae_has_byp "" UBYTE void_int_S6_S3 1 100 0 255 ECU_ADDRESS 0xFFF96DFB /end MEASUREMENT
/begin MEASUREMENT z_m_max_iae_has_fkt "" UBYTE void_int_S6_S3 1 100 0 50 ECU_ADDRESS 0xFFF86645 /end MEASUREMENT
/begin MEASUREMENT z_m_max_iae_has_portout "" UBYTE void_int_S6_S3 1 100 0 1 ECU_ADDRESS 0xFFF86227 /end MEASUREMENT
/begin MEASUREMENT z_m_soll_em_has_byp "" UBYTE void_int_S6_S3 1 100 0 255 ECU_ADDRESS 0xFFF96DFC /end MEASUREMENT
/begin MEASUREMENT z_m_soll_em_has_fkt "" UBYTE void_int_S6_S3 1 100 0 50 ECU_ADDRESS 0xFFF86646 /end MEASUREMENT
/begin MEASUREMENT z_m_soll_em_has_komp_portout "" UBYTE void_int_S6_S3 1 100 252 255 ECU_ADDRESS 0xFFF86228 /end MEASUREMENT
/begin MEASUREMENT z_m_soll_em_has_portout "" UBYTE void_int_S6_S3 1 100 0 3 ECU_ADDRESS 0xFFF86229 /end MEASUREMENT
/begin MEASUREMENT z_m_soll_vm_has_fkt "" UBYTE void_int_S6_S3 1 100 0 50 ECU_ADDRESS 0xFFF86647 /end MEASUREMENT
/begin MEASUREMENT z_modus_em_hst_in "" UBYTE void_int_S6_S3 1 100 0 255 ECU_ADDRESS 0xFFF86691 /end MEASUREMENT
/begin MEASUREMENT z_modus_iae_has_byp "" UBYTE void_int_S6_S3 1 100 0 255 ECU_ADDRESS 0xFFF96DFD /end MEASUREMENT
/begin MEASUREMENT z_modus_iae_has_fkt "" UBYTE E_ZMODUSIAE_S6_S3 1 100 0 2 ECU_ADDRESS 0xFFF86648 /end MEASUREMENT
/begin MEASUREMENT z_modus_iae_has_portout "" UBYTE E_ZMODUSIAE_S6_S3 1 100 0 2 ECU_ADDRESS 0xFFF8622A /end MEASUREMENT
/begin MEASUREMENT z_modus_iae_has_sbe "" UBYTE E_ZMODUSIAE_S6_S3 1 100 0 2 ECU_ADDRESS 0xFFF8665E /end MEASUREMENT
/begin MEASUREMENT z_modus_iep_has_byp "" UBYTE void_int_S6_S3 1 100 0 255 ECU_ADDRESS 0xFFF96DFE /end MEASUREMENT
/begin MEASUREMENT z_modus_iep_has_sbe "Vorgabe des Betriebsmodus der IEP durch die HAS" UBYTE E_ZMODUSIEP_S6_S3 1 100 0 4 ECU_ADDRESS 0xFFF8665F /end MEASUREMENT
/begin MEASUREMENT z_msa_avh_moni_has_sbe "Anforderung einer Schaltverhinderung der HAS" UBYTE void_int_S6_S3 1 100 0 255 ECU_ADDRESS 0xFFF86660 /end MEASUREMENT
/begin MEASUREMENT z_msa_eaf_moni_has_sbe "Anforderung einer Schaltverhinderung der HAS" UBYTE void_int_S6_S3 1 100 0 255 ECU_ADDRESS 0xFFF86661 /end MEASUREMENT
/begin MEASUREMENT z_msa_fst_in "Anforderung einer Abschaltverhinderung durch die Fahrstrategie ASIS" UBYTE void_int_S6_S3 1 100 0 255 ECU_ADDRESS 0xFFF86692 /end MEASUREMENT
/begin MEASUREMENT z_msa_fst_portin "Anforderung einer Abschaltverhinderung durch die Fahrstrategie ASIS" UBYTE void_int_S6_S3 1 100 0 255 ECU_ADDRESS 0xFFF8620A /end MEASUREMENT
/begin MEASUREMENT z_msa_has_byp "" UBYTE void_int_S6_S3 1 100 0 255 ECU_ADDRESS 0xFFF96DFF /end MEASUREMENT
/begin MEASUREMENT z_msa_has_portout "" UBYTE void_int_S6_S3 1 100 0 255 ECU_ADDRESS 0xFFF8622B /end MEASUREMENT
/begin MEASUREMENT z_msa_has_sbe "Anforderung der Beeinflussung der MSA-Funktionalität durch die Hybridablaufsteuerung - Codierung: bit0 = AVZ, bit1 = AVH, bit2 = EAF, bit3 = EVH, bit4 = Deaktivierung, bit7 = Störungsbedingt" UBYTE void_int_S6_S3 1 100 0 255 ECU_ADDRESS 0xFFF86662 /end MEASUREMENT
/begin MEASUREMENT z_msa_stada_in "" UBYTE void_int_S6_S3 1 100 0 6 ECU_ADDRESS 0xFFF866A1 /end MEASUREMENT
/begin MEASUREMENT z_n_min_em_parksp_has_in "Anforderung einer EM-Drehzahlanhebung beim Auslegen der Parksperre infolge unzureichender Ölversorgung" UBYTE void_int_S6_S3 1 100 0 1 ECU_ADDRESS 0xFFF86693 /end MEASUREMENT
/begin MEASUREMENT z_n_min_em_parksp_has_portin "Anforderung einer EM-Drehzahlanhebung beim Auslegen der Parksperre infolge unzureichender Ölversorgung" UBYTE void_int_S6_S3 1 100 0 1 ECU_ADDRESS 0xFFF8620B /end MEASUREMENT
/begin MEASUREMENT z_n_min_iep_in "Anforderung Ausgabe EM-Mindestdrehzahl zur Sicherstellung der Ölversorgung durch die IEP" UBYTE void_int_S6_S3 1 100 0 1 ECU_ADDRESS 0xFFF86694 /end MEASUREMENT
/begin MEASUREMENT z_n_min_iep_portin "Anforderung Ausgabe EM-Mindestdrehzahl zur Sicherstellung der Ölversorgung durch die IEP" UBYTE void_int_S6_S3 1 100 0 1 ECU_ADDRESS 0xFFF8620C /end MEASUREMENT
/begin MEASUREMENT z_n_soll_em_has_byp "" UBYTE void_int_S6_S3 1 100 0 255 ECU_ADDRESS 0xFFF96E00 /end MEASUREMENT
/begin MEASUREMENT z_n_soll_em_has_fkt "" UBYTE void_int_S6_S3 1 100 0 50 ECU_ADDRESS 0xFFF86649 /end MEASUREMENT
/begin MEASUREMENT z_n_soll_em_has_komp_portout "" UBYTE void_int_S6_S3 1 100 254 255 ECU_ADDRESS 0xFFF8622C /end MEASUREMENT
/begin MEASUREMENT z_n_soll_em_has_portout "" UBYTE void_int_S6_S3 1 100 0 1 ECU_ADDRESS 0xFFF8622D /end MEASUREMENT
/begin MEASUREMENT z_n_soll_vm_has_byp "" UBYTE void_int_S6_S3 1 100 0 255 ECU_ADDRESS 0xFFF96E01 /end MEASUREMENT
/begin MEASUREMENT z_n_soll_vm_has_fkt "" UBYTE void_int_S6_S3 1 100 0 50 ECU_ADDRESS 0xFFF8664A /end MEASUREMENT
/begin MEASUREMENT z_n_soll_vm_has_komp_portout "" UBYTE void_int_S6_S3 1 100 254 255 ECU_ADDRESS 0xFFF8622E /end MEASUREMENT
/begin MEASUREMENT z_n_soll_vm_has_portout "" UBYTE void_int_S6_S3 1 100 0 1 ECU_ADDRESS 0xFFF8622F /end MEASUREMENT
/begin MEASUREMENT z_ndk0_aktiv_auw_has "Aktivierungsflag: Zeigt an, ob die Überwachung der K0-Differenzdrehzahl aktiv ist" UBYTE void_int_S6_S3 1 100 0 1 ECU_ADDRESS 0xFFF86193 /end MEASUREMENT
/begin MEASUREMENT z_ndk0zugross_erk_auw_has "Fehlerereignisflag: Zeigt an, ob erkannt wurde, dass die K0-Differenzdrehzahl zu groß ist" UBYTE void_int_S6_S3 1 100 0 1 ECU_ADDRESS 0xFFF86194 /end MEASUREMENT
/begin MEASUREMENT z_nem_aktiv_auw_has "Aktivierungsflag: Zeigt an, ob die Überwachung der EM-Drehzahl aktiv ist" UBYTE void_int_S6_S3 1 100 0 1 ECU_ADDRESS 0xFFF86195 /end MEASUREMENT
/begin MEASUREMENT z_nemzuklein_erk_auw_has "Fehlerereignisflag: Zeigt an, ob erkannt wurde, dass die EM-Istdrehzahl zu gering ist" UBYTE void_int_S6_S3 1 100 0 1 ECU_ADDRESS 0xFFF86196 /end MEASUREMENT
/begin MEASUREMENT z_nllsoll_iae_in "Anforderung der IAE, dass eine definierte LL-Drehzahl durch den Motor eingestellt werden soll" UBYTE E_ZNLLSOLL_S6_S3 1 100 0 2 ECU_ADDRESS 0xFFF86695 /end MEASUREMENT
/begin MEASUREMENT z_nllsoll_iae_portin "Anforderung der IAE, dass eine definierte LL-Drehzahl durch den Motor eingestellt werden soll" UBYTE E_ZNLLSOLL_S6_S3 1 100 0 2 ECU_ADDRESS 0xFFF8620D /end MEASUREMENT
/begin MEASUREMENT z_nminemnull_frk_dihi "Zeigt an, dass die Ausgabe der minimalen EM Drehzahl der HAS unterdrückt werden soll." UBYTE void_int_S6_S3 1 100 0 1 ECU_ADDRESS 0xFFF86633 /end MEASUREMENT
/begin MEASUREMENT z_nvmsollbegr_frk_dihi "Zeigt an, dass die VM-Solldrehzahl auf die EM-Istdrehzahl be-grenzt werden soll" UBYTE void_int_S6_S3 1 100 0 1 ECU_ADDRESS 0xFFF86634 /end MEASUREMENT
/begin MEASUREMENT z_oelversfehler_erk_has "Fehlerereignisflag: Zeigt an, ob erkannt wurde, dass ein Ölversorgungsfehler vorliegt" UBYTE void_int_S6_S3 1 100 0 1 ECU_ADDRESS 0xFFF86197 /end MEASUREMENT
/begin MEASUREMENT z_oelversfehlerkalt_erk_has "Fehlerereignisflag: Zeigt an, ob erkannt wurde, dass ein Ölversorgungsfehler vorliegt" UBYTE void_int_S6_S3 1 100 0 1 ECU_ADDRESS 0xFFF86198 /end MEASUREMENT
/begin MEASUREMENT z_p_hys_k0_has_byp "" UBYTE void_int_S6_S3 1 100 0 255 ECU_ADDRESS 0xFFF96E02 /end MEASUREMENT
/begin MEASUREMENT z_p_hys_k0_has_fkt "Hysteresekompensation" UBYTE void_int_S6_S3 1 100 0 1 ECU_ADDRESS 0xFFF8664B /end MEASUREMENT
/begin MEASUREMENT z_p_hys_k0_has_portout "" UBYTE void_int_S6_S3 1 100 0 1 ECU_ADDRESS 0xFFF86230 /end MEASUREMENT
/begin MEASUREMENT z_ponr_fkt "point of no return" UBYTE void_int_S6_S3 1 100 0 1 ECU_ADDRESS 0xFFF8664C /end MEASUREMENT
/begin MEASUREMENT z_pvu_has_sbe "Beeinflussung des Hybridsystems zur Unterstützung der Positionsventil- Überwachung der HAS-Codierung: 0 = keine Beeinflussung, 1 = Beeinflussung Stufe 1, 2 = Beeinflussung Stufe 2" UBYTE void_int_S6_S3 1 100 0 2 ECU_ADDRESS 0xFFF86658 /end MEASUREMENT
/begin MEASUREMENT z_saf_has_byp "" UBYTE void_int_S6_S3 1 100 0 255 ECU_ADDRESS 0xFFF96E03 /end MEASUREMENT
/begin MEASUREMENT z_saf_has_fkt "Schaltanforderung 1...aktiv" UBYTE void_int_S6_S3 1 100 0 1 ECU_ADDRESS 0xFFF8664D /end MEASUREMENT
/begin MEASUREMENT z_saf_has_portout "Schaltanforderung HAS" UBYTE void_int_S6_S3 1 100 0 1 ECU_ADDRESS 0xFFF86231 /end MEASUREMENT
/begin MEASUREMENT z_sas_has_byp "" UBYTE void_int_S6_S3 1 100 0 255 ECU_ADDRESS 0xFFF96E04 /end MEASUREMENT
/begin MEASUREMENT z_sas_has_portout "" UBYTE void_int_S6_S3 1 100 0 1 ECU_ADDRESS 0xFFF86232 /end MEASUREMENT
/begin MEASUREMENT z_sas_has_sbe "Ändert im Wahrheitsfall die KupplungsBefüllreihenfolge" UBYTE void_int_S6_S3 1 100 0 1 ECU_ADDRESS 0xFFF86663 /end MEASUREMENT
/begin MEASUREMENT z_sbe_has_byp "" UBYTE void_int_S6_S3 1 100 0 255 ECU_ADDRESS 0xFFF96E05 /end MEASUREMENT
/begin MEASUREMENT z_sbe_has_fkt "Schaltbeeinflussung  1...aktiv" UBYTE void_int_S6_S3 1 100 0 1 ECU_ADDRESS 0xFFF8664E /end MEASUREMENT
/begin MEASUREMENT z_sbe_has_portout "" UBYTE void_int_S6_S3 1 100 0 1 ECU_ADDRESS 0xFFF86233 /end MEASUREMENT
/begin MEASUREMENT z_standby_em_has_fkt "" UBYTE void_int_S6_S3 1 100 0 1 ECU_ADDRESS 0xFFF8664F /end MEASUREMENT
/begin MEASUREMENT z_start_modus_has_byp "" UBYTE void_int_S6_S3 1 100 0 255 ECU_ADDRESS 0xFFF96E06 /end MEASUREMENT
/begin MEASUREMENT z_start_modus_has_portout "Flag für Anforderung Anlasserstart" UBYTE void_int_S6_S3 1 100 0 1 ECU_ADDRESS 0xFFF86234 /end MEASUREMENT
/begin MEASUREMENT z_start_modus_has_sbe "Anforderung eines Anlasserstarts" UBYTE void_int_S6_S3 1 100 0 255 ECU_ADDRESS 0xFFF86664 /end MEASUREMENT
/begin MEASUREMENT z_status_psys_mps_has_byp "" UBYTE void_int_S6_S3 1 100 0 255 ECU_ADDRESS 0xFFF96E07 /end MEASUREMENT
/begin MEASUREMENT z_status_psys_mps_portout "Anforderung Kupplungsbefüllung zu starten, obwohl lt. Modellierung kein Pumpendruck vorhanden ist" UBYTE void_int_S6_S3 1 100 0 1 ECU_ADDRESS 0xFFF86235 /end MEASUREMENT
/begin MEASUREMENT z_status_psys_mps_sbe "Flag, das eine Modifikation des Pumpendruckstatus anzeigt" UBYTE void_int_S6_S3 1 100 0 1 ECU_ADDRESS 0xFFF86659 /end MEASUREMENT
/begin MEASUREMENT z_svh_has_byp "" UBYTE void_int_S6_S3 1 100 0 255 ECU_ADDRESS 0xFFF96E08 /end MEASUREMENT
/begin MEASUREMENT z_svh_has_portout "Schaltanforderung HAS" UBYTE void_int_S6_S3 1 100 0 1 ECU_ADDRESS 0xFFF86236 /end MEASUREMENT
/begin MEASUREMENT z_svh_has_sbe "Anforderung einer Schaltverhinderung der HAS" UBYTE void_int_S6_S3 1 100 0 1 ECU_ADDRESS 0xFFF86665 /end MEASUREMENT
/begin MEASUREMENT z_t_k0oeffnicht_has "HAS-Diagnose: Timerflag zur Überwachung (Anfilterung) VM-Drehzahl fällt nicht auf 0 1/min beim K0 öffnen." UBYTE void_int_S6_S3 1 100 0 1 ECU_ADDRESS 0xFFF86199 /end MEASUREMENT
/begin MEASUREMENT z_t_k0schlnicht_has "HAS-Diagnose: Flag zur Überwachung der maximalen Dauer der K0-Ansteuerung in Druckstellung beim Schließen der K0 im Schleppstart." UBYTE void_int_S6_S3 1 100 0 1 ECU_ADDRESS 0xFFF8619A /end MEASUREMENT
/begin MEASUREMENT z_t_k0schlnichtpb_has "HAS-Diagnose: Timerflag zur Anfilterung der Prüfbedingung der K0-Ansteuerung in Druckstellung beim Schließen der K0 im Schleppstart." UBYTE void_int_S6_S3 1 100 0 1 ECU_ADDRESS 0xFFF8619B /end MEASUREMENT
/begin MEASUREMENT z_timer_pumpready_fkt "" UBYTE void_int_S6_S3 1 100 0 1 ECU_ADDRESS 0xFFF86650 /end MEASUREMENT
/begin MEASUREMENT z_tmin_fehler15_fkt "Status Timer für Verweilzeit in Fehler15" UBYTE void_int_S6_S3 1 100 0 255 ECU_ADDRESS 0xFFF86651 /end MEASUREMENT
/begin MEASUREMENT z_vmaus_aktiv_auw_has "Aktivierungsflag: Zeigt an, ob die Überwachung der VM-Drehzahl aktiv ist." UBYTE void_int_S6_S3 1 100 0 1 ECU_ADDRESS 0xFFF8619C /end MEASUREMENT
/begin MEASUREMENT z_vmaus_erk_auw_has "Fehlerereignisflag: Zeigt an, ob erkannt wurde, dass der VM aus ist." UBYTE void_int_S6_S3 1 100 0 1 ECU_ADDRESS 0xFFF8619D /end MEASUREMENT
/begin MEASUREMENT z_ziel_kraftfluss_egs_in "" UBYTE void_int_S6_S3 1 100 0 255 ECU_ADDRESS 0xFFF86696 /end MEASUREMENT
/begin MEASUREMENT z_zuendfreigabe_vm_fkt "" UBYTE void_int_S6_S3 1 100 0 1 ECU_ADDRESS 0xFFF86652 /end MEASUREMENT
/begin MEASUREMENT z_zuendfreigabe_vm_has_fkt "" UBYTE void_int_S6_S3 1 100 0 1 ECU_ADDRESS 0xFFF86653 /end MEASUREMENT
/begin MEASUREMENT zielgang_egs_in "" SBYTE void_int_S6_S3 1 100 -128 127 ECU_ADDRESS 0xFFF86697 /end MEASUREMENT
/begin MEASUREMENT zielgang_egs_portin "" SBYTE void_int_S6_S3 1 100 -128 127 ECU_ADDRESS 0xFFF8620E /end MEASUREMENT
/begin FUNCTION jUl2KupplKC_Fktn "Applikationesgroessen Instanz jUl2KupplKC"
 /begin DEF_CHARACTERISTIC KF_IEDSMINMMOTCGLOGIKUEB_C KF_IEDSMINOFFMMOTCGLOGIKUEB_C KF_MAXSTOERCGDELTAI_EDSLOGIK_C KL_IEDSMINOFFCG_BEF1_C KL_MAX_STOEROFFCG_BEF1_C /end DEF_CHARACTERISTIC
/end FUNCTION
/begin FUNCTION jUl2KupplKD_Fktn "Applikationesgroessen Instanz jUl2KupplKD"
 /begin DEF_CHARACTERISTIC KF_IEDSMINMMOTCGLOGIKUEB_D KF_IEDSMINOFFMMOTCGLOGIKUEB_D KF_MAXSTOERCGDELTAI_EDSLOGIK_D KL_IEDSMINOFFCG_BEF1_D KL_MAX_STOEROFFCG_BEF1_D /end DEF_CHARACTERISTIC
/end FUNCTION
/begin FUNCTION jUl2KupplKE_Fktn "Applikationesgroessen Instanz jUl2KupplKE"
 /begin DEF_CHARACTERISTIC KF_IEDSMINMMOTCGLOGIKUEB_E KF_IEDSMINOFFMMOTCGLOGIKUEB_E KF_MAXSTOERCGDELTAI_EDSLOGIK_E KL_IEDSMINOFFCG_BEF1_E KL_MAX_STOEROFFCG_BEF1_E /end DEF_CHARACTERISTIC
/end FUNCTION
/begin FUNCTION jUl2Nmotu_Fktn "Applikationesgroessen Instanz jUl2Nmotu"
 /begin DEF_CHARACTERISTIC F_NMOTUEB MAX_STOER_NMOTUEB N_MOTABREGEL_OFFSET N_NMOTABREGEL_VORGABE TAB_NMOTUEBDSCOFF /end DEF_CHARACTERISTIC
/end FUNCTION
/begin FUNCTION jUl2Posme_Fktn "Applikationesgroessen Instanz jUl2Posme"
 /begin DEF_CHARACTERISTIC KF_NGPOSMEUEB KL_MMOTUEBNEGME1 KL_MMOTUEBNEGME2 KL_MMOTUEBPOSME1 KL_MMOTUEBPOSME2 M_MERED_MIN M_MOTMAXNEGINT M_MOTMININT N_DIFFMAXINT N_FNGABMEUEB N_FNGTMEUEB N_MAXSTOERNEGMEAUS N_MAXSTOERNEGMEINT1 N_MAXSTOERPOSMEAUS N_MAXSTOERPOSMEGRADIENT N_MAXSTOERPOSMEINT1 N_MAXSTOERPOSMEINT2 N_OFFSET_ME SWI_FLAGOFFPOSME /end DEF_CHARACTERISTIC
/end FUNCTION
/begin FUNCTION K0S "Das Paket K0S (K-Null-S) enthält alle Klassen und Funktionalitäten, welche zur Ansteuerung der K0-Kupplung (Motor / E-Maschine) notwendig sind." /begin SUB_FUNCTION K0S_STEUERFUNKTIONEN K0S_SIGNALE K0S_SOLLWERT K0S_DIAGNOSE /end SUB_FUNCTION /end FUNCTION
/begin FUNCTION K0S_DIAGNOSE "In K0S_DIAGNOSE sind die Überwachungsfunktionen zur K0S enthalten, soweit sie durch dasÜberwachungspaket nicht abgedeckt werden."
 /begin IN_MEASUREMENT iK0sDiagnose.TimerK0IO.time iK0sDiagnose.TimerK0defekt.time iK0sDiagnose.cbelag_schutzfkt_k0 iK0sDiagnose.flag_verbotregeln_k0 iK0sDiagnose.k0_defekt iK0sDiagnose.k0_pruefok iK0sDiagnose.kalt_regeln_verbot iK0sDiagnose.schaltungdirekt_fkt iK0sDiagnose.warm_regeln_verbot iK0sDiagnose.z_diag_k0 iK0sMeUtf.TspK0Schutz.time iK0sMeUtf.m_schutz_k0 iK0sMeUtf.m_schutz_k0_speicher iK0sMeUtf.status_me_k0 iK0sMeUtf.status_me_k0_komp iK0sMeUtf.z_me_utf_k0 /end IN_MEASUREMENT
/end FUNCTION
/begin FUNCTION K0S_SIGNALE "In K0S_SIGNALE werden Signalaufbereitung für die Ansteuerfunktion durchgeführt"
 /begin IN_MEASUREMENT iK0sKorSignale.delay_m_em_max_dyn_sync_k0.write_index iK0sKorSignale.delay_m_em_min_dyn_sync_k0.write_index iK0sKorSignale.delay_m_emist_k0.write_index iK0sKorSignale.delay_m_motist_k0.write_index iK0sKorSignale.delay_m_vmist_k0.write_index iK0sKorSignale.delay_m_vmsollgemvor_k0.write_index iK0sKorSignale.delay_n_mot_k0.write_index iK0sKorSignale.delay_n_tneu_k0.write_index iK0sKorSignale.delay_n_vm_k0.write_index iK0sKorSignale.delay_nabneu_k0.write_index iK0sKorSignale.dk_pedal_k0_dt1.Pt1Si16.x iK0sKorSignale.dk_pedal_k0_dt1.xp iK0sKorSignale.dkg_pedal_k0 iK0sKorSignale.dt1_m_vmsollgemvor_k0.Pt1Si16.x iK0sKorSignale.dt1_m_vmsollgemvor_k0.xp iK0sKorSignale.dt1_ngab_k0.Pt1Si16.x iK0sKorSignale.dt1_ngab_k0.xp iK0sKorSignale.dt1_ngem_sync_k0.Pt1Si16.x iK0sKorSignale.dt1_ngem_sync_k0.xp iK0sKorSignale.idx_sp_sps iK0sKorSignale.idx_sp_sps_lf iK0sKorSignale.idx_sp_sps_schalt iK0sKorSignale.idx_zs_zug_k0 iK0sKorSignale.k0_soll_erw iK0sKorSignale.k0_soll_gepr iK0sKorSignale.m_diff_k0 iK0sKorSignale.m_em_max_dyn_offs_k0 iK0sKorSignale.m_em_max_dyn_sync_filter_k0.x iK0sKorSignale.m_em_max_dyn_sync_k0 iK0sKorSignale.m_em_min_dyn_offs_k0 iK0sKorSignale.m_em_min_dyn_sync_filter_k0.x iK0sKorSignale.m_em_min_dyn_sync_k0 iK0sKorSignale.m_emist_filter_k0.x iK0sKorSignale.m_emist_roh iK0sKorSignale.m_emist_roh_fl iK0sKorSignale.m_emist_sync_k0 iK0sKorSignale.m_emist_sync_k0_fl iK0sKorSignale.m_emsoll_roh iK0sKorSignale.m_motist_filter_k0.x iK0sKorSignale.m_motist_offs_k0 iK0sKorSignale.m_motist_sync_k0 iK0sKorSignale.m_vmist_filter_k0.x iK0sKorSignale.m_vmist_roh iK0sKorSignale.m_vmist_roh_fl iK0sKorSignale.m_vmist_sync_k0 iK0sKorSignale.m_vmist_sync_k0_fl iK0sKorSignale.m_vmsoll_filter_k0.x iK0sKorSignale.m_vmsoll_roh iK0sKorSignale.m_vmsoll_roh_fl iK0sKorSignale.m_vmsollgemvor_sync_k0 iK0sKorSignale.m_vmsollgemvor_sync_k0_fl iK0sKorSignale.n_ab_sync_k0 iK0sKorSignale.n_abneu_filter_k0.x iK0sKorSignale.n_em_sync_k0 iK0sKorSignale.n_em_sync_k0_fl iK0sKorSignale.n_mot_filter_k0.x iK0sKorSignale.n_mot_korr_k0 iK0sKorSignale.n_t_sync_k0 iK0sKorSignale.n_t_sync_k0_fl iK0sKorSignale.n_tneu_filter_k0.x iK0sKorSignale.n_vm_filter_k0.x iK0sKorSignale.n_vm_roh iK0sKorSignale.n_vm_sync_k0 iK0sKorSignale.n_vm_sync_k0_fl iK0sKorSignale.nd_k0 iK0sKorSignale.nd_k0_fl iK0sKorSignale.nd_zszug_filter_k0.x iK0sKorSignale.nd_zszug_k0 iK0sKorSignale.ng_ab_sync_k0 iK0sKorSignale.ng_em_sync_k0 iK0sKorSignale.ng_em_syncziel_k0 iK0sKorSignale.vorzeichen_zug_schub iK0sKorSignale.zs_zug_k0 iK0sKorSignale.zs_zug_merk_k0 iK0sParam.Pt1IGetriebeVirtK0Roh.x iK0sParam.i_getriebe_virt_k0 iK0sParam.i_getriebe_virt_k0_alt iK0sParam.i_getriebe_virt_k0_roh iK0sParam.i_getriebe_virt_k0_roh_filt iK0sParam.j_ersatz_k0 iK0sParam.j_pri_k0 iK0sParam.j_sec_k0 iK0sParam.mue_inv_k0 iK0sParam.mue_inv_richt_k0 iK0sParam.mue_k0 iK0sParam.mue_richt_k0 iK0sShLog.VzInitSchalt.time iK0sShLog.flag_me_haupt_aktiv_merk iK0sShLog.flag_me_haupt_aktiv_war_gesetzt iK0sShLog.flag_sync_verlassen_me_merk iK0sShLog.flanke_me_haupt iK0sShLog.i_getriebe iK0sShLog.i_istgang iK0sShLog.i_zielgang iK0sShLog.idx_schaltung_k0 iK0sShLog.idx_schaltung_k0_aktiv iK0sShLog.istgang_idx_k0 iK0sShLog.istgang_k0 iK0sShLog.pos_flanke_flag_sync_verl_me iK0sShLog.schaltung_k0 iK0sShLog.schaltung_k0_aktiv iK0sShLog.schaltung_k0_merk iK0sShLog.schaltung_k0_trigger iK0sShLog.z_shlog iK0sShLog.zielgang_k0 iK0sTempM.Pt1VpOelK0.x iK0sTempM.c_belag_k0 iK0sTempM.c_belag_k0_int iK0sTempM.c_oel_k0 iK0sTempM.c_torus_k0 iK0sTempM.n_pumpe_virt_k0 iK0sTempM.q_belag_ab iK0sTempM.q_belag_ab_korr iK0sTempM.q_k0_ab iK0sTempM.q_k0_gehaeuse_ab1 iK0sTempM.q_k0_gehaeuse_ab2 iK0sTempM.q_k0_lraum_ab iK0sTempM.q_k0_verlust iK0sTempM.q_k0_verlust_schlepp iK0sTempM.vp_oel_k0 iK0sTempM.vp_oel_k0_roh /end IN_MEASUREMENT
/end FUNCTION
/begin FUNCTION K0S_SOLLWERT "In K0S_SOLLWERT werden die Sollwerte zur Ansteuerfunktion generiert"
 /begin IN_MEASUREMENT iK0sKorSW.iSODyn.delta_dkpedal_k0 iK0sKorSW.iSODyn.dk_pedal0_k0 iK0sKorSW.iSODyn.fdyn_timer.time iK0sKorSW.iSODyn.wndo_fdyn_alt_k0 iK0sKorSW.iSODyn.wndo_fdyn_filter.x iK0sKorSW.iSODyn.wndo_fdyn_filter.xp iK0sKorSW.iSODyn.wndo_fdyn_k0 iK0sKorSW.iSODyn.wndo_fdyn_roh_begrenzt_k0 iK0sKorSW.iSODyn.wndo_fdyn_roh_k0 iK0sKorSW.iSODyn.z_fdyn_k0 iK0sKorSW.iSOShi.f_SchaltoffsetAktiv iK0sKorSW.iSOShi.n_sec_merk iK0sKorSW.iSOShi.ngt_delta iK0sKorSW.iSOShi.schaltung_aktiv_merk iK0sKorSW.iSOShi.t_schleif_k0 iK0sKorSW.iSOShi.wndo_schalt_k0 iK0sKorSW.iSOShi.wndo_schalt_k0_roh iK0sKorSW.iSOShi.wndo_schalt_pt1_filter.x iK0sKorSW.iSOShi.wndo_schalt_pt2_filter.x iK0sKorSW.iSOShi.wndo_schalt_pt2_filter.xp iK0sKorSW.iStdSW.ada_timer.time iK0sKorSW.iStdSW.einreg_timer.time iK0sKorSW.iStdSW.f_einreg iK0sKorSW.iStdSW.f_minit_rest_k0 iK0sKorSW.iStdSW.wnd_einreg_abs iK0sKorSW.iStdSW.wnd_einreg_abs_merk iK0sKorSW.iStdSW.wnd_init_filter.x iK0sKorSW.iStdSW.wnd_init_filter.xp iK0sKorSW.iStdSW.wnd_std_filter.x iK0sKorSW.iStdSW.wnd_std_filter.xp iK0sKorSW.iStdSW.wnd_std_k0 iK0sKorSW.iStdSW.wnd_std_roh_abs_k0 iK0sKorSW.iStdSW.wnd_std_roh_abs_k0_begrenzt iK0sKorSW.iStdSW.wnd_std_roh_k0_begrenzt iK0sKorSW.sollwert_aktiv iK0sKorSW.wn_mot iK0sKorSW.wnd_k0 iK0sKorSW.wnd_k0_fl iK0sKorSW.wnd_p_k0_fl /end IN_MEASUREMENT
/end FUNCTION
/begin FUNCTION K0S_STEUERFUNKTIONEN "In K0S_STEUERFUNKTIONEN sind die Ansteuerfunktionen der K0 enthalten"
 /begin IN_MEASUREMENT iK0sDruck.DruckFilter.x iK0sDruck.DruckFilterHys.x iK0sDruck.Dt1PkorrK0.Pt1Fl32.x iK0sDruck.Dt1PkorrK0.xp iK0sDruck.FilterPoTorus.x iK0sDruck.FilterPoTorusDyn.x iK0sDruck.FuellrampeK0.letzter_timer iK0sDruck.FuellrampeK0.letzter_wert iK0sDruck.LFOffsetFilter.x iK0sDruck.filter_wert_hilf iK0sDruck.help_p0 iK0sDruck.k0_ansteuern iK0sDruck.p0_ist_filter.x iK0sDruck.p0_ist_filter.xp iK0sDruck.p_hys_k0 iK0sDruck.p_hys_k0_hilf iK0sDruck.p_rampe_hys iK0sDruck.p_regler_k0 iK0sDruck.p_vorsteuer_k0 iK0sDruck.pg_hys_hilf iK0sDruck.po_gestzu_k0 iK0sDruck.po_ist_k0 iK0sDruck.po_msoll_k0 iK0sDruck.po_msoll_zu_k0 iK0sDruck.po_pgschliess_k0 iK0sDruck.po_reg_k0 iK0sDruck.po_soll_k0 iK0sDruck.po_soll_k0_fl32 iK0sDruck.po_soll_k0_roh_fl32 iK0sDruck.po_soll_roh_k0 iK0sDruck.po_soll_stell_k0 iK0sDruck.po_torus_k0 iK0sDruck.po_torusdyn_k0 iK0sDruck.z_hys_k0 iK0sDruck.z_k0_hilf iK0sKorK0.flag_p_sys_k0 iK0sKorK0.flag_verbot_mschalt iK0sKorK0.k0_bef_hysterese iK0sKorK0.k0_ist iK0sKorK0.k0_ist_komp iK0sKorK0.z_k0 iK0sKorK0.z_k0_merk iK0sRegler.a_regramp iK0sRegler.cd iK0sRegler.ci iK0sRegler.ct iK0sRegler.f_kd_schalt_alt iK0sRegler.f_ki_schalt_alt iK0sRegler.f_kp_schalt_alt iK0sRegler.fkd iK0sRegler.fki iK0sRegler.fkp iK0sRegler.help_FKI iK0sRegler.kd iK0sRegler.ki iK0sRegler.kp iK0sRegler.m_regler_k0 iK0sRegler.m_regler_k0_d iK0sRegler.m_regler_k0_d_int iK0sRegler.m_regler_k0_i iK0sRegler.m_regler_k0_i_int iK0sRegler.m_regler_k0_int iK0sRegler.m_regler_k0_p iK0sRegler.m_regler_k0_p_int iK0sRegler.m_soll_max_k0 iK0sRegler.m_soll_min_k0 iK0sSteuerung.Pt1ZuregelnK0.x iK0sSteuerung.TimerFuellzeit.time iK0sSteuerung.TimerOffenK0.maxtime iK0sSteuerung.TimerOffenK0.time iK0sSteuerung.TimerZuregelnmax.time iK0sSteuerung.flag_optimierte_befuellung iK0sSteuerung.flag_schliessrampe_ds iK0sSteuerung.flag_schliessrampe_ende iK0sSteuerung.flag_schliessrampe_start iK0sSteuerung.g_m_bestimmung iK0sSteuerung.iLBibPID.faktor_d iK0sSteuerung.iLBibPID.faktor_i iK0sSteuerung.iLBibPID.faktor_p iK0sSteuerung.iLBibPID.faktor_t1 iK0sSteuerung.iLBibPID.regel_diff_alt iK0sSteuerung.iLBibPID.stell_max iK0sSteuerung.iLBibPID.stell_min iK0sSteuerung.iLBibPID.stellgr_alt iK0sSteuerung.iLBibPID.stellgr_d_alt iK0sSteuerung.iLBibPID.stellgr_i_alt iK0sSteuerung.iLBibPID.stellgr_i_modulo iK0sSteuerung.m_init_zu_k0 iK0sSteuerung.m_ist_k0 iK0sSteuerung.m_ist_k0_filter.x iK0sSteuerung.m_ist_k0_filter.xp iK0sSteuerung.m_ist_richt_k0 iK0sSteuerung.m_schlepp_k0 iK0sSteuerung.m_schlepp_k0_filter.x iK0sSteuerung.m_schlepp_k0_filter.xp iK0sSteuerung.m_schlepp_k0_roh iK0sSteuerung.m_soll_k0 iK0sSteuerung.m_soll_zu_k0 iK0sSteuerung.mg_k0_zu iK0sSteuerung.mo_k0zu iK0sSteuerung.mo_k0zu_has_merk iK0sSteuerung.mo_mgschliess_k0 iK0sSteuerung.timer_k0_offen iK0sVorst.DelayDme.write_index iK0sVorst.Pt1MInitEinregK0.x iK0sVorst.Pt1MInitSchaltK0.x iK0sVorst.Pt1MoLwK0.x iK0sVorst.Pt1MschaltK0.x iK0sVorst.Pt2MschaltabK0.x iK0sVorst.Pt2MschaltabK0.xp iK0sVorst.TimerTMSchaltK0.time iK0sVorst.TimerTMoLwK0.time iK0sVorst.f_korrmschalt_k0 iK0sVorst.faktor_m_init_einreg_k0 iK0sVorst.flag_m_schalt_aufgebaut iK0sVorst.init_sport_schalt iK0sVorst.m_hochsch_k0 iK0sVorst.m_init_einreg_k0_init iK0sVorst.m_init_rest_k0 iK0sVorst.m_korr_schalt_k0 iK0sVorst.m_mehrfachruecksch_k0 iK0sVorst.m_mot_vorsteuer_k0 iK0sVorst.m_ruecksch_k0 iK0sVorst.m_schalt_k0 iK0sVorst.m_schroh_k0 iK0sVorst.m_steuerung_k0 iK0sVorst.m_vor_init_k0 iK0sVorst.m_vorsteuer_k0 iK0sVorst.m_vorsteuer_k0_int iK0sVorst.mdiff_emminmax_emist_k0_merk iK0sVorst.me_vm_k0 iK0sVorst.mg_vmsollgemvor_sync_k0 iK0sVorst.mo_lastwechsel_k0 iK0sVorst.mpt_molw iK0sVorst.pt1_m_schalt_merk iK0sVorst.qs_status iK0sVorst.sign_m_init_rest iK0sVorst.z_mo_lastwechsel_k0 /end IN_MEASUREMENT
/end FUNCTION
/begin FUNCTION KAS "Das Paket KAS (Kupplungsansteuerung ausserhalb Schaltung) enthält alle Klassen und Funktionalitäten, welche einen regelnden Zugriff auf die Schaltkupplung benötigen." /begin SUB_FUNCTION KAS_KOORDINATOR KAS_BIBLIO IAE /end SUB_FUNCTION /end FUNCTION
/begin FUNCTION KAS_BIBLIO "Allgemeine Bibliothek für KAS"
 /begin IN_MEASUREMENT iKasEkopl.Pt1MoEntkoppl.x iKasEkopl.TimerSchlEkop.maxtime iKasEkopl.TimerSchlEkop.time iKasEkopl.TimerZEkopl.maxtime iKasEkopl.TimerZEkopl.time iKasEkopl.flag_mo_aktiv_entkoppl iKasEkopl.m_max_alter_has_entkopl iKasEkopl.m_max_has_entkoppeln iKasEkopl.m_mot_init iKasEkopl.m_regler_entkoppeln iKasEkopl.m_soll_entkoppeln_init iKasEkopl.m_vorsteuer_entkoppeln iKasEkopl.m_vorsteuer_entkoppeln_init iKasEkopl.mo_vorsteuer_entkoppeln iKasEkopl.mo_vorstschl_entkoppeln iKasEkopl.z_entkoppeln /end IN_MEASUREMENT
/end FUNCTION
/begin FUNCTION KAS_KOORDINATOR "IN KAS_KOORDINATOR sind die Koordinatorfunktionen zur Ansteuerung der Kupplung ausserhalb Schaltung enthalten"
 /begin IN_MEASUREMENT iKorGskup.f_gsk_schlupft iKorGskup.f_kraftschl_kup_fa iKorGskup.fehler_gsk_regeln_verboten iKorGskup.gsk_aktiv iKorGskup.gsk_funktion iKorGskup.gsk_zustand iKorGskup.kup_gsk iKorGskup.m_motmax_gsk iKorGskup.me_gsk_abs_diff iKorGskup.p_gsk iKorGskup.p_gsk_wirk /end IN_MEASUREMENT
/end FUNCTION
/begin FUNCTION MON "Das Paket MON enthält alle Klassen und Funktionalitäten, welche zur Beobachtung (keine Reaktionsgenerierung und damit keine Überwachung) des Getriebes notwendig sind."
 /begin IN_MEASUREMENT iMonMoSig.mon_mst_klasse iMonMoSig.mon_mst_status iMonMoSig.mon_mst_timer /end IN_MEASUREMENT
/end FUNCTION
/begin FUNCTION NVR "Das Paket NVR enthält alle Klassen und Funktionalitäten, welche zur Ansteuerung des Non Volatile Rams (EEprom) notwendig sind."
 /begin IN_MEASUREMENT AdaGlsDRS.KF1.BewSchaltCtr AdaGlsDRS.KF1.Speicher AdaGlsDRS.KF2.BewSchaltCtr AdaGlsDRS.KF2.Speicher AdaGlsEHS.KF1.BewSchaltCtr AdaGlsEHS.KF1.Speicher AdaGlsEHS.KF2.BewSchaltCtr AdaGlsEHS.KF2.Speicher AdaGlsERS.KF1.BewSchaltCtr AdaGlsERS.KF1.Speicher AdaGlsERS.KF2.BewSchaltCtr AdaGlsERS.KF2.Speicher AdaGlsNFRS.KF1.BewSchaltCtr AdaGlsNFRS.KF1.Speicher AdaGlsNFRS.KF2.BewSchaltCtr AdaGlsNFRS.KF2.Speicher AdaIae.Daten.BewCtr AdaIae.Daten.Speicher AdaIae.Iae.AnfahrCtr AdaIae.Kup.SchaltCtr AdaIaeuf.Daten.Speicher AdaIaeufRead.Daten.Speicher AdaK0.PF.PruefCtr AdaK0.PF.SchaltCtr AdaK0.PF.Speicher AdaK0.TSF.PruefCtr AdaK0.TSF.SchaltCtr AdaK0.TSF.Speicher AdaK0.Timer.Lock AdaK0.Timer.Maxlock AdaKup.AdaBE.GlsKf1 AdaKup.AdaBE.GlsKf2 AdaKup.PF.PruefCtr AdaKup.PF.SchaltCtr AdaKup.PF.Speicher AdaKup.TSF.PruefCtr AdaKup.TSF.SchaltCtr AdaKup.TSF.Speicher BPDaten.SchlafMV.ResetErkennungPosVUeb IAE.Std.CIaeAbstell Kanal.Test.EndeEE MvG.AnzSchleppstart.Ctr MvG.Betriebspunkt.Ctr MvG.GetrTemp.Ctr MvG.HisSpeicherLoesen.Ctr MvG.IaeBelastung.Ctr MvG.IaeTemp.Ctr MvG.IaeZustand.Ctr MvG.IepBetriebsstunden.Ctr MvG.K0BelagTemp.Ctr MvG.K0Belastung.Ctr MvG.K0Zustand.Ctr MvG.KflWechsel.Ctr MvG.KupTemp.Ctr MvG.MotorStartTemp.Ctr MvG.Schaltungen.Ctr NoIni.MOBEF.MESchlupfCounter NoIni.MvG.Version PulsAda.Daten.NPruefschleife PulsAda.Daten.NPruefzyklen PulsAda.Daten.NPulsgrenz PulsAda.Daten.Prueftyp PulsAda.Daten.Pulsid PulsAda.Daten.ZwSpPf PulsAda.Daten.ZwSpTsf Sonstige.BefModell.KolbenPos Sonstige.InfoSpeicher.Eintrag Sonstige.InfoSpeicher.Init Sonstige.InfoSpeicher.Zaehler Sonstige.Itf.AbstellTemperatur Sonstige.Itf.Dummy Sonstige.PosVUew.Zaehler Sonstige.Test.StartEE Ueberwachungen.Parksperrenmagnet.TmaxPmueb iNvrInSWP.ee_urstart_info_eeprom iNvrInSWP.f_externer_loesch_auftrag iNvrInSWP.n_aufruf_eeprom_default iNvrInSWP.n_aufruf_eeprom_update iNvrInSWP.n_aufruf_eeprom_valid iNvrInSWP.n_aufruf_statistics_update iNvrInSWP.n_aufruf_statistics_valid iNvrKoordinator.ee_anzeige_block_history iNvrKoordinator.ee_management_status iNvrKoordinator.ee_systemstart_ueber_reset /end IN_MEASUREMENT
/end FUNCTION
/begin FUNCTION RMN_TskMon "" /begin OUT_MEASUREMENT RMN_bTskErr /end OUT_MEASUREMENT /end FUNCTION
/begin FUNCTION RRT_TskMeas "" /begin DEF_CHARACTERISTIC RRT_swtRstMax_C /end DEF_CHARACTERISTIC /end FUNCTION
/begin FUNCTION Run_Action_FOp_ANK "" /begin SUB_FUNCTION SFOp_ANK2_FOp_ANK /end SUB_FUNCTION
 /begin LOC_MEASUREMENT abstellpos_vm_in abstellpos_vm_status_in c_getriebe_egs_in c_vm_in gangwechsel_egs_in i_istgang_egs i_zielgang_egs istgang_egs_in m_em_in m_iae_in m_k0_in m_k0_mber_has_sbe m_k0_mod_has_fkt m_max_dyn_em_in m_min_dyn_em_in m_min_vm_in m_mot_in m_motmax_has m_soll_em_has_fkt m_soll_em_hst_in m_soll_k0_has_fkt m_soll_res_em_bas_sbe m_soll_res_em_has_sbe m_soll_vm_has_fkt m_soll_vm_hst_in m_soll_vm_l_hst_in m_vm_in m_vm_start_in m_wunsch_fpw_hst_fil m_wunsch_fpw_hst_in m_wunsch_fpw_in mg_wunsch_fpw mg_wunsch_fpw_hst n_ab_egs_in n_em_in n_min_em_has_sbe n_min_psys_em_has_sbe n_mot_soll_iae_in n_sec_iae n_soll_em_has_fkt n_soll_em_hst_in n_soll_ll_vm_in n_soll_vm_has_fkt n_t_egs_in n_vm_in nd_iae nd_k0_in ndg_k0_in ng_vm osmode_next_in p_bremse_fzg_in phi_neigung_in pos_egs_in sollgang_egs_in st_OMLID_act_stg st_ablauf_fkt st_ist_bz_has_stg st_soll_bz_has_hst st_ziel_bz_has_stg status_ablauf_has_fkt status_alaengs_adaoff_in status_betriebsbereit_hst_in status_efahren_has_sbe status_fehler15_eh_diagin status_fehler_iep_in status_iae_adap_in status_iae_in status_iep_in status_k0_adap_in status_k0_in status_kl15_in status_kolbenpos_k0_in status_kraftfluss_egs_in status_kraftfluss_egs_roh_in status_ll_vm_in status_nem_in status_nreg_em_hst_in status_nvm_in status_posvueb_in status_psys_has_sbe status_sa_vm_in status_schaltart_svh_has_sbe status_schaltung_egs_in status_sync_schaltung_sbe status_waschstr_in status_zug_svh_sbe t_betrieb_pvu_has_ee_in t_betrieb_pvu_has_sbe v_f_sbe vg_f_sbe z_ablauf_has_hst_in z_ablauf_has_stg z_ablauf_svh_reset_has_fkt z_ablaufreinit_frk_dihi z_ablaufvariante_has_hst_in z_ablaufvariante_has_stg z_ba_has_k0_hst_in z_ba_has_vm_hst_in z_diag_ersfkt_has_in z_diag_ersfkt_hi_has_in z_diag_notgang_has_in z_emfehler_frk_dihi z_freigabe_pvu_has_sbe z_fuwdeakt_frk_dihi z_hybfkt_stg z_iep_in z_k0_fst_in z_k0_has_fkt z_k0_has_sbe z_k0syncmk0erh_frk_dihi z_kps_stada_in z_m_soll_em_has_fkt z_m_soll_vm_has_fkt z_modus_em_hst_in z_modus_iae_has_sbe z_modus_iep_has_sbe z_msa_avh_moni_has_sbe z_msa_eaf_moni_has_sbe z_msa_fst_in z_msa_has_sbe z_msa_stada_in z_n_min_em_parksp_has_in z_n_min_iep_in z_n_soll_em_has_fkt z_n_soll_vm_has_fkt z_nllsoll_iae_in z_nminemnull_frk_dihi z_nvmsollbegr_frk_dihi z_p_hys_k0_has_fkt z_pvu_has_sbe z_saf_has_fkt z_sas_has_sbe z_start_modus_has_sbe z_status_psys_mps_sbe z_svh_has_sbe z_ziel_kraftfluss_egs_in z_zuendfreigabe_vm_fkt zielgang_egs_in /end LOC_MEASUREMENT
/end FUNCTION
/begin FUNCTION Run_BSB_BypassSignalBerechnung ""
 /begin DEF_CHARACTERISTIC ANALYSE_HAS_BYP_VECTOR BYP_VNR_HAS_BYP_VECTOR HAS_AKTIV_HAS_BYP_VECTOR MG_SOLL_K0_NEG_HAS_BYP_VECTOR MG_SOLL_K0_POS_HAS_BYP_VECTOR MO_MOD_EM_HST_HAS_BYP_VECTOR M_K0_HAS_BYP_VECTOR M_K0_MBER_HAS_BYP_VECTOR M_MAX_EM_HAS_BYP_VECTOR M_MAX_IAE_HAS_BYP_VECTOR M_MIN_EM_HAS_BYP_VECTOR M_MOTMAX_HAS_BYP_VECTOR M_SOLL_EM_HAS_BYP_VECTOR M_SOLL_K0_HAS_BYP_VECTOR M_SOLL_RES_EM_HAS_BYP_VECTOR ND_MIN_SAF_HAS_BYP_VECTOR N_MIN_EM_HAS_SBE_HAS_BYP_VECTOR N_SOLL_EM_HAS_BYP_VECTOR N_SOLL_VM_HAS_BYP_VECTOR PC_OK_HAS_BYP_VECTOR STATUS_ABLAUFAKTIV_BYP_VECTOR STATUS_ABLAUF_HAS_BYP_VECTOR STATUS_EFAHREN_HAS_BYP_VECTOR STATUS_MOTORSTB_HAS_BYP_VECTOR STATUS_ZIEL_BZ_HAS_BYP_VECTOR ST_IST_BZ_HAS_BYP_VECTOR ST_ZIEL_BZ_HAS_BYP_VECTOR Z_GLSBE_HAS_BYP_VECTOR Z_K0_BEFUELLOPT_HAS_BYP_VECTOR Z_K0_HAS_BYP_VECTOR Z_MODUS_IAE_HAS_BYP_VECTOR Z_MODUS_IEP_HAS_BYP_VECTOR Z_MSA_HAS_BYP_VECTOR Z_M_MAX_IAE_HAS_BYP_VECTOR Z_M_SOLL_EM_HAS_BYP_VECTOR Z_N_SOLL_EM_HAS_BYP_VECTOR Z_N_SOLL_VM_HAS_BYP_VECTOR Z_P_HYS_K0_HAS_BYP_VECTOR Z_SAF_HAS_BYP_VECTOR Z_SAS_HAS_BYP_VECTOR Z_SBE_HAS_BYP_VECTOR Z_START_MODUS_HAS_BYP_VECTOR Z_STATUS_PSYS_MPS_HAS_BYP_VECTOR Z_SVH_HAS_BYP_VECTOR /end DEF_CHARACTERISTIC
 /begin LOC_MEASUREMENT analyse_has_byp byp_vnr_has_byp bypass_has_aktiv c_getriebe_egs_in gangwechsel_egs_in has_aktiv_has_byp istgang_egs_in m_em_in m_iae_in m_k0_has_byp m_k0_in m_k0_mber_has_byp m_max_dyn_em_in m_max_em_has_byp m_max_iae_has_byp m_min_dyn_em_in m_min_em_has_byp m_mot_in m_motmax_has_byp m_soll_em_has_byp m_soll_em_hst_in m_soll_k0_has_byp m_soll_res_em_has_byp m_soll_vm_hst_in m_vm_in m_vm_start_in m_wunsch_fpw_in mg_soll_k0_neg_has_byp mg_soll_k0_pos_has_byp mo_mod_em_hst_has_byp n_ab_egs_in n_em_in n_min_em_has_sbe_has_byp n_mot_soll_iae_in n_soll_em_has_byp n_soll_ll_vm_in n_soll_vm_has_byp n_t_egs_in n_vm_in nd_min_saf_has_byp osmode_next_in p_bremse_fzg_in pc_ok_has_byp phi_neigung_in pos_egs_in sollgang_egs_in st_ist_bz_has_byp st_ziel_bz_has_byp status_ablauf_has_fkt_byp status_ablaufaktiv_has_byp status_alaengs_adaoff_in status_efahren_has_byp status_fehler_iep_in status_iae_adap_in status_iae_in status_iep_in status_k0_adap_in status_k0_in status_kolbenpos_k0_in status_kraftfluss_egs_in status_kraftfluss_egs_roh_in status_ll_vm_in status_motorstandby_has_byp status_nem_in status_nvm_in status_posvueb_in status_waschstr_in t_betrieb_pvu_has_ee_in z_ablauf_has_hst_in z_ablaufvariante_has_hst_in z_diag_ersfkt_has_in z_diag_ersfkt_hi_has_in z_diag_notgang_has_in z_glsbe_has_byp z_iep_in z_k0_befuellopt_has_byp z_k0_fst_in z_k0_has_byp z_kps_stada_in z_m_max_iae_has_byp z_m_soll_em_has_byp z_modus_em_hst_in z_modus_iae_has_byp z_modus_iep_has_byp z_msa_fst_in z_msa_has_byp z_n_min_em_parksp_has_in z_n_min_iep_in z_n_soll_em_has_byp z_n_soll_vm_has_byp z_nllsoll_iae_in z_p_hys_k0_has_byp z_saf_has_byp z_sas_has_byp z_sbe_has_byp z_start_modus_has_byp z_status_psys_mps_has_byp z_svh_has_byp z_ziel_kraftfluss_egs_in zielgang_egs_in /end LOC_MEASUREMENT
/end FUNCTION
/begin FUNCTION Run_DIAGi_Diagnose_in "" /begin SUB_FUNCTION SDIAGi16_Bitwise_AND_ui32_1 SDIAGi15_Bitwise_AND_ui32_ /end SUB_FUNCTION
 /begin DEF_CHARACTERISTIC BM_ERSFKTHI_EMFEHLER_FRK_HAS BM_ERSFKT_EMFEHLER_FRK_HAS TAB_ZDIAGNOTGANGFUW_FRK_HAS TAB_ZDIAGNOTGANG_FRK_HAS /end DEF_CHARACTERISTIC
 /begin LOC_MEASUREMENT c_getriebe_egs_in gangwechsel_egs_in istgang_egs_in m_em_in m_iae_in m_k0_in m_max_dyn_em_in m_min_dyn_em_in m_mot_in m_soll_em_hst_in m_soll_vm_hst_in m_vm_in m_vm_start_in m_wunsch_fpw_in n_ab_egs_in n_em_in n_mot_soll_iae_in n_soll_ll_vm_in n_t_egs_in n_vm_in osmode_next_in p_bremse_fzg_in phi_neigung_in pos_egs_in sollgang_egs_in status_alaengs_adaoff_in status_fehler15_eh_diagin status_fehler15_eh_in status_fehler_iep_in status_iae_adap_in status_iae_in status_iep_in status_k0_adap_in status_k0_in status_kolbenpos_k0_in status_kraftfluss_egs_in status_kraftfluss_egs_roh_in status_ll_vm_in status_nem_in status_nvm_in status_posvueb_in status_waschstr_in t_betrieb_pvu_has_ee_in z_ablauf_has_hst_in z_ablaufreinit_frk_dihi z_ablaufvariante_has_hst_in z_captargetnvm_ehi_has z_diag_ersfkt_has_in z_diag_ersfkt_hi_has_in z_diag_notgang_has_in z_emfehler_frk_dihi z_fuwdeakt_frk_dihi z_hascycreinit_ehi_has z_hasforcesync0_ehi_has z_hss1off_ehi_has z_iep_in z_k0_fst_in z_k0syncmk0erh_frk_dihi z_kps_stada_in z_modus_em_hst_in z_msa_fst_in z_n_min_em_parksp_has_in z_n_min_iep_in z_nllsoll_iae_in z_nminemnull_frk_dihi z_nvmsollbegr_frk_dihi z_ziel_kraftfluss_egs_in zielgang_egs_in /end LOC_MEASUREMENT
/end FUNCTION
/begin FUNCTION Run_DIAGo_Diagnose_out ""
 /begin SUB_FUNCTION Run_SDIAGo73_cTimer_trigger_1 Run_SDIAGo72_cTimer_trigger_ SDIAGo71_Fehle__t_vor_Kaltstart SDIAGo70_Fehler_liegt_nicht_vor Run_SDIAGo64_cTimer_triggerpb_ Run_SDIAGo63_cTimer_trigger_ Run_SDIAGo54_cTimer_trigger_ SDIAGo53_Subsystem1 SDIAGo52_Subsystem SDIAGo35_Zustart SDIAGo34_Ankoppeln_VM Run_SDIAGo23_c__us_filt_auw_has Run_SDIAGo22_c__in_filt_auw_has Run_SDIAGo21_c__ss_filt_auw_has Run_SDIAGo20_c__ht_filt_auw_has Run_SDIAGo19_c__ss_filt_auw_has Run_SDIAGo16_c__ichterk_auw_has /end SUB_FUNCTION
 /begin DEF_CHARACTERISTIC KL_MK0SCHLNICHTMVM_DIHO_X KL_MK0SCHLNICHTMVM_DIHO_Y MS_K0NDSK0ZUGROSS_ERK_AUW_HAS MS_K0OEFFNICHT_DIHO MS_K0SCHLNICHTPB_DIHO MS_VMK0OEFFNICHT_DIHO NDS_K0K0OEFFNICHT_DIHO NDS_K0ZUGROSS_ERK_AUW_HAS NGS_VMK0OEFFNICHT_DIHO NO_EMK0OEFFNICHT_DIHO NS_EMK0SCHLNICHT_DIHO NS_EMZUKLEIN_ERK_AUW_HAS NS_VMAUS_ERK_AUW_HAS NS_VMK0OEFFNICHT_DIHO NS_VMK0SCHLNICHT_DIHO SWI_PDEAK_OELVERSFEHLER_ERK_HAS SWI_ZEMAKTIVFUWZUS_DIHO SWI_Z_K0OEFFNICHTPB_ERSATZ_HAS SWI_Z_K0OEFFNICHT_ERSATZ_HAS SWI_Z_K0SCHLNICHTPB_ERSATZ_HAS SWI_Z_K0SCHLNICHT_ERSATZ_HAS T_K0SCHLNICHTPB_DIHO T_VK0NDK0ZUGROSS_FILT_AUW_HAS T_VK0OEFFNICHT_ERK_DIHO T_VK0SCHLNICHT_ERK_AUW_HAS T_VK0SCHLNICHT_ERK_DIHO T_VK0SCHLNICHT_FILT_AUW_HAS T_VNDK0ZUGROSS_FILT_AUW_HAS T_VNEMZUKLEIN_FILT_AUW_HAS T_VOELVERSFEHLERKALT_FILT_HAS T_VOELVERSFEHLER_FILT_HAS T_VVMAUS_FILT_AUW_HAS Z_K0OEFFNICHTPB_ERSATZ_HAS Z_K0OEFFNICHT_ERSATZ_HAS Z_K0SCHLNICHTPB_ERSATZ_HAS Z_K0SCHLNICHT_ERSATZ_HAS /end DEF_CHARACTERISTIC
 /begin LOC_MEASUREMENT DD_SDIAGo2_CC_Diagout DD_SDIAGo2_CC_Diagout_a DD_SDIAGo2_CC_Diagout_b DD_SDIAGo2_CC_Diagout_c DD_SDIAGo2_CC_Diagout_d DD_SDIAGo2_CC_Diagout_e DD_SDIAGo2_CC_Diagout_f DD_SDIAGo2_CC_Diagout_g abstellpos_vm_in abstellpos_vm_status_in c_getriebe_egs_in c_vm_in gangwechsel_egs_in i_istgang_egs i_zielgang_egs istgang_egs_in m_em_in m_iae_in m_k0_fkt m_k0_in m_k0_mber_has_sbe m_k0_mod_has_fkt m_max_dyn_em_in m_max_em_has_fkt m_max_iae_has_fkt m_min_dyn_em_in m_min_em_has_fkt m_min_vm_in m_mot_in m_motmax_has m_soll_em_has_fkt m_soll_em_hst_in m_soll_k0_has_fkt m_soll_res_em_bas_sbe m_soll_res_em_has_fkt m_soll_res_em_has_sbe m_soll_vm_has_fkt m_soll_vm_hst_in m_soll_vm_l_has_fkt m_soll_vm_l_hst_in m_vm_in m_vm_start_in m_wunsch_fpw_hst_fil m_wunsch_fpw_hst_in m_wunsch_fpw_in mg_max_em_has_fkt mg_min_em_has_fkt mg_soll_K0_fkt mg_soll_k0_has_fkt mg_wunsch_fpw mg_wunsch_fpw_hst mod_K0_fkt n_ab_egs_in n_em_in n_min_em_has_sbe n_min_psys_em_has_sbe n_mot_soll_iae_in n_sec_iae n_soll_em_has_fkt n_soll_em_hst_in n_soll_ll_vm_in n_soll_vm_has_fkt n_t_egs_in n_vm_in nd_iae nd_k0_in nd_soll_iae_fkt ndg_k0_in ng_vm osmode_next_in p_bremse_fzg_in phi_neigung_in pos_egs_in sollgang_egs_in st_OMLID_act_stg st_ablauf_fkt st_ist_bz_has_stg st_soll_bz_has_hst st_ziel_bz_has_stg status_ablauf_has_fkt status_alaengs_adaoff_in status_betriebsbereit_hst_in status_efahren_has_sbe status_fehler15_eh_diagin status_fehler_iep_in status_iae_adap_in status_iae_in status_iep_in status_k0_adap_in status_k0_in status_kl15_in status_kolbenpos_k0_in status_kraftfluss_egs_in status_kraftfluss_egs_roh_in status_ll_vm_in status_nem_in status_nreg_em_hst_in status_nvm_in status_posvueb_in status_psys_has_sbe status_sa_vm_in status_schaltart_svh_has_sbe status_schaltung_egs_in status_sync_schaltung_sbe status_waschstr_in status_zug_svh_sbe t_betrieb_pvu_has_ee_in t_betrieb_pvu_has_sbe t_k0_ndk0zugross_filt_auw_has t_k0oeffnicht_has t_k0schlnicht_erk_auw_has t_k0schlnicht_filt_auw_has t_k0schlnicht_has t_k0schlnichtpb_has t_ndk0zugross_filt_auw_has t_nemzuklein_filt_auw_has t_oelversfehler_filt_has t_oelversfehlerkalt_filt_has t_vmaus_filt_auw_has timer_pumpready_aktiv_fkt v_f_sbe vg_f_sbe z_ablauf_has_hst_in z_ablauf_has_stg z_ablauf_svh_reset_has_fkt z_ablaufreinit_frk_dihi z_ablaufvariante_has_hst_in z_ablaufvariante_has_stg z_ablaufvariante_kalt_zus z_ba_has_k0_hst_in z_ba_has_vm_hst_in z_diag_ersfkt_has_in z_diag_ersfkt_hi_has_in z_diag_notgang_has_in z_emaktiv_fuw_zus_fkt z_emaktivfuwzus_diho z_emfehler_frk_dihi z_fehler15_eh_fkt z_freigabe_pvu_has_sbe z_fuwdeakt_frk_dihi z_fuwkalt_aktiv_auw_has z_hybfkt_stg z_iep_in z_init_fkt z_k0_befuellopt_has_fkt z_k0_fst_in z_k0_has_fkt z_k0_has_sbe z_k0_ndk0zugross_auw_diho z_k0_ndk0zugross_erk_auw_has z_k0oeffnichtfehler_has z_k0oeffnichtinit_has z_k0oeffnichtpb_diho z_k0oeffnichtpb_has z_k0schlnicht_erk_auw_has z_k0schlnichtfehler_has z_k0schlnichtinit_has z_k0schlnichtpb_diho z_k0schlnichtpb_has z_k0syncmk0erh_frk_dihi z_kps_stada_in z_m_begr_em_has_fkt z_m_max_iae_has_fkt z_m_soll_em_has_fkt z_m_soll_vm_has_fkt z_modus_em_hst_in z_modus_iae_has_fkt z_modus_iae_has_sbe z_modus_iep_has_sbe z_msa_avh_moni_has_sbe z_msa_eaf_moni_has_sbe z_msa_fst_in z_msa_has_sbe z_msa_stada_in z_n_min_em_parksp_has_in z_n_min_iep_in z_n_soll_em_has_fkt z_n_soll_vm_has_fkt z_ndk0_aktiv_auw_has z_ndk0zugross_erk_auw_has z_nem_aktiv_auw_has z_nemzuklein_erk_auw_has z_nllsoll_iae_in z_nminemnull_frk_dihi z_nvmsollbegr_frk_dihi z_oelversfehler_erk_has z_oelversfehlerkalt_erk_has z_p_hys_k0_has_fkt z_ponr_fkt z_pvu_has_sbe z_saf_has_fkt z_sas_has_sbe z_sbe_has_fkt z_standby_em_has_fkt z_start_modus_has_sbe z_status_psys_mps_sbe z_svh_has_sbe z_t_k0oeffnicht_has z_t_k0schlnicht_has z_t_k0schlnichtpb_has z_timer_pumpready_fkt z_tmin_fehler15_fkt z_vmaus_aktiv_auw_has z_vmaus_erk_auw_has z_ziel_kraftfluss_egs_in z_zuendfreigabe_vm_fkt z_zuendfreigabe_vm_has_fkt zielgang_egs_in /end LOC_MEASUREMENT
/end FUNCTION
/begin FUNCTION Run_FHC_HybridControl ""
 /begin SUB_FUNCTION SFHC56_Zustandsautomat_Emul_HS SFHC52_Optiona__ufruf_Erkennung SFHC5_Abbruchsteuerung /end SUB_FUNCTION
 /begin DEF_CHARACTERISTIC STATUS_ABL_ABBRUCH_FERTIG SWI_ABSTSTATTABK_OML_HAS SWI_AKTPASSIVABB_OML SWI_ZUSSTATTANK_OML_HAS /end DEF_CHARACTERISTIC
 /begin LOC_MEASUREMENT abstellpos_vm_in abstellpos_vm_status_in bErrorHybrid bExceptionHybrid bReInitNormalMode_azg c_getriebe_egs_in c_vm_in ctrlAbortOp_req_azg gangwechsel_egs_in i_istgang_egs i_zielgang_egs istgang_egs_in m_em_in m_iae_in m_k0_fkt m_k0_in m_k0_mod_has_fkt m_max_dyn_em_in m_max_em_has_fkt m_max_iae_has_fkt m_min_dyn_em_in m_min_em_has_fkt m_min_vm_in m_mot_in m_soll_em_has_fkt m_soll_em_hst_in m_soll_k0_has_fkt m_soll_res_em_has_fkt m_soll_vm_has_fkt m_soll_vm_hst_in m_soll_vm_l_has_fkt m_soll_vm_l_hst_in m_vm_in m_vm_start_in m_wunsch_fpw_hst_fil m_wunsch_fpw_hst_in m_wunsch_fpw_in mg_max_em_has_fkt mg_min_em_has_fkt mg_soll_K0_fkt mg_soll_k0_has_fkt mg_wunsch_fpw mg_wunsch_fpw_hst mod_K0_fkt n_ab_egs_in n_em_in n_min_psys_em_has_sbe n_mot_soll_iae_in n_sec_iae n_soll_em_has_fkt n_soll_em_hst_in n_soll_ll_vm_in n_soll_vm_has_fkt n_t_egs_in n_vm_in nd_iae nd_k0_in nd_soll_iae_fkt ndg_k0_in ng_vm osmode_next_in p_bremse_fzg_in phi_neigung_in pos_egs_in sollgang_egs_in st_OMLID_act_stg st_ablauf_fkt st_ist_bz_has_stg st_ist_bz_has_stg_azg st_ist_bz_hst_in_azg st_ist_bz_hst_mod_azg st_ist_bz_hst_sta st_soll_bz_has_hst st_soll_bz_hst_sta st_ziel_bz_has_stg st_ziel_bz_has_stg_azg st_ziel_bz_hst_in_azg st_ziel_bz_hst_mod_azg status_ablauf_has_fkt status_alaengs_adaoff_in status_betriebsbereit_hst_in status_fehler_iep_in status_iae_adap_in status_iae_in status_iep_in status_k0_adap_in status_k0_in status_kl15_in status_kolbenpos_k0_in status_kraftfluss_egs_in status_kraftfluss_egs_roh_in status_ll_vm_in status_nem_in status_nreg_em_hst_in status_nvm_in status_posvueb_in status_psys_has_sbe status_sa_vm_in status_schaltung_egs_in status_sync_schaltung_sbe status_waschstr_in t_betrieb_pvu_has_ee_in t_betrieb_pvu_has_sbe timer_pumpready_aktiv_fkt v_f_sbe vg_f_sbe z_ablauf_has_hst_in z_ablauf_has_stg z_ablauf_svh_reset_has_fkt z_ablaufvariante_has_hst_in z_ablaufvariante_has_stg z_ablaufvariante_kalt_zus z_ba_has_k0_hst_in z_ba_has_vm_hst_in z_diag_ersfkt_has_in z_diag_ersfkt_hi_has_in z_diag_notgang_has_in z_emaktiv_fuw_zus_fkt z_fehler15_eh_fkt z_freigabe_pvu_has_sbe z_hybfkt_stg z_iep_in z_init_fkt z_init_sta z_k0_befuellopt_has_fkt z_k0_fst_in z_k0_has_fkt z_kps_stada_in z_m_begr_em_has_fkt z_m_max_iae_has_fkt z_m_soll_em_has_fkt z_m_soll_vm_has_fkt z_modus_em_hst_in z_modus_iae_has_fkt z_msa_fst_in z_msa_stada_in z_n_min_em_parksp_has_in z_n_min_iep_in z_n_soll_em_has_fkt z_n_soll_vm_has_fkt z_nllsoll_iae_in z_p_hys_k0_has_fkt z_ponr_fkt z_pvu_has_sbe z_saf_has_fkt z_sbe_has_fkt z_standby_em_has_fkt z_status_psys_mps_sbe z_timer_pumpready_fkt z_tmin_fehler15_fkt z_ziel_kraftfluss_egs_in z_zuendfreigabe_vm_fkt z_zuendfreigabe_vm_has_fkt zielgang_egs_in /end LOC_MEASUREMENT
/end FUNCTION
/begin FUNCTION Run_FOp_OperativeFunktionen ""
 /begin SUB_FUNCTION SFOp18_FOp_Zustart SFOp17_FOp_VMein SFOp16_FOp_VMaus SFOp15_FOp_Schleppstart SFOp14_FOp_Passiv SFOp13_FOp_OhneAblauffkt SFOp12_FOp_Notstart SFOp20_DS_Write SFOp19_DS_Read SFOp10_FOp_Gangeinlegen SFOp9_FOp_Gangauslegen SFOp8_FOp_Fehler15 SFOp7_FOp_Direktstart SFOp6_FOp_Ankoppeln SFOp5_FOp_Abstellen SFOp4_FOp_Abo SFOp3_FOp_Abkoppeln /end SUB_FUNCTION
 /begin LOC_MEASUREMENT abstellpos_vm_in abstellpos_vm_status_in bErrorHybrid bExceptionHybrid c_getriebe_egs_in c_vm_in gangwechsel_egs_in i_istgang_egs i_zielgang_egs istgang_egs_in m_em_in m_iae_in m_k0_fkt m_k0_in m_k0_mber_has_sbe m_k0_mod_has_fkt m_max_dyn_em_in m_max_em_has_fkt m_max_iae_has_fkt m_min_dyn_em_in m_min_em_has_fkt m_min_vm_in m_mot_in m_motmax_has m_soll_em_has_fkt m_soll_em_hst_in m_soll_k0_has_fkt m_soll_res_em_bas_sbe m_soll_res_em_has_fkt m_soll_res_em_has_sbe m_soll_vm_has_fkt m_soll_vm_hst_in m_soll_vm_l_has_fkt m_soll_vm_l_hst_in m_vm_in m_vm_start_in m_wunsch_fpw_hst_fil m_wunsch_fpw_hst_in m_wunsch_fpw_in mg_max_em_has_fkt mg_min_em_has_fkt mg_soll_K0_fkt mg_soll_k0_has_fkt mg_wunsch_fpw mg_wunsch_fpw_hst mod_K0_fkt n_ab_egs_in n_em_in n_min_em_has_sbe n_min_psys_em_has_sbe n_mot_soll_iae_in n_sec_iae n_soll_em_has_fkt n_soll_em_hst_in n_soll_ll_vm_in n_soll_vm_has_fkt n_t_egs_in n_vm_in nd_iae nd_k0_in nd_soll_iae_fkt ndg_k0_in ng_vm osmode_next_in p_bremse_fzg_in phi_neigung_in pos_egs_in sollgang_egs_in st_OMLID_act_stg st_ablauf_fkt st_ist_bz_has_stg st_ist_bz_hst_sta st_soll_bz_has_hst st_soll_bz_hst_sta st_ziel_bz_has_stg status_ablauf_has_fkt status_alaengs_adaoff_in status_betriebsbereit_hst_in status_efahren_has_sbe status_fehler15_eh_diagin status_fehler_iep_in status_iae_adap_in status_iae_in status_iep_in status_k0_adap_in status_k0_in status_kl15_in status_kolbenpos_k0_in status_kraftfluss_egs_in status_kraftfluss_egs_roh_in status_ll_vm_in status_nem_in status_nreg_em_hst_in status_nvm_in status_posvueb_in status_psys_has_sbe status_sa_vm_in status_schaltart_svh_has_sbe status_schaltung_egs_in status_sync_schaltung_sbe status_waschstr_in status_zug_svh_sbe t_betrieb_pvu_has_ee_in t_betrieb_pvu_has_sbe timer_pumpready_aktiv_fkt v_f_sbe vg_f_sbe z_ablauf_has_hst_in z_ablauf_has_stg z_ablauf_svh_reset_has_fkt z_ablaufreinit_frk_dihi z_ablaufvariante_has_hst_in z_ablaufvariante_has_stg z_ablaufvariante_kalt_zus z_ba_has_k0_hst_in z_ba_has_vm_hst_in z_diag_ersfkt_has_in z_diag_ersfkt_hi_has_in z_diag_notgang_has_in z_emaktiv_fuw_zus_fkt z_emfehler_frk_dihi z_fehler15_eh_fkt z_freigabe_pvu_has_sbe z_fuwdeakt_frk_dihi z_hybfkt_stg z_iep_in z_init_fkt z_init_sta z_k0_befuellopt_has_fkt z_k0_fst_in z_k0_has_fkt z_k0_has_sbe z_k0syncmk0erh_frk_dihi z_kps_stada_in z_m_begr_em_has_fkt z_m_max_iae_has_fkt z_m_soll_em_has_fkt z_m_soll_vm_has_fkt z_modus_em_hst_in z_modus_iae_has_fkt z_modus_iae_has_sbe z_modus_iep_has_sbe z_msa_avh_moni_has_sbe z_msa_eaf_moni_has_sbe z_msa_fst_in z_msa_has_sbe z_msa_stada_in z_n_min_em_parksp_has_in z_n_min_iep_in z_n_soll_em_has_fkt z_n_soll_vm_has_fkt z_nllsoll_iae_in z_nminemnull_frk_dihi z_nvmsollbegr_frk_dihi z_p_hys_k0_has_fkt z_ponr_fkt z_pvu_has_sbe z_saf_has_fkt z_sas_has_sbe z_sbe_has_fkt z_standby_em_has_fkt z_start_modus_has_sbe z_status_psys_mps_sbe z_svh_has_sbe z_timer_pumpready_fkt z_tmin_fehler15_fkt z_ziel_kraftfluss_egs_in z_zuendfreigabe_vm_fkt z_zuendfreigabe_vm_has_fkt zielgang_egs_in /end LOC_MEASUREMENT
/end FUNCTION
/begin FUNCTION Run_FSF_SonderFunktionen "" /begin DEF_CHARACTERISTIC FSF1 /end DEF_CHARACTERISTIC
 /begin LOC_MEASUREMENT FSFSig1 FSFSig2 c_getriebe_egs_in gangwechsel_egs_in istgang_egs_in m_em_in m_iae_in m_k0_in m_max_dyn_em_in m_min_dyn_em_in m_mot_in m_soll_em_hst_in m_soll_vm_hst_in m_vm_in m_vm_start_in m_wunsch_fpw_in n_ab_egs_in n_em_in n_mot_soll_iae_in n_soll_ll_vm_in n_t_egs_in n_vm_in osmode_next_in p_bremse_fzg_in phi_neigung_in pos_egs_in sollgang_egs_in status_alaengs_adaoff_in status_fehler_iep_in status_iae_adap_in status_iae_in status_iep_in status_k0_adap_in status_k0_in status_kolbenpos_k0_in status_kraftfluss_egs_in status_kraftfluss_egs_roh_in status_ll_vm_in status_nem_in status_nvm_in status_posvueb_in status_waschstr_in t_betrieb_pvu_has_ee_in z_ablauf_has_hst_in z_ablaufvariante_has_hst_in z_diag_ersfkt_has_in z_diag_ersfkt_hi_has_in z_diag_notgang_has_in z_iep_in z_k0_fst_in z_kps_stada_in z_modus_em_hst_in z_msa_fst_in z_n_min_em_parksp_has_in z_n_min_iep_in z_nllsoll_iae_in z_ziel_kraftfluss_egs_in zielgang_egs_in /end LOC_MEASUREMENT
/end FUNCTION
/begin FUNCTION Run_FSTA_Strategie ""
 /begin SUB_FUNCTION SFSTA3_FSTAPS_ProjektSpezifisch Run_SFSTA12_cTimer_trigger_ SFSTA11_Bitwise_AND_ui32_3 SFSTA10_Bitwise_AND_ui32_2 SFSTA9_Bitwise_AND_ui32_1 SFSTA8_Bitwise_AND_ui32_ /end SUB_FUNCTION
 /begin DEF_CHARACTERISTIC BM_ERSFKT_HI_ZUST_HALTEN_HAS BM_ERSFKT_HI_ZUST_INIT_HAS BM_ERSFKT_ZUST_HALTEN_HAS BM_ERSFKT_ZUST_INIT_HAS T_VZABLAUFREINIT_HAS /end DEF_CHARACTERISTIC
 /begin LOC_MEASUREMENT abstellpos_vm_in abstellpos_vm_status_in bErrorHybrid bExceptionHybrid c_getriebe_egs_in c_getriebe_egs_portin c_iep_portin c_vm_in gangwechsel_egs_in gangwechsel_egs_portin i_istgang_egs i_zielgang_egs istgang_egs_in istgang_egs_portin m_em_in m_em_portin m_iae_in m_iae_portin m_k0_fkt m_k0_in m_k0_mod_has_fkt m_k0_portin m_max_dyn_em_in m_max_dyn_em_portin m_max_em_has_fkt m_max_iae_has_fkt m_min_dyn_em_in m_min_dyn_em_portin m_min_em_has_fkt m_min_vm_in m_mot_in m_mot_portin m_soll_em_has_fkt m_soll_em_hst_in m_soll_em_hst_portin m_soll_k0_has_fkt m_soll_res_em_has_fkt m_soll_vm_has_fkt m_soll_vm_hst_in m_soll_vm_hst_portin m_soll_vm_l_has_fkt m_soll_vm_l_hst_in m_vm_in m_vm_portin m_vm_start_in m_vm_start_portin m_wunsch_fpw_hst_fil m_wunsch_fpw_hst_in m_wunsch_fpw_in m_wunsch_fpw_portin mg_max_em_has_fkt mg_min_em_has_fkt mg_soll_K0_fkt mg_soll_k0_has_fkt mg_wunsch_fpw mg_wunsch_fpw_hst mod_K0_fkt n_ab_egs_in n_ab_egs_portin n_em_in n_em_portin n_min_psys_em_has_sbe n_mot_soll_iae_in n_mot_soll_iae_portin n_sec_iae n_soll_em_has_fkt n_soll_em_hst_in n_soll_ll_vm_in n_soll_ll_vm_portin n_soll_vm_has_fkt n_t_egs_in n_t_egs_portin n_vm_in n_vm_portin nd_iae nd_k0_in nd_soll_iae_fkt ndg_k0_in ng_vm osmode_next_in osmode_next_portin p_bremse_fzg_in p_bremse_fzg_portin phi_neigung_in phi_neigung_portin pos_egs_in pos_egs_portin posv_timer_portin posvueb_aktiv_portin sollgang_egs_in sollgang_egs_portin st_OMLID_act_stg st_ablauf_fkt st_ist_bz_has_stg st_ist_bz_hst_sta st_soll_bz_has_hst st_soll_bz_hst_sta st_ziel_bz_has_stg status_ablauf_has_fkt status_alaengs_adaoff_in status_alaengs_adaoff_portin status_betriebsbereit_hst_in status_ee_busy_portin status_fehler15_eh_diagin status_fehler_iep_in status_fehler_iep_portin status_iae_adap_in status_iae_adap_portin status_iae_in status_iae_portin status_iep_in status_iep_portin status_k0_adap_in status_k0_adap_portin status_k0_in status_k0_portin status_kl15_in status_kolbenpos_k0_in status_kolbenpos_k0_portin status_kraftfluss_egs_in status_kraftfluss_egs_roh_in status_kraftschl_atsys_portin status_ll_vm_in status_nem_in status_nem_portin status_nreg_em_hst_in status_nvm_in status_nvm_portin status_phineigung_portin status_posvueb_in status_psys_has_sbe status_sa_vm_in status_schaltung_egs_in status_sync_schaltung_sbe status_waschstr_in status_waschstr_portin t_betrieb_pvu_has_ee_in t_betrieb_pvu_has_ee_portin t_betrieb_pvu_has_sbe timer_pumpready_aktiv_fkt v_f_sbe vg_f_sbe z_ablauf_has_hst_in z_ablauf_has_hst_portin z_ablauf_has_stg z_ablauf_svh_reset_has_fkt z_ablaufreinit_frk_dihi z_ablaufvariante_has_hst_in z_ablaufvariante_has_hst_portin z_ablaufvariante_has_stg z_ablaufvariante_kalt_zus z_ba_has_k0_hst_in z_ba_has_vm_hst_in z_diag_ersfkt_has_in z_diag_ersfkt_has_portin z_diag_ersfkt_hi_has_in z_diag_ersfkt_hi_has_portin z_diag_notgang_has_in z_diag_notgang_has_portin z_emaktiv_fuw_zus_fkt z_emfehler_frk_dihi z_fehler15_eh_fkt z_freigabe_pvu_has_sbe z_fuwdeakt_frk_dihi z_hybfkt_stg z_iep_in z_iep_portin z_init_fkt z_init_sta z_k0_befuellopt_has_fkt z_k0_fst_in z_k0_fst_portin z_k0_has_fkt z_k0syncmk0erh_frk_dihi z_kps_stada_in z_kps_stada_portin z_m_begr_em_has_fkt z_m_max_iae_has_fkt z_m_soll_em_has_fkt z_m_soll_vm_has_fkt z_modus_em_hst_in z_modus_iae_has_fkt z_msa_fst_in z_msa_fst_portin z_msa_stada_in z_n_min_em_parksp_has_in z_n_min_em_parksp_has_portin z_n_min_iep_in z_n_min_iep_portin z_n_soll_em_has_fkt z_n_soll_vm_has_fkt z_nllsoll_iae_in z_nllsoll_iae_portin z_nminemnull_frk_dihi z_nvmsollbegr_frk_dihi z_p_hys_k0_has_fkt z_ponr_fkt z_pvu_has_sbe z_saf_has_fkt z_sbe_has_fkt z_standby_em_has_fkt z_status_psys_mps_sbe z_timer_pumpready_fkt z_tmin_fehler15_fkt z_ziel_kraftfluss_egs_in z_zuendfreigabe_vm_fkt z_zuendfreigabe_vm_has_fkt zielgang_egs_in zielgang_egs_portin /end LOC_MEASUREMENT
/end FUNCTION
/begin FUNCTION Run_GC_Global_Cal ""
 /begin DEF_CHARACTERISTIC STATUS_ABL_ABBRUCH_AKTIV STATUS_ABL_ABBRUCH_FERTIG SWI_RESPSCHLE_SCHALT_ANS Z_ABLVAR_KST_MPS_HAS /end DEF_CHARACTERISTIC
/end FUNCTION
/begin FUNCTION Run_SAi_SignalAufbereitung_in ""
 /begin SUB_FUNCTION SSAi4_SAiPS_ProjektSpezifisch SSAi3_SAiPA_ProjektAllgemein SSAi2_SAiEEP_EEProm /end SUB_FUNCTION
 /begin LOC_MEASUREMENT abstellpos_vm_in abstellpos_vm_portin abstellpos_vm_status_in abstellpos_vm_status_portin c_getriebe_egs_in c_getriebe_egs_portin c_iep_portin c_vm_in c_vm_portin gangwechsel_egs_in gangwechsel_egs_portin istgang_egs istgang_egs_in istgang_egs_portin m_em_in m_em_portin m_iae_in m_iae_portin m_k0_in m_k0_portin m_max_dyn_em_in m_max_dyn_em_portin m_max_vm_portin m_min_dyn_em_in m_min_dyn_em_portin m_min_vm_in m_min_vm_portin m_mot_in m_mot_portin m_soll_em_hst_in m_soll_em_hst_portin m_soll_vm_hst_in m_soll_vm_hst_portin m_soll_vm_l_hst_in m_soll_vm_l_hst_portin m_vm m_vm_in m_vm_portin m_vm_start_in m_vm_start_portin m_wunsch_fpw_hst_in m_wunsch_fpw_hst_portin m_wunsch_fpw_in m_wunsch_fpw_portin n_ab_egs_in n_ab_egs_portin n_em_in n_em_portin n_mot_soll_iae_in n_mot_soll_iae_portin n_soll_em_hst_in n_soll_em_hst_portin n_soll_ll_vm_in n_soll_ll_vm_portin n_t_egs_in n_t_egs_portin n_vm_in n_vm_portin osmode_next_in osmode_next_portin p_bremse_fzg_in p_bremse_fzg_portin phi_neigung_in phi_neigung_portin pos_egs_in pos_egs_portin posv_timer_portin posvueb_aktiv_portin sollgang_egs_in sollgang_egs_portin st_OMLID_act_stg st_ist_bz_has_stg st_soll_bz_has_hst st_ziel_bz_has_stg status_alaengs_adaoff_in status_alaengs_adaoff_portin status_betriebsber_hst_portin status_betriebsbereit_hst_in status_ee_busy_portin status_fehler_iep_in status_fehler_iep_portin status_fehler_k0_portin status_iae_adap_in status_iae_adap_portin status_iae_in status_iae_portin status_iep_in status_iep_portin status_k0_adap_in status_k0_adap_portin status_k0_in status_k0_portin status_kl15_in status_kolbenpos_k0_in status_kolbenpos_k0_portin status_kraftfluss_egs_in status_kraftfluss_egs_roh_in status_kraftschl_atsys_portin status_ll_vm_in status_modus_em_portin status_nem_in status_nem_portin status_nreg_em_hst_in status_nreg_em_hst_portin status_nvm_in status_nvm_portin status_phineigung_portin status_posvueb_in status_sa_vm_in status_sa_vm_portin status_waschstr_in status_waschstr_portin t_betrieb_pvu_has_ee_in t_betrieb_pvu_has_ee_portin z_ablauf_has_hst_in z_ablauf_has_hst_portin z_ablauf_has_stg z_ablaufvariante_has_hst_in z_ablaufvariante_has_hst_portin z_ablaufvariante_has_stg z_ba__st_drv_veh_portin z_ba_has_k0_hst_in z_ba_has_k0_hst_portin z_ba_has_vm_hst_in z_ba_has_vm_hst_portin z_diag_ersfkt_has_in z_diag_ersfkt_has_portin z_diag_ersfkt_hi_has_in z_diag_ersfkt_hi_has_portin z_diag_notgang_has_in z_diag_notgang_has_portin z_hybfkt_stg z_iep_in z_iep_portin z_k0_fst_in z_k0_fst_portin z_kps_stada_in z_kps_stada_portin z_modus_em_hst_in z_msa_fst_in z_msa_fst_portin z_msa_stada_in z_n_min_em_parksp_has_in z_n_min_em_parksp_has_portin z_n_min_iep_in z_n_min_iep_portin z_nllsoll_iae_in z_nllsoll_iae_portin z_ziel_kraftfluss_egs_in zielgang_egs_in zielgang_egs_portin /end LOC_MEASUREMENT
/end FUNCTION
/begin FUNCTION Run_SAo_SignalAufbereitung_out ""
 /begin SUB_FUNCTION SSAo5_SAoPS_ProjektSpezifisch SSAo4_SAoPA_ProjektAllgemein SSAo3_SAoEH_ErrorHandler SSAo2_SAoEEP_EEProm /end SUB_FUNCTION
 /begin LOC_MEASUREMENT SAoEEP1 SAoEEP2 SAoEH1 SAoEH2 abstellpos_vm_in abstellpos_vm_status_in analyse_has_byp analyse_has_portout bErrorHybrid bExceptionHybrid byp_vnr_has_byp bypass_has_aktiv c_getriebe_egs_in c_vm_in err_n_soll_em_has_komp_portout err_n_soll_em_has_portout err_n_soll_vm_has_komp_portout err_n_soll_vm_has_portout gangwechsel_egs_in has_aktiv_has_byp i_istgang_egs i_zielgang_egs iep_soll_has_portout istgang_egs_in m_em_in m_iae_in m_k0_fkt m_k0_has_byp m_k0_has_portout m_k0_in m_k0_mber_has_byp m_k0_mber_has_portout m_k0_mber_has_sbe m_k0_mod_has_fkt m_max_dyn_em_in m_max_em_has_byp m_max_em_has_fkt m_max_em_has_portout m_max_iae_has_byp m_max_iae_has_fkt m_max_iae_has_portout m_min_dyn_em_in m_min_em_has_byp m_min_em_has_fkt m_min_em_has_portout m_min_vm_in m_mot_in m_motmax_has m_motmax_has_byp m_motmax_has_komp_portout m_motmax_has_portout m_soll_em_has_byp m_soll_em_has_fkt m_soll_em_has_komp_portout m_soll_em_has_portout m_soll_em_hst_in m_soll_k0_has_byp m_soll_k0_has_fkt m_soll_k0_has_portout m_soll_res_em_bas_sbe m_soll_res_em_has_byp m_soll_res_em_has_fkt m_soll_res_em_has_portout m_soll_res_em_has_sbe m_soll_vm_has_fkt m_soll_vm_hst_in m_soll_vm_l_has_fkt m_soll_vm_l_hst_in m_vm_in m_vm_start_in m_wunsch_fpw_hst_fil m_wunsch_fpw_hst_in m_wunsch_fpw_in mg_max_em_has_fkt mg_min_em_has_fkt mg_soll_K0_fkt mg_soll_k0_has_fkt mg_soll_k0_neg_has_byp mg_soll_k0_neg_has_portout mg_soll_k0_pos_has_byp mg_soll_k0_pos_has_portout mg_wunsch_fpw mg_wunsch_fpw_hst mo_mod_em_hst_has_byp mo_mod_em_hst_has_portout mod_K0_fkt n_ab_egs_in n_em_in n_min_em_has_sbe n_min_em_has_sbe_has_byp n_min_psys_em_has_sbe n_mot_llsoll_has_komp_portout n_mot_llsoll_has_portout n_mot_soll_iae_in n_sec_iae n_soll_em_has_byp n_soll_em_has_fkt n_soll_em_has_komp_portout n_soll_em_has_portout n_soll_em_hst_in n_soll_ll_vm_in n_soll_vm_has_byp n_soll_vm_has_fkt n_soll_vm_has_komp_portout n_soll_vm_has_portout n_t_egs_in n_vm_in nd_iae nd_k0_in nd_min_saf_has_byp nd_min_saf_has_portout nd_soll_iae_fkt ndg_k0_in ng_vm osmode_next_in p_bremse_fzg_in pc_ok_has_byp phi_neigung_in pos_egs_in sollgang_egs_in st_OMLID_act_stg st_ablauf_fkt st_ist_bz_has_byp st_ist_bz_has_portout st_ist_bz_has_stg st_ist_bz_hst_sta st_soll_bz_has_hst st_soll_bz_hst_sta st_ziel_bz_has_byp st_ziel_bz_has_portout st_ziel_bz_has_stg status_ablauf_has_fkt status_ablauf_has_fkt_byp status_ablauf_has_portout status_ablaufaktiv_has_byp status_ablaufaktiv_has_portout status_alaengs_adaoff_in status_betriebsbereit_hst_in status_efahren_has_byp status_efahren_has_portout status_efahren_has_sbe status_fehler15_eh_diagin status_fehler_iep_in status_iae_adap_in status_iae_in status_iep_in status_k0_adap_in status_k0_in status_kl15_in status_kolbenpos_k0_in status_kraftfluss_egs_in status_kraftfluss_egs_roh_in status_ll_vm_in status_motorstandby_has_byp status_nem_in status_nreg_em_hst_in status_nvm_in status_posvueb_in status_psys_has_sbe status_sa_vm_in status_schaltart_svh_has_sbe status_schaltung_egs_in status_sync_schaltung_sbe status_waschstr_in status_zug_svh_sbe t_betrieb_pvu_has_ee_in t_betrieb_pvu_has_portout t_betrieb_pvu_has_sbe timer_pumpready_aktiv_fkt v_f_sbe vg_f_sbe z_ablauf_has_hst_in z_ablauf_has_stg z_ablauf_svh_reset_has_fkt z_ablaufreinit_frk_dihi z_ablaufvariante_has_hst_in z_ablaufvariante_has_stg z_ablaufvariante_kalt_zus z_ba_has_k0_hst_in z_ba_has_vm_hst_in z_diag_ersfkt_has_in z_diag_ersfkt_hi_has_in z_diag_notgang_has_in z_emaktiv_fuw_zus_fkt z_emfehler_frk_dihi z_fehler15_eh_fkt z_freigabe_pvu_has_portout z_freigabe_pvu_has_sbe z_fuwdeakt_frk_dihi z_glsbe_has_byp z_glsbe_has_portout z_hybfkt_stg z_iep_in z_init_fkt z_init_sta z_k0_befuellopt_has_byp z_k0_befuellopt_has_fkt z_k0_befuellopt_has_portout z_k0_fst_in z_k0_has_byp z_k0_has_fkt z_k0_has_portout z_k0_has_sbe z_k0syncmk0erh_frk_dihi z_kps_stada_in z_m_begr_em_has_fkt z_m_max_iae_has_byp z_m_max_iae_has_fkt z_m_max_iae_has_portout z_m_soll_em_has_byp z_m_soll_em_has_fkt z_m_soll_em_has_komp_portout z_m_soll_em_has_portout z_m_soll_vm_has_fkt z_modus_em_hst_in z_modus_iae_has_byp z_modus_iae_has_fkt z_modus_iae_has_portout z_modus_iae_has_sbe z_modus_iep_has_byp z_modus_iep_has_sbe z_msa_avh_moni_has_sbe z_msa_eaf_moni_has_sbe z_msa_fst_in z_msa_has_byp z_msa_has_portout z_msa_has_sbe z_msa_stada_in z_n_min_em_parksp_has_in z_n_min_iep_in z_n_soll_em_has_byp z_n_soll_em_has_fkt z_n_soll_em_has_komp_portout z_n_soll_em_has_portout z_n_soll_vm_has_byp z_n_soll_vm_has_fkt z_n_soll_vm_has_komp_portout z_n_soll_vm_has_portout z_nllsoll_iae_in z_nminemnull_frk_dihi z_nvmsollbegr_frk_dihi z_p_hys_k0_has_byp z_p_hys_k0_has_fkt z_p_hys_k0_has_portout z_ponr_fkt z_pvu_has_sbe z_saf_has_byp z_saf_has_fkt z_saf_has_portout z_sas_has_byp z_sas_has_portout z_sas_has_sbe z_sbe_has_byp z_sbe_has_fkt z_sbe_has_portout z_standby_em_has_fkt z_start_modus_has_byp z_start_modus_has_portout z_start_modus_has_sbe z_status_psys_mps_has_byp z_status_psys_mps_portout z_status_psys_mps_sbe z_svh_has_byp z_svh_has_portout z_svh_has_sbe z_timer_pumpready_fkt z_tmin_fehler15_fkt z_ziel_kraftfluss_egs_in z_zuendfreigabe_vm_fkt z_zuendfreigabe_vm_has_fkt zielgang_egs_in /end LOC_MEASUREMENT
/end FUNCTION
/begin FUNCTION Run_SDIAGo16_c__ichterk_auw_has "" /begin DEF_CHARACTERISTIC T_VK0SCHLNICHT_ERK_AUW_HAS /end DEF_CHARACTERISTIC /begin OUT_MEASUREMENT SDIAGo16_isActive_ SDIAGo16_t_left_ /end OUT_MEASUREMENT /begin LOC_MEASUREMENT SDIAGo16_Unit_Delay /end LOC_MEASUREMENT /end FUNCTION
/begin FUNCTION Run_SDIAGo19_c__ss_filt_auw_has "" /begin DEF_CHARACTERISTIC T_VK0NDK0ZUGROSS_FILT_AUW_HAS /end DEF_CHARACTERISTIC /begin OUT_MEASUREMENT SDIAGo19_isActive_ SDIAGo19_t_left_ /end OUT_MEASUREMENT /begin LOC_MEASUREMENT SDIAGo19_Unit_Delay /end LOC_MEASUREMENT /end FUNCTION
/begin FUNCTION Run_SDIAGo20_c__ht_filt_auw_has "" /begin DEF_CHARACTERISTIC T_VK0SCHLNICHT_FILT_AUW_HAS /end DEF_CHARACTERISTIC /begin OUT_MEASUREMENT SDIAGo20_isActive_ SDIAGo20_t_left_ /end OUT_MEASUREMENT /begin LOC_MEASUREMENT SDIAGo20_Unit_Delay /end LOC_MEASUREMENT /end FUNCTION
/begin FUNCTION Run_SDIAGo21_c__ss_filt_auw_has "" /begin DEF_CHARACTERISTIC T_VNDK0ZUGROSS_FILT_AUW_HAS /end DEF_CHARACTERISTIC /begin OUT_MEASUREMENT SDIAGo21_isActive_ SDIAGo21_t_left_ /end OUT_MEASUREMENT /begin LOC_MEASUREMENT SDIAGo21_Unit_Delay /end LOC_MEASUREMENT /end FUNCTION
/begin FUNCTION Run_SDIAGo22_c__in_filt_auw_has "" /begin DEF_CHARACTERISTIC T_VNEMZUKLEIN_FILT_AUW_HAS /end DEF_CHARACTERISTIC /begin OUT_MEASUREMENT SDIAGo22_isActive_ SDIAGo22_t_left_ /end OUT_MEASUREMENT /begin LOC_MEASUREMENT SDIAGo22_Unit_Delay /end LOC_MEASUREMENT /end FUNCTION
/begin FUNCTION Run_SDIAGo23_c__us_filt_auw_has "" /begin DEF_CHARACTERISTIC T_VVMAUS_FILT_AUW_HAS /end DEF_CHARACTERISTIC /begin OUT_MEASUREMENT SDIAGo23_isActive_ SDIAGo23_t_left_ /end OUT_MEASUREMENT /begin LOC_MEASUREMENT SDIAGo23_Unit_Delay /end LOC_MEASUREMENT /end FUNCTION
/begin FUNCTION Run_SDIAGo54_cTimer_trigger_ "" /begin DEF_CHARACTERISTIC T_VK0OEFFNICHT_ERK_DIHO /end DEF_CHARACTERISTIC /begin OUT_MEASUREMENT SDIAGo54_isActive_ SDIAGo54_t_left_ /end OUT_MEASUREMENT /begin LOC_MEASUREMENT SDIAGo54_Unit_Delay /end LOC_MEASUREMENT /end FUNCTION
/begin FUNCTION Run_SDIAGo63_cTimer_trigger_ "" /begin DEF_CHARACTERISTIC T_VK0SCHLNICHT_ERK_DIHO /end DEF_CHARACTERISTIC /begin OUT_MEASUREMENT SDIAGo63_isActive_ SDIAGo63_t_left_ /end OUT_MEASUREMENT /begin LOC_MEASUREMENT SDIAGo63_Unit_Delay /end LOC_MEASUREMENT /end FUNCTION
/begin FUNCTION Run_SDIAGo64_cTimer_triggerpb_ "" /begin DEF_CHARACTERISTIC T_K0SCHLNICHTPB_DIHO /end DEF_CHARACTERISTIC /begin OUT_MEASUREMENT SDIAGo64_isActive_ SDIAGo64_t_left_ /end OUT_MEASUREMENT /begin LOC_MEASUREMENT SDIAGo64_Unit_Delay /end LOC_MEASUREMENT /end FUNCTION
/begin FUNCTION Run_SDIAGo72_cTimer_trigger_ "" /begin DEF_CHARACTERISTIC T_VOELVERSFEHLER_FILT_HAS /end DEF_CHARACTERISTIC /begin OUT_MEASUREMENT SDIAGo72_isActive_ SDIAGo72_t_left_ /end OUT_MEASUREMENT /begin LOC_MEASUREMENT SDIAGo72_Unit_Delay /end LOC_MEASUREMENT /end FUNCTION
/begin FUNCTION Run_SDIAGo73_cTimer_trigger_1 "" /begin DEF_CHARACTERISTIC T_VOELVERSFEHLERKALT_FILT_HAS /end DEF_CHARACTERISTIC /begin OUT_MEASUREMENT SDIAGo73_isActive_ SDIAGo73_t_left_ /end OUT_MEASUREMENT /begin LOC_MEASUREMENT SDIAGo73_Unit_Delay /end LOC_MEASUREMENT /end FUNCTION
/begin FUNCTION Run_SFHC103_cTimer_trigger_ "" /begin DEF_CHARACTERISTIC T_VBRE_NMINPSYSEM_HAS /end DEF_CHARACTERISTIC /begin OUT_MEASUREMENT SFHC103_isActive_ SFHC103_t_left_ /end OUT_MEASUREMENT /begin LOC_MEASUREMENT SFHC103_Unit_Delay /end LOC_MEASUREMENT /end FUNCTION
/begin FUNCTION Run_SFHC118_cT__tatuspsysem_lp3 "" /begin OUT_MEASUREMENT SFHC118_isActive_ SFHC118_t_left_ /end OUT_MEASUREMENT /begin LOC_MEASUREMENT SFHC118_Unit_Delay /end LOC_MEASUREMENT /end FUNCTION
/begin FUNCTION Run_SFHC122_cT__ger_psysem_verz "" /begin OUT_MEASUREMENT SFHC122_isActive_ SFHC122_t_left_ /end OUT_MEASUREMENT /begin LOC_MEASUREMENT SFHC122_Unit_Delay /end LOC_MEASUREMENT /end FUNCTION
/begin FUNCTION Run_SFHC16_cTimer_trigger_ "" /begin DEF_CHARACTERISTIC TS_ANFMAX_PVU_HAS /end DEF_CHARACTERISTIC /begin OUT_MEASUREMENT SFHC16_isActive_ SFHC16_t_left_ /end OUT_MEASUREMENT /begin LOC_MEASUREMENT SFHC16_Unit_Delay /end LOC_MEASUREMENT /end FUNCTION
/begin FUNCTION Run_SFHC19_cTi__sashasaktiv_bbr "" /begin DEF_CHARACTERISTIC TS_AKTIV_PVU_HAS /end DEF_CHARACTERISTIC /begin OUT_MEASUREMENT SFHC19_isActive_ SFHC19_t_left_ /end OUT_MEASUREMENT /begin LOC_MEASUREMENT SFHC19_Unit_Delay /end LOC_MEASUREMENT /end FUNCTION
/begin FUNCTION Run_SFHC20_cTi___zsashasmax_bbr "" /begin DEF_CHARACTERISTIC TS_MAX_PVU_HAS /end DEF_CHARACTERISTIC /begin OUT_MEASUREMENT SFHC20_isActive_ SFHC20_t_left_ /end OUT_MEASUREMENT /begin LOC_MEASUREMENT SFHC20_Unit_Delay /end LOC_MEASUREMENT /end FUNCTION
/begin FUNCTION Run_SFHC25_cDT1_ndgk0 "" /begin DEF_CHARACTERISTIC FK_NDGK0 XP_MAX /end DEF_CHARACTERISTIC /begin OUT_MEASUREMENT SFHC25_x_filter_ SFHC25_xp_ /end OUT_MEASUREMENT /begin LOC_MEASUREMENT SFHC32_Unit_Delay2 /end LOC_MEASUREMENT /end FUNCTION
/begin FUNCTION Run_SFHC26_cDT1_ndgvm "" /begin DEF_CHARACTERISTIC FK_NGVM_HAS XP_MAX /end DEF_CHARACTERISTIC /begin OUT_MEASUREMENT SFHC26_x_filter_ SFHC26_xp_ /end OUT_MEASUREMENT /begin LOC_MEASUREMENT SFHC35_Unit_Delay2 n_vm_in /end LOC_MEASUREMENT /end FUNCTION
/begin FUNCTION Run_SFHC27_cDT1_vg_f "" /begin DEF_CHARACTERISTIC FK_VGF_HAS XP_MAX /end DEF_CHARACTERISTIC /begin OUT_MEASUREMENT SFHC27_x_filter_ SFHC27_xp_ /end OUT_MEASUREMENT /begin LOC_MEASUREMENT SFHC38_Unit_Delay2 /end LOC_MEASUREMENT /end FUNCTION
/begin FUNCTION Run_SFHC28_cDelayEM_ "" /begin DEF_CHARACTERISTIC T_VNEMNDK0_HAS /end DEF_CHARACTERISTIC /begin OUT_MEASUREMENT SFHC28_out_ /end OUT_MEASUREMENT /begin LOC_MEASUREMENT SFHC42_Unit_Delay1 n_em_in /end LOC_MEASUREMENT /end FUNCTION
/begin FUNCTION Run_SFHC29_cDelayNVM_ "" /begin DEF_CHARACTERISTIC T_VNVMNDK0_HAS /end DEF_CHARACTERISTIC /begin OUT_MEASUREMENT SFHC29_out_ /end OUT_MEASUREMENT /begin LOC_MEASUREMENT SFHC45_Unit_Delay1 n_vm_in /end LOC_MEASUREMENT /end FUNCTION
/begin FUNCTION Run_SFHC47_cPt1nseciae "" /begin OUT_MEASUREMENT SFHC47_x_ /end OUT_MEASUREMENT /begin LOC_MEASUREMENT SFHC47_Unit_Delay2 n_sec_iae_mod /end LOC_MEASUREMENT /end FUNCTION
/begin FUNCTION Run_SFHC56_cTi__tatus_Schaltung "" /begin DEF_CHARACTERISTIC T_VSCHALTUNGAKTIV_HAS /end DEF_CHARACTERISTIC /begin OUT_MEASUREMENT SFHC56_isActive_ SFHC56_t_left_ /end OUT_MEASUREMENT /begin LOC_MEASUREMENT SFHC56_Unit_Delay /end LOC_MEASUREMENT /end FUNCTION
/begin FUNCTION Run_SFHC59_cDT1MgWunsch "" /begin DEF_CHARACTERISTIC FK_MGWUNSCHFPW XP_MAX /end DEF_CHARACTERISTIC /begin OUT_MEASUREMENT SFHC59_x_filter_ SFHC59_xp_ /end OUT_MEASUREMENT /begin LOC_MEASUREMENT SFHC62_Unit_Delay2 m_wunsch_fpw_in /end LOC_MEASUREMENT /end FUNCTION
/begin FUNCTION Run_SFHC60_cDT1MgWunschHST "" /begin DEF_CHARACTERISTIC FK_MGWUNSCHFPW XP_MAX /end DEF_CHARACTERISTIC /begin OUT_MEASUREMENT SFHC60_x_filter_ SFHC60_xp_ /end OUT_MEASUREMENT /begin LOC_MEASUREMENT SFHC65_Unit_Delay2 m_wunsch_fpw_hst_in /end LOC_MEASUREMENT /end FUNCTION
/begin FUNCTION Run_SFHC61_cPT1MWunsch "" /begin DEF_CHARACTERISTIC MPT_MWUNSCHFPWHST /end DEF_CHARACTERISTIC /begin OUT_MEASUREMENT SFHC61_x_ /end OUT_MEASUREMENT /begin LOC_MEASUREMENT SFHC61_Unit_Delay2 m_wunsch_fpw_hst_in /end LOC_MEASUREMENT /end FUNCTION
/begin FUNCTION Run_SFHC82_cTimer_kl50_ein_has "" /begin DEF_CHARACTERISTIC T_VNMINPSYSEM_KL50_HAS /end DEF_CHARACTERISTIC /begin OUT_MEASUREMENT SFHC82_isActive_ SFHC82_t_left_ /end OUT_MEASUREMENT /begin LOC_MEASUREMENT SFHC82_Unit_Delay /end LOC_MEASUREMENT /end FUNCTION
/begin FUNCTION Run_SFHC92_cLi__adient_NMinPsys "" /begin DEF_CHARACTERISTIC NG_MINPSYSEMHASMAX_HAS NG_MINPSYSEMHASMIN_HAS /end DEF_CHARACTERISTIC /begin OUT_MEASUREMENT SFHC92_out_ /end OUT_MEASUREMENT /begin LOC_MEASUREMENT SFHC92_Unit_Delay n_min_psys_em_has_ngbegr /end LOC_MEASUREMENT /end FUNCTION
/begin FUNCTION Run_SFHC93_cPT1_NMinPsys_1 "" /begin DEF_CHARACTERISTIC FK_NMINPSYSEM_1_HAS /end DEF_CHARACTERISTIC /begin OUT_MEASUREMENT SFHC93_x2_ /end OUT_MEASUREMENT /begin LOC_MEASUREMENT SFHC92_out_ SFHC93_Unit_Delay2 /end LOC_MEASUREMENT /end FUNCTION
/begin FUNCTION Run_SFHC94_cPT1_NMinPsys_2 "" /begin DEF_CHARACTERISTIC FK_NMINPSYSEM_2_HAS /end DEF_CHARACTERISTIC /begin OUT_MEASUREMENT SFHC94_x2_ /end OUT_MEASUREMENT /begin LOC_MEASUREMENT SFHC93_x2_ SFHC94_Unit_Delay2 /end LOC_MEASUREMENT /end FUNCTION
/begin FUNCTION Run_SFOp_ABK105_cTimer_trigger_ "" /begin DEF_CHARACTERISTIC T_MAX_SAK_ABK /end DEF_CHARACTERISTIC /begin OUT_MEASUREMENT SFOp_ABK105_isActive_ SFOp_ABK105_t_left_ /end OUT_MEASUREMENT /begin LOC_MEASUREMENT SFOp_ABK105_Unit_Delay /end LOC_MEASUREMENT /end FUNCTION
/begin FUNCTION Run_SFOp_ABK69__radient_MSollK0 "" /begin OUT_MEASUREMENT SFOp_ABK69_out_ /end OUT_MEASUREMENT /begin LOC_MEASUREMENT SFOp_ABK69_Unit_Delay /end LOC_MEASUREMENT /end FUNCTION
/begin FUNCTION Run_SFOp_ABK70_cTimer_trigger_ "" /begin DEF_CHARACTERISTIC T_MAX_KOE_ABK /end DEF_CHARACTERISTIC /begin OUT_MEASUREMENT SFOp_ABK70_isActive_ SFOp_ABK70_t_left_ /end OUT_MEASUREMENT /begin LOC_MEASUREMENT SFOp_ABK70_Unit_Delay /end LOC_MEASUREMENT /end FUNCTION
/begin FUNCTION Run_SFOp_ABK81_cTimer_trigger_ "" /begin DEF_CHARACTERISTIC T_MAX_KSA_ABK /end DEF_CHARACTERISTIC /begin OUT_MEASUREMENT SFOp_ABK81_isActive_ SFOp_ABK81_t_left_ /end OUT_MEASUREMENT /begin LOC_MEASUREMENT SFOp_ABK81_Unit_Delay /end LOC_MEASUREMENT /end FUNCTION
/begin FUNCTION Run_SFOp_ABK90_cTimer_trigger_ "" /begin DEF_CHARACTERISTIC T_MAX_LAU_ABK /end DEF_CHARACTERISTIC /begin OUT_MEASUREMENT SFOp_ABK90_isActive_ SFOp_ABK90_t_left_ /end OUT_MEASUREMENT /begin LOC_MEASUREMENT SFOp_ABK90_Unit_Delay /end LOC_MEASUREMENT /end FUNCTION
/begin FUNCTION Run_SFOp_ABK91__t_MK0modhas_abk "" /begin DEF_CHARACTERISTIC MG_K0MODHAS_LAU_ABK /end DEF_CHARACTERISTIC /begin OUT_MEASUREMENT SFOp_ABK91_out_ /end OUT_MEASUREMENT /begin LOC_MEASUREMENT SFOp_ABK91_Unit_Delay /end LOC_MEASUREMENT /end FUNCTION
/begin FUNCTION Run_SFOp_ABK92__vzk0oeffnen_abk "" /begin DEF_CHARACTERISTIC T_VZK0OEFFNEN_LAU_ABK /end DEF_CHARACTERISTIC /begin OUT_MEASUREMENT SFOp_ABK92_isActive_ SFOp_ABK92_t_left_ /end OUT_MEASUREMENT /begin LOC_MEASUREMENT SFOp_ABK92_Unit_Delay /end LOC_MEASUREMENT /end FUNCTION
/begin FUNCTION Run_SFOp_ABO28___m_stoer_em_abo "" /begin OUT_MEASUREMENT SFOp_ABO28_x2_ /end OUT_MEASUREMENT /begin LOC_MEASUREMENT SFOp_ABO28_Unit_Delay2 /end LOC_MEASUREMENT /end FUNCTION
/begin FUNCTION Run_SFOp_ABO29__m_stoer_em_abo1 "" /begin OUT_MEASUREMENT SFOp_ABO29_x2_ /end OUT_MEASUREMENT /begin LOC_MEASUREMENT SFOp_ABO28_x2_ SFOp_ABO29_Unit_Delay2 /end LOC_MEASUREMENT /end FUNCTION
/begin FUNCTION Run_SFOp_ABO30__toerk0emfil_abo "" /begin OUT_MEASUREMENT SFOp_ABO30_isActive_ SFOp_ABO30_t_left_ /end OUT_MEASUREMENT /begin LOC_MEASUREMENT SFOp_ABO30_Unit_Delay /end LOC_MEASUREMENT /end FUNCTION
/begin FUNCTION Run_SFOp_ABO49__sollemaktiv_ans "" /begin DEF_CHARACTERISTIC T_MSOLLEMAKTIV_ABO /end DEF_CHARACTERISTIC /begin OUT_MEASUREMENT SFOp_ABO49_isActive_ SFOp_ABO49_t_left_ /end OUT_MEASUREMENT /begin LOC_MEASUREMENT SFOp_ABO49_Unit_Delay /end LOC_MEASUREMENT /end FUNCTION
/begin FUNCTION Run_SFOp_ABO65_cTimer_T1MAX_ABO "" /begin DEF_CHARACTERISTIC T_MAX_AND_ABO /end DEF_CHARACTERISTIC /begin OUT_MEASUREMENT SFOp_ABO65_isActive_ SFOp_ABO65_t_left_ /end OUT_MEASUREMENT /begin LOC_MEASUREMENT SFOp_ABO65_Unit_Delay /end LOC_MEASUREMENT /end FUNCTION
/begin FUNCTION Run_SFOp_ABO71__ent_msollk0_kon "" /begin OUT_MEASUREMENT SFOp_ABO71_out_ /end OUT_MEASUREMENT /begin LOC_MEASUREMENT SFOp_ABO71_Unit_Delay /end LOC_MEASUREMENT /end FUNCTION
/begin FUNCTION Run_SFOp_ABO72__0startrampe_abo "" /begin DEF_CHARACTERISTIC T_MK0STARTRAMPE_AND_ABO /end DEF_CHARACTERISTIC /begin OUT_MEASUREMENT SFOp_ABO72_isActive_ SFOp_ABO72_t_left_ /end OUT_MEASUREMENT /begin LOC_MEASUREMENT SFOp_ABO72_Unit_Delay /end LOC_MEASUREMENT /end FUNCTION
/begin FUNCTION Run_SFOp_ABO85__x_k0oeffnen_abo "" /begin DEF_CHARACTERISTIC T_MAX_KOE_ABO /end DEF_CHARACTERISTIC /begin OUT_MEASUREMENT SFOp_ABO85_isActive_ SFOp_ABO85_t_left_ /end OUT_MEASUREMENT /begin LOC_MEASUREMENT SFOp_ABO85_Unit_Delay /end LOC_MEASUREMENT /end FUNCTION
/begin FUNCTION Run_SFOp_ABO88__ent_msollk0_abo "" /begin OUT_MEASUREMENT SFOp_ABO88_out_ /end OUT_MEASUREMENT /begin LOC_MEASUREMENT SFOp_ABO88_Unit_Delay /end LOC_MEASUREMENT /end FUNCTION
/begin FUNCTION Run_SFOp_ABST1__cTimer_trigge_a "" /begin DEF_CHARACTERISTIC T_MAX_LAU_ABST /end DEF_CHARACTERISTIC /begin OUT_MEASUREMENT SFOp_ABST142_isActive_ SFOp_ABST142_t_left_ /end OUT_MEASUREMENT /begin LOC_MEASUREMENT SFOp_ABST142_Unit_Delay /end LOC_MEASUREMENT /end FUNCTION
/begin FUNCTION Run_SFOp_ABST1__cTimer_trigge_b "" /begin DEF_CHARACTERISTIC T_MAX_SAK_ABST /end DEF_CHARACTERISTIC /begin OUT_MEASUREMENT SFOp_ABST157_isActive_ SFOp_ABST157_t_left_ /end OUT_MEASUREMENT /begin LOC_MEASUREMENT SFOp_ABST157_Unit_Delay /end LOC_MEASUREMENT /end FUNCTION
/begin FUNCTION Run_SFOp_ABST1__cTimer_trigger_ "" /begin DEF_CHARACTERISTIC T_VK0OEFFNEN_LAU_ABST /end DEF_CHARACTERISTIC /begin OUT_MEASUREMENT SFOp_ABST144_isActive_ SFOp_ABST144_t_left_ /end OUT_MEASUREMENT /begin LOC_MEASUREMENT SFOp_ABST144_Unit_Delay /end LOC_MEASUREMENT /end FUNCTION
/begin FUNCTION Run_SFOp_ABST1__dient_MK0modhas "" /begin OUT_MEASUREMENT SFOp_ABST143_out_ /end OUT_MEASUREMENT /begin LOC_MEASUREMENT SFOp_ABST143_Unit_Delay /end LOC_MEASUREMENT /end FUNCTION
/begin FUNCTION Run_SFOp_ABST1__er_VM_abstell_a "" /begin DEF_CHARACTERISTIC T_MAX_KOE_ABST /end DEF_CHARACTERISTIC /begin OUT_MEASUREMENT SFOp_ABST121_isActive_ SFOp_ABST121_t_left_ /end OUT_MEASUREMENT /begin LOC_MEASUREMENT SFOp_ABST121_Unit_Delay /end LOC_MEASUREMENT /end FUNCTION
/begin FUNCTION Run_SFOp_ABST1__er_VM_abstellen "" /begin DEF_CHARACTERISTIC T_MAX_GAB_ABST /end DEF_CHARACTERISTIC /begin OUT_MEASUREMENT SFOp_ABST109_isActive_ SFOp_ABST109_t_left_ /end OUT_MEASUREMENT /begin LOC_MEASUREMENT SFOp_ABST109_Unit_Delay /end LOC_MEASUREMENT /end FUNCTION
/begin FUNCTION Run_SFOp_ABST1__iessen_Abbruch_ "" /begin DEF_CHARACTERISTIC T_MAX_KSA_ABST /end DEF_CHARACTERISTIC /begin OUT_MEASUREMENT SFOp_ABST132_isActive_ SFOp_ABST132_t_left_ /end OUT_MEASUREMENT /begin LOC_MEASUREMENT SFOp_ABST132_Unit_Delay /end LOC_MEASUREMENT /end FUNCTION
/begin FUNCTION Run_SFOp_ABST1__radient_MSoll_a "" /begin OUT_MEASUREMENT SFOp_ABST120_out_ /end OUT_MEASUREMENT /begin LOC_MEASUREMENT SFOp_ABST120_Unit_Delay /end LOC_MEASUREMENT /end FUNCTION
/begin RECORD_LAYOUT AblGLKWub_M FNC_VALUES 1 UBYTE COLUMN_DIR DIRECT /end RECORD_LAYOUT
/begin RECORD_LAYOUT FLOAT32_IEEE_COL_DIRECT_S6_S3 FNC_VALUES 1 FLOAT32_IEEE COLUMN_DIR DIRECT /end RECORD_LAYOUT
/begin RECORD_LAYOUT FLOAT32_IEEE_X_INCR_DIRECT_S6_S3 AXIS_PTS_X 1 FLOAT32_IEEE INDEX_INCR DIRECT /end RECORD_LAYOUT
/begin RECORD_LAYOUT UBYTE_COL_DIRECT_S6_S3 FNC_VALUES 1 UBYTE COLUMN_DIR DIRECT /end RECORD_LAYOUT
/begin RECORD_LAYOUT ULONG_COL_DIRECT_S6_S3 FNC_VALUES 1 ULONG COLUMN_DIR DIRECT /end RECORD_LAYOUT
/begin RECORD_LAYOUT UWORD_COL_DIRECT_S6_S3 FNC_VALUES 1 UWORD COLUMN_DIR DIRECT /end RECORD_LAYOUT
/begin RECORD_LAYOUT ZF_kf_si16_S5_S3 FNC_VALUES 5 SWORD ROW_DIR DIRECT AXIS_PTS_X 3 SWORD INDEX_INCR DIRECT AXIS_PTS_Y 4 SWORD INDEX_INCR DIRECT NO_AXIS_PTS_X 1 ULONG NO_AXIS_PTS_Y 2 ULONG /end RECORD_LAYOUT
/begin RECORD_LAYOUT ZF_kf_ui16_S5_S3 FNC_VALUES 5 UWORD ROW_DIR DIRECT AXIS_PTS_X 3 UWORD INDEX_INCR DIRECT AXIS_PTS_Y 4 UWORD INDEX_INCR DIRECT NO_AXIS_PTS_X 1 ULONG NO_AXIS_PTS_Y 2 ULONG /end RECORD_LAYOUT
/begin RECORD_LAYOUT ZF_kl_si16_S5_S3 FNC_VALUES 3 SWORD COLUMN_DIR DIRECT AXIS_PTS_X 2 SWORD INDEX_INCR DIRECT NO_AXIS_PTS_X 1 ULONG /end RECORD_LAYOUT
/begin RECORD_LAYOUT ZF_kl_ui16_S5_S3 FNC_VALUES 3 UWORD COLUMN_DIR DIRECT AXIS_PTS_X 2 UWORD INDEX_INCR DIRECT NO_AXIS_PTS_X 1 ULONG /end RECORD_LAYOUT
/begin RECORD_LAYOUT ZF_kl_ui8_S5_S3 FNC_VALUES 3 UBYTE COLUMN_DIR DIRECT AXIS_PTS_X 2 UBYTE INDEX_INCR DIRECT NO_AXIS_PTS_X 1 ULONG /end RECORD_LAYOUT
/begin RECORD_LAYOUT ZF_kw_si16_S5_S3 FNC_VALUES 1 SWORD COLUMN_DIR DIRECT /end RECORD_LAYOUT
/begin RECORD_LAYOUT ZF_kw_ui16_S5_S3 FNC_VALUES 1 UWORD COLUMN_DIR DIRECT /end RECORD_LAYOUT
/begin RECORD_LAYOUT ZF_kw_ui8_S5_S3 FNC_VALUES 1 UBYTE COLUMN_DIR DIRECT /end RECORD_LAYOUT
/begin RECORD_LAYOUT ZF_tab_ui16_S5_S3 FNC_VALUES 2 UWORD COLUMN_DIR DIRECT NO_AXIS_PTS_X 1 ULONG /end RECORD_LAYOUT
/end MODULE
/end PROJECT
