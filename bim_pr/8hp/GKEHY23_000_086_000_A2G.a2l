ASAP2_VERSION 1 51
/begin PROJECT ZHBC8600 "Gen2_BMW_System_Supplier_Lib"
/begin MODULE CPP ""
/begin MOD_COMMON "" BYTE_ORDER MSB_FIRST ALIGNMENT_BYTE 1 ALIGNMENT_WORD 2 ALIGNMENT_LONG 4 ALIGNMENT_FLOAT32_IEEE 4 ALIGNMENT_FLOAT64_IEEE 1 /end MOD_COMMON
/begin COMPU_METHOD EH_STANDARD_S4_S3 "int = ((phys * 1) / 1) - (0) -" RAT_FUNC "%1.0" "-" COEFFS 0 1 0 0 0 1 /end COMPU_METHOD
/begin COMPU_METHOD SAB_P_2396KPA100_M2444_S2_S3 "int = ((phys * 100) / 2396) - (-102) kPa" RAT_FUNC "%4.3" "kPa" COEFFS 0 0.0417362270451 102 0 0 1 /end COMPU_METHOD
/begin COMPU_METHOD SAB_P_2685MMHG1000_914P10_S2_S3 "int = ((phys * 1000) / 2685) - (33.8919925512104) mmHg" RAT_FUNC "%4.3" "mmHg" COEFFS 0 0.372439478585 -33.8919925512 0 0 1 /end COMPU_METHOD
/begin COMPU_METHOD SAB_P_2HPA_P600_S2_S3 "int = ((phys * 1) / 2) - (300) hPa" RAT_FUNC "%1.0" "hPa" COEFFS 0 0.5 -300 0 0 1 /end COMPU_METHOD
/begin COMPU_METHOD SAB_P_36MBAR10_P300_S2_S3 "int = ((phys * 10) / 36) - (83.3333333333333) mbar" RAT_FUNC "%4.3" "mbar" COEFFS 0 0.277777777778 -83.3333333333 0 0 1 /end COMPU_METHOD
/begin COMPU_METHOD SAB_P_3BAR10_M100_S2_S3 "int = ((phys * 10) / 3) - (-100) bar" RAT_FUNC "%4.3" "bar" COEFFS 0 3.33333333333 100 0 0 1 /end COMPU_METHOD
/begin COMPU_METHOD SAB_P_3BAR10_M30_S2_S3 "int = ((phys * 10) / 3) - (-100) bar" RAT_FUNC "%4.3" "bar" COEFFS 0 3.33333333333 100 0 0 1 /end COMPU_METHOD
/begin COMPU_METHOD SAB_P_3BAR10_S2_S3 "int = ((phys * 10) / 3) - (0) bar" RAT_FUNC "%4.3" "bar" COEFFS 0 3.33333333333 0 0 0 1 /end COMPU_METHOD
/begin COMPU_METHOD SAB_P_5BAR10_S2_S3 "int = ((phys * 10) / 5) - (0) bar" RAT_FUNC "%4.3" "bar" COEFFS 0 2 0 0 0 1 /end COMPU_METHOD
/begin COMPU_METHOD SAB_P_781MBAR100_S2_S3 "int = ((phys * 100) / 781) - (0) mbar" RAT_FUNC "%6.5" "mbar" COEFFS 0 0.128040973111 0 0 0 1 /end COMPU_METHOD
/begin COMPU_METHOD SAB_P_8KPA_S2_S3 "int = ((phys * 1) / 8) - (0) kPa" RAT_FUNC "%4.3" "kPa" COEFFS 0 0.125 0 0 0 1 /end COMPU_METHOD
/begin COMPU_METHOD SAB_P_BAR100_S2_S3 "int = ((phys * 100) / 1) - (0) bar" RAT_FUNC "%7.6" "bar" COEFFS 0 100 0 0 0 1 /end COMPU_METHOD
/begin COMPU_METHOD SAB_P_BAR10_S2_S3 "int = ((phys * 10) / 1) - (0) bar" RAT_FUNC "%4.3" "bar" COEFFS 0 10 0 0 0 1 /end COMPU_METHOD
/begin COMPU_METHOD SAB_P_BAR128_S2_S3 "int = ((phys * 128) / 1) - (0) bar" RAT_FUNC "%7.6" "bar" COEFFS 0 128 0 0 0 1 /end COMPU_METHOD
/begin COMPU_METHOD SAB_P_BAR4_S2_S3 "int = ((phys * 4) / 1) - (0) bar" RAT_FUNC "%4.3" "bar" COEFFS 0 4 0 0 0 1 /end COMPU_METHOD
/begin COMPU_METHOD SAB_P_BAR5_S2_S3 "int = ((phys * 5) / 1) - (0) bar" RAT_FUNC "%4.3" "bar" COEFFS 0 5 0 0 0 1 /end COMPU_METHOD
/begin COMPU_METHOD SAB_P_BAR_100KPA2396_P102_S2_S3 "int = ((phys * 100) / 2396) - (-102) kPa" RAT_FUNC "%4.3" "kPa" COEFFS 0 0.0417362270451 102 0 0 1 /end COMPU_METHOD
/begin COMPU_METHOD SAB_P_BAR_1KPA_S2_S3 "int = ((phys * 1) / 1) - (0) kPa" RAT_FUNC "%1.0" "kPa" COEFFS 0 1 0 0 0 1 /end COMPU_METHOD
/begin COMPU_METHOD SAB_P_BARO_10HPA_P50_S2_S3 "int = ((phys * 1) / 10) - (50) hPa" RAT_FUNC "%4.3" "hPa" COEFFS 0 0.1 -50 0 0 1 /end COMPU_METHOD
/begin COMPU_METHOD SAB_P_BARO_1MBAR_S2_S3 "int = ((phys * 1) / 1) - (0) mbar" RAT_FUNC "%1.0" "mbar" COEFFS 0 1 0 0 0 1 /end COMPU_METHOD
/begin COMPU_METHOD SAB_P_BARO_5HPA_S2_S3 "int = ((phys * 1) / 5) - (0) hPa" RAT_FUNC "%4.3" "hPa" COEFFS 0 0.2 0 0 0 1 /end COMPU_METHOD
/begin COMPU_METHOD SAB_P_BARO_5MBAR_S2_S3 "int = ((phys * 1) / 5) - (0) mbar" RAT_FUNC "%4.3" "mbar" COEFFS 0 0.2 0 0 0 1 /end COMPU_METHOD
/begin COMPU_METHOD SAB_P_MMHG10_S2_S3 "int = ((phys * 10) / 1) - (0) mmHg" RAT_FUNC "%4.3" "mmHg" COEFFS 0 10 0 0 0 1 /end COMPU_METHOD
/begin COMPU_METHOD SAB_PHI_2GRAD_S2_S3 "int = ((phys * 1) / 2) - (0) grad" RAT_FUNC "%4.3" "grad" COEFFS 0 0.5 0 0 0 1 /end COMPU_METHOD
/begin COMPU_METHOD SAB_PHI_4375GRAD100000_S2_S3 "int = ((phys * 100000) / 4375) - (0) grad" RAT_FUNC "%4.3" "grad" COEFFS 0 22.8571428571 0 0 0 1 /end COMPU_METHOD
/begin MEASUREMENT ZFEH_EepromData.ydiMemory_xau16[16].amb_cond.ambient_condition[0][17] "ambient condition shot [0 .. 2-1] with 25 data bytes [0 .. 25-1] for the error code stored in this error memory slot" UBYTE EH_STANDARD_S4_S3 1 100 0 255 ECU_ADDRESS 0xFFF82769 DISPLAY_IDENTIFIER ambient_condition[0][17].amb_cond.ydiMemory_xau16[16].ZFEH_EepromData /end MEASUREMENT
/begin MEASUREMENT ZFEH_EepromData.ydiMemory_xau16[16].amb_cond.ambient_condition[0][18] "ambient condition shot [0 .. 2-1] with 25 data bytes [0 .. 25-1] for the error code stored in this error memory slot" UBYTE EH_STANDARD_S4_S3 1 100 0 255 ECU_ADDRESS 0xFFF8276A DISPLAY_IDENTIFIER ambient_condition[0][18].amb_cond.ydiMemory_xau16[16].ZFEH_EepromData /end MEASUREMENT
/begin MEASUREMENT ZFEH_EepromData.ydiMemory_xau16[16].amb_cond.ambient_condition[0][19] "ambient condition shot [0 .. 2-1] with 25 data bytes [0 .. 25-1] for the error code stored in this error memory slot" UBYTE EH_STANDARD_S4_S3 1 100 0 255 ECU_ADDRESS 0xFFF8276B DISPLAY_IDENTIFIER ambient_condition[0][19].amb_cond.ydiMemory_xau16[16].ZFEH_EepromData /end MEASUREMENT
/begin MEASUREMENT ZFEH_EepromData.ydiMemory_xau16[16].amb_cond.ambient_condition[0][1] "ambient condition shot [0 .. 2-1] with 25 data bytes [0 .. 25-1] for the error code stored in this error memory slot" UBYTE EH_STANDARD_S4_S3 1 100 0 255 ECU_ADDRESS 0xFFF82759 DISPLAY_IDENTIFIER ambient_condition[0][1].amb_cond.ydiMemory_xau16[16].ZFEH_EepromData /end MEASUREMENT
/begin MEASUREMENT ZFEH_EepromData.ydiMemory_xau16[16].amb_cond.ambient_condition[0][20] "ambient condition shot [0 .. 2-1] with 25 data bytes [0 .. 25-1] for the error code stored in this error memory slot" UBYTE EH_STANDARD_S4_S3 1 100 0 255 ECU_ADDRESS 0xFFF8276C DISPLAY_IDENTIFIER ambient_condition[0][20].amb_cond.ydiMemory_xau16[16].ZFEH_EepromData /end MEASUREMENT
/begin MEASUREMENT ZFEH_EepromData.ydiMemory_xau16[16].amb_cond.ambient_condition[0][21] "ambient condition shot [0 .. 2-1] with 25 data bytes [0 .. 25-1] for the error code stored in this error memory slot" UBYTE EH_STANDARD_S4_S3 1 100 0 255 ECU_ADDRESS 0xFFF8276D DISPLAY_IDENTIFIER ambient_condition[0][21].amb_cond.ydiMemory_xau16[16].ZFEH_EepromData /end MEASUREMENT
/begin MEASUREMENT ZFEH_EepromData.ydiMemory_xau16[16].amb_cond.ambient_condition[0][22] "ambient condition shot [0 .. 2-1] with 25 data bytes [0 .. 25-1] for the error code stored in this error memory slot" UBYTE EH_STANDARD_S4_S3 1 100 0 255 ECU_ADDRESS 0xFFF8276E DISPLAY_IDENTIFIER ambient_condition[0][22].amb_cond.ydiMemory_xau16[16].ZFEH_EepromData /end MEASUREMENT
/begin MEASUREMENT ZFEH_EepromData.ydiMemory_xau16[16].amb_cond.ambient_condition[0][23] "ambient condition shot [0 .. 2-1] with 25 data bytes [0 .. 25-1] for the error code stored in this error memory slot" UBYTE EH_STANDARD_S4_S3 1 100 0 255 ECU_ADDRESS 0xFFF8276F DISPLAY_IDENTIFIER ambient_condition[0][23].amb_cond.ydiMemory_xau16[16].ZFEH_EepromData /end MEASUREMENT
/begin MEASUREMENT ZFEH_EepromData.ydiMemory_xau16[16].amb_cond.ambient_condition[0][24] "ambient condition shot [0 .. 2-1] with 25 data bytes [0 .. 25-1] for the error code stored in this error memory slot" UBYTE EH_STANDARD_S4_S3 1 100 0 255 ECU_ADDRESS 0xFFF82770 DISPLAY_IDENTIFIER ambient_condition[0][24].amb_cond.ydiMemory_xau16[16].ZFEH_EepromData /end MEASUREMENT
/begin MEASUREMENT ZFEH_EepromData.ydiMemory_xau16[16].amb_cond.ambient_condition[0][2] "ambient condition shot [0 .. 2-1] with 25 data bytes [0 .. 25-1] for the error code stored in this error memory slot" UBYTE EH_STANDARD_S4_S3 1 100 0 255 ECU_ADDRESS 0xFFF8275A DISPLAY_IDENTIFIER ambient_condition[0][2].amb_cond.ydiMemory_xau16[16].ZFEH_EepromData /end MEASUREMENT
/begin MEASUREMENT ZFEH_EepromData.ydiMemory_xau16[16].amb_cond.ambient_condition[0][3] "ambient condition shot [0 .. 2-1] with 25 data bytes [0 .. 25-1] for the error code stored in this error memory slot" UBYTE EH_STANDARD_S4_S3 1 100 0 255 ECU_ADDRESS 0xFFF8275B DISPLAY_IDENTIFIER ambient_condition[0][3].amb_cond.ydiMemory_xau16[16].ZFEH_EepromData /end MEASUREMENT
/begin MEASUREMENT ZFEH_EepromData.ydiMemory_xau16[16].amb_cond.ambient_condition[0][4] "ambient condition shot [0 .. 2-1] with 25 data bytes [0 .. 25-1] for the error code stored in this error memory slot" UBYTE EH_STANDARD_S4_S3 1 100 0 255 ECU_ADDRESS 0xFFF8275C DISPLAY_IDENTIFIER ambient_condition[0][4].amb_cond.ydiMemory_xau16[16].ZFEH_EepromData /end MEASUREMENT
/begin MEASUREMENT ZFEH_EepromData.ydiMemory_xau16[16].amb_cond.ambient_condition[0][5] "ambient condition shot [0 .. 2-1] with 25 data bytes [0 .. 25-1] for the error code stored in this error memory slot" UBYTE EH_STANDARD_S4_S3 1 100 0 255 ECU_ADDRESS 0xFFF8275D DISPLAY_IDENTIFIER ambient_condition[0][5].amb_cond.ydiMemory_xau16[16].ZFEH_EepromData /end MEASUREMENT
/begin MEASUREMENT ZFEH_EepromData.ydiMemory_xau16[16].amb_cond.ambient_condition[0][6] "ambient condition shot [0 .. 2-1] with 25 data bytes [0 .. 25-1] for the error code stored in this error memory slot" UBYTE EH_STANDARD_S4_S3 1 100 0 255 ECU_ADDRESS 0xFFF8275E DISPLAY_IDENTIFIER ambient_condition[0][6].amb_cond.ydiMemory_xau16[16].ZFEH_EepromData /end MEASUREMENT
/begin MEASUREMENT ZFEH_EepromData.ydiMemory_xau16[16].amb_cond.ambient_condition[0][7] "ambient condition shot [0 .. 2-1] with 25 data bytes [0 .. 25-1] for the error code stored in this error memory slot" UBYTE EH_STANDARD_S4_S3 1 100 0 255 ECU_ADDRESS 0xFFF8275F DISPLAY_IDENTIFIER ambient_condition[0][7].amb_cond.ydiMemory_xau16[16].ZFEH_EepromData /end MEASUREMENT
/begin MEASUREMENT ZFEH_EepromData.ydiMemory_xau16[16].amb_cond.ambient_condition[0][8] "ambient condition shot [0 .. 2-1] with 25 data bytes [0 .. 25-1] for the error code stored in this error memory slot" UBYTE EH_STANDARD_S4_S3 1 100 0 255 ECU_ADDRESS 0xFFF82760 DISPLAY_IDENTIFIER ambient_condition[0][8].amb_cond.ydiMemory_xau16[16].ZFEH_EepromData /end MEASUREMENT
/begin MEASUREMENT ZFEH_EepromData.ydiMemory_xau16[16].amb_cond.ambient_condition[0][9] "ambient condition shot [0 .. 2-1] with 25 data bytes [0 .. 25-1] for the error code stored in this error memory slot" UBYTE EH_STANDARD_S4_S3 1 100 0 255 ECU_ADDRESS 0xFFF82761 DISPLAY_IDENTIFIER ambient_condition[0][9].amb_cond.ydiMemory_xau16[16].ZFEH_EepromData /end MEASUREMENT
/begin MEASUREMENT ZFEH_EepromData.ydiMemory_xau16[16].amb_cond.ambient_condition[1][0] "ambient condition shot [0 .. 2-1] with 25 data bytes [0 .. 25-1] for the error code stored in this error memory slot" UBYTE EH_STANDARD_S4_S3 1 100 0 255 ECU_ADDRESS 0xFFF82771 DISPLAY_IDENTIFIER ambient_condition[1][0].amb_cond.ydiMemory_xau16[16].ZFEH_EepromData /end MEASUREMENT
/begin MEASUREMENT ZFEH_EepromData.ydiMemory_xau16[16].amb_cond.ambient_condition[1][10] "ambient condition shot [0 .. 2-1] with 25 data bytes [0 .. 25-1] for the error code stored in this error memory slot" UBYTE EH_STANDARD_S4_S3 1 100 0 255 ECU_ADDRESS 0xFFF8277B DISPLAY_IDENTIFIER ambient_condition[1][10].amb_cond.ydiMemory_xau16[16].ZFEH_EepromData /end MEASUREMENT
/begin MEASUREMENT ZFEH_EepromData.ydiMemory_xau16[16].amb_cond.ambient_condition[1][11] "ambient condition shot [0 .. 2-1] with 25 data bytes [0 .. 25-1] for the error code stored in this error memory slot" UBYTE EH_STANDARD_S4_S3 1 100 0 255 ECU_ADDRESS 0xFFF8277C DISPLAY_IDENTIFIER ambient_condition[1][11].amb_cond.ydiMemory_xau16[16].ZFEH_EepromData /end MEASUREMENT
/begin MEASUREMENT ZFEH_EepromData.ydiMemory_xau16[16].amb_cond.ambient_condition[1][12] "ambient condition shot [0 .. 2-1] with 25 data bytes [0 .. 25-1] for the error code stored in this error memory slot" UBYTE EH_STANDARD_S4_S3 1 100 0 255 ECU_ADDRESS 0xFFF8277D DISPLAY_IDENTIFIER ambient_condition[1][12].amb_cond.ydiMemory_xau16[16].ZFEH_EepromData /end MEASUREMENT
/begin MEASUREMENT ZFEH_EepromData.ydiMemory_xau16[16].amb_cond.ambient_condition[1][13] "ambient condition shot [0 .. 2-1] with 25 data bytes [0 .. 25-1] for the error code stored in this error memory slot" UBYTE EH_STANDARD_S4_S3 1 100 0 255 ECU_ADDRESS 0xFFF8277E DISPLAY_IDENTIFIER ambient_condition[1][13].amb_cond.ydiMemory_xau16[16].ZFEH_EepromData /end MEASUREMENT
/begin MEASUREMENT ZFEH_EepromData.ydiMemory_xau16[16].amb_cond.ambient_condition[1][14] "ambient condition shot [0 .. 2-1] with 25 data bytes [0 .. 25-1] for the error code stored in this error memory slot" UBYTE EH_STANDARD_S4_S3 1 100 0 255 ECU_ADDRESS 0xFFF8277F DISPLAY_IDENTIFIER ambient_condition[1][14].amb_cond.ydiMemory_xau16[16].ZFEH_EepromData /end MEASUREMENT
/begin MEASUREMENT ZFEH_EepromData.ydiMemory_xau16[16].amb_cond.ambient_condition[1][15] "ambient condition shot [0 .. 2-1] with 25 data bytes [0 .. 25-1] for the error code stored in this error memory slot" UBYTE EH_STANDARD_S4_S3 1 100 0 255 ECU_ADDRESS 0xFFF82780 DISPLAY_IDENTIFIER ambient_condition[1][15].amb_cond.ydiMemory_xau16[16].ZFEH_EepromData /end MEASUREMENT
/begin MEASUREMENT ZFEH_EepromData.ydiMemory_xau16[16].amb_cond.ambient_condition[1][16] "ambient condition shot [0 .. 2-1] with 25 data bytes [0 .. 25-1] for the error code stored in this error memory slot" UBYTE EH_STANDARD_S4_S3 1 100 0 255 ECU_ADDRESS 0xFFF82781 DISPLAY_IDENTIFIER ambient_condition[1][16].amb_cond.ydiMemory_xau16[16].ZFEH_EepromData /end MEASUREMENT
/begin MEASUREMENT ZFEH_EepromData.ydiMemory_xau16[16].amb_cond.ambient_condition[1][17] "ambient condition shot [0 .. 2-1] with 25 data bytes [0 .. 25-1] for the error code stored in this error memory slot" UBYTE EH_STANDARD_S4_S3 1 100 0 255 ECU_ADDRESS 0xFFF82782 DISPLAY_IDENTIFIER ambient_condition[1][17].amb_cond.ydiMemory_xau16[16].ZFEH_EepromData /end MEASUREMENT
/begin MEASUREMENT ZFEH_EepromData.ydiMemory_xau16[16].amb_cond.ambient_condition[1][18] "ambient condition shot [0 .. 2-1] with 25 data bytes [0 .. 25-1] for the error code stored in this error memory slot" UBYTE EH_STANDARD_S4_S3 1 100 0 255 ECU_ADDRESS 0xFFF82783 DISPLAY_IDENTIFIER ambient_condition[1][18].amb_cond.ydiMemory_xau16[16].ZFEH_EepromData /end MEASUREMENT
/begin MEASUREMENT ZFEH_EepromData.ydiMemory_xau16[16].amb_cond.ambient_condition[1][19] "ambient condition shot [0 .. 2-1] with 25 data bytes [0 .. 25-1] for the error code stored in this error memory slot" UBYTE EH_STANDARD_S4_S3 1 100 0 255 ECU_ADDRESS 0xFFF82784 DISPLAY_IDENTIFIER ambient_condition[1][19].amb_cond.ydiMemory_xau16[16].ZFEH_EepromData /end MEASUREMENT
/begin MEASUREMENT ZFEH_EepromData.ydiMemory_xau16[16].amb_cond.ambient_condition[1][1] "ambient condition shot [0 .. 2-1] with 25 data bytes [0 .. 25-1] for the error code stored in this error memory slot" UBYTE EH_STANDARD_S4_S3 1 100 0 255 ECU_ADDRESS 0xFFF82772 DISPLAY_IDENTIFIER ambient_condition[1][1].amb_cond.ydiMemory_xau16[16].ZFEH_EepromData /end MEASUREMENT
/begin MEASUREMENT ZFEH_EepromData.ydiMemory_xau16[16].amb_cond.ambient_condition[1][20] "ambient condition shot [0 .. 2-1] with 25 data bytes [0 .. 25-1] for the error code stored in this error memory slot" UBYTE EH_STANDARD_S4_S3 1 100 0 255 ECU_ADDRESS 0xFFF82785 DISPLAY_IDENTIFIER ambient_condition[1][20].amb_cond.ydiMemory_xau16[16].ZFEH_EepromData /end MEASUREMENT
/begin MEASUREMENT ZFEH_EepromData.ydiMemory_xau16[16].amb_cond.ambient_condition[1][21] "ambient condition shot [0 .. 2-1] with 25 data bytes [0 .. 25-1] for the error code stored in this error memory slot" UBYTE EH_STANDARD_S4_S3 1 100 0 255 ECU_ADDRESS 0xFFF82786 DISPLAY_IDENTIFIER ambient_condition[1][21].amb_cond.ydiMemory_xau16[16].ZFEH_EepromData /end MEASUREMENT
/begin MEASUREMENT ZFEH_EepromData.ydiMemory_xau16[16].amb_cond.ambient_condition[1][22] "ambient condition shot [0 .. 2-1] with 25 data bytes [0 .. 25-1] for the error code stored in this error memory slot" UBYTE EH_STANDARD_S4_S3 1 100 0 255 ECU_ADDRESS 0xFFF82787 DISPLAY_IDENTIFIER ambient_condition[1][22].amb_cond.ydiMemory_xau16[16].ZFEH_EepromData /end MEASUREMENT
/begin MEASUREMENT ZFEH_EepromData.ydiMemory_xau16[16].amb_cond.ambient_condition[1][23] "ambient condition shot [0 .. 2-1] with 25 data bytes [0 .. 25-1] for the error code stored in this error memory slot" UBYTE EH_STANDARD_S4_S3 1 100 0 255 ECU_ADDRESS 0xFFF82788 DISPLAY_IDENTIFIER ambient_condition[1][23].amb_cond.ydiMemory_xau16[16].ZFEH_EepromData /end MEASUREMENT
/begin MEASUREMENT ZFEH_EepromData.ydiMemory_xau16[16].amb_cond.ambient_condition[1][24] "ambient condition shot [0 .. 2-1] with 25 data bytes [0 .. 25-1] for the error code stored in this error memory slot" UBYTE EH_STANDARD_S4_S3 1 100 0 255 ECU_ADDRESS 0xFFF82789 DISPLAY_IDENTIFIER ambient_condition[1][24].amb_cond.ydiMemory_xau16[16].ZFEH_EepromData /end MEASUREMENT
/begin MEASUREMENT ZFEH_EepromData.ydiMemory_xau16[16].amb_cond.ambient_condition[1][2] "ambient condition shot [0 .. 2-1] with 25 data bytes [0 .. 25-1] for the error code stored in this error memory slot" UBYTE EH_STANDARD_S4_S3 1 100 0 255 ECU_ADDRESS 0xFFF82773 DISPLAY_IDENTIFIER ambient_condition[1][2].amb_cond.ydiMemory_xau16[16].ZFEH_EepromData /end MEASUREMENT
/begin MEASUREMENT ZFEH_EepromData.ydiMemory_xau16[16].amb_cond.ambient_condition[1][3] "ambient condition shot [0 .. 2-1] with 25 data bytes [0 .. 25-1] for the error code stored in this error memory slot" UBYTE EH_STANDARD_S4_S3 1 100 0 255 ECU_ADDRESS 0xFFF82774 DISPLAY_IDENTIFIER ambient_condition[1][3].amb_cond.ydiMemory_xau16[16].ZFEH_EepromData /end MEASUREMENT
/begin MEASUREMENT ZFEH_EepromData.ydiMemory_xau16[16].amb_cond.ambient_condition[1][4] "ambient condition shot [0 .. 2-1] with 25 data bytes [0 .. 25-1] for the error code stored in this error memory slot" UBYTE EH_STANDARD_S4_S3 1 100 0 255 ECU_ADDRESS 0xFFF82775 DISPLAY_IDENTIFIER ambient_condition[1][4].amb_cond.ydiMemory_xau16[16].ZFEH_EepromData /end MEASUREMENT
/begin MEASUREMENT ZFEH_EepromData.ydiMemory_xau16[16].amb_cond.ambient_condition[1][5] "ambient condition shot [0 .. 2-1] with 25 data bytes [0 .. 25-1] for the error code stored in this error memory slot" UBYTE EH_STANDARD_S4_S3 1 100 0 255 ECU_ADDRESS 0xFFF82776 DISPLAY_IDENTIFIER ambient_condition[1][5].amb_cond.ydiMemory_xau16[16].ZFEH_EepromData /end MEASUREMENT
/begin MEASUREMENT ZFEH_EepromData.ydiMemory_xau16[16].amb_cond.ambient_condition[1][6] "ambient condition shot [0 .. 2-1] with 25 data bytes [0 .. 25-1] for the error code stored in this error memory slot" UBYTE EH_STANDARD_S4_S3 1 100 0 255 ECU_ADDRESS 0xFFF82777 DISPLAY_IDENTIFIER ambient_condition[1][6].amb_cond.ydiMemory_xau16[16].ZFEH_EepromData /end MEASUREMENT
/begin MEASUREMENT ZFEH_EepromData.ydiMemory_xau16[16].amb_cond.ambient_condition[1][7] "ambient condition shot [0 .. 2-1] with 25 data bytes [0 .. 25-1] for the error code stored in this error memory slot" UBYTE EH_STANDARD_S4_S3 1 100 0 255 ECU_ADDRESS 0xFFF82778 DISPLAY_IDENTIFIER ambient_condition[1][7].amb_cond.ydiMemory_xau16[16].ZFEH_EepromData /end MEASUREMENT
/begin MEASUREMENT ZFEH_EepromData.ydiMemory_xau16[16].amb_cond.ambient_condition[1][8] "ambient condition shot [0 .. 2-1] with 25 data bytes [0 .. 25-1] for the error code stored in this error memory slot" UBYTE EH_STANDARD_S4_S3 1 100 0 255 ECU_ADDRESS 0xFFF82779 DISPLAY_IDENTIFIER ambient_condition[1][8].amb_cond.ydiMemory_xau16[16].ZFEH_EepromData /end MEASUREMENT
/begin MEASUREMENT ZFEH_EepromData.ydiMemory_xau16[16].amb_cond.ambient_condition[1][9] "ambient condition shot [0 .. 2-1] with 25 data bytes [0 .. 25-1] for the error code stored in this error memory slot" UBYTE EH_STANDARD_S4_S3 1 100 0 255 ECU_ADDRESS 0xFFF8277A DISPLAY_IDENTIFIER ambient_condition[1][9].amb_cond.ydiMemory_xau16[16].ZFEH_EepromData /end MEASUREMENT
/begin MEASUREMENT ZFEH_EepromData.ydiMemory_xau16[16].amb_cond.status_of_ambient_conditions[0] "status of ambient condition shot x: 0=invalid 1=valid" UBYTE EH_STANDARD_S4_S3 1 100 0 1 ECU_ADDRESS 0xFFF8278A DISPLAY_IDENTIFIER status_of_ambient_conditions[0].amb_cond.ydiMemory_xau16[16].ZFEH_EepromData /end MEASUREMENT
/begin MEASUREMENT ZFEH_EepromData.ydiMemory_xau16[16].amb_cond.status_of_ambient_conditions[1] "status of ambient condition shot x: 0=invalid 1=valid" UBYTE EH_STANDARD_S4_S3 1 100 0 1 ECU_ADDRESS 0xFFF8278B DISPLAY_IDENTIFIER status_of_ambient_conditions[1].amb_cond.ydiMemory_xau16[16].ZFEH_EepromData /end MEASUREMENT
/begin MEASUREMENT ZFEH_EepromData.ydiMemory_xau16[16].backwards_counter "backwards counter of error code stored in error memory slot" UBYTE EH_STANDARD_S4_S3 1 100 0 255 ECU_ADDRESS 0xFFF8274B DISPLAY_IDENTIFIER backwards_counter.ydiMemory_xau16[16].ZFEH_EepromData /end MEASUREMENT
/begin MEASUREMENT ZFEH_EepromData.ydiMemory_xau16[16].condition_byte "condition byte of error code stored in error memory slot" UBYTE EH_STANDARD_S4_S3 1 100 0 255 ECU_ADDRESS 0xFFF82755 DISPLAY_IDENTIFIER condition_byte.ydiMemory_xau16[16].ZFEH_EepromData /end MEASUREMENT
/begin MEASUREMENT ZFEH_EepromData.ydiMemory_xau16[16].error_code "error code stored in error memory slot" UWORD EH_STANDARD_S4_S3 1 100 0 65535 ECU_ADDRESS 0xFFF82744 DISPLAY_IDENTIFIER error_code.ydiMemory_xau16[16].ZFEH_EepromData /end MEASUREMENT
/begin MEASUREMENT ZFEH_EepromData.ydiMemory_xau16[16].error_type "error type of error code stored in error memory slot" UWORD EH_STANDARD_S4_S3 1 100 0 65535 ECU_ADDRESS 0xFFF82746 DISPLAY_IDENTIFIER error_type.ydiMemory_xau16[16].ZFEH_EepromData /end MEASUREMENT
/begin MEASUREMENT ZFEH_EepromData.ydiMemory_xau16[16].frequency_counter "frequency counter of error code stored in error memory slot" UBYTE EH_STANDARD_S4_S3 1 100 0 255 ECU_ADDRESS 0xFFF8274A DISPLAY_IDENTIFIER frequency_counter.ydiMemory_xau16[16].ZFEH_EepromData /end MEASUREMENT
/begin MEASUREMENT ZFEH_EepromData.ydiMemory_xau16[16].master_time "master time of error code stored in error memory slot" ULONG EH_STANDARD_S4_S3 1 100 0 4294967295 ECU_ADDRESS 0xFFF82750 DISPLAY_IDENTIFIER master_time.ydiMemory_xau16[16].ZFEH_EepromData /end MEASUREMENT
/begin MEASUREMENT ZFEH_EepromData.ydiMemory_xau16[16].obd_driving_cycle_counter "obd driving cycle counter of error code stored in error memory slot" UWORD EH_STANDARD_S4_S3 1 100 0 65535 ECU_ADDRESS 0xFFF82756 DISPLAY_IDENTIFIER obd_driving_cycle_counter.ydiMemory_xau16[16].ZFEH_EepromData /end MEASUREMENT
/begin MEASUREMENT ZFEH_EepromData.ydiMemory_xau16[16].permanent_counter "counter of permanent error codes stored in error memory slot" UBYTE EH_STANDARD_S4_S3 1 100 0 255 ECU_ADDRESS 0xFFF8274C DISPLAY_IDENTIFIER permanent_counter.ydiMemory_xau16[16].ZFEH_EepromData /end MEASUREMENT
/begin MEASUREMENT ZFEH_EepromData.ydiMemory_xau16[16].sequence_counter "sequence counter of error code stored in error memory slot" UBYTE EH_STANDARD_S4_S3 1 100 0 255 ECU_ADDRESS 0xFFF8274D DISPLAY_IDENTIFIER sequence_counter.ydiMemory_xau16[16].ZFEH_EepromData /end MEASUREMENT
/begin MEASUREMENT ZFEH_EepromData.ydiMemory_xau16[16].status_word "status word of error code stored in error memory slot" UWORD EH_STANDARD_S4_S3 1 100 0 65535 ECU_ADDRESS 0xFFF82748 DISPLAY_IDENTIFIER status_word.ydiMemory_xau16[16].ZFEH_EepromData /end MEASUREMENT
/begin MEASUREMENT ZFEH_EepromData.ydiMemory_xau16[17].amb_cond.ambient_condition[0][0] "ambient condition shot [0 .. 2-1] with 25 data bytes [0 .. 25-1] for the error code stored in this error memory slot" UBYTE EH_STANDARD_S4_S3 1 100 0 255 ECU_ADDRESS 0xFFF827A0 DISPLAY_IDENTIFIER ambient_condition[0][0].amb_cond.ydiMemory_xau16[17].ZFEH_EepromData /end MEASUREMENT
/begin MEASUREMENT ZFEH_EepromData.ydiMemory_xau16[17].amb_cond.ambient_condition[0][10] "ambient condition shot [0 .. 2-1] with 25 data bytes [0 .. 25-1] for the error code stored in this error memory slot" UBYTE EH_STANDARD_S4_S3 1 100 0 255 ECU_ADDRESS 0xFFF827AA DISPLAY_IDENTIFIER ambient_condition[0][10].amb_cond.ydiMemory_xau16[17].ZFEH_EepromData /end MEASUREMENT
/begin MEASUREMENT ZFEH_EepromData.ydiMemory_xau16[17].amb_cond.ambient_condition[0][11] "ambient condition shot [0 .. 2-1] with 25 data bytes [0 .. 25-1] for the error code stored in this error memory slot" UBYTE EH_STANDARD_S4_S3 1 100 0 255 ECU_ADDRESS 0xFFF827AB DISPLAY_IDENTIFIER ambient_condition[0][11].amb_cond.ydiMemory_xau16[17].ZFEH_EepromData /end MEASUREMENT
/begin MEASUREMENT ZFEH_EepromData.ydiMemory_xau16[17].amb_cond.ambient_condition[0][12] "ambient condition shot [0 .. 2-1] with 25 data bytes [0 .. 25-1] for the error code stored in this error memory slot" UBYTE EH_STANDARD_S4_S3 1 100 0 255 ECU_ADDRESS 0xFFF827AC DISPLAY_IDENTIFIER ambient_condition[0][12].amb_cond.ydiMemory_xau16[17].ZFEH_EepromData /end MEASUREMENT
/begin MEASUREMENT ZFEH_EepromData.ydiMemory_xau16[17].amb_cond.ambient_condition[0][13] "ambient condition shot [0 .. 2-1] with 25 data bytes [0 .. 25-1] for the error code stored in this error memory slot" UBYTE EH_STANDARD_S4_S3 1 100 0 255 ECU_ADDRESS 0xFFF827AD DISPLAY_IDENTIFIER ambient_condition[0][13].amb_cond.ydiMemory_xau16[17].ZFEH_EepromData /end MEASUREMENT
/begin MEASUREMENT ZFEH_EepromData.ydiMemory_xau16[17].amb_cond.ambient_condition[0][14] "ambient condition shot [0 .. 2-1] with 25 data bytes [0 .. 25-1] for the error code stored in this error memory slot" UBYTE EH_STANDARD_S4_S3 1 100 0 255 ECU_ADDRESS 0xFFF827AE DISPLAY_IDENTIFIER ambient_condition[0][14].amb_cond.ydiMemory_xau16[17].ZFEH_EepromData /end MEASUREMENT
/begin MEASUREMENT ZFEH_EepromData.ydiMemory_xau16[17].amb_cond.ambient_condition[0][15] "ambient condition shot [0 .. 2-1] with 25 data bytes [0 .. 25-1] for the error code stored in this error memory slot" UBYTE EH_STANDARD_S4_S3 1 100 0 255 ECU_ADDRESS 0xFFF827AF DISPLAY_IDENTIFIER ambient_condition[0][15].amb_cond.ydiMemory_xau16[17].ZFEH_EepromData /end MEASUREMENT
/begin MEASUREMENT ZFEH_EepromData.ydiMemory_xau16[17].amb_cond.ambient_condition[0][16] "ambient condition shot [0 .. 2-1] with 25 data bytes [0 .. 25-1] for the error code stored in this error memory slot" UBYTE EH_STANDARD_S4_S3 1 100 0 255 ECU_ADDRESS 0xFFF827B0 DISPLAY_IDENTIFIER ambient_condition[0][16].amb_cond.ydiMemory_xau16[17].ZFEH_EepromData /end MEASUREMENT
/begin MEASUREMENT ZFEH_EepromData.ydiMemory_xau16[17].amb_cond.ambient_condition[0][17] "ambient condition shot [0 .. 2-1] with 25 data bytes [0 .. 25-1] for the error code stored in this error memory slot" UBYTE EH_STANDARD_S4_S3 1 100 0 255 ECU_ADDRESS 0xFFF827B1 DISPLAY_IDENTIFIER ambient_condition[0][17].amb_cond.ydiMemory_xau16[17].ZFEH_EepromData /end MEASUREMENT
/begin MEASUREMENT ZFEH_EepromData.ydiMemory_xau16[17].amb_cond.ambient_condition[0][18] "ambient condition shot [0 .. 2-1] with 25 data bytes [0 .. 25-1] for the error code stored in this error memory slot" UBYTE EH_STANDARD_S4_S3 1 100 0 255 ECU_ADDRESS 0xFFF827B2 DISPLAY_IDENTIFIER ambient_condition[0][18].amb_cond.ydiMemory_xau16[17].ZFEH_EepromData /end MEASUREMENT
/begin MEASUREMENT ZFEH_EepromData.ydiMemory_xau16[17].amb_cond.ambient_condition[0][19] "ambient condition shot [0 .. 2-1] with 25 data bytes [0 .. 25-1] for the error code stored in this error memory slot" UBYTE EH_STANDARD_S4_S3 1 100 0 255 ECU_ADDRESS 0xFFF827B3 DISPLAY_IDENTIFIER ambient_condition[0][19].amb_cond.ydiMemory_xau16[17].ZFEH_EepromData /end MEASUREMENT
/begin MEASUREMENT ZFEH_EepromData.ydiMemory_xau16[17].amb_cond.ambient_condition[0][1] "ambient condition shot [0 .. 2-1] with 25 data bytes [0 .. 25-1] for the error code stored in this error memory slot" UBYTE EH_STANDARD_S4_S3 1 100 0 255 ECU_ADDRESS 0xFFF827A1 DISPLAY_IDENTIFIER ambient_condition[0][1].amb_cond.ydiMemory_xau16[17].ZFEH_EepromData /end MEASUREMENT
/begin MEASUREMENT ZFEH_EepromData.ydiMemory_xau16[17].amb_cond.ambient_condition[0][20] "ambient condition shot [0 .. 2-1] with 25 data bytes [0 .. 25-1] for the error code stored in this error memory slot" UBYTE EH_STANDARD_S4_S3 1 100 0 255 ECU_ADDRESS 0xFFF827B4 DISPLAY_IDENTIFIER ambient_condition[0][20].amb_cond.ydiMemory_xau16[17].ZFEH_EepromData /end MEASUREMENT
/begin MEASUREMENT ZFEH_EepromData.ydiMemory_xau16[17].amb_cond.ambient_condition[0][21] "ambient condition shot [0 .. 2-1] with 25 data bytes [0 .. 25-1] for the error code stored in this error memory slot" UBYTE EH_STANDARD_S4_S3 1 100 0 255 ECU_ADDRESS 0xFFF827B5 DISPLAY_IDENTIFIER ambient_condition[0][21].amb_cond.ydiMemory_xau16[17].ZFEH_EepromData /end MEASUREMENT
/begin MEASUREMENT ZFEH_EepromData.ydiMemory_xau16[17].amb_cond.ambient_condition[0][22] "ambient condition shot [0 .. 2-1] with 25 data bytes [0 .. 25-1] for the error code stored in this error memory slot" UBYTE EH_STANDARD_S4_S3 1 100 0 255 ECU_ADDRESS 0xFFF827B6 DISPLAY_IDENTIFIER ambient_condition[0][22].amb_cond.ydiMemory_xau16[17].ZFEH_EepromData /end MEASUREMENT
/begin MEASUREMENT ZFEH_EepromData.ydiMemory_xau16[17].amb_cond.ambient_condition[0][23] "ambient condition shot [0 .. 2-1] with 25 data bytes [0 .. 25-1] for the error code stored in this error memory slot" UBYTE EH_STANDARD_S4_S3 1 100 0 255 ECU_ADDRESS 0xFFF827B7 DISPLAY_IDENTIFIER ambient_condition[0][23].amb_cond.ydiMemory_xau16[17].ZFEH_EepromData /end MEASUREMENT
/begin MEASUREMENT ZFEH_EepromData.ydiMemory_xau16[17].amb_cond.ambient_condition[0][24] "ambient condition shot [0 .. 2-1] with 25 data bytes [0 .. 25-1] for the error code stored in this error memory slot" UBYTE EH_STANDARD_S4_S3 1 100 0 255 ECU_ADDRESS 0xFFF827B8 DISPLAY_IDENTIFIER ambient_condition[0][24].amb_cond.ydiMemory_xau16[17].ZFEH_EepromData /end MEASUREMENT
/begin MEASUREMENT ZFEH_EepromData.ydiMemory_xau16[17].amb_cond.ambient_condition[0][2] "ambient condition shot [0 .. 2-1] with 25 data bytes [0 .. 25-1] for the error code stored in this error memory slot" UBYTE EH_STANDARD_S4_S3 1 100 0 255 ECU_ADDRESS 0xFFF827A2 DISPLAY_IDENTIFIER ambient_condition[0][2].amb_cond.ydiMemory_xau16[17].ZFEH_EepromData /end MEASUREMENT
/begin MEASUREMENT ZFEH_EepromData.ydiMemory_xau16[17].amb_cond.ambient_condition[0][3] "ambient condition shot [0 .. 2-1] with 25 data bytes [0 .. 25-1] for the error code stored in this error memory slot" UBYTE EH_STANDARD_S4_S3 1 100 0 255 ECU_ADDRESS 0xFFF827A3 DISPLAY_IDENTIFIER ambient_condition[0][3].amb_cond.ydiMemory_xau16[17].ZFEH_EepromData /end MEASUREMENT
/begin MEASUREMENT ZFEH_EepromData.ydiMemory_xau16[17].amb_cond.ambient_condition[0][4] "ambient condition shot [0 .. 2-1] with 25 data bytes [0 .. 25-1] for the error code stored in this error memory slot" UBYTE EH_STANDARD_S4_S3 1 100 0 255 ECU_ADDRESS 0xFFF827A4 DISPLAY_IDENTIFIER ambient_condition[0][4].amb_cond.ydiMemory_xau16[17].ZFEH_EepromData /end MEASUREMENT
/begin MEASUREMENT ZFEH_EepromData.ydiMemory_xau16[17].amb_cond.ambient_condition[0][5] "ambient condition shot [0 .. 2-1] with 25 data bytes [0 .. 25-1] for the error code stored in this error memory slot" UBYTE EH_STANDARD_S4_S3 1 100 0 255 ECU_ADDRESS 0xFFF827A5 DISPLAY_IDENTIFIER ambient_condition[0][5].amb_cond.ydiMemory_xau16[17].ZFEH_EepromData /end MEASUREMENT
/begin MEASUREMENT ZFEH_EepromData.ydiMemory_xau16[17].amb_cond.ambient_condition[0][6] "ambient condition shot [0 .. 2-1] with 25 data bytes [0 .. 25-1] for the error code stored in this error memory slot" UBYTE EH_STANDARD_S4_S3 1 100 0 255 ECU_ADDRESS 0xFFF827A6 DISPLAY_IDENTIFIER ambient_condition[0][6].amb_cond.ydiMemory_xau16[17].ZFEH_EepromData /end MEASUREMENT
/begin MEASUREMENT ZFEH_EepromData.ydiMemory_xau16[17].amb_cond.ambient_condition[0][7] "ambient condition shot [0 .. 2-1] with 25 data bytes [0 .. 25-1] for the error code stored in this error memory slot" UBYTE EH_STANDARD_S4_S3 1 100 0 255 ECU_ADDRESS 0xFFF827A7 DISPLAY_IDENTIFIER ambient_condition[0][7].amb_cond.ydiMemory_xau16[17].ZFEH_EepromData /end MEASUREMENT
/begin MEASUREMENT ZFEH_EepromData.ydiMemory_xau16[17].amb_cond.ambient_condition[0][8] "ambient condition shot [0 .. 2-1] with 25 data bytes [0 .. 25-1] for the error code stored in this error memory slot" UBYTE EH_STANDARD_S4_S3 1 100 0 255 ECU_ADDRESS 0xFFF827A8 DISPLAY_IDENTIFIER ambient_condition[0][8].amb_cond.ydiMemory_xau16[17].ZFEH_EepromData /end MEASUREMENT
/begin MEASUREMENT ZFEH_EepromData.ydiMemory_xau16[17].amb_cond.ambient_condition[0][9] "ambient condition shot [0 .. 2-1] with 25 data bytes [0 .. 25-1] for the error code stored in this error memory slot" UBYTE EH_STANDARD_S4_S3 1 100 0 255 ECU_ADDRESS 0xFFF827A9 DISPLAY_IDENTIFIER ambient_condition[0][9].amb_cond.ydiMemory_xau16[17].ZFEH_EepromData /end MEASUREMENT
/begin MEASUREMENT ZFEH_EepromData.ydiMemory_xau16[17].amb_cond.ambient_condition[1][0] "ambient condition shot [0 .. 2-1] with 25 data bytes [0 .. 25-1] for the error code stored in this error memory slot" UBYTE EH_STANDARD_S4_S3 1 100 0 255 ECU_ADDRESS 0xFFF827B9 DISPLAY_IDENTIFIER ambient_condition[1][0].amb_cond.ydiMemory_xau16[17].ZFEH_EepromData /end MEASUREMENT
/begin MEASUREMENT ZFEH_EepromData.ydiMemory_xau16[17].amb_cond.ambient_condition[1][10] "ambient condition shot [0 .. 2-1] with 25 data bytes [0 .. 25-1] for the error code stored in this error memory slot" UBYTE EH_STANDARD_S4_S3 1 100 0 255 ECU_ADDRESS 0xFFF827C3 DISPLAY_IDENTIFIER ambient_condition[1][10].amb_cond.ydiMemory_xau16[17].ZFEH_EepromData /end MEASUREMENT
/begin MEASUREMENT ZFEH_EepromData.ydiMemory_xau16[17].amb_cond.ambient_condition[1][11] "ambient condition shot [0 .. 2-1] with 25 data bytes [0 .. 25-1] for the error code stored in this error memory slot" UBYTE EH_STANDARD_S4_S3 1 100 0 255 ECU_ADDRESS 0xFFF827C4 DISPLAY_IDENTIFIER ambient_condition[1][11].amb_cond.ydiMemory_xau16[17].ZFEH_EepromData /end MEASUREMENT
/begin MEASUREMENT ZFEH_EepromData.ydiMemory_xau16[17].amb_cond.ambient_condition[1][12] "ambient condition shot [0 .. 2-1] with 25 data bytes [0 .. 25-1] for the error code stored in this error memory slot" UBYTE EH_STANDARD_S4_S3 1 100 0 255 ECU_ADDRESS 0xFFF827C5 DISPLAY_IDENTIFIER ambient_condition[1][12].amb_cond.ydiMemory_xau16[17].ZFEH_EepromData /end MEASUREMENT
/begin MEASUREMENT ZFEH_EepromData.ydiMemory_xau16[17].amb_cond.ambient_condition[1][13] "ambient condition shot [0 .. 2-1] with 25 data bytes [0 .. 25-1] for the error code stored in this error memory slot" UBYTE EH_STANDARD_S4_S3 1 100 0 255 ECU_ADDRESS 0xFFF827C6 DISPLAY_IDENTIFIER ambient_condition[1][13].amb_cond.ydiMemory_xau16[17].ZFEH_EepromData /end MEASUREMENT
/begin MEASUREMENT ZFEH_EepromData.ydiMemory_xau16[17].amb_cond.ambient_condition[1][14] "ambient condition shot [0 .. 2-1] with 25 data bytes [0 .. 25-1] for the error code stored in this error memory slot" UBYTE EH_STANDARD_S4_S3 1 100 0 255 ECU_ADDRESS 0xFFF827C7 DISPLAY_IDENTIFIER ambient_condition[1][14].amb_cond.ydiMemory_xau16[17].ZFEH_EepromData /end MEASUREMENT
/begin MEASUREMENT ZFEH_EepromData.ydiMemory_xau16[17].amb_cond.ambient_condition[1][15] "ambient condition shot [0 .. 2-1] with 25 data bytes [0 .. 25-1] for the error code stored in this error memory slot" UBYTE EH_STANDARD_S4_S3 1 100 0 255 ECU_ADDRESS 0xFFF827C8 DISPLAY_IDENTIFIER ambient_condition[1][15].amb_cond.ydiMemory_xau16[17].ZFEH_EepromData /end MEASUREMENT
/begin MEASUREMENT ZFEH_EepromData.ydiMemory_xau16[17].amb_cond.ambient_condition[1][16] "ambient condition shot [0 .. 2-1] with 25 data bytes [0 .. 25-1] for the error code stored in this error memory slot" UBYTE EH_STANDARD_S4_S3 1 100 0 255 ECU_ADDRESS 0xFFF827C9 DISPLAY_IDENTIFIER ambient_condition[1][16].amb_cond.ydiMemory_xau16[17].ZFEH_EepromData /end MEASUREMENT
/begin MEASUREMENT ZFEH_EepromData.ydiMemory_xau16[17].amb_cond.ambient_condition[1][17] "ambient condition shot [0 .. 2-1] with 25 data bytes [0 .. 25-1] for the error code stored in this error memory slot" UBYTE EH_STANDARD_S4_S3 1 100 0 255 ECU_ADDRESS 0xFFF827CA DISPLAY_IDENTIFIER ambient_condition[1][17].amb_cond.ydiMemory_xau16[17].ZFEH_EepromData /end MEASUREMENT
/begin MEASUREMENT ZFEH_EepromData.ydiMemory_xau16[17].amb_cond.ambient_condition[1][18] "ambient condition shot [0 .. 2-1] with 25 data bytes [0 .. 25-1] for the error code stored in this error memory slot" UBYTE EH_STANDARD_S4_S3 1 100 0 255 ECU_ADDRESS 0xFFF827CB DISPLAY_IDENTIFIER ambient_condition[1][18].amb_cond.ydiMemory_xau16[17].ZFEH_EepromData /end MEASUREMENT
/begin MEASUREMENT ZFEH_EepromData.ydiMemory_xau16[17].amb_cond.ambient_condition[1][19] "ambient condition shot [0 .. 2-1] with 25 data bytes [0 .. 25-1] for the error code stored in this error memory slot" UBYTE EH_STANDARD_S4_S3 1 100 0 255 ECU_ADDRESS 0xFFF827CC DISPLAY_IDENTIFIER ambient_condition[1][19].amb_cond.ydiMemory_xau16[17].ZFEH_EepromData /end MEASUREMENT
/begin MEASUREMENT ZFEH_EepromData.ydiMemory_xau16[17].amb_cond.ambient_condition[1][1] "ambient condition shot [0 .. 2-1] with 25 data bytes [0 .. 25-1] for the error code stored in this error memory slot" UBYTE EH_STANDARD_S4_S3 1 100 0 255 ECU_ADDRESS 0xFFF827BA DISPLAY_IDENTIFIER ambient_condition[1][1].amb_cond.ydiMemory_xau16[17].ZFEH_EepromData /end MEASUREMENT
/begin MEASUREMENT ZFEH_EepromData.ydiMemory_xau16[17].amb_cond.ambient_condition[1][20] "ambient condition shot [0 .. 2-1] with 25 data bytes [0 .. 25-1] for the error code stored in this error memory slot" UBYTE EH_STANDARD_S4_S3 1 100 0 255 ECU_ADDRESS 0xFFF827CD DISPLAY_IDENTIFIER ambient_condition[1][20].amb_cond.ydiMemory_xau16[17].ZFEH_EepromData /end MEASUREMENT
/begin MEASUREMENT ZFEH_EepromData.ydiMemory_xau16[17].amb_cond.ambient_condition[1][21] "ambient condition shot [0 .. 2-1] with 25 data bytes [0 .. 25-1] for the error code stored in this error memory slot" UBYTE EH_STANDARD_S4_S3 1 100 0 255 ECU_ADDRESS 0xFFF827CE DISPLAY_IDENTIFIER ambient_condition[1][21].amb_cond.ydiMemory_xau16[17].ZFEH_EepromData /end MEASUREMENT
/begin MEASUREMENT ZFEH_EepromData.ydiMemory_xau16[17].amb_cond.ambient_condition[1][22] "ambient condition shot [0 .. 2-1] with 25 data bytes [0 .. 25-1] for the error code stored in this error memory slot" UBYTE EH_STANDARD_S4_S3 1 100 0 255 ECU_ADDRESS 0xFFF827CF DISPLAY_IDENTIFIER ambient_condition[1][22].amb_cond.ydiMemory_xau16[17].ZFEH_EepromData /end MEASUREMENT
/begin MEASUREMENT ZFEH_EepromData.ydiMemory_xau16[17].amb_cond.ambient_condition[1][23] "ambient condition shot [0 .. 2-1] with 25 data bytes [0 .. 25-1] for the error code stored in this error memory slot" UBYTE EH_STANDARD_S4_S3 1 100 0 255 ECU_ADDRESS 0xFFF827D0 DISPLAY_IDENTIFIER ambient_condition[1][23].amb_cond.ydiMemory_xau16[17].ZFEH_EepromData /end MEASUREMENT
/begin MEASUREMENT ZFEH_EepromData.ydiMemory_xau16[17].amb_cond.ambient_condition[1][24] "ambient condition shot [0 .. 2-1] with 25 data bytes [0 .. 25-1] for the error code stored in this error memory slot" UBYTE EH_STANDARD_S4_S3 1 100 0 255 ECU_ADDRESS 0xFFF827D1 DISPLAY_IDENTIFIER ambient_condition[1][24].amb_cond.ydiMemory_xau16[17].ZFEH_EepromData /end MEASUREMENT
/begin MEASUREMENT ZFEH_EepromData.ydiMemory_xau16[17].amb_cond.ambient_condition[1][2] "ambient condition shot [0 .. 2-1] with 25 data bytes [0 .. 25-1] for the error code stored in this error memory slot" UBYTE EH_STANDARD_S4_S3 1 100 0 255 ECU_ADDRESS 0xFFF827BB DISPLAY_IDENTIFIER ambient_condition[1][2].amb_cond.ydiMemory_xau16[17].ZFEH_EepromData /end MEASUREMENT
/begin MEASUREMENT ZFEH_EepromData.ydiMemory_xau16[17].amb_cond.ambient_condition[1][3] "ambient condition shot [0 .. 2-1] with 25 data bytes [0 .. 25-1] for the error code stored in this error memory slot" UBYTE EH_STANDARD_S4_S3 1 100 0 255 ECU_ADDRESS 0xFFF827BC DISPLAY_IDENTIFIER ambient_condition[1][3].amb_cond.ydiMemory_xau16[17].ZFEH_EepromData /end MEASUREMENT
/begin MEASUREMENT ZFEH_EepromData.ydiMemory_xau16[17].amb_cond.ambient_condition[1][4] "ambient condition shot [0 .. 2-1] with 25 data bytes [0 .. 25-1] for the error code stored in this error memory slot" UBYTE EH_STANDARD_S4_S3 1 100 0 255 ECU_ADDRESS 0xFFF827BD DISPLAY_IDENTIFIER ambient_condition[1][4].amb_cond.ydiMemory_xau16[17].ZFEH_EepromData /end MEASUREMENT
/begin MEASUREMENT ZFEH_EepromData.ydiMemory_xau16[17].amb_cond.ambient_condition[1][5] "ambient condition shot [0 .. 2-1] with 25 data bytes [0 .. 25-1] for the error code stored in this error memory slot" UBYTE EH_STANDARD_S4_S3 1 100 0 255 ECU_ADDRESS 0xFFF827BE DISPLAY_IDENTIFIER ambient_condition[1][5].amb_cond.ydiMemory_xau16[17].ZFEH_EepromData /end MEASUREMENT
/begin MEASUREMENT ZFEH_EepromData.ydiMemory_xau16[17].amb_cond.ambient_condition[1][6] "ambient condition shot [0 .. 2-1] with 25 data bytes [0 .. 25-1] for the error code stored in this error memory slot" UBYTE EH_STANDARD_S4_S3 1 100 0 255 ECU_ADDRESS 0xFFF827BF DISPLAY_IDENTIFIER ambient_condition[1][6].amb_cond.ydiMemory_xau16[17].ZFEH_EepromData /end MEASUREMENT
/begin MEASUREMENT ZFEH_EepromData.ydiMemory_xau16[17].amb_cond.ambient_condition[1][7] "ambient condition shot [0 .. 2-1] with 25 data bytes [0 .. 25-1] for the error code stored in this error memory slot" UBYTE EH_STANDARD_S4_S3 1 100 0 255 ECU_ADDRESS 0xFFF827C0 DISPLAY_IDENTIFIER ambient_condition[1][7].amb_cond.ydiMemory_xau16[17].ZFEH_EepromData /end MEASUREMENT
/begin MEASUREMENT ZFEH_EepromData.ydiMemory_xau16[17].amb_cond.ambient_condition[1][8] "ambient condition shot [0 .. 2-1] with 25 data bytes [0 .. 25-1] for the error code stored in this error memory slot" UBYTE EH_STANDARD_S4_S3 1 100 0 255 ECU_ADDRESS 0xFFF827C1 DISPLAY_IDENTIFIER ambient_condition[1][8].amb_cond.ydiMemory_xau16[17].ZFEH_EepromData /end MEASUREMENT
/begin MEASUREMENT ZFEH_EepromData.ydiMemory_xau16[17].amb_cond.ambient_condition[1][9] "ambient condition shot [0 .. 2-1] with 25 data bytes [0 .. 25-1] for the error code stored in this error memory slot" UBYTE EH_STANDARD_S4_S3 1 100 0 255 ECU_ADDRESS 0xFFF827C2 DISPLAY_IDENTIFIER ambient_condition[1][9].amb_cond.ydiMemory_xau16[17].ZFEH_EepromData /end MEASUREMENT
/begin MEASUREMENT ZFEH_EepromData.ydiMemory_xau16[17].amb_cond.status_of_ambient_conditions[0] "status of ambient condition shot x: 0=invalid 1=valid" UBYTE EH_STANDARD_S4_S3 1 100 0 1 ECU_ADDRESS 0xFFF827D2 DISPLAY_IDENTIFIER status_of_ambient_conditions[0].amb_cond.ydiMemory_xau16[17].ZFEH_EepromData /end MEASUREMENT
/begin MEASUREMENT ZFEH_EepromData.ydiMemory_xau16[17].amb_cond.status_of_ambient_conditions[1] "status of ambient condition shot x: 0=invalid 1=valid" UBYTE EH_STANDARD_S4_S3 1 100 0 1 ECU_ADDRESS 0xFFF827D3 DISPLAY_IDENTIFIER status_of_ambient_conditions[1].amb_cond.ydiMemory_xau16[17].ZFEH_EepromData /end MEASUREMENT
/begin MEASUREMENT ZFEH_EepromData.ydiMemory_xau16[17].backwards_counter "backwards counter of error code stored in error memory slot" UBYTE EH_STANDARD_S4_S3 1 100 0 255 ECU_ADDRESS 0xFFF82793 DISPLAY_IDENTIFIER backwards_counter.ydiMemory_xau16[17].ZFEH_EepromData /end MEASUREMENT
/begin MEASUREMENT ZFEH_EepromData.ydiMemory_xau16[17].condition_byte "condition byte of error code stored in error memory slot" UBYTE EH_STANDARD_S4_S3 1 100 0 255 ECU_ADDRESS 0xFFF8279D DISPLAY_IDENTIFIER condition_byte.ydiMemory_xau16[17].ZFEH_EepromData /end MEASUREMENT
/begin MEASUREMENT ZFEH_EepromData.ydiMemory_xau16[17].error_code "error code stored in error memory slot" UWORD EH_STANDARD_S4_S3 1 100 0 65535 ECU_ADDRESS 0xFFF8278C DISPLAY_IDENTIFIER error_code.ydiMemory_xau16[17].ZFEH_EepromData /end MEASUREMENT
/begin MEASUREMENT ZFEH_EepromData.ydiMemory_xau16[17].error_type "error type of error code stored in error memory slot" UWORD EH_STANDARD_S4_S3 1 100 0 65535 ECU_ADDRESS 0xFFF8278E DISPLAY_IDENTIFIER error_type.ydiMemory_xau16[17].ZFEH_EepromData /end MEASUREMENT
/begin MEASUREMENT ZFEH_EepromData.ydiMemory_xau16[17].frequency_counter "frequency counter of error code stored in error memory slot" UBYTE EH_STANDARD_S4_S3 1 100 0 255 ECU_ADDRESS 0xFFF82792 DISPLAY_IDENTIFIER frequency_counter.ydiMemory_xau16[17].ZFEH_EepromData /end MEASUREMENT
/begin MEASUREMENT ZFEH_EepromData.ydiMemory_xau16[17].master_time "master time of error code stored in error memory slot" ULONG EH_STANDARD_S4_S3 1 100 0 4294967295 ECU_ADDRESS 0xFFF82798 DISPLAY_IDENTIFIER master_time.ydiMemory_xau16[17].ZFEH_EepromData /end MEASUREMENT
/begin MEASUREMENT ZFEH_EepromData.ydiMemory_xau16[17].obd_driving_cycle_counter "obd driving cycle counter of error code stored in error memory slot" UWORD EH_STANDARD_S4_S3 1 100 0 65535 ECU_ADDRESS 0xFFF8279E DISPLAY_IDENTIFIER obd_driving_cycle_counter.ydiMemory_xau16[17].ZFEH_EepromData /end MEASUREMENT
/begin MEASUREMENT ZFEH_EepromData.ydiMemory_xau16[17].permanent_counter "counter of permanent error codes stored in error memory slot" UBYTE EH_STANDARD_S4_S3 1 100 0 255 ECU_ADDRESS 0xFFF82794 DISPLAY_IDENTIFIER permanent_counter.ydiMemory_xau16[17].ZFEH_EepromData /end MEASUREMENT
/begin MEASUREMENT ZFEH_EepromData.ydiMemory_xau16[17].sequence_counter "sequence counter of error code stored in error memory slot" UBYTE EH_STANDARD_S4_S3 1 100 0 255 ECU_ADDRESS 0xFFF82795 DISPLAY_IDENTIFIER sequence_counter.ydiMemory_xau16[17].ZFEH_EepromData /end MEASUREMENT
/begin MEASUREMENT ZFEH_EepromData.ydiMemory_xau16[17].status_word "status word of error code stored in error memory slot" UWORD EH_STANDARD_S4_S3 1 100 0 65535 ECU_ADDRESS 0xFFF82790 DISPLAY_IDENTIFIER status_word.ydiMemory_xau16[17].ZFEH_EepromData /end MEASUREMENT
/begin MEASUREMENT ZFEH_EepromData.ydiMemory_xau16[18].amb_cond.ambient_condition[0][0] "ambient condition shot [0 .. 2-1] with 25 data bytes [0 .. 25-1] for the error code stored in this error memory slot" UBYTE EH_STANDARD_S4_S3 1 100 0 255 ECU_ADDRESS 0xFFF827E8 DISPLAY_IDENTIFIER ambient_condition[0][0].amb_cond.ydiMemory_xau16[18].ZFEH_EepromData /end MEASUREMENT
/begin MEASUREMENT ZFEH_EepromData.ydiMemory_xau16[18].amb_cond.ambient_condition[0][10] "ambient condition shot [0 .. 2-1] with 25 data bytes [0 .. 25-1] for the error code stored in this error memory slot" UBYTE EH_STANDARD_S4_S3 1 100 0 255 ECU_ADDRESS 0xFFF827F2 DISPLAY_IDENTIFIER ambient_condition[0][10].amb_cond.ydiMemory_xau16[18].ZFEH_EepromData /end MEASUREMENT
/begin MEASUREMENT ZFEH_EepromData.ydiMemory_xau16[18].amb_cond.ambient_condition[0][11] "ambient condition shot [0 .. 2-1] with 25 data bytes [0 .. 25-1] for the error code stored in this error memory slot" UBYTE EH_STANDARD_S4_S3 1 100 0 255 ECU_ADDRESS 0xFFF827F3 DISPLAY_IDENTIFIER ambient_condition[0][11].amb_cond.ydiMemory_xau16[18].ZFEH_EepromData /end MEASUREMENT
/begin MEASUREMENT ZFEH_EepromData.ydiMemory_xau16[18].amb_cond.ambient_condition[0][12] "ambient condition shot [0 .. 2-1] with 25 data bytes [0 .. 25-1] for the error code stored in this error memory slot" UBYTE EH_STANDARD_S4_S3 1 100 0 255 ECU_ADDRESS 0xFFF827F4 DISPLAY_IDENTIFIER ambient_condition[0][12].amb_cond.ydiMemory_xau16[18].ZFEH_EepromData /end MEASUREMENT
/begin MEASUREMENT ZFEH_EepromData.ydiMemory_xau16[18].amb_cond.ambient_condition[0][13] "ambient condition shot [0 .. 2-1] with 25 data bytes [0 .. 25-1] for the error code stored in this error memory slot" UBYTE EH_STANDARD_S4_S3 1 100 0 255 ECU_ADDRESS 0xFFF827F5 DISPLAY_IDENTIFIER ambient_condition[0][13].amb_cond.ydiMemory_xau16[18].ZFEH_EepromData /end MEASUREMENT
/begin MEASUREMENT ZFEH_EepromData.ydiMemory_xau16[18].amb_cond.ambient_condition[0][14] "ambient condition shot [0 .. 2-1] with 25 data bytes [0 .. 25-1] for the error code stored in this error memory slot" UBYTE EH_STANDARD_S4_S3 1 100 0 255 ECU_ADDRESS 0xFFF827F6 DISPLAY_IDENTIFIER ambient_condition[0][14].amb_cond.ydiMemory_xau16[18].ZFEH_EepromData /end MEASUREMENT
/begin MEASUREMENT ZFEH_EepromData.ydiMemory_xau16[18].amb_cond.ambient_condition[0][15] "ambient condition shot [0 .. 2-1] with 25 data bytes [0 .. 25-1] for the error code stored in this error memory slot" UBYTE EH_STANDARD_S4_S3 1 100 0 255 ECU_ADDRESS 0xFFF827F7 DISPLAY_IDENTIFIER ambient_condition[0][15].amb_cond.ydiMemory_xau16[18].ZFEH_EepromData /end MEASUREMENT
/begin MEASUREMENT ZFEH_EepromData.ydiMemory_xau16[18].amb_cond.ambient_condition[0][16] "ambient condition shot [0 .. 2-1] with 25 data bytes [0 .. 25-1] for the error code stored in this error memory slot" UBYTE EH_STANDARD_S4_S3 1 100 0 255 ECU_ADDRESS 0xFFF827F8 DISPLAY_IDENTIFIER ambient_condition[0][16].amb_cond.ydiMemory_xau16[18].ZFEH_EepromData /end MEASUREMENT
/begin MEASUREMENT ZFEH_EepromData.ydiMemory_xau16[18].amb_cond.ambient_condition[0][17] "ambient condition shot [0 .. 2-1] with 25 data bytes [0 .. 25-1] for the error code stored in this error memory slot" UBYTE EH_STANDARD_S4_S3 1 100 0 255 ECU_ADDRESS 0xFFF827F9 DISPLAY_IDENTIFIER ambient_condition[0][17].amb_cond.ydiMemory_xau16[18].ZFEH_EepromData /end MEASUREMENT
/begin MEASUREMENT ZFEH_EepromData.ydiMemory_xau16[18].amb_cond.ambient_condition[0][18] "ambient condition shot [0 .. 2-1] with 25 data bytes [0 .. 25-1] for the error code stored in this error memory slot" UBYTE EH_STANDARD_S4_S3 1 100 0 255 ECU_ADDRESS 0xFFF827FA DISPLAY_IDENTIFIER ambient_condition[0][18].amb_cond.ydiMemory_xau16[18].ZFEH_EepromData /end MEASUREMENT
/begin MEASUREMENT ZFEH_EepromData.ydiMemory_xau16[18].amb_cond.ambient_condition[0][19] "ambient condition shot [0 .. 2-1] with 25 data bytes [0 .. 25-1] for the error code stored in this error memory slot" UBYTE EH_STANDARD_S4_S3 1 100 0 255 ECU_ADDRESS 0xFFF827FB DISPLAY_IDENTIFIER ambient_condition[0][19].amb_cond.ydiMemory_xau16[18].ZFEH_EepromData /end MEASUREMENT
/begin MEASUREMENT ZFEH_EepromData.ydiMemory_xau16[18].amb_cond.ambient_condition[0][1] "ambient condition shot [0 .. 2-1] with 25 data bytes [0 .. 25-1] for the error code stored in this error memory slot" UBYTE EH_STANDARD_S4_S3 1 100 0 255 ECU_ADDRESS 0xFFF827E9 DISPLAY_IDENTIFIER ambient_condition[0][1].amb_cond.ydiMemory_xau16[18].ZFEH_EepromData /end MEASUREMENT
/begin MEASUREMENT ZFEH_EepromData.ydiMemory_xau16[18].amb_cond.ambient_condition[0][20] "ambient condition shot [0 .. 2-1] with 25 data bytes [0 .. 25-1] for the error code stored in this error memory slot" UBYTE EH_STANDARD_S4_S3 1 100 0 255 ECU_ADDRESS 0xFFF827FC DISPLAY_IDENTIFIER ambient_condition[0][20].amb_cond.ydiMemory_xau16[18].ZFEH_EepromData /end MEASUREMENT
/begin MEASUREMENT ZFEH_EepromData.ydiMemory_xau16[18].amb_cond.ambient_condition[0][21] "ambient condition shot [0 .. 2-1] with 25 data bytes [0 .. 25-1] for the error code stored in this error memory slot" UBYTE EH_STANDARD_S4_S3 1 100 0 255 ECU_ADDRESS 0xFFF827FD DISPLAY_IDENTIFIER ambient_condition[0][21].amb_cond.ydiMemory_xau16[18].ZFEH_EepromData /end MEASUREMENT
/begin MEASUREMENT ZFEH_EepromData.ydiMemory_xau16[18].amb_cond.ambient_condition[0][22] "ambient condition shot [0 .. 2-1] with 25 data bytes [0 .. 25-1] for the error code stored in this error memory slot" UBYTE EH_STANDARD_S4_S3 1 100 0 255 ECU_ADDRESS 0xFFF827FE DISPLAY_IDENTIFIER ambient_condition[0][22].amb_cond.ydiMemory_xau16[18].ZFEH_EepromData /end MEASUREMENT
/begin MEASUREMENT ZFEH_EepromData.ydiMemory_xau16[18].amb_cond.ambient_condition[0][23] "ambient condition shot [0 .. 2-1] with 25 data bytes [0 .. 25-1] for the error code stored in this error memory slot" UBYTE EH_STANDARD_S4_S3 1 100 0 255 ECU_ADDRESS 0xFFF827FF DISPLAY_IDENTIFIER ambient_condition[0][23].amb_cond.ydiMemory_xau16[18].ZFEH_EepromData /end MEASUREMENT
/begin MEASUREMENT ZFEH_EepromData.ydiMemory_xau16[18].amb_cond.ambient_condition[0][24] "ambient condition shot [0 .. 2-1] with 25 data bytes [0 .. 25-1] for the error code stored in this error memory slot" UBYTE EH_STANDARD_S4_S3 1 100 0 255 ECU_ADDRESS 0xFFF82800 DISPLAY_IDENTIFIER ambient_condition[0][24].amb_cond.ydiMemory_xau16[18].ZFEH_EepromData /end MEASUREMENT
/begin MEASUREMENT ZFEH_EepromData.ydiMemory_xau16[18].amb_cond.ambient_condition[0][2] "ambient condition shot [0 .. 2-1] with 25 data bytes [0 .. 25-1] for the error code stored in this error memory slot" UBYTE EH_STANDARD_S4_S3 1 100 0 255 ECU_ADDRESS 0xFFF827EA DISPLAY_IDENTIFIER ambient_condition[0][2].amb_cond.ydiMemory_xau16[18].ZFEH_EepromData /end MEASUREMENT
/begin MEASUREMENT ZFEH_EepromData.ydiMemory_xau16[18].amb_cond.ambient_condition[0][3] "ambient condition shot [0 .. 2-1] with 25 data bytes [0 .. 25-1] for the error code stored in this error memory slot" UBYTE EH_STANDARD_S4_S3 1 100 0 255 ECU_ADDRESS 0xFFF827EB DISPLAY_IDENTIFIER ambient_condition[0][3].amb_cond.ydiMemory_xau16[18].ZFEH_EepromData /end MEASUREMENT
/begin MEASUREMENT ZFEH_EepromData.ydiMemory_xau16[18].amb_cond.ambient_condition[0][4] "ambient condition shot [0 .. 2-1] with 25 data bytes [0 .. 25-1] for the error code stored in this error memory slot" UBYTE EH_STANDARD_S4_S3 1 100 0 255 ECU_ADDRESS 0xFFF827EC DISPLAY_IDENTIFIER ambient_condition[0][4].amb_cond.ydiMemory_xau16[18].ZFEH_EepromData /end MEASUREMENT
/begin MEASUREMENT ZFEH_EepromData.ydiMemory_xau16[18].amb_cond.ambient_condition[0][5] "ambient condition shot [0 .. 2-1] with 25 data bytes [0 .. 25-1] for the error code stored in this error memory slot" UBYTE EH_STANDARD_S4_S3 1 100 0 255 ECU_ADDRESS 0xFFF827ED DISPLAY_IDENTIFIER ambient_condition[0][5].amb_cond.ydiMemory_xau16[18].ZFEH_EepromData /end MEASUREMENT
/begin MEASUREMENT ZFEH_EepromData.ydiMemory_xau16[18].amb_cond.ambient_condition[0][6] "ambient condition shot [0 .. 2-1] with 25 data bytes [0 .. 25-1] for the error code stored in this error memory slot" UBYTE EH_STANDARD_S4_S3 1 100 0 255 ECU_ADDRESS 0xFFF827EE DISPLAY_IDENTIFIER ambient_condition[0][6].amb_cond.ydiMemory_xau16[18].ZFEH_EepromData /end MEASUREMENT
/begin MEASUREMENT ZFEH_EepromData.ydiMemory_xau16[18].amb_cond.ambient_condition[0][7] "ambient condition shot [0 .. 2-1] with 25 data bytes [0 .. 25-1] for the error code stored in this error memory slot" UBYTE EH_STANDARD_S4_S3 1 100 0 255 ECU_ADDRESS 0xFFF827EF DISPLAY_IDENTIFIER ambient_condition[0][7].amb_cond.ydiMemory_xau16[18].ZFEH_EepromData /end MEASUREMENT
/begin MEASUREMENT ZFEH_EepromData.ydiMemory_xau16[18].amb_cond.ambient_condition[0][8] "ambient condition shot [0 .. 2-1] with 25 data bytes [0 .. 25-1] for the error code stored in this error memory slot" UBYTE EH_STANDARD_S4_S3 1 100 0 255 ECU_ADDRESS 0xFFF827F0 DISPLAY_IDENTIFIER ambient_condition[0][8].amb_cond.ydiMemory_xau16[18].ZFEH_EepromData /end MEASUREMENT
/begin MEASUREMENT ZFEH_EepromData.ydiMemory_xau16[18].amb_cond.ambient_condition[0][9] "ambient condition shot [0 .. 2-1] with 25 data bytes [0 .. 25-1] for the error code stored in this error memory slot" UBYTE EH_STANDARD_S4_S3 1 100 0 255 ECU_ADDRESS 0xFFF827F1 DISPLAY_IDENTIFIER ambient_condition[0][9].amb_cond.ydiMemory_xau16[18].ZFEH_EepromData /end MEASUREMENT
/begin MEASUREMENT ZFEH_EepromData.ydiMemory_xau16[18].amb_cond.ambient_condition[1][0] "ambient condition shot [0 .. 2-1] with 25 data bytes [0 .. 25-1] for the error code stored in this error memory slot" UBYTE EH_STANDARD_S4_S3 1 100 0 255 ECU_ADDRESS 0xFFF82801 DISPLAY_IDENTIFIER ambient_condition[1][0].amb_cond.ydiMemory_xau16[18].ZFEH_EepromData /end MEASUREMENT
/begin MEASUREMENT ZFEH_EepromData.ydiMemory_xau16[18].amb_cond.ambient_condition[1][10] "ambient condition shot [0 .. 2-1] with 25 data bytes [0 .. 25-1] for the error code stored in this error memory slot" UBYTE EH_STANDARD_S4_S3 1 100 0 255 ECU_ADDRESS 0xFFF8280B DISPLAY_IDENTIFIER ambient_condition[1][10].amb_cond.ydiMemory_xau16[18].ZFEH_EepromData /end MEASUREMENT
/begin MEASUREMENT ZFEH_EepromData.ydiMemory_xau16[18].amb_cond.ambient_condition[1][11] "ambient condition shot [0 .. 2-1] with 25 data bytes [0 .. 25-1] for the error code stored in this error memory slot" UBYTE EH_STANDARD_S4_S3 1 100 0 255 ECU_ADDRESS 0xFFF8280C DISPLAY_IDENTIFIER ambient_condition[1][11].amb_cond.ydiMemory_xau16[18].ZFEH_EepromData /end MEASUREMENT
/begin MEASUREMENT ZFEH_EepromData.ydiMemory_xau16[18].amb_cond.ambient_condition[1][12] "ambient condition shot [0 .. 2-1] with 25 data bytes [0 .. 25-1] for the error code stored in this error memory slot" UBYTE EH_STANDARD_S4_S3 1 100 0 255 ECU_ADDRESS 0xFFF8280D DISPLAY_IDENTIFIER ambient_condition[1][12].amb_cond.ydiMemory_xau16[18].ZFEH_EepromData /end MEASUREMENT
/begin MEASUREMENT ZFEH_EepromData.ydiMemory_xau16[18].amb_cond.ambient_condition[1][13] "ambient condition shot [0 .. 2-1] with 25 data bytes [0 .. 25-1] for the error code stored in this error memory slot" UBYTE EH_STANDARD_S4_S3 1 100 0 255 ECU_ADDRESS 0xFFF8280E DISPLAY_IDENTIFIER ambient_condition[1][13].amb_cond.ydiMemory_xau16[18].ZFEH_EepromData /end MEASUREMENT
/begin MEASUREMENT ZFEH_EepromData.ydiMemory_xau16[18].amb_cond.ambient_condition[1][14] "ambient condition shot [0 .. 2-1] with 25 data bytes [0 .. 25-1] for the error code stored in this error memory slot" UBYTE EH_STANDARD_S4_S3 1 100 0 255 ECU_ADDRESS 0xFFF8280F DISPLAY_IDENTIFIER ambient_condition[1][14].amb_cond.ydiMemory_xau16[18].ZFEH_EepromData /end MEASUREMENT
/begin MEASUREMENT ZFEH_EepromData.ydiMemory_xau16[18].amb_cond.ambient_condition[1][15] "ambient condition shot [0 .. 2-1] with 25 data bytes [0 .. 25-1] for the error code stored in this error memory slot" UBYTE EH_STANDARD_S4_S3 1 100 0 255 ECU_ADDRESS 0xFFF82810 DISPLAY_IDENTIFIER ambient_condition[1][15].amb_cond.ydiMemory_xau16[18].ZFEH_EepromData /end MEASUREMENT
/begin MEASUREMENT ZFEH_EepromData.ydiMemory_xau16[18].amb_cond.ambient_condition[1][16] "ambient condition shot [0 .. 2-1] with 25 data bytes [0 .. 25-1] for the error code stored in this error memory slot" UBYTE EH_STANDARD_S4_S3 1 100 0 255 ECU_ADDRESS 0xFFF82811 DISPLAY_IDENTIFIER ambient_condition[1][16].amb_cond.ydiMemory_xau16[18].ZFEH_EepromData /end MEASUREMENT
/begin MEASUREMENT ZFEH_EepromData.ydiMemory_xau16[18].amb_cond.ambient_condition[1][17] "ambient condition shot [0 .. 2-1] with 25 data bytes [0 .. 25-1] for the error code stored in this error memory slot" UBYTE EH_STANDARD_S4_S3 1 100 0 255 ECU_ADDRESS 0xFFF82812 DISPLAY_IDENTIFIER ambient_condition[1][17].amb_cond.ydiMemory_xau16[18].ZFEH_EepromData /end MEASUREMENT
/begin MEASUREMENT ZFEH_EepromData.ydiMemory_xau16[18].amb_cond.ambient_condition[1][18] "ambient condition shot [0 .. 2-1] with 25 data bytes [0 .. 25-1] for the error code stored in this error memory slot" UBYTE EH_STANDARD_S4_S3 1 100 0 255 ECU_ADDRESS 0xFFF82813 DISPLAY_IDENTIFIER ambient_condition[1][18].amb_cond.ydiMemory_xau16[18].ZFEH_EepromData /end MEASUREMENT
/begin MEASUREMENT ZFEH_EepromData.ydiMemory_xau16[18].amb_cond.ambient_condition[1][19] "ambient condition shot [0 .. 2-1] with 25 data bytes [0 .. 25-1] for the error code stored in this error memory slot" UBYTE EH_STANDARD_S4_S3 1 100 0 255 ECU_ADDRESS 0xFFF82814 DISPLAY_IDENTIFIER ambient_condition[1][19].amb_cond.ydiMemory_xau16[18].ZFEH_EepromData /end MEASUREMENT
/begin MEASUREMENT ZFEH_EepromData.ydiMemory_xau16[18].amb_cond.ambient_condition[1][1] "ambient condition shot [0 .. 2-1] with 25 data bytes [0 .. 25-1] for the error code stored in this error memory slot" UBYTE EH_STANDARD_S4_S3 1 100 0 255 ECU_ADDRESS 0xFFF82802 DISPLAY_IDENTIFIER ambient_condition[1][1].amb_cond.ydiMemory_xau16[18].ZFEH_EepromData /end MEASUREMENT
/begin MEASUREMENT ZFEH_EepromData.ydiMemory_xau16[18].amb_cond.ambient_condition[1][20] "ambient condition shot [0 .. 2-1] with 25 data bytes [0 .. 25-1] for the error code stored in this error memory slot" UBYTE EH_STANDARD_S4_S3 1 100 0 255 ECU_ADDRESS 0xFFF82815 DISPLAY_IDENTIFIER ambient_condition[1][20].amb_cond.ydiMemory_xau16[18].ZFEH_EepromData /end MEASUREMENT
/begin MEASUREMENT ZFEH_EepromData.ydiMemory_xau16[18].amb_cond.ambient_condition[1][21] "ambient condition shot [0 .. 2-1] with 25 data bytes [0 .. 25-1] for the error code stored in this error memory slot" UBYTE EH_STANDARD_S4_S3 1 100 0 255 ECU_ADDRESS 0xFFF82816 DISPLAY_IDENTIFIER ambient_condition[1][21].amb_cond.ydiMemory_xau16[18].ZFEH_EepromData /end MEASUREMENT
/begin MEASUREMENT ZFEH_EepromData.ydiMemory_xau16[18].amb_cond.ambient_condition[1][22] "ambient condition shot [0 .. 2-1] with 25 data bytes [0 .. 25-1] for the error code stored in this error memory slot" UBYTE EH_STANDARD_S4_S3 1 100 0 255 ECU_ADDRESS 0xFFF82817 DISPLAY_IDENTIFIER ambient_condition[1][22].amb_cond.ydiMemory_xau16[18].ZFEH_EepromData /end MEASUREMENT
/begin MEASUREMENT ZFEH_EepromData.ydiMemory_xau16[18].amb_cond.ambient_condition[1][23] "ambient condition shot [0 .. 2-1] with 25 data bytes [0 .. 25-1] for the error code stored in this error memory slot" UBYTE EH_STANDARD_S4_S3 1 100 0 255 ECU_ADDRESS 0xFFF82818 DISPLAY_IDENTIFIER ambient_condition[1][23].amb_cond.ydiMemory_xau16[18].ZFEH_EepromData /end MEASUREMENT
/begin MEASUREMENT ZFEH_EepromData.ydiMemory_xau16[18].amb_cond.ambient_condition[1][24] "ambient condition shot [0 .. 2-1] with 25 data bytes [0 .. 25-1] for the error code stored in this error memory slot" UBYTE EH_STANDARD_S4_S3 1 100 0 255 ECU_ADDRESS 0xFFF82819 DISPLAY_IDENTIFIER ambient_condition[1][24].amb_cond.ydiMemory_xau16[18].ZFEH_EepromData /end MEASUREMENT
/begin MEASUREMENT ZFEH_EepromData.ydiMemory_xau16[18].amb_cond.ambient_condition[1][2] "ambient condition shot [0 .. 2-1] with 25 data bytes [0 .. 25-1] for the error code stored in this error memory slot" UBYTE EH_STANDARD_S4_S3 1 100 0 255 ECU_ADDRESS 0xFFF82803 DISPLAY_IDENTIFIER ambient_condition[1][2].amb_cond.ydiMemory_xau16[18].ZFEH_EepromData /end MEASUREMENT
/begin MEASUREMENT ZFEH_EepromData.ydiMemory_xau16[18].amb_cond.ambient_condition[1][3] "ambient condition shot [0 .. 2-1] with 25 data bytes [0 .. 25-1] for the error code stored in this error memory slot" UBYTE EH_STANDARD_S4_S3 1 100 0 255 ECU_ADDRESS 0xFFF82804 DISPLAY_IDENTIFIER ambient_condition[1][3].amb_cond.ydiMemory_xau16[18].ZFEH_EepromData /end MEASUREMENT
/begin MEASUREMENT ZFEH_EepromData.ydiMemory_xau16[18].amb_cond.ambient_condition[1][4] "ambient condition shot [0 .. 2-1] with 25 data bytes [0 .. 25-1] for the error code stored in this error memory slot" UBYTE EH_STANDARD_S4_S3 1 100 0 255 ECU_ADDRESS 0xFFF82805 DISPLAY_IDENTIFIER ambient_condition[1][4].amb_cond.ydiMemory_xau16[18].ZFEH_EepromData /end MEASUREMENT
/begin MEASUREMENT ZFEH_EepromData.ydiMemory_xau16[18].amb_cond.ambient_condition[1][5] "ambient condition shot [0 .. 2-1] with 25 data bytes [0 .. 25-1] for the error code stored in this error memory slot" UBYTE EH_STANDARD_S4_S3 1 100 0 255 ECU_ADDRESS 0xFFF82806 DISPLAY_IDENTIFIER ambient_condition[1][5].amb_cond.ydiMemory_xau16[18].ZFEH_EepromData /end MEASUREMENT
/begin MEASUREMENT ZFEH_EepromData.ydiMemory_xau16[18].amb_cond.ambient_condition[1][6] "ambient condition shot [0 .. 2-1] with 25 data bytes [0 .. 25-1] for the error code stored in this error memory slot" UBYTE EH_STANDARD_S4_S3 1 100 0 255 ECU_ADDRESS 0xFFF82807 DISPLAY_IDENTIFIER ambient_condition[1][6].amb_cond.ydiMemory_xau16[18].ZFEH_EepromData /end MEASUREMENT
/begin MEASUREMENT ZFEH_EepromData.ydiMemory_xau16[18].amb_cond.ambient_condition[1][7] "ambient condition shot [0 .. 2-1] with 25 data bytes [0 .. 25-1] for the error code stored in this error memory slot" UBYTE EH_STANDARD_S4_S3 1 100 0 255 ECU_ADDRESS 0xFFF82808 DISPLAY_IDENTIFIER ambient_condition[1][7].amb_cond.ydiMemory_xau16[18].ZFEH_EepromData /end MEASUREMENT
/begin MEASUREMENT ZFEH_EepromData.ydiMemory_xau16[18].amb_cond.ambient_condition[1][8] "ambient condition shot [0 .. 2-1] with 25 data bytes [0 .. 25-1] for the error code stored in this error memory slot" UBYTE EH_STANDARD_S4_S3 1 100 0 255 ECU_ADDRESS 0xFFF82809 DISPLAY_IDENTIFIER ambient_condition[1][8].amb_cond.ydiMemory_xau16[18].ZFEH_EepromData /end MEASUREMENT
/begin MEASUREMENT ZFEH_EepromData.ydiMemory_xau16[18].amb_cond.ambient_condition[1][9] "ambient condition shot [0 .. 2-1] with 25 data bytes [0 .. 25-1] for the error code stored in this error memory slot" UBYTE EH_STANDARD_S4_S3 1 100 0 255 ECU_ADDRESS 0xFFF8280A DISPLAY_IDENTIFIER ambient_condition[1][9].amb_cond.ydiMemory_xau16[18].ZFEH_EepromData /end MEASUREMENT
/begin MEASUREMENT ZFEH_EepromData.ydiMemory_xau16[18].amb_cond.status_of_ambient_conditions[0] "status of ambient condition shot x: 0=invalid 1=valid" UBYTE EH_STANDARD_S4_S3 1 100 0 1 ECU_ADDRESS 0xFFF8281A DISPLAY_IDENTIFIER status_of_ambient_conditions[0].amb_cond.ydiMemory_xau16[18].ZFEH_EepromData /end MEASUREMENT
/begin MEASUREMENT ZFEH_EepromData.ydiMemory_xau16[18].amb_cond.status_of_ambient_conditions[1] "status of ambient condition shot x: 0=invalid 1=valid" UBYTE EH_STANDARD_S4_S3 1 100 0 1 ECU_ADDRESS 0xFFF8281B DISPLAY_IDENTIFIER status_of_ambient_conditions[1].amb_cond.ydiMemory_xau16[18].ZFEH_EepromData /end MEASUREMENT
/begin MEASUREMENT ZFEH_EepromData.ydiMemory_xau16[18].backwards_counter "backwards counter of error code stored in error memory slot" UBYTE EH_STANDARD_S4_S3 1 100 0 255 ECU_ADDRESS 0xFFF827DB DISPLAY_IDENTIFIER backwards_counter.ydiMemory_xau16[18].ZFEH_EepromData /end MEASUREMENT
/begin MEASUREMENT ZFEH_EepromData.ydiMemory_xau16[18].condition_byte "condition byte of error code stored in error memory slot" UBYTE EH_STANDARD_S4_S3 1 100 0 255 ECU_ADDRESS 0xFFF827E5 DISPLAY_IDENTIFIER condition_byte.ydiMemory_xau16[18].ZFEH_EepromData /end MEASUREMENT
/begin MEASUREMENT ZFEH_EepromData.ydiMemory_xau16[18].error_code "error code stored in error memory slot" UWORD EH_STANDARD_S4_S3 1 100 0 65535 ECU_ADDRESS 0xFFF827D4 DISPLAY_IDENTIFIER error_code.ydiMemory_xau16[18].ZFEH_EepromData /end MEASUREMENT
/begin MEASUREMENT ZFEH_EepromData.ydiMemory_xau16[18].error_type "error type of error code stored in error memory slot" UWORD EH_STANDARD_S4_S3 1 100 0 65535 ECU_ADDRESS 0xFFF827D6 DISPLAY_IDENTIFIER error_type.ydiMemory_xau16[18].ZFEH_EepromData /end MEASUREMENT
/begin MEASUREMENT ZFEH_EepromData.ydiMemory_xau16[18].frequency_counter "frequency counter of error code stored in error memory slot" UBYTE EH_STANDARD_S4_S3 1 100 0 255 ECU_ADDRESS 0xFFF827DA DISPLAY_IDENTIFIER frequency_counter.ydiMemory_xau16[18].ZFEH_EepromData /end MEASUREMENT
/begin MEASUREMENT ZFEH_EepromData.ydiMemory_xau16[18].master_time "master time of error code stored in error memory slot" ULONG EH_STANDARD_S4_S3 1 100 0 4294967295 ECU_ADDRESS 0xFFF827E0 DISPLAY_IDENTIFIER master_time.ydiMemory_xau16[18].ZFEH_EepromData /end MEASUREMENT
/begin MEASUREMENT ZFEH_EepromData.ydiMemory_xau16[18].obd_driving_cycle_counter "obd driving cycle counter of error code stored in error memory slot" UWORD EH_STANDARD_S4_S3 1 100 0 65535 ECU_ADDRESS 0xFFF827E6 DISPLAY_IDENTIFIER obd_driving_cycle_counter.ydiMemory_xau16[18].ZFEH_EepromData /end MEASUREMENT
/begin MEASUREMENT ZFEH_EepromData.ydiMemory_xau16[18].permanent_counter "counter of permanent error codes stored in error memory slot" UBYTE EH_STANDARD_S4_S3 1 100 0 255 ECU_ADDRESS 0xFFF827DC DISPLAY_IDENTIFIER permanent_counter.ydiMemory_xau16[18].ZFEH_EepromData /end MEASUREMENT
/begin MEASUREMENT ZFEH_EepromData.ydiMemory_xau16[18].sequence_counter "sequence counter of error code stored in error memory slot" UBYTE EH_STANDARD_S4_S3 1 100 0 255 ECU_ADDRESS 0xFFF827DD DISPLAY_IDENTIFIER sequence_counter.ydiMemory_xau16[18].ZFEH_EepromData /end MEASUREMENT
/begin MEASUREMENT ZFEH_EepromData.ydiMemory_xau16[18].status_word "status word of error code stored in error memory slot" UWORD EH_STANDARD_S4_S3 1 100 0 65535 ECU_ADDRESS 0xFFF827D8 DISPLAY_IDENTIFIER status_word.ydiMemory_xau16[18].ZFEH_EepromData /end MEASUREMENT
/begin MEASUREMENT ZFEH_EepromData.ydiMemory_xau16[19].amb_cond.ambient_condition[0][0] "ambient condition shot [0 .. 2-1] with 25 data bytes [0 .. 25-1] for the error code stored in this error memory slot" UBYTE EH_STANDARD_S4_S3 1 100 0 255 ECU_ADDRESS 0xFFF82830 DISPLAY_IDENTIFIER ambient_condition[0][0].amb_cond.ydiMemory_xau16[19].ZFEH_EepromData /end MEASUREMENT
/begin MEASUREMENT ZFEH_EepromData.ydiMemory_xau16[19].amb_cond.ambient_condition[0][10] "ambient condition shot [0 .. 2-1] with 25 data bytes [0 .. 25-1] for the error code stored in this error memory slot" UBYTE EH_STANDARD_S4_S3 1 100 0 255 ECU_ADDRESS 0xFFF8283A DISPLAY_IDENTIFIER ambient_condition[0][10].amb_cond.ydiMemory_xau16[19].ZFEH_EepromData /end MEASUREMENT
/begin MEASUREMENT ZFEH_EepromData.ydiMemory_xau16[19].amb_cond.ambient_condition[0][11] "ambient condition shot [0 .. 2-1] with 25 data bytes [0 .. 25-1] for the error code stored in this error memory slot" UBYTE EH_STANDARD_S4_S3 1 100 0 255 ECU_ADDRESS 0xFFF8283B DISPLAY_IDENTIFIER ambient_condition[0][11].amb_cond.ydiMemory_xau16[19].ZFEH_EepromData /end MEASUREMENT
/begin MEASUREMENT ZFEH_EepromData.ydiMemory_xau16[19].amb_cond.ambient_condition[0][12] "ambient condition shot [0 .. 2-1] with 25 data bytes [0 .. 25-1] for the error code stored in this error memory slot" UBYTE EH_STANDARD_S4_S3 1 100 0 255 ECU_ADDRESS 0xFFF8283C DISPLAY_IDENTIFIER ambient_condition[0][12].amb_cond.ydiMemory_xau16[19].ZFEH_EepromData /end MEASUREMENT
/begin MEASUREMENT ZFEH_EepromData.ydiMemory_xau16[19].amb_cond.ambient_condition[0][13] "ambient condition shot [0 .. 2-1] with 25 data bytes [0 .. 25-1] for the error code stored in this error memory slot" UBYTE EH_STANDARD_S4_S3 1 100 0 255 ECU_ADDRESS 0xFFF8283D DISPLAY_IDENTIFIER ambient_condition[0][13].amb_cond.ydiMemory_xau16[19].ZFEH_EepromData /end MEASUREMENT
/begin MEASUREMENT ZFEH_EepromData.ydiMemory_xau16[19].amb_cond.ambient_condition[0][14] "ambient condition shot [0 .. 2-1] with 25 data bytes [0 .. 25-1] for the error code stored in this error memory slot" UBYTE EH_STANDARD_S4_S3 1 100 0 255 ECU_ADDRESS 0xFFF8283E DISPLAY_IDENTIFIER ambient_condition[0][14].amb_cond.ydiMemory_xau16[19].ZFEH_EepromData /end MEASUREMENT
/begin MEASUREMENT ZFEH_EepromData.ydiMemory_xau16[19].amb_cond.ambient_condition[0][15] "ambient condition shot [0 .. 2-1] with 25 data bytes [0 .. 25-1] for the error code stored in this error memory slot" UBYTE EH_STANDARD_S4_S3 1 100 0 255 ECU_ADDRESS 0xFFF8283F DISPLAY_IDENTIFIER ambient_condition[0][15].amb_cond.ydiMemory_xau16[19].ZFEH_EepromData /end MEASUREMENT
/begin MEASUREMENT ZFEH_EepromData.ydiMemory_xau16[19].amb_cond.ambient_condition[0][16] "ambient condition shot [0 .. 2-1] with 25 data bytes [0 .. 25-1] for the error code stored in this error memory slot" UBYTE EH_STANDARD_S4_S3 1 100 0 255 ECU_ADDRESS 0xFFF82840 DISPLAY_IDENTIFIER ambient_condition[0][16].amb_cond.ydiMemory_xau16[19].ZFEH_EepromData /end MEASUREMENT
/begin MEASUREMENT ZFEH_EepromData.ydiMemory_xau16[19].amb_cond.ambient_condition[0][17] "ambient condition shot [0 .. 2-1] with 25 data bytes [0 .. 25-1] for the error code stored in this error memory slot" UBYTE EH_STANDARD_S4_S3 1 100 0 255 ECU_ADDRESS 0xFFF82841 DISPLAY_IDENTIFIER ambient_condition[0][17].amb_cond.ydiMemory_xau16[19].ZFEH_EepromData /end MEASUREMENT
/begin MEASUREMENT ZFEH_EepromData.ydiMemory_xau16[19].amb_cond.ambient_condition[0][18] "ambient condition shot [0 .. 2-1] with 25 data bytes [0 .. 25-1] for the error code stored in this error memory slot" UBYTE EH_STANDARD_S4_S3 1 100 0 255 ECU_ADDRESS 0xFFF82842 DISPLAY_IDENTIFIER ambient_condition[0][18].amb_cond.ydiMemory_xau16[19].ZFEH_EepromData /end MEASUREMENT
/begin MEASUREMENT ZFEH_EepromData.ydiMemory_xau16[19].amb_cond.ambient_condition[0][19] "ambient condition shot [0 .. 2-1] with 25 data bytes [0 .. 25-1] for the error code stored in this error memory slot" UBYTE EH_STANDARD_S4_S3 1 100 0 255 ECU_ADDRESS 0xFFF82843 DISPLAY_IDENTIFIER ambient_condition[0][19].amb_cond.ydiMemory_xau16[19].ZFEH_EepromData /end MEASUREMENT
/begin MEASUREMENT ZFEH_EepromData.ydiMemory_xau16[19].amb_cond.ambient_condition[0][1] "ambient condition shot [0 .. 2-1] with 25 data bytes [0 .. 25-1] for the error code stored in this error memory slot" UBYTE EH_STANDARD_S4_S3 1 100 0 255 ECU_ADDRESS 0xFFF82831 DISPLAY_IDENTIFIER ambient_condition[0][1].amb_cond.ydiMemory_xau16[19].ZFEH_EepromData /end MEASUREMENT
/begin MEASUREMENT ZFEH_EepromData.ydiMemory_xau16[19].amb_cond.ambient_condition[0][20] "ambient condition shot [0 .. 2-1] with 25 data bytes [0 .. 25-1] for the error code stored in this error memory slot" UBYTE EH_STANDARD_S4_S3 1 100 0 255 ECU_ADDRESS 0xFFF82844 DISPLAY_IDENTIFIER ambient_condition[0][20].amb_cond.ydiMemory_xau16[19].ZFEH_EepromData /end MEASUREMENT
/begin MEASUREMENT ZFEH_EepromData.ydiMemory_xau16[19].amb_cond.ambient_condition[0][21] "ambient condition shot [0 .. 2-1] with 25 data bytes [0 .. 25-1] for the error code stored in this error memory slot" UBYTE EH_STANDARD_S4_S3 1 100 0 255 ECU_ADDRESS 0xFFF82845 DISPLAY_IDENTIFIER ambient_condition[0][21].amb_cond.ydiMemory_xau16[19].ZFEH_EepromData /end MEASUREMENT
/begin MEASUREMENT ZFEH_EepromData.ydiMemory_xau16[19].amb_cond.ambient_condition[0][22] "ambient condition shot [0 .. 2-1] with 25 data bytes [0 .. 25-1] for the error code stored in this error memory slot" UBYTE EH_STANDARD_S4_S3 1 100 0 255 ECU_ADDRESS 0xFFF82846 DISPLAY_IDENTIFIER ambient_condition[0][22].amb_cond.ydiMemory_xau16[19].ZFEH_EepromData /end MEASUREMENT
/begin MEASUREMENT ZFEH_EepromData.ydiMemory_xau16[19].amb_cond.ambient_condition[0][23] "ambient condition shot [0 .. 2-1] with 25 data bytes [0 .. 25-1] for the error code stored in this error memory slot" UBYTE EH_STANDARD_S4_S3 1 100 0 255 ECU_ADDRESS 0xFFF82847 DISPLAY_IDENTIFIER ambient_condition[0][23].amb_cond.ydiMemory_xau16[19].ZFEH_EepromData /end MEASUREMENT
/begin MEASUREMENT ZFEH_EepromData.ydiMemory_xau16[19].amb_cond.ambient_condition[0][24] "ambient condition shot [0 .. 2-1] with 25 data bytes [0 .. 25-1] for the error code stored in this error memory slot" UBYTE EH_STANDARD_S4_S3 1 100 0 255 ECU_ADDRESS 0xFFF82848 DISPLAY_IDENTIFIER ambient_condition[0][24].amb_cond.ydiMemory_xau16[19].ZFEH_EepromData /end MEASUREMENT
/begin MEASUREMENT ZFEH_EepromData.ydiMemory_xau16[19].amb_cond.ambient_condition[0][2] "ambient condition shot [0 .. 2-1] with 25 data bytes [0 .. 25-1] for the error code stored in this error memory slot" UBYTE EH_STANDARD_S4_S3 1 100 0 255 ECU_ADDRESS 0xFFF82832 DISPLAY_IDENTIFIER ambient_condition[0][2].amb_cond.ydiMemory_xau16[19].ZFEH_EepromData /end MEASUREMENT
/begin MEASUREMENT ZFEH_EepromData.ydiMemory_xau16[19].amb_cond.ambient_condition[0][3] "ambient condition shot [0 .. 2-1] with 25 data bytes [0 .. 25-1] for the error code stored in this error memory slot" UBYTE EH_STANDARD_S4_S3 1 100 0 255 ECU_ADDRESS 0xFFF82833 DISPLAY_IDENTIFIER ambient_condition[0][3].amb_cond.ydiMemory_xau16[19].ZFEH_EepromData /end MEASUREMENT
/begin MEASUREMENT ZFEH_EepromData.ydiMemory_xau16[19].amb_cond.ambient_condition[0][4] "ambient condition shot [0 .. 2-1] with 25 data bytes [0 .. 25-1] for the error code stored in this error memory slot" UBYTE EH_STANDARD_S4_S3 1 100 0 255 ECU_ADDRESS 0xFFF82834 DISPLAY_IDENTIFIER ambient_condition[0][4].amb_cond.ydiMemory_xau16[19].ZFEH_EepromData /end MEASUREMENT
/begin MEASUREMENT ZFEH_EepromData.ydiMemory_xau16[19].amb_cond.ambient_condition[0][5] "ambient condition shot [0 .. 2-1] with 25 data bytes [0 .. 25-1] for the error code stored in this error memory slot" UBYTE EH_STANDARD_S4_S3 1 100 0 255 ECU_ADDRESS 0xFFF82835 DISPLAY_IDENTIFIER ambient_condition[0][5].amb_cond.ydiMemory_xau16[19].ZFEH_EepromData /end MEASUREMENT
/begin MEASUREMENT ZFEH_EepromData.ydiMemory_xau16[19].amb_cond.ambient_condition[0][6] "ambient condition shot [0 .. 2-1] with 25 data bytes [0 .. 25-1] for the error code stored in this error memory slot" UBYTE EH_STANDARD_S4_S3 1 100 0 255 ECU_ADDRESS 0xFFF82836 DISPLAY_IDENTIFIER ambient_condition[0][6].amb_cond.ydiMemory_xau16[19].ZFEH_EepromData /end MEASUREMENT
/begin MEASUREMENT ZFEH_EepromData.ydiMemory_xau16[19].amb_cond.ambient_condition[0][7] "ambient condition shot [0 .. 2-1] with 25 data bytes [0 .. 25-1] for the error code stored in this error memory slot" UBYTE EH_STANDARD_S4_S3 1 100 0 255 ECU_ADDRESS 0xFFF82837 DISPLAY_IDENTIFIER ambient_condition[0][7].amb_cond.ydiMemory_xau16[19].ZFEH_EepromData /end MEASUREMENT
/begin MEASUREMENT ZFEH_EepromData.ydiMemory_xau16[19].amb_cond.ambient_condition[0][8] "ambient condition shot [0 .. 2-1] with 25 data bytes [0 .. 25-1] for the error code stored in this error memory slot" UBYTE EH_STANDARD_S4_S3 1 100 0 255 ECU_ADDRESS 0xFFF82838 DISPLAY_IDENTIFIER ambient_condition[0][8].amb_cond.ydiMemory_xau16[19].ZFEH_EepromData /end MEASUREMENT
/begin MEASUREMENT ZFEH_EepromData.ydiMemory_xau16[19].amb_cond.ambient_condition[0][9] "ambient condition shot [0 .. 2-1] with 25 data bytes [0 .. 25-1] for the error code stored in this error memory slot" UBYTE EH_STANDARD_S4_S3 1 100 0 255 ECU_ADDRESS 0xFFF82839 DISPLAY_IDENTIFIER ambient_condition[0][9].amb_cond.ydiMemory_xau16[19].ZFEH_EepromData /end MEASUREMENT
/begin MEASUREMENT ZFEH_EepromData.ydiMemory_xau16[19].amb_cond.ambient_condition[1][0] "ambient condition shot [0 .. 2-1] with 25 data bytes [0 .. 25-1] for the error code stored in this error memory slot" UBYTE EH_STANDARD_S4_S3 1 100 0 255 ECU_ADDRESS 0xFFF82849 DISPLAY_IDENTIFIER ambient_condition[1][0].amb_cond.ydiMemory_xau16[19].ZFEH_EepromData /end MEASUREMENT
/begin MEASUREMENT ZFEH_EepromData.ydiMemory_xau16[19].amb_cond.ambient_condition[1][10] "ambient condition shot [0 .. 2-1] with 25 data bytes [0 .. 25-1] for the error code stored in this error memory slot" UBYTE EH_STANDARD_S4_S3 1 100 0 255 ECU_ADDRESS 0xFFF82853 DISPLAY_IDENTIFIER ambient_condition[1][10].amb_cond.ydiMemory_xau16[19].ZFEH_EepromData /end MEASUREMENT
/begin MEASUREMENT ZFEH_EepromData.ydiMemory_xau16[19].amb_cond.ambient_condition[1][11] "ambient condition shot [0 .. 2-1] with 25 data bytes [0 .. 25-1] for the error code stored in this error memory slot" UBYTE EH_STANDARD_S4_S3 1 100 0 255 ECU_ADDRESS 0xFFF82854 DISPLAY_IDENTIFIER ambient_condition[1][11].amb_cond.ydiMemory_xau16[19].ZFEH_EepromData /end MEASUREMENT
/begin MEASUREMENT ZFEH_EepromData.ydiMemory_xau16[19].amb_cond.ambient_condition[1][12] "ambient condition shot [0 .. 2-1] with 25 data bytes [0 .. 25-1] for the error code stored in this error memory slot" UBYTE EH_STANDARD_S4_S3 1 100 0 255 ECU_ADDRESS 0xFFF82855 DISPLAY_IDENTIFIER ambient_condition[1][12].amb_cond.ydiMemory_xau16[19].ZFEH_EepromData /end MEASUREMENT
/begin MEASUREMENT ZFEH_EepromData.ydiMemory_xau16[19].amb_cond.ambient_condition[1][13] "ambient condition shot [0 .. 2-1] with 25 data bytes [0 .. 25-1] for the error code stored in this error memory slot" UBYTE EH_STANDARD_S4_S3 1 100 0 255 ECU_ADDRESS 0xFFF82856 DISPLAY_IDENTIFIER ambient_condition[1][13].amb_cond.ydiMemory_xau16[19].ZFEH_EepromData /end MEASUREMENT
/begin MEASUREMENT ZFEH_EepromData.ydiMemory_xau16[19].amb_cond.ambient_condition[1][14] "ambient condition shot [0 .. 2-1] with 25 data bytes [0 .. 25-1] for the error code stored in this error memory slot" UBYTE EH_STANDARD_S4_S3 1 100 0 255 ECU_ADDRESS 0xFFF82857 DISPLAY_IDENTIFIER ambient_condition[1][14].amb_cond.ydiMemory_xau16[19].ZFEH_EepromData /end MEASUREMENT
/begin MEASUREMENT ZFEH_EepromData.ydiMemory_xau16[19].amb_cond.ambient_condition[1][15] "ambient condition shot [0 .. 2-1] with 25 data bytes [0 .. 25-1] for the error code stored in this error memory slot" UBYTE EH_STANDARD_S4_S3 1 100 0 255 ECU_ADDRESS 0xFFF82858 DISPLAY_IDENTIFIER ambient_condition[1][15].amb_cond.ydiMemory_xau16[19].ZFEH_EepromData /end MEASUREMENT
/begin MEASUREMENT ZFEH_EepromData.ydiMemory_xau16[19].amb_cond.ambient_condition[1][16] "ambient condition shot [0 .. 2-1] with 25 data bytes [0 .. 25-1] for the error code stored in this error memory slot" UBYTE EH_STANDARD_S4_S3 1 100 0 255 ECU_ADDRESS 0xFFF82859 DISPLAY_IDENTIFIER ambient_condition[1][16].amb_cond.ydiMemory_xau16[19].ZFEH_EepromData /end MEASUREMENT
/begin MEASUREMENT ZFEH_EepromData.ydiMemory_xau16[19].amb_cond.ambient_condition[1][17] "ambient condition shot [0 .. 2-1] with 25 data bytes [0 .. 25-1] for the error code stored in this error memory slot" UBYTE EH_STANDARD_S4_S3 1 100 0 255 ECU_ADDRESS 0xFFF8285A DISPLAY_IDENTIFIER ambient_condition[1][17].amb_cond.ydiMemory_xau16[19].ZFEH_EepromData /end MEASUREMENT
/begin MEASUREMENT ZFEH_EepromData.ydiMemory_xau16[19].amb_cond.ambient_condition[1][18] "ambient condition shot [0 .. 2-1] with 25 data bytes [0 .. 25-1] for the error code stored in this error memory slot" UBYTE EH_STANDARD_S4_S3 1 100 0 255 ECU_ADDRESS 0xFFF8285B DISPLAY_IDENTIFIER ambient_condition[1][18].amb_cond.ydiMemory_xau16[19].ZFEH_EepromData /end MEASUREMENT
/begin MEASUREMENT ZFEH_EepromData.ydiMemory_xau16[19].amb_cond.ambient_condition[1][19] "ambient condition shot [0 .. 2-1] with 25 data bytes [0 .. 25-1] for the error code stored in this error memory slot" UBYTE EH_STANDARD_S4_S3 1 100 0 255 ECU_ADDRESS 0xFFF8285C DISPLAY_IDENTIFIER ambient_condition[1][19].amb_cond.ydiMemory_xau16[19].ZFEH_EepromData /end MEASUREMENT
/begin MEASUREMENT ZFEH_EepromData.ydiMemory_xau16[19].amb_cond.ambient_condition[1][1] "ambient condition shot [0 .. 2-1] with 25 data bytes [0 .. 25-1] for the error code stored in this error memory slot" UBYTE EH_STANDARD_S4_S3 1 100 0 255 ECU_ADDRESS 0xFFF8284A DISPLAY_IDENTIFIER ambient_condition[1][1].amb_cond.ydiMemory_xau16[19].ZFEH_EepromData /end MEASUREMENT
/begin MEASUREMENT ZFEH_EepromData.ydiMemory_xau16[19].amb_cond.ambient_condition[1][20] "ambient condition shot [0 .. 2-1] with 25 data bytes [0 .. 25-1] for the error code stored in this error memory slot" UBYTE EH_STANDARD_S4_S3 1 100 0 255 ECU_ADDRESS 0xFFF8285D DISPLAY_IDENTIFIER ambient_condition[1][20].amb_cond.ydiMemory_xau16[19].ZFEH_EepromData /end MEASUREMENT
/begin MEASUREMENT ZFEH_EepromData.ydiMemory_xau16[19].amb_cond.ambient_condition[1][21] "ambient condition shot [0 .. 2-1] with 25 data bytes [0 .. 25-1] for the error code stored in this error memory slot" UBYTE EH_STANDARD_S4_S3 1 100 0 255 ECU_ADDRESS 0xFFF8285E DISPLAY_IDENTIFIER ambient_condition[1][21].amb_cond.ydiMemory_xau16[19].ZFEH_EepromData /end MEASUREMENT
/begin MEASUREMENT ZFEH_EepromData.ydiMemory_xau16[19].amb_cond.ambient_condition[1][22] "ambient condition shot [0 .. 2-1] with 25 data bytes [0 .. 25-1] for the error code stored in this error memory slot" UBYTE EH_STANDARD_S4_S3 1 100 0 255 ECU_ADDRESS 0xFFF8285F DISPLAY_IDENTIFIER ambient_condition[1][22].amb_cond.ydiMemory_xau16[19].ZFEH_EepromData /end MEASUREMENT
/begin MEASUREMENT ZFEH_EepromData.ydiMemory_xau16[19].amb_cond.ambient_condition[1][23] "ambient condition shot [0 .. 2-1] with 25 data bytes [0 .. 25-1] for the error code stored in this error memory slot" UBYTE EH_STANDARD_S4_S3 1 100 0 255 ECU_ADDRESS 0xFFF82860 DISPLAY_IDENTIFIER ambient_condition[1][23].amb_cond.ydiMemory_xau16[19].ZFEH_EepromData /end MEASUREMENT
/begin MEASUREMENT ZFEH_EepromData.ydiMemory_xau16[19].amb_cond.ambient_condition[1][24] "ambient condition shot [0 .. 2-1] with 25 data bytes [0 .. 25-1] for the error code stored in this error memory slot" UBYTE EH_STANDARD_S4_S3 1 100 0 255 ECU_ADDRESS 0xFFF82861 DISPLAY_IDENTIFIER ambient_condition[1][24].amb_cond.ydiMemory_xau16[19].ZFEH_EepromData /end MEASUREMENT
/begin MEASUREMENT ZFEH_EepromData.ydiMemory_xau16[19].amb_cond.ambient_condition[1][2] "ambient condition shot [0 .. 2-1] with 25 data bytes [0 .. 25-1] for the error code stored in this error memory slot" UBYTE EH_STANDARD_S4_S3 1 100 0 255 ECU_ADDRESS 0xFFF8284B DISPLAY_IDENTIFIER ambient_condition[1][2].amb_cond.ydiMemory_xau16[19].ZFEH_EepromData /end MEASUREMENT
/begin MEASUREMENT ZFEH_EepromData.ydiMemory_xau16[19].amb_cond.ambient_condition[1][3] "ambient condition shot [0 .. 2-1] with 25 data bytes [0 .. 25-1] for the error code stored in this error memory slot" UBYTE EH_STANDARD_S4_S3 1 100 0 255 ECU_ADDRESS 0xFFF8284C DISPLAY_IDENTIFIER ambient_condition[1][3].amb_cond.ydiMemory_xau16[19].ZFEH_EepromData /end MEASUREMENT
/begin MEASUREMENT ZFEH_EepromData.ydiMemory_xau16[19].amb_cond.ambient_condition[1][4] "ambient condition shot [0 .. 2-1] with 25 data bytes [0 .. 25-1] for the error code stored in this error memory slot" UBYTE EH_STANDARD_S4_S3 1 100 0 255 ECU_ADDRESS 0xFFF8284D DISPLAY_IDENTIFIER ambient_condition[1][4].amb_cond.ydiMemory_xau16[19].ZFEH_EepromData /end MEASUREMENT
/begin MEASUREMENT ZFEH_EepromData.ydiMemory_xau16[19].amb_cond.ambient_condition[1][5] "ambient condition shot [0 .. 2-1] with 25 data bytes [0 .. 25-1] for the error code stored in this error memory slot" UBYTE EH_STANDARD_S4_S3 1 100 0 255 ECU_ADDRESS 0xFFF8284E DISPLAY_IDENTIFIER ambient_condition[1][5].amb_cond.ydiMemory_xau16[19].ZFEH_EepromData /end MEASUREMENT
/begin MEASUREMENT ZFEH_EepromData.ydiMemory_xau16[19].amb_cond.ambient_condition[1][6] "ambient condition shot [0 .. 2-1] with 25 data bytes [0 .. 25-1] for the error code stored in this error memory slot" UBYTE EH_STANDARD_S4_S3 1 100 0 255 ECU_ADDRESS 0xFFF8284F DISPLAY_IDENTIFIER ambient_condition[1][6].amb_cond.ydiMemory_xau16[19].ZFEH_EepromData /end MEASUREMENT
/begin MEASUREMENT ZFEH_EepromData.ydiMemory_xau16[19].amb_cond.ambient_condition[1][7] "ambient condition shot [0 .. 2-1] with 25 data bytes [0 .. 25-1] for the error code stored in this error memory slot" UBYTE EH_STANDARD_S4_S3 1 100 0 255 ECU_ADDRESS 0xFFF82850 DISPLAY_IDENTIFIER ambient_condition[1][7].amb_cond.ydiMemory_xau16[19].ZFEH_EepromData /end MEASUREMENT
/begin MEASUREMENT ZFEH_EepromData.ydiMemory_xau16[19].amb_cond.ambient_condition[1][8] "ambient condition shot [0 .. 2-1] with 25 data bytes [0 .. 25-1] for the error code stored in this error memory slot" UBYTE EH_STANDARD_S4_S3 1 100 0 255 ECU_ADDRESS 0xFFF82851 DISPLAY_IDENTIFIER ambient_condition[1][8].amb_cond.ydiMemory_xau16[19].ZFEH_EepromData /end MEASUREMENT
/begin MEASUREMENT ZFEH_EepromData.ydiMemory_xau16[19].amb_cond.ambient_condition[1][9] "ambient condition shot [0 .. 2-1] with 25 data bytes [0 .. 25-1] for the error code stored in this error memory slot" UBYTE EH_STANDARD_S4_S3 1 100 0 255 ECU_ADDRESS 0xFFF82852 DISPLAY_IDENTIFIER ambient_condition[1][9].amb_cond.ydiMemory_xau16[19].ZFEH_EepromData /end MEASUREMENT
/begin MEASUREMENT ZFEH_EepromData.ydiMemory_xau16[19].amb_cond.status_of_ambient_conditions[0] "status of ambient condition shot x: 0=invalid 1=valid" UBYTE EH_STANDARD_S4_S3 1 100 0 1 ECU_ADDRESS 0xFFF82862 DISPLAY_IDENTIFIER status_of_ambient_conditions[0].amb_cond.ydiMemory_xau16[19].ZFEH_EepromData /end MEASUREMENT
/begin MEASUREMENT ZFEH_EepromData.ydiMemory_xau16[19].amb_cond.status_of_ambient_conditions[1] "status of ambient condition shot x: 0=invalid 1=valid" UBYTE EH_STANDARD_S4_S3 1 100 0 1 ECU_ADDRESS 0xFFF82863 DISPLAY_IDENTIFIER status_of_ambient_conditions[1].amb_cond.ydiMemory_xau16[19].ZFEH_EepromData /end MEASUREMENT
/begin MEASUREMENT ZFEH_EepromData.ydiMemory_xau16[19].backwards_counter "backwards counter of error code stored in error memory slot" UBYTE EH_STANDARD_S4_S3 1 100 0 255 ECU_ADDRESS 0xFFF82823 DISPLAY_IDENTIFIER backwards_counter.ydiMemory_xau16[19].ZFEH_EepromData /end MEASUREMENT
/begin MEASUREMENT ZFEH_EepromData.ydiMemory_xau16[19].condition_byte "condition byte of error code stored in error memory slot" UBYTE EH_STANDARD_S4_S3 1 100 0 255 ECU_ADDRESS 0xFFF8282D DISPLAY_IDENTIFIER condition_byte.ydiMemory_xau16[19].ZFEH_EepromData /end MEASUREMENT
/begin MEASUREMENT ZFEH_EepromData.ydiMemory_xau16[19].error_code "error code stored in error memory slot" UWORD EH_STANDARD_S4_S3 1 100 0 65535 ECU_ADDRESS 0xFFF8281C DISPLAY_IDENTIFIER error_code.ydiMemory_xau16[19].ZFEH_EepromData /end MEASUREMENT
/begin MEASUREMENT ZFEH_EepromData.ydiMemory_xau16[19].error_type "error type of error code stored in error memory slot" UWORD EH_STANDARD_S4_S3 1 100 0 65535 ECU_ADDRESS 0xFFF8281E DISPLAY_IDENTIFIER error_type.ydiMemory_xau16[19].ZFEH_EepromData /end MEASUREMENT
/begin MEASUREMENT ZFEH_EepromData.ydiMemory_xau16[19].frequency_counter "frequency counter of error code stored in error memory slot" UBYTE EH_STANDARD_S4_S3 1 100 0 255 ECU_ADDRESS 0xFFF82822 DISPLAY_IDENTIFIER frequency_counter.ydiMemory_xau16[19].ZFEH_EepromData /end MEASUREMENT
/begin MEASUREMENT ZFEH_EepromData.ydiMemory_xau16[19].master_time "master time of error code stored in error memory slot" ULONG EH_STANDARD_S4_S3 1 100 0 4294967295 ECU_ADDRESS 0xFFF82828 DISPLAY_IDENTIFIER master_time.ydiMemory_xau16[19].ZFEH_EepromData /end MEASUREMENT
/begin MEASUREMENT ZFEH_EepromData.ydiMemory_xau16[19].obd_driving_cycle_counter "obd driving cycle counter of error code stored in error memory slot" UWORD EH_STANDARD_S4_S3 1 100 0 65535 ECU_ADDRESS 0xFFF8282E DISPLAY_IDENTIFIER obd_driving_cycle_counter.ydiMemory_xau16[19].ZFEH_EepromData /end MEASUREMENT
/begin MEASUREMENT ZFEH_EepromData.ydiMemory_xau16[19].permanent_counter "counter of permanent error codes stored in error memory slot" UBYTE EH_STANDARD_S4_S3 1 100 0 255 ECU_ADDRESS 0xFFF82824 DISPLAY_IDENTIFIER permanent_counter.ydiMemory_xau16[19].ZFEH_EepromData /end MEASUREMENT
/begin MEASUREMENT ZFEH_EepromData.ydiMemory_xau16[19].sequence_counter "sequence counter of error code stored in error memory slot" UBYTE EH_STANDARD_S4_S3 1 100 0 255 ECU_ADDRESS 0xFFF82825 DISPLAY_IDENTIFIER sequence_counter.ydiMemory_xau16[19].ZFEH_EepromData /end MEASUREMENT
/begin MEASUREMENT ZFEH_EepromData.ydiMemory_xau16[19].status_word "status word of error code stored in error memory slot" UWORD EH_STANDARD_S4_S3 1 100 0 65535 ECU_ADDRESS 0xFFF82820 DISPLAY_IDENTIFIER status_word.ydiMemory_xau16[19].ZFEH_EepromData /end MEASUREMENT
/begin MEASUREMENT ZFEH_EepromData.ydiMemory_xau16[1].amb_cond.ambient_condition[0][0] "ambient condition shot [0 .. 2-1] with 25 data bytes [0 .. 25-1] for the error code stored in this error memory slot" UBYTE EH_STANDARD_S4_S3 1 100 0 255 ECU_ADDRESS 0xFFF82320 DISPLAY_IDENTIFIER ambient_condition[0][0].amb_cond.ydiMemory_xau16[1].ZFEH_EepromData /end MEASUREMENT
/begin MEASUREMENT ZFEH_EepromData.ydiMemory_xau16[1].amb_cond.ambient_condition[0][10] "ambient condition shot [0 .. 2-1] with 25 data bytes [0 .. 25-1] for the error code stored in this error memory slot" UBYTE EH_STANDARD_S4_S3 1 100 0 255 ECU_ADDRESS 0xFFF8232A DISPLAY_IDENTIFIER ambient_condition[0][10].amb_cond.ydiMemory_xau16[1].ZFEH_EepromData /end MEASUREMENT
/begin MEASUREMENT ZFEH_EepromData.ydiMemory_xau16[1].amb_cond.ambient_condition[0][11] "ambient condition shot [0 .. 2-1] with 25 data bytes [0 .. 25-1] for the error code stored in this error memory slot" UBYTE EH_STANDARD_S4_S3 1 100 0 255 ECU_ADDRESS 0xFFF8232B DISPLAY_IDENTIFIER ambient_condition[0][11].amb_cond.ydiMemory_xau16[1].ZFEH_EepromData /end MEASUREMENT
/begin MEASUREMENT ZFEH_EepromData.ydiMemory_xau16[1].amb_cond.ambient_condition[0][12] "ambient condition shot [0 .. 2-1] with 25 data bytes [0 .. 25-1] for the error code stored in this error memory slot" UBYTE EH_STANDARD_S4_S3 1 100 0 255 ECU_ADDRESS 0xFFF8232C DISPLAY_IDENTIFIER ambient_condition[0][12].amb_cond.ydiMemory_xau16[1].ZFEH_EepromData /end MEASUREMENT
/begin MEASUREMENT ZFEH_EepromData.ydiMemory_xau16[1].amb_cond.ambient_condition[0][13] "ambient condition shot [0 .. 2-1] with 25 data bytes [0 .. 25-1] for the error code stored in this error memory slot" UBYTE EH_STANDARD_S4_S3 1 100 0 255 ECU_ADDRESS 0xFFF8232D DISPLAY_IDENTIFIER ambient_condition[0][13].amb_cond.ydiMemory_xau16[1].ZFEH_EepromData /end MEASUREMENT
/begin MEASUREMENT ZFEH_EepromData.ydiMemory_xau16[1].amb_cond.ambient_condition[0][14] "ambient condition shot [0 .. 2-1] with 25 data bytes [0 .. 25-1] for the error code stored in this error memory slot" UBYTE EH_STANDARD_S4_S3 1 100 0 255 ECU_ADDRESS 0xFFF8232E DISPLAY_IDENTIFIER ambient_condition[0][14].amb_cond.ydiMemory_xau16[1].ZFEH_EepromData /end MEASUREMENT
/begin MEASUREMENT ZFEH_EepromData.ydiMemory_xau16[1].amb_cond.ambient_condition[0][15] "ambient condition shot [0 .. 2-1] with 25 data bytes [0 .. 25-1] for the error code stored in this error memory slot" UBYTE EH_STANDARD_S4_S3 1 100 0 255 ECU_ADDRESS 0xFFF8232F DISPLAY_IDENTIFIER ambient_condition[0][15].amb_cond.ydiMemory_xau16[1].ZFEH_EepromData /end MEASUREMENT
/begin MEASUREMENT ZFEH_EepromData.ydiMemory_xau16[1].amb_cond.ambient_condition[0][16] "ambient condition shot [0 .. 2-1] with 25 data bytes [0 .. 25-1] for the error code stored in this error memory slot" UBYTE EH_STANDARD_S4_S3 1 100 0 255 ECU_ADDRESS 0xFFF82330 DISPLAY_IDENTIFIER ambient_condition[0][16].amb_cond.ydiMemory_xau16[1].ZFEH_EepromData /end MEASUREMENT
/begin MEASUREMENT ZFEH_EepromData.ydiMemory_xau16[1].amb_cond.ambient_condition[0][17] "ambient condition shot [0 .. 2-1] with 25 data bytes [0 .. 25-1] for the error code stored in this error memory slot" UBYTE EH_STANDARD_S4_S3 1 100 0 255 ECU_ADDRESS 0xFFF82331 DISPLAY_IDENTIFIER ambient_condition[0][17].amb_cond.ydiMemory_xau16[1].ZFEH_EepromData /end MEASUREMENT
/begin MEASUREMENT ZFEH_EepromData.ydiMemory_xau16[1].amb_cond.ambient_condition[0][18] "ambient condition shot [0 .. 2-1] with 25 data bytes [0 .. 25-1] for the error code stored in this error memory slot" UBYTE EH_STANDARD_S4_S3 1 100 0 255 ECU_ADDRESS 0xFFF82332 DISPLAY_IDENTIFIER ambient_condition[0][18].amb_cond.ydiMemory_xau16[1].ZFEH_EepromData /end MEASUREMENT
/begin MEASUREMENT ZFEH_EepromData.ydiMemory_xau16[1].amb_cond.ambient_condition[0][19] "ambient condition shot [0 .. 2-1] with 25 data bytes [0 .. 25-1] for the error code stored in this error memory slot" UBYTE EH_STANDARD_S4_S3 1 100 0 255 ECU_ADDRESS 0xFFF82333 DISPLAY_IDENTIFIER ambient_condition[0][19].amb_cond.ydiMemory_xau16[1].ZFEH_EepromData /end MEASUREMENT
/begin MEASUREMENT ZFEH_EepromData.ydiMemory_xau16[1].amb_cond.ambient_condition[0][1] "ambient condition shot [0 .. 2-1] with 25 data bytes [0 .. 25-1] for the error code stored in this error memory slot" UBYTE EH_STANDARD_S4_S3 1 100 0 255 ECU_ADDRESS 0xFFF82321 DISPLAY_IDENTIFIER ambient_condition[0][1].amb_cond.ydiMemory_xau16[1].ZFEH_EepromData /end MEASUREMENT
/begin MEASUREMENT ZFEH_EepromData.ydiMemory_xau16[1].amb_cond.ambient_condition[0][20] "ambient condition shot [0 .. 2-1] with 25 data bytes [0 .. 25-1] for the error code stored in this error memory slot" UBYTE EH_STANDARD_S4_S3 1 100 0 255 ECU_ADDRESS 0xFFF82334 DISPLAY_IDENTIFIER ambient_condition[0][20].amb_cond.ydiMemory_xau16[1].ZFEH_EepromData /end MEASUREMENT
/begin MEASUREMENT ZFEH_EepromData.ydiMemory_xau16[1].amb_cond.ambient_condition[0][21] "ambient condition shot [0 .. 2-1] with 25 data bytes [0 .. 25-1] for the error code stored in this error memory slot" UBYTE EH_STANDARD_S4_S3 1 100 0 255 ECU_ADDRESS 0xFFF82335 DISPLAY_IDENTIFIER ambient_condition[0][21].amb_cond.ydiMemory_xau16[1].ZFEH_EepromData /end MEASUREMENT
/begin MEASUREMENT ZFEH_EepromData.ydiMemory_xau16[1].amb_cond.ambient_condition[0][22] "ambient condition shot [0 .. 2-1] with 25 data bytes [0 .. 25-1] for the error code stored in this error memory slot" UBYTE EH_STANDARD_S4_S3 1 100 0 255 ECU_ADDRESS 0xFFF82336 DISPLAY_IDENTIFIER ambient_condition[0][22].amb_cond.ydiMemory_xau16[1].ZFEH_EepromData /end MEASUREMENT
/begin MEASUREMENT ZFEH_EepromData.ydiMemory_xau16[1].amb_cond.ambient_condition[0][23] "ambient condition shot [0 .. 2-1] with 25 data bytes [0 .. 25-1] for the error code stored in this error memory slot" UBYTE EH_STANDARD_S4_S3 1 100 0 255 ECU_ADDRESS 0xFFF82337 DISPLAY_IDENTIFIER ambient_condition[0][23].amb_cond.ydiMemory_xau16[1].ZFEH_EepromData /end MEASUREMENT
/begin MEASUREMENT ZFEH_EepromData.ydiMemory_xau16[1].amb_cond.ambient_condition[0][24] "ambient condition shot [0 .. 2-1] with 25 data bytes [0 .. 25-1] for the error code stored in this error memory slot" UBYTE EH_STANDARD_S4_S3 1 100 0 255 ECU_ADDRESS 0xFFF82338 DISPLAY_IDENTIFIER ambient_condition[0][24].amb_cond.ydiMemory_xau16[1].ZFEH_EepromData /end MEASUREMENT
/begin MEASUREMENT ZFEH_EepromData.ydiMemory_xau16[1].amb_cond.ambient_condition[0][2] "ambient condition shot [0 .. 2-1] with 25 data bytes [0 .. 25-1] for the error code stored in this error memory slot" UBYTE EH_STANDARD_S4_S3 1 100 0 255 ECU_ADDRESS 0xFFF82322 DISPLAY_IDENTIFIER ambient_condition[0][2].amb_cond.ydiMemory_xau16[1].ZFEH_EepromData /end MEASUREMENT
/begin MEASUREMENT ZFEH_EepromData.ydiMemory_xau16[1].amb_cond.ambient_condition[0][3] "ambient condition shot [0 .. 2-1] with 25 data bytes [0 .. 25-1] for the error code stored in this error memory slot" UBYTE EH_STANDARD_S4_S3 1 100 0 255 ECU_ADDRESS 0xFFF82323 DISPLAY_IDENTIFIER ambient_condition[0][3].amb_cond.ydiMemory_xau16[1].ZFEH_EepromData /end MEASUREMENT
/begin MEASUREMENT ZFEH_EepromData.ydiMemory_xau16[1].amb_cond.ambient_condition[0][4] "ambient condition shot [0 .. 2-1] with 25 data bytes [0 .. 25-1] for the error code stored in this error memory slot" UBYTE EH_STANDARD_S4_S3 1 100 0 255 ECU_ADDRESS 0xFFF82324 DISPLAY_IDENTIFIER ambient_condition[0][4].amb_cond.ydiMemory_xau16[1].ZFEH_EepromData /end MEASUREMENT
/begin MEASUREMENT ZFEH_EepromData.ydiMemory_xau16[1].amb_cond.ambient_condition[0][5] "ambient condition shot [0 .. 2-1] with 25 data bytes [0 .. 25-1] for the error code stored in this error memory slot" UBYTE EH_STANDARD_S4_S3 1 100 0 255 ECU_ADDRESS 0xFFF82325 DISPLAY_IDENTIFIER ambient_condition[0][5].amb_cond.ydiMemory_xau16[1].ZFEH_EepromData /end MEASUREMENT
/begin MEASUREMENT ZFEH_EepromData.ydiMemory_xau16[1].amb_cond.ambient_condition[0][6] "ambient condition shot [0 .. 2-1] with 25 data bytes [0 .. 25-1] for the error code stored in this error memory slot" UBYTE EH_STANDARD_S4_S3 1 100 0 255 ECU_ADDRESS 0xFFF82326 DISPLAY_IDENTIFIER ambient_condition[0][6].amb_cond.ydiMemory_xau16[1].ZFEH_EepromData /end MEASUREMENT
/begin MEASUREMENT ZFEH_EepromData.ydiMemory_xau16[1].amb_cond.ambient_condition[0][7] "ambient condition shot [0 .. 2-1] with 25 data bytes [0 .. 25-1] for the error code stored in this error memory slot" UBYTE EH_STANDARD_S4_S3 1 100 0 255 ECU_ADDRESS 0xFFF82327 DISPLAY_IDENTIFIER ambient_condition[0][7].amb_cond.ydiMemory_xau16[1].ZFEH_EepromData /end MEASUREMENT
/begin MEASUREMENT ZFEH_EepromData.ydiMemory_xau16[1].amb_cond.ambient_condition[0][8] "ambient condition shot [0 .. 2-1] with 25 data bytes [0 .. 25-1] for the error code stored in this error memory slot" UBYTE EH_STANDARD_S4_S3 1 100 0 255 ECU_ADDRESS 0xFFF82328 DISPLAY_IDENTIFIER ambient_condition[0][8].amb_cond.ydiMemory_xau16[1].ZFEH_EepromData /end MEASUREMENT
/begin MEASUREMENT ZFEH_EepromData.ydiMemory_xau16[1].amb_cond.ambient_condition[0][9] "ambient condition shot [0 .. 2-1] with 25 data bytes [0 .. 25-1] for the error code stored in this error memory slot" UBYTE EH_STANDARD_S4_S3 1 100 0 255 ECU_ADDRESS 0xFFF82329 DISPLAY_IDENTIFIER ambient_condition[0][9].amb_cond.ydiMemory_xau16[1].ZFEH_EepromData /end MEASUREMENT
/begin MEASUREMENT ZFEH_EepromData.ydiMemory_xau16[1].amb_cond.ambient_condition[1][0] "ambient condition shot [0 .. 2-1] with 25 data bytes [0 .. 25-1] for the error code stored in this error memory slot" UBYTE EH_STANDARD_S4_S3 1 100 0 255 ECU_ADDRESS 0xFFF82339 DISPLAY_IDENTIFIER ambient_condition[1][0].amb_cond.ydiMemory_xau16[1].ZFEH_EepromData /end MEASUREMENT
/begin MEASUREMENT ZFEH_EepromData.ydiMemory_xau16[1].amb_cond.ambient_condition[1][10] "ambient condition shot [0 .. 2-1] with 25 data bytes [0 .. 25-1] for the error code stored in this error memory slot" UBYTE EH_STANDARD_S4_S3 1 100 0 255 ECU_ADDRESS 0xFFF82343 DISPLAY_IDENTIFIER ambient_condition[1][10].amb_cond.ydiMemory_xau16[1].ZFEH_EepromData /end MEASUREMENT
/begin MEASUREMENT ZFEH_EepromData.ydiMemory_xau16[1].amb_cond.ambient_condition[1][11] "ambient condition shot [0 .. 2-1] with 25 data bytes [0 .. 25-1] for the error code stored in this error memory slot" UBYTE EH_STANDARD_S4_S3 1 100 0 255 ECU_ADDRESS 0xFFF82344 DISPLAY_IDENTIFIER ambient_condition[1][11].amb_cond.ydiMemory_xau16[1].ZFEH_EepromData /end MEASUREMENT
/begin MEASUREMENT ZFEH_EepromData.ydiMemory_xau16[1].amb_cond.ambient_condition[1][12] "ambient condition shot [0 .. 2-1] with 25 data bytes [0 .. 25-1] for the error code stored in this error memory slot" UBYTE EH_STANDARD_S4_S3 1 100 0 255 ECU_ADDRESS 0xFFF82345 DISPLAY_IDENTIFIER ambient_condition[1][12].amb_cond.ydiMemory_xau16[1].ZFEH_EepromData /end MEASUREMENT
/begin MEASUREMENT ZFEH_EepromData.ydiMemory_xau16[1].amb_cond.ambient_condition[1][13] "ambient condition shot [0 .. 2-1] with 25 data bytes [0 .. 25-1] for the error code stored in this error memory slot" UBYTE EH_STANDARD_S4_S3 1 100 0 255 ECU_ADDRESS 0xFFF82346 DISPLAY_IDENTIFIER ambient_condition[1][13].amb_cond.ydiMemory_xau16[1].ZFEH_EepromData /end MEASUREMENT
/begin MEASUREMENT ZFEH_EepromData.ydiMemory_xau16[1].amb_cond.ambient_condition[1][14] "ambient condition shot [0 .. 2-1] with 25 data bytes [0 .. 25-1] for the error code stored in this error memory slot" UBYTE EH_STANDARD_S4_S3 1 100 0 255 ECU_ADDRESS 0xFFF82347 DISPLAY_IDENTIFIER ambient_condition[1][14].amb_cond.ydiMemory_xau16[1].ZFEH_EepromData /end MEASUREMENT
/begin MEASUREMENT ZFEH_EepromData.ydiMemory_xau16[1].amb_cond.ambient_condition[1][15] "ambient condition shot [0 .. 2-1] with 25 data bytes [0 .. 25-1] for the error code stored in this error memory slot" UBYTE EH_STANDARD_S4_S3 1 100 0 255 ECU_ADDRESS 0xFFF82348 DISPLAY_IDENTIFIER ambient_condition[1][15].amb_cond.ydiMemory_xau16[1].ZFEH_EepromData /end MEASUREMENT
/begin MEASUREMENT ZFEH_EepromData.ydiMemory_xau16[1].amb_cond.ambient_condition[1][16] "ambient condition shot [0 .. 2-1] with 25 data bytes [0 .. 25-1] for the error code stored in this error memory slot" UBYTE EH_STANDARD_S4_S3 1 100 0 255 ECU_ADDRESS 0xFFF82349 DISPLAY_IDENTIFIER ambient_condition[1][16].amb_cond.ydiMemory_xau16[1].ZFEH_EepromData /end MEASUREMENT
/begin MEASUREMENT ZFEH_EepromData.ydiMemory_xau16[1].amb_cond.ambient_condition[1][17] "ambient condition shot [0 .. 2-1] with 25 data bytes [0 .. 25-1] for the error code stored in this error memory slot" UBYTE EH_STANDARD_S4_S3 1 100 0 255 ECU_ADDRESS 0xFFF8234A DISPLAY_IDENTIFIER ambient_condition[1][17].amb_cond.ydiMemory_xau16[1].ZFEH_EepromData /end MEASUREMENT
/begin MEASUREMENT ZFEH_EepromData.ydiMemory_xau16[1].amb_cond.ambient_condition[1][18] "ambient condition shot [0 .. 2-1] with 25 data bytes [0 .. 25-1] for the error code stored in this error memory slot" UBYTE EH_STANDARD_S4_S3 1 100 0 255 ECU_ADDRESS 0xFFF8234B DISPLAY_IDENTIFIER ambient_condition[1][18].amb_cond.ydiMemory_xau16[1].ZFEH_EepromData /end MEASUREMENT
/begin MEASUREMENT ZFEH_EepromData.ydiMemory_xau16[1].amb_cond.ambient_condition[1][19] "ambient condition shot [0 .. 2-1] with 25 data bytes [0 .. 25-1] for the error code stored in this error memory slot" UBYTE EH_STANDARD_S4_S3 1 100 0 255 ECU_ADDRESS 0xFFF8234C DISPLAY_IDENTIFIER ambient_condition[1][19].amb_cond.ydiMemory_xau16[1].ZFEH_EepromData /end MEASUREMENT
/begin MEASUREMENT ZFEH_EepromData.ydiMemory_xau16[1].amb_cond.ambient_condition[1][1] "ambient condition shot [0 .. 2-1] with 25 data bytes [0 .. 25-1] for the error code stored in this error memory slot" UBYTE EH_STANDARD_S4_S3 1 100 0 255 ECU_ADDRESS 0xFFF8233A DISPLAY_IDENTIFIER ambient_condition[1][1].amb_cond.ydiMemory_xau16[1].ZFEH_EepromData /end MEASUREMENT
/begin MEASUREMENT ZFEH_EepromData.ydiMemory_xau16[1].amb_cond.ambient_condition[1][20] "ambient condition shot [0 .. 2-1] with 25 data bytes [0 .. 25-1] for the error code stored in this error memory slot" UBYTE EH_STANDARD_S4_S3 1 100 0 255 ECU_ADDRESS 0xFFF8234D DISPLAY_IDENTIFIER ambient_condition[1][20].amb_cond.ydiMemory_xau16[1].ZFEH_EepromData /end MEASUREMENT
/begin MEASUREMENT ZFEH_EepromData.ydiMemory_xau16[1].amb_cond.ambient_condition[1][21] "ambient condition shot [0 .. 2-1] with 25 data bytes [0 .. 25-1] for the error code stored in this error memory slot" UBYTE EH_STANDARD_S4_S3 1 100 0 255 ECU_ADDRESS 0xFFF8234E DISPLAY_IDENTIFIER ambient_condition[1][21].amb_cond.ydiMemory_xau16[1].ZFEH_EepromData /end MEASUREMENT
/begin MEASUREMENT ZFEH_EepromData.ydiMemory_xau16[1].amb_cond.ambient_condition[1][22] "ambient condition shot [0 .. 2-1] with 25 data bytes [0 .. 25-1] for the error code stored in this error memory slot" UBYTE EH_STANDARD_S4_S3 1 100 0 255 ECU_ADDRESS 0xFFF8234F DISPLAY_IDENTIFIER ambient_condition[1][22].amb_cond.ydiMemory_xau16[1].ZFEH_EepromData /end MEASUREMENT
/begin MEASUREMENT ZFEH_EepromData.ydiMemory_xau16[1].amb_cond.ambient_condition[1][23] "ambient condition shot [0 .. 2-1] with 25 data bytes [0 .. 25-1] for the error code stored in this error memory slot" UBYTE EH_STANDARD_S4_S3 1 100 0 255 ECU_ADDRESS 0xFFF82350 DISPLAY_IDENTIFIER ambient_condition[1][23].amb_cond.ydiMemory_xau16[1].ZFEH_EepromData /end MEASUREMENT
/begin MEASUREMENT ZFEH_EepromData.ydiMemory_xau16[1].amb_cond.ambient_condition[1][24] "ambient condition shot [0 .. 2-1] with 25 data bytes [0 .. 25-1] for the error code stored in this error memory slot" UBYTE EH_STANDARD_S4_S3 1 100 0 255 ECU_ADDRESS 0xFFF82351 DISPLAY_IDENTIFIER ambient_condition[1][24].amb_cond.ydiMemory_xau16[1].ZFEH_EepromData /end MEASUREMENT
/begin MEASUREMENT ZFEH_EepromData.ydiMemory_xau16[1].amb_cond.ambient_condition[1][2] "ambient condition shot [0 .. 2-1] with 25 data bytes [0 .. 25-1] for the error code stored in this error memory slot" UBYTE EH_STANDARD_S4_S3 1 100 0 255 ECU_ADDRESS 0xFFF8233B DISPLAY_IDENTIFIER ambient_condition[1][2].amb_cond.ydiMemory_xau16[1].ZFEH_EepromData /end MEASUREMENT
/begin MEASUREMENT ZFEH_EepromData.ydiMemory_xau16[1].amb_cond.ambient_condition[1][3] "ambient condition shot [0 .. 2-1] with 25 data bytes [0 .. 25-1] for the error code stored in this error memory slot" UBYTE EH_STANDARD_S4_S3 1 100 0 255 ECU_ADDRESS 0xFFF8233C DISPLAY_IDENTIFIER ambient_condition[1][3].amb_cond.ydiMemory_xau16[1].ZFEH_EepromData /end MEASUREMENT
/begin MEASUREMENT ZFEH_EepromData.ydiMemory_xau16[1].amb_cond.ambient_condition[1][4] "ambient condition shot [0 .. 2-1] with 25 data bytes [0 .. 25-1] for the error code stored in this error memory slot" UBYTE EH_STANDARD_S4_S3 1 100 0 255 ECU_ADDRESS 0xFFF8233D DISPLAY_IDENTIFIER ambient_condition[1][4].amb_cond.ydiMemory_xau16[1].ZFEH_EepromData /end MEASUREMENT
/begin MEASUREMENT ZFEH_EepromData.ydiMemory_xau16[1].amb_cond.ambient_condition[1][5] "ambient condition shot [0 .. 2-1] with 25 data bytes [0 .. 25-1] for the error code stored in this error memory slot" UBYTE EH_STANDARD_S4_S3 1 100 0 255 ECU_ADDRESS 0xFFF8233E DISPLAY_IDENTIFIER ambient_condition[1][5].amb_cond.ydiMemory_xau16[1].ZFEH_EepromData /end MEASUREMENT
/begin MEASUREMENT ZFEH_EepromData.ydiMemory_xau16[1].amb_cond.ambient_condition[1][6] "ambient condition shot [0 .. 2-1] with 25 data bytes [0 .. 25-1] for the error code stored in this error memory slot" UBYTE EH_STANDARD_S4_S3 1 100 0 255 ECU_ADDRESS 0xFFF8233F DISPLAY_IDENTIFIER ambient_condition[1][6].amb_cond.ydiMemory_xau16[1].ZFEH_EepromData /end MEASUREMENT
/begin MEASUREMENT ZFEH_EepromData.ydiMemory_xau16[1].amb_cond.ambient_condition[1][7] "ambient condition shot [0 .. 2-1] with 25 data bytes [0 .. 25-1] for the error code stored in this error memory slot" UBYTE EH_STANDARD_S4_S3 1 100 0 255 ECU_ADDRESS 0xFFF82340 DISPLAY_IDENTIFIER ambient_condition[1][7].amb_cond.ydiMemory_xau16[1].ZFEH_EepromData /end MEASUREMENT
/begin MEASUREMENT ZFEH_EepromData.ydiMemory_xau16[1].amb_cond.ambient_condition[1][8] "ambient condition shot [0 .. 2-1] with 25 data bytes [0 .. 25-1] for the error code stored in this error memory slot" UBYTE EH_STANDARD_S4_S3 1 100 0 255 ECU_ADDRESS 0xFFF82341 DISPLAY_IDENTIFIER ambient_condition[1][8].amb_cond.ydiMemory_xau16[1].ZFEH_EepromData /end MEASUREMENT
/begin MEASUREMENT ZFEH_EepromData.ydiMemory_xau16[1].amb_cond.ambient_condition[1][9] "ambient condition shot [0 .. 2-1] with 25 data bytes [0 .. 25-1] for the error code stored in this error memory slot" UBYTE EH_STANDARD_S4_S3 1 100 0 255 ECU_ADDRESS 0xFFF82342 DISPLAY_IDENTIFIER ambient_condition[1][9].amb_cond.ydiMemory_xau16[1].ZFEH_EepromData /end MEASUREMENT
/begin MEASUREMENT ZFEH_EepromData.ydiMemory_xau16[1].amb_cond.status_of_ambient_conditions[0] "status of ambient condition shot x: 0=invalid 1=valid" UBYTE EH_STANDARD_S4_S3 1 100 0 1 ECU_ADDRESS 0xFFF82352 DISPLAY_IDENTIFIER status_of_ambient_conditions[0].amb_cond.ydiMemory_xau16[1].ZFEH_EepromData /end MEASUREMENT
/begin MEASUREMENT ZFEH_EepromData.ydiMemory_xau16[1].amb_cond.status_of_ambient_conditions[1] "status of ambient condition shot x: 0=invalid 1=valid" UBYTE EH_STANDARD_S4_S3 1 100 0 1 ECU_ADDRESS 0xFFF82353 DISPLAY_IDENTIFIER status_of_ambient_conditions[1].amb_cond.ydiMemory_xau16[1].ZFEH_EepromData /end MEASUREMENT
/begin MEASUREMENT ZFEH_EepromData.ydiMemory_xau16[1].backwards_counter "backwards counter of error code stored in error memory slot" UBYTE EH_STANDARD_S4_S3 1 100 0 255 ECU_ADDRESS 0xFFF82313 DISPLAY_IDENTIFIER backwards_counter.ydiMemory_xau16[1].ZFEH_EepromData /end MEASUREMENT
/begin MEASUREMENT ZFEH_EepromData.ydiMemory_xau16[1].condition_byte "condition byte of error code stored in error memory slot" UBYTE EH_STANDARD_S4_S3 1 100 0 255 ECU_ADDRESS 0xFFF8231D DISPLAY_IDENTIFIER condition_byte.ydiMemory_xau16[1].ZFEH_EepromData /end MEASUREMENT
/begin MEASUREMENT ZFEH_EepromData.ydiMemory_xau16[1].error_code "error code stored in error memory slot" UWORD EH_STANDARD_S4_S3 1 100 0 65535 ECU_ADDRESS 0xFFF8230C DISPLAY_IDENTIFIER error_code.ydiMemory_xau16[1].ZFEH_EepromData /end MEASUREMENT
/begin MEASUREMENT ZFEH_EepromData.ydiMemory_xau16[1].error_type "error type of error code stored in error memory slot" UWORD EH_STANDARD_S4_S3 1 100 0 65535 ECU_ADDRESS 0xFFF8230E DISPLAY_IDENTIFIER error_type.ydiMemory_xau16[1].ZFEH_EepromData /end MEASUREMENT
/begin MEASUREMENT ZFEH_EepromData.ydiMemory_xau16[1].frequency_counter "frequency counter of error code stored in error memory slot" UBYTE EH_STANDARD_S4_S3 1 100 0 255 ECU_ADDRESS 0xFFF82312 DISPLAY_IDENTIFIER frequency_counter.ydiMemory_xau16[1].ZFEH_EepromData /end MEASUREMENT
/begin MEASUREMENT ZFEH_EepromData.ydiMemory_xau16[1].master_time "master time of error code stored in error memory slot" ULONG EH_STANDARD_S4_S3 1 100 0 4294967295 ECU_ADDRESS 0xFFF82318 DISPLAY_IDENTIFIER master_time.ydiMemory_xau16[1].ZFEH_EepromData /end MEASUREMENT
/begin MEASUREMENT ZFEH_EepromData.ydiMemory_xau16[1].obd_driving_cycle_counter "obd driving cycle counter of error code stored in error memory slot" UWORD EH_STANDARD_S4_S3 1 100 0 65535 ECU_ADDRESS 0xFFF8231E DISPLAY_IDENTIFIER obd_driving_cycle_counter.ydiMemory_xau16[1].ZFEH_EepromData /end MEASUREMENT
/begin MEASUREMENT ZFEH_EepromData.ydiMemory_xau16[1].permanent_counter "counter of permanent error codes stored in error memory slot" UBYTE EH_STANDARD_S4_S3 1 100 0 255 ECU_ADDRESS 0xFFF82314 DISPLAY_IDENTIFIER permanent_counter.ydiMemory_xau16[1].ZFEH_EepromData /end MEASUREMENT
/begin MEASUREMENT ZFEH_EepromData.ydiMemory_xau16[1].sequence_counter "sequence counter of error code stored in error memory slot" UBYTE EH_STANDARD_S4_S3 1 100 0 255 ECU_ADDRESS 0xFFF82315 DISPLAY_IDENTIFIER sequence_counter.ydiMemory_xau16[1].ZFEH_EepromData /end MEASUREMENT
/begin MEASUREMENT ZFEH_EepromData.ydiMemory_xau16[1].status_word "status word of error code stored in error memory slot" UWORD EH_STANDARD_S4_S3 1 100 0 65535 ECU_ADDRESS 0xFFF82310 DISPLAY_IDENTIFIER status_word.ydiMemory_xau16[1].ZFEH_EepromData /end MEASUREMENT
/begin MEASUREMENT ZFEH_EepromData.ydiMemory_xau16[2].amb_cond.ambient_condition[0][0] "ambient condition shot [0 .. 2-1] with 25 data bytes [0 .. 25-1] for the error code stored in this error memory slot" UBYTE EH_STANDARD_S4_S3 1 100 0 255 ECU_ADDRESS 0xFFF82368 DISPLAY_IDENTIFIER ambient_condition[0][0].amb_cond.ydiMemory_xau16[2].ZFEH_EepromData /end MEASUREMENT
/begin MEASUREMENT ZFEH_EepromData.ydiMemory_xau16[2].amb_cond.ambient_condition[0][10] "ambient condition shot [0 .. 2-1] with 25 data bytes [0 .. 25-1] for the error code stored in this error memory slot" UBYTE EH_STANDARD_S4_S3 1 100 0 255 ECU_ADDRESS 0xFFF82372 DISPLAY_IDENTIFIER ambient_condition[0][10].amb_cond.ydiMemory_xau16[2].ZFEH_EepromData /end MEASUREMENT
/begin MEASUREMENT ZFEH_EepromData.ydiMemory_xau16[2].amb_cond.ambient_condition[0][11] "ambient condition shot [0 .. 2-1] with 25 data bytes [0 .. 25-1] for the error code stored in this error memory slot" UBYTE EH_STANDARD_S4_S3 1 100 0 255 ECU_ADDRESS 0xFFF82373 DISPLAY_IDENTIFIER ambient_condition[0][11].amb_cond.ydiMemory_xau16[2].ZFEH_EepromData /end MEASUREMENT
/begin MEASUREMENT ZFEH_EepromData.ydiMemory_xau16[2].amb_cond.ambient_condition[0][12] "ambient condition shot [0 .. 2-1] with 25 data bytes [0 .. 25-1] for the error code stored in this error memory slot" UBYTE EH_STANDARD_S4_S3 1 100 0 255 ECU_ADDRESS 0xFFF82374 DISPLAY_IDENTIFIER ambient_condition[0][12].amb_cond.ydiMemory_xau16[2].ZFEH_EepromData /end MEASUREMENT
/begin MEASUREMENT ZFEH_EepromData.ydiMemory_xau16[2].amb_cond.ambient_condition[0][13] "ambient condition shot [0 .. 2-1] with 25 data bytes [0 .. 25-1] for the error code stored in this error memory slot" UBYTE EH_STANDARD_S4_S3 1 100 0 255 ECU_ADDRESS 0xFFF82375 DISPLAY_IDENTIFIER ambient_condition[0][13].amb_cond.ydiMemory_xau16[2].ZFEH_EepromData /end MEASUREMENT
/begin MEASUREMENT ZFEH_EepromData.ydiMemory_xau16[2].amb_cond.ambient_condition[0][14] "ambient condition shot [0 .. 2-1] with 25 data bytes [0 .. 25-1] for the error code stored in this error memory slot" UBYTE EH_STANDARD_S4_S3 1 100 0 255 ECU_ADDRESS 0xFFF82376 DISPLAY_IDENTIFIER ambient_condition[0][14].amb_cond.ydiMemory_xau16[2].ZFEH_EepromData /end MEASUREMENT
/begin MEASUREMENT ZFEH_EepromData.ydiMemory_xau16[2].amb_cond.ambient_condition[0][15] "ambient condition shot [0 .. 2-1] with 25 data bytes [0 .. 25-1] for the error code stored in this error memory slot" UBYTE EH_STANDARD_S4_S3 1 100 0 255 ECU_ADDRESS 0xFFF82377 DISPLAY_IDENTIFIER ambient_condition[0][15].amb_cond.ydiMemory_xau16[2].ZFEH_EepromData /end MEASUREMENT
/begin MEASUREMENT ZFEH_EepromData.ydiMemory_xau16[2].amb_cond.ambient_condition[0][16] "ambient condition shot [0 .. 2-1] with 25 data bytes [0 .. 25-1] for the error code stored in this error memory slot" UBYTE EH_STANDARD_S4_S3 1 100 0 255 ECU_ADDRESS 0xFFF82378 DISPLAY_IDENTIFIER ambient_condition[0][16].amb_cond.ydiMemory_xau16[2].ZFEH_EepromData /end MEASUREMENT
/begin MEASUREMENT ZFEH_EepromData.ydiMemory_xau16[2].amb_cond.ambient_condition[0][17] "ambient condition shot [0 .. 2-1] with 25 data bytes [0 .. 25-1] for the error code stored in this error memory slot" UBYTE EH_STANDARD_S4_S3 1 100 0 255 ECU_ADDRESS 0xFFF82379 DISPLAY_IDENTIFIER ambient_condition[0][17].amb_cond.ydiMemory_xau16[2].ZFEH_EepromData /end MEASUREMENT
/begin MEASUREMENT ZFEH_EepromData.ydiMemory_xau16[2].amb_cond.ambient_condition[0][18] "ambient condition shot [0 .. 2-1] with 25 data bytes [0 .. 25-1] for the error code stored in this error memory slot" UBYTE EH_STANDARD_S4_S3 1 100 0 255 ECU_ADDRESS 0xFFF8237A DISPLAY_IDENTIFIER ambient_condition[0][18].amb_cond.ydiMemory_xau16[2].ZFEH_EepromData /end MEASUREMENT
/begin MEASUREMENT ZFEH_EepromData.ydiMemory_xau16[2].amb_cond.ambient_condition[0][19] "ambient condition shot [0 .. 2-1] with 25 data bytes [0 .. 25-1] for the error code stored in this error memory slot" UBYTE EH_STANDARD_S4_S3 1 100 0 255 ECU_ADDRESS 0xFFF8237B DISPLAY_IDENTIFIER ambient_condition[0][19].amb_cond.ydiMemory_xau16[2].ZFEH_EepromData /end MEASUREMENT
/begin MEASUREMENT ZFEH_EepromData.ydiMemory_xau16[2].amb_cond.ambient_condition[0][1] "ambient condition shot [0 .. 2-1] with 25 data bytes [0 .. 25-1] for the error code stored in this error memory slot" UBYTE EH_STANDARD_S4_S3 1 100 0 255 ECU_ADDRESS 0xFFF82369 DISPLAY_IDENTIFIER ambient_condition[0][1].amb_cond.ydiMemory_xau16[2].ZFEH_EepromData /end MEASUREMENT
/begin MEASUREMENT ZFEH_EepromData.ydiMemory_xau16[2].amb_cond.ambient_condition[0][20] "ambient condition shot [0 .. 2-1] with 25 data bytes [0 .. 25-1] for the error code stored in this error memory slot" UBYTE EH_STANDARD_S4_S3 1 100 0 255 ECU_ADDRESS 0xFFF8237C DISPLAY_IDENTIFIER ambient_condition[0][20].amb_cond.ydiMemory_xau16[2].ZFEH_EepromData /end MEASUREMENT
/begin MEASUREMENT ZFEH_EepromData.ydiMemory_xau16[2].amb_cond.ambient_condition[0][21] "ambient condition shot [0 .. 2-1] with 25 data bytes [0 .. 25-1] for the error code stored in this error memory slot" UBYTE EH_STANDARD_S4_S3 1 100 0 255 ECU_ADDRESS 0xFFF8237D DISPLAY_IDENTIFIER ambient_condition[0][21].amb_cond.ydiMemory_xau16[2].ZFEH_EepromData /end MEASUREMENT
/begin MEASUREMENT ZFEH_EepromData.ydiMemory_xau16[2].amb_cond.ambient_condition[0][22] "ambient condition shot [0 .. 2-1] with 25 data bytes [0 .. 25-1] for the error code stored in this error memory slot" UBYTE EH_STANDARD_S4_S3 1 100 0 255 ECU_ADDRESS 0xFFF8237E DISPLAY_IDENTIFIER ambient_condition[0][22].amb_cond.ydiMemory_xau16[2].ZFEH_EepromData /end MEASUREMENT
/begin MEASUREMENT ZFEH_EepromData.ydiMemory_xau16[2].amb_cond.ambient_condition[0][23] "ambient condition shot [0 .. 2-1] with 25 data bytes [0 .. 25-1] for the error code stored in this error memory slot" UBYTE EH_STANDARD_S4_S3 1 100 0 255 ECU_ADDRESS 0xFFF8237F DISPLAY_IDENTIFIER ambient_condition[0][23].amb_cond.ydiMemory_xau16[2].ZFEH_EepromData /end MEASUREMENT
/begin MEASUREMENT ZFEH_EepromData.ydiMemory_xau16[2].amb_cond.ambient_condition[0][24] "ambient condition shot [0 .. 2-1] with 25 data bytes [0 .. 25-1] for the error code stored in this error memory slot" UBYTE EH_STANDARD_S4_S3 1 100 0 255 ECU_ADDRESS 0xFFF82380 DISPLAY_IDENTIFIER ambient_condition[0][24].amb_cond.ydiMemory_xau16[2].ZFEH_EepromData /end MEASUREMENT
/begin MEASUREMENT ZFEH_EepromData.ydiMemory_xau16[2].amb_cond.ambient_condition[0][2] "ambient condition shot [0 .. 2-1] with 25 data bytes [0 .. 25-1] for the error code stored in this error memory slot" UBYTE EH_STANDARD_S4_S3 1 100 0 255 ECU_ADDRESS 0xFFF8236A DISPLAY_IDENTIFIER ambient_condition[0][2].amb_cond.ydiMemory_xau16[2].ZFEH_EepromData /end MEASUREMENT
/begin MEASUREMENT ZFEH_EepromData.ydiMemory_xau16[2].amb_cond.ambient_condition[0][3] "ambient condition shot [0 .. 2-1] with 25 data bytes [0 .. 25-1] for the error code stored in this error memory slot" UBYTE EH_STANDARD_S4_S3 1 100 0 255 ECU_ADDRESS 0xFFF8236B DISPLAY_IDENTIFIER ambient_condition[0][3].amb_cond.ydiMemory_xau16[2].ZFEH_EepromData /end MEASUREMENT
/begin MEASUREMENT ZFEH_EepromData.ydiMemory_xau16[2].amb_cond.ambient_condition[0][4] "ambient condition shot [0 .. 2-1] with 25 data bytes [0 .. 25-1] for the error code stored in this error memory slot" UBYTE EH_STANDARD_S4_S3 1 100 0 255 ECU_ADDRESS 0xFFF8236C DISPLAY_IDENTIFIER ambient_condition[0][4].amb_cond.ydiMemory_xau16[2].ZFEH_EepromData /end MEASUREMENT
/begin MEASUREMENT ZFEH_EepromData.ydiMemory_xau16[2].amb_cond.ambient_condition[0][5] "ambient condition shot [0 .. 2-1] with 25 data bytes [0 .. 25-1] for the error code stored in this error memory slot" UBYTE EH_STANDARD_S4_S3 1 100 0 255 ECU_ADDRESS 0xFFF8236D DISPLAY_IDENTIFIER ambient_condition[0][5].amb_cond.ydiMemory_xau16[2].ZFEH_EepromData /end MEASUREMENT
/begin MEASUREMENT ZFEH_EepromData.ydiMemory_xau16[2].amb_cond.ambient_condition[0][6] "ambient condition shot [0 .. 2-1] with 25 data bytes [0 .. 25-1] for the error code stored in this error memory slot" UBYTE EH_STANDARD_S4_S3 1 100 0 255 ECU_ADDRESS 0xFFF8236E DISPLAY_IDENTIFIER ambient_condition[0][6].amb_cond.ydiMemory_xau16[2].ZFEH_EepromData /end MEASUREMENT
/begin MEASUREMENT ZFEH_EepromData.ydiMemory_xau16[2].amb_cond.ambient_condition[0][7] "ambient condition shot [0 .. 2-1] with 25 data bytes [0 .. 25-1] for the error code stored in this error memory slot" UBYTE EH_STANDARD_S4_S3 1 100 0 255 ECU_ADDRESS 0xFFF8236F DISPLAY_IDENTIFIER ambient_condition[0][7].amb_cond.ydiMemory_xau16[2].ZFEH_EepromData /end MEASUREMENT
/begin MEASUREMENT ZFEH_EepromData.ydiMemory_xau16[2].amb_cond.ambient_condition[0][8] "ambient condition shot [0 .. 2-1] with 25 data bytes [0 .. 25-1] for the error code stored in this error memory slot" UBYTE EH_STANDARD_S4_S3 1 100 0 255 ECU_ADDRESS 0xFFF82370 DISPLAY_IDENTIFIER ambient_condition[0][8].amb_cond.ydiMemory_xau16[2].ZFEH_EepromData /end MEASUREMENT
/begin MEASUREMENT ZFEH_EepromData.ydiMemory_xau16[2].amb_cond.ambient_condition[0][9] "ambient condition shot [0 .. 2-1] with 25 data bytes [0 .. 25-1] for the error code stored in this error memory slot" UBYTE EH_STANDARD_S4_S3 1 100 0 255 ECU_ADDRESS 0xFFF82371 DISPLAY_IDENTIFIER ambient_condition[0][9].amb_cond.ydiMemory_xau16[2].ZFEH_EepromData /end MEASUREMENT
/begin MEASUREMENT ZFEH_EepromData.ydiMemory_xau16[2].amb_cond.ambient_condition[1][0] "ambient condition shot [0 .. 2-1] with 25 data bytes [0 .. 25-1] for the error code stored in this error memory slot" UBYTE EH_STANDARD_S4_S3 1 100 0 255 ECU_ADDRESS 0xFFF82381 DISPLAY_IDENTIFIER ambient_condition[1][0].amb_cond.ydiMemory_xau16[2].ZFEH_EepromData /end MEASUREMENT
/begin MEASUREMENT ZFEH_EepromData.ydiMemory_xau16[2].amb_cond.ambient_condition[1][10] "ambient condition shot [0 .. 2-1] with 25 data bytes [0 .. 25-1] for the error code stored in this error memory slot" UBYTE EH_STANDARD_S4_S3 1 100 0 255 ECU_ADDRESS 0xFFF8238B DISPLAY_IDENTIFIER ambient_condition[1][10].amb_cond.ydiMemory_xau16[2].ZFEH_EepromData /end MEASUREMENT
/begin MEASUREMENT ZFEH_EepromData.ydiMemory_xau16[2].amb_cond.ambient_condition[1][11] "ambient condition shot [0 .. 2-1] with 25 data bytes [0 .. 25-1] for the error code stored in this error memory slot" UBYTE EH_STANDARD_S4_S3 1 100 0 255 ECU_ADDRESS 0xFFF8238C DISPLAY_IDENTIFIER ambient_condition[1][11].amb_cond.ydiMemory_xau16[2].ZFEH_EepromData /end MEASUREMENT
/begin MEASUREMENT ZFEH_EepromData.ydiMemory_xau16[2].amb_cond.ambient_condition[1][12] "ambient condition shot [0 .. 2-1] with 25 data bytes [0 .. 25-1] for the error code stored in this error memory slot" UBYTE EH_STANDARD_S4_S3 1 100 0 255 ECU_ADDRESS 0xFFF8238D DISPLAY_IDENTIFIER ambient_condition[1][12].amb_cond.ydiMemory_xau16[2].ZFEH_EepromData /end MEASUREMENT
/begin MEASUREMENT ZFEH_EepromData.ydiMemory_xau16[2].amb_cond.ambient_condition[1][13] "ambient condition shot [0 .. 2-1] with 25 data bytes [0 .. 25-1] for the error code stored in this error memory slot" UBYTE EH_STANDARD_S4_S3 1 100 0 255 ECU_ADDRESS 0xFFF8238E DISPLAY_IDENTIFIER ambient_condition[1][13].amb_cond.ydiMemory_xau16[2].ZFEH_EepromData /end MEASUREMENT
/begin MEASUREMENT ZFEH_EepromData.ydiMemory_xau16[2].amb_cond.ambient_condition[1][14] "ambient condition shot [0 .. 2-1] with 25 data bytes [0 .. 25-1] for the error code stored in this error memory slot" UBYTE EH_STANDARD_S4_S3 1 100 0 255 ECU_ADDRESS 0xFFF8238F DISPLAY_IDENTIFIER ambient_condition[1][14].amb_cond.ydiMemory_xau16[2].ZFEH_EepromData /end MEASUREMENT
/begin MEASUREMENT ZFEH_EepromData.ydiMemory_xau16[2].amb_cond.ambient_condition[1][15] "ambient condition shot [0 .. 2-1] with 25 data bytes [0 .. 25-1] for the error code stored in this error memory slot" UBYTE EH_STANDARD_S4_S3 1 100 0 255 ECU_ADDRESS 0xFFF82390 DISPLAY_IDENTIFIER ambient_condition[1][15].amb_cond.ydiMemory_xau16[2].ZFEH_EepromData /end MEASUREMENT
/begin MEASUREMENT ZFEH_EepromData.ydiMemory_xau16[2].amb_cond.ambient_condition[1][16] "ambient condition shot [0 .. 2-1] with 25 data bytes [0 .. 25-1] for the error code stored in this error memory slot" UBYTE EH_STANDARD_S4_S3 1 100 0 255 ECU_ADDRESS 0xFFF82391 DISPLAY_IDENTIFIER ambient_condition[1][16].amb_cond.ydiMemory_xau16[2].ZFEH_EepromData /end MEASUREMENT
/begin MEASUREMENT ZFEH_EepromData.ydiMemory_xau16[2].amb_cond.ambient_condition[1][17] "ambient condition shot [0 .. 2-1] with 25 data bytes [0 .. 25-1] for the error code stored in this error memory slot" UBYTE EH_STANDARD_S4_S3 1 100 0 255 ECU_ADDRESS 0xFFF82392 DISPLAY_IDENTIFIER ambient_condition[1][17].amb_cond.ydiMemory_xau16[2].ZFEH_EepromData /end MEASUREMENT
/begin MEASUREMENT ZFEH_EepromData.ydiMemory_xau16[2].amb_cond.ambient_condition[1][18] "ambient condition shot [0 .. 2-1] with 25 data bytes [0 .. 25-1] for the error code stored in this error memory slot" UBYTE EH_STANDARD_S4_S3 1 100 0 255 ECU_ADDRESS 0xFFF82393 DISPLAY_IDENTIFIER ambient_condition[1][18].amb_cond.ydiMemory_xau16[2].ZFEH_EepromData /end MEASUREMENT
/begin MEASUREMENT ZFEH_EepromData.ydiMemory_xau16[2].amb_cond.ambient_condition[1][19] "ambient condition shot [0 .. 2-1] with 25 data bytes [0 .. 25-1] for the error code stored in this error memory slot" UBYTE EH_STANDARD_S4_S3 1 100 0 255 ECU_ADDRESS 0xFFF82394 DISPLAY_IDENTIFIER ambient_condition[1][19].amb_cond.ydiMemory_xau16[2].ZFEH_EepromData /end MEASUREMENT
/begin MEASUREMENT ZFEH_EepromData.ydiMemory_xau16[2].amb_cond.ambient_condition[1][1] "ambient condition shot [0 .. 2-1] with 25 data bytes [0 .. 25-1] for the error code stored in this error memory slot" UBYTE EH_STANDARD_S4_S3 1 100 0 255 ECU_ADDRESS 0xFFF82382 DISPLAY_IDENTIFIER ambient_condition[1][1].amb_cond.ydiMemory_xau16[2].ZFEH_EepromData /end MEASUREMENT
/begin MEASUREMENT ZFEH_EepromData.ydiMemory_xau16[2].amb_cond.ambient_condition[1][20] "ambient condition shot [0 .. 2-1] with 25 data bytes [0 .. 25-1] for the error code stored in this error memory slot" UBYTE EH_STANDARD_S4_S3 1 100 0 255 ECU_ADDRESS 0xFFF82395 DISPLAY_IDENTIFIER ambient_condition[1][20].amb_cond.ydiMemory_xau16[2].ZFEH_EepromData /end MEASUREMENT
/begin MEASUREMENT ZFEH_EepromData.ydiMemory_xau16[2].amb_cond.ambient_condition[1][21] "ambient condition shot [0 .. 2-1] with 25 data bytes [0 .. 25-1] for the error code stored in this error memory slot" UBYTE EH_STANDARD_S4_S3 1 100 0 255 ECU_ADDRESS 0xFFF82396 DISPLAY_IDENTIFIER ambient_condition[1][21].amb_cond.ydiMemory_xau16[2].ZFEH_EepromData /end MEASUREMENT
/begin MEASUREMENT ZFEH_EepromData.ydiMemory_xau16[2].amb_cond.ambient_condition[1][22] "ambient condition shot [0 .. 2-1] with 25 data bytes [0 .. 25-1] for the error code stored in this error memory slot" UBYTE EH_STANDARD_S4_S3 1 100 0 255 ECU_ADDRESS 0xFFF82397 DISPLAY_IDENTIFIER ambient_condition[1][22].amb_cond.ydiMemory_xau16[2].ZFEH_EepromData /end MEASUREMENT
/begin MEASUREMENT ZFEH_EepromData.ydiMemory_xau16[2].amb_cond.ambient_condition[1][23] "ambient condition shot [0 .. 2-1] with 25 data bytes [0 .. 25-1] for the error code stored in this error memory slot" UBYTE EH_STANDARD_S4_S3 1 100 0 255 ECU_ADDRESS 0xFFF82398 DISPLAY_IDENTIFIER ambient_condition[1][23].amb_cond.ydiMemory_xau16[2].ZFEH_EepromData /end MEASUREMENT
/begin MEASUREMENT ZFEH_EepromData.ydiMemory_xau16[2].amb_cond.ambient_condition[1][24] "ambient condition shot [0 .. 2-1] with 25 data bytes [0 .. 25-1] for the error code stored in this error memory slot" UBYTE EH_STANDARD_S4_S3 1 100 0 255 ECU_ADDRESS 0xFFF82399 DISPLAY_IDENTIFIER ambient_condition[1][24].amb_cond.ydiMemory_xau16[2].ZFEH_EepromData /end MEASUREMENT
/begin MEASUREMENT ZFEH_EepromData.ydiMemory_xau16[2].amb_cond.ambient_condition[1][2] "ambient condition shot [0 .. 2-1] with 25 data bytes [0 .. 25-1] for the error code stored in this error memory slot" UBYTE EH_STANDARD_S4_S3 1 100 0 255 ECU_ADDRESS 0xFFF82383 DISPLAY_IDENTIFIER ambient_condition[1][2].amb_cond.ydiMemory_xau16[2].ZFEH_EepromData /end MEASUREMENT
/begin MEASUREMENT ZFEH_EepromData.ydiMemory_xau16[2].amb_cond.ambient_condition[1][3] "ambient condition shot [0 .. 2-1] with 25 data bytes [0 .. 25-1] for the error code stored in this error memory slot" UBYTE EH_STANDARD_S4_S3 1 100 0 255 ECU_ADDRESS 0xFFF82384 DISPLAY_IDENTIFIER ambient_condition[1][3].amb_cond.ydiMemory_xau16[2].ZFEH_EepromData /end MEASUREMENT
/begin MEASUREMENT ZFEH_EepromData.ydiMemory_xau16[2].amb_cond.ambient_condition[1][4] "ambient condition shot [0 .. 2-1] with 25 data bytes [0 .. 25-1] for the error code stored in this error memory slot" UBYTE EH_STANDARD_S4_S3 1 100 0 255 ECU_ADDRESS 0xFFF82385 DISPLAY_IDENTIFIER ambient_condition[1][4].amb_cond.ydiMemory_xau16[2].ZFEH_EepromData /end MEASUREMENT
/begin MEASUREMENT ZFEH_EepromData.ydiMemory_xau16[2].amb_cond.ambient_condition[1][5] "ambient condition shot [0 .. 2-1] with 25 data bytes [0 .. 25-1] for the error code stored in this error memory slot" UBYTE EH_STANDARD_S4_S3 1 100 0 255 ECU_ADDRESS 0xFFF82386 DISPLAY_IDENTIFIER ambient_condition[1][5].amb_cond.ydiMemory_xau16[2].ZFEH_EepromData /end MEASUREMENT
/begin MEASUREMENT ZFEH_EepromData.ydiMemory_xau16[2].amb_cond.ambient_condition[1][6] "ambient condition shot [0 .. 2-1] with 25 data bytes [0 .. 25-1] for the error code stored in this error memory slot" UBYTE EH_STANDARD_S4_S3 1 100 0 255 ECU_ADDRESS 0xFFF82387 DISPLAY_IDENTIFIER ambient_condition[1][6].amb_cond.ydiMemory_xau16[2].ZFEH_EepromData /end MEASUREMENT
/begin MEASUREMENT ZFEH_EepromData.ydiMemory_xau16[2].amb_cond.ambient_condition[1][7] "ambient condition shot [0 .. 2-1] with 25 data bytes [0 .. 25-1] for the error code stored in this error memory slot" UBYTE EH_STANDARD_S4_S3 1 100 0 255 ECU_ADDRESS 0xFFF82388 DISPLAY_IDENTIFIER ambient_condition[1][7].amb_cond.ydiMemory_xau16[2].ZFEH_EepromData /end MEASUREMENT
/begin MEASUREMENT ZFEH_EepromData.ydiMemory_xau16[2].amb_cond.ambient_condition[1][8] "ambient condition shot [0 .. 2-1] with 25 data bytes [0 .. 25-1] for the error code stored in this error memory slot" UBYTE EH_STANDARD_S4_S3 1 100 0 255 ECU_ADDRESS 0xFFF82389 DISPLAY_IDENTIFIER ambient_condition[1][8].amb_cond.ydiMemory_xau16[2].ZFEH_EepromData /end MEASUREMENT
/begin MEASUREMENT ZFEH_EepromData.ydiMemory_xau16[2].amb_cond.ambient_condition[1][9] "ambient condition shot [0 .. 2-1] with 25 data bytes [0 .. 25-1] for the error code stored in this error memory slot" UBYTE EH_STANDARD_S4_S3 1 100 0 255 ECU_ADDRESS 0xFFF8238A DISPLAY_IDENTIFIER ambient_condition[1][9].amb_cond.ydiMemory_xau16[2].ZFEH_EepromData /end MEASUREMENT
/begin MEASUREMENT ZFEH_EepromData.ydiMemory_xau16[2].amb_cond.status_of_ambient_conditions[0] "status of ambient condition shot x: 0=invalid 1=valid" UBYTE EH_STANDARD_S4_S3 1 100 0 1 ECU_ADDRESS 0xFFF8239A DISPLAY_IDENTIFIER status_of_ambient_conditions[0].amb_cond.ydiMemory_xau16[2].ZFEH_EepromData /end MEASUREMENT
/begin MEASUREMENT ZFEH_EepromData.ydiMemory_xau16[2].amb_cond.status_of_ambient_conditions[1] "status of ambient condition shot x: 0=invalid 1=valid" UBYTE EH_STANDARD_S4_S3 1 100 0 1 ECU_ADDRESS 0xFFF8239B DISPLAY_IDENTIFIER status_of_ambient_conditions[1].amb_cond.ydiMemory_xau16[2].ZFEH_EepromData /end MEASUREMENT
/begin MEASUREMENT ZFEH_EepromData.ydiMemory_xau16[2].backwards_counter "backwards counter of error code stored in error memory slot" UBYTE EH_STANDARD_S4_S3 1 100 0 255 ECU_ADDRESS 0xFFF8235B DISPLAY_IDENTIFIER backwards_counter.ydiMemory_xau16[2].ZFEH_EepromData /end MEASUREMENT
/begin MEASUREMENT ZFEH_EepromData.ydiMemory_xau16[2].condition_byte "condition byte of error code stored in error memory slot" UBYTE EH_STANDARD_S4_S3 1 100 0 255 ECU_ADDRESS 0xFFF82365 DISPLAY_IDENTIFIER condition_byte.ydiMemory_xau16[2].ZFEH_EepromData /end MEASUREMENT
/begin MEASUREMENT ZFEH_EepromData.ydiMemory_xau16[2].error_code "error code stored in error memory slot" UWORD EH_STANDARD_S4_S3 1 100 0 65535 ECU_ADDRESS 0xFFF82354 DISPLAY_IDENTIFIER error_code.ydiMemory_xau16[2].ZFEH_EepromData /end MEASUREMENT
/begin MEASUREMENT ZFEH_EepromData.ydiMemory_xau16[2].error_type "error type of error code stored in error memory slot" UWORD EH_STANDARD_S4_S3 1 100 0 65535 ECU_ADDRESS 0xFFF82356 DISPLAY_IDENTIFIER error_type.ydiMemory_xau16[2].ZFEH_EepromData /end MEASUREMENT
/begin MEASUREMENT ZFEH_EepromData.ydiMemory_xau16[2].frequency_counter "frequency counter of error code stored in error memory slot" UBYTE EH_STANDARD_S4_S3 1 100 0 255 ECU_ADDRESS 0xFFF8235A DISPLAY_IDENTIFIER frequency_counter.ydiMemory_xau16[2].ZFEH_EepromData /end MEASUREMENT
/begin MEASUREMENT ZFEH_EepromData.ydiMemory_xau16[2].master_time "master time of error code stored in error memory slot" ULONG EH_STANDARD_S4_S3 1 100 0 4294967295 ECU_ADDRESS 0xFFF82360 DISPLAY_IDENTIFIER master_time.ydiMemory_xau16[2].ZFEH_EepromData /end MEASUREMENT
/begin MEASUREMENT ZFEH_EepromData.ydiMemory_xau16[2].obd_driving_cycle_counter "obd driving cycle counter of error code stored in error memory slot" UWORD EH_STANDARD_S4_S3 1 100 0 65535 ECU_ADDRESS 0xFFF82366 DISPLAY_IDENTIFIER obd_driving_cycle_counter.ydiMemory_xau16[2].ZFEH_EepromData /end MEASUREMENT
/begin MEASUREMENT ZFEH_EepromData.ydiMemory_xau16[2].permanent_counter "counter of permanent error codes stored in error memory slot" UBYTE EH_STANDARD_S4_S3 1 100 0 255 ECU_ADDRESS 0xFFF8235C DISPLAY_IDENTIFIER permanent_counter.ydiMemory_xau16[2].ZFEH_EepromData /end MEASUREMENT
/begin MEASUREMENT ZFEH_EepromData.ydiMemory_xau16[2].sequence_counter "sequence counter of error code stored in error memory slot" UBYTE EH_STANDARD_S4_S3 1 100 0 255 ECU_ADDRESS 0xFFF8235D DISPLAY_IDENTIFIER sequence_counter.ydiMemory_xau16[2].ZFEH_EepromData /end MEASUREMENT
/begin MEASUREMENT ZFEH_EepromData.ydiMemory_xau16[2].status_word "status word of error code stored in error memory slot" UWORD EH_STANDARD_S4_S3 1 100 0 65535 ECU_ADDRESS 0xFFF82358 DISPLAY_IDENTIFIER status_word.ydiMemory_xau16[2].ZFEH_EepromData /end MEASUREMENT
/begin MEASUREMENT ZFEH_EepromData.ydiMemory_xau16[3].amb_cond.ambient_condition[0][0] "ambient condition shot [0 .. 2-1] with 25 data bytes [0 .. 25-1] for the error code stored in this error memory slot" UBYTE EH_STANDARD_S4_S3 1 100 0 255 ECU_ADDRESS 0xFFF823B0 DISPLAY_IDENTIFIER ambient_condition[0][0].amb_cond.ydiMemory_xau16[3].ZFEH_EepromData /end MEASUREMENT
/begin MEASUREMENT ZFEH_EepromData.ydiMemory_xau16[3].amb_cond.ambient_condition[0][10] "ambient condition shot [0 .. 2-1] with 25 data bytes [0 .. 25-1] for the error code stored in this error memory slot" UBYTE EH_STANDARD_S4_S3 1 100 0 255 ECU_ADDRESS 0xFFF823BA DISPLAY_IDENTIFIER ambient_condition[0][10].amb_cond.ydiMemory_xau16[3].ZFEH_EepromData /end MEASUREMENT
/begin MEASUREMENT ZFEH_EepromData.ydiMemory_xau16[3].amb_cond.ambient_condition[0][11] "ambient condition shot [0 .. 2-1] with 25 data bytes [0 .. 25-1] for the error code stored in this error memory slot" UBYTE EH_STANDARD_S4_S3 1 100 0 255 ECU_ADDRESS 0xFFF823BB DISPLAY_IDENTIFIER ambient_condition[0][11].amb_cond.ydiMemory_xau16[3].ZFEH_EepromData /end MEASUREMENT
/begin MEASUREMENT ZFEH_EepromData.ydiMemory_xau16[3].amb_cond.ambient_condition[0][12] "ambient condition shot [0 .. 2-1] with 25 data bytes [0 .. 25-1] for the error code stored in this error memory slot" UBYTE EH_STANDARD_S4_S3 1 100 0 255 ECU_ADDRESS 0xFFF823BC DISPLAY_IDENTIFIER ambient_condition[0][12].amb_cond.ydiMemory_xau16[3].ZFEH_EepromData /end MEASUREMENT
/begin MEASUREMENT ZFEH_EepromData.ydiMemory_xau16[3].amb_cond.ambient_condition[0][13] "ambient condition shot [0 .. 2-1] with 25 data bytes [0 .. 25-1] for the error code stored in this error memory slot" UBYTE EH_STANDARD_S4_S3 1 100 0 255 ECU_ADDRESS 0xFFF823BD DISPLAY_IDENTIFIER ambient_condition[0][13].amb_cond.ydiMemory_xau16[3].ZFEH_EepromData /end MEASUREMENT
/begin MEASUREMENT ZFEH_EepromData.ydiMemory_xau16[3].amb_cond.ambient_condition[0][14] "ambient condition shot [0 .. 2-1] with 25 data bytes [0 .. 25-1] for the error code stored in this error memory slot" UBYTE EH_STANDARD_S4_S3 1 100 0 255 ECU_ADDRESS 0xFFF823BE DISPLAY_IDENTIFIER ambient_condition[0][14].amb_cond.ydiMemory_xau16[3].ZFEH_EepromData /end MEASUREMENT
/begin MEASUREMENT ZFEH_EepromData.ydiMemory_xau16[3].amb_cond.ambient_condition[0][15] "ambient condition shot [0 .. 2-1] with 25 data bytes [0 .. 25-1] for the error code stored in this error memory slot" UBYTE EH_STANDARD_S4_S3 1 100 0 255 ECU_ADDRESS 0xFFF823BF DISPLAY_IDENTIFIER ambient_condition[0][15].amb_cond.ydiMemory_xau16[3].ZFEH_EepromData /end MEASUREMENT
/begin MEASUREMENT ZFEH_EepromData.ydiMemory_xau16[3].amb_cond.ambient_condition[0][16] "ambient condition shot [0 .. 2-1] with 25 data bytes [0 .. 25-1] for the error code stored in this error memory slot" UBYTE EH_STANDARD_S4_S3 1 100 0 255 ECU_ADDRESS 0xFFF823C0 DISPLAY_IDENTIFIER ambient_condition[0][16].amb_cond.ydiMemory_xau16[3].ZFEH_EepromData /end MEASUREMENT
/begin MEASUREMENT ZFEH_EepromData.ydiMemory_xau16[3].amb_cond.ambient_condition[0][17] "ambient condition shot [0 .. 2-1] with 25 data bytes [0 .. 25-1] for the error code stored in this error memory slot" UBYTE EH_STANDARD_S4_S3 1 100 0 255 ECU_ADDRESS 0xFFF823C1 DISPLAY_IDENTIFIER ambient_condition[0][17].amb_cond.ydiMemory_xau16[3].ZFEH_EepromData /end MEASUREMENT
/begin MEASUREMENT ZFEH_EepromData.ydiMemory_xau16[3].amb_cond.ambient_condition[0][18] "ambient condition shot [0 .. 2-1] with 25 data bytes [0 .. 25-1] for the error code stored in this error memory slot" UBYTE EH_STANDARD_S4_S3 1 100 0 255 ECU_ADDRESS 0xFFF823C2 DISPLAY_IDENTIFIER ambient_condition[0][18].amb_cond.ydiMemory_xau16[3].ZFEH_EepromData /end MEASUREMENT
/begin MEASUREMENT ZFEH_EepromData.ydiMemory_xau16[3].amb_cond.ambient_condition[0][19] "ambient condition shot [0 .. 2-1] with 25 data bytes [0 .. 25-1] for the error code stored in this error memory slot" UBYTE EH_STANDARD_S4_S3 1 100 0 255 ECU_ADDRESS 0xFFF823C3 DISPLAY_IDENTIFIER ambient_condition[0][19].amb_cond.ydiMemory_xau16[3].ZFEH_EepromData /end MEASUREMENT
/begin MEASUREMENT ZFEH_EepromData.ydiMemory_xau16[3].amb_cond.ambient_condition[0][1] "ambient condition shot [0 .. 2-1] with 25 data bytes [0 .. 25-1] for the error code stored in this error memory slot" UBYTE EH_STANDARD_S4_S3 1 100 0 255 ECU_ADDRESS 0xFFF823B1 DISPLAY_IDENTIFIER ambient_condition[0][1].amb_cond.ydiMemory_xau16[3].ZFEH_EepromData /end MEASUREMENT
/begin MEASUREMENT ZFEH_EepromData.ydiMemory_xau16[3].amb_cond.ambient_condition[0][20] "ambient condition shot [0 .. 2-1] with 25 data bytes [0 .. 25-1] for the error code stored in this error memory slot" UBYTE EH_STANDARD_S4_S3 1 100 0 255 ECU_ADDRESS 0xFFF823C4 DISPLAY_IDENTIFIER ambient_condition[0][20].amb_cond.ydiMemory_xau16[3].ZFEH_EepromData /end MEASUREMENT
/begin MEASUREMENT ZFEH_EepromData.ydiMemory_xau16[3].amb_cond.ambient_condition[0][21] "ambient condition shot [0 .. 2-1] with 25 data bytes [0 .. 25-1] for the error code stored in this error memory slot" UBYTE EH_STANDARD_S4_S3 1 100 0 255 ECU_ADDRESS 0xFFF823C5 DISPLAY_IDENTIFIER ambient_condition[0][21].amb_cond.ydiMemory_xau16[3].ZFEH_EepromData /end MEASUREMENT
/begin MEASUREMENT ZFEH_EepromData.ydiMemory_xau16[3].amb_cond.ambient_condition[0][22] "ambient condition shot [0 .. 2-1] with 25 data bytes [0 .. 25-1] for the error code stored in this error memory slot" UBYTE EH_STANDARD_S4_S3 1 100 0 255 ECU_ADDRESS 0xFFF823C6 DISPLAY_IDENTIFIER ambient_condition[0][22].amb_cond.ydiMemory_xau16[3].ZFEH_EepromData /end MEASUREMENT
/begin MEASUREMENT ZFEH_EepromData.ydiMemory_xau16[3].amb_cond.ambient_condition[0][23] "ambient condition shot [0 .. 2-1] with 25 data bytes [0 .. 25-1] for the error code stored in this error memory slot" UBYTE EH_STANDARD_S4_S3 1 100 0 255 ECU_ADDRESS 0xFFF823C7 DISPLAY_IDENTIFIER ambient_condition[0][23].amb_cond.ydiMemory_xau16[3].ZFEH_EepromData /end MEASUREMENT
/begin MEASUREMENT ZFEH_EepromData.ydiMemory_xau16[3].amb_cond.ambient_condition[0][24] "ambient condition shot [0 .. 2-1] with 25 data bytes [0 .. 25-1] for the error code stored in this error memory slot" UBYTE EH_STANDARD_S4_S3 1 100 0 255 ECU_ADDRESS 0xFFF823C8 DISPLAY_IDENTIFIER ambient_condition[0][24].amb_cond.ydiMemory_xau16[3].ZFEH_EepromData /end MEASUREMENT
/begin MEASUREMENT ZFEH_EepromData.ydiMemory_xau16[3].amb_cond.ambient_condition[0][2] "ambient condition shot [0 .. 2-1] with 25 data bytes [0 .. 25-1] for the error code stored in this error memory slot" UBYTE EH_STANDARD_S4_S3 1 100 0 255 ECU_ADDRESS 0xFFF823B2 DISPLAY_IDENTIFIER ambient_condition[0][2].amb_cond.ydiMemory_xau16[3].ZFEH_EepromData /end MEASUREMENT
/begin MEASUREMENT ZFEH_EepromData.ydiMemory_xau16[3].amb_cond.ambient_condition[0][3] "ambient condition shot [0 .. 2-1] with 25 data bytes [0 .. 25-1] for the error code stored in this error memory slot" UBYTE EH_STANDARD_S4_S3 1 100 0 255 ECU_ADDRESS 0xFFF823B3 DISPLAY_IDENTIFIER ambient_condition[0][3].amb_cond.ydiMemory_xau16[3].ZFEH_EepromData /end MEASUREMENT
/begin MEASUREMENT ZFEH_EepromData.ydiMemory_xau16[3].amb_cond.ambient_condition[0][4] "ambient condition shot [0 .. 2-1] with 25 data bytes [0 .. 25-1] for the error code stored in this error memory slot" UBYTE EH_STANDARD_S4_S3 1 100 0 255 ECU_ADDRESS 0xFFF823B4 DISPLAY_IDENTIFIER ambient_condition[0][4].amb_cond.ydiMemory_xau16[3].ZFEH_EepromData /end MEASUREMENT
/begin MEASUREMENT ZFEH_EepromData.ydiMemory_xau16[3].amb_cond.ambient_condition[0][5] "ambient condition shot [0 .. 2-1] with 25 data bytes [0 .. 25-1] for the error code stored in this error memory slot" UBYTE EH_STANDARD_S4_S3 1 100 0 255 ECU_ADDRESS 0xFFF823B5 DISPLAY_IDENTIFIER ambient_condition[0][5].amb_cond.ydiMemory_xau16[3].ZFEH_EepromData /end MEASUREMENT
/begin MEASUREMENT ZFEH_EepromData.ydiMemory_xau16[3].amb_cond.ambient_condition[0][6] "ambient condition shot [0 .. 2-1] with 25 data bytes [0 .. 25-1] for the error code stored in this error memory slot" UBYTE EH_STANDARD_S4_S3 1 100 0 255 ECU_ADDRESS 0xFFF823B6 DISPLAY_IDENTIFIER ambient_condition[0][6].amb_cond.ydiMemory_xau16[3].ZFEH_EepromData /end MEASUREMENT
/begin MEASUREMENT ZFEH_EepromData.ydiMemory_xau16[3].amb_cond.ambient_condition[0][7] "ambient condition shot [0 .. 2-1] with 25 data bytes [0 .. 25-1] for the error code stored in this error memory slot" UBYTE EH_STANDARD_S4_S3 1 100 0 255 ECU_ADDRESS 0xFFF823B7 DISPLAY_IDENTIFIER ambient_condition[0][7].amb_cond.ydiMemory_xau16[3].ZFEH_EepromData /end MEASUREMENT
/begin MEASUREMENT ZFEH_EepromData.ydiMemory_xau16[3].amb_cond.ambient_condition[0][8] "ambient condition shot [0 .. 2-1] with 25 data bytes [0 .. 25-1] for the error code stored in this error memory slot" UBYTE EH_STANDARD_S4_S3 1 100 0 255 ECU_ADDRESS 0xFFF823B8 DISPLAY_IDENTIFIER ambient_condition[0][8].amb_cond.ydiMemory_xau16[3].ZFEH_EepromData /end MEASUREMENT
/begin MEASUREMENT ZFEH_EepromData.ydiMemory_xau16[3].amb_cond.ambient_condition[0][9] "ambient condition shot [0 .. 2-1] with 25 data bytes [0 .. 25-1] for the error code stored in this error memory slot" UBYTE EH_STANDARD_S4_S3 1 100 0 255 ECU_ADDRESS 0xFFF823B9 DISPLAY_IDENTIFIER ambient_condition[0][9].amb_cond.ydiMemory_xau16[3].ZFEH_EepromData /end MEASUREMENT
/begin MEASUREMENT ZFEH_EepromData.ydiMemory_xau16[3].amb_cond.ambient_condition[1][0] "ambient condition shot [0 .. 2-1] with 25 data bytes [0 .. 25-1] for the error code stored in this error memory slot" UBYTE EH_STANDARD_S4_S3 1 100 0 255 ECU_ADDRESS 0xFFF823C9 DISPLAY_IDENTIFIER ambient_condition[1][0].amb_cond.ydiMemory_xau16[3].ZFEH_EepromData /end MEASUREMENT
/begin MEASUREMENT ZFEH_EepromData.ydiMemory_xau16[3].amb_cond.ambient_condition[1][10] "ambient condition shot [0 .. 2-1] with 25 data bytes [0 .. 25-1] for the error code stored in this error memory slot" UBYTE EH_STANDARD_S4_S3 1 100 0 255 ECU_ADDRESS 0xFFF823D3 DISPLAY_IDENTIFIER ambient_condition[1][10].amb_cond.ydiMemory_xau16[3].ZFEH_EepromData /end MEASUREMENT
/begin MEASUREMENT ZFEH_EepromData.ydiMemory_xau16[3].amb_cond.ambient_condition[1][11] "ambient condition shot [0 .. 2-1] with 25 data bytes [0 .. 25-1] for the error code stored in this error memory slot" UBYTE EH_STANDARD_S4_S3 1 100 0 255 ECU_ADDRESS 0xFFF823D4 DISPLAY_IDENTIFIER ambient_condition[1][11].amb_cond.ydiMemory_xau16[3].ZFEH_EepromData /end MEASUREMENT
/begin MEASUREMENT ZFEH_EepromData.ydiMemory_xau16[3].amb_cond.ambient_condition[1][12] "ambient condition shot [0 .. 2-1] with 25 data bytes [0 .. 25-1] for the error code stored in this error memory slot" UBYTE EH_STANDARD_S4_S3 1 100 0 255 ECU_ADDRESS 0xFFF823D5 DISPLAY_IDENTIFIER ambient_condition[1][12].amb_cond.ydiMemory_xau16[3].ZFEH_EepromData /end MEASUREMENT
/begin MEASUREMENT ZFEH_EepromData.ydiMemory_xau16[3].amb_cond.ambient_condition[1][13] "ambient condition shot [0 .. 2-1] with 25 data bytes [0 .. 25-1] for the error code stored in this error memory slot" UBYTE EH_STANDARD_S4_S3 1 100 0 255 ECU_ADDRESS 0xFFF823D6 DISPLAY_IDENTIFIER ambient_condition[1][13].amb_cond.ydiMemory_xau16[3].ZFEH_EepromData /end MEASUREMENT
/begin MEASUREMENT ZFEH_EepromData.ydiMemory_xau16[3].amb_cond.ambient_condition[1][14] "ambient condition shot [0 .. 2-1] with 25 data bytes [0 .. 25-1] for the error code stored in this error memory slot" UBYTE EH_STANDARD_S4_S3 1 100 0 255 ECU_ADDRESS 0xFFF823D7 DISPLAY_IDENTIFIER ambient_condition[1][14].amb_cond.ydiMemory_xau16[3].ZFEH_EepromData /end MEASUREMENT
/begin MEASUREMENT ZFEH_EepromData.ydiMemory_xau16[3].amb_cond.ambient_condition[1][15] "ambient condition shot [0 .. 2-1] with 25 data bytes [0 .. 25-1] for the error code stored in this error memory slot" UBYTE EH_STANDARD_S4_S3 1 100 0 255 ECU_ADDRESS 0xFFF823D8 DISPLAY_IDENTIFIER ambient_condition[1][15].amb_cond.ydiMemory_xau16[3].ZFEH_EepromData /end MEASUREMENT
/begin MEASUREMENT ZFEH_EepromData.ydiMemory_xau16[3].amb_cond.ambient_condition[1][16] "ambient condition shot [0 .. 2-1] with 25 data bytes [0 .. 25-1] for the error code stored in this error memory slot" UBYTE EH_STANDARD_S4_S3 1 100 0 255 ECU_ADDRESS 0xFFF823D9 DISPLAY_IDENTIFIER ambient_condition[1][16].amb_cond.ydiMemory_xau16[3].ZFEH_EepromData /end MEASUREMENT
/begin MEASUREMENT ZFEH_EepromData.ydiMemory_xau16[3].amb_cond.ambient_condition[1][17] "ambient condition shot [0 .. 2-1] with 25 data bytes [0 .. 25-1] for the error code stored in this error memory slot" UBYTE EH_STANDARD_S4_S3 1 100 0 255 ECU_ADDRESS 0xFFF823DA DISPLAY_IDENTIFIER ambient_condition[1][17].amb_cond.ydiMemory_xau16[3].ZFEH_EepromData /end MEASUREMENT
/begin MEASUREMENT ZFEH_EepromData.ydiMemory_xau16[3].amb_cond.ambient_condition[1][18] "ambient condition shot [0 .. 2-1] with 25 data bytes [0 .. 25-1] for the error code stored in this error memory slot" UBYTE EH_STANDARD_S4_S3 1 100 0 255 ECU_ADDRESS 0xFFF823DB DISPLAY_IDENTIFIER ambient_condition[1][18].amb_cond.ydiMemory_xau16[3].ZFEH_EepromData /end MEASUREMENT
/begin MEASUREMENT ZFEH_EepromData.ydiMemory_xau16[3].amb_cond.ambient_condition[1][19] "ambient condition shot [0 .. 2-1] with 25 data bytes [0 .. 25-1] for the error code stored in this error memory slot" UBYTE EH_STANDARD_S4_S3 1 100 0 255 ECU_ADDRESS 0xFFF823DC DISPLAY_IDENTIFIER ambient_condition[1][19].amb_cond.ydiMemory_xau16[3].ZFEH_EepromData /end MEASUREMENT
/begin MEASUREMENT ZFEH_EepromData.ydiMemory_xau16[3].amb_cond.ambient_condition[1][1] "ambient condition shot [0 .. 2-1] with 25 data bytes [0 .. 25-1] for the error code stored in this error memory slot" UBYTE EH_STANDARD_S4_S3 1 100 0 255 ECU_ADDRESS 0xFFF823CA DISPLAY_IDENTIFIER ambient_condition[1][1].amb_cond.ydiMemory_xau16[3].ZFEH_EepromData /end MEASUREMENT
/begin MEASUREMENT ZFEH_EepromData.ydiMemory_xau16[3].amb_cond.ambient_condition[1][20] "ambient condition shot [0 .. 2-1] with 25 data bytes [0 .. 25-1] for the error code stored in this error memory slot" UBYTE EH_STANDARD_S4_S3 1 100 0 255 ECU_ADDRESS 0xFFF823DD DISPLAY_IDENTIFIER ambient_condition[1][20].amb_cond.ydiMemory_xau16[3].ZFEH_EepromData /end MEASUREMENT
/begin MEASUREMENT ZFEH_EepromData.ydiMemory_xau16[3].amb_cond.ambient_condition[1][21] "ambient condition shot [0 .. 2-1] with 25 data bytes [0 .. 25-1] for the error code stored in this error memory slot" UBYTE EH_STANDARD_S4_S3 1 100 0 255 ECU_ADDRESS 0xFFF823DE DISPLAY_IDENTIFIER ambient_condition[1][21].amb_cond.ydiMemory_xau16[3].ZFEH_EepromData /end MEASUREMENT
/begin MEASUREMENT ZFEH_EepromData.ydiMemory_xau16[3].amb_cond.ambient_condition[1][22] "ambient condition shot [0 .. 2-1] with 25 data bytes [0 .. 25-1] for the error code stored in this error memory slot" UBYTE EH_STANDARD_S4_S3 1 100 0 255 ECU_ADDRESS 0xFFF823DF DISPLAY_IDENTIFIER ambient_condition[1][22].amb_cond.ydiMemory_xau16[3].ZFEH_EepromData /end MEASUREMENT
/begin MEASUREMENT ZFEH_EepromData.ydiMemory_xau16[3].amb_cond.ambient_condition[1][23] "ambient condition shot [0 .. 2-1] with 25 data bytes [0 .. 25-1] for the error code stored in this error memory slot" UBYTE EH_STANDARD_S4_S3 1 100 0 255 ECU_ADDRESS 0xFFF823E0 DISPLAY_IDENTIFIER ambient_condition[1][23].amb_cond.ydiMemory_xau16[3].ZFEH_EepromData /end MEASUREMENT
/begin MEASUREMENT ZFEH_EepromData.ydiMemory_xau16[3].amb_cond.ambient_condition[1][24] "ambient condition shot [0 .. 2-1] with 25 data bytes [0 .. 25-1] for the error code stored in this error memory slot" UBYTE EH_STANDARD_S4_S3 1 100 0 255 ECU_ADDRESS 0xFFF823E1 DISPLAY_IDENTIFIER ambient_condition[1][24].amb_cond.ydiMemory_xau16[3].ZFEH_EepromData /end MEASUREMENT
/begin MEASUREMENT ZFEH_EepromData.ydiMemory_xau16[3].amb_cond.ambient_condition[1][2] "ambient condition shot [0 .. 2-1] with 25 data bytes [0 .. 25-1] for the error code stored in this error memory slot" UBYTE EH_STANDARD_S4_S3 1 100 0 255 ECU_ADDRESS 0xFFF823CB DISPLAY_IDENTIFIER ambient_condition[1][2].amb_cond.ydiMemory_xau16[3].ZFEH_EepromData /end MEASUREMENT
/begin MEASUREMENT ZFEH_EepromData.ydiMemory_xau16[3].amb_cond.ambient_condition[1][3] "ambient condition shot [0 .. 2-1] with 25 data bytes [0 .. 25-1] for the error code stored in this error memory slot" UBYTE EH_STANDARD_S4_S3 1 100 0 255 ECU_ADDRESS 0xFFF823CC DISPLAY_IDENTIFIER ambient_condition[1][3].amb_cond.ydiMemory_xau16[3].ZFEH_EepromData /end MEASUREMENT
/begin MEASUREMENT ZFEH_EepromData.ydiMemory_xau16[3].amb_cond.ambient_condition[1][4] "ambient condition shot [0 .. 2-1] with 25 data bytes [0 .. 25-1] for the error code stored in this error memory slot" UBYTE EH_STANDARD_S4_S3 1 100 0 255 ECU_ADDRESS 0xFFF823CD DISPLAY_IDENTIFIER ambient_condition[1][4].amb_cond.ydiMemory_xau16[3].ZFEH_EepromData /end MEASUREMENT
/begin MEASUREMENT ZFEH_EepromData.ydiMemory_xau16[3].amb_cond.ambient_condition[1][5] "ambient condition shot [0 .. 2-1] with 25 data bytes [0 .. 25-1] for the error code stored in this error memory slot" UBYTE EH_STANDARD_S4_S3 1 100 0 255 ECU_ADDRESS 0xFFF823CE DISPLAY_IDENTIFIER ambient_condition[1][5].amb_cond.ydiMemory_xau16[3].ZFEH_EepromData /end MEASUREMENT
/begin MEASUREMENT ZFEH_EepromData.ydiMemory_xau16[3].amb_cond.ambient_condition[1][6] "ambient condition shot [0 .. 2-1] with 25 data bytes [0 .. 25-1] for the error code stored in this error memory slot" UBYTE EH_STANDARD_S4_S3 1 100 0 255 ECU_ADDRESS 0xFFF823CF DISPLAY_IDENTIFIER ambient_condition[1][6].amb_cond.ydiMemory_xau16[3].ZFEH_EepromData /end MEASUREMENT
/begin MEASUREMENT ZFEH_EepromData.ydiMemory_xau16[3].amb_cond.ambient_condition[1][7] "ambient condition shot [0 .. 2-1] with 25 data bytes [0 .. 25-1] for the error code stored in this error memory slot" UBYTE EH_STANDARD_S4_S3 1 100 0 255 ECU_ADDRESS 0xFFF823D0 DISPLAY_IDENTIFIER ambient_condition[1][7].amb_cond.ydiMemory_xau16[3].ZFEH_EepromData /end MEASUREMENT
/begin MEASUREMENT ZFEH_EepromData.ydiMemory_xau16[3].amb_cond.ambient_condition[1][8] "ambient condition shot [0 .. 2-1] with 25 data bytes [0 .. 25-1] for the error code stored in this error memory slot" UBYTE EH_STANDARD_S4_S3 1 100 0 255 ECU_ADDRESS 0xFFF823D1 DISPLAY_IDENTIFIER ambient_condition[1][8].amb_cond.ydiMemory_xau16[3].ZFEH_EepromData /end MEASUREMENT
/begin MEASUREMENT ZFEH_EepromData.ydiMemory_xau16[3].amb_cond.ambient_condition[1][9] "ambient condition shot [0 .. 2-1] with 25 data bytes [0 .. 25-1] for the error code stored in this error memory slot" UBYTE EH_STANDARD_S4_S3 1 100 0 255 ECU_ADDRESS 0xFFF823D2 DISPLAY_IDENTIFIER ambient_condition[1][9].amb_cond.ydiMemory_xau16[3].ZFEH_EepromData /end MEASUREMENT
/begin MEASUREMENT ZFEH_EepromData.ydiMemory_xau16[3].amb_cond.status_of_ambient_conditions[0] "status of ambient condition shot x: 0=invalid 1=valid" UBYTE EH_STANDARD_S4_S3 1 100 0 1 ECU_ADDRESS 0xFFF823E2 DISPLAY_IDENTIFIER status_of_ambient_conditions[0].amb_cond.ydiMemory_xau16[3].ZFEH_EepromData /end MEASUREMENT
/begin MEASUREMENT ZFEH_EepromData.ydiMemory_xau16[3].amb_cond.status_of_ambient_conditions[1] "status of ambient condition shot x: 0=invalid 1=valid" UBYTE EH_STANDARD_S4_S3 1 100 0 1 ECU_ADDRESS 0xFFF823E3 DISPLAY_IDENTIFIER status_of_ambient_conditions[1].amb_cond.ydiMemory_xau16[3].ZFEH_EepromData /end MEASUREMENT
/begin MEASUREMENT ZFEH_EepromData.ydiMemory_xau16[3].backwards_counter "backwards counter of error code stored in error memory slot" UBYTE EH_STANDARD_S4_S3 1 100 0 255 ECU_ADDRESS 0xFFF823A3 DISPLAY_IDENTIFIER backwards_counter.ydiMemory_xau16[3].ZFEH_EepromData /end MEASUREMENT
/begin MEASUREMENT ZFEH_EepromData.ydiMemory_xau16[3].condition_byte "condition byte of error code stored in error memory slot" UBYTE EH_STANDARD_S4_S3 1 100 0 255 ECU_ADDRESS 0xFFF823AD DISPLAY_IDENTIFIER condition_byte.ydiMemory_xau16[3].ZFEH_EepromData /end MEASUREMENT
/begin MEASUREMENT ZFEH_EepromData.ydiMemory_xau16[3].error_code "error code stored in error memory slot" UWORD EH_STANDARD_S4_S3 1 100 0 65535 ECU_ADDRESS 0xFFF8239C DISPLAY_IDENTIFIER error_code.ydiMemory_xau16[3].ZFEH_EepromData /end MEASUREMENT
/begin MEASUREMENT ZFEH_EepromData.ydiMemory_xau16[3].error_type "error type of error code stored in error memory slot" UWORD EH_STANDARD_S4_S3 1 100 0 65535 ECU_ADDRESS 0xFFF8239E DISPLAY_IDENTIFIER error_type.ydiMemory_xau16[3].ZFEH_EepromData /end MEASUREMENT
/begin MEASUREMENT ZFEH_EepromData.ydiMemory_xau16[3].frequency_counter "frequency counter of error code stored in error memory slot" UBYTE EH_STANDARD_S4_S3 1 100 0 255 ECU_ADDRESS 0xFFF823A2 DISPLAY_IDENTIFIER frequency_counter.ydiMemory_xau16[3].ZFEH_EepromData /end MEASUREMENT
/begin MEASUREMENT ZFEH_EepromData.ydiMemory_xau16[3].master_time "master time of error code stored in error memory slot" ULONG EH_STANDARD_S4_S3 1 100 0 4294967295 ECU_ADDRESS 0xFFF823A8 DISPLAY_IDENTIFIER master_time.ydiMemory_xau16[3].ZFEH_EepromData /end MEASUREMENT
/begin MEASUREMENT ZFEH_EepromData.ydiMemory_xau16[3].obd_driving_cycle_counter "obd driving cycle counter of error code stored in error memory slot" UWORD EH_STANDARD_S4_S3 1 100 0 65535 ECU_ADDRESS 0xFFF823AE DISPLAY_IDENTIFIER obd_driving_cycle_counter.ydiMemory_xau16[3].ZFEH_EepromData /end MEASUREMENT
/begin MEASUREMENT ZFEH_EepromData.ydiMemory_xau16[3].permanent_counter "counter of permanent error codes stored in error memory slot" UBYTE EH_STANDARD_S4_S3 1 100 0 255 ECU_ADDRESS 0xFFF823A4 DISPLAY_IDENTIFIER permanent_counter.ydiMemory_xau16[3].ZFEH_EepromData /end MEASUREMENT
/begin MEASUREMENT ZFEH_EepromData.ydiMemory_xau16[3].sequence_counter "sequence counter of error code stored in error memory slot" UBYTE EH_STANDARD_S4_S3 1 100 0 255 ECU_ADDRESS 0xFFF823A5 DISPLAY_IDENTIFIER sequence_counter.ydiMemory_xau16[3].ZFEH_EepromData /end MEASUREMENT
/begin MEASUREMENT ZFEH_EepromData.ydiMemory_xau16[3].status_word "status word of error code stored in error memory slot" UWORD EH_STANDARD_S4_S3 1 100 0 65535 ECU_ADDRESS 0xFFF823A0 DISPLAY_IDENTIFIER status_word.ydiMemory_xau16[3].ZFEH_EepromData /end MEASUREMENT
/begin MEASUREMENT ZFEH_EepromData.ydiMemory_xau16[4].amb_cond.ambient_condition[0][0] "ambient condition shot [0 .. 2-1] with 25 data bytes [0 .. 25-1] for the error code stored in this error memory slot" UBYTE EH_STANDARD_S4_S3 1 100 0 255 ECU_ADDRESS 0xFFF823F8 DISPLAY_IDENTIFIER ambient_condition[0][0].amb_cond.ydiMemory_xau16[4].ZFEH_EepromData /end MEASUREMENT
/begin MEASUREMENT ZFEH_EepromData.ydiMemory_xau16[4].amb_cond.ambient_condition[0][10] "ambient condition shot [0 .. 2-1] with 25 data bytes [0 .. 25-1] for the error code stored in this error memory slot" UBYTE EH_STANDARD_S4_S3 1 100 0 255 ECU_ADDRESS 0xFFF82402 DISPLAY_IDENTIFIER ambient_condition[0][10].amb_cond.ydiMemory_xau16[4].ZFEH_EepromData /end MEASUREMENT
/begin MEASUREMENT ZFEH_EepromData.ydiMemory_xau16[4].amb_cond.ambient_condition[0][11] "ambient condition shot [0 .. 2-1] with 25 data bytes [0 .. 25-1] for the error code stored in this error memory slot" UBYTE EH_STANDARD_S4_S3 1 100 0 255 ECU_ADDRESS 0xFFF82403 DISPLAY_IDENTIFIER ambient_condition[0][11].amb_cond.ydiMemory_xau16[4].ZFEH_EepromData /end MEASUREMENT
/begin MEASUREMENT ZFEH_EepromData.ydiMemory_xau16[4].amb_cond.ambient_condition[0][12] "ambient condition shot [0 .. 2-1] with 25 data bytes [0 .. 25-1] for the error code stored in this error memory slot" UBYTE EH_STANDARD_S4_S3 1 100 0 255 ECU_ADDRESS 0xFFF82404 DISPLAY_IDENTIFIER ambient_condition[0][12].amb_cond.ydiMemory_xau16[4].ZFEH_EepromData /end MEASUREMENT
/begin MEASUREMENT ZFEH_EepromData.ydiMemory_xau16[4].amb_cond.ambient_condition[0][13] "ambient condition shot [0 .. 2-1] with 25 data bytes [0 .. 25-1] for the error code stored in this error memory slot" UBYTE EH_STANDARD_S4_S3 1 100 0 255 ECU_ADDRESS 0xFFF82405 DISPLAY_IDENTIFIER ambient_condition[0][13].amb_cond.ydiMemory_xau16[4].ZFEH_EepromData /end MEASUREMENT
/begin MEASUREMENT ZFEH_EepromData.ydiMemory_xau16[4].amb_cond.ambient_condition[0][14] "ambient condition shot [0 .. 2-1] with 25 data bytes [0 .. 25-1] for the error code stored in this error memory slot" UBYTE EH_STANDARD_S4_S3 1 100 0 255 ECU_ADDRESS 0xFFF82406 DISPLAY_IDENTIFIER ambient_condition[0][14].amb_cond.ydiMemory_xau16[4].ZFEH_EepromData /end MEASUREMENT
/begin MEASUREMENT ZFEH_EepromData.ydiMemory_xau16[4].amb_cond.ambient_condition[0][15] "ambient condition shot [0 .. 2-1] with 25 data bytes [0 .. 25-1] for the error code stored in this error memory slot" UBYTE EH_STANDARD_S4_S3 1 100 0 255 ECU_ADDRESS 0xFFF82407 DISPLAY_IDENTIFIER ambient_condition[0][15].amb_cond.ydiMemory_xau16[4].ZFEH_EepromData /end MEASUREMENT
/begin MEASUREMENT ZFEH_EepromData.ydiMemory_xau16[4].amb_cond.ambient_condition[0][16] "ambient condition shot [0 .. 2-1] with 25 data bytes [0 .. 25-1] for the error code stored in this error memory slot" UBYTE EH_STANDARD_S4_S3 1 100 0 255 ECU_ADDRESS 0xFFF82408 DISPLAY_IDENTIFIER ambient_condition[0][16].amb_cond.ydiMemory_xau16[4].ZFEH_EepromData /end MEASUREMENT
/begin MEASUREMENT ZFEH_EepromData.ydiMemory_xau16[4].amb_cond.ambient_condition[0][17] "ambient condition shot [0 .. 2-1] with 25 data bytes [0 .. 25-1] for the error code stored in this error memory slot" UBYTE EH_STANDARD_S4_S3 1 100 0 255 ECU_ADDRESS 0xFFF82409 DISPLAY_IDENTIFIER ambient_condition[0][17].amb_cond.ydiMemory_xau16[4].ZFEH_EepromData /end MEASUREMENT
/begin MEASUREMENT ZFEH_EepromData.ydiMemory_xau16[4].amb_cond.ambient_condition[0][18] "ambient condition shot [0 .. 2-1] with 25 data bytes [0 .. 25-1] for the error code stored in this error memory slot" UBYTE EH_STANDARD_S4_S3 1 100 0 255 ECU_ADDRESS 0xFFF8240A DISPLAY_IDENTIFIER ambient_condition[0][18].amb_cond.ydiMemory_xau16[4].ZFEH_EepromData /end MEASUREMENT
/begin MEASUREMENT ZFEH_EepromData.ydiMemory_xau16[4].amb_cond.ambient_condition[0][19] "ambient condition shot [0 .. 2-1] with 25 data bytes [0 .. 25-1] for the error code stored in this error memory slot" UBYTE EH_STANDARD_S4_S3 1 100 0 255 ECU_ADDRESS 0xFFF8240B DISPLAY_IDENTIFIER ambient_condition[0][19].amb_cond.ydiMemory_xau16[4].ZFEH_EepromData /end MEASUREMENT
/begin MEASUREMENT ZFEH_EepromData.ydiMemory_xau16[4].amb_cond.ambient_condition[0][1] "ambient condition shot [0 .. 2-1] with 25 data bytes [0 .. 25-1] for the error code stored in this error memory slot" UBYTE EH_STANDARD_S4_S3 1 100 0 255 ECU_ADDRESS 0xFFF823F9 DISPLAY_IDENTIFIER ambient_condition[0][1].amb_cond.ydiMemory_xau16[4].ZFEH_EepromData /end MEASUREMENT
/begin MEASUREMENT ZFEH_EepromData.ydiMemory_xau16[4].amb_cond.ambient_condition[0][20] "ambient condition shot [0 .. 2-1] with 25 data bytes [0 .. 25-1] for the error code stored in this error memory slot" UBYTE EH_STANDARD_S4_S3 1 100 0 255 ECU_ADDRESS 0xFFF8240C DISPLAY_IDENTIFIER ambient_condition[0][20].amb_cond.ydiMemory_xau16[4].ZFEH_EepromData /end MEASUREMENT
/begin MEASUREMENT ZFEH_EepromData.ydiMemory_xau16[4].amb_cond.ambient_condition[0][21] "ambient condition shot [0 .. 2-1] with 25 data bytes [0 .. 25-1] for the error code stored in this error memory slot" UBYTE EH_STANDARD_S4_S3 1 100 0 255 ECU_ADDRESS 0xFFF8240D DISPLAY_IDENTIFIER ambient_condition[0][21].amb_cond.ydiMemory_xau16[4].ZFEH_EepromData /end MEASUREMENT
/begin MEASUREMENT ZFEH_EepromData.ydiMemory_xau16[4].amb_cond.ambient_condition[0][22] "ambient condition shot [0 .. 2-1] with 25 data bytes [0 .. 25-1] for the error code stored in this error memory slot" UBYTE EH_STANDARD_S4_S3 1 100 0 255 ECU_ADDRESS 0xFFF8240E DISPLAY_IDENTIFIER ambient_condition[0][22].amb_cond.ydiMemory_xau16[4].ZFEH_EepromData /end MEASUREMENT
/begin MEASUREMENT ZFEH_EepromData.ydiMemory_xau16[4].amb_cond.ambient_condition[0][23] "ambient condition shot [0 .. 2-1] with 25 data bytes [0 .. 25-1] for the error code stored in this error memory slot" UBYTE EH_STANDARD_S4_S3 1 100 0 255 ECU_ADDRESS 0xFFF8240F DISPLAY_IDENTIFIER ambient_condition[0][23].amb_cond.ydiMemory_xau16[4].ZFEH_EepromData /end MEASUREMENT
/begin MEASUREMENT ZFEH_EepromData.ydiMemory_xau16[4].amb_cond.ambient_condition[0][24] "ambient condition shot [0 .. 2-1] with 25 data bytes [0 .. 25-1] for the error code stored in this error memory slot" UBYTE EH_STANDARD_S4_S3 1 100 0 255 ECU_ADDRESS 0xFFF82410 DISPLAY_IDENTIFIER ambient_condition[0][24].amb_cond.ydiMemory_xau16[4].ZFEH_EepromData /end MEASUREMENT
/begin MEASUREMENT ZFEH_EepromData.ydiMemory_xau16[4].amb_cond.ambient_condition[0][2] "ambient condition shot [0 .. 2-1] with 25 data bytes [0 .. 25-1] for the error code stored in this error memory slot" UBYTE EH_STANDARD_S4_S3 1 100 0 255 ECU_ADDRESS 0xFFF823FA DISPLAY_IDENTIFIER ambient_condition[0][2].amb_cond.ydiMemory_xau16[4].ZFEH_EepromData /end MEASUREMENT
/begin MEASUREMENT ZFEH_EepromData.ydiMemory_xau16[4].amb_cond.ambient_condition[0][3] "ambient condition shot [0 .. 2-1] with 25 data bytes [0 .. 25-1] for the error code stored in this error memory slot" UBYTE EH_STANDARD_S4_S3 1 100 0 255 ECU_ADDRESS 0xFFF823FB DISPLAY_IDENTIFIER ambient_condition[0][3].amb_cond.ydiMemory_xau16[4].ZFEH_EepromData /end MEASUREMENT
/begin MEASUREMENT ZFEH_EepromData.ydiMemory_xau16[4].amb_cond.ambient_condition[0][4] "ambient condition shot [0 .. 2-1] with 25 data bytes [0 .. 25-1] for the error code stored in this error memory slot" UBYTE EH_STANDARD_S4_S3 1 100 0 255 ECU_ADDRESS 0xFFF823FC DISPLAY_IDENTIFIER ambient_condition[0][4].amb_cond.ydiMemory_xau16[4].ZFEH_EepromData /end MEASUREMENT
/begin MEASUREMENT ZFEH_EepromData.ydiMemory_xau16[4].amb_cond.ambient_condition[0][5] "ambient condition shot [0 .. 2-1] with 25 data bytes [0 .. 25-1] for the error code stored in this error memory slot" UBYTE EH_STANDARD_S4_S3 1 100 0 255 ECU_ADDRESS 0xFFF823FD DISPLAY_IDENTIFIER ambient_condition[0][5].amb_cond.ydiMemory_xau16[4].ZFEH_EepromData /end MEASUREMENT
/begin MEASUREMENT ZFEH_EepromData.ydiMemory_xau16[4].amb_cond.ambient_condition[0][6] "ambient condition shot [0 .. 2-1] with 25 data bytes [0 .. 25-1] for the error code stored in this error memory slot" UBYTE EH_STANDARD_S4_S3 1 100 0 255 ECU_ADDRESS 0xFFF823FE DISPLAY_IDENTIFIER ambient_condition[0][6].amb_cond.ydiMemory_xau16[4].ZFEH_EepromData /end MEASUREMENT
/begin MEASUREMENT ZFEH_EepromData.ydiMemory_xau16[4].amb_cond.ambient_condition[0][7] "ambient condition shot [0 .. 2-1] with 25 data bytes [0 .. 25-1] for the error code stored in this error memory slot" UBYTE EH_STANDARD_S4_S3 1 100 0 255 ECU_ADDRESS 0xFFF823FF DISPLAY_IDENTIFIER ambient_condition[0][7].amb_cond.ydiMemory_xau16[4].ZFEH_EepromData /end MEASUREMENT
/begin MEASUREMENT ZFEH_EepromData.ydiMemory_xau16[4].amb_cond.ambient_condition[0][8] "ambient condition shot [0 .. 2-1] with 25 data bytes [0 .. 25-1] for the error code stored in this error memory slot" UBYTE EH_STANDARD_S4_S3 1 100 0 255 ECU_ADDRESS 0xFFF82400 DISPLAY_IDENTIFIER ambient_condition[0][8].amb_cond.ydiMemory_xau16[4].ZFEH_EepromData /end MEASUREMENT
/begin MEASUREMENT ZFEH_EepromData.ydiMemory_xau16[4].amb_cond.ambient_condition[0][9] "ambient condition shot [0 .. 2-1] with 25 data bytes [0 .. 25-1] for the error code stored in this error memory slot" UBYTE EH_STANDARD_S4_S3 1 100 0 255 ECU_ADDRESS 0xFFF82401 DISPLAY_IDENTIFIER ambient_condition[0][9].amb_cond.ydiMemory_xau16[4].ZFEH_EepromData /end MEASUREMENT
/begin MEASUREMENT ZFEH_EepromData.ydiMemory_xau16[4].amb_cond.ambient_condition[1][0] "ambient condition shot [0 .. 2-1] with 25 data bytes [0 .. 25-1] for the error code stored in this error memory slot" UBYTE EH_STANDARD_S4_S3 1 100 0 255 ECU_ADDRESS 0xFFF82411 DISPLAY_IDENTIFIER ambient_condition[1][0].amb_cond.ydiMemory_xau16[4].ZFEH_EepromData /end MEASUREMENT
/begin MEASUREMENT ZFEH_EepromData.ydiMemory_xau16[4].amb_cond.ambient_condition[1][10] "ambient condition shot [0 .. 2-1] with 25 data bytes [0 .. 25-1] for the error code stored in this error memory slot" UBYTE EH_STANDARD_S4_S3 1 100 0 255 ECU_ADDRESS 0xFFF8241B DISPLAY_IDENTIFIER ambient_condition[1][10].amb_cond.ydiMemory_xau16[4].ZFEH_EepromData /end MEASUREMENT
/begin MEASUREMENT ZFEH_EepromData.ydiMemory_xau16[4].amb_cond.ambient_condition[1][11] "ambient condition shot [0 .. 2-1] with 25 data bytes [0 .. 25-1] for the error code stored in this error memory slot" UBYTE EH_STANDARD_S4_S3 1 100 0 255 ECU_ADDRESS 0xFFF8241C DISPLAY_IDENTIFIER ambient_condition[1][11].amb_cond.ydiMemory_xau16[4].ZFEH_EepromData /end MEASUREMENT
/begin MEASUREMENT ZFEH_EepromData.ydiMemory_xau16[4].amb_cond.ambient_condition[1][12] "ambient condition shot [0 .. 2-1] with 25 data bytes [0 .. 25-1] for the error code stored in this error memory slot" UBYTE EH_STANDARD_S4_S3 1 100 0 255 ECU_ADDRESS 0xFFF8241D DISPLAY_IDENTIFIER ambient_condition[1][12].amb_cond.ydiMemory_xau16[4].ZFEH_EepromData /end MEASUREMENT
/begin MEASUREMENT ZFEH_EepromData.ydiMemory_xau16[4].amb_cond.ambient_condition[1][13] "ambient condition shot [0 .. 2-1] with 25 data bytes [0 .. 25-1] for the error code stored in this error memory slot" UBYTE EH_STANDARD_S4_S3 1 100 0 255 ECU_ADDRESS 0xFFF8241E DISPLAY_IDENTIFIER ambient_condition[1][13].amb_cond.ydiMemory_xau16[4].ZFEH_EepromData /end MEASUREMENT
/begin MEASUREMENT ZFEH_EepromData.ydiMemory_xau16[4].amb_cond.ambient_condition[1][14] "ambient condition shot [0 .. 2-1] with 25 data bytes [0 .. 25-1] for the error code stored in this error memory slot" UBYTE EH_STANDARD_S4_S3 1 100 0 255 ECU_ADDRESS 0xFFF8241F DISPLAY_IDENTIFIER ambient_condition[1][14].amb_cond.ydiMemory_xau16[4].ZFEH_EepromData /end MEASUREMENT
/begin MEASUREMENT ZFEH_EepromData.ydiMemory_xau16[4].amb_cond.ambient_condition[1][15] "ambient condition shot [0 .. 2-1] with 25 data bytes [0 .. 25-1] for the error code stored in this error memory slot" UBYTE EH_STANDARD_S4_S3 1 100 0 255 ECU_ADDRESS 0xFFF82420 DISPLAY_IDENTIFIER ambient_condition[1][15].amb_cond.ydiMemory_xau16[4].ZFEH_EepromData /end MEASUREMENT
/begin MEASUREMENT ZFEH_EepromData.ydiMemory_xau16[4].amb_cond.ambient_condition[1][16] "ambient condition shot [0 .. 2-1] with 25 data bytes [0 .. 25-1] for the error code stored in this error memory slot" UBYTE EH_STANDARD_S4_S3 1 100 0 255 ECU_ADDRESS 0xFFF82421 DISPLAY_IDENTIFIER ambient_condition[1][16].amb_cond.ydiMemory_xau16[4].ZFEH_EepromData /end MEASUREMENT
/begin MEASUREMENT ZFEH_EepromData.ydiMemory_xau16[4].amb_cond.ambient_condition[1][17] "ambient condition shot [0 .. 2-1] with 25 data bytes [0 .. 25-1] for the error code stored in this error memory slot" UBYTE EH_STANDARD_S4_S3 1 100 0 255 ECU_ADDRESS 0xFFF82422 DISPLAY_IDENTIFIER ambient_condition[1][17].amb_cond.ydiMemory_xau16[4].ZFEH_EepromData /end MEASUREMENT
/begin MEASUREMENT ZFEH_EepromData.ydiMemory_xau16[4].amb_cond.ambient_condition[1][18] "ambient condition shot [0 .. 2-1] with 25 data bytes [0 .. 25-1] for the error code stored in this error memory slot" UBYTE EH_STANDARD_S4_S3 1 100 0 255 ECU_ADDRESS 0xFFF82423 DISPLAY_IDENTIFIER ambient_condition[1][18].amb_cond.ydiMemory_xau16[4].ZFEH_EepromData /end MEASUREMENT
/begin MEASUREMENT ZFEH_EepromData.ydiMemory_xau16[4].amb_cond.ambient_condition[1][19] "ambient condition shot [0 .. 2-1] with 25 data bytes [0 .. 25-1] for the error code stored in this error memory slot" UBYTE EH_STANDARD_S4_S3 1 100 0 255 ECU_ADDRESS 0xFFF82424 DISPLAY_IDENTIFIER ambient_condition[1][19].amb_cond.ydiMemory_xau16[4].ZFEH_EepromData /end MEASUREMENT
/begin MEASUREMENT ZFEH_EepromData.ydiMemory_xau16[4].amb_cond.ambient_condition[1][1] "ambient condition shot [0 .. 2-1] with 25 data bytes [0 .. 25-1] for the error code stored in this error memory slot" UBYTE EH_STANDARD_S4_S3 1 100 0 255 ECU_ADDRESS 0xFFF82412 DISPLAY_IDENTIFIER ambient_condition[1][1].amb_cond.ydiMemory_xau16[4].ZFEH_EepromData /end MEASUREMENT
/begin MEASUREMENT ZFEH_EepromData.ydiMemory_xau16[4].amb_cond.ambient_condition[1][20] "ambient condition shot [0 .. 2-1] with 25 data bytes [0 .. 25-1] for the error code stored in this error memory slot" UBYTE EH_STANDARD_S4_S3 1 100 0 255 ECU_ADDRESS 0xFFF82425 DISPLAY_IDENTIFIER ambient_condition[1][20].amb_cond.ydiMemory_xau16[4].ZFEH_EepromData /end MEASUREMENT
/begin MEASUREMENT ZFEH_EepromData.ydiMemory_xau16[4].amb_cond.ambient_condition[1][21] "ambient condition shot [0 .. 2-1] with 25 data bytes [0 .. 25-1] for the error code stored in this error memory slot" UBYTE EH_STANDARD_S4_S3 1 100 0 255 ECU_ADDRESS 0xFFF82426 DISPLAY_IDENTIFIER ambient_condition[1][21].amb_cond.ydiMemory_xau16[4].ZFEH_EepromData /end MEASUREMENT
/begin MEASUREMENT ZFEH_EepromData.ydiMemory_xau16[4].amb_cond.ambient_condition[1][22] "ambient condition shot [0 .. 2-1] with 25 data bytes [0 .. 25-1] for the error code stored in this error memory slot" UBYTE EH_STANDARD_S4_S3 1 100 0 255 ECU_ADDRESS 0xFFF82427 DISPLAY_IDENTIFIER ambient_condition[1][22].amb_cond.ydiMemory_xau16[4].ZFEH_EepromData /end MEASUREMENT
/begin MEASUREMENT ZFEH_EepromData.ydiMemory_xau16[4].amb_cond.ambient_condition[1][23] "ambient condition shot [0 .. 2-1] with 25 data bytes [0 .. 25-1] for the error code stored in this error memory slot" UBYTE EH_STANDARD_S4_S3 1 100 0 255 ECU_ADDRESS 0xFFF82428 DISPLAY_IDENTIFIER ambient_condition[1][23].amb_cond.ydiMemory_xau16[4].ZFEH_EepromData /end MEASUREMENT
/begin MEASUREMENT ZFEH_EepromData.ydiMemory_xau16[4].amb_cond.ambient_condition[1][24] "ambient condition shot [0 .. 2-1] with 25 data bytes [0 .. 25-1] for the error code stored in this error memory slot" UBYTE EH_STANDARD_S4_S3 1 100 0 255 ECU_ADDRESS 0xFFF82429 DISPLAY_IDENTIFIER ambient_condition[1][24].amb_cond.ydiMemory_xau16[4].ZFEH_EepromData /end MEASUREMENT
/begin MEASUREMENT ZFEH_EepromData.ydiMemory_xau16[4].amb_cond.ambient_condition[1][2] "ambient condition shot [0 .. 2-1] with 25 data bytes [0 .. 25-1] for the error code stored in this error memory slot" UBYTE EH_STANDARD_S4_S3 1 100 0 255 ECU_ADDRESS 0xFFF82413 DISPLAY_IDENTIFIER ambient_condition[1][2].amb_cond.ydiMemory_xau16[4].ZFEH_EepromData /end MEASUREMENT
/begin MEASUREMENT ZFEH_EepromData.ydiMemory_xau16[4].amb_cond.ambient_condition[1][3] "ambient condition shot [0 .. 2-1] with 25 data bytes [0 .. 25-1] for the error code stored in this error memory slot" UBYTE EH_STANDARD_S4_S3 1 100 0 255 ECU_ADDRESS 0xFFF82414 DISPLAY_IDENTIFIER ambient_condition[1][3].amb_cond.ydiMemory_xau16[4].ZFEH_EepromData /end MEASUREMENT
/begin MEASUREMENT ZFEH_EepromData.ydiMemory_xau16[4].amb_cond.ambient_condition[1][4] "ambient condition shot [0 .. 2-1] with 25 data bytes [0 .. 25-1] for the error code stored in this error memory slot" UBYTE EH_STANDARD_S4_S3 1 100 0 255 ECU_ADDRESS 0xFFF82415 DISPLAY_IDENTIFIER ambient_condition[1][4].amb_cond.ydiMemory_xau16[4].ZFEH_EepromData /end MEASUREMENT
/begin MEASUREMENT ZFEH_EepromData.ydiMemory_xau16[4].amb_cond.ambient_condition[1][5] "ambient condition shot [0 .. 2-1] with 25 data bytes [0 .. 25-1] for the error code stored in this error memory slot" UBYTE EH_STANDARD_S4_S3 1 100 0 255 ECU_ADDRESS 0xFFF82416 DISPLAY_IDENTIFIER ambient_condition[1][5].amb_cond.ydiMemory_xau16[4].ZFEH_EepromData /end MEASUREMENT
/begin MEASUREMENT ZFEH_EepromData.ydiMemory_xau16[4].amb_cond.ambient_condition[1][6] "ambient condition shot [0 .. 2-1] with 25 data bytes [0 .. 25-1] for the error code stored in this error memory slot" UBYTE EH_STANDARD_S4_S3 1 100 0 255 ECU_ADDRESS 0xFFF82417 DISPLAY_IDENTIFIER ambient_condition[1][6].amb_cond.ydiMemory_xau16[4].ZFEH_EepromData /end MEASUREMENT
/begin MEASUREMENT ZFEH_EepromData.ydiMemory_xau16[4].amb_cond.ambient_condition[1][7] "ambient condition shot [0 .. 2-1] with 25 data bytes [0 .. 25-1] for the error code stored in this error memory slot" UBYTE EH_STANDARD_S4_S3 1 100 0 255 ECU_ADDRESS 0xFFF82418 DISPLAY_IDENTIFIER ambient_condition[1][7].amb_cond.ydiMemory_xau16[4].ZFEH_EepromData /end MEASUREMENT
/begin MEASUREMENT ZFEH_EepromData.ydiMemory_xau16[4].amb_cond.ambient_condition[1][8] "ambient condition shot [0 .. 2-1] with 25 data bytes [0 .. 25-1] for the error code stored in this error memory slot" UBYTE EH_STANDARD_S4_S3 1 100 0 255 ECU_ADDRESS 0xFFF82419 DISPLAY_IDENTIFIER ambient_condition[1][8].amb_cond.ydiMemory_xau16[4].ZFEH_EepromData /end MEASUREMENT
/begin MEASUREMENT ZFEH_EepromData.ydiMemory_xau16[4].amb_cond.ambient_condition[1][9] "ambient condition shot [0 .. 2-1] with 25 data bytes [0 .. 25-1] for the error code stored in this error memory slot" UBYTE EH_STANDARD_S4_S3 1 100 0 255 ECU_ADDRESS 0xFFF8241A DISPLAY_IDENTIFIER ambient_condition[1][9].amb_cond.ydiMemory_xau16[4].ZFEH_EepromData /end MEASUREMENT
/begin MEASUREMENT ZFEH_EepromData.ydiMemory_xau16[4].amb_cond.status_of_ambient_conditions[0] "status of ambient condition shot x: 0=invalid 1=valid" UBYTE EH_STANDARD_S4_S3 1 100 0 1 ECU_ADDRESS 0xFFF8242A DISPLAY_IDENTIFIER status_of_ambient_conditions[0].amb_cond.ydiMemory_xau16[4].ZFEH_EepromData /end MEASUREMENT
/begin MEASUREMENT ZFEH_EepromData.ydiMemory_xau16[4].amb_cond.status_of_ambient_conditions[1] "status of ambient condition shot x: 0=invalid 1=valid" UBYTE EH_STANDARD_S4_S3 1 100 0 1 ECU_ADDRESS 0xFFF8242B DISPLAY_IDENTIFIER status_of_ambient_conditions[1].amb_cond.ydiMemory_xau16[4].ZFEH_EepromData /end MEASUREMENT
/begin MEASUREMENT ZFEH_EepromData.ydiMemory_xau16[4].backwards_counter "backwards counter of error code stored in error memory slot" UBYTE EH_STANDARD_S4_S3 1 100 0 255 ECU_ADDRESS 0xFFF823EB DISPLAY_IDENTIFIER backwards_counter.ydiMemory_xau16[4].ZFEH_EepromData /end MEASUREMENT
/begin MEASUREMENT ZFEH_EepromData.ydiMemory_xau16[4].condition_byte "condition byte of error code stored in error memory slot" UBYTE EH_STANDARD_S4_S3 1 100 0 255 ECU_ADDRESS 0xFFF823F5 DISPLAY_IDENTIFIER condition_byte.ydiMemory_xau16[4].ZFEH_EepromData /end MEASUREMENT
/begin MEASUREMENT ZFEH_EepromData.ydiMemory_xau16[4].error_code "error code stored in error memory slot" UWORD EH_STANDARD_S4_S3 1 100 0 65535 ECU_ADDRESS 0xFFF823E4 DISPLAY_IDENTIFIER error_code.ydiMemory_xau16[4].ZFEH_EepromData /end MEASUREMENT
/begin MEASUREMENT ZFEH_EepromData.ydiMemory_xau16[4].error_type "error type of error code stored in error memory slot" UWORD EH_STANDARD_S4_S3 1 100 0 65535 ECU_ADDRESS 0xFFF823E6 DISPLAY_IDENTIFIER error_type.ydiMemory_xau16[4].ZFEH_EepromData /end MEASUREMENT
/begin MEASUREMENT ZFEH_EepromData.ydiMemory_xau16[4].frequency_counter "frequency counter of error code stored in error memory slot" UBYTE EH_STANDARD_S4_S3 1 100 0 255 ECU_ADDRESS 0xFFF823EA DISPLAY_IDENTIFIER frequency_counter.ydiMemory_xau16[4].ZFEH_EepromData /end MEASUREMENT
/begin MEASUREMENT ZFEH_EepromData.ydiMemory_xau16[4].master_time "master time of error code stored in error memory slot" ULONG EH_STANDARD_S4_S3 1 100 0 4294967295 ECU_ADDRESS 0xFFF823F0 DISPLAY_IDENTIFIER master_time.ydiMemory_xau16[4].ZFEH_EepromData /end MEASUREMENT
/begin MEASUREMENT ZFEH_EepromData.ydiMemory_xau16[4].obd_driving_cycle_counter "obd driving cycle counter of error code stored in error memory slot" UWORD EH_STANDARD_S4_S3 1 100 0 65535 ECU_ADDRESS 0xFFF823F6 DISPLAY_IDENTIFIER obd_driving_cycle_counter.ydiMemory_xau16[4].ZFEH_EepromData /end MEASUREMENT
/begin MEASUREMENT ZFEH_EepromData.ydiMemory_xau16[4].permanent_counter "counter of permanent error codes stored in error memory slot" UBYTE EH_STANDARD_S4_S3 1 100 0 255 ECU_ADDRESS 0xFFF823EC DISPLAY_IDENTIFIER permanent_counter.ydiMemory_xau16[4].ZFEH_EepromData /end MEASUREMENT
/begin MEASUREMENT ZFEH_EepromData.ydiMemory_xau16[4].sequence_counter "sequence counter of error code stored in error memory slot" UBYTE EH_STANDARD_S4_S3 1 100 0 255 ECU_ADDRESS 0xFFF823ED DISPLAY_IDENTIFIER sequence_counter.ydiMemory_xau16[4].ZFEH_EepromData /end MEASUREMENT
/begin MEASUREMENT ZFEH_EepromData.ydiMemory_xau16[4].status_word "status word of error code stored in error memory slot" UWORD EH_STANDARD_S4_S3 1 100 0 65535 ECU_ADDRESS 0xFFF823E8 DISPLAY_IDENTIFIER status_word.ydiMemory_xau16[4].ZFEH_EepromData /end MEASUREMENT
/begin MEASUREMENT ZFEH_EepromData.ydiMemory_xau16[5].amb_cond.ambient_condition[0][0] "ambient condition shot [0 .. 2-1] with 25 data bytes [0 .. 25-1] for the error code stored in this error memory slot" UBYTE EH_STANDARD_S4_S3 1 100 0 255 ECU_ADDRESS 0xFFF82440 DISPLAY_IDENTIFIER ambient_condition[0][0].amb_cond.ydiMemory_xau16[5].ZFEH_EepromData /end MEASUREMENT
/begin MEASUREMENT ZFEH_EepromData.ydiMemory_xau16[5].amb_cond.ambient_condition[0][10] "ambient condition shot [0 .. 2-1] with 25 data bytes [0 .. 25-1] for the error code stored in this error memory slot" UBYTE EH_STANDARD_S4_S3 1 100 0 255 ECU_ADDRESS 0xFFF8244A DISPLAY_IDENTIFIER ambient_condition[0][10].amb_cond.ydiMemory_xau16[5].ZFEH_EepromData /end MEASUREMENT
/begin MEASUREMENT ZFEH_EepromData.ydiMemory_xau16[5].amb_cond.ambient_condition[0][11] "ambient condition shot [0 .. 2-1] with 25 data bytes [0 .. 25-1] for the error code stored in this error memory slot" UBYTE EH_STANDARD_S4_S3 1 100 0 255 ECU_ADDRESS 0xFFF8244B DISPLAY_IDENTIFIER ambient_condition[0][11].amb_cond.ydiMemory_xau16[5].ZFEH_EepromData /end MEASUREMENT
/begin MEASUREMENT ZFEH_EepromData.ydiMemory_xau16[5].amb_cond.ambient_condition[0][12] "ambient condition shot [0 .. 2-1] with 25 data bytes [0 .. 25-1] for the error code stored in this error memory slot" UBYTE EH_STANDARD_S4_S3 1 100 0 255 ECU_ADDRESS 0xFFF8244C DISPLAY_IDENTIFIER ambient_condition[0][12].amb_cond.ydiMemory_xau16[5].ZFEH_EepromData /end MEASUREMENT
/begin MEASUREMENT ZFEH_EepromData.ydiMemory_xau16[5].amb_cond.ambient_condition[0][13] "ambient condition shot [0 .. 2-1] with 25 data bytes [0 .. 25-1] for the error code stored in this error memory slot" UBYTE EH_STANDARD_S4_S3 1 100 0 255 ECU_ADDRESS 0xFFF8244D DISPLAY_IDENTIFIER ambient_condition[0][13].amb_cond.ydiMemory_xau16[5].ZFEH_EepromData /end MEASUREMENT
/begin MEASUREMENT ZFEH_EepromData.ydiMemory_xau16[5].amb_cond.ambient_condition[0][14] "ambient condition shot [0 .. 2-1] with 25 data bytes [0 .. 25-1] for the error code stored in this error memory slot" UBYTE EH_STANDARD_S4_S3 1 100 0 255 ECU_ADDRESS 0xFFF8244E DISPLAY_IDENTIFIER ambient_condition[0][14].amb_cond.ydiMemory_xau16[5].ZFEH_EepromData /end MEASUREMENT
/begin MEASUREMENT ZFEH_EepromData.ydiMemory_xau16[5].amb_cond.ambient_condition[0][15] "ambient condition shot [0 .. 2-1] with 25 data bytes [0 .. 25-1] for the error code stored in this error memory slot" UBYTE EH_STANDARD_S4_S3 1 100 0 255 ECU_ADDRESS 0xFFF8244F DISPLAY_IDENTIFIER ambient_condition[0][15].amb_cond.ydiMemory_xau16[5].ZFEH_EepromData /end MEASUREMENT
/begin MEASUREMENT ZFEH_EepromData.ydiMemory_xau16[5].amb_cond.ambient_condition[0][16] "ambient condition shot [0 .. 2-1] with 25 data bytes [0 .. 25-1] for the error code stored in this error memory slot" UBYTE EH_STANDARD_S4_S3 1 100 0 255 ECU_ADDRESS 0xFFF82450 DISPLAY_IDENTIFIER ambient_condition[0][16].amb_cond.ydiMemory_xau16[5].ZFEH_EepromData /end MEASUREMENT
/begin MEASUREMENT ZFEH_EepromData.ydiMemory_xau16[5].amb_cond.ambient_condition[0][17] "ambient condition shot [0 .. 2-1] with 25 data bytes [0 .. 25-1] for the error code stored in this error memory slot" UBYTE EH_STANDARD_S4_S3 1 100 0 255 ECU_ADDRESS 0xFFF82451 DISPLAY_IDENTIFIER ambient_condition[0][17].amb_cond.ydiMemory_xau16[5].ZFEH_EepromData /end MEASUREMENT
/begin MEASUREMENT ZFEH_EepromData.ydiMemory_xau16[5].amb_cond.ambient_condition[0][18] "ambient condition shot [0 .. 2-1] with 25 data bytes [0 .. 25-1] for the error code stored in this error memory slot" UBYTE EH_STANDARD_S4_S3 1 100 0 255 ECU_ADDRESS 0xFFF82452 DISPLAY_IDENTIFIER ambient_condition[0][18].amb_cond.ydiMemory_xau16[5].ZFEH_EepromData /end MEASUREMENT
/begin MEASUREMENT ZFEH_EepromData.ydiMemory_xau16[5].amb_cond.ambient_condition[0][19] "ambient condition shot [0 .. 2-1] with 25 data bytes [0 .. 25-1] for the error code stored in this error memory slot" UBYTE EH_STANDARD_S4_S3 1 100 0 255 ECU_ADDRESS 0xFFF82453 DISPLAY_IDENTIFIER ambient_condition[0][19].amb_cond.ydiMemory_xau16[5].ZFEH_EepromData /end MEASUREMENT
/begin MEASUREMENT ZFEH_EepromData.ydiMemory_xau16[5].amb_cond.ambient_condition[0][1] "ambient condition shot [0 .. 2-1] with 25 data bytes [0 .. 25-1] for the error code stored in this error memory slot" UBYTE EH_STANDARD_S4_S3 1 100 0 255 ECU_ADDRESS 0xFFF82441 DISPLAY_IDENTIFIER ambient_condition[0][1].amb_cond.ydiMemory_xau16[5].ZFEH_EepromData /end MEASUREMENT
/begin MEASUREMENT ZFEH_EepromData.ydiMemory_xau16[5].amb_cond.ambient_condition[0][20] "ambient condition shot [0 .. 2-1] with 25 data bytes [0 .. 25-1] for the error code stored in this error memory slot" UBYTE EH_STANDARD_S4_S3 1 100 0 255 ECU_ADDRESS 0xFFF82454 DISPLAY_IDENTIFIER ambient_condition[0][20].amb_cond.ydiMemory_xau16[5].ZFEH_EepromData /end MEASUREMENT
/begin MEASUREMENT ZFEH_EepromData.ydiMemory_xau16[5].amb_cond.ambient_condition[0][21] "ambient condition shot [0 .. 2-1] with 25 data bytes [0 .. 25-1] for the error code stored in this error memory slot" UBYTE EH_STANDARD_S4_S3 1 100 0 255 ECU_ADDRESS 0xFFF82455 DISPLAY_IDENTIFIER ambient_condition[0][21].amb_cond.ydiMemory_xau16[5].ZFEH_EepromData /end MEASUREMENT
/begin MEASUREMENT ZFEH_EepromData.ydiMemory_xau16[5].amb_cond.ambient_condition[0][22] "ambient condition shot [0 .. 2-1] with 25 data bytes [0 .. 25-1] for the error code stored in this error memory slot" UBYTE EH_STANDARD_S4_S3 1 100 0 255 ECU_ADDRESS 0xFFF82456 DISPLAY_IDENTIFIER ambient_condition[0][22].amb_cond.ydiMemory_xau16[5].ZFEH_EepromData /end MEASUREMENT
/begin MEASUREMENT ZFEH_EepromData.ydiMemory_xau16[5].amb_cond.ambient_condition[0][23] "ambient condition shot [0 .. 2-1] with 25 data bytes [0 .. 25-1] for the error code stored in this error memory slot" UBYTE EH_STANDARD_S4_S3 1 100 0 255 ECU_ADDRESS 0xFFF82457 DISPLAY_IDENTIFIER ambient_condition[0][23].amb_cond.ydiMemory_xau16[5].ZFEH_EepromData /end MEASUREMENT
/begin MEASUREMENT ZFEH_EepromData.ydiMemory_xau16[5].amb_cond.ambient_condition[0][24] "ambient condition shot [0 .. 2-1] with 25 data bytes [0 .. 25-1] for the error code stored in this error memory slot" UBYTE EH_STANDARD_S4_S3 1 100 0 255 ECU_ADDRESS 0xFFF82458 DISPLAY_IDENTIFIER ambient_condition[0][24].amb_cond.ydiMemory_xau16[5].ZFEH_EepromData /end MEASUREMENT
/begin MEASUREMENT ZFEH_EepromData.ydiMemory_xau16[5].amb_cond.ambient_condition[0][2] "ambient condition shot [0 .. 2-1] with 25 data bytes [0 .. 25-1] for the error code stored in this error memory slot" UBYTE EH_STANDARD_S4_S3 1 100 0 255 ECU_ADDRESS 0xFFF82442 DISPLAY_IDENTIFIER ambient_condition[0][2].amb_cond.ydiMemory_xau16[5].ZFEH_EepromData /end MEASUREMENT
/begin MEASUREMENT ZFEH_EepromData.ydiMemory_xau16[5].amb_cond.ambient_condition[0][3] "ambient condition shot [0 .. 2-1] with 25 data bytes [0 .. 25-1] for the error code stored in this error memory slot" UBYTE EH_STANDARD_S4_S3 1 100 0 255 ECU_ADDRESS 0xFFF82443 DISPLAY_IDENTIFIER ambient_condition[0][3].amb_cond.ydiMemory_xau16[5].ZFEH_EepromData /end MEASUREMENT
/begin MEASUREMENT ZFEH_EepromData.ydiMemory_xau16[5].amb_cond.ambient_condition[0][4] "ambient condition shot [0 .. 2-1] with 25 data bytes [0 .. 25-1] for the error code stored in this error memory slot" UBYTE EH_STANDARD_S4_S3 1 100 0 255 ECU_ADDRESS 0xFFF82444 DISPLAY_IDENTIFIER ambient_condition[0][4].amb_cond.ydiMemory_xau16[5].ZFEH_EepromData /end MEASUREMENT
/begin MEASUREMENT ZFEH_EepromData.ydiMemory_xau16[5].amb_cond.ambient_condition[0][5] "ambient condition shot [0 .. 2-1] with 25 data bytes [0 .. 25-1] for the error code stored in this error memory slot" UBYTE EH_STANDARD_S4_S3 1 100 0 255 ECU_ADDRESS 0xFFF82445 DISPLAY_IDENTIFIER ambient_condition[0][5].amb_cond.ydiMemory_xau16[5].ZFEH_EepromData /end MEASUREMENT
/begin MEASUREMENT ZFEH_EepromData.ydiMemory_xau16[5].amb_cond.ambient_condition[0][6] "ambient condition shot [0 .. 2-1] with 25 data bytes [0 .. 25-1] for the error code stored in this error memory slot" UBYTE EH_STANDARD_S4_S3 1 100 0 255 ECU_ADDRESS 0xFFF82446 DISPLAY_IDENTIFIER ambient_condition[0][6].amb_cond.ydiMemory_xau16[5].ZFEH_EepromData /end MEASUREMENT
/begin MEASUREMENT ZFEH_EepromData.ydiMemory_xau16[5].amb_cond.ambient_condition[0][7] "ambient condition shot [0 .. 2-1] with 25 data bytes [0 .. 25-1] for the error code stored in this error memory slot" UBYTE EH_STANDARD_S4_S3 1 100 0 255 ECU_ADDRESS 0xFFF82447 DISPLAY_IDENTIFIER ambient_condition[0][7].amb_cond.ydiMemory_xau16[5].ZFEH_EepromData /end MEASUREMENT
/begin MEASUREMENT ZFEH_EepromData.ydiMemory_xau16[5].amb_cond.ambient_condition[0][8] "ambient condition shot [0 .. 2-1] with 25 data bytes [0 .. 25-1] for the error code stored in this error memory slot" UBYTE EH_STANDARD_S4_S3 1 100 0 255 ECU_ADDRESS 0xFFF82448 DISPLAY_IDENTIFIER ambient_condition[0][8].amb_cond.ydiMemory_xau16[5].ZFEH_EepromData /end MEASUREMENT
/begin MEASUREMENT ZFEH_EepromData.ydiMemory_xau16[5].amb_cond.ambient_condition[0][9] "ambient condition shot [0 .. 2-1] with 25 data bytes [0 .. 25-1] for the error code stored in this error memory slot" UBYTE EH_STANDARD_S4_S3 1 100 0 255 ECU_ADDRESS 0xFFF82449 DISPLAY_IDENTIFIER ambient_condition[0][9].amb_cond.ydiMemory_xau16[5].ZFEH_EepromData /end MEASUREMENT
/begin MEASUREMENT ZFEH_EepromData.ydiMemory_xau16[5].amb_cond.ambient_condition[1][0] "ambient condition shot [0 .. 2-1] with 25 data bytes [0 .. 25-1] for the error code stored in this error memory slot" UBYTE EH_STANDARD_S4_S3 1 100 0 255 ECU_ADDRESS 0xFFF82459 DISPLAY_IDENTIFIER ambient_condition[1][0].amb_cond.ydiMemory_xau16[5].ZFEH_EepromData /end MEASUREMENT
/begin MEASUREMENT ZFEH_EepromData.ydiMemory_xau16[5].amb_cond.ambient_condition[1][10] "ambient condition shot [0 .. 2-1] with 25 data bytes [0 .. 25-1] for the error code stored in this error memory slot" UBYTE EH_STANDARD_S4_S3 1 100 0 255 ECU_ADDRESS 0xFFF82463 DISPLAY_IDENTIFIER ambient_condition[1][10].amb_cond.ydiMemory_xau16[5].ZFEH_EepromData /end MEASUREMENT
/begin MEASUREMENT ZFEH_EepromData.ydiMemory_xau16[5].amb_cond.ambient_condition[1][11] "ambient condition shot [0 .. 2-1] with 25 data bytes [0 .. 25-1] for the error code stored in this error memory slot" UBYTE EH_STANDARD_S4_S3 1 100 0 255 ECU_ADDRESS 0xFFF82464 DISPLAY_IDENTIFIER ambient_condition[1][11].amb_cond.ydiMemory_xau16[5].ZFEH_EepromData /end MEASUREMENT
/begin MEASUREMENT ZFEH_EepromData.ydiMemory_xau16[5].amb_cond.ambient_condition[1][12] "ambient condition shot [0 .. 2-1] with 25 data bytes [0 .. 25-1] for the error code stored in this error memory slot" UBYTE EH_STANDARD_S4_S3 1 100 0 255 ECU_ADDRESS 0xFFF82465 DISPLAY_IDENTIFIER ambient_condition[1][12].amb_cond.ydiMemory_xau16[5].ZFEH_EepromData /end MEASUREMENT
/begin MEASUREMENT ZFEH_EepromData.ydiMemory_xau16[5].amb_cond.ambient_condition[1][13] "ambient condition shot [0 .. 2-1] with 25 data bytes [0 .. 25-1] for the error code stored in this error memory slot" UBYTE EH_STANDARD_S4_S3 1 100 0 255 ECU_ADDRESS 0xFFF82466 DISPLAY_IDENTIFIER ambient_condition[1][13].amb_cond.ydiMemory_xau16[5].ZFEH_EepromData /end MEASUREMENT
/begin MEASUREMENT ZFEH_EepromData.ydiMemory_xau16[5].amb_cond.ambient_condition[1][14] "ambient condition shot [0 .. 2-1] with 25 data bytes [0 .. 25-1] for the error code stored in this error memory slot" UBYTE EH_STANDARD_S4_S3 1 100 0 255 ECU_ADDRESS 0xFFF82467 DISPLAY_IDENTIFIER ambient_condition[1][14].amb_cond.ydiMemory_xau16[5].ZFEH_EepromData /end MEASUREMENT
/begin MEASUREMENT ZFEH_EepromData.ydiMemory_xau16[5].amb_cond.ambient_condition[1][15] "ambient condition shot [0 .. 2-1] with 25 data bytes [0 .. 25-1] for the error code stored in this error memory slot" UBYTE EH_STANDARD_S4_S3 1 100 0 255 ECU_ADDRESS 0xFFF82468 DISPLAY_IDENTIFIER ambient_condition[1][15].amb_cond.ydiMemory_xau16[5].ZFEH_EepromData /end MEASUREMENT
/begin MEASUREMENT ZFEH_EepromData.ydiMemory_xau16[5].amb_cond.ambient_condition[1][16] "ambient condition shot [0 .. 2-1] with 25 data bytes [0 .. 25-1] for the error code stored in this error memory slot" UBYTE EH_STANDARD_S4_S3 1 100 0 255 ECU_ADDRESS 0xFFF82469 DISPLAY_IDENTIFIER ambient_condition[1][16].amb_cond.ydiMemory_xau16[5].ZFEH_EepromData /end MEASUREMENT
/begin MEASUREMENT ZFEH_EepromData.ydiMemory_xau16[5].amb_cond.ambient_condition[1][17] "ambient condition shot [0 .. 2-1] with 25 data bytes [0 .. 25-1] for the error code stored in this error memory slot" UBYTE EH_STANDARD_S4_S3 1 100 0 255 ECU_ADDRESS 0xFFF8246A DISPLAY_IDENTIFIER ambient_condition[1][17].amb_cond.ydiMemory_xau16[5].ZFEH_EepromData /end MEASUREMENT
/begin MEASUREMENT ZFEH_EepromData.ydiMemory_xau16[5].amb_cond.ambient_condition[1][18] "ambient condition shot [0 .. 2-1] with 25 data bytes [0 .. 25-1] for the error code stored in this error memory slot" UBYTE EH_STANDARD_S4_S3 1 100 0 255 ECU_ADDRESS 0xFFF8246B DISPLAY_IDENTIFIER ambient_condition[1][18].amb_cond.ydiMemory_xau16[5].ZFEH_EepromData /end MEASUREMENT
/begin MEASUREMENT ZFEH_EepromData.ydiMemory_xau16[5].amb_cond.ambient_condition[1][19] "ambient condition shot [0 .. 2-1] with 25 data bytes [0 .. 25-1] for the error code stored in this error memory slot" UBYTE EH_STANDARD_S4_S3 1 100 0 255 ECU_ADDRESS 0xFFF8246C DISPLAY_IDENTIFIER ambient_condition[1][19].amb_cond.ydiMemory_xau16[5].ZFEH_EepromData /end MEASUREMENT
/begin MEASUREMENT ZFEH_EepromData.ydiMemory_xau16[5].amb_cond.ambient_condition[1][1] "ambient condition shot [0 .. 2-1] with 25 data bytes [0 .. 25-1] for the error code stored in this error memory slot" UBYTE EH_STANDARD_S4_S3 1 100 0 255 ECU_ADDRESS 0xFFF8245A DISPLAY_IDENTIFIER ambient_condition[1][1].amb_cond.ydiMemory_xau16[5].ZFEH_EepromData /end MEASUREMENT
/begin MEASUREMENT ZFEH_EepromData.ydiMemory_xau16[5].amb_cond.ambient_condition[1][20] "ambient condition shot [0 .. 2-1] with 25 data bytes [0 .. 25-1] for the error code stored in this error memory slot" UBYTE EH_STANDARD_S4_S3 1 100 0 255 ECU_ADDRESS 0xFFF8246D DISPLAY_IDENTIFIER ambient_condition[1][20].amb_cond.ydiMemory_xau16[5].ZFEH_EepromData /end MEASUREMENT
/begin MEASUREMENT ZFEH_EepromData.ydiMemory_xau16[5].amb_cond.ambient_condition[1][21] "ambient condition shot [0 .. 2-1] with 25 data bytes [0 .. 25-1] for the error code stored in this error memory slot" UBYTE EH_STANDARD_S4_S3 1 100 0 255 ECU_ADDRESS 0xFFF8246E DISPLAY_IDENTIFIER ambient_condition[1][21].amb_cond.ydiMemory_xau16[5].ZFEH_EepromData /end MEASUREMENT
/begin MEASUREMENT ZFEH_EepromData.ydiMemory_xau16[5].amb_cond.ambient_condition[1][22] "ambient condition shot [0 .. 2-1] with 25 data bytes [0 .. 25-1] for the error code stored in this error memory slot" UBYTE EH_STANDARD_S4_S3 1 100 0 255 ECU_ADDRESS 0xFFF8246F DISPLAY_IDENTIFIER ambient_condition[1][22].amb_cond.ydiMemory_xau16[5].ZFEH_EepromData /end MEASUREMENT
/begin MEASUREMENT ZFEH_EepromData.ydiMemory_xau16[5].amb_cond.ambient_condition[1][23] "ambient condition shot [0 .. 2-1] with 25 data bytes [0 .. 25-1] for the error code stored in this error memory slot" UBYTE EH_STANDARD_S4_S3 1 100 0 255 ECU_ADDRESS 0xFFF82470 DISPLAY_IDENTIFIER ambient_condition[1][23].amb_cond.ydiMemory_xau16[5].ZFEH_EepromData /end MEASUREMENT
/begin MEASUREMENT ZFEH_EepromData.ydiMemory_xau16[5].amb_cond.ambient_condition[1][24] "ambient condition shot [0 .. 2-1] with 25 data bytes [0 .. 25-1] for the error code stored in this error memory slot" UBYTE EH_STANDARD_S4_S3 1 100 0 255 ECU_ADDRESS 0xFFF82471 DISPLAY_IDENTIFIER ambient_condition[1][24].amb_cond.ydiMemory_xau16[5].ZFEH_EepromData /end MEASUREMENT
/begin MEASUREMENT ZFEH_EepromData.ydiMemory_xau16[5].amb_cond.ambient_condition[1][2] "ambient condition shot [0 .. 2-1] with 25 data bytes [0 .. 25-1] for the error code stored in this error memory slot" UBYTE EH_STANDARD_S4_S3 1 100 0 255 ECU_ADDRESS 0xFFF8245B DISPLAY_IDENTIFIER ambient_condition[1][2].amb_cond.ydiMemory_xau16[5].ZFEH_EepromData /end MEASUREMENT
/begin MEASUREMENT ZFEH_EepromData.ydiMemory_xau16[5].amb_cond.ambient_condition[1][3] "ambient condition shot [0 .. 2-1] with 25 data bytes [0 .. 25-1] for the error code stored in this error memory slot" UBYTE EH_STANDARD_S4_S3 1 100 0 255 ECU_ADDRESS 0xFFF8245C DISPLAY_IDENTIFIER ambient_condition[1][3].amb_cond.ydiMemory_xau16[5].ZFEH_EepromData /end MEASUREMENT
/begin MEASUREMENT ZFEH_EepromData.ydiMemory_xau16[5].amb_cond.ambient_condition[1][4] "ambient condition shot [0 .. 2-1] with 25 data bytes [0 .. 25-1] for the error code stored in this error memory slot" UBYTE EH_STANDARD_S4_S3 1 100 0 255 ECU_ADDRESS 0xFFF8245D DISPLAY_IDENTIFIER ambient_condition[1][4].amb_cond.ydiMemory_xau16[5].ZFEH_EepromData /end MEASUREMENT
/begin MEASUREMENT ZFEH_EepromData.ydiMemory_xau16[5].amb_cond.ambient_condition[1][5] "ambient condition shot [0 .. 2-1] with 25 data bytes [0 .. 25-1] for the error code stored in this error memory slot" UBYTE EH_STANDARD_S4_S3 1 100 0 255 ECU_ADDRESS 0xFFF8245E DISPLAY_IDENTIFIER ambient_condition[1][5].amb_cond.ydiMemory_xau16[5].ZFEH_EepromData /end MEASUREMENT
/begin MEASUREMENT ZFEH_EepromData.ydiMemory_xau16[5].amb_cond.ambient_condition[1][6] "ambient condition shot [0 .. 2-1] with 25 data bytes [0 .. 25-1] for the error code stored in this error memory slot" UBYTE EH_STANDARD_S4_S3 1 100 0 255 ECU_ADDRESS 0xFFF8245F DISPLAY_IDENTIFIER ambient_condition[1][6].amb_cond.ydiMemory_xau16[5].ZFEH_EepromData /end MEASUREMENT
/begin MEASUREMENT ZFEH_EepromData.ydiMemory_xau16[5].amb_cond.ambient_condition[1][7] "ambient condition shot [0 .. 2-1] with 25 data bytes [0 .. 25-1] for the error code stored in this error memory slot" UBYTE EH_STANDARD_S4_S3 1 100 0 255 ECU_ADDRESS 0xFFF82460 DISPLAY_IDENTIFIER ambient_condition[1][7].amb_cond.ydiMemory_xau16[5].ZFEH_EepromData /end MEASUREMENT
/begin MEASUREMENT ZFEH_EepromData.ydiMemory_xau16[5].amb_cond.ambient_condition[1][8] "ambient condition shot [0 .. 2-1] with 25 data bytes [0 .. 25-1] for the error code stored in this error memory slot" UBYTE EH_STANDARD_S4_S3 1 100 0 255 ECU_ADDRESS 0xFFF82461 DISPLAY_IDENTIFIER ambient_condition[1][8].amb_cond.ydiMemory_xau16[5].ZFEH_EepromData /end MEASUREMENT
/begin MEASUREMENT ZFEH_EepromData.ydiMemory_xau16[5].amb_cond.ambient_condition[1][9] "ambient condition shot [0 .. 2-1] with 25 data bytes [0 .. 25-1] for the error code stored in this error memory slot" UBYTE EH_STANDARD_S4_S3 1 100 0 255 ECU_ADDRESS 0xFFF82462 DISPLAY_IDENTIFIER ambient_condition[1][9].amb_cond.ydiMemory_xau16[5].ZFEH_EepromData /end MEASUREMENT
/begin MEASUREMENT ZFEH_EepromData.ydiMemory_xau16[5].amb_cond.status_of_ambient_conditions[0] "status of ambient condition shot x: 0=invalid 1=valid" UBYTE EH_STANDARD_S4_S3 1 100 0 1 ECU_ADDRESS 0xFFF82472 DISPLAY_IDENTIFIER status_of_ambient_conditions[0].amb_cond.ydiMemory_xau16[5].ZFEH_EepromData /end MEASUREMENT
/begin MEASUREMENT ZFEH_EepromData.ydiMemory_xau16[5].amb_cond.status_of_ambient_conditions[1] "status of ambient condition shot x: 0=invalid 1=valid" UBYTE EH_STANDARD_S4_S3 1 100 0 1 ECU_ADDRESS 0xFFF82473 DISPLAY_IDENTIFIER status_of_ambient_conditions[1].amb_cond.ydiMemory_xau16[5].ZFEH_EepromData /end MEASUREMENT
/begin MEASUREMENT ZFEH_EepromData.ydiMemory_xau16[5].backwards_counter "backwards counter of error code stored in error memory slot" UBYTE EH_STANDARD_S4_S3 1 100 0 255 ECU_ADDRESS 0xFFF82433 DISPLAY_IDENTIFIER backwards_counter.ydiMemory_xau16[5].ZFEH_EepromData /end MEASUREMENT
/begin MEASUREMENT ZFEH_EepromData.ydiMemory_xau16[5].condition_byte "condition byte of error code stored in error memory slot" UBYTE EH_STANDARD_S4_S3 1 100 0 255 ECU_ADDRESS 0xFFF8243D DISPLAY_IDENTIFIER condition_byte.ydiMemory_xau16[5].ZFEH_EepromData /end MEASUREMENT
/begin MEASUREMENT ZFEH_EepromData.ydiMemory_xau16[5].error_code "error code stored in error memory slot" UWORD EH_STANDARD_S4_S3 1 100 0 65535 ECU_ADDRESS 0xFFF8242C DISPLAY_IDENTIFIER error_code.ydiMemory_xau16[5].ZFEH_EepromData /end MEASUREMENT
/begin MEASUREMENT ZFEH_EepromData.ydiMemory_xau16[5].error_type "error type of error code stored in error memory slot" UWORD EH_STANDARD_S4_S3 1 100 0 65535 ECU_ADDRESS 0xFFF8242E DISPLAY_IDENTIFIER error_type.ydiMemory_xau16[5].ZFEH_EepromData /end MEASUREMENT
/begin MEASUREMENT ZFEH_EepromData.ydiMemory_xau16[5].frequency_counter "frequency counter of error code stored in error memory slot" UBYTE EH_STANDARD_S4_S3 1 100 0 255 ECU_ADDRESS 0xFFF82432 DISPLAY_IDENTIFIER frequency_counter.ydiMemory_xau16[5].ZFEH_EepromData /end MEASUREMENT
/end MODULE
/end PROJECT
