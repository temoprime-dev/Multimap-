ASAP2_VERSION 1 51
/begin PROJECT ZHBC8600 "Gen2_BMW_System_Supplier_Lib"
/begin MODULE CPP ""
/begin MOD_COMMON "" BYTE_ORDER MSB_FIRST ALIGNMENT_BYTE 1 ALIGNMENT_WORD 2 ALIGNMENT_LONG 4 ALIGNMENT_FLOAT32_IEEE 4 ALIGNMENT_FLOAT64_IEEE 1 /end MOD_COMMON
/begin COMPU_VTAB Conv.cK0sKorSignale._.vorzeichen_zug_schub_S5_S3 "Umrechnung fuer Messgroesse cK0sKorSignale::vorzeichen_zug_schub" TAB_VERB 2 0 "Schub" 1 "Zug" DEFAULT_VALUE "" /end COMPU_VTAB
/begin COMPU_VTAB Conv.cK0sKorSignale._.zs_zug_k0_S5_S3 "Umrechnung fuer Messgroesse cK0sKorSignale::zs_zug_k0" TAB_VERB 2 0 "Schub" 1 "Zug" DEFAULT_VALUE "" /end COMPU_VTAB
/begin COMPU_VTAB Conv.cK0sKorSignale._.zs_zug_merk_k0_S5_S3 "Umrechnung fuer Messgroesse cK0sKorSignale::zs_zug_merk_k0" TAB_VERB 2 0 "Schub" 1 "Zug" DEFAULT_VALUE "" /end COMPU_VTAB
/begin COMPU_VTAB Conv.cK0sMeUtf._.status_me_k0_komp_S5_S3 "Umrechnung fuer Messgroesse cK0sMeUtf::status_me_k0_komp" TAB_VERB 2 254 "Motoreingriff Aktiv" 255 "Motoreingriff inaktiv" DEFAULT_VALUE "" /end COMPU_VTAB
/begin COMPU_VTAB Conv.cK0sMeUtf._.status_me_k0_S5_S3 "Umrechnung fuer Messgroesse cK0sMeUtf::status_me_k0" TAB_VERB 2 0 "Motoreingriff inaktiv" 1 "Motoreingriff Aktiv" DEFAULT_VALUE "" /end COMPU_VTAB
/begin COMPU_VTAB Conv.cK0sMeUtf._.z_me_utf_k0_S5_S3 "Umrechnung fuer Messgroesse cK0sMeUtf::z_me_utf_k0" TAB_VERB 3 1 "UTF-Schutzfunktion Passiv" 2 "UTF-Schutzfunktion Warten" 3 "UTF-Schutzfunktion Aktiv" DEFAULT_VALUE "" /end COMPU_VTAB
/begin COMPU_VTAB Conv.cK0sSchaltungsLogik._.flag_me_haupt_aktiv_merk_S5_S3 "Umrechnung fuer Messgroesse cK0sSchaltungsLogik::flag_me_haupt_aktiv_merk" TAB_VERB 2 0 "Motoreingriff nicht aktiv" 1 "Motoreingriff aktiv" DEFAULT_VALUE "" /end COMPU_VTAB
/begin COMPU_VTAB Conv.cK0sSchaltungsLogik._.flag_me_haupt_aktiv_war_gesetzt_S5_S3 "Umrechnung fuer Messgroesse cK0sSchaltungsLogik::flag_me_haupt_aktiv_war_gesetzt" TAB_VERB 2 0 "Motoreingriff Aktiv war nicht gesetzt" 1 "Motoreingriff Aktiv war gesetzt" DEFAULT_VALUE "" /end COMPU_VTAB
/begin COMPU_VTAB Conv.cK0sSchaltungsLogik._.flag_sync_verlassen_me_merk_S5_S3 "Umrechnung fuer Messgroesse cK0sSchaltungsLogik::flag_sync_verlassen_me_merk" TAB_VERB 2 0 "Flanke nicht erkannt" 1 "Flanke erkannt" DEFAULT_VALUE "" /end COMPU_VTAB
/begin COMPU_VTAB Conv.cK0sSchaltungsLogik._.flanke_me_haupt_S5_S3 "Umrechnung fuer Messgroesse cK0sSchaltungsLogik::flanke_me_haupt" TAB_VERB 2 0 "Flanke nicht erkannt" 1 "Flanke erkannt" DEFAULT_VALUE "" /end COMPU_VTAB
/begin COMPU_VTAB Conv.cK0sSchaltungsLogik._.idx_schaltung_k0_aktiv_S5_S3 "Umrechnung fuer Messgroesse cK0sSchaltungsLogik::idx_schaltung_k0_aktiv" TAB_VERB 5 0 "Mehrfachrueckschaltung" 1 "Rueckschaltung" 2 "keine Schaltung_k0" 3 "Hochschaltung" 4 "Mehrfachochschaltung" DEFAULT_VALUE "" /end COMPU_VTAB
/begin COMPU_VTAB Conv.cK0sSchaltungsLogik._.idx_schaltung_k0_S5_S3 "Umrechnung fuer Messgroesse cK0sSchaltungsLogik::idx_schaltung_k0" TAB_VERB 5 0 "Mehrfachrueckschaltung" 1 "Rueckschaltung" 2 "keine Schaltung_k0" 3 "Hochschaltung" 4 "Mehrfachochschaltung" DEFAULT_VALUE "" /end COMPU_VTAB
/begin COMPU_VTAB Conv.cK0sSchaltungsLogik._.istgang_idx_k0_S5_S3 "Umrechnung fuer Messgroesse cK0sSchaltungsLogik::istgang_idx_k0" TAB_VERB 10 0 "GR1" 1 "KEIN_GANG" 2 "G1" 3 "G2" 4 "G3" 5 "G4" 6 "G5" 7 "G6" 8 "G7" 9 "G8" DEFAULT_VALUE "" /end COMPU_VTAB
/begin COMPU_VTAB Conv.cK0sSchaltungsLogik._.istgang_k0_S5_S3 "Umrechnung fuer Messgroesse cK0sSchaltungsLogik::istgang_k0" TAB_VERB 10 -1 "GR1" 0 "KEIN_GANG" 1 "G1" 2 "G2" 3 "G3" 4 "G4" 5 "G5" 6 "G6" 7 "G7" 8 "G8" DEFAULT_VALUE "" /end COMPU_VTAB
/begin COMPU_VTAB Conv.cK0sSchaltungsLogik._.pos_flanke_flag_sync_verl_me_S5_S3 "Umrechnung fuer Messgroesse cK0sSchaltungsLogik::pos_flanke_flag_sync_verl_me" TAB_VERB 2 0 "Flanke nicht erkannt" 1 "Flanke erkannt" DEFAULT_VALUE "" /end COMPU_VTAB
/begin COMPU_VTAB Conv.cK0sSchaltungsLogik._.schaltung_k0_aktiv_S5_S3 "Umrechnung fuer Messgroesse cK0sSchaltungsLogik::schaltung_k0_aktiv" TAB_VERB 5 -2 "Mehrfachrueckschaltung" -1 "Rückchaltung" 0 "keine Schaltung" 1 "Hochschaltung" 2 "Mehrfachochschaltung" DEFAULT_VALUE "" /end COMPU_VTAB
/begin COMPU_VTAB Conv.cK0sSchaltungsLogik._.schaltung_k0_merk_S5_S3 "Umrechnung fuer Messgroesse cK0sSchaltungsLogik::schaltung_k0_merk" TAB_VERB 5 -2 "Mehrfachrueckschaltung" -1 "Rückchaltung" 0 "keine Schaltung" 1 "Hochschaltung" 2 "Mehrfachochschaltung" DEFAULT_VALUE "" /end COMPU_VTAB
/begin COMPU_VTAB Conv.cK0sSchaltungsLogik._.schaltung_k0_S5_S3 "Umrechnung fuer Messgroesse cK0sSchaltungsLogik::schaltung_k0" TAB_VERB 5 -2 "Mehrfachrueckschaltung" -1 "Rückchaltung" 0 "keine Schaltung" 1 "Hochschaltung" 2 "Mehrfachochschaltung" DEFAULT_VALUE "" /end COMPU_VTAB
/begin COMPU_VTAB Conv.cK0sSchaltungsLogik._.schaltung_k0_trigger_S5_S3 "Umrechnung fuer Messgroesse cK0sSchaltungsLogik::schaltung_k0_trigger" TAB_VERB 7 0 "SWT_PASSIV" 1 "SWT_SCHALTBEFEHL" 2 "SWT_BEGINN_SCHALTUNG" 3 "SWT_BEGINN_ME_HAUPT" 4 "SWT_VERSCHACHTELTE_SCHATLUNG" 5 "SWT_ENDE_ME_HAUPT" 6 "SWT_ENDE_SCHALTUNG" DEFAULT_VALUE "" /end COMPU_VTAB
/begin COMPU_VTAB Conv.cK0sSchaltungsLogik._.z_shlog_S5_S3 "Umrechnung fuer Messgroesse cK0sSchaltungsLogik::z_shlog" TAB_VERB 2 0 "Z_SHLOG_KEINE_SCHALTUNG" 1 "Z_SHLOG_SCHALTUNG" DEFAULT_VALUE "" /end COMPU_VTAB
/begin COMPU_VTAB Conv.cK0sSchaltungsLogik._.zielgang_k0_S5_S3 "Umrechnung fuer Messgroesse cK0sSchaltungsLogik::zielgang_k0" TAB_VERB 9 0 "KEIN_GANG" 1 "G1" 2 "G2" 3 "G3" 4 "G4" 5 "G5" 6 "G6" 7 "G7" 8 "G8" DEFAULT_VALUE "" /end COMPU_VTAB
/begin COMPU_VTAB Conv.cK0sSteuerung._.flag_optimierte_befuellung_S5_S3 "Umrechnung fuer Messgroesse cK0sSteuerung::flag_optimierte_befuellung" TAB_VERB 2 0 "Keine optimierte Befüllung" 1 "Optimierte Befüllung" DEFAULT_VALUE "" /end COMPU_VTAB
/begin COMPU_VTAB Conv.cK0sSteuerung._.flag_schliessrampe_ds_S5_S3 "Umrechnung fuer Messgroesse cK0sSteuerung::flag_schliessrampe_ds" TAB_VERB 2 0 "Schliessrampe aus DS Gestartet" 1 "Schliessrampe nicht aus DS gestartet" DEFAULT_VALUE "" /end COMPU_VTAB
/begin COMPU_VTAB Conv.cK0sSteuerung._.flag_schliessrampe_ende_S5_S3 "Umrechnung fuer Messgroesse cK0sSteuerung::flag_schliessrampe_ende" TAB_VERB 2 0 "Schliessrampe nicht beendet" 1 "Schliessrampe Beendet" DEFAULT_VALUE "" /end COMPU_VTAB
/begin COMPU_VTAB Conv.cK0sSteuerung._.flag_schliessrampe_start_S5_S3 "Umrechnung fuer Messgroesse cK0sSteuerung::flag_schliessrampe_start" TAB_VERB 2 0 "Schliessrampe Gestartet" 1 "Schliessrampe gestartet" DEFAULT_VALUE "" /end COMPU_VTAB
/begin COMPU_VTAB Conv.cK0sVorsteuer._.flag_m_schalt_aufgebaut_S5_S3 "Umrechnung fuer Messgroesse cK0sVorsteuer::flag_m_schalt_aufgebaut" TAB_VERB 2 0 "Aufschalten noch nicht Abgeschlossen" 1 "Aufschalten Abgeschlossen" DEFAULT_VALUE "" /end COMPU_VTAB
/begin COMPU_VTAB Conv.cK0sVorsteuer._.init_sport_schalt_S5_S3 "Umrechnung fuer Messgroesse cK0sVorsteuer::init_sport_schalt" TAB_VERB 2 0 "Initialisierung läuft" 1 "Initialisierung abgeschlossen" DEFAULT_VALUE "" /end COMPU_VTAB
/begin COMPU_VTAB Conv.cK0sVorsteuer._.pt1_m_schalt_merk_S5_S3 "Umrechnung fuer Messgroesse cK0sVorsteuer::pt1_m_schalt_merk" TAB_VERB 2 0 "Aufschalten Abgeschlossen" 1 "Aufschalten noch nicht Abgeschlossen" DEFAULT_VALUE "" /end COMPU_VTAB
/begin COMPU_VTAB Conv.cK0sVorsteuer._.qs_status_S5_S3 "Umrechnung fuer Messgroesse cK0sVorsteuer::qs_status" TAB_VERB 3 0 "Normal" 1 "Spontan" 2 "Sport" DEFAULT_VALUE "" /end COMPU_VTAB
/begin COMPU_VTAB Conv.cK0sVorsteuer._.z_mo_lastwechsel_k0_S5_S3 "Umrechnung fuer Messgroesse cK0sVorsteuer::z_mo_lastwechsel_k0" TAB_VERB 4 0 "mo_lastwechsel nicht aktiv" 1 "mo_lastwechsel schlupfgeregelt im zug" 2 "mo_lastwechsel schlupfgeregelt im schub" 3 "mo_lastwechsel in geregelt_geschlossen" DEFAULT_VALUE "" /end COMPU_VTAB
/begin COMPU_VTAB Conv.cKasEkopl._.flag_mo_aktiv_entkoppl_S5_S3 "Umrechnung fuer Messgroesse cKasEkopl::flag_mo_aktiv_entkoppl" TAB_VERB 2 0 "FALSE" 1 "TRUE" DEFAULT_VALUE "" /end COMPU_VTAB
/begin COMPU_VTAB Conv.cKasEkopl._.z_entkoppeln_S5_S3 "Umrechnung fuer Messgroesse cKasEkopl::z_entkoppeln" TAB_VERB 4 0 "Entkoppeln PASSIV" 1 "Entkoppeln Oeffnen" 2 "Entkoppeln Entkoppeln" 3 "Entkoppeln Schliessen" DEFAULT_VALUE "" /end COMPU_VTAB
/begin COMPU_VTAB Conv.cKorDiagl._.b_eg_uwig_direkt_getr_notlaufsp_S5_S3 "Umrechnung fuer Messgroesse cKorDiagl::b_eg_uwig_direkt_getr_notlaufsp" TAB_VERB 2 0 "FALSE" 1 "TRUE" DEFAULT_VALUE "" /end COMPU_VTAB
/begin COMPU_VTAB Conv.cKorDiagl._.ersatzgang_S5_S3 "Umrechnung fuer Messgroesse cKorDiagl::ersatzgang" TAB_VERB 10 -1 "GR1" 0 "KEIN_GANG" 1 "G1" 2 "G2" 3 "G3" 4 "G4" 5 "G5" 6 "G6" 7 "G7" 8 "G8" DEFAULT_VALUE "" /end COMPU_VTAB
/begin COMPU_VTAB Conv.cKorDiagl._.symptom_aktiv_S5_S3 "Umrechnung fuer Messgroesse cKorDiagl::symptom_aktiv" TAB_VERB 2 0 "symptom nicht active" 1 "ssymptom active" DEFAULT_VALUE "" /end COMPU_VTAB
/begin COMPU_VTAB Conv.cKorDraus._.druckausgabe_kup_pf_in_n_aktiv_S5_S3 "Umrechnung fuer Messgroesse cKorDraus::druckausgabe_kup_pf_in_n_aktiv" TAB_VERB 2 0 "Keine Druckausgabe Fülldruck-Kuppung in KEIN_KFL aktiv" 1 "Druckausgabe Fülldruck-Kuppung in KEIN_KFL aktiv" DEFAULT_VALUE "" /end COMPU_VTAB
/begin COMPU_VTAB Conv.cKorDraus._.druckausgabe_kup_zu_in_n_aktiv_S5_S3 "Umrechnung fuer Messgroesse cKorDraus::druckausgabe_kup_zu_in_n_aktiv" TAB_VERB 2 0 "Keine Druckausgabe schiessende Kuppung in KEIN_KFL aktiv" 1 "Druckausgabe schiessende Kuppung in KEIN_KFL aktiv" DEFAULT_VALUE "" /end COMPU_VTAB
/begin COMPU_VTAB Conv.cKorDraus._.gang_kfl_zuletzt_S5_S3 "Umrechnung fuer Messgroesse cKorDraus::gang_kfl_zuletzt" TAB_VERB 10 -1 "GR1" 0 "KEIN_GANG" 1 "G1" 2 "G2" 3 "G3" 4 "G4" 5 "G5" 6 "G6" 7 "G7" 8 "G8" DEFAULT_VALUE "" /end COMPU_VTAB
/begin COMPU_VTAB Conv.cKorDraus._.gwk_moeglich_S5_S3 "Umrechnung fuer Messgroesse cKorDraus::gwk_moeglich" TAB_VERB 2 0 "GWK-Betrieb nicht moeglich" 1 "GWK-Betrieb moeglich" DEFAULT_VALUE "" /end COMPU_VTAB
/begin COMPU_VTAB Conv.cKorDraus._.k0_hydraulisch_moeglich_S5_S3 "Umrechnung fuer Messgroesse cKorDraus::k0_hydraulisch_moeglich" TAB_VERB 2 0 "K0-Betrieb hydraulisch nicht moeglich" 1 "K0-Betrieb hydraulisch moeglich" DEFAULT_VALUE "" /end COMPU_VTAB
/begin COMPU_VTAB Conv.cKorDraus._.kfl_zuletzt_S5_S3 "Umrechnung fuer Messgroesse cKorDraus::kfl_zuletzt" TAB_VERB 3 0 "Kein Kraftfluss (nur Initialisierung)" 1 "Kraftfluss vorwaerts" 2 "Kraffluss rueckwaerts" DEFAULT_VALUE "" /end COMPU_VTAB
/begin COMPU_VTAB Conv.cKorDraus._.kup_pf_in_n_S5_S3 "Umrechnung fuer Messgroesse cKorDraus::kup_pf_in_n" TAB_VERB 6 0 "KEINE" 1 "K_A" 2 "K_B" 3 "K_C" 4 "K_D" 5 "K_E" DEFAULT_VALUE "" /end COMPU_VTAB
/begin COMPU_VTAB Conv.cKorDraus._.kup_pruefpuls_S5_S3 "Umrechnung fuer Messgroesse cKorDraus::kup_pruefpuls" TAB_VERB 7 0 "KEINE_KUPPLUNG" 1 "K_A" 2 "K_B" 3 "K_C" 4 "K_D" 5 "K_E" 6 "K_K0" DEFAULT_VALUE "" /end COMPU_VTAB
/begin COMPU_VTAB Conv.cKorDraus._.kup_zu_in_n_S5_S3 "Umrechnung fuer Messgroesse cKorDraus::kup_zu_in_n" TAB_VERB 6 0 "KEINE" 1 "K_A" 2 "K_B" 3 "K_C" 4 "K_D" 5 "K_E" DEFAULT_VALUE "" /end COMPU_VTAB
/begin COMPU_VTAB Conv.cKorDraus._.posv_uew_hyd_aktiv_S5_S3 "Umrechnung fuer Messgroesse cKorDraus::posv_uew_hyd_aktiv" TAB_VERB 2 0 "Keine Hydraulikansteuerung POS P bei POSV-Ueberwachung aktiv ist" 1 "Hydraulikansteuerung POS P bei POSV-Ueberwachung aktiv ist" DEFAULT_VALUE "" /end COMPU_VTAB
/begin COMPU_VTAB Conv.cKorDraus._.statisch_p_kup_pf_in_n_S5_S3 "Umrechnung fuer Messgroesse cKorDraus::statisch_p_kup_pf_in_n" TAB_VERB 2 0 "Keine STATISCH Ansteuerung der Fülldruck-Kuppung in KEIN_KFL aktiv" 1 "STATISCH Ansteuerung der Fülldruck-Kuppung in KEIN_KFL aktiv" DEFAULT_VALUE "" /end COMPU_VTAB
/begin COMPU_VTAB Conv.cKorDraus._.z_pof1kplbinn_S5_S3 "Umrechnung fuer Messgroesse cKorDraus::z_pof1kplbinn" TAB_VERB 4 0 "Passiv" 1 "Warten bis POSV-Uebweachung beendet" 2 "Warten bis Kolben Kpl B anliegt" 3 "Druckoffset P_OF1KPLBINN wird aktiv ausgegeben." DEFAULT_VALUE "" /end COMPU_VTAB
/begin COMPU_VTAB Conv.cKorGskup._.f_gsk_schlupft_S5_S3 "Umrechnung fuer Messgroesse cKorGskup::f_gsk_schlupft" TAB_VERB 2 0 "GSK nicht aktiv oder QuGskSchlupft wurde nicht abgefrag" 1 "GSK aktiv und QuGskSchlupft abgefragt" DEFAULT_VALUE "" /end COMPU_VTAB
/begin COMPU_VTAB Conv.cKorGskup._.f_kraftschl_kup_fa_S5_S3 "Umrechnung fuer Messgroesse cKorGskup::f_kraftschl_kup_fa" TAB_VERB 2 0 "noch nicht im FA" 1 "im FA oder schon weiter" DEFAULT_VALUE "" /end COMPU_VTAB
/begin COMPU_VTAB Conv.cKorGskup._.fehler_gsk_regeln_verboten_S5_S3 "Umrechnung fuer Messgroesse cKorGskup::fehler_gsk_regeln_verboten" TAB_VERB 2 0 "Regeln der GSK nicht erlaubt" 1 "Regeln der GSK erlaubt" DEFAULT_VALUE "" /end COMPU_VTAB
/begin COMPU_VTAB Conv.cKorGskup._.gsk_aktiv_S5_S3 "Umrechnung fuer Messgroesse cKorGskup::gsk_aktiv" TAB_VERB 2 0 "GSK nicht aktiv" 1 "GSK aktiv" DEFAULT_VALUE "" /end COMPU_VTAB
/begin COMPU_VTAB Conv.cKorGskup._.gsk_funktion_S5_S3 "Umrechnung fuer Messgroesse cKorGskup::gsk_funktion" TAB_VERB 5 0 "GSKFKT_PASSIV" 1 "GSKFKT_SAD" 2 "GSKFKT_BYPASS" 3 "GSKFKT_CSC" 4 "GSKFKT_IAE" DEFAULT_VALUE "" /end COMPU_VTAB
/begin COMPU_VTAB Conv.cKorGskup._.gsk_zustand_S5_S3 "Umrechnung fuer Messgroesse cKorGskup::gsk_zustand" TAB_VERB 7 0 "GSK_INAKTIV" 1 "GSK_STARTRAMPE" 2 "GSK_EINREGELN" 3 "SBC-Betrieb" 4 "AFU-Betrieb" 5 "LC=Rennstartautomatik" 6 "GSK_KPL_ZU" DEFAULT_VALUE "" /end COMPU_VTAB
/begin COMPU_VTAB Conv.cKorGskup._.kup_gsk_S5_S3 "Umrechnung fuer Messgroesse cKorGskup::kup_gsk" TAB_VERB 6 0 "KEINE" 1 "K_A" 2 "K_B" 3 "K_C" 4 "K_D" 5 "K_E" DEFAULT_VALUE "" /end COMPU_VTAB
/begin COMPU_VTAB Conv.cKorSaste._.kup_ge1_S5_S3 "Umrechnung fuer Messgroesse cKorSaste::kup_ge1" TAB_VERB 6 0 "KEINE" 1 "K_A" 2 "K_B" 3 "K_C" 4 "K_D" 5 "K_E" DEFAULT_VALUE "" /end COMPU_VTAB
/begin COMPU_VTAB Conv.cKorSaste._.kup_ge2_S5_S3 "Umrechnung fuer Messgroesse cKorSaste::kup_ge2" TAB_VERB 6 0 "KEINE" 1 "K_A" 2 "K_B" 3 "K_C" 4 "K_D" 5 "K_E" DEFAULT_VALUE "" /end COMPU_VTAB
/begin COMPU_VTAB Conv.cKorSaste._.kup_ge3_S5_S3 "Umrechnung fuer Messgroesse cKorSaste::kup_ge3" TAB_VERB 6 0 "KEINE" 1 "K_A" 2 "K_B" 3 "K_C" 4 "K_D" 5 "K_E" DEFAULT_VALUE "" /end COMPU_VTAB
/begin COMPU_VTAB Conv.cKorSaste._.kup_kab_S5_S3 "Umrechnung fuer Messgroesse cKorSaste::kup_kab" TAB_VERB 6 0 "KEINE" 1 "K_A" 2 "K_B" 3 "K_C" 4 "K_D" 5 "K_E" DEFAULT_VALUE "" /end COMPU_VTAB
/begin COMPU_VTAB Conv.cKorSaste._.kup_kabvkzu_S5_S3 "Umrechnung fuer Messgroesse cKorSaste::kup_kabvkzu" TAB_VERB 6 0 "KEINE" 1 "K_A" 2 "K_B" 3 "K_C" 4 "K_D" 5 "K_E" DEFAULT_VALUE "" /end COMPU_VTAB
/begin COMPU_VTAB Conv.cKorSaste._.kup_kzu_S5_S3 "Umrechnung fuer Messgroesse cKorSaste::kup_kzu" TAB_VERB 6 0 "KEINE" 1 "K_A" 2 "K_B" 3 "K_C" 4 "K_D" 5 "K_E" DEFAULT_VALUE "" /end COMPU_VTAB
/begin COMPU_VTAB Conv.cKorSaste._.kup_vkab_S5_S3 "Umrechnung fuer Messgroesse cKorSaste::kup_vkab" TAB_VERB 6 0 "KEINE" 1 "K_A" 2 "K_B" 3 "K_C" 4 "K_D" 5 "K_E" DEFAULT_VALUE "" /end COMPU_VTAB
/begin COMPU_VTAB Conv.cKorSaste._.kup_vkzu_S5_S3 "Umrechnung fuer Messgroesse cKorSaste::kup_vkzu" TAB_VERB 6 0 "KEINE" 1 "K_A" 2 "K_B" 3 "K_C" 4 "K_D" 5 "K_E" DEFAULT_VALUE "" /end COMPU_VTAB
/begin COMPU_VTAB Conv.cKorSaste._.me_sas_status_S5_S3 "Umrechnung fuer Messgroesse cKorSaste::me_sas_status" TAB_VERB 4 0 "keine Momentenanforderung" 1 "Momentenerhoehung" 2 "Momentenerniedrigung" 3 "Signal ungueltig (momentan nicht benutzt)" DEFAULT_VALUE "" /end COMPU_VTAB
/begin COMPU_VTAB Conv.cKorSaste._.schaltungsabbruch_durch_ga_S5_S3 "Umrechnung fuer Messgroesse cKorSaste::schaltungsabbruch_durch_ga" TAB_VERB 2 0 "Kein Schaltungsabbruch durch GA" 1 "Schaltungsabbruch durch GA" DEFAULT_VALUE "" /end COMPU_VTAB
/begin COMPU_VTAB Conv.cKorSaste._.zielgang_vorb_angefordert_S5_S3 "Umrechnung fuer Messgroesse cKorSaste::zielgang_vorb_angefordert" TAB_VERB 2 0 "vorbereitete Schaltung nicht angefordert oder keine Vorbereitung aktiv" 1 "vorbereitete Schaltung ist angefordert" DEFAULT_VALUE "" /end COMPU_VTAB
/begin COMPU_VTAB Conv.cKorSaste._.zielgang_vorbereitung_S5_S3 "Umrechnung fuer Messgroesse cKorSaste::zielgang_vorbereitung" TAB_VERB 10 -1 "GR1" 0 "KEIN_GANG" 1 "G1" 2 "G2" 3 "G3" 4 "G4" 5 "G5" 6 "G6" 7 "G7" 8 "G8" DEFAULT_VALUE "" /end COMPU_VTAB
/begin COMPU_VTAB Conv.cModHydlg._.err_v_nr_abgldat_S5_S3 "Umrechnung fuer Messgroesse cModHydlg::err_v_nr_abgldat" TAB_VERB 2 0 "Versionsnr. Abgleichdaten Boot i.O." 1 "Versionsnr. Abgleichdaten Boot n.i.O." DEFAULT_VALUE "" /end COMPU_VTAB
/begin COMPU_VTAB Conv.cModHydlg._.status_pruef_abgldat_S5_S3 "Umrechnung fuer Messgroesse cModHydlg::status_pruef_abgldat" TAB_VERB 2 0 "Abgleichdaten Boot n.i.O." 1 "Abgleichdaten Boot i.O." DEFAULT_VALUE "" /end COMPU_VTAB
/begin COMPU_VTAB Conv.cModHydlg._.version_abgleichdaten_S5_S3 "Umrechnung fuer Messgroesse cModHydlg::version_abgleichdaten" TAB_VERB 15 0 "unbelegt" 4 "Hydraulik E26/1 oder E26/2" 5 "Hydraulik E26/5 (Hybrid)" 6 "Hydraulik E26/6 (E-Schaltung mit WFS)" 7 "Hydraulik E26/4 (M-Schaltung mit WFS)" 8 "Hydraulik E26/9 (Hybrid mit WFS)" 9 "Hydraulik E28/1 (FQ12)" 10 "Hydraulik E28/2 E28/3 E28/4 (9HP EP2)" 11 "Hydraulik E26/11 (Hybrid E-Schaltung mit WFS)" 12 "Belegt wegen E20/1 und E20/2" 13 "Hydraulik E26/14 (8HPTU E-Schaltung)" 14 "Hydraulik E26/16 (8HPTU E-Schaltung mit WFS)" 15 "E26/13 (Hybrid Gen3 E-Schaltung)" 16 "E26/18 (Hybrid Gen3 K11 E-Schaltung)" 17 "E26/23 (Hybrid Gen3 K11 E-Schaltung mit WFS)" DEFAULT_VALUE "" /end COMPU_VTAB
/begin COMPU_VTAB Conv.cModHysKo._.f_ig_eds_S5_S3 "Umrechnung fuer Messgroesse cModHysKo::f_ig_eds" TAB_VERB 2 0 "Steigender Gradient Sollstrom" 1 "Fallender Gradient Sollstrom" DEFAULT_VALUE "" /end COMPU_VTAB
/begin COMPU_VTAB Conv.cModHysKo._.f_pg_abssoll_S5_S3 "Umrechnung fuer Messgroesse cModHysKo::f_pg_abssoll" TAB_VERB 2 0 "Steigender Gradient Solldruck" 1 "Fallender Gradient Solldruck" DEFAULT_VALUE "" /end COMPU_VTAB
/begin COMPU_VTAB Conv.cModHysKo._.ig_wechsel_erkannt_S5_S3 "Umrechnung fuer Messgroesse cModHysKo::ig_wechsel_erkannt" TAB_VERB 2 0 "Kein Richtungswechsel Gradient" 1 "Richtungswechsel Gradient erkannt" DEFAULT_VALUE "" /end COMPU_VTAB
/begin COMPU_VTAB Conv.cModHysKo._.pg_wechsel_erkannt_S5_S3 "Umrechnung fuer Messgroesse cModHysKo::pg_wechsel_erkannt" TAB_VERB 2 0 "Kein Richtungswechsel Gradient" 1 "Richtungswechsel Gradient erkannt" DEFAULT_VALUE "" /end COMPU_VTAB
/begin COMPU_VTAB Conv.cModHysKo._.z_rampe_S5_S3 "Umrechnung fuer Messgroesse cModHysKo::z_rampe" TAB_VERB 4 0 "Z_DRUCK_MIN" 1 "Z_NACH_SF" 2 "Z_DRUCK_HOCH" 3 "Z_DRUCK_REGEL" DEFAULT_VALUE "" /end COMPU_VTAB
/begin COMPU_VTAB Conv.cModKuppl._.f_erste_bef_aus_sb_S5_S3 "Umrechnung fuer Messgroesse cModKuppl::f_erste_bef_aus_sb" TAB_VERB 2 0 "FALSE" 1 "TRUE" DEFAULT_VALUE "" /end COMPU_VTAB
/begin COMPU_VTAB Conv.cModKuppl._.f_erste_bef_S5_S3 "Umrechnung fuer Messgroesse cModKuppl::f_erste_bef" TAB_VERB 2 0 "FALSE" 1 "TRUE" DEFAULT_VALUE "" /end COMPU_VTAB
/begin COMPU_VTAB Conv.cModKuppl._.f_fuellopt_S5_S3 "Umrechnung fuer Messgroesse cModKuppl::f_fuellopt" TAB_VERB 2 0 "FALSE" 1 "TRUE" DEFAULT_VALUE "" /end COMPU_VTAB
/begin COMPU_VTAB Conv.cModKuppl._.f_fuellred_S5_S3 "Umrechnung fuer Messgroesse cModKuppl::f_fuellred" TAB_VERB 2 0 "FALSE" 1 "TRUE" DEFAULT_VALUE "" /end COMPU_VTAB
/begin COMPU_VTAB Conv.cModKuppl._.f_geschlossen_S5_S3 "Umrechnung fuer Messgroesse cModKuppl::f_geschlossen" TAB_VERB 2 0 "FALSE" 1 "TRUE" DEFAULT_VALUE "" /end COMPU_VTAB
/begin COMPU_VTAB Conv.cModKuppl._.f_kolben_anlegen_S5_S3 "Umrechnung fuer Messgroesse cModKuppl::f_kolben_anlegen" TAB_VERB 2 0 "FALSE" 1 "TRUE" DEFAULT_VALUE "" /end COMPU_VTAB
/begin COMPU_VTAB Conv.cModKuppl._.f_sf_ausgabe_aktiv_S5_S3 "Umrechnung fuer Messgroesse cModKuppl::f_sf_ausgabe_aktiv" TAB_VERB 2 0 "FALSE" 1 "TRUE" DEFAULT_VALUE "" /end COMPU_VTAB
/begin COMPU_VTAB Conv.cModKuppl._.f_sf_vorhanden_S5_S3 "Umrechnung fuer Messgroesse cModKuppl::f_sf_vorhanden" TAB_VERB 2 0 "FALSE" 1 "TRUE" DEFAULT_VALUE "" /end COMPU_VTAB
/begin COMPU_VTAB Conv.cModKuppl._.f_strom_pre_puls_erf_S5_S3 "Umrechnung fuer Messgroesse cModKuppl::f_strom_pre_puls_erf" TAB_VERB 2 0 "FALSE" 1 "TRUE" DEFAULT_VALUE "" /end COMPU_VTAB
/begin COMPU_VTAB Conv.cModKuppl._.f_stromschl_angefordert_S5_S3 "Umrechnung fuer Messgroesse cModKuppl::f_stromschl_angefordert" TAB_VERB 2 0 "FALSE" 1 "TRUE" DEFAULT_VALUE "" /end COMPU_VTAB
/begin COMPU_VTAB Conv.cModKuppl._.kolben_pos_gelesen_S5_S3 "Umrechnung fuer Messgroesse cModKuppl::kolben_pos_gelesen" TAB_VERB 2 0 "FALSE" 1 "TRUE" DEFAULT_VALUE "" /end COMPU_VTAB
/begin COMPU_VTAB Conv.cModKuppl._.kpl_inaktiv_S5_S3 "Umrechnung fuer Messgroesse cModKuppl::kpl_inaktiv" TAB_VERB 2 0 "FALSE" 1 "TRUE" DEFAULT_VALUE "" /end COMPU_VTAB
/begin COMPU_VTAB Conv.cModKuppl._.kup_index_spsas_S5_S3 "Umrechnung fuer Messgroesse cModKuppl::kup_index_spsas" TAB_VERB 3 0 "Normal" 1 "Spontan" 2 "Sport/AMax" DEFAULT_VALUE "" /end COMPU_VTAB
/begin COMPU_VTAB Conv.cModKuppl._.kup_schaltart_sas_S5_S3 "Umrechnung fuer Messgroesse cModKuppl::kup_schaltart_sas" TAB_VERB 6 0 "KEINE_SCHALTUNG" 1 "HS" 2 "RS" 3 "SCHALTART_GE" 4 "SCHALTART_GA" 5 "nicht verwendet" DEFAULT_VALUE "" /end COMPU_VTAB
/begin COMPU_VTAB Conv.cModKuppl._.zustand_S5_S3 "Umrechnung fuer Messgroesse cModKuppl::zustand" TAB_VERB 6 0 "K_LEER_STEHT" 1 "K_FUELLT_STEHT" 2 "K_FUELLT_LAEUFT" 3 "K_VOLL_STEHT" 4 "K_ENTLEERT_STEHT" 5 "K_ENTLEERT_LAEUFT" DEFAULT_VALUE "" /end COMPU_VTAB
/begin COMPU_VTAB Conv.cModPVorg._.f_anst_statisch_S5_S3 "Umrechnung fuer Messgroesse cModPVorg::f_anst_statisch" TAB_VERB 2 0 "FALSE" 1 "TRUE" DEFAULT_VALUE "" /end COMPU_VTAB
/begin COMPU_VTAB Conv.cModPVorg._.f_druck_vorgegeben_S5_S3 "Umrechnung fuer Messgroesse cModPVorg::f_druck_vorgegeben" TAB_VERB 2 0 "FALSE" 1 "TRUE" DEFAULT_VALUE "" /end COMPU_VTAB
/begin COMPU_VTAB Conv.cModPVorg._.fktn_druckvorgabe_S5_S3 "Umrechnung fuer Messgroesse cModPVorg::fktn_druckvorgabe" TAB_VERB 29 0 "DRUCKVORGABE_STATISCH" 1 "DRUCKVORGABE_KZU" 2 "DRUCKVORGABE_KAB" 3 "DRUCKVORGABE_VKZU" 4 "DRUCKVORGABE_VKAB" 5 "DRUCKVORGABE_GE1GA" 6 "DRUCKVORGABE_GE1GE" 7 "DRUCKVORGABE_GE2GA" 8 "DRUCKVORGABE_GE2GE" 9 "DRUCKVORGABE_GE3GA" 10 "DRUCKVORGABE_GE3GE" 11 "DRUCKVORGABE_KUPZU_IN_N" 12 "DRUCKVORGABE_KUP_PF_IN_N" 13 "DRUCKVORGABE_GSK" 15 "DRUCKVORGABE_PRUEFPULS" 16 "DRUCKVORGABE_KAB_KFL_WECHSEL" 17 "DRUCKVORGABE_ABSENK_AUSERHALB_SAS" 18 "DRUCKVORGABE_K0S" 19 "DRUCKVORGABE_EL_VORBEF" 20 "DRUCKVORGABE_SYSTEM" 21 "DRUCKVORGABE_WK" 22 "DRUCKVORGABE_GESYNC1GA" 23 "DRUCKVORGABE_GESYNC1GE" 24 "DRUCKVORGABE_GESYNC2GA" 25 "DRUCKVORGABE_GESYNC2GE" 26 "DRUCKVORGABE_TSTEDS" 27 "DRUCKVORGABE_PULS_LEER" 28 "DRUCKVORGABE_KUP_SEGELN" 29 "DRUCKVORGABE_KUP_PARKSPERRE" DEFAULT_VALUE "" /end COMPU_VTAB
/begin COMPU_VTAB Conv.cModPVorg._.typ_druckvorgabe_S5_S3 "Umrechnung fuer Messgroesse cModPVorg::typ_druckvorgabe" TAB_VERB 5 0 "STD_KUP_WIRKDRUCK_MIT_HYS" 1 "STD_KUP_WIRKDRUCK_OHNE_HYS" 2 "MANUELL_SF" 3 "MANUELL_ABSOLUTDRUCKVORGABE_MIT_HYS" 4 "ABSOLUTDRUCKVORGABE" DEFAULT_VALUE "" /end COMPU_VTAB
/begin COMPU_METHOD Conv.cK0sKorSignale._.vorzeichen_zug_schub_S5_S3 "Umrechnung fuer Messgroesse cK0sKorSignale::vorzeichen_zug_schub" TAB_VERB "%4.0" "" COMPU_TAB_REF Conv.cK0sKorSignale._.vorzeichen_zug_schub_S5_S3 /end COMPU_METHOD
/begin COMPU_METHOD Conv.cK0sKorSignale._.zs_zug_k0_S5_S3 "Umrechnung fuer Messgroesse cK0sKorSignale::zs_zug_k0" TAB_VERB "%4.0" "" COMPU_TAB_REF Conv.cK0sKorSignale._.zs_zug_k0_S5_S3 /end COMPU_METHOD
/begin COMPU_METHOD Conv.cK0sKorSignale._.zs_zug_merk_k0_S5_S3 "Umrechnung fuer Messgroesse cK0sKorSignale::zs_zug_merk_k0" TAB_VERB "%4.0" "" COMPU_TAB_REF Conv.cK0sKorSignale._.zs_zug_merk_k0_S5_S3 /end COMPU_METHOD
/begin COMPU_METHOD Conv.cK0sMeUtf._.status_me_k0_komp_S5_S3 "Umrechnung fuer Messgroesse cK0sMeUtf::status_me_k0_komp" TAB_VERB "%4.0" "" COMPU_TAB_REF Conv.cK0sMeUtf._.status_me_k0_komp_S5_S3 /end COMPU_METHOD
/begin COMPU_METHOD Conv.cK0sMeUtf._.status_me_k0_S5_S3 "Umrechnung fuer Messgroesse cK0sMeUtf::status_me_k0" TAB_VERB "%4.0" "" COMPU_TAB_REF Conv.cK0sMeUtf._.status_me_k0_S5_S3 /end COMPU_METHOD
/begin COMPU_METHOD Conv.cK0sMeUtf._.z_me_utf_k0_S5_S3 "Umrechnung fuer Messgroesse cK0sMeUtf::z_me_utf_k0" TAB_VERB "%4.0" "" COMPU_TAB_REF Conv.cK0sMeUtf._.z_me_utf_k0_S5_S3 /end COMPU_METHOD
/begin COMPU_METHOD Conv.cK0sSchaltungsLogik._.flag_me_haupt_aktiv_merk_S5_S3 "Umrechnung fuer Messgroesse cK0sSchaltungsLogik::flag_me_haupt_aktiv_merk" TAB_VERB "%4.0" "" COMPU_TAB_REF Conv.cK0sSchaltungsLogik._.flag_me_haupt_aktiv_merk_S5_S3 /end COMPU_METHOD
/begin COMPU_METHOD Conv.cK0sSchaltungsLogik._.flag_me_haupt_aktiv_war_gesetzt_S5_S3 "Umrechnung fuer Messgroesse cK0sSchaltungsLogik::flag_me_haupt_aktiv_war_gesetzt" TAB_VERB "%4.0" "" COMPU_TAB_REF Conv.cK0sSchaltungsLogik._.flag_me_haupt_aktiv_war_gesetzt_S5_S3 /end COMPU_METHOD
/begin COMPU_METHOD Conv.cK0sSchaltungsLogik._.flag_sync_verlassen_me_merk_S5_S3 "Umrechnung fuer Messgroesse cK0sSchaltungsLogik::flag_sync_verlassen_me_merk" TAB_VERB "%4.0" "" COMPU_TAB_REF Conv.cK0sSchaltungsLogik._.flag_sync_verlassen_me_merk_S5_S3 /end COMPU_METHOD
/begin COMPU_METHOD Conv.cK0sSchaltungsLogik._.flanke_me_haupt_S5_S3 "Umrechnung fuer Messgroesse cK0sSchaltungsLogik::flanke_me_haupt" TAB_VERB "%4.0" "" COMPU_TAB_REF Conv.cK0sSchaltungsLogik._.flanke_me_haupt_S5_S3 /end COMPU_METHOD
/begin COMPU_METHOD Conv.cK0sSchaltungsLogik._.idx_schaltung_k0_aktiv_S5_S3 "Umrechnung fuer Messgroesse cK0sSchaltungsLogik::idx_schaltung_k0_aktiv" TAB_VERB "%4.0" "" COMPU_TAB_REF Conv.cK0sSchaltungsLogik._.idx_schaltung_k0_aktiv_S5_S3 /end COMPU_METHOD
/begin COMPU_METHOD Conv.cK0sSchaltungsLogik._.idx_schaltung_k0_S5_S3 "Umrechnung fuer Messgroesse cK0sSchaltungsLogik::idx_schaltung_k0" TAB_VERB "%4.0" "" COMPU_TAB_REF Conv.cK0sSchaltungsLogik._.idx_schaltung_k0_S5_S3 /end COMPU_METHOD
/begin COMPU_METHOD Conv.cK0sSchaltungsLogik._.istgang_idx_k0_S5_S3 "Umrechnung fuer Messgroesse cK0sSchaltungsLogik::istgang_idx_k0" TAB_VERB "%4.0" "" COMPU_TAB_REF Conv.cK0sSchaltungsLogik._.istgang_idx_k0_S5_S3 /end COMPU_METHOD
/begin COMPU_METHOD Conv.cK0sSchaltungsLogik._.istgang_k0_S5_S3 "Umrechnung fuer Messgroesse cK0sSchaltungsLogik::istgang_k0" TAB_VERB "%4.0" "" COMPU_TAB_REF Conv.cK0sSchaltungsLogik._.istgang_k0_S5_S3 /end COMPU_METHOD
/begin COMPU_METHOD Conv.cK0sSchaltungsLogik._.pos_flanke_flag_sync_verl_me_S5_S3 "Umrechnung fuer Messgroesse cK0sSchaltungsLogik::pos_flanke_flag_sync_verl_me" TAB_VERB "%4.0" "" COMPU_TAB_REF Conv.cK0sSchaltungsLogik._.pos_flanke_flag_sync_verl_me_S5_S3 /end COMPU_METHOD
/begin COMPU_METHOD Conv.cK0sSchaltungsLogik._.schaltung_k0_aktiv_S5_S3 "Umrechnung fuer Messgroesse cK0sSchaltungsLogik::schaltung_k0_aktiv" TAB_VERB "%4.0" "" COMPU_TAB_REF Conv.cK0sSchaltungsLogik._.schaltung_k0_aktiv_S5_S3 /end COMPU_METHOD
/begin COMPU_METHOD Conv.cK0sSchaltungsLogik._.schaltung_k0_merk_S5_S3 "Umrechnung fuer Messgroesse cK0sSchaltungsLogik::schaltung_k0_merk" TAB_VERB "%4.0" "" COMPU_TAB_REF Conv.cK0sSchaltungsLogik._.schaltung_k0_merk_S5_S3 /end COMPU_METHOD
/begin COMPU_METHOD Conv.cK0sSchaltungsLogik._.schaltung_k0_S5_S3 "Umrechnung fuer Messgroesse cK0sSchaltungsLogik::schaltung_k0" TAB_VERB "%4.0" "" COMPU_TAB_REF Conv.cK0sSchaltungsLogik._.schaltung_k0_S5_S3 /end COMPU_METHOD
/begin COMPU_METHOD Conv.cK0sSchaltungsLogik._.schaltung_k0_trigger_S5_S3 "Umrechnung fuer Messgroesse cK0sSchaltungsLogik::schaltung_k0_trigger" TAB_VERB "%4.0" "" COMPU_TAB_REF Conv.cK0sSchaltungsLogik._.schaltung_k0_trigger_S5_S3 /end COMPU_METHOD
/begin COMPU_METHOD Conv.cK0sSchaltungsLogik._.z_shlog_S5_S3 "Umrechnung fuer Messgroesse cK0sSchaltungsLogik::z_shlog" TAB_VERB "%4.0" "" COMPU_TAB_REF Conv.cK0sSchaltungsLogik._.z_shlog_S5_S3 /end COMPU_METHOD
/begin COMPU_METHOD Conv.cK0sSchaltungsLogik._.zielgang_k0_S5_S3 "Umrechnung fuer Messgroesse cK0sSchaltungsLogik::zielgang_k0" TAB_VERB "%4.0" "" COMPU_TAB_REF Conv.cK0sSchaltungsLogik._.zielgang_k0_S5_S3 /end COMPU_METHOD
/begin COMPU_METHOD Conv.cK0sSteuerung._.flag_optimierte_befuellung_S5_S3 "Umrechnung fuer Messgroesse cK0sSteuerung::flag_optimierte_befuellung" TAB_VERB "%4.0" "" COMPU_TAB_REF Conv.cK0sSteuerung._.flag_optimierte_befuellung_S5_S3 /end COMPU_METHOD
/begin COMPU_METHOD Conv.cK0sSteuerung._.flag_schliessrampe_ds_S5_S3 "Umrechnung fuer Messgroesse cK0sSteuerung::flag_schliessrampe_ds" TAB_VERB "%4.0" "" COMPU_TAB_REF Conv.cK0sSteuerung._.flag_schliessrampe_ds_S5_S3 /end COMPU_METHOD
/begin COMPU_METHOD Conv.cK0sSteuerung._.flag_schliessrampe_ende_S5_S3 "Umrechnung fuer Messgroesse cK0sSteuerung::flag_schliessrampe_ende" TAB_VERB "%4.0" "" COMPU_TAB_REF Conv.cK0sSteuerung._.flag_schliessrampe_ende_S5_S3 /end COMPU_METHOD
/begin COMPU_METHOD Conv.cK0sSteuerung._.flag_schliessrampe_start_S5_S3 "Umrechnung fuer Messgroesse cK0sSteuerung::flag_schliessrampe_start" TAB_VERB "%4.0" "" COMPU_TAB_REF Conv.cK0sSteuerung._.flag_schliessrampe_start_S5_S3 /end COMPU_METHOD
/begin COMPU_METHOD Conv.cK0sVorsteuer._.flag_m_schalt_aufgebaut_S5_S3 "Umrechnung fuer Messgroesse cK0sVorsteuer::flag_m_schalt_aufgebaut" TAB_VERB "%4.0" "" COMPU_TAB_REF Conv.cK0sVorsteuer._.flag_m_schalt_aufgebaut_S5_S3 /end COMPU_METHOD
/begin COMPU_METHOD Conv.cK0sVorsteuer._.init_sport_schalt_S5_S3 "Umrechnung fuer Messgroesse cK0sVorsteuer::init_sport_schalt" TAB_VERB "%4.0" "" COMPU_TAB_REF Conv.cK0sVorsteuer._.init_sport_schalt_S5_S3 /end COMPU_METHOD
/begin COMPU_METHOD Conv.cK0sVorsteuer._.pt1_m_schalt_merk_S5_S3 "Umrechnung fuer Messgroesse cK0sVorsteuer::pt1_m_schalt_merk" TAB_VERB "%4.0" "" COMPU_TAB_REF Conv.cK0sVorsteuer._.pt1_m_schalt_merk_S5_S3 /end COMPU_METHOD
/begin COMPU_METHOD Conv.cK0sVorsteuer._.qs_status_S5_S3 "Umrechnung fuer Messgroesse cK0sVorsteuer::qs_status" TAB_VERB "%4.0" "" COMPU_TAB_REF Conv.cK0sVorsteuer._.qs_status_S5_S3 /end COMPU_METHOD
/begin COMPU_METHOD Conv.cK0sVorsteuer._.z_mo_lastwechsel_k0_S5_S3 "Umrechnung fuer Messgroesse cK0sVorsteuer::z_mo_lastwechsel_k0" TAB_VERB "%4.0" "" COMPU_TAB_REF Conv.cK0sVorsteuer._.z_mo_lastwechsel_k0_S5_S3 /end COMPU_METHOD
/begin COMPU_METHOD Conv.cKasEkopl._.flag_mo_aktiv_entkoppl_S5_S3 "Umrechnung fuer Messgroesse cKasEkopl::flag_mo_aktiv_entkoppl" TAB_VERB "%4.0" "" COMPU_TAB_REF Conv.cKasEkopl._.flag_mo_aktiv_entkoppl_S5_S3 /end COMPU_METHOD
/begin COMPU_METHOD Conv.cKasEkopl._.z_entkoppeln_S5_S3 "Umrechnung fuer Messgroesse cKasEkopl::z_entkoppeln" TAB_VERB "%4.0" "" COMPU_TAB_REF Conv.cKasEkopl._.z_entkoppeln_S5_S3 /end COMPU_METHOD
/begin COMPU_METHOD Conv.cKorDiagl._.b_eg_uwig_direkt_getr_notlaufsp_S5_S3 "Umrechnung fuer Messgroesse cKorDiagl::b_eg_uwig_direkt_getr_notlaufsp" TAB_VERB "%4.0" "" COMPU_TAB_REF Conv.cKorDiagl._.b_eg_uwig_direkt_getr_notlaufsp_S5_S3 /end COMPU_METHOD
/begin COMPU_METHOD Conv.cKorDiagl._.ersatzgang_S5_S3 "Umrechnung fuer Messgroesse cKorDiagl::ersatzgang" TAB_VERB "%4.0" "" COMPU_TAB_REF Conv.cKorDiagl._.ersatzgang_S5_S3 /end COMPU_METHOD
/begin COMPU_METHOD Conv.cKorDiagl._.symptom_aktiv_S5_S3 "Umrechnung fuer Messgroesse cKorDiagl::symptom_aktiv" TAB_VERB "%4.0" "" COMPU_TAB_REF Conv.cKorDiagl._.symptom_aktiv_S5_S3 /end COMPU_METHOD
/begin COMPU_METHOD Conv.cKorDraus._.druckausgabe_kup_pf_in_n_aktiv_S5_S3 "Umrechnung fuer Messgroesse cKorDraus::druckausgabe_kup_pf_in_n_aktiv" TAB_VERB "%4.0" "" COMPU_TAB_REF Conv.cKorDraus._.druckausgabe_kup_pf_in_n_aktiv_S5_S3 /end COMPU_METHOD
/begin COMPU_METHOD Conv.cKorDraus._.druckausgabe_kup_zu_in_n_aktiv_S5_S3 "Umrechnung fuer Messgroesse cKorDraus::druckausgabe_kup_zu_in_n_aktiv" TAB_VERB "%4.0" "" COMPU_TAB_REF Conv.cKorDraus._.druckausgabe_kup_zu_in_n_aktiv_S5_S3 /end COMPU_METHOD
/begin COMPU_METHOD Conv.cKorDraus._.gang_kfl_zuletzt_S5_S3 "Umrechnung fuer Messgroesse cKorDraus::gang_kfl_zuletzt" TAB_VERB "%4.0" "" COMPU_TAB_REF Conv.cKorDraus._.gang_kfl_zuletzt_S5_S3 /end COMPU_METHOD
/begin COMPU_METHOD Conv.cKorDraus._.gwk_moeglich_S5_S3 "Umrechnung fuer Messgroesse cKorDraus::gwk_moeglich" TAB_VERB "%4.0" "" COMPU_TAB_REF Conv.cKorDraus._.gwk_moeglich_S5_S3 /end COMPU_METHOD
/begin COMPU_METHOD Conv.cKorDraus._.k0_hydraulisch_moeglich_S5_S3 "Umrechnung fuer Messgroesse cKorDraus::k0_hydraulisch_moeglich" TAB_VERB "%4.0" "" COMPU_TAB_REF Conv.cKorDraus._.k0_hydraulisch_moeglich_S5_S3 /end COMPU_METHOD
/begin COMPU_METHOD Conv.cKorDraus._.kfl_zuletzt_S5_S3 "Umrechnung fuer Messgroesse cKorDraus::kfl_zuletzt" TAB_VERB "%4.0" "" COMPU_TAB_REF Conv.cKorDraus._.kfl_zuletzt_S5_S3 /end COMPU_METHOD
/begin COMPU_METHOD Conv.cKorDraus._.kup_pf_in_n_S5_S3 "Umrechnung fuer Messgroesse cKorDraus::kup_pf_in_n" TAB_VERB "%4.0" "" COMPU_TAB_REF Conv.cKorDraus._.kup_pf_in_n_S5_S3 /end COMPU_METHOD
/begin COMPU_METHOD Conv.cKorDraus._.kup_pruefpuls_S5_S3 "Umrechnung fuer Messgroesse cKorDraus::kup_pruefpuls" TAB_VERB "%4.0" "" COMPU_TAB_REF Conv.cKorDraus._.kup_pruefpuls_S5_S3 /end COMPU_METHOD
/begin COMPU_METHOD Conv.cKorDraus._.kup_zu_in_n_S5_S3 "Umrechnung fuer Messgroesse cKorDraus::kup_zu_in_n" TAB_VERB "%4.0" "" COMPU_TAB_REF Conv.cKorDraus._.kup_zu_in_n_S5_S3 /end COMPU_METHOD
/begin COMPU_METHOD Conv.cKorDraus._.posv_uew_hyd_aktiv_S5_S3 "Umrechnung fuer Messgroesse cKorDraus::posv_uew_hyd_aktiv" TAB_VERB "%4.0" "" COMPU_TAB_REF Conv.cKorDraus._.posv_uew_hyd_aktiv_S5_S3 /end COMPU_METHOD
/begin COMPU_METHOD Conv.cKorDraus._.statisch_p_kup_pf_in_n_S5_S3 "Umrechnung fuer Messgroesse cKorDraus::statisch_p_kup_pf_in_n" TAB_VERB "%4.0" "" COMPU_TAB_REF Conv.cKorDraus._.statisch_p_kup_pf_in_n_S5_S3 /end COMPU_METHOD
/begin COMPU_METHOD Conv.cKorDraus._.z_pof1kplbinn_S5_S3 "Umrechnung fuer Messgroesse cKorDraus::z_pof1kplbinn" TAB_VERB "%4.0" "" COMPU_TAB_REF Conv.cKorDraus._.z_pof1kplbinn_S5_S3 /end COMPU_METHOD
/begin COMPU_METHOD Conv.cKorGskup._.f_gsk_schlupft_S5_S3 "Umrechnung fuer Messgroesse cKorGskup::f_gsk_schlupft" TAB_VERB "%4.0" "" COMPU_TAB_REF Conv.cKorGskup._.f_gsk_schlupft_S5_S3 /end COMPU_METHOD
/begin COMPU_METHOD Conv.cKorGskup._.f_kraftschl_kup_fa_S5_S3 "Umrechnung fuer Messgroesse cKorGskup::f_kraftschl_kup_fa" TAB_VERB "%4.0" "" COMPU_TAB_REF Conv.cKorGskup._.f_kraftschl_kup_fa_S5_S3 /end COMPU_METHOD
/begin COMPU_METHOD Conv.cKorGskup._.fehler_gsk_regeln_verboten_S5_S3 "Umrechnung fuer Messgroesse cKorGskup::fehler_gsk_regeln_verboten" TAB_VERB "%4.0" "" COMPU_TAB_REF Conv.cKorGskup._.fehler_gsk_regeln_verboten_S5_S3 /end COMPU_METHOD
/begin COMPU_METHOD Conv.cKorGskup._.gsk_aktiv_S5_S3 "Umrechnung fuer Messgroesse cKorGskup::gsk_aktiv" TAB_VERB "%4.0" "" COMPU_TAB_REF Conv.cKorGskup._.gsk_aktiv_S5_S3 /end COMPU_METHOD
/begin COMPU_METHOD Conv.cKorGskup._.gsk_funktion_S5_S3 "Umrechnung fuer Messgroesse cKorGskup::gsk_funktion" TAB_VERB "%4.0" "" COMPU_TAB_REF Conv.cKorGskup._.gsk_funktion_S5_S3 /end COMPU_METHOD
/begin COMPU_METHOD Conv.cKorGskup._.gsk_zustand_S5_S3 "Umrechnung fuer Messgroesse cKorGskup::gsk_zustand" TAB_VERB "%4.0" "" COMPU_TAB_REF Conv.cKorGskup._.gsk_zustand_S5_S3 /end COMPU_METHOD
/begin COMPU_METHOD Conv.cKorGskup._.kup_gsk_S5_S3 "Umrechnung fuer Messgroesse cKorGskup::kup_gsk" TAB_VERB "%4.0" "" COMPU_TAB_REF Conv.cKorGskup._.kup_gsk_S5_S3 /end COMPU_METHOD
/begin COMPU_METHOD Conv.cKorSaste._.kup_ge1_S5_S3 "Umrechnung fuer Messgroesse cKorSaste::kup_ge1" TAB_VERB "%4.0" "" COMPU_TAB_REF Conv.cKorSaste._.kup_ge1_S5_S3 /end COMPU_METHOD
/begin COMPU_METHOD Conv.cKorSaste._.kup_ge2_S5_S3 "Umrechnung fuer Messgroesse cKorSaste::kup_ge2" TAB_VERB "%4.0" "" COMPU_TAB_REF Conv.cKorSaste._.kup_ge2_S5_S3 /end COMPU_METHOD
/begin COMPU_METHOD Conv.cKorSaste._.kup_ge3_S5_S3 "Umrechnung fuer Messgroesse cKorSaste::kup_ge3" TAB_VERB "%4.0" "" COMPU_TAB_REF Conv.cKorSaste._.kup_ge3_S5_S3 /end COMPU_METHOD
/begin COMPU_METHOD Conv.cKorSaste._.kup_kab_S5_S3 "Umrechnung fuer Messgroesse cKorSaste::kup_kab" TAB_VERB "%4.0" "" COMPU_TAB_REF Conv.cKorSaste._.kup_kab_S5_S3 /end COMPU_METHOD
/begin COMPU_METHOD Conv.cKorSaste._.kup_kabvkzu_S5_S3 "Umrechnung fuer Messgroesse cKorSaste::kup_kabvkzu" TAB_VERB "%4.0" "" COMPU_TAB_REF Conv.cKorSaste._.kup_kabvkzu_S5_S3 /end COMPU_METHOD
/begin COMPU_METHOD Conv.cKorSaste._.kup_kzu_S5_S3 "Umrechnung fuer Messgroesse cKorSaste::kup_kzu" TAB_VERB "%4.0" "" COMPU_TAB_REF Conv.cKorSaste._.kup_kzu_S5_S3 /end COMPU_METHOD
/begin COMPU_METHOD Conv.cKorSaste._.kup_vkab_S5_S3 "Umrechnung fuer Messgroesse cKorSaste::kup_vkab" TAB_VERB "%4.0" "" COMPU_TAB_REF Conv.cKorSaste._.kup_vkab_S5_S3 /end COMPU_METHOD
/begin COMPU_METHOD Conv.cKorSaste._.kup_vkzu_S5_S3 "Umrechnung fuer Messgroesse cKorSaste::kup_vkzu" TAB_VERB "%4.0" "" COMPU_TAB_REF Conv.cKorSaste._.kup_vkzu_S5_S3 /end COMPU_METHOD
/begin COMPU_METHOD Conv.cKorSaste._.me_sas_status_S5_S3 "Umrechnung fuer Messgroesse cKorSaste::me_sas_status" TAB_VERB "%4.0" "" COMPU_TAB_REF Conv.cKorSaste._.me_sas_status_S5_S3 /end COMPU_METHOD
/begin COMPU_METHOD Conv.cKorSaste._.schaltungsabbruch_durch_ga_S5_S3 "Umrechnung fuer Messgroesse cKorSaste::schaltungsabbruch_durch_ga" TAB_VERB "%4.0" "" COMPU_TAB_REF Conv.cKorSaste._.schaltungsabbruch_durch_ga_S5_S3 /end COMPU_METHOD
/begin COMPU_METHOD Conv.cKorSaste._.zielgang_vorb_angefordert_S5_S3 "Umrechnung fuer Messgroesse cKorSaste::zielgang_vorb_angefordert" TAB_VERB "%4.0" "" COMPU_TAB_REF Conv.cKorSaste._.zielgang_vorb_angefordert_S5_S3 /end COMPU_METHOD
/begin COMPU_METHOD Conv.cKorSaste._.zielgang_vorbereitung_S5_S3 "Umrechnung fuer Messgroesse cKorSaste::zielgang_vorbereitung" TAB_VERB "%4.0" "" COMPU_TAB_REF Conv.cKorSaste._.zielgang_vorbereitung_S5_S3 /end COMPU_METHOD
/begin COMPU_METHOD Conv.cModHydlg._.err_v_nr_abgldat_S5_S3 "Umrechnung fuer Messgroesse cModHydlg::err_v_nr_abgldat" TAB_VERB "%4.0" "" COMPU_TAB_REF Conv.cModHydlg._.err_v_nr_abgldat_S5_S3 /end COMPU_METHOD
/begin COMPU_METHOD Conv.cModHydlg._.status_pruef_abgldat_S5_S3 "Umrechnung fuer Messgroesse cModHydlg::status_pruef_abgldat" TAB_VERB "%4.0" "" COMPU_TAB_REF Conv.cModHydlg._.status_pruef_abgldat_S5_S3 /end COMPU_METHOD
/begin COMPU_METHOD Conv.cModHydlg._.version_abgleichdaten_S5_S3 "Umrechnung fuer Messgroesse cModHydlg::version_abgleichdaten" TAB_VERB "%4.0" "" COMPU_TAB_REF Conv.cModHydlg._.version_abgleichdaten_S5_S3 /end COMPU_METHOD
/begin COMPU_METHOD Conv.cModHysKo._.f_ig_eds_S5_S3 "Umrechnung fuer Messgroesse cModHysKo::f_ig_eds" TAB_VERB "%4.0" "" COMPU_TAB_REF Conv.cModHysKo._.f_ig_eds_S5_S3 /end COMPU_METHOD
/begin COMPU_METHOD Conv.cModHysKo._.f_pg_abssoll_S5_S3 "Umrechnung fuer Messgroesse cModHysKo::f_pg_abssoll" TAB_VERB "%4.0" "" COMPU_TAB_REF Conv.cModHysKo._.f_pg_abssoll_S5_S3 /end COMPU_METHOD
/begin COMPU_METHOD Conv.cModHysKo._.ig_wechsel_erkannt_S5_S3 "Umrechnung fuer Messgroesse cModHysKo::ig_wechsel_erkannt" TAB_VERB "%4.0" "" COMPU_TAB_REF Conv.cModHysKo._.ig_wechsel_erkannt_S5_S3 /end COMPU_METHOD
/begin COMPU_METHOD Conv.cModHysKo._.pg_wechsel_erkannt_S5_S3 "Umrechnung fuer Messgroesse cModHysKo::pg_wechsel_erkannt" TAB_VERB "%4.0" "" COMPU_TAB_REF Conv.cModHysKo._.pg_wechsel_erkannt_S5_S3 /end COMPU_METHOD
/begin COMPU_METHOD Conv.cModHysKo._.z_rampe_S5_S3 "Umrechnung fuer Messgroesse cModHysKo::z_rampe" TAB_VERB "%4.0" "" COMPU_TAB_REF Conv.cModHysKo._.z_rampe_S5_S3 /end COMPU_METHOD
/begin COMPU_METHOD Conv.cModKuppl._.f_erste_bef_aus_sb_S5_S3 "Umrechnung fuer Messgroesse cModKuppl::f_erste_bef_aus_sb" TAB_VERB "%4.0" "" COMPU_TAB_REF Conv.cModKuppl._.f_erste_bef_aus_sb_S5_S3 /end COMPU_METHOD
/begin COMPU_METHOD Conv.cModKuppl._.f_erste_bef_S5_S3 "Umrechnung fuer Messgroesse cModKuppl::f_erste_bef" TAB_VERB "%4.0" "" COMPU_TAB_REF Conv.cModKuppl._.f_erste_bef_S5_S3 /end COMPU_METHOD
/begin COMPU_METHOD Conv.cModKuppl._.f_fuellopt_S5_S3 "Umrechnung fuer Messgroesse cModKuppl::f_fuellopt" TAB_VERB "%4.0" "" COMPU_TAB_REF Conv.cModKuppl._.f_fuellopt_S5_S3 /end COMPU_METHOD
/begin COMPU_METHOD Conv.cModKuppl._.f_fuellred_S5_S3 "Umrechnung fuer Messgroesse cModKuppl::f_fuellred" TAB_VERB "%4.0" "" COMPU_TAB_REF Conv.cModKuppl._.f_fuellred_S5_S3 /end COMPU_METHOD
/begin COMPU_METHOD Conv.cModKuppl._.f_geschlossen_S5_S3 "Umrechnung fuer Messgroesse cModKuppl::f_geschlossen" TAB_VERB "%4.0" "" COMPU_TAB_REF Conv.cModKuppl._.f_geschlossen_S5_S3 /end COMPU_METHOD
/begin COMPU_METHOD Conv.cModKuppl._.f_kolben_anlegen_S5_S3 "Umrechnung fuer Messgroesse cModKuppl::f_kolben_anlegen" TAB_VERB "%4.0" "" COMPU_TAB_REF Conv.cModKuppl._.f_kolben_anlegen_S5_S3 /end COMPU_METHOD
/begin COMPU_METHOD Conv.cModKuppl._.f_sf_ausgabe_aktiv_S5_S3 "Umrechnung fuer Messgroesse cModKuppl::f_sf_ausgabe_aktiv" TAB_VERB "%4.0" "" COMPU_TAB_REF Conv.cModKuppl._.f_sf_ausgabe_aktiv_S5_S3 /end COMPU_METHOD
/begin COMPU_METHOD Conv.cModKuppl._.f_sf_vorhanden_S5_S3 "Umrechnung fuer Messgroesse cModKuppl::f_sf_vorhanden" TAB_VERB "%4.0" "" COMPU_TAB_REF Conv.cModKuppl._.f_sf_vorhanden_S5_S3 /end COMPU_METHOD
/begin COMPU_METHOD Conv.cModKuppl._.f_strom_pre_puls_erf_S5_S3 "Umrechnung fuer Messgroesse cModKuppl::f_strom_pre_puls_erf" TAB_VERB "%4.0" "" COMPU_TAB_REF Conv.cModKuppl._.f_strom_pre_puls_erf_S5_S3 /end COMPU_METHOD
/begin COMPU_METHOD Conv.cModKuppl._.f_stromschl_angefordert_S5_S3 "Umrechnung fuer Messgroesse cModKuppl::f_stromschl_angefordert" TAB_VERB "%4.0" "" COMPU_TAB_REF Conv.cModKuppl._.f_stromschl_angefordert_S5_S3 /end COMPU_METHOD
/begin COMPU_METHOD Conv.cModKuppl._.kolben_pos_gelesen_S5_S3 "Umrechnung fuer Messgroesse cModKuppl::kolben_pos_gelesen" TAB_VERB "%4.0" "" COMPU_TAB_REF Conv.cModKuppl._.kolben_pos_gelesen_S5_S3 /end COMPU_METHOD
/begin COMPU_METHOD Conv.cModKuppl._.kpl_inaktiv_S5_S3 "Umrechnung fuer Messgroesse cModKuppl::kpl_inaktiv" TAB_VERB "%4.0" "" COMPU_TAB_REF Conv.cModKuppl._.kpl_inaktiv_S5_S3 /end COMPU_METHOD
/begin COMPU_METHOD Conv.cModKuppl._.kup_index_spsas_S5_S3 "Umrechnung fuer Messgroesse cModKuppl::kup_index_spsas" TAB_VERB "%4.0" "" COMPU_TAB_REF Conv.cModKuppl._.kup_index_spsas_S5_S3 /end COMPU_METHOD
/begin COMPU_METHOD Conv.cModKuppl._.kup_schaltart_sas_S5_S3 "Umrechnung fuer Messgroesse cModKuppl::kup_schaltart_sas" TAB_VERB "%4.0" "" COMPU_TAB_REF Conv.cModKuppl._.kup_schaltart_sas_S5_S3 /end COMPU_METHOD
/begin COMPU_METHOD Conv.cModKuppl._.zustand_S5_S3 "Umrechnung fuer Messgroesse cModKuppl::zustand" TAB_VERB "%4.0" "" COMPU_TAB_REF Conv.cModKuppl._.zustand_S5_S3 /end COMPU_METHOD
/begin COMPU_METHOD Conv.cModPVorg._.f_anst_statisch_S5_S3 "Umrechnung fuer Messgroesse cModPVorg::f_anst_statisch" TAB_VERB "%4.0" "" COMPU_TAB_REF Conv.cModPVorg._.f_anst_statisch_S5_S3 /end COMPU_METHOD
/begin COMPU_METHOD Conv.cModPVorg._.f_druck_vorgegeben_S5_S3 "Umrechnung fuer Messgroesse cModPVorg::f_druck_vorgegeben" TAB_VERB "%4.0" "" COMPU_TAB_REF Conv.cModPVorg._.f_druck_vorgegeben_S5_S3 /end COMPU_METHOD
/begin COMPU_METHOD Conv.cModPVorg._.fktn_druckvorgabe_S5_S3 "Umrechnung fuer Messgroesse cModPVorg::fktn_druckvorgabe" TAB_VERB "%4.0" "" COMPU_TAB_REF Conv.cModPVorg._.fktn_druckvorgabe_S5_S3 /end COMPU_METHOD
/begin COMPU_METHOD Conv.cModPVorg._.typ_druckvorgabe_S5_S3 "Umrechnung fuer Messgroesse cModPVorg::typ_druckvorgabe" TAB_VERB "%4.0" "" COMPU_TAB_REF Conv.cModPVorg._.typ_druckvorgabe_S5_S3 /end COMPU_METHOD
/begin COMPU_METHOD UMR___1_1000_0_S5_S3 "int = ((phys * 1000) / 1) - (0) [-]" RAT_FUNC "%4.3" "[-]" COEFFS 0 1000 0 0 0 1 /end COMPU_METHOD
/begin COMPU_METHOD UMR___1_100_0_S5_S3 "int = ((phys * 100) / 1) - (0) [-]" RAT_FUNC "%3.2" "[-]" COEFFS 0 100 0 0 0 1 /end COMPU_METHOD
/begin COMPU_METHOD UMR___1_1_0_S5_S3 "int = ((phys * 1) / 1) - (0) [-]" RAT_FUNC "%1.0" "[-]" COEFFS 0 1 0 0 0 1 /end COMPU_METHOD
/begin COMPU_METHOD UMR___1_300_0_S5_S3 "int = ((phys * 300) / 1) - (0) [-]" RAT_FUNC "%6.5" "[-]" COEFFS 0 300 0 0 0 1 /end COMPU_METHOD
/begin COMPU_METHOD UMR__SEC_1_1_0_S5_S3 "int = ((phys * 1) / 1) - (0) [1/s]" RAT_FUNC "%1.0" "[1/s]" COEFFS 0 1 0 0 0 1 /end COMPU_METHOD
/begin COMPU_METHOD UMR_BAR__1_1000_0_S5_S3 "int = ((phys * 1000) / 1) - (0) [bar]" RAT_FUNC "%4.3" "[bar]" COEFFS 0 1000 0 0 0 1 /end COMPU_METHOD
/begin COMPU_METHOD UMR_BAR_NM_1_1_0_S5_S3 "int = ((phys * 1) / 1) - (0) [bar/Nm]" RAT_FUNC "%1.0" "[bar/Nm]" COEFFS 0 1 0 0 0 1 /end COMPU_METHOD
/begin COMPU_METHOD UMR_BAR_SEC_1_1000_0_S5_S3 "int = ((phys * 1000) / 1) - (0) [bar/s]" RAT_FUNC "%5.4" "[bar/s]" COEFFS 0 1000 0 0 0 1 /end COMPU_METHOD
/begin COMPU_METHOD UMR_BAR_SEC_1_10_0_S5_S3 "int = ((phys * 10) / 1) - (0) [bar/s]" RAT_FUNC "%2.1" "[bar/s]" COEFFS 0 10 0 0 0 1 /end COMPU_METHOD
/begin COMPU_METHOD UMR_GRADC__1_1_0_S5_S3 "int = ((phys * 1) / 1) - (0) [°C]" RAT_FUNC "%1.0" "[°C]" COEFFS 0 1 0 0 0 1 /end COMPU_METHOD
/begin COMPU_METHOD UMR_GRADC__1_1_M40_S5_S3 "int = ((phys * 1) / 1) - (-40) [°C]" RAT_FUNC "%1.0" "[°C]" COEFFS 0 1 40 0 0 1 /end COMPU_METHOD
/begin COMPU_METHOD UMR_KGM2__1_1_0_S5_S3 "int = ((phys * 1) / 1) - (0) [kg*m^2]" RAT_FUNC "%1.0" "[kg*m^2]" COEFFS 0 1 0 0 0 1 /end COMPU_METHOD
/begin COMPU_METHOD UMR_LITER_MIN_1_1_0_S5_S3 "int = ((phys * 1) / 1) - (0) [Liter/min]" RAT_FUNC "%1.0" "[Liter/min]" COEFFS 0 1 0 0 0 1 /end COMPU_METHOD
/begin COMPU_METHOD UMR_MA__1_10_0_S5_S3 "int = ((phys * 10) / 1) - (0) [mA]" RAT_FUNC "%2.1" "[mA]" COEFFS 0 10 0 0 0 1 /end COMPU_METHOD
/begin COMPU_METHOD UMR_MA_SEC_1_1_0_S5_S3 "int = ((phys * 1) / 1) - (0) [mA/s]" RAT_FUNC "%1.0" "[mA/s]" COEFFS 0 1 0 0 0 1 /end COMPU_METHOD
/begin COMPU_METHOD UMR_MBAR__1_1_0_S5_S3 "int = ((phys * 1) / 1) - (0) [mbar]" RAT_FUNC "%1.0" "[mbar]" COEFFS 0 1 0 0 0 1 /end COMPU_METHOD
/begin COMPU_METHOD UMR_MSEC__10_1_0_S5_S3 "int = ((phys * 1) / 10) - (0) [ms]" RAT_FUNC "%1.0" "[ms]" COEFFS 0 0.1 0 0 0 1 /end COMPU_METHOD
/begin COMPU_METHOD UMR_MSEC__1_1_0_S5_S3 "int = ((phys * 1) / 1) - (0) [ms]" RAT_FUNC "%1.0" "[ms]" COEFFS 0 1 0 0 0 1 /end COMPU_METHOD
/begin COMPU_METHOD UMR_NM__1_1000_0_S5_S3 "int = ((phys * 1000) / 1) - (0) [Nm]" RAT_FUNC "%4.3" "[Nm]" COEFFS 0 1000 0 0 0 1 /end COMPU_METHOD
/begin COMPU_METHOD UMR_NM__1_100_0_S5_S3 "int = ((phys * 100) / 1) - (0) [Nm]" RAT_FUNC "%3.2" "[Nm]" COEFFS 0 100 0 0 0 1 /end COMPU_METHOD
/begin COMPU_METHOD UMR_NM__1_10_0_S5_S3 "int = ((phys * 10) / 1) - (0) [Nm]" RAT_FUNC "%2.1" "[Nm]" COEFFS 0 10 0 0 0 1 /end COMPU_METHOD
/begin COMPU_METHOD UMR_NM__1_1_0_S5_S3 "int = ((phys * 1) / 1) - (0) [Nm]" RAT_FUNC "%1.0" "[Nm]" COEFFS 0 1 0 0 0 1 /end COMPU_METHOD
/begin COMPU_METHOD UMR_NM_BAR_1_1_0_S5_S3 "int = ((phys * 1) / 1) - (0) [Nm/bar]" RAT_FUNC "%1.0" "[Nm/bar]" COEFFS 0 1 0 0 0 1 /end COMPU_METHOD
/begin COMPU_METHOD UMR_PROZENT__1_100_0_S5_S3 "int = ((phys * 100) / 1) - (0) [%]" RAT_FUNC "%3.2" "[%]" COEFFS 0 100 0 0 0 1 /end COMPU_METHOD
/begin COMPU_METHOD UMR_PROZENT__1_1_0_S5_S3 "int = ((phys * 1) / 1) - (0) [%]" RAT_FUNC "%1.0" "[%]" COEFFS 0 1 0 0 0 1 /end COMPU_METHOD
/begin COMPU_METHOD UMR_SEC__1_100_0_S5_S3 "int = ((phys * 100) / 1) - (0) [s]" RAT_FUNC "%3.2" "[s]" COEFFS 0 100 0 0 0 1 /end COMPU_METHOD
/begin COMPU_METHOD UMR_U_MIN_1_1_0_S5_S3 "int = ((phys * 1) / 1) - (0) [U/min]" RAT_FUNC "%1.0" "[U/min]" COEFFS 0 1 0 0 0 1 /end COMPU_METHOD
/begin COMPU_METHOD UMR_U_MINSEC_1_1_0_S5_S3 "int = ((phys * 1) / 1) - (0) [U/(min*s)]" RAT_FUNC "%1.0" "[U/(min*s)]" COEFFS 0 1 0 0 0 1 /end COMPU_METHOD
/begin COMPU_METHOD UMR_W__1_1_0_S5_S3 "int = ((phys * 1) / 1) - (0) [W]" RAT_FUNC "%1.0" "[W]" COEFFS 0 1 0 0 0 1 /end COMPU_METHOD
/begin MEASUREMENT iK0sKorSignale.m_em_max_dyn_offs_k0 "Maximales kurzzeitig mögliches EM Moment" SWORD UMR_NM__1_1_0_S5_S3 1 100 -32768 32767 ECU_ADDRESS 0xFFF8B7F8 DISPLAY_IDENTIFIER m_em_max_dyn_offs_k0.iK0sKorSignale /end MEASUREMENT
/begin MEASUREMENT iK0sKorSignale.m_em_max_dyn_sync_filter_k0.x "Filterwert" SLONG UMR___1_300_0_S5_S3 1 100 -7158278.82667 7158278.82333 ECU_ADDRESS 0xFFF8B870 DISPLAY_IDENTIFIER m_em_max_dyn_sync_filter_k0.iK0sKorSignale /end MEASUREMENT
/begin MEASUREMENT iK0sKorSignale.m_em_max_dyn_sync_k0 "Maximales kurzzeitig mögliches EM Moment" SWORD UMR_NM__1_1_0_S5_S3 1 100 -32768 32767 ECU_ADDRESS 0xFFF8B7FC DISPLAY_IDENTIFIER m_em_max_dyn_sync_k0.iK0sKorSignale /end MEASUREMENT
/begin MEASUREMENT iK0sKorSignale.m_em_min_dyn_offs_k0 "Minimales kurzzeitig mögliches EM Moment" SWORD UMR_NM__1_1_0_S5_S3 1 100 -32768 32767 ECU_ADDRESS 0xFFF8B7FA DISPLAY_IDENTIFIER m_em_min_dyn_offs_k0.iK0sKorSignale /end MEASUREMENT
/begin MEASUREMENT iK0sKorSignale.m_em_min_dyn_sync_filter_k0.x "Filterwert" SLONG UMR___1_300_0_S5_S3 1 100 -7158278.82667 7158278.82333 ECU_ADDRESS 0xFFF8B88C DISPLAY_IDENTIFIER m_em_min_dyn_sync_filter_k0.iK0sKorSignale /end MEASUREMENT
/begin MEASUREMENT iK0sKorSignale.m_em_min_dyn_sync_k0 "Minimales kurzzeitig mögliches EM Moment" SWORD UMR_NM__1_1_0_S5_S3 1 100 -32768 32767 ECU_ADDRESS 0xFFF8B7FE DISPLAY_IDENTIFIER m_em_min_dyn_sync_k0.iK0sKorSignale /end MEASUREMENT
/begin MEASUREMENT iK0sKorSignale.m_emist_filter_k0.x "Filterwert" SLONG UMR___1_300_0_S5_S3 1 100 -7158278.82667 7158278.82333 ECU_ADDRESS 0xFFF8B8C4 DISPLAY_IDENTIFIER m_emist_filter_k0.iK0sKorSignale /end MEASUREMENT
/begin MEASUREMENT iK0sKorSignale.m_emist_roh "Rohwert E-Maschinen Istmoment ohne Eingriff" SWORD UMR_NM__1_1_0_S5_S3 1 100 -200 1300 ECU_ADDRESS 0xFFF8B7E4 DISPLAY_IDENTIFIER m_emist_roh.iK0sKorSignale /end MEASUREMENT
/begin MEASUREMENT iK0sKorSignale.m_emist_roh_fl "Rohwert E-Maschinen Istmoment ohne Eingriff" FLOAT32_IEEE UMR_NM__1_1_0_S5_S3 1 100 -200 1300 ECU_ADDRESS 0xFFF8B7EC DISPLAY_IDENTIFIER m_emist_roh_fl.iK0sKorSignale /end MEASUREMENT
/begin MEASUREMENT iK0sKorSignale.m_emist_sync_k0 "gefiltertes und verzögertes E-Maschinen Istmoment" SWORD UMR_NM__1_1_0_S5_S3 1 100 -200 1300 ECU_ADDRESS 0xFFF8B7C8 DISPLAY_IDENTIFIER m_emist_sync_k0.iK0sKorSignale /end MEASUREMENT
/begin MEASUREMENT iK0sKorSignale.m_emist_sync_k0_fl "gefiltertes und verzögertes E-Maschinen Istmoment" FLOAT32_IEEE UMR_NM__1_1_0_S5_S3 1 100 -200 1300 ECU_ADDRESS 0xFFF8B7CC DISPLAY_IDENTIFIER m_emist_sync_k0_fl.iK0sKorSignale /end MEASUREMENT
/begin MEASUREMENT iK0sKorSignale.m_emsoll_roh "Rohwert E-Maschinen Sollmoment mit Eingriff" SWORD UMR_NM__1_1_0_S5_S3 1 100 -200 1300 ECU_ADDRESS 0xFFF8B7DC DISPLAY_IDENTIFIER m_emsoll_roh.iK0sKorSignale /end MEASUREMENT
/begin MEASUREMENT iK0sKorSignale.m_motist_filter_k0.x "Filterwert" SLONG UMR___1_300_0_S5_S3 1 100 -7158278.82667 7158278.82333 ECU_ADDRESS 0xFFF8B854 DISPLAY_IDENTIFIER m_motist_filter_k0.iK0sKorSignale /end MEASUREMENT
/begin MEASUREMENT iK0sKorSignale.m_motist_offs_k0 "Summenmoment aus EM und VM ohne Getriebeeingriff" SWORD UMR_NM__1_1_0_S5_S3 1 100 -200 1300 ECU_ADDRESS 0xFFF8B7F4 DISPLAY_IDENTIFIER m_motist_offs_k0.iK0sKorSignale /end MEASUREMENT
/begin MEASUREMENT iK0sKorSignale.m_motist_sync_k0 "Summenmoment aus EM und VM ohne Getriebeeingriff" SWORD UMR_NM__1_1_0_S5_S3 1 100 -200 1300 ECU_ADDRESS 0xFFF8B7F6 DISPLAY_IDENTIFIER m_motist_sync_k0.iK0sKorSignale /end MEASUREMENT
/begin MEASUREMENT iK0sKorSignale.m_vmist_filter_k0.x "Filterwert" SLONG UMR___1_300_0_S5_S3 1 100 -7158278.82667 7158278.82333 ECU_ADDRESS 0xFFF8B8A8 DISPLAY_IDENTIFIER m_vmist_filter_k0.iK0sKorSignale /end MEASUREMENT
/begin MEASUREMENT iK0sKorSignale.m_vmist_roh "Rohwert Verbrennungsmotor Istmoment ohne Eingriff" SWORD UMR_NM__1_1_0_S5_S3 1 100 -200 1300 ECU_ADDRESS 0xFFF8B7D8 DISPLAY_IDENTIFIER m_vmist_roh.iK0sKorSignale /end MEASUREMENT
/begin MEASUREMENT iK0sKorSignale.m_vmist_roh_fl "Rohwert Verbrennungsmotor Istmoment ohne Eingriff" FLOAT32_IEEE UMR_NM__1_1_0_S5_S3 1 100 -200 1300 ECU_ADDRESS 0xFFF8B7E8 DISPLAY_IDENTIFIER m_vmist_roh_fl.iK0sKorSignale /end MEASUREMENT
/begin MEASUREMENT iK0sKorSignale.m_vmist_sync_k0 "gefiltertes und verzögertes Verbrennungsmotor Istmoment" SWORD UMR_NM__1_1_0_S5_S3 1 100 -200 1300 ECU_ADDRESS 0xFFF8B7C2 DISPLAY_IDENTIFIER m_vmist_sync_k0.iK0sKorSignale /end MEASUREMENT
/begin MEASUREMENT iK0sKorSignale.m_vmist_sync_k0_fl "gefiltertes und verzögertes Verbrennungsmotor Istmoment" FLOAT32_IEEE UMR_NM__1_1_0_S5_S3 1 100 -200 1300 ECU_ADDRESS 0xFFF8B7C4 DISPLAY_IDENTIFIER m_vmist_sync_k0_fl.iK0sKorSignale /end MEASUREMENT
/begin MEASUREMENT iK0sKorSignale.m_vmsoll_filter_k0.x "Filterwert" SLONG UMR___1_300_0_S5_S3 1 100 -7158278.82667 7158278.82333 ECU_ADDRESS 0xFFF8B830 DISPLAY_IDENTIFIER m_vmsoll_filter_k0.iK0sKorSignale /end MEASUREMENT
/begin MEASUREMENT iK0sKorSignale.m_vmsoll_roh "Rohwert Verbrennungsmotor Sollmoment mit Eingriff" SWORD UMR_NM__1_1_0_S5_S3 1 100 -200 1300 ECU_ADDRESS 0xFFF8B7DA DISPLAY_IDENTIFIER m_vmsoll_roh.iK0sKorSignale /end MEASUREMENT
/begin MEASUREMENT iK0sKorSignale.m_vmsoll_roh_fl "Rohwert Verbrennungsmotor Sollmoment mit Eingriff" FLOAT32_IEEE UMR_NM__1_1_0_S5_S3 1 100 -200 1300 ECU_ADDRESS 0xFFF8B7E0 DISPLAY_IDENTIFIER m_vmsoll_roh_fl.iK0sKorSignale /end MEASUREMENT
/begin MEASUREMENT iK0sKorSignale.m_vmsollgemvor_sync_k0 "gefiltertes und verzögertes E-Maschinen Sollmoment" SWORD UMR_NM__1_1_0_S5_S3 1 100 -200 1300 ECU_ADDRESS 0xFFF8B7D0 DISPLAY_IDENTIFIER m_vmsollgemvor_sync_k0.iK0sKorSignale /end MEASUREMENT
/begin MEASUREMENT iK0sKorSignale.m_vmsollgemvor_sync_k0_fl "gefiltertes und verzögertes E-Maschinen Sollmoment" FLOAT32_IEEE UMR_NM__1_1_0_S5_S3 1 100 -200 1300 ECU_ADDRESS 0xFFF8B7D4 DISPLAY_IDENTIFIER m_vmsollgemvor_sync_k0_fl.iK0sKorSignale /end MEASUREMENT
/begin MEASUREMENT iK0sKorSignale.n_ab_sync_k0 "Abtriebsdrehzahl gefiltert und verzögert" SWORD UMR_U_MIN_1_1_0_S5_S3 1 100 0 8128 ECU_ADDRESS 0xFFF8B824 DISPLAY_IDENTIFIER n_ab_sync_k0.iK0sKorSignale /end MEASUREMENT
/begin MEASUREMENT iK0sKorSignale.n_abneu_filter_k0.x "Filterwert" SLONG UMR___1_300_0_S5_S3 1 100 -7158278.82667 7158278.82333 ECU_ADDRESS 0xFFF8B918 DISPLAY_IDENTIFIER n_abneu_filter_k0.iK0sKorSignale /end MEASUREMENT
/begin MEASUREMENT iK0sKorSignale.n_em_sync_k0 "E-Maschinendrehzahl gefiltert und verzögert" SWORD UMR_U_MIN_1_1_0_S5_S3 1 100 -10000 10000 ECU_ADDRESS 0xFFF8B814 DISPLAY_IDENTIFIER n_em_sync_k0.iK0sKorSignale /end MEASUREMENT
/begin MEASUREMENT iK0sKorSignale.n_em_sync_k0_fl "E-Maschinendrehzahl gefiltert und verzögert" FLOAT32_IEEE UMR_U_MIN_1_1_0_S5_S3 1 100 -10000 10000 ECU_ADDRESS 0xFFF8B818 DISPLAY_IDENTIFIER n_em_sync_k0_fl.iK0sKorSignale /end MEASUREMENT
/begin MEASUREMENT iK0sKorSignale.n_mot_filter_k0.x "Filterwert" SLONG UMR___1_300_0_S5_S3 1 100 -7158278.82667 7158278.82333 ECU_ADDRESS 0xFFF8B8E0 DISPLAY_IDENTIFIER n_mot_filter_k0.iK0sKorSignale /end MEASUREMENT
/begin MEASUREMENT iK0sKorSignale.n_mot_korr_k0 "Korrigierte Motordrehzahl" SWORD UMR_U_MIN_1_1_0_S5_S3 1 100 0 8128 ECU_ADDRESS 0xFFF8B800 DISPLAY_IDENTIFIER n_mot_korr_k0.iK0sKorSignale /end MEASUREMENT
/begin MEASUREMENT iK0sKorSignale.n_t_sync_k0 "Turbinendrehzahl gefiltert und verzögert" SWORD UMR_U_MIN_1_1_0_S5_S3 1 100 0 8128 ECU_ADDRESS 0xFFF8B81C DISPLAY_IDENTIFIER n_t_sync_k0.iK0sKorSignale /end MEASUREMENT
/begin MEASUREMENT iK0sKorSignale.n_t_sync_k0_fl "Turbinendrehzahl gefiltert und verzögert in Float" FLOAT32_IEEE UMR_U_MIN_1_1_0_S5_S3 1 100 0 8128 ECU_ADDRESS 0xFFF8B820 DISPLAY_IDENTIFIER n_t_sync_k0_fl.iK0sKorSignale /end MEASUREMENT
/begin MEASUREMENT iK0sKorSignale.n_tneu_filter_k0.x "Filterwert" SLONG UMR___1_300_0_S5_S3 1 100 -7158278.82667 7158278.82333 ECU_ADDRESS 0xFFF8B934 DISPLAY_IDENTIFIER n_tneu_filter_k0.iK0sKorSignale /end MEASUREMENT
/begin MEASUREMENT iK0sKorSignale.n_vm_filter_k0.x "Filterwert" SLONG UMR___1_300_0_S5_S3 1 100 -7158278.82667 7158278.82333 ECU_ADDRESS 0xFFF8B8FC DISPLAY_IDENTIFIER n_vm_filter_k0.iK0sKorSignale /end MEASUREMENT
/begin MEASUREMENT iK0sKorSignale.n_vm_roh "Rohwert Verbrennungsmotoristdrehzahl" SWORD UMR_U_MIN_1_1_0_S5_S3 1 100 -10000 10000 ECU_ADDRESS 0xFFF8B80A DISPLAY_IDENTIFIER n_vm_roh.iK0sKorSignale /end MEASUREMENT
/begin MEASUREMENT iK0sKorSignale.n_vm_sync_k0 "Verbrennungsmotoristdrehzahl gefiltert und verzögert" SWORD UMR_U_MIN_1_1_0_S5_S3 1 100 0 10000 ECU_ADDRESS 0xFFF8B80C DISPLAY_IDENTIFIER n_vm_sync_k0.iK0sKorSignale /end MEASUREMENT
/begin MEASUREMENT iK0sKorSignale.n_vm_sync_k0_fl "Verbrennungsmotoristdrehzahl gefiltert und verzögert" FLOAT32_IEEE UMR_U_MIN_1_1_0_S5_S3 1 100 0 10000 ECU_ADDRESS 0xFFF8B810 DISPLAY_IDENTIFIER n_vm_sync_k0_fl.iK0sKorSignale /end MEASUREMENT
/begin MEASUREMENT iK0sKorSignale.nd_k0 "Differenzdrehzahl K0" SWORD UMR_U_MIN_1_1_0_S5_S3 1 100 -8128 8128 ECU_ADDRESS 0xFFF8B802 DISPLAY_IDENTIFIER nd_k0.iK0sKorSignale /end MEASUREMENT
/begin MEASUREMENT iK0sKorSignale.nd_k0_fl "Differenzdrehzahl K0" FLOAT32_IEEE UMR_U_MIN_1_1_0_S5_S3 1 100 -8128 8128 ECU_ADDRESS 0xFFF8B804 DISPLAY_IDENTIFIER nd_k0_fl.iK0sKorSignale /end MEASUREMENT
/begin MEASUREMENT iK0sKorSignale.nd_zszug_filter_k0.x "Filterwert" SLONG UMR___1_300_0_S5_S3 1 100 -7158278.82667 7158278.82333 ECU_ADDRESS 0xFFF8B960 DISPLAY_IDENTIFIER nd_zszug_filter_k0.iK0sKorSignale /end MEASUREMENT
/begin MEASUREMENT iK0sKorSignale.nd_zszug_k0 "Gefilterte Differenzdrehzahl K0 für Zug/Schub erkennung" SWORD UMR_U_MIN_1_1_0_S5_S3 1 100 -8128 8128 ECU_ADDRESS 0xFFF8B808 DISPLAY_IDENTIFIER nd_zszug_k0.iK0sKorSignale /end MEASUREMENT
/begin MEASUREMENT iK0sKorSignale.ng_ab_sync_k0 "Abtriebsdrehzahlgradient" SWORD UMR_U_MINSEC_1_1_0_S5_S3 1 100 -8128 8128 ECU_ADDRESS 0xFFF8B7BC DISPLAY_IDENTIFIER ng_ab_sync_k0.iK0sKorSignale /end MEASUREMENT
/begin MEASUREMENT iK0sKorSignale.ng_em_sync_k0 "Em Gradient" SWORD UMR_U_MINSEC_1_1_0_S5_S3 1 100 -8128 8128 ECU_ADDRESS 0xFFF8B7BA DISPLAY_IDENTIFIER ng_em_sync_k0.iK0sKorSignale /end MEASUREMENT
/begin MEASUREMENT iK0sKorSignale.ng_em_syncziel_k0 "Abtriebsdrehzahlgradient aus n_ab" SWORD UMR_U_MINSEC_1_1_0_S5_S3 1 100 -8128 8128 ECU_ADDRESS 0xFFF8B7B8 DISPLAY_IDENTIFIER ng_em_syncziel_k0.iK0sKorSignale /end MEASUREMENT
/begin MEASUREMENT iK0sKorSignale.vorzeichen_zug_schub "Vorzeichen Zug/Schub-Bestimmung" SBYTE Conv.cK0sKorSignale._.vorzeichen_zug_schub_S5_S3 1 100 -1 1 ECU_ADDRESS 0xFFF8B7B3 DISPLAY_IDENTIFIER vorzeichen_zug_schub.iK0sKorSignale /end MEASUREMENT
/begin MEASUREMENT iK0sKorSignale.zs_zug_k0 "Zug/Schub-Bestimmung" UBYTE Conv.cK0sKorSignale._.zs_zug_k0_S5_S3 1 100 0 1 BIT_MASK 0x1 ECU_ADDRESS 0xFFF8B7B2 DISPLAY_IDENTIFIER zs_zug_k0.iK0sKorSignale /end MEASUREMENT
/begin MEASUREMENT iK0sKorSignale.zs_zug_merk_k0 "Zug/Schub-Bestimmung" UBYTE Conv.cK0sKorSignale._.zs_zug_merk_k0_S5_S3 1 100 0 1 BIT_MASK 0x1 ECU_ADDRESS 0xFFF8B7B4 DISPLAY_IDENTIFIER zs_zug_merk_k0.iK0sKorSignale /end MEASUREMENT
/begin MEASUREMENT iK0sMeUtf.TspK0Schutz.time "Zeit des Timers" UWORD UMR_SEC__1_100_0_S5_S3 1 100 0 655.35 ECU_ADDRESS 0xFFF8BA70 DISPLAY_IDENTIFIER TspK0Schutz.iK0sMeUtf /end MEASUREMENT
/begin MEASUREMENT iK0sMeUtf.m_schutz_k0 "Absolutes Begrenzungsmoment UTF Schutzfunktion" SWORD UMR_NM__1_1_0_S5_S3 1 100 -400 1640 ECU_ADDRESS 0xFFF8BA64 DISPLAY_IDENTIFIER m_schutz_k0.iK0sMeUtf /end MEASUREMENT
/begin MEASUREMENT iK0sMeUtf.m_schutz_k0_speicher "Absolutes Begrenzungsmoment UTF Schutzfunktion" SLONG UMR_NM__1_1000_0_S5_S3 1 100 -200 1300 ECU_ADDRESS 0xFFF8BA6C DISPLAY_IDENTIFIER m_schutz_k0_speicher.iK0sMeUtf /end MEASUREMENT
/begin MEASUREMENT iK0sMeUtf.status_me_k0 "Status ob Motoreingriff erfolgen soll" UBYTE Conv.cK0sMeUtf._.status_me_k0_S5_S3 1 100 0 1 ECU_ADDRESS 0xFFF8BA66 DISPLAY_IDENTIFIER status_me_k0.iK0sMeUtf /end MEASUREMENT
/begin MEASUREMENT iK0sMeUtf.status_me_k0_komp "Komplement: Status ob Motoreingriff erfolgen soll" UBYTE Conv.cK0sMeUtf._.status_me_k0_komp_S5_S3 1 100 254 255 ECU_ADDRESS 0xFFF8BA67 DISPLAY_IDENTIFIER status_me_k0_komp.iK0sMeUtf /end MEASUREMENT
/begin MEASUREMENT iK0sMeUtf.z_me_utf_k0 "Zustand der UTF-Schutzfunktion" UBYTE Conv.cK0sMeUtf._.z_me_utf_k0_S5_S3 1 100 1 3 ECU_ADDRESS 0xFFF8BA68 DISPLAY_IDENTIFIER z_me_utf_k0.iK0sMeUtf /end MEASUREMENT
/begin MEASUREMENT iK0sParam.Pt1IGetriebeVirtK0Roh.x "Filterwert" FLOAT32_IEEE UMR___1_1_0_S5_S3 1 100 -1000000000 1000000000 ECU_ADDRESS 0xFFF8BAA0 FORMAT "%3.2" DISPLAY_IDENTIFIER Pt1IGetriebeVirtK0Roh.iK0sParam /end MEASUREMENT
/begin MEASUREMENT iK0sParam.i_getriebe_virt_k0 "Aktuell wirksamen virtuellen Getriebeübersetzung" FLOAT32_IEEE UMR___1_1_0_S5_S3 1 100 0 5 ECU_ADDRESS 0xFFF8BA8C FORMAT "%3.2" DISPLAY_IDENTIFIER i_getriebe_virt_k0.iK0sParam /end MEASUREMENT
/begin MEASUREMENT iK0sParam.i_getriebe_virt_k0_alt "Virtuellen Getriebeübersetzung aus der letzten Task" FLOAT32_IEEE UMR___1_1_0_S5_S3 1 100 0 5 ECU_ADDRESS 0xFFF8BA90 FORMAT "%3.2" DISPLAY_IDENTIFIER i_getriebe_virt_k0_alt.iK0sParam /end MEASUREMENT
/begin MEASUREMENT iK0sParam.i_getriebe_virt_k0_roh "Rohwert der aktuell wirksamen virtuellen Getriebeübersetzung" FLOAT32_IEEE UMR___1_1_0_S5_S3 1 100 0 5 ECU_ADDRESS 0xFFF8BA84 FORMAT "%3.2" DISPLAY_IDENTIFIER i_getriebe_virt_k0_roh.iK0sParam /end MEASUREMENT
/begin MEASUREMENT iK0sParam.i_getriebe_virt_k0_roh_filt "Gefilteter Rohwert der aktuell wirksamen virtuellen Getriebeübersetzung" FLOAT32_IEEE UMR___1_1_0_S5_S3 1 100 0 5 ECU_ADDRESS 0xFFF8BA88 FORMAT "%3.2" DISPLAY_IDENTIFIER i_getriebe_virt_k0_roh_filt.iK0sParam /end MEASUREMENT
/begin MEASUREMENT iK0sParam.j_ersatz_k0 "Ersatzträgheitsmoment" FLOAT32_IEEE UMR_KGM2__1_1_0_S5_S3 1 100 0 100 ECU_ADDRESS 0xFFF8BA9C FORMAT "%4.3" DISPLAY_IDENTIFIER j_ersatz_k0.iK0sParam /end MEASUREMENT
/begin MEASUREMENT iK0sParam.j_pri_k0 "Primaerrtraegheit" FLOAT32_IEEE UMR_KGM2__1_1_0_S5_S3 1 100 0 100 ECU_ADDRESS 0xFFF8BA98 FORMAT "%4.3" DISPLAY_IDENTIFIER j_pri_k0.iK0sParam /end MEASUREMENT
/begin MEASUREMENT iK0sParam.j_sec_k0 "Sekundaertraegheit" FLOAT32_IEEE UMR_KGM2__1_1_0_S5_S3 1 100 0 100 ECU_ADDRESS 0xFFF8BA94 FORMAT "%4.3" DISPLAY_IDENTIFIER j_sec_k0.iK0sParam /end MEASUREMENT
/begin MEASUREMENT iK0sParam.mue_inv_k0 "inverse K0- Reibwert Stationär" FLOAT32_IEEE UMR_BAR_NM_1_1_0_S5_S3 1 100 0.00333333333333 0.04 ECU_ADDRESS 0xFFF8BA78 FORMAT "%4.3" DISPLAY_IDENTIFIER mue_inv_k0.iK0sParam /end MEASUREMENT
/begin MEASUREMENT iK0sParam.mue_inv_richt_k0 "inverser K0- Zug Schub abhänfgiger Reibwert Stationär" FLOAT32_IEEE UMR_BAR_NM_1_1_0_S5_S3 1 100 -0.00333333333333 0.00333333333333 ECU_ADDRESS 0xFFF8BA80 FORMAT "%4.3" DISPLAY_IDENTIFIER mue_inv_richt_k0.iK0sParam /end MEASUREMENT
/begin MEASUREMENT iK0sParam.mue_k0 "K0- Reibwert Stationär" FLOAT32_IEEE UMR___1_1_0_S5_S3 1 100 25 300 ECU_ADDRESS 0xFFF8BA74 FORMAT "%3.2" DISPLAY_IDENTIFIER mue_k0.iK0sParam /end MEASUREMENT
/begin MEASUREMENT iK0sParam.mue_richt_k0 "K0- Zug Schub abhänfgiger Reibwert Stationär" FLOAT32_IEEE UMR_NM_BAR_1_1_0_S5_S3 1 100 -300 300 ECU_ADDRESS 0xFFF8BA7C FORMAT "%4.3" DISPLAY_IDENTIFIER mue_richt_k0.iK0sParam /end MEASUREMENT
/begin MEASUREMENT iK0sRegler.a_regramp "Faktor für Regelrampe" FLOAT32_IEEE UMR___1_1_0_S5_S3 1 100 0 1 ECU_ADDRESS 0xFFF8BADC FORMAT "%3.2" DISPLAY_IDENTIFIER a_regramp.iK0sRegler /end MEASUREMENT
/begin MEASUREMENT iK0sRegler.cd "Zeitdiskreter D-Anteil" FLOAT32_IEEE UMR___1_1_0_S5_S3 1 100 0 10 ECU_ADDRESS 0xFFF8BAF8 FORMAT "%3.2" DISPLAY_IDENTIFIER cd.iK0sRegler /end MEASUREMENT
/begin MEASUREMENT iK0sRegler.ci "Zeitdiskreter I-Anteil" FLOAT32_IEEE UMR___1_1_0_S5_S3 1 100 0 10 ECU_ADDRESS 0xFFF8BAF0 FORMAT "%3.2" DISPLAY_IDENTIFIER ci.iK0sRegler /end MEASUREMENT
/begin MEASUREMENT iK0sRegler.ct "Der unskalierte Zeit-Anteil" FLOAT32_IEEE UMR___1_1_0_S5_S3 1 100 0 10 ECU_ADDRESS 0xFFF8BAF4 FORMAT "%3.2" DISPLAY_IDENTIFIER ct.iK0sRegler /end MEASUREMENT
/begin MEASUREMENT iK0sRegler.f_kd_schalt_alt "Hilfsgroesse zur Berechnung des D-Anteil Faktor für Parametergewichtung" FLOAT32_IEEE UMR___1_1_0_S5_S3 1 100 0 5 ECU_ADDRESS 0xFFF8BACC FORMAT "%3.2" DISPLAY_IDENTIFIER f_kd_schalt_alt.iK0sRegler /end MEASUREMENT
/begin MEASUREMENT iK0sRegler.f_ki_schalt_alt "Hilfsgroesse zur Berechnung des I-Anteil Faktor für Parametergewichtung" FLOAT32_IEEE UMR___1_1_0_S5_S3 1 100 0 5 ECU_ADDRESS 0xFFF8BAD4 FORMAT "%3.2" DISPLAY_IDENTIFIER f_ki_schalt_alt.iK0sRegler /end MEASUREMENT
/begin MEASUREMENT iK0sRegler.f_kp_schalt_alt "Hilfsgroesse zur Berechnung des P-Anteil Faktor für Parametergewichtung" FLOAT32_IEEE UMR___1_1_0_S5_S3 1 100 0 5 ECU_ADDRESS 0xFFF8BAC4 FORMAT "%3.2" DISPLAY_IDENTIFIER f_kp_schalt_alt.iK0sRegler /end MEASUREMENT
/begin MEASUREMENT iK0sRegler.fkd "D-Anteil Faktor für Parametergewichtung" FLOAT32_IEEE UMR___1_1_0_S5_S3 1 100 0 10 ECU_ADDRESS 0xFFF8BAE8 FORMAT "%3.2" DISPLAY_IDENTIFIER fkd.iK0sRegler /end MEASUREMENT
/begin MEASUREMENT iK0sRegler.fki "I-Anteil Faktor für Parametergewichtung" FLOAT32_IEEE UMR___1_1_0_S5_S3 1 100 0 10 ECU_ADDRESS 0xFFF8BAEC FORMAT "%3.2" DISPLAY_IDENTIFIER fki.iK0sRegler /end MEASUREMENT
/begin MEASUREMENT iK0sRegler.fkp "P-Anteil Faktor für Parametergewichtung" FLOAT32_IEEE UMR___1_1_0_S5_S3 1 100 0 10 ECU_ADDRESS 0xFFF8BAE4 FORMAT "%3.2" DISPLAY_IDENTIFIER fkp.iK0sRegler /end MEASUREMENT
/begin MEASUREMENT iK0sRegler.help_FKI "-" FLOAT32_IEEE UMR___1_1_0_S5_S3 1 100 -1e+037 1e+037 ECU_ADDRESS 0xFFF8BAD0 FORMAT "%3.2" DISPLAY_IDENTIFIER help_FKI.iK0sRegler /end MEASUREMENT
/begin MEASUREMENT iK0sRegler.kd "PID Regler D-Anteil" FLOAT32_IEEE UMR___1_1_0_S5_S3 1 100 0 20 ECU_ADDRESS 0xFFF8BABC FORMAT "%3.2" DISPLAY_IDENTIFIER kd.iK0sRegler /end MEASUREMENT
/begin MEASUREMENT iK0sRegler.ki "PID Regler I-Anteil" FLOAT32_IEEE UMR___1_1_0_S5_S3 1 100 0 20 ECU_ADDRESS 0xFFF8BAC0 FORMAT "%3.2" DISPLAY_IDENTIFIER ki.iK0sRegler /end MEASUREMENT
/begin MEASUREMENT iK0sRegler.kp "PID Regler P-Anteil" FLOAT32_IEEE UMR___1_1_0_S5_S3 1 100 0 20 ECU_ADDRESS 0xFFF8BAC8 FORMAT "%3.2" DISPLAY_IDENTIFIER kp.iK0sRegler /end MEASUREMENT
/begin MEASUREMENT iK0sRegler.m_regler_k0 "[Nm], gesamtes Reglermoment" FLOAT32_IEEE UMR_NM__1_1_0_S5_S3 1 100 -1500 1500 ECU_ADDRESS 0xFFF8BAA4 DISPLAY_IDENTIFIER m_regler_k0.iK0sRegler /end MEASUREMENT
/begin MEASUREMENT iK0sRegler.m_regler_k0_d "[Nm] Moment D-Anteil" FLOAT32_IEEE UMR_NM__1_1_0_S5_S3 1 100 -1500 1500 ECU_ADDRESS 0xFFF8BAE0 DISPLAY_IDENTIFIER m_regler_k0_d.iK0sRegler /end MEASUREMENT
/begin MEASUREMENT iK0sRegler.m_regler_k0_d_int "[Nm], D Anteil Reglermoment" SWORD UMR_NM__1_10_0_S5_S3 1 100 -1500 1500 ECU_ADDRESS 0xFFF8BAFE DISPLAY_IDENTIFIER m_regler_k0_d_int.iK0sRegler /end MEASUREMENT
/begin MEASUREMENT iK0sRegler.m_regler_k0_i "[Nm] Moment I-Anteil" FLOAT32_IEEE UMR_NM__1_1_0_S5_S3 1 100 -1500 1500 ECU_ADDRESS 0xFFF8BAAC DISPLAY_IDENTIFIER m_regler_k0_i.iK0sRegler /end MEASUREMENT
/begin MEASUREMENT iK0sRegler.m_regler_k0_i_int "[Nm], I Anteil Reglermoment" SWORD UMR_NM__1_10_0_S5_S3 1 100 -1500 1500 ECU_ADDRESS 0xFFF8BAA8 DISPLAY_IDENTIFIER m_regler_k0_i_int.iK0sRegler /end MEASUREMENT
/begin MEASUREMENT iK0sRegler.m_regler_k0_int "[Nm], gesamtes Reglermoment" SWORD UMR_NM__1_10_0_S5_S3 1 100 -1500 1500 ECU_ADDRESS 0xFFF8BAD8 DISPLAY_IDENTIFIER m_regler_k0_int.iK0sRegler /end MEASUREMENT
/begin MEASUREMENT iK0sRegler.m_regler_k0_p "[Nm] Moment P-Antei" FLOAT32_IEEE UMR_NM__1_1_0_S5_S3 1 100 -1500 1500 ECU_ADDRESS 0xFFF8BAB0 DISPLAY_IDENTIFIER m_regler_k0_p.iK0sRegler /end MEASUREMENT
/begin MEASUREMENT iK0sRegler.m_regler_k0_p_int "[Nm], P Anteil Reglermoment" SWORD UMR_NM__1_10_0_S5_S3 1 100 -1500 1500 ECU_ADDRESS 0xFFF8BAFC DISPLAY_IDENTIFIER m_regler_k0_p_int.iK0sRegler /end MEASUREMENT
/begin MEASUREMENT iK0sRegler.m_soll_max_k0 "[Nm], Max Sollmoment" FLOAT32_IEEE UMR_NM__1_1_0_S5_S3 1 100 -1500 1500 ECU_ADDRESS 0xFFF8BAB4 DISPLAY_IDENTIFIER m_soll_max_k0.iK0sRegler /end MEASUREMENT
/begin MEASUREMENT iK0sRegler.m_soll_min_k0 "[Nm], Min Sollmoment" FLOAT32_IEEE UMR_NM__1_1_0_S5_S3 1 100 -1500 1500 ECU_ADDRESS 0xFFF8BAB8 DISPLAY_IDENTIFIER m_soll_min_k0.iK0sRegler /end MEASUREMENT
/begin MEASUREMENT iK0sShLog.VzInitSchalt.time "Zeit des Timers" UBYTE UMR_SEC__1_100_0_S5_S3 1 100 0 2.55 ECU_ADDRESS 0xFFF8CF3E DISPLAY_IDENTIFIER VzInitSchalt.iK0sShLog /end MEASUREMENT
/begin MEASUREMENT iK0sShLog.flag_me_haupt_aktiv_merk "Erkennung Motoreingriff Aktiv um ein Task Verzoegert" UBYTE Conv.cK0sSchaltungsLogik._.flag_me_haupt_aktiv_merk_S5_S3 1 100 0 1 BIT_MASK 0x1 ECU_ADDRESS 0xFFF8CF3B DISPLAY_IDENTIFIER flag_me_haupt_aktiv_merk.iK0sShLog /end MEASUREMENT
/begin MEASUREMENT iK0sShLog.flag_me_haupt_aktiv_war_gesetzt "Erkennung Motoreingriff Aktiv war gesetzt" UBYTE Conv.cK0sSchaltungsLogik._.flag_me_haupt_aktiv_war_gesetzt_S5_S3 1 100 0 1 BIT_MASK 0x1 ECU_ADDRESS 0xFFF8CF3C DISPLAY_IDENTIFIER flag_me_haupt_aktiv_war_gesetzt.iK0sShLog /end MEASUREMENT
/begin MEASUREMENT iK0sShLog.flag_sync_verlassen_me_merk "positive Flanke Flag Synchrondrehzahl verlassen, um ein Task verzoegert" UBYTE Conv.cK0sSchaltungsLogik._.flag_sync_verlassen_me_merk_S5_S3 1 100 0 1 BIT_MASK 0x1 ECU_ADDRESS 0xFFF8CF3A DISPLAY_IDENTIFIER flag_sync_verlassen_me_merk.iK0sShLog /end MEASUREMENT
/begin MEASUREMENT iK0sShLog.flanke_me_haupt "Flankenerkennung positiver Motoreingriff" UBYTE Conv.cK0sSchaltungsLogik._.flanke_me_haupt_S5_S3 1 100 0 1 BIT_MASK 0x1 ECU_ADDRESS 0xFFF8CF20 DISPLAY_IDENTIFIER flanke_me_haupt.iK0sShLog /end MEASUREMENT
/begin MEASUREMENT iK0sShLog.i_getriebe "Getriebeuebersetzung" FLOAT32_IEEE UMR___1_1_0_S5_S3 1 100 0 5 ECU_ADDRESS 0xFFF8CF24 FORMAT "%3.2" DISPLAY_IDENTIFIER i_getriebe.iK0sShLog /end MEASUREMENT
/begin MEASUREMENT iK0sShLog.i_istgang "Getriebeuebersetzung des Istganges" FLOAT32_IEEE UMR___1_1_0_S5_S3 1 100 0 5 ECU_ADDRESS 0xFFF8CF28 FORMAT "%3.2" DISPLAY_IDENTIFIER i_istgang.iK0sShLog /end MEASUREMENT
/begin MEASUREMENT iK0sShLog.i_zielgang "Getriebeuebersetzung des Zielgangs" FLOAT32_IEEE UMR___1_1_0_S5_S3 1 100 0 5 ECU_ADDRESS 0xFFF8CF2C FORMAT "%3.2" DISPLAY_IDENTIFIER i_zielgang.iK0sShLog /end MEASUREMENT
/begin MEASUREMENT iK0sShLog.idx_schaltung_k0 "Wie schaltung_k0 jedoch 0-3" UBYTE Conv.cK0sSchaltungsLogik._.idx_schaltung_k0_S5_S3 1 100 0 4 ECU_ADDRESS 0xFFF8CF32 DISPLAY_IDENTIFIER idx_schaltung_k0.iK0sShLog /end MEASUREMENT
/begin MEASUREMENT iK0sShLog.idx_schaltung_k0_aktiv "Wie schaltung_k0_aktiv aber als index (0-3)" UBYTE Conv.cK0sSchaltungsLogik._.idx_schaltung_k0_aktiv_S5_S3 1 100 0 4 ECU_ADDRESS 0xFFF8CF34 DISPLAY_IDENTIFIER idx_schaltung_k0_aktiv.iK0sShLog /end MEASUREMENT
/begin MEASUREMENT iK0sShLog.istgang_idx_k0 "Istgangerkennung der K0 als index" UBYTE Conv.cK0sSchaltungsLogik._.istgang_idx_k0_S5_S3 1 100 0 9 ECU_ADDRESS 0xFFF8CF36 DISPLAY_IDENTIFIER istgang_idx_k0.iK0sShLog /end MEASUREMENT
/begin MEASUREMENT iK0sShLog.istgang_k0 "Istgangerkennung der K0" SBYTE Conv.cK0sSchaltungsLogik._.istgang_k0_S5_S3 1 100 -1 8 ECU_ADDRESS 0xFFF8CF35 DISPLAY_IDENTIFIER istgang_k0.iK0sShLog /end MEASUREMENT
/begin MEASUREMENT iK0sShLog.pos_flanke_flag_sync_verl_me "positive Flanke Flag Synchrondrehzahl verlassen" UBYTE Conv.cK0sSchaltungsLogik._.pos_flanke_flag_sync_verl_me_S5_S3 1 100 0 1 BIT_MASK 0x1 ECU_ADDRESS 0xFFF8CF39 DISPLAY_IDENTIFIER pos_flanke_flag_sync_verl_me.iK0sShLog /end MEASUREMENT
/begin MEASUREMENT iK0sShLog.schaltung_k0 "Schalttyp" SBYTE Conv.cK0sSchaltungsLogik._.schaltung_k0_S5_S3 1 100 -2 2 ECU_ADDRESS 0xFFF8CF30 DISPLAY_IDENTIFIER schaltung_k0.iK0sShLog /end MEASUREMENT
/begin MEASUREMENT iK0sShLog.schaltung_k0_aktiv "Schaltung_k0 läuft (Gleitphase)" SBYTE Conv.cK0sSchaltungsLogik._.schaltung_k0_aktiv_S5_S3 1 100 -2 2 ECU_ADDRESS 0xFFF8CF33 DISPLAY_IDENTIFIER schaltung_k0_aktiv.iK0sShLog /end MEASUREMENT
/begin MEASUREMENT iK0sShLog.schaltung_k0_merk "Schalttyp verzögert um 1 Task" SBYTE Conv.cK0sSchaltungsLogik._.schaltung_k0_merk_S5_S3 1 100 -2 2 ECU_ADDRESS 0xFFF8CF31 DISPLAY_IDENTIFIER schaltung_k0_merk.iK0sShLog /end MEASUREMENT
/begin MEASUREMENT iK0sShLog.schaltung_k0_trigger "Schaltung_k0spointer" UBYTE Conv.cK0sSchaltungsLogik._.schaltung_k0_trigger_S5_S3 1 100 0 6 ECU_ADDRESS 0xFFF8CF37 DISPLAY_IDENTIFIER schaltung_k0_trigger.iK0sShLog /end MEASUREMENT
/begin MEASUREMENT iK0sShLog.z_shlog "Zustand des Schaltungslogik-Zustandsautomates" UBYTE Conv.cK0sSchaltungsLogik._.z_shlog_S5_S3 1 100 0 1 ECU_ADDRESS 0xFFF8CF3D DISPLAY_IDENTIFIER z_shlog.iK0sShLog /end MEASUREMENT
/begin MEASUREMENT iK0sShLog.zielgang_k0 "Zielgangerkennung für die K0" SBYTE Conv.cK0sSchaltungsLogik._.zielgang_k0_S5_S3 1 100 -1 8 ECU_ADDRESS 0xFFF8CF38 DISPLAY_IDENTIFIER zielgang_k0.iK0sShLog /end MEASUREMENT
/begin MEASUREMENT iK0sSteuerung.Pt1ZuregelnK0.x "Filterwert" FLOAT32_IEEE UMR___1_1_0_S5_S3 1 100 -1000000000 1000000000 ECU_ADDRESS 0xFFF8BB80 FORMAT "%3.2" DISPLAY_IDENTIFIER Pt1ZuregelnK0.iK0sSteuerung /end MEASUREMENT
/begin MEASUREMENT iK0sSteuerung.TimerFuellzeit.time "Zeit des Timers" UWORD UMR_SEC__1_100_0_S5_S3 1 100 0 655.35 ECU_ADDRESS 0xFFF8BB64 DISPLAY_IDENTIFIER TimerFuellzeit.iK0sSteuerung /end MEASUREMENT
/begin MEASUREMENT iK0sSteuerung.TimerOffenK0.maxtime "Endzeit" ULONG UMR_SEC__1_100_0_S5_S3 1 100 0 36000 ECU_ADDRESS 0xFFF8BB7C DISPLAY_IDENTIFIER maxtime.TimerOffenK0.iK0sSteuerung /end MEASUREMENT
/begin MEASUREMENT iK0sSteuerung.TimerOffenK0.time "Zeit des Timers" ULONG UMR_SEC__1_100_0_S5_S3 1 100 0 36000 ECU_ADDRESS 0xFFF8BB78 DISPLAY_IDENTIFIER time.TimerOffenK0.iK0sSteuerung /end MEASUREMENT
/begin MEASUREMENT iK0sSteuerung.TimerZuregelnmax.time "Zeit des Timers" UWORD UMR_SEC__1_100_0_S5_S3 1 100 0 655.35 ECU_ADDRESS 0xFFF8BB66 DISPLAY_IDENTIFIER TimerZuregelnmax.iK0sSteuerung /end MEASUREMENT
/begin MEASUREMENT iK0sSteuerung.flag_optimierte_befuellung "Obtimierte Befüllung angefordert" UBYTE Conv.cK0sSteuerung._.flag_optimierte_befuellung_S5_S3 1 100 0 1 BIT_MASK 0x1 ECU_ADDRESS 0xFFF8BB2C DISPLAY_IDENTIFIER flag_optimierte_befuellung.iK0sSteuerung /end MEASUREMENT
/begin MEASUREMENT iK0sSteuerung.flag_schliessrampe_ds "Schliessrampe gestartet" UBYTE Conv.cK0sSteuerung._.flag_schliessrampe_ds_S5_S3 1 100 0 1 BIT_MASK 0x1 ECU_ADDRESS 0xFFF8BB2D DISPLAY_IDENTIFIER flag_schliessrampe_ds.iK0sSteuerung /end MEASUREMENT
/begin MEASUREMENT iK0sSteuerung.flag_schliessrampe_ende "Schliessrampe fertig" UBYTE Conv.cK0sSteuerung._.flag_schliessrampe_ende_S5_S3 1 100 0 1 BIT_MASK 0x1 ECU_ADDRESS 0xFFF8BB2F DISPLAY_IDENTIFIER flag_schliessrampe_ende.iK0sSteuerung /end MEASUREMENT
/begin MEASUREMENT iK0sSteuerung.flag_schliessrampe_start "Schliessrampe gestartet" UBYTE Conv.cK0sSteuerung._.flag_schliessrampe_start_S5_S3 1 100 0 1 BIT_MASK 0x1 ECU_ADDRESS 0xFFF8BB2E DISPLAY_IDENTIFIER flag_schliessrampe_start.iK0sSteuerung /end MEASUREMENT
/begin MEASUREMENT iK0sSteuerung.g_m_bestimmung "Bestimmung des Momentengradient der Schliessrampe 1-über SCHLIESSRAMPE 0-über GESCHLOSSEN 2-nicht definiert" UBYTE UMR___1_1_0_S5_S3 1 100 0 2 ECU_ADDRESS 0xFFF8BB30 DISPLAY_IDENTIFIER g_m_bestimmung.iK0sSteuerung /end MEASUREMENT
/begin MEASUREMENT iK0sSteuerung.iLBibPID.faktor_d "Param. D-Anteil" FLOAT32_IEEE UMR___1_1_0_S5_S3 1 100 -1e+037 1e+037 ECU_ADDRESS 0xFFF8BB44 FORMAT "%3.2" DISPLAY_IDENTIFIER faktor_d.iLBibPID.iK0sSteuerung /end MEASUREMENT
/begin MEASUREMENT iK0sSteuerung.iLBibPID.faktor_i "Param. I-Anteil" FLOAT32_IEEE UMR___1_1_0_S5_S3 1 100 -1e+037 1e+037 ECU_ADDRESS 0xFFF8BB40 FORMAT "%3.2" DISPLAY_IDENTIFIER faktor_i.iLBibPID.iK0sSteuerung /end MEASUREMENT
/begin MEASUREMENT iK0sSteuerung.iLBibPID.faktor_p "Param. P-Anteil" FLOAT32_IEEE UMR___1_1_0_S5_S3 1 100 -1e+037 1e+037 ECU_ADDRESS 0xFFF8BB3C FORMAT "%3.2" DISPLAY_IDENTIFIER faktor_p.iLBibPID.iK0sSteuerung /end MEASUREMENT
/begin MEASUREMENT iK0sSteuerung.iLBibPID.faktor_t1 "Param. T1-Anteil" FLOAT32_IEEE UMR___1_1_0_S5_S3 1 100 -1e+037 1e+037 ECU_ADDRESS 0xFFF8BB48 FORMAT "%3.2" DISPLAY_IDENTIFIER faktor_t1.iLBibPID.iK0sSteuerung /end MEASUREMENT
/begin MEASUREMENT iK0sSteuerung.iLBibPID.regel_diff_alt "verzoeg. Regeldifferenz" FLOAT32_IEEE UMR___1_1_0_S5_S3 1 100 -1e+037 1e+037 ECU_ADDRESS 0xFFF8BB54 FORMAT "%3.2" DISPLAY_IDENTIFIER regel_diff_alt.iLBibPID.iK0sSteuerung /end MEASUREMENT
/begin MEASUREMENT iK0sSteuerung.iLBibPID.stell_max "maximale Stellgroesse" FLOAT32_IEEE UMR___1_1_0_S5_S3 1 100 -1e+037 1e+037 ECU_ADDRESS 0xFFF8BB4C FORMAT "%3.2" DISPLAY_IDENTIFIER stell_max.iLBibPID.iK0sSteuerung /end MEASUREMENT
/begin MEASUREMENT iK0sSteuerung.iLBibPID.stell_min "minimale Stellgroesse" FLOAT32_IEEE UMR___1_1_0_S5_S3 1 100 -1e+037 1e+037 ECU_ADDRESS 0xFFF8BB50 FORMAT "%3.2" DISPLAY_IDENTIFIER stell_min.iLBibPID.iK0sSteuerung /end MEASUREMENT
/begin MEASUREMENT iK0sSteuerung.iLBibPID.stellgr_alt "verzoegerte Stellgroesse" FLOAT32_IEEE UMR___1_1_0_S5_S3 1 100 -1e+037 1e+037 ECU_ADDRESS 0xFFF8BB58 FORMAT "%3.2" DISPLAY_IDENTIFIER stellgr_alt.iLBibPID.iK0sSteuerung /end MEASUREMENT
/begin MEASUREMENT iK0sSteuerung.iLBibPID.stellgr_d_alt "verzoegerte D-Stellgroesse" FLOAT32_IEEE UMR___1_1_0_S5_S3 1 100 -1e+037 1e+037 ECU_ADDRESS 0xFFF8BB38 FORMAT "%3.2" DISPLAY_IDENTIFIER stellgr_d_alt.iLBibPID.iK0sSteuerung /end MEASUREMENT
/begin MEASUREMENT iK0sSteuerung.iLBibPID.stellgr_i_alt "verzoegerte I-Stellgroesse" FLOAT32_IEEE UMR___1_1_0_S5_S3 1 100 -1e+037 1e+037 ECU_ADDRESS 0xFFF8BB34 FORMAT "%3.2" DISPLAY_IDENTIFIER stellgr_i_alt.iLBibPID.iK0sSteuerung /end MEASUREMENT
/begin MEASUREMENT iK0sSteuerung.iLBibPID.stellgr_i_modulo "Ganzzahl. Rest d. I-Quotient" FLOAT32_IEEE UMR___1_1_0_S5_S3 1 100 -1e+037 1e+037 ECU_ADDRESS 0xFFF8BB5C FORMAT "%3.2" DISPLAY_IDENTIFIER stellgr_i_modulo.iLBibPID.iK0sSteuerung /end MEASUREMENT
/begin MEASUREMENT iK0sSteuerung.m_init_zu_k0 "Initialisierungsmoment für die Überanpressung in gesteuert zu" FLOAT32_IEEE UMR_NM__1_1_0_S5_S3 1 100 -1500 1500 ECU_ADDRESS 0xFFF8BB18 DISPLAY_IDENTIFIER m_init_zu_k0.iK0sSteuerung /end MEASUREMENT
/begin MEASUREMENT iK0sSteuerung.m_ist_k0 "Von der k0 übertragenes Moment" SWORD UMR_NM__1_1_0_S5_S3 1 100 0 1500 ECU_ADDRESS 0xFFF8BB0C DISPLAY_IDENTIFIER m_ist_k0.iK0sSteuerung /end MEASUREMENT
/begin MEASUREMENT iK0sSteuerung.m_ist_k0_filter.x "Filterwert" FLOAT32_IEEE UMR___1_1_0_S5_S3 1 100 -2147483648 2147483647 ECU_ADDRESS 0xFFF8BB68 FORMAT "%3.2" DISPLAY_IDENTIFIER x.m_ist_k0_filter.iK0sSteuerung /end MEASUREMENT
/begin MEASUREMENT iK0sSteuerung.m_ist_k0_filter.xp "Ableitung vom Eingangswert" FLOAT32_IEEE UMR__SEC_1_1_0_S5_S3 1 100 -2147483648 2147483647 ECU_ADDRESS 0xFFF8BB6C FORMAT "%3.2" DISPLAY_IDENTIFIER xp.m_ist_k0_filter.iK0sSteuerung /end MEASUREMENT
/begin MEASUREMENT iK0sSteuerung.m_ist_richt_k0 "Von der k0 übertragenes Roh-IstMoment" FLOAT32_IEEE UMR_NM__1_1_0_S5_S3 1 100 -1500 1500 ECU_ADDRESS 0xFFF8BB14 DISPLAY_IDENTIFIER m_ist_richt_k0.iK0sSteuerung /end MEASUREMENT
/begin MEASUREMENT iK0sSteuerung.m_schlepp_k0 "K0 Schleppmoment" SWORD UMR_NM__1_1_0_S5_S3 1 100 0 1500 ECU_ADDRESS 0xFFF8BB0E DISPLAY_IDENTIFIER m_schlepp_k0.iK0sSteuerung /end MEASUREMENT
/begin MEASUREMENT iK0sSteuerung.m_schlepp_k0_filter.x "Filterwert" FLOAT32_IEEE UMR___1_1_0_S5_S3 1 100 -2147483648 2147483647 ECU_ADDRESS 0xFFF8BB70 FORMAT "%3.2" DISPLAY_IDENTIFIER x.m_schlepp_k0_filter.iK0sSteuerung /end MEASUREMENT
/begin MEASUREMENT iK0sSteuerung.m_schlepp_k0_filter.xp "Ableitung vom Eingangswert" FLOAT32_IEEE UMR__SEC_1_1_0_S5_S3 1 100 -2147483648 2147483647 ECU_ADDRESS 0xFFF8BB74 FORMAT "%3.2" DISPLAY_IDENTIFIER xp.m_schlepp_k0_filter.iK0sSteuerung /end MEASUREMENT
/begin MEASUREMENT iK0sSteuerung.m_schlepp_k0_roh "K0 Schleppmoment Roh" FLOAT32_IEEE UMR_NM__1_1_0_S5_S3 1 100 0 1500 ECU_ADDRESS 0xFFF8BB10 DISPLAY_IDENTIFIER m_schlepp_k0_roh.iK0sSteuerung /end MEASUREMENT
/begin MEASUREMENT iK0sSteuerung.m_soll_k0 "K0 Sollmoment" FLOAT32_IEEE UMR_NM__1_1_0_S5_S3 1 100 -2000 13000 ECU_ADDRESS 0xFFF8BB00 DISPLAY_IDENTIFIER m_soll_k0.iK0sSteuerung /end MEASUREMENT
/begin MEASUREMENT iK0sSteuerung.m_soll_zu_k0 "Interne K0-Sollmomentvorgabe für geschlossen Zustand" FLOAT32_IEEE UMR_NM__1_1_0_S5_S3 1 100 -2000 13000 ECU_ADDRESS 0xFFF8BB04 DISPLAY_IDENTIFIER m_soll_zu_k0.iK0sSteuerung /end MEASUREMENT
/begin MEASUREMENT iK0sSteuerung.mg_k0_zu "Momentengradient der Schliessrampe" FLOAT32_IEEE UMR_NM__1_1_0_S5_S3 1 100 -1500 1500 ECU_ADDRESS 0xFFF8BB20 DISPLAY_IDENTIFIER mg_k0_zu.iK0sSteuerung /end MEASUREMENT
/begin MEASUREMENT iK0sSteuerung.mo_k0zu "Verlauf des gesteuerten Momentenoffsets für die Überanpressung in GESCHLOSSEN" FLOAT32_IEEE UMR_NM__1_1_0_S5_S3 1 100 -1500 1500 ECU_ADDRESS 0xFFF8BB1C DISPLAY_IDENTIFIER mo_k0zu.iK0sSteuerung /end MEASUREMENT
/begin MEASUREMENT iK0sSteuerung.mo_k0zu_has_merk "Differenz aus Has Vorgabe zu Vorsteuer plus offset" FLOAT32_IEEE UMR_NM__1_1_0_S5_S3 1 100 -1500 1500 ECU_ADDRESS 0xFFF8BB24 DISPLAY_IDENTIFIER mo_k0zu_has_merk.iK0sSteuerung /end MEASUREMENT
/begin MEASUREMENT iK0sSteuerung.mo_mgschliess_k0 "Momentengradient Offsetanteil Schliessrampe" FLOAT32_IEEE UMR_NM__1_1_0_S5_S3 1 100 -2000 13000 ECU_ADDRESS 0xFFF8BB08 DISPLAY_IDENTIFIER mo_mgschliess_k0.iK0sSteuerung /end MEASUREMENT
/begin MEASUREMENT iK0sSteuerung.timer_k0_offen "Zeit des offen Timers" ULONG UMR_SEC__1_100_0_S5_S3 1 100 0 36000 ECU_ADDRESS 0xFFF8BB28 DISPLAY_IDENTIFIER timer_k0_offen.iK0sSteuerung /end MEASUREMENT
/begin MEASUREMENT iK0sTempM.Pt1VpOelK0.x "Filterwert" FLOAT32_IEEE UMR___1_1_0_S5_S3 1 100 -1000000000 1000000000 ECU_ADDRESS 0xFFF8BBC0 FORMAT "%3.2" DISPLAY_IDENTIFIER Pt1VpOelK0.iK0sTempM /end MEASUREMENT
/begin MEASUREMENT iK0sTempM.c_belag_k0 "[°C] Geschätzte Belagtemperatur K0 aus Temperaturmodell" FLOAT32_IEEE UMR_GRADC__1_1_0_S5_S3 1 100 -40 500 ECU_ADDRESS 0xFFF8BB88 DISPLAY_IDENTIFIER c_belag_k0.iK0sTempM /end MEASUREMENT
/begin MEASUREMENT iK0sTempM.c_belag_k0_int "[°C] Geschätzte Belagtemperatur K0 aus Temperaturmodell" UWORD UMR_GRADC__1_1_M40_S5_S3 1 100 -40 500 ECU_ADDRESS 0xFFF8BB84 DISPLAY_IDENTIFIER c_belag_k0_int.iK0sTempM /end MEASUREMENT
/begin MEASUREMENT iK0sTempM.c_oel_k0 "[°C] K0 Oeltemperatur aus Temperaturmodell" FLOAT32_IEEE UMR_GRADC__1_1_0_S5_S3 1 100 -40 500 ECU_ADDRESS 0xFFF8BB8C DISPLAY_IDENTIFIER c_oel_k0.iK0sTempM /end MEASUREMENT
/begin MEASUREMENT iK0sTempM.c_torus_k0 "[°C] K0 Torusraum Temperatur aus Temperaturmodell" FLOAT32_IEEE UMR_GRADC__1_1_0_S5_S3 1 100 -40 500 ECU_ADDRESS 0xFFF8BB90 DISPLAY_IDENTIFIER c_torus_k0.iK0sTempM /end MEASUREMENT
/begin MEASUREMENT iK0sTempM.n_pumpe_virt_k0 "" FLOAT32_IEEE UMR_U_MIN_1_1_0_S5_S3 1 100 0 8128 ECU_ADDRESS 0xFFF8BBBC DISPLAY_IDENTIFIER n_pumpe_virt_k0.iK0sTempM /end MEASUREMENT
/begin MEASUREMENT iK0sTempM.q_belag_ab "Wärmestrom von einem Belag an den Lammelenraum" FLOAT32_IEEE UMR_W__1_1_0_S5_S3 1 100 -50000 50000 ECU_ADDRESS 0xFFF8BBA0 DISPLAY_IDENTIFIER q_belag_ab.iK0sTempM /end MEASUREMENT
/begin MEASUREMENT iK0sTempM.q_belag_ab_korr "Korrigierter Wärmestrom von allen Belägen an den Lammellenraum" FLOAT32_IEEE UMR_W__1_1_0_S5_S3 1 100 -50000 50000 ECU_ADDRESS 0xFFF8BBA4 DISPLAY_IDENTIFIER q_belag_ab_korr.iK0sTempM /end MEASUREMENT
/begin MEASUREMENT iK0sTempM.q_k0_ab "Wärmestrom aus dem Torusraum" FLOAT32_IEEE UMR_W__1_1_0_S5_S3 1 100 -50000 50000 ECU_ADDRESS 0xFFF8BBB8 DISPLAY_IDENTIFIER q_k0_ab.iK0sTempM /end MEASUREMENT
/begin MEASUREMENT iK0sTempM.q_k0_gehaeuse_ab1 "Wärmeabfuhr durch Strahlung, Konvektion" FLOAT32_IEEE UMR_W__1_1_0_S5_S3 1 100 -50000 50000 ECU_ADDRESS 0xFFF8BBB0 DISPLAY_IDENTIFIER q_k0_gehaeuse_ab1.iK0sTempM /end MEASUREMENT
/begin MEASUREMENT iK0sTempM.q_k0_gehaeuse_ab2 "Wärmeabfuhr durch Strahlung, Konvektion" FLOAT32_IEEE UMR_W__1_1_0_S5_S3 1 100 -50000 50000 ECU_ADDRESS 0xFFF8BBB4 DISPLAY_IDENTIFIER q_k0_gehaeuse_ab2.iK0sTempM /end MEASUREMENT
/begin MEASUREMENT iK0sTempM.q_k0_lraum_ab "Wärmestrom vom Lammelenraum zum Torus" FLOAT32_IEEE UMR_W__1_1_0_S5_S3 1 100 -50000 50000 ECU_ADDRESS 0xFFF8BBAC DISPLAY_IDENTIFIER q_k0_lraum_ab.iK0sTempM /end MEASUREMENT
/begin MEASUREMENT iK0sTempM.q_k0_verlust "Reibleistung K0 Belag" FLOAT32_IEEE UMR_W__1_1_0_S5_S3 1 100 -50000 50000 ECU_ADDRESS 0xFFF8BB9C DISPLAY_IDENTIFIER q_k0_verlust.iK0sTempM /end MEASUREMENT
/begin MEASUREMENT iK0sTempM.q_k0_verlust_schlepp "Wärmestrom durch Schleppmoment" FLOAT32_IEEE UMR_W__1_1_0_S5_S3 1 100 -50000 50000 ECU_ADDRESS 0xFFF8BBA8 DISPLAY_IDENTIFIER q_k0_verlust_schlepp.iK0sTempM /end MEASUREMENT
/begin MEASUREMENT iK0sTempM.vp_oel_k0 "Gefilterter Kuehloelstrom durch den Torus in l/min" FLOAT32_IEEE UMR_LITER_MIN_1_1_0_S5_S3 1 100 0 10 ECU_ADDRESS 0xFFF8BB98 FORMAT "%2.1" DISPLAY_IDENTIFIER vp_oel_k0.iK0sTempM /end MEASUREMENT
/begin MEASUREMENT iK0sTempM.vp_oel_k0_roh "Kuehloelstrom durch den Torus in l/min" FLOAT32_IEEE UMR_LITER_MIN_1_1_0_S5_S3 1 100 0 10 ECU_ADDRESS 0xFFF8BB94 FORMAT "%2.1" DISPLAY_IDENTIFIER vp_oel_k0_roh.iK0sTempM /end MEASUREMENT
/begin MEASUREMENT iK0sVorst.DelayDme.write_index "Index der aktuellen Bufferposition" SBYTE UMR___1_1_0_S5_S3 1 100 0 10 ECU_ADDRESS 0xFFF8CF9C DISPLAY_IDENTIFIER DelayDme.iK0sVorst /end MEASUREMENT
/begin MEASUREMENT iK0sVorst.Pt1MInitEinregK0.x "Filterwert" FLOAT32_IEEE UMR___1_1_0_S5_S3 1 100 -1000000000 1000000000 ECU_ADDRESS 0xFFF8CFC8 FORMAT "%3.2" DISPLAY_IDENTIFIER Pt1MInitEinregK0.iK0sVorst /end MEASUREMENT
/begin MEASUREMENT iK0sVorst.Pt1MInitSchaltK0.x "Filterwert" FLOAT32_IEEE UMR___1_1_0_S5_S3 1 100 -1000000000 1000000000 ECU_ADDRESS 0xFFF8CFCC FORMAT "%3.2" DISPLAY_IDENTIFIER Pt1MInitSchaltK0.iK0sVorst /end MEASUREMENT
/begin MEASUREMENT iK0sVorst.Pt1MoLwK0.x "Filterwert" FLOAT32_IEEE UMR___1_1_0_S5_S3 1 100 -1000000000 1000000000 ECU_ADDRESS 0xFFF8CFD0 FORMAT "%3.2" DISPLAY_IDENTIFIER Pt1MoLwK0.iK0sVorst /end MEASUREMENT
/begin MEASUREMENT iK0sVorst.Pt1MschaltK0.x "Filterwert" FLOAT32_IEEE UMR___1_1_0_S5_S3 1 100 -1000000000 1000000000 ECU_ADDRESS 0xFFF8CFD4 FORMAT "%3.2" DISPLAY_IDENTIFIER Pt1MschaltK0.iK0sVorst /end MEASUREMENT
/begin MEASUREMENT iK0sVorst.Pt2MschaltabK0.x "Filterwert" FLOAT32_IEEE UMR___1_1_0_S5_S3 1 100 -2147483648 2147483647 ECU_ADDRESS 0xFFF8CFD8 FORMAT "%3.2" DISPLAY_IDENTIFIER x.Pt2MschaltabK0.iK0sVorst /end MEASUREMENT
/begin MEASUREMENT iK0sVorst.Pt2MschaltabK0.xp "Ableitung vom Eingangswert" FLOAT32_IEEE UMR__SEC_1_1_0_S5_S3 1 100 -2147483648 2147483647 ECU_ADDRESS 0xFFF8CFDC FORMAT "%3.2" DISPLAY_IDENTIFIER xp.Pt2MschaltabK0.iK0sVorst /end MEASUREMENT
/begin MEASUREMENT iK0sVorst.TimerTMSchaltK0.time "Zeit des Timers" UWORD UMR_SEC__1_100_0_S5_S3 1 100 0 655.35 ECU_ADDRESS 0xFFF8CFE2 DISPLAY_IDENTIFIER TimerTMSchaltK0.iK0sVorst /end MEASUREMENT
/begin MEASUREMENT iK0sVorst.TimerTMoLwK0.time "Zeit des Timers" UBYTE UMR_SEC__1_100_0_S5_S3 1 100 0 2.55 ECU_ADDRESS 0xFFF8CFE0 DISPLAY_IDENTIFIER TimerTMoLwK0.iK0sVorst /end MEASUREMENT
/begin MEASUREMENT iK0sVorst.f_korrmschalt_k0 "berechnetes Verhältnis VM zu EM bei Motoreingriff" FLOAT32_IEEE UMR___1_1_0_S5_S3 1 100 -100 100 ECU_ADDRESS 0xFFF8CF70 FORMAT "%3.2" DISPLAY_IDENTIFIER f_korrmschalt_k0.iK0sVorst /end MEASUREMENT
/begin MEASUREMENT iK0sVorst.faktor_m_init_einreg_k0 "Faktor zum Abbau des Restmoment im ersten Regeln" UBYTE UMR___1_100_0_S5_S3 1 100 0 1 ECU_ADDRESS 0xFFF8CF48 DISPLAY_IDENTIFIER faktor_m_init_einreg_k0.iK0sVorst /end MEASUREMENT
/begin MEASUREMENT iK0sVorst.flag_m_schalt_aufgebaut "Aufschalten des Schaltmomentes" UBYTE Conv.cK0sVorsteuer._.flag_m_schalt_aufgebaut_S5_S3 1 100 0 1 BIT_MASK 0x1 ECU_ADDRESS 0xFFF8CF59 DISPLAY_IDENTIFIER flag_m_schalt_aufgebaut.iK0sVorst /end MEASUREMENT
/begin MEASUREMENT iK0sVorst.init_sport_schalt "Initialisierung des Parameterpointers für Sportschaltung ist erfolgt" UBYTE Conv.cK0sVorsteuer._.init_sport_schalt_S5_S3 1 100 0 1 BIT_MASK 0x1 ECU_ADDRESS 0xFFF8CF6D DISPLAY_IDENTIFIER init_sport_schalt.iK0sVorst /end MEASUREMENT
/begin MEASUREMENT iK0sVorst.m_hochsch_k0 "Schaltmoment beim Hochschalten (ausgelesen aus den Schaltmomentenkennfeldern)" FLOAT32_IEEE UMR_NM__1_1_0_S5_S3 1 100 -1500 1500 ECU_ADDRESS 0xFFF8CF64 DISPLAY_IDENTIFIER m_hochsch_k0.iK0sVorst /end MEASUREMENT
/begin MEASUREMENT iK0sVorst.m_init_einreg_k0_init "Restmoment bei ersten Einstieg in Regeln" FLOAT32_IEEE UMR_NM__1_1_0_S5_S3 1 100 -1500 1500 ECU_ADDRESS 0xFFF8CF44 DISPLAY_IDENTIFIER m_init_einreg_k0_init.iK0sVorst /end MEASUREMENT
/begin MEASUREMENT iK0sVorst.m_init_rest_k0 "Restmoment nach Schaltungen" FLOAT32_IEEE UMR_NM__1_1_0_S5_S3 1 100 -1500 1500 ECU_ADDRESS 0xFFF8CF40 DISPLAY_IDENTIFIER m_init_rest_k0.iK0sVorst /end MEASUREMENT
/begin MEASUREMENT iK0sVorst.m_korr_schalt_k0 "Korrigiertes Schaltmoment" FLOAT32_IEEE UMR_NM__1_1_0_S5_S3 1 100 -1500 1500 ECU_ADDRESS 0xFFF8CF5C DISPLAY_IDENTIFIER m_korr_schalt_k0.iK0sVorst /end MEASUREMENT
/begin MEASUREMENT iK0sVorst.m_mehrfachruecksch_k0 "Schaltmoment beim Doppelzurückschalten (ausgelesen aus den Schaltmomentenkennfelder)" FLOAT32_IEEE UMR_NM__1_1_0_S5_S3 1 100 -1500 1500 ECU_ADDRESS 0xFFF8CF90 DISPLAY_IDENTIFIER m_mehrfachruecksch_k0.iK0sVorst /end MEASUREMENT
/begin MEASUREMENT iK0sVorst.m_mot_vorsteuer_k0 "Vorsteuermoment (Sollmoment P- und D-Anteil)" FLOAT32_IEEE UMR_NM__1_1_0_S5_S3 1 100 -1500 1500 ECU_ADDRESS 0xFFF8CF7C DISPLAY_IDENTIFIER m_mot_vorsteuer_k0.iK0sVorst /end MEASUREMENT
/begin MEASUREMENT iK0sVorst.m_ruecksch_k0 "Schaltmoment beim Zurückschalten (ausgelesen aus den Schaltmomentenkennfelder)" FLOAT32_IEEE UMR_NM__1_1_0_S5_S3 1 100 -1500 1500 ECU_ADDRESS 0xFFF8CF68 DISPLAY_IDENTIFIER m_ruecksch_k0.iK0sVorst /end MEASUREMENT
/begin MEASUREMENT iK0sVorst.m_schalt_k0 "Schaltmoment (ausgelesen aus den Schaltmomentenkennfeldern)" FLOAT32_IEEE UMR_NM__1_1_0_S5_S3 1 100 -1500 1500 ECU_ADDRESS 0xFFF8CF54 DISPLAY_IDENTIFIER m_schalt_k0.iK0sVorst /end MEASUREMENT
/begin MEASUREMENT iK0sVorst.m_schroh_k0 "Rohwert des Schaltmomentes" FLOAT32_IEEE UMR_NM__1_1_0_S5_S3 1 100 -1500 1500 ECU_ADDRESS 0xFFF8CF84 DISPLAY_IDENTIFIER m_schroh_k0.iK0sVorst /end MEASUREMENT
/begin MEASUREMENT iK0sVorst.m_steuerung_k0 "Gewichtetes Vorsteuermoment aus Vorsteuerung; kein Sprung bei Uminitialisierung der Trägheiten" FLOAT32_IEEE UMR_NM__1_1_0_S5_S3 1 100 -1500 1500 ECU_ADDRESS 0xFFF8CF4C DISPLAY_IDENTIFIER m_steuerung_k0.iK0sVorst /end MEASUREMENT
/begin MEASUREMENT iK0sVorst.m_vor_init_k0 "Momentensprung bei Uminitialisierung der Vorsteuerung" FLOAT32_IEEE UMR_NM__1_1_0_S5_S3 1 100 -1500 1500 ECU_ADDRESS 0xFFF8CF80 DISPLAY_IDENTIFIER m_vor_init_k0.iK0sVorst /end MEASUREMENT
/begin MEASUREMENT iK0sVorst.m_vorsteuer_k0 "[Nm], Physikalisches Vorsteuermoment incl. Schaltmoment" FLOAT32_IEEE UMR_NM__1_1_0_S5_S3 1 100 -1500 1500 ECU_ADDRESS 0xFFF8CF50 DISPLAY_IDENTIFIER m_vorsteuer_k0.iK0sVorst /end MEASUREMENT
/begin MEASUREMENT iK0sVorst.m_vorsteuer_k0_int "[Nm], Gesamt Vorsteuermoment" SWORD UMR_NM__1_10_0_S5_S3 1 100 -1500 1500 ECU_ADDRESS 0xFFF8CF8C DISPLAY_IDENTIFIER m_vorsteuer_k0_int.iK0sVorst /end MEASUREMENT
/begin MEASUREMENT iK0sVorst.mdiff_emminmax_emist_k0_merk "Differenz zwischen E-Istmoment und E-min bzw max Moment je nach ME-Art" SWORD UMR_NM__1_1_0_S5_S3 1 100 -1500 1500 ECU_ADDRESS 0xFFF8CF74 DISPLAY_IDENTIFIER mdiff_emminmax_emist_k0_merk.iK0sVorst /end MEASUREMENT
/begin MEASUREMENT iK0sVorst.me_vm_k0 "Korrigiertes Restmoment für Motorreingriff" FLOAT32_IEEE UMR_NM__1_1_0_S5_S3 1 100 -1500 1500 ECU_ADDRESS 0xFFF8CF60 DISPLAY_IDENTIFIER me_vm_k0.iK0sVorst /end MEASUREMENT
/begin MEASUREMENT iK0sVorst.mg_vmsollgemvor_sync_k0 "Gradient des gemittelten Motorsollmomentes" FLOAT32_IEEE UMR_NM__1_1_0_S5_S3 1 100 -1500 1500 ECU_ADDRESS 0xFFF8CF88 DISPLAY_IDENTIFIER mg_vmsollgemvor_sync_k0.iK0sVorst /end MEASUREMENT
/begin MEASUREMENT iK0sVorst.mo_lastwechsel_k0 "Momentenoffset beim Ausstieg aus LASTFREI" FLOAT32_IEEE UMR_NM__1_1_0_S5_S3 1 100 -15000 15000 ECU_ADDRESS 0xFFF8CF78 DISPLAY_IDENTIFIER mo_lastwechsel_k0.iK0sVorst /end MEASUREMENT
/begin MEASUREMENT iK0sVorst.mpt_molw "Filterzeitkonstante zum abfiltern von mo_lastwechsel" FLOAT32_IEEE UMR___1_1_0_S5_S3 1 100 0 1 ECU_ADDRESS 0xFFF8CF98 FORMAT "%3.2" DISPLAY_IDENTIFIER mpt_molw.iK0sVorst /end MEASUREMENT
/begin MEASUREMENT iK0sVorst.pt1_m_schalt_merk "Aufschalten des Schaltmomentes" UBYTE Conv.cK0sVorsteuer._.pt1_m_schalt_merk_S5_S3 1 100 0 1 BIT_MASK 0x1 ECU_ADDRESS 0xFFF8CF58 DISPLAY_IDENTIFIER pt1_m_schalt_merk.iK0sVorst /end MEASUREMENT
/begin MEASUREMENT iK0sVorst.qs_status "Status für Spontan/sportparameter" UBYTE Conv.cK0sVorsteuer._.qs_status_S5_S3 1 100 0 2 ECU_ADDRESS 0xFFF8CF94 DISPLAY_IDENTIFIER qs_status.iK0sVorst /end MEASUREMENT
/begin MEASUREMENT iK0sVorst.sign_m_init_rest "Vorzeichen für m_init_rest" SBYTE UMR___1_1_0_S5_S3 1 100 -1 1 ECU_ADDRESS 0xFFF8CF6C DISPLAY_IDENTIFIER sign_m_init_rest.iK0sVorst /end MEASUREMENT
/begin MEASUREMENT iK0sVorst.z_mo_lastwechsel_k0 "K0-Zustand im Zustandsautomaten" UBYTE Conv.cK0sVorsteuer._.z_mo_lastwechsel_k0_S5_S3 1 100 0 3 ECU_ADDRESS 0xFFF8CF95 DISPLAY_IDENTIFIER z_mo_lastwechsel_k0.iK0sVorst /end MEASUREMENT
/begin MEASUREMENT iKasEkopl.Pt1MoEntkoppl.x "Filterwert" SLONG UMR___1_300_0_S5_S3 1 100 -7158278.82667 7158278.82333 ECU_ADDRESS 0xFFF8D008 DISPLAY_IDENTIFIER Pt1MoEntkoppl.iKasEkopl /end MEASUREMENT
/begin MEASUREMENT iKasEkopl.TimerSchlEkop.maxtime "Endzeit" UWORD UMR_SEC__1_100_0_S5_S3 1 100 0 655.35 ECU_ADDRESS 0xFFF8D004 DISPLAY_IDENTIFIER maxtime.TimerSchlEkop.iKasEkopl /end MEASUREMENT
/begin MEASUREMENT iKasEkopl.TimerSchlEkop.time "Zeit des Timers" UWORD UMR_SEC__1_100_0_S5_S3 1 100 0 655.35 ECU_ADDRESS 0xFFF8D002 DISPLAY_IDENTIFIER time.TimerSchlEkop.iKasEkopl /end MEASUREMENT
/begin MEASUREMENT iKasEkopl.TimerZEkopl.maxtime "Endzeit" UWORD UMR_SEC__1_100_0_S5_S3 1 100 0 655.35 ECU_ADDRESS 0xFFF8D000 DISPLAY_IDENTIFIER maxtime.TimerZEkopl.iKasEkopl /end MEASUREMENT
/begin MEASUREMENT iKasEkopl.TimerZEkopl.time "Zeit des Timers" UWORD UMR_SEC__1_100_0_S5_S3 1 100 0 655.35 ECU_ADDRESS 0xFFF8CFFE DISPLAY_IDENTIFIER time.TimerZEkopl.iKasEkopl /end MEASUREMENT
/begin MEASUREMENT iKasEkopl.flag_mo_aktiv_entkoppl "Momentenoffset wird im Entkoppeln aufgeschaltet" UBYTE Conv.cKasEkopl._.flag_mo_aktiv_entkoppl_S5_S3 1 100 0 1 BIT_MASK 0x1 ECU_ADDRESS 0xFFF8CFFC DISPLAY_IDENTIFIER flag_mo_aktiv_entkoppl.iKasEkopl /end MEASUREMENT
/begin MEASUREMENT iKasEkopl.m_max_alter_has_entkopl "gespeichertes m_max_has beim Eintritt in Zustand Entkoppeln" SWORD UMR_NM__1_1_0_S5_S3 1 100 -200 1300 ECU_ADDRESS 0xFFF8CFEA DISPLAY_IDENTIFIER m_max_alter_has_entkopl.iKasEkopl /end MEASUREMENT
/begin MEASUREMENT iKasEkopl.m_max_has_entkoppeln "Internes Moment von m_max_has_iae" SWORD UMR_NM__1_1_0_S5_S3 1 100 -200 1300 ECU_ADDRESS 0xFFF8CFFA DISPLAY_IDENTIFIER m_max_has_entkoppeln.iKasEkopl /end MEASUREMENT
/begin MEASUREMENT iKasEkopl.m_mot_init "Motormomentenwert zu Beginn des SCHLIESSEN_ENTKOPPELN Zustandes" SWORD UMR_NM__1_1_0_S5_S3 1 100 -200 1300 ECU_ADDRESS 0xFFF8CFF8 DISPLAY_IDENTIFIER m_mot_init.iKasEkopl /end MEASUREMENT
/begin MEASUREMENT iKasEkopl.m_regler_entkoppeln "Reglermoment für Entkopplung" FLOAT32_IEEE UMR_NM__1_1_0_S5_S3 1 100 -200 1300 ECU_ADDRESS 0xFFF8CFF4 DISPLAY_IDENTIFIER m_regler_entkoppeln.iKasEkopl /end MEASUREMENT
/begin MEASUREMENT iKasEkopl.m_soll_entkoppeln_init "Init Wert für Sollmoment Entkopplung" SWORD UMR_NM__1_1_0_S5_S3 1 100 -200 1300 ECU_ADDRESS 0xFFF8CFEE DISPLAY_IDENTIFIER m_soll_entkoppeln_init.iKasEkopl /end MEASUREMENT
/begin MEASUREMENT iKasEkopl.m_vorsteuer_entkoppeln "Vorsteuermoment für Entkopplung" SWORD UMR_NM__1_1_0_S5_S3 1 100 -200 1300 ECU_ADDRESS 0xFFF8CFE6 DISPLAY_IDENTIFIER m_vorsteuer_entkoppeln.iKasEkopl /end MEASUREMENT
/begin MEASUREMENT iKasEkopl.m_vorsteuer_entkoppeln_init "Vorsteuermoment Initialisierungswert für Entkopplung" SWORD UMR_NM__1_1_0_S5_S3 1 100 -200 1300 ECU_ADDRESS 0xFFF8CFE8 DISPLAY_IDENTIFIER m_vorsteuer_entkoppeln_init.iKasEkopl /end MEASUREMENT
/begin MEASUREMENT iKasEkopl.mo_vorsteuer_entkoppeln "Ofset auf Vorsteuermoment für Entkopplung" SWORD UMR_NM__1_1_0_S5_S3 1 100 -200 1300 ECU_ADDRESS 0xFFF8CFEC DISPLAY_IDENTIFIER mo_vorsteuer_entkoppeln.iKasEkopl /end MEASUREMENT
/begin MEASUREMENT iKasEkopl.mo_vorstschl_entkoppeln "Offset auf Vorsteuermoment für Entkopplung_Schliessen" SLONG UMR_NM__1_100_0_S5_S3 1 100 -1300 1500 ECU_ADDRESS 0xFFF8CFF0 DISPLAY_IDENTIFIER mo_vorstschl_entkoppeln.iKasEkopl /end MEASUREMENT
/begin MEASUREMENT iKasEkopl.z_entkoppeln "Zustand der Anfahrkupplung" UBYTE Conv.cKasEkopl._.z_entkoppeln_S5_S3 1 100 0 3 ECU_ADDRESS 0xFFF8CFE4 DISPLAY_IDENTIFIER z_entkoppeln.iKasEkopl /end MEASUREMENT
/begin MEASUREMENT iKorDiagl.b_eg_uwig_direkt_getr_notlaufsp "S/W Schaltungsabbrüche mit o. ohne Momentenschutz" UBYTE Conv.cKorDiagl._.b_eg_uwig_direkt_getr_notlaufsp_S5_S3 1 100 0 1 BIT_MASK 0x1 ECU_ADDRESS 0xFFF8BBC7 DISPLAY_IDENTIFIER b_eg_uwig_direkt_getr_notlaufsp.iKorDiagl /end MEASUREMENT
/begin MEASUREMENT iKorDiagl.ersatzgang "Ersatzgang" SBYTE Conv.cKorDiagl._.ersatzgang_S5_S3 1 100 -1 8 ECU_ADDRESS 0xFFF8BBC4 DISPLAY_IDENTIFIER ersatzgang.iKorDiagl /end MEASUREMENT
/begin MEASUREMENT iKorDiagl.ersatzgang_info "Ersatzgang Info" UBYTE UMR___1_1_0_S5_S3 1 100 0 10 ECU_ADDRESS 0xFFF8BBC5 DISPLAY_IDENTIFIER ersatzgang_info.iKorDiagl /end MEASUREMENT
/begin MEASUREMENT iKorDiagl.symptom_aktiv "FLAG: Symptom UWIG aktiv" UBYTE Conv.cKorDiagl._.symptom_aktiv_S5_S3 1 100 0 1 BIT_MASK 0x1 ECU_ADDRESS 0xFFF8BBC6 DISPLAY_IDENTIFIER symptom_aktiv.iKorDiagl /end MEASUREMENT
/begin MEASUREMENT iKorDraus.druckausgabe_kup_pf_in_n_aktiv "Flag ob Druckausgabe Fülldruck-Kuppung in KEIN_KFL aktiv ist" UBYTE Conv.cKorDraus._.druckausgabe_kup_pf_in_n_aktiv_S5_S3 1 100 0 1 BIT_MASK 0x1 ECU_ADDRESS 0xFFF8BBD0 DISPLAY_IDENTIFIER druckausgabe_kup_pf_in_n_aktiv.iKorDraus /end MEASUREMENT
/begin MEASUREMENT iKorDraus.druckausgabe_kup_zu_in_n_aktiv "Flag ob Druckausgabe Schiessende Kuppung in KEIN_KFL aktiv ist" UBYTE Conv.cKorDraus._.druckausgabe_kup_zu_in_n_aktiv_S5_S3 1 100 0 1 BIT_MASK 0x1 ECU_ADDRESS 0xFFF8BBCE DISPLAY_IDENTIFIER druckausgabe_kup_zu_in_n_aktiv.iKorDraus /end MEASUREMENT
/begin MEASUREMENT iKorDraus.gang_kfl_zuletzt "Gang, in dem zuletzt Kraftfluss erkannt wurde" SBYTE Conv.cKorDraus._.gang_kfl_zuletzt_S5_S3 1 100 -1 8 ECU_ADDRESS 0xFFF8BBCC DISPLAY_IDENTIFIER gang_kfl_zuletzt.iKorDraus /end MEASUREMENT
/begin MEASUREMENT iKorDraus.gwk_moeglich "Flag ob GWK-Betrieb moeglich ist" UBYTE Conv.cKorDraus._.gwk_moeglich_S5_S3 1 100 0 1 BIT_MASK 0x1 ECU_ADDRESS 0xFFF8BBC8 DISPLAY_IDENTIFIER gwk_moeglich.iKorDraus /end MEASUREMENT
/begin MEASUREMENT iKorDraus.k0_hydraulisch_moeglich "Flag ob K0-Betrieb hydraulisch moeglich ist" UBYTE Conv.cKorDraus._.k0_hydraulisch_moeglich_S5_S3 1 100 0 1 BIT_MASK 0x1 ECU_ADDRESS 0xFFF8BBC9 DISPLAY_IDENTIFIER k0_hydraulisch_moeglich.iKorDraus /end MEASUREMENT
/begin MEASUREMENT iKorDraus.kfl_zuletzt "Kraftfluss-Zustand, der zuletzt angenommen wurde" UBYTE Conv.cKorDraus._.kfl_zuletzt_S5_S3 1 100 0 2 ECU_ADDRESS 0xFFF8BBCB DISPLAY_IDENTIFIER kfl_zuletzt.iKorDraus /end MEASUREMENT
/begin MEASUREMENT iKorDraus.kup_pf_in_n "Fülldruck-Kupplung in KEIN_KFL" UBYTE Conv.cKorDraus._.kup_pf_in_n_S5_S3 1 100 0 5 ECU_ADDRESS 0xFFF8BBCF DISPLAY_IDENTIFIER kup_pf_in_n.iKorDraus /end MEASUREMENT
/begin MEASUREMENT iKorDraus.kup_pruefpuls "Kupplung, die mit einem Pruefpuls beaufschlagt wird" UBYTE Conv.cKorDraus._.kup_pruefpuls_S5_S3 1 100 0 6 ECU_ADDRESS 0xFFF8BBCA DISPLAY_IDENTIFIER kup_pruefpuls.iKorDraus /end MEASUREMENT
/begin MEASUREMENT iKorDraus.kup_zu_in_n "Schliessende Kupplung in KEIN_KFL" UBYTE Conv.cKorDraus._.kup_zu_in_n_S5_S3 1 100 0 5 ECU_ADDRESS 0xFFF8BBCD DISPLAY_IDENTIFIER kup_zu_in_n.iKorDraus /end MEASUREMENT
/begin MEASUREMENT iKorDraus.p_kup_pf_in_n "Druckwert Fülldruck-Kupplung in KEIN_KFL" UWORD UMR_BAR__1_1000_0_S5_S3 1 100 0 20 ECU_ADDRESS 0xFFF8BBD2 DISPLAY_IDENTIFIER p_kup_pf_in_n.iKorDraus /end MEASUREMENT
/begin MEASUREMENT iKorDraus.posv_uew_hyd_aktiv "Flag ob Hydraulikansteuerung POS P bei POSV-Ueberwachung aktiv ist" UBYTE Conv.cKorDraus._.posv_uew_hyd_aktiv_S5_S3 1 100 0 1 BIT_MASK 0x1 ECU_ADDRESS 0xFFF8BBD7 DISPLAY_IDENTIFIER posv_uew_hyd_aktiv.iKorDraus /end MEASUREMENT
/begin MEASUREMENT iKorDraus.statisch_p_kup_pf_in_n "Flag STATISCH zur Druckausgabe Fülldruck-Kuppung in KEIN_KFL" UBYTE Conv.cKorDraus._.statisch_p_kup_pf_in_n_S5_S3 1 100 0 1 BIT_MASK 0x1 ECU_ADDRESS 0xFFF8BBD4 DISPLAY_IDENTIFIER statisch_p_kup_pf_in_n.iKorDraus /end MEASUREMENT
/begin MEASUREMENT iKorDraus.timer_cruise "Zeit seit Start der Fahrbetriebstask" UBYTE UMR_MSEC__10_1_0_S5_S3 1 100 0 2550 ECU_ADDRESS 0xFFF8BBD8 DISPLAY_IDENTIFIER timer_cruise.iKorDraus /end MEASUREMENT
/begin MEASUREMENT iKorDraus.timer_iedsofpsv "Zeit seit Abwahl Position P" UBYTE UMR_MSEC__10_1_0_S5_S3 1 100 0 2550 ECU_ADDRESS 0xFFF8BBD9 DISPLAY_IDENTIFIER timer_iedsofpsv.iKorDraus /end MEASUREMENT
/begin MEASUREMENT iKorDraus.timer_pof1kplbinn "Zeit seit Neustart für Druckoffset Kup. B in Neutral" UBYTE UMR_MSEC__10_1_0_S5_S3 1 100 0 2550 ECU_ADDRESS 0xFFF8BBD5 DISPLAY_IDENTIFIER timer_pof1kplbinn.iKorDraus /end MEASUREMENT
/begin MEASUREMENT iKorDraus.z_pof1kplbinn "Zustand Druckoffset P_OF1KPLBINN" UBYTE Conv.cKorDraus._.z_pof1kplbinn_S5_S3 1 100 0 3 ECU_ADDRESS 0xFFF8BBD6 DISPLAY_IDENTIFIER z_pof1kplbinn.iKorDraus /end MEASUREMENT
/begin MEASUREMENT iKorGskup.f_gsk_schlupft "FLAG: !!!ACHTUNG!!!GSK Ansteuerung aktiv wird nicht Zyklisch bestimmt die Messgröße ist nur zur Darstellung der Abfrag QuGskSchlupft" UBYTE Conv.cKorGskup._.f_gsk_schlupft_S5_S3 1 100 0 1 BIT_MASK 0x1 ECU_ADDRESS 0xFFF8D758 DISPLAY_IDENTIFIER f_gsk_schlupft.iKorGskup /end MEASUREMENT
/begin MEASUREMENT iKorGskup.f_kraftschl_kup_fa "FLAG: Kraftschl.Kup mindestens in FA" UBYTE Conv.cKorGskup._.f_kraftschl_kup_fa_S5_S3 1 100 0 1 BIT_MASK 0x1 ECU_ADDRESS 0xFFF8D74D DISPLAY_IDENTIFIER f_kraftschl_kup_fa.iKorGskup /end MEASUREMENT
/begin MEASUREMENT iKorGskup.fehler_gsk_regeln_verboten "HPSYS: Regeln der GSK nicht erlaubt" UBYTE Conv.cKorGskup._.fehler_gsk_regeln_verboten_S5_S3 1 100 0 1 BIT_MASK 0x1 ECU_ADDRESS 0xFFF8D750 DISPLAY_IDENTIFIER fehler_gsk_regeln_verboten.iKorGskup /end MEASUREMENT
/begin MEASUREMENT iKorGskup.gsk_aktiv "FLAG: GSK Ansteuerung aktiv" UBYTE Conv.cKorGskup._.gsk_aktiv_S5_S3 1 100 0 1 BIT_MASK 0x1 ECU_ADDRESS 0xFFF8D74C DISPLAY_IDENTIFIER gsk_aktiv.iKorGskup /end MEASUREMENT
/begin MEASUREMENT iKorGskup.gsk_funktion "aktuelle GSK Funktion" UBYTE Conv.cKorGskup._.gsk_funktion_S5_S3 1 100 0 4 ECU_ADDRESS 0xFFF8D749 DISPLAY_IDENTIFIER gsk_funktion.iKorGskup /end MEASUREMENT
/begin MEASUREMENT iKorGskup.gsk_zustand "Zustandsgroesse GSK (CSC)" UBYTE Conv.cKorGskup._.gsk_zustand_S5_S3 1 100 0 8 ECU_ADDRESS 0xFFF8D754 DISPLAY_IDENTIFIER gsk_zustand.iKorGskup /end MEASUREMENT
/begin MEASUREMENT iKorGskup.kup_gsk "Nr. der Geregelten Schaltkupplung (SAD, CSC, Bypass, IAE)" UBYTE Conv.cKorGskup._.kup_gsk_S5_S3 1 100 0 7 ECU_ADDRESS 0xFFF8D748 DISPLAY_IDENTIFIER kup_gsk.iKorGskup /end MEASUREMENT
/begin MEASUREMENT iKorGskup.m_motmax_gsk "maximal zulaessiges Motormoment aus GSK (CSC, Bypass)" SWORD UMR_NM__1_1_0_S5_S3 1 100 -200 1300 ECU_ADDRESS 0xFFF8D756 DISPLAY_IDENTIFIER m_motmax_gsk.iKorGskup /end MEASUREMENT
/begin MEASUREMENT iKorGskup.me_gsk_abs_diff "Momentenanforderung GSK als absolute Differenz zu den anderen Eingriffen" SWORD UMR_NM__1_1_0_S5_S3 1 100 -1500 1500 ECU_ADDRESS 0xFFF8D74E DISPLAY_IDENTIFIER me_gsk_abs_diff.iKorGskup /end MEASUREMENT
/begin MEASUREMENT iKorGskup.p_gsk "Druck fuer geregelte Schaltkupplung" SWORD UMR_MBAR__1_1_0_S5_S3 1 100 -1000 12750 ECU_ADDRESS 0xFFF8D74A DISPLAY_IDENTIFIER p_gsk.iKorGskup /end MEASUREMENT
/begin MEASUREMENT iKorGskup.p_gsk_wirk "aktueller Wirkdruck der aktuellen geregelten Schalt-Kupplung" SWORD UMR_MBAR__1_1_0_S5_S3 1 100 -1000 12750 ECU_ADDRESS 0xFFF8D752 DISPLAY_IDENTIFIER p_gsk_wirk.iKorGskup /end MEASUREMENT
/begin MEASUREMENT iKorSaste.kup_ge1 "Kupplungsnr. der ersten GE-Kupplung (Kraftschliessende)" UBYTE Conv.cKorSaste._.kup_ge1_S5_S3 1 100 0 5 ECU_ADDRESS 0xFFF8D75C DISPLAY_IDENTIFIER kup_ge1.iKorSaste /end MEASUREMENT
/begin MEASUREMENT iKorSaste.kup_ge2 "Kupplungsnr. der zweiten GE-Kupplung (1. nicht Kraftschliessende)" UBYTE Conv.cKorSaste._.kup_ge2_S5_S3 1 100 0 5 ECU_ADDRESS 0xFFF8D75D DISPLAY_IDENTIFIER kup_ge2.iKorSaste /end MEASUREMENT
/begin MEASUREMENT iKorSaste.kup_ge3 "Kupplungsnr. der dritten GE-Kupplung (2. nicht Kraftschliessende)" UBYTE Conv.cKorSaste._.kup_ge3_S5_S3 1 100 0 5 ECU_ADDRESS 0xFFF8D75E DISPLAY_IDENTIFIER kup_ge3.iKorSaste /end MEASUREMENT
/begin MEASUREMENT iKorSaste.kup_kab "Kupplungsnr. der abschaltenden Kupplung" UBYTE Conv.cKorSaste._.kup_kab_S5_S3 1 100 0 5 ECU_ADDRESS 0xFFF8D75B DISPLAY_IDENTIFIER kup_kab.iKorSaste /end MEASUREMENT
/begin MEASUREMENT iKorSaste.kup_kabvkzu "Merker fuer KAB die voruebergehend durch VKZU-ABlauf angesteuert wird" UBYTE Conv.cKorSaste._.kup_kabvkzu_S5_S3 1 100 0 5 ECU_ADDRESS 0xFFF8D76C DISPLAY_IDENTIFIER kup_kabvkzu.iKorSaste /end MEASUREMENT
/begin MEASUREMENT iKorSaste.kup_kzu "Kupplungsnr. der zuschaltenden Kupplung" UBYTE Conv.cKorSaste._.kup_kzu_S5_S3 1 100 0 5 ECU_ADDRESS 0xFFF8D75A DISPLAY_IDENTIFIER kup_kzu.iKorSaste /end MEASUREMENT
/begin MEASUREMENT iKorSaste.kup_vkab "Kupplungsnr. der vorbereitenden abschaltenden Kupplung" UBYTE Conv.cKorSaste._.kup_vkab_S5_S3 1 100 0 5 ECU_ADDRESS 0xFFF8D760 DISPLAY_IDENTIFIER kup_vkab.iKorSaste /end MEASUREMENT
/begin MEASUREMENT iKorSaste.kup_vkzu "Kupplungsnr. der vorbereitenden zuschaltenden Kupplung" UBYTE Conv.cKorSaste._.kup_vkzu_S5_S3 1 100 0 5 ECU_ADDRESS 0xFFF8D75F DISPLAY_IDENTIFIER kup_vkzu.iKorSaste /end MEASUREMENT
/begin MEASUREMENT iKorSaste.m_t_mepos "Maximalwert von m_mot und m_motist" SWORD UMR_NM__1_1_0_S5_S3 1 100 -200 1300 ECU_ADDRESS 0xFFF8D76E DISPLAY_IDENTIFIER m_t_mepos.iKorSaste /end MEASUREMENT
/begin MEASUREMENT iKorSaste.me_sas_status "Status des Motoreingriffs waehrend Schaltungen" UBYTE Conv.cKorSaste._.me_sas_status_S5_S3 1 100 0 3 ECU_ADDRESS 0xFFF8D766 DISPLAY_IDENTIFIER me_sas_status.iKorSaste /end MEASUREMENT
/begin MEASUREMENT iKorSaste.n_motmax "maximale Motordrehzahl" UWORD UMR_U_MIN_1_1_0_S5_S3 1 100 0 8160 ECU_ADDRESS 0xFFF8D768 DISPLAY_IDENTIFIER n_motmax.iKorSaste /end MEASUREMENT
/begin MEASUREMENT iKorSaste.n_tmax "maximale Turbinendrehzahl" UWORD UMR_U_MIN_1_1_0_S5_S3 1 100 0 8160 ECU_ADDRESS 0xFFF8D764 DISPLAY_IDENTIFIER n_tmax.iKorSaste /end MEASUREMENT
/begin MEASUREMENT iKorSaste.schaltungsabbruch_durch_ga "Flag ob Schaltungsabbruch durch Gangauslegen vorliegt" UBYTE Conv.cKorSaste._.schaltungsabbruch_durch_ga_S5_S3 1 100 0 1 BIT_MASK 0x1 ECU_ADDRESS 0xFFF8D767 DISPLAY_IDENTIFIER schaltungsabbruch_durch_ga.iKorSaste /end MEASUREMENT
/begin MEASUREMENT iKorSaste.timer_ende_ga "Timer Ende Gang auslegen" UWORD UMR_MSEC__10_1_0_S5_S3 1 100 0 655350 ECU_ADDRESS 0xFFF8D76A DISPLAY_IDENTIFIER timer_ende_ga.iKorSaste /end MEASUREMENT
/begin MEASUREMENT iKorSaste.zielgang_vorb_angefordert "Flag ob vorbereitete Schaltung angefordert ist" UBYTE Conv.cKorSaste._.zielgang_vorb_angefordert_S5_S3 1 100 0 1 BIT_MASK 0x1 ECU_ADDRESS 0xFFF8D762 DISPLAY_IDENTIFIER zielgang_vorb_angefordert.iKorSaste /end MEASUREMENT
/begin MEASUREMENT iKorSaste.zielgang_vorbereitung "Zielgang der vorbereitenden Schaltung" SBYTE Conv.cKorSaste._.zielgang_vorbereitung_S5_S3 1 100 -1 8 ECU_ADDRESS 0xFFF8D761 DISPLAY_IDENTIFIER zielgang_vorbereitung.iKorSaste /end MEASUREMENT
/begin MEASUREMENT iKupA.cModPVorg._.f_anst_statisch "Flag für die statische Ansteuerung" UBYTE Conv.cModPVorg._.f_anst_statisch_S5_S3 1 100 0 1 BIT_MASK 0x1 ECU_ADDRESS 0xFFF8BC07 DISPLAY_IDENTIFIER f_anst_statisch_A /end MEASUREMENT
/begin MEASUREMENT iKupA.cModPVorg._.f_druck_vorgegeben "Flag, ob Druck an dieses Element in diesem Zyklus schon vorgegeben wurde" UBYTE Conv.cModPVorg._.f_druck_vorgegeben_S5_S3 1 100 0 1 BIT_MASK 0x1 ECU_ADDRESS 0xFFF8BC06 DISPLAY_IDENTIFIER f_druck_vorgegeben_A /end MEASUREMENT
/begin MEASUREMENT iKupA.cModPVorg._.fktn_druckvorgabe "Die ansteuernde Funktion" UBYTE Conv.cModPVorg._.fktn_druckvorgabe_S5_S3 1 100 0 29 ECU_ADDRESS 0xFFF8BC08 DISPLAY_IDENTIFIER fktn_druckvorgabe_A /end MEASUREMENT
/begin MEASUREMENT iKupA.cModPVorg._.p_abssoll "Solldruck der Kupplung" UWORD UMR_BAR__1_1000_0_S5_S3 1 100 0 20 ECU_ADDRESS 0xFFF8BC02 DISPLAY_IDENTIFIER p_abssoll_A /end MEASUREMENT
/begin MEASUREMENT iKupA.cModPVorg._.p_abssoll_sys "Solldruck der Kupplung, begrentzt auf Systemdruck" UWORD UMR_BAR__1_1000_0_S5_S3 1 100 0 20 ECU_ADDRESS 0xFFF8BC04 DISPLAY_IDENTIFIER p_abssoll_sys_A /end MEASUREMENT
/begin MEASUREMENT iKupA.cModPVorg._.p_vorgabe "Solldruck der Kupplung" UWORD UMR_BAR__1_1000_0_S5_S3 1 100 0 20 ECU_ADDRESS 0xFFF8BC00 DISPLAY_IDENTIFIER p_vorgabe_A /end MEASUREMENT
/begin MEASUREMENT iKupA.cModPVorg._.typ_druckvorgabe "Der Typ des angesteuerten Druckes" UBYTE Conv.cModPVorg._.typ_druckvorgabe_S5_S3 1 100 0 4 ECU_ADDRESS 0xFFF8BC09 DISPLAY_IDENTIFIER typ_druckvorgabe_A /end MEASUREMENT
/begin MEASUREMENT iKupA.f_erste_bef "Flag für erste Befüllung" UBYTE Conv.cModKuppl._.f_erste_bef_S5_S3 1 100 0 1 BIT_MASK 0x1 ECU_ADDRESS 0xFFF8BC52 DISPLAY_IDENTIFIER f_erste_bef_A /end MEASUREMENT
/begin MEASUREMENT iKupA.f_erste_bef_aus_sb "Flag für erste Befüllung aus standby" UBYTE Conv.cModKuppl._.f_erste_bef_aus_sb_S5_S3 1 100 0 1 BIT_MASK 0x1 ECU_ADDRESS 0xFFF8BC53 DISPLAY_IDENTIFIER f_erste_bef_aus_sb_A /end MEASUREMENT
/begin MEASUREMENT iKupA.f_fuellopt "Flag für optimierte Befüllung" UBYTE Conv.cModKuppl._.f_fuellopt_S5_S3 1 100 0 1 BIT_MASK 0x1 ECU_ADDRESS 0xFFF8BC4F DISPLAY_IDENTIFIER f_fuellopt_A /end MEASUREMENT
/begin MEASUREMENT iKupA.f_fuellred "Flag für reduzierte Befüllung" UBYTE Conv.cModKuppl._.f_fuellred_S5_S3 1 100 0 1 BIT_MASK 0x1 ECU_ADDRESS 0xFFF8BC4E DISPLAY_IDENTIFIER f_fuellred_A /end MEASUREMENT
/begin MEASUREMENT iKupA.f_geschlossen "Flag für Kupplung geschlossen" UBYTE Conv.cModKuppl._.f_geschlossen_S5_S3 1 100 0 1 BIT_MASK 0x1 ECU_ADDRESS 0xFFF8BC51 DISPLAY_IDENTIFIER f_geschlossen_A /end MEASUREMENT
/begin MEASUREMENT iKupA.f_kolben_anlegen "Flag für Kolben anlegen" UBYTE Conv.cModKuppl._.f_kolben_anlegen_S5_S3 1 100 0 1 BIT_MASK 0x1 ECU_ADDRESS 0xFFF8BC50 DISPLAY_IDENTIFIER f_kolben_anlegen_A /end MEASUREMENT
/begin MEASUREMENT iKupA.f_sf_ausgabe_aktiv "Flag für Schnellfüllung" UBYTE Conv.cModKuppl._.f_sf_ausgabe_aktiv_S5_S3 1 100 0 1 BIT_MASK 0x1 ECU_ADDRESS 0xFFF8BC4B DISPLAY_IDENTIFIER f_sf_ausgabe_aktiv_A /end MEASUREMENT
/begin MEASUREMENT iKupA.f_sf_vorhanden "Flag für ausgegebene SF" UBYTE Conv.cModKuppl._.f_sf_vorhanden_S5_S3 1 100 0 1 BIT_MASK 0x1 ECU_ADDRESS 0xFFF8BC4C DISPLAY_IDENTIFIER f_sf_vorhanden_A /end MEASUREMENT
/begin MEASUREMENT iKupA.f_strom_pre_puls_erf "Flag für Stromprepuls" UBYTE Conv.cModKuppl._.f_strom_pre_puls_erf_S5_S3 1 100 0 1 BIT_MASK 0x1 ECU_ADDRESS 0xFFF8BC54 DISPLAY_IDENTIFIER f_strom_pre_puls_erf_A /end MEASUREMENT
/begin MEASUREMENT iKupA.f_stromschl_angefordert "Flag zum ausführen der Stromschleife" UBYTE Conv.cModKuppl._.f_stromschl_angefordert_S5_S3 1 100 0 1 BIT_MASK 0x1 ECU_ADDRESS 0xFFF8BC55 DISPLAY_IDENTIFIER f_stromschl_angefordert_A /end MEASUREMENT
/begin MEASUREMENT iKupA.kolben_pos "Die aktuelle Kolbenposition" UWORD UMR_PROZENT__1_100_0_S5_S3 1 100 0 100 ECU_ADDRESS 0xFFF8BC40 DISPLAY_IDENTIFIER kolben_pos_A /end MEASUREMENT
/begin MEASUREMENT iKupA.kolben_pos_gelesen "Die aktuelle Kolbenposition wurde aus dem EEPROM gelesen" UBYTE Conv.cModKuppl._.kolben_pos_gelesen_S5_S3 1 100 0 1 BIT_MASK 0x1 ECU_ADDRESS 0xFFF8BC42 DISPLAY_IDENTIFIER kolben_pos_gelesen_A /end MEASUREMENT
/begin MEASUREMENT iKupA.kolben_posbas "Position, bei der der Kolben gestartet ist" UWORD UMR_PROZENT__1_100_0_S5_S3 1 100 0 100 ECU_ADDRESS 0xFFF8BC44 DISPLAY_IDENTIFIER kolben_posbas_A /end MEASUREMENT
/begin MEASUREMENT iKupA.kpl_inaktiv "Flag, ob Kupplung inaktiv ist" UBYTE Conv.cModKuppl._.kpl_inaktiv_S5_S3 1 100 0 1 BIT_MASK 0x1 ECU_ADDRESS 0xFFF8BC4D DISPLAY_IDENTIFIER kpl_inaktiv_A /end MEASUREMENT
/begin MEASUREMENT iKupA.kup_index_spsas "Der Spontanitaetsindex dieser Kupplung" UBYTE Conv.cModKuppl._.kup_index_spsas_S5_S3 1 100 0 2 ECU_ADDRESS 0xFFF8BC4A DISPLAY_IDENTIFIER kup_index_spsas_A /end MEASUREMENT
/begin MEASUREMENT iKupA.kup_schaltart_sas "Die Schaltart dieser Kupplung (für Bestimmung offset auf SF-Zeit)" UBYTE Conv.cModKuppl._.kup_schaltart_sas_S5_S3 1 100 0 5 ECU_ADDRESS 0xFFF8BC49 DISPLAY_IDENTIFIER kup_schaltart_sas_A /end MEASUREMENT
/begin MEASUREMENT iKupA.kv_nummer "Die Kupplungsventilnummer" UBYTE UMR___1_1_0_S5_S3 1 100 0 9 ECU_ADDRESS 0xFFF8BC48 DISPLAY_IDENTIFIER kv_nummer_A /end MEASUREMENT
/begin MEASUREMENT iKupA.n_kup_zbeg "Die Kupplungsdrehzahl zu beginn des Zustandes" UWORD UMR_U_MIN_1_1_0_S5_S3 1 100 0 8160 ECU_ADDRESS 0xFFF8BC46 DISPLAY_IDENTIFIER n_kup_zbeg_A /end MEASUREMENT
/begin MEASUREMENT iKupA.p_absist "Istdruck der Kupplung" UWORD UMR_BAR__1_1000_0_S5_S3 1 100 0 20 ECU_ADDRESS 0xFFF8BC3C DISPLAY_IDENTIFIER p_absist_A /end MEASUREMENT
/begin MEASUREMENT iKupA.p_filter.letzter_ms_timer "letzter BS-Timer" UWORD UMR_MSEC__1_1_0_S5_S3 1 100 0 65535 ECU_ADDRESS 0xFFF8BC18 DISPLAY_IDENTIFIER letzter_ms_timer.p_filter.iKupA /end MEASUREMENT
/begin MEASUREMENT iKupA.p_filter.x "letzter Wert" SLONG UMR___1_1_0_S5_S3 1 100 -2147483648 2147483647 ECU_ADDRESS 0xFFF8BC14 DISPLAY_IDENTIFIER x.p_filter.iKupA /end MEASUREMENT
/begin MEASUREMENT iKupA.p_fmin "minimale Fülldruck der Kupplung" UWORD UMR_BAR__1_1000_0_S5_S3 1 100 0 20 ECU_ADDRESS 0xFFF8BC3E DISPLAY_IDENTIFIER p_fmin_A /end MEASUREMENT
/begin MEASUREMENT iKupA.t0_sf "Gesamtschnellfüllzeit" UWORD UMR_MSEC__1_1_0_S5_S3 1 100 0 20000 ECU_ADDRESS 0xFFF8BC34 DISPLAY_IDENTIFIER t0_sf_A /end MEASUREMENT
/begin MEASUREMENT iKupA.t_kpl_aktiv.timer "Der aktuelle Timerwert" ULONG UMR_MSEC__10_1_0_S5_S3 1 100 0 42949672950 ECU_ADDRESS 0xFFF8BC20 DISPLAY_IDENTIFIER t_kpl_aktiv.iKupA /end MEASUREMENT
/begin MEASUREMENT iKupA.t_kpl_inaktiv.timer "Der aktuelle Timerwert" ULONG UMR_MSEC__10_1_0_S5_S3 1 100 0 42949672950 ECU_ADDRESS 0xFFF8BC24 DISPLAY_IDENTIFIER t_kpl_inaktiv.iKupA /end MEASUREMENT
/begin MEASUREMENT iKupA.t_lauf_entleer "Kolbenlaufzeit beim leeren" UWORD UMR_MSEC__1_1_0_S5_S3 1 100 0 20000 ECU_ADDRESS 0xFFF8BC3A DISPLAY_IDENTIFIER t_lauf_entleer_A /end MEASUREMENT
/begin MEASUREMENT iKupA.t_lauf_fuell "Kolbenlaufzeit beim füllen" UWORD UMR_MSEC__1_1_0_S5_S3 1 100 0 20000 ECU_ADDRESS 0xFFF8BC38 DISPLAY_IDENTIFIER t_lauf_fuell_A /end MEASUREMENT
/begin MEASUREMENT iKupA.timer_sas_ende_mit_pmax.timer "Der aktuelle Timerwert" UBYTE UMR_MSEC__10_1_0_S5_S3 1 100 0 2550 ECU_ADDRESS 0xFFF8BC1E DISPLAY_IDENTIFIER timer_sas_ende_mit_pmax.iKupA /end MEASUREMENT
/begin MEASUREMENT iKupA.totzeit "Die Totzeit" UWORD UMR_MSEC__1_1_0_S5_S3 1 100 0 2000 ECU_ADDRESS 0xFFF8BC36 DISPLAY_IDENTIFIER totzeit_A /end MEASUREMENT
/begin MEASUREMENT iKupA.zustand "Der Zustand" UBYTE Conv.cModKuppl._.zustand_S5_S3 1 100 0 5 ECU_ADDRESS 0xFFF8BC32 DISPLAY_IDENTIFIER zustand_A /end MEASUREMENT
/begin MEASUREMENT iKupA.zustandstimer.timer "Der aktuelle Timerwert" UWORD UMR_MSEC__1_1_0_S5_S3 1 100 0 65535 ECU_ADDRESS 0xFFF8BC1C DISPLAY_IDENTIFIER zustandstimer.iKupA /end MEASUREMENT
/begin MEASUREMENT iKupB.cModPVorg._.f_anst_statisch "Flag für die statische Ansteuerung" UBYTE Conv.cModPVorg._.f_anst_statisch_S5_S3 1 100 0 1 BIT_MASK 0x1 ECU_ADDRESS 0xFFF8BC63 DISPLAY_IDENTIFIER f_anst_statisch_B /end MEASUREMENT
/begin MEASUREMENT iKupB.cModPVorg._.f_druck_vorgegeben "Flag, ob Druck an dieses Element in diesem Zyklus schon vorgegeben wurde" UBYTE Conv.cModPVorg._.f_druck_vorgegeben_S5_S3 1 100 0 1 BIT_MASK 0x1 ECU_ADDRESS 0xFFF8BC62 DISPLAY_IDENTIFIER f_druck_vorgegeben_B /end MEASUREMENT
/begin MEASUREMENT iKupB.cModPVorg._.fktn_druckvorgabe "Die ansteuernde Funktion" UBYTE Conv.cModPVorg._.fktn_druckvorgabe_S5_S3 1 100 0 29 ECU_ADDRESS 0xFFF8BC64 DISPLAY_IDENTIFIER fktn_druckvorgabe_B /end MEASUREMENT
/begin MEASUREMENT iKupB.cModPVorg._.p_abssoll "Solldruck der Kupplung" UWORD UMR_BAR__1_1000_0_S5_S3 1 100 0 20 ECU_ADDRESS 0xFFF8BC5E DISPLAY_IDENTIFIER p_abssoll_B /end MEASUREMENT
/begin MEASUREMENT iKupB.cModPVorg._.p_abssoll_sys "Solldruck der Kupplung, begrentzt auf Systemdruck" UWORD UMR_BAR__1_1000_0_S5_S3 1 100 0 20 ECU_ADDRESS 0xFFF8BC60 DISPLAY_IDENTIFIER p_abssoll_sys_B /end MEASUREMENT
/begin MEASUREMENT iKupB.cModPVorg._.p_vorgabe "Solldruck der Kupplung" UWORD UMR_BAR__1_1000_0_S5_S3 1 100 0 20 ECU_ADDRESS 0xFFF8BC5C DISPLAY_IDENTIFIER p_vorgabe_B /end MEASUREMENT
/begin MEASUREMENT iKupB.cModPVorg._.typ_druckvorgabe "Der Typ des angesteuerten Druckes" UBYTE Conv.cModPVorg._.typ_druckvorgabe_S5_S3 1 100 0 4 ECU_ADDRESS 0xFFF8BC65 DISPLAY_IDENTIFIER typ_druckvorgabe_B /end MEASUREMENT
/begin MEASUREMENT iKupB.f_erste_bef "Flag für erste Befüllung" UBYTE Conv.cModKuppl._.f_erste_bef_S5_S3 1 100 0 1 BIT_MASK 0x1 ECU_ADDRESS 0xFFF8BCAE DISPLAY_IDENTIFIER f_erste_bef_B /end MEASUREMENT
/begin MEASUREMENT iKupB.f_erste_bef_aus_sb "Flag für erste Befüllung aus standby" UBYTE Conv.cModKuppl._.f_erste_bef_aus_sb_S5_S3 1 100 0 1 BIT_MASK 0x1 ECU_ADDRESS 0xFFF8BCAF DISPLAY_IDENTIFIER f_erste_bef_aus_sb_B /end MEASUREMENT
/begin MEASUREMENT iKupB.f_fuellopt "Flag für optimierte Befüllung" UBYTE Conv.cModKuppl._.f_fuellopt_S5_S3 1 100 0 1 BIT_MASK 0x1 ECU_ADDRESS 0xFFF8BCAB DISPLAY_IDENTIFIER f_fuellopt_B /end MEASUREMENT
/begin MEASUREMENT iKupB.f_fuellred "Flag für reduzierte Befüllung" UBYTE Conv.cModKuppl._.f_fuellred_S5_S3 1 100 0 1 BIT_MASK 0x1 ECU_ADDRESS 0xFFF8BCAA DISPLAY_IDENTIFIER f_fuellred_B /end MEASUREMENT
/begin MEASUREMENT iKupB.f_geschlossen "Flag für Kupplung geschlossen" UBYTE Conv.cModKuppl._.f_geschlossen_S5_S3 1 100 0 1 BIT_MASK 0x1 ECU_ADDRESS 0xFFF8BCAD DISPLAY_IDENTIFIER f_geschlossen_B /end MEASUREMENT
/begin MEASUREMENT iKupB.f_kolben_anlegen "Flag für Kolben anlegen" UBYTE Conv.cModKuppl._.f_kolben_anlegen_S5_S3 1 100 0 1 BIT_MASK 0x1 ECU_ADDRESS 0xFFF8BCAC DISPLAY_IDENTIFIER f_kolben_anlegen_B /end MEASUREMENT
/begin MEASUREMENT iKupB.f_sf_ausgabe_aktiv "Flag für Schnellfüllung" UBYTE Conv.cModKuppl._.f_sf_ausgabe_aktiv_S5_S3 1 100 0 1 BIT_MASK 0x1 ECU_ADDRESS 0xFFF8BCA7 DISPLAY_IDENTIFIER f_sf_ausgabe_aktiv_B /end MEASUREMENT
/begin MEASUREMENT iKupB.f_sf_vorhanden "Flag für ausgegebene SF" UBYTE Conv.cModKuppl._.f_sf_vorhanden_S5_S3 1 100 0 1 BIT_MASK 0x1 ECU_ADDRESS 0xFFF8BCA8 DISPLAY_IDENTIFIER f_sf_vorhanden_B /end MEASUREMENT
/begin MEASUREMENT iKupB.f_strom_pre_puls_erf "Flag für Stromprepuls" UBYTE Conv.cModKuppl._.f_strom_pre_puls_erf_S5_S3 1 100 0 1 BIT_MASK 0x1 ECU_ADDRESS 0xFFF8BCB0 DISPLAY_IDENTIFIER f_strom_pre_puls_erf_B /end MEASUREMENT
/begin MEASUREMENT iKupB.f_stromschl_angefordert "Flag zum ausführen der Stromschleife" UBYTE Conv.cModKuppl._.f_stromschl_angefordert_S5_S3 1 100 0 1 BIT_MASK 0x1 ECU_ADDRESS 0xFFF8BCB1 DISPLAY_IDENTIFIER f_stromschl_angefordert_B /end MEASUREMENT
/begin MEASUREMENT iKupB.kolben_pos "Die aktuelle Kolbenposition" UWORD UMR_PROZENT__1_100_0_S5_S3 1 100 0 100 ECU_ADDRESS 0xFFF8BC9C DISPLAY_IDENTIFIER kolben_pos_B /end MEASUREMENT
/begin MEASUREMENT iKupB.kolben_pos_gelesen "Die aktuelle Kolbenposition wurde aus dem EEPROM gelesen" UBYTE Conv.cModKuppl._.kolben_pos_gelesen_S5_S3 1 100 0 1 BIT_MASK 0x1 ECU_ADDRESS 0xFFF8BC9E DISPLAY_IDENTIFIER kolben_pos_gelesen_B /end MEASUREMENT
/begin MEASUREMENT iKupB.kolben_posbas "Position, bei der der Kolben gestartet ist" UWORD UMR_PROZENT__1_100_0_S5_S3 1 100 0 100 ECU_ADDRESS 0xFFF8BCA0 DISPLAY_IDENTIFIER kolben_posbas_B /end MEASUREMENT
/begin MEASUREMENT iKupB.kpl_inaktiv "Flag, ob Kupplung inaktiv ist" UBYTE Conv.cModKuppl._.kpl_inaktiv_S5_S3 1 100 0 1 BIT_MASK 0x1 ECU_ADDRESS 0xFFF8BCA9 DISPLAY_IDENTIFIER kpl_inaktiv_B /end MEASUREMENT
/begin MEASUREMENT iKupB.kup_index_spsas "Der Spontanitaetsindex dieser Kupplung" UBYTE Conv.cModKuppl._.kup_index_spsas_S5_S3 1 100 0 2 ECU_ADDRESS 0xFFF8BCA6 DISPLAY_IDENTIFIER kup_index_spsas_B /end MEASUREMENT
/begin MEASUREMENT iKupB.kup_schaltart_sas "Die Schaltart dieser Kupplung (für Bestimmung offset auf SF-Zeit)" UBYTE Conv.cModKuppl._.kup_schaltart_sas_S5_S3 1 100 0 5 ECU_ADDRESS 0xFFF8BCA5 DISPLAY_IDENTIFIER kup_schaltart_sas_B /end MEASUREMENT
/begin MEASUREMENT iKupB.kv_nummer "Die Kupplungsventilnummer" UBYTE UMR___1_1_0_S5_S3 1 100 0 9 ECU_ADDRESS 0xFFF8BCA4 DISPLAY_IDENTIFIER kv_nummer_B /end MEASUREMENT
/begin MEASUREMENT iKupB.n_kup_zbeg "Die Kupplungsdrehzahl zu beginn des Zustandes" UWORD UMR_U_MIN_1_1_0_S5_S3 1 100 0 8160 ECU_ADDRESS 0xFFF8BCA2 DISPLAY_IDENTIFIER n_kup_zbeg_B /end MEASUREMENT
/begin MEASUREMENT iKupB.p_absist "Istdruck der Kupplung" UWORD UMR_BAR__1_1000_0_S5_S3 1 100 0 20 ECU_ADDRESS 0xFFF8BC98 DISPLAY_IDENTIFIER p_absist_B /end MEASUREMENT
/begin MEASUREMENT iKupB.p_filter.letzter_ms_timer "letzter BS-Timer" UWORD UMR_MSEC__1_1_0_S5_S3 1 100 0 65535 ECU_ADDRESS 0xFFF8BC74 DISPLAY_IDENTIFIER letzter_ms_timer.p_filter.iKupB /end MEASUREMENT
/begin MEASUREMENT iKupB.p_filter.x "letzter Wert" SLONG UMR___1_1_0_S5_S3 1 100 -2147483648 2147483647 ECU_ADDRESS 0xFFF8BC70 DISPLAY_IDENTIFIER x.p_filter.iKupB /end MEASUREMENT
/begin MEASUREMENT iKupB.p_fmin "minimale Fülldruck der Kupplung" UWORD UMR_BAR__1_1000_0_S5_S3 1 100 0 20 ECU_ADDRESS 0xFFF8BC9A DISPLAY_IDENTIFIER p_fmin_B /end MEASUREMENT
/begin MEASUREMENT iKupB.t0_sf "Gesamtschnellfüllzeit" UWORD UMR_MSEC__1_1_0_S5_S3 1 100 0 20000 ECU_ADDRESS 0xFFF8BC90 DISPLAY_IDENTIFIER t0_sf_B /end MEASUREMENT
/begin MEASUREMENT iKupB.t_kpl_aktiv.timer "Der aktuelle Timerwert" ULONG UMR_MSEC__10_1_0_S5_S3 1 100 0 42949672950 ECU_ADDRESS 0xFFF8BC7C DISPLAY_IDENTIFIER t_kpl_aktiv.iKupB /end MEASUREMENT
/begin MEASUREMENT iKupB.t_kpl_inaktiv.timer "Der aktuelle Timerwert" ULONG UMR_MSEC__10_1_0_S5_S3 1 100 0 42949672950 ECU_ADDRESS 0xFFF8BC80 DISPLAY_IDENTIFIER t_kpl_inaktiv.iKupB /end MEASUREMENT
/begin MEASUREMENT iKupB.t_lauf_entleer "Kolbenlaufzeit beim leeren" UWORD UMR_MSEC__1_1_0_S5_S3 1 100 0 20000 ECU_ADDRESS 0xFFF8BC96 DISPLAY_IDENTIFIER t_lauf_entleer_B /end MEASUREMENT
/begin MEASUREMENT iKupB.t_lauf_fuell "Kolbenlaufzeit beim füllen" UWORD UMR_MSEC__1_1_0_S5_S3 1 100 0 20000 ECU_ADDRESS 0xFFF8BC94 DISPLAY_IDENTIFIER t_lauf_fuell_B /end MEASUREMENT
/begin MEASUREMENT iKupB.timer_sas_ende_mit_pmax.timer "Der aktuelle Timerwert" UBYTE UMR_MSEC__10_1_0_S5_S3 1 100 0 2550 ECU_ADDRESS 0xFFF8BC7A DISPLAY_IDENTIFIER timer_sas_ende_mit_pmax.iKupB /end MEASUREMENT
/begin MEASUREMENT iKupB.totzeit "Die Totzeit" UWORD UMR_MSEC__1_1_0_S5_S3 1 100 0 2000 ECU_ADDRESS 0xFFF8BC92 DISPLAY_IDENTIFIER totzeit_B /end MEASUREMENT
/begin MEASUREMENT iKupB.zustand "Der Zustand" UBYTE Conv.cModKuppl._.zustand_S5_S3 1 100 0 5 ECU_ADDRESS 0xFFF8BC8E DISPLAY_IDENTIFIER zustand_B /end MEASUREMENT
/begin MEASUREMENT iKupB.zustandstimer.timer "Der aktuelle Timerwert" UWORD UMR_MSEC__1_1_0_S5_S3 1 100 0 65535 ECU_ADDRESS 0xFFF8BC78 DISPLAY_IDENTIFIER zustandstimer.iKupB /end MEASUREMENT
/begin MEASUREMENT iKupC.cModPVorg._.f_anst_statisch "Flag für die statische Ansteuerung" UBYTE Conv.cModPVorg._.f_anst_statisch_S5_S3 1 100 0 1 BIT_MASK 0x1 ECU_ADDRESS 0xFFF8BCBF DISPLAY_IDENTIFIER f_anst_statisch_C /end MEASUREMENT
/begin MEASUREMENT iKupC.cModPVorg._.f_druck_vorgegeben "Flag, ob Druck an dieses Element in diesem Zyklus schon vorgegeben wurde" UBYTE Conv.cModPVorg._.f_druck_vorgegeben_S5_S3 1 100 0 1 BIT_MASK 0x1 ECU_ADDRESS 0xFFF8BCBE DISPLAY_IDENTIFIER f_druck_vorgegeben_C /end MEASUREMENT
/begin MEASUREMENT iKupC.cModPVorg._.fktn_druckvorgabe "Die ansteuernde Funktion" UBYTE Conv.cModPVorg._.fktn_druckvorgabe_S5_S3 1 100 0 29 ECU_ADDRESS 0xFFF8BCC0 DISPLAY_IDENTIFIER fktn_druckvorgabe_C /end MEASUREMENT
/begin MEASUREMENT iKupC.cModPVorg._.p_abssoll "Solldruck der Kupplung" UWORD UMR_BAR__1_1000_0_S5_S3 1 100 0 20 ECU_ADDRESS 0xFFF8BCBA DISPLAY_IDENTIFIER p_abssoll_C /end MEASUREMENT
/begin MEASUREMENT iKupC.cModPVorg._.p_abssoll_sys "Solldruck der Kupplung, begrentzt auf Systemdruck" UWORD UMR_BAR__1_1000_0_S5_S3 1 100 0 20 ECU_ADDRESS 0xFFF8BCBC DISPLAY_IDENTIFIER p_abssoll_sys_C /end MEASUREMENT
/begin MEASUREMENT iKupC.cModPVorg._.p_vorgabe "Solldruck der Kupplung" UWORD UMR_BAR__1_1000_0_S5_S3 1 100 0 20 ECU_ADDRESS 0xFFF8BCB8 DISPLAY_IDENTIFIER p_vorgabe_C /end MEASUREMENT
/begin MEASUREMENT iKupC.cModPVorg._.typ_druckvorgabe "Der Typ des angesteuerten Druckes" UBYTE Conv.cModPVorg._.typ_druckvorgabe_S5_S3 1 100 0 4 ECU_ADDRESS 0xFFF8BCC1 DISPLAY_IDENTIFIER typ_druckvorgabe_C /end MEASUREMENT
/begin MEASUREMENT iKupC.f_erste_bef "Flag für erste Befüllung" UBYTE Conv.cModKuppl._.f_erste_bef_S5_S3 1 100 0 1 BIT_MASK 0x1 ECU_ADDRESS 0xFFF8BD0A DISPLAY_IDENTIFIER f_erste_bef_C /end MEASUREMENT
/begin MEASUREMENT iKupC.f_erste_bef_aus_sb "Flag für erste Befüllung aus standby" UBYTE Conv.cModKuppl._.f_erste_bef_aus_sb_S5_S3 1 100 0 1 BIT_MASK 0x1 ECU_ADDRESS 0xFFF8BD0B DISPLAY_IDENTIFIER f_erste_bef_aus_sb_C /end MEASUREMENT
/begin MEASUREMENT iKupC.f_fuellopt "Flag für optimierte Befüllung" UBYTE Conv.cModKuppl._.f_fuellopt_S5_S3 1 100 0 1 BIT_MASK 0x1 ECU_ADDRESS 0xFFF8BD07 DISPLAY_IDENTIFIER f_fuellopt_C /end MEASUREMENT
/begin MEASUREMENT iKupC.f_fuellred "Flag für reduzierte Befüllung" UBYTE Conv.cModKuppl._.f_fuellred_S5_S3 1 100 0 1 BIT_MASK 0x1 ECU_ADDRESS 0xFFF8BD06 DISPLAY_IDENTIFIER f_fuellred_C /end MEASUREMENT
/begin MEASUREMENT iKupC.f_geschlossen "Flag für Kupplung geschlossen" UBYTE Conv.cModKuppl._.f_geschlossen_S5_S3 1 100 0 1 BIT_MASK 0x1 ECU_ADDRESS 0xFFF8BD09 DISPLAY_IDENTIFIER f_geschlossen_C /end MEASUREMENT
/begin MEASUREMENT iKupC.f_kolben_anlegen "Flag für Kolben anlegen" UBYTE Conv.cModKuppl._.f_kolben_anlegen_S5_S3 1 100 0 1 BIT_MASK 0x1 ECU_ADDRESS 0xFFF8BD08 DISPLAY_IDENTIFIER f_kolben_anlegen_C /end MEASUREMENT
/begin MEASUREMENT iKupC.f_sf_ausgabe_aktiv "Flag für Schnellfüllung" UBYTE Conv.cModKuppl._.f_sf_ausgabe_aktiv_S5_S3 1 100 0 1 BIT_MASK 0x1 ECU_ADDRESS 0xFFF8BD03 DISPLAY_IDENTIFIER f_sf_ausgabe_aktiv_C /end MEASUREMENT
/begin MEASUREMENT iKupC.f_sf_vorhanden "Flag für ausgegebene SF" UBYTE Conv.cModKuppl._.f_sf_vorhanden_S5_S3 1 100 0 1 BIT_MASK 0x1 ECU_ADDRESS 0xFFF8BD04 DISPLAY_IDENTIFIER f_sf_vorhanden_C /end MEASUREMENT
/begin MEASUREMENT iKupC.f_strom_pre_puls_erf "Flag für Stromprepuls" UBYTE Conv.cModKuppl._.f_strom_pre_puls_erf_S5_S3 1 100 0 1 BIT_MASK 0x1 ECU_ADDRESS 0xFFF8BD0C DISPLAY_IDENTIFIER f_strom_pre_puls_erf_C /end MEASUREMENT
/begin MEASUREMENT iKupC.f_stromschl_angefordert "Flag zum ausführen der Stromschleife" UBYTE Conv.cModKuppl._.f_stromschl_angefordert_S5_S3 1 100 0 1 BIT_MASK 0x1 ECU_ADDRESS 0xFFF8BD0D DISPLAY_IDENTIFIER f_stromschl_angefordert_C /end MEASUREMENT
/begin MEASUREMENT iKupC.kolben_pos "Die aktuelle Kolbenposition" UWORD UMR_PROZENT__1_100_0_S5_S3 1 100 0 100 ECU_ADDRESS 0xFFF8BCF8 DISPLAY_IDENTIFIER kolben_pos_C /end MEASUREMENT
/begin MEASUREMENT iKupC.kolben_pos_gelesen "Die aktuelle Kolbenposition wurde aus dem EEPROM gelesen" UBYTE Conv.cModKuppl._.kolben_pos_gelesen_S5_S3 1 100 0 1 BIT_MASK 0x1 ECU_ADDRESS 0xFFF8BCFA DISPLAY_IDENTIFIER kolben_pos_gelesen_C /end MEASUREMENT
/begin MEASUREMENT iKupC.kolben_posbas "Position, bei der der Kolben gestartet ist" UWORD UMR_PROZENT__1_100_0_S5_S3 1 100 0 100 ECU_ADDRESS 0xFFF8BCFC DISPLAY_IDENTIFIER kolben_posbas_C /end MEASUREMENT
/begin MEASUREMENT iKupC.kpl_inaktiv "Flag, ob Kupplung inaktiv ist" UBYTE Conv.cModKuppl._.kpl_inaktiv_S5_S3 1 100 0 1 BIT_MASK 0x1 ECU_ADDRESS 0xFFF8BD05 DISPLAY_IDENTIFIER kpl_inaktiv_C /end MEASUREMENT
/begin MEASUREMENT iKupC.kup_index_spsas "Der Spontanitaetsindex dieser Kupplung" UBYTE Conv.cModKuppl._.kup_index_spsas_S5_S3 1 100 0 2 ECU_ADDRESS 0xFFF8BD02 DISPLAY_IDENTIFIER kup_index_spsas_C /end MEASUREMENT
/begin MEASUREMENT iKupC.kup_schaltart_sas "Die Schaltart dieser Kupplung (für Bestimmung offset auf SF-Zeit)" UBYTE Conv.cModKuppl._.kup_schaltart_sas_S5_S3 1 100 0 5 ECU_ADDRESS 0xFFF8BD01 DISPLAY_IDENTIFIER kup_schaltart_sas_C /end MEASUREMENT
/begin MEASUREMENT iKupC.kv_nummer "Die Kupplungsventilnummer" UBYTE UMR___1_1_0_S5_S3 1 100 0 9 ECU_ADDRESS 0xFFF8BD00 DISPLAY_IDENTIFIER kv_nummer_C /end MEASUREMENT
/begin MEASUREMENT iKupC.n_kup_zbeg "Die Kupplungsdrehzahl zu beginn des Zustandes" UWORD UMR_U_MIN_1_1_0_S5_S3 1 100 0 8160 ECU_ADDRESS 0xFFF8BCFE DISPLAY_IDENTIFIER n_kup_zbeg_C /end MEASUREMENT
/begin MEASUREMENT iKupC.p_absist "Istdruck der Kupplung" UWORD UMR_BAR__1_1000_0_S5_S3 1 100 0 20 ECU_ADDRESS 0xFFF8BCF4 DISPLAY_IDENTIFIER p_absist_C /end MEASUREMENT
/begin MEASUREMENT iKupC.p_filter.letzter_ms_timer "letzter BS-Timer" UWORD UMR_MSEC__1_1_0_S5_S3 1 100 0 65535 ECU_ADDRESS 0xFFF8BCD0 DISPLAY_IDENTIFIER letzter_ms_timer.p_filter.iKupC /end MEASUREMENT
/begin MEASUREMENT iKupC.p_filter.x "letzter Wert" SLONG UMR___1_1_0_S5_S3 1 100 -2147483648 2147483647 ECU_ADDRESS 0xFFF8BCCC DISPLAY_IDENTIFIER x.p_filter.iKupC /end MEASUREMENT
/begin MEASUREMENT iKupC.p_fmin "minimale Fülldruck der Kupplung" UWORD UMR_BAR__1_1000_0_S5_S3 1 100 0 20 ECU_ADDRESS 0xFFF8BCF6 DISPLAY_IDENTIFIER p_fmin_C /end MEASUREMENT
/begin MEASUREMENT iKupC.t0_sf "Gesamtschnellfüllzeit" UWORD UMR_MSEC__1_1_0_S5_S3 1 100 0 20000 ECU_ADDRESS 0xFFF8BCEC DISPLAY_IDENTIFIER t0_sf_C /end MEASUREMENT
/begin MEASUREMENT iKupC.t_kpl_aktiv.timer "Der aktuelle Timerwert" ULONG UMR_MSEC__10_1_0_S5_S3 1 100 0 42949672950 ECU_ADDRESS 0xFFF8BCD8 DISPLAY_IDENTIFIER t_kpl_aktiv.iKupC /end MEASUREMENT
/begin MEASUREMENT iKupC.t_kpl_inaktiv.timer "Der aktuelle Timerwert" ULONG UMR_MSEC__10_1_0_S5_S3 1 100 0 42949672950 ECU_ADDRESS 0xFFF8BCDC DISPLAY_IDENTIFIER t_kpl_inaktiv.iKupC /end MEASUREMENT
/begin MEASUREMENT iKupC.t_lauf_entleer "Kolbenlaufzeit beim leeren" UWORD UMR_MSEC__1_1_0_S5_S3 1 100 0 20000 ECU_ADDRESS 0xFFF8BCF2 DISPLAY_IDENTIFIER t_lauf_entleer_C /end MEASUREMENT
/begin MEASUREMENT iKupC.t_lauf_fuell "Kolbenlaufzeit beim füllen" UWORD UMR_MSEC__1_1_0_S5_S3 1 100 0 20000 ECU_ADDRESS 0xFFF8BCF0 DISPLAY_IDENTIFIER t_lauf_fuell_C /end MEASUREMENT
/begin MEASUREMENT iKupC.timer_sas_ende_mit_pmax.timer "Der aktuelle Timerwert" UBYTE UMR_MSEC__10_1_0_S5_S3 1 100 0 2550 ECU_ADDRESS 0xFFF8BCD6 DISPLAY_IDENTIFIER timer_sas_ende_mit_pmax.iKupC /end MEASUREMENT
/begin MEASUREMENT iKupC.totzeit "Die Totzeit" UWORD UMR_MSEC__1_1_0_S5_S3 1 100 0 2000 ECU_ADDRESS 0xFFF8BCEE DISPLAY_IDENTIFIER totzeit_C /end MEASUREMENT
/begin MEASUREMENT iKupC.zustand "Der Zustand" UBYTE Conv.cModKuppl._.zustand_S5_S3 1 100 0 5 ECU_ADDRESS 0xFFF8BCEA DISPLAY_IDENTIFIER zustand_C /end MEASUREMENT
/begin MEASUREMENT iKupC.zustandstimer.timer "Der aktuelle Timerwert" UWORD UMR_MSEC__1_1_0_S5_S3 1 100 0 65535 ECU_ADDRESS 0xFFF8BCD4 DISPLAY_IDENTIFIER zustandstimer.iKupC /end MEASUREMENT
/begin MEASUREMENT iKupD.cModPVorg._.f_anst_statisch "Flag für die statische Ansteuerung" UBYTE Conv.cModPVorg._.f_anst_statisch_S5_S3 1 100 0 1 BIT_MASK 0x1 ECU_ADDRESS 0xFFF8BD1B DISPLAY_IDENTIFIER f_anst_statisch_D /end MEASUREMENT
/begin MEASUREMENT iKupD.cModPVorg._.f_druck_vorgegeben "Flag, ob Druck an dieses Element in diesem Zyklus schon vorgegeben wurde" UBYTE Conv.cModPVorg._.f_druck_vorgegeben_S5_S3 1 100 0 1 BIT_MASK 0x1 ECU_ADDRESS 0xFFF8BD1A DISPLAY_IDENTIFIER f_druck_vorgegeben_D /end MEASUREMENT
/begin MEASUREMENT iKupD.cModPVorg._.fktn_druckvorgabe "Die ansteuernde Funktion" UBYTE Conv.cModPVorg._.fktn_druckvorgabe_S5_S3 1 100 0 29 ECU_ADDRESS 0xFFF8BD1C DISPLAY_IDENTIFIER fktn_druckvorgabe_D /end MEASUREMENT
/begin MEASUREMENT iKupD.cModPVorg._.p_abssoll "Solldruck der Kupplung" UWORD UMR_BAR__1_1000_0_S5_S3 1 100 0 20 ECU_ADDRESS 0xFFF8BD16 DISPLAY_IDENTIFIER p_abssoll_D /end MEASUREMENT
/begin MEASUREMENT iKupD.cModPVorg._.p_abssoll_sys "Solldruck der Kupplung, begrentzt auf Systemdruck" UWORD UMR_BAR__1_1000_0_S5_S3 1 100 0 20 ECU_ADDRESS 0xFFF8BD18 DISPLAY_IDENTIFIER p_abssoll_sys_D /end MEASUREMENT
/begin MEASUREMENT iKupD.cModPVorg._.p_vorgabe "Solldruck der Kupplung" UWORD UMR_BAR__1_1000_0_S5_S3 1 100 0 20 ECU_ADDRESS 0xFFF8BD14 DISPLAY_IDENTIFIER p_vorgabe_D /end MEASUREMENT
/begin MEASUREMENT iKupD.cModPVorg._.typ_druckvorgabe "Der Typ des angesteuerten Druckes" UBYTE Conv.cModPVorg._.typ_druckvorgabe_S5_S3 1 100 0 4 ECU_ADDRESS 0xFFF8BD1D DISPLAY_IDENTIFIER typ_druckvorgabe_D /end MEASUREMENT
/begin MEASUREMENT iKupD.f_erste_bef "Flag für erste Befüllung" UBYTE Conv.cModKuppl._.f_erste_bef_S5_S3 1 100 0 1 BIT_MASK 0x1 ECU_ADDRESS 0xFFF8BD66 DISPLAY_IDENTIFIER f_erste_bef_D /end MEASUREMENT
/begin MEASUREMENT iKupD.f_erste_bef_aus_sb "Flag für erste Befüllung aus standby" UBYTE Conv.cModKuppl._.f_erste_bef_aus_sb_S5_S3 1 100 0 1 BIT_MASK 0x1 ECU_ADDRESS 0xFFF8BD67 DISPLAY_IDENTIFIER f_erste_bef_aus_sb_D /end MEASUREMENT
/begin MEASUREMENT iKupD.f_fuellopt "Flag für optimierte Befüllung" UBYTE Conv.cModKuppl._.f_fuellopt_S5_S3 1 100 0 1 BIT_MASK 0x1 ECU_ADDRESS 0xFFF8BD63 DISPLAY_IDENTIFIER f_fuellopt_D /end MEASUREMENT
/begin MEASUREMENT iKupD.f_fuellred "Flag für reduzierte Befüllung" UBYTE Conv.cModKuppl._.f_fuellred_S5_S3 1 100 0 1 BIT_MASK 0x1 ECU_ADDRESS 0xFFF8BD62 DISPLAY_IDENTIFIER f_fuellred_D /end MEASUREMENT
/begin MEASUREMENT iKupD.f_geschlossen "Flag für Kupplung geschlossen" UBYTE Conv.cModKuppl._.f_geschlossen_S5_S3 1 100 0 1 BIT_MASK 0x1 ECU_ADDRESS 0xFFF8BD65 DISPLAY_IDENTIFIER f_geschlossen_D /end MEASUREMENT
/begin MEASUREMENT iKupD.f_kolben_anlegen "Flag für Kolben anlegen" UBYTE Conv.cModKuppl._.f_kolben_anlegen_S5_S3 1 100 0 1 BIT_MASK 0x1 ECU_ADDRESS 0xFFF8BD64 DISPLAY_IDENTIFIER f_kolben_anlegen_D /end MEASUREMENT
/begin MEASUREMENT iKupD.f_sf_ausgabe_aktiv "Flag für Schnellfüllung" UBYTE Conv.cModKuppl._.f_sf_ausgabe_aktiv_S5_S3 1 100 0 1 BIT_MASK 0x1 ECU_ADDRESS 0xFFF8BD5F DISPLAY_IDENTIFIER f_sf_ausgabe_aktiv_D /end MEASUREMENT
/begin MEASUREMENT iKupD.f_sf_vorhanden "Flag für ausgegebene SF" UBYTE Conv.cModKuppl._.f_sf_vorhanden_S5_S3 1 100 0 1 BIT_MASK 0x1 ECU_ADDRESS 0xFFF8BD60 DISPLAY_IDENTIFIER f_sf_vorhanden_D /end MEASUREMENT
/begin MEASUREMENT iKupD.f_strom_pre_puls_erf "Flag für Stromprepuls" UBYTE Conv.cModKuppl._.f_strom_pre_puls_erf_S5_S3 1 100 0 1 BIT_MASK 0x1 ECU_ADDRESS 0xFFF8BD68 DISPLAY_IDENTIFIER f_strom_pre_puls_erf_D /end MEASUREMENT
/begin MEASUREMENT iKupD.f_stromschl_angefordert "Flag zum ausführen der Stromschleife" UBYTE Conv.cModKuppl._.f_stromschl_angefordert_S5_S3 1 100 0 1 BIT_MASK 0x1 ECU_ADDRESS 0xFFF8BD69 DISPLAY_IDENTIFIER f_stromschl_angefordert_D /end MEASUREMENT
/begin MEASUREMENT iKupD.kolben_pos "Die aktuelle Kolbenposition" UWORD UMR_PROZENT__1_100_0_S5_S3 1 100 0 100 ECU_ADDRESS 0xFFF8BD54 DISPLAY_IDENTIFIER kolben_pos_D /end MEASUREMENT
/begin MEASUREMENT iKupD.kolben_pos_gelesen "Die aktuelle Kolbenposition wurde aus dem EEPROM gelesen" UBYTE Conv.cModKuppl._.kolben_pos_gelesen_S5_S3 1 100 0 1 BIT_MASK 0x1 ECU_ADDRESS 0xFFF8BD56 DISPLAY_IDENTIFIER kolben_pos_gelesen_D /end MEASUREMENT
/begin MEASUREMENT iKupD.kolben_posbas "Position, bei der der Kolben gestartet ist" UWORD UMR_PROZENT__1_100_0_S5_S3 1 100 0 100 ECU_ADDRESS 0xFFF8BD58 DISPLAY_IDENTIFIER kolben_posbas_D /end MEASUREMENT
/begin MEASUREMENT iKupD.kpl_inaktiv "Flag, ob Kupplung inaktiv ist" UBYTE Conv.cModKuppl._.kpl_inaktiv_S5_S3 1 100 0 1 BIT_MASK 0x1 ECU_ADDRESS 0xFFF8BD61 DISPLAY_IDENTIFIER kpl_inaktiv_D /end MEASUREMENT
/begin MEASUREMENT iKupD.kup_index_spsas "Der Spontanitaetsindex dieser Kupplung" UBYTE Conv.cModKuppl._.kup_index_spsas_S5_S3 1 100 0 2 ECU_ADDRESS 0xFFF8BD5E DISPLAY_IDENTIFIER kup_index_spsas_D /end MEASUREMENT
/begin MEASUREMENT iKupD.kup_schaltart_sas "Die Schaltart dieser Kupplung (für Bestimmung offset auf SF-Zeit)" UBYTE Conv.cModKuppl._.kup_schaltart_sas_S5_S3 1 100 0 5 ECU_ADDRESS 0xFFF8BD5D DISPLAY_IDENTIFIER kup_schaltart_sas_D /end MEASUREMENT
/begin MEASUREMENT iKupD.kv_nummer "Die Kupplungsventilnummer" UBYTE UMR___1_1_0_S5_S3 1 100 0 9 ECU_ADDRESS 0xFFF8BD5C DISPLAY_IDENTIFIER kv_nummer_D /end MEASUREMENT
/begin MEASUREMENT iKupD.n_kup_zbeg "Die Kupplungsdrehzahl zu beginn des Zustandes" UWORD UMR_U_MIN_1_1_0_S5_S3 1 100 0 8160 ECU_ADDRESS 0xFFF8BD5A DISPLAY_IDENTIFIER n_kup_zbeg_D /end MEASUREMENT
/begin MEASUREMENT iKupD.p_absist "Istdruck der Kupplung" UWORD UMR_BAR__1_1000_0_S5_S3 1 100 0 20 ECU_ADDRESS 0xFFF8BD50 DISPLAY_IDENTIFIER p_absist_D /end MEASUREMENT
/begin MEASUREMENT iKupD.p_filter.letzter_ms_timer "letzter BS-Timer" UWORD UMR_MSEC__1_1_0_S5_S3 1 100 0 65535 ECU_ADDRESS 0xFFF8BD2C DISPLAY_IDENTIFIER letzter_ms_timer.p_filter.iKupD /end MEASUREMENT
/begin MEASUREMENT iKupD.p_filter.x "letzter Wert" SLONG UMR___1_1_0_S5_S3 1 100 -2147483648 2147483647 ECU_ADDRESS 0xFFF8BD28 DISPLAY_IDENTIFIER x.p_filter.iKupD /end MEASUREMENT
/begin MEASUREMENT iKupD.p_fmin "minimale Fülldruck der Kupplung" UWORD UMR_BAR__1_1000_0_S5_S3 1 100 0 20 ECU_ADDRESS 0xFFF8BD52 DISPLAY_IDENTIFIER p_fmin_D /end MEASUREMENT
/begin MEASUREMENT iKupD.t0_sf "Gesamtschnellfüllzeit" UWORD UMR_MSEC__1_1_0_S5_S3 1 100 0 20000 ECU_ADDRESS 0xFFF8BD48 DISPLAY_IDENTIFIER t0_sf_D /end MEASUREMENT
/begin MEASUREMENT iKupD.t_kpl_aktiv.timer "Der aktuelle Timerwert" ULONG UMR_MSEC__10_1_0_S5_S3 1 100 0 42949672950 ECU_ADDRESS 0xFFF8BD34 DISPLAY_IDENTIFIER t_kpl_aktiv.iKupD /end MEASUREMENT
/begin MEASUREMENT iKupD.t_kpl_inaktiv.timer "Der aktuelle Timerwert" ULONG UMR_MSEC__10_1_0_S5_S3 1 100 0 42949672950 ECU_ADDRESS 0xFFF8BD38 DISPLAY_IDENTIFIER t_kpl_inaktiv.iKupD /end MEASUREMENT
/begin MEASUREMENT iKupD.t_lauf_entleer "Kolbenlaufzeit beim leeren" UWORD UMR_MSEC__1_1_0_S5_S3 1 100 0 20000 ECU_ADDRESS 0xFFF8BD4E DISPLAY_IDENTIFIER t_lauf_entleer_D /end MEASUREMENT
/begin MEASUREMENT iKupD.t_lauf_fuell "Kolbenlaufzeit beim füllen" UWORD UMR_MSEC__1_1_0_S5_S3 1 100 0 20000 ECU_ADDRESS 0xFFF8BD4C DISPLAY_IDENTIFIER t_lauf_fuell_D /end MEASUREMENT
/begin MEASUREMENT iKupD.timer_sas_ende_mit_pmax.timer "Der aktuelle Timerwert" UBYTE UMR_MSEC__10_1_0_S5_S3 1 100 0 2550 ECU_ADDRESS 0xFFF8BD32 DISPLAY_IDENTIFIER timer_sas_ende_mit_pmax.iKupD /end MEASUREMENT
/begin MEASUREMENT iKupD.totzeit "Die Totzeit" UWORD UMR_MSEC__1_1_0_S5_S3 1 100 0 2000 ECU_ADDRESS 0xFFF8BD4A DISPLAY_IDENTIFIER totzeit_D /end MEASUREMENT
/begin MEASUREMENT iKupD.zustand "Der Zustand" UBYTE Conv.cModKuppl._.zustand_S5_S3 1 100 0 5 ECU_ADDRESS 0xFFF8BD46 DISPLAY_IDENTIFIER zustand_D /end MEASUREMENT
/begin MEASUREMENT iKupD.zustandstimer.timer "Der aktuelle Timerwert" UWORD UMR_MSEC__1_1_0_S5_S3 1 100 0 65535 ECU_ADDRESS 0xFFF8BD30 DISPLAY_IDENTIFIER zustandstimer.iKupD /end MEASUREMENT
/begin MEASUREMENT iKupE.cModPVorg._.f_anst_statisch "Flag für die statische Ansteuerung" UBYTE Conv.cModPVorg._.f_anst_statisch_S5_S3 1 100 0 1 BIT_MASK 0x1 ECU_ADDRESS 0xFFF8BD77 DISPLAY_IDENTIFIER f_anst_statisch_E /end MEASUREMENT
/begin MEASUREMENT iKupE.cModPVorg._.f_druck_vorgegeben "Flag, ob Druck an dieses Element in diesem Zyklus schon vorgegeben wurde" UBYTE Conv.cModPVorg._.f_druck_vorgegeben_S5_S3 1 100 0 1 BIT_MASK 0x1 ECU_ADDRESS 0xFFF8BD76 DISPLAY_IDENTIFIER f_druck_vorgegeben_E /end MEASUREMENT
/begin MEASUREMENT iKupE.cModPVorg._.fktn_druckvorgabe "Die ansteuernde Funktion" UBYTE Conv.cModPVorg._.fktn_druckvorgabe_S5_S3 1 100 0 29 ECU_ADDRESS 0xFFF8BD78 DISPLAY_IDENTIFIER fktn_druckvorgabe_E /end MEASUREMENT
/begin MEASUREMENT iKupE.cModPVorg._.p_abssoll "Solldruck der Kupplung" UWORD UMR_BAR__1_1000_0_S5_S3 1 100 0 20 ECU_ADDRESS 0xFFF8BD72 DISPLAY_IDENTIFIER p_abssoll_E /end MEASUREMENT
/begin MEASUREMENT iKupE.cModPVorg._.p_abssoll_sys "Solldruck der Kupplung, begrentzt auf Systemdruck" UWORD UMR_BAR__1_1000_0_S5_S3 1 100 0 20 ECU_ADDRESS 0xFFF8BD74 DISPLAY_IDENTIFIER p_abssoll_sys_E /end MEASUREMENT
/begin MEASUREMENT iKupE.cModPVorg._.p_vorgabe "Solldruck der Kupplung" UWORD UMR_BAR__1_1000_0_S5_S3 1 100 0 20 ECU_ADDRESS 0xFFF8BD70 DISPLAY_IDENTIFIER p_vorgabe_E /end MEASUREMENT
/begin MEASUREMENT iKupE.cModPVorg._.typ_druckvorgabe "Der Typ des angesteuerten Druckes" UBYTE Conv.cModPVorg._.typ_druckvorgabe_S5_S3 1 100 0 4 ECU_ADDRESS 0xFFF8BD79 DISPLAY_IDENTIFIER typ_druckvorgabe_E /end MEASUREMENT
/begin MEASUREMENT iKupE.f_erste_bef "Flag für erste Befüllung" UBYTE Conv.cModKuppl._.f_erste_bef_S5_S3 1 100 0 1 BIT_MASK 0x1 ECU_ADDRESS 0xFFF8BDC2 DISPLAY_IDENTIFIER f_erste_bef_E /end MEASUREMENT
/begin MEASUREMENT iKupE.f_erste_bef_aus_sb "Flag für erste Befüllung aus standby" UBYTE Conv.cModKuppl._.f_erste_bef_aus_sb_S5_S3 1 100 0 1 BIT_MASK 0x1 ECU_ADDRESS 0xFFF8BDC3 DISPLAY_IDENTIFIER f_erste_bef_aus_sb_E /end MEASUREMENT
/begin MEASUREMENT iKupE.f_fuellopt "Flag für optimierte Befüllung" UBYTE Conv.cModKuppl._.f_fuellopt_S5_S3 1 100 0 1 BIT_MASK 0x1 ECU_ADDRESS 0xFFF8BDBF DISPLAY_IDENTIFIER f_fuellopt_E /end MEASUREMENT
/begin MEASUREMENT iKupE.f_fuellred "Flag für reduzierte Befüllung" UBYTE Conv.cModKuppl._.f_fuellred_S5_S3 1 100 0 1 BIT_MASK 0x1 ECU_ADDRESS 0xFFF8BDBE DISPLAY_IDENTIFIER f_fuellred_E /end MEASUREMENT
/begin MEASUREMENT iKupE.f_geschlossen "Flag für Kupplung geschlossen" UBYTE Conv.cModKuppl._.f_geschlossen_S5_S3 1 100 0 1 BIT_MASK 0x1 ECU_ADDRESS 0xFFF8BDC1 DISPLAY_IDENTIFIER f_geschlossen_E /end MEASUREMENT
/begin MEASUREMENT iKupE.f_kolben_anlegen "Flag für Kolben anlegen" UBYTE Conv.cModKuppl._.f_kolben_anlegen_S5_S3 1 100 0 1 BIT_MASK 0x1 ECU_ADDRESS 0xFFF8BDC0 DISPLAY_IDENTIFIER f_kolben_anlegen_E /end MEASUREMENT
/begin MEASUREMENT iKupE.f_sf_ausgabe_aktiv "Flag für Schnellfüllung" UBYTE Conv.cModKuppl._.f_sf_ausgabe_aktiv_S5_S3 1 100 0 1 BIT_MASK 0x1 ECU_ADDRESS 0xFFF8BDBB DISPLAY_IDENTIFIER f_sf_ausgabe_aktiv_E /end MEASUREMENT
/begin MEASUREMENT iKupE.f_sf_vorhanden "Flag für ausgegebene SF" UBYTE Conv.cModKuppl._.f_sf_vorhanden_S5_S3 1 100 0 1 BIT_MASK 0x1 ECU_ADDRESS 0xFFF8BDBC DISPLAY_IDENTIFIER f_sf_vorhanden_E /end MEASUREMENT
/begin MEASUREMENT iKupE.f_strom_pre_puls_erf "Flag für Stromprepuls" UBYTE Conv.cModKuppl._.f_strom_pre_puls_erf_S5_S3 1 100 0 1 BIT_MASK 0x1 ECU_ADDRESS 0xFFF8BDC4 DISPLAY_IDENTIFIER f_strom_pre_puls_erf_E /end MEASUREMENT
/begin MEASUREMENT iKupE.f_stromschl_angefordert "Flag zum ausführen der Stromschleife" UBYTE Conv.cModKuppl._.f_stromschl_angefordert_S5_S3 1 100 0 1 BIT_MASK 0x1 ECU_ADDRESS 0xFFF8BDC5 DISPLAY_IDENTIFIER f_stromschl_angefordert_E /end MEASUREMENT
/begin MEASUREMENT iKupE.kolben_pos "Die aktuelle Kolbenposition" UWORD UMR_PROZENT__1_100_0_S5_S3 1 100 0 100 ECU_ADDRESS 0xFFF8BDB0 DISPLAY_IDENTIFIER kolben_pos_E /end MEASUREMENT
/begin MEASUREMENT iKupE.kolben_pos_gelesen "Die aktuelle Kolbenposition wurde aus dem EEPROM gelesen" UBYTE Conv.cModKuppl._.kolben_pos_gelesen_S5_S3 1 100 0 1 BIT_MASK 0x1 ECU_ADDRESS 0xFFF8BDB2 DISPLAY_IDENTIFIER kolben_pos_gelesen_E /end MEASUREMENT
/begin MEASUREMENT iKupE.kolben_posbas "Position, bei der der Kolben gestartet ist" UWORD UMR_PROZENT__1_100_0_S5_S3 1 100 0 100 ECU_ADDRESS 0xFFF8BDB4 DISPLAY_IDENTIFIER kolben_posbas_E /end MEASUREMENT
/begin MEASUREMENT iKupE.kpl_inaktiv "Flag, ob Kupplung inaktiv ist" UBYTE Conv.cModKuppl._.kpl_inaktiv_S5_S3 1 100 0 1 BIT_MASK 0x1 ECU_ADDRESS 0xFFF8BDBD DISPLAY_IDENTIFIER kpl_inaktiv_E /end MEASUREMENT
/begin MEASUREMENT iKupE.kup_index_spsas "Der Spontanitaetsindex dieser Kupplung" UBYTE Conv.cModKuppl._.kup_index_spsas_S5_S3 1 100 0 2 ECU_ADDRESS 0xFFF8BDBA DISPLAY_IDENTIFIER kup_index_spsas_E /end MEASUREMENT
/begin MEASUREMENT iKupE.kup_schaltart_sas "Die Schaltart dieser Kupplung (für Bestimmung offset auf SF-Zeit)" UBYTE Conv.cModKuppl._.kup_schaltart_sas_S5_S3 1 100 0 5 ECU_ADDRESS 0xFFF8BDB9 DISPLAY_IDENTIFIER kup_schaltart_sas_E /end MEASUREMENT
/begin MEASUREMENT iKupE.kv_nummer "Die Kupplungsventilnummer" UBYTE UMR___1_1_0_S5_S3 1 100 0 9 ECU_ADDRESS 0xFFF8BDB8 DISPLAY_IDENTIFIER kv_nummer_E /end MEASUREMENT
/begin MEASUREMENT iKupE.n_kup_zbeg "Die Kupplungsdrehzahl zu beginn des Zustandes" UWORD UMR_U_MIN_1_1_0_S5_S3 1 100 0 8160 ECU_ADDRESS 0xFFF8BDB6 DISPLAY_IDENTIFIER n_kup_zbeg_E /end MEASUREMENT
/begin MEASUREMENT iKupE.p_absist "Istdruck der Kupplung" UWORD UMR_BAR__1_1000_0_S5_S3 1 100 0 20 ECU_ADDRESS 0xFFF8BDAC DISPLAY_IDENTIFIER p_absist_E /end MEASUREMENT
/begin MEASUREMENT iKupE.p_filter.letzter_ms_timer "letzter BS-Timer" UWORD UMR_MSEC__1_1_0_S5_S3 1 100 0 65535 ECU_ADDRESS 0xFFF8BD88 DISPLAY_IDENTIFIER letzter_ms_timer.p_filter.iKupE /end MEASUREMENT
/begin MEASUREMENT iKupE.p_filter.x "letzter Wert" SLONG UMR___1_1_0_S5_S3 1 100 -2147483648 2147483647 ECU_ADDRESS 0xFFF8BD84 DISPLAY_IDENTIFIER x.p_filter.iKupE /end MEASUREMENT
/begin MEASUREMENT iKupE.p_fmin "minimale Fülldruck der Kupplung" UWORD UMR_BAR__1_1000_0_S5_S3 1 100 0 20 ECU_ADDRESS 0xFFF8BDAE DISPLAY_IDENTIFIER p_fmin_E /end MEASUREMENT
/begin MEASUREMENT iKupE.t0_sf "Gesamtschnellfüllzeit" UWORD UMR_MSEC__1_1_0_S5_S3 1 100 0 20000 ECU_ADDRESS 0xFFF8BDA4 DISPLAY_IDENTIFIER t0_sf_E /end MEASUREMENT
/begin MEASUREMENT iKupE.t_kpl_aktiv.timer "Der aktuelle Timerwert" ULONG UMR_MSEC__10_1_0_S5_S3 1 100 0 42949672950 ECU_ADDRESS 0xFFF8BD90 DISPLAY_IDENTIFIER t_kpl_aktiv.iKupE /end MEASUREMENT
/begin MEASUREMENT iKupE.t_kpl_inaktiv.timer "Der aktuelle Timerwert" ULONG UMR_MSEC__10_1_0_S5_S3 1 100 0 42949672950 ECU_ADDRESS 0xFFF8BD94 DISPLAY_IDENTIFIER t_kpl_inaktiv.iKupE /end MEASUREMENT
/begin MEASUREMENT iKupE.t_lauf_entleer "Kolbenlaufzeit beim leeren" UWORD UMR_MSEC__1_1_0_S5_S3 1 100 0 20000 ECU_ADDRESS 0xFFF8BDAA DISPLAY_IDENTIFIER t_lauf_entleer_E /end MEASUREMENT
/begin MEASUREMENT iKupE.t_lauf_fuell "Kolbenlaufzeit beim füllen" UWORD UMR_MSEC__1_1_0_S5_S3 1 100 0 20000 ECU_ADDRESS 0xFFF8BDA8 DISPLAY_IDENTIFIER t_lauf_fuell_E /end MEASUREMENT
/begin MEASUREMENT iKupE.timer_sas_ende_mit_pmax.timer "Der aktuelle Timerwert" UBYTE UMR_MSEC__10_1_0_S5_S3 1 100 0 2550 ECU_ADDRESS 0xFFF8BD8E DISPLAY_IDENTIFIER timer_sas_ende_mit_pmax.iKupE /end MEASUREMENT
/begin MEASUREMENT iKupE.totzeit "Die Totzeit" UWORD UMR_MSEC__1_1_0_S5_S3 1 100 0 2000 ECU_ADDRESS 0xFFF8BDA6 DISPLAY_IDENTIFIER totzeit_E /end MEASUREMENT
/begin MEASUREMENT iKupE.zustand "Der Zustand" UBYTE Conv.cModKuppl._.zustand_S5_S3 1 100 0 5 ECU_ADDRESS 0xFFF8BDA2 DISPLAY_IDENTIFIER zustand_E /end MEASUREMENT
/begin MEASUREMENT iKupE.zustandstimer.timer "Der aktuelle Timerwert" UWORD UMR_MSEC__1_1_0_S5_S3 1 100 0 65535 ECU_ADDRESS 0xFFF8BD8C DISPLAY_IDENTIFIER zustandstimer.iKupE /end MEASUREMENT
/begin MEASUREMENT iKupHysA.f_ig_eds "Flag Gradientenrichtung Strom" UBYTE Conv.cModHysKo._.f_ig_eds_S5_S3 1 100 0 1 BIT_MASK 0x1 ECU_ADDRESS 0xFFF8D024 DISPLAY_IDENTIFIER f_ig_eds_A /end MEASUREMENT
/begin MEASUREMENT iKupHysA.f_pg_abssoll "Flag Gradientenrichtung" UBYTE Conv.cModHysKo._.f_pg_abssoll_S5_S3 1 100 0 1 BIT_MASK 0x1 ECU_ADDRESS 0xFFF8D014 DISPLAY_IDENTIFIER f_pg_abssoll_A /end MEASUREMENT
/begin MEASUREMENT iKupHysA.iDt1IEds.Pt1Si16.x "Filterwert" SLONG UMR___1_300_0_S5_S3 1 100 -7158278.82667 7158278.82333 ECU_ADDRESS 0xFFF8D05C DISPLAY_IDENTIFIER Pt1Si16.iDt1IEds.iKupHysA /end MEASUREMENT
/begin MEASUREMENT iKupHysA.iDt1IEds.xp "Ableitung vom Eingangswert" SWORD UMR___1_1_0_S5_S3 1 100 -32768 32767 ECU_ADDRESS 0xFFF8D058 DISPLAY_IDENTIFIER iDt1IEds.iKupHysA /end MEASUREMENT
/begin MEASUREMENT iKupHysA.iDt1PAbssoll.Pt1Fl32.x "Filterwert" FLOAT32_IEEE UMR___1_1_0_S5_S3 1 100 -1000000000 1000000000 ECU_ADDRESS 0xFFF8D04C FORMAT "%3.2" DISPLAY_IDENTIFIER Pt1Fl32.iDt1PAbssoll.iKupHysA /end MEASUREMENT
/begin MEASUREMENT iKupHysA.iDt1PAbssoll.xp "Ableitung vom Eingangswert" FLOAT32_IEEE UMR___1_1_0_S5_S3 1 100 -32768 32767 ECU_ADDRESS 0xFFF8D048 FORMAT "%3.2" DISPLAY_IDENTIFIER iDt1PAbssoll.iKupHysA /end MEASUREMENT
/begin MEASUREMENT iKupHysA.iDt1Verz.Pt1Fl32.x "Filterwert" FLOAT32_IEEE UMR___1_1_0_S5_S3 1 100 -1000000000 1000000000 ECU_ADDRESS 0xFFF8D06C FORMAT "%3.2" DISPLAY_IDENTIFIER Pt1Fl32.iDt1Verz.iKupHysA /end MEASUREMENT
/begin MEASUREMENT iKupHysA.iDt1Verz.xp "Ableitung vom Eingangswert" FLOAT32_IEEE UMR___1_1_0_S5_S3 1 100 -32768 32767 ECU_ADDRESS 0xFFF8D068 FORMAT "%3.2" DISPLAY_IDENTIFIER iDt1Verz.iKupHysA /end MEASUREMENT
/begin MEASUREMENT iKupHysA.iPt2IoKomp.x "Filterwert" FLOAT32_IEEE UMR___1_1_0_S5_S3 1 100 -2147483648 2147483647 ECU_ADDRESS 0xFFF8D060 FORMAT "%3.2" DISPLAY_IDENTIFIER x.iPt2IoKomp.iKupHysA /end MEASUREMENT
/begin MEASUREMENT iKupHysA.iPt2IoKomp.xp "Ableitung vom Eingangswert" FLOAT32_IEEE UMR__SEC_1_1_0_S5_S3 1 100 -2147483648 2147483647 ECU_ADDRESS 0xFFF8D064 FORMAT "%3.2" DISPLAY_IDENTIFIER xp.iPt2IoKomp.iKupHysA /end MEASUREMENT
/begin MEASUREMENT iKupHysA.iPt2MoKomp.x "Filterwert" FLOAT32_IEEE UMR___1_1_0_S5_S3 1 100 -2147483648 2147483647 ECU_ADDRESS 0xFFF8D050 FORMAT "%3.2" DISPLAY_IDENTIFIER x.iPt2MoKomp.iKupHysA /end MEASUREMENT
/begin MEASUREMENT iKupHysA.iPt2MoKomp.xp "Ableitung vom Eingangswert" FLOAT32_IEEE UMR__SEC_1_1_0_S5_S3 1 100 -2147483648 2147483647 ECU_ADDRESS 0xFFF8D054 FORMAT "%3.2" DISPLAY_IDENTIFIER xp.iPt2MoKomp.iKupHysA /end MEASUREMENT
/begin MEASUREMENT iKupHysA.i_eds "Sollstrom des Schaltelements" UWORD UMR_MA__1_10_0_S5_S3 1 100 0 6553.5 ECU_ADDRESS 0xFFF8D01C DISPLAY_IDENTIFIER i_eds_A /end MEASUREMENT
/begin MEASUREMENT iKupHysA.i_umkehr "Umkehrpunkt des Sollstroms" UWORD UMR_MA__1_10_0_S5_S3 1 100 0 6553.5 ECU_ADDRESS 0xFFF8D01E DISPLAY_IDENTIFIER i_umkehr_A /end MEASUREMENT
/begin MEASUREMENT iKupHysA.i_umkehr_alt "Umkehrpunkt bei Gradientenwechsel des Sollstroms" UWORD UMR_MA__1_10_0_S5_S3 1 100 0 6553.5 ECU_ADDRESS 0xFFF8D020 DISPLAY_IDENTIFIER i_umkehr_alt_A /end MEASUREMENT
/begin MEASUREMENT iKupHysA.ig_eds "Gradient Sollstrom" SWORD UMR_MA_SEC_1_1_0_S5_S3 1 100 -32768 32767 ECU_ADDRESS 0xFFF8D022 DISPLAY_IDENTIFIER ig_eds_A /end MEASUREMENT
/begin MEASUREMENT iKupHysA.ig_wechsel_erkannt "Wechsel der Gradientenrichtung erkannt" UBYTE Conv.cModHysKo._.ig_wechsel_erkannt_S5_S3 1 100 0 1 BIT_MASK 0x1 ECU_ADDRESS 0xFFF8D028 DISPLAY_IDENTIFIER ig_wechsel_erkannt_A /end MEASUREMENT
/begin MEASUREMENT iKupHysA.io_stg "Kompensation Stromoffset" SWORD UMR_MA__1_10_0_S5_S3 1 100 -3276.8 3276.7 ECU_ADDRESS 0xFFF8D026 DISPLAY_IDENTIFIER io_stg_A /end MEASUREMENT
/begin MEASUREMENT iKupHysA.k_kf_out "Faktor aus Kennfeld" SWORD UMR___1_1000_0_S5_S3 1 100 0 32.767 ECU_ADDRESS 0xFFF8D02E DISPLAY_IDENTIFIER k_kf_out_A /end MEASUREMENT
/begin MEASUREMENT iKupHysA.k_rampe_out "Faktor aus Rampe" SWORD UMR___1_1000_0_S5_S3 1 100 0 32.767 ECU_ADDRESS 0xFFF8D030 DISPLAY_IDENTIFIER k_rampe_out_A /end MEASUREMENT
/begin MEASUREMENT iKupHysA.mo_kpl "Kompensation Momentenoffset Kupplung" SWORD UMR_NM__1_1_0_S5_S3 1 100 -32768 32767 ECU_ADDRESS 0xFFF8D016 DISPLAY_IDENTIFIER mo_kpl_A /end MEASUREMENT
/begin MEASUREMENT iKupHysA.p_abssoll "Solldruck der Kupplung" UWORD UMR_BAR__1_1000_0_S5_S3 1 100 0 20 ECU_ADDRESS 0xFFF8D00C DISPLAY_IDENTIFIER p_abssoll_A /end MEASUREMENT
/begin MEASUREMENT iKupHysA.p_umkehr "Druckumkehrpunkt des Solldrucks" UWORD UMR_BAR__1_1000_0_S5_S3 1 100 0 20 ECU_ADDRESS 0xFFF8D00E DISPLAY_IDENTIFIER p_umkehr_A /end MEASUREMENT
/begin MEASUREMENT iKupHysA.p_umkehr_alt "Druckumkehrpunkt bei Gradientenwechsel des Solldrucks" UWORD UMR_BAR__1_1000_0_S5_S3 1 100 0 20 ECU_ADDRESS 0xFFF8D010 DISPLAY_IDENTIFIER p_umkehr_alt_A /end MEASUREMENT
/begin MEASUREMENT iKupHysA.pg_abssoll "Druckgradient Solldruck" SWORD UMR_BAR_SEC_1_1000_0_S5_S3 1 100 -32.768 32.767 ECU_ADDRESS 0xFFF8D012 DISPLAY_IDENTIFIER pg_abssoll_A /end MEASUREMENT
/begin MEASUREMENT iKupHysA.pg_wechsel_erkannt "Wechsel der Gradientenrichtung erkannt" UBYTE Conv.cModHysKo._.pg_wechsel_erkannt_S5_S3 1 100 0 1 BIT_MASK 0x1 ECU_ADDRESS 0xFFF8D01A DISPLAY_IDENTIFIER pg_wechsel_erkannt_A /end MEASUREMENT
/begin MEASUREMENT iKupHysA.pg_wirk "Druckgradient Wirkdruck" SWORD UMR_BAR_SEC_1_10_0_S5_S3 1 100 -3276.8 3276.7 ECU_ADDRESS 0xFFF8D02C DISPLAY_IDENTIFIER pg_wirk_A /end MEASUREMENT
/begin MEASUREMENT iKupHysA.po_kpl "Kompensation Druckoffset Kupplung" SWORD UMR_BAR__1_1000_0_S5_S3 1 100 -32.768 32.767 ECU_ADDRESS 0xFFF8D018 DISPLAY_IDENTIFIER po_kpl_A /end MEASUREMENT
/begin MEASUREMENT iKupHysA.po_vhyskomp "Druckoffset Verzugskompensation" SWORD UMR_BAR__1_1000_0_S5_S3 1 100 -32.768 32.767 ECU_ADDRESS 0xFFF8D032 DISPLAY_IDENTIFIER po_vhyskomp_A /end MEASUREMENT
/begin MEASUREMENT iKupHysA.po_wirk "Druckoffset Verzugskompensation" SWORD UMR_BAR__1_1000_0_S5_S3 1 100 0 20 ECU_ADDRESS 0xFFF8D02A DISPLAY_IDENTIFIER po_wirk_A /end MEASUREMENT
/begin MEASUREMENT iKupHysA.trajekfort_kpl "Trajektorienfortschritt Kupplung" UBYTE UMR_PROZENT__1_1_0_S5_S3 1 100 0 100 ECU_ADDRESS 0xFFF8D015 DISPLAY_IDENTIFIER trajekfort_kpl_A /end MEASUREMENT
/begin MEASUREMENT iKupHysA.trajekfort_stg "Trajektorienfortschritt Steuerung" UBYTE UMR_PROZENT__1_1_0_S5_S3 1 100 0 100 ECU_ADDRESS 0xFFF8D025 DISPLAY_IDENTIFIER trajekfort_stg_A /end MEASUREMENT
/begin MEASUREMENT iKupHysA.z_rampe "Der Zustand" UBYTE Conv.cModHysKo._.z_rampe_S5_S3 1 100 0 3 ECU_ADDRESS 0xFFF8D034 DISPLAY_IDENTIFIER z_rampe_A /end MEASUREMENT
/begin MEASUREMENT iKupHysB.f_ig_eds "Flag Gradientenrichtung Strom" UBYTE Conv.cModHysKo._.f_ig_eds_S5_S3 1 100 0 1 BIT_MASK 0x1 ECU_ADDRESS 0xFFF8D088 DISPLAY_IDENTIFIER f_ig_eds_B /end MEASUREMENT
/begin MEASUREMENT iKupHysB.f_pg_abssoll "Flag Gradientenrichtung" UBYTE Conv.cModHysKo._.f_pg_abssoll_S5_S3 1 100 0 1 BIT_MASK 0x1 ECU_ADDRESS 0xFFF8D078 DISPLAY_IDENTIFIER f_pg_abssoll_B /end MEASUREMENT
/begin MEASUREMENT iKupHysB.iDt1IEds.Pt1Si16.x "Filterwert" SLONG UMR___1_300_0_S5_S3 1 100 -7158278.82667 7158278.82333 ECU_ADDRESS 0xFFF8D0C0 DISPLAY_IDENTIFIER Pt1Si16.iDt1IEds.iKupHysB /end MEASUREMENT
/begin MEASUREMENT iKupHysB.iDt1IEds.xp "Ableitung vom Eingangswert" SWORD UMR___1_1_0_S5_S3 1 100 -32768 32767 ECU_ADDRESS 0xFFF8D0BC DISPLAY_IDENTIFIER iDt1IEds.iKupHysB /end MEASUREMENT
/begin MEASUREMENT iKupHysB.iDt1PAbssoll.Pt1Fl32.x "Filterwert" FLOAT32_IEEE UMR___1_1_0_S5_S3 1 100 -1000000000 1000000000 ECU_ADDRESS 0xFFF8D0B0 FORMAT "%3.2" DISPLAY_IDENTIFIER Pt1Fl32.iDt1PAbssoll.iKupHysB /end MEASUREMENT
/begin MEASUREMENT iKupHysB.iDt1PAbssoll.xp "Ableitung vom Eingangswert" FLOAT32_IEEE UMR___1_1_0_S5_S3 1 100 -32768 32767 ECU_ADDRESS 0xFFF8D0AC FORMAT "%3.2" DISPLAY_IDENTIFIER iDt1PAbssoll.iKupHysB /end MEASUREMENT
/begin MEASUREMENT iKupHysB.iDt1Verz.Pt1Fl32.x "Filterwert" FLOAT32_IEEE UMR___1_1_0_S5_S3 1 100 -1000000000 1000000000 ECU_ADDRESS 0xFFF8D0D0 FORMAT "%3.2" DISPLAY_IDENTIFIER Pt1Fl32.iDt1Verz.iKupHysB /end MEASUREMENT
/begin MEASUREMENT iKupHysB.iDt1Verz.xp "Ableitung vom Eingangswert" FLOAT32_IEEE UMR___1_1_0_S5_S3 1 100 -32768 32767 ECU_ADDRESS 0xFFF8D0CC FORMAT "%3.2" DISPLAY_IDENTIFIER iDt1Verz.iKupHysB /end MEASUREMENT
/begin MEASUREMENT iKupHysB.iPt2IoKomp.x "Filterwert" FLOAT32_IEEE UMR___1_1_0_S5_S3 1 100 -2147483648 2147483647 ECU_ADDRESS 0xFFF8D0C4 FORMAT "%3.2" DISPLAY_IDENTIFIER x.iPt2IoKomp.iKupHysB /end MEASUREMENT
/begin MEASUREMENT iKupHysB.iPt2IoKomp.xp "Ableitung vom Eingangswert" FLOAT32_IEEE UMR__SEC_1_1_0_S5_S3 1 100 -2147483648 2147483647 ECU_ADDRESS 0xFFF8D0C8 FORMAT "%3.2" DISPLAY_IDENTIFIER xp.iPt2IoKomp.iKupHysB /end MEASUREMENT
/begin MEASUREMENT iKupHysB.iPt2MoKomp.x "Filterwert" FLOAT32_IEEE UMR___1_1_0_S5_S3 1 100 -2147483648 2147483647 ECU_ADDRESS 0xFFF8D0B4 FORMAT "%3.2" DISPLAY_IDENTIFIER x.iPt2MoKomp.iKupHysB /end MEASUREMENT
/begin MEASUREMENT iKupHysB.iPt2MoKomp.xp "Ableitung vom Eingangswert" FLOAT32_IEEE UMR__SEC_1_1_0_S5_S3 1 100 -2147483648 2147483647 ECU_ADDRESS 0xFFF8D0B8 FORMAT "%3.2" DISPLAY_IDENTIFIER xp.iPt2MoKomp.iKupHysB /end MEASUREMENT
/begin MEASUREMENT iKupHysB.i_eds "Sollstrom des Schaltelements" UWORD UMR_MA__1_10_0_S5_S3 1 100 0 6553.5 ECU_ADDRESS 0xFFF8D080 DISPLAY_IDENTIFIER i_eds_B /end MEASUREMENT
/begin MEASUREMENT iKupHysB.i_umkehr "Umkehrpunkt des Sollstroms" UWORD UMR_MA__1_10_0_S5_S3 1 100 0 6553.5 ECU_ADDRESS 0xFFF8D082 DISPLAY_IDENTIFIER i_umkehr_B /end MEASUREMENT
/begin MEASUREMENT iKupHysB.i_umkehr_alt "Umkehrpunkt bei Gradientenwechsel des Sollstroms" UWORD UMR_MA__1_10_0_S5_S3 1 100 0 6553.5 ECU_ADDRESS 0xFFF8D084 DISPLAY_IDENTIFIER i_umkehr_alt_B /end MEASUREMENT
/begin MEASUREMENT iKupHysB.ig_eds "Gradient Sollstrom" SWORD UMR_MA_SEC_1_1_0_S5_S3 1 100 -32768 32767 ECU_ADDRESS 0xFFF8D086 DISPLAY_IDENTIFIER ig_eds_B /end MEASUREMENT
/begin MEASUREMENT iKupHysB.ig_wechsel_erkannt "Wechsel der Gradientenrichtung erkannt" UBYTE Conv.cModHysKo._.ig_wechsel_erkannt_S5_S3 1 100 0 1 BIT_MASK 0x1 ECU_ADDRESS 0xFFF8D08C DISPLAY_IDENTIFIER ig_wechsel_erkannt_B /end MEASUREMENT
/begin MEASUREMENT iKupHysB.io_stg "Kompensation Stromoffset" SWORD UMR_MA__1_10_0_S5_S3 1 100 -3276.8 3276.7 ECU_ADDRESS 0xFFF8D08A DISPLAY_IDENTIFIER io_stg_B /end MEASUREMENT
/begin MEASUREMENT iKupHysB.k_kf_out "Faktor aus Kennfeld" SWORD UMR___1_1000_0_S5_S3 1 100 0 32.767 ECU_ADDRESS 0xFFF8D092 DISPLAY_IDENTIFIER k_kf_out_B /end MEASUREMENT
/begin MEASUREMENT iKupHysB.k_rampe_out "Faktor aus Rampe" SWORD UMR___1_1000_0_S5_S3 1 100 0 32.767 ECU_ADDRESS 0xFFF8D094 DISPLAY_IDENTIFIER k_rampe_out_B /end MEASUREMENT
/begin MEASUREMENT iKupHysB.mo_kpl "Kompensation Momentenoffset Kupplung" SWORD UMR_NM__1_1_0_S5_S3 1 100 -32768 32767 ECU_ADDRESS 0xFFF8D07A DISPLAY_IDENTIFIER mo_kpl_B /end MEASUREMENT
/begin MEASUREMENT iKupHysB.p_abssoll "Solldruck der Kupplung" UWORD UMR_BAR__1_1000_0_S5_S3 1 100 0 20 ECU_ADDRESS 0xFFF8D070 DISPLAY_IDENTIFIER p_abssoll_B /end MEASUREMENT
/begin MEASUREMENT iKupHysB.p_umkehr "Druckumkehrpunkt des Solldrucks" UWORD UMR_BAR__1_1000_0_S5_S3 1 100 0 20 ECU_ADDRESS 0xFFF8D072 DISPLAY_IDENTIFIER p_umkehr_B /end MEASUREMENT
/begin MEASUREMENT iKupHysB.p_umkehr_alt "Druckumkehrpunkt bei Gradientenwechsel des Solldrucks" UWORD UMR_BAR__1_1000_0_S5_S3 1 100 0 20 ECU_ADDRESS 0xFFF8D074 DISPLAY_IDENTIFIER p_umkehr_alt_B /end MEASUREMENT
/begin MEASUREMENT iKupHysB.pg_abssoll "Druckgradient Solldruck" SWORD UMR_BAR_SEC_1_1000_0_S5_S3 1 100 -32.768 32.767 ECU_ADDRESS 0xFFF8D076 DISPLAY_IDENTIFIER pg_abssoll_B /end MEASUREMENT
/begin MEASUREMENT iKupHysB.pg_wechsel_erkannt "Wechsel der Gradientenrichtung erkannt" UBYTE Conv.cModHysKo._.pg_wechsel_erkannt_S5_S3 1 100 0 1 BIT_MASK 0x1 ECU_ADDRESS 0xFFF8D07E DISPLAY_IDENTIFIER pg_wechsel_erkannt_B /end MEASUREMENT
/begin MEASUREMENT iKupHysB.pg_wirk "Druckgradient Wirkdruck" SWORD UMR_BAR_SEC_1_10_0_S5_S3 1 100 -3276.8 3276.7 ECU_ADDRESS 0xFFF8D090 DISPLAY_IDENTIFIER pg_wirk_B /end MEASUREMENT
/begin MEASUREMENT iKupHysB.po_kpl "Kompensation Druckoffset Kupplung" SWORD UMR_BAR__1_1000_0_S5_S3 1 100 -32.768 32.767 ECU_ADDRESS 0xFFF8D07C DISPLAY_IDENTIFIER po_kpl_B /end MEASUREMENT
/begin MEASUREMENT iKupHysB.po_vhyskomp "Druckoffset Verzugskompensation" SWORD UMR_BAR__1_1000_0_S5_S3 1 100 -32.768 32.767 ECU_ADDRESS 0xFFF8D096 DISPLAY_IDENTIFIER po_vhyskomp_B /end MEASUREMENT
/begin MEASUREMENT iKupHysB.po_wirk "Druckoffset Verzugskompensation" SWORD UMR_BAR__1_1000_0_S5_S3 1 100 0 20 ECU_ADDRESS 0xFFF8D08E DISPLAY_IDENTIFIER po_wirk_B /end MEASUREMENT
/begin MEASUREMENT iKupHysB.trajekfort_kpl "Trajektorienfortschritt Kupplung" UBYTE UMR_PROZENT__1_1_0_S5_S3 1 100 0 100 ECU_ADDRESS 0xFFF8D079 DISPLAY_IDENTIFIER trajekfort_kpl_B /end MEASUREMENT
/begin MEASUREMENT iKupHysB.trajekfort_stg "Trajektorienfortschritt Steuerung" UBYTE UMR_PROZENT__1_1_0_S5_S3 1 100 0 100 ECU_ADDRESS 0xFFF8D089 DISPLAY_IDENTIFIER trajekfort_stg_B /end MEASUREMENT
/begin MEASUREMENT iKupHysB.z_rampe "Der Zustand" UBYTE Conv.cModHysKo._.z_rampe_S5_S3 1 100 0 3 ECU_ADDRESS 0xFFF8D098 DISPLAY_IDENTIFIER z_rampe_B /end MEASUREMENT
/begin MEASUREMENT iKupHysC.f_ig_eds "Flag Gradientenrichtung Strom" UBYTE Conv.cModHysKo._.f_ig_eds_S5_S3 1 100 0 1 BIT_MASK 0x1 ECU_ADDRESS 0xFFF8D0EC DISPLAY_IDENTIFIER f_ig_eds_C /end MEASUREMENT
/begin MEASUREMENT iKupHysC.f_pg_abssoll "Flag Gradientenrichtung" UBYTE Conv.cModHysKo._.f_pg_abssoll_S5_S3 1 100 0 1 BIT_MASK 0x1 ECU_ADDRESS 0xFFF8D0DC DISPLAY_IDENTIFIER f_pg_abssoll_C /end MEASUREMENT
/begin MEASUREMENT iKupHysC.iDt1IEds.Pt1Si16.x "Filterwert" SLONG UMR___1_300_0_S5_S3 1 100 -7158278.82667 7158278.82333 ECU_ADDRESS 0xFFF8D124 DISPLAY_IDENTIFIER Pt1Si16.iDt1IEds.iKupHysC /end MEASUREMENT
/begin MEASUREMENT iKupHysC.iDt1IEds.xp "Ableitung vom Eingangswert" SWORD UMR___1_1_0_S5_S3 1 100 -32768 32767 ECU_ADDRESS 0xFFF8D120 DISPLAY_IDENTIFIER iDt1IEds.iKupHysC /end MEASUREMENT
/begin MEASUREMENT iKupHysC.iDt1PAbssoll.Pt1Fl32.x "Filterwert" FLOAT32_IEEE UMR___1_1_0_S5_S3 1 100 -1000000000 1000000000 ECU_ADDRESS 0xFFF8D114 FORMAT "%3.2" DISPLAY_IDENTIFIER Pt1Fl32.iDt1PAbssoll.iKupHysC /end MEASUREMENT
/begin MEASUREMENT iKupHysC.iDt1PAbssoll.xp "Ableitung vom Eingangswert" FLOAT32_IEEE UMR___1_1_0_S5_S3 1 100 -32768 32767 ECU_ADDRESS 0xFFF8D110 FORMAT "%3.2" DISPLAY_IDENTIFIER iDt1PAbssoll.iKupHysC /end MEASUREMENT
/begin MEASUREMENT iKupHysC.iDt1Verz.Pt1Fl32.x "Filterwert" FLOAT32_IEEE UMR___1_1_0_S5_S3 1 100 -1000000000 1000000000 ECU_ADDRESS 0xFFF8D134 FORMAT "%3.2" DISPLAY_IDENTIFIER Pt1Fl32.iDt1Verz.iKupHysC /end MEASUREMENT
/begin MEASUREMENT iKupHysC.iDt1Verz.xp "Ableitung vom Eingangswert" FLOAT32_IEEE UMR___1_1_0_S5_S3 1 100 -32768 32767 ECU_ADDRESS 0xFFF8D130 FORMAT "%3.2" DISPLAY_IDENTIFIER iDt1Verz.iKupHysC /end MEASUREMENT
/begin MEASUREMENT iKupHysC.iPt2IoKomp.x "Filterwert" FLOAT32_IEEE UMR___1_1_0_S5_S3 1 100 -2147483648 2147483647 ECU_ADDRESS 0xFFF8D128 FORMAT "%3.2" DISPLAY_IDENTIFIER x.iPt2IoKomp.iKupHysC /end MEASUREMENT
/begin MEASUREMENT iKupHysC.iPt2IoKomp.xp "Ableitung vom Eingangswert" FLOAT32_IEEE UMR__SEC_1_1_0_S5_S3 1 100 -2147483648 2147483647 ECU_ADDRESS 0xFFF8D12C FORMAT "%3.2" DISPLAY_IDENTIFIER xp.iPt2IoKomp.iKupHysC /end MEASUREMENT
/begin MEASUREMENT iKupHysC.iPt2MoKomp.x "Filterwert" FLOAT32_IEEE UMR___1_1_0_S5_S3 1 100 -2147483648 2147483647 ECU_ADDRESS 0xFFF8D118 FORMAT "%3.2" DISPLAY_IDENTIFIER x.iPt2MoKomp.iKupHysC /end MEASUREMENT
/begin MEASUREMENT iKupHysC.iPt2MoKomp.xp "Ableitung vom Eingangswert" FLOAT32_IEEE UMR__SEC_1_1_0_S5_S3 1 100 -2147483648 2147483647 ECU_ADDRESS 0xFFF8D11C FORMAT "%3.2" DISPLAY_IDENTIFIER xp.iPt2MoKomp.iKupHysC /end MEASUREMENT
/begin MEASUREMENT iKupHysC.i_eds "Sollstrom des Schaltelements" UWORD UMR_MA__1_10_0_S5_S3 1 100 0 6553.5 ECU_ADDRESS 0xFFF8D0E4 DISPLAY_IDENTIFIER i_eds_C /end MEASUREMENT
/begin MEASUREMENT iKupHysC.i_umkehr "Umkehrpunkt des Sollstroms" UWORD UMR_MA__1_10_0_S5_S3 1 100 0 6553.5 ECU_ADDRESS 0xFFF8D0E6 DISPLAY_IDENTIFIER i_umkehr_C /end MEASUREMENT
/begin MEASUREMENT iKupHysC.i_umkehr_alt "Umkehrpunkt bei Gradientenwechsel des Sollstroms" UWORD UMR_MA__1_10_0_S5_S3 1 100 0 6553.5 ECU_ADDRESS 0xFFF8D0E8 DISPLAY_IDENTIFIER i_umkehr_alt_C /end MEASUREMENT
/begin MEASUREMENT iKupHysC.ig_eds "Gradient Sollstrom" SWORD UMR_MA_SEC_1_1_0_S5_S3 1 100 -32768 32767 ECU_ADDRESS 0xFFF8D0EA DISPLAY_IDENTIFIER ig_eds_C /end MEASUREMENT
/begin MEASUREMENT iKupHysC.ig_wechsel_erkannt "Wechsel der Gradientenrichtung erkannt" UBYTE Conv.cModHysKo._.ig_wechsel_erkannt_S5_S3 1 100 0 1 BIT_MASK 0x1 ECU_ADDRESS 0xFFF8D0F0 DISPLAY_IDENTIFIER ig_wechsel_erkannt_C /end MEASUREMENT
/begin MEASUREMENT iKupHysC.io_stg "Kompensation Stromoffset" SWORD UMR_MA__1_10_0_S5_S3 1 100 -3276.8 3276.7 ECU_ADDRESS 0xFFF8D0EE DISPLAY_IDENTIFIER io_stg_C /end MEASUREMENT
/begin MEASUREMENT iKupHysC.k_kf_out "Faktor aus Kennfeld" SWORD UMR___1_1000_0_S5_S3 1 100 0 32.767 ECU_ADDRESS 0xFFF8D0F6 DISPLAY_IDENTIFIER k_kf_out_C /end MEASUREMENT
/begin MEASUREMENT iKupHysC.k_rampe_out "Faktor aus Rampe" SWORD UMR___1_1000_0_S5_S3 1 100 0 32.767 ECU_ADDRESS 0xFFF8D0F8 DISPLAY_IDENTIFIER k_rampe_out_C /end MEASUREMENT
/begin MEASUREMENT iKupHysC.mo_kpl "Kompensation Momentenoffset Kupplung" SWORD UMR_NM__1_1_0_S5_S3 1 100 -32768 32767 ECU_ADDRESS 0xFFF8D0DE DISPLAY_IDENTIFIER mo_kpl_C /end MEASUREMENT
/begin MEASUREMENT iKupHysC.p_abssoll "Solldruck der Kupplung" UWORD UMR_BAR__1_1000_0_S5_S3 1 100 0 20 ECU_ADDRESS 0xFFF8D0D4 DISPLAY_IDENTIFIER p_abssoll_C /end MEASUREMENT
/begin MEASUREMENT iKupHysC.p_umkehr "Druckumkehrpunkt des Solldrucks" UWORD UMR_BAR__1_1000_0_S5_S3 1 100 0 20 ECU_ADDRESS 0xFFF8D0D6 DISPLAY_IDENTIFIER p_umkehr_C /end MEASUREMENT
/begin MEASUREMENT iKupHysC.p_umkehr_alt "Druckumkehrpunkt bei Gradientenwechsel des Solldrucks" UWORD UMR_BAR__1_1000_0_S5_S3 1 100 0 20 ECU_ADDRESS 0xFFF8D0D8 DISPLAY_IDENTIFIER p_umkehr_alt_C /end MEASUREMENT
/begin MEASUREMENT iKupHysC.pg_abssoll "Druckgradient Solldruck" SWORD UMR_BAR_SEC_1_1000_0_S5_S3 1 100 -32.768 32.767 ECU_ADDRESS 0xFFF8D0DA DISPLAY_IDENTIFIER pg_abssoll_C /end MEASUREMENT
/begin MEASUREMENT iKupHysC.pg_wechsel_erkannt "Wechsel der Gradientenrichtung erkannt" UBYTE Conv.cModHysKo._.pg_wechsel_erkannt_S5_S3 1 100 0 1 BIT_MASK 0x1 ECU_ADDRESS 0xFFF8D0E2 DISPLAY_IDENTIFIER pg_wechsel_erkannt_C /end MEASUREMENT
/begin MEASUREMENT iKupHysC.pg_wirk "Druckgradient Wirkdruck" SWORD UMR_BAR_SEC_1_10_0_S5_S3 1 100 -3276.8 3276.7 ECU_ADDRESS 0xFFF8D0F4 DISPLAY_IDENTIFIER pg_wirk_C /end MEASUREMENT
/begin MEASUREMENT iKupHysC.po_kpl "Kompensation Druckoffset Kupplung" SWORD UMR_BAR__1_1000_0_S5_S3 1 100 -32.768 32.767 ECU_ADDRESS 0xFFF8D0E0 DISPLAY_IDENTIFIER po_kpl_C /end MEASUREMENT
/begin MEASUREMENT iKupHysC.po_vhyskomp "Druckoffset Verzugskompensation" SWORD UMR_BAR__1_1000_0_S5_S3 1 100 -32.768 32.767 ECU_ADDRESS 0xFFF8D0FA DISPLAY_IDENTIFIER po_vhyskomp_C /end MEASUREMENT
/begin MEASUREMENT iKupHysC.po_wirk "Druckoffset Verzugskompensation" SWORD UMR_BAR__1_1000_0_S5_S3 1 100 0 20 ECU_ADDRESS 0xFFF8D0F2 DISPLAY_IDENTIFIER po_wirk_C /end MEASUREMENT
/begin MEASUREMENT iKupHysC.trajekfort_kpl "Trajektorienfortschritt Kupplung" UBYTE UMR_PROZENT__1_1_0_S5_S3 1 100 0 100 ECU_ADDRESS 0xFFF8D0DD DISPLAY_IDENTIFIER trajekfort_kpl_C /end MEASUREMENT
/begin MEASUREMENT iKupHysC.trajekfort_stg "Trajektorienfortschritt Steuerung" UBYTE UMR_PROZENT__1_1_0_S5_S3 1 100 0 100 ECU_ADDRESS 0xFFF8D0ED DISPLAY_IDENTIFIER trajekfort_stg_C /end MEASUREMENT
/begin MEASUREMENT iKupHysC.z_rampe "Der Zustand" UBYTE Conv.cModHysKo._.z_rampe_S5_S3 1 100 0 3 ECU_ADDRESS 0xFFF8D0FC DISPLAY_IDENTIFIER z_rampe_C /end MEASUREMENT
/begin MEASUREMENT iKupHysD.f_ig_eds "Flag Gradientenrichtung Strom" UBYTE Conv.cModHysKo._.f_ig_eds_S5_S3 1 100 0 1 BIT_MASK 0x1 ECU_ADDRESS 0xFFF8D150 DISPLAY_IDENTIFIER f_ig_eds_D /end MEASUREMENT
/begin MEASUREMENT iKupHysD.f_pg_abssoll "Flag Gradientenrichtung" UBYTE Conv.cModHysKo._.f_pg_abssoll_S5_S3 1 100 0 1 BIT_MASK 0x1 ECU_ADDRESS 0xFFF8D140 DISPLAY_IDENTIFIER f_pg_abssoll_D /end MEASUREMENT
/begin MEASUREMENT iKupHysD.iDt1IEds.Pt1Si16.x "Filterwert" SLONG UMR___1_300_0_S5_S3 1 100 -7158278.82667 7158278.82333 ECU_ADDRESS 0xFFF8D188 DISPLAY_IDENTIFIER Pt1Si16.iDt1IEds.iKupHysD /end MEASUREMENT
/begin MEASUREMENT iKupHysD.iDt1IEds.xp "Ableitung vom Eingangswert" SWORD UMR___1_1_0_S5_S3 1 100 -32768 32767 ECU_ADDRESS 0xFFF8D184 DISPLAY_IDENTIFIER iDt1IEds.iKupHysD /end MEASUREMENT
/begin MEASUREMENT iKupHysD.iDt1PAbssoll.Pt1Fl32.x "Filterwert" FLOAT32_IEEE UMR___1_1_0_S5_S3 1 100 -1000000000 1000000000 ECU_ADDRESS 0xFFF8D178 FORMAT "%3.2" DISPLAY_IDENTIFIER Pt1Fl32.iDt1PAbssoll.iKupHysD /end MEASUREMENT
/begin MEASUREMENT iKupHysD.iDt1PAbssoll.xp "Ableitung vom Eingangswert" FLOAT32_IEEE UMR___1_1_0_S5_S3 1 100 -32768 32767 ECU_ADDRESS 0xFFF8D174 FORMAT "%3.2" DISPLAY_IDENTIFIER iDt1PAbssoll.iKupHysD /end MEASUREMENT
/begin MEASUREMENT iKupHysD.iDt1Verz.Pt1Fl32.x "Filterwert" FLOAT32_IEEE UMR___1_1_0_S5_S3 1 100 -1000000000 1000000000 ECU_ADDRESS 0xFFF8D198 FORMAT "%3.2" DISPLAY_IDENTIFIER Pt1Fl32.iDt1Verz.iKupHysD /end MEASUREMENT
/begin MEASUREMENT iKupHysD.iDt1Verz.xp "Ableitung vom Eingangswert" FLOAT32_IEEE UMR___1_1_0_S5_S3 1 100 -32768 32767 ECU_ADDRESS 0xFFF8D194 FORMAT "%3.2" DISPLAY_IDENTIFIER iDt1Verz.iKupHysD /end MEASUREMENT
/begin MEASUREMENT iKupHysD.iPt2IoKomp.x "Filterwert" FLOAT32_IEEE UMR___1_1_0_S5_S3 1 100 -2147483648 2147483647 ECU_ADDRESS 0xFFF8D18C FORMAT "%3.2" DISPLAY_IDENTIFIER x.iPt2IoKomp.iKupHysD /end MEASUREMENT
/begin MEASUREMENT iKupHysD.iPt2IoKomp.xp "Ableitung vom Eingangswert" FLOAT32_IEEE UMR__SEC_1_1_0_S5_S3 1 100 -2147483648 2147483647 ECU_ADDRESS 0xFFF8D190 FORMAT "%3.2" DISPLAY_IDENTIFIER xp.iPt2IoKomp.iKupHysD /end MEASUREMENT
/begin MEASUREMENT iKupHysD.iPt2MoKomp.x "Filterwert" FLOAT32_IEEE UMR___1_1_0_S5_S3 1 100 -2147483648 2147483647 ECU_ADDRESS 0xFFF8D17C FORMAT "%3.2" DISPLAY_IDENTIFIER x.iPt2MoKomp.iKupHysD /end MEASUREMENT
/begin MEASUREMENT iKupHysD.iPt2MoKomp.xp "Ableitung vom Eingangswert" FLOAT32_IEEE UMR__SEC_1_1_0_S5_S3 1 100 -2147483648 2147483647 ECU_ADDRESS 0xFFF8D180 FORMAT "%3.2" DISPLAY_IDENTIFIER xp.iPt2MoKomp.iKupHysD /end MEASUREMENT
/begin MEASUREMENT iKupHysD.i_eds "Sollstrom des Schaltelements" UWORD UMR_MA__1_10_0_S5_S3 1 100 0 6553.5 ECU_ADDRESS 0xFFF8D148 DISPLAY_IDENTIFIER i_eds_D /end MEASUREMENT
/begin MEASUREMENT iKupHysD.i_umkehr "Umkehrpunkt des Sollstroms" UWORD UMR_MA__1_10_0_S5_S3 1 100 0 6553.5 ECU_ADDRESS 0xFFF8D14A DISPLAY_IDENTIFIER i_umkehr_D /end MEASUREMENT
/begin MEASUREMENT iKupHysD.i_umkehr_alt "Umkehrpunkt bei Gradientenwechsel des Sollstroms" UWORD UMR_MA__1_10_0_S5_S3 1 100 0 6553.5 ECU_ADDRESS 0xFFF8D14C DISPLAY_IDENTIFIER i_umkehr_alt_D /end MEASUREMENT
/begin MEASUREMENT iKupHysD.ig_eds "Gradient Sollstrom" SWORD UMR_MA_SEC_1_1_0_S5_S3 1 100 -32768 32767 ECU_ADDRESS 0xFFF8D14E DISPLAY_IDENTIFIER ig_eds_D /end MEASUREMENT
/begin MEASUREMENT iKupHysD.ig_wechsel_erkannt "Wechsel der Gradientenrichtung erkannt" UBYTE Conv.cModHysKo._.ig_wechsel_erkannt_S5_S3 1 100 0 1 BIT_MASK 0x1 ECU_ADDRESS 0xFFF8D154 DISPLAY_IDENTIFIER ig_wechsel_erkannt_D /end MEASUREMENT
/begin MEASUREMENT iKupHysD.io_stg "Kompensation Stromoffset" SWORD UMR_MA__1_10_0_S5_S3 1 100 -3276.8 3276.7 ECU_ADDRESS 0xFFF8D152 DISPLAY_IDENTIFIER io_stg_D /end MEASUREMENT
/begin MEASUREMENT iKupHysD.k_kf_out "Faktor aus Kennfeld" SWORD UMR___1_1000_0_S5_S3 1 100 0 32.767 ECU_ADDRESS 0xFFF8D15A DISPLAY_IDENTIFIER k_kf_out_D /end MEASUREMENT
/begin MEASUREMENT iKupHysD.k_rampe_out "Faktor aus Rampe" SWORD UMR___1_1000_0_S5_S3 1 100 0 32.767 ECU_ADDRESS 0xFFF8D15C DISPLAY_IDENTIFIER k_rampe_out_D /end MEASUREMENT
/begin MEASUREMENT iKupHysD.mo_kpl "Kompensation Momentenoffset Kupplung" SWORD UMR_NM__1_1_0_S5_S3 1 100 -32768 32767 ECU_ADDRESS 0xFFF8D142 DISPLAY_IDENTIFIER mo_kpl_D /end MEASUREMENT
/begin MEASUREMENT iKupHysD.p_abssoll "Solldruck der Kupplung" UWORD UMR_BAR__1_1000_0_S5_S3 1 100 0 20 ECU_ADDRESS 0xFFF8D138 DISPLAY_IDENTIFIER p_abssoll_D /end MEASUREMENT
/begin MEASUREMENT iKupHysD.p_umkehr "Druckumkehrpunkt des Solldrucks" UWORD UMR_BAR__1_1000_0_S5_S3 1 100 0 20 ECU_ADDRESS 0xFFF8D13A DISPLAY_IDENTIFIER p_umkehr_D /end MEASUREMENT
/begin MEASUREMENT iKupHysD.p_umkehr_alt "Druckumkehrpunkt bei Gradientenwechsel des Solldrucks" UWORD UMR_BAR__1_1000_0_S5_S3 1 100 0 20 ECU_ADDRESS 0xFFF8D13C DISPLAY_IDENTIFIER p_umkehr_alt_D /end MEASUREMENT
/begin MEASUREMENT iKupHysD.pg_abssoll "Druckgradient Solldruck" SWORD UMR_BAR_SEC_1_1000_0_S5_S3 1 100 -32.768 32.767 ECU_ADDRESS 0xFFF8D13E DISPLAY_IDENTIFIER pg_abssoll_D /end MEASUREMENT
/begin MEASUREMENT iKupHysD.pg_wechsel_erkannt "Wechsel der Gradientenrichtung erkannt" UBYTE Conv.cModHysKo._.pg_wechsel_erkannt_S5_S3 1 100 0 1 BIT_MASK 0x1 ECU_ADDRESS 0xFFF8D146 DISPLAY_IDENTIFIER pg_wechsel_erkannt_D /end MEASUREMENT
/begin MEASUREMENT iKupHysD.pg_wirk "Druckgradient Wirkdruck" SWORD UMR_BAR_SEC_1_10_0_S5_S3 1 100 -3276.8 3276.7 ECU_ADDRESS 0xFFF8D158 DISPLAY_IDENTIFIER pg_wirk_D /end MEASUREMENT
/begin MEASUREMENT iKupHysD.po_kpl "Kompensation Druckoffset Kupplung" SWORD UMR_BAR__1_1000_0_S5_S3 1 100 -32.768 32.767 ECU_ADDRESS 0xFFF8D144 DISPLAY_IDENTIFIER po_kpl_D /end MEASUREMENT
/begin MEASUREMENT iKupHysD.po_vhyskomp "Druckoffset Verzugskompensation" SWORD UMR_BAR__1_1000_0_S5_S3 1 100 -32.768 32.767 ECU_ADDRESS 0xFFF8D15E DISPLAY_IDENTIFIER po_vhyskomp_D /end MEASUREMENT
/begin MEASUREMENT iKupHysD.po_wirk "Druckoffset Verzugskompensation" SWORD UMR_BAR__1_1000_0_S5_S3 1 100 0 20 ECU_ADDRESS 0xFFF8D156 DISPLAY_IDENTIFIER po_wirk_D /end MEASUREMENT
/begin MEASUREMENT iKupHysD.trajekfort_kpl "Trajektorienfortschritt Kupplung" UBYTE UMR_PROZENT__1_1_0_S5_S3 1 100 0 100 ECU_ADDRESS 0xFFF8D141 DISPLAY_IDENTIFIER trajekfort_kpl_D /end MEASUREMENT
/begin MEASUREMENT iKupHysD.trajekfort_stg "Trajektorienfortschritt Steuerung" UBYTE UMR_PROZENT__1_1_0_S5_S3 1 100 0 100 ECU_ADDRESS 0xFFF8D151 DISPLAY_IDENTIFIER trajekfort_stg_D /end MEASUREMENT
/begin MEASUREMENT iKupHysD.z_rampe "Der Zustand" UBYTE Conv.cModHysKo._.z_rampe_S5_S3 1 100 0 3 ECU_ADDRESS 0xFFF8D160 DISPLAY_IDENTIFIER z_rampe_D /end MEASUREMENT
/begin MEASUREMENT iKupHysE.f_ig_eds "Flag Gradientenrichtung Strom" UBYTE Conv.cModHysKo._.f_ig_eds_S5_S3 1 100 0 1 BIT_MASK 0x1 ECU_ADDRESS 0xFFF8D1B4 DISPLAY_IDENTIFIER f_ig_eds_E /end MEASUREMENT
/begin MEASUREMENT iKupHysE.f_pg_abssoll "Flag Gradientenrichtung" UBYTE Conv.cModHysKo._.f_pg_abssoll_S5_S3 1 100 0 1 BIT_MASK 0x1 ECU_ADDRESS 0xFFF8D1A4 DISPLAY_IDENTIFIER f_pg_abssoll_E /end MEASUREMENT
/begin MEASUREMENT iKupHysE.iDt1IEds.Pt1Si16.x "Filterwert" SLONG UMR___1_300_0_S5_S3 1 100 -7158278.82667 7158278.82333 ECU_ADDRESS 0xFFF8D1EC DISPLAY_IDENTIFIER Pt1Si16.iDt1IEds.iKupHysE /end MEASUREMENT
/begin MEASUREMENT iKupHysE.iDt1IEds.xp "Ableitung vom Eingangswert" SWORD UMR___1_1_0_S5_S3 1 100 -32768 32767 ECU_ADDRESS 0xFFF8D1E8 DISPLAY_IDENTIFIER iDt1IEds.iKupHysE /end MEASUREMENT
/begin MEASUREMENT iKupHysE.iDt1PAbssoll.Pt1Fl32.x "Filterwert" FLOAT32_IEEE UMR___1_1_0_S5_S3 1 100 -1000000000 1000000000 ECU_ADDRESS 0xFFF8D1DC FORMAT "%3.2" DISPLAY_IDENTIFIER Pt1Fl32.iDt1PAbssoll.iKupHysE /end MEASUREMENT
/begin MEASUREMENT iKupHysE.iDt1PAbssoll.xp "Ableitung vom Eingangswert" FLOAT32_IEEE UMR___1_1_0_S5_S3 1 100 -32768 32767 ECU_ADDRESS 0xFFF8D1D8 FORMAT "%3.2" DISPLAY_IDENTIFIER iDt1PAbssoll.iKupHysE /end MEASUREMENT
/begin MEASUREMENT iKupHysE.iDt1Verz.Pt1Fl32.x "Filterwert" FLOAT32_IEEE UMR___1_1_0_S5_S3 1 100 -1000000000 1000000000 ECU_ADDRESS 0xFFF8D1FC FORMAT "%3.2" DISPLAY_IDENTIFIER Pt1Fl32.iDt1Verz.iKupHysE /end MEASUREMENT
/begin MEASUREMENT iKupHysE.iDt1Verz.xp "Ableitung vom Eingangswert" FLOAT32_IEEE UMR___1_1_0_S5_S3 1 100 -32768 32767 ECU_ADDRESS 0xFFF8D1F8 FORMAT "%3.2" DISPLAY_IDENTIFIER iDt1Verz.iKupHysE /end MEASUREMENT
/begin MEASUREMENT iKupHysE.iPt2IoKomp.x "Filterwert" FLOAT32_IEEE UMR___1_1_0_S5_S3 1 100 -2147483648 2147483647 ECU_ADDRESS 0xFFF8D1F0 FORMAT "%3.2" DISPLAY_IDENTIFIER x.iPt2IoKomp.iKupHysE /end MEASUREMENT
/begin MEASUREMENT iKupHysE.iPt2IoKomp.xp "Ableitung vom Eingangswert" FLOAT32_IEEE UMR__SEC_1_1_0_S5_S3 1 100 -2147483648 2147483647 ECU_ADDRESS 0xFFF8D1F4 FORMAT "%3.2" DISPLAY_IDENTIFIER xp.iPt2IoKomp.iKupHysE /end MEASUREMENT
/begin MEASUREMENT iKupHysE.iPt2MoKomp.x "Filterwert" FLOAT32_IEEE UMR___1_1_0_S5_S3 1 100 -2147483648 2147483647 ECU_ADDRESS 0xFFF8D1E0 FORMAT "%3.2" DISPLAY_IDENTIFIER x.iPt2MoKomp.iKupHysE /end MEASUREMENT
/begin MEASUREMENT iKupHysE.iPt2MoKomp.xp "Ableitung vom Eingangswert" FLOAT32_IEEE UMR__SEC_1_1_0_S5_S3 1 100 -2147483648 2147483647 ECU_ADDRESS 0xFFF8D1E4 FORMAT "%3.2" DISPLAY_IDENTIFIER xp.iPt2MoKomp.iKupHysE /end MEASUREMENT
/begin MEASUREMENT iKupHysE.i_eds "Sollstrom des Schaltelements" UWORD UMR_MA__1_10_0_S5_S3 1 100 0 6553.5 ECU_ADDRESS 0xFFF8D1AC DISPLAY_IDENTIFIER i_eds_E /end MEASUREMENT
/begin MEASUREMENT iKupHysE.i_umkehr "Umkehrpunkt des Sollstroms" UWORD UMR_MA__1_10_0_S5_S3 1 100 0 6553.5 ECU_ADDRESS 0xFFF8D1AE DISPLAY_IDENTIFIER i_umkehr_E /end MEASUREMENT
/begin MEASUREMENT iKupHysE.i_umkehr_alt "Umkehrpunkt bei Gradientenwechsel des Sollstroms" UWORD UMR_MA__1_10_0_S5_S3 1 100 0 6553.5 ECU_ADDRESS 0xFFF8D1B0 DISPLAY_IDENTIFIER i_umkehr_alt_E /end MEASUREMENT
/begin MEASUREMENT iKupHysE.ig_eds "Gradient Sollstrom" SWORD UMR_MA_SEC_1_1_0_S5_S3 1 100 -32768 32767 ECU_ADDRESS 0xFFF8D1B2 DISPLAY_IDENTIFIER ig_eds_E /end MEASUREMENT
/begin MEASUREMENT iKupHysE.ig_wechsel_erkannt "Wechsel der Gradientenrichtung erkannt" UBYTE Conv.cModHysKo._.ig_wechsel_erkannt_S5_S3 1 100 0 1 BIT_MASK 0x1 ECU_ADDRESS 0xFFF8D1B8 DISPLAY_IDENTIFIER ig_wechsel_erkannt_E /end MEASUREMENT
/begin MEASUREMENT iKupHysE.io_stg "Kompensation Stromoffset" SWORD UMR_MA__1_10_0_S5_S3 1 100 -3276.8 3276.7 ECU_ADDRESS 0xFFF8D1B6 DISPLAY_IDENTIFIER io_stg_E /end MEASUREMENT
/begin MEASUREMENT iKupHysE.k_kf_out "Faktor aus Kennfeld" SWORD UMR___1_1000_0_S5_S3 1 100 0 32.767 ECU_ADDRESS 0xFFF8D1BE DISPLAY_IDENTIFIER k_kf_out_E /end MEASUREMENT
/begin MEASUREMENT iKupHysE.k_rampe_out "Faktor aus Rampe" SWORD UMR___1_1000_0_S5_S3 1 100 0 32.767 ECU_ADDRESS 0xFFF8D1C0 DISPLAY_IDENTIFIER k_rampe_out_E /end MEASUREMENT
/begin MEASUREMENT iKupHysE.mo_kpl "Kompensation Momentenoffset Kupplung" SWORD UMR_NM__1_1_0_S5_S3 1 100 -32768 32767 ECU_ADDRESS 0xFFF8D1A6 DISPLAY_IDENTIFIER mo_kpl_E /end MEASUREMENT
/begin MEASUREMENT iKupHysE.p_abssoll "Solldruck der Kupplung" UWORD UMR_BAR__1_1000_0_S5_S3 1 100 0 20 ECU_ADDRESS 0xFFF8D19C DISPLAY_IDENTIFIER p_abssoll_E /end MEASUREMENT
/begin MEASUREMENT iKupHysE.p_umkehr "Druckumkehrpunkt des Solldrucks" UWORD UMR_BAR__1_1000_0_S5_S3 1 100 0 20 ECU_ADDRESS 0xFFF8D19E DISPLAY_IDENTIFIER p_umkehr_E /end MEASUREMENT
/begin MEASUREMENT iKupHysE.p_umkehr_alt "Druckumkehrpunkt bei Gradientenwechsel des Solldrucks" UWORD UMR_BAR__1_1000_0_S5_S3 1 100 0 20 ECU_ADDRESS 0xFFF8D1A0 DISPLAY_IDENTIFIER p_umkehr_alt_E /end MEASUREMENT
/begin MEASUREMENT iKupHysE.pg_abssoll "Druckgradient Solldruck" SWORD UMR_BAR_SEC_1_1000_0_S5_S3 1 100 -32.768 32.767 ECU_ADDRESS 0xFFF8D1A2 DISPLAY_IDENTIFIER pg_abssoll_E /end MEASUREMENT
/begin MEASUREMENT iKupHysE.pg_wechsel_erkannt "Wechsel der Gradientenrichtung erkannt" UBYTE Conv.cModHysKo._.pg_wechsel_erkannt_S5_S3 1 100 0 1 BIT_MASK 0x1 ECU_ADDRESS 0xFFF8D1AA DISPLAY_IDENTIFIER pg_wechsel_erkannt_E /end MEASUREMENT
/begin MEASUREMENT iKupHysE.pg_wirk "Druckgradient Wirkdruck" SWORD UMR_BAR_SEC_1_10_0_S5_S3 1 100 -3276.8 3276.7 ECU_ADDRESS 0xFFF8D1BC DISPLAY_IDENTIFIER pg_wirk_E /end MEASUREMENT
/begin MEASUREMENT iKupHysE.po_kpl "Kompensation Druckoffset Kupplung" SWORD UMR_BAR__1_1000_0_S5_S3 1 100 -32.768 32.767 ECU_ADDRESS 0xFFF8D1A8 DISPLAY_IDENTIFIER po_kpl_E /end MEASUREMENT
/begin MEASUREMENT iKupHysE.po_vhyskomp "Druckoffset Verzugskompensation" SWORD UMR_BAR__1_1000_0_S5_S3 1 100 -32.768 32.767 ECU_ADDRESS 0xFFF8D1C2 DISPLAY_IDENTIFIER po_vhyskomp_E /end MEASUREMENT
/begin MEASUREMENT iKupHysE.po_wirk "Druckoffset Verzugskompensation" SWORD UMR_BAR__1_1000_0_S5_S3 1 100 0 20 ECU_ADDRESS 0xFFF8D1BA DISPLAY_IDENTIFIER po_wirk_E /end MEASUREMENT
/begin MEASUREMENT iKupHysE.trajekfort_kpl "Trajektorienfortschritt Kupplung" UBYTE UMR_PROZENT__1_1_0_S5_S3 1 100 0 100 ECU_ADDRESS 0xFFF8D1A5 DISPLAY_IDENTIFIER trajekfort_kpl_E /end MEASUREMENT
/begin MEASUREMENT iKupHysE.trajekfort_stg "Trajektorienfortschritt Steuerung" UBYTE UMR_PROZENT__1_1_0_S5_S3 1 100 0 100 ECU_ADDRESS 0xFFF8D1B5 DISPLAY_IDENTIFIER trajekfort_stg_E /end MEASUREMENT
/begin MEASUREMENT iKupHysE.z_rampe "Der Zustand" UBYTE Conv.cModHysKo._.z_rampe_S5_S3 1 100 0 3 ECU_ADDRESS 0xFFF8D1C4 DISPLAY_IDENTIFIER z_rampe_E /end MEASUREMENT
/begin MEASUREMENT iKupHysK0.f_ig_eds "Flag Gradientenrichtung Strom" UBYTE Conv.cModHysKo._.f_ig_eds_S5_S3 1 100 0 1 BIT_MASK 0x1 ECU_ADDRESS 0xFFF8D218 DISPLAY_IDENTIFIER f_ig_eds_0 /end MEASUREMENT
/begin MEASUREMENT iKupHysK0.f_pg_abssoll "Flag Gradientenrichtung" UBYTE Conv.cModHysKo._.f_pg_abssoll_S5_S3 1 100 0 1 BIT_MASK 0x1 ECU_ADDRESS 0xFFF8D208 DISPLAY_IDENTIFIER f_pg_abssoll_0 /end MEASUREMENT
/begin MEASUREMENT iKupHysK0.iDt1IEds.Pt1Si16.x "Filterwert" SLONG UMR___1_300_0_S5_S3 1 100 -7158278.82667 7158278.82333 ECU_ADDRESS 0xFFF8D250 DISPLAY_IDENTIFIER Pt1Si16.iDt1IEds.iKupHysK0 /end MEASUREMENT
/begin MEASUREMENT iKupHysK0.iDt1IEds.xp "Ableitung vom Eingangswert" SWORD UMR___1_1_0_S5_S3 1 100 -32768 32767 ECU_ADDRESS 0xFFF8D24C DISPLAY_IDENTIFIER iDt1IEds.iKupHysK0 /end MEASUREMENT
/begin MEASUREMENT iKupHysK0.iDt1PAbssoll.Pt1Fl32.x "Filterwert" FLOAT32_IEEE UMR___1_1_0_S5_S3 1 100 -1000000000 1000000000 ECU_ADDRESS 0xFFF8D240 FORMAT "%3.2" DISPLAY_IDENTIFIER Pt1Fl32.iDt1PAbssoll.iKupHysK0 /end MEASUREMENT
/begin MEASUREMENT iKupHysK0.iDt1PAbssoll.xp "Ableitung vom Eingangswert" FLOAT32_IEEE UMR___1_1_0_S5_S3 1 100 -32768 32767 ECU_ADDRESS 0xFFF8D23C FORMAT "%3.2" DISPLAY_IDENTIFIER iDt1PAbssoll.iKupHysK0 /end MEASUREMENT
/begin MEASUREMENT iKupHysK0.iDt1Verz.Pt1Fl32.x "Filterwert" FLOAT32_IEEE UMR___1_1_0_S5_S3 1 100 -1000000000 1000000000 ECU_ADDRESS 0xFFF8D260 FORMAT "%3.2" DISPLAY_IDENTIFIER Pt1Fl32.iDt1Verz.iKupHysK0 /end MEASUREMENT
/begin MEASUREMENT iKupHysK0.iDt1Verz.xp "Ableitung vom Eingangswert" FLOAT32_IEEE UMR___1_1_0_S5_S3 1 100 -32768 32767 ECU_ADDRESS 0xFFF8D25C FORMAT "%3.2" DISPLAY_IDENTIFIER iDt1Verz.iKupHysK0 /end MEASUREMENT
/begin MEASUREMENT iKupHysK0.iPt2IoKomp.x "Filterwert" FLOAT32_IEEE UMR___1_1_0_S5_S3 1 100 -2147483648 2147483647 ECU_ADDRESS 0xFFF8D254 FORMAT "%3.2" DISPLAY_IDENTIFIER x.iPt2IoKomp.iKupHysK0 /end MEASUREMENT
/begin MEASUREMENT iKupHysK0.iPt2IoKomp.xp "Ableitung vom Eingangswert" FLOAT32_IEEE UMR__SEC_1_1_0_S5_S3 1 100 -2147483648 2147483647 ECU_ADDRESS 0xFFF8D258 FORMAT "%3.2" DISPLAY_IDENTIFIER xp.iPt2IoKomp.iKupHysK0 /end MEASUREMENT
/begin MEASUREMENT iKupHysK0.iPt2MoKomp.x "Filterwert" FLOAT32_IEEE UMR___1_1_0_S5_S3 1 100 -2147483648 2147483647 ECU_ADDRESS 0xFFF8D244 FORMAT "%3.2" DISPLAY_IDENTIFIER x.iPt2MoKomp.iKupHysK0 /end MEASUREMENT
/begin MEASUREMENT iKupHysK0.iPt2MoKomp.xp "Ableitung vom Eingangswert" FLOAT32_IEEE UMR__SEC_1_1_0_S5_S3 1 100 -2147483648 2147483647 ECU_ADDRESS 0xFFF8D248 FORMAT "%3.2" DISPLAY_IDENTIFIER xp.iPt2MoKomp.iKupHysK0 /end MEASUREMENT
/begin MEASUREMENT iKupHysK0.i_eds "Sollstrom des Schaltelements" UWORD UMR_MA__1_10_0_S5_S3 1 100 0 6553.5 ECU_ADDRESS 0xFFF8D210 DISPLAY_IDENTIFIER i_eds_0 /end MEASUREMENT
/begin MEASUREMENT iKupHysK0.i_umkehr "Umkehrpunkt des Sollstroms" UWORD UMR_MA__1_10_0_S5_S3 1 100 0 6553.5 ECU_ADDRESS 0xFFF8D212 DISPLAY_IDENTIFIER i_umkehr_0 /end MEASUREMENT
/begin MEASUREMENT iKupHysK0.i_umkehr_alt "Umkehrpunkt bei Gradientenwechsel des Sollstroms" UWORD UMR_MA__1_10_0_S5_S3 1 100 0 6553.5 ECU_ADDRESS 0xFFF8D214 DISPLAY_IDENTIFIER i_umkehr_alt_0 /end MEASUREMENT
/begin MEASUREMENT iKupHysK0.ig_eds "Gradient Sollstrom" SWORD UMR_MA_SEC_1_1_0_S5_S3 1 100 -32768 32767 ECU_ADDRESS 0xFFF8D216 DISPLAY_IDENTIFIER ig_eds_0 /end MEASUREMENT
/begin MEASUREMENT iKupHysK0.ig_wechsel_erkannt "Wechsel der Gradientenrichtung erkannt" UBYTE Conv.cModHysKo._.ig_wechsel_erkannt_S5_S3 1 100 0 1 BIT_MASK 0x1 ECU_ADDRESS 0xFFF8D21C DISPLAY_IDENTIFIER ig_wechsel_erkannt_0 /end MEASUREMENT
/begin MEASUREMENT iKupHysK0.io_stg "Kompensation Stromoffset" SWORD UMR_MA__1_10_0_S5_S3 1 100 -3276.8 3276.7 ECU_ADDRESS 0xFFF8D21A DISPLAY_IDENTIFIER io_stg_0 /end MEASUREMENT
/begin MEASUREMENT iKupHysK0.k_kf_out "Faktor aus Kennfeld" SWORD UMR___1_1000_0_S5_S3 1 100 0 32.767 ECU_ADDRESS 0xFFF8D222 DISPLAY_IDENTIFIER k_kf_out_0 /end MEASUREMENT
/begin MEASUREMENT iKupHysK0.k_rampe_out "Faktor aus Rampe" SWORD UMR___1_1000_0_S5_S3 1 100 0 32.767 ECU_ADDRESS 0xFFF8D224 DISPLAY_IDENTIFIER k_rampe_out_0 /end MEASUREMENT
/begin MEASUREMENT iKupHysK0.mo_kpl "Kompensation Momentenoffset Kupplung" SWORD UMR_NM__1_1_0_S5_S3 1 100 -32768 32767 ECU_ADDRESS 0xFFF8D20A DISPLAY_IDENTIFIER mo_kpl_0 /end MEASUREMENT
/begin MEASUREMENT iKupHysK0.p_abssoll "Solldruck der Kupplung" UWORD UMR_BAR__1_1000_0_S5_S3 1 100 0 20 ECU_ADDRESS 0xFFF8D200 DISPLAY_IDENTIFIER p_abssoll_0 /end MEASUREMENT
/begin MEASUREMENT iKupHysK0.p_umkehr "Druckumkehrpunkt des Solldrucks" UWORD UMR_BAR__1_1000_0_S5_S3 1 100 0 20 ECU_ADDRESS 0xFFF8D202 DISPLAY_IDENTIFIER p_umkehr_0 /end MEASUREMENT
/begin MEASUREMENT iKupHysK0.p_umkehr_alt "Druckumkehrpunkt bei Gradientenwechsel des Solldrucks" UWORD UMR_BAR__1_1000_0_S5_S3 1 100 0 20 ECU_ADDRESS 0xFFF8D204 DISPLAY_IDENTIFIER p_umkehr_alt_0 /end MEASUREMENT
/begin MEASUREMENT iKupHysK0.pg_abssoll "Druckgradient Solldruck" SWORD UMR_BAR_SEC_1_1000_0_S5_S3 1 100 -32.768 32.767 ECU_ADDRESS 0xFFF8D206 DISPLAY_IDENTIFIER pg_abssoll_0 /end MEASUREMENT
/begin MEASUREMENT iKupHysK0.pg_wechsel_erkannt "Wechsel der Gradientenrichtung erkannt" UBYTE Conv.cModHysKo._.pg_wechsel_erkannt_S5_S3 1 100 0 1 BIT_MASK 0x1 ECU_ADDRESS 0xFFF8D20E DISPLAY_IDENTIFIER pg_wechsel_erkannt_0 /end MEASUREMENT
/begin MEASUREMENT iKupHysK0.pg_wirk "Druckgradient Wirkdruck" SWORD UMR_BAR_SEC_1_10_0_S5_S3 1 100 -3276.8 3276.7 ECU_ADDRESS 0xFFF8D220 DISPLAY_IDENTIFIER pg_wirk_0 /end MEASUREMENT
/begin MEASUREMENT iKupHysK0.po_kpl "Kompensation Druckoffset Kupplung" SWORD UMR_BAR__1_1000_0_S5_S3 1 100 -32.768 32.767 ECU_ADDRESS 0xFFF8D20C DISPLAY_IDENTIFIER po_kpl_0 /end MEASUREMENT
/begin MEASUREMENT iKupHysK0.po_vhyskomp "Druckoffset Verzugskompensation" SWORD UMR_BAR__1_1000_0_S5_S3 1 100 -32.768 32.767 ECU_ADDRESS 0xFFF8D226 DISPLAY_IDENTIFIER po_vhyskomp_0 /end MEASUREMENT
/begin MEASUREMENT iKupHysK0.po_wirk "Druckoffset Verzugskompensation" SWORD UMR_BAR__1_1000_0_S5_S3 1 100 0 20 ECU_ADDRESS 0xFFF8D21E DISPLAY_IDENTIFIER po_wirk_0 /end MEASUREMENT
/begin MEASUREMENT iKupHysK0.trajekfort_kpl "Trajektorienfortschritt Kupplung" UBYTE UMR_PROZENT__1_1_0_S5_S3 1 100 0 100 ECU_ADDRESS 0xFFF8D209 DISPLAY_IDENTIFIER trajekfort_kpl_0 /end MEASUREMENT
/begin MEASUREMENT iKupHysK0.trajekfort_stg "Trajektorienfortschritt Steuerung" UBYTE UMR_PROZENT__1_1_0_S5_S3 1 100 0 100 ECU_ADDRESS 0xFFF8D219 DISPLAY_IDENTIFIER trajekfort_stg_0 /end MEASUREMENT
/begin MEASUREMENT iKupHysK0.z_rampe "Der Zustand" UBYTE Conv.cModHysKo._.z_rampe_S5_S3 1 100 0 3 ECU_ADDRESS 0xFFF8D228 DISPLAY_IDENTIFIER z_rampe_0 /end MEASUREMENT
/begin MEASUREMENT iKupK0.cModPVorg._.f_anst_statisch "Flag für die statische Ansteuerung" UBYTE Conv.cModPVorg._.f_anst_statisch_S5_S3 1 100 0 1 BIT_MASK 0x1 ECU_ADDRESS 0xFFF8BDD3 DISPLAY_IDENTIFIER f_anst_statisch_K0 /end MEASUREMENT
/begin MEASUREMENT iKupK0.cModPVorg._.f_druck_vorgegeben "Flag, ob Druck an dieses Element in diesem Zyklus schon vorgegeben wurde" UBYTE Conv.cModPVorg._.f_druck_vorgegeben_S5_S3 1 100 0 1 BIT_MASK 0x1 ECU_ADDRESS 0xFFF8BDD2 DISPLAY_IDENTIFIER f_druck_vorgegeben_K0 /end MEASUREMENT
/begin MEASUREMENT iKupK0.cModPVorg._.fktn_druckvorgabe "Die ansteuernde Funktion" UBYTE Conv.cModPVorg._.fktn_druckvorgabe_S5_S3 1 100 0 29 ECU_ADDRESS 0xFFF8BDD4 DISPLAY_IDENTIFIER fktn_druckvorgabe_K0 /end MEASUREMENT
/begin MEASUREMENT iKupK0.cModPVorg._.p_abssoll "Solldruck der Kupplung" UWORD UMR_BAR__1_1000_0_S5_S3 1 100 0 20 ECU_ADDRESS 0xFFF8BDCE DISPLAY_IDENTIFIER p_abssoll_K0 /end MEASUREMENT
/begin MEASUREMENT iKupK0.cModPVorg._.p_abssoll_sys "Solldruck der Kupplung, begrentzt auf Systemdruck" UWORD UMR_BAR__1_1000_0_S5_S3 1 100 0 20 ECU_ADDRESS 0xFFF8BDD0 DISPLAY_IDENTIFIER p_abssoll_sys_K0 /end MEASUREMENT
/begin MEASUREMENT iKupK0.cModPVorg._.p_vorgabe "Solldruck der Kupplung" UWORD UMR_BAR__1_1000_0_S5_S3 1 100 0 20 ECU_ADDRESS 0xFFF8BDCC DISPLAY_IDENTIFIER p_vorgabe_K0 /end MEASUREMENT
/begin MEASUREMENT iKupK0.cModPVorg._.typ_druckvorgabe "Der Typ des angesteuerten Druckes" UBYTE Conv.cModPVorg._.typ_druckvorgabe_S5_S3 1 100 0 4 ECU_ADDRESS 0xFFF8BDD5 DISPLAY_IDENTIFIER typ_druckvorgabe_K0 /end MEASUREMENT
/begin MEASUREMENT iKupK0.f_erste_bef "Flag für erste Befüllung" UBYTE Conv.cModKuppl._.f_erste_bef_S5_S3 1 100 0 1 BIT_MASK 0x1 ECU_ADDRESS 0xFFF8BE1E DISPLAY_IDENTIFIER f_erste_bef_0 /end MEASUREMENT
/begin MEASUREMENT iKupK0.f_erste_bef_aus_sb "Flag für erste Befüllung aus standby" UBYTE Conv.cModKuppl._.f_erste_bef_aus_sb_S5_S3 1 100 0 1 BIT_MASK 0x1 ECU_ADDRESS 0xFFF8BE1F DISPLAY_IDENTIFIER f_erste_bef_aus_sb_0 /end MEASUREMENT
/begin MEASUREMENT iKupK0.f_fuellopt "Flag für optimierte Befüllung" UBYTE Conv.cModKuppl._.f_fuellopt_S5_S3 1 100 0 1 BIT_MASK 0x1 ECU_ADDRESS 0xFFF8BE1B DISPLAY_IDENTIFIER f_fuellopt_0 /end MEASUREMENT
/begin MEASUREMENT iKupK0.f_fuellred "Flag für reduzierte Befüllung" UBYTE Conv.cModKuppl._.f_fuellred_S5_S3 1 100 0 1 BIT_MASK 0x1 ECU_ADDRESS 0xFFF8BE1A DISPLAY_IDENTIFIER f_fuellred_0 /end MEASUREMENT
/begin MEASUREMENT iKupK0.f_geschlossen "Flag für Kupplung geschlossen" UBYTE Conv.cModKuppl._.f_geschlossen_S5_S3 1 100 0 1 BIT_MASK 0x1 ECU_ADDRESS 0xFFF8BE1D DISPLAY_IDENTIFIER f_geschlossen_0 /end MEASUREMENT
/begin MEASUREMENT iKupK0.f_kolben_anlegen "Flag für Kolben anlegen" UBYTE Conv.cModKuppl._.f_kolben_anlegen_S5_S3 1 100 0 1 BIT_MASK 0x1 ECU_ADDRESS 0xFFF8BE1C DISPLAY_IDENTIFIER f_kolben_anlegen_0 /end MEASUREMENT
/begin MEASUREMENT iKupK0.f_sf_ausgabe_aktiv "Flag für Schnellfüllung" UBYTE Conv.cModKuppl._.f_sf_ausgabe_aktiv_S5_S3 1 100 0 1 BIT_MASK 0x1 ECU_ADDRESS 0xFFF8BE17 DISPLAY_IDENTIFIER f_sf_ausgabe_aktiv_0 /end MEASUREMENT
/begin MEASUREMENT iKupK0.f_sf_vorhanden "Flag für ausgegebene SF" UBYTE Conv.cModKuppl._.f_sf_vorhanden_S5_S3 1 100 0 1 BIT_MASK 0x1 ECU_ADDRESS 0xFFF8BE18 DISPLAY_IDENTIFIER f_sf_vorhanden_0 /end MEASUREMENT
/begin MEASUREMENT iKupK0.f_strom_pre_puls_erf "Flag für Stromprepuls" UBYTE Conv.cModKuppl._.f_strom_pre_puls_erf_S5_S3 1 100 0 1 BIT_MASK 0x1 ECU_ADDRESS 0xFFF8BE20 DISPLAY_IDENTIFIER f_strom_pre_puls_erf_0 /end MEASUREMENT
/begin MEASUREMENT iKupK0.f_stromschl_angefordert "Flag zum ausführen der Stromschleife" UBYTE Conv.cModKuppl._.f_stromschl_angefordert_S5_S3 1 100 0 1 BIT_MASK 0x1 ECU_ADDRESS 0xFFF8BE21 DISPLAY_IDENTIFIER f_stromschl_angefordert_0 /end MEASUREMENT
/begin MEASUREMENT iKupK0.kolben_pos "Die aktuelle Kolbenposition" UWORD UMR_PROZENT__1_100_0_S5_S3 1 100 0 100 ECU_ADDRESS 0xFFF8BE0C DISPLAY_IDENTIFIER kolben_pos_0 /end MEASUREMENT
/begin MEASUREMENT iKupK0.kolben_pos_gelesen "Die aktuelle Kolbenposition wurde aus dem EEPROM gelesen" UBYTE Conv.cModKuppl._.kolben_pos_gelesen_S5_S3 1 100 0 1 BIT_MASK 0x1 ECU_ADDRESS 0xFFF8BE0E DISPLAY_IDENTIFIER kolben_pos_gelesen_0 /end MEASUREMENT
/begin MEASUREMENT iKupK0.kolben_posbas "Position, bei der der Kolben gestartet ist" UWORD UMR_PROZENT__1_100_0_S5_S3 1 100 0 100 ECU_ADDRESS 0xFFF8BE10 DISPLAY_IDENTIFIER kolben_posbas_0 /end MEASUREMENT
/begin MEASUREMENT iKupK0.kpl_inaktiv "Flag, ob Kupplung inaktiv ist" UBYTE Conv.cModKuppl._.kpl_inaktiv_S5_S3 1 100 0 1 BIT_MASK 0x1 ECU_ADDRESS 0xFFF8BE19 DISPLAY_IDENTIFIER kpl_inaktiv_0 /end MEASUREMENT
/begin MEASUREMENT iKupK0.kup_index_spsas "Der Spontanitaetsindex dieser Kupplung" UBYTE Conv.cModKuppl._.kup_index_spsas_S5_S3 1 100 0 2 ECU_ADDRESS 0xFFF8BE16 DISPLAY_IDENTIFIER kup_index_spsas_0 /end MEASUREMENT
/begin MEASUREMENT iKupK0.kup_schaltart_sas "Die Schaltart dieser Kupplung (für Bestimmung offset auf SF-Zeit)" UBYTE Conv.cModKuppl._.kup_schaltart_sas_S5_S3 1 100 0 5 ECU_ADDRESS 0xFFF8BE15 DISPLAY_IDENTIFIER kup_schaltart_sas_0 /end MEASUREMENT
/begin MEASUREMENT iKupK0.kv_nummer "Die Kupplungsventilnummer" UBYTE UMR___1_1_0_S5_S3 1 100 0 9 ECU_ADDRESS 0xFFF8BE14 DISPLAY_IDENTIFIER kv_nummer_0 /end MEASUREMENT
/begin MEASUREMENT iKupK0.n_kup_zbeg "Die Kupplungsdrehzahl zu beginn des Zustandes" UWORD UMR_U_MIN_1_1_0_S5_S3 1 100 0 8160 ECU_ADDRESS 0xFFF8BE12 DISPLAY_IDENTIFIER n_kup_zbeg_0 /end MEASUREMENT
/begin MEASUREMENT iKupK0.p_absist "Istdruck der Kupplung" UWORD UMR_BAR__1_1000_0_S5_S3 1 100 0 20 ECU_ADDRESS 0xFFF8BE08 DISPLAY_IDENTIFIER p_absist_0 /end MEASUREMENT
/begin MEASUREMENT iKupK0.p_filter.letzter_ms_timer "letzter BS-Timer" UWORD UMR_MSEC__1_1_0_S5_S3 1 100 0 65535 ECU_ADDRESS 0xFFF8BDE4 DISPLAY_IDENTIFIER letzter_ms_timer.p_filter.iKupK0 /end MEASUREMENT
/begin MEASUREMENT iKupK0.p_filter.x "letzter Wert" SLONG UMR___1_1_0_S5_S3 1 100 -2147483648 2147483647 ECU_ADDRESS 0xFFF8BDE0 DISPLAY_IDENTIFIER x.p_filter.iKupK0 /end MEASUREMENT
/begin MEASUREMENT iKupK0.p_fmin "minimale Fülldruck der Kupplung" UWORD UMR_BAR__1_1000_0_S5_S3 1 100 0 20 ECU_ADDRESS 0xFFF8BE0A DISPLAY_IDENTIFIER p_fmin_0 /end MEASUREMENT
/begin MEASUREMENT iKupK0.t0_sf "Gesamtschnellfüllzeit" UWORD UMR_MSEC__1_1_0_S5_S3 1 100 0 20000 ECU_ADDRESS 0xFFF8BE00 DISPLAY_IDENTIFIER t0_sf_0 /end MEASUREMENT
/begin MEASUREMENT iKupK0.t_kpl_aktiv.timer "Der aktuelle Timerwert" ULONG UMR_MSEC__10_1_0_S5_S3 1 100 0 42949672950 ECU_ADDRESS 0xFFF8BDEC DISPLAY_IDENTIFIER t_kpl_aktiv.iKupK0 /end MEASUREMENT
/begin MEASUREMENT iKupK0.t_kpl_inaktiv.timer "Der aktuelle Timerwert" ULONG UMR_MSEC__10_1_0_S5_S3 1 100 0 42949672950 ECU_ADDRESS 0xFFF8BDF0 DISPLAY_IDENTIFIER t_kpl_inaktiv.iKupK0 /end MEASUREMENT
/begin MEASUREMENT iKupK0.t_lauf_entleer "Kolbenlaufzeit beim leeren" UWORD UMR_MSEC__1_1_0_S5_S3 1 100 0 20000 ECU_ADDRESS 0xFFF8BE06 DISPLAY_IDENTIFIER t_lauf_entleer_0 /end MEASUREMENT
/begin MEASUREMENT iKupK0.t_lauf_fuell "Kolbenlaufzeit beim füllen" UWORD UMR_MSEC__1_1_0_S5_S3 1 100 0 20000 ECU_ADDRESS 0xFFF8BE04 DISPLAY_IDENTIFIER t_lauf_fuell_0 /end MEASUREMENT
/begin MEASUREMENT iKupK0.timer_sas_ende_mit_pmax.timer "Der aktuelle Timerwert" UBYTE UMR_MSEC__10_1_0_S5_S3 1 100 0 2550 ECU_ADDRESS 0xFFF8BDEA DISPLAY_IDENTIFIER timer_sas_ende_mit_pmax.iKupK0 /end MEASUREMENT
/begin MEASUREMENT iKupK0.totzeit "Die Totzeit" UWORD UMR_MSEC__1_1_0_S5_S3 1 100 0 2000 ECU_ADDRESS 0xFFF8BE02 DISPLAY_IDENTIFIER totzeit_0 /end MEASUREMENT
/begin MEASUREMENT iKupK0.zustand "Der Zustand" UBYTE Conv.cModKuppl._.zustand_S5_S3 1 100 0 5 ECU_ADDRESS 0xFFF8BDFE DISPLAY_IDENTIFIER zustand_0 /end MEASUREMENT
/begin MEASUREMENT iKupK0.zustandstimer.timer "Der aktuelle Timerwert" UWORD UMR_MSEC__1_1_0_S5_S3 1 100 0 65535 ECU_ADDRESS 0xFFF8BDE8 DISPLAY_IDENTIFIER zustandstimer.iKupK0 /end MEASUREMENT
/begin MEASUREMENT iModHydlg.err_v_nr_abgldat "Fehler der Versionnummer der Abgleichdaten im KD-Boot" UBYTE Conv.cModHydlg._.err_v_nr_abgldat_S5_S3 1 100 0 1 BIT_MASK 0x1 ECU_ADDRESS 0xFFF8BBF2 DISPLAY_IDENTIFIER err_v_nr_abgldat.iModHydlg /end MEASUREMENT
/begin MEASUREMENT iModHydlg.status_pruef_abgldat "Pruefergebnis Abgleichdaten im KD-Boot" UBYTE Conv.cModHydlg._.status_pruef_abgldat_S5_S3 1 100 0 1 BIT_MASK 0x1 ECU_ADDRESS 0xFFF8BBF0 DISPLAY_IDENTIFIER status_pruef_abgldat.iModHydlg /end MEASUREMENT
/begin MEASUREMENT iModHydlg.version_abgleichdaten "Von der Software erwartete Versionsnummer der Abgleichdaten" ULONG Conv.cModHydlg._.version_abgleichdaten_S5_S3 1 100 0 255 ECU_ADDRESS 0xFFF8BBF4 DISPLAY_IDENTIFIER version_abgleichdaten.iModHydlg /end MEASUREMENT
/begin RECORD_LAYOUT ZF_KW_INT32_S3_S3 FNC_VALUES 1 SLONG COLUMN_DIR DIRECT /end RECORD_LAYOUT
/begin RECORD_LAYOUT ZF_KW_INT32_S4_S3 FNC_VALUES 1 SLONG COLUMN_DIR DIRECT /end RECORD_LAYOUT
/begin RECORD_LAYOUT ZF_KW_INT8_S1_S3 FNC_VALUES 1 SBYTE COLUMN_DIR DIRECT /end RECORD_LAYOUT
/begin RECORD_LAYOUT ZF_KW_INT8_S3_S3 FNC_VALUES 1 SBYTE COLUMN_DIR DIRECT /end RECORD_LAYOUT
/begin RECORD_LAYOUT ZF_KW_INT8_S4_S3 FNC_VALUES 1 SBYTE COLUMN_DIR DIRECT /end RECORD_LAYOUT
/begin RECORD_LAYOUT ZF_kw_si32_S5_S3 FNC_VALUES 1 SLONG COLUMN_DIR DIRECT /end RECORD_LAYOUT
/begin RECORD_LAYOUT ZF_kw_tGang_S5_S3 FNC_VALUES 1 SBYTE COLUMN_DIR DIRECT /end RECORD_LAYOUT
/begin RECORD_LAYOUT ZF_TAB2D_INT16_S1_S3 FNC_VALUES 3 SWORD ROW_DIR DIRECT NO_AXIS_PTS_X 1 ULONG NO_AXIS_PTS_Y 2 ULONG /end RECORD_LAYOUT
/begin RECORD_LAYOUT ZF_TAB2D_INT16_S2_S3 FNC_VALUES 3 SWORD ROW_DIR DIRECT NO_AXIS_PTS_X 1 ULONG NO_AXIS_PTS_Y 2 ULONG /end RECORD_LAYOUT
/begin RECORD_LAYOUT ZF_TAB2D_INT16_S3_S3 FNC_VALUES 3 SWORD ROW_DIR DIRECT NO_AXIS_PTS_X 1 ULONG NO_AXIS_PTS_Y 2 ULONG /end RECORD_LAYOUT
/begin RECORD_LAYOUT ZF_TAB2D_INT16_S4_S3 FNC_VALUES 3 SWORD ROW_DIR DIRECT NO_AXIS_PTS_X 1 ULONG NO_AXIS_PTS_Y 2 ULONG /end RECORD_LAYOUT
/begin RECORD_LAYOUT ZF_TAB2D_INT32_S1_S3 FNC_VALUES 3 SLONG ROW_DIR DIRECT NO_AXIS_PTS_X 1 ULONG NO_AXIS_PTS_Y 2 ULONG /end RECORD_LAYOUT
/begin RECORD_LAYOUT ZF_TAB2D_INT32_S2_S3 FNC_VALUES 3 SLONG ROW_DIR DIRECT NO_AXIS_PTS_X 1 ULONG NO_AXIS_PTS_Y 2 ULONG /end RECORD_LAYOUT
/begin RECORD_LAYOUT ZF_TAB2D_INT32_S3_S3 FNC_VALUES 3 SLONG ROW_DIR DIRECT NO_AXIS_PTS_X 1 ULONG NO_AXIS_PTS_Y 2 ULONG /end RECORD_LAYOUT
/begin RECORD_LAYOUT ZF_TAB2D_INT32_S4_S3 FNC_VALUES 3 SLONG ROW_DIR DIRECT NO_AXIS_PTS_X 1 ULONG NO_AXIS_PTS_Y 2 ULONG /end RECORD_LAYOUT
/begin RECORD_LAYOUT ZF_TAB2D_INT8_S1_S3 FNC_VALUES 3 SBYTE ROW_DIR DIRECT NO_AXIS_PTS_X 1 ULONG NO_AXIS_PTS_Y 2 ULONG /end RECORD_LAYOUT
/begin RECORD_LAYOUT ZF_TAB2D_INT8_S2_S3 FNC_VALUES 3 SBYTE ROW_DIR DIRECT NO_AXIS_PTS_X 1 ULONG NO_AXIS_PTS_Y 2 ULONG /end RECORD_LAYOUT
/begin RECORD_LAYOUT ZF_TAB2D_INT8_S3_S3 FNC_VALUES 3 SBYTE ROW_DIR DIRECT NO_AXIS_PTS_X 1 ULONG NO_AXIS_PTS_Y 2 ULONG /end RECORD_LAYOUT
/begin RECORD_LAYOUT ZF_TAB2D_INT8_S4_S3 FNC_VALUES 3 SBYTE ROW_DIR DIRECT NO_AXIS_PTS_X 1 ULONG NO_AXIS_PTS_Y 2 ULONG /end RECORD_LAYOUT
/begin RECORD_LAYOUT ZF_TAB2D_NAT16_S1_S3 FNC_VALUES 3 UWORD ROW_DIR DIRECT NO_AXIS_PTS_X 1 ULONG NO_AXIS_PTS_Y 2 ULONG /end RECORD_LAYOUT
/begin RECORD_LAYOUT ZF_TAB2D_NAT16_S3_S3 FNC_VALUES 3 UWORD ROW_DIR DIRECT NO_AXIS_PTS_X 1 ULONG NO_AXIS_PTS_Y 2 ULONG /end RECORD_LAYOUT
/begin RECORD_LAYOUT ZF_TAB2D_NAT16_S4_S3 FNC_VALUES 3 UWORD ROW_DIR DIRECT NO_AXIS_PTS_X 1 ULONG NO_AXIS_PTS_Y 2 ULONG /end RECORD_LAYOUT
/begin RECORD_LAYOUT ZF_TAB2D_NAT32_S2_S3 FNC_VALUES 3 ULONG ROW_DIR DIRECT NO_AXIS_PTS_X 1 ULONG NO_AXIS_PTS_Y 2 ULONG /end RECORD_LAYOUT
/begin RECORD_LAYOUT ZF_TAB2D_NAT32_S3_S3 FNC_VALUES 3 ULONG ROW_DIR DIRECT NO_AXIS_PTS_X 1 ULONG NO_AXIS_PTS_Y 2 ULONG /end RECORD_LAYOUT
/begin RECORD_LAYOUT ZF_TAB2D_NAT8_S1_S3 FNC_VALUES 3 UBYTE ROW_DIR DIRECT NO_AXIS_PTS_X 1 ULONG NO_AXIS_PTS_Y 2 ULONG /end RECORD_LAYOUT
/begin RECORD_LAYOUT ZF_TAB2D_NAT8_S4_S3 FNC_VALUES 3 UBYTE ROW_DIR DIRECT NO_AXIS_PTS_X 1 ULONG NO_AXIS_PTS_Y 2 ULONG /end RECORD_LAYOUT
/begin RECORD_LAYOUT ZF_TAB2D_OI_INT16_S2_S3 FNC_VALUES 1 SWORD ROW_DIR DIRECT /end RECORD_LAYOUT
/begin RECORD_LAYOUT ZF_TAB2D_OI_INT16_S3_S3 FNC_VALUES 1 SWORD ROW_DIR DIRECT /end RECORD_LAYOUT
/begin RECORD_LAYOUT ZF_TAB2D_OI_INT16_S4_S3 FNC_VALUES 1 SWORD ROW_DIR DIRECT /end RECORD_LAYOUT
/begin RECORD_LAYOUT ZF_TAB2D_OI_INT32_S2_S3 FNC_VALUES 1 SLONG ROW_DIR DIRECT /end RECORD_LAYOUT
/end MODULE
/end PROJECT
