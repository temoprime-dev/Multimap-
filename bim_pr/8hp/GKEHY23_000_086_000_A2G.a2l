ASAP2_VERSION 1 51
/begin PROJECT ZHBC8600 "Gen2_BMW_System_Supplier_Lib"
/begin MODULE CPP ""
/begin MOD_COMMON "" BYTE_ORDER MSB_FIRST ALIGNMENT_BYTE 1 ALIGNMENT_WORD 2 ALIGNMENT_LONG 4 ALIGNMENT_FLOAT32_IEEE 4 ALIGNMENT_FLOAT64_IEEE 1 /end MOD_COMMON
/begin COMPU_VTAB CONV_TAB_E_FEHLERIEP_S6_S3 "Conversion table" TAB_VERB 2 0 "NORMALBETRIEB" 1 "FEHLER" DEFAULT_VALUE "" /end COMPU_VTAB
/begin COMPU_VTAB CONV_TAB_E_HYBFKT_S6_S3 "Conversion table" TAB_VERB 16 0 "PASSIV" 1 "ANKOPPELN_VM" 2 "ABKOPPELN_VM" 3 "GANGEINLEGEN" 4 "GANGAUSLEGEN" 5 "OHNABLAUFFKT" 6 "DIREKTSTART" 7 "VM_ZUSTART" 8 "ABSTELLEN_VM" 9 "NICHTDEFINIERT_4" 10 "VM_SCHLEPPSTART" 11 "VM_NOTSTART" 12 "VM_EIN" 13 "VM_AUS" 14 "NICHTDEFINIERT_3" 15 "FEHLER" DEFAULT_VALUE "" /end COMPU_VTAB
/begin COMPU_VTAB CONV_TAB_E_POS_S6_S3 "Conversion table" TAB_VERB 9 0 "D1" 1 "D2" 2 "D3" 3 "D4" 4 "D5" 5 "D" 6 "N" 7 "R" 8 "P" DEFAULT_VALUE "" /end COMPU_VTAB
/begin COMPU_VTAB CONV_TAB_E_SIGSTATUS_S6_S3 "Conversion table" TAB_VERB 3 0 "SIGNAL_OK" 1 "ERSATZWERT" 2 "SIGNAL_FEHLER" DEFAULT_VALUE "" /end COMPU_VTAB
/begin COMPU_VTAB CONV_TAB_E_STATUSADA_S6_S3 "Conversion table" TAB_VERB 3 0 "KEINADAPTION" 1 "TOUCHPOINT_ADAPTION" 2 "REIBWERT_ADAPTION" DEFAULT_VALUE "" /end COMPU_VTAB
/begin COMPU_VTAB CONV_TAB_E_STATUSIAE_S6_S3 "Conversion table" TAB_VERB 9 0 "NICHTDEFINIERT" 1 "OFFEN" 2 "ANGELEGT" 3 "ANFAHREN" 4 "ENTKOPPELT" 5 "ENTKOPPELT_ANFAHREN" 6 "SYNCHRONISIEREN" 7 "GESCHLOSSEN" 8 "OEFFNEN" DEFAULT_VALUE "" /end COMPU_VTAB
/begin COMPU_VTAB CONV_TAB_E_STATUSIEP_S6_S3 "Conversion table" TAB_VERB 5 0 "AUS" 1 "SLEEP" 2 "LP1" 3 "LP2" 4 "LP3" DEFAULT_VALUE "" /end COMPU_VTAB
/begin COMPU_VTAB CONV_TAB_E_STATUSK0_S6_S3 "Conversion table" TAB_VERB 6 0 "OFFEN" 1 "ANGELEGT" 2 "DRUCKSTELLUNG" 3 "SCHLUPFGEREGELT" 4 "GEREGELTGESCHL" 5 "GESCHLOSSEN" DEFAULT_VALUE "" /end COMPU_VTAB
/begin COMPU_VTAB CONV_TAB_E_STATUSKSL_S6_S3 "Conversion table" TAB_VERB 7 0 "KEIN_KRAFTSCHLUSS" 1 "VORW_AUF_ABBAUEND" 2 "VORWAERTS" 3 "RUECKW_AUF_ABBAUEND" 4 "RUECKWAERTS" 5 "VORWAERTS_SCHLUPF" 6 "RUECKWAERTS_SCHLUPF" DEFAULT_VALUE "" /end COMPU_VTAB
/begin COMPU_VTAB CONV_TAB_E_STATUSPSY_S6_S3 "Conversion table" TAB_VERB 5 0 "AUS" 1 "NICHTDEFINIERT" 2 "LP1" 3 "LP2" 4 "LP3" DEFAULT_VALUE "" /end COMPU_VTAB
/begin COMPU_VTAB CONV_TAB_E_STBZHAS_S6_S3 "Conversion table" TAB_VERB 16 0 "INIT_INAKTIV" 1 "ANGEKOPPELT" 2 "ENTKOPPELT" 3 "EFAHREN" 4 "STOP" 5 "LADEN" 6 "ENTK_VMEIN" 7 "EFAHREN_VMEIN" 8 "HYBRID" 9 "NICHTDEFINIERT_1" 10 "NICHTDEFINIERT_2" 11 "NICHTDEFINIERT_3" 12 "NICHTDEFINIERT_4" 13 "NICHTDEFINIERT_5" 14 "INIT_KL15" 15 "FEHLER" DEFAULT_VALUE "" /end COMPU_VTAB
/begin COMPU_VTAB CONV_TAB_E_ZIEP_S6_S3 "Conversion table" TAB_VERB 5 0 "AUS" 1 "SLEEP" 2 "LP1" 3 "LP2" 4 "LP3" DEFAULT_VALUE "" /end COMPU_VTAB
/begin COMPU_VTAB CONV_TAB_E_ZK0_S6_S3 "Conversion table" TAB_VERB 6 0 "OEFFNENSW" 1 "BEFUELLEN" 2 "DRUCKSTELLUNG" 3 "SCHLUPFREGELUNG" 4 "GEREGELTGESCHL" 5 "GESCHLOSSEN" DEFAULT_VALUE "" /end COMPU_VTAB
/begin COMPU_VTAB CONV_TAB_E_ZK0FSTIN_S6_S3 "Conversion table" TAB_VERB 4 0 "OFFEN" 1 "SCHLUPFGEREGELT" 2 "GEREGELTGESCHL" 3 "GESCHLOSSEN" DEFAULT_VALUE "" /end COMPU_VTAB
/begin COMPU_VTAB CONV_TAB_E_ZMODUSIAE_S6_S3 "Conversion table" TAB_VERB 3 0 "EFAHREN_SCHLUPF" 1 "EFAHREN_KRAFTSCHL" 2 "HYBRIDFAHREN" DEFAULT_VALUE "" /end COMPU_VTAB
/begin COMPU_VTAB CONV_TAB_E_ZMODUSIEP_S6_S3 "Conversion table" TAB_VERB 5 0 "KEINVORGABE" 1 "AUS" 2 "LP1" 3 "LP2" 4 "LP3" DEFAULT_VALUE "" /end COMPU_VTAB
/begin COMPU_VTAB CONV_TAB_E_ZNLLSOLL_S6_S3 "Conversion table" TAB_VERB 3 0 "KEINANF" 1 "ANF_ADAP" 2 "ANF_ALLG" DEFAULT_VALUE "" /end COMPU_VTAB
/begin COMPU_METHOD b_int_S6_S3 "Bit Feld" RAT_FUNC "%10.0" "-" COEFFS 0 1 0 0 0 1 /end COMPU_METHOD
/begin COMPU_METHOD c_int_S6_S3 "Temperatur" RAT_FUNC "%12.6" "°C" COEFFS 0 1 0 0 0 1 /end COMPU_METHOD
/begin COMPU_METHOD E_FEHLERIEP_S6_S3 "" TAB_VERB "%12.6" "" COMPU_TAB_REF CONV_TAB_E_FEHLERIEP_S6_S3 /end COMPU_METHOD
/begin COMPU_METHOD E_HYBFKT_S6_S3 "" TAB_VERB "%12.6" "" COMPU_TAB_REF CONV_TAB_E_HYBFKT_S6_S3 /end COMPU_METHOD
/begin COMPU_METHOD E_POS_S6_S3 "" TAB_VERB "%12.6" "" COMPU_TAB_REF CONV_TAB_E_POS_S6_S3 /end COMPU_METHOD
/begin COMPU_METHOD E_SIGSTATUS_S6_S3 "" TAB_VERB "%12.6" "" COMPU_TAB_REF CONV_TAB_E_SIGSTATUS_S6_S3 /end COMPU_METHOD
/begin COMPU_METHOD E_STATUSADA_S6_S3 "" TAB_VERB "%12.6" "" COMPU_TAB_REF CONV_TAB_E_STATUSADA_S6_S3 /end COMPU_METHOD
/begin COMPU_METHOD E_STATUSIAE_S6_S3 "" TAB_VERB "%12.6" "" COMPU_TAB_REF CONV_TAB_E_STATUSIAE_S6_S3 /end COMPU_METHOD
/begin COMPU_METHOD E_STATUSIEP_S6_S3 "" TAB_VERB "%12.6" "" COMPU_TAB_REF CONV_TAB_E_STATUSIEP_S6_S3 /end COMPU_METHOD
/begin COMPU_METHOD E_STATUSK0_S6_S3 "" TAB_VERB "%12.6" "" COMPU_TAB_REF CONV_TAB_E_STATUSK0_S6_S3 /end COMPU_METHOD
/begin COMPU_METHOD E_STATUSKSL_S6_S3 "" TAB_VERB "%12.6" "" COMPU_TAB_REF CONV_TAB_E_STATUSKSL_S6_S3 /end COMPU_METHOD
/begin COMPU_METHOD E_STATUSPSY_S6_S3 "" TAB_VERB "%12.6" "" COMPU_TAB_REF CONV_TAB_E_STATUSPSY_S6_S3 /end COMPU_METHOD
/begin COMPU_METHOD E_STBZHAS_S6_S3 "" TAB_VERB "%12.6" "" COMPU_TAB_REF CONV_TAB_E_STBZHAS_S6_S3 /end COMPU_METHOD
/begin COMPU_METHOD E_ZIEP_S6_S3 "" TAB_VERB "%12.6" "" COMPU_TAB_REF CONV_TAB_E_ZIEP_S6_S3 /end COMPU_METHOD
/begin COMPU_METHOD E_ZK0_S6_S3 "" TAB_VERB "%12.6" "" COMPU_TAB_REF CONV_TAB_E_ZK0_S6_S3 /end COMPU_METHOD
/begin COMPU_METHOD E_ZK0FSTIN_S6_S3 "" TAB_VERB "%12.6" "" COMPU_TAB_REF CONV_TAB_E_ZK0FSTIN_S6_S3 /end COMPU_METHOD
/begin COMPU_METHOD E_ZMODUSIAE_S6_S3 "" TAB_VERB "%12.6" "" COMPU_TAB_REF CONV_TAB_E_ZMODUSIAE_S6_S3 /end COMPU_METHOD
/begin COMPU_METHOD E_ZMODUSIEP_S6_S3 "" TAB_VERB "%12.6" "" COMPU_TAB_REF CONV_TAB_E_ZMODUSIEP_S6_S3 /end COMPU_METHOD
/begin COMPU_METHOD E_ZNLLSOLL_S6_S3 "" TAB_VERB "%12.6" "" COMPU_TAB_REF CONV_TAB_E_ZNLLSOLL_S6_S3 /end COMPU_METHOD
/begin COMPU_METHOD n_fl_S6_S3 "Drehzahl" RAT_FUNC "%12.6" "1/min" COEFFS 0 1 0 0 0 1 /end COMPU_METHOD
/begin COMPU_METHOD ng_fl_S6_S3 "Drehzahlgradient" RAT_FUNC "%12.6" "1/min/s" COEFFS 0 1 0 0 0 1 /end COMPU_METHOD
/begin COMPU_METHOD p_fl_S6_S3 "Druck" RAT_FUNC "%12.6" "bar" COEFFS 0 1 0 0 0 1 /end COMPU_METHOD
/begin COMPU_METHOD phi_fl_S6_S3 "Winkel" RAT_FUNC "%12.6" "rad" COEFFS 0 1 0 0 0 1 /end COMPU_METHOD
/begin COMPU_METHOD SAB2_INTEGRAL_PROZENT100_S3_S3 "int = ((phys * 100) / 1) - (0) %.sec" RAT_FUNC "%4.3" "%.sec" COEFFS 0 100 0 0 0 1 /end COMPU_METHOD
/begin COMPU_METHOD SAB2_K100_KOMP_S3_S3 "int = ((phys * 100) / 1) - (0) -" RAT_FUNC "%4.3" "-" COEFFS 0 100 0 0 0 1 /end COMPU_METHOD
/begin COMPU_METHOD SAB2_K1024_S3_S3 "int = ((phys * 1024) / 1) - (0) -" RAT_FUNC "%11.10" "-" COEFFS 0 1024 0 0 0 1 /end COMPU_METHOD
/begin COMPU_METHOD t_fl_S6_S3 "Zeit" RAT_FUNC "%12.6" "s" COEFFS 0 1 0 0 0 1 /end COMPU_METHOD
/begin COMPU_METHOD t_int_S6_S3 "Zeit" RAT_FUNC "%11.2" "s" COEFFS 0 100 0 0 0 1 /end COMPU_METHOD
/begin COMPU_METHOD trq_fl_a_S6_S3 "Moment" RAT_FUNC "%12.6" "Nm" COEFFS 0 1 0 0 0 1 /end COMPU_METHOD
/begin COMPU_METHOD trqg_fl_c_S6_S3 "Momentengradient" RAT_FUNC "%12.6" "Nm/s" COEFFS 0 1 0 0 0 1 /end COMPU_METHOD
/begin COMPU_METHOD v_fl_S6_S3 "Geschwindigkeit" RAT_FUNC "%12.6" "km/h" COEFFS 0 1 0 0 0 1 /end COMPU_METHOD
/begin COMPU_METHOD vg_fl_S6_S3 "Geschwindigkeitsgradient" RAT_FUNC "%12.6" "km/h/s" COEFFS 0 1 0 0 0 1 /end COMPU_METHOD
/begin COMPU_METHOD void_fl_S6_S3 "ohne Umrechnung" RAT_FUNC "%12.6" "-" COEFFS 0 1 0 0 0 1 /end COMPU_METHOD
/begin COMPU_METHOD void_int_b_S6_S3 "ohne Umrechnung" RAT_FUNC "%5.0" "-" COEFFS 0 1 0 0 0 1 /end COMPU_METHOD
/begin COMPU_METHOD void_int_e_S6_S3 "ohne Umrechnung" RAT_FUNC "%1.0" "-" COEFFS 0 1 0 0 0 1 /end COMPU_METHOD
/begin COMPU_METHOD void_int_S6_S3 "ohne Umrechnung" RAT_FUNC "%3.0" "-" COEFFS 0 1 0 0 0 1 /end COMPU_METHOD
/begin COMPU_METHOD VOID_SCALING_f_S6_S3 "Void scaling for unscaled variables" RAT_FUNC "%12.6" "" COEFFS 0 1 0 0 0 1 /end COMPU_METHOD
/begin COMPU_METHOD VOID_SCALING_S6_S3 "Void scaling for unscaled variables" RAT_FUNC "%1.0" "" COEFFS 0 1 0 0 0 1 /end COMPU_METHOD
/begin CHARACTERISTIC ABLAUFVAR_RESPONSE_ANS "HAS - interne Ablaufvariante fuer Ablauf Schleppstart Response" VALUE 0x1D7CF6 UBYTE_COL_DIRECT_S6_S3 0 void_int_S6_S3 0 255 /end CHARACTERISTIC
/begin CHARACTERISTIC CS_1BEFUELLOPTCGETRIEBE_ANS "Temperaturschwelle fuer die Anforderung opt. K0-Befuellung" VALUE 0x1D195C FLOAT32_IEEE_COL_DIRECT_S6_S3 0 c_int_S6_S3 -3.40282e+038 3.40282e+038 /end CHARACTERISTIC
/begin CHARACTERISTIC FK_14NSOLLVM_ANS "Filterzeit zur Filterung von n_soll_vm_has" VALUE 0x1D1960 FLOAT32_IEEE_COL_DIRECT_S6_S3 0 t_fl_S6_S3 -3.40282e+038 3.40282e+038 /end CHARACTERISTIC
/begin CHARACTERISTIC FK_NMOTSOLLIAE1_ANS "Filterkonstante 1 zur Filterung von n_mot_soll_iae_fil" VALUE 0x1D1968 FLOAT32_IEEE_COL_DIRECT_S6_S3 0 t_fl_S6_S3 -3.40282e+038 3.40282e+038 /end CHARACTERISTIC
/begin CHARACTERISTIC FK_NMOTSOLLIAE2_ANS "Filterkonstante 2 zur Filterung von n_mot_soll_iae_fil" VALUE 0x1D196C FLOAT32_IEEE_COL_DIRECT_S6_S3 0 t_fl_S6_S3 -3.40282e+038 3.40282e+038 /end CHARACTERISTIC
/begin CHARACTERISTIC F_1NDSOLLIAESTAT_ANS "Gewichtungsfaktor für nd_ziel_iae_stat" VALUE 0x1D1974 FLOAT32_IEEE_COL_DIRECT_S6_S3 0 void_fl_S6_S3 -3.40282e+038 3.40282e+038 /end CHARACTERISTIC
/begin MEASUREMENT FlipFlop_schwelle_nsollem_nq "Gemessen in solldrehzahl_em/grad.begr." UBYTE void_int_S6_S3 1 100 0 255 ECU_ADDRESS 0xFFF96DB1 /end MEASUREMENT
/begin CHARACTERISTIC KF_0MZIELK0BEFNORM_ANS_W "Zielmoment der K0 im Zustand SAK" MAP 0x1D1AD4 FLOAT32_IEEE_COL_DIRECT_S6_S3 0 trq_fl_a_S6_S3 -3.40282e+038 3.40282e+038
 /begin AXIS_DESCR COM_AXIS NO_INPUT_QUANTITY c_int_S6_S3 8 -3.40282e+038 3.40282e+038 DEPOSIT ABSOLUTE AXIS_PTS_REF KF_0MZIELK0BEFNORM_ANS_X /end AXIS_DESCR
 /begin AXIS_DESCR COM_AXIS NO_INPUT_QUANTITY phi_fl_S6_S3 8 -3.40282e+038 3.40282e+038 DEPOSIT ABSOLUTE AXIS_PTS_REF KF_0MZIELK0BEFNORM_ANS_Y /end AXIS_DESCR
/end CHARACTERISTIC
/begin AXIS_PTS KF_0MZIELK0BEFNORM_ANS_X "X-Achse: c_getriebe_egs_in" 0x1D1BD4 NO_INPUT_QUANTITY FLOAT32_IEEE_X_INCR_DIRECT_S6_S3 0 c_int_S6_S3 8 -3.40282e+038 3.40282e+038 DEPOSIT ABSOLUTE /end AXIS_PTS
/begin AXIS_PTS KF_0MZIELK0BEFNORM_ANS_Y "Y-Achse: abstellpos_vm_in" 0x1D1BF4 NO_INPUT_QUANTITY FLOAT32_IEEE_X_INCR_DIRECT_S6_S3 0 phi_fl_S6_S3 8 -3.40282e+038 3.40282e+038 DEPOSIT ABSOLUTE /end AXIS_PTS
/begin CHARACTERISTIC KF_0MZIELK0BEFRED_ANS_W "Zielmoment der K0 im Zustand SAK für die red. Befuellung" MAP 0x1D1C14 FLOAT32_IEEE_COL_DIRECT_S6_S3 0 trq_fl_a_S6_S3 -3.40282e+038 3.40282e+038
 /begin AXIS_DESCR COM_AXIS NO_INPUT_QUANTITY c_int_S6_S3 8 -3.40282e+038 3.40282e+038 DEPOSIT ABSOLUTE AXIS_PTS_REF KF_0MZIELK0BEFRED_ANS_X /end AXIS_DESCR
 /begin AXIS_DESCR COM_AXIS NO_INPUT_QUANTITY phi_fl_S6_S3 8 -3.40282e+038 3.40282e+038 DEPOSIT ABSOLUTE AXIS_PTS_REF KF_0MZIELK0BEFRED_ANS_Y /end AXIS_DESCR
/end CHARACTERISTIC
/begin AXIS_PTS KF_0MZIELK0BEFRED_ANS_X "X-Achse: c_getriebe_egs_in" 0x1D1D14 NO_INPUT_QUANTITY FLOAT32_IEEE_X_INCR_DIRECT_S6_S3 0 c_int_S6_S3 8 -3.40282e+038 3.40282e+038 DEPOSIT ABSOLUTE /end AXIS_PTS
/begin AXIS_PTS KF_0MZIELK0BEFRED_ANS_Y "Y-Achse: abstellpos_vm_in" 0x1D1D34 NO_INPUT_QUANTITY FLOAT32_IEEE_X_INCR_DIRECT_S6_S3 0 phi_fl_S6_S3 8 -3.40282e+038 3.40282e+038 DEPOSIT ABSOLUTE /end AXIS_PTS
/begin CHARACTERISTIC KF_14NOEMNSOLLVMIAEENTK_ANS_W "Offset für die VM Soll-Drehzahlvorgabe bei IAE entk." MAP 0x1D1D54 FLOAT32_IEEE_COL_DIRECT_S6_S3 0 n_fl_S6_S3 -3.40282e+038 3.40282e+038
 /begin AXIS_DESCR COM_AXIS NO_INPUT_QUANTITY n_fl_S6_S3 10 -3.40282e+038 3.40282e+038 DEPOSIT ABSOLUTE AXIS_PTS_REF KF_14NOEMNSOLLVMIAEENTK_ANS_X /end AXIS_DESCR
 /begin AXIS_DESCR COM_AXIS NO_INPUT_QUANTITY trq_fl_a_S6_S3 7 -3.40282e+038 3.40282e+038 DEPOSIT ABSOLUTE AXIS_PTS_REF KF_14NOEMNSOLLVMIAEENTK_ANS_Y /end AXIS_DESCR
/end CHARACTERISTIC
/begin AXIS_PTS KF_14NOEMNSOLLVMIAEENTK_ANS_X "X-Achse: n_em_in" 0x1D1E6C NO_INPUT_QUANTITY FLOAT32_IEEE_X_INCR_DIRECT_S6_S3 0 n_fl_S6_S3 10 -3.40282e+038 3.40282e+038 DEPOSIT ABSOLUTE /end AXIS_PTS
/begin AXIS_PTS KF_14NOEMNSOLLVMIAEENTK_ANS_Y "Y-Achse: m_wunsch_fpw_in" 0x1D1E94 NO_INPUT_QUANTITY FLOAT32_IEEE_X_INCR_DIRECT_S6_S3 0 trq_fl_a_S6_S3 7 -3.40282e+038 3.40282e+038 DEPOSIT ABSOLUTE /end AXIS_PTS
/begin CHARACTERISTIC KF_14NOEMNSOLLVM_ANS_W "Offset für die VM Soll-Drehzahlvorgabe" MAP 0x1D1EB0 FLOAT32_IEEE_COL_DIRECT_S6_S3 0 n_fl_S6_S3 -3.40282e+038 3.40282e+038
 /begin AXIS_DESCR COM_AXIS NO_INPUT_QUANTITY n_fl_S6_S3 10 -3.40282e+038 3.40282e+038 DEPOSIT ABSOLUTE AXIS_PTS_REF KF_14NOEMNSOLLVM_ANS_X /end AXIS_DESCR
 /begin AXIS_DESCR COM_AXIS NO_INPUT_QUANTITY trq_fl_a_S6_S3 7 -3.40282e+038 3.40282e+038 DEPOSIT ABSOLUTE AXIS_PTS_REF KF_14NOEMNSOLLVM_ANS_Y /end AXIS_DESCR
/end CHARACTERISTIC
/begin AXIS_PTS KF_14NOEMNSOLLVM_ANS_X "X-Achse: n_em_in" 0x1D1FC8 NO_INPUT_QUANTITY FLOAT32_IEEE_X_INCR_DIRECT_S6_S3 0 n_fl_S6_S3 10 -3.40282e+038 3.40282e+038 DEPOSIT ABSOLUTE /end AXIS_PTS
/begin AXIS_PTS KF_14NOEMNSOLLVM_ANS_Y "Y-Achse: m_wunsch_fpw_in" 0x1D1FF0 NO_INPUT_QUANTITY FLOAT32_IEEE_X_INCR_DIRECT_S6_S3 0 trq_fl_a_S6_S3 7 -3.40282e+038 3.40282e+038 DEPOSIT ABSOLUTE /end AXIS_PTS
/begin CHARACTERISTIC KF_15NDGSOLLIAE_ANS_W "Drehzahlgradient für die EM-Drehzahl" MAP 0x1D200C FLOAT32_IEEE_COL_DIRECT_S6_S3 0 ng_fl_S6_S3 -3.40282e+038 3.40282e+038
 /begin AXIS_DESCR COM_AXIS NO_INPUT_QUANTITY trq_fl_a_S6_S3 6 -3.40282e+038 3.40282e+038 DEPOSIT ABSOLUTE AXIS_PTS_REF KF_15NDGSOLLIAE_ANS_X /end AXIS_DESCR
 /begin AXIS_DESCR COM_AXIS NO_INPUT_QUANTITY n_fl_S6_S3 7 -3.40282e+038 3.40282e+038 DEPOSIT ABSOLUTE AXIS_PTS_REF KF_15NDGSOLLIAE_ANS_Y /end AXIS_DESCR
/end CHARACTERISTIC
/begin AXIS_PTS KF_15NDGSOLLIAE_ANS_X "X-Achse m_mot_in" 0x1D20B4 NO_INPUT_QUANTITY FLOAT32_IEEE_X_INCR_DIRECT_S6_S3 0 trq_fl_a_S6_S3 6 -3.40282e+038 3.40282e+038 DEPOSIT ABSOLUTE /end AXIS_PTS
/begin AXIS_PTS KF_15NDGSOLLIAE_ANS_Y "Y-Achse n_sec_iae_fil" 0x1D20CC NO_INPUT_QUANTITY FLOAT32_IEEE_X_INCR_DIRECT_S6_S3 0 n_fl_S6_S3 7 -3.40282e+038 3.40282e+038 DEPOSIT ABSOLUTE /end AXIS_PTS
/begin CHARACTERISTIC KF_15NDSOLLIAE_ANS_W "Ausgabe Sollwandlerschlupf abhängig von Turbinendrehzahl und Fahrsollmoment" MAP 0x1D20E8 FLOAT32_IEEE_COL_DIRECT_S6_S3 0 n_fl_S6_S3 -3.40282e+038 3.40282e+038
 /begin AXIS_DESCR COM_AXIS NO_INPUT_QUANTITY trq_fl_a_S6_S3 6 -3.40282e+038 3.40282e+038 DEPOSIT ABSOLUTE AXIS_PTS_REF KF_15NDSOLLIAE_ANS_X /end AXIS_DESCR
 /begin AXIS_DESCR COM_AXIS NO_INPUT_QUANTITY n_fl_S6_S3 7 -3.40282e+038 3.40282e+038 DEPOSIT ABSOLUTE AXIS_PTS_REF KF_15NDSOLLIAE_ANS_Y /end AXIS_DESCR
/end CHARACTERISTIC
/begin AXIS_PTS KF_15NDSOLLIAE_ANS_X "X-Achse m_mot_in" 0x1D2190 NO_INPUT_QUANTITY FLOAT32_IEEE_X_INCR_DIRECT_S6_S3 0 trq_fl_a_S6_S3 6 -3.40282e+038 3.40282e+038 DEPOSIT ABSOLUTE /end AXIS_PTS
/begin AXIS_PTS KF_15NDSOLLIAE_ANS_Y "Y-Achse: n_sec_iae_fil" 0x1D21A8 NO_INPUT_QUANTITY FLOAT32_IEEE_X_INCR_DIRECT_S6_S3 0 n_fl_S6_S3 7 -3.40282e+038 3.40282e+038 DEPOSIT ABSOLUTE /end AXIS_PTS
/begin CHARACTERISTIC KF_15NGSOLLEM_NEMNDIAE_ANS_W "Bestimmung ng_soll = f(nem, nd_iae)" MAP 0x1D21C4 FLOAT32_IEEE_COL_DIRECT_S6_S3 0 ng_fl_S6_S3 -3.40282e+038 3.40282e+038
 /begin AXIS_DESCR COM_AXIS NO_INPUT_QUANTITY n_fl_S6_S3 9 -3.40282e+038 3.40282e+038 DEPOSIT ABSOLUTE AXIS_PTS_REF KF_15NGSOLLEM_NEMNDIAE_ANS_X /end AXIS_DESCR
 /begin AXIS_DESCR COM_AXIS NO_INPUT_QUANTITY n_fl_S6_S3 7 -3.40282e+038 3.40282e+038 DEPOSIT ABSOLUTE AXIS_PTS_REF KF_15NGSOLLEM_NEMNDIAE_ANS_Y /end AXIS_DESCR
/end CHARACTERISTIC
/begin AXIS_PTS KF_15NGSOLLEM_NEMNDIAE_ANS_X "X-Achse: n_em_in" 0x1D22C0 NO_INPUT_QUANTITY FLOAT32_IEEE_X_INCR_DIRECT_S6_S3 0 n_fl_S6_S3 9 -3.40282e+038 3.40282e+038 DEPOSIT ABSOLUTE /end AXIS_PTS
/begin AXIS_PTS KF_15NGSOLLEM_NEMNDIAE_ANS_Y "Y-Achse: nd_iae_in" 0x1D22E4 NO_INPUT_QUANTITY FLOAT32_IEEE_X_INCR_DIRECT_S6_S3 0 n_fl_S6_S3 7 -3.40282e+038 3.40282e+038 DEPOSIT ABSOLUTE /end AXIS_PTS
/begin CHARACTERISTIC KF_15NGSOLLEM_STIAEKRAFT_ANS_W "Bestimmung Umschaltkriterium ng_sollemststkraftfluss" MAP 0x1D7D54 UBYTE_COL_DIRECT_S6_S3 0 void_int_S6_S3 0 1
 /begin AXIS_DESCR COM_AXIS NO_INPUT_QUANTITY void_int_S6_S3 9 0 255 DEPOSIT ABSOLUTE AXIS_PTS_REF KF_15NGSOLLEM_STIAEKRAFT_ANS_X /end AXIS_DESCR
 /begin AXIS_DESCR COM_AXIS NO_INPUT_QUANTITY void_int_S6_S3 7 0 255 DEPOSIT ABSOLUTE AXIS_PTS_REF KF_15NGSOLLEM_STIAEKRAFT_ANS_Y /end AXIS_DESCR
/end CHARACTERISTIC
/begin AXIS_PTS KF_15NGSOLLEM_STIAEKRAFT_ANS_X "X-Achse: status_iae_in" 0x1D7D93 NO_INPUT_QUANTITY UBYTE_X_INCR_DIRECT_S6_S3 0 void_int_S6_S3 9 0 255 DEPOSIT ABSOLUTE /end AXIS_PTS
/begin AXIS_PTS KF_15NGSOLLEM_STIAEKRAFT_ANS_Y "Y-Achse: status_kraftfluss_egs_in" 0x1D7D9C NO_INPUT_QUANTITY UBYTE_X_INCR_DIRECT_S6_S3 0 void_int_S6_S3 7 0 255 DEPOSIT ABSOLUTE /end AXIS_PTS
/begin CHARACTERISTIC KF_1FNDSOLLIAE_ANS_W "Gewichtungsfaktor für Berechnung flag_ndiae_erreicht" MAP 0x1D2300 FLOAT32_IEEE_COL_DIRECT_S6_S3 0 void_fl_S6_S3 -3.40282e+038 3.40282e+038
 /begin AXIS_DESCR COM_AXIS NO_INPUT_QUANTITY t_fl_S6_S3 8 -3.40282e+038 3.40282e+038 DEPOSIT ABSOLUTE AXIS_PTS_REF KF_1FNDSOLLIAE_ANS_X /end AXIS_DESCR
 /begin AXIS_DESCR COM_AXIS NO_INPUT_QUANTITY void_int_S6_S3 8 -128 127 DEPOSIT ABSOLUTE AXIS_PTS_REF KF_1FNDSOLLIAE_ANS_Y /end AXIS_DESCR
/end CHARACTERISTIC
/begin AXIS_PTS KF_1FNDSOLLIAE_ANS_X "X-Achse: t_waitschlupf" 0x1D2400 NO_INPUT_QUANTITY FLOAT32_IEEE_X_INCR_DIRECT_S6_S3 0 t_fl_S6_S3 8 -3.40282e+038 3.40282e+038 DEPOSIT ABSOLUTE /end AXIS_PTS
/begin AXIS_PTS KF_1FNDSOLLIAE_ANS_Y "Y-Achse: istgang_egs_in" 0x1D5B84 NO_INPUT_QUANTITY SBYTE_X_INCR_DIRECT_S6_S3 0 void_int_S6_S3 8 -128 127 DEPOSIT ABSOLUTE /end AXIS_PTS
/begin CHARACTERISTIC KF_1MGK0BEFNORM_ANS_W "m_soll_k0_has für normale Befüllung" MAP 0x1D2420 FLOAT32_IEEE_COL_DIRECT_S6_S3 0 trq_fl_a_S6_S3 -3.40282e+038 3.40282e+038
 /begin AXIS_DESCR COM_AXIS NO_INPUT_QUANTITY c_int_S6_S3 8 -3.40282e+038 3.40282e+038 DEPOSIT ABSOLUTE AXIS_PTS_REF KF_1MGK0BEFNORM_ANS_X /end AXIS_DESCR
 /begin AXIS_DESCR COM_AXIS NO_INPUT_QUANTITY phi_fl_S6_S3 8 -3.40282e+038 3.40282e+038 DEPOSIT ABSOLUTE AXIS_PTS_REF KF_1MGK0BEFNORM_ANS_Y /end AXIS_DESCR
/end CHARACTERISTIC
/begin AXIS_PTS KF_1MGK0BEFNORM_ANS_X "X-Achse c_getriebe_egs_in" 0x1D2520 NO_INPUT_QUANTITY FLOAT32_IEEE_X_INCR_DIRECT_S6_S3 0 c_int_S6_S3 8 -3.40282e+038 3.40282e+038 DEPOSIT ABSOLUTE /end AXIS_PTS
/begin AXIS_PTS KF_1MGK0BEFNORM_ANS_Y "Y-Achse: abstellpos_vm_on" 0x1D2540 NO_INPUT_QUANTITY FLOAT32_IEEE_X_INCR_DIRECT_S6_S3 0 phi_fl_S6_S3 8 -3.40282e+038 3.40282e+038 DEPOSIT ABSOLUTE /end AXIS_PTS
/begin CHARACTERISTIC KF_1MGK0BEFOPT_ANS_W "mg_soll_k0_has für opt. Befüllung" MAP 0x1D2560 FLOAT32_IEEE_COL_DIRECT_S6_S3 0 trqg_fl_c_S6_S3 -3.40282e+038 3.40282e+038
 /begin AXIS_DESCR COM_AXIS NO_INPUT_QUANTITY c_int_S6_S3 8 -3.40282e+038 3.40282e+038 DEPOSIT ABSOLUTE AXIS_PTS_REF KF_1MGK0BEFOPT_ANS_X /end AXIS_DESCR
 /begin AXIS_DESCR COM_AXIS NO_INPUT_QUANTITY phi_fl_S6_S3 8 -3.40282e+038 3.40282e+038 DEPOSIT ABSOLUTE AXIS_PTS_REF KF_1MGK0BEFOPT_ANS_Y /end AXIS_DESCR
/end CHARACTERISTIC
/begin AXIS_PTS KF_1MGK0BEFOPT_ANS_X "X-Achse c_getriebe_egs_in" 0x1D2660 NO_INPUT_QUANTITY FLOAT32_IEEE_X_INCR_DIRECT_S6_S3 0 c_int_S6_S3 8 -3.40282e+038 3.40282e+038 DEPOSIT ABSOLUTE /end AXIS_PTS
/begin AXIS_PTS KF_1MGK0BEFOPT_ANS_Y "Y-Achse abstellpos_vm_in" 0x1D2680 NO_INPUT_QUANTITY FLOAT32_IEEE_X_INCR_DIRECT_S6_S3 0 phi_fl_S6_S3 8 -3.40282e+038 3.40282e+038 DEPOSIT ABSOLUTE /end AXIS_PTS
/begin CHARACTERISTIC KF_1MGK0BEFRED_ANS_W "mg_soll_k0_has für reduzierte Befüllung" MAP 0x1D26A0 FLOAT32_IEEE_COL_DIRECT_S6_S3 0 trqg_fl_c_S6_S3 -3.40282e+038 3.40282e+038
 /begin AXIS_DESCR COM_AXIS NO_INPUT_QUANTITY c_int_S6_S3 8 -3.40282e+038 3.40282e+038 DEPOSIT ABSOLUTE AXIS_PTS_REF KF_1MGK0BEFRED_ANS_X /end AXIS_DESCR
 /begin AXIS_DESCR COM_AXIS NO_INPUT_QUANTITY phi_fl_S6_S3 8 -3.40282e+038 3.40282e+038 DEPOSIT ABSOLUTE AXIS_PTS_REF KF_1MGK0BEFRED_ANS_Y /end AXIS_DESCR
/end CHARACTERISTIC
/begin AXIS_PTS KF_1MGK0BEFRED_ANS_X "X-Achse c_getriebe_egs_in" 0x1D27A0 NO_INPUT_QUANTITY FLOAT32_IEEE_X_INCR_DIRECT_S6_S3 0 c_int_S6_S3 8 -3.40282e+038 3.40282e+038 DEPOSIT ABSOLUTE /end AXIS_PTS
/begin AXIS_PTS KF_1MGK0BEFRED_ANS_Y "Y-Achse abstellpos_vm_in" 0x1D27C0 NO_INPUT_QUANTITY FLOAT32_IEEE_X_INCR_DIRECT_S6_S3 0 phi_fl_S6_S3 8 -3.40282e+038 3.40282e+038 DEPOSIT ABSOLUTE /end AXIS_PTS
/begin CHARACTERISTIC KF_1MGSOLLK0ANFIAE_ANS_W "mg_soll_k0_has für IAE Anfahren" MAP 0x1D27E0 FLOAT32_IEEE_COL_DIRECT_S6_S3 0 trqg_fl_c_S6_S3 -3.40282e+038 3.40282e+038
 /begin AXIS_DESCR COM_AXIS NO_INPUT_QUANTITY ng_fl_S6_S3 8 -3.40282e+038 3.40282e+038 DEPOSIT ABSOLUTE AXIS_PTS_REF KF_1MGSOLLK0ANFIAE_ANS_X /end AXIS_DESCR
 /begin AXIS_DESCR COM_AXIS NO_INPUT_QUANTITY n_fl_S6_S3 8 -3.40282e+038 3.40282e+038 DEPOSIT ABSOLUTE AXIS_PTS_REF KF_1MGSOLLK0ANFIAE_ANS_Y /end AXIS_DESCR
/end CHARACTERISTIC
/begin AXIS_PTS KF_1MGSOLLK0ANFIAE_ANS_X "X-Achse ng_vm_in" 0x1D28E0 NO_INPUT_QUANTITY FLOAT32_IEEE_X_INCR_DIRECT_S6_S3 0 ng_fl_S6_S3 8 -3.40282e+038 3.40282e+038 DEPOSIT ABSOLUTE /end AXIS_PTS
/begin AXIS_PTS KF_1MGSOLLK0ANFIAE_ANS_Y "Y-Achse n_vm_in" 0x1D2900 NO_INPUT_QUANTITY FLOAT32_IEEE_X_INCR_DIRECT_S6_S3 0 n_fl_S6_S3 8 -3.40282e+038 3.40282e+038 DEPOSIT ABSOLUTE /end AXIS_PTS
/begin CHARACTERISTIC KF_1MZIELK0ANFIAE_ANS_W "m_soll_k0_has während IAE Anfahren" MAP 0x1D2920 FLOAT32_IEEE_COL_DIRECT_S6_S3 0 trq_fl_a_S6_S3 -3.40282e+038 3.40282e+038
 /begin AXIS_DESCR COM_AXIS NO_INPUT_QUANTITY ng_fl_S6_S3 8 -3.40282e+038 3.40282e+038 DEPOSIT ABSOLUTE AXIS_PTS_REF KF_1MZIELK0ANFIAE_ANS_X /end AXIS_DESCR
 /begin AXIS_DESCR COM_AXIS NO_INPUT_QUANTITY n_fl_S6_S3 8 -3.40282e+038 3.40282e+038 DEPOSIT ABSOLUTE AXIS_PTS_REF KF_1MZIELK0ANFIAE_ANS_Y /end AXIS_DESCR
/end CHARACTERISTIC
/begin AXIS_PTS KF_1MZIELK0ANFIAE_ANS_X "X-Achse ng_vm_in" 0x1D2A20 NO_INPUT_QUANTITY FLOAT32_IEEE_X_INCR_DIRECT_S6_S3 0 ng_fl_S6_S3 8 -3.40282e+038 3.40282e+038 DEPOSIT ABSOLUTE /end AXIS_PTS
/begin AXIS_PTS KF_1MZIELK0ANFIAE_ANS_Y "Y-Achse: n_vm_in" 0x1D2A40 NO_INPUT_QUANTITY FLOAT32_IEEE_X_INCR_DIRECT_S6_S3 0 n_fl_S6_S3 8 -3.40282e+038 3.40282e+038 DEPOSIT ABSOLUTE /end AXIS_PTS
/begin CHARACTERISTIC KF_1MZIELK0BEFNORM_ANS_W "m_soll_k0_has für normale Befüllung" MAP 0x1D2A60 FLOAT32_IEEE_COL_DIRECT_S6_S3 0 trq_fl_a_S6_S3 -3.40282e+038 3.40282e+038
 /begin AXIS_DESCR COM_AXIS NO_INPUT_QUANTITY c_int_S6_S3 8 -3.40282e+038 3.40282e+038 DEPOSIT ABSOLUTE AXIS_PTS_REF KF_1MZIELK0BEFNORM_ANS_X /end AXIS_DESCR
 /begin AXIS_DESCR COM_AXIS NO_INPUT_QUANTITY phi_fl_S6_S3 8 -3.40282e+038 3.40282e+038 DEPOSIT ABSOLUTE AXIS_PTS_REF KF_1MZIELK0BEFNORM_ANS_Y /end AXIS_DESCR
/end CHARACTERISTIC
/begin AXIS_PTS KF_1MZIELK0BEFNORM_ANS_X "X-Achse c_getriebe_egs_in" 0x1D2B60 NO_INPUT_QUANTITY FLOAT32_IEEE_X_INCR_DIRECT_S6_S3 0 c_int_S6_S3 8 -3.40282e+038 3.40282e+038 DEPOSIT ABSOLUTE /end AXIS_PTS
/begin AXIS_PTS KF_1MZIELK0BEFNORM_ANS_Y "Y-Achse: abstellpos_vm_in" 0x1D2B80 NO_INPUT_QUANTITY FLOAT32_IEEE_X_INCR_DIRECT_S6_S3 0 phi_fl_S6_S3 8 -3.40282e+038 3.40282e+038 DEPOSIT ABSOLUTE /end AXIS_PTS
/begin CHARACTERISTIC KF_1MZIELK0BEFOPT_ANS_W "m_soll_k0_has für opt. Befüllung" MAP 0x1D2BA0 FLOAT32_IEEE_COL_DIRECT_S6_S3 0 trq_fl_a_S6_S3 -3.40282e+038 3.40282e+038
 /begin AXIS_DESCR COM_AXIS NO_INPUT_QUANTITY c_int_S6_S3 8 -3.40282e+038 3.40282e+038 DEPOSIT ABSOLUTE AXIS_PTS_REF KF_1MZIELK0BEFOPT_ANS_X /end AXIS_DESCR
 /begin AXIS_DESCR COM_AXIS NO_INPUT_QUANTITY phi_fl_S6_S3 8 -3.40282e+038 3.40282e+038 DEPOSIT ABSOLUTE AXIS_PTS_REF KF_1MZIELK0BEFOPT_ANS_Y /end AXIS_DESCR
/end CHARACTERISTIC
/begin AXIS_PTS KF_1MZIELK0BEFOPT_ANS_X "X-Achse c_getriebe_egs_in" 0x1D2CA0 NO_INPUT_QUANTITY FLOAT32_IEEE_X_INCR_DIRECT_S6_S3 0 c_int_S6_S3 8 -3.40282e+038 3.40282e+038 DEPOSIT ABSOLUTE /end AXIS_PTS
/begin AXIS_PTS KF_1MZIELK0BEFOPT_ANS_Y "Y-Achse abstellpos_vm_in" 0x1D2CC0 NO_INPUT_QUANTITY FLOAT32_IEEE_X_INCR_DIRECT_S6_S3 0 phi_fl_S6_S3 8 -3.40282e+038 3.40282e+038 DEPOSIT ABSOLUTE /end AXIS_PTS
/begin CHARACTERISTIC KF_1MZIELK0BEFRED_ANS_W "m_soll_k0_has für reduzierte Befüllung" MAP 0x1D2CE0 FLOAT32_IEEE_COL_DIRECT_S6_S3 0 trq_fl_a_S6_S3 -3.40282e+038 3.40282e+038
 /begin AXIS_DESCR COM_AXIS NO_INPUT_QUANTITY c_int_S6_S3 8 -3.40282e+038 3.40282e+038 DEPOSIT ABSOLUTE AXIS_PTS_REF KF_1MZIELK0BEFRED_ANS_X /end AXIS_DESCR
 /begin AXIS_DESCR COM_AXIS NO_INPUT_QUANTITY phi_fl_S6_S3 8 -3.40282e+038 3.40282e+038 DEPOSIT ABSOLUTE AXIS_PTS_REF KF_1MZIELK0BEFRED_ANS_Y /end AXIS_DESCR
/end CHARACTERISTIC
/begin AXIS_PTS KF_1MZIELK0BEFRED_ANS_X "X-Achse c_getriebe_egs_in" 0x1D2DE0 NO_INPUT_QUANTITY FLOAT32_IEEE_X_INCR_DIRECT_S6_S3 0 c_int_S6_S3 8 -3.40282e+038 3.40282e+038 DEPOSIT ABSOLUTE /end AXIS_PTS
/begin AXIS_PTS KF_1MZIELK0BEFRED_ANS_Y "Y-Achse: abstellpos_vm_on" 0x1D2E00 NO_INPUT_QUANTITY FLOAT32_IEEE_X_INCR_DIRECT_S6_S3 0 phi_fl_S6_S3 8 -3.40282e+038 3.40282e+038 DEPOSIT ABSOLUTE /end AXIS_PTS
/begin CHARACTERISTIC KF_24NDSOLLIAEABLVAR_ANS_W "Bestimmung der Abfilterung von n_soll_em =f(z_ablaufvariante)" MAP 0x1D2E20 FLOAT32_IEEE_COL_DIRECT_S6_S3 0 n_fl_S6_S3 -3.40282e+038 3.40282e+038
 /begin AXIS_DESCR COM_AXIS NO_INPUT_QUANTITY n_fl_S6_S3 7 -3.40282e+038 3.40282e+038 DEPOSIT ABSOLUTE AXIS_PTS_REF KF_24NDSOLLIAEABLVAR_ANS_X /end AXIS_DESCR
 /begin AXIS_DESCR COM_AXIS NO_INPUT_QUANTITY n_fl_S6_S3 7 -3.40282e+038 3.40282e+038 DEPOSIT ABSOLUTE AXIS_PTS_REF KF_24NDSOLLIAEABLVAR_ANS_Y /end AXIS_DESCR
/end CHARACTERISTIC
/begin AXIS_PTS KF_24NDSOLLIAEABLVAR_ANS_X "X-Achse: nd_k0_in" 0x1D2EE4 NO_INPUT_QUANTITY FLOAT32_IEEE_X_INCR_DIRECT_S6_S3 0 n_fl_S6_S3 7 -3.40282e+038 3.40282e+038 DEPOSIT ABSOLUTE /end AXIS_PTS
/begin AXIS_PTS KF_24NDSOLLIAEABLVAR_ANS_Y "Y-Achse: ng_vm_in" 0x1D2F00 NO_INPUT_QUANTITY FLOAT32_IEEE_X_INCR_DIRECT_S6_S3 0 n_fl_S6_S3 7 -3.40282e+038 3.40282e+038 DEPOSIT ABSOLUTE /end AXIS_PTS
/begin CHARACTERISTIC KF_2MGSOLLK0MVMMIN_ANS_W "Gradient des K0-Sollmoments in Abhängigkeit vom VM Reibmoment und Fahrerwunschmoment  beim Anschleppen" MAP 0x1D2F1C FLOAT32_IEEE_COL_DIRECT_S6_S3 0 trqg_fl_c_S6_S3 -3.40282e+038 3.40282e+038
 /begin AXIS_DESCR COM_AXIS NO_INPUT_QUANTITY trq_fl_a_S6_S3 6 -3.40282e+038 3.40282e+038 DEPOSIT ABSOLUTE AXIS_PTS_REF KF_2MGSOLLK0MVMMIN_ANS_X /end AXIS_DESCR
 /begin AXIS_DESCR COM_AXIS NO_INPUT_QUANTITY trq_fl_a_S6_S3 7 -3.40282e+038 3.40282e+038 DEPOSIT ABSOLUTE AXIS_PTS_REF KF_2MGSOLLK0MVMMIN_ANS_Y /end AXIS_DESCR
/end CHARACTERISTIC
/begin AXIS_PTS KF_2MGSOLLK0MVMMIN_ANS_X "X-Achse: m_min_vm" 0x1D2FC4 NO_INPUT_QUANTITY FLOAT32_IEEE_X_INCR_DIRECT_S6_S3 0 trq_fl_a_S6_S3 6 -3.40282e+038 3.40282e+038 DEPOSIT ABSOLUTE /end AXIS_PTS
/begin AXIS_PTS KF_2MGSOLLK0MVMMIN_ANS_Y "Y-Achse: m_wunsch_fpw_hst_in" 0x1D2FDC NO_INPUT_QUANTITY FLOAT32_IEEE_X_INCR_DIRECT_S6_S3 0 trq_fl_a_S6_S3 7 -3.40282e+038 3.40282e+038 DEPOSIT ABSOLUTE /end AXIS_PTS
/begin CHARACTERISTIC KF_2MGSOLLK0MVMSTART_ANS_W "Gradient des K0-Sollmoments in Abhängigkeit vom VM Reibmoment und Fahrerwunschmoment  beim Anschleppen" MAP 0x1D2FF8 FLOAT32_IEEE_COL_DIRECT_S6_S3 0 trqg_fl_c_S6_S3 -3.40282e+038 3.40282e+038
 /begin AXIS_DESCR COM_AXIS NO_INPUT_QUANTITY trq_fl_a_S6_S3 6 -3.40282e+038 3.40282e+038 DEPOSIT ABSOLUTE AXIS_PTS_REF KF_2MGSOLLK0MVMSTART_ANS_X /end AXIS_DESCR
 /begin AXIS_DESCR COM_AXIS NO_INPUT_QUANTITY trq_fl_a_S6_S3 7 -3.40282e+038 3.40282e+038 DEPOSIT ABSOLUTE AXIS_PTS_REF KF_2MGSOLLK0MVMSTART_ANS_Y /end AXIS_DESCR
/end CHARACTERISTIC
/begin AXIS_PTS KF_2MGSOLLK0MVMSTART_ANS_X "X-Achse: m_vm_start" 0x1D30A0 NO_INPUT_QUANTITY FLOAT32_IEEE_X_INCR_DIRECT_S6_S3 0 trq_fl_a_S6_S3 6 -3.40282e+038 3.40282e+038 DEPOSIT ABSOLUTE /end AXIS_PTS
/begin AXIS_PTS KF_2MGSOLLK0MVMSTART_ANS_Y "Y-Achse: m_wunsch_fpw_hst_in" 0x1D30B8 NO_INPUT_QUANTITY FLOAT32_IEEE_X_INCR_DIRECT_S6_S3 0 trq_fl_a_S6_S3 7 -3.40282e+038 3.40282e+038 DEPOSIT ABSOLUTE /end AXIS_PTS
/begin CHARACTERISTIC KF_2MGSOLLK0VMMIN_ANS_W "Gradient des K0-Sollmoments in Abhängigkeit von  z_ablaufvariante und abstellpos_vm_in beim Anschleppen" MAP 0x1D30D4 FLOAT32_IEEE_COL_DIRECT_S6_S3 0 trqg_fl_c_S6_S3 -3.40282e+038 3.40282e+038
 /begin AXIS_DESCR COM_AXIS NO_INPUT_QUANTITY void_int_S6_S3 8 0 255 DEPOSIT ABSOLUTE AXIS_PTS_REF KF_2MGSOLLK0VMMIN_ANS_X /end AXIS_DESCR
 /begin AXIS_DESCR COM_AXIS NO_INPUT_QUANTITY phi_fl_S6_S3 8 -3.40282e+038 3.40282e+038 DEPOSIT ABSOLUTE AXIS_PTS_REF KF_2MGSOLLK0VMMIN_ANS_Y /end AXIS_DESCR
/end CHARACTERISTIC
/begin AXIS_PTS KF_2MGSOLLK0VMMIN_ANS_X "X-Achse: z_ablaufvariante_has_stg" 0x1D5B8C NO_INPUT_QUANTITY UBYTE_X_INCR_DIRECT_S6_S3 0 void_int_S6_S3 8 0 255 DEPOSIT ABSOLUTE /end AXIS_PTS
/begin AXIS_PTS KF_2MGSOLLK0VMMIN_ANS_Y "Y-Achse: abstellpos_vm_in" 0x1D31D4 NO_INPUT_QUANTITY FLOAT32_IEEE_X_INCR_DIRECT_S6_S3 0 phi_fl_S6_S3 8 -3.40282e+038 3.40282e+038 DEPOSIT ABSOLUTE /end AXIS_PTS
/begin CHARACTERISTIC KF_2MGSOLLK0VMSTART_ANS_W "Gradient des K0-Sollmoments in Abhängigkeit von  z_ablaufvariante und abstellpos_vm_in beim Anschleppen" MAP 0x1D31F4 FLOAT32_IEEE_COL_DIRECT_S6_S3 0 trqg_fl_c_S6_S3 -3.40282e+038 3.40282e+038
 /begin AXIS_DESCR COM_AXIS NO_INPUT_QUANTITY void_int_S6_S3 8 0 255 DEPOSIT ABSOLUTE AXIS_PTS_REF KF_2MGSOLLK0VMSTART_ANS_X /end AXIS_DESCR
 /begin AXIS_DESCR COM_AXIS NO_INPUT_QUANTITY phi_fl_S6_S3 8 -3.40282e+038 3.40282e+038 DEPOSIT ABSOLUTE AXIS_PTS_REF KF_2MGSOLLK0VMSTART_ANS_Y /end AXIS_DESCR
/end CHARACTERISTIC
/begin AXIS_PTS KF_2MGSOLLK0VMSTART_ANS_X "X-Achse: z_ablaufvariante_has_stg" 0x1D5B94 NO_INPUT_QUANTITY UBYTE_X_INCR_DIRECT_S6_S3 0 void_int_S6_S3 8 0 255 DEPOSIT ABSOLUTE /end AXIS_PTS
/begin AXIS_PTS KF_2MGSOLLK0VMSTART_ANS_Y "Y-Achse: abstellpos_vm_in" 0x1D32F4 NO_INPUT_QUANTITY FLOAT32_IEEE_X_INCR_DIRECT_S6_S3 0 phi_fl_S6_S3 8 -3.40282e+038 3.40282e+038 DEPOSIT ABSOLUTE /end AXIS_PTS
/begin CHARACTERISTIC KF_2MK0CGETRMMOT1_ANS_W "K0 Moment in Phase 2" MAP 0x1D3314 FLOAT32_IEEE_COL_DIRECT_S6_S3 0 trq_fl_a_S6_S3 -3.40282e+038 3.40282e+038
 /begin AXIS_DESCR COM_AXIS NO_INPUT_QUANTITY c_int_S6_S3 8 -3.40282e+038 3.40282e+038 DEPOSIT ABSOLUTE AXIS_PTS_REF KF_2MK0CGETRMMOT1_ANS_X /end AXIS_DESCR
 /begin AXIS_DESCR COM_AXIS NO_INPUT_QUANTITY trq_fl_a_S6_S3 8 -3.40282e+038 3.40282e+038 DEPOSIT ABSOLUTE AXIS_PTS_REF KF_2MK0CGETRMMOT1_ANS_Y /end AXIS_DESCR
/end CHARACTERISTIC
/begin AXIS_PTS KF_2MK0CGETRMMOT1_ANS_X "X-Achse: c_getriebe_egs_in" 0x1D3414 NO_INPUT_QUANTITY FLOAT32_IEEE_X_INCR_DIRECT_S6_S3 0 c_int_S6_S3 8 -3.40282e+038 3.40282e+038 DEPOSIT ABSOLUTE /end AXIS_PTS
/begin AXIS_PTS KF_2MK0CGETRMMOT1_ANS_Y "Y-Achse: m_mot_in" 0x1D3434 NO_INPUT_QUANTITY FLOAT32_IEEE_X_INCR_DIRECT_S6_S3 0 trq_fl_a_S6_S3 8 -3.40282e+038 3.40282e+038 DEPOSIT ABSOLUTE /end AXIS_PTS
/begin CHARACTERISTIC KF_2MK0CGETRMMOT1_SCHUB_ANS_W "K0 Moment in Phase 2 im Schub" MAP 0x1D3454 FLOAT32_IEEE_COL_DIRECT_S6_S3 0 trq_fl_a_S6_S3 -3.40282e+038 3.40282e+038
 /begin AXIS_DESCR COM_AXIS NO_INPUT_QUANTITY c_int_S6_S3 8 -3.40282e+038 3.40282e+038 DEPOSIT ABSOLUTE AXIS_PTS_REF KF_2MK0CGETRMMOT1_SCHUB_ANS_X /end AXIS_DESCR
 /begin AXIS_DESCR COM_AXIS NO_INPUT_QUANTITY trq_fl_a_S6_S3 8 -3.40282e+038 3.40282e+038 DEPOSIT ABSOLUTE AXIS_PTS_REF KF_2MK0CGETRMMOT1_SCHUB_ANS_Y /end AXIS_DESCR
/end CHARACTERISTIC
/begin AXIS_PTS KF_2MK0CGETRMMOT1_SCHUB_ANS_X "X-Achse: c_getriebe_egs_in" 0x1D3554 NO_INPUT_QUANTITY FLOAT32_IEEE_X_INCR_DIRECT_S6_S3 0 c_int_S6_S3 8 -3.40282e+038 3.40282e+038 DEPOSIT ABSOLUTE /end AXIS_PTS
/begin AXIS_PTS KF_2MK0CGETRMMOT1_SCHUB_ANS_Y "Y-Achse: m_mot_in" 0x1D3574 NO_INPUT_QUANTITY FLOAT32_IEEE_X_INCR_DIRECT_S6_S3 0 trq_fl_a_S6_S3 8 -3.40282e+038 3.40282e+038 DEPOSIT ABSOLUTE /end AXIS_PTS
/begin CHARACTERISTIC KF_2MK0CGETRMMOT2_ANS_W "K0 Moment in Phase 2" MAP 0x1D3594 FLOAT32_IEEE_COL_DIRECT_S6_S3 0 trq_fl_a_S6_S3 -3.40282e+038 3.40282e+038
 /begin AXIS_DESCR COM_AXIS NO_INPUT_QUANTITY c_int_S6_S3 8 -3.40282e+038 3.40282e+038 DEPOSIT ABSOLUTE AXIS_PTS_REF KF_2MK0CGETRMMOT2_ANS_X /end AXIS_DESCR
 /begin AXIS_DESCR COM_AXIS NO_INPUT_QUANTITY trq_fl_a_S6_S3 8 -3.40282e+038 3.40282e+038 DEPOSIT ABSOLUTE AXIS_PTS_REF KF_2MK0CGETRMMOT2_ANS_Y /end AXIS_DESCR
/end CHARACTERISTIC
/begin AXIS_PTS KF_2MK0CGETRMMOT2_ANS_X "X-Achse: c_getriebe_egs_in" 0x1D3694 NO_INPUT_QUANTITY FLOAT32_IEEE_X_INCR_DIRECT_S6_S3 0 c_int_S6_S3 8 -3.40282e+038 3.40282e+038 DEPOSIT ABSOLUTE /end AXIS_PTS
/begin AXIS_PTS KF_2MK0CGETRMMOT2_ANS_Y "Y-Achse: m_mot_in" 0x1D36B4 NO_INPUT_QUANTITY FLOAT32_IEEE_X_INCR_DIRECT_S6_S3 0 trq_fl_a_S6_S3 8 -3.40282e+038 3.40282e+038 DEPOSIT ABSOLUTE /end AXIS_PTS
/begin CHARACTERISTIC KF_2MK0CGETRMMOT2_SCHUB_ANS_W "K0 Moment in Phase 2 im Schub" MAP 0x1D36D4 FLOAT32_IEEE_COL_DIRECT_S6_S3 0 trq_fl_a_S6_S3 -3.40282e+038 3.40282e+038
 /begin AXIS_DESCR COM_AXIS NO_INPUT_QUANTITY c_int_S6_S3 8 -3.40282e+038 3.40282e+038 DEPOSIT ABSOLUTE AXIS_PTS_REF KF_2MK0CGETRMMOT2_SCHUB_ANS_X /end AXIS_DESCR
 /begin AXIS_DESCR COM_AXIS NO_INPUT_QUANTITY trq_fl_a_S6_S3 8 -3.40282e+038 3.40282e+038 DEPOSIT ABSOLUTE AXIS_PTS_REF KF_2MK0CGETRMMOT2_SCHUB_ANS_Y /end AXIS_DESCR
/end CHARACTERISTIC
/begin AXIS_PTS KF_2MK0CGETRMMOT2_SCHUB_ANS_X "X-Achse: c_getriebe_egs_in" 0x1D37D4 NO_INPUT_QUANTITY FLOAT32_IEEE_X_INCR_DIRECT_S6_S3 0 c_int_S6_S3 8 -3.40282e+038 3.40282e+038 DEPOSIT ABSOLUTE /end AXIS_PTS
/begin AXIS_PTS KF_2MK0CGETRMMOT2_SCHUB_ANS_Y "Y-Achse: m_mot_in" 0x1D37F4 NO_INPUT_QUANTITY FLOAT32_IEEE_X_INCR_DIRECT_S6_S3 0 trq_fl_a_S6_S3 8 -3.40282e+038 3.40282e+038 DEPOSIT ABSOLUTE /end AXIS_PTS
/begin CHARACTERISTIC KF_2MK0MMOTNVM1_ANS_W "K0 Moment in Phase 2" MAP 0x1D3814 FLOAT32_IEEE_COL_DIRECT_S6_S3 0 trq_fl_a_S6_S3 -3.40282e+038 3.40282e+038
 /begin AXIS_DESCR COM_AXIS NO_INPUT_QUANTITY trq_fl_a_S6_S3 8 -3.40282e+038 3.40282e+038 DEPOSIT ABSOLUTE AXIS_PTS_REF KF_2MK0MMOTNVM1_ANS_X /end AXIS_DESCR
 /begin AXIS_DESCR COM_AXIS NO_INPUT_QUANTITY n_fl_S6_S3 8 -3.40282e+038 3.40282e+038 DEPOSIT ABSOLUTE AXIS_PTS_REF KF_2MK0MMOTNVM1_ANS_Y /end AXIS_DESCR
/end CHARACTERISTIC
/begin AXIS_PTS KF_2MK0MMOTNVM1_ANS_X "X-Achse: m_mot_in" 0x1D3914 NO_INPUT_QUANTITY FLOAT32_IEEE_X_INCR_DIRECT_S6_S3 0 trq_fl_a_S6_S3 8 -3.40282e+038 3.40282e+038 DEPOSIT ABSOLUTE /end AXIS_PTS
/begin AXIS_PTS KF_2MK0MMOTNVM1_ANS_Y "Y-Achse: n_vm_in" 0x1D3934 NO_INPUT_QUANTITY FLOAT32_IEEE_X_INCR_DIRECT_S6_S3 0 n_fl_S6_S3 8 -3.40282e+038 3.40282e+038 DEPOSIT ABSOLUTE /end AXIS_PTS
/begin CHARACTERISTIC KF_2MK0MMOTNVM1_SCHUB_ANS_W "K0 Moment in Phase 2 im Schub" MAP 0x1D3954 FLOAT32_IEEE_COL_DIRECT_S6_S3 0 trq_fl_a_S6_S3 -3.40282e+038 3.40282e+038
 /begin AXIS_DESCR COM_AXIS NO_INPUT_QUANTITY trq_fl_a_S6_S3 8 -3.40282e+038 3.40282e+038 DEPOSIT ABSOLUTE AXIS_PTS_REF KF_2MK0MMOTNVM1_SCHUB_ANS_X /end AXIS_DESCR
 /begin AXIS_DESCR COM_AXIS NO_INPUT_QUANTITY n_fl_S6_S3 8 -3.40282e+038 3.40282e+038 DEPOSIT ABSOLUTE AXIS_PTS_REF KF_2MK0MMOTNVM1_SCHUB_ANS_Y /end AXIS_DESCR
/end CHARACTERISTIC
/begin AXIS_PTS KF_2MK0MMOTNVM1_SCHUB_ANS_X "X-Achse: m_mot_in" 0x1D3A54 NO_INPUT_QUANTITY FLOAT32_IEEE_X_INCR_DIRECT_S6_S3 0 trq_fl_a_S6_S3 8 -3.40282e+038 3.40282e+038 DEPOSIT ABSOLUTE /end AXIS_PTS
/begin AXIS_PTS KF_2MK0MMOTNVM1_SCHUB_ANS_Y "Y-Achse: n_vm_in" 0x1D3A74 NO_INPUT_QUANTITY FLOAT32_IEEE_X_INCR_DIRECT_S6_S3 0 n_fl_S6_S3 8 -3.40282e+038 3.40282e+038 DEPOSIT ABSOLUTE /end AXIS_PTS
/begin CHARACTERISTIC KF_2MK0MMOTNVM2_ANS_W "K0 Moment in Phase 2" MAP 0x1D3A94 FLOAT32_IEEE_COL_DIRECT_S6_S3 0 trq_fl_a_S6_S3 -3.40282e+038 3.40282e+038
 /begin AXIS_DESCR COM_AXIS NO_INPUT_QUANTITY trq_fl_a_S6_S3 8 -3.40282e+038 3.40282e+038 DEPOSIT ABSOLUTE AXIS_PTS_REF KF_2MK0MMOTNVM2_ANS_X /end AXIS_DESCR
 /begin AXIS_DESCR COM_AXIS NO_INPUT_QUANTITY n_fl_S6_S3 8 -3.40282e+038 3.40282e+038 DEPOSIT ABSOLUTE AXIS_PTS_REF KF_2MK0MMOTNVM2_ANS_Y /end AXIS_DESCR
/end CHARACTERISTIC
/begin AXIS_PTS KF_2MK0MMOTNVM2_ANS_X "X-Achse: m_mot_in" 0x1D3B94 NO_INPUT_QUANTITY FLOAT32_IEEE_X_INCR_DIRECT_S6_S3 0 trq_fl_a_S6_S3 8 -3.40282e+038 3.40282e+038 DEPOSIT ABSOLUTE /end AXIS_PTS
/begin AXIS_PTS KF_2MK0MMOTNVM2_ANS_Y "Y-Achse: n_vm_in" 0x1D3BB4 NO_INPUT_QUANTITY FLOAT32_IEEE_X_INCR_DIRECT_S6_S3 0 n_fl_S6_S3 8 -3.40282e+038 3.40282e+038 DEPOSIT ABSOLUTE /end AXIS_PTS
/begin CHARACTERISTIC KF_2MK0MMOTNVM2_SCHUB_ANS_W "K0 Moment in Phase 2 im Schub" MAP 0x1D3BD4 FLOAT32_IEEE_COL_DIRECT_S6_S3 0 trq_fl_a_S6_S3 -3.40282e+038 3.40282e+038
 /begin AXIS_DESCR COM_AXIS NO_INPUT_QUANTITY trq_fl_a_S6_S3 8 -3.40282e+038 3.40282e+038 DEPOSIT ABSOLUTE AXIS_PTS_REF KF_2MK0MMOTNVM2_SCHUB_ANS_X /end AXIS_DESCR
 /begin AXIS_DESCR COM_AXIS NO_INPUT_QUANTITY n_fl_S6_S3 8 -3.40282e+038 3.40282e+038 DEPOSIT ABSOLUTE AXIS_PTS_REF KF_2MK0MMOTNVM2_SCHUB_ANS_Y /end AXIS_DESCR
/end CHARACTERISTIC
/begin AXIS_PTS KF_2MK0MMOTNVM2_SCHUB_ANS_X "X-Achse: m_mot_in" 0x1D3CD4 NO_INPUT_QUANTITY FLOAT32_IEEE_X_INCR_DIRECT_S6_S3 0 trq_fl_a_S6_S3 8 -3.40282e+038 3.40282e+038 DEPOSIT ABSOLUTE /end AXIS_PTS
/begin AXIS_PTS KF_2MK0MMOTNVM2_SCHUB_ANS_Y "Y-Achse: n_vm_in" 0x1D3CF4 NO_INPUT_QUANTITY FLOAT32_IEEE_X_INCR_DIRECT_S6_S3 0 n_fl_S6_S3 8 -3.40282e+038 3.40282e+038 DEPOSIT ABSOLUTE /end AXIS_PTS
/begin CHARACTERISTIC KF_2MOK0ABSTELLPOS_ANS_W "K0 Momentoffset aus der Abstellpos Phase 102" MAP 0x1D3D14 FLOAT32_IEEE_COL_DIRECT_S6_S3 0 trq_fl_a_S6_S3 -3.40282e+038 3.40282e+038
 /begin AXIS_DESCR COM_AXIS NO_INPUT_QUANTITY c_int_S6_S3 8 -3.40282e+038 3.40282e+038 DEPOSIT ABSOLUTE AXIS_PTS_REF KF_2MOK0ABSTELLPOS_ANS_X /end AXIS_DESCR
 /begin AXIS_DESCR COM_AXIS NO_INPUT_QUANTITY phi_fl_S6_S3 8 -3.40282e+038 3.40282e+038 DEPOSIT ABSOLUTE AXIS_PTS_REF KF_2MOK0ABSTELLPOS_ANS_Y /end AXIS_DESCR
/end CHARACTERISTIC
/begin AXIS_PTS KF_2MOK0ABSTELLPOS_ANS_X "X-Achse: c_vm_in" 0x1D3E14 NO_INPUT_QUANTITY FLOAT32_IEEE_X_INCR_DIRECT_S6_S3 0 c_int_S6_S3 8 -3.40282e+038 3.40282e+038 DEPOSIT ABSOLUTE /end AXIS_PTS
/begin AXIS_PTS KF_2MOK0ABSTELLPOS_ANS_Y "Y-Achse: abstellpos_vm_in" 0x1D3E34 NO_INPUT_QUANTITY FLOAT32_IEEE_X_INCR_DIRECT_S6_S3 0 phi_fl_S6_S3 8 -3.40282e+038 3.40282e+038 DEPOSIT ABSOLUTE /end AXIS_PTS
/begin CHARACTERISTIC KF_3MK0CGETRMMOT_ANS_W "K0 Moment in Phase 3" MAP 0x1D3E54 FLOAT32_IEEE_COL_DIRECT_S6_S3 0 trq_fl_a_S6_S3 -3.40282e+038 3.40282e+038
 /begin AXIS_DESCR COM_AXIS NO_INPUT_QUANTITY c_int_S6_S3 8 -3.40282e+038 3.40282e+038 DEPOSIT ABSOLUTE AXIS_PTS_REF KF_3MK0CGETRMMOT_ANS_X /end AXIS_DESCR
 /begin AXIS_DESCR COM_AXIS NO_INPUT_QUANTITY trq_fl_a_S6_S3 8 -3.40282e+038 3.40282e+038 DEPOSIT ABSOLUTE AXIS_PTS_REF KF_3MK0CGETRMMOT_ANS_Y /end AXIS_DESCR
/end CHARACTERISTIC
/begin AXIS_PTS KF_3MK0CGETRMMOT_ANS_X "X-Achse: c_getriebe_egs_in" 0x1D3F54 NO_INPUT_QUANTITY FLOAT32_IEEE_X_INCR_DIRECT_S6_S3 0 c_int_S6_S3 8 -3.40282e+038 3.40282e+038 DEPOSIT ABSOLUTE /end AXIS_PTS
/begin AXIS_PTS KF_3MK0CGETRMMOT_ANS_Y "Y-Achse: m_mot_in" 0x1D3F74 NO_INPUT_QUANTITY FLOAT32_IEEE_X_INCR_DIRECT_S6_S3 0 trq_fl_a_S6_S3 8 -3.40282e+038 3.40282e+038 DEPOSIT ABSOLUTE /end AXIS_PTS
/begin CHARACTERISTIC KF_3MK0CGETRMMOT_SCHUB_ANS_W "K0 Moment in Phase 3 im Schub" MAP 0x1D3F94 FLOAT32_IEEE_COL_DIRECT_S6_S3 0 trq_fl_a_S6_S3 -3.40282e+038 3.40282e+038
 /begin AXIS_DESCR COM_AXIS NO_INPUT_QUANTITY c_int_S6_S3 8 -3.40282e+038 3.40282e+038 DEPOSIT ABSOLUTE AXIS_PTS_REF KF_3MK0CGETRMMOT_SCHUB_ANS_X /end AXIS_DESCR
 /begin AXIS_DESCR COM_AXIS NO_INPUT_QUANTITY trq_fl_a_S6_S3 8 -3.40282e+038 3.40282e+038 DEPOSIT ABSOLUTE AXIS_PTS_REF KF_3MK0CGETRMMOT_SCHUB_ANS_Y /end AXIS_DESCR
/end CHARACTERISTIC
/begin AXIS_PTS KF_3MK0CGETRMMOT_SCHUB_ANS_X "X-Achse: c_getriebe_egs_in" 0x1D4094 NO_INPUT_QUANTITY FLOAT32_IEEE_X_INCR_DIRECT_S6_S3 0 c_int_S6_S3 8 -3.40282e+038 3.40282e+038 DEPOSIT ABSOLUTE /end AXIS_PTS
/begin AXIS_PTS KF_3MK0CGETRMMOT_SCHUB_ANS_Y "Y-Achse: m_mot_in" 0x1D40B4 NO_INPUT_QUANTITY FLOAT32_IEEE_X_INCR_DIRECT_S6_S3 0 trq_fl_a_S6_S3 8 -3.40282e+038 3.40282e+038 DEPOSIT ABSOLUTE /end AXIS_PTS
/begin CHARACTERISTIC KF_3MK0MMOTNVM_ANS_W "K0 Moment in Phase 3" MAP 0x1D40D4 FLOAT32_IEEE_COL_DIRECT_S6_S3 0 trq_fl_a_S6_S3 -3.40282e+038 3.40282e+038
 /begin AXIS_DESCR COM_AXIS NO_INPUT_QUANTITY trq_fl_a_S6_S3 8 -3.40282e+038 3.40282e+038 DEPOSIT ABSOLUTE AXIS_PTS_REF KF_3MK0MMOTNVM_ANS_X /end AXIS_DESCR
 /begin AXIS_DESCR COM_AXIS NO_INPUT_QUANTITY n_fl_S6_S3 8 -3.40282e+038 3.40282e+038 DEPOSIT ABSOLUTE AXIS_PTS_REF KF_3MK0MMOTNVM_ANS_Y /end AXIS_DESCR
/end CHARACTERISTIC
/begin AXIS_PTS KF_3MK0MMOTNVM_ANS_X "X-Achse: m_mot_in" 0x1D41D4 NO_INPUT_QUANTITY FLOAT32_IEEE_X_INCR_DIRECT_S6_S3 0 trq_fl_a_S6_S3 8 -3.40282e+038 3.40282e+038 DEPOSIT ABSOLUTE /end AXIS_PTS
/begin AXIS_PTS KF_3MK0MMOTNVM_ANS_Y "Y-Achse: n_vm_in" 0x1D41F4 NO_INPUT_QUANTITY FLOAT32_IEEE_X_INCR_DIRECT_S6_S3 0 n_fl_S6_S3 8 -3.40282e+038 3.40282e+038 DEPOSIT ABSOLUTE /end AXIS_PTS
/begin CHARACTERISTIC KF_3MK0MMOTNVM_SCHUB_ANS_W "K0 Moment in Phase 3 im Schub" MAP 0x1D4214 FLOAT32_IEEE_COL_DIRECT_S6_S3 0 trq_fl_a_S6_S3 -3.40282e+038 3.40282e+038
 /begin AXIS_DESCR COM_AXIS NO_INPUT_QUANTITY trq_fl_a_S6_S3 8 -3.40282e+038 3.40282e+038 DEPOSIT ABSOLUTE AXIS_PTS_REF KF_3MK0MMOTNVM_SCHUB_ANS_X /end AXIS_DESCR
 /begin AXIS_DESCR COM_AXIS NO_INPUT_QUANTITY n_fl_S6_S3 8 -3.40282e+038 3.40282e+038 DEPOSIT ABSOLUTE AXIS_PTS_REF KF_3MK0MMOTNVM_SCHUB_ANS_Y /end AXIS_DESCR
/end CHARACTERISTIC
/begin AXIS_PTS KF_3MK0MMOTNVM_SCHUB_ANS_X "X-Achse: m_mot_in" 0x1D4314 NO_INPUT_QUANTITY FLOAT32_IEEE_X_INCR_DIRECT_S6_S3 0 trq_fl_a_S6_S3 8 -3.40282e+038 3.40282e+038 DEPOSIT ABSOLUTE /end AXIS_PTS
/begin AXIS_PTS KF_3MK0MMOTNVM_SCHUB_ANS_Y "Y-Achse: n_vm_in" 0x1D4334 NO_INPUT_QUANTITY FLOAT32_IEEE_X_INCR_DIRECT_S6_S3 0 n_fl_S6_S3 8 -3.40282e+038 3.40282e+038 DEPOSIT ABSOLUTE /end AXIS_PTS
/begin CHARACTERISTIC KF_3VMISTVMSOLL_ANS_W "Drehzahlschwelle VM zum Zurücksetzen der SVH" MAP 0x1D4354 FLOAT32_IEEE_COL_DIRECT_S6_S3 0 n_fl_S6_S3 -3.40282e+038 3.40282e+038
 /begin AXIS_DESCR COM_AXIS NO_INPUT_QUANTITY c_int_S6_S3 8 -3.40282e+038 3.40282e+038 DEPOSIT ABSOLUTE AXIS_PTS_REF KF_3VMISTVMSOLL_ANS_X /end AXIS_DESCR
 /begin AXIS_DESCR COM_AXIS NO_INPUT_QUANTITY void_int_S6_S3 8 -128 127 DEPOSIT ABSOLUTE AXIS_PTS_REF KF_3VMISTVMSOLL_ANS_Y /end AXIS_DESCR
/end CHARACTERISTIC
/begin AXIS_PTS KF_3VMISTVMSOLL_ANS_X "X-Achse c_getriebe_egs_in" 0x1D4454 NO_INPUT_QUANTITY FLOAT32_IEEE_X_INCR_DIRECT_S6_S3 0 c_int_S6_S3 8 -3.40282e+038 3.40282e+038 DEPOSIT ABSOLUTE /end AXIS_PTS
/begin AXIS_PTS KF_3VMISTVMSOLL_ANS_Y "Y-Achse: sollgang_egs_in" 0x1D5B9C NO_INPUT_QUANTITY SBYTE_X_INCR_DIRECT_S6_S3 0 void_int_S6_S3 8 -128 127 DEPOSIT ABSOLUTE /end AXIS_PTS
/begin CHARACTERISTIC KF_4MGSOLLK0_ANS_W "Ausgabe Gradient Kupplungsmoment in Abh. von nd_Kpl und Fahrsollmoment" MAP 0x1D4474 FLOAT32_IEEE_COL_DIRECT_S6_S3 0 trqg_fl_c_S6_S3 -3.40282e+038 3.40282e+038
 /begin AXIS_DESCR COM_AXIS NO_INPUT_QUANTITY n_fl_S6_S3 7 -3.40282e+038 3.40282e+038 DEPOSIT ABSOLUTE AXIS_PTS_REF KF_4MGSOLLK0_ANS_X /end AXIS_DESCR
 /begin AXIS_DESCR COM_AXIS NO_INPUT_QUANTITY ng_fl_S6_S3 6 -3.40282e+038 3.40282e+038 DEPOSIT ABSOLUTE AXIS_PTS_REF KF_4MGSOLLK0_ANS_Y /end AXIS_DESCR
/end CHARACTERISTIC
/begin AXIS_PTS KF_4MGSOLLK0_ANS_X "X-Achse Gradient Kupplungsmoment in Abh. von nd_Kpl und Fahrsollmoment" 0x1D451C NO_INPUT_QUANTITY FLOAT32_IEEE_X_INCR_DIRECT_S6_S3 0 n_fl_S6_S3 7 -3.40282e+038 3.40282e+038 DEPOSIT ABSOLUTE /end AXIS_PTS
/begin AXIS_PTS KF_4MGSOLLK0_ANS_Y "Y-AchseGradient Kupplungsmoment in Abh. von nd_Kpl und Fahrsollmoment" 0x1D4538 NO_INPUT_QUANTITY FLOAT32_IEEE_X_INCR_DIRECT_S6_S3 0 ng_fl_S6_S3 6 -3.40282e+038 3.40282e+038 DEPOSIT ABSOLUTE /end AXIS_PTS
/begin CHARACTERISTIC KF_4MGSOLLK0_SCHUB_ANS_W "Momentgradient der K0 im nichtentkoppeltem Zustand" MAP 0x1D4550 FLOAT32_IEEE_COL_DIRECT_S6_S3 0 trqg_fl_c_S6_S3 -3.40282e+038 3.40282e+038
 /begin AXIS_DESCR COM_AXIS NO_INPUT_QUANTITY n_fl_S6_S3 7 -3.40282e+038 3.40282e+038 DEPOSIT ABSOLUTE AXIS_PTS_REF KF_4MGSOLLK0_SCHUB_ANS_X /end AXIS_DESCR
 /begin AXIS_DESCR COM_AXIS NO_INPUT_QUANTITY ng_fl_S6_S3 6 -3.40282e+038 3.40282e+038 DEPOSIT ABSOLUTE AXIS_PTS_REF KF_4MGSOLLK0_SCHUB_ANS_Y /end AXIS_DESCR
/end CHARACTERISTIC
/begin AXIS_PTS KF_4MGSOLLK0_SCHUB_ANS_X "X-Achse nd_k0_input" 0x1D45F8 NO_INPUT_QUANTITY FLOAT32_IEEE_X_INCR_DIRECT_S6_S3 0 n_fl_S6_S3 7 -3.40282e+038 3.40282e+038 DEPOSIT ABSOLUTE /end AXIS_PTS
/begin AXIS_PTS KF_4MGSOLLK0_SCHUB_ANS_Y "Y-Achse: ndg_k0_in" 0x1D4614 NO_INPUT_QUANTITY FLOAT32_IEEE_X_INCR_DIRECT_S6_S3 0 ng_fl_S6_S3 6 -3.40282e+038 3.40282e+038 DEPOSIT ABSOLUTE /end AXIS_PTS
/begin CHARACTERISTIC KF_MGK0VMANDREH_KON_ANS_W "mg_soll_k0_has für VM Andrehen" MAP 0x1D4D04 FLOAT32_IEEE_COL_DIRECT_S6_S3 0 trqg_fl_c_S6_S3 -3.40282e+038 3.40282e+038
 /begin AXIS_DESCR COM_AXIS NO_INPUT_QUANTITY c_int_S6_S3 8 -3.40282e+038 3.40282e+038 DEPOSIT ABSOLUTE AXIS_PTS_REF KF_MGK0VMANDREH_KON_ANS_X /end AXIS_DESCR
 /begin AXIS_DESCR COM_AXIS NO_INPUT_QUANTITY phi_fl_S6_S3 8 -3.40282e+038 3.40282e+038 DEPOSIT ABSOLUTE AXIS_PTS_REF KF_MGK0VMANDREH_KON_ANS_Y /end AXIS_DESCR
/end CHARACTERISTIC
/begin AXIS_PTS KF_MGK0VMANDREH_KON_ANS_X "X-Achse c_getriebe_egs_in" 0x1D4E04 NO_INPUT_QUANTITY FLOAT32_IEEE_X_INCR_DIRECT_S6_S3 0 c_int_S6_S3 8 -3.40282e+038 3.40282e+038 DEPOSIT ABSOLUTE /end AXIS_PTS
/begin AXIS_PTS KF_MGK0VMANDREH_KON_ANS_Y "Y-Achse abstellpos_vm_in" 0x1D4E24 NO_INPUT_QUANTITY FLOAT32_IEEE_X_INCR_DIRECT_S6_S3 0 phi_fl_S6_S3 8 -3.40282e+038 3.40282e+038 DEPOSIT ABSOLUTE /end AXIS_PTS
/begin CHARACTERISTIC KF_MZIELK0VMANDREH_KON_ANS_W "m_soll_k0_has für Verbrenner dreht bereits " MAP 0x1D5104 FLOAT32_IEEE_COL_DIRECT_S6_S3 0 trq_fl_a_S6_S3 -3.40282e+038 3.40282e+038
 /begin AXIS_DESCR COM_AXIS NO_INPUT_QUANTITY ng_fl_S6_S3 8 -3.40282e+038 3.40282e+038 DEPOSIT ABSOLUTE AXIS_PTS_REF KF_MZIELK0VMANDREH_KON_ANS_X /end AXIS_DESCR
 /begin AXIS_DESCR COM_AXIS NO_INPUT_QUANTITY n_fl_S6_S3 8 -3.40282e+038 3.40282e+038 DEPOSIT ABSOLUTE AXIS_PTS_REF KF_MZIELK0VMANDREH_KON_ANS_Y /end AXIS_DESCR
/end CHARACTERISTIC
/begin AXIS_PTS KF_MZIELK0VMANDREH_KON_ANS_X "X-Achse ng_vm_in" 0x1D5204 NO_INPUT_QUANTITY FLOAT32_IEEE_X_INCR_DIRECT_S6_S3 0 ng_fl_S6_S3 8 -3.40282e+038 3.40282e+038 DEPOSIT ABSOLUTE /end AXIS_PTS
/begin AXIS_PTS KF_MZIELK0VMANDREH_KON_ANS_Y "Y-Achse: n_vm_in" 0x1D5224 NO_INPUT_QUANTITY FLOAT32_IEEE_X_INCR_DIRECT_S6_S3 0 n_fl_S6_S3 8 -3.40282e+038 3.40282e+038 DEPOSIT ABSOLUTE /end AXIS_PTS
/begin CHARACTERISTIC KF_NOSOLLIAEAKTIV_ANS_W "Aktivierung Drehzahloffset für EM Solldrehzahl als f=(status_iae_in, status_kraftfluss_egs_in)" MAP 0x1D7E00 UBYTE_COL_DIRECT_S6_S3 0 void_int_S6_S3 0 1
 /begin AXIS_DESCR COM_AXIS NO_INPUT_QUANTITY void_int_S6_S3 9 0 8 DEPOSIT ABSOLUTE AXIS_PTS_REF KF_NOSOLLIAEAKTIV_ANS_X /end AXIS_DESCR
 /begin AXIS_DESCR COM_AXIS NO_INPUT_QUANTITY void_int_S6_S3 7 0 6 DEPOSIT ABSOLUTE AXIS_PTS_REF KF_NOSOLLIAEAKTIV_ANS_Y /end AXIS_DESCR
/end CHARACTERISTIC
/begin AXIS_PTS KF_NOSOLLIAEAKTIV_ANS_X "X-Achse: status_iae_in" 0x1D7E3F NO_INPUT_QUANTITY UBYTE_X_INCR_DIRECT_S6_S3 0 void_int_S6_S3 9 0 8 DEPOSIT ABSOLUTE /end AXIS_PTS
/begin AXIS_PTS KF_NOSOLLIAEAKTIV_ANS_Y "Y-Achse: status_kraftfluss_egs_in" 0x1D7E48 NO_INPUT_QUANTITY UBYTE_X_INCR_DIRECT_S6_S3 0 void_int_S6_S3 7 0 6 DEPOSIT ABSOLUTE /end AXIS_PTS
/begin CHARACTERISTIC KF_NSOLLVMZIELIST_ANS_W "Bestimmung der Umschaltung von n_sec_iae_ziel oder n_em für Bestimmung n_soll_vm im Zustand St_Schaltung_aktiv" MAP 0x1D5BF4 UBYTE_COL_DIRECT_S6_S3 0 void_int_S6_S3 0 255
 /begin AXIS_DESCR COM_AXIS NO_INPUT_QUANTITY void_int_S6_S3 10 -128 127 DEPOSIT ABSOLUTE AXIS_PTS_REF KF_NSOLLVMZIELIST_ANS_X /end AXIS_DESCR
 /begin AXIS_DESCR COM_AXIS NO_INPUT_QUANTITY void_int_S6_S3 10 -128 127 DEPOSIT ABSOLUTE AXIS_PTS_REF KF_NSOLLVMZIELIST_ANS_Y /end AXIS_DESCR
/end CHARACTERISTIC
/begin AXIS_PTS KF_NSOLLVMZIELIST_ANS_X "X-Achse: zielgang_egs_in" 0x1D8C58 NO_INPUT_QUANTITY SBYTE_X_INCR_DIRECT_S6_S3 0 void_int_S6_S3 10 -128 127 DEPOSIT ABSOLUTE /end AXIS_PTS
/begin AXIS_PTS KF_NSOLLVMZIELIST_ANS_Y "Y-Achse: istgang_egs_in" 0x1D8C62 NO_INPUT_QUANTITY SBYTE_X_INCR_DIRECT_S6_S3 0 void_int_S6_S3 10 -128 127 DEPOSIT ABSOLUTE /end AXIS_PTS
/begin CHARACTERISTIC KF_UMSCHNSOLLEMABS_ANS_W "Umschaltung n_soll_em_has Berechnung, relativ oder absolut" MAP 0x1D7E9E UBYTE_COL_DIRECT_S6_S3 0 void_int_S6_S3 0 1
 /begin AXIS_DESCR COM_AXIS NO_INPUT_QUANTITY void_int_S6_S3 9 0 255 DEPOSIT ABSOLUTE AXIS_PTS_REF KF_UMSCHNSOLLEMABS_ANS_X /end AXIS_DESCR
 /begin AXIS_DESCR COM_AXIS NO_INPUT_QUANTITY void_int_S6_S3 7 0 255 DEPOSIT ABSOLUTE AXIS_PTS_REF KF_UMSCHNSOLLEMABS_ANS_Y /end AXIS_DESCR
/end CHARACTERISTIC
/begin AXIS_PTS KF_UMSCHNSOLLEMABS_ANS_X "X-Achse: status_iae_in" 0x1D7EDD NO_INPUT_QUANTITY UBYTE_X_INCR_DIRECT_S6_S3 0 void_int_S6_S3 9 0 255 DEPOSIT ABSOLUTE /end AXIS_PTS
/begin AXIS_PTS KF_UMSCHNSOLLEMABS_ANS_Y "Y-Achse: status_kraftfluss_egs_in" 0x1D7EE6 NO_INPUT_QUANTITY UBYTE_X_INCR_DIRECT_S6_S3 0 void_int_S6_S3 7 0 255 DEPOSIT ABSOLUTE /end AXIS_PTS
/begin AXIS_PTS KL_10FNDGSOLLIAE_ANS_X "X-Achse: istgang_egs_in" 0x1D8C9C NO_INPUT_QUANTITY SBYTE_X_INCR_DIRECT_S6_S3 0 void_int_S6_S3 10 -1 8 DEPOSIT ABSOLUTE /end AXIS_PTS
/begin CHARACTERISTIC KL_10FNDGSOLLIAE_ANS_Y "KL_10FNDGSOLLIAE_ANS_Y" CURVE 0x1D5384 FLOAT32_IEEE_COL_DIRECT_S6_S3 0 void_fl_S6_S3 -3.40282e+038 3.40282e+038
 /begin AXIS_DESCR COM_AXIS NO_INPUT_QUANTITY void_int_S6_S3 10 -1 8 DEPOSIT ABSOLUTE AXIS_PTS_REF KL_10FNDGSOLLIAE_ANS_X /end AXIS_DESCR
/end CHARACTERISTIC
/begin AXIS_PTS KL_10FNDSOLLIAE_ANS_X "X-Achse: istgang_egs_in" 0x1D8CA6 NO_INPUT_QUANTITY SBYTE_X_INCR_DIRECT_S6_S3 0 void_int_S6_S3 10 -1 8 DEPOSIT ABSOLUTE /end AXIS_PTS
/begin CHARACTERISTIC KL_10FNDSOLLIAE_ANS_Y "KL_10FNDSOLLIAE_ANS_Y" CURVE 0x1D53AC FLOAT32_IEEE_COL_DIRECT_S6_S3 0 void_fl_S6_S3 -3.40282e+038 3.40282e+038
 /begin AXIS_DESCR COM_AXIS NO_INPUT_QUANTITY void_int_S6_S3 10 -1 8 DEPOSIT ABSOLUTE AXIS_PTS_REF KL_10FNDSOLLIAE_ANS_X /end AXIS_DESCR
/end CHARACTERISTIC
/begin AXIS_PTS KL_1FNDGSOLLIAE_ANS_X "X-Achse: istgang_egs_in" 0x1D8CB0 NO_INPUT_QUANTITY SBYTE_X_INCR_DIRECT_S6_S3 0 void_int_S6_S3 10 -128 127 DEPOSIT ABSOLUTE /end AXIS_PTS
/begin CHARACTERISTIC KL_1FNDGSOLLIAE_ANS_Y "KL_1FNDGSOLLIAE_ANS_Y" CURVE 0x1D53D4 FLOAT32_IEEE_COL_DIRECT_S6_S3 0 void_fl_S6_S3 -3.40282e+038 3.40282e+038
 /begin AXIS_DESCR COM_AXIS NO_INPUT_QUANTITY void_int_S6_S3 10 -128 127 DEPOSIT ABSOLUTE AXIS_PTS_REF KL_1FNDGSOLLIAE_ANS_X /end AXIS_DESCR
/end CHARACTERISTIC
/begin AXIS_PTS KL_1FNDSOLLIAE_ANS_X "X-Achse: istgange_egs_in" 0x1D8CBA NO_INPUT_QUANTITY SBYTE_X_INCR_DIRECT_S6_S3 0 void_int_S6_S3 10 -128 127 DEPOSIT ABSOLUTE /end AXIS_PTS
/begin CHARACTERISTIC KL_1FNDSOLLIAE_ANS_Y "KL_1FNDSOLLIAE_ANS_Y" CURVE 0x1D53FC FLOAT32_IEEE_COL_DIRECT_S6_S3 0 void_fl_S6_S3 -3.40282e+038 3.40282e+038
 /begin AXIS_DESCR COM_AXIS NO_INPUT_QUANTITY void_int_S6_S3 10 -128 127 DEPOSIT ABSOLUTE AXIS_PTS_REF KL_1FNDSOLLIAE_ANS_X /end AXIS_DESCR
/end CHARACTERISTIC
/begin AXIS_PTS KL_1NDIAEEMMAXIAE_ANS_X "X: Momentoffset auf m_max_iae_has = f(nd_iae, nd_ziel_iae_stat)" 0x1D5424 NO_INPUT_QUANTITY FLOAT32_IEEE_X_INCR_DIRECT_S6_S3 0 n_fl_S6_S3 8 -3.40282e+038 3.40282e+038 DEPOSIT ABSOLUTE /end AXIS_PTS
/begin CHARACTERISTIC KL_1NDIAEEMMAXIAE_ANS_Y "Y: Momentoffset auf m_max_iae_has = f(nd_iae, nd_ziel_iae_stat)" CURVE 0x1D5444 FLOAT32_IEEE_COL_DIRECT_S6_S3 0 trq_fl_a_S6_S3 -3.40282e+038 3.40282e+038
 /begin AXIS_DESCR COM_AXIS NO_INPUT_QUANTITY n_fl_S6_S3 8 -3.40282e+038 3.40282e+038 DEPOSIT ABSOLUTE AXIS_PTS_REF KL_1NDIAEEMMAXIAE_ANS_X /end AXIS_DESCR
/end CHARACTERISTIC
/begin AXIS_PTS KL_24NDSOLLIAEABLVAR_ANS_X "X-Achse: z_ablaufvariante_has_stg" 0x1D5D14 NO_INPUT_QUANTITY UBYTE_X_INCR_DIRECT_S6_S3 0 void_int_S6_S3 8 0 99 DEPOSIT ABSOLUTE /end AXIS_PTS
/begin CHARACTERISTIC KL_24NDSOLLIAEABLVAR_ANS_Y "Bestimmung der Abfilterung von n_soll_em =f(z_ablaufvariante)" CURVE 0x1D5D1C UBYTE_COL_DIRECT_S6_S3 0 void_int_S6_S3 0 2
 /begin AXIS_DESCR COM_AXIS NO_INPUT_QUANTITY void_int_S6_S3 8 0 99 DEPOSIT ABSOLUTE AXIS_PTS_REF KL_24NDSOLLIAEABLVAR_ANS_X /end AXIS_DESCR
/end CHARACTERISTIC
/begin AXIS_PTS KL_2FMK0CGETRMMOT1_ANS_X "X-Achse: istgang_egs_in" 0x1D8CC4 NO_INPUT_QUANTITY SBYTE_X_INCR_DIRECT_S6_S3 0 void_int_S6_S3 10 -128 127 DEPOSIT ABSOLUTE /end AXIS_PTS
/begin CHARACTERISTIC KL_2FMK0CGETRMMOT1_ANS_Y "Gewichtungsfaktor K0-Moment in Phase 2" CURVE 0x1D54C4 FLOAT32_IEEE_COL_DIRECT_S6_S3 0 void_fl_S6_S3 -3.40282e+038 3.40282e+038
 /begin AXIS_DESCR COM_AXIS NO_INPUT_QUANTITY void_int_S6_S3 10 -128 127 DEPOSIT ABSOLUTE AXIS_PTS_REF KL_2FMK0CGETRMMOT1_ANS_X /end AXIS_DESCR
/end CHARACTERISTIC
/begin AXIS_PTS KL_2FMK0CGETRMMOT1_SCHUB_ANS_X "X-Achse: istgang_egs_in" 0x1D8CCE NO_INPUT_QUANTITY SBYTE_X_INCR_DIRECT_S6_S3 0 void_int_S6_S3 10 -128 127 DEPOSIT ABSOLUTE /end AXIS_PTS
/begin CHARACTERISTIC KL_2FMK0CGETRMMOT1_SCHUB_ANS_Y "Gewichtungsfaktor K0-Moment in Phase 2 im Schub" CURVE 0x1D54EC FLOAT32_IEEE_COL_DIRECT_S6_S3 0 void_fl_S6_S3 -3.40282e+038 3.40282e+038
 /begin AXIS_DESCR COM_AXIS NO_INPUT_QUANTITY void_int_S6_S3 10 -128 127 DEPOSIT ABSOLUTE AXIS_PTS_REF KL_2FMK0CGETRMMOT1_SCHUB_ANS_X /end AXIS_DESCR
/end CHARACTERISTIC
/begin AXIS_PTS KL_2FMK0CGETRMMOT2_ANS_X "X-Achse: istgang_egs_in" 0x1D8CD8 NO_INPUT_QUANTITY SBYTE_X_INCR_DIRECT_S6_S3 0 void_int_S6_S3 10 -1 8 DEPOSIT ABSOLUTE /end AXIS_PTS
/begin CHARACTERISTIC KL_2FMK0CGETRMMOT2_ANS_Y "Gewichtungsfaktor K0-Moment in Phase 2" CURVE 0x1D5514 FLOAT32_IEEE_COL_DIRECT_S6_S3 0 void_fl_S6_S3 -3.40282e+038 3.40282e+038
 /begin AXIS_DESCR COM_AXIS NO_INPUT_QUANTITY void_int_S6_S3 10 -1 8 DEPOSIT ABSOLUTE AXIS_PTS_REF KL_2FMK0CGETRMMOT2_ANS_X /end AXIS_DESCR
/end CHARACTERISTIC
/begin AXIS_PTS KL_2FMK0CGETRMMOT2_SCHUB_ANS_X "x-Achse: istgang_egs_in" 0x1D8CE2 NO_INPUT_QUANTITY SBYTE_X_INCR_DIRECT_S6_S3 0 void_int_S6_S3 10 -128 127 DEPOSIT ABSOLUTE /end AXIS_PTS
/begin CHARACTERISTIC KL_2FMK0CGETRMMOT2_SCHUB_ANS_Y "Gewichtungsfaktor K0-Moment in Phase 2 im Schub" CURVE 0x1D553C FLOAT32_IEEE_COL_DIRECT_S6_S3 0 void_fl_S6_S3 -3.40282e+038 3.40282e+038
 /begin AXIS_DESCR COM_AXIS NO_INPUT_QUANTITY void_int_S6_S3 10 -128 127 DEPOSIT ABSOLUTE AXIS_PTS_REF KL_2FMK0CGETRMMOT2_SCHUB_ANS_X /end AXIS_DESCR
/end CHARACTERISTIC
/begin AXIS_PTS KL_2FMK0MMOTNVM1_ANS_X "X-Achse: istgang_egs_in" 0x1D8CEC NO_INPUT_QUANTITY SBYTE_X_INCR_DIRECT_S6_S3 0 void_int_S6_S3 10 -128 127 DEPOSIT ABSOLUTE /end AXIS_PTS
/begin CHARACTERISTIC KL_2FMK0MMOTNVM1_ANS_Y "Gewichtungsfaktor K0-Moment in Phase 2" CURVE 0x1D5564 FLOAT32_IEEE_COL_DIRECT_S6_S3 0 void_fl_S6_S3 -3.40282e+038 3.40282e+038
 /begin AXIS_DESCR COM_AXIS NO_INPUT_QUANTITY void_int_S6_S3 10 -128 127 DEPOSIT ABSOLUTE AXIS_PTS_REF KL_2FMK0MMOTNVM1_ANS_X /end AXIS_DESCR
/end CHARACTERISTIC
/begin AXIS_PTS KL_2FMK0MMOTNVM1_SCHUB_ANS_X "X-Achse: istgang_egs_in" 0x1D8CF6 NO_INPUT_QUANTITY SBYTE_X_INCR_DIRECT_S6_S3 0 void_int_S6_S3 10 -128 127 DEPOSIT ABSOLUTE /end AXIS_PTS
/begin CHARACTERISTIC KL_2FMK0MMOTNVM1_SCHUB_ANS_Y "Gewichtungsfaktor K0-Moment in Phase 2 im Schub" CURVE 0x1D558C FLOAT32_IEEE_COL_DIRECT_S6_S3 0 void_fl_S6_S3 -3.40282e+038 3.40282e+038
 /begin AXIS_DESCR COM_AXIS NO_INPUT_QUANTITY void_int_S6_S3 10 -128 127 DEPOSIT ABSOLUTE AXIS_PTS_REF KL_2FMK0MMOTNVM1_SCHUB_ANS_X /end AXIS_DESCR
/end CHARACTERISTIC
/begin AXIS_PTS KL_2FMK0MMOTNVM2_ANS_X "X-Achse: istgang_egs_in" 0x1D8D00 NO_INPUT_QUANTITY SBYTE_X_INCR_DIRECT_S6_S3 0 void_int_S6_S3 10 -1 8 DEPOSIT ABSOLUTE /end AXIS_PTS
/begin CHARACTERISTIC KL_2FMK0MMOTNVM2_ANS_Y "Gewichtungsfaktor K0-Moment in Phase 2" CURVE 0x1D55B4 FLOAT32_IEEE_COL_DIRECT_S6_S3 0 void_fl_S6_S3 -3.40282e+038 3.40282e+038
 /begin AXIS_DESCR COM_AXIS NO_INPUT_QUANTITY void_int_S6_S3 10 -1 8 DEPOSIT ABSOLUTE AXIS_PTS_REF KL_2FMK0MMOTNVM2_ANS_X /end AXIS_DESCR
/end CHARACTERISTIC
/begin AXIS_PTS KL_2FMK0MMOTNVM2_SCHUB_ANS_X "X-Achse: istgang_egs_in" 0x1D8D0A NO_INPUT_QUANTITY SBYTE_X_INCR_DIRECT_S6_S3 0 void_int_S6_S3 10 -128 127 DEPOSIT ABSOLUTE /end AXIS_PTS
/begin CHARACTERISTIC KL_2FMK0MMOTNVM2_SCHUB_ANS_Y "Gewichtungsfaktor K0-Moment in Phase 2 im Schub" CURVE 0x1D55DC FLOAT32_IEEE_COL_DIRECT_S6_S3 0 void_fl_S6_S3 -3.40282e+038 3.40282e+038
 /begin AXIS_DESCR COM_AXIS NO_INPUT_QUANTITY void_int_S6_S3 10 -128 127 DEPOSIT ABSOLUTE AXIS_PTS_REF KL_2FMK0MMOTNVM2_SCHUB_ANS_X /end AXIS_DESCR
/end CHARACTERISTIC
/begin AXIS_PTS KL_2FNDGSOLLIAE_ANS_X "X-Achse: istgang_egs_in" 0x1D8D14 NO_INPUT_QUANTITY SBYTE_X_INCR_DIRECT_S6_S3 0 void_int_S6_S3 10 -128 127 DEPOSIT ABSOLUTE /end AXIS_PTS
/begin CHARACTERISTIC KL_2FNDGSOLLIAE_ANS_Y "KL_2FNDGSOLLIAE_ANS_Y" CURVE 0x1D5604 FLOAT32_IEEE_COL_DIRECT_S6_S3 0 void_fl_S6_S3 -3.40282e+038 3.40282e+038
 /begin AXIS_DESCR COM_AXIS NO_INPUT_QUANTITY void_int_S6_S3 10 -128 127 DEPOSIT ABSOLUTE AXIS_PTS_REF KL_2FNDGSOLLIAE_ANS_X /end AXIS_DESCR
/end CHARACTERISTIC
/begin AXIS_PTS KL_2FNDSOLLIAE_ANS_X "X-Achse: istgang_egs_in" 0x1D8D1E NO_INPUT_QUANTITY SBYTE_X_INCR_DIRECT_S6_S3 0 void_int_S6_S3 10 -128 127 DEPOSIT ABSOLUTE /end AXIS_PTS
/begin CHARACTERISTIC KL_2FNDSOLLIAE_ANS_Y "KL_2FNDSOLLIAE_ANS_Y" CURVE 0x1D562C FLOAT32_IEEE_COL_DIRECT_S6_S3 0 void_fl_S6_S3 -3.40282e+038 3.40282e+038
 /begin AXIS_DESCR COM_AXIS NO_INPUT_QUANTITY void_int_S6_S3 10 -128 127 DEPOSIT ABSOLUTE AXIS_PTS_REF KL_2FNDSOLLIAE_ANS_X /end AXIS_DESCR
/end CHARACTERISTIC
/begin AXIS_PTS KL_2MGSOLLK0_ANS_X "X-Achse: m_mot_in" 0x1D5654 NO_INPUT_QUANTITY FLOAT32_IEEE_X_INCR_DIRECT_S6_S3 0 trq_fl_a_S6_S3 5 -3.40282e+038 3.40282e+038 DEPOSIT ABSOLUTE /end AXIS_PTS
/begin CHARACTERISTIC KL_2MGSOLLK0_ANS_Y "Y-Achse: Gradientoffset für die Ber. von mg_soll_k0_has_nverz im Anschleppen" CURVE 0x1D5668 FLOAT32_IEEE_COL_DIRECT_S6_S3 0 trqg_fl_c_S6_S3 -3.40282e+038 3.40282e+038
 /begin AXIS_DESCR COM_AXIS NO_INPUT_QUANTITY trq_fl_a_S6_S3 5 -3.40282e+038 3.40282e+038 DEPOSIT ABSOLUTE AXIS_PTS_REF KL_2MGSOLLK0_ANS_X /end AXIS_DESCR
/end CHARACTERISTIC
/begin AXIS_PTS KL_2MGSOLLK0_SCHUB_ANS_X "X-Achse: m_mot_in" 0x1D567C NO_INPUT_QUANTITY FLOAT32_IEEE_X_INCR_DIRECT_S6_S3 0 trq_fl_a_S6_S3 6 -3.40282e+038 3.40282e+038 DEPOSIT ABSOLUTE /end AXIS_PTS
/begin CHARACTERISTIC KL_2MGSOLLK0_SCHUB_ANS_Y "Y-Achse: Gradientoffset für die Ber. von mg_soll_k0_has_nverz im Anschleppen" CURVE 0x1D5694 FLOAT32_IEEE_COL_DIRECT_S6_S3 0 trqg_fl_c_S6_S3 -3.40282e+038 3.40282e+038
 /begin AXIS_DESCR COM_AXIS NO_INPUT_QUANTITY trq_fl_a_S6_S3 6 -3.40282e+038 3.40282e+038 DEPOSIT ABSOLUTE AXIS_PTS_REF KL_2MGSOLLK0_SCHUB_ANS_X /end AXIS_DESCR
/end CHARACTERISTIC
/begin AXIS_PTS KL_2MK0MVMSTART_ANS_X "Anteil des K0-Zielmoments beim VM Zuenden in Abhängigkeit des VM Startmoments beim VM Anschleppen" 0x1D56AC NO_INPUT_QUANTITY FLOAT32_IEEE_X_INCR_DIRECT_S6_S3 0 trq_fl_a_S6_S3 8 -3.40282e+038 3.40282e+038 DEPOSIT ABSOLUTE /end AXIS_PTS
/begin CHARACTERISTIC KL_2MK0MVMSTART_ANS_Y "Anteil des K0-Zielmoments beim VM Zuenden in Abhängigkeit des VM Startmoments beim VM Anschleppen" CURVE 0x1D56CC FLOAT32_IEEE_COL_DIRECT_S6_S3 0 trq_fl_a_S6_S3 -3.40282e+038 3.40282e+038
 /begin AXIS_DESCR COM_AXIS NO_INPUT_QUANTITY trq_fl_a_S6_S3 8 -3.40282e+038 3.40282e+038 DEPOSIT ABSOLUTE AXIS_PTS_REF KL_2MK0MVMSTART_ANS_X /end AXIS_DESCR
/end CHARACTERISTIC
/begin AXIS_PTS KL_2NDIAEEMMAXIAE_ANS_X "Momentoffset auf m_max_iae f(nd_iae-nd_soll_iae_stat)" 0x1D56EC NO_INPUT_QUANTITY FLOAT32_IEEE_X_INCR_DIRECT_S6_S3 0 n_fl_S6_S3 8 -3.40282e+038 3.40282e+038 DEPOSIT ABSOLUTE /end AXIS_PTS
/begin CHARACTERISTIC KL_2NDIAEEMMAXIAE_ANS_Y "Momentoffset auf m_max_iae f(nd_iae-nd_soll_iae_stat) im Zustand Ans." CURVE 0x1D570C FLOAT32_IEEE_COL_DIRECT_S6_S3 0 trq_fl_a_S6_S3 -3.40282e+038 3.40282e+038
 /begin AXIS_DESCR COM_AXIS NO_INPUT_QUANTITY n_fl_S6_S3 8 -3.40282e+038 3.40282e+038 DEPOSIT ABSOLUTE AXIS_PTS_REF KL_2NDIAEEMMAXIAE_ANS_X /end AXIS_DESCR
/end CHARACTERISTIC
/begin AXIS_PTS KL_3FMK0CGETRMMOT_ANS_X "X-Achse: istgang_egs_in" 0x1D8D28 NO_INPUT_QUANTITY SBYTE_X_INCR_DIRECT_S6_S3 0 void_int_S6_S3 10 -128 127 DEPOSIT ABSOLUTE /end AXIS_PTS
/begin CHARACTERISTIC KL_3FMK0CGETRMMOT_ANS_Y "Y-Acvhse: Gewichtungsfaktor K0-Moment in Phase 3" CURVE 0x1D572C FLOAT32_IEEE_COL_DIRECT_S6_S3 0 void_fl_S6_S3 -3.40282e+038 3.40282e+038
 /begin AXIS_DESCR COM_AXIS NO_INPUT_QUANTITY void_int_S6_S3 10 -128 127 DEPOSIT ABSOLUTE AXIS_PTS_REF KL_3FMK0CGETRMMOT_ANS_X /end AXIS_DESCR
/end CHARACTERISTIC
/begin AXIS_PTS KL_3FMK0CGETRMMOT_SCHUB_ANS_X "X-Achse: istgang_egs_in" 0x1D8D32 NO_INPUT_QUANTITY SBYTE_X_INCR_DIRECT_S6_S3 0 void_int_S6_S3 10 -128 127 DEPOSIT ABSOLUTE /end AXIS_PTS
/begin CHARACTERISTIC KL_3FMK0CGETRMMOT_SCHUB_ANS_Y "Gewichtungsfaktor K0-Moment in Phase 3 im Schub" CURVE 0x1D5754 FLOAT32_IEEE_COL_DIRECT_S6_S3 0 void_fl_S6_S3 -3.40282e+038 3.40282e+038
 /begin AXIS_DESCR COM_AXIS NO_INPUT_QUANTITY void_int_S6_S3 10 -128 127 DEPOSIT ABSOLUTE AXIS_PTS_REF KL_3FMK0CGETRMMOT_SCHUB_ANS_X /end AXIS_DESCR
/end CHARACTERISTIC
/begin AXIS_PTS KL_3FMK0MMOTNVM_ANS_X "X-Achse: istgang_egs_in" 0x1D8D3C NO_INPUT_QUANTITY SBYTE_X_INCR_DIRECT_S6_S3 0 void_int_S6_S3 10 -128 127 DEPOSIT ABSOLUTE /end AXIS_PTS
/begin CHARACTERISTIC KL_3FMK0MMOTNVM_ANS_Y "Gewichtungsfaktor K0-Moment in Phase 3" CURVE 0x1D577C FLOAT32_IEEE_COL_DIRECT_S6_S3 0 void_fl_S6_S3 -3.40282e+038 3.40282e+038
 /begin AXIS_DESCR COM_AXIS NO_INPUT_QUANTITY void_int_S6_S3 10 -128 127 DEPOSIT ABSOLUTE AXIS_PTS_REF KL_3FMK0MMOTNVM_ANS_X /end AXIS_DESCR
/end CHARACTERISTIC
/begin AXIS_PTS KL_3FMK0MMOTNVM_SCHUB_ANS_X "X-Achse: istgang_egs_in" 0x1D8D46 NO_INPUT_QUANTITY SBYTE_X_INCR_DIRECT_S6_S3 0 void_int_S6_S3 10 -128 127 DEPOSIT ABSOLUTE /end AXIS_PTS
/begin CHARACTERISTIC KL_3FMK0MMOTNVM_SCHUB_ANS_Y "Gewichtungsfaktor K0-Moment in Phase 3 im Schub" CURVE 0x1D57A4 FLOAT32_IEEE_COL_DIRECT_S6_S3 0 void_fl_S6_S3 -3.40282e+038 3.40282e+038
 /begin AXIS_DESCR COM_AXIS NO_INPUT_QUANTITY void_int_S6_S3 10 -128 127 DEPOSIT ABSOLUTE AXIS_PTS_REF KL_3FMK0MMOTNVM_SCHUB_ANS_X /end AXIS_DESCR
/end CHARACTERISTIC
/begin AXIS_PTS KL_3FNDGSOLLIAE_ANS_X "X-Achse: istgang_egs_in" 0x1D8D50 NO_INPUT_QUANTITY SBYTE_X_INCR_DIRECT_S6_S3 0 void_int_S6_S3 10 -128 127 DEPOSIT ABSOLUTE /end AXIS_PTS
/begin CHARACTERISTIC KL_3FNDGSOLLIAE_ANS_Y "KL_3FNDGSOLLIAE_ANS_Y" CURVE 0x1D57CC FLOAT32_IEEE_COL_DIRECT_S6_S3 0 void_fl_S6_S3 -3.40282e+038 3.40282e+038
 /begin AXIS_DESCR COM_AXIS NO_INPUT_QUANTITY void_int_S6_S3 10 -128 127 DEPOSIT ABSOLUTE AXIS_PTS_REF KL_3FNDGSOLLIAE_ANS_X /end AXIS_DESCR
/end CHARACTERISTIC
/begin AXIS_PTS KL_3FNDSOLLIAE_ANS_X "X-Achse: istgang_egs_in" 0x1D8D5A NO_INPUT_QUANTITY SBYTE_X_INCR_DIRECT_S6_S3 0 void_int_S6_S3 10 -128 127 DEPOSIT ABSOLUTE /end AXIS_PTS
/begin CHARACTERISTIC KL_3FNDSOLLIAE_ANS_Y "KL_3FNDSOLLIAE_ANS_Y" CURVE 0x1D57F4 FLOAT32_IEEE_COL_DIRECT_S6_S3 0 void_fl_S6_S3 -3.40282e+038 3.40282e+038
 /begin AXIS_DESCR COM_AXIS NO_INPUT_QUANTITY void_int_S6_S3 10 -128 127 DEPOSIT ABSOLUTE AXIS_PTS_REF KL_3FNDSOLLIAE_ANS_X /end AXIS_DESCR
/end CHARACTERISTIC
/begin AXIS_PTS KL_3MGSOLLK0_ANS_X "X-Achse: f(m_ziel_k0-m_soll_k0)" 0x1D581C NO_INPUT_QUANTITY FLOAT32_IEEE_X_INCR_DIRECT_S6_S3 0 trq_fl_a_S6_S3 5 -3.40282e+038 3.40282e+038 DEPOSIT ABSOLUTE /end AXIS_PTS
/begin CHARACTERISTIC KL_3MGSOLLK0_ANS_Y "K0-Sollgradient in der Phase VM zuenden" CURVE 0x1D5830 FLOAT32_IEEE_COL_DIRECT_S6_S3 0 trqg_fl_c_S6_S3 -3.40282e+038 3.40282e+038
 /begin AXIS_DESCR COM_AXIS NO_INPUT_QUANTITY trq_fl_a_S6_S3 5 -3.40282e+038 3.40282e+038 DEPOSIT ABSOLUTE AXIS_PTS_REF KL_3MGSOLLK0_ANS_X /end AXIS_DESCR
/end CHARACTERISTIC
/begin AXIS_PTS KL_3MGSOLLK0_SCHUB_ANS_X "X-Achse: f(m_ziel_k0-m_soll_k0)" 0x1D5844 NO_INPUT_QUANTITY FLOAT32_IEEE_X_INCR_DIRECT_S6_S3 0 trq_fl_a_S6_S3 5 -3.40282e+038 3.40282e+038 DEPOSIT ABSOLUTE /end AXIS_PTS
/begin CHARACTERISTIC KL_3MGSOLLK0_SCHUB_ANS_Y "K0-Sollgradient in der Phase VM zuenden" CURVE 0x1D5858 FLOAT32_IEEE_COL_DIRECT_S6_S3 0 trqg_fl_c_S6_S3 -3.40282e+038 3.40282e+038
 /begin AXIS_DESCR COM_AXIS NO_INPUT_QUANTITY trq_fl_a_S6_S3 5 -3.40282e+038 3.40282e+038 DEPOSIT ABSOLUTE AXIS_PTS_REF KL_3MGSOLLK0_SCHUB_ANS_X /end AXIS_DESCR
/end CHARACTERISTIC
/begin AXIS_PTS KL_3MK0MVMSTART_ANS_X "Anteil des K0-Zielmoments beim VM Zuenden in Abhängigkeit des VM Startmoments beim VM Anschleppen" 0x1D586C NO_INPUT_QUANTITY FLOAT32_IEEE_X_INCR_DIRECT_S6_S3 0 trq_fl_a_S6_S3 8 -3.40282e+038 3.40282e+038 DEPOSIT ABSOLUTE /end AXIS_PTS
/begin CHARACTERISTIC KL_3MK0MVMSTART_ANS_Y "Anteil des K0-Zielmoments beim VM Zuenden in Abhängigkeit des VM Startmoments beim VM Anschleppen" CURVE 0x1D588C FLOAT32_IEEE_COL_DIRECT_S6_S3 0 trq_fl_a_S6_S3 -3.40282e+038 3.40282e+038
 /begin AXIS_DESCR COM_AXIS NO_INPUT_QUANTITY trq_fl_a_S6_S3 8 -3.40282e+038 3.40282e+038 DEPOSIT ABSOLUTE AXIS_PTS_REF KL_3MK0MVMSTART_ANS_X /end AXIS_DESCR
/end CHARACTERISTIC
/begin AXIS_PTS KL_3NDIAEEMMAXIAE_ANS_X "Momentoffset auf m_max_iae f(nd_iae-nd_soll_iae_stat)" 0x1D58AC NO_INPUT_QUANTITY FLOAT32_IEEE_X_INCR_DIRECT_S6_S3 0 n_fl_S6_S3 8 -3.40282e+038 3.40282e+038 DEPOSIT ABSOLUTE /end AXIS_PTS
/begin CHARACTERISTIC KL_3NDIAEEMMAXIAE_ANS_Y "Momentoffset auf m_max_iae f(nd_iae-nd_soll_iae_stat) im Zustand Zuen." CURVE 0x1D58CC FLOAT32_IEEE_COL_DIRECT_S6_S3 0 trq_fl_a_S6_S3 -3.40282e+038 3.40282e+038
 /begin AXIS_DESCR COM_AXIS NO_INPUT_QUANTITY n_fl_S6_S3 8 -3.40282e+038 3.40282e+038 DEPOSIT ABSOLUTE AXIS_PTS_REF KL_3NDIAEEMMAXIAE_ANS_X /end AXIS_DESCR
/end CHARACTERISTIC
/begin AXIS_PTS KL_3TMINABLVAR_ANS_X "X-Achse: z_ablaufvariante_has_stg" 0x1D5D24 NO_INPUT_QUANTITY UBYTE_X_INCR_DIRECT_S6_S3 0 void_int_S6_S3 8 0 99 DEPOSIT ABSOLUTE /end AXIS_PTS
/begin CHARACTERISTIC KL_3TMINABLVAR_ANS_Y "Mintimer im Zustand Zuenden = f(z_ablaufvariante_has_stg)" CURVE 0x1D58EC FLOAT32_IEEE_COL_DIRECT_S6_S3 0 t_fl_S6_S3 -3.40282e+038 3.40282e+038
 /begin AXIS_DESCR COM_AXIS NO_INPUT_QUANTITY void_int_S6_S3 8 0 99 DEPOSIT ABSOLUTE AXIS_PTS_REF KL_3TMINABLVAR_ANS_X /end AXIS_DESCR
/end CHARACTERISTIC
/begin AXIS_PTS KL_4FMGK0ISTGANG_ANS_X "X-Achse: istgang_egs_in" 0x1D8D64 NO_INPUT_QUANTITY SBYTE_X_INCR_DIRECT_S6_S3 0 void_int_S6_S3 10 -128 127 DEPOSIT ABSOLUTE /end AXIS_PTS
/begin CHARACTERISTIC KL_4FMGK0ISTGANG_ANS_Y "Gewichtungsfaktor K0-Momentgradient in Phase 104" CURVE 0x1D590C FLOAT32_IEEE_COL_DIRECT_S6_S3 0 void_fl_S6_S3 -3.40282e+038 3.40282e+038
 /begin AXIS_DESCR COM_AXIS NO_INPUT_QUANTITY void_int_S6_S3 10 -128 127 DEPOSIT ABSOLUTE AXIS_PTS_REF KL_4FMGK0ISTGANG_ANS_X /end AXIS_DESCR
/end CHARACTERISTIC
/begin AXIS_PTS KL_4FNDGSOLLIAE_ANS_X "X-Achse: istgang_egs_in" 0x1D8D6E NO_INPUT_QUANTITY SBYTE_X_INCR_DIRECT_S6_S3 0 void_int_S6_S3 10 -128 127 DEPOSIT ABSOLUTE /end AXIS_PTS
/begin CHARACTERISTIC KL_4FNDGSOLLIAE_ANS_Y "KL_4FNDGSOLLIAE_ANS_Y" CURVE 0x1D5934 FLOAT32_IEEE_COL_DIRECT_S6_S3 0 void_fl_S6_S3 -3.40282e+038 3.40282e+038
 /begin AXIS_DESCR COM_AXIS NO_INPUT_QUANTITY void_int_S6_S3 10 -128 127 DEPOSIT ABSOLUTE AXIS_PTS_REF KL_4FNDGSOLLIAE_ANS_X /end AXIS_DESCR
/end CHARACTERISTIC
/begin AXIS_PTS KL_4FNDSOLLIAE_ANS_X "X-Achse: istgang_egs_in" 0x1D8D78 NO_INPUT_QUANTITY SBYTE_X_INCR_DIRECT_S6_S3 0 void_int_S6_S3 10 -128 127 DEPOSIT ABSOLUTE /end AXIS_PTS
/begin CHARACTERISTIC KL_4FNDSOLLIAE_ANS_Y "KL_4FNDSOLLIAE_ANS_Y" CURVE 0x1D595C FLOAT32_IEEE_COL_DIRECT_S6_S3 0 void_fl_S6_S3 -3.40282e+038 3.40282e+038
 /begin AXIS_DESCR COM_AXIS NO_INPUT_QUANTITY void_int_S6_S3 10 -128 127 DEPOSIT ABSOLUTE AXIS_PTS_REF KL_4FNDSOLLIAE_ANS_X /end AXIS_DESCR
/end CHARACTERISTIC
/begin AXIS_PTS KL_4NDIAEEMMAXIAE_ANS_X "Momentoffset auf m_max_iae f(nd_iae-nd_soll_iae_stat)" 0x1D5984 NO_INPUT_QUANTITY FLOAT32_IEEE_X_INCR_DIRECT_S6_S3 0 n_fl_S6_S3 8 -3.40282e+038 3.40282e+038 DEPOSIT ABSOLUTE /end AXIS_PTS
/begin CHARACTERISTIC KL_4NDIAEEMMAXIAE_ANS_Y "Momentoffset auf m_max_iae f(nd_iae-nd_soll_iae_stat) im Zustand Syn." CURVE 0x1D59A4 FLOAT32_IEEE_COL_DIRECT_S6_S3 0 trq_fl_a_S6_S3 -3.40282e+038 3.40282e+038
 /begin AXIS_DESCR COM_AXIS NO_INPUT_QUANTITY n_fl_S6_S3 8 -3.40282e+038 3.40282e+038 DEPOSIT ABSOLUTE AXIS_PTS_REF KL_4NDIAEEMMAXIAE_ANS_X /end AXIS_DESCR
/end CHARACTERISTIC
/begin AXIS_PTS KL_5FNDGSOLLIAE_ANS_X "X-Achse: istgang_egs_in" 0x1D8D82 NO_INPUT_QUANTITY SBYTE_X_INCR_DIRECT_S6_S3 0 void_int_S6_S3 10 -128 127 DEPOSIT ABSOLUTE /end AXIS_PTS
/begin CHARACTERISTIC KL_5FNDGSOLLIAE_ANS_Y "KL_5FNDGSOLLIAE_ANS_Y" CURVE 0x1D59C4 FLOAT32_IEEE_COL_DIRECT_S6_S3 0 ng_fl_S6_S3 -3.40282e+038 3.40282e+038
 /begin AXIS_DESCR COM_AXIS NO_INPUT_QUANTITY void_int_S6_S3 10 -128 127 DEPOSIT ABSOLUTE AXIS_PTS_REF KL_5FNDGSOLLIAE_ANS_X /end AXIS_DESCR
/end CHARACTERISTIC
/begin AXIS_PTS KL_5FNDSOLLIAE_ANS_X "X-Achse: istgang_egs_in" 0x1D8D8C NO_INPUT_QUANTITY SBYTE_X_INCR_DIRECT_S6_S3 0 void_int_S6_S3 10 -128 127 DEPOSIT ABSOLUTE /end AXIS_PTS
/begin CHARACTERISTIC KL_5FNDSOLLIAE_ANS_Y "KL_5FNDSOLLIAE_ANS_Y" CURVE 0x1D59EC FLOAT32_IEEE_COL_DIRECT_S6_S3 0 void_fl_S6_S3 -3.40282e+038 3.40282e+038
 /begin AXIS_DESCR COM_AXIS NO_INPUT_QUANTITY void_int_S6_S3 10 -128 127 DEPOSIT ABSOLUTE AXIS_PTS_REF KL_5FNDSOLLIAE_ANS_X /end AXIS_DESCR
/end CHARACTERISTIC
/begin AXIS_PTS KL_MGK0MODMAX_SCL_ANS_X "Maximaler Gradient des modifizierten K0 Moments der HAS in Abhängigkeit des VM Zielmoments im Zustand K0-Schliessen beim Schleppstart" 0x1D5A34 NO_INPUT_QUANTITY FLOAT32_IEEE_X_INCR_DIRECT_S6_S3 0 trq_fl_a_S6_S3 6 -3.40282e+038 3.40282e+038 DEPOSIT ABSOLUTE /end AXIS_PTS
/begin CHARACTERISTIC KL_MGK0MODMAX_SCL_ANS_Y "Maximaler Gradient des modifizierten K0 Moments der HAS in Abhängigkeit des VM Zielmoments im Zustand K0-Schliessen beim Schleppstart" CURVE 0x1D5A4C FLOAT32_IEEE_COL_DIRECT_S6_S3 0 trqg_fl_c_S6_S3 -3.40282e+038 3.40282e+038
 /begin AXIS_DESCR COM_AXIS NO_INPUT_QUANTITY trq_fl_a_S6_S3 6 -3.40282e+038 3.40282e+038 DEPOSIT ABSOLUTE AXIS_PTS_REF KL_MGK0MODMAX_SCL_ANS_X /end AXIS_DESCR
/end CHARACTERISTIC
/begin AXIS_PTS KL_MGK0MODMAX_SYN_ANS_X "Maximaler Gradient des modifizierten K0 Moments der HAS in Abhängigkeit des Gradienten des K0 Sollmoments im Zustand K0-Synchronisieren beim Schleppstart" 0x1D5A64 NO_INPUT_QUANTITY FLOAT32_IEEE_X_INCR_DIRECT_S6_S3 0 trqg_fl_c_S6_S3 6 -3.40282e+038 3.40282e+038 DEPOSIT ABSOLUTE /end AXIS_PTS
/begin CHARACTERISTIC KL_MGK0MODMAX_SYN_ANS_Y "Maximaler Gradient des modifizierten K0 Moments der HAS in Abhängigkeit des Gradienten des K0 Sollmoments im Zustand K0-Synchronisieren beim Schleppstart" CURVE 0x1D5A7C FLOAT32_IEEE_COL_DIRECT_S6_S3 0 trqg_fl_c_S6_S3 -3.40282e+038 3.40282e+038
 /begin AXIS_DESCR COM_AXIS NO_INPUT_QUANTITY trqg_fl_c_S6_S3 6 -3.40282e+038 3.40282e+038 DEPOSIT ABSOLUTE AXIS_PTS_REF KL_MGK0MODMAX_SYN_ANS_X /end AXIS_DESCR
/end CHARACTERISTIC
/begin AXIS_PTS KL_MGK0MODMIN_SYN_ANS_X "Minimaler Gradient des modifizierten K0 Moments der HAS in Abhängigkeit des Gradienten des K0 Sollmoments im Zustand K0-Synchronisieren beim Schleppstart" 0x1D5A94 NO_INPUT_QUANTITY FLOAT32_IEEE_X_INCR_DIRECT_S6_S3 0 trqg_fl_c_S6_S3 6 -3.40282e+038 3.40282e+038 DEPOSIT ABSOLUTE /end AXIS_PTS
/begin CHARACTERISTIC KL_MGK0MODMIN_SYN_ANS_Y "Minimaler Gradient des modifizierten K0 Moments der HAS in Abhängigkeit des Gradienten des K0 Sollmoments im Zustand K0-Synchronisieren beim Schleppstart" CURVE 0x1D5AAC FLOAT32_IEEE_COL_DIRECT_S6_S3 0 trqg_fl_c_S6_S3 -3.40282e+038 3.40282e+038
 /begin AXIS_DESCR COM_AXIS NO_INPUT_QUANTITY trqg_fl_c_S6_S3 6 -3.40282e+038 3.40282e+038 DEPOSIT ABSOLUTE AXIS_PTS_REF KL_MGK0MODMIN_SYN_ANS_X /end AXIS_DESCR
/end CHARACTERISTIC
/begin AXIS_PTS KL_NGIAEANF_ANS_X "X-Achse: (n_motanfahr_gef_iae_in - n_soll_em_has)" 0x1D5AEC NO_INPUT_QUANTITY FLOAT32_IEEE_X_INCR_DIRECT_S6_S3 0 n_fl_S6_S3 10 -3500 3500 DEPOSIT ABSOLUTE /end AXIS_PTS
/begin CHARACTERISTIC KL_NGIAEANF_ANS_Y "Gradientenbegrenzer für Übergang n_soll_em aus Anfahrdrehzahl IAE oder HAS intern" CURVE 0x1D5B14 FLOAT32_IEEE_COL_DIRECT_S6_S3 0 ng_fl_S6_S3 -3.40282e+038 3.40282e+038
 /begin AXIS_DESCR COM_AXIS NO_INPUT_QUANTITY n_fl_S6_S3 10 -3500 3500 DEPOSIT ABSOLUTE AXIS_PTS_REF KL_NGIAEANF_ANS_X /end AXIS_DESCR
/end CHARACTERISTIC
/begin AXIS_PTS KL_NSOLLVMKRAFTFLUSS_ANS_X "X-Achse: status_kraftfluss_egs_in" 0x1D7FDA NO_INPUT_QUANTITY UBYTE_X_INCR_DIRECT_S6_S3 0 void_int_S6_S3 7 0 255 DEPOSIT ABSOLUTE /end AXIS_PTS
/begin CHARACTERISTIC KL_NSOLLVMKRAFTFLUSS_ANS_Y "Bestimmung der Umschaltung von n_sec_iae_ziel oder n_em für Bestimmung n_soll_vm im Zustand St_Schaltung_aktiv" CURVE 0x1D7FE1 UBYTE_COL_DIRECT_S6_S3 0 void_int_S6_S3 0 255
 /begin AXIS_DESCR COM_AXIS NO_INPUT_QUANTITY void_int_S6_S3 7 0 255 DEPOSIT ABSOLUTE AXIS_PTS_REF KL_NSOLLVMKRAFTFLUSS_ANS_X /end AXIS_DESCR
/end CHARACTERISTIC
/begin AXIS_PTS KL_NZIELEMKRAFTFLUSS_ANS_X "X-Achse: status_kraftfluss_egs_in" 0x1D7FE8 NO_INPUT_QUANTITY UBYTE_X_INCR_DIRECT_S6_S3 0 void_int_S6_S3 7 0 255 DEPOSIT ABSOLUTE /end AXIS_PTS
/begin CHARACTERISTIC KL_NZIELEMKRAFTFLUSS_ANS_Y "In Abhaengigkeit von status_kraftfluss_egs_in kann n_ab_egs_in mal i_istgang_egs_in bei der Berechnung von n_soll_em_has beruecksichtigt werden" CURVE 0x1D7FEF UBYTE_COL_DIRECT_S6_S3 0 void_int_S6_S3 0 255
 /begin AXIS_DESCR COM_AXIS NO_INPUT_QUANTITY void_int_S6_S3 7 0 255 DEPOSIT ABSOLUTE AXIS_PTS_REF KL_NZIELEMKRAFTFLUSS_ANS_X /end AXIS_DESCR
/end CHARACTERISTIC
/begin AXIS_PTS KL_ZABLVARSTATUSPSYSEM_ANS_X "X-Achse: z_ablaufvariante_has_stg" 0x1D5D34 z_ablaufvariante_has_stg UBYTE_X_INCR_DIRECT_S6_S3 0 void_int_S6_S3 8 0 10 DEPOSIT ABSOLUTE /end AXIS_PTS
/begin CHARACTERISTIC KL_ZABLVARSTATUSPSYSEM_ANS_Y "Beeinflussung status_psys_em_has_sbe = f(z_ablaufvariante_has_stg)" CURVE 0x1D5D3C UBYTE_COL_DIRECT_S6_S3 0 void_int_S6_S3 0 255
 /begin AXIS_DESCR COM_AXIS z_ablaufvariante_has_stg void_int_S6_S3 8 0 10 DEPOSIT ABSOLUTE AXIS_PTS_REF KL_ZABLVARSTATUSPSYSEM_ANS_X /end AXIS_DESCR
/end CHARACTERISTIC
/begin CHARACTERISTIC K_0MSTOERKPL_ANS "Gewichtungsfaktor auf das Kupplungsmoment zur Berechnung des Störmoments im Zustand SAK" VALUE 0x1D1978 FLOAT32_IEEE_COL_DIRECT_S6_S3 0 void_fl_S6_S3 -3.40282e+038 3.40282e+038 /end CHARACTERISTIC
/begin CHARACTERISTIC K_10MSTOERKPL_ANS "Gewichtungsfaktor auf das Kupplungsmoment zur Berechnung des Störmoments im Zustand SLST Abbr." VALUE 0x1D197C FLOAT32_IEEE_COL_DIRECT_S6_S3 0 void_fl_S6_S3 0 100 /end CHARACTERISTIC
/begin CHARACTERISTIC K_1MSTOERKPL_ANS "Gewichtungsfaktor auf das Kupplungsmoment zur Berechnung des Störmoments im Zustand KON" VALUE 0x1D1980 FLOAT32_IEEE_COL_DIRECT_S6_S3 0 void_fl_S6_S3 -3.40282e+038 3.40282e+038 /end CHARACTERISTIC
/begin CHARACTERISTIC K_2MSTOERKPL_ANS "Gewichtungsfaktor auf das Kupplungsmoment zur Berechnung des Störmoments" VALUE 0x1D1984 FLOAT32_IEEE_COL_DIRECT_S6_S3 0 void_fl_S6_S3 -3.40282e+038 3.40282e+038 /end CHARACTERISTIC
/begin CHARACTERISTIC K_3MSTOERKPL_ANS "Gewichtungsfaktor auf das Kupplungsmoment zur Berechnung des Störmoments" VALUE 0x1D1988 FLOAT32_IEEE_COL_DIRECT_S6_S3 0 void_fl_S6_S3 -3.40282e+038 3.40282e+038 /end CHARACTERISTIC
/begin CHARACTERISTIC K_4MSTOERKPL_ANS "Faktor auf das Störmoment der Kupplung" VALUE 0x1D198C FLOAT32_IEEE_COL_DIRECT_S6_S3 0 void_fl_S6_S3 -3.40282e+038 3.40282e+038 /end CHARACTERISTIC
/begin CHARACTERISTIC K_SVH_RESET_KON_ANS "Bedingtes Rücksetzen einer Schaltverhinderung während VM-Schleppstart im Zustand Konditionieren (255=alle Arten von Schaltugne zurücksetzen, 0= keine Schltg. zurücksetzen),Bit Codierung siehe Handbuch" VALUE 0x1D7CF7 UBYTE_COL_DIRECT_S6_S3 0 void_int_S6_S3 0 255 /end CHARACTERISTIC
/begin CHARACTERISTIC K_SVH_RESET_NSRS_SAK_ANS "Bedingtes Rücksetzen einer Schaltverhinderung während VM-Schleppstart im Zustand SAK, ausser SRS (255=alle Arten von Schaltugen zurücksetzen, 0= keine Schltg. zurücksetzen) Bit Codierung siehe Handbuch" VALUE 0x1D7CF8 UBYTE_COL_DIRECT_S6_S3 0 void_int_S6_S3 0 255 /end CHARACTERISTIC
/begin CHARACTERISTIC K_SVH_RESET_SAK_ANS "Bedingtes Rücksetzen einer Schaltverhinderung während VM-Schleppstart im Zustand Schaltung aktiv (255=alle Arten von Schaltugne zurücksetzen, 0= keine Schltg. zurücksetzen) Bit Codierung siehe Handbuch" VALUE 0x1D7CF9 UBYTE_COL_DIRECT_S6_S3 0 void_int_S6_S3 0 255 /end CHARACTERISTIC
/begin CHARACTERISTIC K_SVH_RESET_SCL_ANS "Bedingtes Rücksetzen einer Schaltverhinderung während VM-Schleppstart im Zustand K0 Schliessen (255=alle Arten von Schaltugne zurücksetzen, 0= keine Schltg. zurücksetzen) Bit Codierung siehe Handbuch" VALUE 0x1D7CFA UBYTE_COL_DIRECT_S6_S3 0 void_int_S6_S3 0 255 /end CHARACTERISTIC
/begin CHARACTERISTIC K_SVH_RESET_SRS_SAK_ANS "Bedingtes Rücksetzen einer Schaltverhinderung während VM-Schleppstart im Zustand SAK, für SRS (255=alle Arten von Schaltugen zurücksetzen, 0= keine Schltg. zurücksetzen) Bit Codierung siehe Handbuch" VALUE 0x1D7CFB UBYTE_COL_DIRECT_S6_S3 0 void_int_S6_S3 0 255 /end CHARACTERISTIC
/begin CHARACTERISTIC K_SVH_RESET_SRT_ANS "Bedingtes Rücksetzen einer Schaltverhinderung während VM-Schleppstart im Zustand Start (255=alle Arten von Schaltugne zurücksetzen, 0= keine Schltg. zurücksetzen) Bit Codierung siehe Handbuch" VALUE 0x1D7CFC UBYTE_COL_DIRECT_S6_S3 0 void_int_S6_S3 0 255 /end CHARACTERISTIC
/begin CHARACTERISTIC K_SVH_RESET_SST_ANS "Bedingtes Rücksetzen einer Schaltverhinderung während VM-Schleppstart im Zustand Anschleppen (255=alle Arten von Schaltugne zurücksetzen, 0= keine Schltg. zurücksetzen) Bit Codierung siehe Handbuch" VALUE 0x1D7CFD UBYTE_COL_DIRECT_S6_S3 0 void_int_S6_S3 0 255 /end CHARACTERISTIC
/begin CHARACTERISTIC K_SVH_RESET_SYN_ANS "Bedingtes Rücksetzen einer Schaltverhinderung während VM-Schleppstart im Zustand Synchronisieren (255=alle Arten von Schaltugne zurücksetzen, 0= keine Schltg. zurücksetzen) Bit Codierung siehe Handbuch" VALUE 0x1D7CFE UBYTE_COL_DIRECT_S6_S3 0 void_int_S6_S3 0 255 /end CHARACTERISTIC
/begin CHARACTERISTIC K_SVH_RESET_ZND_ANS "Bedingtes Rücksetzen einer Schaltverhinderung während VM-Schleppstart im Zustand Zuenden (255=alle Arten von Schaltugne zurücksetzen, 0= keine Schltg. zurücksetzen) Bit Codierung siehe Handbuch" VALUE 0x1D7CFF UBYTE_COL_DIRECT_S6_S3 0 void_int_S6_S3 0 255 /end CHARACTERISTIC
/begin CHARACTERISTIC MG_10SOLLK0_ANS "Gradient für m_soll_k0_has im Zustand SLST_Abbruch" VALUE 0x1D1990 FLOAT32_IEEE_COL_DIRECT_S6_S3 0 trqg_fl_c_S6_S3 0 10000 /end CHARACTERISTIC
/begin CHARACTERISTIC MG_1MOMAXIAE1_ANS "Drehmomentgradient 1 (Phase 1) zur Beeinflussung des IAE-Begrenzungsmoment" VALUE 0x1D1994 FLOAT32_IEEE_COL_DIRECT_S6_S3 0 trqg_fl_c_S6_S3 -3.40282e+038 3.40282e+038 /end CHARACTERISTIC
/begin CHARACTERISTIC MG_1MOMAXIAE2_ANS "Drehmomentgradient 2 (Phase 1) zur Beeinflussung des IAE-Begrenzungsmoment" VALUE 0x1D1998 FLOAT32_IEEE_COL_DIRECT_S6_S3 0 trqg_fl_c_S6_S3 -3.40282e+038 3.40282e+038 /end CHARACTERISTIC
/begin CHARACTERISTIC MG_2K0OFFSET_ANS "Momentengradient für die Notanschlepprampe K0" VALUE 0x1D199C FLOAT32_IEEE_COL_DIRECT_S6_S3 0 trqg_fl_c_S6_S3 -10000 10000 /end CHARACTERISTIC
/begin CHARACTERISTIC MG_2MOMAXIAE1_ANS "Drehmomentgradient 1 (Phase 2) zur Beeinflussung des IAE-Begrenzungsmoment" VALUE 0x1D19A0 FLOAT32_IEEE_COL_DIRECT_S6_S3 0 trqg_fl_c_S6_S3 -3.40282e+038 3.40282e+038 /end CHARACTERISTIC
/begin CHARACTERISTIC MG_2MOMAXIAE2_ANS "Drehmomentgradient 2 (Phase 2) zur Beeinflussung des IAE-Begrenzungsmoment" VALUE 0x1D19A4 FLOAT32_IEEE_COL_DIRECT_S6_S3 0 trqg_fl_c_S6_S3 -3.40282e+038 3.40282e+038 /end CHARACTERISTIC
/begin CHARACTERISTIC MG_3MOMAXIAE1_ANS "Drehmomentgradient 1 (Phase 3) zur Beeinflussung des IAE-Begrenzungsmoment" VALUE 0x1D19A8 FLOAT32_IEEE_COL_DIRECT_S6_S3 0 trqg_fl_c_S6_S3 -3.40282e+038 3.40282e+038 /end CHARACTERISTIC
/begin CHARACTERISTIC MG_3MOMAXIAE2_ANS "Drehmomentgradient 2 (Phase 3) zur Beeinflussung des IAE-Begrenzungsmoment" VALUE 0x1D19AC FLOAT32_IEEE_COL_DIRECT_S6_S3 0 trqg_fl_c_S6_S3 -3.40282e+038 3.40282e+038 /end CHARACTERISTIC
/begin CHARACTERISTIC MG_4MOMAXIAE1_ANS "Drehmomentgradient 1 (Phase 4) zur Beeinflussung des IAE-Begrenzungsmoment" VALUE 0x1D19B0 FLOAT32_IEEE_COL_DIRECT_S6_S3 0 trqg_fl_c_S6_S3 -3.40282e+038 3.40282e+038 /end CHARACTERISTIC
/begin CHARACTERISTIC MG_4MOMAXIAE2_ANS "Drehmomentgradient 2 (Phase 4) zur Beeinflussung des IAE-Begrenzungsmoment" VALUE 0x1D19B4 FLOAT32_IEEE_COL_DIRECT_S6_S3 0 trqg_fl_c_S6_S3 -3.40282e+038 3.40282e+038 /end CHARACTERISTIC
/begin CHARACTERISTIC MG_5MOMAXIAE_ANS "Gradient für maximales IAE Offsetmoment" VALUE 0x1D19B8 FLOAT32_IEEE_COL_DIRECT_S6_S3 0 trqg_fl_c_S6_S3 -3.40282e+038 3.40282e+038 /end CHARACTERISTIC
/begin CHARACTERISTIC MG_K0SOLL1_NST_NOS "Gradient der ersten Momentenrampe des K0-Sollmoments (vor Umschaltung) im Zustand Notstarten" VALUE 0x1D18F4 FLOAT32_IEEE_COL_DIRECT_S6_S3 0 trqg_fl_c_S6_S3 0 5000 /end CHARACTERISTIC
/begin CHARACTERISTIC MG_K0SOLL2_NST_NOS "Gradient der zweiten Momentenrampe des K0-Sollmoments (nach Umschaltung) im Zustand Notstarten" VALUE 0x1D18F8 FLOAT32_IEEE_COL_DIRECT_S6_S3 0 trqg_fl_c_S6_S3 0 5000 /end CHARACTERISTIC
/begin CHARACTERISTIC MO_14MEM_ANS "Drehmoment-Offset auf das max. dynamische EM-Moment" VALUE 0x1D19BC FLOAT32_IEEE_COL_DIRECT_S6_S3 0 trq_fl_a_S6_S3 0 1000 /end CHARACTERISTIC
/begin CHARACTERISTIC MO_2K0ABSTELLPOSUNGUELTIG_ANS "Momentoffset der K0 Vorgabe für Abstellpos. ungültig" VALUE 0x1D19C0 FLOAT32_IEEE_COL_DIRECT_S6_S3 0 trq_fl_a_S6_S3 -1000 1000 /end CHARACTERISTIC
/begin CHARACTERISTIC MO_2SOLLKPL_ANS "Momentenoffset fuer die Notanschlepprampe K0" VALUE 0x1D19C4 FLOAT32_IEEE_COL_DIRECT_S6_S3 0 trq_fl_a_S6_S3 0 1000 /end CHARACTERISTIC
/begin CHARACTERISTIC MO_SOLLK0MPS_KON_NOS "Bei Modifikation des Pumpendruckstatus (MPS): Momentenoffset auf das K0-Sollmoment während Befüllen der K0 im Zustand Konditionieren " VALUE 0x1D1900 FLOAT32_IEEE_COL_DIRECT_S6_S3 0 trq_fl_a_S6_S3 0 1000 /end CHARACTERISTIC
/begin CHARACTERISTIC MS23_MZIELPHYSK0 "Schwellwert für Aktivierung Hysteresekompensation" VALUE 0x1D19D0 FLOAT32_IEEE_COL_DIRECT_S6_S3 0 trq_fl_a_S6_S3 -3.40282e+038 3.40282e+038 /end CHARACTERISTIC
/begin CHARACTERISTIC MS_14ZMSOLLEMAKTIV_ANS "Momentenschwelle in der Phase Konditionieren bis K0 synchronisieren für die Aktivierung z_m_soll_em_has (Eingagnsgrösse m_soll_em_has)" VALUE 0x1D19D8 FLOAT32_IEEE_COL_DIRECT_S6_S3 0 trq_fl_a_S6_S3 0 1000 /end CHARACTERISTIC
/begin CHARACTERISTIC MS_2K0STATUSABL_ANS "Momentschwelle K0 zur Umschaltung status_ablauf_has in 102" VALUE 0x1D19DC FLOAT32_IEEE_COL_DIRECT_S6_S3 0 trq_fl_a_S6_S3 0 1000 /end CHARACTERISTIC
/begin CHARACTERISTIC MS_2MINVMMGSOLLK0_ANS "Minimalwert des Betrags des VM Minimalmoments zur Auswahl der K0 Sollgradienten beim Anschleppen" VALUE 0x1D19E0 FLOAT32_IEEE_COL_DIRECT_S6_S3 0 trq_fl_a_S6_S3 0 1000 /end CHARACTERISTIC
/begin CHARACTERISTIC MS_35ABEGSMMMINVMLLEMHAS_ANS "Abtriebsdrehzahlschwelle für negative Grenze Drehzahlregler EM" VALUE 0x1D19E4 FLOAT32_IEEE_COL_DIRECT_S6_S3 0 trq_fl_a_S6_S3 -3.40282e+038 3.40282e+038 /end CHARACTERISTIC
/begin CHARACTERISTIC MS_MMAXIAEINAKTIV_ANS "Maxmoment der IAE" VALUE 0x1D19E8 FLOAT32_IEEE_COL_DIRECT_S6_S3 0 trq_fl_a_S6_S3 -3.40282e+038 3.40282e+038 /end CHARACTERISTIC
/begin CHARACTERISTIC MS_MVM_SAK_ANS "Momentschwelle des Verbrenners für Aktivierung CoM in SAK" VALUE 0x1D19EC FLOAT32_IEEE_COL_DIRECT_S6_S3 0 trq_fl_a_S6_S3 -100 1000 /end CHARACTERISTIC
/begin CHARACTERISTIC MS_RESEM_ANS_ANS "Minmalwert für m_soll_res_em im Zustand ANS" VALUE 0x1D19F0 FLOAT32_IEEE_COL_DIRECT_S6_S3 0 trq_fl_a_S6_S3 0 200 /end CHARACTERISTIC
/begin CHARACTERISTIC MS_RESEM_KON_ANS "Minmalwert für m_soll_res_em im Zustand KON" VALUE 0x1D19F4 FLOAT32_IEEE_COL_DIRECT_S6_S3 0 trq_fl_a_S6_S3 0 200 /end CHARACTERISTIC
/begin CHARACTERISTIC MS_RESEM_SAK_ANS "Minmalwert für m_soll_res_em im Zustand SAK" VALUE 0x1D19F8 FLOAT32_IEEE_COL_DIRECT_S6_S3 0 trq_fl_a_S6_S3 0 200 /end CHARACTERISTIC
/begin CHARACTERISTIC MS_RESEM_SRT_ANS "Minmalwert für m_soll_res_em im Zustand SRT" VALUE 0x1D19FC FLOAT32_IEEE_COL_DIRECT_S6_S3 0 trq_fl_a_S6_S3 0 200 /end CHARACTERISTIC
/begin CHARACTERISTIC M_03MAXEMHAS_ANS "Maximales Moment EM aus HAS" VALUE 0x1D1A00 FLOAT32_IEEE_COL_DIRECT_S6_S3 0 trq_fl_a_S6_S3 -3.40282e+038 3.40282e+038 /end CHARACTERISTIC
/begin CHARACTERISTIC M_03MINEMHAS_ANS "Minimales Moment EM aus HAS" VALUE 0x1D1A04 FLOAT32_IEEE_COL_DIRECT_S6_S3 0 trq_fl_a_S6_S3 -3.40282e+038 3.40282e+038 /end CHARACTERISTIC
/begin CHARACTERISTIC M_35MINEMVMLLHAS_ANS "Minimale Moment EM bei Leerlaufregelung" VALUE 0x1D1A08 FLOAT32_IEEE_COL_DIRECT_S6_S3 0 trq_fl_a_S6_S3 -3.40282e+038 3.40282e+038 /end CHARACTERISTIC
/begin CHARACTERISTIC M_45MAXEMHAS_ANS "Maximales Moment EM aus HAS" VALUE 0x1D1A0C FLOAT32_IEEE_COL_DIRECT_S6_S3 0 trq_fl_a_S6_S3 -3.40282e+038 3.40282e+038 /end CHARACTERISTIC
/begin CHARACTERISTIC M_45MINEMHAS_ANS "Minimales Moment EM aus HAS" VALUE 0x1D1A10 FLOAT32_IEEE_COL_DIRECT_S6_S3 0 trq_fl_a_S6_S3 -3.40282e+038 3.40282e+038 /end CHARACTERISTIC
/begin CHARACTERISTIC M_SOLLK0INIMPS_NST_NOS "Startwert des K0-Sollmoments bei Beginn der Momentenvorgabe an die K0 (Gradientenbegrenzer wird darauf initialisiert) im Zustand Notstarten" VALUE 0x1D1908 FLOAT32_IEEE_COL_DIRECT_S6_S3 0 trq_fl_a_S6_S3 0 1000 /end CHARACTERISTIC
/begin CHARACTERISTIC M_SOLLK0INI_NST_NOS "Startwert des K0-Sollmoments bei Beginn der Momentenvorgabe an die K0 (Gradientenbegrenzer wird darauf initialisiert) im Zustand Notstarten" VALUE 0x1D190C FLOAT32_IEEE_COL_DIRECT_S6_S3 0 trq_fl_a_S6_S3 0 1000 /end CHARACTERISTIC
/begin CHARACTERISTIC M_SOLLK0ZIEL1_NOS "Zielwert des K0-Sollmoments bis Umschaltzeitpunkt" VALUE 0x1D1910 FLOAT32_IEEE_COL_DIRECT_S6_S3 0 trq_fl_a_S6_S3 0 1000 /end CHARACTERISTIC
/begin CHARACTERISTIC M_SOLLK0ZIEL2_NOS "Zielwert des K0-Sollmoments ab Umschaltzeitpunkt" VALUE 0x1D1914 FLOAT32_IEEE_COL_DIRECT_S6_S3 0 trq_fl_a_S6_S3 0 1000 /end CHARACTERISTIC
/begin CHARACTERISTIC NDG_K0_SAK_ANS "Differenzdrehzahlgradientschwelle der K0 für Erkennung CoM in SAK" VALUE 0x1D1A14 FLOAT32_IEEE_COL_DIRECT_S6_S3 0 ng_fl_S6_S3 -3.40282e+038 3.40282e+038 /end CHARACTERISTIC
/begin CHARACTERISTIC NDS_15NEMNVM_ANS "Drehzahldifferenzschwelle Umchalten für Flipflop" VALUE 0x1D1A18 FLOAT32_IEEE_COL_DIRECT_S6_S3 0 n_fl_S6_S3 -3.40282e+038 3.40282e+038 /end CHARACTERISTIC
/begin CHARACTERISTIC NDS_K0_NST_NOS "K0-Differenzdrehzahlschwelle als Übergangsbedingung vom Zustand Notstarten in den Zustand K0-Schließen" VALUE 0x1D1918 FLOAT32_IEEE_COL_DIRECT_S6_S3 0 n_fl_S6_S3 0 500 /end CHARACTERISTIC
/begin CHARACTERISTIC NDS_K0_SAK_ANS "Differenzdrehzahlschwelle der K0 für Erkennung CoM in SAK" VALUE 0x1D1A28 FLOAT32_IEEE_COL_DIRECT_S6_S3 0 n_fl_S6_S3 -3.40282e+038 3.40282e+038 /end CHARACTERISTIC
/begin CHARACTERISTIC ND_IAEANFAHRENTK_ANS "Differenzdrehzahlschwelle ab der im Konditionieren (IAE Anfahren) ein anderes K0 Moment vorgegeben wird" VALUE 0x1D1A34 FLOAT32_IEEE_COL_DIRECT_S6_S3 0 n_fl_S6_S3 0 10000 /end CHARACTERISTIC
/begin CHARACTERISTIC NG_15NSOLLEMNSOLLLLVM_ANS "Drehzahlgradient für n_soll_em < n_soll_ll_vm" VALUE 0x1D1A38 FLOAT32_IEEE_COL_DIRECT_S6_S3 0 ng_fl_S6_S3 -3.40282e+038 3.40282e+038 /end CHARACTERISTIC
/begin CHARACTERISTIC NG_15NSOLLEM_ANS "Drehzahlgradient für n_soll_em = nd_iae (IAE nicht entkoppelt)" VALUE 0x1D1A3C FLOAT32_IEEE_COL_DIRECT_S6_S3 0 ng_fl_S6_S3 -3.40282e+038 3.40282e+038 /end CHARACTERISTIC
/begin CHARACTERISTIC NO_15NSOLLEM_ANS "Drehzahloffset Umschalten für FlipFlop_nsollem" VALUE 0x1D1A44 FLOAT32_IEEE_COL_DIRECT_S6_S3 0 n_fl_S6_S3 -3.40282e+038 3.40282e+038 /end CHARACTERISTIC
/begin CHARACTERISTIC NO_NEMZMMAXIAEABLVAR_KON_ANS "Drehzahloffset auf n_soll_ll_vm_in zur Bestimmung flag_vm_restart" VALUE 0x1D1A48 FLOAT32_IEEE_COL_DIRECT_S6_S3 0 n_fl_S6_S3 -3.40282e+038 3.40282e+038 /end CHARACTERISTIC
/begin CHARACTERISTIC NS_1BEFUELLOPTNEM_ANS "Drehzahlschwelle fuer die Anforderung opt. K0- Befuellung" VALUE 0x1D1A50 FLOAT32_IEEE_COL_DIRECT_S6_S3 0 n_fl_S6_S3 -10000 10000 /end CHARACTERISTIC
/begin CHARACTERISTIC NS_1NVMZMMAXIAEABLVAR_ANS "Drehzahlschwelle n_VN unterhalb der entkoppelt wird" VALUE 0x1D1A54 FLOAT32_IEEE_COL_DIRECT_S6_S3 0 n_fl_S6_S3 -10000 10000 /end CHARACTERISTIC
/begin CHARACTERISTIC NS_2K0ABSTELLPOSUNGUELTIG_ANS "Drehzahloffset der K0 Vorgabe für Abstellpos. ungültig" VALUE 0x1D1A58 FLOAT32_IEEE_COL_DIRECT_S6_S3 0 n_fl_S6_S3 -10000 10000 /end CHARACTERISTIC
/begin CHARACTERISTIC NS_2MGK0MINVMSTARTVM_ANS "Drehzahlschwelle fuer Umschaltung mg_soll_k0 in 102" VALUE 0x1D1A5C FLOAT32_IEEE_COL_DIRECT_S6_S3 0 n_fl_S6_S3 -10000 10000 /end CHARACTERISTIC
/begin CHARACTERISTIC NS_2MOK0ABSTELLPOSNVM_ANS "Umschalten der Eingangsgroessen n_vm_in nach nd_k0" VALUE 0x1D1A60 FLOAT32_IEEE_COL_DIRECT_S6_S3 0 n_fl_S6_S3 -10000 10000 /end CHARACTERISTIC
/begin CHARACTERISTIC NS_35ABEGSMMMINVMLLEMHAS_ANS "Abtriebsdrehzahlschwelle für negative Grenze Drehzahlregler EM" VALUE 0x1D1A6C FLOAT32_IEEE_COL_DIRECT_S6_S3 0 n_fl_S6_S3 -10000 10000 /end CHARACTERISTIC
/begin CHARACTERISTIC NS_EMIAEANFAHRENTK_ANS "Drehzahlschwelle ab der im Konditionieren (IAE Anfahren) ein anderes K0 Moment vorgegeben wird" VALUE 0x1D1A70 FLOAT32_IEEE_COL_DIRECT_S6_S3 0 n_fl_S6_S3 -10000 10000 /end CHARACTERISTIC
/begin CHARACTERISTIC NS_NVM_SAK_ANS "Drehzahlschwelle n_vm für Erkennung CoM in SAK" VALUE 0x1D1A78 FLOAT32_IEEE_COL_DIRECT_S6_S3 0 n_fl_S6_S3 -10000 10000 /end CHARACTERISTIC
/begin CHARACTERISTIC NS_VMANDREHK0_ERK_KON_ANS "Drehzahlschwelle n_vm fuer das Erkennen VM läuft, für Umschaltung m_ziel in KON" VALUE 0x1D1A7C FLOAT32_IEEE_COL_DIRECT_S6_S3 0 n_fl_S6_S3 -10000 10000 /end CHARACTERISTIC
/begin CHARACTERISTIC NS_VMAUS_ERK_KON_ANS "Drehzahlschwelle n_vm beim Eintritt in KON zur Aktivierung m_ziel_k0 beim VM andrehen" VALUE 0x1D1A80 FLOAT32_IEEE_COL_DIRECT_S6_S3 0 n_fl_S6_S3 -10000 10000 /end CHARACTERISTIC
/begin CHARACTERISTIC NS_VM_UMS_NST_NOS "VM-Drehzahlschwelle als Umschaltbedingung vom Zustand Notstarten in den Zustand K0-Schließen" VALUE 0x1D1924 FLOAT32_IEEE_COL_DIRECT_S6_S3 0 n_fl_S6_S3 0 3000 /end CHARACTERISTIC
/begin MEASUREMENT SFOp_NOS75_isActive_ "" UBYTE VOID_SCALING_S6_S3 1 100 0 1 ECU_ADDRESS 0xFFF96DAE /end MEASUREMENT
/begin MEASUREMENT SFOp_NOS77_out_ "" FLOAT32_IEEE VOID_SCALING_f_S6_S3 1 100 -3.40282e+038 3.40282e+038 ECU_ADDRESS 0xFFF96824 /end MEASUREMENT
/begin MEASUREMENT SFOp_NOS78_isActive_ "" UBYTE VOID_SCALING_S6_S3 1 100 0 1 ECU_ADDRESS 0xFFF86453 /end MEASUREMENT
/begin MEASUREMENT SFOp_SLST246_isActive_ "" UBYTE VOID_SCALING_S6_S3 1 100 0 1 ECU_ADDRESS 0xFFF96DB3 /end MEASUREMENT
/begin MEASUREMENT SFOp_SLST252_out_ "" FLOAT32_IEEE VOID_SCALING_f_S6_S3 1 100 -3.40282e+038 3.40282e+038 ECU_ADDRESS 0xFFF968C8 /end MEASUREMENT
/begin MEASUREMENT SFOp_SLST266_isActive_ "" UBYTE VOID_SCALING_S6_S3 1 100 0 1 ECU_ADDRESS 0xFFF96DB6 /end MEASUREMENT
/begin MEASUREMENT SFOp_SLST295_out_ "" FLOAT32_IEEE VOID_SCALING_f_S6_S3 1 100 -3.40282e+038 3.40282e+038 ECU_ADDRESS 0xFFF968F4 /end MEASUREMENT
/begin MEASUREMENT SFOp_SLST327_out_ "" FLOAT32_IEEE VOID_SCALING_f_S6_S3 1 100 -3.40282e+038 3.40282e+038 ECU_ADDRESS 0xFFF96914 /end MEASUREMENT
/begin MEASUREMENT SFOp_SLST333_haften_b_ "" UBYTE VOID_SCALING_S6_S3 1 100 0 1 ECU_ADDRESS 0xFFF96DB9 /end MEASUREMENT
/begin MEASUREMENT SFOp_SLST334_out_ "" FLOAT32_IEEE VOID_SCALING_f_S6_S3 1 100 -3.40282e+038 3.40282e+038 ECU_ADDRESS 0xFFF9691C /end MEASUREMENT
/begin MEASUREMENT SFOp_SLST394_out_ "" FLOAT32_IEEE VOID_SCALING_f_S6_S3 1 100 -3.40282e+038 3.40282e+038 ECU_ADDRESS 0xFFF96954 /end MEASUREMENT
/begin MEASUREMENT SFOp_SLST461_isActive_ "" UBYTE VOID_SCALING_S6_S3 1 100 0 1 ECU_ADDRESS 0xFFF86495 /end MEASUREMENT
/begin MEASUREMENT SFOp_SLST469_out_ "" FLOAT32_IEEE VOID_SCALING_f_S6_S3 1 100 -3.40282e+038 3.40282e+038 ECU_ADDRESS 0xFFF96990 /end MEASUREMENT
/begin MEASUREMENT SFOp_SLST477_out_ "" FLOAT32_IEEE VOID_SCALING_f_S6_S3 1 100 -3.40282e+038 3.40282e+038 ECU_ADDRESS 0xFFF96998 /end MEASUREMENT
/begin MEASUREMENT SFOp_SLST509_isActive_ "" UBYTE VOID_SCALING_S6_S3 1 100 0 1 ECU_ADDRESS 0xFFF96DC1 /end MEASUREMENT
/begin CHARACTERISTIC STATUS_1K0ZMSOLLEMAKTIV_ANS "Status K0 in der Phase Konditionieren für die Aktivierung z_m_soll_em_has" VALUE 0x1D7D02 UBYTE_COL_DIRECT_S6_S3 0 void_int_S6_S3 0 15 /end CHARACTERISTIC
/begin CHARACTERISTIC STATUS_24K0ZMSOLLEMAKTIV_ANS "Status K0 in den Phase Anschleppen bis  K0 synchronisieren für die Aktivierung z_m_soll_em_has" VALUE 0x1D7D03 UBYTE_COL_DIRECT_S6_S3 0 void_int_S6_S3 0 8 /end CHARACTERISTIC
/begin CHARACTERISTIC STATUS_2ABLVMDREHT_HST_ANS "Anzeige der Strategie für VM dreht" VALUE 0x1D7D04 UBYTE_COL_DIRECT_S6_S3 0 void_int_S6_S3 0 8 /end CHARACTERISTIC
/begin CHARACTERISTIC STATUS_2ABLVMFEHLER_HST_ANS "Status Ablauf von HST VM startet fehlerhaft im zustand Ans" VALUE 0x1D7D05 UBYTE_COL_DIRECT_S6_S3 0 void_int_S6_S3 0 8 /end CHARACTERISTIC
/begin CHARACTERISTIC STATUS_2ABLVMLAEUFT_HST_ANS "Anzeige der Strategie für VM laeuft" VALUE 0x1D7D06 UBYTE_COL_DIRECT_S6_S3 0 void_int_S6_S3 0 8 /end CHARACTERISTIC
/begin CHARACTERISTIC STATUS_3ABLVMDREHT_HST_ANS "Anzeige der Strategie für VM dreht" VALUE 0x1D7D07 UBYTE_COL_DIRECT_S6_S3 0 void_int_S6_S3 0 8 /end CHARACTERISTIC
/begin CHARACTERISTIC STATUS_3ABLVMFEHLER_HST_ANS "Status Ablauf von HST VM startet fehlerhaft" VALUE 0x1D7D08 UBYTE_COL_DIRECT_S6_S3 0 void_int_S6_S3 0 8 /end CHARACTERISTIC
/begin CHARACTERISTIC STATUS_3ABLVMLAEUFT_HST_ANS "Anzeige der Strategie für VM laeuft" VALUE 0x1D7D09 UBYTE_COL_DIRECT_S6_S3 0 void_int_S6_S3 0 8 /end CHARACTERISTIC
/begin CHARACTERISTIC STATUS_ABL_100_ANS "Projektspezifische Vorgabe des Zahlenwerts für den Ablaufstatus status_ablauf_has in den einzelnen Zuständen eines Hybridablaufs" VALUE 0x1D7D0A UBYTE_COL_DIRECT_S6_S3 0 void_int_S6_S3 0 255 /end CHARACTERISTIC
/begin CHARACTERISTIC STATUS_ABL_101_ANS "Projektspezifische Vorgabe des Zahlenwerts für den Ablaufstatus status_ablauf_has in den einzelnen Zuständen eines Hybridablaufs" VALUE 0x1D7D0B UBYTE_COL_DIRECT_S6_S3 0 void_int_S6_S3 0 255 /end CHARACTERISTIC
/begin CHARACTERISTIC STATUS_ABL_101_ZNSOLLEM_ANS "Projektspezifische Vorgabe des Zahlenwerts für den Ablaufstatus status_ablauf_has in den einzelnen Zuständen eines Hybridablaufs" VALUE 0x1D7D0D UBYTE_COL_DIRECT_S6_S3 0 void_int_S6_S3 0 255 /end CHARACTERISTIC
/begin CHARACTERISTIC STATUS_ABL_102_ANS "Projektspezifische Vorgabe des Zahlenwerts für den Ablaufstatus status_ablauf_has in den einzelnen Zuständen eines Hybridablaufs" VALUE 0x1D7D0E UBYTE_COL_DIRECT_S6_S3 0 void_int_S6_S3 0 255 /end CHARACTERISTIC
/begin CHARACTERISTIC STATUS_ABL_103_ANS "Projektspezifische Vorgabe des Zahlenwerts für den Ablaufstatus status_ablauf_has in den einzelnen Zuständen eines Hybridablaufs" VALUE 0x1D7D0F UBYTE_COL_DIRECT_S6_S3 0 void_int_S6_S3 0 255 /end CHARACTERISTIC
/begin CHARACTERISTIC STATUS_ABL_104_ANS "Projektspezifische Vorgabe des Zahlenwerts für den Ablaufstatus status_ablauf_has in den einzelnen Zuständen eines Hybridablaufs" VALUE 0x1D7D10 UBYTE_COL_DIRECT_S6_S3 0 void_int_S6_S3 0 255 /end CHARACTERISTIC
/begin CHARACTERISTIC STATUS_ABL_105_ANS "Projektspezifische Vorgabe des Zahlenwerts für den Ablaufstatus status_ablauf_has in den einzelnen Zuständen eines Hybridablaufs" VALUE 0x1D7D11 UBYTE_COL_DIRECT_S6_S3 0 void_int_S6_S3 0 255 /end CHARACTERISTIC
/begin CHARACTERISTIC STATUS_ABL_ABBRUCH_AKTIV "Status Ablauf Abbruch aktiv" VALUE 0x1D7428 UBYTE_COL_DIRECT_S6_S3 0 void_int_S6_S3 0 255 /end CHARACTERISTIC
/begin CHARACTERISTIC STATUS_ABL_ABBRUCH_FERTIG "Status Ablauf Abbruch fertig" VALUE 0x1D7429 UBYTE_COL_DIRECT_S6_S3 0 void_int_S6_S3 0 255 /end CHARACTERISTIC
/begin CHARACTERISTIC STATUS_ABL_K0ENTK_102_ANS "Statusrueckmeldung an HST bei K0-Entkopplung in der Phase 102" VALUE 0x1D7D12 UBYTE_COL_DIRECT_S6_S3 0 void_int_S6_S3 0 255 /end CHARACTERISTIC
/begin CHARACTERISTIC STATUS_ABL_NST_NOS "Statusrückmeldung der HAS an HSTim Zustand Notstarten" VALUE 0x1D7CEB UBYTE_COL_DIRECT_S6_S3 0 void_int_S6_S3 0 15 /end CHARACTERISTIC
/begin CHARACTERISTIC STATUS_ABL_START_VMABF_ANS "Statusrückmeldung an HST im Zustand Start beim VM Abfangen beim VM Uustarten" VALUE 0x1D7D13 UBYTE_COL_DIRECT_S6_S3 0 void_int_S6_S3 0 255 /end CHARACTERISTIC
/begin CHARACTERISTIC STATUS_ABSTELLPOSVMGUELTIG_ANS "Abstellposition gueltig" VALUE 0x1D7D14 UBYTE_COL_DIRECT_S6_S3 0 void_int_S6_S3 0 2 /end CHARACTERISTIC
/begin CHARACTERISTIC SWI_01MSTOERK0EMFILMK0_ANS "Umschaltung der Einganggroessen für Berechnung msollem =f(mstoerkoemverzfil oder m_k0_in)" VALUE 0x1D7D15 UBYTE_COL_DIRECT_S6_S3 0 void_int_e_S6_S3 0 1 /end CHARACTERISTIC
/begin CHARACTERISTIC SWI_01MSTOERK0EMMK0_ANS "Umschaltung der Einganggroessen m_stoer_k0_em_verz_fil (SWI TRUE) nach m_k0_in (SWI FALSE)" VALUE 0x1D7D16 UBYTE_COL_DIRECT_S6_S3 0 void_int_e_S6_S3 0 1 /end CHARACTERISTIC
/begin CHARACTERISTIC SWI_0MSOLLEM_NULL_ANS "Umschaltung von EM Sollmoment im Zustand Schaltung aktiv" VALUE 0x1D7D17 UBYTE_COL_DIRECT_S6_S3 0 void_int_e_S6_S3 0 1 /end CHARACTERISTIC
/begin CHARACTERISTIC SWI_0ZMSOLLEM_ANS "SWI Vorgabe Sollmoment EM in Schaltung aktiv" VALUE 0x1D7D18 UBYTE_COL_DIRECT_S6_S3 0 void_int_e_S6_S3 0 1 /end CHARACTERISTIC
/begin CHARACTERISTIC SWI_100_ZPHYSK0_ANS "SWI für die Hysteresekompensation K0 im Zustand Schaltung aktiv: 0 : Druckanteil p_hys_k0_has inaktiv 1 : Druckanteil p_hys_k0_has aktiv" VALUE 0x1D7D19 UBYTE_COL_DIRECT_S6_S3 0 void_int_e_S6_S3 0 1 /end CHARACTERISTIC
/begin CHARACTERISTIC SWI_101_ZPHYSK0_ANS "SWI für die Hysteresekompensation K0 im Zustand Konditionieren: 0 : Druckanteil p_hys_k0_has inaktiv 1 : Druckanteil p_hys_k0_has aktiv" VALUE 0x1D7D1A UBYTE_COL_DIRECT_S6_S3 0 void_int_e_S6_S3 0 1 /end CHARACTERISTIC
/begin CHARACTERISTIC SWI_102_ZPHYSK0_ANS "SWI für die Hysteresekompensation K0 im Zustand Anschleppen: 0 : Druckanteil p_hys_k0_has inaktiv 1 : Druckanteil p_hys_k0_has aktiv" VALUE 0x1D7D1B UBYTE_COL_DIRECT_S6_S3 0 void_int_e_S6_S3 0 1 /end CHARACTERISTIC
/begin CHARACTERISTIC SWI_103_ZPHYSK0_ANS "SWI für die Hysteresekompensation K0 im Zustand VM zuenden: 0 : Druckanteil p_hys_k0_has inaktiv 1 : Druckanteil p_hys_k0_has aktiv" VALUE 0x1D7D1C UBYTE_COL_DIRECT_S6_S3 0 void_int_e_S6_S3 0 1 /end CHARACTERISTIC
/begin CHARACTERISTIC SWI_104_ZPHYSK0_ANS "SWI für die Hysteresekompensation K0 im Zustand K0 Synchronisieren: 0 : Druckanteil p_hys_k0_has inaktiv 1 : Druckanteil p_hys_k0_has aktiv" VALUE 0x1D7D1D UBYTE_COL_DIRECT_S6_S3 0 void_int_e_S6_S3 0 1 /end CHARACTERISTIC
/begin CHARACTERISTIC SWI_105_ZPHYSK0_ANS "SWI für die Hysteresekompensation K0 im Zustand k0 schliessen: 0 : Druckanteil p_hys_k0_has inaktiv 1 : Druckanteil p_hys_k0_has aktiv" VALUE 0x1D7D1E UBYTE_COL_DIRECT_S6_S3 0 void_int_e_S6_S3 0 1 /end CHARACTERISTIC
/begin CHARACTERISTIC SWI_10ZMSOLLEM_ANS "SWI Vorgabe Sollmoment EM SLST Abbruch" VALUE 0x1D7D1F UBYTE_COL_DIRECT_S6_S3 0 void_int_e_S6_S3 0 1 /end CHARACTERISTIC
/begin CHARACTERISTIC SWI_10ZNSOLLEM_ANS "SWI Vorgabe Solldrehzahl EM SLST Abbruch" VALUE 0x1D7D20 UBYTE_COL_DIRECT_S6_S3 0 void_int_e_S6_S3 0 1 /end CHARACTERISTIC
/begin CHARACTERISTIC SWI_110_ZPHYSK0_ANS "SWI für die Hysteresekompensation K0 im Zustand SLST Abbruch: 0 : Druckanteil p_hys_k0_has inaktiv 1 : Druckanteil p_hys_k0_has aktiv" VALUE 0x1D7D21 UBYTE_COL_DIRECT_S6_S3 0 void_int_e_S6_S3 0 1 /end CHARACTERISTIC
/begin CHARACTERISTIC SWI_14NONSOLLVMIAEENTK_ANS "SWI zum Einschalten Testen n_soll_vm_has = n_em_in" VALUE 0x1D7D22 UBYTE_COL_DIRECT_S6_S3 0 void_int_e_S6_S3 0 1 /end CHARACTERISTIC
/begin CHARACTERISTIC SWI_150ZMSOLLEM_ANS "SWI Vorgabe Sollmoment Uebergabe Abbruch" VALUE 0x1D7D23 UBYTE_COL_DIRECT_S6_S3 0 void_int_e_S6_S3 0 1 /end CHARACTERISTIC
/begin CHARACTERISTIC SWI_150ZNSOLLEM_ANS "SWI Vorgabe Solldrehzahl EM Uebergabe Abbruch" VALUE 0x1D7D24 UBYTE_COL_DIRECT_S6_S3 0 void_int_e_S6_S3 0 1 /end CHARACTERISTIC
/begin CHARACTERISTIC SWI_150_ZPHYSK0_ANS "SWI für die Hysteresekompensation K0 im Zustand Übergabe Abbruch: 0 : Druckanteil p_hys_k0_has inaktiv 1 : Druckanteil p_hys_k0_has aktiv" VALUE 0x1D7D25 UBYTE_COL_DIRECT_S6_S3 0 void_int_e_S6_S3 0 1 /end CHARACTERISTIC
/begin CHARACTERISTIC SWI_15NEMNSOLLEM_ANS "SWI zur Umschaltung der Einflussgrösse für die EM-Solldrezhalber. 0: NULL, 1: n_em_in" VALUE 0x1D7D26 UBYTE_COL_DIRECT_S6_S3 0 void_int_e_S6_S3 0 1 /end CHARACTERISTIC
/begin CHARACTERISTIC SWI_160ZMSOLLEM_ANS "SWI Vorgabe Sollmoment EM Uebergabe" VALUE 0x1D7D27 UBYTE_COL_DIRECT_S6_S3 0 void_int_e_S6_S3 0 1 /end CHARACTERISTIC
/begin CHARACTERISTIC SWI_160ZNSOLLEM_ANS "SWI Vorgabe Solldrehzahl EM Uebergabe" VALUE 0x1D7D28 UBYTE_COL_DIRECT_S6_S3 0 void_int_e_S6_S3 0 1 /end CHARACTERISTIC
/begin CHARACTERISTIC SWI_160_ZPHYSK0_ANS "SWI für die Hysteresekompensation K0 im Zustand Übergabe: 0 : Druckanteil p_hys_k0_has inaktiv 1 : Druckanteil p_hys_k0_has aktiv" VALUE 0x1D7D29 UBYTE_COL_DIRECT_S6_S3 0 void_int_e_S6_S3 0 1 /end CHARACTERISTIC
/begin CHARACTERISTIC SWI_16ZNSOLLEMAKTIV_ANS "Drehzahlvorgabe EM aus Signalberechnung" VALUE 0x1D7D2A UBYTE_COL_DIRECT_S6_S3 0 void_int_e_S6_S3 0 1 /end CHARACTERISTIC
/begin CHARACTERISTIC SWI_1MSOLLEM_NULL_ANS "Umschaltung von EM Sollmoment" VALUE 0x1D7D2B UBYTE_COL_DIRECT_S6_S3 0 void_int_e_S6_S3 0 1 /end CHARACTERISTIC
/begin CHARACTERISTIC SWI_1UMSCHMSOLLK0MZIELK0_ANS "Umschaltung m_soll_k0_has von Gradientenbegrenzt auf m_ziel_k0_has" VALUE 0x1D7D2C UBYTE_COL_DIRECT_S6_S3 0 void_int_e_S6_S3 0 1 /end CHARACTERISTIC
/begin CHARACTERISTIC SWI_1ZMSOLLEM_ANS "SWI Vorgabe Sollmoment EM Konditionieren" VALUE 0x1D7D2D UBYTE_COL_DIRECT_S6_S3 0 void_int_e_S6_S3 0 1 /end CHARACTERISTIC
/begin CHARACTERISTIC SWI_1ZNSOLLEM_ANS "SWI Vorgabe Solldrehzahl EM Konditionieren" VALUE 0x1D7D2E UBYTE_COL_DIRECT_S6_S3 0 void_int_e_S6_S3 0 1 /end CHARACTERISTIC
/begin CHARACTERISTIC SWI_24MSTOERK0EMMK0_ANS "Umschaltung der Einganggroessen m_stoer_k0_em_verz_fil (SWI TRUE) nach m_k0_in (SWI FALSE)" VALUE 0x1D7D2F UBYTE_COL_DIRECT_S6_S3 0 void_int_e_S6_S3 0 1 /end CHARACTERISTIC
/begin CHARACTERISTIC SWI_2MGSOLLK0_ANS "true: KF_2MGSOLLK0MVMSTART_ANS, KF_2MGSOLLK0MVMMIN_ANS   false: KL_2MGSOLLK0MVMSTART_ANS, KL_2MGSOLLK0MVMMIN_ANS" VALUE 0x1D7D30 UBYTE_COL_DIRECT_S6_S3 0 void_int_e_S6_S3 0 1 /end CHARACTERISTIC
/begin CHARACTERISTIC SWI_2UMSCHLMMOTNGVM_ANS "Umschalten der Eingangsgroessen m_mot_in nach ng_vm in der Phase Anschleppsen" VALUE 0x1D7D31 UBYTE_COL_DIRECT_S6_S3 0 void_int_e_S6_S3 0 1 /end CHARACTERISTIC
/begin CHARACTERISTIC SWI_2ZMSOLLEM_ANS "SWI Vorgabe Sollmoment EM Anschleppen" VALUE 0x1D7D32 UBYTE_COL_DIRECT_S6_S3 0 void_int_e_S6_S3 0 1 /end CHARACTERISTIC
/begin CHARACTERISTIC SWI_2ZNSOLLEM_ANS "SWI Vorgabe Solldrehzahl EM Anschleppen" VALUE 0x1D7D33 UBYTE_COL_DIRECT_S6_S3 0 void_int_e_S6_S3 0 1 /end CHARACTERISTIC
/begin CHARACTERISTIC SWI_2ZNSOLL_VMAKTIV_ANS "Schalter für Aktivierung Flag Drehzahlvorgabe VM in Zustand st_ablauf= 102: 0 : z_n_soll_vm_has = FALSE 1 : z_n_soll_vm_has = TRUE" VALUE 0x1D7D34 UBYTE_COL_DIRECT_S6_S3 0 void_int_e_S6_S3 0 1 /end CHARACTERISTIC
/begin CHARACTERISTIC SWI_3UMSCHLMMOTNGVM_ANS "Umschalten der Eingangsgroessen m_mot_in nach ng_vm in der Phase VM zuenden" VALUE 0x1D7D35 UBYTE_COL_DIRECT_S6_S3 0 void_int_e_S6_S3 0 1 /end CHARACTERISTIC
/begin CHARACTERISTIC SWI_3UMSCHLNVMNDK0_ANS "Umschalten der Eingangsgroessen n_vm_in nach nd_k0" VALUE 0x1D7D36 UBYTE_COL_DIRECT_S6_S3 0 void_int_e_S6_S3 0 1 /end CHARACTERISTIC
/begin CHARACTERISTIC SWI_3ZMSOLLEM_ANS "SWI Vorgabe Sollmoment EM VM Zuenden" VALUE 0x1D7D37 UBYTE_COL_DIRECT_S6_S3 0 void_int_e_S6_S3 0 1 /end CHARACTERISTIC
/begin CHARACTERISTIC SWI_3ZNSOLLEM_ANS "SWI Vorgabe Solldrehzahl EM VM Zuenden" VALUE 0x1D7D38 UBYTE_COL_DIRECT_S6_S3 0 void_int_e_S6_S3 0 1 /end CHARACTERISTIC
/begin CHARACTERISTIC SWI_3ZNSOLL_VMAKTIV_ANS "Schalter für Aktivierung Flag Drehzahlvorgabe VM in Zustand st_ablauf= 103: 0 : z_n_soll_vm_has = FALSE 1 : z_n_soll_vm_has = TRUE" VALUE 0x1D7D39 UBYTE_COL_DIRECT_S6_S3 0 void_int_e_S6_S3 0 1 /end CHARACTERISTIC
/begin CHARACTERISTIC SWI_46NEMNSOLLEM_ANS "SWI zur Umschaltung (Phase 4 -160) n_soll_em = n_em" VALUE 0x1D7D3A UBYTE_COL_DIRECT_S6_S3 0 void_int_e_S6_S3 0 1 /end CHARACTERISTIC
/begin CHARACTERISTIC SWI_4ZMSOLLEM_ANS "SWI Vorgabe Sollmoment EM Synchronisieren" VALUE 0x1D7D3B UBYTE_COL_DIRECT_S6_S3 0 void_int_e_S6_S3 0 1 /end CHARACTERISTIC
/begin CHARACTERISTIC SWI_4ZNSOLLEM_ANS "SWI Vorgabe Solldrehzahl EM Synchronisieren" VALUE 0x1D7D3C UBYTE_COL_DIRECT_S6_S3 0 void_int_e_S6_S3 0 1 /end CHARACTERISTIC
/begin CHARACTERISTIC SWI_4ZNSOLL_VMAKTIV_ANS "Schalter für Aktivierung Flag Drehzahlvorgabe VM in Zustand st_ablauf= 104: 0 : z_n_soll_vm_has = FALSE 1 : z_n_soll_vm_has = TRUE" VALUE 0x1D7D3D UBYTE_COL_DIRECT_S6_S3 0 void_int_e_S6_S3 0 1 /end CHARACTERISTIC
/begin CHARACTERISTIC SWI_5ZMMAXIAE_ANS "SWI zur Umschaltung IAE Vorsteuermoment aus der HAS" VALUE 0x1D7D3E UBYTE_COL_DIRECT_S6_S3 0 void_int_e_S6_S3 0 1 /end CHARACTERISTIC
/begin CHARACTERISTIC SWI_5ZMSOLLEM_ANS "SWI Vorgabe Sollmoment EM Schliessen" VALUE 0x1D7D3F UBYTE_COL_DIRECT_S6_S3 0 void_int_e_S6_S3 0 1 /end CHARACTERISTIC
/begin CHARACTERISTIC SWI_5ZMSOLLEM_NULL_ANS "SWI zur Umschaltung Aktivierung EM Sollmoment" VALUE 0x1D7D40 UBYTE_COL_DIRECT_S6_S3 0 void_int_e_S6_S3 0 1 /end CHARACTERISTIC
/begin CHARACTERISTIC SWI_5ZNSOLLEM_ANS "SWI Vorgabe Solldrehzahl EM Schliessen" VALUE 0x1D7D41 UBYTE_COL_DIRECT_S6_S3 0 void_int_e_S6_S3 0 1 /end CHARACTERISTIC
/begin CHARACTERISTIC SWI_AUSW_NIAEANF_ANS "Umschaltung: n_soll_em_has über n_motanfahr_gef_iae (1) oder n_soll_em_has (0)" VALUE 0x1D7D45 UBYTE_COL_DIRECT_S6_S3 0 void_int_e_S6_S3 0 1 /end CHARACTERISTIC
/begin CHARACTERISTIC SWI_BEFUELLRED_AKTIV_KON_ANS "SWI zur Aktivierung der Ausgabe einer reduzierten K0-Befuellung als f(z_m_max_iae_ablvar_has_in)" VALUE 0x1D7D47 UBYTE_COL_DIRECT_S6_S3 0 void_int_e_S6_S3 0 1 /end CHARACTERISTIC
/begin CHARACTERISTIC SWI_BEFUELLRED_AKTIV_SAK_ANS "SWI zur Aktivierung der Ausgabe einer reduzierten K0-Befuellung " VALUE 0x1D7D48 UBYTE_COL_DIRECT_S6_S3 0 void_int_e_S6_S3 0 1 /end CHARACTERISTIC
/begin CHARACTERISTIC SWI_MK0MOD_HAS_ANS "Schalter zur Umschaltung zwischen  m_stoer_k0_em_verz_fil und m_k0_mod_has_ablauf zur Ausgabe auf m_k0_mod. 0: m_k0_mod = m_k0_mod_has_ablauf 1: m_k0_mod = m_stoer_k0_em_verz_fil
" VALUE 0x1D7D49 UBYTE_COL_DIRECT_S6_S3 0 void_int_e_S6_S3 0 1 /end CHARACTERISTIC
/begin CHARACTERISTIC SWI_NMINPSYSEM_ANS "Schalter zur Berücksichtigung der n_min_psys_em_sbe für die Berechnung n_soll_em_has" VALUE 0x1D7D4A UBYTE_COL_DIRECT_S6_S3 0 void_int_e_S6_S3 0 1 /end CHARACTERISTIC
/begin CHARACTERISTIC SWI_NMOTSOLLIAEFILAKTIV_ANS "Filterung der IAE Anfahrdrehzahl - ja oder nein" VALUE 0x1D7D4B UBYTE_COL_DIRECT_S6_S3 0 void_int_e_S6_S3 0 1 /end CHARACTERISTIC
/begin CHARACTERISTIC SWI_RESPSCHLE_SCHALT_ANS "Schalter zum aktivieren des Response Schleppstarts" VALUE 0x1D742A UBYTE_COL_DIRECT_S6_S3 0 void_int_S6_S3 0 255 /end CHARACTERISTIC
/begin CHARACTERISTIC SWI_START_ZPHYSK0_ANS "SWI für die Hysteresekompensation K0 im Zustand Start: 0 : Druckanteil p_hys_k0_has inaktiv 1 : Druckanteil p_hys_k0_has aktiv" VALUE 0x1D7D4C UBYTE_COL_DIRECT_S6_S3 0 void_int_e_S6_S3 0 1 /end CHARACTERISTIC
/begin CHARACTERISTIC SWI_UMSCH_ZVMSTARTFEHLER_ANS "Swi zur Deaktivierung der K0 und VM Vorgaben wenn VM nicht zündet" VALUE 0x1D7D50 UBYTE_COL_DIRECT_S6_S3 0 void_int_e_S6_S3 0 1 /end CHARACTERISTIC
/begin CHARACTERISTIC SWI_ZPHYSK0_ABB_NOS "SWI für die Hysteresenkompensation K0 im Zustand Not-start beim Abbruch Notstart: 0 = Druckanteil p_hys_k0_has inaktiv, 1 = Druckanteil p_hys_k0_has aktiv" VALUE 0x1D7CEF UBYTE_COL_DIRECT_S6_S3 0 void_int_e_S6_S3 0 1 /end CHARACTERISTIC
/begin CHARACTERISTIC SWI_ZPHYSK0_NST_NOS "Schalter zur (De)Aktivierung der K0-Hysteresekompensation im Zustand Notstarten" VALUE 0x1D7CF1 UBYTE_COL_DIRECT_S6_S3 0 void_int_e_S6_S3 0 1 /end CHARACTERISTIC
/begin CHARACTERISTIC SWI_ZPHYSK0_UEA_NOS "SWI für die Hysteresenkompensation K0 im Zustand Notstart beim Abbruch Übergabe: 0 = Druckanteil p_hys_k0_has inaktiv, 1 = Druckanteil p_hys_k0_has aktiv" VALUE 0x1D7CF4 UBYTE_COL_DIRECT_S6_S3 0 void_int_e_S6_S3 0 1 /end CHARACTERISTIC
/begin CHARACTERISTIC SWI_ZPHYSK0_UEB_NOS "Schalter zur (De)Aktivierung der K0-Hysteresekompensation im Zustand Uebrgabe" VALUE 0x1D7CF5 UBYTE_COL_DIRECT_S6_S3 0 void_int_e_S6_S3 0 1 /end CHARACTERISTIC
/begin CHARACTERISTIC TAB_4NDSSYNC_ANS "Differenzdrehzahlschwelle der K0 in der Phase K0 Synchronisieren" VAL_BLK 0x1D194C FLOAT32_IEEE_COL_DIRECT_S6_S3 0 n_fl_S6_S3 -3.40282e+038 3.40282e+038 MATRIX_DIM 2 1 1 /end CHARACTERISTIC
/begin CHARACTERISTIC TAB_4TMINHAFTEN_ANS "Minimale Haftenzeit der K0 in der Phase K0 Synchronisieren" VAL_BLK 0x1D1954 FLOAT32_IEEE_COL_DIRECT_S6_S3 0 t_fl_S6_S3 -3.40282e+038 3.40282e+038 MATRIX_DIM 2 1 1 /end CHARACTERISTIC
/begin CHARACTERISTIC TAB_ZPHYSK0_PASSIV_HAS "Vorgabe des K0 Hystereseflags in FOp_Passiv" VAL_BLK 0x1D193C UBYTE_COL_DIRECT_S6_S3 0 void_int_S6_S3 0 255 MATRIX_DIM 16 1 1 /end CHARACTERISTIC
/begin CHARACTERISTIC TG_3VZMSOLLK0_ANS "Zeitgradient fü Abfilterung t_vzmsollk0_ans für verz. m_soll_k0_has" VALUE 0x1D1A88 FLOAT32_IEEE_COL_DIRECT_S6_S3 0 void_fl_S6_S3 0.5 2 /end CHARACTERISTIC
/begin CHARACTERISTIC T_0MAX_ANS "Max-Timer in Phase Schaltung Aktiv (100)" VALUE 0x1D1A8C FLOAT32_IEEE_COL_DIRECT_S6_S3 0 t_fl_S6_S3 -3.40282e+038 3.40282e+038 /end CHARACTERISTIC
/begin CHARACTERISTIC T_10MAX_ANS "Maximalzeit im Zustand SLST Abbr." VALUE 0x1D1A90 FLOAT32_IEEE_COL_DIRECT_S6_S3 0 t_fl_S6_S3 0 10 /end CHARACTERISTIC
/begin CHARACTERISTIC T_1MAX_ANS "Zeit für Füllausgleichsphase K0" VALUE 0x1D1A94 FLOAT32_IEEE_COL_DIRECT_S6_S3 0 t_fl_S6_S3 -3.40282e+038 3.40282e+038 /end CHARACTERISTIC
/begin CHARACTERISTIC T_1WAITSCHLUPF_ANS "??" VALUE 0x1D1A98 FLOAT32_IEEE_COL_DIRECT_S6_S3 0 t_fl_S6_S3 -3.40282e+038 3.40282e+038 /end CHARACTERISTIC
/begin CHARACTERISTIC T_23VZMSOLLK0_ANS "Verzögerungszeit für m_soll_k0_has für Phasen 102,103" VALUE 0x1D1A9C FLOAT32_IEEE_COL_DIRECT_S6_S3 0 t_fl_S6_S3 0 0.15 /end CHARACTERISTIC
/begin CHARACTERISTIC T_2MAX_ANS "Maximalzeit im Zustand St_Anschleppen_Ans" VALUE 0x1D1AA0 FLOAT32_IEEE_COL_DIRECT_S6_S3 0 t_fl_S6_S3 -3.40282e+038 3.40282e+038 /end CHARACTERISTIC
/begin CHARACTERISTIC T_2MIN_ANS "Mindestzeit zum Verbleib in VM_zuenden" VALUE 0x1D1AA4 FLOAT32_IEEE_COL_DIRECT_S6_S3 0 t_fl_S6_S3 -3.40282e+038 3.40282e+038 /end CHARACTERISTIC
/begin CHARACTERISTIC T_2MK0OFFSET_ANS "Timer Ausloesen einer Notanschlepprampe K0" VALUE 0x1D1AA8 FLOAT32_IEEE_COL_DIRECT_S6_S3 0 t_fl_S6_S3 0 1 /end CHARACTERISTIC
/begin CHARACTERISTIC T_3MAX_ANS "Maximalzeit im Zustand St_VM_zuenden_En_St" VALUE 0x1D1AAC FLOAT32_IEEE_COL_DIRECT_S6_S3 0 t_fl_S6_S3 -3.40282e+038 3.40282e+038 /end CHARACTERISTIC
/begin CHARACTERISTIC T_4MAX_ANS "Maximalzeit im Zustand St_K0_Synchronisieren_En_St" VALUE 0x1D1AB0 FLOAT32_IEEE_COL_DIRECT_S6_S3 0 t_fl_S6_S3 -3.40282e+038 3.40282e+038 /end CHARACTERISTIC
/begin CHARACTERISTIC T_5MAX_ANS "Maximalzeit im Zustand St_K0_Schliessen_En_St" VALUE 0x1D1AB4 FLOAT32_IEEE_COL_DIRECT_S6_S3 0 t_fl_S6_S3 -3.40282e+038 3.40282e+038 /end CHARACTERISTIC
/begin CHARACTERISTIC T_MAX_NST_NOS "maximale Verweildauer im Zustand Notstarten (151)" VALUE 0x1D192C FLOAT32_IEEE_COL_DIRECT_S6_S3 0 t_fl_S6_S3 0 10 /end CHARACTERISTIC
/begin CHARACTERISTIC T_NDG "Filterzeit Differenzdrehzahlgradient" VALUE 0x1D1ABC FLOAT32_IEEE_COL_DIRECT_S6_S3 0 t_fl_S6_S3 -3.40282e+038 3.40282e+038 /end CHARACTERISTIC
/begin CHARACTERISTIC T_NDSK0_NST_NOS "minimale Verweildauer, in der die K0-Differenzdrehzahl unterhalb einer applizierbaren Schwelle ist; im Zustand Notstarten (151)" VALUE 0x1D1934 FLOAT32_IEEE_COL_DIRECT_S6_S3 0 t_fl_S6_S3 0 10 /end CHARACTERISTIC
/begin CHARACTERISTIC T_UMS_NST_NOS "maximale Umschaltdauer im Zustand Notstarten (151)" VALUE 0x1D1938 FLOAT32_IEEE_COL_DIRECT_S6_S3 0 t_fl_S6_S3 0 10 /end CHARACTERISTIC
/begin CHARACTERISTIC T_VORSYNC "Zeitschwelle Differenzdrehzahl vor Synchron" VALUE 0x1D1ACC FLOAT32_IEEE_COL_DIRECT_S6_S3 0 t_fl_S6_S3 -3.40282e+038 3.40282e+038 /end CHARACTERISTIC
/begin CHARACTERISTIC T_VZMGK0_ANS "Verzögerungsteit für den Kupplungsgradient zum Anschleppen" VALUE 0x1D1AD0 FLOAT32_IEEE_COL_DIRECT_S6_S3 0 t_fl_S6_S3 -3.40282e+038 3.40282e+038 /end CHARACTERISTIC
/begin CHARACTERISTIC Z_ABLAUF_VMABF_ANS "Wert der Anforderung eines VM_Abfangen durch die Strategieanpassung (z_ablauf_has_stg) beim Abbruch der Funktion VM_Abstellen bei der Aktivierung des Ablaufs VM Starten Variante VM Zustarten" VALUE 0x1D8C4A UWORD_COL_DIRECT_S6_S3 0 void_int_b_S6_S3 0 65535 /end CHARACTERISTIC
/begin MEASUREMENT abstellpos_vm_in "Abstellposition VM vor nächstem ZOT" UBYTE void_int_S6_S3 1 100 0 180 ECU_ADDRESS 0xFFF86698 /end MEASUREMENT
/begin MEASUREMENT abstellpos_vm_status_in "Status Abstellposition VM" UBYTE void_int_S6_S3 1 100 0 2 ECU_ADDRESS 0xFFF86699 /end MEASUREMENT
/begin MEASUREMENT c_getriebe_egs_in "" FLOAT32_IEEE c_int_S6_S3 1 100 -40 215 ECU_ADDRESS 0xFFF85DDC /end MEASUREMENT
/begin MEASUREMENT c_vm_in "" FLOAT32_IEEE c_int_S6_S3 1 100 -3.40282e+038 3.40282e+038 ECU_ADDRESS 0xFFF85E38 /end MEASUREMENT
/begin MEASUREMENT gangwechsel_egs_in "Flag während laufender Schaltung, bei synchron verlassen bis synchron erreicht" UBYTE void_int_S6_S3 1 100 0 1 ECU_ADDRESS 0xFFF86677 /end MEASUREMENT
/begin MEASUREMENT i_istgang_egs "" FLOAT32_IEEE void_fl_S6_S3 1 100 0 8 ECU_ADDRESS 0xFFF85D8C /end MEASUREMENT
/begin MEASUREMENT i_zielgang_egs "" FLOAT32_IEEE void_fl_S6_S3 1 100 0 8 ECU_ADDRESS 0xFFF85D90 /end MEASUREMENT
/begin MEASUREMENT init_anfiae_aktiv_ans "Trigger zur Aktivierung des Gradientenbegrenzer" UBYTE void_int_S6_S3 1 100 0 1 ECU_ADDRESS 0xFFF96DC2 /end MEASUREMENT
/begin MEASUREMENT init_nsollem_grad_ans "Initflag zur Initi. des Gradientenbegrenzer für die Ber. n_soll_em" UBYTE void_int_S6_S3 1 100 0 255 ECU_ADDRESS 0xFFF96DC3 /end MEASUREMENT
/begin MEASUREMENT istgang_egs_in "" SBYTE void_int_S6_S3 1 100 -128 127 ECU_ADDRESS 0xFFF86678 /end MEASUREMENT
/begin MEASUREMENT m_em_in "" FLOAT32_IEEE trq_fl_a_S6_S3 1 100 -1024 1024 ECU_ADDRESS 0xFFF85DE0 /end MEASUREMENT
/begin MEASUREMENT m_iae_in "" FLOAT32_IEEE trq_fl_a_S6_S3 1 100 -32768 32767 ECU_ADDRESS 0xFFF85DE4 /end MEASUREMENT
/begin MEASUREMENT m_k0_in "" FLOAT32_IEEE trq_fl_a_S6_S3 1 100 -32768 32767 ECU_ADDRESS 0xFFF85DE8 /end MEASUREMENT
/begin MEASUREMENT m_k0_mber_has_sbe "K0-Moment der HAS zur Motormomentbegrenzung in der SAB" FLOAT32_IEEE trq_fl_a_S6_S3 1 100 -3.40282e+038 3.40282e+038 ECU_ADDRESS 0xFFF85DC4 /end MEASUREMENT
/begin MEASUREMENT m_k0_mod_has_fkt "" FLOAT32_IEEE trq_fl_a_S6_S3 1 100 -1200 1200 ECU_ADDRESS 0xFFF85D4C /end MEASUREMENT
/begin MEASUREMENT m_max_dyn_em_in "" FLOAT32_IEEE trq_fl_a_S6_S3 1 100 -32768 32767 ECU_ADDRESS 0xFFF85DEC /end MEASUREMENT
/begin MEASUREMENT m_min_dyn_em_in "" FLOAT32_IEEE trq_fl_a_S6_S3 1 100 -3.40282e+038 3.40282e+038 ECU_ADDRESS 0xFFF85DF0 /end MEASUREMENT
/begin MEASUREMENT m_min_vm_in "" FLOAT32_IEEE trq_fl_a_S6_S3 1 100 -3.40282e+038 3.40282e+038 ECU_ADDRESS 0xFFF85E3C /end MEASUREMENT
/begin MEASUREMENT m_mot_in "" FLOAT32_IEEE trq_fl_a_S6_S3 1 100 -1024 1024 ECU_ADDRESS 0xFFF85DF4 /end MEASUREMENT
/begin MEASUREMENT m_motmax_has "" FLOAT32_IEEE trq_fl_a_S6_S3 1 100 -1200 1200 ECU_ADDRESS 0xFFF85DC8 /end MEASUREMENT
/begin MEASUREMENT m_soll_em_hst_in "" FLOAT32_IEEE trq_fl_a_S6_S3 1 100 -32768 32767 ECU_ADDRESS 0xFFF85DF8 /end MEASUREMENT
/begin MEASUREMENT m_soll_k0_has_fkt "" FLOAT32_IEEE trq_fl_a_S6_S3 1 100 -1200 1200 ECU_ADDRESS 0xFFF85D60 /end MEASUREMENT
/begin MEASUREMENT m_soll_k0_ziel_nos_mess "Zielwert des K0-Sollmoments m_soll_k0_has" FLOAT32_IEEE trq_fl_a_S6_S3 1 100 -3.40282e+038 3.40282e+038 ECU_ADDRESS 0xFFF96834 /end MEASUREMENT
/begin MEASUREMENT m_soll_res_em_bas_sbe "" FLOAT32_IEEE trq_fl_a_S6_S3 1 100 -3.40282e+038 3.40282e+038 ECU_ADDRESS 0xFFF85DCC /end MEASUREMENT
/begin MEASUREMENT m_soll_res_em_has_sbe "" FLOAT32_IEEE trq_fl_a_S6_S3 1 100 -3.40282e+038 3.40282e+038 ECU_ADDRESS 0xFFF85DD0 /end MEASUREMENT
/begin MEASUREMENT m_soll_vm_hst_in "" FLOAT32_IEEE trq_fl_a_S6_S3 1 100 -32768 32767 ECU_ADDRESS 0xFFF85DFC /end MEASUREMENT
/begin MEASUREMENT m_soll_vm_l_hst_in "" FLOAT32_IEEE trq_fl_a_S6_S3 1 100 -3.40282e+038 3.40282e+038 ECU_ADDRESS 0xFFF85E40 /end MEASUREMENT
/begin MEASUREMENT m_stoer_k0_em_fil "Gefiltertes Stoermoment der K0 im Schleppstart" FLOAT32_IEEE trq_fl_a_S6_S3 1 100 -3.40282e+038 3.40282e+038 ECU_ADDRESS 0xFFF969E4 /end MEASUREMENT
/begin MEASUREMENT m_vm_in "" FLOAT32_IEEE trq_fl_a_S6_S3 1 100 -1024 1023.5 ECU_ADDRESS 0xFFF85E00 /end MEASUREMENT
/begin MEASUREMENT m_vm_start_in "" FLOAT32_IEEE trq_fl_a_S6_S3 1 100 -1024 1023.5 ECU_ADDRESS 0xFFF85E04 /end MEASUREMENT
/begin MEASUREMENT m_wunsch_fpw_hst_fil "" FLOAT32_IEEE trqg_fl_c_S6_S3 1 100 -2000 2000 ECU_ADDRESS 0xFFF85D94 /end MEASUREMENT
/begin MEASUREMENT m_wunsch_fpw_hst_in "" FLOAT32_IEEE trq_fl_a_S6_S3 1 100 -3.40282e+038 3.40282e+038 ECU_ADDRESS 0xFFF85E44 /end MEASUREMENT
/begin MEASUREMENT m_wunsch_fpw_in "" FLOAT32_IEEE trq_fl_a_S6_S3 1 100 -32768 32767 ECU_ADDRESS 0xFFF85E08 /end MEASUREMENT
/begin MEASUREMENT m_ziel_vm_has_ans "Zielmoment des VM beim Schleppstart" FLOAT32_IEEE trq_fl_a_S6_S3 1 100 -3.40282e+038 3.40282e+038 ECU_ADDRESS 0xFFF969E8 /end MEASUREMENT
/begin MEASUREMENT mg_soll_k0_kon_ans "K0 Gradient im Zustand KON" FLOAT32_IEEE trqg_fl_c_S6_S3 1 100 -3.40282e+038 3.40282e+038 ECU_ADDRESS 0xFFF969EC /end MEASUREMENT
/begin MEASUREMENT mg_wunsch_fpw "" FLOAT32_IEEE trqg_fl_c_S6_S3 1 100 -2000 2000 ECU_ADDRESS 0xFFF85D98 /end MEASUREMENT
/begin MEASUREMENT mg_wunsch_fpw_hst "" FLOAT32_IEEE trqg_fl_c_S6_S3 1 100 -2000 2000 ECU_ADDRESS 0xFFF85D9C /end MEASUREMENT
/begin MEASUREMENT n_ab_egs_in "" FLOAT32_IEEE n_fl_S6_S3 1 100 0 65535 ECU_ADDRESS 0xFFF85E0C /end MEASUREMENT
/begin MEASUREMENT n_em_in "" FLOAT32_IEEE n_fl_S6_S3 1 100 -3.40282e+038 3.40282e+038 ECU_ADDRESS 0xFFF85E10 /end MEASUREMENT
/begin MEASUREMENT n_em_ziel_gradbr_ans "Zieldrehzahl für das Auffiltern der n_soll_em_has nach n_ziel_em_ans" FLOAT32_IEEE n_fl_S6_S3 1 100 -3.40282e+038 3.40282e+038 ECU_ADDRESS 0xFFF969F4 /end MEASUREMENT
/begin MEASUREMENT n_min_em_has_sbe "Minimale EM Drehzahl der Leerlaufsimulation der HAS (LLS)" FLOAT32_IEEE n_fl_S6_S3 1 100 -32767 32767 ECU_ADDRESS 0xFFF85DD4 /end MEASUREMENT
/begin MEASUREMENT n_min_psys_em_has_sbe "Minimale EM Drehzahl zur Sicherstellung Ölversorgung" FLOAT32_IEEE n_fl_S6_S3 1 100 -32767 32767 ECU_ADDRESS 0xFFF85DA0 /end MEASUREMENT
/begin MEASUREMENT n_mot_soll_iae_fil_in "PT2 gefilterte Anfahrdrehzahl der IAE" FLOAT32_IEEE n_fl_S6_S3 1 100 -3.40282e+038 3.40282e+038 ECU_ADDRESS 0xFFF969F8 /end MEASUREMENT
/begin MEASUREMENT n_mot_soll_iae_in "" FLOAT32_IEEE n_fl_S6_S3 1 100 -3.40282e+038 3.40282e+038 ECU_ADDRESS 0xFFF85E14 /end MEASUREMENT
/begin MEASUREMENT n_sec_iae "" FLOAT32_IEEE n_fl_S6_S3 1 100 -10000 10000 ECU_ADDRESS 0xFFF85DA4 /end MEASUREMENT
/begin MEASUREMENT n_sec_iae_ziel_ans "Abtriebsseitige IAE Zieldrehzahl bezogen auf den Getriebeeingang während einer Schaltung beim SLST" FLOAT32_IEEE n_fl_S6_S3 1 100 -3.40282e+038 3.40282e+038 ECU_ADDRESS 0xFFF969FC /end MEASUREMENT
/begin MEASUREMENT n_soll_em_anfiae_ans "Gemessen in solldrehzahlgrad.begr. n_soll_em_has aus regulaerer Berechnung" FLOAT32_IEEE n_fl_S6_S3 1 100 -3.40282e+038 3.40282e+038 ECU_ADDRESS 0xFFF96A00 /end MEASUREMENT
/begin MEASUREMENT n_soll_em_hst_in "" FLOAT32_IEEE n_fl_S6_S3 1 100 -3.40282e+038 3.40282e+038 ECU_ADDRESS 0xFFF85E48 /end MEASUREMENT
/begin MEASUREMENT n_soll_em_max_ans "Gemessen in solldrehzahl_em/grad.begr." FLOAT32_IEEE n_fl_S6_S3 1 100 -3.40282e+038 3.40282e+038 ECU_ADDRESS 0xFFF96A04 /end MEASUREMENT
/begin MEASUREMENT n_soll_ll_vm_in "" FLOAT32_IEEE n_fl_S6_S3 1 100 0 2540 ECU_ADDRESS 0xFFF85E18 /end MEASUREMENT
/begin MEASUREMENT n_t_egs_in "" FLOAT32_IEEE n_fl_S6_S3 1 100 0 65535 ECU_ADDRESS 0xFFF85E1C /end MEASUREMENT
/begin MEASUREMENT n_vm_in "" FLOAT32_IEEE n_fl_S6_S3 1 100 0 65535 ECU_ADDRESS 0xFFF85E20 /end MEASUREMENT
/begin MEASUREMENT nd_anfiaensollem_ans "Gemessen in solldrehzahl_em/grad. Begrenzter Überführungsoffset" FLOAT32_IEEE n_fl_S6_S3 1 100 -3.40282e+038 3.40282e+038 ECU_ADDRESS 0xFFF96A0C /end MEASUREMENT
/begin MEASUREMENT nd_iae "" FLOAT32_IEEE n_fl_S6_S3 1 100 -10000 10000 ECU_ADDRESS 0xFFF85DA8 /end MEASUREMENT
/begin MEASUREMENT nd_iae_init_ans "Initialiseriung Gradientenbeg. zur Berechnung n_soll_em " FLOAT32_IEEE n_fl_S6_S3 1 100 -3.40282e+038 3.40282e+038 ECU_ADDRESS 0xFFF96A10 /end MEASUREMENT
/begin MEASUREMENT nd_k0_in "" FLOAT32_IEEE n_fl_S6_S3 1 100 -10000 10000 ECU_ADDRESS 0xFFF85DAC /end MEASUREMENT
/begin MEASUREMENT nd_soll_iae "Gemessen in solldrehzahl_em/konditionieren" FLOAT32_IEEE n_fl_S6_S3 1 100 -3.40282e+038 3.40282e+038 ECU_ADDRESS 0xFFF96A14 /end MEASUREMENT
/begin MEASUREMENT nd_soll_iae_init_ans "Initialiseriung Gradientenbeg. zur Berechnung n_soll_em " FLOAT32_IEEE n_fl_S6_S3 1 100 -3.40282e+038 3.40282e+038 ECU_ADDRESS 0xFFF96A18 /end MEASUREMENT
/begin MEASUREMENT ndg_k0_in "" FLOAT32_IEEE ng_fl_S6_S3 1 100 -10000 10000 ECU_ADDRESS 0xFFF85DB0 /end MEASUREMENT
/begin MEASUREMENT ng_nsoll_em_ans "Gemessen in solldrehzahl_em/konditionieren" FLOAT32_IEEE ng_fl_S6_S3 1 100 -3.40282e+038 3.40282e+038 ECU_ADDRESS 0xFFF96A1C /end MEASUREMENT
/begin MEASUREMENT ng_vm "" FLOAT32_IEEE ng_fl_S6_S3 1 100 -10000 10000 ECU_ADDRESS 0xFFF85DB4 /end MEASUREMENT
/begin MEASUREMENT osmode_next_in "" UBYTE void_int_S6_S3 1 100 1 3 ECU_ADDRESS 0xFFF86679 /end MEASUREMENT
/begin MEASUREMENT p_bremse_fzg_in "" FLOAT32_IEEE p_fl_S6_S3 1 100 -32000 0 ECU_ADDRESS 0xFFF85E24 /end MEASUREMENT
/begin MEASUREMENT phi_neigung_in "Fahrzeug-Neigungswinkel" FLOAT32_IEEE void_fl_S6_S3 1 100 -3.40282e+038 3.40282e+038 ECU_ADDRESS 0xFFF85E28 /end MEASUREMENT
/begin MEASUREMENT pos_egs_in "Waehlhebelposition" UBYTE E_POS_S6_S3 1 100 0 8 ECU_ADDRESS 0xFFF8667A /end MEASUREMENT
/begin MEASUREMENT sollgang_egs_in "" SBYTE void_int_S6_S3 1 100 -128 127 ECU_ADDRESS 0xFFF8667B /end MEASUREMENT
/begin MEASUREMENT st_OMLID_act_stg "Innere Zustände der OML" UWORD void_int_b_S6_S3 1 100 0 4999 ECU_ADDRESS 0xFFF860CA /end MEASUREMENT
/begin MEASUREMENT st_ist_bz_has_stg "Istzustand OML" UBYTE E_STBZHAS_S6_S3 1 100 0 15 ECU_ADDRESS 0xFFF86635 /end MEASUREMENT
/begin MEASUREMENT st_soll_bz_has_hst "interner HST Soll-Betriebszustand der Strategieanpassung (variantenunabhaengig)" UBYTE void_int_S6_S3 1 100 0 1 ECU_ADDRESS 0xFFF8669A /end MEASUREMENT
/begin MEASUREMENT st_ziel_bz_has_stg "Zielzustand OML" UBYTE E_STBZHAS_S6_S3 1 100 0 15 ECU_ADDRESS 0xFFF86636 /end MEASUREMENT
/begin MEASUREMENT status_alaengs_adaoff_in "Information, ob die Adaptionen aufgrund erkannter Laengsbeschleunigung deaktiviert wird. 0 = Adaption aktiv aufgrund erkannter Laengsbeschleunigung
1 = Adaption inaktiv aufgrund nicht erkannter Laengsbeschleunigung" UBYTE void_int_S6_S3 1 100 0 1 ECU_ADDRESS 0xFFF8667C /end MEASUREMENT
/begin MEASUREMENT status_betriebsbereit_hst_in "" UBYTE void_int_S6_S3 1 100 0 1 ECU_ADDRESS 0xFFF8669B /end MEASUREMENT
/begin MEASUREMENT status_efahren_has_sbe "Status E-Fahren der HAS zur Festlegung der entsprechenden Portout-Größe in der HAS Signalaufbereitung_Out" UBYTE void_int_S6_S3 1 100 0 1 ECU_ADDRESS 0xFFF8665A /end MEASUREMENT
/begin MEASUREMENT status_fehler15_eh_diagin "Info vom Errorhandler ob Ersatzfkt. aktiv" UBYTE void_int_S6_S3 1 100 0 1 ECU_ADDRESS 0xFFF8662E /end MEASUREMENT
/begin MEASUREMENT status_fehler_iep_in "" UBYTE E_FEHLERIEP_S6_S3 1 100 0 1 ECU_ADDRESS 0xFFF8667D /end MEASUREMENT
/begin MEASUREMENT status_iae_adap_in "Status der Adaption des Integrierten Anfahrelements IAE" UBYTE E_STATUSADA_S6_S3 1 100 0 2 ECU_ADDRESS 0xFFF8667E /end MEASUREMENT
/begin MEASUREMENT status_iae_in "" UBYTE E_STATUSIAE_S6_S3 1 100 0 8 ECU_ADDRESS 0xFFF8667F /end MEASUREMENT
/begin MEASUREMENT status_iep_in "" UBYTE E_STATUSIEP_S6_S3 1 100 0 4 ECU_ADDRESS 0xFFF86680 /end MEASUREMENT
/begin MEASUREMENT status_k0_adap_in "" UBYTE E_STATUSADA_S6_S3 1 100 0 2 ECU_ADDRESS 0xFFF86681 /end MEASUREMENT
/begin MEASUREMENT status_k0_in "" UBYTE E_STATUSK0_S6_S3 1 100 0 5 ECU_ADDRESS 0xFFF86682 /end MEASUREMENT
/begin MEASUREMENT status_kl15_in "" UBYTE void_int_S6_S3 1 100 0 1 ECU_ADDRESS 0xFFF8669C /end MEASUREMENT
/begin MEASUREMENT status_kolbenpos_k0_in "" UBYTE void_int_S6_S3 1 100 0 255 ECU_ADDRESS 0xFFF86683 /end MEASUREMENT
/begin MEASUREMENT status_kraftfluss_egs_in "" UBYTE E_STATUSKSL_S6_S3 1 100 0 6 ECU_ADDRESS 0xFFF86684 /end MEASUREMENT
/begin MEASUREMENT status_kraftfluss_egs_roh_in "" UBYTE void_int_S6_S3 1 100 0 255 ECU_ADDRESS 0xFFF86685 /end MEASUREMENT
/begin MEASUREMENT status_ll_vm_in "" UBYTE void_int_S6_S3 1 100 0 255 ECU_ADDRESS 0xFFF86686 /end MEASUREMENT
/begin MEASUREMENT status_nem_in "Status zur Drehzahl E-Motor" UBYTE E_SIGSTATUS_S6_S3 1 100 0 2 ECU_ADDRESS 0xFFF86687 /end MEASUREMENT
/begin MEASUREMENT status_nreg_em_hst_in "Status E-Motor Drehzahlregelung der HST" UBYTE void_int_S6_S3 1 100 0 255 ECU_ADDRESS 0xFFF8669D /end MEASUREMENT
/begin MEASUREMENT status_nvm_in "Status zur Drehzahl VM-Motor" UBYTE E_SIGSTATUS_S6_S3 1 100 0 2 ECU_ADDRESS 0xFFF86688 /end MEASUREMENT
/begin MEASUREMENT status_posvueb_in "Erkennung PosV Diagnose" UBYTE void_int_S6_S3 1 100 0 255 ECU_ADDRESS 0xFFF86689 /end MEASUREMENT
/begin MEASUREMENT status_psys_has_sbe "" UBYTE E_STATUSPSY_S6_S3 1 100 0 4 ECU_ADDRESS 0xFFF86654 /end MEASUREMENT
/begin MEASUREMENT status_sa_vm_in "00 Keine Beeinflussung; 01 Schubabschaltung aktiv; 10 Nicht stellbarer Bereich; 11 Signal ungültig" UBYTE void_int_S6_S3 1 100 0 3 ECU_ADDRESS 0xFFF8669E /end MEASUREMENT
/begin MEASUREMENT status_schaltart_svh_has_sbe "Schaltart der angeforderten Schaltung der Schaltverhinderung der HAS (0 = keine Schaltung angefordert) - Bit-Codierung (m/oL=mit/ohne Lanstanh.)=: bit0=ZRSmL,1=ZHSmL,2=SRSmL,3=SHSmL,4=ZRSoL,5=ZHSoL,6=SRSoL,7=SHSoL" UBYTE void_int_S6_S3 1 100 0 255 ECU_ADDRESS 0xFFF8665B /end MEASUREMENT
/begin MEASUREMENT status_schaltung_egs_in "" SBYTE void_int_S6_S3 1 100 -9 9 ECU_ADDRESS 0xFFF86655 /end MEASUREMENT
/begin MEASUREMENT status_sync_schaltung_sbe "Anzeige der Synchronerkennung der aktuellen Schaltung innerhalb der HAS" UBYTE void_int_S6_S3 1 100 0 1 ECU_ADDRESS 0xFFF86656 /end MEASUREMENT
/begin MEASUREMENT status_waschstr_in "" UBYTE void_int_S6_S3 1 100 0 255 ECU_ADDRESS 0xFFF8668A /end MEASUREMENT
/begin MEASUREMENT status_zug_svh_sbe "Status für Anzeige Zug/Schub" UBYTE void_int_S6_S3 1 100 0 1 ECU_ADDRESS 0xFFF8665C /end MEASUREMENT
/begin MEASUREMENT t_0max_ans_mes "Gemessen in St_Schaltung_aktiv_En_St" FLOAT32_IEEE t_fl_S6_S3 1 100 -3.40282e+038 3.40282e+038 ECU_ADDRESS 0xFFF96A2C /end MEASUREMENT
/begin MEASUREMENT t_10max_ans_mes "Gemessen in St_SLST_Abbruch_Ans_En_St" FLOAT32_IEEE t_fl_S6_S3 1 100 -3.40282e+038 3.40282e+038 ECU_ADDRESS 0xFFF96A30 /end MEASUREMENT
/begin MEASUREMENT t_1waitschlupf_ans_mes "Gemessen im Kond." FLOAT32_IEEE t_fl_S6_S3 1 100 -3.40282e+038 3.40282e+038 ECU_ADDRESS 0xFFF96A34 /end MEASUREMENT
/begin MEASUREMENT t_2max_ans_mes "Gemessen in St_Anschleppen_Ans_En_St" FLOAT32_IEEE t_fl_S6_S3 1 100 -3.40282e+038 3.40282e+038 ECU_ADDRESS 0xFFF96A3C /end MEASUREMENT
/begin MEASUREMENT t_3max_ans_mes "Gemessen in St_VM_zuenden_En_St" FLOAT32_IEEE t_fl_S6_S3 1 100 -3.40282e+038 3.40282e+038 ECU_ADDRESS 0xFFF96A40 /end MEASUREMENT
/begin MEASUREMENT t_3min_ans_mes "Gemessene aktuelle Zeit vom Timer T_3MIN_ANS" FLOAT32_IEEE t_fl_S6_S3 1 100 -3.40282e+038 3.40282e+038 ECU_ADDRESS 0xFFF96A44 /end MEASUREMENT
/begin MEASUREMENT t_3minablvar_ans_mes "Gemessener Applikationswert für T_3MIN_ANS" FLOAT32_IEEE t_fl_S6_S3 1 100 -3.40282e+038 3.40282e+038 ECU_ADDRESS 0xFFF96A48 /end MEASUREMENT
/begin MEASUREMENT t_4max_ans_mes "Gemessen in St_K0_Synchronisieren_En_St" FLOAT32_IEEE t_fl_S6_S3 1 100 -3.40282e+038 3.40282e+038 ECU_ADDRESS 0xFFF96A4C /end MEASUREMENT
/begin MEASUREMENT t_5max_ans_mes "Gemessen in St_K0_Schliessen_En_St" FLOAT32_IEEE t_fl_S6_S3 1 100 -3.40282e+038 3.40282e+038 ECU_ADDRESS 0xFFF96A50 /end MEASUREMENT
/begin MEASUREMENT t_betrieb_pvu_has_ee_in "" ULONG t_int_S6_S3 1 100 0 10000 ECU_ADDRESS 0xFFF85E2C /end MEASUREMENT
/begin MEASUREMENT t_betrieb_pvu_has_sbe "Betriebsdauer seit dem letzten Ablauf der Diagnosefunktion \"Positionsventil-Überwachung\" der Funktion zur Unterstüt-zung der Positionsventil-Überwachung der HAS" FLOAT32_IEEE t_fl_S6_S3 1 100 0 1000000 ECU_ADDRESS 0xFFF85DB8 /end MEASUREMENT
/begin MEASUREMENT t_max_nst_nos_mess "Timer der maximalen Verweildauer im Zustand Notstarten" FLOAT32_IEEE t_fl_S6_S3 1 100 -3.40282e+038 3.40282e+038 ECU_ADDRESS 0xFFF9683C /end MEASUREMENT
/begin MEASUREMENT t_ndsk0_nst_nos_mess "Timer der minimalen Verweildauer, in der die K0-Differenzdrehzahl unterhalb einer applizierbaren Schwelle ist; im Zustand Notstarten" FLOAT32_IEEE t_fl_S6_S3 1 100 -3.40282e+038 3.40282e+038 ECU_ADDRESS 0xFFF96844 /end MEASUREMENT
/begin MEASUREMENT t_ums_nst_nos_mess "Timer der maximalen Umschaltdauer im Zustand Notstarten" FLOAT32_IEEE t_fl_S6_S3 1 100 -3.40282e+038 3.40282e+038 ECU_ADDRESS 0xFFF96848 /end MEASUREMENT
/begin MEASUREMENT trig_anfiae_aktiv_ans "Trigger zur Aktivierung der Gradientenüberführung nach Anfahrdrehzahl der IAE" UBYTE void_int_e_S6_S3 1 100 0 1 ECU_ADDRESS 0xFFF96DC5 /end MEASUREMENT
/begin MEASUREMENT trig_anfiae_deaktiv_ans "Trigger zur Deaktivierung der Gradientenüberführung zurück zu n_soll_em_has" UBYTE void_int_e_S6_S3 1 100 0 1 ECU_ADDRESS 0xFFF96DC6 /end MEASUREMENT
/begin MEASUREMENT v_f_sbe "Fahrzeuggeschwindigkeit auf Basis der Getriebeabtriebsdrehzahl in der  Hybridablaufsteuerung" FLOAT32_IEEE v_fl_S6_S3 1 100 -3.40282e+038 3.40282e+038 ECU_ADDRESS 0xFFF85DBC /end MEASUREMENT
/begin MEASUREMENT vg_f_sbe "Fahrzeuggeschwindigkeitsgradient auf Basis der Getriebeabtriebsdrehzahl in der  Hybridablaufsteuerung" FLOAT32_IEEE vg_fl_S6_S3 1 100 -3.40282e+038 3.40282e+038 ECU_ADDRESS 0xFFF85DC0 /end MEASUREMENT
/begin MEASUREMENT z_ablauf_has_hst_in "" UBYTE void_int_S6_S3 1 100 0 15 ECU_ADDRESS 0xFFF8668B /end MEASUREMENT
/begin MEASUREMENT z_ablauf_has_stg "Zusaetzliche Steuergroesse zur Ablaufsteuerung" UBYTE void_int_S6_S3 1 100 0 15 ECU_ADDRESS 0xFFF86637 /end MEASUREMENT
/begin MEASUREMENT z_ablaufreinit_frk_dihi "Zeigt an, dass der aktuelle HAS-Ablauf erneut begonnen werden soll" UBYTE void_int_S6_S3 1 100 0 1 ECU_ADDRESS 0xFFF8662F /end MEASUREMENT
/begin MEASUREMENT z_ablaufvariante_has_hst_in "" UBYTE void_int_S6_S3 1 100 0 15 ECU_ADDRESS 0xFFF8668C /end MEASUREMENT
/begin MEASUREMENT z_ablaufvariante_has_stg "Ablaufvariante, die  die OML ausgibt" UBYTE void_int_S6_S3 1 100 0 99 ECU_ADDRESS 0xFFF86638 /end MEASUREMENT
/begin MEASUREMENT z_ba_has_k0_hst_in "" UBYTE void_int_S6_S3 1 100 0 1 ECU_ADDRESS 0xFFF8669F /end MEASUREMENT
/begin MEASUREMENT z_ba_has_vm_hst_in "" UBYTE void_int_S6_S3 1 100 0 1 ECU_ADDRESS 0xFFF866A0 /end MEASUREMENT
/begin MEASUREMENT z_diag_ersfkt_has_in "Funktionsschnittstelle zur Ermittlung ob irgendeine Ersatzmaßnahme in der Diagnoseverwaltung aktiv ist" ULONG b_int_S6_S3 1 100 0 4294967295 ECU_ADDRESS 0xFFF85E30 /end MEASUREMENT
/begin MEASUREMENT z_diag_ersfkt_hi_has_in "Funktionsschnittstelle zur Ermittlung ob irgendeine Ersatzmaßnahme in der Diagnoseverwaltung aktiv ist" ULONG b_int_S6_S3 1 100 0 4294967295 ECU_ADDRESS 0xFFF85E34 /end MEASUREMENT
/begin MEASUREMENT z_diag_notgang_has_in "Notganginformation" UBYTE void_int_S6_S3 1 100 0 255 ECU_ADDRESS 0xFFF8668D /end MEASUREMENT
/begin MEASUREMENT z_emfehler_frk_dihi "Zeigt an, dass eine EM Fehlfunktion erkannt wurde, die in der HAS ausgewertet werden soll" UBYTE void_int_S6_S3 1 100 0 1 ECU_ADDRESS 0xFFF86630 /end MEASUREMENT
/begin MEASUREMENT z_freigabe_pvu_has_sbe "Freigabe zur Aktivierung der Diagnosefunktion \"Positionsventil-Überwachung\" der Funktion zur Unterstützung der Positi-onsventil-Überwachung der HAS" UBYTE void_int_S6_S3 1 100 0 1 ECU_ADDRESS 0xFFF86657 /end MEASUREMENT
/begin MEASUREMENT z_fuwdeakt_frk_dihi "Zeigt an, dass die FUW-Funktion nicht aktiviert werden darf" UBYTE void_int_S6_S3 1 100 0 1 ECU_ADDRESS 0xFFF86631 /end MEASUREMENT
/begin MEASUREMENT z_hybfkt_stg "Anforderung der Aktivierung einer Hybridfunktion durch die Hyrid-Zustandssteuerung" UBYTE E_HYBFKT_S6_S3 1 100 0 15 ECU_ADDRESS 0xFFF86639 /end MEASUREMENT
/begin MEASUREMENT z_iae_entkoppelt_has "Gemessen in Zustart Out" UBYTE void_int_S6_S3 1 100 0 255 ECU_ADDRESS 0xFFF96DC7 /end MEASUREMENT
/begin MEASUREMENT z_iep_in "" UBYTE E_ZIEP_S6_S3 1 100 0 4 ECU_ADDRESS 0xFFF8668E /end MEASUREMENT
/begin MEASUREMENT z_k0_fst_in "" UBYTE E_ZK0FSTIN_S6_S3 1 100 0 3 ECU_ADDRESS 0xFFF8668F /end MEASUREMENT
/begin MEASUREMENT z_k0_has_fkt "" UBYTE E_ZK0_S6_S3 1 100 0 5 ECU_ADDRESS 0xFFF86643 /end MEASUREMENT
/begin MEASUREMENT z_k0_has_sbe "" UBYTE E_ZK0_S6_S3 1 100 0 5 ECU_ADDRESS 0xFFF8665D /end MEASUREMENT
/begin MEASUREMENT z_k0syncmk0erh_frk_dihi "Zeigt an, dass eine K0-Zwangsynchronisation mittels Erhöhung des K0-Moments erfolgen soll" UBYTE void_int_S6_S3 1 100 0 1 ECU_ADDRESS 0xFFF86632 /end MEASUREMENT
/begin MEASUREMENT z_kps_stada_in "Sollvorgabe für die Trennkupplung K0 durch die Stillstandsadaption" UBYTE void_int_S6_S3 1 100 0 255 ECU_ADDRESS 0xFFF86690 /end MEASUREMENT
/begin MEASUREMENT z_modus_em_hst_in "" UBYTE void_int_S6_S3 1 100 0 255 ECU_ADDRESS 0xFFF86691 /end MEASUREMENT
/begin MEASUREMENT z_modus_iae_has_sbe "" UBYTE E_ZMODUSIAE_S6_S3 1 100 0 2 ECU_ADDRESS 0xFFF8665E /end MEASUREMENT
/begin MEASUREMENT z_modus_iep_has_sbe "Vorgabe des Betriebsmodus der IEP durch die HAS" UBYTE E_ZMODUSIEP_S6_S3 1 100 0 4 ECU_ADDRESS 0xFFF8665F /end MEASUREMENT
/begin MEASUREMENT z_msa_avh_moni_has_sbe "Anforderung einer Schaltverhinderung der HAS" UBYTE void_int_S6_S3 1 100 0 255 ECU_ADDRESS 0xFFF86660 /end MEASUREMENT
/begin MEASUREMENT z_msa_eaf_moni_has_sbe "Anforderung einer Schaltverhinderung der HAS" UBYTE void_int_S6_S3 1 100 0 255 ECU_ADDRESS 0xFFF86661 /end MEASUREMENT
/begin MEASUREMENT z_msa_fst_in "Anforderung einer Abschaltverhinderung durch die Fahrstrategie ASIS" UBYTE void_int_S6_S3 1 100 0 255 ECU_ADDRESS 0xFFF86692 /end MEASUREMENT
/begin MEASUREMENT z_msa_has_sbe "Anforderung der Beeinflussung der MSA-Funktionalität durch die Hybridablaufsteuerung - Codierung: bit0 = AVZ, bit1 = AVH, bit2 = EAF, bit3 = EVH, bit4 = Deaktivierung, bit7 = Störungsbedingt" UBYTE void_int_S6_S3 1 100 0 255 ECU_ADDRESS 0xFFF86662 /end MEASUREMENT
/begin MEASUREMENT z_msa_stada_in "" UBYTE void_int_S6_S3 1 100 0 6 ECU_ADDRESS 0xFFF866A1 /end MEASUREMENT
/begin MEASUREMENT z_n_min_em_parksp_has_in "Anforderung einer EM-Drehzahlanhebung beim Auslegen der Parksperre infolge unzureichender Ölversorgung" UBYTE void_int_S6_S3 1 100 0 1 ECU_ADDRESS 0xFFF86693 /end MEASUREMENT
/begin MEASUREMENT z_n_min_iep_in "Anforderung Ausgabe EM-Mindestdrehzahl zur Sicherstellung der Ölversorgung durch die IEP" UBYTE void_int_S6_S3 1 100 0 1 ECU_ADDRESS 0xFFF86694 /end MEASUREMENT
/begin MEASUREMENT z_n_soll_em_aktiv_ans_mes "Gemessen in SLST Input" UBYTE void_int_S6_S3 1 100 0 1 ECU_ADDRESS 0xFFF96DCB /end MEASUREMENT
/begin MEASUREMENT z_nllsoll_iae_in "Anforderung der IAE, dass eine definierte LL-Drehzahl durch den Motor eingestellt werden soll" UBYTE E_ZNLLSOLL_S6_S3 1 100 0 2 ECU_ADDRESS 0xFFF86695 /end MEASUREMENT
/begin MEASUREMENT z_nminemnull_frk_dihi "Zeigt an, dass die Ausgabe der minimalen EM Drehzahl der HAS unterdrückt werden soll." UBYTE void_int_S6_S3 1 100 0 1 ECU_ADDRESS 0xFFF86633 /end MEASUREMENT
/begin MEASUREMENT z_nvmsollbegr_frk_dihi "Zeigt an, dass die VM-Solldrehzahl auf die EM-Istdrehzahl be-grenzt werden soll" UBYTE void_int_S6_S3 1 100 0 1 ECU_ADDRESS 0xFFF86634 /end MEASUREMENT
/begin MEASUREMENT z_pvu_has_sbe "Beeinflussung des Hybridsystems zur Unterstützung der Positionsventil- Überwachung der HAS-Codierung: 0 = keine Beeinflussung, 1 = Beeinflussung Stufe 1, 2 = Beeinflussung Stufe 2" UBYTE void_int_S6_S3 1 100 0 2 ECU_ADDRESS 0xFFF86658 /end MEASUREMENT
/begin MEASUREMENT z_respschleschaltaktiv_ans "Gemessen in Schleppstart/Input" UBYTE void_int_S6_S3 1 100 0 255 ECU_ADDRESS 0xFFF96DCC /end MEASUREMENT
/begin MEASUREMENT z_sas_has_sbe "Ändert im Wahrheitsfall die KupplungsBefüllreihenfolge" UBYTE void_int_S6_S3 1 100 0 1 ECU_ADDRESS 0xFFF86663 /end MEASUREMENT
/begin MEASUREMENT z_start_modus_has_sbe "Anforderung eines Anlasserstarts" UBYTE void_int_S6_S3 1 100 0 255 ECU_ADDRESS 0xFFF86664 /end MEASUREMENT
/begin MEASUREMENT z_status_psys_mps_sbe "Flag, das eine Modifikation des Pumpendruckstatus anzeigt" UBYTE void_int_S6_S3 1 100 0 1 ECU_ADDRESS 0xFFF86659 /end MEASUREMENT
/begin MEASUREMENT z_svh_has_sbe "Anforderung einer Schaltverhinderung der HAS" UBYTE void_int_S6_S3 1 100 0 1 ECU_ADDRESS 0xFFF86665 /end MEASUREMENT
/begin MEASUREMENT z_t10max_ans "Gemessen in St_SLST_Abbruch_Ans_En_St" UBYTE void_int_S6_S3 1 100 0 255 ECU_ADDRESS 0xFFF96DCF /end MEASUREMENT
/begin MEASUREMENT z_t2max_ans "Gemessen in St_Anschleppen_Ans_En_St" UBYTE void_int_S6_S3 1 100 0 255 ECU_ADDRESS 0xFFF96DD0 /end MEASUREMENT
/begin MEASUREMENT z_t3max_ans "Gemessen in St_VM_zuenden_En_St" UBYTE void_int_S6_S3 1 100 0 255 ECU_ADDRESS 0xFFF96DD1 /end MEASUREMENT
/begin MEASUREMENT z_t4max_ans "Gemessen in St_K0_Synchronisieren_En_St" UBYTE void_int_S6_S3 1 100 0 255 ECU_ADDRESS 0xFFF96DD2 /end MEASUREMENT
/begin MEASUREMENT z_t5max_ans "Gemessen in St_K0_Schliessen_En_St" UBYTE void_int_S6_S3 1 100 0 255 ECU_ADDRESS 0xFFF96DD3 /end MEASUREMENT
/begin MEASUREMENT z_ziel_kraftfluss_egs_in "" UBYTE void_int_S6_S3 1 100 0 255 ECU_ADDRESS 0xFFF86696 /end MEASUREMENT
/begin MEASUREMENT zielgang_egs_in "" SBYTE void_int_S6_S3 1 100 -128 127 ECU_ADDRESS 0xFFF86697 /end MEASUREMENT
/begin FUNCTION SFOp_NOS51_ac___ieren_nos_en_st "" /begin DEF_CHARACTERISTIC MO_SOLLK0MPS_KON_NOS /end DEF_CHARACTERISTIC
 /begin LOC_MEASUREMENT m_k0_in n_em_in n_vm_in nd_k0_in status_k0_in status_psys_has_sbe z_ablauf_has_stg z_status_psys_mps_sbe /end LOC_MEASUREMENT
/end FUNCTION
/begin FUNCTION SFOp_NOS55_Entry "" /begin DEF_CHARACTERISTIC STATUS_ABL_ABBRUCH_AKTIV SWI_ZPHYSK0_ABB_NOS /end DEF_CHARACTERISTIC /end FUNCTION
/begin FUNCTION SFOp_NOS6_Input ""
 /begin LOC_MEASUREMENT abstellpos_vm_in abstellpos_vm_status_in c_getriebe_egs_in c_vm_in gangwechsel_egs_in i_istgang_egs i_zielgang_egs istgang_egs_in m_em_in m_iae_in m_k0_in m_k0_mber_has_sbe m_k0_mod_has_fkt m_max_dyn_em_in m_min_dyn_em_in m_min_vm_in m_mot_in m_motmax_has m_soll_em_hst_in m_soll_k0_has_fkt m_soll_res_em_bas_sbe m_soll_res_em_has_sbe m_soll_vm_hst_in m_soll_vm_l_hst_in m_vm_in m_vm_start_in m_wunsch_fpw_hst_fil m_wunsch_fpw_hst_in m_wunsch_fpw_in mg_wunsch_fpw mg_wunsch_fpw_hst n_ab_egs_in n_em_in n_min_em_has_sbe n_min_psys_em_has_sbe n_mot_soll_iae_in n_sec_iae n_soll_em_hst_in n_soll_ll_vm_in n_t_egs_in n_vm_in nd_iae nd_k0_in ndg_k0_in ng_vm osmode_next_in p_bremse_fzg_in phi_neigung_in pos_egs_in sollgang_egs_in st_OMLID_act_stg st_ist_bz_has_stg st_soll_bz_has_hst st_ziel_bz_has_stg status_alaengs_adaoff_in status_betriebsbereit_hst_in status_efahren_has_sbe status_fehler15_eh_diagin status_fehler_iep_in status_iae_adap_in status_iae_in status_iep_in status_k0_adap_in status_k0_in status_kl15_in status_kolbenpos_k0_in status_kraftfluss_egs_in status_kraftfluss_egs_roh_in status_ll_vm_in status_nem_in status_nreg_em_hst_in status_nvm_in status_posvueb_in status_psys_has_sbe status_sa_vm_in status_schaltart_svh_has_sbe status_schaltung_egs_in status_sync_schaltung_sbe status_waschstr_in status_zug_svh_sbe t_betrieb_pvu_has_ee_in t_betrieb_pvu_has_sbe v_f_sbe vg_f_sbe z_ablauf_has_hst_in z_ablauf_has_stg z_ablaufreinit_frk_dihi z_ablaufvariante_has_hst_in z_ablaufvariante_has_stg z_ba_has_k0_hst_in z_ba_has_vm_hst_in z_diag_ersfkt_has_in z_diag_ersfkt_hi_has_in z_diag_notgang_has_in z_emfehler_frk_dihi z_freigabe_pvu_has_sbe z_fuwdeakt_frk_dihi z_hybfkt_stg z_iep_in z_k0_fst_in z_k0_has_fkt z_k0_has_sbe z_k0syncmk0erh_frk_dihi z_kps_stada_in z_modus_em_hst_in z_modus_iae_has_sbe z_modus_iep_has_sbe z_msa_avh_moni_has_sbe z_msa_eaf_moni_has_sbe z_msa_fst_in z_msa_has_sbe z_msa_stada_in z_n_min_em_parksp_has_in z_n_min_iep_in z_nllsoll_iae_in z_nminemnull_frk_dihi z_nvmsollbegr_frk_dihi z_pvu_has_sbe z_sas_has_sbe z_start_modus_has_sbe z_status_psys_mps_sbe z_svh_has_sbe z_ziel_kraftfluss_egs_in zielgang_egs_in /end LOC_MEASUREMENT
/end FUNCTION
/begin FUNCTION SFOp_NOS70_ac_notstarten_nos_en "" /begin DEF_CHARACTERISTIC STATUS_ABL_NST_NOS SWI_ZPHYSK0_NST_NOS /end DEF_CHARACTERISTIC /end FUNCTION
/begin FUNCTION SFOp_NOS71_ac___arten_nos_en_st ""
 /begin SUB_FUNCTION Run_SFOp_NOS75__mer_max_nst_nos Run_SFOp_NOS78__t_ndsk0_nst_nos Run_SFOp_NOS77__r_m_soll_k0_has Run_SFOp_NOS80__mer_ums_nst_nos /end SUB_FUNCTION
 /begin DEF_CHARACTERISTIC MG_K0SOLL1_NST_NOS MG_K0SOLL2_NST_NOS M_SOLLK0INIMPS_NST_NOS M_SOLLK0INI_NST_NOS M_SOLLK0ZIEL1_NOS M_SOLLK0ZIEL2_NOS NDS_K0_NST_NOS NS_VM_UMS_NST_NOS T_MAX_NST_NOS T_NDSK0_NST_NOS T_UMS_NST_NOS /end DEF_CHARACTERISTIC
 /begin LOC_MEASUREMENT SFOp_NOS75_isActive_ SFOp_NOS77_out_ SFOp_NOS78_isActive_ m_k0_in m_soll_k0_ziel_nos_mess n_em_in n_vm_in nd_k0_in status_k0_in status_psys_has_sbe t_max_nst_nos_mess t_ndsk0_nst_nos_mess t_ums_nst_nos_mess z_ablauf_has_stg z_status_psys_mps_sbe /end LOC_MEASUREMENT
/end FUNCTION
/begin FUNCTION SFOp_NOS91_ac_uebergabe_nos_en "" /begin DEF_CHARACTERISTIC SWI_ZPHYSK0_UEB_NOS /end DEF_CHARACTERISTIC /end FUNCTION
/begin FUNCTION SFOp_NOS92_ac___rgabe_nos_en_st ""
 /begin LOC_MEASUREMENT m_k0_in n_em_in n_vm_in nd_k0_in status_k0_in status_psys_has_sbe z_ablauf_has_stg z_status_psys_mps_sbe /end LOC_MEASUREMENT
/end FUNCTION
/begin FUNCTION SFOp_NOS96_Entry "" /begin DEF_CHARACTERISTIC STATUS_ABL_ABBRUCH_FERTIG SWI_ZPHYSK0_UEA_NOS /end DEF_CHARACTERISTIC /end FUNCTION
/begin FUNCTION SFOp_NOS9_St_Ablauf ""
 /begin SUB_FUNCTION SFOp_NOS39_st___art_abbruch_nos SFOp_NOS38_st_uebergabe SFOp_NOS37_st_notstarten_nos SFOp_NOS36_st___art_abbruch_nos SFOp_NOS35_st___ditionieren_nos SFOp_NOS34_st_k0schliessen_nos /end SUB_FUNCTION
/end FUNCTION
/begin FUNCTION SFOp_OhneAb5_Input ""
 /begin LOC_MEASUREMENT c_getriebe_egs_in gangwechsel_egs_in istgang_egs_in m_em_in m_iae_in m_k0_in m_max_dyn_em_in m_min_dyn_em_in m_mot_in m_soll_em_hst_in m_soll_vm_hst_in m_vm_in m_vm_start_in m_wunsch_fpw_in n_ab_egs_in n_em_in n_mot_soll_iae_in n_soll_ll_vm_in n_t_egs_in n_vm_in osmode_next_in p_bremse_fzg_in phi_neigung_in pos_egs_in sollgang_egs_in status_alaengs_adaoff_in status_fehler_iep_in status_iae_adap_in status_iae_in status_iep_in status_k0_adap_in status_k0_in status_kolbenpos_k0_in status_kraftfluss_egs_in status_kraftfluss_egs_roh_in status_ll_vm_in status_nem_in status_nvm_in status_posvueb_in status_waschstr_in t_betrieb_pvu_has_ee_in z_ablauf_has_hst_in z_ablaufvariante_has_hst_in z_diag_ersfkt_has_in z_diag_ersfkt_hi_has_in z_diag_notgang_has_in z_iep_in z_k0_fst_in z_kps_stada_in z_modus_em_hst_in z_msa_fst_in z_n_min_em_parksp_has_in z_n_min_iep_in z_nllsoll_iae_in z_ziel_kraftfluss_egs_in zielgang_egs_in /end LOC_MEASUREMENT
/end FUNCTION
/begin FUNCTION SFOp_Passiv10___le_K0_geoeffnet "" /begin DEF_CHARACTERISTIC TAB_ZPHYSK0_PASSIV_HAS /end DEF_CHARACTERISTIC /begin LOC_MEASUREMENT st_ist_bz_has_stg /end LOC_MEASUREMENT /end FUNCTION
/begin FUNCTION SFOp_Passiv11____K0_geschlossen "" /begin DEF_CHARACTERISTIC TAB_ZPHYSK0_PASSIV_HAS /end DEF_CHARACTERISTIC /begin LOC_MEASUREMENT st_ist_bz_has_stg /end LOC_MEASUREMENT /end FUNCTION
/begin FUNCTION SFOp_Passiv2_Action_Passiv2 ""
 /begin SUB_FUNCTION SFOp_Passiv11____K0_geschlossen SFOp_Passiv10___le_K0_geoeffnet /end SUB_FUNCTION
 /begin LOC_MEASUREMENT abstellpos_vm_in abstellpos_vm_status_in c_getriebe_egs_in c_vm_in gangwechsel_egs_in i_istgang_egs i_zielgang_egs istgang_egs_in m_em_in m_iae_in m_k0_in m_k0_mber_has_sbe m_k0_mod_has_fkt m_max_dyn_em_in m_min_dyn_em_in m_min_vm_in m_mot_in m_motmax_has m_soll_em_hst_in m_soll_k0_has_fkt m_soll_res_em_bas_sbe m_soll_res_em_has_sbe m_soll_vm_hst_in m_soll_vm_l_hst_in m_vm_in m_vm_start_in m_wunsch_fpw_hst_fil m_wunsch_fpw_hst_in m_wunsch_fpw_in mg_wunsch_fpw mg_wunsch_fpw_hst n_ab_egs_in n_em_in n_min_em_has_sbe n_min_psys_em_has_sbe n_mot_soll_iae_in n_sec_iae n_soll_em_hst_in n_soll_ll_vm_in n_t_egs_in n_vm_in nd_iae nd_k0_in ndg_k0_in ng_vm osmode_next_in p_bremse_fzg_in phi_neigung_in pos_egs_in sollgang_egs_in st_OMLID_act_stg st_ist_bz_has_stg st_soll_bz_has_hst st_ziel_bz_has_stg status_alaengs_adaoff_in status_betriebsbereit_hst_in status_efahren_has_sbe status_fehler15_eh_diagin status_fehler_iep_in status_iae_adap_in status_iae_in status_iep_in status_k0_adap_in status_k0_in status_kl15_in status_kolbenpos_k0_in status_kraftfluss_egs_in status_kraftfluss_egs_roh_in status_ll_vm_in status_nem_in status_nreg_em_hst_in status_nvm_in status_posvueb_in status_psys_has_sbe status_sa_vm_in status_schaltart_svh_has_sbe status_schaltung_egs_in status_sync_schaltung_sbe status_waschstr_in status_zug_svh_sbe t_betrieb_pvu_has_ee_in t_betrieb_pvu_has_sbe v_f_sbe vg_f_sbe z_ablauf_has_hst_in z_ablauf_has_stg z_ablaufreinit_frk_dihi z_ablaufvariante_has_hst_in z_ablaufvariante_has_stg z_ba_has_k0_hst_in z_ba_has_vm_hst_in z_diag_ersfkt_has_in z_diag_ersfkt_hi_has_in z_diag_notgang_has_in z_emfehler_frk_dihi z_freigabe_pvu_has_sbe z_fuwdeakt_frk_dihi z_hybfkt_stg z_iep_in z_k0_fst_in z_k0_has_fkt z_k0_has_sbe z_k0syncmk0erh_frk_dihi z_kps_stada_in z_modus_em_hst_in z_modus_iae_has_sbe z_modus_iep_has_sbe z_msa_avh_moni_has_sbe z_msa_eaf_moni_has_sbe z_msa_fst_in z_msa_has_sbe z_msa_stada_in z_n_min_em_parksp_has_in z_n_min_iep_in z_nllsoll_iae_in z_nminemnull_frk_dihi z_nvmsollbegr_frk_dihi z_pvu_has_sbe z_sas_has_sbe z_start_modus_has_sbe z_status_psys_mps_sbe z_svh_has_sbe z_ziel_kraftfluss_egs_in zielgang_egs_in /end LOC_MEASUREMENT
/end FUNCTION
/begin FUNCTION SFOp_SLST10_St_Start "" /begin SUB_FUNCTION SFOp_SLST526_Entry /end SUB_FUNCTION /begin DEF_CHARACTERISTIC K_SVH_RESET_SRT_ANS /end DEF_CHARACTERISTIC /end FUNCTION
/begin FUNCTION SFOp_SLST160_Schleppstart ""
 /begin SUB_FUNCTION SFOp_SLST171_St_VM_zuenden_Ans SFOp_SLST170_S__SLSTAbbruch_Ans SFOp_SLST169_S__LST_Abbruch_Ans SFOp_SLST168_S__ditionieren_Ans SFOp_SLST167_S__hronisieren_Ans SFOp_SLST166_S___Schliessen_Ans SFOp_SLST165_St_Anschleppen_Ans SFOp_SLST178_zuenden SFOp_SLST177_synchronisieren SFOp_SLST176_slst_abbruch SFOp_SLST175_konditionieren SFOp_SLST174_k0_schliessen SFOp_SLST173_anschleppen SFOp_SLST172_Gradient /end SUB_FUNCTION
 /begin LOC_MEASUREMENT abstellpos_vm_in abstellpos_vm_status_in c_getriebe_egs_in c_vm_in gangwechsel_egs_in i_istgang_egs i_zielgang_egs istgang_egs_in m_em_in m_iae_in m_k0_in m_max_dyn_em_in m_min_vm_in m_mot_in m_soll_em_hst_in m_soll_vm_hst_in m_soll_vm_l_hst_in m_stoer_k0_em_fil m_vm_in m_vm_start_in m_wunsch_fpw_hst_fil m_wunsch_fpw_hst_in m_wunsch_fpw_in m_ziel_vm_has_ans n_ab_egs_in n_em_in n_min_psys_em_has_sbe n_mot_soll_iae_in n_sec_iae n_soll_ll_vm_in n_vm_in nd_iae nd_k0_in ndg_k0_in ng_vm sollgang_egs_in status_iae_in status_k0_in status_kraftfluss_egs_in status_ll_vm_in status_schaltung_egs_in status_sync_schaltung_sbe status_zug_svh_sbe z_ablauf_has_hst_in z_ablauf_has_stg z_ablaufvariante_has_stg z_iae_entkoppelt_has z_modus_em_hst_in z_n_soll_em_aktiv_ans_mes z_respschleschaltaktiv_ans z_svh_has_sbe zielgang_egs_in /end LOC_MEASUREMENT
/end FUNCTION
/begin FUNCTION SFOp_SLST161_St_Schaltung_aktiv "" /begin SUB_FUNCTION SFOp_SLST498_Entry_Static SFOp_SLST497_Entry /end SUB_FUNCTION /begin DEF_CHARACTERISTIC STATUS_ABL_100_ANS /end DEF_CHARACTERISTIC /begin LOC_MEASUREMENT SFOp_SLST509_isActive_ /end LOC_MEASUREMENT /end FUNCTION
/begin FUNCTION SFOp_SLST162_St_Uebergabe "" /begin SUB_FUNCTION SFOp_SLST522_Entry /end SUB_FUNCTION /end FUNCTION
/begin FUNCTION SFOp_SLST165_St_Anschleppen_Ans ""
 /begin SUB_FUNCTION Run_SFOp_SLST2__cTimer_2Max_Ans Run_SFOp_SLST246_cTimerState Run_SFOp_SLST276_CL_PT1_sec_ Run_SFOp_SLST2__TimerDownMgK0Vz Run_SFOp_SLST2__radient_MSollK0 Run_SFOp_SLST2__erDownOFFSETMK0 Run_SFOp_SLST2__radient_MMaxIae SFOp_SLST233_Entry /end SUB_FUNCTION
 /begin DEF_CHARACTERISTIC FK_14NSOLLVM_ANS F_1NDSOLLIAESTAT_ANS KF_14NOEMNSOLLVMIAEENTK_ANS_W KF_14NOEMNSOLLVMIAEENTK_ANS_X KF_14NOEMNSOLLVMIAEENTK_ANS_Y KF_14NOEMNSOLLVM_ANS_W KF_14NOEMNSOLLVM_ANS_X KF_14NOEMNSOLLVM_ANS_Y KF_2MGSOLLK0MVMMIN_ANS_W KF_2MGSOLLK0MVMMIN_ANS_X KF_2MGSOLLK0MVMMIN_ANS_Y KF_2MGSOLLK0MVMSTART_ANS_W KF_2MGSOLLK0MVMSTART_ANS_X KF_2MGSOLLK0MVMSTART_ANS_Y KF_2MGSOLLK0VMMIN_ANS_W KF_2MGSOLLK0VMMIN_ANS_X KF_2MGSOLLK0VMMIN_ANS_Y KF_2MGSOLLK0VMSTART_ANS_W KF_2MGSOLLK0VMSTART_ANS_X KF_2MGSOLLK0VMSTART_ANS_Y KF_2MK0CGETRMMOT2_ANS_W KF_2MK0CGETRMMOT2_ANS_X KF_2MK0CGETRMMOT2_ANS_Y KF_2MK0CGETRMMOT2_SCHUB_ANS_W KF_2MK0CGETRMMOT2_SCHUB_ANS_X KF_2MK0CGETRMMOT2_SCHUB_ANS_Y KF_2MK0MMOTNVM2_ANS_W KF_2MK0MMOTNVM2_ANS_X KF_2MK0MMOTNVM2_ANS_Y KF_2MK0MMOTNVM2_SCHUB_ANS_W KF_2MK0MMOTNVM2_SCHUB_ANS_X KF_2MK0MMOTNVM2_SCHUB_ANS_Y KL_24NDSOLLIAEABLVAR_ANS_X KL_24NDSOLLIAEABLVAR_ANS_Y KL_2FMK0CGETRMMOT2_ANS_X KL_2FMK0CGETRMMOT2_ANS_Y KL_2FMK0CGETRMMOT2_SCHUB_ANS_X KL_2FMK0CGETRMMOT2_SCHUB_ANS_Y KL_2FMK0MMOTNVM2_ANS_X KL_2FMK0MMOTNVM2_ANS_Y KL_2FMK0MMOTNVM2_SCHUB_ANS_X KL_2FMK0MMOTNVM2_SCHUB_ANS_Y KL_2MGSOLLK0_ANS_X KL_2MGSOLLK0_ANS_Y KL_2MGSOLLK0_SCHUB_ANS_X KL_2MGSOLLK0_SCHUB_ANS_Y KL_2MK0MVMSTART_ANS_X KL_2MK0MVMSTART_ANS_Y KL_2NDIAEEMMAXIAE_ANS_X KL_2NDIAEEMMAXIAE_ANS_Y K_2MSTOERKPL_ANS K_SVH_RESET_SST_ANS MG_2K0OFFSET_ANS MG_2MOMAXIAE1_ANS MG_2MOMAXIAE2_ANS MO_14MEM_ANS MO_2SOLLKPL_ANS MS23_MZIELPHYSK0 MS_14ZMSOLLEMAKTIV_ANS MS_2K0STATUSABL_ANS MS_2MINVMMGSOLLK0_ANS MS_MMAXIAEINAKTIV_ANS MS_RESEM_ANS_ANS NS_2MGK0MINVMSTARTVM_ANS NS_2MOK0ABSTELLPOSNVM_ANS STATUS_24K0ZMSOLLEMAKTIV_ANS STATUS_2ABLVMDREHT_HST_ANS STATUS_2ABLVMFEHLER_HST_ANS STATUS_2ABLVMLAEUFT_HST_ANS STATUS_ABL_102_ANS STATUS_ABL_K0ENTK_102_ANS SWI_102_ZPHYSK0_ANS SWI_14NONSOLLVMIAEENTK_ANS SWI_16ZNSOLLEMAKTIV_ANS SWI_24MSTOERK0EMMK0_ANS SWI_2MGSOLLK0_ANS SWI_2UMSCHLMMOTNGVM_ANS SWI_2ZMSOLLEM_ANS SWI_2ZNSOLLEM_ANS SWI_2ZNSOLL_VMAKTIV_ANS SWI_MK0MOD_HAS_ANS SWI_UMSCH_ZVMSTARTFEHLER_ANS T_23VZMSOLLK0_ANS T_2MAX_ANS T_2MIN_ANS T_2MK0OFFSET_ANS T_VZMGK0_ANS /end DEF_CHARACTERISTIC
 /begin LOC_MEASUREMENT SFOp_SLST246_isActive_ SFOp_SLST252_out_ SFOp_SLST266_isActive_ SFOp_SLST394_out_ abstellpos_vm_in abstellpos_vm_status_in c_getriebe_egs_in c_vm_in gangwechsel_egs_in i_istgang_egs i_zielgang_egs istgang_egs_in m_em_in m_iae_in m_k0_in m_max_dyn_em_in m_min_vm_in m_mot_in m_soll_em_hst_in m_soll_vm_hst_in m_soll_vm_l_hst_in m_stoer_k0_em_fil m_vm_in m_vm_start_in m_wunsch_fpw_hst_fil m_wunsch_fpw_hst_in m_wunsch_fpw_in m_ziel_vm_has_ans n_ab_egs_in n_em_in n_min_psys_em_has_sbe n_mot_soll_iae_in n_sec_iae n_soll_ll_vm_in n_vm_in nd_iae nd_k0_in ndg_k0_in ng_vm sollgang_egs_in status_iae_in status_k0_in status_kraftfluss_egs_in status_ll_vm_in status_schaltung_egs_in status_sync_schaltung_sbe status_zug_svh_sbe t_2max_ans_mes z_ablauf_has_hst_in z_ablauf_has_stg z_ablaufvariante_has_stg z_iae_entkoppelt_has z_modus_em_hst_in z_n_soll_em_aktiv_ans_mes z_respschleschaltaktiv_ans z_svh_has_sbe z_t2max_ans zielgang_egs_in /end LOC_MEASUREMENT
/end FUNCTION
/begin FUNCTION SFOp_SLST166_S___Schliessen_Ans ""
 /begin SUB_FUNCTION Run_SFOp_SLST2__cTimer_5Max_Ans Run_SFOp_SLST2__miter_Gradient_ Run_SFOp_SLST2__adient_MMaxIae1 SFOp_SLST286_Entry /end SUB_FUNCTION
 /begin DEF_CHARACTERISTIC KL_MGK0MODMAX_SCL_ANS_X KL_MGK0MODMAX_SCL_ANS_Y MG_5MOMAXIAE_ANS MS_35ABEGSMMMINVMLLEMHAS_ANS MS_MMAXIAEINAKTIV_ANS M_35MINEMVMLLHAS_ANS M_45MINEMHAS_ANS STATUS_ABL_105_ANS SWI_16ZNSOLLEMAKTIV_ANS SWI_5ZMMAXIAE_ANS SWI_5ZMSOLLEM_NULL_ANS SWI_5ZNSOLLEM_ANS T_5MAX_ANS /end DEF_CHARACTERISTIC
 /begin LOC_MEASUREMENT SFOp_SLST295_out_ SFOp_SLST327_out_ abstellpos_vm_in abstellpos_vm_status_in c_getriebe_egs_in c_vm_in gangwechsel_egs_in i_istgang_egs i_zielgang_egs istgang_egs_in m_em_in m_iae_in m_k0_in m_max_dyn_em_in m_min_vm_in m_mot_in m_soll_em_hst_in m_soll_vm_hst_in m_soll_vm_l_hst_in m_stoer_k0_em_fil m_vm_in m_vm_start_in m_wunsch_fpw_hst_fil m_wunsch_fpw_hst_in m_wunsch_fpw_in m_ziel_vm_has_ans n_ab_egs_in n_em_in n_min_psys_em_has_sbe n_mot_soll_iae_in n_sec_iae n_soll_ll_vm_in n_vm_in nd_iae nd_k0_in ndg_k0_in ng_vm sollgang_egs_in status_iae_in status_k0_in status_kraftfluss_egs_in status_ll_vm_in status_schaltung_egs_in status_sync_schaltung_sbe status_zug_svh_sbe t_5max_ans_mes z_ablauf_has_hst_in z_ablauf_has_stg z_ablaufvariante_has_stg z_iae_entkoppelt_has z_modus_em_hst_in z_n_soll_em_aktiv_ans_mes z_respschleschaltaktiv_ans z_svh_has_sbe z_t5max_ans zielgang_egs_in /end LOC_MEASUREMENT
/end FUNCTION
/begin FUNCTION SFOp_SLST167_S__hronisieren_Ans ""
 /begin SUB_FUNCTION Run_SFOp_SLST3__cTimer_4Max_Ans Run_SFOp_SLST352_CL_PT1_sec_ SFOp_SLST355_Enabled_Subsystem1 Run_SFOp_SLST3__radient_MSollK0 Run_SFOp_SLST3__miter_Gradient_ Run_SFOp_SLST3__NCHRON_DEFAULT_ Run_SFOp_SLST3__adient_MMaxIae1 SFOp_SLST310_Entry /end SUB_FUNCTION
 /begin DEF_CHARACTERISTIC FK_14NSOLLVM_ANS F_1NDSOLLIAESTAT_ANS KF_4MGSOLLK0_ANS_W KF_4MGSOLLK0_ANS_X KF_4MGSOLLK0_ANS_Y KF_4MGSOLLK0_SCHUB_ANS_W KF_4MGSOLLK0_SCHUB_ANS_X KF_4MGSOLLK0_SCHUB_ANS_Y KL_4FMGK0ISTGANG_ANS_X KL_4FMGK0ISTGANG_ANS_Y KL_4NDIAEEMMAXIAE_ANS_X KL_4NDIAEEMMAXIAE_ANS_Y KL_MGK0MODMAX_SYN_ANS_X KL_MGK0MODMAX_SYN_ANS_Y KL_MGK0MODMIN_SYN_ANS_X KL_MGK0MODMIN_SYN_ANS_Y K_4MSTOERKPL_ANS MG_4MOMAXIAE1_ANS MG_4MOMAXIAE2_ANS MO_14MEM_ANS MS_14ZMSOLLEMAKTIV_ANS MS_MMAXIAEINAKTIV_ANS M_35MINEMVMLLHAS_ANS M_45MINEMHAS_ANS NS_35ABEGSMMMINVMLLEMHAS_ANS STATUS_24K0ZMSOLLEMAKTIV_ANS STATUS_ABL_104_ANS SWI_16ZNSOLLEMAKTIV_ANS SWI_24MSTOERK0EMMK0_ANS SWI_4ZMSOLLEM_ANS SWI_4ZNSOLLEM_ANS SWI_4ZNSOLL_VMAKTIV_ANS TAB_4NDSSYNC_ANS TAB_4TMINHAFTEN_ANS T_4MAX_ANS T_NDG T_VORSYNC /end DEF_CHARACTERISTIC
 /begin LOC_MEASUREMENT SFOp_SLST327_out_ SFOp_SLST333_haften_b_ SFOp_SLST334_out_ SFOp_SLST469_out_ abstellpos_vm_in abstellpos_vm_status_in c_getriebe_egs_in c_vm_in gangwechsel_egs_in i_istgang_egs i_zielgang_egs istgang_egs_in m_em_in m_iae_in m_k0_in m_max_dyn_em_in m_min_vm_in m_mot_in m_soll_em_hst_in m_soll_vm_hst_in m_soll_vm_l_hst_in m_stoer_k0_em_fil m_vm_in m_vm_start_in m_wunsch_fpw_hst_fil m_wunsch_fpw_hst_in m_wunsch_fpw_in m_ziel_vm_has_ans n_ab_egs_in n_em_in n_min_psys_em_has_sbe n_mot_soll_iae_in n_sec_iae n_soll_ll_vm_in n_vm_in nd_iae nd_k0_in ndg_k0_in ng_vm sollgang_egs_in status_iae_in status_k0_in status_kraftfluss_egs_in status_ll_vm_in status_schaltung_egs_in status_sync_schaltung_sbe status_zug_svh_sbe t_4max_ans_mes z_ablauf_has_hst_in z_ablauf_has_stg z_ablaufvariante_has_stg z_iae_entkoppelt_has z_modus_em_hst_in z_n_soll_em_aktiv_ans_mes z_respschleschaltaktiv_ans z_svh_has_sbe z_t4max_ans zielgang_egs_in /end LOC_MEASUREMENT
/end FUNCTION
/begin FUNCTION SFOp_SLST168_S__ditionieren_Ans ""
 /begin SUB_FUNCTION Run_SFOp_SLST420_CL_PT1_sec_ SFOp_SLST406_Vorgaben_LP3 Run_SFOp_SLST3__er_WAITSCHLUPF_ Run_SFOp_SLST3__radient_MMaxIae Run_SFOp_SLST389_cTimer_T1MAX SFOp_SLST374_Entry /end SUB_FUNCTION
 /begin DEF_CHARACTERISTIC FK_14NSOLLVM_ANS F_1NDSOLLIAESTAT_ANS KF_14NOEMNSOLLVMIAEENTK_ANS_W KF_14NOEMNSOLLVMIAEENTK_ANS_X KF_14NOEMNSOLLVMIAEENTK_ANS_Y KF_14NOEMNSOLLVM_ANS_W KF_14NOEMNSOLLVM_ANS_X KF_14NOEMNSOLLVM_ANS_Y KF_1FNDSOLLIAE_ANS_W KF_1FNDSOLLIAE_ANS_X KF_1FNDSOLLIAE_ANS_Y KL_1NDIAEEMMAXIAE_ANS_X KL_1NDIAEEMMAXIAE_ANS_Y K_1MSTOERKPL_ANS K_SVH_RESET_KON_ANS MG_1MOMAXIAE1_ANS MG_1MOMAXIAE2_ANS MO_14MEM_ANS MS_14ZMSOLLEMAKTIV_ANS MS_MMAXIAEINAKTIV_ANS MS_RESEM_KON_ANS STATUS_1K0ZMSOLLEMAKTIV_ANS STATUS_ABL_101_ANS STATUS_ABL_101_ZNSOLLEM_ANS SWI_01MSTOERK0EMFILMK0_ANS SWI_01MSTOERK0EMMK0_ANS SWI_14NONSOLLVMIAEENTK_ANS SWI_16ZNSOLLEMAKTIV_ANS SWI_1MSOLLEM_NULL_ANS SWI_1ZMSOLLEM_ANS SWI_1ZNSOLLEM_ANS T_1MAX_ANS T_1WAITSCHLUPF_ANS /end DEF_CHARACTERISTIC
 /begin LOC_MEASUREMENT SFOp_SLST394_out_ abstellpos_vm_in abstellpos_vm_status_in c_getriebe_egs_in c_vm_in gangwechsel_egs_in i_istgang_egs i_zielgang_egs istgang_egs_in m_em_in m_iae_in m_k0_in m_max_dyn_em_in m_min_vm_in m_mot_in m_soll_em_hst_in m_soll_vm_hst_in m_soll_vm_l_hst_in m_stoer_k0_em_fil m_vm_in m_vm_start_in m_wunsch_fpw_hst_fil m_wunsch_fpw_hst_in m_wunsch_fpw_in m_ziel_vm_has_ans mg_soll_k0_kon_ans n_ab_egs_in n_em_in n_min_psys_em_has_sbe n_mot_soll_iae_in n_sec_iae n_soll_ll_vm_in n_vm_in nd_iae nd_k0_in ndg_k0_in ng_vm sollgang_egs_in status_iae_in status_k0_in status_kraftfluss_egs_in status_ll_vm_in status_schaltung_egs_in status_sync_schaltung_sbe status_zug_svh_sbe t_1waitschlupf_ans_mes z_ablauf_has_hst_in z_ablauf_has_stg z_ablaufvariante_has_stg z_iae_entkoppelt_has z_modus_em_hst_in z_n_soll_em_aktiv_ans_mes z_respschleschaltaktiv_ans z_svh_has_sbe zielgang_egs_in /end LOC_MEASUREMENT
/end FUNCTION
/begin FUNCTION SFOp_SLST169_S__LST_Abbruch_Ans ""
 /begin SUB_FUNCTION Run_SFOp_SLST4__Max_slstabb_Ans Run_SFOp_SLST4__radient_MSollK0 SFOp_SLST424_Entry /end SUB_FUNCTION
 /begin DEF_CHARACTERISTIC K_10MSTOERKPL_ANS MG_10SOLLK0_ANS MS_14ZMSOLLEMAKTIV_ANS MS_MMAXIAEINAKTIV_ANS STATUS_24K0ZMSOLLEMAKTIV_ANS STATUS_ABL_ABBRUCH_AKTIV SWI_10ZMSOLLEM_ANS SWI_10ZNSOLLEM_ANS SWI_16ZNSOLLEMAKTIV_ANS SWI_24MSTOERK0EMMK0_ANS SWI_MK0MOD_HAS_ANS T_10MAX_ANS /end DEF_CHARACTERISTIC
 /begin LOC_MEASUREMENT abstellpos_vm_in abstellpos_vm_status_in c_getriebe_egs_in c_vm_in gangwechsel_egs_in i_istgang_egs i_zielgang_egs istgang_egs_in m_em_in m_iae_in m_k0_in m_max_dyn_em_in m_min_vm_in m_mot_in m_soll_em_hst_in m_soll_vm_hst_in m_soll_vm_l_hst_in m_stoer_k0_em_fil m_vm_in m_vm_start_in m_wunsch_fpw_hst_fil m_wunsch_fpw_hst_in m_wunsch_fpw_in m_ziel_vm_has_ans n_ab_egs_in n_em_in n_min_psys_em_has_sbe n_mot_soll_iae_in n_sec_iae n_soll_ll_vm_in n_vm_in nd_iae nd_k0_in ndg_k0_in ng_vm sollgang_egs_in status_iae_in status_k0_in status_kraftfluss_egs_in status_ll_vm_in status_schaltung_egs_in status_sync_schaltung_sbe status_zug_svh_sbe t_10max_ans_mes z_ablauf_has_hst_in z_ablauf_has_stg z_ablaufvariante_has_stg z_iae_entkoppelt_has z_modus_em_hst_in z_n_soll_em_aktiv_ans_mes z_respschleschaltaktiv_ans z_svh_has_sbe z_t10max_ans zielgang_egs_in /end LOC_MEASUREMENT
/end FUNCTION
/begin FUNCTION SFOp_SLST170_S__SLSTAbbruch_Ans "" /begin SUB_FUNCTION SFOp_SLST442_Entry /end SUB_FUNCTION /begin DEF_CHARACTERISTIC STATUS_ABL_ABBRUCH_FERTIG /end DEF_CHARACTERISTIC /end FUNCTION
/begin FUNCTION SFOp_SLST171_St_VM_zuenden_Ans ""
 /begin SUB_FUNCTION Run_SFOp_SLST4__cTimer_3Max_Ans Run_SFOp_SLST489_CL_PT1_sec_ Run_SFOp_SLST4__radient_MSoll_a Run_SFOp_SLST4___3vzmsollk0_ans Run_SFOp_SLST4__adient_MMaxIae1 SFOp_SLST454_Response_SLST Run_SFOp_SLST4__cTimer_trigger_ SFOp_SLST448_Entry /end SUB_FUNCTION
 /begin DEF_CHARACTERISTIC FK_14NSOLLVM_ANS F_1NDSOLLIAESTAT_ANS KF_14NOEMNSOLLVMIAEENTK_ANS_W KF_14NOEMNSOLLVMIAEENTK_ANS_X KF_14NOEMNSOLLVMIAEENTK_ANS_Y KF_14NOEMNSOLLVM_ANS_W KF_14NOEMNSOLLVM_ANS_X KF_14NOEMNSOLLVM_ANS_Y KF_3MK0CGETRMMOT_ANS_W KF_3MK0CGETRMMOT_ANS_X KF_3MK0CGETRMMOT_ANS_Y KF_3MK0CGETRMMOT_SCHUB_ANS_W KF_3MK0CGETRMMOT_SCHUB_ANS_X KF_3MK0CGETRMMOT_SCHUB_ANS_Y KF_3MK0MMOTNVM_ANS_W KF_3MK0MMOTNVM_ANS_X KF_3MK0MMOTNVM_ANS_Y KF_3MK0MMOTNVM_SCHUB_ANS_W KF_3MK0MMOTNVM_SCHUB_ANS_X KF_3MK0MMOTNVM_SCHUB_ANS_Y KL_24NDSOLLIAEABLVAR_ANS_X KL_24NDSOLLIAEABLVAR_ANS_Y KL_3FMK0CGETRMMOT_ANS_X KL_3FMK0CGETRMMOT_ANS_Y KL_3FMK0CGETRMMOT_SCHUB_ANS_X KL_3FMK0CGETRMMOT_SCHUB_ANS_Y KL_3FMK0MMOTNVM_ANS_X KL_3FMK0MMOTNVM_ANS_Y KL_3FMK0MMOTNVM_SCHUB_ANS_X KL_3FMK0MMOTNVM_SCHUB_ANS_Y KL_3MGSOLLK0_ANS_X KL_3MGSOLLK0_ANS_Y KL_3MGSOLLK0_SCHUB_ANS_X KL_3MGSOLLK0_SCHUB_ANS_Y KL_3MK0MVMSTART_ANS_X KL_3MK0MVMSTART_ANS_Y KL_3NDIAEEMMAXIAE_ANS_X KL_3NDIAEEMMAXIAE_ANS_Y KL_3TMINABLVAR_ANS_X KL_3TMINABLVAR_ANS_Y K_3MSTOERKPL_ANS MG_3MOMAXIAE1_ANS MG_3MOMAXIAE2_ANS MO_14MEM_ANS MS23_MZIELPHYSK0 MS_14ZMSOLLEMAKTIV_ANS MS_MMAXIAEINAKTIV_ANS M_03MINEMHAS_ANS M_35MINEMVMLLHAS_ANS NS_35ABEGSMMMINVMLLEMHAS_ANS STATUS_24K0ZMSOLLEMAKTIV_ANS STATUS_2ABLVMLAEUFT_HST_ANS STATUS_3ABLVMDREHT_HST_ANS STATUS_3ABLVMFEHLER_HST_ANS STATUS_3ABLVMLAEUFT_HST_ANS STATUS_ABL_103_ANS SWI_103_ZPHYSK0_ANS SWI_14NONSOLLVMIAEENTK_ANS SWI_16ZNSOLLEMAKTIV_ANS SWI_24MSTOERK0EMMK0_ANS SWI_3UMSCHLMMOTNGVM_ANS SWI_3UMSCHLNVMNDK0_ANS SWI_3ZMSOLLEM_ANS SWI_3ZNSOLLEM_ANS SWI_3ZNSOLL_VMAKTIV_ANS SWI_MK0MOD_HAS_ANS SWI_UMSCH_ZVMSTARTFEHLER_ANS TG_3VZMSOLLK0_ANS T_23VZMSOLLK0_ANS T_3MAX_ANS /end DEF_CHARACTERISTIC
 /begin LOC_MEASUREMENT SFOp_SLST252_out_ SFOp_SLST461_isActive_ SFOp_SLST469_out_ SFOp_SLST477_out_ abstellpos_vm_in abstellpos_vm_status_in c_getriebe_egs_in c_vm_in gangwechsel_egs_in i_istgang_egs i_zielgang_egs istgang_egs_in m_em_in m_iae_in m_k0_in m_max_dyn_em_in m_min_vm_in m_mot_in m_soll_em_hst_in m_soll_vm_hst_in m_soll_vm_l_hst_in m_stoer_k0_em_fil m_vm_in m_vm_start_in m_wunsch_fpw_hst_fil m_wunsch_fpw_hst_in m_wunsch_fpw_in m_ziel_vm_has_ans n_ab_egs_in n_em_in n_min_psys_em_has_sbe n_mot_soll_iae_in n_sec_iae n_soll_ll_vm_in n_vm_in nd_iae nd_k0_in ndg_k0_in ng_vm sollgang_egs_in status_iae_in status_k0_in status_kraftfluss_egs_in status_ll_vm_in status_schaltung_egs_in status_sync_schaltung_sbe status_zug_svh_sbe t_3max_ans_mes t_3min_ans_mes t_3minablvar_ans_mes z_ablauf_has_hst_in z_ablauf_has_stg z_ablaufvariante_has_stg z_iae_entkoppelt_has z_modus_em_hst_in z_n_soll_em_aktiv_ans_mes z_respschleschaltaktiv_ans z_svh_has_sbe z_t3max_ans zielgang_egs_in /end LOC_MEASUREMENT
/end FUNCTION
/begin FUNCTION SFOp_SLST172_Gradient ""
 /begin SUB_FUNCTION Run_SFOp_SLST2__iter_nsollemiae Run_SFOp_SLST2__oll_iae_fil_in1 Run_SFOp_SLST2__soll_iae_fil_in SFOp_SLST179_G__ientenbegrenzer /end SUB_FUNCTION
 /begin DEF_CHARACTERISTIC FK_NMOTSOLLIAE1_ANS FK_NMOTSOLLIAE2_ANS KL_NGIAEANF_ANS_X KL_NGIAEANF_ANS_Y SWI_AUSW_NIAEANF_ANS SWI_NMOTSOLLIAEFILAKTIV_ANS /end DEF_CHARACTERISTIC
 /begin LOC_MEASUREMENT abstellpos_vm_in abstellpos_vm_status_in c_getriebe_egs_in c_vm_in gangwechsel_egs_in i_istgang_egs i_zielgang_egs init_anfiae_aktiv_ans istgang_egs_in m_em_in m_iae_in m_k0_in m_max_dyn_em_in m_min_vm_in m_mot_in m_soll_em_hst_in m_soll_vm_hst_in m_soll_vm_l_hst_in m_stoer_k0_em_fil m_vm_in m_vm_start_in m_wunsch_fpw_hst_fil m_wunsch_fpw_hst_in m_wunsch_fpw_in m_ziel_vm_has_ans n_ab_egs_in n_em_in n_min_psys_em_has_sbe n_mot_soll_iae_fil_in n_mot_soll_iae_in n_sec_iae n_soll_em_anfiae_ans n_soll_ll_vm_in n_vm_in nd_anfiaensollem_ans nd_iae nd_k0_in ndg_k0_in ng_vm sollgang_egs_in status_iae_in status_k0_in status_kraftfluss_egs_in status_ll_vm_in status_schaltung_egs_in status_sync_schaltung_sbe status_zug_svh_sbe trig_anfiae_aktiv_ans trig_anfiae_deaktiv_ans z_ablauf_has_hst_in z_ablauf_has_stg z_ablaufvariante_has_stg z_iae_entkoppelt_has z_modus_em_hst_in z_n_soll_em_aktiv_ans_mes z_respschleschaltaktiv_ans z_svh_has_sbe zielgang_egs_in /end LOC_MEASUREMENT
/end FUNCTION
/begin FUNCTION SFOp_SLST173_anschleppen "" /begin SUB_FUNCTION SFOp_SLST215_Z__g_n_soll_em_ans /end SUB_FUNCTION /end FUNCTION
/begin FUNCTION SFOp_SLST174_k0_schliessen "" /begin SUB_FUNCTION SFOp_SLST218_Z___n_soll_em_schl /end SUB_FUNCTION /end FUNCTION
/begin FUNCTION SFOp_SLST175_konditionieren "" /begin SUB_FUNCTION SFOp_SLST221_Z___n_soll_em_kond /end SUB_FUNCTION /end FUNCTION
/begin FUNCTION SFOp_SLST176_slst_abbruch "" /begin SUB_FUNCTION SFOp_SLST224_Z__g_n_soll_em_ans /end SUB_FUNCTION /end FUNCTION
/begin FUNCTION SFOp_SLST177_synchronisieren "" /begin SUB_FUNCTION SFOp_SLST227_Z__g_n_soll_em_syn /end SUB_FUNCTION /end FUNCTION
/begin FUNCTION SFOp_SLST178_zuenden "" /begin SUB_FUNCTION SFOp_SLST230_Z__g_n_soll_em_zue /end SUB_FUNCTION /end FUNCTION
/begin FUNCTION SFOp_SLST179_G__ientenbegrenzer "" /begin SUB_FUNCTION Run_SFOp_SLST1__Gradient_ndiae1 /end SUB_FUNCTION
 /begin DEF_CHARACTERISTIC KF_UMSCHNSOLLEMABS_ANS_W KF_UMSCHNSOLLEMABS_ANS_X KF_UMSCHNSOLLEMABS_ANS_Y KL_NZIELEMKRAFTFLUSS_ANS_X KL_NZIELEMKRAFTFLUSS_ANS_Y NDS_15NEMNVM_ANS NO_15NSOLLEM_ANS SWI_15NEMNSOLLEM_ANS SWI_NMINPSYSEM_ANS /end DEF_CHARACTERISTIC
 /begin LOC_MEASUREMENT FlipFlop_schwelle_nsollem_nq abstellpos_vm_in abstellpos_vm_status_in c_getriebe_egs_in c_vm_in gangwechsel_egs_in i_istgang_egs i_zielgang_egs init_nsollem_grad_ans istgang_egs_in m_em_in m_iae_in m_k0_in m_max_dyn_em_in m_min_vm_in m_mot_in m_soll_em_hst_in m_soll_vm_hst_in m_soll_vm_l_hst_in m_stoer_k0_em_fil m_vm_in m_vm_start_in m_wunsch_fpw_hst_fil m_wunsch_fpw_hst_in m_wunsch_fpw_in m_ziel_vm_has_ans n_ab_egs_in n_em_in n_em_ziel_gradbr_ans n_min_psys_em_has_sbe n_mot_soll_iae_in n_sec_iae n_soll_em_max_ans n_soll_ll_vm_in n_vm_in nd_iae nd_iae_init_ans nd_k0_in nd_soll_iae nd_soll_iae_init_ans ndg_k0_in ng_nsoll_em_ans ng_vm sollgang_egs_in status_iae_in status_k0_in status_kraftfluss_egs_in status_ll_vm_in status_schaltung_egs_in status_sync_schaltung_sbe status_zug_svh_sbe z_ablauf_has_hst_in z_ablauf_has_stg z_ablaufvariante_has_stg z_iae_entkoppelt_has z_modus_em_hst_in z_n_soll_em_aktiv_ans_mes z_respschleschaltaktiv_ans z_svh_has_sbe zielgang_egs_in /end LOC_MEASUREMENT
/end FUNCTION
/begin FUNCTION SFOp_SLST215_Z__g_n_soll_em_ans ""
 /begin DEF_CHARACTERISTIC KF_15NDGSOLLIAE_ANS_W KF_15NDGSOLLIAE_ANS_X KF_15NDGSOLLIAE_ANS_Y KF_15NDSOLLIAE_ANS_W KF_15NDSOLLIAE_ANS_X KF_15NDSOLLIAE_ANS_Y KF_15NGSOLLEM_NEMNDIAE_ANS_W KF_15NGSOLLEM_NEMNDIAE_ANS_X KF_15NGSOLLEM_NEMNDIAE_ANS_Y KF_15NGSOLLEM_STIAEKRAFT_ANS_W KF_15NGSOLLEM_STIAEKRAFT_ANS_X KF_15NGSOLLEM_STIAEKRAFT_ANS_Y KF_24NDSOLLIAEABLVAR_ANS_W KF_24NDSOLLIAEABLVAR_ANS_X KF_24NDSOLLIAEABLVAR_ANS_Y KF_NOSOLLIAEAKTIV_ANS_W KF_NOSOLLIAEAKTIV_ANS_X KF_NOSOLLIAEAKTIV_ANS_Y KL_24NDSOLLIAEABLVAR_ANS_X KL_24NDSOLLIAEABLVAR_ANS_Y KL_2FNDGSOLLIAE_ANS_X KL_2FNDGSOLLIAE_ANS_Y KL_2FNDSOLLIAE_ANS_X KL_2FNDSOLLIAE_ANS_Y NG_15NSOLLEMNSOLLLLVM_ANS NG_15NSOLLEM_ANS /end DEF_CHARACTERISTIC
/end FUNCTION
/begin FUNCTION SFOp_SLST218_Z___n_soll_em_schl ""
 /begin DEF_CHARACTERISTIC KF_15NDGSOLLIAE_ANS_W KF_15NDGSOLLIAE_ANS_X KF_15NDGSOLLIAE_ANS_Y KF_15NDSOLLIAE_ANS_W KF_15NDSOLLIAE_ANS_X KF_15NDSOLLIAE_ANS_Y KF_15NGSOLLEM_NEMNDIAE_ANS_W KF_15NGSOLLEM_NEMNDIAE_ANS_X KF_15NGSOLLEM_NEMNDIAE_ANS_Y KF_15NGSOLLEM_STIAEKRAFT_ANS_W KF_15NGSOLLEM_STIAEKRAFT_ANS_X KF_15NGSOLLEM_STIAEKRAFT_ANS_Y KF_NOSOLLIAEAKTIV_ANS_W KF_NOSOLLIAEAKTIV_ANS_X KF_NOSOLLIAEAKTIV_ANS_Y KL_5FNDGSOLLIAE_ANS_X KL_5FNDGSOLLIAE_ANS_Y KL_5FNDSOLLIAE_ANS_X KL_5FNDSOLLIAE_ANS_Y NG_15NSOLLEMNSOLLLLVM_ANS NG_15NSOLLEM_ANS SWI_46NEMNSOLLEM_ANS /end DEF_CHARACTERISTIC
/end FUNCTION
/begin FUNCTION SFOp_SLST221_Z___n_soll_em_kond ""
 /begin DEF_CHARACTERISTIC KF_15NDGSOLLIAE_ANS_W KF_15NDGSOLLIAE_ANS_X KF_15NDGSOLLIAE_ANS_Y KF_15NDSOLLIAE_ANS_W KF_15NDSOLLIAE_ANS_X KF_15NDSOLLIAE_ANS_Y KF_15NGSOLLEM_NEMNDIAE_ANS_W KF_15NGSOLLEM_NEMNDIAE_ANS_X KF_15NGSOLLEM_NEMNDIAE_ANS_Y KF_15NGSOLLEM_STIAEKRAFT_ANS_W KF_15NGSOLLEM_STIAEKRAFT_ANS_X KF_15NGSOLLEM_STIAEKRAFT_ANS_Y KF_NOSOLLIAEAKTIV_ANS_W KF_NOSOLLIAEAKTIV_ANS_X KF_NOSOLLIAEAKTIV_ANS_Y KL_1FNDGSOLLIAE_ANS_X KL_1FNDGSOLLIAE_ANS_Y KL_1FNDSOLLIAE_ANS_X KL_1FNDSOLLIAE_ANS_Y NG_15NSOLLEMNSOLLLLVM_ANS NG_15NSOLLEM_ANS /end DEF_CHARACTERISTIC
/end FUNCTION
/begin FUNCTION SFOp_SLST224_Z__g_n_soll_em_ans ""
 /begin DEF_CHARACTERISTIC KF_15NDGSOLLIAE_ANS_W KF_15NDGSOLLIAE_ANS_X KF_15NDGSOLLIAE_ANS_Y KF_15NDSOLLIAE_ANS_W KF_15NDSOLLIAE_ANS_X KF_15NDSOLLIAE_ANS_Y KF_15NGSOLLEM_NEMNDIAE_ANS_W KF_15NGSOLLEM_NEMNDIAE_ANS_X KF_15NGSOLLEM_NEMNDIAE_ANS_Y KF_15NGSOLLEM_STIAEKRAFT_ANS_W KF_15NGSOLLEM_STIAEKRAFT_ANS_X KF_15NGSOLLEM_STIAEKRAFT_ANS_Y KF_NOSOLLIAEAKTIV_ANS_W KF_NOSOLLIAEAKTIV_ANS_X KF_NOSOLLIAEAKTIV_ANS_Y KL_10FNDGSOLLIAE_ANS_X KL_10FNDGSOLLIAE_ANS_Y KL_10FNDSOLLIAE_ANS_X KL_10FNDSOLLIAE_ANS_Y NG_15NSOLLEMNSOLLLLVM_ANS NG_15NSOLLEM_ANS /end DEF_CHARACTERISTIC
/end FUNCTION
/begin FUNCTION SFOp_SLST227_Z__g_n_soll_em_syn ""
 /begin DEF_CHARACTERISTIC KF_15NDGSOLLIAE_ANS_W KF_15NDGSOLLIAE_ANS_X KF_15NDGSOLLIAE_ANS_Y KF_15NDSOLLIAE_ANS_W KF_15NDSOLLIAE_ANS_X KF_15NDSOLLIAE_ANS_Y KF_15NGSOLLEM_NEMNDIAE_ANS_W KF_15NGSOLLEM_NEMNDIAE_ANS_X KF_15NGSOLLEM_NEMNDIAE_ANS_Y KF_15NGSOLLEM_STIAEKRAFT_ANS_W KF_15NGSOLLEM_STIAEKRAFT_ANS_X KF_15NGSOLLEM_STIAEKRAFT_ANS_Y KF_24NDSOLLIAEABLVAR_ANS_W KF_24NDSOLLIAEABLVAR_ANS_X KF_24NDSOLLIAEABLVAR_ANS_Y KF_NOSOLLIAEAKTIV_ANS_W KF_NOSOLLIAEAKTIV_ANS_X KF_NOSOLLIAEAKTIV_ANS_Y KL_24NDSOLLIAEABLVAR_ANS_X KL_24NDSOLLIAEABLVAR_ANS_Y KL_4FNDGSOLLIAE_ANS_X KL_4FNDGSOLLIAE_ANS_Y KL_4FNDSOLLIAE_ANS_X KL_4FNDSOLLIAE_ANS_Y NG_15NSOLLEMNSOLLLLVM_ANS NG_15NSOLLEM_ANS SWI_46NEMNSOLLEM_ANS /end DEF_CHARACTERISTIC
/end FUNCTION
/begin FUNCTION SFOp_SLST230_Z__g_n_soll_em_zue ""
 /begin DEF_CHARACTERISTIC KF_15NDGSOLLIAE_ANS_W KF_15NDGSOLLIAE_ANS_X KF_15NDGSOLLIAE_ANS_Y KF_15NDSOLLIAE_ANS_W KF_15NDSOLLIAE_ANS_X KF_15NDSOLLIAE_ANS_Y KF_15NGSOLLEM_NEMNDIAE_ANS_W KF_15NGSOLLEM_NEMNDIAE_ANS_X KF_15NGSOLLEM_NEMNDIAE_ANS_Y KF_15NGSOLLEM_STIAEKRAFT_ANS_W KF_15NGSOLLEM_STIAEKRAFT_ANS_X KF_15NGSOLLEM_STIAEKRAFT_ANS_Y KF_24NDSOLLIAEABLVAR_ANS_W KF_24NDSOLLIAEABLVAR_ANS_X KF_24NDSOLLIAEABLVAR_ANS_Y KF_NOSOLLIAEAKTIV_ANS_W KF_NOSOLLIAEAKTIV_ANS_X KF_NOSOLLIAEAKTIV_ANS_Y KL_24NDSOLLIAEABLVAR_ANS_X KL_24NDSOLLIAEABLVAR_ANS_Y KL_3FNDGSOLLIAE_ANS_X KL_3FNDGSOLLIAE_ANS_Y KL_3FNDSOLLIAE_ANS_X KL_3FNDSOLLIAE_ANS_Y NG_15NSOLLEMNSOLLLLVM_ANS NG_15NSOLLEM_ANS /end DEF_CHARACTERISTIC
/end FUNCTION
/begin FUNCTION SFOp_SLST233_Entry ""
 /begin DEF_CHARACTERISTIC KF_2MK0CGETRMMOT1_ANS_W KF_2MK0CGETRMMOT1_ANS_X KF_2MK0CGETRMMOT1_ANS_Y KF_2MK0CGETRMMOT1_SCHUB_ANS_W KF_2MK0CGETRMMOT1_SCHUB_ANS_X KF_2MK0CGETRMMOT1_SCHUB_ANS_Y KF_2MK0MMOTNVM1_ANS_W KF_2MK0MMOTNVM1_ANS_X KF_2MK0MMOTNVM1_ANS_Y KF_2MK0MMOTNVM1_SCHUB_ANS_W KF_2MK0MMOTNVM1_SCHUB_ANS_X KF_2MK0MMOTNVM1_SCHUB_ANS_Y KF_2MOK0ABSTELLPOS_ANS_W KF_2MOK0ABSTELLPOS_ANS_X KF_2MOK0ABSTELLPOS_ANS_Y KL_2FMK0CGETRMMOT1_ANS_X KL_2FMK0CGETRMMOT1_ANS_Y KL_2FMK0CGETRMMOT1_SCHUB_ANS_X KL_2FMK0CGETRMMOT1_SCHUB_ANS_Y KL_2FMK0MMOTNVM1_ANS_X KL_2FMK0MMOTNVM1_ANS_Y KL_2FMK0MMOTNVM1_SCHUB_ANS_X KL_2FMK0MMOTNVM1_SCHUB_ANS_Y KL_2MK0MVMSTART_ANS_X KL_2MK0MVMSTART_ANS_Y K_SVH_RESET_SST_ANS MO_2K0ABSTELLPOSUNGUELTIG_ANS NS_2K0ABSTELLPOSUNGUELTIG_ANS STATUS_ABSTELLPOSVMGUELTIG_ANS T_23VZMSOLLK0_ANS /end DEF_CHARACTERISTIC
 /begin LOC_MEASUREMENT abstellpos_vm_in abstellpos_vm_status_in c_getriebe_egs_in c_vm_in gangwechsel_egs_in i_istgang_egs i_zielgang_egs istgang_egs_in m_em_in m_iae_in m_k0_in m_max_dyn_em_in m_min_vm_in m_mot_in m_soll_em_hst_in m_soll_vm_hst_in m_soll_vm_l_hst_in m_stoer_k0_em_fil m_vm_in m_vm_start_in m_wunsch_fpw_hst_fil m_wunsch_fpw_hst_in m_wunsch_fpw_in m_ziel_vm_has_ans n_ab_egs_in n_em_in n_min_psys_em_has_sbe n_mot_soll_iae_in n_sec_iae n_soll_ll_vm_in n_vm_in nd_iae nd_k0_in ndg_k0_in ng_vm sollgang_egs_in status_iae_in status_k0_in status_kraftfluss_egs_in status_ll_vm_in status_schaltung_egs_in status_sync_schaltung_sbe status_zug_svh_sbe z_ablauf_has_hst_in z_ablauf_has_stg z_ablaufvariante_has_stg z_iae_entkoppelt_has z_modus_em_hst_in z_n_soll_em_aktiv_ans_mes z_respschleschaltaktiv_ans z_svh_has_sbe zielgang_egs_in /end LOC_MEASUREMENT
/end FUNCTION
/begin FUNCTION SFOp_SLST286_Entry "" /begin SUB_FUNCTION SFOp_SLST290_B__altverhinderung /end SUB_FUNCTION /begin DEF_CHARACTERISTIC STATUS_ABL_105_ANS SWI_105_ZPHYSK0_ANS SWI_5ZMSOLLEM_ANS /end DEF_CHARACTERISTIC
 /begin LOC_MEASUREMENT abstellpos_vm_in abstellpos_vm_status_in c_getriebe_egs_in c_vm_in gangwechsel_egs_in i_istgang_egs i_zielgang_egs istgang_egs_in m_em_in m_iae_in m_k0_in m_max_dyn_em_in m_min_vm_in m_mot_in m_soll_em_hst_in m_soll_vm_hst_in m_soll_vm_l_hst_in m_stoer_k0_em_fil m_vm_in m_vm_start_in m_wunsch_fpw_hst_fil m_wunsch_fpw_hst_in m_wunsch_fpw_in m_ziel_vm_has_ans n_ab_egs_in n_em_in n_min_psys_em_has_sbe n_mot_soll_iae_in n_sec_iae n_soll_ll_vm_in n_vm_in nd_iae nd_k0_in ndg_k0_in ng_vm sollgang_egs_in status_iae_in status_k0_in status_kraftfluss_egs_in status_ll_vm_in status_schaltung_egs_in status_sync_schaltung_sbe status_zug_svh_sbe z_ablauf_has_hst_in z_ablauf_has_stg z_ablaufvariante_has_stg z_iae_entkoppelt_has z_modus_em_hst_in z_n_soll_em_aktiv_ans_mes z_respschleschaltaktiv_ans z_svh_has_sbe zielgang_egs_in /end LOC_MEASUREMENT
/end FUNCTION
/begin FUNCTION SFOp_SLST290_B__altverhinderung "" /begin DEF_CHARACTERISTIC K_SVH_RESET_SCL_ANS /end DEF_CHARACTERISTIC /begin LOC_MEASUREMENT z_respschleschaltaktiv_ans /end LOC_MEASUREMENT /end FUNCTION
/begin FUNCTION SFOp_SLST310_Entry "" /begin SUB_FUNCTION SFOp_SLST314_B__altverhinderung /end SUB_FUNCTION /begin DEF_CHARACTERISTIC M_45MAXEMHAS_ANS STATUS_ABL_104_ANS SWI_104_ZPHYSK0_ANS /end DEF_CHARACTERISTIC
 /begin LOC_MEASUREMENT abstellpos_vm_in abstellpos_vm_status_in c_getriebe_egs_in c_vm_in gangwechsel_egs_in i_istgang_egs i_zielgang_egs istgang_egs_in m_em_in m_iae_in m_k0_in m_max_dyn_em_in m_min_vm_in m_mot_in m_soll_em_hst_in m_soll_vm_hst_in m_soll_vm_l_hst_in m_stoer_k0_em_fil m_vm_in m_vm_start_in m_wunsch_fpw_hst_fil m_wunsch_fpw_hst_in m_wunsch_fpw_in m_ziel_vm_has_ans n_ab_egs_in n_em_in n_min_psys_em_has_sbe n_mot_soll_iae_in n_sec_iae n_soll_ll_vm_in n_vm_in nd_iae nd_k0_in ndg_k0_in ng_vm sollgang_egs_in status_iae_in status_k0_in status_kraftfluss_egs_in status_ll_vm_in status_schaltung_egs_in status_sync_schaltung_sbe status_zug_svh_sbe z_ablauf_has_hst_in z_ablauf_has_stg z_ablaufvariante_has_stg z_iae_entkoppelt_has z_modus_em_hst_in z_n_soll_em_aktiv_ans_mes z_respschleschaltaktiv_ans z_svh_has_sbe zielgang_egs_in /end LOC_MEASUREMENT
/end FUNCTION
/begin FUNCTION SFOp_SLST314_B__altverhinderung "" /begin DEF_CHARACTERISTIC K_SVH_RESET_SYN_ANS /end DEF_CHARACTERISTIC /begin LOC_MEASUREMENT z_respschleschaltaktiv_ans /end LOC_MEASUREMENT /end FUNCTION
/begin FUNCTION SFOp_SLST34_m_ziel_vm_has_zus "" /begin LOC_MEASUREMENT m_max_dyn_em_in m_wunsch_fpw_hst_in m_ziel_vm_has_ans /end LOC_MEASUREMENT /end FUNCTION
/begin FUNCTION SFOp_SLST355_Enabled_Subsystem1 ""
 /begin DEF_CHARACTERISTIC KF_14NOEMNSOLLVMIAEENTK_ANS_W KF_14NOEMNSOLLVMIAEENTK_ANS_X KF_14NOEMNSOLLVMIAEENTK_ANS_Y KF_14NOEMNSOLLVM_ANS_W KF_14NOEMNSOLLVM_ANS_X KF_14NOEMNSOLLVM_ANS_Y KL_24NDSOLLIAEABLVAR_ANS_X KL_24NDSOLLIAEABLVAR_ANS_Y SWI_14NONSOLLVMIAEENTK_ANS /end DEF_CHARACTERISTIC
/end FUNCTION
/begin FUNCTION SFOp_SLST35_st__psys_em_has_sbe "" /begin DEF_CHARACTERISTIC KL_ZABLVARSTATUSPSYSEM_ANS_X KL_ZABLVARSTATUSPSYSEM_ANS_Y /end DEF_CHARACTERISTIC /begin LOC_MEASUREMENT status_psys_has_sbe z_ablaufvariante_has_stg /end LOC_MEASUREMENT /end FUNCTION
/begin FUNCTION SFOp_SLST374_Entry ""
 /begin DEF_CHARACTERISTIC K_SVH_RESET_KON_ANS M_03MAXEMHAS_ANS M_03MINEMHAS_ANS NO_NEMZMMAXIAEABLVAR_KON_ANS NS_1NVMZMMAXIAEABLVAR_ANS SWI_101_ZPHYSK0_ANS /end DEF_CHARACTERISTIC
 /begin LOC_MEASUREMENT abstellpos_vm_in abstellpos_vm_status_in c_getriebe_egs_in c_vm_in gangwechsel_egs_in i_istgang_egs i_zielgang_egs istgang_egs_in m_em_in m_iae_in m_k0_in m_max_dyn_em_in m_min_vm_in m_mot_in m_soll_em_hst_in m_soll_vm_hst_in m_soll_vm_l_hst_in m_stoer_k0_em_fil m_vm_in m_vm_start_in m_wunsch_fpw_hst_fil m_wunsch_fpw_hst_in m_wunsch_fpw_in m_ziel_vm_has_ans n_ab_egs_in n_em_in n_min_psys_em_has_sbe n_mot_soll_iae_in n_sec_iae n_soll_ll_vm_in n_vm_in nd_iae nd_k0_in ndg_k0_in ng_vm sollgang_egs_in status_iae_in status_k0_in status_kraftfluss_egs_in status_ll_vm_in status_schaltung_egs_in status_sync_schaltung_sbe status_zug_svh_sbe z_ablauf_has_hst_in z_ablauf_has_stg z_ablaufvariante_has_stg z_iae_entkoppelt_has z_modus_em_hst_in z_n_soll_em_aktiv_ans_mes z_respschleschaltaktiv_ans z_svh_has_sbe zielgang_egs_in /end LOC_MEASUREMENT
/end FUNCTION
/begin FUNCTION SFOp_SLST406_Vorgaben_LP3 "" /begin SUB_FUNCTION Run_SFOp_SLST4__ent_msollk0_kon /end SUB_FUNCTION
 /begin DEF_CHARACTERISTIC ABLAUFVAR_RESPONSE_ANS CS_1BEFUELLOPTCGETRIEBE_ANS KF_1MGK0BEFNORM_ANS_W KF_1MGK0BEFNORM_ANS_X KF_1MGK0BEFNORM_ANS_Y KF_1MGK0BEFOPT_ANS_W KF_1MGK0BEFOPT_ANS_X KF_1MGK0BEFOPT_ANS_Y KF_1MGK0BEFRED_ANS_W KF_1MGK0BEFRED_ANS_X KF_1MGK0BEFRED_ANS_Y KF_1MGSOLLK0ANFIAE_ANS_W KF_1MGSOLLK0ANFIAE_ANS_X KF_1MGSOLLK0ANFIAE_ANS_Y KF_1MZIELK0ANFIAE_ANS_W KF_1MZIELK0ANFIAE_ANS_X KF_1MZIELK0ANFIAE_ANS_Y KF_1MZIELK0BEFNORM_ANS_W KF_1MZIELK0BEFNORM_ANS_X KF_1MZIELK0BEFNORM_ANS_Y KF_1MZIELK0BEFOPT_ANS_W KF_1MZIELK0BEFOPT_ANS_X KF_1MZIELK0BEFOPT_ANS_Y KF_1MZIELK0BEFRED_ANS_W KF_1MZIELK0BEFRED_ANS_X KF_1MZIELK0BEFRED_ANS_Y KF_MGK0VMANDREH_KON_ANS_W KF_MGK0VMANDREH_KON_ANS_X KF_MGK0VMANDREH_KON_ANS_Y KF_MZIELK0VMANDREH_KON_ANS_W KF_MZIELK0VMANDREH_KON_ANS_X KF_MZIELK0VMANDREH_KON_ANS_Y ND_IAEANFAHRENTK_ANS NS_1BEFUELLOPTNEM_ANS NS_EMIAEANFAHRENTK_ANS NS_VMANDREHK0_ERK_KON_ANS NS_VMAUS_ERK_KON_ANS SWI_1UMSCHMSOLLK0MZIELK0_ANS SWI_BEFUELLRED_AKTIV_KON_ANS /end DEF_CHARACTERISTIC
 /begin LOC_MEASUREMENT abstellpos_vm_in c_getriebe_egs_in n_em_in n_vm_in nd_iae ng_vm status_iae_in /end LOC_MEASUREMENT
/end FUNCTION
/begin FUNCTION SFOp_SLST424_Entry ""
 /begin DEF_CHARACTERISTIC MS_MMAXIAEINAKTIV_ANS STATUS_ABL_ABBRUCH_AKTIV SWI_110_ZPHYSK0_ANS /end DEF_CHARACTERISTIC
/end FUNCTION
/begin FUNCTION SFOp_SLST442_Entry ""
 /begin DEF_CHARACTERISTIC STATUS_ABL_ABBRUCH_FERTIG SWI_150ZMSOLLEM_ANS SWI_150ZNSOLLEM_ANS SWI_150_ZPHYSK0_ANS SWI_16ZNSOLLEMAKTIV_ANS /end DEF_CHARACTERISTIC
 /begin LOC_MEASUREMENT abstellpos_vm_in abstellpos_vm_status_in c_getriebe_egs_in c_vm_in gangwechsel_egs_in i_istgang_egs i_zielgang_egs istgang_egs_in m_em_in m_iae_in m_k0_in m_max_dyn_em_in m_min_vm_in m_mot_in m_soll_em_hst_in m_soll_vm_hst_in m_soll_vm_l_hst_in m_stoer_k0_em_fil m_vm_in m_vm_start_in m_wunsch_fpw_hst_fil m_wunsch_fpw_hst_in m_wunsch_fpw_in m_ziel_vm_has_ans n_ab_egs_in n_em_in n_min_psys_em_has_sbe n_mot_soll_iae_in n_sec_iae n_soll_ll_vm_in n_vm_in nd_iae nd_k0_in ndg_k0_in ng_vm sollgang_egs_in status_iae_in status_k0_in status_kraftfluss_egs_in status_ll_vm_in status_schaltung_egs_in status_sync_schaltung_sbe status_zug_svh_sbe z_ablauf_has_hst_in z_ablauf_has_stg z_ablaufvariante_has_stg z_iae_entkoppelt_has z_modus_em_hst_in z_n_soll_em_aktiv_ans_mes z_respschleschaltaktiv_ans z_svh_has_sbe zielgang_egs_in /end LOC_MEASUREMENT
/end FUNCTION
/begin FUNCTION SFOp_SLST448_Entry "" /begin DEF_CHARACTERISTIC STATUS_ABL_103_ANS /end DEF_CHARACTERISTIC /end FUNCTION
/begin FUNCTION SFOp_SLST454_Response_SLST ""
 /begin DEF_CHARACTERISTIC KF_3VMISTVMSOLL_ANS_W KF_3VMISTVMSOLL_ANS_X KF_3VMISTVMSOLL_ANS_Y K_SVH_RESET_ZND_ANS SWI_RESPSCHLE_SCHALT_ANS /end DEF_CHARACTERISTIC
/end FUNCTION
/begin FUNCTION SFOp_SLST497_Entry "" /begin DEF_CHARACTERISTIC MS_RESEM_SAK_ANS STATUS_ABL_100_ANS SWI_100_ZPHYSK0_ANS /end DEF_CHARACTERISTIC
 /begin LOC_MEASUREMENT abstellpos_vm_in abstellpos_vm_status_in c_getriebe_egs_in c_vm_in gangwechsel_egs_in i_istgang_egs i_zielgang_egs istgang_egs_in m_em_in m_iae_in m_k0_in m_max_dyn_em_in m_min_vm_in m_mot_in m_soll_em_hst_in m_soll_vm_hst_in m_soll_vm_l_hst_in m_stoer_k0_em_fil m_vm_in m_vm_start_in m_wunsch_fpw_hst_fil m_wunsch_fpw_hst_in m_wunsch_fpw_in m_ziel_vm_has_ans n_ab_egs_in n_em_in n_min_psys_em_has_sbe n_mot_soll_iae_in n_sec_iae n_soll_ll_vm_in n_vm_in nd_iae nd_k0_in ndg_k0_in ng_vm sollgang_egs_in status_iae_in status_k0_in status_kraftfluss_egs_in status_ll_vm_in status_schaltung_egs_in status_sync_schaltung_sbe status_zug_svh_sbe z_ablauf_has_hst_in z_ablauf_has_stg z_ablaufvariante_has_stg z_iae_entkoppelt_has z_modus_em_hst_in z_n_soll_em_aktiv_ans_mes z_respschleschaltaktiv_ans z_svh_has_sbe zielgang_egs_in /end LOC_MEASUREMENT
/end FUNCTION
/begin FUNCTION SFOp_SLST498_Entry_Static ""
 /begin SUB_FUNCTION Run_SFOp_SLST5__ate_t_0_max_ans SFOp_SLST516_Berechnung_LP3 Run_SFOp_SLST5__L_PT1_14nsollvm /end SUB_FUNCTION
 /begin DEF_CHARACTERISTIC FK_14NSOLLVM_ANS KF_NSOLLVMZIELIST_ANS_W KF_NSOLLVMZIELIST_ANS_X KF_NSOLLVMZIELIST_ANS_Y KL_NSOLLVMKRAFTFLUSS_ANS_X KL_NSOLLVMKRAFTFLUSS_ANS_Y K_0MSTOERKPL_ANS K_SVH_RESET_NSRS_SAK_ANS K_SVH_RESET_SAK_ANS K_SVH_RESET_SRS_SAK_ANS MS_14ZMSOLLEMAKTIV_ANS MS_MVM_SAK_ANS NDG_K0_SAK_ANS NDS_K0_SAK_ANS NS_NVM_SAK_ANS STATUS_1K0ZMSOLLEMAKTIV_ANS SWI_01MSTOERK0EMFILMK0_ANS SWI_01MSTOERK0EMMK0_ANS SWI_0MSOLLEM_NULL_ANS SWI_0ZMSOLLEM_ANS T_0MAX_ANS /end DEF_CHARACTERISTIC
 /begin LOC_MEASUREMENT SFOp_SLST509_isActive_ abstellpos_vm_in abstellpos_vm_status_in c_getriebe_egs_in c_vm_in gangwechsel_egs_in i_istgang_egs i_zielgang_egs istgang_egs_in m_em_in m_iae_in m_k0_in m_max_dyn_em_in m_min_vm_in m_mot_in m_soll_em_hst_in m_soll_vm_hst_in m_soll_vm_l_hst_in m_stoer_k0_em_fil m_vm_in m_vm_start_in m_wunsch_fpw_hst_fil m_wunsch_fpw_hst_in m_wunsch_fpw_in m_ziel_vm_has_ans n_ab_egs_in n_em_in n_min_psys_em_has_sbe n_mot_soll_iae_in n_sec_iae n_sec_iae_ziel_ans n_soll_ll_vm_in n_vm_in nd_iae nd_k0_in ndg_k0_in ng_vm sollgang_egs_in status_iae_in status_k0_in status_kraftfluss_egs_in status_ll_vm_in status_schaltung_egs_in status_sync_schaltung_sbe status_zug_svh_sbe t_0max_ans_mes z_ablauf_has_hst_in z_ablauf_has_stg z_ablaufvariante_has_stg z_iae_entkoppelt_has z_modus_em_hst_in z_n_soll_em_aktiv_ans_mes z_respschleschaltaktiv_ans z_svh_has_sbe zielgang_egs_in /end LOC_MEASUREMENT
/end FUNCTION
/begin FUNCTION SFOp_SLST516_Berechnung_LP3 ""
 /begin DEF_CHARACTERISTIC KF_0MZIELK0BEFNORM_ANS_W KF_0MZIELK0BEFNORM_ANS_X KF_0MZIELK0BEFNORM_ANS_Y KF_0MZIELK0BEFRED_ANS_W KF_0MZIELK0BEFRED_ANS_X KF_0MZIELK0BEFRED_ANS_Y SWI_BEFUELLRED_AKTIV_SAK_ANS /end DEF_CHARACTERISTIC
 /begin LOC_MEASUREMENT abstellpos_vm_in c_getriebe_egs_in gangwechsel_egs_in z_svh_has_sbe /end LOC_MEASUREMENT
/end FUNCTION
/begin FUNCTION SFOp_SLST522_Entry ""
 /begin DEF_CHARACTERISTIC SWI_160ZMSOLLEM_ANS SWI_160ZNSOLLEM_ANS SWI_160_ZPHYSK0_ANS SWI_16ZNSOLLEMAKTIV_ANS /end DEF_CHARACTERISTIC
 /begin LOC_MEASUREMENT abstellpos_vm_in abstellpos_vm_status_in c_getriebe_egs_in c_vm_in gangwechsel_egs_in i_istgang_egs i_zielgang_egs istgang_egs_in m_em_in m_iae_in m_k0_in m_max_dyn_em_in m_min_vm_in m_mot_in m_soll_em_hst_in m_soll_vm_hst_in m_soll_vm_l_hst_in m_stoer_k0_em_fil m_vm_in m_vm_start_in m_wunsch_fpw_hst_fil m_wunsch_fpw_hst_in m_wunsch_fpw_in m_ziel_vm_has_ans n_ab_egs_in n_em_in n_min_psys_em_has_sbe n_mot_soll_iae_in n_sec_iae n_soll_ll_vm_in n_vm_in nd_iae nd_k0_in ndg_k0_in ng_vm sollgang_egs_in status_iae_in status_k0_in status_kraftfluss_egs_in status_ll_vm_in status_schaltung_egs_in status_sync_schaltung_sbe status_zug_svh_sbe z_ablauf_has_hst_in z_ablauf_has_stg z_ablaufvariante_has_stg z_iae_entkoppelt_has z_modus_em_hst_in z_n_soll_em_aktiv_ans_mes z_respschleschaltaktiv_ans z_svh_has_sbe zielgang_egs_in /end LOC_MEASUREMENT
/end FUNCTION
/begin FUNCTION SFOp_SLST526_Entry ""
 /begin DEF_CHARACTERISTIC K_SVH_RESET_SRT_ANS MS_RESEM_SRT_ANS STATUS_ABL_START_VMABF_ANS SWI_START_ZPHYSK0_ANS Z_ABLAUF_VMABF_ANS /end DEF_CHARACTERISTIC
 /begin LOC_MEASUREMENT abstellpos_vm_in abstellpos_vm_status_in c_getriebe_egs_in c_vm_in gangwechsel_egs_in i_istgang_egs i_zielgang_egs istgang_egs_in m_em_in m_iae_in m_k0_in m_max_dyn_em_in m_min_vm_in m_mot_in m_soll_em_hst_in m_soll_vm_hst_in m_soll_vm_l_hst_in m_stoer_k0_em_fil m_vm_in m_vm_start_in m_wunsch_fpw_hst_fil m_wunsch_fpw_hst_in m_wunsch_fpw_in m_ziel_vm_has_ans n_ab_egs_in n_em_in n_min_psys_em_has_sbe n_mot_soll_iae_in n_sec_iae n_soll_ll_vm_in n_vm_in nd_iae nd_k0_in ndg_k0_in ng_vm sollgang_egs_in status_iae_in status_k0_in status_kraftfluss_egs_in status_ll_vm_in status_schaltung_egs_in status_sync_schaltung_sbe status_zug_svh_sbe z_ablauf_has_hst_in z_ablauf_has_stg z_ablaufvariante_has_stg z_iae_entkoppelt_has z_modus_em_hst_in z_n_soll_em_aktiv_ans_mes z_respschleschaltaktiv_ans z_svh_has_sbe zielgang_egs_in /end LOC_MEASUREMENT
/end FUNCTION
/begin RECORD_LAYOUT FLOAT32_IEEE_COL_DIRECT_S6_S3 FNC_VALUES 1 FLOAT32_IEEE COLUMN_DIR DIRECT /end RECORD_LAYOUT
/begin RECORD_LAYOUT FLOAT32_IEEE_X_INCR_DIRECT_S6_S3 AXIS_PTS_X 1 FLOAT32_IEEE INDEX_INCR DIRECT /end RECORD_LAYOUT
/begin RECORD_LAYOUT SBYTE_X_INCR_DIRECT_S6_S3 AXIS_PTS_X 1 SBYTE INDEX_INCR DIRECT /end RECORD_LAYOUT
/begin RECORD_LAYOUT UBYTE_COL_DIRECT_S6_S3 FNC_VALUES 1 UBYTE COLUMN_DIR DIRECT /end RECORD_LAYOUT
/begin RECORD_LAYOUT UBYTE_X_INCR_DIRECT_S6_S3 AXIS_PTS_X 1 UBYTE INDEX_INCR DIRECT /end RECORD_LAYOUT
/begin RECORD_LAYOUT UWORD_COL_DIRECT_S6_S3 FNC_VALUES 1 UWORD COLUMN_DIR DIRECT /end RECORD_LAYOUT
/end MODULE
/end PROJECT
