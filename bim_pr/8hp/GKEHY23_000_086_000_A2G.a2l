ASAP2_VERSION 1 51
/begin PROJECT ZHBC8600 "Gen2_BMW_System_Supplier_Lib"
/begin MODULE CPP ""
/begin MOD_COMMON "" BYTE_ORDER MSB_FIRST ALIGNMENT_BYTE 1 ALIGNMENT_WORD 2 ALIGNMENT_LONG 4 ALIGNMENT_FLOAT32_IEEE 4 ALIGNMENT_FLOAT64_IEEE 1 /end MOD_COMMON
/begin COMPU_VTAB CONV_TAB_E_FEHLERIEP_S6_S3 "Conversion table" TAB_VERB 2 0 "NORMALBETRIEB" 1 "FEHLER" DEFAULT_VALUE "" /end COMPU_VTAB
/begin COMPU_VTAB CONV_TAB_E_HYBFKT_S6_S3 "Conversion table" TAB_VERB 16 0 "PASSIV" 1 "ANKOPPELN_VM" 2 "ABKOPPELN_VM" 3 "GANGEINLEGEN" 4 "GANGAUSLEGEN" 5 "OHNABLAUFFKT" 6 "DIREKTSTART" 7 "VM_ZUSTART" 8 "ABSTELLEN_VM" 9 "NICHTDEFINIERT_4" 10 "VM_SCHLEPPSTART" 11 "VM_NOTSTART" 12 "VM_EIN" 13 "VM_AUS" 14 "NICHTDEFINIERT_3" 15 "FEHLER" DEFAULT_VALUE "" /end COMPU_VTAB
/begin COMPU_VTAB CONV_TAB_E_POS_S6_S3 "Conversion table" TAB_VERB 9 0 "D1" 1 "D2" 2 "D3" 3 "D4" 4 "D5" 5 "D" 6 "N" 7 "R" 8 "P" DEFAULT_VALUE "" /end COMPU_VTAB
/begin COMPU_VTAB CONV_TAB_E_SIGSTATUS_S6_S3 "Conversion table" TAB_VERB 3 0 "SIGNAL_OK" 1 "ERSATZWERT" 2 "SIGNAL_FEHLER" DEFAULT_VALUE "" /end COMPU_VTAB
/begin COMPU_VTAB CONV_TAB_E_STATUSADA_S6_S3 "Conversion table" TAB_VERB 3 0 "KEINADAPTION" 1 "TOUCHPOINT_ADAPTION" 2 "REIBWERT_ADAPTION" DEFAULT_VALUE "" /end COMPU_VTAB
/begin COMPU_VTAB CONV_TAB_E_STATUSIAE_S6_S3 "Conversion table" TAB_VERB 9 0 "NICHTDEFINIERT" 1 "OFFEN" 2 "ANGELEGT" 3 "ANFAHREN" 4 "ENTKOPPELT" 5 "ENTKOPPELT_ANFAHREN" 6 "SYNCHRONISIEREN" 7 "GESCHLOSSEN" 8 "OEFFNEN" DEFAULT_VALUE "" /end COMPU_VTAB
/begin COMPU_VTAB CONV_TAB_E_STATUSIEP_S6_S3 "Conversion table" TAB_VERB 5 0 "AUS" 1 "SLEEP" 2 "LP1" 3 "LP2" 4 "LP3" DEFAULT_VALUE "" /end COMPU_VTAB
/begin COMPU_VTAB CONV_TAB_E_STATUSK0_S6_S3 "Conversion table" TAB_VERB 6 0 "OFFEN" 1 "ANGELEGT" 2 "DRUCKSTELLUNG" 3 "SCHLUPFGEREGELT" 4 "GEREGELTGESCHL" 5 "GESCHLOSSEN" DEFAULT_VALUE "" /end COMPU_VTAB
/begin COMPU_VTAB CONV_TAB_E_STATUSKSL_S6_S3 "Conversion table" TAB_VERB 7 0 "KEIN_KRAFTSCHLUSS" 1 "VORW_AUF_ABBAUEND" 2 "VORWAERTS" 3 "RUECKW_AUF_ABBAUEND" 4 "RUECKWAERTS" 5 "VORWAERTS_SCHLUPF" 6 "RUECKWAERTS_SCHLUPF" DEFAULT_VALUE "" /end COMPU_VTAB
/begin COMPU_VTAB CONV_TAB_E_STATUSPSY_S6_S3 "Conversion table" TAB_VERB 5 0 "AUS" 1 "NICHTDEFINIERT" 2 "LP1" 3 "LP2" 4 "LP3" DEFAULT_VALUE "" /end COMPU_VTAB
/begin COMPU_VTAB CONV_TAB_E_STBZHAS_S6_S3 "Conversion table" TAB_VERB 16 0 "INIT_INAKTIV" 1 "ANGEKOPPELT" 2 "ENTKOPPELT" 3 "EFAHREN" 4 "STOP" 5 "LADEN" 6 "ENTK_VMEIN" 7 "EFAHREN_VMEIN" 8 "HYBRID" 9 "NICHTDEFINIERT_1" 10 "NICHTDEFINIERT_2" 11 "NICHTDEFINIERT_3" 12 "NICHTDEFINIERT_4" 13 "NICHTDEFINIERT_5" 14 "INIT_KL15" 15 "FEHLER" DEFAULT_VALUE "" /end COMPU_VTAB
/begin COMPU_VTAB CONV_TAB_E_ZIEP_S6_S3 "Conversion table" TAB_VERB 5 0 "AUS" 1 "SLEEP" 2 "LP1" 3 "LP2" 4 "LP3" DEFAULT_VALUE "" /end COMPU_VTAB
/begin COMPU_VTAB CONV_TAB_E_ZK0_S6_S3 "Conversion table" TAB_VERB 6 0 "OEFFNENSW" 1 "BEFUELLEN" 2 "DRUCKSTELLUNG" 3 "SCHLUPFREGELUNG" 4 "GEREGELTGESCHL" 5 "GESCHLOSSEN" DEFAULT_VALUE "" /end COMPU_VTAB
/begin COMPU_VTAB CONV_TAB_E_ZK0FSTIN_S6_S3 "Conversion table" TAB_VERB 4 0 "OFFEN" 1 "SCHLUPFGEREGELT" 2 "GEREGELTGESCHL" 3 "GESCHLOSSEN" DEFAULT_VALUE "" /end COMPU_VTAB
/begin COMPU_VTAB CONV_TAB_E_ZMODUSIAE_S6_S3 "Conversion table" TAB_VERB 3 0 "EFAHREN_SCHLUPF" 1 "EFAHREN_KRAFTSCHL" 2 "HYBRIDFAHREN" DEFAULT_VALUE "" /end COMPU_VTAB
/begin COMPU_VTAB CONV_TAB_E_ZMODUSIEP_S6_S3 "Conversion table" TAB_VERB 5 0 "KEINVORGABE" 1 "AUS" 2 "LP1" 3 "LP2" 4 "LP3" DEFAULT_VALUE "" /end COMPU_VTAB
/begin COMPU_VTAB CONV_TAB_E_ZNLLSOLL_S6_S3 "Conversion table" TAB_VERB 3 0 "KEINANF" 1 "ANF_ADAP" 2 "ANF_ALLG" DEFAULT_VALUE "" /end COMPU_VTAB
/begin COMPU_METHOD b_int_S6_S3 "Bit Feld" RAT_FUNC "%10.0" "-" COEFFS 0 1 0 0 0 1 /end COMPU_METHOD
/begin COMPU_METHOD c_int_l_S6_S3 "Temperatur" RAT_FUNC "%5.0" "°C" COEFFS 0 1 0 0 0 1 /end COMPU_METHOD
/begin COMPU_METHOD c_int_m_S6_S3 "Temperatur" RAT_FUNC "%3.0" "°C" COEFFS 0 1 0 0 0 1 /end COMPU_METHOD
/begin COMPU_METHOD c_int_S6_S3 "Temperatur" RAT_FUNC "%12.6" "°C" COEFFS 0 1 0 0 0 1 /end COMPU_METHOD
/begin COMPU_METHOD E_FEHLERIEP_S6_S3 "" TAB_VERB "%12.6" "" COMPU_TAB_REF CONV_TAB_E_FEHLERIEP_S6_S3 /end COMPU_METHOD
/begin COMPU_METHOD E_HYBFKT_S6_S3 "" TAB_VERB "%12.6" "" COMPU_TAB_REF CONV_TAB_E_HYBFKT_S6_S3 /end COMPU_METHOD
/begin COMPU_METHOD E_POS_S6_S3 "" TAB_VERB "%12.6" "" COMPU_TAB_REF CONV_TAB_E_POS_S6_S3 /end COMPU_METHOD
/begin COMPU_METHOD E_SIGSTATUS_S6_S3 "" TAB_VERB "%12.6" "" COMPU_TAB_REF CONV_TAB_E_SIGSTATUS_S6_S3 /end COMPU_METHOD
/begin COMPU_METHOD E_STATUSADA_S6_S3 "" TAB_VERB "%12.6" "" COMPU_TAB_REF CONV_TAB_E_STATUSADA_S6_S3 /end COMPU_METHOD
/begin COMPU_METHOD E_STATUSIAE_S6_S3 "" TAB_VERB "%12.6" "" COMPU_TAB_REF CONV_TAB_E_STATUSIAE_S6_S3 /end COMPU_METHOD
/begin COMPU_METHOD E_STATUSIEP_S6_S3 "" TAB_VERB "%12.6" "" COMPU_TAB_REF CONV_TAB_E_STATUSIEP_S6_S3 /end COMPU_METHOD
/begin COMPU_METHOD E_STATUSK0_S6_S3 "" TAB_VERB "%12.6" "" COMPU_TAB_REF CONV_TAB_E_STATUSK0_S6_S3 /end COMPU_METHOD
/begin COMPU_METHOD E_STATUSKSL_S6_S3 "" TAB_VERB "%12.6" "" COMPU_TAB_REF CONV_TAB_E_STATUSKSL_S6_S3 /end COMPU_METHOD
/begin COMPU_METHOD E_STATUSPSY_S6_S3 "" TAB_VERB "%12.6" "" COMPU_TAB_REF CONV_TAB_E_STATUSPSY_S6_S3 /end COMPU_METHOD
/begin COMPU_METHOD E_STBZHAS_S6_S3 "" TAB_VERB "%12.6" "" COMPU_TAB_REF CONV_TAB_E_STBZHAS_S6_S3 /end COMPU_METHOD
/begin COMPU_METHOD E_ZIEP_S6_S3 "" TAB_VERB "%12.6" "" COMPU_TAB_REF CONV_TAB_E_ZIEP_S6_S3 /end COMPU_METHOD
/begin COMPU_METHOD E_ZK0_S6_S3 "" TAB_VERB "%12.6" "" COMPU_TAB_REF CONV_TAB_E_ZK0_S6_S3 /end COMPU_METHOD
/begin COMPU_METHOD E_ZK0FSTIN_S6_S3 "" TAB_VERB "%12.6" "" COMPU_TAB_REF CONV_TAB_E_ZK0FSTIN_S6_S3 /end COMPU_METHOD
/begin COMPU_METHOD E_ZMODUSIAE_S6_S3 "" TAB_VERB "%12.6" "" COMPU_TAB_REF CONV_TAB_E_ZMODUSIAE_S6_S3 /end COMPU_METHOD
/begin COMPU_METHOD E_ZMODUSIEP_S6_S3 "" TAB_VERB "%12.6" "" COMPU_TAB_REF CONV_TAB_E_ZMODUSIEP_S6_S3 /end COMPU_METHOD
/begin COMPU_METHOD E_ZNLLSOLL_S6_S3 "" TAB_VERB "%12.6" "" COMPU_TAB_REF CONV_TAB_E_ZNLLSOLL_S6_S3 /end COMPU_METHOD
/begin COMPU_METHOD m_fl_S6_S3 "Masse" RAT_FUNC "%12.6" "kg" COEFFS 0 1 0 0 0 1 /end COMPU_METHOD
/begin COMPU_METHOD n_fl_S6_S3 "Drehzahl" RAT_FUNC "%12.6" "1/min" COEFFS 0 1 0 0 0 1 /end COMPU_METHOD
/begin COMPU_METHOD n_int_S6_S3 "Drehzahl" RAT_FUNC "%5.0" "1/min" COEFFS 0 1 0 0 0 1 /end COMPU_METHOD
/begin COMPU_METHOD ng_fl_S6_S3 "Drehzahlgradient" RAT_FUNC "%12.6" "1/min/s" COEFFS 0 1 0 0 0 1 /end COMPU_METHOD
/begin COMPU_METHOD p_fl_S6_S3 "Druck" RAT_FUNC "%12.6" "bar" COEFFS 0 1 0 0 0 1 /end COMPU_METHOD
/begin COMPU_METHOD phi_fl_S6_S3 "Winkel" RAT_FUNC "%12.6" "rad" COEFFS 0 1 0 0 0 1 /end COMPU_METHOD
/begin COMPU_METHOD SAB2_K40_S3_S3 "int = ((phys * 40) / 1) - (0) -" RAT_FUNC "%4.3" "-" COEFFS 0 40 0 0 0 1 /end COMPU_METHOD
/begin COMPU_METHOD SAB2_K_M125_S3_S3 "int = ((phys * 1) / 1) - (-125) -" RAT_FUNC "%1.0" "-" COEFFS 0 1 125 0 0 1 /end COMPU_METHOD
/begin COMPU_METHOD t_fl_k_S6_S3 "Zeit" RAT_FUNC "%3.0" "s" COEFFS 0 1 0 0 0 1 /end COMPU_METHOD
/begin COMPU_METHOD t_fl_S6_S3 "Zeit" RAT_FUNC "%12.6" "s" COEFFS 0 1 0 0 0 1 /end COMPU_METHOD
/begin COMPU_METHOD t_int_d_S6_S3 "Zeit" RAT_FUNC "%4.2" "s" COEFFS 0 100 0 0 0 1 /end COMPU_METHOD
/begin COMPU_METHOD t_int_S6_S3 "Zeit" RAT_FUNC "%11.2" "s" COEFFS 0 100 0 0 0 1 /end COMPU_METHOD
/begin COMPU_METHOD trq_fl_a_S6_S3 "Moment" RAT_FUNC "%12.6" "Nm" COEFFS 0 1 0 0 0 1 /end COMPU_METHOD
/begin COMPU_METHOD trq_fl_S6_S3 "Moment" RAT_FUNC "%5.0" "Nm" COEFFS 0 1 0 0 0 1 /end COMPU_METHOD
/begin COMPU_METHOD trqg_fl_c_S6_S3 "Momentengradient" RAT_FUNC "%12.6" "Nm/s" COEFFS 0 1 0 0 0 1 /end COMPU_METHOD
/begin COMPU_METHOD trqg_fl_S6_S3 "Momentengradient" RAT_FUNC "%5.0" "Nm/s" COEFFS 0 1 0 0 0 1 /end COMPU_METHOD
/begin COMPU_METHOD v_fl_S6_S3 "Geschwindigkeit" RAT_FUNC "%12.6" "km/h" COEFFS 0 1 0 0 0 1 /end COMPU_METHOD
/begin COMPU_METHOD vg_fl_S6_S3 "Geschwindigkeitsgradient" RAT_FUNC "%12.6" "km/h/s" COEFFS 0 1 0 0 0 1 /end COMPU_METHOD
/begin COMPU_METHOD void_fl_S6_S3 "ohne Umrechnung" RAT_FUNC "%12.6" "-" COEFFS 0 1 0 0 0 1 /end COMPU_METHOD
/begin COMPU_METHOD void_int_b_S6_S3 "ohne Umrechnung" RAT_FUNC "%5.0" "-" COEFFS 0 1 0 0 0 1 /end COMPU_METHOD
/begin COMPU_METHOD void_int_e_S6_S3 "ohne Umrechnung" RAT_FUNC "%1.0" "-" COEFFS 0 1 0 0 0 1 /end COMPU_METHOD
/begin COMPU_METHOD void_int_S6_S3 "ohne Umrechnung" RAT_FUNC "%3.0" "-" COEFFS 0 1 0 0 0 1 /end COMPU_METHOD
/begin COMPU_METHOD VOID_SCALING_f_S6_S3 "Void scaling for unscaled variables" RAT_FUNC "%12.6" "" COEFFS 0 1 0 0 0 1 /end COMPU_METHOD
/begin COMPU_METHOD VOID_SCALING_S6_S3 "Void scaling for unscaled variables" RAT_FUNC "%1.0" "" COEFFS 0 1 0 0 0 1 /end COMPU_METHOD
/begin CHARACTERISTIC BM_ERSFKT_HI_ZUST_HALTEN_HAS "Bitmaske zur Festlegung der Diagnose Ersatzfunktionen (HI-Byte) die zum Halten des aktuellen Soll-Betriebszustands der Hybrid-Zustandssteuerung führen" VALUE 0x197584 ULONG_COL_DIRECT_S6_S3 0 b_int_S6_S3 0 4294967295 /end CHARACTERISTIC
/begin CHARACTERISTIC BM_ERSFKT_HI_ZUST_INIT_HAS "Bitmaske zur Festlegung der Diagnose Ersatzfunktionen (HI-Byte) die zum Rücksprung des Soll-Betriebszustands der Hybrid-Zustandssteuerung in den Initialisierungszustand führen" VALUE 0x197588 ULONG_COL_DIRECT_S6_S3 0 b_int_S6_S3 0 4294967295 /end CHARACTERISTIC
/begin CHARACTERISTIC BM_ERSFKT_ZUST_HALTEN_HAS "Bitmaske zur Festlegung der Diagnose Ersatzfunktionen die zum Halten des aktuellen Soll-Betriebszustands der Hybrid-Zustandssteuerung führen" VALUE 0x19758C ULONG_COL_DIRECT_S6_S3 0 b_int_S6_S3 0 4294967295 /end CHARACTERISTIC
/begin CHARACTERISTIC BM_ERSFKT_ZUST_INIT_HAS "Bitmaske zur Festlegung der Diagnose Ersatzfunktionen die zum Rücksprung des Soll-Betriebszustands der Hybrid-Zustandssteuerung in den Initialisierungszustand führen" VALUE 0x197590 ULONG_COL_DIRECT_S6_S3 0 b_int_S6_S3 0 4294967295 /end CHARACTERISTIC
/begin CHARACTERISTIC BM_ZABSMSA_MSA_HAS "Bitmaske zur Festlegung der Anforderung der Beeinflussung der MSA-Funktionalität bei aktiven ABS-/ESP-Regelzuständen - Codierung wie z_msa_has_sbe" VALUE 0x1D75FA UBYTE_COL_DIRECT_S6_S3 0 void_int_S6_S3 0 255 /end CHARACTERISTIC
/begin CHARACTERISTIC BM_ZBERGMSA_MSA_HAS "Bitmaske zur Festlegung der Anforderung der Beeinflussung der MSA-Funktionalität  am Berg - Codierung wie z_msa_has_sbe" VALUE 0x1D75FB UBYTE_COL_DIRECT_S6_S3 0 void_int_S6_S3 0 255 /end CHARACTERISTIC
/begin CHARACTERISTIC BM_ZCGETRMSA_MSA_HAS "Bitmaske zur Festlegung der Anforderung der Beeinflussung der MSA-Funktionalität in Abhängigkeit der Getriebeöltemperatur - Codierung wie z_msa_has_sbe" VALUE 0x1D75FC UBYTE_COL_DIRECT_S6_S3 0 void_int_S6_S3 0 255 /end CHARACTERISTIC
/begin CHARACTERISTIC BM_ZDIAGERSFKT2_DIAG_MSA_HAS "Bitmaske zur Festlegung der Diagnose Ersatzfunktionen die zur zweiten Anforderung der Beeinflussung der MSA-Funktionalität bei aktiver Diagnose-Ersatzfunktion" VALUE 0x19798C ULONG_COL_DIRECT_S6_S3 0 b_int_S6_S3 0 4294967295 /end CHARACTERISTIC
/begin CHARACTERISTIC BM_ZDIAGERSFKTHI2_DIAG_MSA_HAS "Bitmaske zur Festlegung der Diagnose Ersatzfunktionen (HI-Byte) die zur zweiten Anforderung der Beeinflussung der MSA-Funktionalität bei aktiver Diagnose-Ersatzfunktion" VALUE 0x197990 ULONG_COL_DIRECT_S6_S3 0 b_int_S6_S3 0 4294967295 /end CHARACTERISTIC
/begin CHARACTERISTIC BM_ZDIAGMSA1_MSA_HAS "Bitmaske zur Festlegung der ersten Anforderung der Beeinflussung der MSA-Funktionalität bei aktiver Diagnose-Ersatzfunktion - Codierung wie z_msa_has_sbe" VALUE 0x1D75FD UBYTE_COL_DIRECT_S6_S3 0 void_int_S6_S3 0 255 /end CHARACTERISTIC
/begin CHARACTERISTIC BM_ZDIAGMSA2_MSA_HAS "Bitmaske zur Festlegung der zweiten Anforderung der Beeinflussung der MSA-Funktionalität bei aktiver Diagnose-Ersatzfunktion - Codierung wie z_msa_has_sbe" VALUE 0x1D75FE UBYTE_COL_DIRECT_S6_S3 0 void_int_S6_S3 0 255 /end CHARACTERISTIC
/begin CHARACTERISTIC BM_ZFSTMSA_MSA_HAS "Bitmaske zur Festlegung der Anforderung der Beeinflussung der MSA-Funktionalität  in Abhängigkeit der Vorgabe der Fahrstrategie - Codierung wie z_msa_has_sbe" VALUE 0x1D75FF UBYTE_COL_DIRECT_S6_S3 0 void_int_S6_S3 0 255 /end CHARACTERISTIC
/begin CHARACTERISTIC BM_ZIAEMSAKRI_MSA_HAS "Bitmaske zur Festlegung der Anforderung der Beeinflussung der MSA-Funktionalität in Abhängigkeit des IAE Betriebszustands Kriechen - Codierung wie z_msa_has_sbe" VALUE 0x1D7600 UBYTE_COL_DIRECT_S6_S3 0 void_int_S6_S3 0 255 /end CHARACTERISTIC
/begin CHARACTERISTIC BM_ZIAEMSASYN_MSA_HAS "Bitmaske zur Festlegung der Anforderung der Beeinflussung der MSA-Funktionalität in Abhängigkeit des IAE Betriebszustands Synchronisieren - Codierung wie z_msa_has_sbe" VALUE 0x1D7601 UBYTE_COL_DIRECT_S6_S3 0 void_int_S6_S3 0 255 /end CHARACTERISTIC
/begin CHARACTERISTIC BM_ZKFLMSA_MSA_HAS "Bitmaske zur Festlegung der Anforderung der Beeinflussung der MSA-Funktionalität  in Abhängigkeit des Kraftfluss-Status - Codierung wie z_msa_has_sbe" VALUE 0x1D7602 UBYTE_COL_DIRECT_S6_S3 0 void_int_S6_S3 0 255 /end CHARACTERISTIC
/begin CHARACTERISTIC BM_ZNDK0MSA_MSA_HAS "Bitmaske zur Festlegung der Anforderung der Beeinflussung der MSA-Funktionalität in Abhängigkeit der Differenzdrehzahl K0 - Codierung wie z_msa_has_sbe" VALUE 0x1D7603 UBYTE_COL_DIRECT_S6_S3 0 void_int_S6_S3 0 255 /end CHARACTERISTIC
/begin CHARACTERISTIC BM_ZSASMSAGE_MSA_HAS "Bitmaske zur Festlegung der Anforderung der Beeinflussung der MSA-Funktionalität bei aktivem Schaltablauf beim Gangeinlegen - Codierung wie z_msa_has_sbe" VALUE 0x1D7604 UBYTE_COL_DIRECT_S6_S3 0 void_int_S6_S3 0 255 /end CHARACTERISTIC
/begin CHARACTERISTIC BM_ZSTADAMSA_MSA_HAS "Bitmaske zur Freigabe der Anforderung der Beeinflussung der MSA-Funktionalität in Abhängigkeit der Vorgabe der Stillstandadaption - Codierung wie z_msa_has_sbe" VALUE 0x1D7605 UBYTE_COL_DIRECT_S6_S3 0 void_int_S6_S3 0 255 /end CHARACTERISTIC
/begin CHARACTERISTIC BM_ZVGFMSA_MSA_HAS "Bitmaske zur Festlegung der Anforderung der Beeinflussung der MSA-Funktionalität in Abhängigkeit des Fahrzeuggeschwindigkeitsgradienten - Codierung wie z_msa_has_sbe" VALUE 0x1D7606 UBYTE_COL_DIRECT_S6_S3 0 void_int_S6_S3 0 255 /end CHARACTERISTIC
/begin CHARACTERISTIC CS_GETR1_CGETR_LLS_HAS "Getriebeöltemperaturschwelle zur Aktivie-rung der Leerlaufsimulation in Abhängigkeit der Getriebeöltemperatur (Hotmode)" VALUE 0x197994 FLOAT32_IEEE_COL_DIRECT_S6_S3 0 c_int_S6_S3 -50 200 /end CHARACTERISTIC
/begin CHARACTERISTIC CS_GETR2_CGETR_LLS_HAS "Getriebeöltemperaturschwelle zur Deaktivierung der Leerlaufsimulation in Abhängigkeit der Getriebeöltemperatur (Hotmode)" VALUE 0x197998 FLOAT32_IEEE_COL_DIRECT_S6_S3 0 c_int_S6_S3 -50 200 /end CHARACTERISTIC
/begin CHARACTERISTIC CS_GETRIEBE_BBR_HAS "Temperaturschwelle für Ber. z_sas" VALUE 0x19799C FLOAT32_IEEE_COL_DIRECT_S6_S3 0 c_int_S6_S3 -30 100 /end CHARACTERISTIC
/begin CHARACTERISTIC CS_GETR_ALA_HAS "Temperaturschwelle für die Anlasserstart Anforderung" VALUE 0x1979A0 FLOAT32_IEEE_COL_DIRECT_S6_S3 0 c_int_S6_S3 -30 100 /end CHARACTERISTIC
/begin CHARACTERISTIC CS_GETR_CGETR_MSA_HAS "Getriebeöltemperaturschwelle zur Aktivierung der Beeinflussung der MSA-Funktionalität in Abhängigkeit der Getriebeöltemperatur" VALUE 0x1979A4 FLOAT32_IEEE_COL_DIRECT_S6_S3 0 c_int_S6_S3 -50 200 /end CHARACTERISTIC
/begin CHARACTERISTIC C_GETRIEBEEGS_ERSATZ_HAS "Ersatzwert fuer c_getriebe_egs_in (wenn SWI_ = 1)" VALUE 0x1D80A2 SWORD_COL_DIRECT_S6_S3 0 c_int_l_S6_S3 -32768 32767 /end CHARACTERISTIC
/begin CHARACTERISTIC C_GETRIEBE_OFFSET "Offset fuer c_getriebe_egs_in (wenn SWI_ = 1)" VALUE 0x1D80A4 SWORD_COL_DIRECT_S6_S3 0 c_int_l_S6_S3 -32768 32767 /end CHARACTERISTIC
/begin MEASUREMENT DD_SFSBo53_z_ndk0_msa_Bit2 "Anforderung der Beeinflussung der MSA-Funktionalität bei aktiven ABS-/ESP-Regelzuständen durch die Hybridablaufsteuerung - Codierung wie z_msa_has_sbe" UBYTE void_int_S6_S3 1 100 0 255 ECU_ADDRESS 0xFFF96D74 /end MEASUREMENT
/begin CHARACTERISTIC FK_MK0MBERZUS_HAS "Filterkoeffizient zur PT1-Filterung des K0-Moments der HAS zur Motormomentbe-grenzung in der SAB beim Zustart" VALUE 0x1979A8 FLOAT32_IEEE_COL_DIRECT_S6_S3 0 void_fl_S6_S3 0 1 /end CHARACTERISTIC
/begin CHARACTERISTIC FK_NGEM_ZUS "Filterkonstante zur Berechnung des EM-Drehzahlgradienten beim Zustart" VALUE 0x1D5D7C FLOAT32_IEEE_COL_DIRECT_S6_S3 0 void_fl_S6_S3 0 1 /end CHARACTERISTIC
/begin CHARACTERISTIC FK_NMINEMADAP_1_LLS_HAS "Filterkoeffizient zur PT2-Filterung des Referenzwerts der minimalen EM-Drehzahl der Leerlaufsimulation der HAS (LLS) - 1.PT1-Glied, Adaption aktiv!" VALUE 0x1979AC FLOAT32_IEEE_COL_DIRECT_S6_S3 0 void_fl_S6_S3 0 5 /end CHARACTERISTIC
/begin CHARACTERISTIC FK_NMINEMADAP_2_LLS_HAS "Filterkoeffizient zur PT2-Filterung des Referenzwerts der minimalen EM-Drehzahl der Leerlaufsimulation der HAS (LLS) - 2.PT1-Glied, Adaption aktiv!" VALUE 0x1979B0 FLOAT32_IEEE_COL_DIRECT_S6_S3 0 void_fl_S6_S3 0 5 /end CHARACTERISTIC
/begin CHARACTERISTIC FK_NMINEM_1_LLS_HAS "Filterkoeffizient zur PT2-Filterung des Referenzwerts der minimalen EM-Drehzahl der Leerlaufsimulation der HAS (LLS) - 1.PT1-Glied" VALUE 0x1979B4 FLOAT32_IEEE_COL_DIRECT_S6_S3 0 void_fl_S6_S3 0 5 /end CHARACTERISTIC
/begin CHARACTERISTIC FK_NMINEM_2_LLS_HAS "Filterkoeffizient zur PT2-Filterung des Referenzwerts der minimalen EM-Drehzahl der Leerlaufsimulation der HAS (LLS) - 2.PT1-Glied" VALUE 0x1979B8 FLOAT32_IEEE_COL_DIRECT_S6_S3 0 void_fl_S6_S3 0 5 /end CHARACTERISTIC
/begin CHARACTERISTIC GANGWECHSEL_EGS_ERSATZ_HAS "Ersatzwert fuer gangwechsel_egs_in (wenn SWI_ = 1)" VALUE 0x1D742E UBYTE_COL_DIRECT_S6_S3 0 void_int_S6_S3 0 1 /end CHARACTERISTIC
/begin CHARACTERISTIC ISTGANG_EGS_ERSATZ_HAS "Ersatzwert fuer istgang_egs_in (wenn SWI_ = 1)" VALUE 0x1D742F SBYTE_COL_DIRECT_S6_S3 0 void_int_S6_S3 -128 127 /end CHARACTERISTIC
/begin CHARACTERISTIC KF_FKMSTOERK0EM_ZUS_W "Filterkonstante beider PT1-Glieder der PT2 Filterung des K0-Störmoments der EM-Ansteuerung beim Zustart" MAP 0x1D5F1C FLOAT32_IEEE_COL_DIRECT_S6_S3 0 void_fl_S6_S3 0 1
 /begin AXIS_DESCR COM_AXIS c_getriebe_egs_in c_int_S6_S3 8 -3.40282e+038 3.40282e+038 DEPOSIT ABSOLUTE AXIS_PTS_REF KF_FKMSTOERK0EM_ZUS_X /end AXIS_DESCR
 /begin AXIS_DESCR COM_AXIS NO_INPUT_QUANTITY trq_fl_a_S6_S3 8 -3.40282e+038 3.40282e+038 DEPOSIT ABSOLUTE AXIS_PTS_REF KF_FKMSTOERK0EM_ZUS_Y /end AXIS_DESCR
/end CHARACTERISTIC
/begin AXIS_PTS KF_FKMSTOERK0EM_ZUS_X "Filterkonstante beider PT1-Glieder der PT2 Filterung des K0-Störmoments der EM-Ansteuerung beim Zustart" 0x1D601C c_getriebe_egs_in FLOAT32_IEEE_X_INCR_DIRECT_S6_S3 0 c_int_S6_S3 8 -3.40282e+038 3.40282e+038 DEPOSIT ABSOLUTE /end AXIS_PTS
/begin AXIS_PTS KF_FKMSTOERK0EM_ZUS_Y "Filterkonstante beider PT1-Glieder der PT2 Filterung des K0-Störmoments der EM-Ansteuerung beim Zustart" 0x1D603C NO_INPUT_QUANTITY FLOAT32_IEEE_X_INCR_DIRECT_S6_S3 0 trq_fl_a_S6_S3 8 -3.40282e+038 3.40282e+038 DEPOSIT ABSOLUTE /end AXIS_PTS
/begin CHARACTERISTIC KF_KMSTOERK0EMMOD_ZUS_W "Faktor zur Modifikation des K0-Störmoments der EM-Ansteuerung in Abhängigkeit des K0 Differenzdrehzahl und der EM-Drehzahl beim Zustart" MAP 0x1D605C FLOAT32_IEEE_COL_DIRECT_S6_S3 0 void_fl_S6_S3 0 2
 /begin AXIS_DESCR COM_AXIS nd_k0_in n_fl_S6_S3 10 -3.40282e+038 3.40282e+038 DEPOSIT ABSOLUTE AXIS_PTS_REF KF_KMSTOERK0EMMOD_ZUS_X /end AXIS_DESCR
 /begin AXIS_DESCR COM_AXIS n_em_in n_fl_S6_S3 8 -3.40282e+038 3.40282e+038 DEPOSIT ABSOLUTE AXIS_PTS_REF KF_KMSTOERK0EMMOD_ZUS_Y /end AXIS_DESCR
/end CHARACTERISTIC
/begin AXIS_PTS KF_KMSTOERK0EMMOD_ZUS_X "Faktor zur Modifikation des K0-Störmoments der EM-Ansteuerung in Abhängigkeit des K0 Differenzdrehzahl und der EM-Drehzahl beim Zustart" 0x1D619C nd_k0_in FLOAT32_IEEE_X_INCR_DIRECT_S6_S3 0 n_fl_S6_S3 10 -3.40282e+038 3.40282e+038 DEPOSIT ABSOLUTE /end AXIS_PTS
/begin AXIS_PTS KF_KMSTOERK0EMMOD_ZUS_Y "Faktor zur Modifikation des K0-Störmoments der EM-Ansteuerung in Abhängigkeit des K0 Differenzdrehzahl und der EM-Drehzahl beim Zustart" 0x1D61C4 n_em_in FLOAT32_IEEE_X_INCR_DIRECT_S6_S3 0 n_fl_S6_S3 8 -3.40282e+038 3.40282e+038 DEPOSIT ABSOLUTE /end AXIS_PTS
/begin CHARACTERISTIC KF_MEMRESVMSTART_HAS_W "Kennlinie fuer Momentenreserve EM ueber Ablaufvariante und VM-Startmoment" MAP 0x197AD0 FLOAT32_IEEE_COL_DIRECT_S6_S3 0 trq_fl_a_S6_S3 0 3.40282347e+038
 /begin AXIS_DESCR COM_AXIS NO_INPUT_QUANTITY void_int_b_S6_S3 5 -32768 32767 DEPOSIT ABSOLUTE AXIS_PTS_REF KF_MEMRESVMSTART_HAS_X /end AXIS_DESCR
 /begin AXIS_DESCR COM_AXIS m_vm_start_in trq_fl_a_S6_S3 6 -3.40282e+038 3.40282e+038 DEPOSIT ABSOLUTE AXIS_PTS_REF KF_MEMRESVMSTART_HAS_Y /end AXIS_DESCR
/end CHARACTERISTIC
/begin AXIS_PTS KF_MEMRESVMSTART_HAS_X "Kennlinie fuer Momentenreserve EM ueber Ablaufvariante und VM-Startmoment" 0x1D80FE NO_INPUT_QUANTITY SWORD_X_INCR_DIRECT_S6_S3 0 void_int_b_S6_S3 5 -32768 32767 DEPOSIT ABSOLUTE /end AXIS_PTS
/begin AXIS_PTS KF_MEMRESVMSTART_HAS_Y "Kennlinie fuer Momentenreserve EM ueber Ablaufvariante und VM-Startmoment" 0x197B48 m_vm_start_in FLOAT32_IEEE_X_INCR_DIRECT_S6_S3 0 trq_fl_a_S6_S3 6 -3.40282e+038 3.40282e+038 DEPOSIT ABSOLUTE /end AXIS_PTS
/begin CHARACTERISTIC KF_MK0MBERZUSBASIS_HAS_W "Basiswert des K0 Moments beim Zustart zur Bestimmung des K0-Moments der HAS zur Motormomentbegrenzung in der SAB in Abhaengigkeit des K0-Referenzmoments und der K0 Differenzdrehzahl" MAP 0x197B60 FLOAT32_IEEE_COL_DIRECT_S6_S3 0 trq_fl_a_S6_S3 -1000 1000
 /begin AXIS_DESCR COM_AXIS NO_INPUT_QUANTITY m_fl_S6_S3 7 -3.40282e+038 3.40282e+038 DEPOSIT ABSOLUTE AXIS_PTS_REF KF_MK0MBERZUSBASIS_HAS_X /end AXIS_DESCR
 /begin AXIS_DESCR COM_AXIS nd_k0_in n_fl_S6_S3 7 -3.40282e+038 3.40282e+038 DEPOSIT ABSOLUTE AXIS_PTS_REF KF_MK0MBERZUSBASIS_HAS_Y /end AXIS_DESCR
/end CHARACTERISTIC
/begin AXIS_PTS KF_MK0MBERZUSBASIS_HAS_X "Basiswert des K0 Moments beim Zustart zur Bestimmung des K0-Moments der HAS zur Motormomentbegrenzung in der SAB in Abhaengigkeit des K0-Referenzmoments und der K0 Differenzdrehzahl" 0x197C24 NO_INPUT_QUANTITY FLOAT32_IEEE_X_INCR_DIRECT_S6_S3 0 m_fl_S6_S3 7 -3.40282e+038 3.40282e+038 DEPOSIT ABSOLUTE /end AXIS_PTS
/begin AXIS_PTS KF_MK0MBERZUSBASIS_HAS_Y "Basiswert des K0 Moments beim Zustart zur Bestimmung des K0-Moments der HAS zur Motormomentbegrenzung in der SAB in Abhaengigkeit des K0-Referenzmoments und der K0 Differenzdrehzahl" 0x197C40 nd_k0_in FLOAT32_IEEE_X_INCR_DIRECT_S6_S3 0 n_fl_S6_S3 7 -3.40282e+038 3.40282e+038 DEPOSIT ABSOLUTE /end AXIS_PTS
/begin CHARACTERISTIC KF_MSOLLK0BEF_ANH_ZUS_W "Vorgabe des K0-Sollmoments in Abhängigkeit des VM-Zielmoments und des maximalen dynamischen EM Moments im Zustand Drehzahlanhebung beim VM Zustart" MAP 0x1D6910 FLOAT32_IEEE_COL_DIRECT_S6_S3 0 trq_fl_a_S6_S3 0 100
 /begin AXIS_DESCR COM_AXIS NO_INPUT_QUANTITY trq_fl_a_S6_S3 5 -3.40282e+038 3.40282e+038 DEPOSIT ABSOLUTE AXIS_PTS_REF KF_MSOLLK0BEF_ANH_ZUS_X /end AXIS_DESCR
 /begin AXIS_DESCR COM_AXIS NO_INPUT_QUANTITY trq_fl_a_S6_S3 5 -3.40282e+038 3.40282e+038 DEPOSIT ABSOLUTE AXIS_PTS_REF KF_MSOLLK0BEF_ANH_ZUS_Y /end AXIS_DESCR
/end CHARACTERISTIC
/begin AXIS_PTS KF_MSOLLK0BEF_ANH_ZUS_X "Vorgabe des K0-Sollmoments in Abhängigkeit des VM-Zielmoments und des maximalen dynamischen EM Moments im Zustand Drehzahlanhebung beim VM Zustart" 0x1D6974 NO_INPUT_QUANTITY FLOAT32_IEEE_X_INCR_DIRECT_S6_S3 0 trq_fl_a_S6_S3 5 -3.40282e+038 3.40282e+038 DEPOSIT ABSOLUTE /end AXIS_PTS
/begin AXIS_PTS KF_MSOLLK0BEF_ANH_ZUS_Y "Vorgabe des K0-Sollmoments in Abhängigkeit des VM-Zielmoments und des maximalen dynamischen EM Moments im Zustand Drehzahlanhebung beim VM Zustart" 0x1D6988 NO_INPUT_QUANTITY FLOAT32_IEEE_X_INCR_DIRECT_S6_S3 0 trq_fl_a_S6_S3 5 -3.40282e+038 3.40282e+038 DEPOSIT ABSOLUTE /end AXIS_PTS
/begin CHARACTERISTIC KF_NS_NEM_ALA_HAS_W "Das Anlasserwunschbit wird bis zu dieser EM Drehzahlschwelle gesetzt" MAP 0x197D8C FLOAT32_IEEE_COL_DIRECT_S6_S3 0 n_fl_S6_S3 -50 1500
 /begin AXIS_DESCR COM_AXIS istgang_egs_in void_int_S6_S3 10 -128 127 DEPOSIT ABSOLUTE AXIS_PTS_REF KF_NS_NEM_ALA_HAS_X /end AXIS_DESCR
 /begin AXIS_DESCR COM_AXIS abstellpos_vm_status_in void_int_S6_S3 8 0 255 DEPOSIT ABSOLUTE AXIS_PTS_REF KF_NS_NEM_ALA_HAS_Y /end AXIS_DESCR
/end CHARACTERISTIC
/begin AXIS_PTS KF_NS_NEM_ALA_HAS_X "X-Achse: istgang_egs_in" 0x1D8108 istgang_egs_in SBYTE_X_INCR_DIRECT_S6_S3 0 void_int_S6_S3 10 -128 127 DEPOSIT ABSOLUTE /end AXIS_PTS
/begin AXIS_PTS KF_NS_NEM_ALA_HAS_Y "Y-Achse: abstellpos_vm_in" 0x198118 abstellpos_vm_status_in UBYTE_X_INCR_DIRECT_S6_S3 0 void_int_S6_S3 8 0 255 DEPOSIT ABSOLUTE /end AXIS_PTS
/begin CHARACTERISTIC KF_ZIELGANGISTGANG_ALA_HAS_W "Beeinflussung z_start_modus =f(zielgang, istgang)" MAP 0x198120 UBYTE_COL_DIRECT_S6_S3 0 void_int_S6_S3 0 1
 /begin AXIS_DESCR COM_AXIS zielgang_egs_in void_int_S6_S3 8 -128 127 DEPOSIT ABSOLUTE AXIS_PTS_REF KF_ZIELGANGISTGANG_ALA_HAS_X /end AXIS_DESCR
 /begin AXIS_DESCR COM_AXIS istgang_egs_in void_int_S6_S3 8 -128 127 DEPOSIT ABSOLUTE AXIS_PTS_REF KF_ZIELGANGISTGANG_ALA_HAS_Y /end AXIS_DESCR
/end CHARACTERISTIC
/begin AXIS_PTS KF_ZIELGANGISTGANG_ALA_HAS_X "X-Achse: Zielgang" 0x198160 zielgang_egs_in SBYTE_X_INCR_DIRECT_S6_S3 0 void_int_S6_S3 8 -128 127 DEPOSIT ABSOLUTE /end AXIS_PTS
/begin AXIS_PTS KF_ZIELGANGISTGANG_ALA_HAS_Y "Y-Achse: Istgang" 0x198168 istgang_egs_in SBYTE_X_INCR_DIRECT_S6_S3 0 void_int_S6_S3 8 -128 127 DEPOSIT ABSOLUTE /end AXIS_PTS
/begin CHARACTERISTIC KF_ZNOMINEMGANG_LLS_HAS_W "Unterdrückung der Drehzahlausgabe n_min_em_has_sbe abhängig von Ist- und Zielgang" MAP 0x198170 UBYTE_COL_DIRECT_S6_S3 0 void_int_S6_S3 0 255
 /begin AXIS_DESCR COM_AXIS istgang_egs_in void_int_S6_S3 8 -128 127 DEPOSIT ABSOLUTE AXIS_PTS_REF KF_ZNOMINEMGANG_LLS_HAS_X /end AXIS_DESCR
 /begin AXIS_DESCR COM_AXIS zielgang_egs_in void_int_S6_S3 8 -128 127 DEPOSIT ABSOLUTE AXIS_PTS_REF KF_ZNOMINEMGANG_LLS_HAS_Y /end AXIS_DESCR
/end CHARACTERISTIC
/begin AXIS_PTS KF_ZNOMINEMGANG_LLS_HAS_X "Eingang: Istagng, Unterdrückung der Drehzahlausgabe n_min_em_has_sbe abhängig von Ist- und Zielgang" 0x1981B0 istgang_egs_in SBYTE_X_INCR_DIRECT_S6_S3 0 void_int_S6_S3 8 -128 127 DEPOSIT ABSOLUTE /end AXIS_PTS
/begin AXIS_PTS KF_ZNOMINEMGANG_LLS_HAS_Y "Eingang: Zielgang, Unterdrückung der Drehzahlausgabe n_min_em_has_sbe abhängig von Ist- und Zielgang" 0x1981B8 zielgang_egs_in SBYTE_X_INCR_DIRECT_S6_S3 0 void_int_S6_S3 8 -128 127 DEPOSIT ABSOLUTE /end AXIS_PTS
/begin AXIS_PTS KL_ABLAUFVARIANTE_HAS_HST_IN_X "Anpassung der Codierung der Ablaufvariante an Hybridstrategie" 0x1D7525 z_ablaufvariante_has_hst_portin UBYTE_X_INCR_DIRECT_S6_S3 0 void_int_S6_S3 17 0 99 DEPOSIT ABSOLUTE /end AXIS_PTS
/begin CHARACTERISTIC KL_ABLAUFVARIANTE_HAS_HST_IN_Y "Anpassung der Codierung der Ablaufvariante an Hybridstrategie" CURVE 0x1D7536 UBYTE_COL_DIRECT_S6_S3 0 void_int_S6_S3 0 99
 /begin AXIS_DESCR COM_AXIS z_ablaufvariante_has_hst_portin void_int_S6_S3 17 0 99 DEPOSIT ABSOLUTE AXIS_PTS_REF KL_ABLAUFVARIANTE_HAS_HST_IN_X /end AXIS_DESCR
/end CHARACTERISTIC
/begin AXIS_PTS KL_ABLVARZSASAKTIV_BBR_HAS_X "Ablaufvariante zur Beeinflussung der K0 Ansteuerung im Zustandsübergang I-NIT_KL15 (14) nach LADEN (5) (Änderung der Befüllreihenfolge) durch die HAS" 0x1981C0 z_ablaufvariante_has_stg UBYTE_X_INCR_DIRECT_S6_S3 0 void_int_S6_S3 8 0 99 DEPOSIT ABSOLUTE /end AXIS_PTS
/begin CHARACTERISTIC KL_ABLVARZSASAKTIV_BBR_HAS_Y "Ablaufvariante zur Beeinflussung der K0 Ansteuerung im Zustandsübergang I-NIT_KL15 (14) nach LADEN (5) (Änderung der Befüllreihenfolge) durch die HAS" CURVE 0x1981C8 UBYTE_COL_DIRECT_S6_S3 0 void_int_S6_S3 0 1
 /begin AXIS_DESCR COM_AXIS z_ablaufvariante_has_stg void_int_S6_S3 8 0 99 DEPOSIT ABSOLUTE AXIS_PTS_REF KL_ABLVARZSASAKTIV_BBR_HAS_X /end AXIS_DESCR
/end CHARACTERISTIC
/begin AXIS_PTS KL_KSVHRESET_ANH_ZUS_X "Ruecksetzen einer Schaltverhinderung in Abhängigkeit des Istgangs im Zustand VM-Drehzahlanhebung beim Zustart (255 = alle Arten von Schaltungen zuruecksetzen, 0 = keine Schaltung zuruecksetzen) -> Bit-Codierung siehe Handbuch" 0x1D72E0 NO_INPUT_QUANTITY SBYTE_X_INCR_DIRECT_S6_S3 0 void_int_S6_S3 8 -1 8 DEPOSIT ABSOLUTE /end AXIS_PTS
/begin CHARACTERISTIC KL_KSVHRESET_ANH_ZUS_Y "Ruecksetzen einer Schaltverhinderung in Abhängigkeit des Istgangs im Zustand VM-Drehzahlanhebung beim Zustart (255 = alle Arten von Schaltungen zuruecksetzen, 0 = keine Schaltung zuruecksetzen) -> Bit-Codierung siehe Handbuch" CURVE 0x1D72E8 UBYTE_COL_DIRECT_S6_S3 0 void_int_S6_S3 0 255
 /begin AXIS_DESCR COM_AXIS NO_INPUT_QUANTITY void_int_S6_S3 8 -1 8 DEPOSIT ABSOLUTE AXIS_PTS_REF KL_KSVHRESET_ANH_ZUS_X /end AXIS_DESCR
/end CHARACTERISTIC
/begin AXIS_PTS KL_KSVHRESET_SYN_ZUS_X "Ruecksetzen einer Schaltverhinderung in Abhängigkeit des Istgangs im Zustand K0-Synchronisieren beim Zustart (255 = alle Arten von Schaltungen zuruecksetzen, 0 = keine Schaltung zuruecksetzen) -> Bit-Codierung siehe Handbuch" 0x1D7300 NO_INPUT_QUANTITY SBYTE_X_INCR_DIRECT_S6_S3 0 void_int_S6_S3 8 -1 8 DEPOSIT ABSOLUTE /end AXIS_PTS
/begin CHARACTERISTIC KL_KSVHRESET_SYN_ZUS_Y "Ruecksetzen einer Schaltverhinderung in Abhängigkeit des Istgangs im Zustand K0-Synchronisieren beim Zustart (255 = alle Arten von Schaltungen zuruecksetzen, 0 = keine Schaltung zuruecksetzen) -> Bit-Codierung siehe Handbuch" CURVE 0x1D7308 UBYTE_COL_DIRECT_S6_S3 0 void_int_S6_S3 0 255
 /begin AXIS_DESCR COM_AXIS NO_INPUT_QUANTITY void_int_S6_S3 8 -1 8 DEPOSIT ABSOLUTE AXIS_PTS_REF KL_KSVHRESET_SYN_ZUS_X /end AXIS_DESCR
/end CHARACTERISTIC
/begin AXIS_PTS KL_MK0MODK0BEF_ZUS_X "Modifiziertes K0-Moment der HAS in Abhängigkeit des K0 Istmoments in den Zustaenden der K0-Befüllung ZST, SAK, ANH, ABF beim Zustart" 0x1D6EB0 NO_INPUT_QUANTITY FLOAT32_IEEE_X_INCR_DIRECT_S6_S3 0 trq_fl_a_S6_S3 6 -3.40282e+038 3.40282e+038 DEPOSIT ABSOLUTE /end AXIS_PTS
/begin CHARACTERISTIC KL_MK0MODK0BEF_ZUS_Y "Modifiziertes K0-Moment der HAS in Abhängigkeit des K0 Istmoments in den Zustaenden der K0-Befüllung ZST, SAK, ANH, ABF beim Zustart" CURVE 0x1D6EC8 FLOAT32_IEEE_COL_DIRECT_S6_S3 0 trq_fl_a_S6_S3 0 1000
 /begin AXIS_DESCR COM_AXIS NO_INPUT_QUANTITY trq_fl_a_S6_S3 6 -3.40282e+038 3.40282e+038 DEPOSIT ABSOLUTE AXIS_PTS_REF KL_MK0MODK0BEF_ZUS_X /end AXIS_DESCR
/end CHARACTERISTIC
/begin AXIS_PTS KL_MOMAXDYNEM_LASTANH_SVH_HAS_X "" 0x197F70 mg_wunsch_fpw FLOAT32_IEEE_X_INCR_DIRECT_S6_S3 0 trqg_fl_c_S6_S3 8 -3.40282e+038 3.40282e+038 DEPOSIT ABSOLUTE /end AXIS_PTS
/begin CHARACTERISTIC KL_MOMAXDYNEM_LASTANH_SVH_HAS_Y "Momentenoffset zur Erkennung Lastanhe-bung in Relation zum maximalen dynami-schen EM Moment des Status des Lastän-derungszustands der Schaltverhinderung der HAS" CURVE 0x197F90 FLOAT32_IEEE_COL_DIRECT_S6_S3 0 trq_fl_a_S6_S3 -1000 1000
 /begin AXIS_DESCR COM_AXIS mg_wunsch_fpw trqg_fl_c_S6_S3 8 -3.40282e+038 3.40282e+038 DEPOSIT ABSOLUTE AXIS_PTS_REF KL_MOMAXDYNEM_LASTANH_SVH_HAS_X /end AXIS_DESCR
/end CHARACTERISTIC
/begin AXIS_PTS KL_MSOLLK0EMANK_FUW_ZUS_X "K0 Sollmoment zur Ankoppelung der EM an den VM bei EM-Fehlfunktion der Funktionsüberwachung der EM-Funktion beim Zustart in Abhängigkeit der Getriebeöltemperatur" 0x1D6FA0 NO_INPUT_QUANTITY FLOAT32_IEEE_X_INCR_DIRECT_S6_S3 0 trq_fl_a_S6_S3 8 -3.40282e+038 3.40282e+038 DEPOSIT ABSOLUTE /end AXIS_PTS
/begin CHARACTERISTIC KL_MSOLLK0EMANK_FUW_ZUS_Y "K0 Sollmoment zur Ankoppelung der EM an den VM bei EM-Fehlfunktion der Funktionsüberwachung der EM-Funktion beim Zustart in Abhängigkeit der Getriebeöltemperatur" CURVE 0x1D6FC0 FLOAT32_IEEE_COL_DIRECT_S6_S3 0 trq_fl_a_S6_S3 0 1000
 /begin AXIS_DESCR COM_AXIS NO_INPUT_QUANTITY trq_fl_a_S6_S3 8 -3.40282e+038 3.40282e+038 DEPOSIT ABSOLUTE AXIS_PTS_REF KL_MSOLLK0EMANK_FUW_ZUS_X /end AXIS_DESCR
/end CHARACTERISTIC
/begin AXIS_PTS KL_MSOLLK0KALTNEM_ANH_ZUS_X "K0 Sollmoment zur Ankoppelung der EM an den VM beim Kaltstart mit abgesenkter EM Drehzahl in Abhängigkeit der Getriebeöltemperatur im Zustand Drehzahlanhebung beim VM Zustart" 0x1D6FE0 NO_INPUT_QUANTITY FLOAT32_IEEE_X_INCR_DIRECT_S6_S3 0 trq_fl_a_S6_S3 8 -3.40282e+038 3.40282e+038 DEPOSIT ABSOLUTE /end AXIS_PTS
/begin CHARACTERISTIC KL_MSOLLK0KALTNEM_ANH_ZUS_Y "K0 Sollmoment zur Ankoppelung der EM an den VM beim Kaltstart mit abgesenkter EM Drehzahl in Abhängigkeit der Getriebeöltemperatur im Zustand Drehzahlanhebung beim VM Zustart" CURVE 0x1D7000 FLOAT32_IEEE_COL_DIRECT_S6_S3 0 trq_fl_a_S6_S3 0 1000
 /begin AXIS_DESCR COM_AXIS NO_INPUT_QUANTITY trq_fl_a_S6_S3 8 -3.40282e+038 3.40282e+038 DEPOSIT ABSOLUTE AXIS_PTS_REF KL_MSOLLK0KALTNEM_ANH_ZUS_X /end AXIS_DESCR
/end CHARACTERISTIC
/begin AXIS_PTS KL_MSSOLLEMAKTIV_ZUS_X "Schwelle des K0-Störmoments bzw. des EM-Sollmoments zur Aktivierung der Maximalzeit der Ausgabe des EM-Vorsteuermoments beim Zustart in Abhängigkeit des Istgangs" 0x1D8E2A istgang_egs_in SBYTE_X_INCR_DIRECT_S6_S3 0 void_int_S6_S3 10 -128 127 DEPOSIT ABSOLUTE /end AXIS_PTS
/begin CHARACTERISTIC KL_MSSOLLEMAKTIV_ZUS_Y "Schwelle des K0-Störmoments bzw. des EM-Sollmoments zur Aktivierung der Maximalzeit der Ausgabe des EM-Vorsteuermoments beim Zustart in Abhängigkeit des Istgangs" CURVE 0x1D7048 FLOAT32_IEEE_COL_DIRECT_S6_S3 0 trq_fl_a_S6_S3 0 1000
 /begin AXIS_DESCR COM_AXIS istgang_egs_in void_int_S6_S3 10 -128 127 DEPOSIT ABSOLUTE AXIS_PTS_REF KL_MSSOLLEMAKTIV_ZUS_X /end AXIS_DESCR
/end CHARACTERISTIC
/begin AXIS_PTS KL_MS_MMOTNEG_ALA_HAS_X "Momentenschwelle zur Bestimmung ob das Anlasserwunschbit beim entsprechenden Getriebeeingangsmoment gesetzt werden soll" 0x1D811C istgang_egs_in SBYTE_X_INCR_DIRECT_S6_S3 0 void_int_S6_S3 10 -1 8 DEPOSIT ABSOLUTE /end AXIS_PTS
/begin CHARACTERISTIC KL_MS_MMOTNEG_ALA_HAS_Y "Momentenschwelle zur Bestimmung ob das Anlasserwunschbit beim entsprechenden Getriebeeingangsmoment gesetzt werden soll" CURVE 0x197FD8 FLOAT32_IEEE_COL_DIRECT_S6_S3 0 trq_fl_a_S6_S3 -100 100
 /begin AXIS_DESCR COM_AXIS istgang_egs_in void_int_S6_S3 10 -1 8 DEPOSIT ABSOLUTE AXIS_PTS_REF KL_MS_MMOTNEG_ALA_HAS_X /end AXIS_DESCR
/end CHARACTERISTIC
/begin AXIS_PTS KL_MS_MMOTPOS_ALA_HAS_X "Momentenschwelle zur Bestimmung ob das Anlasserwunschbit beim entsprechenden Getriebeeingangsmoment gesetzt werden soll" 0x1D8126 istgang_egs_in SBYTE_X_INCR_DIRECT_S6_S3 0 void_int_S6_S3 10 -1 8 DEPOSIT ABSOLUTE /end AXIS_PTS
/begin CHARACTERISTIC KL_MS_MMOTPOS_ALA_HAS_Y "Momentenschwelle zur Bestimmung ob das Anlasserwunschbit beim entsprechenden Getriebeeingangsmoment gesetzt werden soll" CURVE 0x198000 FLOAT32_IEEE_COL_DIRECT_S6_S3 0 trq_fl_a_S6_S3 -100 100
 /begin AXIS_DESCR COM_AXIS istgang_egs_in void_int_S6_S3 10 -1 8 DEPOSIT ABSOLUTE AXIS_PTS_REF KL_MS_MMOTPOS_ALA_HAS_X /end AXIS_DESCR
/end CHARACTERISTIC
/begin AXIS_PTS KL_NMINEMCGETR_LLS_HAS_X "Festlegung der Minimaldrehzahl bei hoher Getriebeöltemperatur in Abhängigkeit der Getriebeöltemperatur zur Ausgabe als minimale EM-Drehzahl der Leer-laufsimulation der HAS (LLS)" 0x198028 c_getriebe_egs_in FLOAT32_IEEE_X_INCR_DIRECT_S6_S3 0 c_int_S6_S3 4 -3.40282e+038 3.40282e+038 DEPOSIT ABSOLUTE /end AXIS_PTS
/begin CHARACTERISTIC KL_NMINEMCGETR_LLS_HAS_Y "Festlegung der Minimaldrehzahl bei hoher Getriebeöltemperatur in Abhängigkeit der Getriebeöltemperatur zur Ausgabe als minimale EM-Drehzahl der Leer-laufsimulation der HAS (LLS)" CURVE 0x198038 FLOAT32_IEEE_COL_DIRECT_S6_S3 0 n_fl_S6_S3 0 10000
 /begin AXIS_DESCR COM_AXIS c_getriebe_egs_in c_int_S6_S3 4 -3.40282e+038 3.40282e+038 DEPOSIT ABSOLUTE AXIS_PTS_REF KL_NMINEMCGETR_LLS_HAS_X /end AXIS_DESCR
/end CHARACTERISTIC
/begin AXIS_PTS KL_NMINEMIAEADAP_LLS_HAS_X "" 0x198048 c_getriebe_egs_in FLOAT32_IEEE_X_INCR_DIRECT_S6_S3 0 c_int_S6_S3 6 -3.40282e+038 3.40282e+038 DEPOSIT ABSOLUTE /end AXIS_PTS
/begin CHARACTERISTIC KL_NMINEMIAEADAP_LLS_HAS_Y "Festlegung der Minimaldrehzahl der IAE-Adaption in Abhängigkeit der Getriebeöltemperatur zur Ausgabe als minimale EM-Drehzahl der Leerlaufsimulation der HAS (LLS)" CURVE 0x198060 FLOAT32_IEEE_COL_DIRECT_S6_S3 0 n_fl_S6_S3 -3.40282e+038 3.40282e+038
 /begin AXIS_DESCR COM_AXIS c_getriebe_egs_in c_int_S6_S3 6 -3.40282e+038 3.40282e+038 DEPOSIT ABSOLUTE AXIS_PTS_REF KL_NMINEMIAEADAP_LLS_HAS_X /end AXIS_DESCR
/end CHARACTERISTIC
/begin AXIS_PTS KL_NMINEMK0ADAP_LLS_HAS_X "" 0x198078 c_getriebe_egs_in FLOAT32_IEEE_X_INCR_DIRECT_S6_S3 0 c_int_S6_S3 6 -3.40282e+038 3.40282e+038 DEPOSIT ABSOLUTE /end AXIS_PTS
/begin CHARACTERISTIC KL_NMINEMK0ADAP_LLS_HAS_Y "Festlegung der Minimaldrehzahl der K0-Adaption in Abhängigkeit der Getriebeöltemperatur zur Ausgabe als minimale EM-Drehzahl der Leerlaufsimulation der HAS (LLS)" CURVE 0x198090 FLOAT32_IEEE_COL_DIRECT_S6_S3 0 n_fl_S6_S3 -3.40282e+038 3.40282e+038
 /begin AXIS_DESCR COM_AXIS c_getriebe_egs_in c_int_S6_S3 6 -3.40282e+038 3.40282e+038 DEPOSIT ABSOLUTE AXIS_PTS_REF KL_NMINEMK0ADAP_LLS_HAS_X /end AXIS_DESCR
/end CHARACTERISTIC
/begin AXIS_PTS KL_NMINEMSTADA_LLS_HAS_X "Festlegung der Minimaldrehzahl der Schaltkupplungs-Adaption in Abhängigkeit der Getriebeöltemperatur zur Ausgabe als minimale EM-Drehzahl der Leerlaufsimulation der HAS (LLS)" 0x1980A8 c_getriebe_egs_in FLOAT32_IEEE_X_INCR_DIRECT_S6_S3 0 c_int_S6_S3 6 -10000 10000 DEPOSIT ABSOLUTE /end AXIS_PTS
/begin CHARACTERISTIC KL_NMINEMSTADA_LLS_HAS_Y "Festlegung der Minimaldrehzahl der Schaltkupplungs-Adaption in Abhängigkeit der Getriebeöltemperatur zur Ausgabe als minimale EM-Drehzahl der Leerlaufsimulation der HAS (LLS)" CURVE 0x1980C0 FLOAT32_IEEE_COL_DIRECT_S6_S3 0 n_fl_S6_S3 0 10000
 /begin AXIS_DESCR COM_AXIS c_getriebe_egs_in c_int_S6_S3 6 -10000 10000 DEPOSIT ABSOLUTE AXIS_PTS_REF KL_NMINEMSTADA_LLS_HAS_X /end AXIS_DESCR
/end CHARACTERISTIC
/begin AXIS_PTS KL_TVMSTOERK0EMFIL_ZUS_X "Verzögerungszeit nach Beginn der K0 Befüllung zur Aktivierung der Filterung des K0-Störmoments der EM-Ansteuerung beim Zustart in Abhängigkeit der Getriebeöltemperatur" 0x1D7240 c_getriebe_egs_in FLOAT32_IEEE_X_INCR_DIRECT_S6_S3 0 c_int_S6_S3 8 -3.40282e+038 3.40282e+038 DEPOSIT ABSOLUTE /end AXIS_PTS
/begin CHARACTERISTIC KL_TVMSTOERK0EMFIL_ZUS_Y "Verzögerungszeit nach Beginn der K0 Befüllung zur Aktivierung der Filterung des K0-Störmoments der EM-Ansteuerung beim Zustart in Abhängigkeit der Getriebeöltemperatur" CURVE 0x1D7260 FLOAT32_IEEE_COL_DIRECT_S6_S3 0 t_fl_S6_S3 0 10
 /begin AXIS_DESCR COM_AXIS c_getriebe_egs_in c_int_S6_S3 8 -3.40282e+038 3.40282e+038 DEPOSIT ABSOLUTE AXIS_PTS_REF KL_TVMSTOERK0EMFIL_ZUS_X /end AXIS_DESCR
/end CHARACTERISTIC
/begin AXIS_PTS KL_TZSASHASMAX_BBR_HAS_X "Maximaler Zeitraum nach Erkennung der Betriebsbereitschaft des Hybridsystems in dem die  Beeinflussung der SAS Befüllreihenfolge durch die HAS aktiv ist" 0x1980D8 c_getriebe_egs_in FLOAT32_IEEE_X_INCR_DIRECT_S6_S3 0 c_int_S6_S3 8 -127 1000 DEPOSIT ABSOLUTE /end AXIS_PTS
/begin CHARACTERISTIC KL_TZSASHASMAX_BBR_HAS_Y "Maximaler Zeitraum nach Erkennung der Betriebsbe-reitschaft des Hybridsystems in dem die  Beeinflussung der SAS Befüllreihenfolge durch die HAS aktiv ist" CURVE 0x1980F8 FLOAT32_IEEE_COL_DIRECT_S6_S3 0 t_fl_S6_S3 -1000 1000000
 /begin AXIS_DESCR COM_AXIS c_getriebe_egs_in c_int_S6_S3 8 -127 1000 DEPOSIT ABSOLUTE AXIS_PTS_REF KL_TZSASHASMAX_BBR_HAS_X /end AXIS_DESCR
/end CHARACTERISTIC
/begin AXIS_PTS KL_ZMSOLLEMAKTIVSTKFL_ZUS_X "Festlegung der Bedingung zur Aktivierung der Maximalzeit der Ausgabe des EM-Sollmoments beim Zustart in Abhängigkeit des Status Kraftfluss" 0x1D8049 status_kraftfluss_egs_in UBYTE_X_INCR_DIRECT_S6_S3 0 void_int_S6_S3 7 0 255 DEPOSIT ABSOLUTE /end AXIS_PTS
/begin CHARACTERISTIC KL_ZMSOLLEMAKTIVSTKFL_ZUS_Y "Festlegung der Bedingung zur Aktivierung der Maximalzeit der Ausgabe des EM-Sollmoments beim Zustart in Abhängigkeit des Status Kraftfluss" CURVE 0x1D8050 UBYTE_COL_DIRECT_S6_S3 0 void_int_S6_S3 0 1
 /begin AXIS_DESCR COM_AXIS status_kraftfluss_egs_in void_int_S6_S3 7 0 255 DEPOSIT ABSOLUTE AXIS_PTS_REF KL_ZMSOLLEMAKTIVSTKFL_ZUS_X /end AXIS_DESCR
/end CHARACTERISTIC
/begin AXIS_PTS KL_ZVMSTARTABLVAR_SST_BFI_HAS_X "" 0x1981D0 z_ablaufvariante_has_stg UBYTE_X_INCR_DIRECT_S6_S3 0 void_int_S6_S3 8 0 99 DEPOSIT ABSOLUTE /end AXIS_PTS
/begin CHARACTERISTIC KL_ZVMSTARTABLVAR_SST_BFI_HAS_Y "Festlegung der VM-Startanforderung in Abhängigkeit der Ablaufvariante der HAS innerhalb der Funktion zur Beeinflussung der IEP durch die HAS bei SST-Betätigung" CURVE 0x1981D8 UBYTE_COL_DIRECT_S6_S3 0 void_int_S6_S3 0 1
 /begin AXIS_DESCR COM_AXIS z_ablaufvariante_has_stg void_int_S6_S3 8 0 99 DEPOSIT ABSOLUTE AXIS_PTS_REF KL_ZVMSTARTABLVAR_SST_BFI_HAS_X /end AXIS_DESCR
/end CHARACTERISTIC
/begin AXIS_PTS KL_ZVMSTARTVOREIL_SST_BFI_HAS_X "Festlegung der voreilenden VM-Startanforderung in Abhängigkeit der Ablaufvariante der HST innerhalb der Funktion zur Beeinflussung der IEP durch die HAS bei SST-Betätigung" 0x1981E0 z_ablaufvariante_has_hst_in UBYTE_X_INCR_DIRECT_S6_S3 0 void_int_S6_S3 8 0 99 DEPOSIT ABSOLUTE /end AXIS_PTS
/begin CHARACTERISTIC KL_ZVMSTARTVOREIL_SST_BFI_HAS_Y "Festlegung der voreilenden VM-Startanforderung in Abhängigkeit der Ablaufvariante der HST innerhalb der Funktion zur Beeinflussung der IEP durch die HAS bei SST-Betätigung" CURVE 0x1981E8 UBYTE_COL_DIRECT_S6_S3 0 void_int_S6_S3 0 1
 /begin AXIS_DESCR COM_AXIS z_ablaufvariante_has_hst_in void_int_S6_S3 8 0 99 DEPOSIT ABSOLUTE AXIS_PTS_REF KL_ZVMSTARTVOREIL_SST_BFI_HAS_X /end AXIS_DESCR
/end CHARACTERISTIC
/begin CHARACTERISTIC KOLBENPOS_FAKTOR "Faktor für Umrechnung HEX-PHYS" VALUE 0x19759C FLOAT32_IEEE_COL_DIRECT_S6_S3 0 void_fl_S6_S3 -3.40282e+038 3.40282e+038 /end CHARACTERISTIC
/begin CHARACTERISTIC K_NSOLLLLVM_LLS_HAS "Faktor zur Berücksichtigung der LL-Solldrehzahl des VM bei der Bestimmung der minimalen EM-Drehzahl der Leerlaufsimulation der HAS (LLS)" VALUE 0x1979BC FLOAT32_IEEE_COL_DIRECT_S6_S3 0 void_fl_S6_S3 0 2 /end CHARACTERISTIC
/begin CHARACTERISTIC K_SVH_RESETLAUSABLABBR_SRT_ZUS "Ruecksetzen Schaltverhinderung bei bereits laufender Schaltung und vorherigem Ablauf-Abbruch im Zustand Start beim Zustart (255 = alle Arten von Schaltungen zuruecksetzen, 0 = keine Schaltung zuruecksetzen)  Bit-Codierung siehe Handbuch" VALUE 0x1D8018 UBYTE_COL_DIRECT_S6_S3 0 void_int_S6_S3 0 255 /end CHARACTERISTIC
/begin CHARACTERISTIC K_SVH_RESETLAUS_SRT_ZUS "Ruecksetzen Schaltverhinderung bei bereits laufender Schaltung im Zustand Start beim Zustart (255 = alle Arten von Schaltungen zuruecksetzen, 0 = keine Schaltung zuruecksetzen)  Bit-Codierung siehe Handbuch" VALUE 0x1D8019 UBYTE_COL_DIRECT_S6_S3 0 void_int_S6_S3 0 255 /end CHARACTERISTIC
/begin CHARACTERISTIC K_SVH_RESET_ABB_ZUS "Rücksetzen einer Schaltverhinderung während VM-Zustart beim Abbruch Zustart (255 = alle Arten von Schaltungen zurücksetzen, 0 = keine Schaltung zurücksetzen) -> Bit-Codierung siehe Handbuch" VALUE 0x1D801A UBYTE_COL_DIRECT_S6_S3 0 void_int_S6_S3 0 255 /end CHARACTERISTIC
/begin CHARACTERISTIC MGO_WUNSCHFPW_LASTANH_SVH_HAS "Gradientenschwelle zur Bestimmung des Status des Laständerungszustands der Schaltverhinderung der HAS" VALUE 0x1979C0 FLOAT32_IEEE_COL_DIRECT_S6_S3 0 trqg_fl_c_S6_S3 0 60000 /end CHARACTERISTIC
/begin CHARACTERISTIC MGS_WUNSCHFPW_LASTANH_SVH_HAS "Gradientenschwelle zur Bestimmung des Status des Laständerungszustands der Schaltverhinderung der HAS" VALUE 0x1979C4 FLOAT32_IEEE_COL_DIRECT_S6_S3 0 trqg_fl_c_S6_S3 -30000 30000 /end CHARACTERISTIC
/begin CHARACTERISTIC MG_EMRESVMSTART_HAS "Momentengradient zum Abbau des EM-Reservemoment beim VM-Start" VALUE 0x1D80FA SWORD_COL_DIRECT_S6_S3 0 trqg_fl_S6_S3 -32768 32767 /end CHARACTERISTIC
/begin CHARACTERISTIC MG_K0MBERZUSNEG_HAS "Negativer Grenzgradient des K0-Moments der HAS zur Motormomentbegrenzung in der SAB beim Zustart" VALUE 0x1979C8 FLOAT32_IEEE_COL_DIRECT_S6_S3 0 trqg_fl_c_S6_S3 -50000 0 /end CHARACTERISTIC
/begin CHARACTERISTIC MG_K0MBERZUSPOS_HAS "Positiver Grenzgradient des K0-Moments der HAS zur Motormomentbegrenzung in der SAB beim Zustart" VALUE 0x1979CC FLOAT32_IEEE_COL_DIRECT_S6_S3 0 trqg_fl_c_S6_S3 0 50000 /end CHARACTERISTIC
/begin CHARACTERISTIC MG_SOLLK0EMANKPOS_FUW_ZUS "Gradient des K0 Sollmoments zur Ankopplung der EM an den VM bei Erkennung EM Fehlfunktion der Funktionsüberwachung der EM Funktion beim Zustart" VALUE 0x1D5DBC FLOAT32_IEEE_COL_DIRECT_S6_S3 0 trqg_fl_c_S6_S3 0 50000 /end CHARACTERISTIC
/begin CHARACTERISTIC MG_SOLLK0NEG_ANH_ZUS "Negativer Gradient des K0 Sollmoments zur Begrenzung der K0 Vorsteuerung im Zustand Drehzahlanhebung beim VM Zustart" VALUE 0x1D5DD8 FLOAT32_IEEE_COL_DIRECT_S6_S3 0 trqg_fl_c_S6_S3 -10000 0 /end CHARACTERISTIC
/begin CHARACTERISTIC MG_SOLLK0POSKALTNEM_ANH_ZUS "Gradient des K0 Sollmoment zur Ankoppelung der EM an den VM beim Kaltstart mit abgesenkter EM Drehzahl im Zustand Drehzahlanhebung beim VM Zustart" VALUE 0x1D5DE4 FLOAT32_IEEE_COL_DIRECT_S6_S3 0 trqg_fl_c_S6_S3 0 50000 /end CHARACTERISTIC
/begin CHARACTERISTIC MG_SOLLK0POS_ANH_ZUS "Positiver Gradient des K0 Sollmoments zur Begrenzung der K0 Vorsteuerung im Zustand Drehzahlanhebung beim VM Zustart" VALUE 0x1D5DF4 FLOAT32_IEEE_COL_DIRECT_S6_S3 0 trqg_fl_c_S6_S3 0 10000 /end CHARACTERISTIC
/begin CHARACTERISTIC MO_WUNSCHFPW_ZUG_SVH_HAS "Offset zur Momentenschwelle zur Bestimmung des Status des Lastzustands Zug der Schaltverhinderung der HAS" VALUE 0x1979D4 FLOAT32_IEEE_COL_DIRECT_S6_S3 0 trq_fl_a_S6_S3 0 2000 /end CHARACTERISTIC
/begin CHARACTERISTIC MS_K0MSTOERK0EMFIL_ZUS "K0-Momentenschwelle zur Initialisierung der Filterung des K0-Störmoments der EM-Ansteuerung beim Zustart" VALUE 0x1D5E2C FLOAT32_IEEE_COL_DIRECT_S6_S3 0 trq_fl_a_S6_S3 -1000 1000 /end CHARACTERISTIC
/begin CHARACTERISTIC MS_MMOTHYS_ALA_HAS "Hysterese zur Bestimmung des Anlasserwunschbits beim entsprechenden Getrie-beeingangsmomnet" VALUE 0x1979D8 FLOAT32_IEEE_COL_DIRECT_S6_S3 0 trq_fl_a_S6_S3 0 20 /end CHARACTERISTIC
/begin CHARACTERISTIC MS_WUNSCHFPWTVSRSSAS_MSA_HAS "Momentenschwelle zur Erkennung Schubbetrieb zur Initialisierung der Verzögerungs-zeit zur Rücknahme der Anforderung der Beeinflussung der MSA-Funktionalität bei aktivem Schaltablauf bei Schub RS im Hybridfahren" VALUE 0x1979DC FLOAT32_IEEE_COL_DIRECT_S6_S3 0 trq_fl_a_S6_S3 -1000 1000 /end CHARACTERISTIC
/begin CHARACTERISTIC MS_WUNSCHFPW_ZUG_SVH_HAS "Momentenschwelle zur Bestimmung des Status des Lastzustands Zug der Schaltverhinderung der HAS" VALUE 0x1979E0 FLOAT32_IEEE_COL_DIRECT_S6_S3 0 trq_fl_a_S6_S3 -1000 1000 /end CHARACTERISTIC
/begin CHARACTERISTIC MS_WUNSCHK0HYS_ANH_ZUS "Schwelle für das gefilterte Fahrerwunschmoment der HST zum Setzen des K0-Hystereseflags der HAS im Zustand VM-Drehzahlanhebung beim Zustart" VALUE 0x1D5E3C FLOAT32_IEEE_COL_DIRECT_S6_S3 0 trq_fl_a_S6_S3 -1000 1000 /end CHARACTERISTIC
/begin CHARACTERISTIC MS_ZIELVMHASK0HYS_ANH_ZUS "Schwelle für das VM-Zielmoment zum Setzen des K0-Hystereseflags der HAS im Zustand VM-Drehzahlanhebung beim Zustart" VALUE 0x1D5E40 FLOAT32_IEEE_COL_DIRECT_S6_S3 0 trq_fl_a_S6_S3 -1000 1000 /end CHARACTERISTIC
/begin CHARACTERISTIC M_EM_ERSATZ_HAS "Ersatzwert fuer m_em_in (wenn SWI_ = 1)" VALUE 0x1D80A6 SWORD_COL_DIRECT_S6_S3 0 trq_fl_S6_S3 -32768 32767 /end CHARACTERISTIC
/begin CHARACTERISTIC M_IAE_ERSATZ_HAS "Ersatzwert fuer m_iae_in (wenn SWI_ = 1)" VALUE 0x1D80A8 SWORD_COL_DIRECT_S6_S3 0 trq_fl_S6_S3 -32768 32767 /end CHARACTERISTIC
/begin CHARACTERISTIC M_K0MBERMAX_HAS "Maximalwert des K0-Moments der HAS zur Motormomentbegrenzung in der SAB" VALUE 0x1979EC FLOAT32_IEEE_COL_DIRECT_S6_S3 0 trq_fl_a_S6_S3 0 1000 /end CHARACTERISTIC
/begin CHARACTERISTIC M_K0_ERSATZ_HAS "Ersatzwert fuer m_k0_in (wenn SWI_ = 1)" VALUE 0x1D80AA SWORD_COL_DIRECT_S6_S3 0 trq_fl_S6_S3 -32768 32767 /end CHARACTERISTIC
/begin CHARACTERISTIC M_MAXDYNEM_ERSATZ_HAS "Ersatzwert fuer m_max_dyn_em_in (wenn SWI_ = 1)" VALUE 0x1D80AC SWORD_COL_DIRECT_S6_S3 0 trq_fl_S6_S3 -32768 32767 /end CHARACTERISTIC
/begin CHARACTERISTIC M_MINDYNEM_ERSATZ_HAS "Ersatzwert fuer m_min_dyn_em_in (wenn SWI_ = 1)" VALUE 0x1D80AE SWORD_COL_DIRECT_S6_S3 0 trq_fl_S6_S3 -32768 32767 /end CHARACTERISTIC
/begin CHARACTERISTIC M_MOT_ERSATZ_HAS "Ersatzwert fuer m_mot_in (wenn SWI_ = 1)" VALUE 0x1D80B2 SWORD_COL_DIRECT_S6_S3 0 trq_fl_S6_S3 -1024 1024 /end CHARACTERISTIC
/begin CHARACTERISTIC M_SOLLEMHST_ERSATZ_HAS "Ersatzwert fuer m_soll_em_hst_in (wenn SWI_ = 1)" VALUE 0x1D80B4 SWORD_COL_DIRECT_S6_S3 0 trq_fl_S6_S3 -32768 32767 /end CHARACTERISTIC
/begin CHARACTERISTIC M_SOLLVMHST_ERSATZ_HAS "Ersatzwert fuer m_soll_vm_hst_in (wenn SWI_ = 1)" VALUE 0x1D80B6 SWORD_COL_DIRECT_S6_S3 0 trq_fl_S6_S3 -32768 32767 /end CHARACTERISTIC
/begin CHARACTERISTIC M_VMSTART_ERSATZ_HAS "Ersatzwert fuer m_vm_start_in (wenn SWI_ = 1)" VALUE 0x1D80BA SWORD_COL_DIRECT_S6_S3 0 trq_fl_S6_S3 -32768 32767 /end CHARACTERISTIC
/begin CHARACTERISTIC M_VM_ERSATZ_HAS "Ersatzwert fuer m_vm_in (wenn SWI_ = 1)" VALUE 0x1D80BC SWORD_COL_DIRECT_S6_S3 0 trq_fl_S6_S3 -32768 32767 /end CHARACTERISTIC
/begin CHARACTERISTIC M_WUNSCHFPW_ERSATZ_HAS "Ersatzwert fuer m_wunsch_fpw_in (wenn SWI_ = 1)" VALUE 0x1D80C0 SWORD_COL_DIRECT_S6_S3 0 trq_fl_S6_S3 -32768 32767 /end CHARACTERISTIC
/begin CHARACTERISTIC NDS_K01_NDK0_MSA_HAS "Untere negative Differenzdrehzahlschwelle der K0 zur Aktivierung der Beeinflussung der MSA-Funktionalität in Abhängigkeit der Differenzdrehzahl der K0" VALUE 0x1979F0 FLOAT32_IEEE_COL_DIRECT_S6_S3 0 n_fl_S6_S3 -10000 0 /end CHARACTERISTIC
/begin CHARACTERISTIC NDS_K02_NDK0_MSA_HAS "Obere negative Differenzdrehzahlschwelle der K0 zur Deaktivierung der Beeinflussung der MSA-Funktionalität in Abhängigkeit der Differenzdrehzahl der K0" VALUE 0x1979F4 FLOAT32_IEEE_COL_DIRECT_S6_S3 0 n_fl_S6_S3 -10000 0 /end CHARACTERISTIC
/begin CHARACTERISTIC NDS_K0_GE_NDK0_MSA_HAS "Differenzdrehzahlschwelle zur Erkennung von einer zu grossen ND_K0 während Gangeinle-gen" VALUE 0x1979F8 FLOAT32_IEEE_COL_DIRECT_S6_S3 0 n_fl_S6_S3 -10000 10000 /end CHARACTERISTIC
/begin CHARACTERISTIC NDS_VMNEMBED_ANH_ZUS "Schwellwert der Differenzdrehzahl zwischen VM und EM Drehzahl als Übergangsbedingung nach K0 Synchronisieren im Zustand Drehzahlanhebung beim Zustart" VALUE 0x1D5E78 FLOAT32_IEEE_COL_DIRECT_S6_S3 0 n_fl_S6_S3 -10000 0 /end CHARACTERISTIC
/begin CHARACTERISTIC NDS_VMNEMK0HYS_ANH_ZUS "Schwellwert der Differenzdrehzahl zwischen VM und EM Drehzahl zur Aktivierung der Logik zur Rücknahme des K0-Hystereseflags im Zustand VM Drehzahlanhebung beim Zustart" VALUE 0x1D5E7C FLOAT32_IEEE_COL_DIRECT_S6_S3 0 n_fl_S6_S3 -10000 10000 /end CHARACTERISTIC
/begin CHARACTERISTIC NDS_VMNEMSVHRESET_ANH_ZUS "Schwellwert der Differenzdrehzahl zwischen VM und EM Drehzahl zum Setzen der SVH Reset-Anforderung des Zustands K0-Synchronisieren bereits im Zustand VM Drehzahlanhebung beim Zustart" VALUE 0x1D5E84 FLOAT32_IEEE_COL_DIRECT_S6_S3 0 n_fl_S6_S3 -10000 0 /end CHARACTERISTIC
/begin CHARACTERISTIC NG_MINEMMAXADAP_LLS_HAS "Maximaler Drehzahlgradient der ungefilterten minimalen EM-Drehzahl der Leerlauf-simulation der HAS (LLS) bei anstehenden Adaptionen" VALUE 0x1979FC FLOAT32_IEEE_COL_DIRECT_S6_S3 0 ng_fl_S6_S3 0 50000 /end CHARACTERISTIC
/begin CHARACTERISTIC NG_MINEMMAX_LLS_HAS "Maximaler Drehzahlgradient der ungefilterten minimalen EM-Drehzahl der Leerlaufsimulation der HAS (LLS)" VALUE 0x197A00 FLOAT32_IEEE_COL_DIRECT_S6_S3 0 ng_fl_S6_S3 0 50000 /end CHARACTERISTIC
/begin CHARACTERISTIC NG_MINEMMIN_LLS_HAS "Minimaler Drehzahlgradient der ungefilterten minimalen EM-Drehzahl der Leerlaufsimulation der HAS (LLS)" VALUE 0x197A04 FLOAT32_IEEE_COL_DIRECT_S6_S3 0 ng_fl_S6_S3 -50000 0 /end CHARACTERISTIC
/begin CHARACTERISTIC NO_EMMINEMREF_LLS_HAS "Offset auf die LL-Solldrehzahl des VM als EM-Drehzahlschwelle zur Aktivierung des IAE Hybrid Betriebsmodus E-Fahren Kraftschluss" VALUE 0x197A10 FLOAT32_IEEE_COL_DIRECT_S6_S3 0 n_fl_S6_S3 -10000 10000 /end CHARACTERISTIC
/begin CHARACTERISTIC NO_EMNMINEMINIT_LLS_HAS "Drehzahl-Offset auf EM-Drehzahl der HAS zur Initialisierung des Gradientenbegrenzers und PT2-Filters" VALUE 0x197A14 FLOAT32_IEEE_COL_DIRECT_S6_S3 0 n_fl_S6_S3 -10000 10000 /end CHARACTERISTIC
/begin CHARACTERISTIC NO_SOLLLLVM_BMI_HAS "Offset auf die LL-Solldrehzahl des VM als EM-Drehzahlschwelle zur Aktivierung des IAE Hybrid Betriebsmodus E-Fahren Kraftschluss" VALUE 0x197A18 FLOAT32_IEEE_COL_DIRECT_S6_S3 0 n_fl_S6_S3 -10000 10000 /end CHARACTERISTIC
/begin CHARACTERISTIC NS_EMEMAKTIV_FUW_ZUS "EM Drehzahlschwelle zur Erkennung der EM Fehlfunktion der Funktionsüberwachung der EM Funktion beim Zustart" VALUE 0x1D5E9C FLOAT32_IEEE_COL_DIRECT_S6_S3 0 n_fl_S6_S3 0 10000 /end CHARACTERISTIC
/begin CHARACTERISTIC NS_EMEMFEHLER_FUW_ZUS "EM Drehzahlschwelle zur Berücksichtigung der EM-Fehleranzeige durch die Diagnose in der Funktionsüberwachung der EM-Funktion beim Zustart" VALUE 0x1D5EA0 FLOAT32_IEEE_COL_DIRECT_S6_S3 0 n_fl_S6_S3 0 10000 /end CHARACTERISTIC
/begin CHARACTERISTIC NS_EMK0HYS_ANH_ZUS "EM-Drehzahlschwelle zur Aktivierung der Logik zur Rücknahme des K0 Hystereseflags im Zustand VM Drehzahlanhebung beim Zustart" VALUE 0x1D5EA4 FLOAT32_IEEE_COL_DIRECT_S6_S3 0 n_fl_S6_S3 0 2000 /end CHARACTERISTIC
/begin CHARACTERISTIC NS_EMSVHRESET_ANH_ZUS "EM-Drehzahlschwelle zum Setzen der SVH Reset-Anforderung des Zustands K0-Synchronisieren bereits im Zustand VM Drehzahlanhebung beim Zustart" VALUE 0x1D5EC0 FLOAT32_IEEE_COL_DIRECT_S6_S3 0 n_fl_S6_S3 0 10000 /end CHARACTERISTIC
/begin CHARACTERISTIC NS_EM_NDK0_MSA_HAS "EM Drehzahlschwelle zur Aktivierung der Beeinflussung der MSA-Funktionalität bei geringer EM Drehzahl in Abhängigkeit der Differenzdrehzahl der K0 zum Schutz der K0" VALUE 0x197A1C FLOAT32_IEEE_COL_DIRECT_S6_S3 0 n_fl_S6_S3 0 10000 /end CHARACTERISTIC
/begin CHARACTERISTIC NS_EM_STATUSEFAHRENMOD2_HAS "EM Drehzahlschwelle zur Sicherstellung der Ölversorgung bei der Rücknahme des Status E-Fahren im Umschaltmodus 2 der Bestimmung des Status E-Fahren der HAS" VALUE 0x197A20 FLOAT32_IEEE_COL_DIRECT_S6_S3 0 n_fl_S6_S3 0 10000 /end CHARACTERISTIC
/begin CHARACTERISTIC NS_EM_STATUSEFAHRENMOD3_HAS "EM Drehzahlschwelle zur Sicherstellung der Ölversorgung beim Setzen des Status E-Fahren im Umschaltmodus 3 der Bestimmung des Status E-Fahren der HAS" VALUE 0x197A24 FLOAT32_IEEE_COL_DIRECT_S6_S3 0 n_fl_S6_S3 0 10000 /end CHARACTERISTIC
/begin CHARACTERISTIC NS_MINEMZIEP_BMI_HAS "EM Drehzahlschwelle zur Berücksichtigung des Ansteuerstatus der IEP bei der Deaktivierung des IAE Hybrid Betriebsmodus E-Fahren Kraftschluss" VALUE 0x197A28 FLOAT32_IEEE_COL_DIRECT_S6_S3 0 n_fl_S6_S3 0 10000 /end CHARACTERISTIC
/begin CHARACTERISTIC NS_VM1_NDK0_MSA_HAS "Erste VM Drehzahlschwelle zur Aktivierung der Beeinflussung der MSA-Funktionalität K0 bei geringer EM Drehzahl in Abhängigkeit der Differenzdrehzahl der zum Schutz der K0" VALUE 0x197A2C FLOAT32_IEEE_COL_DIRECT_S6_S3 0 n_fl_S6_S3 0 10000 /end CHARACTERISTIC
/begin CHARACTERISTIC NS_VM2_NDK0_MSA_HAS "Zweite VM Drehzahlschwelle zur Aktivierung der Beeinflussung der MSA-Funktionalität bei geringer EM Drehzahl in Abhängigkeit der Differenzdrehzahl der K0 zum Schutz der K0" VALUE 0x197A30 FLOAT32_IEEE_COL_DIRECT_S6_S3 0 n_fl_S6_S3 0 10000 /end CHARACTERISTIC
/begin CHARACTERISTIC NS_VMSTART_BFI_HAS "VM Drehzahlschwelle zur Deaktivierung der Beeinflussung der IEP durch die HAS bei einem ZSE-Start" VALUE 0x197A34 FLOAT32_IEEE_COL_DIRECT_S6_S3 0 n_fl_S6_S3 0 10000 /end CHARACTERISTIC
/begin CHARACTERISTIC N_ABEGS_ERSATZ_HAS "Ersatzwert fuer n_ab_egs_in (wenn SWI_ = 1)" VALUE 0x1D80C2 UWORD_COL_DIRECT_S6_S3 0 n_int_S6_S3 0 65535 /end CHARACTERISTIC
/begin CHARACTERISTIC N_EM_ERSATZ_HAS "Ersatzwert fuer n_em_in (wenn SWI_ = 1)" VALUE 0x1D80C4 UWORD_COL_DIRECT_S6_S3 0 n_int_S6_S3 0 65535 /end CHARACTERISTIC
/begin CHARACTERISTIC N_MINEMBEFUELLFZP_LLS_HAS "Festlegung der EM Minimaldrehzahl bei Anforderung zur Befuellung des Ansaugkanals bei Uebergang Init-x" VALUE 0x197A38 FLOAT32_IEEE_COL_DIRECT_S6_S3 0 n_fl_S6_S3 0 10000 /end CHARACTERISTIC
/begin CHARACTERISTIC N_MINEMEFAHRENPVU_LLS_HAS "Festlegung der Minimaldrehzahl bei aktiver Unterstuetzung der Positionsventil-Ueberwachung  durch die HAS im Zustand EFahren zur Ausgabe als minimale EM-Drehzahl der HAS-Leerlaufsimulation (LLS)" VALUE 0x197A3C FLOAT32_IEEE_COL_DIRECT_S6_S3 0 n_fl_S6_S3 0 10000 /end CHARACTERISTIC
/begin CHARACTERISTIC N_MINEMIAE_LLS_HAS "Festlegung der Minimaldrehzahl bei allgemeiner Anforderung durch das IAE-Modul zur Ausgabe als minimale EM-Drehzahl der Leerlaufsimulation der HAS (LLS)" VALUE 0x197A40 FLOAT32_IEEE_COL_DIRECT_S6_S3 0 n_fl_S6_S3 0 10000 /end CHARACTERISTIC
/begin CHARACTERISTIC N_MINEMKFL_LLS_HAS "Festlegung der Minimaldrehzahl in Abhän-gigkeit des Kraftfluss-Status zur Sicherstellung der Ölversorgung bei einem in Neutral rollenden Fahrzeug zur Ausgabe als minimale EM-Drehzahl der Leerlaufsimulation der HAS (LLS)" VALUE 0x197A44 FLOAT32_IEEE_COL_DIRECT_S6_S3 0 n_fl_S6_S3 0 10000 /end CHARACTERISTIC
/begin CHARACTERISTIC N_MINEMPARKSP_LLS_HAS "Festlegung der Minimaldrehzahl bei Anforderung durch ATSYS bei Auslegen der Parksperre zur Ausgabe als minimale EM-Drehzahl der HAS-Leerlaufsimulation (LLS)" VALUE 0x197A48 FLOAT32_IEEE_COL_DIRECT_S6_S3 0 n_fl_S6_S3 0 10000 /end CHARACTERISTIC
/begin CHARACTERISTIC N_MINEMSTALAENGSADAOFF_LLS_HAS "Festlegung der EM Minimaldrehzahl bei status_alaengs_adaoff = 0" VALUE 0x197A4C FLOAT32_IEEE_COL_DIRECT_S6_S3 0 n_fl_S6_S3 0 10000 /end CHARACTERISTIC
/begin CHARACTERISTIC N_MINEMVMSTARTENPVU_LLS_HAS "Festlegung der Minimaldrehzahl bei aktiver Unterstuetzung der Positionsventil-Ueberwachung  durch die HAS beim VM Starten zur Ausgabe als minimale EM-Drehzahl der HAS-Leerlaufsimulation (LLS)" VALUE 0x197A50 FLOAT32_IEEE_COL_DIRECT_S6_S3 0 n_fl_S6_S3 0 10000 /end CHARACTERISTIC
/begin CHARACTERISTIC N_MOT_SOLL_IAE_ERSATZ_HAS "Ersatzwert fuer n_mot_soll_iae_portin" VALUE 0x1D80C6 UWORD_COL_DIRECT_S6_S3 0 n_int_S6_S3 0 10000 /end CHARACTERISTIC
/begin CHARACTERISTIC N_SOLLLLVM_ERSATZ_HAS "Ersatzwert fuer n_soll_ll_vm_in (wenn SWI_ = 1)" VALUE 0x1D80CA UWORD_COL_DIRECT_S6_S3 0 n_int_S6_S3 0 65535 /end CHARACTERISTIC
/begin CHARACTERISTIC N_TEGS_ERSATZ_HAS "Ersatzwert fuer n_t_egs_in (wenn SWI_ = 1)" VALUE 0x1D80CC UWORD_COL_DIRECT_S6_S3 0 n_int_S6_S3 0 65535 /end CHARACTERISTIC
/begin CHARACTERISTIC N_VM_ERSATZ_HAS "Ersatzwert fuer n_vm_in (wenn SWI_ = 1)" VALUE 0x1D80CE UWORD_COL_DIRECT_S6_S3 0 n_int_S6_S3 0 65535 /end CHARACTERISTIC
/begin CHARACTERISTIC OSMODE_NEXT_ERSATZ_HAS "Ersatzwert osmode_next_in (Ersatzwert bei 1)" VALUE 0x1D7430 UBYTE_COL_DIRECT_S6_S3 0 void_int_S6_S3 0 255 /end CHARACTERISTIC
/begin CHARACTERISTIC PHIS_NEIGUNGD1_BERG_MSA_HAS "Schwellwert des Fahrzeugneigungswinkels zur Aktivierung der Beeinflussung der MSA-Funktionalität am Berg an der Steigung in Position D - Steigung = positiver Wert " VALUE 0x197A54 FLOAT32_IEEE_COL_DIRECT_S6_S3 0 phi_fl_S6_S3 0 42 /end CHARACTERISTIC
/begin CHARACTERISTIC PHIS_NEIGUNGD2_BERG_MSA_HAS "Schwellwert des Fahrzeugneigungswinkels zur Deaktivierung der Beeinflussung der MSA-Funktionalität am Berg an der Stei-gung in Position D - Steigung = positiver Wert" VALUE 0x197A58 FLOAT32_IEEE_COL_DIRECT_S6_S3 0 phi_fl_S6_S3 0 42 /end CHARACTERISTIC
/begin CHARACTERISTIC PHIS_NEIGUNGR1_BERG_MSA_HAS "Schwellwert des Fahrzeugneigungswinkels zur Aktivierung der Beeinflussung der MSA-Funktionalität am Berg im Gefaelle in Position R - Gefaelle = negativer Wert " VALUE 0x197A5C FLOAT32_IEEE_COL_DIRECT_S6_S3 0 phi_fl_S6_S3 -42 0 /end CHARACTERISTIC
/begin CHARACTERISTIC PHIS_NEIGUNGR2_BERG_MSA_HAS "Schwellwert des Fahrzeugneigungswinkels zur Deaktivierung der Beeinflussung der MSA-Funktionalität am Berg im Gefaelle in Position R - Gefaelle = negativer Wert" VALUE 0x197A60 FLOAT32_IEEE_COL_DIRECT_S6_S3 0 phi_fl_S6_S3 -42 0 /end CHARACTERISTIC
/begin CHARACTERISTIC PHI_NEIGUNG_ERSATZ_HAS "Ersatzwert fuer phi_neigung_in(wenn SWI_ = 1)" VALUE 0x1975A4 FLOAT32_IEEE_COL_DIRECT_S6_S3 0 phi_fl_S6_S3 -42 42 /end CHARACTERISTIC
/begin CHARACTERISTIC POS_EGS_ERSATZ_HAS "Ersatzwert fuer pos_egs_in (wenn SWI_ = 1)" VALUE 0x1D7431 UBYTE_COL_DIRECT_S6_S3 0 void_int_S6_S3 0 8 /end CHARACTERISTIC
/begin CHARACTERISTIC PO_BREMSE_ZUG_SVH_HAS "Offset zur  Bremsdruckschwelle zur Bestimmung des Status des Lastzustands Zug der Schaltverhinderung der HAS" VALUE 0x197A64 FLOAT32_IEEE_COL_DIRECT_S6_S3 0 p_fl_S6_S3 0 127 /end CHARACTERISTIC
/begin CHARACTERISTIC PS_BREMSEMOT_ALA_HAS "Bremsdruckschwelle ab der in bestimmen Gängen das Anlasserwunschbit nicht gestzt werden soll" VALUE 0x197A68 FLOAT32_IEEE_COL_DIRECT_S6_S3 0 void_fl_S6_S3 0 127 /end CHARACTERISTIC
/begin CHARACTERISTIC PS_BREMSE_ZUG_SVH_HAS "Bremsdruckschwelle zur Bestimmung des Status des Lastzustands Zug der Schaltverhinderung der HAS" VALUE 0x197A6C FLOAT32_IEEE_COL_DIRECT_S6_S3 0 p_fl_S6_S3 0 127 /end CHARACTERISTIC
/begin CHARACTERISTIC P_BREMSEFZG_ERSATZ_HAS "Ersatzwert fuer p_bremse_fzg_in (wenn SWI_ = 1)" VALUE 0x1D80D0 UWORD_COL_DIRECT_S6_S3 0 void_int_b_S6_S3 0 65535 /end CHARACTERISTIC
/begin MEASUREMENT SFOp_Zus307_KL__K0EMANK_FUW_ZUS "" FLOAT32_IEEE VOID_SCALING_f_S6_S3 1 100 -3.40282e+038 3.40282e+038 ECU_ADDRESS 0xFFF96B40 /end MEASUREMENT
/begin MEASUREMENT SFOp_Zus309_KL_MK0MODK0BEF_ZUS "" FLOAT32_IEEE VOID_SCALING_f_S6_S3 1 100 -3.40282e+038 3.40282e+038 ECU_ADDRESS 0xFFF96B44 /end MEASUREMENT
/begin MEASUREMENT SFOp_Zus309_KL__K0EMANK_FUW_ZUS "" FLOAT32_IEEE VOID_SCALING_f_S6_S3 1 100 -3.40282e+038 3.40282e+038 ECU_ADDRESS 0xFFF96B48 /end MEASUREMENT
/begin MEASUREMENT SFOp_Zus309_KL__KALTNEM_ANH_ZUS "" FLOAT32_IEEE VOID_SCALING_f_S6_S3 1 100 -3.40282e+038 3.40282e+038 ECU_ADDRESS 0xFFF96B4C /end MEASUREMENT
/begin MEASUREMENT SFOp_Zus313_out_ "" FLOAT32_IEEE VOID_SCALING_f_S6_S3 1 100 -3.40282e+038 3.40282e+038 ECU_ADDRESS 0xFFF96C00 /end MEASUREMENT
/begin MEASUREMENT SFOp_Zus317_KL__VHRESET_ANH_ZUS "" UBYTE void_int_S6_S3 1 100 0 255 ECU_ADDRESS 0xFFF86572 /end MEASUREMENT
/begin MEASUREMENT SFOp_Zus318_KL__VHRESET_SYN_ZUS "" UBYTE void_int_S6_S3 1 100 0 255 ECU_ADDRESS 0xFFF86573 /end MEASUREMENT
/begin MEASUREMENT SFOp_Zus78_xp_ "" FLOAT32_IEEE VOID_SCALING_f_S6_S3 1 100 -3.40282e+038 3.40282e+038 ECU_ADDRESS 0xFFF96C38 /end MEASUREMENT
/begin MEASUREMENT SFOp_Zus89_x2_ "" FLOAT32_IEEE VOID_SCALING_f_S6_S3 1 100 -3.40282e+038 3.40282e+038 ECU_ADDRESS 0xFFF96C50 /end MEASUREMENT
/begin MEASUREMENT SFSBo24_isActive_ "" UBYTE VOID_SCALING_S6_S3 1 100 0 1 ECU_ADDRESS 0xFFF86269 /end MEASUREMENT
/begin MEASUREMENT SFSBo25_isActive_ "" UBYTE VOID_SCALING_S6_S3 1 100 0 1 ECU_ADDRESS 0xFFF8626A /end MEASUREMENT
/begin MEASUREMENT SFSBo33_isActive_ "" UBYTE VOID_SCALING_S6_S3 1 100 0 1 ECU_ADDRESS 0xFFF96D76 /end MEASUREMENT
/begin MEASUREMENT SFSBo34_isActive_ "" UBYTE VOID_SCALING_S6_S3 1 100 0 1 ECU_ADDRESS 0xFFF96D77 /end MEASUREMENT
/begin CHARACTERISTIC SOLLGANG_EGS_ERSATZ_HAS "Ersatzwert fuer sollgang_egs_in (wenn SWI_ = 1)" VALUE 0x1D7432 SBYTE_COL_DIRECT_S6_S3 0 void_int_S6_S3 -128 127 /end CHARACTERISTIC
/begin CHARACTERISTIC STATUS_ABLAUFMEMRESRUECK_HAS "Statuswert oberhalb dessen  das EM-Reservemoment für den VM-Start abgebaut wird." VALUE 0x1D7607 UBYTE_COL_DIRECT_S6_S3 0 void_int_S6_S3 0 255 /end CHARACTERISTIC
/begin CHARACTERISTIC STATUS_ABL_ABBRFKT_SRT_ZUS "Projektspezifische Statusrückmeldung an HST beim Aufruf als Abbruchfunktion im Zustand Start beim Zustart" VALUE 0x1D801D UBYTE_COL_DIRECT_S6_S3 0 void_int_S6_S3 0 255 /end CHARACTERISTIC
/begin CHARACTERISTIC STATUS_ABL_ABBRUCH_AKTIV "Status Ablauf Abbruch aktiv" VALUE 0x1D7428 UBYTE_COL_DIRECT_S6_S3 0 void_int_S6_S3 0 255 /end CHARACTERISTIC
/begin CHARACTERISTIC STATUS_ABL_ZST_ZUS "Projektspezifische Vorgabe des Zahlenwerts für den Ablaufstatus status_ablauf_has in den einzelnen Zuständen eines Hybridablaufs" VALUE 0x1D8023 UBYTE_COL_DIRECT_S6_S3 0 void_int_S6_S3 0 255 /end CHARACTERISTIC
/begin CHARACTERISTIC STATUS_ALAENGS_ADAO_ERS_HAS "Ersatzwert fuer status_alaengs_adaoff_in (wenn SWI_ = 1)" VALUE 0x1D7433 UBYTE_COL_DIRECT_S6_S3 0 void_int_S6_S3 0 1 /end CHARACTERISTIC
/begin CHARACTERISTIC STATUS_FEHLER_IEP_ERSATZ_HAS "Ersatzwert fuer z_iep_has_fkt (wenn SWI_ = 1)" VALUE 0x1D7437 UBYTE_COL_DIRECT_S6_S3 0 void_int_S6_S3 0 255 /end CHARACTERISTIC
/begin CHARACTERISTIC STATUS_IAEADAP_BMI_HAS "Status der IAE-Adaption, der zum Verlassen des IAE Hybrid Betriebsmodus E-Fahren Kraftschluss führt - Wert 0: keine Beeinflussung BMI" VALUE 0x1D7608 UBYTE_COL_DIRECT_S6_S3 0 void_int_S6_S3 0 3 /end CHARACTERISTIC
/begin CHARACTERISTIC STATUS_IAE_ADAP_ERSATZ_HAS "Ersatzwert fuer status_iae_adap_in (wenn SWI_ = 1)" VALUE 0x1D7438 UBYTE_COL_DIRECT_S6_S3 0 void_int_S6_S3 0 255 /end CHARACTERISTIC
/begin CHARACTERISTIC STATUS_IAE_ERSATZ_HAS "Ersatzwert fuer status_iae_in (wenn SWI_ = 1)" VALUE 0x1D7439 UBYTE_COL_DIRECT_S6_S3 0 void_int_S6_S3 0 255 /end CHARACTERISTIC
/begin CHARACTERISTIC STATUS_IEP_ERSATZ_HAS "Ersatzwert status_iep_in (Ersatzwert bei 1)" VALUE 0x1D743A UBYTE_COL_DIRECT_S6_S3 0 void_int_S6_S3 0 255 /end CHARACTERISTIC
/begin CHARACTERISTIC STATUS_K0ADAP_BMI_HAS "Status der K0-Adaption, der zum Verlassen des IAE Hybrid Betriebsmodus E-Fahren Kraftschluss führt - Wert 0: keine Beeinflussung BMI" VALUE 0x1D7609 UBYTE_COL_DIRECT_S6_S3 0 void_int_S6_S3 0 1 /end CHARACTERISTIC
/begin CHARACTERISTIC STATUS_K0ADAP_LLS_HAS "Status der K0-Adaption, der zur Ausgabe der minimalen EM-Drehzahl der Leerlaufsimulation der HAS (LLS) führt - Wert 0: keine Drehzahlausgabe" VALUE 0x1D760A UBYTE_COL_DIRECT_S6_S3 0 void_int_S6_S3 0 3 /end CHARACTERISTIC
/begin CHARACTERISTIC STATUS_K0_ADAP_ERSATZ_HAS "Ersatzwert fuer status_k0_adap_has_in (wenn SWI_ = 1)" VALUE 0x1D743B UBYTE_COL_DIRECT_S6_S3 0 void_int_S6_S3 0 255 /end CHARACTERISTIC
/begin CHARACTERISTIC STATUS_K0_BBR_HAS "Einfluss für z_sas bei niedrigen Temperaturen" VALUE 0x1D760B UBYTE_COL_DIRECT_S6_S3 0 void_int_S6_S3 0 8 /end CHARACTERISTIC
/begin CHARACTERISTIC STATUS_K0_ERSATZ_HAS "Ersatzwert fuer status_k0_in (wenn SWI_ = 1)" VALUE 0x1D743C UBYTE_COL_DIRECT_S6_S3 0 void_int_S6_S3 0 255 /end CHARACTERISTIC
/begin CHARACTERISTIC STATUS_KOLBENPOS_K0_ERS_HAS "Ersatzwert fuer status_kolbenpos_k0_in (wenn SWI_ = 1)" VALUE 0x1D743D UBYTE_COL_DIRECT_S6_S3 0 void_int_S6_S3 0 100 /end CHARACTERISTIC
/begin CHARACTERISTIC STATUS_KRAFTFLUSS_ERS_HAS "Ersatzwert fuer status_kraftfluss_egs_in und z_ziel_kraftfluss_egs_in (wenn SWI_ = 1)" VALUE 0x1D743E UBYTE_COL_DIRECT_S6_S3 0 void_int_S6_S3 0 255 /end CHARACTERISTIC
/begin CHARACTERISTIC STATUS_LLVM_ERSATZ_HAS "Ersatzwert fuer status_ll_vm_in (wenn SWI_ = 1)" VALUE 0x1D743F UBYTE_COL_DIRECT_S6_S3 0 void_int_S6_S3 0 255 /end CHARACTERISTIC
/begin CHARACTERISTIC STATUS_NEM_ERSATZ_HAS "Ersatzwert fuer status_nem_in (wenn SWI_ = 1)" VALUE 0x1D7440 UBYTE_COL_DIRECT_S6_S3 0 void_int_S6_S3 0 2 /end CHARACTERISTIC
/begin CHARACTERISTIC STATUS_NVM_ERSATZ_HAS "Ersatzwert fuer status_nvm_in (wenn SWI_ = 1)" VALUE 0x1D7442 UBYTE_COL_DIRECT_S6_S3 0 void_int_S6_S3 0 2 /end CHARACTERISTIC
/begin CHARACTERISTIC STATUS_POSVUEB_ERSATZ_HAS "Ersatzwert für posv_timer_portin (Ersatzwert bei 1)" VALUE 0x1D7443 UBYTE_COL_DIRECT_S6_S3 0 void_int_S6_S3 0 2 /end CHARACTERISTIC
/begin CHARACTERISTIC STATUS_WASCHSTR_ERSATZ_HAS "Ersatzwert fuer status_waschstr_has_in (wenn SWI_ = 1)" VALUE 0x1D7445 UBYTE_COL_DIRECT_S6_S3 0 void_int_S6_S3 0 255 /end CHARACTERISTIC
/begin CHARACTERISTIC ST_ABLAUFMK0MBERZUS_HAS "Festlegung des Zustands beim Ablauf VM Zustart, ab dem das K0-Moment der HAS zur Motormomentbegrenzung in der SAB dem modifizierten K0-Ist-Moment der HAS entspricht" VALUE 0x1D80FC UWORD_COL_DIRECT_S6_S3 0 void_int_b_S6_S3 0 1000 /end CHARACTERISTIC
/begin CHARACTERISTIC SWI_ABFRAGEMMOT_ALA_HAS "Schalter, ob das Getriebeeingangsmoment beim Anlasserwunschbit mit berücksichtigt werden soll" VALUE 0x1D760C UBYTE_COL_DIRECT_S6_S3 0 void_int_e_S6_S3 0 1 /end CHARACTERISTIC
/begin CHARACTERISTIC SWI_ABFRAGESTIAE_ALA_HAS "Schalter zum Aktivieren der Abfrage des Status bei der Funktion Anlasserstart Anforderung" VALUE 0x1D760D UBYTE_COL_DIRECT_S6_S3 0 void_int_e_S6_S3 0 1 /end CHARACTERISTIC
/begin CHARACTERISTIC SWI_BBR_AUS_BZ2_HAS "Schalter zur Aktivierung der Erkennung der Anforderung der K0 Ansteuerung aus dem Hybrid-Betriebszustand Abgekoppelt in P/N (2) der Beeinflussung der SAS Befüllreihenfolge durch die HAS" VALUE 0x1D760E UBYTE_COL_DIRECT_S6_S3 0 void_int_e_S6_S3 0 1 /end CHARACTERISTIC
/begin CHARACTERISTIC SWI_BFIFUWAKTIV_HAS "Schalter zur Aktivierung der Beeinflussung der IEP durch die HAS bei EM-Fehlfunktion beim Zustart" VALUE 0x1D760F UBYTE_COL_DIRECT_S6_S3 0 void_int_e_S6_S3 0 1 /end CHARACTERISTIC
/begin CHARACTERISTIC SWI_BFIPVU_BFI_HAS "Schalter zur Aktivierung der Beeinflussung der IEP zur Unterstützung der Positionsventil-Überwachung durch die HAS " VALUE 0x1D7610 UBYTE_COL_DIRECT_S6_S3 0 void_int_e_S6_S3 0 1 /end CHARACTERISTIC
/begin CHARACTERISTIC SWI_BMI_EFAHREN_KRAFTSCHLUSS "" VALUE 0x1D7611 UBYTE_COL_DIRECT_S6_S3 0 void_int_e_S6_S3 0 1 /end CHARACTERISTIC
/begin CHARACTERISTIC SWI_C_GETRIEBEEGS_ERSATZ_HAS "Schalter fuer Ersatzwert c_getriebe_egs_in (Ersatzwert bei 1)" VALUE 0x1D7448 UBYTE_COL_DIRECT_S6_S3 0 void_int_e_S6_S3 0 1 /end CHARACTERISTIC
/begin CHARACTERISTIC SWI_GANGWECHSEL_EGS_ERSATZ_HAS "Schalter fuer Ersatzwert gangwechsel_egs_in (Ersatzwert bei 1)" VALUE 0x1D744A UBYTE_COL_DIRECT_S6_S3 0 void_int_e_S6_S3 0 1 /end CHARACTERISTIC
/begin CHARACTERISTIC SWI_ISTGANG_EGS_ERSATZ_HAS "Schalter fuer Ersatzwert istgang_egs_in (Ersatzwert bei 1)" VALUE 0x1D744B UBYTE_COL_DIRECT_S6_S3 0 void_int_e_S6_S3 0 1 /end CHARACTERISTIC
/begin CHARACTERISTIC SWI_MEMRESVMSTART_BAS_HAS "Schalter zur Aktivierung der kontinuierlichen Vorgabe des EM-Reservemoments für den VM-Start entsprechend Schleppstart" VALUE 0x1D7613 UBYTE_COL_DIRECT_S6_S3 0 void_int_e_S6_S3 0 1 /end CHARACTERISTIC
/begin CHARACTERISTIC SWI_MK0MODBEGR_ANH_ZUS "Aktivierung der Null-Setzung des modifizierten K0-Moments der HAS im Zustand K0-Synchronisieren beim Zustart" VALUE 0x1D8029 UBYTE_COL_DIRECT_S6_S3 0 void_int_e_S6_S3 0 1 /end CHARACTERISTIC
/begin CHARACTERISTIC SWI_MK0REF_MK0MBER_HAS "Schalter zur Auswahl  des K0-Referenzmoments zur Bestimmung des K0-Moments der HAS zur Motormomentbegrenzung in der SAB - 0 = m_soll_k0_has_fkt, 1 = m_k0_in" VALUE 0x1D7614 UBYTE_COL_DIRECT_S6_S3 0 void_int_e_S6_S3 0 1 /end CHARACTERISTIC
/begin CHARACTERISTIC SWI_MODUS_LASTANH_SVH_HAS "Schalter zur Auswahl des Bestimmungsmodus zur Erkennung Lastanhebung des Status des Laständerungszustands der Schalt-verhinderung der HAS" VALUE 0x1D7615 UBYTE_COL_DIRECT_S6_S3 0 void_int_e_S6_S3 0 1 /end CHARACTERISTIC
/begin CHARACTERISTIC SWI_M_EM_ERSATZ_HAS "Schalter fuer Ersatzwert m_em_in (Ersatzwert bei 1)" VALUE 0x1D744C UBYTE_COL_DIRECT_S6_S3 0 void_int_e_S6_S3 0 1 /end CHARACTERISTIC
/begin CHARACTERISTIC SWI_M_IAE_ERSATZ_HAS "Schalter fuer Ersatzwert m_iae_in (Ersatzwert bei 1)" VALUE 0x1D744D UBYTE_COL_DIRECT_S6_S3 0 void_int_e_S6_S3 0 1 /end CHARACTERISTIC
/begin CHARACTERISTIC SWI_M_K0_ERSATZ_HAS "Schalter fuer Ersatzwert m_k0_in (Ersatzwert bei 1)" VALUE 0x1D744E UBYTE_COL_DIRECT_S6_S3 0 void_int_e_S6_S3 0 1 /end CHARACTERISTIC
/begin CHARACTERISTIC SWI_M_MAXDYNEM_ERSATZ_HAS "Schalter fuer Ersatzwert m_max_dyn_em_in (Ersatzwert bei 1)" VALUE 0x1D744F UBYTE_COL_DIRECT_S6_S3 0 void_int_e_S6_S3 0 1 /end CHARACTERISTIC
/begin CHARACTERISTIC SWI_M_MINDYNEM_ERSATZ_HAS "Schalter fuer Ersatzwert m_min_dyn_em_in (Ersatzwert bei 1)" VALUE 0x1D7450 UBYTE_COL_DIRECT_S6_S3 0 void_int_e_S6_S3 0 1 /end CHARACTERISTIC
/begin CHARACTERISTIC SWI_M_MOT_ERSATZ_HAS "Schalter fuer Ersatzwert m_mot_in (Ersatzwert bei 1)" VALUE 0x1D7452 UBYTE_COL_DIRECT_S6_S3 0 void_int_e_S6_S3 0 1 /end CHARACTERISTIC
/begin CHARACTERISTIC SWI_M_SOLLEMHST_ERSATZ_HAS "Schalter fuer Ersatzwert m_soll_em_hst_in (Ersatzwert bei 1)" VALUE 0x1D7453 UBYTE_COL_DIRECT_S6_S3 0 void_int_e_S6_S3 0 1 /end CHARACTERISTIC
/begin CHARACTERISTIC SWI_M_SOLLVMHST_ERSATZ_HAS "Schalter fuer Ersatzwert m_soll_vm_hst_in (Ersatzwert bei 1)" VALUE 0x1D7454 UBYTE_COL_DIRECT_S6_S3 0 void_int_e_S6_S3 0 1 /end CHARACTERISTIC
/begin CHARACTERISTIC SWI_M_VMSTART_ERSATZ_HAS "Schalter fuer Ersatzwert m_vm_start_in (Ersatzwert bei 1)" VALUE 0x1D7456 UBYTE_COL_DIRECT_S6_S3 0 void_int_e_S6_S3 0 1 /end CHARACTERISTIC
/begin CHARACTERISTIC SWI_M_VM_ERSATZ_HAS "Schalter fuer Ersatzwert m_vm_in (Ersatzwert bei 1)" VALUE 0x1D7457 UBYTE_COL_DIRECT_S6_S3 0 void_int_e_S6_S3 0 1 /end CHARACTERISTIC
/begin CHARACTERISTIC SWI_M_WUNSCHFPW_ERSATZ_HAS "Schalter fuer Ersatzwert m_wunsch_fpw_in (Ersatzwert bei 1)" VALUE 0x1D745A UBYTE_COL_DIRECT_S6_S3 0 void_int_e_S6_S3 0 1 /end CHARACTERISTIC
/begin CHARACTERISTIC SWI_NEM_FEHLERWERTNULL_HAS "Aktivierung des Ersatzwerts Null für die EM-Drehzahl bei Signalstatus Signal fehlerhaft" VALUE 0x1D745B UBYTE_COL_DIRECT_S6_S3 0 void_int_e_S6_S3 0 1 /end CHARACTERISTIC
/begin CHARACTERISTIC SWI_N_ABEGS_ERSATZ_HAS "Schalter fuer Ersatzwert n_ab_egs_in (Ersatzwert bei 1)" VALUE 0x1D745C UBYTE_COL_DIRECT_S6_S3 0 void_int_e_S6_S3 0 1 /end CHARACTERISTIC
/begin CHARACTERISTIC SWI_N_EM_ERSATZ_HAS "Schalter fuer Ersatzwert n_em_in (Ersatzwert bei 1)" VALUE 0x1D745D UBYTE_COL_DIRECT_S6_S3 0 void_int_e_S6_S3 0 1 /end CHARACTERISTIC
/begin CHARACTERISTIC SWI_N_MOT_SOLL_IAE_ERSATZ_HAS "Schalter fuer n_mot_soll_iae_portin" VALUE 0x1D745E UBYTE_COL_DIRECT_S6_S3 0 void_int_e_S6_S3 0 1 /end CHARACTERISTIC
/begin CHARACTERISTIC SWI_N_SOLLLLVM_ERSATZ_HAS "Schalter fuer Ersatzwert n_soll_ll_vm_in (Ersatzwert bei 1)" VALUE 0x1D7460 UBYTE_COL_DIRECT_S6_S3 0 void_int_e_S6_S3 0 1 /end CHARACTERISTIC
/begin CHARACTERISTIC SWI_N_TEGS_ERSATZ_HAS "Schalter fuer Ersatzwert n_t_egs_in (Ersatzwert bei 1)" VALUE 0x1D7461 UBYTE_COL_DIRECT_S6_S3 0 void_int_e_S6_S3 0 1 /end CHARACTERISTIC
/begin CHARACTERISTIC SWI_N_VM_ERSATZ_HAS "Schalter fuer Ersatzwert n_vm_in (Ersatzwert bei 1)" VALUE 0x1D7462 UBYTE_COL_DIRECT_S6_S3 0 void_int_e_S6_S3 0 1 /end CHARACTERISTIC
/begin CHARACTERISTIC SWI_OSMODE_NEXT_ERSATZ_HAS "Schalter fuer Ersatzwert osmode_next_in (Ersatzwert bei 1)" VALUE 0x1D7463 UBYTE_COL_DIRECT_S6_S3 0 void_int_e_S6_S3 0 1 /end CHARACTERISTIC
/begin CHARACTERISTIC SWI_PHI_NEIGUNG_ERSATZ_HAS "Schalter fuer Ersatzwert phi_neigung_in(Ersatzwert bei 1)" VALUE 0x1D7464 UBYTE_COL_DIRECT_S6_S3 0 void_int_e_S6_S3 0 1 /end CHARACTERISTIC
/begin CHARACTERISTIC SWI_POS_EGS_ERSATZ_HAS "Schalter fuer Ersatzwert pos_egs_portin (Ersatzwert bei 1)" VALUE 0x1D7465 UBYTE_COL_DIRECT_S6_S3 0 void_int_e_S6_S3 0 1 /end CHARACTERISTIC
/begin CHARACTERISTIC SWI_P_BREMSEFZG_ERSATZ_HAS "Schalter fuer Ersatzwert p_bremse_fzg_in (Ersatzwert bei 1)" VALUE 0x1D7466 UBYTE_COL_DIRECT_S6_S3 0 void_int_e_S6_S3 0 1 /end CHARACTERISTIC
/begin CHARACTERISTIC SWI_SOLLGANG_EGS_ERSATZ_HAS "Schalter fuer Ersatzwert sollgang_egs_in (Ersatzwert bei 1)" VALUE 0x1D7467 UBYTE_COL_DIRECT_S6_S3 0 void_int_e_S6_S3 0 1 /end CHARACTERISTIC
/begin CHARACTERISTIC SWI_STATUS_ALAENGS_ADAO_ERS_HAS "Schalter fuer Ersatzwert status_alaengs_adaoff_in (Ersatzwert bei 1)" VALUE 0x1D7468 UBYTE_COL_DIRECT_S6_S3 0 void_int_e_S6_S3 0 1 /end CHARACTERISTIC
/begin CHARACTERISTIC SWI_STATUS_FEHLER_IEP_ERS_HAS "Schalter fuer Ersatzwert z_iep_has_fkt (Ersatzwert bei 1)" VALUE 0x1D746A UBYTE_COL_DIRECT_S6_S3 0 void_int_e_S6_S3 0 1 /end CHARACTERISTIC
/begin CHARACTERISTIC SWI_STATUS_IAE_ADAP_ERSATZ_HAS "Schalter fuer Ersatzwert status_iae_adap_in (Ersatzwert bei 1)" VALUE 0x1D746B UBYTE_COL_DIRECT_S6_S3 0 void_int_e_S6_S3 0 1 /end CHARACTERISTIC
/begin CHARACTERISTIC SWI_STATUS_IAE_ERSATZ_HAS "Schalter fuer Ersatzwert status_iae_in (Ersatzwert bei 1)" VALUE 0x1D746C UBYTE_COL_DIRECT_S6_S3 0 void_int_e_S6_S3 0 1 /end CHARACTERISTIC
/begin CHARACTERISTIC SWI_STATUS_IEP_ERSATZ_HAS "Ersatzwert status_iep_in (Ersatzwert bei 1)" VALUE 0x1D746D UBYTE_COL_DIRECT_S6_S3 0 void_int_e_S6_S3 0 1 /end CHARACTERISTIC
/begin CHARACTERISTIC SWI_STATUS_K0_ADAP_ERSATZ_HAS "Schalter fuer Ersatzwert status_k0_adap_has_in (Ersatzwert bei 1)" VALUE 0x1D746E UBYTE_COL_DIRECT_S6_S3 0 void_int_e_S6_S3 0 1 /end CHARACTERISTIC
/begin CHARACTERISTIC SWI_STATUS_K0_ERSATZ_HAS "Schalter fuer Ersatzwert status_k0_in (Ersatzwert bei 1)" VALUE 0x1D746F UBYTE_COL_DIRECT_S6_S3 0 void_int_e_S6_S3 0 1 /end CHARACTERISTIC
/begin CHARACTERISTIC SWI_STATUS_KOLBENPOS_K0_ERS_HAS "Schalter fuer Ersatzwert status_kolbenpos_k0_in (Ersatzwert bei 1)" VALUE 0x1D7470 UBYTE_COL_DIRECT_S6_S3 0 void_int_e_S6_S3 0 1 /end CHARACTERISTIC
/begin CHARACTERISTIC SWI_STATUS_KRAFTFLUSS_ERS_HAS "Schalter fuer Ersatzwert status_kraftfluss_egs_in und z_ziel_kraftfluss_egs_in (Ersatzwert bei 1)" VALUE 0x1D7471 UBYTE_COL_DIRECT_S6_S3 0 void_int_e_S6_S3 0 1 /end CHARACTERISTIC
/begin CHARACTERISTIC SWI_STATUS_NEM_ERSATZ_HAS "Schalter fuer Ersatzwert status_nem_in (Ersatzwert bei 1)" VALUE 0x1D7472 UBYTE_COL_DIRECT_S6_S3 0 void_int_e_S6_S3 0 1 /end CHARACTERISTIC
/begin CHARACTERISTIC SWI_STATUS_NVM_ERSATZ_HAS "Schalter fuer Ersatzwert status_nvm_in (Ersatzwert bei 1)" VALUE 0x1D7474 UBYTE_COL_DIRECT_S6_S3 0 void_int_e_S6_S3 0 1 /end CHARACTERISTIC
/begin CHARACTERISTIC SWI_STATUS_POSVUEB_ERSATZ_HAS "Schalter fuer Ersatzwert pos_egs_in (Ersatzwert bei 1)" VALUE 0x1D7475 UBYTE_COL_DIRECT_S6_S3 0 void_int_e_S6_S3 0 1 /end CHARACTERISTIC
/begin CHARACTERISTIC SWI_STATUS_WASCHSTR_ERSATZ_HAS "Schalter fuer Ersatzwert status_waschstr_has_in (Ersatzwert bei 1)" VALUE 0x1D7477 UBYTE_COL_DIRECT_S6_S3 0 void_int_e_S6_S3 0 1 /end CHARACTERISTIC
/begin CHARACTERISTIC SWI_TMAXSASAKTIV_MSA_HAS "Schalter zur Aktivierung der Rücknahme der Anforderung der Beeinflussung der MSA-Funktionalität bei aktivem Schaltablauf während einer laufenden Schaltung" VALUE 0x1D7617 UBYTE_COL_DIRECT_S6_S3 0 void_int_e_S6_S3 0 1 /end CHARACTERISTIC
/begin CHARACTERISTIC SWI_T_BETRIEB_PVU_EE_ERSATZ_HAS "Schalter fuer Ersatzwert t_betrieb_pvu_has_ee_in (Ersatzwert bei 1)" VALUE 0x1D7478 UBYTE_COL_DIRECT_S6_S3 0 void_int_e_S6_S3 0 1 /end CHARACTERISTIC
/begin CHARACTERISTIC SWI_ZABLVAR_SST_BFI_HAS "Schalter zur Aktivierung, ob die Ablaufvariante bei der Beeinflussung der IEP beim SST mit abgefragt warden soll" VALUE 0x1D7618 UBYTE_COL_DIRECT_S6_S3 0 void_int_e_S6_S3 0 1 /end CHARACTERISTIC
/begin CHARACTERISTIC SWI_ZIELGANG_EGS_ERSATZ_HAS "Schalter fuer Ersatzwert zielgang_egs_in (Ersatzwert bei 1)" VALUE 0x1D7479 UBYTE_COL_DIRECT_S6_S3 0 void_int_e_S6_S3 0 1 /end CHARACTERISTIC
/begin CHARACTERISTIC SWI_ZMODUSIEP_SST_BFI_HAS "Schalter, ob beim SST die IEP ausgeschalten werden soll, oder im LP3 kaufen soll" VALUE 0x1D7619 UBYTE_COL_DIRECT_S6_S3 0 void_int_e_S6_S3 0 1 /end CHARACTERISTIC
/begin CHARACTERISTIC SWI_ZPHYSK0_ABB_ZUS "SWI für die Hysteresekompensation K0 im Zustand Zustarten beim Abbruch Zustart: 0 = Druckanteil p_hys_k0_has inaktiv, 1 = Druckanteil p_hys_k0_has aktiv" VALUE 0x1D8035 UBYTE_COL_DIRECT_S6_S3 0 void_int_e_S6_S3 0 1 /end CHARACTERISTIC
/begin CHARACTERISTIC SWI_ZPHYSK0_ANH_ZUS "SWI für die Hysteresekompensation K0 im Zustand VM Drehzahlanhebung beim VM Zustarten: 0 = Druckanteil p_hys_k0_has inaktiv, 1 = Druckanteil p_hys_k0_has aktiv" VALUE 0x1D8037 UBYTE_COL_DIRECT_S6_S3 0 void_int_e_S6_S3 0 1 /end CHARACTERISTIC
/begin CHARACTERISTIC SWI_ZPHYSK0_SRT_ZUS "SWI für die Hysteresekompensation K0 im Zustand Start beim Zustart: 0 : Druckanteil p_hys_k0_has inaktiv 1 : Druckanteil p_hys_k0_has aktiv" VALUE 0x1D803A UBYTE_COL_DIRECT_S6_S3 0 void_int_e_S6_S3 0 1 /end CHARACTERISTIC
/begin CHARACTERISTIC SWI_ZPHYSK0_UEB_ZUS "SWI für die Hysteresekompensation K0 im Zustand Übergabe beim Zustart: 0 : Druckanteil p_hys_k0_has inaktiv 1 : Druckanteil p_hys_k0_has aktiv " VALUE 0x1D803D UBYTE_COL_DIRECT_S6_S3 0 void_int_e_S6_S3 0 1 /end CHARACTERISTIC
/begin CHARACTERISTIC SWI_ZPHYSK0_ZST_ZUS "SWI für die Hysteresekompensation K0 im Zustand Zustarten beim VM Zustarten: 0 = Druckanteil p_hys_k0_has inaktiv, 1 = Druckanteil p_hys_k0_has aktiv" VALUE 0x1D803E UBYTE_COL_DIRECT_S6_S3 0 void_int_e_S6_S3 0 1 /end CHARACTERISTIC
/begin CHARACTERISTIC SWI_Z_ABLAUFHASHST_ERSATZ_HAS "Schalter fuer Ersatzwert z_ablauf_has_hst_in (Ersatzwert bei 1)" VALUE 0x1D747A UBYTE_COL_DIRECT_S6_S3 0 void_int_e_S6_S3 0 1 /end CHARACTERISTIC
/begin CHARACTERISTIC SWI_Z_ABLAUFVARIANTE_ERS_HAS "Schalter fuer Ersatzwert z_ablaufvariante_has_hst_in (Ersatzwert bei 1)" VALUE 0x1D747B UBYTE_COL_DIRECT_S6_S3 0 void_int_e_S6_S3 0 1 /end CHARACTERISTIC
/begin CHARACTERISTIC SWI_Z_DIAG_ERSFKT_ERS_HAS "Schalter fuer Ersatzwert z_diag_ersfkt_has_in (Ersatzwert bei 1)" VALUE 0x1D747E UBYTE_COL_DIRECT_S6_S3 0 void_int_e_S6_S3 0 1 /end CHARACTERISTIC
/begin CHARACTERISTIC SWI_Z_DIAG_ERSFKT_HI_ERS_HAS "Schalter fuer Ersatzwert z_diag_ersfkt_hi_has_in (Ersatzwert bei 1)" VALUE 0x1D747F UBYTE_COL_DIRECT_S6_S3 0 void_int_e_S6_S3 0 1 /end CHARACTERISTIC
/begin CHARACTERISTIC SWI_Z_DIAG_NOTGANG_HAS_ERS_HAS "Schalter fuer Ersatzwert z_diag_notgang_has_in (Ersatzwert bei 1)" VALUE 0x1D7480 UBYTE_COL_DIRECT_S6_S3 0 void_int_e_S6_S3 0 1 /end CHARACTERISTIC
/begin CHARACTERISTIC SWI_Z_IEP_ERSATZ_HAS "Schalter fuer Ersatzwert status_iep_in (Ersatzwert bei 1)" VALUE 0x1D7481 UBYTE_COL_DIRECT_S6_S3 0 void_int_e_S6_S3 0 1 /end CHARACTERISTIC
/begin CHARACTERISTIC SWI_Z_K0_FST_ERSATZ_HAS "Schalter fuer Ersatzwert z_k0_fst_in (Ersatzwert bei 1)" VALUE 0x1D7482 UBYTE_COL_DIRECT_S6_S3 0 void_int_e_S6_S3 0 1 /end CHARACTERISTIC
/begin CHARACTERISTIC SWI_Z_KPS_STADA_ERSATZ_HAS "Schalter fuer Ersatzwert z_kps_stada_in (Ersatzwert bei 1)" VALUE 0x1D7483 UBYTE_COL_DIRECT_S6_S3 0 void_int_e_S6_S3 0 1 /end CHARACTERISTIC
/begin CHARACTERISTIC SWI_Z_MSA_FST_ERSATZ_HAS "Schalter fuer Ersatzwert z_msa_fst_has_in (Ersatzwert bei 1)" VALUE 0x1D7484 UBYTE_COL_DIRECT_S6_S3 0 void_int_e_S6_S3 0 1 /end CHARACTERISTIC
/begin CHARACTERISTIC SWI_Z_NLLSOLL_IAE_ERS_HAS "Schalter fuer Ersatzwert z_nllsoll_iae_in (Ersatzwert bei 1)" VALUE 0x1D7485 UBYTE_COL_DIRECT_S6_S3 0 void_int_e_S6_S3 0 1 /end CHARACTERISTIC
/begin CHARACTERISTIC SWI_Z_NMINEMPARKSP_ERS_HAS "Schalter fuer z_n_min_em_parksp_has_in: Anforderung einer EM-Drehzahlanhebung beim Auslegen der Parksperre infolge unzureichender Ölversorgung" VALUE 0x1D7486 UBYTE_COL_DIRECT_S6_S3 0 void_int_e_S6_S3 0 1 /end CHARACTERISTIC
/begin CHARACTERISTIC SWI_Z_N_MIN_IEP_ERSATZ_HAS "Schalter fuer Ersatzwert z_n_min_iep_in (Ersatzwert bei 1)" VALUE 0x1D7487 UBYTE_COL_DIRECT_S6_S3 0 void_int_e_S6_S3 0 1 /end CHARACTERISTIC
/begin CHARACTERISTIC TAB_BMZFKTMSA_MSA_HAS "Tabelle der Bitmasken zur Festlegung der Anforderung der Beeinflussung der MSA-Funktionalität bei aktiver Hybridfunktion in Abhängigkeit der aktiven Hybridfunktion - Codierung wie z_msa_has_sbe" VAL_BLK 0x197928 UBYTE_COL_DIRECT_S6_S3 0 void_int_S6_S3 0 255 MATRIX_DIM 16 1 1 /end CHARACTERISTIC
/begin CHARACTERISTIC TAB_BMZMSAAKTIV_MSA_HAS "Bitmaske zur Festlegung, welche der Beeinflussungsmöglichkeiten der MSA-Funktionalität durch die HAS aktiviert sind - f(st_ist_bz_has_stg)" VAL_BLK 0x197938 UBYTE_COL_DIRECT_S6_S3 0 void_int_S6_S3 0 255 MATRIX_DIM 16 1 1 /end CHARACTERISTIC
/begin CHARACTERISTIC TAB_BMZSASMSAHS_MSA_HAS "Festlegung der Anforderung der Beeinflussung der MSA-Funktionalität bei aktivem Schaltablauf Hochschaltung in Abhängigkeit des Zielgangs - Codierung wie z_msa_has_sbe" VAL_BLK 0x1D75D8 UBYTE_COL_DIRECT_S6_S3 0 void_int_S6_S3 0 255 MATRIX_DIM 9 1 1 /end CHARACTERISTIC
/begin CHARACTERISTIC TAB_BMZSASMSARS_MSA_HAS "Festlegung der Anforderung der Beeinflussung der MSA-Funktionalität bei aktivem Schaltablauf Rückschaltung in Abhängigkeit des Zielgangs - Codierung wie z_msa_has_sbe" VAL_BLK 0x1D75E1 UBYTE_COL_DIRECT_S6_S3 0 void_int_S6_S3 0 255 MATRIX_DIM 9 1 1 /end CHARACTERISTIC
/begin CHARACTERISTIC TAB_STATUSEFAHREN_BMI_HAS "Festlegung des Status E-Fahren der HAS in Abhängigkeit des Betriebszustands der Hybrid-Zustandssteuerung" VAL_BLK 0x197948 UBYTE_COL_DIRECT_S6_S3 0 void_int_S6_S3 0 1 MATRIX_DIM 16 1 1 /end CHARACTERISTIC
/begin CHARACTERISTIC TAB_STATUSEFAHREN_OUT_HAS "Festlegung des Status E-Fahren der HAS in Abhängigkeit des Betriebszustands der Hybrid-Zustandssteuerung" VAL_BLK 0x197958 UBYTE_COL_DIRECT_S6_S3 0 void_int_S6_S3 0 1 MATRIX_DIM 16 1 1 /end CHARACTERISTIC
/begin CHARACTERISTIC TAB_STKRAFTFLUSS_NDK0_MSA_HAS "Erkennen Gangeinlegen zur Beeinflussung der MSA-Funktionalität bei einer zu grossen ND_K0" VAL_BLK 0x1D75F3 UBYTE_COL_DIRECT_S6_S3 0 void_int_S6_S3 0 1 MATRIX_DIM 7 1 1 /end CHARACTERISTIC
/begin CHARACTERISTIC TAB_TMAXSRSSAS_MSA_HAS "Maximalzeit der Anforderung der Beeinflussung der MSA-Funktionalität bei aktivem Schaltablauf bei Schub RS im Hybridfahren in Abhängigkeit des Zielgangs" VAL_BLK 0x1978BC FLOAT32_IEEE_COL_DIRECT_S6_S3 0 t_fl_S6_S3 0 1000 MATRIX_DIM 9 1 1 /end CHARACTERISTIC
/begin CHARACTERISTIC TAB_TVRUECKSRSSAS_MSA_HAS "Verzögerungszeit zur Rücknahme der Anforderung der Beeinflussung der MSA-Funktionalität bei aktivem Schaltablauf bei Schub RS im Hybridfahren in Abhängigkeit des Zielgangs" VAL_BLK 0x1978E0 FLOAT32_IEEE_COL_DIRECT_S6_S3 0 t_fl_S6_S3 0 10 MATRIX_DIM 9 1 1 /end CHARACTERISTIC
/begin CHARACTERISTIC TAB_ZDIAGNOTGANG_BMI_HAS "Tabelle zur Festlegung der Zahlenwerte der Notgang-Information der Diagnose die zu einer Überführung des IAE Hybrid Betriebsmodus in den Zustand E-Fahren Kraftschluss führen - Wert 0: keine Beeinflussung BMI" VAL_BLK 0x1D80F4 UBYTE_COL_DIRECT_S6_S3 0 void_int_S6_S3 0 255 MATRIX_DIM 6 1 1 /end CHARACTERISTIC
/begin CHARACTERISTIC TAB_ZSTATUSEFAHREN_BMI_MOD_HAS "Festlegung des Umschaltmodus des Status E-Fahren des IAE Hybrid Betriebsmodus  der HAS in Abhängigkeit der von der Hybrid-Zustandssteuerung angeforderten Hybridfunktion" VAL_BLK 0x19796C UBYTE_COL_DIRECT_S6_S3 0 void_int_S6_S3 0 3 MATRIX_DIM 16 1 1 /end CHARACTERISTIC
/begin CHARACTERISTIC TAB_ZSTATUSEFAHREN_OUT_MOD_HAS "Festlegung des Umschaltmodus des Status E-Fahren der HAS in Abhängigkeit der von der Hybrid-Zustandssteuerung angeforderten Hybridfunktion" VAL_BLK 0x19797C UBYTE_COL_DIRECT_S6_S3 0 void_int_S6_S3 0 3 MATRIX_DIM 16 1 1 /end CHARACTERISTIC
/begin CHARACTERISTIC T_BETRIEB_PVU_EE_ERSATZ_HAS "Ersatzwert fuer t_betrieb_pvu_has_ee_in (wenn SWI_ = 1)" VALUE 0x1975A8 ULONG_COL_DIRECT_S6_S3 0 t_int_S6_S3 0 42949672.95 /end CHARACTERISTIC
/begin CHARACTERISTIC T_MAX_EMAKTIV_FUW_ZUS "Maximale Dauer der Überwachung der EM Reaktion der Funktionsüberwachung der EM Funktion beim Zustartt" VALUE 0x1D5EE4 FLOAT32_IEEE_COL_DIRECT_S6_S3 0 t_fl_S6_S3 0 5000 /end CHARACTERISTIC
/begin CHARACTERISTIC T_MSOLLEMAKTIVMAX_ZUS "Maximalzeit der Ausgabe des K0-Störmoments der EM-Ansteuerung beim Zustart" VALUE 0x1D5EF4 FLOAT32_IEEE_COL_DIRECT_S6_S3 0 t_fl_S6_S3 0 10 /end CHARACTERISTIC
/begin CHARACTERISTIC T_NMINEMBEFUELLFZP_LLS_HAS "Zeit für die Ausgabe einer EM Mindrehzahl zur Befuellung des Ansaugkanals der FZP" VALUE 0x197A70 FLOAT32_IEEE_COL_DIRECT_S6_S3 0 t_fl_S6_S3 0 5 /end CHARACTERISTIC
/begin CHARACTERISTIC T_VAUSD_BERG_MSA_HAS "Verzögerungszeit zur Deaktivierung der Beeinflussung der MSA-Funktionalität am Berg beim Gang auslegen aus Position D" VALUE 0x197A74 FLOAT32_IEEE_COL_DIRECT_S6_S3 0 t_fl_S6_S3 0 5 /end CHARACTERISTIC
/begin CHARACTERISTIC T_VAUSR_BERG_MSA_HAS "Verzögerungszeit zur Deaktivierung der Beeinflussung der MSA-Funktionalität am Berg beim Gang auslegen aus Position R" VALUE 0x197A78 FLOAT32_IEEE_COL_DIRECT_S6_S3 0 t_fl_S6_S3 0 5 /end CHARACTERISTIC
/begin CHARACTERISTIC T_VBRE_ABS_MSA_HAS "Verzögerungszeit zur Deaktivierung der Beeinflussung der MSA-Funktionalität bei aktiven ABS-/ESP-Regelzuständen beim Bremsen" VALUE 0x197A7C FLOAT32_IEEE_COL_DIRECT_S6_S3 0 t_fl_S6_S3 0 5 /end CHARACTERISTIC
/begin CHARACTERISTIC T_VK0ZUNEMFEHLER_FUW_ZUS "Verzögerungszeit zur Abschätzung 'K0 zu' bei fehlerhafter EM-Drehzahl der Funktionsüberwachung der EM-Funktion bei beim Zustart" VALUE 0x1D5F0C FLOAT32_IEEE_COL_DIRECT_S6_S3 0 t_fl_S6_S3 0 5 /end CHARACTERISTIC
/begin CHARACTERISTIC T_VNEMBED_NDK0_MSA_HAS "Verzögerungszeit nach Überschreiten der ersten VM Drehzahlschwelle  zur Aktivierung der Beeinflussung der MSA-Funktionalität bei geringer EM Drehzahl in Abhängigkeit der Differenzdrehzahl der K0 zum Schutz der K0" VALUE 0x197A80 FLOAT32_IEEE_COL_DIRECT_S6_S3 0 t_fl_S6_S3 0 600 /end CHARACTERISTIC
/begin CHARACTERISTIC T_VRUECKGELSAS_MSA_HAS "Verzögerungszeit zur Ruecknahme der Beeinflussung der MSA-Funktionalität bei aktivem Schaltablauf beim Gangeinlegen" VALUE 0x197A84 FLOAT32_IEEE_COL_DIRECT_S6_S3 0 t_fl_S6_S3 0 10 /end CHARACTERISTIC
/begin CHARACTERISTIC T_ZIEPHASAKTIV_BFI_HAS "Zeitraum nach Erkennung der Betriebsbereitschaft des Hybridsystems in dem die Beeinflussung der IEP durch die HAS aktiv ist" VALUE 0x197A88 FLOAT32_IEEE_COL_DIRECT_S6_S3 0 t_fl_S6_S3 0 5 /end CHARACTERISTIC
/begin CHARACTERISTIC T_ZIEPHASMAX_BFI_HAS "Maximaler Zeitraum nach Erkennung der Betriebsbereitschaft des Hybridsystems in dem die Beeinflussung der IEP durch die HAS aktiv ist" VALUE 0x197A8C FLOAT32_IEEE_COL_DIRECT_S6_S3 0 t_fl_S6_S3 0 500 /end CHARACTERISTIC
/begin CHARACTERISTIC T_ZSASHASAKTIV_BBR_HAS "Zeitraum nach Erkennung der Betriebsbereitschaft des Hybridsystems, in dem die Beeinflussung der SAS Befüllreihenfolge durch die HAS bestätigt werden muss" VALUE 0x197A90 FLOAT32_IEEE_COL_DIRECT_S6_S3 0 t_fl_S6_S3 0 5 /end CHARACTERISTIC
/begin CHARACTERISTIC VGS_F1_VGF_MSA_HAS "Fahrzeuggeschwindigkeitsgradientenschwelle zur Aktivierung der Beeinflussung der MSA-Funktionalität in Abhängigkeit des Fahrzeuggeschwindigkeitsgradienten" VALUE 0x197A94 FLOAT32_IEEE_COL_DIRECT_S6_S3 0 vg_fl_S6_S3 -100 100 /end CHARACTERISTIC
/begin CHARACTERISTIC VGS_F2_VGF_MSA_HAS "Fahrzeuggeschwindigkeitsgradientenschwelle zur Deaktivierung der Beeinflussung der MSA-Funktionalität in Abhängigkeit des Fahrzeuggeschwindigkeitsgradienten" VALUE 0x197A98 FLOAT32_IEEE_COL_DIRECT_S6_S3 0 vg_fl_S6_S3 -100 100 /end CHARACTERISTIC
/begin CHARACTERISTIC VGS_FBRE_ABS_MSA_HAS "Fahrzeuggeschwindigkeitsgradientenschwelle zur Aktivierung der Beeinflussung der MSA-Funktionalität bei aktiven ABS-/ESP-Regelzuständen beim Bremsen" VALUE 0x197A9C FLOAT32_IEEE_COL_DIRECT_S6_S3 0 vg_fl_S6_S3 -100 100 /end CHARACTERISTIC
/begin CHARACTERISTIC VGS_FKRI_IAE_MSA_HAS "Fahrzeuggeschwindigkeitsgradientenschwelle zur Aktivierung der Beeinflussung der MSA-Funktionalität in Abhängigkeit des IAE Betriebszustands Kriechen" VALUE 0x197AA0 FLOAT32_IEEE_COL_DIRECT_S6_S3 0 vg_fl_S6_S3 0 100 /end CHARACTERISTIC
/begin CHARACTERISTIC VS_F1_KFL_MSA_HAS "Fahrzeuggeschwindigkeitsschwelle zur Aktiverung der Beeinflussung der MSA-Funktionalität in Abhängigkeit des Kraftfluss-Status" VALUE 0x197AA4 FLOAT32_IEEE_COL_DIRECT_S6_S3 0 v_fl_S6_S3 0 500 /end CHARACTERISTIC
/begin CHARACTERISTIC VS_F2_KFL_MSA_HAS "Fahrzeuggeschwindigkeitsschwelle zur Deaktivierung der Beeinflussung der MSA-Funktionalität in Abhängigkeit des Kraftfluss-Status" VALUE 0x197AA8 FLOAT32_IEEE_COL_DIRECT_S6_S3 0 v_fl_S6_S3 0 500 /end CHARACTERISTIC
/begin CHARACTERISTIC VS_FBRE_ABS_MSA_HAS "Fahrzeuggeschwindigkeitsschwelle zur Deaktivierung der Beeinflussung der MSA-Funktionalität bei aktiven ABS-/ESP-Regelzuständen beim Bremsen" VALUE 0x197AAC FLOAT32_IEEE_COL_DIRECT_S6_S3 0 v_fl_S6_S3 0 500 /end CHARACTERISTIC
/begin CHARACTERISTIC VS_FD1_BERG_MSA_HAS "Fahrzeuggeschwindigkeitsschwelle zur Aktivierung der Beeinflussung der MSA-Funktionalität am Berg an der Steigung in Position D " VALUE 0x197AB0 FLOAT32_IEEE_COL_DIRECT_S6_S3 0 v_fl_S6_S3 0 500 /end CHARACTERISTIC
/begin CHARACTERISTIC VS_FD2_BERG_MSA_HAS "Fahrzeuggeschwindigkeitsschwelle zur Deaktivierung der Beeinflussung der MSA-Funktionalität am Berg an der Steigung in Position D " VALUE 0x197AB4 FLOAT32_IEEE_COL_DIRECT_S6_S3 0 v_fl_S6_S3 0 500 /end CHARACTERISTIC
/begin CHARACTERISTIC VS_FKFL_LLS_HAS "Fahrzeuggeschwindigkeitsschwelle zur Aktiverung der minimalen EM-Drehzahl der Leerlaufsimulation der HAS (LLS) in Abhängigkeit des Kraftfluss-Status zur Sicherstellung der Ölversorgung bei einem in Neutral rollenden Fahrzeug" VALUE 0x197AB8 FLOAT32_IEEE_COL_DIRECT_S6_S3 0 v_fl_S6_S3 0 500 /end CHARACTERISTIC
/begin CHARACTERISTIC VS_FKRI_IAE_MSA_HAS "Fahrzeuggeschwindigkeitsschwelle zur Deaktivierung der Beeinflussung der MSA-Funktionalität in Abhängigkeit des IAE Betriebszustands Kriechen bei Fahrzeugstillstand" VALUE 0x197ABC FLOAT32_IEEE_COL_DIRECT_S6_S3 0 v_fl_S6_S3 0 500 /end CHARACTERISTIC
/begin CHARACTERISTIC VS_FMAX_VGF_MSA_HAS "Maximale Fahrzeuggeschwindigkeitsschwelle zur Aktivierung der Beeinflussung der MSA-Funktionalität in Abhängigkeit des Fahrzeuggeschwindigkeitsgradienten" VALUE 0x197AC0 FLOAT32_IEEE_COL_DIRECT_S6_S3 0 v_fl_S6_S3 0 500 /end CHARACTERISTIC
/begin CHARACTERISTIC VS_FMIN_VGF_MSA_HAS "Minimale Fahrzeuggeschwindigkeitsschwelle zur Aktiverung bzw. Deaktivierung der Beeinflussung der MSA-Funktionalität in Abhängigkeit des Fahrzeuggeschwin-digkeitsgradienten" VALUE 0x197AC4 FLOAT32_IEEE_COL_DIRECT_S6_S3 0 v_fl_S6_S3 0 500 /end CHARACTERISTIC
/begin CHARACTERISTIC VS_FR1_BERG_MSA_HAS "Fahrzeuggeschwindigkeitsschwelle zur Aktivierung der Beeinflussung der MSA-Funktionalität am Berg im Gefaelle in Position R " VALUE 0x197AC8 FLOAT32_IEEE_COL_DIRECT_S6_S3 0 v_fl_S6_S3 0 500 /end CHARACTERISTIC
/begin CHARACTERISTIC VS_FR2_BERG_MSA_HAS "Fahrzeuggeschwindigkeitsschwelle zur Deaktivierung der Beeinflussung der MSA-Funktionalität am Berg im Gefaelle in Position R " VALUE 0x197ACC FLOAT32_IEEE_COL_DIRECT_S6_S3 0 v_fl_S6_S3 0 500 /end CHARACTERISTIC
/begin CHARACTERISTIC ZIELGANG_EGS_ERSATZ_HAS "Ersatzwert fuer zielgang_egs_in (wenn SWI_ = 1)" VALUE 0x1D7488 SBYTE_COL_DIRECT_S6_S3 0 void_int_S6_S3 -128 127 /end CHARACTERISTIC
/begin CHARACTERISTIC Z_ABLAUFHASHST_ERSATZ_HAS "Ersatzwert fuer z_ablauf_has_hst_in (wenn SWI_ = 1)" VALUE 0x1D7489 UBYTE_COL_DIRECT_S6_S3 0 void_int_S6_S3 0 255 /end CHARACTERISTIC
/begin CHARACTERISTIC Z_ABLAUFVARIANTE_ERS_HAS "Ersatzwert fuer z_ablaufvariante_has_hst_in (wenn SWI_ = 1)" VALUE 0x1D748A UBYTE_COL_DIRECT_S6_S3 0 void_int_S6_S3 0 255 /end CHARACTERISTIC
/begin CHARACTERISTIC Z_ABLAUFVARIANTE_KALTNEM_ZUS "Anforderung eines Kaltstart-Ablaufs mit abgesenkter EM-Drehzahl durch die HAS Zustandssteuerung (OML) beim Zustart (z_ablaufvariante_has_stg)" VALUE 0x1D803F UBYTE_COL_DIRECT_S6_S3 0 void_int_S6_S3 0 100 /end CHARACTERISTIC
/begin CHARACTERISTIC Z_ABLAUF_ABBRUCH_ZUS "Anzeigen eines Abbruchs durch die HAS-Zustandssteuerung (OML) beim Zustart" VALUE 0x1D8041 UBYTE_COL_DIRECT_S6_S3 0 void_int_S6_S3 0 255 /end CHARACTERISTIC
/begin CHARACTERISTIC Z_DIAG_ERSFKT_ERS_HAS "Ersatzwert fuer z_diag_ersfkt_has_in (wenn SWI_ = 1)" VALUE 0x1975B4 ULONG_COL_DIRECT_S6_S3 0 b_int_S6_S3 0 4294967295 /end CHARACTERISTIC
/begin CHARACTERISTIC Z_DIAG_ERSFKT_HI_ERS_HAS "Ersatzwert fuer z_diag_ersfkt_hi_has_in (wenn SWI_ = 1)" VALUE 0x1975B8 ULONG_COL_DIRECT_S6_S3 0 b_int_S6_S3 0 4294967295 /end CHARACTERISTIC
/begin CHARACTERISTIC Z_DIAG_NOTGANG_HAS_ERS_HAS "Ersatzwert fuer z_diag_notgang_has_in (wenn SWI_ = 1)" VALUE 0x1D748D UBYTE_COL_DIRECT_S6_S3 0 void_int_S6_S3 0 255 /end CHARACTERISTIC
/begin CHARACTERISTIC Z_IEP_ERSATZ_HAS "Ersatzwert fuer status_iep_in (wenn SWI_ = 1)" VALUE 0x1D748E UBYTE_COL_DIRECT_S6_S3 0 void_int_S6_S3 0 255 /end CHARACTERISTIC
/begin CHARACTERISTIC Z_K0_FST_ERSATZ_HAS "Ersatzwert z_k0_fst_in (Ersatzwert bei 1)" VALUE 0x1D748F UBYTE_COL_DIRECT_S6_S3 0 void_int_S6_S3 0 255 /end CHARACTERISTIC
/begin CHARACTERISTIC Z_KPS_STADA_ERSATZ_HAS "Ersatzwert fuer z_kps_stada_in (wenn SWI_ = 1)" VALUE 0x1D7490 UBYTE_COL_DIRECT_S6_S3 0 void_int_S6_S3 0 1 /end CHARACTERISTIC
/begin CHARACTERISTIC Z_MSA_FST_ERSATZ_HAS "Ersatzwert fuer z_msa_fst_has_in (wenn SWI_ = 1)" VALUE 0x1D7491 UBYTE_COL_DIRECT_S6_S3 0 void_int_S6_S3 0 255 /end CHARACTERISTIC
/begin CHARACTERISTIC Z_NLLSOLL_IAE_ERS_HAS "Ersatzwert fuer z_nllsoll_iae_in (wenn SWI_ = 1)" VALUE 0x1D7492 UBYTE_COL_DIRECT_S6_S3 0 void_int_S6_S3 0 2 /end CHARACTERISTIC
/begin CHARACTERISTIC Z_NMINEMPARKSP_ERS_HAS "Ersatzwert fuer z_n_min_em_parksp_has_in: Anforderung einer EM-Drehzahlanhebung beim Auslegen der Parksperre infolge unzureichender Ölversorgung" VALUE 0x1D7493 UBYTE_COL_DIRECT_S6_S3 0 void_int_S6_S3 0 1 /end CHARACTERISTIC
/begin CHARACTERISTIC Z_N_MIN_IEP_ERSATZ_HAS "Ersatzwert fuer z_n_min_iep_in (wenn SWI_ = 1)" VALUE 0x1D7494 UBYTE_COL_DIRECT_S6_S3 0 void_int_S6_S3 0 1 /end CHARACTERISTIC
/begin MEASUREMENT abstellpos_vm_in "Abstellposition VM vor nächstem ZOT" UBYTE void_int_S6_S3 1 100 0 180 ECU_ADDRESS 0xFFF86698 /end MEASUREMENT
/begin MEASUREMENT abstellpos_vm_status_in "Status Abstellposition VM" UBYTE void_int_S6_S3 1 100 0 2 ECU_ADDRESS 0xFFF86699 /end MEASUREMENT
/begin MEASUREMENT c_getriebe_egs_in "" FLOAT32_IEEE c_int_S6_S3 1 100 -40 215 ECU_ADDRESS 0xFFF85DDC /end MEASUREMENT
/begin MEASUREMENT c_getriebe_egs_portin "" UBYTE c_int_m_S6_S3 1 100 0 255 ECU_ADDRESS 0xFFF861EE /end MEASUREMENT
/begin MEASUREMENT c_iep_portin "" SWORD c_int_l_S6_S3 1 100 -32768 32767 ECU_ADDRESS 0xFFF8604A /end MEASUREMENT
/begin MEASUREMENT c_vm_in "" FLOAT32_IEEE c_int_S6_S3 1 100 -3.40282e+038 3.40282e+038 ECU_ADDRESS 0xFFF85E38 /end MEASUREMENT
/begin MEASUREMENT gangwechsel_egs_in "Flag während laufender Schaltung, bei synchron verlassen bis synchron erreicht" UBYTE void_int_S6_S3 1 100 0 1 ECU_ADDRESS 0xFFF86677 /end MEASUREMENT
/begin MEASUREMENT gangwechsel_egs_portin "Flag während laufender Schaltung, bei synchron verlassen bis synchron erreicht" UBYTE void_int_S6_S3 1 100 0 1 ECU_ADDRESS 0xFFF861EF /end MEASUREMENT
/begin MEASUREMENT i_istgang_egs "" FLOAT32_IEEE void_fl_S6_S3 1 100 0 8 ECU_ADDRESS 0xFFF85D8C /end MEASUREMENT
/begin MEASUREMENT i_zielgang_egs "" FLOAT32_IEEE void_fl_S6_S3 1 100 0 8 ECU_ADDRESS 0xFFF85D90 /end MEASUREMENT
/begin MEASUREMENT istgang_egs_begr_svh "Begrenzter Ist-Gang der Schaltverhinderung der HAS" SBYTE void_int_S6_S3 1 100 -128 127 ECU_ADDRESS 0xFFF96D78 /end MEASUREMENT
/begin MEASUREMENT istgang_egs_in "" SBYTE void_int_S6_S3 1 100 -128 127 ECU_ADDRESS 0xFFF86678 /end MEASUREMENT
/begin MEASUREMENT istgang_egs_portin "" SBYTE void_int_S6_S3 1 100 -128 127 ECU_ADDRESS 0xFFF861F0 /end MEASUREMENT
/begin MEASUREMENT k_mstoerk0em_zus "Faktor zur Modifikation des K0-Störmoments zur Bestimmung des EM-Vorsteuermoments beim Zustart" FLOAT32_IEEE void_fl_S6_S3 1 100 0 2 ECU_ADDRESS 0xFFF85B50 /end MEASUREMENT
/begin MEASUREMENT m_em_in "" FLOAT32_IEEE trq_fl_a_S6_S3 1 100 -1024 1024 ECU_ADDRESS 0xFFF85DE0 /end MEASUREMENT
/begin MEASUREMENT m_em_in_azg "AZG-Signal für m_em_in" SWORD trq_fl_S6_S3 1 100 -32767 32767 ECU_ADDRESS 0xFFF96EE4 /end MEASUREMENT
/begin MEASUREMENT m_em_portin "" SWORD trq_fl_S6_S3 1 100 -32768 32767 ECU_ADDRESS 0xFFF8604C /end MEASUREMENT
/begin MEASUREMENT m_iae_in "" FLOAT32_IEEE trq_fl_a_S6_S3 1 100 -32768 32767 ECU_ADDRESS 0xFFF85DE4 /end MEASUREMENT
/begin MEASUREMENT m_iae_portin "" SWORD trq_fl_S6_S3 1 100 -32768 32767 ECU_ADDRESS 0xFFF8604E /end MEASUREMENT
/begin MEASUREMENT m_k0_fkt "" FLOAT32_IEEE trq_fl_a_S6_S3 1 100 -1200 1200 ECU_ADDRESS 0xFFF85D48 /end MEASUREMENT
/begin MEASUREMENT m_k0_in "" FLOAT32_IEEE trq_fl_a_S6_S3 1 100 -32768 32767 ECU_ADDRESS 0xFFF85DE8 /end MEASUREMENT
/begin MEASUREMENT m_k0_in_azg "AZG-Signal für m_k0_in" SWORD trq_fl_S6_S3 1 100 -32767 32767 ECU_ADDRESS 0xFFF96EE6 /end MEASUREMENT
/begin MEASUREMENT m_k0_mber_has_sbe "K0-Moment der HAS zur Motormomentbegrenzung in der SAB" FLOAT32_IEEE trq_fl_a_S6_S3 1 100 -3.40282e+038 3.40282e+038 ECU_ADDRESS 0xFFF85DC4 /end MEASUREMENT
/begin MEASUREMENT m_k0_mber_zus_basis "Basiswert des K0 Moments beim Zustart zur Bestimmung des K0-Moments der HAS zur Motormomentbegrenzung in der SAB" FLOAT32_IEEE trq_fl_a_S6_S3 1 100 -3.40282e+038 3.40282e+038 ECU_ADDRESS 0xFFF96538 /end MEASUREMENT
/begin MEASUREMENT m_k0_mber_zus_gbegr "Gradientenbegrenzter Basiswert des K0 Moments beim Zustart zur Bestimmung des K0-Moments der HAS zur Motormomentbegrenzung in der SAB" FLOAT32_IEEE trq_fl_a_S6_S3 1 100 -3.40282e+038 3.40282e+038 ECU_ADDRESS 0xFFF9653C /end MEASUREMENT
/begin MEASUREMENT m_k0_mod_has_fkt "" FLOAT32_IEEE trq_fl_a_S6_S3 1 100 -1200 1200 ECU_ADDRESS 0xFFF85D4C /end MEASUREMENT
/begin MEASUREMENT m_k0_portin "" SWORD trq_fl_S6_S3 1 100 -32768 32767 ECU_ADDRESS 0xFFF86050 /end MEASUREMENT
/begin MEASUREMENT m_max_dyn_em_in "" FLOAT32_IEEE trq_fl_a_S6_S3 1 100 -32768 32767 ECU_ADDRESS 0xFFF85DEC /end MEASUREMENT
/begin MEASUREMENT m_max_dyn_em_in_azg "AZG-Signal für m_max_dyn_em_in" SWORD trq_fl_S6_S3 1 100 -32767 32767 ECU_ADDRESS 0xFFF96EE8 /end MEASUREMENT
/begin MEASUREMENT m_max_dyn_em_portin "" SWORD trq_fl_S6_S3 1 100 -32768 32767 ECU_ADDRESS 0xFFF86052 /end MEASUREMENT
/begin MEASUREMENT m_max_em_has_fkt "" FLOAT32_IEEE trq_fl_a_S6_S3 1 100 -1200 1200 ECU_ADDRESS 0xFFF85D50 /end MEASUREMENT
/begin MEASUREMENT m_max_iae_has_fkt "" FLOAT32_IEEE trq_fl_a_S6_S3 1 100 -1200 1200 ECU_ADDRESS 0xFFF85D54 /end MEASUREMENT
/begin MEASUREMENT m_min_dyn_em_in "" FLOAT32_IEEE trq_fl_a_S6_S3 1 100 -3.40282e+038 3.40282e+038 ECU_ADDRESS 0xFFF85DF0 /end MEASUREMENT
/begin MEASUREMENT m_min_dyn_em_portin "" SWORD trq_fl_S6_S3 1 100 -32768 32767 ECU_ADDRESS 0xFFF86054 /end MEASUREMENT
/begin MEASUREMENT m_min_em_has_fkt "" FLOAT32_IEEE trq_fl_a_S6_S3 1 100 -1200 1200 ECU_ADDRESS 0xFFF85D58 /end MEASUREMENT
/begin MEASUREMENT m_min_vm_in "" FLOAT32_IEEE trq_fl_a_S6_S3 1 100 -3.40282e+038 3.40282e+038 ECU_ADDRESS 0xFFF85E3C /end MEASUREMENT
/begin MEASUREMENT m_mot_in "" FLOAT32_IEEE trq_fl_a_S6_S3 1 100 -1024 1024 ECU_ADDRESS 0xFFF85DF4 /end MEASUREMENT
/begin MEASUREMENT m_mot_portin "" SWORD trq_fl_S6_S3 1 100 -1024 1024 ECU_ADDRESS 0xFFF86056 /end MEASUREMENT
/begin MEASUREMENT m_motmax_has "" FLOAT32_IEEE trq_fl_a_S6_S3 1 100 -1200 1200 ECU_ADDRESS 0xFFF85DC8 /end MEASUREMENT
/begin MEASUREMENT m_soll_em_has_fkt "" FLOAT32_IEEE trq_fl_a_S6_S3 1 100 -1200 1200 ECU_ADDRESS 0xFFF85D5C /end MEASUREMENT
/begin MEASUREMENT m_soll_em_hst_in "" FLOAT32_IEEE trq_fl_a_S6_S3 1 100 -32768 32767 ECU_ADDRESS 0xFFF85DF8 /end MEASUREMENT
/begin MEASUREMENT m_soll_em_hst_portin "" SWORD trq_fl_S6_S3 1 100 -32768 32767 ECU_ADDRESS 0xFFF86058 /end MEASUREMENT
/begin MEASUREMENT m_soll_k0_has_fkt "" FLOAT32_IEEE trq_fl_a_S6_S3 1 100 -1200 1200 ECU_ADDRESS 0xFFF85D60 /end MEASUREMENT
/begin MEASUREMENT m_soll_res_em_bas_sbe "" FLOAT32_IEEE trq_fl_a_S6_S3 1 100 -3.40282e+038 3.40282e+038 ECU_ADDRESS 0xFFF85DCC /end MEASUREMENT
/begin MEASUREMENT m_soll_res_em_has_fkt "" FLOAT32_IEEE trq_fl_a_S6_S3 1 100 -1200 1200 ECU_ADDRESS 0xFFF85D64 /end MEASUREMENT
/begin MEASUREMENT m_soll_res_em_has_sbe "" FLOAT32_IEEE trq_fl_a_S6_S3 1 100 -3.40282e+038 3.40282e+038 ECU_ADDRESS 0xFFF85DD0 /end MEASUREMENT
/begin MEASUREMENT m_soll_vm_has_fkt "" FLOAT32_IEEE trq_fl_a_S6_S3 1 100 -1200 1200 ECU_ADDRESS 0xFFF85D68 /end MEASUREMENT
/begin MEASUREMENT m_soll_vm_hst_in "" FLOAT32_IEEE trq_fl_a_S6_S3 1 100 -32768 32767 ECU_ADDRESS 0xFFF85DFC /end MEASUREMENT
/begin MEASUREMENT m_soll_vm_hst_portin "" SWORD trq_fl_S6_S3 1 100 -32768 32767 ECU_ADDRESS 0xFFF8605A /end MEASUREMENT
/begin MEASUREMENT m_soll_vm_l_has_fkt "" FLOAT32_IEEE trq_fl_a_S6_S3 1 100 -1200 1200 ECU_ADDRESS 0xFFF85D6C /end MEASUREMENT
/begin MEASUREMENT m_soll_vm_l_hst_in "" FLOAT32_IEEE trq_fl_a_S6_S3 1 100 -3.40282e+038 3.40282e+038 ECU_ADDRESS 0xFFF85E40 /end MEASUREMENT
/begin MEASUREMENT m_stoerk0em_fil_zus "Gefiltertes K0-Störmoment zur Bestimmung des EM-Vorsteuermoments beim Zustart" FLOAT32_IEEE trq_fl_a_S6_S3 1 100 -1000 1000 ECU_ADDRESS 0xFFF85B5C /end MEASUREMENT
/begin MEASUREMENT m_vm_in "" FLOAT32_IEEE trq_fl_a_S6_S3 1 100 -1024 1023.5 ECU_ADDRESS 0xFFF85E00 /end MEASUREMENT
/begin MEASUREMENT m_vm_in_azg "AZG-Signal für m_vm_in" SWORD trq_fl_S6_S3 1 100 -32767 32767 ECU_ADDRESS 0xFFF96EEA /end MEASUREMENT
/begin MEASUREMENT m_vm_portin "" SWORD trq_fl_S6_S3 1 100 -32768 32767 ECU_ADDRESS 0xFFF8605C /end MEASUREMENT
/begin MEASUREMENT m_vm_start_in "" FLOAT32_IEEE trq_fl_a_S6_S3 1 100 -1024 1023.5 ECU_ADDRESS 0xFFF85E04 /end MEASUREMENT
/begin MEASUREMENT m_vm_start_portin "" SWORD trq_fl_S6_S3 1 100 -32768 32767 ECU_ADDRESS 0xFFF8605E /end MEASUREMENT
/begin MEASUREMENT m_wunsch_fpw_hst_fil "" FLOAT32_IEEE trqg_fl_c_S6_S3 1 100 -2000 2000 ECU_ADDRESS 0xFFF85D94 /end MEASUREMENT
/begin MEASUREMENT m_wunsch_fpw_hst_in "" FLOAT32_IEEE trq_fl_a_S6_S3 1 100 -3.40282e+038 3.40282e+038 ECU_ADDRESS 0xFFF85E44 /end MEASUREMENT
/begin MEASUREMENT m_wunsch_fpw_in "" FLOAT32_IEEE trq_fl_a_S6_S3 1 100 -32768 32767 ECU_ADDRESS 0xFFF85E08 /end MEASUREMENT
/begin MEASUREMENT m_wunsch_fpw_portin "" SWORD trq_fl_S6_S3 1 100 -32768 32767 ECU_ADDRESS 0xFFF86060 /end MEASUREMENT
/begin MEASUREMENT m_ziel_vm_has_zus "Zielmoment des VM bei Zustart" FLOAT32_IEEE trq_fl_a_S6_S3 1 100 -3.40282e+038 3.40282e+038 ECU_ADDRESS 0xFFF96C58 /end MEASUREMENT
/begin MEASUREMENT mg_max_em_has_fkt "" FLOAT32_IEEE trqg_fl_c_S6_S3 1 100 -3000 3000 ECU_ADDRESS 0xFFF85D70 /end MEASUREMENT
/begin MEASUREMENT mg_min_em_has_fkt "" FLOAT32_IEEE trqg_fl_c_S6_S3 1 100 -3000 3000 ECU_ADDRESS 0xFFF85D74 /end MEASUREMENT
/begin MEASUREMENT mg_soll_K0_fkt "" FLOAT32_IEEE trqg_fl_c_S6_S3 1 100 -3000 3000 ECU_ADDRESS 0xFFF85D78 /end MEASUREMENT
/begin MEASUREMENT mg_soll_k0_has_fkt "" FLOAT32_IEEE trqg_fl_c_S6_S3 1 100 -3000 3000 ECU_ADDRESS 0xFFF85D7C /end MEASUREMENT
/begin MEASUREMENT mg_wunsch_fpw "" FLOAT32_IEEE trqg_fl_c_S6_S3 1 100 -2000 2000 ECU_ADDRESS 0xFFF85D98 /end MEASUREMENT
/begin MEASUREMENT mg_wunsch_fpw_hst "" FLOAT32_IEEE trqg_fl_c_S6_S3 1 100 -2000 2000 ECU_ADDRESS 0xFFF85D9C /end MEASUREMENT
/begin MEASUREMENT mod_K0_fkt "" UBYTE void_int_S6_S3 1 100 0 50 ECU_ADDRESS 0xFFF8663A /end MEASUREMENT
/begin MEASUREMENT ms_wunschfpw_lastanh_svh "Schwellwert des Fahrerwunschmoments zur Bestimmung des Zustands Lastanhebung der Schaltverhinderung der HAS" FLOAT32_IEEE trq_fl_a_S6_S3 1 100 -3.40282e+038 3.40282e+038 ECU_ADDRESS 0xFFF96540 /end MEASUREMENT
/begin MEASUREMENT n_ab_egs_in "" FLOAT32_IEEE n_fl_S6_S3 1 100 0 65535 ECU_ADDRESS 0xFFF85E0C /end MEASUREMENT
/begin MEASUREMENT n_ab_egs_portin "" UWORD n_int_S6_S3 1 100 0 65535 ECU_ADDRESS 0xFFF86062 /end MEASUREMENT
/begin MEASUREMENT n_em_in "" FLOAT32_IEEE n_fl_S6_S3 1 100 -3.40282e+038 3.40282e+038 ECU_ADDRESS 0xFFF85E10 /end MEASUREMENT
/begin MEASUREMENT n_em_in_azg "AZG-Signal für n_em_in" UWORD n_int_S6_S3 1 100 0 65535 ECU_ADDRESS 0xFFF96EEC /end MEASUREMENT
/begin MEASUREMENT n_em_portin "" UWORD n_int_S6_S3 1 100 0 65535 ECU_ADDRESS 0xFFF86064 /end MEASUREMENT
/begin MEASUREMENT n_min_em_befuellfzp_lls_has "Minimalwert der minimalen EM Drehzahl der Leerlaufsimulation der HAS (LLS) bei Anforderung zur Befuellung des Ansaugkanals bei Uebergang Init-x" FLOAT32_IEEE n_fl_S6_S3 1 100 -3.40282e+038 3.40282e+038 ECU_ADDRESS 0xFFF96544 /end MEASUREMENT
/begin MEASUREMENT n_min_em_cgetr_lls_has "Minimalwert der minimalen EM Drehzahl der Leerlaufsimulation der HAS (LLS) in Abhängigkeit der Getriebeöltemperatur" FLOAT32_IEEE n_fl_S6_S3 1 100 -3.40282e+038 3.40282e+038 ECU_ADDRESS 0xFFF96548 /end MEASUREMENT
/begin MEASUREMENT n_min_em_has_sbe "Minimale EM Drehzahl der Leerlaufsimulation der HAS (LLS)" FLOAT32_IEEE n_fl_S6_S3 1 100 -32767 32767 ECU_ADDRESS 0xFFF85DD4 /end MEASUREMENT
/begin MEASUREMENT n_min_em_iae_lls_has "Minimalwert der minimale EM Drehzahl der Leerlaufsimulation der HAS (LLS) bei Anforderung der IAE-Adaption" FLOAT32_IEEE n_fl_S6_S3 1 100 -3.40282e+038 3.40282e+038 ECU_ADDRESS 0xFFF9654C /end MEASUREMENT
/begin MEASUREMENT n_min_em_k0adap_lls_has "Minimalwert der minimalen EM Drehzahl der Leerlaufsimulation der HAS (LLS) bei Anforderung der K0-Adaption" FLOAT32_IEEE n_fl_S6_S3 1 100 -3.40282e+038 3.40282e+038 ECU_ADDRESS 0xFFF96550 /end MEASUREMENT
/begin MEASUREMENT n_min_em_kfl_lls_has "Minimalwert der minimalen EM Drehzahl der Leerlaufsimula-tion der HAS (LLS) in Abhängigkeit des Kraftfluss-Status zur Sicherstellung der Ölversorgung bei einem in Neutral rollenden Fahrzeug" FLOAT32_IEEE n_fl_S6_S3 1 100 -3.40282e+038 3.40282e+038 ECU_ADDRESS 0xFFF96554 /end MEASUREMENT
/begin MEASUREMENT n_min_em_lls_has_mod "Modifizierte minimale EM Drehzahl der Leerlaufsimulation der HAS (LLS)" FLOAT32_IEEE n_fl_S6_S3 1 100 -3.40282e+038 3.40282e+038 ECU_ADDRESS 0xFFF96558 /end MEASUREMENT
/begin MEASUREMENT n_min_em_lls_has_ngbegr "Nicht gradientenbegrenzte, nicht gefilterte und nicht abgesicherte minimale EM Drehzahl der Leerlaufsimulation der HAS (LLS)" FLOAT32_IEEE n_fl_S6_S3 1 100 -3.40282e+038 3.40282e+038 ECU_ADDRESS 0xFFF9655C /end MEASUREMENT
/begin MEASUREMENT n_min_em_lls_has_ngef "Nicht gefilterte und nicht abgesicherte minimale EM Drehzahl der Leerlaufsimulation der HAS (LLS)" FLOAT32_IEEE n_fl_S6_S3 1 100 -3.40282e+038 3.40282e+038 ECU_ADDRESS 0xFFF96560 /end MEASUREMENT
/begin MEASUREMENT n_min_em_lls_has_ref "Nicht abgesicherte minimale EM Drehzahl der Leerlaufsimulation der HAS (LLS)" FLOAT32_IEEE n_fl_S6_S3 1 100 -3.40282e+038 3.40282e+038 ECU_ADDRESS 0xFFF96564 /end MEASUREMENT
/begin MEASUREMENT n_min_em_pvu_lls_has "Minimalwert der minimalen EM-Drehzahl der Leerlaufsimulation der HAS (LLS) bei aktiver Unterstuetzung der Positionsventil-Ueberwachung durch die HAS" FLOAT32_IEEE n_fl_S6_S3 1 100 -3.40282e+038 3.40282e+038 ECU_ADDRESS 0xFFF96568 /end MEASUREMENT
/begin MEASUREMENT n_min_psys_em_has_sbe "Minimale EM Drehzahl zur Sicherstellung Ölversorgung" FLOAT32_IEEE n_fl_S6_S3 1 100 -32767 32767 ECU_ADDRESS 0xFFF85DA0 /end MEASUREMENT
/begin MEASUREMENT n_mineminit_lls_has "Initialisierungsdrehzahl des Gradientenbegrenzers und PT2-Filters" FLOAT32_IEEE n_fl_S6_S3 1 100 -3.40282e+038 3.40282e+038 ECU_ADDRESS 0xFFF9656C /end MEASUREMENT
/begin MEASUREMENT n_mot_soll_iae_in "" FLOAT32_IEEE n_fl_S6_S3 1 100 -3.40282e+038 3.40282e+038 ECU_ADDRESS 0xFFF85E14 /end MEASUREMENT
/begin MEASUREMENT n_mot_soll_iae_portin "Soll-Anfahrdrehzahl der IAE" UWORD n_int_S6_S3 1 100 0 65535 ECU_ADDRESS 0xFFF86066 /end MEASUREMENT
/begin MEASUREMENT n_sec_iae "" FLOAT32_IEEE n_fl_S6_S3 1 100 -10000 10000 ECU_ADDRESS 0xFFF85DA4 /end MEASUREMENT
/begin MEASUREMENT n_sec_iae_ist_zus "Abtriebsseitige IAE-Drehzahl bezogen auf den Getriebeeeingang und den aktuellen  Istgang während einer Schaltung beim Zustart" FLOAT32_IEEE n_fl_S6_S3 1 100 0 10000 ECU_ADDRESS 0xFFF96C6C /end MEASUREMENT
/begin MEASUREMENT n_sec_iae_ziel_zus "Abtriebsseitige IAE Zieldrehzahl bezogen auf den Getriebeeingang während einer Schaltung beim Zustart" FLOAT32_IEEE n_fl_S6_S3 1 100 -3.40282e+038 3.40282e+038 ECU_ADDRESS 0xFFF96C70 /end MEASUREMENT
/begin MEASUREMENT n_soll_em_has_fkt "" FLOAT32_IEEE n_fl_S6_S3 1 100 0 8000 ECU_ADDRESS 0xFFF85D80 /end MEASUREMENT
/begin MEASUREMENT n_soll_em_hst_in "" FLOAT32_IEEE n_fl_S6_S3 1 100 -3.40282e+038 3.40282e+038 ECU_ADDRESS 0xFFF85E48 /end MEASUREMENT
/begin MEASUREMENT n_soll_ll_vm_in "" FLOAT32_IEEE n_fl_S6_S3 1 100 0 2540 ECU_ADDRESS 0xFFF85E18 /end MEASUREMENT
/begin MEASUREMENT n_soll_ll_vm_portin "" UWORD n_int_S6_S3 1 100 0 65535 ECU_ADDRESS 0xFFF86068 /end MEASUREMENT
/begin MEASUREMENT n_soll_vm_has_fkt "" FLOAT32_IEEE n_fl_S6_S3 1 100 0 8000 ECU_ADDRESS 0xFFF85D84 /end MEASUREMENT
/begin MEASUREMENT n_t_egs_in "" FLOAT32_IEEE n_fl_S6_S3 1 100 0 65535 ECU_ADDRESS 0xFFF85E1C /end MEASUREMENT
/begin MEASUREMENT n_t_egs_portin "" UWORD n_int_S6_S3 1 100 0 65535 ECU_ADDRESS 0xFFF8606A /end MEASUREMENT
/begin MEASUREMENT n_vm_in "" FLOAT32_IEEE n_fl_S6_S3 1 100 0 65535 ECU_ADDRESS 0xFFF85E20 /end MEASUREMENT
/begin MEASUREMENT n_vm_in_azg "AZG-Signal für n_vm_in" UWORD n_int_S6_S3 1 100 0 65535 ECU_ADDRESS 0xFFF96EEE /end MEASUREMENT
/begin MEASUREMENT n_vm_portin "" UWORD n_int_S6_S3 1 100 0 65535 ECU_ADDRESS 0xFFF8606C /end MEASUREMENT
/begin MEASUREMENT nd_iae "" FLOAT32_IEEE n_fl_S6_S3 1 100 -10000 10000 ECU_ADDRESS 0xFFF85DA8 /end MEASUREMENT
/begin MEASUREMENT nd_k0_in "" FLOAT32_IEEE n_fl_S6_S3 1 100 -10000 10000 ECU_ADDRESS 0xFFF85DAC /end MEASUREMENT
/begin MEASUREMENT nd_soll_iae_fkt "Differenzdrehzahl der Anfahrkupplung" FLOAT32_IEEE ng_fl_S6_S3 1 100 -8000 8000 ECU_ADDRESS 0xFFF85D88 /end MEASUREMENT
/begin MEASUREMENT ndg_k0_in "" FLOAT32_IEEE ng_fl_S6_S3 1 100 -10000 10000 ECU_ADDRESS 0xFFF85DB0 /end MEASUREMENT
/begin MEASUREMENT ng_vm "" FLOAT32_IEEE ng_fl_S6_S3 1 100 -10000 10000 ECU_ADDRESS 0xFFF85DB4 /end MEASUREMENT
/begin MEASUREMENT osmode_next_in "" UBYTE void_int_S6_S3 1 100 1 3 ECU_ADDRESS 0xFFF86679 /end MEASUREMENT
/begin MEASUREMENT osmode_next_portin "" UBYTE void_int_S6_S3 1 100 0 255 ECU_ADDRESS 0xFFF861F1 /end MEASUREMENT
/begin MEASUREMENT p_bremse_fzg_in "" FLOAT32_IEEE p_fl_S6_S3 1 100 -32000 0 ECU_ADDRESS 0xFFF85E24 /end MEASUREMENT
/begin MEASUREMENT p_bremse_fzg_portin "" UWORD void_int_b_S6_S3 1 100 0 65535 ECU_ADDRESS 0xFFF8606E /end MEASUREMENT
/begin MEASUREMENT phi_neigung_in "Fahrzeug-Neigungswinkel" FLOAT32_IEEE void_fl_S6_S3 1 100 -3.40282e+038 3.40282e+038 ECU_ADDRESS 0xFFF85E28 /end MEASUREMENT
/begin MEASUREMENT phi_neigung_portin "" UBYTE void_int_S6_S3 1 100 0 255 ECU_ADDRESS 0xFFF861F2 /end MEASUREMENT
/begin MEASUREMENT pos_egs_in "Waehlhebelposition" UBYTE E_POS_S6_S3 1 100 0 8 ECU_ADDRESS 0xFFF8667A /end MEASUREMENT
/begin MEASUREMENT pos_egs_portin "Wählhebelposition" UBYTE E_POS_S6_S3 1 100 0 8 ECU_ADDRESS 0xFFF861F3 /end MEASUREMENT
/begin MEASUREMENT posv_timer_portin "Flag ob Timerbedingungen für PosV Diagnose erfüllt sind" UBYTE void_int_S6_S3 1 100 0 255 ECU_ADDRESS 0xFFF861F4 /end MEASUREMENT
/begin MEASUREMENT posvueb_aktiv_portin "Anforderung der  PosV Diagnose einer Drehzahlanhebung und der Deaktivierung der IEP " UBYTE void_int_S6_S3 1 100 0 255 ECU_ADDRESS 0xFFF861F5 /end MEASUREMENT
/begin MEASUREMENT sollgang_egs_in "" SBYTE void_int_S6_S3 1 100 -128 127 ECU_ADDRESS 0xFFF8667B /end MEASUREMENT
/begin MEASUREMENT sollgang_egs_portin "" SBYTE void_int_S6_S3 1 100 -128 127 ECU_ADDRESS 0xFFF861F6 /end MEASUREMENT
/begin MEASUREMENT st_OMLID_act_stg "Innere Zustände der OML" UWORD void_int_b_S6_S3 1 100 0 4999 ECU_ADDRESS 0xFFF860CA /end MEASUREMENT
/begin MEASUREMENT st_ablauf_fkt "Phase des Ablauf" UWORD void_int_b_S6_S3 1 100 0 65535 ECU_ADDRESS 0xFFF860CC /end MEASUREMENT
/begin MEASUREMENT st_ist_bz_has_stg "Istzustand OML" UBYTE E_STBZHAS_S6_S3 1 100 0 15 ECU_ADDRESS 0xFFF86635 /end MEASUREMENT
/begin MEASUREMENT st_soll_bz_has_hst "interner HST Soll-Betriebszustand der Strategieanpassung (variantenunabhaengig)" UBYTE void_int_S6_S3 1 100 0 1 ECU_ADDRESS 0xFFF8669A /end MEASUREMENT
/begin MEASUREMENT st_ziel_bz_has_stg "Zielzustand OML" UBYTE E_STBZHAS_S6_S3 1 100 0 15 ECU_ADDRESS 0xFFF86636 /end MEASUREMENT
/begin MEASUREMENT status_ablauf_has_fkt "" UBYTE void_int_S6_S3 1 100 0 50 ECU_ADDRESS 0xFFF8663B /end MEASUREMENT
/begin MEASUREMENT status_alaengs_adaoff_in "Information, ob die Adaptionen aufgrund erkannter Laengsbeschleunigung deaktiviert wird. 0 = Adaption aktiv aufgrund erkannter Laengsbeschleunigung
1 = Adaption inaktiv aufgrund nicht erkannter Laengsbeschleunigung" UBYTE void_int_S6_S3 1 100 0 1 ECU_ADDRESS 0xFFF8667C /end MEASUREMENT
/begin MEASUREMENT status_alaengs_adaoff_portin "Information, ob die Adaptionen aufgrund erkannter Laengsbeschleunigung deaktiviert wird. 0 = Adaption aktiv aufgrund erkannter Laengsbeschleunigung
1 = Adaption inaktiv aufgrund nicht erkannter Laengsbeschleunigung" UBYTE void_int_S6_S3 1 100 0 1 ECU_ADDRESS 0xFFF861F7 /end MEASUREMENT
/begin MEASUREMENT status_betriebsbereit_hst_in "" UBYTE void_int_S6_S3 1 100 0 1 ECU_ADDRESS 0xFFF8669B /end MEASUREMENT
/begin MEASUREMENT status_ee_busy_portin "" UBYTE void_int_S6_S3 1 100 0 1 ECU_ADDRESS 0xFFF861F8 /end MEASUREMENT
/begin MEASUREMENT status_efahren_bmi_has "Status E-Fahren der HAS zur Festlegung der entsprechenden Portout-Größe in der HAS Signalaufbereitung_Out" UBYTE void_int_S6_S3 1 100 0 1 ECU_ADDRESS 0xFFF96D79 /end MEASUREMENT
/begin MEASUREMENT status_efahren_bmi_ist "Festgelegter Status E-Fahren zur Bestimmung des Hybrid-Betriebsmodus der IAE bezogen auf den Ist-Betriebszustand der Zustandsteuerung" UBYTE void_int_S6_S3 1 100 0 1 ECU_ADDRESS 0xFFF96D7A /end MEASUREMENT
/begin MEASUREMENT status_efahren_bmi_ziel "Festgelegter Status E-Fahren zur Bestimmung des Hybrid-Betriebsmodus der IAE bezogen auf den Ziel-Betriebszustand der Zustandsteuerung" UBYTE void_int_S6_S3 1 100 0 1 ECU_ADDRESS 0xFFF96D7B /end MEASUREMENT
/begin MEASUREMENT status_efahren_has_sbe "Status E-Fahren der HAS zur Festlegung der entsprechenden Portout-Größe in der HAS Signalaufbereitung_Out" UBYTE void_int_S6_S3 1 100 0 1 ECU_ADDRESS 0xFFF8665A /end MEASUREMENT
/begin MEASUREMENT status_efahren_out_ist "Festgelegter Status E-Fahren der HAS bezogen auf den Ist-Betriebszustand der Zustandsteuerung" UBYTE void_int_S6_S3 1 100 0 1 ECU_ADDRESS 0xFFF96D7C /end MEASUREMENT
/begin MEASUREMENT status_efahren_out_ziel "Festgelegter Status E-Fahren der HAS bezogen auf den Ziel-Betriebszustand der Zustandsteuerung" UBYTE void_int_S6_S3 1 100 0 1 ECU_ADDRESS 0xFFF96D7D /end MEASUREMENT
/begin MEASUREMENT status_fehler15_eh_diagin "Info vom Errorhandler ob Ersatzfkt. aktiv" UBYTE void_int_S6_S3 1 100 0 1 ECU_ADDRESS 0xFFF8662E /end MEASUREMENT
/begin MEASUREMENT status_fehler_iep_in "" UBYTE E_FEHLERIEP_S6_S3 1 100 0 1 ECU_ADDRESS 0xFFF8667D /end MEASUREMENT
/begin MEASUREMENT status_fehler_iep_portin "" UBYTE E_FEHLERIEP_S6_S3 1 100 0 1 ECU_ADDRESS 0xFFF861F9 /end MEASUREMENT
/begin MEASUREMENT status_iae_adap_in "Status der Adaption des Integrierten Anfahrelements IAE" UBYTE E_STATUSADA_S6_S3 1 100 0 2 ECU_ADDRESS 0xFFF8667E /end MEASUREMENT
/begin MEASUREMENT status_iae_adap_portin "Status der Adaption des Integrierten Anfahrelements IAE" UBYTE E_STATUSADA_S6_S3 1 100 0 2 ECU_ADDRESS 0xFFF861FA /end MEASUREMENT
/begin MEASUREMENT status_iae_in "" UBYTE E_STATUSIAE_S6_S3 1 100 0 8 ECU_ADDRESS 0xFFF8667F /end MEASUREMENT
/begin MEASUREMENT status_iae_portin "" UBYTE E_STATUSIAE_S6_S3 1 100 0 8 ECU_ADDRESS 0xFFF861FB /end MEASUREMENT
/begin MEASUREMENT status_iep_in "" UBYTE E_STATUSIEP_S6_S3 1 100 0 4 ECU_ADDRESS 0xFFF86680 /end MEASUREMENT
/begin MEASUREMENT status_iep_portin "" UBYTE E_STATUSIEP_S6_S3 1 100 0 4 ECU_ADDRESS 0xFFF861FC /end MEASUREMENT
/begin MEASUREMENT status_k0_adap_in "" UBYTE E_STATUSADA_S6_S3 1 100 0 2 ECU_ADDRESS 0xFFF86681 /end MEASUREMENT
/begin MEASUREMENT status_k0_adap_portin "Status der Adaption der Trennkupplung K0" UBYTE E_STATUSADA_S6_S3 1 100 0 2 ECU_ADDRESS 0xFFF861FD /end MEASUREMENT
/begin MEASUREMENT status_k0_in "" UBYTE E_STATUSK0_S6_S3 1 100 0 5 ECU_ADDRESS 0xFFF86682 /end MEASUREMENT
/begin MEASUREMENT status_k0_portin "" UBYTE E_STATUSK0_S6_S3 1 100 0 5 ECU_ADDRESS 0xFFF861FE /end MEASUREMENT
/begin MEASUREMENT status_kl15_in "" UBYTE void_int_S6_S3 1 100 0 1 ECU_ADDRESS 0xFFF8669C /end MEASUREMENT
/begin MEASUREMENT status_kolbenpos_k0_in "" UBYTE void_int_S6_S3 1 100 0 255 ECU_ADDRESS 0xFFF86683 /end MEASUREMENT
/begin MEASUREMENT status_kolbenpos_k0_portin "" UWORD void_int_b_S6_S3 1 100 0 65535 ECU_ADDRESS 0xFFF86070 /end MEASUREMENT
/begin MEASUREMENT status_kraftfluss_egs_in "" UBYTE E_STATUSKSL_S6_S3 1 100 0 6 ECU_ADDRESS 0xFFF86684 /end MEASUREMENT
/begin MEASUREMENT status_kraftfluss_egs_roh_in "" UBYTE void_int_S6_S3 1 100 0 255 ECU_ADDRESS 0xFFF86685 /end MEASUREMENT
/begin MEASUREMENT status_kraftschl_atsys_portin "" UBYTE E_STATUSKSL_S6_S3 1 100 0 6 ECU_ADDRESS 0xFFF861FF /end MEASUREMENT
/begin MEASUREMENT status_lastanh_svh "Zustand Lastanhebung der Schaltverhinderung der HAS - TRUE = Lastanhebung bzw. Responsestart, FALSE = keine Lastanhebung bzw. Komfortstart" UBYTE void_int_S6_S3 1 100 0 1 ECU_ADDRESS 0xFFF96D7E /end MEASUREMENT
/begin MEASUREMENT status_ll_vm_in "" UBYTE void_int_S6_S3 1 100 0 255 ECU_ADDRESS 0xFFF86686 /end MEASUREMENT
/begin MEASUREMENT status_nem_in "Status zur Drehzahl E-Motor" UBYTE E_SIGSTATUS_S6_S3 1 100 0 2 ECU_ADDRESS 0xFFF86687 /end MEASUREMENT
/begin MEASUREMENT status_nem_portin "Status zur Drehzahl E-Motor" UBYTE E_SIGSTATUS_S6_S3 1 100 0 2 ECU_ADDRESS 0xFFF86200 /end MEASUREMENT
/begin MEASUREMENT status_nreg_em_hst_in "Status E-Motor Drehzahlregelung der HST" UBYTE void_int_S6_S3 1 100 0 255 ECU_ADDRESS 0xFFF8669D /end MEASUREMENT
/begin MEASUREMENT status_nvm_in "Status zur Drehzahl VM-Motor" UBYTE E_SIGSTATUS_S6_S3 1 100 0 2 ECU_ADDRESS 0xFFF86688 /end MEASUREMENT
/begin MEASUREMENT status_nvm_portin "Status zur Drehzahl VM-Motor" UBYTE E_SIGSTATUS_S6_S3 1 100 0 2 ECU_ADDRESS 0xFFF86201 /end MEASUREMENT
/begin MEASUREMENT status_phineigung_portin "Signalstatus für den Fahrzeug-Neigungswinkel" UBYTE void_int_S6_S3 1 100 0 1 ECU_ADDRESS 0xFFF86202 /end MEASUREMENT
/begin MEASUREMENT status_posvueb_in "Erkennung PosV Diagnose" UBYTE void_int_S6_S3 1 100 0 255 ECU_ADDRESS 0xFFF86689 /end MEASUREMENT
/begin MEASUREMENT status_psys_has_sbe "" UBYTE E_STATUSPSY_S6_S3 1 100 0 4 ECU_ADDRESS 0xFFF86654 /end MEASUREMENT
/begin MEASUREMENT status_rs_anf_svh "Richtung der angeforderten Schaltung der Schaltverhinderung der HAS - TRUE = RS angefordert, FALSE = keine RS angefordert" UBYTE void_int_S6_S3 1 100 0 1 ECU_ADDRESS 0xFFF96D7F /end MEASUREMENT
/begin MEASUREMENT status_sa_vm_in "00 Keine Beeinflussung; 01 Schubabschaltung aktiv; 10 Nicht stellbarer Bereich; 11 Signal ungültig" UBYTE void_int_S6_S3 1 100 0 3 ECU_ADDRESS 0xFFF8669E /end MEASUREMENT
/begin MEASUREMENT status_schaltanf_fst_svh "Lastzustand der Schaltverhinderung der HAS - TRUE = Zug-Betrieb, FALSE = Schub-Betrieb" SBYTE void_int_S6_S3 1 100 -128 127 ECU_ADDRESS 0xFFF96D80 /end MEASUREMENT
/begin MEASUREMENT status_schaltart_svh_has_sbe "Schaltart der angeforderten Schaltung der Schaltverhinderung der HAS (0 = keine Schaltung angefordert) - Bit-Codierung (m/oL=mit/ohne Lanstanh.)=: bit0=ZRSmL,1=ZHSmL,2=SRSmL,3=SHSmL,4=ZRSoL,5=ZHSoL,6=SRSoL,7=SHSoL" UBYTE void_int_S6_S3 1 100 0 255 ECU_ADDRESS 0xFFF8665B /end MEASUREMENT
/begin MEASUREMENT status_schaltung_egs_in "" SBYTE void_int_S6_S3 1 100 -9 9 ECU_ADDRESS 0xFFF86655 /end MEASUREMENT
/begin MEASUREMENT status_sync_schaltung_sbe "Anzeige der Synchronerkennung der aktuellen Schaltung innerhalb der HAS" UBYTE void_int_S6_S3 1 100 0 1 ECU_ADDRESS 0xFFF86656 /end MEASUREMENT
/begin MEASUREMENT status_waschstr_in "" UBYTE void_int_S6_S3 1 100 0 255 ECU_ADDRESS 0xFFF8668A /end MEASUREMENT
/begin MEASUREMENT status_waschstr_portin "Zustand der N-Halte-Phase" UBYTE void_int_S6_S3 1 100 0 255 ECU_ADDRESS 0xFFF86203 /end MEASUREMENT
/begin MEASUREMENT status_zug_svh "Richtung der angeforderten Schaltung der Schaltverhinderung der HAS - TRUE = RS angefordert, FALSE = keine RS angefordert" UBYTE void_int_S6_S3 1 100 0 1 ECU_ADDRESS 0xFFF96D82 /end MEASUREMENT
/begin MEASUREMENT status_zug_svh_sbe "Status für Anzeige Zug/Schub" UBYTE void_int_S6_S3 1 100 0 1 ECU_ADDRESS 0xFFF8665C /end MEASUREMENT
/begin MEASUREMENT t_abs_msa_has "Verzögerungszeit zur Deaktivierung der Beeinflussung der MSA-Funktionalität bei aktiven ABS-/ESP-Regelzuständen" FLOAT32_IEEE t_fl_S6_S3 1 100 0 5 ECU_ADDRESS 0xFFF8532C /end MEASUREMENT
/begin MEASUREMENT t_berg_msa_has "Timer der Verzögerungszeit zur Deaktivierung der Beeinflussung der MSA-Funktionalität am Berg beim Gang auslegen" FLOAT32_IEEE t_fl_S6_S3 1 100 0 5 ECU_ADDRESS 0xFFF96570 /end MEASUREMENT
/begin MEASUREMENT t_betrieb_pvu_has_ee_in "" ULONG t_int_S6_S3 1 100 0 10000 ECU_ADDRESS 0xFFF85E2C /end MEASUREMENT
/begin MEASUREMENT t_betrieb_pvu_has_ee_portin "" ULONG t_int_S6_S3 1 100 0 42949672.95 ECU_ADDRESS 0xFFF85174 /end MEASUREMENT
/begin MEASUREMENT t_betrieb_pvu_has_sbe "Betriebsdauer seit dem letzten Ablauf der Diagnosefunktion \"Positionsventil-Überwachung\" der Funktion zur Unterstüt-zung der Positionsventil-Überwachung der HAS" FLOAT32_IEEE t_fl_S6_S3 1 100 0 1000000 ECU_ADDRESS 0xFFF85DB8 /end MEASUREMENT
/begin MEASUREMENT t_emaktiv_fuw_zus "Timer zur Funktionsüberwachung der EM-Funktion beim Zustart" FLOAT32_IEEE t_fl_S6_S3 1 100 0 1000 ECU_ADDRESS 0xFFF85B84 /end MEASUREMENT
/begin MEASUREMENT t_k0zunemfehlerbed_fuw_zus "Timer zur Abschätzung 'K0 zu' bei fehlerhafter EM-Drehzahl der Funktionsüberwachung der EM-Funktion beim Zustart" FLOAT32_IEEE t_fl_S6_S3 1 100 0 5 ECU_ADDRESS 0xFFF85B90 /end MEASUREMENT
/begin MEASUREMENT t_maxsas_msa_has "Timer der Maximalzeit der Anforderung der Beeinflussung der MSA-Funktionalität bei aktivem Schaltablauf in Abhängigkeit des Ziel-Betriebszustands der Hybrid-Zustandssteuerung" FLOAT32_IEEE t_fl_S6_S3 1 100 0 1000 ECU_ADDRESS 0xFFF96574 /end MEASUREMENT
/begin MEASUREMENT t_msollemaktiv_zus "Timer der Maximalzeit der Vorgabe des K0-Störmoments und damit der Ausgabe des EM-Vorsteuermoments beim Zustart" FLOAT32_IEEE t_fl_S6_S3 1 100 0 10 ECU_ADDRESS 0xFFF85B98 /end MEASUREMENT
/begin MEASUREMENT t_mstoerk0emfil_zus "Timer der Verzögerungszeit nach Beginn der K0 Befüllung zur Aktivierung der Filterung des K0-Störmoments der EM-Ansteuerung beim Zustart" FLOAT32_IEEE t_fl_S6_S3 1 100 0 10 ECU_ADDRESS 0xFFF85B9C /end MEASUREMENT
/begin MEASUREMENT t_nembed_ndk0_msa_has "Timer der Verzögerungszeit nach Überschreiten der ersten VM Drehzahlschwelle  zur Aktivierung der Beeinflussung der MSA-Funktionalität bei geringer EM Drehzahl in Abhängigkeit der Differenzdrehzahl der K0 zum Schutz der K0" FLOAT32_IEEE t_fl_S6_S3 1 100 0 600 ECU_ADDRESS 0xFFF96578 /end MEASUREMENT
/begin MEASUREMENT t_vrueckgesas_msa_has "Timer der Maximalzeit der Anforderung der Beeinflussung der MSA-Funktionalität bei aktivem Schaltablauf in Abhängigkeit des Ziel-Betriebszustands der Hybrid-Zustandssteuerung" FLOAT32_IEEE t_fl_S6_S3 1 100 0 1000 ECU_ADDRESS 0xFFF9657C /end MEASUREMENT
/begin MEASUREMENT t_vruecksas_msa_has "Timer der Verzögerungszeit zur Rücknahme der Anforderung der Beeinflussung der MSA-Funktionalität bei aktivem Schaltablauf in Abhängigkeit des Ziel-Betriebszustands der Hybrid-Zustandssteuerung" FLOAT32_IEEE t_fl_S6_S3 1 100 0 10 ECU_ADDRESS 0xFFF96580 /end MEASUREMENT
/begin MEASUREMENT t_ziephasaktiv_bfi "Timer für den Zeitraum nach Erkennung der Betriebsbereitschaft des Hybridsystems in dem die Beeinflussung der IEP durch die HAS aktiv ist" FLOAT32_IEEE t_fl_S6_S3 1 100 0 5 ECU_ADDRESS 0xFFF96588 /end MEASUREMENT
/begin MEASUREMENT t_ziephasmax_bfi "Timer für den maximaler Zeitraum nach Erkennung der Betriebsbereitschaft des Hybridsystems in dem die Beeinflussung der IEP durch die HAS aktiv ist" FLOAT32_IEEE t_fl_S6_S3 1 100 0 500 ECU_ADDRESS 0xFFF9658C /end MEASUREMENT
/begin MEASUREMENT t_zsashasaktiv_bbr "Timer für den Zeitraum nach Erkennung der Betriebsbereitschaft des Hybridsystems, in dem die Beeinflussung der SAS Befüllreihenfolge durch die HAS aktiv ist" FLOAT32_IEEE t_fl_S6_S3 1 100 0 5 ECU_ADDRESS 0xFFF96590 /end MEASUREMENT
/begin MEASUREMENT t_zsashasmax_bbr "Timer für den maximalen Zeitraum nach Erkennung der Betriebsbereitschaft des Hybridsystems, in dem die Beeinflussung der SAS Befüllreihenfolge durch die HAS aktiv ist" FLOAT32_IEEE t_fl_S6_S3 1 100 0 500 ECU_ADDRESS 0xFFF96594 /end MEASUREMENT
/begin MEASUREMENT timer_pumpready_aktiv_fkt "" UBYTE t_int_d_S6_S3 1 100 0 1 ECU_ADDRESS 0xFFF8663C /end MEASUREMENT
/begin MEASUREMENT v_f_sbe "Fahrzeuggeschwindigkeit auf Basis der Getriebeabtriebsdrehzahl in der  Hybridablaufsteuerung" FLOAT32_IEEE v_fl_S6_S3 1 100 -3.40282e+038 3.40282e+038 ECU_ADDRESS 0xFFF85DBC /end MEASUREMENT
/begin MEASUREMENT vg_f_sbe "Fahrzeuggeschwindigkeitsgradient auf Basis der Getriebeabtriebsdrehzahl in der  Hybridablaufsteuerung" FLOAT32_IEEE vg_fl_S6_S3 1 100 -3.40282e+038 3.40282e+038 ECU_ADDRESS 0xFFF85DC0 /end MEASUREMENT
/begin MEASUREMENT z_ablauf_has_hst_in "" UBYTE void_int_S6_S3 1 100 0 15 ECU_ADDRESS 0xFFF8668B /end MEASUREMENT
/begin MEASUREMENT z_ablauf_has_hst_portin "" UBYTE void_int_S6_S3 1 100 0 255 ECU_ADDRESS 0xFFF86204 /end MEASUREMENT
/begin MEASUREMENT z_ablauf_has_stg "Zusaetzliche Steuergroesse zur Ablaufsteuerung" UBYTE void_int_S6_S3 1 100 0 15 ECU_ADDRESS 0xFFF86637 /end MEASUREMENT
/begin MEASUREMENT z_ablauf_svh_reset_has_fkt "" UBYTE void_int_S6_S3 1 100 0 255 ECU_ADDRESS 0xFFF8663D /end MEASUREMENT
/begin MEASUREMENT z_ablaufreinit_frk_dihi "Zeigt an, dass der aktuelle HAS-Ablauf erneut begonnen werden soll" UBYTE void_int_S6_S3 1 100 0 1 ECU_ADDRESS 0xFFF8662F /end MEASUREMENT
/begin MEASUREMENT z_ablaufvariante_has_hst_in "" UBYTE void_int_S6_S3 1 100 0 15 ECU_ADDRESS 0xFFF8668C /end MEASUREMENT
/begin MEASUREMENT z_ablaufvariante_has_hst_portin "" UBYTE void_int_S6_S3 1 100 0 255 ECU_ADDRESS 0xFFF86205 /end MEASUREMENT
/begin MEASUREMENT z_ablaufvariante_has_stg "Ablaufvariante, die  die OML ausgibt" UBYTE void_int_S6_S3 1 100 0 99 ECU_ADDRESS 0xFFF86638 /end MEASUREMENT
/begin MEASUREMENT z_ablaufvariante_kalt_zus "Anzeige der aktiven Ablaufvariante Kaltstart beim Zustart - 0 = kein Kaltstart, 1 = Kaltstart mit abgesenkter EM-Drehzahl" UBYTE void_int_S6_S3 1 100 0 255 ECU_ADDRESS 0xFFF8663E /end MEASUREMENT
/begin MEASUREMENT z_abs_msa_has "Anforderung der Beeinflussung der MSA-Funktionalität bei aktiven ABS-/ESP-Regelzuständen durch die Hybridablaufsteuerung - Codierung wie z_msa_has_sbe" UBYTE void_int_S6_S3 1 100 0 255 ECU_ADDRESS 0xFFF96D83 /end MEASUREMENT
/begin MEASUREMENT z_adaparameter_lls_has "Flag zur Umschaltung der Gradientenbegrenzer- und PT2-Filterkonstanten" UBYTE void_int_S6_S3 1 100 0 1 ECU_ADDRESS 0xFFF96D84 /end MEASUREMENT
/begin MEASUREMENT z_ba_has_k0_hst_in "" UBYTE void_int_S6_S3 1 100 0 1 ECU_ADDRESS 0xFFF8669F /end MEASUREMENT
/begin MEASUREMENT z_ba_has_vm_hst_in "" UBYTE void_int_S6_S3 1 100 0 1 ECU_ADDRESS 0xFFF866A0 /end MEASUREMENT
/begin MEASUREMENT z_berg_msa_has "Anforderung der Beeinflussung der MSA-Funktionalität am Berg durch die Hybridablaufsteuerung - Codierung wie z_msa_has_sbe" UBYTE void_int_S6_S3 1 100 0 255 ECU_ADDRESS 0xFFF96D85 /end MEASUREMENT
/begin MEASUREMENT z_cgetr_msa_has "Anforderung der Beeinflussung der MSA-Funktionalität in Abhängigkeit der Getriebeöltemperatur durch die Hybridablaufsteuerung - Codierung wie z_msa_has_sbe" UBYTE void_int_S6_S3 1 100 0 255 ECU_ADDRESS 0xFFF96D86 /end MEASUREMENT
/begin MEASUREMENT z_diag_ersfkt_has_in "Funktionsschnittstelle zur Ermittlung ob irgendeine Ersatzmaßnahme in der Diagnoseverwaltung aktiv ist" ULONG b_int_S6_S3 1 100 0 4294967295 ECU_ADDRESS 0xFFF85E30 /end MEASUREMENT
/begin MEASUREMENT z_diag_ersfkt_has_portin "Funktionsschnittstelle zur Ermittlung ob irgendeine Ersatzmaßnahme in der Diagnoseverwaltung aktiv ist" ULONG b_int_S6_S3 1 100 0 4294967295 ECU_ADDRESS 0xFFF85178 /end MEASUREMENT
/begin MEASUREMENT z_diag_ersfkt_hi_has_in "Funktionsschnittstelle zur Ermittlung ob irgendeine Ersatzmaßnahme in der Diagnoseverwaltung aktiv ist" ULONG b_int_S6_S3 1 100 0 4294967295 ECU_ADDRESS 0xFFF85E34 /end MEASUREMENT
/begin MEASUREMENT z_diag_ersfkt_hi_has_portin "Funktionsschnittstelle zur Ermittlung ob irgendeine Ersatzmaßnahme in der Diagnoseverwaltung aktiv ist" ULONG b_int_S6_S3 1 100 0 4294967295 ECU_ADDRESS 0xFFF8517C /end MEASUREMENT
/begin MEASUREMENT z_diag_msa_has "Anforderung der Beeinflussung der MSA-Funktionalität bei aktiver Diagnose-Ersatzfunktion durch die Hybridablaufsteuerung - Codierung wie z_msa_has_sbe" UBYTE void_int_S6_S3 1 100 0 255 ECU_ADDRESS 0xFFF96D87 /end MEASUREMENT
/begin MEASUREMENT z_diag_notgang_has_in "Notganginformation" UBYTE void_int_S6_S3 1 100 0 255 ECU_ADDRESS 0xFFF8668D /end MEASUREMENT
/begin MEASUREMENT z_diag_notgang_has_portin "Notganginformation" UBYTE void_int_S6_S3 1 100 0 255 ECU_ADDRESS 0xFFF86206 /end MEASUREMENT
/begin MEASUREMENT z_diagnotgang_bmi_has "Anzeige der Beeinflussung des Hybrid-Betriebsmodus der IAE durch die Diagnose Notgang-Information - 0 = keine Beeinflussung, 1 = Überführung in den Zustand E-Fahren Kraftschluss" UBYTE void_int_S6_S3 1 100 0 1 ECU_ADDRESS 0xFFF96D88 /end MEASUREMENT
/begin MEASUREMENT z_emaktiv_fuw_zus_fkt "Anzeige der EM Fehlfuntion der Funktionsüberwachung der EM beim Zustart" UBYTE void_int_S6_S3 1 100 0 1 ECU_ADDRESS 0xFFF8663F /end MEASUREMENT
/begin MEASUREMENT z_emfehler_frk_dihi "Zeigt an, dass eine EM Fehlfunktion erkannt wurde, die in der HAS ausgewertet werden soll" UBYTE void_int_S6_S3 1 100 0 1 ECU_ADDRESS 0xFFF86630 /end MEASUREMENT
/begin MEASUREMENT z_fehler15_eh_fkt "" UBYTE void_int_S6_S3 1 100 0 1 ECU_ADDRESS 0xFFF86640 /end MEASUREMENT
/begin MEASUREMENT z_fkt_msa_has "Anforderung der Beeinflussung der MSA-Funktionalität bei aktiver Hybridfunktion durch die Hybridablaufsteuerung - Codierung wie z_msa_has_sbe" UBYTE void_int_S6_S3 1 100 0 255 ECU_ADDRESS 0xFFF96D89 /end MEASUREMENT
/begin MEASUREMENT z_freigabe_pvu_has_sbe "Freigabe zur Aktivierung der Diagnosefunktion \"Positionsventil-Überwachung\" der Funktion zur Unterstützung der Positi-onsventil-Überwachung der HAS" UBYTE void_int_S6_S3 1 100 0 1 ECU_ADDRESS 0xFFF86657 /end MEASUREMENT
/begin MEASUREMENT z_fst_msa_has "Anforderung der Beeinflussung der MSA-Funktionalität bei aktiver Hybridfunktion in Abhängigkeit der Vorgabe der Fahrstrategie  - Codierung wie z_msa_has_sbe" UBYTE void_int_S6_S3 1 100 0 255 ECU_ADDRESS 0xFFF96D8A /end MEASUREMENT
/begin MEASUREMENT z_fuwdeakt_frk_dihi "Zeigt an, dass die FUW-Funktion nicht aktiviert werden darf" UBYTE void_int_S6_S3 1 100 0 1 ECU_ADDRESS 0xFFF86631 /end MEASUREMENT
/begin MEASUREMENT z_ge_ndk0_msa_has "Motorstartanforderung während Gangeinlegen bei nd_k0 über Schwelle NDS_K0_GE_NDK0_MSA_HAS" UBYTE void_int_S6_S3 1 100 0 1 ECU_ADDRESS 0xFFF96D8B /end MEASUREMENT
/begin MEASUREMENT z_hybfkt_stg "Anforderung der Aktivierung einer Hybridfunktion durch die Hyrid-Zustandssteuerung" UBYTE E_HYBFKT_S6_S3 1 100 0 15 ECU_ADDRESS 0xFFF86639 /end MEASUREMENT
/begin MEASUREMENT z_iae_msa_has "Anforderung der Beeinflussung der MSA-Funktionalität in Abhängigkeit des IAE Betriebszustands durch die Hybridablaufsteuerung - Codierung wie z_msa_has_sbe" UBYTE void_int_S6_S3 1 100 0 255 ECU_ADDRESS 0xFFF96D8C /end MEASUREMENT
/begin MEASUREMENT z_iep_in "" UBYTE E_ZIEP_S6_S3 1 100 0 4 ECU_ADDRESS 0xFFF8668E /end MEASUREMENT
/begin MEASUREMENT z_iep_portin "" UBYTE E_ZIEP_S6_S3 1 100 0 4 ECU_ADDRESS 0xFFF86207 /end MEASUREMENT
/begin MEASUREMENT z_init_fkt "" UBYTE void_int_S6_S3 1 100 0 1 ECU_ADDRESS 0xFFF86641 /end MEASUREMENT
/begin MEASUREMENT z_k0_befuellopt_has_fkt "" UBYTE void_int_S6_S3 1 100 0 1 ECU_ADDRESS 0xFFF86642 /end MEASUREMENT
/begin MEASUREMENT z_k0_fst_in "" UBYTE E_ZK0FSTIN_S6_S3 1 100 0 3 ECU_ADDRESS 0xFFF8668F /end MEASUREMENT
/begin MEASUREMENT z_k0_fst_portin "" UBYTE E_ZK0FSTIN_S6_S3 1 100 0 3 ECU_ADDRESS 0xFFF86208 /end MEASUREMENT
/begin MEASUREMENT z_k0_has_fkt "" UBYTE E_ZK0_S6_S3 1 100 0 5 ECU_ADDRESS 0xFFF86643 /end MEASUREMENT
/begin MEASUREMENT z_k0_has_sbe "" UBYTE E_ZK0_S6_S3 1 100 0 5 ECU_ADDRESS 0xFFF8665D /end MEASUREMENT
/begin MEASUREMENT z_k0ansteuerung_bbr "Erkennung der Anforderung der K0 Ansteuerung der Beeinflussung der SAS Befüllreihenfolge durch die HAS" UBYTE void_int_S6_S3 1 100 0 1 ECU_ADDRESS 0xFFF96D8D /end MEASUREMENT
/begin MEASUREMENT z_k0syncmk0erh_frk_dihi "Zeigt an, dass eine K0-Zwangsynchronisation mittels Erhöhung des K0-Moments erfolgen soll" UBYTE void_int_S6_S3 1 100 0 1 ECU_ADDRESS 0xFFF86632 /end MEASUREMENT
/begin MEASUREMENT z_kfl_msa_has "Anforderung der Beeinflussung der MSA-Funktionalität in Abhängigkeit des Kraftfluss-Status durch die Hybridab-laufsteuerung - Codierung wie z_msa_has_sbe" UBYTE void_int_S6_S3 1 100 0 255 ECU_ADDRESS 0xFFF96D90 /end MEASUREMENT
/begin MEASUREMENT z_kps_stada_in "Sollvorgabe für die Trennkupplung K0 durch die Stillstandsadaption" UBYTE void_int_S6_S3 1 100 0 255 ECU_ADDRESS 0xFFF86690 /end MEASUREMENT
/begin MEASUREMENT z_kps_stada_portin "Sollvorgabe für die Trennkupplung K0 durch die Stillstandsadaption" UBYTE void_int_S6_S3 1 100 0 255 ECU_ADDRESS 0xFFF86209 /end MEASUREMENT
/begin MEASUREMENT z_m_begr_em_has_fkt "" UBYTE void_int_S6_S3 1 100 0 50 ECU_ADDRESS 0xFFF86644 /end MEASUREMENT
/begin MEASUREMENT z_m_max_iae_has_fkt "" UBYTE void_int_S6_S3 1 100 0 50 ECU_ADDRESS 0xFFF86645 /end MEASUREMENT
/begin MEASUREMENT z_m_soll_em_has_fkt "" UBYTE void_int_S6_S3 1 100 0 50 ECU_ADDRESS 0xFFF86646 /end MEASUREMENT
/begin MEASUREMENT z_m_soll_vm_has_fkt "" UBYTE void_int_S6_S3 1 100 0 50 ECU_ADDRESS 0xFFF86647 /end MEASUREMENT
/begin MEASUREMENT z_modus_em_hst_in "" UBYTE void_int_S6_S3 1 100 0 255 ECU_ADDRESS 0xFFF86691 /end MEASUREMENT
/begin MEASUREMENT z_modus_iae_has_fkt "" UBYTE E_ZMODUSIAE_S6_S3 1 100 0 2 ECU_ADDRESS 0xFFF86648 /end MEASUREMENT
/begin MEASUREMENT z_modus_iae_has_sbe "" UBYTE E_ZMODUSIAE_S6_S3 1 100 0 2 ECU_ADDRESS 0xFFF8665E /end MEASUREMENT
/begin MEASUREMENT z_modus_iep_has_fuw "Vorgabe des Betriebsmodus zur Beeinflussung der IEP durch die HAS bei EM-Fehlfunktion beim Zustart" UBYTE E_ZMODUSIEP_S6_S3 1 100 0 4 ECU_ADDRESS 0xFFF96D91 /end MEASUREMENT
/begin MEASUREMENT z_modus_iep_has_pvu "Vorgabe des Betriebsmodus zur Beeinflussung der IEP zur Unterstuetzung der Positionsventil-Ueberwachung der HAS" UBYTE E_ZMODUSIEP_S6_S3 1 100 0 4 ECU_ADDRESS 0xFFF96D92 /end MEASUREMENT
/begin MEASUREMENT z_modus_iep_has_sbe "Vorgabe des Betriebsmodus der IEP durch die HAS" UBYTE E_ZMODUSIEP_S6_S3 1 100 0 4 ECU_ADDRESS 0xFFF8665F /end MEASUREMENT
/begin MEASUREMENT z_modus_iep_has_sst "Vorgabe des Betriebsmodus zur Beeinflussung der IEP durch die HAS bei SST-Start" UBYTE E_ZMODUSIEP_S6_S3 1 100 0 4 ECU_ADDRESS 0xFFF96D93 /end MEASUREMENT
/begin MEASUREMENT z_msa_aktiv_has "Bitmaske zur Festlegung, welche der Beeinflussungsmöglichkeiten der MSA-Funktionalität durch die HAS aktiviert sind - Codierung wie z_msa_has_sbe" UBYTE void_int_S6_S3 1 100 0 255 ECU_ADDRESS 0xFFF96D94 /end MEASUREMENT
/begin MEASUREMENT z_msa_avh_moni_has_sbe "Anforderung einer Schaltverhinderung der HAS" UBYTE void_int_S6_S3 1 100 0 255 ECU_ADDRESS 0xFFF86660 /end MEASUREMENT
/begin MEASUREMENT z_msa_eaf_moni_has_sbe "Anforderung einer Schaltverhinderung der HAS" UBYTE void_int_S6_S3 1 100 0 255 ECU_ADDRESS 0xFFF86661 /end MEASUREMENT
/begin MEASUREMENT z_msa_fktaktiv_has "Anzeige der aktiven Einzelfkt. der Beeinfl. der MSA-Funktionalität durch die HAS, Codierung: bit0=CGETR,bit1=VGF,bit2=ABS,bit3=KFL,bit4=SAS,bit5=IAE,bit6=STADA,bit7=frei,bit8=frei,bit9=frei,bit10=FKT,bit11=BERG,bit12=FST,bit13=frei,bit14=NDK0,bit15=DIAG" UWORD void_int_b_S6_S3 1 100 0 65535 ECU_ADDRESS 0xFFF96EF2 /end MEASUREMENT
/begin MEASUREMENT z_msa_fst_in "Anforderung einer Abschaltverhinderung durch die Fahrstrategie ASIS" UBYTE void_int_S6_S3 1 100 0 255 ECU_ADDRESS 0xFFF86692 /end MEASUREMENT
/begin MEASUREMENT z_msa_fst_portin "Anforderung einer Abschaltverhinderung durch die Fahrstrategie ASIS" UBYTE void_int_S6_S3 1 100 0 255 ECU_ADDRESS 0xFFF8620A /end MEASUREMENT
/begin MEASUREMENT z_msa_has_sbe "Anforderung der Beeinflussung der MSA-Funktionalität durch die Hybridablaufsteuerung - Codierung: bit0 = AVZ, bit1 = AVH, bit2 = EAF, bit3 = EVH, bit4 = Deaktivierung, bit7 = Störungsbedingt" UBYTE void_int_S6_S3 1 100 0 255 ECU_ADDRESS 0xFFF86662 /end MEASUREMENT
/begin MEASUREMENT z_msa_stada_in "" UBYTE void_int_S6_S3 1 100 0 6 ECU_ADDRESS 0xFFF866A1 /end MEASUREMENT
/begin MEASUREMENT z_n_min_em_parksp_has_in "Anforderung einer EM-Drehzahlanhebung beim Auslegen der Parksperre infolge unzureichender Ölversorgung" UBYTE void_int_S6_S3 1 100 0 1 ECU_ADDRESS 0xFFF86693 /end MEASUREMENT
/begin MEASUREMENT z_n_min_em_parksp_has_portin "Anforderung einer EM-Drehzahlanhebung beim Auslegen der Parksperre infolge unzureichender Ölversorgung" UBYTE void_int_S6_S3 1 100 0 1 ECU_ADDRESS 0xFFF8620B /end MEASUREMENT
/begin MEASUREMENT z_n_min_iep_in "Anforderung Ausgabe EM-Mindestdrehzahl zur Sicherstellung der Ölversorgung durch die IEP" UBYTE void_int_S6_S3 1 100 0 1 ECU_ADDRESS 0xFFF86694 /end MEASUREMENT
/begin MEASUREMENT z_n_min_iep_portin "Anforderung Ausgabe EM-Mindestdrehzahl zur Sicherstellung der Ölversorgung durch die IEP" UBYTE void_int_S6_S3 1 100 0 1 ECU_ADDRESS 0xFFF8620C /end MEASUREMENT
/begin MEASUREMENT z_n_soll_em_has_fkt "" UBYTE void_int_S6_S3 1 100 0 50 ECU_ADDRESS 0xFFF86649 /end MEASUREMENT
/begin MEASUREMENT z_n_soll_vm_has_fkt "" UBYTE void_int_S6_S3 1 100 0 50 ECU_ADDRESS 0xFFF8664A /end MEASUREMENT
/begin MEASUREMENT z_ndk0_msa_has "Anforderung der Beeinflussung der MSA-Funktionalität bei hohen negativen Differenzdrehzahlen an der K0 Hybridablaufsteuerung - Codierung wie z_msa_has_sbe" UBYTE void_int_S6_S3 1 100 0 255 ECU_ADDRESS 0xFFF96D95 /end MEASUREMENT
/begin MEASUREMENT z_nembed_ndk0_msa_has "Aktivierungsbedingung der Beeinflussung der MSA-Funktionalität bei geringer EM Drehzahl in Abhängigkeit der Differenzdrehzahl der K0 zum Schutz der K0" UBYTE void_int_S6_S3 1 100 0 1 ECU_ADDRESS 0xFFF96D96 /end MEASUREMENT
/begin MEASUREMENT z_nllsoll_iae_in "Anforderung der IAE, dass eine definierte LL-Drehzahl durch den Motor eingestellt werden soll" UBYTE E_ZNLLSOLL_S6_S3 1 100 0 2 ECU_ADDRESS 0xFFF86695 /end MEASUREMENT
/begin MEASUREMENT z_nllsoll_iae_portin "Anforderung der IAE, dass eine definierte LL-Drehzahl durch den Motor eingestellt werden soll" UBYTE E_ZNLLSOLL_S6_S3 1 100 0 2 ECU_ADDRESS 0xFFF8620D /end MEASUREMENT
/begin MEASUREMENT z_nmineminit_lls_has "Flag zur Initialisierung des Gradientenbegrenzers und PT2-Filters" UBYTE void_int_S6_S3 1 100 0 1 ECU_ADDRESS 0xFFF96D97 /end MEASUREMENT
/begin MEASUREMENT z_nminemnull_frk_dihi "Zeigt an, dass die Ausgabe der minimalen EM Drehzahl der HAS unterdrückt werden soll." UBYTE void_int_S6_S3 1 100 0 1 ECU_ADDRESS 0xFFF86633 /end MEASUREMENT
/begin MEASUREMENT z_nvmsollbegr_frk_dihi "Zeigt an, dass die VM-Solldrehzahl auf die EM-Istdrehzahl be-grenzt werden soll" UBYTE void_int_S6_S3 1 100 0 1 ECU_ADDRESS 0xFFF86634 /end MEASUREMENT
/begin MEASUREMENT z_p_hys_k0_has_fkt "Hysteresekompensation" UBYTE void_int_S6_S3 1 100 0 1 ECU_ADDRESS 0xFFF8664B /end MEASUREMENT
/begin MEASUREMENT z_ponr_fkt "point of no return" UBYTE void_int_S6_S3 1 100 0 1 ECU_ADDRESS 0xFFF8664C /end MEASUREMENT
/begin MEASUREMENT z_pvu_has_sbe "Beeinflussung des Hybridsystems zur Unterstützung der Positionsventil- Überwachung der HAS-Codierung: 0 = keine Beeinflussung, 1 = Beeinflussung Stufe 1, 2 = Beeinflussung Stufe 2" UBYTE void_int_S6_S3 1 100 0 2 ECU_ADDRESS 0xFFF86658 /end MEASUREMENT
/begin MEASUREMENT z_saf_has_fkt "Schaltanforderung 1...aktiv" UBYTE void_int_S6_S3 1 100 0 1 ECU_ADDRESS 0xFFF8664D /end MEASUREMENT
/begin MEASUREMENT z_sas_has_sbe "Ändert im Wahrheitsfall die KupplungsBefüllreihenfolge" UBYTE void_int_S6_S3 1 100 0 1 ECU_ADDRESS 0xFFF86663 /end MEASUREMENT
/begin MEASUREMENT z_sas_msa_ge_has "Anforderung der Beeinflussung der MSA-Funktionalität bei aktivem Schaltablauf beim Gangeinlegen durch die Hybridablaufsteuerung - Codierung wie z_msa_has_sbe" UBYTE void_int_S6_S3 1 100 0 255 ECU_ADDRESS 0xFFF8626C /end MEASUREMENT
/begin MEASUREMENT z_sas_msa_has "Anforderung der Beeinflussung der MSA-Funktionalität bei aktivem Schaltablauf durch die Hybridablaufsteuerung - Codierung wie z_msa_has_sbe" UBYTE void_int_S6_S3 1 100 0 255 ECU_ADDRESS 0xFFF96D98 /end MEASUREMENT
/begin MEASUREMENT z_sas_msa_rshs_has "Anforderung der Beeinflussung der MSA-Funktionalität bei aktivem Schaltablauf bei RS und HS durch die Hybridablaufsteuerung - Codierung wie z_msa_has_sbe" UBYTE void_int_S6_S3 1 100 0 255 ECU_ADDRESS 0xFFF8626D /end MEASUREMENT
/begin MEASUREMENT z_sbe_has_fkt "Schaltbeeinflussung  1...aktiv" UBYTE void_int_S6_S3 1 100 0 1 ECU_ADDRESS 0xFFF8664E /end MEASUREMENT
/begin MEASUREMENT z_stada_msa_has "Anforderung der Beeinflussung der MSA-Funktionalität in Abhängigkeit der Vorgabe der Still-standadaption - Codierung wie z_msa_has_sbe" UBYTE void_int_S6_S3 1 100 0 255 ECU_ADDRESS 0xFFF96D99 /end MEASUREMENT
/begin MEASUREMENT z_standby_em_has_fkt "" UBYTE void_int_S6_S3 1 100 0 1 ECU_ADDRESS 0xFFF8664F /end MEASUREMENT
/begin MEASUREMENT z_start_modus_has_sbe "Anforderung eines Anlasserstarts" UBYTE void_int_S6_S3 1 100 0 255 ECU_ADDRESS 0xFFF86664 /end MEASUREMENT
/begin MEASUREMENT z_status_psys_mps_sbe "Flag, das eine Modifikation des Pumpendruckstatus anzeigt" UBYTE void_int_S6_S3 1 100 0 1 ECU_ADDRESS 0xFFF86659 /end MEASUREMENT
/begin MEASUREMENT z_statusefahren_bmi_modus "Umschaltmodus zur Festl. des Zeitpunkts der Umschaltung auf den Zielzust. des Status E-Fahren zur Best.des Hybrid-Betriebsmodus der IAE, Cod.: 0=am Ende des Zustandsübergangs,1=zu Beginn des Zustandsübergangs,2=nach der K0 Befüllung,3=beim Öffnen der K0" UBYTE void_int_S6_S3 1 100 0 3 ECU_ADDRESS 0xFFF96D9A /end MEASUREMENT
/begin MEASUREMENT z_statusefahren_out_modus "Umschaltmodus zur Festl. des Zeitpunkts der Umschaltung auf den Zielzust. des Status E-Fahren der HAS bei einem Zustandsübergang, Cod.: 0=am Ende des Zustandsübergangs,1=zu Beginn des Zustandsübergangs,2=nach der K0 Befüllung,3=beim Öffnen der K0" UBYTE void_int_S6_S3 1 100 0 3 ECU_ADDRESS 0xFFF96D9B /end MEASUREMENT
/begin MEASUREMENT z_svh_has_sbe "Anforderung einer Schaltverhinderung der HAS" UBYTE void_int_S6_S3 1 100 0 1 ECU_ADDRESS 0xFFF86665 /end MEASUREMENT
/begin MEASUREMENT z_t_k0zunemfehlerbed_fuw_zus "Bedingung Timer bei  fehlerhafter EM-Drehzahl der Funktionsüberwachung der EM-Funktion beim Zustart " UBYTE void_int_S6_S3 1 100 0 255 ECU_ADDRESS 0xFFF96DE7 /end MEASUREMENT
/begin MEASUREMENT z_t_msollemaktiv_zus "Bedingung Timer zur Initialisierung der Vorgabe des K0-Störmoments und damit der Ausgabe des EM-Vorsteuermoments beim Zustart" UBYTE void_int_S6_S3 1 100 0 255 ECU_ADDRESS 0xFFF96DEB /end MEASUREMENT
/begin MEASUREMENT z_t_mstoerk0emfil_zus "Bedingung Timer zur Initialisierung der K0 Befüllung zur Aktivierung der Filterung des K0-Störmoments der EM-Ansteuerung beim Zustart" UBYTE void_int_S6_S3 1 100 0 255 ECU_ADDRESS 0xFFF96DEC /end MEASUREMENT
/begin MEASUREMENT z_timer_pumpready_fkt "" UBYTE void_int_S6_S3 1 100 0 1 ECU_ADDRESS 0xFFF86650 /end MEASUREMENT
/begin MEASUREMENT z_tmin_fehler15_fkt "Status Timer für Verweilzeit in Fehler15" UBYTE void_int_S6_S3 1 100 0 255 ECU_ADDRESS 0xFFF86651 /end MEASUREMENT
/begin MEASUREMENT z_tnminembefuellfzp_lls_has "Zeit für die Ausgabe einer EM Mindrehzahl zur Befuellung des Ansaugkanals der FZP" UBYTE t_fl_k_S6_S3 1 100 0 5 ECU_ADDRESS 0xFFF96D9C /end MEASUREMENT
/begin MEASUREMENT z_vgf_msa_has "Anforderung der Beeinflussung der MSA-Funktionalität in Abhängigkeit des Fahrzeuggeschwindigkeitsgradienten durch die Hybridablaufsteuerung - Codierung wie z_msa_has_sbe" UBYTE void_int_S6_S3 1 100 0 255 ECU_ADDRESS 0xFFF96D9D /end MEASUREMENT
/begin MEASUREMENT z_vmstart_bfi "Erkennung der Anforderung eines VM Starts der Funktion zur  Beeinflussung der IEP durch die HAS" UBYTE void_int_S6_S3 1 100 0 1 ECU_ADDRESS 0xFFF96D9E /end MEASUREMENT
/begin MEASUREMENT z_vmstartvoreil_bfi "Erkennung der voreilenden Anforderung eines VM Starts der Funktion zur  Beeinflussung der IEP durch die HAS" UBYTE void_int_S6_S3 1 100 0 1 ECU_ADDRESS 0xFFF96D9F /end MEASUREMENT
/begin MEASUREMENT z_ziel_kraftfluss_egs_in "" UBYTE void_int_S6_S3 1 100 0 255 ECU_ADDRESS 0xFFF86696 /end MEASUREMENT
/begin MEASUREMENT z_zuendfreigabe_vm_fkt "" UBYTE void_int_S6_S3 1 100 0 1 ECU_ADDRESS 0xFFF86652 /end MEASUREMENT
/begin MEASUREMENT z_zuendfreigabe_vm_has_fkt "" UBYTE void_int_S6_S3 1 100 0 1 ECU_ADDRESS 0xFFF86653 /end MEASUREMENT
/begin MEASUREMENT zielgang_egs_in "" SBYTE void_int_S6_S3 1 100 -128 127 ECU_ADDRESS 0xFFF86697 /end MEASUREMENT
/begin MEASUREMENT zielgang_egs_portin "" SBYTE void_int_S6_S3 1 100 -128 127 ECU_ADDRESS 0xFFF8620E /end MEASUREMENT
/begin FUNCTION SFOp_Zus298_K0_Ansteuerung ""
 /begin SUB_FUNCTION Run_SFOp_Zus31__iter_Gradient_1 Run_SFOp_Zus31__hlerbed_fuw_zus /end SUB_FUNCTION
 /begin DEF_CHARACTERISTIC KF_MSOLLK0BEF_ANH_ZUS_W KF_MSOLLK0BEF_ANH_ZUS_X KF_MSOLLK0BEF_ANH_ZUS_Y KL_MK0MODK0BEF_ZUS_X KL_MK0MODK0BEF_ZUS_Y KL_MSOLLK0EMANK_FUW_ZUS_X KL_MSOLLK0EMANK_FUW_ZUS_Y KL_MSOLLK0KALTNEM_ANH_ZUS_X KL_MSOLLK0KALTNEM_ANH_ZUS_Y MG_SOLLK0EMANKPOS_FUW_ZUS MG_SOLLK0NEG_ANH_ZUS MG_SOLLK0POSKALTNEM_ANH_ZUS MG_SOLLK0POS_ANH_ZUS MS_WUNSCHK0HYS_ANH_ZUS MS_ZIELVMHASK0HYS_ANH_ZUS NDS_VMNEMBED_ANH_ZUS NDS_VMNEMK0HYS_ANH_ZUS NS_EMEMAKTIV_FUW_ZUS NS_EMEMFEHLER_FUW_ZUS NS_EMK0HYS_ANH_ZUS SWI_MK0MODBEGR_ANH_ZUS SWI_ZPHYSK0_ANH_ZUS T_VK0ZUNEMFEHLER_FUW_ZUS /end DEF_CHARACTERISTIC
 /begin LOC_MEASUREMENT SFOp_Zus307_KL__K0EMANK_FUW_ZUS SFOp_Zus309_KL_MK0MODK0BEF_ZUS SFOp_Zus309_KL__K0EMANK_FUW_ZUS SFOp_Zus309_KL__KALTNEM_ANH_ZUS SFOp_Zus313_out_ c_getriebe_egs_in m_k0_in m_max_dyn_em_in m_wunsch_fpw_hst_in m_ziel_vm_has_zus n_em_in n_vm_in pos_egs_in status_k0_in status_kraftfluss_egs_in status_nem_in t_k0zunemfehlerbed_fuw_zus z_emfehler_frk_dihi z_fuwdeakt_frk_dihi z_t_k0zunemfehlerbed_fuw_zus /end LOC_MEASUREMENT
/end FUNCTION
/begin FUNCTION SFOp_Zus299_Sc__gsbeeinflussung ""
 /begin SUB_FUNCTION SFOp_Zus318_K_SVH_RESET_SYN_ZUS SFOp_Zus317_K_SVH_RESET_ANH_ZUS /end SUB_FUNCTION
 /begin DEF_CHARACTERISTIC NDS_VMNEMSVHRESET_ANH_ZUS NS_EMSVHRESET_ANH_ZUS /end DEF_CHARACTERISTIC
/end FUNCTION
/begin FUNCTION SFOp_Zus317_K_SVH_RESET_ANH_ZUS "" /begin DEF_CHARACTERISTIC KL_KSVHRESET_ANH_ZUS_X KL_KSVHRESET_ANH_ZUS_Y /end DEF_CHARACTERISTIC /begin LOC_MEASUREMENT SFOp_Zus317_KL__VHRESET_ANH_ZUS /end LOC_MEASUREMENT /end FUNCTION
/begin FUNCTION SFOp_Zus318_K_SVH_RESET_SYN_ZUS "" /begin DEF_CHARACTERISTIC KL_KSVHRESET_SYN_ZUS_X KL_KSVHRESET_SYN_ZUS_Y /end DEF_CHARACTERISTIC /begin LOC_MEASUREMENT SFOp_Zus318_KL__VHRESET_SYN_ZUS /end LOC_MEASUREMENT /end FUNCTION
/begin FUNCTION SFOp_Zus321_Entry ""
 /begin DEF_CHARACTERISTIC K_SVH_RESET_ABB_ZUS STATUS_ABL_ABBRUCH_AKTIV SWI_ZPHYSK0_ABB_ZUS /end DEF_CHARACTERISTIC
/end FUNCTION
/begin FUNCTION SFOp_Zus336_ac_zustarten_zus_en "" /begin DEF_CHARACTERISTIC STATUS_ABL_ZST_ZUS SWI_ZPHYSK0_ZST_ZUS /end DEF_CHARACTERISTIC /end FUNCTION
/begin FUNCTION SFOp_Zus362_Entry "" /begin DEF_CHARACTERISTIC SWI_ZPHYSK0_UEB_ZUS /end DEF_CHARACTERISTIC /end FUNCTION
/begin FUNCTION SFOp_Zus369_ac_start_en ""
 /begin DEF_CHARACTERISTIC K_SVH_RESETLAUSABLABBR_SRT_ZUS K_SVH_RESETLAUS_SRT_ZUS STATUS_ABL_ABBRFKT_SRT_ZUS SWI_ZPHYSK0_SRT_ZUS Z_ABLAUF_ABBRUCH_ZUS /end DEF_CHARACTERISTIC
 /begin LOC_MEASUREMENT SFOp_Zus78_xp_ c_getriebe_egs_in gangwechsel_egs_in i_zielgang_egs istgang_egs_in k_mstoerk0em_zus m_em_in m_k0_in m_k0_mod_has_fkt m_max_dyn_em_in m_min_dyn_em_in m_min_vm_in m_soll_k0_has_fkt m_soll_vm_hst_in m_soll_vm_l_hst_in m_stoerk0em_fil_zus m_vm_in m_vm_start_in m_wunsch_fpw_hst_in m_wunsch_fpw_in m_ziel_vm_has_zus mg_wunsch_fpw_hst n_ab_egs_in n_em_in n_sec_iae_ist_zus n_sec_iae_ziel_zus n_soll_em_hst_in n_soll_ll_vm_in n_vm_in nd_k0_in ndg_k0_in ng_vm pos_egs_in sollgang_egs_in status_iae_in status_k0_in status_kraftfluss_egs_in status_nem_in status_nreg_em_hst_in status_psys_has_sbe status_schaltart_svh_has_sbe status_schaltung_egs_in status_sync_schaltung_sbe t_emaktiv_fuw_zus z_ablauf_has_hst_in z_ablauf_has_stg z_ablaufvariante_has_stg z_emfehler_frk_dihi z_fuwdeakt_frk_dihi z_k0_fst_in z_k0_has_fkt z_k0syncmk0erh_frk_dihi z_pvu_has_sbe z_svh_has_sbe /end LOC_MEASUREMENT
/end FUNCTION
/begin FUNCTION SFOp_Zus6_Input ""
 /begin SUB_FUNCTION Run_SFOp_Zus77__emaktiv_fuw_zus SFOp_Zus76_Signale_input Run_SFOp_Zus90__toerk0emfil_zus Run_SFOp_Zus89__0em_fil_basis_2 Run_SFOp_Zus88__0em_fil_basis_1 Run_SFOp_Zus85__sollemaktiv_zus Run_SFOp_Zus78_cDT1_ngem /end SUB_FUNCTION
 /begin DEF_CHARACTERISTIC FK_NGEM_ZUS KF_FKMSTOERK0EM_ZUS_W KF_FKMSTOERK0EM_ZUS_X KF_FKMSTOERK0EM_ZUS_Y KF_KMSTOERK0EMMOD_ZUS_W KF_KMSTOERK0EMMOD_ZUS_X KF_KMSTOERK0EMMOD_ZUS_Y KL_MSSOLLEMAKTIV_ZUS_X KL_MSSOLLEMAKTIV_ZUS_Y KL_TVMSTOERK0EMFIL_ZUS_X KL_TVMSTOERK0EMFIL_ZUS_Y KL_ZMSOLLEMAKTIVSTKFL_ZUS_X KL_ZMSOLLEMAKTIVSTKFL_ZUS_Y MS_K0MSTOERK0EMFIL_ZUS T_MAX_EMAKTIV_FUW_ZUS T_MSOLLEMAKTIVMAX_ZUS /end DEF_CHARACTERISTIC
 /begin LOC_MEASUREMENT SFOp_Zus78_xp_ SFOp_Zus89_x2_ abstellpos_vm_in abstellpos_vm_status_in c_getriebe_egs_in c_vm_in gangwechsel_egs_in i_istgang_egs i_zielgang_egs istgang_egs_in k_mstoerk0em_zus m_em_in m_iae_in m_k0_in m_k0_mber_has_sbe m_k0_mod_has_fkt m_max_dyn_em_in m_min_dyn_em_in m_min_vm_in m_mot_in m_motmax_has m_soll_em_hst_in m_soll_k0_has_fkt m_soll_res_em_bas_sbe m_soll_res_em_has_sbe m_soll_vm_hst_in m_soll_vm_l_hst_in m_stoerk0em_fil_zus m_vm_in m_vm_start_in m_wunsch_fpw_hst_fil m_wunsch_fpw_hst_in m_wunsch_fpw_in mg_wunsch_fpw mg_wunsch_fpw_hst n_ab_egs_in n_em_in n_min_em_has_sbe n_min_psys_em_has_sbe n_mot_soll_iae_in n_sec_iae n_sec_iae_ist_zus n_sec_iae_ziel_zus n_soll_em_hst_in n_soll_ll_vm_in n_t_egs_in n_vm_in nd_iae nd_k0_in ndg_k0_in ng_vm osmode_next_in p_bremse_fzg_in phi_neigung_in pos_egs_in sollgang_egs_in st_OMLID_act_stg st_ist_bz_has_stg st_soll_bz_has_hst st_ziel_bz_has_stg status_alaengs_adaoff_in status_betriebsbereit_hst_in status_efahren_has_sbe status_fehler15_eh_diagin status_fehler_iep_in status_iae_adap_in status_iae_in status_iep_in status_k0_adap_in status_k0_in status_kl15_in status_kolbenpos_k0_in status_kraftfluss_egs_in status_kraftfluss_egs_roh_in status_ll_vm_in status_nem_in status_nreg_em_hst_in status_nvm_in status_posvueb_in status_psys_has_sbe status_sa_vm_in status_schaltart_svh_has_sbe status_schaltung_egs_in status_sync_schaltung_sbe status_waschstr_in status_zug_svh_sbe t_betrieb_pvu_has_ee_in t_betrieb_pvu_has_sbe t_emaktiv_fuw_zus t_msollemaktiv_zus t_mstoerk0emfil_zus v_f_sbe vg_f_sbe z_ablauf_has_hst_in z_ablauf_has_stg z_ablaufreinit_frk_dihi z_ablaufvariante_has_hst_in z_ablaufvariante_has_stg z_ba_has_k0_hst_in z_ba_has_vm_hst_in z_diag_ersfkt_has_in z_diag_ersfkt_hi_has_in z_diag_notgang_has_in z_emfehler_frk_dihi z_freigabe_pvu_has_sbe z_fuwdeakt_frk_dihi z_hybfkt_stg z_iep_in z_k0_fst_in z_k0_has_fkt z_k0_has_sbe z_k0syncmk0erh_frk_dihi z_kps_stada_in z_modus_em_hst_in z_modus_iae_has_sbe z_modus_iep_has_sbe z_msa_avh_moni_has_sbe z_msa_eaf_moni_has_sbe z_msa_fst_in z_msa_has_sbe z_msa_stada_in z_n_min_em_parksp_has_in z_n_min_iep_in z_nllsoll_iae_in z_nminemnull_frk_dihi z_nvmsollbegr_frk_dihi z_pvu_has_sbe z_sas_has_sbe z_start_modus_has_sbe z_status_psys_mps_sbe z_svh_has_sbe z_t_msollemaktiv_zus z_t_mstoerk0emfil_zus z_ziel_kraftfluss_egs_in zielgang_egs_in /end LOC_MEASUREMENT
/end FUNCTION
/begin FUNCTION SFOp_Zus76_Signale_input "" /begin SUB_FUNCTION SFOp_Zus97_Erk__art_mit_red_EMN /end SUB_FUNCTION
 /begin LOC_MEASUREMENT m_max_dyn_em_in m_wunsch_fpw_hst_in m_ziel_vm_has_zus z_ablaufvariante_has_stg /end LOC_MEASUREMENT
/end FUNCTION
/begin FUNCTION SFOp_Zus7_Output "" /begin SUB_FUNCTION SFOp_Zus100_Sc__gsbeeinflussung /end SUB_FUNCTION /end FUNCTION
/begin FUNCTION SFOp_Zus97_Erk__art_mit_red_EMN "" /begin DEF_CHARACTERISTIC Z_ABLAUFVARIANTE_KALTNEM_ZUS /end DEF_CHARACTERISTIC /begin LOC_MEASUREMENT z_ablaufvariante_has_stg /end LOC_MEASUREMENT /end FUNCTION
/begin FUNCTION SFOp_Zus9_St_Ablauf ""
 /begin SUB_FUNCTION SFOp_Zus132_st_uebergabe SFOp_Zus130_Zustart SFOp_Zus129_St_Schaltung_aktiv /end SUB_FUNCTION
/end FUNCTION
/begin FUNCTION SFSBo100_Bitwise_OR_ui16_6 "" /begin LOC_MEASUREMENT z_msa_fktaktiv_has /end LOC_MEASUREMENT /end FUNCTION
/begin FUNCTION SFSBo10_MSA ""
 /begin SUB_FUNCTION SFSBo166_Bitwise_AND_ui8_10 Run_SFSBo163_c___t_berg_msa_has Run_SFSBo156_c__uecksas_msa_has Run_SFSBo155_c__ckgesas_msa_has Run_SFSBo154_c___maxsas_msa_has SFSBo153_Bitwise_OR_ui8_ SFSBo148_Bitwise_AND_ui32_3 SFSBo147_Bitwise_AND_ui32_2 SFSBo146_Bitwise_AND_ui32_ SFSBo144_If_Action_Subsystem SFSBo140_Enabled_Subsystem SFSBo127_Bitwise_AND_ui8_ SFSBo53_Anzeig____e_AVH_und_EAF SFSBo100_Bitwise_OR_ui16_6 SFSBo76_Bitwise_AND_ui16_6 /end SUB_FUNCTION
 /begin DEF_CHARACTERISTIC BM_ZABSMSA_MSA_HAS BM_ZBERGMSA_MSA_HAS BM_ZDIAGERSFKT2_DIAG_MSA_HAS BM_ZDIAGERSFKTHI2_DIAG_MSA_HAS BM_ZDIAGMSA1_MSA_HAS BM_ZDIAGMSA2_MSA_HAS BM_ZFSTMSA_MSA_HAS BM_ZIAEMSAKRI_MSA_HAS BM_ZIAEMSASYN_MSA_HAS BM_ZKFLMSA_MSA_HAS BM_ZNDK0MSA_MSA_HAS BM_ZSASMSAGE_MSA_HAS BM_ZSTADAMSA_MSA_HAS BM_ZVGFMSA_MSA_HAS CS_GETR_CGETR_MSA_HAS MS_WUNSCHFPWTVSRSSAS_MSA_HAS NDS_K01_NDK0_MSA_HAS NDS_K02_NDK0_MSA_HAS NDS_K0_GE_NDK0_MSA_HAS NS_EM_NDK0_MSA_HAS NS_VM1_NDK0_MSA_HAS NS_VM2_NDK0_MSA_HAS PHIS_NEIGUNGD1_BERG_MSA_HAS PHIS_NEIGUNGD2_BERG_MSA_HAS PHIS_NEIGUNGR1_BERG_MSA_HAS PHIS_NEIGUNGR2_BERG_MSA_HAS SWI_TMAXSASAKTIV_MSA_HAS TAB_BMZFKTMSA_MSA_HAS TAB_BMZMSAAKTIV_MSA_HAS TAB_BMZSASMSAHS_MSA_HAS TAB_BMZSASMSARS_MSA_HAS TAB_STKRAFTFLUSS_NDK0_MSA_HAS TAB_TMAXSRSSAS_MSA_HAS TAB_TVRUECKSRSSAS_MSA_HAS T_VAUSD_BERG_MSA_HAS T_VAUSR_BERG_MSA_HAS T_VNEMBED_NDK0_MSA_HAS T_VRUECKGELSAS_MSA_HAS VGS_F1_VGF_MSA_HAS VGS_F2_VGF_MSA_HAS VGS_FBRE_ABS_MSA_HAS VGS_FKRI_IAE_MSA_HAS VS_F1_KFL_MSA_HAS VS_F2_KFL_MSA_HAS VS_FBRE_ABS_MSA_HAS VS_FD1_BERG_MSA_HAS VS_FD2_BERG_MSA_HAS VS_FKRI_IAE_MSA_HAS VS_FMAX_VGF_MSA_HAS VS_FMIN_VGF_MSA_HAS VS_FR1_BERG_MSA_HAS VS_FR2_BERG_MSA_HAS /end DEF_CHARACTERISTIC
 /begin LOC_MEASUREMENT c_getriebe_egs_in i_istgang_egs m_wunsch_fpw_hst_in n_ab_egs_in n_em_in n_vm_in nd_k0_in phi_neigung_in pos_egs_in st_ist_bz_has_stg st_ziel_bz_has_stg status_iae_in status_k0_in status_kraftfluss_egs_in status_schaltung_egs_in t_berg_msa_has t_maxsas_msa_has t_nembed_ndk0_msa_has t_vrueckgesas_msa_has t_vruecksas_msa_has v_f_sbe vg_f_sbe z_abs_msa_has z_berg_msa_has z_cgetr_msa_has z_diag_ersfkt_has_in z_diag_ersfkt_hi_has_in z_diag_msa_has z_fkt_msa_has z_fst_msa_has z_ge_ndk0_msa_has z_hybfkt_stg z_iae_msa_has z_kfl_msa_has z_msa_aktiv_has z_msa_avh_moni_has_sbe z_msa_eaf_moni_has_sbe z_msa_fktaktiv_has z_msa_fst_in z_msa_has_sbe z_msa_stada_in z_ndk0_msa_has z_nembed_ndk0_msa_has z_sas_msa_ge_has z_sas_msa_has z_sas_msa_rshs_has z_stada_msa_has z_vgf_msa_has zielgang_egs_in /end LOC_MEASUREMENT
/end FUNCTION
/begin FUNCTION SFSBo119_Bitwise_AND_ui8_4 "" /begin LOC_MEASUREMENT z_msa_has_sbe /end LOC_MEASUREMENT /end FUNCTION
/begin FUNCTION SFSBo122_Bitwise_AND_ui8_7 "" /begin LOC_MEASUREMENT DD_SFSBo53_z_ndk0_msa_Bit2 /end LOC_MEASUREMENT /end FUNCTION
/begin FUNCTION SFSBo123_Bitwise_AND_ui8_8 "" /begin LOC_MEASUREMENT z_msa_has_sbe /end LOC_MEASUREMENT /end FUNCTION
/begin FUNCTION SFSBo124_Bitwise_OR_ui8_ "" /begin LOC_MEASUREMENT z_msa_avh_moni_has_sbe /end LOC_MEASUREMENT /end FUNCTION
/begin FUNCTION SFSBo125_Shift_right_ui1 "" /begin LOC_MEASUREMENT z_msa_eaf_moni_has_sbe /end LOC_MEASUREMENT /end FUNCTION
/begin FUNCTION SFSBo127_Bitwise_AND_ui8_ "" /begin LOC_MEASUREMENT z_msa_has_sbe /end LOC_MEASUREMENT /end FUNCTION
/begin FUNCTION SFSBo13_Status_EFahren_BMI "" /begin DEF_CHARACTERISTIC TAB_STATUSEFAHREN_BMI_HAS TAB_ZSTATUSEFAHREN_BMI_MOD_HAS /end DEF_CHARACTERISTIC
 /begin LOC_MEASUREMENT st_ist_bz_has_stg st_ziel_bz_has_stg status_efahren_bmi_has status_efahren_bmi_ist status_efahren_bmi_ziel status_k0_in z_hybfkt_stg z_statusefahren_bmi_modus /end LOC_MEASUREMENT
/end FUNCTION
/begin FUNCTION SFSBo140_Enabled_Subsystem "" /begin SUB_FUNCTION Run_SFSBo141_cTimer_ /end SUB_FUNCTION /begin DEF_CHARACTERISTIC T_VBRE_ABS_MSA_HAS /end DEF_CHARACTERISTIC /begin LOC_MEASUREMENT t_abs_msa_has /end LOC_MEASUREMENT /end FUNCTION
/begin FUNCTION SFSBo144_If_Action_Subsystem "" /begin DEF_CHARACTERISTIC BM_ZCGETRMSA_MSA_HAS /end DEF_CHARACTERISTIC /end FUNCTION
/begin FUNCTION SFSBo146_Bitwise_AND_ui32_ "" /begin LOC_MEASUREMENT z_diag_ersfkt_has_in /end LOC_MEASUREMENT /end FUNCTION
/begin FUNCTION SFSBo147_Bitwise_AND_ui32_2 "" /begin DEF_CHARACTERISTIC BM_ZDIAGERSFKT2_DIAG_MSA_HAS /end DEF_CHARACTERISTIC /begin LOC_MEASUREMENT z_diag_ersfkt_has_in /end LOC_MEASUREMENT /end FUNCTION
/begin FUNCTION SFSBo148_Bitwise_AND_ui32_3 "" /begin DEF_CHARACTERISTIC BM_ZDIAGERSFKTHI2_DIAG_MSA_HAS /end DEF_CHARACTERISTIC /begin LOC_MEASUREMENT z_diag_ersfkt_hi_has_in /end LOC_MEASUREMENT /end FUNCTION
/begin FUNCTION SFSBo14_Status_EFahren_out ""
 /begin DEF_CHARACTERISTIC NS_EM_STATUSEFAHRENMOD2_HAS NS_EM_STATUSEFAHRENMOD3_HAS TAB_STATUSEFAHREN_OUT_HAS TAB_ZSTATUSEFAHREN_OUT_MOD_HAS /end DEF_CHARACTERISTIC
 /begin LOC_MEASUREMENT n_em_in st_ist_bz_has_stg st_ziel_bz_has_stg status_efahren_out_ist status_efahren_out_ziel status_k0_in z_hybfkt_stg z_statusefahren_out_modus /end LOC_MEASUREMENT
/end FUNCTION
/begin FUNCTION SFSBo153_Bitwise_OR_ui8_ "" /begin LOC_MEASUREMENT z_sas_msa_has /end LOC_MEASUREMENT /end FUNCTION
/begin FUNCTION SFSBo166_Bitwise_AND_ui8_10 "" /begin DEF_CHARACTERISTIC BM_ZSTADAMSA_MSA_HAS /end DEF_CHARACTERISTIC /begin LOC_MEASUREMENT z_msa_stada_in z_stada_msa_has /end LOC_MEASUREMENT /end FUNCTION
/begin FUNCTION SFSBo172_Lastaenderungszustand "" /begin SUB_FUNCTION SFSBo175_Ablauf_aktiv /end SUB_FUNCTION
 /begin DEF_CHARACTERISTIC KL_MOMAXDYNEM_LASTANH_SVH_HAS_X KL_MOMAXDYNEM_LASTANH_SVH_HAS_Y MGS_WUNSCHFPW_LASTANH_SVH_HAS SWI_MODUS_LASTANH_SVH_HAS /end DEF_CHARACTERISTIC
 /begin LOC_MEASUREMENT m_max_dyn_em_in m_wunsch_fpw_hst_in m_wunsch_fpw_in mg_wunsch_fpw mg_wunsch_fpw_hst ms_wunschfpw_lastanh_svh st_ist_bz_has_stg st_ziel_bz_has_stg status_lastanh_svh z_hybfkt_stg /end LOC_MEASUREMENT
/end FUNCTION
/begin FUNCTION SFSBo173_Lastzustand ""
 /begin DEF_CHARACTERISTIC MO_WUNSCHFPW_ZUG_SVH_HAS MS_WUNSCHFPW_ZUG_SVH_HAS PO_BREMSE_ZUG_SVH_HAS PS_BREMSE_ZUG_SVH_HAS /end DEF_CHARACTERISTIC
 /begin LOC_MEASUREMENT m_wunsch_fpw_in p_bremse_fzg_in status_zug_svh /end LOC_MEASUREMENT
/end FUNCTION
/begin FUNCTION SFSBo174_Schaltungsrichtung ""
 /begin LOC_MEASUREMENT istgang_egs_begr_svh istgang_egs_in sollgang_egs_in status_rs_anf_svh status_schaltanf_fst_svh /end LOC_MEASUREMENT
/end FUNCTION
/begin FUNCTION SFSBo175_Ablauf_aktiv "" /begin SUB_FUNCTION SFSBo178_Schleppstart SFSBo177_Andere_Startart /end SUB_FUNCTION
 /begin LOC_MEASUREMENT m_max_dyn_em_in m_wunsch_fpw_hst_in m_wunsch_fpw_in mg_wunsch_fpw z_hybfkt_stg /end LOC_MEASUREMENT
/end FUNCTION
/begin FUNCTION SFSBo177_Andere_Startart ""
 /begin DEF_CHARACTERISTIC MGO_WUNSCHFPW_LASTANH_SVH_HAS MGS_WUNSCHFPW_LASTANH_SVH_HAS /end DEF_CHARACTERISTIC
 /begin LOC_MEASUREMENT m_max_dyn_em_in m_wunsch_fpw_hst_in m_wunsch_fpw_in mg_wunsch_fpw z_hybfkt_stg /end LOC_MEASUREMENT
/end FUNCTION
/begin FUNCTION SFSBo178_Schleppstart "" /begin LOC_MEASUREMENT m_max_dyn_em_in m_wunsch_fpw_hst_in m_wunsch_fpw_in /end LOC_MEASUREMENT /end FUNCTION
/begin FUNCTION SFSBo17_n_min_EM_LL ""
 /begin SUB_FUNCTION Run_SFSBo223_cLimiter_Gradient_ Run_SFSBo220_cTimer_testablvar Run_SFSBo211_CL_PT1_1 Run_SFSBo210_CL_PT1_ /end SUB_FUNCTION
 /begin DEF_CHARACTERISTIC CS_GETR1_CGETR_LLS_HAS CS_GETR2_CGETR_LLS_HAS FK_NMINEMADAP_1_LLS_HAS FK_NMINEMADAP_2_LLS_HAS FK_NMINEM_1_LLS_HAS FK_NMINEM_2_LLS_HAS KF_ZNOMINEMGANG_LLS_HAS_W KF_ZNOMINEMGANG_LLS_HAS_X KF_ZNOMINEMGANG_LLS_HAS_Y KL_NMINEMCGETR_LLS_HAS_X KL_NMINEMCGETR_LLS_HAS_Y KL_NMINEMIAEADAP_LLS_HAS_X KL_NMINEMIAEADAP_LLS_HAS_Y KL_NMINEMK0ADAP_LLS_HAS_X KL_NMINEMK0ADAP_LLS_HAS_Y KL_NMINEMSTADA_LLS_HAS_X KL_NMINEMSTADA_LLS_HAS_Y K_NSOLLLLVM_LLS_HAS NG_MINEMMAXADAP_LLS_HAS NG_MINEMMAX_LLS_HAS NG_MINEMMIN_LLS_HAS NO_EMMINEMREF_LLS_HAS NO_EMNMINEMINIT_LLS_HAS N_MINEMBEFUELLFZP_LLS_HAS N_MINEMEFAHRENPVU_LLS_HAS N_MINEMIAE_LLS_HAS N_MINEMKFL_LLS_HAS N_MINEMPARKSP_LLS_HAS N_MINEMSTALAENGSADAOFF_LLS_HAS N_MINEMVMSTARTENPVU_LLS_HAS STATUS_K0ADAP_LLS_HAS T_NMINEMBEFUELLFZP_LLS_HAS VS_FKFL_LLS_HAS /end DEF_CHARACTERISTIC
 /begin LOC_MEASUREMENT c_getriebe_egs_in istgang_egs_in n_em_in n_min_em_befuellfzp_lls_has n_min_em_cgetr_lls_has n_min_em_iae_lls_has n_min_em_k0adap_lls_has n_min_em_kfl_lls_has n_min_em_lls_has_mod n_min_em_lls_has_ngbegr n_min_em_lls_has_ngef n_min_em_lls_has_ref n_min_em_pvu_lls_has n_min_psys_em_has_sbe n_mineminit_lls_has n_soll_ll_vm_in st_ist_bz_has_stg st_ziel_bz_has_stg status_alaengs_adaoff_in status_betriebsbereit_hst_in status_iae_in status_k0_adap_in status_kraftfluss_egs_in status_waschstr_in v_f_sbe z_adaparameter_lls_has z_n_min_em_parksp_has_in z_nllsoll_iae_in z_nmineminit_lls_has z_nminemnull_frk_dihi z_pvu_has_sbe z_tnminembefuellfzp_lls_has zielgang_egs_in /end LOC_MEASUREMENT
/end FUNCTION
/begin FUNCTION SFSBo185_Bitwise_AND_ui8_ "" /begin LOC_MEASUREMENT z_ablauf_svh_reset_has_fkt /end LOC_MEASUREMENT /end FUNCTION
/begin FUNCTION SFSBo188_Variante_Audi ""
 /begin LOC_MEASUREMENT abstellpos_vm_in abstellpos_vm_status_in c_vm_in m_soll_res_em_has_fkt st_ist_bz_has_stg st_ziel_bz_has_stg status_ablauf_has_fkt /end LOC_MEASUREMENT
/end FUNCTION
/begin FUNCTION SFSBo189_Variante_BMW "" /begin SUB_FUNCTION SFSBo196_If_Action_Subsystem /end SUB_FUNCTION
 /begin DEF_CHARACTERISTIC KF_MEMRESVMSTART_HAS_W KF_MEMRESVMSTART_HAS_X KF_MEMRESVMSTART_HAS_Y SWI_MEMRESVMSTART_BAS_HAS /end DEF_CHARACTERISTIC
 /begin LOC_MEASUREMENT m_vm_start_in st_ist_bz_has_stg status_ablauf_has_fkt z_ablaufvariante_has_hst_in /end LOC_MEASUREMENT
/end FUNCTION
/begin FUNCTION SFSBo196_If_Action_Subsystem "" /begin SUB_FUNCTION Run_SFSBo200_cLimiter_Gradient_ /end SUB_FUNCTION /begin DEF_CHARACTERISTIC MG_EMRESVMSTART_HAS STATUS_ABLAUFMEMRESRUECK_HAS /end DEF_CHARACTERISTIC /begin LOC_MEASUREMENT status_ablauf_has_fkt /end LOC_MEASUREMENT /end FUNCTION
/begin FUNCTION SFSBo32_Timer ""
 /begin SUB_FUNCTION Run_SFSBo34_cT___zsashasmax_bbr Run_SFSBo33_cT__sashasaktiv_bbr /end SUB_FUNCTION
 /begin DEF_CHARACTERISTIC KL_TZSASHASMAX_BBR_HAS_X KL_TZSASHASMAX_BBR_HAS_Y T_ZSASHASAKTIV_BBR_HAS /end DEF_CHARACTERISTIC
 /begin LOC_MEASUREMENT c_getriebe_egs_in t_zsashasaktiv_bbr t_zsashasmax_bbr /end LOC_MEASUREMENT
/end FUNCTION
/begin FUNCTION SFSBo47_Subsystem "" /begin DEF_CHARACTERISTIC TAB_ZDIAGNOTGANG_BMI_HAS /end DEF_CHARACTERISTIC /begin LOC_MEASUREMENT z_diag_notgang_has_in /end LOC_MEASUREMENT /end FUNCTION
/begin FUNCTION SFSBo4_Anlasse__art_Anforderung ""
 /begin DEF_CHARACTERISTIC CS_GETR_ALA_HAS KF_NS_NEM_ALA_HAS_W KF_NS_NEM_ALA_HAS_X KF_NS_NEM_ALA_HAS_Y KF_ZIELGANGISTGANG_ALA_HAS_W KF_ZIELGANGISTGANG_ALA_HAS_X KF_ZIELGANGISTGANG_ALA_HAS_Y KL_MS_MMOTNEG_ALA_HAS_X KL_MS_MMOTNEG_ALA_HAS_Y KL_MS_MMOTPOS_ALA_HAS_X KL_MS_MMOTPOS_ALA_HAS_Y MS_MMOTHYS_ALA_HAS PS_BREMSEMOT_ALA_HAS SWI_ABFRAGEMMOT_ALA_HAS SWI_ABFRAGESTIAE_ALA_HAS /end DEF_CHARACTERISTIC
 /begin LOC_MEASUREMENT abstellpos_vm_status_in c_getriebe_egs_in istgang_egs_in m_mot_in n_em_in p_bremse_fzg_in pos_egs_in st_ist_bz_has_stg status_iae_in zielgang_egs_in /end LOC_MEASUREMENT
/end FUNCTION
/begin FUNCTION SFSBo53_Anzeig____e_AVH_und_EAF ""
 /begin SUB_FUNCTION SFSBo125_Shift_right_ui1 SFSBo124_Bitwise_OR_ui8_ SFSBo123_Bitwise_AND_ui8_8 SFSBo122_Bitwise_AND_ui8_7 SFSBo119_Bitwise_AND_ui8_4 /end SUB_FUNCTION
 /begin LOC_MEASUREMENT DD_SFSBo53_z_ndk0_msa_Bit2 z_msa_avh_moni_has_sbe z_msa_eaf_moni_has_sbe z_msa_has_sbe /end LOC_MEASUREMENT
/end FUNCTION
/begin FUNCTION SFSBo5_BeeinflussungIEP ""
 /begin SUB_FUNCTION Run_SFSBo25_cT___zsashasmax_bbr Run_SFSBo24_cT__sashasaktiv_bbr /end SUB_FUNCTION
 /begin DEF_CHARACTERISTIC KL_ZVMSTARTABLVAR_SST_BFI_HAS_X KL_ZVMSTARTABLVAR_SST_BFI_HAS_Y KL_ZVMSTARTVOREIL_SST_BFI_HAS_X KL_ZVMSTARTVOREIL_SST_BFI_HAS_Y NS_VMSTART_BFI_HAS SWI_BFIFUWAKTIV_HAS SWI_BFIPVU_BFI_HAS SWI_ZABLVAR_SST_BFI_HAS SWI_ZMODUSIEP_SST_BFI_HAS T_ZIEPHASAKTIV_BFI_HAS T_ZIEPHASMAX_BFI_HAS /end DEF_CHARACTERISTIC
 /begin LOC_MEASUREMENT SFSBo24_isActive_ SFSBo25_isActive_ n_vm_in st_ist_bz_has_stg st_ziel_bz_has_stg status_betriebsbereit_hst_in status_waschstr_in t_ziephasaktiv_bfi t_ziephasmax_bfi z_ablaufvariante_has_hst_in z_ablaufvariante_has_stg z_emaktiv_fuw_zus_fkt z_modus_iep_has_fuw z_modus_iep_has_pvu z_modus_iep_has_sst z_pvu_has_sbe z_vmstart_bfi z_vmstartvoreil_bfi /end LOC_MEASUREMENT
/end FUNCTION
/begin FUNCTION SFSBo6_Beeinfl__uellreihenfolge "" /begin SUB_FUNCTION SFSBo32_Timer /end SUB_FUNCTION
 /begin DEF_CHARACTERISTIC CS_GETRIEBE_BBR_HAS KL_ABLVARZSASAKTIV_BBR_HAS_X KL_ABLVARZSASAKTIV_BBR_HAS_Y STATUS_K0_BBR_HAS SWI_BBR_AUS_BZ2_HAS /end DEF_CHARACTERISTIC
 /begin LOC_MEASUREMENT SFSBo33_isActive_ SFSBo34_isActive_ c_getriebe_egs_in st_ist_bz_has_stg st_ziel_bz_has_stg status_betriebsbereit_hst_in status_k0_in z_ablaufvariante_has_stg z_k0ansteuerung_bbr /end LOC_MEASUREMENT
/end FUNCTION
/begin FUNCTION SFSBo76_Bitwise_AND_ui16_6 "" /begin LOC_MEASUREMENT z_msa_fktaktiv_has /end LOC_MEASUREMENT /end FUNCTION
/begin FUNCTION SFSBo7_Bestimm__omentbegrenzung ""
 /begin SUB_FUNCTION Run_SFSBo40_cL___mber_zus_gbegr Run_SFSBo39_CL__k0_mber_has_sbe /end SUB_FUNCTION
 /begin DEF_CHARACTERISTIC FK_MK0MBERZUS_HAS KF_MK0MBERZUSBASIS_HAS_W KF_MK0MBERZUSBASIS_HAS_X KF_MK0MBERZUSBASIS_HAS_Y MG_K0MBERZUSNEG_HAS MG_K0MBERZUSPOS_HAS M_K0MBERMAX_HAS ST_ABLAUFMK0MBERZUS_HAS SWI_MK0REF_MK0MBER_HAS /end DEF_CHARACTERISTIC
 /begin LOC_MEASUREMENT m_k0_in m_k0_mber_zus_basis m_k0_mber_zus_gbegr m_k0_mod_has_fkt m_soll_k0_has_fkt nd_k0_in st_ablauf_fkt status_ablauf_has_fkt status_k0_in z_hybfkt_stg /end LOC_MEASUREMENT
/end FUNCTION
/begin FUNCTION SFSBo8_Betriebsmodus_IAE_BMI "" /begin SUB_FUNCTION SFSBo47_Subsystem /end SUB_FUNCTION
 /begin DEF_CHARACTERISTIC NO_SOLLLLVM_BMI_HAS NS_MINEMZIEP_BMI_HAS STATUS_IAEADAP_BMI_HAS STATUS_K0ADAP_BMI_HAS SWI_BMI_EFAHREN_KRAFTSCHLUSS /end DEF_CHARACTERISTIC
 /begin LOC_MEASUREMENT n_em_in n_soll_ll_vm_in st_ist_bz_has_stg st_ziel_bz_has_stg status_fehler_iep_in status_iae_adap_in status_k0_adap_in z_diag_notgang_has_in z_diagnotgang_bmi_has z_iep_in /end LOC_MEASUREMENT
/end FUNCTION
/begin FUNCTION SFSTA10_Bitwise_AND_ui32_2 "" /begin DEF_CHARACTERISTIC BM_ERSFKT_ZUST_INIT_HAS /end DEF_CHARACTERISTIC /begin LOC_MEASUREMENT z_diag_ersfkt_has_in /end LOC_MEASUREMENT /end FUNCTION
/begin FUNCTION SFSTA11_Bitwise_AND_ui32_3 "" /begin DEF_CHARACTERISTIC BM_ERSFKT_HI_ZUST_INIT_HAS /end DEF_CHARACTERISTIC /begin LOC_MEASUREMENT z_diag_ersfkt_hi_has_in /end LOC_MEASUREMENT /end FUNCTION
/begin FUNCTION SFSTA3_FSTAPS_ProjektSpezifisch ""
 /begin LOC_MEASUREMENT abstellpos_vm_in abstellpos_vm_status_in c_getriebe_egs_in c_getriebe_egs_portin c_iep_portin c_vm_in gangwechsel_egs_in gangwechsel_egs_portin i_istgang_egs i_zielgang_egs istgang_egs_in istgang_egs_portin m_em_in m_em_portin m_iae_in m_iae_portin m_k0_fkt m_k0_in m_k0_mod_has_fkt m_k0_portin m_max_dyn_em_in m_max_dyn_em_portin m_max_em_has_fkt m_max_iae_has_fkt m_min_dyn_em_in m_min_dyn_em_portin m_min_em_has_fkt m_min_vm_in m_mot_in m_mot_portin m_soll_em_has_fkt m_soll_em_hst_in m_soll_em_hst_portin m_soll_k0_has_fkt m_soll_res_em_has_fkt m_soll_vm_has_fkt m_soll_vm_hst_in m_soll_vm_hst_portin m_soll_vm_l_has_fkt m_soll_vm_l_hst_in m_vm_in m_vm_portin m_vm_start_in m_vm_start_portin m_wunsch_fpw_hst_fil m_wunsch_fpw_hst_in m_wunsch_fpw_in m_wunsch_fpw_portin mg_max_em_has_fkt mg_min_em_has_fkt mg_soll_K0_fkt mg_soll_k0_has_fkt mg_wunsch_fpw mg_wunsch_fpw_hst mod_K0_fkt n_ab_egs_in n_ab_egs_portin n_em_in n_em_portin n_min_psys_em_has_sbe n_mot_soll_iae_in n_mot_soll_iae_portin n_sec_iae n_soll_em_has_fkt n_soll_em_hst_in n_soll_ll_vm_in n_soll_ll_vm_portin n_soll_vm_has_fkt n_t_egs_in n_t_egs_portin n_vm_in n_vm_portin nd_iae nd_k0_in nd_soll_iae_fkt ndg_k0_in ng_vm osmode_next_in osmode_next_portin p_bremse_fzg_in p_bremse_fzg_portin phi_neigung_in phi_neigung_portin pos_egs_in pos_egs_portin posv_timer_portin posvueb_aktiv_portin sollgang_egs_in sollgang_egs_portin st_OMLID_act_stg st_ablauf_fkt st_ist_bz_has_stg st_soll_bz_has_hst st_ziel_bz_has_stg status_ablauf_has_fkt status_alaengs_adaoff_in status_alaengs_adaoff_portin status_betriebsbereit_hst_in status_ee_busy_portin status_fehler15_eh_diagin status_fehler_iep_in status_fehler_iep_portin status_iae_adap_in status_iae_adap_portin status_iae_in status_iae_portin status_iep_in status_iep_portin status_k0_adap_in status_k0_adap_portin status_k0_in status_k0_portin status_kl15_in status_kolbenpos_k0_in status_kolbenpos_k0_portin status_kraftfluss_egs_in status_kraftfluss_egs_roh_in status_kraftschl_atsys_portin status_ll_vm_in status_nem_in status_nem_portin status_nreg_em_hst_in status_nvm_in status_nvm_portin status_phineigung_portin status_posvueb_in status_psys_has_sbe status_sa_vm_in status_schaltung_egs_in status_sync_schaltung_sbe status_waschstr_in status_waschstr_portin t_betrieb_pvu_has_ee_in t_betrieb_pvu_has_ee_portin t_betrieb_pvu_has_sbe timer_pumpready_aktiv_fkt v_f_sbe vg_f_sbe z_ablauf_has_hst_in z_ablauf_has_hst_portin z_ablauf_has_stg z_ablauf_svh_reset_has_fkt z_ablaufreinit_frk_dihi z_ablaufvariante_has_hst_in z_ablaufvariante_has_hst_portin z_ablaufvariante_has_stg z_ablaufvariante_kalt_zus z_ba_has_k0_hst_in z_ba_has_vm_hst_in z_diag_ersfkt_has_in z_diag_ersfkt_has_portin z_diag_ersfkt_hi_has_in z_diag_ersfkt_hi_has_portin z_diag_notgang_has_in z_diag_notgang_has_portin z_emaktiv_fuw_zus_fkt z_emfehler_frk_dihi z_fehler15_eh_fkt z_freigabe_pvu_has_sbe z_fuwdeakt_frk_dihi z_hybfkt_stg z_iep_in z_iep_portin z_init_fkt z_k0_befuellopt_has_fkt z_k0_fst_in z_k0_fst_portin z_k0_has_fkt z_k0syncmk0erh_frk_dihi z_kps_stada_in z_kps_stada_portin z_m_begr_em_has_fkt z_m_max_iae_has_fkt z_m_soll_em_has_fkt z_m_soll_vm_has_fkt z_modus_em_hst_in z_modus_iae_has_fkt z_msa_fst_in z_msa_fst_portin z_msa_stada_in z_n_min_em_parksp_has_in z_n_min_em_parksp_has_portin z_n_min_iep_in z_n_min_iep_portin z_n_soll_em_has_fkt z_n_soll_vm_has_fkt z_nllsoll_iae_in z_nllsoll_iae_portin z_nminemnull_frk_dihi z_nvmsollbegr_frk_dihi z_p_hys_k0_has_fkt z_ponr_fkt z_pvu_has_sbe z_saf_has_fkt z_sbe_has_fkt z_standby_em_has_fkt z_status_psys_mps_sbe z_timer_pumpready_fkt z_tmin_fehler15_fkt z_ziel_kraftfluss_egs_in z_zuendfreigabe_vm_fkt z_zuendfreigabe_vm_has_fkt zielgang_egs_in zielgang_egs_portin /end LOC_MEASUREMENT
/end FUNCTION
/begin FUNCTION SFSTA8_Bitwise_AND_ui32_ "" /begin DEF_CHARACTERISTIC BM_ERSFKT_ZUST_HALTEN_HAS /end DEF_CHARACTERISTIC /begin LOC_MEASUREMENT z_diag_ersfkt_has_in /end LOC_MEASUREMENT /end FUNCTION
/begin FUNCTION SFSTA9_Bitwise_AND_ui32_1 "" /begin DEF_CHARACTERISTIC BM_ERSFKT_HI_ZUST_HALTEN_HAS /end DEF_CHARACTERISTIC /begin LOC_MEASUREMENT z_diag_ersfkt_hi_has_in /end LOC_MEASUREMENT /end FUNCTION
/begin FUNCTION SIG_KOORDINATOR "In SIG_KOORDINATOR sind die Schnittstellenumrechungsfunktionen enthalten"
 /begin IN_MEASUREMENT defaultgang drehz_anhebung_has f_min_emdrehzahl_iae hochtemp_betrieb_sps iItfInput.abs_reg iItfInput.abs_reg_status iItfInput.ags_zka_index iItfInput.anhaenger_aktiv iItfInput.asc_passiv iItfInput.asc_regelt iItfInput.atsys_ee_busy iItfInput.autohold_aktiv iItfInput.ax_ref iItfInput.ax_ref_status iItfInput.azg_aktiv_stada iItfInput.bls_defakt iItfInput.bls_defpas iItfInput.bls_status iItfInput.bs_timer iItfInput.c_chip iItfInput.c_getr iItfInput.c_getr_fl32 iItfInput.c_getr_status iItfInput.c_getrabst iItfInput.c_mot iItfInput.codierung_nic iItfInput.dk_pedal iItfInput.dki iItfInput.dki_fl32 iItfInput.dki_mmotsoll iItfInput.dkig iItfInput.druck_vorhanden_mod iItfInput.edsmv_ersatzinfo iItfInput.eng_red_limit iItfInput.ersf_k0auf iItfInput.f_iep_shutdown iItfInput.f_minimaldruck_ausgabe iItfInput.fahr_bereit iItfInput.fahrbetrieb iItfInput.feststellbremse_aktiv iItfInput.fet0_active iItfInput.fl_brake_inter iItfInput.fl_brake_inter_status iItfInput.fl_schubabschaltung_aktiv iItfInput.flag_m_max_has_iae iItfInput.flag_p_hys_k0_has iItfInput.flag_partfilt_aktiv iItfInput.freigabe_posvdiag iItfInput.fzg_anfahrassistent_aktiv iItfInput.fzg_geschwindigkeit iItfInput.fzg_rollverh_aktiv_stat iItfInput.getr_betriebszeit iItfInput.hdc iItfInput.hillhold_aktiv iItfInput.hyd_notlauf iItfInput.i_min_ausser_parksperre iItfInput.iae_req_subst iItfInput.iep_soll_has iItfInput.iep_soll_sab iItfInput.iep_soll_tes iItfInput.index_sp_sps iItfInput.init_n_abneu_gef iItfInput.init_n_t iItfInput.iv_abs_reg iItfInput.iv_abs_reg_status iItfInput.iv_ags_zka_index iItfInput.iv_anhaengeraktiv iItfInput.iv_ascpas iItfInput.iv_ascreg iItfInput.iv_atsys_ee_busy iItfInput.iv_ax_ref iItfInput.iv_ax_ref_status iItfInput.iv_blsdefakt iItfInput.iv_blsdefpas iItfInput.iv_blsstatus iItfInput.iv_bstimer iItfInput.iv_cchip iItfInput.iv_cgetr iItfInput.iv_cgetrstatus iItfInput.iv_cmot iItfInput.iv_codierungnic iItfInput.iv_dki iItfInput.iv_dkpedal iItfInput.iv_druck_vorhanden_mod iItfInput.iv_edsmversatzinfo iItfInput.iv_eng_red_limit iItfInput.iv_f_iep_shutdown iItfInput.iv_fahr_bereit iItfInput.iv_fahrbet_task iItfInput.iv_feststellbremseaktiv iItfInput.iv_fet0_active iItfInput.iv_fl_brake_inter iItfInput.iv_fl_brake_inter_status iItfInput.iv_fl_schubabschaltung_aktiv iItfInput.iv_flag_m_max_has_iae iItfInput.iv_flag_p_hys_k0_has iItfInput.iv_flag_partfilt_aktiv iItfInput.iv_freigabe_posvdiag iItfInput.iv_fzg_anfahrassistent_aktiv iItfInput.iv_fzg_rollverh_aktiv_stat iItfInput.iv_fzggeschwindigkeit iItfInput.iv_getrbetriebszeit iItfInput.iv_gnotinfo iItfInput.iv_gsoll iItfInput.iv_hdc iItfInput.iv_iae_req_subst iItfInput.iv_iep_soll_has iItfInput.iv_iep_soll_sab iItfInput.iv_iep_soll_tes iItfInput.iv_indexspsps iItfInput.iv_k0_soll iItfInput.iv_ll_mot_aktiv iItfInput.iv_ll_mot_aktiv_status iItfInput.iv_m_emist iItfInput.iv_m_emsoll iItfInput.iv_m_max_dyn_em iItfInput.iv_m_max_has_iae iItfInput.iv_m_min_dyn_em iItfInput.iv_m_motsoll_mod iItfInput.iv_m_motsoll_mod_status iItfInput.iv_m_soll_k0_has iItfInput.iv_m_vmist iItfInput.iv_m_vmsoll iItfInput.iv_mg_soll_k0_neg_has iItfInput.iv_mg_soll_k0_pos_has iItfInput.iv_mmot iItfInput.iv_mmotist iItfInput.iv_mmotsoll_in iItfInput.iv_mmotstatus iItfInput.iv_mvg_vm_start iItfInput.iv_n6 iItfInput.iv_n_ab_dir iItfInput.iv_n_ab_dir_status iItfInput.iv_n_dif_iae_virt iItfInput.iv_n_mot_llsoll_has iItfInput.iv_n_t_dir iItfInput.iv_n_t_dir_status iItfInput.iv_n_vm iItfInput.iv_n_vm_status iItfInput.iv_nabneu iItfInput.iv_nabstatus iItfInput.iv_ndiaeneu iItfInput.iv_neigung iItfInput.iv_neigungstatus iItfInput.iv_nmot iItfInput.iv_nmotabregel iItfInput.iv_nmotsolleer iItfInput.iv_nmotstatus iItfInput.iv_notltask iItfInput.iv_ntneu iItfInput.iv_ntstatus iItfInput.iv_ntu_virt iItfInput.iv_ntu_virt_dir iItfInput.iv_ntu_virt_dir_status iItfInput.iv_p_air iItfInput.iv_p_bremse_halbe iItfInput.iv_pbremse iItfInput.iv_pos iItfInput.iv_posstatus iItfInput.iv_preadaption_start iItfInput.iv_progauswahl iItfInput.iv_pssensorsignal iItfInput.iv_pt_damping_active iItfInput.iv_rad_geschw_hinten_links iItfInput.iv_rad_geschw_hinten_rechts iItfInput.iv_rad_geschw_vorne_links iItfInput.iv_rad_geschw_vorne_rechts iItfInput.iv_saf_has_aktiv iItfInput.iv_sbytask iItfInput.iv_schluesselstart_aktiv iItfInput.iv_statistics_ee_busy iItfInput.iv_status_has iItfInput.iv_status_n_haltephase iItfInput.iv_svh_aktiv_has iItfInput.iv_timeegsoff iItfInput.iv_timeegsoff_status iItfInput.iv_udrmv iItfInput.iv_verbot_sas_fkt iItfInput.iv_z_k0_befuellopt iItfInput.iv_z_k0_soll_subst iItfInput.iv_z_modus_iae iItfInput.iv_zzuendung iItfInput.k0_diag_moeglich iItfInput.k0_soll iItfInput.ll_mot_aktiv iItfInput.ll_mot_aktiv_status iItfInput.m_emist iItfInput.m_emsoll iItfInput.m_max_dyn_em iItfInput.m_max_has_iae iItfInput.m_min_dyn_em iItfInput.m_mot iItfInput.m_mot_faktor10 iItfInput.m_mot_fl32 iItfInput.m_mot_status iItfInput.m_motist iItfInput.m_motist_faktor10 iItfInput.m_motkor iItfInput.m_motkor_in iItfInput.m_motsoll iItfInput.m_motsoll_faktor10 iItfInput.m_motsoll_in iItfInput.m_motsoll_mod iItfInput.m_motsoll_mod_status iItfInput.m_soll_k0_has iItfInput.m_t iItfInput.m_t8 iItfInput.m_vmist iItfInput.m_vmsoll iItfInput.manuell iItfInput.max_p_haupt iItfInput.mg_soll_k0_neg_has iItfInput.mg_soll_k0_pos_has iItfInput.mvg_vm_start iItfInput.n6 iItfInput.n_ab iItfInput.n_ab8 iItfInput.n_ab_dir iItfInput.n_ab_dir_status iItfInput.n_ab_status iItfInput.n_abneu iItfInput.n_abneu_int16 iItfInput.n_dif_iae_virt iItfInput.n_mot iItfInput.n_mot8 iItfInput.n_mot_int16 iItfInput.n_mot_llsoll_has iItfInput.n_mot_solleer iItfInput.n_mot_status iItfInput.n_motabregel iItfInput.n_t iItfInput.n_t8 iItfInput.n_t_dir iItfInput.n_t_dir_status iItfInput.n_t_status iItfInput.n_tneu iItfInput.n_tneu_int16 iItfInput.n_vm iItfInput.n_vm_status iItfInput.nd_iaeneu iItfInput.neigung iItfInput.neigung_gef iItfInput.neigung_status iItfInput.ng_ab iItfInput.ng_mot iItfInput.ng_t iItfInput.notgang iItfInput.notgang_info iItfInput.notlauf iItfInput.ntu_virt iItfInput.ntu_virt_dir iItfInput.ntu_virt_dir_status iItfInput.nue iItfInput.nueg iItfInput.nullbestromung_aktiv iItfInput.p_air iItfInput.p_bremse iItfInput.p_bremse_halbe iItfInput.pak_aktiv iItfInput.pos iItfInput.pos_status iItfInput.pos_wunsch iItfInput.preadaption_start iItfInput.prog_auswahl iItfInput.ps_sensor_signal iItfInput.pt_damping_active iItfInput.pumpendruck_nicht_vorhanden iItfInput.pumpendruck_vorhanden iItfInput.rad_geschw_hinten_links iItfInput.rad_geschw_hinten_rechts iItfInput.rad_geschw_vorne_links iItfInput.rad_geschw_vorne_rechts iItfInput.saf_has_aktiv iItfInput.schluesselstart_aktiv iItfInput.sfkt_starten_azg iItfInput.sollgang iItfInput.standby iItfInput.statistics_ee_busy iItfInput.status_has iItfInput.status_n_haltephase iItfInput.stromlos_ausser_ps iItfInput.stromlos_ges iItfInput.stromlos_ps iItfInput.svh_aktiv_has iItfInput.timeegsoff iItfInput.timeegsoff_status iItfInput.u_drmv iItfInput.verbot_sas_fkt iItfInput.z_k0_befuellopt iItfInput.z_k0_soll_subst iItfInput.z_modus_iae iItfInput.z_zuendung iItfInput.zug_schub iItfInputParaumsch.f_e_fahren_aktiv iItfInputParaumsch.iv_f_e_fahren_aktiv iItfInputParaumsch.iv_seraprsas iItfInputParaumsch.iv_seraprsas_komp iItfInputParaumsch.serap_rsas iItfInputParaumsch.serap_rsas_komp i_eds0 i_eds0_komp i_eds1 i_eds10 i_eds10_komp i_eds11 i_eds11_komp i_eds1_komp i_eds2 i_eds2_komp i_eds3 i_eds3_komp i_eds4 i_eds4_komp i_eds5 i_eds5_komp i_eds6 i_eds6_komp i_eds7 i_eds7_komp i_eds8 i_eds8_komp i_eds9 i_eds9_komp i_eds_k0 i_eds_kupa i_eds_kupb i_eds_kupc i_eds_kupd i_eds_kupe i_eds_psys kraftschluss m_hotmodemax m_motmax max_kuehlung_anfordern me_komp me_red_abs me_red_status me_status_komp mv_1 mv_2 mv_3 reihenschaltung_moeglich sbc_info sollgang_pruefung z_n_mot_llsoll_iae /end IN_MEASUREMENT
/end FUNCTION
/begin FUNCTION SSAi2_SAiEEP_EEProm ""
 /begin LOC_MEASUREMENT c_getriebe_egs_portin c_iep_portin gangwechsel_egs_portin istgang_egs_portin m_em_portin m_iae_portin m_k0_portin m_max_dyn_em_portin m_min_dyn_em_portin m_mot_portin m_soll_em_hst_portin m_soll_vm_hst_portin m_vm_portin m_vm_start_portin m_wunsch_fpw_portin n_ab_egs_portin n_em_portin n_mot_soll_iae_portin n_soll_ll_vm_portin n_t_egs_portin n_vm_portin osmode_next_portin p_bremse_fzg_portin phi_neigung_portin pos_egs_portin posv_timer_portin posvueb_aktiv_portin sollgang_egs_portin status_alaengs_adaoff_portin status_ee_busy_portin status_fehler_iep_portin status_iae_adap_portin status_iae_portin status_iep_portin status_k0_adap_portin status_k0_portin status_kolbenpos_k0_portin status_kraftschl_atsys_portin status_nem_portin status_nvm_portin status_phineigung_portin status_waschstr_portin t_betrieb_pvu_has_ee_portin z_ablauf_has_hst_portin z_ablaufvariante_has_hst_portin z_diag_ersfkt_has_portin z_diag_ersfkt_hi_has_portin z_diag_notgang_has_portin z_iep_portin z_k0_fst_portin z_kps_stada_portin z_msa_fst_portin z_n_min_em_parksp_has_portin z_n_min_iep_portin z_nllsoll_iae_portin zielgang_egs_portin /end LOC_MEASUREMENT
/end FUNCTION
/begin FUNCTION SSAi3_SAiPA_ProjektAllgemein ""
 /begin DEF_CHARACTERISTIC C_GETRIEBEEGS_ERSATZ_HAS C_GETRIEBE_OFFSET GANGWECHSEL_EGS_ERSATZ_HAS ISTGANG_EGS_ERSATZ_HAS KL_ABLAUFVARIANTE_HAS_HST_IN_X KL_ABLAUFVARIANTE_HAS_HST_IN_Y KOLBENPOS_FAKTOR M_EM_ERSATZ_HAS M_IAE_ERSATZ_HAS M_K0_ERSATZ_HAS M_MAXDYNEM_ERSATZ_HAS M_MINDYNEM_ERSATZ_HAS M_MOT_ERSATZ_HAS M_SOLLEMHST_ERSATZ_HAS M_SOLLVMHST_ERSATZ_HAS M_VMSTART_ERSATZ_HAS M_VM_ERSATZ_HAS M_WUNSCHFPW_ERSATZ_HAS N_ABEGS_ERSATZ_HAS N_EM_ERSATZ_HAS N_MOT_SOLL_IAE_ERSATZ_HAS N_SOLLLLVM_ERSATZ_HAS N_TEGS_ERSATZ_HAS N_VM_ERSATZ_HAS OSMODE_NEXT_ERSATZ_HAS PHI_NEIGUNG_ERSATZ_HAS POS_EGS_ERSATZ_HAS P_BREMSEFZG_ERSATZ_HAS SOLLGANG_EGS_ERSATZ_HAS STATUS_ALAENGS_ADAO_ERS_HAS STATUS_FEHLER_IEP_ERSATZ_HAS STATUS_IAE_ADAP_ERSATZ_HAS STATUS_IAE_ERSATZ_HAS STATUS_IEP_ERSATZ_HAS STATUS_K0_ADAP_ERSATZ_HAS STATUS_K0_ERSATZ_HAS STATUS_KOLBENPOS_K0_ERS_HAS STATUS_KRAFTFLUSS_ERS_HAS STATUS_LLVM_ERSATZ_HAS STATUS_NEM_ERSATZ_HAS STATUS_NVM_ERSATZ_HAS STATUS_POSVUEB_ERSATZ_HAS STATUS_WASCHSTR_ERSATZ_HAS SWI_C_GETRIEBEEGS_ERSATZ_HAS SWI_GANGWECHSEL_EGS_ERSATZ_HAS SWI_ISTGANG_EGS_ERSATZ_HAS SWI_M_EM_ERSATZ_HAS SWI_M_IAE_ERSATZ_HAS SWI_M_K0_ERSATZ_HAS SWI_M_MAXDYNEM_ERSATZ_HAS SWI_M_MINDYNEM_ERSATZ_HAS SWI_M_MOT_ERSATZ_HAS SWI_M_SOLLEMHST_ERSATZ_HAS SWI_M_SOLLVMHST_ERSATZ_HAS SWI_M_VMSTART_ERSATZ_HAS SWI_M_VM_ERSATZ_HAS SWI_M_WUNSCHFPW_ERSATZ_HAS SWI_NEM_FEHLERWERTNULL_HAS SWI_N_ABEGS_ERSATZ_HAS SWI_N_EM_ERSATZ_HAS SWI_N_MOT_SOLL_IAE_ERSATZ_HAS SWI_N_SOLLLLVM_ERSATZ_HAS SWI_N_TEGS_ERSATZ_HAS SWI_N_VM_ERSATZ_HAS SWI_OSMODE_NEXT_ERSATZ_HAS SWI_PHI_NEIGUNG_ERSATZ_HAS SWI_POS_EGS_ERSATZ_HAS SWI_P_BREMSEFZG_ERSATZ_HAS SWI_SOLLGANG_EGS_ERSATZ_HAS SWI_STATUS_ALAENGS_ADAO_ERS_HAS SWI_STATUS_FEHLER_IEP_ERS_HAS SWI_STATUS_IAE_ADAP_ERSATZ_HAS SWI_STATUS_IAE_ERSATZ_HAS SWI_STATUS_IEP_ERSATZ_HAS SWI_STATUS_K0_ADAP_ERSATZ_HAS SWI_STATUS_K0_ERSATZ_HAS SWI_STATUS_KOLBENPOS_K0_ERS_HAS SWI_STATUS_KRAFTFLUSS_ERS_HAS SWI_STATUS_NEM_ERSATZ_HAS SWI_STATUS_NVM_ERSATZ_HAS SWI_STATUS_POSVUEB_ERSATZ_HAS SWI_STATUS_WASCHSTR_ERSATZ_HAS SWI_T_BETRIEB_PVU_EE_ERSATZ_HAS SWI_ZIELGANG_EGS_ERSATZ_HAS SWI_Z_ABLAUFHASHST_ERSATZ_HAS SWI_Z_ABLAUFVARIANTE_ERS_HAS SWI_Z_DIAG_ERSFKT_ERS_HAS SWI_Z_DIAG_ERSFKT_HI_ERS_HAS SWI_Z_DIAG_NOTGANG_HAS_ERS_HAS SWI_Z_IEP_ERSATZ_HAS SWI_Z_K0_FST_ERSATZ_HAS SWI_Z_KPS_STADA_ERSATZ_HAS SWI_Z_MSA_FST_ERSATZ_HAS SWI_Z_NLLSOLL_IAE_ERS_HAS SWI_Z_NMINEMPARKSP_ERS_HAS SWI_Z_N_MIN_IEP_ERSATZ_HAS T_BETRIEB_PVU_EE_ERSATZ_HAS ZIELGANG_EGS_ERSATZ_HAS Z_ABLAUFHASHST_ERSATZ_HAS Z_ABLAUFVARIANTE_ERS_HAS Z_DIAG_ERSFKT_ERS_HAS Z_DIAG_ERSFKT_HI_ERS_HAS Z_DIAG_NOTGANG_HAS_ERS_HAS Z_IEP_ERSATZ_HAS Z_K0_FST_ERSATZ_HAS Z_KPS_STADA_ERSATZ_HAS Z_MSA_FST_ERSATZ_HAS Z_NLLSOLL_IAE_ERS_HAS Z_NMINEMPARKSP_ERS_HAS Z_N_MIN_IEP_ERSATZ_HAS /end DEF_CHARACTERISTIC
 /begin LOC_MEASUREMENT c_getriebe_egs_portin c_iep_portin gangwechsel_egs_portin istgang_egs_portin m_em_in_azg m_em_portin m_iae_portin m_k0_in_azg m_k0_portin m_max_dyn_em_in_azg m_max_dyn_em_portin m_min_dyn_em_portin m_mot_portin m_soll_em_hst_portin m_soll_vm_hst_portin m_vm_in_azg m_vm_portin m_vm_start_portin m_wunsch_fpw_portin n_ab_egs_portin n_em_in_azg n_em_portin n_mot_soll_iae_portin n_soll_ll_vm_portin n_t_egs_portin n_vm_in_azg n_vm_portin osmode_next_portin p_bremse_fzg_portin phi_neigung_portin pos_egs_portin posv_timer_portin posvueb_aktiv_portin sollgang_egs_portin status_alaengs_adaoff_portin status_ee_busy_portin status_fehler_iep_portin status_iae_adap_portin status_iae_portin status_iep_portin status_k0_adap_portin status_k0_portin status_kolbenpos_k0_portin status_kraftschl_atsys_portin status_nem_portin status_nvm_portin status_phineigung_portin status_waschstr_portin t_betrieb_pvu_has_ee_portin z_ablauf_has_hst_portin z_ablaufvariante_has_hst_portin z_diag_ersfkt_has_portin z_diag_ersfkt_hi_has_portin z_diag_notgang_has_portin z_iep_portin z_k0_fst_portin z_kps_stada_portin z_msa_fst_portin z_n_min_em_parksp_has_portin z_n_min_iep_portin z_nllsoll_iae_portin zielgang_egs_portin /end LOC_MEASUREMENT
/end FUNCTION
/begin RECORD_LAYOUT FLOAT32_IEEE_COL_DIRECT_S6_S3 FNC_VALUES 1 FLOAT32_IEEE COLUMN_DIR DIRECT /end RECORD_LAYOUT
/begin RECORD_LAYOUT FLOAT32_IEEE_X_INCR_DIRECT_S6_S3 AXIS_PTS_X 1 FLOAT32_IEEE INDEX_INCR DIRECT /end RECORD_LAYOUT
/begin RECORD_LAYOUT SBYTE_COL_DIRECT_S6_S3 FNC_VALUES 1 SBYTE COLUMN_DIR DIRECT /end RECORD_LAYOUT
/begin RECORD_LAYOUT SBYTE_X_INCR_DIRECT_S6_S3 AXIS_PTS_X 1 SBYTE INDEX_INCR DIRECT /end RECORD_LAYOUT
/begin RECORD_LAYOUT SWORD_COL_DIRECT_S6_S3 FNC_VALUES 1 SWORD COLUMN_DIR DIRECT /end RECORD_LAYOUT
/begin RECORD_LAYOUT SWORD_X_INCR_DIRECT_S6_S3 AXIS_PTS_X 1 SWORD INDEX_INCR DIRECT /end RECORD_LAYOUT
/begin RECORD_LAYOUT UBYTE_COL_DIRECT_S6_S3 FNC_VALUES 1 UBYTE COLUMN_DIR DIRECT /end RECORD_LAYOUT
/begin RECORD_LAYOUT UBYTE_X_INCR_DIRECT_S6_S3 AXIS_PTS_X 1 UBYTE INDEX_INCR DIRECT /end RECORD_LAYOUT
/begin RECORD_LAYOUT ULONG_COL_DIRECT_S6_S3 FNC_VALUES 1 ULONG COLUMN_DIR DIRECT /end RECORD_LAYOUT
/begin RECORD_LAYOUT UWORD_COL_DIRECT_S6_S3 FNC_VALUES 1 UWORD COLUMN_DIR DIRECT /end RECORD_LAYOUT
/end MODULE
/end PROJECT
