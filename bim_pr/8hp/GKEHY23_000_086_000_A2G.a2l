ASAP2_VERSION 1 51
/begin PROJECT ZHBC8600 "Gen2_BMW_System_Supplier_Lib"
/begin MODULE CPP ""
/begin MOD_COMMON "" BYTE_ORDER MSB_FIRST ALIGNMENT_BYTE 1 ALIGNMENT_WORD 2 ALIGNMENT_LONG 4 ALIGNMENT_FLOAT32_IEEE 4 ALIGNMENT_FLOAT64_IEEE 1 /end MOD_COMMON
/begin COMPU_METHOD SAB_C_CMO_1CEL_M48_S2_S3 "int = ((phys * 1) / 1) - (-48) Grad Celsius" RAT_FUNC "%1.0" "Grad Celsius" COEFFS 0 1 48 0 0 1 /end COMPU_METHOD
/begin COMPU_METHOD SAB_K1000_S2_S3 "int = ((phys * 1000) / 1) - (0) -" RAT_FUNC "%4.3" "-" COEFFS 0 1000 0 0 0 1 /end COMPU_METHOD
/begin COMPU_METHOD SAB_L_10KM_S2_S3 "int = ((phys * 1) / 10) - (0) km" RAT_FUNC "%4.3" "km" COEFFS 0 0.1 0 0 0 1 /end COMPU_METHOD
/begin COMPU_METHOD SAB_L_1KM_S2_S3 "int = ((phys * 1) / 1) - (0) km" RAT_FUNC "%1.0" "km" COEFFS 0 1 0 0 0 1 /end COMPU_METHOD
/begin COMPU_METHOD SAB_L_1MM_S2_S3 "int = ((phys * 1) / 1) - (0) mm" RAT_FUNC "%1.0" "mm" COEFFS 0 1 0 0 0 1 /end COMPU_METHOD
/begin COMPU_METHOD SAB_M_1NM_M32000_S2_S3 "int = ((phys * 1) / 1) - (-32000) Nm" RAT_FUNC "%1.0" "Nm" COEFFS 0 1 32000 0 0 1 /end COMPU_METHOD
/begin COMPU_METHOD SAB_M_1NM_S2_S3 "int = ((phys * 1) / 1) - (0) Nm" RAT_FUNC "%1.0" "Nm" COEFFS 0 1 0 0 0 1 /end COMPU_METHOD
/begin COMPU_METHOD SAB_M_NM2_M2047_S2_S3 "int = ((phys * 2) / 1) - (-2047) Nm" RAT_FUNC "%4.3" "Nm" COEFFS 0 2 2047 0 0 1 /end COMPU_METHOD
/begin COMPU_METHOD SAB_M_NM2_S2_S3 "int = ((phys * 2) / 1) - (0) Nm" RAT_FUNC "%4.3" "Nm" COEFFS 0 2 0 0 0 1 /end COMPU_METHOD
/begin COMPU_METHOD SAB_N_10RPM_S2_S3 "int = ((phys * 1) / 10) - (0) 1/min" RAT_FUNC "%4.3" "1/min" COEFFS 0 0.1 0 0 0 1 /end COMPU_METHOD
/begin COMPU_METHOD SAB_N_1RPM_S2_S3 "int = ((phys * 1) / 1) - (0) 1/min" RAT_FUNC "%1.0" "1/min" COEFFS 0 1 0 0 0 1 /end COMPU_METHOD
/begin COMPU_METHOD SAB_N_5RPM_S2_S3 "int = ((phys * 1) / 5) - (0) 1/min" RAT_FUNC "%4.3" "1/min" COEFFS 0 0.2 0 0 0 1 /end COMPU_METHOD
/begin COMPU_METHOD SAB_N_RPM2_M5000_S2_S3 "int = ((phys * 2) / 1) - (-10000) 1/min" RAT_FUNC "%4.3" "1/min" COEFFS 0 2 10000 0 0 1 /end COMPU_METHOD
/begin COMPU_METHOD SAB_N_RPM4_S2_S3 "int = ((phys * 4) / 1) - (0) 1/min" RAT_FUNC "%4.3" "1/min" COEFFS 0 4 0 0 0 1 /end COMPU_METHOD
/begin COMPU_METHOD SAB_PROZENT10_S2_S3 "int = ((phys * 10) / 1) - (0) %" RAT_FUNC "%4.3" "%" COEFFS 0 10 0 0 0 1 /end COMPU_METHOD
/begin COMPU_METHOD SAB_PROZENT50_S2_S3 "int = ((phys * 50) / 1) - (0) %" RAT_FUNC "%4.3" "%" COEFFS 0 50 0 0 0 1 /end COMPU_METHOD
/begin COMPU_METHOD SAB_PROZENT_100PROZENT125_1016M10_S2_S3 "int = ((phys * 125) / 100) - (-127) %" RAT_FUNC "%4.3" "%" COEFFS 0 1.25 127 0 0 1 /end COMPU_METHOD
/begin COMPU_METHOD SAB_PROZENT_GRADP10MS10_S2_S3 "int = ((phys * 10) / 1) - (0) Grad/10ms" RAT_FUNC "%4.3" "Grad/10ms" COEFFS 0 10 0 0 0 1 /end COMPU_METHOD
/begin COMPU_METHOD SAB_PROZENT_PROZENT10_M300_S2_S3 "int = ((phys * 10) / 1) - (-3000) %" RAT_FUNC "%4.3" "%" COEFFS 0 10 3000 0 0 1 /end COMPU_METHOD
/begin COMPU_METHOD SAB_PROZENT_PROZENT_M30_S2_S3 "int = ((phys * 1) / 1) - (-30) Unit_PerCent" RAT_FUNC "%1.0" "Unit_PerCent" COEFFS 0 1 30 0 0 1 /end COMPU_METHOD
/begin COMPU_METHOD SAB_PROZENT_PROZENT_S2_S3 "int = ((phys * 1) / 1) - (0) Unit_PerCent" RAT_FUNC "%1.0" "Unit_PerCent" COEFFS 0 1 0 0 0 1 /end COMPU_METHOD
/begin COMPU_METHOD SAB_PROZENT_S2_S3 "int = ((phys * 1) / 1) - (0) %" RAT_FUNC "%1.0" "%" COEFFS 0 1 0 0 0 1 /end COMPU_METHOD
/begin COMPU_METHOD SAB_PROZENTPS2_S2_S3 "int = ((phys * 2) / 1) - (0) %/s" RAT_FUNC "%4.3" "%/s" COEFFS 0 2 0 0 0 1 /end COMPU_METHOD
/begin COMPU_METHOD SAB_PROZENTPS_S2_S3 "int = ((phys * 1) / 1) - (0) %/s" RAT_FUNC "%1.0" "%/s" COEFFS 0 1 0 0 0 1 /end COMPU_METHOD
/begin COMPU_METHOD SAB_R_OHM1000_S2_S3 "int = ((phys * 1000) / 1) - (0) Ohm" RAT_FUNC "%4.3" "Ohm" COEFFS 0 1000 0 0 0 1 /end COMPU_METHOD
/begin COMPU_METHOD SAB_S_DISTSENS_256MM_S2_S3 "int = ((phys * 256) / 1) - (0) mm" RAT_FUNC "%4.3" "mm" COEFFS 0 256 0 0 0 1 /end COMPU_METHOD
/begin COMPU_METHOD SAB_SECOND_S2_S3 "int = ((phys * 1) / 1) - (0) second" RAT_FUNC "%1.0" "second" COEFFS 0 1 0 0 0 1 /end COMPU_METHOD
/begin COMPU_METHOD SAB_STANDARD_S2_S3 "int = ((phys * 1) / 1) - (0) -" RAT_FUNC "%1.0" "-" COEFFS 0 1 0 0 0 1 /end COMPU_METHOD
/begin COMPU_METHOD SAB_T_100MS_S2_S3 "int = ((phys * 1) / 100) - (0) ms" RAT_FUNC "%4.3" "ms" COEFFS 0 0.01 0 0 0 1 /end COMPU_METHOD
/begin COMPU_METHOD SAB_T_14S_S2_S3 "int = ((phys * 1) / 14) - (0) s" RAT_FUNC "%4.3" "s" COEFFS 0 0.0714285714286 0 0 0 1 /end COMPU_METHOD
/begin COMPU_METHOD SAB_T_1D_S2_S3 "int = ((phys * 1) / 1) - (0) day" RAT_FUNC "%1.0" "day" COEFFS 0 1 0 0 0 1 /end COMPU_METHOD
/begin COMPU_METHOD SAB_T_1H_S2_S3 "int = ((phys * 1) / 1) - (0) h" RAT_FUNC "%1.0" "h" COEFFS 0 1 0 0 0 1 /end COMPU_METHOD
/begin COMPU_METHOD SAB_T_1M_S2_S3 "int = ((phys * 1) / 1) - (0) month" RAT_FUNC "%1.0" "month" COEFFS 0 1 0 0 0 1 /end COMPU_METHOD
/begin COMPU_METHOD SAB_T_1MIN_S2_S3 "int = ((phys * 1) / 1) - (0) min" RAT_FUNC "%1.0" "min" COEFFS 0 1 0 0 0 1 /end COMPU_METHOD
/begin COMPU_METHOD SAB_T_1MS_S2_S3 "int = ((phys * 1) / 1) - (0) ms" RAT_FUNC "%1.0" "ms" COEFFS 0 1 0 0 0 1 /end COMPU_METHOD
/begin COMPU_METHOD SAB_T_1S_S2_S3 "int = ((phys * 1) / 1) - (0) sec" RAT_FUNC "%1.0" "sec" COEFFS 0 1 0 0 0 1 /end COMPU_METHOD
/begin COMPU_METHOD SAB_T_1Y_S2_S3 "int = ((phys * 1) / 1) - (0) year" RAT_FUNC "%1.0" "year" COEFFS 0 1 0 0 0 1 /end COMPU_METHOD
/begin COMPU_METHOD SAB_T_30MS_S2_S3 "int = ((phys * 1) / 30) - (0) ms" RAT_FUNC "%4.3" "ms" COEFFS 0 0.0333333333333 0 0 0 1 /end COMPU_METHOD
/begin COMPU_METHOD SAB_T_40MS_S2_S3 "int = ((phys * 1) / 40) - (0) ms" RAT_FUNC "%4.3" "ms" COEFFS 0 0.025 0 0 0 1 /end COMPU_METHOD
/begin COMPU_METHOD SAB_T_4S_S2_S3 "int = ((phys * 1) / 4) - (0) s" RAT_FUNC "%4.3" "s" COEFFS 0 0.25 0 0 0 1 /end COMPU_METHOD
/begin COMPU_METHOD SAB_T_H4_S2_S3 "int = ((phys * 4) / 1) - (0) h" RAT_FUNC "%4.3" "h" COEFFS 0 4 0 0 0 1 /end COMPU_METHOD
/begin COMPU_METHOD SAB_T_MIN60_S2_S3 "int = ((phys * 60) / 1) - (0) min" RAT_FUNC "%4.3" "min" COEFFS 0 60 0 0 0 1 /end COMPU_METHOD
/begin COMPU_METHOD SAB_T_S100_S2_S3 "int = ((phys * 100) / 1) - (0) s" RAT_FUNC "%4.3" "s" COEFFS 0 100 0 0 0 1 /end COMPU_METHOD
/begin COMPU_METHOD SAB_T_TIMER_100US_S2_S3 "int = ((phys * 1) / 100) - (0) us" RAT_FUNC "%4.3" "us" COEFFS 0 0.01 0 0 0 1 /end COMPU_METHOD
/begin COMPU_METHOD SAB_T_TIMER_10MS_S2_S3 "int = ((phys * 1) / 10) - (0) ms" RAT_FUNC "%4.3" "ms" COEFFS 0 0.1 0 0 0 1 /end COMPU_METHOD
/begin COMPU_METHOD SAB_T_TIMER_125NS_S2_S3 "int = ((phys * 8000) / 1) - (0) ms" RAT_FUNC "%7.6" "ms" COEFFS 0 8000 0 0 0 1 /end COMPU_METHOD
/begin COMPU_METHOD SAB_T_TIMER_20MS_S2_S3 "int = ((phys * 1) / 20) - (0) ms" RAT_FUNC "%4.3" "ms" COEFFS 0 0.05 0 0 0 1 /end COMPU_METHOD
/begin COMPU_METHOD SAB_U_1VOLT1000_S2_S3 "int = ((phys * 1000) / 1) - (0) Volt" RAT_FUNC "%4.3" "Volt" COEFFS 0 1000 0 0 0 1 /end COMPU_METHOD
/begin MEASUREMENT ZFFSAB._.CAN_Handling.CANMsg[14].Status "CAN Message status" UBYTE SAB_STANDARD_S2_S3 1 100 0 255 ECU_ADDRESS 0xFFF95DD2 DISPLAY_IDENTIFIER Status.CANMsg[14].CAN_Handling._.ZFFSAB /end MEASUREMENT
/begin MEASUREMENT ZFFSAB._.CAN_Handling.CANMsg[15].Status "CAN Message status" UBYTE SAB_STANDARD_S2_S3 1 100 0 255 ECU_ADDRESS 0xFFF95DD3 DISPLAY_IDENTIFIER Status.CANMsg[15].CAN_Handling._.ZFFSAB /end MEASUREMENT
/begin MEASUREMENT ZFFSAB._.CAN_Handling.CANMsg[16].Status "CAN Message status" UBYTE SAB_STANDARD_S2_S3 1 100 0 255 ECU_ADDRESS 0xFFF95DD4 DISPLAY_IDENTIFIER Status.CANMsg[16].CAN_Handling._.ZFFSAB /end MEASUREMENT
/begin MEASUREMENT ZFFSAB._.CAN_Handling.CANMsg[17].Status "CAN Message status" UBYTE SAB_STANDARD_S2_S3 1 100 0 255 ECU_ADDRESS 0xFFF95DD5 DISPLAY_IDENTIFIER Status.CANMsg[17].CAN_Handling._.ZFFSAB /end MEASUREMENT
/begin MEASUREMENT ZFFSAB._.CAN_Handling.CANMsg[18].Status "CAN Message status" UBYTE SAB_STANDARD_S2_S3 1 100 0 255 ECU_ADDRESS 0xFFF95DD6 DISPLAY_IDENTIFIER Status.CANMsg[18].CAN_Handling._.ZFFSAB /end MEASUREMENT
/begin MEASUREMENT ZFFSAB._.CAN_Handling.CANMsg[19].Status "CAN Message status" UBYTE SAB_STANDARD_S2_S3 1 100 0 255 ECU_ADDRESS 0xFFF95DD7 DISPLAY_IDENTIFIER Status.CANMsg[19].CAN_Handling._.ZFFSAB /end MEASUREMENT
/begin MEASUREMENT ZFFSAB._.CAN_Handling.CANMsg[1].Status "CAN Message status" UBYTE SAB_STANDARD_S2_S3 1 100 0 255 ECU_ADDRESS 0xFFF95DC5 DISPLAY_IDENTIFIER Status.CANMsg[1].CAN_Handling._.ZFFSAB /end MEASUREMENT
/begin MEASUREMENT ZFFSAB._.CAN_Handling.CANMsg[20].Status "CAN Message status" UBYTE SAB_STANDARD_S2_S3 1 100 0 255 ECU_ADDRESS 0xFFF95DD8 DISPLAY_IDENTIFIER Status.CANMsg[20].CAN_Handling._.ZFFSAB /end MEASUREMENT
/begin MEASUREMENT ZFFSAB._.CAN_Handling.CANMsg[21].Status "CAN Message status" UBYTE SAB_STANDARD_S2_S3 1 100 0 255 ECU_ADDRESS 0xFFF95DD9 DISPLAY_IDENTIFIER Status.CANMsg[21].CAN_Handling._.ZFFSAB /end MEASUREMENT
/begin MEASUREMENT ZFFSAB._.CAN_Handling.CANMsg[22].Status "CAN Message status" UBYTE SAB_STANDARD_S2_S3 1 100 0 255 ECU_ADDRESS 0xFFF95DDA DISPLAY_IDENTIFIER Status.CANMsg[22].CAN_Handling._.ZFFSAB /end MEASUREMENT
/begin MEASUREMENT ZFFSAB._.CAN_Handling.CANMsg[23].Status "CAN Message status" UBYTE SAB_STANDARD_S2_S3 1 100 0 255 ECU_ADDRESS 0xFFF95DDB DISPLAY_IDENTIFIER Status.CANMsg[23].CAN_Handling._.ZFFSAB /end MEASUREMENT
/begin MEASUREMENT ZFFSAB._.CAN_Handling.CANMsg[24].Status "CAN Message status" UBYTE SAB_STANDARD_S2_S3 1 100 0 255 ECU_ADDRESS 0xFFF95DDC DISPLAY_IDENTIFIER Status.CANMsg[24].CAN_Handling._.ZFFSAB /end MEASUREMENT
/begin MEASUREMENT ZFFSAB._.CAN_Handling.CANMsg[25].Status "CAN Message status" UBYTE SAB_STANDARD_S2_S3 1 100 0 255 ECU_ADDRESS 0xFFF95DDD DISPLAY_IDENTIFIER Status.CANMsg[25].CAN_Handling._.ZFFSAB /end MEASUREMENT
/begin MEASUREMENT ZFFSAB._.CAN_Handling.CANMsg[26].Status "CAN Message status" UBYTE SAB_STANDARD_S2_S3 1 100 0 255 ECU_ADDRESS 0xFFF95DDE DISPLAY_IDENTIFIER Status.CANMsg[26].CAN_Handling._.ZFFSAB /end MEASUREMENT
/begin MEASUREMENT ZFFSAB._.CAN_Handling.CANMsg[27].Status "CAN Message status" UBYTE SAB_STANDARD_S2_S3 1 100 0 255 ECU_ADDRESS 0xFFF95DDF DISPLAY_IDENTIFIER Status.CANMsg[27].CAN_Handling._.ZFFSAB /end MEASUREMENT
/begin MEASUREMENT ZFFSAB._.CAN_Handling.CANMsg[28].Status "CAN Message status" UBYTE SAB_STANDARD_S2_S3 1 100 0 255 ECU_ADDRESS 0xFFF95DE0 DISPLAY_IDENTIFIER Status.CANMsg[28].CAN_Handling._.ZFFSAB /end MEASUREMENT
/begin MEASUREMENT ZFFSAB._.CAN_Handling.CANMsg[29].Status "CAN Message status" UBYTE SAB_STANDARD_S2_S3 1 100 0 255 ECU_ADDRESS 0xFFF95DE1 DISPLAY_IDENTIFIER Status.CANMsg[29].CAN_Handling._.ZFFSAB /end MEASUREMENT
/begin MEASUREMENT ZFFSAB._.CAN_Handling.CANMsg[2].Status "CAN Message status" UBYTE SAB_STANDARD_S2_S3 1 100 0 255 ECU_ADDRESS 0xFFF95DC6 DISPLAY_IDENTIFIER Status.CANMsg[2].CAN_Handling._.ZFFSAB /end MEASUREMENT
/begin MEASUREMENT ZFFSAB._.CAN_Handling.CANMsg[30].Status "CAN Message status" UBYTE SAB_STANDARD_S2_S3 1 100 0 255 ECU_ADDRESS 0xFFF95DE2 DISPLAY_IDENTIFIER Status.CANMsg[30].CAN_Handling._.ZFFSAB /end MEASUREMENT
/begin MEASUREMENT ZFFSAB._.CAN_Handling.CANMsg[31].Status "CAN Message status" UBYTE SAB_STANDARD_S2_S3 1 100 0 255 ECU_ADDRESS 0xFFF95DE3 DISPLAY_IDENTIFIER Status.CANMsg[31].CAN_Handling._.ZFFSAB /end MEASUREMENT
/begin MEASUREMENT ZFFSAB._.CAN_Handling.CANMsg[32].Status "CAN Message status" UBYTE SAB_STANDARD_S2_S3 1 100 0 255 ECU_ADDRESS 0xFFF95DE4 DISPLAY_IDENTIFIER Status.CANMsg[32].CAN_Handling._.ZFFSAB /end MEASUREMENT
/begin MEASUREMENT ZFFSAB._.CAN_Handling.CANMsg[33].Status "CAN Message status" UBYTE SAB_STANDARD_S2_S3 1 100 0 255 ECU_ADDRESS 0xFFF95DE5 DISPLAY_IDENTIFIER Status.CANMsg[33].CAN_Handling._.ZFFSAB /end MEASUREMENT
/begin MEASUREMENT ZFFSAB._.CAN_Handling.CANMsg[34].Status "CAN Message status" UBYTE SAB_STANDARD_S2_S3 1 100 0 255 ECU_ADDRESS 0xFFF95DE6 DISPLAY_IDENTIFIER Status.CANMsg[34].CAN_Handling._.ZFFSAB /end MEASUREMENT
/begin MEASUREMENT ZFFSAB._.CAN_Handling.CANMsg[35].Status "CAN Message status" UBYTE SAB_STANDARD_S2_S3 1 100 0 255 ECU_ADDRESS 0xFFF95DE7 DISPLAY_IDENTIFIER Status.CANMsg[35].CAN_Handling._.ZFFSAB /end MEASUREMENT
/begin MEASUREMENT ZFFSAB._.CAN_Handling.CANMsg[36].Status "CAN Message status" UBYTE SAB_STANDARD_S2_S3 1 100 0 255 ECU_ADDRESS 0xFFF95DE8 DISPLAY_IDENTIFIER Status.CANMsg[36].CAN_Handling._.ZFFSAB /end MEASUREMENT
/begin MEASUREMENT ZFFSAB._.CAN_Handling.CANMsg[37].Status "CAN Message status" UBYTE SAB_STANDARD_S2_S3 1 100 0 255 ECU_ADDRESS 0xFFF95DE9 DISPLAY_IDENTIFIER Status.CANMsg[37].CAN_Handling._.ZFFSAB /end MEASUREMENT
/begin MEASUREMENT ZFFSAB._.CAN_Handling.CANMsg[38].Status "CAN Message status" UBYTE SAB_STANDARD_S2_S3 1 100 0 255 ECU_ADDRESS 0xFFF95DEA DISPLAY_IDENTIFIER Status.CANMsg[38].CAN_Handling._.ZFFSAB /end MEASUREMENT
/begin MEASUREMENT ZFFSAB._.CAN_Handling.CANMsg[39].Status "CAN Message status" UBYTE SAB_STANDARD_S2_S3 1 100 0 255 ECU_ADDRESS 0xFFF95DEB DISPLAY_IDENTIFIER Status.CANMsg[39].CAN_Handling._.ZFFSAB /end MEASUREMENT
/begin MEASUREMENT ZFFSAB._.CAN_Handling.CANMsg[3].Status "CAN Message status" UBYTE SAB_STANDARD_S2_S3 1 100 0 255 ECU_ADDRESS 0xFFF95DC7 DISPLAY_IDENTIFIER Status.CANMsg[3].CAN_Handling._.ZFFSAB /end MEASUREMENT
/begin MEASUREMENT ZFFSAB._.CAN_Handling.CANMsg[40].Status "CAN Message status" UBYTE SAB_STANDARD_S2_S3 1 100 0 255 ECU_ADDRESS 0xFFF95DEC DISPLAY_IDENTIFIER Status.CANMsg[40].CAN_Handling._.ZFFSAB /end MEASUREMENT
/begin MEASUREMENT ZFFSAB._.CAN_Handling.CANMsg[41].Status "CAN Message status" UBYTE SAB_STANDARD_S2_S3 1 100 0 255 ECU_ADDRESS 0xFFF95DED DISPLAY_IDENTIFIER Status.CANMsg[41].CAN_Handling._.ZFFSAB /end MEASUREMENT
/begin MEASUREMENT ZFFSAB._.CAN_Handling.CANMsg[42].Status "CAN Message status" UBYTE SAB_STANDARD_S2_S3 1 100 0 255 ECU_ADDRESS 0xFFF95DEE DISPLAY_IDENTIFIER Status.CANMsg[42].CAN_Handling._.ZFFSAB /end MEASUREMENT
/begin MEASUREMENT ZFFSAB._.CAN_Handling.CANMsg[43].Status "CAN Message status" UBYTE SAB_STANDARD_S2_S3 1 100 0 255 ECU_ADDRESS 0xFFF95DEF DISPLAY_IDENTIFIER Status.CANMsg[43].CAN_Handling._.ZFFSAB /end MEASUREMENT
/begin MEASUREMENT ZFFSAB._.CAN_Handling.CANMsg[44].Status "CAN Message status" UBYTE SAB_STANDARD_S2_S3 1 100 0 255 ECU_ADDRESS 0xFFF95DF0 DISPLAY_IDENTIFIER Status.CANMsg[44].CAN_Handling._.ZFFSAB /end MEASUREMENT
/begin MEASUREMENT ZFFSAB._.CAN_Handling.CANMsg[45].Status "CAN Message status" UBYTE SAB_STANDARD_S2_S3 1 100 0 255 ECU_ADDRESS 0xFFF95DF1 DISPLAY_IDENTIFIER Status.CANMsg[45].CAN_Handling._.ZFFSAB /end MEASUREMENT
/begin MEASUREMENT ZFFSAB._.CAN_Handling.CANMsg[4].Status "CAN Message status" UBYTE SAB_STANDARD_S2_S3 1 100 0 255 ECU_ADDRESS 0xFFF95DC8 DISPLAY_IDENTIFIER Status.CANMsg[4].CAN_Handling._.ZFFSAB /end MEASUREMENT
/begin MEASUREMENT ZFFSAB._.CAN_Handling.CANMsg[5].Status "CAN Message status" UBYTE SAB_STANDARD_S2_S3 1 100 0 255 ECU_ADDRESS 0xFFF95DC9 DISPLAY_IDENTIFIER Status.CANMsg[5].CAN_Handling._.ZFFSAB /end MEASUREMENT
/begin MEASUREMENT ZFFSAB._.CAN_Handling.CANMsg[6].Status "CAN Message status" UBYTE SAB_STANDARD_S2_S3 1 100 0 255 ECU_ADDRESS 0xFFF95DCA DISPLAY_IDENTIFIER Status.CANMsg[6].CAN_Handling._.ZFFSAB /end MEASUREMENT
/begin MEASUREMENT ZFFSAB._.CAN_Handling.CANMsg[7].Status "CAN Message status" UBYTE SAB_STANDARD_S2_S3 1 100 0 255 ECU_ADDRESS 0xFFF95DCB DISPLAY_IDENTIFIER Status.CANMsg[7].CAN_Handling._.ZFFSAB /end MEASUREMENT
/begin MEASUREMENT ZFFSAB._.CAN_Handling.CANMsg[8].Status "CAN Message status" UBYTE SAB_STANDARD_S2_S3 1 100 0 255 ECU_ADDRESS 0xFFF95DCC DISPLAY_IDENTIFIER Status.CANMsg[8].CAN_Handling._.ZFFSAB /end MEASUREMENT
/begin MEASUREMENT ZFFSAB._.CAN_Handling.CANMsg[9].Status "CAN Message status" UBYTE SAB_STANDARD_S2_S3 1 100 0 255 ECU_ADDRESS 0xFFF95DCD DISPLAY_IDENTIFIER Status.CANMsg[9].CAN_Handling._.ZFFSAB /end MEASUREMENT
/begin MEASUREMENT ZFFSAB._.CAN_Handling.f_ACanMsgDiag "State of diagnosis test conditions for A-CAN (0 = not ok;1 = ok)" UBYTE SAB_STANDARD_S2_S3 1 100 0 1 ECU_ADDRESS 0xFFF95E3B DISPLAY_IDENTIFIER f_ACanMsgDiag.CAN_Handling._.ZFFSAB /end MEASUREMENT
/begin MEASUREMENT ZFFSAB._.CAN_Handling.f_AfterRunning "the system is in after running (Nachlauf)" UBYTE SAB_STANDARD_S2_S3 1 100 0 1 ECU_ADDRESS 0xFFF95E04 DISPLAY_IDENTIFIER f_AfterRunning.CAN_Handling._.ZFFSAB /end MEASUREMENT
/begin MEASUREMENT ZFFSAB._.CAN_Handling.f_AllTo "flag for Timeout (1 = all monitored signals in Timeout 0 = not all in Timeout)" UBYTE SAB_STANDARD_S2_S3 1 100 0 1 ECU_ADDRESS 0xFFF95E07 DISPLAY_IDENTIFIER f_AllTo.CAN_Handling._.ZFFSAB /end MEASUREMENT
/begin MEASUREMENT ZFFSAB._.CAN_Handling.f_AllTo1 "flag for Timeout (1 = all monitored signals A-CAN in Timeout 0 = not all in Timeout)" UBYTE SAB_STANDARD_S2_S3 1 100 0 1 ECU_ADDRESS 0xFFF95E0C DISPLAY_IDENTIFIER f_AllTo1.CAN_Handling._.ZFFSAB /end MEASUREMENT
/begin MEASUREMENT ZFFSAB._.CAN_Handling.f_AllTo2 "flag for Timeout (1 = all monitored signals FA-CAN in Timeout 0 = not all in Timeout)" UBYTE SAB_STANDARD_S2_S3 1 100 0 1 ECU_ADDRESS 0xFFF95E0D DISPLAY_IDENTIFIER f_AllTo2.CAN_Handling._.ZFFSAB /end MEASUREMENT
/begin MEASUREMENT ZFFSAB._.CAN_Handling.f_Can1BusDiag "State of diagnosis test conditions for CAN Bus Off(0 = not ok;1 = ok)" UBYTE SAB_STANDARD_S2_S3 1 100 0 1 ECU_ADDRESS 0xFFF95E3A DISPLAY_IDENTIFIER f_Can1BusDiag.CAN_Handling._.ZFFSAB /end MEASUREMENT
/begin MEASUREMENT ZFFSAB._.CAN_Handling.f_Can2BusDiag "State of diagnosis test conditions for the second CAN Bus Off(0 = not ok;1 = ok)" UBYTE SAB_STANDARD_S2_S3 1 100 0 1 ECU_ADDRESS 0xFFF95E3C DISPLAY_IDENTIFIER f_Can2BusDiag.CAN_Handling._.ZFFSAB /end MEASUREMENT
/begin MEASUREMENT ZFFSAB._.CAN_Handling.f_CanMsgDiag "State of diagnosis test conditions for CAN (0 = not ok;1 = ok)" UBYTE SAB_STANDARD_S2_S3 1 100 0 1 ECU_ADDRESS 0xFFF95E39 DISPLAY_IDENTIFIER f_CanMsgDiag.CAN_Handling._.ZFFSAB /end MEASUREMENT
/begin MEASUREMENT ZFFSAB._.CAN_Handling.f_FaultStatKFC_CANB1 "value = 1 if KFC_CANB1 is entered or in forward filtering" UBYTE SAB_STANDARD_S2_S3 1 100 0 1 ECU_ADDRESS 0xFFF95E0A DISPLAY_IDENTIFIER f_FaultStatKFC_CANB1.CAN_Handling._.ZFFSAB /end MEASUREMENT
/begin MEASUREMENT ZFFSAB._.CAN_Handling.f_FaultStatKFC_CANB2 "value = 1 if KFC_CANB2 is entered or in forward filtering" UBYTE SAB_STANDARD_S2_S3 1 100 0 1 ECU_ADDRESS 0xFFF95E0B DISPLAY_IDENTIFIER f_FaultStatKFC_CANB2.CAN_Handling._.ZFFSAB /end MEASUREMENT
/begin MEASUREMENT ZFFSAB._.CAN_Handling.iv_Busruhe "State of CAN Bus(0 = Bus active;1 = Bus not active because of flashing active)" UBYTE SAB_STANDARD_S2_S3 1 100 0 1 ECU_ADDRESS 0xFFF95E00 DISPLAY_IDENTIFIER iv_Busruhe.CAN_Handling._.ZFFSAB /end MEASUREMENT
/begin MEASUREMENT ZFFSAB._.CAN_Handling.iv_JumpstartAktiv "State of Jumpstart" UBYTE SAB_STANDARD_S2_S3 1 100 0 2 ECU_ADDRESS 0xFFF95E3D DISPLAY_IDENTIFIER iv_JumpstartAktiv.CAN_Handling._.ZFFSAB /end MEASUREMENT
/begin MEASUREMENT ZFFSAB._.CAN_Handling.iv_f_FaultStatKFC_UBATTO "value = 1 if KFC_UBATTO is entered or in forward filtering" UBYTE SAB_STANDARD_S2_S3 1 100 0 1 ECU_ADDRESS 0xFFF95E3E DISPLAY_IDENTIFIER iv_f_FaultStatKFC_UBATTO.CAN_Handling._.ZFFSAB /end MEASUREMENT
/begin MEASUREMENT ZFFSAB._.CAN_Handling.iv_f_clear_learnedmsg "flag for learned messaeges (1=clear all, 0=not clear)" UBYTE SAB_STANDARD_S2_S3 1 100 0 1 ECU_ADDRESS 0xFFF95E38 DISPLAY_IDENTIFIER iv_f_clear_learnedmsg.CAN_Handling._.ZFFSAB /end MEASUREMENT
/begin MEASUREMENT ZFFSAB._.CAN_Handling.iv_st_Can1BusErr "State of CAN Bus from CAN-Controller(0=ok;1=BusOff;2=Error Active;4=Error Passive;128=channel not ok)" UBYTE SAB_STANDARD_S2_S3 1 100 0 255 ECU_ADDRESS 0xFFF95E06 DISPLAY_IDENTIFIER iv_st_Can1BusErr.CAN_Handling._.ZFFSAB /end MEASUREMENT
/begin MEASUREMENT ZFFSAB._.CAN_Handling.iv_st_Can2BusErr "State of A-CANBus from CAN-Controller (0=ok;1=BusOff;2=Error Active;4=Error Passive;128=channel not ok)" UBYTE SAB_STANDARD_S2_S3 1 100 0 255 ECU_ADDRESS 0xFFF95E08 DISPLAY_IDENTIFIER iv_st_Can2BusErr.CAN_Handling._.ZFFSAB /end MEASUREMENT
/begin MEASUREMENT ZFFSAB._.CAN_Handling.iv_u_BattFilt "Filtered battery voltage used for test conditions" UWORD SAB_U_1VOLT1000_S2_S3 1 100 0 65.535 ECU_ADDRESS 0xFFF95E02 DISPLAY_IDENTIFIER iv_u_BattFilt.CAN_Handling._.ZFFSAB /end MEASUREMENT
/begin MEASUREMENT ZFFSAB._.CAN_Handling.st_ACANMsgBitmask1 "bit is set if the corrisponding message is on the A CAN" ULONG SAB_STANDARD_S2_S3 1 100 0 4294967295 ECU_ADDRESS 0xFFF95E10 DISPLAY_IDENTIFIER st_ACANMsgBitmask1.CAN_Handling._.ZFFSAB /end MEASUREMENT
/begin MEASUREMENT ZFFSAB._.CAN_Handling.st_ACANMsgBitmask2 "bit is set if the corrisponding message is on the A CAN" ULONG SAB_STANDARD_S2_S3 1 100 0 4294967295 ECU_ADDRESS 0xFFF95E14 DISPLAY_IDENTIFIER st_ACANMsgBitmask2.CAN_Handling._.ZFFSAB /end MEASUREMENT
/begin MEASUREMENT ZFFSAB._.CAN_Handling.st_CANControlConfigBitmask1 "every CAN message that is monitored or learned (Bit x = 1)" ULONG SAB_STANDARD_S2_S3 1 100 0 4294967295 ECU_ADDRESS 0xFFF95E20 DISPLAY_IDENTIFIER st_CANControlConfigBitmask1.CAN_Handling._.ZFFSAB /end MEASUREMENT
/begin MEASUREMENT ZFFSAB._.CAN_Handling.st_CANControlConfigBitmask2 "every CAN message that is monitored or learned (Bit x = 1)" ULONG SAB_STANDARD_S2_S3 1 100 0 4294967295 ECU_ADDRESS 0xFFF95E2C DISPLAY_IDENTIFIER st_CANControlConfigBitmask2.CAN_Handling._.ZFFSAB /end MEASUREMENT
/begin MEASUREMENT ZFFSAB._.CAN_Handling.st_CanMsgErrorBitmask1 "Info bitmask for Ambient Conditions (SAB-UWB ID73). Bit for each Msg-No. Lowest index at LSB. (Msg 0-31) (0=i.O.; 1=Error)" ULONG SAB_STANDARD_S2_S3 1 100 0 4294967295 ECU_ADDRESS 0xFFF95E40 DISPLAY_IDENTIFIER st_CanMsgErrorBitmask1.CAN_Handling._.ZFFSAB /end MEASUREMENT
/begin MEASUREMENT ZFFSAB._.CAN_Handling.st_CanMsgErrorBitmask2 "Info bitmask for Ambient Conditions (SAB-UWB ID73). Bit for each Msg-No. Lowest index at LSB. (Msg 32 upside)(0=i.O.; 1=Error)" ULONG SAB_STANDARD_S2_S3 1 100 0 4294967295 ECU_ADDRESS 0xFFF95E44 DISPLAY_IDENTIFIER st_CanMsgErrorBitmask2.CAN_Handling._.ZFFSAB /end MEASUREMENT
/begin MEASUREMENT ZFFSAB._.CAN_Handling.st_ConfigBitmaskCANMsg1 "every CAN message that is monitored (bit x = index of CAN message array)" ULONG SAB_STANDARD_S2_S3 1 100 0 4294967295 ECU_ADDRESS 0xFFF95E18 DISPLAY_IDENTIFIER st_ConfigBitmaskCANMsg1.CAN_Handling._.ZFFSAB /end MEASUREMENT
/begin MEASUREMENT ZFFSAB._.CAN_Handling.st_ConfigBitmaskCANMsg2 "every CAN message that is monitored (bit x = index of CAN message array)" ULONG SAB_STANDARD_S2_S3 1 100 0 4294967295 ECU_ADDRESS 0xFFF95E1C DISPLAY_IDENTIFIER st_ConfigBitmaskCANMsg2.CAN_Handling._.ZFFSAB /end MEASUREMENT
/begin MEASUREMENT ZFFSAB._.CAN_Handling.st_LearnedBitmaskCANMsg1 "every CAN message that is learned (Msg 0-31, Bit x = 1)" ULONG SAB_STANDARD_S2_S3 1 100 0 4294967295 ECU_ADDRESS 0xFFF95E24 DISPLAY_IDENTIFIER st_LearnedBitmaskCANMsg1.CAN_Handling._.ZFFSAB /end MEASUREMENT
/begin MEASUREMENT ZFFSAB._.CAN_Handling.st_LearnedBitmaskCANMsg2 "every CAN message that is learned (Msg 32 upside, Bit x = 1)" ULONG SAB_STANDARD_S2_S3 1 100 0 4294967295 ECU_ADDRESS 0xFFF95E30 DISPLAY_IDENTIFIER st_LearnedBitmaskCANMsg2.CAN_Handling._.ZFFSAB /end MEASUREMENT
/begin MEASUREMENT ZFFSAB._.CAN_Handling.st_ToLearnBitmaskCANMsg1 "every CAN message that is to be learned" ULONG SAB_STANDARD_S2_S3 1 100 0 4294967295 ECU_ADDRESS 0xFFF95E28 DISPLAY_IDENTIFIER st_ToLearnBitmaskCANMsg1.CAN_Handling._.ZFFSAB /end MEASUREMENT
/begin MEASUREMENT ZFFSAB._.CAN_Handling.st_ToLearnBitmaskCANMsg2 "every CAN message that is to be learned" ULONG SAB_STANDARD_S2_S3 1 100 0 4294967295 ECU_ADDRESS 0xFFF95E34 DISPLAY_IDENTIFIER st_ToLearnBitmaskCANMsg2.CAN_Handling._.ZFFSAB /end MEASUREMENT
/begin MEASUREMENT ZFFSAB._.CAN_Handling.sts_Can1BusDisturbance "State of monitored disturbances of CAN Bus from local errorhandling" UBYTE SAB_STANDARD_S2_S3 1 100 0 1 ECU_ADDRESS 0xFFF95E05 DISPLAY_IDENTIFIER sts_Can1BusDisturbance.CAN_Handling._.ZFFSAB /end MEASUREMENT
/begin MEASUREMENT ZFFSAB._.CAN_Handling.sts_Can2BusDisturbance "State of monitored disturbances of A-CAN Bus from local errorhandling" UBYTE SAB_STANDARD_S2_S3 1 100 0 1 ECU_ADDRESS 0xFFF95E09 DISPLAY_IDENTIFIER sts_Can2BusDisturbance.CAN_Handling._.ZFFSAB /end MEASUREMENT
/begin MEASUREMENT ZFFSAB._.CAN_Handling.tmr_CAN1BusDiagDelay.time "Description for this variable only in SW documentation possible not in asap2" UWORD SAB_T_TIMER_10MS_S2_S3 1 100 0 655350 ECU_ADDRESS 0xFFF95DF4 DISPLAY_IDENTIFIER time.tmr_CAN1BusDiagDelay.CAN_Handling._.ZFFSAB /end MEASUREMENT
/begin MEASUREMENT ZFFSAB._.CAN_Handling.tmr_CAN2BusDiagDelay.time "Description for this variable only in SW documentation possible not in asap2" UWORD SAB_T_TIMER_10MS_S2_S3 1 100 0 655350 ECU_ADDRESS 0xFFF95DF6 DISPLAY_IDENTIFIER time.tmr_CAN2BusDiagDelay.CAN_Handling._.ZFFSAB /end MEASUREMENT
/begin MEASUREMENT ZFFSAB._.CAN_Handling.tmr_DiagAfterKL15.time "Description for this variable only in SW documentation possible not in asap2" UWORD SAB_T_TIMER_10MS_S2_S3 1 100 0 655350 ECU_ADDRESS 0xFFF95DF2 DISPLAY_IDENTIFIER time.tmr_DiagAfterKL15.CAN_Handling._.ZFFSAB /end MEASUREMENT
/begin MEASUREMENT ZFFSAB._.CAN_SwitchingIn.ACAN_FACAN "intermediate variable which describes if ACAN(0)FACAN(1)is chosen or both are faulty(3)" UBYTE SAB_STANDARD_S2_S3 1 100 0 255 ECU_ADDRESS 0xFFF9594F DISPLAY_IDENTIFIER ACAN_FACAN.CAN_SwitchingIn._.ZFFSAB /end MEASUREMENT
/begin MEASUREMENT ZFFSAB._.CAN_SwitchingIn.CANA_Sts "this variable determines the Status of all ACAN DME Messages" UBYTE SAB_STANDARD_S2_S3 1 100 0 255 ECU_ADDRESS 0xFFF95950 DISPLAY_IDENTIFIER CANA_Sts.CAN_SwitchingIn._.ZFFSAB /end MEASUREMENT
/begin MEASUREMENT ZFFSAB._.CAN_SwitchingIn.CANFA_Sts "this variable determines the Status of all FACAN DME Messages" UBYTE SAB_STANDARD_S2_S3 1 100 0 255 ECU_ADDRESS 0xFFF95951 DISPLAY_IDENTIFIER CANFA_Sts.CAN_SwitchingIn._.ZFFSAB /end MEASUREMENT
/begin MEASUREMENT ZFFSAB._.CAN_SwitchingIn.LastCycleFaulty "this variable determines if there was a faulty CAN in last cycle" UBYTE SAB_STANDARD_S2_S3 1 100 0 1 ECU_ADDRESS 0xFFF95952 DISPLAY_IDENTIFIER LastCycleFaulty.CAN_SwitchingIn._.ZFFSAB /end MEASUREMENT
/begin MEASUREMENT ZFFSAB._.CAN_SwitchingIn.sv_ACAN_FACAN_Static "Output variable to CAN with the information which CAN is used A(0) FA(1) both faulty (3)" UBYTE SAB_STANDARD_S2_S3 1 100 0 255 ECU_ADDRESS 0xFFF9594D DISPLAY_IDENTIFIER sv_ACAN_FACAN_Static.CAN_SwitchingIn._.ZFFSAB /end MEASUREMENT
/begin MEASUREMENT ZFFSAB._.CAN_SwitchingIn.sv_f_ACAN_Or_FACAN_Active "Output variable to SAB2. Returns 0 if ACAN or 1 if FACAN is active" UBYTE SAB_STANDARD_S2_S3 1 100 0 1 ECU_ADDRESS 0xFFF9594E DISPLAY_IDENTIFIER sv_f_ACAN_Or_FACAN_Active.CAN_SwitchingIn._.ZFFSAB /end MEASUREMENT
/begin MEASUREMENT ZFFSAB._.CAN_SwitchingIn.tmr_CAN_HYS.time "Description for this variable only in SW documentation possible not in asap2" UBYTE SAB_T_TIMER_10MS_S2_S3 1 100 0 2550 ECU_ADDRESS 0xFFF95938 DISPLAY_IDENTIFIER time.tmr_CAN_HYS.CAN_SwitchingIn._.ZFFSAB /end MEASUREMENT
/begin MEASUREMENT ZFFSAB._.ChargeConditionIn.f_ChargeErr "Error flag of Charge-signal" UBYTE SAB_STANDARD_S2_S3 1 100 0 1 ECU_ADDRESS 0xFFF96E9D DISPLAY_IDENTIFIER f_ChargeErr.ChargeConditionIn._.ZFFSAB /end MEASUREMENT
/begin MEASUREMENT ZFFSAB._.ChargeConditionIn.iv_Charge "Input raw signal of charging condition high voltage storage" UWORD SAB_PROZENT10_S2_S3 1 100 0 100 ECU_ADDRESS 0xFFF96E98 DISPLAY_IDENTIFIER iv_Charge.ChargeConditionIn._.ZFFSAB /end MEASUREMENT
/begin MEASUREMENT ZFFSAB._.ChargeConditionIn.iv_ChargeSts "Input CAN message status of charging condition high voltage storage" UBYTE SAB_STANDARD_S2_S3 1 100 0 255 ECU_ADDRESS 0xFFF96E9A DISPLAY_IDENTIFIER iv_ChargeSts.ChargeConditionIn._.ZFFSAB /end MEASUREMENT
/begin MEASUREMENT ZFFSAB._.ChargeConditionIn.sv_Charge "Output signal of charging condition high voltage storage" UBYTE SAB_PROZENT_S2_S3 1 100 0 100 ECU_ADDRESS 0xFFF96E9B DISPLAY_IDENTIFIER sv_Charge.ChargeConditionIn._.ZFFSAB /end MEASUREMENT
/begin MEASUREMENT ZFFSAB._.ChargeConditionIn.sv_ChargeSts "Output status signal of charging condition high voltage storage" UBYTE SAB_STANDARD_S2_S3 1 100 0 2 ECU_ADDRESS 0xFFF96E9C DISPLAY_IDENTIFIER sv_ChargeSts.ChargeConditionIn._.ZFFSAB /end MEASUREMENT
/begin MEASUREMENT ZFFSAB._.Coding.iv_CodingAppl "This variable provides the value of GET_CODING0x3000 means NIC" UWORD SAB_STANDARD_S2_S3 1 100 0 65535 ECU_ADDRESS 0xFFF95958 DISPLAY_IDENTIFIER iv_CodingAppl.Coding._.ZFFSAB /end MEASUREMENT
/begin MEASUREMENT ZFFSAB._.Coding.iv_CodingElectrical "This variable provides the value of GET_CODING0x3001 means Coding" UWORD SAB_STANDARD_S2_S3 1 100 0 65535 ECU_ADDRESS 0xFFF9595A DISPLAY_IDENTIFIER iv_CodingElectrical.Coding._.ZFFSAB /end MEASUREMENT
/begin MEASUREMENT ZFFSAB._.Coding.sv_AGS_Codierung "This variable provides the bitmasked high byte of GET_CODING(0x3000) to the AGS Layer LayerIn_Codierung" UBYTE SAB_STANDARD_S2_S3 1 100 0 255 ECU_ADDRESS 0xFFF95964 DISPLAY_IDENTIFIER sv_AGS_Codierung.Coding._.ZFFSAB /end MEASUREMENT
/begin MEASUREMENT ZFFSAB._.Coding.sv_AGS_CodierungOBD "Output to the AGS Layer LayerIn_CodierungOBD" UBYTE SAB_STANDARD_S2_S3 1 100 0 255 ECU_ADDRESS 0xFFF95965 DISPLAY_IDENTIFIER sv_AGS_CodierungOBD.Coding._.ZFFSAB /end MEASUREMENT
/begin MEASUREMENT ZFFSAB._.Coding.sv_Coding3000 "This variable provides the information of address 0x3000 from the _GET_CODING interface" UWORD SAB_STANDARD_S2_S3 1 100 0 255 ECU_ADDRESS 0xFFF9595C DISPLAY_IDENTIFIER sv_Coding3000.Coding._.ZFFSAB /end MEASUREMENT
/begin MEASUREMENT ZFFSAB._.Coding.sv_Coding3001 "This variable provides the information of address 0x3001 from the _GET_CODING interface" UWORD SAB_STANDARD_S2_S3 1 100 0 255 ECU_ADDRESS 0xFFF9595E DISPLAY_IDENTIFIER sv_Coding3001.Coding._.ZFFSAB /end MEASUREMENT
/begin MEASUREMENT ZFFSAB._.Coding.sv_VarCode_MILCycles "This variable provides information of macro GET_CODING_MIL_CYCLES: 0=Activate MIL-Lamp in 2.DC 1=Activate MIL-Lamp in 3.DC" UBYTE SAB_STANDARD_S2_S3 1 100 0 1 ECU_ADDRESS 0xFFF95961 DISPLAY_IDENTIFIER sv_VarCode_MILCycles.Coding._.ZFFSAB /end MEASUREMENT
/begin MEASUREMENT ZFFSAB._.Coding.sv_VarCode_MILLamp "This variable provides information of macro GET_CODING_MIL_LAMP: 0=Deactivate MIL-Control (OBD) 1=Activate MIL-Control (EOBD)" UBYTE SAB_STANDARD_S2_S3 1 100 0 255 ECU_ADDRESS 0xFFF95962 DISPLAY_IDENTIFIER sv_VarCode_MILLamp.Coding._.ZFFSAB /end MEASUREMENT
/begin MEASUREMENT ZFFSAB._.Coding.sv_VarCode_NIC "This variable provides the information of the NIC Status at the adress 0x3000 from the _GET_CODING interface: 0=NIC deactive 1=NIC active" UBYTE SAB_STANDARD_S2_S3 1 100 0 2 ECU_ADDRESS 0xFFF95960 DISPLAY_IDENTIFIER sv_VarCode_NIC.Coding._.ZFFSAB /end MEASUREMENT
/begin MEASUREMENT ZFFSAB._.Coding.sv_VarCode_Scantool_Enable "This variable provides information of macro GET_CODING_SCANTOOL_ENABLE: 0=Deactivate Scantool-Output 1=Activate Scantool-Output" UBYTE SAB_STANDARD_S2_S3 1 100 0 255 ECU_ADDRESS 0xFFF95963 DISPLAY_IDENTIFIER sv_VarCode_Scantool_Enable.Coding._.ZFFSAB /end MEASUREMENT
/begin MEASUREMENT ZFFSAB._.ComConditionsIn.Preconditions "Output signal of ComConditionsIn" UWORD SAB_STANDARD_S2_S3 1 100 0 65535 ECU_ADDRESS 0xFFF95EFA DISPLAY_IDENTIFIER Preconditions.ComConditionsIn._.ZFFSAB /end MEASUREMENT
/begin MEASUREMENT ZFFSAB._.ComConditionsIn.iv_PreConEWS "state of immobilizer (EWS): 0 = blocked 1 = free 2 = init 3 = reset" UBYTE SAB_STANDARD_S2_S3 1 100 0 3 ECU_ADDRESS 0xFFF95EF9 DISPLAY_IDENTIFIER iv_PreConEWS.ComConditionsIn._.ZFFSAB /end MEASUREMENT
/begin MEASUREMENT ZFFSAB._.ComConditionsIn.iv_PreConKL15CanSts "Input value value of terminal 15 status" UBYTE SAB_STANDARD_S2_S3 1 100 0 255 ECU_ADDRESS 0xFFF95EF8 DISPLAY_IDENTIFIER iv_PreConKL15CanSts.ComConditionsIn._.ZFFSAB /end MEASUREMENT
/begin MEASUREMENT ZFFSAB._.CrankShaftCurTorqueIn.f_CrankErr "Error flag for current torque of crankshaft" UBYTE SAB_STANDARD_S2_S3 1 100 0 1 ECU_ADDRESS 0xFFF8DA20 DISPLAY_IDENTIFIER f_CrankErr.CrankShaftCurTorqueIn._.ZFFSAB /end MEASUREMENT
/begin MEASUREMENT ZFFSAB._.CrankShaftCurTorqueIn.f_m_IstEMErr "Error flag for local diagnosis" UBYTE SAB_STANDARD_S2_S3 1 100 0 1 ECU_ADDRESS 0xFFF8DA26 DISPLAY_IDENTIFIER f_m_IstEMErr.CrankShaftCurTorqueIn._.ZFFSAB /end MEASUREMENT
/begin MEASUREMENT ZFFSAB._.CrankShaftCurTorqueIn.f_m_IstEMErr_ "Complement Error flag for local diagnosis" UBYTE SAB_STANDARD_S2_S3 1 100 0 1 ECU_ADDRESS 0xFFF8DA27 DISPLAY_IDENTIFIER f_m_IstEMErr_.CrankShaftCurTorqueIn._.ZFFSAB /end MEASUREMENT
/begin MEASUREMENT ZFFSAB._.CrankShaftCurTorqueIn.f_m_IstEMLev2Err "Error flag for local diagnosis" UBYTE SAB_STANDARD_S2_S3 1 100 0 1 ECU_ADDRESS 0xFFF8DA30 DISPLAY_IDENTIFIER f_m_IstEMLev2Err.CrankShaftCurTorqueIn._.ZFFSAB /end MEASUREMENT
/begin MEASUREMENT ZFFSAB._.CrankShaftCurTorqueIn.f_m_IstEMLev2Err_ "Complement Error flag for local diagnosis" UBYTE SAB_STANDARD_S2_S3 1 100 0 255 ECU_ADDRESS 0xFFF8DA31 DISPLAY_IDENTIFIER f_m_IstEMLev2Err_.CrankShaftCurTorqueIn._.ZFFSAB /end MEASUREMENT
/begin MEASUREMENT ZFFSAB._.CrankShaftCurTorqueIn.f_m_IstVMErr "Error flag for local diagnosis" UBYTE SAB_STANDARD_S2_S3 1 100 0 1 ECU_ADDRESS 0xFFF8DA25 DISPLAY_IDENTIFIER f_m_IstVMErr.CrankShaftCurTorqueIn._.ZFFSAB /end MEASUREMENT
/begin MEASUREMENT ZFFSAB._.CrankShaftCurTorqueIn.f_m_IstVMLev2Err "Error flag for local diagnosis" UBYTE SAB_STANDARD_S2_S3 1 100 0 1 ECU_ADDRESS 0xFFF8DA2E DISPLAY_IDENTIFIER f_m_IstVMLev2Err.CrankShaftCurTorqueIn._.ZFFSAB /end MEASUREMENT
/begin MEASUREMENT ZFFSAB._.CrankShaftCurTorqueIn.f_m_IstVMLev2Err_ "Complement Error flag for local diagnosis" UBYTE SAB_STANDARD_S2_S3 1 100 0 255 ECU_ADDRESS 0xFFF8DA2F DISPLAY_IDENTIFIER f_m_IstVMLev2Err_.CrankShaftCurTorqueIn._.ZFFSAB /end MEASUREMENT
/begin MEASUREMENT ZFFSAB._.CrankShaftCurTorqueIn.iv_m_Crank "Input value of current torque of crankshaft from CAN" UWORD SAB_M_NM2_M2047_S2_S3 1 100 -1023.5 1023.5 ECU_ADDRESS 0xFFF8DA32 DISPLAY_IDENTIFIER iv_m_Crank.CrankShaftCurTorqueIn._.ZFFSAB /end MEASUREMENT
/begin MEASUREMENT ZFFSAB._.CrankShaftCurTorqueIn.iv_m_CrankSts "Input value message status of current torque of crankshaft" UBYTE SAB_STANDARD_S2_S3 1 100 0 255 ECU_ADDRESS 0xFFF8DA36 DISPLAY_IDENTIFIER iv_m_CrankSts.CrankShaftCurTorqueIn._.ZFFSAB /end MEASUREMENT
/begin MEASUREMENT ZFFSAB._.CrankShaftCurTorqueIn.iv_m_CrankSts_ "Input value message status of current torque of crankshaft" UBYTE SAB_STANDARD_S2_S3 1 100 0 255 ECU_ADDRESS 0xFFF8DA37 DISPLAY_IDENTIFIER iv_m_CrankSts_.CrankShaftCurTorqueIn._.ZFFSAB /end MEASUREMENT
/begin MEASUREMENT ZFFSAB._.CrankShaftCurTorqueIn.iv_m_Crank_ "Input value of current torque of crankshaft from CAN (Complement)" UWORD SAB_STANDARD_S2_S3 1 100 0 4094 ECU_ADDRESS 0xFFF8DA34 DISPLAY_IDENTIFIER iv_m_Crank_.CrankShaftCurTorqueIn._.ZFFSAB /end MEASUREMENT
/begin MEASUREMENT ZFFSAB._.CrankShaftCurTorqueIn.iv_m_IstEM "Input value of current crankshaft torque from CAN - but only the electrical machine is considered" UWORD SAB_M_NM2_M2047_S2_S3 1 100 -1023.5 1023.5 ECU_ADDRESS 0xFFF8DA40 DISPLAY_IDENTIFIER iv_m_IstEM.CrankShaftCurTorqueIn._.ZFFSAB /end MEASUREMENT
/begin MEASUREMENT ZFFSAB._.CrankShaftCurTorqueIn.iv_m_IstEMSts "Input value of current crankshaft torque from CAN - but only the electrical machine is considered" UBYTE SAB_STANDARD_S2_S3 1 100 0 255 ECU_ADDRESS 0xFFF8DA44 DISPLAY_IDENTIFIER iv_m_IstEMSts.CrankShaftCurTorqueIn._.ZFFSAB /end MEASUREMENT
/begin MEASUREMENT ZFFSAB._.CrankShaftCurTorqueIn.iv_m_IstEMSts_ "Input value of current crankshaft torque from CAN - but only the electrical machine is considered" UBYTE SAB_STANDARD_S2_S3 1 100 0 255 ECU_ADDRESS 0xFFF8DA45 DISPLAY_IDENTIFIER iv_m_IstEMSts_.CrankShaftCurTorqueIn._.ZFFSAB /end MEASUREMENT
/begin MEASUREMENT ZFFSAB._.CrankShaftCurTorqueIn.iv_m_IstEM_ "Input value of current crankshaft torque from CAN - but only the electrical machine is considered" UWORD SAB_STANDARD_S2_S3 1 100 0 65535 ECU_ADDRESS 0xFFF8DA42 DISPLAY_IDENTIFIER iv_m_IstEM_.CrankShaftCurTorqueIn._.ZFFSAB /end MEASUREMENT
/begin MEASUREMENT ZFFSAB._.CrankShaftCurTorqueIn.iv_m_IstVM "Input value of current crankshaft torque from CAN - but only combustion machine is considered" UWORD SAB_M_NM2_M2047_S2_S3 1 100 -1023.5 1023.5 ECU_ADDRESS 0xFFF8DA3A DISPLAY_IDENTIFIER iv_m_IstVM.CrankShaftCurTorqueIn._.ZFFSAB /end MEASUREMENT
/begin MEASUREMENT ZFFSAB._.CrankShaftCurTorqueIn.iv_m_IstVMSts "Input value of current torque of crankshaft from CAN - but only combustion machine is considered" UBYTE SAB_STANDARD_S2_S3 1 100 0 255 ECU_ADDRESS 0xFFF8DA3E DISPLAY_IDENTIFIER iv_m_IstVMSts.CrankShaftCurTorqueIn._.ZFFSAB /end MEASUREMENT
/begin MEASUREMENT ZFFSAB._.CrankShaftCurTorqueIn.iv_m_IstVMSts_ "Input value of current torque of crankshaft from CAN - but only combustion machine is considered" UBYTE SAB_STANDARD_S2_S3 1 100 0 255 ECU_ADDRESS 0xFFF8DA3F DISPLAY_IDENTIFIER iv_m_IstVMSts_.CrankShaftCurTorqueIn._.ZFFSAB /end MEASUREMENT
/begin MEASUREMENT ZFFSAB._.CrankShaftCurTorqueIn.iv_m_IstVM_ "Input value of current crankshaft torque from CAN - but only combustion machine is considered" UWORD SAB_STANDARD_S2_S3 1 100 0 65535 ECU_ADDRESS 0xFFF8DA3C DISPLAY_IDENTIFIER iv_m_IstVM_.CrankShaftCurTorqueIn._.ZFFSAB /end MEASUREMENT
/begin MEASUREMENT ZFFSAB._.CrankShaftCurTorqueIn.iv_m_PumpCensored "Input value of pump intake torque with coefficient from class PumpIntakeTorqueOut" SWORD SAB_M_1NM_S2_S3 1 100 0 30 ECU_ADDRESS 0xFFF8DA38 DISPLAY_IDENTIFIER iv_m_PumpCensored.CrankShaftCurTorqueIn._.ZFFSAB /end MEASUREMENT
/begin MEASUREMENT ZFFSAB._.CrankShaftCurTorqueIn.m_CrankCor "Intermediate value converted quantisation of current torque of crankshaft" SWORD SAB_M_1NM_S2_S3 1 100 -2048 2047.875 ECU_ADDRESS 0xFFF8DA22 DISPLAY_IDENTIFIER m_CrankCor.CrankShaftCurTorqueIn._.ZFFSAB /end MEASUREMENT
/begin MEASUREMENT ZFFSAB._.CrankShaftCurTorqueIn.m_CrankSts_ "Complement of signal status of current torque of crankshaft" UBYTE SAB_STANDARD_S2_S3 1 100 0 255 ECU_ADDRESS 0xFFF8DA24 DISPLAY_IDENTIFIER m_CrankSts_.CrankShaftCurTorqueIn._.ZFFSAB /end MEASUREMENT
/begin MEASUREMENT ZFFSAB._.CrankShaftCurTorqueIn.m_IstEM1 "Intermediate value converted quantisation of current torque of crankshaft from electric machine" SWORD SAB_M_1NM_S2_S3 1 100 -2048 2047 ECU_ADDRESS 0xFFF8DA2A DISPLAY_IDENTIFIER m_IstEM1.CrankShaftCurTorqueIn._.ZFFSAB /end MEASUREMENT
/begin MEASUREMENT ZFFSAB._.CrankShaftCurTorqueIn.m_IstEM1Lev2 "Intermediate value converted quantisation of current torque of crankshaft from electric machine" SWORD SAB_M_1NM_S2_S3 1 100 -2048 2047 ECU_ADDRESS 0xFFF8DA2C DISPLAY_IDENTIFIER m_IstEM1Lev2.CrankShaftCurTorqueIn._.ZFFSAB /end MEASUREMENT
/begin MEASUREMENT ZFFSAB._.CrankShaftCurTorqueIn.m_IstVMCor "Intermediate value converted quantisation of current torque of crankshaft from combustion machine" SWORD SAB_M_1NM_S2_S3 1 100 -2048 2047 ECU_ADDRESS 0xFFF8DA28 DISPLAY_IDENTIFIER m_IstVMCor.CrankShaftCurTorqueIn._.ZFFSAB /end MEASUREMENT
/begin MEASUREMENT ZFFSAB._.CrankShaftCurTorqueIn.sv_AGS_MMotIst "Output value of Actual engine torque of crankshaft for LayerAGS" SWORD SAB_M_1NM_S2_S3 1 100 -8192 8192 ECU_ADDRESS 0xFFF8DA66 DISPLAY_IDENTIFIER sv_AGS_MMotIst.CrankShaftCurTorqueIn._.ZFFSAB /end MEASUREMENT
/begin MEASUREMENT ZFFSAB._.CrankShaftCurTorqueIn.sv_AGS_MVm "Output value of current torque of crankshaft for LayerAGS - only combustion machine is considered" SWORD SAB_M_NM2_S2_S3 1 100 -1023.5 1023.5 ECU_ADDRESS 0xFFF8DA64 DISPLAY_IDENTIFIER sv_AGS_MVm.CrankShaftCurTorqueIn._.ZFFSAB /end MEASUREMENT
/begin MEASUREMENT ZFFSAB._.CrankShaftCurTorqueIn.sv_m_Crank "Output value of current torque of crankshaft corrected by the pump intake torque" SWORD SAB_M_1NM_S2_S3 1 100 -400 1640 ECU_ADDRESS 0xFFF8DA46 DISPLAY_IDENTIFIER sv_m_Crank.CrankShaftCurTorqueIn._.ZFFSAB /end MEASUREMENT
/begin MEASUREMENT ZFFSAB._.CrankShaftCurTorqueIn.sv_m_CrankLev2 "Output value of current torque of crankshaft corrected by the pump intake torque (Complement)" SWORD SAB_M_1NM_S2_S3 1 100 -400 1640 ECU_ADDRESS 0xFFF8DA48 DISPLAY_IDENTIFIER sv_m_CrankLev2.CrankShaftCurTorqueIn._.ZFFSAB /end MEASUREMENT
/begin MEASUREMENT ZFFSAB._.CrankShaftCurTorqueIn.sv_m_CrankLev2_ "Output value of current torque of crankshaft corrected by the pump intake torque (Complement)" SWORD SAB_STANDARD_S2_S3 1 100 -1024 1023 ECU_ADDRESS 0xFFF8DA4A DISPLAY_IDENTIFIER sv_m_CrankLev2_.CrankShaftCurTorqueIn._.ZFFSAB /end MEASUREMENT
/begin MEASUREMENT ZFFSAB._.CrankShaftCurTorqueIn.sv_m_CrankSts "Output value signal status of current torque of crankshaft" UBYTE SAB_STANDARD_S2_S3 1 100 0 2 ECU_ADDRESS 0xFFF8DA4C DISPLAY_IDENTIFIER sv_m_CrankSts.CrankShaftCurTorqueIn._.ZFFSAB /end MEASUREMENT
/begin MEASUREMENT ZFFSAB._.CrankShaftCurTorqueIn.sv_m_Ind "Output value of current torque of crankshaft" UWORD SAB_M_1NM_S2_S3 1 100 0 3101 ECU_ADDRESS 0xFFF8DA4E DISPLAY_IDENTIFIER sv_m_Ind.CrankShaftCurTorqueIn._.ZFFSAB /end MEASUREMENT
/begin MEASUREMENT ZFFSAB._.CrankShaftCurTorqueIn.sv_m_IstEM "Output value of current torque - only electrical machine is considered" SWORD SAB_M_1NM_S2_S3 1 100 -400 1640 ECU_ADDRESS 0xFFF8DA54 DISPLAY_IDENTIFIER sv_m_IstEM.CrankShaftCurTorqueIn._.ZFFSAB /end MEASUREMENT
/begin MEASUREMENT ZFFSAB._.CrankShaftCurTorqueIn.sv_m_IstEMLev2 "Output value of current torque - only electrical machine is considered" SWORD SAB_M_1NM_S2_S3 1 100 -400 1640 ECU_ADDRESS 0xFFF8DA5E DISPLAY_IDENTIFIER sv_m_IstEMLev2.CrankShaftCurTorqueIn._.ZFFSAB /end MEASUREMENT
/begin MEASUREMENT ZFFSAB._.CrankShaftCurTorqueIn.sv_m_IstEMLev2Sts "Output status of current torque from electrical machine" UBYTE SAB_STANDARD_S2_S3 1 100 0 2 ECU_ADDRESS 0xFFF8DA62 DISPLAY_IDENTIFIER sv_m_IstEMLev2Sts.CrankShaftCurTorqueIn._.ZFFSAB /end MEASUREMENT
/begin MEASUREMENT ZFFSAB._.CrankShaftCurTorqueIn.sv_m_IstEMLev2Sts_ "Output status of current torque from electrical machine" UBYTE SAB_STANDARD_S2_S3 1 100 0 255 ECU_ADDRESS 0xFFF8DA63 DISPLAY_IDENTIFIER sv_m_IstEMLev2Sts_.CrankShaftCurTorqueIn._.ZFFSAB /end MEASUREMENT
/begin MEASUREMENT ZFFSAB._.CrankShaftCurTorqueIn.sv_m_IstEMLev2_ "Output value of current torque - only electrical machine is considered" SWORD SAB_STANDARD_S2_S3 1 100 -32768 32767 ECU_ADDRESS 0xFFF8DA60 DISPLAY_IDENTIFIER sv_m_IstEMLev2_.CrankShaftCurTorqueIn._.ZFFSAB /end MEASUREMENT
/begin MEASUREMENT ZFFSAB._.CrankShaftCurTorqueIn.sv_m_IstEMSts "Output status of current torque from electrical machine" UBYTE SAB_STANDARD_S2_S3 1 100 0 2 ECU_ADDRESS 0xFFF8DA56 DISPLAY_IDENTIFIER sv_m_IstEMSts.CrankShaftCurTorqueIn._.ZFFSAB /end MEASUREMENT
/begin MEASUREMENT ZFFSAB._.CrankShaftCurTorqueIn.sv_m_IstVM "Output value of current torque of crankshaft - only combustion machine is considered" SWORD SAB_M_1NM_S2_S3 1 100 -400 1640 ECU_ADDRESS 0xFFF8DA50 DISPLAY_IDENTIFIER sv_m_IstVM.CrankShaftCurTorqueIn._.ZFFSAB /end MEASUREMENT
/begin MEASUREMENT ZFFSAB._.CrankShaftCurTorqueIn.sv_m_IstVMLev2 "Output value of current torque of crankshaft - only combustion machine is considered" SWORD SAB_M_1NM_S2_S3 1 100 -400 1640 ECU_ADDRESS 0xFFF8DA58 DISPLAY_IDENTIFIER sv_m_IstVMLev2.CrankShaftCurTorqueIn._.ZFFSAB /end MEASUREMENT
/begin MEASUREMENT ZFFSAB._.CrankShaftCurTorqueIn.sv_m_IstVMLev2Sts "Output status of current torque of crankshaft - but only combustion machine is considered" UBYTE SAB_STANDARD_S2_S3 1 100 0 2 ECU_ADDRESS 0xFFF8DA5C DISPLAY_IDENTIFIER sv_m_IstVMLev2Sts.CrankShaftCurTorqueIn._.ZFFSAB /end MEASUREMENT
/begin MEASUREMENT ZFFSAB._.CrankShaftCurTorqueIn.sv_m_IstVMLev2Sts_ "Output status of current torque of crankshaft - but only combustion machine is considered" UBYTE SAB_STANDARD_S2_S3 1 100 0 255 ECU_ADDRESS 0xFFF8DA5D DISPLAY_IDENTIFIER sv_m_IstVMLev2Sts_.CrankShaftCurTorqueIn._.ZFFSAB /end MEASUREMENT
/begin MEASUREMENT ZFFSAB._.CrankShaftCurTorqueIn.sv_m_IstVMLev2_ "Output value of current torque of crankshaft - only combustion machine is considered" SWORD SAB_STANDARD_S2_S3 1 100 -32768 32767 ECU_ADDRESS 0xFFF8DA5A DISPLAY_IDENTIFIER sv_m_IstVMLev2_.CrankShaftCurTorqueIn._.ZFFSAB /end MEASUREMENT
/begin MEASUREMENT ZFFSAB._.CrankShaftCurTorqueIn.sv_m_IstVMSts "Output status of current torque of crankshaft - but only combustion machine is considered" UBYTE SAB_STANDARD_S2_S3 1 100 0 2 ECU_ADDRESS 0xFFF8DA52 DISPLAY_IDENTIFIER sv_m_IstVMSts.CrankShaftCurTorqueIn._.ZFFSAB /end MEASUREMENT
/begin MEASUREMENT ZFFSAB._.CurWheelTrqIn.f_M_RadIstErr "Error flag of cross acceleration" UBYTE SAB_STANDARD_S2_S3 1 100 0 1 ECU_ADDRESS 0xFFF96E97 DISPLAY_IDENTIFIER f_M_RadIstErr.CurWheelTrqIn._.ZFFSAB /end MEASUREMENT
/begin MEASUREMENT ZFFSAB._.CurWheelTrqIn.iv_M_RadIst "Input value cross acceleration from CAN" UWORD SAB_M_1NM_M32000_S2_S3 1 100 -32000 33535 ECU_ADDRESS 0xFFF96E90 DISPLAY_IDENTIFIER iv_M_RadIst.CurWheelTrqIn._.ZFFSAB /end MEASUREMENT
/begin MEASUREMENT ZFFSAB._.CurWheelTrqIn.iv_M_RadIstQF "Input value qualifier of cross acceleration" UBYTE SAB_STANDARD_S2_S3 1 100 0 255 ECU_ADDRESS 0xFFF96E8E DISPLAY_IDENTIFIER iv_M_RadIstQF.CurWheelTrqIn._.ZFFSAB /end MEASUREMENT
/begin MEASUREMENT ZFFSAB._.CurWheelTrqIn.iv_M_RadIstSts "Input value message status of cross acceleration" UBYTE SAB_STANDARD_S2_S3 1 100 0 255 ECU_ADDRESS 0xFFF96E92 DISPLAY_IDENTIFIER iv_M_RadIstSts.CurWheelTrqIn._.ZFFSAB /end MEASUREMENT
/begin MEASUREMENT ZFFSAB._.CurWheelTrqIn.sv_M_RadIst "Output value cross acceleration" UWORD SAB_M_1NM_M32000_S2_S3 1 100 -32000 32000 ECU_ADDRESS 0xFFF96E94 DISPLAY_IDENTIFIER sv_M_RadIst.CurWheelTrqIn._.ZFFSAB /end MEASUREMENT
/begin MEASUREMENT ZFFSAB._.CurWheelTrqIn.sv_M_RadIstSts "Output value signal status of cross acceleration" UBYTE SAB_STANDARD_S2_S3 1 100 0 2 ECU_ADDRESS 0xFFF96E96 DISPLAY_IDENTIFIER sv_M_RadIstSts.CurWheelTrqIn._.ZFFSAB /end MEASUREMENT
/begin MEASUREMENT ZFFSAB._.DesiredTorqueIn.f_m_DSCErr "Error flag for desired torque calculated from iv_m_DSCRangePositiveDesSts and iv_m_DSCDes and iv_m_DSCStsDes" UBYTE SAB_STANDARD_S2_S3 1 100 0 255 ECU_ADDRESS 0xFFF8DA9C DISPLAY_IDENTIFIER f_m_DSCErr.DesiredTorqueIn._.ZFFSAB /end MEASUREMENT
/begin MEASUREMENT ZFFSAB._.DesiredTorqueIn.f_m_EngDesEMErr "Error flag for desired torque calculated from iv_m_DriverDesEM" UBYTE SAB_STANDARD_S2_S3 1 100 0 1 ECU_ADDRESS 0xFFF8DAC0 DISPLAY_IDENTIFIER f_m_EngDesEMErr.DesiredTorqueIn._.ZFFSAB /end MEASUREMENT
/begin MEASUREMENT ZFFSAB._.DesiredTorqueIn.f_m_EngDesErr "Error flag for desired torque calculated from iv_m_DriverDes" UBYTE SAB_STANDARD_S2_S3 1 100 0 1 ECU_ADDRESS 0xFFF8DAC5 DISPLAY_IDENTIFIER f_m_EngDesErr.DesiredTorqueIn._.ZFFSAB /end MEASUREMENT
/begin MEASUREMENT ZFFSAB._.DesiredTorqueIn.f_m_EngDesErr_ "Complement of Error flag for desired torque calculated from iv_m_DriverDes" UBYTE SAB_STANDARD_S2_S3 1 100 254 255 ECU_ADDRESS 0xFFF8DABC DISPLAY_IDENTIFIER f_m_EngDesErr_.DesiredTorqueIn._.ZFFSAB /end MEASUREMENT
/begin MEASUREMENT ZFFSAB._.DesiredTorqueIn.f_m_EngDesLev2Err "Error flag for desired torque calculated from iv_m_DriverDes" UBYTE SAB_STANDARD_S2_S3 1 100 0 1 ECU_ADDRESS 0xFFF8DAB4 DISPLAY_IDENTIFIER f_m_EngDesLev2Err.DesiredTorqueIn._.ZFFSAB /end MEASUREMENT
/begin MEASUREMENT ZFFSAB._.DesiredTorqueIn.f_m_EngDesLev2Err_ "Complement Error flag for desired torque calculated from iv_m_DriverDes" UBYTE SAB_STANDARD_S2_S3 1 100 0 255 ECU_ADDRESS 0xFFF8DAB5 DISPLAY_IDENTIFIER f_m_EngDesLev2Err_.DesiredTorqueIn._.ZFFSAB /end MEASUREMENT
/begin MEASUREMENT ZFFSAB._.DesiredTorqueIn.f_m_EngDesVMErr "Error flag for desired torque calculated from iv_m_DriverDesVM" UBYTE SAB_STANDARD_S2_S3 1 100 0 1 ECU_ADDRESS 0xFFF8DABD DISPLAY_IDENTIFIER f_m_EngDesVMErr.DesiredTorqueIn._.ZFFSAB /end MEASUREMENT
/begin MEASUREMENT ZFFSAB._.DesiredTorqueIn.f_m_MaxIncrVMErr "Error flag for setting range of torque from combustion engine" UBYTE SAB_STANDARD_S2_S3 1 100 0 1 ECU_ADDRESS 0xFFF8DAC4 DISPLAY_IDENTIFIER f_m_MaxIncrVMErr.DesiredTorqueIn._.ZFFSAB /end MEASUREMENT
/begin MEASUREMENT ZFFSAB._.DesiredTorqueIn.iv_m_DriverDes "Input value for desired torque" UWORD SAB_M_NM2_M2047_S2_S3 1 100 -1023.5 1023.5 ECU_ADDRESS 0xFFF8DA6C DISPLAY_IDENTIFIER iv_m_DriverDes.DesiredTorqueIn._.ZFFSAB /end MEASUREMENT
/begin MEASUREMENT ZFFSAB._.DesiredTorqueIn.iv_m_DriverDesEM "Input value of desired torque from electrical machine" UWORD SAB_M_NM2_M2047_S2_S3 1 100 -1023.5 1023.5 ECU_ADDRESS 0xFFF8DA7A DISPLAY_IDENTIFIER iv_m_DriverDesEM.DesiredTorqueIn._.ZFFSAB /end MEASUREMENT
/begin MEASUREMENT ZFFSAB._.DesiredTorqueIn.iv_m_DriverDesEMSts "Input value for message status of CAN-message desired torque from electrical machine" UBYTE SAB_STANDARD_S2_S3 1 100 0 2 ECU_ADDRESS 0xFFF8DA7C DISPLAY_IDENTIFIER iv_m_DriverDesEMSts.DesiredTorqueIn._.ZFFSAB /end MEASUREMENT
/begin MEASUREMENT ZFFSAB._.DesiredTorqueIn.iv_m_DriverDesSts "Input value for message status of CAN-message" UBYTE SAB_STANDARD_S2_S3 1 100 0 255 ECU_ADDRESS 0xFFF8DA70 DISPLAY_IDENTIFIER iv_m_DriverDesSts.DesiredTorqueIn._.ZFFSAB /end MEASUREMENT
/begin MEASUREMENT ZFFSAB._.DesiredTorqueIn.iv_m_DriverDesSts_ "Input value for message status of CAN-message" UBYTE SAB_STANDARD_S2_S3 1 100 0 255 ECU_ADDRESS 0xFFF8DA71 DISPLAY_IDENTIFIER iv_m_DriverDesSts_.DesiredTorqueIn._.ZFFSAB /end MEASUREMENT
/begin MEASUREMENT ZFFSAB._.DesiredTorqueIn.iv_m_DriverDesVM "Input value for desired torque from combustion engine" UWORD SAB_M_NM2_M2047_S2_S3 1 100 -1023.5 1023.5 ECU_ADDRESS 0xFFF8DA76 DISPLAY_IDENTIFIER iv_m_DriverDesVM.DesiredTorqueIn._.ZFFSAB /end MEASUREMENT
/begin MEASUREMENT ZFFSAB._.DesiredTorqueIn.iv_m_DriverDesVMSts "Input value for message status of CAN-message desired torque from combustion engine" UBYTE SAB_STANDARD_S2_S3 1 100 0 2 ECU_ADDRESS 0xFFF8DA78 DISPLAY_IDENTIFIER iv_m_DriverDesVMSts.DesiredTorqueIn._.ZFFSAB /end MEASUREMENT
/begin MEASUREMENT ZFFSAB._.DesiredTorqueIn.iv_m_DriverDes_ "Complement input value for desired torque" UWORD SAB_STANDARD_S2_S3 1 100 0 65535 ECU_ADDRESS 0xFFF8DA6E DISPLAY_IDENTIFIER iv_m_DriverDes_.DesiredTorqueIn._.ZFFSAB /end MEASUREMENT
/begin MEASUREMENT ZFFSAB._.DesiredTorqueIn.iv_m_EngMax "Input value from HPSYS for max torque" SWORD SAB_M_1NM_S2_S3 1 100 -32768 32767 ECU_ADDRESS 0xFFF8DA72 DISPLAY_IDENTIFIER iv_m_EngMax.DesiredTorqueIn._.ZFFSAB /end MEASUREMENT
/begin MEASUREMENT ZFFSAB._.DesiredTorqueIn.iv_m_MaxIncrVM "Input value setting range of torque from combustion engine" UWORD SAB_M_NM2_M2047_S2_S3 1 100 -1023.5 1023.5 ECU_ADDRESS 0xFFF8DA7E DISPLAY_IDENTIFIER iv_m_MaxIncrVM.DesiredTorqueIn._.ZFFSAB /end MEASUREMENT
/begin MEASUREMENT ZFFSAB._.DesiredTorqueIn.iv_m_MaxIncrVMSts "Input value for message status of CAN-message setting range of torque from combustion engine" UBYTE SAB_STANDARD_S2_S3 1 100 0 255 ECU_ADDRESS 0xFFF8DA80 DISPLAY_IDENTIFIER iv_m_MaxIncrVMSts.DesiredTorqueIn._.ZFFSAB /end MEASUREMENT
/begin MEASUREMENT ZFFSAB._.DesiredTorqueIn.iv_m_PumpCensored "Input value of pump intake torque with coefficient from class PumpIntakeTorqueOut" SWORD SAB_M_1NM_S2_S3 1 100 -32768 32767 ECU_ADDRESS 0xFFF8DA74 DISPLAY_IDENTIFIER iv_m_PumpCensored.DesiredTorqueIn._.ZFFSAB /end MEASUREMENT
/begin MEASUREMENT ZFFSAB._.DesiredTorqueIn.m_DSCRangePositiveDesSts "Output Status value for desired torque range" UBYTE SAB_STANDARD_S2_S3 1 100 0 2 ECU_ADDRESS 0xFFF8DAA0 DISPLAY_IDENTIFIER m_DSCRangePositiveDesSts.DesiredTorqueIn._.ZFFSAB /end MEASUREMENT
/begin MEASUREMENT ZFFSAB._.DesiredTorqueIn.m_DSCStsDesSts "REPRESENT_INTERMEDIATE value for status of desired torque" UBYTE SAB_STANDARD_S2_S3 1 100 0 3 ECU_ADDRESS 0xFFF8DAA1 DISPLAY_IDENTIFIER m_DSCStsDesSts.DesiredTorqueIn._.ZFFSAB /end MEASUREMENT
/begin MEASUREMENT ZFFSAB._.DesiredTorqueIn.m_DriverDes "Intermediate value for desired torque" SWORD SAB_M_1NM_S2_S3 1 100 -1023 1023 ECU_ADDRESS 0xFFF8DAC6 DISPLAY_IDENTIFIER m_DriverDes.DesiredTorqueIn._.ZFFSAB /end MEASUREMENT
/begin MEASUREMENT ZFFSAB._.DesiredTorqueIn.m_DriverDesCor "intermediate value for desired torque" SWORD SAB_M_1NM_S2_S3 1 100 -1023 1023 ECU_ADDRESS 0xFFF8DAC8 DISPLAY_IDENTIFIER m_DriverDesCor.DesiredTorqueIn._.ZFFSAB /end MEASUREMENT
/begin MEASUREMENT ZFFSAB._.DesiredTorqueIn.m_DriverDesEM "Intermediate value for desired torque from electrical machine" SWORD SAB_M_1NM_S2_S3 1 100 -1023 1023 ECU_ADDRESS 0xFFF8DAC2 DISPLAY_IDENTIFIER m_DriverDesEM.DesiredTorqueIn._.ZFFSAB /end MEASUREMENT
/begin MEASUREMENT ZFFSAB._.DesiredTorqueIn.m_DriverDesEMSts "Status of desired torque from combustion electrical machine" UBYTE SAB_STANDARD_S2_S3 1 100 0 2 ECU_ADDRESS 0xFFF8DAAA DISPLAY_IDENTIFIER m_DriverDesEMSts.DesiredTorqueIn._.ZFFSAB /end MEASUREMENT
/begin MEASUREMENT ZFFSAB._.DesiredTorqueIn.m_DriverDesSts "Status of desired torque" UBYTE SAB_STANDARD_S2_S3 1 100 0 2 ECU_ADDRESS 0xFFF8DAA2 DISPLAY_IDENTIFIER m_DriverDesSts.DesiredTorqueIn._.ZFFSAB /end MEASUREMENT
/begin MEASUREMENT ZFFSAB._.DesiredTorqueIn.m_DriverDesVM "Intermediate value for desired torque from combustion machine" SWORD SAB_M_1NM_S2_S3 1 100 -1023 1023 ECU_ADDRESS 0xFFF8DABE DISPLAY_IDENTIFIER m_DriverDesVM.DesiredTorqueIn._.ZFFSAB /end MEASUREMENT
/begin MEASUREMENT ZFFSAB._.DesiredTorqueIn.m_DriverDesVMSts "Status of desired torque from combustion machine" UBYTE SAB_STANDARD_S2_S3 1 100 0 2 ECU_ADDRESS 0xFFF8DAA6 DISPLAY_IDENTIFIER m_DriverDesVMSts.DesiredTorqueIn._.ZFFSAB /end MEASUREMENT
/begin MEASUREMENT ZFFSAB._.DesiredTorqueIn.m_EngDesCor1 "REPRESENT_INTERMEDIATE value for desired torque" SWORD SAB_M_1NM_S2_S3 1 100 -1023 1023 ECU_ADDRESS 0xFFF8DA9E DISPLAY_IDENTIFIER m_EngDesCor1.DesiredTorqueIn._.ZFFSAB /end MEASUREMENT
/begin MEASUREMENT ZFFSAB._.DesiredTorqueIn.m_EngDesCor2 "Intermediate value for desired torque" SWORD SAB_M_1NM_S2_S3 1 100 -1023 1023 ECU_ADDRESS 0xFFF8DAAC DISPLAY_IDENTIFIER m_EngDesCor2.DesiredTorqueIn._.ZFFSAB /end MEASUREMENT
/begin MEASUREMENT ZFFSAB._.DesiredTorqueIn.m_EngDesCor2Lev2 "Intermediate value for desired torque" SWORD SAB_M_1NM_S2_S3 1 100 -1023 1023 ECU_ADDRESS 0xFFF8DAB6 DISPLAY_IDENTIFIER m_EngDesCor2Lev2.DesiredTorqueIn._.ZFFSAB /end MEASUREMENT
/begin MEASUREMENT ZFFSAB._.DesiredTorqueIn.m_EngDesCor3 "REPRESENT_INTERMEDIATE value for desired torque" SWORD SAB_M_1NM_S2_S3 1 100 -1023 1023 ECU_ADDRESS 0xFFF8DAB2 DISPLAY_IDENTIFIER m_EngDesCor3.DesiredTorqueIn._.ZFFSAB /end MEASUREMENT
/begin MEASUREMENT ZFFSAB._.DesiredTorqueIn.m_EngDesCor3Lev2 "Intermediate value for desired torque" SWORD SAB_M_1NM_S2_S3 1 100 -1023 1023 ECU_ADDRESS 0xFFF8DAB8 DISPLAY_IDENTIFIER m_EngDesCor3Lev2.DesiredTorqueIn._.ZFFSAB /end MEASUREMENT
/begin MEASUREMENT ZFFSAB._.DesiredTorqueIn.m_EngDesCor3Lev2_ "Complement intermediate value for desired torque" SWORD SAB_M_1NM_S2_S3 1 100 -32768 32767 ECU_ADDRESS 0xFFF8DABA DISPLAY_IDENTIFIER m_EngDesCor3Lev2_.DesiredTorqueIn._.ZFFSAB /end MEASUREMENT
/begin MEASUREMENT ZFFSAB._.DesiredTorqueIn.m_EngDesEMCor1 "REPRESENT_INTERMEDIATE value for desired torque from electrical machine" SWORD SAB_M_1NM_S2_S3 1 100 -1023 1023 ECU_ADDRESS 0xFFF8DAA8 DISPLAY_IDENTIFIER m_EngDesEMCor1.DesiredTorqueIn._.ZFFSAB /end MEASUREMENT
/begin MEASUREMENT ZFFSAB._.DesiredTorqueIn.m_EngDesEMCor2 "Intermediate value for desired torque from electrical machine" SWORD SAB_M_1NM_S2_S3 1 100 -1023 1023 ECU_ADDRESS 0xFFF8DAB0 DISPLAY_IDENTIFIER m_EngDesEMCor2.DesiredTorqueIn._.ZFFSAB /end MEASUREMENT
/begin MEASUREMENT ZFFSAB._.DesiredTorqueIn.m_EngDesVMCor1 "REPRESENT_INTERMEDIATE value for desired torque from combustion machine" SWORD SAB_M_1NM_S2_S3 1 100 -1023 1023 ECU_ADDRESS 0xFFF8DAA4 DISPLAY_IDENTIFIER m_EngDesVMCor1.DesiredTorqueIn._.ZFFSAB /end MEASUREMENT
/begin MEASUREMENT ZFFSAB._.DesiredTorqueIn.m_EngDesVMCor2 "Intermediate value for desired torque from combustion machine" SWORD SAB_M_1NM_S2_S3 1 100 -1023 1023 ECU_ADDRESS 0xFFF8DAAE DISPLAY_IDENTIFIER m_EngDesVMCor2.DesiredTorqueIn._.ZFFSAB /end MEASUREMENT
/begin MEASUREMENT ZFFSAB._.DesiredTorqueIn.sv_AGS_MKwFW "Output value of desired engine torque for AGS-Layer" SWORD SAB_M_1NM_S2_S3 1 100 -8192 8192 ECU_ADDRESS 0xFFF8DA98 DISPLAY_IDENTIFIER sv_AGS_MKwFW.DesiredTorqueIn._.ZFFSAB /end MEASUREMENT
/begin MEASUREMENT ZFFSAB._.DesiredTorqueIn.sv_m_DriverDesMod "Output value of modified desired engine torque" SWORD SAB_M_1NM_S2_S3 1 100 -400 1640 ECU_ADDRESS 0xFFF8DA9A DISPLAY_IDENTIFIER sv_m_DriverDesMod.DesiredTorqueIn._.ZFFSAB /end MEASUREMENT
/begin MEASUREMENT ZFFSAB._.DesiredTorqueIn.sv_m_EngDes "Output value for desired engine torque" SWORD SAB_M_1NM_S2_S3 1 100 -1023 1023 ECU_ADDRESS 0xFFF8DA82 DISPLAY_IDENTIFIER sv_m_EngDes.DesiredTorqueIn._.ZFFSAB /end MEASUREMENT
/begin MEASUREMENT ZFFSAB._.DesiredTorqueIn.sv_m_EngDesEM "Output value of desired engine torque from electrical machine" SWORD SAB_M_1NM_S2_S3 1 100 -1023 1023 ECU_ADDRESS 0xFFF8DA90 DISPLAY_IDENTIFIER sv_m_EngDesEM.DesiredTorqueIn._.ZFFSAB /end MEASUREMENT
/begin MEASUREMENT ZFFSAB._.DesiredTorqueIn.sv_m_EngDesEMSts "Output status of desired torque signal from electrical machine" UBYTE SAB_STANDARD_S2_S3 1 100 0 2 ECU_ADDRESS 0xFFF8DA92 DISPLAY_IDENTIFIER sv_m_EngDesEMSts.DesiredTorqueIn._.ZFFSAB /end MEASUREMENT
/begin MEASUREMENT ZFFSAB._.DesiredTorqueIn.sv_m_EngDesLev2 "Output value for desired engine torque" SWORD SAB_M_1NM_S2_S3 1 100 -1023 1023 ECU_ADDRESS 0xFFF8DA84 DISPLAY_IDENTIFIER sv_m_EngDesLev2.DesiredTorqueIn._.ZFFSAB /end MEASUREMENT
/begin MEASUREMENT ZFFSAB._.DesiredTorqueIn.sv_m_EngDesLev2Sts "Output value for signal status of desired engine torque" UBYTE SAB_STANDARD_S2_S3 1 100 0 2 ECU_ADDRESS 0xFFF8DA89 DISPLAY_IDENTIFIER sv_m_EngDesLev2Sts.DesiredTorqueIn._.ZFFSAB /end MEASUREMENT
/begin MEASUREMENT ZFFSAB._.DesiredTorqueIn.sv_m_EngDesLev2Sts_ "Output value for signal status of desired engine torque" UBYTE SAB_STANDARD_S2_S3 1 100 0 255 ECU_ADDRESS 0xFFF8DA8A DISPLAY_IDENTIFIER sv_m_EngDesLev2Sts_.DesiredTorqueIn._.ZFFSAB /end MEASUREMENT
/begin MEASUREMENT ZFFSAB._.DesiredTorqueIn.sv_m_EngDesLev2_ "Complement output value for desired engine torque" SWORD SAB_STANDARD_S2_S3 1 100 -32767 32767 ECU_ADDRESS 0xFFF8DA86 DISPLAY_IDENTIFIER sv_m_EngDesLev2_.DesiredTorqueIn._.ZFFSAB /end MEASUREMENT
/begin MEASUREMENT ZFFSAB._.DesiredTorqueIn.sv_m_EngDesSts "Output value for signal status of desired engine torque" UBYTE SAB_STANDARD_S2_S3 1 100 0 2 ECU_ADDRESS 0xFFF8DA88 DISPLAY_IDENTIFIER sv_m_EngDesSts.DesiredTorqueIn._.ZFFSAB /end MEASUREMENT
/begin MEASUREMENT ZFFSAB._.DesiredTorqueIn.sv_m_EngDesVM "Output value of desired engine torque from combustion machine" SWORD SAB_M_1NM_S2_S3 1 100 -1023 1023 ECU_ADDRESS 0xFFF8DA8C DISPLAY_IDENTIFIER sv_m_EngDesVM.DesiredTorqueIn._.ZFFSAB /end MEASUREMENT
/begin MEASUREMENT ZFFSAB._.DesiredTorqueIn.sv_m_EngDesVMSts "Output status of desired torque signal from combustion machine" UBYTE SAB_STANDARD_S2_S3 1 100 0 2 ECU_ADDRESS 0xFFF8DA8E DISPLAY_IDENTIFIER sv_m_EngDesVMSts.DesiredTorqueIn._.ZFFSAB /end MEASUREMENT
/begin MEASUREMENT ZFFSAB._.DesiredTorqueIn.sv_m_MaxIncrVM "Output value setting range of torque from combustion machine" SWORD SAB_M_1NM_S2_S3 1 100 -400 1640 ECU_ADDRESS 0xFFF8DA94 DISPLAY_IDENTIFIER sv_m_MaxIncrVM.DesiredTorqueIn._.ZFFSAB /end MEASUREMENT
/begin MEASUREMENT ZFFSAB._.DesiredTorqueIn.sv_m_MaxIncrVMSts "Output status of signal setting range of torque from combustion machine" UBYTE SAB_STANDARD_S2_S3 1 100 0 2 ECU_ADDRESS 0xFFF8DA96 DISPLAY_IDENTIFIER sv_m_MaxIncrVMSts.DesiredTorqueIn._.ZFFSAB /end MEASUREMENT
/begin MEASUREMENT ZFFSAB._.DistanceIn.iv_Mileage "Input value mileage" ULONG SAB_L_1KM_S2_S3 1 100 0 16777215 ECU_ADDRESS 0xFFF95D3C DISPLAY_IDENTIFIER iv_Mileage.DistanceIn._.ZFFSAB /end MEASUREMENT
/begin MEASUREMENT ZFFSAB._.DistanceIn.iv_MileageSts "Input value message status of mileage" UBYTE SAB_STANDARD_S2_S3 1 100 0 255 ECU_ADDRESS 0xFFF95D40 DISPLAY_IDENTIFIER iv_MileageSts.DistanceIn._.ZFFSAB /end MEASUREMENT
/begin MEASUREMENT ZFFSAB._.DistanceIn.sv_Mileage "Output value of mileage" UWORD SAB_L_10KM_S2_S3 1 100 0 655350 ECU_ADDRESS 0xFFF95D42 DISPLAY_IDENTIFIER sv_Mileage.DistanceIn._.ZFFSAB /end MEASUREMENT
/begin MEASUREMENT ZFFSAB._.DistanceIn.sv_MileageFromNab "Output value of MileageFromNab" ULONG SAB_L_1KM_S2_S3 1 100 0 4294967295 ECU_ADDRESS 0xFFF95D48 DISPLAY_IDENTIFIER sv_MileageFromNab.DistanceIn._.ZFFSAB /end MEASUREMENT
/begin MEASUREMENT ZFFSAB._.DistanceIn.sv_MileageSts "REPRESENT_INTERMEDIATE value signal status of mileage" UBYTE SAB_STANDARD_S2_S3 1 100 0 2 ECU_ADDRESS 0xFFF95D4C DISPLAY_IDENTIFIER sv_MileageSts.DistanceIn._.ZFFSAB /end MEASUREMENT
/begin MEASUREMENT ZFFSAB._.DistanceIn.sv_Mileage_1km "Output value of mileage 1km" ULONG SAB_L_1KM_S2_S3 1 100 0 4294967295 ECU_ADDRESS 0xFFF95D44 DISPLAY_IDENTIFIER sv_Mileage_1km.DistanceIn._.ZFFSAB /end MEASUREMENT
/begin MEASUREMENT ZFFSAB._.DistanceIn.sv_f_MileageErr "Output error value of mileage" UBYTE SAB_STANDARD_S2_S3 1 100 0 255 ECU_ADDRESS 0xFFF95D41 DISPLAY_IDENTIFIER sv_f_MileageErr.DistanceIn._.ZFFSAB /end MEASUREMENT
/begin MEASUREMENT ZFFSAB._.DoorStatusIn.f_DoorDErr "Error flag of driverdoor status" UBYTE SAB_STANDARD_S2_S3 1 100 0 1 ECU_ADDRESS 0xFFF8D866 DISPLAY_IDENTIFIER f_DoorDErr.DoorStatusIn._.ZFFSAB /end MEASUREMENT
/begin MEASUREMENT ZFFSAB._.DoorStatusIn.iv_DoorD "Input value driverdoor status" UBYTE SAB_STANDARD_S2_S3 1 100 0 3 ECU_ADDRESS 0xFFF8D860 DISPLAY_IDENTIFIER iv_DoorD.DoorStatusIn._.ZFFSAB /end MEASUREMENT
/begin MEASUREMENT ZFFSAB._.DoorStatusIn.iv_DoorD2 "Input value of second driverdoor status" UBYTE SAB_STANDARD_S2_S3 1 100 0 3 ECU_ADDRESS 0xFFF8D862 DISPLAY_IDENTIFIER iv_DoorD2.DoorStatusIn._.ZFFSAB /end MEASUREMENT
/begin MEASUREMENT ZFFSAB._.DoorStatusIn.iv_DoorD2Sts "Input value message status of second driverdoor signal status" UBYTE SAB_STANDARD_S2_S3 1 100 0 255 ECU_ADDRESS 0xFFF8D863 DISPLAY_IDENTIFIER iv_DoorD2Sts.DoorStatusIn._.ZFFSAB /end MEASUREMENT
/begin MEASUREMENT ZFFSAB._.DoorStatusIn.iv_DoorDSts "Input value message status of driverdoor status" UBYTE SAB_STANDARD_S2_S3 1 100 0 255 ECU_ADDRESS 0xFFF8D861 DISPLAY_IDENTIFIER iv_DoorDSts.DoorStatusIn._.ZFFSAB /end MEASUREMENT
/begin MEASUREMENT ZFFSAB._.DoorStatusIn.sv_DoorDSts "Output value signal status of driverdoor status" UBYTE SAB_STANDARD_S2_S3 1 100 0 2 ECU_ADDRESS 0xFFF8D864 DISPLAY_IDENTIFIER sv_DoorDSts.DoorStatusIn._.ZFFSAB /end MEASUREMENT
/begin MEASUREMENT ZFFSAB._.DoorStatusIn.sv_f_DoorD "Output value of driverdoor status" UBYTE SAB_STANDARD_S2_S3 1 100 0 1 ECU_ADDRESS 0xFFF8D865 DISPLAY_IDENTIFIER sv_f_DoorD.DoorStatusIn._.ZFFSAB /end MEASUREMENT
/begin MEASUREMENT ZFFSAB._.DriverSeatStatusIn.f_SeatBeltErr "Error flag of seatbelt detection" UBYTE SAB_STANDARD_S2_S3 1 100 0 1 ECU_ADDRESS 0xFFF8D875 DISPLAY_IDENTIFIER f_SeatBeltErr.DriverSeatStatusIn._.ZFFSAB /end MEASUREMENT
/begin MEASUREMENT ZFFSAB._.DriverSeatStatusIn.f_SeatFLErr "Error flag of passenger detection" UBYTE SAB_STANDARD_S2_S3 1 100 0 1 ECU_ADDRESS 0xFFF8D874 DISPLAY_IDENTIFIER f_SeatFLErr.DriverSeatStatusIn._.ZFFSAB /end MEASUREMENT
/begin MEASUREMENT ZFFSAB._.DriverSeatStatusIn.iv_SeatBelt "Input value seatbelt detection" UBYTE SAB_STANDARD_S2_S3 1 100 0 3 ECU_ADDRESS 0xFFF8D86C DISPLAY_IDENTIFIER iv_SeatBelt.DriverSeatStatusIn._.ZFFSAB /end MEASUREMENT
/begin MEASUREMENT ZFFSAB._.DriverSeatStatusIn.iv_SeatBeltSts "Input value message status of seatbelt detection" UBYTE SAB_STANDARD_S2_S3 1 100 0 255 ECU_ADDRESS 0xFFF8D86D DISPLAY_IDENTIFIER iv_SeatBeltSts.DriverSeatStatusIn._.ZFFSAB /end MEASUREMENT
/begin MEASUREMENT ZFFSAB._.DriverSeatStatusIn.iv_SeatFL "Input value passenger detection" UBYTE SAB_STANDARD_S2_S3 1 100 0 7 ECU_ADDRESS 0xFFF8D86E DISPLAY_IDENTIFIER iv_SeatFL.DriverSeatStatusIn._.ZFFSAB /end MEASUREMENT
/begin MEASUREMENT ZFFSAB._.DriverSeatStatusIn.iv_SeatFLSts "Input value message status of passenger detection" UBYTE SAB_STANDARD_S2_S3 1 100 0 255 ECU_ADDRESS 0xFFF8D86F DISPLAY_IDENTIFIER iv_SeatFLSts.DriverSeatStatusIn._.ZFFSAB /end MEASUREMENT
/begin MEASUREMENT ZFFSAB._.DriverSeatStatusIn.sv_SeatBeltSts "Output value signal status of seatbelt detection" UBYTE SAB_STANDARD_S2_S3 1 100 0 2 ECU_ADDRESS 0xFFF8D872 DISPLAY_IDENTIFIER sv_SeatBeltSts.DriverSeatStatusIn._.ZFFSAB /end MEASUREMENT
/begin MEASUREMENT ZFFSAB._.DriverSeatStatusIn.sv_SeatFLSts "Output value signal status of passenger detection" UBYTE SAB_STANDARD_S2_S3 1 100 0 2 ECU_ADDRESS 0xFFF8D873 DISPLAY_IDENTIFIER sv_SeatFLSts.DriverSeatStatusIn._.ZFFSAB /end MEASUREMENT
/begin MEASUREMENT ZFFSAB._.DriverSeatStatusIn.sv_f_SeatBelt "Output value of seatbelt detection" UBYTE SAB_STANDARD_S2_S3 1 100 0 1 ECU_ADDRESS 0xFFF8D870 DISPLAY_IDENTIFIER sv_f_SeatBelt.DriverSeatStatusIn._.ZFFSAB /end MEASUREMENT
/begin MEASUREMENT ZFFSAB._.DriverSeatStatusIn.sv_f_SeatFL "Output value of passenger detection" UBYTE SAB_STANDARD_S2_S3 1 100 0 1 ECU_ADDRESS 0xFFF8D871 DISPLAY_IDENTIFIER sv_f_SeatFL.DriverSeatStatusIn._.ZFFSAB /end MEASUREMENT
/begin MEASUREMENT ZFFSAB._.DrivingDirectionIn.DriveDirWheel "Intermediate signal of driving direction wheel" UBYTE SAB_STANDARD_S2_S3 1 100 0 2 ECU_ADDRESS 0xFFF95D2A DISPLAY_IDENTIFIER DriveDirWheel.DrivingDirectionIn._.ZFFSAB /end MEASUREMENT
/begin MEASUREMENT ZFFSAB._.DrivingDirectionIn.DriveDirWheelSts "Intermediate status of driving direction wheel" UBYTE SAB_STANDARD_S2_S3 1 100 0 255 ECU_ADDRESS 0xFFF95D2B DISPLAY_IDENTIFIER DriveDirWheelSts.DrivingDirectionIn._.ZFFSAB /end MEASUREMENT
/begin MEASUREMENT ZFFSAB._.DrivingDirectionIn.DrivingDirectionRaw "Intermediate signal of driving direction" UBYTE SAB_STANDARD_S2_S3 1 100 0 2 ECU_ADDRESS 0xFFF95D28 DISPLAY_IDENTIFIER DrivingDirectionRaw.DrivingDirectionIn._.ZFFSAB /end MEASUREMENT
/begin MEASUREMENT ZFFSAB._.DrivingDirectionIn.DrivingDirectionRawSts "Intermediate status of driving direction" UBYTE SAB_STANDARD_S2_S3 1 100 0 255 ECU_ADDRESS 0xFFF95D29 DISPLAY_IDENTIFIER DrivingDirectionRawSts.DrivingDirectionIn._.ZFFSAB /end MEASUREMENT
/begin MEASUREMENT ZFFSAB._.DrivingDirectionIn.sv_DriveDirectionAGS "Output signal of driving direction wheel AGS" UBYTE SAB_STANDARD_S2_S3 1 100 0 2 ECU_ADDRESS 0xFFF95D27 DISPLAY_IDENTIFIER sv_DriveDirectionAGS.DrivingDirectionIn._.ZFFSAB /end MEASUREMENT
/begin MEASUREMENT ZFFSAB._.DrivingDirectionIn.sv_DrivingDirection "Output signal of driving direction wheel" UBYTE SAB_STANDARD_S2_S3 1 100 0 2 ECU_ADDRESS 0xFFF95D25 DISPLAY_IDENTIFIER sv_DrivingDirection.DrivingDirectionIn._.ZFFSAB /end MEASUREMENT
/begin MEASUREMENT ZFFSAB._.DrivingDirectionIn.sv_DrivingDirectionSts "Output status of signal" UBYTE SAB_STANDARD_S2_S3 1 100 0 2 ECU_ADDRESS 0xFFF95D26 DISPLAY_IDENTIFIER sv_DrivingDirectionSts.DrivingDirectionIn._.ZFFSAB /end MEASUREMENT
/begin MEASUREMENT ZFFSAB._.DrivingDirectionIn.tmr_HoldDirection.time "Description for this variable only in SW documentation possible not in asap2" UBYTE SAB_T_TIMER_10MS_S2_S3 1 100 0 2550 ECU_ADDRESS 0xFFF95D24 DISPLAY_IDENTIFIER time.tmr_HoldDirection.DrivingDirectionIn._.ZFFSAB /end MEASUREMENT
/begin MEASUREMENT ZFFSAB._.DrivingSpeedControlIn.f_SpeedControlErr "Error flag of SpeedControl-signal" UBYTE SAB_STANDARD_S2_S3 1 100 0 1 ECU_ADDRESS 0xFFF96E41 DISPLAY_IDENTIFIER f_SpeedControlErr.DrivingSpeedControlIn._.ZFFSAB /end MEASUREMENT
/begin MEASUREMENT ZFFSAB._.DrivingSpeedControlIn.sv_SpeedControlSts "Output value signal status for output signal" UBYTE SAB_STANDARD_S2_S3 1 100 0 255 ECU_ADDRESS 0xFFF96E40 DISPLAY_IDENTIFIER sv_SpeedControlSts.DrivingSpeedControlIn._.ZFFSAB /end MEASUREMENT
/begin MEASUREMENT ZFFSAB._.DrivingStateIn.f_DriveConditionErr "Error flag of DriveCondition-signal" UBYTE SAB_STANDARD_S2_S3 1 100 0 1 ECU_ADDRESS 0xFFF8E1CB DISPLAY_IDENTIFIER f_DriveConditionErr.DrivingStateIn._.ZFFSAB /end MEASUREMENT
/begin MEASUREMENT ZFFSAB._.DrivingStateIn.iv_DriveCondition "Input raw signal of driving state 0-not driving 1-forward 2-backward 3-no direction detection possible 4-rear axle on roller test bench 5-rear both axles on roller test bench 7-error value" UBYTE SAB_STANDARD_S2_S3 1 100 0 7 ECU_ADDRESS 0xFFF8E1C6 DISPLAY_IDENTIFIER iv_DriveCondition.DrivingStateIn._.ZFFSAB /end MEASUREMENT
/begin MEASUREMENT ZFFSAB._.DrivingStateIn.iv_DriveConditionSts "Input CAN message status of driving state" UBYTE SAB_STANDARD_S2_S3 1 100 0 255 ECU_ADDRESS 0xFFF8E1C7 DISPLAY_IDENTIFIER iv_DriveConditionSts.DrivingStateIn._.ZFFSAB /end MEASUREMENT
/begin MEASUREMENT ZFFSAB._.DrivingStateIn.sv_AGS_DriveCondition "Output signal of AGS driving state 0-rear axle NOT on roller test bench 1-rear axle on roller test bench" UBYTE SAB_STANDARD_S2_S3 1 100 0 1 ECU_ADDRESS 0xFFF8E1C8 DISPLAY_IDENTIFIER sv_AGS_DriveCondition.DrivingStateIn._.ZFFSAB /end MEASUREMENT
/begin MEASUREMENT ZFFSAB._.DrivingStateIn.sv_DriveCondition "Output signal of driving state 0-not driving 1-forward 2-backward 3-no direction detection possible 4-rear axle on roller test bench 7-error value" UBYTE SAB_STANDARD_S2_S3 1 100 0 7 ECU_ADDRESS 0xFFF8E1C9 DISPLAY_IDENTIFIER sv_DriveCondition.DrivingStateIn._.ZFFSAB /end MEASUREMENT
/begin MEASUREMENT ZFFSAB._.DrivingStateIn.sv_DriveConditionSts "Output status signal of driving state" UBYTE SAB_STANDARD_S2_S3 1 100 0 2 ECU_ADDRESS 0xFFF8E1CA DISPLAY_IDENTIFIER sv_DriveConditionSts.DrivingStateIn._.ZFFSAB /end MEASUREMENT
/begin MEASUREMENT ZFFSAB._.DynRunRadiusIn.sv_rd_Dyn "Intermediate value dynamic rolling radius" UWORD SAB_L_1MM_S2_S3 1 100 0 65535 ECU_ADDRESS 0xFFF96E68 DISPLAY_IDENTIFIER sv_rd_Dyn.DynRunRadiusIn._.ZFFSAB /end MEASUREMENT
/begin MEASUREMENT ZFFSAB._.EEpromZentralHandler.allEepromSummeryChannels.eepromSummaryChannel[0].cnt_GetEEpromUpdate "Call counter off function" UBYTE SAB_STANDARD_S2_S3 1 100 0 255 ECU_ADDRESS 0xFFF9606A DISPLAY_IDENTIFIER cnt_GetEEpromUpdate.eepromSummaryChannel[0].allEepromSummeryChannels.EEpromZentralHandler._.ZFFSAB /end MEASUREMENT
/begin MEASUREMENT ZFFSAB._.EEpromZentralHandler.allEepromSummeryChannels.eepromSummaryChannel[0].cnt_GetEEpromValid "Call counter off function" UBYTE SAB_STANDARD_S2_S3 1 100 0 255 ECU_ADDRESS 0xFFF96068 DISPLAY_IDENTIFIER cnt_GetEEpromValid.eepromSummaryChannel[0].allEepromSummeryChannels.EEpromZentralHandler._.ZFFSAB /end MEASUREMENT
/begin MEASUREMENT ZFFSAB._.EEpromZentralHandler.allEepromSummeryChannels.eepromSummaryChannel[0].cnt_GetSizeofEEpromData "Call counter off function" UBYTE SAB_STANDARD_S2_S3 1 100 0 255 ECU_ADDRESS 0xFFF9606F DISPLAY_IDENTIFIER cnt_GetSizeofEEpromData.eepromSummaryChannel[0].allEepromSummeryChannels.EEpromZentralHandler._.ZFFSAB /end MEASUREMENT
/begin MEASUREMENT ZFFSAB._.EEpromZentralHandler.allEepromSummeryChannels.eepromSummaryChannel[0].cnt_SetEEpromInitZyklisch "Call counter off function" UBYTE SAB_STANDARD_S2_S3 1 100 0 255 ECU_ADDRESS 0xFFF9606C DISPLAY_IDENTIFIER cnt_SetEEpromInitZyklisch.eepromSummaryChannel[0].allEepromSummeryChannels.EEpromZentralHandler._.ZFFSAB /end MEASUREMENT
/begin MEASUREMENT ZFFSAB._.EEpromZentralHandler.allEepromSummeryChannels.eepromSummaryChannel[0].eeprom_info "argument of SetEEpromInitZyklisch" UBYTE SAB_STANDARD_S2_S3 1 100 0 255 ECU_ADDRESS 0xFFF9606E DISPLAY_IDENTIFIER eeprom_info.eepromSummaryChannel[0].allEepromSummeryChannels.EEpromZentralHandler._.ZFFSAB /end MEASUREMENT
/begin MEASUREMENT ZFFSAB._.EEpromZentralHandler.allEepromSummeryChannels.eepromSummaryChannel[0].ret_GetEEpromUpdate "Return value off function" UBYTE SAB_STANDARD_S2_S3 1 100 0 255 ECU_ADDRESS 0xFFF9606B DISPLAY_IDENTIFIER ret_GetEEpromUpdate.eepromSummaryChannel[0].allEepromSummeryChannels.EEpromZentralHandler._.ZFFSAB /end MEASUREMENT
/begin MEASUREMENT ZFFSAB._.EEpromZentralHandler.allEepromSummeryChannels.eepromSummaryChannel[0].ret_GetEEpromValid "Return value off function" UBYTE SAB_STANDARD_S2_S3 1 100 0 255 ECU_ADDRESS 0xFFF96069 DISPLAY_IDENTIFIER ret_GetEEpromValid.eepromSummaryChannel[0].allEepromSummeryChannels.EEpromZentralHandler._.ZFFSAB /end MEASUREMENT
/begin MEASUREMENT ZFFSAB._.EEpromZentralHandler.allEepromSummeryChannels.eepromSummaryChannel[0].ret_GetSizeofEEpromData "Return value off function" UWORD SAB_STANDARD_S2_S3 1 100 0 65535 ECU_ADDRESS 0xFFF96070 DISPLAY_IDENTIFIER ret_GetSizeofEEpromData.eepromSummaryChannel[0].allEepromSummeryChannels.EEpromZentralHandler._.ZFFSAB /end MEASUREMENT
/begin MEASUREMENT ZFFSAB._.EEpromZentralHandler.allEepromSummeryChannels.eepromSummaryChannel[0].ret_SetEEpromInitZyklisch "Return value off function" UBYTE SAB_STANDARD_S2_S3 1 100 0 255 ECU_ADDRESS 0xFFF9606D DISPLAY_IDENTIFIER ret_SetEEpromInitZyklisch.eepromSummaryChannel[0].allEepromSummeryChannels.EEpromZentralHandler._.ZFFSAB /end MEASUREMENT
/begin MEASUREMENT ZFFSAB._.EEpromZentralHandler.allEepromSummeryChannels.eepromSummaryChannel[1].cnt_GetEEpromUpdate "Call counter off function" UBYTE SAB_STANDARD_S2_S3 1 100 0 255 ECU_ADDRESS 0xFFF96074 DISPLAY_IDENTIFIER cnt_GetEEpromUpdate.eepromSummaryChannel[1].allEepromSummeryChannels.EEpromZentralHandler._.ZFFSAB /end MEASUREMENT
/begin MEASUREMENT ZFFSAB._.EEpromZentralHandler.allEepromSummeryChannels.eepromSummaryChannel[1].cnt_GetEEpromValid "Call counter off function" UBYTE SAB_STANDARD_S2_S3 1 100 0 255 ECU_ADDRESS 0xFFF96072 DISPLAY_IDENTIFIER cnt_GetEEpromValid.eepromSummaryChannel[1].allEepromSummeryChannels.EEpromZentralHandler._.ZFFSAB /end MEASUREMENT
/begin MEASUREMENT ZFFSAB._.EEpromZentralHandler.allEepromSummeryChannels.eepromSummaryChannel[1].cnt_GetSizeofEEpromData "Call counter off function" UBYTE SAB_STANDARD_S2_S3 1 100 0 255 ECU_ADDRESS 0xFFF96079 DISPLAY_IDENTIFIER cnt_GetSizeofEEpromData.eepromSummaryChannel[1].allEepromSummeryChannels.EEpromZentralHandler._.ZFFSAB /end MEASUREMENT
/begin MEASUREMENT ZFFSAB._.EEpromZentralHandler.allEepromSummeryChannels.eepromSummaryChannel[1].cnt_SetEEpromInitZyklisch "Call counter off function" UBYTE SAB_STANDARD_S2_S3 1 100 0 255 ECU_ADDRESS 0xFFF96076 DISPLAY_IDENTIFIER cnt_SetEEpromInitZyklisch.eepromSummaryChannel[1].allEepromSummeryChannels.EEpromZentralHandler._.ZFFSAB /end MEASUREMENT
/begin MEASUREMENT ZFFSAB._.EEpromZentralHandler.allEepromSummeryChannels.eepromSummaryChannel[1].eeprom_info "argument of SetEEpromInitZyklisch" UBYTE SAB_STANDARD_S2_S3 1 100 0 255 ECU_ADDRESS 0xFFF96078 DISPLAY_IDENTIFIER eeprom_info.eepromSummaryChannel[1].allEepromSummeryChannels.EEpromZentralHandler._.ZFFSAB /end MEASUREMENT
/begin MEASUREMENT ZFFSAB._.EEpromZentralHandler.allEepromSummeryChannels.eepromSummaryChannel[1].ret_GetEEpromUpdate "Return value off function" UBYTE SAB_STANDARD_S2_S3 1 100 0 255 ECU_ADDRESS 0xFFF96075 DISPLAY_IDENTIFIER ret_GetEEpromUpdate.eepromSummaryChannel[1].allEepromSummeryChannels.EEpromZentralHandler._.ZFFSAB /end MEASUREMENT
/begin MEASUREMENT ZFFSAB._.EEpromZentralHandler.allEepromSummeryChannels.eepromSummaryChannel[1].ret_GetEEpromValid "Return value off function" UBYTE SAB_STANDARD_S2_S3 1 100 0 255 ECU_ADDRESS 0xFFF96073 DISPLAY_IDENTIFIER ret_GetEEpromValid.eepromSummaryChannel[1].allEepromSummeryChannels.EEpromZentralHandler._.ZFFSAB /end MEASUREMENT
/begin MEASUREMENT ZFFSAB._.EEpromZentralHandler.allEepromSummeryChannels.eepromSummaryChannel[1].ret_GetSizeofEEpromData "Return value off function" UWORD SAB_STANDARD_S2_S3 1 100 0 65535 ECU_ADDRESS 0xFFF9607A DISPLAY_IDENTIFIER ret_GetSizeofEEpromData.eepromSummaryChannel[1].allEepromSummeryChannels.EEpromZentralHandler._.ZFFSAB /end MEASUREMENT
/begin MEASUREMENT ZFFSAB._.EEpromZentralHandler.allEepromSummeryChannels.eepromSummaryChannel[1].ret_SetEEpromInitZyklisch "Return value off function" UBYTE SAB_STANDARD_S2_S3 1 100 0 255 ECU_ADDRESS 0xFFF96077 DISPLAY_IDENTIFIER ret_SetEEpromInitZyklisch.eepromSummaryChannel[1].allEepromSummeryChannels.EEpromZentralHandler._.ZFFSAB /end MEASUREMENT
/begin MEASUREMENT ZFFSAB._.EEpromZentralHandler.allEepromSummeryChannels.eepromSummaryChannel[2].cnt_GetEEpromUpdate "Call counter off function" UBYTE SAB_STANDARD_S2_S3 1 100 0 255 ECU_ADDRESS 0xFFF9607E DISPLAY_IDENTIFIER cnt_GetEEpromUpdate.eepromSummaryChannel[2].allEepromSummeryChannels.EEpromZentralHandler._.ZFFSAB /end MEASUREMENT
/begin MEASUREMENT ZFFSAB._.EEpromZentralHandler.allEepromSummeryChannels.eepromSummaryChannel[2].cnt_GetEEpromValid "Call counter off function" UBYTE SAB_STANDARD_S2_S3 1 100 0 255 ECU_ADDRESS 0xFFF9607C DISPLAY_IDENTIFIER cnt_GetEEpromValid.eepromSummaryChannel[2].allEepromSummeryChannels.EEpromZentralHandler._.ZFFSAB /end MEASUREMENT
/begin MEASUREMENT ZFFSAB._.EEpromZentralHandler.allEepromSummeryChannels.eepromSummaryChannel[2].cnt_GetSizeofEEpromData "Call counter off function" UBYTE SAB_STANDARD_S2_S3 1 100 0 255 ECU_ADDRESS 0xFFF96083 DISPLAY_IDENTIFIER cnt_GetSizeofEEpromData.eepromSummaryChannel[2].allEepromSummeryChannels.EEpromZentralHandler._.ZFFSAB /end MEASUREMENT
/begin MEASUREMENT ZFFSAB._.EEpromZentralHandler.allEepromSummeryChannels.eepromSummaryChannel[2].cnt_SetEEpromInitZyklisch "Call counter off function" UBYTE SAB_STANDARD_S2_S3 1 100 0 255 ECU_ADDRESS 0xFFF96080 DISPLAY_IDENTIFIER cnt_SetEEpromInitZyklisch.eepromSummaryChannel[2].allEepromSummeryChannels.EEpromZentralHandler._.ZFFSAB /end MEASUREMENT
/begin MEASUREMENT ZFFSAB._.EEpromZentralHandler.allEepromSummeryChannels.eepromSummaryChannel[2].eeprom_info "argument of SetEEpromInitZyklisch" UBYTE SAB_STANDARD_S2_S3 1 100 0 255 ECU_ADDRESS 0xFFF96082 DISPLAY_IDENTIFIER eeprom_info.eepromSummaryChannel[2].allEepromSummeryChannels.EEpromZentralHandler._.ZFFSAB /end MEASUREMENT
/begin MEASUREMENT ZFFSAB._.EEpromZentralHandler.allEepromSummeryChannels.eepromSummaryChannel[2].ret_GetEEpromUpdate "Return value off function" UBYTE SAB_STANDARD_S2_S3 1 100 0 255 ECU_ADDRESS 0xFFF9607F DISPLAY_IDENTIFIER ret_GetEEpromUpdate.eepromSummaryChannel[2].allEepromSummeryChannels.EEpromZentralHandler._.ZFFSAB /end MEASUREMENT
/begin MEASUREMENT ZFFSAB._.EEpromZentralHandler.allEepromSummeryChannels.eepromSummaryChannel[2].ret_GetEEpromValid "Return value off function" UBYTE SAB_STANDARD_S2_S3 1 100 0 255 ECU_ADDRESS 0xFFF9607D DISPLAY_IDENTIFIER ret_GetEEpromValid.eepromSummaryChannel[2].allEepromSummeryChannels.EEpromZentralHandler._.ZFFSAB /end MEASUREMENT
/begin MEASUREMENT ZFFSAB._.EEpromZentralHandler.allEepromSummeryChannels.eepromSummaryChannel[2].ret_GetSizeofEEpromData "Return value off function" UWORD SAB_STANDARD_S2_S3 1 100 0 65535 ECU_ADDRESS 0xFFF96084 DISPLAY_IDENTIFIER ret_GetSizeofEEpromData.eepromSummaryChannel[2].allEepromSummeryChannels.EEpromZentralHandler._.ZFFSAB /end MEASUREMENT
/begin MEASUREMENT ZFFSAB._.EEpromZentralHandler.allEepromSummeryChannels.eepromSummaryChannel[2].ret_SetEEpromInitZyklisch "Return value off function" UBYTE SAB_STANDARD_S2_S3 1 100 0 255 ECU_ADDRESS 0xFFF96081 DISPLAY_IDENTIFIER ret_SetEEpromInitZyklisch.eepromSummaryChannel[2].allEepromSummeryChannels.EEpromZentralHandler._.ZFFSAB /end MEASUREMENT
/begin MEASUREMENT ZFFSAB._.EEpromZentralHandler.allEepromSummeryChannels.eepromSummaryChannel[3].cnt_GetEEpromUpdate "Call counter off function" UBYTE SAB_STANDARD_S2_S3 1 100 0 255 ECU_ADDRESS 0xFFF96088 DISPLAY_IDENTIFIER cnt_GetEEpromUpdate.eepromSummaryChannel[3].allEepromSummeryChannels.EEpromZentralHandler._.ZFFSAB /end MEASUREMENT
/begin MEASUREMENT ZFFSAB._.EEpromZentralHandler.allEepromSummeryChannels.eepromSummaryChannel[3].cnt_GetEEpromValid "Call counter off function" UBYTE SAB_STANDARD_S2_S3 1 100 0 255 ECU_ADDRESS 0xFFF96086 DISPLAY_IDENTIFIER cnt_GetEEpromValid.eepromSummaryChannel[3].allEepromSummeryChannels.EEpromZentralHandler._.ZFFSAB /end MEASUREMENT
/begin MEASUREMENT ZFFSAB._.EEpromZentralHandler.allEepromSummeryChannels.eepromSummaryChannel[3].cnt_GetSizeofEEpromData "Call counter off function" UBYTE SAB_STANDARD_S2_S3 1 100 0 255 ECU_ADDRESS 0xFFF9608D DISPLAY_IDENTIFIER cnt_GetSizeofEEpromData.eepromSummaryChannel[3].allEepromSummeryChannels.EEpromZentralHandler._.ZFFSAB /end MEASUREMENT
/begin MEASUREMENT ZFFSAB._.EEpromZentralHandler.allEepromSummeryChannels.eepromSummaryChannel[3].cnt_SetEEpromInitZyklisch "Call counter off function" UBYTE SAB_STANDARD_S2_S3 1 100 0 255 ECU_ADDRESS 0xFFF9608A DISPLAY_IDENTIFIER cnt_SetEEpromInitZyklisch.eepromSummaryChannel[3].allEepromSummeryChannels.EEpromZentralHandler._.ZFFSAB /end MEASUREMENT
/begin MEASUREMENT ZFFSAB._.EEpromZentralHandler.allEepromSummeryChannels.eepromSummaryChannel[3].eeprom_info "argument of SetEEpromInitZyklisch" UBYTE SAB_STANDARD_S2_S3 1 100 0 255 ECU_ADDRESS 0xFFF9608C DISPLAY_IDENTIFIER eeprom_info.eepromSummaryChannel[3].allEepromSummeryChannels.EEpromZentralHandler._.ZFFSAB /end MEASUREMENT
/begin MEASUREMENT ZFFSAB._.EEpromZentralHandler.allEepromSummeryChannels.eepromSummaryChannel[3].ret_GetEEpromUpdate "Return value off function" UBYTE SAB_STANDARD_S2_S3 1 100 0 255 ECU_ADDRESS 0xFFF96089 DISPLAY_IDENTIFIER ret_GetEEpromUpdate.eepromSummaryChannel[3].allEepromSummeryChannels.EEpromZentralHandler._.ZFFSAB /end MEASUREMENT
/begin MEASUREMENT ZFFSAB._.EEpromZentralHandler.allEepromSummeryChannels.eepromSummaryChannel[3].ret_GetEEpromValid "Return value off function" UBYTE SAB_STANDARD_S2_S3 1 100 0 255 ECU_ADDRESS 0xFFF96087 DISPLAY_IDENTIFIER ret_GetEEpromValid.eepromSummaryChannel[3].allEepromSummeryChannels.EEpromZentralHandler._.ZFFSAB /end MEASUREMENT
/begin MEASUREMENT ZFFSAB._.EEpromZentralHandler.allEepromSummeryChannels.eepromSummaryChannel[3].ret_GetSizeofEEpromData "Return value off function" UWORD SAB_STANDARD_S2_S3 1 100 0 65535 ECU_ADDRESS 0xFFF9608E DISPLAY_IDENTIFIER ret_GetSizeofEEpromData.eepromSummaryChannel[3].allEepromSummeryChannels.EEpromZentralHandler._.ZFFSAB /end MEASUREMENT
/begin MEASUREMENT ZFFSAB._.EEpromZentralHandler.allEepromSummeryChannels.eepromSummaryChannel[3].ret_SetEEpromInitZyklisch "Return value off function" UBYTE SAB_STANDARD_S2_S3 1 100 0 255 ECU_ADDRESS 0xFFF9608B DISPLAY_IDENTIFIER ret_SetEEpromInitZyklisch.eepromSummaryChannel[3].allEepromSummeryChannels.EEpromZentralHandler._.ZFFSAB /end MEASUREMENT
/begin MEASUREMENT ZFFSAB._.EEpromZentralHandler.allEepromSummeryChannels.eepromSummaryChannel[4].cnt_GetEEpromUpdate "Call counter off function" UBYTE SAB_STANDARD_S2_S3 1 100 0 255 ECU_ADDRESS 0xFFF96092 DISPLAY_IDENTIFIER cnt_GetEEpromUpdate.eepromSummaryChannel[4].allEepromSummeryChannels.EEpromZentralHandler._.ZFFSAB /end MEASUREMENT
/begin MEASUREMENT ZFFSAB._.EEpromZentralHandler.allEepromSummeryChannels.eepromSummaryChannel[4].cnt_GetEEpromValid "Call counter off function" UBYTE SAB_STANDARD_S2_S3 1 100 0 255 ECU_ADDRESS 0xFFF96090 DISPLAY_IDENTIFIER cnt_GetEEpromValid.eepromSummaryChannel[4].allEepromSummeryChannels.EEpromZentralHandler._.ZFFSAB /end MEASUREMENT
/begin MEASUREMENT ZFFSAB._.EEpromZentralHandler.allEepromSummeryChannels.eepromSummaryChannel[4].cnt_GetSizeofEEpromData "Call counter off function" UBYTE SAB_STANDARD_S2_S3 1 100 0 255 ECU_ADDRESS 0xFFF96097 DISPLAY_IDENTIFIER cnt_GetSizeofEEpromData.eepromSummaryChannel[4].allEepromSummeryChannels.EEpromZentralHandler._.ZFFSAB /end MEASUREMENT
/begin MEASUREMENT ZFFSAB._.EEpromZentralHandler.allEepromSummeryChannels.eepromSummaryChannel[4].cnt_SetEEpromInitZyklisch "Call counter off function" UBYTE SAB_STANDARD_S2_S3 1 100 0 255 ECU_ADDRESS 0xFFF96094 DISPLAY_IDENTIFIER cnt_SetEEpromInitZyklisch.eepromSummaryChannel[4].allEepromSummeryChannels.EEpromZentralHandler._.ZFFSAB /end MEASUREMENT
/begin MEASUREMENT ZFFSAB._.EEpromZentralHandler.allEepromSummeryChannels.eepromSummaryChannel[4].eeprom_info "argument of SetEEpromInitZyklisch" UBYTE SAB_STANDARD_S2_S3 1 100 0 255 ECU_ADDRESS 0xFFF96096 DISPLAY_IDENTIFIER eeprom_info.eepromSummaryChannel[4].allEepromSummeryChannels.EEpromZentralHandler._.ZFFSAB /end MEASUREMENT
/begin MEASUREMENT ZFFSAB._.EEpromZentralHandler.allEepromSummeryChannels.eepromSummaryChannel[4].ret_GetEEpromUpdate "Return value off function" UBYTE SAB_STANDARD_S2_S3 1 100 0 255 ECU_ADDRESS 0xFFF96093 DISPLAY_IDENTIFIER ret_GetEEpromUpdate.eepromSummaryChannel[4].allEepromSummeryChannels.EEpromZentralHandler._.ZFFSAB /end MEASUREMENT
/begin MEASUREMENT ZFFSAB._.EEpromZentralHandler.allEepromSummeryChannels.eepromSummaryChannel[4].ret_GetEEpromValid "Return value off function" UBYTE SAB_STANDARD_S2_S3 1 100 0 255 ECU_ADDRESS 0xFFF96091 DISPLAY_IDENTIFIER ret_GetEEpromValid.eepromSummaryChannel[4].allEepromSummeryChannels.EEpromZentralHandler._.ZFFSAB /end MEASUREMENT
/begin MEASUREMENT ZFFSAB._.EEpromZentralHandler.allEepromSummeryChannels.eepromSummaryChannel[4].ret_GetSizeofEEpromData "Return value off function" UWORD SAB_STANDARD_S2_S3 1 100 0 65535 ECU_ADDRESS 0xFFF96098 DISPLAY_IDENTIFIER ret_GetSizeofEEpromData.eepromSummaryChannel[4].allEepromSummeryChannels.EEpromZentralHandler._.ZFFSAB /end MEASUREMENT
/begin MEASUREMENT ZFFSAB._.EEpromZentralHandler.allEepromSummeryChannels.eepromSummaryChannel[4].ret_SetEEpromInitZyklisch "Return value off function" UBYTE SAB_STANDARD_S2_S3 1 100 0 255 ECU_ADDRESS 0xFFF96095 DISPLAY_IDENTIFIER ret_SetEEpromInitZyklisch.eepromSummaryChannel[4].allEepromSummeryChannels.EEpromZentralHandler._.ZFFSAB /end MEASUREMENT
/begin MEASUREMENT ZFFSAB._.EEpromZentralHandler.eepromChannel[0].ZFFSAB._.cEEpromChannel._.cnt_GetEEpromUpdate "Call counter off function" UBYTE SAB_STANDARD_S2_S3 1 100 0 255 ECU_ADDRESS 0xFFF95F4A DISPLAY_IDENTIFIER cnt_GetEEpromUpdate._.cEEpromChannel._.ZFFSAB.eepromChannel[0].EEpromZentralHandler._.ZFFSAB /end MEASUREMENT
/begin MEASUREMENT ZFFSAB._.EEpromZentralHandler.eepromChannel[0].ZFFSAB._.cEEpromChannel._.cnt_GetEEpromValid "Call counter off function" UBYTE SAB_STANDARD_S2_S3 1 100 0 255 ECU_ADDRESS 0xFFF95F48 DISPLAY_IDENTIFIER cnt_GetEEpromValid._.cEEpromChannel._.ZFFSAB.eepromChannel[0].EEpromZentralHandler._.ZFFSAB /end MEASUREMENT
/begin MEASUREMENT ZFFSAB._.EEpromZentralHandler.eepromChannel[0].ZFFSAB._.cEEpromChannel._.cnt_GetSizeofEEpromData "Call counter off function" UBYTE SAB_STANDARD_S2_S3 1 100 0 255 ECU_ADDRESS 0xFFF95F4F DISPLAY_IDENTIFIER cnt_GetSizeofEEpromData._.cEEpromChannel._.ZFFSAB.eepromChannel[0].EEpromZentralHandler._.ZFFSAB /end MEASUREMENT
/begin MEASUREMENT ZFFSAB._.EEpromZentralHandler.eepromChannel[0].ZFFSAB._.cEEpromChannel._.cnt_SetEEpromInitZyklisch "Call counter off function" UBYTE SAB_STANDARD_S2_S3 1 100 0 255 ECU_ADDRESS 0xFFF95F4C DISPLAY_IDENTIFIER cnt_SetEEpromInitZyklisch._.cEEpromChannel._.ZFFSAB.eepromChannel[0].EEpromZentralHandler._.ZFFSAB /end MEASUREMENT
/begin MEASUREMENT ZFFSAB._.EEpromZentralHandler.eepromChannel[0].ZFFSAB._.cEEpromChannel._.eeprom_info "argument of SetEEpromInitZyklisch" UBYTE SAB_STANDARD_S2_S3 1 100 0 255 ECU_ADDRESS 0xFFF95F4E DISPLAY_IDENTIFIER eeprom_info._.cEEpromChannel._.ZFFSAB.eepromChannel[0].EEpromZentralHandler._.ZFFSAB /end MEASUREMENT
/begin MEASUREMENT ZFFSAB._.EEpromZentralHandler.eepromChannel[0].ZFFSAB._.cEEpromChannel._.ret_GetEEpromUpdate "Return value off function" UBYTE SAB_STANDARD_S2_S3 1 100 0 255 ECU_ADDRESS 0xFFF95F4B DISPLAY_IDENTIFIER ret_GetEEpromUpdate._.cEEpromChannel._.ZFFSAB.eepromChannel[0].EEpromZentralHandler._.ZFFSAB /end MEASUREMENT
/begin MEASUREMENT ZFFSAB._.EEpromZentralHandler.eepromChannel[0].ZFFSAB._.cEEpromChannel._.ret_GetEEpromValid "Return value off function" UBYTE SAB_STANDARD_S2_S3 1 100 0 255 ECU_ADDRESS 0xFFF95F49 DISPLAY_IDENTIFIER ret_GetEEpromValid._.cEEpromChannel._.ZFFSAB.eepromChannel[0].EEpromZentralHandler._.ZFFSAB /end MEASUREMENT
/begin MEASUREMENT ZFFSAB._.EEpromZentralHandler.eepromChannel[0].ZFFSAB._.cEEpromChannel._.ret_GetSizeofEEpromData "Return value off function" UWORD SAB_STANDARD_S2_S3 1 100 0 65535 ECU_ADDRESS 0xFFF95F50 DISPLAY_IDENTIFIER ret_GetSizeofEEpromData._.cEEpromChannel._.ZFFSAB.eepromChannel[0].EEpromZentralHandler._.ZFFSAB /end MEASUREMENT
/begin MEASUREMENT ZFFSAB._.EEpromZentralHandler.eepromChannel[0].ZFFSAB._.cEEpromChannel._.ret_SetEEpromInitZyklisch "Return value off function" UBYTE SAB_STANDARD_S2_S3 1 100 0 255 ECU_ADDRESS 0xFFF95F4D DISPLAY_IDENTIFIER ret_SetEEpromInitZyklisch._.cEEpromChannel._.ZFFSAB.eepromChannel[0].EEpromZentralHandler._.ZFFSAB /end MEASUREMENT
/begin MEASUREMENT ZFFSAB._.EEpromZentralHandler.eepromChannel[0].cnt_CallEEpromLoadData "Call counter off function" UBYTE SAB_STANDARD_S2_S3 1 100 0 255 ECU_ADDRESS 0xFFF95F54 DISPLAY_IDENTIFIER cnt_CallEEpromLoadData.eepromChannel[0].EEpromZentralHandler._.ZFFSAB /end MEASUREMENT
/begin MEASUREMENT ZFFSAB._.EEpromZentralHandler.eepromChannel[0].cnt_CallEEpromLoadDataState "Call counter off function" UBYTE SAB_STANDARD_S2_S3 1 100 0 255 ECU_ADDRESS 0xFFF95F56 DISPLAY_IDENTIFIER cnt_CallEEpromLoadDataState.eepromChannel[0].EEpromZentralHandler._.ZFFSAB /end MEASUREMENT
/begin MEASUREMENT ZFFSAB._.EEpromZentralHandler.eepromChannel[0].cnt_CallEEpromStoreImmediate "Call counter off function" UBYTE SAB_STANDARD_S2_S3 1 100 0 255 ECU_ADDRESS 0xFFF95F52 DISPLAY_IDENTIFIER cnt_CallEEpromStoreImmediate.eepromChannel[0].EEpromZentralHandler._.ZFFSAB /end MEASUREMENT
/begin MEASUREMENT ZFFSAB._.EEpromZentralHandler.eepromChannel[0].cnt_SetEEpromWriteProtect "Call counter off function" UBYTE SAB_STANDARD_S2_S3 1 100 0 255 ECU_ADDRESS 0xFFF95F59 DISPLAY_IDENTIFIER cnt_SetEEpromWriteProtect.eepromChannel[0].EEpromZentralHandler._.ZFFSAB /end MEASUREMENT
/begin MEASUREMENT ZFFSAB._.EEpromZentralHandler.eepromChannel[0].mode "argument of SetEEpromInitZyklisch" UBYTE SAB_STANDARD_S2_S3 1 100 0 255 ECU_ADDRESS 0xFFF95F58 DISPLAY_IDENTIFIER mode.eepromChannel[0].EEpromZentralHandler._.ZFFSAB /end MEASUREMENT
/begin MEASUREMENT ZFFSAB._.EEpromZentralHandler.eepromChannel[0].ret_CallEEpromLoadData "Return value off function" UBYTE SAB_STANDARD_S2_S3 1 100 0 255 ECU_ADDRESS 0xFFF95F55 DISPLAY_IDENTIFIER ret_CallEEpromLoadData.eepromChannel[0].EEpromZentralHandler._.ZFFSAB /end MEASUREMENT
/begin MEASUREMENT ZFFSAB._.EEpromZentralHandler.eepromChannel[0].ret_CallEEpromLoadDataState "Return value off function" UBYTE SAB_STANDARD_S2_S3 1 100 0 255 ECU_ADDRESS 0xFFF95F57 DISPLAY_IDENTIFIER ret_CallEEpromLoadDataState.eepromChannel[0].EEpromZentralHandler._.ZFFSAB /end MEASUREMENT
/begin MEASUREMENT ZFFSAB._.EEpromZentralHandler.eepromChannel[0].ret_CallEEpromStoreImmediate "Return value off function" UBYTE SAB_STANDARD_S2_S3 1 100 0 255 ECU_ADDRESS 0xFFF95F53 DISPLAY_IDENTIFIER ret_CallEEpromStoreImmediate.eepromChannel[0].EEpromZentralHandler._.ZFFSAB /end MEASUREMENT
/begin MEASUREMENT ZFFSAB._.EEpromZentralHandler.eepromChannel[10].ZFFSAB._.cEEpromChannel._.cnt_GetEEpromUpdate "Call counter off function" UBYTE SAB_STANDARD_S2_S3 1 100 0 255 ECU_ADDRESS 0xFFF95FFE DISPLAY_IDENTIFIER cnt_GetEEpromUpdate._.cEEpromChannel._.ZFFSAB.eepromChannel[10].EEpromZentralHandler._.ZFFSAB /end MEASUREMENT
/begin MEASUREMENT ZFFSAB._.EEpromZentralHandler.eepromChannel[10].ZFFSAB._.cEEpromChannel._.cnt_GetEEpromValid "Call counter off function" UBYTE SAB_STANDARD_S2_S3 1 100 0 255 ECU_ADDRESS 0xFFF95FFC DISPLAY_IDENTIFIER cnt_GetEEpromValid._.cEEpromChannel._.ZFFSAB.eepromChannel[10].EEpromZentralHandler._.ZFFSAB /end MEASUREMENT
/begin MEASUREMENT ZFFSAB._.EEpromZentralHandler.eepromChannel[10].ZFFSAB._.cEEpromChannel._.cnt_GetSizeofEEpromData "Call counter off function" UBYTE SAB_STANDARD_S2_S3 1 100 0 255 ECU_ADDRESS 0xFFF96003 DISPLAY_IDENTIFIER cnt_GetSizeofEEpromData._.cEEpromChannel._.ZFFSAB.eepromChannel[10].EEpromZentralHandler._.ZFFSAB /end MEASUREMENT
/begin MEASUREMENT ZFFSAB._.EEpromZentralHandler.eepromChannel[10].ZFFSAB._.cEEpromChannel._.cnt_SetEEpromInitZyklisch "Call counter off function" UBYTE SAB_STANDARD_S2_S3 1 100 0 255 ECU_ADDRESS 0xFFF96000 DISPLAY_IDENTIFIER cnt_SetEEpromInitZyklisch._.cEEpromChannel._.ZFFSAB.eepromChannel[10].EEpromZentralHandler._.ZFFSAB /end MEASUREMENT
/begin MEASUREMENT ZFFSAB._.EEpromZentralHandler.eepromChannel[10].ZFFSAB._.cEEpromChannel._.eeprom_info "argument of SetEEpromInitZyklisch" UBYTE SAB_STANDARD_S2_S3 1 100 0 255 ECU_ADDRESS 0xFFF96002 DISPLAY_IDENTIFIER eeprom_info._.cEEpromChannel._.ZFFSAB.eepromChannel[10].EEpromZentralHandler._.ZFFSAB /end MEASUREMENT
/begin MEASUREMENT ZFFSAB._.EEpromZentralHandler.eepromChannel[10].ZFFSAB._.cEEpromChannel._.ret_GetEEpromUpdate "Return value off function" UBYTE SAB_STANDARD_S2_S3 1 100 0 255 ECU_ADDRESS 0xFFF95FFF DISPLAY_IDENTIFIER ret_GetEEpromUpdate._.cEEpromChannel._.ZFFSAB.eepromChannel[10].EEpromZentralHandler._.ZFFSAB /end MEASUREMENT
/begin MEASUREMENT ZFFSAB._.EEpromZentralHandler.eepromChannel[10].ZFFSAB._.cEEpromChannel._.ret_GetEEpromValid "Return value off function" UBYTE SAB_STANDARD_S2_S3 1 100 0 255 ECU_ADDRESS 0xFFF95FFD DISPLAY_IDENTIFIER ret_GetEEpromValid._.cEEpromChannel._.ZFFSAB.eepromChannel[10].EEpromZentralHandler._.ZFFSAB /end MEASUREMENT
/begin MEASUREMENT ZFFSAB._.EEpromZentralHandler.eepromChannel[10].ZFFSAB._.cEEpromChannel._.ret_GetSizeofEEpromData "Return value off function" UWORD SAB_STANDARD_S2_S3 1 100 0 65535 ECU_ADDRESS 0xFFF96004 DISPLAY_IDENTIFIER ret_GetSizeofEEpromData._.cEEpromChannel._.ZFFSAB.eepromChannel[10].EEpromZentralHandler._.ZFFSAB /end MEASUREMENT
/begin MEASUREMENT ZFFSAB._.EEpromZentralHandler.eepromChannel[10].ZFFSAB._.cEEpromChannel._.ret_SetEEpromInitZyklisch "Return value off function" UBYTE SAB_STANDARD_S2_S3 1 100 0 255 ECU_ADDRESS 0xFFF96001 DISPLAY_IDENTIFIER ret_SetEEpromInitZyklisch._.cEEpromChannel._.ZFFSAB.eepromChannel[10].EEpromZentralHandler._.ZFFSAB /end MEASUREMENT
/begin MEASUREMENT ZFFSAB._.EEpromZentralHandler.eepromChannel[10].cnt_CallEEpromLoadData "Call counter off function" UBYTE SAB_STANDARD_S2_S3 1 100 0 255 ECU_ADDRESS 0xFFF96008 DISPLAY_IDENTIFIER cnt_CallEEpromLoadData.eepromChannel[10].EEpromZentralHandler._.ZFFSAB /end MEASUREMENT
/begin MEASUREMENT ZFFSAB._.EEpromZentralHandler.eepromChannel[10].cnt_CallEEpromLoadDataState "Call counter off function" UBYTE SAB_STANDARD_S2_S3 1 100 0 255 ECU_ADDRESS 0xFFF9600A DISPLAY_IDENTIFIER cnt_CallEEpromLoadDataState.eepromChannel[10].EEpromZentralHandler._.ZFFSAB /end MEASUREMENT
/begin MEASUREMENT ZFFSAB._.EEpromZentralHandler.eepromChannel[10].cnt_CallEEpromStoreImmediate "Call counter off function" UBYTE SAB_STANDARD_S2_S3 1 100 0 255 ECU_ADDRESS 0xFFF96006 DISPLAY_IDENTIFIER cnt_CallEEpromStoreImmediate.eepromChannel[10].EEpromZentralHandler._.ZFFSAB /end MEASUREMENT
/begin MEASUREMENT ZFFSAB._.EEpromZentralHandler.eepromChannel[10].cnt_SetEEpromWriteProtect "Call counter off function" UBYTE SAB_STANDARD_S2_S3 1 100 0 255 ECU_ADDRESS 0xFFF9600D DISPLAY_IDENTIFIER cnt_SetEEpromWriteProtect.eepromChannel[10].EEpromZentralHandler._.ZFFSAB /end MEASUREMENT
/begin MEASUREMENT ZFFSAB._.EEpromZentralHandler.eepromChannel[10].mode "argument of SetEEpromInitZyklisch" UBYTE SAB_STANDARD_S2_S3 1 100 0 255 ECU_ADDRESS 0xFFF9600C DISPLAY_IDENTIFIER mode.eepromChannel[10].EEpromZentralHandler._.ZFFSAB /end MEASUREMENT
/begin MEASUREMENT ZFFSAB._.EEpromZentralHandler.eepromChannel[10].ret_CallEEpromLoadData "Return value off function" UBYTE SAB_STANDARD_S2_S3 1 100 0 255 ECU_ADDRESS 0xFFF96009 DISPLAY_IDENTIFIER ret_CallEEpromLoadData.eepromChannel[10].EEpromZentralHandler._.ZFFSAB /end MEASUREMENT
/begin MEASUREMENT ZFFSAB._.EEpromZentralHandler.eepromChannel[10].ret_CallEEpromLoadDataState "Return value off function" UBYTE SAB_STANDARD_S2_S3 1 100 0 255 ECU_ADDRESS 0xFFF9600B DISPLAY_IDENTIFIER ret_CallEEpromLoadDataState.eepromChannel[10].EEpromZentralHandler._.ZFFSAB /end MEASUREMENT
/begin MEASUREMENT ZFFSAB._.EEpromZentralHandler.eepromChannel[10].ret_CallEEpromStoreImmediate "Return value off function" UBYTE SAB_STANDARD_S2_S3 1 100 0 255 ECU_ADDRESS 0xFFF96007 DISPLAY_IDENTIFIER ret_CallEEpromStoreImmediate.eepromChannel[10].EEpromZentralHandler._.ZFFSAB /end MEASUREMENT
/begin MEASUREMENT ZFFSAB._.EEpromZentralHandler.eepromChannel[11].ZFFSAB._.cEEpromChannel._.cnt_GetEEpromUpdate "Call counter off function" UBYTE SAB_STANDARD_S2_S3 1 100 0 255 ECU_ADDRESS 0xFFF96010 DISPLAY_IDENTIFIER cnt_GetEEpromUpdate._.cEEpromChannel._.ZFFSAB.eepromChannel[11].EEpromZentralHandler._.ZFFSAB /end MEASUREMENT
/begin MEASUREMENT ZFFSAB._.EEpromZentralHandler.eepromChannel[11].ZFFSAB._.cEEpromChannel._.cnt_GetEEpromValid "Call counter off function" UBYTE SAB_STANDARD_S2_S3 1 100 0 255 ECU_ADDRESS 0xFFF9600E DISPLAY_IDENTIFIER cnt_GetEEpromValid._.cEEpromChannel._.ZFFSAB.eepromChannel[11].EEpromZentralHandler._.ZFFSAB /end MEASUREMENT
/begin MEASUREMENT ZFFSAB._.EEpromZentralHandler.eepromChannel[11].ZFFSAB._.cEEpromChannel._.cnt_GetSizeofEEpromData "Call counter off function" UBYTE SAB_STANDARD_S2_S3 1 100 0 255 ECU_ADDRESS 0xFFF96015 DISPLAY_IDENTIFIER cnt_GetSizeofEEpromData._.cEEpromChannel._.ZFFSAB.eepromChannel[11].EEpromZentralHandler._.ZFFSAB /end MEASUREMENT
/begin MEASUREMENT ZFFSAB._.EEpromZentralHandler.eepromChannel[11].ZFFSAB._.cEEpromChannel._.cnt_SetEEpromInitZyklisch "Call counter off function" UBYTE SAB_STANDARD_S2_S3 1 100 0 255 ECU_ADDRESS 0xFFF96012 DISPLAY_IDENTIFIER cnt_SetEEpromInitZyklisch._.cEEpromChannel._.ZFFSAB.eepromChannel[11].EEpromZentralHandler._.ZFFSAB /end MEASUREMENT
/begin MEASUREMENT ZFFSAB._.EEpromZentralHandler.eepromChannel[11].ZFFSAB._.cEEpromChannel._.eeprom_info "argument of SetEEpromInitZyklisch" UBYTE SAB_STANDARD_S2_S3 1 100 0 255 ECU_ADDRESS 0xFFF96014 DISPLAY_IDENTIFIER eeprom_info._.cEEpromChannel._.ZFFSAB.eepromChannel[11].EEpromZentralHandler._.ZFFSAB /end MEASUREMENT
/begin MEASUREMENT ZFFSAB._.EEpromZentralHandler.eepromChannel[11].ZFFSAB._.cEEpromChannel._.ret_GetEEpromUpdate "Return value off function" UBYTE SAB_STANDARD_S2_S3 1 100 0 255 ECU_ADDRESS 0xFFF96011 DISPLAY_IDENTIFIER ret_GetEEpromUpdate._.cEEpromChannel._.ZFFSAB.eepromChannel[11].EEpromZentralHandler._.ZFFSAB /end MEASUREMENT
/begin MEASUREMENT ZFFSAB._.EEpromZentralHandler.eepromChannel[11].ZFFSAB._.cEEpromChannel._.ret_GetEEpromValid "Return value off function" UBYTE SAB_STANDARD_S2_S3 1 100 0 255 ECU_ADDRESS 0xFFF9600F DISPLAY_IDENTIFIER ret_GetEEpromValid._.cEEpromChannel._.ZFFSAB.eepromChannel[11].EEpromZentralHandler._.ZFFSAB /end MEASUREMENT
/begin MEASUREMENT ZFFSAB._.EEpromZentralHandler.eepromChannel[11].ZFFSAB._.cEEpromChannel._.ret_GetSizeofEEpromData "Return value off function" UWORD SAB_STANDARD_S2_S3 1 100 0 65535 ECU_ADDRESS 0xFFF96016 DISPLAY_IDENTIFIER ret_GetSizeofEEpromData._.cEEpromChannel._.ZFFSAB.eepromChannel[11].EEpromZentralHandler._.ZFFSAB /end MEASUREMENT
/begin MEASUREMENT ZFFSAB._.EEpromZentralHandler.eepromChannel[11].ZFFSAB._.cEEpromChannel._.ret_SetEEpromInitZyklisch "Return value off function" UBYTE SAB_STANDARD_S2_S3 1 100 0 255 ECU_ADDRESS 0xFFF96013 DISPLAY_IDENTIFIER ret_SetEEpromInitZyklisch._.cEEpromChannel._.ZFFSAB.eepromChannel[11].EEpromZentralHandler._.ZFFSAB /end MEASUREMENT
/begin MEASUREMENT ZFFSAB._.EEpromZentralHandler.eepromChannel[11].cnt_CallEEpromLoadData "Call counter off function" UBYTE SAB_STANDARD_S2_S3 1 100 0 255 ECU_ADDRESS 0xFFF9601A DISPLAY_IDENTIFIER cnt_CallEEpromLoadData.eepromChannel[11].EEpromZentralHandler._.ZFFSAB /end MEASUREMENT
/begin MEASUREMENT ZFFSAB._.EEpromZentralHandler.eepromChannel[11].cnt_CallEEpromLoadDataState "Call counter off function" UBYTE SAB_STANDARD_S2_S3 1 100 0 255 ECU_ADDRESS 0xFFF9601C DISPLAY_IDENTIFIER cnt_CallEEpromLoadDataState.eepromChannel[11].EEpromZentralHandler._.ZFFSAB /end MEASUREMENT
/begin MEASUREMENT ZFFSAB._.EEpromZentralHandler.eepromChannel[11].cnt_CallEEpromStoreImmediate "Call counter off function" UBYTE SAB_STANDARD_S2_S3 1 100 0 255 ECU_ADDRESS 0xFFF96018 DISPLAY_IDENTIFIER cnt_CallEEpromStoreImmediate.eepromChannel[11].EEpromZentralHandler._.ZFFSAB /end MEASUREMENT
/begin MEASUREMENT ZFFSAB._.EEpromZentralHandler.eepromChannel[11].cnt_SetEEpromWriteProtect "Call counter off function" UBYTE SAB_STANDARD_S2_S3 1 100 0 255 ECU_ADDRESS 0xFFF9601F DISPLAY_IDENTIFIER cnt_SetEEpromWriteProtect.eepromChannel[11].EEpromZentralHandler._.ZFFSAB /end MEASUREMENT
/begin MEASUREMENT ZFFSAB._.EEpromZentralHandler.eepromChannel[11].mode "argument of SetEEpromInitZyklisch" UBYTE SAB_STANDARD_S2_S3 1 100 0 255 ECU_ADDRESS 0xFFF9601E DISPLAY_IDENTIFIER mode.eepromChannel[11].EEpromZentralHandler._.ZFFSAB /end MEASUREMENT
/begin MEASUREMENT ZFFSAB._.EEpromZentralHandler.eepromChannel[11].ret_CallEEpromLoadData "Return value off function" UBYTE SAB_STANDARD_S2_S3 1 100 0 255 ECU_ADDRESS 0xFFF9601B DISPLAY_IDENTIFIER ret_CallEEpromLoadData.eepromChannel[11].EEpromZentralHandler._.ZFFSAB /end MEASUREMENT
/begin MEASUREMENT ZFFSAB._.EEpromZentralHandler.eepromChannel[11].ret_CallEEpromLoadDataState "Return value off function" UBYTE SAB_STANDARD_S2_S3 1 100 0 255 ECU_ADDRESS 0xFFF9601D DISPLAY_IDENTIFIER ret_CallEEpromLoadDataState.eepromChannel[11].EEpromZentralHandler._.ZFFSAB /end MEASUREMENT
/begin MEASUREMENT ZFFSAB._.EEpromZentralHandler.eepromChannel[11].ret_CallEEpromStoreImmediate "Return value off function" UBYTE SAB_STANDARD_S2_S3 1 100 0 255 ECU_ADDRESS 0xFFF96019 DISPLAY_IDENTIFIER ret_CallEEpromStoreImmediate.eepromChannel[11].EEpromZentralHandler._.ZFFSAB /end MEASUREMENT
/begin MEASUREMENT ZFFSAB._.EEpromZentralHandler.eepromChannel[12].ZFFSAB._.cEEpromChannel._.cnt_GetEEpromUpdate "Call counter off function" UBYTE SAB_STANDARD_S2_S3 1 100 0 255 ECU_ADDRESS 0xFFF96022 DISPLAY_IDENTIFIER cnt_GetEEpromUpdate._.cEEpromChannel._.ZFFSAB.eepromChannel[12].EEpromZentralHandler._.ZFFSAB /end MEASUREMENT
/begin MEASUREMENT ZFFSAB._.EEpromZentralHandler.eepromChannel[12].ZFFSAB._.cEEpromChannel._.cnt_GetEEpromValid "Call counter off function" UBYTE SAB_STANDARD_S2_S3 1 100 0 255 ECU_ADDRESS 0xFFF96020 DISPLAY_IDENTIFIER cnt_GetEEpromValid._.cEEpromChannel._.ZFFSAB.eepromChannel[12].EEpromZentralHandler._.ZFFSAB /end MEASUREMENT
/begin MEASUREMENT ZFFSAB._.EEpromZentralHandler.eepromChannel[12].ZFFSAB._.cEEpromChannel._.cnt_GetSizeofEEpromData "Call counter off function" UBYTE SAB_STANDARD_S2_S3 1 100 0 255 ECU_ADDRESS 0xFFF96027 DISPLAY_IDENTIFIER cnt_GetSizeofEEpromData._.cEEpromChannel._.ZFFSAB.eepromChannel[12].EEpromZentralHandler._.ZFFSAB /end MEASUREMENT
/begin MEASUREMENT ZFFSAB._.EEpromZentralHandler.eepromChannel[12].ZFFSAB._.cEEpromChannel._.cnt_SetEEpromInitZyklisch "Call counter off function" UBYTE SAB_STANDARD_S2_S3 1 100 0 255 ECU_ADDRESS 0xFFF96024 DISPLAY_IDENTIFIER cnt_SetEEpromInitZyklisch._.cEEpromChannel._.ZFFSAB.eepromChannel[12].EEpromZentralHandler._.ZFFSAB /end MEASUREMENT
/begin MEASUREMENT ZFFSAB._.EEpromZentralHandler.eepromChannel[12].ZFFSAB._.cEEpromChannel._.eeprom_info "argument of SetEEpromInitZyklisch" UBYTE SAB_STANDARD_S2_S3 1 100 0 255 ECU_ADDRESS 0xFFF96026 DISPLAY_IDENTIFIER eeprom_info._.cEEpromChannel._.ZFFSAB.eepromChannel[12].EEpromZentralHandler._.ZFFSAB /end MEASUREMENT
/begin MEASUREMENT ZFFSAB._.EEpromZentralHandler.eepromChannel[12].ZFFSAB._.cEEpromChannel._.ret_GetEEpromUpdate "Return value off function" UBYTE SAB_STANDARD_S2_S3 1 100 0 255 ECU_ADDRESS 0xFFF96023 DISPLAY_IDENTIFIER ret_GetEEpromUpdate._.cEEpromChannel._.ZFFSAB.eepromChannel[12].EEpromZentralHandler._.ZFFSAB /end MEASUREMENT
/begin MEASUREMENT ZFFSAB._.EEpromZentralHandler.eepromChannel[12].ZFFSAB._.cEEpromChannel._.ret_GetEEpromValid "Return value off function" UBYTE SAB_STANDARD_S2_S3 1 100 0 255 ECU_ADDRESS 0xFFF96021 DISPLAY_IDENTIFIER ret_GetEEpromValid._.cEEpromChannel._.ZFFSAB.eepromChannel[12].EEpromZentralHandler._.ZFFSAB /end MEASUREMENT
/begin MEASUREMENT ZFFSAB._.EEpromZentralHandler.eepromChannel[12].ZFFSAB._.cEEpromChannel._.ret_GetSizeofEEpromData "Return value off function" UWORD SAB_STANDARD_S2_S3 1 100 0 65535 ECU_ADDRESS 0xFFF96028 DISPLAY_IDENTIFIER ret_GetSizeofEEpromData._.cEEpromChannel._.ZFFSAB.eepromChannel[12].EEpromZentralHandler._.ZFFSAB /end MEASUREMENT
/begin MEASUREMENT ZFFSAB._.EEpromZentralHandler.eepromChannel[12].ZFFSAB._.cEEpromChannel._.ret_SetEEpromInitZyklisch "Return value off function" UBYTE SAB_STANDARD_S2_S3 1 100 0 255 ECU_ADDRESS 0xFFF96025 DISPLAY_IDENTIFIER ret_SetEEpromInitZyklisch._.cEEpromChannel._.ZFFSAB.eepromChannel[12].EEpromZentralHandler._.ZFFSAB /end MEASUREMENT
/begin MEASUREMENT ZFFSAB._.EEpromZentralHandler.eepromChannel[12].cnt_CallEEpromLoadData "Call counter off function" UBYTE SAB_STANDARD_S2_S3 1 100 0 255 ECU_ADDRESS 0xFFF9602C DISPLAY_IDENTIFIER cnt_CallEEpromLoadData.eepromChannel[12].EEpromZentralHandler._.ZFFSAB /end MEASUREMENT
/begin MEASUREMENT ZFFSAB._.EEpromZentralHandler.eepromChannel[12].cnt_CallEEpromLoadDataState "Call counter off function" UBYTE SAB_STANDARD_S2_S3 1 100 0 255 ECU_ADDRESS 0xFFF9602E DISPLAY_IDENTIFIER cnt_CallEEpromLoadDataState.eepromChannel[12].EEpromZentralHandler._.ZFFSAB /end MEASUREMENT
/begin MEASUREMENT ZFFSAB._.EEpromZentralHandler.eepromChannel[12].cnt_CallEEpromStoreImmediate "Call counter off function" UBYTE SAB_STANDARD_S2_S3 1 100 0 255 ECU_ADDRESS 0xFFF9602A DISPLAY_IDENTIFIER cnt_CallEEpromStoreImmediate.eepromChannel[12].EEpromZentralHandler._.ZFFSAB /end MEASUREMENT
/begin MEASUREMENT ZFFSAB._.EEpromZentralHandler.eepromChannel[12].cnt_SetEEpromWriteProtect "Call counter off function" UBYTE SAB_STANDARD_S2_S3 1 100 0 255 ECU_ADDRESS 0xFFF96031 DISPLAY_IDENTIFIER cnt_SetEEpromWriteProtect.eepromChannel[12].EEpromZentralHandler._.ZFFSAB /end MEASUREMENT
/begin MEASUREMENT ZFFSAB._.EEpromZentralHandler.eepromChannel[12].mode "argument of SetEEpromInitZyklisch" UBYTE SAB_STANDARD_S2_S3 1 100 0 255 ECU_ADDRESS 0xFFF96030 DISPLAY_IDENTIFIER mode.eepromChannel[12].EEpromZentralHandler._.ZFFSAB /end MEASUREMENT
/begin MEASUREMENT ZFFSAB._.EEpromZentralHandler.eepromChannel[12].ret_CallEEpromLoadData "Return value off function" UBYTE SAB_STANDARD_S2_S3 1 100 0 255 ECU_ADDRESS 0xFFF9602D DISPLAY_IDENTIFIER ret_CallEEpromLoadData.eepromChannel[12].EEpromZentralHandler._.ZFFSAB /end MEASUREMENT
/begin MEASUREMENT ZFFSAB._.EEpromZentralHandler.eepromChannel[12].ret_CallEEpromLoadDataState "Return value off function" UBYTE SAB_STANDARD_S2_S3 1 100 0 255 ECU_ADDRESS 0xFFF9602F DISPLAY_IDENTIFIER ret_CallEEpromLoadDataState.eepromChannel[12].EEpromZentralHandler._.ZFFSAB /end MEASUREMENT
/begin MEASUREMENT ZFFSAB._.EEpromZentralHandler.eepromChannel[12].ret_CallEEpromStoreImmediate "Return value off function" UBYTE SAB_STANDARD_S2_S3 1 100 0 255 ECU_ADDRESS 0xFFF9602B DISPLAY_IDENTIFIER ret_CallEEpromStoreImmediate.eepromChannel[12].EEpromZentralHandler._.ZFFSAB /end MEASUREMENT
/begin MEASUREMENT ZFFSAB._.EEpromZentralHandler.eepromChannel[13].ZFFSAB._.cEEpromChannel._.cnt_GetEEpromUpdate "Call counter off function" UBYTE SAB_STANDARD_S2_S3 1 100 0 255 ECU_ADDRESS 0xFFF96034 DISPLAY_IDENTIFIER cnt_GetEEpromUpdate._.cEEpromChannel._.ZFFSAB.eepromChannel[13].EEpromZentralHandler._.ZFFSAB /end MEASUREMENT
/begin MEASUREMENT ZFFSAB._.EEpromZentralHandler.eepromChannel[13].ZFFSAB._.cEEpromChannel._.cnt_GetEEpromValid "Call counter off function" UBYTE SAB_STANDARD_S2_S3 1 100 0 255 ECU_ADDRESS 0xFFF96032 DISPLAY_IDENTIFIER cnt_GetEEpromValid._.cEEpromChannel._.ZFFSAB.eepromChannel[13].EEpromZentralHandler._.ZFFSAB /end MEASUREMENT
/begin MEASUREMENT ZFFSAB._.EEpromZentralHandler.eepromChannel[13].ZFFSAB._.cEEpromChannel._.cnt_GetSizeofEEpromData "Call counter off function" UBYTE SAB_STANDARD_S2_S3 1 100 0 255 ECU_ADDRESS 0xFFF96039 DISPLAY_IDENTIFIER cnt_GetSizeofEEpromData._.cEEpromChannel._.ZFFSAB.eepromChannel[13].EEpromZentralHandler._.ZFFSAB /end MEASUREMENT
/begin MEASUREMENT ZFFSAB._.EEpromZentralHandler.eepromChannel[13].ZFFSAB._.cEEpromChannel._.cnt_SetEEpromInitZyklisch "Call counter off function" UBYTE SAB_STANDARD_S2_S3 1 100 0 255 ECU_ADDRESS 0xFFF96036 DISPLAY_IDENTIFIER cnt_SetEEpromInitZyklisch._.cEEpromChannel._.ZFFSAB.eepromChannel[13].EEpromZentralHandler._.ZFFSAB /end MEASUREMENT
/begin MEASUREMENT ZFFSAB._.EEpromZentralHandler.eepromChannel[13].ZFFSAB._.cEEpromChannel._.eeprom_info "argument of SetEEpromInitZyklisch" UBYTE SAB_STANDARD_S2_S3 1 100 0 255 ECU_ADDRESS 0xFFF96038 DISPLAY_IDENTIFIER eeprom_info._.cEEpromChannel._.ZFFSAB.eepromChannel[13].EEpromZentralHandler._.ZFFSAB /end MEASUREMENT
/begin MEASUREMENT ZFFSAB._.EEpromZentralHandler.eepromChannel[13].ZFFSAB._.cEEpromChannel._.ret_GetEEpromUpdate "Return value off function" UBYTE SAB_STANDARD_S2_S3 1 100 0 255 ECU_ADDRESS 0xFFF96035 DISPLAY_IDENTIFIER ret_GetEEpromUpdate._.cEEpromChannel._.ZFFSAB.eepromChannel[13].EEpromZentralHandler._.ZFFSAB /end MEASUREMENT
/begin MEASUREMENT ZFFSAB._.EEpromZentralHandler.eepromChannel[13].ZFFSAB._.cEEpromChannel._.ret_GetEEpromValid "Return value off function" UBYTE SAB_STANDARD_S2_S3 1 100 0 255 ECU_ADDRESS 0xFFF96033 DISPLAY_IDENTIFIER ret_GetEEpromValid._.cEEpromChannel._.ZFFSAB.eepromChannel[13].EEpromZentralHandler._.ZFFSAB /end MEASUREMENT
/begin MEASUREMENT ZFFSAB._.EEpromZentralHandler.eepromChannel[13].ZFFSAB._.cEEpromChannel._.ret_GetSizeofEEpromData "Return value off function" UWORD SAB_STANDARD_S2_S3 1 100 0 65535 ECU_ADDRESS 0xFFF9603A DISPLAY_IDENTIFIER ret_GetSizeofEEpromData._.cEEpromChannel._.ZFFSAB.eepromChannel[13].EEpromZentralHandler._.ZFFSAB /end MEASUREMENT
/begin MEASUREMENT ZFFSAB._.EEpromZentralHandler.eepromChannel[13].ZFFSAB._.cEEpromChannel._.ret_SetEEpromInitZyklisch "Return value off function" UBYTE SAB_STANDARD_S2_S3 1 100 0 255 ECU_ADDRESS 0xFFF96037 DISPLAY_IDENTIFIER ret_SetEEpromInitZyklisch._.cEEpromChannel._.ZFFSAB.eepromChannel[13].EEpromZentralHandler._.ZFFSAB /end MEASUREMENT
/begin MEASUREMENT ZFFSAB._.EEpromZentralHandler.eepromChannel[13].cnt_CallEEpromLoadData "Call counter off function" UBYTE SAB_STANDARD_S2_S3 1 100 0 255 ECU_ADDRESS 0xFFF9603E DISPLAY_IDENTIFIER cnt_CallEEpromLoadData.eepromChannel[13].EEpromZentralHandler._.ZFFSAB /end MEASUREMENT
/begin MEASUREMENT ZFFSAB._.EEpromZentralHandler.eepromChannel[13].cnt_CallEEpromLoadDataState "Call counter off function" UBYTE SAB_STANDARD_S2_S3 1 100 0 255 ECU_ADDRESS 0xFFF96040 DISPLAY_IDENTIFIER cnt_CallEEpromLoadDataState.eepromChannel[13].EEpromZentralHandler._.ZFFSAB /end MEASUREMENT
/begin MEASUREMENT ZFFSAB._.EEpromZentralHandler.eepromChannel[13].cnt_CallEEpromStoreImmediate "Call counter off function" UBYTE SAB_STANDARD_S2_S3 1 100 0 255 ECU_ADDRESS 0xFFF9603C DISPLAY_IDENTIFIER cnt_CallEEpromStoreImmediate.eepromChannel[13].EEpromZentralHandler._.ZFFSAB /end MEASUREMENT
/begin MEASUREMENT ZFFSAB._.EEpromZentralHandler.eepromChannel[13].cnt_SetEEpromWriteProtect "Call counter off function" UBYTE SAB_STANDARD_S2_S3 1 100 0 255 ECU_ADDRESS 0xFFF96043 DISPLAY_IDENTIFIER cnt_SetEEpromWriteProtect.eepromChannel[13].EEpromZentralHandler._.ZFFSAB /end MEASUREMENT
/begin MEASUREMENT ZFFSAB._.EEpromZentralHandler.eepromChannel[13].mode "argument of SetEEpromInitZyklisch" UBYTE SAB_STANDARD_S2_S3 1 100 0 255 ECU_ADDRESS 0xFFF96042 DISPLAY_IDENTIFIER mode.eepromChannel[13].EEpromZentralHandler._.ZFFSAB /end MEASUREMENT
/begin MEASUREMENT ZFFSAB._.EEpromZentralHandler.eepromChannel[13].ret_CallEEpromLoadData "Return value off function" UBYTE SAB_STANDARD_S2_S3 1 100 0 255 ECU_ADDRESS 0xFFF9603F DISPLAY_IDENTIFIER ret_CallEEpromLoadData.eepromChannel[13].EEpromZentralHandler._.ZFFSAB /end MEASUREMENT
/begin MEASUREMENT ZFFSAB._.EEpromZentralHandler.eepromChannel[13].ret_CallEEpromLoadDataState "Return value off function" UBYTE SAB_STANDARD_S2_S3 1 100 0 255 ECU_ADDRESS 0xFFF96041 DISPLAY_IDENTIFIER ret_CallEEpromLoadDataState.eepromChannel[13].EEpromZentralHandler._.ZFFSAB /end MEASUREMENT
/begin MEASUREMENT ZFFSAB._.EEpromZentralHandler.eepromChannel[13].ret_CallEEpromStoreImmediate "Return value off function" UBYTE SAB_STANDARD_S2_S3 1 100 0 255 ECU_ADDRESS 0xFFF9603D DISPLAY_IDENTIFIER ret_CallEEpromStoreImmediate.eepromChannel[13].EEpromZentralHandler._.ZFFSAB /end MEASUREMENT
/begin MEASUREMENT ZFFSAB._.EEpromZentralHandler.eepromChannel[14].ZFFSAB._.cEEpromChannel._.cnt_GetEEpromUpdate "Call counter off function" UBYTE SAB_STANDARD_S2_S3 1 100 0 255 ECU_ADDRESS 0xFFF96046 DISPLAY_IDENTIFIER cnt_GetEEpromUpdate._.cEEpromChannel._.ZFFSAB.eepromChannel[14].EEpromZentralHandler._.ZFFSAB /end MEASUREMENT
/begin MEASUREMENT ZFFSAB._.EEpromZentralHandler.eepromChannel[14].ZFFSAB._.cEEpromChannel._.cnt_GetEEpromValid "Call counter off function" UBYTE SAB_STANDARD_S2_S3 1 100 0 255 ECU_ADDRESS 0xFFF96044 DISPLAY_IDENTIFIER cnt_GetEEpromValid._.cEEpromChannel._.ZFFSAB.eepromChannel[14].EEpromZentralHandler._.ZFFSAB /end MEASUREMENT
/begin MEASUREMENT ZFFSAB._.EEpromZentralHandler.eepromChannel[14].ZFFSAB._.cEEpromChannel._.cnt_GetSizeofEEpromData "Call counter off function" UBYTE SAB_STANDARD_S2_S3 1 100 0 255 ECU_ADDRESS 0xFFF9604B DISPLAY_IDENTIFIER cnt_GetSizeofEEpromData._.cEEpromChannel._.ZFFSAB.eepromChannel[14].EEpromZentralHandler._.ZFFSAB /end MEASUREMENT
/begin MEASUREMENT ZFFSAB._.EEpromZentralHandler.eepromChannel[14].ZFFSAB._.cEEpromChannel._.cnt_SetEEpromInitZyklisch "Call counter off function" UBYTE SAB_STANDARD_S2_S3 1 100 0 255 ECU_ADDRESS 0xFFF96048 DISPLAY_IDENTIFIER cnt_SetEEpromInitZyklisch._.cEEpromChannel._.ZFFSAB.eepromChannel[14].EEpromZentralHandler._.ZFFSAB /end MEASUREMENT
/begin MEASUREMENT ZFFSAB._.EEpromZentralHandler.eepromChannel[14].ZFFSAB._.cEEpromChannel._.eeprom_info "argument of SetEEpromInitZyklisch" UBYTE SAB_STANDARD_S2_S3 1 100 0 255 ECU_ADDRESS 0xFFF9604A DISPLAY_IDENTIFIER eeprom_info._.cEEpromChannel._.ZFFSAB.eepromChannel[14].EEpromZentralHandler._.ZFFSAB /end MEASUREMENT
/begin MEASUREMENT ZFFSAB._.EEpromZentralHandler.eepromChannel[14].ZFFSAB._.cEEpromChannel._.ret_GetEEpromUpdate "Return value off function" UBYTE SAB_STANDARD_S2_S3 1 100 0 255 ECU_ADDRESS 0xFFF96047 DISPLAY_IDENTIFIER ret_GetEEpromUpdate._.cEEpromChannel._.ZFFSAB.eepromChannel[14].EEpromZentralHandler._.ZFFSAB /end MEASUREMENT
/begin MEASUREMENT ZFFSAB._.EEpromZentralHandler.eepromChannel[14].ZFFSAB._.cEEpromChannel._.ret_GetEEpromValid "Return value off function" UBYTE SAB_STANDARD_S2_S3 1 100 0 255 ECU_ADDRESS 0xFFF96045 DISPLAY_IDENTIFIER ret_GetEEpromValid._.cEEpromChannel._.ZFFSAB.eepromChannel[14].EEpromZentralHandler._.ZFFSAB /end MEASUREMENT
/begin MEASUREMENT ZFFSAB._.EEpromZentralHandler.eepromChannel[14].ZFFSAB._.cEEpromChannel._.ret_GetSizeofEEpromData "Return value off function" UWORD SAB_STANDARD_S2_S3 1 100 0 65535 ECU_ADDRESS 0xFFF9604C DISPLAY_IDENTIFIER ret_GetSizeofEEpromData._.cEEpromChannel._.ZFFSAB.eepromChannel[14].EEpromZentralHandler._.ZFFSAB /end MEASUREMENT
/begin MEASUREMENT ZFFSAB._.EEpromZentralHandler.eepromChannel[14].ZFFSAB._.cEEpromChannel._.ret_SetEEpromInitZyklisch "Return value off function" UBYTE SAB_STANDARD_S2_S3 1 100 0 255 ECU_ADDRESS 0xFFF96049 DISPLAY_IDENTIFIER ret_SetEEpromInitZyklisch._.cEEpromChannel._.ZFFSAB.eepromChannel[14].EEpromZentralHandler._.ZFFSAB /end MEASUREMENT
/begin MEASUREMENT ZFFSAB._.EEpromZentralHandler.eepromChannel[14].cnt_CallEEpromLoadData "Call counter off function" UBYTE SAB_STANDARD_S2_S3 1 100 0 255 ECU_ADDRESS 0xFFF96050 DISPLAY_IDENTIFIER cnt_CallEEpromLoadData.eepromChannel[14].EEpromZentralHandler._.ZFFSAB /end MEASUREMENT
/begin MEASUREMENT ZFFSAB._.EEpromZentralHandler.eepromChannel[14].cnt_CallEEpromLoadDataState "Call counter off function" UBYTE SAB_STANDARD_S2_S3 1 100 0 255 ECU_ADDRESS 0xFFF96052 DISPLAY_IDENTIFIER cnt_CallEEpromLoadDataState.eepromChannel[14].EEpromZentralHandler._.ZFFSAB /end MEASUREMENT
/begin MEASUREMENT ZFFSAB._.EEpromZentralHandler.eepromChannel[14].cnt_CallEEpromStoreImmediate "Call counter off function" UBYTE SAB_STANDARD_S2_S3 1 100 0 255 ECU_ADDRESS 0xFFF9604E DISPLAY_IDENTIFIER cnt_CallEEpromStoreImmediate.eepromChannel[14].EEpromZentralHandler._.ZFFSAB /end MEASUREMENT
/begin MEASUREMENT ZFFSAB._.EEpromZentralHandler.eepromChannel[14].cnt_SetEEpromWriteProtect "Call counter off function" UBYTE SAB_STANDARD_S2_S3 1 100 0 255 ECU_ADDRESS 0xFFF96055 DISPLAY_IDENTIFIER cnt_SetEEpromWriteProtect.eepromChannel[14].EEpromZentralHandler._.ZFFSAB /end MEASUREMENT
/begin MEASUREMENT ZFFSAB._.EEpromZentralHandler.eepromChannel[14].mode "argument of SetEEpromInitZyklisch" UBYTE SAB_STANDARD_S2_S3 1 100 0 255 ECU_ADDRESS 0xFFF96054 DISPLAY_IDENTIFIER mode.eepromChannel[14].EEpromZentralHandler._.ZFFSAB /end MEASUREMENT
/begin MEASUREMENT ZFFSAB._.EEpromZentralHandler.eepromChannel[14].ret_CallEEpromLoadData "Return value off function" UBYTE SAB_STANDARD_S2_S3 1 100 0 255 ECU_ADDRESS 0xFFF96051 DISPLAY_IDENTIFIER ret_CallEEpromLoadData.eepromChannel[14].EEpromZentralHandler._.ZFFSAB /end MEASUREMENT
/begin MEASUREMENT ZFFSAB._.EEpromZentralHandler.eepromChannel[14].ret_CallEEpromLoadDataState "Return value off function" UBYTE SAB_STANDARD_S2_S3 1 100 0 255 ECU_ADDRESS 0xFFF96053 DISPLAY_IDENTIFIER ret_CallEEpromLoadDataState.eepromChannel[14].EEpromZentralHandler._.ZFFSAB /end MEASUREMENT
/begin MEASUREMENT ZFFSAB._.EEpromZentralHandler.eepromChannel[14].ret_CallEEpromStoreImmediate "Return value off function" UBYTE SAB_STANDARD_S2_S3 1 100 0 255 ECU_ADDRESS 0xFFF9604F DISPLAY_IDENTIFIER ret_CallEEpromStoreImmediate.eepromChannel[14].EEpromZentralHandler._.ZFFSAB /end MEASUREMENT
/begin MEASUREMENT ZFFSAB._.EEpromZentralHandler.eepromChannel[15].ZFFSAB._.cEEpromChannel._.cnt_GetEEpromUpdate "Call counter off function" UBYTE SAB_STANDARD_S2_S3 1 100 0 255 ECU_ADDRESS 0xFFF96058 DISPLAY_IDENTIFIER cnt_GetEEpromUpdate._.cEEpromChannel._.ZFFSAB.eepromChannel[15].EEpromZentralHandler._.ZFFSAB /end MEASUREMENT
/begin MEASUREMENT ZFFSAB._.EEpromZentralHandler.eepromChannel[15].ZFFSAB._.cEEpromChannel._.cnt_GetEEpromValid "Call counter off function" UBYTE SAB_STANDARD_S2_S3 1 100 0 255 ECU_ADDRESS 0xFFF96056 DISPLAY_IDENTIFIER cnt_GetEEpromValid._.cEEpromChannel._.ZFFSAB.eepromChannel[15].EEpromZentralHandler._.ZFFSAB /end MEASUREMENT
/begin MEASUREMENT ZFFSAB._.EEpromZentralHandler.eepromChannel[15].ZFFSAB._.cEEpromChannel._.cnt_GetSizeofEEpromData "Call counter off function" UBYTE SAB_STANDARD_S2_S3 1 100 0 255 ECU_ADDRESS 0xFFF9605D DISPLAY_IDENTIFIER cnt_GetSizeofEEpromData._.cEEpromChannel._.ZFFSAB.eepromChannel[15].EEpromZentralHandler._.ZFFSAB /end MEASUREMENT
/begin MEASUREMENT ZFFSAB._.EEpromZentralHandler.eepromChannel[15].ZFFSAB._.cEEpromChannel._.cnt_SetEEpromInitZyklisch "Call counter off function" UBYTE SAB_STANDARD_S2_S3 1 100 0 255 ECU_ADDRESS 0xFFF9605A DISPLAY_IDENTIFIER cnt_SetEEpromInitZyklisch._.cEEpromChannel._.ZFFSAB.eepromChannel[15].EEpromZentralHandler._.ZFFSAB /end MEASUREMENT
/begin MEASUREMENT ZFFSAB._.EEpromZentralHandler.eepromChannel[15].ZFFSAB._.cEEpromChannel._.eeprom_info "argument of SetEEpromInitZyklisch" UBYTE SAB_STANDARD_S2_S3 1 100 0 255 ECU_ADDRESS 0xFFF9605C DISPLAY_IDENTIFIER eeprom_info._.cEEpromChannel._.ZFFSAB.eepromChannel[15].EEpromZentralHandler._.ZFFSAB /end MEASUREMENT
/begin MEASUREMENT ZFFSAB._.EEpromZentralHandler.eepromChannel[15].ZFFSAB._.cEEpromChannel._.ret_GetEEpromUpdate "Return value off function" UBYTE SAB_STANDARD_S2_S3 1 100 0 255 ECU_ADDRESS 0xFFF96059 DISPLAY_IDENTIFIER ret_GetEEpromUpdate._.cEEpromChannel._.ZFFSAB.eepromChannel[15].EEpromZentralHandler._.ZFFSAB /end MEASUREMENT
/begin MEASUREMENT ZFFSAB._.EEpromZentralHandler.eepromChannel[15].ZFFSAB._.cEEpromChannel._.ret_GetEEpromValid "Return value off function" UBYTE SAB_STANDARD_S2_S3 1 100 0 255 ECU_ADDRESS 0xFFF96057 DISPLAY_IDENTIFIER ret_GetEEpromValid._.cEEpromChannel._.ZFFSAB.eepromChannel[15].EEpromZentralHandler._.ZFFSAB /end MEASUREMENT
/begin MEASUREMENT ZFFSAB._.EEpromZentralHandler.eepromChannel[15].ZFFSAB._.cEEpromChannel._.ret_GetSizeofEEpromData "Return value off function" UWORD SAB_STANDARD_S2_S3 1 100 0 65535 ECU_ADDRESS 0xFFF9605E DISPLAY_IDENTIFIER ret_GetSizeofEEpromData._.cEEpromChannel._.ZFFSAB.eepromChannel[15].EEpromZentralHandler._.ZFFSAB /end MEASUREMENT
/begin MEASUREMENT ZFFSAB._.EEpromZentralHandler.eepromChannel[15].ZFFSAB._.cEEpromChannel._.ret_SetEEpromInitZyklisch "Return value off function" UBYTE SAB_STANDARD_S2_S3 1 100 0 255 ECU_ADDRESS 0xFFF9605B DISPLAY_IDENTIFIER ret_SetEEpromInitZyklisch._.cEEpromChannel._.ZFFSAB.eepromChannel[15].EEpromZentralHandler._.ZFFSAB /end MEASUREMENT
/begin MEASUREMENT ZFFSAB._.EEpromZentralHandler.eepromChannel[15].cnt_CallEEpromLoadData "Call counter off function" UBYTE SAB_STANDARD_S2_S3 1 100 0 255 ECU_ADDRESS 0xFFF96062 DISPLAY_IDENTIFIER cnt_CallEEpromLoadData.eepromChannel[15].EEpromZentralHandler._.ZFFSAB /end MEASUREMENT
/begin MEASUREMENT ZFFSAB._.EEpromZentralHandler.eepromChannel[15].cnt_CallEEpromLoadDataState "Call counter off function" UBYTE SAB_STANDARD_S2_S3 1 100 0 255 ECU_ADDRESS 0xFFF96064 DISPLAY_IDENTIFIER cnt_CallEEpromLoadDataState.eepromChannel[15].EEpromZentralHandler._.ZFFSAB /end MEASUREMENT
/begin MEASUREMENT ZFFSAB._.EEpromZentralHandler.eepromChannel[15].cnt_CallEEpromStoreImmediate "Call counter off function" UBYTE SAB_STANDARD_S2_S3 1 100 0 255 ECU_ADDRESS 0xFFF96060 DISPLAY_IDENTIFIER cnt_CallEEpromStoreImmediate.eepromChannel[15].EEpromZentralHandler._.ZFFSAB /end MEASUREMENT
/begin MEASUREMENT ZFFSAB._.EEpromZentralHandler.eepromChannel[15].cnt_SetEEpromWriteProtect "Call counter off function" UBYTE SAB_STANDARD_S2_S3 1 100 0 255 ECU_ADDRESS 0xFFF96067 DISPLAY_IDENTIFIER cnt_SetEEpromWriteProtect.eepromChannel[15].EEpromZentralHandler._.ZFFSAB /end MEASUREMENT
/begin MEASUREMENT ZFFSAB._.EEpromZentralHandler.eepromChannel[15].mode "argument of SetEEpromInitZyklisch" UBYTE SAB_STANDARD_S2_S3 1 100 0 255 ECU_ADDRESS 0xFFF96066 DISPLAY_IDENTIFIER mode.eepromChannel[15].EEpromZentralHandler._.ZFFSAB /end MEASUREMENT
/begin MEASUREMENT ZFFSAB._.EEpromZentralHandler.eepromChannel[15].ret_CallEEpromLoadData "Return value off function" UBYTE SAB_STANDARD_S2_S3 1 100 0 255 ECU_ADDRESS 0xFFF96063 DISPLAY_IDENTIFIER ret_CallEEpromLoadData.eepromChannel[15].EEpromZentralHandler._.ZFFSAB /end MEASUREMENT
/begin MEASUREMENT ZFFSAB._.EEpromZentralHandler.eepromChannel[15].ret_CallEEpromLoadDataState "Return value off function" UBYTE SAB_STANDARD_S2_S3 1 100 0 255 ECU_ADDRESS 0xFFF96065 DISPLAY_IDENTIFIER ret_CallEEpromLoadDataState.eepromChannel[15].EEpromZentralHandler._.ZFFSAB /end MEASUREMENT
/begin MEASUREMENT ZFFSAB._.EEpromZentralHandler.eepromChannel[15].ret_CallEEpromStoreImmediate "Return value off function" UBYTE SAB_STANDARD_S2_S3 1 100 0 255 ECU_ADDRESS 0xFFF96061 DISPLAY_IDENTIFIER ret_CallEEpromStoreImmediate.eepromChannel[15].EEpromZentralHandler._.ZFFSAB /end MEASUREMENT
/begin MEASUREMENT ZFFSAB._.EEpromZentralHandler.eepromChannel[1].ZFFSAB._.cEEpromChannel._.cnt_GetEEpromUpdate "Call counter off function" UBYTE SAB_STANDARD_S2_S3 1 100 0 255 ECU_ADDRESS 0xFFF95F5C DISPLAY_IDENTIFIER cnt_GetEEpromUpdate._.cEEpromChannel._.ZFFSAB.eepromChannel[1].EEpromZentralHandler._.ZFFSAB /end MEASUREMENT
/begin MEASUREMENT ZFFSAB._.EEpromZentralHandler.eepromChannel[1].ZFFSAB._.cEEpromChannel._.cnt_GetEEpromValid "Call counter off function" UBYTE SAB_STANDARD_S2_S3 1 100 0 255 ECU_ADDRESS 0xFFF95F5A DISPLAY_IDENTIFIER cnt_GetEEpromValid._.cEEpromChannel._.ZFFSAB.eepromChannel[1].EEpromZentralHandler._.ZFFSAB /end MEASUREMENT
/begin MEASUREMENT ZFFSAB._.EEpromZentralHandler.eepromChannel[1].ZFFSAB._.cEEpromChannel._.cnt_GetSizeofEEpromData "Call counter off function" UBYTE SAB_STANDARD_S2_S3 1 100 0 255 ECU_ADDRESS 0xFFF95F61 DISPLAY_IDENTIFIER cnt_GetSizeofEEpromData._.cEEpromChannel._.ZFFSAB.eepromChannel[1].EEpromZentralHandler._.ZFFSAB /end MEASUREMENT
/begin MEASUREMENT ZFFSAB._.EEpromZentralHandler.eepromChannel[1].ZFFSAB._.cEEpromChannel._.cnt_SetEEpromInitZyklisch "Call counter off function" UBYTE SAB_STANDARD_S2_S3 1 100 0 255 ECU_ADDRESS 0xFFF95F5E DISPLAY_IDENTIFIER cnt_SetEEpromInitZyklisch._.cEEpromChannel._.ZFFSAB.eepromChannel[1].EEpromZentralHandler._.ZFFSAB /end MEASUREMENT
/begin MEASUREMENT ZFFSAB._.EEpromZentralHandler.eepromChannel[1].ZFFSAB._.cEEpromChannel._.eeprom_info "argument of SetEEpromInitZyklisch" UBYTE SAB_STANDARD_S2_S3 1 100 0 255 ECU_ADDRESS 0xFFF95F60 DISPLAY_IDENTIFIER eeprom_info._.cEEpromChannel._.ZFFSAB.eepromChannel[1].EEpromZentralHandler._.ZFFSAB /end MEASUREMENT
/begin MEASUREMENT ZFFSAB._.EEpromZentralHandler.eepromChannel[1].ZFFSAB._.cEEpromChannel._.ret_GetEEpromUpdate "Return value off function" UBYTE SAB_STANDARD_S2_S3 1 100 0 255 ECU_ADDRESS 0xFFF95F5D DISPLAY_IDENTIFIER ret_GetEEpromUpdate._.cEEpromChannel._.ZFFSAB.eepromChannel[1].EEpromZentralHandler._.ZFFSAB /end MEASUREMENT
/begin MEASUREMENT ZFFSAB._.EEpromZentralHandler.eepromChannel[1].ZFFSAB._.cEEpromChannel._.ret_GetEEpromValid "Return value off function" UBYTE SAB_STANDARD_S2_S3 1 100 0 255 ECU_ADDRESS 0xFFF95F5B DISPLAY_IDENTIFIER ret_GetEEpromValid._.cEEpromChannel._.ZFFSAB.eepromChannel[1].EEpromZentralHandler._.ZFFSAB /end MEASUREMENT
/begin MEASUREMENT ZFFSAB._.EEpromZentralHandler.eepromChannel[1].ZFFSAB._.cEEpromChannel._.ret_GetSizeofEEpromData "Return value off function" UWORD SAB_STANDARD_S2_S3 1 100 0 65535 ECU_ADDRESS 0xFFF95F62 DISPLAY_IDENTIFIER ret_GetSizeofEEpromData._.cEEpromChannel._.ZFFSAB.eepromChannel[1].EEpromZentralHandler._.ZFFSAB /end MEASUREMENT
/begin MEASUREMENT ZFFSAB._.EEpromZentralHandler.eepromChannel[1].ZFFSAB._.cEEpromChannel._.ret_SetEEpromInitZyklisch "Return value off function" UBYTE SAB_STANDARD_S2_S3 1 100 0 255 ECU_ADDRESS 0xFFF95F5F DISPLAY_IDENTIFIER ret_SetEEpromInitZyklisch._.cEEpromChannel._.ZFFSAB.eepromChannel[1].EEpromZentralHandler._.ZFFSAB /end MEASUREMENT
/begin MEASUREMENT ZFFSAB._.EEpromZentralHandler.eepromChannel[1].cnt_CallEEpromLoadData "Call counter off function" UBYTE SAB_STANDARD_S2_S3 1 100 0 255 ECU_ADDRESS 0xFFF95F66 DISPLAY_IDENTIFIER cnt_CallEEpromLoadData.eepromChannel[1].EEpromZentralHandler._.ZFFSAB /end MEASUREMENT
/begin MEASUREMENT ZFFSAB._.EEpromZentralHandler.eepromChannel[1].cnt_CallEEpromLoadDataState "Call counter off function" UBYTE SAB_STANDARD_S2_S3 1 100 0 255 ECU_ADDRESS 0xFFF95F68 DISPLAY_IDENTIFIER cnt_CallEEpromLoadDataState.eepromChannel[1].EEpromZentralHandler._.ZFFSAB /end MEASUREMENT
/begin MEASUREMENT ZFFSAB._.EEpromZentralHandler.eepromChannel[1].cnt_CallEEpromStoreImmediate "Call counter off function" UBYTE SAB_STANDARD_S2_S3 1 100 0 255 ECU_ADDRESS 0xFFF95F64 DISPLAY_IDENTIFIER cnt_CallEEpromStoreImmediate.eepromChannel[1].EEpromZentralHandler._.ZFFSAB /end MEASUREMENT
/begin MEASUREMENT ZFFSAB._.EEpromZentralHandler.eepromChannel[1].cnt_SetEEpromWriteProtect "Call counter off function" UBYTE SAB_STANDARD_S2_S3 1 100 0 255 ECU_ADDRESS 0xFFF95F6B DISPLAY_IDENTIFIER cnt_SetEEpromWriteProtect.eepromChannel[1].EEpromZentralHandler._.ZFFSAB /end MEASUREMENT
/begin MEASUREMENT ZFFSAB._.EEpromZentralHandler.eepromChannel[1].mode "argument of SetEEpromInitZyklisch" UBYTE SAB_STANDARD_S2_S3 1 100 0 255 ECU_ADDRESS 0xFFF95F6A DISPLAY_IDENTIFIER mode.eepromChannel[1].EEpromZentralHandler._.ZFFSAB /end MEASUREMENT
/begin MEASUREMENT ZFFSAB._.EEpromZentralHandler.eepromChannel[1].ret_CallEEpromLoadData "Return value off function" UBYTE SAB_STANDARD_S2_S3 1 100 0 255 ECU_ADDRESS 0xFFF95F67 DISPLAY_IDENTIFIER ret_CallEEpromLoadData.eepromChannel[1].EEpromZentralHandler._.ZFFSAB /end MEASUREMENT
/begin MEASUREMENT ZFFSAB._.EEpromZentralHandler.eepromChannel[1].ret_CallEEpromLoadDataState "Return value off function" UBYTE SAB_STANDARD_S2_S3 1 100 0 255 ECU_ADDRESS 0xFFF95F69 DISPLAY_IDENTIFIER ret_CallEEpromLoadDataState.eepromChannel[1].EEpromZentralHandler._.ZFFSAB /end MEASUREMENT
/begin MEASUREMENT ZFFSAB._.EEpromZentralHandler.eepromChannel[1].ret_CallEEpromStoreImmediate "Return value off function" UBYTE SAB_STANDARD_S2_S3 1 100 0 255 ECU_ADDRESS 0xFFF95F65 DISPLAY_IDENTIFIER ret_CallEEpromStoreImmediate.eepromChannel[1].EEpromZentralHandler._.ZFFSAB /end MEASUREMENT
/begin MEASUREMENT ZFFSAB._.EEpromZentralHandler.eepromChannel[2].ZFFSAB._.cEEpromChannel._.cnt_GetEEpromUpdate "Call counter off function" UBYTE SAB_STANDARD_S2_S3 1 100 0 255 ECU_ADDRESS 0xFFF95F6E DISPLAY_IDENTIFIER cnt_GetEEpromUpdate._.cEEpromChannel._.ZFFSAB.eepromChannel[2].EEpromZentralHandler._.ZFFSAB /end MEASUREMENT
/begin MEASUREMENT ZFFSAB._.EEpromZentralHandler.eepromChannel[2].ZFFSAB._.cEEpromChannel._.cnt_GetEEpromValid "Call counter off function" UBYTE SAB_STANDARD_S2_S3 1 100 0 255 ECU_ADDRESS 0xFFF95F6C DISPLAY_IDENTIFIER cnt_GetEEpromValid._.cEEpromChannel._.ZFFSAB.eepromChannel[2].EEpromZentralHandler._.ZFFSAB /end MEASUREMENT
/begin MEASUREMENT ZFFSAB._.EEpromZentralHandler.eepromChannel[2].ZFFSAB._.cEEpromChannel._.cnt_GetSizeofEEpromData "Call counter off function" UBYTE SAB_STANDARD_S2_S3 1 100 0 255 ECU_ADDRESS 0xFFF95F73 DISPLAY_IDENTIFIER cnt_GetSizeofEEpromData._.cEEpromChannel._.ZFFSAB.eepromChannel[2].EEpromZentralHandler._.ZFFSAB /end MEASUREMENT
/begin MEASUREMENT ZFFSAB._.EEpromZentralHandler.eepromChannel[2].ZFFSAB._.cEEpromChannel._.cnt_SetEEpromInitZyklisch "Call counter off function" UBYTE SAB_STANDARD_S2_S3 1 100 0 255 ECU_ADDRESS 0xFFF95F70 DISPLAY_IDENTIFIER cnt_SetEEpromInitZyklisch._.cEEpromChannel._.ZFFSAB.eepromChannel[2].EEpromZentralHandler._.ZFFSAB /end MEASUREMENT
/begin MEASUREMENT ZFFSAB._.EEpromZentralHandler.eepromChannel[2].ZFFSAB._.cEEpromChannel._.eeprom_info "argument of SetEEpromInitZyklisch" UBYTE SAB_STANDARD_S2_S3 1 100 0 255 ECU_ADDRESS 0xFFF95F72 DISPLAY_IDENTIFIER eeprom_info._.cEEpromChannel._.ZFFSAB.eepromChannel[2].EEpromZentralHandler._.ZFFSAB /end MEASUREMENT
/begin MEASUREMENT ZFFSAB._.EEpromZentralHandler.eepromChannel[2].ZFFSAB._.cEEpromChannel._.ret_GetEEpromUpdate "Return value off function" UBYTE SAB_STANDARD_S2_S3 1 100 0 255 ECU_ADDRESS 0xFFF95F6F DISPLAY_IDENTIFIER ret_GetEEpromUpdate._.cEEpromChannel._.ZFFSAB.eepromChannel[2].EEpromZentralHandler._.ZFFSAB /end MEASUREMENT
/begin MEASUREMENT ZFFSAB._.EEpromZentralHandler.eepromChannel[2].ZFFSAB._.cEEpromChannel._.ret_GetEEpromValid "Return value off function" UBYTE SAB_STANDARD_S2_S3 1 100 0 255 ECU_ADDRESS 0xFFF95F6D DISPLAY_IDENTIFIER ret_GetEEpromValid._.cEEpromChannel._.ZFFSAB.eepromChannel[2].EEpromZentralHandler._.ZFFSAB /end MEASUREMENT
/begin MEASUREMENT ZFFSAB._.EEpromZentralHandler.eepromChannel[2].ZFFSAB._.cEEpromChannel._.ret_GetSizeofEEpromData "Return value off function" UWORD SAB_STANDARD_S2_S3 1 100 0 65535 ECU_ADDRESS 0xFFF95F74 DISPLAY_IDENTIFIER ret_GetSizeofEEpromData._.cEEpromChannel._.ZFFSAB.eepromChannel[2].EEpromZentralHandler._.ZFFSAB /end MEASUREMENT
/begin MEASUREMENT ZFFSAB._.EEpromZentralHandler.eepromChannel[2].ZFFSAB._.cEEpromChannel._.ret_SetEEpromInitZyklisch "Return value off function" UBYTE SAB_STANDARD_S2_S3 1 100 0 255 ECU_ADDRESS 0xFFF95F71 DISPLAY_IDENTIFIER ret_SetEEpromInitZyklisch._.cEEpromChannel._.ZFFSAB.eepromChannel[2].EEpromZentralHandler._.ZFFSAB /end MEASUREMENT
/begin MEASUREMENT ZFFSAB._.EEpromZentralHandler.eepromChannel[2].cnt_CallEEpromLoadData "Call counter off function" UBYTE SAB_STANDARD_S2_S3 1 100 0 255 ECU_ADDRESS 0xFFF95F78 DISPLAY_IDENTIFIER cnt_CallEEpromLoadData.eepromChannel[2].EEpromZentralHandler._.ZFFSAB /end MEASUREMENT
/begin MEASUREMENT ZFFSAB._.EEpromZentralHandler.eepromChannel[2].cnt_CallEEpromLoadDataState "Call counter off function" UBYTE SAB_STANDARD_S2_S3 1 100 0 255 ECU_ADDRESS 0xFFF95F7A DISPLAY_IDENTIFIER cnt_CallEEpromLoadDataState.eepromChannel[2].EEpromZentralHandler._.ZFFSAB /end MEASUREMENT
/begin MEASUREMENT ZFFSAB._.EEpromZentralHandler.eepromChannel[2].cnt_CallEEpromStoreImmediate "Call counter off function" UBYTE SAB_STANDARD_S2_S3 1 100 0 255 ECU_ADDRESS 0xFFF95F76 DISPLAY_IDENTIFIER cnt_CallEEpromStoreImmediate.eepromChannel[2].EEpromZentralHandler._.ZFFSAB /end MEASUREMENT
/begin MEASUREMENT ZFFSAB._.EEpromZentralHandler.eepromChannel[2].cnt_SetEEpromWriteProtect "Call counter off function" UBYTE SAB_STANDARD_S2_S3 1 100 0 255 ECU_ADDRESS 0xFFF95F7D DISPLAY_IDENTIFIER cnt_SetEEpromWriteProtect.eepromChannel[2].EEpromZentralHandler._.ZFFSAB /end MEASUREMENT
/begin MEASUREMENT ZFFSAB._.EEpromZentralHandler.eepromChannel[2].mode "argument of SetEEpromInitZyklisch" UBYTE SAB_STANDARD_S2_S3 1 100 0 255 ECU_ADDRESS 0xFFF95F7C DISPLAY_IDENTIFIER mode.eepromChannel[2].EEpromZentralHandler._.ZFFSAB /end MEASUREMENT
/begin MEASUREMENT ZFFSAB._.EEpromZentralHandler.eepromChannel[2].ret_CallEEpromLoadData "Return value off function" UBYTE SAB_STANDARD_S2_S3 1 100 0 255 ECU_ADDRESS 0xFFF95F79 DISPLAY_IDENTIFIER ret_CallEEpromLoadData.eepromChannel[2].EEpromZentralHandler._.ZFFSAB /end MEASUREMENT
/begin MEASUREMENT ZFFSAB._.EEpromZentralHandler.eepromChannel[2].ret_CallEEpromLoadDataState "Return value off function" UBYTE SAB_STANDARD_S2_S3 1 100 0 255 ECU_ADDRESS 0xFFF95F7B DISPLAY_IDENTIFIER ret_CallEEpromLoadDataState.eepromChannel[2].EEpromZentralHandler._.ZFFSAB /end MEASUREMENT
/begin MEASUREMENT ZFFSAB._.EEpromZentralHandler.eepromChannel[2].ret_CallEEpromStoreImmediate "Return value off function" UBYTE SAB_STANDARD_S2_S3 1 100 0 255 ECU_ADDRESS 0xFFF95F77 DISPLAY_IDENTIFIER ret_CallEEpromStoreImmediate.eepromChannel[2].EEpromZentralHandler._.ZFFSAB /end MEASUREMENT
/begin MEASUREMENT ZFFSAB._.EEpromZentralHandler.eepromChannel[3].ZFFSAB._.cEEpromChannel._.cnt_GetEEpromUpdate "Call counter off function" UBYTE SAB_STANDARD_S2_S3 1 100 0 255 ECU_ADDRESS 0xFFF95F80 DISPLAY_IDENTIFIER cnt_GetEEpromUpdate._.cEEpromChannel._.ZFFSAB.eepromChannel[3].EEpromZentralHandler._.ZFFSAB /end MEASUREMENT
/begin MEASUREMENT ZFFSAB._.EEpromZentralHandler.eepromChannel[3].ZFFSAB._.cEEpromChannel._.cnt_GetEEpromValid "Call counter off function" UBYTE SAB_STANDARD_S2_S3 1 100 0 255 ECU_ADDRESS 0xFFF95F7E DISPLAY_IDENTIFIER cnt_GetEEpromValid._.cEEpromChannel._.ZFFSAB.eepromChannel[3].EEpromZentralHandler._.ZFFSAB /end MEASUREMENT
/begin MEASUREMENT ZFFSAB._.EEpromZentralHandler.eepromChannel[3].ZFFSAB._.cEEpromChannel._.cnt_GetSizeofEEpromData "Call counter off function" UBYTE SAB_STANDARD_S2_S3 1 100 0 255 ECU_ADDRESS 0xFFF95F85 DISPLAY_IDENTIFIER cnt_GetSizeofEEpromData._.cEEpromChannel._.ZFFSAB.eepromChannel[3].EEpromZentralHandler._.ZFFSAB /end MEASUREMENT
/begin MEASUREMENT ZFFSAB._.EEpromZentralHandler.eepromChannel[3].ZFFSAB._.cEEpromChannel._.cnt_SetEEpromInitZyklisch "Call counter off function" UBYTE SAB_STANDARD_S2_S3 1 100 0 255 ECU_ADDRESS 0xFFF95F82 DISPLAY_IDENTIFIER cnt_SetEEpromInitZyklisch._.cEEpromChannel._.ZFFSAB.eepromChannel[3].EEpromZentralHandler._.ZFFSAB /end MEASUREMENT
/begin MEASUREMENT ZFFSAB._.EEpromZentralHandler.eepromChannel[3].ZFFSAB._.cEEpromChannel._.eeprom_info "argument of SetEEpromInitZyklisch" UBYTE SAB_STANDARD_S2_S3 1 100 0 255 ECU_ADDRESS 0xFFF95F84 DISPLAY_IDENTIFIER eeprom_info._.cEEpromChannel._.ZFFSAB.eepromChannel[3].EEpromZentralHandler._.ZFFSAB /end MEASUREMENT
/begin MEASUREMENT ZFFSAB._.EEpromZentralHandler.eepromChannel[3].ZFFSAB._.cEEpromChannel._.ret_GetEEpromUpdate "Return value off function" UBYTE SAB_STANDARD_S2_S3 1 100 0 255 ECU_ADDRESS 0xFFF95F81 DISPLAY_IDENTIFIER ret_GetEEpromUpdate._.cEEpromChannel._.ZFFSAB.eepromChannel[3].EEpromZentralHandler._.ZFFSAB /end MEASUREMENT
/begin MEASUREMENT ZFFSAB._.EEpromZentralHandler.eepromChannel[3].ZFFSAB._.cEEpromChannel._.ret_GetEEpromValid "Return value off function" UBYTE SAB_STANDARD_S2_S3 1 100 0 255 ECU_ADDRESS 0xFFF95F7F DISPLAY_IDENTIFIER ret_GetEEpromValid._.cEEpromChannel._.ZFFSAB.eepromChannel[3].EEpromZentralHandler._.ZFFSAB /end MEASUREMENT
/begin MEASUREMENT ZFFSAB._.EEpromZentralHandler.eepromChannel[3].ZFFSAB._.cEEpromChannel._.ret_GetSizeofEEpromData "Return value off function" UWORD SAB_STANDARD_S2_S3 1 100 0 65535 ECU_ADDRESS 0xFFF95F86 DISPLAY_IDENTIFIER ret_GetSizeofEEpromData._.cEEpromChannel._.ZFFSAB.eepromChannel[3].EEpromZentralHandler._.ZFFSAB /end MEASUREMENT
/begin MEASUREMENT ZFFSAB._.EEpromZentralHandler.eepromChannel[3].ZFFSAB._.cEEpromChannel._.ret_SetEEpromInitZyklisch "Return value off function" UBYTE SAB_STANDARD_S2_S3 1 100 0 255 ECU_ADDRESS 0xFFF95F83 DISPLAY_IDENTIFIER ret_SetEEpromInitZyklisch._.cEEpromChannel._.ZFFSAB.eepromChannel[3].EEpromZentralHandler._.ZFFSAB /end MEASUREMENT
/begin MEASUREMENT ZFFSAB._.EEpromZentralHandler.eepromChannel[3].cnt_CallEEpromLoadData "Call counter off function" UBYTE SAB_STANDARD_S2_S3 1 100 0 255 ECU_ADDRESS 0xFFF95F8A DISPLAY_IDENTIFIER cnt_CallEEpromLoadData.eepromChannel[3].EEpromZentralHandler._.ZFFSAB /end MEASUREMENT
/begin MEASUREMENT ZFFSAB._.EEpromZentralHandler.eepromChannel[3].cnt_CallEEpromLoadDataState "Call counter off function" UBYTE SAB_STANDARD_S2_S3 1 100 0 255 ECU_ADDRESS 0xFFF95F8C DISPLAY_IDENTIFIER cnt_CallEEpromLoadDataState.eepromChannel[3].EEpromZentralHandler._.ZFFSAB /end MEASUREMENT
/begin MEASUREMENT ZFFSAB._.EEpromZentralHandler.eepromChannel[3].cnt_CallEEpromStoreImmediate "Call counter off function" UBYTE SAB_STANDARD_S2_S3 1 100 0 255 ECU_ADDRESS 0xFFF95F88 DISPLAY_IDENTIFIER cnt_CallEEpromStoreImmediate.eepromChannel[3].EEpromZentralHandler._.ZFFSAB /end MEASUREMENT
/begin MEASUREMENT ZFFSAB._.EEpromZentralHandler.eepromChannel[3].cnt_SetEEpromWriteProtect "Call counter off function" UBYTE SAB_STANDARD_S2_S3 1 100 0 255 ECU_ADDRESS 0xFFF95F8F DISPLAY_IDENTIFIER cnt_SetEEpromWriteProtect.eepromChannel[3].EEpromZentralHandler._.ZFFSAB /end MEASUREMENT
/begin MEASUREMENT ZFFSAB._.EEpromZentralHandler.eepromChannel[3].mode "argument of SetEEpromInitZyklisch" UBYTE SAB_STANDARD_S2_S3 1 100 0 255 ECU_ADDRESS 0xFFF95F8E DISPLAY_IDENTIFIER mode.eepromChannel[3].EEpromZentralHandler._.ZFFSAB /end MEASUREMENT
/begin MEASUREMENT ZFFSAB._.EEpromZentralHandler.eepromChannel[3].ret_CallEEpromLoadData "Return value off function" UBYTE SAB_STANDARD_S2_S3 1 100 0 255 ECU_ADDRESS 0xFFF95F8B DISPLAY_IDENTIFIER ret_CallEEpromLoadData.eepromChannel[3].EEpromZentralHandler._.ZFFSAB /end MEASUREMENT
/begin MEASUREMENT ZFFSAB._.EEpromZentralHandler.eepromChannel[3].ret_CallEEpromLoadDataState "Return value off function" UBYTE SAB_STANDARD_S2_S3 1 100 0 255 ECU_ADDRESS 0xFFF95F8D DISPLAY_IDENTIFIER ret_CallEEpromLoadDataState.eepromChannel[3].EEpromZentralHandler._.ZFFSAB /end MEASUREMENT
/begin MEASUREMENT ZFFSAB._.EEpromZentralHandler.eepromChannel[3].ret_CallEEpromStoreImmediate "Return value off function" UBYTE SAB_STANDARD_S2_S3 1 100 0 255 ECU_ADDRESS 0xFFF95F89 DISPLAY_IDENTIFIER ret_CallEEpromStoreImmediate.eepromChannel[3].EEpromZentralHandler._.ZFFSAB /end MEASUREMENT
/begin MEASUREMENT ZFFSAB._.EEpromZentralHandler.eepromChannel[4].ZFFSAB._.cEEpromChannel._.cnt_GetEEpromUpdate "Call counter off function" UBYTE SAB_STANDARD_S2_S3 1 100 0 255 ECU_ADDRESS 0xFFF95F92 DISPLAY_IDENTIFIER cnt_GetEEpromUpdate._.cEEpromChannel._.ZFFSAB.eepromChannel[4].EEpromZentralHandler._.ZFFSAB /end MEASUREMENT
/begin MEASUREMENT ZFFSAB._.EEpromZentralHandler.eepromChannel[4].ZFFSAB._.cEEpromChannel._.cnt_GetEEpromValid "Call counter off function" UBYTE SAB_STANDARD_S2_S3 1 100 0 255 ECU_ADDRESS 0xFFF95F90 DISPLAY_IDENTIFIER cnt_GetEEpromValid._.cEEpromChannel._.ZFFSAB.eepromChannel[4].EEpromZentralHandler._.ZFFSAB /end MEASUREMENT
/begin MEASUREMENT ZFFSAB._.EEpromZentralHandler.eepromChannel[4].ZFFSAB._.cEEpromChannel._.cnt_GetSizeofEEpromData "Call counter off function" UBYTE SAB_STANDARD_S2_S3 1 100 0 255 ECU_ADDRESS 0xFFF95F97 DISPLAY_IDENTIFIER cnt_GetSizeofEEpromData._.cEEpromChannel._.ZFFSAB.eepromChannel[4].EEpromZentralHandler._.ZFFSAB /end MEASUREMENT
/begin MEASUREMENT ZFFSAB._.EEpromZentralHandler.eepromChannel[4].ZFFSAB._.cEEpromChannel._.cnt_SetEEpromInitZyklisch "Call counter off function" UBYTE SAB_STANDARD_S2_S3 1 100 0 255 ECU_ADDRESS 0xFFF95F94 DISPLAY_IDENTIFIER cnt_SetEEpromInitZyklisch._.cEEpromChannel._.ZFFSAB.eepromChannel[4].EEpromZentralHandler._.ZFFSAB /end MEASUREMENT
/begin MEASUREMENT ZFFSAB._.EEpromZentralHandler.eepromChannel[4].ZFFSAB._.cEEpromChannel._.eeprom_info "argument of SetEEpromInitZyklisch" UBYTE SAB_STANDARD_S2_S3 1 100 0 255 ECU_ADDRESS 0xFFF95F96 DISPLAY_IDENTIFIER eeprom_info._.cEEpromChannel._.ZFFSAB.eepromChannel[4].EEpromZentralHandler._.ZFFSAB /end MEASUREMENT
/begin MEASUREMENT ZFFSAB._.EEpromZentralHandler.eepromChannel[4].ZFFSAB._.cEEpromChannel._.ret_GetEEpromUpdate "Return value off function" UBYTE SAB_STANDARD_S2_S3 1 100 0 255 ECU_ADDRESS 0xFFF95F93 DISPLAY_IDENTIFIER ret_GetEEpromUpdate._.cEEpromChannel._.ZFFSAB.eepromChannel[4].EEpromZentralHandler._.ZFFSAB /end MEASUREMENT
/begin MEASUREMENT ZFFSAB._.EEpromZentralHandler.eepromChannel[4].ZFFSAB._.cEEpromChannel._.ret_GetEEpromValid "Return value off function" UBYTE SAB_STANDARD_S2_S3 1 100 0 255 ECU_ADDRESS 0xFFF95F91 DISPLAY_IDENTIFIER ret_GetEEpromValid._.cEEpromChannel._.ZFFSAB.eepromChannel[4].EEpromZentralHandler._.ZFFSAB /end MEASUREMENT
/begin MEASUREMENT ZFFSAB._.EEpromZentralHandler.eepromChannel[4].ZFFSAB._.cEEpromChannel._.ret_GetSizeofEEpromData "Return value off function" UWORD SAB_STANDARD_S2_S3 1 100 0 65535 ECU_ADDRESS 0xFFF95F98 DISPLAY_IDENTIFIER ret_GetSizeofEEpromData._.cEEpromChannel._.ZFFSAB.eepromChannel[4].EEpromZentralHandler._.ZFFSAB /end MEASUREMENT
/begin MEASUREMENT ZFFSAB._.EEpromZentralHandler.eepromChannel[4].ZFFSAB._.cEEpromChannel._.ret_SetEEpromInitZyklisch "Return value off function" UBYTE SAB_STANDARD_S2_S3 1 100 0 255 ECU_ADDRESS 0xFFF95F95 DISPLAY_IDENTIFIER ret_SetEEpromInitZyklisch._.cEEpromChannel._.ZFFSAB.eepromChannel[4].EEpromZentralHandler._.ZFFSAB /end MEASUREMENT
/begin MEASUREMENT ZFFSAB._.EEpromZentralHandler.eepromChannel[4].cnt_CallEEpromLoadData "Call counter off function" UBYTE SAB_STANDARD_S2_S3 1 100 0 255 ECU_ADDRESS 0xFFF95F9C DISPLAY_IDENTIFIER cnt_CallEEpromLoadData.eepromChannel[4].EEpromZentralHandler._.ZFFSAB /end MEASUREMENT
/begin MEASUREMENT ZFFSAB._.EEpromZentralHandler.eepromChannel[4].cnt_CallEEpromLoadDataState "Call counter off function" UBYTE SAB_STANDARD_S2_S3 1 100 0 255 ECU_ADDRESS 0xFFF95F9E DISPLAY_IDENTIFIER cnt_CallEEpromLoadDataState.eepromChannel[4].EEpromZentralHandler._.ZFFSAB /end MEASUREMENT
/begin MEASUREMENT ZFFSAB._.EEpromZentralHandler.eepromChannel[4].cnt_CallEEpromStoreImmediate "Call counter off function" UBYTE SAB_STANDARD_S2_S3 1 100 0 255 ECU_ADDRESS 0xFFF95F9A DISPLAY_IDENTIFIER cnt_CallEEpromStoreImmediate.eepromChannel[4].EEpromZentralHandler._.ZFFSAB /end MEASUREMENT
/begin MEASUREMENT ZFFSAB._.EEpromZentralHandler.eepromChannel[4].cnt_SetEEpromWriteProtect "Call counter off function" UBYTE SAB_STANDARD_S2_S3 1 100 0 255 ECU_ADDRESS 0xFFF95FA1 DISPLAY_IDENTIFIER cnt_SetEEpromWriteProtect.eepromChannel[4].EEpromZentralHandler._.ZFFSAB /end MEASUREMENT
/begin MEASUREMENT ZFFSAB._.EEpromZentralHandler.eepromChannel[4].mode "argument of SetEEpromInitZyklisch" UBYTE SAB_STANDARD_S2_S3 1 100 0 255 ECU_ADDRESS 0xFFF95FA0 DISPLAY_IDENTIFIER mode.eepromChannel[4].EEpromZentralHandler._.ZFFSAB /end MEASUREMENT
/begin MEASUREMENT ZFFSAB._.EEpromZentralHandler.eepromChannel[4].ret_CallEEpromLoadData "Return value off function" UBYTE SAB_STANDARD_S2_S3 1 100 0 255 ECU_ADDRESS 0xFFF95F9D DISPLAY_IDENTIFIER ret_CallEEpromLoadData.eepromChannel[4].EEpromZentralHandler._.ZFFSAB /end MEASUREMENT
/begin MEASUREMENT ZFFSAB._.EEpromZentralHandler.eepromChannel[4].ret_CallEEpromLoadDataState "Return value off function" UBYTE SAB_STANDARD_S2_S3 1 100 0 255 ECU_ADDRESS 0xFFF95F9F DISPLAY_IDENTIFIER ret_CallEEpromLoadDataState.eepromChannel[4].EEpromZentralHandler._.ZFFSAB /end MEASUREMENT
/begin MEASUREMENT ZFFSAB._.EEpromZentralHandler.eepromChannel[4].ret_CallEEpromStoreImmediate "Return value off function" UBYTE SAB_STANDARD_S2_S3 1 100 0 255 ECU_ADDRESS 0xFFF95F9B DISPLAY_IDENTIFIER ret_CallEEpromStoreImmediate.eepromChannel[4].EEpromZentralHandler._.ZFFSAB /end MEASUREMENT
/begin MEASUREMENT ZFFSAB._.EEpromZentralHandler.eepromChannel[5].ZFFSAB._.cEEpromChannel._.cnt_GetEEpromUpdate "Call counter off function" UBYTE SAB_STANDARD_S2_S3 1 100 0 255 ECU_ADDRESS 0xFFF95FA4 DISPLAY_IDENTIFIER cnt_GetEEpromUpdate._.cEEpromChannel._.ZFFSAB.eepromChannel[5].EEpromZentralHandler._.ZFFSAB /end MEASUREMENT
/begin MEASUREMENT ZFFSAB._.EEpromZentralHandler.eepromChannel[5].ZFFSAB._.cEEpromChannel._.cnt_GetEEpromValid "Call counter off function" UBYTE SAB_STANDARD_S2_S3 1 100 0 255 ECU_ADDRESS 0xFFF95FA2 DISPLAY_IDENTIFIER cnt_GetEEpromValid._.cEEpromChannel._.ZFFSAB.eepromChannel[5].EEpromZentralHandler._.ZFFSAB /end MEASUREMENT
/begin MEASUREMENT ZFFSAB._.EEpromZentralHandler.eepromChannel[5].ZFFSAB._.cEEpromChannel._.cnt_GetSizeofEEpromData "Call counter off function" UBYTE SAB_STANDARD_S2_S3 1 100 0 255 ECU_ADDRESS 0xFFF95FA9 DISPLAY_IDENTIFIER cnt_GetSizeofEEpromData._.cEEpromChannel._.ZFFSAB.eepromChannel[5].EEpromZentralHandler._.ZFFSAB /end MEASUREMENT
/begin MEASUREMENT ZFFSAB._.EEpromZentralHandler.eepromChannel[5].ZFFSAB._.cEEpromChannel._.cnt_SetEEpromInitZyklisch "Call counter off function" UBYTE SAB_STANDARD_S2_S3 1 100 0 255 ECU_ADDRESS 0xFFF95FA6 DISPLAY_IDENTIFIER cnt_SetEEpromInitZyklisch._.cEEpromChannel._.ZFFSAB.eepromChannel[5].EEpromZentralHandler._.ZFFSAB /end MEASUREMENT
/begin MEASUREMENT ZFFSAB._.EEpromZentralHandler.eepromChannel[5].ZFFSAB._.cEEpromChannel._.eeprom_info "argument of SetEEpromInitZyklisch" UBYTE SAB_STANDARD_S2_S3 1 100 0 255 ECU_ADDRESS 0xFFF95FA8 DISPLAY_IDENTIFIER eeprom_info._.cEEpromChannel._.ZFFSAB.eepromChannel[5].EEpromZentralHandler._.ZFFSAB /end MEASUREMENT
/begin MEASUREMENT ZFFSAB._.EEpromZentralHandler.eepromChannel[5].ZFFSAB._.cEEpromChannel._.ret_GetEEpromUpdate "Return value off function" UBYTE SAB_STANDARD_S2_S3 1 100 0 255 ECU_ADDRESS 0xFFF95FA5 DISPLAY_IDENTIFIER ret_GetEEpromUpdate._.cEEpromChannel._.ZFFSAB.eepromChannel[5].EEpromZentralHandler._.ZFFSAB /end MEASUREMENT
/begin MEASUREMENT ZFFSAB._.EEpromZentralHandler.eepromChannel[5].ZFFSAB._.cEEpromChannel._.ret_GetEEpromValid "Return value off function" UBYTE SAB_STANDARD_S2_S3 1 100 0 255 ECU_ADDRESS 0xFFF95FA3 DISPLAY_IDENTIFIER ret_GetEEpromValid._.cEEpromChannel._.ZFFSAB.eepromChannel[5].EEpromZentralHandler._.ZFFSAB /end MEASUREMENT
/begin MEASUREMENT ZFFSAB._.EEpromZentralHandler.eepromChannel[5].ZFFSAB._.cEEpromChannel._.ret_GetSizeofEEpromData "Return value off function" UWORD SAB_STANDARD_S2_S3 1 100 0 65535 ECU_ADDRESS 0xFFF95FAA DISPLAY_IDENTIFIER ret_GetSizeofEEpromData._.cEEpromChannel._.ZFFSAB.eepromChannel[5].EEpromZentralHandler._.ZFFSAB /end MEASUREMENT
/begin MEASUREMENT ZFFSAB._.EEpromZentralHandler.eepromChannel[5].ZFFSAB._.cEEpromChannel._.ret_SetEEpromInitZyklisch "Return value off function" UBYTE SAB_STANDARD_S2_S3 1 100 0 255 ECU_ADDRESS 0xFFF95FA7 DISPLAY_IDENTIFIER ret_SetEEpromInitZyklisch._.cEEpromChannel._.ZFFSAB.eepromChannel[5].EEpromZentralHandler._.ZFFSAB /end MEASUREMENT
/begin MEASUREMENT ZFFSAB._.EEpromZentralHandler.eepromChannel[5].cnt_CallEEpromLoadData "Call counter off function" UBYTE SAB_STANDARD_S2_S3 1 100 0 255 ECU_ADDRESS 0xFFF95FAE DISPLAY_IDENTIFIER cnt_CallEEpromLoadData.eepromChannel[5].EEpromZentralHandler._.ZFFSAB /end MEASUREMENT
/begin MEASUREMENT ZFFSAB._.EEpromZentralHandler.eepromChannel[5].cnt_CallEEpromLoadDataState "Call counter off function" UBYTE SAB_STANDARD_S2_S3 1 100 0 255 ECU_ADDRESS 0xFFF95FB0 DISPLAY_IDENTIFIER cnt_CallEEpromLoadDataState.eepromChannel[5].EEpromZentralHandler._.ZFFSAB /end MEASUREMENT
/begin MEASUREMENT ZFFSAB._.EEpromZentralHandler.eepromChannel[5].cnt_CallEEpromStoreImmediate "Call counter off function" UBYTE SAB_STANDARD_S2_S3 1 100 0 255 ECU_ADDRESS 0xFFF95FAC DISPLAY_IDENTIFIER cnt_CallEEpromStoreImmediate.eepromChannel[5].EEpromZentralHandler._.ZFFSAB /end MEASUREMENT
/begin MEASUREMENT ZFFSAB._.EEpromZentralHandler.eepromChannel[5].cnt_SetEEpromWriteProtect "Call counter off function" UBYTE SAB_STANDARD_S2_S3 1 100 0 255 ECU_ADDRESS 0xFFF95FB3 DISPLAY_IDENTIFIER cnt_SetEEpromWriteProtect.eepromChannel[5].EEpromZentralHandler._.ZFFSAB /end MEASUREMENT
/begin MEASUREMENT ZFFSAB._.EEpromZentralHandler.eepromChannel[5].mode "argument of SetEEpromInitZyklisch" UBYTE SAB_STANDARD_S2_S3 1 100 0 255 ECU_ADDRESS 0xFFF95FB2 DISPLAY_IDENTIFIER mode.eepromChannel[5].EEpromZentralHandler._.ZFFSAB /end MEASUREMENT
/begin MEASUREMENT ZFFSAB._.EEpromZentralHandler.eepromChannel[5].ret_CallEEpromLoadData "Return value off function" UBYTE SAB_STANDARD_S2_S3 1 100 0 255 ECU_ADDRESS 0xFFF95FAF DISPLAY_IDENTIFIER ret_CallEEpromLoadData.eepromChannel[5].EEpromZentralHandler._.ZFFSAB /end MEASUREMENT
/begin MEASUREMENT ZFFSAB._.EEpromZentralHandler.eepromChannel[5].ret_CallEEpromLoadDataState "Return value off function" UBYTE SAB_STANDARD_S2_S3 1 100 0 255 ECU_ADDRESS 0xFFF95FB1 DISPLAY_IDENTIFIER ret_CallEEpromLoadDataState.eepromChannel[5].EEpromZentralHandler._.ZFFSAB /end MEASUREMENT
/begin MEASUREMENT ZFFSAB._.EEpromZentralHandler.eepromChannel[5].ret_CallEEpromStoreImmediate "Return value off function" UBYTE SAB_STANDARD_S2_S3 1 100 0 255 ECU_ADDRESS 0xFFF95FAD DISPLAY_IDENTIFIER ret_CallEEpromStoreImmediate.eepromChannel[5].EEpromZentralHandler._.ZFFSAB /end MEASUREMENT
/begin MEASUREMENT ZFFSAB._.EEpromZentralHandler.eepromChannel[6].ZFFSAB._.cEEpromChannel._.cnt_GetEEpromUpdate "Call counter off function" UBYTE SAB_STANDARD_S2_S3 1 100 0 255 ECU_ADDRESS 0xFFF95FB6 DISPLAY_IDENTIFIER cnt_GetEEpromUpdate._.cEEpromChannel._.ZFFSAB.eepromChannel[6].EEpromZentralHandler._.ZFFSAB /end MEASUREMENT
/begin MEASUREMENT ZFFSAB._.EEpromZentralHandler.eepromChannel[6].ZFFSAB._.cEEpromChannel._.cnt_GetEEpromValid "Call counter off function" UBYTE SAB_STANDARD_S2_S3 1 100 0 255 ECU_ADDRESS 0xFFF95FB4 DISPLAY_IDENTIFIER cnt_GetEEpromValid._.cEEpromChannel._.ZFFSAB.eepromChannel[6].EEpromZentralHandler._.ZFFSAB /end MEASUREMENT
/begin MEASUREMENT ZFFSAB._.EEpromZentralHandler.eepromChannel[6].ZFFSAB._.cEEpromChannel._.cnt_GetSizeofEEpromData "Call counter off function" UBYTE SAB_STANDARD_S2_S3 1 100 0 255 ECU_ADDRESS 0xFFF95FBB DISPLAY_IDENTIFIER cnt_GetSizeofEEpromData._.cEEpromChannel._.ZFFSAB.eepromChannel[6].EEpromZentralHandler._.ZFFSAB /end MEASUREMENT
/begin MEASUREMENT ZFFSAB._.EEpromZentralHandler.eepromChannel[6].ZFFSAB._.cEEpromChannel._.cnt_SetEEpromInitZyklisch "Call counter off function" UBYTE SAB_STANDARD_S2_S3 1 100 0 255 ECU_ADDRESS 0xFFF95FB8 DISPLAY_IDENTIFIER cnt_SetEEpromInitZyklisch._.cEEpromChannel._.ZFFSAB.eepromChannel[6].EEpromZentralHandler._.ZFFSAB /end MEASUREMENT
/begin MEASUREMENT ZFFSAB._.EEpromZentralHandler.eepromChannel[6].ZFFSAB._.cEEpromChannel._.eeprom_info "argument of SetEEpromInitZyklisch" UBYTE SAB_STANDARD_S2_S3 1 100 0 255 ECU_ADDRESS 0xFFF95FBA DISPLAY_IDENTIFIER eeprom_info._.cEEpromChannel._.ZFFSAB.eepromChannel[6].EEpromZentralHandler._.ZFFSAB /end MEASUREMENT
/begin MEASUREMENT ZFFSAB._.EEpromZentralHandler.eepromChannel[6].ZFFSAB._.cEEpromChannel._.ret_GetEEpromUpdate "Return value off function" UBYTE SAB_STANDARD_S2_S3 1 100 0 255 ECU_ADDRESS 0xFFF95FB7 DISPLAY_IDENTIFIER ret_GetEEpromUpdate._.cEEpromChannel._.ZFFSAB.eepromChannel[6].EEpromZentralHandler._.ZFFSAB /end MEASUREMENT
/begin MEASUREMENT ZFFSAB._.EEpromZentralHandler.eepromChannel[6].ZFFSAB._.cEEpromChannel._.ret_GetEEpromValid "Return value off function" UBYTE SAB_STANDARD_S2_S3 1 100 0 255 ECU_ADDRESS 0xFFF95FB5 DISPLAY_IDENTIFIER ret_GetEEpromValid._.cEEpromChannel._.ZFFSAB.eepromChannel[6].EEpromZentralHandler._.ZFFSAB /end MEASUREMENT
/begin MEASUREMENT ZFFSAB._.EEpromZentralHandler.eepromChannel[6].ZFFSAB._.cEEpromChannel._.ret_GetSizeofEEpromData "Return value off function" UWORD SAB_STANDARD_S2_S3 1 100 0 65535 ECU_ADDRESS 0xFFF95FBC DISPLAY_IDENTIFIER ret_GetSizeofEEpromData._.cEEpromChannel._.ZFFSAB.eepromChannel[6].EEpromZentralHandler._.ZFFSAB /end MEASUREMENT
/begin MEASUREMENT ZFFSAB._.EEpromZentralHandler.eepromChannel[6].ZFFSAB._.cEEpromChannel._.ret_SetEEpromInitZyklisch "Return value off function" UBYTE SAB_STANDARD_S2_S3 1 100 0 255 ECU_ADDRESS 0xFFF95FB9 DISPLAY_IDENTIFIER ret_SetEEpromInitZyklisch._.cEEpromChannel._.ZFFSAB.eepromChannel[6].EEpromZentralHandler._.ZFFSAB /end MEASUREMENT
/begin MEASUREMENT ZFFSAB._.EEpromZentralHandler.eepromChannel[6].cnt_CallEEpromLoadData "Call counter off function" UBYTE SAB_STANDARD_S2_S3 1 100 0 255 ECU_ADDRESS 0xFFF95FC0 DISPLAY_IDENTIFIER cnt_CallEEpromLoadData.eepromChannel[6].EEpromZentralHandler._.ZFFSAB /end MEASUREMENT
/begin MEASUREMENT ZFFSAB._.EEpromZentralHandler.eepromChannel[6].cnt_CallEEpromLoadDataState "Call counter off function" UBYTE SAB_STANDARD_S2_S3 1 100 0 255 ECU_ADDRESS 0xFFF95FC2 DISPLAY_IDENTIFIER cnt_CallEEpromLoadDataState.eepromChannel[6].EEpromZentralHandler._.ZFFSAB /end MEASUREMENT
/begin MEASUREMENT ZFFSAB._.EEpromZentralHandler.eepromChannel[6].cnt_CallEEpromStoreImmediate "Call counter off function" UBYTE SAB_STANDARD_S2_S3 1 100 0 255 ECU_ADDRESS 0xFFF95FBE DISPLAY_IDENTIFIER cnt_CallEEpromStoreImmediate.eepromChannel[6].EEpromZentralHandler._.ZFFSAB /end MEASUREMENT
/begin MEASUREMENT ZFFSAB._.EEpromZentralHandler.eepromChannel[6].cnt_SetEEpromWriteProtect "Call counter off function" UBYTE SAB_STANDARD_S2_S3 1 100 0 255 ECU_ADDRESS 0xFFF95FC5 DISPLAY_IDENTIFIER cnt_SetEEpromWriteProtect.eepromChannel[6].EEpromZentralHandler._.ZFFSAB /end MEASUREMENT
/begin MEASUREMENT ZFFSAB._.EEpromZentralHandler.eepromChannel[6].mode "argument of SetEEpromInitZyklisch" UBYTE SAB_STANDARD_S2_S3 1 100 0 255 ECU_ADDRESS 0xFFF95FC4 DISPLAY_IDENTIFIER mode.eepromChannel[6].EEpromZentralHandler._.ZFFSAB /end MEASUREMENT
/begin MEASUREMENT ZFFSAB._.EEpromZentralHandler.eepromChannel[6].ret_CallEEpromLoadData "Return value off function" UBYTE SAB_STANDARD_S2_S3 1 100 0 255 ECU_ADDRESS 0xFFF95FC1 DISPLAY_IDENTIFIER ret_CallEEpromLoadData.eepromChannel[6].EEpromZentralHandler._.ZFFSAB /end MEASUREMENT
/begin MEASUREMENT ZFFSAB._.EEpromZentralHandler.eepromChannel[6].ret_CallEEpromLoadDataState "Return value off function" UBYTE SAB_STANDARD_S2_S3 1 100 0 255 ECU_ADDRESS 0xFFF95FC3 DISPLAY_IDENTIFIER ret_CallEEpromLoadDataState.eepromChannel[6].EEpromZentralHandler._.ZFFSAB /end MEASUREMENT
/begin MEASUREMENT ZFFSAB._.EEpromZentralHandler.eepromChannel[6].ret_CallEEpromStoreImmediate "Return value off function" UBYTE SAB_STANDARD_S2_S3 1 100 0 255 ECU_ADDRESS 0xFFF95FBF DISPLAY_IDENTIFIER ret_CallEEpromStoreImmediate.eepromChannel[6].EEpromZentralHandler._.ZFFSAB /end MEASUREMENT
/begin MEASUREMENT ZFFSAB._.EEpromZentralHandler.eepromChannel[7].ZFFSAB._.cEEpromChannel._.cnt_GetEEpromUpdate "Call counter off function" UBYTE SAB_STANDARD_S2_S3 1 100 0 255 ECU_ADDRESS 0xFFF95FC8 DISPLAY_IDENTIFIER cnt_GetEEpromUpdate._.cEEpromChannel._.ZFFSAB.eepromChannel[7].EEpromZentralHandler._.ZFFSAB /end MEASUREMENT
/begin MEASUREMENT ZFFSAB._.EEpromZentralHandler.eepromChannel[7].ZFFSAB._.cEEpromChannel._.cnt_GetEEpromValid "Call counter off function" UBYTE SAB_STANDARD_S2_S3 1 100 0 255 ECU_ADDRESS 0xFFF95FC6 DISPLAY_IDENTIFIER cnt_GetEEpromValid._.cEEpromChannel._.ZFFSAB.eepromChannel[7].EEpromZentralHandler._.ZFFSAB /end MEASUREMENT
/begin MEASUREMENT ZFFSAB._.EEpromZentralHandler.eepromChannel[7].ZFFSAB._.cEEpromChannel._.cnt_GetSizeofEEpromData "Call counter off function" UBYTE SAB_STANDARD_S2_S3 1 100 0 255 ECU_ADDRESS 0xFFF95FCD DISPLAY_IDENTIFIER cnt_GetSizeofEEpromData._.cEEpromChannel._.ZFFSAB.eepromChannel[7].EEpromZentralHandler._.ZFFSAB /end MEASUREMENT
/begin MEASUREMENT ZFFSAB._.EEpromZentralHandler.eepromChannel[7].ZFFSAB._.cEEpromChannel._.cnt_SetEEpromInitZyklisch "Call counter off function" UBYTE SAB_STANDARD_S2_S3 1 100 0 255 ECU_ADDRESS 0xFFF95FCA DISPLAY_IDENTIFIER cnt_SetEEpromInitZyklisch._.cEEpromChannel._.ZFFSAB.eepromChannel[7].EEpromZentralHandler._.ZFFSAB /end MEASUREMENT
/begin MEASUREMENT ZFFSAB._.EEpromZentralHandler.eepromChannel[7].ZFFSAB._.cEEpromChannel._.eeprom_info "argument of SetEEpromInitZyklisch" UBYTE SAB_STANDARD_S2_S3 1 100 0 255 ECU_ADDRESS 0xFFF95FCC DISPLAY_IDENTIFIER eeprom_info._.cEEpromChannel._.ZFFSAB.eepromChannel[7].EEpromZentralHandler._.ZFFSAB /end MEASUREMENT
/begin MEASUREMENT ZFFSAB._.EEpromZentralHandler.eepromChannel[7].ZFFSAB._.cEEpromChannel._.ret_GetEEpromUpdate "Return value off function" UBYTE SAB_STANDARD_S2_S3 1 100 0 255 ECU_ADDRESS 0xFFF95FC9 DISPLAY_IDENTIFIER ret_GetEEpromUpdate._.cEEpromChannel._.ZFFSAB.eepromChannel[7].EEpromZentralHandler._.ZFFSAB /end MEASUREMENT
/begin MEASUREMENT ZFFSAB._.EEpromZentralHandler.eepromChannel[7].ZFFSAB._.cEEpromChannel._.ret_GetEEpromValid "Return value off function" UBYTE SAB_STANDARD_S2_S3 1 100 0 255 ECU_ADDRESS 0xFFF95FC7 DISPLAY_IDENTIFIER ret_GetEEpromValid._.cEEpromChannel._.ZFFSAB.eepromChannel[7].EEpromZentralHandler._.ZFFSAB /end MEASUREMENT
/begin MEASUREMENT ZFFSAB._.EEpromZentralHandler.eepromChannel[7].ZFFSAB._.cEEpromChannel._.ret_GetSizeofEEpromData "Return value off function" UWORD SAB_STANDARD_S2_S3 1 100 0 65535 ECU_ADDRESS 0xFFF95FCE DISPLAY_IDENTIFIER ret_GetSizeofEEpromData._.cEEpromChannel._.ZFFSAB.eepromChannel[7].EEpromZentralHandler._.ZFFSAB /end MEASUREMENT
/begin MEASUREMENT ZFFSAB._.EEpromZentralHandler.eepromChannel[7].ZFFSAB._.cEEpromChannel._.ret_SetEEpromInitZyklisch "Return value off function" UBYTE SAB_STANDARD_S2_S3 1 100 0 255 ECU_ADDRESS 0xFFF95FCB DISPLAY_IDENTIFIER ret_SetEEpromInitZyklisch._.cEEpromChannel._.ZFFSAB.eepromChannel[7].EEpromZentralHandler._.ZFFSAB /end MEASUREMENT
/begin MEASUREMENT ZFFSAB._.EEpromZentralHandler.eepromChannel[7].cnt_CallEEpromLoadData "Call counter off function" UBYTE SAB_STANDARD_S2_S3 1 100 0 255 ECU_ADDRESS 0xFFF95FD2 DISPLAY_IDENTIFIER cnt_CallEEpromLoadData.eepromChannel[7].EEpromZentralHandler._.ZFFSAB /end MEASUREMENT
/begin MEASUREMENT ZFFSAB._.EEpromZentralHandler.eepromChannel[7].cnt_CallEEpromLoadDataState "Call counter off function" UBYTE SAB_STANDARD_S2_S3 1 100 0 255 ECU_ADDRESS 0xFFF95FD4 DISPLAY_IDENTIFIER cnt_CallEEpromLoadDataState.eepromChannel[7].EEpromZentralHandler._.ZFFSAB /end MEASUREMENT
/begin MEASUREMENT ZFFSAB._.EEpromZentralHandler.eepromChannel[7].cnt_CallEEpromStoreImmediate "Call counter off function" UBYTE SAB_STANDARD_S2_S3 1 100 0 255 ECU_ADDRESS 0xFFF95FD0 DISPLAY_IDENTIFIER cnt_CallEEpromStoreImmediate.eepromChannel[7].EEpromZentralHandler._.ZFFSAB /end MEASUREMENT
/begin MEASUREMENT ZFFSAB._.EEpromZentralHandler.eepromChannel[7].cnt_SetEEpromWriteProtect "Call counter off function" UBYTE SAB_STANDARD_S2_S3 1 100 0 255 ECU_ADDRESS 0xFFF95FD7 DISPLAY_IDENTIFIER cnt_SetEEpromWriteProtect.eepromChannel[7].EEpromZentralHandler._.ZFFSAB /end MEASUREMENT
/begin MEASUREMENT ZFFSAB._.EEpromZentralHandler.eepromChannel[7].mode "argument of SetEEpromInitZyklisch" UBYTE SAB_STANDARD_S2_S3 1 100 0 255 ECU_ADDRESS 0xFFF95FD6 DISPLAY_IDENTIFIER mode.eepromChannel[7].EEpromZentralHandler._.ZFFSAB /end MEASUREMENT
/begin MEASUREMENT ZFFSAB._.EEpromZentralHandler.eepromChannel[7].ret_CallEEpromLoadData "Return value off function" UBYTE SAB_STANDARD_S2_S3 1 100 0 255 ECU_ADDRESS 0xFFF95FD3 DISPLAY_IDENTIFIER ret_CallEEpromLoadData.eepromChannel[7].EEpromZentralHandler._.ZFFSAB /end MEASUREMENT
/begin MEASUREMENT ZFFSAB._.EEpromZentralHandler.eepromChannel[7].ret_CallEEpromLoadDataState "Return value off function" UBYTE SAB_STANDARD_S2_S3 1 100 0 255 ECU_ADDRESS 0xFFF95FD5 DISPLAY_IDENTIFIER ret_CallEEpromLoadDataState.eepromChannel[7].EEpromZentralHandler._.ZFFSAB /end MEASUREMENT
/begin MEASUREMENT ZFFSAB._.EEpromZentralHandler.eepromChannel[7].ret_CallEEpromStoreImmediate "Return value off function" UBYTE SAB_STANDARD_S2_S3 1 100 0 255 ECU_ADDRESS 0xFFF95FD1 DISPLAY_IDENTIFIER ret_CallEEpromStoreImmediate.eepromChannel[7].EEpromZentralHandler._.ZFFSAB /end MEASUREMENT
/begin MEASUREMENT ZFFSAB._.EEpromZentralHandler.eepromChannel[8].ZFFSAB._.cEEpromChannel._.cnt_GetEEpromUpdate "Call counter off function" UBYTE SAB_STANDARD_S2_S3 1 100 0 255 ECU_ADDRESS 0xFFF95FDA DISPLAY_IDENTIFIER cnt_GetEEpromUpdate._.cEEpromChannel._.ZFFSAB.eepromChannel[8].EEpromZentralHandler._.ZFFSAB /end MEASUREMENT
/begin MEASUREMENT ZFFSAB._.EEpromZentralHandler.eepromChannel[8].ZFFSAB._.cEEpromChannel._.cnt_GetEEpromValid "Call counter off function" UBYTE SAB_STANDARD_S2_S3 1 100 0 255 ECU_ADDRESS 0xFFF95FD8 DISPLAY_IDENTIFIER cnt_GetEEpromValid._.cEEpromChannel._.ZFFSAB.eepromChannel[8].EEpromZentralHandler._.ZFFSAB /end MEASUREMENT
/begin MEASUREMENT ZFFSAB._.EEpromZentralHandler.eepromChannel[8].ZFFSAB._.cEEpromChannel._.cnt_GetSizeofEEpromData "Call counter off function" UBYTE SAB_STANDARD_S2_S3 1 100 0 255 ECU_ADDRESS 0xFFF95FDF DISPLAY_IDENTIFIER cnt_GetSizeofEEpromData._.cEEpromChannel._.ZFFSAB.eepromChannel[8].EEpromZentralHandler._.ZFFSAB /end MEASUREMENT
/begin MEASUREMENT ZFFSAB._.EEpromZentralHandler.eepromChannel[8].ZFFSAB._.cEEpromChannel._.cnt_SetEEpromInitZyklisch "Call counter off function" UBYTE SAB_STANDARD_S2_S3 1 100 0 255 ECU_ADDRESS 0xFFF95FDC DISPLAY_IDENTIFIER cnt_SetEEpromInitZyklisch._.cEEpromChannel._.ZFFSAB.eepromChannel[8].EEpromZentralHandler._.ZFFSAB /end MEASUREMENT
/begin MEASUREMENT ZFFSAB._.EEpromZentralHandler.eepromChannel[8].ZFFSAB._.cEEpromChannel._.eeprom_info "argument of SetEEpromInitZyklisch" UBYTE SAB_STANDARD_S2_S3 1 100 0 255 ECU_ADDRESS 0xFFF95FDE DISPLAY_IDENTIFIER eeprom_info._.cEEpromChannel._.ZFFSAB.eepromChannel[8].EEpromZentralHandler._.ZFFSAB /end MEASUREMENT
/begin MEASUREMENT ZFFSAB._.EEpromZentralHandler.eepromChannel[8].ZFFSAB._.cEEpromChannel._.ret_GetEEpromUpdate "Return value off function" UBYTE SAB_STANDARD_S2_S3 1 100 0 255 ECU_ADDRESS 0xFFF95FDB DISPLAY_IDENTIFIER ret_GetEEpromUpdate._.cEEpromChannel._.ZFFSAB.eepromChannel[8].EEpromZentralHandler._.ZFFSAB /end MEASUREMENT
/begin MEASUREMENT ZFFSAB._.EEpromZentralHandler.eepromChannel[8].ZFFSAB._.cEEpromChannel._.ret_GetEEpromValid "Return value off function" UBYTE SAB_STANDARD_S2_S3 1 100 0 255 ECU_ADDRESS 0xFFF95FD9 DISPLAY_IDENTIFIER ret_GetEEpromValid._.cEEpromChannel._.ZFFSAB.eepromChannel[8].EEpromZentralHandler._.ZFFSAB /end MEASUREMENT
/begin MEASUREMENT ZFFSAB._.EEpromZentralHandler.eepromChannel[8].ZFFSAB._.cEEpromChannel._.ret_GetSizeofEEpromData "Return value off function" UWORD SAB_STANDARD_S2_S3 1 100 0 65535 ECU_ADDRESS 0xFFF95FE0 DISPLAY_IDENTIFIER ret_GetSizeofEEpromData._.cEEpromChannel._.ZFFSAB.eepromChannel[8].EEpromZentralHandler._.ZFFSAB /end MEASUREMENT
/begin MEASUREMENT ZFFSAB._.EEpromZentralHandler.eepromChannel[8].ZFFSAB._.cEEpromChannel._.ret_SetEEpromInitZyklisch "Return value off function" UBYTE SAB_STANDARD_S2_S3 1 100 0 255 ECU_ADDRESS 0xFFF95FDD DISPLAY_IDENTIFIER ret_SetEEpromInitZyklisch._.cEEpromChannel._.ZFFSAB.eepromChannel[8].EEpromZentralHandler._.ZFFSAB /end MEASUREMENT
/begin MEASUREMENT ZFFSAB._.EEpromZentralHandler.eepromChannel[8].cnt_CallEEpromLoadData "Call counter off function" UBYTE SAB_STANDARD_S2_S3 1 100 0 255 ECU_ADDRESS 0xFFF95FE4 DISPLAY_IDENTIFIER cnt_CallEEpromLoadData.eepromChannel[8].EEpromZentralHandler._.ZFFSAB /end MEASUREMENT
/begin MEASUREMENT ZFFSAB._.EEpromZentralHandler.eepromChannel[8].cnt_CallEEpromLoadDataState "Call counter off function" UBYTE SAB_STANDARD_S2_S3 1 100 0 255 ECU_ADDRESS 0xFFF95FE6 DISPLAY_IDENTIFIER cnt_CallEEpromLoadDataState.eepromChannel[8].EEpromZentralHandler._.ZFFSAB /end MEASUREMENT
/begin MEASUREMENT ZFFSAB._.EEpromZentralHandler.eepromChannel[8].cnt_CallEEpromStoreImmediate "Call counter off function" UBYTE SAB_STANDARD_S2_S3 1 100 0 255 ECU_ADDRESS 0xFFF95FE2 DISPLAY_IDENTIFIER cnt_CallEEpromStoreImmediate.eepromChannel[8].EEpromZentralHandler._.ZFFSAB /end MEASUREMENT
/begin MEASUREMENT ZFFSAB._.EEpromZentralHandler.eepromChannel[8].cnt_SetEEpromWriteProtect "Call counter off function" UBYTE SAB_STANDARD_S2_S3 1 100 0 255 ECU_ADDRESS 0xFFF95FE9 DISPLAY_IDENTIFIER cnt_SetEEpromWriteProtect.eepromChannel[8].EEpromZentralHandler._.ZFFSAB /end MEASUREMENT
/begin MEASUREMENT ZFFSAB._.EEpromZentralHandler.eepromChannel[8].mode "argument of SetEEpromInitZyklisch" UBYTE SAB_STANDARD_S2_S3 1 100 0 255 ECU_ADDRESS 0xFFF95FE8 DISPLAY_IDENTIFIER mode.eepromChannel[8].EEpromZentralHandler._.ZFFSAB /end MEASUREMENT
/begin MEASUREMENT ZFFSAB._.EEpromZentralHandler.eepromChannel[8].ret_CallEEpromLoadData "Return value off function" UBYTE SAB_STANDARD_S2_S3 1 100 0 255 ECU_ADDRESS 0xFFF95FE5 DISPLAY_IDENTIFIER ret_CallEEpromLoadData.eepromChannel[8].EEpromZentralHandler._.ZFFSAB /end MEASUREMENT
/begin MEASUREMENT ZFFSAB._.EEpromZentralHandler.eepromChannel[8].ret_CallEEpromLoadDataState "Return value off function" UBYTE SAB_STANDARD_S2_S3 1 100 0 255 ECU_ADDRESS 0xFFF95FE7 DISPLAY_IDENTIFIER ret_CallEEpromLoadDataState.eepromChannel[8].EEpromZentralHandler._.ZFFSAB /end MEASUREMENT
/begin MEASUREMENT ZFFSAB._.EEpromZentralHandler.eepromChannel[8].ret_CallEEpromStoreImmediate "Return value off function" UBYTE SAB_STANDARD_S2_S3 1 100 0 255 ECU_ADDRESS 0xFFF95FE3 DISPLAY_IDENTIFIER ret_CallEEpromStoreImmediate.eepromChannel[8].EEpromZentralHandler._.ZFFSAB /end MEASUREMENT
/begin MEASUREMENT ZFFSAB._.EEpromZentralHandler.eepromChannel[9].ZFFSAB._.cEEpromChannel._.cnt_GetEEpromUpdate "Call counter off function" UBYTE SAB_STANDARD_S2_S3 1 100 0 255 ECU_ADDRESS 0xFFF95FEC DISPLAY_IDENTIFIER cnt_GetEEpromUpdate._.cEEpromChannel._.ZFFSAB.eepromChannel[9].EEpromZentralHandler._.ZFFSAB /end MEASUREMENT
/begin MEASUREMENT ZFFSAB._.EEpromZentralHandler.eepromChannel[9].ZFFSAB._.cEEpromChannel._.cnt_GetEEpromValid "Call counter off function" UBYTE SAB_STANDARD_S2_S3 1 100 0 255 ECU_ADDRESS 0xFFF95FEA DISPLAY_IDENTIFIER cnt_GetEEpromValid._.cEEpromChannel._.ZFFSAB.eepromChannel[9].EEpromZentralHandler._.ZFFSAB /end MEASUREMENT
/begin MEASUREMENT ZFFSAB._.EEpromZentralHandler.eepromChannel[9].ZFFSAB._.cEEpromChannel._.cnt_GetSizeofEEpromData "Call counter off function" UBYTE SAB_STANDARD_S2_S3 1 100 0 255 ECU_ADDRESS 0xFFF95FF1 DISPLAY_IDENTIFIER cnt_GetSizeofEEpromData._.cEEpromChannel._.ZFFSAB.eepromChannel[9].EEpromZentralHandler._.ZFFSAB /end MEASUREMENT
/begin MEASUREMENT ZFFSAB._.EEpromZentralHandler.eepromChannel[9].ZFFSAB._.cEEpromChannel._.cnt_SetEEpromInitZyklisch "Call counter off function" UBYTE SAB_STANDARD_S2_S3 1 100 0 255 ECU_ADDRESS 0xFFF95FEE DISPLAY_IDENTIFIER cnt_SetEEpromInitZyklisch._.cEEpromChannel._.ZFFSAB.eepromChannel[9].EEpromZentralHandler._.ZFFSAB /end MEASUREMENT
/begin MEASUREMENT ZFFSAB._.EEpromZentralHandler.eepromChannel[9].ZFFSAB._.cEEpromChannel._.eeprom_info "argument of SetEEpromInitZyklisch" UBYTE SAB_STANDARD_S2_S3 1 100 0 255 ECU_ADDRESS 0xFFF95FF0 DISPLAY_IDENTIFIER eeprom_info._.cEEpromChannel._.ZFFSAB.eepromChannel[9].EEpromZentralHandler._.ZFFSAB /end MEASUREMENT
/begin MEASUREMENT ZFFSAB._.EEpromZentralHandler.eepromChannel[9].ZFFSAB._.cEEpromChannel._.ret_GetEEpromUpdate "Return value off function" UBYTE SAB_STANDARD_S2_S3 1 100 0 255 ECU_ADDRESS 0xFFF95FED DISPLAY_IDENTIFIER ret_GetEEpromUpdate._.cEEpromChannel._.ZFFSAB.eepromChannel[9].EEpromZentralHandler._.ZFFSAB /end MEASUREMENT
/begin MEASUREMENT ZFFSAB._.EEpromZentralHandler.eepromChannel[9].ZFFSAB._.cEEpromChannel._.ret_GetEEpromValid "Return value off function" UBYTE SAB_STANDARD_S2_S3 1 100 0 255 ECU_ADDRESS 0xFFF95FEB DISPLAY_IDENTIFIER ret_GetEEpromValid._.cEEpromChannel._.ZFFSAB.eepromChannel[9].EEpromZentralHandler._.ZFFSAB /end MEASUREMENT
/begin MEASUREMENT ZFFSAB._.EEpromZentralHandler.eepromChannel[9].ZFFSAB._.cEEpromChannel._.ret_GetSizeofEEpromData "Return value off function" UWORD SAB_STANDARD_S2_S3 1 100 0 65535 ECU_ADDRESS 0xFFF95FF2 DISPLAY_IDENTIFIER ret_GetSizeofEEpromData._.cEEpromChannel._.ZFFSAB.eepromChannel[9].EEpromZentralHandler._.ZFFSAB /end MEASUREMENT
/begin MEASUREMENT ZFFSAB._.EEpromZentralHandler.eepromChannel[9].ZFFSAB._.cEEpromChannel._.ret_SetEEpromInitZyklisch "Return value off function" UBYTE SAB_STANDARD_S2_S3 1 100 0 255 ECU_ADDRESS 0xFFF95FEF DISPLAY_IDENTIFIER ret_SetEEpromInitZyklisch._.cEEpromChannel._.ZFFSAB.eepromChannel[9].EEpromZentralHandler._.ZFFSAB /end MEASUREMENT
/begin MEASUREMENT ZFFSAB._.EEpromZentralHandler.eepromChannel[9].cnt_CallEEpromLoadData "Call counter off function" UBYTE SAB_STANDARD_S2_S3 1 100 0 255 ECU_ADDRESS 0xFFF95FF6 DISPLAY_IDENTIFIER cnt_CallEEpromLoadData.eepromChannel[9].EEpromZentralHandler._.ZFFSAB /end MEASUREMENT
/begin MEASUREMENT ZFFSAB._.EEpromZentralHandler.eepromChannel[9].cnt_CallEEpromLoadDataState "Call counter off function" UBYTE SAB_STANDARD_S2_S3 1 100 0 255 ECU_ADDRESS 0xFFF95FF8 DISPLAY_IDENTIFIER cnt_CallEEpromLoadDataState.eepromChannel[9].EEpromZentralHandler._.ZFFSAB /end MEASUREMENT
/begin MEASUREMENT ZFFSAB._.EEpromZentralHandler.eepromChannel[9].cnt_CallEEpromStoreImmediate "Call counter off function" UBYTE SAB_STANDARD_S2_S3 1 100 0 255 ECU_ADDRESS 0xFFF95FF4 DISPLAY_IDENTIFIER cnt_CallEEpromStoreImmediate.eepromChannel[9].EEpromZentralHandler._.ZFFSAB /end MEASUREMENT
/begin MEASUREMENT ZFFSAB._.EEpromZentralHandler.eepromChannel[9].cnt_SetEEpromWriteProtect "Call counter off function" UBYTE SAB_STANDARD_S2_S3 1 100 0 255 ECU_ADDRESS 0xFFF95FFB DISPLAY_IDENTIFIER cnt_SetEEpromWriteProtect.eepromChannel[9].EEpromZentralHandler._.ZFFSAB /end MEASUREMENT
/begin MEASUREMENT ZFFSAB._.EEpromZentralHandler.eepromChannel[9].mode "argument of SetEEpromInitZyklisch" UBYTE SAB_STANDARD_S2_S3 1 100 0 255 ECU_ADDRESS 0xFFF95FFA DISPLAY_IDENTIFIER mode.eepromChannel[9].EEpromZentralHandler._.ZFFSAB /end MEASUREMENT
/begin MEASUREMENT ZFFSAB._.EEpromZentralHandler.eepromChannel[9].ret_CallEEpromLoadData "Return value off function" UBYTE SAB_STANDARD_S2_S3 1 100 0 255 ECU_ADDRESS 0xFFF95FF7 DISPLAY_IDENTIFIER ret_CallEEpromLoadData.eepromChannel[9].EEpromZentralHandler._.ZFFSAB /end MEASUREMENT
/begin MEASUREMENT ZFFSAB._.EEpromZentralHandler.eepromChannel[9].ret_CallEEpromLoadDataState "Return value off function" UBYTE SAB_STANDARD_S2_S3 1 100 0 255 ECU_ADDRESS 0xFFF95FF9 DISPLAY_IDENTIFIER ret_CallEEpromLoadDataState.eepromChannel[9].EEpromZentralHandler._.ZFFSAB /end MEASUREMENT
/begin MEASUREMENT ZFFSAB._.EEpromZentralHandler.eepromChannel[9].ret_CallEEpromStoreImmediate "Return value off function" UBYTE SAB_STANDARD_S2_S3 1 100 0 255 ECU_ADDRESS 0xFFF95FF5 DISPLAY_IDENTIFIER ret_CallEEpromStoreImmediate.eepromChannel[9].EEpromZentralHandler._.ZFFSAB /end MEASUREMENT
/begin MEASUREMENT ZFFSAB._.EEpromZentralHandler.f_EeStoringActive "True if Storing - within EEZH - into the EEPROM is in progress" UBYTE SAB_STANDARD_S2_S3 1 100 0 255 ECU_ADDRESS 0xFFF960A0 DISPLAY_IDENTIFIER f_EeStoringActive.EEpromZentralHandler._.ZFFSAB /end MEASUREMENT
/begin MEASUREMENT ZFFSAB._.EEpromZentralHandler.iv_cnt_EeUpdt "Returns number of successfull saved partitions since start of EEPROM-Emulation" ULONG SAB_STANDARD_S2_S3 1 100 0 4294967295 ECU_ADDRESS 0xFFF960A4 DISPLAY_IDENTIFIER iv_cnt_EeUpdt.EEpromZentralHandler._.ZFFSAB /end MEASUREMENT
/begin MEASUREMENT ZFFSAB._.EEpromZentralHandler.iv_cnt_ErrMemEntry "Number of Trouble Codes Set due to Diagnostic Test" UWORD SAB_STANDARD_S2_S3 1 100 0 65535 ECU_ADDRESS 0xFFF960A8 DISPLAY_IDENTIFIER iv_cnt_ErrMemEntry.EEpromZentralHandler._.ZFFSAB /end MEASUREMENT
/begin MEASUREMENT ZFFSAB._.EEpromZentralHandler.iv_f_EeStoreInProgress "1=EEPROM Storage - outside EEZH - is activ 0=EEPROM Storage is not activ" UBYTE SAB_STANDARD_S2_S3 1 100 0 255 ECU_ADDRESS 0xFFF960AA DISPLAY_IDENTIFIER iv_f_EeStoreInProgress.EEpromZentralHandler._.ZFFSAB /end MEASUREMENT
/begin MEASUREMENT ZFFSAB._.EmergencyGearInfo.Gear_during_act_KMN_GFIX "Input value for actual gear during activation KMN GFIX" SBYTE SAB_STANDARD_S2_S3 1 100 -1 8 ECU_ADDRESS 0xFFF95EEC DISPLAY_IDENTIFIER Gear_during_act_KMN_GFIX.EmergencyGearInfo._.ZFFSAB /end MEASUREMENT
/begin MEASUREMENT ZFFSAB._.EmergencyGearInfo.KMN_GFIX_last_cycle "status KMN GFIX last cycle" ULONG SAB_STANDARD_S2_S3 1 100 0 1 ECU_ADDRESS 0xFFF95EF0 DISPLAY_IDENTIFIER KMN_GFIX_last_cycle.EmergencyGearInfo._.ZFFSAB /end MEASUREMENT
/begin MEASUREMENT ZFFSAB._.EmergencyGearInfo.KMN_High_active_last_call "active KMN high last cycle" ULONG SAB_STANDARD_S2_S3 1 100 0 1 ECU_ADDRESS 0xFFF95EB4 DISPLAY_IDENTIFIER KMN_High_active_last_call.EmergencyGearInfo._.ZFFSAB /end MEASUREMENT
/begin MEASUREMENT ZFFSAB._.EmergencyGearInfo.KMN_active_last_call "active KMN last cycle" ULONG SAB_STANDARD_S2_S3 1 100 0 1 ECU_ADDRESS 0xFFF95EB0 DISPLAY_IDENTIFIER KMN_active_last_call.EmergencyGearInfo._.ZFFSAB /end MEASUREMENT
/begin MEASUREMENT ZFFSAB._.EmergencyGearInfo.ctl_EmergencyGearInfo "information to Hpsys about EmergencyGearInfo" UBYTE SAB_STANDARD_S2_S3 1 100 0 36 ECU_ADDRESS 0xFFF95ED2 DISPLAY_IDENTIFIER ctl_EmergencyGearInfo.EmergencyGearInfo._.ZFFSAB /end MEASUREMENT
/begin MEASUREMENT ZFFSAB._.EmergencyGearInfo.f_3th_stepENPGx "3th step achieved" UBYTE SAB_STANDARD_S2_S3 1 100 0 1 ECU_ADDRESS 0xFFF95EAE DISPLAY_IDENTIFIER f_3th_stepENPGx.EmergencyGearInfo._.ZFFSAB /end MEASUREMENT
/begin MEASUREMENT ZFFSAB._.EmergencyGearInfo.f_IgnitionOff2On "Ignition Off to On" UBYTE SAB_STANDARD_S2_S3 1 100 0 1 ECU_ADDRESS 0xFFF95EAD DISPLAY_IDENTIFIER f_IgnitionOff2On.EmergencyGearInfo._.ZFFSAB /end MEASUREMENT
/begin MEASUREMENT ZFFSAB._.EmergencyGearInfo.iv_ActualGear "Input value for actual gear" SBYTE SAB_STANDARD_S2_S3 1 100 -1 8 ECU_ADDRESS 0xFFF95EA6 DISPLAY_IDENTIFIER iv_ActualGear.EmergencyGearInfo._.ZFFSAB /end MEASUREMENT
/begin MEASUREMENT ZFFSAB._.EmergencyGearInfo.iv_Pos "Input value for position of E-GearLever" UBYTE SAB_STANDARD_S2_S3 1 100 0 255 ECU_ADDRESS 0xFFF95EA8 DISPLAY_IDENTIFIER iv_Pos.EmergencyGearInfo._.ZFFSAB /end MEASUREMENT
/begin MEASUREMENT ZFFSAB._.EmergencyGearInfo.iv_PosSts "Input value for status E-GearLever" UBYTE SAB_STANDARD_S2_S3 1 100 0 1 ECU_ADDRESS 0xFFF95EA9 DISPLAY_IDENTIFIER iv_PosSts.EmergencyGearInfo._.ZFFSAB /end MEASUREMENT
/begin MEASUREMENT ZFFSAB._.EmergencyGearInfo.iv_TargetGear "Input value for target gear" SBYTE SAB_STANDARD_S2_S3 1 100 -1 8 ECU_ADDRESS 0xFFF95EA7 DISPLAY_IDENTIFIER iv_TargetGear.EmergencyGearInfo._.ZFFSAB /end MEASUREMENT
/begin MEASUREMENT ZFFSAB._.EmergencyGearInfo.iv_in_Gear1Act "Input value for gearRatio of first gear" UWORD SAB_K1000_S2_S3 1 100 0 65.535 ECU_ADDRESS 0xFFF95EC2 DISPLAY_IDENTIFIER iv_in_Gear1Act.EmergencyGearInfo._.ZFFSAB /end MEASUREMENT
/begin MEASUREMENT ZFFSAB._.EmergencyGearInfo.iv_in_Gear2Act "Input value for gearRatio of second gear" UWORD SAB_K1000_S2_S3 1 100 0 65.535 ECU_ADDRESS 0xFFF95EC4 DISPLAY_IDENTIFIER iv_in_Gear2Act.EmergencyGearInfo._.ZFFSAB /end MEASUREMENT
/begin MEASUREMENT ZFFSAB._.EmergencyGearInfo.iv_in_Gear3Act "Input value for gearRatio of third gear" UWORD SAB_K1000_S2_S3 1 100 0 65.535 ECU_ADDRESS 0xFFF95EC6 DISPLAY_IDENTIFIER iv_in_Gear3Act.EmergencyGearInfo._.ZFFSAB /end MEASUREMENT
/begin MEASUREMENT ZFFSAB._.EmergencyGearInfo.iv_in_Gear4Act "Input value for gearRatio of fourth gear" UWORD SAB_K1000_S2_S3 1 100 0 65.535 ECU_ADDRESS 0xFFF95EC8 DISPLAY_IDENTIFIER iv_in_Gear4Act.EmergencyGearInfo._.ZFFSAB /end MEASUREMENT
/begin MEASUREMENT ZFFSAB._.EmergencyGearInfo.iv_in_Gear5Act "Input value for gearRatio of fifth gear" UWORD SAB_K1000_S2_S3 1 100 0 65.535 ECU_ADDRESS 0xFFF95ECA DISPLAY_IDENTIFIER iv_in_Gear5Act.EmergencyGearInfo._.ZFFSAB /end MEASUREMENT
/begin MEASUREMENT ZFFSAB._.EmergencyGearInfo.iv_in_Gear6Act "Input value for gearRatio of sixth gear" UWORD SAB_K1000_S2_S3 1 100 0 65.535 ECU_ADDRESS 0xFFF95ECC DISPLAY_IDENTIFIER iv_in_Gear6Act.EmergencyGearInfo._.ZFFSAB /end MEASUREMENT
/begin MEASUREMENT ZFFSAB._.EmergencyGearInfo.iv_in_GearAct "Input value for gearRatio of actual gear" UWORD SAB_K1000_S2_S3 1 100 0 65.535 ECU_ADDRESS 0xFFF95ECE DISPLAY_IDENTIFIER iv_in_GearAct.EmergencyGearInfo._.ZFFSAB /end MEASUREMENT
/begin MEASUREMENT ZFFSAB._.EmergencyGearInfo.iv_n_EnUTh "Input value for upper threshold of engine-RPM" UWORD SAB_N_1RPM_S2_S3 1 100 0 65535 ECU_ADDRESS 0xFFF95ED0 DISPLAY_IDENTIFIER iv_n_EnUTh.EmergencyGearInfo._.ZFFSAB /end MEASUREMENT
/begin MEASUREMENT ZFFSAB._.EmergencyGearInfo.loc_ConditionENPG3Fix "intern test-variable only" UBYTE SAB_STANDARD_S2_S3 1 100 0 255 ECU_ADDRESS 0xFFF95EC1 DISPLAY_IDENTIFIER loc_ConditionENPG3Fix.EmergencyGearInfo._.ZFFSAB /end MEASUREMENT
/begin MEASUREMENT ZFFSAB._.EmergencyGearInfo.loc_ConditionGear1 "intern test-variable only" UBYTE SAB_STANDARD_S2_S3 1 100 0 255 ECU_ADDRESS 0xFFF95EBB DISPLAY_IDENTIFIER loc_ConditionGear1.EmergencyGearInfo._.ZFFSAB /end MEASUREMENT
/begin MEASUREMENT ZFFSAB._.EmergencyGearInfo.loc_ConditionGear2 "intern test-variable only" UBYTE SAB_STANDARD_S2_S3 1 100 0 255 ECU_ADDRESS 0xFFF95EBC DISPLAY_IDENTIFIER loc_ConditionGear2.EmergencyGearInfo._.ZFFSAB /end MEASUREMENT
/begin MEASUREMENT ZFFSAB._.EmergencyGearInfo.loc_ConditionGear3 "intern test-variable only" UBYTE SAB_STANDARD_S2_S3 1 100 0 255 ECU_ADDRESS 0xFFF95EBD DISPLAY_IDENTIFIER loc_ConditionGear3.EmergencyGearInfo._.ZFFSAB /end MEASUREMENT
/begin MEASUREMENT ZFFSAB._.EmergencyGearInfo.loc_ConditionGear4 "intern test-variable only" UBYTE SAB_STANDARD_S2_S3 1 100 0 255 ECU_ADDRESS 0xFFF95EBE DISPLAY_IDENTIFIER loc_ConditionGear4.EmergencyGearInfo._.ZFFSAB /end MEASUREMENT
/begin MEASUREMENT ZFFSAB._.EmergencyGearInfo.loc_ConditionGear5 "intern test-variable only" UBYTE SAB_STANDARD_S2_S3 1 100 0 255 ECU_ADDRESS 0xFFF95EBF DISPLAY_IDENTIFIER loc_ConditionGear5.EmergencyGearInfo._.ZFFSAB /end MEASUREMENT
/begin MEASUREMENT ZFFSAB._.EmergencyGearInfo.loc_ConditionGear6 "intern test-variable only" UBYTE SAB_STANDARD_S2_S3 1 100 0 255 ECU_ADDRESS 0xFFF95EC0 DISPLAY_IDENTIFIER loc_ConditionGear6.EmergencyGearInfo._.ZFFSAB /end MEASUREMENT
/begin MEASUREMENT ZFFSAB._.EmergencyGearInfo.loc_reg_for_GFIX_old "active KMN last cycle" ULONG SAB_STANDARD_S2_S3 1 100 0 1 ECU_ADDRESS 0xFFF95EE4 DISPLAY_IDENTIFIER loc_reg_for_GFIX_old.EmergencyGearInfo._.ZFFSAB /end MEASUREMENT
/begin MEASUREMENT ZFFSAB._.EmergencyGearInfo.loc_reg_hi_for_GFIX_old "active KMN high last cycle" ULONG SAB_STANDARD_S2_S3 1 100 0 1 ECU_ADDRESS 0xFFF95EE8 DISPLAY_IDENTIFIER loc_reg_hi_for_GFIX_old.EmergencyGearInfo._.ZFFSAB /end MEASUREMENT
/begin MEASUREMENT ZFFSAB._.EmergencyGearInfo.n_AbUThGearSubst1 "Output value for calculated threshold" UWORD SAB_N_1RPM_S2_S3 1 100 0 65535 ECU_ADDRESS 0xFFF95ED4 DISPLAY_IDENTIFIER n_AbUThGearSubst1.EmergencyGearInfo._.ZFFSAB /end MEASUREMENT
/begin MEASUREMENT ZFFSAB._.EmergencyGearInfo.n_AbUThGearSubst2 "Output value for calculated threshold" UWORD SAB_N_1RPM_S2_S3 1 100 0 65535 ECU_ADDRESS 0xFFF95ED6 DISPLAY_IDENTIFIER n_AbUThGearSubst2.EmergencyGearInfo._.ZFFSAB /end MEASUREMENT
/begin MEASUREMENT ZFFSAB._.EmergencyGearInfo.n_AbUThGearSubst3 "Output value for calculated threshold" UWORD SAB_N_1RPM_S2_S3 1 100 0 65535 ECU_ADDRESS 0xFFF95ED8 DISPLAY_IDENTIFIER n_AbUThGearSubst3.EmergencyGearInfo._.ZFFSAB /end MEASUREMENT
/begin MEASUREMENT ZFFSAB._.EmergencyGearInfo.n_AbUThGearSubst4 "Output value for calculated threshold" UWORD SAB_N_1RPM_S2_S3 1 100 0 65535 ECU_ADDRESS 0xFFF95EDA DISPLAY_IDENTIFIER n_AbUThGearSubst4.EmergencyGearInfo._.ZFFSAB /end MEASUREMENT
/begin MEASUREMENT ZFFSAB._.EmergencyGearInfo.n_AbUThGearSubst5 "Output value for calculated threshold" UWORD SAB_N_1RPM_S2_S3 1 100 0 65535 ECU_ADDRESS 0xFFF95EDC DISPLAY_IDENTIFIER n_AbUThGearSubst5.EmergencyGearInfo._.ZFFSAB /end MEASUREMENT
/begin MEASUREMENT ZFFSAB._.EmergencyGearInfo.n_AbUThGearSubst6 "Output value for calculated threshold" UWORD SAB_N_1RPM_S2_S3 1 100 0 65535 ECU_ADDRESS 0xFFF95EDE DISPLAY_IDENTIFIER n_AbUThGearSubst6.EmergencyGearInfo._.ZFFSAB /end MEASUREMENT
/begin MEASUREMENT ZFFSAB._.EmergencyGearInfo.st_ENPG3 "internal state of ENPG3 state machine" UBYTE SAB_STANDARD_S2_S3 1 100 0 255 ECU_ADDRESS 0xFFF95EB9 DISPLAY_IDENTIFIER st_ENPG3.EmergencyGearInfo._.ZFFSAB /end MEASUREMENT
/begin MEASUREMENT ZFFSAB._.EmergencyGearInfo.st_ENPG3FIX "internal state of ENPG3FIX state machine" UBYTE SAB_STANDARD_S2_S3 1 100 0 255 ECU_ADDRESS 0xFFF95EBA DISPLAY_IDENTIFIER st_ENPG3FIX.EmergencyGearInfo._.ZFFSAB /end MEASUREMENT
/begin MEASUREMENT ZFFSAB._.EmergencyGearInfo.st_KMN_GFIX_KFC_ERSATZ "internal state of GFIX_KFC_ERSATZ state machine" UBYTE SAB_STANDARD_S2_S3 1 100 0 255 ECU_ADDRESS 0xFFF95EE0 DISPLAY_IDENTIFIER st_KMN_GFIX_KFC_ERSATZ.EmergencyGearInfo._.ZFFSAB /end MEASUREMENT
/begin MEASUREMENT ZFFSAB._.EmergencyGearInfo.st_RD_ENPG3_ENPG3FIX "internal state of ENPG3 state machine" UBYTE SAB_STANDARD_S2_S3 1 100 0 255 ECU_ADDRESS 0xFFF95EB8 DISPLAY_IDENTIFIER st_RD_ENPG3_ENPG3FIX.EmergencyGearInfo._.ZFFSAB /end MEASUREMENT
/begin MEASUREMENT ZFFSAB._.EmergencyGearInfo.sv_IEPsoll_subst "set value KO" UBYTE SAB_STANDARD_S2_S3 1 100 0 4 ECU_ADDRESS 0xFFF95EAB DISPLAY_IDENTIFIER sv_IEPsoll_subst.EmergencyGearInfo._.ZFFSAB /end MEASUREMENT
/begin MEASUREMENT ZFFSAB._.EmergencyGearInfo.sv_K0soll_subst "set value KO" UBYTE SAB_STANDARD_S2_S3 1 100 0 3 ECU_ADDRESS 0xFFF95EAC DISPLAY_IDENTIFIER sv_K0soll_subst.EmergencyGearInfo._.ZFFSAB /end MEASUREMENT
/begin MEASUREMENT ZFFSAB._.EmergencyGearInfo.sv_ctl_EmergencyGearInfoCpy "copy of Emergency gear info" UBYTE SAB_STANDARD_S2_S3 1 100 0 255 ECU_ADDRESS 0xFFF95EAA DISPLAY_IDENTIFIER sv_ctl_EmergencyGearInfoCpy.EmergencyGearInfo._.ZFFSAB /end MEASUREMENT
/begin MEASUREMENT ZFFSAB._.EmergencyGearInfo.tmr_3th_stepENPGx.time "Description for this variable only in SW documentation possible not in asap2" UWORD SAB_T_TIMER_10MS_S2_S3 1 100 0 655350 ECU_ADDRESS 0xFFF95EA2 DISPLAY_IDENTIFIER time.tmr_3th_stepENPGx.EmergencyGearInfo._.ZFFSAB /end MEASUREMENT
/begin MEASUREMENT ZFFSAB._.EmergencyGearInfo.tmr_ENPG3.time "Description for this variable only in SW documentation possible not in asap2" UWORD SAB_T_TIMER_10MS_S2_S3 1 100 0 655350 ECU_ADDRESS 0xFFF95EA4 DISPLAY_IDENTIFIER time.tmr_ENPG3.EmergencyGearInfo._.ZFFSAB /end MEASUREMENT
/begin MEASUREMENT ZFFSAB._.EmergencyGearInfo.tmr_GearSubst.time "Description for this variable only in SW documentation possible not in asap2" UWORD SAB_T_TIMER_10MS_S2_S3 1 100 0 655350 ECU_ADDRESS 0xFFF95EA0 DISPLAY_IDENTIFIER time.tmr_GearSubst.EmergencyGearInfo._.ZFFSAB /end MEASUREMENT
/begin MEASUREMENT ZFFSAB._.EngineCoolantTempIn.f_c_CemErr "Error flag of electrical machine temperature" UBYTE SAB_STANDARD_S2_S3 1 100 0 255 ECU_ADDRESS 0xFFF95980 DISPLAY_IDENTIFIER f_c_CemErr.EngineCoolantTempIn._.ZFFSAB /end MEASUREMENT
/begin MEASUREMENT ZFFSAB._.EngineCoolantTempIn.f_c_EngErr "Error flag of engine coolant temperature" UBYTE SAB_STANDARD_S2_S3 1 100 0 255 ECU_ADDRESS 0xFFF95981 DISPLAY_IDENTIFIER f_c_EngErr.EngineCoolantTempIn._.ZFFSAB /end MEASUREMENT
/begin MEASUREMENT ZFFSAB._.EngineCoolantTempIn.iv_c_Cem "Input value Temperature of electrical machine from CAN" UBYTE SAB_C_CMO_1CEL_M48_S2_S3 1 100 -48 207 ECU_ADDRESS 0xFFF9597A DISPLAY_IDENTIFIER iv_c_Cem.EngineCoolantTempIn._.ZFFSAB /end MEASUREMENT
/begin MEASUREMENT ZFFSAB._.EngineCoolantTempIn.iv_c_CemSts "Input value message status Temperature of electrical machine" UBYTE SAB_STANDARD_S2_S3 1 100 0 255 ECU_ADDRESS 0xFFF9597B DISPLAY_IDENTIFIER iv_c_CemSts.EngineCoolantTempIn._.ZFFSAB /end MEASUREMENT
/begin MEASUREMENT ZFFSAB._.EngineCoolantTempIn.iv_c_Eng "Input value engine coolant temperature from CAN" UBYTE SAB_C_CMO_1CEL_M48_S2_S3 1 100 -48 207 ECU_ADDRESS 0xFFF95978 DISPLAY_IDENTIFIER iv_c_Eng.EngineCoolantTempIn._.ZFFSAB /end MEASUREMENT
/begin MEASUREMENT ZFFSAB._.EngineCoolantTempIn.iv_c_EngSts "Input value message status of engine coolant temperature" UBYTE SAB_STANDARD_S2_S3 1 100 0 255 ECU_ADDRESS 0xFFF95979 DISPLAY_IDENTIFIER iv_c_EngSts.EngineCoolantTempIn._.ZFFSAB /end MEASUREMENT
/begin MEASUREMENT ZFFSAB._.EngineCoolantTempIn.sv_AGS_Cem "Output value engine coolant temperature" UBYTE SAB_C_CMO_1CEL_M48_S2_S3 1 100 -48 207 ECU_ADDRESS 0xFFF9597E DISPLAY_IDENTIFIER sv_AGS_Cem.EngineCoolantTempIn._.ZFFSAB /end MEASUREMENT
/begin MEASUREMENT ZFFSAB._.EngineCoolantTempIn.sv_c_CemSts "Output value signal status of engine coolant temperature" UBYTE SAB_STANDARD_S2_S3 1 100 0 255 ECU_ADDRESS 0xFFF9597F DISPLAY_IDENTIFIER sv_c_CemSts.EngineCoolantTempIn._.ZFFSAB /end MEASUREMENT
/begin MEASUREMENT ZFFSAB._.EngineCoolantTempIn.sv_c_Eng "Output value engine coolant temperature" UBYTE SAB_C_CMO_1CEL_M48_S2_S3 1 100 -48 207 ECU_ADDRESS 0xFFF9597C DISPLAY_IDENTIFIER sv_c_Eng.EngineCoolantTempIn._.ZFFSAB /end MEASUREMENT
/begin MEASUREMENT ZFFSAB._.EngineCoolantTempIn.sv_c_EngSts "Output value signal status of engine coolant temperature" UBYTE SAB_STANDARD_S2_S3 1 100 0 255 ECU_ADDRESS 0xFFF9597D DISPLAY_IDENTIFIER sv_c_EngSts.EngineCoolantTempIn._.ZFFSAB /end MEASUREMENT
/begin MEASUREMENT ZFFSAB._.EngineIdleIn.f_EngIdleActiveErr "Error flag for local diagnosis: 0=no error 1=error detected" UBYTE SAB_STANDARD_S2_S3 1 100 0 1 ECU_ADDRESS 0xFFF96CF7 DISPLAY_IDENTIFIER f_EngIdleActiveErr.EngineIdleIn._.ZFFSAB /end MEASUREMENT
/begin MEASUREMENT ZFFSAB._.EngineIdleIn.iv_EngIdleActive "CAN-Rawsignal: GETCAN_RX_ST_IDLG_ENG_DRV :: This signals specifies if the engine is idling or not. This information will be needed for the stabilizing of the display for the rotational-speed counter and for the recognition for the range in which the engin" UBYTE SAB_STANDARD_S2_S3 1 100 0 3 ECU_ADDRESS 0xFFF96CF3 DISPLAY_IDENTIFIER iv_EngIdleActive.EngineIdleIn._.ZFFSAB /end MEASUREMENT
/begin MEASUREMENT ZFFSAB._.EngineIdleIn.iv_EngIdleActiveSts "Status for the CAN-Signal: GETCAN_RX_ST_IDLG_ENG_DRV :: Bit coded- 0000.0000: Signal is Ok xxxx.xxx1: Time-Out error xxxx.xx1x: CAN-bus error xxxx.x1xx: CAN-version error xxxx.1xxx: Checksum error xxx1.xxxx: Alive counter error xx1x.xxxx: Level 2 error x1" UBYTE SAB_STANDARD_S2_S3 1 100 0 255 ECU_ADDRESS 0xFFF96CF4 DISPLAY_IDENTIFIER iv_EngIdleActiveSts.EngineIdleIn._.ZFFSAB /end MEASUREMENT
/begin MEASUREMENT ZFFSAB._.EngineIdleIn.sv_EngIdleActive "Output Signal Engine Idle Active: 0=Engine Idle active 1=Engine Idle not active" UBYTE SAB_STANDARD_S2_S3 1 100 0 1 ECU_ADDRESS 0xFFF96CF5 DISPLAY_IDENTIFIER sv_EngIdleActive.EngineIdleIn._.ZFFSAB /end MEASUREMENT
/begin MEASUREMENT ZFFSAB._.EngineIdleIn.sv_EngIdleActiveSts "Output signal status for sv_EngIdleActive: 0=no error 1=dynamic substitute signal 2=static substitute signal" UBYTE SAB_STANDARD_S2_S3 1 100 0 2 ECU_ADDRESS 0xFFF96CF6 DISPLAY_IDENTIFIER sv_EngIdleActiveSts.EngineIdleIn._.ZFFSAB /end MEASUREMENT
/begin MEASUREMENT ZFFSAB._.EngineIdleSpeedReqIn.f_n_EngIdleErr "Error flag signal engine idle speed" UBYTE SAB_STANDARD_S2_S3 1 100 0 255 ECU_ADDRESS 0xFFF95AD3 DISPLAY_IDENTIFIER f_n_EngIdleErr.EngineIdleSpeedReqIn._.ZFFSAB /end MEASUREMENT
/begin MEASUREMENT ZFFSAB._.EngineIdleSpeedReqIn.iv_n_EngIdle "Input value for engine idle speed" UBYTE SAB_N_5RPM_S2_S3 1 100 0 1270 ECU_ADDRESS 0xFFF95ACC DISPLAY_IDENTIFIER iv_n_EngIdle.EngineIdleSpeedReqIn._.ZFFSAB /end MEASUREMENT
/begin MEASUREMENT ZFFSAB._.EngineIdleSpeedReqIn.iv_n_EngIdleExt "Input value for engine idle speed (EXT)" UBYTE SAB_N_10RPM_S2_S3 1 100 0 2540 ECU_ADDRESS 0xFFF95ACE DISPLAY_IDENTIFIER iv_n_EngIdleExt.EngineIdleSpeedReqIn._.ZFFSAB /end MEASUREMENT
/begin MEASUREMENT ZFFSAB._.EngineIdleSpeedReqIn.iv_n_EngIdleExtSts "Input value for CAN message status" UBYTE SAB_STANDARD_S2_S3 1 100 0 255 ECU_ADDRESS 0xFFF95ACF DISPLAY_IDENTIFIER iv_n_EngIdleExtSts.EngineIdleSpeedReqIn._.ZFFSAB /end MEASUREMENT
/begin MEASUREMENT ZFFSAB._.EngineIdleSpeedReqIn.iv_n_EngIdleSts "Input value for CAN message status of engine idle speed" UBYTE SAB_STANDARD_S2_S3 1 100 0 255 ECU_ADDRESS 0xFFF95ACD DISPLAY_IDENTIFIER iv_n_EngIdleSts.EngineIdleSpeedReqIn._.ZFFSAB /end MEASUREMENT
/begin MEASUREMENT ZFFSAB._.EngineIdleSpeedReqIn.sv_n_EngIdle "Output value for engine idle speed" UWORD SAB_N_1RPM_S2_S3 1 100 0 2540 ECU_ADDRESS 0xFFF95AD0 DISPLAY_IDENTIFIER sv_n_EngIdle.EngineIdleSpeedReqIn._.ZFFSAB /end MEASUREMENT
/begin MEASUREMENT ZFFSAB._.EngineIdleSpeedReqIn.sv_n_EngIdleSts "Output value status of signal engine idle speed" UBYTE SAB_STANDARD_S2_S3 1 100 0 2 ECU_ADDRESS 0xFFF95AD2 DISPLAY_IDENTIFIER sv_n_EngIdleSts.EngineIdleSpeedReqIn._.ZFFSAB /end MEASUREMENT
/begin MEASUREMENT ZFFSAB._.EngineInterventionLimitIn.f_m_EngInterventionLimitErr "Error flag of m_EngInterventionLimit-signal" UBYTE SAB_STANDARD_S2_S3 1 100 0 1 ECU_ADDRESS 0xFFF95D33 DISPLAY_IDENTIFIER f_m_EngInterventionLimitErr.EngineInterventionLimitIn._.ZFFSAB /end MEASUREMENT
/begin MEASUREMENT ZFFSAB._.EngineInterventionLimitIn.iv_m_EngInterventionLimit "Input raw signal of max. allowed engine torque" UWORD SAB_M_NM2_M2047_S2_S3 1 100 -1023.5 1024 ECU_ADDRESS 0xFFF95D2C DISPLAY_IDENTIFIER iv_m_EngInterventionLimit.EngineInterventionLimitIn._.ZFFSAB /end MEASUREMENT
/begin MEASUREMENT ZFFSAB._.EngineInterventionLimitIn.iv_m_EngInterventionLimitSts "Input raw signal of max. allowed engine torque status" UBYTE SAB_STANDARD_S2_S3 1 100 0 255 ECU_ADDRESS 0xFFF95D2E DISPLAY_IDENTIFIER iv_m_EngInterventionLimitSts.EngineInterventionLimitIn._.ZFFSAB /end MEASUREMENT
/begin MEASUREMENT ZFFSAB._.EngineInterventionLimitIn.m_EngInterventionLimitSts "Intermediate signal status of max. allowed engine torque" UBYTE SAB_STANDARD_S2_S3 1 100 0 1 ECU_ADDRESS 0xFFF95D32 DISPLAY_IDENTIFIER m_EngInterventionLimitSts.EngineInterventionLimitIn._.ZFFSAB /end MEASUREMENT
/begin MEASUREMENT ZFFSAB._.EngineInterventionLimitIn.sv_m_EngInterventionLimit "Output signal of max. allowed engine torque" SWORD SAB_M_1NM_S2_S3 1 100 -32768 32767 ECU_ADDRESS 0xFFF95D30 DISPLAY_IDENTIFIER sv_m_EngInterventionLimit.EngineInterventionLimitIn._.ZFFSAB /end MEASUREMENT
/begin MEASUREMENT ZFFSAB._.EngineSignalDiagnosis.iv_Status_K0 "actual state of clutch K0" UBYTE SAB_STANDARD_S2_S3 1 100 0 5 ECU_ADDRESS 0xFFF95F08 DISPLAY_IDENTIFIER iv_Status_K0.EngineSignalDiagnosis._.ZFFSAB /end MEASUREMENT
/begin MEASUREMENT ZFFSAB._.EngineSpeedIn.f_n_EngErr "Error flag of n_Eng-signal" UBYTE SAB_STANDARD_S2_S3 1 100 0 1 ECU_ADDRESS 0xFFF8DAFA DISPLAY_IDENTIFIER f_n_EngErr.EngineSpeedIn._.ZFFSAB /end MEASUREMENT
/begin MEASUREMENT ZFFSAB._.EngineSpeedIn.f_n_EngLev2Err "Error flag of level 2 n_Eng signal" UBYTE SAB_STANDARD_S2_S3 1 100 0 1 ECU_ADDRESS 0xFFF8DAFB DISPLAY_IDENTIFIER f_n_EngLev2Err.EngineSpeedIn._.ZFFSAB /end MEASUREMENT
/begin MEASUREMENT ZFFSAB._.EngineSpeedIn.f_n_EngLev2Err_ "complement of corresponding signal" UBYTE SAB_STANDARD_S2_S3 1 100 0 1 ECU_ADDRESS 0xFFF8DAFC DISPLAY_IDENTIFIER f_n_EngLev2Err_.EngineSpeedIn._.ZFFSAB /end MEASUREMENT
/begin MEASUREMENT ZFFSAB._.EngineSpeedIn.f_n_EngVMErr "Error flag of n_Eng-signal" UBYTE SAB_STANDARD_S2_S3 1 100 0 1 ECU_ADDRESS 0xFFF8DAFF DISPLAY_IDENTIFIER f_n_EngVMErr.EngineSpeedIn._.ZFFSAB /end MEASUREMENT
/begin MEASUREMENT ZFFSAB._.EngineSpeedIn.f_n_EngVMLev2Err "Error flag of level 2 n_EngVM signal" UBYTE SAB_STANDARD_S2_S3 1 100 0 1 ECU_ADDRESS 0xFFF8DAFD DISPLAY_IDENTIFIER f_n_EngVMLev2Err.EngineSpeedIn._.ZFFSAB /end MEASUREMENT
/begin MEASUREMENT ZFFSAB._.EngineSpeedIn.f_n_EngVMLev2Err_ "complement of corresponding signal" UBYTE SAB_STANDARD_S2_S3 1 100 0 1 ECU_ADDRESS 0xFFF8DAFE DISPLAY_IDENTIFIER f_n_EngVMLev2Err_.EngineSpeedIn._.ZFFSAB /end MEASUREMENT
/begin MEASUREMENT ZFFSAB._.EngineSpeedIn.iv_ActualGear "Istgang" SBYTE SAB_STANDARD_S2_S3 1 100 -1 8 ECU_ADDRESS 0xFFF8DADA DISPLAY_IDENTIFIER iv_ActualGear.EngineSpeedIn._.ZFFSAB /end MEASUREMENT
/begin MEASUREMENT ZFFSAB._.EngineSpeedIn.iv_StatusK0 "Statuf of K0" UBYTE SAB_STANDARD_S2_S3 1 100 0 255 ECU_ADDRESS 0xFFF8DAD7 DISPLAY_IDENTIFIER iv_StatusK0.EngineSpeedIn._.ZFFSAB /end MEASUREMENT
/begin MEASUREMENT ZFFSAB._.EngineSpeedIn.iv_TargetGear "Zielgang" SBYTE SAB_STANDARD_S2_S3 1 100 -1 8 ECU_ADDRESS 0xFFF8DADB DISPLAY_IDENTIFIER iv_TargetGear.EngineSpeedIn._.ZFFSAB /end MEASUREMENT
/begin MEASUREMENT ZFFSAB._.EngineSpeedIn.iv_in_Gear "Input value for gearRatio of actual gear" UWORD SAB_K1000_S2_S3 1 100 0 65.535 ECU_ADDRESS 0xFFF8DB00 DISPLAY_IDENTIFIER iv_in_Gear.EngineSpeedIn._.ZFFSAB /end MEASUREMENT
/begin MEASUREMENT ZFFSAB._.EngineSpeedIn.iv_kraftschluss "signalizes if gearbox is kraftschluessig" UBYTE SAB_STANDARD_S2_S3 1 100 0 6 ECU_ADDRESS 0xFFF8DAD8 DISPLAY_IDENTIFIER iv_kraftschluss.EngineSpeedIn._.ZFFSAB /end MEASUREMENT
/begin MEASUREMENT ZFFSAB._.EngineSpeedIn.iv_n_Eng "Input value of electrical engine rpm from CAN" UWORD SAB_N_RPM2_M5000_S2_S3 1 100 -5000 27767.5 ECU_ADDRESS 0xFFF8DADC DISPLAY_IDENTIFIER iv_n_Eng.EngineSpeedIn._.ZFFSAB /end MEASUREMENT
/begin MEASUREMENT ZFFSAB._.EngineSpeedIn.iv_n_EngErr "Input error value of electrical engine rpm from CAN" UBYTE SAB_STANDARD_S2_S3 1 100 0 255 ECU_ADDRESS 0xFFF8DAE0 DISPLAY_IDENTIFIER iv_n_EngErr.EngineSpeedIn._.ZFFSAB /end MEASUREMENT
/begin MEASUREMENT ZFFSAB._.EngineSpeedIn.iv_n_EngErr_ "Complement of input error value of electrical engine rpm from CAN" UBYTE SAB_STANDARD_S2_S3 1 100 0 255 ECU_ADDRESS 0xFFF8DAE1 DISPLAY_IDENTIFIER iv_n_EngErr_.EngineSpeedIn._.ZFFSAB /end MEASUREMENT
/begin MEASUREMENT ZFFSAB._.EngineSpeedIn.iv_n_EngSts "Input value of message status of electrical engine rpm" UBYTE SAB_STANDARD_S2_S3 1 100 0 255 ECU_ADDRESS 0xFFF8DAE2 DISPLAY_IDENTIFIER iv_n_EngSts.EngineSpeedIn._.ZFFSAB /end MEASUREMENT
/begin MEASUREMENT ZFFSAB._.EngineSpeedIn.iv_n_EngSts_ "Complement of message status of electrical engine rpm" UBYTE SAB_STANDARD_S2_S3 1 100 0 255 ECU_ADDRESS 0xFFF8DAE3 DISPLAY_IDENTIFIER iv_n_EngSts_.EngineSpeedIn._.ZFFSAB /end MEASUREMENT
/begin MEASUREMENT ZFFSAB._.EngineSpeedIn.iv_n_EngVM "Input value combustion engine rpm from CAN" UWORD SAB_N_RPM4_S2_S3 1 100 0 16383.75 ECU_ADDRESS 0xFFF8DAD0 DISPLAY_IDENTIFIER iv_n_EngVM.EngineSpeedIn._.ZFFSAB /end MEASUREMENT
/begin MEASUREMENT ZFFSAB._.EngineSpeedIn.iv_n_EngVMErr "Input error value of combustion engine rpm from CAN" UBYTE SAB_STANDARD_S2_S3 1 100 0 255 ECU_ADDRESS 0xFFF8DAD4 DISPLAY_IDENTIFIER iv_n_EngVMErr.EngineSpeedIn._.ZFFSAB /end MEASUREMENT
/begin MEASUREMENT ZFFSAB._.EngineSpeedIn.iv_n_EngVMSts "Input value of message status of combustion engine rpm" UBYTE SAB_STANDARD_S2_S3 1 100 0 255 ECU_ADDRESS 0xFFF8DAD5 DISPLAY_IDENTIFIER iv_n_EngVMSts.EngineSpeedIn._.ZFFSAB /end MEASUREMENT
/begin MEASUREMENT ZFFSAB._.EngineSpeedIn.iv_n_EngVMSts_ "Complement of message status of combustion engine rpm" UBYTE SAB_STANDARD_S2_S3 1 100 0 255 ECU_ADDRESS 0xFFF8DAD6 DISPLAY_IDENTIFIER iv_n_EngVMSts_.EngineSpeedIn._.ZFFSAB /end MEASUREMENT
/begin MEASUREMENT ZFFSAB._.EngineSpeedIn.iv_n_EngVM_ "Input value combustion engine rpm from CAN complement" UWORD SAB_STANDARD_S2_S3 1 100 0 65535 ECU_ADDRESS 0xFFF8DAD2 DISPLAY_IDENTIFIER iv_n_EngVM_.EngineSpeedIn._.ZFFSAB /end MEASUREMENT
/begin MEASUREMENT ZFFSAB._.EngineSpeedIn.iv_n_Eng_ "Complement of input value of electrical engine rpm from CAN" UWORD SAB_STANDARD_S2_S3 1 100 0 65535 ECU_ADDRESS 0xFFF8DADE DISPLAY_IDENTIFIER iv_n_Eng_.EngineSpeedIn._.ZFFSAB /end MEASUREMENT
/begin MEASUREMENT ZFFSAB._.EngineSpeedIn.iv_st_IAE "IAE Kupplungsstatus" UBYTE SAB_STANDARD_S2_S3 1 100 0 8 ECU_ADDRESS 0xFFF8DAD9 DISPLAY_IDENTIFIER iv_st_IAE.EngineSpeedIn._.ZFFSAB /end MEASUREMENT
/begin MEASUREMENT ZFFSAB._.EngineSpeedIn.sv_AGS_NEm "speed electrical machine" UWORD SAB_N_RPM2_M5000_S2_S3 1 100 -5000 27767 ECU_ADDRESS 0xFFF8DAE8 DISPLAY_IDENTIFIER sv_AGS_NEm.EngineSpeedIn._.ZFFSAB /end MEASUREMENT
/begin MEASUREMENT ZFFSAB._.EngineSpeedIn.sv_n_Eng "Output value engine rpm" UWORD SAB_N_1RPM_S2_S3 1 100 0 65535 ECU_ADDRESS 0xFFF8DAE4 DISPLAY_IDENTIFIER sv_n_Eng.EngineSpeedIn._.ZFFSAB /end MEASUREMENT
/begin MEASUREMENT ZFFSAB._.EngineSpeedIn.sv_n_EngLev2 "Level 2 output value engine rpm" UWORD SAB_N_1RPM_S2_S3 1 100 0 65535 ECU_ADDRESS 0xFFF8DAEE DISPLAY_IDENTIFIER sv_n_EngLev2.EngineSpeedIn._.ZFFSAB /end MEASUREMENT
/begin MEASUREMENT ZFFSAB._.EngineSpeedIn.sv_n_EngLev2Sts "Level 2 output value signal status of engine rpm" UBYTE SAB_STANDARD_S2_S3 1 100 0 2 ECU_ADDRESS 0xFFF8DAF2 DISPLAY_IDENTIFIER sv_n_EngLev2Sts.EngineSpeedIn._.ZFFSAB /end MEASUREMENT
/begin MEASUREMENT ZFFSAB._.EngineSpeedIn.sv_n_EngLev2Sts_ "Level 2 output value signal status complement of engine rpm" UBYTE SAB_STANDARD_S2_S3 1 100 0 255 ECU_ADDRESS 0xFFF8DAF3 DISPLAY_IDENTIFIER sv_n_EngLev2Sts_.EngineSpeedIn._.ZFFSAB /end MEASUREMENT
/begin MEASUREMENT ZFFSAB._.EngineSpeedIn.sv_n_EngLev2_ "Level 2 output value engine rpm complement" UWORD SAB_STANDARD_S2_S3 1 100 0 65535 ECU_ADDRESS 0xFFF8DAF0 DISPLAY_IDENTIFIER sv_n_EngLev2_.EngineSpeedIn._.ZFFSAB /end MEASUREMENT
/begin MEASUREMENT ZFFSAB._.EngineSpeedIn.sv_n_EngSts "Staus of output value of engine rpm" UBYTE SAB_STANDARD_S2_S3 1 100 0 2 ECU_ADDRESS 0xFFF8DAE6 DISPLAY_IDENTIFIER sv_n_EngSts.EngineSpeedIn._.ZFFSAB /end MEASUREMENT
/begin MEASUREMENT ZFFSAB._.EngineSpeedIn.sv_n_EngVM "Output value engine rpm" UWORD SAB_N_1RPM_S2_S3 1 100 0 65535 ECU_ADDRESS 0xFFF8DAEA DISPLAY_IDENTIFIER sv_n_EngVM.EngineSpeedIn._.ZFFSAB /end MEASUREMENT
/begin MEASUREMENT ZFFSAB._.EngineSpeedIn.sv_n_EngVMLev2 "Level 2 output value engine rpm" UWORD SAB_N_1RPM_S2_S3 1 100 0 65535 ECU_ADDRESS 0xFFF8DAF4 DISPLAY_IDENTIFIER sv_n_EngVMLev2.EngineSpeedIn._.ZFFSAB /end MEASUREMENT
/begin MEASUREMENT ZFFSAB._.EngineSpeedIn.sv_n_EngVMLev2Sts "Level 2 output value signal status of engine rpm" UBYTE SAB_STANDARD_S2_S3 1 100 0 2 ECU_ADDRESS 0xFFF8DAF8 DISPLAY_IDENTIFIER sv_n_EngVMLev2Sts.EngineSpeedIn._.ZFFSAB /end MEASUREMENT
/begin MEASUREMENT ZFFSAB._.EngineSpeedIn.sv_n_EngVMLev2Sts_ "Level 2 output value signal status complement of engine rpm" UBYTE SAB_STANDARD_S2_S3 1 100 0 255 ECU_ADDRESS 0xFFF8DAF9 DISPLAY_IDENTIFIER sv_n_EngVMLev2Sts_.EngineSpeedIn._.ZFFSAB /end MEASUREMENT
/begin MEASUREMENT ZFFSAB._.EngineSpeedIn.sv_n_EngVMLev2_ "Level 2 output value engine rpm complement" UWORD SAB_STANDARD_S2_S3 1 100 0 65535 ECU_ADDRESS 0xFFF8DAF6 DISPLAY_IDENTIFIER sv_n_EngVMLev2_.EngineSpeedIn._.ZFFSAB /end MEASUREMENT
/begin MEASUREMENT ZFFSAB._.EngineSpeedIn.sv_n_EngVMSts "Output value of signal status of engine rpm" UBYTE SAB_STANDARD_S2_S3 1 100 0 2 ECU_ADDRESS 0xFFF8DAEC DISPLAY_IDENTIFIER sv_n_EngVMSts.EngineSpeedIn._.ZFFSAB /end MEASUREMENT
/end MODULE
/end PROJECT
