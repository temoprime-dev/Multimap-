ASAP2_VERSION 1 51
/begin PROJECT ZHBC8600 "Gen2_BMW_System_Supplier_Lib"
/begin MODULE CPP ""
/begin MOD_COMMON "" BYTE_ORDER MSB_FIRST ALIGNMENT_BYTE 1 ALIGNMENT_WORD 2 ALIGNMENT_LONG 4 ALIGNMENT_FLOAT32_IEEE 4 ALIGNMENT_FLOAT64_IEEE 1 /end MOD_COMMON
/begin COMPU_METHOD SAB2_L_1MM_S3_S3 "int = ((phys * 1) / 1) - (0) mm" RAT_FUNC "%1.0" "mm" COEFFS 0 1 0 0 0 1 /end COMPU_METHOD
/begin COMPU_METHOD SAB2_L_KM100_S3_S3 "int = ((phys * 100) / 1) - (0) km" RAT_FUNC "%4.3" "km" COEFFS 0 100 0 0 0 1 /end COMPU_METHOD
/begin COMPU_METHOD SAB2_L_M6554_S3_S3 "int = ((phys * 6554) / 1) - (0) m" RAT_FUNC "%21.20" "m" COEFFS 0 6554 0 0 0 1 /end COMPU_METHOD
/begin COMPU_METHOD SAB2_M_10NM_S3_S3 "int = ((phys * 1) / 10) - (0) Nm" RAT_FUNC "%4.3" "Nm" COEFFS 0 0.1 0 0 0 1 /end COMPU_METHOD
/begin COMPU_METHOD SAB2_M_15NM_S3_S3 "int = ((phys * 1) / 15) - (0) Nm" RAT_FUNC "%4.3" "Nm" COEFFS 0 0.0666666666667 0 0 0 1 /end COMPU_METHOD
/begin COMPU_METHOD SAB2_M_1NM_KOMP_S3_S3 "int = ((phys * 1) / 1) - (0) Nm" RAT_FUNC "%1.0" "Nm" COEFFS 0 1 0 0 0 1 /end COMPU_METHOD
/begin FUNCTION zf_SAB_EEpromZentralHandler "desc_en"
 /begin IN_MEASUREMENT ZFFSAB._.EEpromZentralHandler.allEepromSummeryChannels.eepromSummaryChannel[0].cnt_GetEEpromUpdate ZFFSAB._.EEpromZentralHandler.allEepromSummeryChannels.eepromSummaryChannel[0].cnt_GetEEpromValid ZFFSAB._.EEpromZentralHandler.allEepromSummeryChannels.eepromSummaryChannel[0].cnt_GetSizeofEEpromData ZFFSAB._.EEpromZentralHandler.allEepromSummeryChannels.eepromSummaryChannel[0].cnt_SetEEpromInitZyklisch ZFFSAB._.EEpromZentralHandler.allEepromSummeryChannels.eepromSummaryChannel[0].eeprom_info ZFFSAB._.EEpromZentralHandler.allEepromSummeryChannels.eepromSummaryChannel[0].ret_GetEEpromUpdate ZFFSAB._.EEpromZentralHandler.allEepromSummeryChannels.eepromSummaryChannel[0].ret_GetEEpromValid ZFFSAB._.EEpromZentralHandler.allEepromSummeryChannels.eepromSummaryChannel[0].ret_GetSizeofEEpromData ZFFSAB._.EEpromZentralHandler.allEepromSummeryChannels.eepromSummaryChannel[0].ret_SetEEpromInitZyklisch ZFFSAB._.EEpromZentralHandler.allEepromSummeryChannels.eepromSummaryChannel[1].cnt_GetEEpromUpdate ZFFSAB._.EEpromZentralHandler.allEepromSummeryChannels.eepromSummaryChannel[1].cnt_GetEEpromValid ZFFSAB._.EEpromZentralHandler.allEepromSummeryChannels.eepromSummaryChannel[1].cnt_GetSizeofEEpromData ZFFSAB._.EEpromZentralHandler.allEepromSummeryChannels.eepromSummaryChannel[1].cnt_SetEEpromInitZyklisch ZFFSAB._.EEpromZentralHandler.allEepromSummeryChannels.eepromSummaryChannel[1].eeprom_info ZFFSAB._.EEpromZentralHandler.allEepromSummeryChannels.eepromSummaryChannel[1].ret_GetEEpromUpdate ZFFSAB._.EEpromZentralHandler.allEepromSummeryChannels.eepromSummaryChannel[1].ret_GetEEpromValid ZFFSAB._.EEpromZentralHandler.allEepromSummeryChannels.eepromSummaryChannel[1].ret_GetSizeofEEpromData ZFFSAB._.EEpromZentralHandler.allEepromSummeryChannels.eepromSummaryChannel[1].ret_SetEEpromInitZyklisch ZFFSAB._.EEpromZentralHandler.allEepromSummeryChannels.eepromSummaryChannel[2].cnt_GetEEpromUpdate ZFFSAB._.EEpromZentralHandler.allEepromSummeryChannels.eepromSummaryChannel[2].cnt_GetEEpromValid ZFFSAB._.EEpromZentralHandler.allEepromSummeryChannels.eepromSummaryChannel[2].cnt_GetSizeofEEpromData ZFFSAB._.EEpromZentralHandler.allEepromSummeryChannels.eepromSummaryChannel[2].cnt_SetEEpromInitZyklisch ZFFSAB._.EEpromZentralHandler.allEepromSummeryChannels.eepromSummaryChannel[2].eeprom_info ZFFSAB._.EEpromZentralHandler.allEepromSummeryChannels.eepromSummaryChannel[2].ret_GetEEpromUpdate ZFFSAB._.EEpromZentralHandler.allEepromSummeryChannels.eepromSummaryChannel[2].ret_GetEEpromValid ZFFSAB._.EEpromZentralHandler.allEepromSummeryChannels.eepromSummaryChannel[2].ret_GetSizeofEEpromData ZFFSAB._.EEpromZentralHandler.allEepromSummeryChannels.eepromSummaryChannel[2].ret_SetEEpromInitZyklisch ZFFSAB._.EEpromZentralHandler.allEepromSummeryChannels.eepromSummaryChannel[3].cnt_GetEEpromUpdate ZFFSAB._.EEpromZentralHandler.allEepromSummeryChannels.eepromSummaryChannel[3].cnt_GetEEpromValid ZFFSAB._.EEpromZentralHandler.allEepromSummeryChannels.eepromSummaryChannel[3].cnt_GetSizeofEEpromData ZFFSAB._.EEpromZentralHandler.allEepromSummeryChannels.eepromSummaryChannel[3].cnt_SetEEpromInitZyklisch ZFFSAB._.EEpromZentralHandler.allEepromSummeryChannels.eepromSummaryChannel[3].eeprom_info ZFFSAB._.EEpromZentralHandler.allEepromSummeryChannels.eepromSummaryChannel[3].ret_GetEEpromUpdate ZFFSAB._.EEpromZentralHandler.allEepromSummeryChannels.eepromSummaryChannel[3].ret_GetEEpromValid ZFFSAB._.EEpromZentralHandler.allEepromSummeryChannels.eepromSummaryChannel[3].ret_GetSizeofEEpromData ZFFSAB._.EEpromZentralHandler.allEepromSummeryChannels.eepromSummaryChannel[3].ret_SetEEpromInitZyklisch ZFFSAB._.EEpromZentralHandler.allEepromSummeryChannels.eepromSummaryChannel[4].cnt_GetEEpromUpdate ZFFSAB._.EEpromZentralHandler.allEepromSummeryChannels.eepromSummaryChannel[4].cnt_GetEEpromValid ZFFSAB._.EEpromZentralHandler.allEepromSummeryChannels.eepromSummaryChannel[4].cnt_GetSizeofEEpromData ZFFSAB._.EEpromZentralHandler.allEepromSummeryChannels.eepromSummaryChannel[4].cnt_SetEEpromInitZyklisch ZFFSAB._.EEpromZentralHandler.allEepromSummeryChannels.eepromSummaryChannel[4].eeprom_info ZFFSAB._.EEpromZentralHandler.allEepromSummeryChannels.eepromSummaryChannel[4].ret_GetEEpromUpdate ZFFSAB._.EEpromZentralHandler.allEepromSummeryChannels.eepromSummaryChannel[4].ret_GetEEpromValid ZFFSAB._.EEpromZentralHandler.allEepromSummeryChannels.eepromSummaryChannel[4].ret_GetSizeofEEpromData ZFFSAB._.EEpromZentralHandler.allEepromSummeryChannels.eepromSummaryChannel[4].ret_SetEEpromInitZyklisch ZFFSAB._.EEpromZentralHandler.eepromChannel[0].ZFFSAB._.cEEpromChannel._.cnt_GetEEpromUpdate ZFFSAB._.EEpromZentralHandler.eepromChannel[0].ZFFSAB._.cEEpromChannel._.cnt_GetEEpromValid ZFFSAB._.EEpromZentralHandler.eepromChannel[0].ZFFSAB._.cEEpromChannel._.cnt_GetSizeofEEpromData ZFFSAB._.EEpromZentralHandler.eepromChannel[0].ZFFSAB._.cEEpromChannel._.cnt_SetEEpromInitZyklisch ZFFSAB._.EEpromZentralHandler.eepromChannel[0].ZFFSAB._.cEEpromChannel._.eeprom_info ZFFSAB._.EEpromZentralHandler.eepromChannel[0].ZFFSAB._.cEEpromChannel._.ret_GetEEpromUpdate ZFFSAB._.EEpromZentralHandler.eepromChannel[0].ZFFSAB._.cEEpromChannel._.ret_GetEEpromValid ZFFSAB._.EEpromZentralHandler.eepromChannel[0].ZFFSAB._.cEEpromChannel._.ret_GetSizeofEEpromData ZFFSAB._.EEpromZentralHandler.eepromChannel[0].ZFFSAB._.cEEpromChannel._.ret_SetEEpromInitZyklisch ZFFSAB._.EEpromZentralHandler.eepromChannel[0].cnt_CallEEpromLoadData ZFFSAB._.EEpromZentralHandler.eepromChannel[0].cnt_CallEEpromLoadDataState ZFFSAB._.EEpromZentralHandler.eepromChannel[0].cnt_CallEEpromStoreImmediate ZFFSAB._.EEpromZentralHandler.eepromChannel[0].cnt_SetEEpromWriteProtect ZFFSAB._.EEpromZentralHandler.eepromChannel[0].mode ZFFSAB._.EEpromZentralHandler.eepromChannel[0].ret_CallEEpromLoadData ZFFSAB._.EEpromZentralHandler.eepromChannel[0].ret_CallEEpromLoadDataState ZFFSAB._.EEpromZentralHandler.eepromChannel[0].ret_CallEEpromStoreImmediate ZFFSAB._.EEpromZentralHandler.eepromChannel[10].ZFFSAB._.cEEpromChannel._.cnt_GetEEpromUpdate ZFFSAB._.EEpromZentralHandler.eepromChannel[10].ZFFSAB._.cEEpromChannel._.cnt_GetEEpromValid ZFFSAB._.EEpromZentralHandler.eepromChannel[10].ZFFSAB._.cEEpromChannel._.cnt_GetSizeofEEpromData ZFFSAB._.EEpromZentralHandler.eepromChannel[10].ZFFSAB._.cEEpromChannel._.cnt_SetEEpromInitZyklisch ZFFSAB._.EEpromZentralHandler.eepromChannel[10].ZFFSAB._.cEEpromChannel._.eeprom_info ZFFSAB._.EEpromZentralHandler.eepromChannel[10].ZFFSAB._.cEEpromChannel._.ret_GetEEpromUpdate ZFFSAB._.EEpromZentralHandler.eepromChannel[10].ZFFSAB._.cEEpromChannel._.ret_GetEEpromValid ZFFSAB._.EEpromZentralHandler.eepromChannel[10].ZFFSAB._.cEEpromChannel._.ret_GetSizeofEEpromData ZFFSAB._.EEpromZentralHandler.eepromChannel[10].ZFFSAB._.cEEpromChannel._.ret_SetEEpromInitZyklisch ZFFSAB._.EEpromZentralHandler.eepromChannel[10].cnt_CallEEpromLoadData ZFFSAB._.EEpromZentralHandler.eepromChannel[10].cnt_CallEEpromLoadDataState ZFFSAB._.EEpromZentralHandler.eepromChannel[10].cnt_CallEEpromStoreImmediate ZFFSAB._.EEpromZentralHandler.eepromChannel[10].cnt_SetEEpromWriteProtect ZFFSAB._.EEpromZentralHandler.eepromChannel[10].mode ZFFSAB._.EEpromZentralHandler.eepromChannel[10].ret_CallEEpromLoadData ZFFSAB._.EEpromZentralHandler.eepromChannel[10].ret_CallEEpromLoadDataState ZFFSAB._.EEpromZentralHandler.eepromChannel[10].ret_CallEEpromStoreImmediate ZFFSAB._.EEpromZentralHandler.eepromChannel[11].ZFFSAB._.cEEpromChannel._.cnt_GetEEpromUpdate ZFFSAB._.EEpromZentralHandler.eepromChannel[11].ZFFSAB._.cEEpromChannel._.cnt_GetEEpromValid ZFFSAB._.EEpromZentralHandler.eepromChannel[11].ZFFSAB._.cEEpromChannel._.cnt_GetSizeofEEpromData ZFFSAB._.EEpromZentralHandler.eepromChannel[11].ZFFSAB._.cEEpromChannel._.cnt_SetEEpromInitZyklisch ZFFSAB._.EEpromZentralHandler.eepromChannel[11].ZFFSAB._.cEEpromChannel._.eeprom_info ZFFSAB._.EEpromZentralHandler.eepromChannel[11].ZFFSAB._.cEEpromChannel._.ret_GetEEpromUpdate ZFFSAB._.EEpromZentralHandler.eepromChannel[11].ZFFSAB._.cEEpromChannel._.ret_GetEEpromValid ZFFSAB._.EEpromZentralHandler.eepromChannel[11].ZFFSAB._.cEEpromChannel._.ret_GetSizeofEEpromData ZFFSAB._.EEpromZentralHandler.eepromChannel[11].ZFFSAB._.cEEpromChannel._.ret_SetEEpromInitZyklisch ZFFSAB._.EEpromZentralHandler.eepromChannel[11].cnt_CallEEpromLoadData ZFFSAB._.EEpromZentralHandler.eepromChannel[11].cnt_CallEEpromLoadDataState ZFFSAB._.EEpromZentralHandler.eepromChannel[11].cnt_CallEEpromStoreImmediate ZFFSAB._.EEpromZentralHandler.eepromChannel[11].cnt_SetEEpromWriteProtect ZFFSAB._.EEpromZentralHandler.eepromChannel[11].mode ZFFSAB._.EEpromZentralHandler.eepromChannel[11].ret_CallEEpromLoadData ZFFSAB._.EEpromZentralHandler.eepromChannel[11].ret_CallEEpromLoadDataState ZFFSAB._.EEpromZentralHandler.eepromChannel[11].ret_CallEEpromStoreImmediate ZFFSAB._.EEpromZentralHandler.eepromChannel[12].ZFFSAB._.cEEpromChannel._.cnt_GetEEpromUpdate ZFFSAB._.EEpromZentralHandler.eepromChannel[12].ZFFSAB._.cEEpromChannel._.cnt_GetEEpromValid ZFFSAB._.EEpromZentralHandler.eepromChannel[12].ZFFSAB._.cEEpromChannel._.cnt_GetSizeofEEpromData ZFFSAB._.EEpromZentralHandler.eepromChannel[12].ZFFSAB._.cEEpromChannel._.cnt_SetEEpromInitZyklisch ZFFSAB._.EEpromZentralHandler.eepromChannel[12].ZFFSAB._.cEEpromChannel._.eeprom_info ZFFSAB._.EEpromZentralHandler.eepromChannel[12].ZFFSAB._.cEEpromChannel._.ret_GetEEpromUpdate ZFFSAB._.EEpromZentralHandler.eepromChannel[12].ZFFSAB._.cEEpromChannel._.ret_GetEEpromValid ZFFSAB._.EEpromZentralHandler.eepromChannel[12].ZFFSAB._.cEEpromChannel._.ret_GetSizeofEEpromData ZFFSAB._.EEpromZentralHandler.eepromChannel[12].ZFFSAB._.cEEpromChannel._.ret_SetEEpromInitZyklisch ZFFSAB._.EEpromZentralHandler.eepromChannel[12].cnt_CallEEpromLoadData ZFFSAB._.EEpromZentralHandler.eepromChannel[12].cnt_CallEEpromLoadDataState ZFFSAB._.EEpromZentralHandler.eepromChannel[12].cnt_CallEEpromStoreImmediate ZFFSAB._.EEpromZentralHandler.eepromChannel[12].cnt_SetEEpromWriteProtect ZFFSAB._.EEpromZentralHandler.eepromChannel[12].mode ZFFSAB._.EEpromZentralHandler.eepromChannel[12].ret_CallEEpromLoadData ZFFSAB._.EEpromZentralHandler.eepromChannel[12].ret_CallEEpromLoadDataState ZFFSAB._.EEpromZentralHandler.eepromChannel[12].ret_CallEEpromStoreImmediate ZFFSAB._.EEpromZentralHandler.eepromChannel[13].ZFFSAB._.cEEpromChannel._.cnt_GetEEpromUpdate ZFFSAB._.EEpromZentralHandler.eepromChannel[13].ZFFSAB._.cEEpromChannel._.cnt_GetEEpromValid ZFFSAB._.EEpromZentralHandler.eepromChannel[13].ZFFSAB._.cEEpromChannel._.cnt_GetSizeofEEpromData ZFFSAB._.EEpromZentralHandler.eepromChannel[13].ZFFSAB._.cEEpromChannel._.cnt_SetEEpromInitZyklisch ZFFSAB._.EEpromZentralHandler.eepromChannel[13].ZFFSAB._.cEEpromChannel._.eeprom_info ZFFSAB._.EEpromZentralHandler.eepromChannel[13].ZFFSAB._.cEEpromChannel._.ret_GetEEpromUpdate ZFFSAB._.EEpromZentralHandler.eepromChannel[13].ZFFSAB._.cEEpromChannel._.ret_GetEEpromValid ZFFSAB._.EEpromZentralHandler.eepromChannel[13].ZFFSAB._.cEEpromChannel._.ret_GetSizeofEEpromData ZFFSAB._.EEpromZentralHandler.eepromChannel[13].ZFFSAB._.cEEpromChannel._.ret_SetEEpromInitZyklisch ZFFSAB._.EEpromZentralHandler.eepromChannel[13].cnt_CallEEpromLoadData ZFFSAB._.EEpromZentralHandler.eepromChannel[13].cnt_CallEEpromLoadDataState ZFFSAB._.EEpromZentralHandler.eepromChannel[13].cnt_CallEEpromStoreImmediate ZFFSAB._.EEpromZentralHandler.eepromChannel[13].cnt_SetEEpromWriteProtect ZFFSAB._.EEpromZentralHandler.eepromChannel[13].mode ZFFSAB._.EEpromZentralHandler.eepromChannel[13].ret_CallEEpromLoadData ZFFSAB._.EEpromZentralHandler.eepromChannel[13].ret_CallEEpromLoadDataState ZFFSAB._.EEpromZentralHandler.eepromChannel[13].ret_CallEEpromStoreImmediate ZFFSAB._.EEpromZentralHandler.eepromChannel[14].ZFFSAB._.cEEpromChannel._.cnt_GetEEpromUpdate ZFFSAB._.EEpromZentralHandler.eepromChannel[14].ZFFSAB._.cEEpromChannel._.cnt_GetEEpromValid ZFFSAB._.EEpromZentralHandler.eepromChannel[14].ZFFSAB._.cEEpromChannel._.cnt_GetSizeofEEpromData ZFFSAB._.EEpromZentralHandler.eepromChannel[14].ZFFSAB._.cEEpromChannel._.cnt_SetEEpromInitZyklisch ZFFSAB._.EEpromZentralHandler.eepromChannel[14].ZFFSAB._.cEEpromChannel._.eeprom_info ZFFSAB._.EEpromZentralHandler.eepromChannel[14].ZFFSAB._.cEEpromChannel._.ret_GetEEpromUpdate ZFFSAB._.EEpromZentralHandler.eepromChannel[14].ZFFSAB._.cEEpromChannel._.ret_GetEEpromValid ZFFSAB._.EEpromZentralHandler.eepromChannel[14].ZFFSAB._.cEEpromChannel._.ret_GetSizeofEEpromData ZFFSAB._.EEpromZentralHandler.eepromChannel[14].ZFFSAB._.cEEpromChannel._.ret_SetEEpromInitZyklisch ZFFSAB._.EEpromZentralHandler.eepromChannel[14].cnt_CallEEpromLoadData ZFFSAB._.EEpromZentralHandler.eepromChannel[14].cnt_CallEEpromLoadDataState ZFFSAB._.EEpromZentralHandler.eepromChannel[14].cnt_CallEEpromStoreImmediate ZFFSAB._.EEpromZentralHandler.eepromChannel[14].cnt_SetEEpromWriteProtect ZFFSAB._.EEpromZentralHandler.eepromChannel[14].mode ZFFSAB._.EEpromZentralHandler.eepromChannel[14].ret_CallEEpromLoadData ZFFSAB._.EEpromZentralHandler.eepromChannel[14].ret_CallEEpromLoadDataState ZFFSAB._.EEpromZentralHandler.eepromChannel[14].ret_CallEEpromStoreImmediate ZFFSAB._.EEpromZentralHandler.eepromChannel[15].ZFFSAB._.cEEpromChannel._.cnt_GetEEpromUpdate ZFFSAB._.EEpromZentralHandler.eepromChannel[15].ZFFSAB._.cEEpromChannel._.cnt_GetEEpromValid ZFFSAB._.EEpromZentralHandler.eepromChannel[15].ZFFSAB._.cEEpromChannel._.cnt_GetSizeofEEpromData ZFFSAB._.EEpromZentralHandler.eepromChannel[15].ZFFSAB._.cEEpromChannel._.cnt_SetEEpromInitZyklisch ZFFSAB._.EEpromZentralHandler.eepromChannel[15].ZFFSAB._.cEEpromChannel._.eeprom_info ZFFSAB._.EEpromZentralHandler.eepromChannel[15].ZFFSAB._.cEEpromChannel._.ret_GetEEpromUpdate ZFFSAB._.EEpromZentralHandler.eepromChannel[15].ZFFSAB._.cEEpromChannel._.ret_GetEEpromValid ZFFSAB._.EEpromZentralHandler.eepromChannel[15].ZFFSAB._.cEEpromChannel._.ret_GetSizeofEEpromData ZFFSAB._.EEpromZentralHandler.eepromChannel[15].ZFFSAB._.cEEpromChannel._.ret_SetEEpromInitZyklisch ZFFSAB._.EEpromZentralHandler.eepromChannel[15].cnt_CallEEpromLoadData ZFFSAB._.EEpromZentralHandler.eepromChannel[15].cnt_CallEEpromLoadDataState ZFFSAB._.EEpromZentralHandler.eepromChannel[15].cnt_CallEEpromStoreImmediate ZFFSAB._.EEpromZentralHandler.eepromChannel[15].cnt_SetEEpromWriteProtect ZFFSAB._.EEpromZentralHandler.eepromChannel[15].mode ZFFSAB._.EEpromZentralHandler.eepromChannel[15].ret_CallEEpromLoadData ZFFSAB._.EEpromZentralHandler.eepromChannel[15].ret_CallEEpromLoadDataState ZFFSAB._.EEpromZentralHandler.eepromChannel[15].ret_CallEEpromStoreImmediate ZFFSAB._.EEpromZentralHandler.eepromChannel[1].ZFFSAB._.cEEpromChannel._.cnt_GetEEpromUpdate ZFFSAB._.EEpromZentralHandler.eepromChannel[1].ZFFSAB._.cEEpromChannel._.cnt_GetEEpromValid ZFFSAB._.EEpromZentralHandler.eepromChannel[1].ZFFSAB._.cEEpromChannel._.cnt_GetSizeofEEpromData ZFFSAB._.EEpromZentralHandler.eepromChannel[1].ZFFSAB._.cEEpromChannel._.cnt_SetEEpromInitZyklisch ZFFSAB._.EEpromZentralHandler.eepromChannel[1].ZFFSAB._.cEEpromChannel._.eeprom_info ZFFSAB._.EEpromZentralHandler.eepromChannel[1].ZFFSAB._.cEEpromChannel._.ret_GetEEpromUpdate ZFFSAB._.EEpromZentralHandler.eepromChannel[1].ZFFSAB._.cEEpromChannel._.ret_GetEEpromValid ZFFSAB._.EEpromZentralHandler.eepromChannel[1].ZFFSAB._.cEEpromChannel._.ret_GetSizeofEEpromData ZFFSAB._.EEpromZentralHandler.eepromChannel[1].ZFFSAB._.cEEpromChannel._.ret_SetEEpromInitZyklisch ZFFSAB._.EEpromZentralHandler.eepromChannel[1].cnt_CallEEpromLoadData ZFFSAB._.EEpromZentralHandler.eepromChannel[1].cnt_CallEEpromLoadDataState ZFFSAB._.EEpromZentralHandler.eepromChannel[1].cnt_CallEEpromStoreImmediate ZFFSAB._.EEpromZentralHandler.eepromChannel[1].cnt_SetEEpromWriteProtect ZFFSAB._.EEpromZentralHandler.eepromChannel[1].mode ZFFSAB._.EEpromZentralHandler.eepromChannel[1].ret_CallEEpromLoadData ZFFSAB._.EEpromZentralHandler.eepromChannel[1].ret_CallEEpromLoadDataState ZFFSAB._.EEpromZentralHandler.eepromChannel[1].ret_CallEEpromStoreImmediate ZFFSAB._.EEpromZentralHandler.eepromChannel[2].ZFFSAB._.cEEpromChannel._.cnt_GetEEpromUpdate ZFFSAB._.EEpromZentralHandler.eepromChannel[2].ZFFSAB._.cEEpromChannel._.cnt_GetEEpromValid ZFFSAB._.EEpromZentralHandler.eepromChannel[2].ZFFSAB._.cEEpromChannel._.cnt_GetSizeofEEpromData ZFFSAB._.EEpromZentralHandler.eepromChannel[2].ZFFSAB._.cEEpromChannel._.cnt_SetEEpromInitZyklisch ZFFSAB._.EEpromZentralHandler.eepromChannel[2].ZFFSAB._.cEEpromChannel._.eeprom_info ZFFSAB._.EEpromZentralHandler.eepromChannel[2].ZFFSAB._.cEEpromChannel._.ret_GetEEpromUpdate ZFFSAB._.EEpromZentralHandler.eepromChannel[2].ZFFSAB._.cEEpromChannel._.ret_GetEEpromValid ZFFSAB._.EEpromZentralHandler.eepromChannel[2].ZFFSAB._.cEEpromChannel._.ret_GetSizeofEEpromData ZFFSAB._.EEpromZentralHandler.eepromChannel[2].ZFFSAB._.cEEpromChannel._.ret_SetEEpromInitZyklisch ZFFSAB._.EEpromZentralHandler.eepromChannel[2].cnt_CallEEpromLoadData ZFFSAB._.EEpromZentralHandler.eepromChannel[2].cnt_CallEEpromLoadDataState ZFFSAB._.EEpromZentralHandler.eepromChannel[2].cnt_CallEEpromStoreImmediate ZFFSAB._.EEpromZentralHandler.eepromChannel[2].cnt_SetEEpromWriteProtect ZFFSAB._.EEpromZentralHandler.eepromChannel[2].mode ZFFSAB._.EEpromZentralHandler.eepromChannel[2].ret_CallEEpromLoadData ZFFSAB._.EEpromZentralHandler.eepromChannel[2].ret_CallEEpromLoadDataState ZFFSAB._.EEpromZentralHandler.eepromChannel[2].ret_CallEEpromStoreImmediate ZFFSAB._.EEpromZentralHandler.eepromChannel[3].ZFFSAB._.cEEpromChannel._.cnt_GetEEpromUpdate ZFFSAB._.EEpromZentralHandler.eepromChannel[3].ZFFSAB._.cEEpromChannel._.cnt_GetEEpromValid ZFFSAB._.EEpromZentralHandler.eepromChannel[3].ZFFSAB._.cEEpromChannel._.cnt_GetSizeofEEpromData ZFFSAB._.EEpromZentralHandler.eepromChannel[3].ZFFSAB._.cEEpromChannel._.cnt_SetEEpromInitZyklisch ZFFSAB._.EEpromZentralHandler.eepromChannel[3].ZFFSAB._.cEEpromChannel._.eeprom_info ZFFSAB._.EEpromZentralHandler.eepromChannel[3].ZFFSAB._.cEEpromChannel._.ret_GetEEpromUpdate ZFFSAB._.EEpromZentralHandler.eepromChannel[3].ZFFSAB._.cEEpromChannel._.ret_GetEEpromValid ZFFSAB._.EEpromZentralHandler.eepromChannel[3].ZFFSAB._.cEEpromChannel._.ret_GetSizeofEEpromData ZFFSAB._.EEpromZentralHandler.eepromChannel[3].ZFFSAB._.cEEpromChannel._.ret_SetEEpromInitZyklisch ZFFSAB._.EEpromZentralHandler.eepromChannel[3].cnt_CallEEpromLoadData ZFFSAB._.EEpromZentralHandler.eepromChannel[3].cnt_CallEEpromLoadDataState ZFFSAB._.EEpromZentralHandler.eepromChannel[3].cnt_CallEEpromStoreImmediate ZFFSAB._.EEpromZentralHandler.eepromChannel[3].cnt_SetEEpromWriteProtect ZFFSAB._.EEpromZentralHandler.eepromChannel[3].mode ZFFSAB._.EEpromZentralHandler.eepromChannel[3].ret_CallEEpromLoadData ZFFSAB._.EEpromZentralHandler.eepromChannel[3].ret_CallEEpromLoadDataState ZFFSAB._.EEpromZentralHandler.eepromChannel[3].ret_CallEEpromStoreImmediate ZFFSAB._.EEpromZentralHandler.eepromChannel[4].ZFFSAB._.cEEpromChannel._.cnt_GetEEpromUpdate ZFFSAB._.EEpromZentralHandler.eepromChannel[4].ZFFSAB._.cEEpromChannel._.cnt_GetEEpromValid ZFFSAB._.EEpromZentralHandler.eepromChannel[4].ZFFSAB._.cEEpromChannel._.cnt_GetSizeofEEpromData ZFFSAB._.EEpromZentralHandler.eepromChannel[4].ZFFSAB._.cEEpromChannel._.cnt_SetEEpromInitZyklisch ZFFSAB._.EEpromZentralHandler.eepromChannel[4].ZFFSAB._.cEEpromChannel._.eeprom_info ZFFSAB._.EEpromZentralHandler.eepromChannel[4].ZFFSAB._.cEEpromChannel._.ret_GetEEpromUpdate ZFFSAB._.EEpromZentralHandler.eepromChannel[4].ZFFSAB._.cEEpromChannel._.ret_GetEEpromValid ZFFSAB._.EEpromZentralHandler.eepromChannel[4].ZFFSAB._.cEEpromChannel._.ret_GetSizeofEEpromData ZFFSAB._.EEpromZentralHandler.eepromChannel[4].ZFFSAB._.cEEpromChannel._.ret_SetEEpromInitZyklisch ZFFSAB._.EEpromZentralHandler.eepromChannel[4].cnt_CallEEpromLoadData ZFFSAB._.EEpromZentralHandler.eepromChannel[4].cnt_CallEEpromLoadDataState ZFFSAB._.EEpromZentralHandler.eepromChannel[4].cnt_CallEEpromStoreImmediate ZFFSAB._.EEpromZentralHandler.eepromChannel[4].cnt_SetEEpromWriteProtect ZFFSAB._.EEpromZentralHandler.eepromChannel[4].mode ZFFSAB._.EEpromZentralHandler.eepromChannel[4].ret_CallEEpromLoadData ZFFSAB._.EEpromZentralHandler.eepromChannel[4].ret_CallEEpromLoadDataState ZFFSAB._.EEpromZentralHandler.eepromChannel[4].ret_CallEEpromStoreImmediate ZFFSAB._.EEpromZentralHandler.eepromChannel[5].ZFFSAB._.cEEpromChannel._.cnt_GetEEpromUpdate ZFFSAB._.EEpromZentralHandler.eepromChannel[5].ZFFSAB._.cEEpromChannel._.cnt_GetEEpromValid ZFFSAB._.EEpromZentralHandler.eepromChannel[5].ZFFSAB._.cEEpromChannel._.cnt_GetSizeofEEpromData ZFFSAB._.EEpromZentralHandler.eepromChannel[5].ZFFSAB._.cEEpromChannel._.cnt_SetEEpromInitZyklisch ZFFSAB._.EEpromZentralHandler.eepromChannel[5].ZFFSAB._.cEEpromChannel._.eeprom_info ZFFSAB._.EEpromZentralHandler.eepromChannel[5].ZFFSAB._.cEEpromChannel._.ret_GetEEpromUpdate ZFFSAB._.EEpromZentralHandler.eepromChannel[5].ZFFSAB._.cEEpromChannel._.ret_GetEEpromValid ZFFSAB._.EEpromZentralHandler.eepromChannel[5].ZFFSAB._.cEEpromChannel._.ret_GetSizeofEEpromData ZFFSAB._.EEpromZentralHandler.eepromChannel[5].ZFFSAB._.cEEpromChannel._.ret_SetEEpromInitZyklisch ZFFSAB._.EEpromZentralHandler.eepromChannel[5].cnt_CallEEpromLoadData ZFFSAB._.EEpromZentralHandler.eepromChannel[5].cnt_CallEEpromLoadDataState ZFFSAB._.EEpromZentralHandler.eepromChannel[5].cnt_CallEEpromStoreImmediate ZFFSAB._.EEpromZentralHandler.eepromChannel[5].cnt_SetEEpromWriteProtect ZFFSAB._.EEpromZentralHandler.eepromChannel[5].mode ZFFSAB._.EEpromZentralHandler.eepromChannel[5].ret_CallEEpromLoadData ZFFSAB._.EEpromZentralHandler.eepromChannel[5].ret_CallEEpromLoadDataState ZFFSAB._.EEpromZentralHandler.eepromChannel[5].ret_CallEEpromStoreImmediate ZFFSAB._.EEpromZentralHandler.eepromChannel[6].ZFFSAB._.cEEpromChannel._.cnt_GetEEpromUpdate ZFFSAB._.EEpromZentralHandler.eepromChannel[6].ZFFSAB._.cEEpromChannel._.cnt_GetEEpromValid ZFFSAB._.EEpromZentralHandler.eepromChannel[6].ZFFSAB._.cEEpromChannel._.cnt_GetSizeofEEpromData ZFFSAB._.EEpromZentralHandler.eepromChannel[6].ZFFSAB._.cEEpromChannel._.cnt_SetEEpromInitZyklisch ZFFSAB._.EEpromZentralHandler.eepromChannel[6].ZFFSAB._.cEEpromChannel._.eeprom_info ZFFSAB._.EEpromZentralHandler.eepromChannel[6].ZFFSAB._.cEEpromChannel._.ret_GetEEpromUpdate ZFFSAB._.EEpromZentralHandler.eepromChannel[6].ZFFSAB._.cEEpromChannel._.ret_GetEEpromValid ZFFSAB._.EEpromZentralHandler.eepromChannel[6].ZFFSAB._.cEEpromChannel._.ret_GetSizeofEEpromData ZFFSAB._.EEpromZentralHandler.eepromChannel[6].ZFFSAB._.cEEpromChannel._.ret_SetEEpromInitZyklisch ZFFSAB._.EEpromZentralHandler.eepromChannel[6].cnt_CallEEpromLoadData ZFFSAB._.EEpromZentralHandler.eepromChannel[6].cnt_CallEEpromLoadDataState ZFFSAB._.EEpromZentralHandler.eepromChannel[6].cnt_CallEEpromStoreImmediate ZFFSAB._.EEpromZentralHandler.eepromChannel[6].cnt_SetEEpromWriteProtect ZFFSAB._.EEpromZentralHandler.eepromChannel[6].mode ZFFSAB._.EEpromZentralHandler.eepromChannel[6].ret_CallEEpromLoadData ZFFSAB._.EEpromZentralHandler.eepromChannel[6].ret_CallEEpromLoadDataState ZFFSAB._.EEpromZentralHandler.eepromChannel[6].ret_CallEEpromStoreImmediate ZFFSAB._.EEpromZentralHandler.eepromChannel[7].ZFFSAB._.cEEpromChannel._.cnt_GetEEpromUpdate ZFFSAB._.EEpromZentralHandler.eepromChannel[7].ZFFSAB._.cEEpromChannel._.cnt_GetEEpromValid ZFFSAB._.EEpromZentralHandler.eepromChannel[7].ZFFSAB._.cEEpromChannel._.cnt_GetSizeofEEpromData ZFFSAB._.EEpromZentralHandler.eepromChannel[7].ZFFSAB._.cEEpromChannel._.cnt_SetEEpromInitZyklisch ZFFSAB._.EEpromZentralHandler.eepromChannel[7].ZFFSAB._.cEEpromChannel._.eeprom_info ZFFSAB._.EEpromZentralHandler.eepromChannel[7].ZFFSAB._.cEEpromChannel._.ret_GetEEpromUpdate ZFFSAB._.EEpromZentralHandler.eepromChannel[7].ZFFSAB._.cEEpromChannel._.ret_GetEEpromValid ZFFSAB._.EEpromZentralHandler.eepromChannel[7].ZFFSAB._.cEEpromChannel._.ret_GetSizeofEEpromData ZFFSAB._.EEpromZentralHandler.eepromChannel[7].ZFFSAB._.cEEpromChannel._.ret_SetEEpromInitZyklisch ZFFSAB._.EEpromZentralHandler.eepromChannel[7].cnt_CallEEpromLoadData ZFFSAB._.EEpromZentralHandler.eepromChannel[7].cnt_CallEEpromLoadDataState ZFFSAB._.EEpromZentralHandler.eepromChannel[7].cnt_CallEEpromStoreImmediate ZFFSAB._.EEpromZentralHandler.eepromChannel[7].cnt_SetEEpromWriteProtect ZFFSAB._.EEpromZentralHandler.eepromChannel[7].mode ZFFSAB._.EEpromZentralHandler.eepromChannel[7].ret_CallEEpromLoadData ZFFSAB._.EEpromZentralHandler.eepromChannel[7].ret_CallEEpromLoadDataState ZFFSAB._.EEpromZentralHandler.eepromChannel[7].ret_CallEEpromStoreImmediate ZFFSAB._.EEpromZentralHandler.eepromChannel[8].ZFFSAB._.cEEpromChannel._.cnt_GetEEpromUpdate ZFFSAB._.EEpromZentralHandler.eepromChannel[8].ZFFSAB._.cEEpromChannel._.cnt_GetEEpromValid ZFFSAB._.EEpromZentralHandler.eepromChannel[8].ZFFSAB._.cEEpromChannel._.cnt_GetSizeofEEpromData ZFFSAB._.EEpromZentralHandler.eepromChannel[8].ZFFSAB._.cEEpromChannel._.cnt_SetEEpromInitZyklisch ZFFSAB._.EEpromZentralHandler.eepromChannel[8].ZFFSAB._.cEEpromChannel._.eeprom_info ZFFSAB._.EEpromZentralHandler.eepromChannel[8].ZFFSAB._.cEEpromChannel._.ret_GetEEpromUpdate ZFFSAB._.EEpromZentralHandler.eepromChannel[8].ZFFSAB._.cEEpromChannel._.ret_GetEEpromValid ZFFSAB._.EEpromZentralHandler.eepromChannel[8].ZFFSAB._.cEEpromChannel._.ret_GetSizeofEEpromData ZFFSAB._.EEpromZentralHandler.eepromChannel[8].ZFFSAB._.cEEpromChannel._.ret_SetEEpromInitZyklisch ZFFSAB._.EEpromZentralHandler.eepromChannel[8].cnt_CallEEpromLoadData ZFFSAB._.EEpromZentralHandler.eepromChannel[8].cnt_CallEEpromLoadDataState ZFFSAB._.EEpromZentralHandler.eepromChannel[8].cnt_CallEEpromStoreImmediate ZFFSAB._.EEpromZentralHandler.eepromChannel[8].cnt_SetEEpromWriteProtect ZFFSAB._.EEpromZentralHandler.eepromChannel[8].mode ZFFSAB._.EEpromZentralHandler.eepromChannel[8].ret_CallEEpromLoadData ZFFSAB._.EEpromZentralHandler.eepromChannel[8].ret_CallEEpromLoadDataState ZFFSAB._.EEpromZentralHandler.eepromChannel[8].ret_CallEEpromStoreImmediate ZFFSAB._.EEpromZentralHandler.eepromChannel[9].ZFFSAB._.cEEpromChannel._.cnt_GetEEpromUpdate ZFFSAB._.EEpromZentralHandler.eepromChannel[9].ZFFSAB._.cEEpromChannel._.cnt_GetEEpromValid ZFFSAB._.EEpromZentralHandler.eepromChannel[9].ZFFSAB._.cEEpromChannel._.cnt_GetSizeofEEpromData ZFFSAB._.EEpromZentralHandler.eepromChannel[9].ZFFSAB._.cEEpromChannel._.cnt_SetEEpromInitZyklisch ZFFSAB._.EEpromZentralHandler.eepromChannel[9].ZFFSAB._.cEEpromChannel._.eeprom_info ZFFSAB._.EEpromZentralHandler.eepromChannel[9].ZFFSAB._.cEEpromChannel._.ret_GetEEpromUpdate ZFFSAB._.EEpromZentralHandler.eepromChannel[9].ZFFSAB._.cEEpromChannel._.ret_GetEEpromValid ZFFSAB._.EEpromZentralHandler.eepromChannel[9].ZFFSAB._.cEEpromChannel._.ret_GetSizeofEEpromData ZFFSAB._.EEpromZentralHandler.eepromChannel[9].ZFFSAB._.cEEpromChannel._.ret_SetEEpromInitZyklisch ZFFSAB._.EEpromZentralHandler.eepromChannel[9].cnt_CallEEpromLoadData ZFFSAB._.EEpromZentralHandler.eepromChannel[9].cnt_CallEEpromLoadDataState ZFFSAB._.EEpromZentralHandler.eepromChannel[9].cnt_CallEEpromStoreImmediate ZFFSAB._.EEpromZentralHandler.eepromChannel[9].cnt_SetEEpromWriteProtect ZFFSAB._.EEpromZentralHandler.eepromChannel[9].mode ZFFSAB._.EEpromZentralHandler.eepromChannel[9].ret_CallEEpromLoadData ZFFSAB._.EEpromZentralHandler.eepromChannel[9].ret_CallEEpromLoadDataState ZFFSAB._.EEpromZentralHandler.eepromChannel[9].ret_CallEEpromStoreImmediate ZFFSAB._.EEpromZentralHandler.f_EeStoringActive ZFFSAB._.EEpromZentralHandler.iv_cnt_EeUpdt ZFFSAB._.EEpromZentralHandler.iv_cnt_ErrMemEntry ZFFSAB._.EEpromZentralHandler.iv_f_EeStoreInProgress /end IN_MEASUREMENT
/end FUNCTION
/begin FUNCTION zf_SAB_EmergencyGearInfo "desc_en"
 /begin IN_MEASUREMENT ZFFSAB._.EmergencyGearInfo.Gear_during_act_KMN_GFIX ZFFSAB._.EmergencyGearInfo.KMN_GFIX_last_cycle ZFFSAB._.EmergencyGearInfo.KMN_High_active_last_call ZFFSAB._.EmergencyGearInfo.KMN_active_last_call ZFFSAB._.EmergencyGearInfo.ctl_EmergencyGearInfo ZFFSAB._.EmergencyGearInfo.f_3th_stepENPGx ZFFSAB._.EmergencyGearInfo.f_IgnitionOff2On ZFFSAB._.EmergencyGearInfo.iv_ActualGear ZFFSAB._.EmergencyGearInfo.iv_Pos ZFFSAB._.EmergencyGearInfo.iv_PosSts ZFFSAB._.EmergencyGearInfo.iv_TargetGear ZFFSAB._.EmergencyGearInfo.iv_in_Gear1Act ZFFSAB._.EmergencyGearInfo.iv_in_Gear2Act ZFFSAB._.EmergencyGearInfo.iv_in_Gear3Act ZFFSAB._.EmergencyGearInfo.iv_in_Gear4Act ZFFSAB._.EmergencyGearInfo.iv_in_Gear5Act ZFFSAB._.EmergencyGearInfo.iv_in_Gear6Act ZFFSAB._.EmergencyGearInfo.iv_in_GearAct ZFFSAB._.EmergencyGearInfo.iv_n_EnUTh ZFFSAB._.EmergencyGearInfo.loc_ConditionENPG3Fix ZFFSAB._.EmergencyGearInfo.loc_ConditionGear1 ZFFSAB._.EmergencyGearInfo.loc_ConditionGear2 ZFFSAB._.EmergencyGearInfo.loc_ConditionGear3 ZFFSAB._.EmergencyGearInfo.loc_ConditionGear4 ZFFSAB._.EmergencyGearInfo.loc_ConditionGear5 ZFFSAB._.EmergencyGearInfo.loc_ConditionGear6 ZFFSAB._.EmergencyGearInfo.loc_reg_for_GFIX_old ZFFSAB._.EmergencyGearInfo.loc_reg_hi_for_GFIX_old ZFFSAB._.EmergencyGearInfo.n_AbUThGearSubst1 ZFFSAB._.EmergencyGearInfo.n_AbUThGearSubst2 ZFFSAB._.EmergencyGearInfo.n_AbUThGearSubst3 ZFFSAB._.EmergencyGearInfo.n_AbUThGearSubst4 ZFFSAB._.EmergencyGearInfo.n_AbUThGearSubst5 ZFFSAB._.EmergencyGearInfo.n_AbUThGearSubst6 ZFFSAB._.EmergencyGearInfo.st_ENPG3 ZFFSAB._.EmergencyGearInfo.st_ENPG3FIX ZFFSAB._.EmergencyGearInfo.st_KMN_GFIX_KFC_ERSATZ ZFFSAB._.EmergencyGearInfo.st_RD_ENPG3_ENPG3FIX ZFFSAB._.EmergencyGearInfo.sv_IEPsoll_subst ZFFSAB._.EmergencyGearInfo.sv_K0soll_subst ZFFSAB._.EmergencyGearInfo.sv_ctl_EmergencyGearInfoCpy /end IN_MEASUREMENT
/end FUNCTION
/begin FUNCTION zf_SAB_EngineCoolantTempIn "desc_en"
 /begin IN_MEASUREMENT ZFFSAB._.EngineCoolantTempIn.f_c_CemErr ZFFSAB._.EngineCoolantTempIn.f_c_EngErr ZFFSAB._.EngineCoolantTempIn.iv_c_Cem ZFFSAB._.EngineCoolantTempIn.iv_c_CemSts ZFFSAB._.EngineCoolantTempIn.iv_c_Eng ZFFSAB._.EngineCoolantTempIn.iv_c_EngSts ZFFSAB._.EngineCoolantTempIn.sv_AGS_Cem ZFFSAB._.EngineCoolantTempIn.sv_c_CemSts ZFFSAB._.EngineCoolantTempIn.sv_c_Eng ZFFSAB._.EngineCoolantTempIn.sv_c_EngSts /end IN_MEASUREMENT
/end FUNCTION
/begin FUNCTION zf_SAB_EngineIdleIn "desc_en"
 /begin IN_MEASUREMENT ZFFSAB._.EngineIdleIn.f_EngIdleActiveErr ZFFSAB._.EngineIdleIn.iv_EngIdleActive ZFFSAB._.EngineIdleIn.iv_EngIdleActiveSts ZFFSAB._.EngineIdleIn.sv_EngIdleActive ZFFSAB._.EngineIdleIn.sv_EngIdleActiveSts /end IN_MEASUREMENT
/end FUNCTION
/begin FUNCTION zf_SAB_EngineIdleSpeedReqIn "desc_en"
 /begin IN_MEASUREMENT ZFFSAB._.EngineIdleSpeedReqIn.f_n_EngIdleErr ZFFSAB._.EngineIdleSpeedReqIn.iv_n_EngIdle ZFFSAB._.EngineIdleSpeedReqIn.iv_n_EngIdleExt ZFFSAB._.EngineIdleSpeedReqIn.iv_n_EngIdleExtSts ZFFSAB._.EngineIdleSpeedReqIn.iv_n_EngIdleSts ZFFSAB._.EngineIdleSpeedReqIn.sv_n_EngIdle ZFFSAB._.EngineIdleSpeedReqIn.sv_n_EngIdleSts /end IN_MEASUREMENT
/end FUNCTION
/begin FUNCTION zf_SAB_EngineInterventionLimitIn "desc_en"
 /begin IN_MEASUREMENT ZFFSAB._.EngineInterventionLimitIn.f_m_EngInterventionLimitErr ZFFSAB._.EngineInterventionLimitIn.iv_m_EngInterventionLimit ZFFSAB._.EngineInterventionLimitIn.iv_m_EngInterventionLimitSts ZFFSAB._.EngineInterventionLimitIn.m_EngInterventionLimitSts ZFFSAB._.EngineInterventionLimitIn.sv_m_EngInterventionLimit /end IN_MEASUREMENT
/end FUNCTION
/begin FUNCTION zf_SAB_EngineSignalDiagnosis "desc_en" /begin IN_MEASUREMENT ZFFSAB._.EngineSignalDiagnosis.iv_Status_K0 /end IN_MEASUREMENT /end FUNCTION
/begin FUNCTION zf_SAB_EngineSpeedIn "desc_en"
 /begin IN_MEASUREMENT ZFFSAB._.EngineSpeedIn.f_n_EngErr ZFFSAB._.EngineSpeedIn.f_n_EngLev2Err ZFFSAB._.EngineSpeedIn.f_n_EngLev2Err_ ZFFSAB._.EngineSpeedIn.f_n_EngVMErr ZFFSAB._.EngineSpeedIn.f_n_EngVMLev2Err ZFFSAB._.EngineSpeedIn.f_n_EngVMLev2Err_ ZFFSAB._.EngineSpeedIn.iv_ActualGear ZFFSAB._.EngineSpeedIn.iv_StatusK0 ZFFSAB._.EngineSpeedIn.iv_TargetGear ZFFSAB._.EngineSpeedIn.iv_in_Gear ZFFSAB._.EngineSpeedIn.iv_kraftschluss ZFFSAB._.EngineSpeedIn.iv_n_Eng ZFFSAB._.EngineSpeedIn.iv_n_EngErr ZFFSAB._.EngineSpeedIn.iv_n_EngErr_ ZFFSAB._.EngineSpeedIn.iv_n_EngSts ZFFSAB._.EngineSpeedIn.iv_n_EngSts_ ZFFSAB._.EngineSpeedIn.iv_n_EngVM ZFFSAB._.EngineSpeedIn.iv_n_EngVMErr ZFFSAB._.EngineSpeedIn.iv_n_EngVMSts ZFFSAB._.EngineSpeedIn.iv_n_EngVMSts_ ZFFSAB._.EngineSpeedIn.iv_n_EngVM_ ZFFSAB._.EngineSpeedIn.iv_n_Eng_ ZFFSAB._.EngineSpeedIn.iv_st_IAE ZFFSAB._.EngineSpeedIn.sv_AGS_NEm ZFFSAB._.EngineSpeedIn.sv_n_Eng ZFFSAB._.EngineSpeedIn.sv_n_EngLev2 ZFFSAB._.EngineSpeedIn.sv_n_EngLev2Sts ZFFSAB._.EngineSpeedIn.sv_n_EngLev2Sts_ ZFFSAB._.EngineSpeedIn.sv_n_EngLev2_ ZFFSAB._.EngineSpeedIn.sv_n_EngSts ZFFSAB._.EngineSpeedIn.sv_n_EngVM ZFFSAB._.EngineSpeedIn.sv_n_EngVMLev2 ZFFSAB._.EngineSpeedIn.sv_n_EngVMLev2Sts ZFFSAB._.EngineSpeedIn.sv_n_EngVMLev2Sts_ ZFFSAB._.EngineSpeedIn.sv_n_EngVMLev2_ ZFFSAB._.EngineSpeedIn.sv_n_EngVMSts ZFFSAB._.EngineSpeedRedIn.f_n_EngMaxRedErr ZFFSAB._.ParkingBrakeIn.f_ParkingBrakeErr /end IN_MEASUREMENT
/end FUNCTION
/begin FUNCTION zf_SAB_EngineSpeedRedIn "desc_en"
 /begin IN_MEASUREMENT ZFFSAB._.EngineSpeedRedIn.iv_n_EngMaxAlw ZFFSAB._.EngineSpeedRedIn.iv_n_EngMaxAlw_ ZFFSAB._.EngineSpeedRedIn.iv_n_EngMaxRed ZFFSAB._.EngineSpeedRedIn.iv_n_EngMaxRedSts ZFFSAB._.EngineSpeedRedIn.iv_n_EngMaxRedSts_ ZFFSAB._.EngineSpeedRedIn.iv_n_EngMaxRed_ ZFFSAB._.EngineSpeedRedIn.sv_n_EngMaxRed ZFFSAB._.EngineSpeedRedIn.sv_n_EngMaxRedSts ZFFSAB._.EngineSpeedRedIn.sv_n_EngRed ZFFSAB._.EngineSpeedRedIn.sv_n_EngRed_ /end IN_MEASUREMENT
/end FUNCTION
/begin FUNCTION zf_SAB_EngineTorqueIn "desc_en"
 /begin IN_MEASUREMENT ZFFSAB._.EngineTorqueIn.EngineTorqueInFl.iv_m_Eng_ ZFFSAB._.EngineTorqueIn.f_m_EngErr ZFFSAB._.EngineTorqueIn.iv_m_Eng ZFFSAB._.EngineTorqueIn.iv_m_EngSts ZFFSAB._.EngineTorqueIn.iv_m_EngSts_ ZFFSAB._.EngineTorqueIn.iv_m_Eng_ ZFFSAB._.EngineTorqueIn.iv_m_K0AktModified ZFFSAB._.EngineTorqueIn.iv_m_PumpCensored ZFFSAB._.EngineTorqueIn.m_EngCor ZFFSAB._.EngineTorqueIn.m_EngCor2 ZFFSAB._.EngineTorqueIn.m_EngCor2Sts ZFFSAB._.EngineTorqueIn.m_EngCorSts ZFFSAB._.EngineTorqueIn.m_EngCorSts_ ZFFSAB._.EngineTorqueIn.sv_AGS_MMot ZFFSAB._.EngineTorqueIn.sv_m_Eng ZFFSAB._.EngineTorqueIn.sv_m_EngFilt ZFFSAB._.EngineTorqueIn.sv_m_EngFiltSts ZFFSAB._.EngineTorqueIn.sv_m_EngLev2 ZFFSAB._.EngineTorqueIn.sv_m_EngLev2_ ZFFSAB._.EngineTorqueIn.sv_m_EngSts /end IN_MEASUREMENT
/end FUNCTION
/begin FUNCTION zf_SAB_EngineTorqueInFl "desc_en"
 /begin IN_MEASUREMENT ZFFSAB._.EngineTorqueIn.EngineTorqueInFl.f_m_EngErr ZFFSAB._.EngineTorqueIn.EngineTorqueInFl.iv_m_Eng ZFFSAB._.EngineTorqueIn.EngineTorqueInFl.iv_m_EngSts ZFFSAB._.EngineTorqueIn.EngineTorqueInFl.m_EngCor ZFFSAB._.EngineTorqueIn.EngineTorqueInFl.sv_m_EngLev2 ZFFSAB._.EngineTorqueIn.EngineTorqueInFl.sv_m_EngLev2_ ZFFSAB._.EngineTorqueIn.EngineTorqueInFl.sv_m_EngSts /end IN_MEASUREMENT
/end FUNCTION
/begin FUNCTION zf_SAB_EstVehicleWeightIn "desc_en"
 /begin IN_MEASUREMENT ZFFSAB._.EstVehicleWeightIn.f_MassFzgEstErr ZFFSAB._.EstVehicleWeightIn.iv_MassFzgEst ZFFSAB._.EstVehicleWeightIn.iv_MassFzgEstErr ZFFSAB._.EstVehicleWeightIn.iv_MassFzgEstSts ZFFSAB._.EstVehicleWeightIn.sv_MassFzgEst ZFFSAB._.EstVehicleWeightIn.sv_MassFzgEstSts /end IN_MEASUREMENT
/end FUNCTION
/begin FUNCTION zf_SAB_ExtBrakeInterventionIn "desc_en"
 /begin IN_MEASUREMENT ZFFSAB._.ExtBrakeInterventionIn.BrakeTorq ZFFSAB._.ExtBrakeInterventionIn.BrakeTorqDvch ZFFSAB._.ExtBrakeInterventionIn.BrakeTorqDvchSts ZFFSAB._.ExtBrakeInterventionIn.BrakeTorqSts ZFFSAB._.ExtBrakeInterventionIn.StBrake ZFFSAB._.ExtBrakeInterventionIn.StBrakeSts ZFFSAB._.ExtBrakeInterventionIn.f_BrakeTorq ZFFSAB._.ExtBrakeInterventionIn.f_BrakeTorqDvch ZFFSAB._.ExtBrakeInterventionIn.f_StBrake ZFFSAB._.ExtBrakeInterventionIn.iv_BrakeTorq ZFFSAB._.ExtBrakeInterventionIn.iv_BrakeTorqDvch ZFFSAB._.ExtBrakeInterventionIn.iv_BrakeTorqDvchSts ZFFSAB._.ExtBrakeInterventionIn.iv_BrakeTorqSts ZFFSAB._.ExtBrakeInterventionIn.iv_StBrake ZFFSAB._.ExtBrakeInterventionIn.iv_StBrakeSts ZFFSAB._.ExtBrakeInterventionIn.iv_StBrakeTorq ZFFSAB._.ExtBrakeInterventionIn.sv_AGS_MBrSoll ZFFSAB._.ExtBrakeInterventionIn.sv_ExtBrakeInterventionSts ZFFSAB._.ExtBrakeInterventionIn.sv_f_ExtBrakeIntervention /end IN_MEASUREMENT
/end FUNCTION
/begin FUNCTION zf_SAB_FlagKickDownIn "desc_en"
 /begin IN_MEASUREMENT ZFFSAB._.FlagKickDownIn.f_KickdownErr ZFFSAB._.FlagKickDownIn.iv_Kickdown ZFFSAB._.FlagKickDownIn.iv_KickdownSts ZFFSAB._.FlagKickDownIn.sv_KickdownSts ZFFSAB._.FlagKickDownIn.sv_f_Kickdown /end IN_MEASUREMENT
/end FUNCTION
/begin FUNCTION zf_SAB_FlagTrailerInfoIn "desc_en"
 /begin IN_MEASUREMENT ZFFSAB._.FlagTrailerInfoIn.iv_TrailerInfo ZFFSAB._.FlagTrailerInfoIn.iv_TrailerInfoSts ZFFSAB._.FlagTrailerInfoIn.sv_TrailerInfoSts ZFFSAB._.FlagTrailerInfoIn.sv_f_TrailerInfo /end IN_MEASUREMENT
/end FUNCTION
/begin FUNCTION zf_SAB_FpDkVpIn "desc_en"
 /begin IN_MEASUREMENT ZFFSAB._.FpDkVpIn.f_ThrottlePositionErr ZFFSAB._.FpDkVpIn.f_ThrottlePositionVirtErr ZFFSAB._.FpDkVpIn.iv_ThrottlePosition ZFFSAB._.FpDkVpIn.iv_ThrottlePositionErr ZFFSAB._.FpDkVpIn.iv_ThrottlePositionErr_ ZFFSAB._.FpDkVpIn.iv_ThrottlePositionSts ZFFSAB._.FpDkVpIn.iv_ThrottlePositionSts_ ZFFSAB._.FpDkVpIn.iv_ThrottlePositionVirt ZFFSAB._.FpDkVpIn.iv_ThrottlePositionVirtSts ZFFSAB._.FpDkVpIn.iv_ThrottlePosition_ ZFFSAB._.FpDkVpIn.sv_MaxThrottlePosition ZFFSAB._.FpDkVpIn.sv_MaxThrottlePositionSts ZFFSAB._.FpDkVpIn.sv_ThrottlePosition ZFFSAB._.FpDkVpIn.sv_ThrottlePositionLev2 ZFFSAB._.FpDkVpIn.sv_ThrottlePositionLev2Sts ZFFSAB._.FpDkVpIn.sv_ThrottlePositionLev2Sts_ ZFFSAB._.FpDkVpIn.sv_ThrottlePositionLev2_ ZFFSAB._.FpDkVpIn.sv_ThrottlePositionSts ZFFSAB._.FpDkVpIn.sv_ThrottlePositionVirt ZFFSAB._.FpDkVpIn.sv_ThrottlePositionVirtSts /end IN_MEASUREMENT
/end FUNCTION
/begin FUNCTION zf_SAB_FrictionIn "desc_en"
 /begin IN_MEASUREMENT ZFFSAB._.FrictionIn.f_m_FrictionErr ZFFSAB._.FrictionIn.iv_m_Friction ZFFSAB._.FrictionIn.iv_m_FrictionSts ZFFSAB._.FrictionIn.m_FrictionCor ZFFSAB._.FrictionIn.sv_m_Friction ZFFSAB._.FrictionIn.sv_m_FrictionSts /end IN_MEASUREMENT
/end FUNCTION
/begin FUNCTION zf_SAB_FuelCutoffActiveIn "desc_en"
 /begin IN_MEASUREMENT ZFFSAB._.FuelCutoffActiveIn.iv_FuelCutoffActive ZFFSAB._.FuelCutoffActiveIn.iv_FuelCutoffActiveSts ZFFSAB._.FuelCutoffActiveIn.sv_AGS_StatINFS ZFFSAB._.FuelCutoffActiveIn.sv_FuelCutoffActiveSts ZFFSAB._.FuelCutoffActiveIn.sv_f_FuelCutoffActive /end IN_MEASUREMENT
/end FUNCTION
/begin FUNCTION zf_SAB_FullThrottleTorqueIn "desc_en"
 /begin IN_MEASUREMENT ZFFSAB._.FullThrottleTorqueIn.f_m_MKWMaxErr ZFFSAB._.FullThrottleTorqueIn.iv_m_MKWMax ZFFSAB._.FullThrottleTorqueIn.iv_m_MKWMaxSts ZFFSAB._.FullThrottleTorqueIn.sv_m_MKWMax ZFFSAB._.FullThrottleTorqueIn.sv_m_MKWMaxSts /end IN_MEASUREMENT
/end FUNCTION
/begin FUNCTION zf_SAB_GearBoxState "desc_en"
 /begin IN_MEASUREMENT ZFFSAB._.GearBoxState.f_ctl_HssOff ZFFSAB._.GearBoxState.iv_fet0_active ZFFSAB._.GearBoxState.iv_fet0_active_ ZFFSAB._.GearBoxState.iv_u_BattFilt ZFFSAB._.GearBoxState.sv_StatusLimphome ZFFSAB._.GearBoxState.sv_StatusLimphome_ /end IN_MEASUREMENT
/end FUNCTION
/begin FUNCTION zf_SAB_GearboxTempIn "desc_en"
 /begin IN_MEASUREMENT ZFFSAB._.GearboxTempIn.f_IgnitionOff2On ZFFSAB._.GearboxTempIn.iv_c_Chip2Trans ZFFSAB._.GearboxTempIn.iv_c_Chip2TransESts ZFFSAB._.GearboxTempIn.iv_c_OilTransESts ZFFSAB._.GearboxTempIn.iv_n_Eng ZFFSAB._.GearboxTempIn.iv_n_EngSts ZFFSAB._.GearboxTempIn.sv_c_ChipTrans ZFFSAB._.GearboxTempIn.sv_c_ChipTransSts ZFFSAB._.GearboxTempIn.sv_c_OilTrans ZFFSAB._.GearboxTempIn.sv_c_OilTransSts ZFFSAB._.GearboxTempIn.sv_c_OilTransSts_ ZFFSAB._.GearboxTempIn.sv_c_OilTransTXCAN ZFFSAB._.GearboxTempIn.sv_c_OilTrans_ /end IN_MEASUREMENT
/end FUNCTION
/begin FUNCTION zf_SAB_GearboxTempInFl "desc_en"
 /begin IN_MEASUREMENT ZFFSAB._.GearboxTempIn.GearboxTempInFl.iv_c_Chip2Trans ZFFSAB._.GearboxTempIn.GearboxTempInFl.sv_c_ChipTrans ZFFSAB._.GearboxTempIn.GearboxTempInFl.sv_c_ChipTransSts ZFFSAB._.GearboxTempIn.GearboxTempInFl.sv_c_OilTrans ZFFSAB._.GearboxTempIn.GearboxTempInFl.sv_c_OilTransSts ZFFSAB._.GearboxTempIn.GearboxTempInFl.sv_c_OilTrans_ /end IN_MEASUREMENT
/end FUNCTION
/begin FUNCTION zf_SAB_GearLeverIn "desc_en"
 /begin IN_MEASUREMENT ZFFSAB._.GearLeverIn.GLI_SWI_LeverType ZFFSAB._.GearLeverIn.P1Act ZFFSAB._.GearLeverIn.P1Sts ZFFSAB._.GearLeverIn.P1_Raw ZFFSAB._.GearLeverIn.P2Act ZFFSAB._.GearLeverIn.P2Sts ZFFSAB._.GearLeverIn.P2_Raw ZFFSAB._.GearLeverIn.P_Raw ZFFSAB._.GearLeverIn.P_Raw_ ZFFSAB._.GearLeverIn.Pos ZFFSAB._.GearLeverIn.PosS1Raw ZFFSAB._.GearLeverIn.PosS1Raw_ ZFFSAB._.GearLeverIn.PosS2Raw ZFFSAB._.GearLeverIn.PosS2Raw_ ZFFSAB._.GearLeverIn.Pos_ ZFFSAB._.GearLeverIn.iv_P1S1Raw ZFFSAB._.GearLeverIn.iv_P1S2Raw ZFFSAB._.GearLeverIn.iv_P2S1Raw ZFFSAB._.GearLeverIn.iv_P2S2Raw ZFFSAB._.GearLeverIn.iv_PS1_Raw ZFFSAB._.GearLeverIn.iv_PS1_Raw_ ZFFSAB._.GearLeverIn.iv_PS2_Raw ZFFSAB._.GearLeverIn.iv_PS2_Raw_ ZFFSAB._.GearLeverIn.iv_PosAbsS1Raw ZFFSAB._.GearLeverIn.iv_PosAbsS1Raw_ ZFFSAB._.GearLeverIn.iv_PosAbsS2Raw ZFFSAB._.GearLeverIn.iv_PosAbsS2Raw_ ZFFSAB._.GearLeverIn.iv_PosRelS1Raw ZFFSAB._.GearLeverIn.iv_PosRelS1Raw_ ZFFSAB._.GearLeverIn.iv_PosRelS2Raw ZFFSAB._.GearLeverIn.iv_PosRelS2Raw_ ZFFSAB._.GearLeverIn.iv_PosS1RawSts ZFFSAB._.GearLeverIn.iv_PosS1RawSts_ ZFFSAB._.GearLeverIn.iv_PosS2RawSts ZFFSAB._.GearLeverIn.iv_PosS2RawSts_ ZFFSAB._.GearLeverIn.sv_AGS_LeverPos ZFFSAB._.GearLeverIn.sv_CtrlSignalSource ZFFSAB._.GearLeverIn.sv_CtrlSignalSourceSts ZFFSAB._.GearLeverIn.sv_CtrlSignalSourceSts_ ZFFSAB._.GearLeverIn.sv_GatePosition ZFFSAB._.GearLeverIn.sv_GatePosition_ ZFFSAB._.GearLeverIn.sv_PosRaw ZFFSAB._.GearLeverIn.sv_PosRaw_ ZFFSAB._.GearLeverIn.sv_SWILeverType ZFFSAB._.GearLeverIn.sv_SWILeverTypeKomp ZFFSAB._.GearLeverIn.sv_SWISignalSource ZFFSAB._.GearLeverIn.sv_f_P12BadOpRaw ZFFSAB._.GearLeverIn.sv_f_P12Button ZFFSAB._.GearLeverIn.sv_f_P12Button_ ZFFSAB._.GearLeverIn.sv_f_P12OneErr ZFFSAB._.GearLeverIn.sv_f_P12TwoErr ZFFSAB._.GearLeverIn.sv_f_PosS1Err ZFFSAB._.GearLeverIn.sv_f_PosS2Err ZFFSAB._.GearLeverIn.sv_f_SD_Button ZFFSAB._.GearLeverIn.sv_f_TipMinusSBWErr ZFFSAB._.GearLeverIn.sv_f_TipMinusSBW_Raw ZFFSAB._.GearLeverIn.sv_f_TipMinusSBW_Raw_ ZFFSAB._.GearLeverIn.sv_f_TipPlusSBW_Raw ZFFSAB._.GearLeverIn.sv_f_TipPlusSBW_Raw_ /end IN_MEASUREMENT
/end FUNCTION
/begin FUNCTION zf_SAB_GearLimitation "desc_en"
 /begin IN_MEASUREMENT ZFFSAB._.GearLimitation.iv_f_GearLimitActive ZFFSAB._.GearLimitation.sv_GearLimit ZFFSAB._.GearLimitation.sv_f_GearLimitActive /end IN_MEASUREMENT
/end FUNCTION
/begin FUNCTION zf_SAB_GearRatioByCurrents "desc_en"
 /begin IN_MEASUREMENT ZFFSAB._.GearRatioByCurrents.IstGang ZFFSAB._.GearRatioByCurrents.IstGangOld ZFFSAB._.GearRatioByCurrents.err_flags_old ZFFSAB._.GearRatioByCurrents.err_flags_old_ ZFFSAB._.GearRatioByCurrents.f_RearAxleRatioLearned ZFFSAB._.GearRatioByCurrents.f_RearAxleRatioLearned_ ZFFSAB._.GearRatioByCurrents.f_n6PlausiErr ZFFSAB._.GearRatioByCurrents.f_n6PlausiErr_ ZFFSAB._.GearRatioByCurrents.f_n6WheelErr ZFFSAB._.GearRatioByCurrents.f_n6WheelErr_ ZFFSAB._.GearRatioByCurrents.f_n6nEngErr ZFFSAB._.GearRatioByCurrents.f_n_AbPlausiErr ZFFSAB._.GearRatioByCurrents.f_n_AbPlausiErr_ ZFFSAB._.GearRatioByCurrents.f_n_AbWheelErr ZFFSAB._.GearRatioByCurrents.f_n_AbWheelErr_ ZFFSAB._.GearRatioByCurrents.f_n_Abn6Err ZFFSAB._.GearRatioByCurrents.f_n_Abn6Err_ ZFFSAB._.GearRatioByCurrents.f_n_PlausiErr ZFFSAB._.GearRatioByCurrents.f_n_PlausiErr_ ZFFSAB._.GearRatioByCurrents.f_n_TuVirtPlausiErr ZFFSAB._.GearRatioByCurrents.f_n_TuVirtPlausiErr_ ZFFSAB._.GearRatioByCurrents.f_n_WheelPlausiErr ZFFSAB._.GearRatioByCurrents.f_n_WheelPlausiErr_ ZFFSAB._.GearRatioByCurrents.f_xErrChanged ZFFSAB._.GearRatioByCurrents.iGang ZFFSAB._.GearRatioByCurrents.iGang_ ZFFSAB._.GearRatioByCurrents.iv_ieds0 ZFFSAB._.GearRatioByCurrents.iv_ieds0_ ZFFSAB._.GearRatioByCurrents.iv_ieds1 ZFFSAB._.GearRatioByCurrents.iv_ieds1_ ZFFSAB._.GearRatioByCurrents.iv_ieds3 ZFFSAB._.GearRatioByCurrents.iv_ieds3_ ZFFSAB._.GearRatioByCurrents.iv_ieds4 ZFFSAB._.GearRatioByCurrents.iv_ieds4_ ZFFSAB._.GearRatioByCurrents.iv_n6 ZFFSAB._.GearRatioByCurrents.iv_n6_ ZFFSAB._.GearRatioByCurrents.iv_n6_ESts ZFFSAB._.GearRatioByCurrents.iv_n6_ESts_ ZFFSAB._.GearRatioByCurrents.iv_n_Ab ZFFSAB._.GearRatioByCurrents.iv_n_AbESts ZFFSAB._.GearRatioByCurrents.iv_n_AbESts_ ZFFSAB._.GearRatioByCurrents.iv_n_Ab_ ZFFSAB._.GearRatioByCurrents.iv_n_Tu ZFFSAB._.GearRatioByCurrents.iv_n_Tu_ ZFFSAB._.GearRatioByCurrents.iv_sts_ClutchIAE ZFFSAB._.GearRatioByCurrents.iv_sts_n6_DirectionDiag ZFFSAB._.GearRatioByCurrents.iv_sts_n6_DirectionDiag_ ZFFSAB._.GearRatioByCurrents.n_AbByWheelAvg ZFFSAB._.GearRatioByCurrents.n_AbByWheelAvg_ ZFFSAB._.GearRatioByCurrents.n_TuVirtLev2 ZFFSAB._.GearRatioByCurrents.n_TuVirtLev2Sts ZFFSAB._.GearRatioByCurrents.n_TuVirtLev2Sts_ ZFFSAB._.GearRatioByCurrents.n_TuVirtLev2_ ZFFSAB._.GearRatioByCurrents.n_WheelAvgSts ZFFSAB._.GearRatioByCurrents.n_WheelAvgSts_ ZFFSAB._.GearRatioByCurrents.sts_n6_Dir ZFFSAB._.GearRatioByCurrents.sv_f_IAE_ReqSubst ZFFSAB._.GearRatioByCurrents.sv_n_EngLev2 ZFFSAB._.GearRatioByCurrents.sv_n_EngLev2Sts ZFFSAB._.GearRatioByCurrents.sv_n_EngLev2Sts_ ZFFSAB._.GearRatioByCurrents.sv_n_EngLev2_ ZFFSAB._.GearRatioByCurrents.sv_st_KL15 ZFFSAB._.GearRatioByCurrents.sv_st_KL15_ /end IN_MEASUREMENT
/end FUNCTION
/begin FUNCTION zf_SAB_GearRatioByCurrents_fl "desc_en"
 /begin IN_MEASUREMENT ZFFSAB._.GearRatioByCurrents.GearRatioByCurrents_fl.IstGang ZFFSAB._.GearRatioByCurrents.GearRatioByCurrents_fl.IstGangOld ZFFSAB._.GearRatioByCurrents.GearRatioByCurrents_fl.err_flags_old ZFFSAB._.GearRatioByCurrents.GearRatioByCurrents_fl.err_flags_old_ ZFFSAB._.GearRatioByCurrents.GearRatioByCurrents_fl.f_RearAxleRatioLearned ZFFSAB._.GearRatioByCurrents.GearRatioByCurrents_fl.f_RearAxleRatioLearned_ ZFFSAB._.GearRatioByCurrents.GearRatioByCurrents_fl.f_n6PlausiErr ZFFSAB._.GearRatioByCurrents.GearRatioByCurrents_fl.f_n6WheelErr ZFFSAB._.GearRatioByCurrents.GearRatioByCurrents_fl.f_n6nEngErr ZFFSAB._.GearRatioByCurrents.GearRatioByCurrents_fl.f_n_AbPlausiErr ZFFSAB._.GearRatioByCurrents.GearRatioByCurrents_fl.f_n_AbWheelErr ZFFSAB._.GearRatioByCurrents.GearRatioByCurrents_fl.f_n_Abn6Err ZFFSAB._.GearRatioByCurrents.GearRatioByCurrents_fl.f_n_PlausiErr ZFFSAB._.GearRatioByCurrents.GearRatioByCurrents_fl.f_n_TuVirtPlausiErr ZFFSAB._.GearRatioByCurrents.GearRatioByCurrents_fl.f_n_WheelPlausiErr ZFFSAB._.GearRatioByCurrents.GearRatioByCurrents_fl.f_xErrChanged ZFFSAB._.GearRatioByCurrents.GearRatioByCurrents_fl.iGang ZFFSAB._.GearRatioByCurrents.GearRatioByCurrents_fl.iv_ieds0 ZFFSAB._.GearRatioByCurrents.GearRatioByCurrents_fl.iv_ieds0_ ZFFSAB._.GearRatioByCurrents.GearRatioByCurrents_fl.iv_ieds1 ZFFSAB._.GearRatioByCurrents.GearRatioByCurrents_fl.iv_ieds1_ ZFFSAB._.GearRatioByCurrents.GearRatioByCurrents_fl.iv_ieds2 ZFFSAB._.GearRatioByCurrents.GearRatioByCurrents_fl.iv_ieds2_ ZFFSAB._.GearRatioByCurrents.GearRatioByCurrents_fl.iv_ieds3 ZFFSAB._.GearRatioByCurrents.GearRatioByCurrents_fl.iv_ieds3_ ZFFSAB._.GearRatioByCurrents.GearRatioByCurrents_fl.iv_ieds4 ZFFSAB._.GearRatioByCurrents.GearRatioByCurrents_fl.iv_ieds4_ ZFFSAB._.GearRatioByCurrents.GearRatioByCurrents_fl.iv_n6 ZFFSAB._.GearRatioByCurrents.GearRatioByCurrents_fl.iv_n6_ ZFFSAB._.GearRatioByCurrents.GearRatioByCurrents_fl.iv_n6_ESts ZFFSAB._.GearRatioByCurrents.GearRatioByCurrents_fl.iv_n6_ESts_ ZFFSAB._.GearRatioByCurrents.GearRatioByCurrents_fl.iv_n_Ab ZFFSAB._.GearRatioByCurrents.GearRatioByCurrents_fl.iv_n_AbESts ZFFSAB._.GearRatioByCurrents.GearRatioByCurrents_fl.iv_n_AbESts_ ZFFSAB._.GearRatioByCurrents.GearRatioByCurrents_fl.iv_n_Ab_ ZFFSAB._.GearRatioByCurrents.GearRatioByCurrents_fl.iv_n_Tu ZFFSAB._.GearRatioByCurrents.GearRatioByCurrents_fl.iv_n_Tu_ ZFFSAB._.GearRatioByCurrents.GearRatioByCurrents_fl.iv_sts_ClutchIAE ZFFSAB._.GearRatioByCurrents.GearRatioByCurrents_fl.iv_sts_n6_DirectionDiag ZFFSAB._.GearRatioByCurrents.GearRatioByCurrents_fl.iv_sts_n6_DirectionDiag_ ZFFSAB._.GearRatioByCurrents.GearRatioByCurrents_fl.n_AbByWheelAvg ZFFSAB._.GearRatioByCurrents.GearRatioByCurrents_fl.n_AbByWheelAvg_ ZFFSAB._.GearRatioByCurrents.GearRatioByCurrents_fl.n_TuVirtLev2 ZFFSAB._.GearRatioByCurrents.GearRatioByCurrents_fl.n_TuVirtLev2Sts ZFFSAB._.GearRatioByCurrents.GearRatioByCurrents_fl.n_TuVirtLev2_ ZFFSAB._.GearRatioByCurrents.GearRatioByCurrents_fl.n_WheelAvgSts ZFFSAB._.GearRatioByCurrents.GearRatioByCurrents_fl.n_WheelAvgSts_ ZFFSAB._.GearRatioByCurrents.GearRatioByCurrents_fl.sts_n6_Dir ZFFSAB._.GearRatioByCurrents.GearRatioByCurrents_fl.sv_f_IAE_ReqSubst ZFFSAB._.GearRatioByCurrents.GearRatioByCurrents_fl.sv_n_EngLev2 ZFFSAB._.GearRatioByCurrents.GearRatioByCurrents_fl.sv_n_EngLev2Sts ZFFSAB._.GearRatioByCurrents.GearRatioByCurrents_fl.sv_n_EngLev2Sts_ ZFFSAB._.GearRatioByCurrents.GearRatioByCurrents_fl.sv_n_EngLev2_ ZFFSAB._.GearRatioByCurrents.GearRatioByCurrents_fl.sv_st_KL15 ZFFSAB._.GearRatioByCurrents.GearRatioByCurrents_fl.sv_st_KL15_ /end IN_MEASUREMENT
/end FUNCTION
/begin FUNCTION zf_SAB_HDCIn "desc_en"
 /begin IN_MEASUREMENT ZFFSAB._.HDCIn.f_HDCErr ZFFSAB._.HDCIn.iv_HDC ZFFSAB._.HDCIn.iv_HDCSts ZFFSAB._.HDCIn.sv_HDC ZFFSAB._.HDCIn.sv_HDCSbe ZFFSAB._.HDCIn.sv_HDCSts /end IN_MEASUREMENT
/end FUNCTION
/begin FUNCTION zf_SAB_HybridControlIn "desc_en"
 /begin IN_MEASUREMENT ZFFSAB._.HybridControlIn.f_ST_TAR_CENGErr ZFFSAB._.HybridControlIn.f_ST_TAR_PENG_CENGErr ZFFSAB._.HybridControlIn.iv_Ablaufvariante_HAS ZFFSAB._.HybridControlIn.iv_Ablaufvariante_HASSts ZFFSAB._.HybridControlIn.iv_ST_TAR_CENG ZFFSAB._.HybridControlIn.iv_ST_TAR_CENGSts ZFFSAB._.HybridControlIn.iv_ST_TAR_PENG_CENG ZFFSAB._.HybridControlIn.iv_ST_TAR_PENG_CENGSts ZFFSAB._.HybridControlIn.iv_Startablauf ZFFSAB._.HybridControlIn.iv_st_EngineSpeedControlEM ZFFSAB._.HybridControlIn.iv_st_EngineSpeedControlEMSts ZFFSAB._.HybridControlIn.iv_st_EngineSpeedControlEMSts_ ZFFSAB._.HybridControlIn.iv_st_EngineSpeedControlEM_ ZFFSAB._.HybridControlIn.sv_Ablaufvariante_HAS ZFFSAB._.HybridControlIn.sv_STAT_Drv ZFFSAB._.HybridControlIn.sv_ST_TAR_CENG ZFFSAB._.HybridControlIn.sv_ST_TAR_CENGSts ZFFSAB._.HybridControlIn.sv_ST_TAR_PENG_CENG ZFFSAB._.HybridControlIn.sv_ST_TAR_PENG_CENGSts ZFFSAB._.HybridControlIn.sv_st_EngineSpeedControlEM ZFFSAB._.HybridControlIn.sv_st_EngineSpeedControlEMSts ZFFSAB._.HybridControlIn.sv_st_EngineSpeedControlEMSts_ ZFFSAB._.HybridControlIn.sv_st_EngineSpeedControlEM_ /end IN_MEASUREMENT
/end FUNCTION
/begin FUNCTION zf_SAB_HybridGearboxReadyToDriveIn "desc_en"
 /begin IN_MEASUREMENT ZFFSAB._.HybridGearboxReadyToDriveIn.f_SystemPressureFromEngineSpeed ZFFSAB._.HybridGearboxReadyToDriveIn.f_SystemPressureFromIEP ZFFSAB._.HybridGearboxReadyToDriveIn.iv_StateIEP ZFFSAB._.HybridGearboxReadyToDriveIn.sv_GearboxReadyToDrive ZFFSAB._.HybridGearboxReadyToDriveIn.sv_GearboxReadyToDriveSts ZFFSAB._.HybridGearboxReadyToDriveIn.sv_GearboxReadyToDriveSts_ ZFFSAB._.HybridGearboxReadyToDriveIn.sv_GearboxReadyToDrive_ /end IN_MEASUREMENT
/end FUNCTION
/begin FUNCTION zf_SAB_HybridOpModeEMIn "desc_en"
 /begin IN_MEASUREMENT ZFFSAB._.HybridOpModeEMIn.f_DmpEMErr ZFFSAB._.HybridOpModeEMIn.f_ModEMErr ZFFSAB._.HybridOpModeEMIn.iv_DmpEM ZFFSAB._.HybridOpModeEMIn.iv_DmpEMSts ZFFSAB._.HybridOpModeEMIn.iv_ModEM ZFFSAB._.HybridOpModeEMIn.iv_ModEMSts ZFFSAB._.HybridOpModeEMIn.sv_DmpEM ZFFSAB._.HybridOpModeEMIn.sv_DmpEMSts ZFFSAB._.HybridOpModeEMIn.sv_ModEM ZFFSAB._.HybridOpModeEMIn.sv_ModEMSts /end IN_MEASUREMENT
/end FUNCTION
/begin FUNCTION zf_SAB_HybridSignalsIn "desc_en"
 /begin IN_MEASUREMENT ZFFSAB._.HybridSignalsIn.f_AepReq ZFFSAB._.HybridSignalsIn.f_EgsReaktNRedErr ZFFSAB._.HybridSignalsIn.f_m_EngStartErr ZFFSAB._.HybridSignalsIn.f_n_SollEMErr ZFFSAB._.HybridSignalsIn.iv_AepReq ZFFSAB._.HybridSignalsIn.iv_AepReqSts ZFFSAB._.HybridSignalsIn.iv_EgsReaktNRed ZFFSAB._.HybridSignalsIn.iv_EgsReaktNRedSts ZFFSAB._.HybridSignalsIn.iv_STAT_Drv ZFFSAB._.HybridSignalsIn.iv_STAT_DrvSts ZFFSAB._.HybridSignalsIn.iv_Vor_Kurz_m_crsh_Max ZFFSAB._.HybridSignalsIn.iv_Vor_Kurz_m_crsh_MaxSts ZFFSAB._.HybridSignalsIn.iv_Vor_Kurz_m_crsh_Min ZFFSAB._.HybridSignalsIn.iv_Vor_Kurz_m_crsh_MinSts ZFFSAB._.HybridSignalsIn.iv_Vor_Lang_m_crsh_Max ZFFSAB._.HybridSignalsIn.iv_Vor_Lang_m_crsh_MaxSts ZFFSAB._.HybridSignalsIn.iv_Vor_Lang_m_crsh_Min ZFFSAB._.HybridSignalsIn.iv_Vor_Lang_m_crsh_MinSts ZFFSAB._.HybridSignalsIn.iv_Vor_m_Ant_Sum_Rekup_Max ZFFSAB._.HybridSignalsIn.iv_Vor_m_Ant_Sum_Rekup_MaxSts ZFFSAB._.HybridSignalsIn.iv_m_AntSumRekupGearb ZFFSAB._.HybridSignalsIn.iv_m_AntSumRekupGearbSts ZFFSAB._.HybridSignalsIn.iv_m_AntSumRekupMax ZFFSAB._.HybridSignalsIn.iv_m_AntSumRekupMaxSts ZFFSAB._.HybridSignalsIn.iv_m_AntSumSchleppUnten ZFFSAB._.HybridSignalsIn.iv_m_AntSumSchleppUntenSts ZFFSAB._.HybridSignalsIn.iv_m_EngStart ZFFSAB._.HybridSignalsIn.iv_m_EngStartSts ZFFSAB._.HybridSignalsIn.iv_n_SollEM ZFFSAB._.HybridSignalsIn.iv_n_SollEMSts ZFFSAB._.HybridSignalsIn.sv_AGS_AepReq ZFFSAB._.HybridSignalsIn.sv_AGS_EgsReaktNRed ZFFSAB._.HybridSignalsIn.sv_AGS_StatusAntriebFzg ZFFSAB._.HybridSignalsIn.sv_AepReqSts ZFFSAB._.HybridSignalsIn.sv_EgsReaktNRedSts ZFFSAB._.HybridSignalsIn.sv_Vor_Kurz_m_crsh_Max ZFFSAB._.HybridSignalsIn.sv_Vor_Kurz_m_crsh_Min ZFFSAB._.HybridSignalsIn.sv_Vor_Lang_m_crsh_Max ZFFSAB._.HybridSignalsIn.sv_Vor_Lang_m_crsh_Min ZFFSAB._.HybridSignalsIn.sv_Vor_m_Ant_Sum_Rekup_Max ZFFSAB._.HybridSignalsIn.sv_m_AntSumRekupGearb ZFFSAB._.HybridSignalsIn.sv_m_AntSumRekupMax ZFFSAB._.HybridSignalsIn.sv_m_AntSumSchleppUnten ZFFSAB._.HybridSignalsIn.sv_m_EngStart ZFFSAB._.HybridSignalsIn.sv_m_EngStartSts ZFFSAB._.HybridSignalsIn.sv_n_SollEM ZFFSAB._.HybridSignalsIn.sv_n_SollEMSts /end IN_MEASUREMENT
/end FUNCTION
/begin FUNCTION zf_SAB_HybridVehicleReadyToDriveIn "desc_en"
 /begin IN_MEASUREMENT ZFFSAB._.HybridVehicleReadyToDriveIn.VehicleReadyToDriveOld ZFFSAB._.HybridVehicleReadyToDriveIn.VehicleReadyToDriveOldSts ZFFSAB._.HybridVehicleReadyToDriveIn.f_ReqVehImdtVehRdyToDrvOff ZFFSAB._.HybridVehicleReadyToDriveIn.iv_ReqVehImdtVehRdyToDrvOff ZFFSAB._.HybridVehicleReadyToDriveIn.iv_ReqVehImdtVehRdyToDrvOffSts ZFFSAB._.HybridVehicleReadyToDriveIn.iv_STAT_Drv ZFFSAB._.HybridVehicleReadyToDriveIn.iv_STAT_DrvSts ZFFSAB._.HybridVehicleReadyToDriveIn.sv_VehicleReadyToDrive ZFFSAB._.HybridVehicleReadyToDriveIn.sv_VehicleReadyToDriveSts ZFFSAB._.HybridVehicleReadyToDriveInBPRAM.f_VehicleReadyToDriveInitPhase ZFFSAB._.HybridVehicleReadyToDriveInBPRAM.f_VehicleReadyToDriveInitPhase_ ZFFSAB._.HybridVehicleReadyToDriveInBPRAM.stc_VehicleReadyToDriveBPRAM ZFFSAB._.HybridVehicleReadyToDriveInBPRAM.stc_VehicleReadyToDriveBPRAM_ ZFFSAB._.HybridVehicleReadyToDriveInBPRAM.stc_VehicleReadyToDriveStsBPRAM ZFFSAB._.HybridVehicleReadyToDriveInBPRAM.stc_VehicleReadyToDriveStsBPRAM_ /end IN_MEASUREMENT
/end FUNCTION
/begin FUNCTION zf_SAB_IgnitionKeyStatusIn "desc_en"
 /begin IN_MEASUREMENT ZFFSAB._.IgnitionKeyStatusIn.f_KeyValidErr ZFFSAB._.IgnitionKeyStatusIn.iv_KeyValid ZFFSAB._.IgnitionKeyStatusIn.iv_KeyValidSts ZFFSAB._.IgnitionKeyStatusIn.sv_KeyValidSts ZFFSAB._.IgnitionKeyStatusIn.sv_f_KeyRemoteStart ZFFSAB._.IgnitionKeyStatusIn.sv_f_KeyValid /end IN_MEASUREMENT
/end FUNCTION
/begin FUNCTION zf_SAB_IgnitionStatusIn "desc_en"
 /begin IN_MEASUREMENT ZFFSAB._.AmbConditionsIn.iv_f_IgnOn ZFFSAB._.IgnitionStatusIn.IgnPlausiErr ZFFSAB._.IgnitionStatusIn.f_KL15 ZFFSAB._.IgnitionStatusIn.f_KL15Err ZFFSAB._.IgnitionStatusIn.f_Kl15_Pin ZFFSAB._.IgnitionStatusIn.iv_KL15 ZFFSAB._.IgnitionStatusIn.iv_KL15Sts ZFFSAB._.IgnitionStatusIn.iv_KL15Sts_ ZFFSAB._.IgnitionStatusIn.iv_KL15_ ZFFSAB._.IgnitionStatusIn.iv_KLDiv ZFFSAB._.IgnitionStatusIn.iv_KLDiv_ ZFFSAB._.IgnitionStatusIn.iv_t_System ZFFSAB._.IgnitionStatusIn.iv_u_Kl15_Pin ZFFSAB._.IgnitionStatusIn.st_IgnPlausiState ZFFSAB._.IgnitionStatusIn.st_IgnPlausiState_ ZFFSAB._.IgnitionStatusIn.sv_KL15 ZFFSAB._.IgnitionStatusIn.sv_KL15Sts ZFFSAB._.IgnitionStatusIn.sv_KL15Sts_ ZFFSAB._.IgnitionStatusIn.sv_KL15_ ZFFSAB._.IgnitionStatusIn.sv_f_IgnOn /end IN_MEASUREMENT
/end FUNCTION
/begin FUNCTION zf_SAB_InclinationIn "desc_en"
 /begin IN_MEASUREMENT ZFFSAB._.InclinationIn.f_SensErr ZFFSAB._.InclinationIn.iv_Sens ZFFSAB._.InclinationIn.iv_SensErr ZFFSAB._.InclinationIn.iv_SensSts ZFFSAB._.InclinationIn.sv_AGS_Acclivity ZFFSAB._.InclinationIn.sv_Sens ZFFSAB._.InclinationIn.sv_SensSts /end IN_MEASUREMENT
/end FUNCTION
/begin FUNCTION zf_SAB_Interfo "desc_en"
 /begin IN_MEASUREMENT ZFFSAB._.Interfo.arg_idx ZFFSAB._.Interfo.arg_idx_komp ZFFSAB._.Interfo.f_erase_infomemory /end IN_MEASUREMENT
/end FUNCTION
/begin FUNCTION zf_SAB_LayerAGS "desc_en"
 /begin IN_MEASUREMENT ZFFSAB._.LayerAGS.IstGangAGS ZFFSAB._.LayerAGS.SollGangMoeglich ZFFSAB._.LayerAGS.ZielGangAGS ZFFSAB._.LayerAGS.iv_AGS_DispRpmEngCrsh ZFFSAB._.LayerAGS.iv_AGS_EFahrKL ZFFSAB._.LayerAGS.iv_AGS_EFahrKLSts ZFFSAB._.LayerAGS.iv_AGS_EngStartTyp ZFFSAB._.LayerAGS.iv_AGS_EngStartTypSts ZFFSAB._.LayerAGS.iv_AGS_GWkFDyn ZFFSAB._.LayerAGS.iv_AGS_IdxGrbDyn ZFFSAB._.LayerAGS.iv_AGS_K0ZielZustand ZFFSAB._.LayerAGS.iv_AGS_MEm ZFFSAB._.LayerAGS.iv_AGS_MEmSts ZFFSAB._.LayerAGS.iv_AGS_MSA ZFFSAB._.LayerAGS.iv_AGS_RpmDynOut ZFFSAB._.LayerAGS.iv_AGS_ZGangSoll ZFFSAB._.LayerAGS.iv_AGS_ZK0Soll ZFFSAB._.LayerAGS.iv_AGS_ZkaIndex ZFFSAB._.LayerAGS.sv_AGS_CkbTout ZFFSAB._.LayerAGS.sv_AGS_EFahrKL ZFFSAB._.LayerAGS.sv_AGS_EngStartTyp ZFFSAB._.LayerAGS.sv_AGS_ForceHs ZFFSAB._.LayerAGS.sv_AGS_GangZielAgs ZFFSAB._.LayerAGS.sv_AGS_IstGang ZFFSAB._.LayerAGS.sv_AGS_K0IstZustand ZFFSAB._.LayerAGS.sv_AGS_K0ZielZustand ZFFSAB._.LayerAGS.sv_AGS_MEm ZFFSAB._.LayerAGS.sv_AGS_MTurbine ZFFSAB._.LayerAGS.sv_AGS_MsaAdaptRs ZFFSAB._.LayerAGS.sv_AGS_Pos ZFFSAB._.LayerAGS.sv_AGS_PosStat ZFFSAB._.LayerAGS.sv_AGS_PtDampgActive ZFFSAB._.LayerAGS.sv_AGS_RpmEngMax ZFFSAB._.LayerAGS.sv_AGS_ShiftDelay ZFFSAB._.LayerAGS.sv_AGS_SportGetriebe ZFFSAB._.LayerAGS.sv_AGS_VVehPlausi ZFFSAB._.LayerAGS.sv_AGS_ZGangSoll ZFFSAB._.LayerAGS.sv_AGS_ZHasIst ZFFSAB._.LayerAGS.sv_AGS_ZHasZiel ZFFSAB._.LayerAGS.sv_AGS_ZK0Soll ZFFSAB._.LayerAGS.sv_AGS_ZielGang ZFFSAB._.LayerAGS.sv_f_TrailerInfo_AGS /end IN_MEASUREMENT
/end FUNCTION
/begin FUNCTION zf_SAB_LDMDesiredTorqueIn "desc_en"
 /begin IN_MEASUREMENT ZFFSAB._.LDMDesiredTorqueIn.f_LDMModeErr ZFFSAB._.LDMDesiredTorqueIn.f_m_LDMErr ZFFSAB._.LDMDesiredTorqueIn.iv_FASMode ZFFSAB._.LDMDesiredTorqueIn.iv_FASModeSts ZFFSAB._.LDMDesiredTorqueIn.iv_m_LDM ZFFSAB._.LDMDesiredTorqueIn.iv_m_LDMSts ZFFSAB._.LDMDesiredTorqueIn.sv_LDMDynamic ZFFSAB._.LDMDesiredTorqueIn.sv_LDMDynamic2 ZFFSAB._.LDMDesiredTorqueIn.sv_LDMDynamic2Sts ZFFSAB._.LDMDesiredTorqueIn.sv_LDMDynamicSts ZFFSAB._.LDMDesiredTorqueIn.sv_LDMMode ZFFSAB._.LDMDesiredTorqueIn.sv_LDMModeSts ZFFSAB._.LDMDesiredTorqueIn.sv_m_LDM ZFFSAB._.LDMDesiredTorqueIn.sv_m_LDMSts /end IN_MEASUREMENT
/end FUNCTION
/begin FUNCTION zf_SAB_LowModeDriveIn "desc_en"
 /begin IN_MEASUREMENT ZFFSAB._.LowModeDriveIn.iv_LowMode ZFFSAB._.LowModeDriveIn.iv_LowModeFA ZFFSAB._.LowModeDriveIn.iv_LowModeFASts ZFFSAB._.LowModeDriveIn.iv_LowModeSts ZFFSAB._.LowModeDriveIn.sv_LowMode ZFFSAB._.LowModeDriveIn.sv_LowModeSts /end IN_MEASUREMENT
/end FUNCTION
/begin FUNCTION zf_SAB_MaxTorquePredictionEMIn "desc_en"
 /begin IN_MEASUREMENT ZFFSAB._.MaxTorquePredictionEMIn.f_m_maxPredEMErr ZFFSAB._.MaxTorquePredictionEMIn.f_m_minPredEMErr ZFFSAB._.MaxTorquePredictionEMIn.iv_m_MaxPredEM ZFFSAB._.MaxTorquePredictionEMIn.iv_m_MaxPredEMSts ZFFSAB._.MaxTorquePredictionEMIn.iv_m_MinPredEM ZFFSAB._.MaxTorquePredictionEMIn.iv_m_MinPredEMSts ZFFSAB._.MaxTorquePredictionEMIn.sv_m_MaxPredEM ZFFSAB._.MaxTorquePredictionEMIn.sv_m_MaxPredEMSts ZFFSAB._.MaxTorquePredictionEMIn.sv_m_MinPredEM ZFFSAB._.MaxTorquePredictionEMIn.sv_m_MinPredEMSts /end IN_MEASUREMENT
/end FUNCTION
/begin FUNCTION zf_SAB_MSAIn "desc_en"
 /begin IN_MEASUREMENT ZFFSAB._.MSAIn.f_HIS_gelernt ZFFSAB._.MSAIn.iv_STAT_MSA ZFFSAB._.MSAIn.iv_STAT_MSASts ZFFSAB._.MSAIn.sv_AGS_MsaStat ZFFSAB._.MSAIn.sv_DiOff ZFFSAB._.MSAIn.sv_DiOff_ ZFFSAB._.MSAIn.sv_f_HIS_verbaut /end IN_MEASUREMENT
/end FUNCTION
/begin FUNCTION zf_SAB_MSAOut "desc_en"
 /begin IN_MEASUREMENT ZFFSAB._.MSAOut.iv_StatusMSAHAS ZFFSAB._.MSAOut.sv_MSA_Rq_Hyb_Grb ZFFSAB._.MSAOut.sv_RqMSA_FnSlctn /end IN_MEASUREMENT
/end FUNCTION
/begin FUNCTION zf_SAB_OBD_CyclesIn "desc_en"
 /begin IN_MEASUREMENT ZFFSAB._.OBD_CyclesIn.f_OBD_CyclesInfoErr ZFFSAB._.OBD_CyclesIn.iv_OBD_CyclesInfo ZFFSAB._.OBD_CyclesIn.iv_OBD_CyclesInfoSts ZFFSAB._.OBD_CyclesIn.iv_u_Batt_Diag ZFFSAB._.OBD_CyclesIn.sv_OBD_CyclesInfoSts ZFFSAB._.OBD_CyclesIn.sv_OBD_DrivingCycle ZFFSAB._.OBD_CyclesIn.sv_OBD_NormedTrip ZFFSAB._.OBD_CyclesIn.sv_OBD_NormedTripB ZFFSAB._.OBD_CyclesIn.sv_OBD_WarmUpCycle /end IN_MEASUREMENT
/end FUNCTION
/begin FUNCTION zf_SAB_OSModeSwitchingOut "desc_en"
 /begin IN_MEASUREMENT ZFFSAB._.OSModeSwitchingOut.OSModeActive ZFFSAB._.OSModeSwitchingOut.OSModeNext ZFFSAB._.OSModeSwitchingOut.iv_n_Eng ZFFSAB._.OSModeSwitchingOut.iv_n_EngSts /end IN_MEASUREMENT
/end FUNCTION
/begin FUNCTION zf_SAB_ParkingBrakeIn "desc_en"
 /begin IN_MEASUREMENT ZFFSAB._.ParkingBrakeIn.iv_ParkingBrake ZFFSAB._.ParkingBrakeIn.iv_ParkingBrake1 ZFFSAB._.ParkingBrakeIn.iv_ParkingBrake1Sts ZFFSAB._.ParkingBrakeIn.iv_ParkingBrake2 ZFFSAB._.ParkingBrakeIn.iv_ParkingBrake2Sts ZFFSAB._.ParkingBrakeIn.iv_ParkingBrakeSts ZFFSAB._.ParkingBrakeIn.sv_ParkingBrakeSts ZFFSAB._.ParkingBrakeIn.sv_f_ParkingBrake /end IN_MEASUREMENT
/end FUNCTION
/begin FUNCTION zf_SAB_ParklockSensorIn "desc_en"
 /begin IN_MEASUREMENT ZFFSAB._.ParklockSensorIn.PSensFaultInfo ZFFSAB._.ParklockSensorIn.PSensFaultInfo_ ZFFSAB._.ParklockSensorIn.iv_PSens1 ZFFSAB._.ParklockSensorIn.iv_PSens1FaultInfo ZFFSAB._.ParklockSensorIn.iv_PSens1FaultInfo_ ZFFSAB._.ParklockSensorIn.iv_PSens1_ ZFFSAB._.ParklockSensorIn.iv_PSens2 ZFFSAB._.ParklockSensorIn.iv_PSens2FaultInfo ZFFSAB._.ParklockSensorIn.iv_PSens2FaultInfo_ ZFFSAB._.ParklockSensorIn.iv_PSens2_ ZFFSAB._.ParklockSensorIn.iv_u_SensESts ZFFSAB._.ParklockSensorIn.iv_u_SensESts_ ZFFSAB._.ParklockSensorIn.sv_PSens ZFFSAB._.ParklockSensorIn.sv_PSensSts ZFFSAB._.ParklockSensorIn.sv_PSensSts_ ZFFSAB._.ParklockSensorIn.sv_PSens_ /end IN_MEASUREMENT
/end FUNCTION
/begin FUNCTION zf_SAB_ParklockStatusIn "desc_en"
 /begin IN_MEASUREMENT ZFFSAB._.ParklockStatusIn.f_EmfPErr ZFFSAB._.ParklockStatusIn.iv_EmfP ZFFSAB._.ParklockStatusIn.iv_EmfPSts ZFFSAB._.ParklockStatusIn.sv_EmfP ZFFSAB._.ParklockStatusIn.sv_EmfPSts /end IN_MEASUREMENT
/end FUNCTION
/begin FUNCTION zf_SAB_ParkManeuverAssistant "desc_en"
 /begin IN_MEASUREMENT ZFFSAB._.ParkManeuverAssistant.FASModeRaw ZFFSAB._.ParkManeuverAssistant.FASModeRaw_ ZFFSAB._.ParkManeuverAssistant.f_FASBrakeErr ZFFSAB._.ParkManeuverAssistant.f_FASPosErr ZFFSAB._.ParkManeuverAssistant.f_PMAModeLearned ZFFSAB._.ParkManeuverAssistant.f_PMAModeLearned_ ZFFSAB._.ParkManeuverAssistant.iv_Brake ZFFSAB._.ParkManeuverAssistant.iv_BrakeSts ZFFSAB._.ParkManeuverAssistant.iv_BrakeSts_ ZFFSAB._.ParkManeuverAssistant.iv_Brake_ ZFFSAB._.ParkManeuverAssistant.iv_FASGearbox ZFFSAB._.ParkManeuverAssistant.iv_FASGearbox_ ZFFSAB._.ParkManeuverAssistant.iv_FASMode ZFFSAB._.ParkManeuverAssistant.iv_FASModeSts ZFFSAB._.ParkManeuverAssistant.iv_FASModeSts_ ZFFSAB._.ParkManeuverAssistant.iv_FASMode_ ZFFSAB._.ParkManeuverAssistant.iv_FASPos ZFFSAB._.ParkManeuverAssistant.iv_FASPosSts ZFFSAB._.ParkManeuverAssistant.iv_FASPosSts_ ZFFSAB._.ParkManeuverAssistant.iv_FASPos_ ZFFSAB._.ParkManeuverAssistant.sv_FASBrake ZFFSAB._.ParkManeuverAssistant.sv_FASBrakeSts ZFFSAB._.ParkManeuverAssistant.sv_FASBrakeSts_ ZFFSAB._.ParkManeuverAssistant.sv_FASBrake_ ZFFSAB._.ParkManeuverAssistant.sv_FASGearbox ZFFSAB._.ParkManeuverAssistant.sv_FASGearbox_ ZFFSAB._.ParkManeuverAssistant.sv_FASMode ZFFSAB._.ParkManeuverAssistant.sv_FASModeSts ZFFSAB._.ParkManeuverAssistant.sv_FASModeSts_ ZFFSAB._.ParkManeuverAssistant.sv_FASMode_ ZFFSAB._.ParkManeuverAssistant.sv_FASPos ZFFSAB._.ParkManeuverAssistant.sv_FASPosSts ZFFSAB._.ParkManeuverAssistant.sv_FASPosSts_ ZFFSAB._.ParkManeuverAssistant.sv_FASPos_ /end IN_MEASUREMENT
/end FUNCTION
/begin FUNCTION zf_SAB_PMA_ErrorHandling "desc_en"
 /begin IN_MEASUREMENT ZFFSAB._.PMA_ErrorHandling.f_PMA_Error ZFFSAB._.PMA_ErrorHandling.f_PMA_TestCondition ZFFSAB._.PMA_ErrorHandling.iv_Brake ZFFSAB._.PMA_ErrorHandling.iv_BrakeSts ZFFSAB._.PMA_ErrorHandling.iv_FASMode ZFFSAB._.PMA_ErrorHandling.iv_FASModeSts ZFFSAB._.PMA_ErrorHandling.iv_FASPos ZFFSAB._.PMA_ErrorHandling.iv_FASPosSts ZFFSAB._.PMA_ErrorHandling.iv_u_Batt_Diag /end IN_MEASUREMENT
/end FUNCTION
/begin FUNCTION zf_SAB_PowerdownIn "desc_en"
 /begin IN_MEASUREMENT ZFFSAB._.PowerdownIn.f_EeStoreAllowed ZFFSAB._.PowerdownIn.f_Iep_Shutdown ZFFSAB._.PowerdownIn.f_IgnitionOn ZFFSAB._.PowerdownIn.f_InternalWakeUp ZFFSAB._.PowerdownIn.f_RapidPowerShutdown ZFFSAB._.PowerdownIn.f_ResetByTester ZFFSAB._.PowerdownIn.iv_f_CanActive ZFFSAB._.PowerdownIn.iv_f_EeStoreInProgress ZFFSAB._.PowerdownIn.iv_f_PowDownEnable ZFFSAB._.PowerdownIn.iv_f_PowDownEnableAtsys ZFFSAB._.PowerdownIn.st_Powerdown ZFFSAB._.PowerdownIn.st_PowerdownMain ZFFSAB._.PowerdownIn.sv_f_CanComActive ZFFSAB._.PowerdownIn.sv_f_PowDownCondOk ZFFSAB._.PowerdownIn.sv_f_ShutDown /end IN_MEASUREMENT
/end FUNCTION
/begin FUNCTION zf_SAB_RearAxleRatioIn "desc_en"
 /begin IN_MEASUREMENT ZFFSAB._.RearAxleRatioIn.f_IgnitionOff2On ZFFSAB._.RearAxleRatioIn.iv_Pos ZFFSAB._.RearAxleRatioIn.iv_Pos_ ZFFSAB._.RearAxleRatioIn.sv_RearAxleRatio_Value ZFFSAB._.RearAxleRatioIn.sv_RearAxleRatio_ValueLearnedFlag ZFFSAB._.RearAxleRatioIn.sv_RearAxleRatio_ValueLearnedFlag_ ZFFSAB._.RearAxleRatioIn.sv_RearAxleRatio_ValueNumact /end IN_MEASUREMENT
/end FUNCTION
/begin FUNCTION zf_SAB_RegPartFilterIn "desc_en"
 /begin IN_MEASUREMENT ZFFSAB._.RegPartFilterIn.f_PartfiltAktivErr ZFFSAB._.RegPartFilterIn.iv_PartfiltAktiv ZFFSAB._.RegPartFilterIn.iv_PartfiltAktivSts ZFFSAB._.RegPartFilterIn.sv_PartfiltAktiv ZFFSAB._.RegPartFilterIn.sv_PartfiltAktivSts /end IN_MEASUREMENT
/end FUNCTION
/begin FUNCTION zf_SAB_RollPreventIn "desc_en"
 /begin IN_MEASUREMENT ZFFSAB._.RollPreventIn.FzgRollPreventActiveFilt ZFFSAB._.RollPreventIn.f_FzgRollPreventActiveErr ZFFSAB._.RollPreventIn.f_HillHolderOrAutoHoldactive ZFFSAB._.RollPreventIn.iv_Brake ZFFSAB._.RollPreventIn.iv_BrakeSts ZFFSAB._.RollPreventIn.iv_FzgRollPreventActive ZFFSAB._.RollPreventIn.iv_FzgRollPreventActive2 ZFFSAB._.RollPreventIn.iv_FzgRollPreventActive2Sts ZFFSAB._.RollPreventIn.iv_FzgRollPreventActiveSts ZFFSAB._.RollPreventIn.sv_FzgRollPreventActive ZFFSAB._.RollPreventIn.sv_FzgRollPreventActiveSts /end IN_MEASUREMENT
/end FUNCTION
/begin FUNCTION zf_SAB_RoutineControlUDS "desc_en"
 /begin IN_MEASUREMENT ZFFSAB._.RoutineControlUDS.AbortCustomerReason ZFFSAB._.RoutineControlUDS.f_ReadyToBSS_NOT_RUNNING ZFFSAB._.RoutineControlUDS.iv_PreadaptionCondition ZFFSAB._.RoutineControlUDS.iv_PreadaptionState ZFFSAB._.RoutineControlUDS.st_IEP_test ZFFSAB._.RoutineControlUDS.st_basicsettings ZFFSAB._.RoutineControlUDS.st_basicsettings_preadap ZFFSAB._.RoutineControlUDS.sv_EPumpCtrlByTester ZFFSAB._.RoutineControlUDS.sv_PreadaptionRequest /end IN_MEASUREMENT
/end FUNCTION
/begin FUNCTION zf_SAB_RPM_Diagnosis "desc_en"
 /begin IN_MEASUREMENT ZFFSAB._.RPM_Diagnosis.iv_u_Batt_Diag ZFFSAB._.RPM_Diagnosis.iv_u_SensESts ZFFSAB._.RPM_Diagnosis.iv_u_SensEStsRam ZFFSAB._.RPM_Diagnosis.iv_u_SensEStsRam_ ZFFSAB._.RPM_Diagnosis.iv_u_SensEStsRaw ZFFSAB._.RPM_Diagnosis.iv_u_SensEStsRaw_ ZFFSAB._.RPM_Diagnosis.iv_u_SensESts_ /end IN_MEASUREMENT
/end FUNCTION
/begin FUNCTION zf_SAB_RPM_SensingIn "desc_en"
 /begin IN_MEASUREMENT ZFFSAB._.RPM_SensingIn.Ab.St_RPMSensing ZFFSAB._.RPM_SensingIn.Ab.cnt_total_teeth ZFFSAB._.RPM_SensingIn.Ab.f_FirstVirtualCalc ZFFSAB._.RPM_SensingIn.Ab.f_NeverOnePulse ZFFSAB._.RPM_SensingIn.Ab.frq_SpeedSensor ZFFSAB._.RPM_SensingIn.Ab.iv_ESts ZFFSAB._.RPM_SensingIn.Ab.iv_PulseWidth ZFFSAB._.RPM_SensingIn.Ab.iv_f_Diag ZFFSAB._.RPM_SensingIn.Ab.iv_n_Pulses ZFFSAB._.RPM_SensingIn.Ab.iv_t_Pulses ZFFSAB._.RPM_SensingIn.Ab.iv_t_Pulses_old ZFFSAB._.RPM_SensingIn.Ab.k_nenner ZFFSAB._.RPM_SensingIn.Ab.k_zaehler ZFFSAB._.RPM_SensingIn.Ab.n_Offset ZFFSAB._.RPM_SensingIn.Ab.n_RPM ZFFSAB._.RPM_SensingIn.Ab.n_RPM_Old ZFFSAB._.RPM_SensingIn.Ab.n_RPM_min ZFFSAB._.RPM_SensingIn.Ab.n_Sts ZFFSAB._.RPM_SensingIn.Ab.sts_Direction ZFFSAB._.RPM_SensingIn.Ab.sts_DirectionDiag ZFFSAB._.RPM_SensingIn.Ab.sts_DirectionSts ZFFSAB._.RPM_SensingIn.Ab.sv_n_RPM ZFFSAB._.RPM_SensingIn.Ab.sv_n_Sts ZFFSAB._.RPM_SensingIn.Ab.sv_sts_Direction ZFFSAB._.RPM_SensingIn.Ab.sv_sts_DirectionSts ZFFSAB._.RPM_SensingIn.Tu.St_RPMSensing ZFFSAB._.RPM_SensingIn.Tu.cnt_total_teeth ZFFSAB._.RPM_SensingIn.Tu.f_FirstVirtualCalc ZFFSAB._.RPM_SensingIn.Tu.f_NeverOnePulse ZFFSAB._.RPM_SensingIn.Tu.frq_SpeedSensor ZFFSAB._.RPM_SensingIn.Tu.iv_ESts ZFFSAB._.RPM_SensingIn.Tu.iv_PulseWidth ZFFSAB._.RPM_SensingIn.Tu.iv_f_Diag ZFFSAB._.RPM_SensingIn.Tu.iv_n_Pulses ZFFSAB._.RPM_SensingIn.Tu.iv_t_Pulses ZFFSAB._.RPM_SensingIn.Tu.iv_t_Pulses_old ZFFSAB._.RPM_SensingIn.Tu.k_nenner ZFFSAB._.RPM_SensingIn.Tu.k_zaehler ZFFSAB._.RPM_SensingIn.Tu.n_Offset ZFFSAB._.RPM_SensingIn.Tu.n_RPM ZFFSAB._.RPM_SensingIn.Tu.n_RPM_Old ZFFSAB._.RPM_SensingIn.Tu.n_RPM_min ZFFSAB._.RPM_SensingIn.Tu.n_Sts ZFFSAB._.RPM_SensingIn.Tu.sts_Direction ZFFSAB._.RPM_SensingIn.Tu.sts_DirectionDiag ZFFSAB._.RPM_SensingIn.Tu.sts_DirectionSts ZFFSAB._.RPM_SensingIn.Tu.sv_n_RPM ZFFSAB._.RPM_SensingIn.Tu.sv_n_Sts ZFFSAB._.RPM_SensingIn.Tu.sv_sts_Direction ZFFSAB._.RPM_SensingIn.Tu.sv_sts_DirectionSts ZFFSAB._.RPM_SensingIn.f_first_init ZFFSAB._.RPM_SensingIn.iv_Pos ZFFSAB._.RPM_SensingIn.iv_PosSts /end IN_MEASUREMENT
/end FUNCTION
/begin FUNCTION zf_SAB_SensorSupplyMonitoring "desc_en"
 /begin IN_MEASUREMENT ZFFSAB._.SensorSupplyMonitoring.iv_u_Sens1ESts ZFFSAB._.SensorSupplyMonitoring.iv_u_Sens1ESts_ /end IN_MEASUREMENT
/end FUNCTION
/begin FUNCTION zf_SAB_ShiftlockRequestExternalIn "desc_en"
 /begin IN_MEASUREMENT ZFFSAB._.ShiftlockRequestExternalIn.f_PNErr ZFFSAB._.ShiftlockRequestExternalIn.iv_PN ZFFSAB._.ShiftlockRequestExternalIn.iv_PNSts ZFFSAB._.ShiftlockRequestExternalIn.sv_PNSts ZFFSAB._.ShiftlockRequestExternalIn.sv_f_PN /end IN_MEASUREMENT
/end FUNCTION
/begin FUNCTION zf_SAB_SpeedometerSpeedIn "desc_en"
 /begin IN_MEASUREMENT ZFFSAB._.SpeedometerSpeedIn.f_v_SpeedometerErr ZFFSAB._.SpeedometerSpeedIn.iv_v_Speedometer ZFFSAB._.SpeedometerSpeedIn.iv_v_SpeedometerSts ZFFSAB._.SpeedometerSpeedIn.sv_v_Speedometer ZFFSAB._.SpeedometerSpeedIn.sv_v_SpeedometerSts /end IN_MEASUREMENT
/end FUNCTION
/begin FUNCTION zf_SAB_SpeedPlausibilityIn "desc_en"
 /begin IN_MEASUREMENT ZFFSAB._.SpeedPlausibilityIn.f_n_AbGra_VUNPLAUSILEV2 ZFFSAB._.SpeedPlausibilityIn.sv_n_AbOld ZFFSAB._.SpeedPlausibilityIn.sv_n_Ab_plausibel ZFFSAB._.SpeedPlausibilityIn.sv_v_unplausi ZFFSAB._.SpeedPlausibilityIn.sv_v_unplausi_ ZFFSAB._.SpeedPlausibilityIn.v_unplausiOld /end IN_MEASUREMENT
/end FUNCTION
/begin FUNCTION zf_SAB_SportButtonIn "desc_en"
 /begin IN_MEASUREMENT ZFFSAB._.SportButtonIn.iv_DriveLogicRaw ZFFSAB._.SportButtonIn.iv_DriveLogicRawSts ZFFSAB._.SportButtonIn.iv_DriveLogicS1 ZFFSAB._.SportButtonIn.iv_DriveLogicS2 ZFFSAB._.SportButtonIn.iv_DriveLogicStsS1 ZFFSAB._.SportButtonIn.iv_DriveLogicStsS2 ZFFSAB._.SportButtonIn.iv_GWS_S_ButtonRaw ZFFSAB._.SportButtonIn.iv_GWS_S_ButtonRawSts ZFFSAB._.SportButtonIn.iv_GWS_S_ButtonS1 ZFFSAB._.SportButtonIn.iv_GWS_S_ButtonS2 ZFFSAB._.SportButtonIn.iv_GWS_S_ButtonStsS1 ZFFSAB._.SportButtonIn.iv_GWS_S_ButtonStsS2 ZFFSAB._.SportButtonIn.iv_ICM_S_ButtonRaw ZFFSAB._.SportButtonIn.iv_ICM_S_ButtonRawSts ZFFSAB._.SportButtonIn.sv_DriveDynamics ZFFSAB._.SportButtonIn.sv_DriveDynamicsSts ZFFSAB._.SportButtonIn.sv_DriveLogic ZFFSAB._.SportButtonIn.sv_SWI_GWS_Dlg ZFFSAB._.SportButtonIn.sv_SWI_GWS_S_Btn ZFFSAB._.SportButtonIn.sv_S_Button /end IN_MEASUREMENT
/end FUNCTION
/begin FUNCTION zf_SAB_SteeringWheelAngleIn "desc_en"
 /begin IN_MEASUREMENT ZFFSAB._.SteeringWheelAngleIn.f_SteerAngleErr ZFFSAB._.SteeringWheelAngleIn.iv_SteerAngle ZFFSAB._.SteeringWheelAngleIn.iv_SteerAngleErr ZFFSAB._.SteeringWheelAngleIn.iv_SteerAngleSts ZFFSAB._.SteeringWheelAngleIn.sv_AGS_LwVaEff ZFFSAB._.SteeringWheelAngleIn.sv_AGS_LwVaStat /end IN_MEASUREMENT
/end FUNCTION
/begin FUNCTION zf_SAB_SubstTempIn "desc_en"
 /begin IN_MEASUREMENT ZFFSAB._.SubstTempIn.PAK_counter_end ZFFSAB._.SubstTempIn.PAK_counter_end_ ZFFSAB._.SubstTempIn.PAK_counter_start ZFFSAB._.SubstTempIn.PAK_counter_start_ ZFFSAB._.SubstTempIn.iv_c_Chip1TransESts ZFFSAB._.SubstTempIn.iv_c_Chip2TransESts ZFFSAB._.SubstTempIn.iv_hot_modeLevel ZFFSAB._.SubstTempIn.iv_n_Eng ZFFSAB._.SubstTempIn.iv_n_EngSts /end IN_MEASUREMENT
/end FUNCTION
/begin FUNCTION zf_SAB_TempDiagnosis "desc_en"
 /begin IN_MEASUREMENT ZFFSAB._.TempDiagnosis_AT.PAK_counter_end ZFFSAB._.TempDiagnosis_AT.PAK_counter_end_ ZFFSAB._.TempDiagnosis_AT.PAK_counter_start ZFFSAB._.TempDiagnosis_AT.PAK_counter_start_ ZFFSAB._.TempDiagnosis_AT.c_OilTransCor ZFFSAB._.TempDiagnosis_AT.c_OilTransCorInt ZFFSAB._.TempDiagnosis_AT.c_OilTransCor_ ZFFSAB._.TempDiagnosis_AT.c_OilTrans_old ZFFSAB._.TempDiagnosis_AT.c_OilTrans_old_ ZFFSAB._.TempDiagnosis_AT.f_CChipdelta ZFFSAB._.TempDiagnosis_AT.f_CChipdelta_old ZFFSAB._.TempDiagnosis_AT.f_CChipdelta_old_ ZFFSAB._.TempDiagnosis_AT.f_CGT_Tolerance ZFFSAB._.TempDiagnosis_AT.f_c_CGT_JumpErr ZFFSAB._.TempDiagnosis_AT.f_c_CGT_JumpErr_old ZFFSAB._.TempDiagnosis_AT.f_c_CGT_JumpErr_old_ ZFFSAB._.TempDiagnosis_AT.f_c_CgtPlausiErr ZFFSAB._.TempDiagnosis_AT.f_c_CgtPlausiErr_ ZFFSAB._.TempDiagnosis_AT.f_c_Chip1CGT ZFFSAB._.TempDiagnosis_AT.f_c_Chip1Chip2 ZFFSAB._.TempDiagnosis_AT.f_c_Chip1PlausiErr ZFFSAB._.TempDiagnosis_AT.f_c_Chip2CGT ZFFSAB._.TempDiagnosis_AT.f_c_Chip2PlausiErr ZFFSAB._.TempDiagnosis_AT.f_c_Chip2PlausiErr_ ZFFSAB._.TempDiagnosis_AT.f_c_PlausiErr ZFFSAB._.TempDiagnosis_AT.f_c_PlausiErr_ ZFFSAB._.TempDiagnosis_AT.iv_c_Chip1Trans ZFFSAB._.TempDiagnosis_AT.iv_c_Chip1TransESts ZFFSAB._.TempDiagnosis_AT.iv_c_Chip2Trans ZFFSAB._.TempDiagnosis_AT.iv_c_Chip2TransESts ZFFSAB._.TempDiagnosis_AT.iv_c_Chip2Trans_old ZFFSAB._.TempDiagnosis_AT.iv_c_Chip2Trans_old_ ZFFSAB._.TempDiagnosis_AT.iv_c_OilTrans ZFFSAB._.TempDiagnosis_AT.iv_c_OilTransESts ZFFSAB._.TempDiagnosis_AT.iv_c_OilTransESts_old ZFFSAB._.TempDiagnosis_AT.iv_c_OilTransESts_old_ /end IN_MEASUREMENT
/end FUNCTION
/begin FUNCTION zf_SAB_TempDiagnosis_AT "desc_en"
 /begin IN_MEASUREMENT ZFFSAB._.GearboxTempIn.PAK_counter_end ZFFSAB._.GearboxTempIn.PAK_counter_end_ ZFFSAB._.GearboxTempIn.PAK_counter_start ZFFSAB._.GearboxTempIn.PAK_counter_start_ /end IN_MEASUREMENT
/end FUNCTION
/begin FUNCTION zf_SAB_TempDiagnosis_Fl "desc_en"
 /begin IN_MEASUREMENT ZFFSAB._.TempDiagnosis_AT.TempDiagnosis_AT_Fl.c_OilTransCor ZFFSAB._.TempDiagnosis_AT.TempDiagnosis_AT_Fl.c_OilTransCorInt ZFFSAB._.TempDiagnosis_AT.TempDiagnosis_AT_Fl.c_OilTrans_old ZFFSAB._.TempDiagnosis_AT.TempDiagnosis_AT_Fl.c_OilTrans_old_ ZFFSAB._.TempDiagnosis_AT.TempDiagnosis_AT_Fl.f_CChipdelta ZFFSAB._.TempDiagnosis_AT.TempDiagnosis_AT_Fl.f_CChipdelta_old ZFFSAB._.TempDiagnosis_AT.TempDiagnosis_AT_Fl.f_CChipdelta_old_ ZFFSAB._.TempDiagnosis_AT.TempDiagnosis_AT_Fl.f_CGT_Tolerance ZFFSAB._.TempDiagnosis_AT.TempDiagnosis_AT_Fl.f_c_CGT_JumpErr ZFFSAB._.TempDiagnosis_AT.TempDiagnosis_AT_Fl.f_c_CGT_JumpErr_old ZFFSAB._.TempDiagnosis_AT.TempDiagnosis_AT_Fl.f_c_CGT_JumpErr_old_ ZFFSAB._.TempDiagnosis_AT.TempDiagnosis_AT_Fl.f_c_CgtPlausiErr ZFFSAB._.TempDiagnosis_AT.TempDiagnosis_AT_Fl.f_c_Chip1CGT ZFFSAB._.TempDiagnosis_AT.TempDiagnosis_AT_Fl.f_c_Chip1Chip2 ZFFSAB._.TempDiagnosis_AT.TempDiagnosis_AT_Fl.f_c_Chip1PlausiErr ZFFSAB._.TempDiagnosis_AT.TempDiagnosis_AT_Fl.f_c_Chip2CGT ZFFSAB._.TempDiagnosis_AT.TempDiagnosis_AT_Fl.f_c_Chip2PlausiErr ZFFSAB._.TempDiagnosis_AT.TempDiagnosis_AT_Fl.f_c_PlausiErr ZFFSAB._.TempDiagnosis_AT.TempDiagnosis_AT_Fl.iv_c_Chip1Trans ZFFSAB._.TempDiagnosis_AT.TempDiagnosis_AT_Fl.iv_c_Chip1TransESts ZFFSAB._.TempDiagnosis_AT.TempDiagnosis_AT_Fl.iv_c_Chip2Trans ZFFSAB._.TempDiagnosis_AT.TempDiagnosis_AT_Fl.iv_c_Chip2TransESts ZFFSAB._.TempDiagnosis_AT.TempDiagnosis_AT_Fl.iv_c_Chip2Trans_old ZFFSAB._.TempDiagnosis_AT.TempDiagnosis_AT_Fl.iv_c_Chip2Trans_old_ ZFFSAB._.TempDiagnosis_AT.TempDiagnosis_AT_Fl.iv_c_OilTrans ZFFSAB._.TempDiagnosis_AT.TempDiagnosis_AT_Fl.iv_c_OilTransESts ZFFSAB._.TempDiagnosis_AT.TempDiagnosis_AT_Fl.iv_c_OilTransESts_old ZFFSAB._.TempDiagnosis_AT.TempDiagnosis_AT_Fl.iv_c_OilTransESts_old_ /end IN_MEASUREMENT
/end FUNCTION
/begin FUNCTION zf_SAB_TempExternIn "desc_en"
 /begin IN_MEASUREMENT ZFFSAB._.TempExternIn.f_c_AmbientErr ZFFSAB._.TempExternIn.iv_c_Ambient ZFFSAB._.TempExternIn.iv_c_AmbientSts ZFFSAB._.TempExternIn.sv_c_Ambient ZFFSAB._.TempExternIn.sv_c_AmbientSts /end IN_MEASUREMENT
/end FUNCTION
/begin FUNCTION zf_SAB_TimeEGSOffIn "desc_en"
 /begin IN_MEASUREMENT ZFFSAB._.TimeEGSOffIn.f_TimeEGSOffCalculated ZFFSAB._.TimeEGSOffIn.iv_Systime ZFFSAB._.TimeEGSOffIn.sv_TimeEGSOff ZFFSAB._.TimeEGSOffIn.sv_TimeEGSOffSts ZFFSAB._.TimeEGSOffIn.t_SystimeCurBuf ZFFSAB._.TimeEGSOffIn.t_SystimeOldBuf /end IN_MEASUREMENT
/end FUNCTION
/begin FUNCTION zf_SAB_Timer "desc_en"
 /begin IN_MEASUREMENT ZFFSAB._.BackToNormalFunctionViaReset.tmr_delay_Limphome.time ZFFSAB._.BackToNormalFunctionViaReset.tmr_delay_Limphome.time_ ZFFSAB._.BackToNormalFunctionViaReset.tmr_delay_LimphomeCnt.time ZFFSAB._.BackToNormalFunctionViaReset.tmr_delay_LimphomeCnt.time_ ZFFSAB._.GearBoxState.tmr_t_HssOff.time ZFFSAB._.GearBoxState.tmr_t_HssOff.time_ ZFFSAB._.GearRatioByCurrents.GearRatioByCurrents_fl.tmr_DiagDelayCurrentConst_LEV2.time ZFFSAB._.GearRatioByCurrents.GearRatioByCurrents_fl.tmr_DiagDelayCurrentConst_LEV2.time_ ZFFSAB._.GearRatioByCurrents.GearRatioByCurrents_fl.tmr_IAECloseDelay_LEV2.time ZFFSAB._.GearRatioByCurrents.GearRatioByCurrents_fl.tmr_IAECloseDelay_LEV2.time_ ZFFSAB._.GearRatioByCurrents.GearRatioByCurrents_fl.tmr_IAEClose_LEV2.time ZFFSAB._.GearRatioByCurrents.GearRatioByCurrents_fl.tmr_IAEClose_LEV2.time_ ZFFSAB._.GearRatioByCurrents.GearRatioByCurrents_fl.tmr_nTuVirtLev2Delay_LEV2.time ZFFSAB._.GearRatioByCurrents.GearRatioByCurrents_fl.tmr_nTuVirtLev2Delay_LEV2.time_ ZFFSAB._.GearRatioByCurrents.GearRatioByCurrents_fl.tmr_nTuVirtPlausiErrDelay_LEV2.time ZFFSAB._.GearRatioByCurrents.GearRatioByCurrents_fl.tmr_nTuVirtPlausiErrDelay_LEV2.time_ ZFFSAB._.GearRatioByCurrents.GearRatioByCurrents_fl.tmr_t_nDiagDelay_LEV2.time ZFFSAB._.GearRatioByCurrents.GearRatioByCurrents_fl.tmr_t_nDiagDelay_LEV2.time_ ZFFSAB._.GearRatioByCurrents.tmr_DiagDelayCurrentConst_LEV2.time ZFFSAB._.GearRatioByCurrents.tmr_DiagDelayCurrentConst_LEV2.time_ ZFFSAB._.GearRatioByCurrents.tmr_IAECloseDelay_LEV2.time ZFFSAB._.GearRatioByCurrents.tmr_IAECloseDelay_LEV2.time_ ZFFSAB._.GearRatioByCurrents.tmr_IAEClose_LEV2.time ZFFSAB._.GearRatioByCurrents.tmr_IAEClose_LEV2.time_ ZFFSAB._.GearRatioByCurrents.tmr_nTuVirtLev2Delay_LEV2.time ZFFSAB._.GearRatioByCurrents.tmr_nTuVirtLev2Delay_LEV2.time_ ZFFSAB._.GearRatioByCurrents.tmr_nTuVirtPlausiErrDelay_LEV2.time ZFFSAB._.GearRatioByCurrents.tmr_nTuVirtPlausiErrDelay_LEV2.time_ ZFFSAB._.GearRatioByCurrents.tmr_t_nDiagDelay_LEV2.time ZFFSAB._.GearRatioByCurrents.tmr_t_nDiagDelay_LEV2.time_ ZFFSAB._.GearboxTempIn.tmr_CGTPausi_CGTLEV2.time ZFFSAB._.GearboxTempIn.tmr_CGTPausi_CGTLEV2.time_ ZFFSAB._.IgnitionStatusIn.t_IgnTimer.time ZFFSAB._.IgnitionStatusIn.t_IgnTimer.time_ ZFFSAB._.IgnitionStatusIn.tmr_IgnPlausiDelay.time ZFFSAB._.IgnitionStatusIn.tmr_IgnPlausiDelay.time_ ZFFSAB._.IgnitionStatusIn.tmr_IgnPlausiTol.time ZFFSAB._.IgnitionStatusIn.tmr_IgnPlausiTol.time_ ZFFSAB._.ParklockSensorIn.tmr_PosZ.time ZFFSAB._.ParklockSensorIn.tmr_PosZ.time_ ZFFSAB._.RPM_Diagnosis.tmr_t_delay_1SENSORLEV2.time ZFFSAB._.RPM_Diagnosis.tmr_t_delay_1SENSORLEV2.time_ ZFFSAB._.RPM_Diagnosis.tmr_t_delay_N6LEV2.time ZFFSAB._.RPM_Diagnosis.tmr_t_delay_N6LEV2.time_ ZFFSAB._.RPM_Diagnosis.tmr_t_delay_N6PLAUSILEV2.time ZFFSAB._.RPM_Diagnosis.tmr_t_delay_N6PLAUSILEV2.time_ ZFFSAB._.RPM_Diagnosis.tmr_t_delay_NTUVIRTLEV2.time ZFFSAB._.RPM_Diagnosis.tmr_t_delay_NTUVIRTLEV2.time_ ZFFSAB._.RPM_Diagnosis.tmr_t_delay_SENSORLEV2.time ZFFSAB._.RPM_Diagnosis.tmr_t_delay_SENSORLEV2.time_ ZFFSAB._.RPM_SensingIn.Ab.t_n_Offset.time ZFFSAB._.RPM_SensingIn.Ab.t_n_Offset.time_ ZFFSAB._.RPM_SensingIn.Tu.t_n_Offset.time ZFFSAB._.RPM_SensingIn.Tu.t_n_Offset.time_ ZFFSAB._.RearAxleRatioIn.tmr_ForceLearnRearAxleRatio.time ZFFSAB._.RearAxleRatioIn.tmr_ForceLearnRearAxleRatio.time_ ZFFSAB._.RearAxleRatioIn.tmr_IG_HA_LearnDif.time ZFFSAB._.RearAxleRatioIn.tmr_IG_HA_LearnDif.time_ ZFFSAB._.SensorSupplyMonitoring.tmr_t_delay_USENS.time ZFFSAB._.SensorSupplyMonitoring.tmr_t_delay_USENS.time_ ZFFSAB._.SpeedPlausibilityIn.tmr_DelayBrake_VUNPLAUSILEV2.time ZFFSAB._.SpeedPlausibilityIn.tmr_DelayBrake_VUNPLAUSILEV2.time_ ZFFSAB._.SpeedPlausibilityIn.tmr_DelayDeactGra_VUNPLAUSILEV2.time ZFFSAB._.SpeedPlausibilityIn.tmr_DelayDeactGra_VUNPLAUSILEV2.time_ ZFFSAB._.SpeedPlausibilityIn.tmr_DelayGra_VUNPLAUSILEV2.time ZFFSAB._.SpeedPlausibilityIn.tmr_DelayGra_VUNPLAUSILEV2.time_ ZFFSAB._.SpeedPlausibilityIn.tmr_DelayTo_VUNPLAUSILEV2.time ZFFSAB._.SpeedPlausibilityIn.tmr_DelayTo_VUNPLAUSILEV2.time_ ZFFSAB._.TempDiagnosis_AT.TempDiagnosis_AT_Fl.cnt_ToleranceErr1.time ZFFSAB._.TempDiagnosis_AT.TempDiagnosis_AT_Fl.cnt_ToleranceErr1.time_ ZFFSAB._.TempDiagnosis_AT.TempDiagnosis_AT_Fl.cnt_ToleranceErr2.time ZFFSAB._.TempDiagnosis_AT.TempDiagnosis_AT_Fl.cnt_ToleranceErr2.time_ ZFFSAB._.TempDiagnosis_AT.TempDiagnosis_AT_Fl.tmr_DiagDelay.time ZFFSAB._.TempDiagnosis_AT.TempDiagnosis_AT_Fl.tmr_DiagDelay.time_ ZFFSAB._.TempDiagnosis_AT.TempDiagnosis_AT_Fl.tmr_TolCheck_CGTLEV2.time ZFFSAB._.TempDiagnosis_AT.TempDiagnosis_AT_Fl.tmr_TolCheck_CGTLEV2.time_ ZFFSAB._.TempDiagnosis_AT.cnt_ToleranceErr1.time ZFFSAB._.TempDiagnosis_AT.cnt_ToleranceErr1.time_ ZFFSAB._.TempDiagnosis_AT.cnt_ToleranceErr2.time ZFFSAB._.TempDiagnosis_AT.cnt_ToleranceErr2.time_ ZFFSAB._.TempDiagnosis_AT.tmr_DiagDelay.time ZFFSAB._.TempDiagnosis_AT.tmr_DiagDelay.time_ ZFFSAB._.TempDiagnosis_AT.tmr_TolCheck_CGTLEV2.time ZFFSAB._.TempDiagnosis_AT.tmr_TolCheck_CGTLEV2.time_ ZFFSAB._.TransmissionOutputSpeedIn.TransmissionOutputSpeedIn_Fl.tmr_DelayNAbMaxCalc.time ZFFSAB._.TransmissionOutputSpeedIn.TransmissionOutputSpeedIn_Fl.tmr_DelayNAbMaxCalc.time_ ZFFSAB._.TransmissionOutputSpeedIn.tmr_DelayNAbMaxCalc.time ZFFSAB._.TransmissionOutputSpeedIn.tmr_DelayNAbMaxCalc.time_ ZFFSAB._.TransmissionOutputSpeedIn.tmr_nAbFiltAktiv.time ZFFSAB._.TransmissionOutputSpeedIn.tmr_nAbFiltAktiv.time_ ZFFSAB._.TurbineSpeedIn.tmr_Delay_TurbineSpeedTx.time ZFFSAB._.TurbineSpeedIn.tmr_Delay_TurbineSpeedTx.time_ ZFFSAB._.TurbineSpeedIn.tmr_nTuFiltAktiv.time ZFFSAB._.TurbineSpeedIn.tmr_nTuFiltAktiv.time_ ZFFSAB._.TurbineSpeedIn.tmr_nTuFiltAktiv2ndPath.time ZFFSAB._.TurbineSpeedIn.tmr_nTuFiltAktiv2ndPath.time_ ZFFSAB._.VehicleSpeedIn.VehicleSpeedInFL.tmr_DelayVIstMaxCalc.time ZFFSAB._.VehicleSpeedIn.VehicleSpeedInFL.tmr_DelayVIstMaxCalc.time_ ZFFSAB._.VehicleSpeedIn.tmr_DelayVIstMaxCalc.time ZFFSAB._.VehicleSpeedIn.tmr_DelayVIstMaxCalc.time_ /end IN_MEASUREMENT
/end FUNCTION
/begin FUNCTION zf_SAB_TipTasterIn "desc_en"
 /begin IN_MEASUREMENT ZFFSAB._.TipTasterIn.Analog.f_TipErr ZFFSAB._.TipTasterIn.Analog.f_TipMinus ZFFSAB._.TipTasterIn.Analog.f_TipMinusErr ZFFSAB._.TipTasterIn.Analog.f_TipPlus ZFFSAB._.TipTasterIn.Analog.f_TipPlusErr ZFFSAB._.TipTasterIn.Analog.iv_Tip ZFFSAB._.TipTasterIn.Analog.iv_TipSts ZFFSAB._.TipTasterIn.Analog.iv_f_TipMinus ZFFSAB._.TipTasterIn.Analog.iv_f_TipMinusSts ZFFSAB._.TipTasterIn.Analog.iv_f_TipPlus ZFFSAB._.TipTasterIn.Analog.iv_f_TipPlusSts ZFFSAB._.TipTasterIn.CAN.f_TipErr ZFFSAB._.TipTasterIn.CAN.f_TipMinus ZFFSAB._.TipTasterIn.CAN.f_TipMinusErr ZFFSAB._.TipTasterIn.CAN.f_TipPlus ZFFSAB._.TipTasterIn.CAN.f_TipPlusErr ZFFSAB._.TipTasterIn.CAN.iv_Tip ZFFSAB._.TipTasterIn.CAN.iv_TipSts ZFFSAB._.TipTasterIn.CAN.iv_f_TipMinus ZFFSAB._.TipTasterIn.CAN.iv_f_TipMinusSts ZFFSAB._.TipTasterIn.CAN.iv_f_TipPlus ZFFSAB._.TipTasterIn.CAN.iv_f_TipPlusSts ZFFSAB._.TipTasterIn.Out[0].f_TipMinus ZFFSAB._.TipTasterIn.Out[0].f_TipMinusErr ZFFSAB._.TipTasterIn.Out[0].f_TipPlus ZFFSAB._.TipTasterIn.Out[0].f_TipPlusErr ZFFSAB._.TipTasterIn.Out[0].sv_f_TipMinusErr ZFFSAB._.TipTasterIn.Out[0].sv_f_TipMinusRaw ZFFSAB._.TipTasterIn.Out[0].sv_f_TipPlusErr ZFFSAB._.TipTasterIn.Out[0].sv_f_TipPlusRaw ZFFSAB._.TipTasterIn.Out[1].f_TipMinus ZFFSAB._.TipTasterIn.Out[1].f_TipMinusErr ZFFSAB._.TipTasterIn.Out[1].f_TipPlus ZFFSAB._.TipTasterIn.Out[1].f_TipPlusErr ZFFSAB._.TipTasterIn.Out[1].sv_f_TipMinusErr ZFFSAB._.TipTasterIn.Out[1].sv_f_TipMinusRaw ZFFSAB._.TipTasterIn.Out[1].sv_f_TipPlusErr ZFFSAB._.TipTasterIn.Out[1].sv_f_TipPlusRaw ZFFSAB._.TipTasterIn.SBW.f_TipErr ZFFSAB._.TipTasterIn.SBW.f_TipMinus ZFFSAB._.TipTasterIn.SBW.f_TipMinusErr ZFFSAB._.TipTasterIn.SBW.f_TipPlus ZFFSAB._.TipTasterIn.SBW.f_TipPlusErr ZFFSAB._.TipTasterIn.SBW.iv_Tip ZFFSAB._.TipTasterIn.SBW.iv_TipSts ZFFSAB._.TipTasterIn.SBW.iv_f_TipMinus ZFFSAB._.TipTasterIn.SBW.iv_f_TipMinusSts ZFFSAB._.TipTasterIn.SBW.iv_f_TipPlus ZFFSAB._.TipTasterIn.SBW.iv_f_TipPlusSts ZFFSAB._.TipTasterIn.iv_u_Batt_Diag ZFFSAB._.TipTasterIn.sv_f_Tip1MinusRaw ZFFSAB._.TipTasterIn.sv_f_Tip1PlusRaw ZFFSAB._.TipTasterIn.sv_f_Tip2MinusRaw ZFFSAB._.TipTasterIn.sv_f_Tip2PlusRaw /end IN_MEASUREMENT
/end FUNCTION
/begin FUNCTION zf_SAB_TorqueReserveIn "desc_en"
 /begin IN_MEASUREMENT ZFFSAB._.TorqueReserveIn.f_m_ReserveErr ZFFSAB._.TorqueReserveIn.iv_m_Reserve ZFFSAB._.TorqueReserveIn.iv_m_ReserveSts ZFFSAB._.TorqueReserveIn.sv_m_Reserve ZFFSAB._.TorqueReserveIn.sv_m_ReserveSts /end IN_MEASUREMENT
/end FUNCTION
/begin FUNCTION zf_SAB_TractionControlIn "desc_en"
 /begin IN_MEASUREMENT ZFFSAB._.TractionControlIn.f_EingriffTraktionErr ZFFSAB._.TractionControlIn.iv_EingriffTraktion ZFFSAB._.TractionControlIn.iv_EingriffTraktionSts ZFFSAB._.TractionControlIn.sv_AGS_EingriffTraktion ZFFSAB._.TractionControlIn.sv_EingriffTraktionSts /end IN_MEASUREMENT
/end FUNCTION
/begin FUNCTION zf_SAB_TransmissionOutputSpeedIn "desc_en"
 /begin IN_MEASUREMENT ZFFSAB._.TransmissionOutputSpeedIn.Ab_f_DirectionErr ZFFSAB._.TransmissionOutputSpeedIn.TransmissionOutputSpeedIn_Fl.f_n_AbPlausiErr ZFFSAB._.TransmissionOutputSpeedIn.TransmissionOutputSpeedIn_Fl.f_n_AbWheelErr ZFFSAB._.TransmissionOutputSpeedIn.TransmissionOutputSpeedIn_Fl.f_n_WheelPlausiErr ZFFSAB._.TransmissionOutputSpeedIn.TransmissionOutputSpeedIn_Fl.iGang ZFFSAB._.TransmissionOutputSpeedIn.TransmissionOutputSpeedIn_Fl.iv_n_Ab ZFFSAB._.TransmissionOutputSpeedIn.TransmissionOutputSpeedIn_Fl.iv_n_AbESts ZFFSAB._.TransmissionOutputSpeedIn.TransmissionOutputSpeedIn_Fl.iv_n_AbESts_ ZFFSAB._.TransmissionOutputSpeedIn.TransmissionOutputSpeedIn_Fl.iv_n_Ab_ ZFFSAB._.TransmissionOutputSpeedIn.TransmissionOutputSpeedIn_Fl.iv_u_SensESts ZFFSAB._.TransmissionOutputSpeedIn.TransmissionOutputSpeedIn_Fl.iv_u_SensESts_ ZFFSAB._.TransmissionOutputSpeedIn.TransmissionOutputSpeedIn_Fl.loc_RearAxleRatio ZFFSAB._.TransmissionOutputSpeedIn.TransmissionOutputSpeedIn_Fl.n_AbByNWheel ZFFSAB._.TransmissionOutputSpeedIn.TransmissionOutputSpeedIn_Fl.n_WheelAvg ZFFSAB._.TransmissionOutputSpeedIn.TransmissionOutputSpeedIn_Fl.n_WheelAvgSts ZFFSAB._.TransmissionOutputSpeedIn.TransmissionOutputSpeedIn_Fl.sv_n_Ab ZFFSAB._.TransmissionOutputSpeedIn.TransmissionOutputSpeedIn_Fl.sv_n_AbMax ZFFSAB._.TransmissionOutputSpeedIn.TransmissionOutputSpeedIn_Fl.sv_n_AbMaxSts ZFFSAB._.TransmissionOutputSpeedIn.TransmissionOutputSpeedIn_Fl.sv_n_AbSts ZFFSAB._.TransmissionOutputSpeedIn.f_n_AbPlausiErr ZFFSAB._.TransmissionOutputSpeedIn.f_n_AbPlausiErr_ ZFFSAB._.TransmissionOutputSpeedIn.f_n_AbWheelErr ZFFSAB._.TransmissionOutputSpeedIn.f_n_WheelPlausiErr ZFFSAB._.TransmissionOutputSpeedIn.iGang ZFFSAB._.TransmissionOutputSpeedIn.iv_n_Ab ZFFSAB._.TransmissionOutputSpeedIn.iv_n_AbESts ZFFSAB._.TransmissionOutputSpeedIn.iv_n_AbESts_ ZFFSAB._.TransmissionOutputSpeedIn.iv_n_Ab_ ZFFSAB._.TransmissionOutputSpeedIn.iv_u_SensESts ZFFSAB._.TransmissionOutputSpeedIn.iv_u_SensESts_ ZFFSAB._.TransmissionOutputSpeedIn.loc_RearAxleRatio ZFFSAB._.TransmissionOutputSpeedIn.n_AbByNWheel ZFFSAB._.TransmissionOutputSpeedIn.n_AbFilt_CAN ZFFSAB._.TransmissionOutputSpeedIn.n_AbFilt_CAN_ ZFFSAB._.TransmissionOutputSpeedIn.n_WheelAvg ZFFSAB._.TransmissionOutputSpeedIn.n_WheelAvgSts ZFFSAB._.TransmissionOutputSpeedIn.sv_n_Ab ZFFSAB._.TransmissionOutputSpeedIn.sv_n_AbFilt ZFFSAB._.TransmissionOutputSpeedIn.sv_n_AbMax ZFFSAB._.TransmissionOutputSpeedIn.sv_n_AbMaxSts ZFFSAB._.TransmissionOutputSpeedIn.sv_n_AbMaxSts_ ZFFSAB._.TransmissionOutputSpeedIn.sv_n_AbMax_ ZFFSAB._.TransmissionOutputSpeedIn.sv_n_AbSts ZFFSAB._.TransmissionOutputSpeedIn.sv_n_AbSts_ ZFFSAB._.TransmissionOutputSpeedIn.sv_n_Ab_ ZFFSAB._.TransmissionOutputSpeedIn.sv_n_Ab_Tx ZFFSAB._.TransmissionOutputSpeedIn.sv_n_Ab_Tx_ /end IN_MEASUREMENT
/end FUNCTION
/begin FUNCTION zf_SAB_TurbineSpeedIn "desc_en"
 /begin IN_MEASUREMENT ZFFSAB._.TurbineSpeedIn.Ab_sts_DirectionDiag ZFFSAB._.TurbineSpeedIn.Tu_f_DirectionErr ZFFSAB._.TurbineSpeedIn.Tu_sts_DirectionDiag ZFFSAB._.TurbineSpeedIn.TurbineSpeedIn_Fl.Tu_f_DirectionErr ZFFSAB._.TurbineSpeedIn.TurbineSpeedIn_Fl.f_OverallPlausiState ZFFSAB._.TurbineSpeedIn.TurbineSpeedIn_Fl.f_n_TuPlausiErr ZFFSAB._.TurbineSpeedIn.TurbineSpeedIn_Fl.f_n_Tu_PlausiErr_active ZFFSAB._.TurbineSpeedIn.TurbineSpeedIn_Fl.f_n_Tu_PlausiErr_active_ ZFFSAB._.TurbineSpeedIn.TurbineSpeedIn_Fl.iv_n_Tu ZFFSAB._.TurbineSpeedIn.TurbineSpeedIn_Fl.iv_n_TuESts ZFFSAB._.TurbineSpeedIn.TurbineSpeedIn_Fl.iv_n_TuESts_ ZFFSAB._.TurbineSpeedIn.TurbineSpeedIn_Fl.iv_n_Tu_ ZFFSAB._.TurbineSpeedIn.TurbineSpeedIn_Fl.iv_u_SensESts ZFFSAB._.TurbineSpeedIn.TurbineSpeedIn_Fl.iv_u_SensESts_ ZFFSAB._.TurbineSpeedIn.TurbineSpeedIn_Fl.n_EngLev2TSI ZFFSAB._.TurbineSpeedIn.TurbineSpeedIn_Fl.n_EngLev2TSISts ZFFSAB._.TurbineSpeedIn.TurbineSpeedIn_Fl.n_Tu_Filt2 ZFFSAB._.TurbineSpeedIn.TurbineSpeedIn_Fl.n_Tu_Filt_CAN ZFFSAB._.TurbineSpeedIn.TurbineSpeedIn_Fl.n_Tu_detected ZFFSAB._.TurbineSpeedIn.TurbineSpeedIn_Fl.sv_n_TuLev2 ZFFSAB._.TurbineSpeedIn.TurbineSpeedIn_Fl.sv_n_TuLev2Sts ZFFSAB._.TurbineSpeedIn.f_OverallPlausiState ZFFSAB._.TurbineSpeedIn.f_n_TuPlausiErr ZFFSAB._.TurbineSpeedIn.f_n_Tu_PlausiErr_active ZFFSAB._.TurbineSpeedIn.f_n_Tu_PlausiErr_active_ ZFFSAB._.TurbineSpeedIn.iv_n_Tu ZFFSAB._.TurbineSpeedIn.iv_n_TuESts ZFFSAB._.TurbineSpeedIn.iv_n_TuESts_ ZFFSAB._.TurbineSpeedIn.iv_n_Tu_ ZFFSAB._.TurbineSpeedIn.iv_u_SensESts ZFFSAB._.TurbineSpeedIn.iv_u_SensESts_ ZFFSAB._.TurbineSpeedIn.n_EngLev2TSI ZFFSAB._.TurbineSpeedIn.n_EngLev2TSISts ZFFSAB._.TurbineSpeedIn.n_EngLev2TSISts_ ZFFSAB._.TurbineSpeedIn.n_EngLev2TSI_ ZFFSAB._.TurbineSpeedIn.n_TuSts_ ZFFSAB._.TurbineSpeedIn.n_Tu_ ZFFSAB._.TurbineSpeedIn.n_Tu_Filt2 ZFFSAB._.TurbineSpeedIn.n_Tu_Filt2_ ZFFSAB._.TurbineSpeedIn.n_Tu_Filt_CAN ZFFSAB._.TurbineSpeedIn.n_Tu_Filt_CAN_ ZFFSAB._.TurbineSpeedIn.n_Tu_detected ZFFSAB._.TurbineSpeedIn.n_Tu_detected_ ZFFSAB._.TurbineSpeedIn.sv_Tu_sts_Direction ZFFSAB._.TurbineSpeedIn.sv_Tu_sts_DirectionSts ZFFSAB._.TurbineSpeedIn.sv_n_Tu ZFFSAB._.TurbineSpeedIn.sv_n_TuFilt ZFFSAB._.TurbineSpeedIn.sv_n_TuLev2 ZFFSAB._.TurbineSpeedIn.sv_n_TuLev2Sts ZFFSAB._.TurbineSpeedIn.sv_n_TuLev2Sts_ ZFFSAB._.TurbineSpeedIn.sv_n_TuLev2_ ZFFSAB._.TurbineSpeedIn.sv_n_TuSts ZFFSAB._.TurbineSpeedIn.sv_n_Tu_Tx ZFFSAB._.TurbineSpeedIn.sv_n_Tu_Tx_ /end IN_MEASUREMENT
/end FUNCTION
/begin FUNCTION zf_SAB_TurbineSpeedVirtualIn "desc_en"
 /begin IN_MEASUREMENT ZFFSAB._.TurbineSpeedVirtualIn.SF_n4_ig ZFFSAB._.TurbineSpeedVirtualIn.SF_n4_zg ZFFSAB._.TurbineSpeedVirtualIn.f_gangnachfuehrung_aktiv ZFFSAB._.TurbineSpeedVirtualIn.f_nulldurchgang_sv_n_Dif_IAE ZFFSAB._.TurbineSpeedVirtualIn.i_IstGang ZFFSAB._.TurbineSpeedVirtualIn.i_ZielGang ZFFSAB._.TurbineSpeedVirtualIn.iv_ActualGear ZFFSAB._.TurbineSpeedVirtualIn.iv_Pos ZFFSAB._.TurbineSpeedVirtualIn.iv_TargetGearInfo ZFFSAB._.TurbineSpeedVirtualIn.iv_in_Gear ZFFSAB._.TurbineSpeedVirtualIn.iv_kraftschluss ZFFSAB._.TurbineSpeedVirtualIn.iv_n6 ZFFSAB._.TurbineSpeedVirtualIn.iv_n6TuVirtFilt ZFFSAB._.TurbineSpeedVirtualIn.iv_n6TuVirtFiltSync ZFFSAB._.TurbineSpeedVirtualIn.iv_n6_Dir ZFFSAB._.TurbineSpeedVirtualIn.iv_st_IAE ZFFSAB._.TurbineSpeedVirtualIn.iv_z_modus_IAE ZFFSAB._.TurbineSpeedVirtualIn.k_n6 ZFFSAB._.TurbineSpeedVirtualIn.k_nab ZFFSAB._.TurbineSpeedVirtualIn.k_nmot ZFFSAB._.TurbineSpeedVirtualIn.n_TuVirtOptSts ZFFSAB._.TurbineSpeedVirtualIn.pos_fl ZFFSAB._.TurbineSpeedVirtualIn.sv_n6 ZFFSAB._.TurbineSpeedVirtualIn.sv_n6_Sts ZFFSAB._.TurbineSpeedVirtualIn.sv_n_AbTuVirtFilt ZFFSAB._.TurbineSpeedVirtualIn.sv_n_AbTuVirtFiltSync ZFFSAB._.TurbineSpeedVirtualIn.sv_n_Ab_Dir ZFFSAB._.TurbineSpeedVirtualIn.sv_n_Dif_IAE ZFFSAB._.TurbineSpeedVirtualIn.sv_n_Dif_IAEFilt ZFFSAB._.TurbineSpeedVirtualIn.sv_n_Dif_IAEOpt ZFFSAB._.TurbineSpeedVirtualIn.sv_n_Dif_IAE_Dir ZFFSAB._.TurbineSpeedVirtualIn.sv_n_Dif_IAE_Dir_alt ZFFSAB._.TurbineSpeedVirtualIn.sv_n_Dif_IAE_virt ZFFSAB._.TurbineSpeedVirtualIn.sv_n_Dif_IAE_virt_Dir ZFFSAB._.TurbineSpeedVirtualIn.sv_n_Dif_IAE_virt_DirSts ZFFSAB._.TurbineSpeedVirtualIn.sv_n_Dif_IAE_virt_Dir_alt ZFFSAB._.TurbineSpeedVirtualIn.sv_n_EngTuVirtFilt ZFFSAB._.TurbineSpeedVirtualIn.sv_n_EngTuVirtFiltSync ZFFSAB._.TurbineSpeedVirtualIn.sv_n_TuVirt ZFFSAB._.TurbineSpeedVirtualIn.sv_n_TuVirtOpt ZFFSAB._.TurbineSpeedVirtualIn.sv_n_TuVirtVz ZFFSAB._.TurbineSpeedVirtualIn.sv_n_TuVirtVzFilt ZFFSAB._.TurbineSpeedVirtualIn.sv_n_TuVirt_Dir /end IN_MEASUREMENT
/end FUNCTION
/begin FUNCTION zf_SAB_TurbineTorqueIn "desc_en"
 /begin IN_MEASUREMENT ZFFSAB._.TurbineTorqueIn.dc_TrqFaultInfo ZFFSAB._.TurbineTorqueIn.iv_dc_Trq ZFFSAB._.TurbineTorqueIn.iv_dc_TrqESts ZFFSAB._.TurbineTorqueIn.sv_dc_MotTrq ZFFSAB._.TurbineTorqueIn.sv_dc_MotTrqSts /end IN_MEASUREMENT
/end FUNCTION
/begin FUNCTION zf_SAB_VehicleSpeedIn "desc_en"
 /begin IN_MEASUREMENT ZFFSAB._.VehicleSpeedIn.VehicleSpeedInFL.iv_u_SensESts ZFFSAB._.VehicleSpeedIn.VehicleSpeedInFL.n_WheelAvg ZFFSAB._.VehicleSpeedIn.VehicleSpeedInFL.n_WheelAvgSts ZFFSAB._.VehicleSpeedIn.VehicleSpeedInFL.sv_v_FzgByNab ZFFSAB._.VehicleSpeedIn.VehicleSpeedInFL.sv_v_FzgByNabSts ZFFSAB._.VehicleSpeedIn.VehicleSpeedInFL.sv_v_Ist ZFFSAB._.VehicleSpeedIn.VehicleSpeedInFL.sv_v_IstMax ZFFSAB._.VehicleSpeedIn.VehicleSpeedInFL.sv_v_IstMaxSts ZFFSAB._.VehicleSpeedIn.VehicleSpeedInFL.sv_v_IstSts ZFFSAB._.VehicleSpeedIn.VehicleSpeedInFL.v_Fzg ZFFSAB._.VehicleSpeedIn.VehicleSpeedInFL.v_FzgSts ZFFSAB._.VehicleSpeedIn.VehicleSpeedInFL.v_IstByNWheel ZFFSAB._.VehicleSpeedIn.f_v_FzgErr ZFFSAB._.VehicleSpeedIn.iv_u_SensESts ZFFSAB._.VehicleSpeedIn.iv_v_Fzg ZFFSAB._.VehicleSpeedIn.iv_v_FzgErr ZFFSAB._.VehicleSpeedIn.iv_v_FzgErrSts ZFFSAB._.VehicleSpeedIn.iv_v_FzgSts ZFFSAB._.VehicleSpeedIn.n_WheelAvg ZFFSAB._.VehicleSpeedIn.n_WheelAvgSts ZFFSAB._.VehicleSpeedIn.sv_AGS_VVehCog ZFFSAB._.VehicleSpeedIn.sv_AGS_VVehCogStat ZFFSAB._.VehicleSpeedIn.sv_v_FzgByNab ZFFSAB._.VehicleSpeedIn.sv_v_FzgByNabSts ZFFSAB._.VehicleSpeedIn.sv_v_FzgByNabSts_ ZFFSAB._.VehicleSpeedIn.sv_v_FzgByNab_ ZFFSAB._.VehicleSpeedIn.sv_v_Ist ZFFSAB._.VehicleSpeedIn.sv_v_IstMax ZFFSAB._.VehicleSpeedIn.sv_v_IstMaxSts ZFFSAB._.VehicleSpeedIn.sv_v_IstMaxSts_ ZFFSAB._.VehicleSpeedIn.sv_v_IstMax_ ZFFSAB._.VehicleSpeedIn.sv_v_IstSts ZFFSAB._.VehicleSpeedIn.sv_v_IstSts_ ZFFSAB._.VehicleSpeedIn.sv_v_Ist_ ZFFSAB._.VehicleSpeedIn.v_Fzg ZFFSAB._.VehicleSpeedIn.v_FzgSts ZFFSAB._.VehicleSpeedIn.v_FzgSts_ ZFFSAB._.VehicleSpeedIn.v_Fzg_ ZFFSAB._.VehicleSpeedIn.v_IstByNWheel /end IN_MEASUREMENT
/end FUNCTION
/begin FUNCTION zf_SAB_VoltageMonitoringOut "desc_en"
 /begin IN_MEASUREMENT ZFFSAB._.VoltageMonitoringOut.f_DiagActive_UBATTL ZFFSAB._.VoltageMonitoringOut.f_DiagActive_UBATTU ZFFSAB._.VoltageMonitoringOut.iv_Pos ZFFSAB._.VoltageMonitoringOut.iv_fet0_active ZFFSAB._.VoltageMonitoringOut.iv_u_Batt_Diag ZFFSAB._.VoltageMonitoringOut.sv_f_FET1 ZFFSAB._.VoltageMonitoringOut.sv_f_FET2 ZFFSAB._.VoltageMonitoringOut.sv_f_GetUndervoltageTC ZFFSAB._.VoltageMonitoringOut.sv_f_JumpstartAktiv ZFFSAB._.VoltageMonitoringOut.sv_sts_EDSMV /end IN_MEASUREMENT
/end FUNCTION
/begin FUNCTION zf_SAB_WarmUpIn "desc_en"
 /begin IN_MEASUREMENT ZFFSAB._.WarmUpIn.f_WarmUpSwitchErr ZFFSAB._.WarmUpIn.iv_WarmUpSwitch ZFFSAB._.WarmUpIn.iv_WarmUpSwitchSts ZFFSAB._.WarmUpIn.sv_WarmUpSwitch ZFFSAB._.WarmUpIn.sv_WarmUpSwitchSts /end IN_MEASUREMENT
/end FUNCTION
/begin FUNCTION zf_SAB_WheelIn "desc_en"
 /begin IN_MEASUREMENT ZFFSAB._.WheelIn.DriveDirWheel ZFFSAB._.WheelIn.DriveDirWheelSts ZFFSAB._.WheelIn.FL.f_n_WheelErr ZFFSAB._.WheelIn.FL.f_v_WheelErr ZFFSAB._.WheelIn.FL.iv_v_Wheel ZFFSAB._.WheelIn.FL.iv_v_WheelSts ZFFSAB._.WheelIn.FL.n_Wheel ZFFSAB._.WheelIn.FL.n_WheelSts ZFFSAB._.WheelIn.FL.sv_v_Wheel ZFFSAB._.WheelIn.FL.sv_v_WheelSts ZFFSAB._.WheelIn.FL.v_WheelBalanced ZFFSAB._.WheelIn.FR.f_n_WheelErr ZFFSAB._.WheelIn.FR.f_v_WheelErr ZFFSAB._.WheelIn.FR.iv_v_Wheel ZFFSAB._.WheelIn.FR.iv_v_WheelSts ZFFSAB._.WheelIn.FR.n_Wheel ZFFSAB._.WheelIn.FR.n_WheelSts ZFFSAB._.WheelIn.FR.sv_v_Wheel ZFFSAB._.WheelIn.FR.sv_v_WheelSts ZFFSAB._.WheelIn.FR.v_WheelBalanced ZFFSAB._.WheelIn.RL.f_n_WheelErr ZFFSAB._.WheelIn.RL.f_v_WheelErr ZFFSAB._.WheelIn.RL.iv_v_Wheel ZFFSAB._.WheelIn.RL.iv_v_WheelSts ZFFSAB._.WheelIn.RL.n_Wheel ZFFSAB._.WheelIn.RL.n_WheelSts ZFFSAB._.WheelIn.RL.sv_v_Wheel ZFFSAB._.WheelIn.RL.sv_v_WheelSts ZFFSAB._.WheelIn.RL.v_WheelBalanced ZFFSAB._.WheelIn.RR.f_n_WheelErr ZFFSAB._.WheelIn.RR.f_v_WheelErr ZFFSAB._.WheelIn.RR.iv_v_Wheel ZFFSAB._.WheelIn.RR.iv_v_WheelSts ZFFSAB._.WheelIn.RR.n_Wheel ZFFSAB._.WheelIn.RR.n_WheelSts ZFFSAB._.WheelIn.RR.sv_v_Wheel ZFFSAB._.WheelIn.RR.sv_v_WheelSts ZFFSAB._.WheelIn.RR.v_WheelBalanced ZFFSAB._.WheelIn.cod_SWI_WheelActivePassive ZFFSAB._.WheelIn.f_n_WheelAvgErr ZFFSAB._.WheelIn.lfz_Wheel ZFFSAB._.WheelIn.lfz_WheelSts ZFFSAB._.WheelIn.n_AbFilt1 ZFFSAB._.WheelIn.n_Ab_ByWheelActL ZFFSAB._.WheelIn.n_Ab_ByWheelActR ZFFSAB._.WheelIn.n_Ab_ByWheelActiveAvg ZFFSAB._.WheelIn.n_Ab_ByWheelPassiveAvg ZFFSAB._.WheelIn.n_WheelAvg ZFFSAB._.WheelIn.n_WheelAvgSts ZFFSAB._.WheelIn.sv_AGS_FourWheelDrive ZFFSAB._.WheelIn.sv_n_Ab_ByWheelActiveAvgFilt ZFFSAB._.WheelIn.sv_n_Ab_ByWheelActiveBalancedAvg ZFFSAB._.WheelIn.sv_v_WheelActiveAvg ZFFSAB._.WheelIn.sv_v_WheelActiveAvgSts ZFFSAB._.WheelIn.v_WheelActiveBalancedAvg ZFFSAB._.WheelIn.v_WheelAvg ZFFSAB._.WheelIn.v_WheelAvgSts ZFFSAB._.WheelIn.v_WheelDiagSts ZFFSAB._.WheelIn.v_WheelFSts ZFFSAB._.WheelIn.v_WheelPassiveAvg ZFFSAB._.WheelIn.v_WheelPassiveAvgSts ZFFSAB._.WheelIn.v_WheelRSts /end IN_MEASUREMENT
/end FUNCTION
/begin FUNCTION zf_SAB_YawIn "desc_en"
 /begin IN_MEASUREMENT ZFFSAB._.YawIn.f_YawRateErr ZFFSAB._.YawIn.iv_YawQURateSts ZFFSAB._.YawIn.iv_YawRate ZFFSAB._.YawIn.iv_YawRateSts ZFFSAB._.YawIn.sv_YawRate ZFFSAB._.YawIn.sv_f_YawRateSts /end IN_MEASUREMENT
/end FUNCTION
/begin FUNCTION zf_SABin_Interfi "desc_en"
 /begin IN_MEASUREMENT ZFFSAB._.Interfi.iv_Kraftschluss ZFFSAB._.Interfi.iv_Pos ZFFSAB._.Interfi.iv_PosSts ZFFSAB._.Interfi.iv_u_Batt_Diag /end IN_MEASUREMENT
/end FUNCTION
/begin FUNCTION zf_SABin_Timer "desc_en"
 /begin IN_MEASUREMENT ZFFSAB._.ActuatorSignalsIn.tmr_EPumpAliveSignal.time ZFFSAB._.ActuatorSignalsIn.tmr_EPumpPermShutDown.time ZFFSAB._.ActuatorSignalsIn.tmr_EPumpTempShutDown.time ZFFSAB._.BootJump.tmr_IEP_ShutdownDelay.time ZFFSAB._.CAN_Handling.tmr_CAN1BusDiagDelay.time ZFFSAB._.CAN_Handling.tmr_CAN2BusDiagDelay.time ZFFSAB._.CAN_Handling.tmr_DiagAfterKL15.time ZFFSAB._.CAN_SwitchingIn.tmr_CAN_HYS.time ZFFSAB._.DrivingDirectionIn.tmr_HoldDirection.time ZFFSAB._.EmergencyGearInfo.tmr_3th_stepENPGx.time ZFFSAB._.EmergencyGearInfo.tmr_ENPG3.time ZFFSAB._.EmergencyGearInfo.tmr_GearSubst.time ZFFSAB._.HybridVehicleReadyToDriveIn.tmr_ToStartVM.time ZFFSAB._.HybridVehicleReadyToDriveIn.tmr_holdStateVehicleReadyToDrive.time ZFFSAB._.PowerdownIn.tmr_PowerDown.time ZFFSAB._.PowerdownIn.tmr_ResetByTester.time ZFFSAB._.RollPreventIn.tmr_hillholdDelay.time ZFFSAB._.RoutineControlUDS.tmr_IEP_Test.time ZFFSAB._.RoutineControlUDS.tmr_PreadaptionSOC0x80.time ZFFSAB._.TipTasterIn.tmr_AnalogPaddleDebounceFunction.time ZFFSAB._.TipTasterIn.tmr_AnalogPaddleLearnFunction.time ZFFSAB._.TipTasterIn.tmr_CANPaddleAllowableReceived.time ZFFSAB._.VoltageMonitoringOut.tmr_DiagActive_UBATTL.time ZFFSAB._.VoltageMonitoringOut.tmr_DiagActive_UBATTU.time ZFFSAB._.VoltageMonitoringOut.tmr_GearSubstLSSOFF.time ZFFSAB._.VoltageMonitoringOut.tmr_Jumpstart.time ZFFSAB._.VoltageMonitoringOut.tmr_u_BattU.time /end IN_MEASUREMENT
/end FUNCTION
/begin FUNCTION zff_ABK_AUTOPOS "desc_en"
 /begin IN_MEASUREMENT AutoPos.PosAuto AutoPos.f_CC_AutoPosPByDriverLeaveCar AutoPos.f_NoAutoPEMFHelp AutoPos.f_SpdBelowOrEqP_Th AutoPos.st_AutoPosEvent DiagPos.st_DiagPosEvent TesterAccess.st_VehicleAutoP /end IN_MEASUREMENT
/end FUNCTION
/begin FUNCTION zff_ABK_CARWASHMODE "desc_en" /begin IN_MEASUREMENT CarwashMode.st_HoldN /end IN_MEASUREMENT /end FUNCTION
/begin FUNCTION zff_ABK_CC_MSG "desc_en"
 /begin IN_MEASUREMENT CCMsg.IDEmpty.cCC_ID._.MsgOnceSent CCMsg.IDEmpty.cCC_ID._.MyIdx CCMsg.IDEmpty.cCC_ID._.f_ID_Locked CCMsg.IDEmpty.cCC_ID._.f_ID_Reset CCMsg.IDEmpty.cCC_ID._.st_ID CCMsg.ID_DrvLeavesCar.cCC_ID._.MsgOnceSent CCMsg.ID_DrvLeavesCar.cCC_ID._.MyIdx CCMsg.ID_DrvLeavesCar.cCC_ID._.f_ID_Locked CCMsg.ID_DrvLeavesCar.cCC_ID._.f_ID_Reset CCMsg.ID_DrvLeavesCar.cCC_ID._.st_ID CCMsg.ID_DrvLeavesCar.f_ID_DrvLeavesCar CCMsg.ID_DrvLeavesCar.f_PrematureReset CCMsg.ID_DrvLeavesCar_BeltLocked.cCC_ID._.MsgOnceSent CCMsg.ID_DrvLeavesCar_BeltLocked.cCC_ID._.MyIdx CCMsg.ID_DrvLeavesCar_BeltLocked.cCC_ID._.f_ID_Locked CCMsg.ID_DrvLeavesCar_BeltLocked.cCC_ID._.f_ID_Reset CCMsg.ID_DrvLeavesCar_BeltLocked.cCC_ID._.st_ID CCMsg.ID_DrvLeavesCar_BeltLocked.f_ID_DrvLeavesCar_BeltLocked CCMsg.ID_GearboxWarning1.cCC_ID._.MsgOnceSent CCMsg.ID_GearboxWarning1.cCC_ID._.MyIdx CCMsg.ID_GearboxWarning1.cCC_ID._.f_ID_Locked CCMsg.ID_GearboxWarning1.cCC_ID._.f_ID_Reset CCMsg.ID_GearboxWarning1.cCC_ID._.st_ID CCMsg.ID_GearboxWarning1.f_ID_GearboxWarning1 CCMsg.ID_GearboxWarning2.cCC_ID._.MsgOnceSent CCMsg.ID_GearboxWarning2.cCC_ID._.MyIdx CCMsg.ID_GearboxWarning2.cCC_ID._.f_ID_Locked CCMsg.ID_GearboxWarning2.cCC_ID._.f_ID_Reset CCMsg.ID_GearboxWarning2.cCC_ID._.st_ID CCMsg.ID_GearboxWarning2.f_ID_GearboxWarning2 CCMsg.ID_GongBadOp.cCC_ID._.MsgOnceSent CCMsg.ID_GongBadOp.cCC_ID._.MyIdx CCMsg.ID_GongBadOp.cCC_ID._.f_ID_Locked CCMsg.ID_GongBadOp.cCC_ID._.f_ID_Reset CCMsg.ID_GongBadOp.cCC_ID._.st_ID CCMsg.ID_GongBadOp.f_ID_GongBadOp CCMsg.ID_GongInMechLimp.cCC_ID._.MsgOnceSent CCMsg.ID_GongInMechLimp.cCC_ID._.MyIdx CCMsg.ID_GongInMechLimp.cCC_ID._.f_ID_Locked CCMsg.ID_GongInMechLimp.cCC_ID._.f_ID_Reset CCMsg.ID_GongInMechLimp.cCC_ID._.st_ID CCMsg.ID_GongInMechLimp.f_ID_GongInMechLimp CCMsg.ID_GongWrongDrvDir.cCC_ID._.MsgOnceSent CCMsg.ID_GongWrongDrvDir.cCC_ID._.MyIdx CCMsg.ID_GongWrongDrvDir.cCC_ID._.f_ID_Locked CCMsg.ID_GongWrongDrvDir.cCC_ID._.f_ID_Reset CCMsg.ID_GongWrongDrvDir.cCC_ID._.st_ID CCMsg.ID_GongWrongDrvDir.f_ID_GongWrongDrvDir CCMsg.ID_Hotmode1.cCC_ID._.MsgOnceSent CCMsg.ID_Hotmode1.cCC_ID._.MyIdx CCMsg.ID_Hotmode1.cCC_ID._.f_ID_Locked CCMsg.ID_Hotmode1.cCC_ID._.f_ID_Reset CCMsg.ID_Hotmode1.cCC_ID._.st_ID CCMsg.ID_Hotmode1.f_ID_Hotmode1 CCMsg.ID_Hotmode2.cCC_ID._.MsgOnceSent CCMsg.ID_Hotmode2.cCC_ID._.MyIdx CCMsg.ID_Hotmode2.cCC_ID._.f_ID_Locked CCMsg.ID_Hotmode2.cCC_ID._.f_ID_Reset CCMsg.ID_Hotmode2.cCC_ID._.st_ID CCMsg.ID_Hotmode2.f_ID_Hotmode2 CCMsg.ID_Hotmode3.cCC_ID._.MsgOnceSent CCMsg.ID_Hotmode3.cCC_ID._.MyIdx CCMsg.ID_Hotmode3.cCC_ID._.f_ID_Locked CCMsg.ID_Hotmode3.cCC_ID._.f_ID_Reset CCMsg.ID_Hotmode3.cCC_ID._.st_ID CCMsg.ID_Hotmode3.f_ID_Hotmode3 CCMsg.ID_IgnitionError.cCC_ID._.MsgOnceSent CCMsg.ID_IgnitionError.cCC_ID._.MyIdx CCMsg.ID_IgnitionError.cCC_ID._.f_ID_Locked CCMsg.ID_IgnitionError.cCC_ID._.f_ID_Reset CCMsg.ID_IgnitionError.cCC_ID._.st_ID CCMsg.ID_IgnitionError.f_ID_IgnitionError CCMsg.ID_MechLimpInD.cCC_ID._.MsgOnceSent CCMsg.ID_MechLimpInD.cCC_ID._.MyIdx CCMsg.ID_MechLimpInD.cCC_ID._.f_ID_Locked CCMsg.ID_MechLimpInD.cCC_ID._.f_ID_Reset CCMsg.ID_MechLimpInD.cCC_ID._.st_ID CCMsg.ID_MechLimpInD.f_ID_MechLimpInD CCMsg.ID_MechLimpInP.cCC_ID._.MsgOnceSent CCMsg.ID_MechLimpInP.cCC_ID._.MyIdx CCMsg.ID_MechLimpInP.cCC_ID._.f_ID_Locked CCMsg.ID_MechLimpInP.cCC_ID._.f_ID_Reset CCMsg.ID_MechLimpInP.cCC_ID._.st_ID CCMsg.ID_MechLimpInP.f_ID_MechLimpInP CCMsg.ID_PS_Abuse.cCC_ID._.MsgOnceSent CCMsg.ID_PS_Abuse.cCC_ID._.MyIdx CCMsg.ID_PS_Abuse.cCC_ID._.f_ID_Locked CCMsg.ID_PS_Abuse.cCC_ID._.f_ID_Reset CCMsg.ID_PS_Abuse.cCC_ID._.st_ID CCMsg.ID_PS_Abuse.f_ID_PS_Abuse CCMsg.ID_P_ButtonError.cCC_ID._.MsgOnceSent CCMsg.ID_P_ButtonError.cCC_ID._.MyIdx CCMsg.ID_P_ButtonError.cCC_ID._.f_ID_Locked CCMsg.ID_P_ButtonError.cCC_ID._.f_ID_Reset CCMsg.ID_P_ButtonError.cCC_ID._.st_ID CCMsg.ID_P_ButtonError.f_ID_P_ButtonError CCMsg.ID_ParkLockFault.cCC_ID._.MsgOnceSent CCMsg.ID_ParkLockFault.cCC_ID._.MyIdx CCMsg.ID_ParkLockFault.cCC_ID._.f_ID_Locked CCMsg.ID_ParkLockFault.cCC_ID._.f_ID_Reset CCMsg.ID_ParkLockFault.cCC_ID._.st_ID CCMsg.ID_ParkLockFault.f_ID_ParkLockFault CCMsg.ID_ParkLockFault_IEP_On.cCC_ID._.MsgOnceSent CCMsg.ID_ParkLockFault_IEP_On.cCC_ID._.MyIdx CCMsg.ID_ParkLockFault_IEP_On.cCC_ID._.f_ID_Locked CCMsg.ID_ParkLockFault_IEP_On.cCC_ID._.f_ID_Reset CCMsg.ID_ParkLockFault_IEP_On.cCC_ID._.st_ID CCMsg.ID_ParkLockFault_IEP_On.f_ID_ParkLockFault_IEP_On CCMsg.ID_ParkLockFault_InMechLimp.cCC_ID._.MsgOnceSent CCMsg.ID_ParkLockFault_InMechLimp.cCC_ID._.MyIdx CCMsg.ID_ParkLockFault_InMechLimp.cCC_ID._.f_ID_Locked CCMsg.ID_ParkLockFault_InMechLimp.cCC_ID._.f_ID_Reset CCMsg.ID_ParkLockFault_InMechLimp.cCC_ID._.st_ID CCMsg.ID_ParkLockFault_InMechLimp.f_ID_ParkLockFault_InMechLimp CCMsg.ID_PosN_Warning.cCC_ID._.MsgOnceSent CCMsg.ID_PosN_Warning.cCC_ID._.MyIdx CCMsg.ID_PosN_Warning.cCC_ID._.f_ID_Locked CCMsg.ID_PosN_Warning.cCC_ID._.f_ID_Reset CCMsg.ID_PosN_Warning.cCC_ID._.st_ID CCMsg.ID_PosN_Warning.f_ID_PosN_Warning CCMsg.ID_ShiftWithoutBrakeWarning.cCC_ID._.MsgOnceSent CCMsg.ID_ShiftWithoutBrakeWarning.cCC_ID._.MyIdx CCMsg.ID_ShiftWithoutBrakeWarning.cCC_ID._.f_ID_Locked CCMsg.ID_ShiftWithoutBrakeWarning.cCC_ID._.f_ID_Reset CCMsg.ID_ShiftWithoutBrakeWarning.cCC_ID._.st_ID CCMsg.ID_ShiftWithoutBrakeWarning.f_ID_ShiftWithoutBrakeWarning CCMsg.ID_ShifterError.cCC_ID._.MsgOnceSent CCMsg.ID_ShifterError.cCC_ID._.MyIdx CCMsg.ID_ShifterError.cCC_ID._.f_ID_Locked CCMsg.ID_ShifterError.cCC_ID._.f_ID_Reset CCMsg.ID_ShifterError.cCC_ID._.st_ID CCMsg.ID_ShifterError.f_ID_ShifterError CCMsg.ID_ShiftlockBrakeWarning.cCC_ID._.MsgOnceSent CCMsg.ID_ShiftlockBrakeWarning.cCC_ID._.MyIdx CCMsg.ID_ShiftlockBrakeWarning.cCC_ID._.f_ID_Locked CCMsg.ID_ShiftlockBrakeWarning.cCC_ID._.f_ID_Reset CCMsg.ID_ShiftlockBrakeWarning.cCC_ID._.st_ID CCMsg.ID_ShiftlockBrakeWarning.f_ID_ShiftlockBrakeWarning CCMsg.ID_Speed2HighForDrvReqP.cCC_ID._.MsgOnceSent CCMsg.ID_Speed2HighForDrvReqP.cCC_ID._.MyIdx CCMsg.ID_Speed2HighForDrvReqP.cCC_ID._.f_ID_Locked CCMsg.ID_Speed2HighForDrvReqP.cCC_ID._.f_ID_Reset CCMsg.ID_Speed2HighForDrvReqP.cCC_ID._.st_ID CCMsg.ID_Speed2HighForDrvReqP.f_ID_Speed2HighForDrvReqP CCMsg.ID_Speed2HighInPosP.cCC_ID._.MsgOnceSent CCMsg.ID_Speed2HighInPosP.cCC_ID._.MyIdx CCMsg.ID_Speed2HighInPosP.cCC_ID._.f_ID_Locked CCMsg.ID_Speed2HighInPosP.cCC_ID._.f_ID_Reset CCMsg.ID_Speed2HighInPosP.cCC_ID._.st_ID CCMsg.ID_Speed2HighInPosP.f_ID_Speed2HighInPosP CCMsg.ID_V_ImplausibleInPosP.cCC_ID._.MsgOnceSent CCMsg.ID_V_ImplausibleInPosP.cCC_ID._.MyIdx CCMsg.ID_V_ImplausibleInPosP.cCC_ID._.f_ID_Locked CCMsg.ID_V_ImplausibleInPosP.cCC_ID._.f_ID_Reset CCMsg.ID_V_ImplausibleInPosP.cCC_ID._.st_ID CCMsg.ID_V_ImplausibleInPosP.f_ID_V_ImplausibleInPosP CCMsgBPRAM.Bitmask_MsgSendHigh_Buf CCMsgBPRAM.Bitmask_MsgSendHigh_Buf_ CCMsgBPRAM.Bitmask_MsgSendLow_Buf CCMsgBPRAM.Bitmask_MsgSendLow_Buf_ cCC_ID._.f_CC_DrvExpectsP cID_ParkLockFault_IEP_On._.f_IgnOn_Old /end IN_MEASUREMENT
/end FUNCTION
/begin FUNCTION zff_ABK_DEBOUNCEDRVREQ "desc_en"
 /begin IN_MEASUREMENT DebounceDrvReq.DrvReqPRND_Filt DebounceDrvReq.f_LastPosRD DebounceDrvReq.f_NoDebounceNA2N DebounceDrvReq.f_NoDebounceRD2N DebounceDrvReq.f_StartOrResetOfDebounceOccured DebounceDrvReq.st_Debounce /end IN_MEASUREMENT
/end FUNCTION
/begin FUNCTION zff_ABK_DIAGPOS "desc_en"
 /begin IN_MEASUREMENT DiagPos.PosPRND DiagPos.PosPRND_ DiagPos.PosPRND_Old DiagPos.PosStatus DiagPos.f_CC_DiagPosInWrongDrvDir DiagPos.f_DrvAssistPosModeErr_Old DiagPos.st_GbxTempReqP /end IN_MEASUREMENT
/end FUNCTION
/begin FUNCTION zff_ABK_DISPATCH "desc_en"
 /begin IN_MEASUREMENT Dispatcher.CtlDispGear Dispatcher.CtlDispMode Dispatcher.CtlDispPos Dispatcher.CtlDispPos_ /end IN_MEASUREMENT
/end FUNCTION
/begin FUNCTION zff_ABK_DRVPRESENCEDETECTOR "desc_en"
 /begin IN_MEASUREMENT DrvPresenceDetector.f_CC_DrvLeavesCar DrvPresenceDetector.f_CC_DrvLeavesCarBeltLocked DrvPresenceDetector.f_DrvLeavesCar DrvPresenceDetector.f_DrvLeavesCarBrakeAccPed DrvPresenceDetector.f_DrvLeavesCarDoorSeatb DrvPresenceDetector.f_DrvLeavesCarInN DrvPresenceDetector.st_DriverPresence DrvPresenceDetector.st_tmr_DrvLeavesCarInN /end IN_MEASUREMENT
/end FUNCTION
/begin FUNCTION zff_ABK_DRVREQ2POS "desc_en" /begin IN_MEASUREMENT DrvReq2Pos.PosDrvReq DrvReq2Pos.f_CC_Spd2HighP /end IN_MEASUREMENT /end FUNCTION
/begin FUNCTION zff_ABK_EEPROM "desc_en"
 /begin IN_MEASUREMENT EepromBPRAM.f_ForceEEPROM_Update EepromBPRAM.f_ForceEEPROM_Update_ EepromEws4ImmedWrap.EepromEws4Immediate.f_ews4_locked EepromEws4ImmedWrap.EepromEws4Immediate.f_ews4_locked_ EepromEws4ImmedWrap.EepromEws4Immediate.fsc_old_date EepromEws4ImmedWrap.EepromEws4Immediate.fsc_old_date_ EepromEws4ImmedWrap.EepromEws4Immediate.fsc_status EepromEws4ImmedWrap.EepromEws4Immediate.fsc_status_ EepromWrap.Eeprom.cnt_AdaptivMode EepromWrap.Eeprom.cnt_AdaptivMode_ EepromWrap.Eeprom.cnt_AutoPEmf1 EepromWrap.Eeprom.cnt_AutoPEmf1_ EepromWrap.Eeprom.cnt_AutoPEmf2 EepromWrap.Eeprom.cnt_AutoPEmf2_ EepromWrap.Eeprom.cnt_AutoPEmf3 EepromWrap.Eeprom.cnt_AutoPEmf3_ EepromWrap.Eeprom.cnt_AutoP_DrvPresenceUnknown.Complement EepromWrap.Eeprom.cnt_AutoP_DrvPresenceUnknown.Value EepromWrap.Eeprom.cnt_DiagPosInWrongDrvDir.Complement EepromWrap.Eeprom.cnt_DiagPosInWrongDrvDir.Value EepromWrap.Eeprom.cnt_GbxTempReqP EepromWrap.Eeprom.cnt_GbxTempReqP_ EepromWrap.Eeprom.cnt_ID828.Complement EepromWrap.Eeprom.cnt_ID828.Value EepromWrap.Eeprom.cnt_Init_Calls EepromWrap.Eeprom.cnt_Init_Calls_ EepromWrap.Eeprom.cnt_ManualMode EepromWrap.Eeprom.cnt_ManualMode_ EepromWrap.Eeprom.cnt_SportMode EepromWrap.Eeprom.cnt_SportMode_ EepromWrap.Eeprom.cnt_info_memory_entries EepromWrap.Eeprom.idx_last_drvLeavesCarInN_mem_entry EepromWrap.Eeprom.idx_last_drvLeavesCarInN_mem_entry_ EepromWrap.Eeprom.info_memory[0].errorID EepromWrap.Eeprom.info_memory[0].moduleID EepromWrap.Eeprom.info_memory[1].errorID EepromWrap.Eeprom.info_memory[1].moduleID EepromWrap.Eeprom.info_memory[2].errorID EepromWrap.Eeprom.info_memory[2].moduleID EepromWrap.Eeprom.info_memory[3].errorID EepromWrap.Eeprom.info_memory[3].moduleID EepromWrap.Eeprom.info_memory[4].errorID EepromWrap.Eeprom.info_memory[4].moduleID EepromWrap.Eeprom.info_memory[5].errorID EepromWrap.Eeprom.info_memory[5].moduleID EepromWrap.Eeprom.info_memory[6].errorID EepromWrap.Eeprom.info_memory[6].moduleID EepromWrap.Eeprom.info_memory[7].errorID EepromWrap.Eeprom.info_memory[7].moduleID EepromWrap.Eeprom.info_memory_checksum /end IN_MEASUREMENT
/end FUNCTION
/begin FUNCTION zff_ABK_ENGINESIGNALS "desc_en"
 /begin IN_MEASUREMENT EngineSignals.f_EngOn EngineSignals.f_GearboxReadySts_Old EngineSignals.f_GearboxReady_Old EngineSignals.n_EngSub EngineSignals.n_EngSubSts EngineSignals.st_EngOn EngineSignals.st_EngOn_Old /end IN_MEASUREMENT
/end FUNCTION
/begin FUNCTION zff_ABK_EWS4 "desc_en"
 /begin IN_MEASUREMENT Ews4Measure.cnt_NrOfMissingResponses Ews4Measure.cnt_TASCASReq Ews4Measure.cnt_saved_eewrite_update_val Ews4Measure.f_FSCSignature_NonAuthentical Ews4Measure.f_at_least_one_nonauth_rsp_rxd Ews4Measure.f_client_enabled Ews4Measure.f_rsp_nonauthentic Ews4Measure.f_switchedCANpath_wait_fIgnOn Ews4Measure.fsc_check_routine_result Ews4Measure.fsc_ews4_actual_date Ews4Measure.fsc_ews4_old_date Ews4Measure.fsc_ews4_status Ews4Measure.rsp_err_cnt_A Ews4Measure.rsp_err_cnt_B Ews4Measure.rsp_err_cnt_C Ews4Measure.rsp_ok_cnt Ews4Measure.st_Ews4 Ews4Measure.st_Ews4IntSub Ews4Measure.st_Ews4Internal Ews4Measure.st_Ews4StoreEE Ews4Measure.st_Ews4_ChRspKf_TYP_ST Ews4Measure.st_FSC_Active Ews4Measure.st_actual_CAN_ch Ews4Measure.st_crypto_fctn_call Ews4Measure.uwb_ews4 /end IN_MEASUREMENT
/end FUNCTION
/begin FUNCTION zff_ABK_FASREQ2POS "desc_en"
 /begin IN_MEASUREMENT FASReq2Pos.PosDrvAssistRaw_Trig FASReq2Pos.PosFASReq FASReq2Pos.f_DrvAssistPosModeErr FASReq2Pos.f_NoDrvAssist FASReq2Pos.f_NoDrvAssist_ViaSubstFunct FASReq2Pos.st_ModeDrvAssistTrans FASReq2Pos.st_ModeDrvAssistTrans_ /end IN_MEASUREMENT
/end FUNCTION
/begin FUNCTION zff_ABK_GEARBOXSTATE "desc_en" /begin IN_MEASUREMENT GearboxState.st_Gearbox /end IN_MEASUREMENT /end FUNCTION
/begin FUNCTION zff_ABK_INTERFI "desc_en"
 /begin IN_MEASUREMENT Interfi.AcceleratorPedalAngle Interfi.AcceleratorPedalAngleSts Interfi.BrakePedalDrvAssistSts Interfi.BrakePedalSts Interfi.CtrlSignalSourceSts Interfi.DoorDSts Interfi.DriveLogicRaw Interfi.DrivingDirection Interfi.DrivingDirectionSts Interfi.EepromBusy Interfi.EepromStoreInProgress Interfi.EepromUpdCnt Interfi.GatePosRaw Interfi.GearboxDrvRdy Interfi.GearboxDrvRdySts Interfi.IgnOnRawSts Interfi.KeyValidSts Interfi.ModeDrvAssistVehSts Interfi.PSensor Interfi.PSensorSts Interfi.ParkingBrakeSts Interfi.PosDrvAssistRaw Interfi.PosDrvAssistRawSts Interfi.PosRaw Interfi.SeatBeltSts Interfi.SeatFLSts Interfi.VehicleDrvRdy Interfi.VehicleDrvRdySts Interfi.c_ChipTrans Interfi.c_OilTrans Interfi.c_OilTransSts Interfi.f_BrakePedal Interfi.f_BrakePedalDrvAssist Interfi.f_CanComActive Interfi.f_DoorD Interfi.f_FaultFiltKFC_CANB1 Interfi.f_FaultFiltKFC_CANB2 Interfi.f_FaultFiltKFC_PINFO Interfi.f_FaultFiltKFC_POSSBW Interfi.f_FaultFiltKFC_ParkSolenoid Interfi.f_FaultFiltPSensor Interfi.f_FaultKFC_CANB Interfi.f_FaultKFC_CANB2 Interfi.f_FaultKFC_PINFO Interfi.f_FaultKFC_POSSBW Interfi.f_FaultKFC_PSIN Interfi.f_KeyValid Interfi.f_ModeDrvAssistVeh Interfi.f_P12BadOpRaw Interfi.f_P12Button Interfi.f_P12TwoErr Interfi.f_PN Interfi.f_ParkingBrake Interfi.f_PowDownCondOK Interfi.f_RemoteStartRaw Interfi.f_SDButtonRaw Interfi.f_SeatBelt Interfi.f_SeatFL Interfi.f_SportButtonRaw Interfi.f_SubstAdaptivModeFix Interfi.f_SubstHSS1Off Interfi.f_SubstHoldP Interfi.f_SubstKMN_CCID419 Interfi.f_SubstKMN_CCID420 Interfi.f_SubstNoD Interfi.f_SubstNoR Interfi.f_SubstNoShiftlock Interfi.f_SubstWarnLight Interfi.f_V_Implausible Interfi.n_AbRaw Interfi.n_Eng Interfi.n_EngSts Interfi.s_mileage_10km Interfi.st_DiagNUWIG Interfi.st_EmfP Interfi.st_GearCurr Interfi.st_GearDest Interfi.st_GearShiftStrat Interfi.st_IAE_Hotmode Interfi.st_IgnOnRaw Interfi.st_LeverType Interfi.st_Limphome Interfi.st_LowMode Interfi.st_MSA_Function Interfi.st_MSA_FunctionRequester Interfi.st_ModeDisplay Interfi.st_OsMode Interfi.st_ParkLock Interfi.st_SubstAll Interfi.st_SubstAllHi Interfi.st_TipMinus1_Raw Interfi.st_TipMinus2_Raw Interfi.st_TipPlus1_Raw Interfi.st_TipPlus2_Raw Interfi.st_VehDrvRdy Interfi.t_systime_secs Interfi.u_BattDiag Interfi.u_mv3 Interfi.v_VehSpdMinSts Interfi.v_VehSpd_nab Level2Signals.L2_BrakePedalSts.Complement Level2Signals.L2_BrakePedalSts.Value Level2Signals.L2_BrakePressureSts.Complement Level2Signals.L2_BrakePressureSts.Value Level2Signals.L2_f_BrakePedal.Complement Level2Signals.L2_f_BrakePedal.Value /end IN_MEASUREMENT
/end FUNCTION
/begin FUNCTION zff_ABK_INTOSCALLSRAM "desc_en"
 /begin IN_MEASUREMENT IntOsCallsRAM.f_erase_infomemory IntOsCallsRAM.f_sbwInitialized /end IN_MEASUREMENT
/end FUNCTION
/begin FUNCTION zff_ABK_KOMBI_MSG "desc_en"
 /begin IN_MEASUREMENT KombiMsg.f_FlashPosBadOp KombiMsg.f_IgnOnNeverDetected KombiMsg.f_StandbyBeforeCruise KombiMsg.f_freezeDisplayPReq /end IN_MEASUREMENT
/end FUNCTION
/begin FUNCTION zff_ABK_KOMBIMSGFLASH "desc_en" /begin IN_MEASUREMENT KombiMsgFlash.f_CC_PL_Fault KombiMsgFlash.st_KombiPosFlash /end IN_MEASUREMENT /end FUNCTION
/begin FUNCTION zff_ABK_KOMBIMSGGEAR "desc_en" /begin IN_MEASUREMENT KombiMsgGear.DisplayGear /end IN_MEASUREMENT /end FUNCTION
/begin FUNCTION zff_ABK_KOMBIMSGMODE "desc_en" /begin IN_MEASUREMENT KombiMsgMode.DisplayMode KombiMsgMode.SelectedDispMode /end IN_MEASUREMENT /end FUNCTION
/begin FUNCTION zff_ABK_KOMBIMSGOUTBMW "desc_en"
 /begin IN_MEASUREMENT KombiMsgOutOEM.CtlDispGear KombiMsgOutOEM.CtlDispMode KombiMsgOutOEM.CtlDispPos KombiMsgOutOEM.CtlDispPosFlash KombiMsgOutOEM.CtlDispPos_ /end IN_MEASUREMENT
/end FUNCTION
/begin FUNCTION zff_ABK_KOMBIMSGPOS "desc_en"
 /begin IN_MEASUREMENT KombiMsgPos.DisplayPos KombiMsgPos.DisplayPosFlash KombiMsgPos.DisplayPosRule KombiMsgPos.DisplayPos_ /end IN_MEASUREMENT
/end FUNCTION
/begin FUNCTION zff_ABK_LEVEL2DIAG "desc_en"
 /begin IN_MEASUREMENT DisplayMonitoring.L2_DisplayPos.Complement DisplayMonitoring.L2_DisplayPos.Value DisplayMonitoring.L2_DisplayPosFlash.Complement DisplayMonitoring.L2_DisplayPosFlash.Value DisplayMonitoring.L2_st_SetDispPosDark.Complement DisplayMonitoring.L2_st_SetDispPosDark.Value Level2Signals.L2_AcceleratorPedalAngle.Complement Level2Signals.L2_AcceleratorPedalAngle.Value Level2Signals.L2_AcceleratorPedalAngleSts.Complement Level2Signals.L2_AcceleratorPedalAngleSts.Value Level2Signals.L2_BrakePedalDrvAssistSts.Complement Level2Signals.L2_BrakePedalDrvAssistSts.Value Level2Signals.L2_BrakePressure.Complement Level2Signals.L2_BrakePressure.Value Level2Signals.L2_CtrlSignalSourceSts.Complement Level2Signals.L2_CtrlSignalSourceSts.Value Level2Signals.L2_DoorDSts.Complement Level2Signals.L2_DoorDSts.Value Level2Signals.L2_DrvReq_Raw.Complement Level2Signals.L2_DrvReq_Raw.Value Level2Signals.L2_GatePosRaw.Complement Level2Signals.L2_GatePosRaw.Value Level2Signals.L2_GearboxDrvRdy.Complement Level2Signals.L2_GearboxDrvRdy.Value Level2Signals.L2_GearboxDrvRdySts.Complement Level2Signals.L2_GearboxDrvRdySts.Value Level2Signals.L2_IgnOnRawSts.Complement Level2Signals.L2_IgnOnRawSts.Value Level2Signals.L2_IgnOnSts.Complement Level2Signals.L2_IgnOnSts.Value Level2Signals.L2_ModeDrvAssistVehSts.Complement Level2Signals.L2_ModeDrvAssistVehSts.Value Level2Signals.L2_PSensor.Complement Level2Signals.L2_PSensor.Value Level2Signals.L2_PSensorSts.Complement Level2Signals.L2_PSensorSts.Value Level2Signals.L2_PosDrvAssistRaw.Complement Level2Signals.L2_PosDrvAssistRaw.Value Level2Signals.L2_PosDrvAssistRawSts.Complement Level2Signals.L2_PosDrvAssistRawSts.Value Level2Signals.L2_PosPRND_Old.Complement Level2Signals.L2_PosPRND_Old.Value Level2Signals.L2_PosPRND_PreviousOld.Complement Level2Signals.L2_PosPRND_PreviousOld.Value Level2Signals.L2_PosRaw.Complement Level2Signals.L2_PosRaw.Value Level2Signals.L2_PosRawRelOld.Complement Level2Signals.L2_PosRawRelOld.Value Level2Signals.L2_SeatBeltSts.Complement Level2Signals.L2_SeatBeltSts.Value Level2Signals.L2_SeatFLSts.Complement Level2Signals.L2_SeatFLSts.Value Level2Signals.L2_VehicleDrvRdy.Complement Level2Signals.L2_VehicleDrvRdy.Value Level2Signals.L2_VehicleDrvRdySts.Complement Level2Signals.L2_VehicleDrvRdySts.Value Level2Signals.L2_f_BrakePedalDrvAssist.Complement Level2Signals.L2_f_BrakePedalDrvAssist.Value Level2Signals.L2_f_BrakePedalSL.Complement Level2Signals.L2_f_BrakePedalSL.Value Level2Signals.L2_f_DoorD.Complement Level2Signals.L2_f_DoorD.Value Level2Signals.L2_f_DrvLeavesCar.Complement Level2Signals.L2_f_DrvLeavesCar.Value Level2Signals.L2_f_DrvLeavesCarBrakeAccPed.Complement Level2Signals.L2_f_DrvLeavesCarBrakeAccPed.Value Level2Signals.L2_f_DrvLeavesCarDoorSeatb.Complement Level2Signals.L2_f_DrvLeavesCarDoorSeatb.Value Level2Signals.L2_f_EngOn.Complement Level2Signals.L2_f_EngOn.Value Level2Signals.L2_f_GearboxReadySts_Old.Complement Level2Signals.L2_f_GearboxReadySts_Old.Value Level2Signals.L2_f_GearboxReady_Old.Complement Level2Signals.L2_f_GearboxReady_Old.Value Level2Signals.L2_f_IgnOn.Complement Level2Signals.L2_f_IgnOn.Value Level2Signals.L2_f_MechLimp.Complement Level2Signals.L2_f_MechLimp.Value Level2Signals.L2_f_ModeDrvAssistVeh.Complement Level2Signals.L2_f_ModeDrvAssistVeh.Value Level2Signals.L2_f_P12Button.Complement Level2Signals.L2_f_P12Button.Value Level2Signals.L2_f_ParkLock.Complement Level2Signals.L2_f_ParkLock.Value Level2Signals.L2_f_ResyncNeeded.Complement Level2Signals.L2_f_ResyncNeeded.Value Level2Signals.L2_f_SeatBelt.Complement Level2Signals.L2_f_SeatBelt.Value Level2Signals.L2_f_SeatFL.Complement Level2Signals.L2_f_SeatFL.Value Level2Signals.L2_f_V_Implausible.Complement Level2Signals.L2_f_V_Implausible.Value Level2Signals.L2_n_AbRaw.Complement Level2Signals.L2_n_AbRaw.Value Level2Signals.L2_st_EngOn.Complement Level2Signals.L2_st_EngOn.Value Level2Signals.L2_st_EngOnOld.Complement Level2Signals.L2_st_EngOnOld.Value Level2Signals.L2_st_IgnOnRaw.Complement Level2Signals.L2_st_IgnOnRaw.Value Level2Signals.L2_st_LeverType.Complement Level2Signals.L2_st_LeverType.Value Level2Signals.L2_st_Limphome.Complement Level2Signals.L2_st_Limphome.Value Level2Signals.L2_st_ModeDrvAssistTrans.Complement Level2Signals.L2_st_ModeDrvAssistTrans.Value Level2Signals.L2_v_VehSpdMin.Complement Level2Signals.L2_v_VehSpdMin.Value Level2Signals.L2_v_VehSpd_nab.Complement Level2Signals.L2_v_VehSpd_nab.Value Level2Signals.swi_ign_komp_fault_injection PosMonitoring.L2_DrvReqPRND_Filt.Complement PosMonitoring.L2_DrvReqPRND_Filt.Value PosMonitoring.L2_DrvReqPRND_Raw.Complement PosMonitoring.L2_DrvReqPRND_Raw.Value PosMonitoring.L2_DrvReqP_Trig.Complement PosMonitoring.L2_DrvReqP_Trig.Value PosMonitoring.L2_DrvReqP_old.Complement PosMonitoring.L2_DrvReqP_old.Value PosMonitoring.L2_DrvReq_Old.Complement PosMonitoring.L2_DrvReq_Old.Value PosMonitoring.L2_DrvReq_Trig.Complement PosMonitoring.L2_DrvReq_Trig.Value PosMonitoring.L2_GatePos_Old.Complement PosMonitoring.L2_GatePos_Old.Value PosMonitoring.L2_GatePos_Trig.Complement PosMonitoring.L2_GatePos_Trig.Value PosMonitoring.L2_Max_D_t_StoreN.Complement PosMonitoring.L2_Max_D_t_StoreN.Value PosMonitoring.L2_Max_D_t_StoreRD.Complement PosMonitoring.L2_Max_D_t_StoreRD.Value PosMonitoring.L2_PosDrvAssistRaw_Old.Complement PosMonitoring.L2_PosDrvAssistRaw_Old.Value PosMonitoring.L2_PosDrvAssistRaw_Trig.Complement PosMonitoring.L2_PosDrvAssistRaw_Trig.Value PosMonitoring.L2_PosPRND_Init.Complement PosMonitoring.L2_PosPRND_Init.Value PosMonitoring.L2_PosPRND_Trig.Complement PosMonitoring.L2_PosPRND_Trig.Value PosMonitoring.L2_f_DiagposAutoposDetectedLastCycle.Complement PosMonitoring.L2_f_DiagposAutoposDetectedLastCycle.Value PosMonitoring.L2_f_Shiftlock_Brake.Complement PosMonitoring.L2_f_Shiftlock_Brake.Value PosMonitoring.L2_f_WaitDrvReqRD2N.Complement PosMonitoring.L2_f_WaitDrvReqRD2N.Value /end IN_MEASUREMENT
/end FUNCTION
/begin FUNCTION zff_ABK_MODE "desc_en"
 /begin IN_MEASUREMENT Mode.ModeNext Mode.st_ModeChangeEvent Mode.st_StoreMode Mode.st_StoreModePosChange Mode.st_TipM Mode.st_TipP /end IN_MEASUREMENT
/end FUNCTION
/begin FUNCTION zff_ABK_MODEIN "desc_en"
 /begin IN_MEASUREMENT ModeIn.f_LowModeButton ModeIn.f_LowModeInvalid ModeIn.f_MGate ModeIn.f_MGateOff ModeIn.f_MGateOld ModeIn.f_MGateOn ModeIn.f_TempMan ModeIn.st_LowModeOld /end IN_MEASUREMENT
/end FUNCTION
/begin FUNCTION zff_ABK_MULTACCESS "desc_en"
 /begin IN_MEASUREMENT MultAccess.DriveLogic MultAccess.DriveLogicOld MultAccess.DriveLogicTrig MultAccess.DrvReqPRND_Raw MultAccess.DrvReqP_Trig MultAccess.DrvReq_Old MultAccess.DrvReq_Trig MultAccess.GatePos MultAccess.GatePosOld MultAccess.cnt_SimOperations MultAccess.f_P12ButtonOld MultAccess.f_SDButton MultAccess.f_SDButtonRawOff MultAccess.f_SDButtonRawOld MultAccess.f_SDButtonRawOn MultAccess.f_SportButton MultAccess.f_SportButtonRaw MultAccess.f_SportButtonRawOld MultAccess.f_SportButtonTrig MultAccess.st_EmfP_Old MultAccess.st_EmfP_Trig MultAccess.st_TipMinus1 MultAccess.st_TipMinus1Old MultAccess.st_TipMinus1Trig MultAccess.st_TipMinus2 MultAccess.st_TipMinus2Old MultAccess.st_TipMinus2Trig MultAccess.st_TipPlus1 MultAccess.st_TipPlus1Old MultAccess.st_TipPlus1Trig MultAccess.st_TipPlus2 MultAccess.st_TipPlus2Old MultAccess.st_TipPlus2Trig /end IN_MEASUREMENT
/end FUNCTION
/begin FUNCTION zff_ABK_PAKCONFIG "desc_en" /begin IN_MEASUREMENT PAKConfig.PAKConfig_TEST /end IN_MEASUREMENT /end FUNCTION
/begin FUNCTION zff_ABK_POS_INITPOS "desc_en"
 /begin IN_MEASUREMENT InitPos.PosPRND_Init InitPosBPRAM.f_RzN_LimphomeBuf InitPosBPRAM.f_RzN_LimphomeBuf_ /end IN_MEASUREMENT
/end FUNCTION
/begin FUNCTION zff_ABK_POWERDOWN "desc_en" /begin IN_MEASUREMENT PowerDown.f_PowDownEnable PowerDown.st_PowerDownDelay /end IN_MEASUREMENT /end FUNCTION
/begin FUNCTION zff_ABK_RELTOABS "desc_en" /begin IN_MEASUREMENT RelToAbs.DrvReq_Raw /end IN_MEASUREMENT /end FUNCTION
/begin FUNCTION zff_ABK_SHIFTLOCK "desc_en"
 /begin IN_MEASUREMENT ShiftLock.DrvReqPRND_SL ShiftLock.Shiftlock_Brake.cShiftlock_SubModule._.f_Active ShiftLock.Shiftlock_CAN.cShiftlock_SubModule._.f_Active ShiftLock.Shiftlock_Engine.cShiftlock_SubModule._.f_Active ShiftLock.Shiftlock_RemoteStart.cShiftlock_SubModule._.f_Active ShiftLock.Shiftlock_RemoteStart.f_RemoteStart ShiftLock.Shiftlock_RemoteStart.f_RemoteStart_SLDisable ShiftLock.f_CC_ShiftlockActive ShiftLock.f_Shiftlock_Brake ShiftLock.f_Shiftlock_CAN ShiftLock.f_Shiftlock_Engine ShiftLock.f_Shiftlock_RemoteStart /end IN_MEASUREMENT
/end FUNCTION
/begin FUNCTION zff_ABK_SIGNAL_CONDITIONING "desc_en" /begin IN_MEASUREMENT SignalConditioning.f_cc_PSAbuse /end IN_MEASUREMENT /end FUNCTION
/begin FUNCTION zff_ABK_SIGNALS "desc_en"
 /begin IN_MEASUREMENT CyclePos10msIn20ms.cnt_Position GlobalSignals.IgnOnSts GlobalSignals.f_AcceleratorPedalPressed GlobalSignals.f_BrakePedalSL GlobalSignals.f_FaultFiltDisplay GlobalSignals.f_HotCondReset GlobalSignals.f_HotCond_1 GlobalSignals.f_HotCond_2 GlobalSignals.f_HotCond_3 GlobalSignals.f_IgnOn GlobalSignals.f_IgnOn_RisingEdg GlobalSignals.f_MechLimp GlobalSignals.f_P12BadOp GlobalSignals.f_P12BadOpOld GlobalSignals.f_P12BadOpTrig GlobalSignals.f_ParkLock GlobalSignals.f_PosChangeByDiag GlobalSignals.f_ResyncNeeded GlobalSignals.st_Hotmode GlobalSignals.st_Hotmode_pre GlobalSignals.st_SpeedCondD GlobalSignals.st_SpeedCondP GlobalSignals.st_SpeedCondR GlobalSignals.v_VehSpdMin InitPos.f_ResUBatt InitPosBPRAM.DirBuf InitPosBPRAM.DirBuf_ InitPosBPRAM.PosPRNDBuf InitPosBPRAM.PosPRNDBuf_ InitPosBPRAM.PosPRND_4RzN_Buf InitPosBPRAM.PosPRND_4RzN_Buf_ InitPosBPRAM.f_MechLimpBuf InitPosBPRAM.f_MechLimpBuf_ InitPosBPRAM.st_InverseCoasting InitPosBPRAM.st_InverseCoasting_ /end IN_MEASUREMENT
/end FUNCTION
/begin FUNCTION zff_ABK_SRVCMSGHANDLER "desc_en"
 /begin IN_MEASUREMENT SrvcMsgHandler.LastSemaphore SrvcMsgHandler.MSA_Msg_Function_Requester SrvcMsgHandler.MSA_Msg_Function_Selection SrvcMsgHandler.cnt_NrOfOverdueMsgs SrvcMsgHandler.cnt_Send_Counter SrvcMsgHandler.st_SendMSA_MSg /end IN_MEASUREMENT
/end FUNCTION
/begin FUNCTION zff_ABK_STARTERRELEASE "desc_en" /begin IN_MEASUREMENT StarterRelease.st_StarterRelease /end IN_MEASUREMENT /end FUNCTION
/begin FUNCTION zff_ABK_STARTERRELEASEBMW "desc_en"
 /begin IN_MEASUREMENT StarterReleaseOEM.st_StarterRelease StarterReleaseOEM.st_StarterRelease_ /end IN_MEASUREMENT
/end FUNCTION
/begin FUNCTION zff_ABK_STARTERRELEASEBPRAM "desc_en"
 /begin IN_MEASUREMENT StarterReleaseBPRam.f_DelayCrankInMechLimpBPRam StarterReleaseBPRam.f_DelayCrankInMechLimpBPRam_ /end IN_MEASUREMENT
/end FUNCTION
/begin FUNCTION zff_ABK_STATISTICCOUNTER "desc_en"
 /begin IN_MEASUREMENT StatisticCounter.SportLevel StatisticCounter.cnt_AdaptiveMode StatisticCounter.cnt_ManualMode StatisticCounter.cnt_SportMode /end IN_MEASUREMENT
/end FUNCTION
/begin FUNCTION zff_ABK_STOREDRVREQ "desc_en"
 /begin IN_MEASUREMENT StoreDrvReq.DrvReqPRND StoreDrvReq.DrvReqPRND_FiltPrev StoreDrvReq.f_NoStoreN StoreDrvReq.f_NoStoreP StoreDrvReq.f_NoStoreRD StoreDrvReq.f_StartRestartOrResetOfStorageOccured StoreDrvReq.st_StorePRND /end IN_MEASUREMENT
/end FUNCTION
/begin FUNCTION zff_ABK_TESTERACCESS "desc_en"
 /begin IN_MEASUREMENT TesterAccess.DiagTestLever TesterAccess.DiagTestSBW TesterAccess.DiagTestSteptronic TesterAccess.DummyUI8 TesterAccess.DummyUI8_SBW_CGT40_M TesterAccess.Faulttype /end IN_MEASUREMENT
/end FUNCTION
/begin FUNCTION zff_ABK_TIMER "desc_en"
 /begin IN_MEASUREMENT CCMsg.IDEmpty.cCC_ID._.tmr_ID_CycleTime.f_IsExpired CCMsg.IDEmpty.cCC_ID._.tmr_ID_CycleTime.time CCMsg.IDEmpty.cCC_ID._.tmr_ID_HoldCC.f_IsExpired CCMsg.IDEmpty.cCC_ID._.tmr_ID_HoldCC.time CCMsg.IDEmpty.cCC_ID._.tmr_ID_MinTime.f_IsExpired CCMsg.IDEmpty.cCC_ID._.tmr_ID_MinTime.time CCMsg.IDEmpty.cCC_ID._.tmr_ID_delay.f_IsExpired CCMsg.IDEmpty.cCC_ID._.tmr_ID_delay.time CCMsg.ID_DrvLeavesCar.cCC_ID._.tmr_ID_CycleTime.f_IsExpired CCMsg.ID_DrvLeavesCar.cCC_ID._.tmr_ID_CycleTime.time CCMsg.ID_DrvLeavesCar.cCC_ID._.tmr_ID_HoldCC.f_IsExpired CCMsg.ID_DrvLeavesCar.cCC_ID._.tmr_ID_HoldCC.time CCMsg.ID_DrvLeavesCar.cCC_ID._.tmr_ID_MinTime.f_IsExpired CCMsg.ID_DrvLeavesCar.cCC_ID._.tmr_ID_MinTime.time CCMsg.ID_DrvLeavesCar.cCC_ID._.tmr_ID_delay.f_IsExpired CCMsg.ID_DrvLeavesCar.cCC_ID._.tmr_ID_delay.time CCMsg.ID_DrvLeavesCar_BeltLocked.cCC_ID._.tmr_ID_CycleTime.f_IsExpired CCMsg.ID_DrvLeavesCar_BeltLocked.cCC_ID._.tmr_ID_CycleTime.time CCMsg.ID_DrvLeavesCar_BeltLocked.cCC_ID._.tmr_ID_HoldCC.f_IsExpired CCMsg.ID_DrvLeavesCar_BeltLocked.cCC_ID._.tmr_ID_HoldCC.time CCMsg.ID_DrvLeavesCar_BeltLocked.cCC_ID._.tmr_ID_MinTime.f_IsExpired CCMsg.ID_DrvLeavesCar_BeltLocked.cCC_ID._.tmr_ID_MinTime.time CCMsg.ID_DrvLeavesCar_BeltLocked.cCC_ID._.tmr_ID_delay.f_IsExpired CCMsg.ID_DrvLeavesCar_BeltLocked.cCC_ID._.tmr_ID_delay.time CCMsg.ID_GearboxWarning1.cCC_ID._.tmr_ID_CycleTime.f_IsExpired CCMsg.ID_GearboxWarning1.cCC_ID._.tmr_ID_CycleTime.time CCMsg.ID_GearboxWarning1.cCC_ID._.tmr_ID_HoldCC.f_IsExpired CCMsg.ID_GearboxWarning1.cCC_ID._.tmr_ID_HoldCC.time CCMsg.ID_GearboxWarning1.cCC_ID._.tmr_ID_MinTime.f_IsExpired CCMsg.ID_GearboxWarning1.cCC_ID._.tmr_ID_MinTime.time CCMsg.ID_GearboxWarning1.cCC_ID._.tmr_ID_delay.f_IsExpired CCMsg.ID_GearboxWarning1.cCC_ID._.tmr_ID_delay.time CCMsg.ID_GearboxWarning2.cCC_ID._.tmr_ID_CycleTime.f_IsExpired CCMsg.ID_GearboxWarning2.cCC_ID._.tmr_ID_CycleTime.time CCMsg.ID_GearboxWarning2.cCC_ID._.tmr_ID_HoldCC.f_IsExpired CCMsg.ID_GearboxWarning2.cCC_ID._.tmr_ID_HoldCC.time CCMsg.ID_GearboxWarning2.cCC_ID._.tmr_ID_MinTime.f_IsExpired CCMsg.ID_GearboxWarning2.cCC_ID._.tmr_ID_MinTime.time CCMsg.ID_GearboxWarning2.cCC_ID._.tmr_ID_delay.f_IsExpired CCMsg.ID_GearboxWarning2.cCC_ID._.tmr_ID_delay.time CCMsg.ID_GongBadOp.cCC_ID._.tmr_ID_CycleTime.f_IsExpired CCMsg.ID_GongBadOp.cCC_ID._.tmr_ID_CycleTime.time CCMsg.ID_GongBadOp.cCC_ID._.tmr_ID_HoldCC.f_IsExpired CCMsg.ID_GongBadOp.cCC_ID._.tmr_ID_HoldCC.time CCMsg.ID_GongBadOp.cCC_ID._.tmr_ID_MinTime.f_IsExpired CCMsg.ID_GongBadOp.cCC_ID._.tmr_ID_MinTime.time CCMsg.ID_GongBadOp.cCC_ID._.tmr_ID_delay.f_IsExpired CCMsg.ID_GongBadOp.cCC_ID._.tmr_ID_delay.time CCMsg.ID_GongInMechLimp.cCC_ID._.tmr_ID_CycleTime.f_IsExpired CCMsg.ID_GongInMechLimp.cCC_ID._.tmr_ID_CycleTime.time CCMsg.ID_GongInMechLimp.cCC_ID._.tmr_ID_HoldCC.f_IsExpired CCMsg.ID_GongInMechLimp.cCC_ID._.tmr_ID_HoldCC.time CCMsg.ID_GongInMechLimp.cCC_ID._.tmr_ID_MinTime.f_IsExpired CCMsg.ID_GongInMechLimp.cCC_ID._.tmr_ID_MinTime.time CCMsg.ID_GongInMechLimp.cCC_ID._.tmr_ID_delay.f_IsExpired CCMsg.ID_GongInMechLimp.cCC_ID._.tmr_ID_delay.time CCMsg.ID_GongWrongDrvDir.cCC_ID._.tmr_ID_CycleTime.f_IsExpired CCMsg.ID_GongWrongDrvDir.cCC_ID._.tmr_ID_CycleTime.time CCMsg.ID_GongWrongDrvDir.cCC_ID._.tmr_ID_HoldCC.f_IsExpired CCMsg.ID_GongWrongDrvDir.cCC_ID._.tmr_ID_HoldCC.time CCMsg.ID_GongWrongDrvDir.cCC_ID._.tmr_ID_MinTime.f_IsExpired CCMsg.ID_GongWrongDrvDir.cCC_ID._.tmr_ID_MinTime.time CCMsg.ID_GongWrongDrvDir.cCC_ID._.tmr_ID_delay.f_IsExpired CCMsg.ID_GongWrongDrvDir.cCC_ID._.tmr_ID_delay.time CCMsg.ID_Hotmode1.cCC_ID._.tmr_ID_CycleTime.f_IsExpired CCMsg.ID_Hotmode1.cCC_ID._.tmr_ID_CycleTime.time CCMsg.ID_Hotmode1.cCC_ID._.tmr_ID_HoldCC.f_IsExpired CCMsg.ID_Hotmode1.cCC_ID._.tmr_ID_HoldCC.time CCMsg.ID_Hotmode1.cCC_ID._.tmr_ID_MinTime.f_IsExpired CCMsg.ID_Hotmode1.cCC_ID._.tmr_ID_MinTime.time CCMsg.ID_Hotmode1.cCC_ID._.tmr_ID_delay.f_IsExpired CCMsg.ID_Hotmode1.cCC_ID._.tmr_ID_delay.time CCMsg.ID_Hotmode2.cCC_ID._.tmr_ID_CycleTime.f_IsExpired CCMsg.ID_Hotmode2.cCC_ID._.tmr_ID_CycleTime.time CCMsg.ID_Hotmode2.cCC_ID._.tmr_ID_HoldCC.f_IsExpired CCMsg.ID_Hotmode2.cCC_ID._.tmr_ID_HoldCC.time CCMsg.ID_Hotmode2.cCC_ID._.tmr_ID_MinTime.f_IsExpired CCMsg.ID_Hotmode2.cCC_ID._.tmr_ID_MinTime.time CCMsg.ID_Hotmode2.cCC_ID._.tmr_ID_delay.f_IsExpired CCMsg.ID_Hotmode2.cCC_ID._.tmr_ID_delay.time CCMsg.ID_Hotmode3.cCC_ID._.tmr_ID_CycleTime.f_IsExpired CCMsg.ID_Hotmode3.cCC_ID._.tmr_ID_CycleTime.time CCMsg.ID_Hotmode3.cCC_ID._.tmr_ID_HoldCC.f_IsExpired CCMsg.ID_Hotmode3.cCC_ID._.tmr_ID_HoldCC.time CCMsg.ID_Hotmode3.cCC_ID._.tmr_ID_MinTime.f_IsExpired CCMsg.ID_Hotmode3.cCC_ID._.tmr_ID_MinTime.time CCMsg.ID_Hotmode3.cCC_ID._.tmr_ID_delay.f_IsExpired CCMsg.ID_Hotmode3.cCC_ID._.tmr_ID_delay.time CCMsg.ID_IgnitionError.cCC_ID._.tmr_ID_CycleTime.f_IsExpired CCMsg.ID_IgnitionError.cCC_ID._.tmr_ID_CycleTime.time CCMsg.ID_IgnitionError.cCC_ID._.tmr_ID_HoldCC.f_IsExpired CCMsg.ID_IgnitionError.cCC_ID._.tmr_ID_HoldCC.time CCMsg.ID_IgnitionError.cCC_ID._.tmr_ID_MinTime.f_IsExpired CCMsg.ID_IgnitionError.cCC_ID._.tmr_ID_MinTime.time CCMsg.ID_IgnitionError.cCC_ID._.tmr_ID_delay.f_IsExpired CCMsg.ID_IgnitionError.cCC_ID._.tmr_ID_delay.time CCMsg.ID_MechLimpInD.cCC_ID._.tmr_ID_CycleTime.f_IsExpired CCMsg.ID_MechLimpInD.cCC_ID._.tmr_ID_CycleTime.time CCMsg.ID_MechLimpInD.cCC_ID._.tmr_ID_HoldCC.f_IsExpired CCMsg.ID_MechLimpInD.cCC_ID._.tmr_ID_HoldCC.time CCMsg.ID_MechLimpInD.cCC_ID._.tmr_ID_MinTime.f_IsExpired CCMsg.ID_MechLimpInD.cCC_ID._.tmr_ID_MinTime.time CCMsg.ID_MechLimpInD.cCC_ID._.tmr_ID_delay.f_IsExpired CCMsg.ID_MechLimpInD.cCC_ID._.tmr_ID_delay.time CCMsg.ID_MechLimpInP.cCC_ID._.tmr_ID_CycleTime.f_IsExpired CCMsg.ID_MechLimpInP.cCC_ID._.tmr_ID_CycleTime.time CCMsg.ID_MechLimpInP.cCC_ID._.tmr_ID_HoldCC.f_IsExpired CCMsg.ID_MechLimpInP.cCC_ID._.tmr_ID_HoldCC.time CCMsg.ID_MechLimpInP.cCC_ID._.tmr_ID_MinTime.f_IsExpired CCMsg.ID_MechLimpInP.cCC_ID._.tmr_ID_MinTime.time CCMsg.ID_MechLimpInP.cCC_ID._.tmr_ID_delay.f_IsExpired CCMsg.ID_MechLimpInP.cCC_ID._.tmr_ID_delay.time CCMsg.ID_PS_Abuse.cCC_ID._.tmr_ID_CycleTime.f_IsExpired CCMsg.ID_PS_Abuse.cCC_ID._.tmr_ID_CycleTime.time CCMsg.ID_PS_Abuse.cCC_ID._.tmr_ID_HoldCC.f_IsExpired CCMsg.ID_PS_Abuse.cCC_ID._.tmr_ID_HoldCC.time CCMsg.ID_PS_Abuse.cCC_ID._.tmr_ID_MinTime.f_IsExpired CCMsg.ID_PS_Abuse.cCC_ID._.tmr_ID_MinTime.time CCMsg.ID_PS_Abuse.cCC_ID._.tmr_ID_delay.f_IsExpired CCMsg.ID_PS_Abuse.cCC_ID._.tmr_ID_delay.time CCMsg.ID_P_ButtonError.cCC_ID._.tmr_ID_CycleTime.f_IsExpired CCMsg.ID_P_ButtonError.cCC_ID._.tmr_ID_CycleTime.time CCMsg.ID_P_ButtonError.cCC_ID._.tmr_ID_HoldCC.f_IsExpired CCMsg.ID_P_ButtonError.cCC_ID._.tmr_ID_HoldCC.time CCMsg.ID_P_ButtonError.cCC_ID._.tmr_ID_MinTime.f_IsExpired CCMsg.ID_P_ButtonError.cCC_ID._.tmr_ID_MinTime.time CCMsg.ID_P_ButtonError.cCC_ID._.tmr_ID_delay.f_IsExpired CCMsg.ID_P_ButtonError.cCC_ID._.tmr_ID_delay.time CCMsg.ID_ParkLockFault.cCC_ID._.tmr_ID_CycleTime.f_IsExpired CCMsg.ID_ParkLockFault.cCC_ID._.tmr_ID_CycleTime.time CCMsg.ID_ParkLockFault.cCC_ID._.tmr_ID_HoldCC.f_IsExpired CCMsg.ID_ParkLockFault.cCC_ID._.tmr_ID_HoldCC.time CCMsg.ID_ParkLockFault.cCC_ID._.tmr_ID_MinTime.f_IsExpired CCMsg.ID_ParkLockFault.cCC_ID._.tmr_ID_MinTime.time CCMsg.ID_ParkLockFault.cCC_ID._.tmr_ID_delay.f_IsExpired CCMsg.ID_ParkLockFault.cCC_ID._.tmr_ID_delay.time CCMsg.ID_ParkLockFault_IEP_On.cCC_ID._.tmr_ID_CycleTime.f_IsExpired CCMsg.ID_ParkLockFault_IEP_On.cCC_ID._.tmr_ID_CycleTime.time CCMsg.ID_ParkLockFault_IEP_On.cCC_ID._.tmr_ID_HoldCC.f_IsExpired CCMsg.ID_ParkLockFault_IEP_On.cCC_ID._.tmr_ID_HoldCC.time CCMsg.ID_ParkLockFault_IEP_On.cCC_ID._.tmr_ID_MinTime.f_IsExpired CCMsg.ID_ParkLockFault_IEP_On.cCC_ID._.tmr_ID_MinTime.time CCMsg.ID_ParkLockFault_IEP_On.cCC_ID._.tmr_ID_delay.f_IsExpired CCMsg.ID_ParkLockFault_IEP_On.cCC_ID._.tmr_ID_delay.time CCMsg.ID_ParkLockFault_InMechLimp.cCC_ID._.tmr_ID_CycleTime.f_IsExpired CCMsg.ID_ParkLockFault_InMechLimp.cCC_ID._.tmr_ID_CycleTime.time CCMsg.ID_ParkLockFault_InMechLimp.cCC_ID._.tmr_ID_HoldCC.f_IsExpired CCMsg.ID_ParkLockFault_InMechLimp.cCC_ID._.tmr_ID_HoldCC.time CCMsg.ID_ParkLockFault_InMechLimp.cCC_ID._.tmr_ID_MinTime.f_IsExpired CCMsg.ID_ParkLockFault_InMechLimp.cCC_ID._.tmr_ID_MinTime.time CCMsg.ID_ParkLockFault_InMechLimp.cCC_ID._.tmr_ID_delay.f_IsExpired CCMsg.ID_ParkLockFault_InMechLimp.cCC_ID._.tmr_ID_delay.time CCMsg.ID_PosN_Warning.cCC_ID._.tmr_ID_CycleTime.f_IsExpired CCMsg.ID_PosN_Warning.cCC_ID._.tmr_ID_CycleTime.time CCMsg.ID_PosN_Warning.cCC_ID._.tmr_ID_HoldCC.f_IsExpired CCMsg.ID_PosN_Warning.cCC_ID._.tmr_ID_HoldCC.time CCMsg.ID_PosN_Warning.cCC_ID._.tmr_ID_MinTime.f_IsExpired CCMsg.ID_PosN_Warning.cCC_ID._.tmr_ID_MinTime.time CCMsg.ID_PosN_Warning.cCC_ID._.tmr_ID_delay.f_IsExpired CCMsg.ID_PosN_Warning.cCC_ID._.tmr_ID_delay.time CCMsg.ID_ShiftWithoutBrakeWarning.cCC_ID._.tmr_ID_CycleTime.f_IsExpired CCMsg.ID_ShiftWithoutBrakeWarning.cCC_ID._.tmr_ID_CycleTime.time CCMsg.ID_ShiftWithoutBrakeWarning.cCC_ID._.tmr_ID_HoldCC.f_IsExpired CCMsg.ID_ShiftWithoutBrakeWarning.cCC_ID._.tmr_ID_HoldCC.time CCMsg.ID_ShiftWithoutBrakeWarning.cCC_ID._.tmr_ID_MinTime.f_IsExpired CCMsg.ID_ShiftWithoutBrakeWarning.cCC_ID._.tmr_ID_MinTime.time CCMsg.ID_ShiftWithoutBrakeWarning.cCC_ID._.tmr_ID_delay.f_IsExpired CCMsg.ID_ShiftWithoutBrakeWarning.cCC_ID._.tmr_ID_delay.time CCMsg.ID_ShifterError.cCC_ID._.tmr_ID_CycleTime.f_IsExpired CCMsg.ID_ShifterError.cCC_ID._.tmr_ID_CycleTime.time CCMsg.ID_ShifterError.cCC_ID._.tmr_ID_HoldCC.f_IsExpired CCMsg.ID_ShifterError.cCC_ID._.tmr_ID_HoldCC.time CCMsg.ID_ShifterError.cCC_ID._.tmr_ID_MinTime.f_IsExpired CCMsg.ID_ShifterError.cCC_ID._.tmr_ID_MinTime.time CCMsg.ID_ShifterError.cCC_ID._.tmr_ID_delay.f_IsExpired CCMsg.ID_ShifterError.cCC_ID._.tmr_ID_delay.time CCMsg.ID_ShiftlockBrakeWarning.cCC_ID._.tmr_ID_CycleTime.f_IsExpired CCMsg.ID_ShiftlockBrakeWarning.cCC_ID._.tmr_ID_CycleTime.time CCMsg.ID_ShiftlockBrakeWarning.cCC_ID._.tmr_ID_HoldCC.f_IsExpired CCMsg.ID_ShiftlockBrakeWarning.cCC_ID._.tmr_ID_HoldCC.time CCMsg.ID_ShiftlockBrakeWarning.cCC_ID._.tmr_ID_MinTime.f_IsExpired CCMsg.ID_ShiftlockBrakeWarning.cCC_ID._.tmr_ID_MinTime.time CCMsg.ID_ShiftlockBrakeWarning.cCC_ID._.tmr_ID_delay.f_IsExpired CCMsg.ID_ShiftlockBrakeWarning.cCC_ID._.tmr_ID_delay.time CCMsg.ID_Speed2HighForDrvReqP.cCC_ID._.tmr_ID_CycleTime.f_IsExpired CCMsg.ID_Speed2HighForDrvReqP.cCC_ID._.tmr_ID_CycleTime.time CCMsg.ID_Speed2HighForDrvReqP.cCC_ID._.tmr_ID_HoldCC.f_IsExpired CCMsg.ID_Speed2HighForDrvReqP.cCC_ID._.tmr_ID_HoldCC.time CCMsg.ID_Speed2HighForDrvReqP.cCC_ID._.tmr_ID_MinTime.f_IsExpired CCMsg.ID_Speed2HighForDrvReqP.cCC_ID._.tmr_ID_MinTime.time CCMsg.ID_Speed2HighForDrvReqP.cCC_ID._.tmr_ID_delay.f_IsExpired CCMsg.ID_Speed2HighForDrvReqP.cCC_ID._.tmr_ID_delay.time CCMsg.ID_Speed2HighInPosP.cCC_ID._.tmr_ID_CycleTime.f_IsExpired CCMsg.ID_Speed2HighInPosP.cCC_ID._.tmr_ID_CycleTime.time CCMsg.ID_Speed2HighInPosP.cCC_ID._.tmr_ID_HoldCC.f_IsExpired CCMsg.ID_Speed2HighInPosP.cCC_ID._.tmr_ID_HoldCC.time CCMsg.ID_Speed2HighInPosP.cCC_ID._.tmr_ID_MinTime.f_IsExpired CCMsg.ID_Speed2HighInPosP.cCC_ID._.tmr_ID_MinTime.time CCMsg.ID_Speed2HighInPosP.cCC_ID._.tmr_ID_delay.f_IsExpired CCMsg.ID_Speed2HighInPosP.cCC_ID._.tmr_ID_delay.time CCMsg.ID_V_ImplausibleInPosP.cCC_ID._.tmr_ID_CycleTime.f_IsExpired CCMsg.ID_V_ImplausibleInPosP.cCC_ID._.tmr_ID_CycleTime.time CCMsg.ID_V_ImplausibleInPosP.cCC_ID._.tmr_ID_HoldCC.f_IsExpired CCMsg.ID_V_ImplausibleInPosP.cCC_ID._.tmr_ID_HoldCC.time CCMsg.ID_V_ImplausibleInPosP.cCC_ID._.tmr_ID_MinTime.f_IsExpired CCMsg.ID_V_ImplausibleInPosP.cCC_ID._.tmr_ID_MinTime.time CCMsg.ID_V_ImplausibleInPosP.cCC_ID._.tmr_ID_delay.f_IsExpired CCMsg.ID_V_ImplausibleInPosP.cCC_ID._.tmr_ID_delay.time DebounceDrvReq.tmr_DebounceDrvReq.f_IsExpired DebounceDrvReq.tmr_DebounceDrvReq.time DiagPos.tmr_DelayGbxTempReqP.f_IsExpired DiagPos.tmr_DelayGbxTempReqP.time DisplayMonitoring.L2_tmr_BackFilterNPorRDinsteadDR.f_IsExpired.Complement DisplayMonitoring.L2_tmr_BackFilterNPorRDinsteadDR.f_IsExpired.Value DisplayMonitoring.L2_tmr_BackFilterNPorRDinsteadDR.time.Complement DisplayMonitoring.L2_tmr_BackFilterNPorRDinsteadDR.time.Value DisplayMonitoring.L2_tmr_BackFilterPosPinPosN.f_IsExpired.Complement DisplayMonitoring.L2_tmr_BackFilterPosPinPosN.f_IsExpired.Value DisplayMonitoring.L2_tmr_BackFilterPosPinPosN.time.Complement DisplayMonitoring.L2_tmr_BackFilterPosPinPosN.time.Value DisplayMonitoring.L2_tmr_FilterNPorRDinsteadDR.f_IsExpired.Complement DisplayMonitoring.L2_tmr_FilterNPorRDinsteadDR.f_IsExpired.Value DisplayMonitoring.L2_tmr_FilterNPorRDinsteadDR.time.Complement DisplayMonitoring.L2_tmr_FilterNPorRDinsteadDR.time.Value DisplayMonitoring.L2_tmr_FilterPosPinPosN.f_IsExpired.Complement DisplayMonitoring.L2_tmr_FilterPosPinPosN.f_IsExpired.Value DisplayMonitoring.L2_tmr_FilterPosPinPosN.time.Complement DisplayMonitoring.L2_tmr_FilterPosPinPosN.time.Value DisplayMonitoring.L2_tmr_FlashN.f_IsExpired.Complement DisplayMonitoring.L2_tmr_FlashN.f_IsExpired.Value DisplayMonitoring.L2_tmr_FlashN.time.Complement DisplayMonitoring.L2_tmr_FlashN.time.Value DrvPresenceDetector.tmr_DrvLeavesCarInN.f_IsExpired DrvPresenceDetector.tmr_DrvLeavesCarInN.time EngineSignals.tmr_DebounceGearboxReady.f_IsExpired EngineSignals.tmr_DebounceGearboxReady.time EngineSignals.tmr_DebounceGearboxReadySts.f_IsExpired EngineSignals.tmr_DebounceGearboxReadySts.time GlobalSignals.tmr_DebounceOilChipTransErr.f_IsExpired GlobalSignals.tmr_DebounceOilChipTransErr.time GlobalSignals.tmr_P12BadOp.f_IsExpired GlobalSignals.tmr_P12BadOp.time KombiMsg.tmr_IgnOnNeverDetected.f_IsExpired KombiMsg.tmr_IgnOnNeverDetected.time KombiMsg.tmr_P12BadOpDisp.f_IsExpired KombiMsg.tmr_P12BadOpDisp.time KombiMsgFlash.tmr_FlashN.f_IsExpired KombiMsgFlash.tmr_FlashN.time KombiMsgFlash.tmr_FlashNInWrongDrvDir.f_IsExpired KombiMsgFlash.tmr_FlashNInWrongDrvDir.time Level2Signals.L2_tmr_DebounceGearboxReady.f_IsExpired.Complement Level2Signals.L2_tmr_DebounceGearboxReady.f_IsExpired.Value Level2Signals.L2_tmr_DebounceGearboxReady.time.Complement Level2Signals.L2_tmr_DebounceGearboxReady.time.Value Level2Signals.L2_tmr_DebounceGearboxReadySts.f_IsExpired.Complement Level2Signals.L2_tmr_DebounceGearboxReadySts.f_IsExpired.Value Level2Signals.L2_tmr_DebounceGearboxReadySts.time.Complement Level2Signals.L2_tmr_DebounceGearboxReadySts.time.Value Mode.tmr_ModeReturnTip1.f_IsExpired Mode.tmr_ModeReturnTip1.time Mode.tmr_ModeReturnTip2.f_IsExpired Mode.tmr_ModeReturnTip2.time ModeIn.tmr_DelayMGate.f_IsExpired ModeIn.tmr_DelayMGate.time PosMonitoring.L2_tmr_D_Request.f_IsExpired.Complement PosMonitoring.L2_tmr_D_Request.f_IsExpired.Value PosMonitoring.L2_tmr_D_Request.time.Complement PosMonitoring.L2_tmr_D_Request.time.Value PosMonitoring.L2_tmr_D_t_StoreN.f_IsExpired.Complement PosMonitoring.L2_tmr_D_t_StoreN.f_IsExpired.Value PosMonitoring.L2_tmr_D_t_StoreN.time.Complement PosMonitoring.L2_tmr_D_t_StoreN.time.Value PosMonitoring.L2_tmr_DelayShiftlockBrake.f_IsExpired.Complement PosMonitoring.L2_tmr_DelayShiftlockBrake.f_IsExpired.Value PosMonitoring.L2_tmr_DelayShiftlockBrake.time.Complement PosMonitoring.L2_tmr_DelayShiftlockBrake.time.Value PosMonitoring.L2_tmr_N_Request.f_IsExpired.Complement PosMonitoring.L2_tmr_N_Request.f_IsExpired.Value PosMonitoring.L2_tmr_N_Request.time.Complement PosMonitoring.L2_tmr_N_Request.time.Value PosMonitoring.L2_tmr_R_Request.f_IsExpired.Complement PosMonitoring.L2_tmr_R_Request.f_IsExpired.Value PosMonitoring.L2_tmr_R_Request.time.Complement PosMonitoring.L2_tmr_R_Request.time.Value PosMonitoring.L2_tmr_Rocking.f_IsExpired.Complement PosMonitoring.L2_tmr_Rocking.f_IsExpired.Value PosMonitoring.L2_tmr_Rocking.time.Complement PosMonitoring.L2_tmr_Rocking.time.Value PosMonitoring.L2_tmr_WaitForDebouncedDrvReq.f_IsExpired.Complement PosMonitoring.L2_tmr_WaitForDebouncedDrvReq.f_IsExpired.Value PosMonitoring.L2_tmr_WaitForDebouncedDrvReq.time.Complement PosMonitoring.L2_tmr_WaitForDebouncedDrvReq.time.Value PowerDown.tmr_PowDownDelay.f_IsExpired PowerDown.tmr_PowDownDelay.time SignalConditioning.tmr_DiagAfterFirstKL15.f_IsExpired SignalConditioning.tmr_DiagAfterFirstKL15.time SignalConditioning.tmr_DiagAfterKL15.f_IsExpired SignalConditioning.tmr_DiagAfterKL15.time SrvcMsgHandler.tmr_MSA_MsgCyclicSend.f_IsExpired SrvcMsgHandler.tmr_MSA_MsgCyclicSend.time SrvcMsgHandler.tmr_MSA_MsgDebouncing.f_IsExpired SrvcMsgHandler.tmr_MSA_MsgDebouncing.time SrvcMsgHandler.tmr_MSA_MsgWaitResend.f_IsExpired SrvcMsgHandler.tmr_MSA_MsgWaitResend.time StoreDrvReq.tmr_StorePRND.f_IsExpired StoreDrvReq.tmr_StorePRND.time tmr_StarterReleaseBPRam.f_IsExpired tmr_StarterReleaseBPRam.timeBuf tmr_StarterReleaseBPRam.timeBuf_ /end IN_MEASUREMENT
/end FUNCTION
/begin FUNCTION zff_EH "data of Errorhandler" /begin SUB_FUNCTION zff_EH_Messgroessen zff_EH_Applikationsgroessen /end SUB_FUNCTION /end FUNCTION
/begin FUNCTION zff_EH_Applikationsgroessen "all calibration values of Errorhandler"
 /begin SUB_FUNCTION dData_zff_EH_DiagnosisControl_Fktn dData_zff_EH_Obd_Fktn dData_zff_EH_DemWrapper_Fktn dData_zff_EH_CarbHandler_Fktn dData_zff_EH_Erm_Fktn /end SUB_FUNCTION
/end FUNCTION
/begin FUNCTION zff_EH_CarbHandler "desc_en" /begin IN_MEASUREMENT ZFEH_CarbHandler.st_f_ResponsePending /end IN_MEASUREMENT /end FUNCTION
/begin FUNCTION zff_EH_CommonInformation "desc_en" /begin IN_MEASUREMENT ZFEH_Diagnosis.ctl_QuitSubstFunct /end IN_MEASUREMENT /end FUNCTION
/begin FUNCTION zff_EH_CvnCalculation "desc_en"
 /begin IN_MEASUREMENT ZFEH_CvnCalculation.CompLength ZFEH_CvnCalculation.Crc32 ZFEH_CvnCalculation.CrcCompLength ZFEH_CvnCalculation.Cvn ZFEH_CvnCalculation.CvnState ZFEH_CvnCalculation.Length /end IN_MEASUREMENT
/end FUNCTION
/begin FUNCTION zff_EH_Eeprom "desc_en"
 /begin IN_MEASUREMENT ZFEH_Eeprom.cnt_CheckEeData ZFEH_Eeprom.cnt_EEinit ZFEH_Eeprom.cnt_EEvalid ZFEH_Eeprom.cnt_SetDefaultData ZFEH_Eeprom.cnt_SetDefaultDataIgnored ZFEH_Eeprom.st_CheckEeData ZFEH_Eeprom.st_EEvalid /end IN_MEASUREMENT
/end FUNCTION
/begin FUNCTION zff_EH_Erm "desc_en"
 /begin IN_MEASUREMENT ZFEH_Erm.alivecounter_old[0] ZFEH_Erm.alivecounter_old[1] ZFEH_Erm.alivecounter_old[2] ZFEH_Erm.alivecounter_old[3] ZFEH_Erm.alivecounter_old[4] ZFEH_Erm.alivecounter_old[5] ZFEH_Erm.alivecounter_old[6] ZFEH_Erm.alivecounter_old[7] ZFEH_Erm.st_alivecounter[0] ZFEH_Erm.st_alivecounter[1] ZFEH_Erm.st_alivecounter[2] ZFEH_Erm.st_alivecounter[3] ZFEH_Erm.st_alivecounter[4] ZFEH_Erm.st_alivecounter[5] ZFEH_Erm.st_alivecounter[6] ZFEH_Erm.st_alivecounter[7] ZFEH_Erm.st_alivecounter_check[0] ZFEH_Erm.st_alivecounter_check[1] ZFEH_Erm.st_alivecounter_check[2] ZFEH_Erm.st_alivecounter_check[3] ZFEH_Erm.st_alivecounter_check[4] ZFEH_Erm.st_alivecounter_check[5] ZFEH_Erm.st_alivecounter_check[6] ZFEH_Erm.st_alivecounter_check[7] ZFEH_Erm.st_lh_complementcheck ZFEH_Erm.st_lh_complementcheck_ ZFEH_Erm.st_limphome_check ZFEH_Erm.st_limphome_check_ ZFEH_Erm.st_nonegtrqreq_check ZFEH_Erm.st_nonegtrqreq_check_ ZFEH_Erm.st_nopostrqreq_check ZFEH_Erm.st_nopostrqreq_check_ ZFEH_Erm.st_position_check ZFEH_Erm.st_position_check_ /end IN_MEASUREMENT
/end FUNCTION
/end MODULE
/end PROJECT
