ASAP2_VERSION 1 51
/begin PROJECT ZHBC8600 "Gen2_BMW_System_Supplier_Lib"
/begin MODULE CPP ""
/begin MOD_COMMON "" BYTE_ORDER MSB_FIRST ALIGNMENT_BYTE 1 ALIGNMENT_WORD 2 ALIGNMENT_LONG 4 ALIGNMENT_FLOAT32_IEEE 4 ALIGNMENT_FLOAT64_IEEE 1 /end MOD_COMMON
/begin COMPU_METHOD default_S1 "" RAT_FUNC "%6.2" "" COEFFS 0 1 0 0 0 1 /end COMPU_METHOD
/begin COMPU_METHOD UMR___1_10000_0_S5_S3 "int = ((phys * 10000) / 1) - (0) [-]" RAT_FUNC "%5.4" "[-]" COEFFS 0 10000 0 0 0 1 /end COMPU_METHOD
/begin COMPU_METHOD UMR___1_1000_0_S5_S3 "int = ((phys * 1000) / 1) - (0) [-]" RAT_FUNC "%4.3" "[-]" COEFFS 0 1000 0 0 0 1 /end COMPU_METHOD
/begin COMPU_METHOD UMR___1_100_0_S5_S3 "int = ((phys * 100) / 1) - (0) [-]" RAT_FUNC "%3.2" "[-]" COEFFS 0 100 0 0 0 1 /end COMPU_METHOD
/begin COMPU_METHOD UMR___1_10_0_S5_S3 "int = ((phys * 10) / 1) - (0) [-]" RAT_FUNC "%2.1" "[-]" COEFFS 0 10 0 0 0 1 /end COMPU_METHOD
/begin COMPU_METHOD UMR___1_1_0_3_S5_S3 "int = ((phys * 1) / 1) - (0) [-]" RAT_FUNC "%1.0" "[-]" COEFFS 0 1 0 0 0 1 /end COMPU_METHOD
/begin COMPU_METHOD UMR___1_1_0_S5_S3 "int = ((phys * 1) / 1) - (0) [-]" RAT_FUNC "%1.0" "[-]" COEFFS 0 1 0 0 0 1 /end COMPU_METHOD
/begin COMPU_METHOD UMR__SEC_1_1_0_S5_S3 "int = ((phys * 1) / 1) - (0) [1/s]" RAT_FUNC "%1.0" "[1/s]" COEFFS 0 1 0 0 0 1 /end COMPU_METHOD
/begin COMPU_METHOD UMR_BAR__1_1000_0_S5_S3 "int = ((phys * 1000) / 1) - (0) [bar]" RAT_FUNC "%4.3" "[bar]" COEFFS 0 1000 0 0 0 1 /end COMPU_METHOD
/begin COMPU_METHOD UMR_BAR__1_100_0_S5_S3 "int = ((phys * 100) / 1) - (0) [bar]" RAT_FUNC "%3.2" "[bar]" COEFFS 0 100 0 0 0 1 /end COMPU_METHOD
/begin COMPU_METHOD UMR_BAR__1_1_0_S5_S3 "int = ((phys * 1) / 1) - (0) [bar]" RAT_FUNC "%1.0" "[bar]" COEFFS 0 1 0 0 0 1 /end COMPU_METHOD
/begin COMPU_METHOD UMR_BAR_SEC_1_10_0_S5_S3 "int = ((phys * 10) / 1) - (0) [bar/s]" RAT_FUNC "%2.1" "[bar/s]" COEFFS 0 10 0 0 0 1 /end COMPU_METHOD
/begin COMPU_METHOD UMR_GRAD__1_3_M128_S5_S3 "int = ((phys * 3) / 1) - (-128) [Grad]" RAT_FUNC "%4.3" "[Grad]" COEFFS 0 3 128 0 0 1 /end COMPU_METHOD
/begin COMPU_METHOD UMR_GRADC__1_1_0_S5_S3 "int = ((phys * 1) / 1) - (0) [°C]" RAT_FUNC "%1.0" "[°C]" COEFFS 0 1 0 0 0 1 /end COMPU_METHOD
/begin COMPU_METHOD UMR_GRADC__1_1_M40_S5_S3 "int = ((phys * 1) / 1) - (-40) [°C]" RAT_FUNC "%1.0" "[°C]" COEFFS 0 1 40 0 0 1 /end COMPU_METHOD
/begin COMPU_METHOD UMR_GRADC__1_1_M48_S5_S3 "int = ((phys * 1) / 1) - (-48) [°C]" RAT_FUNC "%1.0" "[°C]" COEFFS 0 1 48 0 0 1 /end COMPU_METHOD
/begin COMPU_METHOD UMR_J_K_1_1_0_S5_S3 "int = ((phys * 1) / 1) - (0) [J/(K)]" RAT_FUNC "%1.0" "[J/(K)]" COEFFS 0 1 0 0 0 1 /end COMPU_METHOD
/begin COMPU_METHOD UMR_J_LITERK_1_1_0_S5_S3 "int = ((phys * 1) / 1) - (0) [J/(Liter*K)]" RAT_FUNC "%1.0" "[J/(Liter*K)]" COEFFS 0 1 0 0 0 1 /end COMPU_METHOD
/begin COMPU_METHOD UMR_KGM2__1_1_0_S5_S3 "int = ((phys * 1) / 1) - (0) [kg*m^2]" RAT_FUNC "%1.0" "[kg*m^2]" COEFFS 0 1 0 0 0 1 /end COMPU_METHOD
/begin COMPU_METHOD UMR_LITER_MIN_1_10_0_S5_S3 "int = ((phys * 10) / 1) - (0) [Liter/min]" RAT_FUNC "%2.1" "[Liter/min]" COEFFS 0 10 0 0 0 1 /end COMPU_METHOD
/begin COMPU_METHOD UMR_LITER_MIN_1_1_0_S5_S3 "int = ((phys * 1) / 1) - (0) [Liter/min]" RAT_FUNC "%1.0" "[Liter/min]" COEFFS 0 1 0 0 0 1 /end COMPU_METHOD
/begin COMPU_METHOD UMR_MA__1_1_0_S5_S3 "int = ((phys * 1) / 1) - (0) [mA]" RAT_FUNC "%1.0" "[mA]" COEFFS 0 1 0 0 0 1 /end COMPU_METHOD
/begin COMPU_METHOD UMR_MBAR__1_1_0_S5_S3 "int = ((phys * 1) / 1) - (0) [mbar]" RAT_FUNC "%1.0" "[mbar]" COEFFS 0 1 0 0 0 1 /end COMPU_METHOD
/begin COMPU_METHOD UMR_MSEC__10_1_0_S5_S3 "int = ((phys * 1) / 10) - (0) [ms]" RAT_FUNC "%1.0" "[ms]" COEFFS 0 0.1 0 0 0 1 /end COMPU_METHOD
/begin COMPU_METHOD UMR_MSEC__1_1_0_S5_S3 "int = ((phys * 1) / 1) - (0) [ms]" RAT_FUNC "%1.0" "[ms]" COEFFS 0 1 0 0 0 1 /end COMPU_METHOD
/begin COMPU_METHOD UMR_NM__1_1_0_S5_S3 "int = ((phys * 1) / 1) - (0) [Nm]" RAT_FUNC "%1.0" "[Nm]" COEFFS 0 1 0 0 0 1 /end COMPU_METHOD
/begin COMPU_METHOD UMR_NM_BAR_1_1_0_S5_S3 "int = ((phys * 1) / 1) - (0) [Nm/bar]" RAT_FUNC "%1.0" "[Nm/bar]" COEFFS 0 1 0 0 0 1 /end COMPU_METHOD
/begin COMPU_METHOD UMR_NM_SEC_1_1_0_S5_S3 "int = ((phys * 1) / 1) - (0) [Nm/s]" RAT_FUNC "%1.0" "[Nm/s]" COEFFS 0 1 0 0 0 1 /end COMPU_METHOD
/begin COMPU_METHOD UMR_PROZENT__16_10_0_S5_S3 "int = ((phys * 10) / 16) - (0) [%]" RAT_FUNC "%2.1" "[%]" COEFFS 0 0.625 0 0 0 1 /end COMPU_METHOD
/begin COMPU_METHOD UMR_PROZENT__1_100_0_S5_S3 "int = ((phys * 100) / 1) - (0) [%]" RAT_FUNC "%3.2" "[%]" COEFFS 0 100 0 0 0 1 /end COMPU_METHOD
/begin COMPU_METHOD UMR_PROZENT__20_51_0_S5_S3 "int = ((phys * 51) / 20) - (0) [%]" RAT_FUNC "%5.4" "[%]" COEFFS 0 2.55 0 0 0 1 /end COMPU_METHOD
/begin COMPU_METHOD UMR_PROZENT_SEC_20_51_0_S5_S3 "int = ((phys * 51) / 20) - (0) [%/s]" RAT_FUNC "%5.4" "[%/s]" COEFFS 0 2.55 0 0 0 1 /end COMPU_METHOD
/begin COMPU_METHOD UMR_SEC__1_1000_0_S5_S3 "int = ((phys * 1000) / 1) - (0) [s]" RAT_FUNC "%4.3" "[s]" COEFFS 0 1000 0 0 0 1 /end COMPU_METHOD
/begin COMPU_METHOD UMR_SEC__1_100_0_S5_S3 "int = ((phys * 100) / 1) - (0) [s]" RAT_FUNC "%3.2" "[s]" COEFFS 0 100 0 0 0 1 /end COMPU_METHOD
/begin COMPU_METHOD UMR_SEC__1_1_0_S5_S3 "int = ((phys * 1) / 1) - (0) [s]" RAT_FUNC "%1.0" "[s]" COEFFS 0 1 0 0 0 1 /end COMPU_METHOD
/begin COMPU_METHOD UMR_U_MIN_1_1_0_S5_S3 "int = ((phys * 1) / 1) - (0) [U/min]" RAT_FUNC "%1.0" "[U/min]" COEFFS 0 1 0 0 0 1 /end COMPU_METHOD
/begin COMPU_METHOD UMR_U_MINMSEC_1_1_0_S5_S3 "int = ((phys * 1) / 1) - (0) [U/(min*ms)]" RAT_FUNC "%1.0" "[U/(min*ms)]" COEFFS 0 1 0 0 0 1 /end COMPU_METHOD
/begin COMPU_METHOD UMR_U_MINSEC_1_1_0_S5_S3 "int = ((phys * 1) / 1) - (0) [U/(min*s)]" RAT_FUNC "%1.0" "[U/(min*s)]" COEFFS 0 1 0 0 0 1 /end COMPU_METHOD
/begin COMPU_METHOD UMR_W_K_1_1_0_1_S5_S3 "int = ((phys * 1) / 1) - (0) [W/K]" RAT_FUNC "%1.0" "[W/K]" COEFFS 0 1 0 0 0 1 /end COMPU_METHOD
/begin COMPU_METHOD UMR_W_K_1_1_0_2_S5_S3 "int = ((phys * 1) / 1) - (0) [W/K]" RAT_FUNC "%1.0" "[W/K]" COEFFS 0 1 0 0 0 1 /end COMPU_METHOD
/begin COMPU_METHOD UMR_W_K_1_1_0_S5_S3 "int = ((phys * 1) / 1) - (0) [W/K]" RAT_FUNC "%1.0" "[W/K]" COEFFS 0 1 0 0 0 1 /end COMPU_METHOD
/begin CHARACTERISTIC CO_MAXREG_K0 "Offset auf die Getriebesumpf-Temperaturschwelle CS_MAXREG_K0. Unterhalb CS_MAXREG_K0 - CO_MAXREG_K0, wird die K0-Schlupfregelung wieder erlaubt." VALUE 0x1D83FE ZF_kw_ui16_S5_S3 100 UMR_GRADC__1_1_M40_S5_S3 0 100 /end CHARACTERISTIC
/begin CHARACTERISTIC CO_MINREG_K0 "Obere Temperaturschwelle zum Regelnverbot bei Kälte K0" VALUE 0x1D7816 ZF_kw_ui8_S5_S3 100 UMR_GRADC__1_1_M40_S5_S3 0 100 /end CHARACTERISTIC
/begin CHARACTERISTIC CS_BELAGDIAG_K0 "Obere Belag-Temperaturschwelle zum Öffnen der K0" VALUE 0x1D83F2 ZF_kw_ui16_S5_S3 500 UMR_GRADC__1_1_M40_S5_S3 0 500 /end CHARACTERISTIC
/begin CHARACTERISTIC CS_BELAGFDYNHYS_K0 "Hysterseswert Belagtemperatur" VALUE 0x1D7822 ZF_kw_ui8_S5_S3 255 UMR_GRADC__1_1_0_S5_S3 0 255 /end CHARACTERISTIC
/begin CHARACTERISTIC CS_BELAGFDYNOG_K0 "appl. [°C], Temperaturschwelle Belag für Ausstieg aus Fahrdynamik" VALUE 0x1D840A ZF_kw_ui16_S5_S3 540 UMR_GRADC__1_1_M40_S5_S3 -40 500 /end CHARACTERISTIC
/begin CHARACTERISTIC CS_BELAGHYS_K0 "Hysterese fuer Obere Belag-Temperaturschwelle zum Öffnen der K0" VALUE 0x1D780F ZF_kw_ui8_S5_S3 100 UMR_GRADC__1_1_M40_S5_S3 0 100 /end CHARACTERISTIC
/begin CHARACTERISTIC CS_BELAGOG_K0 "[°C] obere Belagtemperaturschwelle zum Schließen der K0" VALUE 0x1D83FA ZF_kw_ui16_S5_S3 500 UMR_GRADC__1_1_M40_S5_S3 0 500 /end CHARACTERISTIC
/begin CHARACTERISTIC CS_GETRFDYNOG_K0 "obere Temperaturschwelle für Fahrdynamik" VALUE 0x1D7823 ZF_kw_ui8_S5_S3 255 UMR_GRADC__1_1_M40_S5_S3 -40 215 /end CHARACTERISTIC
/begin CHARACTERISTIC CS_GETRFDYNUG_K0 "untere Temperaturschwelle für Fahrdynamik" VALUE 0x1D7824 ZF_kw_ui8_S5_S3 255 UMR_GRADC__1_1_M40_S5_S3 -40 215 /end CHARACTERISTIC
/begin CHARACTERISTIC CS_GETR_ANFMODUS_IAE "Getriebetemperaturschwelle zum Einstieg in Kaltanfahrmodus" VALUE 0x1D8382 ZF_kw_ui16_S5_S3 80 UMR_GRADC__1_1_M40_S5_S3 -40 40 /end CHARACTERISTIC
/begin CHARACTERISTIC CS_MAXREG_K0 "Getriebesumpf Temperaturschwelle, oberhalb derer die K0-Schlupfregelung verboten wird" VALUE 0x1D83FC ZF_kw_ui16_S5_S3 255 UMR_GRADC__1_1_M40_S5_S3 -40 215 /end CHARACTERISTIC
/begin CHARACTERISTIC CS_MINREG_K0 "Untere Temperaturschwelle zum Regelnverbot bei Kälte K0" VALUE 0x1D7815 ZF_kw_ui8_S5_S3 150 UMR_GRADC__1_1_M40_S5_S3 -20 130 /end CHARACTERISTIC
/begin CHARACTERISTIC CS_VPOEL12_K0 "Temperaturschwelle zum Auswahl der Tempereaturstuetzstelle 1-2 aus KF" VALUE 0x1D7813 ZF_kw_ui8_S5_S3 150 UMR_GRADC__1_1_M40_S5_S3 -30 120 /end CHARACTERISTIC
/begin CHARACTERISTIC CS_VPOEL23_K0 "emperaturschwelle zum Auswahl der Tempereaturstuetzstelle 2-3 aus KF" VALUE 0x1D7814 ZF_kw_ui8_S5_S3 150 UMR_GRADC__1_1_M40_S5_S3 -30 120 /end CHARACTERISTIC
/begin CHARACTERISTIC DELTA_IEDSK0_ABGL "Stromoffset zur Korrektur der Abgleichdaten" VALUE 0x1D7832 ZF_kw_si8_S5_S3 200 UMR_MA__1_1_0_S5_S3 -100 100 /end CHARACTERISTIC
/begin CHARACTERISTIC DKIS_STALL_IAE "dki-Schwelle zur Erkennung Stallspeed" VALUE 0x1D77B4 ZF_kw_ui8_S5_S3 100 UMR_PROZENT__20_51_0_S5_S3 0 100 /end CHARACTERISTIC
/begin CHARACTERISTIC D_PT2_MSCHALTAB_K0 "Dämpfungskonstante für Standardsollwertfilter" VALUE 0x1A1544 ZF_kw_fl32_S5_S3 1.98 UMR___1_1_0_S5_S3 0.02 2 FORMAT "%3.2" /end CHARACTERISTIC
/begin CHARACTERISTIC D_RAWNDEINREG_K0 "Dämpfungskonstante für Standardsollwertfilter beim Einregeln" VALUE 0x1D781A ZF_kw_ui8_S5_S3 1.8 UMR___1_100_0_S5_S3 0.2 2 /end CHARACTERISTIC
/begin CHARACTERISTIC D_WNDOFDYN_K0 "Dämpfungskonstante für Drehzahloffset der Fahrdynamik" VALUE 0x1D7820 ZF_kw_ui8_S5_S3 1.8 UMR___1_100_0_S5_S3 0.2 2 /end CHARACTERISTIC
/begin CHARACTERISTIC D_WNDOSCHALT_K0 "Dämpfungskonstante für Solldifferenzdrehzahl-Offset während Schaltungen" VALUE 0x1D781F ZF_kw_ui8_S5_S3 1.8 UMR___1_100_0_S5_S3 0.2 2 /end CHARACTERISTIC
/begin CHARACTERISTIC D_WNDSTD_K0 "Dämpfungskonstante für Standardsollwertfilter" VALUE 0x1D7819 ZF_kw_ui8_S5_S3 1.8 UMR___1_100_0_S5_S3 0.2 2 /end CHARACTERISTIC
/begin CHARACTERISTIC F_K0_VERLUST "Faktor für die Gewichtung der Reibleistung, um diese auf die Lamelle zu beziehen" VALUE 0x19ECB0 ZF_kw_fl32_S5_S3 1 UMR___1_1_0_S5_S3 0 1 FORMAT "%3.2" /end CHARACTERISTIC
/begin CHARACTERISTIC F_KORR_BELAGAB_K0 "Faktor zur Berechnung des gesamten von den Reiblamellen abgehenden Wärmestroms aus dem Wärmestrom einer einzelnen Lamelle" VALUE 0x19F100 ZF_kw_fl32_S5_S3 2 UMR___1_1_0_S5_S3 0 2 FORMAT "%3.2" /end CHARACTERISTIC
/begin CHARACTERISTIC F_KPOMSOLLKORRC_K0 "Faktor zur Korrektur von po_msoll_k0;" VALUE 0x1A0900 ZF_kw_fl32_S5_S3 10 UMR___1_1_0_S5_S3 0 10 FORMAT "%3.2" /end CHARACTERISTIC
/begin CHARACTERISTIC F_MKRIECH_ANF_IAE "Faktor, mit welchem das letzte Kriechmoment als Min-Anfahrmoment berücksichtigt wird" VALUE 0x1D779F ZF_kw_ui8_S5_S3 1 UMR___1_100_0_S5_S3 0 1 /end CHARACTERISTIC
/begin CHARACTERISTIC F_NG_AB_NEIGUNG_IAE "Faktor auf Abtriebsdrehzahlgradient zur Korrekturrechnung der Neigung" VALUE 0x1D83B8 ZF_kw_si16_S5_S3 1 UMR___1_1000_0_S5_S3 0 1 /end CHARACTERISTIC
/begin CHARACTERISTIC F_RHO_CP_OEL "Produkt der spez. Wärmekapazität und der Dichte des Getriebeöls in J/l*K" VALUE 0x19EF90 ZF_kw_fl32_S5_S3 3900 UMR_J_LITERK_1_1_0_S5_S3 100 4000 /end CHARACTERISTIC
/begin CHARACTERISTIC F_WAERMEKAP_BELAG_K0 "Wärmekapazität des Reibbelages der K0" VALUE 0x19EF88 ZF_kw_fl32_S5_S3 99.9 UMR_J_K_1_1_0_S5_S3 0.1 100 FORMAT "%2.1" /end CHARACTERISTIC
/begin CHARACTERISTIC F_WAERMEKAP_TORUS_K0 "Wärmekapazität des K0 Torus" VALUE 0x19EF8C ZF_kw_fl32_S5_S3 9999.9 UMR_J_K_1_1_0_S5_S3 0.1 10000 FORMAT "%2.1" /end CHARACTERISTIC
/begin CHARACTERISTIC GS_GEFAELLE_IEP "Schwelle für Gefällestrecke" VALUE 0x1D77E8 ZF_kw_ui8_S5_S3 84 UMR_GRAD__1_3_M128_S5_S3 -42 42 /end CHARACTERISTIC
/begin CHARACTERISTIC I_KEINKRAFTSCHLUSS_K0 "Fester Ersatzwert fuer i_getriebe_virt_k0_roh bei fehlendem Kraftschluss" VALUE 0x1D83E0 ZF_kw_ui16_S5_S3 64 UMR___1_1000_0_S5_S3 0 64 /end CHARACTERISTIC
/begin CHARACTERISTIC J_EM_K0 "Trägheitsmoment E-Maschine" VALUE 0x19EC4C ZF_kw_fl32_S5_S3 5 UMR_KGM2__1_1_0_S5_S3 0 5 FORMAT "%4.3" /end CHARACTERISTIC
/begin CHARACTERISTIC J_FAHRZEUG_K0 "Trägheitmoment Fahrzeug auf n_ab bezogen" VALUE 0x19EB6C ZF_kw_fl32_S5_S3 47 UMR_KGM2__1_1_0_S5_S3 3 50 FORMAT "%4.3" /end CHARACTERISTIC
/begin CHARACTERISTIC J_MOTOR_K0 "Trägheitsmoment Motorseite" VALUE 0x19EC40 ZF_kw_fl32_S5_S3 5 UMR_KGM2__1_1_0_S5_S3 0 5 FORMAT "%4.3" /end CHARACTERISTIC
/begin CHARACTERISTIC J_PRI_K0 "Trägheitsmoment Trennkupplung K0 Primärseite" VALUE 0x19EC44 ZF_kw_fl32_S5_S3 5 UMR_KGM2__1_1_0_S5_S3 0 5 FORMAT "%4.3" /end CHARACTERISTIC
/begin CHARACTERISTIC J_SEC_K0 "Trägheitsmoment Secundärseite K0" VALUE 0x19EC48 ZF_kw_fl32_S5_S3 5 UMR_KGM2__1_1_0_S5_S3 0 5 FORMAT "%4.3" /end CHARACTERISTIC
/begin CHARACTERISTIC KF_ADDONLP_IEP "[1/min] Offset auf Gesamtleckage" MAP 0x19E09C ZF_kf_fl32_S5_S3 60 UMR_LITER_MIN_1_1_0_S5_S3 -10 50
 /begin AXIS_DESCR STD_AXIS iIepLeckagemodell.q_leckage_fzp_iep UMR_LITER_MIN_1_1_0_S5_S3 6 0 20 DEPOSIT ABSOLUTE FORMAT "%2.1" /end AXIS_DESCR
 /begin AXIS_DESCR STD_AXIS iIepBerLp.iep_soll UMR___1_1_0_S5_S3 4 0 3 DEPOSIT ABSOLUTE /end AXIS_DESCR
 FORMAT "%2.1" /end CHARACTERISTIC
/begin CHARACTERISTIC KF_ALPHA_BELAG_OFFEN_K0 "Produkt aus Wärmeübergangs-koeffizient und Fläche des Wärmeübergangs vom Reibbelag zum Öl im Lamellenraum bei offener K0" MAP 0x19ECB4 ZF_kf_fl32_S5_S3 100 UMR_W_K_1_1_0_1_S5_S3 0 100
 /begin AXIS_DESCR STD_AXIS NO_INPUT_QUANTITY UMR_U_MIN_1_1_0_S5_S3 9 -8128 8128 DEPOSIT ABSOLUTE /end AXIS_DESCR
 /begin AXIS_DESCR STD_AXIS iK0sTempM.vp_oel_k0 UMR_LITER_MIN_1_1_0_S5_S3 7 -1500 1500 DEPOSIT ABSOLUTE FORMAT "%2.1" /end AXIS_DESCR
 FORMAT "%2.1" /end CHARACTERISTIC
/begin CHARACTERISTIC KF_ALPHA_BELAG_REGELN_K0 "Produkt aus Wärmeübergangskoeffizient u. Fläche des Wärmeübergang vom Reibbelag zum Öl im Lamellenraum bei reglender oder geschlossener Kupplung" MAP 0x19EDF8 ZF_kf_fl32_S5_S3 100 UMR_W_K_1_1_0_1_S5_S3 0 100
 /begin AXIS_DESCR STD_AXIS NO_INPUT_QUANTITY UMR_U_MIN_1_1_0_S5_S3 10 -8128 8128 DEPOSIT ABSOLUTE /end AXIS_DESCR
 /begin AXIS_DESCR STD_AXIS iK0sTempM.vp_oel_k0 UMR_LITER_MIN_1_1_0_S5_S3 8 -1500 1500 DEPOSIT ABSOLUTE FORMAT "%2.1" /end AXIS_DESCR
 FORMAT "%2.1" /end CHARACTERISTIC
/begin CHARACTERISTIC KF_ALPHA_SCHLUPF_IAE "Kennfeld ALPHA_IAE bei kup_status_iae = schlupfend, angelegt oder entkoppelt" MAP 0x19DD98 ZF_kf_fl32_S5_S3 999.9 UMR_W_K_1_1_0_S5_S3 0.1 1000
 /begin AXIS_DESCR STD_AXIS NO_INPUT_QUANTITY UMR_U_MIN_1_1_0_S5_S3 4 -8160 8160 DEPOSIT ABSOLUTE /end AXIS_DESCR
 /begin AXIS_DESCR STD_AXIS NO_INPUT_QUANTITY UMR_LITER_MIN_1_10_0_S5_S3 4 0 50 DEPOSIT ABSOLUTE /end AXIS_DESCR
/end CHARACTERISTIC
/begin CHARACTERISTIC KF_AMPUEBTEMPPULS_IAE "Amplitude des Rechteckimpuls bei Übertemperaturpulsen der IAE im Anfahren" MAP 0x19CE50 ZF_kf_si16_S5_S3 1000 UMR_NM__1_1_0_S5_S3 0 1000
 /begin AXIS_DESCR STD_AXIS NO_INPUT_QUANTITY UMR_GRADC__1_1_M40_S5_S3 4 -40 500 DEPOSIT ABSOLUTE /end AXIS_DESCR
 /begin AXIS_DESCR STD_AXIS NO_INPUT_QUANTITY UMR_GRADC__1_1_M40_S5_S3 4 -40 215 DEPOSIT ABSOLUTE /end AXIS_DESCR
/end CHARACTERISTIC
/begin CHARACTERISTIC KF_CGETR_POS_D_PWM_IEP "PWM-Signal als f(c_getr, iep_ist)" MAP 0x19DED8 ZF_kf_ui16_S5_S3 1000 UMR___1_1_0_S5_S3 0 1000
 /begin AXIS_DESCR STD_AXIS zff_atsys._.iSignale._.obj.sig_c_getr UMR_GRADC__1_1_M40_S5_S3 8 -40 215 DEPOSIT ABSOLUTE /end AXIS_DESCR
 /begin AXIS_DESCR STD_AXIS iIepKordi.iep_ist UMR___1_1_0_S5_S3 5 0 4 DEPOSIT ABSOLUTE /end AXIS_DESCR
/end CHARACTERISTIC
/begin CHARACTERISTIC KF_CGETR_PWM_IEP "PWM-Signal als f(c_getr, iep_ist)" MAP 0x19DE64 ZF_kf_ui16_S5_S3 1000 UMR___1_1_0_S5_S3 0 1000
 /begin AXIS_DESCR STD_AXIS zff_atsys._.iSignale._.obj.sig_c_getr UMR_GRADC__1_1_M40_S5_S3 8 -40 215 DEPOSIT ABSOLUTE /end AXIS_DESCR
 /begin AXIS_DESCR STD_AXIS iIepKordi.iep_ist UMR___1_1_0_S5_S3 5 0 4 DEPOSIT ABSOLUTE /end AXIS_DESCR
/end CHARACTERISTIC
/begin CHARACTERISTIC KF_D_POIST_K0 "Dämpfungskonstante PT2-Filter po_ist" MAP 0x1A1088 ZF_kf_fl32_S5_S3 1.98 UMR___1_1_0_S5_S3 0.02 2
 /begin AXIS_DESCR STD_AXIS NO_INPUT_QUANTITY UMR_BAR__1_1_0_S5_S3 4 0 30 DEPOSIT ABSOLUTE FORMAT "%4.3" /end AXIS_DESCR
 /begin AXIS_DESCR STD_AXIS zff_atsys._.iSignale._.obj.sig_c_getr_fl32 UMR_GRADC__1_1_0_S5_S3 4 -40 215 DEPOSIT ABSOLUTE /end AXIS_DESCR
 FORMAT "%3.2" /end CHARACTERISTIC
/begin CHARACTERISTIC KF_FDYNANFAHR_ECO_IAE "Fahrdynamikoffset für Anfahren IAE" MAP 0x19D8E4 ZF_kf_si16_S5_S3 8000 UMR_NM__1_1_0_S5_S3 -2000 6000
 /begin AXIS_DESCR STD_AXIS NO_INPUT_QUANTITY UMR___1_1_0_S5_S3 6 -1 8 DEPOSIT ABSOLUTE /end AXIS_DESCR
 /begin AXIS_DESCR STD_AXIS NO_INPUT_QUANTITY UMR_PROZENT_SEC_20_51_0_S5_S3 6 -11764.7058824 11764.7058824 DEPOSIT ABSOLUTE /end AXIS_DESCR
/end CHARACTERISTIC
/begin CHARACTERISTIC KF_FDYNANFAHR_IAE "Fahrdynamikoffset für Anfahren IAE" MAP 0x19D9EC ZF_kf_si16_S5_S3 8000 UMR_NM__1_1_0_S5_S3 -2000 6000
 /begin AXIS_DESCR STD_AXIS NO_INPUT_QUANTITY UMR___1_1_0_S5_S3 6 -1 8 DEPOSIT ABSOLUTE /end AXIS_DESCR
 /begin AXIS_DESCR STD_AXIS NO_INPUT_QUANTITY UMR_PROZENT_SEC_20_51_0_S5_S3 6 -11764.7058824 11764.7058824 DEPOSIT ABSOLUTE /end AXIS_DESCR
/end CHARACTERISTIC
/begin CHARACTERISTIC KF_F_AMPUEBTEMPPULS_IAE "Faktor auf Amplitude des Rechteckimpuls bei Übertemperaturpulsen der IAE im Anfahren" MAP 0x19CE88 ZF_kf_si16_S5_S3 10 UMR___1_100_0_S5_S3 0 10
 /begin AXIS_DESCR STD_AXIS NO_INPUT_QUANTITY UMR_PROZENT__20_51_0_S5_S3 4 0 100 DEPOSIT ABSOLUTE /end AXIS_DESCR
 /begin AXIS_DESCR STD_AXIS iIaeSigna.nd_iae UMR_U_MIN_1_1_0_S5_S3 4 -10000 10000 DEPOSIT ABSOLUTE /end AXIS_DESCR
/end CHARACTERISTIC
/begin CHARACTERISTIC KF_F_KI_K0 "[Gewichtungsfaktor fuer I-Anteil im Regler" MAP 0x1A0D10 ZF_kf_fl32_S5_S3 30 UMR___1_1_0_S5_S3 0 30
 /begin AXIS_DESCR STD_AXIS NO_INPUT_QUANTITY UMR_U_MIN_1_1_0_S5_S3 4 0 8128 DEPOSIT ABSOLUTE /end AXIS_DESCR
 /begin AXIS_DESCR STD_AXIS NO_INPUT_QUANTITY UMR___1_1_0_S5_S3 4 -40 215 DEPOSIT ABSOLUTE FORMAT "%3.2" /end AXIS_DESCR
 FORMAT "%3.2" /end CHARACTERISTIC
/begin CHARACTERISTIC KF_F_MAUFNMOTPBREMS_IAE "Faktor auf m_iaeauf - Wert zur Überführung auf den Wert 0" MAP 0x19D608 ZF_kf_si16_S5_S3 1 UMR___1_100_0_S5_S3 0 1
 /begin AXIS_DESCR STD_AXIS iIaeSigna.n_mot_iae UMR_U_MIN_1_1_0_S5_S3 4 0 10000 DEPOSIT ABSOLUTE /end AXIS_DESCR
 /begin AXIS_DESCR STD_AXIS iIaeSigna.p_brems_iae UMR_BAR__1_100_0_S5_S3 4 -10 300 DEPOSIT ABSOLUTE /end AXIS_DESCR
/end CHARACTERISTIC
/begin CHARACTERISTIC KF_F_M_AUF_IAE "Faktor auf IAE-Aufnahmemoment" MAP 0x19D5D0 ZF_kf_si16_S5_S3 1 UMR___1_100_0_S5_S3 0 1
 /begin AXIS_DESCR STD_AXIS iIaeSigna.nue_iae UMR___1_1000_0_S5_S3 4 0 30 DEPOSIT ABSOLUTE /end AXIS_DESCR
 /begin AXIS_DESCR STD_AXIS iIaeSigna.nd_mot_iae UMR_U_MIN_1_1_0_S5_S3 4 -8000 8000 DEPOSIT ABSOLUTE /end AXIS_DESCR
/end CHARACTERISTIC
/begin CHARACTERISTIC KF_F_M_KRIECH_MAX_IAE "Faktor auf maximales Kriechmoment" MAP 0x19CA24 ZF_kf_si16_S5_S3 2 UMR___1_100_0_S5_S3 0 2
 /begin AXIS_DESCR STD_AXIS iIaeSigna.nd_mot_iae UMR_U_MIN_1_1_0_S5_S3 6 -10000 10000 DEPOSIT ABSOLUTE /end AXIS_DESCR
 /begin AXIS_DESCR STD_AXIS iIaeSigna.m_motist_iae UMR_NM__1_1_0_S5_S3 6 -200 1300 DEPOSIT ABSOLUTE /end AXIS_DESCR
/end CHARACTERISTIC
/begin CHARACTERISTIC KF_F_NDMOTANFAHR_IAE "Faktor auf Anfahrvorsteuermoment in Abhängigkeit des Motordrückens unter die Sollleerlaufdrehzahl" MAP 0x19CDA4 ZF_kf_si16_S5_S3 2 UMR___1_100_0_S5_S3 0 2
 /begin AXIS_DESCR STD_AXIS iIaeSigna.nd_mot_iae UMR_U_MIN_1_1_0_S5_S3 4 -8160 8160 DEPOSIT ABSOLUTE /end AXIS_DESCR
 /begin AXIS_DESCR STD_AXIS iIaeSigna.ng_mot_iae UMR_U_MINSEC_1_1_0_S5_S3 4 -30000 30000 DEPOSIT ABSOLUTE /end AXIS_DESCR
/end CHARACTERISTIC
/begin CHARACTERISTIC KF_KDREGK0S "D-Anteil im Schubregeln" MAP 0x1A0BE4 ZF_kf_fl32_S5_S3 8 UMR___1_1_0_S5_S3 0 8
 /begin AXIS_DESCR STD_AXIS NO_INPUT_QUANTITY UMR___1_1_0_S5_S3 6 0 10000 DEPOSIT ABSOLUTE FORMAT "%3.2" /end AXIS_DESCR
 /begin AXIS_DESCR STD_AXIS NO_INPUT_QUANTITY UMR___1_1_0_S5_S3 4 -40 215 DEPOSIT ABSOLUTE FORMAT "%3.2" /end AXIS_DESCR
 FORMAT "%3.2" /end CHARACTERISTIC
/begin CHARACTERISTIC KF_KDREGK0Z "D-Anteil im Zugregeln" MAP 0x1A0C74 ZF_kf_fl32_S5_S3 8 UMR___1_1_0_S5_S3 0 8
 /begin AXIS_DESCR STD_AXIS NO_INPUT_QUANTITY UMR___1_1_0_S5_S3 6 0 10000 DEPOSIT ABSOLUTE FORMAT "%3.2" /end AXIS_DESCR
 /begin AXIS_DESCR STD_AXIS NO_INPUT_QUANTITY UMR___1_1_0_S5_S3 4 -40 215 DEPOSIT ABSOLUTE FORMAT "%3.2" /end AXIS_DESCR
 FORMAT "%3.2" /end CHARACTERISTIC
/begin CHARACTERISTIC KF_KIREGK0S "[I-Anteil im Schubregeln" MAP 0x1A0D78 ZF_kf_fl32_S5_S3 10 UMR___1_1_0_S5_S3 0 10
 /begin AXIS_DESCR STD_AXIS NO_INPUT_QUANTITY UMR___1_1_0_S5_S3 6 0 10000 DEPOSIT ABSOLUTE FORMAT "%3.2" /end AXIS_DESCR
 /begin AXIS_DESCR STD_AXIS NO_INPUT_QUANTITY UMR___1_1_0_S5_S3 4 -40 215 DEPOSIT ABSOLUTE FORMAT "%3.2" /end AXIS_DESCR
 FORMAT "%3.2" /end CHARACTERISTIC
/begin CHARACTERISTIC KF_KIREGK0Z "I-Anteil im Zugregeln" MAP 0x1A0E08 ZF_kf_fl32_S5_S3 10 UMR___1_1_0_S5_S3 0 10
 /begin AXIS_DESCR STD_AXIS NO_INPUT_QUANTITY UMR___1_1_0_S5_S3 6 0 10000 DEPOSIT ABSOLUTE FORMAT "%3.2" /end AXIS_DESCR
 /begin AXIS_DESCR STD_AXIS NO_INPUT_QUANTITY UMR___1_1_0_S5_S3 4 -40 215 DEPOSIT ABSOLUTE FORMAT "%3.2" /end AXIS_DESCR
 FORMAT "%3.2" /end CHARACTERISTIC
/begin CHARACTERISTIC KF_KI_KRIECH_IAE "I-Anteil für Differenzdrehzahlregler im Kriechen" MAP 0x19D058 ZF_kf_fl32_S5_S3 9.999 UMR___1_1_0_3_S5_S3 0.001 10
 /begin AXIS_DESCR STD_AXIS NO_INPUT_QUANTITY UMR_GRADC__1_1_0_S5_S3 6 -40 215 DEPOSIT ABSOLUTE /end AXIS_DESCR
 /begin AXIS_DESCR STD_AXIS zff_atsys._.iSignale._.obj.sig_istgang UMR___1_1_0_S5_S3 7 -1 7 DEPOSIT ABSOLUTE /end AXIS_DESCR
 FORMAT "%4.3" /end CHARACTERISTIC
/begin CHARACTERISTIC KF_KORRANCGETRDKP_IEP "[1/min] KorrMotordrehzahlschw=f(c_getr,dk_pedal)" MAP 0x19E23C ZF_kf_si16_S5_S3 200 UMR_U_MIN_1_1_0_S5_S3 -100 100
 /begin AXIS_DESCR STD_AXIS zff_atsys._.iSignale._.obj.sig_c_getr UMR_GRADC__1_1_M40_S5_S3 8 -40 215 DEPOSIT ABSOLUTE /end AXIS_DESCR
 /begin AXIS_DESCR STD_AXIS iItfInput.dk_pedal UMR_PROZENT__20_51_0_S5_S3 5 0 100 DEPOSIT ABSOLUTE /end AXIS_DESCR
/end CHARACTERISTIC
/begin CHARACTERISTIC KF_KORRANCGETRPBREMSE_IEP "[U/min] Motordrehzahlschwelle=f(c_getr,p_bremse)" MAP 0x19E158 ZF_kf_fl32_S5_S3 200 UMR_U_MIN_1_1_0_S5_S3 -100 100
 /begin AXIS_DESCR STD_AXIS zff_atsys._.iSignale._.obj.sig_c_getr_fl32 UMR_GRADC__1_1_0_S5_S3 6 -40 215 DEPOSIT ABSOLUTE /end AXIS_DESCR
 /begin AXIS_DESCR STD_AXIS iItfInput.p_bremse UMR_BAR__1_1_0_S5_S3 7 -100 1000 DEPOSIT ABSOLUTE /end AXIS_DESCR
/end CHARACTERISTIC
/begin CHARACTERISTIC KF_KORRAUSPSYSCGETR_IEP "Motordrehzahlschwelle=f(p_sys, c_getr)" MAP 0x19E374 ZF_kf_fl32_S5_S3 5 UMR___1_1_0_S5_S3 0 5
 /begin AXIS_DESCR STD_AXIS iSasPsyst.p_sys UMR_BAR__1_1000_0_S5_S3 6 0 20 DEPOSIT ABSOLUTE /end AXIS_DESCR
 /begin AXIS_DESCR STD_AXIS zff_atsys._.iSignale._.obj.sig_c_getr_fl32 UMR_GRADC__1_1_0_S5_S3 5 -40 215 DEPOSIT ABSOLUTE /end AXIS_DESCR
 FORMAT "%3.2" /end CHARACTERISTIC
/begin CHARACTERISTIC KF_KORRAUSPSYSDKP_IEP "[1/min] KorrMotordrehzahlschw=f(p_sys,dki)" MAP 0x19E420 ZF_kf_fl32_S5_S3 200 UMR_U_MIN_1_1_0_S5_S3 -100 100
 /begin AXIS_DESCR STD_AXIS iSasPsyst.p_sys UMR_BAR__1_1000_0_S5_S3 7 0 20 DEPOSIT ABSOLUTE /end AXIS_DESCR
 /begin AXIS_DESCR STD_AXIS iItfInput.dk_pedal UMR_PROZENT__20_51_0_S5_S3 6 0 100 DEPOSIT ABSOLUTE /end AXIS_DESCR
/end CHARACTERISTIC
/begin CHARACTERISTIC KF_KPREGK0S "P-Anteil im Schubregeln" MAP 0x1A0E98 ZF_kf_fl32_S5_S3 8 UMR___1_1_0_S5_S3 0 8
 /begin AXIS_DESCR STD_AXIS NO_INPUT_QUANTITY UMR___1_1_0_S5_S3 6 0 10000 DEPOSIT ABSOLUTE FORMAT "%3.2" /end AXIS_DESCR
 /begin AXIS_DESCR STD_AXIS NO_INPUT_QUANTITY UMR___1_1_0_S5_S3 4 -40 215 DEPOSIT ABSOLUTE FORMAT "%3.2" /end AXIS_DESCR
 FORMAT "%3.2" /end CHARACTERISTIC
/begin CHARACTERISTIC KF_KPREGK0Z "P-Anteil im Zugregeln" MAP 0x1A0F28 ZF_kf_fl32_S5_S3 8 UMR___1_1_0_S5_S3 0 8
 /begin AXIS_DESCR STD_AXIS NO_INPUT_QUANTITY UMR___1_1_0_S5_S3 6 0 10000 DEPOSIT ABSOLUTE FORMAT "%3.2" /end AXIS_DESCR
 /begin AXIS_DESCR STD_AXIS NO_INPUT_QUANTITY UMR___1_1_0_S5_S3 4 -40 215 DEPOSIT ABSOLUTE FORMAT "%3.2" /end AXIS_DESCR
 FORMAT "%3.2" /end CHARACTERISTIC
/begin CHARACTERISTIC KF_KP_KRIECH_IAE "P-Anteil für Differenzdrehzahlregler im Kriechen" MAP 0x19D13C ZF_kf_fl32_S5_S3 9.999 UMR___1_1_0_3_S5_S3 0.001 10
 /begin AXIS_DESCR STD_AXIS NO_INPUT_QUANTITY UMR_GRADC__1_1_0_S5_S3 6 -40 215 DEPOSIT ABSOLUTE /end AXIS_DESCR
 /begin AXIS_DESCR STD_AXIS zff_atsys._.iSignale._.obj.sig_istgang UMR___1_1_0_S5_S3 7 -1 7 DEPOSIT ABSOLUTE /end AXIS_DESCR
 FORMAT "%4.3" /end CHARACTERISTIC
/begin CHARACTERISTIC KF_LECKAGEFZP_IEP "[l/min] Leckagebestimmung der FZP" MAP 0x19DFF8 ZF_kf_fl32_S5_S3 20 UMR_LITER_MIN_1_1_0_S5_S3 0 20
 /begin AXIS_DESCR STD_AXIS iSasPsyst.p_sys UMR_BAR__1_1000_0_S5_S3 7 0 20 DEPOSIT ABSOLUTE /end AXIS_DESCR
 /begin AXIS_DESCR STD_AXIS zff_atsys._.iSignale._.obj.sig_c_getr_fl32 UMR_GRADC__1_1_0_S5_S3 4 -40 215 DEPOSIT ABSOLUTE /end AXIS_DESCR
 FORMAT "%2.1" /end CHARACTERISTIC
/begin CHARACTERISTIC KF_LECKAGEHSG_IEP "[l/min] Leckagebestimmung der HSG" MAP 0x19DF4C ZF_kf_fl32_S5_S3 20 UMR_LITER_MIN_1_1_0_S5_S3 0 20
 /begin AXIS_DESCR STD_AXIS iSasPsyst.p_sys UMR_BAR__1_1000_0_S5_S3 5 0 20 DEPOSIT ABSOLUTE /end AXIS_DESCR
 /begin AXIS_DESCR STD_AXIS zff_atsys._.iSignale._.obj.sig_c_getr_fl32 UMR_GRADC__1_1_0_S5_S3 6 -40 215 DEPOSIT ABSOLUTE /end AXIS_DESCR
 FORMAT "%2.1" /end CHARACTERISTIC
/begin CHARACTERISTIC KF_MDT_PKORR_K0 "Filterzeitkonstante für den DT1-Filter für Filterung von p_abssoll_roh_k0" MAP 0x1A0838 ZF_kf_si16_S5_S3 1 UMR___1_100_0_S5_S3 0 1
 /begin AXIS_DESCR STD_AXIS NO_INPUT_QUANTITY UMR_BAR__1_1000_0_S5_S3 5 0 30 DEPOSIT ABSOLUTE /end AXIS_DESCR
 /begin AXIS_DESCR STD_AXIS zff_atsys._.iSignale._.obj.sig_c_getr UMR_GRADC__1_1_M40_S5_S3 5 -40 215 DEPOSIT ABSOLUTE /end AXIS_DESCR
/end CHARACTERISTIC
/begin CHARACTERISTIC KF_MGSOLLSYNC_IAE "Momentengradient im Synchronisieren" MAP 0x19CC70 ZF_kf_si16_S5_S3 5000 UMR_NM_SEC_1_1_0_S5_S3 0 5000
 /begin AXIS_DESCR STD_AXIS iIaeSigna.m_motistoe_iae UMR_NM__1_1_0_S5_S3 6 -1000 10000 DEPOSIT ABSOLUTE /end AXIS_DESCR
 /begin AXIS_DESCR STD_AXIS iIaeSigna.ng_ab_iae UMR_U_MINSEC_1_1_0_S5_S3 4 -30000 30000 DEPOSIT ABSOLUTE /end AXIS_DESCR
/end CHARACTERISTIC
/begin CHARACTERISTIC KF_MIST_SCHLEPP_K0 "Schleppmoment bei offener Kupplung" MAP 0x19F104 ZF_kf_fl32_S5_S3 100 UMR_NM__1_1_0_S5_S3 0 100
 /begin AXIS_DESCR STD_AXIS NO_INPUT_QUANTITY UMR_U_MIN_1_1_0_S5_S3 4 0 8128 DEPOSIT ABSOLUTE /end AXIS_DESCR
 /begin AXIS_DESCR STD_AXIS iK0sTempM.c_oel_k0 UMR_GRADC__1_1_0_S5_S3 5 -1500 1500 DEPOSIT ABSOLUTE /end AXIS_DESCR
/end CHARACTERISTIC
/begin CHARACTERISTIC KF_MMOTMAXC_IAE "Momentenbegrenzung bei hoher IAE-Kupplungstemperatur" MAP 0x19D734 ZF_kf_si16_S5_S3 2000 UMR_NM__1_1_0_S5_S3 -1000 1000
 /begin AXIS_DESCR STD_AXIS NO_INPUT_QUANTITY UMR_GRADC__1_1_M40_S5_S3 6 -40 500 DEPOSIT ABSOLUTE /end AXIS_DESCR
 /begin AXIS_DESCR STD_AXIS iIaeSigna.ng_getrein_iae UMR_U_MINSEC_1_1_0_S5_S3 6 -10000 10000 DEPOSIT ABSOLUTE /end AXIS_DESCR
/end CHARACTERISTIC
/begin CHARACTERISTIC KF_MMOTMAXND_IAE "Momentenbegrenzung bei Differenzdrehzahl im Zustand ZU" MAP 0x19D79C ZF_kf_si16_S5_S3 2000 UMR_NM__1_1_0_S5_S3 -1000 1000
 /begin AXIS_DESCR STD_AXIS iIaeSigna.nd_iae UMR_U_MIN_1_1_0_S5_S3 6 -10000 10000 DEPOSIT ABSOLUTE /end AXIS_DESCR
 /begin AXIS_DESCR STD_AXIS NO_INPUT_QUANTITY UMR_NM__1_1_0_S5_S3 6 -1000 1000 DEPOSIT ABSOLUTE /end AXIS_DESCR
/end CHARACTERISTIC
/begin CHARACTERISTIC KF_MOSOLLLASTNMOT_IAE "Momentengradient im Synchronisieren" MAP 0x19CBA0 ZF_kf_si16_S5_S3 2000 UMR_NM__1_1_0_S5_S3 -1000 1000
 /begin AXIS_DESCR STD_AXIS NO_INPUT_QUANTITY UMR_NM__1_1_0_S5_S3 6 -3000 3000 DEPOSIT ABSOLUTE /end AXIS_DESCR
 /begin AXIS_DESCR STD_AXIS iIaeSigna.n_mot_iae UMR_U_MIN_1_1_0_S5_S3 6 0 10000 DEPOSIT ABSOLUTE /end AXIS_DESCR
/end CHARACTERISTIC
/begin CHARACTERISTIC KF_MOSOLLNDIAETIMER_IAE "Momentenoffset bei zunehmendem nd_iae_kf und Timerwert im Synchronisieren" MAP 0x19CC08 ZF_kf_si16_S5_S3 1000 UMR_NM__1_1_0_S5_S3 0 1000
 /begin AXIS_DESCR STD_AXIS NO_INPUT_QUANTITY UMR_MSEC__10_1_0_S5_S3 6 0 300000 DEPOSIT ABSOLUTE /end AXIS_DESCR
 /begin AXIS_DESCR STD_AXIS iIaeSigna.nd_iae_kf UMR_U_MIN_1_1_0_S5_S3 6 0 10000 DEPOSIT ABSOLUTE /end AXIS_DESCR
/end CHARACTERISTIC
/begin CHARACTERISTIC KF_MO_ZU_IAE "Momentenoffset zur Einstellung der Überanpressung in ZU" MAP 0x19CCD0 ZF_kf_si16_S5_S3 1000 UMR_NM__1_1_0_S5_S3 0 1000
 /begin AXIS_DESCR STD_AXIS iIaeSigna.m_motistoe_iae UMR_NM__1_1_0_S5_S3 6 -200 1300 DEPOSIT ABSOLUTE /end AXIS_DESCR
 /begin AXIS_DESCR STD_AXIS iIaeMomen.i_stuetz_iae UMR___1_1000_0_S5_S3 6 0 6 DEPOSIT ABSOLUTE /end AXIS_DESCR
/end CHARACTERISTIC
/begin CHARACTERISTIC KF_MPT_ISTUETZSCHALT_IAE "Mindestüberführungszeit für i_stütz_iae bei Schaltungen" MAP 0x19D6E8 ZF_kf_si16_S5_S3 5 UMR___1_100_0_S5_S3 0 5
 /begin AXIS_DESCR STD_AXIS iIaeSigna.n_mot_iae UMR_U_MIN_1_1_0_S5_S3 4 0 8160 DEPOSIT ABSOLUTE /end AXIS_DESCR
 /begin AXIS_DESCR STD_AXIS iIaeSigna.m_motistoe_iae UMR_NM__1_1_0_S5_S3 4 -200 1300 DEPOSIT ABSOLUTE /end AXIS_DESCR
/end CHARACTERISTIC
/begin CHARACTERISTIC KF_MSCHALTK012 "[Nm] Schaltmoment" MAP 0x1A1548 ZF_kf_fl32_S5_S3 3000 UMR_NM__1_1_0_S5_S3 -1500 1500
 /begin AXIS_DESCR STD_AXIS iK0sKorSignale.n_em_sync_k0_fl UMR_U_MIN_1_1_0_S5_S3 4 0 10000 DEPOSIT ABSOLUTE /end AXIS_DESCR
 /begin AXIS_DESCR STD_AXIS NO_INPUT_QUANTITY UMR___1_1_0_S5_S3 6 -400 1640 DEPOSIT ABSOLUTE FORMAT "%3.2" /end AXIS_DESCR
/end CHARACTERISTIC
/begin CHARACTERISTIC KF_MSCHALTK021 "[Nm] Schaltmoment" MAP 0x1A1A58 ZF_kf_fl32_S5_S3 3000 UMR_NM__1_1_0_S5_S3 -1500 1500
 /begin AXIS_DESCR STD_AXIS iK0sKorSignale.n_em_sync_k0_fl UMR_U_MIN_1_1_0_S5_S3 4 0 10000 DEPOSIT ABSOLUTE /end AXIS_DESCR
 /begin AXIS_DESCR STD_AXIS NO_INPUT_QUANTITY UMR___1_1_0_S5_S3 6 -400 1640 DEPOSIT ABSOLUTE FORMAT "%3.2" /end AXIS_DESCR
/end CHARACTERISTIC
/begin CHARACTERISTIC KF_MSCHALTK023 "[Nm] Schaltmoment" MAP 0x1A15D8 ZF_kf_fl32_S5_S3 3000 UMR_NM__1_1_0_S5_S3 -1500 1500
 /begin AXIS_DESCR STD_AXIS iK0sKorSignale.n_em_sync_k0_fl UMR_U_MIN_1_1_0_S5_S3 4 0 10000 DEPOSIT ABSOLUTE /end AXIS_DESCR
 /begin AXIS_DESCR STD_AXIS NO_INPUT_QUANTITY UMR___1_1_0_S5_S3 6 -400 1640 DEPOSIT ABSOLUTE FORMAT "%3.2" /end AXIS_DESCR
/end CHARACTERISTIC
/begin CHARACTERISTIC KF_MSCHALTK031 "[Nm] Schaltmoment" MAP 0x1A1C98 ZF_kf_fl32_S5_S3 3000 UMR_NM__1_1_0_S5_S3 -1500 1500
 /begin AXIS_DESCR STD_AXIS iK0sKorSignale.n_em_sync_k0_fl UMR_U_MIN_1_1_0_S5_S3 4 0 10000 DEPOSIT ABSOLUTE /end AXIS_DESCR
 /begin AXIS_DESCR STD_AXIS NO_INPUT_QUANTITY UMR___1_1_0_S5_S3 6 -400 1640 DEPOSIT ABSOLUTE FORMAT "%3.2" /end AXIS_DESCR
/end CHARACTERISTIC
/begin CHARACTERISTIC KF_MSCHALTK032 "[Nm] Schaltmoment" MAP 0x1A19C8 ZF_kf_fl32_S5_S3 3000 UMR_NM__1_1_0_S5_S3 -1500 1500
 /begin AXIS_DESCR STD_AXIS iK0sKorSignale.n_em_sync_k0_fl UMR_U_MIN_1_1_0_S5_S3 4 0 10000 DEPOSIT ABSOLUTE /end AXIS_DESCR
 /begin AXIS_DESCR STD_AXIS NO_INPUT_QUANTITY UMR___1_1_0_S5_S3 6 -400 1640 DEPOSIT ABSOLUTE FORMAT "%3.2" /end AXIS_DESCR
/end CHARACTERISTIC
/begin CHARACTERISTIC KF_MSCHALTK034 "[Nm] Schaltmoment" MAP 0x1A1668 ZF_kf_fl32_S5_S3 3000 UMR_NM__1_1_0_S5_S3 -1500 1500
 /begin AXIS_DESCR STD_AXIS iK0sKorSignale.n_em_sync_k0_fl UMR_U_MIN_1_1_0_S5_S3 4 0 10000 DEPOSIT ABSOLUTE /end AXIS_DESCR
 /begin AXIS_DESCR STD_AXIS NO_INPUT_QUANTITY UMR___1_1_0_S5_S3 6 -400 1640 DEPOSIT ABSOLUTE FORMAT "%3.2" /end AXIS_DESCR
/end CHARACTERISTIC
/begin CHARACTERISTIC KF_MSCHALTK042 "[Nm] Schaltmoment" MAP 0x1A1C08 ZF_kf_fl32_S5_S3 3000 UMR_NM__1_1_0_S5_S3 -1500 1500
 /begin AXIS_DESCR STD_AXIS iK0sKorSignale.n_em_sync_k0_fl UMR_U_MIN_1_1_0_S5_S3 4 0 10000 DEPOSIT ABSOLUTE /end AXIS_DESCR
 /begin AXIS_DESCR STD_AXIS NO_INPUT_QUANTITY UMR___1_1_0_S5_S3 6 -400 1640 DEPOSIT ABSOLUTE FORMAT "%3.2" /end AXIS_DESCR
/end CHARACTERISTIC
/begin CHARACTERISTIC KF_MSCHALTK043 "[Nm] Schaltmoment" MAP 0x1A1938 ZF_kf_fl32_S5_S3 3000 UMR_NM__1_1_0_S5_S3 -1500 1500
 /begin AXIS_DESCR STD_AXIS iK0sKorSignale.n_em_sync_k0_fl UMR_U_MIN_1_1_0_S5_S3 4 0 10000 DEPOSIT ABSOLUTE /end AXIS_DESCR
 /begin AXIS_DESCR STD_AXIS NO_INPUT_QUANTITY UMR___1_1_0_S5_S3 6 -400 1640 DEPOSIT ABSOLUTE FORMAT "%3.2" /end AXIS_DESCR
/end CHARACTERISTIC
/begin CHARACTERISTIC KF_MSCHALTK045 "[Nm] Schaltmoment" MAP 0x1A16F8 ZF_kf_fl32_S5_S3 3000 UMR_NM__1_1_0_S5_S3 -1500 1500
 /begin AXIS_DESCR STD_AXIS iK0sKorSignale.n_em_sync_k0_fl UMR_U_MIN_1_1_0_S5_S3 4 0 10000 DEPOSIT ABSOLUTE /end AXIS_DESCR
 /begin AXIS_DESCR STD_AXIS NO_INPUT_QUANTITY UMR___1_1_0_S5_S3 6 -400 1640 DEPOSIT ABSOLUTE FORMAT "%3.2" /end AXIS_DESCR
/end CHARACTERISTIC
/begin CHARACTERISTIC KF_MSCHALTK051 "[Nm] Schaltmoment" MAP 0x1A2088 ZF_kf_fl32_S5_S3 3000 UMR_NM__1_1_0_S5_S3 -1500 1500
 /begin AXIS_DESCR STD_AXIS iK0sKorSignale.n_em_sync_k0_fl UMR_U_MIN_1_1_0_S5_S3 4 0 10000 DEPOSIT ABSOLUTE /end AXIS_DESCR
 /begin AXIS_DESCR STD_AXIS NO_INPUT_QUANTITY UMR___1_1_0_S5_S3 6 -400 1640 DEPOSIT ABSOLUTE FORMAT "%3.2" /end AXIS_DESCR
/end CHARACTERISTIC
/begin CHARACTERISTIC KF_MSCHALTK053 "[Nm] Schaltmoment" MAP 0x1A1B78 ZF_kf_fl32_S5_S3 3000 UMR_NM__1_1_0_S5_S3 -1500 1500
 /begin AXIS_DESCR STD_AXIS iK0sKorSignale.n_em_sync_k0_fl UMR_U_MIN_1_1_0_S5_S3 4 0 10000 DEPOSIT ABSOLUTE /end AXIS_DESCR
 /begin AXIS_DESCR STD_AXIS NO_INPUT_QUANTITY UMR___1_1_0_S5_S3 6 -400 1640 DEPOSIT ABSOLUTE FORMAT "%3.2" /end AXIS_DESCR
/end CHARACTERISTIC
/begin CHARACTERISTIC KF_MSCHALTK054 "[Nm] Schaltmoment" MAP 0x1A18A8 ZF_kf_fl32_S5_S3 3000 UMR_NM__1_1_0_S5_S3 -1500 1500
 /begin AXIS_DESCR STD_AXIS iK0sKorSignale.n_em_sync_k0_fl UMR_U_MIN_1_1_0_S5_S3 4 0 10000 DEPOSIT ABSOLUTE /end AXIS_DESCR
 /begin AXIS_DESCR STD_AXIS NO_INPUT_QUANTITY UMR___1_1_0_S5_S3 6 -400 1640 DEPOSIT ABSOLUTE FORMAT "%3.2" /end AXIS_DESCR
/end CHARACTERISTIC
/begin CHARACTERISTIC KF_MSCHALTK056 "[Nm] Schaltmoment" MAP 0x1A1788 ZF_kf_fl32_S5_S3 3000 UMR_NM__1_1_0_S5_S3 -1500 1500
 /begin AXIS_DESCR STD_AXIS iK0sKorSignale.n_em_sync_k0_fl UMR_U_MIN_1_1_0_S5_S3 4 0 10000 DEPOSIT ABSOLUTE /end AXIS_DESCR
 /begin AXIS_DESCR STD_AXIS NO_INPUT_QUANTITY UMR___1_1_0_S5_S3 6 -400 1640 DEPOSIT ABSOLUTE FORMAT "%3.2" /end AXIS_DESCR
/end CHARACTERISTIC
/begin CHARACTERISTIC KF_MSCHALTK063 "[Nm] Schaltmoment" MAP 0x1A1FF8 ZF_kf_fl32_S5_S3 3000 UMR_NM__1_1_0_S5_S3 -1500 1500
 /begin AXIS_DESCR STD_AXIS iK0sKorSignale.n_em_sync_k0_fl UMR_U_MIN_1_1_0_S5_S3 4 0 10000 DEPOSIT ABSOLUTE /end AXIS_DESCR
 /begin AXIS_DESCR STD_AXIS NO_INPUT_QUANTITY UMR___1_1_0_S5_S3 6 -400 1640 DEPOSIT ABSOLUTE FORMAT "%3.2" /end AXIS_DESCR
/end CHARACTERISTIC
/begin CHARACTERISTIC KF_MSCHALTK064 "[Nm] Schaltmoment" MAP 0x1A1AE8 ZF_kf_fl32_S5_S3 3000 UMR_NM__1_1_0_S5_S3 -1500 1500
 /begin AXIS_DESCR STD_AXIS iK0sKorSignale.n_em_sync_k0_fl UMR_U_MIN_1_1_0_S5_S3 4 0 10000 DEPOSIT ABSOLUTE /end AXIS_DESCR
 /begin AXIS_DESCR STD_AXIS NO_INPUT_QUANTITY UMR___1_1_0_S5_S3 6 -400 1640 DEPOSIT ABSOLUTE FORMAT "%3.2" /end AXIS_DESCR
/end CHARACTERISTIC
/begin CHARACTERISTIC KF_MSCHALTK065 "[Nm] Schaltmoment" MAP 0x1A1818 ZF_kf_fl32_S5_S3 3000 UMR_NM__1_1_0_S5_S3 -1500 1500
 /begin AXIS_DESCR STD_AXIS iK0sKorSignale.n_em_sync_k0_fl UMR_U_MIN_1_1_0_S5_S3 4 0 10000 DEPOSIT ABSOLUTE /end AXIS_DESCR
 /begin AXIS_DESCR STD_AXIS NO_INPUT_QUANTITY UMR___1_1_0_S5_S3 6 -400 1640 DEPOSIT ABSOLUTE FORMAT "%3.2" /end AXIS_DESCR
/end CHARACTERISTIC
/begin CHARACTERISTIC KF_MSCHALTK067 "[Nm] Schaltmoment" MAP 0x1A22C8 ZF_kf_fl32_S5_S3 3000 UMR_NM__1_1_0_S5_S3 -1500 1500
 /begin AXIS_DESCR STD_AXIS iK0sKorSignale.n_em_sync_k0_fl UMR_U_MIN_1_1_0_S5_S3 4 0 10000 DEPOSIT ABSOLUTE /end AXIS_DESCR
 /begin AXIS_DESCR STD_AXIS NO_INPUT_QUANTITY UMR___1_1_0_S5_S3 6 -400 1640 DEPOSIT ABSOLUTE FORMAT "%3.2" /end AXIS_DESCR
/end CHARACTERISTIC
/begin CHARACTERISTIC KF_MSCHALTK071 "[Nm] Schaltmoment" MAP 0x1A2238 ZF_kf_fl32_S5_S3 3000 UMR_NM__1_1_0_S5_S3 -1500 1500
 /begin AXIS_DESCR STD_AXIS iK0sKorSignale.n_em_sync_k0_fl UMR_U_MIN_1_1_0_S5_S3 4 0 10000 DEPOSIT ABSOLUTE /end AXIS_DESCR
 /begin AXIS_DESCR STD_AXIS NO_INPUT_QUANTITY UMR___1_1_0_S5_S3 6 -400 1640 DEPOSIT ABSOLUTE FORMAT "%3.2" /end AXIS_DESCR
/end CHARACTERISTIC
/begin CHARACTERISTIC KF_MSCHALTK075 "[Nm] Schaltmoment" MAP 0x1A21A8 ZF_kf_fl32_S5_S3 3000 UMR_NM__1_1_0_S5_S3 -1500 1500
 /begin AXIS_DESCR STD_AXIS iK0sKorSignale.n_em_sync_k0_fl UMR_U_MIN_1_1_0_S5_S3 4 0 10000 DEPOSIT ABSOLUTE /end AXIS_DESCR
 /begin AXIS_DESCR STD_AXIS NO_INPUT_QUANTITY UMR___1_1_0_S5_S3 6 -400 1640 DEPOSIT ABSOLUTE FORMAT "%3.2" /end AXIS_DESCR
/end CHARACTERISTIC
/begin CHARACTERISTIC KF_MSCHALTK076 "[Nm] Schaltmoment" MAP 0x1A2118 ZF_kf_fl32_S5_S3 3000 UMR_NM__1_1_0_S5_S3 -1500 1500
 /begin AXIS_DESCR STD_AXIS iK0sKorSignale.n_em_sync_k0_fl UMR_U_MIN_1_1_0_S5_S3 4 0 10000 DEPOSIT ABSOLUTE /end AXIS_DESCR
 /begin AXIS_DESCR STD_AXIS NO_INPUT_QUANTITY UMR___1_1_0_S5_S3 6 -400 1640 DEPOSIT ABSOLUTE FORMAT "%3.2" /end AXIS_DESCR
/end CHARACTERISTIC
/begin CHARACTERISTIC KF_MSCHALTK078 "[Nm] Schaltmoment" MAP 0x1A1F68 ZF_kf_fl32_S5_S3 3000 UMR_NM__1_1_0_S5_S3 -1500 1500
 /begin AXIS_DESCR STD_AXIS iK0sKorSignale.n_em_sync_k0_fl UMR_U_MIN_1_1_0_S5_S3 4 0 10000 DEPOSIT ABSOLUTE /end AXIS_DESCR
 /begin AXIS_DESCR STD_AXIS NO_INPUT_QUANTITY UMR___1_1_0_S5_S3 6 -400 1640 DEPOSIT ABSOLUTE FORMAT "%3.2" /end AXIS_DESCR
/end CHARACTERISTIC
/begin CHARACTERISTIC KF_MSCHALTK082 "[Nm] Schaltmoment" MAP 0x1A1ED8 ZF_kf_fl32_S5_S3 3000 UMR_NM__1_1_0_S5_S3 -1500 1500
 /begin AXIS_DESCR STD_AXIS iK0sKorSignale.n_em_sync_k0_fl UMR_U_MIN_1_1_0_S5_S3 4 0 10000 DEPOSIT ABSOLUTE /end AXIS_DESCR
 /begin AXIS_DESCR STD_AXIS NO_INPUT_QUANTITY UMR___1_1_0_S5_S3 6 -400 1640 DEPOSIT ABSOLUTE FORMAT "%3.2" /end AXIS_DESCR
/end CHARACTERISTIC
/begin CHARACTERISTIC KF_MSCHALTK084 "[Nm] Schaltmoment" MAP 0x1A1E48 ZF_kf_fl32_S5_S3 3000 UMR_NM__1_1_0_S5_S3 -1500 1500
 /begin AXIS_DESCR STD_AXIS iK0sKorSignale.n_em_sync_k0_fl UMR_U_MIN_1_1_0_S5_S3 4 0 10000 DEPOSIT ABSOLUTE /end AXIS_DESCR
 /begin AXIS_DESCR STD_AXIS NO_INPUT_QUANTITY UMR___1_1_0_S5_S3 6 -400 1640 DEPOSIT ABSOLUTE FORMAT "%3.2" /end AXIS_DESCR
/end CHARACTERISTIC
/begin CHARACTERISTIC KF_MSCHALTK086 "[Nm] Schaltmoment" MAP 0x1A1DB8 ZF_kf_fl32_S5_S3 3000 UMR_NM__1_1_0_S5_S3 -1500 1500
 /begin AXIS_DESCR STD_AXIS iK0sKorSignale.n_em_sync_k0_fl UMR_U_MIN_1_1_0_S5_S3 4 0 10000 DEPOSIT ABSOLUTE /end AXIS_DESCR
 /begin AXIS_DESCR STD_AXIS NO_INPUT_QUANTITY UMR___1_1_0_S5_S3 6 -400 1640 DEPOSIT ABSOLUTE FORMAT "%3.2" /end AXIS_DESCR
/end CHARACTERISTIC
/begin CHARACTERISTIC KF_MSCHALTK087 "[Nm] Schaltmoment" MAP 0x1A1D28 ZF_kf_fl32_S5_S3 3000 UMR_NM__1_1_0_S5_S3 -1500 1500
 /begin AXIS_DESCR STD_AXIS iK0sKorSignale.n_em_sync_k0_fl UMR_U_MIN_1_1_0_S5_S3 4 0 10000 DEPOSIT ABSOLUTE /end AXIS_DESCR
 /begin AXIS_DESCR STD_AXIS NO_INPUT_QUANTITY UMR___1_1_0_S5_S3 6 -400 1640 DEPOSIT ABSOLUTE FORMAT "%3.2" /end AXIS_DESCR
/end CHARACTERISTIC
/begin CHARACTERISTIC KF_MSOLLMAXANFAHR_ECO_IAE "Maximales Soll-Moment im Anfahren" MAP 0x19D844 ZF_kf_si16_S5_S3 1100 UMR_NM__1_1_0_S5_S3 -100 1000
 /begin AXIS_DESCR STD_AXIS iIaeSigna.nd_mot_iae UMR_U_MIN_1_1_0_S5_S3 6 -8160 8160 DEPOSIT ABSOLUTE /end AXIS_DESCR
 /begin AXIS_DESCR STD_AXIS NO_INPUT_QUANTITY UMR_PROZENT__20_51_0_S5_S3 4 0 100 DEPOSIT ABSOLUTE /end AXIS_DESCR
/end CHARACTERISTIC
/begin CHARACTERISTIC KF_MSOLLMAXANFAHR_IAE "Maximales Soll-Moment im Anfahren" MAP 0x19D94C ZF_kf_si16_S5_S3 1100 UMR_NM__1_1_0_S5_S3 -100 1000
 /begin AXIS_DESCR STD_AXIS iIaeSigna.nd_mot_iae UMR_U_MIN_1_1_0_S5_S3 6 -8160 8160 DEPOSIT ABSOLUTE /end AXIS_DESCR
 /begin AXIS_DESCR STD_AXIS NO_INPUT_QUANTITY UMR_PROZENT__20_51_0_S5_S3 4 0 100 DEPOSIT ABSOLUTE /end AXIS_DESCR
/end CHARACTERISTIC
/begin CHARACTERISTIC KF_MSOLL_KALTANFAHR_IAE "IAE Sollmoment während Kaltanfahrt" MAP 0x19CDDC ZF_kf_si16_S5_S3 1000 UMR_NM__1_1_0_S5_S3 0 1000
 /begin AXIS_DESCR STD_AXIS iIaeSigna.nd_mot_iae UMR_U_MIN_1_1_0_S5_S3 8 -8160 8160 DEPOSIT ABSOLUTE /end AXIS_DESCR
 /begin AXIS_DESCR STD_AXIS iIaeSigna.mot_stress_iae UMR_PROZENT__16_10_0_S5_S3 4 0 200 DEPOSIT ABSOLUTE /end AXIS_DESCR
/end CHARACTERISTIC
/begin CHARACTERISTIC KF_MUEKORR_K0 "Korrekturoffset Übertragungsbeiwert K0 inkl. Geometriedaten Kolbenfläche, Reibradius, Anzahl der Reibflächen" MAP 0x19EA18 ZF_kf_fl32_S5_S3 1000 UMR___1_1_0_S5_S3 0 1000
 /begin AXIS_DESCR STD_AXIS zff_atsys._.iSignale._.obj.sig_c_getr_fl32 UMR_GRADC__1_1_0_S5_S3 6 -40 215 DEPOSIT ABSOLUTE /end AXIS_DESCR
 /begin AXIS_DESCR STD_AXIS NO_INPUT_QUANTITY UMR_NM__1_1_0_S5_S3 5 -10000 10000 DEPOSIT ABSOLUTE /end AXIS_DESCR
 FORMAT "%3.2" /end CHARACTERISTIC
/begin CHARACTERISTIC KF_MUE_K0 "Basiswert Übertragungsbeiwert Trennkupplung K0" MAP 0x19E954 ZF_kf_fl32_S5_S3 999.999 UMR_NM_BAR_1_1_0_S5_S3 0.001 1000
 /begin AXIS_DESCR STD_AXIS NO_INPUT_QUANTITY UMR_U_MIN_1_1_0_S5_S3 7 -8128 8128 DEPOSIT ABSOLUTE /end AXIS_DESCR
 /begin AXIS_DESCR STD_AXIS NO_INPUT_QUANTITY UMR_NM__1_1_0_S5_S3 5 -1500 1500 DEPOSIT ABSOLUTE /end AXIS_DESCR
 FORMAT "%4.3" /end CHARACTERISTIC
/begin CHARACTERISTIC KF_M_ANGELEGT_PBREMSDKI_IAE "Momentenvorgabe in Zustand Angelegt" MAP 0x19C8B4 ZF_kf_si16_S5_S3 100 UMR_NM__1_1_0_S5_S3 0 100
 /begin AXIS_DESCR STD_AXIS iIaeSigna.p_brems_iae UMR_BAR__1_100_0_S5_S3 6 -10 300 DEPOSIT ABSOLUTE /end AXIS_DESCR
 /begin AXIS_DESCR STD_AXIS NO_INPUT_QUANTITY UMR_PROZENT__20_51_0_S5_S3 4 0 100 DEPOSIT ABSOLUTE /end AXIS_DESCR
/end CHARACTERISTIC
/begin CHARACTERISTIC KF_M_KRIECH_IAE "gest. Kriechmoment" MAP 0x19CB08 ZF_kf_si16_S5_S3 2000 UMR_NM__1_1_0_S5_S3 0 2000
 /begin AXIS_DESCR STD_AXIS iIaeSigna.nd_getrein_iae UMR_U_MIN_1_1_0_S5_S3 6 -10000 10000 DEPOSIT ABSOLUTE /end AXIS_DESCR
 /begin AXIS_DESCR STD_AXIS NO_INPUT_QUANTITY UMR_GRADC__1_1_M40_S5_S3 6 -40 500 DEPOSIT ABSOLUTE /end AXIS_DESCR
/end CHARACTERISTIC
/begin CHARACTERISTIC KF_M_KRIECH_MAX_IAE "maximales Kriechmoment" MAP 0x19C9BC ZF_kf_si16_S5_S3 400 UMR_NM__1_1_0_S5_S3 -200 200
 /begin AXIS_DESCR STD_AXIS iIaeSigna.nd_getrein_iae UMR_U_MIN_1_1_0_S5_S3 6 -10000 10000 DEPOSIT ABSOLUTE /end AXIS_DESCR
 /begin AXIS_DESCR STD_AXIS iIaeSigna.p_brems_iae UMR_BAR__1_100_0_S5_S3 6 -10 300 DEPOSIT ABSOLUTE /end AXIS_DESCR
/end CHARACTERISTIC
/begin CHARACTERISTIC KF_M_KRIECH_MIN_IAE "minimales Kriechmoment" MAP 0x19CAA0 ZF_kf_si16_S5_S3 400 UMR_NM__1_1_0_S5_S3 -200 200
 /begin AXIS_DESCR STD_AXIS iIaeSigna.nd_getrein_iae UMR_U_MIN_1_1_0_S5_S3 6 -10000 10000 DEPOSIT ABSOLUTE /end AXIS_DESCR
 /begin AXIS_DESCR STD_AXIS iIaeSigna.p_brems_iae UMR_BAR__1_100_0_S5_S3 6 -10 300 DEPOSIT ABSOLUTE /end AXIS_DESCR
/end CHARACTERISTIC
/begin CHARACTERISTIC KF_M_MOTMAXSTALL_IAE "Motormomentenbegrenzung Endwert im Stallspeed" MAP 0x19D820 ZF_kf_si16_S5_S3 1000 UMR_NM__1_1_0_S5_S3 0 1000
 /begin AXIS_DESCR STD_AXIS NO_INPUT_QUANTITY UMR_SEC__1_100_0_S5_S3 4 0 300 DEPOSIT ABSOLUTE /end AXIS_DESCR
 /begin AXIS_DESCR STD_AXIS NO_INPUT_QUANTITY UMR_GRADC__1_1_M40_S5_S3 2 -40 460 DEPOSIT ABSOLUTE /end AXIS_DESCR
/end CHARACTERISTIC
/begin CHARACTERISTIC KF_M_SCHLEPP_IAE "Schleppmoment IAE" MAP 0x19D668 ZF_kf_si16_S5_S3 100 UMR_NM__1_1_0_S5_S3 0 100
 /begin AXIS_DESCR STD_AXIS NO_INPUT_QUANTITY UMR_GRADC__1_1_M40_S5_S3 4 -40 215 DEPOSIT ABSOLUTE /end AXIS_DESCR
 /begin AXIS_DESCR STD_AXIS NO_INPUT_QUANTITY UMR___1_1_0_S5_S3 6 -1 10 DEPOSIT ABSOLUTE /end AXIS_DESCR
/end CHARACTERISTIC
/begin CHARACTERISTIC KF_NDMOT_POSN_IAE "Drehzahlschwelle zur Erkennung Motordrücken um kfl_sollneutral_iae zu setzen" MAP 0x19DC9C ZF_kf_si16_S5_S3 2000 UMR_U_MIN_1_1_0_S5_S3 -1000 1000
 /begin AXIS_DESCR STD_AXIS iIaeSigna.n_motsoll_ll_iae UMR_U_MIN_1_1_0_S5_S3 6 -10000 10000 DEPOSIT ABSOLUTE /end AXIS_DESCR
 /begin AXIS_DESCR STD_AXIS iIaeSigna.m_motist_iae UMR_NM__1_1_0_S5_S3 6 -300 1500 DEPOSIT ABSOLUTE /end AXIS_DESCR
/end CHARACTERISTIC
/begin CHARACTERISTIC KF_ND_IAESOLLKRIECH_IAE "maximales Kriechmoment" MAP 0x19C910 ZF_kf_si16_S5_S3 4000 UMR_U_MIN_1_1_0_S5_S3 -2000 2000
 /begin AXIS_DESCR STD_AXIS iIaeSigna.nd_getrein_basis_ll_iae UMR_U_MIN_1_1_0_S5_S3 6 0 10000 DEPOSIT ABSOLUTE /end AXIS_DESCR
 /begin AXIS_DESCR STD_AXIS NO_INPUT_QUANTITY UMR___1_1_0_S5_S3 6 -1 8 DEPOSIT ABSOLUTE /end AXIS_DESCR
/end CHARACTERISTIC
/begin CHARACTERISTIC KF_NMOTANFAHRMAXC_IAE "Max. Anfahrdrehzahlbegrenzung bei Übertemperatur" MAP 0x19CFA4 ZF_kf_si16_S5_S3 5000 UMR_U_MIN_1_1_0_S5_S3 0 5000
 /begin AXIS_DESCR STD_AXIS NO_INPUT_QUANTITY UMR_GRADC__1_1_M40_S5_S3 6 -40 500 DEPOSIT ABSOLUTE /end AXIS_DESCR
 /begin AXIS_DESCR STD_AXIS NO_INPUT_QUANTITY UMR_GRADC__1_1_M40_S5_S3 6 -40 215 DEPOSIT ABSOLUTE /end AXIS_DESCR
/end CHARACTERISTIC
/begin CHARACTERISTIC KF_NMOTANFAHR_SOLL_NEIGUNG_IAE "Drehzahloffset auf Anfahrsolldrehzahl in Abhängigkeit der Neigung und des Pedalwerts" MAP 0x19CEC0 ZF_kf_si16_S5_S3 7000 UMR_U_MIN_1_1_0_S5_S3 0 7000
 /begin AXIS_DESCR STD_AXIS NO_INPUT_QUANTITY UMR_GRAD__1_3_M128_S5_S3 6 -42.6666666667 42.3333333333 DEPOSIT ABSOLUTE /end AXIS_DESCR
 /begin AXIS_DESCR STD_AXIS NO_INPUT_QUANTITY UMR_PROZENT__20_51_0_S5_S3 6 0 100 DEPOSIT ABSOLUTE /end AXIS_DESCR
/end CHARACTERISTIC
/begin CHARACTERISTIC KF_NS_SYNC_HYS_E_ECO_IAE "Hysterese für KF_NS_SYNC_IAE im E-Fahrmodus und ECO" MAP 0x19DBD8 ZF_kf_si16_S5_S3 5000 UMR_U_MIN_1_1_0_S5_S3 0 5000
 /begin AXIS_DESCR STD_AXIS NO_INPUT_QUANTITY UMR_PROZENT__20_51_0_S5_S3 4 0 100 DEPOSIT ABSOLUTE /end AXIS_DESCR
 /begin AXIS_DESCR STD_AXIS iIaeSigna.ng_ab_iae UMR_U_MINSEC_1_1_0_S5_S3 4 -10000 10000 DEPOSIT ABSOLUTE /end AXIS_DESCR
/end CHARACTERISTIC
/begin CHARACTERISTIC KF_NS_SYNC_HYS_E_IAE "Hysterese für KF_NS_SYNC_IAE im E-Fahrmodus" MAP 0x19DB68 ZF_kf_si16_S5_S3 5000 UMR_U_MIN_1_1_0_S5_S3 0 5000
 /begin AXIS_DESCR STD_AXIS NO_INPUT_QUANTITY UMR_PROZENT__20_51_0_S5_S3 4 0 100 DEPOSIT ABSOLUTE /end AXIS_DESCR
 /begin AXIS_DESCR STD_AXIS iIaeSigna.ng_ab_iae UMR_U_MINSEC_1_1_0_S5_S3 4 -10000 10000 DEPOSIT ABSOLUTE /end AXIS_DESCR
/end CHARACTERISTIC
/begin CHARACTERISTIC KF_NS_SYNC_HYS_H_ECO_IAE "Hysterese für KF_NS_SYNC_IAE im H-Fahrmodusund ECO" MAP 0x19DBA0 ZF_kf_si16_S5_S3 5000 UMR_U_MIN_1_1_0_S5_S3 0 5000
 /begin AXIS_DESCR STD_AXIS NO_INPUT_QUANTITY UMR_PROZENT__20_51_0_S5_S3 4 0 100 DEPOSIT ABSOLUTE /end AXIS_DESCR
 /begin AXIS_DESCR STD_AXIS iIaeSigna.ng_ab_iae UMR_U_MINSEC_1_1_0_S5_S3 4 -10000 10000 DEPOSIT ABSOLUTE /end AXIS_DESCR
/end CHARACTERISTIC
/begin CHARACTERISTIC KF_NS_SYNC_HYS_H_IAE "Hysterese für KF_NS_SYNC_IAE im H-Fahrmodus" MAP 0x19DB30 ZF_kf_si16_S5_S3 5000 UMR_U_MIN_1_1_0_S5_S3 0 5000
 /begin AXIS_DESCR STD_AXIS NO_INPUT_QUANTITY UMR_PROZENT__20_51_0_S5_S3 4 0 100 DEPOSIT ABSOLUTE /end AXIS_DESCR
 /begin AXIS_DESCR STD_AXIS iIaeSigna.ng_ab_iae UMR_U_MINSEC_1_1_0_S5_S3 4 -10000 10000 DEPOSIT ABSOLUTE /end AXIS_DESCR
/end CHARACTERISTIC
/begin CHARACTERISTIC KF_NS_SYNC_IAE "Drehzahlschwelle" MAP 0x19DA9C ZF_kf_si16_S5_S3 3000 UMR_U_MIN_1_1_0_S5_S3 -1000 2000
 /begin AXIS_DESCR STD_AXIS iIaeSigna.x_kf_ns_sync_iae UMR___1_1000_0_S5_S3 9 -30 30 DEPOSIT ABSOLUTE /end AXIS_DESCR
 /begin AXIS_DESCR STD_AXIS iIaeSigna.ng_ab_iae UMR_U_MINSEC_1_1_0_S5_S3 6 -10000 10000 DEPOSIT ABSOLUTE /end AXIS_DESCR
/end CHARACTERISTIC
/begin CHARACTERISTIC KF_OG_M_AUF_FAKTOR_IAE "Mindeständerung des Faktors zum Rausrampen des eingefrorenen IAE-Aufnahmemomentenwerts" MAP 0x19D568 ZF_kf_fl32_S5_S3 10000 UMR__SEC_1_1_0_S5_S3 -10000 0
 /begin AXIS_DESCR STD_AXIS NO_INPUT_QUANTITY UMR_PROZENT__20_51_0_S5_S3 4 0 100 DEPOSIT ABSOLUTE /end AXIS_DESCR
 /begin AXIS_DESCR STD_AXIS NO_INPUT_QUANTITY UMR_U_MIN_1_1_0_S5_S3 2 0 8160 DEPOSIT ABSOLUTE /end AXIS_DESCR
 FORMAT "%3.2" /end CHARACTERISTIC
/begin CHARACTERISTIC KF_PHYSCGETRNMOT_K0 "Temperatur- und motordrehzahlabhängiger Anteil des HAS-Hysterese-Offsets" MAP 0x1A1238 ZF_kf_si16_S5_S3 30 UMR_BAR__1_1000_0_S5_S3 0 30
 /begin AXIS_DESCR STD_AXIS zff_atsys._.iSignale._.obj.sig_c_getr UMR_GRADC__1_1_M40_S5_S3 10 -40 215 DEPOSIT ABSOLUTE /end AXIS_DESCR
 /begin AXIS_DESCR STD_AXIS NO_INPUT_QUANTITY UMR_U_MIN_1_1_0_S5_S3 4 0 8160 DEPOSIT ABSOLUTE /end AXIS_DESCR
/end CHARACTERISTIC
/begin CHARACTERISTIC KF_PK0_PSYS "[bar] Stellgroesse KPL = f(po_ko_soll, p_sys)" MAP 0x1A0A58 ZF_kf_ui16_S5_S3 15 UMR_BAR__1_1000_0_S5_S3 0 15
 /begin AXIS_DESCR STD_AXIS NO_INPUT_QUANTITY UMR___1_1000_0_S5_S3 8 0 15 DEPOSIT ABSOLUTE /end AXIS_DESCR
 /begin AXIS_DESCR STD_AXIS iSasPsyst.p_sys UMR_BAR__1_1000_0_S5_S3 4 0 20 DEPOSIT ABSOLUTE /end AXIS_DESCR
/end CHARACTERISTIC
/begin CHARACTERISTIC KF_POCGETRPSYS_K0 "Druckoffset zum Ausgleich von eventuellen Druckstellproblemen" MAP 0x1A0904 ZF_kf_fl32_S5_S3 30 UMR_BAR__1_1_0_S5_S3 0 30
 /begin AXIS_DESCR STD_AXIS zff_atsys._.iSignale._.obj.sig_c_getr UMR_GRADC__1_1_M40_S5_S3 9 -40 215 DEPOSIT ABSOLUTE /end AXIS_DESCR
 /begin AXIS_DESCR STD_AXIS iSasPsyst.p_sys UMR_BAR__1_1000_0_S5_S3 7 0 20 DEPOSIT ABSOLUTE /end AXIS_DESCR
 FORMAT "%4.3" /end CHARACTERISTIC
/begin CHARACTERISTIC KF_POFCGETRMSOLL_K0 "Temperatur- und momentenabhängiger Anteil des HAS-Hysterese-Offsets" MAP 0x1A1198 ZF_kf_si16_S5_S3 30 UMR_BAR__1_1000_0_S5_S3 0 30
 /begin AXIS_DESCR STD_AXIS zff_atsys._.iSignale._.obj.sig_c_getr UMR_GRADC__1_1_M40_S5_S3 10 -40 215 DEPOSIT ABSOLUTE /end AXIS_DESCR
 /begin AXIS_DESCR STD_AXIS iK0sSteuerung.m_soll_k0 UMR_NM__1_1_0_S5_S3 6 0 1500 DEPOSIT ABSOLUTE /end AXIS_DESCR
/end CHARACTERISTIC
/begin CHARACTERISTIC KF_POREGCGETRNMOT_K0 "Temperatur- und motordrehzahlabhängiger Schlupfregeloffsetdruck auf den minimalen Fülldruck" MAP 0x1A12AC ZF_kf_si16_S5_S3 20 UMR_BAR__1_1000_0_S5_S3 -10 10
 /begin AXIS_DESCR STD_AXIS zff_atsys._.iSignale._.obj.sig_c_getr UMR_GRADC__1_1_M40_S5_S3 10 -40 215 DEPOSIT ABSOLUTE /end AXIS_DESCR
 /begin AXIS_DESCR STD_AXIS NO_INPUT_QUANTITY UMR_U_MIN_1_1_0_S5_S3 4 0 8160 DEPOSIT ABSOLUTE /end AXIS_DESCR
/end CHARACTERISTIC
/begin CHARACTERISTIC KF_PO_TORUS_CGETR_VPSEK_K0 "Druckoffsetanteil Torusdruckkompensation" MAP 0x1A13B4 ZF_kf_si16_S5_S3 4 UMR_BAR__1_1000_0_S5_S3 -2 2
 /begin AXIS_DESCR STD_AXIS zff_atsys._.iSignale._.obj.sig_c_getr UMR_GRADC__1_1_M40_S5_S3 3 -40 215 DEPOSIT ABSOLUTE /end AXIS_DESCR
 /begin AXIS_DESCR STD_AXIS NO_INPUT_QUANTITY UMR_LITER_MIN_1_10_0_S5_S3 8 0 500 DEPOSIT ABSOLUTE /end AXIS_DESCR
/end CHARACTERISTIC
/begin CHARACTERISTIC KF_P_TORUS_PSYS_VPSEK_K0 "Druckoffsetanteil Torusdruckkompensation" MAP 0x1A1320 ZF_kf_fl32_S5_S3 4 UMR_BAR__1_1_0_S5_S3 -2 2
 /begin AXIS_DESCR STD_AXIS iSasPsyst.p_sys UMR_BAR__1_1000_0_S5_S3 3 0 20 DEPOSIT ABSOLUTE /end AXIS_DESCR
 /begin AXIS_DESCR STD_AXIS NO_INPUT_QUANTITY UMR_LITER_MIN_1_10_0_S5_S3 8 0 500 DEPOSIT ABSOLUTE /end AXIS_DESCR
 FORMAT "%4.3" /end CHARACTERISTIC
/begin CHARACTERISTIC KF_RAWNDEINREGK0S "Rampensteigung Einregelrampe Schub" MAP 0x19F5E8 ZF_kf_si16_S5_S3 6000 UMR_U_MINSEC_1_1_0_S5_S3 -3000 3000
 /begin AXIS_DESCR STD_AXIS iK0sKorSignale.ng_em_sync_k0 UMR_U_MINSEC_1_1_0_S5_S3 4 -8128 8128 DEPOSIT ABSOLUTE /end AXIS_DESCR
 /begin AXIS_DESCR STD_AXIS iK0sKorSignale.nd_k0 UMR_U_MIN_1_1_0_S5_S3 4 -2000 2000 DEPOSIT ABSOLUTE /end AXIS_DESCR
/end CHARACTERISTIC
/begin CHARACTERISTIC KF_RAWNDEINREGK0Z "Rampensteigung Einregelrampe Zug" MAP 0x19F620 ZF_kf_si16_S5_S3 6000 UMR_U_MINSEC_1_1_0_S5_S3 -3000 3000
 /begin AXIS_DESCR STD_AXIS iK0sKorSignale.ng_em_sync_k0 UMR_U_MINSEC_1_1_0_S5_S3 4 -8128 8128 DEPOSIT ABSOLUTE /end AXIS_DESCR
 /begin AXIS_DESCR STD_AXIS iK0sKorSignale.nd_k0 UMR_U_MIN_1_1_0_S5_S3 4 -2000 2000 DEPOSIT ABSOLUTE /end AXIS_DESCR
/end CHARACTERISTIC
/begin CHARACTERISTIC KF_TFC_K0 "Temperaturabhängiges Kennfeld für Füllzeit" MAP 0x1A05E8 ZF_kf_ui16_S5_S3 50 UMR_SEC__1_100_0_S5_S3 0 50
 /begin AXIS_DESCR STD_AXIS iK0sKorSignale.n_em_sync_k0 UMR_U_MIN_1_1_0_S5_S3 8 -8128 8128 DEPOSIT ABSOLUTE /end AXIS_DESCR
 /begin AXIS_DESCR STD_AXIS zff_atsys._.iSignale._.obj.sig_c_getr UMR_GRADC__1_1_M40_S5_S3 9 -40 215 DEPOSIT ABSOLUTE /end AXIS_DESCR
/end CHARACTERISTIC
/begin CHARACTERISTIC KF_TFC_K0_OPT "Temperaturabhängiges Kennfeld für Füllzeit bei optimierter Befüllung" MAP 0x1A06A4 ZF_kf_ui16_S5_S3 10 UMR_SEC__1_100_0_S5_S3 0 10
 /begin AXIS_DESCR STD_AXIS iK0sKorSignale.n_em_sync_k0 UMR_U_MIN_1_1_0_S5_S3 8 -8128 8128 DEPOSIT ABSOLUTE /end AXIS_DESCR
 /begin AXIS_DESCR STD_AXIS zff_atsys._.iSignale._.obj.sig_c_getr UMR_GRADC__1_1_M40_S5_S3 9 -40 215 DEPOSIT ABSOLUTE /end AXIS_DESCR
/end CHARACTERISTIC
/begin CHARACTERISTIC KF_TFC_K0_RED "Temperaturabhängiges Kennfeld für Füllzeit bei reduzierter Befüllung" MAP 0x1A0760 ZF_kf_ui16_S5_S3 10 UMR_SEC__1_100_0_S5_S3 0 10
 /begin AXIS_DESCR STD_AXIS iK0sKorSignale.n_em_sync_k0 UMR_U_MIN_1_1_0_S5_S3 8 -8128 8128 DEPOSIT ABSOLUTE /end AXIS_DESCR
 /begin AXIS_DESCR STD_AXIS zff_atsys._.iSignale._.obj.sig_c_getr UMR_GRADC__1_1_M40_S5_S3 9 -40 215 DEPOSIT ABSOLUTE /end AXIS_DESCR
/end CHARACTERISTIC
/begin CHARACTERISTIC KF_TSTATUS_AUSLP1_IEP "Kennfeld zur Eingabe der Zeit die die IEP zum Erreichen des Leistungspunktes benötigt" MAP 0x19E5F4 ZF_kf_ui16_S5_S3 1000 UMR_MSEC__1_1_0_S5_S3 0 1000
 /begin AXIS_DESCR STD_AXIS iSasPsyst.p_sys UMR_BAR__1_1000_0_S5_S3 7 0 20 DEPOSIT ABSOLUTE /end AXIS_DESCR
 /begin AXIS_DESCR STD_AXIS zff_atsys._.iSignale._.obj.sig_c_getr UMR_GRADC__1_1_M40_S5_S3 6 -40 215 DEPOSIT ABSOLUTE /end AXIS_DESCR
/end CHARACTERISTIC
/begin CHARACTERISTIC KF_TSTATUS_AUSLP2_IEP "Kennfeld zur Eingabe der Zeit die die IEP zum Erreichen des Leistungspunktes benötigt" MAP 0x19E66C ZF_kf_ui16_S5_S3 1000 UMR_MSEC__1_1_0_S5_S3 0 1000
 /begin AXIS_DESCR STD_AXIS iSasPsyst.p_sys UMR_BAR__1_1000_0_S5_S3 7 0 20 DEPOSIT ABSOLUTE /end AXIS_DESCR
 /begin AXIS_DESCR STD_AXIS zff_atsys._.iSignale._.obj.sig_c_getr UMR_GRADC__1_1_M40_S5_S3 6 -40 215 DEPOSIT ABSOLUTE /end AXIS_DESCR
/end CHARACTERISTIC
/begin CHARACTERISTIC KF_TSTATUS_AUSLP3_IEP "Kennfeld zur Eingabe der Zeit die die IEP zum Erreichen des Leistungspunktes benötigt" MAP 0x19E6E4 ZF_kf_ui16_S5_S3 1000 UMR_MSEC__1_1_0_S5_S3 0 1000
 /begin AXIS_DESCR STD_AXIS iSasPsyst.p_sys UMR_BAR__1_1000_0_S5_S3 7 0 20 DEPOSIT ABSOLUTE /end AXIS_DESCR
 /begin AXIS_DESCR STD_AXIS zff_atsys._.iSignale._.obj.sig_c_getr UMR_GRADC__1_1_M40_S5_S3 6 -40 215 DEPOSIT ABSOLUTE /end AXIS_DESCR
/end CHARACTERISTIC
/begin CHARACTERISTIC KF_TSTATUS_LP1LP2_IEP "Kennfeld zur Eingabe der Zeit die die IEP zum Erreichen des Leistungspunktes benötigt" MAP 0x19E760 ZF_kf_ui16_S5_S3 1000 UMR_MSEC__1_1_0_S5_S3 0 1000
 /begin AXIS_DESCR STD_AXIS iSasPsyst.p_sys UMR_BAR__1_1000_0_S5_S3 7 0 20 DEPOSIT ABSOLUTE /end AXIS_DESCR
 /begin AXIS_DESCR STD_AXIS zff_atsys._.iSignale._.obj.sig_c_getr UMR_GRADC__1_1_M40_S5_S3 6 -40 215 DEPOSIT ABSOLUTE /end AXIS_DESCR
/end CHARACTERISTIC
/begin CHARACTERISTIC KF_TSTATUS_LP1LP3_IEP "Kennfeld zur Eingabe der Zeit die die IEP zum Erreichen des Leistungspunktes benötigt" MAP 0x19E7D8 ZF_kf_ui16_S5_S3 1000 UMR_MSEC__1_1_0_S5_S3 0 1000
 /begin AXIS_DESCR STD_AXIS iSasPsyst.p_sys UMR_BAR__1_1000_0_S5_S3 7 0 20 DEPOSIT ABSOLUTE /end AXIS_DESCR
 /begin AXIS_DESCR STD_AXIS zff_atsys._.iSignale._.obj.sig_c_getr UMR_GRADC__1_1_M40_S5_S3 6 -40 215 DEPOSIT ABSOLUTE /end AXIS_DESCR
/end CHARACTERISTIC
/begin CHARACTERISTIC KF_TSTATUS_LP2LP3_IEP "Kennfeld zur Eingabe der Zeit die die IEP zum Erreichen des Leistungspunktes benötigt" MAP 0x19E850 ZF_kf_ui16_S5_S3 1000 UMR_MSEC__1_1_0_S5_S3 0 1000
 /begin AXIS_DESCR STD_AXIS iSasPsyst.p_sys UMR_BAR__1_1000_0_S5_S3 7 0 20 DEPOSIT ABSOLUTE /end AXIS_DESCR
 /begin AXIS_DESCR STD_AXIS zff_atsys._.iSignale._.obj.sig_c_getr UMR_GRADC__1_1_M40_S5_S3 6 -40 215 DEPOSIT ABSOLUTE /end AXIS_DESCR
/end CHARACTERISTIC
/begin CHARACTERISTIC KF_TSTATUS_LPAUS_IEP "Zeit, in der die IEP noch Druck liefert während des Abschaltens" MAP 0x19E8C8 ZF_kf_ui16_S5_S3 1000 UMR_MSEC__1_1_0_S5_S3 0 1000
 /begin AXIS_DESCR STD_AXIS iSasPsyst.p_sys UMR_BAR__1_1000_0_S5_S3 7 0 20 DEPOSIT ABSOLUTE /end AXIS_DESCR
 /begin AXIS_DESCR STD_AXIS zff_atsys._.iSignale._.obj.sig_c_getr UMR_GRADC__1_1_M40_S5_S3 6 -40 215 DEPOSIT ABSOLUTE /end AXIS_DESCR
/end CHARACTERISTIC
/begin CHARACTERISTIC KF_T_POIST_K0 "Zeitkonstante PT2-Filter po_ist" MAP 0x1A10F0 ZF_kf_fl32_S5_S3 4 UMR_SEC__1_1_0_S5_S3 0 4
 /begin AXIS_DESCR STD_AXIS NO_INPUT_QUANTITY UMR_BAR__1_1_0_S5_S3 4 0 30 DEPOSIT ABSOLUTE FORMAT "%4.3" /end AXIS_DESCR
 /begin AXIS_DESCR STD_AXIS zff_atsys._.iSignale._.obj.sig_c_getr_fl32 UMR_GRADC__1_1_0_S5_S3 4 -40 215 DEPOSIT ABSOLUTE /end AXIS_DESCR
 FORMAT "%4.3" /end CHARACTERISTIC
/begin CHARACTERISTIC KF_T_PT2_M_IST_IAE "Filterkonstante für PT2-Filter für m_ist_iae" MAP 0x19D430 ZF_kf_si16_S5_S3 1.98 UMR_SEC__1_1000_0_S5_S3 0.02 2
 /begin AXIS_DESCR STD_AXIS iIaeDraus.p_ist_basis_iae UMR_BAR__1_1000_0_S5_S3 6 -1 20 DEPOSIT ABSOLUTE /end AXIS_DESCR
 /begin AXIS_DESCR STD_AXIS NO_INPUT_QUANTITY UMR_GRADC__1_1_M40_S5_S3 6 -40 215 DEPOSIT ABSOLUTE /end AXIS_DESCR
/end CHARACTERISTIC
/begin CHARACTERISTIC KF_T_UEF_MANF_KRIECH_ANGL_IAE "Zeit der Überführungsfunktion für m_soll_iae beim Übergang von Anfahren nach Kriechen oder Angelegt" MAP 0x19D3F8 ZF_kf_si16_S5_S3 5000 UMR_MSEC__10_1_0_S5_S3 0 5000
 /begin AXIS_DESCR STD_AXIS iIaeMomen.m_soll_iae UMR_NM__1_1_0_S5_S3 4 -200 2000 DEPOSIT ABSOLUTE /end AXIS_DESCR
 /begin AXIS_DESCR STD_AXIS iIaeSigna.nd_mot_iae UMR_U_MIN_1_1_0_S5_S3 4 -10000 10000 DEPOSIT ABSOLUTE /end AXIS_DESCR
/end CHARACTERISTIC
/begin CHARACTERISTIC KF_T_UEF_M_ANGELEGT_KRIECH_IAE "Zeit der Überführungsfunktion für m_soll_iae beim Übergang von Angelegt nach Kriechen" MAP 0x19D390 ZF_kf_si16_S5_S3 50000 UMR_MSEC__10_1_0_S5_S3 0 50000
 /begin AXIS_DESCR STD_AXIS NO_INPUT_QUANTITY UMR_U_MIN_1_1_0_S5_S3 6 0 10000 DEPOSIT ABSOLUTE /end AXIS_DESCR
 /begin AXIS_DESCR STD_AXIS NO_INPUT_QUANTITY UMR_GRADC__1_1_M40_S5_S3 6 -10040 9960 DEPOSIT ABSOLUTE /end AXIS_DESCR
/end CHARACTERISTIC
/begin CHARACTERISTIC KF_T_UEF_M_VOR_ANF_IAE "Dauer Überführung von m_ist_vorst_iae im Zustand Anfahren" MAP 0x19D498 ZF_kf_si16_S5_S3 5000 UMR_MSEC__10_1_0_S5_S3 0 5000
 /begin AXIS_DESCR STD_AXIS NO_INPUT_QUANTITY UMR_U_MIN_1_1_0_S5_S3 6 0 10000 DEPOSIT ABSOLUTE /end AXIS_DESCR
 /begin AXIS_DESCR STD_AXIS NO_INPUT_QUANTITY UMR_GRADC__1_1_M40_S5_S3 6 -10040 9960 DEPOSIT ABSOLUTE /end AXIS_DESCR
/end CHARACTERISTIC
/begin CHARACTERISTIC KF_T_UEF_M_VOR_ANF_KRIANG_IAE "Dauer Überführung von m_ist_vorst_iae im Zustand Angelegt/Kriechen von Anfahren" MAP 0x19D500 ZF_kf_si16_S5_S3 5000 UMR_MSEC__10_1_0_S5_S3 0 5000
 /begin AXIS_DESCR STD_AXIS NO_INPUT_QUANTITY UMR_U_MIN_1_1_0_S5_S3 6 0 10000 DEPOSIT ABSOLUTE /end AXIS_DESCR
 /begin AXIS_DESCR STD_AXIS NO_INPUT_QUANTITY UMR_GRADC__1_1_M40_S5_S3 6 -10040 9960 DEPOSIT ABSOLUTE /end AXIS_DESCR
/end CHARACTERISTIC
/begin CHARACTERISTIC KF_T_UEF_ZU_KRIECH_ANGL_IAE "Zeit der Überführungsfunktion für m_soll_iae beim Übergang von ZU nach Kriechen oder Angelegt" MAP 0x19D2E4 ZF_kf_si16_S5_S3 5000 UMR_MSEC__10_1_0_S5_S3 0 5000
 /begin AXIS_DESCR STD_AXIS NO_INPUT_QUANTITY UMR___1_1_0_S5_S3 6 -1 9 DEPOSIT ABSOLUTE /end AXIS_DESCR
 /begin AXIS_DESCR STD_AXIS NO_INPUT_QUANTITY UMR_U_MINSEC_1_1_0_S5_S3 6 -10000 10000 DEPOSIT ABSOLUTE /end AXIS_DESCR
/end CHARACTERISTIC
/begin CHARACTERISTIC KF_VPOEL_CGETR_1_K0 "K0 Kuehlöldurcchfluss bei Temperaturstützstelle 1" MAP 0x19EF94 ZF_kf_fl32_S5_S3 10 UMR_LITER_MIN_1_1_0_S5_S3 0 10
 /begin AXIS_DESCR STD_AXIS NO_INPUT_QUANTITY UMR_BAR__1_1_0_S5_S3 3 0 22 DEPOSIT ABSOLUTE FORMAT "%4.3" /end AXIS_DESCR
 /begin AXIS_DESCR STD_AXIS iK0sTempM.n_pumpe_virt_k0 UMR_U_MIN_1_1_0_S5_S3 6 -8128 8128 DEPOSIT ABSOLUTE /end AXIS_DESCR
 FORMAT "%2.1" /end CHARACTERISTIC
/begin CHARACTERISTIC KF_VPOEL_CGETR_2_K0 "K0 Kuehlöldurcchfluss bei Temperaturstützstelle 2" MAP 0x19F008 ZF_kf_fl32_S5_S3 10 UMR_LITER_MIN_1_1_0_S5_S3 0 10
 /begin AXIS_DESCR STD_AXIS NO_INPUT_QUANTITY UMR_BAR__1_1_0_S5_S3 3 0 22 DEPOSIT ABSOLUTE FORMAT "%4.3" /end AXIS_DESCR
 /begin AXIS_DESCR STD_AXIS iK0sTempM.n_pumpe_virt_k0 UMR_U_MIN_1_1_0_S5_S3 6 -8128 8128 DEPOSIT ABSOLUTE /end AXIS_DESCR
 FORMAT "%2.1" /end CHARACTERISTIC
/begin CHARACTERISTIC KF_VPOEL_CGETR_3_K0 "K0 Kuehlöldurcchfluss bei Temperaturstützstelle 3" MAP 0x19F07C ZF_kf_fl32_S5_S3 10 UMR_LITER_MIN_1_1_0_S5_S3 0 10
 /begin AXIS_DESCR STD_AXIS NO_INPUT_QUANTITY UMR_BAR__1_1_0_S5_S3 3 0 22 DEPOSIT ABSOLUTE FORMAT "%4.3" /end AXIS_DESCR
 /begin AXIS_DESCR STD_AXIS iK0sTempM.n_pumpe_virt_k0 UMR_U_MIN_1_1_0_S5_S3 6 -8128 8128 DEPOSIT ABSOLUTE /end AXIS_DESCR
 FORMAT "%2.1" /end CHARACTERISTIC
/begin CHARACTERISTIC KF_WNDOFDYNK01 "Solldifferenzdrehzahloffset Fahrdynamik" MAP 0x19F6D8 ZF_kf_si16_S5_S3 300 UMR_U_MIN_1_1_0_S5_S3 0 300
 /begin AXIS_DESCR STD_AXIS iK0sKorSignale.n_em_sync_k0 UMR_U_MIN_1_1_0_S5_S3 4 0 8128 DEPOSIT ABSOLUTE /end AXIS_DESCR
 /begin AXIS_DESCR STD_AXIS iK0sKorSW.iSODyn.delta_dkpedal_k0 UMR_PROZENT__20_51_0_S5_S3 6 0 100 DEPOSIT ABSOLUTE /end AXIS_DESCR
/end CHARACTERISTIC
/begin CHARACTERISTIC KF_WNDOFDYNK02 "Solldifferenzdrehzahloffset Fahrdynamik" MAP 0x19F724 ZF_kf_si16_S5_S3 300 UMR_U_MIN_1_1_0_S5_S3 0 300
 /begin AXIS_DESCR STD_AXIS iK0sKorSignale.n_em_sync_k0 UMR_U_MIN_1_1_0_S5_S3 4 0 8128 DEPOSIT ABSOLUTE /end AXIS_DESCR
 /begin AXIS_DESCR STD_AXIS iK0sKorSW.iSODyn.delta_dkpedal_k0 UMR_PROZENT__20_51_0_S5_S3 6 0 100 DEPOSIT ABSOLUTE /end AXIS_DESCR
/end CHARACTERISTIC
/begin CHARACTERISTIC KF_WNDOFDYNK03 "Solldifferenzdrehzahloffset Fahrdynamik" MAP 0x19F770 ZF_kf_si16_S5_S3 300 UMR_U_MIN_1_1_0_S5_S3 0 300
 /begin AXIS_DESCR STD_AXIS iK0sKorSignale.n_em_sync_k0 UMR_U_MIN_1_1_0_S5_S3 4 0 8128 DEPOSIT ABSOLUTE /end AXIS_DESCR
 /begin AXIS_DESCR STD_AXIS iK0sKorSW.iSODyn.delta_dkpedal_k0 UMR_PROZENT__20_51_0_S5_S3 6 0 100 DEPOSIT ABSOLUTE /end AXIS_DESCR
/end CHARACTERISTIC
/begin CHARACTERISTIC KF_WNDOFDYNK04 "Solldifferenzdrehzahloffset Fahrdynamik" MAP 0x19F7BC ZF_kf_si16_S5_S3 300 UMR_U_MIN_1_1_0_S5_S3 0 300
 /begin AXIS_DESCR STD_AXIS iK0sKorSignale.n_em_sync_k0 UMR_U_MIN_1_1_0_S5_S3 4 0 8128 DEPOSIT ABSOLUTE /end AXIS_DESCR
 /begin AXIS_DESCR STD_AXIS iK0sKorSW.iSODyn.delta_dkpedal_k0 UMR_PROZENT__20_51_0_S5_S3 6 0 100 DEPOSIT ABSOLUTE /end AXIS_DESCR
/end CHARACTERISTIC
/begin CHARACTERISTIC KF_WNDOFDYNK05 "Solldifferenzdrehzahloffset Fahrdynamik" MAP 0x19F808 ZF_kf_si16_S5_S3 300 UMR_U_MIN_1_1_0_S5_S3 0 300
 /begin AXIS_DESCR STD_AXIS iK0sKorSignale.n_em_sync_k0 UMR_U_MIN_1_1_0_S5_S3 4 0 8128 DEPOSIT ABSOLUTE /end AXIS_DESCR
 /begin AXIS_DESCR STD_AXIS iK0sKorSW.iSODyn.delta_dkpedal_k0 UMR_PROZENT__20_51_0_S5_S3 6 0 100 DEPOSIT ABSOLUTE /end AXIS_DESCR
/end CHARACTERISTIC
/begin CHARACTERISTIC KF_WNDOFDYNK06 "Solldifferenzdrehzahloffset Fahrdynamik" MAP 0x19F854 ZF_kf_si16_S5_S3 300 UMR_U_MIN_1_1_0_S5_S3 0 300
 /begin AXIS_DESCR STD_AXIS iK0sKorSignale.n_em_sync_k0 UMR_U_MIN_1_1_0_S5_S3 4 0 8128 DEPOSIT ABSOLUTE /end AXIS_DESCR
 /begin AXIS_DESCR STD_AXIS iK0sKorSW.iSODyn.delta_dkpedal_k0 UMR_PROZENT__20_51_0_S5_S3 6 0 100 DEPOSIT ABSOLUTE /end AXIS_DESCR
/end CHARACTERISTIC
/begin CHARACTERISTIC KF_WNDOFDYNK07 "Solldifferenzdrehzahloffset Fahrdynamik" MAP 0x19F8A0 ZF_kf_si16_S5_S3 300 UMR_U_MIN_1_1_0_S5_S3 0 300
 /begin AXIS_DESCR STD_AXIS iK0sKorSignale.n_em_sync_k0 UMR_U_MIN_1_1_0_S5_S3 4 0 8128 DEPOSIT ABSOLUTE /end AXIS_DESCR
 /begin AXIS_DESCR STD_AXIS iK0sKorSW.iSODyn.delta_dkpedal_k0 UMR_PROZENT__20_51_0_S5_S3 6 0 100 DEPOSIT ABSOLUTE /end AXIS_DESCR
/end CHARACTERISTIC
/begin CHARACTERISTIC KF_WNDOFDYNK08 "Solldifferenzdrehzahloffset Fahrdynamik" MAP 0x19F8EC ZF_kf_si16_S5_S3 300 UMR_U_MIN_1_1_0_S5_S3 0 300
 /begin AXIS_DESCR STD_AXIS iK0sKorSignale.n_em_sync_k0 UMR_U_MIN_1_1_0_S5_S3 4 0 8128 DEPOSIT ABSOLUTE /end AXIS_DESCR
 /begin AXIS_DESCR STD_AXIS iK0sKorSW.iSODyn.delta_dkpedal_k0 UMR_PROZENT__20_51_0_S5_S3 6 0 100 DEPOSIT ABSOLUTE /end AXIS_DESCR
/end CHARACTERISTIC
/begin CHARACTERISTIC KF_WNDOFDYNK0R "Solldifferenzdrehzahloffset Fahrdynamik" MAP 0x19F68C ZF_kf_si16_S5_S3 300 UMR_U_MIN_1_1_0_S5_S3 0 300
 /begin AXIS_DESCR STD_AXIS iK0sKorSignale.n_em_sync_k0 UMR_U_MIN_1_1_0_S5_S3 4 0 8128 DEPOSIT ABSOLUTE /end AXIS_DESCR
 /begin AXIS_DESCR STD_AXIS iK0sKorSW.iSODyn.delta_dkpedal_k0 UMR_PROZENT__20_51_0_S5_S3 6 0 100 DEPOSIT ABSOLUTE /end AXIS_DESCR
/end CHARACTERISTIC
/begin CHARACTERISTIC KF_WNDOGSCHALT_K0_RSZ "Initialisierungswert für den Sollwertgradient im Synchronpunkt neuer Gang bei RSZ" MAP 0x19FA50 ZF_kf_si16_S5_S3 4000 UMR_U_MINSEC_1_1_0_S5_S3 -2000 2000
 /begin AXIS_DESCR STD_AXIS iK0sKorSignale.n_em_sync_k0 UMR_U_MIN_1_1_0_S5_S3 4 0 8128 DEPOSIT ABSOLUTE /end AXIS_DESCR
 /begin AXIS_DESCR STD_AXIS iK0sKorSignale.m_vmist_sync_k0 UMR_NM__1_1_0_S5_S3 4 -2000 13000 DEPOSIT ABSOLUTE /end AXIS_DESCR
/end CHARACTERISTIC
/begin CHARACTERISTIC KF_WNDOGSCHALT_K0_RSZ_SP "Initialisierungswert für den Sollwertgradient im Synchronpunkt neuer Gang bei RSZ" MAP 0x19FAF4 ZF_kf_si16_S5_S3 4000 UMR_U_MINSEC_1_1_0_S5_S3 -2000 2000
 /begin AXIS_DESCR STD_AXIS iK0sKorSignale.n_em_sync_k0 UMR_U_MIN_1_1_0_S5_S3 4 0 8128 DEPOSIT ABSOLUTE /end AXIS_DESCR
 /begin AXIS_DESCR STD_AXIS iK0sKorSignale.m_vmist_sync_k0 UMR_NM__1_1_0_S5_S3 4 -2000 13000 DEPOSIT ABSOLUTE /end AXIS_DESCR
/end CHARACTERISTIC
/begin CHARACTERISTIC KF_WNDSTDK01 "Solldifferenzdrehzahl WK waehrend Normalbetrieb / Warmlauf 1.Gang" MAP 0x19FCA0 ZF_kf_si16_S5_S3 200 UMR_U_MIN_1_1_0_S5_S3 0 200
 /begin AXIS_DESCR STD_AXIS iK0sKorSignale.n_em_sync_k0 UMR_U_MIN_1_1_0_S5_S3 8 0 8128 DEPOSIT ABSOLUTE /end AXIS_DESCR
 /begin AXIS_DESCR STD_AXIS iK0sKorSignale.m_vmist_sync_k0 UMR_NM__1_1_0_S5_S3 6 -2000 13000 DEPOSIT ABSOLUTE /end AXIS_DESCR
/end CHARACTERISTIC
/begin CHARACTERISTIC KF_WNDSTDK01_ASD "Solldifferenzdrehzahl WK waehrend Normalbetrieb / Warmlauf 1.Gang" MAP 0x1A01C8 ZF_kf_si16_S5_S3 200 UMR_U_MIN_1_1_0_S5_S3 0 200
 /begin AXIS_DESCR STD_AXIS iK0sKorSignale.n_em_sync_k0 UMR_U_MIN_1_1_0_S5_S3 8 0 8128 DEPOSIT ABSOLUTE /end AXIS_DESCR
 /begin AXIS_DESCR STD_AXIS iK0sKorSignale.m_vmist_sync_k0 UMR_NM__1_1_0_S5_S3 6 -2000 13000 DEPOSIT ABSOLUTE /end AXIS_DESCR
/end CHARACTERISTIC
/begin CHARACTERISTIC KF_WNDSTDK02 "Solldifferenzdrehzahl WK waehrend Normalbetrieb / Warmlauf 2.Gang" MAP 0x19FD24 ZF_kf_si16_S5_S3 200 UMR_U_MIN_1_1_0_S5_S3 0 200
 /begin AXIS_DESCR STD_AXIS iK0sKorSignale.n_em_sync_k0 UMR_U_MIN_1_1_0_S5_S3 8 0 8128 DEPOSIT ABSOLUTE /end AXIS_DESCR
 /begin AXIS_DESCR STD_AXIS iK0sKorSignale.m_vmist_sync_k0 UMR_NM__1_1_0_S5_S3 6 -2000 13000 DEPOSIT ABSOLUTE /end AXIS_DESCR
/end CHARACTERISTIC
/begin CHARACTERISTIC KF_WNDSTDK02_ASD "Solldifferenzdrehzahl WK waehrend Normalbetrieb / Warmlauf 2.Gang" MAP 0x1A024C ZF_kf_si16_S5_S3 200 UMR_U_MIN_1_1_0_S5_S3 0 200
 /begin AXIS_DESCR STD_AXIS iK0sKorSignale.n_em_sync_k0 UMR_U_MIN_1_1_0_S5_S3 8 0 8128 DEPOSIT ABSOLUTE /end AXIS_DESCR
 /begin AXIS_DESCR STD_AXIS iK0sKorSignale.m_vmist_sync_k0 UMR_NM__1_1_0_S5_S3 6 -2000 13000 DEPOSIT ABSOLUTE /end AXIS_DESCR
/end CHARACTERISTIC
/begin CHARACTERISTIC KF_WNDSTDK03 "Solldifferenzdrehzahl WK waehrend Normalbetrieb / Warmlauf 3.Gang" MAP 0x19FDA8 ZF_kf_si16_S5_S3 200 UMR_U_MIN_1_1_0_S5_S3 0 200
 /begin AXIS_DESCR STD_AXIS iK0sKorSignale.n_em_sync_k0 UMR_U_MIN_1_1_0_S5_S3 8 0 8128 DEPOSIT ABSOLUTE /end AXIS_DESCR
 /begin AXIS_DESCR STD_AXIS iK0sKorSignale.m_vmist_sync_k0 UMR_NM__1_1_0_S5_S3 6 -2000 13000 DEPOSIT ABSOLUTE /end AXIS_DESCR
/end CHARACTERISTIC
/begin CHARACTERISTIC KF_WNDSTDK03_ASD "Solldifferenzdrehzahl WK waehrend Normalbetrieb / Warmlauf 3.Gang" MAP 0x1A02D0 ZF_kf_si16_S5_S3 200 UMR_U_MIN_1_1_0_S5_S3 0 200
 /begin AXIS_DESCR STD_AXIS iK0sKorSignale.n_em_sync_k0 UMR_U_MIN_1_1_0_S5_S3 8 0 8128 DEPOSIT ABSOLUTE /end AXIS_DESCR
 /begin AXIS_DESCR STD_AXIS iK0sKorSignale.m_vmist_sync_k0 UMR_NM__1_1_0_S5_S3 6 -2000 13000 DEPOSIT ABSOLUTE /end AXIS_DESCR
/end CHARACTERISTIC
/begin CHARACTERISTIC KF_WNDSTDK04 "Solldifferenzdrehzahl WK waehrend Normalbetrieb / Warmlauf 4.Gang" MAP 0x19FE2C ZF_kf_si16_S5_S3 200 UMR_U_MIN_1_1_0_S5_S3 0 200
 /begin AXIS_DESCR STD_AXIS iK0sKorSignale.n_em_sync_k0 UMR_U_MIN_1_1_0_S5_S3 8 0 8128 DEPOSIT ABSOLUTE /end AXIS_DESCR
 /begin AXIS_DESCR STD_AXIS iK0sKorSignale.m_vmist_sync_k0 UMR_NM__1_1_0_S5_S3 6 -2000 13000 DEPOSIT ABSOLUTE /end AXIS_DESCR
/end CHARACTERISTIC
/begin CHARACTERISTIC KF_WNDSTDK04_ASD "Solldifferenzdrehzahl WK waehrend Normalbetrieb / Warmlauf 4.Gang" MAP 0x1A0354 ZF_kf_si16_S5_S3 200 UMR_U_MIN_1_1_0_S5_S3 0 200
 /begin AXIS_DESCR STD_AXIS iK0sKorSignale.n_em_sync_k0 UMR_U_MIN_1_1_0_S5_S3 8 0 8128 DEPOSIT ABSOLUTE /end AXIS_DESCR
 /begin AXIS_DESCR STD_AXIS iK0sKorSignale.m_vmist_sync_k0 UMR_NM__1_1_0_S5_S3 6 -2000 13000 DEPOSIT ABSOLUTE /end AXIS_DESCR
/end CHARACTERISTIC
/begin CHARACTERISTIC KF_WNDSTDK05 "Solldifferenzdrehzahl WK waehrend Normalbetrieb / Warmlauf 5.Gang" MAP 0x19FEB0 ZF_kf_si16_S5_S3 200 UMR_U_MIN_1_1_0_S5_S3 0 200
 /begin AXIS_DESCR STD_AXIS iK0sKorSignale.n_em_sync_k0 UMR_U_MIN_1_1_0_S5_S3 8 0 8128 DEPOSIT ABSOLUTE /end AXIS_DESCR
 /begin AXIS_DESCR STD_AXIS iK0sKorSignale.m_vmist_sync_k0 UMR_NM__1_1_0_S5_S3 6 -2000 13000 DEPOSIT ABSOLUTE /end AXIS_DESCR
/end CHARACTERISTIC
/begin CHARACTERISTIC KF_WNDSTDK05_ASD "Solldifferenzdrehzahl WK waehrend Normalbetrieb / Warmlauf 5.Gang" MAP 0x1A03D8 ZF_kf_si16_S5_S3 200 UMR_U_MIN_1_1_0_S5_S3 0 200
 /begin AXIS_DESCR STD_AXIS iK0sKorSignale.n_em_sync_k0 UMR_U_MIN_1_1_0_S5_S3 8 0 8128 DEPOSIT ABSOLUTE /end AXIS_DESCR
 /begin AXIS_DESCR STD_AXIS iK0sKorSignale.m_vmist_sync_k0 UMR_NM__1_1_0_S5_S3 6 -2000 13000 DEPOSIT ABSOLUTE /end AXIS_DESCR
/end CHARACTERISTIC
/begin CHARACTERISTIC KF_WNDSTDK06 "Solldifferenzdrehzahl WK waehrend Normalbetrieb / Warmlauf 6.Gang" MAP 0x19FF34 ZF_kf_si16_S5_S3 200 UMR_U_MIN_1_1_0_S5_S3 0 200
 /begin AXIS_DESCR STD_AXIS iK0sKorSignale.n_em_sync_k0 UMR_U_MIN_1_1_0_S5_S3 8 0 8128 DEPOSIT ABSOLUTE /end AXIS_DESCR
 /begin AXIS_DESCR STD_AXIS iK0sKorSignale.m_vmist_sync_k0 UMR_NM__1_1_0_S5_S3 6 -2000 13000 DEPOSIT ABSOLUTE /end AXIS_DESCR
/end CHARACTERISTIC
/begin CHARACTERISTIC KF_WNDSTDK06_ASD "Solldifferenzdrehzahl WK waehrend Normalbetrieb / Warmlauf 6.Gang" MAP 0x1A045C ZF_kf_si16_S5_S3 200 UMR_U_MIN_1_1_0_S5_S3 0 200
 /begin AXIS_DESCR STD_AXIS iK0sKorSignale.n_em_sync_k0 UMR_U_MIN_1_1_0_S5_S3 8 0 8128 DEPOSIT ABSOLUTE /end AXIS_DESCR
 /begin AXIS_DESCR STD_AXIS iK0sKorSignale.m_vmist_sync_k0 UMR_NM__1_1_0_S5_S3 6 -2000 13000 DEPOSIT ABSOLUTE /end AXIS_DESCR
/end CHARACTERISTIC
/begin CHARACTERISTIC KF_WNDSTDK07 "Solldifferenzdrehzahl WK waehrend Normalbetrieb / Warmlauf 7.Gang" MAP 0x19FFB8 ZF_kf_si16_S5_S3 200 UMR_U_MIN_1_1_0_S5_S3 0 200
 /begin AXIS_DESCR STD_AXIS iK0sKorSignale.n_em_sync_k0 UMR_U_MIN_1_1_0_S5_S3 8 0 8128 DEPOSIT ABSOLUTE /end AXIS_DESCR
 /begin AXIS_DESCR STD_AXIS iK0sKorSignale.m_vmist_sync_k0 UMR_NM__1_1_0_S5_S3 6 -2000 13000 DEPOSIT ABSOLUTE /end AXIS_DESCR
/end CHARACTERISTIC
/begin CHARACTERISTIC KF_WNDSTDK07_ASD "Solldifferenzdrehzahl WK waehrend Normalbetrieb / Warmlauf 7.Gang" MAP 0x1A04E0 ZF_kf_si16_S5_S3 200 UMR_U_MIN_1_1_0_S5_S3 0 200
 /begin AXIS_DESCR STD_AXIS iK0sKorSignale.n_em_sync_k0 UMR_U_MIN_1_1_0_S5_S3 8 0 8128 DEPOSIT ABSOLUTE /end AXIS_DESCR
 /begin AXIS_DESCR STD_AXIS iK0sKorSignale.m_vmist_sync_k0 UMR_NM__1_1_0_S5_S3 6 -2000 13000 DEPOSIT ABSOLUTE /end AXIS_DESCR
/end CHARACTERISTIC
/begin CHARACTERISTIC KF_WNDSTDK08 "Solldifferenzdrehzahl WK waehrend Normalbetrieb / Warmlauf 8.Gang" MAP 0x1A003C ZF_kf_si16_S5_S3 200 UMR_U_MIN_1_1_0_S5_S3 0 200
 /begin AXIS_DESCR STD_AXIS iK0sKorSignale.n_em_sync_k0 UMR_U_MIN_1_1_0_S5_S3 8 0 8128 DEPOSIT ABSOLUTE /end AXIS_DESCR
 /begin AXIS_DESCR STD_AXIS iK0sKorSignale.m_vmist_sync_k0 UMR_NM__1_1_0_S5_S3 6 -2000 13000 DEPOSIT ABSOLUTE /end AXIS_DESCR
/end CHARACTERISTIC
/begin CHARACTERISTIC KF_WNDSTDK08_ASD "Solldifferenzdrehzahl WK waehrend Normalbetrieb / Warmlauf 8.Gang" MAP 0x1A0564 ZF_kf_si16_S5_S3 200 UMR_U_MIN_1_1_0_S5_S3 0 200
 /begin AXIS_DESCR STD_AXIS iK0sKorSignale.n_em_sync_k0 UMR_U_MIN_1_1_0_S5_S3 8 0 8128 DEPOSIT ABSOLUTE /end AXIS_DESCR
 /begin AXIS_DESCR STD_AXIS iK0sKorSignale.m_vmist_sync_k0 UMR_NM__1_1_0_S5_S3 6 -2000 13000 DEPOSIT ABSOLUTE /end AXIS_DESCR
/end CHARACTERISTIC
/begin CHARACTERISTIC KF_WNDSTDK0PN "Solldifferenzdrehzahl WK waehrend Position P/N" MAP 0x19FB98 ZF_kf_si16_S5_S3 200 UMR_U_MIN_1_1_0_S5_S3 0 200
 /begin AXIS_DESCR STD_AXIS iK0sKorSignale.n_em_sync_k0 UMR_U_MIN_1_1_0_S5_S3 8 0 8128 DEPOSIT ABSOLUTE /end AXIS_DESCR
 /begin AXIS_DESCR STD_AXIS iK0sKorSignale.m_vmist_sync_k0 UMR_NM__1_1_0_S5_S3 6 -2000 13000 DEPOSIT ABSOLUTE /end AXIS_DESCR
/end CHARACTERISTIC
/begin CHARACTERISTIC KF_WNDSTDK0PN_ASD "Solldifferenzdrehzahl WK waehrend Position P/N" MAP 0x1A00C0 ZF_kf_si16_S5_S3 200 UMR_U_MIN_1_1_0_S5_S3 0 200
 /begin AXIS_DESCR STD_AXIS iK0sKorSignale.n_em_sync_k0 UMR_U_MIN_1_1_0_S5_S3 8 0 8128 DEPOSIT ABSOLUTE /end AXIS_DESCR
 /begin AXIS_DESCR STD_AXIS iK0sKorSignale.m_vmist_sync_k0 UMR_NM__1_1_0_S5_S3 6 -2000 13000 DEPOSIT ABSOLUTE /end AXIS_DESCR
/end CHARACTERISTIC
/begin CHARACTERISTIC KF_WNDSTDK0R "Solldifferenzdrehzahl WK waehrend Normalbetrieb / Warmlauf R.Gang" MAP 0x19FC1C ZF_kf_si16_S5_S3 200 UMR_U_MIN_1_1_0_S5_S3 0 200
 /begin AXIS_DESCR STD_AXIS iK0sKorSignale.n_em_sync_k0 UMR_U_MIN_1_1_0_S5_S3 8 0 8128 DEPOSIT ABSOLUTE /end AXIS_DESCR
 /begin AXIS_DESCR STD_AXIS iK0sKorSignale.m_vmist_sync_k0 UMR_NM__1_1_0_S5_S3 6 -2000 13000 DEPOSIT ABSOLUTE /end AXIS_DESCR
/end CHARACTERISTIC
/begin CHARACTERISTIC KF_WNDSTDK0R_ASD "Solldifferenzdrehzahl WK waehrend Normalbetrieb / Warmlauf R.Gang" MAP 0x1A0144 ZF_kf_si16_S5_S3 200 UMR_U_MIN_1_1_0_S5_S3 0 200
 /begin AXIS_DESCR STD_AXIS iK0sKorSignale.n_em_sync_k0 UMR_U_MIN_1_1_0_S5_S3 8 0 8128 DEPOSIT ABSOLUTE /end AXIS_DESCR
 /begin AXIS_DESCR STD_AXIS iK0sKorSignale.m_vmist_sync_k0 UMR_NM__1_1_0_S5_S3 6 -2000 13000 DEPOSIT ABSOLUTE /end AXIS_DESCR
/end CHARACTERISTIC
/begin CHARACTERISTIC KI_K0ZU "Verstärkungsfaktor für den I-Regler" VALUE 0x1A0A4C ZF_kw_fl32_S5_S3 10 UMR___1_1_0_S5_S3 0 10 FORMAT "%3.2" /end CHARACTERISTIC
/begin CHARACTERISTIC KI_ZU_IAE "I-Anteil für Absicherungsregler in ZU" VALUE 0x19D054 ZF_kw_fl32_S5_S3 10 UMR___1_1_0_S5_S3 0 10 FORMAT "%3.2" /end CHARACTERISTIC
/begin CHARACTERISTIC KL_ALPHA_AUF_IAE "Kennfeld ALPHA_IAE bei kup_status_iae = nicht definiert oder offen" CURVE 0x19DD50 ZF_kl_fl32_S5_S3 999.9 UMR_W_K_1_1_0_S5_S3 0.1 1000
 /begin AXIS_DESCR STD_AXIS NO_INPUT_QUANTITY UMR_U_MIN_1_1_0_S5_S3 4 -8160 8160 DEPOSIT ABSOLUTE /end AXIS_DESCR
/end CHARACTERISTIC
/begin CHARACTERISTIC KL_ALPHA_GEHAEUSE_K0 "Wärmeübergang auf Grund von Konvektion/Strahlung aus dem Lamellenraum ans Getriebegehäuse" CURVE 0x19F1A4 ZF_kl_fl32_S5_S3 100 UMR_W_K_1_1_0_1_S5_S3 0 100
 /begin AXIS_DESCR STD_AXIS iK0sTempM.vp_oel_k0 UMR_LITER_MIN_1_1_0_S5_S3 8 0 10 DEPOSIT ABSOLUTE FORMAT "%2.1" /end AXIS_DESCR
 FORMAT "%2.1" /end CHARACTERISTIC
/begin CHARACTERISTIC KL_ALPHA_GEHAEUSE_ND_K0 "Wärmeübergang auf Grund von Konvektion/Strahlung vom Torus ans Getriebegehäuse in Abhängigkeit der Differenzdrehzahl" CURVE 0x19F1E8 ZF_kl_fl32_S5_S3 1000 UMR_W_K_1_1_0_2_S5_S3 0 1000
 /begin AXIS_DESCR STD_AXIS NO_INPUT_QUANTITY UMR_U_MIN_1_1_0_S5_S3 11 -8128 8128 DEPOSIT ABSOLUTE /end AXIS_DESCR
 FORMAT "%3.2" /end CHARACTERISTIC
/begin CHARACTERISTIC KL_ALPHA_GEHAEUSE_VPOEL_K0 "Wärmeübergang auf Grund von Konvektion/Strahlung vom Torus ans Getriebegehäuse in Abhängigkeit des Kühlölvolumenstroms" CURVE 0x19F244 ZF_kl_fl32_S5_S3 100 UMR_W_K_1_1_0_1_S5_S3 0 100
 /begin AXIS_DESCR STD_AXIS iK0sTempM.vp_oel_k0 UMR_LITER_MIN_1_1_0_S5_S3 8 0 10 DEPOSIT ABSOLUTE FORMAT "%2.1" /end AXIS_DESCR
 FORMAT "%2.1" /end CHARACTERISTIC
/begin CHARACTERISTIC KL_ALPHA_LRAUM_ND_K0 "Produkt aus Wärmeübergangskoeffizient u. Fläche des Wärmeübergangs vom Lamellenraum zum Torus in Abhängigkeit der Differenzdrehzahl" CURVE 0x19F2CC ZF_kl_fl32_S5_S3 200 UMR_W_K_1_1_0_2_S5_S3 0 200
 /begin AXIS_DESCR STD_AXIS NO_INPUT_QUANTITY UMR_U_MIN_1_1_0_S5_S3 11 -8128 8128 DEPOSIT ABSOLUTE /end AXIS_DESCR
 FORMAT "%3.2" /end CHARACTERISTIC
/begin CHARACTERISTIC KL_ALPHA_LRAUM_VPOEL_K0 "Wärmeübergang auf Grund von Konvektion/Strahlung aus dem Lamellenraum ans Getriebegehäuse" CURVE 0x19F288 ZF_kl_fl32_S5_S3 1000 UMR_W_K_1_1_0_2_S5_S3 0 1000
 /begin AXIS_DESCR STD_AXIS iK0sTempM.vp_oel_k0 UMR_LITER_MIN_1_1_0_S5_S3 8 0 10 DEPOSIT ABSOLUTE FORMAT "%2.1" /end AXIS_DESCR
 FORMAT "%3.2" /end CHARACTERISTIC
/begin CHARACTERISTIC KL_ALPHA_ZU_IAE "Kennfeld ALPHA_IAE bei kup_status_iae = zu" CURVE 0x19DD74 ZF_kl_fl32_S5_S3 999.9 UMR_W_K_1_1_0_S5_S3 0.1 1000
 /begin AXIS_DESCR STD_AXIS NO_INPUT_QUANTITY UMR_LITER_MIN_1_10_0_S5_S3 4 0 50 DEPOSIT ABSOLUTE /end AXIS_DESCR
/end CHARACTERISTIC
/begin CHARACTERISTIC KL_CSMOT_ANFMODUS_IAE "Motortemperaturschwelle zum Einstieg in Kaltanfahrmodus" CURVE 0x19CD90 ZF_kl_si16_S5_S3 80 UMR_GRADC__1_1_M48_S5_S3 -40 40
 /begin AXIS_DESCR STD_AXIS iIaeSigna.mot_stress_iae UMR_PROZENT__16_10_0_S5_S3 4 0 200 DEPOSIT ABSOLUTE /end AXIS_DESCR
/end CHARACTERISTIC
/begin CHARACTERISTIC KL_DKPEDALMIN_K0 "Minimaler Pedalwert beim Übergang z_fdyn = 1 -> 2 für SWI_WNDFDYN = TRUE" CURVE 0x19F988 ZF_kl_si16_S5_S3 100 UMR_PROZENT__20_51_0_S5_S3 0 100
 /begin AXIS_DESCR STD_AXIS iK0sKorSignale.n_em_sync_k0 UMR_U_MIN_1_1_0_S5_S3 4 0 8128 DEPOSIT ABSOLUTE /end AXIS_DESCR
/end CHARACTERISTIC
/begin CHARACTERISTIC KL_DNKORR_K0 "Kennlinie zur Extrapolation der Motordrehzahl" CURVE 0x19EB58 ZF_kl_si16_S5_S3 200 UMR_U_MIN_1_1_0_S5_S3 -100 100
 /begin AXIS_DESCR STD_AXIS NO_INPUT_QUANTITY UMR___1_1_0_S5_S3 4 -10500 10500 DEPOSIT ABSOLUTE /end AXIS_DESCR
/end CHARACTERISTIC
/begin CHARACTERISTIC KL_FMUEC_K0 "Temperaturabhängiger Korrekturfaktor Übertragungsbeiwert Trennkupplung K0" CURVE 0x19EAC4 ZF_kl_fl32_S5_S3 1.99 UMR___1_1_0_S5_S3 0.01 2
 /begin AXIS_DESCR STD_AXIS NO_INPUT_QUANTITY UMR___1_1_0_S5_S3 6 -40 215 DEPOSIT ABSOLUTE FORMAT "%3.2" /end AXIS_DESCR
 FORMAT "%3.2" /end CHARACTERISTIC
/begin CHARACTERISTIC KL_FNMOTANFAHRLL_IAE "Faktor zur Korrektur der Anfahrdrehzahl bei LL-Drehzahlanhebung" CURVE 0x19CF60 ZF_kl_si16_S5_S3 2 UMR___1_100_0_S5_S3 0 2
 /begin AXIS_DESCR STD_AXIS iIaeSigna.n_motanfahr_basis_iae UMR_U_MIN_1_1_0_S5_S3 4 0 5000 DEPOSIT ABSOLUTE /end AXIS_DESCR
/end CHARACTERISTIC
/begin CHARACTERISTIC KL_FNMOTANFAHRMOTSTRESS_IAE "Dauer der Überführungsfunktion des Kriechsollwerts" CURVE 0x19D028 ZF_kl_si16_S5_S3 2 UMR___1_100_0_S5_S3 0 2
 /begin AXIS_DESCR STD_AXIS iIaeSigna.mot_stress_iae UMR_PROZENT__16_10_0_S5_S3 4 0 200 DEPOSIT ABSOLUTE /end AXIS_DESCR
/end CHARACTERISTIC
/begin CHARACTERISTIC KL_FNSSYNC_IAE "Faktor zur Berücksichtigung der Getriebeöltemperatur in der Berechnung der IAE-Öffnen und Schliessdrehzahl" CURVE 0x19DA64 ZF_kl_si16_S5_S3 4 UMR___1_100_0_S5_S3 -2 2
 /begin AXIS_DESCR STD_AXIS NO_INPUT_QUANTITY UMR_GRADC__1_1_M40_S5_S3 6 -40 500 DEPOSIT ABSOLUTE /end AXIS_DESCR
/end CHARACTERISTIC
/begin CHARACTERISTIC KL_F_CIAEINI_IAE "Faktor zur IAE-Temperatur-Initialisierung" CURVE 0x19DE14 ZF_kl_fl32_S5_S3 1 UMR___1_1_0_S5_S3 0 1
 /begin AXIS_DESCR STD_AXIS NO_INPUT_QUANTITY UMR_SEC__1_1_0_S5_S3 6 0 4294967295 DEPOSIT ABSOLUTE FORMAT "%4.3" /end AXIS_DESCR
 FORMAT "%3.2" /end CHARACTERISTIC
/begin CHARACTERISTIC KL_F_MINIT_REST_EINREG_K0 "Faktorkennlinie zum Abbau von m_init_rest_k0" CURVE 0x1A0AB8 ZF_kl_ui8_S5_S3 1 UMR___1_100_0_S5_S3 0 1
 /begin AXIS_DESCR STD_AXIS iK0sKorSW.iStdSW.f_minit_rest_k0 UMR_PROZENT__20_51_0_S5_S3 4 0 100 DEPOSIT ABSOLUTE /end AXIS_DESCR
/end CHARACTERISTIC
/begin CHARACTERISTIC KL_F_MMOTGEMOE_IAE "Gewichtungsfunktion für gem. Motormoment" CURVE 0x19DC88 ZF_kl_si16_S5_S3 1 UMR___1_100_0_S5_S3 0 1
 /begin AXIS_DESCR STD_AXIS iIaeSigna.n_mot_iae UMR_U_MIN_1_1_0_S5_S3 4 0 8160 DEPOSIT ABSOLUTE /end AXIS_DESCR
/end CHARACTERISTIC
/begin CHARACTERISTIC KL_F_MOSCHALT_ZU_IAE "Faktor auf Überanpressung in Zustand Zu während Schaltungen" CURVE 0x19CCBC ZF_kl_si16_S5_S3 5 UMR___1_100_0_S5_S3 0 5
 /begin AXIS_DESCR STD_AXIS iIaeSigna.m_motistoe_iae UMR_NM__1_1_0_S5_S3 4 -200 1300 DEPOSIT ABSOLUTE /end AXIS_DESCR
/end CHARACTERISTIC
/begin CHARACTERISTIC KL_F_MPT_ZUREGELN_K0 "Gewichtungsfaktor für Abfilterkonstante Überanpressungsoffset" CURVE 0x1A08BC ZF_kl_fl32_S5_S3 1 UMR___1_1_0_S5_S3 0 1
 /begin AXIS_DESCR STD_AXIS NO_INPUT_QUANTITY UMR___1_1_0_S5_S3 3 -40 215 DEPOSIT ABSOLUTE FORMAT "%3.2" /end AXIS_DESCR
 FORMAT "%3.2" /end CHARACTERISTIC
/begin CHARACTERISTIC KL_F_MSCHLEPP_IAE "Faktor auf IAE-Schleppmoment" CURVE 0x19D640 ZF_kl_si16_S5_S3 1 UMR___1_100_0_S5_S3 0 1
 /begin AXIS_DESCR STD_AXIS iIaeMomen.m_soll_iae UMR_NM__1_1_0_S5_S3 4 -200 1500 DEPOSIT ABSOLUTE /end AXIS_DESCR
/end CHARACTERISTIC
/begin CHARACTERISTIC KL_F_M_ANGELEGT_IAE "Faktor auf Ansteuermoment in Angelegt abhängig von Motordrehzahl" CURVE 0x19C900 ZF_kl_si16_S5_S3 1 UMR___1_100_0_S5_S3 0 1
 /begin AXIS_DESCR STD_AXIS iIaeSigna.n_mot_iae UMR_U_MIN_1_1_0_S5_S3 3 0 10000 DEPOSIT ABSOLUTE /end AXIS_DESCR
/end CHARACTERISTIC
/begin CHARACTERISTIC KL_F_M_KRIECH_MAX_NEIGUNG_IAE "Faktor auf maximales Kriechmoment in Abhängigkeit der Neigung" CURVE 0x19CA8C ZF_kl_si16_S5_S3 2 UMR___1_100_0_S5_S3 0 2
 /begin AXIS_DESCR STD_AXIS NO_INPUT_QUANTITY UMR_GRAD__1_3_M128_S5_S3 4 -3376 3290.66666667 DEPOSIT ABSOLUTE /end AXIS_DESCR
/end CHARACTERISTIC
/begin CHARACTERISTIC KL_F_NDIAESOLLKRIECH_IAE "Faktor auf Solldrehzahl im Kriechen" CURVE 0x19C978 ZF_kl_si16_S5_S3 2 UMR___1_100_0_S5_S3 0 2
 /begin AXIS_DESCR STD_AXIS iIaeSigna.nd_getrein_iae UMR_U_MIN_1_1_0_S5_S3 6 -10000 10000 DEPOSIT ABSOLUTE /end AXIS_DESCR
/end CHARACTERISTIC
/begin CHARACTERISTIC KL_F_NGMOTANFAHRINITGE_IAE "Faktor auf Initialisierungsgradient für den Sollanfahrdrehzahlfilter während des Gangeinlegevorgangs" CURVE 0x19CF28 ZF_kl_si16_S5_S3 2 UMR___1_100_0_S5_S3 0 2
 /begin AXIS_DESCR STD_AXIS NO_INPUT_QUANTITY UMR_PROZENT__20_51_0_S5_S3 6 0 100 DEPOSIT ABSOLUTE /end AXIS_DESCR
/end CHARACTERISTIC
/begin CHARACTERISTIC KL_F_NUE_IAE "Faktor auf nue-Wert zur Überführung auf den Wert 0" CURVE 0x19DC10 ZF_kl_si16_S5_S3 1 UMR___1_100_0_S5_S3 0 1
 /begin AXIS_DESCR STD_AXIS iIaeSigna.n_mot_iae UMR_U_MIN_1_1_0_S5_S3 4 0 8160 DEPOSIT ABSOLUTE /end AXIS_DESCR
/end CHARACTERISTIC
/begin CHARACTERISTIC KL_F_ONMOTANFAHR_IAE "Faktor auf Anfahrdrehzahloffset zur Erkennung auf entkoppelt_anfahren" CURVE 0x19CF88 ZF_kl_si16_S5_S3 1 UMR___1_100_0_S5_S3 0 1
 /begin AXIS_DESCR STD_AXIS iIaeSigna.n_mot_iae UMR_U_MIN_1_1_0_S5_S3 6 0 8160 DEPOSIT ABSOLUTE /end AXIS_DESCR
/end CHARACTERISTIC
/begin CHARACTERISTIC KL_F_RAWNDEINREG_K0 "Faktor auf Sollwertrampe" CURVE 0x19F658 ZF_kl_ui16_S5_S3 10 UMR___1_100_0_S5_S3 0 10
 /begin AXIS_DESCR STD_AXIS iK0sTempM.c_belag_k0_int UMR_GRADC__1_1_M40_S5_S3 4 -40 500 DEPOSIT ABSOLUTE /end AXIS_DESCR
/end CHARACTERISTIC
/begin CHARACTERISTIC KL_F_WNDOFDYN_K0 "Faktor auf Fahrdynamikoffset" CURVE 0x19F938 ZF_kl_ui8_S5_S3 1 UMR___1_100_0_S5_S3 0 1
 /begin AXIS_DESCR STD_AXIS zff_atsys._.iSignale._.obj.sig_c_getr UMR_GRADC__1_1_M40_S5_S3 2 -40 215 DEPOSIT ABSOLUTE /end AXIS_DESCR
/end CHARACTERISTIC
/begin CHARACTERISTIC KL_F_WNDSTD_CGETR_K0 "Temperatur Faktor auf Standardsollwert" CURVE 0x19FA40 ZF_kl_ui8_S5_S3 2 UMR___1_10_0_S5_S3 0 2
 /begin AXIS_DESCR STD_AXIS zff_atsys._.iSignale._.obj.sig_c_getr UMR_GRADC__1_1_M40_S5_S3 6 -40 215 DEPOSIT ABSOLUTE /end AXIS_DESCR
/end CHARACTERISTIC
/begin CHARACTERISTIC KL_F_WND_K0 "Faktor zur wnd - Reduktion" CURVE 0x19F680 ZF_kl_ui16_S5_S3 1 UMR___1_100_0_S5_S3 0 1
 /begin AXIS_DESCR STD_AXIS iK0sTempM.c_belag_k0_int UMR_GRADC__1_1_M40_S5_S3 2 -40 500 DEPOSIT ABSOLUTE /end AXIS_DESCR
/end CHARACTERISTIC
/begin CHARACTERISTIC KL_KORRANDKP_IEP "[U/min] KorrMotordrehzahlschw=f(dk)" CURVE 0x19E2B0 ZF_kl_si16_S5_S3 200 UMR_U_MIN_1_1_0_S5_S3 -100 100
 /begin AXIS_DESCR STD_AXIS iItfInput.dk_pedal UMR_PROZENT__20_51_0_S5_S3 6 0 100 DEPOSIT ABSOLUTE /end AXIS_DESCR
/end CHARACTERISTIC
/begin CHARACTERISTIC KL_KORRANT_IEP "KorrMotordrehzahlschw=f(t_an_iep)" CURVE 0x19E310 ZF_kl_fl32_S5_S3 10 UMR___1_1_0_S5_S3 0 10
 /begin AXIS_DESCR STD_AXIS iIepSchuz.t_an_iep UMR_SEC__1_1_0_S5_S3 12 0 99999 DEPOSIT ABSOLUTE FORMAT "%4.3" /end AXIS_DESCR
 FORMAT "%3.2" /end CHARACTERISTIC
/begin CHARACTERISTIC KL_MAXIREGZU_IAE "Momentengradient zum Schließen der IAE" CURVE 0x19CD70 ZF_kl_si16_S5_S3 2000 UMR_NM__1_1_0_S5_S3 -1000 1000
 /begin AXIS_DESCR STD_AXIS iIaeSigna.m_motistoe_iae UMR_NM__1_1_0_S5_S3 6 -200 1300 DEPOSIT ABSOLUTE /end AXIS_DESCR
/end CHARACTERISTIC
/begin CHARACTERISTIC KL_MAXOGNMOTANFAHR_SOLL_IAE "Begrenzung Offsetgradient KF_OGNMOTANFAHR_SOLL_x_IAE nach Stallanfahrt" CURVE 0x19CF44 ZF_kl_si16_S5_S3 10000 UMR_U_MINSEC_1_1_0_S5_S3 0 10000
 /begin AXIS_DESCR STD_AXIS NO_INPUT_QUANTITY UMR_PROZENT__20_51_0_S5_S3 6 0 100 DEPOSIT ABSOLUTE /end AXIS_DESCR
/end CHARACTERISTIC
/begin CHARACTERISTIC KL_MGK0ZU "[Nm/s] Momentengradient für die Schließrampe nach ZU mit Vorgabe k0_soll_gepr = GESCHLOSSEN" CURVE 0x1A0FEC ZF_kl_fl32_S5_S3 500 UMR_NM_SEC_1_1_0_S5_S3 0 500
 /begin AXIS_DESCR STD_AXIS NO_INPUT_QUANTITY UMR___1_1_0_S5_S3 6 -1000 1000 DEPOSIT ABSOLUTE FORMAT "%3.2" /end AXIS_DESCR
/end CHARACTERISTIC
/begin CHARACTERISTIC KL_MGNOTSCHLIESS_K0 "[Nm/s] Momentengradient für die Schließrampe nach ZU Vorgabe k0_soll_gepr = SCHLIESSRAMPE" CURVE 0x1A1020 ZF_kl_fl32_S5_S3 4096 UMR_NM_SEC_1_1_0_S5_S3 0 4096
 /begin AXIS_DESCR STD_AXIS iK0sKorSignale.m_vmist_sync_k0_fl UMR_NM__1_1_0_S5_S3 6 -1000 1000 DEPOSIT ABSOLUTE /end AXIS_DESCR
/end CHARACTERISTIC
/begin CHARACTERISTIC KL_MG_ZU_IAE "Momentengradient zum Schließen der IAE" CURVE 0x19CD54 ZF_kl_si16_S5_S3 5000 UMR_NM_SEC_1_1_0_S5_S3 0 5000
 /begin AXIS_DESCR STD_AXIS iIaeSigna.m_motistoe_iae UMR_NM__1_1_0_S5_S3 6 -200 1300 DEPOSIT ABSOLUTE /end AXIS_DESCR
/end CHARACTERISTIC
/begin CHARACTERISTIC KL_MIST_SCHLEPP_K0 "Kennlinie zur Vertrimmung des K0-Schleppmoments" CURVE 0x19F180 ZF_kl_fl32_S5_S3 1 UMR___1_1_0_S5_S3 0 1
 /begin AXIS_DESCR STD_AXIS NO_INPUT_QUANTITY UMR_U_MIN_1_1_0_S5_S3 4 0 8128 DEPOSIT ABSOLUTE /end AXIS_DESCR
 FORMAT "%3.2" /end CHARACTERISTIC
/begin CHARACTERISTIC KL_MMOTMAXXD_IAE "Momentenbegrenzung bei Anfahrdrehzahlabweichung (xd_iae) im Zustand Anfahren/Synchronisieren" CURVE 0x19D804 ZF_kl_si16_S5_S3 2000 UMR_NM__1_1_0_S5_S3 -1000 1000
 /begin AXIS_DESCR STD_AXIS NO_INPUT_QUANTITY UMR_U_MIN_1_1_0_S5_S3 6 -10000 10000 DEPOSIT ABSOLUTE /end AXIS_DESCR
/end CHARACTERISTIC
/begin CHARACTERISTIC KL_MOK0ZU "Momentenoffset für die Überanpressung der K0 im Zustand GESCHLOSSEN" CURVE 0x1A0FB8 ZF_kl_fl32_S5_S3 1000 UMR_NM__1_1_0_S5_S3 0 1000
 /begin AXIS_DESCR STD_AXIS NO_INPUT_QUANTITY UMR___1_1_0_S5_S3 6 -1200 1200 DEPOSIT ABSOLUTE FORMAT "%3.2" /end AXIS_DESCR
/end CHARACTERISTIC
/begin CHARACTERISTIC KL_MOTSTRESSPAIR_IAE "Bestimmung Motorstress aus Luftdruck" CURVE 0x19DA54 ZF_kl_si16_S5_S3 204.8 UMR_PROZENT__16_10_0_S5_S3 0 204.8
 /begin AXIS_DESCR STD_AXIS NO_INPUT_QUANTITY UMR_MBAR__1_1_0_S5_S3 3 0 2026 DEPOSIT ABSOLUTE /end AXIS_DESCR
/end CHARACTERISTIC
/begin CHARACTERISTIC KL_MOZUREGELN_K0 "Offset auf das Vorsteuermoment zum Schlupaufbau für den Übergang GESCHLOSSEN -> Regeln" CURVE 0x1A1054 ZF_kl_fl32_S5_S3 250 UMR_NM__1_1_0_S5_S3 -250 0
 /begin AXIS_DESCR STD_AXIS NO_INPUT_QUANTITY UMR___1_1_0_S5_S3 6 -1200 1200 DEPOSIT ABSOLUTE FORMAT "%3.2" /end AXIS_DESCR
/end CHARACTERISTIC
/begin CHARACTERISTIC KL_MO_ASRREGELT_ZU_IAE "Momentenoffset zur Einstellung der Überanpressung in ZU wenn elektronische Differenzialsperre aktiv ist" CURVE 0x19CD38 ZF_kl_si16_S5_S3 900 UMR_NM__1_1_0_S5_S3 0 900
 /begin AXIS_DESCR STD_AXIS iIaeSigna.m_motistoe_iae UMR_NM__1_1_0_S5_S3 6 -200 1300 DEPOSIT ABSOLUTE /end AXIS_DESCR
/end CHARACTERISTIC
/begin CHARACTERISTIC KL_MO_KORRMSCHALT_K0 "Faktor zum korrigieren von m_schalt_k0" CURVE 0x1A14D8 ZF_kl_fl32_S5_S3 200 UMR_NM__1_1_0_S5_S3 -100 100
 /begin AXIS_DESCR STD_AXIS iK0sVorst.f_korrmschalt_k0 UMR___1_1_0_S5_S3 7 -100 100 DEPOSIT ABSOLUTE FORMAT "%3.2" /end AXIS_DESCR
/end CHARACTERISTIC
/begin CHARACTERISTIC KL_MPT_PO_TORUSDYN_K0 "Temperaturabhängige Kennlinie für Filterzeitkonstante der Dynamische Torusdruckkompensation" CURVE 0x1A1184 ZF_kl_si16_S5_S3 1 UMR___1_100_0_S5_S3 0 1
 /begin AXIS_DESCR STD_AXIS zff_atsys._.iSignale._.obj.sig_c_getr UMR_GRADC__1_1_M40_S5_S3 4 -40 215 DEPOSIT ABSOLUTE /end AXIS_DESCR
/end CHARACTERISTIC
/begin CHARACTERISTIC KL_MSCHLEPPOFFEN_IAE "Schleppmoment der IAE im offenem Zustand" CURVE 0x19DD14 ZF_kl_si16_S5_S3 100 UMR_NM__1_1_0_S5_S3 0 100
 /begin AXIS_DESCR STD_AXIS NO_INPUT_QUANTITY UMR_GRADC__1_1_M40_S5_S3 4 -40 215 DEPOSIT ABSOLUTE /end AXIS_DESCR
/end CHARACTERISTIC
/begin CHARACTERISTIC KL_MSCHLEPP_CIAE_IAE "Offset auf IAE-Schleppmoment" CURVE 0x19D654 ZF_kl_ui16_S5_S3 255 UMR_NM__1_1_0_S5_S3 0 255
 /begin AXIS_DESCR STD_AXIS NO_INPUT_QUANTITY UMR_GRADC__1_1_M40_S5_S3 4 -40 215 DEPOSIT ABSOLUTE /end AXIS_DESCR
/end CHARACTERISTIC
/begin CHARACTERISTIC KL_MSMOTINIT_PT2_ECO_IAE "Motormomentenschwelle zur Initialisierung des Sollanfahrdrehzahlfilter" CURVE 0x19D8AC ZF_kl_si16_S5_S3 300 UMR_NM__1_1_0_S5_S3 -100 200
 /begin AXIS_DESCR STD_AXIS NO_INPUT_QUANTITY UMR_PROZENT__20_51_0_S5_S3 6 0 100 DEPOSIT ABSOLUTE /end AXIS_DESCR
/end CHARACTERISTIC
/begin CHARACTERISTIC KL_MSMOTINIT_PT2_IAE "Motormomentenschwelle zur Initialisierung des Sollanfahrdrehzahlfilter" CURVE 0x19D9B4 ZF_kl_si16_S5_S3 300 UMR_NM__1_1_0_S5_S3 -100 200
 /begin AXIS_DESCR STD_AXIS NO_INPUT_QUANTITY UMR_PROZENT__20_51_0_S5_S3 6 0 100 DEPOSIT ABSOLUTE /end AXIS_DESCR
/end CHARACTERISTIC
/begin CHARACTERISTIC KL_MSOLLMINANFAHR_ECO_IAE "Minimales Soll-Moment im Anfahren" CURVE 0x19D890 ZF_kl_si16_S5_S3 100 UMR_NM__1_1_0_S5_S3 -50 50
 /begin AXIS_DESCR STD_AXIS NO_INPUT_QUANTITY UMR_PROZENT__20_51_0_S5_S3 6 0 100 DEPOSIT ABSOLUTE /end AXIS_DESCR
/end CHARACTERISTIC
/begin CHARACTERISTIC KL_MSOLLMINANFAHR_IAE "Minimales Soll-Moment im Anfahren" CURVE 0x19D998 ZF_kl_si16_S5_S3 100 UMR_NM__1_1_0_S5_S3 -50 50
 /begin AXIS_DESCR STD_AXIS NO_INPUT_QUANTITY UMR_PROZENT__20_51_0_S5_S3 6 0 100 DEPOSIT ABSOLUTE /end AXIS_DESCR
/end CHARACTERISTIC
/begin CHARACTERISTIC KL_MS_MINREGD_K0 "Offset auf das Vorsteuermoment zum Schlupaufbau für den Übergang GESCHLOSSEN -> Regeln" CURVE 0x1A1404 ZF_kl_fl32_S5_S3 100 UMR_NM__1_1_0_S5_S3 0 100
 /begin AXIS_DESCR STD_AXIS iK0sKorSignale.n_vm_sync_k0_fl UMR_U_MIN_1_1_0_S5_S3 5 0 10000 DEPOSIT ABSOLUTE /end AXIS_DESCR
/end CHARACTERISTIC
/begin CHARACTERISTIC KL_MS_MINREGPN_K0 "Offset auf das Vorsteuermoment zum Schlupaufbau für den Übergang GESCHLOSSEN -> Regeln" CURVE 0x1A1430 ZF_kl_fl32_S5_S3 100 UMR_NM__1_1_0_S5_S3 0 100
 /begin AXIS_DESCR STD_AXIS iK0sKorSignale.n_vm_sync_k0_fl UMR_U_MIN_1_1_0_S5_S3 5 0 10000 DEPOSIT ABSOLUTE /end AXIS_DESCR
/end CHARACTERISTIC
/begin CHARACTERISTIC KL_M_ANGELEGT_ND_IAE "Momentenvorgabe in ANGELEGT in Abh. von nd_nmot_iae" CURVE 0x19C898 ZF_kl_si16_S5_S3 100 UMR_NM__1_1_0_S5_S3 -50 50
 /begin AXIS_DESCR STD_AXIS NO_INPUT_QUANTITY UMR_NM__1_1_0_S5_S3 6 -8160 8160 DEPOSIT ABSOLUTE /end AXIS_DESCR
/end CHARACTERISTIC
/begin CHARACTERISTIC KL_M_KRIECHMAX_CGETR_IAE "Max. Kriechmoment, abhängig von c_getr" CURVE 0x19C9A8 ZF_kl_si16_S5_S3 250 UMR_NM__1_1_0_S5_S3 -50 200
 /begin AXIS_DESCR STD_AXIS NO_INPUT_QUANTITY UMR_GRADC__1_1_M40_S5_S3 4 -40 500 DEPOSIT ABSOLUTE /end AXIS_DESCR
/end CHARACTERISTIC
/begin CHARACTERISTIC KL_M_KRIECHMAX_MOTSTRESS_IAE "Max. Kriechmoment, abhängig vom motorstress_iae" CURVE 0x19C994 ZF_kl_si16_S5_S3 250 UMR_NM__1_1_0_S5_S3 -50 200
 /begin AXIS_DESCR STD_AXIS iIaeSigna.mot_stress_iae UMR_PROZENT__16_10_0_S5_S3 4 0 204.8 DEPOSIT ABSOLUTE /end AXIS_DESCR
/end CHARACTERISTIC
/begin CHARACTERISTIC KL_M_STELLMAX_IAE "max. Momentenbegrenzung IAE im aktiven schlupfenden Zustand" CURVE 0x19D720 ZF_kl_si16_S5_S3 2550 UMR_NM__1_1_0_S5_S3 0 2550
 /begin AXIS_DESCR STD_AXIS NO_INPUT_QUANTITY UMR_GRADC__1_1_M40_S5_S3 4 -40 500 DEPOSIT ABSOLUTE /end AXIS_DESCR
/end CHARACTERISTIC
/begin CHARACTERISTIC KL_NDSK0DEFEKTREG1_K0 "Schwelle für max. zulässige Regelabweichung xd" CURVE 0x19EC78 ZF_kl_si16_S5_S3 500 UMR_U_MIN_1_1_0_S5_S3 0 500
 /begin AXIS_DESCR STD_AXIS iK0sKorSignale.m_vmist_sync_k0 UMR_NM__1_1_0_S5_S3 2 -200 1300 DEPOSIT ABSOLUTE /end AXIS_DESCR
/end CHARACTERISTIC
/begin CHARACTERISTIC KL_NDSK0DEFEKTREG2_K0 "Differenzdrehzahlschwelle 2 zur Überprüfung eines mechanischen Defekts der K0 im Regelbetrieb" CURVE 0x19EC84 ZF_kl_si16_S5_S3 500 UMR_U_MIN_1_1_0_S5_S3 0 500
 /begin AXIS_DESCR STD_AXIS iK0sKorSignale.m_vmist_sync_k0 UMR_NM__1_1_0_S5_S3 2 -200 1300 DEPOSIT ABSOLUTE /end AXIS_DESCR
/end CHARACTERISTIC
/begin CHARACTERISTIC KL_NGMOT_IEP "Korrektur KL zur Bestimmung der kor. Motordrehzahlschwelle zum Einschal. der Iep" CURVE 0x19E2CC ZF_kl_si16_S5_S3 400 UMR_U_MIN_1_1_0_S5_S3 -200 200
 /begin AXIS_DESCR STD_AXIS NO_INPUT_QUANTITY UMR_U_MINSEC_1_1_0_S5_S3 10 -10000 10000 DEPOSIT ABSOLUTE /end AXIS_DESCR
/end CHARACTERISTIC
/begin CHARACTERISTIC KL_NMOTANFAHRMMOTMAX_IAE "Max. Anfahrdrehzahlbegrenzung bei IAE-Motormomentenbegrenzung" CURVE 0x19D00C ZF_kl_si16_S5_S3 5000 UMR_U_MIN_1_1_0_S5_S3 0 5000
 /begin AXIS_DESCR STD_AXIS NO_INPUT_QUANTITY UMR_NM__1_1_0_S5_S3 6 0 1500 DEPOSIT ABSOLUTE /end AXIS_DESCR
/end CHARACTERISTIC
/begin CHARACTERISTIC KL_NSMOTINIT_PT2_ECO_IAE "Motordrehzahlschwelle zur Initialisierung des Sollanfahrdrehzahlfilter" CURVE 0x19D8C8 ZF_kl_si16_S5_S3 300 UMR_U_MIN_1_1_0_S5_S3 -100 200
 /begin AXIS_DESCR STD_AXIS NO_INPUT_QUANTITY UMR_PROZENT__20_51_0_S5_S3 6 0 100 DEPOSIT ABSOLUTE /end AXIS_DESCR
/end CHARACTERISTIC
/begin CHARACTERISTIC KL_NSMOTINIT_PT2_IAE "Motordrehzahlschwelle zur Initialisierung des Sollanfahrdrehzahlfilter" CURVE 0x19D9D0 ZF_kl_si16_S5_S3 300 UMR_U_MIN_1_1_0_S5_S3 -100 200
 /begin AXIS_DESCR STD_AXIS NO_INPUT_QUANTITY UMR_PROZENT__20_51_0_S5_S3 6 0 100 DEPOSIT ABSOLUTE /end AXIS_DESCR
/end CHARACTERISTIC
/begin CHARACTERISTIC KL_NSMOT_PSS_IEP "Kennline zur Vorgabe bis zu welcher Getriebeeingangsdrehzahl die IEP den Systemdruck stützen soll" CURVE 0x19E55C ZF_kl_ui16_S5_S3 1600 UMR_U_MIN_1_1_0_S5_S3 0 1600
 /begin AXIS_DESCR STD_AXIS zff_atsys._.iSignale._.obj.sig_c_getr UMR_GRADC__1_1_M40_S5_S3 6 -40 215 DEPOSIT ABSOLUTE /end AXIS_DESCR
/end CHARACTERISTIC
/begin CHARACTERISTIC KL_NS_ASRREGELT_SYNC_IAE "Drehzahlschwelle zur Schliess- und Öffnendrehzahlberechnung bei aktiver elektr. Differenzialsperre" CURVE 0x19DC24 ZF_kl_si16_S5_S3 6000 UMR_U_MIN_1_1_0_S5_S3 -1000 5000
 /begin AXIS_DESCR STD_AXIS iIaeSigna.n_motsoll_ll_iae UMR_U_MIN_1_1_0_S5_S3 4 0 8000 DEPOSIT ABSOLUTE /end AXIS_DESCR
/end CHARACTERISTIC
/begin CHARACTERISTIC KL_NS_MOT_PUMPE_IEP "Drehzahlschwelle zur Einschaltverhinderung bei zu hohem Systemdruck" CURVE 0x19E540 ZF_kl_ui16_S5_S3 500 UMR_U_MIN_1_1_0_S5_S3 0 500
 /begin AXIS_DESCR STD_AXIS zff_atsys._.iSignale._.obj.sig_c_getr UMR_GRADC__1_1_M40_S5_S3 6 -40 215 DEPOSIT ABSOLUTE /end AXIS_DESCR
/end CHARACTERISTIC
/begin CHARACTERISTIC KL_ONMOTANFAHR_IAE "Faktor zur Korrektur der Anfahrdrehzahl bei LL-Drehzahlanhebung" CURVE 0x19CF74 ZF_kl_si16_S5_S3 5000 UMR_U_MIN_1_1_0_S5_S3 0 5000
 /begin AXIS_DESCR STD_AXIS iIaeSigna.n_getrein_iae UMR_U_MIN_1_1_0_S5_S3 4 0 8000 DEPOSIT ABSOLUTE /end AXIS_DESCR
/end CHARACTERISTIC
/begin CHARACTERISTIC KL_ONS_SYNC_IAE "Offsetdrehzahl auf Öffnen-/Schliessdrehzahlschwelle" CURVE 0x19DA80 ZF_kl_si16_S5_S3 2000 UMR_U_MIN_1_1_0_S5_S3 -1000 1000
 /begin AXIS_DESCR STD_AXIS iIaeSigna.m_motist_iae UMR_NM__1_1_0_S5_S3 6 -1000 1000 DEPOSIT ABSOLUTE /end AXIS_DESCR
/end CHARACTERISTIC
/begin CHARACTERISTIC KL_PO_TORUSDYN_CGETR_K0 "Temperaturabhängige Kennlinie für Dynamische Torusdruckkompensation" CURVE 0x1A1170 ZF_kl_si16_S5_S3 4 UMR_BAR__1_1000_0_S5_S3 -2 2
 /begin AXIS_DESCR STD_AXIS zff_atsys._.iSignale._.obj.sig_c_getr UMR_GRADC__1_1_M40_S5_S3 4 -40 215 DEPOSIT ABSOLUTE /end AXIS_DESCR
/end CHARACTERISTIC
/begin CHARACTERISTIC KL_P_K0STELLMAX "[bar], Begrenzung auf maximalen Stelldruck" CURVE 0x1A08DC ZF_kl_fl32_S5_S3 20 UMR_BAR__1_1_0_S5_S3 0 20
 /begin AXIS_DESCR STD_AXIS iK0sKorSignale.n_vm_sync_k0_fl UMR_U_MIN_1_1_0_S5_S3 4 0 10000 DEPOSIT ABSOLUTE /end AXIS_DESCR
 FORMAT "%4.3" /end CHARACTERISTIC
/begin CHARACTERISTIC KL_START_UEBTEMPPULS_IAE "Faktor zur Verzögerung der Pulsausgabe" CURVE 0x19CE3C ZF_kl_ui16_S5_S3 1 UMR___1_100_0_S5_S3 0 1
 /begin AXIS_DESCR STD_AXIS NO_INPUT_QUANTITY UMR_SEC__1_100_0_S5_S3 4 0 300 DEPOSIT ABSOLUTE /end AXIS_DESCR
/end CHARACTERISTIC
/begin CHARACTERISTIC KL_TYP_UEF_1_IAE "Verlauf der Überführungsfunktion Typ 1" CURVE 0x19D220 ZF_kl_si16_S5_S3 100 UMR_PROZENT__1_100_0_S5_S3 0 100
 /begin AXIS_DESCR STD_AXIS NO_INPUT_QUANTITY UMR_PROZENT__1_100_0_S5_S3 10 0 100 DEPOSIT ABSOLUTE /end AXIS_DESCR
/end CHARACTERISTIC
/begin CHARACTERISTIC KL_TYP_UEF_2_IAE "Verlauf der Überführungsfunktion Typ 2" CURVE 0x19D24C ZF_kl_si16_S5_S3 100 UMR_PROZENT__1_100_0_S5_S3 0 100
 /begin AXIS_DESCR STD_AXIS NO_INPUT_QUANTITY UMR_PROZENT__1_100_0_S5_S3 10 0 100 DEPOSIT ABSOLUTE /end AXIS_DESCR
/end CHARACTERISTIC
/begin CHARACTERISTIC KL_TYP_UEF_3_IAE "Verlauf der Überführungsfunktion Typ 3" CURVE 0x19D278 ZF_kl_si16_S5_S3 100 UMR_PROZENT__1_100_0_S5_S3 0 100
 /begin AXIS_DESCR STD_AXIS NO_INPUT_QUANTITY UMR_PROZENT__1_100_0_S5_S3 10 0 100 DEPOSIT ABSOLUTE /end AXIS_DESCR
/end CHARACTERISTIC
/begin CHARACTERISTIC KL_TYP_UEF_4_IAE "Verlauf der Überführungsfunktion Typ 4" CURVE 0x19D2A4 ZF_kl_si16_S5_S3 100 UMR_PROZENT__1_100_0_S5_S3 0 100
 /begin AXIS_DESCR STD_AXIS NO_INPUT_QUANTITY UMR_PROZENT__1_100_0_S5_S3 10 0 100 DEPOSIT ABSOLUTE /end AXIS_DESCR
/end CHARACTERISTIC
/begin CHARACTERISTIC KL_T_PT2_NEIGUNG_IAE "Filterzeitkonstante für Filterung des Abtriebdrehzahlgradienten zur Neigungsberechnung" CURVE 0x19DD28 ZF_kl_si16_S5_S3 9970 UMR_MSEC__1_1_0_S5_S3 30 10000
 /begin AXIS_DESCR STD_AXIS NO_INPUT_QUANTITY UMR_U_MINMSEC_1_1_0_S5_S3 4 -30000 30000 DEPOSIT ABSOLUTE /end AXIS_DESCR
/end CHARACTERISTIC
/begin CHARACTERISTIC KL_T_PT2_NMOTANFENTKOPPL_IAE "Filterzeitkonstante PT2-Filter für Sollanfahrdrehzahl E-Anfahren-entkoppelt" CURVE 0x19D03C ZF_kl_si16_S5_S3 4000 UMR_MSEC__1_1_0_S5_S3 0 4000
 /begin AXIS_DESCR STD_AXIS iIaeSigna.ng_getrein_iae UMR_U_MINSEC_1_1_0_S5_S3 4 -10000 10000 DEPOSIT ABSOLUTE /end AXIS_DESCR
/end CHARACTERISTIC
/begin CHARACTERISTIC KL_T_RAWNDEINREG_K0 "Filterzeitkonstante für Standardsollwertfilter beim Einregeln" CURVE 0x19F66C ZF_kl_ui16_S5_S3 3990 UMR_MSEC__1_1_0_S5_S3 10 4000
 /begin AXIS_DESCR STD_AXIS iK0sKorSW.iStdSW.f_einreg UMR_PROZENT__20_51_0_S5_S3 4 0 100 DEPOSIT ABSOLUTE /end AXIS_DESCR
/end CHARACTERISTIC
/begin CHARACTERISTIC KL_T_UEF_I_STUETZ_IAE "Dauer der Überführungsfunktion für Umschaltung des Momentenstützfaktors bei Schaltungen" CURVE 0x19D6CC ZF_kl_si16_S5_S3 5000 UMR_MSEC__10_1_0_S5_S3 0 5000
 /begin AXIS_DESCR STD_AXIS iIaeSigna.n_ab_iae UMR_U_MIN_1_1_0_S5_S3 6 0 10000 DEPOSIT ABSOLUTE /end AXIS_DESCR
/end CHARACTERISTIC
/begin CHARACTERISTIC KL_T_UEF_KRIECH_IAE "Dauer der Überführungsfunktion des Kriechsollwerts" CURVE 0x19D34C ZF_kl_si16_S5_S3 5000 UMR_MSEC__10_1_0_S5_S3 0 5000
 /begin AXIS_DESCR STD_AXIS NO_INPUT_QUANTITY UMR_U_MIN_1_1_0_S5_S3 4 -10000 10000 DEPOSIT ABSOLUTE /end AXIS_DESCR
/end CHARACTERISTIC
/begin CHARACTERISTIC KL_T_UEF_MSOLLANFAHR_IAE "Dauer der Überführungsfunktion bei Einstieg in Anfahren" CURVE 0x19D374 ZF_kl_si16_S5_S3 5000 UMR_MSEC__10_1_0_S5_S3 0 5000
 /begin AXIS_DESCR STD_AXIS NO_INPUT_QUANTITY UMR_PROZENT__20_51_0_S5_S3 6 0 100 DEPOSIT ABSOLUTE /end AXIS_DESCR
/end CHARACTERISTIC
/begin CHARACTERISTIC KL_T_UEF_MSOLLEHANF_IAE "Dauer der Überführungsfunktion beim Wechsel aus E-Anfahren/E-Anfahren_entkoppl nach H-Anfahren" CURVE 0x19D360 ZF_kl_si16_S5_S3 5000 UMR_MSEC__10_1_0_S5_S3 0 5000
 /begin AXIS_DESCR STD_AXIS iIaeSigna.ng_getrein_iae UMR_U_MINSEC_1_1_0_S5_S3 4 -30000 30000 DEPOSIT ABSOLUTE /end AXIS_DESCR
/end CHARACTERISTIC
/begin CHARACTERISTIC KL_T_UEF_M_AUF_GA_IAE "Dauer der Überführungsfunktion zum Abbau des IAE-Aufnahmemoments beim Gangauslegen" CURVE 0x19D5A8 ZF_kl_si16_S5_S3 3000 UMR_MSEC__10_1_0_S5_S3 0 3000
 /begin AXIS_DESCR STD_AXIS NO_INPUT_QUANTITY UMR_GRADC__1_1_M40_S5_S3 4 -40 215 DEPOSIT ABSOLUTE /end AXIS_DESCR
/end CHARACTERISTIC
/begin CHARACTERISTIC KL_T_UEF_M_AUF_GE_IAE "Dauer der Überführungsfunktion zum Abbau des IAE-Aufnahmemoments beim Gangeinlegen" CURVE 0x19D5BC ZF_kl_si16_S5_S3 3000 UMR_MSEC__10_1_0_S5_S3 0 3000
 /begin AXIS_DESCR STD_AXIS NO_INPUT_QUANTITY UMR_GRADC__1_1_M40_S5_S3 4 -40 215 DEPOSIT ABSOLUTE /end AXIS_DESCR
/end CHARACTERISTIC
/begin CHARACTERISTIC KL_T_UEF_M_KRIECH_ANGELEGT_IAE "Dauer der Überführungsfunktion beim Übergang von Kriechen nach Stillstand für m_soll_iae" CURVE 0x19D2D0 ZF_kl_si16_S5_S3 5000 UMR_MSEC__10_1_0_S5_S3 0 5000
 /begin AXIS_DESCR STD_AXIS iIaeSigna.ng_getrein_iae UMR_U_MINSEC_1_1_0_S5_S3 4 -10000 10000 DEPOSIT ABSOLUTE /end AXIS_DESCR
/end CHARACTERISTIC
/begin CHARACTERISTIC KL_T_WNDOSCHALTAB_K0_HSS "Filterzeitkonstante zum Abfiltern des Schaltoffsets bei HSS" CURVE 0x19FAB0 ZF_kl_si16_S5_S3 3970 UMR_MSEC__1_1_0_S5_S3 30 4000
 /begin AXIS_DESCR STD_AXIS NO_INPUT_QUANTITY UMR___1_1_0_S5_S3 4 -16256 16256 DEPOSIT ABSOLUTE /end AXIS_DESCR
/end CHARACTERISTIC
/begin CHARACTERISTIC KL_T_WNDOSCHALTAB_K0_HSS_SP "Filterzeitkonstante zum Abfiltern des Schaltoffsets bei HSS" CURVE 0x19FB54 ZF_kl_si16_S5_S3 3970 UMR_MSEC__1_1_0_S5_S3 30 4000
 /begin AXIS_DESCR STD_AXIS NO_INPUT_QUANTITY UMR___1_1_0_S5_S3 4 -16256 16256 DEPOSIT ABSOLUTE /end AXIS_DESCR
/end CHARACTERISTIC
/begin CHARACTERISTIC KL_T_WNDOSCHALTAB_K0_RSZ "Filterzeitkonstante zum Abfiltern des Schaltoffsets bei RSZ" CURVE 0x19FA9C ZF_kl_si16_S5_S3 3970 UMR_MSEC__1_1_0_S5_S3 30 4000
 /begin AXIS_DESCR STD_AXIS NO_INPUT_QUANTITY UMR___1_1_0_S5_S3 4 -16256 16256 DEPOSIT ABSOLUTE /end AXIS_DESCR
/end CHARACTERISTIC
/begin CHARACTERISTIC KL_T_WNDOSCHALTAB_K0_RSZ_SP "Filterzeitkonstante zum Abfiltern des Schaltoffsets bei RSZ" CURVE 0x19FB40 ZF_kl_si16_S5_S3 3970 UMR_MSEC__1_1_0_S5_S3 30 4000
 /begin AXIS_DESCR STD_AXIS NO_INPUT_QUANTITY UMR___1_1_0_S5_S3 4 -16256 16256 DEPOSIT ABSOLUTE /end AXIS_DESCR
/end CHARACTERISTIC
/begin CHARACTERISTIC KL_VZ_MMOTGEMOE_IAE "Verzögerungszeit des gemittelten Motormoment ohne Eingriffe" CURVE 0x19DC74 ZF_kl_si16_S5_S3 90 UMR_MSEC__1_1_0_S5_S3 0 90
 /begin AXIS_DESCR STD_AXIS iIaeSigna.n_mot_iae UMR_U_MIN_1_1_0_S5_S3 4 0 8160 DEPOSIT ABSOLUTE /end AXIS_DESCR
/end CHARACTERISTIC
/begin CHARACTERISTIC KL_VZ_MMOTISTOE_IAE "Verzögerungszeit Motoristmoment ohne Eingriffe" CURVE 0x19DC4C ZF_kl_si16_S5_S3 90 UMR_MSEC__1_1_0_S5_S3 0 90
 /begin AXIS_DESCR STD_AXIS iIaeSigna.n_mot_iae UMR_U_MIN_1_1_0_S5_S3 4 0 8160 DEPOSIT ABSOLUTE /end AXIS_DESCR
/end CHARACTERISTIC
/begin CHARACTERISTIC KL_VZ_MMOTIST_IAE "Verzögerungszeit Motoristmoment incl.aller Eingriffe" CURVE 0x19DC38 ZF_kl_si16_S5_S3 90 UMR_MSEC__1_1_0_S5_S3 0 90
 /begin AXIS_DESCR STD_AXIS iIaeSigna.n_mot_iae UMR_U_MIN_1_1_0_S5_S3 4 0 8160 DEPOSIT ABSOLUTE /end AXIS_DESCR
/end CHARACTERISTIC
/begin CHARACTERISTIC KL_VZ_MMOTSOLLOE_IAE "Verzögerungszeit Motorsollmoment ohne Eingriffe" CURVE 0x19DC60 ZF_kl_si16_S5_S3 90 UMR_MSEC__1_1_0_S5_S3 0 90
 /begin AXIS_DESCR STD_AXIS iIaeSigna.n_mot_iae UMR_U_MIN_1_1_0_S5_S3 4 0 8160 DEPOSIT ABSOLUTE /end AXIS_DESCR
/end CHARACTERISTIC
/begin CHARACTERISTIC KL_WAERMEKAP_LRAUM_K0 "Wärmekapazität des die Reiblamellen der K0 umgebenden Ölvolumens" CURVE 0x19F328 ZF_kl_fl32_S5_S3 9999.9 UMR_J_K_1_1_0_S5_S3 0.1 10000
 /begin AXIS_DESCR STD_AXIS zff_atsys._.iSignale._.obj.sig_c_getr_fl32 UMR_GRADC__1_1_0_S5_S3 6 -40 215 DEPOSIT ABSOLUTE /end AXIS_DESCR
 FORMAT "%2.1" /end CHARACTERISTIC
/begin CHARACTERISTIC KL_WNDOGSCHALT_K0_HSZ "Initialisierungswert für den Sollwertgradient im Synchronpunkt neuer Gang bei HSZ" CURVE 0x19FA88 ZF_kl_si16_S5_S3 4000 UMR_U_MINSEC_1_1_0_S5_S3 -2000 2000
 /begin AXIS_DESCR STD_AXIS iK0sKorSW.iSOShi.ngt_delta UMR_U_MINSEC_1_1_0_S5_S3 4 -32767 32767 DEPOSIT ABSOLUTE /end AXIS_DESCR
/end CHARACTERISTIC
/begin CHARACTERISTIC KL_WNDOGSCHALT_K0_HSZ_SP "Initialisierungswert für den Sollwertgradient im Synchronpunkt neuer Gang bei HSZ" CURVE 0x19FB2C ZF_kl_si16_S5_S3 4000 UMR_U_MINSEC_1_1_0_S5_S3 -2000 2000
 /begin AXIS_DESCR STD_AXIS iK0sKorSW.iSOShi.ngt_delta UMR_U_MINSEC_1_1_0_S5_S3 4 -32767 32767 DEPOSIT ABSOLUTE /end AXIS_DESCR
/end CHARACTERISTIC
/begin CHARACTERISTIC K_TSTATUS_START_AUSLP3_IEP "Faktor, zur Verlängerung des Status von AUS nach LP3" VALUE 0x19E75C ZF_kw_fl32_S5_S3 29.9 UMR___1_1_0_S5_S3 0.1 30 FORMAT "%3.2" /end CHARACTERISTIC
/begin CHARACTERISTIC MDT_DKGPEDAL_K0 "Filterkonstante für DT1-Filter für Gradient von dk_pedal" VALUE 0x1D77F1 ZF_kw_ui8_S5_S3 0.99 UMR___1_100_0_S5_S3 0.01 1 /end CHARACTERISTIC
/begin CHARACTERISTIC MDT_DKIG_IAE "Filterfaktor für DT-1 Filter des Fahrpedal" VALUE 0x1D77C4 ZF_kw_ui8_S5_S3 0.99 UMR___1_100_0_S5_S3 0.01 1 /end CHARACTERISTIC
/begin CHARACTERISTIC MDT_MG_MOTIST_IAE "Filterzeitkonstante für DT1-Filter für Motoristmoment mit Getriebeeingriff" VALUE 0x1D77C5 ZF_kw_ui8_S5_S3 0.99 UMR___1_100_0_S5_S3 0.01 1 /end CHARACTERISTIC
/begin CHARACTERISTIC MDT_NDG_IAE "Filterzeitkonstante für Gradinetenbildung fuer Differenzdrehzahl am Anfahrelement" VALUE 0x1D77B8 ZF_kw_ui8_S5_S3 0.99 UMR___1_100_0_S5_S3 0.01 1 /end CHARACTERISTIC
/begin CHARACTERISTIC MDT_NGAB_K0 "Filterkonstante für DT1-Filter für Gradient der Abtriebsdrehzahl" VALUE 0x1D77F2 ZF_kw_ui8_S5_S3 0.99 UMR___1_100_0_S5_S3 0.01 1 /end CHARACTERISTIC
/begin CHARACTERISTIC MDT_NG_AB_IAE "Filterfaktor für DT-1 Filter für Abtriebsdrehzahl" VALUE 0x1D77C6 ZF_kw_ui8_S5_S3 0.99 UMR___1_100_0_S5_S3 0.01 1 /end CHARACTERISTIC
/begin CHARACTERISTIC MDT_NG_EM_K0 "Koeffizient für DT1-Filter für Em Drehzahlgradient" VALUE 0x1D7817 ZF_kw_ui8_S5_S3 0.99 UMR___1_100_0_S5_S3 0.01 1 /end CHARACTERISTIC
/begin CHARACTERISTIC MDT_NG_GETREIN_IAE "Filterfaktor für DT-1 Filter für Getriebeeingangsdrehzahl" VALUE 0x1D77C7 ZF_kw_ui8_S5_S3 0.99 UMR___1_100_0_S5_S3 0.01 1 /end CHARACTERISTIC
/begin CHARACTERISTIC MDT_NG_MOT_IAE "Filterfaktor für DT-1 Filter für Motordrehzahl" VALUE 0x1D77C8 ZF_kw_ui8_S5_S3 0.99 UMR___1_100_0_S5_S3 0.01 1 /end CHARACTERISTIC
/begin CHARACTERISTIC MDT_PG_BREMS_IAE "Filterfaktor für DT-1 Filter für Bremsdruck" VALUE 0x1D77C9 ZF_kw_ui8_S5_S3 0.99 UMR___1_100_0_S5_S3 0.01 1 /end CHARACTERISTIC
/begin CHARACTERISTIC MGS_FDYN_K0 "minimaler Motormomentengradient zur Aktivierung der Fahrdynamik" VALUE 0x1D840C ZF_kw_ui16_S5_S3 1000 UMR_NM_SEC_1_1_0_S5_S3 0 1000 /end CHARACTERISTIC
/begin CHARACTERISTIC MG_ANKRIECHEN_IAE "Gradient der Kriechmomentenoffsetrampe" VALUE 0x1D837A ZF_kw_si16_S5_S3 10000 UMR_NM_SEC_1_1_0_S5_S3 0 10000 /end CHARACTERISTIC
/begin CHARACTERISTIC MG_ANKRIECHNEG_IAE "Negativer Gradient zum Rausrampen des Kriechmomentenoffsetrampe" VALUE 0x1D837C ZF_kw_si16_S5_S3 10000 UMR_NM_SEC_1_1_0_S5_S3 -10000 0 /end CHARACTERISTIC
/begin CHARACTERISTIC MG_MOTAUFREGELSTALL_IAE "Momentengradient zum Abbau des reduzierenden Eingriffs nach Stallspeed" VALUE 0x1D8394 ZF_kw_si16_S5_S3 10000 UMR_NM_SEC_1_1_0_S5_S3 0 10000 /end CHARACTERISTIC
/begin CHARACTERISTIC MG_M_MOTMAX_IAE "Momentengradient zum Abbau des reduzierenden Eingriffs" VALUE 0x1D8390 ZF_kw_si16_S5_S3 10000 UMR_NM_SEC_1_1_0_S5_S3 0 10000 /end CHARACTERISTIC
/begin CHARACTERISTIC MMOT_SCHWELLE_LP2_IEP "Momentenschwelle, ab der der LP2 der el. Zusatzpumpe notwendig ist" VALUE 0x1D83C0 ZF_kw_ui16_S5_S3 200 UMR_NM__1_1_0_S5_S3 0 200 /end CHARACTERISTIC
/begin CHARACTERISTIC MMOT_SCHWELLE_LP3_IEP "Momentenschwelle, ab der der LP3 der el. Zusatzpumpe notwendig ist" VALUE 0x1D83C2 ZF_kw_ui16_S5_S3 600 UMR_NM__1_1_0_S5_S3 0 600 /end CHARACTERISTIC
/begin CHARACTERISTIC MO_EMIST_K0 "Momentenoffset zur Nullpunktanpassung E-Maschinen Istmoment" VALUE 0x1D77FF ZF_kw_si8_S5_S3 200 UMR___1_1_0_S5_S3 -100 100 /end CHARACTERISTIC
/begin CHARACTERISTIC MO_IAEAUF_IAE "Offset auf maximales IAE-Aufnahmemoment" VALUE 0x1D838E ZF_kw_si16_S5_S3 10 UMR_NM__1_1_0_S5_S3 0 10 /end CHARACTERISTIC
/begin CHARACTERISTIC MO_MEMMAXDYN_K0 "Offset" VALUE 0x1D7802 ZF_kw_si8_S5_S3 200 UMR_NM__1_1_0_S5_S3 -100 100 /end CHARACTERISTIC
/begin CHARACTERISTIC MO_MEMMINDYN_K0 "Offset" VALUE 0x1D7803 ZF_kw_si8_S5_S3 200 UMR_NM__1_1_0_S5_S3 -100 100 /end CHARACTERISTIC
/begin CHARACTERISTIC MO_MMOTIST_K0 "Offset" VALUE 0x1D7801 ZF_kw_si8_S5_S3 200 UMR_NM__1_1_0_S5_S3 -100 100 /end CHARACTERISTIC
/begin CHARACTERISTIC MO_MOTISTOE_IAE "Momentenoffset zur Nullpunktanpassung Motoristmoment ohne Eingriff" VALUE 0x1D77CB ZF_kw_si8_S5_S3 255 UMR_NM__1_1_0_S5_S3 -128 127 /end CHARACTERISTIC
/begin CHARACTERISTIC MO_MOTIST_IAE "Momentenoffset zur Nullpunktanpassung Motoristmoment" VALUE 0x1D77CA ZF_kw_si8_S5_S3 255 UMR_NM__1_1_0_S5_S3 -128 127 /end CHARACTERISTIC
/begin CHARACTERISTIC MO_MOTSOLLOE_IAE "Momentenoffset zur Nullpunktanpassung Motorsollmoment ohne Eingriff" VALUE 0x1D8398 ZF_kw_si16_S5_S3 200 UMR_NM__1_1_0_S5_S3 -100 100 /end CHARACTERISTIC
/begin CHARACTERISTIC MO_VMIST_K0 "Momentenoffset zur Nullpunktanpassung Verbrennungsmotor Istmoment" VALUE 0x1D77FE ZF_kw_si8_S5_S3 200 UMR___1_1_0_S5_S3 -100 100 /end CHARACTERISTIC
/begin CHARACTERISTIC MO_VMSOLL_K0 "Momentenoffset zur Nullpunktanpassung Verbrennungsmotorsollmoment ohne Getriebeeingriff" VALUE 0x1D7800 ZF_kw_si8_S5_S3 200 UMR___1_1_0_S5_S3 -100 100 /end CHARACTERISTIC
/begin CHARACTERISTIC MPT_AX_REF_DIAGIAE "PT1 Filter zur Neigungsermittlung aus der Beschleunigung" VALUE 0x1D77C3 ZF_kw_ui8_S5_S3 0.99 UMR___1_100_0_S5_S3 0.01 1 /end CHARACTERISTIC
/begin CHARACTERISTIC MPT_DKI_IAE "Filterfaktor für PT-1 Filter des Fahrpedal" VALUE 0x1D77C2 ZF_kw_ui8_S5_S3 0.99 UMR___1_100_0_S5_S3 0.01 1 /end CHARACTERISTIC
/begin CHARACTERISTIC MPT_DSFA_K0 "Filterzeitkonstante des PT1-Filters für Übergang von DRUCKSTELLUNG nach ANGELEGT" VALUE 0x1D782C ZF_kw_ui8_S5_S3 0.99 UMR___1_100_0_S5_S3 0.01 1 /end CHARACTERISTIC
/begin CHARACTERISTIC MPT_GSDS_K0 "Filterzeitkonstante des PT1-Filters für Übergang von GESCHLOSSEN nach DRUCKSTELLUNG" VALUE 0x1D782A ZF_kw_ui8_S5_S3 0.99 UMR___1_100_0_S5_S3 0.01 1 /end CHARACTERISTIC
/begin CHARACTERISTIC MPT_GSFA_K0 "Filterzeitkonstante des PT1-Filters für Übergang von GESCHLOSSEN nach ANGELEGT" VALUE 0x1D782B ZF_kw_ui8_S5_S3 0.99 UMR___1_100_0_S5_S3 0.01 1 /end CHARACTERISTIC
/begin CHARACTERISTIC MPT_HYSABREG_K0 "Filterzeitkonstante des PT1-Filters für Abbau von p_hys_k0" VALUE 0x1D782F ZF_kw_ui8_S5_S3 0.99 UMR___1_100_0_S5_S3 0.01 1 /end CHARACTERISTIC
/begin CHARACTERISTIC MPT_HYSAB_K0 "Filterzeitkonstante des PT1-Filters für Abbau von p_hys_k0" VALUE 0x1D782D ZF_kw_ui8_S5_S3 0.99 UMR___1_100_0_S5_S3 0.01 1 /end CHARACTERISTIC
/begin CHARACTERISTIC MPT_HYSAUF_K0 "Filterzeitkonstante des PT1-Filters für Aufbau von p_hys_k0" VALUE 0x1D782E ZF_kw_ui8_S5_S3 0.99 UMR___1_100_0_S5_S3 0.01 1 /end CHARACTERISTIC
/begin CHARACTERISTIC MPT_I_GETRIEBE_VIRT_K0 "Filterzeitkonstante für PT1-Filter zur Berechnung von i_getriebe_virt_k0_roh" VALUE 0x19E944 ZF_kw_fl32_S5_S3 0.99 UMR___1_1_0_S5_S3 0.01 1 FORMAT "%3.2" /end CHARACTERISTIC
/begin CHARACTERISTIC MPT_MEMIST_K0 "Filterzeitkonstante für E-MAschinenistmoment" VALUE 0x1D77F9 ZF_kw_ui8_S5_S3 0.99 UMR___1_100_0_S5_S3 0.01 1 /end CHARACTERISTIC
/begin CHARACTERISTIC MPT_MEMMAXDYN_K0 "Filterzeitkonstante für PT1-Filter" VALUE 0x1D7804 ZF_kw_ui8_S5_S3 0.99 UMR___1_100_0_S5_S3 0.01 1 /end CHARACTERISTIC
/begin CHARACTERISTIC MPT_MEMMINDYN_K0 "Filterzeitkonstante für PT1-Filter" VALUE 0x1D7805 ZF_kw_ui8_S5_S3 0.99 UMR___1_100_0_S5_S3 0.01 1 /end CHARACTERISTIC
/begin CHARACTERISTIC MPT_MINIT_REST_SCHALT_K0 "-" VALUE 0x1A0888 ZF_kw_fl32_S5_S3 0.99 UMR___1_1_0_S5_S3 0.01 1 FORMAT "%3.2" /end CHARACTERISTIC
/begin CHARACTERISTIC MPT_MMOTGEMOE_IAE "Filterzeitkonstante für PT1-Filter für gemischtes Motormoment" VALUE 0x1D77C0 ZF_kw_ui8_S5_S3 0.99 UMR___1_100_0_S5_S3 0.01 1 /end CHARACTERISTIC
/begin CHARACTERISTIC MPT_MMOTISTOE_IAE "Filterzeitkonstante für PT1-Filter für Motoristmoment ohne Getriebeeingriff" VALUE 0x1D77BE ZF_kw_ui8_S5_S3 0.99 UMR___1_100_0_S5_S3 0.01 1 /end CHARACTERISTIC
/begin CHARACTERISTIC MPT_MMOTIST_IAE "Filterzeitkonstante für Motoristmoment" VALUE 0x1D77BD ZF_kw_ui8_S5_S3 0.99 UMR___1_100_0_S5_S3 0.01 1 /end CHARACTERISTIC
/begin CHARACTERISTIC MPT_MMOTIST_K0 "Filterzeitkonstante für Motoristmoment" VALUE 0x1D77F8 ZF_kw_ui8_S5_S3 0.99 UMR___1_100_0_S5_S3 0.01 1 /end CHARACTERISTIC
/begin CHARACTERISTIC MPT_MMOTMAX_IAE "PT1-Filterwert für Motormomentenbegrenzung" VALUE 0x1D77B3 ZF_kw_ui8_S5_S3 0.99 UMR___1_100_0_S5_S3 0.01 1 /end CHARACTERISTIC
/begin CHARACTERISTIC MPT_MMOTSOLLOE_IAE "Filterzeitkonstante für PT1-Filter für Motorsollmoment ohne Getriebeeingriff" VALUE 0x1D77BF ZF_kw_ui8_S5_S3 0.99 UMR___1_100_0_S5_S3 0.01 1 /end CHARACTERISTIC
/begin CHARACTERISTIC MPT_MVMIST_K0 "Filterzeitkonstante für Verbrennungsmotoristmoment" VALUE 0x1D77FA ZF_kw_ui8_S5_S3 0.99 UMR___1_100_0_S5_S3 0.01 1 /end CHARACTERISTIC
/begin CHARACTERISTIC MPT_NAB_IAE "Filterzeitkonstante für Abtriebsdrehzahl" VALUE 0x1D77BA ZF_kw_ui8_S5_S3 0.99 UMR___1_100_0_S5_S3 0.01 1 /end CHARACTERISTIC
/begin CHARACTERISTIC MPT_NAB_K0 "Filterzeitkonstante für PT1-Filter für Abtriebsdrehzahl" VALUE 0x1D7809 ZF_kw_ui8_S5_S3 0.99 UMR___1_100_0_S5_S3 0.01 1 /end CHARACTERISTIC
/begin CHARACTERISTIC MPT_NDZSZUG_K0 "Filterzeitkonstante für ZUG/SCHUB Erkennung Differenzdrehzahl" VALUE 0x1D77F7 ZF_kw_ui8_S5_S3 0.99 UMR___1_100_0_S5_S3 0.01 1 /end CHARACTERISTIC
/begin CHARACTERISTIC MPT_ND_GETREIN_IAE "Filterkonstante für PT1-Filter Differenzdrehzahl nd_getrein_iae" VALUE 0x1D77BC ZF_kw_ui8_S5_S3 0.99 UMR___1_100_0_S5_S3 0.01 1 /end CHARACTERISTIC
/begin CHARACTERISTIC MPT_ND_IAE "Filterzeitkonstante für Differenzdrehzahl am Anfahrelement" VALUE 0x1D77B7 ZF_kw_ui8_S5_S3 0.99 UMR___1_100_0_S5_S3 0.01 1 /end CHARACTERISTIC
/begin CHARACTERISTIC MPT_ND_MOT_IAE "Filterzeitkonstante für Differenzdrehzahl zwischen Motor und -Leerlaufdrehzahl" VALUE 0x1D77B6 ZF_kw_ui8_S5_S3 0.99 UMR___1_100_0_S5_S3 0.01 1 /end CHARACTERISTIC
/begin CHARACTERISTIC MPT_NEIGUNG_IEP "PT1- Filterzeitkonstante für neigung_gef_iep" VALUE 0x1D77E7 ZF_kw_ui8_S5_S3 0.99 UMR_SEC__1_100_0_S5_S3 0.01 1 /end CHARACTERISTIC
/begin CHARACTERISTIC MPT_NG_MOT_IEP "PT1- Filterzeitkonstante ng_mot_iep" VALUE 0x1D77DE ZF_kw_ui8_S5_S3 0.99 UMR___1_100_0_S5_S3 0.01 1 /end CHARACTERISTIC
/begin CHARACTERISTIC MPT_NMOTSOLLANFAHR_ENTK_IAE "Filterkonstante für PT1-Filter für Sollanfahrdrehzahl während Entkopplung" VALUE 0x1D77A2 ZF_kw_ui8_S5_S3 1 UMR___1_100_0_S5_S3 0 1 /end CHARACTERISTIC
/begin CHARACTERISTIC MPT_NMOT_IAE "Filterzeitkonstante für Motordrehzahl" VALUE 0x1D77B9 ZF_kw_ui8_S5_S3 0.99 UMR___1_100_0_S5_S3 0.01 1 /end CHARACTERISTIC
/begin CHARACTERISTIC MPT_NSMOTANKORR_IEP "PT1- Filterzeitkonstante ns_mot_an_korr_iep" VALUE 0x1D77DF ZF_kw_ui8_S5_S3 0.99 UMR___1_100_0_S5_S3 0.01 1 /end CHARACTERISTIC
/begin CHARACTERISTIC MPT_NT_IAE "Filterzeitkonstante für Abtriebsdrehzahl" VALUE 0x1D77BB ZF_kw_ui8_S5_S3 0.99 UMR___1_100_0_S5_S3 0.01 1 /end CHARACTERISTIC
/begin CHARACTERISTIC MPT_NT_K0 "Filterzeitkonstante für PT1-Filter für Turbinendrehzahl" VALUE 0x1D7808 ZF_kw_ui8_S5_S3 0.99 UMR___1_100_0_S5_S3 0.01 1 /end CHARACTERISTIC
/begin CHARACTERISTIC MPT_NUE_IAE "PT1-Filterzeitkonstante für nue_iae" VALUE 0x1D77B5 ZF_kw_ui8_S5_S3 0.99 UMR___1_100_0_S5_S3 0.01 1 /end CHARACTERISTIC
/begin CHARACTERISTIC MPT_PBREMS_IAE "Filterzeitkonstante für Bremsdruck" VALUE 0x1D77C1 ZF_kw_ui8_S5_S3 0.99 UMR___1_100_0_S5_S3 0.01 1 /end CHARACTERISTIC
/begin CHARACTERISTIC MPT_PO_TORUS_K0 "Filterzeitkonstante für Torusdruck Filterung" VALUE 0x1D7833 ZF_kw_ui8_S5_S3 0.99 UMR___1_100_0_S5_S3 0.01 1 /end CHARACTERISTIC
/begin CHARACTERISTIC MPT_VPOEL_K0 "Filterzeitkonstante für PT1-Filter zur Berechnung von vp_oel_k0" VALUE 0x19ECAC ZF_kw_fl32_S5_S3 0.99 UMR___1_1_0_S5_S3 0.01 1 FORMAT "%3.2" /end CHARACTERISTIC
/begin CHARACTERISTIC MPT_WNDOSCHALTAB_HSS_K0 "Filterzeitkonstante zum Abfiltern des Schaltoffsets während der Gleitphase bei HSS" VALUE 0x1D781D ZF_kw_ui8_S5_S3 0.99 UMR___1_100_0_S5_S3 0.01 1 /end CHARACTERISTIC
/begin CHARACTERISTIC MPT_WNDOSCHALTAB_RSZ_K0 "Filterzeitkonstante zum Abfiltern des Schaltoffsets während der Gleitphase bei RSZ" VALUE 0x1D781E ZF_kw_ui8_S5_S3 0.99 UMR___1_100_0_S5_S3 0.01 1 /end CHARACTERISTIC
/begin CHARACTERISTIC MS_LWREGK0S "Momentenschwelle für Schub erkennung" VALUE 0x1D83E4 ZF_kw_si16_S5_S3 200 UMR_NM__1_1_0_S5_S3 -200 0 /end CHARACTERISTIC
/begin CHARACTERISTIC MS_LWREGK0Z "Momentenschwelle für Zug erkennung" VALUE 0x1D83E2 ZF_kw_si16_S5_S3 200 UMR_NM__1_1_0_S5_S3 0 200 /end CHARACTERISTIC
/begin CHARACTERISTIC MS_ME_MAXSCHUTZ_K0 "Keine Beschreibung in Spec." VALUE 0x1D83F8 ZF_kw_si16_S5_S3 500 UMR_NM__1_1_0_S5_S3 0 500 /end CHARACTERISTIC
/begin CHARACTERISTIC MS_MVMISTDIAG_K0 "Schwelle Verbrennungsmotoristmoment m_vmist_sync_k0 zur aktivierung der Diagnosefunktion K0 zur ueberpruefung eines mechanischen Defekts" VALUE 0x1D83EC ZF_kw_si16_S5_S3 1000 UMR_NM__1_1_0_S5_S3 0 1000 /end CHARACTERISTIC
/begin CHARACTERISTIC MS_OFFEN_K0 "Momentenschwelle für Offen Anzeige" VALUE 0x1D8422 ZF_kw_si16_S5_S3 300 UMR_NM__1_1_0_S5_S3 0 300 /end CHARACTERISTIC
/begin CHARACTERISTIC MS_SCHUTZENDE_K0 "Keine Beschreibung in Spec." VALUE 0x1D83F6 ZF_kw_si16_S5_S3 500 UMR_NM__1_1_0_S5_S3 0 500 /end CHARACTERISTIC
/begin CHARACTERISTIC M_ANGELEGT_AUTOHOLD_IAE "Vorsteuermoment im Zustand Angelegt bei aktiver Rollverhinderung" VALUE 0x1D8374 ZF_kw_si16_S5_S3 50 UMR_NM__1_1_0_S5_S3 0 50 /end CHARACTERISTIC
/begin CHARACTERISTIC M_ANGELEGT_FSTBR_IAE "Vorsteuermoment im Zustand Angelegt bei betätigter Feststellbremse" VALUE 0x1D8372 ZF_kw_si16_S5_S3 50 UMR_NM__1_1_0_S5_S3 0 50 /end CHARACTERISTIC
/begin CHARACTERISTIC M_AUF_MIN_IAE "minimales IAE-Aufnahmemoment" VALUE 0x1D838C ZF_kw_si16_S5_S3 100 UMR_NM__1_1_0_S5_S3 0 100 /end CHARACTERISTIC
/begin CHARACTERISTIC NDS_EINREGREG_K0 "Drehzahlschwelle Übergang EINREGELN nach SCHLUPFGEREGELT" VALUE 0x1D7818 ZF_kw_ui8_S5_S3 255 UMR_U_MIN_1_1_0_S5_S3 0 255 /end CHARACTERISTIC
/begin CHARACTERISTIC NDS_HYSMREIBZU_IAE "Hysterese für Drehzahlschwelle für Reibmomentberechnung im Zustand ZU" VALUE 0x1D83B6 ZF_kw_si16_S5_S3 1000 UMR_U_MIN_1_1_0_S5_S3 0 1000 /end CHARACTERISTIC
/begin CHARACTERISTIC NDS_K0ZU "Differenzdrehzahlschwelle für Einstieg in GEREGELTGESCHLOSSEN oder GESCHLOSSEN wirkt auch beim Übergang von GEREGELTGESCHLOSSEN oder GESCHLOSSEN nach SCHLUPFGEREGELT" VALUE 0x1D7830 ZF_kw_ui8_S5_S3 255 UMR_U_MIN_1_1_0_S5_S3 0 255 /end CHARACTERISTIC
/begin CHARACTERISTIC NDS_K0ZU_PLAUSI "Differenzdrehzahlschwelle für anzeige ko_ist geschlossen" VALUE 0x1D7831 ZF_kw_ui8_S5_S3 255 UMR_U_MIN_1_1_0_S5_S3 0 255 /end CHARACTERISTIC
/begin CHARACTERISTIC NDS_LWREGK0S "Drehzahlschwelle für ZUG/SCHUB Erkennung" VALUE 0x1D83E6 ZF_kw_si16_S5_S3 255 UMR_U_MIN_1_1_0_S5_S3 -255 0 /end CHARACTERISTIC
/begin CHARACTERISTIC NDS_LWREGK0Z "Drehzahlschwelle für ZUG/SCHUB Erkennung" VALUE 0x1D77F6 ZF_kw_ui8_S5_S3 255 UMR_U_MIN_1_1_0_S5_S3 0 255 /end CHARACTERISTIC
/begin CHARACTERISTIC NDS_MREIBZU_IAE "Drehzahlschwelle für Reibmomentberechnung im Zustand ZU" VALUE 0x1D83B4 ZF_kw_si16_S5_S3 1000 UMR_U_MIN_1_1_0_S5_S3 0 1000 /end CHARACTERISTIC
/begin CHARACTERISTIC NDS_NDIAE_POSN_IAE "IAE-Differenzdrehzahlschwelle, ab der auf Differenzdrehzahl in der Abwürgeschutzfkt erkannt wird" VALUE 0x1D83A6 ZF_kw_si16_S5_S3 5000 UMR_U_MIN_1_1_0_S5_S3 0 5000 /end CHARACTERISTIC
/begin CHARACTERISTIC NDS_POSN_IAE "Differenzdrehzahlschwelle zur LL-Drehzahl zur Aktivierung der Abwürgschutzfkt" VALUE 0x1D83A4 ZF_kw_si16_S5_S3 2000 UMR_U_MIN_1_1_0_S5_S3 -1000 1000 /end CHARACTERISTIC
/begin CHARACTERISTIC NDS_SCHUTZEINSTIEG_K0 "Keine Beschreibung in Spec." VALUE 0x1D83F4 ZF_kw_ui16_S5_S3 3000 UMR_U_MIN_1_1_0_S5_S3 0 3000 /end CHARACTERISTIC
/begin CHARACTERISTIC ND_MOTPOSN_RSETZ_IAE "Drehzahlschwelle zur LL-Drehzahl um Abwürgeschutzfkt aufzuheben" VALUE 0x1D83AA ZF_kw_si16_S5_S3 2000 UMR_U_MIN_1_1_0_S5_S3 -1000 1000 /end CHARACTERISTIC
/begin CHARACTERISTIC NEIG_D_IAE "Neigungsschwelle in Position D oberhalb welcher eine Ausgabe einer min. EM-Drehzahl erfolgt" VALUE 0x1D77D2 ZF_kw_ui8_S5_S3 84.6667 UMR_GRAD__1_3_M128_S5_S3 -42.6666666667 42 /end CHARACTERISTIC
/begin CHARACTERISTIC NEIG_HYS_IAE "Hysterese auf Neigungsschwelle" VALUE 0x1D77D4 ZF_kw_ui8_S5_S3 84.6667 UMR_GRAD__1_3_M128_S5_S3 -42.6666666667 42 /end CHARACTERISTIC
/begin CHARACTERISTIC NEIG_R_IAE "Neigungsschwelle in Position R oberhalb welcher eine Ausgabe einer min. EM-Drehzahl erfolgt" VALUE 0x1D77D3 ZF_kw_ui8_S5_S3 84.6667 UMR_GRAD__1_3_M128_S5_S3 -42.6666666667 42 /end CHARACTERISTIC
/begin CHARACTERISTIC NGS_AB_POSN_IAE "Abtriebsdrehzahlgradientenschwelle zur Aktivierung der Abwürgschutzfkt" VALUE 0x1D83B0 ZF_kw_si16_S5_S3 10000 UMR_U_MINSEC_1_1_0_S5_S3 -10000 0 /end CHARACTERISTIC
/begin CHARACTERISTIC NGS_GETREIN_POSN_IAE "Getriebeeingangsdrehzahlgradientenschwelle zur Aktivierung der Abwürgschutzfkt" VALUE 0x1D83AC ZF_kw_si16_S5_S3 10000 UMR_U_MINSEC_1_1_0_S5_S3 -10000 0 /end CHARACTERISTIC
/begin CHARACTERISTIC NGS_HYSAB_POSN_IAE "Hysterese auf Abtriebsdrehzahlgradientenschwelle zur Deaktivierung der Abwürgschutzfkt" VALUE 0x1D83B2 ZF_kw_si16_S5_S3 20000 UMR_U_MINSEC_1_1_0_S5_S3 -10000 10000 /end CHARACTERISTIC
/begin CHARACTERISTIC NGS_HYSGETREIN_POSN_IAE "Hysterese zur Deaktivierung der Abwürgschutzfkt" VALUE 0x1D83AE ZF_kw_si16_S5_S3 20000 UMR_U_MINSEC_1_1_0_S5_S3 -10000 10000 /end CHARACTERISTIC
/begin CHARACTERISTIC NMOT_ADDKORR_K0 "additiver Korrekturwert für Motordrehzahl" VALUE 0x1D780D ZF_kw_si8_S5_S3 200 UMR_U_MIN_1_1_0_S5_S3 -100 100 /end CHARACTERISTIC
/begin CHARACTERISTIC NMOT_MULTKORR_K0 "Multiplikativer Korrekturwert für Motordrehzahl" VALUE 0x1D83E8 ZF_kw_si16_S5_S3 0.04 UMR___1_10000_0_S5_S3 -0.02 0.02 /end CHARACTERISTIC
/begin CHARACTERISTIC NS_ABMINANKRIECHEN_IAE "Abtriebsdrehzahlschwelle im Zustand Kriechen zum Start einer Kriechmomentenoffsetrampe" VALUE 0x1D8378 ZF_kw_si16_S5_S3 2000 UMR_U_MIN_1_1_0_S5_S3 0 2000 /end CHARACTERISTIC
/begin CHARACTERISTIC NS_ABNEIG_IAE "Abtriebsdrehzahlschwelle unterhalb welcher eine Ausgabe einer min. EM-Drehzahl möglich ist" VALUE 0x1D83BA ZF_kw_ui16_S5_S3 2000 UMR_U_MIN_1_1_0_S5_S3 0 2000 /end CHARACTERISTIC
/begin CHARACTERISTIC NS_ABPOSN_RSETZ_IAE "Abtriebsdrehzahlschwelle zum Rücksetzen der kfl_sollneutral Anforderung" VALUE 0x1D83A8 ZF_kw_si16_S5_S3 1000 UMR_U_MIN_1_1_0_S5_S3 0 1000 /end CHARACTERISTIC
/begin CHARACTERISTIC NS_ABREGINITKRIECH_HYS_IAE "Abtriebsdrehzahlhysteresewert zur Initialisierung des Kriechdifferenzdrehzahlreglers" VALUE 0x1D837E ZF_kw_si16_S5_S3 2000 UMR_U_MIN_1_1_0_S5_S3 0 2000 /end CHARACTERISTIC
/begin CHARACTERISTIC NS_ABREGINITKRIECH_IAE "Abtriebsdrehzahlwert zur Initialisierung des Kriechdifferenzdrehzahlreglers" VALUE 0x1D8380 ZF_kw_si16_S5_S3 2100 UMR_U_MIN_1_1_0_S5_S3 -100 2000 /end CHARACTERISTIC
/begin CHARACTERISTIC NS_ASRREGELT_SYNC_HYS_E_IAE "Hysterese auf Drehzahlschwelle zur Oeffnendrehzahlberechnung bei aktivem Anfahrregler-Eingriff" VALUE 0x1D839C ZF_kw_si16_S5_S3 5000 UMR_U_MIN_1_1_0_S5_S3 0 5000 /end CHARACTERISTIC
/begin CHARACTERISTIC NS_ASRREGELT_SYNC_HYS_H_IAE "Hysterese auf Drehzahlschwelle zur Oeffnendrehzahlberechnung bei aktivem Anfahrregler-Eingriff" VALUE 0x1D839A ZF_kw_si16_S5_S3 5000 UMR_U_MIN_1_1_0_S5_S3 0 5000 /end CHARACTERISTIC
/begin CHARACTERISTIC NS_EMLL_MIN_IAE "Minimale EM-Leerlaufdrehzahl" VALUE 0x1D839E ZF_kw_si16_S5_S3 1000 UMR_U_MIN_1_1_0_S5_S3 0 1000 /end CHARACTERISTIC
/begin CHARACTERISTIC NS_F_EINMAL_AUS_IEP "Drehzhalschwelle wann f_einmal_aus TRUE wird" VALUE 0x1D83D8 ZF_kw_ui16_S5_S3 1500 UMR_U_MIN_1_1_0_S5_S3 0 1500 /end CHARACTERISTIC
/begin CHARACTERISTIC NS_HYBRID_HYS_IEP "Hysterese zur Einschaltschwelle beim hybridischen Fahren" VALUE 0x1D77ED ZF_kw_ui8_S5_S3 200 UMR_U_MIN_1_1_0_S5_S3 0 200 /end CHARACTERISTIC
/begin CHARACTERISTIC NS_HYBRID_IEP "Einschaltschwelle beim hybridischen Fahren" VALUE 0x1D83DC ZF_kw_ui16_S5_S3 1500 UMR_U_MIN_1_1_0_S5_S3 0 1500 /end CHARACTERISTIC
/begin CHARACTERISTIC NS_HYS_ABNEIG_IAE "Hysterese auf Abtriebsdrehzahlschwelle unterhalb welcher eine Ausgabe einer min. EM-Drehzahl möglich ist." VALUE 0x1D83BC ZF_kw_ui16_S5_S3 2000 UMR_U_MIN_1_1_0_S5_S3 0 2000 /end CHARACTERISTIC
/begin CHARACTERISTIC NS_MOTANFAHRMAXC_IAE "Motordrehzahlschwellwert im Anfahren ab welcher Anfahrdrehzahlbegrenzung aktiv wird" VALUE 0x1D8386 ZF_kw_si16_S5_S3 5000 UMR_U_MIN_1_1_0_S5_S3 0 5000 /end CHARACTERISTIC
/begin CHARACTERISTIC NS_MOT_HYS_IEP "Hysterese zu NS_MOT_IEP" VALUE 0x1D77D8 ZF_kw_ui8_S5_S3 150 UMR_U_MIN_1_1_0_S5_S3 0 150 /end CHARACTERISTIC
/begin CHARACTERISTIC NS_NAB_ERF_IEP "Drehzahl unterhalb der die IEP wegen der Gefahr des Ölverschaumens (Hochgeschwindigkeit) angeschalten wird" VALUE 0x1D83D6 ZF_kw_ui16_S5_S3 5000 UMR_U_MIN_1_1_0_S5_S3 0 5000 /end CHARACTERISTIC
/begin CHARACTERISTIC NS_NAB_IEP "Schwelle für Abtriebsdrehzahl" VALUE 0x1D83D4 ZF_kw_ui16_S5_S3 5000 UMR_U_MIN_1_1_0_S5_S3 0 5000 /end CHARACTERISTIC
/begin CHARACTERISTIC NS_NDGETREINLLBASIS_IAE "Drehzahlwert zur Bildung von nd_getrein_iae, wenn Schalter SWI_NDGETREINLLBASIS_IAE auf true" VALUE 0x1D83A0 ZF_kw_si16_S5_S3 5000 UMR_U_MIN_1_1_0_S5_S3 0 5000 /end CHARACTERISTIC
/begin CHARACTERISTIC NS_NDMOTSTALL_IAE "Differenzdrehzahlschwelle für die Umschaltung der Motormomentengradientenbegrenzung im Anfahren" VALUE 0x1D8396 ZF_kw_si16_S5_S3 5500 UMR_U_MIN_1_1_0_S5_S3 -500 5000 /end CHARACTERISTIC
/begin CHARACTERISTIC NS_NMOT_IEP "EM Drehzahlschwelle, ab der m_mott und m_soll_iae berücksichtigt werden bei der LP Bestimmung" VALUE 0x1D83C6 ZF_kw_ui16_S5_S3 500 UMR_U_MIN_1_1_0_S5_S3 0 500 /end CHARACTERISTIC
/begin CHARACTERISTIC N_EMKNICK_ERSATZ_IAE "Ersatzwert für EM-Knickdrehzahl" VALUE 0x1D8384 ZF_kw_si16_S5_S3 3000 UMR_U_MIN_1_1_0_S5_S3 0 3000 /end CHARACTERISTIC
/begin CHARACTERISTIC OG_M_AUF_REST_IAE "Reduzierungsgradient für nicht abgebaute Anteile von m_aufiae. Betragswert, wird in beide Richtungen verwendet" VALUE 0x1D838A ZF_kw_si16_S5_S3 1000 UMR_NM_SEC_1_1_0_S5_S3 0 1000 /end CHARACTERISTIC
/begin CHARACTERISTIC PG_HYSABREG_K0 "Rampengradient für Abbau p_hys_k0 und Überführung von po_reg_k0" VALUE 0x1D8424 ZF_kw_ui16_S5_S3 29.9 UMR_BAR_SEC_1_10_0_S5_S3 0.1 30 /end CHARACTERISTIC
/begin CHARACTERISTIC PS_BREMS_POSN_IAE "Bremsdruckschwelle zur Aktivierung der Abwürgschutzfkt." VALUE 0x1D83A2 ZF_kw_si16_S5_S3 100 UMR_BAR__1_100_0_S5_S3 0 100 /end CHARACTERISTIC
/begin CHARACTERISTIC PS_BREMS_STALL_IAE "Bremsdruckschwelle für Stallspeederkennung" VALUE 0x1D8392 ZF_kw_si16_S5_S3 100 UMR_BAR__1_100_0_S5_S3 0 100 /end CHARACTERISTIC
/begin CHARACTERISTIC PS_KEINEKUEHLUNG_K0 "Schwelle Ansteuerdruck fuer aktive Kuehlung" VALUE 0x1D83DE ZF_kw_ui16_S5_S3 5 UMR_BAR__1_1000_0_S5_S3 0 5 /end CHARACTERISTIC
/begin CHARACTERISTIC PS_PSOLLDIAG_K0 "Mindestsolldruckschwelle p_k0_soll zur Aktivierung der Diagnosefunktion K0 zur Ueberpruefung eines mechanischen Defekts" VALUE 0x1D83EA ZF_kw_ui16_S5_S3 10 UMR_BAR__1_1000_0_S5_S3 0 10 /end CHARACTERISTIC
/begin CHARACTERISTIC PUMPENVOLPROUMDR_IEP "Pumpenvolumen der FZP pro Umdrehung in Liter" VALUE 0x1D83C8 ZF_kw_ui16_S5_S3 0.9999 UMR___1_10000_0_S5_S3 0.0001 1 /end CHARACTERISTIC
/begin CHARACTERISTIC P_MANUELLZU_K0 "Druck für manuelles schließen der k0 über SWI_MANUELLZU_K0 bei Fahrzeugstillstand, VM aus und E-Maschinendrehzahl = 0 min-1" VALUE 0x1A08D8 ZF_kw_fl32_S5_S3 30 UMR_BAR__1_1_0_S5_S3 0 30 FORMAT "%4.3" /end CHARACTERISTIC
/begin CHARACTERISTIC P_MAX_K0 "Maximaler Kupplungsdruck" VALUE 0x1D8420 ZF_kw_si16_S5_S3 30 UMR_BAR__1_1000_0_S5_S3 0 30 /end CHARACTERISTIC
/begin CHARACTERISTIC P_SYSMIN_PSS_IEP "Schwelle des Systemdruck ab der die IP den Systemdruck stützen kann" VALUE 0x1D83DA ZF_kw_ui16_S5_S3 20 UMR_BAR__1_1000_0_S5_S3 0 20 /end CHARACTERISTIC
/begin CHARACTERISTIC P_SYS_SCHWELLE_IEP "Schwelle des Systemsdrucks über der die IEP nicht betrieben werden darf" VALUE 0x1D83CA ZF_kw_ui16_S5_S3 20 UMR_BAR__1_1000_0_S5_S3 0 20 /end CHARACTERISTIC
/begin CHARACTERISTIC SWI_ABFR_HAS_PSS_IEP "Schalter zur Auswahl, ob die K0 Befülung beim Stützen des Systemdrucks mit berücksichtigt erden soll 0 = K0 Befüllung beim Stützen nicht erücksichtigt 1 = K0 Befüllung beim Stützen wird brücksichtigt" VALUE 0x1D77EA ZF_kw_bool8_S5_S3 1 UMR___1_1_0_S5_S3 0 1 /end CHARACTERISTIC
/begin CHARACTERISTIC SWI_AKTIVEKUEHLUNG_K0 "Schalter zum Umschalten zwischen den Berechnungsarten des Kuehloelstroms 0 normal 1 erweitert" VALUE 0x1D77EE ZF_kw_bool8_S5_S3 1 UMR___1_1_0_S5_S3 0 1 /end CHARACTERISTIC
/begin CHARACTERISTIC SWI_DIAGAKTIV_K0 "Schalter zur Aktivierung bzw. Deaktivierung der Diagnosefunktion K0 zur Ueberpruefung eines mechanischen Defekts" VALUE 0x1D780E ZF_kw_bool8_S5_S3 1 UMR___1_1_0_S5_S3 0 1 /end CHARACTERISTIC
/begin CHARACTERISTIC SWI_DIAGTEMPERLAUBT_K0 "Schalter für Belagtemperaturdiagnose 0 = Belagtemperaturdiagnose verboten 1 = Belagtemperaturdiagnose erlaubt" VALUE 0x1D7812 ZF_kw_bool8_S5_S3 1 UMR___1_1_0_S5_S3 0 1 /end CHARACTERISTIC
/begin CHARACTERISTIC SWI_F_EINMALAUS_IEP "Schalter zur Beeinflussung von f_einmal_aus 0 = f_einmal_aus wird in Abhängigkeit von f_an_aus_iep gesetzt 1 = f_einmal_aus wird in Abhängigkeit von n_mot gesetzt" VALUE 0x1D77E9 ZF_kw_bool8_S5_S3 1 UMR___1_1_0_S5_S3 0 1 /end CHARACTERISTIC
/begin CHARACTERISTIC SWI_GEFAEL_LUFT_AKTIV_IEP "Schalter zum Einschalten der Gefällefunktionalität 0 = Gefälle Funktionen deaktiviert 1 = Gefälle Funktion aktiviert" VALUE 0x1D77E6 ZF_kw_bool8_S5_S3 1 UMR___1_1_0_S5_S3 0 1 /end CHARACTERISTIC
/begin CHARACTERISTIC SWI_IEP "Schalter zum Einschalten der Pumpe 0: Ausschalten der Pumpe 1: Einschalten der Pumpe" VALUE 0x1D77DC ZF_kw_bool8_S5_S3 1 UMR___1_1_0_S5_S3 0 1 /end CHARACTERISTIC
/begin CHARACTERISTIC SWI_INITVORSCHALT_K0 "Schalter für Initialisierung Vorsteuerung 0: Momentenoffset wird während Schaltung nicht aufgeschaltet 1: Momentenoffset wird während Schaltung aufgeschaltet" VALUE 0x1D7826 ZF_kw_bool8_S5_S3 1 UMR___1_1_0_S5_S3 0 1 /end CHARACTERISTIC
/begin CHARACTERISTIC SWI_JFZGSCHALTAKTIV_K0 "Schalter zum Umschalten zwischen den Berechnungsarten des Fahrzeug-Motormoments während Schaltungen" VALUE 0x1D77EF ZF_kw_ui8_S5_S3 2 UMR___1_1_0_S5_S3 0 2 /end CHARACTERISTIC
/begin CHARACTERISTIC SWI_KEINKRAFTSCHLUSS_K0 "Schalter zum Umschalten zwischen den Berechnungsarten des sek Traegheitmoment 0 normal 1 erweitert" VALUE 0x1D77F0 ZF_kw_bool8_S5_S3 1 UMR___1_1_0_S5_S3 0 1 /end CHARACTERISTIC
/begin CHARACTERISTIC SWI_KRIECHAKTIVNDS_IAE "Schalter für Differenzdrehzahlkriterium zur Deaktivierung des Kriechreglers" VALUE 0x1D77B1 ZF_kw_bool8_S5_S3 1 UMR___1_1_0_S5_S3 0 1 /end CHARACTERISTIC
/begin CHARACTERISTIC SWI_MANUELLZU_K0 "Schalter für Manuelles Schließen der k0 0: k0 über Druckansteuerung und Schlupfregelung regeln/steuern 1: k0 manuell schließen über P_MANUELLZU_K0" VALUE 0x1D7825 ZF_kw_ui8_S5_S3 1 UMR___1_1_0_S5_S3 0 1 /end CHARACTERISTIC
/begin CHARACTERISTIC SWI_MIAEAUF_ANFAHREN_IAE "Schalter für Berechnung m_iaeauf im Anfahren" VALUE 0x1D77AB ZF_kw_bool8_S5_S3 1 UMR___1_1_0_S5_S3 0 1 /end CHARACTERISTIC
/begin CHARACTERISTIC SWI_MISTMSOLLMUE_K0 "Schalter zum Umschalten zwischen Soll- und Istmoment als Eingangssignal für Reibwertkennfelder" VALUE 0x1D77F4 ZF_kw_bool8_S5_S3 1 UMR___1_1_0_S5_S3 0 1 /end CHARACTERISTIC
/begin CHARACTERISTIC SWI_MSCHALTK0_SP "Schaltmoment wird zur Verbesserung der Entkoppelung bei RSZ und HSS bereits mit schaltung_k0 <> 0 aufgeschaltet" VALUE 0x1D7827 ZF_kw_bool8_S5_S3 1 UMR___1_1_0_S5_S3 0 1 /end CHARACTERISTIC
/begin CHARACTERISTIC SWI_M_IAEAUF_SCHLEPP_IAE "Schalter für Rausrampen IAE-Schleppmoment" VALUE 0x1D77AF ZF_kw_bool8_S5_S3 1 UMR___1_1_0_S5_S3 0 1 /end CHARACTERISTIC
/begin CHARACTERISTIC SWI_M_MAXEMIAE_IEP "Schalter zur Auswahl des Eingangsmoments 0: ABS(m_mot) 1: Max(ABS(m_mot),ABS(m_soll_iae)" VALUE 0x1D77D6 ZF_kw_bool8_S5_S3 1 UMR___1_1_0_S5_S3 0 1 /end CHARACTERISTIC
/begin CHARACTERISTIC SWI_NAB_LUFT_AKTIV_IEP "Schalter zum Einschalten der Geschwindigkeitsfunktionalität 0 = Geschwindigkeit Funktionen deaktiviert 1 = Geschwindigkeit Funktion aktiviert" VALUE 0x1D77E5 ZF_kw_bool8_S5_S3 1 UMR___1_1_0_S5_S3 0 1 /end CHARACTERISTIC
/begin CHARACTERISTIC SWI_NDGETREINLLBASIS_IAE "Schalter um Ersatzwert NS_NDGETREINLLBASIS_IAE zur Bildung von nd_getrein_iae zu aktivieren." VALUE 0x1D77CF ZF_kw_bool8_S5_S3 1 UMR___1_1_0_S5_S3 0 1 /end CHARACTERISTIC
/begin CHARACTERISTIC SWI_NDWNDMUE_K0 "Schalter zum Umschalten zwischen Soll- und Istdrehzahl als Eingangssignal für Reibwertkennfelder" VALUE 0x1D77F3 ZF_kw_bool8_S5_S3 1 UMR___1_1_0_S5_S3 0 1 /end CHARACTERISTIC
/begin CHARACTERISTIC SWI_NEIGUNGGEF_IAE "Schalter zur Auswahl welches Neigungssignal zur Ausgabe der minimalen E-Maschinendrehzahl verwendet werden soll" VALUE 0x1D77D5 ZF_kw_ui8_S5_S3 2 UMR___1_1_0_S5_S3 1 3 /end CHARACTERISTIC
/begin CHARACTERISTIC SWI_NMIN_AKTIV_IEP "Schalter um die Drehzahlanhebung bei der low Spec IEP zu aktivieren 0: Drehzahlanhebung nicht aktiv 1: Drehzahlanhebung aktiv" VALUE 0x1D77D9 ZF_kw_bool8_S5_S3 1 UMR___1_1_0_S5_S3 0 1 /end CHARACTERISTIC
/begin CHARACTERISTIC SWI_NMOTLLREG_AKTIV_IAE "Schalter zur Berücksichtigung ob der Motorleerlaufregler aktiv ist in den Übergangsbedingungen" VALUE 0x1D77D1 ZF_kw_bool8_S5_S3 1 UMR___1_1_0_S5_S3 0 1 /end CHARACTERISTIC
/begin CHARACTERISTIC SWI_NMOTSOLL_LL_E_IAE "Schalter zur Auswahl der Solllleerlaufdrehzahlberechnung beim elektrischen Fahren mit Schlupf" VALUE 0x1D77CC ZF_kw_ui8_S5_S3 2 UMR___1_1_0_S5_S3 0 2 /end CHARACTERISTIC
/begin CHARACTERISTIC SWI_NSOLLH_SLST_IAE "Schalter zur Aktivierung H-Anfahrdrehzahl bei z_modus_iae = E-Anfahren" VALUE 0x1D77B2 ZF_kw_bool8_S5_S3 1 UMR___1_1_0_S5_S3 0 1 /end CHARACTERISTIC
/begin CHARACTERISTIC SWI_NS_SYNC_IAE "Schalter zur Auswahl, welche Eingangsgröße für die Berechnung der Öffnen- Schließendrehzahl verwendet wird" VALUE 0x1D77D0 ZF_kw_ui8_S5_S3 3 UMR___1_1_0_S5_S3 1 4 /end CHARACTERISTIC
/begin CHARACTERISTIC SWI_PT2INITEH_ANFAHRT_IAE "Init PT2-Filter im Anfahren bei z_modus_iae-Wechsel" VALUE 0x1D77A1 ZF_kw_bool8_S5_S3 1 UMR___1_1_0_S5_S3 0 1 /end CHARACTERISTIC
/begin CHARACTERISTIC SWI_P_STUE_HYBRID_PSS_IEP "Schalter um die Funktion Systemeinbrüche im hybridischen zu aktivieren" VALUE 0x1D77EB ZF_kw_bool8_S5_S3 1 UMR___1_1_0_S5_S3 0 1 /end CHARACTERISTIC
/begin CHARACTERISTIC SWI_REGINITMETHODE_K0 "Schalter zur stossfreien Initialisierung aus Druckstellung" VALUE 0x1D7829 ZF_kw_bool8_S5_S3 1 UMR___1_1_0_S5_S3 0 1 /end CHARACTERISTIC
/begin CHARACTERISTIC SWI_REGRAMPSCHALT_K0 "[-], 1: KP, TD werden ab Schaltbefehl über Rampe auf Werte während schaltung_aktiv umgeschalten; 0: Umschaltung erst mit schaltung_aktiv." VALUE 0x1D7828 ZF_kw_ui8_S5_S3 1 UMR___1_1_0_S5_S3 0 1 /end CHARACTERISTIC
/begin CHARACTERISTIC SWI_SCHUTZ_K0 "Schalter für Motoreingriffsfunktion 0 = Motoreingriffsfunktion verboten 1 = Motoreingriffsfunktion erlaubt" VALUE 0x1D7810 ZF_kw_bool8_S5_S3 1 UMR___1_1_0_S5_S3 0 1 /end CHARACTERISTIC
/begin CHARACTERISTIC SWI_VORGABE_MANUELL_IEP "Schalter für manuelle Istvorgange des Leistungspunktes der el. Zusatzpumpe 0: Istvorgabe über Modell 1: Istvorgabe manuell" VALUE 0x1D77DB ZF_kw_bool8_S5_S3 1 UMR___1_1_0_S5_S3 0 1 /end CHARACTERISTIC
/begin CHARACTERISTIC SWI_WNDOFDYN_K0 "Schalter zur Aktivierung von delta_dk_pedal_k0 für Fahrdynamikoffset und des Hochpumpens" VALUE 0x1D7821 ZF_kw_bool8_S5_S3 1 UMR___1_1_0_S5_S3 0 1 /end CHARACTERISTIC
/begin CHARACTERISTIC SWI_ZUGSCHUBERKENNUNG_K0 "Schalter zum Umschalten zwischen Momente und Drehzahlen als Signal für die zug Schub Erkennung" VALUE 0x1D77F5 ZF_kw_bool8_S5_S3 1 UMR___1_1_0_S5_S3 0 1 /end CHARACTERISTIC
/begin CHARACTERISTIC T1_K0REGELN "[s] Zeitkonstante für den diskreten d Anteil" VALUE 0x1A0A48 ZF_kw_fl32_S5_S3 4.99 UMR_SEC__1_1_0_S5_S3 0.01 5 FORMAT "%4.3" /end CHARACTERISTIC
/begin CHARACTERISTIC TAB_ANFORDERUNG_P_SYS_K0 "Tabelle zur Zustandsabhängigen K0-Anforderung zur Systemdruckanhebung" CURVE 0x1A1158 ZF_tab_bool8_S5_S3 1 UMR___1_1_0_S5_S3 0 1
 /begin AXIS_DESCR FIX_AXIS NO_INPUT_QUANTITY UMR___1_1_0_S5_S3 18 0 17 READ_ONLY FIX_AXIS_PAR_DIST 0 1 18 /end AXIS_DESCR
/end CHARACTERISTIC
/begin CHARACTERISTIC TAB_DELTAFPSFDYN_K0 "Schwelle Fahrpedalweg zum Übergang Vorbereitung zu OffsetAktiv der Fahrdynamik" CURVE 0x19F99C ZF_tab_ui8_S5_S3 100 UMR_PROZENT__20_51_0_S5_S3 0 100
 /begin AXIS_DESCR FIX_AXIS NO_INPUT_QUANTITY UMR___1_1_0_S5_S3 10 -1 8 READ_ONLY FIX_AXIS_PAR_DIST -1 1 10 /end AXIS_DESCR
/end CHARACTERISTIC
/begin CHARACTERISTIC TAB_FPGSFDYN_K0 "minimaler Fahrpedalgradient zur Aktivierung der Fahrdynamik" CURVE 0x19F9D4 ZF_tab_ui16_S5_S3 1000 UMR_PROZENT_SEC_20_51_0_S5_S3 0 1000
 /begin AXIS_DESCR FIX_AXIS NO_INPUT_QUANTITY UMR___1_1_0_S5_S3 10 -1 8 READ_ONLY FIX_AXIS_PAR_DIST -1 1 10 /end AXIS_DESCR
/end CHARACTERISTIC
/begin CHARACTERISTIC TAB_FPSFDYN_K0 "Maximale Fahrpedalstellung zur Aktivierung der Fahrdynamik" CURVE 0x19F9AC ZF_tab_ui8_S5_S3 100 UMR_PROZENT__20_51_0_S5_S3 0 100
 /begin AXIS_DESCR FIX_AXIS NO_INPUT_QUANTITY UMR___1_1_0_S5_S3 10 -1 8 READ_ONLY FIX_AXIS_PAR_DIST -1 1 10 /end AXIS_DESCR
/end CHARACTERISTIC
/begin CHARACTERISTIC TAB_F_KDSCHALT_K0 "[], gewichtung der Reglerparameter TD während Schaltungen" MAP 0x1A0B84 ZF_tab2d_fl32_S5_S3 2 UMR___1_1_0_S5_S3 0 2
 /begin AXIS_DESCR FIX_AXIS NO_INPUT_QUANTITY UMR___1_1_0_S5_S3 2 0 1 READ_ONLY FORMAT "%3.2" FIX_AXIS_PAR_DIST 0 1 2 /end AXIS_DESCR
 /begin AXIS_DESCR FIX_AXIS NO_INPUT_QUANTITY UMR___1_1_0_S5_S3 5 0 4 READ_ONLY FORMAT "%3.2" FIX_AXIS_PAR_DIST 0 1 5 /end AXIS_DESCR
 FORMAT "%3.2" /end CHARACTERISTIC
/begin CHARACTERISTIC TAB_F_KDSCHALT_K0_SP "[], gewichtung der Reglerparameter TD während Schaltungen" MAP 0x1A0BB4 ZF_tab2d_fl32_S5_S3 2 UMR___1_1_0_S5_S3 0 2
 /begin AXIS_DESCR FIX_AXIS NO_INPUT_QUANTITY UMR___1_1_0_S5_S3 2 0 1 READ_ONLY FORMAT "%3.2" FIX_AXIS_PAR_DIST 0 1 2 /end AXIS_DESCR
 /begin AXIS_DESCR FIX_AXIS NO_INPUT_QUANTITY UMR___1_1_0_S5_S3 5 0 4 READ_ONLY FORMAT "%3.2" FIX_AXIS_PAR_DIST 0 1 5 /end AXIS_DESCR
 FORMAT "%3.2" /end CHARACTERISTIC
/begin CHARACTERISTIC TAB_F_KISCHALT_K0 "[-] Faktor für Gewichtung I-Anteil während Schaltungen" MAP 0x1A0AC4 ZF_tab2d_fl32_S5_S3 2 UMR___1_1_0_S5_S3 0 2
 /begin AXIS_DESCR FIX_AXIS NO_INPUT_QUANTITY UMR___1_1_0_S5_S3 2 0 1 READ_ONLY FORMAT "%3.2" FIX_AXIS_PAR_DIST 0 1 2 /end AXIS_DESCR
 /begin AXIS_DESCR FIX_AXIS NO_INPUT_QUANTITY UMR___1_1_0_S5_S3 5 0 4 READ_ONLY FORMAT "%3.2" FIX_AXIS_PAR_DIST 0 1 5 /end AXIS_DESCR
 FORMAT "%3.2" /end CHARACTERISTIC
/begin CHARACTERISTIC TAB_F_KISCHALT_K0_SP "[-] Faktor für Gewichtung I-Anteil während Schaltungen" MAP 0x1A0AF4 ZF_tab2d_fl32_S5_S3 2 UMR___1_1_0_S5_S3 0 2
 /begin AXIS_DESCR FIX_AXIS NO_INPUT_QUANTITY UMR___1_1_0_S5_S3 2 0 1 READ_ONLY FORMAT "%3.2" FIX_AXIS_PAR_DIST 0 1 2 /end AXIS_DESCR
 /begin AXIS_DESCR FIX_AXIS NO_INPUT_QUANTITY UMR___1_1_0_S5_S3 5 0 4 READ_ONLY FORMAT "%3.2" FIX_AXIS_PAR_DIST 0 1 5 /end AXIS_DESCR
 FORMAT "%3.2" /end CHARACTERISTIC
/begin CHARACTERISTIC TAB_F_KPSCHALT_K0 "[], gewichtung der Reglerparameter KP während Schaltungen" MAP 0x1A0B24 ZF_tab2d_fl32_S5_S3 2 UMR___1_1_0_S5_S3 0 2
 /begin AXIS_DESCR FIX_AXIS NO_INPUT_QUANTITY UMR___1_1_0_S5_S3 2 0 1 READ_ONLY FORMAT "%3.2" FIX_AXIS_PAR_DIST 0 1 2 /end AXIS_DESCR
 /begin AXIS_DESCR FIX_AXIS NO_INPUT_QUANTITY UMR___1_1_0_S5_S3 5 0 4 READ_ONLY FORMAT "%3.2" FIX_AXIS_PAR_DIST 0 1 5 /end AXIS_DESCR
 FORMAT "%3.2" /end CHARACTERISTIC
/begin CHARACTERISTIC TAB_F_KPSCHALT_K0_SP "[], gewichtung der Reglerparameter KP während Schaltungen" MAP 0x1A0B54 ZF_tab2d_fl32_S5_S3 2 UMR___1_1_0_S5_S3 0 2
 /begin AXIS_DESCR FIX_AXIS NO_INPUT_QUANTITY UMR___1_1_0_S5_S3 2 0 1 READ_ONLY FORMAT "%3.2" FIX_AXIS_PAR_DIST 0 1 2 /end AXIS_DESCR
 /begin AXIS_DESCR FIX_AXIS NO_INPUT_QUANTITY UMR___1_1_0_S5_S3 5 0 4 READ_ONLY FORMAT "%3.2" FIX_AXIS_PAR_DIST 0 1 5 /end AXIS_DESCR
 FORMAT "%3.2" /end CHARACTERISTIC
/begin CHARACTERISTIC TAB_F_MGVMSOLLGEMVORSCHALT_K0 "Gewichtungsfaktor für D-Anteil der Vorsteuerung Schaltungabhängig" CURVE 0x1A1490 ZF_tab_fl32_S5_S3 1 UMR___1_1_0_S5_S3 0 1
 /begin AXIS_DESCR FIX_AXIS iK0sShLog.idx_schaltung_k0 UMR___1_1_0_S5_S3 5 0 4 READ_ONLY FIX_AXIS_PAR_DIST 0 1 5 /end AXIS_DESCR
 FORMAT "%3.2" /end CHARACTERISTIC
/begin CHARACTERISTIC TAB_F_MMAX_KRIECH_IAE "Gangfaktor Max-Kriechmoment" CURVE 0x19CB70 ZF_tab_ui8_S5_S3 2 UMR___1_100_0_S5_S3 0 2
 /begin AXIS_DESCR FIX_AXIS NO_INPUT_QUANTITY UMR___1_1_0_S5_S3 10 -1 8 READ_ONLY FIX_AXIS_PAR_DIST -1 1 10 /end AXIS_DESCR
/end CHARACTERISTIC
/begin CHARACTERISTIC TAB_F_MMIN_KRIECH_IAE "Gangfaktor Min-Kriechmoment" CURVE 0x19CB80 ZF_tab_ui8_S5_S3 2 UMR___1_100_0_S5_S3 0 2
 /begin AXIS_DESCR FIX_AXIS NO_INPUT_QUANTITY UMR___1_1_0_S5_S3 10 -1 8 READ_ONLY FIX_AXIS_PAR_DIST -1 1 10 /end AXIS_DESCR
/end CHARACTERISTIC
/begin CHARACTERISTIC TAB_F_MVMSOLLGEMVOR "[-] Gewichtungsfunktion für gem. Verbrennungsmotormoment" CURVE 0x19EB20 ZF_tab_ui8_S5_S3 1 UMR___1_100_0_S5_S3 0 1
 /begin AXIS_DESCR FIX_AXIS iK0sKorSignale.zs_zug_k0 UMR___1_1_0_S5_S3 2 0 1 READ_ONLY FIX_AXIS_PAR_DIST 0 1 2 /end AXIS_DESCR
/end CHARACTERISTIC
/begin CHARACTERISTIC TAB_F_MVST_KRIECH_IAE "Gangfaktor Kriechmoment Vorsteuerung" CURVE 0x19CB90 ZF_tab_ui8_S5_S3 2 UMR___1_100_0_S5_S3 0 2
 /begin AXIS_DESCR FIX_AXIS NO_INPUT_QUANTITY UMR___1_1_0_S5_S3 10 -1 8 READ_ONLY FIX_AXIS_PAR_DIST -1 1 10 /end AXIS_DESCR
/end CHARACTERISTIC
/begin CHARACTERISTIC TAB_JGETRIEBE_K0 "Ersatzträgheitsmoment Sekundärseite für alle Gänge" MAP 0x19EB70 ZF_tab2d_fl32_S5_S3 5 UMR_KGM2__1_1_0_S5_S3 0 5
 /begin AXIS_DESCR FIX_AXIS NO_INPUT_QUANTITY UMR___1_1_0_S5_S3 10 -1 8 READ_ONLY FORMAT "%3.2" FIX_AXIS_PAR_DIST -1 1 10 /end AXIS_DESCR
 /begin AXIS_DESCR FIX_AXIS iK0sShLog.idx_schaltung_k0_aktiv UMR___1_1_0_S5_S3 5 0 4 READ_ONLY FIX_AXIS_PAR_DIST 0 1 5 /end AXIS_DESCR
 FORMAT "%4.3" /end CHARACTERISTIC
/begin CHARACTERISTIC TAB_K0SCHLRAMPKUPSTATUSIAE_K0 "Anforderung k0_soll_gepr = SCHLIESSRAMPE in Abhängigkeit des IAE Status" CURVE 0x19F0F0 ZF_tab_bool8_S5_S3 1 UMR___1_1_0_S5_S3 0 1
 /begin AXIS_DESCR FIX_AXIS iIaeKordi.kup_status_iae UMR___1_1_0_S5_S3 9 0 8 READ_ONLY FIX_AXIS_PAR_DIST 0 1 9 /end AXIS_DESCR
/end CHARACTERISTIC
/begin CHARACTERISTIC TAB_KI_SCHUTZ_K0 "Keine Beschreibung in Spec." CURVE 0x19EC90 ZF_tab_si16_S5_S3 10 UMR___1_100_0_S5_S3 0 10
 /begin AXIS_DESCR FIX_AXIS NO_INPUT_QUANTITY UMR___1_1_0_S5_S3 2 0 1 READ_ONLY FIX_AXIS_PAR_DIST 0 1 2 /end AXIS_DESCR
/end CHARACTERISTIC
/begin CHARACTERISTIC TAB_KORRANISTGANG_IEP "[U/min] KorrMotordrehzahlschw=f(istgang)" CURVE 0x19E2F8 ZF_tab_si16_S5_S3 200 UMR_U_MIN_1_1_0_S5_S3 -100 100
 /begin AXIS_DESCR FIX_AXIS zff_atsys._.iSignale._.obj.sig_istgang UMR___1_1_0_S5_S3 10 -1 8 READ_ONLY FIX_AXIS_PAR_DIST -1 1 10 /end AXIS_DESCR
/end CHARACTERISTIC
/begin CHARACTERISTIC TAB_KORRAUSISTGANG_IEP "Hysterese zum Ausschalten der el. Zusatzpumpe" CURVE 0x19E504 ZF_tab_si16_S5_S3 200 UMR___1_1_0_S5_S3 -100 100
 /begin AXIS_DESCR FIX_AXIS zff_atsys._.iSignale._.obj.sig_istgang UMR___1_1_0_S5_S3 10 -1 8 READ_ONLY FIX_AXIS_PAR_DIST -1 1 10 /end AXIS_DESCR
/end CHARACTERISTIC
/begin CHARACTERISTIC TAB_LECKAGEHSG_IEP "minimaler Fahrpedalgradient zur Aktivierung der Fahrdynamik" CURVE 0x19E12C ZF_tab_fl32_S5_S3 9.9 UMR___1_1_0_S5_S3 0.1 10
 /begin AXIS_DESCR FIX_AXIS zff_atsys._.iSignale._.obj.sig_zielgang_sas UMR___1_1_0_S5_S3 10 -1 8 READ_ONLY FIX_AXIS_PAR_DIST -1 1 10 /end AXIS_DESCR
 FORMAT "%3.2" /end CHARACTERISTIC
/begin CHARACTERISTIC TAB_MDTMGVMSOLLGEMVOR_K0 "Filterzeitkonstante für DT1-Filterung von m_vmsollgemvor_sync_k0" MAP 0x19EB00 ZF_tab2d_ui16_S5_S3 0.99 UMR___1_100_0_S5_S3 0.01 1
 /begin AXIS_DESCR FIX_AXIS iK0sKorSignale.idx_zs_zug_k0 UMR___1_1_0_S5_S3 2 0 1 READ_ONLY FIX_AXIS_PAR_DIST 0 1 2 /end AXIS_DESCR
 /begin AXIS_DESCR FIX_AXIS NO_INPUT_QUANTITY UMR___1_1_0_S5_S3 2 0 1 READ_ONLY FIX_AXIS_PAR_DIST 0 1 2 /end AXIS_DESCR
/end CHARACTERISTIC
/begin CHARACTERISTIC TAB_MDTMGVMSOLLGEMVOR_K0_SP "Filterzeitkonstante für DT1-Filterung von m_vmsollgemvor_sync_k0" MAP 0x19EB10 ZF_tab2d_ui16_S5_S3 0.99 UMR___1_100_0_S5_S3 0.01 1
 /begin AXIS_DESCR FIX_AXIS iK0sKorSignale.idx_zs_zug_k0 UMR___1_1_0_S5_S3 2 0 1 READ_ONLY FIX_AXIS_PAR_DIST 0 1 2 /end AXIS_DESCR
 /begin AXIS_DESCR FIX_AXIS NO_INPUT_QUANTITY UMR___1_1_0_S5_S3 2 0 1 READ_ONLY FIX_AXIS_PAR_DIST 0 1 2 /end AXIS_DESCR
/end CHARACTERISTIC
/begin CHARACTERISTIC TAB_MPT_MSCHALTAUF_K0 "Filterzeitkonstante für PT1-Filter für Aufschaltung Schaltmoment" MAP 0x1A14A8 ZF_tab2d_fl32_S5_S3 0.99 UMR___1_1_0_S5_S3 0.01 1
 /begin AXIS_DESCR FIX_AXIS iK0sKorSignale.zs_zug_k0 UMR___1_1_0_S5_S3 2 0 1 READ_ONLY FIX_AXIS_PAR_DIST 0 1 2 /end AXIS_DESCR
 /begin AXIS_DESCR FIX_AXIS iK0sShLog.idx_schaltung_k0 UMR___1_1_0_S5_S3 5 0 4 READ_ONLY FIX_AXIS_PAR_DIST 0 1 5 /end AXIS_DESCR
 FORMAT "%3.2" /end CHARACTERISTIC
/begin CHARACTERISTIC TAB_MPT_MVMSOLLGEMVOR_K0 "Filterzeitkonstante für PT1-Filter für gem. Verbrennungsmotormoment für die Vorsteuerung" CURVE 0x19EAF8 ZF_tab_ui8_S5_S3 0.99 UMR___1_100_0_S5_S3 0.01 1
 /begin AXIS_DESCR FIX_AXIS iK0sKorSignale.zs_zug_k0 UMR___1_1_0_S5_S3 2 0 1 READ_ONLY FIX_AXIS_PAR_DIST 0 1 2 /end AXIS_DESCR
/end CHARACTERISTIC
/begin CHARACTERISTIC TAB_MPT_NMOT_K0 "Filterzeitkonstante für Motordrehzahl" MAP 0x19EB30 ZF_tab2d_ui8_S5_S3 0.99 UMR___1_100_0_S5_S3 0.01 1
 /begin AXIS_DESCR FIX_AXIS iK0sKorSignale.zs_zug_k0 UMR___1_1_0_S5_S3 2 0 1 READ_ONLY FIX_AXIS_PAR_DIST 0 1 2 /end AXIS_DESCR
 /begin AXIS_DESCR FIX_AXIS iK0sShLog.idx_schaltung_k0 UMR___1_1_0_S5_S3 5 0 4 READ_ONLY FIX_AXIS_PAR_DIST 0 1 5 /end AXIS_DESCR
/end CHARACTERISTIC
/begin CHARACTERISTIC TAB_MPT_NVM_K0 "Filterzeitkonstante für diue Filterung der VM Drehzahl" MAP 0x19EB44 ZF_tab2d_ui8_S5_S3 0.99 UMR___1_100_0_S5_S3 0.01 1
 /begin AXIS_DESCR FIX_AXIS iK0sKorSignale.zs_zug_k0 UMR___1_1_0_S5_S3 2 0 1 READ_ONLY FIX_AXIS_PAR_DIST 0 1 2 /end AXIS_DESCR
 /begin AXIS_DESCR FIX_AXIS iK0sShLog.idx_schaltung_k0 UMR___1_1_0_S5_S3 5 0 4 READ_ONLY FIX_AXIS_PAR_DIST 0 1 5 /end AXIS_DESCR
/end CHARACTERISTIC
/begin CHARACTERISTIC TAB_MPT_ZUREGELN_K0 "Filterzeitkonstante für Drucksprung ZU nach REGELN" MAP 0x1A088C ZF_tab2d_fl32_S5_S3 0.99 UMR___1_1_0_S5_S3 0.01 1
 /begin AXIS_DESCR FIX_AXIS iK0sKorSignale.zs_zug_k0 UMR___1_1_0_S5_S3 2 0 1 READ_ONLY FIX_AXIS_PAR_DIST 0 1 2 /end AXIS_DESCR
 /begin AXIS_DESCR FIX_AXIS iK0sShLog.idx_schaltung_k0 UMR___1_1_0_S5_S3 5 0 4 READ_ONLY FIX_AXIS_PAR_DIST 0 1 5 /end AXIS_DESCR
 FORMAT "%3.2" /end CHARACTERISTIC
/begin CHARACTERISTIC TAB_MVG_CBELK0 "Klassengrenzen fuer K0 Belag-Temperatur MvG" CURVE 0x19F5CC ZF_tab_ui16_S5_S3 540 UMR_GRADC__1_1_M40_S5_S3 -40 500
 /begin AXIS_DESCR FIX_AXIS NO_INPUT_QUANTITY UMR___1_1_0_S5_S3 7 0 6 READ_ONLY FIX_AXIS_PAR_DIST 0 1 7 /end AXIS_DESCR
/end CHARACTERISTIC
/begin CHARACTERISTIC TAB_MVG_C_IAE "Klassengrenzen fuer IAE Temperatur MvG" CURVE 0x19DE00 ZF_tab_ui16_S5_S3 540 UMR_GRADC__1_1_M40_S5_S3 -40 500
 /begin AXIS_DESCR FIX_AXIS NO_INPUT_QUANTITY UMR___1_1_0_S5_S3 7 0 6 READ_ONLY FIX_AXIS_PAR_DIST 0 1 7 /end AXIS_DESCR
/end CHARACTERISTIC
/begin CHARACTERISTIC TAB_MVG_MISTK0 "Grenzen der Teilintervalle für das Motoristmoment" CURVE 0x1A147C ZF_tab_si16_S5_S3 2500 UMR_NM__1_1_0_S5_S3 -500 2000
 /begin AXIS_DESCR FIX_AXIS NO_INPUT_QUANTITY UMR___1_1_0_S5_S3 7 0 6 READ_ONLY FIX_AXIS_PAR_DIST 0 1 7 /end AXIS_DESCR
/end CHARACTERISTIC
/begin CHARACTERISTIC TAB_MVG_NDK0 "Grenzen der Teilintervalle für die Differenzdrehzahl der K0" CURVE 0x1A1468 ZF_tab_si16_S5_S3 4000 UMR_U_MIN_1_1_0_S5_S3 -2000 2000
 /begin AXIS_DESCR FIX_AXIS NO_INPUT_QUANTITY UMR___1_1_0_S5_S3 7 0 6 READ_ONLY FIX_AXIS_PAR_DIST 0 1 7 /end AXIS_DESCR
/end CHARACTERISTIC
/begin CHARACTERISTIC TAB_NSTFDYN_K0 "Maximale Turbinendrehzahl zur Aktivierung der Fahrdynamik" CURVE 0x19F9BC ZF_tab_ui16_S5_S3 8128 UMR_U_MIN_1_1_0_S5_S3 0 8128
 /begin AXIS_DESCR FIX_AXIS NO_INPUT_QUANTITY UMR___1_1_0_S5_S3 10 0 9 READ_ONLY FIX_AXIS_PAR_DIST 0 1 10 /end AXIS_DESCR
/end CHARACTERISTIC
/begin CHARACTERISTIC TAB_SCHALTUNG_PSS_IEP "Tabelle zur Vorgabe bei welcher Schaltung die IEP den Systemdruck stützen soll" MAP 0x19E578 ZF_tab2d_bool8_S5_S3 1 UMR___1_1_0_S5_S3 0 1
 /begin AXIS_DESCR FIX_AXIS zff_atsys._.iSignale._.obj.sig_istgang UMR___1_1_0_S5_S3 10 -1 8 READ_ONLY FIX_AXIS_PAR_DIST -1 1 10 /end AXIS_DESCR
 /begin AXIS_DESCR FIX_AXIS zff_atsys._.iSignale._.obj.sig_zielgang_sas UMR___1_1_0_S5_S3 10 -1 8 READ_ONLY FIX_AXIS_PAR_DIST -1 1 10 /end AXIS_DESCR
/end CHARACTERISTIC
/begin CHARACTERISTIC TAB_SOLLGEPR_K0 "Zuordnung von k0_soll zu k0_soll_gepr" CURVE 0x19E948 ZF_tab_ui8_S5_S3 5 UMR___1_1_0_S5_S3 0 5
 /begin AXIS_DESCR FIX_AXIS iItfInput.k0_soll UMR___1_1_0_S5_S3 6 0 5 READ_ONLY FIX_AXIS_PAR_DIST 0 1 6 /end AXIS_DESCR
/end CHARACTERISTIC
/begin CHARACTERISTIC TAB_STATUSIAE_PSS_IEP "Tabelle zur Vorgabe bei welchem IAE Status die IEP den Systemdruck stützen soll" CURVE 0x19E5E4 ZF_tab_bool8_S5_S3 1 UMR___1_1_0_S5_S3 0 1
 /begin AXIS_DESCR FIX_AXIS iIaeKordi.kup_status_iae UMR___1_1_0_S5_S3 9 0 8 READ_ONLY FIX_AXIS_PAR_DIST 0 1 9 /end AXIS_DESCR
/end CHARACTERISTIC
/begin CHARACTERISTIC TAB_STUETZFAKTOR_IAE "Stützfaktor" CURVE 0x19D6B4 ZF_tab_si16_S5_S3 5 UMR___1_1000_0_S5_S3 0 5
 /begin AXIS_DESCR FIX_AXIS NO_INPUT_QUANTITY UMR___1_1_0_S5_S3 10 -1 8 READ_ONLY FIX_AXIS_PAR_DIST -1 1 10 /end AXIS_DESCR
/end CHARACTERISTIC
/begin CHARACTERISTIC TAB_SWIFDYNERLAUBT_K0 "Schalter, für Erlaubnis der Fahrdynamikfunktion = f(istgang, (k0_ist == 4)" MAP 0x19F9EC ZF_tab2d_bool8_S5_S3 1 UMR___1_1_0_S5_S3 0 1
 /begin AXIS_DESCR FIX_AXIS NO_INPUT_QUANTITY UMR___1_1_0_S5_S3 10 -1 8 READ_ONLY FIX_AXIS_PAR_DIST -1 1 10 /end AXIS_DESCR
 /begin AXIS_DESCR FIX_AXIS NO_INPUT_QUANTITY UMR___1_1_0_S5_S3 2 0 1 READ_ONLY FIX_AXIS_PAR_DIST 0 1 2 /end AXIS_DESCR
/end CHARACTERISTIC
/begin CHARACTERISTIC TAB_SWIFDYNOFFSETAKTIV_K0 "Schalter, für Fahrdynamikoffset ausgegeben = f(istgang, (wk_ist == 2)" MAP 0x19FA08 ZF_tab2d_bool8_S5_S3 1 UMR___1_1_0_S5_S3 0 1
 /begin AXIS_DESCR FIX_AXIS NO_INPUT_QUANTITY UMR___1_1_0_S5_S3 10 0 9 READ_ONLY FIX_AXIS_PAR_DIST 0 1 10 /end AXIS_DESCR
 /begin AXIS_DESCR FIX_AXIS NO_INPUT_QUANTITY UMR___1_1_0_S5_S3 2 0 1 READ_ONLY FIX_AXIS_PAR_DIST 0 1 2 /end AXIS_DESCR
/end CHARACTERISTIC
/begin CHARACTERISTIC TAB_SWIGESTGES_K0_SP "Schalter = f(index_sp_sps) zum Umschalten auf den gesteuerten ZU-Zustand" CURVE 0x19F35C ZF_tab_ui8_S5_S3 1 UMR___1_1_0_S5_S3 0 1
 /begin AXIS_DESCR FIX_AXIS zff_atsys._.iSignale._.obj.sig_index_sp_sps UMR___1_1_0_S5_S3 100 0 99 READ_ONLY FIX_AXIS_PAR_DIST 0 1 100 /end AXIS_DESCR
/end CHARACTERISTIC
/begin CHARACTERISTIC TAB_SWILASTWECHSEL_K0_SP "Schalter zur Datensatzumschaltung bei Lastwechsel" CURVE 0x19F494 ZF_tab_ui8_S5_S3 1 UMR___1_1_0_S5_S3 0 1
 /begin AXIS_DESCR FIX_AXIS zff_atsys._.iSignale._.obj.sig_index_sp_sps UMR___1_1_0_S5_S3 100 0 99 READ_ONLY FIX_AXIS_PAR_DIST 0 1 100 /end AXIS_DESCR
/end CHARACTERISTIC
/begin CHARACTERISTIC TAB_SWIMSCHALTRSZ_K0_SP "Schalter = f(index_sp_sps) zur Datensatzumschaltung bei Lastwechsel" CURVE 0x19F564 ZF_tab_ui8_S5_S3 1 UMR___1_1_0_S5_S3 0 1
 /begin AXIS_DESCR FIX_AXIS zff_atsys._.iSignale._.obj.sig_index_sp_sps UMR___1_1_0_S5_S3 100 0 99 READ_ONLY FIX_AXIS_PAR_DIST 0 1 100 /end AXIS_DESCR
/end CHARACTERISTIC
/begin CHARACTERISTIC TAB_SWIREGSCHALT_K0_SP "Schalter = f(index_sp_sps) zur Datensatzumschaltung bei Lastwechsel" CURVE 0x19F42C ZF_tab_ui8_S5_S3 1 UMR___1_1_0_S5_S3 0 1
 /begin AXIS_DESCR FIX_AXIS zff_atsys._.iSignale._.obj.sig_index_sp_sps UMR___1_1_0_S5_S3 100 0 99 READ_ONLY FIX_AXIS_PAR_DIST 0 1 100 /end AXIS_DESCR
/end CHARACTERISTIC
/begin CHARACTERISTIC TAB_SWISCHALTUNGDIREKT_K0 "Schalter für Schaltungen ohne Schlupf (nur in vollständig ZU moglich)" MAP 0x19EC98 ZF_tab2d_bool8_S5_S3 1 UMR___1_1_0_S5_S3 0 1
 /begin AXIS_DESCR FIX_AXIS iK0sKorSignale.idx_zs_zug_k0 UMR___1_1_0_S5_S3 2 0 1 READ_ONLY FIX_AXIS_PAR_DIST 0 1 2 /end AXIS_DESCR
 /begin AXIS_DESCR FIX_AXIS iK0sShLog.idx_schaltung_k0 UMR___1_1_0_S5_S3 5 0 4 READ_ONLY FIX_AXIS_PAR_DIST 0 1 5 /end AXIS_DESCR
/end CHARACTERISTIC
/begin CHARACTERISTIC TAB_SWISTARTSCHALT_K0 "Schalter, ob Schaltung mit Start ME-Haupt beginnt" MAP 0x19EC50 ZF_tab2d_ui8_S5_S3 1 UMR___1_1_0_S5_S3 0 1
 /begin AXIS_DESCR FIX_AXIS iK0sKorSignale.zs_zug_k0 UMR___1_1_0_S5_S3 2 0 1 READ_ONLY FIX_AXIS_PAR_DIST 0 1 2 /end AXIS_DESCR
 /begin AXIS_DESCR FIX_AXIS iK0sShLog.idx_schaltung_k0 UMR___1_1_0_S5_S3 5 0 4 READ_ONLY FIX_AXIS_PAR_DIST 0 1 5 /end AXIS_DESCR
/end CHARACTERISTIC
/begin CHARACTERISTIC TAB_SWIVERBOTFDYN_K0_SP "Schalter = f(index_sp_sps) zur Datensatzumschaltung bei Lastwechsel" CURVE 0x19F4FC ZF_tab_ui8_S5_S3 1 UMR___1_1_0_S5_S3 0 1
 /begin AXIS_DESCR FIX_AXIS zff_atsys._.iSignale._.obj.sig_index_sp_sps UMR___1_1_0_S5_S3 100 0 99 READ_ONLY FIX_AXIS_PAR_DIST 0 1 100 /end AXIS_DESCR
/end CHARACTERISTIC
/begin CHARACTERISTIC TAB_SWIWNDOSCHALT_K0_SP "Schalter = f(index_sp_sps) zur Datensatzumschaltung bei Lastwechsel" CURVE 0x19F3C4 ZF_tab_ui8_S5_S3 1 UMR___1_1_0_S5_S3 0 1
 /begin AXIS_DESCR FIX_AXIS zff_atsys._.iSignale._.obj.sig_index_sp_sps UMR___1_1_0_S5_S3 100 0 99 READ_ONLY FIX_AXIS_PAR_DIST 0 1 100 /end AXIS_DESCR
/end CHARACTERISTIC
/begin CHARACTERISTIC TAB_SWI_ASRREGELT_IAE "Schalter zur Auswahl, ob ein ASR-Regeleingriff Einfluss auf die Öffnen-/Schließendrehzahlschwellen und Zustandübergänge Synchronisieren/Zu hat" CURVE 0x19DD3C ZF_tab_bool8_S5_S3 1 UMR___1_1_0_S5_S3 0 1
 /begin AXIS_DESCR FIX_AXIS NO_INPUT_QUANTITY UMR___1_1_0_S5_S3 10 0 9 READ_ONLY FIX_AXIS_PAR_DIST 0 1 10 /end AXIS_DESCR
/end CHARACTERISTIC
/begin CHARACTERISTIC TAB_SWI_F_KI_K0 "Schalter Schalter zur Aktivierung der Gewichtung des Regler-I-Anteils" CURVE 0x1A0D04 ZF_tab_bool8_S5_S3 1 UMR___1_1_0_S5_S3 0 1
 /begin AXIS_DESCR FIX_AXIS iK0sShLog.idx_schaltung_k0 UMR___1_1_0_S5_S3 5 0 4 READ_ONLY FIX_AXIS_PAR_DIST 0 1 5 /end AXIS_DESCR
/end CHARACTERISTIC
/begin CHARACTERISTIC TAB_T_AN_MIN_LP_IEP "Tabelle zur Eingabe der Mindestlaufzeit der IEP in einem LP" MAP 0x19E520 ZF_tab2d_ui8_S5_S3 30 UMR_SEC__1_1_0_S5_S3 0 30
 /begin AXIS_DESCR FIX_AXIS iIepKordi.iep_ist UMR___1_1_0_S5_S3 5 0 4 READ_ONLY FIX_AXIS_PAR_DIST 0 1 5 /end AXIS_DESCR
 /begin AXIS_DESCR FIX_AXIS iIepBerLp.iep_soll UMR___1_1_0_S5_S3 4 0 3 READ_ONLY FIX_AXIS_PAR_DIST 0 1 4 /end AXIS_DESCR
/end CHARACTERISTIC
/begin CHARACTERISTIC TAB_T_FDYNAB_K0 "Filterzeitkonstante für Erniedrigung des Drehzahloffsets bei aktiver Fahrdynamik" CURVE 0x19F940 ZF_tab_ui16_S5_S3 3970 UMR_MSEC__1_1_0_S5_S3 30 4000
 /begin AXIS_DESCR FIX_AXIS NO_INPUT_QUANTITY UMR___1_1_0_S5_S3 10 -1 8 READ_ONLY FIX_AXIS_PAR_DIST -1 1 10 /end AXIS_DESCR
/end CHARACTERISTIC
/begin CHARACTERISTIC TAB_T_FDYNAUF_K0 "Filterzeitkonstante für Erhöhung des Drehzahloffsets bei aktiver Fahrdynamik" CURVE 0x19F958 ZF_tab_ui16_S5_S3 3970 UMR_MSEC__1_1_0_S5_S3 30 4000
 /begin AXIS_DESCR FIX_AXIS NO_INPUT_QUANTITY UMR___1_1_0_S5_S3 10 -1 8 READ_ONLY FIX_AXIS_PAR_DIST -1 1 10 /end AXIS_DESCR
/end CHARACTERISTIC
/begin CHARACTERISTIC TAB_T_FDYNVERLASSEN_K0 "Filterzeitkonstante für Drehzahloffset beim Ausstieg aus Fahrdynamik" CURVE 0x19F970 ZF_tab_ui16_S5_S3 3970 UMR_MSEC__1_1_0_S5_S3 30 4000
 /begin AXIS_DESCR FIX_AXIS NO_INPUT_QUANTITY UMR___1_1_0_S5_S3 10 -1 8 READ_ONLY FIX_AXIS_PAR_DIST -1 1 10 /end AXIS_DESCR
/end CHARACTERISTIC
/begin CHARACTERISTIC TAB_T_PT2_MSCHALTAB_K0 "Filterzeitkonstante für PT2-Filter für Abschaltung Schaltmoment" MAP 0x1A1514 ZF_tab2d_fl32_S5_S3 1.98 UMR_SEC__1_1_0_S5_S3 0.02 2
 /begin AXIS_DESCR FIX_AXIS iK0sKorSignale.zs_zug_k0 UMR___1_1_0_S5_S3 2 0 1 READ_ONLY FIX_AXIS_PAR_DIST 0 1 2 /end AXIS_DESCR
 /begin AXIS_DESCR FIX_AXIS iK0sShLog.idx_schaltung_k0 UMR___1_1_0_S5_S3 5 0 4 READ_ONLY FIX_AXIS_PAR_DIST 0 1 5 /end AXIS_DESCR
 FORMAT "%4.3" /end CHARACTERISTIC
/begin CHARACTERISTIC TAB_T_WNDOSCHALTAUF_K0 "Aufregelzeitkonstante Sollwertoffset" MAP 0x19FAD8 ZF_tab2d_ui16_S5_S3 3970 UMR_MSEC__1_1_0_S5_S3 30 4000
 /begin AXIS_DESCR FIX_AXIS iK0sKorSignale.idx_zs_zug_k0 UMR___1_1_0_S5_S3 2 0 1 READ_ONLY FIX_AXIS_PAR_DIST 0 1 2 /end AXIS_DESCR
 /begin AXIS_DESCR FIX_AXIS iK0sShLog.idx_schaltung_k0 UMR___1_1_0_S5_S3 5 0 4 READ_ONLY FIX_AXIS_PAR_DIST 0 1 5 /end AXIS_DESCR
/end CHARACTERISTIC
/begin CHARACTERISTIC TAB_T_WNDOSCHALTAUF_K0_SP "Aufregelzeitkonstante Sollwertoffset" MAP 0x19FB7C ZF_tab2d_ui16_S5_S3 3970 UMR_MSEC__1_1_0_S5_S3 30 4000
 /begin AXIS_DESCR FIX_AXIS iK0sKorSignale.idx_zs_zug_k0 UMR___1_1_0_S5_S3 2 0 1 READ_ONLY FIX_AXIS_PAR_DIST 0 1 2 /end AXIS_DESCR
 /begin AXIS_DESCR FIX_AXIS iK0sShLog.idx_schaltung_k0 UMR___1_1_0_S5_S3 5 0 4 READ_ONLY FIX_AXIS_PAR_DIST 0 1 5 /end AXIS_DESCR
/end CHARACTERISTIC
/begin CHARACTERISTIC TAB_T_WNDSTD_K0 "Zeitkonstante für Standardsollwertfilter waehrend Normalbetrieb / Warmlauf" MAP 0x19FA24 ZF_tab2d_ui16_S5_S3 4000 UMR_MSEC__1_1_0_S5_S3 0 4000
 /begin AXIS_DESCR FIX_AXIS iK0sKorSignale.idx_zs_zug_k0 UMR___1_1_0_S5_S3 2 0 1 READ_ONLY FIX_AXIS_PAR_DIST 0 1 2 /end AXIS_DESCR
 /begin AXIS_DESCR FIX_AXIS iK0sShLog.idx_schaltung_k0 UMR___1_1_0_S5_S3 5 0 4 READ_ONLY FIX_AXIS_PAR_DIST 0 1 5 /end AXIS_DESCR
/end CHARACTERISTIC
/begin CHARACTERISTIC TAB_T_ZUREGELNMAX_K0 "[ms] Maximalzeit für den Zustand ZU_REGELN" MAP 0x1A081C ZF_tab2d_ui16_S5_S3 4000 UMR_MSEC__10_1_0_S5_S3 0 4000
 /begin AXIS_DESCR FIX_AXIS iK0sKorSignale.zs_zug_k0 UMR___1_1_0_S5_S3 2 0 1 READ_ONLY FIX_AXIS_PAR_DIST 0 1 2 /end AXIS_DESCR
 /begin AXIS_DESCR FIX_AXIS iK0sShLog.idx_schaltung_k0 UMR___1_1_0_S5_S3 5 0 4 READ_ONLY FIX_AXIS_PAR_DIST 0 1 5 /end AXIS_DESCR
/end CHARACTERISTIC
/begin CHARACTERISTIC TAB_VORGABELP_IEP "Vorgabe Leistungspunkt der el. Zusatzpumpe" MAP 0x19DE48 ZF_tab2d_ui8_S5_S3 5 UMR___1_1_0_S5_S3 0 5
 /begin AXIS_DESCR FIX_AXIS NO_INPUT_QUANTITY UMR___1_1_0_S5_S3 9 0 8 READ_ONLY FIX_AXIS_PAR_DIST 0 1 9 /end AXIS_DESCR
 /begin AXIS_DESCR FIX_AXIS iBihSigna.bremsbed_ofstb UMR___1_1_0_S5_S3 2 0 1 READ_ONLY FIX_AXIS_PAR_DIST 0 1 2 /end AXIS_DESCR
/end CHARACTERISTIC
/begin CHARACTERISTIC TAB_VZINITSCHALT_K0 "Verzögerungszeit [ms] Schaltungsende nach Ende Hauptmotoreingriff" MAP 0x19EC64 ZF_tab2d_ui8_S5_S3 1990 UMR_MSEC__10_1_0_S5_S3 10 2000
 /begin AXIS_DESCR FIX_AXIS iK0sKorSignale.zs_zug_k0 UMR___1_1_0_S5_S3 2 0 1 READ_ONLY FIX_AXIS_PAR_DIST 0 1 2 /end AXIS_DESCR
 /begin AXIS_DESCR FIX_AXIS iK0sShLog.idx_schaltung_k0 UMR___1_1_0_S5_S3 5 0 4 READ_ONLY FIX_AXIS_PAR_DIST 0 1 5 /end AXIS_DESCR
/end CHARACTERISTIC
/begin CHARACTERISTIC TAB_VZMVMSOLLGEMVOR "appl. [ms], Verzögerungszeit für gem. Verbrennungsmotormoment für die Vorsteuerung" CURVE 0x19EB28 ZF_tab_ui8_S5_S3 90 UMR_MSEC__10_1_0_S5_S3 0 90
 /begin AXIS_DESCR FIX_AXIS NO_INPUT_QUANTITY UMR___1_1_0_S5_S3 2 0 1 READ_ONLY FIX_AXIS_PAR_DIST 0 1 2 /end AXIS_DESCR
/end CHARACTERISTIC
/begin CHARACTERISTIC TAB_WNDOSCHALT_K0 "Sollwertoffset" MAP 0x19FAC4 ZF_tab2d_ui8_S5_S3 255 UMR_U_MIN_1_1_0_S5_S3 0 255
 /begin AXIS_DESCR FIX_AXIS iK0sKorSignale.idx_zs_zug_k0 UMR___1_1_0_S5_S3 2 0 1 READ_ONLY FIX_AXIS_PAR_DIST 0 1 2 /end AXIS_DESCR
 /begin AXIS_DESCR FIX_AXIS iK0sShLog.idx_schaltung_k0 UMR___1_1_0_S5_S3 5 0 4 READ_ONLY FIX_AXIS_PAR_DIST 0 1 5 /end AXIS_DESCR
/end CHARACTERISTIC
/begin CHARACTERISTIC TAB_WNDOSCHALT_K0_SP "Sollwertoffset" MAP 0x19FB68 ZF_tab2d_ui8_S5_S3 255 UMR_U_MIN_1_1_0_S5_S3 0 255
 /begin AXIS_DESCR FIX_AXIS iK0sKorSignale.idx_zs_zug_k0 UMR___1_1_0_S5_S3 2 0 1 READ_ONLY FIX_AXIS_PAR_DIST 0 1 2 /end AXIS_DESCR
 /begin AXIS_DESCR FIX_AXIS iK0sShLog.idx_schaltung_k0 UMR___1_1_0_S5_S3 5 0 4 READ_ONLY FIX_AXIS_PAR_DIST 0 1 5 /end AXIS_DESCR
/end CHARACTERISTIC
/begin CHARACTERISTIC TAB_WND_K0ZU "Standardsolldifferenzdrehzahl in GEREGELTGESCHLOSSEN" CURVE 0x19F5E0 ZF_tab_ui8_S5_S3 200 UMR_U_MIN_1_1_0_S5_S3 0 200
 /begin AXIS_DESCR FIX_AXIS iK0sKorSignale.idx_zs_zug_k0 UMR___1_1_0_S5_S3 2 0 1 READ_ONLY FIX_AXIS_PAR_DIST 0 1 2 /end AXIS_DESCR
/end CHARACTERISTIC
/begin CHARACTERISTIC TAB_ZIELGANGPOSN_IAE "Tab-Wert 1 = Freigabe des Zielgangs zur Aktivierung des Abwürgeschutzes" CURVE 0x19DD04 ZF_tab_bool8_S5_S3 1 UMR___1_1_0_S5_S3 0 1
 /begin AXIS_DESCR FIX_AXIS NO_INPUT_QUANTITY UMR___1_1_0_S5_S3 10 -1 8 READ_ONLY FIX_AXIS_PAR_DIST -1 1 10 /end AXIS_DESCR
/end CHARACTERISTIC
/begin CHARACTERISTIC TAB_ZK0_ZUL_APERK "Waehrend der IaeAP-Ada zulaessige K0 Zustaende" CURVE 0x1A145C ZF_tab_bool8_S5_S3 1 UMR___1_1_0_S5_S3 0 1
 /begin AXIS_DESCR FIX_AXIS NO_INPUT_QUANTITY UMR___1_1_0_S5_S3 6 0 5 READ_ONLY FIX_AXIS_PAR_DIST 0 1 6 /end AXIS_DESCR
/end CHARACTERISTIC
/begin CHARACTERISTIC TEMP_HYS_IEP "Hysterese für die Schwellen der Getriebesumpftemperatur" VALUE 0x1D77E2 ZF_kw_ui8_S5_S3 1 UMR_GRADC__1_1_0_S5_S3 0 1 /end CHARACTERISTIC
/begin CHARACTERISTIC TEMP_MAX_IEP "Maximale Getriebesumpftemperatur, bei der die Pumpe betrieben werden darf" VALUE 0x1D77E0 ZF_kw_ui8_S5_S3 150 UMR_GRADC__1_1_M40_S5_S3 0 150 /end CHARACTERISTIC
/begin CHARACTERISTIC TEMP_MAX_LP2_IEP "Temperaturschwelle ab der LP1 anstelle von LP2 vorgegeben wird" VALUE 0x1D77D7 ZF_kw_ui8_S5_S3 150 UMR_GRADC__1_1_M40_S5_S3 0 150 /end CHARACTERISTIC
/begin CHARACTERISTIC TEMP_MIN_IEP "Maximale Getriebesumpftemperatur, bei der die Pumpe betrieben werden darf" VALUE 0x1D77E1 ZF_kw_ui8_S5_S3 150 UMR_GRADC__1_1_M40_S5_S3 0 150 /end CHARACTERISTIC
/begin CHARACTERISTIC TSP_FDYN_K0 "Sperrzeit für Fahrdynamik" VALUE 0x1D8408 ZF_kw_ui16_S5_S3 9000 UMR_MSEC__10_1_0_S5_S3 0 9000 /end CHARACTERISTIC
/begin CHARACTERISTIC TS_MAXANKRIECHEN_IAE "Zeitschwelle zum Erreichen einer Abtriebsdrehzahlschwelle Im Zustand Kriechen" VALUE 0x1D8376 ZF_kw_ui16_S5_S3 10000 UMR_MSEC__10_1_0_S5_S3 0 10000 /end CHARACTERISTIC
/begin CHARACTERISTIC TYP_UEF_I_STUETZ_IAE "Typ der Überführungsfunktion für Umschaltung des Momentenstützfaktors bei Schaltungen" VALUE 0x1D77B0 ZF_kw_ui8_S5_S3 3 UMR___1_1_0_S5_S3 1 4 /end CHARACTERISTIC
/begin CHARACTERISTIC TYP_UEF_KALTANFAHR_IAE "Typ der Überführung Kriechen >> Kaltanfahren" VALUE 0x1D77AA ZF_kw_ui8_S5_S3 3 UMR___1_1_0_S5_S3 1 4 /end CHARACTERISTIC
/begin CHARACTERISTIC TYP_UEF_KRIECH_IAE "Typ der Überführungsfunktion zum Führen des Kriechsollwerts" VALUE 0x1D77A9 ZF_kw_ui8_S5_S3 3 UMR___1_1_0_S5_S3 1 4 /end CHARACTERISTIC
/begin CHARACTERISTIC TYP_UEF_MANF_KRIECH_ANGL_IAE "Typ der Überführungsfunktion für m_soll_iae beim Übergang von Anfahren nach Kriechen oder Angelegt" VALUE 0x1D77A7 ZF_kw_ui8_S5_S3 3 UMR___1_1_0_S5_S3 1 4 /end CHARACTERISTIC
/begin CHARACTERISTIC TYP_UEF_MSOLLANFAHR_IAE "Typ der Überführungsfunktion beim Übergang von Kriechen nach H-Anfahren" VALUE 0x1D77A4 ZF_kw_ui8_S5_S3 3 UMR___1_1_0_S5_S3 1 4 /end CHARACTERISTIC
/begin CHARACTERISTIC TYP_UEF_MSOLLEHANF_IAE "Typ der Überführungsfunktion des Sollanfahrmoments beim Wechsel aus E-Anfahren/E-Anfahren_entkoppelt nach H-Anfahren" VALUE 0x1D77A3 ZF_kw_ui8_S5_S3 3 UMR___1_1_0_S5_S3 1 4 /end CHARACTERISTIC
/begin CHARACTERISTIC TYP_UEF_M_ANGELEGT_KRIECH_IAE "Typ der Überführungsfunktion beim Übergang von Stillstand nach Kriechen für das gesteuerte Moment" VALUE 0x1D77A8 ZF_kw_ui8_S5_S3 3 UMR___1_1_0_S5_S3 1 4 /end CHARACTERISTIC
/begin CHARACTERISTIC TYP_UEF_M_AUF_IAE "Typ der Überführungsfunktion fuer das IAE-Aufnahmemoment bei GE/GA" VALUE 0x1D77AE ZF_kw_ui8_S5_S3 3 UMR___1_1_0_S5_S3 1 4 /end CHARACTERISTIC
/begin CHARACTERISTIC TYP_UEF_M_KRIECH_ANGELEGT_IAE "Typ der Überführungsfunktion beim Übergang von Kriechen nach Stillstand für m_soll_iae" VALUE 0x1D77A5 ZF_kw_ui8_S5_S3 3 UMR___1_1_0_S5_S3 1 4 /end CHARACTERISTIC
/begin CHARACTERISTIC TYP_UEF_M_VOR_ANF_IAE "Berechnung von m_ist_vorst_iae im Zustand Anfahren" VALUE 0x1D77AC ZF_kw_ui8_S5_S3 3 UMR___1_1_0_S5_S3 1 4 /end CHARACTERISTIC
/begin CHARACTERISTIC TYP_UEF_M_VOR_ANF_KRIANG_IAE "Berechnung von m_ist_vorst_iae beim Zustandsübergang von Anfahren nach Kriechen oder Angelegt" VALUE 0x1D77AD ZF_kw_ui8_S5_S3 3 UMR___1_1_0_S5_S3 1 4 /end CHARACTERISTIC
/begin CHARACTERISTIC TYP_UEF_ZU_KRIECH_ANGL_IAE "Typ der Überführungsfunktion für m_soll_iae beim Übergang aus ZU nach Kriechen oder Angelegt" VALUE 0x1D77A6 ZF_kw_ui8_S5_S3 3 UMR___1_1_0_S5_S3 1 4 /end CHARACTERISTIC
/begin CHARACTERISTIC T_AN_MAX_IEP "Maximale Zeit, die die Pumpe am Stück laufen darf" VALUE 0x19E51C ZF_kw_ui32_S5_S3 99999 UMR_SEC__1_1_0_S5_S3 0 99999 /end CHARACTERISTIC
/begin CHARACTERISTIC T_AUS_IEP "Wenn die maximale Anschaltdauer überschritten ist bleibt die Pumpe für die Zeit AUS" VALUE 0x19E53C ZF_kw_ui32_S5_S3 99999 UMR_SEC__1_1_0_S5_S3 0 99999 /end CHARACTERISTIC
/begin CHARACTERISTIC T_EINREGMAX_K0 "Maximalzeit Einregeln" VALUE 0x1D8400 ZF_kw_ui16_S5_S3 20000 UMR_MSEC__10_1_0_S5_S3 0 20000 /end CHARACTERISTIC
/begin CHARACTERISTIC T_FDYNMAX_K0 "maximale Dauer der Fahrdynamik" VALUE 0x1D8406 ZF_kw_ui16_S5_S3 6000 UMR_MSEC__10_1_0_S5_S3 0 6000 /end CHARACTERISTIC
/begin CHARACTERISTIC T_FEHLER_RESET_IEP "Zeit , die die Pumpe mit 0% PWM angesteuert werden muss damit ein Reset durchgeführt werden kann" VALUE 0x1D77E4 ZF_kw_ui8_S5_S3 1 UMR_SEC__1_100_0_S5_S3 0 1 /end CHARACTERISTIC
/begin CHARACTERISTIC T_GEFAELLE_IEP "Zeit, wie lange man in der Gefällestrecke sein muss damit die Gefahr der Luftansaugung besteht" VALUE 0x1D83CC ZF_kw_ui16_S5_S3 4999 UMR_SEC__1_1_0_S5_S3 1 5000 /end CHARACTERISTIC
/begin CHARACTERISTIC T_K0DEFEKTREG1_K0 "Zeitschwelle 1 zur Entprellung der Differenzdrehzahlschwelle1 zur Überprüfung einesmechanischen efekts der K0 im Regelbetrieb" VALUE 0x1D83EE ZF_kw_ui16_S5_S3 60000 UMR_MSEC__10_1_0_S5_S3 0 60000 /end CHARACTERISTIC
/begin CHARACTERISTIC T_K0DEFEKTREG2_K0 "Zeitschwelle 2 zur Entprellung der Differenzdrehzahlschwelle1 zur Überprüfung einesmechanischen efekts der K0 im Regelbetrieb" VALUE 0x1D83F0 ZF_kw_ui16_S5_S3 60000 UMR_MSEC__10_1_0_S5_S3 0 60000 /end CHARACTERISTIC
/begin CHARACTERISTIC T_LUFT_AKTIV_IEP "Zeit, wie lange die IEP laufen muss, bis die Gefahr der Luftansaugen aufgehoben ist" VALUE 0x1D83D0 ZF_kw_ui16_S5_S3 4999 UMR_SEC__1_1_0_S5_S3 1 5000 /end CHARACTERISTIC
/begin CHARACTERISTIC T_LUFT_SPERR_IEP "Zeit, wie lange die IEP nicht laufen darf, wenn die Gefahr der Luftansaugen aufgehoben ist" VALUE 0x1D83D2 ZF_kw_ui16_S5_S3 5000 UMR_SEC__1_1_0_S5_S3 0 5000 /end CHARACTERISTIC
/begin CHARACTERISTIC T_MAX_LP_POSBREMSE_IEP "Maximale Laufzeit der Pumpe bei P und Bremslicht an notwendig ist" VALUE 0x1D83C4 ZF_kw_ui16_S5_S3 600 UMR_SEC__1_1_0_S5_S3 0 600 /end CHARACTERISTIC
/begin CHARACTERISTIC T_MSCHALT_K0 "[ms] Rampenzeit zum stehen lasssen vom Schaltmoment vordem Abfiltern" VALUE 0x1D8426 ZF_kw_ui16_S5_S3 2000 UMR_MSEC__10_1_0_S5_S3 0 2000 /end CHARACTERISTIC
/begin CHARACTERISTIC T_NAB_IEP "Zeit, wie lange man in der Phase der Hochgeschwindigkeit sein muss damit die Gefahr der Luftansaugung besteht" VALUE 0x1D83CE ZF_kw_ui16_S5_S3 4999 UMR_SEC__1_1_0_S5_S3 1 5000 /end CHARACTERISTIC
/begin CHARACTERISTIC T_NMIN_IEP "Timer wie lange die EM-Drehzahl bei einem höherem LP als LP1 ausgegeben werden soll" VALUE 0x1D77DA ZF_kw_ui8_S5_S3 10 UMR_SEC__1_1_0_S5_S3 0 10 /end CHARACTERISTIC
/begin CHARACTERISTIC T_PSYS_PSS_IEP "Zeit, die die IEP beim Systemeinbruch unterstützen soll" VALUE 0x1D77EC ZF_kw_ui8_S5_S3 2 UMR_SEC__1_100_0_S5_S3 0 2 /end CHARACTERISTIC
/begin CHARACTERISTIC T_REGRAMPSCHALT_K0 "[ms] Rampenzeit zum Umschalten der Reglerparameter während Schaltungen" VALUE 0x1D841E ZF_kw_ui16_S5_S3 2000 UMR_MSEC__10_1_0_S5_S3 0 2000 /end CHARACTERISTIC
/begin CHARACTERISTIC T_UEBTEMPPULS_IAE "Rechteckimpulsdauer bei Übertemperaturpulsen der IAE im Anfahren" VALUE 0x1D77A0 ZF_kw_ui8_S5_S3 2550 UMR_MSEC__10_1_0_S5_S3 0 2550 /end CHARACTERISTIC
/begin CHARACTERISTIC T_UEF_KALTANFAHR_IAE "Dauer der Überführung Kriechen >> Kaltanfahren" VALUE 0x1D8388 ZF_kw_si16_S5_S3 10000 UMR_MSEC__10_1_0_S5_S3 0 10000 /end CHARACTERISTIC
/begin CHARACTERISTIC T_WARTEN_CIAEINI_IAE "Zeit in der auf ein gültiges Signal timeegsoff gewartet wird" VALUE 0x1D83BE ZF_kw_ui16_S5_S3 1000 UMR_MSEC__10_1_0_S5_S3 0 1000 /end CHARACTERISTIC
/begin CHARACTERISTIC T_WASH_FKT_IEP "Timer für Waschstrassen, ab wann Iep abschalten muss notwendig ist" VALUE 0x1D77E3 ZF_kw_ui8_S5_S3 20 UMR_SEC__1_1_0_S5_S3 0 20 /end CHARACTERISTIC
/begin CHARACTERISTIC T_WNDOSCHALTAB_K0_HSZ "Filterzeitkonstante zum Abfiltern des Schaltoffsets bei HSZ" VALUE 0x1D840E ZF_kw_ui16_S5_S3 3970 UMR_MSEC__1_1_0_S5_S3 30 4000 /end CHARACTERISTIC
/begin CHARACTERISTIC T_WNDOSCHALTAB_K0_HSZ_SP "Filterzeitkonstante zum Abfiltern des Schaltoffsets bei HSZ" VALUE 0x1D8416 ZF_kw_ui16_S5_S3 3970 UMR_MSEC__1_1_0_S5_S3 30 4000 /end CHARACTERISTIC
/begin CHARACTERISTIC T_WNDOSCHALTAB_K0_RSS "Filterzeitkonstante zum Abfiltern des Schaltoffsets bei RSS" VALUE 0x1D8410 ZF_kw_ui16_S5_S3 3970 UMR_MSEC__1_1_0_S5_S3 30 4000 /end CHARACTERISTIC
/begin CHARACTERISTIC T_WNDOSCHALTAB_K0_RSS_SP "Filterzeitkonstante zum Abfiltern des Schaltoffsets bei RSS" VALUE 0x1D8418 ZF_kw_ui16_S5_S3 3970 UMR_MSEC__1_1_0_S5_S3 30 4000 /end CHARACTERISTIC
/begin CHARACTERISTIC T_XDG_REGLER_IAE "Zeitkonstante D-Anteil Regler IAE" VALUE 0x19D050 ZF_kw_fl32_S5_S3 2000 UMR_MSEC__1_1_0_S5_S3 0 2000 /end CHARACTERISTIC
/begin CHARACTERISTIC VORGABE_MANUELL_IEP "Ist-Zustand Vorgabe der elektrischen Zusatzpumpe wenn SWI_VORGABE_MANUELL=1" VALUE 0x1D77DD ZF_kw_ui8_S5_S3 4 UMR___1_1_0_S5_S3 0 4 /end CHARACTERISTIC
/begin CHARACTERISTIC VP_KEINEKUEHLUNG_K0 "Kuehloelvolumenstrom" VALUE 0x19E940 ZF_kw_fl32_S5_S3 10 UMR_LITER_MIN_1_1_0_S5_S3 0 10 FORMAT "%2.1" /end CHARACTERISTIC
/begin CHARACTERISTIC VZ_MEMIST_K0 "Verzögerungszeit für E-AMschinenistmoment" VALUE 0x1D77FC ZF_kw_ui8_S5_S3 90 UMR_MSEC__10_1_0_S5_S3 0 90 /end CHARACTERISTIC
/begin CHARACTERISTIC VZ_MEMMAXDYN_K0 "Verzögerungszeit" VALUE 0x1D7806 ZF_kw_ui8_S5_S3 90 UMR_MSEC__10_1_0_S5_S3 0 90 /end CHARACTERISTIC
/begin CHARACTERISTIC VZ_MEMMINDYN_K0 "Verzögerungszeit" VALUE 0x1D7807 ZF_kw_ui8_S5_S3 90 UMR_MSEC__10_1_0_S5_S3 0 90 /end CHARACTERISTIC
/begin CHARACTERISTIC VZ_MMOTIST_K0 "Verzögerungszeit Motoristmoment" VALUE 0x1D77FB ZF_kw_ui8_S5_S3 90 UMR_MSEC__10_1_0_S5_S3 0 90 /end CHARACTERISTIC
/begin CHARACTERISTIC VZ_MVMIST_K0 "Verzögerungszeit Verbrennungsmotoristmoment" VALUE 0x1D77FD ZF_kw_ui8_S5_S3 90 UMR_MSEC__10_1_0_S5_S3 0 90 /end CHARACTERISTIC
/begin CHARACTERISTIC VZ_NABNT_K0 "Verzögerungszeit Abtriebsdrehzahl und Turbinendrehzahl" VALUE 0x1D780A ZF_kw_ui8_S5_S3 90 UMR_MSEC__10_1_0_S5_S3 0 90 /end CHARACTERISTIC
/begin CHARACTERISTIC VZ_NAB_IAE "Verzögerungszeit Abtriebsdrehzahl" VALUE 0x1D77CD ZF_kw_ui8_S5_S3 90 UMR_MSEC__1_1_0_S5_S3 0 90 /end CHARACTERISTIC
/begin CHARACTERISTIC VZ_NMOT_K0 "Verzögerungszeit Motormoment" VALUE 0x1D780C ZF_kw_ui8_S5_S3 90 UMR_MSEC__10_1_0_S5_S3 0 90 /end CHARACTERISTIC
/begin CHARACTERISTIC VZ_NT_IAE "Verzögerungszeit Turbinendrehzahl" VALUE 0x1D77CE ZF_kw_ui8_S5_S3 90 UMR_MSEC__1_1_0_S5_S3 0 90 /end CHARACTERISTIC
/begin CHARACTERISTIC VZ_NVM_K0 "Verzögerungszeit Verbrennungsmotormoment" VALUE 0x1D780B ZF_kw_ui8_S5_S3 90 UMR_MSEC__10_1_0_S5_S3 0 90 /end CHARACTERISTIC
/begin CHARACTERISTIC WAERMEKAP_IAE "[J/K] Waermekapazität des Reibelements" VALUE 0x19DD4C ZF_kw_fl32_S5_S3 7600 UMR_J_K_1_1_0_S5_S3 400 8000 FORMAT "%2.1" /end CHARACTERISTIC
/begin CHARACTERISTIC WNDOGSCHALT_K0_HSS "Initialisierungswert für den Sollwertgradient im Synchronpunkt neuer Gang bei HSS" VALUE 0x1D8412 ZF_kw_si16_S5_S3 4000 UMR_U_MINSEC_1_1_0_S5_S3 -2000 2000 /end CHARACTERISTIC
/begin CHARACTERISTIC WNDOGSCHALT_K0_HSS_SP "Initialisierungswert für den Sollwertgradient im Synchronpunkt neuer Gang bei HSS" VALUE 0x1D841A ZF_kw_si16_S5_S3 4000 UMR_U_MINSEC_1_1_0_S5_S3 -2000 2000 /end CHARACTERISTIC
/begin CHARACTERISTIC WNDOGSCHALT_K0_RSS "Initialisierungswert für den Sollwertgradient im Synchronpunkt neuer Gang bei RSS" VALUE 0x1D8414 ZF_kw_si16_S5_S3 4000 UMR_U_MINSEC_1_1_0_S5_S3 -2000 2000 /end CHARACTERISTIC
/begin CHARACTERISTIC WNDOGSCHALT_K0_RSS_SP "Initialisierungswert für den Sollwertgradient im Synchronpunkt neuer Gang bei RSS" VALUE 0x1D841C ZF_kw_si16_S5_S3 4000 UMR_U_MINSEC_1_1_0_S5_S3 -2000 2000 /end CHARACTERISTIC
/begin CHARACTERISTIC WNDOSCHALT_K0_HSS "Endwert des Sollwertfilters während der Gleitphase bei HSS" VALUE 0x1D781B ZF_kw_ui8_S5_S3 255 UMR_U_MIN_1_1_0_S5_S3 0 255 /end CHARACTERISTIC
/begin CHARACTERISTIC WNDOSCHALT_RSZ_K0 "Endwert des Sollwertfilters während der Gleitphase bei RSZ" VALUE 0x1D781C ZF_kw_ui8_S5_S3 255 UMR_U_MIN_1_1_0_S5_S3 0 255 /end CHARACTERISTIC
/begin CHARACTERISTIC WND_GRENZMAX_K0 "Maximale Grenze Differenzdrehzahl" VALUE 0x1D8402 ZF_kw_si16_S5_S3 5000 UMR_U_MIN_1_1_0_S5_S3 0 5000 /end CHARACTERISTIC
/begin CHARACTERISTIC WND_GRENZMIN_K0 "Minimale Grenze Differenzdrehzahl" VALUE 0x1D8404 ZF_kw_si16_S5_S3 255 UMR_U_MIN_1_1_0_S5_S3 0 255 /end CHARACTERISTIC
/begin CHARACTERISTIC WND_SCHUTZ_K0 "Keine Beschreibung in Spec." VALUE 0x1D7811 ZF_kw_ui8_S5_S3 255 UMR_U_MIN_1_1_0_S5_S3 0 255 /end CHARACTERISTIC
/begin CHARACTERISTIC XDS_K0ZU "[1/min] Regelabweichung in ZU, bei der der überlagerte I-Regler losläuft" VALUE 0x1A0A50 ZF_kw_fl32_S5_S3 255 UMR_U_MIN_1_1_0_S5_S3 0 255 /end CHARACTERISTIC
/begin CHARACTERISTIC XDS_K0ZU_SCHALT "Regelabweichung in ZU, bei der der überlagerte I-Regler losläuft während Schaltung" VALUE 0x1A0A54 ZF_kw_fl32_S5_S3 8000 UMR_U_MIN_1_1_0_S5_S3 0 8000 /end CHARACTERISTIC
/begin CHARACTERISTIC XDS_ZU_IAE "Schwelle für Regelabweichung in ZU, ab der der I-Regler startet" VALUE 0x19CD8C ZF_kw_fl32_S5_S3 100 UMR_U_MIN_1_1_0_S5_S3 0 100 /end CHARACTERISTIC
/begin FUNCTION jIaeMomen_Fktn "Applikationesgroessen Instanz jIaeMomen"
 /begin DEF_CHARACTERISTIC CS_GETR_ANFMODUS_IAE F_MKRIECH_ANF_IAE KF_AMPUEBTEMPPULS_IAE KF_F_AMPUEBTEMPPULS_IAE KF_F_MAUFNMOTPBREMS_IAE KF_F_M_AUF_IAE KF_F_M_KRIECH_MAX_IAE KF_F_NDMOTANFAHR_IAE KF_KI_KRIECH_IAE KF_KP_KRIECH_IAE KF_MGSOLLSYNC_IAE KF_MOSOLLLASTNMOT_IAE KF_MOSOLLNDIAETIMER_IAE KF_MO_ZU_IAE KF_MPT_ISTUETZSCHALT_IAE KF_MSOLL_KALTANFAHR_IAE KF_M_ANGELEGT_PBREMSDKI_IAE KF_M_KRIECH_IAE KF_M_KRIECH_MAX_IAE KF_M_KRIECH_MIN_IAE KF_M_SCHLEPP_IAE KF_ND_IAESOLLKRIECH_IAE KF_NMOTANFAHRMAXC_IAE KF_NMOTANFAHR_SOLL_NEIGUNG_IAE KF_OG_M_AUF_FAKTOR_IAE KF_T_PT2_M_IST_IAE KF_T_UEF_MANF_KRIECH_ANGL_IAE KF_T_UEF_M_ANGELEGT_KRIECH_IAE KF_T_UEF_M_VOR_ANF_IAE KF_T_UEF_M_VOR_ANF_KRIANG_IAE KF_T_UEF_ZU_KRIECH_ANGL_IAE KI_ZU_IAE KL_CSMOT_ANFMODUS_IAE KL_FNMOTANFAHRLL_IAE KL_FNMOTANFAHRMOTSTRESS_IAE KL_F_MOSCHALT_ZU_IAE KL_F_MSCHLEPP_IAE KL_F_M_ANGELEGT_IAE KL_F_M_KRIECH_MAX_NEIGUNG_IAE KL_F_NDIAESOLLKRIECH_IAE KL_F_NGMOTANFAHRINITGE_IAE KL_F_ONMOTANFAHR_IAE KL_MAXIREGZU_IAE KL_MAXOGNMOTANFAHR_SOLL_IAE KL_MG_ZU_IAE KL_MO_ASRREGELT_ZU_IAE KL_MSCHLEPP_CIAE_IAE KL_M_ANGELEGT_ND_IAE KL_M_KRIECHMAX_CGETR_IAE KL_M_KRIECHMAX_MOTSTRESS_IAE KL_NMOTANFAHRMMOTMAX_IAE KL_ONMOTANFAHR_IAE KL_START_UEBTEMPPULS_IAE KL_TYP_UEF_1_IAE KL_TYP_UEF_2_IAE KL_TYP_UEF_3_IAE KL_TYP_UEF_4_IAE KL_T_PT2_NMOTANFENTKOPPL_IAE KL_T_UEF_I_STUETZ_IAE KL_T_UEF_KRIECH_IAE KL_T_UEF_MSOLLANFAHR_IAE KL_T_UEF_MSOLLEHANF_IAE KL_T_UEF_M_AUF_GA_IAE KL_T_UEF_M_AUF_GE_IAE KL_T_UEF_M_KRIECH_ANGELEGT_IAE MG_ANKRIECHEN_IAE MG_ANKRIECHNEG_IAE MO_IAEAUF_IAE MPT_NMOTSOLLANFAHR_ENTK_IAE M_ANGELEGT_AUTOHOLD_IAE M_ANGELEGT_FSTBR_IAE M_AUF_MIN_IAE NS_ABMINANKRIECHEN_IAE NS_ABREGINITKRIECH_HYS_IAE NS_ABREGINITKRIECH_IAE NS_MOTANFAHRMAXC_IAE N_EMKNICK_ERSATZ_IAE OG_M_AUF_REST_IAE SWI_KRIECHAKTIVNDS_IAE SWI_MIAEAUF_ANFAHREN_IAE SWI_M_IAEAUF_SCHLEPP_IAE SWI_NSOLLH_SLST_IAE SWI_PT2INITEH_ANFAHRT_IAE TAB_F_MMAX_KRIECH_IAE TAB_F_MMIN_KRIECH_IAE TAB_F_MVST_KRIECH_IAE TAB_STUETZFAKTOR_IAE TS_MAXANKRIECHEN_IAE TYP_UEF_I_STUETZ_IAE TYP_UEF_KALTANFAHR_IAE TYP_UEF_KRIECH_IAE TYP_UEF_MANF_KRIECH_ANGL_IAE TYP_UEF_MSOLLANFAHR_IAE TYP_UEF_MSOLLEHANF_IAE TYP_UEF_M_ANGELEGT_KRIECH_IAE TYP_UEF_M_AUF_IAE TYP_UEF_M_KRIECH_ANGELEGT_IAE TYP_UEF_M_VOR_ANF_IAE TYP_UEF_M_VOR_ANF_KRIANG_IAE TYP_UEF_ZU_KRIECH_ANGL_IAE T_UEBTEMPPULS_IAE T_UEF_KALTANFAHR_IAE T_XDG_REGLER_IAE XDS_ZU_IAE /end DEF_CHARACTERISTIC
/end FUNCTION
/begin FUNCTION jIaeMotmx_Fktn "Applikationesgroessen Instanz jIaeMotmx"
 /begin DEF_CHARACTERISTIC DKIS_STALL_IAE KF_MMOTMAXC_IAE KF_MMOTMAXND_IAE KF_M_MOTMAXSTALL_IAE KL_MMOTMAXXD_IAE KL_M_STELLMAX_IAE MG_MOTAUFREGELSTALL_IAE MG_M_MOTMAX_IAE MPT_MMOTMAX_IAE NS_NDMOTSTALL_IAE PS_BREMS_STALL_IAE /end DEF_CHARACTERISTIC
/end FUNCTION
/begin FUNCTION jIaePara_Fktn "Applikationesgroessen Instanz jIaePara"
 /begin DEF_CHARACTERISTIC KF_FDYNANFAHR_IAE KF_MSOLLMAXANFAHR_IAE KL_MSMOTINIT_PT2_IAE KL_MSOLLMINANFAHR_IAE KL_NSMOTINIT_PT2_IAE /end DEF_CHARACTERISTIC
/end FUNCTION
/begin FUNCTION jIaeParaEco_Fktn "Applikationesgroessen Instanz jIaeParaEco"
 /begin DEF_CHARACTERISTIC KF_FDYNANFAHR_ECO_IAE KF_MSOLLMAXANFAHR_ECO_IAE KL_MSMOTINIT_PT2_ECO_IAE KL_MSOLLMINANFAHR_ECO_IAE KL_NSMOTINIT_PT2_ECO_IAE /end DEF_CHARACTERISTIC
/end FUNCTION
/begin FUNCTION jIaeSigna_Fktn "Applikationesgroessen Instanz jIaeSigna"
 /begin DEF_CHARACTERISTIC F_NG_AB_NEIGUNG_IAE KF_NDMOT_POSN_IAE KF_NS_SYNC_HYS_E_ECO_IAE KF_NS_SYNC_HYS_E_IAE KF_NS_SYNC_HYS_H_ECO_IAE KF_NS_SYNC_HYS_H_IAE KF_NS_SYNC_IAE KL_FNSSYNC_IAE KL_F_MMOTGEMOE_IAE KL_F_NUE_IAE KL_MOTSTRESSPAIR_IAE KL_MSCHLEPPOFFEN_IAE KL_NS_ASRREGELT_SYNC_IAE KL_ONS_SYNC_IAE KL_T_PT2_NEIGUNG_IAE KL_VZ_MMOTGEMOE_IAE KL_VZ_MMOTISTOE_IAE KL_VZ_MMOTIST_IAE KL_VZ_MMOTSOLLOE_IAE MDT_DKIG_IAE MDT_MG_MOTIST_IAE MDT_NDG_IAE MDT_NG_AB_IAE MDT_NG_GETREIN_IAE MDT_NG_MOT_IAE MDT_PG_BREMS_IAE MO_MOTISTOE_IAE MO_MOTIST_IAE MO_MOTSOLLOE_IAE MPT_AX_REF_DIAGIAE MPT_DKI_IAE MPT_MMOTGEMOE_IAE MPT_MMOTISTOE_IAE MPT_MMOTIST_IAE MPT_MMOTSOLLOE_IAE MPT_NAB_IAE MPT_ND_GETREIN_IAE MPT_ND_IAE MPT_ND_MOT_IAE MPT_NMOT_IAE MPT_NT_IAE MPT_NUE_IAE MPT_PBREMS_IAE NDS_HYSMREIBZU_IAE NDS_MREIBZU_IAE NDS_NDIAE_POSN_IAE NDS_POSN_IAE ND_MOTPOSN_RSETZ_IAE NEIG_D_IAE NEIG_HYS_IAE NEIG_R_IAE NGS_AB_POSN_IAE NGS_GETREIN_POSN_IAE NGS_HYSAB_POSN_IAE NGS_HYSGETREIN_POSN_IAE NS_ABNEIG_IAE NS_ABPOSN_RSETZ_IAE NS_ASRREGELT_SYNC_HYS_E_IAE NS_ASRREGELT_SYNC_HYS_H_IAE NS_EMLL_MIN_IAE NS_HYS_ABNEIG_IAE NS_NDGETREINLLBASIS_IAE PS_BREMS_POSN_IAE SWI_NDGETREINLLBASIS_IAE SWI_NEIGUNGGEF_IAE SWI_NMOTLLREG_AKTIV_IAE SWI_NMOTSOLL_LL_E_IAE SWI_NS_SYNC_IAE TAB_SWI_ASRREGELT_IAE TAB_ZIELGANGPOSN_IAE VZ_NAB_IAE VZ_NT_IAE /end DEF_CHARACTERISTIC
/end FUNCTION
/begin FUNCTION jIaeTempm_Fktn "Applikationesgroessen Instanz jIaeTempm"
 /begin DEF_CHARACTERISTIC KF_ALPHA_SCHLUPF_IAE KL_ALPHA_AUF_IAE KL_ALPHA_ZU_IAE KL_F_CIAEINI_IAE TAB_MVG_C_IAE T_WARTEN_CIAEINI_IAE WAERMEKAP_IAE /end DEF_CHARACTERISTIC
/end FUNCTION
/begin FUNCTION jIepBerLp_Fktn "Applikationesgroessen Instanz jIepBerLp"
 /begin DEF_CHARACTERISTIC MMOT_SCHWELLE_LP2_IEP MMOT_SCHWELLE_LP3_IEP NS_MOT_HYS_IEP NS_NMOT_IEP SWI_M_MAXEMIAE_IEP SWI_NMIN_AKTIV_IEP TAB_VORGABELP_IEP TEMP_MAX_LP2_IEP T_MAX_LP_POSBREMSE_IEP T_NMIN_IEP /end DEF_CHARACTERISTIC
/end FUNCTION
/begin FUNCTION jIepKordi_Fktn "Applikationesgroessen Instanz jIepKordi"
 /begin DEF_CHARACTERISTIC KF_CGETR_POS_D_PWM_IEP KF_CGETR_PWM_IEP SWI_IEP SWI_VORGABE_MANUELL_IEP VORGABE_MANUELL_IEP /end DEF_CHARACTERISTIC
/end FUNCTION
/begin FUNCTION jIepLeckagemodell_Fktn "Applikationesgroessen Instanz jIepLeckagemodell"
 /begin DEF_CHARACTERISTIC KF_ADDONLP_IEP KF_KORRANCGETRDKP_IEP KF_KORRANCGETRPBREMSE_IEP KF_KORRAUSPSYSCGETR_IEP KF_KORRAUSPSYSDKP_IEP KF_LECKAGEFZP_IEP KF_LECKAGEHSG_IEP KL_KORRANDKP_IEP KL_KORRANT_IEP KL_NGMOT_IEP MPT_NG_MOT_IEP MPT_NSMOTANKORR_IEP PUMPENVOLPROUMDR_IEP TAB_KORRANISTGANG_IEP TAB_KORRAUSISTGANG_IEP TAB_LECKAGEHSG_IEP /end DEF_CHARACTERISTIC
/end FUNCTION
/begin FUNCTION jIepSchuz_Fktn "Applikationesgroessen Instanz jIepSchuz"
 /begin DEF_CHARACTERISTIC KL_NS_MOT_PUMPE_IEP P_SYS_SCHWELLE_IEP TAB_T_AN_MIN_LP_IEP TEMP_HYS_IEP TEMP_MAX_IEP TEMP_MIN_IEP T_AN_MAX_IEP T_AUS_IEP /end DEF_CHARACTERISTIC
/end FUNCTION
/begin FUNCTION jIepSigna_Fktn "Applikationesgroessen Instanz jIepSigna"
 /begin DEF_CHARACTERISTIC GS_GEFAELLE_IEP KL_NSMOT_PSS_IEP MPT_NEIGUNG_IEP NS_F_EINMAL_AUS_IEP NS_HYBRID_HYS_IEP NS_HYBRID_IEP NS_NAB_ERF_IEP NS_NAB_IEP P_SYSMIN_PSS_IEP SWI_ABFR_HAS_PSS_IEP SWI_F_EINMALAUS_IEP SWI_GEFAEL_LUFT_AKTIV_IEP SWI_NAB_LUFT_AKTIV_IEP SWI_P_STUE_HYBRID_PSS_IEP TAB_SCHALTUNG_PSS_IEP TAB_STATUSIAE_PSS_IEP T_FEHLER_RESET_IEP T_GEFAELLE_IEP T_LUFT_AKTIV_IEP T_LUFT_SPERR_IEP T_NAB_IEP T_PSYS_PSS_IEP T_WASH_FKT_IEP /end DEF_CHARACTERISTIC
/end FUNCTION
/begin FUNCTION jIepStSig_Fktn "Applikationesgroessen Instanz jIepStSig"
 /begin DEF_CHARACTERISTIC KF_TSTATUS_AUSLP1_IEP KF_TSTATUS_AUSLP2_IEP KF_TSTATUS_AUSLP3_IEP KF_TSTATUS_LP1LP2_IEP KF_TSTATUS_LP1LP3_IEP KF_TSTATUS_LP2LP3_IEP KF_TSTATUS_LPAUS_IEP K_TSTATUS_START_AUSLP3_IEP /end DEF_CHARACTERISTIC
/end FUNCTION
/begin FUNCTION jK0sSigna_Fktn "Applikationesgroessen Instanz jK0sSigna"
 /begin DEF_CHARACTERISTIC CO_MAXREG_K0 CO_MINREG_K0 CS_BELAGDIAG_K0 CS_BELAGHYS_K0 CS_BELAGOG_K0 CS_MAXREG_K0 CS_MINREG_K0 CS_VPOEL12_K0 CS_VPOEL23_K0 F_K0_VERLUST F_KORR_BELAGAB_K0 F_RHO_CP_OEL F_WAERMEKAP_BELAG_K0 F_WAERMEKAP_TORUS_K0 I_KEINKRAFTSCHLUSS_K0 J_EM_K0 J_FAHRZEUG_K0 J_MOTOR_K0 J_PRI_K0 J_SEC_K0 KF_ALPHA_BELAG_OFFEN_K0 KF_ALPHA_BELAG_REGELN_K0 KF_MIST_SCHLEPP_K0 KF_MUEKORR_K0 KF_MUE_K0 KF_VPOEL_CGETR_1_K0 KF_VPOEL_CGETR_2_K0 KF_VPOEL_CGETR_3_K0 KL_ALPHA_GEHAEUSE_K0 KL_ALPHA_GEHAEUSE_ND_K0 KL_ALPHA_GEHAEUSE_VPOEL_K0 KL_ALPHA_LRAUM_ND_K0 KL_ALPHA_LRAUM_VPOEL_K0 KL_DNKORR_K0 KL_FMUEC_K0 KL_MIST_SCHLEPP_K0 KL_NDSK0DEFEKTREG1_K0 KL_NDSK0DEFEKTREG2_K0 KL_WAERMEKAP_LRAUM_K0 MDT_DKGPEDAL_K0 MDT_NGAB_K0 MDT_NG_EM_K0 MO_EMIST_K0 MO_MEMMAXDYN_K0 MO_MEMMINDYN_K0 MO_MMOTIST_K0 MO_VMIST_K0 MO_VMSOLL_K0 MPT_I_GETRIEBE_VIRT_K0 MPT_MEMIST_K0 MPT_MEMMAXDYN_K0 MPT_MEMMINDYN_K0 MPT_MMOTIST_K0 MPT_MVMIST_K0 MPT_NAB_K0 MPT_NDZSZUG_K0 MPT_NT_K0 MPT_VPOEL_K0 MS_LWREGK0S MS_LWREGK0Z MS_ME_MAXSCHUTZ_K0 MS_MVMISTDIAG_K0 MS_SCHUTZENDE_K0 NDS_LWREGK0S NDS_LWREGK0Z NDS_SCHUTZEINSTIEG_K0 NMOT_ADDKORR_K0 NMOT_MULTKORR_K0 PS_KEINEKUEHLUNG_K0 PS_PSOLLDIAG_K0 SWI_AKTIVEKUEHLUNG_K0 SWI_DIAGAKTIV_K0 SWI_DIAGTEMPERLAUBT_K0 SWI_JFZGSCHALTAKTIV_K0 SWI_KEINKRAFTSCHLUSS_K0 SWI_MISTMSOLLMUE_K0 SWI_NDWNDMUE_K0 SWI_SCHUTZ_K0 SWI_ZUGSCHUBERKENNUNG_K0 TAB_F_MVMSOLLGEMVOR TAB_JGETRIEBE_K0 TAB_K0SCHLRAMPKUPSTATUSIAE_K0 TAB_KI_SCHUTZ_K0 TAB_MDTMGVMSOLLGEMVOR_K0 TAB_MDTMGVMSOLLGEMVOR_K0_SP TAB_MPT_MVMSOLLGEMVOR_K0 TAB_MPT_NMOT_K0 TAB_MPT_NVM_K0 TAB_MVG_CBELK0 TAB_SOLLGEPR_K0 TAB_SWIGESTGES_K0_SP TAB_SWILASTWECHSEL_K0_SP TAB_SWIMSCHALTRSZ_K0_SP TAB_SWIREGSCHALT_K0_SP TAB_SWISCHALTUNGDIREKT_K0 TAB_SWISTARTSCHALT_K0 TAB_SWIVERBOTFDYN_K0_SP TAB_SWIWNDOSCHALT_K0_SP TAB_VZINITSCHALT_K0 TAB_VZMVMSOLLGEMVOR T_K0DEFEKTREG1_K0 T_K0DEFEKTREG2_K0 VP_KEINEKUEHLUNG_K0 VZ_MEMIST_K0 VZ_MEMMAXDYN_K0 VZ_MEMMINDYN_K0 VZ_MMOTIST_K0 VZ_MVMIST_K0 VZ_NABNT_K0 VZ_NMOT_K0 VZ_NVM_K0 WND_SCHUTZ_K0 /end DEF_CHARACTERISTIC
/end FUNCTION
/begin FUNCTION jK0sSollw_Fktn "Applikationesgroessen Instanz jK0sSollw"
 /begin DEF_CHARACTERISTIC CS_BELAGFDYNHYS_K0 CS_BELAGFDYNOG_K0 CS_GETRFDYNOG_K0 CS_GETRFDYNUG_K0 D_RAWNDEINREG_K0 D_WNDOFDYN_K0 D_WNDOSCHALT_K0 D_WNDSTD_K0 KF_RAWNDEINREGK0S KF_RAWNDEINREGK0Z KF_WNDOFDYNK01 KF_WNDOFDYNK02 KF_WNDOFDYNK03 KF_WNDOFDYNK04 KF_WNDOFDYNK05 KF_WNDOFDYNK06 KF_WNDOFDYNK07 KF_WNDOFDYNK08 KF_WNDOFDYNK0R KL_DKPEDALMIN_K0 KL_F_RAWNDEINREG_K0 KL_F_WNDOFDYN_K0 KL_F_WNDSTD_CGETR_K0 KL_F_WND_K0 KL_T_RAWNDEINREG_K0 MGS_FDYN_K0 MPT_WNDOSCHALTAB_HSS_K0 MPT_WNDOSCHALTAB_RSZ_K0 NDS_EINREGREG_K0 SWI_WNDOFDYN_K0 TAB_DELTAFPSFDYN_K0 TAB_FPGSFDYN_K0 TAB_FPSFDYN_K0 TAB_NSTFDYN_K0 TAB_SWIFDYNERLAUBT_K0 TAB_SWIFDYNOFFSETAKTIV_K0 TAB_T_FDYNAB_K0 TAB_T_FDYNAUF_K0 TAB_T_FDYNVERLASSEN_K0 TAB_T_WNDSTD_K0 TAB_WND_K0ZU TSP_FDYN_K0 T_EINREGMAX_K0 T_FDYNMAX_K0 WNDOSCHALT_K0_HSS WNDOSCHALT_RSZ_K0 WND_GRENZMAX_K0 WND_GRENZMIN_K0 /end DEF_CHARACTERISTIC
/end FUNCTION
/begin FUNCTION jK0sSollwSP0_Fktn "Applikationesgroessen Instanz jK0sSollwSP0"
 /begin DEF_CHARACTERISTIC KF_WNDOGSCHALT_K0_RSZ KL_T_WNDOSCHALTAB_K0_HSS KL_T_WNDOSCHALTAB_K0_RSZ KL_WNDOGSCHALT_K0_HSZ TAB_T_WNDOSCHALTAUF_K0 TAB_WNDOSCHALT_K0 T_WNDOSCHALTAB_K0_HSZ T_WNDOSCHALTAB_K0_RSS WNDOGSCHALT_K0_HSS WNDOGSCHALT_K0_RSS /end DEF_CHARACTERISTIC
/end FUNCTION
/begin FUNCTION jK0sSollwSP1_Fktn "Applikationesgroessen Instanz jK0sSollwSP1"
 /begin DEF_CHARACTERISTIC KF_WNDOGSCHALT_K0_RSZ_SP KL_T_WNDOSCHALTAB_K0_HSS_SP KL_T_WNDOSCHALTAB_K0_RSZ_SP KL_WNDOGSCHALT_K0_HSZ_SP TAB_T_WNDOSCHALTAUF_K0_SP TAB_WNDOSCHALT_K0_SP T_WNDOSCHALTAB_K0_HSZ_SP T_WNDOSCHALTAB_K0_RSS_SP WNDOGSCHALT_K0_HSS_SP WNDOGSCHALT_K0_RSS_SP /end DEF_CHARACTERISTIC
/end FUNCTION
/begin FUNCTION jK0sSollwX_Fktn "Applikationesgroessen Instanz jK0sSollwX"
 /begin DEF_CHARACTERISTIC KF_WNDSTDK01 KF_WNDSTDK02 KF_WNDSTDK03 KF_WNDSTDK04 KF_WNDSTDK05 KF_WNDSTDK06 KF_WNDSTDK07 KF_WNDSTDK08 KF_WNDSTDK0PN KF_WNDSTDK0R /end DEF_CHARACTERISTIC
/end FUNCTION
/begin FUNCTION jK0sSollwXASD_Fktn "Applikationesgroessen Instanz jK0sSollwXASD"
 /begin DEF_CHARACTERISTIC KF_WNDSTDK01_ASD KF_WNDSTDK02_ASD KF_WNDSTDK03_ASD KF_WNDSTDK04_ASD KF_WNDSTDK05_ASD KF_WNDSTDK06_ASD KF_WNDSTDK07_ASD KF_WNDSTDK08_ASD KF_WNDSTDK0PN_ASD KF_WNDSTDK0R_ASD /end DEF_CHARACTERISTIC
/end FUNCTION
/begin FUNCTION jK0sSteur_Fktn "Applikationesgroessen Instanz jK0sSteur"
 /begin DEF_CHARACTERISTIC DELTA_IEDSK0_ABGL F_KPOMSOLLKORRC_K0 KF_D_POIST_K0 KF_F_KI_K0 KF_KDREGK0S KF_KDREGK0Z KF_KIREGK0S KF_KIREGK0Z KF_KPREGK0S KF_KPREGK0Z KF_MDT_PKORR_K0 KF_PHYSCGETRNMOT_K0 KF_PK0_PSYS KF_POCGETRPSYS_K0 KF_POFCGETRMSOLL_K0 KF_POREGCGETRNMOT_K0 KF_PO_TORUS_CGETR_VPSEK_K0 KF_P_TORUS_PSYS_VPSEK_K0 KF_TFC_K0 KF_TFC_K0_OPT KF_TFC_K0_RED KF_T_POIST_K0 KI_K0ZU KL_F_MINIT_REST_EINREG_K0 KL_F_MPT_ZUREGELN_K0 KL_MGK0ZU KL_MGNOTSCHLIESS_K0 KL_MOK0ZU KL_MOZUREGELN_K0 KL_MPT_PO_TORUSDYN_K0 KL_MS_MINREGD_K0 KL_MS_MINREGPN_K0 KL_PO_TORUSDYN_CGETR_K0 KL_P_K0STELLMAX MPT_DSFA_K0 MPT_GSDS_K0 MPT_GSFA_K0 MPT_HYSABREG_K0 MPT_HYSAB_K0 MPT_HYSAUF_K0 MPT_MINIT_REST_SCHALT_K0 MPT_PO_TORUS_K0 MS_OFFEN_K0 NDS_K0ZU NDS_K0ZU_PLAUSI PG_HYSABREG_K0 P_MANUELLZU_K0 P_MAX_K0 SWI_INITVORSCHALT_K0 SWI_MANUELLZU_K0 SWI_MSCHALTK0_SP SWI_REGINITMETHODE_K0 SWI_REGRAMPSCHALT_K0 T1_K0REGELN TAB_ANFORDERUNG_P_SYS_K0 TAB_F_KDSCHALT_K0 TAB_F_KDSCHALT_K0_SP TAB_F_KISCHALT_K0 TAB_F_KISCHALT_K0_SP TAB_F_KPSCHALT_K0 TAB_F_KPSCHALT_K0_SP TAB_F_MGVMSOLLGEMVORSCHALT_K0 TAB_MPT_ZUREGELN_K0 TAB_MVG_MISTK0 TAB_MVG_NDK0 TAB_SWI_F_KI_K0 TAB_T_ZUREGELNMAX_K0 TAB_ZK0_ZUL_APERK T_REGRAMPSCHALT_K0 XDS_K0ZU XDS_K0ZU_SCHALT /end DEF_CHARACTERISTIC
/end FUNCTION
/begin FUNCTION jK0sSteurSP0_Fktn "Applikationesgroessen Instanz jK0sSteurSP0"
 /begin DEF_CHARACTERISTIC D_PT2_MSCHALTAB_K0 KF_MSCHALTK012 KF_MSCHALTK021 KF_MSCHALTK023 KF_MSCHALTK031 KF_MSCHALTK032 KF_MSCHALTK034 KF_MSCHALTK042 KF_MSCHALTK043 KF_MSCHALTK045 KF_MSCHALTK051 KF_MSCHALTK053 KF_MSCHALTK054 KF_MSCHALTK056 KF_MSCHALTK063 KF_MSCHALTK064 KF_MSCHALTK065 KF_MSCHALTK067 KF_MSCHALTK071 KF_MSCHALTK075 KF_MSCHALTK076 KF_MSCHALTK078 KF_MSCHALTK082 KF_MSCHALTK084 KF_MSCHALTK086 KF_MSCHALTK087 KL_MO_KORRMSCHALT_K0 TAB_MPT_MSCHALTAUF_K0 TAB_T_PT2_MSCHALTAB_K0 T_MSCHALT_K0 /end DEF_CHARACTERISTIC
/end FUNCTION
/begin RECORD_LAYOUT ZF_kf_fl32_S5_S3 FNC_VALUES 5 FLOAT32_IEEE ROW_DIR DIRECT AXIS_PTS_X 3 FLOAT32_IEEE INDEX_INCR DIRECT AXIS_PTS_Y 4 FLOAT32_IEEE INDEX_INCR DIRECT NO_AXIS_PTS_X 1 ULONG NO_AXIS_PTS_Y 2 ULONG /end RECORD_LAYOUT
/begin RECORD_LAYOUT ZF_kf_si16_S5_S3 FNC_VALUES 5 SWORD ROW_DIR DIRECT AXIS_PTS_X 3 SWORD INDEX_INCR DIRECT AXIS_PTS_Y 4 SWORD INDEX_INCR DIRECT NO_AXIS_PTS_X 1 ULONG NO_AXIS_PTS_Y 2 ULONG /end RECORD_LAYOUT
/begin RECORD_LAYOUT ZF_kf_ui16_S5_S3 FNC_VALUES 5 UWORD ROW_DIR DIRECT AXIS_PTS_X 3 UWORD INDEX_INCR DIRECT AXIS_PTS_Y 4 UWORD INDEX_INCR DIRECT NO_AXIS_PTS_X 1 ULONG NO_AXIS_PTS_Y 2 ULONG /end RECORD_LAYOUT
/begin RECORD_LAYOUT ZF_kl_fl32_S5_S3 FNC_VALUES 3 FLOAT32_IEEE COLUMN_DIR DIRECT AXIS_PTS_X 2 FLOAT32_IEEE INDEX_INCR DIRECT NO_AXIS_PTS_X 1 ULONG /end RECORD_LAYOUT
/begin RECORD_LAYOUT ZF_kl_si16_S5_S3 FNC_VALUES 3 SWORD COLUMN_DIR DIRECT AXIS_PTS_X 2 SWORD INDEX_INCR DIRECT NO_AXIS_PTS_X 1 ULONG /end RECORD_LAYOUT
/begin RECORD_LAYOUT ZF_kl_ui16_S5_S3 FNC_VALUES 3 UWORD COLUMN_DIR DIRECT AXIS_PTS_X 2 UWORD INDEX_INCR DIRECT NO_AXIS_PTS_X 1 ULONG /end RECORD_LAYOUT
/begin RECORD_LAYOUT ZF_kl_ui8_S5_S3 FNC_VALUES 3 UBYTE COLUMN_DIR DIRECT AXIS_PTS_X 2 UBYTE INDEX_INCR DIRECT NO_AXIS_PTS_X 1 ULONG /end RECORD_LAYOUT
/begin RECORD_LAYOUT ZF_kw_bool8_S5_S3 FNC_VALUES 1 UBYTE COLUMN_DIR DIRECT /end RECORD_LAYOUT
/begin RECORD_LAYOUT ZF_kw_fl32_S5_S3 FNC_VALUES 1 FLOAT32_IEEE COLUMN_DIR DIRECT /end RECORD_LAYOUT
/begin RECORD_LAYOUT ZF_kw_si16_S5_S3 FNC_VALUES 1 SWORD COLUMN_DIR DIRECT /end RECORD_LAYOUT
/begin RECORD_LAYOUT ZF_kw_si8_S5_S3 FNC_VALUES 1 SBYTE COLUMN_DIR DIRECT /end RECORD_LAYOUT
/begin RECORD_LAYOUT ZF_kw_ui16_S5_S3 FNC_VALUES 1 UWORD COLUMN_DIR DIRECT /end RECORD_LAYOUT
/begin RECORD_LAYOUT ZF_kw_ui32_S5_S3 FNC_VALUES 1 ULONG COLUMN_DIR DIRECT /end RECORD_LAYOUT
/begin RECORD_LAYOUT ZF_kw_ui8_S5_S3 FNC_VALUES 1 UBYTE COLUMN_DIR DIRECT /end RECORD_LAYOUT
/begin RECORD_LAYOUT ZF_tab2d_bool8_S5_S3 FNC_VALUES 3 UBYTE ROW_DIR DIRECT NO_AXIS_PTS_X 1 ULONG NO_AXIS_PTS_Y 2 ULONG /end RECORD_LAYOUT
/begin RECORD_LAYOUT ZF_tab2d_fl32_S5_S3 FNC_VALUES 3 FLOAT32_IEEE ROW_DIR DIRECT NO_AXIS_PTS_X 1 ULONG NO_AXIS_PTS_Y 2 ULONG /end RECORD_LAYOUT
/begin RECORD_LAYOUT ZF_tab2d_ui16_S5_S3 FNC_VALUES 3 UWORD ROW_DIR DIRECT NO_AXIS_PTS_X 1 ULONG NO_AXIS_PTS_Y 2 ULONG /end RECORD_LAYOUT
/begin RECORD_LAYOUT ZF_tab2d_ui8_S5_S3 FNC_VALUES 3 UBYTE ROW_DIR DIRECT NO_AXIS_PTS_X 1 ULONG NO_AXIS_PTS_Y 2 ULONG /end RECORD_LAYOUT
/begin RECORD_LAYOUT ZF_tab_bool8_S5_S3 FNC_VALUES 2 UBYTE COLUMN_DIR DIRECT NO_AXIS_PTS_X 1 ULONG /end RECORD_LAYOUT
/begin RECORD_LAYOUT ZF_tab_fl32_S5_S3 FNC_VALUES 2 FLOAT32_IEEE COLUMN_DIR DIRECT NO_AXIS_PTS_X 1 ULONG /end RECORD_LAYOUT
/begin RECORD_LAYOUT ZF_tab_si16_S5_S3 FNC_VALUES 2 SWORD COLUMN_DIR DIRECT NO_AXIS_PTS_X 1 ULONG /end RECORD_LAYOUT
/begin RECORD_LAYOUT ZF_tab_ui16_S5_S3 FNC_VALUES 2 UWORD COLUMN_DIR DIRECT NO_AXIS_PTS_X 1 ULONG /end RECORD_LAYOUT
/begin RECORD_LAYOUT ZF_tab_ui8_S5_S3 FNC_VALUES 2 UBYTE COLUMN_DIR DIRECT NO_AXIS_PTS_X 1 ULONG /end RECORD_LAYOUT
/end MODULE
/end PROJECT
