ASAP2_VERSION 1 51
/begin PROJECT ZHBC8600 "Gen2_BMW_System_Supplier_Lib"
/begin MODULE CPP ""
/begin MOD_COMMON "" BYTE_ORDER MSB_FIRST ALIGNMENT_BYTE 1 ALIGNMENT_WORD 2 ALIGNMENT_LONG 4 ALIGNMENT_FLOAT32_IEEE 4 ALIGNMENT_FLOAT64_IEEE 1 /end MOD_COMMON
/begin COMPU_VTAB CONV_TAB_E_FEHLERIEP_S6_S3 "Conversion table" TAB_VERB 2 0 "NORMALBETRIEB" 1 "FEHLER" DEFAULT_VALUE "" /end COMPU_VTAB
/begin COMPU_VTAB CONV_TAB_E_HYBFKT_S6_S3 "Conversion table" TAB_VERB 16 0 "PASSIV" 1 "ANKOPPELN_VM" 2 "ABKOPPELN_VM" 3 "GANGEINLEGEN" 4 "GANGAUSLEGEN" 5 "OHNABLAUFFKT" 6 "DIREKTSTART" 7 "VM_ZUSTART" 8 "ABSTELLEN_VM" 9 "NICHTDEFINIERT_4" 10 "VM_SCHLEPPSTART" 11 "VM_NOTSTART" 12 "VM_EIN" 13 "VM_AUS" 14 "NICHTDEFINIERT_3" 15 "FEHLER" DEFAULT_VALUE "" /end COMPU_VTAB
/begin COMPU_VTAB CONV_TAB_E_POS_S6_S3 "Conversion table" TAB_VERB 9 0 "D1" 1 "D2" 2 "D3" 3 "D4" 4 "D5" 5 "D" 6 "N" 7 "R" 8 "P" DEFAULT_VALUE "" /end COMPU_VTAB
/begin COMPU_VTAB CONV_TAB_E_SIGSTATUS_S6_S3 "Conversion table" TAB_VERB 3 0 "SIGNAL_OK" 1 "ERSATZWERT" 2 "SIGNAL_FEHLER" DEFAULT_VALUE "" /end COMPU_VTAB
/begin COMPU_VTAB CONV_TAB_E_STATUSADA_S6_S3 "Conversion table" TAB_VERB 3 0 "KEINADAPTION" 1 "TOUCHPOINT_ADAPTION" 2 "REIBWERT_ADAPTION" DEFAULT_VALUE "" /end COMPU_VTAB
/begin COMPU_VTAB CONV_TAB_E_STATUSIAE_S6_S3 "Conversion table" TAB_VERB 9 0 "NICHTDEFINIERT" 1 "OFFEN" 2 "ANGELEGT" 3 "ANFAHREN" 4 "ENTKOPPELT" 5 "ENTKOPPELT_ANFAHREN" 6 "SYNCHRONISIEREN" 7 "GESCHLOSSEN" 8 "OEFFNEN" DEFAULT_VALUE "" /end COMPU_VTAB
/begin COMPU_VTAB CONV_TAB_E_STATUSIEP_S6_S3 "Conversion table" TAB_VERB 5 0 "AUS" 1 "SLEEP" 2 "LP1" 3 "LP2" 4 "LP3" DEFAULT_VALUE "" /end COMPU_VTAB
/begin COMPU_VTAB CONV_TAB_E_STATUSK0_S6_S3 "Conversion table" TAB_VERB 6 0 "OFFEN" 1 "ANGELEGT" 2 "DRUCKSTELLUNG" 3 "SCHLUPFGEREGELT" 4 "GEREGELTGESCHL" 5 "GESCHLOSSEN" DEFAULT_VALUE "" /end COMPU_VTAB
/begin COMPU_VTAB CONV_TAB_E_STATUSKSL_S6_S3 "Conversion table" TAB_VERB 7 0 "KEIN_KRAFTSCHLUSS" 1 "VORW_AUF_ABBAUEND" 2 "VORWAERTS" 3 "RUECKW_AUF_ABBAUEND" 4 "RUECKWAERTS" 5 "VORWAERTS_SCHLUPF" 6 "RUECKWAERTS_SCHLUPF" DEFAULT_VALUE "" /end COMPU_VTAB
/begin COMPU_VTAB CONV_TAB_E_STATUSPSY_S6_S3 "Conversion table" TAB_VERB 5 0 "AUS" 1 "NICHTDEFINIERT" 2 "LP1" 3 "LP2" 4 "LP3" DEFAULT_VALUE "" /end COMPU_VTAB
/begin COMPU_VTAB CONV_TAB_E_STBZHAS_S6_S3 "Conversion table" TAB_VERB 16 0 "INIT_INAKTIV" 1 "ANGEKOPPELT" 2 "ENTKOPPELT" 3 "EFAHREN" 4 "STOP" 5 "LADEN" 6 "ENTK_VMEIN" 7 "EFAHREN_VMEIN" 8 "HYBRID" 9 "NICHTDEFINIERT_1" 10 "NICHTDEFINIERT_2" 11 "NICHTDEFINIERT_3" 12 "NICHTDEFINIERT_4" 13 "NICHTDEFINIERT_5" 14 "INIT_KL15" 15 "FEHLER" DEFAULT_VALUE "" /end COMPU_VTAB
/begin COMPU_VTAB CONV_TAB_E_ZIEP_S6_S3 "Conversion table" TAB_VERB 5 0 "AUS" 1 "SLEEP" 2 "LP1" 3 "LP2" 4 "LP3" DEFAULT_VALUE "" /end COMPU_VTAB
/begin COMPU_VTAB CONV_TAB_E_ZK0_S6_S3 "Conversion table" TAB_VERB 6 0 "OEFFNENSW" 1 "BEFUELLEN" 2 "DRUCKSTELLUNG" 3 "SCHLUPFREGELUNG" 4 "GEREGELTGESCHL" 5 "GESCHLOSSEN" DEFAULT_VALUE "" /end COMPU_VTAB
/begin COMPU_VTAB CONV_TAB_E_ZK0FSTIN_S6_S3 "Conversion table" TAB_VERB 4 0 "OFFEN" 1 "SCHLUPFGEREGELT" 2 "GEREGELTGESCHL" 3 "GESCHLOSSEN" DEFAULT_VALUE "" /end COMPU_VTAB
/begin COMPU_VTAB CONV_TAB_E_ZMODUSIAE_S6_S3 "Conversion table" TAB_VERB 3 0 "EFAHREN_SCHLUPF" 1 "EFAHREN_KRAFTSCHL" 2 "HYBRIDFAHREN" DEFAULT_VALUE "" /end COMPU_VTAB
/begin COMPU_VTAB CONV_TAB_E_ZMODUSIEP_S6_S3 "Conversion table" TAB_VERB 5 0 "KEINVORGABE" 1 "AUS" 2 "LP1" 3 "LP2" 4 "LP3" DEFAULT_VALUE "" /end COMPU_VTAB
/begin COMPU_VTAB CONV_TAB_E_ZNLLSOLL_S6_S3 "Conversion table" TAB_VERB 3 0 "KEINANF" 1 "ANF_ADAP" 2 "ANF_ALLG" DEFAULT_VALUE "" /end COMPU_VTAB
/begin COMPU_METHOD b_int_S6_S3 "Bit Feld" RAT_FUNC "%10.0" "-" COEFFS 0 1 0 0 0 1 /end COMPU_METHOD
/begin COMPU_METHOD c_int_l_S6_S3 "Temperatur" RAT_FUNC "%5.0" "°C" COEFFS 0 1 0 0 0 1 /end COMPU_METHOD
/begin COMPU_METHOD c_int_m_S6_S3 "Temperatur" RAT_FUNC "%3.0" "°C" COEFFS 0 1 0 0 0 1 /end COMPU_METHOD
/begin COMPU_METHOD c_int_S6_S3 "Temperatur" RAT_FUNC "%12.6" "°C" COEFFS 0 1 0 0 0 1 /end COMPU_METHOD
/begin COMPU_METHOD E_FEHLERIEP_S6_S3 "" TAB_VERB "%12.6" "" COMPU_TAB_REF CONV_TAB_E_FEHLERIEP_S6_S3 /end COMPU_METHOD
/begin COMPU_METHOD E_HYBFKT_S6_S3 "" TAB_VERB "%12.6" "" COMPU_TAB_REF CONV_TAB_E_HYBFKT_S6_S3 /end COMPU_METHOD
/begin COMPU_METHOD E_POS_S6_S3 "" TAB_VERB "%12.6" "" COMPU_TAB_REF CONV_TAB_E_POS_S6_S3 /end COMPU_METHOD
/begin COMPU_METHOD E_SIGSTATUS_S6_S3 "" TAB_VERB "%12.6" "" COMPU_TAB_REF CONV_TAB_E_SIGSTATUS_S6_S3 /end COMPU_METHOD
/begin COMPU_METHOD E_STATUSADA_S6_S3 "" TAB_VERB "%12.6" "" COMPU_TAB_REF CONV_TAB_E_STATUSADA_S6_S3 /end COMPU_METHOD
/begin COMPU_METHOD E_STATUSIAE_S6_S3 "" TAB_VERB "%12.6" "" COMPU_TAB_REF CONV_TAB_E_STATUSIAE_S6_S3 /end COMPU_METHOD
/begin COMPU_METHOD E_STATUSIEP_S6_S3 "" TAB_VERB "%12.6" "" COMPU_TAB_REF CONV_TAB_E_STATUSIEP_S6_S3 /end COMPU_METHOD
/begin COMPU_METHOD E_STATUSK0_S6_S3 "" TAB_VERB "%12.6" "" COMPU_TAB_REF CONV_TAB_E_STATUSK0_S6_S3 /end COMPU_METHOD
/begin COMPU_METHOD E_STATUSKSL_S6_S3 "" TAB_VERB "%12.6" "" COMPU_TAB_REF CONV_TAB_E_STATUSKSL_S6_S3 /end COMPU_METHOD
/begin COMPU_METHOD E_STATUSPSY_S6_S3 "" TAB_VERB "%12.6" "" COMPU_TAB_REF CONV_TAB_E_STATUSPSY_S6_S3 /end COMPU_METHOD
/begin COMPU_METHOD E_STBZHAS_S6_S3 "" TAB_VERB "%12.6" "" COMPU_TAB_REF CONV_TAB_E_STBZHAS_S6_S3 /end COMPU_METHOD
/begin COMPU_METHOD E_ZIEP_S6_S3 "" TAB_VERB "%12.6" "" COMPU_TAB_REF CONV_TAB_E_ZIEP_S6_S3 /end COMPU_METHOD
/begin COMPU_METHOD E_ZK0_S6_S3 "" TAB_VERB "%12.6" "" COMPU_TAB_REF CONV_TAB_E_ZK0_S6_S3 /end COMPU_METHOD
/begin COMPU_METHOD E_ZK0FSTIN_S6_S3 "" TAB_VERB "%12.6" "" COMPU_TAB_REF CONV_TAB_E_ZK0FSTIN_S6_S3 /end COMPU_METHOD
/begin COMPU_METHOD E_ZMODUSIAE_S6_S3 "" TAB_VERB "%12.6" "" COMPU_TAB_REF CONV_TAB_E_ZMODUSIAE_S6_S3 /end COMPU_METHOD
/begin COMPU_METHOD E_ZMODUSIEP_S6_S3 "" TAB_VERB "%12.6" "" COMPU_TAB_REF CONV_TAB_E_ZMODUSIEP_S6_S3 /end COMPU_METHOD
/begin COMPU_METHOD E_ZNLLSOLL_S6_S3 "" TAB_VERB "%12.6" "" COMPU_TAB_REF CONV_TAB_E_ZNLLSOLL_S6_S3 /end COMPU_METHOD
/begin COMPU_METHOD n_fl_S6_S3 "Drehzahl" RAT_FUNC "%12.6" "1/min" COEFFS 0 1 0 0 0 1 /end COMPU_METHOD
/begin COMPU_METHOD n_int_n_S6_S3 "Drehzahl" RAT_FUNC "%3.0" "1/min" COEFFS 0 1 0 0 0 1 /end COMPU_METHOD
/begin COMPU_METHOD n_int_S6_S3 "Drehzahl" RAT_FUNC "%5.0" "1/min" COEFFS 0 1 0 0 0 1 /end COMPU_METHOD
/begin COMPU_METHOD ng_fl_S6_S3 "Drehzahlgradient" RAT_FUNC "%12.6" "1/min/s" COEFFS 0 1 0 0 0 1 /end COMPU_METHOD
/begin COMPU_METHOD p_fl_S6_S3 "Druck" RAT_FUNC "%12.6" "bar" COEFFS 0 1 0 0 0 1 /end COMPU_METHOD
/begin COMPU_METHOD SAB2_K_M128_S3_S3 "int = ((phys * 1) / 1) - (-128) -" RAT_FUNC "%1.0" "-" COEFFS 0 1 128 0 0 1 /end COMPU_METHOD
/begin COMPU_METHOD SAB2_KM_10_S3_S3 "int = ((phys * 1) / 10) - (0) km" RAT_FUNC "%4.3" "km" COEFFS 0 0.1 0 0 0 1 /end COMPU_METHOD
/begin COMPU_METHOD SAB2_L_10KM_S3_S3 "int = ((phys * 1) / 10) - (0) km" RAT_FUNC "%4.3" "km" COEFFS 0 0.1 0 0 0 1 /end COMPU_METHOD
/begin COMPU_METHOD SAB2_L_10M_S3_S3 "int = ((phys * 1) / 10) - (0) m" RAT_FUNC "%4.3" "m" COEFFS 0 0.1 0 0 0 1 /end COMPU_METHOD
/begin COMPU_METHOD SAB2_L_1KM_S3_S3 "int = ((phys * 1) / 1) - (0) km" RAT_FUNC "%1.0" "km" COEFFS 0 1 0 0 0 1 /end COMPU_METHOD
/begin COMPU_METHOD t_fl_S6_S3 "Zeit" RAT_FUNC "%12.6" "s" COEFFS 0 1 0 0 0 1 /end COMPU_METHOD
/begin COMPU_METHOD t_int_d_S6_S3 "Zeit" RAT_FUNC "%4.2" "s" COEFFS 0 100 0 0 0 1 /end COMPU_METHOD
/begin COMPU_METHOD t_int_S6_S3 "Zeit" RAT_FUNC "%11.2" "s" COEFFS 0 100 0 0 0 1 /end COMPU_METHOD
/begin COMPU_METHOD trq_fl_a_S6_S3 "Moment" RAT_FUNC "%12.6" "Nm" COEFFS 0 1 0 0 0 1 /end COMPU_METHOD
/begin COMPU_METHOD trq_fl_S6_S3 "Moment" RAT_FUNC "%5.0" "Nm" COEFFS 0 1 0 0 0 1 /end COMPU_METHOD
/begin COMPU_METHOD trqg_fl_c_S6_S3 "Momentengradient" RAT_FUNC "%12.6" "Nm/s" COEFFS 0 1 0 0 0 1 /end COMPU_METHOD
/begin COMPU_METHOD trqg_fl_S6_S3 "Momentengradient" RAT_FUNC "%5.0" "Nm/s" COEFFS 0 1 0 0 0 1 /end COMPU_METHOD
/begin COMPU_METHOD UMR___1_1000_0_S5_S3 "int = ((phys * 1000) / 1) - (0) [-]" RAT_FUNC "%4.3" "[-]" COEFFS 0 1000 0 0 0 1 /end COMPU_METHOD
/begin COMPU_METHOD UMR___1_100_0_S5_S3 "int = ((phys * 100) / 1) - (0) [-]" RAT_FUNC "%3.2" "[-]" COEFFS 0 100 0 0 0 1 /end COMPU_METHOD
/begin COMPU_METHOD UMR___1_1_0_S5_S3 "int = ((phys * 1) / 1) - (0) [-]" RAT_FUNC "%1.0" "[-]" COEFFS 0 1 0 0 0 1 /end COMPU_METHOD
/begin COMPU_METHOD UMR_GRADC__1_1_M40_S5_S3 "int = ((phys * 1) / 1) - (-40) [°C]" RAT_FUNC "%1.0" "[°C]" COEFFS 0 1 40 0 0 1 /end COMPU_METHOD
/begin COMPU_METHOD UMR_KGM2__1_1000_0_S5_S3 "int = ((phys * 1000) / 1) - (0) [kg*m^2]" RAT_FUNC "%4.3" "[kg*m^2]" COEFFS 0 1000 0 0 0 1 /end COMPU_METHOD
/begin COMPU_METHOD UMR_KM_H_1_1_0_S5_S3 "int = ((phys * 1) / 1) - (0) [km/h]" RAT_FUNC "%1.0" "[km/h]" COEFFS 0 1 0 0 0 1 /end COMPU_METHOD
/begin COMPU_METHOD UMR_MA__1_10_0_S5_S3 "int = ((phys * 10) / 1) - (0) [mA]" RAT_FUNC "%2.1" "[mA]" COEFFS 0 10 0 0 0 1 /end COMPU_METHOD
/begin COMPU_METHOD UMR_NM__1_1_0_S5_S3 "int = ((phys * 1) / 1) - (0) [Nm]" RAT_FUNC "%1.0" "[Nm]" COEFFS 0 1 0 0 0 1 /end COMPU_METHOD
/begin COMPU_METHOD UMR_U_MIN_1_1_0_S5_S3 "int = ((phys * 1) / 1) - (0) [U/min]" RAT_FUNC "%1.0" "[U/min]" COEFFS 0 1 0 0 0 1 /end COMPU_METHOD
/begin COMPU_METHOD UMR_U_MINTASK_1_100_0_S5_S3 "int = ((phys * 100) / 1) - (0) [U/(min*task)]" RAT_FUNC "%3.2" "[U/(min*task)]" COEFFS 0 100 0 0 0 1 /end COMPU_METHOD
/begin COMPU_METHOD v_fl_S6_S3 "Geschwindigkeit" RAT_FUNC "%12.6" "km/h" COEFFS 0 1 0 0 0 1 /end COMPU_METHOD
/begin COMPU_METHOD vg_fl_S6_S3 "Geschwindigkeitsgradient" RAT_FUNC "%12.6" "km/h/s" COEFFS 0 1 0 0 0 1 /end COMPU_METHOD
/begin COMPU_METHOD void_fl_S6_S3 "ohne Umrechnung" RAT_FUNC "%12.6" "-" COEFFS 0 1 0 0 0 1 /end COMPU_METHOD
/begin COMPU_METHOD void_int_b_S6_S3 "ohne Umrechnung" RAT_FUNC "%5.0" "-" COEFFS 0 1 0 0 0 1 /end COMPU_METHOD
/begin COMPU_METHOD void_int_e_S6_S3 "ohne Umrechnung" RAT_FUNC "%1.0" "-" COEFFS 0 1 0 0 0 1 /end COMPU_METHOD
/begin COMPU_METHOD void_int_S6_S3 "ohne Umrechnung" RAT_FUNC "%3.0" "-" COEFFS 0 1 0 0 0 1 /end COMPU_METHOD
/begin CHARACTERISTIC ABSTELLPOS_VM_ERSATZ_HAS "Ersatzwert fuer abstellpos_vm_in (wenn SWI_ = 1)" VALUE 0x1D809E UWORD_COL_DIRECT_S6_S3 0 void_int_b_S6_S3 0 360 /end CHARACTERISTIC
/begin CHARACTERISTIC ABSTELLPOS_VM_STS_ERS_HAS "Ersatzwert fuer abstellpos_vm_status_in (wenn SWI_ = 1)" VALUE 0x1D742C UBYTE_COL_DIRECT_S6_S3 0 void_int_S6_S3 0 2 /end CHARACTERISTIC
/begin CHARACTERISTIC ANALYSE_HAS_ERSATZ_HAS "Ersatzwert für analyse_has_portout (bei SWI_ = 1)" VALUE 0x1D754A UBYTE_COL_DIRECT_S6_S3 0 void_int_S6_S3 0 8 /end CHARACTERISTIC
/begin CHARACTERISTIC CO_VM_HAS "Offset fuer negative Werte von c_vm_in" VALUE 0x1D80A0 SWORD_COL_DIRECT_S6_S3 0 c_int_l_S6_S3 -32768 32767 /end CHARACTERISTIC
/begin CHARACTERISTIC CS_EDSLOGIK "ASIL-C: Temperaturschwelle zur Aktivierung der Funktion" VALUE 0x1D7C83 ZF_kw_ui8_S5_S3 190 UMR_GRADC__1_1_M40_S5_S3 -40 150 /end CHARACTERISTIC
/begin CHARACTERISTIC C_VM_ERSATZ_HAS "Ersatzwert fuer c_vm_in (wenn SWI_ = 1)" VALUE 0x1D742D UBYTE_COL_DIRECT_S6_S3 0 c_int_m_S6_S3 0 255 /end CHARACTERISTIC
/begin CHARACTERISTIC ERR_N_SOLL_EM_NULL "Ersatzwert für das Signal err_n_soll_em_has_portout" VALUE 0x1D754B UBYTE_COL_DIRECT_S6_S3 0 void_int_S6_S3 0 1 /end CHARACTERISTIC
/begin CHARACTERISTIC ERR_N_SOLL_VM_NULL "Ersatzwert für das Signal err_n_soll_vm_has_portout" VALUE 0x1D754C UBYTE_COL_DIRECT_S6_S3 0 void_int_S6_S3 0 1 /end CHARACTERISTIC
/begin CHARACTERISTIC F_NMOTUEB "LEVEL2: Faktor Abregeldrehzahl für die Motordrehzahlueberwachung" VALUE 0x1D7C91 ZF_kw_ui8_S5_S3 0.1 UMR___1_100_0_S5_S3 1 1.1 /end CHARACTERISTIC
/begin CHARACTERISTIC IEDSC_MAX_POSVC "ASIL-C: Stromschwelle zur Erkennung ob Kupplung C geschaltet ist" VALUE 0x1D8BE8 ZF_kw_ui16_S5_S3 1200 UMR_MA__1_10_0_S5_S3 0 1200 /end CHARACTERISTIC
/begin CHARACTERISTIC I_EDSMAXPOSNUEB_A "ASIL-B: Druckreglerstromschwelle fuer die PosN-Plausi" VALUE 0x1D8BFE ZF_kw_ui16_S5_S3 1200 UMR_MA__1_10_0_S5_S3 0 1200 /end CHARACTERISTIC
/begin CHARACTERISTIC I_EDSMAXPOSNUEB_B "ASIL-B: Druckreglerstromschwelle fuer die PosN-Plausi" VALUE 0x1D8C00 ZF_kw_ui16_S5_S3 1200 UMR_MA__1_10_0_S5_S3 0 1200 /end CHARACTERISTIC
/begin CHARACTERISTIC I_EDSMAXPOSPUEB_POS "Stromschwelle für EDS_POS für Überwachung unzulässiges Auslegen Position P" VALUE 0x1D8BEC ZF_kw_ui16_S5_S3 1200 UMR_MA__1_10_0_S5_S3 0 1200 /end CHARACTERISTIC
/begin CHARACTERISTIC I_EDSMINPOSNUEB_C "ASIL-B: Druckreglerstromschwelle fuer die PosN-Plausi" VALUE 0x1D8C02 ZF_kw_ui16_S5_S3 1200 UMR_MA__1_10_0_S5_S3 0 1200 /end CHARACTERISTIC
/begin CHARACTERISTIC I_EDSMINPOSNUEB_D "ASIL-B: Druckreglerstromschwelle fuer die PosN-Plausi" VALUE 0x1D8C04 ZF_kw_ui16_S5_S3 1200 UMR_MA__1_10_0_S5_S3 0 1200 /end CHARACTERISTIC
/begin CHARACTERISTIC I_EDSMINPOSNUEB_E "ASIL-B: Druckreglerstromschwelle fuer die PosN-Plausi" VALUE 0x1D8C06 ZF_kw_ui16_S5_S3 1200 UMR_MA__1_10_0_S5_S3 0 1200 /end CHARACTERISTIC
/begin CHARACTERISTIC I_EDSMINPOSPUEB_C "ASIL-C: Stromschwelle für Kupplung C für Überwachung unzulässiges Auslegen Position P" VALUE 0x1D8BEE ZF_kw_ui16_S5_S3 1200 UMR_MA__1_10_0_S5_S3 0 1200 /end CHARACTERISTIC
/begin CHARACTERISTIC I_EDSNULLPOSNUEB "ASIL-B: Stromschwelle fuer Nullbestromung in der PosN-Plausi" VALUE 0x1D8BFC ZF_kw_ui16_S5_S3 1200 UMR_MA__1_10_0_S5_S3 0 1200 /end CHARACTERISTIC
/begin CHARACTERISTIC I_KUPB_MIN_EDSLOGIK "ASIL-B: Stromschwelle zur Erkennung ob Kupplung B geschaltet ist" VALUE 0x1D8BF8 ZF_kw_ui16_S5_S3 1200 UMR_MA__1_10_0_S5_S3 0 1200 /end CHARACTERISTIC
/begin CHARACTERISTIC I_KUPD_MAX_EDSLOGIK "ASIL-B: Stromschwelle zur Erkennung ob Kupplung D geschaltet ist" VALUE 0x1D8BF6 ZF_kw_ui16_S5_S3 1200 UMR_MA__1_10_0_S5_S3 0 1200 /end CHARACTERISTIC
/begin CHARACTERISTIC J_VM_K0 "ASIL-B: Massenträgheit des Motors" VALUE 0x1D8BF4 ZF_kw_ui16_S5_S3 1 UMR_KGM2__1_1000_0_S5_S3 0 1 /end CHARACTERISTIC
/begin CHARACTERISTIC KF_IEDSMAXMMOTCGLOGIKUEB_A "Maximale Druckreglerstromschwelle fuer EDS" MAP 0x1CF784 ZF_kf_si16_S5_S3 1200 UMR_MA__1_10_0_S5_S3 0 1200
 /begin AXIS_DESCR STD_AXIS iUl2ItfipInt.m_mot_l2 UMR_NM__1_1_0_S5_S3 4 -200 1300 DEPOSIT ABSOLUTE /end AXIS_DESCR
 /begin AXIS_DESCR STD_AXIS iUl2ItfipInt.c_getr_l2 UMR_GRADC__1_1_M40_S5_S3 4 -40 215 DEPOSIT ABSOLUTE /end AXIS_DESCR
/end CHARACTERISTIC
/begin CHARACTERISTIC KF_IEDSMAXMMOTCGLOGIKUEB_B "Maximale Druckreglerstromschwelle fuer EDS" MAP 0x1CF888 ZF_kf_si16_S5_S3 1200 UMR_MA__1_10_0_S5_S3 0 1200
 /begin AXIS_DESCR STD_AXIS iUl2ItfipInt.m_mot_l2 UMR_NM__1_1_0_S5_S3 4 -200 1300 DEPOSIT ABSOLUTE /end AXIS_DESCR
 /begin AXIS_DESCR STD_AXIS iUl2ItfipInt.c_getr_l2 UMR_GRADC__1_1_M40_S5_S3 4 -40 215 DEPOSIT ABSOLUTE /end AXIS_DESCR
/end CHARACTERISTIC
/begin CHARACTERISTIC KF_IEDSMAXOFFMMOTCGLOGIKUEB_A "Minimale Druckreglerstromschwelle fuer EDS" MAP 0x1CF7BC ZF_kf_si16_S5_S3 1200 UMR_MA__1_10_0_S5_S3 0 1200
 /begin AXIS_DESCR STD_AXIS iUl2ItfipInt.m_mot_l2 UMR_NM__1_1_0_S5_S3 4 -200 1300 DEPOSIT ABSOLUTE /end AXIS_DESCR
 /begin AXIS_DESCR STD_AXIS iUl2ItfipInt.c_getr_l2 UMR_GRADC__1_1_M40_S5_S3 4 -40 215 DEPOSIT ABSOLUTE /end AXIS_DESCR
/end CHARACTERISTIC
/begin CHARACTERISTIC KF_IEDSMAXOFFMMOTCGLOGIKUEB_B "Minimale Druckreglerstromschwelle fuer EDS" MAP 0x1CF8C0 ZF_kf_si16_S5_S3 1200 UMR_MA__1_10_0_S5_S3 0 1200
 /begin AXIS_DESCR STD_AXIS iUl2ItfipInt.m_mot_l2 UMR_NM__1_1_0_S5_S3 4 -200 1300 DEPOSIT ABSOLUTE /end AXIS_DESCR
 /begin AXIS_DESCR STD_AXIS iUl2ItfipInt.c_getr_l2 UMR_GRADC__1_1_M40_S5_S3 4 -40 215 DEPOSIT ABSOLUTE /end AXIS_DESCR
/end CHARACTERISTIC
/begin CHARACTERISTIC KF_IEDSMINMMOTCGLOGIKUEB_C "Minimale Druckreglerstromschwelle fuer EDS" MAP 0x1CF98C ZF_kf_si16_S5_S3 1200 UMR_MA__1_10_0_S5_S3 0 1200
 /begin AXIS_DESCR STD_AXIS iUl2ItfipInt.m_mot_l2 UMR_NM__1_1_0_S5_S3 4 -200 1300 DEPOSIT ABSOLUTE /end AXIS_DESCR
 /begin AXIS_DESCR STD_AXIS iUl2ItfipInt.c_getr_l2 UMR_GRADC__1_1_M40_S5_S3 4 -40 215 DEPOSIT ABSOLUTE /end AXIS_DESCR
/end CHARACTERISTIC
/begin CHARACTERISTIC KF_IEDSMINMMOTCGLOGIKUEB_D "Minimale Druckreglerstromschwelle fuer EDS" MAP 0x1CFA90 ZF_kf_si16_S5_S3 1200 UMR_MA__1_10_0_S5_S3 0 1200
 /begin AXIS_DESCR STD_AXIS iUl2ItfipInt.m_mot_l2 UMR_NM__1_1_0_S5_S3 4 -200 1300 DEPOSIT ABSOLUTE /end AXIS_DESCR
 /begin AXIS_DESCR STD_AXIS iUl2ItfipInt.c_getr_l2 UMR_GRADC__1_1_M40_S5_S3 4 -40 215 DEPOSIT ABSOLUTE /end AXIS_DESCR
/end CHARACTERISTIC
/begin CHARACTERISTIC KF_IEDSMINMMOTCGLOGIKUEB_E "Minimale Druckreglerstromschwelle fuer EDS" MAP 0x1CFB94 ZF_kf_si16_S5_S3 1200 UMR_MA__1_10_0_S5_S3 0 1200
 /begin AXIS_DESCR STD_AXIS iUl2ItfipInt.m_mot_l2 UMR_NM__1_1_0_S5_S3 4 -200 1300 DEPOSIT ABSOLUTE /end AXIS_DESCR
 /begin AXIS_DESCR STD_AXIS iUl2ItfipInt.c_getr_l2 UMR_GRADC__1_1_M40_S5_S3 4 -40 215 DEPOSIT ABSOLUTE /end AXIS_DESCR
/end CHARACTERISTIC
/begin CHARACTERISTIC KF_IEDSMINOFFMMOTCGLOGIKUEB_C "Minimale Druckreglerstromschwelle fuer EDS" MAP 0x1CF9C4 ZF_kf_si16_S5_S3 1200 UMR_MA__1_10_0_S5_S3 0 1200
 /begin AXIS_DESCR STD_AXIS iUl2ItfipInt.m_mot_l2 UMR_NM__1_1_0_S5_S3 4 -200 1300 DEPOSIT ABSOLUTE /end AXIS_DESCR
 /begin AXIS_DESCR STD_AXIS iUl2ItfipInt.c_getr_l2 UMR_GRADC__1_1_M40_S5_S3 4 -40 215 DEPOSIT ABSOLUTE /end AXIS_DESCR
/end CHARACTERISTIC
/begin CHARACTERISTIC KF_IEDSMINOFFMMOTCGLOGIKUEB_D "Minimale Druckreglerstromschwelle fuer EDS" MAP 0x1CFAC8 ZF_kf_si16_S5_S3 1200 UMR_MA__1_10_0_S5_S3 0 1200
 /begin AXIS_DESCR STD_AXIS iUl2ItfipInt.m_mot_l2 UMR_NM__1_1_0_S5_S3 4 -200 1300 DEPOSIT ABSOLUTE /end AXIS_DESCR
 /begin AXIS_DESCR STD_AXIS iUl2ItfipInt.c_getr_l2 UMR_GRADC__1_1_M40_S5_S3 4 -40 215 DEPOSIT ABSOLUTE /end AXIS_DESCR
/end CHARACTERISTIC
/begin CHARACTERISTIC KF_IEDSMINOFFMMOTCGLOGIKUEB_E "Minimale Druckreglerstromschwelle fuer EDS" MAP 0x1CFBCC ZF_kf_si16_S5_S3 1200 UMR_MA__1_10_0_S5_S3 0 1200
 /begin AXIS_DESCR STD_AXIS iUl2ItfipInt.m_mot_l2 UMR_NM__1_1_0_S5_S3 4 -200 1300 DEPOSIT ABSOLUTE /end AXIS_DESCR
 /begin AXIS_DESCR STD_AXIS iUl2ItfipInt.c_getr_l2 UMR_GRADC__1_1_M40_S5_S3 4 -40 215 DEPOSIT ABSOLUTE /end AXIS_DESCR
/end CHARACTERISTIC
/begin CHARACTERISTIC KF_MAXSTOERCGDELTAI_EDSLOGIK_A "Minimale Druckreglerstromschwelle fuer EDS" MAP 0x1CF810 ZF_kf_si16_S5_S3 255 UMR___1_1_0_S5_S3 0 255
 /begin AXIS_DESCR STD_AXIS iUl2ItfipInt.c_getr_l2 UMR_GRADC__1_1_M40_S5_S3 6 -40 215 DEPOSIT ABSOLUTE /end AXIS_DESCR
 /begin AXIS_DESCR STD_AXIS NO_INPUT_QUANTITY UMR_MA__1_10_0_S5_S3 6 0 1000 DEPOSIT ABSOLUTE /end AXIS_DESCR
/end CHARACTERISTIC
/begin CHARACTERISTIC KF_MAXSTOERCGDELTAI_EDSLOGIK_B "Minimale Druckreglerstromschwelle fuer EDS" MAP 0x1CF914 ZF_kf_si16_S5_S3 255 UMR___1_1_0_S5_S3 0 255
 /begin AXIS_DESCR STD_AXIS iUl2ItfipInt.c_getr_l2 UMR_GRADC__1_1_M40_S5_S3 6 -40 215 DEPOSIT ABSOLUTE /end AXIS_DESCR
 /begin AXIS_DESCR STD_AXIS NO_INPUT_QUANTITY UMR_MA__1_10_0_S5_S3 6 0 1000 DEPOSIT ABSOLUTE /end AXIS_DESCR
/end CHARACTERISTIC
/begin CHARACTERISTIC KF_MAXSTOERCGDELTAI_EDSLOGIK_C "Minimale Druckreglerstromschwelle fuer EDS" MAP 0x1CFA18 ZF_kf_si16_S5_S3 255 UMR___1_1_0_S5_S3 0 255
 /begin AXIS_DESCR STD_AXIS iUl2ItfipInt.c_getr_l2 UMR_GRADC__1_1_M40_S5_S3 6 -40 215 DEPOSIT ABSOLUTE /end AXIS_DESCR
 /begin AXIS_DESCR STD_AXIS NO_INPUT_QUANTITY UMR_MA__1_10_0_S5_S3 6 0 1000 DEPOSIT ABSOLUTE /end AXIS_DESCR
/end CHARACTERISTIC
/begin CHARACTERISTIC KF_MAXSTOERCGDELTAI_EDSLOGIK_D "Minimale Druckreglerstromschwelle fuer EDS" MAP 0x1CFB1C ZF_kf_si16_S5_S3 255 UMR___1_1_0_S5_S3 0 255
 /begin AXIS_DESCR STD_AXIS iUl2ItfipInt.c_getr_l2 UMR_GRADC__1_1_M40_S5_S3 6 -40 215 DEPOSIT ABSOLUTE /end AXIS_DESCR
 /begin AXIS_DESCR STD_AXIS NO_INPUT_QUANTITY UMR_MA__1_10_0_S5_S3 6 0 1000 DEPOSIT ABSOLUTE /end AXIS_DESCR
/end CHARACTERISTIC
/begin CHARACTERISTIC KF_MAXSTOERCGDELTAI_EDSLOGIK_E "Minimale Druckreglerstromschwelle fuer EDS" MAP 0x1CFC20 ZF_kf_si16_S5_S3 255 UMR___1_1_0_S5_S3 0 255
 /begin AXIS_DESCR STD_AXIS iUl2ItfipInt.c_getr_l2 UMR_GRADC__1_1_M40_S5_S3 6 -40 215 DEPOSIT ABSOLUTE /end AXIS_DESCR
 /begin AXIS_DESCR STD_AXIS NO_INPUT_QUANTITY UMR_MA__1_10_0_S5_S3 6 0 1000 DEPOSIT ABSOLUTE /end AXIS_DESCR
/end CHARACTERISTIC
/begin CHARACTERISTIC KF_MMOTGETRAUF "Zulässiges Getriebeaufnahmemoment in Abh. von der Uebersetzung und die Getriebetemperatur" MAP 0x1CF668 ZF_kf_ui16_S5_S3 1000 UMR_NM__1_1_0_S5_S3 0 1000
 /begin AXIS_DESCR STD_AXIS NO_INPUT_QUANTITY UMR___1_1000_0_S5_S3 8 0 65.535 DEPOSIT ABSOLUTE /end AXIS_DESCR
 /begin AXIS_DESCR STD_AXIS iUl2ItfipInt.c_getr_l2 UMR_GRADC__1_1_M40_S5_S3 6 -40 215 DEPOSIT ABSOLUTE /end AXIS_DESCR
/end CHARACTERISTIC
/begin CHARACTERISTIC KF_NGPOSMEUEB "Schwellwert für zulässigen Gradient bei posME bei Übersetzungswechsel" MAP 0x1CFCF8 ZF_kf_ui16_S5_S3 100 UMR_U_MINTASK_1_100_0_S5_S3 0 100
 /begin AXIS_DESCR STD_AXIS NO_INPUT_QUANTITY UMR___1_1000_0_S5_S3 8 0 65.535 DEPOSIT ABSOLUTE /end AXIS_DESCR
 /begin AXIS_DESCR STD_AXIS NO_INPUT_QUANTITY UMR_NM__1_1_0_S5_S3 4 0 65535 DEPOSIT ABSOLUTE /end AXIS_DESCR
/end CHARACTERISTIC
/begin CHARACTERISTIC KF_OFFSETMMOTGETRAUF "Offsetkennfeld" MAP 0x1CF6EC ZF_kf_ui16_S5_S3 1000 UMR_NM__1_1_0_S5_S3 0 1000
 /begin AXIS_DESCR STD_AXIS NO_INPUT_QUANTITY UMR___1_1000_0_S5_S3 8 0 65.535 DEPOSIT ABSOLUTE /end AXIS_DESCR
 /begin AXIS_DESCR STD_AXIS iUl2ItfipInt.c_getr_l2 UMR_GRADC__1_1_M40_S5_S3 6 -40 215 DEPOSIT ABSOLUTE /end AXIS_DESCR
/end CHARACTERISTIC
/begin CHARACTERISTIC KF_STSOLLBZHASHST_ZUL_HAS_W "" MAP 0x1D7496 UBYTE_COL_DIRECT_S6_S3 0 void_int_S6_S3 0 1
 /begin AXIS_DESCR COM_AXIS st_ist_bz_has_stg_mes void_int_S6_S3 11 0 15 DEPOSIT ABSOLUTE AXIS_PTS_REF KF_STSOLLBZHASHST_ZUL_HAS_X /end AXIS_DESCR
 /begin AXIS_DESCR COM_AXIS st_soll_bz_has_hst_bas void_int_S6_S3 11 0 15 DEPOSIT ABSOLUTE AXIS_PTS_REF KF_STSOLLBZHASHST_ZUL_HAS_Y /end AXIS_DESCR
/end CHARACTERISTIC
/begin AXIS_PTS KF_STSOLLBZHASHST_ZUL_HAS_X "X-Achse: st_ist_bz_has_hst_stg" 0x1D750F st_ist_bz_has_stg_mes UBYTE_X_INCR_DIRECT_S6_S3 0 void_int_S6_S3 11 0 15 DEPOSIT ABSOLUTE /end AXIS_PTS
/begin AXIS_PTS KF_STSOLLBZHASHST_ZUL_HAS_Y "Y-Achse: st_soll_bz_has_hst_bas" 0x1D751A st_soll_bz_has_hst_bas UBYTE_X_INCR_DIRECT_S6_S3 0 void_int_S6_S3 11 0 15 DEPOSIT ABSOLUTE /end AXIS_PTS
/begin CHARACTERISTIC KL_F_VGETRAUF "Faktorisierungskennfeld" CURVE 0x1CF770 ZF_kl_ui16_S5_S3 1 UMR___1_100_0_S5_S3 0 1
 /begin AXIS_DESCR STD_AXIS NO_INPUT_QUANTITY UMR_KM_H_1_1_0_S5_S3 4 0 400 DEPOSIT ABSOLUTE /end AXIS_DESCR
/end CHARACTERISTIC
/begin CHARACTERISTIC KL_IEDSMAXOFFCG_BEF1_A "Offset auf Stromschwelle zur Erkennung eines EDS-Logik-Fehlers bei 1. Befüllung" CURVE 0x1CF7F4 ZF_kl_si16_S5_S3 1200 UMR_MA__1_10_0_S5_S3 0 1200
 /begin AXIS_DESCR STD_AXIS iUl2ItfipInt.c_getr_l2 UMR_GRADC__1_1_M40_S5_S3 6 -40 215 DEPOSIT ABSOLUTE /end AXIS_DESCR
/end CHARACTERISTIC
/begin CHARACTERISTIC KL_IEDSMAXOFFCG_BEF1_B "Offset auf Stromschwelle zur Erkennung eines EDS-Logik-Fehlers bei 1. Befüllung" CURVE 0x1CF8F8 ZF_kl_si16_S5_S3 1200 UMR_MA__1_10_0_S5_S3 0 1200
 /begin AXIS_DESCR STD_AXIS iUl2ItfipInt.c_getr_l2 UMR_GRADC__1_1_M40_S5_S3 6 -40 215 DEPOSIT ABSOLUTE /end AXIS_DESCR
/end CHARACTERISTIC
/begin CHARACTERISTIC KL_IEDSMINOFFCG_BEF1_C "Offset auf Stromschwelle zur Erkennung eines EDS-Logik-Fehlers bei 1. Befüllung" CURVE 0x1CF9FC ZF_kl_si16_S5_S3 1200 UMR_MA__1_10_0_S5_S3 0 1200
 /begin AXIS_DESCR STD_AXIS iUl2ItfipInt.c_getr_l2 UMR_GRADC__1_1_M40_S5_S3 6 -40 215 DEPOSIT ABSOLUTE /end AXIS_DESCR
/end CHARACTERISTIC
/begin CHARACTERISTIC KL_IEDSMINOFFCG_BEF1_D "Offset auf Stromschwelle zur Erkennung eines EDS-Logik-Fehlers bei 1. Befüllung" CURVE 0x1CFB00 ZF_kl_si16_S5_S3 1200 UMR_MA__1_10_0_S5_S3 0 1200
 /begin AXIS_DESCR STD_AXIS iUl2ItfipInt.c_getr_l2 UMR_GRADC__1_1_M40_S5_S3 6 -40 215 DEPOSIT ABSOLUTE /end AXIS_DESCR
/end CHARACTERISTIC
/begin CHARACTERISTIC KL_IEDSMINOFFCG_BEF1_E "Offset auf Stromschwelle zur Erkennung eines EDS-Logik-Fehlers bei 1. Befüllung" CURVE 0x1CFC04 ZF_kl_si16_S5_S3 1200 UMR_MA__1_10_0_S5_S3 0 1200
 /begin AXIS_DESCR STD_AXIS iUl2ItfipInt.c_getr_l2 UMR_GRADC__1_1_M40_S5_S3 6 -40 215 DEPOSIT ABSOLUTE /end AXIS_DESCR
/end CHARACTERISTIC
/begin CHARACTERISTIC KL_I_MAXK0 "ASIL-B: Stromschwelle für KO-Erkennung" CURVE 0x1CF5E0 ZF_kl_ui16_S5_S3 1200 UMR_MA__1_10_0_S5_S3 0 1200
 /begin AXIS_DESCR STD_AXIS NO_INPUT_QUANTITY UMR___1_1000_0_S5_S3 8 0 65.535 DEPOSIT ABSOLUTE /end AXIS_DESCR
/end CHARACTERISTIC
/begin CHARACTERISTIC KL_MAXSTOER_EDSLOGIK_K0 "ASIL-C: Störzähler zur Fehlererkennung der K0" CURVE 0x1CF628 ZF_kl_ui16_S5_S3 255 UMR___1_1_0_S5_S3 0 255
 /begin AXIS_DESCR STD_AXIS NO_INPUT_QUANTITY UMR_MA__1_10_0_S5_S3 6 0 1200 DEPOSIT ABSOLUTE /end AXIS_DESCR
/end CHARACTERISTIC
/begin CHARACTERISTIC KL_MAX_STOEROFFCG_BEF1_A "Minimale Druckreglerstromschwelle fuer EDS" CURVE 0x1CF878 ZF_kl_ui8_S5_S3 255 UMR___1_1_0_S5_S3 0 255
 /begin AXIS_DESCR STD_AXIS iUl2ItfipInt.c_getr_l2 UMR_GRADC__1_1_M40_S5_S3 6 -40 215 DEPOSIT ABSOLUTE /end AXIS_DESCR
/end CHARACTERISTIC
/begin CHARACTERISTIC KL_MAX_STOEROFFCG_BEF1_B "Minimale Druckreglerstromschwelle fuer EDS" CURVE 0x1CF97C ZF_kl_ui8_S5_S3 255 UMR___1_1_0_S5_S3 0 255
 /begin AXIS_DESCR STD_AXIS iUl2ItfipInt.c_getr_l2 UMR_GRADC__1_1_M40_S5_S3 6 -40 215 DEPOSIT ABSOLUTE /end AXIS_DESCR
/end CHARACTERISTIC
/begin CHARACTERISTIC KL_MAX_STOEROFFCG_BEF1_C "Minimale Druckreglerstromschwelle fuer EDS" CURVE 0x1CFA80 ZF_kl_ui8_S5_S3 255 UMR___1_1_0_S5_S3 0 255
 /begin AXIS_DESCR STD_AXIS iUl2ItfipInt.c_getr_l2 UMR_GRADC__1_1_M40_S5_S3 6 -40 215 DEPOSIT ABSOLUTE /end AXIS_DESCR
/end CHARACTERISTIC
/begin CHARACTERISTIC KL_MAX_STOEROFFCG_BEF1_D "Minimale Druckreglerstromschwelle fuer EDS" CURVE 0x1CFB84 ZF_kl_ui8_S5_S3 255 UMR___1_1_0_S5_S3 0 255
 /begin AXIS_DESCR STD_AXIS iUl2ItfipInt.c_getr_l2 UMR_GRADC__1_1_M40_S5_S3 6 -40 215 DEPOSIT ABSOLUTE /end AXIS_DESCR
/end CHARACTERISTIC
/begin CHARACTERISTIC KL_MAX_STOEROFFCG_BEF1_E "Minimale Druckreglerstromschwelle fuer EDS" CURVE 0x1CFC88 ZF_kl_ui8_S5_S3 255 UMR___1_1_0_S5_S3 0 255
 /begin AXIS_DESCR STD_AXIS iUl2ItfipInt.c_getr_l2 UMR_GRADC__1_1_M40_S5_S3 6 -40 215 DEPOSIT ABSOLUTE /end AXIS_DESCR
/end CHARACTERISTIC
/begin CHARACTERISTIC KL_MMOTUEBNEGME1 "Schwellwert 1 fuer nicht zul. Ausgabe NEGME in Abh. von der Uebersetzung" CURVE 0x1CFD58 ZF_kl_ui16_S5_S3 1300 UMR_NM__1_1_0_S5_S3 0 1300
 /begin AXIS_DESCR STD_AXIS NO_INPUT_QUANTITY UMR___1_1000_0_S5_S3 8 0 65.535 DEPOSIT ABSOLUTE /end AXIS_DESCR
/end CHARACTERISTIC
/begin CHARACTERISTIC KL_MMOTUEBNEGME2 "Schwellwert 2 fuer nicht zul. Ausgabe NEGME in Abh. von der Uebersetzung" CURVE 0x1CFD7C ZF_kl_si16_S5_S3 1300 UMR_NM__1_1_0_S5_S3 -1300 0
 /begin AXIS_DESCR STD_AXIS NO_INPUT_QUANTITY UMR___1_1000_0_S5_S3 8 -32.768 32.767 DEPOSIT ABSOLUTE /end AXIS_DESCR
/end CHARACTERISTIC
/begin CHARACTERISTIC KL_MMOTUEBPOSME1 "Schwellwert 1 fuer nicht zul. Ausgabe POSME in Abh. von der Uebersetzung" CURVE 0x1CFCB0 ZF_kl_ui16_S5_S3 1300 UMR_NM__1_1_0_S5_S3 0 1300
 /begin AXIS_DESCR STD_AXIS NO_INPUT_QUANTITY UMR___1_1000_0_S5_S3 8 0 65.535 DEPOSIT ABSOLUTE /end AXIS_DESCR
/end CHARACTERISTIC
/begin CHARACTERISTIC KL_MMOTUEBPOSME2 "Schwellwert 2 fuer nicht zul. Ausgabe POSME in Abh. von der Uebersetzung" CURVE 0x1CFCD4 ZF_kl_ui16_S5_S3 1300 UMR_NM__1_1_0_S5_S3 0 1300
 /begin AXIS_DESCR STD_AXIS NO_INPUT_QUANTITY UMR___1_1000_0_S5_S3 8 0 65.535 DEPOSIT ABSOLUTE /end AXIS_DESCR
/end CHARACTERISTIC
/begin CHARACTERISTIC KL_M_REIB_K0 "ASIL-B: Abstützendes Moment an der Strasse" CURVE 0x1CF604 ZF_kl_ui16_S5_S3 1200 UMR_NM__1_1_0_S5_S3 0 1200
 /begin AXIS_DESCR STD_AXIS NO_INPUT_QUANTITY UMR___1_1000_0_S5_S3 8 0 65.535 DEPOSIT ABSOLUTE /end AXIS_DESCR
/end CHARACTERISTIC
/begin CHARACTERISTIC KL_N_DIFF_K0_MIN "ASIL-C: minimale Differenzdrehzahl an der K0" CURVE 0x1CF644 ZF_kl_ui16_S5_S3 4000 UMR_U_MIN_1_1_0_S5_S3 0 4000
 /begin AXIS_DESCR STD_AXIS NO_INPUT_QUANTITY UMR___1_1000_0_S5_S3 8 0 65.535 DEPOSIT ABSOLUTE /end AXIS_DESCR
/end CHARACTERISTIC
/begin CHARACTERISTIC KN_SOLLEMHST_MOD_HAS "Faktor zur Modifikation der HAS-Eingangsgröße n_soll_em_hst_in" VALUE 0x197598 FLOAT32_IEEE_COL_DIRECT_S6_S3 0 n_fl_S6_S3 -3.40282e+038 3.40282e+038 /end CHARACTERISTIC
/begin CHARACTERISTIC MAX_STOERPOSNEDS "ASIL-B: Schwellwert fuer den Ereigniszaehler Phase A der PosN-Plausi" VALUE 0x1D7C8D ZF_kw_ui8_S5_S3 255 UMR___1_1_0_S5_S3 0 255 /end CHARACTERISTIC
/begin CHARACTERISTIC MAX_STOERPOSNEDS14 "ASIL-B: Schwellwert fuer den Ereigniszaehler Phase B der PosN-Plausi" VALUE 0x1D7C8E ZF_kw_ui8_S5_S3 255 UMR___1_1_0_S5_S3 0 255 /end CHARACTERISTIC
/begin CHARACTERISTIC MAX_STOER_NMOTUEB "LEVEL2: Maximaler Grenzwert des Störzählers fuer NMOT-Uew." VALUE 0x1D7C92 ZF_kw_ui8_S5_S3 99 UMR___1_1_0_S5_S3 1 100 /end CHARACTERISTIC
/begin CHARACTERISTIC MG_SOLLK0NEG_HAS_ERSATZ_HAS "Ersatzwert für mg_soll_k0_neg_has_portout (bei SWI_ = 1)" VALUE 0x1D80D2 SWORD_COL_DIRECT_S6_S3 0 trqg_fl_S6_S3 -10000 0 /end CHARACTERISTIC
/begin CHARACTERISTIC MG_SOLLK0POS_HAS_ERSATZ_HAS "Ersatzwert für mg_soll_k0_pos_has_portout (bei SWI_ = 1)" VALUE 0x1D80D4 SWORD_COL_DIRECT_S6_S3 0 trqg_fl_S6_S3 0 10000 /end CHARACTERISTIC
/begin CHARACTERISTIC MO_MODEMHST_HAS_ERSATZ_HAS "Ersatzwert fuer mo_mod_em_hst_has_portout (wenn SWI_ = 1)" VALUE 0x1D80D6 SWORD_COL_DIRECT_S6_S3 0 trq_fl_S6_S3 -32768 32767 /end CHARACTERISTIC
/begin CHARACTERISTIC M_K0MAX_OUT_HAS "Konstante" VALUE 0x1D80D8 SWORD_COL_DIRECT_S6_S3 0 trq_fl_S6_S3 -32768 32767 /end CHARACTERISTIC
/begin CHARACTERISTIC M_K0_HAS_ERSATZ_HAS "Ersatzwert für m_k0_has_portout (bei SWI_ = 1)" VALUE 0x1D80DA SWORD_COL_DIRECT_S6_S3 0 trq_fl_S6_S3 -32768 32767 /end CHARACTERISTIC
/begin CHARACTERISTIC M_K0_MBER_HAS_ERSATZ_HAS "Ersatzwert fuer m_k0_mber_has_portout (wenn SWI_ = 1)" VALUE 0x1D80DC SWORD_COL_DIRECT_S6_S3 0 trq_fl_S6_S3 -32768 32767 /end CHARACTERISTIC
/begin CHARACTERISTIC M_MAXEM_HAS_ERSATZ_HAS "Ersatzwert fuer m_max_em_has_portout (wenn SWI_ = 1)" VALUE 0x1D80DE SWORD_COL_DIRECT_S6_S3 0 trq_fl_S6_S3 -32768 32767 /end CHARACTERISTIC
/begin CHARACTERISTIC M_MAXIAE_HAS_ERSATZ_HAS "Ersatzwert für m_max_iae_has_portout (bei SWI_ = 1)" VALUE 0x1D80E0 SWORD_COL_DIRECT_S6_S3 0 trq_fl_S6_S3 -32768 32767 /end CHARACTERISTIC
/begin CHARACTERISTIC M_MERED_MIN "Überwachungsschwelle für die Statusüberwachung des negativen Motoreingriffs" VALUE 0x1D8C1E ZF_kw_ui16_S5_S3 1000 UMR_NM__1_1_0_S5_S3 0 1000 /end CHARACTERISTIC
/begin CHARACTERISTIC M_MINEM_HAS_ERSATZ_HAS "Ersatzwert fuer m_min_em_has_portout (wenn SWI_ = 1)" VALUE 0x1D80E2 SWORD_COL_DIRECT_S6_S3 0 trq_fl_S6_S3 -32768 32767 /end CHARACTERISTIC
/begin CHARACTERISTIC M_MINVM_ERSATZ_HAS "Ersatzwert fuer m_min_vm_in (wenn SWI_ = 1)" VALUE 0x1D80B0 SWORD_COL_DIRECT_S6_S3 0 trq_fl_S6_S3 -32768 32767 /end CHARACTERISTIC
/begin CHARACTERISTIC M_MOTMAXNEGINT "Deckelung des negativen Motoristmoments" VALUE 0x1D8C1C ZF_kw_si16_S5_S3 255 UMR_NM__1_1_0_S5_S3 -255 0 /end CHARACTERISTIC
/begin CHARACTERISTIC M_MOTMAX_HAS_ERSATZ_HAS "Ersatzwert für m_motmax_has_portout (bei SWI_ = 1)" VALUE 0x1D80E4 SWORD_COL_DIRECT_S6_S3 0 trq_fl_S6_S3 -32768 32767 /end CHARACTERISTIC
/begin CHARACTERISTIC M_MOTMININT "Mindestmotormoment zum Einstieg in die Ueberwachung" VALUE 0x1D7C96 ZF_kw_ui8_S5_S3 255 UMR_NM__1_1_0_S5_S3 0 255 /end CHARACTERISTIC
/begin CHARACTERISTIC M_RESEM_HAS_ERSATZ_HAS "Ersatzwert für m_soll_res_em_has_portout (bei SWI_ = 1)" VALUE 0x1D80E6 SWORD_COL_DIRECT_S6_S3 0 trq_fl_S6_S3 -32768 32767 /end CHARACTERISTIC
/begin CHARACTERISTIC M_SOLLEM_HAS_ERSATZ_HAS "Ersatzwert für m_soll_em_has_portout (bei SWI_ = 1)" VALUE 0x1D80E8 SWORD_COL_DIRECT_S6_S3 0 trq_fl_S6_S3 -32768 32767 /end CHARACTERISTIC
/begin CHARACTERISTIC M_SOLLK0_HAS_ERSATZ_HAS "Ersatzwert für m_soll_k0_has_portout (bei SWI_ = 1)" VALUE 0x1D80EA SWORD_COL_DIRECT_S6_S3 0 trq_fl_S6_S3 -32768 32767 /end CHARACTERISTIC
/begin CHARACTERISTIC M_SOLLVMLHST_ERSATZ_HAS "Ersatzwert fuer m_soll_vm_l_hst_in (wenn SWI_ = 1)" VALUE 0x1D80B8 SWORD_COL_DIRECT_S6_S3 0 trq_fl_S6_S3 -32768 32767 /end CHARACTERISTIC
/begin CHARACTERISTIC M_WUNSCHFPWHST_ERSATZ_HAS "Ersatzwert fuer m_wunsch_fpw_hst_in (wenn SWI_ = 1)" VALUE 0x1D80BE SWORD_COL_DIRECT_S6_S3 0 trq_fl_S6_S3 -32768 32767 /end CHARACTERISTIC
/begin CHARACTERISTIC ND_MIN_SAF_HAS_ERSATZ_HAS "Ersatzwert für nd_min_saf_has_portout (bei SWI_ = 1)" VALUE 0x1D80EC UWORD_COL_DIRECT_S6_S3 0 n_int_S6_S3 0 1000 /end CHARACTERISTIC
/begin CHARACTERISTIC NO_SOLLEMHST_MOD_HAS "Offset zur Modifikation der HAS-Eingangsgröße n_soll_em_hst_in" VALUE 0x1975A0 FLOAT32_IEEE_COL_DIRECT_S6_S3 0 n_fl_S6_S3 -3.40282e+038 3.40282e+038 /end CHARACTERISTIC
/begin CHARACTERISTIC N_DIFFMAXINT "Differenzdrehzahlschwelle zum Einstieg in die Funktion" VALUE 0x1D8C1A ZF_kw_si16_S5_S3 10000 UMR_U_MIN_1_1_0_S5_S3 -5000 5000 /end CHARACTERISTIC
/begin CHARACTERISTIC N_DIFF_EM_MAX "ASIL-B: Maximal zulässige Differenzdrehzahl an der EM" VALUE 0x1D8BF2 ZF_kw_ui16_S5_S3 1200 UMR_U_MIN_1_1_0_S5_S3 0 1200 /end CHARACTERISTIC
/begin CHARACTERISTIC N_FNGABMEUEB "Filterzähler für Abtriebsdrehzahlgradient Überwachung posME" VALUE 0x1D7C95 ZF_kw_ui8_S5_S3 255 UMR___1_1_0_S5_S3 0 255 /end CHARACTERISTIC
/begin CHARACTERISTIC N_FNGTMEUEB "Filterzähler für Turbinendrehzahlgradient Überwachung posME" VALUE 0x1D7C94 ZF_kw_ui8_S5_S3 255 UMR___1_1_0_S5_S3 0 255 /end CHARACTERISTIC
/begin CHARACTERISTIC N_K0_TASKS "ASIL-B: Anzahl der Tasks bis bei Unterschreiten der K0-Stromschwelle aus der Funktion ausgestiegen wird." VALUE 0x1D7C8A ZF_kw_ui8_S5_S3 255 UMR_NM__1_1_0_S5_S3 0 255 /end CHARACTERISTIC
/begin CHARACTERISTIC N_KUP_OFFEN "ASIL-C: Zähler zur Verzögerung der Erkennung - Schaltelement nicht geschaltet" VALUE 0x1D7C8F ZF_kw_ui8_S5_S3 5 UMR___1_1_0_S5_S3 0 5 /end CHARACTERISTIC
/begin CHARACTERISTIC N_KUP_OFFEN_STROMLOS "ASIL-C: Zähler zur Verzögerung der Stromlos-Erkennung - Schaltelement nicht geschaltet" VALUE 0x1D7C90 ZF_kw_ui8_S5_S3 5 UMR___1_1_0_S5_S3 0 5 /end CHARACTERISTIC
/begin CHARACTERISTIC N_MAXKABPOS_C "ASIL-C: Zähler zur erweiterten Erkennungn Kupplung C nicht geschaltet bei Teilfunktion Plausibilisierung Aktuatoransteuerung/ Sollposition eines Kraftschlusswechsels" VALUE 0x1D7C84 ZF_kw_ui8_S5_S3 255 UMR___1_1_0_S5_S3 0 255 /end CHARACTERISTIC
/begin CHARACTERISTIC N_MAXKABPOS_E "ASIL-C: Zähler zur erweiterten Erkennungn Kupplung E nicht geschaltet bei Teilfunktion Plausibilisierung Aktuatoransteuerung/ Sollposition eines Kraftschlusswechsels" VALUE 0x1D7C85 ZF_kw_ui8_S5_S3 255 UMR___1_1_0_S5_S3 0 255 /end CHARACTERISTIC
/begin CHARACTERISTIC N_MAXKFLWECHSEL "ASIL-C: Zähler zur Erkennung eines Kraftschlusswechsels" VALUE 0x1D7C86 ZF_kw_ui8_S5_S3 255 UMR___1_1_0_S5_S3 0 255 /end CHARACTERISTIC
/begin CHARACTERISTIC N_MAXSTOERMGETRAUF "Schwellwert für den Störzähler" VALUE 0x1D8BFA ZF_kw_ui16_S5_S3 255 UMR___1_1_0_S5_S3 0 255 /end CHARACTERISTIC
/begin CHARACTERISTIC N_MAXSTOERNEGMEAUS "Schwellwert für die Fehlerreaktion (unerlaubter NEGME)" VALUE 0x1D8C18 ZF_kw_ui16_S5_S3 2000 UMR___1_1_0_S5_S3 0 2000 /end CHARACTERISTIC
/begin CHARACTERISTIC N_MAXSTOERNEGMEINT1 "Schwellwert 1 für die Fehlerreaktion (Intensitaet NEGME)" VALUE 0x1D8C16 ZF_kw_ui16_S5_S3 1000 UMR___1_1_0_S5_S3 0 1000 /end CHARACTERISTIC
/begin CHARACTERISTIC N_MAXSTOERPOSMEAUS "Schwellwert für die Fehlerreaktion (unerlaubter POSME)" VALUE 0x1D8C0C ZF_kw_ui16_S5_S3 2000 UMR___1_1_0_S5_S3 0 2000 /end CHARACTERISTIC
/begin CHARACTERISTIC N_MAXSTOERPOSMEGRADIENT "Schwellwert für die Fehlerreaktion Gradient posME" VALUE 0x1D8C14 ZF_kw_ui16_S5_S3 1000 UMR___1_1_0_S5_S3 0 1000 /end CHARACTERISTIC
/begin CHARACTERISTIC N_MAXSTOERPOSMEINT1 "Schwellwert 1 für die Fehlerreaktion (Intensitaet POSME)" VALUE 0x1D8C0E ZF_kw_ui16_S5_S3 1000 UMR___1_1_0_S5_S3 0 1000 /end CHARACTERISTIC
/begin CHARACTERISTIC N_MAXSTOERPOSMEINT2 "Schwellwert 2 für die Fehlerreaktion (Intensitaet POSME)" VALUE 0x1D8C10 ZF_kw_ui16_S5_S3 1000 UMR___1_1_0_S5_S3 0 1000 /end CHARACTERISTIC
/begin CHARACTERISTIC N_MAXSTOERPOS_P "Störzähler für Überwachung unzulässiges Auslegen Position P" VALUE 0x1D7C87 ZF_kw_ui8_S5_S3 255 UMR___1_1_0_S5_S3 0 255 /end CHARACTERISTIC
/begin CHARACTERISTIC N_MAXSTOERVPLAUSIPOS_P "ASIL-C: Stoerzaehler fuer Ueberwachung unzulaessiges Einlegen Position P" VALUE 0x1D7C88 ZF_kw_ui8_S5_S3 255 UMR___1_1_0_S5_S3 0 255 /end CHARACTERISTIC
/begin CHARACTERISTIC N_MINEM_HAS_ERSATZ_HAS "Ersatzwert für n_mot_llsoll_has_portout (bei SWI_ = 1)" VALUE 0x1D80EE UWORD_COL_DIRECT_S6_S3 0 n_int_S6_S3 0 2550 /end CHARACTERISTIC
/begin CHARACTERISTIC N_MOTABREGEL_OFFSET "LEVEL2: Drehzahloffset auf Motordrehzahlminimum für die Abregeldrehzahlnachführung bei Reduzierung der Vorgabe" VALUE 0x1D8C0A ZF_kw_ui16_S5_S3 2000 UMR_U_MIN_1_1_0_S5_S3 0 2000 /end CHARACTERISTIC
/begin CHARACTERISTIC N_NMOTABREGEL_VORGABE "LEVEL2: Zählerschwelle für Absenkung der Abregeldrehzahlschwelle nach einer Reduzierung der Vorgabe" VALUE 0x1D8C08 ZF_kw_ui16_S5_S3 999 UMR___1_1_0_S5_S3 1 1000 /end CHARACTERISTIC
/begin CHARACTERISTIC N_OFFSET_ME "Offset zw. gem. Turbinendrehzahl und errechneter zur Schaltungserkennung Posme Überw." VALUE 0x1D8C12 ZF_kw_ui16_S5_S3 1000 UMR_U_MIN_1_1_0_S5_S3 0 1000 /end CHARACTERISTIC
/begin CHARACTERISTIC N_SOLLEMHST_ERSATZ_HAS "Ersatzwert fuer n_soll_em_hst_in (wenn SWI_ = 1)" VALUE 0x1D80C8 UWORD_COL_DIRECT_S6_S3 0 n_int_S6_S3 0 65535 /end CHARACTERISTIC
/begin CHARACTERISTIC N_SOLLEM_HAS_ERSATZ_HAS "Ersatzwert für n_soll_em_has_portout (bei SWI_ = 1)" VALUE 0x1D80F0 UWORD_COL_DIRECT_S6_S3 0 n_int_S6_S3 0 8000 /end CHARACTERISTIC
/begin CHARACTERISTIC N_SOLLVM_HAS_ERSATZ_HAS "Ersatzwert für n_soll_vm_has_portout (bei SWI_ = 1)" VALUE 0x1D80F2 UWORD_COL_DIRECT_S6_S3 0 n_int_S6_S3 0 8000 /end CHARACTERISTIC
/begin CHARACTERISTIC N_STOER_MAX_FAHRTR_EDSLOGIK "ASIL-B: Störzählerschwelle zur Anfilterung des KFC1_POSLEV2" VALUE 0x1D7C8C ZF_kw_ui8_S5_S3 255 UMR___1_1_0_S5_S3 0 255 /end CHARACTERISTIC
/begin CHARACTERISTIC N_VERZ_EDSLOGIK "ASIL-B: Entprellzeit für RGang-Erkennung" VALUE 0x1D7C8B ZF_kw_ui8_S5_S3 255 UMR___1_1_0_S5_S3 0 255 /end CHARACTERISTIC
/begin CHARACTERISTIC N_VPOSPUEB "ASIL-C: Verzögerungszähler für Einstieg in Überwachung (Degradation)" VALUE 0x1D8BF0 ZF_kw_ui16_S5_S3 400 UMR___1_1_0_S5_S3 0 400 /end CHARACTERISTIC
/begin CHARACTERISTIC STATUS_ABLAUFAKTIV_ERS_HAS "Ersatzwert für status_ablaufaktiv_has_portout (bei SWI_ = 1)" VALUE 0x1D754D UBYTE_COL_DIRECT_S6_S3 0 void_int_S6_S3 0 255 /end CHARACTERISTIC
/begin CHARACTERISTIC STATUS_ABLAUF_HAS_ERS_HAS "Ersatzwert für status_ablauf_has_portout (bei SWI_ = 1)" VALUE 0x1D754E UBYTE_COL_DIRECT_S6_S3 0 void_int_S6_S3 0 255 /end CHARACTERISTIC
/begin CHARACTERISTIC STATUS_BETRBER_AUS_HAS "Abschaltschwellwert der Portin-Größe (GET_FAHR_BEREIT) zur Rücknahme der Betriebsbereitschaft  des Hybridsystems in der HAS - status_betriebsbereit_hst_in" VALUE 0x1D7434 UBYTE_COL_DIRECT_S6_S3 0 void_int_S6_S3 0 255 /end CHARACTERISTIC
/begin CHARACTERISTIC STATUS_BETRBER_EIN_HAS "Einschaltschwellwert der Portin-Größe (GET_FAHR_BEREIT) zur Erkennung der Betriebsbereitschaft  des Hybridsystems in der HAS - status_betriebsbereit_hst_in" VALUE 0x1D7435 UBYTE_COL_DIRECT_S6_S3 0 void_int_S6_S3 0 255 /end CHARACTERISTIC
/begin CHARACTERISTIC STATUS_BETRIEBSBER_ERS_HAS "Ersatzwert fuer status_betriebsbereit_hst_in (wenn SWI_ = 1)" VALUE 0x1D7436 UBYTE_COL_DIRECT_S6_S3 0 void_int_S6_S3 0 255 /end CHARACTERISTIC
/begin CHARACTERISTIC STATUS_EFAHREN_HAS_ERS_HAS "Ersatzwert für status_efahren_has_portout (bei SWI_ = 1)" VALUE 0x1D754F UBYTE_COL_DIRECT_S6_S3 0 void_int_S6_S3 0 255 /end CHARACTERISTIC
/begin CHARACTERISTIC STATUS_LLVM_ERSATZ_HAS "Ersatzwert fuer status_ll_vm_in (wenn SWI_ = 1)" VALUE 0x1D743F UBYTE_COL_DIRECT_S6_S3 0 void_int_S6_S3 0 255 /end CHARACTERISTIC
/begin CHARACTERISTIC STATUS_NREGEMHST_ERSATZ_HAS "Ersatzwert fuer status_nreg_em_hst_in (wenn SWI_ = 1)" VALUE 0x1D7441 UBYTE_COL_DIRECT_S6_S3 0 void_int_S6_S3 0 255 /end CHARACTERISTIC
/begin CHARACTERISTIC STATUS_SAVM_ERSATZ_HAS "Ersatzwert fuer status_sa_vm_in (wenn SWI_ = 1)" VALUE 0x1D7444 UBYTE_COL_DIRECT_S6_S3 0 void_int_S6_S3 0 3 /end CHARACTERISTIC
/begin CHARACTERISTIC ST_IST_BZ_HAS_ERSATZ_HAS "Ersatzwert fuer st_ist_bz_has_portout (wenn SWI_ = 1)" VALUE 0x1D7550 UBYTE_COL_DIRECT_S6_S3 0 void_int_S6_S3 0 255 /end CHARACTERISTIC
/begin CHARACTERISTIC ST_ZIEL_BZ_HAS_ERSATZ_HAS "Ersatzwert fuer st_ziel_bz_has_portout (wenn SWI_ = 1)" VALUE 0x1D7551 UBYTE_COL_DIRECT_S6_S3 0 void_int_S6_S3 0 255 /end CHARACTERISTIC
/begin CHARACTERISTIC SWI_ABSTELLPOS_VM_ERSATZ_HAS "Schalter fuer Ersatzwert abstellpos_vm_in (Ersatzwert bei 1)" VALUE 0x1D7446 UBYTE_COL_DIRECT_S6_S3 0 void_int_e_S6_S3 0 1 /end CHARACTERISTIC
/begin CHARACTERISTIC SWI_ABSTELLPOS_VM_STS_ERS_HAS "Schalter fuer Ersatzwert abstellpos_vm_status_in (Ersatzwert bei 1)" VALUE 0x1D7447 UBYTE_COL_DIRECT_S6_S3 0 void_int_e_S6_S3 0 1 /end CHARACTERISTIC
/begin CHARACTERISTIC SWI_ANALYSE_HAS_ERSATZ_HAS "Schalter für Ersatzwert für analyse_has_portout (bei SWI_ = 1)  " VALUE 0x1D7552 UBYTE_COL_DIRECT_S6_S3 0 void_int_S6_S3 0 1 /end CHARACTERISTIC
/begin CHARACTERISTIC SWI_C_VM_ERSATZ_HAS "Schalter fuer Ersatzwert c_vm_in (Ersatzwert bei 1)" VALUE 0x1D7449 UBYTE_COL_DIRECT_S6_S3 0 void_int_e_S6_S3 0 1 /end CHARACTERISTIC
/begin CHARACTERISTIC SWI_FLAGOFFPOSME "Schalter fuer internes Prüfflag immer auf 0" VALUE 0x1D7C93 ZF_kw_ui8_S5_S3 1 UMR___1_1_0_S5_S3 0 1 /end CHARACTERISTIC
/begin CHARACTERISTIC SWI_K0UEB "ASIL-B: zum Umschalten des Berechnungsverfahrens der Fehlererkennung" VALUE 0x1D7C89 ZF_kw_ui8_S5_S3 3 UMR___1_1_0_S5_S3 0 3 /end CHARACTERISTIC
/begin CHARACTERISTIC SWI_MK0ABSOUT_AKTIV_HAS "Schalter fuer Absolutwert m_k0_has" VALUE 0x1D7553 UBYTE_COL_DIRECT_S6_S3 0 void_int_S6_S3 0 1 /end CHARACTERISTIC
/begin CHARACTERISTIC SWI_MK0HASOUT_MK0MOD_HAS "Schalter zur Aktivierung des modifizierten K0-Moments als Bsiswert für das K0-Istmoment der HAS" VALUE 0x1D7554 UBYTE_COL_DIRECT_S6_S3 0 void_int_S6_S3 0 1 /end CHARACTERISTIC
/begin CHARACTERISTIC SWI_MK0HASOUT_ZK0_HAS "Schalter zur Aktivierung der Berücksichtigung von z_k0_has bei der Bestimmung des Istmoments K0 der HAS" VALUE 0x1D7555 UBYTE_COL_DIRECT_S6_S3 0 void_int_S6_S3 0 1 /end CHARACTERISTIC
/begin CHARACTERISTIC SWI_MO_MODEMHST_HAS_ERSATZ_HAS "Schalter fuer Ersatzwert mo_mod_em_hst_has_portout (Ersatzwert bei 1)" VALUE 0x1D7556 UBYTE_COL_DIRECT_S6_S3 0 void_int_S6_S3 0 1 /end CHARACTERISTIC
/begin CHARACTERISTIC SWI_M_K0_HAS_ERSATZ_HAS "Schalter fuer Ersatzwert m_k0_has_portout (Ersatzwert bei 1)" VALUE 0x1D7557 UBYTE_COL_DIRECT_S6_S3 0 void_int_S6_S3 0 1 /end CHARACTERISTIC
/begin CHARACTERISTIC SWI_M_K0_MBER_HAS_ERSATZ_HAS "Schalter fuer Ersatzwert m_k0_mber_has_portout (Ersatzwert bei 1)" VALUE 0x1D7558 UBYTE_COL_DIRECT_S6_S3 0 void_int_S6_S3 0 1 /end CHARACTERISTIC
/begin CHARACTERISTIC SWI_M_MAXEM_HAS_ERSATZ_HAS "Schalter fuer Ersatzwert m_max_em_has_portout (Ersatzwert bei 1)" VALUE 0x1D7559 UBYTE_COL_DIRECT_S6_S3 0 void_int_S6_S3 0 1 /end CHARACTERISTIC
/begin CHARACTERISTIC SWI_M_MAXIAE_HAS_ERSATZ_HAS "Schalter fuer Ersatzwert m_max_iae_has_portout (Ersatzwert bei 1)" VALUE 0x1D755A UBYTE_COL_DIRECT_S6_S3 0 void_int_S6_S3 0 1 /end CHARACTERISTIC
/begin CHARACTERISTIC SWI_M_MINEM_HAS_ERSATZ_HAS "Schalter fuer Ersatzwert m_min_em_has_portout (Ersatzwert bei 1)" VALUE 0x1D755B UBYTE_COL_DIRECT_S6_S3 0 void_int_S6_S3 0 1 /end CHARACTERISTIC
/begin CHARACTERISTIC SWI_M_MINVM_ERSATZ_HAS "Schalter fuer Ersatzwert m_min_vm_in (Ersatzwert bei 1)" VALUE 0x1D7451 UBYTE_COL_DIRECT_S6_S3 0 void_int_e_S6_S3 0 1 /end CHARACTERISTIC
/begin CHARACTERISTIC SWI_M_MOTMAX_HAS_ERSATZ_HAS "Schalter fuer Ersatzwert m_motmax_has_portout (Ersatzwert bei 1)" VALUE 0x1D755C UBYTE_COL_DIRECT_S6_S3 0 void_int_S6_S3 0 1 /end CHARACTERISTIC
/begin CHARACTERISTIC SWI_M_RESEM_HAS_ERSATZ_HAS "Schalter fuer Ersatzwert m_soll_res_em_has_portout (Ersatzwert bei 1)" VALUE 0x1D755D UBYTE_COL_DIRECT_S6_S3 0 void_int_S6_S3 0 1 /end CHARACTERISTIC
/begin CHARACTERISTIC SWI_M_SOLLEM_HAS_ERSATZ_HAS "Schalter fuer Ersatzwert m_soll_em_has_portout (Ersatzwert bei 1)" VALUE 0x1D755E UBYTE_COL_DIRECT_S6_S3 0 void_int_S6_S3 0 1 /end CHARACTERISTIC
/begin CHARACTERISTIC SWI_M_SOLLK0_HAS_ERSATZ_HAS "Schalter fuer Ersatzwert m_soll_k0_has_portout (Ersatzwert bei 1)" VALUE 0x1D755F UBYTE_COL_DIRECT_S6_S3 0 void_int_S6_S3 0 1 /end CHARACTERISTIC
/begin CHARACTERISTIC SWI_M_SOLLVMLHST_ERSATZ_HAS "Schalter fuer Ersatzwert m_soll_vm_l_hst_in (Ersatzwert bei 1)" VALUE 0x1D7455 UBYTE_COL_DIRECT_S6_S3 0 void_int_e_S6_S3 0 1 /end CHARACTERISTIC
/begin CHARACTERISTIC SWI_M_WUNSCHFPWHST_ERSATZ_HAS "Schalter fuer Ersatzwert m_wunsch_fpw_hst_in (Ersatzwert bei 1)" VALUE 0x1D7458 UBYTE_COL_DIRECT_S6_S3 0 void_int_e_S6_S3 0 1 /end CHARACTERISTIC
/begin CHARACTERISTIC SWI_M_WUNSCHFPWHST_IN_HAS "Auswahl der Eingangsgröße für das Fahrerwunschmoment der HST - 0 = SUMME(m_soll_vm_hst_in,m_soll_em_hst_in); 1= m_wunsch_fpw_in; 2 = m_mot_in; 3 = m_wunsch_fpw_hst_in" VALUE 0x1D7459 UBYTE_COL_DIRECT_S6_S3 0 void_int_S6_S3 0 3 /end CHARACTERISTIC
/begin CHARACTERISTIC SWI_ND_MIN_SAF_HAS_ERSATZ_HAS "Schalter für Ersatzwert für nd_min_saf_has_portout (bei SWI_ = 1)  " VALUE 0x1D7560 UBYTE_COL_DIRECT_S6_S3 0 void_int_S6_S3 0 1 /end CHARACTERISTIC
/begin CHARACTERISTIC SWI_N_MINEM_HAS_ERSATZ_HAS "Schalter fuer Ersatzwert n_mot_llsoll_has_portout (Ersatzwert bei 1)" VALUE 0x1D7561 UBYTE_COL_DIRECT_S6_S3 0 void_int_S6_S3 0 1 /end CHARACTERISTIC
/begin CHARACTERISTIC SWI_N_SOLLEMHST_ERSATZ_HAS "Schalter fuer Ersatzwert n_soll_em_hst_in (Ersatzwert bei 1)" VALUE 0x1D745F UBYTE_COL_DIRECT_S6_S3 0 void_int_e_S6_S3 0 1 /end CHARACTERISTIC
/begin CHARACTERISTIC SWI_N_SOLLEM_HAS_ERSATZ_HAS "Schalter fuer Ersatzwert n_soll_em_has_portout (Ersatzwert bei 1)" VALUE 0x1D7562 UBYTE_COL_DIRECT_S6_S3 0 void_int_S6_S3 0 1 /end CHARACTERISTIC
/begin CHARACTERISTIC SWI_N_SOLLVM_HAS_ERSATZ_HAS "Schalter fuer Ersatzwert n_soll_vm_has_portout (Ersatzwert bei 1)" VALUE 0x1D7563 UBYTE_COL_DIRECT_S6_S3 0 void_int_S6_S3 0 1 /end CHARACTERISTIC
/begin CHARACTERISTIC SWI_STATUS_ABLAUFAKTIV_ERS_HAS "Schalter fuer Ersatzwert status_ablaufaktiv_has_portout (Ersatzwert bei 1)" VALUE 0x1D7564 UBYTE_COL_DIRECT_S6_S3 0 void_int_S6_S3 0 1 /end CHARACTERISTIC
/begin CHARACTERISTIC SWI_STATUS_ABLAUF_HAS_ERS_HAS "Schalter fuer Ersatzwert status_ablauf_has_portout (Ersatzwert bei 1)" VALUE 0x1D7565 UBYTE_COL_DIRECT_S6_S3 0 void_int_S6_S3 0 1 /end CHARACTERISTIC
/begin CHARACTERISTIC SWI_STATUS_BETRIEBSBER_ERS_HAS "Schalter fuer Ersatzwert status_betriebsbereit_hst_in (Ersatzwert bei 1)" VALUE 0x1D7469 UBYTE_COL_DIRECT_S6_S3 0 void_int_e_S6_S3 0 1 /end CHARACTERISTIC
/begin CHARACTERISTIC SWI_STATUS_EFAHREN_HAS_ERS_HAS "Schalter fuer Ersatzwert status_efahren_has_portout (Ersatzwert bei 1)" VALUE 0x1D7566 UBYTE_COL_DIRECT_S6_S3 0 void_int_S6_S3 0 1 /end CHARACTERISTIC
/begin CHARACTERISTIC SWI_STATUS_NREGEMHST_ERSATZ_HAS "Schalter fuer Ersatzwert status_nreg_em_hst_in (Ersatzwert bei 1)" VALUE 0x1D7473 UBYTE_COL_DIRECT_S6_S3 0 void_int_e_S6_S3 0 1 /end CHARACTERISTIC
/begin CHARACTERISTIC SWI_STATUS_SAVM_ERSATZ_HAS "Schalter fuer Ersatzwert status_sa_vm_in (Ersatzwert bei 1)" VALUE 0x1D7476 UBYTE_COL_DIRECT_S6_S3 0 void_int_e_S6_S3 0 1 /end CHARACTERISTIC
/begin CHARACTERISTIC SWI_ST_IST_BZ_HAS_ERSATZ_HAS "Schalter fuer Ersatzwert st_ist_bz_has_portout (Ersatzwert bei 1)" VALUE 0x1D7567 UBYTE_COL_DIRECT_S6_S3 0 void_int_S6_S3 0 1 /end CHARACTERISTIC
/begin CHARACTERISTIC SWI_ST_ZIEL_BZ_HAS_ERSATZ_HAS "Schalter fuer Ersatzwert st_ziel_bz_has_portout (Ersatzwert bei 1)" VALUE 0x1D7568 UBYTE_COL_DIRECT_S6_S3 0 void_int_S6_S3 0 1 /end CHARACTERISTIC
/begin CHARACTERISTIC SWI_T_BETRIEB_PVU_ERSATZ_HAS "Schalter fuer Ersatzwert für t_betrieb_pvu_has_portout" VALUE 0x1D7569 UBYTE_COL_DIRECT_S6_S3 0 void_int_S6_S3 0 1 /end CHARACTERISTIC
/begin CHARACTERISTIC SWI_Z_BAHASK0HST_ERSATZ_HAS "Schalter fuer Ersatzwert z_ba_has_k0_hst_in (Ersatzwert bei 1)" VALUE 0x1D747C UBYTE_COL_DIRECT_S6_S3 0 void_int_e_S6_S3 0 1 /end CHARACTERISTIC
/begin CHARACTERISTIC SWI_Z_BAHASVMHST_ERSATZ_HAS "Schalter fuer Ersatzwert z_ba_has_vm_hst_in (Ersatzwert bei 1)" VALUE 0x1D747D UBYTE_COL_DIRECT_S6_S3 0 void_int_e_S6_S3 0 1 /end CHARACTERISTIC
/begin CHARACTERISTIC SWI_Z_FREIGABE_PVU_ERSATZ_HAS "Schalter fuer Ersatzwert für z_freigabe_pvu_has_portout" VALUE 0x1D756A UBYTE_COL_DIRECT_S6_S3 0 void_int_S6_S3 0 1 /end CHARACTERISTIC
/begin CHARACTERISTIC SWI_Z_GLSBE_HAS_ERS_HAS "Schalter fuer Ersatzwert z_glsbe_has_portout (Ersatzwert bei 1)" VALUE 0x1D756B UBYTE_COL_DIRECT_S6_S3 0 void_int_S6_S3 0 1 /end CHARACTERISTIC
/begin CHARACTERISTIC SWI_Z_K0BEFUELLOPT_HAS_ERS_HAS "Schalter für Ersatzwert für z_k0_befuellopt_has_portout (bei SWI_ = 1)  " VALUE 0x1D756C UBYTE_COL_DIRECT_S6_S3 0 void_int_S6_S3 0 1 /end CHARACTERISTIC
/begin CHARACTERISTIC SWI_Z_K0_HAS_ERSATZ_HAS "Schalter fuer Ersatzwert z_k0_has_portout (Ersatzwert bei 1)" VALUE 0x1D756D UBYTE_COL_DIRECT_S6_S3 0 void_int_S6_S3 0 1 /end CHARACTERISTIC
/begin CHARACTERISTIC SWI_Z_MMAXIAE_HAS_ERSATZ_HAS "Schalter fuer Ersatzwert z_m_max_iae_has_portout (Ersatzwert bei 1)" VALUE 0x1D756E UBYTE_COL_DIRECT_S6_S3 0 void_int_S6_S3 0 1 /end CHARACTERISTIC
/begin CHARACTERISTIC SWI_Z_MODUS_IAE_HAS_ERSATZ_HAS "Schalter fuer Ersatzwert z_modus_iae_has_portout (Ersatzwert bei 1)" VALUE 0x1D756F UBYTE_COL_DIRECT_S6_S3 0 void_int_S6_S3 0 1 /end CHARACTERISTIC
/begin CHARACTERISTIC SWI_Z_MODUS_IEP_HAS_ERSATZ_HAS "Schalter für Ersatzwert iep_soll_has_portout (bei SWI_ = 1)" VALUE 0x1D7570 UBYTE_COL_DIRECT_S6_S3 0 void_int_S6_S3 0 1 /end CHARACTERISTIC
/begin CHARACTERISTIC SWI_Z_MSA_HAS_ERSATZ_HAS "Schalter fuer Ersatzwert z_msa_has_portout (Ersatzwert bei 1)" VALUE 0x1D7571 UBYTE_COL_DIRECT_S6_S3 0 void_int_S6_S3 0 1 /end CHARACTERISTIC
/begin CHARACTERISTIC SWI_Z_MSOLLEM_HAS_ERSATZ_HAS "Schalter fuer Ersatzwert z_m_soll_em_has_portout (Ersatzwert bei 1)" VALUE 0x1D7572 UBYTE_COL_DIRECT_S6_S3 0 void_int_S6_S3 0 1 /end CHARACTERISTIC
/begin CHARACTERISTIC SWI_Z_NSOLLEM_HAS_ERSATZ_HAS "Schalter fuer Ersatzwert z_n_soll_em_has_portout (Ersatzwert bei 1)" VALUE 0x1D7573 UBYTE_COL_DIRECT_S6_S3 0 void_int_S6_S3 0 1 /end CHARACTERISTIC
/begin CHARACTERISTIC SWI_Z_NSOLLVM_HAS_ERSATZ_HAS "Schalter fuer Ersatzwert z_n_soll_vm_has_portout (Ersatzwert bei 1)" VALUE 0x1D7574 UBYTE_COL_DIRECT_S6_S3 0 void_int_S6_S3 0 1 /end CHARACTERISTIC
/begin CHARACTERISTIC SWI_Z_P_HYS_K0_HAS_ERSATZ_HAS "Schalter für Ersatzwert z_p_hys_k0_has_portout" VALUE 0x1D7575 UBYTE_COL_DIRECT_S6_S3 0 void_int_S6_S3 0 1 /end CHARACTERISTIC
/begin CHARACTERISTIC SWI_Z_SAF_HAS_ERSATZ_HAS "Schalter fuer Ersatzwert z_saf_has_portout (Ersatzwert bei 1)" VALUE 0x1D7576 UBYTE_COL_DIRECT_S6_S3 0 void_int_S6_S3 0 1 /end CHARACTERISTIC
/begin CHARACTERISTIC SWI_Z_SAS_HAS_ERSATZ_HAS "Schalter für z_sas_has_portout (bei SWI_ = 1)" VALUE 0x1D7577 UBYTE_COL_DIRECT_S6_S3 0 void_int_S6_S3 0 1 /end CHARACTERISTIC
/begin CHARACTERISTIC SWI_Z_START_MODUS_HAS_ERS_HAS "Schalter für Ersatzwert z_start_modus_has_portout" VALUE 0x1D7578 UBYTE_COL_DIRECT_S6_S3 0 void_int_S6_S3 0 1 /end CHARACTERISTIC
/begin CHARACTERISTIC SWI_Z_STSPSYSMPS_ERSATZ_HAS "Schalter für Ersatzwert z_status_psys_mps_portout" VALUE 0x1D7579 UBYTE_COL_DIRECT_S6_S3 0 void_int_S6_S3 0 1 /end CHARACTERISTIC
/begin CHARACTERISTIC SWI_Z_SVH_HAS_ERSATZ_HAS "Schalter für Ersatzwert z_svh_has_portout" VALUE 0x1D757A UBYTE_COL_DIRECT_S6_S3 0 void_int_S6_S3 0 1 /end CHARACTERISTIC
/begin CHARACTERISTIC TAB_MK0MAXOUT_AKTIV_HAS "Tabelle fuer die Berechnung von m_k0_has" VAL_BLK 0x1D7547 UBYTE_COL_DIRECT_S6_S3 0 void_int_S6_S3 0 255 MATRIX_DIM 3 1 1 /end CHARACTERISTIC
/begin CHARACTERISTIC TAB_NMOTUEBDSCOFF "gangabhängige Tab. für die Vorgabe der Maxi.drehzahl bei DSC-Ausfall" CURVE 0x1CFC98 ZF_tab_ui16_S5_S3 10000 UMR___1_1_0_S5_S3 0 10000
 /begin AXIS_DESCR FIX_AXIS zff_atsys._.iSignale._.obj.sig_zielgang UMR___1_1_0_S5_S3 10 -1 8 READ_ONLY FIX_AXIS_PAR_DIST -1 1 10 /end AXIS_DESCR
/end CHARACTERISTIC
/begin CHARACTERISTIC T_BETRIEB_PVU_ERSATZ_HAS "Ersatzwert für t_betrieb_pvu_has_portout (bei SWI_ = 1)" VALUE 0x1975BC ULONG_COL_DIRECT_S6_S3 0 t_int_S6_S3 0 42949672.95 /end CHARACTERISTIC
/begin CHARACTERISTIC T_MSOLLEMHST_HAS "Verzögerungszeit des EM Sollmoment der HST für die Berechnung des Fahrerwunschmoments der HST" VALUE 0x1975AC FLOAT32_IEEE_COL_DIRECT_S6_S3 0 t_fl_S6_S3 -3.40282e+038 3.40282e+038 /end CHARACTERISTIC
/begin CHARACTERISTIC T_MSOLLVMHST_HAS "Verzögerungszeit des VM Sollmoment der HST für die Berechnung des Fahrerwunschmoments der HST" VALUE 0x1975B0 FLOAT32_IEEE_COL_DIRECT_S6_S3 0 t_fl_S6_S3 -3.40282e+038 3.40282e+038 /end CHARACTERISTIC
/begin CHARACTERISTIC VS_FZG_RSICH_LEV2 "ASIL-C: Fahrzeuggeschwindigkeitsschwelle fuer R-Gang" VALUE 0x1D8BEA ZF_kw_ui16_S5_S3 400 UMR_KM_H_1_1_0_S5_S3 0 400 /end CHARACTERISTIC
/begin CHARACTERISTIC Z_BAHASK0HST_ERSATZ_HAS "Ersatzwert fuer z_ba_has_k0_hst_in (wenn SWI_ = 1)" VALUE 0x1D748B UBYTE_COL_DIRECT_S6_S3 0 void_int_S6_S3 0 1 /end CHARACTERISTIC
/begin CHARACTERISTIC Z_BAHASVMHST_ERSATZ_HAS "Ersatzwert fuer z_ba_has_vm_hst_in (wenn SWI_ = 1)" VALUE 0x1D748C UBYTE_COL_DIRECT_S6_S3 0 void_int_S6_S3 0 1 /end CHARACTERISTIC
/begin CHARACTERISTIC Z_FREIGABE_PVU_ERSATZ_HAS "Ersatzwert für z_freigabe_pvu_has_portout (bei SWI_ = 1)" VALUE 0x1D757B UBYTE_COL_DIRECT_S6_S3 0 void_int_S6_S3 0 1 /end CHARACTERISTIC
/begin CHARACTERISTIC Z_GLSBE_HAS_ERS_HAS "Ersatzwert für z_glsbe_has_portout (bei SWI_ = 1)" VALUE 0x1D757C UBYTE_COL_DIRECT_S6_S3 0 void_int_S6_S3 0 255 /end CHARACTERISTIC
/begin CHARACTERISTIC Z_K0BEFUELLOPT_HAS_ERS_HAS "Ersatzwert für z_k0_befuellopt_has_portout (bei SWI_ = 1)" VALUE 0x1D757D UBYTE_COL_DIRECT_S6_S3 0 void_int_S6_S3 0 2 /end CHARACTERISTIC
/begin CHARACTERISTIC Z_K0_HAS_ERSATZ_HAS "Ersatzwert für z_k0_has_portout (bei SWI_ = 1)" VALUE 0x1D757E UBYTE_COL_DIRECT_S6_S3 0 void_int_S6_S3 0 255 /end CHARACTERISTIC
/begin CHARACTERISTIC Z_MMAXIAE_HAS_ERSATZ_HAS "Ersatzwert für z_m_max_iae_has_portout (bei SWI_ = 1)" VALUE 0x1D757F UBYTE_COL_DIRECT_S6_S3 0 void_int_S6_S3 0 255 /end CHARACTERISTIC
/begin CHARACTERISTIC Z_MODUS_IAE_HAS_ERSATZ_HAS "Ersatzwert für z_modus_iae_has_portout (bei SWI_ = 1)" VALUE 0x1D7580 UBYTE_COL_DIRECT_S6_S3 0 void_int_S6_S3 0 255 /end CHARACTERISTIC
/begin CHARACTERISTIC Z_MODUS_IEP_HAS_ERSATZ_HAS "Ersatzwert für iep_soll_has_portout (bei SWI_ = 1)" VALUE 0x1D7581 UBYTE_COL_DIRECT_S6_S3 0 void_int_S6_S3 0 255 /end CHARACTERISTIC
/begin CHARACTERISTIC Z_MSA_HAS_ERSATZ_HAS "Ersatzwert für z_msa_has_portout (bei SWI_ = 1)" VALUE 0x1D7582 UBYTE_COL_DIRECT_S6_S3 0 void_int_S6_S3 0 255 /end CHARACTERISTIC
/begin CHARACTERISTIC Z_MSOLLEM_HAS_ERSATZ_HAS "Ersatzwert für z_m_soll_em_has_portout (bei SWI_ = 1)" VALUE 0x1D7583 UBYTE_COL_DIRECT_S6_S3 0 void_int_S6_S3 0 255 /end CHARACTERISTIC
/begin CHARACTERISTIC Z_NSOLLEM_HAS_ERSATZ_HAS "Ersatzwert für z_n_soll_em_has_portout (bei SWI_ = 1)" VALUE 0x1D7584 UBYTE_COL_DIRECT_S6_S3 0 void_int_S6_S3 0 255 /end CHARACTERISTIC
/begin CHARACTERISTIC Z_NSOLLVM_HAS_ERSATZ_HAS "Ersatzwert für z_n_soll_vm_has_portout (bei SWI_ = 1)" VALUE 0x1D7585 UBYTE_COL_DIRECT_S6_S3 0 void_int_S6_S3 0 255 /end CHARACTERISTIC
/begin CHARACTERISTIC Z_P_HYS_K0_HAS_ERSATZ_HAS "Ersatzwert für z_p_hys_k0_has_portout (bei SWI_ = 1)" VALUE 0x1D7586 UBYTE_COL_DIRECT_S6_S3 0 void_int_S6_S3 0 255 /end CHARACTERISTIC
/begin CHARACTERISTIC Z_SAF_HAS_ERSATZ_HAS "Ersatzwert für z_saf_has (bei SWI_ = 1)" VALUE 0x1D7587 UBYTE_COL_DIRECT_S6_S3 0 void_int_S6_S3 0 1 /end CHARACTERISTIC
/begin CHARACTERISTIC Z_SAS_HAS_ERSATZ_HAS "Ersatzwert für z_sas_has_portout (bei SWI_ = 1)" VALUE 0x1D7588 UBYTE_COL_DIRECT_S6_S3 0 void_int_S6_S3 0 255 /end CHARACTERISTIC
/begin CHARACTERISTIC Z_SBE_HAS_ERS_HAS "Ersatzwert für flag_verbot_schalt_aktiv_has (bei SWI_ = 1)" VALUE 0x1D7589 UBYTE_COL_DIRECT_S6_S3 0 void_int_S6_S3 0 255 /end CHARACTERISTIC
/begin CHARACTERISTIC Z_START_MODUS_HAS_ERS_HAS "Ersatzwert für z_start_modus_has_portout (bei SWI_ = 1)" VALUE 0x1D758A UBYTE_COL_DIRECT_S6_S3 0 void_int_S6_S3 0 255 /end CHARACTERISTIC
/begin CHARACTERISTIC Z_STSOLLBZHSTMIN_HAS "Minimale Anzahl der Programmdurchlaeufe zur Uebernahme des Soll-Betriebszustands der Hybridstrategie nach einer Aenderung innerhalb der Betriebszustaende 1 bis 8 bei der Einbindung der HST-Einbindung Variante 2" VALUE 0x1D7495 UBYTE_COL_DIRECT_S6_S3 0 void_int_S6_S3 0 100 /end CHARACTERISTIC
/begin CHARACTERISTIC Z_STSPSYSMPS_ERSATZ_HAS "Ersatzwert für z_status_psys_mps_portout (bei SWI_ = 1)" VALUE 0x1D758B UBYTE_COL_DIRECT_S6_S3 0 void_int_S6_S3 0 255 /end CHARACTERISTIC
/begin CHARACTERISTIC Z_SVH_HAS_ERSATZ_HAS "Ersatzwert für z_svh_has_portout (bei SWI_ = 1)" VALUE 0x1D758C UBYTE_COL_DIRECT_S6_S3 0 void_int_S6_S3 0 255 /end CHARACTERISTIC
/begin MEASUREMENT abstellpos_vm_portin "Abstellposition VM vor nächstem ZOT" UBYTE void_int_S6_S3 1 100 0 180 ECU_ADDRESS 0xFFF8666B /end MEASUREMENT
/begin MEASUREMENT abstellpos_vm_status_portin "Status Abstellposition VM" UBYTE void_int_S6_S3 1 100 0 2 ECU_ADDRESS 0xFFF8666C /end MEASUREMENT
/begin MEASUREMENT analyse_has_byp "" UBYTE void_int_S6_S3 1 100 0 255 ECU_ADDRESS 0xFFF96DED /end MEASUREMENT
/begin MEASUREMENT bErrorHybrid "" UBYTE void_int_S6_S3 1 100 0 15 ECU_ADDRESS 0xFFF86666 /end MEASUREMENT
/begin MEASUREMENT bExceptionHybrid "" UBYTE void_int_S6_S3 1 100 0 15 ECU_ADDRESS 0xFFF86667 /end MEASUREMENT
/begin MEASUREMENT byp_vnr_has_byp "" UBYTE void_int_S6_S3 1 100 0 255 ECU_ADDRESS 0xFFF96DEE /end MEASUREMENT
/begin MEASUREMENT bypass_has_aktiv "" UBYTE void_int_S6_S3 1 100 0 255 ECU_ADDRESS 0xFFF96DEF /end MEASUREMENT
/begin MEASUREMENT c_getriebe_egs_in "" FLOAT32_IEEE c_int_S6_S3 1 100 -40 215 ECU_ADDRESS 0xFFF85DDC /end MEASUREMENT
/begin MEASUREMENT c_vm_portin "" UBYTE c_int_m_S6_S3 1 100 0 255 ECU_ADDRESS 0xFFF8666D /end MEASUREMENT
/begin MEASUREMENT err_n_soll_em_has_komp_portout "" UBYTE void_int_S6_S3 1 100 254 255 ECU_ADDRESS 0xFFF86217 /end MEASUREMENT
/begin MEASUREMENT err_n_soll_vm_has_komp_portout "" UBYTE void_int_S6_S3 1 100 254 255 ECU_ADDRESS 0xFFF86219 /end MEASUREMENT
/begin MEASUREMENT gangwechsel_egs_in "Flag während laufender Schaltung, bei synchron verlassen bis synchron erreicht" UBYTE void_int_S6_S3 1 100 0 1 ECU_ADDRESS 0xFFF86677 /end MEASUREMENT
/begin MEASUREMENT has_aktiv_has_byp "" UBYTE void_int_S6_S3 1 100 0 255 ECU_ADDRESS 0xFFF96DF0 /end MEASUREMENT
/begin MEASUREMENT i_istgang_egs "" FLOAT32_IEEE void_fl_S6_S3 1 100 0 8 ECU_ADDRESS 0xFFF85D8C /end MEASUREMENT
/begin MEASUREMENT i_zielgang_egs "" FLOAT32_IEEE void_fl_S6_S3 1 100 0 8 ECU_ADDRESS 0xFFF85D90 /end MEASUREMENT
/begin MEASUREMENT istgang_egs_in "" SBYTE void_int_S6_S3 1 100 -128 127 ECU_ADDRESS 0xFFF86678 /end MEASUREMENT
/begin MEASUREMENT m_em_in "" FLOAT32_IEEE trq_fl_a_S6_S3 1 100 -1024 1024 ECU_ADDRESS 0xFFF85DE0 /end MEASUREMENT
/begin MEASUREMENT m_iae_in "" FLOAT32_IEEE trq_fl_a_S6_S3 1 100 -32768 32767 ECU_ADDRESS 0xFFF85DE4 /end MEASUREMENT
/begin MEASUREMENT m_k0_fkt "" FLOAT32_IEEE trq_fl_a_S6_S3 1 100 -1200 1200 ECU_ADDRESS 0xFFF85D48 /end MEASUREMENT
/begin MEASUREMENT m_k0_has_byp "" SWORD trq_fl_S6_S3 1 100 -32768 32767 ECU_ADDRESS 0xFFF96EFE /end MEASUREMENT
/begin MEASUREMENT m_k0_in "" FLOAT32_IEEE trq_fl_a_S6_S3 1 100 -32768 32767 ECU_ADDRESS 0xFFF85DE8 /end MEASUREMENT
/begin MEASUREMENT m_k0_mber_has_byp "" SWORD trq_fl_S6_S3 1 100 -32768 32767 ECU_ADDRESS 0xFFF96F00 /end MEASUREMENT
/begin MEASUREMENT m_k0_mber_has_sbe "K0-Moment der HAS zur Motormomentbegrenzung in der SAB" FLOAT32_IEEE trq_fl_a_S6_S3 1 100 -3.40282e+038 3.40282e+038 ECU_ADDRESS 0xFFF85DC4 /end MEASUREMENT
/begin MEASUREMENT m_k0_mod_has_fkt "" FLOAT32_IEEE trq_fl_a_S6_S3 1 100 -1200 1200 ECU_ADDRESS 0xFFF85D4C /end MEASUREMENT
/begin MEASUREMENT m_max_dyn_em_in "" FLOAT32_IEEE trq_fl_a_S6_S3 1 100 -32768 32767 ECU_ADDRESS 0xFFF85DEC /end MEASUREMENT
/begin MEASUREMENT m_max_em_has_byp "" SWORD trq_fl_S6_S3 1 100 -32768 32767 ECU_ADDRESS 0xFFF96F02 /end MEASUREMENT
/begin MEASUREMENT m_max_em_has_fkt "" FLOAT32_IEEE trq_fl_a_S6_S3 1 100 -1200 1200 ECU_ADDRESS 0xFFF85D50 /end MEASUREMENT
/begin MEASUREMENT m_max_iae_has_byp "" SWORD trq_fl_S6_S3 1 100 -32768 32767 ECU_ADDRESS 0xFFF96F04 /end MEASUREMENT
/begin MEASUREMENT m_max_iae_has_fkt "" FLOAT32_IEEE trq_fl_a_S6_S3 1 100 -1200 1200 ECU_ADDRESS 0xFFF85D54 /end MEASUREMENT
/begin MEASUREMENT m_max_vm_portin "" SWORD trq_fl_S6_S3 1 100 -32767 32767 ECU_ADDRESS 0xFFF860CE /end MEASUREMENT
/begin MEASUREMENT m_min_dyn_em_in "" FLOAT32_IEEE trq_fl_a_S6_S3 1 100 -3.40282e+038 3.40282e+038 ECU_ADDRESS 0xFFF85DF0 /end MEASUREMENT
/begin MEASUREMENT m_min_em_has_byp "" SWORD trq_fl_S6_S3 1 100 -32768 32767 ECU_ADDRESS 0xFFF96F06 /end MEASUREMENT
/begin MEASUREMENT m_min_em_has_fkt "" FLOAT32_IEEE trq_fl_a_S6_S3 1 100 -1200 1200 ECU_ADDRESS 0xFFF85D58 /end MEASUREMENT
/begin MEASUREMENT m_min_vm_portin "" UWORD trq_fl_S6_S3 1 100 0 65535 ECU_ADDRESS 0xFFF860D0 /end MEASUREMENT
/begin MEASUREMENT m_mot_in "" FLOAT32_IEEE trq_fl_a_S6_S3 1 100 -1024 1024 ECU_ADDRESS 0xFFF85DF4 /end MEASUREMENT
/begin MEASUREMENT m_motmax_has "" FLOAT32_IEEE trq_fl_a_S6_S3 1 100 -1200 1200 ECU_ADDRESS 0xFFF85DC8 /end MEASUREMENT
/begin MEASUREMENT m_motmax_has_byp "" SWORD trq_fl_S6_S3 1 100 -32768 32767 ECU_ADDRESS 0xFFF96F08 /end MEASUREMENT
/begin MEASUREMENT m_motmax_has_komp_portout "Komplement zu geführtem Getriebeschutz " SWORD trq_fl_S6_S3 1 100 -32768 32767 ECU_ADDRESS 0xFFF86076 /end MEASUREMENT
/begin MEASUREMENT m_soll_em_has_byp "" SWORD trq_fl_S6_S3 1 100 -32768 32767 ECU_ADDRESS 0xFFF96F0A /end MEASUREMENT
/begin MEASUREMENT m_soll_em_has_fkt "" FLOAT32_IEEE trq_fl_a_S6_S3 1 100 -1200 1200 ECU_ADDRESS 0xFFF85D5C /end MEASUREMENT
/begin MEASUREMENT m_soll_em_has_komp_portout "" SWORD trq_fl_S6_S3 1 100 -32768 32767 ECU_ADDRESS 0xFFF8607A /end MEASUREMENT
/begin MEASUREMENT m_soll_em_hst_in "" FLOAT32_IEEE trq_fl_a_S6_S3 1 100 -32768 32767 ECU_ADDRESS 0xFFF85DF8 /end MEASUREMENT
/begin MEASUREMENT m_soll_em_hst_verz "Verzögertes EM Sollmoment der HST für die Berechnung des Fahrerwunschmoments der HST" FLOAT32_IEEE trq_fl_a_S6_S3 1 100 -3.40282e+038 3.40282e+038 ECU_ADDRESS 0xFFF963B8 /end MEASUREMENT
/begin MEASUREMENT m_soll_k0_has_byp "" SWORD trq_fl_S6_S3 1 100 -32768 32767 ECU_ADDRESS 0xFFF96F0C /end MEASUREMENT
/begin MEASUREMENT m_soll_k0_has_fkt "" FLOAT32_IEEE trq_fl_a_S6_S3 1 100 -1200 1200 ECU_ADDRESS 0xFFF85D60 /end MEASUREMENT
/begin MEASUREMENT m_soll_res_em_bas_sbe "" FLOAT32_IEEE trq_fl_a_S6_S3 1 100 -3.40282e+038 3.40282e+038 ECU_ADDRESS 0xFFF85DCC /end MEASUREMENT
/begin MEASUREMENT m_soll_res_em_has_azg "AZG-Signal für m_soll_res_em_has" SWORD trq_fl_S6_S3 1 100 -32767 32767 ECU_ADDRESS 0xFFF96EF0 /end MEASUREMENT
/begin MEASUREMENT m_soll_res_em_has_byp "" SWORD trq_fl_S6_S3 1 100 -32768 32767 ECU_ADDRESS 0xFFF96F0E /end MEASUREMENT
/begin MEASUREMENT m_soll_res_em_has_fkt "" FLOAT32_IEEE trq_fl_a_S6_S3 1 100 -1200 1200 ECU_ADDRESS 0xFFF85D64 /end MEASUREMENT
/begin MEASUREMENT m_soll_res_em_has_sbe "" FLOAT32_IEEE trq_fl_a_S6_S3 1 100 -3.40282e+038 3.40282e+038 ECU_ADDRESS 0xFFF85DD0 /end MEASUREMENT
/begin MEASUREMENT m_soll_vm_has_fkt "" FLOAT32_IEEE trq_fl_a_S6_S3 1 100 -1200 1200 ECU_ADDRESS 0xFFF85D68 /end MEASUREMENT
/begin MEASUREMENT m_soll_vm_hst_in "" FLOAT32_IEEE trq_fl_a_S6_S3 1 100 -32768 32767 ECU_ADDRESS 0xFFF85DFC /end MEASUREMENT
/begin MEASUREMENT m_soll_vm_hst_verz "Verzögertes VM Sollmoment der HST für die Berechnung des Fahrerwunschmoments der HST" FLOAT32_IEEE trq_fl_a_S6_S3 1 100 -3.40282e+038 3.40282e+038 ECU_ADDRESS 0xFFF963BC /end MEASUREMENT
/begin MEASUREMENT m_soll_vm_l_has_fkt "" FLOAT32_IEEE trq_fl_a_S6_S3 1 100 -1200 1200 ECU_ADDRESS 0xFFF85D6C /end MEASUREMENT
/begin MEASUREMENT m_soll_vm_l_hst_portin "Sollfüllungsmoment V-Motor (Luftpfad) der Hybridstrategie" SWORD trq_fl_S6_S3 1 100 -32767 32767 ECU_ADDRESS 0xFFF860D2 /end MEASUREMENT
/begin MEASUREMENT m_vm_in "" FLOAT32_IEEE trq_fl_a_S6_S3 1 100 -1024 1023.5 ECU_ADDRESS 0xFFF85E00 /end MEASUREMENT
/begin MEASUREMENT m_vm_start_in "" FLOAT32_IEEE trq_fl_a_S6_S3 1 100 -1024 1023.5 ECU_ADDRESS 0xFFF85E04 /end MEASUREMENT
/begin MEASUREMENT m_wunsch_fpw_hst_fil "" FLOAT32_IEEE trqg_fl_c_S6_S3 1 100 -2000 2000 ECU_ADDRESS 0xFFF85D94 /end MEASUREMENT
/begin MEASUREMENT m_wunsch_fpw_hst_portin "gefiltertes Motorsollmoment inklusive aller Momenteneingriffe exkl. Getriebe-Me" SWORD trq_fl_S6_S3 1 100 -32768 32767 ECU_ADDRESS 0xFFF860D4 /end MEASUREMENT
/begin MEASUREMENT m_wunsch_fpw_in "" FLOAT32_IEEE trq_fl_a_S6_S3 1 100 -32768 32767 ECU_ADDRESS 0xFFF85E08 /end MEASUREMENT
/begin MEASUREMENT mg_max_em_has_fkt "" FLOAT32_IEEE trqg_fl_c_S6_S3 1 100 -3000 3000 ECU_ADDRESS 0xFFF85D70 /end MEASUREMENT
/begin MEASUREMENT mg_min_em_has_fkt "" FLOAT32_IEEE trqg_fl_c_S6_S3 1 100 -3000 3000 ECU_ADDRESS 0xFFF85D74 /end MEASUREMENT
/begin MEASUREMENT mg_soll_K0_fkt "" FLOAT32_IEEE trqg_fl_c_S6_S3 1 100 -3000 3000 ECU_ADDRESS 0xFFF85D78 /end MEASUREMENT
/begin MEASUREMENT mg_soll_k0_has_fkt "" FLOAT32_IEEE trqg_fl_c_S6_S3 1 100 -3000 3000 ECU_ADDRESS 0xFFF85D7C /end MEASUREMENT
/begin MEASUREMENT mg_soll_k0_neg_has_byp "" SWORD trqg_fl_S6_S3 1 100 -32768 32767 ECU_ADDRESS 0xFFF96F10 /end MEASUREMENT
/begin MEASUREMENT mg_soll_k0_pos_has_byp "" SWORD trqg_fl_S6_S3 1 100 -32768 32767 ECU_ADDRESS 0xFFF96F12 /end MEASUREMENT
/begin MEASUREMENT mg_wunsch_fpw "" FLOAT32_IEEE trqg_fl_c_S6_S3 1 100 -2000 2000 ECU_ADDRESS 0xFFF85D98 /end MEASUREMENT
/begin MEASUREMENT mg_wunsch_fpw_hst "" FLOAT32_IEEE trqg_fl_c_S6_S3 1 100 -2000 2000 ECU_ADDRESS 0xFFF85D9C /end MEASUREMENT
/begin MEASUREMENT mo_mod_em_hst_has_byp "" SWORD trq_fl_S6_S3 1 100 -32768 32767 ECU_ADDRESS 0xFFF96F14 /end MEASUREMENT
/begin MEASUREMENT mod_K0_fkt "" UBYTE void_int_S6_S3 1 100 0 50 ECU_ADDRESS 0xFFF8663A /end MEASUREMENT
/begin MEASUREMENT n_ab_egs_in "" FLOAT32_IEEE n_fl_S6_S3 1 100 0 65535 ECU_ADDRESS 0xFFF85E0C /end MEASUREMENT
/begin MEASUREMENT n_em_in "" FLOAT32_IEEE n_fl_S6_S3 1 100 -3.40282e+038 3.40282e+038 ECU_ADDRESS 0xFFF85E10 /end MEASUREMENT
/begin MEASUREMENT n_min_em_has_sbe "Minimale EM Drehzahl der Leerlaufsimulation der HAS (LLS)" FLOAT32_IEEE n_fl_S6_S3 1 100 -32767 32767 ECU_ADDRESS 0xFFF85DD4 /end MEASUREMENT
/begin MEASUREMENT n_min_em_has_sbe_has_byp "" SWORD n_int_S6_S3 1 100 -32768 32767 ECU_ADDRESS 0xFFF96F16 /end MEASUREMENT
/begin MEASUREMENT n_min_psys_em_has_sbe "Minimale EM Drehzahl zur Sicherstellung Ölversorgung" FLOAT32_IEEE n_fl_S6_S3 1 100 -32767 32767 ECU_ADDRESS 0xFFF85DA0 /end MEASUREMENT
/begin MEASUREMENT n_mot_llsoll_has_komp_portout "" UBYTE n_int_n_S6_S3 1 100 0 255 ECU_ADDRESS 0xFFF8621C /end MEASUREMENT
/begin MEASUREMENT n_mot_soll_iae_in "" FLOAT32_IEEE n_fl_S6_S3 1 100 -3.40282e+038 3.40282e+038 ECU_ADDRESS 0xFFF85E14 /end MEASUREMENT
/begin MEASUREMENT n_sec_iae "" FLOAT32_IEEE n_fl_S6_S3 1 100 -10000 10000 ECU_ADDRESS 0xFFF85DA4 /end MEASUREMENT
/begin MEASUREMENT n_soll_em_has_byp "" SWORD n_int_S6_S3 1 100 -32768 32767 ECU_ADDRESS 0xFFF96F18 /end MEASUREMENT
/begin MEASUREMENT n_soll_em_has_fkt "" FLOAT32_IEEE n_fl_S6_S3 1 100 0 8000 ECU_ADDRESS 0xFFF85D80 /end MEASUREMENT
/begin MEASUREMENT n_soll_em_has_komp_portout "" UWORD n_int_S6_S3 1 100 57535 65535 ECU_ADDRESS 0xFFF86086 /end MEASUREMENT
/begin MEASUREMENT n_soll_em_hst_portin "" UWORD n_int_S6_S3 1 100 0 65535 ECU_ADDRESS 0xFFF860D6 /end MEASUREMENT
/begin MEASUREMENT n_soll_ll_vm_in "" FLOAT32_IEEE n_fl_S6_S3 1 100 0 2540 ECU_ADDRESS 0xFFF85E18 /end MEASUREMENT
/begin MEASUREMENT n_soll_vm_has_byp "" SWORD n_int_S6_S3 1 100 -32768 32767 ECU_ADDRESS 0xFFF96F1A /end MEASUREMENT
/begin MEASUREMENT n_soll_vm_has_fkt "" FLOAT32_IEEE n_fl_S6_S3 1 100 0 8000 ECU_ADDRESS 0xFFF85D84 /end MEASUREMENT
/begin MEASUREMENT n_soll_vm_has_komp_portout "" UWORD n_int_S6_S3 1 100 57535 65535 ECU_ADDRESS 0xFFF8608A /end MEASUREMENT
/begin MEASUREMENT n_t_egs_in "" FLOAT32_IEEE n_fl_S6_S3 1 100 0 65535 ECU_ADDRESS 0xFFF85E1C /end MEASUREMENT
/begin MEASUREMENT n_vm_in "" FLOAT32_IEEE n_fl_S6_S3 1 100 0 65535 ECU_ADDRESS 0xFFF85E20 /end MEASUREMENT
/begin MEASUREMENT nd_iae "" FLOAT32_IEEE n_fl_S6_S3 1 100 -10000 10000 ECU_ADDRESS 0xFFF85DA8 /end MEASUREMENT
/begin MEASUREMENT nd_k0_in "" FLOAT32_IEEE n_fl_S6_S3 1 100 -10000 10000 ECU_ADDRESS 0xFFF85DAC /end MEASUREMENT
/begin MEASUREMENT nd_min_saf_has_byp "" UWORD n_int_S6_S3 1 100 0 65535 ECU_ADDRESS 0xFFF96F1C /end MEASUREMENT
/begin MEASUREMENT nd_soll_iae_fkt "Differenzdrehzahl der Anfahrkupplung" FLOAT32_IEEE ng_fl_S6_S3 1 100 -8000 8000 ECU_ADDRESS 0xFFF85D88 /end MEASUREMENT
/begin MEASUREMENT ndg_k0_in "" FLOAT32_IEEE ng_fl_S6_S3 1 100 -10000 10000 ECU_ADDRESS 0xFFF85DB0 /end MEASUREMENT
/begin MEASUREMENT ng_vm "" FLOAT32_IEEE ng_fl_S6_S3 1 100 -10000 10000 ECU_ADDRESS 0xFFF85DB4 /end MEASUREMENT
/begin MEASUREMENT osmode_next_in "" UBYTE void_int_S6_S3 1 100 1 3 ECU_ADDRESS 0xFFF86679 /end MEASUREMENT
/begin MEASUREMENT p_bremse_fzg_in "" FLOAT32_IEEE p_fl_S6_S3 1 100 -32000 0 ECU_ADDRESS 0xFFF85E24 /end MEASUREMENT
/begin MEASUREMENT pc_ok_has_byp "" UBYTE void_int_S6_S3 1 100 0 255 ECU_ADDRESS 0xFFF96DF1 /end MEASUREMENT
/begin MEASUREMENT phi_neigung_in "Fahrzeug-Neigungswinkel" FLOAT32_IEEE void_fl_S6_S3 1 100 -3.40282e+038 3.40282e+038 ECU_ADDRESS 0xFFF85E28 /end MEASUREMENT
/begin MEASUREMENT pos_egs_in "Waehlhebelposition" UBYTE E_POS_S6_S3 1 100 0 8 ECU_ADDRESS 0xFFF8667A /end MEASUREMENT
/begin MEASUREMENT sollgang_egs_in "" SBYTE void_int_S6_S3 1 100 -128 127 ECU_ADDRESS 0xFFF8667B /end MEASUREMENT
/begin MEASUREMENT st_OMLID_act_stg "Innere Zustände der OML" UWORD void_int_b_S6_S3 1 100 0 4999 ECU_ADDRESS 0xFFF860CA /end MEASUREMENT
/begin MEASUREMENT st_ablauf_fkt "Phase des Ablauf" UWORD void_int_b_S6_S3 1 100 0 65535 ECU_ADDRESS 0xFFF860CC /end MEASUREMENT
/begin MEASUREMENT st_ist_bz_has_byp "" UBYTE void_int_S6_S3 1 100 0 255 ECU_ADDRESS 0xFFF96DF2 /end MEASUREMENT
/begin MEASUREMENT st_ist_bz_has_stg "Istzustand OML" UBYTE E_STBZHAS_S6_S3 1 100 0 15 ECU_ADDRESS 0xFFF86635 /end MEASUREMENT
/begin MEASUREMENT st_ist_bz_has_stg_mes "interner HST Ist-Basis-Betriebszustand der HST" UBYTE void_int_S6_S3 1 100 0 255 ECU_ADDRESS 0xFFF96D68 /end MEASUREMENT
/begin MEASUREMENT st_ist_bz_hst_sta "Ist-Betriebszustand aus der Startegieanpassung als Eingangsgroesse der Hybridzustandssteuerung (OML)" UBYTE E_STBZHAS_S6_S3 1 100 0 15 ECU_ADDRESS 0xFFF86668 /end MEASUREMENT
/begin MEASUREMENT st_soll_bz_has_hst_bas "interner HST Soll-Basis-Betriebszustand der HST" UBYTE void_int_S6_S3 1 100 0 255 ECU_ADDRESS 0xFFF96D69 /end MEASUREMENT
/begin MEASUREMENT st_soll_bz_hst_sta "Soll-Betriebszustand aus der Startegieanpassung als Eingangsgroesse der Hybridzustandssteuerung (OML)" UBYTE E_STBZHAS_S6_S3 1 100 0 15 ECU_ADDRESS 0xFFF86669 /end MEASUREMENT
/begin MEASUREMENT st_ziel_bz_has_byp "" UBYTE void_int_S6_S3 1 100 0 255 ECU_ADDRESS 0xFFF96DF3 /end MEASUREMENT
/begin MEASUREMENT st_ziel_bz_has_stg "Zielzustand OML" UBYTE E_STBZHAS_S6_S3 1 100 0 15 ECU_ADDRESS 0xFFF86636 /end MEASUREMENT
/begin MEASUREMENT status_ablauf_has_fkt "" UBYTE void_int_S6_S3 1 100 0 50 ECU_ADDRESS 0xFFF8663B /end MEASUREMENT
/begin MEASUREMENT status_ablauf_has_fkt_byp "" UBYTE void_int_S6_S3 1 100 0 255 ECU_ADDRESS 0xFFF96DF4 /end MEASUREMENT
/begin MEASUREMENT status_ablaufaktiv_has_byp "" UBYTE void_int_S6_S3 1 100 0 255 ECU_ADDRESS 0xFFF96DF5 /end MEASUREMENT
/begin MEASUREMENT status_alaengs_adaoff_in "Information, ob die Adaptionen aufgrund erkannter Laengsbeschleunigung deaktiviert wird. 0 = Adaption aktiv aufgrund erkannter Laengsbeschleunigung
1 = Adaption inaktiv aufgrund nicht erkannter Laengsbeschleunigung" UBYTE void_int_S6_S3 1 100 0 1 ECU_ADDRESS 0xFFF8667C /end MEASUREMENT
/begin MEASUREMENT status_betriebsber_hst_portin "Status Fahrbereitschaft (Hybridsystem)" UBYTE void_int_S6_S3 1 100 0 15 ECU_ADDRESS 0xFFF8666E /end MEASUREMENT
/begin MEASUREMENT status_efahren_has_byp "" UBYTE void_int_S6_S3 1 100 0 255 ECU_ADDRESS 0xFFF96DF6 /end MEASUREMENT
/begin MEASUREMENT status_efahren_has_sbe "Status E-Fahren der HAS zur Festlegung der entsprechenden Portout-Größe in der HAS Signalaufbereitung_Out" UBYTE void_int_S6_S3 1 100 0 1 ECU_ADDRESS 0xFFF8665A /end MEASUREMENT
/begin MEASUREMENT status_fehler15_eh_diagin "Info vom Errorhandler ob Ersatzfkt. aktiv" UBYTE void_int_S6_S3 1 100 0 1 ECU_ADDRESS 0xFFF8662E /end MEASUREMENT
/begin MEASUREMENT status_fehler_iep_in "" UBYTE E_FEHLERIEP_S6_S3 1 100 0 1 ECU_ADDRESS 0xFFF8667D /end MEASUREMENT
/begin MEASUREMENT status_fehler_k0_portin "" UBYTE void_int_S6_S3 1 100 0 255 ECU_ADDRESS 0xFFF8666F /end MEASUREMENT
/begin MEASUREMENT status_iae_adap_in "Status der Adaption des Integrierten Anfahrelements IAE" UBYTE E_STATUSADA_S6_S3 1 100 0 2 ECU_ADDRESS 0xFFF8667E /end MEASUREMENT
/begin MEASUREMENT status_iae_in "" UBYTE E_STATUSIAE_S6_S3 1 100 0 8 ECU_ADDRESS 0xFFF8667F /end MEASUREMENT
/begin MEASUREMENT status_iep_in "" UBYTE E_STATUSIEP_S6_S3 1 100 0 4 ECU_ADDRESS 0xFFF86680 /end MEASUREMENT
/begin MEASUREMENT status_k0_adap_in "" UBYTE E_STATUSADA_S6_S3 1 100 0 2 ECU_ADDRESS 0xFFF86681 /end MEASUREMENT
/begin MEASUREMENT status_k0_in "" UBYTE E_STATUSK0_S6_S3 1 100 0 5 ECU_ADDRESS 0xFFF86682 /end MEASUREMENT
/begin MEASUREMENT status_kolbenpos_k0_in "" UBYTE void_int_S6_S3 1 100 0 255 ECU_ADDRESS 0xFFF86683 /end MEASUREMENT
/begin MEASUREMENT status_kraftfluss_egs_in "" UBYTE E_STATUSKSL_S6_S3 1 100 0 6 ECU_ADDRESS 0xFFF86684 /end MEASUREMENT
/begin MEASUREMENT status_kraftfluss_egs_roh_in "" UBYTE void_int_S6_S3 1 100 0 255 ECU_ADDRESS 0xFFF86685 /end MEASUREMENT
/begin MEASUREMENT status_ll_vm_in "" UBYTE void_int_S6_S3 1 100 0 255 ECU_ADDRESS 0xFFF86686 /end MEASUREMENT
/begin MEASUREMENT status_modus_em_portin "" UBYTE void_int_S6_S3 1 100 0 255 ECU_ADDRESS 0xFFF86670 /end MEASUREMENT
/begin MEASUREMENT status_motorstandby_has_byp "" UBYTE void_int_S6_S3 1 100 0 255 ECU_ADDRESS 0xFFF96DF7 /end MEASUREMENT
/begin MEASUREMENT status_nem_in "Status zur Drehzahl E-Motor" UBYTE E_SIGSTATUS_S6_S3 1 100 0 2 ECU_ADDRESS 0xFFF86687 /end MEASUREMENT
/begin MEASUREMENT status_nreg_em_hst_portin "Status E-Motor Drehzahlregelung der HST" UBYTE void_int_S6_S3 1 100 0 255 ECU_ADDRESS 0xFFF86671 /end MEASUREMENT
/begin MEASUREMENT status_nvm_in "Status zur Drehzahl VM-Motor" UBYTE E_SIGSTATUS_S6_S3 1 100 0 2 ECU_ADDRESS 0xFFF86688 /end MEASUREMENT
/begin MEASUREMENT status_posvueb_in "Erkennung PosV Diagnose" UBYTE void_int_S6_S3 1 100 0 255 ECU_ADDRESS 0xFFF86689 /end MEASUREMENT
/begin MEASUREMENT status_psys_has_sbe "" UBYTE E_STATUSPSY_S6_S3 1 100 0 4 ECU_ADDRESS 0xFFF86654 /end MEASUREMENT
/begin MEASUREMENT status_sa_vm_portin "00 Keine Beeinflussung; 01 Schubabschaltung aktiv; 10 Nicht stellbarer Bereich; 11 Signal ungültig" UBYTE void_int_S6_S3 1 100 0 3 ECU_ADDRESS 0xFFF86672 /end MEASUREMENT
/begin MEASUREMENT status_schaltart_svh_has_sbe "Schaltart der angeforderten Schaltung der Schaltverhinderung der HAS (0 = keine Schaltung angefordert) - Bit-Codierung (m/oL=mit/ohne Lanstanh.)=: bit0=ZRSmL,1=ZHSmL,2=SRSmL,3=SHSmL,4=ZRSoL,5=ZHSoL,6=SRSoL,7=SHSoL" UBYTE void_int_S6_S3 1 100 0 255 ECU_ADDRESS 0xFFF8665B /end MEASUREMENT
/begin MEASUREMENT status_schaltung_egs_in "" SBYTE void_int_S6_S3 1 100 -9 9 ECU_ADDRESS 0xFFF86655 /end MEASUREMENT
/begin MEASUREMENT status_sync_schaltung_sbe "Anzeige der Synchronerkennung der aktuellen Schaltung innerhalb der HAS" UBYTE void_int_S6_S3 1 100 0 1 ECU_ADDRESS 0xFFF86656 /end MEASUREMENT
/begin MEASUREMENT status_waschstr_in "" UBYTE void_int_S6_S3 1 100 0 255 ECU_ADDRESS 0xFFF8668A /end MEASUREMENT
/begin MEASUREMENT status_zug_svh_sbe "Status für Anzeige Zug/Schub" UBYTE void_int_S6_S3 1 100 0 1 ECU_ADDRESS 0xFFF8665C /end MEASUREMENT
/begin MEASUREMENT t_betrieb_pvu_has_ee_in "" ULONG t_int_S6_S3 1 100 0 10000 ECU_ADDRESS 0xFFF85E2C /end MEASUREMENT
/begin MEASUREMENT t_betrieb_pvu_has_sbe "Betriebsdauer seit dem letzten Ablauf der Diagnosefunktion \"Positionsventil-Überwachung\" der Funktion zur Unterstüt-zung der Positionsventil-Überwachung der HAS" FLOAT32_IEEE t_fl_S6_S3 1 100 0 1000000 ECU_ADDRESS 0xFFF85DB8 /end MEASUREMENT
/begin MEASUREMENT timer_pumpready_aktiv_fkt "" UBYTE t_int_d_S6_S3 1 100 0 1 ECU_ADDRESS 0xFFF8663C /end MEASUREMENT
/begin MEASUREMENT v_f_sbe "Fahrzeuggeschwindigkeit auf Basis der Getriebeabtriebsdrehzahl in der  Hybridablaufsteuerung" FLOAT32_IEEE v_fl_S6_S3 1 100 -3.40282e+038 3.40282e+038 ECU_ADDRESS 0xFFF85DBC /end MEASUREMENT
/begin MEASUREMENT vg_f_sbe "Fahrzeuggeschwindigkeitsgradient auf Basis der Getriebeabtriebsdrehzahl in der  Hybridablaufsteuerung" FLOAT32_IEEE vg_fl_S6_S3 1 100 -3.40282e+038 3.40282e+038 ECU_ADDRESS 0xFFF85DC0 /end MEASUREMENT
/begin MEASUREMENT z_ablauf_has_hst_in "" UBYTE void_int_S6_S3 1 100 0 15 ECU_ADDRESS 0xFFF8668B /end MEASUREMENT
/begin MEASUREMENT z_ablauf_has_stg "Zusaetzliche Steuergroesse zur Ablaufsteuerung" UBYTE void_int_S6_S3 1 100 0 15 ECU_ADDRESS 0xFFF86637 /end MEASUREMENT
/begin MEASUREMENT z_ablauf_svh_reset_has_fkt "" UBYTE void_int_S6_S3 1 100 0 255 ECU_ADDRESS 0xFFF8663D /end MEASUREMENT
/begin MEASUREMENT z_ablaufreinit_frk_dihi "Zeigt an, dass der aktuelle HAS-Ablauf erneut begonnen werden soll" UBYTE void_int_S6_S3 1 100 0 1 ECU_ADDRESS 0xFFF8662F /end MEASUREMENT
/begin MEASUREMENT z_ablaufvariante_has_hst_in "" UBYTE void_int_S6_S3 1 100 0 15 ECU_ADDRESS 0xFFF8668C /end MEASUREMENT
/begin MEASUREMENT z_ablaufvariante_has_stg "Ablaufvariante, die  die OML ausgibt" UBYTE void_int_S6_S3 1 100 0 99 ECU_ADDRESS 0xFFF86638 /end MEASUREMENT
/begin MEASUREMENT z_ablaufvariante_kalt_zus "Anzeige der aktiven Ablaufvariante Kaltstart beim Zustart - 0 = kein Kaltstart, 1 = Kaltstart mit abgesenkter EM-Drehzahl" UBYTE void_int_S6_S3 1 100 0 255 ECU_ADDRESS 0xFFF8663E /end MEASUREMENT
/begin MEASUREMENT z_ba__st_drv_veh_portin "" UBYTE void_int_S6_S3 1 100 0 15 ECU_ADDRESS 0xFFF86673 /end MEASUREMENT
/begin MEASUREMENT z_ba_has_k0_hst_portin "Anforderung K0 Betriebsart der HAS durch die HST" UBYTE void_int_S6_S3 1 100 0 15 ECU_ADDRESS 0xFFF86674 /end MEASUREMENT
/begin MEASUREMENT z_ba_has_vm_hst_portin "Anforderung VM Betriebsart der HAS durch die HST" UBYTE void_int_S6_S3 1 100 0 15 ECU_ADDRESS 0xFFF86675 /end MEASUREMENT
/begin MEASUREMENT z_diag_ersfkt_has_in "Funktionsschnittstelle zur Ermittlung ob irgendeine Ersatzmaßnahme in der Diagnoseverwaltung aktiv ist" ULONG b_int_S6_S3 1 100 0 4294967295 ECU_ADDRESS 0xFFF85E30 /end MEASUREMENT
/begin MEASUREMENT z_diag_ersfkt_hi_has_in "Funktionsschnittstelle zur Ermittlung ob irgendeine Ersatzmaßnahme in der Diagnoseverwaltung aktiv ist" ULONG b_int_S6_S3 1 100 0 4294967295 ECU_ADDRESS 0xFFF85E34 /end MEASUREMENT
/begin MEASUREMENT z_diag_notgang_has_in "Notganginformation" UBYTE void_int_S6_S3 1 100 0 255 ECU_ADDRESS 0xFFF8668D /end MEASUREMENT
/begin MEASUREMENT z_emaktiv_fuw_zus_fkt "Anzeige der EM Fehlfuntion der Funktionsüberwachung der EM beim Zustart" UBYTE void_int_S6_S3 1 100 0 1 ECU_ADDRESS 0xFFF8663F /end MEASUREMENT
/begin MEASUREMENT z_emfehler_frk_dihi "Zeigt an, dass eine EM Fehlfunktion erkannt wurde, die in der HAS ausgewertet werden soll" UBYTE void_int_S6_S3 1 100 0 1 ECU_ADDRESS 0xFFF86630 /end MEASUREMENT
/begin MEASUREMENT z_fehler15_eh_fkt "" UBYTE void_int_S6_S3 1 100 0 1 ECU_ADDRESS 0xFFF86640 /end MEASUREMENT
/begin MEASUREMENT z_freigabe_pvu_has_sbe "Freigabe zur Aktivierung der Diagnosefunktion \"Positionsventil-Überwachung\" der Funktion zur Unterstützung der Positi-onsventil-Überwachung der HAS" UBYTE void_int_S6_S3 1 100 0 1 ECU_ADDRESS 0xFFF86657 /end MEASUREMENT
/begin MEASUREMENT z_fuwdeakt_frk_dihi "Zeigt an, dass die FUW-Funktion nicht aktiviert werden darf" UBYTE void_int_S6_S3 1 100 0 1 ECU_ADDRESS 0xFFF86631 /end MEASUREMENT
/begin MEASUREMENT z_glsbe_has_byp "" UBYTE void_int_S6_S3 1 100 0 255 ECU_ADDRESS 0xFFF96DF8 /end MEASUREMENT
/begin MEASUREMENT z_hybfkt_stg "Anforderung der Aktivierung einer Hybridfunktion durch die Hyrid-Zustandssteuerung" UBYTE E_HYBFKT_S6_S3 1 100 0 15 ECU_ADDRESS 0xFFF86639 /end MEASUREMENT
/begin MEASUREMENT z_iep_in "" UBYTE E_ZIEP_S6_S3 1 100 0 4 ECU_ADDRESS 0xFFF8668E /end MEASUREMENT
/begin MEASUREMENT z_init_fkt "" UBYTE void_int_S6_S3 1 100 0 1 ECU_ADDRESS 0xFFF86641 /end MEASUREMENT
/begin MEASUREMENT z_init_sta "Anforderung der Initialisierung der Zustandssteuerung (OML) durch die Strategieanpassung" UBYTE void_int_S6_S3 1 100 0 15 ECU_ADDRESS 0xFFF8666A /end MEASUREMENT
/begin MEASUREMENT z_k0_befuellopt_has_byp "" UBYTE void_int_S6_S3 1 100 0 255 ECU_ADDRESS 0xFFF96DF9 /end MEASUREMENT
/begin MEASUREMENT z_k0_befuellopt_has_fkt "" UBYTE void_int_S6_S3 1 100 0 1 ECU_ADDRESS 0xFFF86642 /end MEASUREMENT
/begin MEASUREMENT z_k0_fst_in "" UBYTE E_ZK0FSTIN_S6_S3 1 100 0 3 ECU_ADDRESS 0xFFF8668F /end MEASUREMENT
/begin MEASUREMENT z_k0_has_byp "" UBYTE void_int_S6_S3 1 100 0 255 ECU_ADDRESS 0xFFF96DFA /end MEASUREMENT
/begin MEASUREMENT z_k0_has_fkt "" UBYTE E_ZK0_S6_S3 1 100 0 5 ECU_ADDRESS 0xFFF86643 /end MEASUREMENT
/begin MEASUREMENT z_k0_has_sbe "" UBYTE E_ZK0_S6_S3 1 100 0 5 ECU_ADDRESS 0xFFF8665D /end MEASUREMENT
/begin MEASUREMENT z_k0syncmk0erh_frk_dihi "Zeigt an, dass eine K0-Zwangsynchronisation mittels Erhöhung des K0-Moments erfolgen soll" UBYTE void_int_S6_S3 1 100 0 1 ECU_ADDRESS 0xFFF86632 /end MEASUREMENT
/begin MEASUREMENT z_kps_stada_in "Sollvorgabe für die Trennkupplung K0 durch die Stillstandsadaption" UBYTE void_int_S6_S3 1 100 0 255 ECU_ADDRESS 0xFFF86690 /end MEASUREMENT
/begin MEASUREMENT z_m_begr_em_has_fkt "" UBYTE void_int_S6_S3 1 100 0 50 ECU_ADDRESS 0xFFF86644 /end MEASUREMENT
/begin MEASUREMENT z_m_max_iae_has_byp "" UBYTE void_int_S6_S3 1 100 0 255 ECU_ADDRESS 0xFFF96DFB /end MEASUREMENT
/begin MEASUREMENT z_m_max_iae_has_fkt "" UBYTE void_int_S6_S3 1 100 0 50 ECU_ADDRESS 0xFFF86645 /end MEASUREMENT
/begin MEASUREMENT z_m_soll_em_has_byp "" UBYTE void_int_S6_S3 1 100 0 255 ECU_ADDRESS 0xFFF96DFC /end MEASUREMENT
/begin MEASUREMENT z_m_soll_em_has_fkt "" UBYTE void_int_S6_S3 1 100 0 50 ECU_ADDRESS 0xFFF86646 /end MEASUREMENT
/begin MEASUREMENT z_m_soll_em_has_komp_portout "" UBYTE void_int_S6_S3 1 100 252 255 ECU_ADDRESS 0xFFF86228 /end MEASUREMENT
/begin MEASUREMENT z_m_soll_vm_has_fkt "" UBYTE void_int_S6_S3 1 100 0 50 ECU_ADDRESS 0xFFF86647 /end MEASUREMENT
/begin MEASUREMENT z_modus_em_hst_in "" UBYTE void_int_S6_S3 1 100 0 255 ECU_ADDRESS 0xFFF86691 /end MEASUREMENT
/begin MEASUREMENT z_modus_iae_has_byp "" UBYTE void_int_S6_S3 1 100 0 255 ECU_ADDRESS 0xFFF96DFD /end MEASUREMENT
/begin MEASUREMENT z_modus_iae_has_fkt "" UBYTE E_ZMODUSIAE_S6_S3 1 100 0 2 ECU_ADDRESS 0xFFF86648 /end MEASUREMENT
/begin MEASUREMENT z_modus_iae_has_sbe "" UBYTE E_ZMODUSIAE_S6_S3 1 100 0 2 ECU_ADDRESS 0xFFF8665E /end MEASUREMENT
/begin MEASUREMENT z_modus_iep_has_byp "" UBYTE void_int_S6_S3 1 100 0 255 ECU_ADDRESS 0xFFF96DFE /end MEASUREMENT
/begin MEASUREMENT z_modus_iep_has_sbe "Vorgabe des Betriebsmodus der IEP durch die HAS" UBYTE E_ZMODUSIEP_S6_S3 1 100 0 4 ECU_ADDRESS 0xFFF8665F /end MEASUREMENT
/begin MEASUREMENT z_msa_avh_moni_has_sbe "Anforderung einer Schaltverhinderung der HAS" UBYTE void_int_S6_S3 1 100 0 255 ECU_ADDRESS 0xFFF86660 /end MEASUREMENT
/begin MEASUREMENT z_msa_eaf_moni_has_sbe "Anforderung einer Schaltverhinderung der HAS" UBYTE void_int_S6_S3 1 100 0 255 ECU_ADDRESS 0xFFF86661 /end MEASUREMENT
/begin MEASUREMENT z_msa_fst_in "Anforderung einer Abschaltverhinderung durch die Fahrstrategie ASIS" UBYTE void_int_S6_S3 1 100 0 255 ECU_ADDRESS 0xFFF86692 /end MEASUREMENT
/begin MEASUREMENT z_msa_has_byp "" UBYTE void_int_S6_S3 1 100 0 255 ECU_ADDRESS 0xFFF96DFF /end MEASUREMENT
/begin MEASUREMENT z_msa_has_sbe "Anforderung der Beeinflussung der MSA-Funktionalität durch die Hybridablaufsteuerung - Codierung: bit0 = AVZ, bit1 = AVH, bit2 = EAF, bit3 = EVH, bit4 = Deaktivierung, bit7 = Störungsbedingt" UBYTE void_int_S6_S3 1 100 0 255 ECU_ADDRESS 0xFFF86662 /end MEASUREMENT
/begin MEASUREMENT z_n_min_em_parksp_has_in "Anforderung einer EM-Drehzahlanhebung beim Auslegen der Parksperre infolge unzureichender Ölversorgung" UBYTE void_int_S6_S3 1 100 0 1 ECU_ADDRESS 0xFFF86693 /end MEASUREMENT
/begin MEASUREMENT z_n_min_iep_in "Anforderung Ausgabe EM-Mindestdrehzahl zur Sicherstellung der Ölversorgung durch die IEP" UBYTE void_int_S6_S3 1 100 0 1 ECU_ADDRESS 0xFFF86694 /end MEASUREMENT
/begin MEASUREMENT z_n_soll_em_has_byp "" UBYTE void_int_S6_S3 1 100 0 255 ECU_ADDRESS 0xFFF96E00 /end MEASUREMENT
/begin MEASUREMENT z_n_soll_em_has_fkt "" UBYTE void_int_S6_S3 1 100 0 50 ECU_ADDRESS 0xFFF86649 /end MEASUREMENT
/begin MEASUREMENT z_n_soll_em_has_komp_portout "" UBYTE void_int_S6_S3 1 100 254 255 ECU_ADDRESS 0xFFF8622C /end MEASUREMENT
/begin MEASUREMENT z_n_soll_vm_has_byp "" UBYTE void_int_S6_S3 1 100 0 255 ECU_ADDRESS 0xFFF96E01 /end MEASUREMENT
/begin MEASUREMENT z_n_soll_vm_has_fkt "" UBYTE void_int_S6_S3 1 100 0 50 ECU_ADDRESS 0xFFF8664A /end MEASUREMENT
/begin MEASUREMENT z_n_soll_vm_has_komp_portout "" UBYTE void_int_S6_S3 1 100 254 255 ECU_ADDRESS 0xFFF8622E /end MEASUREMENT
/begin MEASUREMENT z_nllsoll_iae_in "Anforderung der IAE, dass eine definierte LL-Drehzahl durch den Motor eingestellt werden soll" UBYTE E_ZNLLSOLL_S6_S3 1 100 0 2 ECU_ADDRESS 0xFFF86695 /end MEASUREMENT
/begin MEASUREMENT z_nminemnull_frk_dihi "Zeigt an, dass die Ausgabe der minimalen EM Drehzahl der HAS unterdrückt werden soll." UBYTE void_int_S6_S3 1 100 0 1 ECU_ADDRESS 0xFFF86633 /end MEASUREMENT
/begin MEASUREMENT z_nvmsollbegr_frk_dihi "Zeigt an, dass die VM-Solldrehzahl auf die EM-Istdrehzahl be-grenzt werden soll" UBYTE void_int_S6_S3 1 100 0 1 ECU_ADDRESS 0xFFF86634 /end MEASUREMENT
/begin MEASUREMENT z_p_hys_k0_has_byp "" UBYTE void_int_S6_S3 1 100 0 255 ECU_ADDRESS 0xFFF96E02 /end MEASUREMENT
/begin MEASUREMENT z_p_hys_k0_has_fkt "Hysteresekompensation" UBYTE void_int_S6_S3 1 100 0 1 ECU_ADDRESS 0xFFF8664B /end MEASUREMENT
/begin MEASUREMENT z_ponr_fkt "point of no return" UBYTE void_int_S6_S3 1 100 0 1 ECU_ADDRESS 0xFFF8664C /end MEASUREMENT
/begin MEASUREMENT z_pvu_has_sbe "Beeinflussung des Hybridsystems zur Unterstützung der Positionsventil- Überwachung der HAS-Codierung: 0 = keine Beeinflussung, 1 = Beeinflussung Stufe 1, 2 = Beeinflussung Stufe 2" UBYTE void_int_S6_S3 1 100 0 2 ECU_ADDRESS 0xFFF86658 /end MEASUREMENT
/begin MEASUREMENT z_saf_has_byp "" UBYTE void_int_S6_S3 1 100 0 255 ECU_ADDRESS 0xFFF96E03 /end MEASUREMENT
/begin MEASUREMENT z_saf_has_fkt "Schaltanforderung 1...aktiv" UBYTE void_int_S6_S3 1 100 0 1 ECU_ADDRESS 0xFFF8664D /end MEASUREMENT
/begin MEASUREMENT z_sas_has_byp "" UBYTE void_int_S6_S3 1 100 0 255 ECU_ADDRESS 0xFFF96E04 /end MEASUREMENT
/begin MEASUREMENT z_sas_has_sbe "Ändert im Wahrheitsfall die KupplungsBefüllreihenfolge" UBYTE void_int_S6_S3 1 100 0 1 ECU_ADDRESS 0xFFF86663 /end MEASUREMENT
/begin MEASUREMENT z_sbe_has_byp "" UBYTE void_int_S6_S3 1 100 0 255 ECU_ADDRESS 0xFFF96E05 /end MEASUREMENT
/begin MEASUREMENT z_sbe_has_fkt "Schaltbeeinflussung  1...aktiv" UBYTE void_int_S6_S3 1 100 0 1 ECU_ADDRESS 0xFFF8664E /end MEASUREMENT
/begin MEASUREMENT z_standby_em_has_fkt "" UBYTE void_int_S6_S3 1 100 0 1 ECU_ADDRESS 0xFFF8664F /end MEASUREMENT
/begin MEASUREMENT z_start_modus_has_byp "" UBYTE void_int_S6_S3 1 100 0 255 ECU_ADDRESS 0xFFF96E06 /end MEASUREMENT
/begin MEASUREMENT z_start_modus_has_sbe "Anforderung eines Anlasserstarts" UBYTE void_int_S6_S3 1 100 0 255 ECU_ADDRESS 0xFFF86664 /end MEASUREMENT
/begin MEASUREMENT z_status_psys_mps_has_byp "" UBYTE void_int_S6_S3 1 100 0 255 ECU_ADDRESS 0xFFF96E07 /end MEASUREMENT
/begin MEASUREMENT z_status_psys_mps_sbe "Flag, das eine Modifikation des Pumpendruckstatus anzeigt" UBYTE void_int_S6_S3 1 100 0 1 ECU_ADDRESS 0xFFF86659 /end MEASUREMENT
/begin MEASUREMENT z_svh_has_byp "" UBYTE void_int_S6_S3 1 100 0 255 ECU_ADDRESS 0xFFF96E08 /end MEASUREMENT
/begin MEASUREMENT z_svh_has_sbe "Anforderung einer Schaltverhinderung der HAS" UBYTE void_int_S6_S3 1 100 0 1 ECU_ADDRESS 0xFFF86665 /end MEASUREMENT
/begin MEASUREMENT z_timer_pumpready_fkt "" UBYTE void_int_S6_S3 1 100 0 1 ECU_ADDRESS 0xFFF86650 /end MEASUREMENT
/begin MEASUREMENT z_tmin_fehler15_fkt "Status Timer für Verweilzeit in Fehler15" UBYTE void_int_S6_S3 1 100 0 255 ECU_ADDRESS 0xFFF86651 /end MEASUREMENT
/begin MEASUREMENT z_ziel_kraftfluss_egs_in "" UBYTE void_int_S6_S3 1 100 0 255 ECU_ADDRESS 0xFFF86696 /end MEASUREMENT
/begin MEASUREMENT z_zuendfreigabe_vm_fkt "" UBYTE void_int_S6_S3 1 100 0 1 ECU_ADDRESS 0xFFF86652 /end MEASUREMENT
/begin MEASUREMENT z_zuendfreigabe_vm_has_fkt "" UBYTE void_int_S6_S3 1 100 0 1 ECU_ADDRESS 0xFFF86653 /end MEASUREMENT
/begin MEASUREMENT zielgang_egs_in "" SBYTE void_int_S6_S3 1 100 -128 127 ECU_ADDRESS 0xFFF86697 /end MEASUREMENT
/begin FUNCTION SSAi4_SAiPS_ProjektSpezifisch ""
 /begin SUB_FUNCTION SSAi75_status___ereitschaft_hst Run_SSAi82_cDelay_m_soll_vm Run_SSAi81_cDelay_m_soll_em /end SUB_FUNCTION
 /begin DEF_CHARACTERISTIC ABSTELLPOS_VM_ERSATZ_HAS ABSTELLPOS_VM_STS_ERS_HAS CO_VM_HAS C_VM_ERSATZ_HAS KF_STSOLLBZHASHST_ZUL_HAS_W KF_STSOLLBZHASHST_ZUL_HAS_X KF_STSOLLBZHASHST_ZUL_HAS_Y KN_SOLLEMHST_MOD_HAS M_MINVM_ERSATZ_HAS M_SOLLVMLHST_ERSATZ_HAS M_WUNSCHFPWHST_ERSATZ_HAS NO_SOLLEMHST_MOD_HAS N_SOLLEMHST_ERSATZ_HAS STATUS_LLVM_ERSATZ_HAS STATUS_NREGEMHST_ERSATZ_HAS STATUS_SAVM_ERSATZ_HAS SWI_ABSTELLPOS_VM_ERSATZ_HAS SWI_ABSTELLPOS_VM_STS_ERS_HAS SWI_C_VM_ERSATZ_HAS SWI_M_MINVM_ERSATZ_HAS SWI_M_SOLLVMLHST_ERSATZ_HAS SWI_M_WUNSCHFPWHST_ERSATZ_HAS SWI_M_WUNSCHFPWHST_IN_HAS SWI_N_SOLLEMHST_ERSATZ_HAS SWI_STATUS_NREGEMHST_ERSATZ_HAS SWI_STATUS_SAVM_ERSATZ_HAS SWI_Z_BAHASK0HST_ERSATZ_HAS SWI_Z_BAHASVMHST_ERSATZ_HAS T_MSOLLEMHST_HAS T_MSOLLVMHST_HAS Z_BAHASK0HST_ERSATZ_HAS Z_BAHASVMHST_ERSATZ_HAS Z_STSOLLBZHSTMIN_HAS /end DEF_CHARACTERISTIC
 /begin LOC_MEASUREMENT abstellpos_vm_portin abstellpos_vm_status_portin c_vm_portin m_max_vm_portin m_min_vm_portin m_soll_em_hst_verz m_soll_vm_hst_verz m_soll_vm_l_hst_portin m_wunsch_fpw_hst_portin n_soll_em_hst_portin st_OMLID_act_stg st_ist_bz_has_stg st_ist_bz_has_stg_mes st_soll_bz_has_hst_bas st_ziel_bz_has_stg status_betriebsber_hst_portin status_fehler_k0_portin status_modus_em_portin status_nreg_em_hst_portin status_sa_vm_portin z_ablauf_has_stg z_ablaufvariante_has_stg z_ba__st_drv_veh_portin z_ba_has_k0_hst_portin z_ba_has_vm_hst_portin z_hybfkt_stg /end LOC_MEASUREMENT
/end FUNCTION
/begin FUNCTION SSAi75_status___ereitschaft_hst ""
 /begin DEF_CHARACTERISTIC STATUS_BETRBER_AUS_HAS STATUS_BETRBER_EIN_HAS STATUS_BETRIEBSBER_ERS_HAS SWI_STATUS_BETRIEBSBER_ERS_HAS /end DEF_CHARACTERISTIC
 /begin LOC_MEASUREMENT status_betriebsber_hst_portin /end LOC_MEASUREMENT
/end FUNCTION
/begin FUNCTION SSAo2_SAoEEP_EEProm ""
 /begin LOC_MEASUREMENT c_getriebe_egs_in gangwechsel_egs_in istgang_egs_in m_em_in m_iae_in m_k0_in m_max_dyn_em_in m_min_dyn_em_in m_mot_in m_soll_em_hst_in m_soll_vm_hst_in m_vm_in m_vm_start_in m_wunsch_fpw_in n_ab_egs_in n_em_in n_mot_soll_iae_in n_soll_ll_vm_in n_t_egs_in n_vm_in osmode_next_in p_bremse_fzg_in phi_neigung_in pos_egs_in sollgang_egs_in status_alaengs_adaoff_in status_fehler_iep_in status_iae_adap_in status_iae_in status_iep_in status_k0_adap_in status_k0_in status_kolbenpos_k0_in status_kraftfluss_egs_in status_kraftfluss_egs_roh_in status_ll_vm_in status_nem_in status_nvm_in status_posvueb_in status_waschstr_in t_betrieb_pvu_has_ee_in z_ablauf_has_hst_in z_ablaufvariante_has_hst_in z_diag_ersfkt_has_in z_diag_ersfkt_hi_has_in z_diag_notgang_has_in z_iep_in z_k0_fst_in z_kps_stada_in z_modus_em_hst_in z_msa_fst_in z_n_min_em_parksp_has_in z_n_min_iep_in z_nllsoll_iae_in z_ziel_kraftfluss_egs_in zielgang_egs_in /end LOC_MEASUREMENT
/end FUNCTION
/begin FUNCTION SSAo3_SAoEH_ErrorHandler ""
 /begin LOC_MEASUREMENT c_getriebe_egs_in gangwechsel_egs_in istgang_egs_in m_em_in m_iae_in m_k0_in m_max_dyn_em_in m_min_dyn_em_in m_mot_in m_soll_em_hst_in m_soll_vm_hst_in m_vm_in m_vm_start_in m_wunsch_fpw_in n_ab_egs_in n_em_in n_mot_soll_iae_in n_soll_ll_vm_in n_t_egs_in n_vm_in osmode_next_in p_bremse_fzg_in phi_neigung_in pos_egs_in sollgang_egs_in status_alaengs_adaoff_in status_fehler_iep_in status_iae_adap_in status_iae_in status_iep_in status_k0_adap_in status_k0_in status_kolbenpos_k0_in status_kraftfluss_egs_in status_kraftfluss_egs_roh_in status_ll_vm_in status_nem_in status_nvm_in status_posvueb_in status_waschstr_in t_betrieb_pvu_has_ee_in z_ablauf_has_hst_in z_ablaufvariante_has_hst_in z_diag_ersfkt_has_in z_diag_ersfkt_hi_has_in z_diag_notgang_has_in z_iep_in z_k0_fst_in z_kps_stada_in z_modus_em_hst_in z_msa_fst_in z_n_min_em_parksp_has_in z_n_min_iep_in z_nllsoll_iae_in z_ziel_kraftfluss_egs_in zielgang_egs_in /end LOC_MEASUREMENT
/end FUNCTION
/begin FUNCTION SSAo4_SAoPA_ProjektAllgemein ""
 /begin SUB_FUNCTION SSAo72_Complement_ui8_ SSAo71_Complement_ui8_ SSAo70_Complement_ui8_ SSAo69_If_Action_Subsystem1 SSAo68_If_Action_Subsystem SSAo65_Complement_ui16_ SSAo64_Complement_ui16_ SSAo63_Complement_ui8_ SSAo62_Complement_si16_ SSAo61_Complement_si16_ SSAo60_Complement_ui8_ SSAo59_Complement_ui8_ Run_SSAo55_cLi__r_Gradient_m_k0 /end SUB_FUNCTION
 /begin DEF_CHARACTERISTIC ANALYSE_HAS_ERSATZ_HAS ERR_N_SOLL_EM_NULL ERR_N_SOLL_VM_NULL MG_SOLLK0NEG_HAS_ERSATZ_HAS MG_SOLLK0POS_HAS_ERSATZ_HAS M_K0_HAS_ERSATZ_HAS M_MAXIAE_HAS_ERSATZ_HAS M_MOTMAX_HAS_ERSATZ_HAS M_RESEM_HAS_ERSATZ_HAS M_SOLLEM_HAS_ERSATZ_HAS M_SOLLK0_HAS_ERSATZ_HAS ND_MIN_SAF_HAS_ERSATZ_HAS N_MINEM_HAS_ERSATZ_HAS N_SOLLEM_HAS_ERSATZ_HAS N_SOLLVM_HAS_ERSATZ_HAS STATUS_ABLAUFAKTIV_ERS_HAS STATUS_ABLAUF_HAS_ERS_HAS STATUS_EFAHREN_HAS_ERS_HAS ST_IST_BZ_HAS_ERSATZ_HAS ST_ZIEL_BZ_HAS_ERSATZ_HAS SWI_ANALYSE_HAS_ERSATZ_HAS SWI_MK0ABSOUT_AKTIV_HAS SWI_MK0HASOUT_ZK0_HAS SWI_M_K0_HAS_ERSATZ_HAS SWI_M_MAXIAE_HAS_ERSATZ_HAS SWI_M_MOTMAX_HAS_ERSATZ_HAS SWI_M_RESEM_HAS_ERSATZ_HAS SWI_M_SOLLEM_HAS_ERSATZ_HAS SWI_M_SOLLK0_HAS_ERSATZ_HAS SWI_ND_MIN_SAF_HAS_ERSATZ_HAS SWI_N_MINEM_HAS_ERSATZ_HAS SWI_N_SOLLEM_HAS_ERSATZ_HAS SWI_N_SOLLVM_HAS_ERSATZ_HAS SWI_STATUS_ABLAUFAKTIV_ERS_HAS SWI_STATUS_ABLAUF_HAS_ERS_HAS SWI_STATUS_EFAHREN_HAS_ERS_HAS SWI_ST_IST_BZ_HAS_ERSATZ_HAS SWI_ST_ZIEL_BZ_HAS_ERSATZ_HAS SWI_T_BETRIEB_PVU_ERSATZ_HAS SWI_Z_FREIGABE_PVU_ERSATZ_HAS SWI_Z_GLSBE_HAS_ERS_HAS SWI_Z_K0BEFUELLOPT_HAS_ERS_HAS SWI_Z_K0_HAS_ERSATZ_HAS SWI_Z_MMAXIAE_HAS_ERSATZ_HAS SWI_Z_MODUS_IAE_HAS_ERSATZ_HAS SWI_Z_MODUS_IEP_HAS_ERSATZ_HAS SWI_Z_MSA_HAS_ERSATZ_HAS SWI_Z_MSOLLEM_HAS_ERSATZ_HAS SWI_Z_NSOLLEM_HAS_ERSATZ_HAS SWI_Z_NSOLLVM_HAS_ERSATZ_HAS SWI_Z_P_HYS_K0_HAS_ERSATZ_HAS SWI_Z_SAF_HAS_ERSATZ_HAS SWI_Z_SAS_HAS_ERSATZ_HAS SWI_Z_START_MODUS_HAS_ERS_HAS SWI_Z_STSPSYSMPS_ERSATZ_HAS SWI_Z_SVH_HAS_ERSATZ_HAS T_BETRIEB_PVU_ERSATZ_HAS Z_FREIGABE_PVU_ERSATZ_HAS Z_GLSBE_HAS_ERS_HAS Z_K0BEFUELLOPT_HAS_ERS_HAS Z_K0_HAS_ERSATZ_HAS Z_MMAXIAE_HAS_ERSATZ_HAS Z_MODUS_IAE_HAS_ERSATZ_HAS Z_MODUS_IEP_HAS_ERSATZ_HAS Z_MSA_HAS_ERSATZ_HAS Z_MSOLLEM_HAS_ERSATZ_HAS Z_NSOLLEM_HAS_ERSATZ_HAS Z_NSOLLVM_HAS_ERSATZ_HAS Z_P_HYS_K0_HAS_ERSATZ_HAS Z_SAF_HAS_ERSATZ_HAS Z_SAS_HAS_ERSATZ_HAS Z_SBE_HAS_ERS_HAS Z_START_MODUS_HAS_ERS_HAS Z_STSPSYSMPS_ERSATZ_HAS Z_SVH_HAS_ERSATZ_HAS /end DEF_CHARACTERISTIC
 /begin LOC_MEASUREMENT analyse_has_byp byp_vnr_has_byp bypass_has_aktiv c_getriebe_egs_in err_n_soll_em_has_komp_portout err_n_soll_vm_has_komp_portout gangwechsel_egs_in has_aktiv_has_byp i_istgang_egs i_zielgang_egs istgang_egs_in m_em_in m_iae_in m_k0_fkt m_k0_has_byp m_k0_in m_k0_mber_has_byp m_k0_mber_has_sbe m_k0_mod_has_fkt m_max_dyn_em_in m_max_em_has_byp m_max_em_has_fkt m_max_iae_has_byp m_max_iae_has_fkt m_min_dyn_em_in m_min_em_has_byp m_min_em_has_fkt m_mot_in m_motmax_has m_motmax_has_byp m_motmax_has_komp_portout m_soll_em_has_byp m_soll_em_has_fkt m_soll_em_has_komp_portout m_soll_em_hst_in m_soll_k0_has_byp m_soll_k0_has_fkt m_soll_res_em_bas_sbe m_soll_res_em_has_azg m_soll_res_em_has_byp m_soll_res_em_has_fkt m_soll_res_em_has_sbe m_soll_vm_has_fkt m_soll_vm_hst_in m_soll_vm_l_has_fkt m_vm_in m_vm_start_in m_wunsch_fpw_hst_fil m_wunsch_fpw_in mg_max_em_has_fkt mg_min_em_has_fkt mg_soll_K0_fkt mg_soll_k0_has_fkt mg_soll_k0_neg_has_byp mg_soll_k0_pos_has_byp mg_wunsch_fpw mg_wunsch_fpw_hst mo_mod_em_hst_has_byp mod_K0_fkt n_ab_egs_in n_em_in n_min_em_has_sbe n_min_em_has_sbe_has_byp n_min_psys_em_has_sbe n_mot_llsoll_has_komp_portout n_mot_soll_iae_in n_sec_iae n_soll_em_has_byp n_soll_em_has_fkt n_soll_em_has_komp_portout n_soll_ll_vm_in n_soll_vm_has_byp n_soll_vm_has_fkt n_soll_vm_has_komp_portout n_t_egs_in n_vm_in nd_iae nd_k0_in nd_min_saf_has_byp nd_soll_iae_fkt ndg_k0_in ng_vm osmode_next_in p_bremse_fzg_in pc_ok_has_byp phi_neigung_in pos_egs_in sollgang_egs_in st_OMLID_act_stg st_ablauf_fkt st_ist_bz_has_byp st_ist_bz_has_stg st_ziel_bz_has_byp st_ziel_bz_has_stg status_ablauf_has_fkt status_ablauf_has_fkt_byp status_ablaufaktiv_has_byp status_alaengs_adaoff_in status_efahren_has_byp status_efahren_has_sbe status_fehler15_eh_diagin status_fehler_iep_in status_iae_adap_in status_iae_in status_iep_in status_k0_adap_in status_k0_in status_kolbenpos_k0_in status_kraftfluss_egs_in status_kraftfluss_egs_roh_in status_ll_vm_in status_motorstandby_has_byp status_nem_in status_nvm_in status_posvueb_in status_psys_has_sbe status_schaltart_svh_has_sbe status_schaltung_egs_in status_sync_schaltung_sbe status_waschstr_in status_zug_svh_sbe t_betrieb_pvu_has_ee_in t_betrieb_pvu_has_sbe timer_pumpready_aktiv_fkt v_f_sbe vg_f_sbe z_ablauf_has_hst_in z_ablauf_has_stg z_ablauf_svh_reset_has_fkt z_ablaufreinit_frk_dihi z_ablaufvariante_has_hst_in z_ablaufvariante_has_stg z_ablaufvariante_kalt_zus z_diag_ersfkt_has_in z_diag_ersfkt_hi_has_in z_diag_notgang_has_in z_emaktiv_fuw_zus_fkt z_emfehler_frk_dihi z_fehler15_eh_fkt z_freigabe_pvu_has_sbe z_fuwdeakt_frk_dihi z_glsbe_has_byp z_hybfkt_stg z_iep_in z_init_fkt z_k0_befuellopt_has_byp z_k0_befuellopt_has_fkt z_k0_fst_in z_k0_has_byp z_k0_has_fkt z_k0_has_sbe z_k0syncmk0erh_frk_dihi z_kps_stada_in z_m_begr_em_has_fkt z_m_max_iae_has_byp z_m_max_iae_has_fkt z_m_soll_em_has_byp z_m_soll_em_has_fkt z_m_soll_em_has_komp_portout z_m_soll_vm_has_fkt z_modus_em_hst_in z_modus_iae_has_byp z_modus_iae_has_fkt z_modus_iae_has_sbe z_modus_iep_has_byp z_modus_iep_has_sbe z_msa_avh_moni_has_sbe z_msa_eaf_moni_has_sbe z_msa_fst_in z_msa_has_byp z_msa_has_sbe z_n_min_em_parksp_has_in z_n_min_iep_in z_n_soll_em_has_byp z_n_soll_em_has_fkt z_n_soll_em_has_komp_portout z_n_soll_vm_has_byp z_n_soll_vm_has_fkt z_n_soll_vm_has_komp_portout z_nllsoll_iae_in z_nminemnull_frk_dihi z_nvmsollbegr_frk_dihi z_p_hys_k0_has_byp z_p_hys_k0_has_fkt z_ponr_fkt z_pvu_has_sbe z_saf_has_byp z_saf_has_fkt z_sas_has_byp z_sas_has_sbe z_sbe_has_byp z_sbe_has_fkt z_standby_em_has_fkt z_start_modus_has_byp z_start_modus_has_sbe z_status_psys_mps_has_byp z_status_psys_mps_sbe z_svh_has_byp z_svh_has_sbe z_timer_pumpready_fkt z_tmin_fehler15_fkt z_ziel_kraftfluss_egs_in z_zuendfreigabe_vm_fkt z_zuendfreigabe_vm_has_fkt zielgang_egs_in /end LOC_MEASUREMENT
/end FUNCTION
/begin FUNCTION SSAo59_Complement_ui8_ "" /begin DEF_CHARACTERISTIC ERR_N_SOLL_EM_NULL /end DEF_CHARACTERISTIC /begin LOC_MEASUREMENT err_n_soll_em_has_komp_portout /end LOC_MEASUREMENT /end FUNCTION
/begin FUNCTION SSAo5_SAoPS_ProjektSpezifisch ""
 /begin DEF_CHARACTERISTIC ERR_N_SOLL_EM_NULL ERR_N_SOLL_VM_NULL MO_MODEMHST_HAS_ERSATZ_HAS M_K0_MBER_HAS_ERSATZ_HAS M_MAXEM_HAS_ERSATZ_HAS M_MINEM_HAS_ERSATZ_HAS SWI_MO_MODEMHST_HAS_ERSATZ_HAS SWI_M_K0_MBER_HAS_ERSATZ_HAS SWI_M_MAXEM_HAS_ERSATZ_HAS SWI_M_MINEM_HAS_ERSATZ_HAS /end DEF_CHARACTERISTIC
 /begin LOC_MEASUREMENT analyse_has_byp bErrorHybrid bExceptionHybrid byp_vnr_has_byp bypass_has_aktiv c_getriebe_egs_in err_n_soll_em_has_komp_portout err_n_soll_vm_has_komp_portout gangwechsel_egs_in has_aktiv_has_byp istgang_egs_in m_em_in m_iae_in m_k0_fkt m_k0_has_byp m_k0_in m_k0_mber_has_byp m_k0_mber_has_sbe m_k0_mod_has_fkt m_max_dyn_em_in m_max_em_has_byp m_max_em_has_fkt m_max_iae_has_byp m_max_iae_has_fkt m_min_dyn_em_in m_min_em_has_byp m_min_em_has_fkt m_mot_in m_motmax_has m_motmax_has_byp m_motmax_has_komp_portout m_soll_em_has_byp m_soll_em_has_fkt m_soll_em_has_komp_portout m_soll_em_hst_in m_soll_k0_has_byp m_soll_k0_has_fkt m_soll_res_em_bas_sbe m_soll_res_em_has_byp m_soll_res_em_has_fkt m_soll_res_em_has_sbe m_soll_vm_has_fkt m_soll_vm_hst_in m_soll_vm_l_has_fkt m_vm_in m_vm_start_in m_wunsch_fpw_in mg_max_em_has_fkt mg_min_em_has_fkt mg_soll_K0_fkt mg_soll_k0_has_fkt mg_soll_k0_neg_has_byp mg_soll_k0_pos_has_byp mo_mod_em_hst_has_byp mod_K0_fkt n_ab_egs_in n_em_in n_min_em_has_sbe n_min_em_has_sbe_has_byp n_mot_llsoll_has_komp_portout n_mot_soll_iae_in n_soll_em_has_byp n_soll_em_has_fkt n_soll_em_has_komp_portout n_soll_ll_vm_in n_soll_vm_has_byp n_soll_vm_has_fkt n_soll_vm_has_komp_portout n_t_egs_in n_vm_in nd_min_saf_has_byp nd_soll_iae_fkt osmode_next_in p_bremse_fzg_in pc_ok_has_byp phi_neigung_in pos_egs_in sollgang_egs_in st_OMLID_act_stg st_ablauf_fkt st_ist_bz_has_byp st_ist_bz_has_stg st_ist_bz_hst_sta st_soll_bz_hst_sta st_ziel_bz_has_byp st_ziel_bz_has_stg status_ablauf_has_fkt status_ablauf_has_fkt_byp status_ablaufaktiv_has_byp status_alaengs_adaoff_in status_efahren_has_byp status_efahren_has_sbe status_fehler_iep_in status_iae_adap_in status_iae_in status_iep_in status_k0_adap_in status_k0_in status_kolbenpos_k0_in status_kraftfluss_egs_in status_kraftfluss_egs_roh_in status_ll_vm_in status_motorstandby_has_byp status_nem_in status_nvm_in status_posvueb_in status_schaltart_svh_has_sbe status_waschstr_in status_zug_svh_sbe t_betrieb_pvu_has_ee_in timer_pumpready_aktiv_fkt z_ablauf_has_hst_in z_ablauf_has_stg z_ablauf_svh_reset_has_fkt z_ablaufvariante_has_hst_in z_ablaufvariante_has_stg z_ablaufvariante_kalt_zus z_diag_ersfkt_has_in z_diag_ersfkt_hi_has_in z_diag_notgang_has_in z_emaktiv_fuw_zus_fkt z_fehler15_eh_fkt z_glsbe_has_byp z_hybfkt_stg z_iep_in z_init_fkt z_init_sta z_k0_befuellopt_has_byp z_k0_befuellopt_has_fkt z_k0_fst_in z_k0_has_byp z_k0_has_fkt z_k0_has_sbe z_kps_stada_in z_m_begr_em_has_fkt z_m_max_iae_has_byp z_m_max_iae_has_fkt z_m_soll_em_has_byp z_m_soll_em_has_fkt z_m_soll_em_has_komp_portout z_m_soll_vm_has_fkt z_modus_em_hst_in z_modus_iae_has_byp z_modus_iae_has_fkt z_modus_iae_has_sbe z_modus_iep_has_byp z_modus_iep_has_sbe z_msa_avh_moni_has_sbe z_msa_eaf_moni_has_sbe z_msa_fst_in z_msa_has_byp z_msa_has_sbe z_n_min_em_parksp_has_in z_n_min_iep_in z_n_soll_em_has_byp z_n_soll_em_has_fkt z_n_soll_em_has_komp_portout z_n_soll_vm_has_byp z_n_soll_vm_has_fkt z_n_soll_vm_has_komp_portout z_nllsoll_iae_in z_p_hys_k0_has_byp z_p_hys_k0_has_fkt z_ponr_fkt z_saf_has_byp z_saf_has_fkt z_sas_has_byp z_sas_has_sbe z_sbe_has_byp z_sbe_has_fkt z_standby_em_has_fkt z_start_modus_has_byp z_start_modus_has_sbe z_status_psys_mps_has_byp z_svh_has_byp z_svh_has_sbe z_timer_pumpready_fkt z_tmin_fehler15_fkt z_ziel_kraftfluss_egs_in z_zuendfreigabe_vm_fkt z_zuendfreigabe_vm_has_fkt zielgang_egs_in /end LOC_MEASUREMENT
/end FUNCTION
/begin FUNCTION SSAo60_Complement_ui8_ "" /begin DEF_CHARACTERISTIC ERR_N_SOLL_VM_NULL /end DEF_CHARACTERISTIC /begin LOC_MEASUREMENT err_n_soll_vm_has_komp_portout /end LOC_MEASUREMENT /end FUNCTION
/begin FUNCTION SSAo61_Complement_si16_ "" /begin LOC_MEASUREMENT m_motmax_has_komp_portout /end LOC_MEASUREMENT /end FUNCTION
/begin FUNCTION SSAo62_Complement_si16_ "" /begin LOC_MEASUREMENT m_soll_em_has_komp_portout /end LOC_MEASUREMENT /end FUNCTION
/begin FUNCTION SSAo63_Complement_ui8_ "" /begin LOC_MEASUREMENT n_mot_llsoll_has_komp_portout /end LOC_MEASUREMENT /end FUNCTION
/begin FUNCTION SSAo64_Complement_ui16_ "" /begin LOC_MEASUREMENT n_soll_em_has_komp_portout /end LOC_MEASUREMENT /end FUNCTION
/begin FUNCTION SSAo65_Complement_ui16_ "" /begin LOC_MEASUREMENT n_soll_vm_has_komp_portout /end LOC_MEASUREMENT /end FUNCTION
/begin FUNCTION SSAo68_If_Action_Subsystem "" /begin DEF_CHARACTERISTIC M_K0MAX_OUT_HAS TAB_MK0MAXOUT_AKTIV_HAS /end DEF_CHARACTERISTIC /begin LOC_MEASUREMENT m_k0_in status_k0_in /end LOC_MEASUREMENT /end FUNCTION
/begin FUNCTION SSAo69_If_Action_Subsystem1 "" /begin DEF_CHARACTERISTIC SWI_MK0HASOUT_MK0MOD_HAS /end DEF_CHARACTERISTIC /begin LOC_MEASUREMENT m_k0_in m_k0_mod_has_fkt /end LOC_MEASUREMENT /end FUNCTION
/begin FUNCTION SSAo70_Complement_ui8_ "" /begin LOC_MEASUREMENT z_m_soll_em_has_komp_portout /end LOC_MEASUREMENT /end FUNCTION
/begin FUNCTION SSAo71_Complement_ui8_ "" /begin LOC_MEASUREMENT z_n_soll_em_has_komp_portout /end LOC_MEASUREMENT /end FUNCTION
/begin FUNCTION SSAo72_Complement_ui8_ "" /begin LOC_MEASUREMENT z_n_soll_vm_has_komp_portout /end LOC_MEASUREMENT /end FUNCTION
/begin FUNCTION SYSTEMZUSTAENDE "Kraftschluss und diverse Signalabbildungen"
 /begin IN_MEASUREMENT iUl2EdsSignalFl.globale_einst_bed iUl2EdsSignalFl.n_poskflwechsel_zaehler iUl2EdsSignalFl.pos_alt iUl2EdsSignalFl.posv_ueb_aktiv_l2 iUl2EdsSignalInt.globale_einst_bed iUl2EdsSignalInt.n_poskflwechsel_zaehler iUl2EdsSignalInt.pos_alt iUl2EdsSignalInt.posv_ueb_aktiv_l2 iUl2KraftschlussFl.iKupAbsA.eds_nr iUl2KraftschlussFl.iKupAbsA.typ iUl2KraftschlussFl.iKupAbsA.zustand iUl2KraftschlussFl.iKupAbsC.eds_nr iUl2KraftschlussFl.iKupAbsC.typ iUl2KraftschlussFl.iKupAbsC.zustand iUl2KraftschlussFl.iKupAbsE.eds_nr iUl2KraftschlussFl.iKupAbsE.typ iUl2KraftschlussFl.iKupAbsE.zustand iUl2KraftschlussFl.kup_b_geschl iUl2KraftschlussFl.kup_d_geschl iUl2KraftschlussFl.n_maxkabpos_c_zaehler iUl2KraftschlussFl.n_maxkabpos_e_zaehler iUl2KraftschlussFl.n_verz_edslogik iUl2KraftschlussFl.zustand iUl2KraftschlussFl.zustand_gespeichert iUl2KraftschlussInt.iKupAbsA.eds_nr iUl2KraftschlussInt.iKupAbsA.typ iUl2KraftschlussInt.iKupAbsA.zustand iUl2KraftschlussInt.iKupAbsC.eds_nr iUl2KraftschlussInt.iKupAbsC.typ iUl2KraftschlussInt.iKupAbsC.zustand iUl2KraftschlussInt.iKupAbsE.eds_nr iUl2KraftschlussInt.iKupAbsE.typ iUl2KraftschlussInt.iKupAbsE.zustand iUl2KraftschlussInt.kup_b_geschl iUl2KraftschlussInt.kup_d_geschl iUl2KraftschlussInt.n_maxkabpos_c_zaehler iUl2KraftschlussInt.n_maxkabpos_e_zaehler iUl2KraftschlussInt.n_verz_edslogik iUl2KraftschlussInt.zustand iUl2KraftschlussInt.zustand_gespeichert /end IN_MEASUREMENT
/end FUNCTION
/begin FUNCTION TCI "In TCI sind Funktionen zur Bestimmung der thermischen Kupplungsbelastung und der Kupplungstemperatur enthalten"
 /begin IN_MEASUREMENT iTciCompu.auslastung_lkab iTciCompu.auslastung_lkab_int iTciCompu.auslastung_lkzu iTciCompu.auslastung_lkzu_int iTciCompu.auslastung_wkab iTciCompu.auslastung_wkab_int iTciCompu.auslastung_wkzu iTciCompu.auslastung_wkzu_int iTciCompu.c_kupplung_gestz iTciCompu.c_kupplung_max iTciCompu.f_timer_belast_ber_kab_gestartet iTciCompu.f_timer_belast_ber_kzu_gestartet iTciCompu.flag_ende_kab_ber_erreicht iTciCompu.flag_ende_kzu_ber_erreicht iTciCompu.flag_schaltung_ende iTciCompu.iPKAbFilter.letzter_ms_timer iTciCompu.iPKAbFilter.x iTciCompu.iPKZuFilter.letzter_ms_timer iTciCompu.iPKZuFilter.x iTciCompu.istgang_idx_merk iTciCompu.k_ab iTciCompu.k_zu iTciCompu.l_kab iTciCompu.l_kab_int iTciCompu.l_kab_max iTciCompu.l_kab_max_int iTciCompu.l_kab_max_spez iTciCompu.l_kab_max_spez_int iTciCompu.l_kzu iTciCompu.l_kzu_int iTciCompu.l_kzu_max iTciCompu.l_kzu_max_int iTciCompu.l_kzu_max_spez iTciCompu.l_kzu_max_spez_int iTciCompu.m_kab iTciCompu.m_kzu iTciCompu.nd_abs_kab iTciCompu.nd_abs_kzu iTciCompu.schaltart_sas_red_tci iTciCompu.timer_seit_start_ber_belastung_kab iTciCompu.timer_seit_start_ber_belastung_kzu iTciCompu.w_kab iTciCompu.w_kab_int iTciCompu.w_kab_speicher iTciCompu.w_kab_spez iTciCompu.w_kab_spez_int iTciCompu.w_kzu iTciCompu.w_kzu_int iTciCompu.w_kzu_speicher iTciCompu.w_kzu_spez iTciCompu.w_kzu_spez_int iTciCompu.z_tci iTciCompu.zielgang_sas_idx_merk iTempMKupA.c_kupplung iTempMKupA.c_kupplung_intern iTempMKupA.c_kupplung_merk iTempMKupA.f_aufheizung_aktiv iTempMKupA.kupplung iTempMKupA.q_ab_kupplung iTempMKupA.q_zu_kupplung iTempMKupC.c_kupplung iTempMKupC.c_kupplung_intern iTempMKupC.c_kupplung_merk iTempMKupC.f_aufheizung_aktiv iTempMKupC.kupplung iTempMKupC.q_ab_kupplung iTempMKupC.q_zu_kupplung iTempMKupD.c_kupplung iTempMKupD.c_kupplung_intern iTempMKupD.c_kupplung_merk iTempMKupD.f_aufheizung_aktiv iTempMKupD.kupplung iTempMKupD.q_ab_kupplung iTempMKupD.q_zu_kupplung iTempMKupE.c_kupplung iTempMKupE.c_kupplung_intern iTempMKupE.c_kupplung_merk iTempMKupE.f_aufheizung_aktiv iTempMKupE.kupplung iTempMKupE.q_ab_kupplung iTempMKupE.q_zu_kupplung /end IN_MEASUREMENT
/end FUNCTION
/begin FUNCTION UEW "Das Paket UEW enthält alle Klassen und Funktionalitäten, welche zur Überwachung des Getriebes notwendig sind."
 /begin SUB_FUNCTION UEW_KOORDINATOR UEW_UWIG UEW_UWIG_ALT UEW_PARKSPERRENMAGNET UEW_POSITIONSVENTIL UEW_RBM /end SUB_FUNCTION
/end FUNCTION
/begin FUNCTION UEW_KOORDINATOR "Die Unterstruktur UEW_KOORDINATOR enthält Klassen, die für die Koordination verschiedener Überwachungsfunktionen notwendig sind."
 /begin IN_MEASUREMENT iKorDiagl.b_eg_uwig_direkt_getr_notlaufsp iKorDiagl.ersatzgang iKorDiagl.ersatzgang_info iKorDiagl.symptom_aktiv /end IN_MEASUREMENT
/end FUNCTION
/begin FUNCTION UEW_PARKSPERRENMAGNET "Überwachung der Korrekten Funktion des Parksperrenmagnets"
 /begin IN_MEASUREMENT iUewParksperrenmagnet.flag_einstiegsbed iUewParksperrenmagnet.flag_pmueb iUewParksperrenmagnet.iTimerPmdef.timer iUewParksperrenmagnet.iTimerPmueb.timer iUewParksperrenmagnet.iTimerVerzpmueb.timer iUewParksperrenmagnet.n_stoer_pmueb iUewParksperrenmagnet.zustand /end IN_MEASUREMENT
/end FUNCTION
/begin FUNCTION UEW_PLAUSI_AUSLEGEN_P "Teilfunktion Plausibilisierung Aktuatoransteuerung/ Sollposition P"
 /begin IN_MEASUREMENT iUl2PAbsicherungAuslPFl.einst_bed_einmalig iUl2PAbsicherungAuslPFl.f_call_ext iUl2PAbsicherungAuslPFl.n_richtigpos_p iUl2PAbsicherungAuslPFl.n_stoerpos_p iUl2PAbsicherungAuslPFl.n_vpospueb iUl2PAbsicherungAuslPInt.einst_bed_einmalig iUl2PAbsicherungAuslPInt.f_call_ext iUl2PAbsicherungAuslPInt.n_richtigpos_p iUl2PAbsicherungAuslPInt.n_stoerpos_p iUl2PAbsicherungAuslPInt.n_vpospueb /end IN_MEASUREMENT
/end FUNCTION
/begin FUNCTION UEW_PLAUSI_EDSLOGIK "Überwachung Anzahl geschalteter Schaltelemente"
 /begin IN_MEASUREMENT iUl2EdsLogikFl.f_call_ext iUl2EdsLogikFl.n_zaehler_rueck iUl2EdsLogikInt.f_call_ext iUl2EdsLogikInt.n_zaehler_rueck /end IN_MEASUREMENT
/end FUNCTION
/begin FUNCTION UEW_PLAUSI_EINLEGEN_P "Teilfunktion Absicherung gegen unerlaubtes Einlegen von P bei unplausibler Fahrzeuggeschwindigkeit"
 /begin IN_MEASUREMENT iUl2PAbsicherungEinlPFl.f_call_ext iUl2PAbsicherungEinlPFl.n_richtigvplausipos_p iUl2PAbsicherungEinlPFl.n_stoervplausipos_p iUl2PAbsicherungEinlPInt.f_call_ext iUl2PAbsicherungEinlPInt.n_richtigvplausipos_p iUl2PAbsicherungEinlPInt.n_stoervplausipos_p /end IN_MEASUREMENT
/end FUNCTION
/begin FUNCTION UEW_PLAUSI_K0 "Teilfunktion Plausibilisierung der Ansteuerung der K0"
 /begin IN_MEASUREMENT iUl2K0SPlausiDrehzFl.cUl2K0SPlausiFl._.n_diff_k0 iUl2K0SPlausiDrehzFl.cUl2K0SPlausiFl._.n_diff_k0_einmalig iUl2K0SPlausiDrehzFl.cUl2K0SPlausiFl._.n_i_eds_k0_bed iUl2K0SPlausiDrehzFl.cUl2K0SPlausiFl._.n_k0ueb iUl2K0SPlausiDrehzFl.cUl2K0SPlausiFl._.n_stoeredslogik_k0 iUl2K0SPlausiDrehzFl.cUl2K0SPlausiFl._.st_fehler iUl2K0SPlausiDrehzFl.diff_n_em iUl2K0SPlausiDrehzFl.n_emeink0_n iUl2K0SPlausiDrehzInt.cUl2K0SPlausiInt._.n_diff_k0 iUl2K0SPlausiDrehzInt.cUl2K0SPlausiInt._.n_diff_k0_einmalig iUl2K0SPlausiDrehzInt.cUl2K0SPlausiInt._.n_i_eds_k0_bed iUl2K0SPlausiDrehzInt.cUl2K0SPlausiInt._.n_k0ueb iUl2K0SPlausiDrehzInt.cUl2K0SPlausiInt._.n_stoeredslogik_k0 iUl2K0SPlausiDrehzInt.cUl2K0SPlausiInt._.st_fehler iUl2K0SPlausiDrehzInt.diff_n_em iUl2K0SPlausiDrehzInt.n_emeink0_n iUl2K0SPlausiMomFl.cUl2K0SPlausiFl._.n_diff_k0 iUl2K0SPlausiMomFl.cUl2K0SPlausiFl._.n_diff_k0_einmalig iUl2K0SPlausiMomFl.cUl2K0SPlausiFl._.n_i_eds_k0_bed iUl2K0SPlausiMomFl.cUl2K0SPlausiFl._.n_k0ueb iUl2K0SPlausiMomFl.cUl2K0SPlausiFl._.n_stoeredslogik_k0 iUl2K0SPlausiMomFl.cUl2K0SPlausiFl._.st_fehler iUl2K0SPlausiMomFl.k0_energie_min_reibw_skal iUl2K0SPlausiMomFl.n_emeink0_m iUl2K0SPlausiMomFl.summe_momente iUl2K0SPlausiMomInt.cUl2K0SPlausiInt._.n_diff_k0 iUl2K0SPlausiMomInt.cUl2K0SPlausiInt._.n_diff_k0_einmalig iUl2K0SPlausiMomInt.cUl2K0SPlausiInt._.n_i_eds_k0_bed iUl2K0SPlausiMomInt.cUl2K0SPlausiInt._.n_k0ueb iUl2K0SPlausiMomInt.cUl2K0SPlausiInt._.n_stoeredslogik_k0 iUl2K0SPlausiMomInt.cUl2K0SPlausiInt._.st_fehler iUl2K0SPlausiMomInt.k0_energie_min_reibw_skal iUl2K0SPlausiMomInt.n_emeink0_m iUl2K0SPlausiMomInt.summe_momente /end IN_MEASUREMENT
/end FUNCTION
/begin FUNCTION UEW_PLAUSI_R_GANGSICHERUNG "Teilfunktion R-Gangsicherung bei zu hoher Fahrzeuggeschwindigkeit"
 /begin IN_MEASUREMENT iUl2RGangSicherungFl.f_call_ext iUl2RGangSicherungInt.f_call_ext /end IN_MEASUREMENT
/end FUNCTION
/begin FUNCTION UEW_PLAUSI_SOLLPOS_D_R "Teilfunktion Plausibilisierung Aktuatoransteuerung/ Sollposition D/ R"
 /begin IN_MEASUREMENT iUl2AktuatorAnstDRFl.n_erfolg_fahrtr_edslogik iUl2AktuatorAnstDRFl.n_stoer_fahrtr_edslogik iUl2AktuatorAnstDRInt.n_erfolg_fahrtr_edslogik iUl2AktuatorAnstDRInt.n_stoer_fahrtr_edslogik /end IN_MEASUREMENT
/end FUNCTION
/begin FUNCTION UEW_POSITIONSVENTIL "Überwachung der Korrekten Funktion des Positionsventils"
 /begin IN_MEASUREMENT iUewSgetf.f_keine_egs_offtime iUewSgetf.f_timer_zuendung_reset iUewSgetf.i_edsc_min iUewSgetf.n_stoer_posv iUewSgetf.posv_diagnose_aktiv iUewSgetf.pruefung_posvmechdef_aktiv iUewSgetf.ps_sensor_err iUewSgetf.ps_sensor_signal_alt iUewSgetf.pumpendruck_vorh_posv_uew_alt iUewSgetf.timer_posvmechdef iUewSgetf.timer_verzposvueb iUewSgetf.timer_zuendung iUewSgetf.zwangsposition_p iUewSgetf.zz_zustand /end IN_MEASUREMENT
/end FUNCTION
/begin FUNCTION UEW_RBM "Die Unterstruktur UEW_RBM enthält Prüfmethoden zur Überwachung von abgasrelevanten Überwachungsfunktionen."
 /begin IN_MEASUREMENT iDiaRbmif.flag_rbm_zust_hanfahr_iae iDiaRbmif.flag_rbm_zust_inaktiv_iae iDiaRbmif.flag_rbm_zustand_posn iDiaRbmif.flag_rbm_zustand_uwigkup iDiaRbmif.flag_rbm_zustand_uwigschalt iDiaRbmif.rbm_istgang_vorw_alt iDiaRbmif.rbm_zielgang_sas_vorw_alt /end IN_MEASUREMENT
/end FUNCTION
/begin FUNCTION UEW_UWIG "Übersetzungsüberwachung" /begin SUB_FUNCTION ALLGMEIN /end SUB_FUNCTION /end FUNCTION
/begin FUNCTION UEW_UWIG_ALT "Übersetzungsüberwachung vor dem ReDesign"
 /begin IN_MEASUREMENT iUewIgetr.b_uwig_auf_symptom_pruefen iUewIgetr.delta_dki iUewIgetr.dki_max iUewIgetr.dki_min iUewIgetr.f_abbruch_akt_ueberwachung iUewIgetr.f_ersatzprogramm_aktiv iUewIgetr.f_ersatzwert_stc iUewIgetr.f_ist_ersatzgang_gang_stc iUewIgetr.f_ist_ersatzgang_ge_stc iUewIgetr.f_ist_ersatzgang_schalt_stc iUewIgetr.f_ist_ge_stc iUewIgetr.f_ist_nab_kleiner_schwelle_stc iUewIgetr.f_ist_neue_schaltung_stc iUewIgetr.f_ist_neues_ge_stc iUewIgetr.f_ist_schaltung_stc iUewIgetr.f_ist_stoerung_stc iUewIgetr.f_ist_symptom_gang_stc iUewIgetr.f_ist_symptom_ge_stc iUewIgetr.f_ist_symptom_schalt_stc iUewIgetr.f_pruefbed_im_gang_erreicht_stc iUewIgetr.f_schalt_durch_sym_schalt_stc iUewIgetr.f_stoer_offset_in_schaltung_stc iUewIgetr.f_timer16_rampe_gestartet_stc iUewIgetr.f_ueberwache_ge_stc iUewIgetr.fl_erf_iepuwig iUewIgetr.fl_sym_iepuwig iUewIgetr.flg_kfc_ratioglobal iUewIgetr.flg_kuppident iUewIgetr.i_gang iUewIgetr.i_gang_ge_start iUewIgetr.i_oben_rampe_start_stc iUewIgetr.i_sw_oben iUewIgetr.i_sw_unten iUewIgetr.i_unten_rampe_start_stc iUewIgetr.istgang_akt_uew_stc iUewIgetr.istgang_vorherige_schaltung_stc iUewIgetr.kfc_index_set iUewIgetr.kfl_ziel_bei_symptom_stc iUewIgetr.kup_ge1_stc iUewIgetr.kup_ge2_stc iUewIgetr.kup_ge3_stc iUewIgetr.loop_cnt_stc iUewIgetr.m_kup_ge1_stc iUewIgetr.m_kup_ge2_stc iUewIgetr.m_kup_ge3_stc iUewIgetr.m_kupuwigsym_a iUewIgetr.m_kupuwigsym_b iUewIgetr.m_kupuwigsym_c iUewIgetr.m_kupuwigsym_d iUewIgetr.m_kupuwigsym_e iUewIgetr.n_erfolg_symio_a iUewIgetr.n_erfolg_symio_b iUewIgetr.n_erfolg_symio_c iUewIgetr.n_erfolg_symio_d iUewIgetr.n_erfolg_symio_e iUewIgetr.n_erfolguwig iUewIgetr.n_stoer_gang iUewIgetr.n_stoer_ge iUewIgetr.n_stoer_schalt iUewIgetr.n_sym_uwig_cnt_kup_a iUewIgetr.n_sym_uwig_cnt_kup_b iUewIgetr.n_sym_uwig_cnt_kup_c iUewIgetr.n_sym_uwig_cnt_kup_d iUewIgetr.n_sym_uwig_cnt_kup_e iUewIgetr.n_sym_uwig_schalt12 iUewIgetr.n_sym_uwig_schalt21 iUewIgetr.n_sym_uwig_schalt23 iUewIgetr.n_sym_uwig_schalt31 iUewIgetr.n_sym_uwig_schalt32 iUewIgetr.n_sym_uwig_schalt34 iUewIgetr.n_sym_uwig_schalt42 iUewIgetr.n_sym_uwig_schalt43 iUewIgetr.n_sym_uwig_schalt45 iUewIgetr.n_sym_uwig_schalt51 iUewIgetr.n_sym_uwig_schalt53 iUewIgetr.n_sym_uwig_schalt54 iUewIgetr.n_sym_uwig_schalt56 iUewIgetr.n_sym_uwig_schalt63 iUewIgetr.n_sym_uwig_schalt64 iUewIgetr.n_sym_uwig_schalt65 iUewIgetr.n_sym_uwig_schalt67 iUewIgetr.n_sym_uwig_schalt71 iUewIgetr.n_sym_uwig_schalt75 iUewIgetr.n_sym_uwig_schalt76 iUewIgetr.n_sym_uwig_schalt78 iUewIgetr.n_sym_uwig_schalt82 iUewIgetr.n_sym_uwig_schalt84 iUewIgetr.n_sym_uwig_schalt86 iUewIgetr.n_sym_uwig_schalt87 iUewIgetr.n_t_0_stc iUewIgetr.n_t_ge_start_stc iUewIgetr.nd_synzielgang iUewIgetr.nd_tuwig_ge iUewIgetr.ng_t_ge_start iUewIgetr.schaltart_akt_uew_stc iUewIgetr.symptom_reaktion iUewIgetr.symptom_uwig_r_gang_aktiv iUewIgetr.t_maxsas_stc iUewIgetr.timer16_rampe iUewIgetr.timer16_rznuwig iUewIgetr.timer16_uwig_sas iUewIgetr.timer16_uwigrnf iUewIgetr.timer_iepuwig iUewIgetr.timer_iepuwig_erfolg iUewIgetr.timer_reg_start iUewIgetr.timer_uwig_ge iUewIgetr.timer_uwig_schalt_abbruch iUewIgetr.timer_vngabuwig iUewIgetr.uwig_abbruchgang iUewIgetr.uwig_pruefstatus_kup_a iUewIgetr.uwig_pruefstatus_kup_b iUewIgetr.uwig_pruefstatus_kup_c iUewIgetr.uwig_pruefstatus_kup_d iUewIgetr.uwig_pruefstatus_kup_e iUewIgetr.zielgang_sas_akt_uew_stc iUewIgetr.zustand_uwig /end IN_MEASUREMENT
/end FUNCTION
/begin FUNCTION UL2 "Das Paket UL2 enthält alle Klassen und Funktionalitäten, welche zur Level 2 Absicherung des Getriebes notwendig sind."
 /begin SUB_FUNCTION UL2_BIB_SICHERHEIT UL2_BIB_ALLGEMEIN UL2_ATSYS_ITF UL2_SYSTEMZUSTAENDE UL2_UEW_EDSLOGIK_KUPPL UL2_UEW_EDSLOGIK UL2_UEW_KFLPL UL2_UEW_MOTOREINGRIFF UL2_UEW_GETR_M_AUF UL2_UEW_NMOT /end SUB_FUNCTION
/end FUNCTION
/begin FUNCTION UL2_ATSYS_ITF "Die Unterstruktur UL2_ATSYS_ITF enthält alle Schnittstellenklassen, über die mit den anderen Komponenten oder auf ATSYS-Schnittstellen zugegriffen werden kann."
 /begin IN_MEASUREMENT iUl2ItfOutIGangFl.i_gang iUl2ItfOutIGangInt.i_gang iUl2ItfipFl.c_getr_l2 iUl2ItfipFl.dsc_fehler_l2 iUl2ItfipFl.fzg_geschwindigkeit_max_l2 iUl2ItfipFl.iv_c_getr_l2_komp iUl2ItfipFl.iv_dscfehlerl2komp iUl2ItfipFl.iv_fzg_geschwindigkeit_max_l2_komp iUl2ItfipFl.iv_m_ist_em_l2_komp iUl2ItfipFl.iv_m_ist_vm_l2_komp iUl2ItfipFl.iv_m_mot_l2_komp iUl2ItfipFl.iv_mmotist_l2_komp iUl2ItfipFl.iv_n_ab_l2_komp iUl2ItfipFl.iv_n_ab_max_l2_komp iUl2ItfipFl.iv_n_turb_l2_komp iUl2ItfipFl.iv_nmo_vm_l2_komp iUl2ItfipFl.iv_nmotabregell2komp iUl2ItfipFl.iv_nmotl2komp iUl2ItfipFl.iv_pos_l2_komp iUl2ItfipFl.iv_ps_sensor_signal_l2_komp iUl2ItfipFl.iv_ps_sensor_status_l2_komp iUl2ItfipFl.iv_v_unplausibel_l2_komp iUl2ItfipFl.m_ist_em_l2 iUl2ItfipFl.m_ist_vm_l2 iUl2ItfipFl.m_mot_l2 iUl2ItfipFl.mmotist_l2 iUl2ItfipFl.n_ab_l2 iUl2ItfipFl.n_ab_max_l2 iUl2ItfipFl.n_mot_l2 iUl2ItfipFl.n_motabregel_l2 iUl2ItfipFl.n_turb_l2 iUl2ItfipFl.nmo_vm_l2 iUl2ItfipFl.pos_l2 iUl2ItfipFl.ps_sensor_signal_l2 iUl2ItfipFl.ps_sensor_status_l2 iUl2ItfipFl.v_unplausibel_l2 iUl2ItfipInt.c_getr_l2 iUl2ItfipInt.dsc_fehler_l2 iUl2ItfipInt.fzg_geschwindigkeit_max_l2 iUl2ItfipInt.iv_c_getr_l2 iUl2ItfipInt.iv_dscfehlerl2 iUl2ItfipInt.iv_fzg_geschwindigkeit_max_l2 iUl2ItfipInt.iv_m_ist_em_l2 iUl2ItfipInt.iv_m_ist_vm_l2 iUl2ItfipInt.iv_m_mot_l2 iUl2ItfipInt.iv_mmotist_l2 iUl2ItfipInt.iv_n_ab_l2 iUl2ItfipInt.iv_n_ab_max_l2 iUl2ItfipInt.iv_n_turb_l2 iUl2ItfipInt.iv_nmo_vm_l2 iUl2ItfipInt.iv_nmotabregell2 iUl2ItfipInt.iv_nmotl2 iUl2ItfipInt.iv_pos_l2 iUl2ItfipInt.iv_ps_sensor_signal_l2 iUl2ItfipInt.iv_ps_sensor_status_l2 iUl2ItfipInt.iv_v_unplausibel_l2 iUl2ItfipInt.m_ist_em_l2 iUl2ItfipInt.m_ist_vm_l2 iUl2ItfipInt.m_mot_l2 iUl2ItfipInt.mmotist_l2 iUl2ItfipInt.n_ab_l2 iUl2ItfipInt.n_ab_max_l2 iUl2ItfipInt.n_mot_l2 iUl2ItfipInt.n_motabregel_l2 iUl2ItfipInt.n_turb_l2 iUl2ItfipInt.nmo_vm_l2 iUl2ItfipInt.pos_l2 iUl2ItfipInt.ps_sensor_signal_l2 iUl2ItfipInt.ps_sensor_status_l2 iUl2ItfipInt.swi_m_mot_l2 iUl2ItfipInt.v_unplausibel_l2 iUl2ItfipUewFl.m_getrauf iUl2ItfipUewFl.m_motmax iUl2ItfipUewFl.me_red_abs iUl2ItfipUewFl.me_red_status iUl2ItfipUewFl.zielgang_sas iUl2ItfipUewInt.m_getrauf iUl2ItfipUewInt.m_motmax iUl2ItfipUewInt.me_red_abs iUl2ItfipUewInt.me_red_status iUl2ItfipUewInt.zielgang_sas /end IN_MEASUREMENT
/end FUNCTION
/begin FUNCTION UL2_BIB_ALLGEMEIN "allgemeine Bibliotheken"
 /begin IN_MEASUREMENT iUl2GetrMAufFl.cBasFehlerErfolgFl._.flag_fehler iUl2GetrMAufFl.cBasFehlerErfolgFl._.zaehler_erfolge iUl2GetrMAufFl.cBasFehlerErfolgFl._.zaehler_fehler iUl2GetrMAufFl.mmot_auf_zul iUl2GetrMAufInt.cBasFehlerErfolgInt._.flag_fehler iUl2GetrMAufInt.cBasFehlerErfolgInt._.zaehler_erfolge iUl2GetrMAufInt.cBasFehlerErfolgInt._.zaehler_fehler iUl2GetrMAufInt.mmot_auf_zul iUl2GetrMAufInt.n_maxstoermgetrauf iUl2NegMeIntenFl.cBasFehlerErfolgFl._.flag_fehler iUl2NegMeIntenFl.cBasFehlerErfolgFl._.zaehler_erfolge iUl2NegMeIntenFl.cBasFehlerErfolgFl._.zaehler_fehler iUl2NegMeIntenInt.cBasFehlerErfolgInt._.flag_fehler iUl2NegMeIntenInt.cBasFehlerErfolgInt._.zaehler_erfolge iUl2NegMeIntenInt.cBasFehlerErfolgInt._.zaehler_fehler iUl2NegMeSigFl.cBasFehlerErfolgFl._.flag_fehler iUl2NegMeSigFl.cBasFehlerErfolgFl._.zaehler_erfolge iUl2NegMeSigFl.cBasFehlerErfolgFl._.zaehler_fehler iUl2NegMeSigInt.cBasFehlerErfolgInt._.flag_fehler iUl2NegMeSigInt.cBasFehlerErfolgInt._.zaehler_erfolge iUl2NegMeSigInt.cBasFehlerErfolgInt._.zaehler_fehler iUl2PosMeGradientFl.cBasFehlerErfolgFl._.flag_fehler iUl2PosMeGradientFl.cBasFehlerErfolgFl._.zaehler_erfolge iUl2PosMeGradientFl.cBasFehlerErfolgFl._.zaehler_fehler iUl2PosMeGradientFl.me_mot_anford iUl2PosMeGradientFl.me_mot_rueckm iUl2PosMeGradientFl.ng_ab_fl.n_f iUl2PosMeGradientFl.ng_meueb iUl2PosMeGradientFl.ng_t_fl.n_f iUl2PosMeGradientInt.cBasFehlerErfolgInt._.flag_fehler iUl2PosMeGradientInt.cBasFehlerErfolgInt._.zaehler_erfolge iUl2PosMeGradientInt.cBasFehlerErfolgInt._.zaehler_fehler iUl2PosMeGradientInt.me_mot_anford iUl2PosMeGradientInt.me_mot_rueckm iUl2PosMeGradientInt.ng_ab_l2.n_f iUl2PosMeGradientInt.ng_meueb iUl2PosMeGradientInt.ng_t_l2.n_f iUl2PosMeIntenVar1Fl.cBasFehlerErfolgFl._.flag_fehler iUl2PosMeIntenVar1Fl.cBasFehlerErfolgFl._.zaehler_erfolge iUl2PosMeIntenVar1Fl.cBasFehlerErfolgFl._.zaehler_fehler iUl2PosMeIntenVar1Fl.schwellen_variante iUl2PosMeIntenVar1Int.cBasFehlerErfolgInt._.flag_fehler iUl2PosMeIntenVar1Int.cBasFehlerErfolgInt._.zaehler_erfolge iUl2PosMeIntenVar1Int.cBasFehlerErfolgInt._.zaehler_fehler iUl2PosMeIntenVar1Int.schwellen_variante iUl2PosMeIntenVar2Fl.cBasFehlerErfolgFl._.flag_fehler iUl2PosMeIntenVar2Fl.cBasFehlerErfolgFl._.zaehler_erfolge iUl2PosMeIntenVar2Fl.cBasFehlerErfolgFl._.zaehler_fehler iUl2PosMeIntenVar2Fl.schwellen_variante iUl2PosMeIntenVar2Int.cBasFehlerErfolgInt._.flag_fehler iUl2PosMeIntenVar2Int.cBasFehlerErfolgInt._.zaehler_erfolge iUl2PosMeIntenVar2Int.cBasFehlerErfolgInt._.zaehler_fehler iUl2PosMeIntenVar2Int.schwellen_variante iUl2PosMeSigFl.cBasFehlerErfolgFl._.flag_fehler iUl2PosMeSigFl.cBasFehlerErfolgFl._.zaehler_erfolge iUl2PosMeSigFl.cBasFehlerErfolgFl._.zaehler_fehler iUl2PosMeSigInt.cBasFehlerErfolgInt._.flag_fehler iUl2PosMeSigInt.cBasFehlerErfolgInt._.zaehler_erfolge iUl2PosMeSigInt.cBasFehlerErfolgInt._.zaehler_fehler /end IN_MEASUREMENT
/end FUNCTION
/begin FUNCTION UL2_BIB_SICHERHEIT "Das Paket enhält die Sicherheitsfunktionen zum Beispiel Komplementprüfung, RAM-Prüfungen für die Level2-Funktionen."
 /begin IN_MEASUREMENT iUl2PosMeGradientFl.ng_ab_fl.n_f iUl2PosMeGradientFl.ng_t_fl.n_f iUl2PosMeGradientInt.ng_ab_l2.n_f iUl2PosMeGradientInt.ng_t_l2.n_f /end IN_MEASUREMENT
/end FUNCTION
/begin FUNCTION UL2_DREHZAHLBEOBACHTER "Drehzahlbeobachter"
 /begin IN_MEASUREMENT iUl2DrehzahlBeobFl.fl_drehzbeob_schaltung iUl2DrehzahlBeobFl.i_drehzahl_beobachter iUl2DrehzahlBeobInt.fl_drehzbeob_schaltung iUl2DrehzahlBeobInt.i_drehzahl_beobachter /end IN_MEASUREMENT
/end FUNCTION
/begin FUNCTION UL2_HYDRAULIK "Abbildung der Hydraulik auf Klassenebene"
 /begin IN_MEASUREMENT iUl2EdsKupAFl.cUl2EdsBasisFl._.nr iUl2EdsKupAFl.cUl2EdsBasisFl._.type iUl2EdsKupAInt.cUl2EdsBasisInt._.nr iUl2EdsKupAInt.cUl2EdsBasisInt._.type iUl2EdsKupBFl.cUl2EdsBasisFl._.nr iUl2EdsKupBFl.cUl2EdsBasisFl._.type iUl2EdsKupBInt.cUl2EdsBasisInt._.nr iUl2EdsKupBInt.cUl2EdsBasisInt._.type iUl2EdsKupCFl.cUl2EdsBasisFl._.nr iUl2EdsKupCFl.cUl2EdsBasisFl._.type iUl2EdsKupCInt.cUl2EdsBasisInt._.nr iUl2EdsKupCInt.cUl2EdsBasisInt._.type iUl2EdsKupDFl.cUl2EdsBasisFl._.nr iUl2EdsKupDFl.cUl2EdsBasisFl._.type iUl2EdsKupDInt.cUl2EdsBasisInt._.nr iUl2EdsKupDInt.cUl2EdsBasisInt._.type iUl2EdsKupEFl.cUl2EdsBasisFl._.nr iUl2EdsKupEFl.cUl2EdsBasisFl._.type iUl2EdsKupEInt.cUl2EdsBasisInt._.nr iUl2EdsKupEInt.cUl2EdsBasisInt._.type /end IN_MEASUREMENT
/end FUNCTION
/begin FUNCTION UL2_STROMLOS "Stromlosberechnung"
 /begin IN_MEASUREMENT iUl2StromlosAusserPsFl.alt_stromlos_ausser_ps_l2 iUl2StromlosAusserPsFl.stromlos_ausser_ps_l2 iUl2StromlosAusserPsInt.alt_stromlos_ausser_ps_l2 iUl2StromlosAusserPsInt.stromlos_ausser_ps_l2 /end IN_MEASUREMENT
/end FUNCTION
/begin FUNCTION UL2_SYSTEMZUSTAENDE "Dieses Unterpaket enthält Funktionen/Berechnungen/Abbildungen von Getriebezuständen, die von versch. Überwachungsfkt. benötigt werden. Die enthaltenen Fkt. müssen immer vor den Überwachungen aufgerufen werden." /begin SUB_FUNCTION UL2_HYDRAULIK UL2_STROMLOS UL2_DREHZAHLBEOBACHTER /end SUB_FUNCTION /end FUNCTION
/begin FUNCTION UL2_UEW_EDSLOGIK "Überwachungsfunktionen der EdsLogik"
 /begin SUB_FUNCTION SYSTEMZUSTAENDE UEW_PLAUSI_EDSLOGIK UEW_PLAUSI_SOLLPOS_D_R UEW_PLAUSI_R_GANGSICHERUNG UEW_PLAUSI_EINLEGEN_P UEW_PLAUSI_AUSLEGEN_P UEW_PLAUSI_K0 /end SUB_FUNCTION
/end FUNCTION
/begin FUNCTION UL2_UEW_EDSLOGIK_KUPPL "Kupplungsmodell"
 /begin IN_MEASUREMENT iUl2KoordKupplFl.maxstoercgdeltai_edslogik_max iUl2KoordKupplFl.n_kup_zu_edslogik iUl2KoordKupplFl.n_kup_zu_edslogik_summe iUl2KoordKupplInt.maxstoercgdeltai_edslogik_max iUl2KoordKupplInt.n_kup_zu_edslogik iUl2KoordKupplInt.n_kup_zu_edslogik_summe iUl2KraftschlussFl.iKupAbsA.eds_nr iUl2KraftschlussFl.iKupAbsA.typ iUl2KraftschlussFl.iKupAbsA.zustand iUl2KraftschlussFl.iKupAbsC.eds_nr iUl2KraftschlussFl.iKupAbsC.typ iUl2KraftschlussFl.iKupAbsC.zustand iUl2KraftschlussFl.iKupAbsE.eds_nr iUl2KraftschlussFl.iKupAbsE.typ iUl2KraftschlussFl.iKupAbsE.zustand iUl2KraftschlussInt.iKupAbsA.eds_nr iUl2KraftschlussInt.iKupAbsA.typ iUl2KraftschlussInt.iKupAbsA.zustand iUl2KraftschlussInt.iKupAbsC.eds_nr iUl2KraftschlussInt.iKupAbsC.typ iUl2KraftschlussInt.iKupAbsC.zustand iUl2KraftschlussInt.iKupAbsE.eds_nr iUl2KraftschlussInt.iKupAbsE.typ iUl2KraftschlussInt.iKupAbsE.zustand iUl2KupplAFl.cUl2KupBasisFl._.eds_nr iUl2KupplAFl.cUl2KupBasisFl._.f_geschlossen iUl2KupplAFl.cUl2KupBasisFl._.kup_nr iUl2KupplAFl.delta_i_edslogik iUl2KupplAFl.f_erste_bef_erk iUl2KupplAFl.f_init iUl2KupplAFl.i_sw_kup_oeffnet iUl2KupplAFl.i_sw_kup_schliesst iUl2KupplAFl.n_kup_basis_korrektur iUl2KupplAFl.n_kup_oeffnet iUl2KupplAFl.n_kup_oeffnet_stromlos iUl2KupplAFl.n_stoeredslogik iUl2KupplAFl.n_stoeredslogik_init iUl2KupplAFl.n_stoeredslogik_schwelle iUl2KupplAInt.cUl2KupBasisInt._.eds_nr iUl2KupplAInt.cUl2KupBasisInt._.f_geschlossen iUl2KupplAInt.cUl2KupBasisInt._.kup_nr iUl2KupplAInt.delta_i_edslogik iUl2KupplAInt.f_erste_bef_erk iUl2KupplAInt.f_init iUl2KupplAInt.i_sw_kup_oeffnet iUl2KupplAInt.i_sw_kup_schliesst iUl2KupplAInt.n_kup_basis_korrektur iUl2KupplAInt.n_kup_oeffnet iUl2KupplAInt.n_kup_oeffnet_stromlos iUl2KupplAInt.n_stoeredslogik iUl2KupplAInt.n_stoeredslogik_init iUl2KupplAInt.n_stoeredslogik_schwelle iUl2KupplBFl.cUl2KupBasisFl._.eds_nr iUl2KupplBFl.cUl2KupBasisFl._.f_geschlossen iUl2KupplBFl.cUl2KupBasisFl._.kup_nr iUl2KupplBFl.delta_i_edslogik iUl2KupplBFl.f_erste_bef_erk iUl2KupplBFl.f_init iUl2KupplBFl.i_sw_kup_oeffnet iUl2KupplBFl.i_sw_kup_schliesst iUl2KupplBFl.n_kup_basis_korrektur iUl2KupplBFl.n_kup_oeffnet iUl2KupplBFl.n_kup_oeffnet_stromlos iUl2KupplBFl.n_stoeredslogik iUl2KupplBFl.n_stoeredslogik_init iUl2KupplBFl.n_stoeredslogik_schwelle iUl2KupplBInt.cUl2KupBasisInt._.eds_nr iUl2KupplBInt.cUl2KupBasisInt._.f_geschlossen iUl2KupplBInt.cUl2KupBasisInt._.kup_nr iUl2KupplBInt.delta_i_edslogik iUl2KupplBInt.f_erste_bef_erk iUl2KupplBInt.f_init iUl2KupplBInt.i_sw_kup_oeffnet iUl2KupplBInt.i_sw_kup_schliesst iUl2KupplBInt.n_kup_basis_korrektur iUl2KupplBInt.n_kup_oeffnet iUl2KupplBInt.n_kup_oeffnet_stromlos iUl2KupplBInt.n_stoeredslogik iUl2KupplBInt.n_stoeredslogik_init iUl2KupplBInt.n_stoeredslogik_schwelle iUl2KupplBSfktFl.n_kup_zu_edslogik_anfahrkup iUl2KupplBSfktFl.n_verz_edslogik iUl2KupplBSfktInt.n_kup_zu_edslogik_anfahrkup iUl2KupplBSfktInt.n_verz_edslogik iUl2KupplCFl.cUl2KupBasisFl._.eds_nr iUl2KupplCFl.cUl2KupBasisFl._.f_geschlossen iUl2KupplCFl.cUl2KupBasisFl._.kup_nr iUl2KupplCFl.delta_i_edslogik iUl2KupplCFl.f_erste_bef_erk iUl2KupplCFl.f_init iUl2KupplCFl.i_sw_kup_oeffnet iUl2KupplCFl.i_sw_kup_schliesst iUl2KupplCFl.n_kup_basis_korrektur iUl2KupplCFl.n_kup_oeffnet iUl2KupplCFl.n_kup_oeffnet_stromlos iUl2KupplCFl.n_stoeredslogik iUl2KupplCFl.n_stoeredslogik_init iUl2KupplCFl.n_stoeredslogik_schwelle iUl2KupplCInt.cUl2KupBasisInt._.eds_nr iUl2KupplCInt.cUl2KupBasisInt._.f_geschlossen iUl2KupplCInt.cUl2KupBasisInt._.kup_nr iUl2KupplCInt.delta_i_edslogik iUl2KupplCInt.f_erste_bef_erk iUl2KupplCInt.f_init iUl2KupplCInt.i_sw_kup_oeffnet iUl2KupplCInt.i_sw_kup_schliesst iUl2KupplCInt.n_kup_basis_korrektur iUl2KupplCInt.n_kup_oeffnet iUl2KupplCInt.n_kup_oeffnet_stromlos iUl2KupplCInt.n_stoeredslogik iUl2KupplCInt.n_stoeredslogik_init iUl2KupplCInt.n_stoeredslogik_schwelle iUl2KupplDFl.cUl2KupBasisFl._.eds_nr iUl2KupplDFl.cUl2KupBasisFl._.f_geschlossen iUl2KupplDFl.cUl2KupBasisFl._.kup_nr iUl2KupplDFl.delta_i_edslogik iUl2KupplDFl.f_erste_bef_erk iUl2KupplDFl.f_init iUl2KupplDFl.i_sw_kup_oeffnet iUl2KupplDFl.i_sw_kup_schliesst iUl2KupplDFl.n_kup_basis_korrektur iUl2KupplDFl.n_kup_oeffnet iUl2KupplDFl.n_kup_oeffnet_stromlos iUl2KupplDFl.n_stoeredslogik iUl2KupplDFl.n_stoeredslogik_init iUl2KupplDFl.n_stoeredslogik_schwelle iUl2KupplDInt.cUl2KupBasisInt._.eds_nr iUl2KupplDInt.cUl2KupBasisInt._.f_geschlossen iUl2KupplDInt.cUl2KupBasisInt._.kup_nr iUl2KupplDInt.delta_i_edslogik iUl2KupplDInt.f_erste_bef_erk iUl2KupplDInt.f_init iUl2KupplDInt.i_sw_kup_oeffnet iUl2KupplDInt.i_sw_kup_schliesst iUl2KupplDInt.n_kup_basis_korrektur iUl2KupplDInt.n_kup_oeffnet iUl2KupplDInt.n_kup_oeffnet_stromlos iUl2KupplDInt.n_stoeredslogik iUl2KupplDInt.n_stoeredslogik_init iUl2KupplDInt.n_stoeredslogik_schwelle iUl2KupplEFl.cUl2KupBasisFl._.eds_nr iUl2KupplEFl.cUl2KupBasisFl._.f_geschlossen iUl2KupplEFl.cUl2KupBasisFl._.kup_nr iUl2KupplEFl.delta_i_edslogik iUl2KupplEFl.f_erste_bef_erk iUl2KupplEFl.f_init iUl2KupplEFl.i_sw_kup_oeffnet iUl2KupplEFl.i_sw_kup_schliesst iUl2KupplEFl.n_kup_basis_korrektur iUl2KupplEFl.n_kup_oeffnet iUl2KupplEFl.n_kup_oeffnet_stromlos iUl2KupplEFl.n_stoeredslogik iUl2KupplEFl.n_stoeredslogik_init iUl2KupplEFl.n_stoeredslogik_schwelle iUl2KupplEInt.cUl2KupBasisInt._.eds_nr iUl2KupplEInt.cUl2KupBasisInt._.f_geschlossen iUl2KupplEInt.cUl2KupBasisInt._.kup_nr iUl2KupplEInt.delta_i_edslogik iUl2KupplEInt.f_erste_bef_erk iUl2KupplEInt.f_init iUl2KupplEInt.i_sw_kup_oeffnet iUl2KupplEInt.i_sw_kup_schliesst iUl2KupplEInt.n_kup_basis_korrektur iUl2KupplEInt.n_kup_oeffnet iUl2KupplEInt.n_kup_oeffnet_stromlos iUl2KupplEInt.n_stoeredslogik iUl2KupplEInt.n_stoeredslogik_init iUl2KupplEInt.n_stoeredslogik_schwelle /end IN_MEASUREMENT
/end FUNCTION
/begin FUNCTION UL2_UEW_GETR_M_AUF "Überwachung Getriebe- und Pumpenaufnahmemoment"
 /begin IN_MEASUREMENT iUl2GetrMAufFl.cBasFehlerErfolgFl._.flag_fehler iUl2GetrMAufFl.cBasFehlerErfolgFl._.zaehler_erfolge iUl2GetrMAufFl.cBasFehlerErfolgFl._.zaehler_fehler iUl2GetrMAufFl.mmot_auf_zul iUl2GetrMAufInt.cBasFehlerErfolgInt._.flag_fehler iUl2GetrMAufInt.cBasFehlerErfolgInt._.zaehler_erfolge iUl2GetrMAufInt.cBasFehlerErfolgInt._.zaehler_fehler iUl2GetrMAufInt.mmot_auf_zul iUl2GetrMAufInt.n_maxstoermgetrauf /end IN_MEASUREMENT
/end FUNCTION
/begin FUNCTION UL2_UEW_KFLPL "PosNPlausi Überwachung"
 /begin IN_MEASUREMENT iUl2KupplPosNPlAFl.cUl2KupplPosNPlFl._.n_stoerposneds iUl2KupplPosNPlAInt.cUl2KupplPosNPlInt._.n_stoerposneds iUl2KupplPosNPlBFl.cUl2KupplPosNPlFl._.n_stoerposneds iUl2KupplPosNPlBInt.cUl2KupplPosNPlInt._.n_stoerposneds iUl2KupplPosNPlCFl.cUl2KupplPosNPlFl._.n_stoerposneds iUl2KupplPosNPlCInt.cUl2KupplPosNPlInt._.n_stoerposneds iUl2KupplPosNPlDFl.cUl2KupplPosNPlFl._.n_stoerposneds iUl2KupplPosNPlDInt.cUl2KupplPosNPlInt._.n_stoerposneds iUl2KupplPosNPlEFl.cUl2KupplPosNPlFl._.n_stoerposneds iUl2KupplPosNPlEInt.cUl2KupplPosNPlInt._.n_stoerposneds iUl2PosNPlFl.ctr_posn_ok iUl2PosNPlFl.f_fehler_vorhanden iUl2PosNPlFl.f_phase_b_aktiv iUl2PosNPlFl.n_stoerposneds_phase_a iUl2PosNPlFl.n_stoerposneds_phase_b iUl2PosNPlInt.ctr_posn_ok iUl2PosNPlInt.f_fehler_vorhanden iUl2PosNPlInt.f_phase_b_aktiv iUl2PosNPlInt.n_stoerposneds_phase_a iUl2PosNPlInt.n_stoerposneds_phase_b /end IN_MEASUREMENT
/end FUNCTION
/begin FUNCTION UL2_UEW_MOTOREINGRIFF "Motoreingriffsüberwachung"
 /begin IN_MEASUREMENT iUl2MeKoordFl.err_neg_me iUl2MeKoordFl.err_pos_me iUl2MeKoordInt.err_grad_pos_me iUl2MeKoordInt.err_int_neg_me iUl2MeKoordInt.err_int_pos_me iUl2MeKoordInt.err_neg_me iUl2MeKoordInt.err_pos_me iUl2MeKoordInt.err_sig_neg_me iUl2MeKoordInt.err_sig_pos_me iUl2MeKoordInt.n_maxstoernegmeaus iUl2MeKoordInt.n_maxstoernegmeint1 iUl2MeKoordInt.n_maxstoerposmeaus iUl2MeKoordInt.n_maxstoerposmeint1 iUl2MeKoordInt.n_maxstoerposmeint2 iUl2MeKoordInt.n_stoerposmegradient iUl2MeKoordInt.ng_meueb iUl2NegMeIntenFl.cBasFehlerErfolgFl._.flag_fehler iUl2NegMeIntenFl.cBasFehlerErfolgFl._.zaehler_erfolge iUl2NegMeIntenFl.cBasFehlerErfolgFl._.zaehler_fehler iUl2NegMeIntenInt.cBasFehlerErfolgInt._.flag_fehler iUl2NegMeIntenInt.cBasFehlerErfolgInt._.zaehler_erfolge iUl2NegMeIntenInt.cBasFehlerErfolgInt._.zaehler_fehler iUl2NegMeSigFl.cBasFehlerErfolgFl._.flag_fehler iUl2NegMeSigFl.cBasFehlerErfolgFl._.zaehler_erfolge iUl2NegMeSigFl.cBasFehlerErfolgFl._.zaehler_fehler iUl2NegMeSigInt.cBasFehlerErfolgInt._.flag_fehler iUl2NegMeSigInt.cBasFehlerErfolgInt._.zaehler_erfolge iUl2NegMeSigInt.cBasFehlerErfolgInt._.zaehler_fehler iUl2PosMeGradientFl.cBasFehlerErfolgFl._.flag_fehler iUl2PosMeGradientFl.cBasFehlerErfolgFl._.zaehler_erfolge iUl2PosMeGradientFl.cBasFehlerErfolgFl._.zaehler_fehler iUl2PosMeGradientFl.me_mot_anford iUl2PosMeGradientFl.me_mot_rueckm iUl2PosMeGradientFl.ng_ab_fl.n_f iUl2PosMeGradientFl.ng_meueb iUl2PosMeGradientFl.ng_t_fl.n_f iUl2PosMeGradientInt.cBasFehlerErfolgInt._.flag_fehler iUl2PosMeGradientInt.cBasFehlerErfolgInt._.zaehler_erfolge iUl2PosMeGradientInt.cBasFehlerErfolgInt._.zaehler_fehler iUl2PosMeGradientInt.me_mot_anford iUl2PosMeGradientInt.me_mot_rueckm iUl2PosMeGradientInt.ng_ab_l2.n_f iUl2PosMeGradientInt.ng_meueb iUl2PosMeGradientInt.ng_t_l2.n_f iUl2PosMeIntenVar1Fl.cBasFehlerErfolgFl._.flag_fehler iUl2PosMeIntenVar1Fl.cBasFehlerErfolgFl._.zaehler_erfolge iUl2PosMeIntenVar1Fl.cBasFehlerErfolgFl._.zaehler_fehler iUl2PosMeIntenVar1Fl.schwellen_variante iUl2PosMeIntenVar1Int.cBasFehlerErfolgInt._.flag_fehler iUl2PosMeIntenVar1Int.cBasFehlerErfolgInt._.zaehler_erfolge iUl2PosMeIntenVar1Int.cBasFehlerErfolgInt._.zaehler_fehler iUl2PosMeIntenVar1Int.schwellen_variante iUl2PosMeIntenVar2Fl.cBasFehlerErfolgFl._.flag_fehler iUl2PosMeIntenVar2Fl.cBasFehlerErfolgFl._.zaehler_erfolge iUl2PosMeIntenVar2Fl.cBasFehlerErfolgFl._.zaehler_fehler iUl2PosMeIntenVar2Fl.schwellen_variante iUl2PosMeIntenVar2Int.cBasFehlerErfolgInt._.flag_fehler iUl2PosMeIntenVar2Int.cBasFehlerErfolgInt._.zaehler_erfolge iUl2PosMeIntenVar2Int.cBasFehlerErfolgInt._.zaehler_fehler iUl2PosMeIntenVar2Int.schwellen_variante iUl2PosMeSigFl.cBasFehlerErfolgFl._.flag_fehler iUl2PosMeSigFl.cBasFehlerErfolgFl._.zaehler_erfolge iUl2PosMeSigFl.cBasFehlerErfolgFl._.zaehler_fehler iUl2PosMeSigInt.cBasFehlerErfolgInt._.flag_fehler iUl2PosMeSigInt.cBasFehlerErfolgInt._.zaehler_erfolge iUl2PosMeSigInt.cBasFehlerErfolgInt._.zaehler_fehler /end IN_MEASUREMENT
/end FUNCTION
/begin FUNCTION UL2_UEW_NMOT "Alle Module die zur NMot-Überwachungen gehören."
 /begin IN_MEASUREMENT iUl2Nmotu.dsc_fehler_alt iUl2Nmotu.dsc_fehler_alt_komp iUl2Nmotu.n_mot_max_ul2 iUl2Nmotu.n_mot_max_ul2_alt iUl2Nmotu.n_mot_max_ul2_alt_komp iUl2Nmotu.n_mot_max_ul2_komp iUl2Nmotu.n_mot_min_l2 iUl2Nmotu.n_mot_min_l2_komp iUl2Nmotu.n_mot_obergrenze iUl2Nmotu.n_mot_obergrenze_komp iUl2Nmotu.n_stoer_nmotueb iUl2Nmotu.n_stoer_nmotueb_komp iUl2Nmotu.n_stoer_nmotueb_rueckfilter iUl2Nmotu.n_stoer_nmotueb_rueckfilter_komp iUl2Nmotu.n_stoer_red_nmotabreg iUl2Nmotu.n_stoer_red_nmotabreg_komp iUl2Nmotu.n_stoer_red_ntmaxzg iUl2Nmotu.n_stoer_red_ntmaxzg_komp iUl2Nmotu.n_t_max_zg_l2 iUl2Nmotu.n_t_max_zg_l2_alt iUl2Nmotu.n_t_max_zg_l2_alt_komp iUl2Nmotu.n_t_max_zg_l2_komp iUl2Nmotu.n_t_min_zg_l2 iUl2Nmotu.n_t_min_zg_l2_komp iUl2Nmotu.n_t_zg_obergrenze iUl2Nmotu.n_t_zg_obergrenze_alt iUl2Nmotu.n_t_zg_obergrenze_alt_komp iUl2Nmotu.n_t_zg_obergrenze_komp iUl2Nmotu.ntmaxzg_verz_aktiv iUl2Nmotu.ntmaxzg_verz_aktiv_komp iUl2Nmotu.pruefbed_nmotueb_l2 iUl2Nmotu.pruefbed_nmotueb_l2_komp iUl2Nmotu.z_nmotabreg_l2 iUl2Nmotu.z_nmotabreg_l2_komp iUl2Nmotu.z_nt_max_zg_l2 iUl2Nmotu.z_nt_max_zg_l2_komp iUl2Nmotu.zielgang_sas_alt_l2 iUl2Nmotu.zielgang_sas_alt_l2_komp /end IN_MEASUREMENT
/end FUNCTION
/begin FUNCTION zf_ATSYS "Größen der ATSYS"
 /begin SUB_FUNCTION zf_ATSYS_Messgroessen zf_ATSYS_Applikationsgroessen zf_ATSYS_Applikationsgroessen.Asil zf_ATSYS_Anforderungen /end SUB_FUNCTION
/end FUNCTION
/begin FUNCTION zf_ATSYS_Anforderungen "Anforderungen ATSYS"
 /begin SUB_FUNCTION AT_ARS.doc AT_ATSYS.doc AT_Algad.doc AT_BEFM.doc AT_BYP.doc AT_CSC.doc AT_Daten.doc AT_EDS.doc AT_EDSLOGIK.doc AT_ERSTZ.doc AT_ESig.doc AT_Esch.doc AT_GEFD.doc AT_GEGA.doc AT_GEGA_EP.doc AT_GESTZ.doc AT_GLS.doc AT_GLSA.DOC AT_GLU.doc AT_HISPlausi.doc AT_HOTM.doc AT_HS.doc AT_HSGLU.doc AT_HSad.doc AT_HYB_IEP.doc AT_HYB_K0.doc AT_HYSKOMP.doc AT_IAE.doc AT_IAE_ADA.doc AT_IAE_DIAG.doc AT_IAE_TPADA.doc AT_KFL_UEB.doc AT_KLAUENUEB.doc AT_KPLBP.doc AT_KUPBEL.doc AT_LCCADA.doc AT_LHMVUEB.doc AT_MABDYN.doc AT_MAUF.doc AT_MAUFUEB.doc AT_MAXVERZ.doc AT_MESAS.doc AT_MEueb.doc AT_Mv.doc AT_MvG.doc AT_NABGRADUEB.doc AT_NMOTUEB.doc AT_OS_Modeumschaltung.doc AT_PAK.doc AT_PARUMSCH.doc AT_PFA.doc AT_PKF.doc AT_PMUEB.doc AT_POSUEB.doc AT_POSVUEB.doc AT_PRSENSUEB.doc AT_RS.doc AT_RSad.doc AT_SAC.doc AT_SBAK.doc AT_SCHA.doc AT_SCHST.doc AT_SEGELN.doc AT_SFKT.doc AT_SLTSF.doc AT_SLTSP.doc AT_SSCHR.doc AT_STADA.doc AT_STRVUeb.doc AT_Sltal.doc AT_Sltg.doc AT_TEST.doc AT_TSENS.doc AT_TSFA.doc AT_TUNINGueb.doc AT_UWIG.doc AT_VERS.doc AT_ZZS.doc /end SUB_FUNCTION
/end FUNCTION
/begin FUNCTION zf_ATSYS_Applikationsgroessen "Alle Applikationsgrößen der ATSYS"
 /begin SUB_FUNCTION dAdaIaeap_Fktn dAdaIaeuf_Fktn dAdaGlast_Fktn dAdaGlastHSP_Fktn dAdaGlastRSP_Fktn dAdaGloku_Fktn dAdaGlokuK_Fktn dAdaGlosc_Fktn dAdaPfusf_Fktn dAdaPfusfEHS_Fktn dAdaPfusfERS_Fktn dAdaPulbwX_Fktn dAdaPulpf_Fktn dAdaPulpfK_Fktn dAdaPulsf_Fktn dAdaPulsfK_Fktn dAdaPulzs_Fktn dAdaPulzsK_Fktn dAdaPstbwX_Fktn dAdaPstpf_Fktn dAdaPstpfK_Fktn dAdaPstsf_Fktn dAdaPstsfK_Fktn dAdaPstzs_Fktn dAdaPstzsK_Fktn dAdaUrlufterk_Fktn dAdaUrlufterkSchaltung_Fktn dAdaUrlufterkPuls_Fktn dBibAglex_Fktn dBihDrehz_Fktn dBihHydra_Fktn dBihMobef_Fktn dBihMobefG_Fktn dBihMomen_Fktn dBihMomenG_Fktn dBihSigna_Fktn dBihSignaG_Fktn dDiaRbmif_Fktn dIaeKordi_Fktn dIaeDraus_Fktn dIaeSigna_Fktn dIaeMomen_Fktn dIaeAnfahX_Fktn dIaeAnfahEcoX_Fktn dIaeParaEcoX_Fktn dIaeDiagn_Fktn dIaeTempm_Fktn dIaeKuehl_Fktn dIaeMotmx_Fktn dIaeAdauf_Fktn dIepBerLp_Fktn dIepKordi_Fktn dIepLeckagemodell_Fktn dIepSchuz_Fktn dIepStSig_Fktn dIepSigna_Fktn dKasEkopl_Fktn dK0sSigna_Fktn dK0sSollw_Fktn dK0sSollwSP_Fktn dK0sSollwX_Fktn dK0sSteur_Fktn dK0sSteurSP_Fktn dK0sSteurX_Fktn dModHydlg_Fktn dModKuppl_Fktn dModKupplK_Fktn dModHysKo_Fktn dModHysKoK_Fktn dMoeMekHSP_Fktn dMoeSasAl_Fktn dMoeSasGeG_Fktn dMoeSasHSP_Fktn dMoeSasHSS_Fktn dMoeSasERS_Fktn dMoeSasRSP_Fktn dMoeSasRSS_Fktn dMonMvGet_Fktn dMvsZentr_Fktn dNvrContr_Fktn dSasGloAl_Fktn dSasGloGeG_Fktn dSasGloHSS_Fktn dSasGloRSS_Fktn dSasGloRSP_Fktn dSasGlsAl_Fktn dSasGlsGeG_Fktn dSasGlsHSP_Fktn dSasGlsHSS_Fktn dSasGlsRSP_Fktn dSasGlsRSS_Fktn dSasKabAl_Fktn dSasKabGeG_Fktn dSasKabHSP_Fktn dSasKabEHS_Fktn dSasKabHSS_Fktn dSasKabERS_Fktn dSasKabRSP_Fktn dSasKabRSS_Fktn dSasKzuAl_Fktn dSasKzuGeG_Fktn dSasKzuHSP_Fktn dSasKzuEHS_Fktn dSasKzuHSS_Fktn dSasGloKuK_Fktn dSasKzuERS_Fktn dSasKzuRSP_Fktn dSasKzuRSS_Fktn dSasGeaAl_Fktn dSasKflwe_Fktn dSasKflweW_Fktn dSasPsyst_Fktn dSasPsyGeG_Fktn dSasPsyHSS_Fktn dSasPsyRSS_Fktn dSasStrat_Fktn dUewIgetr_Fktn dUewIgetrG_Fktn dUewIgetrK_Fktn dUewIgetrS_Fktn dUewSgetf_Fktn dUewParksperrenmagnet_Fktn dUl2Kflpl_Fktn dUl2EdsLg_Fktn dUl2Kuppl_Fktn dUl2KupplK_Fktn dUl2KflplK_Fktn dUl2Posme_Fktn dUl2GetrMAuf_Fktn dUl2Nmotu_Fktn dAzsGangb_Fktn dAzsManko_Fktn /end SUB_FUNCTION
/end FUNCTION
/begin FUNCTION zf_ATSYS_Applikationsgroessen.Asil "Asil-relevante Applikationsgroessen (Asil)"
 /begin DEF_CHARACTERISTIC CS_EDSLOGIK F_NMOTUEB IEDSC_MAX_POSVC I_EDSMAXPOSNUEB_A I_EDSMAXPOSNUEB_B I_EDSMAXPOSPUEB_POS I_EDSMINPOSNUEB_C I_EDSMINPOSNUEB_D I_EDSMINPOSNUEB_E I_EDSMINPOSPUEB_C I_EDSNULLPOSNUEB I_KUPB_MIN_EDSLOGIK I_KUPD_MAX_EDSLOGIK J_VM_K0 KF_IEDSMAXMMOTCGLOGIKUEB_A KF_IEDSMAXMMOTCGLOGIKUEB_B KF_IEDSMAXOFFMMOTCGLOGIKUEB_A KF_IEDSMAXOFFMMOTCGLOGIKUEB_B KF_IEDSMINMMOTCGLOGIKUEB_C KF_IEDSMINMMOTCGLOGIKUEB_D KF_IEDSMINMMOTCGLOGIKUEB_E KF_IEDSMINOFFMMOTCGLOGIKUEB_C KF_IEDSMINOFFMMOTCGLOGIKUEB_D KF_IEDSMINOFFMMOTCGLOGIKUEB_E KF_MAXSTOERCGDELTAI_EDSLOGIK_A KF_MAXSTOERCGDELTAI_EDSLOGIK_B KF_MAXSTOERCGDELTAI_EDSLOGIK_C KF_MAXSTOERCGDELTAI_EDSLOGIK_D KF_MAXSTOERCGDELTAI_EDSLOGIK_E KF_MMOTGETRAUF KF_NGPOSMEUEB KF_OFFSETMMOTGETRAUF KL_F_VGETRAUF KL_IEDSMAXOFFCG_BEF1_A KL_IEDSMAXOFFCG_BEF1_B KL_IEDSMINOFFCG_BEF1_C KL_IEDSMINOFFCG_BEF1_D KL_IEDSMINOFFCG_BEF1_E KL_I_MAXK0 KL_MAXSTOER_EDSLOGIK_K0 KL_MAX_STOEROFFCG_BEF1_A KL_MAX_STOEROFFCG_BEF1_B KL_MAX_STOEROFFCG_BEF1_C KL_MAX_STOEROFFCG_BEF1_D KL_MAX_STOEROFFCG_BEF1_E KL_MMOTUEBNEGME1 KL_MMOTUEBNEGME2 KL_MMOTUEBPOSME1 KL_MMOTUEBPOSME2 KL_M_REIB_K0 KL_N_DIFF_K0_MIN MAX_STOERPOSNEDS MAX_STOERPOSNEDS14 MAX_STOER_NMOTUEB M_MERED_MIN M_MOTMAXNEGINT M_MOTMININT N_DIFFMAXINT N_DIFF_EM_MAX N_FNGABMEUEB N_FNGTMEUEB N_K0_TASKS N_KUP_OFFEN N_KUP_OFFEN_STROMLOS N_MAXKABPOS_C N_MAXKABPOS_E N_MAXKFLWECHSEL N_MAXSTOERMGETRAUF N_MAXSTOERNEGMEAUS N_MAXSTOERNEGMEINT1 N_MAXSTOERPOSMEAUS N_MAXSTOERPOSMEGRADIENT N_MAXSTOERPOSMEINT1 N_MAXSTOERPOSMEINT2 N_MAXSTOERPOS_P N_MAXSTOERVPLAUSIPOS_P N_MOTABREGEL_OFFSET N_NMOTABREGEL_VORGABE N_OFFSET_ME N_STOER_MAX_FAHRTR_EDSLOGIK N_VERZ_EDSLOGIK N_VPOSPUEB SWI_FLAGOFFPOSME SWI_K0UEB TAB_NMOTUEBDSCOFF VS_FZG_RSICH_LEV2 /end DEF_CHARACTERISTIC
/end FUNCTION
/begin FUNCTION zf_ATSYS_Messgroessen "Alle Messgrößen der ATSYS"
 /begin SUB_FUNCTION BIBLIO SIG_KOORDINATOR AZS BIH HYD ADA NVR KAS IEP K0S SAS MON UEW UL2 Funktionskomponenten /end SUB_FUNCTION
/end FUNCTION
/begin FUNCTION zf_HNS_TIMER "desc_en"
 /begin IN_MEASUREMENT ZFFSAB2._.ErrorEntryOut.ErrorEntryOut_Fl.tmr_ForwardFilter_LIMPHOMECAN.time ZFFSAB2._.ErrorEntryOut.ErrorEntryOut_Fl.tmr_ForwardFilter_LIMPHOMECAN.time_ /end IN_MEASUREMENT
/end FUNCTION
/begin FUNCTION zf_SAB2_ConfEGSACCOut "desc_en"
 /begin IN_MEASUREMENT ZFFSAB2._.ConfEGSACCOut.iv_EGSACCStsReceipt ZFFSAB2._.ConfEGSACCOut.sv_EGSACCStsReceipt /end IN_MEASUREMENT
/end FUNCTION
/begin FUNCTION zf_SAB2_CoolingReqOut "desc_en"
 /begin IN_MEASUREMENT ZFFSAB2._.CoolingReqOut.iv_c_CoolMax ZFFSAB2._.CoolingReqOut.sv_CoolerRequest /end IN_MEASUREMENT
/end FUNCTION
/begin FUNCTION zf_SAB2_DashboardInfoOut "desc_en"
 /begin IN_MEASUREMENT ZFFSAB2._.DashboardInfoOut.f_CtlDispPosErr ZFFSAB2._.DashboardInfoOut.f_CtlDispPosErr_ ZFFSAB2._.DashboardInfoOut.iv_CtlDispPos ZFFSAB2._.DashboardInfoOut.iv_CtlDispPos_ ZFFSAB2._.DashboardInfoOut.sv_CtlDispPos ZFFSAB2._.DashboardInfoOut.sv_CtlDispPos_ /end IN_MEASUREMENT
/end FUNCTION
/begin FUNCTION zf_SAB2_EngIdleRaiseReqOut "desc_en"
 /begin IN_MEASUREMENT ZFFSAB2._.EngIdleRaiseReqOut.f_n_EngIdleRaiseRequestErr ZFFSAB2._.EngIdleRaiseReqOut.f_n_EngIdleRaiseRequestErr_ ZFFSAB2._.EngIdleRaiseReqOut.iv_n_EngIdleRaiseRequestHAS ZFFSAB2._.EngIdleRaiseReqOut.iv_n_EngIdleRaiseRequestHAS_ ZFFSAB2._.EngIdleRaiseReqOut.sv_n_EngIdleRaiseRequest ZFFSAB2._.EngIdleRaiseReqOut.sv_n_EngIdleRaiseRequest_ /end IN_MEASUREMENT
/end FUNCTION
/begin FUNCTION zf_SAB2_EngineInterventionMonitoringOut "desc_en"
 /begin IN_MEASUREMENT ZFFSAB2._.EngineInterventionMonitoringOut.arrayPointer_EngineInterventionType ZFFSAB2._.EngineInterventionMonitoringOut.f_EIMonActiv ZFFSAB2._.EngineInterventionMonitoringOut.f_EI_IntegralMonActiv ZFFSAB2._.EngineInterventionMonitoringOut.f_EI_PosRealizedHighPErrMem ZFFSAB2._.EngineInterventionMonitoringOut.f_EI_PosRealizedHighSErrMem ZFFSAB2._.EngineInterventionMonitoringOut.f_EI_PosRealizedLowPErrMem ZFFSAB2._.EngineInterventionMonitoringOut.f_EI_PosRealizedLowSErrMem ZFFSAB2._.EngineInterventionMonitoringOut.f_EI_RedRealizedHighPErrMem ZFFSAB2._.EngineInterventionMonitoringOut.f_EI_RedRealizedHighSErrMem ZFFSAB2._.EngineInterventionMonitoringOut.f_EI_RedRealizedLowPErrMem ZFFSAB2._.EngineInterventionMonitoringOut.f_EI_RedRealizedLowSErrMem ZFFSAB2._.EngineInterventionMonitoringOut.iv_m_Crank ZFFSAB2._.EngineInterventionMonitoringOut.iv_m_CrankSts ZFFSAB2._.EngineInterventionMonitoringOut.iv_m_Eng ZFFSAB2._.EngineInterventionMonitoringOut.iv_m_EngIntervention ZFFSAB2._.EngineInterventionMonitoringOut.iv_m_EngInterventionSts ZFFSAB2._.EngineInterventionMonitoringOut.iv_m_EngMaxCensored ZFFSAB2._.EngineInterventionMonitoringOut.iv_n_EngLev2Sts ZFFSAB2._.EngineInterventionMonitoringOut.iv_n_TuLev2Sts ZFFSAB2._.EngineInterventionMonitoringOut.mIntegral_EI_realizedRelative ZFFSAB2._.EngineInterventionMonitoringOut.mIntegral_EI_requestedRelative ZFFSAB2._.EngineInterventionMonitoringOut.m_EI_realizedRelative ZFFSAB2._.EngineInterventionMonitoringOut.m_EI_requestedRelative ZFFSAB2._.EngineInterventionMonitoringOut.stateCounter_EIMonComputationPosition ZFFSAB2._.EngineInterventionMonitoringOut.t_EIMonHoldFlagsTimer ZFFSAB2._.EngineInterventionMonitoringOut.t_IntegrationTime ZFFSAB2._.EngineInterventionMonitoringOut.x_m_EI_realizedPercental /end IN_MEASUREMENT
/end FUNCTION
/begin FUNCTION zf_SAB2_EngineInterventionOut "desc_en"
 /begin IN_MEASUREMENT ZFFSAB2._.EngineInterventionOut.EngInterventionCalcMethod ZFFSAB2._.EngineInterventionOut.f_m_EI_Lev2Err ZFFSAB2._.EngineInterventionOut.f_m_EI_Lev2Err_ ZFFSAB2._.EngineInterventionOut.f_m_EngInterventionNegErr ZFFSAB2._.EngineInterventionOut.f_m_EngInterventionNegErr_ ZFFSAB2._.EngineInterventionOut.f_m_EngInterventionPosErr ZFFSAB2._.EngineInterventionOut.f_m_EngInterventionPosErr_ ZFFSAB2._.EngineInterventionOut.f_m_NegEI_Lev2Err ZFFSAB2._.EngineInterventionOut.f_m_NegEI_Lev2Err_ ZFFSAB2._.EngineInterventionOut.iv_f_m_EngInterventionNegErr ZFFSAB2._.EngineInterventionOut.iv_f_m_EngInterventionNegErr_ ZFFSAB2._.EngineInterventionOut.iv_f_m_EngInterventionPosErr ZFFSAB2._.EngineInterventionOut.iv_f_m_EngInterventionPosErr_ ZFFSAB2._.EngineInterventionOut.iv_m_CrankSts ZFFSAB2._.EngineInterventionOut.iv_m_Eng ZFFSAB2._.EngineInterventionOut.iv_m_EngDesAdjustRange ZFFSAB2._.EngineInterventionOut.iv_m_EngIntervention ZFFSAB2._.EngineInterventionOut.iv_m_EngInterventionLimit ZFFSAB2._.EngineInterventionOut.iv_m_EngInterventionPred ZFFSAB2._.EngineInterventionOut.iv_m_EngInterventionPredSts ZFFSAB2._.EngineInterventionOut.iv_m_EngInterventionSts ZFFSAB2._.EngineInterventionOut.iv_m_EngInterventionSts_ ZFFSAB2._.EngineInterventionOut.iv_m_EngIntervention_ ZFFSAB2._.EngineInterventionOut.iv_m_EngMax ZFFSAB2._.EngineInterventionOut.iv_m_EngMaxHAS ZFFSAB2._.EngineInterventionOut.iv_m_EngMaxHAS_ ZFFSAB2._.EngineInterventionOut.iv_m_EngMax_ ZFFSAB2._.EngineInterventionOut.iv_m_EngRedSts ZFFSAB2._.EngineInterventionOut.iv_m_PumpCensored ZFFSAB2._.EngineInterventionOut.iv_n_EngLev2 ZFFSAB2._.EngineInterventionOut.iv_n_EngLev2Sts ZFFSAB2._.EngineInterventionOut.iv_n_EngLev2Sts_ ZFFSAB2._.EngineInterventionOut.iv_n_EngLev2_ ZFFSAB2._.EngineInterventionOut.iv_n_TuLev2Sts ZFFSAB2._.EngineInterventionOut.iv_n_TuLev2Sts_ ZFFSAB2._.EngineInterventionOut.m_EngDesAdjustRangeCrankshaft ZFFSAB2._.EngineInterventionOut.m_EngInterventionCrankshaft ZFFSAB2._.EngineInterventionOut.m_EngInterventionPredCrankshaft ZFFSAB2._.EngineInterventionOut.m_EngMax ZFFSAB2._.EngineInterventionOut.m_EngMaxCensored ZFFSAB2._.EngineInterventionOut.sv_f_NoNegEIActive ZFFSAB2._.EngineInterventionOut.sv_f_NoNegEIActive_ ZFFSAB2._.EngineInterventionOut.sv_f_NoPosEIActive ZFFSAB2._.EngineInterventionOut.sv_m_EngDesAdjustRange ZFFSAB2._.EngineInterventionOut.sv_m_EngRed ZFFSAB2._.EngineInterventionOut.sv_m_EngRedSts ZFFSAB2._.EngineInterventionOut.sv_m_EngRedSts_ ZFFSAB2._.EngineInterventionOut.sv_m_EngRed_ ZFFSAB2._.EngineInterventionOut.sv_m_Lim /end IN_MEASUREMENT
/end FUNCTION
/begin FUNCTION zf_SAB2_EngineInterventionOut_Fl "desc_en"
 /begin IN_MEASUREMENT ZFFSAB2._.EngineInterventionOut.EngineInterventionOut_Fl.f_m_EngInterventionNegErr ZFFSAB2._.EngineInterventionOut.EngineInterventionOut_Fl.f_m_EngInterventionNegErr_ ZFFSAB2._.EngineInterventionOut.EngineInterventionOut_Fl.iv_f_m_EngInterventionNegErr ZFFSAB2._.EngineInterventionOut.EngineInterventionOut_Fl.iv_f_m_EngInterventionNegErr_ /end IN_MEASUREMENT
/end FUNCTION
/begin FUNCTION zf_SAB2_ErrorEntryOut "desc_en"
 /begin IN_MEASUREMENT ZFFSAB2._.ErrorEntryOut.f_DiagnosticFunctErr ZFFSAB2._.ErrorEntryOut.f_DiagnosticFunctErr_ ZFFSAB2._.ErrorEntryOut.iv_EPumpErr ZFFSAB2._.ErrorEntryOut.iv_FET0_Active ZFFSAB2._.ErrorEntryOut.iv_FET0_Active_ ZFFSAB2._.ErrorEntryOut.iv_SubstFunct ZFFSAB2._.ErrorEntryOut.iv_SubstFunctHi ZFFSAB2._.ErrorEntryOut.sv_DiagnosticFunct ZFFSAB2._.ErrorEntryOut.sv_DiagnosticFunct_ /end IN_MEASUREMENT
/end FUNCTION
/begin FUNCTION zf_SAB2_ErrorEntryOut_Fl "desc_en"
 /begin IN_MEASUREMENT ZFFSAB2._.ErrorEntryOut.ErrorEntryOut_Fl.f_DiagnosticFunctErr ZFFSAB2._.ErrorEntryOut.ErrorEntryOut_Fl.f_DiagnosticFunctErr_ ZFFSAB2._.ErrorEntryOut.ErrorEntryOut_Fl.iv_FET0_Active ZFFSAB2._.ErrorEntryOut.ErrorEntryOut_Fl.iv_FET0_Active_ ZFFSAB2._.ErrorEntryOut.ErrorEntryOut_Fl.iv_v_Fzg ZFFSAB2._.ErrorEntryOut.ErrorEntryOut_Fl.iv_v_FzgSts ZFFSAB2._.ErrorEntryOut.ErrorEntryOut_Fl.iv_v_FzgSts_ ZFFSAB2._.ErrorEntryOut.ErrorEntryOut_Fl.iv_v_Fzg_ ZFFSAB2._.ErrorEntryOut.ErrorEntryOut_Fl.sv_DiagnosticFunct /end IN_MEASUREMENT
/end FUNCTION
/begin FUNCTION zf_SAB2_GearboxLossesOut "desc_en"
 /begin IN_MEASUREMENT ZFFSAB2._.GearboxLossesOut.iv_m_GearboxLosses ZFFSAB2._.GearboxLossesOut.sv_m_GearboxLosses /end IN_MEASUREMENT
/end FUNCTION
/begin FUNCTION zf_SAB2_GearboxReinforcementOut "desc_en"
 /begin IN_MEASUREMENT ZFFSAB2._.GearboxReinforcementOut.ActualGearOld ZFFSAB2._.GearboxReinforcementOut.GearboxReinforcementInter ZFFSAB2._.GearboxReinforcementOut.dt_IGChangeOld ZFFSAB2._.GearboxReinforcementOut.f_ShiftingAborted ZFFSAB2._.GearboxReinforcementOut.in_Gearbox ZFFSAB2._.GearboxReinforcementOut.in_GearboxOld ZFFSAB2._.GearboxReinforcementOut.iv_GearboxReinforcementErr ZFFSAB2._.GearboxReinforcementOut.iv_RearAxleRatio ZFFSAB2._.GearboxReinforcementOut.iv_dt_IGChange ZFFSAB2._.GearboxReinforcementOut.iv_in_ActualGear ZFFSAB2._.GearboxReinforcementOut.iv_in_TargetGear ZFFSAB2._.GearboxReinforcementOut.iv_n_Ab ZFFSAB2._.GearboxReinforcementOut.iv_rga_not_info ZFFSAB2._.GearboxReinforcementOut.iv_status_limphome ZFFSAB2._.GearboxReinforcementOut.sv_GearboxReinforcement ZFFSAB2._.GearboxReinforcementOut.sv_GearboxReinforcementCalcSts ZFFSAB2._.GearboxReinforcementOut.tmr_dt_IGChange /end IN_MEASUREMENT
/end FUNCTION
/begin FUNCTION zf_SAB2_GearboxTorqueOut "desc_en"
 /begin IN_MEASUREMENT ZFFSAB2._.GearboxTorqueOut.f_TimerStarted ZFFSAB2._.GearboxTorqueOut.iv_m_Gearbox ZFFSAB2._.GearboxTorqueOut.iv_m_Gearbox_ ZFFSAB2._.GearboxTorqueOut.iv_n_EngIdleSts ZFFSAB2._.GearboxTorqueOut.sv_m_Gearbox ZFFSAB2._.GearboxTorqueOut.sv_m_Gearbox_ /end IN_MEASUREMENT
/end FUNCTION
/begin FUNCTION zf_SAB2_HybridControlOut "desc_en"
 /begin IN_MEASUREMENT ZFFSAB2._.HybridControlOut.iv_BetriebszustandIst ZFFSAB2._.HybridControlOut.iv_BetriebszustandZiel ZFFSAB2._.HybridControlOut.iv_StatusAblauf_HAS ZFFSAB2._.HybridControlOut.sv_IstzustandKraftschluss ZFFSAB2._.HybridControlOut.sv_IstzustandVerbrenner ZFFSAB2._.HybridControlOut.sv_SollzustandKraftschluss ZFFSAB2._.HybridControlOut.sv_SollzustandVerbrenner ZFFSAB2._.HybridControlOut.sv_StatusAblauf_HAS /end IN_MEASUREMENT
/end FUNCTION
/begin FUNCTION zf_SAB2_HybridSignalsOut "desc_en"
 /begin IN_MEASUREMENT ZFFSAB2._.HybridSignalsOut.iv_StatusK0 ZFFSAB2._.HybridSignalsOut.iv_c_BelagK0 ZFFSAB2._.HybridSignalsOut.iv_m_MaxK0Akt ZFFSAB2._.HybridSignalsOut.iv_m_Max_EM_HAS ZFFSAB2._.HybridSignalsOut.iv_m_Min_EM_HAS ZFFSAB2._.HybridSignalsOut.iv_m_Mod_EMHST_HAS_Offset ZFFSAB2._.HybridSignalsOut.iv_m_MotMaxVM_K0 ZFFSAB2._.HybridSignalsOut.iv_m_ResEM_HAS ZFFSAB2._.HybridSignalsOut.iv_m_SchleppK0Akt ZFFSAB2._.HybridSignalsOut.iv_st_m_MotMaxVM_K0 ZFFSAB2._.HybridSignalsOut.m_MaxK0_OldValue ZFFSAB2._.HybridSignalsOut.sv_StatusK0 ZFFSAB2._.HybridSignalsOut.sv_c_BelagK0 ZFFSAB2._.HybridSignalsOut.sv_m_MaxK0 ZFFSAB2._.HybridSignalsOut.sv_m_Max_EM_HAS ZFFSAB2._.HybridSignalsOut.sv_m_Min_EM_HAS ZFFSAB2._.HybridSignalsOut.sv_m_Mod_EMHST_HAS_Offset ZFFSAB2._.HybridSignalsOut.sv_m_ResEM_HAS /end IN_MEASUREMENT
/end FUNCTION
/begin FUNCTION zf_SAB2_Interfi "desc_en"
 /begin IN_MEASUREMENT ZFFSAB2._.Interfi2.iv_ActualGear ZFFSAB2._.Interfi2.iv_KL15 ZFFSAB2._.Interfi2.iv_KL15_ ZFFSAB2._.Interfi2.iv_Pos ZFFSAB2._.Interfi2.iv_TargetGear ZFFSAB2._.Interfi2.iv_c_OilTrans ZFFSAB2._.Interfi2.iv_c_OilTransSts ZFFSAB2._.Interfi2.iv_f_ACANorFACAN ZFFSAB2._.Interfi2.iv_f_IgnOn ZFFSAB2._.Interfi2.iv_kraftschluss ZFFSAB2._.Interfi2.iv_m_EngSts ZFFSAB2._.Interfi2.iv_n_Eng ZFFSAB2._.Interfi2.iv_n_EngSts ZFFSAB2._.Interfi2.iv_n_Tu ZFFSAB2._.Interfi2.iv_n_TuSts /end IN_MEASUREMENT
/end FUNCTION
/begin FUNCTION zf_SAB2_MIL_RequestOut "desc_en"
 /begin IN_MEASUREMENT ZFFSAB2._.MIL_RequestOut.iv_CodingMilLamp ZFFSAB2._.MIL_RequestOut.iv_MilReq ZFFSAB2._.MIL_RequestOut.sv_MilReq /end IN_MEASUREMENT
/end FUNCTION
/begin FUNCTION zf_SAB2_MStartLimitationOut "desc_en" /begin IN_MEASUREMENT ZFFSAB2._.MStartLimitationOut.sv_f_m_StartLimitation /end IN_MEASUREMENT /end FUNCTION
/begin FUNCTION zf_SAB2_NICActiveOut "desc_en"
 /begin IN_MEASUREMENT ZFFSAB2._.NICActiveOut.iv_ADA_IAEActive ZFFSAB2._.NICActiveOut.iv_SBCActive ZFFSAB2._.NICActiveOut.iv_SSCActive ZFFSAB2._.NICActiveOut.sv_GearboxSts /end IN_MEASUREMENT
/end FUNCTION
/begin FUNCTION zf_SAB2_PumpIntakeTorqueOut "desc_en"
 /begin IN_MEASUREMENT ZFFSAB2._.PumpIntakeTorqueOut.iv_m_Pump ZFFSAB2._.PumpIntakeTorqueOut.sv_m_PumpCensored /end IN_MEASUREMENT
/end FUNCTION
/begin FUNCTION zf_SAB2_ShiftingActiveOut "desc_en"
 /begin IN_MEASUREMENT ZFFSAB2._.ShiftingActiveOut.iv_f_ChangeOfGear ZFFSAB2._.ShiftingActiveOut.sv_f_ShiftingActive /end IN_MEASUREMENT
/end FUNCTION
/begin FUNCTION zf_SAB2_SynEngineSpeedOut "desc_en"
 /begin IN_MEASUREMENT ZFFSAB2._.SynEngineSpeedOut.f_n_mot_synSollVMSts ZFFSAB2._.SynEngineSpeedOut.f_n_mot_synSollVMSts_ ZFFSAB2._.SynEngineSpeedOut.iv_f_n_mot_synEMSts ZFFSAB2._.SynEngineSpeedOut.iv_f_n_mot_synEMSts_ ZFFSAB2._.SynEngineSpeedOut.iv_f_n_mot_synVMSts ZFFSAB2._.SynEngineSpeedOut.iv_f_n_mot_synVMSts_ ZFFSAB2._.SynEngineSpeedOut.iv_n_mot_synEM ZFFSAB2._.SynEngineSpeedOut.iv_n_mot_synEM_ ZFFSAB2._.SynEngineSpeedOut.iv_n_mot_synVM ZFFSAB2._.SynEngineSpeedOut.iv_n_mot_synVM_ ZFFSAB2._.SynEngineSpeedOut.iv_n_motsynEMErr ZFFSAB2._.SynEngineSpeedOut.iv_n_motsynEMErr_ ZFFSAB2._.SynEngineSpeedOut.iv_n_motsynVMErr ZFFSAB2._.SynEngineSpeedOut.iv_n_motsynVMErr_ ZFFSAB2._.SynEngineSpeedOut.sv_f_n_mot_synSollEMSts ZFFSAB2._.SynEngineSpeedOut.sv_f_n_mot_synSollEMSts_ ZFFSAB2._.SynEngineSpeedOut.sv_n_mot_synSollEM ZFFSAB2._.SynEngineSpeedOut.sv_n_mot_synSollEMVMSts ZFFSAB2._.SynEngineSpeedOut.sv_n_mot_synSollEMVMSts_ ZFFSAB2._.SynEngineSpeedOut.sv_n_mot_synSollEM_ ZFFSAB2._.SynEngineSpeedOut.sv_n_mot_synSollVM ZFFSAB2._.SynEngineSpeedOut.sv_n_mot_synSollVM_ /end IN_MEASUREMENT
/end FUNCTION
/begin FUNCTION zf_SAB2_Timer "desc_en"
 /begin IN_MEASUREMENT ZFFSAB2._.EngineInterventionMonitoringOut.t_EIMonActivDelay.time ZFFSAB2._.EngineInterventionMonitoringOut.t_EIMonDelay.time ZFFSAB2._.GearboxTorqueOut.t_freeze_mgt_Aufn_CAN.time /end IN_MEASUREMENT
/end FUNCTION
/begin FUNCTION zf_SAB2_TorqueConverterOut "desc_en"
 /begin IN_MEASUREMENT ZFFSAB2._.TorqueConverterOut.TorqueConverterOutDAT.TableColumnHyb ZFFSAB2._.TorqueConverterOut.TorqueConverterOutDAT.TableRowHyb ZFFSAB2._.TorqueConverterOut.iv_PreadaptionState ZFFSAB2._.TorqueConverterOut.iv_st_IAE ZFFSAB2._.TorqueConverterOut.sv_wk_Ist ZFFSAB2._.TorqueConverterOut.sv_wk_IstHybrid /end IN_MEASUREMENT
/end FUNCTION
/begin FUNCTION zf_SAB_ABSIn "desc_en"
 /begin IN_MEASUREMENT ZFFSAB._.ABSIn.f_ABSOff ZFFSAB._.ABSIn.f_ABSOff_ ZFFSAB._.ABSIn.f_ABSRegErr ZFFSAB._.ABSIn.iv_ABSReg ZFFSAB._.ABSIn.iv_ABSRegSts ZFFSAB._.ABSIn.iv_ABSRegSts_ ZFFSAB._.ABSIn.iv_ABSReg_ ZFFSAB._.ABSIn.sv_ABSReg ZFFSAB._.ABSIn.sv_ABSRegSts ZFFSAB._.ABSIn.sv_ABSRegSts_ ZFFSAB._.ABSIn.sv_ABSReg_ /end IN_MEASUREMENT
/end FUNCTION
/begin FUNCTION zf_SAB_AccelerationAcrossIn "desc_en"
 /begin IN_MEASUREMENT ZFFSAB._.AccelerationAcrossIn.f_AyRefErr ZFFSAB._.AccelerationAcrossIn.iv_AyRef ZFFSAB._.AccelerationAcrossIn.iv_AyRefErr ZFFSAB._.AccelerationAcrossIn.iv_AyRefSts ZFFSAB._.AccelerationAcrossIn.sv_AyRef ZFFSAB._.AccelerationAcrossIn.sv_AyRefSts /end IN_MEASUREMENT
/end FUNCTION
/begin FUNCTION zf_SAB_AccelerationLongIn "desc_en"
 /begin IN_MEASUREMENT ZFFSAB._.AccelerationLongIn.f_AxRefErr ZFFSAB._.AccelerationLongIn.iv_AxRef ZFFSAB._.AccelerationLongIn.iv_AxRefErr ZFFSAB._.AccelerationLongIn.iv_AxRefSts ZFFSAB._.AccelerationLongIn.sv_AxRef ZFFSAB._.AccelerationLongIn.sv_AxRefSts /end IN_MEASUREMENT
/end FUNCTION
/begin FUNCTION zf_SAB_ActuatorSignalsIn "desc_en"
 /begin IN_MEASUREMENT ZFFSAB._.ActuatorSignalsIn.f_EpumpConsiderAliveSignal ZFFSAB._.ActuatorSignalsIn.f_SetDitherFunction ZFFSAB._.ActuatorSignalsIn.iv_DcEPump ZFFSAB._.ActuatorSignalsIn.iv_GetIepCtrlByTester ZFFSAB._.ActuatorSignalsIn.iv_GetIepSollHas ZFFSAB._.ActuatorSignalsIn.iv_GetIepSollSubst ZFFSAB._.ActuatorSignalsIn.iv_GetOut10ESts ZFFSAB._.ActuatorSignalsIn.iv_IEP_ist ZFFSAB._.ActuatorSignalsIn.iv_fet0_active ZFFSAB._.ActuatorSignalsIn.st_EpumpDiagErr ZFFSAB._.ActuatorSignalsIn.sv_EPumpErr /end IN_MEASUREMENT
/end FUNCTION
/begin FUNCTION zf_SAB_AfuReqIn "desc_en"
 /begin IN_MEASUREMENT ZFFSAB._.AfuReqIn.f_AfuReqErr ZFFSAB._.AfuReqIn.iv_AfuReq ZFFSAB._.AfuReqIn.iv_AfuReqSts ZFFSAB._.AfuReqIn.sv_AfuReq ZFFSAB._.AfuReqIn.sv_AfuReqSts /end IN_MEASUREMENT
/end FUNCTION
/begin FUNCTION zf_SAB_AmbConditionsIn "desc_en"
 /begin IN_MEASUREMENT ZFFSAB._.AmbConditionsIn.FaultCodeToAmbientCondition ZFFSAB._.AmbConditionsIn.iv_ABSRegSts ZFFSAB._.AmbConditionsIn.iv_ASCPas ZFFSAB._.AmbConditionsIn.iv_ASCReg ZFFSAB._.AmbConditionsIn.iv_AblaufvarianteHas ZFFSAB._.AmbConditionsIn.iv_ActiveActionByte1 ZFFSAB._.AmbConditionsIn.iv_ActiveActionByte2 ZFFSAB._.AmbConditionsIn.iv_ActiveActionByte3 ZFFSAB._.AmbConditionsIn.iv_ActiveActionByte4 ZFFSAB._.AmbConditionsIn.iv_ActiveActionByte5 ZFFSAB._.AmbConditionsIn.iv_ActiveActionByte6 ZFFSAB._.AmbConditionsIn.iv_ActiveActionByte7 ZFFSAB._.AmbConditionsIn.iv_ActiveActionByte8 ZFFSAB._.AmbConditionsIn.iv_ActualGear ZFFSAB._.AmbConditionsIn.iv_BrakeSts ZFFSAB._.AmbConditionsIn.iv_CtrlSignalSourceSts ZFFSAB._.AmbConditionsIn.iv_DoorDSts ZFFSAB._.AmbConditionsIn.iv_DrivingDirection ZFFSAB._.AmbConditionsIn.iv_FASPosSts ZFFSAB._.AmbConditionsIn.iv_IepIst ZFFSAB._.AmbConditionsIn.iv_KL15 ZFFSAB._.AmbConditionsIn.iv_KL15Sts ZFFSAB._.AmbConditionsIn.iv_KL15_UWB81 ZFFSAB._.AmbConditionsIn.iv_KeyValidSts ZFFSAB._.AmbConditionsIn.iv_Kraftschluss ZFFSAB._.AmbConditionsIn.iv_KupStatusIae ZFFSAB._.AmbConditionsIn.iv_LDMModeSts ZFFSAB._.AmbConditionsIn.iv_Mileage ZFFSAB._.AmbConditionsIn.iv_PSensSts ZFFSAB._.AmbConditionsIn.iv_STAT_Drv ZFFSAB._.AmbConditionsIn.iv_SeatBeltSts ZFFSAB._.AmbConditionsIn.iv_SeatFLSts ZFFSAB._.AmbConditionsIn.iv_StatusK0 ZFFSAB._.AmbConditionsIn.iv_TargetGear ZFFSAB._.AmbConditionsIn.iv_ThrottlePosition ZFFSAB._.AmbConditionsIn.iv_ThrottlePositionSts ZFFSAB._.AmbConditionsIn.iv_Tu_sts_Direction ZFFSAB._.AmbConditionsIn.iv_c_Chip1Trans ZFFSAB._.AmbConditionsIn.iv_c_Chip2Trans ZFFSAB._.AmbConditionsIn.iv_c_ChipTempESts ZFFSAB._.AmbConditionsIn.iv_c_OilTrans ZFFSAB._.AmbConditionsIn.iv_c_OilTransSts ZFFSAB._.AmbConditionsIn.iv_f_L1 ZFFSAB._.AmbConditionsIn.iv_f_L2 ZFFSAB._.AmbConditionsIn.iv_f_L3 ZFFSAB._.AmbConditionsIn.iv_f_L4 ZFFSAB._.AmbConditionsIn.iv_f_P12TwoErr ZFFSAB._.AmbConditionsIn.iv_i_Out0 ZFFSAB._.AmbConditionsIn.iv_i_Out1 ZFFSAB._.AmbConditionsIn.iv_i_Out10 ZFFSAB._.AmbConditionsIn.iv_i_Out11 ZFFSAB._.AmbConditionsIn.iv_i_Out12 ZFFSAB._.AmbConditionsIn.iv_i_Out13 ZFFSAB._.AmbConditionsIn.iv_i_Out14 ZFFSAB._.AmbConditionsIn.iv_i_Out2 ZFFSAB._.AmbConditionsIn.iv_i_Out3 ZFFSAB._.AmbConditionsIn.iv_i_Out4 ZFFSAB._.AmbConditionsIn.iv_i_Out5 ZFFSAB._.AmbConditionsIn.iv_i_Out6 ZFFSAB._.AmbConditionsIn.iv_i_Out7 ZFFSAB._.AmbConditionsIn.iv_i_Out8 ZFFSAB._.AmbConditionsIn.iv_i_Out9 ZFFSAB._.AmbConditionsIn.iv_m_Crank ZFFSAB._.AmbConditionsIn.iv_m_Eng ZFFSAB._.AmbConditionsIn.iv_m_EngIntervention ZFFSAB._.AmbConditionsIn.iv_m_EngMax ZFFSAB._.AmbConditionsIn.iv_m_EngSts ZFFSAB._.AmbConditionsIn.iv_m_IstEm ZFFSAB._.AmbConditionsIn.iv_m_IstK0 ZFFSAB._.AmbConditionsIn.iv_m_MotMaxHas ZFFSAB._.AmbConditionsIn.iv_n_Ab ZFFSAB._.AmbConditionsIn.iv_n_AbSts ZFFSAB._.AmbConditionsIn.iv_n_Eng ZFFSAB._.AmbConditionsIn.iv_n_EngSts ZFFSAB._.AmbConditionsIn.iv_n_EngVM ZFFSAB._.AmbConditionsIn.iv_n_SollEmHas ZFFSAB._.AmbConditionsIn.iv_n_Tu ZFFSAB._.AmbConditionsIn.iv_n_TuSts ZFFSAB._.AmbConditionsIn.iv_n_WheelAvg_UWB12 ZFFSAB._.AmbConditionsIn.iv_n_WheelAvg_UWB74 ZFFSAB._.AmbConditionsIn.iv_n_Wheel_FL ZFFSAB._.AmbConditionsIn.iv_n_Wheel_FR ZFFSAB._.AmbConditionsIn.iv_n_Wheel_RL ZFFSAB._.AmbConditionsIn.iv_n_Wheel_RR ZFFSAB._.AmbConditionsIn.iv_p_BrakeSts ZFFSAB._.AmbConditionsIn.iv_st_HasActualState ZFFSAB._.AmbConditionsIn.iv_st_HasNominalState ZFFSAB._.AmbConditionsIn.iv_st_IgnPlausiErr ZFFSAB._.AmbConditionsIn.iv_st_IstGang ZFFSAB._.AmbConditionsIn.iv_st_WKZugSchub ZFFSAB._.AmbConditionsIn.iv_t_SystemTime ZFFSAB._.AmbConditionsIn.iv_t_TimeSinceReset ZFFSAB._.AmbConditionsIn.iv_u_BattFilt ZFFSAB._.AmbConditionsIn.iv_u_Kl15_Pin ZFFSAB._.AmbConditionsIn.iv_u_Sensor1 ZFFSAB._.AmbConditionsIn.iv_udrmv1_act ZFFSAB._.AmbConditionsIn.sv_ABSRegSts ZFFSAB._.AmbConditionsIn.sv_ASCPas ZFFSAB._.AmbConditionsIn.sv_ASCReg ZFFSAB._.AmbConditionsIn.sv_AblaufvarianteHas ZFFSAB._.AmbConditionsIn.sv_ActiveActionByte1 ZFFSAB._.AmbConditionsIn.sv_ActiveActionByte2 ZFFSAB._.AmbConditionsIn.sv_ActiveActionByte3 ZFFSAB._.AmbConditionsIn.sv_ActiveActionByte4 ZFFSAB._.AmbConditionsIn.sv_ActiveActionByte5 ZFFSAB._.AmbConditionsIn.sv_ActiveActionByte6 ZFFSAB._.AmbConditionsIn.sv_ActiveActionByte7 ZFFSAB._.AmbConditionsIn.sv_ActiveActionByte8 ZFFSAB._.AmbConditionsIn.sv_IepIst ZFFSAB._.AmbConditionsIn.sv_KL15 ZFFSAB._.AmbConditionsIn.sv_KupStatusIae ZFFSAB._.AmbConditionsIn.sv_PowerTransRotation ZFFSAB._.AmbConditionsIn.sv_StatusK0 ZFFSAB._.AmbConditionsIn.sv_ThrottlePosition ZFFSAB._.AmbConditionsIn.sv_c_Chip1Trans ZFFSAB._.AmbConditionsIn.sv_c_Chip2Trans ZFFSAB._.AmbConditionsIn.sv_c_OilTrans ZFFSAB._.AmbConditionsIn.sv_m_Crank ZFFSAB._.AmbConditionsIn.sv_m_Eng ZFFSAB._.AmbConditionsIn.sv_m_EngIntervention ZFFSAB._.AmbConditionsIn.sv_m_EngMax ZFFSAB._.AmbConditionsIn.sv_m_IstEm ZFFSAB._.AmbConditionsIn.sv_m_IstK0 ZFFSAB._.AmbConditionsIn.sv_m_MotMaxHas ZFFSAB._.AmbConditionsIn.sv_n_Ab ZFFSAB._.AmbConditionsIn.sv_n_Eng ZFFSAB._.AmbConditionsIn.sv_n_EngVM ZFFSAB._.AmbConditionsIn.sv_n_SollEmHas ZFFSAB._.AmbConditionsIn.sv_n_Tu ZFFSAB._.AmbConditionsIn.sv_n_WheelAvg_UWB12 ZFFSAB._.AmbConditionsIn.sv_n_WheelAvg_UWB74 ZFFSAB._.AmbConditionsIn.sv_n_Wheel_FL ZFFSAB._.AmbConditionsIn.sv_n_Wheel_FR ZFFSAB._.AmbConditionsIn.sv_n_Wheel_RL ZFFSAB._.AmbConditionsIn.sv_n_Wheel_RR ZFFSAB._.AmbConditionsIn.sv_st_AscDscCanSig ZFFSAB._.AmbConditionsIn.sv_st_DiscreteEntries ZFFSAB._.AmbConditionsIn.sv_st_FemCasCanSig ZFFSAB._.AmbConditionsIn.sv_st_GearShiftingInfo ZFFSAB._.AmbConditionsIn.sv_st_GearboxSig ZFFSAB._.AmbConditionsIn.sv_st_HasActualNominalState ZFFSAB._.AmbConditionsIn.sv_st_IgnitionSignal ZFFSAB._.AmbConditionsIn.sv_st_MVs ZFFSAB._.AmbConditionsIn.sv_st_MotorCanSig ZFFSAB._.AmbConditionsIn.sv_st_ZielGang ZFFSAB._.AmbConditionsIn.sv_sts_PMA ZFFSAB._.AmbConditionsIn.sv_t_SystemTime ZFFSAB._.AmbConditionsIn.sv_t_TimeSinceReset ZFFSAB._.AmbConditionsIn.sv_u_BattFilt ZFFSAB._.AmbConditionsIn.sv_u_Kl15_Pin ZFFSAB._.AmbConditionsIn.sv_u_Sensor1 ZFFSAB._.AmbConditionsIn.sv_udrmv1_act /end IN_MEASUREMENT
/end FUNCTION
/begin FUNCTION zf_SAB_ASCIn "desc_en"
 /begin IN_MEASUREMENT ZFFSAB._.ASCIn.f_ASCErr ZFFSAB._.ASCIn.f_ASCRegErr ZFFSAB._.ASCIn.f_ASCSbeErr ZFFSAB._.ASCIn.iv_ASCReg ZFFSAB._.ASCIn.iv_ASCRegSts ZFFSAB._.ASCIn.iv_ASCSbe ZFFSAB._.ASCIn.iv_ASCSts ZFFSAB._.ASCIn.sv_ASCRegSts ZFFSAB._.ASCIn.sv_ASCSbeSts ZFFSAB._.ASCIn.sv_f_ASCErr2 ZFFSAB._.ASCIn.sv_f_ASCReg ZFFSAB._.ASCIn.sv_f_ASCSbe /end IN_MEASUREMENT
/end FUNCTION
/begin FUNCTION zf_SAB_ASCPasIn "desc_en"
 /begin IN_MEASUREMENT ZFFSAB._.ASCPasIn.f_ASCPasErr ZFFSAB._.ASCPasIn.iv_ASCPas ZFFSAB._.ASCPasIn.iv_ASCPasSts ZFFSAB._.ASCPasIn.iv_ASCPasSts_ ZFFSAB._.ASCPasIn.iv_ASCPas_ ZFFSAB._.ASCPasIn.sv_ASCPas ZFFSAB._.ASCPasIn.sv_ASCPasSts ZFFSAB._.ASCPasIn.sv_f_DSCErr ZFFSAB._.ASCPasIn.sv_f_DSCErr_ /end IN_MEASUREMENT
/end FUNCTION
/begin FUNCTION zf_SAB_AzgDriver "desc_en" /begin IN_MEASUREMENT ZFFSAB._.AzgDriver.addr_fsp /end IN_MEASUREMENT /end FUNCTION
/begin FUNCTION zf_SAB_BackToNormalFunctionViaReset "desc_en"
 /begin IN_MEASUREMENT ZFFSAB._.BackToNormalFunctionViaReset.f_LimphomeD ZFFSAB._.BackToNormalFunctionViaReset.f_LimphomeD_ ZFFSAB._.BackToNormalFunctionViaReset.f_Reset_DetectedTimer ZFFSAB._.BackToNormalFunctionViaReset.f_Reset_DetectedTimer_ ZFFSAB._.BackToNormalFunctionViaReset.iv_EEPROMBusy ZFFSAB._.BackToNormalFunctionViaReset.iv_f_EEPROMStoreInProgress ZFFSAB._.BackToNormalFunctionViaResetBPRAM.Reset_cnt ZFFSAB._.BackToNormalFunctionViaResetBPRAM.Reset_cnt_ ZFFSAB._.BackToNormalFunctionViaResetBPRAM.f_Relevant_KFC_Active ZFFSAB._.BackToNormalFunctionViaResetBPRAM.f_Relevant_KFC_Active_ ZFFSAB._.BackToNormalFunctionViaResetBPRAM.f_Reset_Detected ZFFSAB._.BackToNormalFunctionViaResetBPRAM.f_Reset_Detected_ /end IN_MEASUREMENT
/end FUNCTION
/begin FUNCTION zf_SAB_BaroPressureIn "desc_en"
 /begin IN_MEASUREMENT ZFFSAB._.BaroPressureIn.f_p_AirErr ZFFSAB._.BaroPressureIn.iv_p_Air ZFFSAB._.BaroPressureIn.iv_p_AirSts ZFFSAB._.BaroPressureIn.sv_p_Air ZFFSAB._.BaroPressureIn.sv_p_AirSts /end IN_MEASUREMENT
/end FUNCTION
/begin FUNCTION zf_SAB_BootJump "desc_en" /begin IN_MEASUREMENT ZFFSAB._.BootJump.reset_allowance /end IN_MEASUREMENT /end FUNCTION
/begin FUNCTION zf_SAB_BrakePedalIn "desc_en"
 /begin IN_MEASUREMENT ZFFSAB._.BrakePedalIn.f_BrakeErr ZFFSAB._.BrakePedalIn.iv_Brake ZFFSAB._.BrakePedalIn.iv_BrakeSts ZFFSAB._.BrakePedalIn.iv_BrakeSts_ ZFFSAB._.BrakePedalIn.iv_Brake_ ZFFSAB._.BrakePedalIn.sv_BrakeLev2Sts ZFFSAB._.BrakePedalIn.sv_BrakeSts ZFFSAB._.BrakePedalIn.sv_BrakeSts_ ZFFSAB._.BrakePedalIn.sv_f_Brake ZFFSAB._.BrakePedalIn.sv_f_BrakeLev2 ZFFSAB._.BrakePedalIn.sv_f_Brake_ ZFFSAB._.BrakePedalIn.sv_f_Brake_AGS /end IN_MEASUREMENT
/end FUNCTION
/begin FUNCTION zf_SAB_BrakeTorqueIn "desc_en"
 /begin IN_MEASUREMENT ZFFSAB._.BrakeTorqueIn.f_m_BrakeErr ZFFSAB._.BrakeTorqueIn.f_p_BrakeErr ZFFSAB._.BrakeTorqueIn.iv_m_Brake ZFFSAB._.BrakeTorqueIn.iv_m_BrakeQF ZFFSAB._.BrakeTorqueIn.iv_m_BrakeQF_ ZFFSAB._.BrakeTorqueIn.iv_m_BrakeSts ZFFSAB._.BrakeTorqueIn.iv_m_BrakeSts_ ZFFSAB._.BrakeTorqueIn.iv_m_Brake_ ZFFSAB._.BrakeTorqueIn.sv_m_Brake ZFFSAB._.BrakeTorqueIn.sv_m_BrakeSts ZFFSAB._.BrakeTorqueIn.sv_p_Brake ZFFSAB._.BrakeTorqueIn.sv_p_BrakeSts ZFFSAB._.BrakeTorqueIn.sv_p_BrakeSts_ ZFFSAB._.BrakeTorqueIn.sv_p_Brake_ /end IN_MEASUREMENT
/end FUNCTION
/begin FUNCTION zf_SAB_CAN_Handling "desc_en"
 /begin IN_MEASUREMENT ZFFSAB._.CAN_Handling.CANMsg[0].Status ZFFSAB._.CAN_Handling.CANMsg[10].Status ZFFSAB._.CAN_Handling.CANMsg[11].Status ZFFSAB._.CAN_Handling.CANMsg[12].Status ZFFSAB._.CAN_Handling.CANMsg[13].Status ZFFSAB._.CAN_Handling.CANMsg[14].Status ZFFSAB._.CAN_Handling.CANMsg[15].Status ZFFSAB._.CAN_Handling.CANMsg[16].Status ZFFSAB._.CAN_Handling.CANMsg[17].Status ZFFSAB._.CAN_Handling.CANMsg[18].Status ZFFSAB._.CAN_Handling.CANMsg[19].Status ZFFSAB._.CAN_Handling.CANMsg[1].Status ZFFSAB._.CAN_Handling.CANMsg[20].Status ZFFSAB._.CAN_Handling.CANMsg[21].Status ZFFSAB._.CAN_Handling.CANMsg[22].Status ZFFSAB._.CAN_Handling.CANMsg[23].Status ZFFSAB._.CAN_Handling.CANMsg[24].Status ZFFSAB._.CAN_Handling.CANMsg[25].Status ZFFSAB._.CAN_Handling.CANMsg[26].Status ZFFSAB._.CAN_Handling.CANMsg[27].Status ZFFSAB._.CAN_Handling.CANMsg[28].Status ZFFSAB._.CAN_Handling.CANMsg[29].Status ZFFSAB._.CAN_Handling.CANMsg[2].Status ZFFSAB._.CAN_Handling.CANMsg[30].Status ZFFSAB._.CAN_Handling.CANMsg[31].Status ZFFSAB._.CAN_Handling.CANMsg[32].Status ZFFSAB._.CAN_Handling.CANMsg[33].Status ZFFSAB._.CAN_Handling.CANMsg[34].Status ZFFSAB._.CAN_Handling.CANMsg[35].Status ZFFSAB._.CAN_Handling.CANMsg[36].Status ZFFSAB._.CAN_Handling.CANMsg[37].Status ZFFSAB._.CAN_Handling.CANMsg[38].Status ZFFSAB._.CAN_Handling.CANMsg[39].Status ZFFSAB._.CAN_Handling.CANMsg[3].Status ZFFSAB._.CAN_Handling.CANMsg[40].Status ZFFSAB._.CAN_Handling.CANMsg[41].Status ZFFSAB._.CAN_Handling.CANMsg[42].Status ZFFSAB._.CAN_Handling.CANMsg[43].Status ZFFSAB._.CAN_Handling.CANMsg[44].Status ZFFSAB._.CAN_Handling.CANMsg[45].Status ZFFSAB._.CAN_Handling.CANMsg[4].Status ZFFSAB._.CAN_Handling.CANMsg[5].Status ZFFSAB._.CAN_Handling.CANMsg[6].Status ZFFSAB._.CAN_Handling.CANMsg[7].Status ZFFSAB._.CAN_Handling.CANMsg[8].Status ZFFSAB._.CAN_Handling.CANMsg[9].Status ZFFSAB._.CAN_Handling.f_ACanMsgDiag ZFFSAB._.CAN_Handling.f_AfterRunning ZFFSAB._.CAN_Handling.f_AllTo ZFFSAB._.CAN_Handling.f_AllTo1 ZFFSAB._.CAN_Handling.f_AllTo2 ZFFSAB._.CAN_Handling.f_Can1BusDiag ZFFSAB._.CAN_Handling.f_Can2BusDiag ZFFSAB._.CAN_Handling.f_CanMsgDiag ZFFSAB._.CAN_Handling.f_FaultStatKFC_CANB1 ZFFSAB._.CAN_Handling.f_FaultStatKFC_CANB2 ZFFSAB._.CAN_Handling.iv_Busruhe ZFFSAB._.CAN_Handling.iv_JumpstartAktiv ZFFSAB._.CAN_Handling.iv_f_FaultStatKFC_UBATTO ZFFSAB._.CAN_Handling.iv_f_clear_learnedmsg ZFFSAB._.CAN_Handling.iv_st_Can1BusErr ZFFSAB._.CAN_Handling.iv_st_Can2BusErr ZFFSAB._.CAN_Handling.iv_u_BattFilt ZFFSAB._.CAN_Handling.st_ACANMsgBitmask1 ZFFSAB._.CAN_Handling.st_ACANMsgBitmask2 ZFFSAB._.CAN_Handling.st_CANControlConfigBitmask1 ZFFSAB._.CAN_Handling.st_CANControlConfigBitmask2 ZFFSAB._.CAN_Handling.st_CanMsgErrorBitmask1 ZFFSAB._.CAN_Handling.st_CanMsgErrorBitmask2 ZFFSAB._.CAN_Handling.st_ConfigBitmaskCANMsg1 ZFFSAB._.CAN_Handling.st_ConfigBitmaskCANMsg2 ZFFSAB._.CAN_Handling.st_LearnedBitmaskCANMsg1 ZFFSAB._.CAN_Handling.st_LearnedBitmaskCANMsg2 ZFFSAB._.CAN_Handling.st_ToLearnBitmaskCANMsg1 ZFFSAB._.CAN_Handling.st_ToLearnBitmaskCANMsg2 ZFFSAB._.CAN_Handling.sts_Can1BusDisturbance ZFFSAB._.CAN_Handling.sts_Can2BusDisturbance /end IN_MEASUREMENT
/end FUNCTION
/begin FUNCTION zf_SAB_CAN_SwitchingIn "desc_en"
 /begin IN_MEASUREMENT ZFFSAB._.CAN_SwitchingIn.ACAN_FACAN ZFFSAB._.CAN_SwitchingIn.CANA_Sts ZFFSAB._.CAN_SwitchingIn.CANFA_Sts ZFFSAB._.CAN_SwitchingIn.LastCycleFaulty ZFFSAB._.CAN_SwitchingIn.sv_ACAN_FACAN_Static ZFFSAB._.CAN_SwitchingIn.sv_f_ACAN_Or_FACAN_Active /end IN_MEASUREMENT
/end FUNCTION
/begin FUNCTION zf_SAB_ChargeConditionIn "desc_en"
 /begin IN_MEASUREMENT ZFFSAB._.ChargeConditionIn.f_ChargeErr ZFFSAB._.ChargeConditionIn.iv_Charge ZFFSAB._.ChargeConditionIn.iv_ChargeSts ZFFSAB._.ChargeConditionIn.sv_Charge ZFFSAB._.ChargeConditionIn.sv_ChargeSts /end IN_MEASUREMENT
/end FUNCTION
/begin FUNCTION zf_SAB_Coding "desc_en"
 /begin IN_MEASUREMENT ZFFSAB._.Coding.iv_CodingAppl ZFFSAB._.Coding.iv_CodingElectrical ZFFSAB._.Coding.sv_AGS_Codierung ZFFSAB._.Coding.sv_AGS_CodierungOBD ZFFSAB._.Coding.sv_Coding3000 ZFFSAB._.Coding.sv_Coding3001 ZFFSAB._.Coding.sv_VarCode_MILCycles ZFFSAB._.Coding.sv_VarCode_MILLamp ZFFSAB._.Coding.sv_VarCode_NIC ZFFSAB._.Coding.sv_VarCode_Scantool_Enable /end IN_MEASUREMENT
/end FUNCTION
/begin FUNCTION zf_SAB_ComConditionsIn "desc_en"
 /begin IN_MEASUREMENT ZFFSAB._.ComConditionsIn.Preconditions ZFFSAB._.ComConditionsIn.iv_PreConEWS ZFFSAB._.ComConditionsIn.iv_PreConKL15CanSts /end IN_MEASUREMENT
/end FUNCTION
/begin FUNCTION zf_SAB_CrankShaftCurTorqueIn "desc_en"
 /begin IN_MEASUREMENT ZFFSAB._.CrankShaftCurTorqueIn.f_CrankErr ZFFSAB._.CrankShaftCurTorqueIn.f_m_IstEMErr ZFFSAB._.CrankShaftCurTorqueIn.f_m_IstEMErr_ ZFFSAB._.CrankShaftCurTorqueIn.f_m_IstEMLev2Err ZFFSAB._.CrankShaftCurTorqueIn.f_m_IstEMLev2Err_ ZFFSAB._.CrankShaftCurTorqueIn.f_m_IstVMErr ZFFSAB._.CrankShaftCurTorqueIn.f_m_IstVMLev2Err ZFFSAB._.CrankShaftCurTorqueIn.f_m_IstVMLev2Err_ ZFFSAB._.CrankShaftCurTorqueIn.iv_m_Crank ZFFSAB._.CrankShaftCurTorqueIn.iv_m_CrankSts ZFFSAB._.CrankShaftCurTorqueIn.iv_m_CrankSts_ ZFFSAB._.CrankShaftCurTorqueIn.iv_m_Crank_ ZFFSAB._.CrankShaftCurTorqueIn.iv_m_IstEM ZFFSAB._.CrankShaftCurTorqueIn.iv_m_IstEMSts ZFFSAB._.CrankShaftCurTorqueIn.iv_m_IstEMSts_ ZFFSAB._.CrankShaftCurTorqueIn.iv_m_IstEM_ ZFFSAB._.CrankShaftCurTorqueIn.iv_m_IstVM ZFFSAB._.CrankShaftCurTorqueIn.iv_m_IstVMSts ZFFSAB._.CrankShaftCurTorqueIn.iv_m_IstVMSts_ ZFFSAB._.CrankShaftCurTorqueIn.iv_m_IstVM_ ZFFSAB._.CrankShaftCurTorqueIn.iv_m_PumpCensored ZFFSAB._.CrankShaftCurTorqueIn.m_CrankCor ZFFSAB._.CrankShaftCurTorqueIn.m_CrankSts_ ZFFSAB._.CrankShaftCurTorqueIn.m_IstEM1 ZFFSAB._.CrankShaftCurTorqueIn.m_IstEM1Lev2 ZFFSAB._.CrankShaftCurTorqueIn.m_IstVMCor ZFFSAB._.CrankShaftCurTorqueIn.sv_AGS_MMotIst ZFFSAB._.CrankShaftCurTorqueIn.sv_AGS_MVm ZFFSAB._.CrankShaftCurTorqueIn.sv_m_Crank ZFFSAB._.CrankShaftCurTorqueIn.sv_m_CrankLev2 ZFFSAB._.CrankShaftCurTorqueIn.sv_m_CrankLev2_ ZFFSAB._.CrankShaftCurTorqueIn.sv_m_CrankSts ZFFSAB._.CrankShaftCurTorqueIn.sv_m_Ind ZFFSAB._.CrankShaftCurTorqueIn.sv_m_IstEM ZFFSAB._.CrankShaftCurTorqueIn.sv_m_IstEMLev2 ZFFSAB._.CrankShaftCurTorqueIn.sv_m_IstEMLev2Sts ZFFSAB._.CrankShaftCurTorqueIn.sv_m_IstEMLev2Sts_ ZFFSAB._.CrankShaftCurTorqueIn.sv_m_IstEMLev2_ ZFFSAB._.CrankShaftCurTorqueIn.sv_m_IstEMSts ZFFSAB._.CrankShaftCurTorqueIn.sv_m_IstVM ZFFSAB._.CrankShaftCurTorqueIn.sv_m_IstVMLev2 ZFFSAB._.CrankShaftCurTorqueIn.sv_m_IstVMLev2Sts ZFFSAB._.CrankShaftCurTorqueIn.sv_m_IstVMLev2Sts_ ZFFSAB._.CrankShaftCurTorqueIn.sv_m_IstVMLev2_ ZFFSAB._.CrankShaftCurTorqueIn.sv_m_IstVMSts /end IN_MEASUREMENT
/end FUNCTION
/begin FUNCTION zf_SAB_CurWheelTrqIn "desc_en"
 /begin IN_MEASUREMENT ZFFSAB._.CurWheelTrqIn.f_M_RadIstErr ZFFSAB._.CurWheelTrqIn.iv_M_RadIst ZFFSAB._.CurWheelTrqIn.iv_M_RadIstQF ZFFSAB._.CurWheelTrqIn.iv_M_RadIstSts ZFFSAB._.CurWheelTrqIn.sv_M_RadIst ZFFSAB._.CurWheelTrqIn.sv_M_RadIstSts /end IN_MEASUREMENT
/end FUNCTION
/begin FUNCTION zf_SAB_DesiredTorqueIn "desc_en"
 /begin IN_MEASUREMENT ZFFSAB._.DesiredTorqueIn.f_m_DSCErr ZFFSAB._.DesiredTorqueIn.f_m_EngDesEMErr ZFFSAB._.DesiredTorqueIn.f_m_EngDesErr ZFFSAB._.DesiredTorqueIn.f_m_EngDesErr_ ZFFSAB._.DesiredTorqueIn.f_m_EngDesLev2Err ZFFSAB._.DesiredTorqueIn.f_m_EngDesLev2Err_ ZFFSAB._.DesiredTorqueIn.f_m_EngDesVMErr ZFFSAB._.DesiredTorqueIn.f_m_MaxIncrVMErr ZFFSAB._.DesiredTorqueIn.iv_m_DriverDes ZFFSAB._.DesiredTorqueIn.iv_m_DriverDesEM ZFFSAB._.DesiredTorqueIn.iv_m_DriverDesEMSts ZFFSAB._.DesiredTorqueIn.iv_m_DriverDesSts ZFFSAB._.DesiredTorqueIn.iv_m_DriverDesSts_ ZFFSAB._.DesiredTorqueIn.iv_m_DriverDesVM ZFFSAB._.DesiredTorqueIn.iv_m_DriverDesVMSts ZFFSAB._.DesiredTorqueIn.iv_m_DriverDes_ ZFFSAB._.DesiredTorqueIn.iv_m_EngMax ZFFSAB._.DesiredTorqueIn.iv_m_MaxIncrVM ZFFSAB._.DesiredTorqueIn.iv_m_MaxIncrVMSts ZFFSAB._.DesiredTorqueIn.iv_m_PumpCensored ZFFSAB._.DesiredTorqueIn.m_DSCRangePositiveDesSts ZFFSAB._.DesiredTorqueIn.m_DSCStsDesSts ZFFSAB._.DesiredTorqueIn.m_DriverDes ZFFSAB._.DesiredTorqueIn.m_DriverDesCor ZFFSAB._.DesiredTorqueIn.m_DriverDesEM ZFFSAB._.DesiredTorqueIn.m_DriverDesEMSts ZFFSAB._.DesiredTorqueIn.m_DriverDesSts ZFFSAB._.DesiredTorqueIn.m_DriverDesVM ZFFSAB._.DesiredTorqueIn.m_DriverDesVMSts ZFFSAB._.DesiredTorqueIn.m_EngDesCor1 ZFFSAB._.DesiredTorqueIn.m_EngDesCor2 ZFFSAB._.DesiredTorqueIn.m_EngDesCor2Lev2 ZFFSAB._.DesiredTorqueIn.m_EngDesCor3 ZFFSAB._.DesiredTorqueIn.m_EngDesCor3Lev2 ZFFSAB._.DesiredTorqueIn.m_EngDesCor3Lev2_ ZFFSAB._.DesiredTorqueIn.m_EngDesEMCor1 ZFFSAB._.DesiredTorqueIn.m_EngDesEMCor2 ZFFSAB._.DesiredTorqueIn.m_EngDesVMCor1 ZFFSAB._.DesiredTorqueIn.m_EngDesVMCor2 ZFFSAB._.DesiredTorqueIn.sv_AGS_MKwFW ZFFSAB._.DesiredTorqueIn.sv_m_DriverDesMod ZFFSAB._.DesiredTorqueIn.sv_m_EngDes ZFFSAB._.DesiredTorqueIn.sv_m_EngDesEM ZFFSAB._.DesiredTorqueIn.sv_m_EngDesEMSts ZFFSAB._.DesiredTorqueIn.sv_m_EngDesLev2 ZFFSAB._.DesiredTorqueIn.sv_m_EngDesLev2Sts ZFFSAB._.DesiredTorqueIn.sv_m_EngDesLev2Sts_ ZFFSAB._.DesiredTorqueIn.sv_m_EngDesLev2_ ZFFSAB._.DesiredTorqueIn.sv_m_EngDesSts ZFFSAB._.DesiredTorqueIn.sv_m_EngDesVM ZFFSAB._.DesiredTorqueIn.sv_m_EngDesVMSts ZFFSAB._.DesiredTorqueIn.sv_m_MaxIncrVM ZFFSAB._.DesiredTorqueIn.sv_m_MaxIncrVMSts /end IN_MEASUREMENT
/end FUNCTION
/begin FUNCTION zf_SAB_DistanceIn "desc_en"
 /begin IN_MEASUREMENT ZFFSAB._.AmbConditionsIn.sv_Mileage ZFFSAB._.DistanceIn.iv_Mileage ZFFSAB._.DistanceIn.iv_MileageSts ZFFSAB._.DistanceIn.sv_Mileage ZFFSAB._.DistanceIn.sv_MileageFromNab ZFFSAB._.DistanceIn.sv_MileageSts ZFFSAB._.DistanceIn.sv_Mileage_1km ZFFSAB._.DistanceIn.sv_f_MileageErr /end IN_MEASUREMENT
/end FUNCTION
/begin FUNCTION zf_SAB_DoorStatusIn "desc_en"
 /begin IN_MEASUREMENT ZFFSAB._.DoorStatusIn.f_DoorDErr ZFFSAB._.DoorStatusIn.iv_DoorD ZFFSAB._.DoorStatusIn.iv_DoorD2 ZFFSAB._.DoorStatusIn.iv_DoorD2Sts ZFFSAB._.DoorStatusIn.iv_DoorDSts ZFFSAB._.DoorStatusIn.sv_DoorDSts ZFFSAB._.DoorStatusIn.sv_f_DoorD /end IN_MEASUREMENT
/end FUNCTION
/begin FUNCTION zf_SAB_DriverSeatStatusIn "desc_en"
 /begin IN_MEASUREMENT ZFFSAB._.DriverSeatStatusIn.f_SeatBeltErr ZFFSAB._.DriverSeatStatusIn.f_SeatFLErr ZFFSAB._.DriverSeatStatusIn.iv_SeatBelt ZFFSAB._.DriverSeatStatusIn.iv_SeatBeltSts ZFFSAB._.DriverSeatStatusIn.iv_SeatFL ZFFSAB._.DriverSeatStatusIn.iv_SeatFLSts ZFFSAB._.DriverSeatStatusIn.sv_SeatBeltSts ZFFSAB._.DriverSeatStatusIn.sv_SeatFLSts ZFFSAB._.DriverSeatStatusIn.sv_f_SeatBelt ZFFSAB._.DriverSeatStatusIn.sv_f_SeatFL /end IN_MEASUREMENT
/end FUNCTION
/begin FUNCTION zf_SAB_DrivingDirectionIn "desc_en"
 /begin IN_MEASUREMENT ZFFSAB._.DrivingDirectionIn.DriveDirWheel ZFFSAB._.DrivingDirectionIn.DriveDirWheelSts ZFFSAB._.DrivingDirectionIn.DrivingDirectionRaw ZFFSAB._.DrivingDirectionIn.DrivingDirectionRawSts ZFFSAB._.DrivingDirectionIn.sv_DriveDirectionAGS ZFFSAB._.DrivingDirectionIn.sv_DrivingDirection ZFFSAB._.DrivingDirectionIn.sv_DrivingDirectionSts /end IN_MEASUREMENT
/end FUNCTION
/begin FUNCTION zf_SAB_DrivingSpeedControlIn "desc_en"
 /begin IN_MEASUREMENT ZFFSAB._.DrivingSpeedControlIn.f_SpeedControlErr ZFFSAB._.DrivingSpeedControlIn.sv_SpeedControlSts /end IN_MEASUREMENT
/end FUNCTION
/begin FUNCTION zf_SAB_DrivingStateIn "desc_en"
 /begin IN_MEASUREMENT ZFFSAB._.DrivingStateIn.f_DriveConditionErr ZFFSAB._.DrivingStateIn.iv_DriveCondition ZFFSAB._.DrivingStateIn.iv_DriveConditionSts ZFFSAB._.DrivingStateIn.sv_AGS_DriveCondition ZFFSAB._.DrivingStateIn.sv_DriveCondition ZFFSAB._.DrivingStateIn.sv_DriveConditionSts /end IN_MEASUREMENT
/end FUNCTION
/begin FUNCTION zf_SAB_DynRunRadiusIn "desc_en" /begin IN_MEASUREMENT ZFFSAB._.DynRunRadiusIn.sv_rd_Dyn /end IN_MEASUREMENT /end FUNCTION
/begin FUNCTION zf_SAB_Eeprom "desc_en"
 /begin IN_MEASUREMENT ZFFSAB._.AmbConditionsIn.iv_st_EepromValid ZFFSAB._.AmbConditionsIn.sv_st_EepromValid ZFFSAB._.Interfi.iv_EepromBusy ZFFSAB._.SABEeprom.EepromData.IgnPlausiErr ZFFSAB._.SABEeprom.EepromData.IgnPlausiErr_ ZFFSAB._.SABEeprom.EepromData.Mileage1kmBuf ZFFSAB._.SABEeprom.EepromData.Mileage1kmBuf_ ZFFSAB._.SABEeprom.EepromData.MileageFromNabBuf ZFFSAB._.SABEeprom.EepromData.MileageFromNabBuf_ ZFFSAB._.SABEeprom.EepromData.RearAxleRatioBuf ZFFSAB._.SABEeprom.EepromData.RearAxleRatioBuf_ ZFFSAB._.SABEeprom.EepromData.RearAxleRatio_ValueNumact_ ZFFSAB._.SABEeprom.EepromData.RearAxleRatio_Value_ ZFFSAB._.SABEeprom.EepromData.cnt_ForcedShiftups ZFFSAB._.SABEeprom.EepromData.cnt_ForcedShiftups_ ZFFSAB._.SABEeprom.EepromData.cnt_RstFailSumBuf ZFFSAB._.SABEeprom.EepromData.cnt_RstFailSumBuf_ ZFFSAB._.SABEeprom.EepromData.cnt_RstSuccessSumBuf ZFFSAB._.SABEeprom.EepromData.cnt_RstSuccessSumBuf_ ZFFSAB._.SABEeprom.EepromData.cnt_info_memory_entries ZFFSAB._.SABEeprom.EepromData.f_AnalogPaddleLearned ZFFSAB._.SABEeprom.EepromData.f_AnalogPaddleLearned_ ZFFSAB._.SABEeprom.EepromData.f_CANPaddleLearned ZFFSAB._.SABEeprom.EepromData.f_CANPaddleLearned_ ZFFSAB._.SABEeprom.EepromData.f_PMAModeLearned ZFFSAB._.SABEeprom.EepromData.f_PMAModeLearned_ ZFFSAB._.SABEeprom.EepromData.f_c_CgtPlausiErr ZFFSAB._.SABEeprom.EepromData.f_c_CgtPlausiErr_ ZFFSAB._.SABEeprom.EepromData.f_c_Chip1CGT ZFFSAB._.SABEeprom.EepromData.f_c_Chip1CGT_ ZFFSAB._.SABEeprom.EepromData.f_c_Chip1Chip2 ZFFSAB._.SABEeprom.EepromData.f_c_Chip1Chip2_ ZFFSAB._.SABEeprom.EepromData.f_c_Chip1PlausiErr ZFFSAB._.SABEeprom.EepromData.f_c_Chip1PlausiErr_ ZFFSAB._.SABEeprom.EepromData.f_c_Chip2CGT ZFFSAB._.SABEeprom.EepromData.f_c_Chip2CGT_ ZFFSAB._.SABEeprom.EepromData.f_c_Chip2PlausiErr ZFFSAB._.SABEeprom.EepromData.f_c_Chip2PlausiErr_ ZFFSAB._.SABEeprom.EepromData.f_c_PlausiErr ZFFSAB._.SABEeprom.EepromData.f_c_PlausiErr_ ZFFSAB._.SABEeprom.EepromData.f_n_xErrFlags ZFFSAB._.SABEeprom.EepromData.f_n_xErrFlags_ ZFFSAB._.SABEeprom.EepromData.info_memory[0].errorID ZFFSAB._.SABEeprom.EepromData.info_memory[0].moduleID ZFFSAB._.SABEeprom.EepromData.info_memory[1].errorID ZFFSAB._.SABEeprom.EepromData.info_memory[1].moduleID ZFFSAB._.SABEeprom.EepromData.info_memory[2].errorID ZFFSAB._.SABEeprom.EepromData.info_memory[2].moduleID ZFFSAB._.SABEeprom.EepromData.info_memory[3].errorID ZFFSAB._.SABEeprom.EepromData.info_memory[3].moduleID ZFFSAB._.SABEeprom.EepromData.info_memory[4].errorID ZFFSAB._.SABEeprom.EepromData.info_memory[4].moduleID ZFFSAB._.SABEeprom.EepromData.info_memory[5].errorID ZFFSAB._.SABEeprom.EepromData.info_memory[5].moduleID ZFFSAB._.SABEeprom.EepromData.info_memory[6].errorID ZFFSAB._.SABEeprom.EepromData.info_memory[6].moduleID ZFFSAB._.SABEeprom.EepromData.info_memory[7].errorID ZFFSAB._.SABEeprom.EepromData.info_memory[7].moduleID ZFFSAB._.SABEeprom.EepromData.info_memory_checksum ZFFSAB._.SABEeprom.EepromData.st_ReceiveBitmaskCANMsg1 ZFFSAB._.SABEeprom.EepromData.st_ReceiveBitmaskCANMsg1_ ZFFSAB._.SABEeprom.EepromData.st_ReceiveBitmaskCANMsg2 ZFFSAB._.SABEeprom.EepromData.st_ReceiveBitmaskCANMsg2_ ZFFSAB._.SABEeprom.EepromData.sv_RearAxleRatio_Value ZFFSAB._.SABEeprom.EepromData.sv_RearAxleRatio_ValueLearnedFlag ZFFSAB._.SABEeprom.EepromData.sv_RearAxleRatio_ValueLearnedFlag_ ZFFSAB._.SABEeprom.EepromData.sv_RearAxleRatio_ValueNumact ZFFSAB._.SABEeprom.EepromData.t_SystimeCurBuf ZFFSAB._.SABEeprom.EepromData.t_SystimeCurBuf_ ZFFSAB._.SABEepromBPRAM.f_ForceEEPROM_Update ZFFSAB._.SABEepromBPRAM.f_ForceEEPROM_Update_ /end IN_MEASUREMENT
/end FUNCTION
/begin RECORD_LAYOUT FLOAT32_IEEE_COL_DIRECT_S6_S3 FNC_VALUES 1 FLOAT32_IEEE COLUMN_DIR DIRECT /end RECORD_LAYOUT
/begin RECORD_LAYOUT SWORD_COL_DIRECT_S6_S3 FNC_VALUES 1 SWORD COLUMN_DIR DIRECT /end RECORD_LAYOUT
/begin RECORD_LAYOUT UBYTE_COL_DIRECT_S6_S3 FNC_VALUES 1 UBYTE COLUMN_DIR DIRECT /end RECORD_LAYOUT
/begin RECORD_LAYOUT UBYTE_X_INCR_DIRECT_S6_S3 AXIS_PTS_X 1 UBYTE INDEX_INCR DIRECT /end RECORD_LAYOUT
/begin RECORD_LAYOUT ULONG_COL_DIRECT_S6_S3 FNC_VALUES 1 ULONG COLUMN_DIR DIRECT /end RECORD_LAYOUT
/begin RECORD_LAYOUT UWORD_COL_DIRECT_S6_S3 FNC_VALUES 1 UWORD COLUMN_DIR DIRECT /end RECORD_LAYOUT
/begin RECORD_LAYOUT ZF_kf_si16_S5_S3 FNC_VALUES 5 SWORD ROW_DIR DIRECT AXIS_PTS_X 3 SWORD INDEX_INCR DIRECT AXIS_PTS_Y 4 SWORD INDEX_INCR DIRECT NO_AXIS_PTS_X 1 ULONG NO_AXIS_PTS_Y 2 ULONG /end RECORD_LAYOUT
/begin RECORD_LAYOUT ZF_kf_ui16_S5_S3 FNC_VALUES 5 UWORD ROW_DIR DIRECT AXIS_PTS_X 3 UWORD INDEX_INCR DIRECT AXIS_PTS_Y 4 UWORD INDEX_INCR DIRECT NO_AXIS_PTS_X 1 ULONG NO_AXIS_PTS_Y 2 ULONG /end RECORD_LAYOUT
/begin RECORD_LAYOUT ZF_kl_si16_S5_S3 FNC_VALUES 3 SWORD COLUMN_DIR DIRECT AXIS_PTS_X 2 SWORD INDEX_INCR DIRECT NO_AXIS_PTS_X 1 ULONG /end RECORD_LAYOUT
/begin RECORD_LAYOUT ZF_kl_ui16_S5_S3 FNC_VALUES 3 UWORD COLUMN_DIR DIRECT AXIS_PTS_X 2 UWORD INDEX_INCR DIRECT NO_AXIS_PTS_X 1 ULONG /end RECORD_LAYOUT
/begin RECORD_LAYOUT ZF_kl_ui8_S5_S3 FNC_VALUES 3 UBYTE COLUMN_DIR DIRECT AXIS_PTS_X 2 UBYTE INDEX_INCR DIRECT NO_AXIS_PTS_X 1 ULONG /end RECORD_LAYOUT
/begin RECORD_LAYOUT ZF_kw_si16_S5_S3 FNC_VALUES 1 SWORD COLUMN_DIR DIRECT /end RECORD_LAYOUT
/begin RECORD_LAYOUT ZF_kw_ui16_S5_S3 FNC_VALUES 1 UWORD COLUMN_DIR DIRECT /end RECORD_LAYOUT
/begin RECORD_LAYOUT ZF_kw_ui8_S5_S3 FNC_VALUES 1 UBYTE COLUMN_DIR DIRECT /end RECORD_LAYOUT
/begin RECORD_LAYOUT ZF_tab_ui16_S5_S3 FNC_VALUES 2 UWORD COLUMN_DIR DIRECT NO_AXIS_PTS_X 1 ULONG /end RECORD_LAYOUT
/end MODULE
/end PROJECT
