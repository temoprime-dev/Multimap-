ASAP2_VERSION 1 51
/begin PROJECT ZHBC8600 "Gen2_BMW_System_Supplier_Lib"
/begin MODULE CPP ""
/begin MOD_COMMON "" BYTE_ORDER MSB_FIRST ALIGNMENT_BYTE 1 ALIGNMENT_WORD 2 ALIGNMENT_LONG 4 ALIGNMENT_FLOAT32_IEEE 4 ALIGNMENT_FLOAT64_IEEE 1 /end MOD_COMMON
/begin COMPU_METHOD SAB2_249PROZENT1000_M127_S3_S3 "int = ((phys * 1000) / 249) - (-127) %" RAT_FUNC "%4.3" "%" COEFFS 0 4.01606425703 127 0 0 1 /end COMPU_METHOD
/begin COMPU_METHOD SAB2_249PROZENT1000_M32_S3_S3 "int = ((phys * 1000) / 249) - (-127) -" RAT_FUNC "%4.3" "-" COEFFS 0 4.01606425703 127 0 0 1 /end COMPU_METHOD
/begin COMPU_METHOD SAB2_2K5_S3_S3 "int = ((phys * 5) / 2) - (0) -" RAT_FUNC "%4.3" "-" COEFFS 0 2.5 0 0 0 1 /end COMPU_METHOD
/begin COMPU_METHOD SAB2_39PROZENT100_S3_S3 "int = ((phys * 100) / 39) - (0) %" RAT_FUNC "%4.3" "%" COEFFS 0 2.5641025641 0 0 0 1 /end COMPU_METHOD
/begin COMPU_METHOD UMR___1_1000_0_S5_S3 "int = ((phys * 1000) / 1) - (0) [-]" RAT_FUNC "%4.3" "[-]" COEFFS 0 1000 0 0 0 1 /end COMPU_METHOD
/begin COMPU_METHOD UMR___1_100_0_S5_S3 "int = ((phys * 100) / 1) - (0) [-]" RAT_FUNC "%3.2" "[-]" COEFFS 0 100 0 0 0 1 /end COMPU_METHOD
/begin COMPU_METHOD UMR___1_1_0_S5_S3 "int = ((phys * 1) / 1) - (0) [-]" RAT_FUNC "%1.0" "[-]" COEFFS 0 1 0 0 0 1 /end COMPU_METHOD
/begin COMPU_METHOD UMR_BAR__1_1000_0_S5_S3 "int = ((phys * 1000) / 1) - (0) [bar]" RAT_FUNC "%4.3" "[bar]" COEFFS 0 1000 0 0 0 1 /end COMPU_METHOD
/begin COMPU_METHOD UMR_BAR_SEC_1_10_0_S5_S3 "int = ((phys * 10) / 1) - (0) [bar/s]" RAT_FUNC "%2.1" "[bar/s]" COEFFS 0 10 0 0 0 1 /end COMPU_METHOD
/begin COMPU_METHOD UMR_BAR_SEC_1_1_0_S5_S3 "int = ((phys * 1) / 1) - (0) [bar/s]" RAT_FUNC "%1.0" "[bar/s]" COEFFS 0 1 0 0 0 1 /end COMPU_METHOD
/begin COMPU_METHOD UMR_CM3__1_10_0_S5_S3 "int = ((phys * 10) / 1) - (0) [cm^3]" RAT_FUNC "%2.1" "[cm^3]" COEFFS 0 10 0 0 0 1 /end COMPU_METHOD
/begin COMPU_METHOD UMR_GRADC__1_1_0_S5_S3 "int = ((phys * 1) / 1) - (0) [°C]" RAT_FUNC "%1.0" "[°C]" COEFFS 0 1 0 0 0 1 /end COMPU_METHOD
/begin COMPU_METHOD UMR_GRADC__1_1_M40_S5_S3 "int = ((phys * 1) / 1) - (-40) [°C]" RAT_FUNC "%1.0" "[°C]" COEFFS 0 1 40 0 0 1 /end COMPU_METHOD
/begin COMPU_METHOD UMR_KGM2__1_1000_0_S5_S3 "int = ((phys * 1000) / 1) - (0) [kg*m^2]" RAT_FUNC "%4.3" "[kg*m^2]" COEFFS 0 1000 0 0 0 1 /end COMPU_METHOD
/begin COMPU_METHOD UMR_KM_H_1_1_0_S5_S3 "int = ((phys * 1) / 1) - (0) [km/h]" RAT_FUNC "%1.0" "[km/h]" COEFFS 0 1 0 0 0 1 /end COMPU_METHOD
/begin COMPU_METHOD UMR_LITER_MIN_1_10_0_S5_S3 "int = ((phys * 10) / 1) - (0) [Liter/min]" RAT_FUNC "%2.1" "[Liter/min]" COEFFS 0 10 0 0 0 1 /end COMPU_METHOD
/begin COMPU_METHOD UMR_MA__1_10_0_S5_S3 "int = ((phys * 10) / 1) - (0) [mA]" RAT_FUNC "%2.1" "[mA]" COEFFS 0 10 0 0 0 1 /end COMPU_METHOD
/begin COMPU_METHOD UMR_MIN__1_1_0_S5_S3 "int = ((phys * 1) / 1) - (0) [min]" RAT_FUNC "%1.0" "[min]" COEFFS 0 1 0 0 0 1 /end COMPU_METHOD
/begin COMPU_METHOD UMR_MSEC__10_1_0_S5_S3 "int = ((phys * 1) / 10) - (0) [ms]" RAT_FUNC "%1.0" "[ms]" COEFFS 0 0.1 0 0 0 1 /end COMPU_METHOD
/begin COMPU_METHOD UMR_MSEC__10_1_M128_S5_S3 "int = ((phys * 1) / 10) - (-128) [ms]" RAT_FUNC "%1.0" "[ms]" COEFFS 0 0.1 128 0 0 1 /end COMPU_METHOD
/begin COMPU_METHOD UMR_MSEC__1_1_0_S5_S3 "int = ((phys * 1) / 1) - (0) [ms]" RAT_FUNC "%1.0" "[ms]" COEFFS 0 1 0 0 0 1 /end COMPU_METHOD
/begin COMPU_METHOD UMR_NM__1_1_0_S5_S3 "int = ((phys * 1) / 1) - (0) [Nm]" RAT_FUNC "%1.0" "[Nm]" COEFFS 0 1 0 0 0 1 /end COMPU_METHOD
/begin COMPU_METHOD UMR_NM__6_1_M34_S5_S3 "int = ((phys * 1) / 6) - (-34) [Nm]" RAT_FUNC "%1.0" "[Nm]" COEFFS 0 0.166666666667 34 0 0 1 /end COMPU_METHOD
/begin COMPU_METHOD UMR_NM_SEC_1_1_0_S5_S3 "int = ((phys * 1) / 1) - (0) [Nm/s]" RAT_FUNC "%1.0" "[Nm/s]" COEFFS 0 1 0 0 0 1 /end COMPU_METHOD
/begin COMPU_METHOD UMR_PROZENT__20_51_0_S5_S3 "int = ((phys * 51) / 20) - (0) [%]" RAT_FUNC "%5.4" "[%]" COEFFS 0 2.55 0 0 0 1 /end COMPU_METHOD
/begin COMPU_METHOD UMR_U_MIN_1_1_0_S5_S3 "int = ((phys * 1) / 1) - (0) [U/min]" RAT_FUNC "%1.0" "[U/min]" COEFFS 0 1 0 0 0 1 /end COMPU_METHOD
/begin COMPU_METHOD UMR_U_MIN_32_1_0_S5_S3 "int = ((phys * 1) / 32) - (0) [U/min]" RAT_FUNC "%1.0" "[U/min]" COEFFS 0 0.03125 0 0 0 1 /end COMPU_METHOD
/begin COMPU_METHOD UMR_U_MINSEC_1_1_0_S5_S3 "int = ((phys * 1) / 1) - (0) [U/(min*s)]" RAT_FUNC "%1.0" "[U/(min*s)]" COEFFS 0 1 0 0 0 1 /end COMPU_METHOD
/begin CHARACTERISTIC CGT_PSYSIAE "Getriebeöltemperaturschwelle für FKt. Reduzierung Hochlastschudder IAE" VALUE 0x1D7BEB ZF_kw_ui8_S5_S3 190 UMR_GRADC__1_1_M40_S5_S3 -40 150 /end CHARACTERISTIC
/begin CHARACTERISTIC CGT_PSYSIAEHYS "Hysterese für Getriebeöltemperatur für FKt. Reduzierung Hochlastschudder IAE" VALUE 0x1D7BEC ZF_kw_ui8_S5_S3 100 UMR_GRADC__1_1_0_S5_S3 0 100 /end CHARACTERISTIC
/begin CHARACTERISTIC CS_EDSLOGIK "ASIL-C: Temperaturschwelle zur Aktivierung der Funktion" VALUE 0x1D7C83 ZF_kw_ui8_S5_S3 190 UMR_GRADC__1_1_M40_S5_S3 -40 150 /end CHARACTERISTIC
/begin CHARACTERISTIC CS_FUELLOPTOB "Obere Temperaturschwelle zur Aktivierung der opt. Befuellung" VALUE 0x1D7BFE ZF_kw_ui8_S5_S3 190 UMR_GRADC__1_1_M40_S5_S3 -40 150 /end CHARACTERISTIC
/begin CHARACTERISTIC CS_FUELLOPTUN "Untere Temperaturschwelle zur Aktivierung der opt. Befuellung" VALUE 0x1D7BFD ZF_kw_ui8_S5_S3 190 UMR_GRADC__1_1_M40_S5_S3 -40 150 /end CHARACTERISTIC
/begin CHARACTERISTIC CS_FUELLREDOB "Obere Temperaturschwelle zur Aktivierung der red. Befuellung" VALUE 0x1D7BF1 ZF_kw_ui8_S5_S3 190 UMR_GRADC__1_1_M40_S5_S3 -40 150 /end CHARACTERISTIC
/begin CHARACTERISTIC CS_FUELLREDUN "Untere Temperaturschwelle zur Aktivierung der red. Befuellung" VALUE 0x1D7BF0 ZF_kw_ui8_S5_S3 190 UMR_GRADC__1_1_M40_S5_S3 -40 150 /end CHARACTERISTIC
/begin CHARACTERISTIC CS_KUPPLPSYS "Kupplungstemperaturschwelle für Systemdruckanforderung" VALUE 0x1D8B56 ZF_kw_ui16_S5_S3 500 UMR_GRADC__1_1_0_S5_S3 0 500 /end CHARACTERISTIC
/begin CHARACTERISTIC CS_PSYSIEP "Temperaturschwelle fuer Mindestsystemdruck fuer zusaetzliche Leckage fuer IEP" VALUE 0x1D7BEF ZF_kw_ui8_S5_S3 190 UMR_GRADC__1_1_M40_S5_S3 -40 150 /end CHARACTERISTIC
/begin CHARACTERISTIC CS_UNMAXPSYS "Getriebeöltemperaturschwelle für Ansteuerung max. Systemdruck" VALUE 0x1D7BED ZF_kw_ui8_S5_S3 190 UMR_GRADC__1_1_M40_S5_S3 -40 150 /end CHARACTERISTIC
/begin CHARACTERISTIC C_GETUWIG "Getriebetemperaturschwelle fuer Symptomerkennung UWIG" VALUE 0x1D7BFF ZF_kw_ui8_S5_S3 190 UMR_GRADC__1_1_M40_S5_S3 -40 150 /end CHARACTERISTIC
/begin CHARACTERISTIC C_PMUEB "Temperaturschwelle zum Einstieg in die Funktion" VALUE 0x1D7C80 ZF_kw_ui8_S5_S3 254 UMR_GRADC__1_1_M40_S5_S3 -40 214 /end CHARACTERISTIC
/begin CHARACTERISTIC DKI_MAXUWIG_GE "maximales Drosselklappendelta fuer Ueberwachung Gangeinlegen" VALUE 0x1D7C00 ZF_kw_ui8_S5_S3 100 UMR_PROZENT__20_51_0_S5_S3 0 100 /end CHARACTERISTIC
/begin CHARACTERISTIC DKI_UWIGRNF "Drosselklappenschwelle fuer Rueckkehr zur Normalfunktion UWIG" VALUE 0x1D7C01 ZF_kw_ui8_S5_S3 100 UMR_PROZENT__20_51_0_S5_S3 0 100 /end CHARACTERISTIC
/begin CHARACTERISTIC HYS_CKUPPLPSYS "Hysterese für Kupplungstemperatur" VALUE 0x1D7BEE ZF_kw_ui8_S5_S3 100 UMR_GRADC__1_1_0_S5_S3 0 100 /end CHARACTERISTIC
/begin CHARACTERISTIC IEDSC_MAX_POSVC "ASIL-C: Stromschwelle zur Erkennung ob Kupplung C geschaltet ist" VALUE 0x1D8BE8 ZF_kw_ui16_S5_S3 1200 UMR_MA__1_10_0_S5_S3 0 1200 /end CHARACTERISTIC
/begin CHARACTERISTIC IEDSPOS_PMUEB "Prüfwert für Bestromung des EDS-POS" VALUE 0x1D8BE4 ZF_kw_ui16_S5_S3 850 UMR_MA__1_10_0_S5_S3 0 850 /end CHARACTERISTIC
/begin CHARACTERISTIC I_EDSMAXPOSNUEB_A "ASIL-B: Druckreglerstromschwelle fuer die PosN-Plausi" VALUE 0x1D8BFE ZF_kw_ui16_S5_S3 1200 UMR_MA__1_10_0_S5_S3 0 1200 /end CHARACTERISTIC
/begin CHARACTERISTIC I_EDSMAXPOSNUEB_B "ASIL-B: Druckreglerstromschwelle fuer die PosN-Plausi" VALUE 0x1D8C00 ZF_kw_ui16_S5_S3 1200 UMR_MA__1_10_0_S5_S3 0 1200 /end CHARACTERISTIC
/begin CHARACTERISTIC I_EDSMAXPOSPUEB_POS "Stromschwelle für EDS_POS für Überwachung unzulässiges Auslegen Position P" VALUE 0x1D8BEC ZF_kw_ui16_S5_S3 1200 UMR_MA__1_10_0_S5_S3 0 1200 /end CHARACTERISTIC
/begin CHARACTERISTIC I_EDSMINPOSNUEB_C "ASIL-B: Druckreglerstromschwelle fuer die PosN-Plausi" VALUE 0x1D8C02 ZF_kw_ui16_S5_S3 1200 UMR_MA__1_10_0_S5_S3 0 1200 /end CHARACTERISTIC
/begin CHARACTERISTIC I_EDSMINPOSNUEB_D "ASIL-B: Druckreglerstromschwelle fuer die PosN-Plausi" VALUE 0x1D8C04 ZF_kw_ui16_S5_S3 1200 UMR_MA__1_10_0_S5_S3 0 1200 /end CHARACTERISTIC
/begin CHARACTERISTIC I_EDSMINPOSNUEB_E "ASIL-B: Druckreglerstromschwelle fuer die PosN-Plausi" VALUE 0x1D8C06 ZF_kw_ui16_S5_S3 1200 UMR_MA__1_10_0_S5_S3 0 1200 /end CHARACTERISTIC
/begin CHARACTERISTIC I_EDSMINPOSPUEB_C "ASIL-C: Stromschwelle für Kupplung C für Überwachung unzulässiges Auslegen Position P" VALUE 0x1D8BEE ZF_kw_ui16_S5_S3 1200 UMR_MA__1_10_0_S5_S3 0 1200 /end CHARACTERISTIC
/begin CHARACTERISTIC I_EDSNULLPOSNUEB "ASIL-B: Stromschwelle fuer Nullbestromung in der PosN-Plausi" VALUE 0x1D8BFC ZF_kw_ui16_S5_S3 1200 UMR_MA__1_10_0_S5_S3 0 1200 /end CHARACTERISTIC
/begin CHARACTERISTIC I_KUPB_MIN_EDSLOGIK "ASIL-B: Stromschwelle zur Erkennung ob Kupplung B geschaltet ist" VALUE 0x1D8BF8 ZF_kw_ui16_S5_S3 1200 UMR_MA__1_10_0_S5_S3 0 1200 /end CHARACTERISTIC
/begin CHARACTERISTIC I_KUPD_MAX_EDSLOGIK "ASIL-B: Stromschwelle zur Erkennung ob Kupplung D geschaltet ist" VALUE 0x1D8BF6 ZF_kw_ui16_S5_S3 1200 UMR_MA__1_10_0_S5_S3 0 1200 /end CHARACTERISTIC
/begin CHARACTERISTIC J_VM_K0 "ASIL-B: Massenträgheit des Motors" VALUE 0x1D8BF4 ZF_kw_ui16_S5_S3 1 UMR_KGM2__1_1000_0_S5_S3 0 1 /end CHARACTERISTIC
/begin CHARACTERISTIC KF_IEDSMAXMMOTCGLOGIKUEB_A "Maximale Druckreglerstromschwelle fuer EDS" MAP 0x1CF784 ZF_kf_si16_S5_S3 1200 UMR_MA__1_10_0_S5_S3 0 1200
 /begin AXIS_DESCR STD_AXIS iUl2ItfipInt.m_mot_l2 UMR_NM__1_1_0_S5_S3 4 -200 1300 DEPOSIT ABSOLUTE /end AXIS_DESCR
 /begin AXIS_DESCR STD_AXIS iUl2ItfipInt.c_getr_l2 UMR_GRADC__1_1_M40_S5_S3 4 -40 215 DEPOSIT ABSOLUTE /end AXIS_DESCR
/end CHARACTERISTIC
/begin CHARACTERISTIC KF_IEDSMAXMMOTCGLOGIKUEB_B "Maximale Druckreglerstromschwelle fuer EDS" MAP 0x1CF888 ZF_kf_si16_S5_S3 1200 UMR_MA__1_10_0_S5_S3 0 1200
 /begin AXIS_DESCR STD_AXIS iUl2ItfipInt.m_mot_l2 UMR_NM__1_1_0_S5_S3 4 -200 1300 DEPOSIT ABSOLUTE /end AXIS_DESCR
 /begin AXIS_DESCR STD_AXIS iUl2ItfipInt.c_getr_l2 UMR_GRADC__1_1_M40_S5_S3 4 -40 215 DEPOSIT ABSOLUTE /end AXIS_DESCR
/end CHARACTERISTIC
/begin CHARACTERISTIC KF_IEDSMAXOFFMMOTCGLOGIKUEB_A "Minimale Druckreglerstromschwelle fuer EDS" MAP 0x1CF7BC ZF_kf_si16_S5_S3 1200 UMR_MA__1_10_0_S5_S3 0 1200
 /begin AXIS_DESCR STD_AXIS iUl2ItfipInt.m_mot_l2 UMR_NM__1_1_0_S5_S3 4 -200 1300 DEPOSIT ABSOLUTE /end AXIS_DESCR
 /begin AXIS_DESCR STD_AXIS iUl2ItfipInt.c_getr_l2 UMR_GRADC__1_1_M40_S5_S3 4 -40 215 DEPOSIT ABSOLUTE /end AXIS_DESCR
/end CHARACTERISTIC
/begin CHARACTERISTIC KF_IEDSMAXOFFMMOTCGLOGIKUEB_B "Minimale Druckreglerstromschwelle fuer EDS" MAP 0x1CF8C0 ZF_kf_si16_S5_S3 1200 UMR_MA__1_10_0_S5_S3 0 1200
 /begin AXIS_DESCR STD_AXIS iUl2ItfipInt.m_mot_l2 UMR_NM__1_1_0_S5_S3 4 -200 1300 DEPOSIT ABSOLUTE /end AXIS_DESCR
 /begin AXIS_DESCR STD_AXIS iUl2ItfipInt.c_getr_l2 UMR_GRADC__1_1_M40_S5_S3 4 -40 215 DEPOSIT ABSOLUTE /end AXIS_DESCR
/end CHARACTERISTIC
/begin CHARACTERISTIC KF_IGOUWIGNGTOB_1 "Offset auf obere Uebersetzungschwelle bei GE" MAP 0x1CE660 ZF_kf_si16_S5_S3 32.767 UMR___1_1000_0_S5_S3 0 32.767
 /begin AXIS_DESCR STD_AXIS zff_atsys._.iSignale._.obj.sig_n_ab UMR_U_MIN_1_1_0_S5_S3 8 0 8160 DEPOSIT ABSOLUTE /end AXIS_DESCR
 /begin AXIS_DESCR STD_AXIS iUewIgetr.ng_t_ge_start UMR_U_MINSEC_1_1_0_S5_S3 2 -8000 8000 DEPOSIT ABSOLUTE /end AXIS_DESCR
/end CHARACTERISTIC
/begin CHARACTERISTIC KF_IGOUWIGNGTOB_2 "Offset auf obere Uebersetzungschwelle bei GE" MAP 0x1CE768 ZF_kf_si16_S5_S3 32.767 UMR___1_1000_0_S5_S3 0 32.767
 /begin AXIS_DESCR STD_AXIS zff_atsys._.iSignale._.obj.sig_n_ab UMR_U_MIN_1_1_0_S5_S3 8 0 8160 DEPOSIT ABSOLUTE /end AXIS_DESCR
 /begin AXIS_DESCR STD_AXIS iUewIgetr.ng_t_ge_start UMR_U_MINSEC_1_1_0_S5_S3 2 -8000 8000 DEPOSIT ABSOLUTE /end AXIS_DESCR
/end CHARACTERISTIC
/begin CHARACTERISTIC KF_IGOUWIGNGTOB_3 "Offset auf obere Uebersetzungschwelle bei GE" MAP 0x1CE870 ZF_kf_si16_S5_S3 32.767 UMR___1_1000_0_S5_S3 0 32.767
 /begin AXIS_DESCR STD_AXIS zff_atsys._.iSignale._.obj.sig_n_ab UMR_U_MIN_1_1_0_S5_S3 8 0 8160 DEPOSIT ABSOLUTE /end AXIS_DESCR
 /begin AXIS_DESCR STD_AXIS iUewIgetr.ng_t_ge_start UMR_U_MINSEC_1_1_0_S5_S3 2 -8000 8000 DEPOSIT ABSOLUTE /end AXIS_DESCR
/end CHARACTERISTIC
/begin CHARACTERISTIC KF_IGOUWIGNGTOB_4 "Offset auf obere Uebersetzungschwelle bei GE" MAP 0x1CE978 ZF_kf_si16_S5_S3 32.767 UMR___1_1000_0_S5_S3 0 32.767
 /begin AXIS_DESCR STD_AXIS zff_atsys._.iSignale._.obj.sig_n_ab UMR_U_MIN_1_1_0_S5_S3 8 0 8160 DEPOSIT ABSOLUTE /end AXIS_DESCR
 /begin AXIS_DESCR STD_AXIS iUewIgetr.ng_t_ge_start UMR_U_MINSEC_1_1_0_S5_S3 2 -8000 8000 DEPOSIT ABSOLUTE /end AXIS_DESCR
/end CHARACTERISTIC
/begin CHARACTERISTIC KF_IGOUWIGNGTOB_5 "Offset auf obere Uebersetzungschwelle bei GE" MAP 0x1CEA80 ZF_kf_si16_S5_S3 32.767 UMR___1_1000_0_S5_S3 0 32.767
 /begin AXIS_DESCR STD_AXIS zff_atsys._.iSignale._.obj.sig_n_ab UMR_U_MIN_1_1_0_S5_S3 8 0 8160 DEPOSIT ABSOLUTE /end AXIS_DESCR
 /begin AXIS_DESCR STD_AXIS iUewIgetr.ng_t_ge_start UMR_U_MINSEC_1_1_0_S5_S3 2 -8000 8000 DEPOSIT ABSOLUTE /end AXIS_DESCR
/end CHARACTERISTIC
/begin CHARACTERISTIC KF_IGOUWIGNGTOB_6 "Offset auf obere Uebersetzungschwelle bei GE" MAP 0x1CEB88 ZF_kf_si16_S5_S3 32.767 UMR___1_1000_0_S5_S3 0 32.767
 /begin AXIS_DESCR STD_AXIS zff_atsys._.iSignale._.obj.sig_n_ab UMR_U_MIN_1_1_0_S5_S3 8 0 8160 DEPOSIT ABSOLUTE /end AXIS_DESCR
 /begin AXIS_DESCR STD_AXIS iUewIgetr.ng_t_ge_start UMR_U_MINSEC_1_1_0_S5_S3 2 -8000 8000 DEPOSIT ABSOLUTE /end AXIS_DESCR
/end CHARACTERISTIC
/begin CHARACTERISTIC KF_IGOUWIGNGTOB_7 "Offset auf obere Uebersetzungschwelle bei GE" MAP 0x1CEC90 ZF_kf_si16_S5_S3 32.767 UMR___1_1000_0_S5_S3 0 32.767
 /begin AXIS_DESCR STD_AXIS zff_atsys._.iSignale._.obj.sig_n_ab UMR_U_MIN_1_1_0_S5_S3 8 0 8160 DEPOSIT ABSOLUTE /end AXIS_DESCR
 /begin AXIS_DESCR STD_AXIS iUewIgetr.ng_t_ge_start UMR_U_MINSEC_1_1_0_S5_S3 2 -8000 8000 DEPOSIT ABSOLUTE /end AXIS_DESCR
/end CHARACTERISTIC
/begin CHARACTERISTIC KF_IGOUWIGNGTOB_8 "Offset auf obere Uebersetzungschwelle bei GE" MAP 0x1CED98 ZF_kf_si16_S5_S3 32.767 UMR___1_1000_0_S5_S3 0 32.767
 /begin AXIS_DESCR STD_AXIS zff_atsys._.iSignale._.obj.sig_n_ab UMR_U_MIN_1_1_0_S5_S3 8 0 8160 DEPOSIT ABSOLUTE /end AXIS_DESCR
 /begin AXIS_DESCR STD_AXIS iUewIgetr.ng_t_ge_start UMR_U_MINSEC_1_1_0_S5_S3 2 -8000 8000 DEPOSIT ABSOLUTE /end AXIS_DESCR
/end CHARACTERISTIC
/begin CHARACTERISTIC KF_IGOUWIGNGTOB_R "Offset auf obere Uebersetzungschwelle bei GE" MAP 0x1CE558 ZF_kf_si16_S5_S3 32.767 UMR___1_1000_0_S5_S3 0 32.767
 /begin AXIS_DESCR STD_AXIS zff_atsys._.iSignale._.obj.sig_n_ab UMR_U_MIN_1_1_0_S5_S3 8 0 8160 DEPOSIT ABSOLUTE /end AXIS_DESCR
 /begin AXIS_DESCR STD_AXIS iUewIgetr.ng_t_ge_start UMR_U_MINSEC_1_1_0_S5_S3 2 -8000 8000 DEPOSIT ABSOLUTE /end AXIS_DESCR
/end CHARACTERISTIC
/begin CHARACTERISTIC KF_IGOUWIGNGTUN_1 "Offset auf untere Uebersetzungschwelle bei GE" MAP 0x1CE69C ZF_kf_si16_S5_S3 32.767 UMR___1_1000_0_S5_S3 0 32.767
 /begin AXIS_DESCR STD_AXIS zff_atsys._.iSignale._.obj.sig_n_ab UMR_U_MIN_1_1_0_S5_S3 8 0 8160 DEPOSIT ABSOLUTE /end AXIS_DESCR
 /begin AXIS_DESCR STD_AXIS iUewIgetr.ng_t_ge_start UMR_U_MINSEC_1_1_0_S5_S3 2 -8000 8000 DEPOSIT ABSOLUTE /end AXIS_DESCR
/end CHARACTERISTIC
/begin CHARACTERISTIC KF_IGOUWIGNGTUN_2 "Offset auf untere Uebersetzungschwelle bei GE" MAP 0x1CE7A4 ZF_kf_si16_S5_S3 32.767 UMR___1_1000_0_S5_S3 0 32.767
 /begin AXIS_DESCR STD_AXIS zff_atsys._.iSignale._.obj.sig_n_ab UMR_U_MIN_1_1_0_S5_S3 8 0 8160 DEPOSIT ABSOLUTE /end AXIS_DESCR
 /begin AXIS_DESCR STD_AXIS iUewIgetr.ng_t_ge_start UMR_U_MINSEC_1_1_0_S5_S3 2 -8000 8000 DEPOSIT ABSOLUTE /end AXIS_DESCR
/end CHARACTERISTIC
/begin CHARACTERISTIC KF_IGOUWIGNGTUN_3 "Offset auf untere Uebersetzungschwelle bei GE" MAP 0x1CE8AC ZF_kf_si16_S5_S3 32.767 UMR___1_1000_0_S5_S3 0 32.767
 /begin AXIS_DESCR STD_AXIS zff_atsys._.iSignale._.obj.sig_n_ab UMR_U_MIN_1_1_0_S5_S3 8 0 8160 DEPOSIT ABSOLUTE /end AXIS_DESCR
 /begin AXIS_DESCR STD_AXIS iUewIgetr.ng_t_ge_start UMR_U_MINSEC_1_1_0_S5_S3 2 -8000 8000 DEPOSIT ABSOLUTE /end AXIS_DESCR
/end CHARACTERISTIC
/begin CHARACTERISTIC KF_IGOUWIGNGTUN_4 "Offset auf untere Uebersetzungschwelle bei GE" MAP 0x1CE9B4 ZF_kf_si16_S5_S3 32.767 UMR___1_1000_0_S5_S3 0 32.767
 /begin AXIS_DESCR STD_AXIS zff_atsys._.iSignale._.obj.sig_n_ab UMR_U_MIN_1_1_0_S5_S3 8 0 8160 DEPOSIT ABSOLUTE /end AXIS_DESCR
 /begin AXIS_DESCR STD_AXIS iUewIgetr.ng_t_ge_start UMR_U_MINSEC_1_1_0_S5_S3 2 -8000 8000 DEPOSIT ABSOLUTE /end AXIS_DESCR
/end CHARACTERISTIC
/begin CHARACTERISTIC KF_IGOUWIGNGTUN_5 "Offset auf untere Uebersetzungschwelle bei GE" MAP 0x1CEABC ZF_kf_si16_S5_S3 32.767 UMR___1_1000_0_S5_S3 0 32.767
 /begin AXIS_DESCR STD_AXIS zff_atsys._.iSignale._.obj.sig_n_ab UMR_U_MIN_1_1_0_S5_S3 8 0 8160 DEPOSIT ABSOLUTE /end AXIS_DESCR
 /begin AXIS_DESCR STD_AXIS iUewIgetr.ng_t_ge_start UMR_U_MINSEC_1_1_0_S5_S3 2 -8000 8000 DEPOSIT ABSOLUTE /end AXIS_DESCR
/end CHARACTERISTIC
/begin CHARACTERISTIC KF_IGOUWIGNGTUN_6 "Offset auf untere Uebersetzungschwelle bei GE" MAP 0x1CEBC4 ZF_kf_si16_S5_S3 32.767 UMR___1_1000_0_S5_S3 0 32.767
 /begin AXIS_DESCR STD_AXIS zff_atsys._.iSignale._.obj.sig_n_ab UMR_U_MIN_1_1_0_S5_S3 8 0 8160 DEPOSIT ABSOLUTE /end AXIS_DESCR
 /begin AXIS_DESCR STD_AXIS iUewIgetr.ng_t_ge_start UMR_U_MINSEC_1_1_0_S5_S3 2 -8000 8000 DEPOSIT ABSOLUTE /end AXIS_DESCR
/end CHARACTERISTIC
/begin CHARACTERISTIC KF_IGOUWIGNGTUN_7 "Offset auf untere Uebersetzungschwelle bei GE" MAP 0x1CECCC ZF_kf_si16_S5_S3 32.767 UMR___1_1000_0_S5_S3 0 32.767
 /begin AXIS_DESCR STD_AXIS zff_atsys._.iSignale._.obj.sig_n_ab UMR_U_MIN_1_1_0_S5_S3 8 0 8160 DEPOSIT ABSOLUTE /end AXIS_DESCR
 /begin AXIS_DESCR STD_AXIS iUewIgetr.ng_t_ge_start UMR_U_MINSEC_1_1_0_S5_S3 2 -8000 8000 DEPOSIT ABSOLUTE /end AXIS_DESCR
/end CHARACTERISTIC
/begin CHARACTERISTIC KF_IGOUWIGNGTUN_8 "Offset auf untere Uebersetzungschwelle bei GE" MAP 0x1CEDD4 ZF_kf_si16_S5_S3 32.767 UMR___1_1000_0_S5_S3 0 32.767
 /begin AXIS_DESCR STD_AXIS zff_atsys._.iSignale._.obj.sig_n_ab UMR_U_MIN_1_1_0_S5_S3 8 0 8160 DEPOSIT ABSOLUTE /end AXIS_DESCR
 /begin AXIS_DESCR STD_AXIS iUewIgetr.ng_t_ge_start UMR_U_MINSEC_1_1_0_S5_S3 2 -8000 8000 DEPOSIT ABSOLUTE /end AXIS_DESCR
/end CHARACTERISTIC
/begin CHARACTERISTIC KF_IGOUWIGNGTUN_R "Offset auf untere Uebersetzungschwelle bei GE" MAP 0x1CE594 ZF_kf_si16_S5_S3 32.767 UMR___1_1000_0_S5_S3 0 32.767
 /begin AXIS_DESCR STD_AXIS zff_atsys._.iSignale._.obj.sig_n_ab UMR_U_MIN_1_1_0_S5_S3 8 0 8160 DEPOSIT ABSOLUTE /end AXIS_DESCR
 /begin AXIS_DESCR STD_AXIS iUewIgetr.ng_t_ge_start UMR_U_MINSEC_1_1_0_S5_S3 2 -8000 8000 DEPOSIT ABSOLUTE /end AXIS_DESCR
/end CHARACTERISTIC
/begin CHARACTERISTIC KF_MAXSTOERCGDELTAI_EDSLOGIK_A "Minimale Druckreglerstromschwelle fuer EDS" MAP 0x1CF810 ZF_kf_si16_S5_S3 255 UMR___1_1_0_S5_S3 0 255
 /begin AXIS_DESCR STD_AXIS iUl2ItfipInt.c_getr_l2 UMR_GRADC__1_1_M40_S5_S3 6 -40 215 DEPOSIT ABSOLUTE /end AXIS_DESCR
 /begin AXIS_DESCR STD_AXIS NO_INPUT_QUANTITY UMR_MA__1_10_0_S5_S3 6 0 1000 DEPOSIT ABSOLUTE /end AXIS_DESCR
/end CHARACTERISTIC
/begin CHARACTERISTIC KF_MAXSTOERCGDELTAI_EDSLOGIK_B "Minimale Druckreglerstromschwelle fuer EDS" MAP 0x1CF914 ZF_kf_si16_S5_S3 255 UMR___1_1_0_S5_S3 0 255
 /begin AXIS_DESCR STD_AXIS iUl2ItfipInt.c_getr_l2 UMR_GRADC__1_1_M40_S5_S3 6 -40 215 DEPOSIT ABSOLUTE /end AXIS_DESCR
 /begin AXIS_DESCR STD_AXIS NO_INPUT_QUANTITY UMR_MA__1_10_0_S5_S3 6 0 1000 DEPOSIT ABSOLUTE /end AXIS_DESCR
/end CHARACTERISTIC
/begin CHARACTERISTIC KF_MMOTGETRAUF "Zulässiges Getriebeaufnahmemoment in Abh. von der Uebersetzung und die Getriebetemperatur" MAP 0x1CF668 ZF_kf_ui16_S5_S3 1000 UMR_NM__1_1_0_S5_S3 0 1000
 /begin AXIS_DESCR STD_AXIS NO_INPUT_QUANTITY UMR___1_1000_0_S5_S3 8 0 65.535 DEPOSIT ABSOLUTE /end AXIS_DESCR
 /begin AXIS_DESCR STD_AXIS iUl2ItfipInt.c_getr_l2 UMR_GRADC__1_1_M40_S5_S3 6 -40 215 DEPOSIT ABSOLUTE /end AXIS_DESCR
/end CHARACTERISTIC
/begin CHARACTERISTIC KF_OFFSETMMOTGETRAUF "Offsetkennfeld" MAP 0x1CF6EC ZF_kf_ui16_S5_S3 1000 UMR_NM__1_1_0_S5_S3 0 1000
 /begin AXIS_DESCR STD_AXIS NO_INPUT_QUANTITY UMR___1_1000_0_S5_S3 8 0 65.535 DEPOSIT ABSOLUTE /end AXIS_DESCR
 /begin AXIS_DESCR STD_AXIS iUl2ItfipInt.c_getr_l2 UMR_GRADC__1_1_M40_S5_S3 6 -40 215 DEPOSIT ABSOLUTE /end AXIS_DESCR
/end CHARACTERISTIC
/begin CHARACTERISTIC KF_PKZUWS65 "Schaltdruckkennfeld (n_tkf, m_t)" MAP 0x1CC270 ZF_kf_si16_S5_S3 12.75 UMR_BAR__1_1000_0_S5_S3 0 12.75
 /begin AXIS_DESCR STD_AXIS iSasZentr.iSchaltend.n_tkf UMR_U_MIN_32_1_0_S5_S3 8 0 8160 DEPOSIT ABSOLUTE /end AXIS_DESCR
 /begin AXIS_DESCR STD_AXIS zff_atsys._.iSignale._.obj.sig_m_t UMR_NM__1_1_0_S5_S3 8 -200 1300 DEPOSIT ABSOLUTE /end AXIS_DESCR
/end CHARACTERISTIC
/begin CHARACTERISTIC KF_PKZUWS76 "Schaltdruckkennfeld (n_tkf, m_t)" MAP 0x1CC4BC ZF_kf_si16_S5_S3 12.75 UMR_BAR__1_1000_0_S5_S3 0 12.75
 /begin AXIS_DESCR STD_AXIS iSasZentr.iSchaltend.n_tkf UMR_U_MIN_32_1_0_S5_S3 8 0 8160 DEPOSIT ABSOLUTE /end AXIS_DESCR
 /begin AXIS_DESCR STD_AXIS zff_atsys._.iSignale._.obj.sig_m_t UMR_NM__1_1_0_S5_S3 8 -200 1300 DEPOSIT ABSOLUTE /end AXIS_DESCR
/end CHARACTERISTIC
/begin CHARACTERISTIC KF_PKZUWS87 "Schaltdruckkennfeld (n_tkf, m_t)" MAP 0x1CC708 ZF_kf_si16_S5_S3 12.75 UMR_BAR__1_1000_0_S5_S3 0 12.75
 /begin AXIS_DESCR STD_AXIS iSasZentr.iSchaltend.n_tkf UMR_U_MIN_32_1_0_S5_S3 8 0 8160 DEPOSIT ABSOLUTE /end AXIS_DESCR
 /begin AXIS_DESCR STD_AXIS zff_atsys._.iSignale._.obj.sig_m_t UMR_NM__1_1_0_S5_S3 8 -200 1300 DEPOSIT ABSOLUTE /end AXIS_DESCR
/end CHARACTERISTIC
/begin CHARACTERISTIC KF_PKZUWSSP64 "Schaltdruckkennfeld (n_tkf, m_t)" MAP 0x1CD4D0 ZF_kf_si16_S5_S3 12.75 UMR_BAR__1_1000_0_S5_S3 0 12.75
 /begin AXIS_DESCR STD_AXIS iSasZentr.iSchaltend.n_tkf UMR_U_MIN_32_1_0_S5_S3 8 0 8160 DEPOSIT ABSOLUTE /end AXIS_DESCR
 /begin AXIS_DESCR STD_AXIS zff_atsys._.iSignale._.obj.sig_m_t UMR_NM__1_1_0_S5_S3 8 -200 1300 DEPOSIT ABSOLUTE /end AXIS_DESCR
/end CHARACTERISTIC
/begin CHARACTERISTIC KF_PKZUWSSP71 "Schaltdruckkennfeld (n_tkf, m_t)" MAP 0x1CD71C ZF_kf_si16_S5_S3 12.75 UMR_BAR__1_1000_0_S5_S3 0 12.75
 /begin AXIS_DESCR STD_AXIS iSasZentr.iSchaltend.n_tkf UMR_U_MIN_32_1_0_S5_S3 8 0 8160 DEPOSIT ABSOLUTE /end AXIS_DESCR
 /begin AXIS_DESCR STD_AXIS zff_atsys._.iSignale._.obj.sig_m_t UMR_NM__1_1_0_S5_S3 8 -200 1300 DEPOSIT ABSOLUTE /end AXIS_DESCR
/end CHARACTERISTIC
/begin CHARACTERISTIC KF_PKZUWSSP75 "Schaltdruckkennfeld (n_tkf, m_t)" MAP 0x1CD968 ZF_kf_si16_S5_S3 12.75 UMR_BAR__1_1000_0_S5_S3 0 12.75
 /begin AXIS_DESCR STD_AXIS iSasZentr.iSchaltend.n_tkf UMR_U_MIN_32_1_0_S5_S3 8 0 8160 DEPOSIT ABSOLUTE /end AXIS_DESCR
 /begin AXIS_DESCR STD_AXIS zff_atsys._.iSignale._.obj.sig_m_t UMR_NM__1_1_0_S5_S3 8 -200 1300 DEPOSIT ABSOLUTE /end AXIS_DESCR
/end CHARACTERISTIC
/begin CHARACTERISTIC KF_PKZUWSSP82 "Schaltdruckkennfeld (n_tkf, m_t)" MAP 0x1CDBB4 ZF_kf_si16_S5_S3 12.75 UMR_BAR__1_1000_0_S5_S3 0 12.75
 /begin AXIS_DESCR STD_AXIS iSasZentr.iSchaltend.n_tkf UMR_U_MIN_32_1_0_S5_S3 8 0 8160 DEPOSIT ABSOLUTE /end AXIS_DESCR
 /begin AXIS_DESCR STD_AXIS zff_atsys._.iSignale._.obj.sig_m_t UMR_NM__1_1_0_S5_S3 8 -200 1300 DEPOSIT ABSOLUTE /end AXIS_DESCR
/end CHARACTERISTIC
/begin CHARACTERISTIC KF_PKZUWSSP84 "Schaltdruckkennfeld (n_tkf, m_t)" MAP 0x1CDE00 ZF_kf_si16_S5_S3 12.75 UMR_BAR__1_1000_0_S5_S3 0 12.75
 /begin AXIS_DESCR STD_AXIS iSasZentr.iSchaltend.n_tkf UMR_U_MIN_32_1_0_S5_S3 8 0 8160 DEPOSIT ABSOLUTE /end AXIS_DESCR
 /begin AXIS_DESCR STD_AXIS zff_atsys._.iSignale._.obj.sig_m_t UMR_NM__1_1_0_S5_S3 8 -200 1300 DEPOSIT ABSOLUTE /end AXIS_DESCR
/end CHARACTERISTIC
/begin CHARACTERISTIC KF_PKZUWSSP86 "Schaltdruckkennfeld (n_tkf, m_t)" MAP 0x1CE04C ZF_kf_si16_S5_S3 12.75 UMR_BAR__1_1000_0_S5_S3 0 12.75
 /begin AXIS_DESCR STD_AXIS iSasZentr.iSchaltend.n_tkf UMR_U_MIN_32_1_0_S5_S3 8 0 8160 DEPOSIT ABSOLUTE /end AXIS_DESCR
 /begin AXIS_DESCR STD_AXIS zff_atsys._.iSignale._.obj.sig_m_t UMR_NM__1_1_0_S5_S3 8 -200 1300 DEPOSIT ABSOLUTE /end AXIS_DESCR
/end CHARACTERISTIC
/begin CHARACTERISTIC KF_POFMTNFUELLRED65 "Kennfeld Fuelldruckoffset(n_t, m_t)" MAP 0x1CC318 ZF_kf_si16_S5_S3 12.75 UMR_BAR__1_1000_0_S5_S3 -6.4 6.35
 /begin AXIS_DESCR STD_AXIS zff_atsys._.iSignale._.obj.sig_n_t UMR_U_MIN_1_1_0_S5_S3 4 0 8160 DEPOSIT ABSOLUTE /end AXIS_DESCR
 /begin AXIS_DESCR STD_AXIS zff_atsys._.iSignale._.obj.sig_m_t UMR_NM__1_1_0_S5_S3 6 -200 1300 DEPOSIT ABSOLUTE /end AXIS_DESCR
/end CHARACTERISTIC
/begin CHARACTERISTIC KF_POFMTNFUELLRED76 "Kennfeld Fuelldruckoffset(n_t, m_t)" MAP 0x1CC564 ZF_kf_si16_S5_S3 12.75 UMR_BAR__1_1000_0_S5_S3 -6.4 6.35
 /begin AXIS_DESCR STD_AXIS zff_atsys._.iSignale._.obj.sig_n_t UMR_U_MIN_1_1_0_S5_S3 4 0 8160 DEPOSIT ABSOLUTE /end AXIS_DESCR
 /begin AXIS_DESCR STD_AXIS zff_atsys._.iSignale._.obj.sig_m_t UMR_NM__1_1_0_S5_S3 6 -200 1300 DEPOSIT ABSOLUTE /end AXIS_DESCR
/end CHARACTERISTIC
/begin CHARACTERISTIC KF_POFMTNFUELLRED87 "Kennfeld Fuelldruckoffset(n_t, m_t)" MAP 0x1CC7B0 ZF_kf_si16_S5_S3 12.75 UMR_BAR__1_1000_0_S5_S3 -6.4 6.35
 /begin AXIS_DESCR STD_AXIS zff_atsys._.iSignale._.obj.sig_n_t UMR_U_MIN_1_1_0_S5_S3 4 0 8160 DEPOSIT ABSOLUTE /end AXIS_DESCR
 /begin AXIS_DESCR STD_AXIS zff_atsys._.iSignale._.obj.sig_m_t UMR_NM__1_1_0_S5_S3 6 -200 1300 DEPOSIT ABSOLUTE /end AXIS_DESCR
/end CHARACTERISTIC
/begin CHARACTERISTIC KF_POFMTNFUELLREDSP64 "Kennfeld Fuelldruckoffset(n_t, m_t)" MAP 0x1CD578 ZF_kf_si16_S5_S3 12.75 UMR_BAR__1_1000_0_S5_S3 -6.4 6.35
 /begin AXIS_DESCR STD_AXIS zff_atsys._.iSignale._.obj.sig_n_t UMR_U_MIN_1_1_0_S5_S3 4 0 8160 DEPOSIT ABSOLUTE /end AXIS_DESCR
 /begin AXIS_DESCR STD_AXIS zff_atsys._.iSignale._.obj.sig_m_t UMR_NM__1_1_0_S5_S3 6 -200 1300 DEPOSIT ABSOLUTE /end AXIS_DESCR
/end CHARACTERISTIC
/begin CHARACTERISTIC KF_POFMTNFUELLREDSP71 "Kennfeld Fuelldruckoffset(n_t, m_t)" MAP 0x1CD7C4 ZF_kf_si16_S5_S3 12.75 UMR_BAR__1_1000_0_S5_S3 -6.4 6.35
 /begin AXIS_DESCR STD_AXIS zff_atsys._.iSignale._.obj.sig_n_t UMR_U_MIN_1_1_0_S5_S3 4 0 8160 DEPOSIT ABSOLUTE /end AXIS_DESCR
 /begin AXIS_DESCR STD_AXIS zff_atsys._.iSignale._.obj.sig_m_t UMR_NM__1_1_0_S5_S3 6 -200 1300 DEPOSIT ABSOLUTE /end AXIS_DESCR
/end CHARACTERISTIC
/begin CHARACTERISTIC KF_POFMTNFUELLREDSP75 "Kennfeld Fuelldruckoffset(n_t, m_t)" MAP 0x1CDA10 ZF_kf_si16_S5_S3 12.75 UMR_BAR__1_1000_0_S5_S3 -6.4 6.35
 /begin AXIS_DESCR STD_AXIS zff_atsys._.iSignale._.obj.sig_n_t UMR_U_MIN_1_1_0_S5_S3 4 0 8160 DEPOSIT ABSOLUTE /end AXIS_DESCR
 /begin AXIS_DESCR STD_AXIS zff_atsys._.iSignale._.obj.sig_m_t UMR_NM__1_1_0_S5_S3 6 -200 1300 DEPOSIT ABSOLUTE /end AXIS_DESCR
/end CHARACTERISTIC
/begin CHARACTERISTIC KF_POFMTNFUELLREDSP82 "Kennfeld Fuelldruckoffset(n_t, m_t)" MAP 0x1CDC5C ZF_kf_si16_S5_S3 12.75 UMR_BAR__1_1000_0_S5_S3 -6.4 6.35
 /begin AXIS_DESCR STD_AXIS zff_atsys._.iSignale._.obj.sig_n_t UMR_U_MIN_1_1_0_S5_S3 4 0 8160 DEPOSIT ABSOLUTE /end AXIS_DESCR
 /begin AXIS_DESCR STD_AXIS zff_atsys._.iSignale._.obj.sig_m_t UMR_NM__1_1_0_S5_S3 6 -200 1300 DEPOSIT ABSOLUTE /end AXIS_DESCR
/end CHARACTERISTIC
/begin CHARACTERISTIC KF_POFMTNFUELLREDSP84 "Kennfeld Fuelldruckoffset(n_t, m_t)" MAP 0x1CDEA8 ZF_kf_si16_S5_S3 12.75 UMR_BAR__1_1000_0_S5_S3 -6.4 6.35
 /begin AXIS_DESCR STD_AXIS zff_atsys._.iSignale._.obj.sig_n_t UMR_U_MIN_1_1_0_S5_S3 4 0 8160 DEPOSIT ABSOLUTE /end AXIS_DESCR
 /begin AXIS_DESCR STD_AXIS zff_atsys._.iSignale._.obj.sig_m_t UMR_NM__1_1_0_S5_S3 6 -200 1300 DEPOSIT ABSOLUTE /end AXIS_DESCR
/end CHARACTERISTIC
/begin CHARACTERISTIC KF_POFMTNFUELLREDSP86 "Kennfeld Fuelldruckoffset(n_t, m_t)" MAP 0x1CE0F4 ZF_kf_si16_S5_S3 12.75 UMR_BAR__1_1000_0_S5_S3 -6.4 6.35
 /begin AXIS_DESCR STD_AXIS zff_atsys._.iSignale._.obj.sig_n_t UMR_U_MIN_1_1_0_S5_S3 4 0 8160 DEPOSIT ABSOLUTE /end AXIS_DESCR
 /begin AXIS_DESCR STD_AXIS zff_atsys._.iSignale._.obj.sig_m_t UMR_NM__1_1_0_S5_S3 6 -200 1300 DEPOSIT ABSOLUTE /end AXIS_DESCR
/end CHARACTERISTIC
/begin CHARACTERISTIC KF_PSYSN "Systemdruckkennfeld in Position N" MAP 0x1CE41C ZF_kf_ui16_S5_S3 22 UMR_BAR__1_1000_0_S5_S3 0 22
 /begin AXIS_DESCR STD_AXIS zff_atsys._.iSignale._.obj.sig_n_mot UMR_U_MIN_1_1_0_S5_S3 3 0 8160 DEPOSIT ABSOLUTE /end AXIS_DESCR
 /begin AXIS_DESCR STD_AXIS zff_atsys._.iSignale._.obj.sig_n_ab UMR_U_MIN_1_1_0_S5_S3 3 0 8160 DEPOSIT ABSOLUTE /end AXIS_DESCR
/end CHARACTERISTIC
/begin CHARACTERISTIC KF_PSYS_1 "Systemdruck gangabhängig" MAP 0x1CE1E4 ZF_kf_si16_S5_S3 22 UMR_BAR__1_1000_0_S5_S3 0 22
 /begin AXIS_DESCR STD_AXIS iKorSaste.m_t_mepos UMR_NM__1_1_0_S5_S3 6 -200 1300 DEPOSIT ABSOLUTE /end AXIS_DESCR
 /begin AXIS_DESCR STD_AXIS zff_atsys._.iSignale._.obj.sig_n_mot UMR_U_MIN_1_1_0_S5_S3 3 0 8160 DEPOSIT ABSOLUTE /end AXIS_DESCR
/end CHARACTERISTIC
/begin CHARACTERISTIC KF_PSYS_2 "Systemdruck gangabhängig" MAP 0x1CE224 ZF_kf_si16_S5_S3 22 UMR_BAR__1_1000_0_S5_S3 0 22
 /begin AXIS_DESCR STD_AXIS iKorSaste.m_t_mepos UMR_NM__1_1_0_S5_S3 6 -200 1300 DEPOSIT ABSOLUTE /end AXIS_DESCR
 /begin AXIS_DESCR STD_AXIS zff_atsys._.iSignale._.obj.sig_n_mot UMR_U_MIN_1_1_0_S5_S3 3 0 8160 DEPOSIT ABSOLUTE /end AXIS_DESCR
/end CHARACTERISTIC
/begin CHARACTERISTIC KF_PSYS_3 "Systemdruck gangabhängig" MAP 0x1CE264 ZF_kf_si16_S5_S3 22 UMR_BAR__1_1000_0_S5_S3 0 22
 /begin AXIS_DESCR STD_AXIS iKorSaste.m_t_mepos UMR_NM__1_1_0_S5_S3 6 -200 1300 DEPOSIT ABSOLUTE /end AXIS_DESCR
 /begin AXIS_DESCR STD_AXIS zff_atsys._.iSignale._.obj.sig_n_mot UMR_U_MIN_1_1_0_S5_S3 3 0 8160 DEPOSIT ABSOLUTE /end AXIS_DESCR
/end CHARACTERISTIC
/begin CHARACTERISTIC KF_PSYS_4 "Systemdruck gangabhängig" MAP 0x1CE2A4 ZF_kf_si16_S5_S3 22 UMR_BAR__1_1000_0_S5_S3 0 22
 /begin AXIS_DESCR STD_AXIS iKorSaste.m_t_mepos UMR_NM__1_1_0_S5_S3 6 -200 1300 DEPOSIT ABSOLUTE /end AXIS_DESCR
 /begin AXIS_DESCR STD_AXIS zff_atsys._.iSignale._.obj.sig_n_mot UMR_U_MIN_1_1_0_S5_S3 3 0 8160 DEPOSIT ABSOLUTE /end AXIS_DESCR
/end CHARACTERISTIC
/begin CHARACTERISTIC KF_PSYS_5 "Systemdruck gangabhängig" MAP 0x1CE2E4 ZF_kf_si16_S5_S3 22 UMR_BAR__1_1000_0_S5_S3 0 22
 /begin AXIS_DESCR STD_AXIS iKorSaste.m_t_mepos UMR_NM__1_1_0_S5_S3 6 -200 1300 DEPOSIT ABSOLUTE /end AXIS_DESCR
 /begin AXIS_DESCR STD_AXIS zff_atsys._.iSignale._.obj.sig_n_mot UMR_U_MIN_1_1_0_S5_S3 3 0 8160 DEPOSIT ABSOLUTE /end AXIS_DESCR
/end CHARACTERISTIC
/begin CHARACTERISTIC KF_PSYS_6 "Systemdruck gangabhängig" MAP 0x1CE324 ZF_kf_si16_S5_S3 22 UMR_BAR__1_1000_0_S5_S3 0 22
 /begin AXIS_DESCR STD_AXIS iKorSaste.m_t_mepos UMR_NM__1_1_0_S5_S3 6 -200 1300 DEPOSIT ABSOLUTE /end AXIS_DESCR
 /begin AXIS_DESCR STD_AXIS zff_atsys._.iSignale._.obj.sig_n_mot UMR_U_MIN_1_1_0_S5_S3 3 0 8160 DEPOSIT ABSOLUTE /end AXIS_DESCR
/end CHARACTERISTIC
/begin CHARACTERISTIC KF_PSYS_7 "Systemdruck gangabhängig" MAP 0x1CE364 ZF_kf_si16_S5_S3 22 UMR_BAR__1_1000_0_S5_S3 0 22
 /begin AXIS_DESCR STD_AXIS iKorSaste.m_t_mepos UMR_NM__1_1_0_S5_S3 6 -200 1300 DEPOSIT ABSOLUTE /end AXIS_DESCR
 /begin AXIS_DESCR STD_AXIS zff_atsys._.iSignale._.obj.sig_n_mot UMR_U_MIN_1_1_0_S5_S3 3 0 8160 DEPOSIT ABSOLUTE /end AXIS_DESCR
/end CHARACTERISTIC
/begin CHARACTERISTIC KF_PSYS_8 "Systemdruck gangabhängig" MAP 0x1CE3A4 ZF_kf_si16_S5_S3 22 UMR_BAR__1_1000_0_S5_S3 0 22
 /begin AXIS_DESCR STD_AXIS iKorSaste.m_t_mepos UMR_NM__1_1_0_S5_S3 6 -200 1300 DEPOSIT ABSOLUTE /end AXIS_DESCR
 /begin AXIS_DESCR STD_AXIS zff_atsys._.iSignale._.obj.sig_n_mot UMR_U_MIN_1_1_0_S5_S3 3 0 8160 DEPOSIT ABSOLUTE /end AXIS_DESCR
/end CHARACTERISTIC
/begin CHARACTERISTIC KF_PSYS_K0 "Systemdruckkennfeld K0" MAP 0x1CE444 ZF_kf_si16_S5_S3 22 UMR_BAR__1_1000_0_S5_S3 0 22
 /begin AXIS_DESCR STD_AXIS iItfInput.m_vmist UMR_NM__1_1_0_S5_S3 6 -1500 1500 DEPOSIT ABSOLUTE /end AXIS_DESCR
 /begin AXIS_DESCR STD_AXIS zff_atsys._.iSignale._.obj.sig_n_mot UMR_U_MIN_1_1_0_S5_S3 3 0 8160 DEPOSIT ABSOLUTE /end AXIS_DESCR
/end CHARACTERISTIC
/begin CHARACTERISTIC KF_PSYS_R "Systemdruck gangabhängig" MAP 0x1CE1A4 ZF_kf_si16_S5_S3 22 UMR_BAR__1_1000_0_S5_S3 0 22
 /begin AXIS_DESCR STD_AXIS iKorSaste.m_t_mepos UMR_NM__1_1_0_S5_S3 6 -200 1300 DEPOSIT ABSOLUTE /end AXIS_DESCR
 /begin AXIS_DESCR STD_AXIS zff_atsys._.iSignale._.obj.sig_n_mot UMR_U_MIN_1_1_0_S5_S3 3 0 8160 DEPOSIT ABSOLUTE /end AXIS_DESCR
/end CHARACTERISTIC
/begin CHARACTERISTIC KF_QLECKAGE "Gesamtleckage des Getriebes" MAP 0x1CE4CC ZF_kf_ui16_S5_S3 20 UMR_LITER_MIN_1_10_0_S5_S3 0 20
 /begin AXIS_DESCR STD_AXIS zff_atsys._.iSignale._.obj.sig_c_getr UMR_GRADC__1_1_M40_S5_S3 4 -40 150 DEPOSIT ABSOLUTE /end AXIS_DESCR
 /begin AXIS_DESCR STD_AXIS iSasPsyst.p_sys UMR_BAR__1_1000_0_S5_S3 6 0 20 DEPOSIT ABSOLUTE /end AXIS_DESCR
/end CHARACTERISTIC
/begin CHARACTERISTIC KF_TSYNMTNTRAKZUWS65 "Zeit vor sync. Ende Schaltdruck/Start 3. Rampe KZU bei Weiterschaltung (n_tkf, m_t8)" MAP 0x1CC370 ZF_kf_ui8_S5_S3 1280 UMR_MSEC__10_1_M128_S5_S3 -1280 0
 /begin AXIS_DESCR STD_AXIS zff_atsys._.iSignale._.obj.sig_m_t8 UMR_NM__6_1_M34_S5_S3 4 -204 1326 DEPOSIT ABSOLUTE /end AXIS_DESCR
 /begin AXIS_DESCR STD_AXIS iSasZentr.iSchaltend.n_tkf UMR_U_MIN_32_1_0_S5_S3 4 0 8160 DEPOSIT ABSOLUTE /end AXIS_DESCR
/end CHARACTERISTIC
/begin CHARACTERISTIC KF_TSYNMTNTRAKZUWS76 "Zeit vor sync. Ende Schaltdruck/Start 3. Rampe KZU bei Weiterschaltung (n_tkf, m_t8)" MAP 0x1CC5BC ZF_kf_ui8_S5_S3 1280 UMR_MSEC__10_1_M128_S5_S3 -1280 0
 /begin AXIS_DESCR STD_AXIS zff_atsys._.iSignale._.obj.sig_m_t8 UMR_NM__6_1_M34_S5_S3 4 -204 1326 DEPOSIT ABSOLUTE /end AXIS_DESCR
 /begin AXIS_DESCR STD_AXIS iSasZentr.iSchaltend.n_tkf UMR_U_MIN_32_1_0_S5_S3 4 0 8160 DEPOSIT ABSOLUTE /end AXIS_DESCR
/end CHARACTERISTIC
/begin CHARACTERISTIC KF_TSYNMTNTRAKZUWS87 "Zeit vor sync. Ende Schaltdruck/Start 3. Rampe KZU bei Weiterschaltung (n_tkf, m_t8)" MAP 0x1CC808 ZF_kf_ui8_S5_S3 1280 UMR_MSEC__10_1_M128_S5_S3 -1280 0
 /begin AXIS_DESCR STD_AXIS zff_atsys._.iSignale._.obj.sig_m_t8 UMR_NM__6_1_M34_S5_S3 4 -204 1326 DEPOSIT ABSOLUTE /end AXIS_DESCR
 /begin AXIS_DESCR STD_AXIS iSasZentr.iSchaltend.n_tkf UMR_U_MIN_32_1_0_S5_S3 4 0 8160 DEPOSIT ABSOLUTE /end AXIS_DESCR
/end CHARACTERISTIC
/begin CHARACTERISTIC KF_TSYNMTNTRAKZUWSSP64 "Zeit vor sync. Ende Schaltdruck/Start 3. Rampe KZU bei Weiterschaltung (n_tkf, m_t8)" MAP 0x1CD5D0 ZF_kf_ui8_S5_S3 1280 UMR_MSEC__10_1_M128_S5_S3 -1280 0
 /begin AXIS_DESCR STD_AXIS zff_atsys._.iSignale._.obj.sig_m_t8 UMR_NM__6_1_M34_S5_S3 4 -204 1326 DEPOSIT ABSOLUTE /end AXIS_DESCR
 /begin AXIS_DESCR STD_AXIS iSasZentr.iSchaltend.n_tkf UMR_U_MIN_32_1_0_S5_S3 4 0 8160 DEPOSIT ABSOLUTE /end AXIS_DESCR
/end CHARACTERISTIC
/begin CHARACTERISTIC KF_TSYNMTNTRAKZUWSSP71 "Zeit vor sync. Ende Schaltdruck/Start 3. Rampe KZU bei Weiterschaltung (n_tkf, m_t8)" MAP 0x1CD81C ZF_kf_ui8_S5_S3 1280 UMR_MSEC__10_1_M128_S5_S3 -1280 0
 /begin AXIS_DESCR STD_AXIS zff_atsys._.iSignale._.obj.sig_m_t8 UMR_NM__6_1_M34_S5_S3 4 -204 1326 DEPOSIT ABSOLUTE /end AXIS_DESCR
 /begin AXIS_DESCR STD_AXIS iSasZentr.iSchaltend.n_tkf UMR_U_MIN_32_1_0_S5_S3 4 0 8160 DEPOSIT ABSOLUTE /end AXIS_DESCR
/end CHARACTERISTIC
/begin CHARACTERISTIC KF_TSYNMTNTRAKZUWSSP75 "Zeit vor sync. Ende Schaltdruck/Start 3. Rampe KZU bei Weiterschaltung (n_tkf, m_t8)" MAP 0x1CDA68 ZF_kf_ui8_S5_S3 1280 UMR_MSEC__10_1_M128_S5_S3 -1280 0
 /begin AXIS_DESCR STD_AXIS zff_atsys._.iSignale._.obj.sig_m_t8 UMR_NM__6_1_M34_S5_S3 4 -204 1326 DEPOSIT ABSOLUTE /end AXIS_DESCR
 /begin AXIS_DESCR STD_AXIS iSasZentr.iSchaltend.n_tkf UMR_U_MIN_32_1_0_S5_S3 4 0 8160 DEPOSIT ABSOLUTE /end AXIS_DESCR
/end CHARACTERISTIC
/begin CHARACTERISTIC KF_TSYNMTNTRAKZUWSSP82 "Zeit vor sync. Ende Schaltdruck/Start 3. Rampe KZU bei Weiterschaltung (n_tkf, m_t8)" MAP 0x1CDCB4 ZF_kf_ui8_S5_S3 1280 UMR_MSEC__10_1_M128_S5_S3 -1280 0
 /begin AXIS_DESCR STD_AXIS zff_atsys._.iSignale._.obj.sig_m_t8 UMR_NM__6_1_M34_S5_S3 4 -204 1326 DEPOSIT ABSOLUTE /end AXIS_DESCR
 /begin AXIS_DESCR STD_AXIS iSasZentr.iSchaltend.n_tkf UMR_U_MIN_32_1_0_S5_S3 4 0 8160 DEPOSIT ABSOLUTE /end AXIS_DESCR
/end CHARACTERISTIC
/begin CHARACTERISTIC KF_TSYNMTNTRAKZUWSSP84 "Zeit vor sync. Ende Schaltdruck/Start 3. Rampe KZU bei Weiterschaltung (n_tkf, m_t8)" MAP 0x1CDF00 ZF_kf_ui8_S5_S3 1280 UMR_MSEC__10_1_M128_S5_S3 -1280 0
 /begin AXIS_DESCR STD_AXIS zff_atsys._.iSignale._.obj.sig_m_t8 UMR_NM__6_1_M34_S5_S3 4 -204 1326 DEPOSIT ABSOLUTE /end AXIS_DESCR
 /begin AXIS_DESCR STD_AXIS iSasZentr.iSchaltend.n_tkf UMR_U_MIN_32_1_0_S5_S3 4 0 8160 DEPOSIT ABSOLUTE /end AXIS_DESCR
/end CHARACTERISTIC
/begin CHARACTERISTIC KF_TSYNMTNTRAKZUWSSP86 "Zeit vor sync. Ende Schaltdruck/Start 3. Rampe KZU bei Weiterschaltung (n_tkf, m_t8)" MAP 0x1CE14C ZF_kf_ui8_S5_S3 1280 UMR_MSEC__10_1_M128_S5_S3 -1280 0
 /begin AXIS_DESCR STD_AXIS zff_atsys._.iSignale._.obj.sig_m_t8 UMR_NM__6_1_M34_S5_S3 4 -204 1326 DEPOSIT ABSOLUTE /end AXIS_DESCR
 /begin AXIS_DESCR STD_AXIS iSasZentr.iSchaltend.n_tkf UMR_U_MIN_32_1_0_S5_S3 4 0 8160 DEPOSIT ABSOLUTE /end AXIS_DESCR
/end CHARACTERISTIC
/begin CHARACTERISTIC KL_CGVERZPOSVUEB "Verzoegerungszeit vor Start der Ueberwachung POSV" CURVE 0x1CF5AC ZF_kl_ui16_S5_S3 655350 UMR_MSEC__10_1_0_S5_S3 0 655350
 /begin AXIS_DESCR STD_AXIS zff_atsys._.iSignale._.obj.sig_c_getr UMR_GRADC__1_1_M40_S5_S3 4 -40 160 DEPOSIT ABSOLUTE /end AXIS_DESCR
/end CHARACTERISTIC
/begin CHARACTERISTIC KL_F_VGETRAUF "Faktorisierungskennfeld" CURVE 0x1CF770 ZF_kl_ui16_S5_S3 1 UMR___1_100_0_S5_S3 0 1
 /begin AXIS_DESCR STD_AXIS NO_INPUT_QUANTITY UMR_KM_H_1_1_0_S5_S3 4 0 400 DEPOSIT ABSOLUTE /end AXIS_DESCR
/end CHARACTERISTIC
/begin CHARACTERISTIC KL_IEDSMAXOFFCG_BEF1_A "Offset auf Stromschwelle zur Erkennung eines EDS-Logik-Fehlers bei 1. Befüllung" CURVE 0x1CF7F4 ZF_kl_si16_S5_S3 1200 UMR_MA__1_10_0_S5_S3 0 1200
 /begin AXIS_DESCR STD_AXIS iUl2ItfipInt.c_getr_l2 UMR_GRADC__1_1_M40_S5_S3 6 -40 215 DEPOSIT ABSOLUTE /end AXIS_DESCR
/end CHARACTERISTIC
/begin CHARACTERISTIC KL_IEDSMAXOFFCG_BEF1_B "Offset auf Stromschwelle zur Erkennung eines EDS-Logik-Fehlers bei 1. Befüllung" CURVE 0x1CF8F8 ZF_kl_si16_S5_S3 1200 UMR_MA__1_10_0_S5_S3 0 1200
 /begin AXIS_DESCR STD_AXIS iUl2ItfipInt.c_getr_l2 UMR_GRADC__1_1_M40_S5_S3 6 -40 215 DEPOSIT ABSOLUTE /end AXIS_DESCR
/end CHARACTERISTIC
/begin CHARACTERISTIC KL_IGOUWIGOB12 "Offset auf obere Uebersetzungschwelle bei Schaltung" CURVE 0x1CEEA0 ZF_kl_ui16_S5_S3 65.535 UMR___1_1000_0_S5_S3 0 65.535
 /begin AXIS_DESCR STD_AXIS zff_atsys._.iSignale._.obj.sig_n_ab UMR_U_MIN_1_1_0_S5_S3 8 0 8160 DEPOSIT ABSOLUTE /end AXIS_DESCR
/end CHARACTERISTIC
/begin CHARACTERISTIC KL_IGOUWIGOB21 "Offset auf obere Uebersetzungschwelle bei Schaltung" CURVE 0x1CF098 ZF_kl_ui16_S5_S3 65.535 UMR___1_1000_0_S5_S3 0 65.535
 /begin AXIS_DESCR STD_AXIS zff_atsys._.iSignale._.obj.sig_n_ab UMR_U_MIN_1_1_0_S5_S3 8 0 8160 DEPOSIT ABSOLUTE /end AXIS_DESCR
/end CHARACTERISTIC
/begin CHARACTERISTIC KL_IGOUWIGOB23 "Offset auf obere Uebersetzungschwelle bei Schaltung" CURVE 0x1CEEE8 ZF_kl_ui16_S5_S3 65.535 UMR___1_1000_0_S5_S3 0 65.535
 /begin AXIS_DESCR STD_AXIS zff_atsys._.iSignale._.obj.sig_n_ab UMR_U_MIN_1_1_0_S5_S3 8 0 8160 DEPOSIT ABSOLUTE /end AXIS_DESCR
/end CHARACTERISTIC
/begin CHARACTERISTIC KL_IGOUWIGOB31 "Offset auf obere Uebersetzungschwelle bei Schaltung" CURVE 0x1CF290 ZF_kl_ui16_S5_S3 65.535 UMR___1_1000_0_S5_S3 0 65.535
 /begin AXIS_DESCR STD_AXIS zff_atsys._.iSignale._.obj.sig_n_ab UMR_U_MIN_1_1_0_S5_S3 8 0 8160 DEPOSIT ABSOLUTE /end AXIS_DESCR
/end CHARACTERISTIC
/begin CHARACTERISTIC KL_IGOUWIGOB32 "Offset auf obere Uebersetzungschwelle bei Schaltung" CURVE 0x1CF0E0 ZF_kl_ui16_S5_S3 65.535 UMR___1_1000_0_S5_S3 0 65.535
 /begin AXIS_DESCR STD_AXIS zff_atsys._.iSignale._.obj.sig_n_ab UMR_U_MIN_1_1_0_S5_S3 8 0 8160 DEPOSIT ABSOLUTE /end AXIS_DESCR
/end CHARACTERISTIC
/begin CHARACTERISTIC KL_IGOUWIGOB34 "Offset auf obere Uebersetzungschwelle bei Schaltung" CURVE 0x1CEF30 ZF_kl_ui16_S5_S3 65.535 UMR___1_1000_0_S5_S3 0 65.535
 /begin AXIS_DESCR STD_AXIS zff_atsys._.iSignale._.obj.sig_n_ab UMR_U_MIN_1_1_0_S5_S3 8 0 8160 DEPOSIT ABSOLUTE /end AXIS_DESCR
/end CHARACTERISTIC
/begin CHARACTERISTIC KL_IGOUWIGOB42 "Offset auf obere Uebersetzungschwelle bei Schaltung" CURVE 0x1CF2D8 ZF_kl_ui16_S5_S3 65.535 UMR___1_1000_0_S5_S3 0 65.535
 /begin AXIS_DESCR STD_AXIS zff_atsys._.iSignale._.obj.sig_n_ab UMR_U_MIN_1_1_0_S5_S3 8 0 8160 DEPOSIT ABSOLUTE /end AXIS_DESCR
/end CHARACTERISTIC
/begin CHARACTERISTIC KL_IGOUWIGOB43 "Offset auf obere Uebersetzungschwelle bei Schaltung" CURVE 0x1CF128 ZF_kl_ui16_S5_S3 65.535 UMR___1_1000_0_S5_S3 0 65.535
 /begin AXIS_DESCR STD_AXIS zff_atsys._.iSignale._.obj.sig_n_ab UMR_U_MIN_1_1_0_S5_S3 8 0 8160 DEPOSIT ABSOLUTE /end AXIS_DESCR
/end CHARACTERISTIC
/begin CHARACTERISTIC KL_IGOUWIGOB45 "Offset auf obere Uebersetzungschwelle bei Schaltung" CURVE 0x1CEF78 ZF_kl_ui16_S5_S3 65.535 UMR___1_1000_0_S5_S3 0 65.535
 /begin AXIS_DESCR STD_AXIS zff_atsys._.iSignale._.obj.sig_n_ab UMR_U_MIN_1_1_0_S5_S3 8 0 8160 DEPOSIT ABSOLUTE /end AXIS_DESCR
/end CHARACTERISTIC
/begin CHARACTERISTIC KL_IGOUWIGOB51 "Offset auf obere Uebersetzungschwelle bei Schaltung" CURVE 0x1CF320 ZF_kl_ui16_S5_S3 65.535 UMR___1_1000_0_S5_S3 0 65.535
 /begin AXIS_DESCR STD_AXIS zff_atsys._.iSignale._.obj.sig_n_ab UMR_U_MIN_1_1_0_S5_S3 8 0 8160 DEPOSIT ABSOLUTE /end AXIS_DESCR
/end CHARACTERISTIC
/begin CHARACTERISTIC KL_IGOUWIGOB53 "Offset auf obere Uebersetzungschwelle bei Schaltung" CURVE 0x1CF368 ZF_kl_ui16_S5_S3 65.535 UMR___1_1000_0_S5_S3 0 65.535
 /begin AXIS_DESCR STD_AXIS zff_atsys._.iSignale._.obj.sig_n_ab UMR_U_MIN_1_1_0_S5_S3 8 0 8160 DEPOSIT ABSOLUTE /end AXIS_DESCR
/end CHARACTERISTIC
/begin CHARACTERISTIC KL_IGOUWIGOB54 "Offset auf obere Uebersetzungschwelle bei Schaltung" CURVE 0x1CF170 ZF_kl_ui16_S5_S3 65.535 UMR___1_1000_0_S5_S3 0 65.535
 /begin AXIS_DESCR STD_AXIS zff_atsys._.iSignale._.obj.sig_n_ab UMR_U_MIN_1_1_0_S5_S3 8 0 8160 DEPOSIT ABSOLUTE /end AXIS_DESCR
/end CHARACTERISTIC
/begin CHARACTERISTIC KL_IGOUWIGOB56 "Offset auf obere Uebersetzungschwelle bei Schaltung" CURVE 0x1CEFC0 ZF_kl_ui16_S5_S3 65.535 UMR___1_1000_0_S5_S3 0 65.535
 /begin AXIS_DESCR STD_AXIS zff_atsys._.iSignale._.obj.sig_n_ab UMR_U_MIN_1_1_0_S5_S3 8 0 8160 DEPOSIT ABSOLUTE /end AXIS_DESCR
/end CHARACTERISTIC
/begin CHARACTERISTIC KL_IGOUWIGOB63 "Offset auf obere Uebersetzungschwelle bei Schaltung" CURVE 0x1CF3B0 ZF_kl_ui16_S5_S3 65.535 UMR___1_1000_0_S5_S3 0 65.535
 /begin AXIS_DESCR STD_AXIS zff_atsys._.iSignale._.obj.sig_n_ab UMR_U_MIN_1_1_0_S5_S3 8 0 8160 DEPOSIT ABSOLUTE /end AXIS_DESCR
/end CHARACTERISTIC
/begin CHARACTERISTIC KL_IGOUWIGOB64 "Offset auf obere Uebersetzungschwelle bei Schaltung" CURVE 0x1CF3F8 ZF_kl_ui16_S5_S3 65.535 UMR___1_1000_0_S5_S3 0 65.535
 /begin AXIS_DESCR STD_AXIS zff_atsys._.iSignale._.obj.sig_n_ab UMR_U_MIN_1_1_0_S5_S3 8 0 8160 DEPOSIT ABSOLUTE /end AXIS_DESCR
/end CHARACTERISTIC
/begin CHARACTERISTIC KL_IGOUWIGOB65 "Offset auf obere Uebersetzungschwelle bei Schaltung" CURVE 0x1CF1B8 ZF_kl_ui16_S5_S3 65.535 UMR___1_1000_0_S5_S3 0 65.535
 /begin AXIS_DESCR STD_AXIS zff_atsys._.iSignale._.obj.sig_n_ab UMR_U_MIN_1_1_0_S5_S3 8 0 8160 DEPOSIT ABSOLUTE /end AXIS_DESCR
/end CHARACTERISTIC
/begin CHARACTERISTIC KL_IGOUWIGOB67 "Offset auf obere Uebersetzungschwelle bei Schaltung" CURVE 0x1CF008 ZF_kl_ui16_S5_S3 65.535 UMR___1_1000_0_S5_S3 0 65.535
 /begin AXIS_DESCR STD_AXIS zff_atsys._.iSignale._.obj.sig_n_ab UMR_U_MIN_1_1_0_S5_S3 8 0 8160 DEPOSIT ABSOLUTE /end AXIS_DESCR
/end CHARACTERISTIC
/begin CHARACTERISTIC KL_IGOUWIGOB71 "Offset auf obere Uebersetzungschwelle bei Schaltung" CURVE 0x1CF440 ZF_kl_ui16_S5_S3 65.535 UMR___1_1000_0_S5_S3 0 65.535
 /begin AXIS_DESCR STD_AXIS zff_atsys._.iSignale._.obj.sig_n_ab UMR_U_MIN_1_1_0_S5_S3 8 0 8160 DEPOSIT ABSOLUTE /end AXIS_DESCR
/end CHARACTERISTIC
/begin CHARACTERISTIC KL_IGOUWIGOB75 "Offset auf obere Uebersetzungschwelle bei Schaltung" CURVE 0x1CF488 ZF_kl_ui16_S5_S3 65.535 UMR___1_1000_0_S5_S3 0 65.535
 /begin AXIS_DESCR STD_AXIS zff_atsys._.iSignale._.obj.sig_n_ab UMR_U_MIN_1_1_0_S5_S3 8 0 8160 DEPOSIT ABSOLUTE /end AXIS_DESCR
/end CHARACTERISTIC
/begin CHARACTERISTIC KL_IGOUWIGOB76 "Offset auf obere Uebersetzungschwelle bei Schaltung" CURVE 0x1CF200 ZF_kl_ui16_S5_S3 65.535 UMR___1_1000_0_S5_S3 0 65.535
 /begin AXIS_DESCR STD_AXIS zff_atsys._.iSignale._.obj.sig_n_ab UMR_U_MIN_1_1_0_S5_S3 8 0 8160 DEPOSIT ABSOLUTE /end AXIS_DESCR
/end CHARACTERISTIC
/begin CHARACTERISTIC KL_IGOUWIGOB78 "Offset auf obere Uebersetzungschwelle bei Schaltung" CURVE 0x1CF050 ZF_kl_ui16_S5_S3 65.535 UMR___1_1000_0_S5_S3 0 65.535
 /begin AXIS_DESCR STD_AXIS zff_atsys._.iSignale._.obj.sig_n_ab UMR_U_MIN_1_1_0_S5_S3 8 0 8160 DEPOSIT ABSOLUTE /end AXIS_DESCR
/end CHARACTERISTIC
/begin CHARACTERISTIC KL_IGOUWIGOB82 "Offset auf obere Uebersetzungschwelle bei Schaltung" CURVE 0x1CF4D0 ZF_kl_ui16_S5_S3 65.535 UMR___1_1000_0_S5_S3 0 65.535
 /begin AXIS_DESCR STD_AXIS zff_atsys._.iSignale._.obj.sig_n_ab UMR_U_MIN_1_1_0_S5_S3 8 0 8160 DEPOSIT ABSOLUTE /end AXIS_DESCR
/end CHARACTERISTIC
/begin CHARACTERISTIC KL_IGOUWIGOB84 "Offset auf obere Uebersetzungschwelle bei Schaltung" CURVE 0x1CF518 ZF_kl_ui16_S5_S3 65.535 UMR___1_1000_0_S5_S3 0 65.535
 /begin AXIS_DESCR STD_AXIS zff_atsys._.iSignale._.obj.sig_n_ab UMR_U_MIN_1_1_0_S5_S3 8 0 8160 DEPOSIT ABSOLUTE /end AXIS_DESCR
/end CHARACTERISTIC
/begin CHARACTERISTIC KL_IGOUWIGOB86 "Offset auf obere Uebersetzungschwelle bei Schaltung" CURVE 0x1CF560 ZF_kl_ui16_S5_S3 65.535 UMR___1_1000_0_S5_S3 0 65.535
 /begin AXIS_DESCR STD_AXIS zff_atsys._.iSignale._.obj.sig_n_ab UMR_U_MIN_1_1_0_S5_S3 8 0 8160 DEPOSIT ABSOLUTE /end AXIS_DESCR
/end CHARACTERISTIC
/begin CHARACTERISTIC KL_IGOUWIGOB87 "Offset auf obere Uebersetzungschwelle bei Schaltung" CURVE 0x1CF248 ZF_kl_ui16_S5_S3 65.535 UMR___1_1000_0_S5_S3 0 65.535
 /begin AXIS_DESCR STD_AXIS zff_atsys._.iSignale._.obj.sig_n_ab UMR_U_MIN_1_1_0_S5_S3 8 0 8160 DEPOSIT ABSOLUTE /end AXIS_DESCR
/end CHARACTERISTIC
/begin CHARACTERISTIC KL_IGOUWIGUN12 "Offset auf untere Uebersetzungschwelle bei Schaltung" CURVE 0x1CEEC4 ZF_kl_ui16_S5_S3 65.535 UMR___1_1000_0_S5_S3 0 65.535
 /begin AXIS_DESCR STD_AXIS zff_atsys._.iSignale._.obj.sig_n_ab UMR_U_MIN_1_1_0_S5_S3 8 0 8160 DEPOSIT ABSOLUTE /end AXIS_DESCR
/end CHARACTERISTIC
/begin CHARACTERISTIC KL_IGOUWIGUN21 "Offset auf untere Uebersetzungschwelle bei Schaltung" CURVE 0x1CF0BC ZF_kl_ui16_S5_S3 65.535 UMR___1_1000_0_S5_S3 0 65.535
 /begin AXIS_DESCR STD_AXIS zff_atsys._.iSignale._.obj.sig_n_ab UMR_U_MIN_1_1_0_S5_S3 8 0 8160 DEPOSIT ABSOLUTE /end AXIS_DESCR
/end CHARACTERISTIC
/begin CHARACTERISTIC KL_IGOUWIGUN23 "Offset auf untere Uebersetzungschwelle bei Schaltung" CURVE 0x1CEF0C ZF_kl_ui16_S5_S3 65.535 UMR___1_1000_0_S5_S3 0 65.535
 /begin AXIS_DESCR STD_AXIS zff_atsys._.iSignale._.obj.sig_n_ab UMR_U_MIN_1_1_0_S5_S3 8 0 8160 DEPOSIT ABSOLUTE /end AXIS_DESCR
/end CHARACTERISTIC
/begin CHARACTERISTIC KL_IGOUWIGUN31 "Offset auf untere Uebersetzungschwelle bei Schaltung" CURVE 0x1CF2B4 ZF_kl_ui16_S5_S3 65.535 UMR___1_1000_0_S5_S3 0 65.535
 /begin AXIS_DESCR STD_AXIS zff_atsys._.iSignale._.obj.sig_n_ab UMR_U_MIN_1_1_0_S5_S3 8 0 8160 DEPOSIT ABSOLUTE /end AXIS_DESCR
/end CHARACTERISTIC
/begin CHARACTERISTIC KL_IGOUWIGUN32 "Offset auf untere Uebersetzungschwelle bei Schaltung" CURVE 0x1CF104 ZF_kl_ui16_S5_S3 65.535 UMR___1_1000_0_S5_S3 0 65.535
 /begin AXIS_DESCR STD_AXIS zff_atsys._.iSignale._.obj.sig_n_ab UMR_U_MIN_1_1_0_S5_S3 8 0 8160 DEPOSIT ABSOLUTE /end AXIS_DESCR
/end CHARACTERISTIC
/begin CHARACTERISTIC KL_IGOUWIGUN34 "Offset auf untere Uebersetzungschwelle bei Schaltung" CURVE 0x1CEF54 ZF_kl_ui16_S5_S3 65.535 UMR___1_1000_0_S5_S3 0 65.535
 /begin AXIS_DESCR STD_AXIS zff_atsys._.iSignale._.obj.sig_n_ab UMR_U_MIN_1_1_0_S5_S3 8 0 8160 DEPOSIT ABSOLUTE /end AXIS_DESCR
/end CHARACTERISTIC
/begin CHARACTERISTIC KL_IGOUWIGUN42 "Offset auf untere Uebersetzungschwelle bei Schaltung" CURVE 0x1CF2FC ZF_kl_ui16_S5_S3 65.535 UMR___1_1000_0_S5_S3 0 65.535
 /begin AXIS_DESCR STD_AXIS zff_atsys._.iSignale._.obj.sig_n_ab UMR_U_MIN_1_1_0_S5_S3 8 0 8160 DEPOSIT ABSOLUTE /end AXIS_DESCR
/end CHARACTERISTIC
/begin CHARACTERISTIC KL_IGOUWIGUN43 "Offset auf untere Uebersetzungschwelle bei Schaltung" CURVE 0x1CF14C ZF_kl_ui16_S5_S3 65.535 UMR___1_1000_0_S5_S3 0 65.535
 /begin AXIS_DESCR STD_AXIS zff_atsys._.iSignale._.obj.sig_n_ab UMR_U_MIN_1_1_0_S5_S3 8 0 8160 DEPOSIT ABSOLUTE /end AXIS_DESCR
/end CHARACTERISTIC
/begin CHARACTERISTIC KL_IGOUWIGUN45 "Offset auf untere Uebersetzungschwelle bei Schaltung" CURVE 0x1CEF9C ZF_kl_ui16_S5_S3 65.535 UMR___1_1000_0_S5_S3 0 65.535
 /begin AXIS_DESCR STD_AXIS zff_atsys._.iSignale._.obj.sig_n_ab UMR_U_MIN_1_1_0_S5_S3 8 0 8160 DEPOSIT ABSOLUTE /end AXIS_DESCR
/end CHARACTERISTIC
/begin CHARACTERISTIC KL_IGOUWIGUN51 "Offset auf untere Uebersetzungschwelle bei Schaltung" CURVE 0x1CF344 ZF_kl_ui16_S5_S3 65.535 UMR___1_1000_0_S5_S3 0 65.535
 /begin AXIS_DESCR STD_AXIS zff_atsys._.iSignale._.obj.sig_n_ab UMR_U_MIN_1_1_0_S5_S3 8 0 8160 DEPOSIT ABSOLUTE /end AXIS_DESCR
/end CHARACTERISTIC
/begin CHARACTERISTIC KL_IGOUWIGUN53 "Offset auf untere Uebersetzungschwelle bei Schaltung" CURVE 0x1CF38C ZF_kl_ui16_S5_S3 65.535 UMR___1_1000_0_S5_S3 0 65.535
 /begin AXIS_DESCR STD_AXIS zff_atsys._.iSignale._.obj.sig_n_ab UMR_U_MIN_1_1_0_S5_S3 8 0 8160 DEPOSIT ABSOLUTE /end AXIS_DESCR
/end CHARACTERISTIC
/begin CHARACTERISTIC KL_IGOUWIGUN54 "Offset auf untere Uebersetzungschwelle bei Schaltung" CURVE 0x1CF194 ZF_kl_ui16_S5_S3 65.535 UMR___1_1000_0_S5_S3 0 65.535
 /begin AXIS_DESCR STD_AXIS zff_atsys._.iSignale._.obj.sig_n_ab UMR_U_MIN_1_1_0_S5_S3 8 0 8160 DEPOSIT ABSOLUTE /end AXIS_DESCR
/end CHARACTERISTIC
/begin CHARACTERISTIC KL_IGOUWIGUN56 "Offset auf untere Uebersetzungschwelle bei Schaltung" CURVE 0x1CEFE4 ZF_kl_ui16_S5_S3 65.535 UMR___1_1000_0_S5_S3 0 65.535
 /begin AXIS_DESCR STD_AXIS zff_atsys._.iSignale._.obj.sig_n_ab UMR_U_MIN_1_1_0_S5_S3 8 0 8160 DEPOSIT ABSOLUTE /end AXIS_DESCR
/end CHARACTERISTIC
/begin CHARACTERISTIC KL_IGOUWIGUN63 "Offset auf untere Uebersetzungschwelle bei Schaltung" CURVE 0x1CF3D4 ZF_kl_ui16_S5_S3 65.535 UMR___1_1000_0_S5_S3 0 65.535
 /begin AXIS_DESCR STD_AXIS zff_atsys._.iSignale._.obj.sig_n_ab UMR_U_MIN_1_1_0_S5_S3 8 0 8160 DEPOSIT ABSOLUTE /end AXIS_DESCR
/end CHARACTERISTIC
/begin CHARACTERISTIC KL_IGOUWIGUN64 "Offset auf untere Uebersetzungschwelle bei Schaltung" CURVE 0x1CF41C ZF_kl_ui16_S5_S3 65.535 UMR___1_1000_0_S5_S3 0 65.535
 /begin AXIS_DESCR STD_AXIS zff_atsys._.iSignale._.obj.sig_n_ab UMR_U_MIN_1_1_0_S5_S3 8 0 8160 DEPOSIT ABSOLUTE /end AXIS_DESCR
/end CHARACTERISTIC
/begin CHARACTERISTIC KL_IGOUWIGUN65 "Offset auf untere Uebersetzungschwelle bei Schaltung" CURVE 0x1CF1DC ZF_kl_ui16_S5_S3 65.535 UMR___1_1000_0_S5_S3 0 65.535
 /begin AXIS_DESCR STD_AXIS zff_atsys._.iSignale._.obj.sig_n_ab UMR_U_MIN_1_1_0_S5_S3 8 0 8160 DEPOSIT ABSOLUTE /end AXIS_DESCR
/end CHARACTERISTIC
/begin CHARACTERISTIC KL_IGOUWIGUN67 "Offset auf untere Uebersetzungschwelle bei Schaltung" CURVE 0x1CF02C ZF_kl_ui16_S5_S3 65.535 UMR___1_1000_0_S5_S3 0 65.535
 /begin AXIS_DESCR STD_AXIS zff_atsys._.iSignale._.obj.sig_n_ab UMR_U_MIN_1_1_0_S5_S3 8 0 8160 DEPOSIT ABSOLUTE /end AXIS_DESCR
/end CHARACTERISTIC
/begin CHARACTERISTIC KL_IGOUWIGUN71 "Offset auf untere Uebersetzungschwelle bei Schaltung" CURVE 0x1CF464 ZF_kl_ui16_S5_S3 65.535 UMR___1_1000_0_S5_S3 0 65.535
 /begin AXIS_DESCR STD_AXIS zff_atsys._.iSignale._.obj.sig_n_ab UMR_U_MIN_1_1_0_S5_S3 8 0 8160 DEPOSIT ABSOLUTE /end AXIS_DESCR
/end CHARACTERISTIC
/begin CHARACTERISTIC KL_IGOUWIGUN75 "Offset auf untere Uebersetzungschwelle bei Schaltung" CURVE 0x1CF4AC ZF_kl_ui16_S5_S3 65.535 UMR___1_1000_0_S5_S3 0 65.535
 /begin AXIS_DESCR STD_AXIS zff_atsys._.iSignale._.obj.sig_n_ab UMR_U_MIN_1_1_0_S5_S3 8 0 8160 DEPOSIT ABSOLUTE /end AXIS_DESCR
/end CHARACTERISTIC
/begin CHARACTERISTIC KL_IGOUWIGUN76 "Offset auf untere Uebersetzungschwelle bei Schaltung" CURVE 0x1CF224 ZF_kl_ui16_S5_S3 65.535 UMR___1_1000_0_S5_S3 0 65.535
 /begin AXIS_DESCR STD_AXIS zff_atsys._.iSignale._.obj.sig_n_ab UMR_U_MIN_1_1_0_S5_S3 8 0 8160 DEPOSIT ABSOLUTE /end AXIS_DESCR
/end CHARACTERISTIC
/begin CHARACTERISTIC KL_IGOUWIGUN78 "Offset auf untere Uebersetzungschwelle bei Schaltung" CURVE 0x1CF074 ZF_kl_ui16_S5_S3 65.535 UMR___1_1000_0_S5_S3 0 65.535
 /begin AXIS_DESCR STD_AXIS zff_atsys._.iSignale._.obj.sig_n_ab UMR_U_MIN_1_1_0_S5_S3 8 0 8160 DEPOSIT ABSOLUTE /end AXIS_DESCR
/end CHARACTERISTIC
/begin CHARACTERISTIC KL_IGOUWIGUN82 "Offset auf untere Uebersetzungschwelle bei Schaltung" CURVE 0x1CF4F4 ZF_kl_ui16_S5_S3 65.535 UMR___1_1000_0_S5_S3 0 65.535
 /begin AXIS_DESCR STD_AXIS zff_atsys._.iSignale._.obj.sig_n_ab UMR_U_MIN_1_1_0_S5_S3 8 0 8160 DEPOSIT ABSOLUTE /end AXIS_DESCR
/end CHARACTERISTIC
/begin CHARACTERISTIC KL_IGOUWIGUN84 "Offset auf untere Uebersetzungschwelle bei Schaltung" CURVE 0x1CF53C ZF_kl_ui16_S5_S3 65.535 UMR___1_1000_0_S5_S3 0 65.535
 /begin AXIS_DESCR STD_AXIS zff_atsys._.iSignale._.obj.sig_n_ab UMR_U_MIN_1_1_0_S5_S3 8 0 8160 DEPOSIT ABSOLUTE /end AXIS_DESCR
/end CHARACTERISTIC
/begin CHARACTERISTIC KL_IGOUWIGUN86 "Offset auf untere Uebersetzungschwelle bei Schaltung" CURVE 0x1CF584 ZF_kl_ui16_S5_S3 65.535 UMR___1_1000_0_S5_S3 0 65.535
 /begin AXIS_DESCR STD_AXIS zff_atsys._.iSignale._.obj.sig_n_ab UMR_U_MIN_1_1_0_S5_S3 8 0 8160 DEPOSIT ABSOLUTE /end AXIS_DESCR
/end CHARACTERISTIC
/begin CHARACTERISTIC KL_IGOUWIGUN87 "Offset auf untere Uebersetzungschwelle bei Schaltung" CURVE 0x1CF26C ZF_kl_ui16_S5_S3 65.535 UMR___1_1000_0_S5_S3 0 65.535
 /begin AXIS_DESCR STD_AXIS zff_atsys._.iSignale._.obj.sig_n_ab UMR_U_MIN_1_1_0_S5_S3 8 0 8160 DEPOSIT ABSOLUTE /end AXIS_DESCR
/end CHARACTERISTIC
/begin CHARACTERISTIC KL_I_MAXK0 "ASIL-B: Stromschwelle für KO-Erkennung" CURVE 0x1CF5E0 ZF_kl_ui16_S5_S3 1200 UMR_MA__1_10_0_S5_S3 0 1200
 /begin AXIS_DESCR STD_AXIS NO_INPUT_QUANTITY UMR___1_1000_0_S5_S3 8 0 65.535 DEPOSIT ABSOLUTE /end AXIS_DESCR
/end CHARACTERISTIC
/begin CHARACTERISTIC KL_MAXSTOER_EDSLOGIK_K0 "ASIL-C: Störzähler zur Fehlererkennung der K0" CURVE 0x1CF628 ZF_kl_ui16_S5_S3 255 UMR___1_1_0_S5_S3 0 255
 /begin AXIS_DESCR STD_AXIS NO_INPUT_QUANTITY UMR_MA__1_10_0_S5_S3 6 0 1200 DEPOSIT ABSOLUTE /end AXIS_DESCR
/end CHARACTERISTIC
/begin CHARACTERISTIC KL_MAX_STOEROFFCG_BEF1_A "Minimale Druckreglerstromschwelle fuer EDS" CURVE 0x1CF878 ZF_kl_ui8_S5_S3 255 UMR___1_1_0_S5_S3 0 255
 /begin AXIS_DESCR STD_AXIS iUl2ItfipInt.c_getr_l2 UMR_GRADC__1_1_M40_S5_S3 6 -40 215 DEPOSIT ABSOLUTE /end AXIS_DESCR
/end CHARACTERISTIC
/begin CHARACTERISTIC KL_MAX_STOEROFFCG_BEF1_B "Minimale Druckreglerstromschwelle fuer EDS" CURVE 0x1CF97C ZF_kl_ui8_S5_S3 255 UMR___1_1_0_S5_S3 0 255
 /begin AXIS_DESCR STD_AXIS iUl2ItfipInt.c_getr_l2 UMR_GRADC__1_1_M40_S5_S3 6 -40 215 DEPOSIT ABSOLUTE /end AXIS_DESCR
/end CHARACTERISTIC
/begin CHARACTERISTIC KL_M_REIB_K0 "ASIL-B: Abstützendes Moment an der Strasse" CURVE 0x1CF604 ZF_kl_ui16_S5_S3 1200 UMR_NM__1_1_0_S5_S3 0 1200
 /begin AXIS_DESCR STD_AXIS NO_INPUT_QUANTITY UMR___1_1000_0_S5_S3 8 0 65.535 DEPOSIT ABSOLUTE /end AXIS_DESCR
/end CHARACTERISTIC
/begin CHARACTERISTIC KL_N_DIFF_K0_MIN "ASIL-C: minimale Differenzdrehzahl an der K0" CURVE 0x1CF644 ZF_kl_ui16_S5_S3 4000 UMR_U_MIN_1_1_0_S5_S3 0 4000
 /begin AXIS_DESCR STD_AXIS NO_INPUT_QUANTITY UMR___1_1000_0_S5_S3 8 0 65.535 DEPOSIT ABSOLUTE /end AXIS_DESCR
/end CHARACTERISTIC
/begin CHARACTERISTIC KL_PGOKZU65 "Druckgradient in Abhaengigkeit von m_t" CURVE 0x1CC208 ZF_kl_si16_S5_S3 200 UMR_BAR_SEC_1_10_0_S5_S3 -100 100
 /begin AXIS_DESCR STD_AXIS zff_atsys._.iSignale._.obj.sig_m_t UMR_NM__1_1_0_S5_S3 6 -200 1300 DEPOSIT ABSOLUTE /end AXIS_DESCR
/end CHARACTERISTIC
/begin CHARACTERISTIC KL_PGOKZU76 "Druckgradient in Abhaengigkeit von m_t" CURVE 0x1CC454 ZF_kl_si16_S5_S3 200 UMR_BAR_SEC_1_10_0_S5_S3 -100 100
 /begin AXIS_DESCR STD_AXIS zff_atsys._.iSignale._.obj.sig_m_t UMR_NM__1_1_0_S5_S3 6 -200 1300 DEPOSIT ABSOLUTE /end AXIS_DESCR
/end CHARACTERISTIC
/begin CHARACTERISTIC KL_PGOKZU87 "Druckgradient in Abhaengigkeit von m_t" CURVE 0x1CC6A0 ZF_kl_si16_S5_S3 200 UMR_BAR_SEC_1_10_0_S5_S3 -100 100
 /begin AXIS_DESCR STD_AXIS zff_atsys._.iSignale._.obj.sig_m_t UMR_NM__1_1_0_S5_S3 6 -200 1300 DEPOSIT ABSOLUTE /end AXIS_DESCR
/end CHARACTERISTIC
/begin CHARACTERISTIC KL_PGOKZUSP64 "Druckgradient in Abhaengigkeit von m_t" CURVE 0x1CD468 ZF_kl_si16_S5_S3 200 UMR_BAR_SEC_1_10_0_S5_S3 -100 100
 /begin AXIS_DESCR STD_AXIS zff_atsys._.iSignale._.obj.sig_m_t UMR_NM__1_1_0_S5_S3 6 -200 1300 DEPOSIT ABSOLUTE /end AXIS_DESCR
/end CHARACTERISTIC
/begin CHARACTERISTIC KL_PGOKZUSP71 "Druckgradient in Abhaengigkeit von m_t" CURVE 0x1CD6B4 ZF_kl_si16_S5_S3 200 UMR_BAR_SEC_1_10_0_S5_S3 -100 100
 /begin AXIS_DESCR STD_AXIS zff_atsys._.iSignale._.obj.sig_m_t UMR_NM__1_1_0_S5_S3 6 -200 1300 DEPOSIT ABSOLUTE /end AXIS_DESCR
/end CHARACTERISTIC
/begin CHARACTERISTIC KL_PGOKZUSP75 "Druckgradient in Abhaengigkeit von m_t" CURVE 0x1CD900 ZF_kl_si16_S5_S3 200 UMR_BAR_SEC_1_10_0_S5_S3 -100 100
 /begin AXIS_DESCR STD_AXIS zff_atsys._.iSignale._.obj.sig_m_t UMR_NM__1_1_0_S5_S3 6 -200 1300 DEPOSIT ABSOLUTE /end AXIS_DESCR
/end CHARACTERISTIC
/begin CHARACTERISTIC KL_PGOKZUSP82 "Druckgradient in Abhaengigkeit von m_t" CURVE 0x1CDB4C ZF_kl_si16_S5_S3 200 UMR_BAR_SEC_1_10_0_S5_S3 -100 100
 /begin AXIS_DESCR STD_AXIS zff_atsys._.iSignale._.obj.sig_m_t UMR_NM__1_1_0_S5_S3 6 -200 1300 DEPOSIT ABSOLUTE /end AXIS_DESCR
/end CHARACTERISTIC
/begin CHARACTERISTIC KL_PGOKZUSP84 "Druckgradient in Abhaengigkeit von m_t" CURVE 0x1CDD98 ZF_kl_si16_S5_S3 200 UMR_BAR_SEC_1_10_0_S5_S3 -100 100
 /begin AXIS_DESCR STD_AXIS zff_atsys._.iSignale._.obj.sig_m_t UMR_NM__1_1_0_S5_S3 6 -200 1300 DEPOSIT ABSOLUTE /end AXIS_DESCR
/end CHARACTERISTIC
/begin CHARACTERISTIC KL_PGOKZUSP86 "Druckgradient in Abhaengigkeit von m_t" CURVE 0x1CDFE4 ZF_kl_si16_S5_S3 200 UMR_BAR_SEC_1_10_0_S5_S3 -100 100
 /begin AXIS_DESCR STD_AXIS zff_atsys._.iSignale._.obj.sig_m_t UMR_NM__1_1_0_S5_S3 6 -200 1300 DEPOSIT ABSOLUTE /end AXIS_DESCR
/end CHARACTERISTIC
/begin CHARACTERISTIC KL_PGOKZUWS65 "Druckgradient in Abhaengigkeit von m_t" CURVE 0x1CC224 ZF_kl_si16_S5_S3 200 UMR_BAR_SEC_1_10_0_S5_S3 -100 100
 /begin AXIS_DESCR STD_AXIS zff_atsys._.iSignale._.obj.sig_m_t UMR_NM__1_1_0_S5_S3 6 -200 1300 DEPOSIT ABSOLUTE /end AXIS_DESCR
/end CHARACTERISTIC
/begin CHARACTERISTIC KL_PGOKZUWS76 "Druckgradient in Abhaengigkeit von m_t" CURVE 0x1CC470 ZF_kl_si16_S5_S3 200 UMR_BAR_SEC_1_10_0_S5_S3 -100 100
 /begin AXIS_DESCR STD_AXIS zff_atsys._.iSignale._.obj.sig_m_t UMR_NM__1_1_0_S5_S3 6 -200 1300 DEPOSIT ABSOLUTE /end AXIS_DESCR
/end CHARACTERISTIC
/begin CHARACTERISTIC KL_PGOKZUWS87 "Druckgradient in Abhaengigkeit von m_t" CURVE 0x1CC6BC ZF_kl_si16_S5_S3 200 UMR_BAR_SEC_1_10_0_S5_S3 -100 100
 /begin AXIS_DESCR STD_AXIS zff_atsys._.iSignale._.obj.sig_m_t UMR_NM__1_1_0_S5_S3 6 -200 1300 DEPOSIT ABSOLUTE /end AXIS_DESCR
/end CHARACTERISTIC
/begin CHARACTERISTIC KL_PGOKZUWSSP64 "Druckgradient in Abhaengigkeit von m_t" CURVE 0x1CD484 ZF_kl_si16_S5_S3 200 UMR_BAR_SEC_1_10_0_S5_S3 -100 100
 /begin AXIS_DESCR STD_AXIS zff_atsys._.iSignale._.obj.sig_m_t UMR_NM__1_1_0_S5_S3 6 -200 1300 DEPOSIT ABSOLUTE /end AXIS_DESCR
/end CHARACTERISTIC
/begin CHARACTERISTIC KL_PGOKZUWSSP71 "Druckgradient in Abhaengigkeit von m_t" CURVE 0x1CD6D0 ZF_kl_si16_S5_S3 200 UMR_BAR_SEC_1_10_0_S5_S3 -100 100
 /begin AXIS_DESCR STD_AXIS zff_atsys._.iSignale._.obj.sig_m_t UMR_NM__1_1_0_S5_S3 6 -200 1300 DEPOSIT ABSOLUTE /end AXIS_DESCR
/end CHARACTERISTIC
/begin CHARACTERISTIC KL_PGOKZUWSSP75 "Druckgradient in Abhaengigkeit von m_t" CURVE 0x1CD91C ZF_kl_si16_S5_S3 200 UMR_BAR_SEC_1_10_0_S5_S3 -100 100
 /begin AXIS_DESCR STD_AXIS zff_atsys._.iSignale._.obj.sig_m_t UMR_NM__1_1_0_S5_S3 6 -200 1300 DEPOSIT ABSOLUTE /end AXIS_DESCR
/end CHARACTERISTIC
/begin CHARACTERISTIC KL_PGOKZUWSSP82 "Druckgradient in Abhaengigkeit von m_t" CURVE 0x1CDB68 ZF_kl_si16_S5_S3 200 UMR_BAR_SEC_1_10_0_S5_S3 -100 100
 /begin AXIS_DESCR STD_AXIS zff_atsys._.iSignale._.obj.sig_m_t UMR_NM__1_1_0_S5_S3 6 -200 1300 DEPOSIT ABSOLUTE /end AXIS_DESCR
/end CHARACTERISTIC
/begin CHARACTERISTIC KL_PGOKZUWSSP84 "Druckgradient in Abhaengigkeit von m_t" CURVE 0x1CDDB4 ZF_kl_si16_S5_S3 200 UMR_BAR_SEC_1_10_0_S5_S3 -100 100
 /begin AXIS_DESCR STD_AXIS zff_atsys._.iSignale._.obj.sig_m_t UMR_NM__1_1_0_S5_S3 6 -200 1300 DEPOSIT ABSOLUTE /end AXIS_DESCR
/end CHARACTERISTIC
/begin CHARACTERISTIC KL_PGOKZUWSSP86 "Druckgradient in Abhaengigkeit von m_t" CURVE 0x1CE000 ZF_kl_si16_S5_S3 200 UMR_BAR_SEC_1_10_0_S5_S3 -100 100
 /begin AXIS_DESCR STD_AXIS zff_atsys._.iSignale._.obj.sig_m_t UMR_NM__1_1_0_S5_S3 6 -200 1300 DEPOSIT ABSOLUTE /end AXIS_DESCR
/end CHARACTERISTIC
/begin CHARACTERISTIC KL_PGRASYN65 "Schliessrampenradient" CURVE 0x1CC240 ZF_kl_si16_S5_S3 6553.4 UMR_BAR_SEC_1_10_0_S5_S3 -3276.7 3276.7
 /begin AXIS_DESCR STD_AXIS zff_atsys._.iSignale._.obj.sig_m_t UMR_NM__1_1_0_S5_S3 6 -200 1300 DEPOSIT ABSOLUTE /end AXIS_DESCR
/end CHARACTERISTIC
/begin CHARACTERISTIC KL_PGRASYN76 "Schliessrampenradient" CURVE 0x1CC48C ZF_kl_si16_S5_S3 6553.4 UMR_BAR_SEC_1_10_0_S5_S3 -3276.7 3276.7
 /begin AXIS_DESCR STD_AXIS zff_atsys._.iSignale._.obj.sig_m_t UMR_NM__1_1_0_S5_S3 6 -200 1300 DEPOSIT ABSOLUTE /end AXIS_DESCR
/end CHARACTERISTIC
/begin CHARACTERISTIC KL_PGRASYN87 "Schliessrampenradient" CURVE 0x1CC6D8 ZF_kl_si16_S5_S3 6553.4 UMR_BAR_SEC_1_10_0_S5_S3 -3276.7 3276.7
 /begin AXIS_DESCR STD_AXIS zff_atsys._.iSignale._.obj.sig_m_t UMR_NM__1_1_0_S5_S3 6 -200 1300 DEPOSIT ABSOLUTE /end AXIS_DESCR
/end CHARACTERISTIC
/begin CHARACTERISTIC KL_PGRASYNSP64 "Schliessrampenradient" CURVE 0x1CD4A0 ZF_kl_si16_S5_S3 6553.4 UMR_BAR_SEC_1_10_0_S5_S3 -3276.7 3276.7
 /begin AXIS_DESCR STD_AXIS zff_atsys._.iSignale._.obj.sig_m_t UMR_NM__1_1_0_S5_S3 6 -200 1300 DEPOSIT ABSOLUTE /end AXIS_DESCR
/end CHARACTERISTIC
/begin CHARACTERISTIC KL_PGRASYNSP71 "Schliessrampenradient" CURVE 0x1CD6EC ZF_kl_si16_S5_S3 6553.4 UMR_BAR_SEC_1_10_0_S5_S3 -3276.7 3276.7
 /begin AXIS_DESCR STD_AXIS zff_atsys._.iSignale._.obj.sig_m_t UMR_NM__1_1_0_S5_S3 6 -200 1300 DEPOSIT ABSOLUTE /end AXIS_DESCR
/end CHARACTERISTIC
/begin CHARACTERISTIC KL_PGRASYNSP75 "Schliessrampenradient" CURVE 0x1CD938 ZF_kl_si16_S5_S3 6553.4 UMR_BAR_SEC_1_10_0_S5_S3 -3276.7 3276.7
 /begin AXIS_DESCR STD_AXIS zff_atsys._.iSignale._.obj.sig_m_t UMR_NM__1_1_0_S5_S3 6 -200 1300 DEPOSIT ABSOLUTE /end AXIS_DESCR
/end CHARACTERISTIC
/begin CHARACTERISTIC KL_PGRASYNSP82 "Schliessrampenradient" CURVE 0x1CDB84 ZF_kl_si16_S5_S3 6553.4 UMR_BAR_SEC_1_10_0_S5_S3 -3276.7 3276.7
 /begin AXIS_DESCR STD_AXIS zff_atsys._.iSignale._.obj.sig_m_t UMR_NM__1_1_0_S5_S3 6 -200 1300 DEPOSIT ABSOLUTE /end AXIS_DESCR
/end CHARACTERISTIC
/begin CHARACTERISTIC KL_PGRASYNSP84 "Schliessrampenradient" CURVE 0x1CDDD0 ZF_kl_si16_S5_S3 6553.4 UMR_BAR_SEC_1_10_0_S5_S3 -3276.7 3276.7
 /begin AXIS_DESCR STD_AXIS zff_atsys._.iSignale._.obj.sig_m_t UMR_NM__1_1_0_S5_S3 6 -200 1300 DEPOSIT ABSOLUTE /end AXIS_DESCR
/end CHARACTERISTIC
/begin CHARACTERISTIC KL_PGRASYNSP86 "Schliessrampenradient" CURVE 0x1CE01C ZF_kl_si16_S5_S3 6553.4 UMR_BAR_SEC_1_10_0_S5_S3 -3276.7 3276.7
 /begin AXIS_DESCR STD_AXIS zff_atsys._.iSignale._.obj.sig_m_t UMR_NM__1_1_0_S5_S3 6 -200 1300 DEPOSIT ABSOLUTE /end AXIS_DESCR
/end CHARACTERISTIC
/begin CHARACTERISTIC KL_POFCG65 "Kennlinie Fuelldruckoffset" CURVE 0x1CC1A8 ZF_kl_si16_S5_S3 12.75 UMR_BAR__1_1000_0_S5_S3 -6.4 6.35
 /begin AXIS_DESCR STD_AXIS zff_atsys._.iSignale._.obj.sig_c_getr UMR_GRADC__1_1_M40_S5_S3 10 -40 150 DEPOSIT ABSOLUTE /end AXIS_DESCR
/end CHARACTERISTIC
/begin CHARACTERISTIC KL_POFCG76 "Kennlinie Fuelldruckoffset" CURVE 0x1CC3F4 ZF_kl_si16_S5_S3 12.75 UMR_BAR__1_1000_0_S5_S3 -6.4 6.35
 /begin AXIS_DESCR STD_AXIS zff_atsys._.iSignale._.obj.sig_c_getr UMR_GRADC__1_1_M40_S5_S3 10 -40 150 DEPOSIT ABSOLUTE /end AXIS_DESCR
/end CHARACTERISTIC
/begin CHARACTERISTIC KL_POFCG87 "Kennlinie Fuelldruckoffset" CURVE 0x1CC640 ZF_kl_si16_S5_S3 12.75 UMR_BAR__1_1000_0_S5_S3 -6.4 6.35
 /begin AXIS_DESCR STD_AXIS zff_atsys._.iSignale._.obj.sig_c_getr UMR_GRADC__1_1_M40_S5_S3 10 -40 150 DEPOSIT ABSOLUTE /end AXIS_DESCR
/end CHARACTERISTIC
/begin CHARACTERISTIC KL_POFCGSP64 "Kennlinie Fuelldruckoffset" CURVE 0x1CD408 ZF_kl_si16_S5_S3 12.75 UMR_BAR__1_1000_0_S5_S3 -6.4 6.35
 /begin AXIS_DESCR STD_AXIS zff_atsys._.iSignale._.obj.sig_c_getr UMR_GRADC__1_1_M40_S5_S3 10 -40 150 DEPOSIT ABSOLUTE /end AXIS_DESCR
/end CHARACTERISTIC
/begin CHARACTERISTIC KL_POFCGSP71 "Kennlinie Fuelldruckoffset" CURVE 0x1CD654 ZF_kl_si16_S5_S3 12.75 UMR_BAR__1_1000_0_S5_S3 -6.4 6.35
 /begin AXIS_DESCR STD_AXIS zff_atsys._.iSignale._.obj.sig_c_getr UMR_GRADC__1_1_M40_S5_S3 10 -40 150 DEPOSIT ABSOLUTE /end AXIS_DESCR
/end CHARACTERISTIC
/begin CHARACTERISTIC KL_POFCGSP75 "Kennlinie Fuelldruckoffset" CURVE 0x1CD8A0 ZF_kl_si16_S5_S3 12.75 UMR_BAR__1_1000_0_S5_S3 -6.4 6.35
 /begin AXIS_DESCR STD_AXIS zff_atsys._.iSignale._.obj.sig_c_getr UMR_GRADC__1_1_M40_S5_S3 10 -40 150 DEPOSIT ABSOLUTE /end AXIS_DESCR
/end CHARACTERISTIC
/begin CHARACTERISTIC KL_POFCGSP82 "Kennlinie Fuelldruckoffset" CURVE 0x1CDAEC ZF_kl_si16_S5_S3 12.75 UMR_BAR__1_1000_0_S5_S3 -6.4 6.35
 /begin AXIS_DESCR STD_AXIS zff_atsys._.iSignale._.obj.sig_c_getr UMR_GRADC__1_1_M40_S5_S3 10 -40 150 DEPOSIT ABSOLUTE /end AXIS_DESCR
/end CHARACTERISTIC
/begin CHARACTERISTIC KL_POFCGSP84 "Kennlinie Fuelldruckoffset" CURVE 0x1CDD38 ZF_kl_si16_S5_S3 12.75 UMR_BAR__1_1000_0_S5_S3 -6.4 6.35
 /begin AXIS_DESCR STD_AXIS zff_atsys._.iSignale._.obj.sig_c_getr UMR_GRADC__1_1_M40_S5_S3 10 -40 150 DEPOSIT ABSOLUTE /end AXIS_DESCR
/end CHARACTERISTIC
/begin CHARACTERISTIC KL_POFCGSP86 "Kennlinie Fuelldruckoffset" CURVE 0x1CDF84 ZF_kl_si16_S5_S3 12.75 UMR_BAR__1_1000_0_S5_S3 -6.4 6.35
 /begin AXIS_DESCR STD_AXIS zff_atsys._.iSignale._.obj.sig_c_getr UMR_GRADC__1_1_M40_S5_S3 10 -40 150 DEPOSIT ABSOLUTE /end AXIS_DESCR
/end CHARACTERISTIC
/begin CHARACTERISTIC KL_POFMDMOTSOLL65 "Fuelldruckoffset f(Erhoehung Motorsollmoment)" CURVE 0x1CC390 ZF_kl_si16_S5_S3 12.75 UMR_BAR__1_1000_0_S5_S3 -6.4 6.35
 /begin AXIS_DESCR STD_AXIS NO_INPUT_QUANTITY UMR_NM__1_1_0_S5_S3 6 -1500 1500 DEPOSIT ABSOLUTE /end AXIS_DESCR
/end CHARACTERISTIC
/begin CHARACTERISTIC KL_POFMDMOTSOLL76 "Fuelldruckoffset f(Erhoehung Motorsollmoment)" CURVE 0x1CC5DC ZF_kl_si16_S5_S3 12.75 UMR_BAR__1_1000_0_S5_S3 -6.4 6.35
 /begin AXIS_DESCR STD_AXIS NO_INPUT_QUANTITY UMR_NM__1_1_0_S5_S3 6 -1500 1500 DEPOSIT ABSOLUTE /end AXIS_DESCR
/end CHARACTERISTIC
/begin CHARACTERISTIC KL_POFMDMOTSOLL87 "Fuelldruckoffset f(Erhoehung Motorsollmoment)" CURVE 0x1CC828 ZF_kl_si16_S5_S3 12.75 UMR_BAR__1_1000_0_S5_S3 -6.4 6.35
 /begin AXIS_DESCR STD_AXIS NO_INPUT_QUANTITY UMR_NM__1_1_0_S5_S3 6 -1500 1500 DEPOSIT ABSOLUTE /end AXIS_DESCR
/end CHARACTERISTIC
/begin CHARACTERISTIC KL_POFMDMOTSOLLSP64 "Fuelldruckoffset f(Erhoehung Motorsollmoment)" CURVE 0x1CD5F0 ZF_kl_si16_S5_S3 12.75 UMR_BAR__1_1000_0_S5_S3 -6.4 6.35
 /begin AXIS_DESCR STD_AXIS NO_INPUT_QUANTITY UMR_NM__1_1_0_S5_S3 6 -1500 1500 DEPOSIT ABSOLUTE /end AXIS_DESCR
/end CHARACTERISTIC
/begin CHARACTERISTIC KL_POFMDMOTSOLLSP71 "Fuelldruckoffset f(Erhoehung Motorsollmoment)" CURVE 0x1CD83C ZF_kl_si16_S5_S3 12.75 UMR_BAR__1_1000_0_S5_S3 -6.4 6.35
 /begin AXIS_DESCR STD_AXIS NO_INPUT_QUANTITY UMR_NM__1_1_0_S5_S3 6 -1500 1500 DEPOSIT ABSOLUTE /end AXIS_DESCR
/end CHARACTERISTIC
/begin CHARACTERISTIC KL_POFMDMOTSOLLSP75 "Fuelldruckoffset f(Erhoehung Motorsollmoment)" CURVE 0x1CDA88 ZF_kl_si16_S5_S3 12.75 UMR_BAR__1_1000_0_S5_S3 -6.4 6.35
 /begin AXIS_DESCR STD_AXIS NO_INPUT_QUANTITY UMR_NM__1_1_0_S5_S3 6 -1500 1500 DEPOSIT ABSOLUTE /end AXIS_DESCR
/end CHARACTERISTIC
/begin CHARACTERISTIC KL_POFMDMOTSOLLSP82 "Fuelldruckoffset f(Erhoehung Motorsollmoment)" CURVE 0x1CDCD4 ZF_kl_si16_S5_S3 12.75 UMR_BAR__1_1000_0_S5_S3 -6.4 6.35
 /begin AXIS_DESCR STD_AXIS NO_INPUT_QUANTITY UMR_NM__1_1_0_S5_S3 6 -1500 1500 DEPOSIT ABSOLUTE /end AXIS_DESCR
/end CHARACTERISTIC
/begin CHARACTERISTIC KL_POFMDMOTSOLLSP84 "Fuelldruckoffset f(Erhoehung Motorsollmoment)" CURVE 0x1CDF20 ZF_kl_si16_S5_S3 12.75 UMR_BAR__1_1000_0_S5_S3 -6.4 6.35
 /begin AXIS_DESCR STD_AXIS NO_INPUT_QUANTITY UMR_NM__1_1_0_S5_S3 6 -1500 1500 DEPOSIT ABSOLUTE /end AXIS_DESCR
/end CHARACTERISTIC
/begin CHARACTERISTIC KL_POFMDMOTSOLLSP86 "Fuelldruckoffset f(Erhoehung Motorsollmoment)" CURVE 0x1CE16C ZF_kl_si16_S5_S3 12.75 UMR_BAR__1_1000_0_S5_S3 -6.4 6.35
 /begin AXIS_DESCR STD_AXIS NO_INPUT_QUANTITY UMR_NM__1_1_0_S5_S3 6 -1500 1500 DEPOSIT ABSOLUTE /end AXIS_DESCR
/end CHARACTERISTIC
/begin CHARACTERISTIC KL_POKZUCG65 "Schaltdruckoffset" CURVE 0x1CC17C ZF_kl_si16_S5_S3 12.75 UMR_BAR__1_1000_0_S5_S3 -6.4 6.35
 /begin AXIS_DESCR STD_AXIS zff_atsys._.iSignale._.obj.sig_c_getr UMR_GRADC__1_1_M40_S5_S3 10 -40 150 DEPOSIT ABSOLUTE /end AXIS_DESCR
/end CHARACTERISTIC
/begin CHARACTERISTIC KL_POKZUCG76 "Schaltdruckoffset" CURVE 0x1CC3C8 ZF_kl_si16_S5_S3 12.75 UMR_BAR__1_1000_0_S5_S3 -6.4 6.35
 /begin AXIS_DESCR STD_AXIS zff_atsys._.iSignale._.obj.sig_c_getr UMR_GRADC__1_1_M40_S5_S3 10 -40 150 DEPOSIT ABSOLUTE /end AXIS_DESCR
/end CHARACTERISTIC
/begin CHARACTERISTIC KL_POKZUCG87 "Schaltdruckoffset" CURVE 0x1CC614 ZF_kl_si16_S5_S3 12.75 UMR_BAR__1_1000_0_S5_S3 -6.4 6.35
 /begin AXIS_DESCR STD_AXIS zff_atsys._.iSignale._.obj.sig_c_getr UMR_GRADC__1_1_M40_S5_S3 10 -40 150 DEPOSIT ABSOLUTE /end AXIS_DESCR
/end CHARACTERISTIC
/begin CHARACTERISTIC KL_POKZUCGSP64 "Schaltdruckoffset" CURVE 0x1CD3DC ZF_kl_si16_S5_S3 12.75 UMR_BAR__1_1000_0_S5_S3 -6.4 6.35
 /begin AXIS_DESCR STD_AXIS zff_atsys._.iSignale._.obj.sig_c_getr UMR_GRADC__1_1_M40_S5_S3 10 -40 150 DEPOSIT ABSOLUTE /end AXIS_DESCR
/end CHARACTERISTIC
/begin CHARACTERISTIC KL_POKZUCGSP71 "Schaltdruckoffset" CURVE 0x1CD628 ZF_kl_si16_S5_S3 12.75 UMR_BAR__1_1000_0_S5_S3 -6.4 6.35
 /begin AXIS_DESCR STD_AXIS zff_atsys._.iSignale._.obj.sig_c_getr UMR_GRADC__1_1_M40_S5_S3 10 -40 150 DEPOSIT ABSOLUTE /end AXIS_DESCR
/end CHARACTERISTIC
/begin CHARACTERISTIC KL_POKZUCGSP75 "Schaltdruckoffset" CURVE 0x1CD874 ZF_kl_si16_S5_S3 12.75 UMR_BAR__1_1000_0_S5_S3 -6.4 6.35
 /begin AXIS_DESCR STD_AXIS zff_atsys._.iSignale._.obj.sig_c_getr UMR_GRADC__1_1_M40_S5_S3 10 -40 150 DEPOSIT ABSOLUTE /end AXIS_DESCR
/end CHARACTERISTIC
/begin CHARACTERISTIC KL_POKZUCGSP82 "Schaltdruckoffset" CURVE 0x1CDAC0 ZF_kl_si16_S5_S3 12.75 UMR_BAR__1_1000_0_S5_S3 -6.4 6.35
 /begin AXIS_DESCR STD_AXIS zff_atsys._.iSignale._.obj.sig_c_getr UMR_GRADC__1_1_M40_S5_S3 10 -40 150 DEPOSIT ABSOLUTE /end AXIS_DESCR
/end CHARACTERISTIC
/begin CHARACTERISTIC KL_POKZUCGSP84 "Schaltdruckoffset" CURVE 0x1CDD0C ZF_kl_si16_S5_S3 12.75 UMR_BAR__1_1000_0_S5_S3 -6.4 6.35
 /begin AXIS_DESCR STD_AXIS zff_atsys._.iSignale._.obj.sig_c_getr UMR_GRADC__1_1_M40_S5_S3 10 -40 150 DEPOSIT ABSOLUTE /end AXIS_DESCR
/end CHARACTERISTIC
/begin CHARACTERISTIC KL_POKZUCGSP86 "Schaltdruckoffset" CURVE 0x1CDF58 ZF_kl_si16_S5_S3 12.75 UMR_BAR__1_1000_0_S5_S3 -6.4 6.35
 /begin AXIS_DESCR STD_AXIS zff_atsys._.iSignale._.obj.sig_c_getr UMR_GRADC__1_1_M40_S5_S3 10 -40 150 DEPOSIT ABSOLUTE /end AXIS_DESCR
/end CHARACTERISTIC
/begin CHARACTERISTIC KL_POKZUMDMOTSOLL65 "Schaltdruckoffset in Abhaengigkeit von md_motsoll_sas" CURVE 0x1CC3AC ZF_kl_si16_S5_S3 12.75 UMR_BAR__1_1000_0_S5_S3 -6.4 6.35
 /begin AXIS_DESCR STD_AXIS NO_INPUT_QUANTITY UMR_NM__1_1_0_S5_S3 6 -1500 1500 DEPOSIT ABSOLUTE /end AXIS_DESCR
/end CHARACTERISTIC
/begin CHARACTERISTIC KL_POKZUMDMOTSOLL76 "Schaltdruckoffset in Abhaengigkeit von md_motsoll_sas" CURVE 0x1CC5F8 ZF_kl_si16_S5_S3 12.75 UMR_BAR__1_1000_0_S5_S3 -6.4 6.35
 /begin AXIS_DESCR STD_AXIS NO_INPUT_QUANTITY UMR_NM__1_1_0_S5_S3 6 -1500 1500 DEPOSIT ABSOLUTE /end AXIS_DESCR
/end CHARACTERISTIC
/begin CHARACTERISTIC KL_POKZUMDMOTSOLL87 "Schaltdruckoffset in Abhaengigkeit von md_motsoll_sas" CURVE 0x1CC844 ZF_kl_si16_S5_S3 12.75 UMR_BAR__1_1000_0_S5_S3 -6.4 6.35
 /begin AXIS_DESCR STD_AXIS NO_INPUT_QUANTITY UMR_NM__1_1_0_S5_S3 6 -1500 1500 DEPOSIT ABSOLUTE /end AXIS_DESCR
/end CHARACTERISTIC
/begin CHARACTERISTIC KL_POKZUMDMOTSOLLSP64 "Schaltdruckoffset in Abhaengigkeit von md_motsoll_sas" CURVE 0x1CD60C ZF_kl_si16_S5_S3 12.75 UMR_BAR__1_1000_0_S5_S3 -6.4 6.35
 /begin AXIS_DESCR STD_AXIS NO_INPUT_QUANTITY UMR_NM__1_1_0_S5_S3 6 -1500 1500 DEPOSIT ABSOLUTE /end AXIS_DESCR
/end CHARACTERISTIC
/begin CHARACTERISTIC KL_POKZUMDMOTSOLLSP71 "Schaltdruckoffset in Abhaengigkeit von md_motsoll_sas" CURVE 0x1CD858 ZF_kl_si16_S5_S3 12.75 UMR_BAR__1_1000_0_S5_S3 -6.4 6.35
 /begin AXIS_DESCR STD_AXIS NO_INPUT_QUANTITY UMR_NM__1_1_0_S5_S3 6 -1500 1500 DEPOSIT ABSOLUTE /end AXIS_DESCR
/end CHARACTERISTIC
/begin CHARACTERISTIC KL_POKZUMDMOTSOLLSP75 "Schaltdruckoffset in Abhaengigkeit von md_motsoll_sas" CURVE 0x1CDAA4 ZF_kl_si16_S5_S3 12.75 UMR_BAR__1_1000_0_S5_S3 -6.4 6.35
 /begin AXIS_DESCR STD_AXIS NO_INPUT_QUANTITY UMR_NM__1_1_0_S5_S3 6 -1500 1500 DEPOSIT ABSOLUTE /end AXIS_DESCR
/end CHARACTERISTIC
/begin CHARACTERISTIC KL_POKZUMDMOTSOLLSP82 "Schaltdruckoffset in Abhaengigkeit von md_motsoll_sas" CURVE 0x1CDCF0 ZF_kl_si16_S5_S3 12.75 UMR_BAR__1_1000_0_S5_S3 -6.4 6.35
 /begin AXIS_DESCR STD_AXIS NO_INPUT_QUANTITY UMR_NM__1_1_0_S5_S3 6 -1500 1500 DEPOSIT ABSOLUTE /end AXIS_DESCR
/end CHARACTERISTIC
/begin CHARACTERISTIC KL_POKZUMDMOTSOLLSP84 "Schaltdruckoffset in Abhaengigkeit von md_motsoll_sas" CURVE 0x1CDF3C ZF_kl_si16_S5_S3 12.75 UMR_BAR__1_1000_0_S5_S3 -6.4 6.35
 /begin AXIS_DESCR STD_AXIS NO_INPUT_QUANTITY UMR_NM__1_1_0_S5_S3 6 -1500 1500 DEPOSIT ABSOLUTE /end AXIS_DESCR
/end CHARACTERISTIC
/begin CHARACTERISTIC KL_POKZUMDMOTSOLLSP86 "Schaltdruckoffset in Abhaengigkeit von md_motsoll_sas" CURVE 0x1CE188 ZF_kl_si16_S5_S3 12.75 UMR_BAR__1_1000_0_S5_S3 -6.4 6.35
 /begin AXIS_DESCR STD_AXIS NO_INPUT_QUANTITY UMR_NM__1_1_0_S5_S3 6 -1500 1500 DEPOSIT ABSOLUTE /end AXIS_DESCR
/end CHARACTERISTIC
/begin CHARACTERISTIC KL_POKZUNGAB65 "Druckoffset in Abhaengigkeit von ng_ab" CURVE 0x1CC1E4 ZF_kl_si16_S5_S3 12.75 UMR_BAR__1_1000_0_S5_S3 -6.4 6.35
 /begin AXIS_DESCR STD_AXIS iItfInput.ng_ab UMR_U_MINSEC_1_1_0_S5_S3 4 -5000 1000 DEPOSIT ABSOLUTE /end AXIS_DESCR
/end CHARACTERISTIC
/begin CHARACTERISTIC KL_POKZUNGAB76 "Druckoffset in Abhaengigkeit von ng_ab" CURVE 0x1CC430 ZF_kl_si16_S5_S3 12.75 UMR_BAR__1_1000_0_S5_S3 -6.4 6.35
 /begin AXIS_DESCR STD_AXIS iItfInput.ng_ab UMR_U_MINSEC_1_1_0_S5_S3 4 -5000 1000 DEPOSIT ABSOLUTE /end AXIS_DESCR
/end CHARACTERISTIC
/begin CHARACTERISTIC KL_POKZUNGAB87 "Druckoffset in Abhaengigkeit von ng_ab" CURVE 0x1CC67C ZF_kl_si16_S5_S3 12.75 UMR_BAR__1_1000_0_S5_S3 -6.4 6.35
 /begin AXIS_DESCR STD_AXIS iItfInput.ng_ab UMR_U_MINSEC_1_1_0_S5_S3 4 -5000 1000 DEPOSIT ABSOLUTE /end AXIS_DESCR
/end CHARACTERISTIC
/begin CHARACTERISTIC KL_POKZUNGABSP64 "Druckoffset in Abhaengigkeit von ng_ab" CURVE 0x1CD444 ZF_kl_si16_S5_S3 12.75 UMR_BAR__1_1000_0_S5_S3 -6.4 6.35
 /begin AXIS_DESCR STD_AXIS iItfInput.ng_ab UMR_U_MINSEC_1_1_0_S5_S3 4 -5000 1000 DEPOSIT ABSOLUTE /end AXIS_DESCR
/end CHARACTERISTIC
/begin CHARACTERISTIC KL_POKZUNGABSP71 "Druckoffset in Abhaengigkeit von ng_ab" CURVE 0x1CD690 ZF_kl_si16_S5_S3 12.75 UMR_BAR__1_1000_0_S5_S3 -6.4 6.35
 /begin AXIS_DESCR STD_AXIS iItfInput.ng_ab UMR_U_MINSEC_1_1_0_S5_S3 4 -5000 1000 DEPOSIT ABSOLUTE /end AXIS_DESCR
/end CHARACTERISTIC
/begin CHARACTERISTIC KL_POKZUNGABSP75 "Druckoffset in Abhaengigkeit von ng_ab" CURVE 0x1CD8DC ZF_kl_si16_S5_S3 12.75 UMR_BAR__1_1000_0_S5_S3 -6.4 6.35
 /begin AXIS_DESCR STD_AXIS iItfInput.ng_ab UMR_U_MINSEC_1_1_0_S5_S3 4 -5000 1000 DEPOSIT ABSOLUTE /end AXIS_DESCR
/end CHARACTERISTIC
/begin CHARACTERISTIC KL_POKZUNGABSP82 "Druckoffset in Abhaengigkeit von ng_ab" CURVE 0x1CDB28 ZF_kl_si16_S5_S3 12.75 UMR_BAR__1_1000_0_S5_S3 -6.4 6.35
 /begin AXIS_DESCR STD_AXIS iItfInput.ng_ab UMR_U_MINSEC_1_1_0_S5_S3 4 -5000 1000 DEPOSIT ABSOLUTE /end AXIS_DESCR
/end CHARACTERISTIC
/begin CHARACTERISTIC KL_POKZUNGABSP84 "Druckoffset in Abhaengigkeit von ng_ab" CURVE 0x1CDD74 ZF_kl_si16_S5_S3 12.75 UMR_BAR__1_1000_0_S5_S3 -6.4 6.35
 /begin AXIS_DESCR STD_AXIS iItfInput.ng_ab UMR_U_MINSEC_1_1_0_S5_S3 4 -5000 1000 DEPOSIT ABSOLUTE /end AXIS_DESCR
/end CHARACTERISTIC
/begin CHARACTERISTIC KL_POKZUNGABSP86 "Druckoffset in Abhaengigkeit von ng_ab" CURVE 0x1CDFC0 ZF_kl_si16_S5_S3 12.75 UMR_BAR__1_1000_0_S5_S3 -6.4 6.35
 /begin AXIS_DESCR STD_AXIS iItfInput.ng_ab UMR_U_MINSEC_1_1_0_S5_S3 4 -5000 1000 DEPOSIT ABSOLUTE /end AXIS_DESCR
/end CHARACTERISTIC
/begin CHARACTERISTIC KL_POMDTSYN65 "Druckoffset Schliessphase f(delta_m_t seit synchron)" CURVE 0x1CC25C ZF_kl_si16_S5_S3 12 UMR_BAR__1_1000_0_S5_S3 -6 6
 /begin AXIS_DESCR STD_AXIS iSasZentr.md_tpgrasyn UMR_NM__1_1_0_S5_S3 4 -1500 1500 DEPOSIT ABSOLUTE /end AXIS_DESCR
/end CHARACTERISTIC
/begin CHARACTERISTIC KL_POMDTSYN76 "Druckoffset Schliessphase f(delta_m_t seit synchron)" CURVE 0x1CC4A8 ZF_kl_si16_S5_S3 12 UMR_BAR__1_1000_0_S5_S3 -6 6
 /begin AXIS_DESCR STD_AXIS iSasZentr.md_tpgrasyn UMR_NM__1_1_0_S5_S3 4 -1500 1500 DEPOSIT ABSOLUTE /end AXIS_DESCR
/end CHARACTERISTIC
/begin CHARACTERISTIC KL_POMDTSYN87 "Druckoffset Schliessphase f(delta_m_t seit synchron)" CURVE 0x1CC6F4 ZF_kl_si16_S5_S3 12 UMR_BAR__1_1000_0_S5_S3 -6 6
 /begin AXIS_DESCR STD_AXIS iSasZentr.md_tpgrasyn UMR_NM__1_1_0_S5_S3 4 -1500 1500 DEPOSIT ABSOLUTE /end AXIS_DESCR
/end CHARACTERISTIC
/begin CHARACTERISTIC KL_POMDTSYNSP64 "Druckoffset Schliessphase f(delta_m_t seit synchron)" CURVE 0x1CD4BC ZF_kl_si16_S5_S3 12 UMR_BAR__1_1000_0_S5_S3 -6 6
 /begin AXIS_DESCR STD_AXIS iSasZentr.md_tpgrasyn UMR_NM__1_1_0_S5_S3 4 -1500 1500 DEPOSIT ABSOLUTE /end AXIS_DESCR
/end CHARACTERISTIC
/begin CHARACTERISTIC KL_POMDTSYNSP71 "Druckoffset Schliessphase f(delta_m_t seit synchron)" CURVE 0x1CD708 ZF_kl_si16_S5_S3 12 UMR_BAR__1_1000_0_S5_S3 -6 6
 /begin AXIS_DESCR STD_AXIS iSasZentr.md_tpgrasyn UMR_NM__1_1_0_S5_S3 4 -1500 1500 DEPOSIT ABSOLUTE /end AXIS_DESCR
/end CHARACTERISTIC
/begin CHARACTERISTIC KL_POMDTSYNSP75 "Druckoffset Schliessphase f(delta_m_t seit synchron)" CURVE 0x1CD954 ZF_kl_si16_S5_S3 12 UMR_BAR__1_1000_0_S5_S3 -6 6
 /begin AXIS_DESCR STD_AXIS iSasZentr.md_tpgrasyn UMR_NM__1_1_0_S5_S3 4 -1500 1500 DEPOSIT ABSOLUTE /end AXIS_DESCR
/end CHARACTERISTIC
/begin CHARACTERISTIC KL_POMDTSYNSP82 "Druckoffset Schliessphase f(delta_m_t seit synchron)" CURVE 0x1CDBA0 ZF_kl_si16_S5_S3 12 UMR_BAR__1_1000_0_S5_S3 -6 6
 /begin AXIS_DESCR STD_AXIS iSasZentr.md_tpgrasyn UMR_NM__1_1_0_S5_S3 4 -1500 1500 DEPOSIT ABSOLUTE /end AXIS_DESCR
/end CHARACTERISTIC
/begin CHARACTERISTIC KL_POMDTSYNSP84 "Druckoffset Schliessphase f(delta_m_t seit synchron)" CURVE 0x1CDDEC ZF_kl_si16_S5_S3 12 UMR_BAR__1_1000_0_S5_S3 -6 6
 /begin AXIS_DESCR STD_AXIS iSasZentr.md_tpgrasyn UMR_NM__1_1_0_S5_S3 4 -1500 1500 DEPOSIT ABSOLUTE /end AXIS_DESCR
/end CHARACTERISTIC
/begin CHARACTERISTIC KL_POMDTSYNSP86 "Druckoffset Schliessphase f(delta_m_t seit synchron)" CURVE 0x1CE038 ZF_kl_si16_S5_S3 12 UMR_BAR__1_1000_0_S5_S3 -6 6
 /begin AXIS_DESCR STD_AXIS iSasZentr.md_tpgrasyn UMR_NM__1_1_0_S5_S3 4 -1500 1500 DEPOSIT ABSOLUTE /end AXIS_DESCR
/end CHARACTERISTIC
/begin CHARACTERISTIC KL_PORAKZU65 "Schaltdruckoffset" CURVE 0x1CC1F8 ZF_kl_si16_S5_S3 12.75 UMR_BAR__1_1000_0_S5_S3 -6.4 6.35
 /begin AXIS_DESCR STD_AXIS iSasZentr.iSchaltend.iKzu.timer_zkzu UMR_MSEC__10_1_0_S5_S3 3 0 2540 DEPOSIT ABSOLUTE /end AXIS_DESCR
/end CHARACTERISTIC
/begin CHARACTERISTIC KL_PORAKZU76 "Schaltdruckoffset" CURVE 0x1CC444 ZF_kl_si16_S5_S3 12.75 UMR_BAR__1_1000_0_S5_S3 -6.4 6.35
 /begin AXIS_DESCR STD_AXIS iSasZentr.iSchaltend.iKzu.timer_zkzu UMR_MSEC__10_1_0_S5_S3 3 0 2540 DEPOSIT ABSOLUTE /end AXIS_DESCR
/end CHARACTERISTIC
/begin CHARACTERISTIC KL_PORAKZU87 "Schaltdruckoffset" CURVE 0x1CC690 ZF_kl_si16_S5_S3 12.75 UMR_BAR__1_1000_0_S5_S3 -6.4 6.35
 /begin AXIS_DESCR STD_AXIS iSasZentr.iSchaltend.iKzu.timer_zkzu UMR_MSEC__10_1_0_S5_S3 3 0 2540 DEPOSIT ABSOLUTE /end AXIS_DESCR
/end CHARACTERISTIC
/begin CHARACTERISTIC KL_PORAKZUSP64 "Schaltdruckoffset" CURVE 0x1CD458 ZF_kl_si16_S5_S3 12.75 UMR_BAR__1_1000_0_S5_S3 -6.4 6.35
 /begin AXIS_DESCR STD_AXIS iSasZentr.iSchaltend.iKzu.timer_zkzu UMR_MSEC__10_1_0_S5_S3 3 0 2540 DEPOSIT ABSOLUTE /end AXIS_DESCR
/end CHARACTERISTIC
/begin CHARACTERISTIC KL_PORAKZUSP71 "Schaltdruckoffset" CURVE 0x1CD6A4 ZF_kl_si16_S5_S3 12.75 UMR_BAR__1_1000_0_S5_S3 -6.4 6.35
 /begin AXIS_DESCR STD_AXIS iSasZentr.iSchaltend.iKzu.timer_zkzu UMR_MSEC__10_1_0_S5_S3 3 0 2540 DEPOSIT ABSOLUTE /end AXIS_DESCR
/end CHARACTERISTIC
/begin CHARACTERISTIC KL_PORAKZUSP75 "Schaltdruckoffset" CURVE 0x1CD8F0 ZF_kl_si16_S5_S3 12.75 UMR_BAR__1_1000_0_S5_S3 -6.4 6.35
 /begin AXIS_DESCR STD_AXIS iSasZentr.iSchaltend.iKzu.timer_zkzu UMR_MSEC__10_1_0_S5_S3 3 0 2540 DEPOSIT ABSOLUTE /end AXIS_DESCR
/end CHARACTERISTIC
/begin CHARACTERISTIC KL_PORAKZUSP82 "Schaltdruckoffset" CURVE 0x1CDB3C ZF_kl_si16_S5_S3 12.75 UMR_BAR__1_1000_0_S5_S3 -6.4 6.35
 /begin AXIS_DESCR STD_AXIS iSasZentr.iSchaltend.iKzu.timer_zkzu UMR_MSEC__10_1_0_S5_S3 3 0 2540 DEPOSIT ABSOLUTE /end AXIS_DESCR
/end CHARACTERISTIC
/begin CHARACTERISTIC KL_PORAKZUSP84 "Schaltdruckoffset" CURVE 0x1CDD88 ZF_kl_si16_S5_S3 12.75 UMR_BAR__1_1000_0_S5_S3 -6.4 6.35
 /begin AXIS_DESCR STD_AXIS iSasZentr.iSchaltend.iKzu.timer_zkzu UMR_MSEC__10_1_0_S5_S3 3 0 2540 DEPOSIT ABSOLUTE /end AXIS_DESCR
/end CHARACTERISTIC
/begin CHARACTERISTIC KL_PORAKZUSP86 "Schaltdruckoffset" CURVE 0x1CDFD4 ZF_kl_si16_S5_S3 12.75 UMR_BAR__1_1000_0_S5_S3 -6.4 6.35
 /begin AXIS_DESCR STD_AXIS iSasZentr.iSchaltend.iKzu.timer_zkzu UMR_MSEC__10_1_0_S5_S3 3 0 2540 DEPOSIT ABSOLUTE /end AXIS_DESCR
/end CHARACTERISTIC
/begin CHARACTERISTIC KL_PORASYN65 "Rampe n.Syn.->l.Stuetzst. y PMAX" CURVE 0x1CC1D4 ZF_kl_si16_S5_S3 12.75 UMR_BAR__1_1000_0_S5_S3 0 12.75
 /begin AXIS_DESCR STD_AXIS iSasZentr.iSchaltend.iKzu.timer_zkzu UMR_MSEC__10_1_0_S5_S3 3 0 2540 DEPOSIT ABSOLUTE /end AXIS_DESCR
/end CHARACTERISTIC
/begin CHARACTERISTIC KL_PORASYN76 "Rampe n.Syn.->l.Stuetzst. y PMAX" CURVE 0x1CC420 ZF_kl_si16_S5_S3 12.75 UMR_BAR__1_1000_0_S5_S3 0 12.75
 /begin AXIS_DESCR STD_AXIS iSasZentr.iSchaltend.iKzu.timer_zkzu UMR_MSEC__10_1_0_S5_S3 3 0 2540 DEPOSIT ABSOLUTE /end AXIS_DESCR
/end CHARACTERISTIC
/begin CHARACTERISTIC KL_PORASYN87 "Rampe n.Syn.->l.Stuetzst. y PMAX" CURVE 0x1CC66C ZF_kl_si16_S5_S3 12.75 UMR_BAR__1_1000_0_S5_S3 0 12.75
 /begin AXIS_DESCR STD_AXIS iSasZentr.iSchaltend.iKzu.timer_zkzu UMR_MSEC__10_1_0_S5_S3 3 0 2540 DEPOSIT ABSOLUTE /end AXIS_DESCR
/end CHARACTERISTIC
/begin CHARACTERISTIC KL_PORASYNSP64 "Rampe n.Syn.->l.Stuetzst. y PMAX" CURVE 0x1CD434 ZF_kl_si16_S5_S3 12.75 UMR_BAR__1_1000_0_S5_S3 0 12.75
 /begin AXIS_DESCR STD_AXIS iSasZentr.iSchaltend.iKzu.timer_zkzu UMR_MSEC__10_1_0_S5_S3 3 0 2540 DEPOSIT ABSOLUTE /end AXIS_DESCR
/end CHARACTERISTIC
/begin CHARACTERISTIC KL_PORASYNSP71 "Rampe n.Syn.->l.Stuetzst. y PMAX" CURVE 0x1CD680 ZF_kl_si16_S5_S3 12.75 UMR_BAR__1_1000_0_S5_S3 0 12.75
 /begin AXIS_DESCR STD_AXIS iSasZentr.iSchaltend.iKzu.timer_zkzu UMR_MSEC__10_1_0_S5_S3 3 0 2540 DEPOSIT ABSOLUTE /end AXIS_DESCR
/end CHARACTERISTIC
/begin CHARACTERISTIC KL_PORASYNSP75 "Rampe n.Syn.->l.Stuetzst. y PMAX" CURVE 0x1CD8CC ZF_kl_si16_S5_S3 12.75 UMR_BAR__1_1000_0_S5_S3 0 12.75
 /begin AXIS_DESCR STD_AXIS iSasZentr.iSchaltend.iKzu.timer_zkzu UMR_MSEC__10_1_0_S5_S3 3 0 2540 DEPOSIT ABSOLUTE /end AXIS_DESCR
/end CHARACTERISTIC
/begin CHARACTERISTIC KL_PORASYNSP82 "Rampe n.Syn.->l.Stuetzst. y PMAX" CURVE 0x1CDB18 ZF_kl_si16_S5_S3 12.75 UMR_BAR__1_1000_0_S5_S3 0 12.75
 /begin AXIS_DESCR STD_AXIS iSasZentr.iSchaltend.iKzu.timer_zkzu UMR_MSEC__10_1_0_S5_S3 3 0 2540 DEPOSIT ABSOLUTE /end AXIS_DESCR
/end CHARACTERISTIC
/begin CHARACTERISTIC KL_PORASYNSP84 "Rampe n.Syn.->l.Stuetzst. y PMAX" CURVE 0x1CDD64 ZF_kl_si16_S5_S3 12.75 UMR_BAR__1_1000_0_S5_S3 0 12.75
 /begin AXIS_DESCR STD_AXIS iSasZentr.iSchaltend.iKzu.timer_zkzu UMR_MSEC__10_1_0_S5_S3 3 0 2540 DEPOSIT ABSOLUTE /end AXIS_DESCR
/end CHARACTERISTIC
/begin CHARACTERISTIC KL_PORASYNSP86 "Rampe n.Syn.->l.Stuetzst. y PMAX" CURVE 0x1CDFB0 ZF_kl_si16_S5_S3 12.75 UMR_BAR__1_1000_0_S5_S3 0 12.75
 /begin AXIS_DESCR STD_AXIS iSasZentr.iSchaltend.iKzu.timer_zkzu UMR_MSEC__10_1_0_S5_S3 3 0 2540 DEPOSIT ABSOLUTE /end AXIS_DESCR
/end CHARACTERISTIC
/begin CHARACTERISTIC KL_POSYSCG "Druckoffset auf Systemdruck in Abh. der Getriebeoeltemperatur" CURVE 0x1CE3F8 ZF_kl_si16_S5_S3 20 UMR_BAR__1_1000_0_S5_S3 -10 10
 /begin AXIS_DESCR STD_AXIS zff_atsys._.iSignale._.obj.sig_c_getr UMR_GRADC__1_1_M40_S5_S3 8 -40 150 DEPOSIT ABSOLUTE /end AXIS_DESCR
/end CHARACTERISTIC
/begin CHARACTERISTIC KL_PPUMPE_SYS "p_pumpe_sys fuer Minauswahl mit psys-gefiltert für p_sysist" CURVE 0x1CE494 ZF_kl_ui16_S5_S3 22 UMR_BAR__1_1000_0_S5_S3 0 22
 /begin AXIS_DESCR STD_AXIS zff_atsys._.iSignale._.obj.sig_n_mot UMR_U_MIN_1_1_0_S5_S3 4 0 8160 DEPOSIT ABSOLUTE /end AXIS_DESCR
/end CHARACTERISTIC
/begin CHARACTERISTIC KL_QVERBR_KUEHL "Ölvolumen Druckregler bei Kuehloelanforderung" CURVE 0x1CE4B8 ZF_kl_si16_S5_S3 20 UMR_LITER_MIN_1_10_0_S5_S3 0 20
 /begin AXIS_DESCR STD_AXIS iIaeKuehl.p_kuehl_soll_iae UMR_BAR__1_1000_0_S5_S3 4 -8 8 DEPOSIT ABSOLUTE /end AXIS_DESCR
/end CHARACTERISTIC
/begin CHARACTERISTIC KL_TFPSYSIST "Filterzeit fuer Systemistdruck" CURVE 0x1CE484 ZF_kl_ui16_S5_S3 2540 UMR_MSEC__1_1_0_S5_S3 0 2540
 /begin AXIS_DESCR STD_AXIS zff_atsys._.iSignale._.obj.sig_c_getr UMR_GRADC__1_1_M40_S5_S3 3 -40 150 DEPOSIT ABSOLUTE /end AXIS_DESCR
/end CHARACTERISTIC
/begin CHARACTERISTIC KL_TMAXPSYS "Zeit für Ansteuerung max. Systemdruck zur Vermeidung f. Druckeinbrüchen" CURVE 0x1CE3E4 ZF_kl_ui16_S5_S3 100 UMR_MSEC__10_1_0_S5_S3 0 100
 /begin AXIS_DESCR STD_AXIS zff_atsys._.iSignale._.obj.sig_n_mot UMR_U_MIN_1_1_0_S5_S3 4 0 8160 DEPOSIT ABSOLUTE /end AXIS_DESCR
/end CHARACTERISTIC
/begin CHARACTERISTIC KL_TMAXSYMIEP "Zeitdauer innerhalb der bei keiner Erkennung eines Symptoms die IEP als defekt erkannt wird" CURVE 0x1CE548 ZF_kl_ui8_S5_S3 2550 UMR_MSEC__10_1_0_S5_S3 0 2550
 /begin AXIS_DESCR STD_AXIS zff_atsys._.iSignale._.obj.sig_c_getr UMR_GRADC__1_1_M40_S5_S3 5 -40 215 DEPOSIT ABSOLUTE /end AXIS_DESCR
/end CHARACTERISTIC
/begin CHARACTERISTIC KL_TMINVERZCG_POSVUEB "Ausblendzeit der POSV nach Zündung aus über Neuestart" CURVE 0x1CF5C0 ZF_kl_ui16_S5_S3 655350 UMR_MSEC__10_1_0_S5_S3 0 655350
 /begin AXIS_DESCR STD_AXIS zff_atsys._.iSignale._.obj.sig_c_getr UMR_GRADC__1_1_M40_S5_S3 4 -40 215 DEPOSIT ABSOLUTE /end AXIS_DESCR
/end CHARACTERISTIC
/begin CHARACTERISTIC KL_TSNABESTARTSTART "Aktivierungszeit Fenster für Sonderfunktion MSA Start" CURVE 0x1CE524 ZF_kl_ui16_S5_S3 10000 UMR_MSEC__10_1_0_S5_S3 0 10000
 /begin AXIS_DESCR STD_AXIS zff_atsys._.iSignale._.obj.sig_n_ab UMR_U_MIN_1_1_0_S5_S3 4 0 8160 DEPOSIT ABSOLUTE /end AXIS_DESCR
/end CHARACTERISTIC
/begin CHARACTERISTIC KL_TSYNCGRAKZU65 "Zeit vor sync. Ende Schaltdruck/Start 3. Rampe KZU" CURVE 0x1CC364 ZF_kl_ui8_S5_S3 1280 UMR_MSEC__10_1_M128_S5_S3 -1280 0
 /begin AXIS_DESCR STD_AXIS zff_atsys._.iSignale._.obj.sig_c_getr UMR_GRADC__1_1_M40_S5_S3 4 -40 215 DEPOSIT ABSOLUTE /end AXIS_DESCR
/end CHARACTERISTIC
/begin CHARACTERISTIC KL_TSYNCGRAKZU76 "Zeit vor sync. Ende Schaltdruck/Start 3. Rampe KZU" CURVE 0x1CC5B0 ZF_kl_ui8_S5_S3 1280 UMR_MSEC__10_1_M128_S5_S3 -1280 0
 /begin AXIS_DESCR STD_AXIS zff_atsys._.iSignale._.obj.sig_c_getr UMR_GRADC__1_1_M40_S5_S3 4 -40 215 DEPOSIT ABSOLUTE /end AXIS_DESCR
/end CHARACTERISTIC
/begin CHARACTERISTIC KL_TSYNCGRAKZU87 "Zeit vor sync. Ende Schaltdruck/Start 3. Rampe KZU" CURVE 0x1CC7FC ZF_kl_ui8_S5_S3 1280 UMR_MSEC__10_1_M128_S5_S3 -1280 0
 /begin AXIS_DESCR STD_AXIS zff_atsys._.iSignale._.obj.sig_c_getr UMR_GRADC__1_1_M40_S5_S3 4 -40 215 DEPOSIT ABSOLUTE /end AXIS_DESCR
/end CHARACTERISTIC
/begin CHARACTERISTIC KL_TSYNCGRAKZUSP64 "Zeit vor sync. Ende Schaltdruck/Start 3. Rampe KZU" CURVE 0x1CD5C4 ZF_kl_ui8_S5_S3 1280 UMR_MSEC__10_1_M128_S5_S3 -1280 0
 /begin AXIS_DESCR STD_AXIS zff_atsys._.iSignale._.obj.sig_c_getr UMR_GRADC__1_1_M40_S5_S3 4 -40 215 DEPOSIT ABSOLUTE /end AXIS_DESCR
/end CHARACTERISTIC
/begin CHARACTERISTIC KL_TSYNCGRAKZUSP71 "Zeit vor sync. Ende Schaltdruck/Start 3. Rampe KZU" CURVE 0x1CD810 ZF_kl_ui8_S5_S3 1280 UMR_MSEC__10_1_M128_S5_S3 -1280 0
 /begin AXIS_DESCR STD_AXIS zff_atsys._.iSignale._.obj.sig_c_getr UMR_GRADC__1_1_M40_S5_S3 4 -40 215 DEPOSIT ABSOLUTE /end AXIS_DESCR
/end CHARACTERISTIC
/begin CHARACTERISTIC KL_TSYNCGRAKZUSP75 "Zeit vor sync. Ende Schaltdruck/Start 3. Rampe KZU" CURVE 0x1CDA5C ZF_kl_ui8_S5_S3 1280 UMR_MSEC__10_1_M128_S5_S3 -1280 0
 /begin AXIS_DESCR STD_AXIS zff_atsys._.iSignale._.obj.sig_c_getr UMR_GRADC__1_1_M40_S5_S3 4 -40 215 DEPOSIT ABSOLUTE /end AXIS_DESCR
/end CHARACTERISTIC
/begin CHARACTERISTIC KL_TSYNCGRAKZUSP82 "Zeit vor sync. Ende Schaltdruck/Start 3. Rampe KZU" CURVE 0x1CDCA8 ZF_kl_ui8_S5_S3 1280 UMR_MSEC__10_1_M128_S5_S3 -1280 0
 /begin AXIS_DESCR STD_AXIS zff_atsys._.iSignale._.obj.sig_c_getr UMR_GRADC__1_1_M40_S5_S3 4 -40 215 DEPOSIT ABSOLUTE /end AXIS_DESCR
/end CHARACTERISTIC
/begin CHARACTERISTIC KL_TSYNCGRAKZUSP84 "Zeit vor sync. Ende Schaltdruck/Start 3. Rampe KZU" CURVE 0x1CDEF4 ZF_kl_ui8_S5_S3 1280 UMR_MSEC__10_1_M128_S5_S3 -1280 0
 /begin AXIS_DESCR STD_AXIS zff_atsys._.iSignale._.obj.sig_c_getr UMR_GRADC__1_1_M40_S5_S3 4 -40 215 DEPOSIT ABSOLUTE /end AXIS_DESCR
/end CHARACTERISTIC
/begin CHARACTERISTIC KL_TSYNCGRAKZUSP86 "Zeit vor sync. Ende Schaltdruck/Start 3. Rampe KZU" CURVE 0x1CE140 ZF_kl_ui8_S5_S3 1280 UMR_MSEC__10_1_M128_S5_S3 -1280 0
 /begin AXIS_DESCR STD_AXIS zff_atsys._.iSignale._.obj.sig_c_getr UMR_GRADC__1_1_M40_S5_S3 4 -40 215 DEPOSIT ABSOLUTE /end AXIS_DESCR
/end CHARACTERISTIC
/begin CHARACTERISTIC KL_TUEBCGPOSVMECHDEF "Ueberwachungszeit schlafender POSV Fehler" CURVE 0x1CF5D4 ZF_kl_ui8_S5_S3 2550 UMR_MSEC__10_1_0_S5_S3 0 2550
 /begin AXIS_DESCR STD_AXIS zff_atsys._.iSignale._.obj.sig_c_getr UMR_GRADC__1_1_M40_S5_S3 4 -40 160 DEPOSIT ABSOLUTE /end AXIS_DESCR
/end CHARACTERISTIC
/begin CHARACTERISTIC KL_TVERZSYMIEP "Verzögerungszeit die zum Hochfahren der E-Maschine und zur Druckversorgung benötigt wird" CURVE 0x1CE538 ZF_kl_ui8_S5_S3 2550 UMR_MSEC__10_1_0_S5_S3 0 2550
 /begin AXIS_DESCR STD_AXIS zff_atsys._.iSignale._.obj.sig_c_getr UMR_GRADC__1_1_M40_S5_S3 5 -40 215 DEPOSIT ABSOLUTE /end AXIS_DESCR
/end CHARACTERISTIC
/begin CHARACTERISTIC KL_UWIGOBERS_1 "Ersatzwert obere Uebersetzungsschwelle fuer UWIG im Gang" CURVE 0x1CE6FC ZF_kl_ui16_S5_S3 65.535 UMR___1_1000_0_S5_S3 0 65.535
 /begin AXIS_DESCR STD_AXIS zff_atsys._.iSignale._.obj.sig_n_ab UMR_U_MIN_1_1_0_S5_S3 8 0 8160 DEPOSIT ABSOLUTE /end AXIS_DESCR
/end CHARACTERISTIC
/begin CHARACTERISTIC KL_UWIGOBERS_2 "Ersatzwert obere Uebersetzungsschwelle fuer UWIG im Gang" CURVE 0x1CE804 ZF_kl_ui16_S5_S3 65.535 UMR___1_1000_0_S5_S3 0 65.535
 /begin AXIS_DESCR STD_AXIS zff_atsys._.iSignale._.obj.sig_n_ab UMR_U_MIN_1_1_0_S5_S3 8 0 8160 DEPOSIT ABSOLUTE /end AXIS_DESCR
/end CHARACTERISTIC
/begin CHARACTERISTIC KL_UWIGOBERS_3 "Ersatzwert obere Uebersetzungsschwelle fuer UWIG im Gang" CURVE 0x1CE90C ZF_kl_ui16_S5_S3 65.535 UMR___1_1000_0_S5_S3 0 65.535
 /begin AXIS_DESCR STD_AXIS zff_atsys._.iSignale._.obj.sig_n_ab UMR_U_MIN_1_1_0_S5_S3 8 0 8160 DEPOSIT ABSOLUTE /end AXIS_DESCR
/end CHARACTERISTIC
/begin CHARACTERISTIC KL_UWIGOBERS_4 "Ersatzwert obere Uebersetzungsschwelle fuer UWIG im Gang" CURVE 0x1CEA14 ZF_kl_ui16_S5_S3 65.535 UMR___1_1000_0_S5_S3 0 65.535
 /begin AXIS_DESCR STD_AXIS zff_atsys._.iSignale._.obj.sig_n_ab UMR_U_MIN_1_1_0_S5_S3 8 0 8160 DEPOSIT ABSOLUTE /end AXIS_DESCR
/end CHARACTERISTIC
/begin CHARACTERISTIC KL_UWIGOBERS_5 "Ersatzwert obere Uebersetzungsschwelle fuer UWIG im Gang" CURVE 0x1CEB1C ZF_kl_ui16_S5_S3 65.535 UMR___1_1000_0_S5_S3 0 65.535
 /begin AXIS_DESCR STD_AXIS zff_atsys._.iSignale._.obj.sig_n_ab UMR_U_MIN_1_1_0_S5_S3 8 0 8160 DEPOSIT ABSOLUTE /end AXIS_DESCR
/end CHARACTERISTIC
/begin CHARACTERISTIC KL_UWIGOBERS_6 "Ersatzwert obere Uebersetzungsschwelle fuer UWIG im Gang" CURVE 0x1CEC24 ZF_kl_ui16_S5_S3 65.535 UMR___1_1000_0_S5_S3 0 65.535
 /begin AXIS_DESCR STD_AXIS zff_atsys._.iSignale._.obj.sig_n_ab UMR_U_MIN_1_1_0_S5_S3 8 0 8160 DEPOSIT ABSOLUTE /end AXIS_DESCR
/end CHARACTERISTIC
/begin CHARACTERISTIC KL_UWIGOBERS_7 "Ersatzwert obere Uebersetzungsschwelle fuer UWIG im Gang" CURVE 0x1CED2C ZF_kl_ui16_S5_S3 65.535 UMR___1_1000_0_S5_S3 0 65.535
 /begin AXIS_DESCR STD_AXIS zff_atsys._.iSignale._.obj.sig_n_ab UMR_U_MIN_1_1_0_S5_S3 8 0 8160 DEPOSIT ABSOLUTE /end AXIS_DESCR
/end CHARACTERISTIC
/begin CHARACTERISTIC KL_UWIGOBERS_8 "Ersatzwert obere Uebersetzungsschwelle fuer UWIG im Gang" CURVE 0x1CEE34 ZF_kl_ui16_S5_S3 65.535 UMR___1_1000_0_S5_S3 0 65.535
 /begin AXIS_DESCR STD_AXIS zff_atsys._.iSignale._.obj.sig_n_ab UMR_U_MIN_1_1_0_S5_S3 8 0 8160 DEPOSIT ABSOLUTE /end AXIS_DESCR
/end CHARACTERISTIC
/begin CHARACTERISTIC KL_UWIGOBERS_R "Ersatzwert obere Uebersetzungsschwelle fuer UWIG im Gang" CURVE 0x1CE5F4 ZF_kl_ui16_S5_S3 65.535 UMR___1_1000_0_S5_S3 0 65.535
 /begin AXIS_DESCR STD_AXIS zff_atsys._.iSignale._.obj.sig_n_ab UMR_U_MIN_1_1_0_S5_S3 8 0 8160 DEPOSIT ABSOLUTE /end AXIS_DESCR
/end CHARACTERISTIC
/begin CHARACTERISTIC KL_UWIGOB_1 "obere Uebersetzungsschwelle fuer UWIG im Gang" CURVE 0x1CE6D8 ZF_kl_ui16_S5_S3 65.535 UMR___1_1000_0_S5_S3 0 65.535
 /begin AXIS_DESCR STD_AXIS zff_atsys._.iSignale._.obj.sig_n_ab UMR_U_MIN_1_1_0_S5_S3 8 0 8160 DEPOSIT ABSOLUTE /end AXIS_DESCR
/end CHARACTERISTIC
/begin CHARACTERISTIC KL_UWIGOB_2 "obere Uebersetzungsschwelle fuer UWIG im Gang" CURVE 0x1CE7E0 ZF_kl_ui16_S5_S3 65.535 UMR___1_1000_0_S5_S3 0 65.535
 /begin AXIS_DESCR STD_AXIS zff_atsys._.iSignale._.obj.sig_n_ab UMR_U_MIN_1_1_0_S5_S3 8 0 8160 DEPOSIT ABSOLUTE /end AXIS_DESCR
/end CHARACTERISTIC
/begin CHARACTERISTIC KL_UWIGOB_3 "obere Uebersetzungsschwelle fuer UWIG im Gang" CURVE 0x1CE8E8 ZF_kl_ui16_S5_S3 65.535 UMR___1_1000_0_S5_S3 0 65.535
 /begin AXIS_DESCR STD_AXIS zff_atsys._.iSignale._.obj.sig_n_ab UMR_U_MIN_1_1_0_S5_S3 8 0 8160 DEPOSIT ABSOLUTE /end AXIS_DESCR
/end CHARACTERISTIC
/begin CHARACTERISTIC KL_UWIGOB_4 "obere Uebersetzungsschwelle fuer UWIG im Gang" CURVE 0x1CE9F0 ZF_kl_ui16_S5_S3 65.535 UMR___1_1000_0_S5_S3 0 65.535
 /begin AXIS_DESCR STD_AXIS zff_atsys._.iSignale._.obj.sig_n_ab UMR_U_MIN_1_1_0_S5_S3 8 0 8160 DEPOSIT ABSOLUTE /end AXIS_DESCR
/end CHARACTERISTIC
/begin CHARACTERISTIC KL_UWIGOB_5 "obere Uebersetzungsschwelle fuer UWIG im Gang" CURVE 0x1CEAF8 ZF_kl_ui16_S5_S3 65.535 UMR___1_1000_0_S5_S3 0 65.535
 /begin AXIS_DESCR STD_AXIS zff_atsys._.iSignale._.obj.sig_n_ab UMR_U_MIN_1_1_0_S5_S3 8 0 8160 DEPOSIT ABSOLUTE /end AXIS_DESCR
/end CHARACTERISTIC
/begin CHARACTERISTIC KL_UWIGOB_6 "obere Uebersetzungsschwelle fuer UWIG im Gang" CURVE 0x1CEC00 ZF_kl_ui16_S5_S3 65.535 UMR___1_1000_0_S5_S3 0 65.535
 /begin AXIS_DESCR STD_AXIS zff_atsys._.iSignale._.obj.sig_n_ab UMR_U_MIN_1_1_0_S5_S3 8 0 8160 DEPOSIT ABSOLUTE /end AXIS_DESCR
/end CHARACTERISTIC
/begin CHARACTERISTIC KL_UWIGOB_7 "obere Uebersetzungsschwelle fuer UWIG im Gang" CURVE 0x1CED08 ZF_kl_ui16_S5_S3 65.535 UMR___1_1000_0_S5_S3 0 65.535
 /begin AXIS_DESCR STD_AXIS zff_atsys._.iSignale._.obj.sig_n_ab UMR_U_MIN_1_1_0_S5_S3 8 0 8160 DEPOSIT ABSOLUTE /end AXIS_DESCR
/end CHARACTERISTIC
/begin CHARACTERISTIC KL_UWIGOB_8 "obere Uebersetzungsschwelle fuer UWIG im Gang" CURVE 0x1CEE10 ZF_kl_ui16_S5_S3 65.535 UMR___1_1000_0_S5_S3 0 65.535
 /begin AXIS_DESCR STD_AXIS zff_atsys._.iSignale._.obj.sig_n_ab UMR_U_MIN_1_1_0_S5_S3 8 0 8160 DEPOSIT ABSOLUTE /end AXIS_DESCR
/end CHARACTERISTIC
/begin CHARACTERISTIC KL_UWIGOB_R "obere Uebersetzungsschwelle fuer UWIG im Gang" CURVE 0x1CE5D0 ZF_kl_ui16_S5_S3 65.535 UMR___1_1000_0_S5_S3 0 65.535
 /begin AXIS_DESCR STD_AXIS zff_atsys._.iSignale._.obj.sig_n_ab UMR_U_MIN_1_1_0_S5_S3 8 0 8160 DEPOSIT ABSOLUTE /end AXIS_DESCR
/end CHARACTERISTIC
/begin CHARACTERISTIC KL_UWIGUNERS_1 "Ersatzwert untere Uebersetzungsschwelle fuer UWIG im Gang" CURVE 0x1CE744 ZF_kl_ui16_S5_S3 65.535 UMR___1_1000_0_S5_S3 0 65.535
 /begin AXIS_DESCR STD_AXIS zff_atsys._.iSignale._.obj.sig_n_ab UMR_U_MIN_1_1_0_S5_S3 8 0 8160 DEPOSIT ABSOLUTE /end AXIS_DESCR
/end CHARACTERISTIC
/begin CHARACTERISTIC KL_UWIGUNERS_2 "Ersatzwert untere Uebersetzungsschwelle fuer UWIG im Gang" CURVE 0x1CE84C ZF_kl_ui16_S5_S3 65.535 UMR___1_1000_0_S5_S3 0 65.535
 /begin AXIS_DESCR STD_AXIS zff_atsys._.iSignale._.obj.sig_n_ab UMR_U_MIN_1_1_0_S5_S3 8 0 8160 DEPOSIT ABSOLUTE /end AXIS_DESCR
/end CHARACTERISTIC
/begin CHARACTERISTIC KL_UWIGUNERS_3 "Ersatzwert untere Uebersetzungsschwelle fuer UWIG im Gang" CURVE 0x1CE954 ZF_kl_ui16_S5_S3 65.535 UMR___1_1000_0_S5_S3 0 65.535
 /begin AXIS_DESCR STD_AXIS zff_atsys._.iSignale._.obj.sig_n_ab UMR_U_MIN_1_1_0_S5_S3 8 0 8160 DEPOSIT ABSOLUTE /end AXIS_DESCR
/end CHARACTERISTIC
/begin CHARACTERISTIC KL_UWIGUNERS_4 "Ersatzwert untere Uebersetzungsschwelle fuer UWIG im Gang" CURVE 0x1CEA5C ZF_kl_ui16_S5_S3 65.535 UMR___1_1000_0_S5_S3 0 65.535
 /begin AXIS_DESCR STD_AXIS zff_atsys._.iSignale._.obj.sig_n_ab UMR_U_MIN_1_1_0_S5_S3 8 0 8160 DEPOSIT ABSOLUTE /end AXIS_DESCR
/end CHARACTERISTIC
/begin CHARACTERISTIC KL_UWIGUNERS_5 "Ersatzwert untere Uebersetzungsschwelle fuer UWIG im Gang" CURVE 0x1CEB64 ZF_kl_ui16_S5_S3 65.535 UMR___1_1000_0_S5_S3 0 65.535
 /begin AXIS_DESCR STD_AXIS zff_atsys._.iSignale._.obj.sig_n_ab UMR_U_MIN_1_1_0_S5_S3 8 0 8160 DEPOSIT ABSOLUTE /end AXIS_DESCR
/end CHARACTERISTIC
/begin CHARACTERISTIC KL_UWIGUNERS_6 "Ersatzwert untere Uebersetzungsschwelle fuer UWIG im Gang" CURVE 0x1CEC6C ZF_kl_ui16_S5_S3 65.535 UMR___1_1000_0_S5_S3 0 65.535
 /begin AXIS_DESCR STD_AXIS zff_atsys._.iSignale._.obj.sig_n_ab UMR_U_MIN_1_1_0_S5_S3 8 0 8160 DEPOSIT ABSOLUTE /end AXIS_DESCR
/end CHARACTERISTIC
/begin CHARACTERISTIC KL_UWIGUNERS_7 "Ersatzwert untere Uebersetzungsschwelle fuer UWIG im Gang" CURVE 0x1CED74 ZF_kl_ui16_S5_S3 65.535 UMR___1_1000_0_S5_S3 0 65.535
 /begin AXIS_DESCR STD_AXIS zff_atsys._.iSignale._.obj.sig_n_ab UMR_U_MIN_1_1_0_S5_S3 8 0 8160 DEPOSIT ABSOLUTE /end AXIS_DESCR
/end CHARACTERISTIC
/begin CHARACTERISTIC KL_UWIGUNERS_8 "Ersatzwert untere Uebersetzungsschwelle fuer UWIG im Gang" CURVE 0x1CEE7C ZF_kl_ui16_S5_S3 65.535 UMR___1_1000_0_S5_S3 0 65.535
 /begin AXIS_DESCR STD_AXIS zff_atsys._.iSignale._.obj.sig_n_ab UMR_U_MIN_1_1_0_S5_S3 8 0 8160 DEPOSIT ABSOLUTE /end AXIS_DESCR
/end CHARACTERISTIC
/begin CHARACTERISTIC KL_UWIGUNERS_R "Ersatzwert untere Uebersetzungsschwelle fuer UWIG im Gang" CURVE 0x1CE63C ZF_kl_ui16_S5_S3 65.535 UMR___1_1000_0_S5_S3 0 65.535
 /begin AXIS_DESCR STD_AXIS zff_atsys._.iSignale._.obj.sig_n_ab UMR_U_MIN_1_1_0_S5_S3 8 0 8160 DEPOSIT ABSOLUTE /end AXIS_DESCR
/end CHARACTERISTIC
/begin CHARACTERISTIC KL_UWIGUN_1 "untere Uebersetzungsschwelle fuer UWIG im Gang" CURVE 0x1CE720 ZF_kl_ui16_S5_S3 65.535 UMR___1_1000_0_S5_S3 0 65.535
 /begin AXIS_DESCR STD_AXIS zff_atsys._.iSignale._.obj.sig_n_ab UMR_U_MIN_1_1_0_S5_S3 8 0 8160 DEPOSIT ABSOLUTE /end AXIS_DESCR
/end CHARACTERISTIC
/begin CHARACTERISTIC KL_UWIGUN_2 "untere Uebersetzungsschwelle fuer UWIG im Gang" CURVE 0x1CE828 ZF_kl_ui16_S5_S3 65.535 UMR___1_1000_0_S5_S3 0 65.535
 /begin AXIS_DESCR STD_AXIS zff_atsys._.iSignale._.obj.sig_n_ab UMR_U_MIN_1_1_0_S5_S3 8 0 8160 DEPOSIT ABSOLUTE /end AXIS_DESCR
/end CHARACTERISTIC
/begin CHARACTERISTIC KL_UWIGUN_3 "untere Uebersetzungsschwelle fuer UWIG im Gang" CURVE 0x1CE930 ZF_kl_ui16_S5_S3 65.535 UMR___1_1000_0_S5_S3 0 65.535
 /begin AXIS_DESCR STD_AXIS zff_atsys._.iSignale._.obj.sig_n_ab UMR_U_MIN_1_1_0_S5_S3 8 0 8160 DEPOSIT ABSOLUTE /end AXIS_DESCR
/end CHARACTERISTIC
/begin CHARACTERISTIC KL_UWIGUN_4 "untere Uebersetzungsschwelle fuer UWIG im Gang" CURVE 0x1CEA38 ZF_kl_ui16_S5_S3 65.535 UMR___1_1000_0_S5_S3 0 65.535
 /begin AXIS_DESCR STD_AXIS zff_atsys._.iSignale._.obj.sig_n_ab UMR_U_MIN_1_1_0_S5_S3 8 0 8160 DEPOSIT ABSOLUTE /end AXIS_DESCR
/end CHARACTERISTIC
/begin CHARACTERISTIC KL_UWIGUN_5 "untere Uebersetzungsschwelle fuer UWIG im Gang" CURVE 0x1CEB40 ZF_kl_ui16_S5_S3 65.535 UMR___1_1000_0_S5_S3 0 65.535
 /begin AXIS_DESCR STD_AXIS zff_atsys._.iSignale._.obj.sig_n_ab UMR_U_MIN_1_1_0_S5_S3 8 0 8160 DEPOSIT ABSOLUTE /end AXIS_DESCR
/end CHARACTERISTIC
/begin CHARACTERISTIC KL_UWIGUN_6 "untere Uebersetzungsschwelle fuer UWIG im Gang" CURVE 0x1CEC48 ZF_kl_ui16_S5_S3 65.535 UMR___1_1000_0_S5_S3 0 65.535
 /begin AXIS_DESCR STD_AXIS zff_atsys._.iSignale._.obj.sig_n_ab UMR_U_MIN_1_1_0_S5_S3 8 0 8160 DEPOSIT ABSOLUTE /end AXIS_DESCR
/end CHARACTERISTIC
/begin CHARACTERISTIC KL_UWIGUN_7 "untere Uebersetzungsschwelle fuer UWIG im Gang" CURVE 0x1CED50 ZF_kl_ui16_S5_S3 65.535 UMR___1_1000_0_S5_S3 0 65.535
 /begin AXIS_DESCR STD_AXIS zff_atsys._.iSignale._.obj.sig_n_ab UMR_U_MIN_1_1_0_S5_S3 8 0 8160 DEPOSIT ABSOLUTE /end AXIS_DESCR
/end CHARACTERISTIC
/begin CHARACTERISTIC KL_UWIGUN_8 "untere Uebersetzungsschwelle fuer UWIG im Gang" CURVE 0x1CEE58 ZF_kl_ui16_S5_S3 65.535 UMR___1_1000_0_S5_S3 0 65.535
 /begin AXIS_DESCR STD_AXIS zff_atsys._.iSignale._.obj.sig_n_ab UMR_U_MIN_1_1_0_S5_S3 8 0 8160 DEPOSIT ABSOLUTE /end AXIS_DESCR
/end CHARACTERISTIC
/begin CHARACTERISTIC KL_UWIGUN_R "untere Uebersetzungsschwelle fuer UWIG im Gang" CURVE 0x1CE618 ZF_kl_ui16_S5_S3 65.535 UMR___1_1000_0_S5_S3 0 65.535
 /begin AXIS_DESCR STD_AXIS zff_atsys._.iSignale._.obj.sig_n_ab UMR_U_MIN_1_1_0_S5_S3 8 0 8160 DEPOSIT ABSOLUTE /end AXIS_DESCR
/end CHARACTERISTIC
/begin CHARACTERISTIC MAX_STOERPOSNEDS "ASIL-B: Schwellwert fuer den Ereigniszaehler Phase A der PosN-Plausi" VALUE 0x1D7C8D ZF_kw_ui8_S5_S3 255 UMR___1_1_0_S5_S3 0 255 /end CHARACTERISTIC
/begin CHARACTERISTIC MAX_STOERPOSNEDS14 "ASIL-B: Schwellwert fuer den Ereigniszaehler Phase B der PosN-Plausi" VALUE 0x1D7C8E ZF_kw_ui8_S5_S3 255 UMR___1_1_0_S5_S3 0 255 /end CHARACTERISTIC
/begin CHARACTERISTIC MAX_STOERPOSVMECHDEF "Anzahl von Stoerungen bis zum Ausloesen eines POSV Fehlers" VALUE 0x1D7C82 ZF_kw_ui8_S5_S3 20 UMR___1_1_0_S5_S3 0 20 /end CHARACTERISTIC
/begin CHARACTERISTIC MAX_STOER_GANG "Maximale Anzahl Stoerungen im Gang UWIG" VALUE 0x1D7C02 ZF_kw_ui8_S5_S3 254 UMR___1_1_0_S5_S3 1 255 /end CHARACTERISTIC
/begin CHARACTERISTIC MAX_STOER_GE "Maximale Anzahl Stoerungen waehrend Gangeinlegen UWIG" VALUE 0x1D7C03 ZF_kw_ui8_S5_S3 254 UMR___1_1_0_S5_S3 1 255 /end CHARACTERISTIC
/begin CHARACTERISTIC MAX_STOER_OFFSET12 "Offset fuer Anz. Stoerungen bis ein Symptom ausgeloest wird, wenn bei Schltg. ein Sollmomentgradient unterschritten wird" VALUE 0x1D7C1B ZF_kw_ui8_S5_S3 255 UMR___1_1_0_S5_S3 0 255 /end CHARACTERISTIC
/begin CHARACTERISTIC MAX_STOER_OFFSET21 "Offset fuer Anz. Stoerungen bis ein Symptom ausgeloest wird, wenn bei Schltg. ein Sollmomentgradient unterschritten wird" VALUE 0x1D7C37 ZF_kw_ui8_S5_S3 255 UMR___1_1_0_S5_S3 0 255 /end CHARACTERISTIC
/begin CHARACTERISTIC MAX_STOER_OFFSET23 "Offset fuer Anz. Stoerungen bis ein Symptom ausgeloest wird, wenn bei Schltg. ein Sollmomentgradient unterschritten wird" VALUE 0x1D7C1F ZF_kw_ui8_S5_S3 255 UMR___1_1_0_S5_S3 0 255 /end CHARACTERISTIC
/begin CHARACTERISTIC MAX_STOER_OFFSET31 "Offset fuer Anz. Stoerungen bis ein Symptom ausgeloest wird, wenn bei Schltg. ein Sollmomentgradient unterschritten wird" VALUE 0x1D7C53 ZF_kw_ui8_S5_S3 255 UMR___1_1_0_S5_S3 0 255 /end CHARACTERISTIC
/begin CHARACTERISTIC MAX_STOER_OFFSET32 "Offset fuer Anz. Stoerungen bis ein Symptom ausgeloest wird, wenn bei Schltg. ein Sollmomentgradient unterschritten wird" VALUE 0x1D7C3B ZF_kw_ui8_S5_S3 255 UMR___1_1_0_S5_S3 0 255 /end CHARACTERISTIC
/begin CHARACTERISTIC MAX_STOER_OFFSET34 "Offset fuer Anz. Stoerungen bis ein Symptom ausgeloest wird, wenn bei Schltg. ein Sollmomentgradient unterschritten wird" VALUE 0x1D7C23 ZF_kw_ui8_S5_S3 255 UMR___1_1_0_S5_S3 0 255 /end CHARACTERISTIC
/begin CHARACTERISTIC MAX_STOER_OFFSET42 "Offset fuer Anz. Stoerungen bis ein Symptom ausgeloest wird, wenn bei Schltg. ein Sollmomentgradient unterschritten wird" VALUE 0x1D7C57 ZF_kw_ui8_S5_S3 255 UMR___1_1_0_S5_S3 0 255 /end CHARACTERISTIC
/begin CHARACTERISTIC MAX_STOER_OFFSET43 "Offset fuer Anz. Stoerungen bis ein Symptom ausgeloest wird, wenn bei Schltg. ein Sollmomentgradient unterschritten wird" VALUE 0x1D7C3F ZF_kw_ui8_S5_S3 255 UMR___1_1_0_S5_S3 0 255 /end CHARACTERISTIC
/begin CHARACTERISTIC MAX_STOER_OFFSET45 "Offset fuer Anz. Stoerungen bis ein Symptom ausgeloest wird, wenn bei Schltg. ein Sollmomentgradient unterschritten wird" VALUE 0x1D7C27 ZF_kw_ui8_S5_S3 255 UMR___1_1_0_S5_S3 0 255 /end CHARACTERISTIC
/begin CHARACTERISTIC MAX_STOER_OFFSET51 "Offset fuer Anz. Stoerungen bis ein Symptom ausgeloest wird, wenn bei Schltg. ein Sollmomentgradient unterschritten wird" VALUE 0x1D7C5B ZF_kw_ui8_S5_S3 255 UMR___1_1_0_S5_S3 0 255 /end CHARACTERISTIC
/begin CHARACTERISTIC MAX_STOER_OFFSET53 "Offset fuer Anz. Stoerungen bis ein Symptom ausgeloest wird, wenn bei Schltg. ein Sollmomentgradient unterschritten wird" VALUE 0x1D7C5F ZF_kw_ui8_S5_S3 255 UMR___1_1_0_S5_S3 0 255 /end CHARACTERISTIC
/begin CHARACTERISTIC MAX_STOER_OFFSET54 "Offset fuer Anz. Stoerungen bis ein Symptom ausgeloest wird, wenn bei Schltg. ein Sollmomentgradient unterschritten wird" VALUE 0x1D7C43 ZF_kw_ui8_S5_S3 255 UMR___1_1_0_S5_S3 0 255 /end CHARACTERISTIC
/begin CHARACTERISTIC MAX_STOER_OFFSET56 "Offset fuer Anz. Stoerungen bis ein Symptom ausgeloest wird, wenn bei Schltg. ein Sollmomentgradient unterschritten wird" VALUE 0x1D7C2B ZF_kw_ui8_S5_S3 255 UMR___1_1_0_S5_S3 0 255 /end CHARACTERISTIC
/begin CHARACTERISTIC MAX_STOER_OFFSET63 "Offset fuer Anz. Stoerungen bis ein Symptom ausgeloest wird, wenn bei Schltg. ein Sollmomentgradient unterschritten wird" VALUE 0x1D7C63 ZF_kw_ui8_S5_S3 255 UMR___1_1_0_S5_S3 0 255 /end CHARACTERISTIC
/begin CHARACTERISTIC MAX_STOER_OFFSET64 "Offset fuer Anz. Stoerungen bis ein Symptom ausgeloest wird, wenn bei Schltg. ein Sollmomentgradient unterschritten wird" VALUE 0x1D7C67 ZF_kw_ui8_S5_S3 255 UMR___1_1_0_S5_S3 0 255 /end CHARACTERISTIC
/begin CHARACTERISTIC MAX_STOER_OFFSET65 "Offset fuer Anz. Stoerungen bis ein Symptom ausgeloest wird, wenn bei Schltg. ein Sollmomentgradient unterschritten wird" VALUE 0x1D7C47 ZF_kw_ui8_S5_S3 255 UMR___1_1_0_S5_S3 0 255 /end CHARACTERISTIC
/begin CHARACTERISTIC MAX_STOER_OFFSET67 "Offset fuer Anz. Stoerungen bis ein Symptom ausgeloest wird, wenn bei Schltg. ein Sollmomentgradient unterschritten wird" VALUE 0x1D7C2F ZF_kw_ui8_S5_S3 255 UMR___1_1_0_S5_S3 0 255 /end CHARACTERISTIC
/begin CHARACTERISTIC MAX_STOER_OFFSET71 "Offset fuer Anz. Stoerungen bis ein Symptom ausgeloest wird, wenn bei Schltg. ein Sollmomentgradient unterschritten wird" VALUE 0x1D7C6B ZF_kw_ui8_S5_S3 255 UMR___1_1_0_S5_S3 0 255 /end CHARACTERISTIC
/begin CHARACTERISTIC MAX_STOER_OFFSET75 "Offset fuer Anz. Stoerungen bis ein Symptom ausgeloest wird, wenn bei Schltg. ein Sollmomentgradient unterschritten wird" VALUE 0x1D7C6F ZF_kw_ui8_S5_S3 255 UMR___1_1_0_S5_S3 0 255 /end CHARACTERISTIC
/begin CHARACTERISTIC MAX_STOER_OFFSET76 "Offset fuer Anz. Stoerungen bis ein Symptom ausgeloest wird, wenn bei Schltg. ein Sollmomentgradient unterschritten wird" VALUE 0x1D7C4B ZF_kw_ui8_S5_S3 255 UMR___1_1_0_S5_S3 0 255 /end CHARACTERISTIC
/begin CHARACTERISTIC MAX_STOER_OFFSET78 "Offset fuer Anz. Stoerungen bis ein Symptom ausgeloest wird, wenn bei Schltg. ein Sollmomentgradient unterschritten wird" VALUE 0x1D7C33 ZF_kw_ui8_S5_S3 255 UMR___1_1_0_S5_S3 0 255 /end CHARACTERISTIC
/begin CHARACTERISTIC MAX_STOER_OFFSET82 "Offset fuer Anz. Stoerungen bis ein Symptom ausgeloest wird, wenn bei Schltg. ein Sollmomentgradient unterschritten wird" VALUE 0x1D7C73 ZF_kw_ui8_S5_S3 255 UMR___1_1_0_S5_S3 0 255 /end CHARACTERISTIC
/begin CHARACTERISTIC MAX_STOER_OFFSET84 "Offset fuer Anz. Stoerungen bis ein Symptom ausgeloest wird, wenn bei Schltg. ein Sollmomentgradient unterschritten wird" VALUE 0x1D7C77 ZF_kw_ui8_S5_S3 255 UMR___1_1_0_S5_S3 0 255 /end CHARACTERISTIC
/begin CHARACTERISTIC MAX_STOER_OFFSET86 "Offset fuer Anz. Stoerungen bis ein Symptom ausgeloest wird, wenn bei Schltg. ein Sollmomentgradient unterschritten wird" VALUE 0x1D7C7B ZF_kw_ui8_S5_S3 255 UMR___1_1_0_S5_S3 0 255 /end CHARACTERISTIC
/begin CHARACTERISTIC MAX_STOER_OFFSET87 "Offset fuer Anz. Stoerungen bis ein Symptom ausgeloest wird, wenn bei Schltg. ein Sollmomentgradient unterschritten wird" VALUE 0x1D7C4F ZF_kw_ui8_S5_S3 255 UMR___1_1_0_S5_S3 0 255 /end CHARACTERISTIC
/begin CHARACTERISTIC MAX_STOER_PMUEB "Störzähler für die Fehlererkennung" VALUE 0x1D7C81 ZF_kw_ui8_S5_S3 254 UMR___1_1_0_S5_S3 0 254 /end CHARACTERISTIC
/begin CHARACTERISTIC MAX_STOER_SCHALT "Maximale Anzahl Stoerungen waehrend Schaltung UWIG" VALUE 0x1D7C04 ZF_kw_ui8_S5_S3 254 UMR___1_1_0_S5_S3 1 255 /end CHARACTERISTIC
/begin CHARACTERISTIC MAX_SYMUWIG_GANG "Maximale Anzahl Symptome UWIG" VALUE 0x1D7C05 ZF_kw_ui8_S5_S3 254 UMR___1_1_0_S5_S3 1 255 /end CHARACTERISTIC
/begin CHARACTERISTIC MAX_SYM_UWIG_SCHALT12 "Maximale Anzahl Symptome fuer Schaltung in der UWIG" VALUE 0x1D7C1C ZF_kw_ui8_S5_S3 254 UMR___1_1_0_S5_S3 1 255 /end CHARACTERISTIC
/begin CHARACTERISTIC MAX_SYM_UWIG_SCHALT21 "Maximale Anzahl Symptome fuer Schaltung in der UWIG" VALUE 0x1D7C38 ZF_kw_ui8_S5_S3 254 UMR___1_1_0_S5_S3 1 255 /end CHARACTERISTIC
/begin CHARACTERISTIC MAX_SYM_UWIG_SCHALT23 "Maximale Anzahl Symptome fuer Schaltung in der UWIG" VALUE 0x1D7C20 ZF_kw_ui8_S5_S3 254 UMR___1_1_0_S5_S3 1 255 /end CHARACTERISTIC
/begin CHARACTERISTIC MAX_SYM_UWIG_SCHALT31 "Maximale Anzahl Symptome fuer Schaltung in der UWIG" VALUE 0x1D7C54 ZF_kw_ui8_S5_S3 254 UMR___1_1_0_S5_S3 1 255 /end CHARACTERISTIC
/begin CHARACTERISTIC MAX_SYM_UWIG_SCHALT32 "Maximale Anzahl Symptome fuer Schaltung in der UWIG" VALUE 0x1D7C3C ZF_kw_ui8_S5_S3 254 UMR___1_1_0_S5_S3 1 255 /end CHARACTERISTIC
/begin CHARACTERISTIC MAX_SYM_UWIG_SCHALT34 "Maximale Anzahl Symptome fuer Schaltung in der UWIG" VALUE 0x1D7C24 ZF_kw_ui8_S5_S3 254 UMR___1_1_0_S5_S3 1 255 /end CHARACTERISTIC
/begin CHARACTERISTIC MAX_SYM_UWIG_SCHALT42 "Maximale Anzahl Symptome fuer Schaltung in der UWIG" VALUE 0x1D7C58 ZF_kw_ui8_S5_S3 254 UMR___1_1_0_S5_S3 1 255 /end CHARACTERISTIC
/begin CHARACTERISTIC MAX_SYM_UWIG_SCHALT43 "Maximale Anzahl Symptome fuer Schaltung in der UWIG" VALUE 0x1D7C40 ZF_kw_ui8_S5_S3 254 UMR___1_1_0_S5_S3 1 255 /end CHARACTERISTIC
/begin CHARACTERISTIC MAX_SYM_UWIG_SCHALT45 "Maximale Anzahl Symptome fuer Schaltung in der UWIG" VALUE 0x1D7C28 ZF_kw_ui8_S5_S3 254 UMR___1_1_0_S5_S3 1 255 /end CHARACTERISTIC
/begin CHARACTERISTIC MAX_SYM_UWIG_SCHALT51 "Maximale Anzahl Symptome fuer Schaltung in der UWIG" VALUE 0x1D7C5C ZF_kw_ui8_S5_S3 254 UMR___1_1_0_S5_S3 1 255 /end CHARACTERISTIC
/begin CHARACTERISTIC MAX_SYM_UWIG_SCHALT53 "Maximale Anzahl Symptome fuer Schaltung in der UWIG" VALUE 0x1D7C60 ZF_kw_ui8_S5_S3 254 UMR___1_1_0_S5_S3 1 255 /end CHARACTERISTIC
/begin CHARACTERISTIC MAX_SYM_UWIG_SCHALT54 "Maximale Anzahl Symptome fuer Schaltung in der UWIG" VALUE 0x1D7C44 ZF_kw_ui8_S5_S3 254 UMR___1_1_0_S5_S3 1 255 /end CHARACTERISTIC
/begin CHARACTERISTIC MAX_SYM_UWIG_SCHALT56 "Maximale Anzahl Symptome fuer Schaltung in der UWIG" VALUE 0x1D7C2C ZF_kw_ui8_S5_S3 254 UMR___1_1_0_S5_S3 1 255 /end CHARACTERISTIC
/begin CHARACTERISTIC MAX_SYM_UWIG_SCHALT63 "Maximale Anzahl Symptome fuer Schaltung in der UWIG" VALUE 0x1D7C64 ZF_kw_ui8_S5_S3 254 UMR___1_1_0_S5_S3 1 255 /end CHARACTERISTIC
/begin CHARACTERISTIC MAX_SYM_UWIG_SCHALT64 "Maximale Anzahl Symptome fuer Schaltung in der UWIG" VALUE 0x1D7C68 ZF_kw_ui8_S5_S3 254 UMR___1_1_0_S5_S3 1 255 /end CHARACTERISTIC
/begin CHARACTERISTIC MAX_SYM_UWIG_SCHALT65 "Maximale Anzahl Symptome fuer Schaltung in der UWIG" VALUE 0x1D7C48 ZF_kw_ui8_S5_S3 254 UMR___1_1_0_S5_S3 1 255 /end CHARACTERISTIC
/begin CHARACTERISTIC MAX_SYM_UWIG_SCHALT67 "Maximale Anzahl Symptome fuer Schaltung in der UWIG" VALUE 0x1D7C30 ZF_kw_ui8_S5_S3 254 UMR___1_1_0_S5_S3 1 255 /end CHARACTERISTIC
/begin CHARACTERISTIC MAX_SYM_UWIG_SCHALT71 "Maximale Anzahl Symptome fuer Schaltung in der UWIG" VALUE 0x1D7C6C ZF_kw_ui8_S5_S3 254 UMR___1_1_0_S5_S3 1 255 /end CHARACTERISTIC
/begin CHARACTERISTIC MAX_SYM_UWIG_SCHALT75 "Maximale Anzahl Symptome fuer Schaltung in der UWIG" VALUE 0x1D7C70 ZF_kw_ui8_S5_S3 254 UMR___1_1_0_S5_S3 1 255 /end CHARACTERISTIC
/begin CHARACTERISTIC MAX_SYM_UWIG_SCHALT76 "Maximale Anzahl Symptome fuer Schaltung in der UWIG" VALUE 0x1D7C4C ZF_kw_ui8_S5_S3 254 UMR___1_1_0_S5_S3 1 255 /end CHARACTERISTIC
/begin CHARACTERISTIC MAX_SYM_UWIG_SCHALT78 "Maximale Anzahl Symptome fuer Schaltung in der UWIG" VALUE 0x1D7C34 ZF_kw_ui8_S5_S3 254 UMR___1_1_0_S5_S3 1 255 /end CHARACTERISTIC
/begin CHARACTERISTIC MAX_SYM_UWIG_SCHALT82 "Maximale Anzahl Symptome fuer Schaltung in der UWIG" VALUE 0x1D7C74 ZF_kw_ui8_S5_S3 254 UMR___1_1_0_S5_S3 1 255 /end CHARACTERISTIC
/begin CHARACTERISTIC MAX_SYM_UWIG_SCHALT84 "Maximale Anzahl Symptome fuer Schaltung in der UWIG" VALUE 0x1D7C78 ZF_kw_ui8_S5_S3 254 UMR___1_1_0_S5_S3 1 255 /end CHARACTERISTIC
/begin CHARACTERISTIC MAX_SYM_UWIG_SCHALT86 "Maximale Anzahl Symptome fuer Schaltung in der UWIG" VALUE 0x1D7C7C ZF_kw_ui8_S5_S3 254 UMR___1_1_0_S5_S3 1 255 /end CHARACTERISTIC
/begin CHARACTERISTIC MAX_SYM_UWIG_SCHALT87 "Maximale Anzahl Symptome fuer Schaltung in der UWIG" VALUE 0x1D7C50 ZF_kw_ui8_S5_S3 254 UMR___1_1_0_S5_S3 1 255 /end CHARACTERISTIC
/begin CHARACTERISTIC MGS_MOTSOLLUWIG "Motorsollmomentgradientenschwelle fuer die Erhoehung des Stoerzaehlers" VALUE 0x1D8B64 ZF_kw_si16_S5_S3 2550 UMR_NM_SEC_1_1_0_S5_S3 0 2550 /end CHARACTERISTIC
/begin CHARACTERISTIC MG_PSYSMINPULS "Gradient zur Systemdruckanhebung durch Pulsadaption" VALUE 0x1D8B30 ZF_kw_si16_S5_S3 100 UMR_BAR_SEC_1_1_0_S5_S3 0 100 /end CHARACTERISTIC
/begin CHARACTERISTIC MIN_ERFOLGE_GE "Minimale Anzahl Erfolge waehrend Gangeinlegen bei kleiner n_ab UWIG" VALUE 0x1D7C06 ZF_kw_ui8_S5_S3 254 UMR___1_1_0_S5_S3 1 255 /end CHARACTERISTIC
/begin CHARACTERISTIC MIN_ERFOLG_SYMIO_A "Grenzwert ab dem eine Symptomheilung erfolgreich war" VALUE 0x1D7C16 ZF_kw_ui8_S5_S3 255 UMR___1_1_0_S5_S3 0 255 /end CHARACTERISTIC
/begin CHARACTERISTIC MIN_ERFOLG_SYMIO_B "Grenzwert ab dem eine Symptomheilung erfolgreich war" VALUE 0x1D7C17 ZF_kw_ui8_S5_S3 255 UMR___1_1_0_S5_S3 0 255 /end CHARACTERISTIC
/begin CHARACTERISTIC MIN_ERFOLG_SYMIO_C "Grenzwert ab dem eine Symptomheilung erfolgreich war" VALUE 0x1D7C18 ZF_kw_ui8_S5_S3 255 UMR___1_1_0_S5_S3 0 255 /end CHARACTERISTIC
/begin CHARACTERISTIC MIN_ERFOLG_SYMIO_D "Grenzwert ab dem eine Symptomheilung erfolgreich war" VALUE 0x1D7C19 ZF_kw_ui8_S5_S3 255 UMR___1_1_0_S5_S3 0 255 /end CHARACTERISTIC
/begin CHARACTERISTIC MIN_ERFOLG_SYMIO_E "Grenzwert ab dem eine Symptomheilung erfolgreich war" VALUE 0x1D7C1A ZF_kw_ui8_S5_S3 255 UMR___1_1_0_S5_S3 0 255 /end CHARACTERISTIC
/begin CHARACTERISTIC MS_TPSYSIAEHYS "Hysterese für Turbinenmoment für FKt. Reduzierung Hochlastschudder IAE" VALUE 0x1D8B34 ZF_kw_si16_S5_S3 100 UMR_NM__1_1_0_S5_S3 0 100 /end CHARACTERISTIC
/begin CHARACTERISTIC MS_TPSYSIAEOB "Obere Turbinenmomentschwelle für FKt. Reduzierung Hochlastschudder IAE" VALUE 0x1D8B36 ZF_kw_si16_S5_S3 1500 UMR_NM__1_1_0_S5_S3 -200 1300 /end CHARACTERISTIC
/begin CHARACTERISTIC MS_TPSYSIAEUN "Untere Turbinenmomentschwelle für FKt. Reduzierung Hochlastschudder IAE" VALUE 0x1D8B38 ZF_kw_si16_S5_S3 1500 UMR_NM__1_1_0_S5_S3 -200 1300 /end CHARACTERISTIC
/begin CHARACTERISTIC ND_TOBUWIG_GE_1 "Obergrenze Differenzdrehzahl waehrend Gangeinlegen bei kleinem n_ab" VALUE 0x1D8B8C ZF_kw_si16_S5_S3 5000 UMR_U_MIN_1_1_0_S5_S3 0 5000 /end CHARACTERISTIC
/begin CHARACTERISTIC ND_TOBUWIG_GE_2 "Obergrenze Differenzdrehzahl waehrend Gangeinlegen bei kleinem n_ab" VALUE 0x1D8B90 ZF_kw_si16_S5_S3 5000 UMR_U_MIN_1_1_0_S5_S3 0 5000 /end CHARACTERISTIC
/begin CHARACTERISTIC ND_TOBUWIG_GE_3 "Obergrenze Differenzdrehzahl waehrend Gangeinlegen bei kleinem n_ab" VALUE 0x1D8B94 ZF_kw_si16_S5_S3 5000 UMR_U_MIN_1_1_0_S5_S3 0 5000 /end CHARACTERISTIC
/begin CHARACTERISTIC ND_TOBUWIG_GE_4 "Obergrenze Differenzdrehzahl waehrend Gangeinlegen bei kleinem n_ab" VALUE 0x1D8B98 ZF_kw_si16_S5_S3 5000 UMR_U_MIN_1_1_0_S5_S3 0 5000 /end CHARACTERISTIC
/begin CHARACTERISTIC ND_TOBUWIG_GE_5 "Obergrenze Differenzdrehzahl waehrend Gangeinlegen bei kleinem n_ab" VALUE 0x1D8B9C ZF_kw_si16_S5_S3 5000 UMR_U_MIN_1_1_0_S5_S3 0 5000 /end CHARACTERISTIC
/begin CHARACTERISTIC ND_TOBUWIG_GE_6 "Obergrenze Differenzdrehzahl waehrend Gangeinlegen bei kleinem n_ab" VALUE 0x1D8BA0 ZF_kw_si16_S5_S3 5000 UMR_U_MIN_1_1_0_S5_S3 0 5000 /end CHARACTERISTIC
/begin CHARACTERISTIC ND_TOBUWIG_GE_7 "Obergrenze Differenzdrehzahl waehrend Gangeinlegen bei kleinem n_ab" VALUE 0x1D8BA4 ZF_kw_si16_S5_S3 5000 UMR_U_MIN_1_1_0_S5_S3 0 5000 /end CHARACTERISTIC
/begin CHARACTERISTIC ND_TOBUWIG_GE_8 "Obergrenze Differenzdrehzahl waehrend Gangeinlegen bei kleinem n_ab" VALUE 0x1D8BA8 ZF_kw_si16_S5_S3 5000 UMR_U_MIN_1_1_0_S5_S3 0 5000 /end CHARACTERISTIC
/begin CHARACTERISTIC ND_TOBUWIG_GE_R "Obergrenze Differenzdrehzahl waehrend Gangeinlegen bei kleinem n_ab" VALUE 0x1D8B88 ZF_kw_si16_S5_S3 5000 UMR_U_MIN_1_1_0_S5_S3 0 5000 /end CHARACTERISTIC
/begin CHARACTERISTIC ND_TUNUWIG_GE_1 "Untergrenze Differenzdrehzahl waehrend Gangeinlegen bei kleinem n_ab" VALUE 0x1D8B8E ZF_kw_si16_S5_S3 5000 UMR_U_MIN_1_1_0_S5_S3 -5000 0 /end CHARACTERISTIC
/begin CHARACTERISTIC ND_TUNUWIG_GE_2 "Untergrenze Differenzdrehzahl waehrend Gangeinlegen bei kleinem n_ab" VALUE 0x1D8B92 ZF_kw_si16_S5_S3 5000 UMR_U_MIN_1_1_0_S5_S3 -5000 0 /end CHARACTERISTIC
/begin CHARACTERISTIC ND_TUNUWIG_GE_3 "Untergrenze Differenzdrehzahl waehrend Gangeinlegen bei kleinem n_ab" VALUE 0x1D8B96 ZF_kw_si16_S5_S3 5000 UMR_U_MIN_1_1_0_S5_S3 -5000 0 /end CHARACTERISTIC
/begin CHARACTERISTIC ND_TUNUWIG_GE_4 "Untergrenze Differenzdrehzahl waehrend Gangeinlegen bei kleinem n_ab" VALUE 0x1D8B9A ZF_kw_si16_S5_S3 5000 UMR_U_MIN_1_1_0_S5_S3 -5000 0 /end CHARACTERISTIC
/begin CHARACTERISTIC ND_TUNUWIG_GE_5 "Untergrenze Differenzdrehzahl waehrend Gangeinlegen bei kleinem n_ab" VALUE 0x1D8B9E ZF_kw_si16_S5_S3 5000 UMR_U_MIN_1_1_0_S5_S3 -5000 0 /end CHARACTERISTIC
/begin CHARACTERISTIC ND_TUNUWIG_GE_6 "Untergrenze Differenzdrehzahl waehrend Gangeinlegen bei kleinem n_ab" VALUE 0x1D8BA2 ZF_kw_si16_S5_S3 5000 UMR_U_MIN_1_1_0_S5_S3 -5000 0 /end CHARACTERISTIC
/begin CHARACTERISTIC ND_TUNUWIG_GE_7 "Untergrenze Differenzdrehzahl waehrend Gangeinlegen bei kleinem n_ab" VALUE 0x1D8BA6 ZF_kw_si16_S5_S3 5000 UMR_U_MIN_1_1_0_S5_S3 -5000 0 /end CHARACTERISTIC
/begin CHARACTERISTIC ND_TUNUWIG_GE_8 "Untergrenze Differenzdrehzahl waehrend Gangeinlegen bei kleinem n_ab" VALUE 0x1D8BAA ZF_kw_si16_S5_S3 5000 UMR_U_MIN_1_1_0_S5_S3 -5000 0 /end CHARACTERISTIC
/begin CHARACTERISTIC ND_TUNUWIG_GE_R "Untergrenze Differenzdrehzahl waehrend Gangeinlegen bei kleinem n_ab" VALUE 0x1D8B8A ZF_kw_si16_S5_S3 5000 UMR_U_MIN_1_1_0_S5_S3 -5000 0 /end CHARACTERISTIC
/begin CHARACTERISTIC ND_UWIG "Differenzdrehzahl fuer Ueberwachung ausserhalb Schaltung bei kleinen n_ab" VALUE 0x1D8B68 ZF_kw_ui16_S5_S3 8000 UMR_U_MIN_1_1_0_S5_S3 0 8000 /end CHARACTERISTIC
/begin CHARACTERISTIC ND_UWIGERS "Differenzdrehzahl fuer Ueberwachung ausserhalb Schaltung mit Ersatzwerten bei kleinen n_ab" VALUE 0x1D8B6A ZF_kw_ui16_S5_S3 8000 UMR_U_MIN_1_1_0_S5_S3 0 8000 /end CHARACTERISTIC
/begin CHARACTERISTIC NGS_ABUWIG12 "n_ab-Gradientenschwelle fuer Symptomerkennung waehrend Schaltung" VALUE 0x1D8BAC ZF_kw_si16_S5_S3 25000 UMR_U_MINSEC_1_1_0_S5_S3 -20000 5000 /end CHARACTERISTIC
/begin CHARACTERISTIC NGS_ABUWIG21 "n_ab-Gradientenschwelle fuer Symptomerkennung waehrend Schaltung" VALUE 0x1D8BBA ZF_kw_si16_S5_S3 25000 UMR_U_MINSEC_1_1_0_S5_S3 -20000 5000 /end CHARACTERISTIC
/begin CHARACTERISTIC NGS_ABUWIG23 "n_ab-Gradientenschwelle fuer Symptomerkennung waehrend Schaltung" VALUE 0x1D8BAE ZF_kw_si16_S5_S3 25000 UMR_U_MINSEC_1_1_0_S5_S3 -20000 5000 /end CHARACTERISTIC
/begin CHARACTERISTIC NGS_ABUWIG31 "n_ab-Gradientenschwelle fuer Symptomerkennung waehrend Schaltung" VALUE 0x1D8BC8 ZF_kw_si16_S5_S3 25000 UMR_U_MINSEC_1_1_0_S5_S3 -20000 5000 /end CHARACTERISTIC
/begin CHARACTERISTIC NGS_ABUWIG32 "n_ab-Gradientenschwelle fuer Symptomerkennung waehrend Schaltung" VALUE 0x1D8BBC ZF_kw_si16_S5_S3 25000 UMR_U_MINSEC_1_1_0_S5_S3 -20000 5000 /end CHARACTERISTIC
/begin CHARACTERISTIC NGS_ABUWIG34 "n_ab-Gradientenschwelle fuer Symptomerkennung waehrend Schaltung" VALUE 0x1D8BB0 ZF_kw_si16_S5_S3 25000 UMR_U_MINSEC_1_1_0_S5_S3 -20000 5000 /end CHARACTERISTIC
/begin CHARACTERISTIC NGS_ABUWIG42 "n_ab-Gradientenschwelle fuer Symptomerkennung waehrend Schaltung" VALUE 0x1D8BCA ZF_kw_si16_S5_S3 25000 UMR_U_MINSEC_1_1_0_S5_S3 -20000 5000 /end CHARACTERISTIC
/begin CHARACTERISTIC NGS_ABUWIG43 "n_ab-Gradientenschwelle fuer Symptomerkennung waehrend Schaltung" VALUE 0x1D8BBE ZF_kw_si16_S5_S3 25000 UMR_U_MINSEC_1_1_0_S5_S3 -20000 5000 /end CHARACTERISTIC
/begin CHARACTERISTIC NGS_ABUWIG45 "n_ab-Gradientenschwelle fuer Symptomerkennung waehrend Schaltung" VALUE 0x1D8BB2 ZF_kw_si16_S5_S3 25000 UMR_U_MINSEC_1_1_0_S5_S3 -20000 5000 /end CHARACTERISTIC
/begin CHARACTERISTIC NGS_ABUWIG51 "n_ab-Gradientenschwelle fuer Symptomerkennung waehrend Schaltung" VALUE 0x1D8BCC ZF_kw_si16_S5_S3 25000 UMR_U_MINSEC_1_1_0_S5_S3 -20000 5000 /end CHARACTERISTIC
/begin CHARACTERISTIC NGS_ABUWIG53 "n_ab-Gradientenschwelle fuer Symptomerkennung waehrend Schaltung" VALUE 0x1D8BCE ZF_kw_si16_S5_S3 25000 UMR_U_MINSEC_1_1_0_S5_S3 -20000 5000 /end CHARACTERISTIC
/begin CHARACTERISTIC NGS_ABUWIG54 "n_ab-Gradientenschwelle fuer Symptomerkennung waehrend Schaltung" VALUE 0x1D8BC0 ZF_kw_si16_S5_S3 25000 UMR_U_MINSEC_1_1_0_S5_S3 -20000 5000 /end CHARACTERISTIC
/begin CHARACTERISTIC NGS_ABUWIG56 "n_ab-Gradientenschwelle fuer Symptomerkennung waehrend Schaltung" VALUE 0x1D8BB4 ZF_kw_si16_S5_S3 25000 UMR_U_MINSEC_1_1_0_S5_S3 -20000 5000 /end CHARACTERISTIC
/begin CHARACTERISTIC NGS_ABUWIG63 "n_ab-Gradientenschwelle fuer Symptomerkennung waehrend Schaltung" VALUE 0x1D8BD0 ZF_kw_si16_S5_S3 25000 UMR_U_MINSEC_1_1_0_S5_S3 -20000 5000 /end CHARACTERISTIC
/begin CHARACTERISTIC NGS_ABUWIG64 "n_ab-Gradientenschwelle fuer Symptomerkennung waehrend Schaltung" VALUE 0x1D8BD2 ZF_kw_si16_S5_S3 25000 UMR_U_MINSEC_1_1_0_S5_S3 -20000 5000 /end CHARACTERISTIC
/begin CHARACTERISTIC NGS_ABUWIG65 "n_ab-Gradientenschwelle fuer Symptomerkennung waehrend Schaltung" VALUE 0x1D8BC2 ZF_kw_si16_S5_S3 25000 UMR_U_MINSEC_1_1_0_S5_S3 -20000 5000 /end CHARACTERISTIC
/begin CHARACTERISTIC NGS_ABUWIG67 "n_ab-Gradientenschwelle fuer Symptomerkennung waehrend Schaltung" VALUE 0x1D8BB6 ZF_kw_si16_S5_S3 25000 UMR_U_MINSEC_1_1_0_S5_S3 -20000 5000 /end CHARACTERISTIC
/begin CHARACTERISTIC NGS_ABUWIG71 "n_ab-Gradientenschwelle fuer Symptomerkennung waehrend Schaltung" VALUE 0x1D8BD4 ZF_kw_si16_S5_S3 25000 UMR_U_MINSEC_1_1_0_S5_S3 -20000 5000 /end CHARACTERISTIC
/begin CHARACTERISTIC NGS_ABUWIG75 "n_ab-Gradientenschwelle fuer Symptomerkennung waehrend Schaltung" VALUE 0x1D8BD6 ZF_kw_si16_S5_S3 25000 UMR_U_MINSEC_1_1_0_S5_S3 -20000 5000 /end CHARACTERISTIC
/begin CHARACTERISTIC NGS_ABUWIG76 "n_ab-Gradientenschwelle fuer Symptomerkennung waehrend Schaltung" VALUE 0x1D8BC4 ZF_kw_si16_S5_S3 25000 UMR_U_MINSEC_1_1_0_S5_S3 -20000 5000 /end CHARACTERISTIC
/begin CHARACTERISTIC NGS_ABUWIG78 "n_ab-Gradientenschwelle fuer Symptomerkennung waehrend Schaltung" VALUE 0x1D8BB8 ZF_kw_si16_S5_S3 25000 UMR_U_MINSEC_1_1_0_S5_S3 -20000 5000 /end CHARACTERISTIC
/begin CHARACTERISTIC NGS_ABUWIG82 "n_ab-Gradientenschwelle fuer Symptomerkennung waehrend Schaltung" VALUE 0x1D8BD8 ZF_kw_si16_S5_S3 25000 UMR_U_MINSEC_1_1_0_S5_S3 -20000 5000 /end CHARACTERISTIC
/begin CHARACTERISTIC NGS_ABUWIG84 "n_ab-Gradientenschwelle fuer Symptomerkennung waehrend Schaltung" VALUE 0x1D8BDA ZF_kw_si16_S5_S3 25000 UMR_U_MINSEC_1_1_0_S5_S3 -20000 5000 /end CHARACTERISTIC
/begin CHARACTERISTIC NGS_ABUWIG86 "n_ab-Gradientenschwelle fuer Symptomerkennung waehrend Schaltung" VALUE 0x1D8BDC ZF_kw_si16_S5_S3 25000 UMR_U_MINSEC_1_1_0_S5_S3 -20000 5000 /end CHARACTERISTIC
/begin CHARACTERISTIC NGS_ABUWIG87 "n_ab-Gradientenschwelle fuer Symptomerkennung waehrend Schaltung" VALUE 0x1D8BC6 ZF_kw_si16_S5_S3 25000 UMR_U_MINSEC_1_1_0_S5_S3 -20000 5000 /end CHARACTERISTIC
/begin CHARACTERISTIC NGT_MAXUWIG_GE "maximaler Turbinendrehzahlgradient fuer Ueberwachung Gangeinlegen" VALUE 0x1D8B6C ZF_kw_si16_S5_S3 10000 UMR_U_MINSEC_1_1_0_S5_S3 0 10000 /end CHARACTERISTIC
/begin CHARACTERISTIC NMOTMAX_POSVUEB "NMot Drehzahlschwelle, ab der der Timer für Zündung aus über Neustart, startet" VALUE 0x1D8BE6 ZF_kw_ui16_S5_S3 8160 UMR_U_MIN_1_1_0_S5_S3 0 8160 /end CHARACTERISTIC
/begin CHARACTERISTIC NS_ABIEPUWIG "Drehzahlschwelle des Betriebs zur Erkennung eines IEP-Symptoms" VALUE 0x1D8B86 ZF_kw_ui16_S5_S3 1200 UMR_U_MIN_1_1_0_S5_S3 0 1200 /end CHARACTERISTIC
/begin CHARACTERISTIC NS_ABUWIG "Abtriebsdrehzahlschwelle fuer Symptomerkennung" VALUE 0x1D8B6E ZF_kw_ui16_S5_S3 8160 UMR_U_MIN_1_1_0_S5_S3 0 8160 /end CHARACTERISTIC
/begin CHARACTERISTIC NS_ABUWIG2 "Abtriebsdrehzahlschwelle fuer Symptomerkennung bei n_mot kleiner NS_MOTUWIG" VALUE 0x1D8B70 ZF_kw_ui16_S5_S3 8160 UMR_U_MIN_1_1_0_S5_S3 0 8160 /end CHARACTERISTIC
/begin CHARACTERISTIC NS_EMIEPUWIG "Drehzahlschwelle der EM zur Erkennung eines IEP-Symptoms" VALUE 0x1D8B82 ZF_kw_ui16_S5_S3 8160 UMR_U_MIN_1_1_0_S5_S3 0 8160 /end CHARACTERISTIC
/begin CHARACTERISTIC NS_EMIEPUWIGMIN "Überwachungsschwelle für EM-Drehzahl" VALUE 0x1D8B84 ZF_kw_ui16_S5_S3 1200 UMR_U_MIN_1_1_0_S5_S3 0 1200 /end CHARACTERISTIC
/begin CHARACTERISTIC NS_ESTART "E Maschine Drehzahlschwelle zum Start der SFKT Leerlauf Kolben E nach E-Maschinen Start" VALUE 0x1D8B5E ZF_kw_ui16_S5_S3 8000 UMR_U_MIN_1_1_0_S5_S3 0 8000 /end CHARACTERISTIC
/begin CHARACTERISTIC NS_ESTARTHYS "Hysterese für E Maschinen Drehzahlschwelle zum Start der Sonderfunktion" VALUE 0x1D8B62 ZF_kw_ui16_S5_S3 8000 UMR_U_MIN_1_1_0_S5_S3 0 8000 /end CHARACTERISTIC
/begin CHARACTERISTIC NS_MOTFUELLOPT "Drehzahlschwelle zur Aktivierung der opt. Befuellung" VALUE 0x1D8B5C ZF_kw_ui16_S5_S3 8000 UMR_U_MIN_1_1_0_S5_S3 0 8000 /end CHARACTERISTIC
/begin CHARACTERISTIC NS_MOTUWIGHYB "Motordrehzahlschwelle zur Symptomerkennung UIG-Ueberwachung (Hybrid)" VALUE 0x1D8B72 ZF_kw_ui16_S5_S3 8000 UMR_U_MIN_1_1_0_S5_S3 0 8000 /end CHARACTERISTIC
/begin CHARACTERISTIC NS_TPSYSIAEHYS "Hysterese für Turbinendrehzahl für FKt. Reduzierung Hochlastschudder IAE" VALUE 0x1D8B3A ZF_kw_ui16_S5_S3 1000 UMR_U_MIN_1_1_0_S5_S3 0 1000 /end CHARACTERISTIC
/begin CHARACTERISTIC NS_TPSYSIAEOB "Obere Turbinendrehzahlschwelle für FKt. Reduzierung Hochlastschudder IAE" VALUE 0x1D8B3C ZF_kw_ui16_S5_S3 8000 UMR_U_MIN_1_1_0_S5_S3 0 8000 /end CHARACTERISTIC
/begin CHARACTERISTIC NS_TPSYSIAEUN "Untere Turbinendrehzahlschwelle für FKt. Reduzierung Hochlastschudder IAE" VALUE 0x1D8B3E ZF_kw_ui16_S5_S3 8000 UMR_U_MIN_1_1_0_S5_S3 0 8000 /end CHARACTERISTIC
/begin CHARACTERISTIC NS_TUWIG "Pruefbedinung Turbinendrehzahlschwelle fuer die Symptomerkennung" VALUE 0x1D8B74 ZF_kw_ui16_S5_S3 9999 UMR_U_MIN_1_1_0_S5_S3 0 9999 /end CHARACTERISTIC
/begin CHARACTERISTIC N_ABUWIGRNF "Abtriebsdrehzahlschwelle fuer Rueckkehr zur Normalfunktion UWIG" VALUE 0x1D8B66 ZF_kw_ui16_S5_S3 8160 UMR_U_MIN_1_1_0_S5_S3 0 8160 /end CHARACTERISTIC
/begin CHARACTERISTIC N_DIFF_EM_MAX "ASIL-B: Maximal zulässige Differenzdrehzahl an der EM" VALUE 0x1D8BF2 ZF_kw_ui16_S5_S3 1200 UMR_U_MIN_1_1_0_S5_S3 0 1200 /end CHARACTERISTIC
/begin CHARACTERISTIC N_DIF_IAE_UWIG "Schwelle für den reellen Bauteilschlupf von Kupplung B (auf Getriebeeingang bezogen)." VALUE 0x1D8B80 ZF_kw_si16_S5_S3 2540 UMR_U_MIN_1_1_0_S5_S3 0 2540 /end CHARACTERISTIC
/begin CHARACTERISTIC N_K0_TASKS "ASIL-B: Anzahl der Tasks bis bei Unterschreiten der K0-Stromschwelle aus der Funktion ausgestiegen wird." VALUE 0x1D7C8A ZF_kw_ui8_S5_S3 255 UMR_NM__1_1_0_S5_S3 0 255 /end CHARACTERISTIC
/begin CHARACTERISTIC N_KUP_OFFEN "ASIL-C: Zähler zur Verzögerung der Erkennung - Schaltelement nicht geschaltet" VALUE 0x1D7C8F ZF_kw_ui8_S5_S3 5 UMR___1_1_0_S5_S3 0 5 /end CHARACTERISTIC
/begin CHARACTERISTIC N_KUP_OFFEN_STROMLOS "ASIL-C: Zähler zur Verzögerung der Stromlos-Erkennung - Schaltelement nicht geschaltet" VALUE 0x1D7C90 ZF_kw_ui8_S5_S3 5 UMR___1_1_0_S5_S3 0 5 /end CHARACTERISTIC
/begin CHARACTERISTIC N_MAXKABPOS_C "ASIL-C: Zähler zur erweiterten Erkennungn Kupplung C nicht geschaltet bei Teilfunktion Plausibilisierung Aktuatoransteuerung/ Sollposition eines Kraftschlusswechsels" VALUE 0x1D7C84 ZF_kw_ui8_S5_S3 255 UMR___1_1_0_S5_S3 0 255 /end CHARACTERISTIC
/begin CHARACTERISTIC N_MAXKABPOS_E "ASIL-C: Zähler zur erweiterten Erkennungn Kupplung E nicht geschaltet bei Teilfunktion Plausibilisierung Aktuatoransteuerung/ Sollposition eines Kraftschlusswechsels" VALUE 0x1D7C85 ZF_kw_ui8_S5_S3 255 UMR___1_1_0_S5_S3 0 255 /end CHARACTERISTIC
/begin CHARACTERISTIC N_MAXKFLWECHSEL "ASIL-C: Zähler zur Erkennung eines Kraftschlusswechsels" VALUE 0x1D7C86 ZF_kw_ui8_S5_S3 255 UMR___1_1_0_S5_S3 0 255 /end CHARACTERISTIC
/begin CHARACTERISTIC N_MAXSTOERMGETRAUF "Schwellwert für den Störzähler" VALUE 0x1D8BFA ZF_kw_ui16_S5_S3 255 UMR___1_1_0_S5_S3 0 255 /end CHARACTERISTIC
/begin CHARACTERISTIC N_MAXSTOERPOS_P "Störzähler für Überwachung unzulässiges Auslegen Position P" VALUE 0x1D7C87 ZF_kw_ui8_S5_S3 255 UMR___1_1_0_S5_S3 0 255 /end CHARACTERISTIC
/begin CHARACTERISTIC N_MAXSTOERVPLAUSIPOS_P "ASIL-C: Stoerzaehler fuer Ueberwachung unzulaessiges Einlegen Position P" VALUE 0x1D7C88 ZF_kw_ui8_S5_S3 255 UMR___1_1_0_S5_S3 0 255 /end CHARACTERISTIC
/begin CHARACTERISTIC N_MOTMAXPSYS "Motordrehzahlschwelle für Ansteuerung max. Systemdruck" VALUE 0x1D8B42 ZF_kw_ui16_S5_S3 8200 UMR_U_MIN_1_1_0_S5_S3 0 8200 /end CHARACTERISTIC
/begin CHARACTERISTIC N_STOER_MAX_FAHRTR_EDSLOGIK "ASIL-B: Störzählerschwelle zur Anfilterung des KFC1_POSLEV2" VALUE 0x1D7C8C ZF_kw_ui8_S5_S3 255 UMR___1_1_0_S5_S3 0 255 /end CHARACTERISTIC
/begin CHARACTERISTIC N_SYMOFNEUGETR "Offest auf Maximalwert fuer Symptomzaehler bei Neugetrieben" VALUE 0x1D7C0C ZF_kw_ui8_S5_S3 20 UMR___1_1_0_S5_S3 0 20 /end CHARACTERISTIC
/begin CHARACTERISTIC N_VERZ_EDSLOGIK "ASIL-B: Entprellzeit für RGang-Erkennung" VALUE 0x1D7C8B ZF_kw_ui8_S5_S3 255 UMR___1_1_0_S5_S3 0 255 /end CHARACTERISTIC
/begin CHARACTERISTIC N_VPOSPUEB "ASIL-C: Verzögerungszähler für Einstieg in Überwachung (Degradation)" VALUE 0x1D8BF0 ZF_kw_ui16_S5_S3 400 UMR___1_1_0_S5_S3 0 400 /end CHARACTERISTIC
/begin CHARACTERISTIC P_SYSIAE_INC "Druckerhöhung/Task für die Fkt. Reduzierung Hochlastschudder IAE" VALUE 0x1D8B40 ZF_kw_si16_S5_S3 100 UMR_BAR_SEC_1_10_0_S5_S3 0 100 /end CHARACTERISTIC
/begin CHARACTERISTIC P_SYSMIN12 "Mindestsystemdruck waehrend Schaltungen, Gangein- und auslegen" VALUE 0x1D8ABE ZF_kw_ui16_S5_S3 9 UMR_BAR__1_1000_0_S5_S3 0 9 /end CHARACTERISTIC
/begin CHARACTERISTIC P_SYSMIN21 "Mindestsystemdruck waehrend Schaltungen, Gangein- und auslegen" VALUE 0x1D8AE8 ZF_kw_ui16_S5_S3 9 UMR_BAR__1_1000_0_S5_S3 0 9 /end CHARACTERISTIC
/begin CHARACTERISTIC P_SYSMIN23 "Mindestsystemdruck waehrend Schaltungen, Gangein- und auslegen" VALUE 0x1D8AC4 ZF_kw_ui16_S5_S3 9 UMR_BAR__1_1000_0_S5_S3 0 9 /end CHARACTERISTIC
/begin CHARACTERISTIC P_SYSMIN32 "Mindestsystemdruck waehrend Schaltungen, Gangein- und auslegen" VALUE 0x1D8AEC ZF_kw_ui16_S5_S3 9 UMR_BAR__1_1000_0_S5_S3 0 9 /end CHARACTERISTIC
/begin CHARACTERISTIC P_SYSMIN34 "Mindestsystemdruck waehrend Schaltungen, Gangein- und auslegen" VALUE 0x1D8ACA ZF_kw_ui16_S5_S3 9 UMR_BAR__1_1000_0_S5_S3 0 9 /end CHARACTERISTIC
/begin CHARACTERISTIC P_SYSMIN43 "Mindestsystemdruck waehrend Schaltungen, Gangein- und auslegen" VALUE 0x1D8AF0 ZF_kw_ui16_S5_S3 9 UMR_BAR__1_1000_0_S5_S3 0 9 /end CHARACTERISTIC
/begin CHARACTERISTIC P_SYSMIN45 "Mindestsystemdruck waehrend Schaltungen, Gangein- und auslegen" VALUE 0x1D8AD0 ZF_kw_ui16_S5_S3 9 UMR_BAR__1_1000_0_S5_S3 0 9 /end CHARACTERISTIC
/begin CHARACTERISTIC P_SYSMIN54 "Mindestsystemdruck waehrend Schaltungen, Gangein- und auslegen" VALUE 0x1D8AF4 ZF_kw_ui16_S5_S3 9 UMR_BAR__1_1000_0_S5_S3 0 9 /end CHARACTERISTIC
/begin CHARACTERISTIC P_SYSMIN56 "Mindestsystemdruck waehrend Schaltungen, Gangein- und auslegen" VALUE 0x1D8AD6 ZF_kw_ui16_S5_S3 9 UMR_BAR__1_1000_0_S5_S3 0 9 /end CHARACTERISTIC
/begin CHARACTERISTIC P_SYSMIN65 "Mindestsystemdruck waehrend Schaltungen, Gangein- und auslegen" VALUE 0x1D8AF8 ZF_kw_ui16_S5_S3 9 UMR_BAR__1_1000_0_S5_S3 0 9 /end CHARACTERISTIC
/begin CHARACTERISTIC P_SYSMIN67 "Mindestsystemdruck waehrend Schaltungen, Gangein- und auslegen" VALUE 0x1D8ADC ZF_kw_ui16_S5_S3 9 UMR_BAR__1_1000_0_S5_S3 0 9 /end CHARACTERISTIC
/begin CHARACTERISTIC P_SYSMIN76 "Mindestsystemdruck waehrend Schaltungen, Gangein- und auslegen" VALUE 0x1D8AFC ZF_kw_ui16_S5_S3 9 UMR_BAR__1_1000_0_S5_S3 0 9 /end CHARACTERISTIC
/begin CHARACTERISTIC P_SYSMIN78 "Mindestsystemdruck waehrend Schaltungen, Gangein- und auslegen" VALUE 0x1D8AE2 ZF_kw_ui16_S5_S3 9 UMR_BAR__1_1000_0_S5_S3 0 9 /end CHARACTERISTIC
/begin CHARACTERISTIC P_SYSMIN87 "Mindestsystemdruck waehrend Schaltungen, Gangein- und auslegen" VALUE 0x1D8B00 ZF_kw_ui16_S5_S3 9 UMR_BAR__1_1000_0_S5_S3 0 9 /end CHARACTERISTIC
/begin CHARACTERISTIC P_SYSMINCKUPL "Systemdruck zur Sicherstellung Kühlbedingungen" VALUE 0x1D8B58 ZF_kw_ui16_S5_S3 9 UMR_BAR__1_1000_0_S5_S3 0 9 /end CHARACTERISTIC
/begin CHARACTERISTIC P_SYSMINFUELLOPT12 "Mindestsystemdruck waehrend Schaltungen, bei aktiver Fkt. optimierte Befuellung" VALUE 0x1D8AC0 ZF_kw_ui16_S5_S3 9 UMR_BAR__1_1000_0_S5_S3 0 9 /end CHARACTERISTIC
/begin CHARACTERISTIC P_SYSMINFUELLOPT23 "Mindestsystemdruck waehrend Schaltungen, bei aktiver Fkt. optimierte Befuellung" VALUE 0x1D8AC6 ZF_kw_ui16_S5_S3 9 UMR_BAR__1_1000_0_S5_S3 0 9 /end CHARACTERISTIC
/begin CHARACTERISTIC P_SYSMINFUELLOPT34 "Mindestsystemdruck waehrend Schaltungen, bei aktiver Fkt. optimierte Befuellung" VALUE 0x1D8ACC ZF_kw_ui16_S5_S3 9 UMR_BAR__1_1000_0_S5_S3 0 9 /end CHARACTERISTIC
/begin CHARACTERISTIC P_SYSMINFUELLOPT45 "Mindestsystemdruck waehrend Schaltungen, bei aktiver Fkt. optimierte Befuellung" VALUE 0x1D8AD2 ZF_kw_ui16_S5_S3 9 UMR_BAR__1_1000_0_S5_S3 0 9 /end CHARACTERISTIC
/begin CHARACTERISTIC P_SYSMINFUELLOPT56 "Mindestsystemdruck waehrend Schaltungen, bei aktiver Fkt. optimierte Befuellung" VALUE 0x1D8AD8 ZF_kw_ui16_S5_S3 9 UMR_BAR__1_1000_0_S5_S3 0 9 /end CHARACTERISTIC
/begin CHARACTERISTIC P_SYSMINFUELLOPT67 "Mindestsystemdruck waehrend Schaltungen, bei aktiver Fkt. optimierte Befuellung" VALUE 0x1D8ADE ZF_kw_ui16_S5_S3 9 UMR_BAR__1_1000_0_S5_S3 0 9 /end CHARACTERISTIC
/begin CHARACTERISTIC P_SYSMINFUELLOPT78 "Mindestsystemdruck waehrend Schaltungen, bei aktiver Fkt. optimierte Befuellung" VALUE 0x1D8AE4 ZF_kw_ui16_S5_S3 9 UMR_BAR__1_1000_0_S5_S3 0 9 /end CHARACTERISTIC
/begin CHARACTERISTIC P_SYSMINFUELLOPT_K0 "Mindestsystemdruck bei Funktion optimierte Befuellung wenn K0 aktiv" VALUE 0x1D8B54 ZF_kw_ui16_S5_S3 9 UMR_BAR__1_1000_0_S5_S3 0 9 /end CHARACTERISTIC
/begin CHARACTERISTIC P_SYSMINFUELLRED12 "Mindestsystemdruck waehrend Schaltungen bei red Befüllung" VALUE 0x1D8AC2 ZF_kw_ui16_S5_S3 9 UMR_BAR__1_1000_0_S5_S3 0 9 /end CHARACTERISTIC
/begin CHARACTERISTIC P_SYSMINFUELLRED21 "Mindestsystemdruck waehrend Schaltungen bei red Befüllung" VALUE 0x1D8AEA ZF_kw_ui16_S5_S3 9 UMR_BAR__1_1000_0_S5_S3 0 9 /end CHARACTERISTIC
/begin CHARACTERISTIC P_SYSMINFUELLRED23 "Mindestsystemdruck waehrend Schaltungen bei red Befüllung" VALUE 0x1D8AC8 ZF_kw_ui16_S5_S3 9 UMR_BAR__1_1000_0_S5_S3 0 9 /end CHARACTERISTIC
/begin CHARACTERISTIC P_SYSMINFUELLRED32 "Mindestsystemdruck waehrend Schaltungen bei red Befüllung" VALUE 0x1D8AEE ZF_kw_ui16_S5_S3 9 UMR_BAR__1_1000_0_S5_S3 0 9 /end CHARACTERISTIC
/begin CHARACTERISTIC P_SYSMINFUELLRED34 "Mindestsystemdruck waehrend Schaltungen bei red Befüllung" VALUE 0x1D8ACE ZF_kw_ui16_S5_S3 9 UMR_BAR__1_1000_0_S5_S3 0 9 /end CHARACTERISTIC
/begin CHARACTERISTIC P_SYSMINFUELLRED43 "Mindestsystemdruck waehrend Schaltungen bei red Befüllung" VALUE 0x1D8AF2 ZF_kw_ui16_S5_S3 9 UMR_BAR__1_1000_0_S5_S3 0 9 /end CHARACTERISTIC
/begin CHARACTERISTIC P_SYSMINFUELLRED45 "Mindestsystemdruck waehrend Schaltungen bei red Befüllung" VALUE 0x1D8AD4 ZF_kw_ui16_S5_S3 9 UMR_BAR__1_1000_0_S5_S3 0 9 /end CHARACTERISTIC
/begin CHARACTERISTIC P_SYSMINFUELLRED54 "Mindestsystemdruck waehrend Schaltungen bei red Befüllung" VALUE 0x1D8AF6 ZF_kw_ui16_S5_S3 9 UMR_BAR__1_1000_0_S5_S3 0 9 /end CHARACTERISTIC
/begin CHARACTERISTIC P_SYSMINFUELLRED56 "Mindestsystemdruck waehrend Schaltungen bei red Befüllung" VALUE 0x1D8ADA ZF_kw_ui16_S5_S3 9 UMR_BAR__1_1000_0_S5_S3 0 9 /end CHARACTERISTIC
/begin CHARACTERISTIC P_SYSMINFUELLRED65 "Mindestsystemdruck waehrend Schaltungen bei red Befüllung" VALUE 0x1D8AFA ZF_kw_ui16_S5_S3 9 UMR_BAR__1_1000_0_S5_S3 0 9 /end CHARACTERISTIC
/begin CHARACTERISTIC P_SYSMINFUELLRED67 "Mindestsystemdruck waehrend Schaltungen bei red Befüllung" VALUE 0x1D8AE0 ZF_kw_ui16_S5_S3 9 UMR_BAR__1_1000_0_S5_S3 0 9 /end CHARACTERISTIC
/begin CHARACTERISTIC P_SYSMINFUELLRED76 "Mindestsystemdruck waehrend Schaltungen bei red Befüllung" VALUE 0x1D8AFE ZF_kw_ui16_S5_S3 9 UMR_BAR__1_1000_0_S5_S3 0 9 /end CHARACTERISTIC
/begin CHARACTERISTIC P_SYSMINFUELLRED78 "Mindestsystemdruck waehrend Schaltungen bei red Befüllung" VALUE 0x1D8AE6 ZF_kw_ui16_S5_S3 9 UMR_BAR__1_1000_0_S5_S3 0 9 /end CHARACTERISTIC
/begin CHARACTERISTIC P_SYSMINFUELLRED87 "Mindestsystemdruck waehrend Schaltungen bei red Befüllung" VALUE 0x1D8B02 ZF_kw_ui16_S5_S3 9 UMR_BAR__1_1000_0_S5_S3 0 9 /end CHARACTERISTIC
/begin CHARACTERISTIC P_SYSMINFUELLREDSP31 "Mindestsystemdruck waehrend Schaltungen bei red Befüllung" VALUE 0x1D8B06 ZF_kw_ui16_S5_S3 9 UMR_BAR__1_1000_0_S5_S3 0 9 /end CHARACTERISTIC
/begin CHARACTERISTIC P_SYSMINFUELLREDSP42 "Mindestsystemdruck waehrend Schaltungen bei red Befüllung" VALUE 0x1D8B0A ZF_kw_ui16_S5_S3 9 UMR_BAR__1_1000_0_S5_S3 0 9 /end CHARACTERISTIC
/begin CHARACTERISTIC P_SYSMINFUELLREDSP51 "Mindestsystemdruck waehrend Schaltungen bei red Befüllung" VALUE 0x1D8B1E ZF_kw_ui16_S5_S3 9 UMR_BAR__1_1000_0_S5_S3 0 9 /end CHARACTERISTIC
/begin CHARACTERISTIC P_SYSMINFUELLREDSP53 "Mindestsystemdruck waehrend Schaltungen bei red Befüllung" VALUE 0x1D8B0E ZF_kw_ui16_S5_S3 9 UMR_BAR__1_1000_0_S5_S3 0 9 /end CHARACTERISTIC
/begin CHARACTERISTIC P_SYSMINFUELLREDSP63 "Mindestsystemdruck waehrend Schaltungen bei red Befüllung" VALUE 0x1D8B22 ZF_kw_ui16_S5_S3 9 UMR_BAR__1_1000_0_S5_S3 0 9 /end CHARACTERISTIC
/begin CHARACTERISTIC P_SYSMINFUELLREDSP64 "Mindestsystemdruck waehrend Schaltungen bei red Befüllung" VALUE 0x1D8B12 ZF_kw_ui16_S5_S3 9 UMR_BAR__1_1000_0_S5_S3 0 9 /end CHARACTERISTIC
/begin CHARACTERISTIC P_SYSMINFUELLREDSP71 "Mindestsystemdruck waehrend Schaltungen bei red Befüllung" VALUE 0x1D8B26 ZF_kw_ui16_S5_S3 9 UMR_BAR__1_1000_0_S5_S3 0 9 /end CHARACTERISTIC
/begin CHARACTERISTIC P_SYSMINFUELLREDSP75 "Mindestsystemdruck waehrend Schaltungen bei red Befüllung" VALUE 0x1D8B16 ZF_kw_ui16_S5_S3 9 UMR_BAR__1_1000_0_S5_S3 0 9 /end CHARACTERISTIC
/begin CHARACTERISTIC P_SYSMINFUELLREDSP82 "Mindestsystemdruck waehrend Schaltungen bei red Befüllung" VALUE 0x1D8B2A ZF_kw_ui16_S5_S3 9 UMR_BAR__1_1000_0_S5_S3 0 9 /end CHARACTERISTIC
/begin CHARACTERISTIC P_SYSMINFUELLREDSP84 "Mindestsystemdruck waehrend Schaltungen bei red Befüllung" VALUE 0x1D8B2E ZF_kw_ui16_S5_S3 9 UMR_BAR__1_1000_0_S5_S3 0 9 /end CHARACTERISTIC
/begin CHARACTERISTIC P_SYSMINFUELLREDSP86 "Mindestsystemdruck waehrend Schaltungen bei red Befüllung" VALUE 0x1D8B1A ZF_kw_ui16_S5_S3 9 UMR_BAR__1_1000_0_S5_S3 0 9 /end CHARACTERISTIC
/begin CHARACTERISTIC P_SYSMINFUELLRED_D "Mindestsystemdruck waehrend Gangeinlegen nach D bei red Befüllung" VALUE 0x1D8B4A ZF_kw_ui16_S5_S3 9 UMR_BAR__1_1000_0_S5_S3 0 9 /end CHARACTERISTIC
/begin CHARACTERISTIC P_SYSMINFUELLRED_K0 "Mindestsystemdruck waehrend Gangeinlegen bei red Befüllung" VALUE 0x1D8B50 ZF_kw_ui16_S5_S3 9 UMR_BAR__1_1000_0_S5_S3 0 9 /end CHARACTERISTIC
/begin CHARACTERISTIC P_SYSMINFUELLRED_R "Mindestsystemdruck waehrend Gangeinlegen nach R bei red Befüllung" VALUE 0x1D8B4C ZF_kw_ui16_S5_S3 9 UMR_BAR__1_1000_0_S5_S3 0 9 /end CHARACTERISTIC
/begin CHARACTERISTIC P_SYSMINIEP "Mindestsystemdruck fuer zusaetzliche Leckage fuer IEP" VALUE 0x1D8B5A ZF_kw_ui16_S5_S3 9 UMR_BAR__1_1000_0_S5_S3 0 9 /end CHARACTERISTIC
/begin CHARACTERISTIC P_SYSMINK0 "Mindestsystemdruck für K0S während Befüllung K0" VALUE 0x1D8B52 ZF_kw_ui16_S5_S3 9 UMR_BAR__1_1000_0_S5_S3 0 9 /end CHARACTERISTIC
/begin CHARACTERISTIC P_SYSMINPOSV "Mindestsystemdruck während Positionsventilüberwachung" VALUE 0x1D8B32 ZF_kw_ui16_S5_S3 10 UMR_BAR__1_1000_0_S5_S3 0 10 /end CHARACTERISTIC
/begin CHARACTERISTIC P_SYSMINPULS "Mindestsystemdruck waehrend Pulspruefung" VALUE 0x1D8B4E ZF_kw_ui16_S5_S3 9 UMR_BAR__1_1000_0_S5_S3 0 9 /end CHARACTERISTIC
/begin CHARACTERISTIC P_SYSMINSP31 "Mindestsystemdruck waehrend Schaltungen, Gangein- und auslegen" VALUE 0x1D8B04 ZF_kw_ui16_S5_S3 9 UMR_BAR__1_1000_0_S5_S3 0 9 /end CHARACTERISTIC
/begin CHARACTERISTIC P_SYSMINSP42 "Mindestsystemdruck waehrend Schaltungen, Gangein- und auslegen" VALUE 0x1D8B08 ZF_kw_ui16_S5_S3 9 UMR_BAR__1_1000_0_S5_S3 0 9 /end CHARACTERISTIC
/begin CHARACTERISTIC P_SYSMINSP51 "Mindestsystemdruck waehrend Schaltungen, Gangein- und auslegen" VALUE 0x1D8B1C ZF_kw_ui16_S5_S3 9 UMR_BAR__1_1000_0_S5_S3 0 9 /end CHARACTERISTIC
/begin CHARACTERISTIC P_SYSMINSP53 "Mindestsystemdruck waehrend Schaltungen, Gangein- und auslegen" VALUE 0x1D8B0C ZF_kw_ui16_S5_S3 9 UMR_BAR__1_1000_0_S5_S3 0 9 /end CHARACTERISTIC
/begin CHARACTERISTIC P_SYSMINSP63 "Mindestsystemdruck waehrend Schaltungen, Gangein- und auslegen" VALUE 0x1D8B20 ZF_kw_ui16_S5_S3 9 UMR_BAR__1_1000_0_S5_S3 0 9 /end CHARACTERISTIC
/begin CHARACTERISTIC P_SYSMINSP64 "Mindestsystemdruck waehrend Schaltungen, Gangein- und auslegen" VALUE 0x1D8B10 ZF_kw_ui16_S5_S3 9 UMR_BAR__1_1000_0_S5_S3 0 9 /end CHARACTERISTIC
/begin CHARACTERISTIC P_SYSMINSP71 "Mindestsystemdruck waehrend Schaltungen, Gangein- und auslegen" VALUE 0x1D8B24 ZF_kw_ui16_S5_S3 9 UMR_BAR__1_1000_0_S5_S3 0 9 /end CHARACTERISTIC
/begin CHARACTERISTIC P_SYSMINSP75 "Mindestsystemdruck waehrend Schaltungen, Gangein- und auslegen" VALUE 0x1D8B14 ZF_kw_ui16_S5_S3 9 UMR_BAR__1_1000_0_S5_S3 0 9 /end CHARACTERISTIC
/begin CHARACTERISTIC P_SYSMINSP82 "Mindestsystemdruck waehrend Schaltungen, Gangein- und auslegen" VALUE 0x1D8B28 ZF_kw_ui16_S5_S3 9 UMR_BAR__1_1000_0_S5_S3 0 9 /end CHARACTERISTIC
/begin CHARACTERISTIC P_SYSMINSP84 "Mindestsystemdruck waehrend Schaltungen, Gangein- und auslegen" VALUE 0x1D8B2C ZF_kw_ui16_S5_S3 9 UMR_BAR__1_1000_0_S5_S3 0 9 /end CHARACTERISTIC
/begin CHARACTERISTIC P_SYSMINSP86 "Mindestsystemdruck waehrend Schaltungen, Gangein- und auslegen" VALUE 0x1D8B18 ZF_kw_ui16_S5_S3 9 UMR_BAR__1_1000_0_S5_S3 0 9 /end CHARACTERISTIC
/begin CHARACTERISTIC P_SYSMIN_D "Mindestsystemdruck waehrend Gangeinlegen nach D" VALUE 0x1D8B46 ZF_kw_ui16_S5_S3 9 UMR_BAR__1_1000_0_S5_S3 0 9 /end CHARACTERISTIC
/begin CHARACTERISTIC P_SYSMIN_IAE_1 "minimaler Systemdruck zu Reduzierung Hochlastschudder IAE" VALUE 0x1D8ABA ZF_kw_ui16_S5_S3 22 UMR_BAR__1_1000_0_S5_S3 0 22 /end CHARACTERISTIC
/begin CHARACTERISTIC P_SYSMIN_IAE_2 "minimaler Systemdruck zu Reduzierung Hochlastschudder IAE" VALUE 0x1D8ABC ZF_kw_ui16_S5_S3 22 UMR_BAR__1_1000_0_S5_S3 0 22 /end CHARACTERISTIC
/begin CHARACTERISTIC P_SYSMIN_IAE_R "minimaler Systemdruck zu Reduzierung Hochlastschudder IAE" VALUE 0x1D8AB8 ZF_kw_ui16_S5_S3 22 UMR_BAR__1_1000_0_S5_S3 0 22 /end CHARACTERISTIC
/begin CHARACTERISTIC P_SYSMIN_R "Mindestsystemdruck waehrend Gangeinlegen nach R" VALUE 0x1D8B48 ZF_kw_ui16_S5_S3 9 UMR_BAR__1_1000_0_S5_S3 0 9 /end CHARACTERISTIC
/begin CHARACTERISTIC Q_FUELLRED_A "Grenze verfügbares Restölvolumen für die Aktivierung der Funktion red. Befüllung." VALUE 0x1D7BF7 ZF_kw_ui8_S5_S3 20 UMR_LITER_MIN_1_10_0_S5_S3 0 20 /end CHARACTERISTIC
/begin CHARACTERISTIC Q_FUELLRED_B "Grenze verfügbares Restölvolumen für die Aktivierung der Funktion red. Befüllung." VALUE 0x1D7BF8 ZF_kw_ui8_S5_S3 20 UMR_LITER_MIN_1_10_0_S5_S3 0 20 /end CHARACTERISTIC
/begin CHARACTERISTIC Q_FUELLRED_C "Grenze verfügbares Restölvolumen für die Aktivierung der Funktion red. Befüllung." VALUE 0x1D7BF9 ZF_kw_ui8_S5_S3 20 UMR_LITER_MIN_1_10_0_S5_S3 0 20 /end CHARACTERISTIC
/begin CHARACTERISTIC Q_FUELLRED_D "Grenze verfügbares Restölvolumen für die Aktivierung der Funktion red. Befüllung." VALUE 0x1D7BFA ZF_kw_ui8_S5_S3 20 UMR_LITER_MIN_1_10_0_S5_S3 0 20 /end CHARACTERISTIC
/begin CHARACTERISTIC Q_FUELLRED_E "Grenze verfügbares Restölvolumen für die Aktivierung der Funktion red. Befüllung." VALUE 0x1D7BFB ZF_kw_ui8_S5_S3 20 UMR_LITER_MIN_1_10_0_S5_S3 0 20 /end CHARACTERISTIC
/begin CHARACTERISTIC Q_FUELLRED_K0 "Grenze verfügbares Restölvolumen für die Aktivierung der Funktion red. Befüllung." VALUE 0x1D7BFC ZF_kw_ui8_S5_S3 20 UMR_LITER_MIN_1_10_0_S5_S3 0 20 /end CHARACTERISTIC
/begin CHARACTERISTIC Q_VERBR_IAE "Ölvolumen Druckregler für IAE" VALUE 0x1D7BF5 ZF_kw_ui8_S5_S3 20 UMR_LITER_MIN_1_10_0_S5_S3 0 20 /end CHARACTERISTIC
/begin CHARACTERISTIC Q_VERBR_K0 "Ölvolumen Druckregler für Trennkupplung K0" VALUE 0x1D7BF6 ZF_kw_ui8_S5_S3 20 UMR_LITER_MIN_1_10_0_S5_S3 0 20 /end CHARACTERISTIC
/begin CHARACTERISTIC Q_VERBR_KAB "Ölvolumen Druckregler abschaltendes Schaltelement" VALUE 0x1D7BF3 ZF_kw_ui8_S5_S3 20 UMR_LITER_MIN_1_10_0_S5_S3 0 20 /end CHARACTERISTIC
/begin CHARACTERISTIC Q_VERBR_SYS "Ölvolumen Systemdruckregler" VALUE 0x1D7BF4 ZF_kw_ui8_S5_S3 20 UMR_LITER_MIN_1_10_0_S5_S3 0 20 /end CHARACTERISTIC
/begin CHARACTERISTIC SWI_K0UEB "ASIL-B: zum Umschalten des Berechnungsverfahrens der Fehlererkennung" VALUE 0x1D7C89 ZF_kw_ui8_S5_S3 3 UMR___1_1_0_S5_S3 0 3 /end CHARACTERISTIC
/begin CHARACTERISTIC SWI_UWIG "Schalter Uebersetzungsueberwachung" VALUE 0x1D7C07 ZF_kw_ui8_S5_S3 1 UMR___1_1_0_S5_S3 0 1 /end CHARACTERISTIC
/begin CHARACTERISTIC SWI_UWIG_GE "Schalter Uebersetzungsueberwachung waehrend Gangeinlegen" VALUE 0x1D7C08 ZF_kw_ui8_S5_S3 1 UMR___1_1_0_S5_S3 0 1 /end CHARACTERISTIC
/begin CHARACTERISTIC TAB_PIEP_SYS "p_iep_sys fuer Minauswahl mit psys-gefiltert für p_sysist" CURVE 0x1CE4A8 ZF_tab_ui16_S5_S3 22 UMR_BAR__1_1000_0_S5_S3 0 22
 /begin AXIS_DESCR FIX_AXIS iIepStSig.status_iep UMR___1_1_0_S5_S3 5 0 4 READ_ONLY FIX_AXIS_PAR_DIST 0 1 5 /end AXIS_DESCR
/end CHARACTERISTIC
/begin CHARACTERISTIC TAB_SWIFUELLOPT "Schalter in abhaengigkeit von z_kurze_schaltung" CURVE 0x1CE518 ZF_tab_bool8_S5_S3 1 UMR___1_1_0_S5_S3 0 1
 /begin AXIS_DESCR FIX_AXIS iSasZentr.iSchaltend.z_kurze_schaltung UMR___1_1_0_S5_S3 8 0 7 READ_ONLY FIX_AXIS_PAR_DIST 0 1 8 /end AXIS_DESCR
/end CHARACTERISTIC
/begin CHARACTERISTIC TMAX_PMUEB "Zeitdauer nach der eine Prüfung des Magenten erfolgen soll" VALUE 0x1CF5A8 ZF_kw_ui32_S5_S3 100000000 UMR_MSEC__10_1_0_S5_S3 0 100000000 /end CHARACTERISTIC
/begin CHARACTERISTIC TS_ESTART "Zeitschwelle zum Einstieg der Sonderfunktion Kolben E" VALUE 0x1D8B60 ZF_kw_ui16_S5_S3 10000 UMR_MSEC__10_1_0_S5_S3 0 10000 /end CHARACTERISTIC
/begin CHARACTERISTIC TS_RZNUWIG "Zeitschwelle Rueckkehr zur Normalfunktion UWIG" VALUE 0x1D8B7A ZF_kw_ui16_S5_S3 650000 UMR_MSEC__10_1_0_S5_S3 0 650000 /end CHARACTERISTIC
/begin CHARACTERISTIC TVERZ_PMUEB "Verzögerungszeit zur Systemberuhigung" VALUE 0x1D8BDE ZF_kw_ui16_S5_S3 5000 UMR_MSEC__10_1_0_S5_S3 0 5000 /end CHARACTERISTIC
/begin CHARACTERISTIC T_FFUELLRED65 "Fuellzeit reduzierte Befüllung" VALUE 0x1D7BB5 ZF_kw_ui8_S5_S3 2540 UMR_MSEC__10_1_0_S5_S3 0 2540 /end CHARACTERISTIC
/begin CHARACTERISTIC T_FFUELLRED76 "Fuellzeit reduzierte Befüllung" VALUE 0x1D7BB9 ZF_kw_ui8_S5_S3 2540 UMR_MSEC__10_1_0_S5_S3 0 2540 /end CHARACTERISTIC
/begin CHARACTERISTIC T_FFUELLRED87 "Fuellzeit reduzierte Befüllung" VALUE 0x1D7BBD ZF_kw_ui8_S5_S3 2540 UMR_MSEC__10_1_0_S5_S3 0 2540 /end CHARACTERISTIC
/begin CHARACTERISTIC T_FFUELLREDSP64 "Fuellzeit reduzierte Befüllung" VALUE 0x1D7BD5 ZF_kw_ui8_S5_S3 2540 UMR_MSEC__10_1_0_S5_S3 0 2540 /end CHARACTERISTIC
/begin CHARACTERISTIC T_FFUELLREDSP71 "Fuellzeit reduzierte Befüllung" VALUE 0x1D7BD9 ZF_kw_ui8_S5_S3 2540 UMR_MSEC__10_1_0_S5_S3 0 2540 /end CHARACTERISTIC
/begin CHARACTERISTIC T_FFUELLREDSP75 "Fuellzeit reduzierte Befüllung" VALUE 0x1D7BDD ZF_kw_ui8_S5_S3 2540 UMR_MSEC__10_1_0_S5_S3 0 2540 /end CHARACTERISTIC
/begin CHARACTERISTIC T_FFUELLREDSP82 "Fuellzeit reduzierte Befüllung" VALUE 0x1D7BE1 ZF_kw_ui8_S5_S3 2540 UMR_MSEC__10_1_0_S5_S3 0 2540 /end CHARACTERISTIC
/begin CHARACTERISTIC T_FFUELLREDSP84 "Fuellzeit reduzierte Befüllung" VALUE 0x1D7BE5 ZF_kw_ui8_S5_S3 2540 UMR_MSEC__10_1_0_S5_S3 0 2540 /end CHARACTERISTIC
/begin CHARACTERISTIC T_FFUELLREDSP86 "Fuellzeit reduzierte Befüllung" VALUE 0x1D7BE9 ZF_kw_ui8_S5_S3 2540 UMR_MSEC__10_1_0_S5_S3 0 2540 /end CHARACTERISTIC
/begin CHARACTERISTIC T_FMGMOTSOLLUWIG "Filterzeit fuer Motorsollmomentgradient" VALUE 0x1D8B7C ZF_kw_ui16_S5_S3 999 UMR_MSEC__1_1_0_S5_S3 1 1000 /end CHARACTERISTIC
/begin CHARACTERISTIC T_FPSYS "Filterzeit fuer Systemdruck" VALUE 0x1D8B44 ZF_kw_ui16_S5_S3 2540 UMR_MSEC__1_1_0_S5_S3 0 2540 /end CHARACTERISTIC
/begin CHARACTERISTIC T_MAXSYMNEUGETR "Betriebszeit mit erhoehten Symptomzaehlerschwelle bei Neugetrieben" VALUE 0x1D8B7E ZF_kw_ui16_S5_S3 600 UMR_MIN__1_1_0_S5_S3 0 600 /end CHARACTERISTIC
/begin CHARACTERISTIC T_PMUEBDEF "Prüfdauer" VALUE 0x1D7C7F ZF_kw_ui8_S5_S3 2540 UMR_MSEC__10_1_0_S5_S3 0 2540 /end CHARACTERISTIC
/begin CHARACTERISTIC T_RA2SSCHR65 "Zeit 2.Rampe bei Schrittschaltung" VALUE 0x1D7BB6 ZF_kw_ui8_S5_S3 2540 UMR_MSEC__10_1_0_S5_S3 0 2540 /end CHARACTERISTIC
/begin CHARACTERISTIC T_RA2SSCHR76 "Zeit 2.Rampe bei Schrittschaltung" VALUE 0x1D7BBA ZF_kw_ui8_S5_S3 2540 UMR_MSEC__10_1_0_S5_S3 0 2540 /end CHARACTERISTIC
/begin CHARACTERISTIC T_RA2SSCHR87 "Zeit 2.Rampe bei Schrittschaltung" VALUE 0x1D7BBE ZF_kw_ui8_S5_S3 2540 UMR_MSEC__10_1_0_S5_S3 0 2540 /end CHARACTERISTIC
/begin CHARACTERISTIC T_RA2SSCHRSP64 "Zeit 2.Rampe bei Schrittschaltung" VALUE 0x1D7BD6 ZF_kw_ui8_S5_S3 2540 UMR_MSEC__10_1_0_S5_S3 0 2540 /end CHARACTERISTIC
/begin CHARACTERISTIC T_RA2SSCHRSP71 "Zeit 2.Rampe bei Schrittschaltung" VALUE 0x1D7BDA ZF_kw_ui8_S5_S3 2540 UMR_MSEC__10_1_0_S5_S3 0 2540 /end CHARACTERISTIC
/begin CHARACTERISTIC T_RA2SSCHRSP75 "Zeit 2.Rampe bei Schrittschaltung" VALUE 0x1D7BDE ZF_kw_ui8_S5_S3 2540 UMR_MSEC__10_1_0_S5_S3 0 2540 /end CHARACTERISTIC
/begin CHARACTERISTIC T_RA2SSCHRSP82 "Zeit 2.Rampe bei Schrittschaltung" VALUE 0x1D7BE2 ZF_kw_ui8_S5_S3 2540 UMR_MSEC__10_1_0_S5_S3 0 2540 /end CHARACTERISTIC
/begin CHARACTERISTIC T_RA2SSCHRSP84 "Zeit 2.Rampe bei Schrittschaltung" VALUE 0x1D7BE6 ZF_kw_ui8_S5_S3 2540 UMR_MSEC__10_1_0_S5_S3 0 2540 /end CHARACTERISTIC
/begin CHARACTERISTIC T_RA2SSCHRSP86 "Zeit 2.Rampe bei Schrittschaltung" VALUE 0x1D7BEA ZF_kw_ui8_S5_S3 2540 UMR_MSEC__10_1_0_S5_S3 0 2540 /end CHARACTERISTIC
/begin CHARACTERISTIC T_SYN65 "Zeit n_t innerhalb Synchronschwelle bis Start Rampe 4" VALUE 0x1D7BB3 ZF_kw_ui8_S5_S3 2540 UMR_MSEC__10_1_0_S5_S3 0 2540 /end CHARACTERISTIC
/begin CHARACTERISTIC T_SYN76 "Zeit n_t innerhalb Synchronschwelle bis Start Rampe 4" VALUE 0x1D7BB7 ZF_kw_ui8_S5_S3 2540 UMR_MSEC__10_1_0_S5_S3 0 2540 /end CHARACTERISTIC
/begin CHARACTERISTIC T_SYN87 "Zeit n_t innerhalb Synchronschwelle bis Start Rampe 4" VALUE 0x1D7BBB ZF_kw_ui8_S5_S3 2540 UMR_MSEC__10_1_0_S5_S3 0 2540 /end CHARACTERISTIC
/begin CHARACTERISTIC T_SYNSP64 "Zeit n_t innerhalb Synchronschwelle bis Start Rampe 4" VALUE 0x1D7BD3 ZF_kw_ui8_S5_S3 2540 UMR_MSEC__10_1_0_S5_S3 0 2540 /end CHARACTERISTIC
/begin CHARACTERISTIC T_SYNSP71 "Zeit n_t innerhalb Synchronschwelle bis Start Rampe 4" VALUE 0x1D7BD7 ZF_kw_ui8_S5_S3 2540 UMR_MSEC__10_1_0_S5_S3 0 2540 /end CHARACTERISTIC
/begin CHARACTERISTIC T_SYNSP75 "Zeit n_t innerhalb Synchronschwelle bis Start Rampe 4" VALUE 0x1D7BDB ZF_kw_ui8_S5_S3 2540 UMR_MSEC__10_1_0_S5_S3 0 2540 /end CHARACTERISTIC
/begin CHARACTERISTIC T_SYNSP82 "Zeit n_t innerhalb Synchronschwelle bis Start Rampe 4" VALUE 0x1D7BDF ZF_kw_ui8_S5_S3 2540 UMR_MSEC__10_1_0_S5_S3 0 2540 /end CHARACTERISTIC
/begin CHARACTERISTIC T_SYNSP84 "Zeit n_t innerhalb Synchronschwelle bis Start Rampe 4" VALUE 0x1D7BE3 ZF_kw_ui8_S5_S3 2540 UMR_MSEC__10_1_0_S5_S3 0 2540 /end CHARACTERISTIC
/begin CHARACTERISTIC T_SYNSP86 "Zeit n_t innerhalb Synchronschwelle bis Start Rampe 4" VALUE 0x1D7BE7 ZF_kw_ui8_S5_S3 2540 UMR_MSEC__10_1_0_S5_S3 0 2540 /end CHARACTERISTIC
/begin CHARACTERISTIC T_UWIGRNF "Verzoegerungszeit fuer Pruefung auf Rueckkehr zur Normalfuntkion" VALUE 0x1D8B76 ZF_kw_ui16_S5_S3 650000 UMR_MSEC__10_1_0_S5_S3 0 650000 /end CHARACTERISTIC
/begin CHARACTERISTIC T_UWIGSAS "Zeit wie lange eine Stoerung der Schaltung zugeordnet wird" VALUE 0x1D8B78 ZF_kw_ui16_S5_S3 655350 UMR_MSEC__10_1_0_S5_S3 0 655350 /end CHARACTERISTIC
/begin CHARACTERISTIC T_UWIG_GE_D "Maximale Ueberwachungszeit waehrend Gangeinlegen bei kleiner n_ab" VALUE 0x1D7C09 ZF_kw_ui8_S5_S3 2540 UMR_MSEC__10_1_0_S5_S3 0 2540 /end CHARACTERISTIC
/begin CHARACTERISTIC T_VKZU65 "Verzoegerungszeit Start SF zuschaltende Kupplung" VALUE 0x1D7BB4 ZF_kw_ui8_S5_S3 2540 UMR_MSEC__10_1_0_S5_S3 0 2540 /end CHARACTERISTIC
/begin CHARACTERISTIC T_VKZU76 "Verzoegerungszeit Start SF zuschaltende Kupplung" VALUE 0x1D7BB8 ZF_kw_ui8_S5_S3 2540 UMR_MSEC__10_1_0_S5_S3 0 2540 /end CHARACTERISTIC
/begin CHARACTERISTIC T_VKZU87 "Verzoegerungszeit Start SF zuschaltende Kupplung" VALUE 0x1D7BBC ZF_kw_ui8_S5_S3 2540 UMR_MSEC__10_1_0_S5_S3 0 2540 /end CHARACTERISTIC
/begin CHARACTERISTIC T_VKZUSP64 "Verzoegerungszeit Start SF zuschaltende Kupplung" VALUE 0x1D7BD4 ZF_kw_ui8_S5_S3 2540 UMR_MSEC__10_1_0_S5_S3 0 2540 /end CHARACTERISTIC
/begin CHARACTERISTIC T_VKZUSP71 "Verzoegerungszeit Start SF zuschaltende Kupplung" VALUE 0x1D7BD8 ZF_kw_ui8_S5_S3 2540 UMR_MSEC__10_1_0_S5_S3 0 2540 /end CHARACTERISTIC
/begin CHARACTERISTIC T_VKZUSP75 "Verzoegerungszeit Start SF zuschaltende Kupplung" VALUE 0x1D7BDC ZF_kw_ui8_S5_S3 2540 UMR_MSEC__10_1_0_S5_S3 0 2540 /end CHARACTERISTIC
/begin CHARACTERISTIC T_VKZUSP82 "Verzoegerungszeit Start SF zuschaltende Kupplung" VALUE 0x1D7BE0 ZF_kw_ui8_S5_S3 2540 UMR_MSEC__10_1_0_S5_S3 0 2540 /end CHARACTERISTIC
/begin CHARACTERISTIC T_VKZUSP84 "Verzoegerungszeit Start SF zuschaltende Kupplung" VALUE 0x1D7BE4 ZF_kw_ui8_S5_S3 2540 UMR_MSEC__10_1_0_S5_S3 0 2540 /end CHARACTERISTIC
/begin CHARACTERISTIC T_VKZUSP86 "Verzoegerungszeit Start SF zuschaltende Kupplung" VALUE 0x1D7BE8 ZF_kw_ui8_S5_S3 2540 UMR_MSEC__10_1_0_S5_S3 0 2540 /end CHARACTERISTIC
/begin CHARACTERISTIC T_VNGABUWIG12 "Verzoegerungszeit nach Ueberschreiten NGS_ABUWIGxy-Schwelle waehrend Schaltung" VALUE 0x1D7C1D ZF_kw_ui8_S5_S3 1000 UMR_MSEC__10_1_0_S5_S3 0 1000 /end CHARACTERISTIC
/begin CHARACTERISTIC T_VNGABUWIG21 "Verzoegerungszeit nach Ueberschreiten NGS_ABUWIGxy-Schwelle waehrend Schaltung" VALUE 0x1D7C39 ZF_kw_ui8_S5_S3 1000 UMR_MSEC__10_1_0_S5_S3 0 1000 /end CHARACTERISTIC
/begin CHARACTERISTIC T_VNGABUWIG23 "Verzoegerungszeit nach Ueberschreiten NGS_ABUWIGxy-Schwelle waehrend Schaltung" VALUE 0x1D7C21 ZF_kw_ui8_S5_S3 1000 UMR_MSEC__10_1_0_S5_S3 0 1000 /end CHARACTERISTIC
/begin CHARACTERISTIC T_VNGABUWIG31 "Verzoegerungszeit nach Ueberschreiten NGS_ABUWIGxy-Schwelle waehrend Schaltung" VALUE 0x1D7C55 ZF_kw_ui8_S5_S3 1000 UMR_MSEC__10_1_0_S5_S3 0 1000 /end CHARACTERISTIC
/begin CHARACTERISTIC T_VNGABUWIG32 "Verzoegerungszeit nach Ueberschreiten NGS_ABUWIGxy-Schwelle waehrend Schaltung" VALUE 0x1D7C3D ZF_kw_ui8_S5_S3 1000 UMR_MSEC__10_1_0_S5_S3 0 1000 /end CHARACTERISTIC
/begin CHARACTERISTIC T_VNGABUWIG34 "Verzoegerungszeit nach Ueberschreiten NGS_ABUWIGxy-Schwelle waehrend Schaltung" VALUE 0x1D7C25 ZF_kw_ui8_S5_S3 1000 UMR_MSEC__10_1_0_S5_S3 0 1000 /end CHARACTERISTIC
/begin CHARACTERISTIC T_VNGABUWIG42 "Verzoegerungszeit nach Ueberschreiten NGS_ABUWIGxy-Schwelle waehrend Schaltung" VALUE 0x1D7C59 ZF_kw_ui8_S5_S3 1000 UMR_MSEC__10_1_0_S5_S3 0 1000 /end CHARACTERISTIC
/begin CHARACTERISTIC T_VNGABUWIG43 "Verzoegerungszeit nach Ueberschreiten NGS_ABUWIGxy-Schwelle waehrend Schaltung" VALUE 0x1D7C41 ZF_kw_ui8_S5_S3 1000 UMR_MSEC__10_1_0_S5_S3 0 1000 /end CHARACTERISTIC
/begin CHARACTERISTIC T_VNGABUWIG45 "Verzoegerungszeit nach Ueberschreiten NGS_ABUWIGxy-Schwelle waehrend Schaltung" VALUE 0x1D7C29 ZF_kw_ui8_S5_S3 1000 UMR_MSEC__10_1_0_S5_S3 0 1000 /end CHARACTERISTIC
/begin CHARACTERISTIC T_VNGABUWIG51 "Verzoegerungszeit nach Ueberschreiten NGS_ABUWIGxy-Schwelle waehrend Schaltung" VALUE 0x1D7C5D ZF_kw_ui8_S5_S3 1000 UMR_MSEC__10_1_0_S5_S3 0 1000 /end CHARACTERISTIC
/begin CHARACTERISTIC T_VNGABUWIG53 "Verzoegerungszeit nach Ueberschreiten NGS_ABUWIGxy-Schwelle waehrend Schaltung" VALUE 0x1D7C61 ZF_kw_ui8_S5_S3 1000 UMR_MSEC__10_1_0_S5_S3 0 1000 /end CHARACTERISTIC
/begin CHARACTERISTIC T_VNGABUWIG54 "Verzoegerungszeit nach Ueberschreiten NGS_ABUWIGxy-Schwelle waehrend Schaltung" VALUE 0x1D7C45 ZF_kw_ui8_S5_S3 1000 UMR_MSEC__10_1_0_S5_S3 0 1000 /end CHARACTERISTIC
/begin CHARACTERISTIC T_VNGABUWIG56 "Verzoegerungszeit nach Ueberschreiten NGS_ABUWIGxy-Schwelle waehrend Schaltung" VALUE 0x1D7C2D ZF_kw_ui8_S5_S3 1000 UMR_MSEC__10_1_0_S5_S3 0 1000 /end CHARACTERISTIC
/begin CHARACTERISTIC T_VNGABUWIG63 "Verzoegerungszeit nach Ueberschreiten NGS_ABUWIGxy-Schwelle waehrend Schaltung" VALUE 0x1D7C65 ZF_kw_ui8_S5_S3 1000 UMR_MSEC__10_1_0_S5_S3 0 1000 /end CHARACTERISTIC
/begin CHARACTERISTIC T_VNGABUWIG64 "Verzoegerungszeit nach Ueberschreiten NGS_ABUWIGxy-Schwelle waehrend Schaltung" VALUE 0x1D7C69 ZF_kw_ui8_S5_S3 1000 UMR_MSEC__10_1_0_S5_S3 0 1000 /end CHARACTERISTIC
/begin CHARACTERISTIC T_VNGABUWIG65 "Verzoegerungszeit nach Ueberschreiten NGS_ABUWIGxy-Schwelle waehrend Schaltung" VALUE 0x1D7C49 ZF_kw_ui8_S5_S3 1000 UMR_MSEC__10_1_0_S5_S3 0 1000 /end CHARACTERISTIC
/begin CHARACTERISTIC T_VNGABUWIG67 "Verzoegerungszeit nach Ueberschreiten NGS_ABUWIGxy-Schwelle waehrend Schaltung" VALUE 0x1D7C31 ZF_kw_ui8_S5_S3 1000 UMR_MSEC__10_1_0_S5_S3 0 1000 /end CHARACTERISTIC
/begin CHARACTERISTIC T_VNGABUWIG71 "Verzoegerungszeit nach Ueberschreiten NGS_ABUWIGxy-Schwelle waehrend Schaltung" VALUE 0x1D7C6D ZF_kw_ui8_S5_S3 1000 UMR_MSEC__10_1_0_S5_S3 0 1000 /end CHARACTERISTIC
/begin CHARACTERISTIC T_VNGABUWIG75 "Verzoegerungszeit nach Ueberschreiten NGS_ABUWIGxy-Schwelle waehrend Schaltung" VALUE 0x1D7C71 ZF_kw_ui8_S5_S3 1000 UMR_MSEC__10_1_0_S5_S3 0 1000 /end CHARACTERISTIC
/begin CHARACTERISTIC T_VNGABUWIG76 "Verzoegerungszeit nach Ueberschreiten NGS_ABUWIGxy-Schwelle waehrend Schaltung" VALUE 0x1D7C4D ZF_kw_ui8_S5_S3 1000 UMR_MSEC__10_1_0_S5_S3 0 1000 /end CHARACTERISTIC
/begin CHARACTERISTIC T_VNGABUWIG78 "Verzoegerungszeit nach Ueberschreiten NGS_ABUWIGxy-Schwelle waehrend Schaltung" VALUE 0x1D7C35 ZF_kw_ui8_S5_S3 1000 UMR_MSEC__10_1_0_S5_S3 0 1000 /end CHARACTERISTIC
/begin CHARACTERISTIC T_VNGABUWIG82 "Verzoegerungszeit nach Ueberschreiten NGS_ABUWIGxy-Schwelle waehrend Schaltung" VALUE 0x1D7C75 ZF_kw_ui8_S5_S3 1000 UMR_MSEC__10_1_0_S5_S3 0 1000 /end CHARACTERISTIC
/begin CHARACTERISTIC T_VNGABUWIG84 "Verzoegerungszeit nach Ueberschreiten NGS_ABUWIGxy-Schwelle waehrend Schaltung" VALUE 0x1D7C79 ZF_kw_ui8_S5_S3 1000 UMR_MSEC__10_1_0_S5_S3 0 1000 /end CHARACTERISTIC
/begin CHARACTERISTIC T_VNGABUWIG86 "Verzoegerungszeit nach Ueberschreiten NGS_ABUWIGxy-Schwelle waehrend Schaltung" VALUE 0x1D7C7D ZF_kw_ui8_S5_S3 1000 UMR_MSEC__10_1_0_S5_S3 0 1000 /end CHARACTERISTIC
/begin CHARACTERISTIC T_VNGABUWIG87 "Verzoegerungszeit nach Ueberschreiten NGS_ABUWIGxy-Schwelle waehrend Schaltung" VALUE 0x1D7C51 ZF_kw_ui8_S5_S3 1000 UMR_MSEC__10_1_0_S5_S3 0 1000 /end CHARACTERISTIC
/begin CHARACTERISTIC T_VUWIG "Verzoegerungszeit nach Ende Gangein- und auslegen SBC UWIG" VALUE 0x1D7C0A ZF_kw_ui8_S5_S3 2540 UMR_MSEC__10_1_0_S5_S3 0 2540 /end CHARACTERISTIC
/begin CHARACTERISTIC T_VUWIG12 "Verzoegerungszeit nach Reglerstart bei Schaltung" VALUE 0x1D7C1E ZF_kw_ui8_S5_S3 2540 UMR_MSEC__10_1_0_S5_S3 0 2540 /end CHARACTERISTIC
/begin CHARACTERISTIC T_VUWIG21 "Verzoegerungszeit nach Reglerstart bei Schaltung" VALUE 0x1D7C3A ZF_kw_ui8_S5_S3 2540 UMR_MSEC__10_1_0_S5_S3 0 2540 /end CHARACTERISTIC
/begin CHARACTERISTIC T_VUWIG23 "Verzoegerungszeit nach Reglerstart bei Schaltung" VALUE 0x1D7C22 ZF_kw_ui8_S5_S3 2540 UMR_MSEC__10_1_0_S5_S3 0 2540 /end CHARACTERISTIC
/begin CHARACTERISTIC T_VUWIG31 "Verzoegerungszeit nach Reglerstart bei Schaltung" VALUE 0x1D7C56 ZF_kw_ui8_S5_S3 2540 UMR_MSEC__10_1_0_S5_S3 0 2540 /end CHARACTERISTIC
/begin CHARACTERISTIC T_VUWIG32 "Verzoegerungszeit nach Reglerstart bei Schaltung" VALUE 0x1D7C3E ZF_kw_ui8_S5_S3 2540 UMR_MSEC__10_1_0_S5_S3 0 2540 /end CHARACTERISTIC
/begin CHARACTERISTIC T_VUWIG34 "Verzoegerungszeit nach Reglerstart bei Schaltung" VALUE 0x1D7C26 ZF_kw_ui8_S5_S3 2540 UMR_MSEC__10_1_0_S5_S3 0 2540 /end CHARACTERISTIC
/begin CHARACTERISTIC T_VUWIG42 "Verzoegerungszeit nach Reglerstart bei Schaltung" VALUE 0x1D7C5A ZF_kw_ui8_S5_S3 2540 UMR_MSEC__10_1_0_S5_S3 0 2540 /end CHARACTERISTIC
/begin CHARACTERISTIC T_VUWIG43 "Verzoegerungszeit nach Reglerstart bei Schaltung" VALUE 0x1D7C42 ZF_kw_ui8_S5_S3 2540 UMR_MSEC__10_1_0_S5_S3 0 2540 /end CHARACTERISTIC
/begin CHARACTERISTIC T_VUWIG45 "Verzoegerungszeit nach Reglerstart bei Schaltung" VALUE 0x1D7C2A ZF_kw_ui8_S5_S3 2540 UMR_MSEC__10_1_0_S5_S3 0 2540 /end CHARACTERISTIC
/begin CHARACTERISTIC T_VUWIG51 "Verzoegerungszeit nach Reglerstart bei Schaltung" VALUE 0x1D7C5E ZF_kw_ui8_S5_S3 2540 UMR_MSEC__10_1_0_S5_S3 0 2540 /end CHARACTERISTIC
/begin CHARACTERISTIC T_VUWIG53 "Verzoegerungszeit nach Reglerstart bei Schaltung" VALUE 0x1D7C62 ZF_kw_ui8_S5_S3 2540 UMR_MSEC__10_1_0_S5_S3 0 2540 /end CHARACTERISTIC
/begin CHARACTERISTIC T_VUWIG54 "Verzoegerungszeit nach Reglerstart bei Schaltung" VALUE 0x1D7C46 ZF_kw_ui8_S5_S3 2540 UMR_MSEC__10_1_0_S5_S3 0 2540 /end CHARACTERISTIC
/begin CHARACTERISTIC T_VUWIG56 "Verzoegerungszeit nach Reglerstart bei Schaltung" VALUE 0x1D7C2E ZF_kw_ui8_S5_S3 2540 UMR_MSEC__10_1_0_S5_S3 0 2540 /end CHARACTERISTIC
/begin CHARACTERISTIC T_VUWIG63 "Verzoegerungszeit nach Reglerstart bei Schaltung" VALUE 0x1D7C66 ZF_kw_ui8_S5_S3 2540 UMR_MSEC__10_1_0_S5_S3 0 2540 /end CHARACTERISTIC
/begin CHARACTERISTIC T_VUWIG64 "Verzoegerungszeit nach Reglerstart bei Schaltung" VALUE 0x1D7C6A ZF_kw_ui8_S5_S3 2540 UMR_MSEC__10_1_0_S5_S3 0 2540 /end CHARACTERISTIC
/begin CHARACTERISTIC T_VUWIG65 "Verzoegerungszeit nach Reglerstart bei Schaltung" VALUE 0x1D7C4A ZF_kw_ui8_S5_S3 2540 UMR_MSEC__10_1_0_S5_S3 0 2540 /end CHARACTERISTIC
/begin CHARACTERISTIC T_VUWIG67 "Verzoegerungszeit nach Reglerstart bei Schaltung" VALUE 0x1D7C32 ZF_kw_ui8_S5_S3 2540 UMR_MSEC__10_1_0_S5_S3 0 2540 /end CHARACTERISTIC
/begin CHARACTERISTIC T_VUWIG71 "Verzoegerungszeit nach Reglerstart bei Schaltung" VALUE 0x1D7C6E ZF_kw_ui8_S5_S3 2540 UMR_MSEC__10_1_0_S5_S3 0 2540 /end CHARACTERISTIC
/begin CHARACTERISTIC T_VUWIG75 "Verzoegerungszeit nach Reglerstart bei Schaltung" VALUE 0x1D7C72 ZF_kw_ui8_S5_S3 2540 UMR_MSEC__10_1_0_S5_S3 0 2540 /end CHARACTERISTIC
/begin CHARACTERISTIC T_VUWIG76 "Verzoegerungszeit nach Reglerstart bei Schaltung" VALUE 0x1D7C4E ZF_kw_ui8_S5_S3 2540 UMR_MSEC__10_1_0_S5_S3 0 2540 /end CHARACTERISTIC
/begin CHARACTERISTIC T_VUWIG78 "Verzoegerungszeit nach Reglerstart bei Schaltung" VALUE 0x1D7C36 ZF_kw_ui8_S5_S3 2540 UMR_MSEC__10_1_0_S5_S3 0 2540 /end CHARACTERISTIC
/begin CHARACTERISTIC T_VUWIG82 "Verzoegerungszeit nach Reglerstart bei Schaltung" VALUE 0x1D7C76 ZF_kw_ui8_S5_S3 2540 UMR_MSEC__10_1_0_S5_S3 0 2540 /end CHARACTERISTIC
/begin CHARACTERISTIC T_VUWIG84 "Verzoegerungszeit nach Reglerstart bei Schaltung" VALUE 0x1D7C7A ZF_kw_ui8_S5_S3 2540 UMR_MSEC__10_1_0_S5_S3 0 2540 /end CHARACTERISTIC
/begin CHARACTERISTIC T_VUWIG86 "Verzoegerungszeit nach Reglerstart bei Schaltung" VALUE 0x1D7C7E ZF_kw_ui8_S5_S3 2540 UMR_MSEC__10_1_0_S5_S3 0 2540 /end CHARACTERISTIC
/begin CHARACTERISTIC T_VUWIG87 "Verzoegerungszeit nach Reglerstart bei Schaltung" VALUE 0x1D7C52 ZF_kw_ui8_S5_S3 2540 UMR_MSEC__10_1_0_S5_S3 0 2540 /end CHARACTERISTIC
/begin CHARACTERISTIC T_VUWIGSYM "Verzoegerungszeit nach schwarz/weiss Schaltung durch Symptom UWIG" VALUE 0x1D7C0B ZF_kw_ui8_S5_S3 800 UMR_MSEC__10_1_0_S5_S3 200 1000 /end CHARACTERISTIC
/begin CHARACTERISTIC T_VUWIG_1 "Verzoegerungszeit nach Reglerstart bei GE" VALUE 0x1D7C0E ZF_kw_ui8_S5_S3 2540 UMR_MSEC__10_1_0_S5_S3 0 2540 /end CHARACTERISTIC
/begin CHARACTERISTIC T_VUWIG_2 "Verzoegerungszeit nach Reglerstart bei GE" VALUE 0x1D7C0F ZF_kw_ui8_S5_S3 2540 UMR_MSEC__10_1_0_S5_S3 0 2540 /end CHARACTERISTIC
/begin CHARACTERISTIC T_VUWIG_3 "Verzoegerungszeit nach Reglerstart bei GE" VALUE 0x1D7C10 ZF_kw_ui8_S5_S3 2540 UMR_MSEC__10_1_0_S5_S3 0 2540 /end CHARACTERISTIC
/begin CHARACTERISTIC T_VUWIG_4 "Verzoegerungszeit nach Reglerstart bei GE" VALUE 0x1D7C11 ZF_kw_ui8_S5_S3 2540 UMR_MSEC__10_1_0_S5_S3 0 2540 /end CHARACTERISTIC
/begin CHARACTERISTIC T_VUWIG_5 "Verzoegerungszeit nach Reglerstart bei GE" VALUE 0x1D7C12 ZF_kw_ui8_S5_S3 2540 UMR_MSEC__10_1_0_S5_S3 0 2540 /end CHARACTERISTIC
/begin CHARACTERISTIC T_VUWIG_6 "Verzoegerungszeit nach Reglerstart bei GE" VALUE 0x1D7C13 ZF_kw_ui8_S5_S3 2540 UMR_MSEC__10_1_0_S5_S3 0 2540 /end CHARACTERISTIC
/begin CHARACTERISTIC T_VUWIG_7 "Verzoegerungszeit nach Reglerstart bei GE" VALUE 0x1D7C14 ZF_kw_ui8_S5_S3 2540 UMR_MSEC__10_1_0_S5_S3 0 2540 /end CHARACTERISTIC
/begin CHARACTERISTIC T_VUWIG_8 "Verzoegerungszeit nach Reglerstart bei GE" VALUE 0x1D7C15 ZF_kw_ui8_S5_S3 2540 UMR_MSEC__10_1_0_S5_S3 0 2540 /end CHARACTERISTIC
/begin CHARACTERISTIC T_VUWIG_R "Verzoegerungszeit nach Reglerstart bei GE" VALUE 0x1D7C0D ZF_kw_ui8_S5_S3 2540 UMR_MSEC__10_1_0_S5_S3 0 2540 /end CHARACTERISTIC
/begin CHARACTERISTIC VS_FZG_RSICH_LEV2 "ASIL-C: Fahrzeuggeschwindigkeitsschwelle fuer R-Gang" VALUE 0x1D8BEA ZF_kw_ui16_S5_S3 400 UMR_KM_H_1_1_0_S5_S3 0 400 /end CHARACTERISTIC
/begin CHARACTERISTIC V_PMUEB_OB "obere Geschwindigkeitsschwelle" VALUE 0x1D8BE2 ZF_kw_ui16_S5_S3 400 UMR_KM_H_1_1_0_S5_S3 0 400 /end CHARACTERISTIC
/begin CHARACTERISTIC V_PMUEB_UN "untere Geschwindigkeitsschwelle" VALUE 0x1D8BE0 ZF_kw_ui16_S5_S3 400 UMR_KM_H_1_1_0_S5_S3 0 400 /end CHARACTERISTIC
/begin CHARACTERISTIC V_PUMPE "Pumpenvolumen pro Umdrehung" VALUE 0x1D7BF2 ZF_kw_ui8_S5_S3 20 UMR_CM3__1_10_0_S5_S3 0 20 /end CHARACTERISTIC
/begin FUNCTION jSasKzuRSS64_Fktn "Applikationesgroessen Instanz jSasKzuRSS64"
 /begin DEF_CHARACTERISTIC KF_PKZUWSSP64 KF_POFMTNFUELLREDSP64 KF_TSYNMTNTRAKZUWSSP64 KL_PGOKZUSP64 KL_PGOKZUWSSP64 KL_PGRASYNSP64 KL_POFCGSP64 KL_POFMDMOTSOLLSP64 KL_POKZUCGSP64 KL_POKZUMDMOTSOLLSP64 KL_POKZUNGABSP64 KL_POMDTSYNSP64 KL_PORAKZUSP64 KL_PORASYNSP64 KL_TSYNCGRAKZUSP64 T_FFUELLREDSP64 T_RA2SSCHRSP64 T_SYNSP64 T_VKZUSP64 /end DEF_CHARACTERISTIC
/end FUNCTION
/begin FUNCTION jSasKzuRSS65_Fktn "Applikationesgroessen Instanz jSasKzuRSS65"
 /begin DEF_CHARACTERISTIC KF_PKZUWS65 KF_POFMTNFUELLRED65 KF_TSYNMTNTRAKZUWS65 KL_PGOKZU65 KL_PGOKZUWS65 KL_PGRASYN65 KL_POFCG65 KL_POFMDMOTSOLL65 KL_POKZUCG65 KL_POKZUMDMOTSOLL65 KL_POKZUNGAB65 KL_POMDTSYN65 KL_PORAKZU65 KL_PORASYN65 KL_TSYNCGRAKZU65 T_FFUELLRED65 T_RA2SSCHR65 T_SYN65 T_VKZU65 /end DEF_CHARACTERISTIC
/end FUNCTION
/begin FUNCTION jSasKzuRSS71_Fktn "Applikationesgroessen Instanz jSasKzuRSS71"
 /begin DEF_CHARACTERISTIC KF_PKZUWSSP71 KF_POFMTNFUELLREDSP71 KF_TSYNMTNTRAKZUWSSP71 KL_PGOKZUSP71 KL_PGOKZUWSSP71 KL_PGRASYNSP71 KL_POFCGSP71 KL_POFMDMOTSOLLSP71 KL_POKZUCGSP71 KL_POKZUMDMOTSOLLSP71 KL_POKZUNGABSP71 KL_POMDTSYNSP71 KL_PORAKZUSP71 KL_PORASYNSP71 KL_TSYNCGRAKZUSP71 T_FFUELLREDSP71 T_RA2SSCHRSP71 T_SYNSP71 T_VKZUSP71 /end DEF_CHARACTERISTIC
/end FUNCTION
/begin FUNCTION jSasKzuRSS75_Fktn "Applikationesgroessen Instanz jSasKzuRSS75"
 /begin DEF_CHARACTERISTIC KF_PKZUWSSP75 KF_POFMTNFUELLREDSP75 KF_TSYNMTNTRAKZUWSSP75 KL_PGOKZUSP75 KL_PGOKZUWSSP75 KL_PGRASYNSP75 KL_POFCGSP75 KL_POFMDMOTSOLLSP75 KL_POKZUCGSP75 KL_POKZUMDMOTSOLLSP75 KL_POKZUNGABSP75 KL_POMDTSYNSP75 KL_PORAKZUSP75 KL_PORASYNSP75 KL_TSYNCGRAKZUSP75 T_FFUELLREDSP75 T_RA2SSCHRSP75 T_SYNSP75 T_VKZUSP75 /end DEF_CHARACTERISTIC
/end FUNCTION
/begin FUNCTION jSasKzuRSS76_Fktn "Applikationesgroessen Instanz jSasKzuRSS76"
 /begin DEF_CHARACTERISTIC KF_PKZUWS76 KF_POFMTNFUELLRED76 KF_TSYNMTNTRAKZUWS76 KL_PGOKZU76 KL_PGOKZUWS76 KL_PGRASYN76 KL_POFCG76 KL_POFMDMOTSOLL76 KL_POKZUCG76 KL_POKZUMDMOTSOLL76 KL_POKZUNGAB76 KL_POMDTSYN76 KL_PORAKZU76 KL_PORASYN76 KL_TSYNCGRAKZU76 T_FFUELLRED76 T_RA2SSCHR76 T_SYN76 T_VKZU76 /end DEF_CHARACTERISTIC
/end FUNCTION
/begin FUNCTION jSasKzuRSS82_Fktn "Applikationesgroessen Instanz jSasKzuRSS82"
 /begin DEF_CHARACTERISTIC KF_PKZUWSSP82 KF_POFMTNFUELLREDSP82 KF_TSYNMTNTRAKZUWSSP82 KL_PGOKZUSP82 KL_PGOKZUWSSP82 KL_PGRASYNSP82 KL_POFCGSP82 KL_POFMDMOTSOLLSP82 KL_POKZUCGSP82 KL_POKZUMDMOTSOLLSP82 KL_POKZUNGABSP82 KL_POMDTSYNSP82 KL_PORAKZUSP82 KL_PORASYNSP82 KL_TSYNCGRAKZUSP82 T_FFUELLREDSP82 T_RA2SSCHRSP82 T_SYNSP82 T_VKZUSP82 /end DEF_CHARACTERISTIC
/end FUNCTION
/begin FUNCTION jSasKzuRSS84_Fktn "Applikationesgroessen Instanz jSasKzuRSS84"
 /begin DEF_CHARACTERISTIC KF_PKZUWSSP84 KF_POFMTNFUELLREDSP84 KF_TSYNMTNTRAKZUWSSP84 KL_PGOKZUSP84 KL_PGOKZUWSSP84 KL_PGRASYNSP84 KL_POFCGSP84 KL_POFMDMOTSOLLSP84 KL_POKZUCGSP84 KL_POKZUMDMOTSOLLSP84 KL_POKZUNGABSP84 KL_POMDTSYNSP84 KL_PORAKZUSP84 KL_PORASYNSP84 KL_TSYNCGRAKZUSP84 T_FFUELLREDSP84 T_RA2SSCHRSP84 T_SYNSP84 T_VKZUSP84 /end DEF_CHARACTERISTIC
/end FUNCTION
/begin FUNCTION jSasKzuRSS86_Fktn "Applikationesgroessen Instanz jSasKzuRSS86"
 /begin DEF_CHARACTERISTIC KF_PKZUWSSP86 KF_POFMTNFUELLREDSP86 KF_TSYNMTNTRAKZUWSSP86 KL_PGOKZUSP86 KL_PGOKZUWSSP86 KL_PGRASYNSP86 KL_POFCGSP86 KL_POFMDMOTSOLLSP86 KL_POKZUCGSP86 KL_POKZUMDMOTSOLLSP86 KL_POKZUNGABSP86 KL_POMDTSYNSP86 KL_PORAKZUSP86 KL_PORASYNSP86 KL_TSYNCGRAKZUSP86 T_FFUELLREDSP86 T_RA2SSCHRSP86 T_SYNSP86 T_VKZUSP86 /end DEF_CHARACTERISTIC
/end FUNCTION
/begin FUNCTION jSasKzuRSS87_Fktn "Applikationesgroessen Instanz jSasKzuRSS87"
 /begin DEF_CHARACTERISTIC KF_PKZUWS87 KF_POFMTNFUELLRED87 KF_TSYNMTNTRAKZUWS87 KL_PGOKZU87 KL_PGOKZUWS87 KL_PGRASYN87 KL_POFCG87 KL_POFMDMOTSOLL87 KL_POKZUCG87 KL_POKZUMDMOTSOLL87 KL_POKZUNGAB87 KL_POMDTSYN87 KL_PORAKZU87 KL_PORASYN87 KL_TSYNCGRAKZU87 T_FFUELLRED87 T_RA2SSCHR87 T_SYN87 T_VKZU87 /end DEF_CHARACTERISTIC
/end FUNCTION
/begin FUNCTION jSasPsyGeG1_Fktn "Applikationesgroessen Instanz jSasPsyGeG1" /begin DEF_CHARACTERISTIC KF_PSYS_1 P_SYSMIN_IAE_1 /end DEF_CHARACTERISTIC /end FUNCTION
/begin FUNCTION jSasPsyGeG2_Fktn "Applikationesgroessen Instanz jSasPsyGeG2" /begin DEF_CHARACTERISTIC KF_PSYS_2 P_SYSMIN_IAE_2 /end DEF_CHARACTERISTIC /end FUNCTION
/begin FUNCTION jSasPsyGeG3_Fktn "Applikationesgroessen Instanz jSasPsyGeG3" /begin DEF_CHARACTERISTIC KF_PSYS_3 /end DEF_CHARACTERISTIC /end FUNCTION
/begin FUNCTION jSasPsyGeG4_Fktn "Applikationesgroessen Instanz jSasPsyGeG4" /begin DEF_CHARACTERISTIC KF_PSYS_4 /end DEF_CHARACTERISTIC /end FUNCTION
/begin FUNCTION jSasPsyGeG5_Fktn "Applikationesgroessen Instanz jSasPsyGeG5" /begin DEF_CHARACTERISTIC KF_PSYS_5 /end DEF_CHARACTERISTIC /end FUNCTION
/begin FUNCTION jSasPsyGeG6_Fktn "Applikationesgroessen Instanz jSasPsyGeG6" /begin DEF_CHARACTERISTIC KF_PSYS_6 /end DEF_CHARACTERISTIC /end FUNCTION
/begin FUNCTION jSasPsyGeG7_Fktn "Applikationesgroessen Instanz jSasPsyGeG7" /begin DEF_CHARACTERISTIC KF_PSYS_7 /end DEF_CHARACTERISTIC /end FUNCTION
/begin FUNCTION jSasPsyGeG8_Fktn "Applikationesgroessen Instanz jSasPsyGeG8" /begin DEF_CHARACTERISTIC KF_PSYS_8 /end DEF_CHARACTERISTIC /end FUNCTION
/begin FUNCTION jSasPsyGeGR_Fktn "Applikationesgroessen Instanz jSasPsyGeGR" /begin DEF_CHARACTERISTIC KF_PSYS_R P_SYSMIN_IAE_R /end DEF_CHARACTERISTIC /end FUNCTION
/begin FUNCTION jSasPsyHSS12_Fktn "Applikationesgroessen Instanz jSasPsyHSS12" /begin DEF_CHARACTERISTIC P_SYSMIN12 P_SYSMINFUELLOPT12 P_SYSMINFUELLRED12 /end DEF_CHARACTERISTIC /end FUNCTION
/begin FUNCTION jSasPsyHSS23_Fktn "Applikationesgroessen Instanz jSasPsyHSS23" /begin DEF_CHARACTERISTIC P_SYSMIN23 P_SYSMINFUELLOPT23 P_SYSMINFUELLRED23 /end DEF_CHARACTERISTIC /end FUNCTION
/begin FUNCTION jSasPsyHSS34_Fktn "Applikationesgroessen Instanz jSasPsyHSS34" /begin DEF_CHARACTERISTIC P_SYSMIN34 P_SYSMINFUELLOPT34 P_SYSMINFUELLRED34 /end DEF_CHARACTERISTIC /end FUNCTION
/begin FUNCTION jSasPsyHSS45_Fktn "Applikationesgroessen Instanz jSasPsyHSS45" /begin DEF_CHARACTERISTIC P_SYSMIN45 P_SYSMINFUELLOPT45 P_SYSMINFUELLRED45 /end DEF_CHARACTERISTIC /end FUNCTION
/begin FUNCTION jSasPsyHSS56_Fktn "Applikationesgroessen Instanz jSasPsyHSS56" /begin DEF_CHARACTERISTIC P_SYSMIN56 P_SYSMINFUELLOPT56 P_SYSMINFUELLRED56 /end DEF_CHARACTERISTIC /end FUNCTION
/begin FUNCTION jSasPsyHSS67_Fktn "Applikationesgroessen Instanz jSasPsyHSS67" /begin DEF_CHARACTERISTIC P_SYSMIN67 P_SYSMINFUELLOPT67 P_SYSMINFUELLRED67 /end DEF_CHARACTERISTIC /end FUNCTION
/begin FUNCTION jSasPsyHSS78_Fktn "Applikationesgroessen Instanz jSasPsyHSS78" /begin DEF_CHARACTERISTIC P_SYSMIN78 P_SYSMINFUELLOPT78 P_SYSMINFUELLRED78 /end DEF_CHARACTERISTIC /end FUNCTION
/begin FUNCTION jSasPsyRSS21_Fktn "Applikationesgroessen Instanz jSasPsyRSS21" /begin DEF_CHARACTERISTIC P_SYSMIN21 P_SYSMINFUELLRED21 /end DEF_CHARACTERISTIC /end FUNCTION
/begin FUNCTION jSasPsyRSS31_Fktn "Applikationesgroessen Instanz jSasPsyRSS31" /begin DEF_CHARACTERISTIC P_SYSMINFUELLREDSP31 P_SYSMINSP31 /end DEF_CHARACTERISTIC /end FUNCTION
/begin FUNCTION jSasPsyRSS32_Fktn "Applikationesgroessen Instanz jSasPsyRSS32" /begin DEF_CHARACTERISTIC P_SYSMIN32 P_SYSMINFUELLRED32 /end DEF_CHARACTERISTIC /end FUNCTION
/begin FUNCTION jSasPsyRSS42_Fktn "Applikationesgroessen Instanz jSasPsyRSS42" /begin DEF_CHARACTERISTIC P_SYSMINFUELLREDSP42 P_SYSMINSP42 /end DEF_CHARACTERISTIC /end FUNCTION
/begin FUNCTION jSasPsyRSS43_Fktn "Applikationesgroessen Instanz jSasPsyRSS43" /begin DEF_CHARACTERISTIC P_SYSMIN43 P_SYSMINFUELLRED43 /end DEF_CHARACTERISTIC /end FUNCTION
/begin FUNCTION jSasPsyRSS51_Fktn "Applikationesgroessen Instanz jSasPsyRSS51" /begin DEF_CHARACTERISTIC P_SYSMINFUELLREDSP51 P_SYSMINSP51 /end DEF_CHARACTERISTIC /end FUNCTION
/begin FUNCTION jSasPsyRSS53_Fktn "Applikationesgroessen Instanz jSasPsyRSS53" /begin DEF_CHARACTERISTIC P_SYSMINFUELLREDSP53 P_SYSMINSP53 /end DEF_CHARACTERISTIC /end FUNCTION
/begin FUNCTION jSasPsyRSS54_Fktn "Applikationesgroessen Instanz jSasPsyRSS54" /begin DEF_CHARACTERISTIC P_SYSMIN54 P_SYSMINFUELLRED54 /end DEF_CHARACTERISTIC /end FUNCTION
/begin FUNCTION jSasPsyRSS63_Fktn "Applikationesgroessen Instanz jSasPsyRSS63" /begin DEF_CHARACTERISTIC P_SYSMINFUELLREDSP63 P_SYSMINSP63 /end DEF_CHARACTERISTIC /end FUNCTION
/begin FUNCTION jSasPsyRSS64_Fktn "Applikationesgroessen Instanz jSasPsyRSS64" /begin DEF_CHARACTERISTIC P_SYSMINFUELLREDSP64 P_SYSMINSP64 /end DEF_CHARACTERISTIC /end FUNCTION
/begin FUNCTION jSasPsyRSS65_Fktn "Applikationesgroessen Instanz jSasPsyRSS65" /begin DEF_CHARACTERISTIC P_SYSMIN65 P_SYSMINFUELLRED65 /end DEF_CHARACTERISTIC /end FUNCTION
/begin FUNCTION jSasPsyRSS71_Fktn "Applikationesgroessen Instanz jSasPsyRSS71" /begin DEF_CHARACTERISTIC P_SYSMINFUELLREDSP71 P_SYSMINSP71 /end DEF_CHARACTERISTIC /end FUNCTION
/begin FUNCTION jSasPsyRSS75_Fktn "Applikationesgroessen Instanz jSasPsyRSS75" /begin DEF_CHARACTERISTIC P_SYSMINFUELLREDSP75 P_SYSMINSP75 /end DEF_CHARACTERISTIC /end FUNCTION
/begin FUNCTION jSasPsyRSS76_Fktn "Applikationesgroessen Instanz jSasPsyRSS76" /begin DEF_CHARACTERISTIC P_SYSMIN76 P_SYSMINFUELLRED76 /end DEF_CHARACTERISTIC /end FUNCTION
/begin FUNCTION jSasPsyRSS82_Fktn "Applikationesgroessen Instanz jSasPsyRSS82" /begin DEF_CHARACTERISTIC P_SYSMINFUELLREDSP82 P_SYSMINSP82 /end DEF_CHARACTERISTIC /end FUNCTION
/begin FUNCTION jSasPsyRSS84_Fktn "Applikationesgroessen Instanz jSasPsyRSS84" /begin DEF_CHARACTERISTIC P_SYSMINFUELLREDSP84 P_SYSMINSP84 /end DEF_CHARACTERISTIC /end FUNCTION
/begin FUNCTION jSasPsyRSS86_Fktn "Applikationesgroessen Instanz jSasPsyRSS86" /begin DEF_CHARACTERISTIC P_SYSMINFUELLREDSP86 P_SYSMINSP86 /end DEF_CHARACTERISTIC /end FUNCTION
/begin FUNCTION jSasPsyRSS87_Fktn "Applikationesgroessen Instanz jSasPsyRSS87" /begin DEF_CHARACTERISTIC P_SYSMIN87 P_SYSMINFUELLRED87 /end DEF_CHARACTERISTIC /end FUNCTION
/begin FUNCTION jSasPsyst_Fktn "Applikationesgroessen Instanz jSasPsyst"
 /begin DEF_CHARACTERISTIC CGT_PSYSIAE CGT_PSYSIAEHYS CS_KUPPLPSYS CS_PSYSIEP CS_UNMAXPSYS HYS_CKUPPLPSYS KF_PSYSN KF_PSYS_K0 KL_POSYSCG KL_PPUMPE_SYS KL_TFPSYSIST KL_TMAXPSYS MG_PSYSMINPULS MS_TPSYSIAEHYS MS_TPSYSIAEOB MS_TPSYSIAEUN NS_TPSYSIAEHYS NS_TPSYSIAEOB NS_TPSYSIAEUN N_MOTMAXPSYS P_SYSIAE_INC P_SYSMINCKUPL P_SYSMINFUELLOPT_K0 P_SYSMINFUELLRED_D P_SYSMINFUELLRED_K0 P_SYSMINFUELLRED_R P_SYSMINIEP P_SYSMINK0 P_SYSMINPOSV P_SYSMINPULS P_SYSMIN_D P_SYSMIN_R TAB_PIEP_SYS T_FPSYS /end DEF_CHARACTERISTIC
/end FUNCTION
/begin FUNCTION jSasStrat_Fktn "Applikationesgroessen Instanz jSasStrat"
 /begin DEF_CHARACTERISTIC CS_FUELLOPTOB CS_FUELLOPTUN CS_FUELLREDOB CS_FUELLREDUN KF_QLECKAGE KL_QVERBR_KUEHL KL_TSNABESTARTSTART NS_ESTART NS_ESTARTHYS NS_MOTFUELLOPT Q_FUELLRED_A Q_FUELLRED_B Q_FUELLRED_C Q_FUELLRED_D Q_FUELLRED_E Q_FUELLRED_K0 Q_VERBR_IAE Q_VERBR_K0 Q_VERBR_KAB Q_VERBR_SYS TAB_SWIFUELLOPT TS_ESTART V_PUMPE /end DEF_CHARACTERISTIC
/end FUNCTION
/begin FUNCTION jUewIgetr_Fktn "Applikationesgroessen Instanz jUewIgetr"
 /begin DEF_CHARACTERISTIC C_GETUWIG DKI_MAXUWIG_GE DKI_UWIGRNF KL_TMAXSYMIEP KL_TVERZSYMIEP MAX_STOER_GANG MAX_STOER_GE MAX_STOER_SCHALT MAX_SYMUWIG_GANG MGS_MOTSOLLUWIG MIN_ERFOLGE_GE ND_UWIG ND_UWIGERS NGT_MAXUWIG_GE NS_ABIEPUWIG NS_ABUWIG NS_ABUWIG2 NS_EMIEPUWIG NS_EMIEPUWIGMIN NS_MOTUWIGHYB NS_TUWIG N_ABUWIGRNF N_DIF_IAE_UWIG N_SYMOFNEUGETR SWI_UWIG SWI_UWIG_GE TS_RZNUWIG T_FMGMOTSOLLUWIG T_MAXSYMNEUGETR T_UWIGRNF T_UWIGSAS T_UWIG_GE_D T_VUWIG T_VUWIGSYM /end DEF_CHARACTERISTIC
/end FUNCTION
/begin FUNCTION jUewIgetrG1_Fktn "Applikationesgroessen Instanz jUewIgetrG1"
 /begin DEF_CHARACTERISTIC KF_IGOUWIGNGTOB_1 KF_IGOUWIGNGTUN_1 KL_UWIGOBERS_1 KL_UWIGOB_1 KL_UWIGUNERS_1 KL_UWIGUN_1 ND_TOBUWIG_GE_1 ND_TUNUWIG_GE_1 T_VUWIG_1 /end DEF_CHARACTERISTIC
/end FUNCTION
/begin FUNCTION jUewIgetrG2_Fktn "Applikationesgroessen Instanz jUewIgetrG2"
 /begin DEF_CHARACTERISTIC KF_IGOUWIGNGTOB_2 KF_IGOUWIGNGTUN_2 KL_UWIGOBERS_2 KL_UWIGOB_2 KL_UWIGUNERS_2 KL_UWIGUN_2 ND_TOBUWIG_GE_2 ND_TUNUWIG_GE_2 T_VUWIG_2 /end DEF_CHARACTERISTIC
/end FUNCTION
/begin FUNCTION jUewIgetrG3_Fktn "Applikationesgroessen Instanz jUewIgetrG3"
 /begin DEF_CHARACTERISTIC KF_IGOUWIGNGTOB_3 KF_IGOUWIGNGTUN_3 KL_UWIGOBERS_3 KL_UWIGOB_3 KL_UWIGUNERS_3 KL_UWIGUN_3 ND_TOBUWIG_GE_3 ND_TUNUWIG_GE_3 T_VUWIG_3 /end DEF_CHARACTERISTIC
/end FUNCTION
/begin FUNCTION jUewIgetrG4_Fktn "Applikationesgroessen Instanz jUewIgetrG4"
 /begin DEF_CHARACTERISTIC KF_IGOUWIGNGTOB_4 KF_IGOUWIGNGTUN_4 KL_UWIGOBERS_4 KL_UWIGOB_4 KL_UWIGUNERS_4 KL_UWIGUN_4 ND_TOBUWIG_GE_4 ND_TUNUWIG_GE_4 T_VUWIG_4 /end DEF_CHARACTERISTIC
/end FUNCTION
/begin FUNCTION jUewIgetrG5_Fktn "Applikationesgroessen Instanz jUewIgetrG5"
 /begin DEF_CHARACTERISTIC KF_IGOUWIGNGTOB_5 KF_IGOUWIGNGTUN_5 KL_UWIGOBERS_5 KL_UWIGOB_5 KL_UWIGUNERS_5 KL_UWIGUN_5 ND_TOBUWIG_GE_5 ND_TUNUWIG_GE_5 T_VUWIG_5 /end DEF_CHARACTERISTIC
/end FUNCTION
/begin FUNCTION jUewIgetrG6_Fktn "Applikationesgroessen Instanz jUewIgetrG6"
 /begin DEF_CHARACTERISTIC KF_IGOUWIGNGTOB_6 KF_IGOUWIGNGTUN_6 KL_UWIGOBERS_6 KL_UWIGOB_6 KL_UWIGUNERS_6 KL_UWIGUN_6 ND_TOBUWIG_GE_6 ND_TUNUWIG_GE_6 T_VUWIG_6 /end DEF_CHARACTERISTIC
/end FUNCTION
/begin FUNCTION jUewIgetrG7_Fktn "Applikationesgroessen Instanz jUewIgetrG7"
 /begin DEF_CHARACTERISTIC KF_IGOUWIGNGTOB_7 KF_IGOUWIGNGTUN_7 KL_UWIGOBERS_7 KL_UWIGOB_7 KL_UWIGUNERS_7 KL_UWIGUN_7 ND_TOBUWIG_GE_7 ND_TUNUWIG_GE_7 T_VUWIG_7 /end DEF_CHARACTERISTIC
/end FUNCTION
/begin FUNCTION jUewIgetrG8_Fktn "Applikationesgroessen Instanz jUewIgetrG8"
 /begin DEF_CHARACTERISTIC KF_IGOUWIGNGTOB_8 KF_IGOUWIGNGTUN_8 KL_UWIGOBERS_8 KL_UWIGOB_8 KL_UWIGUNERS_8 KL_UWIGUN_8 ND_TOBUWIG_GE_8 ND_TUNUWIG_GE_8 T_VUWIG_8 /end DEF_CHARACTERISTIC
/end FUNCTION
/begin FUNCTION jUewIgetrGR_Fktn "Applikationesgroessen Instanz jUewIgetrGR"
 /begin DEF_CHARACTERISTIC KF_IGOUWIGNGTOB_R KF_IGOUWIGNGTUN_R KL_UWIGOBERS_R KL_UWIGOB_R KL_UWIGUNERS_R KL_UWIGUN_R ND_TOBUWIG_GE_R ND_TUNUWIG_GE_R T_VUWIG_R /end DEF_CHARACTERISTIC
/end FUNCTION
/begin FUNCTION jUewIgetrKA_Fktn "Applikationesgroessen Instanz jUewIgetrKA" /begin DEF_CHARACTERISTIC MIN_ERFOLG_SYMIO_A /end DEF_CHARACTERISTIC /end FUNCTION
/begin FUNCTION jUewIgetrKB_Fktn "Applikationesgroessen Instanz jUewIgetrKB" /begin DEF_CHARACTERISTIC MIN_ERFOLG_SYMIO_B /end DEF_CHARACTERISTIC /end FUNCTION
/begin FUNCTION jUewIgetrKC_Fktn "Applikationesgroessen Instanz jUewIgetrKC" /begin DEF_CHARACTERISTIC MIN_ERFOLG_SYMIO_C /end DEF_CHARACTERISTIC /end FUNCTION
/begin FUNCTION jUewIgetrKD_Fktn "Applikationesgroessen Instanz jUewIgetrKD" /begin DEF_CHARACTERISTIC MIN_ERFOLG_SYMIO_D /end DEF_CHARACTERISTIC /end FUNCTION
/begin FUNCTION jUewIgetrKE_Fktn "Applikationesgroessen Instanz jUewIgetrKE" /begin DEF_CHARACTERISTIC MIN_ERFOLG_SYMIO_E /end DEF_CHARACTERISTIC /end FUNCTION
/begin FUNCTION jUewIgetrS12_Fktn "Applikationesgroessen Instanz jUewIgetrS12"
 /begin DEF_CHARACTERISTIC KL_IGOUWIGOB12 KL_IGOUWIGUN12 MAX_STOER_OFFSET12 MAX_SYM_UWIG_SCHALT12 NGS_ABUWIG12 T_VNGABUWIG12 T_VUWIG12 /end DEF_CHARACTERISTIC
/end FUNCTION
/begin FUNCTION jUewIgetrS21_Fktn "Applikationesgroessen Instanz jUewIgetrS21"
 /begin DEF_CHARACTERISTIC KL_IGOUWIGOB21 KL_IGOUWIGUN21 MAX_STOER_OFFSET21 MAX_SYM_UWIG_SCHALT21 NGS_ABUWIG21 T_VNGABUWIG21 T_VUWIG21 /end DEF_CHARACTERISTIC
/end FUNCTION
/begin FUNCTION jUewIgetrS23_Fktn "Applikationesgroessen Instanz jUewIgetrS23"
 /begin DEF_CHARACTERISTIC KL_IGOUWIGOB23 KL_IGOUWIGUN23 MAX_STOER_OFFSET23 MAX_SYM_UWIG_SCHALT23 NGS_ABUWIG23 T_VNGABUWIG23 T_VUWIG23 /end DEF_CHARACTERISTIC
/end FUNCTION
/begin FUNCTION jUewIgetrS31_Fktn "Applikationesgroessen Instanz jUewIgetrS31"
 /begin DEF_CHARACTERISTIC KL_IGOUWIGOB31 KL_IGOUWIGUN31 MAX_STOER_OFFSET31 MAX_SYM_UWIG_SCHALT31 NGS_ABUWIG31 T_VNGABUWIG31 T_VUWIG31 /end DEF_CHARACTERISTIC
/end FUNCTION
/begin FUNCTION jUewIgetrS32_Fktn "Applikationesgroessen Instanz jUewIgetrS32"
 /begin DEF_CHARACTERISTIC KL_IGOUWIGOB32 KL_IGOUWIGUN32 MAX_STOER_OFFSET32 MAX_SYM_UWIG_SCHALT32 NGS_ABUWIG32 T_VNGABUWIG32 T_VUWIG32 /end DEF_CHARACTERISTIC
/end FUNCTION
/begin FUNCTION jUewIgetrS34_Fktn "Applikationesgroessen Instanz jUewIgetrS34"
 /begin DEF_CHARACTERISTIC KL_IGOUWIGOB34 KL_IGOUWIGUN34 MAX_STOER_OFFSET34 MAX_SYM_UWIG_SCHALT34 NGS_ABUWIG34 T_VNGABUWIG34 T_VUWIG34 /end DEF_CHARACTERISTIC
/end FUNCTION
/begin FUNCTION jUewIgetrS42_Fktn "Applikationesgroessen Instanz jUewIgetrS42"
 /begin DEF_CHARACTERISTIC KL_IGOUWIGOB42 KL_IGOUWIGUN42 MAX_STOER_OFFSET42 MAX_SYM_UWIG_SCHALT42 NGS_ABUWIG42 T_VNGABUWIG42 T_VUWIG42 /end DEF_CHARACTERISTIC
/end FUNCTION
/begin FUNCTION jUewIgetrS43_Fktn "Applikationesgroessen Instanz jUewIgetrS43"
 /begin DEF_CHARACTERISTIC KL_IGOUWIGOB43 KL_IGOUWIGUN43 MAX_STOER_OFFSET43 MAX_SYM_UWIG_SCHALT43 NGS_ABUWIG43 T_VNGABUWIG43 T_VUWIG43 /end DEF_CHARACTERISTIC
/end FUNCTION
/begin FUNCTION jUewIgetrS45_Fktn "Applikationesgroessen Instanz jUewIgetrS45"
 /begin DEF_CHARACTERISTIC KL_IGOUWIGOB45 KL_IGOUWIGUN45 MAX_STOER_OFFSET45 MAX_SYM_UWIG_SCHALT45 NGS_ABUWIG45 T_VNGABUWIG45 T_VUWIG45 /end DEF_CHARACTERISTIC
/end FUNCTION
/begin FUNCTION jUewIgetrS51_Fktn "Applikationesgroessen Instanz jUewIgetrS51"
 /begin DEF_CHARACTERISTIC KL_IGOUWIGOB51 KL_IGOUWIGUN51 MAX_STOER_OFFSET51 MAX_SYM_UWIG_SCHALT51 NGS_ABUWIG51 T_VNGABUWIG51 T_VUWIG51 /end DEF_CHARACTERISTIC
/end FUNCTION
/begin FUNCTION jUewIgetrS53_Fktn "Applikationesgroessen Instanz jUewIgetrS53"
 /begin DEF_CHARACTERISTIC KL_IGOUWIGOB53 KL_IGOUWIGUN53 MAX_STOER_OFFSET53 MAX_SYM_UWIG_SCHALT53 NGS_ABUWIG53 T_VNGABUWIG53 T_VUWIG53 /end DEF_CHARACTERISTIC
/end FUNCTION
/begin FUNCTION jUewIgetrS54_Fktn "Applikationesgroessen Instanz jUewIgetrS54"
 /begin DEF_CHARACTERISTIC KL_IGOUWIGOB54 KL_IGOUWIGUN54 MAX_STOER_OFFSET54 MAX_SYM_UWIG_SCHALT54 NGS_ABUWIG54 T_VNGABUWIG54 T_VUWIG54 /end DEF_CHARACTERISTIC
/end FUNCTION
/begin FUNCTION jUewIgetrS56_Fktn "Applikationesgroessen Instanz jUewIgetrS56"
 /begin DEF_CHARACTERISTIC KL_IGOUWIGOB56 KL_IGOUWIGUN56 MAX_STOER_OFFSET56 MAX_SYM_UWIG_SCHALT56 NGS_ABUWIG56 T_VNGABUWIG56 T_VUWIG56 /end DEF_CHARACTERISTIC
/end FUNCTION
/begin FUNCTION jUewIgetrS63_Fktn "Applikationesgroessen Instanz jUewIgetrS63"
 /begin DEF_CHARACTERISTIC KL_IGOUWIGOB63 KL_IGOUWIGUN63 MAX_STOER_OFFSET63 MAX_SYM_UWIG_SCHALT63 NGS_ABUWIG63 T_VNGABUWIG63 T_VUWIG63 /end DEF_CHARACTERISTIC
/end FUNCTION
/begin FUNCTION jUewIgetrS64_Fktn "Applikationesgroessen Instanz jUewIgetrS64"
 /begin DEF_CHARACTERISTIC KL_IGOUWIGOB64 KL_IGOUWIGUN64 MAX_STOER_OFFSET64 MAX_SYM_UWIG_SCHALT64 NGS_ABUWIG64 T_VNGABUWIG64 T_VUWIG64 /end DEF_CHARACTERISTIC
/end FUNCTION
/begin FUNCTION jUewIgetrS65_Fktn "Applikationesgroessen Instanz jUewIgetrS65"
 /begin DEF_CHARACTERISTIC KL_IGOUWIGOB65 KL_IGOUWIGUN65 MAX_STOER_OFFSET65 MAX_SYM_UWIG_SCHALT65 NGS_ABUWIG65 T_VNGABUWIG65 T_VUWIG65 /end DEF_CHARACTERISTIC
/end FUNCTION
/begin FUNCTION jUewIgetrS67_Fktn "Applikationesgroessen Instanz jUewIgetrS67"
 /begin DEF_CHARACTERISTIC KL_IGOUWIGOB67 KL_IGOUWIGUN67 MAX_STOER_OFFSET67 MAX_SYM_UWIG_SCHALT67 NGS_ABUWIG67 T_VNGABUWIG67 T_VUWIG67 /end DEF_CHARACTERISTIC
/end FUNCTION
/begin FUNCTION jUewIgetrS71_Fktn "Applikationesgroessen Instanz jUewIgetrS71"
 /begin DEF_CHARACTERISTIC KL_IGOUWIGOB71 KL_IGOUWIGUN71 MAX_STOER_OFFSET71 MAX_SYM_UWIG_SCHALT71 NGS_ABUWIG71 T_VNGABUWIG71 T_VUWIG71 /end DEF_CHARACTERISTIC
/end FUNCTION
/begin FUNCTION jUewIgetrS75_Fktn "Applikationesgroessen Instanz jUewIgetrS75"
 /begin DEF_CHARACTERISTIC KL_IGOUWIGOB75 KL_IGOUWIGUN75 MAX_STOER_OFFSET75 MAX_SYM_UWIG_SCHALT75 NGS_ABUWIG75 T_VNGABUWIG75 T_VUWIG75 /end DEF_CHARACTERISTIC
/end FUNCTION
/begin FUNCTION jUewIgetrS76_Fktn "Applikationesgroessen Instanz jUewIgetrS76"
 /begin DEF_CHARACTERISTIC KL_IGOUWIGOB76 KL_IGOUWIGUN76 MAX_STOER_OFFSET76 MAX_SYM_UWIG_SCHALT76 NGS_ABUWIG76 T_VNGABUWIG76 T_VUWIG76 /end DEF_CHARACTERISTIC
/end FUNCTION
/begin FUNCTION jUewIgetrS78_Fktn "Applikationesgroessen Instanz jUewIgetrS78"
 /begin DEF_CHARACTERISTIC KL_IGOUWIGOB78 KL_IGOUWIGUN78 MAX_STOER_OFFSET78 MAX_SYM_UWIG_SCHALT78 NGS_ABUWIG78 T_VNGABUWIG78 T_VUWIG78 /end DEF_CHARACTERISTIC
/end FUNCTION
/begin FUNCTION jUewIgetrS82_Fktn "Applikationesgroessen Instanz jUewIgetrS82"
 /begin DEF_CHARACTERISTIC KL_IGOUWIGOB82 KL_IGOUWIGUN82 MAX_STOER_OFFSET82 MAX_SYM_UWIG_SCHALT82 NGS_ABUWIG82 T_VNGABUWIG82 T_VUWIG82 /end DEF_CHARACTERISTIC
/end FUNCTION
/begin FUNCTION jUewIgetrS84_Fktn "Applikationesgroessen Instanz jUewIgetrS84"
 /begin DEF_CHARACTERISTIC KL_IGOUWIGOB84 KL_IGOUWIGUN84 MAX_STOER_OFFSET84 MAX_SYM_UWIG_SCHALT84 NGS_ABUWIG84 T_VNGABUWIG84 T_VUWIG84 /end DEF_CHARACTERISTIC
/end FUNCTION
/begin FUNCTION jUewIgetrS86_Fktn "Applikationesgroessen Instanz jUewIgetrS86"
 /begin DEF_CHARACTERISTIC KL_IGOUWIGOB86 KL_IGOUWIGUN86 MAX_STOER_OFFSET86 MAX_SYM_UWIG_SCHALT86 NGS_ABUWIG86 T_VNGABUWIG86 T_VUWIG86 /end DEF_CHARACTERISTIC
/end FUNCTION
/begin FUNCTION jUewIgetrS87_Fktn "Applikationesgroessen Instanz jUewIgetrS87"
 /begin DEF_CHARACTERISTIC KL_IGOUWIGOB87 KL_IGOUWIGUN87 MAX_STOER_OFFSET87 MAX_SYM_UWIG_SCHALT87 NGS_ABUWIG87 T_VNGABUWIG87 T_VUWIG87 /end DEF_CHARACTERISTIC
/end FUNCTION
/begin FUNCTION jUewParksperrenmagnet_Fktn "Applikationesgroessen Instanz jUewParksperrenmagnet"
 /begin DEF_CHARACTERISTIC C_PMUEB IEDSPOS_PMUEB MAX_STOER_PMUEB TMAX_PMUEB TVERZ_PMUEB T_PMUEBDEF V_PMUEB_OB V_PMUEB_UN /end DEF_CHARACTERISTIC
/end FUNCTION
/begin FUNCTION jUewSgetf_Fktn "Applikationesgroessen Instanz jUewSgetf"
 /begin DEF_CHARACTERISTIC KL_CGVERZPOSVUEB KL_TMINVERZCG_POSVUEB KL_TUEBCGPOSVMECHDEF MAX_STOERPOSVMECHDEF NMOTMAX_POSVUEB /end DEF_CHARACTERISTIC
/end FUNCTION
/begin FUNCTION jUl2EdsLg_Fktn "Applikationesgroessen Instanz jUl2EdsLg"
 /begin DEF_CHARACTERISTIC CS_EDSLOGIK IEDSC_MAX_POSVC I_EDSMAXPOSPUEB_POS I_EDSMINPOSPUEB_C I_KUPB_MIN_EDSLOGIK I_KUPD_MAX_EDSLOGIK J_VM_K0 KL_I_MAXK0 KL_MAXSTOER_EDSLOGIK_K0 KL_M_REIB_K0 KL_N_DIFF_K0_MIN N_DIFF_EM_MAX N_K0_TASKS N_MAXKABPOS_C N_MAXKABPOS_E N_MAXKFLWECHSEL N_MAXSTOERPOS_P N_MAXSTOERVPLAUSIPOS_P N_STOER_MAX_FAHRTR_EDSLOGIK N_VERZ_EDSLOGIK N_VPOSPUEB SWI_K0UEB VS_FZG_RSICH_LEV2 /end DEF_CHARACTERISTIC
/end FUNCTION
/begin FUNCTION jUl2GetrMAuf_Fktn "Applikationesgroessen Instanz jUl2GetrMAuf"
 /begin DEF_CHARACTERISTIC KF_MMOTGETRAUF KF_OFFSETMMOTGETRAUF KL_F_VGETRAUF N_MAXSTOERMGETRAUF /end DEF_CHARACTERISTIC
/end FUNCTION
/begin FUNCTION jUl2Kflpl_Fktn "Applikationesgroessen Instanz jUl2Kflpl" /begin DEF_CHARACTERISTIC I_EDSNULLPOSNUEB MAX_STOERPOSNEDS MAX_STOERPOSNEDS14 /end DEF_CHARACTERISTIC /end FUNCTION
/begin FUNCTION jUl2KflplKA_Fktn "Applikationesgroessen Instanz jUl2KflplKA" /begin DEF_CHARACTERISTIC I_EDSMAXPOSNUEB_A /end DEF_CHARACTERISTIC /end FUNCTION
/begin FUNCTION jUl2KflplKB_Fktn "Applikationesgroessen Instanz jUl2KflplKB" /begin DEF_CHARACTERISTIC I_EDSMAXPOSNUEB_B /end DEF_CHARACTERISTIC /end FUNCTION
/begin FUNCTION jUl2KflplKC_Fktn "Applikationesgroessen Instanz jUl2KflplKC" /begin DEF_CHARACTERISTIC I_EDSMINPOSNUEB_C /end DEF_CHARACTERISTIC /end FUNCTION
/begin FUNCTION jUl2KflplKD_Fktn "Applikationesgroessen Instanz jUl2KflplKD" /begin DEF_CHARACTERISTIC I_EDSMINPOSNUEB_D /end DEF_CHARACTERISTIC /end FUNCTION
/begin FUNCTION jUl2KflplKE_Fktn "Applikationesgroessen Instanz jUl2KflplKE" /begin DEF_CHARACTERISTIC I_EDSMINPOSNUEB_E /end DEF_CHARACTERISTIC /end FUNCTION
/begin FUNCTION jUl2Kuppl_Fktn "Applikationesgroessen Instanz jUl2Kuppl" /begin DEF_CHARACTERISTIC N_KUP_OFFEN N_KUP_OFFEN_STROMLOS /end DEF_CHARACTERISTIC /end FUNCTION
/begin FUNCTION jUl2KupplKA_Fktn "Applikationesgroessen Instanz jUl2KupplKA"
 /begin DEF_CHARACTERISTIC KF_IEDSMAXMMOTCGLOGIKUEB_A KF_IEDSMAXOFFMMOTCGLOGIKUEB_A KF_MAXSTOERCGDELTAI_EDSLOGIK_A KL_IEDSMAXOFFCG_BEF1_A KL_MAX_STOEROFFCG_BEF1_A /end DEF_CHARACTERISTIC
/end FUNCTION
/begin FUNCTION jUl2KupplKB_Fktn "Applikationesgroessen Instanz jUl2KupplKB"
 /begin DEF_CHARACTERISTIC KF_IEDSMAXMMOTCGLOGIKUEB_B KF_IEDSMAXOFFMMOTCGLOGIKUEB_B KF_MAXSTOERCGDELTAI_EDSLOGIK_B KL_IEDSMAXOFFCG_BEF1_B KL_MAX_STOEROFFCG_BEF1_B /end DEF_CHARACTERISTIC
/end FUNCTION
/begin RECORD_LAYOUT ZF_kf_si16_S5_S3 FNC_VALUES 5 SWORD ROW_DIR DIRECT AXIS_PTS_X 3 SWORD INDEX_INCR DIRECT AXIS_PTS_Y 4 SWORD INDEX_INCR DIRECT NO_AXIS_PTS_X 1 ULONG NO_AXIS_PTS_Y 2 ULONG /end RECORD_LAYOUT
/begin RECORD_LAYOUT ZF_kf_ui16_S5_S3 FNC_VALUES 5 UWORD ROW_DIR DIRECT AXIS_PTS_X 3 UWORD INDEX_INCR DIRECT AXIS_PTS_Y 4 UWORD INDEX_INCR DIRECT NO_AXIS_PTS_X 1 ULONG NO_AXIS_PTS_Y 2 ULONG /end RECORD_LAYOUT
/begin RECORD_LAYOUT ZF_kf_ui8_S5_S3 FNC_VALUES 5 UBYTE ROW_DIR DIRECT AXIS_PTS_X 3 UBYTE INDEX_INCR DIRECT AXIS_PTS_Y 4 UBYTE INDEX_INCR DIRECT NO_AXIS_PTS_X 1 ULONG NO_AXIS_PTS_Y 2 ULONG /end RECORD_LAYOUT
/begin RECORD_LAYOUT ZF_kl_si16_S5_S3 FNC_VALUES 3 SWORD COLUMN_DIR DIRECT AXIS_PTS_X 2 SWORD INDEX_INCR DIRECT NO_AXIS_PTS_X 1 ULONG /end RECORD_LAYOUT
/begin RECORD_LAYOUT ZF_kl_ui16_S5_S3 FNC_VALUES 3 UWORD COLUMN_DIR DIRECT AXIS_PTS_X 2 UWORD INDEX_INCR DIRECT NO_AXIS_PTS_X 1 ULONG /end RECORD_LAYOUT
/begin RECORD_LAYOUT ZF_kl_ui8_S5_S3 FNC_VALUES 3 UBYTE COLUMN_DIR DIRECT AXIS_PTS_X 2 UBYTE INDEX_INCR DIRECT NO_AXIS_PTS_X 1 ULONG /end RECORD_LAYOUT
/begin RECORD_LAYOUT ZF_kw_si16_S5_S3 FNC_VALUES 1 SWORD COLUMN_DIR DIRECT /end RECORD_LAYOUT
/begin RECORD_LAYOUT ZF_kw_ui16_S5_S3 FNC_VALUES 1 UWORD COLUMN_DIR DIRECT /end RECORD_LAYOUT
/begin RECORD_LAYOUT ZF_kw_ui32_S5_S3 FNC_VALUES 1 ULONG COLUMN_DIR DIRECT /end RECORD_LAYOUT
/begin RECORD_LAYOUT ZF_kw_ui8_S5_S3 FNC_VALUES 1 UBYTE COLUMN_DIR DIRECT /end RECORD_LAYOUT
/begin RECORD_LAYOUT ZF_tab_bool8_S5_S3 FNC_VALUES 2 UBYTE COLUMN_DIR DIRECT NO_AXIS_PTS_X 1 ULONG /end RECORD_LAYOUT
/begin RECORD_LAYOUT ZF_tab_ui16_S5_S3 FNC_VALUES 2 UWORD COLUMN_DIR DIRECT NO_AXIS_PTS_X 1 ULONG /end RECORD_LAYOUT
/end MODULE
/end PROJECT
