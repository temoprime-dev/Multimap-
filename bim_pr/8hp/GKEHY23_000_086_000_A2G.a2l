ASAP2_VERSION 1 51
/begin PROJECT ZHBC8600 "Gen2_BMW_System_Supplier_Lib"
/begin MODULE CPP ""
/begin MOD_COMMON "" BYTE_ORDER MSB_FIRST ALIGNMENT_BYTE 1 ALIGNMENT_WORD 2 ALIGNMENT_LONG 4 ALIGNMENT_FLOAT32_IEEE 4 ALIGNMENT_FLOAT64_IEEE 1 /end MOD_COMMON
/begin COMPU_TAB _CNV_P_2_A_I_32_S2 "" TAB_INTP 2 0 0 65535 65535 /end COMPU_TAB
/begin COMPU_TAB _CNV_P_2_A_I_5_S2 "" TAB_INTP 2 0 0 255 255 /end COMPU_TAB
/begin COMPU_VTAB _CNV_S_2_Enum_EFP_D_101_S2 "" TAB_VERB 2 0 "FP_POS" 1 "FP_NEG" DEFAULT_VALUE "" /end COMPU_VTAB
/begin COMPU_VTAB _CNV_S_9_Enum_EGANG_21_S2 "" TAB_VERB 9 0 "GANG_1" 1 "GANG_2" 2 "GANG_3" 3 "GANG_4" 4 "GANG_5" 5 "GANG_6" 6 "GANG_7" 7 "GANG_8" 8 "GANG_9" DEFAULT_VALUE "" /end COMPU_VTAB
/begin COMPU_METHOD _CNV_P_2_A_I_32_CM_S2 "" TAB_INTP "%6.3" "" COMPU_TAB_REF _CNV_P_2_A_I_32_S2 /end COMPU_METHOD
/begin COMPU_METHOD _CNV_P_2_A_I_5_CM_S2 "" TAB_INTP "%6.3" "" COMPU_TAB_REF _CNV_P_2_A_I_5_S2 /end COMPU_METHOD
/begin COMPU_METHOD _CNV_R_R_Umr_1000_z_36_CM_S2 "" RAT_FUNC "%6.3" "" COEFFS 0 1000 0 0 0 1 /end COMPU_METHOD
/begin COMPU_METHOD _CNV_R_R_Umr_100_zu_194_CM_S2 "" RAT_FUNC "%6.3" "U/(min*ms)" COEFFS 0 100 0 0 0 1 /end COMPU_METHOD
/begin COMPU_METHOD _CNV_R_R_Umr_100_zu_42_CM_S2 "" RAT_FUNC "%6.3" "" COEFFS 0 100 0 0 0 1 /end COMPU_METHOD
/begin COMPU_METHOD _CNV_R_R_Umr_10_zu__133_CM_S2 "" RAT_FUNC "%6.3" "U/min" COEFFS 0 10 0 0 0 1 /end COMPU_METHOD
/begin COMPU_METHOD _CNV_R_R_Umr_10_zu__138_CM_S2 "" RAT_FUNC "%6.3" "1/s²" COEFFS 0 10 0 0 0 1 /end COMPU_METHOD
/begin COMPU_METHOD _CNV_R_R_Umr_10_zu__241_CM_S2 "" RAT_FUNC "%6.3" "1/s³" COEFFS 0 10 0 0 0 1 /end COMPU_METHOD
/begin COMPU_METHOD _CNV_R_R_Umr_10_zu__37_CM_S2 "" RAT_FUNC "%6.3" "m/s*s" COEFFS 0 10 0 0 0 1 /end COMPU_METHOD
/begin COMPU_METHOD _CNV_R_R_Umr_10_zu__9_CM_S2 "" RAT_FUNC "%6.3" "%" COEFFS 0 10 0 0 0 1 /end COMPU_METHOD
/begin COMPU_METHOD _CNV_R_R_Umr_1_zu_1_110_CM_S2 "" RAT_FUNC "%6.3" "°/s" COEFFS 0 1 0 0 0 1 /end COMPU_METHOD
/begin COMPU_METHOD _CNV_R_R_Umr_1_zu_1_214_CM_S2 "" RAT_FUNC "%6.3" "kg" COEFFS 0 1 0 0 0 1 /end COMPU_METHOD
/begin COMPU_METHOD _CNV_R_R_Umr_1_zu_1_266_CM_S2 "" RAT_FUNC "%6.3" "% von %" COEFFS 0 1 0 0 0 1 /end COMPU_METHOD
/begin COMPU_METHOD _CNV_R_R_Umr_1_zu_1_2_CM_S2 "" RAT_FUNC "%6.3" "" COEFFS 0 1 0 0 0 1 /end COMPU_METHOD
/begin COMPU_METHOD _CNV_R_R_Umr_1_zu_1_30_CM_S2 "" RAT_FUNC "%6.3" "%" COEFFS 0 1 0 0 0 1 /end COMPU_METHOD
/begin COMPU_METHOD _CNV_R_R_Umr_1_zu_1_38_CM_S2 "" RAT_FUNC "%6.3" "Nm" COEFFS 0 1 0 0 0 1 /end COMPU_METHOD
/begin COMPU_METHOD _CNV_R_R_Umr_1_zu_1_3_CM_S2 "" RAT_FUNC "%6.3" "U/min" COEFFS 0 1 0 0 0 1 /end COMPU_METHOD
/begin COMPU_METHOD _CNV_R_R_Umr_1_zu_1_62_CM_S2 "" RAT_FUNC "%6.3" "Nm/s" COEFFS 0 0.1 0 0 0 1 /end COMPU_METHOD
/begin COMPU_METHOD _CNV_R_R_Umr_1_zu_1_6_CM_S2 "" RAT_FUNC "%6.3" "ms" COEFFS 0 1 0 0 0 1 /end COMPU_METHOD
/begin COMPU_METHOD _CNV_R_R_Umr_1_zu_1_7_CM_S2 "" RAT_FUNC "%6.3" "%/s" COEFFS 0 1 0 0 0 1 /end COMPU_METHOD
/begin COMPU_METHOD _CNV_R_R_Umr_20_zu__148_CM_S2 "" RAT_FUNC "%6.3" "°/s" COEFFS 0 20 0 0 0 1 /end COMPU_METHOD
/begin COMPU_METHOD _CNV_R_R_Umr_8000_z_63_CM_S2 "" RAT_FUNC "%6.3" "" COEFFS 0 8000 0 0 0 1 /end COMPU_METHOD
/begin COMPU_METHOD _CNV_R_R_Umr_80_zu__192_CM_S2 "" RAT_FUNC "%6.3" "" COEFFS 0 80 0 0 0 1 /end COMPU_METHOD
/begin COMPU_METHOD _CNV_S_2_Enum_EFP_D_101_CM_S2 "" TAB_VERB "%6.3" "" COMPU_TAB_REF _CNV_S_2_Enum_EFP_D_101_S2 /end COMPU_METHOD
/begin COMPU_METHOD _CNV_S_9_Enum_EGANG_21_CM_S2 "" TAB_VERB "%6.3" "" COMPU_TAB_REF _CNV_S_9_Enum_EGANG_21_S2 /end COMPU_METHOD
/begin COMPU_METHOD SAB2_N_4RPM_S3_S3 "int = ((phys * 1) / 4) - (0) 1/min" RAT_FUNC "%4.3" "1/min" COEFFS 0 0.25 0 0 0 1 /end COMPU_METHOD
/begin COMPU_METHOD SAB2_N_50RPM_S3_S3 "int = ((phys * 1) / 50) - (0) 1/min" RAT_FUNC "%4.3" "1/min" COEFFS 0 0.02 0 0 0 1 /end COMPU_METHOD
/begin COMPU_METHOD SAB2_N_5RPM_S3_S3 "int = ((phys * 1) / 5) - (0) 1/min" RAT_FUNC "%4.3" "1/min" COEFFS 0 0.2 0 0 0 1 /end COMPU_METHOD
/begin COMPU_METHOD SAB2_N_64RPM_S3_S3 "int = ((phys * 1) / 64) - (0) 1/min" RAT_FUNC "%4.3" "1/min" COEFFS 0 0.015625 0 0 0 1 /end COMPU_METHOD
/begin COMPU_METHOD SAB2_N_RADPS64_M32767_S3_S3 "int = ((phys * 64) / 1) - (-32767) rad/s" RAT_FUNC "%4.3" "rad/s" COEFFS 0 64 32767 0 0 1 /end COMPU_METHOD
/begin COMPU_METHOD SAB2_N_RPM10_S3_S3 "int = ((phys * 10) / 1) - (0) 1/min" RAT_FUNC "%4.3" "1/min" COEFFS 0 10 0 0 0 1 /end COMPU_METHOD
/begin COMPU_METHOD SAB2_N_RPM24_S3_S3 "int = ((phys * 24) / 1) - (0) U/min" RAT_FUNC "%4.3" "U/min" COEFFS 0 24 0 0 0 1 /end COMPU_METHOD
/begin COMPU_METHOD SAB2_N_RPM32_S3_S3 "int = ((phys * 32) / 1) - (0) 1/min" RAT_FUNC "%4.3" "1/min" COEFFS 0 32 0 0 0 1 /end COMPU_METHOD
/begin COMPU_METHOD SAB2_N_RPM4_S3_S3 "int = ((phys * 4) / 1) - (0) 1/min" RAT_FUNC "%4.3" "1/min" COEFFS 0 4 0 0 0 1 /end COMPU_METHOD
/begin COMPU_METHOD SAB2_N_RPM8_S3_S3 "int = ((phys * 8) / 1) - (0) 1/min" RAT_FUNC "%4.3" "1/min" COEFFS 0 8 0 0 0 1 /end COMPU_METHOD
/begin COMPU_METHOD SAB2_N_RPM_M2000_S3_S3 "int = ((phys * 1) / 1) - (-2000) 1/min" RAT_FUNC "%1.0" "1/min" COEFFS 0 1 2000 0 0 1 /end COMPU_METHOD
/begin COMPU_METHOD SAB2_N_RPM_S3_S3 "int = ((phys * 1) / 1) - (0) 1/min" RAT_FUNC "%1.0" "1/min" COEFFS 0 1 0 0 0 1 /end COMPU_METHOD
/begin COMPU_METHOD SAB2_NG_100RPM_S3_S3 "int = ((phys * 1) / 100) - (0) 100rpm/sec" RAT_FUNC "%4.3" "100rpm/sec" COEFFS 0 0.01 0 0 0 1 /end COMPU_METHOD
/begin COMPU_METHOD SAB2_OM_YAWRATE_GRADPS200_M32768_S3_S3 "int = ((phys * 200) / 1) - (-32768) Grad/s" RAT_FUNC "%4.3" "Grad/s" COEFFS 0 200 32768 0 0 1 /end COMPU_METHOD
/begin COMPU_METHOD SAB2_OM_YAWRATE_GRADPS20_S3_S3 "int = ((phys * 20) / 1) - (0) Grad/s" RAT_FUNC "%4.3" "Grad/s" COEFFS 0 20 0 0 0 1 /end COMPU_METHOD
/begin COMPU_METHOD SAB2_P_1BAR_S3_S3 "int = ((phys * 1) / 1) - (0) bar" RAT_FUNC "%1.0" "bar" COEFFS 0 1 0 0 0 1 /end COMPU_METHOD
/begin COMPU_METHOD SAB2_P_1HPA_S3_S3 "int = ((phys * 1) / 1) - (0) hPa" RAT_FUNC "%1.0" "hPa" COEFFS 0 1 0 0 0 1 /end COMPU_METHOD
/begin COMPU_METHOD SAB2_P_2396KPA100_M2444_S3_S3 "int = ((phys * 100) / 2396) - (-102) kPa" RAT_FUNC "%4.3" "kPa" COEFFS 0 0.0417362270451 102 0 0 1 /end COMPU_METHOD
/begin COMPU_METHOD SAB2_P_BAR10_S3_S3 "int = ((phys * 10) / 1) - (0) bar" RAT_FUNC "%4.3" "bar" COEFFS 0 10 0 0 0 1 /end COMPU_METHOD
/begin COMPU_METHOD SAB2_P_BAR2_S3_S3 "int = ((phys * 2) / 1) - (0) bar" RAT_FUNC "%4.3" "bar" COEFFS 0 2 0 0 0 1 /end COMPU_METHOD
/begin COMPU_METHOD SAB2_P_BAR5_S3_S3 "int = ((phys * 5) / 1) - (0) bar" RAT_FUNC "%4.3" "bar" COEFFS 0 5 0 0 0 1 /end COMPU_METHOD
/begin COMPU_METHOD SAB2_P_BARO_10HPA_P50_S3_S3 "int = ((phys * 1) / 10) - (50) hPa" RAT_FUNC "%4.3" "hPa" COEFFS 0 0.1 -50 0 0 1 /end COMPU_METHOD
/begin COMPU_METHOD SAB2_P_BARO_1MBAR_S3_S3 "int = ((phys * 1) / 1) - (0) mbar" RAT_FUNC "%1.0" "mbar" COEFFS 0 1 0 0 0 1 /end COMPU_METHOD
/begin COMPU_METHOD SAB2_P_BARO_2HPA_P598_S3_S3 "int = ((phys * 1) / 2) - (299) hPa" RAT_FUNC "%4.3" "hPa" COEFFS 0 0.5 -299 0 0 1 /end COMPU_METHOD
/begin COMPU_METHOD SAB2_P_BARO_5MBAR_S3_S3 "int = ((phys * 1) / 5) - (0) mbar" RAT_FUNC "%4.3" "mbar" COEFFS 0 0.2 0 0 0 1 /end COMPU_METHOD
/begin COMPU_METHOD SAB2_P_MMHG10_S3_S3 "int = ((phys * 10) / 1) - (0) mmHg" RAT_FUNC "%4.3" "mmHg" COEFFS 0 10 0 0 0 1 /end COMPU_METHOD
/begin COMPU_METHOD SAB2_PHI_SENS_1GRAD20_M1280_S3_S3 "int = ((phys * 20) / 1) - (-1280) grad" RAT_FUNC "%4.3" "grad" COEFFS 0 20 1280 0 0 1 /end COMPU_METHOD
/begin COMPU_METHOD SAB2_PHI_SENS_1GRAD3_M128_S3_S3 "int = ((phys * 3) / 1) - (-128) grad" RAT_FUNC "%4.3" "grad" COEFFS 0 3 128 0 0 1 /end COMPU_METHOD
/begin COMPU_METHOD SAB2_PHI_STEERING_ANGLE_45GRAD1024_S3_S3 "int = ((phys * 1024) / 45) - (0) grad" RAT_FUNC "%4.3" "grad" COEFFS 0 22.7555555556 0 0 0 1 /end COMPU_METHOD
/begin COMPU_METHOD SAB2_PHI_STEERING_ANGLE_7GRAD160_S3_S3 "int = ((phys * 160) / 7) - (0) grad" RAT_FUNC "%4.3" "grad" COEFFS 0 22.8571428571 0 0 0 1 /end COMPU_METHOD
/begin COMPU_METHOD SAB2_PHI_STEERING_ANGLE_GRAD10_S3_S3 "int = ((phys * 10) / 1) - (0) grad" RAT_FUNC "%4.3" "grad" COEFFS 0 10 0 0 0 1 /end COMPU_METHOD
/begin COMPU_METHOD SAB2_PROZENT10_M127_S3_S3 "int = ((phys * 10) / 1) - (-127) %" RAT_FUNC "%4.3" "%" COEFFS 0 10 127 0 0 1 /end COMPU_METHOD
/begin COMPU_METHOD SAB2_PROZENT10_S3_S3 "int = ((phys * 10) / 1) - (0) %" RAT_FUNC "%4.3" "%" COEFFS 0 10 0 0 0 1 /end COMPU_METHOD
/begin COMPU_METHOD SAB2_T_10S_S3_S3 "int = ((phys * 1) / 10) - (0) s" RAT_FUNC "%4.3" "s" COEFFS 0 0.1 0 0 0 1 /end COMPU_METHOD
/begin COMPU_METHOD SAB2_T_20MS_S3_S3 "int = ((phys * 1) / 20) - (0) ms" RAT_FUNC "%4.3" "ms" COEFFS 0 0.05 0 0 0 1 /end COMPU_METHOD
/begin COMPU_METHOD SAB2_T_MIN60000_S3_S3 "int = ((phys * 60000) / 1) - (0) min" RAT_FUNC "%22.21" "min" COEFFS 0 60000 0 0 0 1 /end COMPU_METHOD
/begin COMPU_METHOD SAB2_T_TIMER_100MS_S3_S3 "int = ((phys * 1) / 100) - (0) ms" RAT_FUNC "%4.3" "ms" COEFFS 0 0.01 0 0 0 1 /end COMPU_METHOD
/begin COMPU_METHOD SAB2_T_TIMER_1MS_S3_S3 "int = ((phys * 1) / 1) - (0) ms" RAT_FUNC "%1.0" "ms" COEFFS 0 1 0 0 0 1 /end COMPU_METHOD
/begin COMPU_METHOD SAB2_T_TIMER_1S_S3_S3 "int = ((phys * 1) / 1) - (0) s" RAT_FUNC "%1.0" "s" COEFFS 0 1 0 0 0 1 /end COMPU_METHOD
/begin COMPU_METHOD SAB2_T_TIMER_1US_S3_S3 "int = ((phys * 1) / 1) - (0) us" RAT_FUNC "%1.0" "us" COEFFS 0 1 0 0 0 1 /end COMPU_METHOD
/begin COMPU_METHOD SBW_CGT40_M_S1_S3 "int = ((phys * 1) / 1) - (-40) Grad Celsius" RAT_FUNC "%1.0" "Grad Celsius" COEFFS 0 1 40 0 0 1 /end COMPU_METHOD
/begin COMPU_METHOD SBW_HDK_M_S1_S3 "int = ((phys * 2550) / 1004) - (0) %" RAT_FUNC "%3.2" "%" COEFFS 0 2.53984063745 0 0 0 1 /end COMPU_METHOD
/begin COMPU_METHOD SBW_KM_10_S1_S3 "int = ((phys * 1) / 10) - (0) km" RAT_FUNC "%1.0" "km" COEFFS 0 0.1 0 0 0 1 /end COMPU_METHOD
/begin COMPU_METHOD SBW_N_1_M_S1_S3 "int = ((phys * 1) / 1) - (0) 1/min" RAT_FUNC "%1.0" "1/min" COEFFS 0 1 0 0 0 1 /end COMPU_METHOD
/begin COMPU_METHOD SBW_P_BREMSE_2_S1_S3 "int = ((phys * 2) / 1) - (0) bar" RAT_FUNC "%2.1" "bar" COEFFS 0 2 0 0 0 1 /end COMPU_METHOD
/begin COMPU_METHOD SBW_STANDARD_S1_S3 "int = ((phys * 1) / 1) - (0) -" RAT_FUNC "%1.0" "-" COEFFS 0 1 0 0 0 1 /end COMPU_METHOD
/begin COMPU_METHOD SBW_TAUSENDSTEL_U_S1_S3 "int = ((phys * 1000) / 1) - (0) V" RAT_FUNC "%4.3" "V" COEFFS 0 1000 0 0 0 1 /end COMPU_METHOD
/begin COMPU_METHOD SBW_TIMER_10MS_S1_S3 "int = ((phys * 1) / 10) - (0) ms" RAT_FUNC "%1.0" "ms" COEFFS 0 0.1 0 0 0 1 /end COMPU_METHOD
/begin COMPU_METHOD SBW_TIMER_1S_S1_S3 "int = ((phys * 1) / 1) - (0) s" RAT_FUNC "%1.0" "s" COEFFS 0 1 0 0 0 1 /end COMPU_METHOD
/begin COMPU_METHOD SBW_VKMH_16_S1_S3 "int = ((phys * 16) / 1) - (0) km/h" RAT_FUNC "%3.2" "km/h" COEFFS 0 16 0 0 0 1 /end COMPU_METHOD
/begin COMPU_METHOD UMR___1_1_0_S5_S3 "int = ((phys * 1) / 1) - (0) [-]" RAT_FUNC "%1.0" "[-]" COEFFS 0 1 0 0 0 1 /end COMPU_METHOD
/begin COMPU_METHOD UMR_GRADC__1_1_M40_S5_S3 "int = ((phys * 1) / 1) - (-40) [°C]" RAT_FUNC "%1.0" "[°C]" COEFFS 0 1 40 0 0 1 /end COMPU_METHOD
/begin MEASUREMENT CRT_ANGLEICH_UMSCHALT_DYNDZM "" ULONG _CNV_R_R_Umr_1_zu_1_6_CM_S2 1 0 0 4294967295 ECU_ADDRESS 0xFFF8EE64 FORMAT "%2.0" /end MEASUREMENT
/begin MEASUREMENT CTR_GRADIENT_PHASE4_DYNDZM "" ULONG _CNV_R_R_Umr_1_zu_1_6_CM_S2 1 0 0 4294967295 ECU_ADDRESS 0xFFF8EE68 FORMAT "%2.0" /end MEASUREMENT
/begin MEASUREMENT CTR_WARTEN_PHASE3_DYNDZM "" ULONG _CNV_R_R_Umr_1_zu_1_6_CM_S2 1 0 0 4294967295 ECU_ADDRESS 0xFFF8EE6C FORMAT "%2.0" /end MEASUREMENT
/begin MEASUREMENT C_ABREGLER "" UWORD _CNV_R_R_Umr_1_zu_1_2_CM_S2 1 0 0 65535 ECU_ADDRESS 0xFFF8E728 FORMAT "%2.0" /end MEASUREMENT
/begin MEASUREMENT C_AKTINDEX_MOTFWFILT "" UBYTE _CNV_R_R_Umr_1_zu_1_2_CM_S2 1 0 0 8 ECU_ADDRESS 0xFFF8EA68 FORMAT "%2.0" /end MEASUREMENT
/begin MEASUREMENT C_AUSROLL_RS21 "" UWORD _CNV_R_R_Umr_1_zu_1_2_CM_S2 1 0 0 65535 ECU_ADDRESS 0xFFF8E7E4 FORMAT "%2.0" /end MEASUREMENT
/begin MEASUREMENT C_BMWAGS2_BREAK "" UWORD _CNV_R_R_Umr_1_zu_1_2_CM_S2 1 0 0 65535 ECU_ADDRESS 0xFFF8E1F8 FORMAT "%2.0" /end MEASUREMENT
/begin MEASUREMENT C_DMRSDYNAMIK_ERR "" ULONG _CNV_R_R_Umr_1_zu_1_2_CM_S2 1 0 0 4294967295 ECU_ADDRESS 0xFFF8EDA0 FORMAT "%2.0" /end MEASUREMENT
/begin MEASUREMENT C_FBIT_AN "" UWORD _CNV_R_R_Umr_1_zu_1_2_CM_S2 1 0 0 65535 ECU_ADDRESS 0xFFF8E52E /end MEASUREMENT
/begin MEASUREMENT C_FILT_MEDTASK "" UBYTE _CNV_R_R_Umr_1_zu_1_2_CM_S2 1 0 0 255 ECU_ADDRESS 0xFFF8EA5E FORMAT "%2.0" /end MEASUREMENT
/begin MEASUREMENT C_FT "" SWORD _CNV_R_R_Umr_1_zu_1_2_CM_S2 1 0 -32768 32767 ECU_ADDRESS 0xFFF8E864 FORMAT "%2.0" /end MEASUREMENT
/begin MEASUREMENT C_FT_AGS "" SWORD _CNV_R_R_Umr_1_zu_1_2_CM_S2 1 0 -32768 32767 ECU_ADDRESS 0xFFF8E866 FORMAT "%2.0" /end MEASUREMENT
/begin MEASUREMENT C_FT_BEGR "" SWORD _CNV_R_R_Umr_1_zu_1_2_CM_S2 1 0 -32768 32767 ECU_ADDRESS 0xFFF8E868 FORMAT "%2.0" /end MEASUREMENT
/begin MEASUREMENT C_FT_CR "" SWORD _CNV_R_R_Umr_1_zu_1_2_CM_S2 1 0 -32768 32767 ECU_ADDRESS 0xFFF8E86A FORMAT "%2.0" /end MEASUREMENT
/begin MEASUREMENT C_FT_KON "" SWORD _CNV_R_R_Umr_1_zu_1_2_CM_S2 1 0 -32768 32767 ECU_ADDRESS 0xFFF8E86C FORMAT "%2.0" /end MEASUREMENT
/begin MEASUREMENT C_HSUKS "" UWORD _CNV_R_R_Umr_1_zu_1_2_CM_S2 1 0 0 65535 ECU_ADDRESS 0xFFF8E616 FORMAT "%2.0" /end MEASUREMENT
/begin MEASUREMENT C_HSURE "" UWORD _CNV_R_R_Umr_1_zu_1_2_CM_S2 1 0 0 65535 ECU_ADDRESS 0xFFF8E618 FORMAT "%2.0" MATRIX_DIM 13 1 1 /end MEASUREMENT
/begin MEASUREMENT C_INSERT_AQKURVEBUF "" UBYTE _CNV_R_R_Umr_1_zu_1_2_CM_S2 1 0 0 20 ECU_ADDRESS 0xFFF8EAA2 FORMAT "%2.0" /end MEASUREMENT
/begin MEASUREMENT C_INSERT_G2WABBUFFER "" UBYTE _CNV_R_R_Umr_1_zu_1_2_CM_S2 1 0 0 255 ECU_ADDRESS 0xFFF8EA5F FORMAT "%2.0" /end MEASUREMENT
/begin MEASUREMENT C_INSERT_GWFPMAXBUFFER "" UBYTE _CNV_R_R_Umr_1_zu_1_2_CM_S2 1 0 0 255 ECU_ADDRESS 0xFFF8EA48 FORMAT "%2.0" /end MEASUREMENT
/begin MEASUREMENT C_INSERT_NABBUFFER "" UBYTE _CNV_R_R_Umr_1_zu_1_2_CM_S2 1 0 0 255 ECU_ADDRESS 0xFFF8EA60 FORMAT "%2.0" /end MEASUREMENT
/begin MEASUREMENT C_INSERT_NTBUFFER "" UBYTE _CNV_R_R_Umr_1_zu_1_2_CM_S2 1 0 0 255 ECU_ADDRESS 0xFFF8EA61 FORMAT "%2.0" /end MEASUREMENT
/begin MEASUREMENT C_INSERT_TBUFFERSGG "" UBYTE _CNV_R_R_Umr_1_zu_1_2_CM_S2 1 0 0 255 ECU_ADDRESS 0xFFF8E9B7 FORMAT "%2.0" /end MEASUREMENT
/begin MEASUREMENT C_INSERT_VFZGMSBUFFER "" UBYTE _CNV_R_R_Umr_1_zu_1_2_CM_S2 1 0 0 255 ECU_ADDRESS 0xFFF8EA02 FORMAT "%2.0" /end MEASUREMENT
/begin MEASUREMENT C_INSERT_VRADRTKORBUFFER "" UBYTE _CNV_R_R_Umr_1_zu_1_2_CM_S2 1 0 0 255 ECU_ADDRESS 0xFFF8EA59 FORMAT "%2.0" /end MEASUREMENT
/begin MEASUREMENT C_MAX_KL_HS "" UBYTE _CNV_P_2_A_I_5_CM_S2 1 0 0 255 ECU_ADDRESS 0xFFF8E9E4 /end MEASUREMENT
/begin MEASUREMENT C_MAX_KL_RS "" UWORD _CNV_P_2_A_I_32_CM_S2 1 0 0 65535 ECU_ADDRESS 0xFFF8E3F8 /end MEASUREMENT
/begin MEASUREMENT C_QS3_EEPROM "" UWORD _CNV_R_R_Umr_1_zu_1_2_CM_S2 1 0 0 65535 ECU_ADDRESS 0xFFF8E342 FORMAT "%2.0" /end MEASUREMENT
/begin MEASUREMENT C_QW_STEIGUNG "" UBYTE _CNV_R_R_Umr_1_zu_1_2_CM_S2 1 0 0 255 ECU_ADDRESS 0xFFF8EBA3 FORMAT "%2.0" /end MEASUREMENT
/begin MEASUREMENT C_SCHLEPP_AGS "" SWORD _CNV_R_R_Umr_1_zu_1_2_CM_S2 1 0 -32768 32767 ECU_ADDRESS 0xFFF8E87C FORMAT "%2.0" /end MEASUREMENT
/begin MEASUREMENT C_SCHLEPP_ALT "" SWORD _CNV_R_R_Umr_1_zu_1_2_CM_S2 1 0 -32768 32767 ECU_ADDRESS 0xFFF8E87E FORMAT "%2.0" /end MEASUREMENT
/begin MEASUREMENT C_SCHLEPP_CTSZG "" SWORD _CNV_R_R_Umr_1_zu_1_2_CM_S2 1 0 -32768 32767 ECU_ADDRESS 0xFFF8E880 FORMAT "%2.0" /end MEASUREMENT
/begin MEASUREMENT C_SCHLEPP_FT "" SWORD _CNV_R_R_Umr_1_zu_1_2_CM_S2 1 0 -32768 32767 ECU_ADDRESS 0xFFF8E882 FORMAT "%2.0" /end MEASUREMENT
/begin MEASUREMENT C_SCHLEPP_GES "" SWORD _CNV_R_R_Umr_1_zu_1_2_CM_S2 1 0 -32768 32767 ECU_ADDRESS 0xFFF8E884 FORMAT "%2.0" /end MEASUREMENT
/begin MEASUREMENT C_SCHLEPP_REF "" SWORD _CNV_R_R_Umr_1_zu_1_2_CM_S2 1 0 -32768 32767 ECU_ADDRESS 0xFFF8E886 FORMAT "%2.0" /end MEASUREMENT
/begin MEASUREMENT C_SCHLUPF_BUFFER "" UWORD _CNV_R_R_Umr_1_zu_1_2_CM_S2 1 0 0 65535 ECU_ADDRESS 0xFFF8E734 FORMAT "%2.0" /end MEASUREMENT
/begin MEASUREMENT C_UPDATE_GN_MTTRAD "" UBYTE _CNV_R_R_Umr_1_zu_1_2_CM_S2 1 0 0 255 ECU_ADDRESS 0xFFF8EB56 FORMAT "%2.0" /end MEASUREMENT
/begin MEASUREMENT C_VALID_GNTMED "" UWORD _CNV_R_R_Umr_1_zu_1_2_CM_S2 1 0 0 65535 ECU_ADDRESS 0xFFF8E5BC FORMAT "%2.0" /end MEASUREMENT
/begin MEASUREMENT CarwashMode.st_HoldN "Status of N-Hold function" UBYTE SBW_STANDARD_S1_S3 1 100 0 7 ECU_ADDRESS 0xFFF89848 DISPLAY_IDENTIFIER st_HoldN.CarwashMode /end MEASUREMENT
/begin MEASUREMENT CyclePos10msIn20ms.cnt_Position "for example 10/-ms=1 10/20ms=2 if reset at end in 20msCycle" UBYTE SBW_STANDARD_S1_S3 1 100 0 255 ECU_ADDRESS 0xFFF893DA DISPLAY_IDENTIFIER cnt_Position.CyclePos10msIn20ms /end MEASUREMENT
/begin MEASUREMENT DA_Q_KURVE "" SWORD _CNV_R_R_Umr_10_zu__37_CM_S2 1 0 -20 20 ECU_ADDRESS 0xFFF8E684 FORMAT "%3.1" /end MEASUREMENT
/begin MEASUREMENT DA_Q_KURVE_GEW "" SWORD _CNV_R_R_Umr_10_zu__37_CM_S2 1 0 -20 20 ECU_ADDRESS 0xFFF8E65E FORMAT "%3.1" /end MEASUREMENT
/begin MEASUREMENT DBG_BRMAX_ZKA "" SWORD _CNV_R_R_Umr_1_zu_1_38_CM_S2 1 0 -32768 32767 ECU_ADDRESS 0xFFF8E7EA FORMAT "%2.0" /end MEASUREMENT
/begin MEASUREMENT DBG_BRMIN_ZKA "" SWORD _CNV_R_R_Umr_1_zu_1_38_CM_S2 1 0 -32768 32767 ECU_ADDRESS 0xFFF8E7EC FORMAT "%2.0" /end MEASUREMENT
/begin MEASUREMENT DBG_DYN2_ZKA_2 "" UBYTE _CNV_R_R_Umr_1_zu_1_2_CM_S2 1 0 0 255 ECU_ADDRESS 0xFFF8EBC4 FORMAT "%2.0" /end MEASUREMENT
/begin MEASUREMENT DBG_GANG_DIFF_ZKA "" SWORD _CNV_R_R_Umr_1_zu_1_2_CM_S2 1 0 -8 8 ECU_ADDRESS 0xFFF8E7EE FORMAT "%2.0" /end MEASUREMENT
/begin MEASUREMENT DBG_GANG_KLOPT_ZKA "" UBYTE _CNV_S_9_Enum_EGANG_21_CM_S2 1 0 0 8 ECU_ADDRESS 0xFFF8EBC5 /end MEASUREMENT
/begin MEASUREMENT DBG_ILOC_ZKA "" UWORD _CNV_R_R_Umr_1_zu_1_2_CM_S2 1 0 0 8 ECU_ADDRESS 0xFFF8E7F0 FORMAT "%2.0" /end MEASUREMENT
/begin MEASUREMENT DBG_KL_GANGAKT_SCHUB_ZKA "" UWORD _CNV_R_R_Umr_1_zu_1_2_CM_S2 1 0 0 65535 ECU_ADDRESS 0xFFF8E7F2 FORMAT "%2.0" /end MEASUREMENT
/begin MEASUREMENT DBG_KL_GANGAKT_ZKA2 "" UWORD _CNV_R_R_Umr_1_zu_1_2_CM_S2 1 0 0 65535 ECU_ADDRESS 0xFFF8E7F4 FORMAT "%2.0" /end MEASUREMENT
/begin MEASUREMENT DBG_KL_HIGH_SCHUB_ZKA "" UWORD _CNV_R_R_Umr_1_zu_1_2_CM_S2 1 0 0 65535 ECU_ADDRESS 0xFFF8E7F6 FORMAT "%2.0" /end MEASUREMENT
/begin MEASUREMENT DBG_KL_HIGH_ZKA "" UWORD _CNV_R_R_Umr_1_zu_1_2_CM_S2 1 0 0 65535 ECU_ADDRESS 0xFFF8E7F8 FORMAT "%2.0" /end MEASUREMENT
/begin MEASUREMENT DBG_KL_LOW_SCHUB_ZKA "" UWORD _CNV_R_R_Umr_1_zu_1_2_CM_S2 1 0 0 65535 ECU_ADDRESS 0xFFF8E7FA FORMAT "%2.0" /end MEASUREMENT
/begin MEASUREMENT DBG_KL_LOW_ZKA2 "" UWORD _CNV_R_R_Umr_1_zu_1_2_CM_S2 1 0 0 65535 ECU_ADDRESS 0xFFF8E7FC FORMAT "%2.0" /end MEASUREMENT
/begin MEASUREMENT DBG_KRIT_ENBL1 "" UBYTE _CNV_R_R_Umr_1_zu_1_2_CM_S2 1 0 0 1 ECU_ADDRESS 0xFFF8EBC6 FORMAT "%2.0" /end MEASUREMENT
/begin MEASUREMENT DBG_KRIT_ENBL3 "" UBYTE _CNV_R_R_Umr_1_zu_1_2_CM_S2 1 0 0 1 ECU_ADDRESS 0xFFF8EBC7 FORMAT "%2.0" /end MEASUREMENT
/begin MEASUREMENT DBG_NGE_G_ZKA "" UWORD _CNV_R_R_Umr_1_zu_1_2_CM_S2 1 0 0 20000 ECU_ADDRESS 0xFFF8E7FE FORMAT "%2.0" /end MEASUREMENT
/begin MEASUREMENT DBG_POT_KL_OPT_FAKT_ZKA "" SLONG _CNV_R_R_Umr_1_zu_1_2_CM_S2 1 0 -2147483648 2147483647 ECU_ADDRESS 0xFFF8F1F4 FORMAT "%2.0" /end MEASUREMENT
/begin MEASUREMENT DBG_POT_KL_OPT_ZKA "" SLONG _CNV_R_R_Umr_1_zu_1_2_CM_S2 1 0 -2147483648 2147483647 ECU_ADDRESS 0xFFF8F1F8 FORMAT "%2.0" /end MEASUREMENT
/begin MEASUREMENT DBG_STABKRI_RICHT_ZKA "" UBYTE _CNV_R_R_Umr_1_zu_1_2_CM_S2 1 0 0 1 ECU_ADDRESS 0xFFF8EBC8 FORMAT "%2.0" /end MEASUREMENT
/begin MEASUREMENT DBG_STABKRI_VETO_ZKA "" UBYTE _CNV_R_R_Umr_1_zu_1_2_CM_S2 1 0 0 1 ECU_ADDRESS 0xFFF8EBC9 FORMAT "%2.0" /end MEASUREMENT
/begin MEASUREMENT DBG_STRAT_VAL_1_ZKA "" UWORD _CNV_R_R_Umr_1_zu_1_2_CM_S2 1 0 0 65535 ECU_ADDRESS 0xFFF8E800 FORMAT "%2.0" /end MEASUREMENT
/begin MEASUREMENT DC_SCHLEPP_BR "" SWORD _CNV_R_R_Umr_1_zu_1_2_CM_S2 1 0 -32768 32767 ECU_ADDRESS 0xFFF8E85C FORMAT "%2.0" /end MEASUREMENT
/begin MEASUREMENT DC_SCHLEPP_BRMAX "" SWORD _CNV_R_R_Umr_1_zu_1_2_CM_S2 1 0 -32768 32767 ECU_ADDRESS 0xFFF8E85E FORMAT "%2.0" /end MEASUREMENT
/begin MEASUREMENT DC_SCHLEPP_KICKFAST "" SWORD _CNV_R_R_Umr_1_zu_1_2_CM_S2 1 0 -32768 32767 ECU_ADDRESS 0xFFF8E872 FORMAT "%2.0" /end MEASUREMENT
/begin MEASUREMENT DC_SCHLEPP_KURVE "" SWORD _CNV_R_R_Umr_1_zu_1_2_CM_S2 1 0 -32768 32767 ECU_ADDRESS 0xFFF8E87A FORMAT "%2.0" /end MEASUREMENT
/begin MEASUREMENT DELTA_NT_HSSKL "" SWORD _CNV_R_R_Umr_1_zu_1_3_CM_S2 1 0 -1000 2000 ECU_ADDRESS 0xFFF8E610 FORMAT "%2.0" /end MEASUREMENT
/begin MEASUREMENT DM_ABFWS_REF_RSUBGH "" SWORD _CNV_R_R_Umr_1_zu_1_38_CM_S2 1 0 -32768 32767 ECU_ADDRESS 0xFFF8E7C0 FORMAT "%2.0" /end MEASUREMENT
/begin MEASUREMENT DM_AB_FWS "" SWORD _CNV_R_R_Umr_1_zu_1_38_CM_S2 1 0 -32768 32767 ECU_ADDRESS 0xFFF8E4C8 FORMAT "%2.0" /end MEASUREMENT
/begin MEASUREMENT DM_AB_FWSALT "" SWORD _CNV_R_R_Umr_1_zu_1_38_CM_S2 1 0 -32768 32767 ECU_ADDRESS 0xFFF8E4CA FORMAT "%2.0" /end MEASUREMENT
/begin MEASUREMENT DM_AB_FWSALTREST "" SWORD _CNV_R_R_Umr_1_zu_1_38_CM_S2 1 0 -32768 32767 ECU_ADDRESS 0xFFF8E4CC FORMAT "%2.0" /end MEASUREMENT
/begin MEASUREMENT DM_AB_FWSBGHNACHLDELTA "" SWORD _CNV_R_R_Umr_1_zu_1_38_CM_S2 1 0 -32768 32767 ECU_ADDRESS 0xFFF8E438 FORMAT "%2.0" /end MEASUREMENT
/begin MEASUREMENT DM_AB_FWSDELTA "" SWORD _CNV_R_R_Umr_1_zu_1_38_CM_S2 1 0 -32768 32767 ECU_ADDRESS 0xFFF8E4CE FORMAT "%2.0" /end MEASUREMENT
/begin MEASUREMENT DM_AB_FWSFLANKE "" UBYTE _CNV_R_R_Umr_1_zu_1_2_CM_S2 1 0 0 255 ECU_ADDRESS 0xFFF8EA49 FORMAT "%2.0" /end MEASUREMENT
/begin MEASUREMENT DM_AB_FWSFREEZE "" SWORD _CNV_R_R_Umr_1_zu_1_38_CM_S2 1 0 -32768 32767 ECU_ADDRESS 0xFFF8E4D0 FORMAT "%2.0" /end MEASUREMENT
/begin MEASUREMENT DM_AB_FWSFREEZEALT "" SWORD _CNV_R_R_Umr_1_zu_1_38_CM_S2 1 0 -32768 32767 ECU_ADDRESS 0xFFF8E4D2 FORMAT "%2.0" /end MEASUREMENT
/begin MEASUREMENT DM_AB_FWSKOR "" SWORD _CNV_R_R_Umr_1_zu_1_38_CM_S2 1 0 -32768 32767 ECU_ADDRESS 0xFFF8E4D4 FORMAT "%2.0" /end MEASUREMENT
/begin MEASUREMENT DM_AB_FWSKORALT "" SWORD _CNV_R_R_Umr_1_zu_1_38_CM_S2 1 0 -32768 32767 ECU_ADDRESS 0xFFF8E4D6 FORMAT "%2.0" /end MEASUREMENT
/begin MEASUREMENT DM_AB_FWSKORDELTA "" SWORD _CNV_R_R_Umr_1_zu_1_38_CM_S2 1 0 -32768 32767 ECU_ADDRESS 0xFFF8E4D8 FORMAT "%2.0" /end MEASUREMENT
/begin MEASUREMENT DM_AB_FWSKOR_FASTREST "" SWORD _CNV_R_R_Umr_1_zu_1_38_CM_S2 1 0 -32768 32767 ECU_ADDRESS 0xFFF8E4DA FORMAT "%2.0" /end MEASUREMENT
/begin MEASUREMENT DM_AB_FWSKOR_FILTFAST "" SWORD _CNV_R_R_Umr_1_zu_1_38_CM_S2 1 0 -32768 32767 ECU_ADDRESS 0xFFF8E4DC FORMAT "%2.0" /end MEASUREMENT
/begin MEASUREMENT DM_AB_FWSKOR_FILTFASTALT "" SWORD _CNV_R_R_Umr_1_zu_1_38_CM_S2 1 0 -32768 32767 ECU_ADDRESS 0xFFF8E4DE FORMAT "%2.0" /end MEASUREMENT
/begin MEASUREMENT DM_AB_FWSKOR_FILTFAST_BGH "" SWORD _CNV_R_R_Umr_1_zu_1_38_CM_S2 1 0 -32768 32767 ECU_ADDRESS 0xFFF8E43A FORMAT "%2.0" /end MEASUREMENT
/begin MEASUREMENT DM_AB_FWSKOR_FILTSLOW "" SWORD _CNV_R_R_Umr_1_zu_1_38_CM_S2 1 0 -32768 32767 ECU_ADDRESS 0xFFF8E4E0 FORMAT "%2.0" /end MEASUREMENT
/begin MEASUREMENT DM_AB_FWSKOR_FILTSLOWALT "" SWORD _CNV_R_R_Umr_1_zu_1_38_CM_S2 1 0 -32768 32767 ECU_ADDRESS 0xFFF8E4E2 FORMAT "%2.0" /end MEASUREMENT
/begin MEASUREMENT DM_AB_FWSKOR_FILTSLOW_BGH "" SWORD _CNV_R_R_Umr_1_zu_1_38_CM_S2 1 0 -32768 32767 ECU_ADDRESS 0xFFF8E43C FORMAT "%2.0" /end MEASUREMENT
/begin MEASUREMENT DM_AB_FWSKOR_SLOWREST "" SWORD _CNV_R_R_Umr_1_zu_1_38_CM_S2 1 0 -32768 32767 ECU_ADDRESS 0xFFF8E4E4 FORMAT "%2.0" /end MEASUREMENT
/begin MEASUREMENT DM_AB_FWSMABINGEW "" SWORD _CNV_R_R_Umr_1_zu_1_38_CM_S2 1 0 -32768 32767 ECU_ADDRESS 0xFFF8E71C FORMAT "%2.0" /end MEASUREMENT
/begin MEASUREMENT DM_AB_FWSMABOUTGEW "" SWORD _CNV_R_R_Umr_1_zu_1_38_CM_S2 1 0 -32768 32767 ECU_ADDRESS 0xFFF8E71E FORMAT "%2.0" /end MEASUREMENT
/begin MEASUREMENT DM_AB_FWSREST "" SWORD _CNV_R_R_Umr_1_zu_1_38_CM_S2 1 0 -32768 32767 ECU_ADDRESS 0xFFF8E4E6 FORMAT "%2.0" /end MEASUREMENT
/begin MEASUREMENT DM_AB_FWSROH "" SWORD _CNV_R_R_Umr_1_zu_1_38_CM_S2 1 0 -32768 32767 ECU_ADDRESS 0xFFF8E4E8 FORMAT "%2.0" /end MEASUREMENT
/begin MEASUREMENT DM_AB_FWSROHALT "" SWORD _CNV_R_R_Umr_1_zu_1_38_CM_S2 1 0 -32768 32767 ECU_ADDRESS 0xFFF8E4EA FORMAT "%2.0" /end MEASUREMENT
/begin MEASUREMENT DM_AB_FWSRSZ "" SWORD _CNV_R_R_Umr_1_zu_1_38_CM_S2 1 0 -32768 32767 ECU_ADDRESS 0xFFF8E848 FORMAT "%2.0" /end MEASUREMENT
/begin MEASUREMENT DM_AB_FWSSERPFAST "" SWORD _CNV_R_R_Umr_1_zu_1_38_CM_S2 1 0 -32768 32767 ECU_ADDRESS 0xFFF8E43E FORMAT "%2.0" /end MEASUREMENT
/begin MEASUREMENT DM_AB_FWSSERPSLOW "" SWORD _CNV_R_R_Umr_1_zu_1_38_CM_S2 1 0 -32768 32767 ECU_ADDRESS 0xFFF8E440 FORMAT "%2.0" /end MEASUREMENT
/begin MEASUREMENT DM_AB_FWS_BESCHL "" SWORD _CNV_R_R_Umr_1_zu_1_38_CM_S2 1 0 -32768 32767 ECU_ADDRESS 0xFFF8E4EC FORMAT "%2.0" /end MEASUREMENT
/begin MEASUREMENT DM_AB_FWS_FILT "" SWORD _CNV_R_R_Umr_1_zu_1_38_CM_S2 1 0 -32768 32767 ECU_ADDRESS 0xFFF8E4EE FORMAT "%2.0" /end MEASUREMENT
/begin MEASUREMENT DM_AB_FWS_FILTALT "" SWORD _CNV_R_R_Umr_1_zu_1_38_CM_S2 1 0 -32768 32767 ECU_ADDRESS 0xFFF8E4F0 FORMAT "%2.0" /end MEASUREMENT
/begin MEASUREMENT DM_AB_FWS_FILTMAB "" SWORD _CNV_R_R_Umr_1_zu_1_38_CM_S2 1 0 -32768 32767 ECU_ADDRESS 0xFFF8E720 FORMAT "%2.0" /end MEASUREMENT
/begin MEASUREMENT DM_AB_FWS_FILTREST "" SWORD _CNV_R_R_Umr_1_zu_1_38_CM_S2 1 0 -32768 32767 ECU_ADDRESS 0xFFF8E4F2 FORMAT "%2.0" /end MEASUREMENT
/begin MEASUREMENT DM_AB_FWS_FILTRESTMAB "" SWORD _CNV_R_R_Umr_1_zu_1_38_CM_S2 1 0 -32768 32767 ECU_ADDRESS 0xFFF8E722 FORMAT "%2.0" /end MEASUREMENT
/begin MEASUREMENT DM_AB_FWS_FILT_BAB "" SWORD _CNV_R_R_Umr_1_zu_1_38_CM_S2 1 0 -32768 32767 ECU_ADDRESS 0xFFF8E42A FORMAT "%2.0" /end MEASUREMENT
/begin MEASUREMENT DM_AB_FWS_STEIGUNG "" SWORD _CNV_R_R_Umr_1_zu_1_38_CM_S2 1 0 -32768 32767 ECU_ADDRESS 0xFFF8E4F4 FORMAT "%2.0" /end MEASUREMENT
/begin MEASUREMENT DM_RAD_FWS "" SWORD _CNV_R_R_Umr_1_zu_1_38_CM_S2 1 0 -32768 32767 ECU_ADDRESS 0xFFF8E4F6 FORMAT "%2.0" /end MEASUREMENT
/begin MEASUREMENT DM_RAD_FWSALT "" SWORD _CNV_R_R_Umr_1_zu_1_38_CM_S2 1 0 -32768 32767 ECU_ADDRESS 0xFFF8E4F8 FORMAT "%2.0" /end MEASUREMENT
/begin MEASUREMENT DM_RAD_FWSDELTA "" SWORD _CNV_R_R_Umr_1_zu_1_38_CM_S2 1 0 -32768 32767 ECU_ADDRESS 0xFFF8E4FA FORMAT "%2.0" /end MEASUREMENT
/begin MEASUREMENT DM_RAD_FWSGEW "" SWORD _CNV_R_R_Umr_1_zu_1_38_CM_S2 1 0 -32768 32767 ECU_ADDRESS 0xFFF8E672 FORMAT "%2.0" /end MEASUREMENT
/begin MEASUREMENT DM_RAD_FWSGEWFILT "" SWORD _CNV_R_R_Umr_1_zu_1_38_CM_S2 1 0 -32768 32767 ECU_ADDRESS 0xFFF8E674 FORMAT "%2.0" /end MEASUREMENT
/begin MEASUREMENT DM_RAD_FWSGEWFILT_ALT "" SWORD _CNV_R_R_Umr_1_zu_1_38_CM_S2 1 0 -32768 32767 ECU_ADDRESS 0xFFF8E676 FORMAT "%2.0" /end MEASUREMENT
/begin MEASUREMENT DM_RAD_FWS_FILT "" SWORD _CNV_R_R_Umr_1_zu_1_38_CM_S2 1 0 -32768 32767 ECU_ADDRESS 0xFFF8E4FC FORMAT "%2.0" /end MEASUREMENT
/begin MEASUREMENT DM_RAD_FWS_FILTREST "" SWORD _CNV_R_R_Umr_1_zu_1_38_CM_S2 1 0 -32768 32767 ECU_ADDRESS 0xFFF8E678 FORMAT "%2.0" /end MEASUREMENT
/begin MEASUREMENT DM_RAD_FWS_GRADBEGR "" SWORD _CNV_R_R_Umr_1_zu_1_38_CM_S2 1 0 -32768 32767 ECU_ADDRESS 0xFFF8E67A FORMAT "%2.0" /end MEASUREMENT
/begin MEASUREMENT DM_RAD_FWS_STEIGUNG "" SWORD _CNV_R_R_Umr_1_zu_1_38_CM_S2 1 0 -32768 32767 ECU_ADDRESS 0xFFF8E67C FORMAT "%2.0" /end MEASUREMENT
/begin MEASUREMENT DM_RAD_KOMP "" SWORD _CNV_R_R_Umr_1_zu_1_38_CM_S2 1 0 -2000 2000 ECU_ADDRESS 0xFFF8E67E FORMAT "%2.0" /end MEASUREMENT
/begin MEASUREMENT DN_K0_SOLL "" UWORD _CNV_R_R_Umr_1_zu_1_3_CM_S2 1 0 0 10000 ECU_ADDRESS 0xFFF8E356 FORMAT "%2.0" /end MEASUREMENT
/begin MEASUREMENT DN_K0_SOLL_SS "" UWORD _CNV_R_R_Umr_1_zu_1_3_CM_S2 1 0 0 10000 ECU_ADDRESS 0xFFF8E3CC FORMAT "%2.0" /end MEASUREMENT
/begin MEASUREMENT DN_MOT_FILT "" SWORD _CNV_R_R_Umr_10_zu__138_CM_S2 1 0 -2000 2000 ECU_ADDRESS 0xFFF8E5B4 FORMAT "%3.1" /end MEASUREMENT
/begin MEASUREMENT DN_MOT_FILTREST "" SWORD _CNV_R_R_Umr_10_zu__138_CM_S2 1 0 -3276.8 3276.7 ECU_ADDRESS 0xFFF8E5B6 FORMAT "%3.1" /end MEASUREMENT
/begin MEASUREMENT DN_RAD_HA "" SWORD _CNV_R_R_Umr_1_zu_1_3_CM_S2 1 0 0 20000 ECU_ADDRESS 0xFFF8E7A0 FORMAT "%2.0" /end MEASUREMENT
/begin MEASUREMENT DN_RAD_HAKURVE "" UWORD _CNV_R_R_Umr_1_zu_1_3_CM_S2 1 0 0 20000 ECU_ADDRESS 0xFFF8E686 FORMAT "%2.0" /end MEASUREMENT
/begin MEASUREMENT DN_RAD_HLVA "" SWORD _CNV_R_R_Umr_1_zu_1_3_CM_S2 1 0 0 20000 ECU_ADDRESS 0xFFF8E7A2 FORMAT "%2.0" /end MEASUREMENT
/begin MEASUREMENT DN_RAD_HRVA "" SWORD _CNV_R_R_Umr_1_zu_1_3_CM_S2 1 0 0 20000 ECU_ADDRESS 0xFFF8E7A4 FORMAT "%2.0" /end MEASUREMENT
/begin MEASUREMENT DN_RAD_VA "" SWORD _CNV_R_R_Umr_1_zu_1_3_CM_S2 1 0 0 20000 ECU_ADDRESS 0xFFF8E7A6 FORMAT "%2.0" /end MEASUREMENT
/begin MEASUREMENT DN_RAD_VLHA "" SWORD _CNV_R_R_Umr_1_zu_1_3_CM_S2 1 0 0 20000 ECU_ADDRESS 0xFFF8E7A8 FORMAT "%2.0" /end MEASUREMENT
/begin MEASUREMENT DN_RAD_VRHA "" SWORD _CNV_R_R_Umr_1_zu_1_3_CM_S2 1 0 0 20000 ECU_ADDRESS 0xFFF8E7AA FORMAT "%2.0" /end MEASUREMENT
/begin MEASUREMENT DN_WA_IST_DYNDZM "" SLONG _CNV_R_R_Umr_10_zu__133_CM_S2 1 0 -20000 20000 ECU_ADDRESS 0xFFF866E0 FORMAT "%2.0" /end MEASUREMENT
/begin MEASUREMENT DN_WA_IST_DYNDZMFILT "" SWORD _CNV_R_R_Umr_1_zu_1_3_CM_S2 1 0 -32768 32767 ECU_ADDRESS 0xFFF8E4A2 FORMAT "%2.0" /end MEASUREMENT
/begin MEASUREMENT DN_WA_IST_DYNDZMREST "" SWORD _CNV_R_R_Umr_1_zu_1_3_CM_S2 1 0 -32768 32767 ECU_ADDRESS 0xFFF8E4A4 FORMAT "%2.0" /end MEASUREMENT
/begin MEASUREMENT DN_WA_IST_NAB_DYNDZM "" SWORD _CNV_R_R_Umr_1_zu_1_3_CM_S2 1 0 -32768 32767 ECU_ADDRESS 0xFFF8E4A6 FORMAT "%2.0" /end MEASUREMENT
/begin MEASUREMENT DW_DKKD_REST_VOLLGAS "" UWORD _CNV_R_R_Umr_1_zu_1_266_CM_S2 1 0 0 100 ECU_ADDRESS 0xFFF8E478 FORMAT "%2.0" /end MEASUREMENT
/begin MEASUREMENT DebounceDrvReq.DrvReqPRND_Filt "Driver Request after Debouncing" UBYTE SBW_STANDARD_S1_S3 1 100 0 8 ECU_ADDRESS 0xFFF8988A DISPLAY_IDENTIFIER DrvReqPRND_Filt.DebounceDrvReq /end MEASUREMENT
/begin MEASUREMENT DebounceDrvReq.f_LastPosRD "Last Position was R or D" UBYTE SBW_STANDARD_S1_S3 1 100 0 1 BIT_MASK 0x1 ECU_ADDRESS 0xFFF8988D DISPLAY_IDENTIFIER f_LastPosRD.DebounceDrvReq /end MEASUREMENT
/begin MEASUREMENT DebounceDrvReq.f_NoDebounceNA2N "error flag to prevent debounce of NA -> N" UBYTE SBW_STANDARD_S1_S3 1 100 0 1 BIT_MASK 0x1 ECU_ADDRESS 0xFFF8988F DISPLAY_IDENTIFIER f_NoDebounceNA2N.DebounceDrvReq /end MEASUREMENT
/begin MEASUREMENT DebounceDrvReq.f_NoDebounceRD2N "error flag to prevent store of D/R -> N" UBYTE SBW_STANDARD_S1_S3 1 100 0 1 BIT_MASK 0x1 ECU_ADDRESS 0xFFF8988E DISPLAY_IDENTIFIER f_NoDebounceRD2N.DebounceDrvReq /end MEASUREMENT
/begin MEASUREMENT DebounceDrvReq.f_StartOrResetOfDebounceOccured "if debounce started this flag prevents from being stopped in the same cycle" UBYTE SBW_STANDARD_S1_S3 1 100 0 1 BIT_MASK 0x1 ECU_ADDRESS 0xFFF8988C DISPLAY_IDENTIFIER f_StartOrResetOfDebounceOccured.DebounceDrvReq /end MEASUREMENT
/begin MEASUREMENT DebounceDrvReq.st_Debounce "0:NoDebounce 1:DebounceNA2N 2:DebounceRD2N 3:DebouncePN2R 4:DebounceN2R 5:DebounceP2R 6:DebounceP2N" UBYTE SBW_STANDARD_S1_S3 1 100 0 6 ECU_ADDRESS 0xFFF8988B DISPLAY_IDENTIFIER st_Debounce.DebounceDrvReq /end MEASUREMENT
/begin MEASUREMENT DebounceDrvReq.tmr_DebounceDrvReq.f_IsExpired "test_timer" UBYTE SBW_STANDARD_S1_S3 1 100 0 255 ECU_ADDRESS 0xFFF89889 DISPLAY_IDENTIFIER f_IsExpired.tmr_DebounceDrvReq.DebounceDrvReq /end MEASUREMENT
/begin MEASUREMENT DebounceDrvReq.tmr_DebounceDrvReq.time "test_timer" UBYTE SBW_TIMER_10MS_S1_S3 1 100 0 2550 ECU_ADDRESS 0xFFF89888 DISPLAY_IDENTIFIER time.tmr_DebounceDrvReq.DebounceDrvReq /end MEASUREMENT
/begin MEASUREMENT DiagPos.PosPRND "Final Position by sequential computation" UBYTE SBW_STANDARD_S1_S3 1 100 0 8 ECU_ADDRESS 0xFFF898B8 DISPLAY_IDENTIFIER PosPRND.DiagPos /end MEASUREMENT
/begin MEASUREMENT DiagPos.PosPRND_ "Complement of Position PosPRND" UBYTE SBW_STANDARD_S1_S3 1 100 247 255 ECU_ADDRESS 0xFFF898B9 DISPLAY_IDENTIFIER PosPRND_.DiagPos /end MEASUREMENT
/begin MEASUREMENT DiagPos.PosPRND_Old "Position from Diagnosis Position from prior cycle" UBYTE SBW_STANDARD_S1_S3 1 100 0 8 ECU_ADDRESS 0xFFF898BA DISPLAY_IDENTIFIER PosPRND_Old.DiagPos /end MEASUREMENT
/begin MEASUREMENT DiagPos.PosStatus "Status of position of SBW/SBL" UBYTE SBW_STANDARD_S1_S3 1 100 0 2 ECU_ADDRESS 0xFFF898BC DISPLAY_IDENTIFIER PosStatus.DiagPos /end MEASUREMENT
/begin MEASUREMENT DiagPos.f_CC_DiagPosInWrongDrvDir "Flag for activation of cc message ID_DiagPosInWrongDrvDir" UBYTE SBW_STANDARD_S1_S3 1 100 0 1 BIT_MASK 0x1 ECU_ADDRESS 0xFFF898BE DISPLAY_IDENTIFIER f_CC_DiagPosInWrongDrvDir.DiagPos /end MEASUREMENT
/begin MEASUREMENT DiagPos.f_DrvAssistPosModeErr_Old "last-cycle value of FAS- pos-/mode-sig.status error-flag" UBYTE SBW_STANDARD_S1_S3 1 100 0 1 BIT_MASK 0x1 ECU_ADDRESS 0xFFF898BD DISPLAY_IDENTIFIER f_DrvAssistPosModeErr_Old.DiagPos /end MEASUREMENT
/begin MEASUREMENT DiagPos.st_DiagPosEvent "Indicates which diag pos event has changed autoposition" UBYTE SBW_STANDARD_S1_S3 1 100 0 255 ECU_ADDRESS 0xFFF898BB DISPLAY_IDENTIFIER st_DiagPosEvent.DiagPos /end MEASUREMENT
/begin MEASUREMENT DiagPos.st_GbxTempReqP "State for Diag-P due to GB temperature" UBYTE SBW_STANDARD_S1_S3 1 100 0 255 ECU_ADDRESS 0xFFF898BF DISPLAY_IDENTIFIER st_GbxTempReqP.DiagPos /end MEASUREMENT
/begin MEASUREMENT DiagPos.tmr_DelayGbxTempReqP.f_IsExpired "test_timer" UBYTE SBW_STANDARD_S1_S3 1 100 0 255 ECU_ADDRESS 0xFFF898B4 DISPLAY_IDENTIFIER f_IsExpired.tmr_DelayGbxTempReqP.DiagPos /end MEASUREMENT
/begin MEASUREMENT DiagPos.tmr_DelayGbxTempReqP.time "test_timer" ULONG SBW_TIMER_10MS_S1_S3 1 100 0 42949672950 ECU_ADDRESS 0xFFF898B0 DISPLAY_IDENTIFIER time.tmr_DelayGbxTempReqP.DiagPos /end MEASUREMENT
/begin MEASUREMENT Dispatcher.CtlDispGear "displayed gear on kombi" UBYTE SBW_STANDARD_S1_S3 1 100 0 255 ECU_ADDRESS 0xFFF89840 DISPLAY_IDENTIFIER CtlDispGear.Dispatcher /end MEASUREMENT
/begin MEASUREMENT Dispatcher.CtlDispMode "Displayed mode for SBW/SBL" UBYTE SBW_STANDARD_S1_S3 1 100 0 15 ECU_ADDRESS 0xFFF89841 DISPLAY_IDENTIFIER CtlDispMode.Dispatcher /end MEASUREMENT
/begin MEASUREMENT Dispatcher.CtlDispPos "displayed pos on kombi" UBYTE SBW_STANDARD_S1_S3 1 100 0 15 ECU_ADDRESS 0xFFF89842 DISPLAY_IDENTIFIER CtlDispPos.Dispatcher /end MEASUREMENT
/begin MEASUREMENT Dispatcher.CtlDispPos_ "Complement of displayed position for SBW/SBL" UBYTE SBW_STANDARD_S1_S3 1 100 0 255 ECU_ADDRESS 0xFFF89843 DISPLAY_IDENTIFIER CtlDispPos_.Dispatcher /end MEASUREMENT
/begin MEASUREMENT DisplayMonitoring.L2_DisplayPos.Complement "Variant independent Dispay Position" UBYTE SBW_STANDARD_S1_S3 1 100 0 15 ECU_ADDRESS 0xFFF98123 DISPLAY_IDENTIFIER Complement.L2_DisplayPos.DisplayMonitoring /end MEASUREMENT
/begin MEASUREMENT DisplayMonitoring.L2_DisplayPos.Value "Variant independent Dispay Position" UBYTE SBW_STANDARD_S1_S3 1 100 0 15 ECU_ADDRESS 0xFFF98122 DISPLAY_IDENTIFIER Value.L2_DisplayPos.DisplayMonitoring /end MEASUREMENT
/begin MEASUREMENT DisplayMonitoring.L2_DisplayPosFlash.Complement "Variant independent flashing Display Position" UBYTE SBW_STANDARD_S1_S3 1 100 0 15 ECU_ADDRESS 0xFFF98125 DISPLAY_IDENTIFIER Complement.L2_DisplayPosFlash.DisplayMonitoring /end MEASUREMENT
/begin MEASUREMENT DisplayMonitoring.L2_DisplayPosFlash.Value "Variant independent flashing Display Position" UBYTE SBW_STANDARD_S1_S3 1 100 0 15 ECU_ADDRESS 0xFFF98124 DISPLAY_IDENTIFIER Value.L2_DisplayPosFlash.DisplayMonitoring /end MEASUREMENT
/begin MEASUREMENT DisplayMonitoring.L2_st_SetDispPosDark.Complement "Level2-flag for setting displayed position dark in kombi" UBYTE SBW_STANDARD_S1_S3 1 100 0 15 ECU_ADDRESS 0xFFF98121 DISPLAY_IDENTIFIER Complement.L2_st_SetDispPosDark.DisplayMonitoring /end MEASUREMENT
/begin MEASUREMENT DisplayMonitoring.L2_st_SetDispPosDark.Value "Level2-flag for setting displayed position dark in kombi" UBYTE SBW_STANDARD_S1_S3 1 100 0 15 ECU_ADDRESS 0xFFF98120 DISPLAY_IDENTIFIER Value.L2_st_SetDispPosDark.DisplayMonitoring /end MEASUREMENT
/begin MEASUREMENT DisplayMonitoring.L2_tmr_BackFilterNPorRDinsteadDR.f_IsExpired.Complement "test_timer" UBYTE SBW_STANDARD_S1_S3 1 100 0 255 ECU_ADDRESS 0xFFF98113 DISPLAY_IDENTIFIER Complement.f_IsExpired.L2_tmr_BackFilterNPorRDinsteadDR.DisplayMonitoring /end MEASUREMENT
/begin MEASUREMENT DisplayMonitoring.L2_tmr_BackFilterNPorRDinsteadDR.f_IsExpired.Value "test_timer" UBYTE SBW_STANDARD_S1_S3 1 100 0 255 ECU_ADDRESS 0xFFF98112 DISPLAY_IDENTIFIER Value.f_IsExpired.L2_tmr_BackFilterNPorRDinsteadDR.DisplayMonitoring /end MEASUREMENT
/begin MEASUREMENT DisplayMonitoring.L2_tmr_BackFilterNPorRDinsteadDR.time.Complement "test_timer" UBYTE SBW_STANDARD_S1_S3 1 100 0 255 ECU_ADDRESS 0xFFF98111 DISPLAY_IDENTIFIER Complement.time.L2_tmr_BackFilterNPorRDinsteadDR.DisplayMonitoring /end MEASUREMENT
/begin MEASUREMENT DisplayMonitoring.L2_tmr_BackFilterNPorRDinsteadDR.time.Value "test_timer" UBYTE SBW_TIMER_10MS_S1_S3 1 100 0 2550 ECU_ADDRESS 0xFFF98110 DISPLAY_IDENTIFIER Value.time.L2_tmr_BackFilterNPorRDinsteadDR.DisplayMonitoring /end MEASUREMENT
/begin MEASUREMENT DisplayMonitoring.L2_tmr_BackFilterPosPinPosN.f_IsExpired.Complement "test_timer" UBYTE SBW_STANDARD_S1_S3 1 100 0 255 ECU_ADDRESS 0xFFF9811B DISPLAY_IDENTIFIER Complement.f_IsExpired.L2_tmr_BackFilterPosPinPosN.DisplayMonitoring /end MEASUREMENT
/begin MEASUREMENT DisplayMonitoring.L2_tmr_BackFilterPosPinPosN.f_IsExpired.Value "test_timer" UBYTE SBW_STANDARD_S1_S3 1 100 0 255 ECU_ADDRESS 0xFFF9811A DISPLAY_IDENTIFIER Value.f_IsExpired.L2_tmr_BackFilterPosPinPosN.DisplayMonitoring /end MEASUREMENT
/begin MEASUREMENT DisplayMonitoring.L2_tmr_BackFilterPosPinPosN.time.Complement "test_timer" UBYTE SBW_STANDARD_S1_S3 1 100 0 255 ECU_ADDRESS 0xFFF98119 DISPLAY_IDENTIFIER Complement.time.L2_tmr_BackFilterPosPinPosN.DisplayMonitoring /end MEASUREMENT
/begin MEASUREMENT DisplayMonitoring.L2_tmr_BackFilterPosPinPosN.time.Value "test_timer" UBYTE SBW_TIMER_10MS_S1_S3 1 100 0 2550 ECU_ADDRESS 0xFFF98118 DISPLAY_IDENTIFIER Value.time.L2_tmr_BackFilterPosPinPosN.DisplayMonitoring /end MEASUREMENT
/begin MEASUREMENT DisplayMonitoring.L2_tmr_FilterNPorRDinsteadDR.f_IsExpired.Complement "test_timer" UBYTE SBW_STANDARD_S1_S3 1 100 0 255 ECU_ADDRESS 0xFFF9810F DISPLAY_IDENTIFIER Complement.f_IsExpired.L2_tmr_FilterNPorRDinsteadDR.DisplayMonitoring /end MEASUREMENT
/begin MEASUREMENT DisplayMonitoring.L2_tmr_FilterNPorRDinsteadDR.f_IsExpired.Value "test_timer" UBYTE SBW_STANDARD_S1_S3 1 100 0 255 ECU_ADDRESS 0xFFF9810E DISPLAY_IDENTIFIER Value.f_IsExpired.L2_tmr_FilterNPorRDinsteadDR.DisplayMonitoring /end MEASUREMENT
/begin MEASUREMENT DisplayMonitoring.L2_tmr_FilterNPorRDinsteadDR.time.Complement "test_timer" UBYTE SBW_STANDARD_S1_S3 1 100 0 255 ECU_ADDRESS 0xFFF9810D DISPLAY_IDENTIFIER Complement.time.L2_tmr_FilterNPorRDinsteadDR.DisplayMonitoring /end MEASUREMENT
/begin MEASUREMENT DisplayMonitoring.L2_tmr_FilterNPorRDinsteadDR.time.Value "test_timer" UBYTE SBW_TIMER_10MS_S1_S3 1 100 0 2550 ECU_ADDRESS 0xFFF9810C DISPLAY_IDENTIFIER Value.time.L2_tmr_FilterNPorRDinsteadDR.DisplayMonitoring /end MEASUREMENT
/begin MEASUREMENT DisplayMonitoring.L2_tmr_FilterPosPinPosN.f_IsExpired.Complement "test_timer" UBYTE SBW_STANDARD_S1_S3 1 100 0 255 ECU_ADDRESS 0xFFF98117 DISPLAY_IDENTIFIER Complement.f_IsExpired.L2_tmr_FilterPosPinPosN.DisplayMonitoring /end MEASUREMENT
/begin MEASUREMENT DisplayMonitoring.L2_tmr_FilterPosPinPosN.f_IsExpired.Value "test_timer" UBYTE SBW_STANDARD_S1_S3 1 100 0 255 ECU_ADDRESS 0xFFF98116 DISPLAY_IDENTIFIER Value.f_IsExpired.L2_tmr_FilterPosPinPosN.DisplayMonitoring /end MEASUREMENT
/begin MEASUREMENT DisplayMonitoring.L2_tmr_FilterPosPinPosN.time.Complement "test_timer" UBYTE SBW_STANDARD_S1_S3 1 100 0 255 ECU_ADDRESS 0xFFF98115 DISPLAY_IDENTIFIER Complement.time.L2_tmr_FilterPosPinPosN.DisplayMonitoring /end MEASUREMENT
/begin MEASUREMENT DisplayMonitoring.L2_tmr_FilterPosPinPosN.time.Value "test_timer" UBYTE SBW_TIMER_10MS_S1_S3 1 100 0 2550 ECU_ADDRESS 0xFFF98114 DISPLAY_IDENTIFIER Value.time.L2_tmr_FilterPosPinPosN.DisplayMonitoring /end MEASUREMENT
/begin MEASUREMENT DisplayMonitoring.L2_tmr_FlashN.f_IsExpired.Complement "test_timer" UBYTE SBW_STANDARD_S1_S3 1 100 0 255 ECU_ADDRESS 0xFFF9811F DISPLAY_IDENTIFIER Complement.f_IsExpired.L2_tmr_FlashN.DisplayMonitoring /end MEASUREMENT
/begin MEASUREMENT DisplayMonitoring.L2_tmr_FlashN.f_IsExpired.Value "test_timer" UBYTE SBW_STANDARD_S1_S3 1 100 0 255 ECU_ADDRESS 0xFFF9811E DISPLAY_IDENTIFIER Value.f_IsExpired.L2_tmr_FlashN.DisplayMonitoring /end MEASUREMENT
/begin MEASUREMENT DisplayMonitoring.L2_tmr_FlashN.time.Complement "test_timer" UBYTE SBW_STANDARD_S1_S3 1 100 0 255 ECU_ADDRESS 0xFFF9811D DISPLAY_IDENTIFIER Complement.time.L2_tmr_FlashN.DisplayMonitoring /end MEASUREMENT
/begin MEASUREMENT DisplayMonitoring.L2_tmr_FlashN.time.Value "test_timer" UBYTE SBW_TIMER_10MS_S1_S3 1 100 0 2550 ECU_ADDRESS 0xFFF9811C DISPLAY_IDENTIFIER Value.time.L2_tmr_FlashN.DisplayMonitoring /end MEASUREMENT
/begin MEASUREMENT DrvPresenceDetector.f_CC_DrvLeavesCar "Flag for CC message Driver leaves Car" UBYTE SBW_STANDARD_S1_S3 1 100 0 1 BIT_MASK 0x1 ECU_ADDRESS 0xFFF897AC DISPLAY_IDENTIFIER f_CC_DrvLeavesCar.DrvPresenceDetector /end MEASUREMENT
/begin MEASUREMENT DrvPresenceDetector.f_CC_DrvLeavesCarBeltLocked "Flag: Driver leaves car with seat belt locked" UBYTE SBW_STANDARD_S1_S3 1 100 0 1 BIT_MASK 0x1 ECU_ADDRESS 0xFFF897B0 DISPLAY_IDENTIFIER f_CC_DrvLeavesCarBeltLocked.DrvPresenceDetector /end MEASUREMENT
/begin MEASUREMENT DrvPresenceDetector.f_DrvLeavesCar "Indicates that the driver leaves the car" UBYTE SBW_STANDARD_S1_S3 1 100 0 1 BIT_MASK 0x1 ECU_ADDRESS 0xFFF897AF DISPLAY_IDENTIFIER f_DrvLeavesCar.DrvPresenceDetector /end MEASUREMENT
/begin MEASUREMENT DrvPresenceDetector.f_DrvLeavesCarBrakeAccPed "Flag for combined Door Seatbelt status" UBYTE SBW_STANDARD_S1_S3 1 100 0 1 BIT_MASK 0x1 ECU_ADDRESS 0xFFF897AE DISPLAY_IDENTIFIER f_DrvLeavesCarBrakeAccPed.DrvPresenceDetector /end MEASUREMENT
/begin MEASUREMENT DrvPresenceDetector.f_DrvLeavesCarDoorSeatb "Flag for combined Door Seatbelt status" UBYTE SBW_STANDARD_S1_S3 1 100 0 1 BIT_MASK 0x1 ECU_ADDRESS 0xFFF897AD DISPLAY_IDENTIFIER f_DrvLeavesCarDoorSeatb.DrvPresenceDetector /end MEASUREMENT
/begin MEASUREMENT DrvPresenceDetector.f_DrvLeavesCarInN "Flag: debounced flag info for driver leaves car in pos. N" UBYTE SBW_STANDARD_S1_S3 1 100 0 1 BIT_MASK 0x1 ECU_ADDRESS 0xFFF897B1 DISPLAY_IDENTIFIER f_DrvLeavesCarInN.DrvPresenceDetector /end MEASUREMENT
/begin MEASUREMENT DrvPresenceDetector.st_DriverPresence "Driver presence status" UBYTE SBW_STANDARD_S1_S3 1 100 0 2 ECU_ADDRESS 0xFFF897B3 DISPLAY_IDENTIFIER st_DriverPresence.DrvPresenceDetector /end MEASUREMENT
/begin MEASUREMENT DrvPresenceDetector.st_tmr_DrvLeavesCarInN "state of tmr_DrvLeavesCarInN - 0x10=initial - 0x02=set_startvalue - 0x01=running - 0x00=elapsed" UBYTE SBW_STANDARD_S1_S3 1 100 0 16 ECU_ADDRESS 0xFFF897B2 DISPLAY_IDENTIFIER st_tmr_DrvLeavesCarInN.DrvPresenceDetector /end MEASUREMENT
/begin MEASUREMENT DrvPresenceDetector.tmr_DrvLeavesCarInN.f_IsExpired "test_timer" UBYTE SBW_STANDARD_S1_S3 1 100 0 255 ECU_ADDRESS 0xFFF897AA DISPLAY_IDENTIFIER f_IsExpired.tmr_DrvLeavesCarInN.DrvPresenceDetector /end MEASUREMENT
/begin MEASUREMENT DrvPresenceDetector.tmr_DrvLeavesCarInN.time "test_timer" UWORD SBW_TIMER_10MS_S1_S3 1 100 0 655350 ECU_ADDRESS 0xFFF897A8 DISPLAY_IDENTIFIER time.tmr_DrvLeavesCarInN.DrvPresenceDetector /end MEASUREMENT
/begin MEASUREMENT DrvReq2Pos.PosDrvReq "Position calculated from Driver Request" UBYTE SBW_STANDARD_S1_S3 1 100 0 8 ECU_ADDRESS 0xFFF8D699 DISPLAY_IDENTIFIER PosDrvReq.DrvReq2Pos /end MEASUREMENT
/begin MEASUREMENT DrvReq2Pos.f_CC_Spd2HighP "Flag for CC-Message: Position P only in standstill" UBYTE SBW_STANDARD_S1_S3 1 100 0 1 BIT_MASK 0x1 ECU_ADDRESS 0xFFF8D698 DISPLAY_IDENTIFIER f_CC_Spd2HighP.DrvReq2Pos /end MEASUREMENT
/begin CHARACTERISTIC E12 "" CURVE 0x1E000E _REC_A1CUR_1_u2_u2_S2 15000 _CNV_R_R_Umr_1_zu_1_3_CM_S2 0 15000
 /begin AXIS_DESCR COM_AXIS W_DKKD _CNV_R_R_Umr_10_zu__9_CM_S2 15 0 120 DEPOSIT ABSOLUTE FORMAT "%3.1" AXIS_PTS_REF SSTSKL_E /end AXIS_DESCR
 FORMAT "%2.0" /end CHARACTERISTIC
/begin CHARACTERISTIC E21 "" CURVE 0x1E002C _REC_A1CUR_1_u2_u2_S2 15000 _CNV_R_R_Umr_1_zu_1_3_CM_S2 0 15000
 /begin AXIS_DESCR COM_AXIS W_DKKD _CNV_R_R_Umr_10_zu__9_CM_S2 15 0 120 DEPOSIT ABSOLUTE FORMAT "%3.1" AXIS_PTS_REF SSTSKL_E /end AXIS_DESCR
 FORMAT "%2.0" /end CHARACTERISTIC
/begin CHARACTERISTIC E23 "" CURVE 0x1E004A _REC_A1CUR_1_u2_u2_S2 15000 _CNV_R_R_Umr_1_zu_1_3_CM_S2 0 15000
 /begin AXIS_DESCR COM_AXIS W_DKKD _CNV_R_R_Umr_10_zu__9_CM_S2 15 0 120 DEPOSIT ABSOLUTE FORMAT "%3.1" AXIS_PTS_REF SSTSKL_E /end AXIS_DESCR
 FORMAT "%2.0" /end CHARACTERISTIC
/begin CHARACTERISTIC E32 "" CURVE 0x1E0068 _REC_A1CUR_1_u2_u2_S2 15000 _CNV_R_R_Umr_1_zu_1_3_CM_S2 0 15000
 /begin AXIS_DESCR COM_AXIS W_DKKD _CNV_R_R_Umr_10_zu__9_CM_S2 15 0 120 DEPOSIT ABSOLUTE FORMAT "%3.1" AXIS_PTS_REF SSTSKL_E /end AXIS_DESCR
 FORMAT "%2.0" /end CHARACTERISTIC
/begin CHARACTERISTIC E34 "" CURVE 0x1E0086 _REC_A1CUR_1_u2_u2_S2 15000 _CNV_R_R_Umr_1_zu_1_3_CM_S2 0 15000
 /begin AXIS_DESCR COM_AXIS W_DKKD _CNV_R_R_Umr_10_zu__9_CM_S2 15 0 120 DEPOSIT ABSOLUTE FORMAT "%3.1" AXIS_PTS_REF SSTSKL_E /end AXIS_DESCR
 FORMAT "%2.0" /end CHARACTERISTIC
/begin CHARACTERISTIC E43 "" CURVE 0x1E00A4 _REC_A1CUR_1_u2_u2_S2 15000 _CNV_R_R_Umr_1_zu_1_3_CM_S2 0 15000
 /begin AXIS_DESCR COM_AXIS W_DKKD _CNV_R_R_Umr_10_zu__9_CM_S2 15 0 120 DEPOSIT ABSOLUTE FORMAT "%3.1" AXIS_PTS_REF SSTSKL_E /end AXIS_DESCR
 FORMAT "%2.0" /end CHARACTERISTIC
/begin CHARACTERISTIC E45 "" CURVE 0x1E00C2 _REC_A1CUR_1_u2_u2_S2 15000 _CNV_R_R_Umr_1_zu_1_3_CM_S2 0 15000
 /begin AXIS_DESCR COM_AXIS W_DKKD _CNV_R_R_Umr_10_zu__9_CM_S2 15 0 120 DEPOSIT ABSOLUTE FORMAT "%3.1" AXIS_PTS_REF SSTSKL_E /end AXIS_DESCR
 FORMAT "%2.0" /end CHARACTERISTIC
/begin CHARACTERISTIC E54 "" CURVE 0x1E00E0 _REC_A1CUR_1_u2_u2_S2 15000 _CNV_R_R_Umr_1_zu_1_3_CM_S2 0 15000
 /begin AXIS_DESCR COM_AXIS W_DKKD _CNV_R_R_Umr_10_zu__9_CM_S2 15 0 120 DEPOSIT ABSOLUTE FORMAT "%3.1" AXIS_PTS_REF SSTSKL_E /end AXIS_DESCR
 FORMAT "%2.0" /end CHARACTERISTIC
/begin CHARACTERISTIC E56 "" CURVE 0x1E00FE _REC_A1CUR_1_u2_u2_S2 15000 _CNV_R_R_Umr_1_zu_1_3_CM_S2 0 15000
 /begin AXIS_DESCR COM_AXIS W_DKKD _CNV_R_R_Umr_10_zu__9_CM_S2 15 0 120 DEPOSIT ABSOLUTE FORMAT "%3.1" AXIS_PTS_REF SSTSKL_E /end AXIS_DESCR
 FORMAT "%2.0" /end CHARACTERISTIC
/begin CHARACTERISTIC E65 "" CURVE 0x1E011C _REC_A1CUR_1_u2_u2_S2 15000 _CNV_R_R_Umr_1_zu_1_3_CM_S2 0 15000
 /begin AXIS_DESCR COM_AXIS W_DKKD _CNV_R_R_Umr_10_zu__9_CM_S2 15 0 120 DEPOSIT ABSOLUTE FORMAT "%3.1" AXIS_PTS_REF SSTSKL_E /end AXIS_DESCR
 FORMAT "%2.0" /end CHARACTERISTIC
/begin CHARACTERISTIC E67 "" CURVE 0x1E13FA _REC_A1CUR_1_u2_u2_S2 15000 _CNV_R_R_Umr_1_zu_1_3_CM_S2 0 15000
 /begin AXIS_DESCR COM_AXIS W_DKKD _CNV_R_R_Umr_10_zu__9_CM_S2 15 0 120 DEPOSIT ABSOLUTE FORMAT "%3.1" AXIS_PTS_REF SSTSKL_E /end AXIS_DESCR
 FORMAT "%2.0" /end CHARACTERISTIC
/begin CHARACTERISTIC E76 "" CURVE 0x1E1418 _REC_A1CUR_1_u2_u2_S2 15000 _CNV_R_R_Umr_1_zu_1_3_CM_S2 0 15000
 /begin AXIS_DESCR COM_AXIS W_DKKD _CNV_R_R_Umr_10_zu__9_CM_S2 15 0 120 DEPOSIT ABSOLUTE FORMAT "%3.1" AXIS_PTS_REF SSTSKL_E /end AXIS_DESCR
 FORMAT "%2.0" /end CHARACTERISTIC
/begin CHARACTERISTIC E78 "" CURVE 0x1E18E6 _REC_A1CUR_1_u2_u2_S2 15000 _CNV_R_R_Umr_1_zu_1_3_CM_S2 0 15000
 /begin AXIS_DESCR COM_AXIS W_DKKD _CNV_R_R_Umr_10_zu__9_CM_S2 15 0 120 DEPOSIT ABSOLUTE FORMAT "%3.1" AXIS_PTS_REF SSTSKL_E /end AXIS_DESCR
 FORMAT "%2.0" /end CHARACTERISTIC
/begin CHARACTERISTIC E87 "" CURVE 0x1E1904 _REC_A1CUR_1_u2_u2_S2 15000 _CNV_R_R_Umr_1_zu_1_3_CM_S2 0 15000
 /begin AXIS_DESCR COM_AXIS W_DKKD _CNV_R_R_Umr_10_zu__9_CM_S2 15 0 120 DEPOSIT ABSOLUTE FORMAT "%3.1" AXIS_PTS_REF SSTSKL_E /end AXIS_DESCR
 FORMAT "%2.0" /end CHARACTERISTIC
/begin CHARACTERISTIC ECO12 "" CURVE 0x1E013A _REC_A1CUR_1_u2_u2_S2 15000 _CNV_R_R_Umr_1_zu_1_3_CM_S2 0 15000
 /begin AXIS_DESCR COM_AXIS W_DKKD _CNV_R_R_Umr_10_zu__9_CM_S2 15 0 120 DEPOSIT ABSOLUTE FORMAT "%3.1" AXIS_PTS_REF SSTSKL_ECO /end AXIS_DESCR
 FORMAT "%2.0" /end CHARACTERISTIC
/begin CHARACTERISTIC ECO21 "" CURVE 0x1E0158 _REC_A1CUR_1_u2_u2_S2 15000 _CNV_R_R_Umr_1_zu_1_3_CM_S2 0 15000
 /begin AXIS_DESCR COM_AXIS W_DKKD _CNV_R_R_Umr_10_zu__9_CM_S2 15 0 120 DEPOSIT ABSOLUTE FORMAT "%3.1" AXIS_PTS_REF SSTSKL_ECO /end AXIS_DESCR
 FORMAT "%2.0" /end CHARACTERISTIC
/begin CHARACTERISTIC ECO23 "" CURVE 0x1E0176 _REC_A1CUR_1_u2_u2_S2 15000 _CNV_R_R_Umr_1_zu_1_3_CM_S2 0 15000
 /begin AXIS_DESCR COM_AXIS W_DKKD _CNV_R_R_Umr_10_zu__9_CM_S2 15 0 120 DEPOSIT ABSOLUTE FORMAT "%3.1" AXIS_PTS_REF SSTSKL_ECO /end AXIS_DESCR
 FORMAT "%2.0" /end CHARACTERISTIC
/begin CHARACTERISTIC ECO32 "" CURVE 0x1E0194 _REC_A1CUR_1_u2_u2_S2 15000 _CNV_R_R_Umr_1_zu_1_3_CM_S2 0 15000
 /begin AXIS_DESCR COM_AXIS W_DKKD _CNV_R_R_Umr_10_zu__9_CM_S2 15 0 120 DEPOSIT ABSOLUTE FORMAT "%3.1" AXIS_PTS_REF SSTSKL_ECO /end AXIS_DESCR
 FORMAT "%2.0" /end CHARACTERISTIC
/begin CHARACTERISTIC ECO34 "" CURVE 0x1E01B2 _REC_A1CUR_1_u2_u2_S2 15000 _CNV_R_R_Umr_1_zu_1_3_CM_S2 0 15000
 /begin AXIS_DESCR COM_AXIS W_DKKD _CNV_R_R_Umr_10_zu__9_CM_S2 15 0 120 DEPOSIT ABSOLUTE FORMAT "%3.1" AXIS_PTS_REF SSTSKL_ECO /end AXIS_DESCR
 FORMAT "%2.0" /end CHARACTERISTIC
/begin CHARACTERISTIC ECO43 "" CURVE 0x1E01D0 _REC_A1CUR_1_u2_u2_S2 15000 _CNV_R_R_Umr_1_zu_1_3_CM_S2 0 15000
 /begin AXIS_DESCR COM_AXIS W_DKKD _CNV_R_R_Umr_10_zu__9_CM_S2 15 0 120 DEPOSIT ABSOLUTE FORMAT "%3.1" AXIS_PTS_REF SSTSKL_ECO /end AXIS_DESCR
 FORMAT "%2.0" /end CHARACTERISTIC
/begin CHARACTERISTIC ECO45 "" CURVE 0x1E01EE _REC_A1CUR_1_u2_u2_S2 15000 _CNV_R_R_Umr_1_zu_1_3_CM_S2 0 15000
 /begin AXIS_DESCR COM_AXIS W_DKKD _CNV_R_R_Umr_10_zu__9_CM_S2 15 0 120 DEPOSIT ABSOLUTE FORMAT "%3.1" AXIS_PTS_REF SSTSKL_ECO /end AXIS_DESCR
 FORMAT "%2.0" /end CHARACTERISTIC
/begin CHARACTERISTIC ECO54 "" CURVE 0x1E020C _REC_A1CUR_1_u2_u2_S2 15000 _CNV_R_R_Umr_1_zu_1_3_CM_S2 0 15000
 /begin AXIS_DESCR COM_AXIS W_DKKD _CNV_R_R_Umr_10_zu__9_CM_S2 15 0 120 DEPOSIT ABSOLUTE FORMAT "%3.1" AXIS_PTS_REF SSTSKL_ECO /end AXIS_DESCR
 FORMAT "%2.0" /end CHARACTERISTIC
/begin CHARACTERISTIC ECO56 "" CURVE 0x1E022A _REC_A1CUR_1_u2_u2_S2 15000 _CNV_R_R_Umr_1_zu_1_3_CM_S2 0 15000
 /begin AXIS_DESCR COM_AXIS W_DKKD _CNV_R_R_Umr_10_zu__9_CM_S2 15 0 120 DEPOSIT ABSOLUTE FORMAT "%3.1" AXIS_PTS_REF SSTSKL_ECO /end AXIS_DESCR
 FORMAT "%2.0" /end CHARACTERISTIC
/begin CHARACTERISTIC ECO65 "" CURVE 0x1E0248 _REC_A1CUR_1_u2_u2_S2 15000 _CNV_R_R_Umr_1_zu_1_3_CM_S2 0 15000
 /begin AXIS_DESCR COM_AXIS W_DKKD _CNV_R_R_Umr_10_zu__9_CM_S2 15 0 120 DEPOSIT ABSOLUTE FORMAT "%3.1" AXIS_PTS_REF SSTSKL_ECO /end AXIS_DESCR
 FORMAT "%2.0" /end CHARACTERISTIC
/begin CHARACTERISTIC ECO67 "" CURVE 0x1E1436 _REC_A1CUR_1_u2_u2_S2 15000 _CNV_R_R_Umr_1_zu_1_3_CM_S2 0 15000
 /begin AXIS_DESCR COM_AXIS W_DKKD _CNV_R_R_Umr_10_zu__9_CM_S2 15 0 120 DEPOSIT ABSOLUTE FORMAT "%3.1" AXIS_PTS_REF SSTSKL_ECO /end AXIS_DESCR
 FORMAT "%2.0" /end CHARACTERISTIC
/begin CHARACTERISTIC ECO76 "" CURVE 0x1E1454 _REC_A1CUR_1_u2_u2_S2 15000 _CNV_R_R_Umr_1_zu_1_3_CM_S2 0 15000
 /begin AXIS_DESCR COM_AXIS W_DKKD _CNV_R_R_Umr_10_zu__9_CM_S2 15 0 120 DEPOSIT ABSOLUTE FORMAT "%3.1" AXIS_PTS_REF SSTSKL_ECO /end AXIS_DESCR
 FORMAT "%2.0" /end CHARACTERISTIC
/begin CHARACTERISTIC ECO78 "" CURVE 0x1E1922 _REC_A1CUR_1_u2_u2_S2 15000 _CNV_R_R_Umr_1_zu_1_3_CM_S2 0 15000
 /begin AXIS_DESCR COM_AXIS W_DKKD _CNV_R_R_Umr_10_zu__9_CM_S2 15 0 120 DEPOSIT ABSOLUTE FORMAT "%3.1" AXIS_PTS_REF SSTSKL_ECO /end AXIS_DESCR
 FORMAT "%2.0" /end CHARACTERISTIC
/begin CHARACTERISTIC ECO87 "" CURVE 0x1E1940 _REC_A1CUR_1_u2_u2_S2 15000 _CNV_R_R_Umr_1_zu_1_3_CM_S2 0 15000
 /begin AXIS_DESCR COM_AXIS W_DKKD _CNV_R_R_Umr_10_zu__9_CM_S2 15 0 120 DEPOSIT ABSOLUTE FORMAT "%3.1" AXIS_PTS_REF SSTSKL_ECO /end AXIS_DESCR
 FORMAT "%2.0" /end CHARACTERISTIC
/begin CHARACTERISTIC ECOA112 "" CURVE 0x1E0266 _REC_A1CUR_1_u2_u2_S2 15000 _CNV_R_R_Umr_1_zu_1_3_CM_S2 0 15000
 /begin AXIS_DESCR COM_AXIS W_DKKD _CNV_R_R_Umr_10_zu__9_CM_S2 15 0 120 DEPOSIT ABSOLUTE FORMAT "%3.1" AXIS_PTS_REF SSTSKL_ECOA1 /end AXIS_DESCR
 FORMAT "%2.0" /end CHARACTERISTIC
/begin CHARACTERISTIC ECOA121 "" CURVE 0x1E0284 _REC_A1CUR_1_u2_u2_S2 15000 _CNV_R_R_Umr_1_zu_1_3_CM_S2 0 15000
 /begin AXIS_DESCR COM_AXIS W_DKKD _CNV_R_R_Umr_10_zu__9_CM_S2 15 0 120 DEPOSIT ABSOLUTE FORMAT "%3.1" AXIS_PTS_REF SSTSKL_ECOA1 /end AXIS_DESCR
 FORMAT "%2.0" /end CHARACTERISTIC
/begin CHARACTERISTIC ECOA123 "" CURVE 0x1E02A2 _REC_A1CUR_1_u2_u2_S2 15000 _CNV_R_R_Umr_1_zu_1_3_CM_S2 0 15000
 /begin AXIS_DESCR COM_AXIS W_DKKD _CNV_R_R_Umr_10_zu__9_CM_S2 15 0 120 DEPOSIT ABSOLUTE FORMAT "%3.1" AXIS_PTS_REF SSTSKL_ECOA1 /end AXIS_DESCR
 FORMAT "%2.0" /end CHARACTERISTIC
/begin CHARACTERISTIC ECOA132 "" CURVE 0x1E02C0 _REC_A1CUR_1_u2_u2_S2 15000 _CNV_R_R_Umr_1_zu_1_3_CM_S2 0 15000
 /begin AXIS_DESCR COM_AXIS W_DKKD _CNV_R_R_Umr_10_zu__9_CM_S2 15 0 120 DEPOSIT ABSOLUTE FORMAT "%3.1" AXIS_PTS_REF SSTSKL_ECOA1 /end AXIS_DESCR
 FORMAT "%2.0" /end CHARACTERISTIC
/begin CHARACTERISTIC ECOA134 "" CURVE 0x1E02DE _REC_A1CUR_1_u2_u2_S2 15000 _CNV_R_R_Umr_1_zu_1_3_CM_S2 0 15000
 /begin AXIS_DESCR COM_AXIS W_DKKD _CNV_R_R_Umr_10_zu__9_CM_S2 15 0 120 DEPOSIT ABSOLUTE FORMAT "%3.1" AXIS_PTS_REF SSTSKL_ECOA1 /end AXIS_DESCR
 FORMAT "%2.0" /end CHARACTERISTIC
/begin CHARACTERISTIC ECOA143 "" CURVE 0x1E02FC _REC_A1CUR_1_u2_u2_S2 15000 _CNV_R_R_Umr_1_zu_1_3_CM_S2 0 15000
 /begin AXIS_DESCR COM_AXIS W_DKKD _CNV_R_R_Umr_10_zu__9_CM_S2 15 0 120 DEPOSIT ABSOLUTE FORMAT "%3.1" AXIS_PTS_REF SSTSKL_ECOA1 /end AXIS_DESCR
 FORMAT "%2.0" /end CHARACTERISTIC
/begin CHARACTERISTIC ECOA145 "" CURVE 0x1E031A _REC_A1CUR_1_u2_u2_S2 15000 _CNV_R_R_Umr_1_zu_1_3_CM_S2 0 15000
 /begin AXIS_DESCR COM_AXIS W_DKKD _CNV_R_R_Umr_10_zu__9_CM_S2 15 0 120 DEPOSIT ABSOLUTE FORMAT "%3.1" AXIS_PTS_REF SSTSKL_ECOA1 /end AXIS_DESCR
 FORMAT "%2.0" /end CHARACTERISTIC
/begin CHARACTERISTIC ECOA154 "" CURVE 0x1E0338 _REC_A1CUR_1_u2_u2_S2 15000 _CNV_R_R_Umr_1_zu_1_3_CM_S2 0 15000
 /begin AXIS_DESCR COM_AXIS W_DKKD _CNV_R_R_Umr_10_zu__9_CM_S2 15 0 120 DEPOSIT ABSOLUTE FORMAT "%3.1" AXIS_PTS_REF SSTSKL_ECOA1 /end AXIS_DESCR
 FORMAT "%2.0" /end CHARACTERISTIC
/begin CHARACTERISTIC ECOA156 "" CURVE 0x1E0356 _REC_A1CUR_1_u2_u2_S2 15000 _CNV_R_R_Umr_1_zu_1_3_CM_S2 0 15000
 /begin AXIS_DESCR COM_AXIS W_DKKD _CNV_R_R_Umr_10_zu__9_CM_S2 15 0 120 DEPOSIT ABSOLUTE FORMAT "%3.1" AXIS_PTS_REF SSTSKL_ECOA1 /end AXIS_DESCR
 FORMAT "%2.0" /end CHARACTERISTIC
/begin CHARACTERISTIC ECOA165 "" CURVE 0x1E0374 _REC_A1CUR_1_u2_u2_S2 15000 _CNV_R_R_Umr_1_zu_1_3_CM_S2 0 15000
 /begin AXIS_DESCR COM_AXIS W_DKKD _CNV_R_R_Umr_10_zu__9_CM_S2 15 0 120 DEPOSIT ABSOLUTE FORMAT "%3.1" AXIS_PTS_REF SSTSKL_ECOA1 /end AXIS_DESCR
 FORMAT "%2.0" /end CHARACTERISTIC
/begin CHARACTERISTIC ECOA167 "" CURVE 0x1E1472 _REC_A1CUR_1_u2_u2_S2 15000 _CNV_R_R_Umr_1_zu_1_3_CM_S2 0 15000
 /begin AXIS_DESCR COM_AXIS W_DKKD _CNV_R_R_Umr_10_zu__9_CM_S2 15 0 120 DEPOSIT ABSOLUTE FORMAT "%3.1" AXIS_PTS_REF SSTSKL_ECOA1 /end AXIS_DESCR
 FORMAT "%2.0" /end CHARACTERISTIC
/begin CHARACTERISTIC ECOA176 "" CURVE 0x1E1490 _REC_A1CUR_1_u2_u2_S2 15000 _CNV_R_R_Umr_1_zu_1_3_CM_S2 0 15000
 /begin AXIS_DESCR COM_AXIS W_DKKD _CNV_R_R_Umr_10_zu__9_CM_S2 15 0 120 DEPOSIT ABSOLUTE FORMAT "%3.1" AXIS_PTS_REF SSTSKL_ECOA1 /end AXIS_DESCR
 FORMAT "%2.0" /end CHARACTERISTIC
/begin CHARACTERISTIC ECOA178 "" CURVE 0x1E195E _REC_A1CUR_1_u2_u2_S2 15000 _CNV_R_R_Umr_1_zu_1_3_CM_S2 0 15000
 /begin AXIS_DESCR COM_AXIS W_DKKD _CNV_R_R_Umr_10_zu__9_CM_S2 15 0 120 DEPOSIT ABSOLUTE FORMAT "%3.1" AXIS_PTS_REF SSTSKL_ECOA1 /end AXIS_DESCR
 FORMAT "%2.0" /end CHARACTERISTIC
/begin CHARACTERISTIC ECOA187 "" CURVE 0x1E197C _REC_A1CUR_1_u2_u2_S2 15000 _CNV_R_R_Umr_1_zu_1_3_CM_S2 0 15000
 /begin AXIS_DESCR COM_AXIS W_DKKD _CNV_R_R_Umr_10_zu__9_CM_S2 15 0 120 DEPOSIT ABSOLUTE FORMAT "%3.1" AXIS_PTS_REF SSTSKL_ECOA1 /end AXIS_DESCR
 FORMAT "%2.0" /end CHARACTERISTIC
/begin CHARACTERISTIC ECOA212 "" CURVE 0x1E0392 _REC_A1CUR_1_u2_u2_S2 15000 _CNV_R_R_Umr_1_zu_1_3_CM_S2 0 15000
 /begin AXIS_DESCR COM_AXIS W_DKKD _CNV_R_R_Umr_10_zu__9_CM_S2 15 0 120 DEPOSIT ABSOLUTE FORMAT "%3.1" AXIS_PTS_REF SSTSKL_ECOA2 /end AXIS_DESCR
 FORMAT "%2.0" /end CHARACTERISTIC
/begin CHARACTERISTIC ECOA221 "" CURVE 0x1E03B0 _REC_A1CUR_1_u2_u2_S2 15000 _CNV_R_R_Umr_1_zu_1_3_CM_S2 0 15000
 /begin AXIS_DESCR COM_AXIS W_DKKD _CNV_R_R_Umr_10_zu__9_CM_S2 15 0 120 DEPOSIT ABSOLUTE FORMAT "%3.1" AXIS_PTS_REF SSTSKL_ECOA2 /end AXIS_DESCR
 FORMAT "%2.0" /end CHARACTERISTIC
/begin CHARACTERISTIC ECOA223 "" CURVE 0x1E03CE _REC_A1CUR_1_u2_u2_S2 15000 _CNV_R_R_Umr_1_zu_1_3_CM_S2 0 15000
 /begin AXIS_DESCR COM_AXIS W_DKKD _CNV_R_R_Umr_10_zu__9_CM_S2 15 0 120 DEPOSIT ABSOLUTE FORMAT "%3.1" AXIS_PTS_REF SSTSKL_ECOA2 /end AXIS_DESCR
 FORMAT "%2.0" /end CHARACTERISTIC
/begin CHARACTERISTIC ECOA232 "" CURVE 0x1E03EC _REC_A1CUR_1_u2_u2_S2 15000 _CNV_R_R_Umr_1_zu_1_3_CM_S2 0 15000
 /begin AXIS_DESCR COM_AXIS W_DKKD _CNV_R_R_Umr_10_zu__9_CM_S2 15 0 120 DEPOSIT ABSOLUTE FORMAT "%3.1" AXIS_PTS_REF SSTSKL_ECOA2 /end AXIS_DESCR
 FORMAT "%2.0" /end CHARACTERISTIC
/begin CHARACTERISTIC ECOA234 "" CURVE 0x1E040A _REC_A1CUR_1_u2_u2_S2 15000 _CNV_R_R_Umr_1_zu_1_3_CM_S2 0 15000
 /begin AXIS_DESCR COM_AXIS W_DKKD _CNV_R_R_Umr_10_zu__9_CM_S2 15 0 120 DEPOSIT ABSOLUTE FORMAT "%3.1" AXIS_PTS_REF SSTSKL_ECOA2 /end AXIS_DESCR
 FORMAT "%2.0" /end CHARACTERISTIC
/begin CHARACTERISTIC ECOA243 "" CURVE 0x1E0428 _REC_A1CUR_1_u2_u2_S2 15000 _CNV_R_R_Umr_1_zu_1_3_CM_S2 0 15000
 /begin AXIS_DESCR COM_AXIS W_DKKD _CNV_R_R_Umr_10_zu__9_CM_S2 15 0 120 DEPOSIT ABSOLUTE FORMAT "%3.1" AXIS_PTS_REF SSTSKL_ECOA2 /end AXIS_DESCR
 FORMAT "%2.0" /end CHARACTERISTIC
/begin CHARACTERISTIC ECOA245 "" CURVE 0x1E0446 _REC_A1CUR_1_u2_u2_S2 15000 _CNV_R_R_Umr_1_zu_1_3_CM_S2 0 15000
 /begin AXIS_DESCR COM_AXIS W_DKKD _CNV_R_R_Umr_10_zu__9_CM_S2 15 0 120 DEPOSIT ABSOLUTE FORMAT "%3.1" AXIS_PTS_REF SSTSKL_ECOA2 /end AXIS_DESCR
 FORMAT "%2.0" /end CHARACTERISTIC
/begin CHARACTERISTIC ECOA254 "" CURVE 0x1E0464 _REC_A1CUR_1_u2_u2_S2 15000 _CNV_R_R_Umr_1_zu_1_3_CM_S2 0 15000
 /begin AXIS_DESCR COM_AXIS W_DKKD _CNV_R_R_Umr_10_zu__9_CM_S2 15 0 120 DEPOSIT ABSOLUTE FORMAT "%3.1" AXIS_PTS_REF SSTSKL_ECOA2 /end AXIS_DESCR
 FORMAT "%2.0" /end CHARACTERISTIC
/begin CHARACTERISTIC ECOA256 "" CURVE 0x1E0482 _REC_A1CUR_1_u2_u2_S2 15000 _CNV_R_R_Umr_1_zu_1_3_CM_S2 0 15000
 /begin AXIS_DESCR COM_AXIS W_DKKD _CNV_R_R_Umr_10_zu__9_CM_S2 15 0 120 DEPOSIT ABSOLUTE FORMAT "%3.1" AXIS_PTS_REF SSTSKL_ECOA2 /end AXIS_DESCR
 FORMAT "%2.0" /end CHARACTERISTIC
/begin CHARACTERISTIC ECOA265 "" CURVE 0x1E04A0 _REC_A1CUR_1_u2_u2_S2 15000 _CNV_R_R_Umr_1_zu_1_3_CM_S2 0 15000
 /begin AXIS_DESCR COM_AXIS W_DKKD _CNV_R_R_Umr_10_zu__9_CM_S2 15 0 120 DEPOSIT ABSOLUTE FORMAT "%3.1" AXIS_PTS_REF SSTSKL_ECOA2 /end AXIS_DESCR
 FORMAT "%2.0" /end CHARACTERISTIC
/begin CHARACTERISTIC ECOA267 "" CURVE 0x1E14AE _REC_A1CUR_1_u2_u2_S2 15000 _CNV_R_R_Umr_1_zu_1_3_CM_S2 0 15000
 /begin AXIS_DESCR COM_AXIS W_DKKD _CNV_R_R_Umr_10_zu__9_CM_S2 15 0 120 DEPOSIT ABSOLUTE FORMAT "%3.1" AXIS_PTS_REF SSTSKL_ECOA2 /end AXIS_DESCR
 FORMAT "%2.0" /end CHARACTERISTIC
/begin CHARACTERISTIC ECOA276 "" CURVE 0x1E14CC _REC_A1CUR_1_u2_u2_S2 15000 _CNV_R_R_Umr_1_zu_1_3_CM_S2 0 15000
 /begin AXIS_DESCR COM_AXIS W_DKKD _CNV_R_R_Umr_10_zu__9_CM_S2 15 0 120 DEPOSIT ABSOLUTE FORMAT "%3.1" AXIS_PTS_REF SSTSKL_ECOA2 /end AXIS_DESCR
 FORMAT "%2.0" /end CHARACTERISTIC
/begin CHARACTERISTIC ECOA278 "" CURVE 0x1E199A _REC_A1CUR_1_u2_u2_S2 15000 _CNV_R_R_Umr_1_zu_1_3_CM_S2 0 15000
 /begin AXIS_DESCR COM_AXIS W_DKKD _CNV_R_R_Umr_10_zu__9_CM_S2 15 0 120 DEPOSIT ABSOLUTE FORMAT "%3.1" AXIS_PTS_REF SSTSKL_ECOA2 /end AXIS_DESCR
 FORMAT "%2.0" /end CHARACTERISTIC
/begin CHARACTERISTIC ECOA287 "" CURVE 0x1E19B8 _REC_A1CUR_1_u2_u2_S2 15000 _CNV_R_R_Umr_1_zu_1_3_CM_S2 0 15000
 /begin AXIS_DESCR COM_AXIS W_DKKD _CNV_R_R_Umr_10_zu__9_CM_S2 15 0 120 DEPOSIT ABSOLUTE FORMAT "%3.1" AXIS_PTS_REF SSTSKL_ECOA2 /end AXIS_DESCR
 FORMAT "%2.0" /end CHARACTERISTIC
/begin CHARACTERISTIC ECOWL212 "" CURVE 0x1E04BE _REC_A1CUR_1_u2_u2_S2 15000 _CNV_R_R_Umr_1_zu_1_3_CM_S2 0 15000
 /begin AXIS_DESCR COM_AXIS W_DKKD _CNV_R_R_Umr_10_zu__9_CM_S2 15 0 120 DEPOSIT ABSOLUTE FORMAT "%3.1" AXIS_PTS_REF SSTSKL_ECOWL2 /end AXIS_DESCR
 FORMAT "%2.0" /end CHARACTERISTIC
/begin CHARACTERISTIC ECOWL221 "" CURVE 0x1E04DC _REC_A1CUR_1_u2_u2_S2 15000 _CNV_R_R_Umr_1_zu_1_3_CM_S2 0 15000
 /begin AXIS_DESCR COM_AXIS W_DKKD _CNV_R_R_Umr_10_zu__9_CM_S2 15 0 120 DEPOSIT ABSOLUTE FORMAT "%3.1" AXIS_PTS_REF SSTSKL_ECOWL2 /end AXIS_DESCR
 FORMAT "%2.0" /end CHARACTERISTIC
/begin CHARACTERISTIC ECOWL223 "" CURVE 0x1E04FA _REC_A1CUR_1_u2_u2_S2 15000 _CNV_R_R_Umr_1_zu_1_3_CM_S2 0 15000
 /begin AXIS_DESCR COM_AXIS W_DKKD _CNV_R_R_Umr_10_zu__9_CM_S2 15 0 120 DEPOSIT ABSOLUTE FORMAT "%3.1" AXIS_PTS_REF SSTSKL_ECOWL2 /end AXIS_DESCR
 FORMAT "%2.0" /end CHARACTERISTIC
/begin CHARACTERISTIC ECOWL232 "" CURVE 0x1E0518 _REC_A1CUR_1_u2_u2_S2 15000 _CNV_R_R_Umr_1_zu_1_3_CM_S2 0 15000
 /begin AXIS_DESCR COM_AXIS W_DKKD _CNV_R_R_Umr_10_zu__9_CM_S2 15 0 120 DEPOSIT ABSOLUTE FORMAT "%3.1" AXIS_PTS_REF SSTSKL_ECOWL2 /end AXIS_DESCR
 FORMAT "%2.0" /end CHARACTERISTIC
/begin CHARACTERISTIC ECOWL234 "" CURVE 0x1E0536 _REC_A1CUR_1_u2_u2_S2 15000 _CNV_R_R_Umr_1_zu_1_3_CM_S2 0 15000
 /begin AXIS_DESCR COM_AXIS W_DKKD _CNV_R_R_Umr_10_zu__9_CM_S2 15 0 120 DEPOSIT ABSOLUTE FORMAT "%3.1" AXIS_PTS_REF SSTSKL_ECOWL2 /end AXIS_DESCR
 FORMAT "%2.0" /end CHARACTERISTIC
/begin CHARACTERISTIC ECOWL243 "" CURVE 0x1E0554 _REC_A1CUR_1_u2_u2_S2 15000 _CNV_R_R_Umr_1_zu_1_3_CM_S2 0 15000
 /begin AXIS_DESCR COM_AXIS W_DKKD _CNV_R_R_Umr_10_zu__9_CM_S2 15 0 120 DEPOSIT ABSOLUTE FORMAT "%3.1" AXIS_PTS_REF SSTSKL_ECOWL2 /end AXIS_DESCR
 FORMAT "%2.0" /end CHARACTERISTIC
/begin CHARACTERISTIC ECOWL245 "" CURVE 0x1E0572 _REC_A1CUR_1_u2_u2_S2 15000 _CNV_R_R_Umr_1_zu_1_3_CM_S2 0 15000
 /begin AXIS_DESCR COM_AXIS W_DKKD _CNV_R_R_Umr_10_zu__9_CM_S2 15 0 120 DEPOSIT ABSOLUTE FORMAT "%3.1" AXIS_PTS_REF SSTSKL_ECOWL2 /end AXIS_DESCR
 FORMAT "%2.0" /end CHARACTERISTIC
/begin CHARACTERISTIC ECOWL254 "" CURVE 0x1E0590 _REC_A1CUR_1_u2_u2_S2 15000 _CNV_R_R_Umr_1_zu_1_3_CM_S2 0 15000
 /begin AXIS_DESCR COM_AXIS W_DKKD _CNV_R_R_Umr_10_zu__9_CM_S2 15 0 120 DEPOSIT ABSOLUTE FORMAT "%3.1" AXIS_PTS_REF SSTSKL_ECOWL2 /end AXIS_DESCR
 FORMAT "%2.0" /end CHARACTERISTIC
/begin CHARACTERISTIC ECOWL256 "" CURVE 0x1E05AE _REC_A1CUR_1_u2_u2_S2 15000 _CNV_R_R_Umr_1_zu_1_3_CM_S2 0 15000
 /begin AXIS_DESCR COM_AXIS W_DKKD _CNV_R_R_Umr_10_zu__9_CM_S2 15 0 120 DEPOSIT ABSOLUTE FORMAT "%3.1" AXIS_PTS_REF SSTSKL_ECOWL2 /end AXIS_DESCR
 FORMAT "%2.0" /end CHARACTERISTIC
/begin CHARACTERISTIC ECOWL265 "" CURVE 0x1E05CC _REC_A1CUR_1_u2_u2_S2 15000 _CNV_R_R_Umr_1_zu_1_3_CM_S2 0 15000
 /begin AXIS_DESCR COM_AXIS W_DKKD _CNV_R_R_Umr_10_zu__9_CM_S2 15 0 120 DEPOSIT ABSOLUTE FORMAT "%3.1" AXIS_PTS_REF SSTSKL_ECOWL2 /end AXIS_DESCR
 FORMAT "%2.0" /end CHARACTERISTIC
/begin CHARACTERISTIC ECOWL267 "" CURVE 0x1E14EA _REC_A1CUR_1_u2_u2_S2 15000 _CNV_R_R_Umr_1_zu_1_3_CM_S2 0 15000
 /begin AXIS_DESCR COM_AXIS W_DKKD _CNV_R_R_Umr_10_zu__9_CM_S2 15 0 120 DEPOSIT ABSOLUTE FORMAT "%3.1" AXIS_PTS_REF SSTSKL_ECOWL2 /end AXIS_DESCR
 FORMAT "%2.0" /end CHARACTERISTIC
/begin CHARACTERISTIC ECOWL276 "" CURVE 0x1E1508 _REC_A1CUR_1_u2_u2_S2 15000 _CNV_R_R_Umr_1_zu_1_3_CM_S2 0 15000
 /begin AXIS_DESCR COM_AXIS W_DKKD _CNV_R_R_Umr_10_zu__9_CM_S2 15 0 120 DEPOSIT ABSOLUTE FORMAT "%3.1" AXIS_PTS_REF SSTSKL_ECOWL2 /end AXIS_DESCR
 FORMAT "%2.0" /end CHARACTERISTIC
/begin CHARACTERISTIC ECOWL278 "" CURVE 0x1E19D6 _REC_A1CUR_1_u2_u2_S2 15000 _CNV_R_R_Umr_1_zu_1_3_CM_S2 0 15000
 /begin AXIS_DESCR COM_AXIS W_DKKD _CNV_R_R_Umr_10_zu__9_CM_S2 15 0 120 DEPOSIT ABSOLUTE FORMAT "%3.1" AXIS_PTS_REF SSTSKL_ECOWL2 /end AXIS_DESCR
 FORMAT "%2.0" /end CHARACTERISTIC
/begin CHARACTERISTIC ECOWL287 "" CURVE 0x1E19F4 _REC_A1CUR_1_u2_u2_S2 15000 _CNV_R_R_Umr_1_zu_1_3_CM_S2 0 15000
 /begin AXIS_DESCR COM_AXIS W_DKKD _CNV_R_R_Umr_10_zu__9_CM_S2 15 0 120 DEPOSIT ABSOLUTE FORMAT "%3.1" AXIS_PTS_REF SSTSKL_ECOWL2 /end AXIS_DESCR
 FORMAT "%2.0" /end CHARACTERISTIC
/begin MEASUREMENT EepromBPRAM.f_ForceEEPROM_Update "Force EEPROM Update if set" UBYTE SBW_STANDARD_S1_S3 1 100 0 1 BIT_MASK 0x1 ECU_ADDRESS 0xFFF835CE DISPLAY_IDENTIFIER f_ForceEEPROM_Update.EepromBPRAM /end MEASUREMENT
/begin MEASUREMENT EepromBPRAM.f_ForceEEPROM_Update_ "Complement of Force EEPROM Update" UBYTE SBW_STANDARD_S1_S3 1 100 0 255 ECU_ADDRESS 0xFFF835CF DISPLAY_IDENTIFIER f_ForceEEPROM_Update_.EepromBPRAM /end MEASUREMENT
/begin MEASUREMENT EepromEws4ImmedWrap.EepromEws4Immediate.f_ews4_locked "flag telling that EWS4 has locked its SK" UBYTE SBW_STANDARD_S1_S3 1 100 0 1 BIT_MASK 0x1 ECU_ADDRESS 0xFFF81024 DISPLAY_IDENTIFIER f_ews4_locked.EepromEws4Immediate.EepromEws4ImmedWrap /end MEASUREMENT
/begin MEASUREMENT EepromEws4ImmedWrap.EepromEws4Immediate.f_ews4_locked_ "bit-compl. of flag telling that EWS4 has locked its SK" UBYTE SBW_STANDARD_S1_S3 1 100 0 255 ECU_ADDRESS 0xFFF81025 DISPLAY_IDENTIFIER f_ews4_locked_.EepromEws4Immediate.EepromEws4ImmedWrap /end MEASUREMENT
/begin MEASUREMENT EepromEws4ImmedWrap.EepromEws4Immediate.fsc_old_date "saved date of last accepted FSC: measured in minutes since 1-1-2000" ULONG SBW_STANDARD_S1_S3 1 100 0 4294967295 ECU_ADDRESS 0xFFF81028 DISPLAY_IDENTIFIER fsc_old_date.EepromEws4Immediate.EepromEws4ImmedWrap /end MEASUREMENT
/begin MEASUREMENT EepromEws4ImmedWrap.EepromEws4Immediate.fsc_old_date_ "bit-compl. of saved date of last accepted FSC" ULONG SBW_STANDARD_S1_S3 1 100 0 4294967295 ECU_ADDRESS 0xFFF8102C DISPLAY_IDENTIFIER fsc_old_date_.EepromEws4Immediate.EepromEws4ImmedWrap /end MEASUREMENT
/begin MEASUREMENT EepromEws4ImmedWrap.EepromEws4Immediate.fsc_status "status of FSC: tells if FSC is not available or was accepted and stored into EEPROM: C_FscStateNotAvailable:0 C_FscStateAccepted:2" UBYTE SBW_STANDARD_S1_S3 1 100 0 2 ECU_ADDRESS 0xFFF81026 DISPLAY_IDENTIFIER fsc_status.EepromEws4Immediate.EepromEws4ImmedWrap /end MEASUREMENT
/begin MEASUREMENT EepromEws4ImmedWrap.EepromEws4Immediate.fsc_status_ "bit-compl. of status of FSC" UBYTE SBW_STANDARD_S1_S3 1 100 0 255 ECU_ADDRESS 0xFFF81027 DISPLAY_IDENTIFIER fsc_status_.EepromEws4Immediate.EepromEws4ImmedWrap /end MEASUREMENT
/begin MEASUREMENT EepromWrap.Eeprom.cnt_AdaptivMode "eeprom-based operating-second counter for AdaptivMode" ULONG SBW_STANDARD_S1_S3 1 100 0 4294967295 ECU_ADDRESS 0xFFF81E6C DISPLAY_IDENTIFIER cnt_AdaptivMode.Eeprom.EepromWrap /end MEASUREMENT
/begin MEASUREMENT EepromWrap.Eeprom.cnt_AdaptivMode_ "bit-complement of eeprom-based operating-second counter for AdaptivMode" ULONG SBW_STANDARD_S1_S3 1 100 0 4294967295 ECU_ADDRESS 0xFFF81E7C DISPLAY_IDENTIFIER cnt_AdaptivMode_.Eeprom.EepromWrap /end MEASUREMENT
/begin MEASUREMENT EepromWrap.Eeprom.cnt_AutoPEmf1 "eeprom-based counter for AutoPEmf1" UBYTE SBW_STANDARD_S1_S3 1 100 0 255 ECU_ADDRESS 0xFFF81E68 DISPLAY_IDENTIFIER cnt_AutoPEmf1.Eeprom.EepromWrap /end MEASUREMENT
/begin MEASUREMENT EepromWrap.Eeprom.cnt_AutoPEmf1_ "bit-complement of eeprom-based counter for AutoPEmf1" UBYTE SBW_STANDARD_S1_S3 1 100 0 255 ECU_ADDRESS 0xFFF81E7A DISPLAY_IDENTIFIER cnt_AutoPEmf1_.Eeprom.EepromWrap /end MEASUREMENT
/begin MEASUREMENT EepromWrap.Eeprom.cnt_AutoPEmf2 "eeprom-based counter for AutoPEmf2" UBYTE SBW_STANDARD_S1_S3 1 100 0 255 ECU_ADDRESS 0xFFF81E67 DISPLAY_IDENTIFIER cnt_AutoPEmf2.Eeprom.EepromWrap /end MEASUREMENT
/begin MEASUREMENT EepromWrap.Eeprom.cnt_AutoPEmf2_ "bit-complement of eeprom-based counter for AutoPEmf2" UBYTE SBW_STANDARD_S1_S3 1 100 0 255 ECU_ADDRESS 0xFFF81E79 DISPLAY_IDENTIFIER cnt_AutoPEmf2_.Eeprom.EepromWrap /end MEASUREMENT
/begin MEASUREMENT EepromWrap.Eeprom.cnt_AutoPEmf3 "eeprom-based counter for AutoPEmf3" UBYTE SBW_STANDARD_S1_S3 1 100 0 255 ECU_ADDRESS 0xFFF81E66 DISPLAY_IDENTIFIER cnt_AutoPEmf3.Eeprom.EepromWrap /end MEASUREMENT
/begin MEASUREMENT EepromWrap.Eeprom.cnt_AutoPEmf3_ "bit-complement of eeprom-based counter for AutoPEmf3" UBYTE SBW_STANDARD_S1_S3 1 100 0 255 ECU_ADDRESS 0xFFF81E78 DISPLAY_IDENTIFIER cnt_AutoPEmf3_.Eeprom.EepromWrap /end MEASUREMENT
/begin MEASUREMENT EepromWrap.Eeprom.cnt_AutoP_DrvPresenceUnknown.Complement "Complement of measurement variable" UBYTE SBW_STANDARD_S1_S3 1 100 0 255 ECU_ADDRESS 0xFFF81E5D DISPLAY_IDENTIFIER Complement.cnt_AutoP_DrvPresenceUnknown.Eeprom.EepromWrap /end MEASUREMENT
/begin MEASUREMENT EepromWrap.Eeprom.cnt_AutoP_DrvPresenceUnknown.Value "Value of measurement variable" UBYTE SBW_STANDARD_S1_S3 1 100 0 255 ECU_ADDRESS 0xFFF81E5C DISPLAY_IDENTIFIER Value.cnt_AutoP_DrvPresenceUnknown.Eeprom.EepromWrap /end MEASUREMENT
/begin MEASUREMENT EepromWrap.Eeprom.cnt_DiagPosInWrongDrvDir.Complement "Complement of measurement variable" UBYTE SBW_STANDARD_S1_S3 1 100 0 255 ECU_ADDRESS 0xFFF81E5B DISPLAY_IDENTIFIER Complement.cnt_DiagPosInWrongDrvDir.Eeprom.EepromWrap /end MEASUREMENT
/begin MEASUREMENT EepromWrap.Eeprom.cnt_DiagPosInWrongDrvDir.Value "Value of measurement variable" UBYTE SBW_STANDARD_S1_S3 1 100 0 255 ECU_ADDRESS 0xFFF81E5A DISPLAY_IDENTIFIER Value.cnt_DiagPosInWrongDrvDir.Eeprom.EepromWrap /end MEASUREMENT
/begin MEASUREMENT EepromWrap.Eeprom.cnt_GbxTempReqP "eeprom-based counter for GbxTempReqP" UBYTE SBW_STANDARD_S1_S3 1 100 0 255 ECU_ADDRESS 0xFFF81E69 DISPLAY_IDENTIFIER cnt_GbxTempReqP.Eeprom.EepromWrap /end MEASUREMENT
/begin MEASUREMENT EepromWrap.Eeprom.cnt_GbxTempReqP_ "bit-complement of eeprom-based counter for GbxTempReqP" UBYTE SBW_STANDARD_S1_S3 1 100 0 255 ECU_ADDRESS 0xFFF81E6A DISPLAY_IDENTIFIER cnt_GbxTempReqP_.Eeprom.EepromWrap /end MEASUREMENT
/begin MEASUREMENT EepromWrap.Eeprom.cnt_ID828.Complement "Complement of measurement variable" UBYTE SBW_STANDARD_S1_S3 1 100 0 255 ECU_ADDRESS 0xFFF81E59 DISPLAY_IDENTIFIER Complement.cnt_ID828.Eeprom.EepromWrap /end MEASUREMENT
/begin MEASUREMENT EepromWrap.Eeprom.cnt_ID828.Value "Value of measurement variable" UBYTE SBW_STANDARD_S1_S3 1 100 0 255 ECU_ADDRESS 0xFFF81E58 DISPLAY_IDENTIFIER Value.cnt_ID828.Eeprom.EepromWrap /end MEASUREMENT
/begin MEASUREMENT EepromWrap.Eeprom.cnt_Init_Calls "eeprom-based init cycles counter" UWORD SBW_STANDARD_S1_S3 1 100 0 65535 ECU_ADDRESS 0xFFF81E62 DISPLAY_IDENTIFIER cnt_Init_Calls.Eeprom.EepromWrap /end MEASUREMENT
/begin MEASUREMENT EepromWrap.Eeprom.cnt_Init_Calls_ "bit-complement of eeprom-based init cycles counter" UWORD SBW_STANDARD_S1_S3 1 100 0 65535 ECU_ADDRESS 0xFFF81E64 DISPLAY_IDENTIFIER cnt_Init_Calls_.Eeprom.EepromWrap /end MEASUREMENT
/begin MEASUREMENT EepromWrap.Eeprom.cnt_ManualMode "eeprom-based operating-second counter for ManualMode" ULONG SBW_STANDARD_S1_S3 1 100 0 4294967295 ECU_ADDRESS 0xFFF81E74 DISPLAY_IDENTIFIER cnt_ManualMode.Eeprom.EepromWrap /end MEASUREMENT
/begin MEASUREMENT EepromWrap.Eeprom.cnt_ManualMode_ "bit-complement of eeprom-based operating-second counter for ManualMode" ULONG SBW_STANDARD_S1_S3 1 100 0 4294967295 ECU_ADDRESS 0xFFF81E84 DISPLAY_IDENTIFIER cnt_ManualMode_.Eeprom.EepromWrap /end MEASUREMENT
/begin MEASUREMENT EepromWrap.Eeprom.cnt_SportMode "eeprom-based operating-second counter for SportMode" ULONG SBW_STANDARD_S1_S3 1 100 0 4294967295 ECU_ADDRESS 0xFFF81E70 DISPLAY_IDENTIFIER cnt_SportMode.Eeprom.EepromWrap /end MEASUREMENT
/begin MEASUREMENT EepromWrap.Eeprom.cnt_SportMode_ "bit-complement of eeprom-based operating-second counter for SportMode" ULONG SBW_STANDARD_S1_S3 1 100 0 4294967295 ECU_ADDRESS 0xFFF81E80 DISPLAY_IDENTIFIER cnt_SportMode_.Eeprom.EepromWrap /end MEASUREMENT
/begin MEASUREMENT EepromWrap.Eeprom.cnt_info_memory_entries "counter for internal information memory entries" UBYTE SBW_STANDARD_S1_S3 1 100 0 255 ECU_ADDRESS 0xFFF81E5E DISPLAY_IDENTIFIER cnt_info_memory_entries.Eeprom.EepromWrap /end MEASUREMENT
/begin MEASUREMENT EepromWrap.Eeprom.idx_last_drvLeavesCarInN_mem_entry "index of last registered DrvLeavesCarInN_Memory array-dataset entry" UBYTE SBW_STANDARD_S1_S3 1 100 0 2 ECU_ADDRESS 0xFFF81E88 DISPLAY_IDENTIFIER idx_last_drvLeavesCarInN_mem_entry.Eeprom.EepromWrap /end MEASUREMENT
/begin MEASUREMENT EepromWrap.Eeprom.idx_last_drvLeavesCarInN_mem_entry_ "bit-complement of index of last registered DrvLeavesCarInN_Memory array-dataset entry" UBYTE SBW_STANDARD_S1_S3 1 100 0 255 ECU_ADDRESS 0xFFF81E89 DISPLAY_IDENTIFIER idx_last_drvLeavesCarInN_mem_entry_.Eeprom.EepromWrap /end MEASUREMENT
/begin MEASUREMENT EepromWrap.Eeprom.info_memory[0].errorID "error code - specified in calling module" UBYTE SBW_STANDARD_S1_S3 1 100 0 255 ECU_ADDRESS 0xFFF81E49 DISPLAY_IDENTIFIER errorID.info_memory[0].Eeprom.EepromWrap /end MEASUREMENT
/begin MEASUREMENT EepromWrap.Eeprom.info_memory[0].moduleID "ID of the calling module" UBYTE SBW_STANDARD_S1_S3 1 100 0 255 ECU_ADDRESS 0xFFF81E48 DISPLAY_IDENTIFIER moduleID.info_memory[0].Eeprom.EepromWrap /end MEASUREMENT
/begin MEASUREMENT EepromWrap.Eeprom.info_memory[1].errorID "error code - specified in calling module" UBYTE SBW_STANDARD_S1_S3 1 100 0 255 ECU_ADDRESS 0xFFF81E4B DISPLAY_IDENTIFIER errorID.info_memory[1].Eeprom.EepromWrap /end MEASUREMENT
/begin MEASUREMENT EepromWrap.Eeprom.info_memory[1].moduleID "ID of the calling module" UBYTE SBW_STANDARD_S1_S3 1 100 0 255 ECU_ADDRESS 0xFFF81E4A DISPLAY_IDENTIFIER moduleID.info_memory[1].Eeprom.EepromWrap /end MEASUREMENT
/begin MEASUREMENT EepromWrap.Eeprom.info_memory[2].errorID "error code - specified in calling module" UBYTE SBW_STANDARD_S1_S3 1 100 0 255 ECU_ADDRESS 0xFFF81E4D DISPLAY_IDENTIFIER errorID.info_memory[2].Eeprom.EepromWrap /end MEASUREMENT
/begin MEASUREMENT EepromWrap.Eeprom.info_memory[2].moduleID "ID of the calling module" UBYTE SBW_STANDARD_S1_S3 1 100 0 255 ECU_ADDRESS 0xFFF81E4C DISPLAY_IDENTIFIER moduleID.info_memory[2].Eeprom.EepromWrap /end MEASUREMENT
/begin MEASUREMENT EepromWrap.Eeprom.info_memory[3].errorID "error code - specified in calling module" UBYTE SBW_STANDARD_S1_S3 1 100 0 255 ECU_ADDRESS 0xFFF81E4F DISPLAY_IDENTIFIER errorID.info_memory[3].Eeprom.EepromWrap /end MEASUREMENT
/begin MEASUREMENT EepromWrap.Eeprom.info_memory[3].moduleID "ID of the calling module" UBYTE SBW_STANDARD_S1_S3 1 100 0 255 ECU_ADDRESS 0xFFF81E4E DISPLAY_IDENTIFIER moduleID.info_memory[3].Eeprom.EepromWrap /end MEASUREMENT
/begin MEASUREMENT EepromWrap.Eeprom.info_memory[4].errorID "error code - specified in calling module" UBYTE SBW_STANDARD_S1_S3 1 100 0 255 ECU_ADDRESS 0xFFF81E51 DISPLAY_IDENTIFIER errorID.info_memory[4].Eeprom.EepromWrap /end MEASUREMENT
/begin MEASUREMENT EepromWrap.Eeprom.info_memory[4].moduleID "ID of the calling module" UBYTE SBW_STANDARD_S1_S3 1 100 0 255 ECU_ADDRESS 0xFFF81E50 DISPLAY_IDENTIFIER moduleID.info_memory[4].Eeprom.EepromWrap /end MEASUREMENT
/begin MEASUREMENT EepromWrap.Eeprom.info_memory[5].errorID "error code - specified in calling module" UBYTE SBW_STANDARD_S1_S3 1 100 0 255 ECU_ADDRESS 0xFFF81E53 DISPLAY_IDENTIFIER errorID.info_memory[5].Eeprom.EepromWrap /end MEASUREMENT
/begin MEASUREMENT EepromWrap.Eeprom.info_memory[5].moduleID "ID of the calling module" UBYTE SBW_STANDARD_S1_S3 1 100 0 255 ECU_ADDRESS 0xFFF81E52 DISPLAY_IDENTIFIER moduleID.info_memory[5].Eeprom.EepromWrap /end MEASUREMENT
/begin MEASUREMENT EepromWrap.Eeprom.info_memory[6].errorID "error code - specified in calling module" UBYTE SBW_STANDARD_S1_S3 1 100 0 255 ECU_ADDRESS 0xFFF81E55 DISPLAY_IDENTIFIER errorID.info_memory[6].Eeprom.EepromWrap /end MEASUREMENT
/begin MEASUREMENT EepromWrap.Eeprom.info_memory[6].moduleID "ID of the calling module" UBYTE SBW_STANDARD_S1_S3 1 100 0 255 ECU_ADDRESS 0xFFF81E54 DISPLAY_IDENTIFIER moduleID.info_memory[6].Eeprom.EepromWrap /end MEASUREMENT
/begin MEASUREMENT EepromWrap.Eeprom.info_memory[7].errorID "error code - specified in calling module" UBYTE SBW_STANDARD_S1_S3 1 100 0 255 ECU_ADDRESS 0xFFF81E57 DISPLAY_IDENTIFIER errorID.info_memory[7].Eeprom.EepromWrap /end MEASUREMENT
/begin MEASUREMENT EepromWrap.Eeprom.info_memory[7].moduleID "ID of the calling module" UBYTE SBW_STANDARD_S1_S3 1 100 0 255 ECU_ADDRESS 0xFFF81E56 DISPLAY_IDENTIFIER moduleID.info_memory[7].Eeprom.EepromWrap /end MEASUREMENT
/begin MEASUREMENT EepromWrap.Eeprom.info_memory_checksum "checksum for internal information memory" UWORD SBW_STANDARD_S1_S3 1 100 0 65535 ECU_ADDRESS 0xFFF81E60 DISPLAY_IDENTIFIER info_memory_checksum.Eeprom.EepromWrap /end MEASUREMENT
/begin MEASUREMENT EngineSignals.f_EngOn "flag engine on for SBW [shift by wire]" UBYTE SBW_STANDARD_S1_S3 1 100 0 1 BIT_MASK 0x1 ECU_ADDRESS 0xFFF897A0 DISPLAY_IDENTIFIER f_EngOn.EngineSignals /end MEASUREMENT
/begin MEASUREMENT EngineSignals.f_GearboxReadySts_Old "gearbox status ready for SBW from last cycle 0=off 1=on" UBYTE SBW_STANDARD_S1_S3 1 100 0 1 BIT_MASK 0x1 ECU_ADDRESS 0xFFF8979F DISPLAY_IDENTIFIER f_GearboxReadySts_Old.EngineSignals /end MEASUREMENT
/begin MEASUREMENT EngineSignals.f_GearboxReady_Old "gearbox ready for SBW from last cycle 0=off 1=on" UBYTE SBW_STANDARD_S1_S3 1 100 0 1 BIT_MASK 0x1 ECU_ADDRESS 0xFFF8979E DISPLAY_IDENTIFIER f_GearboxReady_Old.EngineSignals /end MEASUREMENT
/begin MEASUREMENT EngineSignals.n_EngSub "engine rev.s subst value" UWORD SBW_STANDARD_S1_S3 1 100 0 65535 ECU_ADDRESS 0xFFF8979C DISPLAY_IDENTIFIER n_EngSub.EngineSignals /end MEASUREMENT
/begin MEASUREMENT EngineSignals.n_EngSubSts "state of signal n_EngSub" UBYTE SBW_STANDARD_S1_S3 1 100 0 255 ECU_ADDRESS 0xFFF8979A DISPLAY_IDENTIFIER n_EngSubSts.EngineSignals /end MEASUREMENT
/begin MEASUREMENT EngineSignals.st_EngOn "status engine on for SBW [shift by wire] 0=off 1=on 2=standby" UBYTE SBW_STANDARD_S1_S3 1 100 0 2 ECU_ADDRESS 0xFFF89798 DISPLAY_IDENTIFIER st_EngOn.EngineSignals /end MEASUREMENT
/begin MEASUREMENT EngineSignals.st_EngOn_Old "status engine on for SBW from last cycle 0=off 1=on 2=standby" UBYTE SBW_STANDARD_S1_S3 1 100 0 2 ECU_ADDRESS 0xFFF89799 DISPLAY_IDENTIFIER st_EngOn_Old.EngineSignals /end MEASUREMENT
/begin MEASUREMENT EngineSignals.tmr_DebounceGearboxReady.f_IsExpired "test_timer" UBYTE SBW_STANDARD_S1_S3 1 100 0 255 ECU_ADDRESS 0xFFF89795 DISPLAY_IDENTIFIER f_IsExpired.tmr_DebounceGearboxReady.EngineSignals /end MEASUREMENT
/begin MEASUREMENT EngineSignals.tmr_DebounceGearboxReady.time "test_timer" UBYTE SBW_TIMER_10MS_S1_S3 1 100 0 2550 ECU_ADDRESS 0xFFF89794 DISPLAY_IDENTIFIER time.tmr_DebounceGearboxReady.EngineSignals /end MEASUREMENT
/begin MEASUREMENT EngineSignals.tmr_DebounceGearboxReadySts.f_IsExpired "test_timer" UBYTE SBW_STANDARD_S1_S3 1 100 0 255 ECU_ADDRESS 0xFFF89797 DISPLAY_IDENTIFIER f_IsExpired.tmr_DebounceGearboxReadySts.EngineSignals /end MEASUREMENT
/begin MEASUREMENT EngineSignals.tmr_DebounceGearboxReadySts.time "test_timer" UBYTE SBW_TIMER_10MS_S1_S3 1 100 0 2550 ECU_ADDRESS 0xFFF89796 DISPLAY_IDENTIFIER time.tmr_DebounceGearboxReadySts.EngineSignals /end MEASUREMENT
/begin MEASUREMENT Ews4Measure.cnt_NrOfMissingResponses "counter for missing responses - timeouts - after sending a TCU challenge / used for switching CAN-path" UBYTE SBW_STANDARD_S1_S3 1 100 0 1 ECU_ADDRESS 0xFFF89916 DISPLAY_IDENTIFIER cnt_NrOfMissingResponses.Ews4Measure /end MEASUREMENT
/begin MEASUREMENT Ews4Measure.cnt_TASCASReq "counter for TAS-CAS requests transmitted by EGS" UBYTE SBW_STANDARD_S1_S3 1 100 0 255 ECU_ADDRESS 0xFFF89919 DISPLAY_IDENTIFIER cnt_TASCASReq.Ews4Measure /end MEASUREMENT
/begin MEASUREMENT Ews4Measure.cnt_saved_eewrite_update_val "saved eeprom-based counter value for successful eeprom-writing-events" ULONG SBW_STANDARD_S1_S3 1 100 0 4294967295 ECU_ADDRESS 0xFFF89910 DISPLAY_IDENTIFIER cnt_saved_eewrite_update_val.Ews4Measure /end MEASUREMENT
/begin MEASUREMENT Ews4Measure.f_FSCSignature_NonAuthentical "flag telling if check of FSC signature returned non-authentical or not" UBYTE SBW_STANDARD_S1_S3 1 100 0 1 BIT_MASK 0x1 ECU_ADDRESS 0xFFF8991B DISPLAY_IDENTIFIER f_FSCSignature_NonAuthentical.Ews4Measure /end MEASUREMENT
/begin MEASUREMENT Ews4Measure.f_at_least_one_nonauth_rsp_rxd "flag signalling that at least one non-authentical response was receveid from DME" UBYTE SBW_STANDARD_S1_S3 1 100 0 1 BIT_MASK 0x1 ECU_ADDRESS 0xFFF89918 DISPLAY_IDENTIFIER f_at_least_one_nonauth_rsp_rxd.Ews4Measure /end MEASUREMENT
/begin MEASUREMENT Ews4Measure.f_client_enabled "flag f. ST of chall./KF - relates directly to st_Ews4!=0: true=CLIENT ENABLED false=CLIENT BLOCKED" UBYTE SBW_STANDARD_S1_S3 1 100 0 1 BIT_MASK 0x1 ECU_ADDRESS 0xFFF89909 DISPLAY_IDENTIFIER f_client_enabled.Ews4Measure /end MEASUREMENT
/begin MEASUREMENT Ews4Measure.f_rsp_nonauthentic "flag for checking on authentical response" UBYTE SBW_STANDARD_S1_S3 1 100 0 1 BIT_MASK 0x1 ECU_ADDRESS 0xFFF8990A DISPLAY_IDENTIFIER f_rsp_nonauthentic.Ews4Measure /end MEASUREMENT
/begin MEASUREMENT Ews4Measure.f_switchedCANpath_wait_fIgnOn "flag signalling a can path switch without a following f_IgnOn - step" UBYTE SBW_STANDARD_S1_S3 1 100 0 1 BIT_MASK 0x1 ECU_ADDRESS 0xFFF89917 DISPLAY_IDENTIFIER f_switchedCANpath_wait_fIgnOn.Ews4Measure /end MEASUREMENT
/begin MEASUREMENT Ews4Measure.fsc_check_routine_result "FSC-check-process routine-result for returning back UDS-data" UBYTE SBW_STANDARD_S1_S3 1 100 0 255 ECU_ADDRESS 0xFFF89925 DISPLAY_IDENTIFIER fsc_check_routine_result.Ews4Measure /end MEASUREMENT
/begin MEASUREMENT Ews4Measure.fsc_ews4_actual_date "date of actual checked FSC in MINUTES since 1st Jan 2000" ULONG SBW_STANDARD_S1_S3 1 100 0 4294967295 ECU_ADDRESS 0xFFF89920 DISPLAY_IDENTIFIER fsc_ews4_actual_date.Ews4Measure /end MEASUREMENT
/begin MEASUREMENT Ews4Measure.fsc_ews4_old_date "saved 'old' FSC-date of last authentical FSC in MINUTES since 1st Jan 2000" ULONG SBW_STANDARD_S1_S3 1 100 0 4294967295 ECU_ADDRESS 0xFFF8991C DISPLAY_IDENTIFIER fsc_ews4_old_date.Ews4Measure /end MEASUREMENT
/begin MEASUREMENT Ews4Measure.fsc_ews4_status "FSC-status: C_FscStateNotAvailable:0 C_FscStateVStored:1 C_FscStateAccepted:2 C_FscStateRejected:3" UBYTE SBW_STANDARD_S1_S3 1 100 0 3 ECU_ADDRESS 0xFFF8991A DISPLAY_IDENTIFIER fsc_ews4_status.Ews4Measure /end MEASUREMENT
/begin MEASUREMENT Ews4Measure.rsp_err_cnt_A "error-counter for counting NON-authentical DH-server-responses with SK available" UBYTE SBW_STANDARD_S1_S3 1 100 0 255 ECU_ADDRESS 0xFFF8990C DISPLAY_IDENTIFIER rsp_err_cnt_A.Ews4Measure /end MEASUREMENT
/begin MEASUREMENT Ews4Measure.rsp_err_cnt_B "error-counter for counting NON-authentical DH-server-responses with SK available / after calc. SK" UBYTE SBW_STANDARD_S1_S3 1 100 0 255 ECU_ADDRESS 0xFFF8990D DISPLAY_IDENTIFIER rsp_err_cnt_B.Ews4Measure /end MEASUREMENT
/begin MEASUREMENT Ews4Measure.rsp_err_cnt_C "error-counter for counting DH-server-responses without SK available" UBYTE SBW_STANDARD_S1_S3 1 100 0 255 ECU_ADDRESS 0xFFF8990B DISPLAY_IDENTIFIER rsp_err_cnt_C.Ews4Measure /end MEASUREMENT
/begin MEASUREMENT Ews4Measure.rsp_ok_cnt "ok-counter for counting rxd authentical DH-server-responses with SK available / after calc. SK" UBYTE SBW_STANDARD_S1_S3 1 100 0 255 ECU_ADDRESS 0xFFF8990E DISPLAY_IDENTIFIER rsp_ok_cnt.Ews4Measure /end MEASUREMENT
/begin MEASUREMENT Ews4Measure.st_Ews4 "state of immobilizer EWS4: 0 = blocked 1 = free 2 = init" UBYTE SBW_STANDARD_S1_S3 1 100 0 2 ECU_ADDRESS 0xFFF89904 DISPLAY_IDENTIFIER st_Ews4.Ews4Measure /end MEASUREMENT
/begin MEASUREMENT Ews4Measure.st_Ews4IntSub "internal EWS4-sub-state in state-machine -exists only once for all substates-" UBYTE SBW_STANDARD_S1_S3 1 100 0 255 ECU_ADDRESS 0xFFF89907 DISPLAY_IDENTIFIER st_Ews4IntSub.Ews4Measure /end MEASUREMENT
/begin MEASUREMENT Ews4Measure.st_Ews4Internal "internal EWS4-state in state-machine" UBYTE SBW_STANDARD_S1_S3 1 100 0 255 ECU_ADDRESS 0xFFF89906 DISPLAY_IDENTIFIER st_Ews4Internal.Ews4Measure /end MEASUREMENT
/begin MEASUREMENT Ews4Measure.st_Ews4StoreEE "internal state of storing EWS4 EEPROM-values" UBYTE SBW_STANDARD_S1_S3 1 100 0 255 ECU_ADDRESS 0xFFF89914 DISPLAY_IDENTIFIER st_Ews4StoreEE.Ews4Measure /end MEASUREMENT
/begin MEASUREMENT Ews4Measure.st_Ews4_ChRspKf_TYP_ST "type- and state-infos in challenge/response/keyfactor" UBYTE SBW_STANDARD_S1_S3 1 100 0 255 ECU_ADDRESS 0xFFF89905 DISPLAY_IDENTIFIER st_Ews4_ChRspKf_TYP_ST.Ews4Measure /end MEASUREMENT
/begin MEASUREMENT Ews4Measure.st_FSC_Active "FSC-activity-status for FSC-UDS-jobs in EWS4-internal state-machine: 0:passive 1:store 2:check" UBYTE SBW_STANDARD_S1_S3 1 100 0 2 ECU_ADDRESS 0xFFF89924 DISPLAY_IDENTIFIER st_FSC_Active.Ews4Measure /end MEASUREMENT
/begin MEASUREMENT Ews4Measure.st_actual_CAN_ch "actual CAN-bus selected by EWS4: 1:A-CAN 2:FA-CAN 0xff:no CAN avail" UBYTE SBW_STANDARD_S1_S3 1 100 0 255 ECU_ADDRESS 0xFFF89908 DISPLAY_IDENTIFIER st_actual_CAN_ch.Ews4Measure /end MEASUREMENT
/begin MEASUREMENT Ews4Measure.st_crypto_fctn_call "function-call-status for calling DH-exp.- and MD5-crypto-fctn: 0:start fctn. 1: poll result" UBYTE SBW_STANDARD_S1_S3 1 100 0 1 ECU_ADDRESS 0xFFF89915 DISPLAY_IDENTIFIER st_crypto_fctn_call.Ews4Measure /end MEASUREMENT
/begin MEASUREMENT Ews4Measure.uwb_ews4 "byte for ambient-conditions UWB concerning EWS4 error-entry" UBYTE SBW_STANDARD_S1_S3 1 100 0 255 ECU_ADDRESS 0xFFF89926 DISPLAY_IDENTIFIER uwb_ews4.Ews4Measure /end MEASUREMENT
/begin MEASUREMENT FAKT_AUSROLLRS_DBM "" SWORD _CNV_R_R_Umr_1_zu_1_2_CM_S2 1 0 0 500 ECU_ADDRESS 0xFFF8E2BC FORMAT "%2.0" MATRIX_DIM 9 1 1 /end MEASUREMENT
/begin MEASUREMENT FAKT_EM_POT_REKUP_BAB "" UBYTE _CNV_R_R_Umr_1_zu_1_30_CM_S2 1 0 0 100 ECU_ADDRESS 0xFFF8EBE3 FORMAT "%2.0" /end MEASUREMENT
/begin MEASUREMENT FAKT_GK0_FDYN "" UBYTE _CNV_R_R_Umr_1_zu_1_30_CM_S2 1 0 0 100 ECU_ADDRESS 0xFFF8E919 FORMAT "%2.0" /end MEASUREMENT
/begin MEASUREMENT FAKT_GK0_FDYN_SS "" UBYTE _CNV_R_R_Umr_1_zu_1_30_CM_S2 1 0 0 100 ECU_ADDRESS 0xFFF8E97F FORMAT "%2.0" /end MEASUREMENT
/begin MEASUREMENT FAKT_HEISSHOCH "" UWORD _CNV_R_R_Umr_1_zu_1_30_CM_S2 1 0 0 250 ECU_ADDRESS 0xFFF8E7E6 FORMAT "%2.0" /end MEASUREMENT
/begin MEASUREMENT FAKT_M_MOTDYNGEW_HKOR "" UBYTE _CNV_R_R_Umr_1_zu_1_30_CM_S2 1 0 0 100 ECU_ADDRESS 0xFFF8EA6D FORMAT "%2.0" /end MEASUREMENT
/begin MEASUREMENT FAKT_M_MOTDYNGEW_HKOR_ZKA "" UBYTE _CNV_R_R_Umr_1_zu_1_30_CM_S2 1 0 0 200 ECU_ADDRESS 0xFFF8EBC2 FORMAT "%2.0" /end MEASUREMENT
/begin MEASUREMENT FAKT_M_MOTDYNMIN_HKOR "" UBYTE _CNV_R_R_Umr_1_zu_1_30_CM_S2 1 0 0 100 ECU_ADDRESS 0xFFF8EA6E FORMAT "%2.0" /end MEASUREMENT
/begin MEASUREMENT FAKT_M_MOTDYN_HKOR "" UBYTE _CNV_R_R_Umr_1_zu_1_30_CM_S2 1 0 0 100 ECU_ADDRESS 0xFFF8EA6F FORMAT "%2.0" /end MEASUREMENT
/begin MEASUREMENT FAKT_N_MOTABREGEL_MDS "" UBYTE _CNV_R_R_Umr_1_zu_1_30_CM_S2 1 0 100 115 ECU_ADDRESS 0xFFF8EB3C FORMAT "%2.0" /end MEASUREMENT
/begin MEASUREMENT FAKT_RADKOMP "" SWORD _CNV_R_R_Umr_1_zu_1_30_CM_S2 1 0 -32768 32767 ECU_ADDRESS 0xFFF8E680 FORMAT "%2.0" /end MEASUREMENT
/begin MEASUREMENT FAKT_SOC_NMOTMAXRS_BAB "" UBYTE _CNV_R_R_Umr_100_zu_42_CM_S2 1 0 0 1 ECU_ADDRESS 0xFFF8EBE5 FORMAT "%4.2" /end MEASUREMENT
/begin MEASUREMENT FASReq2Pos.PosDrvAssistRaw_Trig "trigger signal [default=0 / =8:PosP 7:PosR 6:PosN 5:PosD if signal-edge] of PosDrvAssistRaw" UBYTE SBW_STANDARD_S1_S3 1 100 0 8 ECU_ADDRESS 0xFFF898A9 DISPLAY_IDENTIFIER PosDrvAssistRaw_Trig.FASReq2Pos /end MEASUREMENT
/begin MEASUREMENT FASReq2Pos.PosFASReq "EGS-computed Position request from FAS: PMA or RCP from ICM-ECU via CAN" UBYTE SBW_STANDARD_S1_S3 1 100 0 8 ECU_ADDRESS 0xFFF898AA DISPLAY_IDENTIFIER PosFASReq.FASReq2Pos /end MEASUREMENT
/begin MEASUREMENT FASReq2Pos.f_DrvAssistPosModeErr "FAS- pos-/mode-sig.status error-flag" UBYTE SBW_STANDARD_S1_S3 1 100 0 1 BIT_MASK 0x1 ECU_ADDRESS 0xFFF898A6 DISPLAY_IDENTIFIER f_DrvAssistPosModeErr.FASReq2Pos /end MEASUREMENT
/begin MEASUREMENT FASReq2Pos.f_NoDrvAssist "FAS-mode deactivation-flag" UBYTE SBW_STANDARD_S1_S3 1 100 0 1 BIT_MASK 0x1 ECU_ADDRESS 0xFFF898A5 DISPLAY_IDENTIFIER f_NoDrvAssist.FASReq2Pos /end MEASUREMENT
/begin MEASUREMENT FASReq2Pos.f_NoDrvAssist_ViaSubstFunct "flag signaling deactivation of EH-subst.fctn signals [DI_ GET_ALL_SUBST_FUNCT DI_ GET_ALL_SUBST_FUNCT_HI] via appl.switch SWI_NoDrvAssist_ViaSubstFunct or SWI_NoDrvAssist_ViaSubstFunct_Hi" UBYTE SBW_STANDARD_S1_S3 1 100 0 1 BIT_MASK 0x1 ECU_ADDRESS 0xFFF898A4 DISPLAY_IDENTIFIER f_NoDrvAssist_ViaSubstFunct.FASReq2Pos /end MEASUREMENT
/begin MEASUREMENT FASReq2Pos.st_ModeDrvAssistTrans "status for EGS-FAS-mode [1=PMA/RCP-requests allowed and possible]" UBYTE SBW_STANDARD_S1_S3 1 100 0 2 ECU_ADDRESS 0xFFF898A7 DISPLAY_IDENTIFIER st_ModeDrvAssistTrans.FASReq2Pos /end MEASUREMENT
/begin MEASUREMENT FASReq2Pos.st_ModeDrvAssistTrans_ "bit complement of status st_ModeDrvAssistTrans for EGS-FAS-mode" UBYTE SBW_STANDARD_S1_S3 1 100 0 255 ECU_ADDRESS 0xFFF898A8 DISPLAY_IDENTIFIER st_ModeDrvAssistTrans_.FASReq2Pos /end MEASUREMENT
/begin MEASUREMENT FILTGEW_IN_DYNDZM_UEBLEND "" UWORD _CNV_R_R_Umr_1_zu_1_6_CM_S2 1 0 0 65535 ECU_ADDRESS 0xFFF86784 FORMAT "%2.0" /end MEASUREMENT
/begin MEASUREMENT FILTGEW_OUT_DYNDZM_UEBLEND "" UWORD _CNV_R_R_Umr_1_zu_1_6_CM_S2 1 0 0 65535 ECU_ADDRESS 0xFFF86786 FORMAT "%2.0" /end MEASUREMENT
/begin MEASUREMENT FP_DIR_HSURE "" UBYTE _CNV_S_2_Enum_EFP_D_101_CM_S2 1 0 0 1 ECU_ADDRESS 0xFFF8EA90 /end MEASUREMENT
/begin MEASUREMENT FUNKINIT_DONE_BABLOG "" UBYTE _CNV_P_2_A_I_5_CM_S2 1 0 0 255 ECU_ADDRESS 0xFFF8E9EA /end MEASUREMENT
/begin MEASUREMENT FUNKINIT_DONE_BABSIG "" UBYTE _CNV_P_2_A_I_5_CM_S2 1 0 0 255 ECU_ADDRESS 0xFFF8E9EB /end MEASUREMENT
/begin MEASUREMENT FUNKINIT_DONE_BERGANH "" UBYTE _CNV_R_R_Umr_1_zu_1_2_CM_S2 1 0 0 255 ECU_ADDRESS 0xFFF8E9F1 FORMAT "%2.0" /end MEASUREMENT
/begin MEASUREMENT FUNKINIT_DONE_DKFILT "" UBYTE _CNV_R_R_Umr_1_zu_1_2_CM_S2 1 0 0 255 ECU_ADDRESS 0xFFF8E8B7 FORMAT "%2.0" /end MEASUREMENT
/begin MEASUREMENT FUNKINIT_DONE_DMRS "" UBYTE _CNV_R_R_Umr_1_zu_1_2_CM_S2 1 0 0 255 ECU_ADDRESS 0xFFF8EA19 FORMAT "%2.0" /end MEASUREMENT
/begin MEASUREMENT FUNKINIT_DONE_DYNDZMEGS "" UBYTE _CNV_R_R_Umr_1_zu_1_2_CM_S2 1 0 0 1 ECU_ADDRESS 0xFFF8EA27 /end MEASUREMENT
/begin MEASUREMENT FUNKINIT_DONE_DYNHSPV "" UBYTE _CNV_P_2_A_I_5_CM_S2 1 0 0 255 ECU_ADDRESS 0xFFF8EB57 /end MEASUREMENT
/begin MEASUREMENT FUNKINIT_DONE_FAHRWIDERSTAND "" UBYTE _CNV_P_2_A_I_5_CM_S2 1 0 0 255 ECU_ADDRESS 0xFFF8EA4A /end MEASUREMENT
/begin MEASUREMENT FUNKINIT_DONE_FFG "" UBYTE _CNV_R_R_Umr_1_zu_1_2_CM_S2 1 0 0 255 ECU_ADDRESS 0xFFF8E8B8 FORMAT "%2.0" /end MEASUREMENT
/begin MEASUREMENT FUNKINIT_DONE_FT "" UBYTE _CNV_R_R_Umr_1_zu_1_2_CM_S2 1 0 0 255 ECU_ADDRESS 0xFFF8EBFD FORMAT "%2.0" /end MEASUREMENT
/begin MEASUREMENT FUNKINIT_DONE_GNTMED "" UBYTE _CNV_P_2_A_I_5_CM_S2 1 0 0 255 ECU_ADDRESS 0xFFF8EA62 /end MEASUREMENT
/begin MEASUREMENT FUNKINIT_DONE_HKOR "" UBYTE _CNV_R_R_Umr_1_zu_1_2_CM_S2 1 0 0 255 ECU_ADDRESS 0xFFF8EA69 FORMAT "%2.0" /end MEASUREMENT
/begin MEASUREMENT FUNKINIT_DONE_KOMP "" UBYTE _CNV_P_2_A_I_5_CM_S2 1 0 0 255 ECU_ADDRESS 0xFFF8EA9E /end MEASUREMENT
/begin MEASUREMENT FUNKINIT_DONE_KURVE "" UBYTE _CNV_R_R_Umr_1_zu_1_2_CM_S2 1 0 0 255 ECU_ADDRESS 0xFFF8EAA3 FORMAT "%2.0" /end MEASUREMENT
/begin MEASUREMENT FUNKINIT_DONE_MABERK "" UBYTE _CNV_P_2_A_I_5_CM_S2 1 0 0 255 ECU_ADDRESS 0xFFF8EB25 /end MEASUREMENT
/begin MEASUREMENT FUNKINIT_DONE_MMOTFWFILT "" UBYTE _CNV_R_R_Umr_1_zu_1_2_CM_S2 1 0 0 1 ECU_ADDRESS 0xFFF8EA6A FORMAT "%2.0" /end MEASUREMENT
/begin MEASUREMENT FUNKINIT_DONE_SIGNALPOOL "" UBYTE _CNV_R_R_Umr_1_zu_1_2_CM_S2 1 0 0 255 ECU_ADDRESS 0xFFF8EA03 FORMAT "%2.0" /end MEASUREMENT
/begin MEASUREMENT FUNKINIT_DONE_STOPGO "" UBYTE _CNV_R_R_Umr_1_zu_1_2_CM_S2 1 0 0 255 ECU_ADDRESS 0xFFF8EBA5 FORMAT "%2.0" /end MEASUREMENT
/begin MEASUREMENT FUNKINIT_DONE_VFZG "" UBYTE _CNV_R_R_Umr_1_zu_1_2_CM_S2 1 0 0 255 ECU_ADDRESS 0xFFF8EA04 FORMAT "%2.0" /end MEASUREMENT
/begin MEASUREMENT FUNKINIT_DONE_VMMOTFILT "" UBYTE _CNV_R_R_Umr_1_zu_1_2_CM_S2 1 0 0 1 ECU_ADDRESS 0xFFF8EA6B FORMAT "%2.0" /end MEASUREMENT
/begin MEASUREMENT FUNKINIT_DONE_WL "" UBYTE _CNV_R_R_Umr_1_zu_1_2_CM_S2 1 0 0 255 ECU_ADDRESS 0xFFF8EBB8 FORMAT "%2.0" /end MEASUREMENT
/begin MEASUREMENT FUNKINIT_DONE_WL2 "" UBYTE _CNV_R_R_Umr_1_zu_1_2_CM_S2 1 0 0 1 ECU_ADDRESS 0xFFF8EBB5 FORMAT "%2.0" /end MEASUREMENT
/begin MEASUREMENT F_DK_INGEW "" UWORD _CNV_R_R_Umr_1_zu_1_2_CM_S2 1 0 0 1000 ECU_ADDRESS 0xFFF8E224 FORMAT "%2.0" /end MEASUREMENT
/begin MEASUREMENT F_DK_OUTGEW "" UWORD _CNV_R_R_Umr_1_zu_1_2_CM_S2 1 0 0 1000 ECU_ADDRESS 0xFFF8E226 FORMAT "%2.0" /end MEASUREMENT
/begin MEASUREMENT F_FWS_TEMP "" UWORD _CNV_R_R_Umr_1_zu_1_30_CM_S2 1 0 0 250 ECU_ADDRESS 0xFFF8E4FE FORMAT "%2.0" /end MEASUREMENT
/begin MEASUREMENT G2W_AB "" SWORD _CNV_R_R_Umr_10_zu__138_CM_S2 1 0 -3276.8 3276.7 ECU_ADDRESS 0xFFF8E59E FORMAT "%3.1" /end MEASUREMENT
/begin MEASUREMENT G2W_AB_BUFFER "" SWORD _CNV_R_R_Umr_10_zu__138_CM_S2 1 0 -3276.8 3276.7 ECU_ADDRESS 0xFFF8EF50 FORMAT "%3.1" MATRIX_DIM 10 1 1 /end MEASUREMENT
/begin MEASUREMENT G2W_AB_DYNHSPV "" SWORD _CNV_R_R_Umr_10_zu__138_CM_S2 1 0 -3276.8 3276.7 ECU_ADDRESS 0xFFF8E73C FORMAT "%3.1" /end MEASUREMENT
/begin MEASUREMENT G2W_AB_FILT "" SWORD _CNV_R_R_Umr_10_zu__138_CM_S2 1 0 -3276.8 3276.7 ECU_ADDRESS 0xFFF8E5A0 FORMAT "%3.1" /end MEASUREMENT
/begin MEASUREMENT G2W_AB_FILTMARSREST "" SWORD _CNV_R_R_Umr_1_zu_1_2_CM_S2 1 0 -32767 32767 ECU_ADDRESS 0xFFF8E5A2 FORMAT "%2.0" /end MEASUREMENT
/begin MEASUREMENT G2W_AB_FILTREST "" SWORD _CNV_R_R_Umr_1_zu_1_2_CM_S2 1 0 -32767 32767 ECU_ADDRESS 0xFFF8E5A4 FORMAT "%2.0" /end MEASUREMENT
/begin MEASUREMENT G2W_AB_FILT_MARS "" SWORD _CNV_R_R_Umr_10_zu__138_CM_S2 1 0 -3276.8 3276.7 ECU_ADDRESS 0xFFF8E5A6 FORMAT "%3.1" /end MEASUREMENT
/begin MEASUREMENT G2W_AB_FWSFILT "" SWORD _CNV_R_R_Umr_10_zu__138_CM_S2 1 0 -3276.8 3276.7 ECU_ADDRESS 0xFFF8E5A8 FORMAT "%3.1" /end MEASUREMENT
/begin MEASUREMENT G2W_AB_FWSFILTALT "" SWORD _CNV_R_R_Umr_10_zu__138_CM_S2 1 0 -3276.8 3276.7 ECU_ADDRESS 0xFFF8E500 FORMAT "%3.1" /end MEASUREMENT
/begin MEASUREMENT G2W_AB_FWSFILTREST "" SWORD _CNV_R_R_Umr_1_zu_1_2_CM_S2 1 0 -32767 32767 ECU_ADDRESS 0xFFF8E5AA FORMAT "%2.0" /end MEASUREMENT
/begin MEASUREMENT G2W_AB_MED "" SWORD _CNV_R_R_Umr_10_zu__138_CM_S2 1 0 -3276.8 3276.7 ECU_ADDRESS 0xFFF8E5AC FORMAT "%3.1" /end MEASUREMENT
/begin MEASUREMENT G2W_AB_REFDYNHSPV "" SWORD _CNV_R_R_Umr_10_zu__138_CM_S2 1 0 -3276.8 3276.7 ECU_ADDRESS 0xFFF8E73E FORMAT "%3.1" /end MEASUREMENT
/begin MEASUREMENT G2W_AB_SUMME "" SLONG _CNV_R_R_Umr_10_zu__138_CM_S2 1 0 -214748364.7 214748364.7 ECU_ADDRESS 0xFFF8EF78 FORMAT "%3.1" /end MEASUREMENT
/begin MEASUREMENT G3W_AB_FWSFILT "" SWORD _CNV_R_R_Umr_10_zu__241_CM_S2 1 0 -3276.8 3276.7 ECU_ADDRESS 0xFFF8E502 /end MEASUREMENT
/begin MEASUREMENT GANG_SPRUNG_TIPP "" UBYTE _CNV_R_R_Umr_1_zu_1_2_CM_S2 1 0 0 255 ECU_ADDRESS 0xFFF8E9C2 /end MEASUREMENT
/begin MEASUREMENT GDM_RAD_KOMP "" SLONG _CNV_R_R_Umr_1_zu_1_2_CM_S2 1 0 -2147483648 2147483647 ECU_ADDRESS 0xFFF8F064 FORMAT "%5.3" /end MEASUREMENT
/begin MEASUREMENT GEW_NTNAB_SCHALT_DYNHSPV "" UWORD _CNV_R_R_Umr_1_zu_1_2_CM_S2 1 0 0 1000 ECU_ADDRESS 0xFFF8E740 FORMAT "%2.0" /end MEASUREMENT
/begin MEASUREMENT GEW_N_MOTTUR_DYNHSPV "" UBYTE _CNV_R_R_Umr_1_zu_1_30_CM_S2 1 0 0 250 ECU_ADDRESS 0xFFF8EB58 FORMAT "%4.2" /end MEASUREMENT
/begin MEASUREMENT GEW_N_TURRAD_DYNHSPV "" UBYTE _CNV_R_R_Umr_1_zu_1_30_CM_S2 1 0 0 250 ECU_ADDRESS 0xFFF8EB59 FORMAT "%4.2" /end MEASUREMENT
/begin MEASUREMENT GM_LDM_SOLL "" SWORD _CNV_R_R_Umr_1_zu_1_62_CM_S2 1 0 -68266 68266 ECU_ADDRESS 0xFFF8E70A FORMAT "%2.0" /end MEASUREMENT
/begin MEASUREMENT GM_LDM_SOLL_FILT "" SWORD _CNV_R_R_Umr_1_zu_1_62_CM_S2 1 0 -68266 68266 ECU_ADDRESS 0xFFF8E70C FORMAT "%2.0" /end MEASUREMENT
/begin MEASUREMENT GM_LDM_SOLL_FILTREST "" SWORD _CNV_R_R_Umr_1_zu_1_62_CM_S2 1 0 -68266 68266 ECU_ADDRESS 0xFFF8E70E FORMAT "%2.0" /end MEASUREMENT
/begin MEASUREMENT GM_MOT_FW_FILT "" SWORD _CNV_R_R_Umr_1_zu_1_2_CM_S2 1 0 -32768 32767 ECU_ADDRESS 0xFFF8E5F6 FORMAT "%2.0" /end MEASUREMENT
/begin MEASUREMENT GN_EM "" SWORD _CNV_R_R_Umr_10_zu__138_CM_S2 1 0 -2000 2000 ECU_ADDRESS 0xFFF8E5B2 FORMAT "%3.1" /end MEASUREMENT
/begin MEASUREMENT GN_MOT "" SWORD _CNV_R_R_Umr_10_zu__138_CM_S2 1 0 -2000 2000 ECU_ADDRESS 0xFFF8E5B8 FORMAT "%3.1" /end MEASUREMENT
/begin MEASUREMENT GN_MT "" SWORD _CNV_R_R_Umr_100_zu_194_CM_S2 1 0 -327.68 327.67 ECU_ADDRESS 0xFFF8E742 FORMAT "%4.2" /end MEASUREMENT
/begin MEASUREMENT GN_MTTRAD "" SWORD _CNV_R_R_Umr_100_zu_194_CM_S2 1 0 -327.68 327.67 ECU_ADDRESS 0xFFF8E744 FORMAT "%4.2" /end MEASUREMENT
/begin MEASUREMENT GN_MTTRAD_FILT "" SWORD _CNV_R_R_Umr_100_zu_194_CM_S2 1 0 -327.68 327.67 ECU_ADDRESS 0xFFF8E746 FORMAT "%4.2" /end MEASUREMENT
/begin MEASUREMENT GN_MTTRAD_FILT1 "" SWORD _CNV_R_R_Umr_100_zu_194_CM_S2 1 0 -327.68 327.67 ECU_ADDRESS 0xFFF8E748 FORMAT "%4.2" /end MEASUREMENT
/begin MEASUREMENT GN_MTTRAD_FILT2 "" SWORD _CNV_R_R_Umr_100_zu_194_CM_S2 1 0 -327.68 327.67 ECU_ADDRESS 0xFFF8E74A FORMAT "%4.2" /end MEASUREMENT
/begin MEASUREMENT GN_MTTRAD_FILTKOR "" SWORD _CNV_R_R_Umr_100_zu_194_CM_S2 1 0 -327.68 327.67 ECU_ADDRESS 0xFFF8E74C FORMAT "%4.2" /end MEASUREMENT
/begin MEASUREMENT GN_MTTRAD_PT1TRAEG "" UBYTE _CNV_R_R_Umr_100_zu_42_CM_S2 1 0 0 2 ECU_ADDRESS 0xFFF8EB5A FORMAT "%4.2" /end MEASUREMENT
/begin MEASUREMENT GN_MTTRAD_PT1VERST "" UBYTE _CNV_R_R_Umr_100_zu_42_CM_S2 1 0 0 2 ECU_ADDRESS 0xFFF8EB5B FORMAT "%4.2" /end MEASUREMENT
/begin MEASUREMENT GN_T "" SWORD _CNV_R_R_Umr_100_zu_194_CM_S2 1 0 -327.68 327.67 ECU_ADDRESS 0xFFF8E5BE FORMAT "%4.2" /end MEASUREMENT
/begin MEASUREMENT GN_TNAB "" SWORD _CNV_R_R_Umr_100_zu_194_CM_S2 1 0 -327.68 327.67 ECU_ADDRESS 0xFFF8E74E FORMAT "%4.2" /end MEASUREMENT
/begin MEASUREMENT GN_TRAD "" SWORD _CNV_R_R_Umr_100_zu_194_CM_S2 1 0 -327.68 327.67 ECU_ADDRESS 0xFFF8E750 FORMAT "%4.2" /end MEASUREMENT
/begin MEASUREMENT GN_T_FILT "" SWORD _CNV_R_R_Umr_100_zu_194_CM_S2 1 0 -327.68 327.67 ECU_ADDRESS 0xFFF8E5C0 FORMAT "%4.2" /end MEASUREMENT
/begin MEASUREMENT GN_T_FILTREST "" SWORD _CNV_R_R_Umr_100_zu_42_CM_S2 1 0 -327.68 327.67 ECU_ADDRESS 0xFFF8E5C2 FORMAT "%4.2" /end MEASUREMENT
/begin MEASUREMENT GN_T_MED "" SWORD _CNV_R_R_Umr_100_zu_194_CM_S2 1 0 -327.68 327.67 ECU_ADDRESS 0xFFF8E5C4 FORMAT "%4.2" /end MEASUREMENT
/begin MEASUREMENT GN_T_MEDBUFFER "" SWORD _CNV_R_R_Umr_100_zu_194_CM_S2 1 0 -327.68 327.67 ECU_ADDRESS 0xFFF8E5C6 FORMAT "%4.2" MATRIX_DIM 17 1 1 /end MEASUREMENT
/begin MEASUREMENT GN_VM "" SWORD _CNV_R_R_Umr_10_zu__138_CM_S2 1 0 -2000 2000 ECU_ADDRESS 0xFFF8E5E8 FORMAT "%3.1" /end MEASUREMENT
/begin MEASUREMENT GWFPFILTHSURE_ALT_DECR "" SWORD _CNV_R_R_Umr_1_zu_1_110_CM_S2 1 0 -32768 32767 ECU_ADDRESS 0xFFF8E670 FORMAT "%2.0" /end MEASUREMENT
/begin MEASUREMENT GWFP_MAX_HSURE "" SWORD _CNV_R_R_Umr_1_zu_1_7_CM_S2 1 0 -32768 32767 ECU_ADDRESS 0xFFF8E4B6 FORMAT "%2.0" /end MEASUREMENT
/begin MEASUREMENT GW_FP "" SWORD _CNV_R_R_Umr_1_zu_1_7_CM_S2 1 0 -32768 32767 ECU_ADDRESS 0xFFF8E4B8 FORMAT "%2.0" /end MEASUREMENT
/begin MEASUREMENT GW_FPFILT_DMRS "" SWORD _CNV_R_R_Umr_1_zu_1_7_CM_S2 1 0 -32768 32767 ECU_ADDRESS 0xFFF8E47A FORMAT "%2.0" /end MEASUREMENT
/begin MEASUREMENT GW_FPFILT_DMRS_ALT "" SWORD _CNV_R_R_Umr_1_zu_1_7_CM_S2 1 0 -32768 32767 ECU_ADDRESS 0xFFF8E47C FORMAT "%2.0" /end MEASUREMENT
/begin MEASUREMENT GW_FPFILT_DMRS_REST "" SWORD _CNV_R_R_Umr_1_zu_1_7_CM_S2 1 0 -32768 32767 ECU_ADDRESS 0xFFF8E47E FORMAT "%2.0" /end MEASUREMENT
/begin MEASUREMENT GW_FP_ALTFWS "" SWORD _CNV_R_R_Umr_1_zu_1_7_CM_S2 1 0 -32768 32767 ECU_ADDRESS 0xFFF8E504 FORMAT "%2.0" /end MEASUREMENT
/begin MEASUREMENT GW_FP_FILT "" SWORD _CNV_R_R_Umr_1_zu_1_7_CM_S2 1 0 -32768 32767 ECU_ADDRESS 0xFFF8E4BA FORMAT "%2.0" /end MEASUREMENT
/begin MEASUREMENT GW_FP_FILTREST "" SWORD _CNV_R_R_Umr_1_zu_1_7_CM_S2 1 0 -32768 32767 ECU_ADDRESS 0xFFF8E4BC FORMAT "%2.0" /end MEASUREMENT
/begin MEASUREMENT GW_FP_FILTREST_HSURE "" SWORD _CNV_R_R_Umr_1_zu_1_7_CM_S2 1 0 -32768 32767 ECU_ADDRESS 0xFFF8E4BE FORMAT "%2.0" /end MEASUREMENT
/begin MEASUREMENT GW_FP_FILT_HSURE "" SWORD _CNV_R_R_Umr_1_zu_1_7_CM_S2 1 0 -32768 32767 ECU_ADDRESS 0xFFF8E4C0 FORMAT "%2.0" /end MEASUREMENT
/begin MEASUREMENT GW_FP_FILT_HSUREALT "" SWORD _CNV_R_R_Umr_1_zu_1_7_CM_S2 1 0 -32768 32767 ECU_ADDRESS 0xFFF8E632 FORMAT "%2.0" /end MEASUREMENT
/begin MEASUREMENT GW_FP_FILT_HSUREREF "" SWORD _CNV_R_R_Umr_1_zu_1_7_CM_S2 1 0 -32768 32767 ECU_ADDRESS 0xFFF8E612 FORMAT "%2.0" /end MEASUREMENT
/begin MEASUREMENT GW_FP_FILT_REST_SPA "" SWORD _CNV_R_R_Umr_1_zu_1_7_CM_S2 1 0 -32768 32767 ECU_ADDRESS 0xFFF8E7C4 FORMAT "%2.0" /end MEASUREMENT
/begin MEASUREMENT GW_FP_FILT_SPA "" SWORD _CNV_R_R_Umr_1_zu_1_7_CM_S2 1 0 -32768 32767 ECU_ADDRESS 0xFFF8E7C6 FORMAT "%2.0" /end MEASUREMENT
/begin MEASUREMENT GW_FP_MAX "" SWORD _CNV_R_R_Umr_1_zu_1_7_CM_S2 1 0 -32768 32767 ECU_ADDRESS 0xFFF8E878 FORMAT "%2.0" /end MEASUREMENT
/begin MEASUREMENT GW_FP_MAXBUFFER "" SWORD _CNV_R_R_Umr_1_zu_1_7_CM_S2 1 0 -32768 32767 ECU_ADDRESS 0xFFF8EEA4 FORMAT "%2.0" MATRIX_DIM 10 1 1 /end MEASUREMENT
/begin MEASUREMENT GW_FP_MAXFILT "" SWORD _CNV_R_R_Umr_1_zu_1_7_CM_S2 1 0 -32768 32767 ECU_ADDRESS 0xFFF8E4C2 FORMAT "%2.0" /end MEASUREMENT
/begin MEASUREMENT GW_FP_MAXKOR "" SWORD _CNV_R_R_Umr_1_zu_1_7_CM_S2 1 0 -32768 32767 ECU_ADDRESS 0xFFF8E874 FORMAT "%2.0" /end MEASUREMENT
/begin MEASUREMENT GW_FP_MAX_QSHIFT1 "" SWORD _CNV_R_R_Umr_1_zu_1_7_CM_S2 1 0 -32768 32767 ECU_ADDRESS 0xFFF8E772 FORMAT "%2.0" /end MEASUREMENT
/begin MEASUREMENT GW_FP_MAX_QSHIFT2 "" SWORD _CNV_R_R_Umr_1_zu_1_7_CM_S2 1 0 -32768 32767 ECU_ADDRESS 0xFFF8E774 FORMAT "%2.0" /end MEASUREMENT
/begin MEASUREMENT GW_GIER "" SWORD _CNV_R_R_Umr_20_zu__148_CM_S2 1 0 -1638.4 1638.35 ECU_ADDRESS 0xFFF8E692 FORMAT "%4.2" /end MEASUREMENT
/begin MEASUREMENT GW_GIER_ROH "" SWORD _CNV_R_R_Umr_1_zu_1_2_CM_S2 1 0 -1638.4 1638.35 ECU_ADDRESS 0xFFF8E366 FORMAT "%4.2" /end MEASUREMENT
/begin MEASUREMENT GearboxState.st_Gearbox "status of gearbox for transmission to other ECUs" UBYTE SBW_STANDARD_S1_S3 1 100 0 15 ECU_ADDRESS 0xFFF893DC DISPLAY_IDENTIFIER st_Gearbox.GearboxState /end MEASUREMENT
/begin MEASUREMENT GlobalSignals.IgnOnSts "signal status ignition" UBYTE SBW_STANDARD_S1_S3 1 100 0 2 ECU_ADDRESS 0xFFF89777 DISPLAY_IDENTIFIER IgnOnSts.GlobalSignals /end MEASUREMENT
/begin MEASUREMENT GlobalSignals.f_AcceleratorPedalPressed "Accelerator Pedal is pressed" UBYTE SBW_STANDARD_S1_S3 1 100 0 1 BIT_MASK 0x1 ECU_ADDRESS 0xFFF89781 DISPLAY_IDENTIFIER f_AcceleratorPedalPressed.GlobalSignals /end MEASUREMENT
/begin MEASUREMENT GlobalSignals.f_BrakePedalSL "Brake signal with fallback" UBYTE SBW_STANDARD_S1_S3 1 100 0 1 BIT_MASK 0x1 ECU_ADDRESS 0xFFF8978D DISPLAY_IDENTIFIER f_BrakePedalSL.GlobalSignals /end MEASUREMENT
/begin MEASUREMENT GlobalSignals.f_FaultFiltDisplay "KFC_INST built of KFC_INSTG1-3" UBYTE SBW_STANDARD_S1_S3 1 100 0 1 BIT_MASK 0x1 ECU_ADDRESS 0xFFF89789 DISPLAY_IDENTIFIER f_FaultFiltDisplay.GlobalSignals /end MEASUREMENT
/begin MEASUREMENT GlobalSignals.f_HotCondReset "oil chip and converter temperatures are under hotmode threshold1" UBYTE SBW_STANDARD_S1_S3 1 100 0 1 BIT_MASK 0x1 ECU_ADDRESS 0xFFF89785 DISPLAY_IDENTIFIER f_HotCondReset.GlobalSignals /end MEASUREMENT
/begin MEASUREMENT GlobalSignals.f_HotCond_1 "oil chip and converter temperatures are above hotmode threshold1" UBYTE SBW_STANDARD_S1_S3 1 100 0 1 BIT_MASK 0x1 ECU_ADDRESS 0xFFF89786 DISPLAY_IDENTIFIER f_HotCond_1.GlobalSignals /end MEASUREMENT
/begin MEASUREMENT GlobalSignals.f_HotCond_2 "oil chip and converter temperatures are above hotmode threshold2" UBYTE SBW_STANDARD_S1_S3 1 100 0 1 BIT_MASK 0x1 ECU_ADDRESS 0xFFF89787 DISPLAY_IDENTIFIER f_HotCond_2.GlobalSignals /end MEASUREMENT
/begin MEASUREMENT GlobalSignals.f_HotCond_3 "oil chip and converter temperatures are above hotmode threshold3" UBYTE SBW_STANDARD_S1_S3 1 100 0 1 BIT_MASK 0x1 ECU_ADDRESS 0xFFF89788 DISPLAY_IDENTIFIER f_HotCond_3.GlobalSignals /end MEASUREMENT
/begin MEASUREMENT GlobalSignals.f_IgnOn "state ignition on/off" UBYTE SBW_STANDARD_S1_S3 1 100 0 1 BIT_MASK 0x1 ECU_ADDRESS 0xFFF89776 DISPLAY_IDENTIFIER f_IgnOn.GlobalSignals /end MEASUREMENT
/begin MEASUREMENT GlobalSignals.f_IgnOn_RisingEdg "state ignition becomes on at present" UBYTE SBW_STANDARD_S1_S3 1 100 0 1 BIT_MASK 0x1 ECU_ADDRESS 0xFFF89778 DISPLAY_IDENTIFIER f_IgnOn_RisingEdg.GlobalSignals /end MEASUREMENT
/begin MEASUREMENT GlobalSignals.f_MechLimp "flag mech. limphome-mode" UBYTE SBW_STANDARD_S1_S3 1 100 0 1 BIT_MASK 0x1 ECU_ADDRESS 0xFFF8977D DISPLAY_IDENTIFIER f_MechLimp.GlobalSignals /end MEASUREMENT
/begin MEASUREMENT GlobalSignals.f_P12BadOp "Flag for bad operation of P12Button after delay timer" UBYTE SBW_STANDARD_S1_S3 1 100 0 1 BIT_MASK 0x1 ECU_ADDRESS 0xFFF8977E DISPLAY_IDENTIFIER f_P12BadOp.GlobalSignals /end MEASUREMENT
/begin MEASUREMENT GlobalSignals.f_P12BadOpOld "Old value of Flag for bad operation" UBYTE SBW_STANDARD_S1_S3 1 100 0 1 BIT_MASK 0x1 ECU_ADDRESS 0xFFF8977F DISPLAY_IDENTIFIER f_P12BadOpOld.GlobalSignals /end MEASUREMENT
/begin MEASUREMENT GlobalSignals.f_P12BadOpTrig "Triggered flag for bad operation" UBYTE SBW_STANDARD_S1_S3 1 100 0 1 BIT_MASK 0x1 ECU_ADDRESS 0xFFF89780 DISPLAY_IDENTIFIER f_P12BadOpTrig.GlobalSignals /end MEASUREMENT
/begin MEASUREMENT GlobalSignals.f_ParkLock "flag parking lock" UBYTE SBW_STANDARD_S1_S3 1 100 0 1 BIT_MASK 0x1 ECU_ADDRESS 0xFFF8977C DISPLAY_IDENTIFIER f_ParkLock.GlobalSignals /end MEASUREMENT
/begin MEASUREMENT GlobalSignals.f_PosChangeByDiag "diagnosis position or auto position changes gearbox position" UBYTE SBW_STANDARD_S1_S3 1 100 0 1 BIT_MASK 0x1 ECU_ADDRESS 0xFFF8978E DISPLAY_IDENTIFIER f_PosChangeByDiag.GlobalSignals /end MEASUREMENT
/begin MEASUREMENT GlobalSignals.f_ResyncNeeded "after communication errors lever must return in middle position / gearbox position to accept new driver request" UBYTE SBW_STANDARD_S1_S3 1 100 0 1 BIT_MASK 0x1 ECU_ADDRESS 0xFFF89782 DISPLAY_IDENTIFIER f_ResyncNeeded.GlobalSignals /end MEASUREMENT
/begin MEASUREMENT GlobalSignals.st_Hotmode "Status for Hotmode 0: oil-temp.o.k. 1:over threshold1 2:over thresh.2" UBYTE SBW_STANDARD_S1_S3 1 100 0 2 ECU_ADDRESS 0xFFF89783 DISPLAY_IDENTIFIER st_Hotmode.GlobalSignals /end MEASUREMENT
/begin MEASUREMENT GlobalSignals.st_Hotmode_pre "preleminary Status for Hotmode 0: oil-temp.o.k. 1:over threshold1 2:over thresh.2" UBYTE SBW_STANDARD_S1_S3 1 100 0 2 ECU_ADDRESS 0xFFF89784 DISPLAY_IDENTIFIER st_Hotmode_pre.GlobalSignals /end MEASUREMENT
/begin MEASUREMENT GlobalSignals.st_SpeedCondD "speed condition for driver request P 0:Accept 1:Store 2:Reject" UBYTE SBW_STANDARD_S1_S3 1 100 0 2 ECU_ADDRESS 0xFFF8978C DISPLAY_IDENTIFIER st_SpeedCondD.GlobalSignals /end MEASUREMENT
/begin MEASUREMENT GlobalSignals.st_SpeedCondP "speed condition for driver request P 0:Accept 1:Store 2:Reject" UBYTE SBW_STANDARD_S1_S3 1 100 0 2 ECU_ADDRESS 0xFFF8978A DISPLAY_IDENTIFIER st_SpeedCondP.GlobalSignals /end MEASUREMENT
/begin MEASUREMENT GlobalSignals.st_SpeedCondR "speed condition for driver request P 0:Accept 1:Store 2:Reject" UBYTE SBW_STANDARD_S1_S3 1 100 0 2 ECU_ADDRESS 0xFFF8978B DISPLAY_IDENTIFIER st_SpeedCondR.GlobalSignals /end MEASUREMENT
/begin MEASUREMENT GlobalSignals.tmr_DebounceOilChipTransErr.f_IsExpired "test_timer" UBYTE SBW_STANDARD_S1_S3 1 100 0 255 ECU_ADDRESS 0xFFF89774 DISPLAY_IDENTIFIER f_IsExpired.tmr_DebounceOilChipTransErr.GlobalSignals /end MEASUREMENT
/begin MEASUREMENT GlobalSignals.tmr_DebounceOilChipTransErr.time "test_timer" UWORD SBW_TIMER_10MS_S1_S3 1 100 0 655350 ECU_ADDRESS 0xFFF89772 DISPLAY_IDENTIFIER time.tmr_DebounceOilChipTransErr.GlobalSignals /end MEASUREMENT
/begin MEASUREMENT GlobalSignals.tmr_P12BadOp.f_IsExpired "test_timer" UBYTE SBW_STANDARD_S1_S3 1 100 0 255 ECU_ADDRESS 0xFFF89771 DISPLAY_IDENTIFIER f_IsExpired.tmr_P12BadOp.GlobalSignals /end MEASUREMENT
/begin MEASUREMENT GlobalSignals.tmr_P12BadOp.time "test_timer" UBYTE SBW_TIMER_10MS_S1_S3 1 100 0 2550 ECU_ADDRESS 0xFFF89770 DISPLAY_IDENTIFIER time.tmr_P12BadOp.GlobalSignals /end MEASUREMENT
/begin MEASUREMENT GlobalSignals.v_VehSpdMin "mimimum of vram_Aktiv and vfz" UWORD SBW_VKMH_16_S1_S3 1 100 0 21.875 ECU_ADDRESS 0xFFF8977A DISPLAY_IDENTIFIER v_VehSpdMin.GlobalSignals /end MEASUREMENT
/begin MEASUREMENT HSUKS_DECRVAL "" UWORD _CNV_R_R_Umr_1_zu_1_2_CM_S2 1 0 0 65535 ECU_ADDRESS 0xFFF8E8AA FORMAT "%2.0" /end MEASUREMENT
/begin MEASUREMENT HSUKS_EIN_FLAG "" UBYTE _CNV_R_R_Umr_1_zu_1_2_CM_S2 1 0 0 255 ECU_ADDRESS 0xFFF8EC17 FORMAT "%2.0" /end MEASUREMENT
/begin MEASUREMENT IAE.Std.CIaeAbstell "EepromStd[3432 ... 3433]: Abstelltemperatur der IAE [(x=1/UMR___1_1_0)]" UWORD UMR_GRADC__1_1_M40_S5_S3 1 100 -40 65495 ECU_ADDRESS 0xFFF81DA0 DISPLAY_IDENTIFIER CIaeAbstell.Std.IAE /end MEASUREMENT
/begin MEASUREMENT IDX_M_VMHYST_K0 "" UBYTE _CNV_R_R_Umr_1_zu_1_2_CM_S2 1 0 0 255 ECU_ADDRESS 0xFFF8EB61 FORMAT "%2.0" /end MEASUREMENT
/begin MEASUREMENT IDX_N_VMHYST_K0 "" UBYTE _CNV_R_R_Umr_1_zu_1_2_CM_S2 1 0 0 255 ECU_ADDRESS 0xFFF8EB62 FORMAT "%2.0" /end MEASUREMENT
/begin MEASUREMENT IDX_XTAB6S_EFAHREN_ERK "" SBYTE _CNV_R_R_Umr_1_zu_1_2_CM_S2 1 0 0 127 ECU_ADDRESS 0xFFF8EA92 /end MEASUREMENT
/begin MEASUREMENT IG_GANG "" UWORD _CNV_R_R_Umr_1000_z_36_CM_S2 1 0 0 20 ECU_ADDRESS 0xFFF8E344 FORMAT "%5.3" MATRIX_DIM 9 1 1 /end MEASUREMENT
/begin MEASUREMENT IG_GANG_SOLLMDS "" UWORD _CNV_R_R_Umr_1000_z_36_CM_S2 1 0 0 10 ECU_ADDRESS 0xFFF8E72A FORMAT "%5.3" /end MEASUREMENT
/begin MEASUREMENT IG_HA "" UWORD _CNV_R_R_Umr_100_zu_42_CM_S2 1 0 1 10 ECU_ADDRESS 0xFFF8E694 FORMAT "%4.2" /end MEASUREMENT
/begin MEASUREMENT IG_HA_ROH "" UWORD _CNV_R_R_Umr_1_zu_1_2_CM_S2 1 0 0 65535 ECU_ADDRESS 0xFFF8E368 /end MEASUREMENT
/begin MEASUREMENT ISMPL_SCHLUPF_GEW "" UWORD _CNV_R_R_Umr_1_zu_1_2_CM_S2 1 0 0 65535 ECU_ADDRESS 0xFFF8E736 FORMAT "%2.0" /end MEASUREMENT
/begin MEASUREMENT I_FAKT_EINFRS "" UWORD _CNV_R_R_Umr_1000_z_36_CM_S2 1 0 0 5 ECU_ADDRESS 0xFFF8E84A FORMAT "%5.3" /end MEASUREMENT
/begin MEASUREMENT I_FAKT_MFRSZ "" UWORD _CNV_R_R_Umr_1000_z_36_CM_S2 1 0 0 5 ECU_ADDRESS 0xFFF8E84C FORMAT "%5.3" /end MEASUREMENT
/begin MEASUREMENT I_GANG_REAL "" UWORD _CNV_R_R_Umr_1000_z_36_CM_S2 1 0 0 20 ECU_ADDRESS 0xFFF8E3D8 FORMAT "%5.3" /end MEASUREMENT
/begin MEASUREMENT I_STRANG "" ULONG _CNV_R_R_Umr_8000_z_63_CM_S2 1 0 0.000125 511 ECU_ADDRESS 0xFFF8F0D4 FORMAT "%6.4" /end MEASUREMENT
/begin MEASUREMENT I_STRANG_NMOT_HSVIRT "" UWORD _CNV_R_R_Umr_80_zu__192_CM_S2 1 0 0.125 511 ECU_ADDRESS 0xFFF8E752 FORMAT "%4.2" /end MEASUREMENT
/begin MEASUREMENT I_STRANG_ROH "" UWORD _CNV_R_R_Umr_1_zu_1_2_CM_S2 1 0 0.000125 511 ECU_ADDRESS 0xFFF8E36A FORMAT "%4.2" /end MEASUREMENT
/begin MEASUREMENT InitPos.PosPRND_Init "position of selection-lever after reset [without intermediate positions]; buffered in PosPRNDBuf" UBYTE SBW_STANDARD_S1_S3 1 100 0 255 ECU_ADDRESS 0xFFF898C5 DISPLAY_IDENTIFIER PosPRND_Init.InitPos /end MEASUREMENT
/begin MEASUREMENT InitPos.f_ResUBatt "flag for recognition of resets in case of undervoltage" UBYTE SBW_STANDARD_S1_S3 1 100 0 1 BIT_MASK 0x1 ECU_ADDRESS 0xFFF898C4 DISPLAY_IDENTIFIER f_ResUBatt.InitPos /end MEASUREMENT
/begin MEASUREMENT InitPosBPRAM.DirBuf "buffered driving direction [with grip/force transmission = Kraftschluss]" UBYTE SBW_STANDARD_S1_S3 1 100 0 255 ECU_ADDRESS 0xFFF835DC DISPLAY_IDENTIFIER DirBuf.InitPosBPRAM /end MEASUREMENT
/begin MEASUREMENT InitPosBPRAM.DirBuf_ "Complement of buffered driving direction [with grip/force transmission = Kraftschluss]" UBYTE SBW_STANDARD_S1_S3 1 100 0 255 ECU_ADDRESS 0xFFF835DD DISPLAY_IDENTIFIER DirBuf_.InitPosBPRAM /end MEASUREMENT
/begin MEASUREMENT InitPosBPRAM.PosPRNDBuf "buffered PosPRND" UBYTE SBW_STANDARD_S1_S3 1 100 0 255 ECU_ADDRESS 0xFFF835D8 DISPLAY_IDENTIFIER PosPRNDBuf.InitPosBPRAM /end MEASUREMENT
/begin MEASUREMENT InitPosBPRAM.PosPRNDBuf_ "Complement of buffered PosPRND" UBYTE SBW_STANDARD_S1_S3 1 100 0 255 ECU_ADDRESS 0xFFF835D9 DISPLAY_IDENTIFIER PosPRNDBuf_.InitPosBPRAM /end MEASUREMENT
/begin MEASUREMENT InitPosBPRAM.PosPRND_4RzN_Buf "buffered PosPRND used by RzN" UBYTE SBW_STANDARD_S1_S3 1 100 0 255 ECU_ADDRESS 0xFFF835DA DISPLAY_IDENTIFIER PosPRND_4RzN_Buf.InitPosBPRAM /end MEASUREMENT
/begin MEASUREMENT InitPosBPRAM.PosPRND_4RzN_Buf_ "Complement of buffered PosPRND used by RzN" UBYTE SBW_STANDARD_S1_S3 1 100 0 255 ECU_ADDRESS 0xFFF835DB DISPLAY_IDENTIFIER PosPRND_4RzN_Buf_.InitPosBPRAM /end MEASUREMENT
/begin MEASUREMENT InitPosBPRAM.f_MechLimpBuf "buffered flag f_MechLimp" UBYTE SBW_STANDARD_S1_S3 1 100 0 1 BIT_MASK 0x1 ECU_ADDRESS 0xFFF835E0 DISPLAY_IDENTIFIER f_MechLimpBuf.InitPosBPRAM /end MEASUREMENT
/begin MEASUREMENT InitPosBPRAM.f_MechLimpBuf_ "Complement of buffered flag f_MechLimp" UBYTE SBW_STANDARD_S1_S3 1 100 0 255 ECU_ADDRESS 0xFFF835E1 DISPLAY_IDENTIFIER f_MechLimpBuf_.InitPosBPRAM /end MEASUREMENT
/begin MEASUREMENT InitPosBPRAM.f_RzN_LimphomeBuf "indicate that SAB caused a reset to heal limphome" UBYTE SBW_STANDARD_S1_S3 1 100 0 1 BIT_MASK 0x1 ECU_ADDRESS 0xFFF835E2 DISPLAY_IDENTIFIER f_RzN_LimphomeBuf.InitPosBPRAM /end MEASUREMENT
/begin MEASUREMENT InitPosBPRAM.f_RzN_LimphomeBuf_ "complement to f_RzN_LimphomeBuf" UBYTE SBW_STANDARD_S1_S3 1 100 0 255 ECU_ADDRESS 0xFFF835E3 DISPLAY_IDENTIFIER f_RzN_LimphomeBuf_.InitPosBPRAM /end MEASUREMENT
/begin MEASUREMENT InitPosBPRAM.st_InverseCoasting "buffered inverse coasting" UBYTE SBW_STANDARD_S1_S3 1 100 0 255 ECU_ADDRESS 0xFFF835DE DISPLAY_IDENTIFIER st_InverseCoasting.InitPosBPRAM /end MEASUREMENT
/begin MEASUREMENT InitPosBPRAM.st_InverseCoasting_ "Complement of buffered inverse coasting" UBYTE SBW_STANDARD_S1_S3 1 100 0 255 ECU_ADDRESS 0xFFF835DF DISPLAY_IDENTIFIER st_InverseCoasting_.InitPosBPRAM /end MEASUREMENT
/begin MEASUREMENT IntOsCallsRAM.f_erase_infomemory "if set the internal info memory will be erased" UBYTE SBW_STANDARD_S1_S3 1 100 0 1 BIT_MASK 0x1 ECU_ADDRESS 0xFFF8D679 DISPLAY_IDENTIFIER f_erase_infomemory.IntOsCallsRAM /end MEASUREMENT
/begin MEASUREMENT IntOsCallsRAM.f_sbwInitialized "Interfo.sbw_init 0:not yet called / 1: already called" UBYTE SBW_STANDARD_S1_S3 1 100 0 1 BIT_MASK 0x1 ECU_ADDRESS 0xFFF8D678 DISPLAY_IDENTIFIER f_sbwInitialized.IntOsCallsRAM /end MEASUREMENT
/begin MEASUREMENT Interfi.AcceleratorPedalAngle "Accelerator Pedal Angle" UBYTE SBW_HDK_M_S1_S3 1 100 0 100.4 ECU_ADDRESS 0xFFF897CC DISPLAY_IDENTIFIER AcceleratorPedalAngle.Interfi /end MEASUREMENT
/begin MEASUREMENT Interfi.AcceleratorPedalAngleSts "Signal status of Accelerator Pedal Angle" UBYTE SBW_STANDARD_S1_S3 1 100 0 2 ECU_ADDRESS 0xFFF897CD DISPLAY_IDENTIFIER AcceleratorPedalAngleSts.Interfi /end MEASUREMENT
/begin MEASUREMENT Interfi.BrakePedalDrvAssistSts "signal status of _GET_FBR_DRV_ASSIST: 0=signal o.k. 1=signal subst.value 2=signal n.o.k./err." UBYTE SBW_STANDARD_S1_S3 1 100 0 2 ECU_ADDRESS 0xFFF89835 DISPLAY_IDENTIFIER BrakePedalDrvAssistSts.Interfi /end MEASUREMENT
/begin MEASUREMENT Interfi.BrakePedalSts "break pedal status" UBYTE SBW_STANDARD_S1_S3 1 100 0 2 ECU_ADDRESS 0xFFF897CF DISPLAY_IDENTIFIER BrakePedalSts.Interfi /end MEASUREMENT
/begin MEASUREMENT Interfi.CtrlSignalSourceSts "Status of source of signal" UBYTE SBW_STANDARD_S1_S3 1 100 0 2 ECU_ADDRESS 0xFFF89837 DISPLAY_IDENTIFIER CtrlSignalSourceSts.Interfi /end MEASUREMENT
/begin MEASUREMENT Interfi.DoorDSts "status of signal 'door open'" UBYTE SBW_STANDARD_S1_S3 1 100 0 2 ECU_ADDRESS 0xFFF89819 DISPLAY_IDENTIFIER DoorDSts.Interfi /end MEASUREMENT
/begin MEASUREMENT Interfi.DriveLogicRaw "raw value for DriveLogic" UBYTE SBW_STANDARD_S1_S3 1 100 0 2 ECU_ADDRESS 0xFFF89813 DISPLAY_IDENTIFIER DriveLogicRaw.Interfi /end MEASUREMENT
/begin MEASUREMENT Interfi.DrivingDirection "sense of rotation of driven wheels (1:fw; 2:bw; 0:err resp. ud)" UBYTE SBW_STANDARD_S1_S3 1 100 0 255 ECU_ADDRESS 0xFFF897E9 DISPLAY_IDENTIFIER DrivingDirection.Interfi /end MEASUREMENT
/begin MEASUREMENT Interfi.DrivingDirectionSts "state of signal DrivingDirection" UBYTE SBW_STANDARD_S1_S3 1 100 0 255 ECU_ADDRESS 0xFFF897EA DISPLAY_IDENTIFIER DrivingDirectionSts.Interfi /end MEASUREMENT
/begin MEASUREMENT Interfi.EepromBusy "Eeprom Update is active so dont change variables in mirror" UBYTE SBW_STANDARD_S1_S3 1 100 0 1 ECU_ADDRESS 0xFFF897D0 DISPLAY_IDENTIFIER EepromBusy.Interfi /end MEASUREMENT
/begin MEASUREMENT Interfi.EepromStoreInProgress "Eeprom Store in Progress reports end of eeprom-write-process" UBYTE SBW_STANDARD_S1_S3 1 100 0 255 ECU_ADDRESS 0xFFF897D1 DISPLAY_IDENTIFIER EepromStoreInProgress.Interfi /end MEASUREMENT
/begin MEASUREMENT Interfi.EepromUpdCnt "Eeprom Update count reports nr. of successful eeprom-write-attempts" ULONG SBW_STANDARD_S1_S3 1 100 0 4294967295 ECU_ADDRESS 0xFFF897D4 DISPLAY_IDENTIFIER EepromUpdCnt.Interfi /end MEASUREMENT
/begin MEASUREMENT Interfi.GatePosRaw "raw val. of gate position - left-right-noaction" UBYTE SBW_STANDARD_S1_S3 1 100 0 255 ECU_ADDRESS 0xFFF89826 DISPLAY_IDENTIFIER GatePosRaw.Interfi /end MEASUREMENT
/begin MEASUREMENT Interfi.GearboxDrvRdy "state of transmission concerning pump pressure: hibit=0:no syst.pressure - hibit=1:syst.pressure for engaging gear" UBYTE SBW_STANDARD_S1_S3 1 100 0 255 ECU_ADDRESS 0xFFF897DF DISPLAY_IDENTIFIER GearboxDrvRdy.Interfi /end MEASUREMENT
/begin MEASUREMENT Interfi.GearboxDrvRdySts "state of signal GearboxDrvRdy" UBYTE SBW_STANDARD_S1_S3 1 100 0 2 ECU_ADDRESS 0xFFF897E0 DISPLAY_IDENTIFIER GearboxDrvRdySts.Interfi /end MEASUREMENT
/begin MEASUREMENT Interfi.IgnOnRawSts "state ignition (raw-value)" UBYTE SBW_STANDARD_S1_S3 1 100 0 2 ECU_ADDRESS 0xFFF897E4 DISPLAY_IDENTIFIER IgnOnRawSts.Interfi /end MEASUREMENT
/begin MEASUREMENT Interfi.KeyValidSts "status of signal ignition key valid" UBYTE SBW_STANDARD_S1_S3 1 100 0 2 ECU_ADDRESS 0xFFF8981B DISPLAY_IDENTIFIER KeyValidSts.Interfi /end MEASUREMENT
/begin MEASUREMENT Interfi.ModeDrvAssistVehSts "signal status of _GET_MODE_DRV_ASSIST_VEH: 0=signal o.k. 1=signal subst.value 2=signal n.o.k./err." UBYTE SBW_STANDARD_S1_S3 1 100 0 2 ECU_ADDRESS 0xFFF89833 DISPLAY_IDENTIFIER ModeDrvAssistVehSts.Interfi /end MEASUREMENT
/begin MEASUREMENT Interfi.PSensor "state of the parking lock (0=not engaged; 1=engaged; 2=intermediate pos.; 3=unknown)" UBYTE SBW_STANDARD_S1_S3 1 100 0 255 ECU_ADDRESS 0xFFF897E8 DISPLAY_IDENTIFIER PSensor.Interfi /end MEASUREMENT
/begin MEASUREMENT Interfi.PSensorSts "state P-sensor signal (0: ok 1: subst 2: err)" UBYTE SBW_STANDARD_S1_S3 1 100 0 2 ECU_ADDRESS 0xFFF897EE DISPLAY_IDENTIFIER PSensorSts.Interfi /end MEASUREMENT
/begin MEASUREMENT Interfi.ParkingBrakeSts "flag parking brake status" UBYTE SBW_STANDARD_S1_S3 1 100 0 2 ECU_ADDRESS 0xFFF897CA DISPLAY_IDENTIFIER ParkingBrakeSts.Interfi /end MEASUREMENT
/begin MEASUREMENT Interfi.PosDrvAssistRaw "FAS [PMA/RCP] request for driving-direction: 0=NA 5=D 6=N 7=R 8=P" UBYTE SBW_STANDARD_S1_S3 1 100 0 8 ECU_ADDRESS 0xFFF89830 DISPLAY_IDENTIFIER PosDrvAssistRaw.Interfi /end MEASUREMENT
/begin MEASUREMENT Interfi.PosDrvAssistRawSts "signal status of _GET_POS_DRV_ASSIST_RAW: 0=signal o.k. 1=signal subst.value 2=signal n.o.k./err." UBYTE SBW_STANDARD_S1_S3 1 100 0 2 ECU_ADDRESS 0xFFF89831 DISPLAY_IDENTIFIER PosDrvAssistRawSts.Interfi /end MEASUREMENT
/begin MEASUREMENT Interfi.PosRaw "raw val. of driver request (absolute or relative position)" UBYTE SBW_STANDARD_S1_S3 1 100 0 32 ECU_ADDRESS 0xFFF89814 DISPLAY_IDENTIFIER PosRaw.Interfi /end MEASUREMENT
/begin MEASUREMENT Interfi.SeatBeltSts "status of signal f_SeatBelt" UBYTE SBW_STANDARD_S1_S3 1 100 0 2 ECU_ADDRESS 0xFFF89824 DISPLAY_IDENTIFIER SeatBeltSts.Interfi /end MEASUREMENT
/begin MEASUREMENT Interfi.SeatFLSts "status of signal drivers seat occupied" UBYTE SBW_STANDARD_S1_S3 1 100 0 2 ECU_ADDRESS 0xFFF89817 DISPLAY_IDENTIFIER SeatFLSts.Interfi /end MEASUREMENT
/begin MEASUREMENT Interfi.VehicleDrvRdy "op.readiness info from hybrid-master" UBYTE SBW_STANDARD_S1_S3 1 100 0 255 ECU_ADDRESS 0xFFF897E1 DISPLAY_IDENTIFIER VehicleDrvRdy.Interfi /end MEASUREMENT
/begin MEASUREMENT Interfi.VehicleDrvRdySts "state of signal VehicleDrvRdy" UBYTE SBW_STANDARD_S1_S3 1 100 0 2 ECU_ADDRESS 0xFFF897E2 DISPLAY_IDENTIFIER VehicleDrvRdySts.Interfi /end MEASUREMENT
/begin MEASUREMENT Interfi.c_ChipTrans "EGS chip substrat temperature" UBYTE SBW_CGT40_M_S1_S3 1 100 -40 215 ECU_ADDRESS 0xFFF897DA DISPLAY_IDENTIFIER c_ChipTrans.Interfi /end MEASUREMENT
/begin MEASUREMENT Interfi.c_OilTrans "gearbox oil temperature" UBYTE SBW_CGT40_M_S1_S3 1 100 -40 215 ECU_ADDRESS 0xFFF897D8 DISPLAY_IDENTIFIER c_OilTrans.Interfi /end MEASUREMENT
/begin MEASUREMENT Interfi.c_OilTransSts "signal state of c_OilTrans (0=ok 1=subst.sig 2=sig.fault)" UBYTE SBW_STANDARD_S1_S3 1 100 0 2 ECU_ADDRESS 0xFFF897D9 DISPLAY_IDENTIFIER c_OilTransSts.Interfi /end MEASUREMENT
/begin MEASUREMENT Interfi.f_BrakePedal "flag brake light/brake test" UBYTE SBW_STANDARD_S1_S3 1 100 0 1 ECU_ADDRESS 0xFFF897EB DISPLAY_IDENTIFIER f_BrakePedal.Interfi /end MEASUREMENT
/begin MEASUREMENT Interfi.f_BrakePedalDrvAssist "brake-activation flag by FAS [PMA/RCP] from ICM-ECU: 0=brake by FAS inactive 1=brake by FAS active" UBYTE SBW_STANDARD_S1_S3 1 100 0 1 ECU_ADDRESS 0xFFF89834 DISPLAY_IDENTIFIER f_BrakePedalDrvAssist.Interfi /end MEASUREMENT
/begin MEASUREMENT Interfi.f_CanComActive "0: CAN inactive / 1: CAN active" UBYTE SBW_STANDARD_S1_S3 1 100 0 1 ECU_ADDRESS 0xFFF897F1 DISPLAY_IDENTIFIER f_CanComActive.Interfi /end MEASUREMENT
/begin MEASUREMENT Interfi.f_DoorD "driver side door open" UBYTE SBW_STANDARD_S1_S3 1 100 0 1 ECU_ADDRESS 0xFFF89818 DISPLAY_IDENTIFIER f_DoorD.Interfi /end MEASUREMENT
/begin MEASUREMENT Interfi.f_FaultFiltKFC_CANB1 "flag returned by RB macro 'DI_GET_FAULT_FILT_ACTIVE(KFC_CANB1)'" UBYTE SBW_STANDARD_S1_S3 1 100 0 1 ECU_ADDRESS 0xFFF897F8 DISPLAY_IDENTIFIER f_FaultFiltKFC_CANB1.Interfi /end MEASUREMENT
/begin MEASUREMENT Interfi.f_FaultFiltKFC_CANB2 "flag returned by RB macro 'DI_GET_FAULT_FILT_ACTIVE(KFC_CANB2)'" UBYTE SBW_STANDARD_S1_S3 1 100 0 1 ECU_ADDRESS 0xFFF897F6 DISPLAY_IDENTIFIER f_FaultFiltKFC_CANB2.Interfi /end MEASUREMENT
/begin MEASUREMENT Interfi.f_FaultFiltKFC_PINFO "flag returned by RB macro 'DI_GET_FAULT_FILT_ACTIVE(KFC_PINFO)'" UBYTE SBW_STANDARD_S1_S3 1 100 0 1 ECU_ADDRESS 0xFFF897FC DISPLAY_IDENTIFIER f_FaultFiltKFC_PINFO.Interfi /end MEASUREMENT
/begin MEASUREMENT Interfi.f_FaultFiltKFC_POSSBW "flag returned by RB macro 'DI_GET_FAULT_FILT_ACTIVE(KFC_POSSBW)'" UBYTE SBW_STANDARD_S1_S3 1 100 0 1 ECU_ADDRESS 0xFFF897FA DISPLAY_IDENTIFIER f_FaultFiltKFC_POSSBW.Interfi /end MEASUREMENT
/begin MEASUREMENT Interfi.f_FaultFiltKFC_ParkSolenoid "flag returned by RB macro 'DI_GET_FAULT_FILT_ACTIVE(KFC2_OUT11)'" UBYTE SBW_STANDARD_S1_S3 1 100 0 1 ECU_ADDRESS 0xFFF897FE DISPLAY_IDENTIFIER f_FaultFiltKFC_ParkSolenoid.Interfi /end MEASUREMENT
/begin MEASUREMENT Interfi.f_FaultFiltPSensor "flag returned by RB macro 'DI_GET_FAULT_FILT_ACTIVE(KFC_USENS)'" UBYTE SBW_STANDARD_S1_S3 1 100 0 1 ECU_ADDRESS 0xFFF897FF DISPLAY_IDENTIFIER f_FaultFiltPSensor.Interfi /end MEASUREMENT
/begin MEASUREMENT Interfi.f_FaultKFC_CANB "flag returned by RB macro 'DI_GET_FAULT_ACTIVE(KFC_CANB1)'" UBYTE SBW_STANDARD_S1_S3 1 100 0 1 ECU_ADDRESS 0xFFF897F9 DISPLAY_IDENTIFIER f_FaultKFC_CANB.Interfi /end MEASUREMENT
/begin MEASUREMENT Interfi.f_FaultKFC_CANB2 "flag returned by RB macro 'DI_GET_FAULT_ACTIVE(KFC_CANB2)'" UBYTE SBW_STANDARD_S1_S3 1 100 0 1 ECU_ADDRESS 0xFFF897F7 DISPLAY_IDENTIFIER f_FaultKFC_CANB2.Interfi /end MEASUREMENT
/begin MEASUREMENT Interfi.f_FaultKFC_PINFO "flag returned by RB macro 'DI_GET_FAULT_ACTIVE(KFC_PINFO)'" UBYTE SBW_STANDARD_S1_S3 1 100 0 1 ECU_ADDRESS 0xFFF897FD DISPLAY_IDENTIFIER f_FaultKFC_PINFO.Interfi /end MEASUREMENT
/begin MEASUREMENT Interfi.f_FaultKFC_POSSBW "flag returned by RB macro 'DI_GET_FAULT_ACTIVE(KFC1_POSSBW)'" UBYTE SBW_STANDARD_S1_S3 1 100 0 1 ECU_ADDRESS 0xFFF897FB DISPLAY_IDENTIFIER f_FaultKFC_POSSBW.Interfi /end MEASUREMENT
/begin MEASUREMENT Interfi.f_FaultKFC_PSIN "flag error entry ActivePSIN" UBYTE SBW_STANDARD_S1_S3 1 100 0 1 ECU_ADDRESS 0xFFF89800 DISPLAY_IDENTIFIER f_FaultKFC_PSIN.Interfi /end MEASUREMENT
/begin MEASUREMENT Interfi.f_KeyValid "flag for ignition key valid" UBYTE SBW_STANDARD_S1_S3 1 100 0 1 ECU_ADDRESS 0xFFF8981A DISPLAY_IDENTIFIER f_KeyValid.Interfi /end MEASUREMENT
/begin MEASUREMENT Interfi.f_ModeDrvAssistVeh "FAS-signal [PMA/RCP] from ICM-ECU: 0=PMA/RCP-mode inactive 1=PMA/RCP-mode active" UBYTE SBW_STANDARD_S1_S3 1 100 0 1 ECU_ADDRESS 0xFFF89832 DISPLAY_IDENTIFIER f_ModeDrvAssistVeh.Interfi /end MEASUREMENT
/begin MEASUREMENT Interfi.f_P12BadOpRaw "flag park-button bad operation" UBYTE SBW_STANDARD_S1_S3 1 100 0 1 ECU_ADDRESS 0xFFF8982A DISPLAY_IDENTIFIER f_P12BadOpRaw.Interfi /end MEASUREMENT
/begin MEASUREMENT Interfi.f_P12Button "flag park-button pressed" UBYTE SBW_STANDARD_S1_S3 1 100 0 1 ECU_ADDRESS 0xFFF89828 DISPLAY_IDENTIFIER f_P12Button.Interfi /end MEASUREMENT
/begin MEASUREMENT Interfi.f_P12TwoErr "flag park-button two errors" UBYTE SBW_STANDARD_S1_S3 1 100 0 1 ECU_ADDRESS 0xFFF89829 DISPLAY_IDENTIFIER f_P12TwoErr.Interfi /end MEASUREMENT
/begin MEASUREMENT Interfi.f_PN "request shiftlock activation via CAN" UBYTE SBW_STANDARD_S1_S3 1 100 0 1 ECU_ADDRESS 0xFFF89825 DISPLAY_IDENTIFIER f_PN.Interfi /end MEASUREMENT
/begin MEASUREMENT Interfi.f_ParkingBrake "flag parking brake" UBYTE SBW_STANDARD_S1_S3 1 100 0 1 ECU_ADDRESS 0xFFF897C9 DISPLAY_IDENTIFIER f_ParkingBrake.Interfi /end MEASUREMENT
/begin MEASUREMENT Interfi.f_PowDownCondOK "flag EGS in overshoot-state waiting for permission to power down" UBYTE SBW_STANDARD_S1_S3 1 100 0 1 ECU_ADDRESS 0xFFF897F0 DISPLAY_IDENTIFIER f_PowDownCondOK.Interfi /end MEASUREMENT
/begin MEASUREMENT Interfi.f_RemoteStartRaw "flag for engine remote start" UBYTE SBW_STANDARD_S1_S3 1 100 0 1 ECU_ADDRESS 0xFFF89827 DISPLAY_IDENTIFIER f_RemoteStartRaw.Interfi /end MEASUREMENT
/begin MEASUREMENT Interfi.f_SDButtonRaw "flag sport lever action (S/D modeswitch)" UBYTE SBW_STANDARD_S1_S3 1 100 0 1 ECU_ADDRESS 0xFFF8982B DISPLAY_IDENTIFIER f_SDButtonRaw.Interfi /end MEASUREMENT
/begin MEASUREMENT Interfi.f_SeatBelt "driver seat belt 0=open 1=closed" UBYTE SBW_STANDARD_S1_S3 1 100 0 1 ECU_ADDRESS 0xFFF89823 DISPLAY_IDENTIFIER f_SeatBelt.Interfi /end MEASUREMENT
/begin MEASUREMENT Interfi.f_SeatFL "drivers seat occupied" UBYTE SBW_STANDARD_S1_S3 1 100 0 1 ECU_ADDRESS 0xFFF89816 DISPLAY_IDENTIFIER f_SeatFL.Interfi /end MEASUREMENT
/begin MEASUREMENT Interfi.f_SportButtonRaw "raw value for sport button" UBYTE SBW_STANDARD_S1_S3 1 100 0 1 ECU_ADDRESS 0xFFF89812 DISPLAY_IDENTIFIER f_SportButtonRaw.Interfi /end MEASUREMENT
/begin MEASUREMENT Interfi.f_SubstAdaptivModeFix "flag fixed adaptive mode" UBYTE SBW_STANDARD_S1_S3 1 100 0 1 ECU_ADDRESS 0xFFF89802 DISPLAY_IDENTIFIER f_SubstAdaptivModeFix.Interfi /end MEASUREMENT
/begin MEASUREMENT Interfi.f_SubstHSS1Off "flag highside1 off" UBYTE SBW_STANDARD_S1_S3 1 100 0 1 ECU_ADDRESS 0xFFF89803 DISPLAY_IDENTIFIER f_SubstHSS1Off.Interfi /end MEASUREMENT
/begin MEASUREMENT Interfi.f_SubstHoldP "flag substitution function 'hold pos P' is active" UBYTE SBW_STANDARD_S1_S3 1 100 0 1 ECU_ADDRESS 0xFFF89804 DISPLAY_IDENTIFIER f_SubstHoldP.Interfi /end MEASUREMENT
/begin MEASUREMENT Interfi.f_SubstKMN_CCID419 "flag substitute actions KMN_CCID419" UBYTE SBW_STANDARD_S1_S3 1 100 0 1 ECU_ADDRESS 0xFFF89810 DISPLAY_IDENTIFIER f_SubstKMN_CCID419.Interfi /end MEASUREMENT
/begin MEASUREMENT Interfi.f_SubstKMN_CCID420 "flag substitute actions KMN_CCID420" UBYTE SBW_STANDARD_S1_S3 1 100 0 1 ECU_ADDRESS 0xFFF89811 DISPLAY_IDENTIFIER f_SubstKMN_CCID420.Interfi /end MEASUREMENT
/begin MEASUREMENT Interfi.f_SubstNoD "flag substitution function 'NoD' is active" UBYTE SBW_STANDARD_S1_S3 1 100 0 1 ECU_ADDRESS 0xFFF89805 DISPLAY_IDENTIFIER f_SubstNoD.Interfi /end MEASUREMENT
/begin MEASUREMENT Interfi.f_SubstNoR "flag substitution function 'NoR' is active" UBYTE SBW_STANDARD_S1_S3 1 100 0 1 ECU_ADDRESS 0xFFF89806 DISPLAY_IDENTIFIER f_SubstNoR.Interfi /end MEASUREMENT
/begin MEASUREMENT Interfi.f_SubstNoShiftlock "flag substitute actions shiftlock deactivation" UBYTE SBW_STANDARD_S1_S3 1 100 0 1 ECU_ADDRESS 0xFFF89807 DISPLAY_IDENTIFIER f_SubstNoShiftlock.Interfi /end MEASUREMENT
/begin MEASUREMENT Interfi.f_SubstWarnLight "'DI_GET_SUBST_FUNCT(KMN_FAULTINFO)' from RB-SW" UBYTE SBW_STANDARD_S1_S3 1 100 0 1 ECU_ADDRESS 0xFFF89801 DISPLAY_IDENTIFIER f_SubstWarnLight.Interfi /end MEASUREMENT
/begin MEASUREMENT Interfi.f_V_Implausible "flag car velocity implausible" UBYTE SBW_STANDARD_S1_S3 1 100 0 1 ECU_ADDRESS 0xFFF897CB DISPLAY_IDENTIFIER f_V_Implausible.Interfi /end MEASUREMENT
/begin MEASUREMENT Interfi.n_AbRaw "drive/output rev.s (raw- or subst.value)" UWORD SBW_N_1_M_S1_S3 1 100 0 20000 ECU_ADDRESS 0xFFF897E6 DISPLAY_IDENTIFIER n_AbRaw.Interfi /end MEASUREMENT
/begin MEASUREMENT Interfi.n_Eng "engine rev.s; INT=value[r.p.m.]" UWORD SBW_N_1_M_S1_S3 1 100 0 65535 ECU_ADDRESS 0xFFF897DC DISPLAY_IDENTIFIER n_Eng.Interfi /end MEASUREMENT
/begin MEASUREMENT Interfi.n_EngSts "state of signal n_Eng" UBYTE SBW_STANDARD_S1_S3 1 100 0 255 ECU_ADDRESS 0xFFF897DE DISPLAY_IDENTIFIER n_EngSts.Interfi /end MEASUREMENT
/begin MEASUREMENT Interfi.s_mileage_10km "actual km-state of vehicle via CAN phys=int_hex*10[km]" UWORD SBW_KM_10_S1_S3 1 100 0 655350 ECU_ADDRESS 0xFFF89820 DISPLAY_IDENTIFIER s_mileage_10km.Interfi /end MEASUREMENT
/begin MEASUREMENT Interfi.st_DiagNUWIG "state UWIG symptom" UBYTE SBW_STANDARD_S1_S3 1 100 0 3 ECU_ADDRESS 0xFFF897C4 DISPLAY_IDENTIFIER st_DiagNUWIG.Interfi /end MEASUREMENT
/begin MEASUREMENT Interfi.st_EmfP "state for EMF 'help' request" UBYTE SBW_STANDARD_S1_S3 1 100 0 2 ECU_ADDRESS 0xFFF89836 DISPLAY_IDENTIFIER st_EmfP.Interfi /end MEASUREMENT
/begin MEASUREMENT Interfi.st_GearCurr "current gear from HPSYS/ATSYS (8HPFT: -1=r-gear)" SBYTE SBW_STANDARD_S1_S3 1 100 -10 10 ECU_ADDRESS 0xFFF8983B DISPLAY_IDENTIFIER st_GearCurr.Interfi /end MEASUREMENT
/begin MEASUREMENT Interfi.st_GearDest "destination gear (next gear) from HPSYS/ATSYS (8HPFT: -1=r-gear)" SBYTE SBW_STANDARD_S1_S3 1 100 -10 10 ECU_ADDRESS 0xFFF8983C DISPLAY_IDENTIFIER st_GearDest.Interfi /end MEASUREMENT
/begin MEASUREMENT Interfi.st_GearShiftStrat "display gear from shifting strategy" UBYTE SBW_STANDARD_S1_S3 1 100 0 10 ECU_ADDRESS 0xFFF8983D DISPLAY_IDENTIFIER st_GearShiftStrat.Interfi /end MEASUREMENT
/begin MEASUREMENT Interfi.st_IAE_Hotmode "State Value for IAE (Clutch) temperature level 0=no Message 1=State I (Pulsen) 2=State II (IAE open) 3-7->not defined" UBYTE SBW_STANDARD_S1_S3 1 100 0 1 ECU_ADDRESS 0xFFF89822 DISPLAY_IDENTIFIER st_IAE_Hotmode.Interfi /end MEASUREMENT
/begin MEASUREMENT Interfi.st_IgnOnRaw "state ignition on/off (raw-value)" UBYTE SBW_STANDARD_S1_S3 1 100 0 4 ECU_ADDRESS 0xFFF897E3 DISPLAY_IDENTIFIER st_IgnOnRaw.Interfi /end MEASUREMENT
/begin MEASUREMENT Interfi.st_LeverType "state of application lable SWI_LEVERTYPE 0=Automatic lever - bistable rel pos 1=Automatic lever - bistable abs pos 2=IEX or Sport - monostable abs pos" UBYTE SBW_STANDARD_S1_S3 1 100 0 2 ECU_ADDRESS 0xFFF89815 DISPLAY_IDENTIFIER st_LeverType.Interfi /end MEASUREMENT
/begin MEASUREMENT Interfi.st_Limphome "st_Limphome: xxxx xxx1: lowside switch opened xxxx xx1x: highside switch [FET] opened" UBYTE SBW_STANDARD_S1_S3 1 100 0 255 ECU_ADDRESS 0xFFF897EF DISPLAY_IDENTIFIER st_Limphome.Interfi /end MEASUREMENT
/begin MEASUREMENT Interfi.st_LowMode "state of LowMode:0=noLowMode 1=LowMode 3=LowModeInvalid" UBYTE SBW_STANDARD_S1_S3 1 100 0 3 ECU_ADDRESS 0xFFF89838 DISPLAY_IDENTIFIER st_LowMode.Interfi /end MEASUREMENT
/begin MEASUREMENT Interfi.st_MSA_Function "MSA information to send via CAN" UBYTE SBW_STANDARD_S1_S3 1 100 0 255 ECU_ADDRESS 0xFFF89839 DISPLAY_IDENTIFIER st_MSA_Function.Interfi /end MEASUREMENT
/begin MEASUREMENT Interfi.st_MSA_FunctionRequester "ID of ECU which requests MSA information to send via CAN" UBYTE SBW_STANDARD_S1_S3 1 100 0 255 ECU_ADDRESS 0xFFF8983A DISPLAY_IDENTIFIER st_MSA_FunctionRequester.Interfi /end MEASUREMENT
/begin MEASUREMENT Interfi.st_ModeDisplay "current display mode from AGS" UBYTE SBW_STANDARD_S1_S3 1 100 0 10 ECU_ADDRESS 0xFFF897C6 DISPLAY_IDENTIFIER st_ModeDisplay.Interfi /end MEASUREMENT
/begin MEASUREMENT Interfi.st_OsMode "state/mode of Operating System: 0 = Init 1=Stdby 2=Cruise 3=Limphome" UBYTE SBW_STANDARD_S1_S3 1 100 0 3 ECU_ADDRESS 0xFFF897CE DISPLAY_IDENTIFIER st_OsMode.Interfi /end MEASUREMENT
/begin MEASUREMENT Interfi.st_ParkLock "State of Parklock from HPSYS: 0 undef ** 1 loose ** 2 loosing ** 3 engaging ** 4 engaged" UBYTE SBW_STANDARD_S1_S3 1 100 0 1 ECU_ADDRESS 0xFFF897C5 DISPLAY_IDENTIFIER st_ParkLock.Interfi /end MEASUREMENT
/begin MEASUREMENT Interfi.st_SubstAll "Return Subst Functions of Errorhandler lower 32 Bits" ULONG SBW_STANDARD_S1_S3 1 100 0 4294967295 ECU_ADDRESS 0xFFF89808 DISPLAY_IDENTIFIER st_SubstAll.Interfi /end MEASUREMENT
/begin MEASUREMENT Interfi.st_SubstAllHi "Return Subst Functions of Errorhandler upper 32 Bits" ULONG SBW_STANDARD_S1_S3 1 100 0 4294967295 ECU_ADDRESS 0xFFF8980C DISPLAY_IDENTIFIER st_SubstAllHi.Interfi /end MEASUREMENT
/begin MEASUREMENT Interfi.st_TipMinus1_Raw "flag manual tip1 gearlever to minus 0=noTip 1=singleTip 2=doubleTip" UBYTE SBW_STANDARD_S1_S3 1 100 0 2 ECU_ADDRESS 0xFFF8982C DISPLAY_IDENTIFIER st_TipMinus1_Raw.Interfi /end MEASUREMENT
/begin MEASUREMENT Interfi.st_TipMinus2_Raw "flag manual tip2 gearlever to minus 0=noTip 1=singleTip 2=doubleTip" UBYTE SBW_STANDARD_S1_S3 1 100 0 2 ECU_ADDRESS 0xFFF8982E DISPLAY_IDENTIFIER st_TipMinus2_Raw.Interfi /end MEASUREMENT
/begin MEASUREMENT Interfi.st_TipPlus1_Raw "flag manual tip1 gearlever to plus 0=noTip 1=singleTip 2=doubleTip" UBYTE SBW_STANDARD_S1_S3 1 100 0 2 ECU_ADDRESS 0xFFF8982D DISPLAY_IDENTIFIER st_TipPlus1_Raw.Interfi /end MEASUREMENT
/begin MEASUREMENT Interfi.st_TipPlus2_Raw "flag manual tip2 gearlever to plus 0=noTip 1=singleTip 2=doubleTip" UBYTE SBW_STANDARD_S1_S3 1 100 0 2 ECU_ADDRESS 0xFFF8982F DISPLAY_IDENTIFIER st_TipPlus2_Raw.Interfi /end MEASUREMENT
/begin MEASUREMENT Interfi.st_VehDrvRdy "Vehicle drive ready status" UBYTE SBW_STANDARD_S1_S3 1 100 0 255 ECU_ADDRESS 0xFFF897C7 DISPLAY_IDENTIFIER st_VehDrvRdy.Interfi /end MEASUREMENT
/begin MEASUREMENT Interfi.t_systime_secs "system-time of std.core counting in secs after 1st jan 2000 phys=int_hex*1[secs]" ULONG SBW_TIMER_1S_S1_S3 1 100 0 4294967295 ECU_ADDRESS 0xFFF8981C DISPLAY_IDENTIFIER t_systime_secs.Interfi /end MEASUREMENT
/begin MEASUREMENT Interfi.u_BattDiag "supply voltage used for diagnosis" UWORD SBW_TAUSENDSTEL_U_S1_S3 1 100 0 0.025 ECU_ADDRESS 0xFFF897F4 DISPLAY_IDENTIFIER u_BattDiag.Interfi /end MEASUREMENT
/begin MEASUREMENT Interfi.u_mv3 "supply voltage for pressure regulators and solenoid valves" UWORD SBW_TAUSENDSTEL_U_S1_S3 1 100 0 0.025 ECU_ADDRESS 0xFFF897F2 DISPLAY_IDENTIFIER u_mv3.Interfi /end MEASUREMENT
/begin MEASUREMENT Interfi.v_VehSpdMinSts "Signal status actual vehicel speed" UBYTE SBW_STANDARD_S1_S3 1 100 0 2 ECU_ADDRESS 0xFFF897C8 DISPLAY_IDENTIFIER v_VehSpdMinSts.Interfi /end MEASUREMENT
/begin MEASUREMENT Interfi.v_VehSpd_nab "vehicle speed by n_ab" UWORD SBW_VKMH_16_S1_S3 1 100 0 21.875 ECU_ADDRESS 0xFFF897EC DISPLAY_IDENTIFIER v_VehSpd_nab.Interfi /end MEASUREMENT
/begin MEASUREMENT Kanal.Test.EndeEE "EepromStd[3438 ... 3439]: Ende-Marker des Kanals EEPROM_STD Wert: 54321 [(x=1/UMR___1_1_0)]" UWORD UMR___1_1_0_S5_S3 1 100 0 65535 ECU_ADDRESS 0xFFF81DA6 DISPLAY_IDENTIFIER EndeEE.Test.Kanal /end MEASUREMENT
/begin MEASUREMENT KombiMsg.f_FlashPosBadOp "flag to request flashing due to bad operation of park button (tmr_P12BadOpDisp > 0)" UBYTE SBW_STANDARD_S1_S3 1 100 0 1 BIT_MASK 0x1 ECU_ADDRESS 0xFFF89934 DISPLAY_IDENTIFIER f_FlashPosBadOp.KombiMsg /end MEASUREMENT
/begin MEASUREMENT KombiMsg.f_IgnOnNeverDetected "flag to detect state 'STDBY before CRUISE' - is default set true by Ctor. - reset in eshift-code" UBYTE SBW_STANDARD_S1_S3 1 100 0 1 BIT_MASK 0x1 ECU_ADDRESS 0xFFF89932 DISPLAY_IDENTIFIER f_IgnOnNeverDetected.KombiMsg /end MEASUREMENT
/begin MEASUREMENT KombiMsg.f_StandbyBeforeCruise "flag to indicate state standby before cruise" UBYTE SBW_STANDARD_S1_S3 1 100 0 1 BIT_MASK 0x1 ECU_ADDRESS 0xFFF89933 DISPLAY_IDENTIFIER f_StandbyBeforeCruise.KombiMsg /end MEASUREMENT
/begin MEASUREMENT KombiMsg.f_freezeDisplayPReq "flag to indicate request shift to P - freeze mode; gear; pos until P engaged" UBYTE SBW_STANDARD_S1_S3 1 100 0 1 BIT_MASK 0x1 ECU_ADDRESS 0xFFF89935 DISPLAY_IDENTIFIER f_freezeDisplayPReq.KombiMsg /end MEASUREMENT
/begin MEASUREMENT KombiMsg.tmr_IgnOnNeverDetected.f_IsExpired "test_timer" UBYTE SBW_STANDARD_S1_S3 1 100 0 255 ECU_ADDRESS 0xFFF89931 DISPLAY_IDENTIFIER f_IsExpired.tmr_IgnOnNeverDetected.KombiMsg /end MEASUREMENT
/begin MEASUREMENT KombiMsg.tmr_IgnOnNeverDetected.time "test_timer" UBYTE SBW_TIMER_10MS_S1_S3 1 100 0 2550 ECU_ADDRESS 0xFFF89930 DISPLAY_IDENTIFIER time.tmr_IgnOnNeverDetected.KombiMsg /end MEASUREMENT
/begin MEASUREMENT KombiMsg.tmr_P12BadOpDisp.f_IsExpired "test_timer" UBYTE SBW_STANDARD_S1_S3 1 100 0 255 ECU_ADDRESS 0xFFF8992E DISPLAY_IDENTIFIER f_IsExpired.tmr_P12BadOpDisp.KombiMsg /end MEASUREMENT
/begin MEASUREMENT KombiMsg.tmr_P12BadOpDisp.time "test_timer" UWORD SBW_TIMER_10MS_S1_S3 1 100 0 655350 ECU_ADDRESS 0xFFF8992C DISPLAY_IDENTIFIER time.tmr_P12BadOpDisp.KombiMsg /end MEASUREMENT
/begin MEASUREMENT KombiMsgFlash.f_CC_PL_Fault "Flag for CC-Message: 175" UBYTE SBW_STANDARD_S1_S3 1 100 0 1 BIT_MASK 0x1 ECU_ADDRESS 0xFFF8995B DISPLAY_IDENTIFIER f_CC_PL_Fault.KombiMsgFlash /end MEASUREMENT
/begin MEASUREMENT KombiMsgFlash.st_KombiPosFlash "Status of Kombi display for flashing position" UBYTE SBW_STANDARD_S1_S3 1 100 0 8 ECU_ADDRESS 0xFFF8995A DISPLAY_IDENTIFIER st_KombiPosFlash.KombiMsgFlash /end MEASUREMENT
/begin MEASUREMENT KombiMsgFlash.tmr_FlashN.f_IsExpired "test_timer" UBYTE SBW_STANDARD_S1_S3 1 100 0 255 ECU_ADDRESS 0xFFF89955 DISPLAY_IDENTIFIER f_IsExpired.tmr_FlashN.KombiMsgFlash /end MEASUREMENT
/begin MEASUREMENT KombiMsgFlash.tmr_FlashN.time "test_timer" UBYTE SBW_TIMER_10MS_S1_S3 1 100 0 2550 ECU_ADDRESS 0xFFF89954 DISPLAY_IDENTIFIER time.tmr_FlashN.KombiMsgFlash /end MEASUREMENT
/begin MEASUREMENT KombiMsgFlash.tmr_FlashNInWrongDrvDir.f_IsExpired "test_timer" UBYTE SBW_STANDARD_S1_S3 1 100 0 255 ECU_ADDRESS 0xFFF89958 DISPLAY_IDENTIFIER f_IsExpired.tmr_FlashNInWrongDrvDir.KombiMsgFlash /end MEASUREMENT
/begin MEASUREMENT KombiMsgFlash.tmr_FlashNInWrongDrvDir.time "test_timer" UWORD SBW_TIMER_10MS_S1_S3 1 100 0 655350 ECU_ADDRESS 0xFFF89956 DISPLAY_IDENTIFIER time.tmr_FlashNInWrongDrvDir.KombiMsgFlash /end MEASUREMENT
/begin MEASUREMENT KombiMsgGear.DisplayGear "SBW-internal display gear (coding: 1st gear=1 ... 6th gear=6 (7th=7)(8th=8) 0=dark (also r-gear=dark)" UBYTE SBW_STANDARD_S1_S3 1 100 0 8 ECU_ADDRESS 0xFFF8994C DISPLAY_IDENTIFIER DisplayGear.KombiMsgGear /end MEASUREMENT
/begin MEASUREMENT KombiMsgMode.DisplayMode "SBW-internal mode displayed on kombi (coding: C_ModeAdaptive=0; C_ModeSport=1; C_ModeManual=2; C_ModeManualSport=3;)" UBYTE SBW_STANDARD_S1_S3 1 100 0 3 ECU_ADDRESS 0xFFF89945 DISPLAY_IDENTIFIER DisplayMode.KombiMsgMode /end MEASUREMENT
/begin MEASUREMENT KombiMsgMode.SelectedDispMode "interim value for selected mode dependent on SWI_DispMode" UBYTE SBW_STANDARD_S1_S3 1 100 0 4 ECU_ADDRESS 0xFFF89944 DISPLAY_IDENTIFIER SelectedDispMode.KombiMsgMode /end MEASUREMENT
/begin MEASUREMENT KombiMsgOutOEM.CtlDispGear "displayed gear on kombi" UBYTE SBW_STANDARD_S1_S3 1 100 0 255 ECU_ADDRESS 0xFFF893FE DISPLAY_IDENTIFIER CtlDispGear.KombiMsgOutOEM /end MEASUREMENT
/begin MEASUREMENT KombiMsgOutOEM.CtlDispMode "displayed mode on kombi" UBYTE SBW_STANDARD_S1_S3 1 100 0 15 ECU_ADDRESS 0xFFF89402 DISPLAY_IDENTIFIER CtlDispMode.KombiMsgOutOEM /end MEASUREMENT
/begin MEASUREMENT KombiMsgOutOEM.CtlDispPos "displayed pos on kombi" UBYTE SBW_STANDARD_S1_S3 1 100 0 15 ECU_ADDRESS 0xFFF893FF DISPLAY_IDENTIFIER CtlDispPos.KombiMsgOutOEM /end MEASUREMENT
/begin MEASUREMENT KombiMsgOutOEM.CtlDispPosFlash "flag for flashing position on kombi" UBYTE SBW_STANDARD_S1_S3 1 100 0 15 ECU_ADDRESS 0xFFF89401 DISPLAY_IDENTIFIER CtlDispPosFlash.KombiMsgOutOEM /end MEASUREMENT
/begin MEASUREMENT KombiMsgOutOEM.CtlDispPos_ "bit complement of displayed pos on kombi" UBYTE SBW_STANDARD_S1_S3 1 100 0 255 ECU_ADDRESS 0xFFF89400 DISPLAY_IDENTIFIER CtlDispPos_.KombiMsgOutOEM /end MEASUREMENT
/begin MEASUREMENT KombiMsgPos.DisplayPos "SBW-internal display position (same coding as PosPRND: P=8 R=7 N=6 D=5 noaction=0)" UBYTE SBW_STANDARD_S1_S3 1 100 0 8 ECU_ADDRESS 0xFFF8993C DISPLAY_IDENTIFIER DisplayPos.KombiMsgPos /end MEASUREMENT
/begin MEASUREMENT KombiMsgPos.DisplayPosFlash "SBW-internal flashing display position (coding: C_FlashON=1; C_FlashOFF=0; C_FlashInvalid=3;)" UBYTE SBW_STANDARD_S1_S3 1 100 0 3 ECU_ADDRESS 0xFFF8993E DISPLAY_IDENTIFIER DisplayPosFlash.KombiMsgPos /end MEASUREMENT
/begin MEASUREMENT KombiMsgPos.DisplayPosRule "Diagnose Value for checking by which Display Position Rule value was given" UBYTE SBW_STANDARD_S1_S3 1 100 0 20 ECU_ADDRESS 0xFFF8993F DISPLAY_IDENTIFIER DisplayPosRule.KombiMsgPos /end MEASUREMENT
/begin MEASUREMENT KombiMsgPos.DisplayPos_ "SBW-internal display position complement" UBYTE SBW_STANDARD_S1_S3 1 100 248 255 ECU_ADDRESS 0xFFF8993D DISPLAY_IDENTIFIER DisplayPos_.KombiMsgPos /end MEASUREMENT
/begin MEASUREMENT Level2Signals.L2_AcceleratorPedalAngle.Complement "Accelerator Pedal Angle" UBYTE SBW_STANDARD_S1_S3 1 100 0 255 ECU_ADDRESS 0xFFF98063 DISPLAY_IDENTIFIER Complement.L2_AcceleratorPedalAngle.Level2Signals /end MEASUREMENT
/begin MEASUREMENT Level2Signals.L2_AcceleratorPedalAngle.Value "Accelerator Pedal Angle" UBYTE SBW_HDK_M_S1_S3 1 100 0 100.4 ECU_ADDRESS 0xFFF98062 DISPLAY_IDENTIFIER Value.L2_AcceleratorPedalAngle.Level2Signals /end MEASUREMENT
/begin MEASUREMENT Level2Signals.L2_AcceleratorPedalAngleSts.Complement "Signal status of Accelerator Pedal Angle" UBYTE SBW_STANDARD_S1_S3 1 100 0 2 ECU_ADDRESS 0xFFF98065 DISPLAY_IDENTIFIER Complement.L2_AcceleratorPedalAngleSts.Level2Signals /end MEASUREMENT
/begin MEASUREMENT Level2Signals.L2_AcceleratorPedalAngleSts.Value "Signal status of Accelerator Pedal Angle" UBYTE SBW_STANDARD_S1_S3 1 100 0 2 ECU_ADDRESS 0xFFF98064 DISPLAY_IDENTIFIER Value.L2_AcceleratorPedalAngleSts.Level2Signals /end MEASUREMENT
/begin MEASUREMENT Level2Signals.L2_BrakePedalDrvAssistSts.Complement "level 2 signal status of _GET_FBR_DRV_ASSIST: 0=signal o.k. 1=signal subst.value 2=signal n.o.k./err." UBYTE SBW_STANDARD_S1_S3 1 100 0 2 ECU_ADDRESS 0xFFF9802B DISPLAY_IDENTIFIER Complement.L2_BrakePedalDrvAssistSts.Level2Signals /end MEASUREMENT
/begin MEASUREMENT Level2Signals.L2_BrakePedalDrvAssistSts.Value "level 2 signal status of _GET_FBR_DRV_ASSIST: 0=signal o.k. 1=signal subst.value 2=signal n.o.k./err." UBYTE SBW_STANDARD_S1_S3 1 100 0 2 ECU_ADDRESS 0xFFF9802A DISPLAY_IDENTIFIER Value.L2_BrakePedalDrvAssistSts.Level2Signals /end MEASUREMENT
/begin MEASUREMENT Level2Signals.L2_BrakePedalSts.Complement "state of signal BrakePedal" UBYTE SBW_STANDARD_S1_S3 1 100 0 2 ECU_ADDRESS 0xFFF9804F DISPLAY_IDENTIFIER Complement.L2_BrakePedalSts.Level2Signals /end MEASUREMENT
/begin MEASUREMENT Level2Signals.L2_BrakePedalSts.Value "state of signal BrakePedal" UBYTE SBW_STANDARD_S1_S3 1 100 0 2 ECU_ADDRESS 0xFFF9804E DISPLAY_IDENTIFIER Value.L2_BrakePedalSts.Level2Signals /end MEASUREMENT
/begin MEASUREMENT Level2Signals.L2_BrakePressure.Complement "brake Pressure" UWORD SBW_STANDARD_S1_S3 1 100 0 65535 ECU_ADDRESS 0xFFF98048 DISPLAY_IDENTIFIER Complement.L2_BrakePressure.Level2Signals /end MEASUREMENT
/begin MEASUREMENT Level2Signals.L2_BrakePressure.Value "brake Pressure" UWORD SBW_P_BREMSE_2_S1_S3 1 100 0 32767.5 ECU_ADDRESS 0xFFF98046 DISPLAY_IDENTIFIER Value.L2_BrakePressure.Level2Signals /end MEASUREMENT
/begin MEASUREMENT Level2Signals.L2_BrakePressureSts.Complement "flag brake light/brake test" UBYTE SBW_STANDARD_S1_S3 1 100 0 2 ECU_ADDRESS 0xFFF9804D DISPLAY_IDENTIFIER Complement.L2_BrakePressureSts.Level2Signals /end MEASUREMENT
/begin MEASUREMENT Level2Signals.L2_BrakePressureSts.Value "flag brake light/brake test" UBYTE SBW_STANDARD_S1_S3 1 100 0 2 ECU_ADDRESS 0xFFF9804C DISPLAY_IDENTIFIER Value.L2_BrakePressureSts.Level2Signals /end MEASUREMENT
/begin MEASUREMENT Level2Signals.L2_CtrlSignalSourceSts.Complement "Status of source of signal" UBYTE SBW_STANDARD_S1_S3 1 100 0 2 ECU_ADDRESS 0xFFF98059 DISPLAY_IDENTIFIER Complement.L2_CtrlSignalSourceSts.Level2Signals /end MEASUREMENT
/begin MEASUREMENT Level2Signals.L2_CtrlSignalSourceSts.Value "Status of source of signal" UBYTE SBW_STANDARD_S1_S3 1 100 0 2 ECU_ADDRESS 0xFFF98058 DISPLAY_IDENTIFIER Value.L2_CtrlSignalSourceSts.Level2Signals /end MEASUREMENT
/begin MEASUREMENT Level2Signals.L2_DoorDSts.Complement "status of signal 'door open'" UBYTE SBW_STANDARD_S1_S3 1 100 0 2 ECU_ADDRESS 0xFFF9805D DISPLAY_IDENTIFIER Complement.L2_DoorDSts.Level2Signals /end MEASUREMENT
/begin MEASUREMENT Level2Signals.L2_DoorDSts.Value "status of signal 'door open'" UBYTE SBW_STANDARD_S1_S3 1 100 0 2 ECU_ADDRESS 0xFFF9805C DISPLAY_IDENTIFIER Value.L2_DoorDSts.Level2Signals /end MEASUREMENT
/begin MEASUREMENT Level2Signals.L2_DrvReq_Raw.Complement "Driver request by Level2" UBYTE SBW_STANDARD_S1_S3 1 100 0 7 ECU_ADDRESS 0xFFF98085 DISPLAY_IDENTIFIER Complement.L2_DrvReq_Raw.Level2Signals /end MEASUREMENT
/begin MEASUREMENT Level2Signals.L2_DrvReq_Raw.Value "Driver request by Level2" UBYTE SBW_STANDARD_S1_S3 1 100 0 7 ECU_ADDRESS 0xFFF98084 DISPLAY_IDENTIFIER Value.L2_DrvReq_Raw.Level2Signals /end MEASUREMENT
/begin MEASUREMENT Level2Signals.L2_GatePosRaw.Complement "raw val. of gate position - left-right-noaction for level 2" UBYTE SBW_STANDARD_S1_S3 1 100 0 255 ECU_ADDRESS 0xFFF98055 DISPLAY_IDENTIFIER Complement.L2_GatePosRaw.Level2Signals /end MEASUREMENT
/begin MEASUREMENT Level2Signals.L2_GatePosRaw.Value "raw val. of gate position - left-right-noaction for level 2" UBYTE SBW_STANDARD_S1_S3 1 100 0 255 ECU_ADDRESS 0xFFF98054 DISPLAY_IDENTIFIER Value.L2_GatePosRaw.Level2Signals /end MEASUREMENT
/begin MEASUREMENT Level2Signals.L2_GearboxDrvRdy.Complement "signal GearboxDrvRdy for level 2" UBYTE SBW_STANDARD_S1_S3 1 100 0 255 ECU_ADDRESS 0xFFF9802D DISPLAY_IDENTIFIER Complement.L2_GearboxDrvRdy.Level2Signals /end MEASUREMENT
/begin MEASUREMENT Level2Signals.L2_GearboxDrvRdy.Value "signal GearboxDrvRdy for level 2" UBYTE SBW_STANDARD_S1_S3 1 100 0 255 ECU_ADDRESS 0xFFF9802C DISPLAY_IDENTIFIER Value.L2_GearboxDrvRdy.Level2Signals /end MEASUREMENT
/begin MEASUREMENT Level2Signals.L2_GearboxDrvRdySts.Complement "state of signal GearboxDrvRdy for level 2" UBYTE SBW_STANDARD_S1_S3 1 100 0 255 ECU_ADDRESS 0xFFF9802F DISPLAY_IDENTIFIER Complement.L2_GearboxDrvRdySts.Level2Signals /end MEASUREMENT
/begin MEASUREMENT Level2Signals.L2_GearboxDrvRdySts.Value "state of signal GearboxDrvRdy for level 2" UBYTE SBW_STANDARD_S1_S3 1 100 0 255 ECU_ADDRESS 0xFFF9802E DISPLAY_IDENTIFIER Value.L2_GearboxDrvRdySts.Level2Signals /end MEASUREMENT
/begin MEASUREMENT Level2Signals.L2_IgnOnRawSts.Complement "state ignition (raw-value)" UBYTE SBW_STANDARD_S1_S3 1 100 0 2 ECU_ADDRESS 0xFFF98037 DISPLAY_IDENTIFIER Complement.L2_IgnOnRawSts.Level2Signals /end MEASUREMENT
/begin MEASUREMENT Level2Signals.L2_IgnOnRawSts.Value "state ignition (raw-value)" UBYTE SBW_STANDARD_S1_S3 1 100 0 2 ECU_ADDRESS 0xFFF98036 DISPLAY_IDENTIFIER Value.L2_IgnOnRawSts.Level2Signals /end MEASUREMENT
/begin MEASUREMENT Level2Signals.L2_IgnOnSts.Complement "Ignition status for Level2" UBYTE SBW_STANDARD_S1_S3 1 100 0 2 ECU_ADDRESS 0xFFF9806F DISPLAY_IDENTIFIER Complement.L2_IgnOnSts.Level2Signals /end MEASUREMENT
/begin MEASUREMENT Level2Signals.L2_IgnOnSts.Value "Ignition status for Level2" UBYTE SBW_STANDARD_S1_S3 1 100 0 2 ECU_ADDRESS 0xFFF9806E DISPLAY_IDENTIFIER Value.L2_IgnOnSts.Level2Signals /end MEASUREMENT
/begin MEASUREMENT Level2Signals.L2_ModeDrvAssistVehSts.Complement "level 2 signal status of _GET_MODE_DRV_ASSIST_VEH: 0=signal o.k. 1=signal subst.value 2=signal n.o.k./err." UBYTE SBW_STANDARD_S1_S3 1 100 0 2 ECU_ADDRESS 0xFFF98023 DISPLAY_IDENTIFIER Complement.L2_ModeDrvAssistVehSts.Level2Signals /end MEASUREMENT
/begin MEASUREMENT Level2Signals.L2_ModeDrvAssistVehSts.Value "level 2 signal status of _GET_MODE_DRV_ASSIST_VEH: 0=signal o.k. 1=signal subst.value 2=signal n.o.k./err." UBYTE SBW_STANDARD_S1_S3 1 100 0 2 ECU_ADDRESS 0xFFF98022 DISPLAY_IDENTIFIER Value.L2_ModeDrvAssistVehSts.Level2Signals /end MEASUREMENT
/begin MEASUREMENT Level2Signals.L2_PSensor.Complement "state of the parking lock (0=not engaged; 1=engaged; 2=intermediate pos.; 3=unknown) for level 2" UBYTE SBW_STANDARD_S1_S3 1 100 0 255 ECU_ADDRESS 0xFFF98045 DISPLAY_IDENTIFIER Complement.L2_PSensor.Level2Signals /end MEASUREMENT
/begin MEASUREMENT Level2Signals.L2_PSensor.Value "state of the parking lock (0=not engaged; 1=engaged; 2=intermediate pos.; 3=unknown) for level 2" UBYTE SBW_STANDARD_S1_S3 1 100 0 255 ECU_ADDRESS 0xFFF98044 DISPLAY_IDENTIFIER Value.L2_PSensor.Level2Signals /end MEASUREMENT
/begin MEASUREMENT Level2Signals.L2_PSensorSts.Complement "state P-sensor signal (0: ok 1: subst 2: err) for level 2" UBYTE SBW_STANDARD_S1_S3 1 100 0 2 ECU_ADDRESS 0xFFF98043 DISPLAY_IDENTIFIER Complement.L2_PSensorSts.Level2Signals /end MEASUREMENT
/begin MEASUREMENT Level2Signals.L2_PSensorSts.Value "state P-sensor signal (0: ok 1: subst 2: err) for level 2" UBYTE SBW_STANDARD_S1_S3 1 100 0 2 ECU_ADDRESS 0xFFF98042 DISPLAY_IDENTIFIER Value.L2_PSensorSts.Level2Signals /end MEASUREMENT
/begin MEASUREMENT Level2Signals.L2_PosDrvAssistRaw.Complement "level 2 FAS [PMA/RCP] request for driving-direction: 0=NA 5=D 6=N 7=R 8=P" UBYTE SBW_STANDARD_S1_S3 1 100 0 8 ECU_ADDRESS 0xFFF98025 DISPLAY_IDENTIFIER Complement.L2_PosDrvAssistRaw.Level2Signals /end MEASUREMENT
/begin MEASUREMENT Level2Signals.L2_PosDrvAssistRaw.Value "level 2 FAS [PMA/RCP] request for driving-direction: 0=NA 5=D 6=N 7=R 8=P" UBYTE SBW_STANDARD_S1_S3 1 100 0 8 ECU_ADDRESS 0xFFF98024 DISPLAY_IDENTIFIER Value.L2_PosDrvAssistRaw.Level2Signals /end MEASUREMENT
/begin MEASUREMENT Level2Signals.L2_PosDrvAssistRawSts.Complement "level 2 signal status of _GET_POS_DRV_ASSIST_RAW: 0=signal o.k. 1=signal subst.value 2=signal n.o.k./err." UBYTE SBW_STANDARD_S1_S3 1 100 0 2 ECU_ADDRESS 0xFFF98027 DISPLAY_IDENTIFIER Complement.L2_PosDrvAssistRawSts.Level2Signals /end MEASUREMENT
/begin MEASUREMENT Level2Signals.L2_PosDrvAssistRawSts.Value "level 2 signal status of _GET_POS_DRV_ASSIST_RAW: 0=signal o.k. 1=signal subst.value 2=signal n.o.k./err." UBYTE SBW_STANDARD_S1_S3 1 100 0 2 ECU_ADDRESS 0xFFF98026 DISPLAY_IDENTIFIER Value.L2_PosDrvAssistRawSts.Level2Signals /end MEASUREMENT
/begin MEASUREMENT Level2Signals.L2_PosPRND_Old.Complement "remind old position for triggered Position" UBYTE SBW_STANDARD_S1_S3 1 100 0 7 ECU_ADDRESS 0xFFF98089 DISPLAY_IDENTIFIER Complement.L2_PosPRND_Old.Level2Signals /end MEASUREMENT
/begin MEASUREMENT Level2Signals.L2_PosPRND_Old.Value "remind old position for triggered Position" UBYTE SBW_STANDARD_S1_S3 1 100 0 7 ECU_ADDRESS 0xFFF98088 DISPLAY_IDENTIFIER Value.L2_PosPRND_Old.Level2Signals /end MEASUREMENT
/begin MEASUREMENT Level2Signals.L2_PosPRND_PreviousOld.Complement "remind previos old position for functions that use old values in level1" UBYTE SBW_STANDARD_S1_S3 1 100 0 7 ECU_ADDRESS 0xFFF9808B DISPLAY_IDENTIFIER Complement.L2_PosPRND_PreviousOld.Level2Signals /end MEASUREMENT
/begin MEASUREMENT Level2Signals.L2_PosPRND_PreviousOld.Value "remind previos old position for functions that use old values in level1" UBYTE SBW_STANDARD_S1_S3 1 100 0 7 ECU_ADDRESS 0xFFF9808A DISPLAY_IDENTIFIER Value.L2_PosPRND_PreviousOld.Level2Signals /end MEASUREMENT
/begin MEASUREMENT Level2Signals.L2_PosRaw.Complement "raw val. of driver request (absolute or relative position) for level 2" UBYTE SBW_STANDARD_S1_S3 1 100 0 24 ECU_ADDRESS 0xFFF98051 DISPLAY_IDENTIFIER Complement.L2_PosRaw.Level2Signals /end MEASUREMENT
/begin MEASUREMENT Level2Signals.L2_PosRaw.Value "raw val. of driver request (absolute or relative position) for level 2" UBYTE SBW_STANDARD_S1_S3 1 100 0 24 ECU_ADDRESS 0xFFF98050 DISPLAY_IDENTIFIER Value.L2_PosRaw.Level2Signals /end MEASUREMENT
/begin MEASUREMENT Level2Signals.L2_PosRawRelOld.Complement "raw val. of previous driver request complement (absolute or relative position) for level 2" UBYTE SBW_STANDARD_S1_S3 1 100 0 7 ECU_ADDRESS 0xFFF98087 DISPLAY_IDENTIFIER Complement.L2_PosRawRelOld.Level2Signals /end MEASUREMENT
/begin MEASUREMENT Level2Signals.L2_PosRawRelOld.Value "raw val. of previous driver request complement (absolute or relative position) for level 2" UBYTE SBW_STANDARD_S1_S3 1 100 0 7 ECU_ADDRESS 0xFFF98086 DISPLAY_IDENTIFIER Value.L2_PosRawRelOld.Level2Signals /end MEASUREMENT
/begin MEASUREMENT Level2Signals.L2_SeatBeltSts.Complement "status of signal f_SeatBelt" UBYTE SBW_STANDARD_S1_S3 1 100 0 2 ECU_ADDRESS 0xFFF98061 DISPLAY_IDENTIFIER Complement.L2_SeatBeltSts.Level2Signals /end MEASUREMENT
/begin MEASUREMENT Level2Signals.L2_SeatBeltSts.Value "status of signal f_SeatBelt" UBYTE SBW_STANDARD_S1_S3 1 100 0 2 ECU_ADDRESS 0xFFF98060 DISPLAY_IDENTIFIER Value.L2_SeatBeltSts.Level2Signals /end MEASUREMENT
/begin MEASUREMENT Level2Signals.L2_SeatFLSts.Complement "Status of driver seat is occupied signal" UBYTE SBW_STANDARD_S1_S3 1 100 0 2 ECU_ADDRESS 0xFFF98069 DISPLAY_IDENTIFIER Complement.L2_SeatFLSts.Level2Signals /end MEASUREMENT
/begin MEASUREMENT Level2Signals.L2_SeatFLSts.Value "Status of driver seat is occupied signal" UBYTE SBW_STANDARD_S1_S3 1 100 0 2 ECU_ADDRESS 0xFFF98068 DISPLAY_IDENTIFIER Value.L2_SeatFLSts.Level2Signals /end MEASUREMENT
/begin MEASUREMENT Level2Signals.L2_VehicleDrvRdy.Complement "signal VehicleDrvRdy for level 2" UBYTE SBW_STANDARD_S1_S3 1 100 0 255 ECU_ADDRESS 0xFFF98031 DISPLAY_IDENTIFIER Complement.L2_VehicleDrvRdy.Level2Signals /end MEASUREMENT
/begin MEASUREMENT Level2Signals.L2_VehicleDrvRdy.Value "signal VehicleDrvRdy for level 2" UBYTE SBW_STANDARD_S1_S3 1 100 0 255 ECU_ADDRESS 0xFFF98030 DISPLAY_IDENTIFIER Value.L2_VehicleDrvRdy.Level2Signals /end MEASUREMENT
/begin MEASUREMENT Level2Signals.L2_VehicleDrvRdySts.Complement "state of signal VehicleDrvRdy for level 2" UBYTE SBW_STANDARD_S1_S3 1 100 0 255 ECU_ADDRESS 0xFFF98033 DISPLAY_IDENTIFIER Complement.L2_VehicleDrvRdySts.Level2Signals /end MEASUREMENT
/begin MEASUREMENT Level2Signals.L2_VehicleDrvRdySts.Value "state of signal VehicleDrvRdy for level 2" UBYTE SBW_STANDARD_S1_S3 1 100 0 255 ECU_ADDRESS 0xFFF98032 DISPLAY_IDENTIFIER Value.L2_VehicleDrvRdySts.Level2Signals /end MEASUREMENT
/begin MEASUREMENT Level2Signals.L2_f_BrakePedal.Complement "flag brake light/brake test" UBYTE SBW_STANDARD_S1_S3 1 100 0 1 BIT_MASK 0x1 ECU_ADDRESS 0xFFF9804B DISPLAY_IDENTIFIER Complement.L2_f_BrakePedal.Level2Signals /end MEASUREMENT
/begin MEASUREMENT Level2Signals.L2_f_BrakePedal.Value "flag brake light/brake test" UBYTE SBW_STANDARD_S1_S3 1 100 0 1 BIT_MASK 0x1 ECU_ADDRESS 0xFFF9804A DISPLAY_IDENTIFIER Value.L2_f_BrakePedal.Level2Signals /end MEASUREMENT
/begin MEASUREMENT Level2Signals.L2_f_BrakePedalDrvAssist.Complement "level 2 brake-activation flag by FAS [PMA/RCP] from ICM-ECU: 0=brake by FAS inactive 1=brake by FAS active" UBYTE SBW_STANDARD_S1_S3 1 100 0 1 ECU_ADDRESS 0xFFF98029 DISPLAY_IDENTIFIER Complement.L2_f_BrakePedalDrvAssist.Level2Signals /end MEASUREMENT
/begin MEASUREMENT Level2Signals.L2_f_BrakePedalDrvAssist.Value "level 2 brake-activation flag by FAS [PMA/RCP] from ICM-ECU: 0=brake by FAS inactive 1=brake by FAS active" UBYTE SBW_STANDARD_S1_S3 1 100 0 1 ECU_ADDRESS 0xFFF98028 DISPLAY_IDENTIFIER Value.L2_f_BrakePedalDrvAssist.Level2Signals /end MEASUREMENT
/begin MEASUREMENT Level2Signals.L2_f_BrakePedalSL.Complement "if lever is moved in opposite direction lever movements are ignored until NA" UBYTE SBW_STANDARD_S1_S3 1 100 0 1 BIT_MASK 0x1 ECU_ADDRESS 0xFFF9808E DISPLAY_IDENTIFIER Complement.L2_f_BrakePedalSL.Level2Signals /end MEASUREMENT
/begin MEASUREMENT Level2Signals.L2_f_BrakePedalSL.Value "if lever is moved in opposite direction lever movements are ignored until NA" UBYTE SBW_STANDARD_S1_S3 1 100 0 1 BIT_MASK 0x1 ECU_ADDRESS 0xFFF9808D DISPLAY_IDENTIFIER Value.L2_f_BrakePedalSL.Level2Signals /end MEASUREMENT
/begin MEASUREMENT Level2Signals.L2_f_DoorD.Complement "driver side door open" UBYTE SBW_STANDARD_S1_S3 1 100 0 1 BIT_MASK 0x1 ECU_ADDRESS 0xFFF9805B DISPLAY_IDENTIFIER Complement.L2_f_DoorD.Level2Signals /end MEASUREMENT
/begin MEASUREMENT Level2Signals.L2_f_DoorD.Value "driver side door open" UBYTE SBW_STANDARD_S1_S3 1 100 0 1 BIT_MASK 0x1 ECU_ADDRESS 0xFFF9805A DISPLAY_IDENTIFIER Value.L2_f_DoorD.Level2Signals /end MEASUREMENT
/begin MEASUREMENT Level2Signals.L2_f_DrvLeavesCar.Complement "Indicates that the driver leaves the car" UBYTE SBW_STANDARD_S1_S3 1 100 0 1 BIT_MASK 0x1 ECU_ADDRESS 0xFFF98094 DISPLAY_IDENTIFIER Complement.L2_f_DrvLeavesCar.Level2Signals /end MEASUREMENT
/begin MEASUREMENT Level2Signals.L2_f_DrvLeavesCar.Value "Indicates that the driver leaves the car" UBYTE SBW_STANDARD_S1_S3 1 100 0 1 BIT_MASK 0x1 ECU_ADDRESS 0xFFF98093 DISPLAY_IDENTIFIER Value.L2_f_DrvLeavesCar.Level2Signals /end MEASUREMENT
/begin MEASUREMENT Level2Signals.L2_f_DrvLeavesCarBrakeAccPed.Complement "Flag for combined Door Seatbelt status" UBYTE SBW_STANDARD_S1_S3 1 100 0 1 BIT_MASK 0x1 ECU_ADDRESS 0xFFF98092 DISPLAY_IDENTIFIER Complement.L2_f_DrvLeavesCarBrakeAccPed.Level2Signals /end MEASUREMENT
/begin MEASUREMENT Level2Signals.L2_f_DrvLeavesCarBrakeAccPed.Value "Flag for combined Door Seatbelt status" UBYTE SBW_STANDARD_S1_S3 1 100 0 1 BIT_MASK 0x1 ECU_ADDRESS 0xFFF98091 DISPLAY_IDENTIFIER Value.L2_f_DrvLeavesCarBrakeAccPed.Level2Signals /end MEASUREMENT
/begin MEASUREMENT Level2Signals.L2_f_DrvLeavesCarDoorSeatb.Complement "Flag for combined Door Seatbelt status" UBYTE SBW_STANDARD_S1_S3 1 100 0 1 BIT_MASK 0x1 ECU_ADDRESS 0xFFF98090 DISPLAY_IDENTIFIER Complement.L2_f_DrvLeavesCarDoorSeatb.Level2Signals /end MEASUREMENT
/begin MEASUREMENT Level2Signals.L2_f_DrvLeavesCarDoorSeatb.Value "Flag for combined Door Seatbelt status" UBYTE SBW_STANDARD_S1_S3 1 100 0 1 BIT_MASK 0x1 ECU_ADDRESS 0xFFF9808F DISPLAY_IDENTIFIER Value.L2_f_DrvLeavesCarDoorSeatb.Level2Signals /end MEASUREMENT
/begin MEASUREMENT Level2Signals.L2_f_EngOn.Complement "flag engine on for SBW [shift by wire] for Level2" UBYTE SBW_STANDARD_S1_S3 1 100 0 1 BIT_MASK 0x1 ECU_ADDRESS 0xFFF98075 DISPLAY_IDENTIFIER Complement.L2_f_EngOn.Level2Signals /end MEASUREMENT
/begin MEASUREMENT Level2Signals.L2_f_EngOn.Value "flag engine on for SBW [shift by wire] for Level2" UBYTE SBW_STANDARD_S1_S3 1 100 0 1 BIT_MASK 0x1 ECU_ADDRESS 0xFFF98074 DISPLAY_IDENTIFIER Value.L2_f_EngOn.Level2Signals /end MEASUREMENT
/begin MEASUREMENT Level2Signals.L2_f_GearboxReadySts_Old.Complement "gearbox status ready for Level2 from last cycle 0=off 1=on" UBYTE SBW_STANDARD_S1_S3 1 100 0 1 BIT_MASK 0x1 ECU_ADDRESS 0xFFF98079 DISPLAY_IDENTIFIER Complement.L2_f_GearboxReadySts_Old.Level2Signals /end MEASUREMENT
/begin MEASUREMENT Level2Signals.L2_f_GearboxReadySts_Old.Value "gearbox status ready for Level2 from last cycle 0=off 1=on" UBYTE SBW_STANDARD_S1_S3 1 100 0 1 BIT_MASK 0x1 ECU_ADDRESS 0xFFF98078 DISPLAY_IDENTIFIER Value.L2_f_GearboxReadySts_Old.Level2Signals /end MEASUREMENT
/begin MEASUREMENT Level2Signals.L2_f_GearboxReady_Old.Complement "gearbox ready for Level2 from last cycle 0=off 1=on" UBYTE SBW_STANDARD_S1_S3 1 100 0 1 BIT_MASK 0x1 ECU_ADDRESS 0xFFF98077 DISPLAY_IDENTIFIER Complement.L2_f_GearboxReady_Old.Level2Signals /end MEASUREMENT
/begin MEASUREMENT Level2Signals.L2_f_GearboxReady_Old.Value "gearbox ready for Level2 from last cycle 0=off 1=on" UBYTE SBW_STANDARD_S1_S3 1 100 0 1 BIT_MASK 0x1 ECU_ADDRESS 0xFFF98076 DISPLAY_IDENTIFIER Value.L2_f_GearboxReady_Old.Level2Signals /end MEASUREMENT
/begin MEASUREMENT Level2Signals.L2_f_IgnOn.Complement "Ignition flag for Level2" UBYTE SBW_STANDARD_S1_S3 1 100 0 1 BIT_MASK 0x1 ECU_ADDRESS 0xFFF9806D DISPLAY_IDENTIFIER Complement.L2_f_IgnOn.Level2Signals /end MEASUREMENT
/begin MEASUREMENT Level2Signals.L2_f_IgnOn.Value "Ignition flag for Level2" UBYTE SBW_STANDARD_S1_S3 1 100 0 1 BIT_MASK 0x1 ECU_ADDRESS 0xFFF9806C DISPLAY_IDENTIFIER Value.L2_f_IgnOn.Level2Signals /end MEASUREMENT
/begin MEASUREMENT Level2Signals.L2_f_MechLimp.Complement "Mech. limphome flag for Level2" UBYTE SBW_STANDARD_S1_S3 1 100 0 1 BIT_MASK 0x1 ECU_ADDRESS 0xFFF9807B DISPLAY_IDENTIFIER Complement.L2_f_MechLimp.Level2Signals /end MEASUREMENT
/begin MEASUREMENT Level2Signals.L2_f_MechLimp.Value "Mech. limphome flag for Level2" UBYTE SBW_STANDARD_S1_S3 1 100 0 1 BIT_MASK 0x1 ECU_ADDRESS 0xFFF9807A DISPLAY_IDENTIFIER Value.L2_f_MechLimp.Level2Signals /end MEASUREMENT
/begin MEASUREMENT Level2Signals.L2_f_ModeDrvAssistVeh.Complement "level 2 FAS-signal [PMA/RCP] from ICM-ECU: 0=PMA/RCP-mode inactive 1=PMA/RCP-mode active" UBYTE SBW_STANDARD_S1_S3 1 100 0 1 ECU_ADDRESS 0xFFF98021 DISPLAY_IDENTIFIER Complement.L2_f_ModeDrvAssistVeh.Level2Signals /end MEASUREMENT
/begin MEASUREMENT Level2Signals.L2_f_ModeDrvAssistVeh.Value "level 2 FAS-signal [PMA/RCP] from ICM-ECU: 0=PMA/RCP-mode inactive 1=PMA/RCP-mode active" UBYTE SBW_STANDARD_S1_S3 1 100 0 1 ECU_ADDRESS 0xFFF98020 DISPLAY_IDENTIFIER Value.L2_f_ModeDrvAssistVeh.Level2Signals /end MEASUREMENT
/begin MEASUREMENT Level2Signals.L2_f_P12Button.Complement "flag park-button pressed for level 2" UBYTE SBW_STANDARD_S1_S3 1 100 0 1 BIT_MASK 0x1 ECU_ADDRESS 0xFFF98057 DISPLAY_IDENTIFIER Complement.L2_f_P12Button.Level2Signals /end MEASUREMENT
/begin MEASUREMENT Level2Signals.L2_f_P12Button.Value "flag park-button pressed for level 2" UBYTE SBW_STANDARD_S1_S3 1 100 0 1 BIT_MASK 0x1 ECU_ADDRESS 0xFFF98056 DISPLAY_IDENTIFIER Value.L2_f_P12Button.Level2Signals /end MEASUREMENT
/begin MEASUREMENT Level2Signals.L2_f_ParkLock.Complement "flag parking lock for Level2" UBYTE SBW_STANDARD_S1_S3 1 100 0 1 BIT_MASK 0x1 ECU_ADDRESS 0xFFF98081 DISPLAY_IDENTIFIER Complement.L2_f_ParkLock.Level2Signals /end MEASUREMENT
/begin MEASUREMENT Level2Signals.L2_f_ParkLock.Value "flag parking lock for Level2" UBYTE SBW_STANDARD_S1_S3 1 100 0 1 BIT_MASK 0x1 ECU_ADDRESS 0xFFF98080 DISPLAY_IDENTIFIER Value.L2_f_ParkLock.Level2Signals /end MEASUREMENT
/begin MEASUREMENT Level2Signals.L2_f_ResyncNeeded.Complement "Flag for accepting first driver request RND principially after engine on for Level2" UBYTE SBW_STANDARD_S1_S3 1 100 0 1 BIT_MASK 0x1 ECU_ADDRESS 0xFFF98083 DISPLAY_IDENTIFIER Complement.L2_f_ResyncNeeded.Level2Signals /end MEASUREMENT
/begin MEASUREMENT Level2Signals.L2_f_ResyncNeeded.Value "Flag for accepting first driver request RND principially after engine on for Level2" UBYTE SBW_STANDARD_S1_S3 1 100 0 1 BIT_MASK 0x1 ECU_ADDRESS 0xFFF98082 DISPLAY_IDENTIFIER Value.L2_f_ResyncNeeded.Level2Signals /end MEASUREMENT
/begin MEASUREMENT Level2Signals.L2_f_SeatBelt.Complement "driver seat belt 0=open 1=closed" UBYTE SBW_STANDARD_S1_S3 1 100 0 1 BIT_MASK 0x1 ECU_ADDRESS 0xFFF9805F DISPLAY_IDENTIFIER Complement.L2_f_SeatBelt.Level2Signals /end MEASUREMENT
/begin MEASUREMENT Level2Signals.L2_f_SeatBelt.Value "driver seat belt 0=open 1=closed" UBYTE SBW_STANDARD_S1_S3 1 100 0 1 BIT_MASK 0x1 ECU_ADDRESS 0xFFF9805E DISPLAY_IDENTIFIER Value.L2_f_SeatBelt.Level2Signals /end MEASUREMENT
/begin MEASUREMENT Level2Signals.L2_f_SeatFL.Complement "driver seat is occupied" UBYTE SBW_STANDARD_S1_S3 1 100 0 1 BIT_MASK 0x1 ECU_ADDRESS 0xFFF98067 DISPLAY_IDENTIFIER Complement.L2_f_SeatFL.Level2Signals /end MEASUREMENT
/begin MEASUREMENT Level2Signals.L2_f_SeatFL.Value "driver seat is occupied" UBYTE SBW_STANDARD_S1_S3 1 100 0 1 BIT_MASK 0x1 ECU_ADDRESS 0xFFF98066 DISPLAY_IDENTIFIER Value.L2_f_SeatFL.Level2Signals /end MEASUREMENT
/begin MEASUREMENT Level2Signals.L2_f_V_Implausible.Complement "flag implausible speed" UBYTE SBW_STANDARD_S1_S3 1 100 0 1 BIT_MASK 0x1 ECU_ADDRESS 0xFFF9806B DISPLAY_IDENTIFIER Complement.L2_f_V_Implausible.Level2Signals /end MEASUREMENT
/begin MEASUREMENT Level2Signals.L2_f_V_Implausible.Value "flag implausible speed" UBYTE SBW_STANDARD_S1_S3 1 100 0 1 BIT_MASK 0x1 ECU_ADDRESS 0xFFF9806A DISPLAY_IDENTIFIER Value.L2_f_V_Implausible.Level2Signals /end MEASUREMENT
/begin MEASUREMENT Level2Signals.L2_n_AbRaw.Complement "drive/output rev.s (raw- or subst.value) for level 2" UWORD SBW_STANDARD_S1_S3 1 100 0 20000 ECU_ADDRESS 0xFFF9803A DISPLAY_IDENTIFIER Complement.L2_n_AbRaw.Level2Signals /end MEASUREMENT
/begin MEASUREMENT Level2Signals.L2_n_AbRaw.Value "drive/output rev.s (raw- or subst.value) for level 2" UWORD SBW_N_1_M_S1_S3 1 100 0 20000 ECU_ADDRESS 0xFFF98038 DISPLAY_IDENTIFIER Value.L2_n_AbRaw.Level2Signals /end MEASUREMENT
/begin MEASUREMENT Level2Signals.L2_st_EngOn.Complement "status engine on for SBW [shift by wire] 0=off 1=on 2=standby for Level2" UBYTE SBW_STANDARD_S1_S3 1 100 0 2 ECU_ADDRESS 0xFFF98071 DISPLAY_IDENTIFIER Complement.L2_st_EngOn.Level2Signals /end MEASUREMENT
/begin MEASUREMENT Level2Signals.L2_st_EngOn.Value "status engine on for SBW [shift by wire] 0=off 1=on 2=standby for Level2" UBYTE SBW_STANDARD_S1_S3 1 100 0 2 ECU_ADDRESS 0xFFF98070 DISPLAY_IDENTIFIER Value.L2_st_EngOn.Level2Signals /end MEASUREMENT
/begin MEASUREMENT Level2Signals.L2_st_EngOnOld.Complement "previous status engine on for SBW [shift by wire] 0=off 1=on 2=standby for Level2" UBYTE SBW_STANDARD_S1_S3 1 100 0 2 ECU_ADDRESS 0xFFF98073 DISPLAY_IDENTIFIER Complement.L2_st_EngOnOld.Level2Signals /end MEASUREMENT
/begin MEASUREMENT Level2Signals.L2_st_EngOnOld.Value "previous status engine on for SBW [shift by wire] 0=off 1=on 2=standby for Level2" UBYTE SBW_STANDARD_S1_S3 1 100 0 2 ECU_ADDRESS 0xFFF98072 DISPLAY_IDENTIFIER Value.L2_st_EngOnOld.Level2Signals /end MEASUREMENT
/begin MEASUREMENT Level2Signals.L2_st_IgnOnRaw.Complement "state ignition on/off (raw-value) for level 2" UBYTE SBW_STANDARD_S1_S3 1 100 0 4 ECU_ADDRESS 0xFFF98035 DISPLAY_IDENTIFIER Complement.L2_st_IgnOnRaw.Level2Signals /end MEASUREMENT
/begin MEASUREMENT Level2Signals.L2_st_IgnOnRaw.Value "state ignition on/off (raw-value) for level 2" UBYTE SBW_STANDARD_S1_S3 1 100 0 4 ECU_ADDRESS 0xFFF98034 DISPLAY_IDENTIFIER Value.L2_st_IgnOnRaw.Level2Signals /end MEASUREMENT
/begin MEASUREMENT Level2Signals.L2_st_LeverType.Complement "state of application lable 'GET_SWI_LEVER_TYPE' 0=auto 1=sport 2=IEX for level 2" UBYTE SBW_STANDARD_S1_S3 1 100 0 2 ECU_ADDRESS 0xFFF98053 DISPLAY_IDENTIFIER Complement.L2_st_LeverType.Level2Signals /end MEASUREMENT
/begin MEASUREMENT Level2Signals.L2_st_LeverType.Value "state of application lable 'GET_SWI_LEVER_TYPE' 0=auto 1=sport 2=IEX for level 2" UBYTE SBW_STANDARD_S1_S3 1 100 0 2 ECU_ADDRESS 0xFFF98052 DISPLAY_IDENTIFIER Value.L2_st_LeverType.Level2Signals /end MEASUREMENT
/begin MEASUREMENT Level2Signals.L2_st_Limphome.Complement "L2_st_Limphome: xxxx xxx1: lowside switch opened xxxx xx1x: highside switch [FET] opened" UBYTE SBW_STANDARD_S1_S3 1 100 0 255 ECU_ADDRESS 0xFFF9803D DISPLAY_IDENTIFIER Complement.L2_st_Limphome.Level2Signals /end MEASUREMENT
/begin MEASUREMENT Level2Signals.L2_st_Limphome.Value "L2_st_Limphome: xxxx xxx1: lowside switch opened xxxx xx1x: highside switch [FET] opened" UBYTE SBW_STANDARD_S1_S3 1 100 0 255 ECU_ADDRESS 0xFFF9803C DISPLAY_IDENTIFIER Value.L2_st_Limphome.Level2Signals /end MEASUREMENT
/begin MEASUREMENT Level2Signals.L2_st_ModeDrvAssistTrans.Complement "level 2 status for EGS-FAS-mode [0: 2:rejected 1: permitted/activated]" UBYTE SBW_STANDARD_S1_S3 1 100 0 2 ECU_ADDRESS 0xFFF98096 DISPLAY_IDENTIFIER Complement.L2_st_ModeDrvAssistTrans.Level2Signals /end MEASUREMENT
/begin MEASUREMENT Level2Signals.L2_st_ModeDrvAssistTrans.Value "level 2 status for EGS-FAS-mode [0: 2:rejected 1: permitted/activated]" UBYTE SBW_STANDARD_S1_S3 1 100 0 2 ECU_ADDRESS 0xFFF98095 DISPLAY_IDENTIFIER Value.L2_st_ModeDrvAssistTrans.Level2Signals /end MEASUREMENT
/begin MEASUREMENT Level2Signals.L2_tmr_DebounceGearboxReady.f_IsExpired.Complement "test_timer" UBYTE SBW_STANDARD_S1_S3 1 100 0 255 ECU_ADDRESS 0xFFF9801B DISPLAY_IDENTIFIER Complement.f_IsExpired.L2_tmr_DebounceGearboxReady.Level2Signals /end MEASUREMENT
/begin MEASUREMENT Level2Signals.L2_tmr_DebounceGearboxReady.f_IsExpired.Value "test_timer" UBYTE SBW_STANDARD_S1_S3 1 100 0 255 ECU_ADDRESS 0xFFF9801A DISPLAY_IDENTIFIER Value.f_IsExpired.L2_tmr_DebounceGearboxReady.Level2Signals /end MEASUREMENT
/begin MEASUREMENT Level2Signals.L2_tmr_DebounceGearboxReady.time.Complement "test_timer" UBYTE SBW_STANDARD_S1_S3 1 100 0 255 ECU_ADDRESS 0xFFF98019 DISPLAY_IDENTIFIER Complement.time.L2_tmr_DebounceGearboxReady.Level2Signals /end MEASUREMENT
/begin MEASUREMENT Level2Signals.L2_tmr_DebounceGearboxReady.time.Value "test_timer" UBYTE SBW_TIMER_10MS_S1_S3 1 100 0 2550 ECU_ADDRESS 0xFFF98018 DISPLAY_IDENTIFIER Value.time.L2_tmr_DebounceGearboxReady.Level2Signals /end MEASUREMENT
/begin MEASUREMENT Level2Signals.L2_tmr_DebounceGearboxReadySts.f_IsExpired.Complement "test_timer" UBYTE SBW_STANDARD_S1_S3 1 100 0 255 ECU_ADDRESS 0xFFF9801F DISPLAY_IDENTIFIER Complement.f_IsExpired.L2_tmr_DebounceGearboxReadySts.Level2Signals /end MEASUREMENT
/begin MEASUREMENT Level2Signals.L2_tmr_DebounceGearboxReadySts.f_IsExpired.Value "test_timer" UBYTE SBW_STANDARD_S1_S3 1 100 0 255 ECU_ADDRESS 0xFFF9801E DISPLAY_IDENTIFIER Value.f_IsExpired.L2_tmr_DebounceGearboxReadySts.Level2Signals /end MEASUREMENT
/begin MEASUREMENT Level2Signals.L2_tmr_DebounceGearboxReadySts.time.Complement "test_timer" UBYTE SBW_STANDARD_S1_S3 1 100 0 255 ECU_ADDRESS 0xFFF9801D DISPLAY_IDENTIFIER Complement.time.L2_tmr_DebounceGearboxReadySts.Level2Signals /end MEASUREMENT
/begin MEASUREMENT Level2Signals.L2_tmr_DebounceGearboxReadySts.time.Value "test_timer" UBYTE SBW_TIMER_10MS_S1_S3 1 100 0 2550 ECU_ADDRESS 0xFFF9801C DISPLAY_IDENTIFIER Value.time.L2_tmr_DebounceGearboxReadySts.Level2Signals /end MEASUREMENT
/begin MEASUREMENT Level2Signals.L2_v_VehSpdMin.Complement "vehicle speed [minimal selection Level2]" UWORD SBW_STANDARD_S1_S3 1 100 0 350 ECU_ADDRESS 0xFFF9807E DISPLAY_IDENTIFIER Complement.L2_v_VehSpdMin.Level2Signals /end MEASUREMENT
/begin MEASUREMENT Level2Signals.L2_v_VehSpdMin.Value "vehicle speed [minimal selection Level2]" UWORD SBW_VKMH_16_S1_S3 1 100 0 21.875 ECU_ADDRESS 0xFFF9807C DISPLAY_IDENTIFIER Value.L2_v_VehSpdMin.Level2Signals /end MEASUREMENT
/begin MEASUREMENT Level2Signals.L2_v_VehSpd_nab.Complement "vehicle speed for level 2 with complement" UWORD SBW_STANDARD_S1_S3 1 100 0 350 ECU_ADDRESS 0xFFF98040 DISPLAY_IDENTIFIER Complement.L2_v_VehSpd_nab.Level2Signals /end MEASUREMENT
/begin MEASUREMENT Level2Signals.L2_v_VehSpd_nab.Value "vehicle speed for level 2 with complement" UWORD SBW_VKMH_16_S1_S3 1 100 0 21.875 ECU_ADDRESS 0xFFF9803E DISPLAY_IDENTIFIER Value.L2_v_VehSpd_nab.Level2Signals /end MEASUREMENT
/begin MEASUREMENT Level2Signals.swi_ign_komp_fault_injection "ram value for manipulating komplement of ignition only writable with new AZG (above 64k)" UBYTE SBW_STANDARD_S1_S3 1 100 0 255 ECU_ADDRESS 0xFFF9808C DISPLAY_IDENTIFIER swi_ign_komp_fault_injection.Level2Signals /end MEASUREMENT
/begin MEASUREMENT MASSE_FZG "" UWORD _CNV_R_R_Umr_1_zu_1_214_CM_S2 1 0 0 10000 ECU_ADDRESS 0xFFF8E506 FORMAT "%2.0" /end MEASUREMENT
/begin MEASUREMENT MASSE_FZG_EST "" UWORD _CNV_R_R_Umr_1_zu_1_214_CM_S2 1 0 0 8188 ECU_ADDRESS 0xFFF8E696 FORMAT "%2.0" /end MEASUREMENT
/begin MEASUREMENT MASSE_FZG_EST_ROH "" UWORD _CNV_R_R_Umr_1_zu_1_2_CM_S2 1 0 0 4094 ECU_ADDRESS 0xFFF8E36E FORMAT "%2.0" /end MEASUREMENT
/begin MEASUREMENT MASSE_FZG_REST "" SWORD _CNV_R_R_Umr_1_zu_1_214_CM_S2 1 0 0 10000 ECU_ADDRESS 0xFFF8E89E FORMAT "%2.0" /end MEASUREMENT
/begin MEASUREMENT MDRAD_FWSBERG_ZKA "" SWORD _CNV_R_R_Umr_1_zu_1_38_CM_S2 1 0 -32768 32767 ECU_ADDRESS 0xFFF8E802 FORMAT "%2.0" /end MEASUREMENT
/begin MEASUREMENT MDRAD_FWSEBENE_ZKA "" SWORD _CNV_R_R_Umr_1_zu_1_38_CM_S2 1 0 -32768 32767 ECU_ADDRESS 0xFFF8E804 FORMAT "%2.0" /end MEASUREMENT
/begin MEASUREMENT MN_RAD_HA "" UWORD _CNV_R_R_Umr_1_zu_1_3_CM_S2 1 0 0 20000 ECU_ADDRESS 0xFFF8E7AC FORMAT "%2.0" /end MEASUREMENT
/begin MEASUREMENT MN_RAD_VA "" UWORD _CNV_R_R_Umr_1_zu_1_3_CM_S2 1 0 0 20000 ECU_ADDRESS 0xFFF8E7AE FORMAT "%2.0" /end MEASUREMENT
/begin MEASUREMENT MUE_DYN "" UWORD _CNV_R_R_Umr_1000_z_36_CM_S2 1 0 0 65.535 ECU_ADDRESS 0xFFF8E508 FORMAT "%5.3" /end MEASUREMENT
/begin MEASUREMENT MUE_DYN_ROH "" UWORD _CNV_R_R_Umr_1000_z_36_CM_S2 1 0 0 65.535 ECU_ADDRESS 0xFFF8E50A FORMAT "%5.3" /end MEASUREMENT
/begin MEASUREMENT MUE_STAT "" UWORD _CNV_R_R_Umr_1000_z_36_CM_S2 1 0 0 65.535 ECU_ADDRESS 0xFFF8E50C FORMAT "%5.3" /end MEASUREMENT
/begin MEASUREMENT MUE_UEBER "" UWORD _CNV_R_R_Umr_1000_z_36_CM_S2 1 0 0 65.535 ECU_ADDRESS 0xFFF8E50E FORMAT "%5.3" /end MEASUREMENT
/begin MEASUREMENT M_AB_BREMS "" SWORD _CNV_R_R_Umr_1_zu_1_38_CM_S2 1 0 -32768 32767 ECU_ADDRESS 0xFFF8E8A0 FORMAT "%2.0" /end MEASUREMENT
/begin MEASUREMENT M_AB_DYN "" SWORD _CNV_R_R_Umr_1_zu_1_38_CM_S2 1 0 -32768 32767 ECU_ADDRESS 0xFFF8E698 FORMAT "%2.0" /end MEASUREMENT
/begin MEASUREMENT M_AB_DYN_ROH "" SWORD _CNV_R_R_Umr_1_zu_1_2_CM_S2 1 0 -32768 32767 ECU_ADDRESS 0xFFF8E370 FORMAT "%2.0" /end MEASUREMENT
/begin MEASUREMENT M_AB_FWSREF "" SWORD _CNV_R_R_Umr_1_zu_1_38_CM_S2 1 0 -32768 32767 ECU_ADDRESS 0xFFF8E8A2 FORMAT "%2.0" /end MEASUREMENT
/begin MEASUREMENT M_AB_IST_MRAD "" SWORD _CNV_R_R_Umr_1_zu_1_38_CM_S2 1 0 -32768 32767 ECU_ADDRESS 0xFFF8E510 FORMAT "%2.0" /end MEASUREMENT
/begin MEASUREMENT M_AB_MUEFILT "" SWORD _CNV_R_R_Umr_1_zu_1_38_CM_S2 1 0 -32000 32000 ECU_ADDRESS 0xFFF8E512 FORMAT "%2.0" /end MEASUREMENT
/begin MEASUREMENT M_AB_MUEFILTREST "" SWORD _CNV_R_R_Umr_1_zu_1_38_CM_S2 1 0 -32768 32767 ECU_ADDRESS 0xFFF8E514 FORMAT "%2.0" /end MEASUREMENT
/begin MEASUREMENT M_AB_NICK "" SWORD _CNV_R_R_Umr_1_zu_1_38_CM_S2 1 0 -32768 32767 ECU_ADDRESS 0xFFF8E7D4 FORMAT "%2.0" /end MEASUREMENT
/begin MEASUREMENT M_AB_REKUPMAX "" SWORD _CNV_R_R_Umr_1_zu_1_38_CM_S2 1 0 -32768 32767 ECU_ADDRESS 0xFFF8E84E /end MEASUREMENT
/begin MEASUREMENT M_AB_REKUPMAX_FILT "" SWORD _CNV_R_R_Umr_1_zu_1_38_CM_S2 1 0 -32768 32767 ECU_ADDRESS 0xFFF8E850 /end MEASUREMENT
/begin MEASUREMENT M_AB_REKUPMAX_FILTREST "" SWORD _CNV_R_R_Umr_1_zu_1_38_CM_S2 1 0 -32768 32767 ECU_ADDRESS 0xFFF8E852 FORMAT "%2.0" /end MEASUREMENT
/begin MEASUREMENT M_AB_REKUP_BAB "" SWORD _CNV_R_R_Umr_1_zu_1_38_CM_S2 1 0 -32768 32767 ECU_ADDRESS 0xFFF8E854 FORMAT "%2.0" /end MEASUREMENT
/begin MEASUREMENT M_AB_ROT "" SWORD _CNV_R_R_Umr_1_zu_1_38_CM_S2 1 0 -32768 32767 ECU_ADDRESS 0xFFF8E8A4 FORMAT "%2.0" /end MEASUREMENT
/begin MEASUREMENT M_AB_ROT_FWSALT "" SWORD _CNV_R_R_Umr_1_zu_1_38_CM_S2 1 0 -32768 32767 ECU_ADDRESS 0xFFF8E8A6 FORMAT "%2.0" /end MEASUREMENT
/begin MEASUREMENT M_BR "" SWORD _CNV_R_R_Umr_1_zu_1_38_CM_S2 1 0 -32768 32767 ECU_ADDRESS 0xFFF8E69A FORMAT "%2.0" /end MEASUREMENT
/begin MEASUREMENT M_BR_CAN "" SWORD _CNV_R_R_Umr_1_zu_1_38_CM_S2 1 0 -32768 32767 ECU_ADDRESS 0xFFF8E69C FORMAT "%2.0" /end MEASUREMENT
/begin MEASUREMENT M_BR_KOR_BRS "" SWORD _CNV_R_R_Umr_1_zu_1_38_CM_S2 1 0 -32678 0 ECU_ADDRESS 0xFFF8E860 FORMAT "%2.0" /end MEASUREMENT
/begin MEASUREMENT M_BR_ROH "" UWORD _CNV_R_R_Umr_1_zu_1_2_CM_S2 1 0 0 65535 ECU_ADDRESS 0xFFF8E372 /end MEASUREMENT
/begin MEASUREMENT M_BR_SOLL "" SWORD _CNV_R_R_Umr_1_zu_1_38_CM_S2 1 0 -32000 0 ECU_ADDRESS 0xFFF8E69E FORMAT "%2.0" /end MEASUREMENT
/begin MEASUREMENT M_BR_SOLL_ROH "" UWORD _CNV_R_R_Umr_1_zu_1_2_CM_S2 1 0 0 32000 ECU_ADDRESS 0xFFF8E374 FORMAT "%2.0" /end MEASUREMENT
/begin MEASUREMENT M_COMPRISE_SS "" UWORD _CNV_R_R_Umr_1_zu_1_2_CM_S2 1 0 0 65535 ECU_ADDRESS 0xFFF8E3CE /end MEASUREMENT
/begin MEASUREMENT M_EM "" SWORD _CNV_R_R_Umr_1_zu_1_38_CM_S2 1 0 -8192 8192 ECU_ADDRESS 0xFFF8E6A0 FORMAT "%2.0" /end MEASUREMENT
/begin MEASUREMENT M_EM1MAX_SS_ZKA "" SWORD _CNV_R_R_Umr_1_zu_1_38_CM_S2 1 0 -1023.5 1023.5 ECU_ADDRESS 0xFFF8E806 FORMAT "%2.0" /end MEASUREMENT
/begin MEASUREMENT M_EM1MIN_SS_ZKA "" SWORD _CNV_R_R_Umr_1_zu_1_38_CM_S2 1 0 -32768 32767 ECU_ADDRESS 0xFFF8E808 FORMAT "%2.0" /end MEASUREMENT
/begin MEASUREMENT M_EM_MAXKURZ_PRED "" SWORD _CNV_R_R_Umr_1_zu_1_38_CM_S2 1 0 -1023.5 1023.5 ECU_ADDRESS 0xFFF8E6AA FORMAT "%3.1" /end MEASUREMENT
/begin MEASUREMENT M_EM_MAXKURZ_PRED_ROH "" UWORD _CNV_R_R_Umr_1_zu_1_2_CM_S2 1 0 0 4094 ECU_ADDRESS 0xFFF8E376 FORMAT "%2.0" /end MEASUREMENT
/begin MEASUREMENT M_EM_MAXLANG_PRED "" SWORD _CNV_R_R_Umr_1_zu_1_38_CM_S2 1 0 -1023.5 1023.5 ECU_ADDRESS 0xFFF8E6AC FORMAT "%3.1" /end MEASUREMENT
/begin MEASUREMENT M_EM_MAXLANG_PRED_ROH "" UWORD _CNV_R_R_Umr_1_zu_1_2_CM_S2 1 0 0 4094 ECU_ADDRESS 0xFFF8E378 FORMAT "%2.0" /end MEASUREMENT
/begin MEASUREMENT M_EM_MINKURZ_PRED "" SWORD _CNV_R_R_Umr_1_zu_1_38_CM_S2 1 0 -1023.5 1023.5 ECU_ADDRESS 0xFFF8E6AE FORMAT "%3.1" /end MEASUREMENT
/begin MEASUREMENT M_EM_MINKURZ_PRED_ROH "" UWORD _CNV_R_R_Umr_1_zu_1_2_CM_S2 1 0 0 4094 ECU_ADDRESS 0xFFF8E37A FORMAT "%2.0" /end MEASUREMENT
/begin MEASUREMENT M_EM_MINLANG_PRED "" SWORD _CNV_R_R_Umr_1_zu_1_38_CM_S2 1 0 -1023.5 1023.5 ECU_ADDRESS 0xFFF8E6B0 FORMAT "%3.1" /end MEASUREMENT
/begin MEASUREMENT M_EM_MINLANG_PRED_ROH "" UWORD _CNV_R_R_Umr_1_zu_1_2_CM_S2 1 0 0 4094 ECU_ADDRESS 0xFFF8E37C FORMAT "%2.0" /end MEASUREMENT
/begin MEASUREMENT M_EM_ROH "" SWORD _CNV_R_R_Umr_1_zu_1_2_CM_S2 1 0 -32768 32767 ECU_ADDRESS 0xFFF8E386 /end MEASUREMENT
/begin MEASUREMENT M_GE_EM1MAX_ZKA "" SWORD _CNV_R_R_Umr_1_zu_1_38_CM_S2 1 0 0 1023.5 ECU_ADDRESS 0xFFF8E80A FORMAT "%2.0" /end MEASUREMENT
/begin MEASUREMENT M_GE_EM1MIN_ZKA "" SWORD _CNV_R_R_Umr_1_zu_1_38_CM_S2 1 0 -1023.5 0 ECU_ADDRESS 0xFFF8E80C FORMAT "%2.0" /end MEASUREMENT
/begin MEASUREMENT M_GE_MOTMAX_ZKA "" SLONG _CNV_R_R_Umr_1_zu_1_38_CM_S2 1 0 0 1000 ECU_ADDRESS 0xFFF8F1FC FORMAT "%2.0" /end MEASUREMENT
/begin MEASUREMENT M_GE_MOTMIN_ZKA "" SLONG _CNV_R_R_Umr_1_zu_1_38_CM_S2 1 0 -200 0 ECU_ADDRESS 0xFFF8F200 FORMAT "%2.0" /end MEASUREMENT
/begin MEASUREMENT M_LDM_SOLL "" SWORD _CNV_R_R_Umr_1_zu_1_38_CM_S2 1 0 -32768 32767 ECU_ADDRESS 0xFFF8E710 FORMAT "%2.0" /end MEASUREMENT
/begin MEASUREMENT M_LDM_SOLL_ALT "" SWORD _CNV_R_R_Umr_1_zu_1_38_CM_S2 1 0 -1024 1024 ECU_ADDRESS 0xFFF8E712 FORMAT "%2.0" /end MEASUREMENT
/begin MEASUREMENT M_LDM_SOLL_ROH "" SWORD _CNV_R_R_Umr_1_zu_1_38_CM_S2 1 0 -32768 32767 ECU_ADDRESS 0xFFF8E36C FORMAT "%2.0" /end MEASUREMENT
/begin MEASUREMENT M_MOT_DMEE "" SWORD _CNV_R_R_Umr_1_zu_1_38_CM_S2 1 0 -32768 32767 ECU_ADDRESS 0xFFF8E6BA FORMAT "%2.0" /end MEASUREMENT
/begin MEASUREMENT M_MOT_DMEE_ROH "" SWORD _CNV_R_R_Umr_1_zu_1_2_CM_S2 1 0 -32768 32767 ECU_ADDRESS 0xFFF8E38C /end MEASUREMENT
/begin MEASUREMENT M_MOT_FW "" SWORD _CNV_R_R_Umr_1_zu_1_38_CM_S2 1 0 -8192 8192 ECU_ADDRESS 0xFFF8E6BC FORMAT "%2.0" /end MEASUREMENT
/begin MEASUREMENT M_MOT_FW_FILT "" SWORD _CNV_R_R_Umr_1_zu_1_38_CM_S2 1 0 -8192 8192 ECU_ADDRESS 0xFFF8E5F8 FORMAT "%2.0" /end MEASUREMENT
/begin MEASUREMENT M_MOT_FW_FILTALT "" SWORD _CNV_R_R_Umr_1_zu_1_38_CM_S2 1 0 -8192 8192 ECU_ADDRESS 0xFFF8E5FA FORMAT "%2.0" /end MEASUREMENT
/begin MEASUREMENT M_MOT_FW_FILTBUFFER "" SWORD _CNV_R_R_Umr_1_zu_1_38_CM_S2 1 0 -8192 8192 ECU_ADDRESS 0xFFF8EFE8 FORMAT "%2.0" MATRIX_DIM 8 1 1 /end MEASUREMENT
/begin MEASUREMENT M_MOT_FW_FILTREST "" SWORD _CNV_R_R_Umr_1_zu_1_38_CM_S2 1 0 -32768 32767 ECU_ADDRESS 0xFFF8E5FC FORMAT "%2.0" /end MEASUREMENT
/begin MEASUREMENT M_MOT_FW_ROH "" SWORD _CNV_R_R_Umr_1_zu_1_2_CM_S2 1 0 -32768 32767 ECU_ADDRESS 0xFFF8E38E /end MEASUREMENT
/begin MEASUREMENT M_MOT_GANGPOT_ZKA "" SLONG _CNV_R_R_Umr_1_zu_1_38_CM_S2 1 0 -32000000 32000000 ECU_ADDRESS 0xFFF8F1E0 FORMAT "%2.0" /end MEASUREMENT
/begin MEASUREMENT M_MOT_IST "" SWORD _CNV_R_R_Umr_1_zu_1_38_CM_S2 1 0 -32768 32767 ECU_ADDRESS 0xFFF8E6BE FORMAT "%2.0" /end MEASUREMENT
/begin MEASUREMENT M_MOT_IST_ROH "" SWORD _CNV_R_R_Umr_1_zu_1_38_CM_S2 1 0 -32768 32767 ECU_ADDRESS 0xFFF8E390 /end MEASUREMENT
/begin MEASUREMENT M_MOT_MAXDME "" SWORD _CNV_R_R_Umr_1_zu_1_38_CM_S2 1 0 -8192 8192 ECU_ADDRESS 0xFFF8E6C0 FORMAT "%2.0" /end MEASUREMENT
/begin MEASUREMENT M_MOT_MAXDME_ROH "" SWORD _CNV_R_R_Umr_1_zu_1_2_CM_S2 1 0 -32768 32767 ECU_ADDRESS 0xFFF8E392 /end MEASUREMENT
/begin MEASUREMENT M_MOT_MINDME_ZKA "" SWORD _CNV_R_R_Umr_1_zu_1_38_CM_S2 1 0 -32767 0 ECU_ADDRESS 0xFFF8E812 FORMAT "%2.0" /end MEASUREMENT
/begin MEASUREMENT M_MOT_POT_HKOR_ZKA "" SWORD _CNV_R_R_Umr_1_zu_1_38_CM_S2 1 0 -32768 32767 ECU_ADDRESS 0xFFF8E814 FORMAT "%2.0" /end MEASUREMENT
/begin MEASUREMENT M_MOT_REIB "" SWORD _CNV_R_R_Umr_1_zu_1_38_CM_S2 1 0 -32768 32767 ECU_ADDRESS 0xFFF8E6C2 FORMAT "%2.0" /end MEASUREMENT
/begin MEASUREMENT M_MOT_REIB_ROH "" UWORD _CNV_R_R_Umr_1_zu_1_2_CM_S2 1 0 0 65535 ECU_ADDRESS 0xFFF8E394 /end MEASUREMENT
/begin MEASUREMENT M_MOT_STAT "" SWORD _CNV_R_R_Umr_1_zu_1_38_CM_S2 1 0 -32768 32767 ECU_ADDRESS 0xFFF8E6C4 FORMAT "%2.0" /end MEASUREMENT
/begin MEASUREMENT M_RADSOLL_STABKRI_START_ZKA "" SLONG _CNV_R_R_Umr_1_zu_1_38_CM_S2 1 0 -2147483648 2147483647 ECU_ADDRESS 0xFFF8F204 FORMAT "%2.0" /end MEASUREMENT
/begin MEASUREMENT M_RAD_AKTOPT_ZKA "" SLONG _CNV_R_R_Umr_1_zu_1_38_CM_S2 1 0 -2147483648 2147483647 ECU_ADDRESS 0xFFF8F1E4 FORMAT "%2.0" /end MEASUREMENT
/begin MEASUREMENT M_RAD_FWSREF "" UWORD _CNV_R_R_Umr_1_zu_1_38_CM_S2 1 0 0 1000 ECU_ADDRESS 0xFFF8E8A8 FORMAT "%2.0" /end MEASUREMENT
/begin MEASUREMENT M_RAD_GANGPOT_ZKA "" SLONG _CNV_R_R_Umr_1_zu_1_38_CM_S2 1 0 -32000000 32000000 ECU_ADDRESS 0xFFF8F1E8 FORMAT "%2.0" /end MEASUREMENT
/begin MEASUREMENT M_RAD_HDC_KOR "" SWORD _CNV_R_R_Umr_1_zu_1_38_CM_S2 1 0 -1024 1024 ECU_ADDRESS 0xFFF8E5EC FORMAT "%2.0" /end MEASUREMENT
/begin MEASUREMENT M_RAD_HDC_KOR_HS "" SWORD _CNV_R_R_Umr_1_zu_1_38_CM_S2 1 0 -1024 1024 ECU_ADDRESS 0xFFF8E5EE FORMAT "%2.0" /end MEASUREMENT
/begin MEASUREMENT M_RAD_HDC_SOLL "" SWORD _CNV_R_R_Umr_1_zu_1_38_CM_S2 1 0 -32768 32767 ECU_ADDRESS 0xFFF8E6C6 FORMAT "%2.0" /end MEASUREMENT
/begin MEASUREMENT M_RAD_HDC_SOLL_ROH "" SWORD _CNV_R_R_Umr_1_zu_1_38_CM_S2 1 0 -32768 32767 ECU_ADDRESS 0xFFF8E396 FORMAT "%2.0" /end MEASUREMENT
/begin MEASUREMENT M_RAD_HIGHOPT_ZKA "" SLONG _CNV_R_R_Umr_1_zu_1_38_CM_S2 1 0 -2147483648 2147483647 ECU_ADDRESS 0xFFF8F1EC FORMAT "%2.0" /end MEASUREMENT
/begin MEASUREMENT M_RAD_IST "" SWORD _CNV_R_R_Umr_1_zu_1_38_CM_S2 1 0 -32000 32000 ECU_ADDRESS 0xFFF8E6C8 FORMAT "%2.0" /end MEASUREMENT
/begin MEASUREMENT M_RAD_IST_ROH "" UWORD _CNV_R_R_Umr_1_zu_1_2_CM_S2 1 0 0 64000 ECU_ADDRESS 0xFFF8E398 FORMAT "%2.0" /end MEASUREMENT
/begin MEASUREMENT M_RAD_LOWOPT_ZKA "" SLONG _CNV_R_R_Umr_1_zu_1_38_CM_S2 1 0 -2147483648 2147483647 ECU_ADDRESS 0xFFF8F1F0 FORMAT "%2.0" /end MEASUREMENT
/begin MEASUREMENT M_RAD_NACHRS_HDC "" SWORD _CNV_R_R_Umr_1_zu_1_38_CM_S2 1 0 -1024 1024 ECU_ADDRESS 0xFFF8E5F0 FORMAT "%2.0" /end MEASUREMENT
/begin MEASUREMENT M_RAD_OPT_ZKA "" SLONG _CNV_R_R_Umr_1_zu_1_38_CM_S2 1 0 -32000000 32000000 ECU_ADDRESS 0xFFF8F208 FORMAT "%2.0" MATRIX_DIM 9 1 1 /end MEASUREMENT
/begin MEASUREMENT M_RAD_POT_ZKA "" SLONG _CNV_R_R_Umr_1_zu_1_38_CM_S2 1 0 -32000000 32000000 ECU_ADDRESS 0xFFF8F22C FORMAT "%2.0" MATRIX_DIM 9 1 1 /end MEASUREMENT
/begin MEASUREMENT M_RAD_REKUPMAX_IST "" SWORD _CNV_R_R_Umr_1_zu_1_38_CM_S2 1 0 -32000 32000 ECU_ADDRESS 0xFFF8E6B2 FORMAT "%2.0" /end MEASUREMENT
/begin MEASUREMENT M_RAD_REKUPMAX_IST_ROH "" UWORD _CNV_R_R_Umr_1_zu_1_2_CM_S2 1 0 0 64000 ECU_ADDRESS 0xFFF8E37E FORMAT "%2.0" /end MEASUREMENT
/begin MEASUREMENT M_RAD_REKUPMAX_PRED "" SWORD _CNV_R_R_Umr_1_zu_1_38_CM_S2 1 0 -32000 0 ECU_ADDRESS 0xFFF8E6B4 FORMAT "%2.0" /end MEASUREMENT
/begin MEASUREMENT M_RAD_REKUPMAX_PRED_ROH "" UWORD _CNV_R_R_Umr_1_zu_1_2_CM_S2 1 0 0 32000 ECU_ADDRESS 0xFFF8E380 FORMAT "%2.0" /end MEASUREMENT
/begin MEASUREMENT M_RAD_REKUP_SOLL "" SWORD _CNV_R_R_Umr_1_zu_1_38_CM_S2 1 0 -32000 32000 ECU_ADDRESS 0xFFF8E6B6 FORMAT "%2.0" /end MEASUREMENT
/begin MEASUREMENT M_RAD_REKUP_SOLL_ROH "" UWORD _CNV_R_R_Umr_1_zu_1_2_CM_S2 1 0 0 64000 ECU_ADDRESS 0xFFF8E382 FORMAT "%2.0" /end MEASUREMENT
/begin MEASUREMENT M_RAD_SCHLEPPUNT_IST "" SWORD _CNV_R_R_Umr_1_zu_1_38_CM_S2 1 0 -32000 32000 ECU_ADDRESS 0xFFF8E6B8 FORMAT "%2.0" /end MEASUREMENT
/begin MEASUREMENT M_RAD_SCHLEPPUNT_IST_ROH "" UWORD _CNV_R_R_Umr_1_zu_1_2_CM_S2 1 0 0 64000 ECU_ADDRESS 0xFFF8E384 FORMAT "%2.0" /end MEASUREMENT
/begin MEASUREMENT M_RAD_WUNSCH "" SWORD _CNV_R_R_Umr_1_zu_1_38_CM_S2 1 0 -32768 32767 ECU_ADDRESS 0xFFF8E6CA FORMAT "%2.0" /end MEASUREMENT
/begin MEASUREMENT M_RAD_WUNSCH_MOD_ZKA "" SWORD _CNV_R_R_Umr_1_zu_1_38_CM_S2 1 0 -32768 32767 ECU_ADDRESS 0xFFF8E816 FORMAT "%2.0" /end MEASUREMENT
/begin MEASUREMENT M_RAD_WUNSCH_ROH "" SWORD _CNV_R_R_Umr_1_zu_1_38_CM_S2 1 0 -32768 32767 ECU_ADDRESS 0xFFF8E39A FORMAT "%2.0" /end MEASUREMENT
/begin MEASUREMENT M_RAD_WUNSCH_ZKA "" SWORD _CNV_R_R_Umr_1_zu_1_38_CM_S2 1 0 -32768 32767 ECU_ADDRESS 0xFFF8E818 FORMAT "%2.0" /end MEASUREMENT
/begin MEASUREMENT M_REKUP_DBM "" SWORD _CNV_R_R_Umr_1_zu_1_38_CM_S2 1 0 -1023 1023 ECU_ADDRESS 0xFFF8E2CE FORMAT "%2.0" /end MEASUREMENT
/begin MEASUREMENT M_T "" SWORD _CNV_R_R_Umr_1_zu_1_38_CM_S2 1 0 -32000 32000 ECU_ADDRESS 0xFFF8E6CC FORMAT "%2.0" /end MEASUREMENT
/begin MEASUREMENT M_T_ROH "" UWORD _CNV_R_R_Umr_1_zu_1_2_CM_S2 1 0 0 64000 ECU_ADDRESS 0xFFF8E39C FORMAT "%2.0" /end MEASUREMENT
/begin MEASUREMENT M_VM "" SWORD _CNV_R_R_Umr_1_zu_1_38_CM_S2 1 0 -32768 32767 ECU_ADDRESS 0xFFF8E6A2 FORMAT "%2.0" /end MEASUREMENT
/begin MEASUREMENT M_VM_ROH "" SWORD _CNV_R_R_Umr_1_zu_1_38_CM_S2 1 0 -32768 32767 ECU_ADDRESS 0xFFF8E388 FORMAT "%2.0" /end MEASUREMENT
/begin MEASUREMENT Mode.ModeNext "mode computed by SBW 0=Adaptive 1=Sport 2=Manual 3= ManualSport" UBYTE SBW_STANDARD_S1_S3 1 100 0 3 ECU_ADDRESS 0xFFF8987C DISPLAY_IDENTIFIER ModeNext.Mode /end MEASUREMENT
/begin MEASUREMENT Mode.st_ModeChangeEvent "reason for last mode change" UBYTE SBW_STANDARD_S1_S3 1 100 0 18 ECU_ADDRESS 0xFFF89881 DISPLAY_IDENTIFIER st_ModeChangeEvent.Mode /end MEASUREMENT
/begin MEASUREMENT Mode.st_StoreMode "stored mode as default mode" UBYTE SBW_STANDARD_S1_S3 1 100 0 255 ECU_ADDRESS 0xFFF89880 DISPLAY_IDENTIFIER st_StoreMode.Mode /end MEASUREMENT
/begin MEASUREMENT Mode.st_StoreModePosChange "stored mode after change of position to PRN from D" UBYTE SBW_STANDARD_S1_S3 1 100 0 255 ECU_ADDRESS 0xFFF8987F DISPLAY_IDENTIFIER st_StoreModePosChange.Mode /end MEASUREMENT
/begin MEASUREMENT Mode.st_TipM "Forwarded tip minus signal for shifting strategy 0=noTip 1=singleTip 2=doubleTip" UBYTE SBW_STANDARD_S1_S3 1 100 0 2 ECU_ADDRESS 0xFFF8987E DISPLAY_IDENTIFIER st_TipM.Mode /end MEASUREMENT
/begin MEASUREMENT Mode.st_TipP "Forwarded tip plus signal for shifting strategy 0=noTip 1=singleTip 2=doubleTip" UBYTE SBW_STANDARD_S1_S3 1 100 0 2 ECU_ADDRESS 0xFFF8987D DISPLAY_IDENTIFIER st_TipP.Mode /end MEASUREMENT
/begin MEASUREMENT Mode.tmr_ModeReturnTip1.f_IsExpired "test_timer" UBYTE SBW_STANDARD_S1_S3 1 100 0 255 ECU_ADDRESS 0xFFF89876 DISPLAY_IDENTIFIER f_IsExpired.tmr_ModeReturnTip1.Mode /end MEASUREMENT
/begin MEASUREMENT Mode.tmr_ModeReturnTip1.time "test_timer" UWORD SBW_TIMER_10MS_S1_S3 1 100 0 655350 ECU_ADDRESS 0xFFF89874 DISPLAY_IDENTIFIER time.tmr_ModeReturnTip1.Mode /end MEASUREMENT
/begin MEASUREMENT Mode.tmr_ModeReturnTip2.f_IsExpired "test_timer" UBYTE SBW_STANDARD_S1_S3 1 100 0 255 ECU_ADDRESS 0xFFF8987A DISPLAY_IDENTIFIER f_IsExpired.tmr_ModeReturnTip2.Mode /end MEASUREMENT
/begin MEASUREMENT Mode.tmr_ModeReturnTip2.time "test_timer" UWORD SBW_TIMER_10MS_S1_S3 1 100 0 655350 ECU_ADDRESS 0xFFF89878 DISPLAY_IDENTIFIER time.tmr_ModeReturnTip2.Mode /end MEASUREMENT
/begin MEASUREMENT ModeIn.f_LowModeButton "detection of state change of st_LowMode 0 to 1" UBYTE SBW_STANDARD_S1_S3 1 100 0 1 BIT_MASK 0x1 ECU_ADDRESS 0xFFF89861 DISPLAY_IDENTIFIER f_LowModeButton.ModeIn /end MEASUREMENT
/begin MEASUREMENT ModeIn.f_LowModeInvalid "detection of state change of st_LowMode to 3" UBYTE SBW_STANDARD_S1_S3 1 100 0 1 BIT_MASK 0x1 ECU_ADDRESS 0xFFF89862 DISPLAY_IDENTIFIER f_LowModeInvalid.ModeIn /end MEASUREMENT
/begin MEASUREMENT ModeIn.f_MGate "flag to detect if lever is in manual gate" UBYTE SBW_STANDARD_S1_S3 1 100 0 1 BIT_MASK 0x1 ECU_ADDRESS 0xFFF8985C DISPLAY_IDENTIFIER f_MGate.ModeIn /end MEASUREMENT
/begin MEASUREMENT ModeIn.f_MGateOff "Triggered flag when M-Gate is switched off" UBYTE SBW_STANDARD_S1_S3 1 100 0 1 BIT_MASK 0x1 ECU_ADDRESS 0xFFF8985F DISPLAY_IDENTIFIER f_MGateOff.ModeIn /end MEASUREMENT
/begin MEASUREMENT ModeIn.f_MGateOld "flag to detect if lever was in manual during last cycle" UBYTE SBW_STANDARD_S1_S3 1 100 0 1 BIT_MASK 0x1 ECU_ADDRESS 0xFFF8985D DISPLAY_IDENTIFIER f_MGateOld.ModeIn /end MEASUREMENT
/begin MEASUREMENT ModeIn.f_MGateOn "Triggered flag when M-Gate is switched on" UBYTE SBW_STANDARD_S1_S3 1 100 0 1 BIT_MASK 0x1 ECU_ADDRESS 0xFFF8985E DISPLAY_IDENTIFIER f_MGateOn.ModeIn /end MEASUREMENT
/begin MEASUREMENT ModeIn.f_TempMan "information whether temporary mode manual is active or not" UBYTE SBW_STANDARD_S1_S3 1 100 0 1 BIT_MASK 0x1 ECU_ADDRESS 0xFFF89860 DISPLAY_IDENTIFIER f_TempMan.ModeIn /end MEASUREMENT
/begin MEASUREMENT ModeIn.st_LowModeOld "last cycle state of 'GET_LOW_MODE'" UBYTE SBW_STANDARD_S1_S3 1 100 0 3 ECU_ADDRESS 0xFFF89863 DISPLAY_IDENTIFIER st_LowModeOld.ModeIn /end MEASUREMENT
/begin MEASUREMENT ModeIn.tmr_DelayMGate.f_IsExpired "test_timer" UBYTE SBW_STANDARD_S1_S3 1 100 0 255 ECU_ADDRESS 0xFFF8985A DISPLAY_IDENTIFIER f_IsExpired.tmr_DelayMGate.ModeIn /end MEASUREMENT
/begin MEASUREMENT ModeIn.tmr_DelayMGate.time "test_timer" UWORD SBW_TIMER_10MS_S1_S3 1 100 0 655350 ECU_ADDRESS 0xFFF89858 DISPLAY_IDENTIFIER time.tmr_DelayMGate.ModeIn /end MEASUREMENT
/begin MEASUREMENT MultAccess.DriveLogic "drive logic rocker (0=no action 1=Plus 2=Minus)" UBYTE SBW_STANDARD_S1_S3 1 100 0 2 ECU_ADDRESS 0xFFF893FA DISPLAY_IDENTIFIER DriveLogic.MultAccess /end MEASUREMENT
/begin MEASUREMENT MultAccess.DriveLogicOld "old value of DriveLogic" UBYTE SBW_STANDARD_S1_S3 1 100 0 2 ECU_ADDRESS 0xFFF893F8 DISPLAY_IDENTIFIER DriveLogicOld.MultAccess /end MEASUREMENT
/begin MEASUREMENT MultAccess.DriveLogicTrig "drive logic rocker event (0=no action 1=Plus 2=Minus)" UBYTE SBW_STANDARD_S1_S3 1 100 0 2 ECU_ADDRESS 0xFFF893F9 DISPLAY_IDENTIFIER DriveLogicTrig.MultAccess /end MEASUREMENT
/begin MEASUREMENT MultAccess.DrvReqPRND_Raw "raw value of driver request" UBYTE SBW_STANDARD_S1_S3 1 100 0 8 ECU_ADDRESS 0xFFF893EF DISPLAY_IDENTIFIER DrvReqPRND_Raw.MultAccess /end MEASUREMENT
/begin MEASUREMENT MultAccess.DrvReqP_Trig "P button pressed event" UBYTE SBW_STANDARD_S1_S3 1 100 0 1 BIT_MASK 0x1 ECU_ADDRESS 0xFFF893F1 DISPLAY_IDENTIFIER DrvReqP_Trig.MultAccess /end MEASUREMENT
/begin MEASUREMENT MultAccess.DrvReq_Old "old value of RelToAbs.DrvReq_Raw" UBYTE SBW_STANDARD_S1_S3 1 100 0 8 ECU_ADDRESS 0xFFF893ED DISPLAY_IDENTIFIER DrvReq_Old.MultAccess /end MEASUREMENT
/begin MEASUREMENT MultAccess.DrvReq_Trig "actual value of RelToAbs.DrvReq_Raw" UBYTE SBW_STANDARD_S1_S3 1 100 0 8 ECU_ADDRESS 0xFFF893EE DISPLAY_IDENTIFIER DrvReq_Trig.MultAccess /end MEASUREMENT
/begin MEASUREMENT MultAccess.GatePos "gate position of the shift lever (see constant C_GatePosPRND and other)" UBYTE SBW_STANDARD_S1_S3 1 100 0 3 ECU_ADDRESS 0xFFF893F3 DISPLAY_IDENTIFIER GatePos.MultAccess /end MEASUREMENT
/begin MEASUREMENT MultAccess.GatePosOld "old value of SafeGuard.GatePosRawSafe" UBYTE SBW_STANDARD_S1_S3 1 100 0 3 ECU_ADDRESS 0xFFF893F2 DISPLAY_IDENTIFIER GatePosOld.MultAccess /end MEASUREMENT
/begin MEASUREMENT MultAccess.cnt_SimOperations "counter to detect simultanious pressed buttons paddles etc" UBYTE SBW_STANDARD_S1_S3 1 100 0 4 ECU_ADDRESS 0xFFF893FD DISPLAY_IDENTIFIER cnt_SimOperations.MultAccess /end MEASUREMENT
/begin MEASUREMENT MultAccess.f_P12ButtonOld "old value of Interfi.f_P12Button" UBYTE SBW_STANDARD_S1_S3 1 100 0 1 BIT_MASK 0x1 ECU_ADDRESS 0xFFF893F0 DISPLAY_IDENTIFIER f_P12ButtonOld.MultAccess /end MEASUREMENT
/begin MEASUREMENT MultAccess.f_SDButton "sport/drive button pressed (also used to indicate sport gate)" UBYTE SBW_STANDARD_S1_S3 1 100 0 1 BIT_MASK 0x1 ECU_ADDRESS 0xFFF893EC DISPLAY_IDENTIFIER f_SDButton.MultAccess /end MEASUREMENT
/begin MEASUREMENT MultAccess.f_SDButtonRawOff "sport/drive button unpressed event" UBYTE SBW_STANDARD_S1_S3 1 100 0 1 BIT_MASK 0x1 ECU_ADDRESS 0xFFF893EB DISPLAY_IDENTIFIER f_SDButtonRawOff.MultAccess /end MEASUREMENT
/begin MEASUREMENT MultAccess.f_SDButtonRawOld "old value of f_SDButtonRaw" UBYTE SBW_STANDARD_S1_S3 1 100 0 1 BIT_MASK 0x1 ECU_ADDRESS 0xFFF893E9 DISPLAY_IDENTIFIER f_SDButtonRawOld.MultAccess /end MEASUREMENT
/begin MEASUREMENT MultAccess.f_SDButtonRawOn "sport/drive button pressed event" UBYTE SBW_STANDARD_S1_S3 1 100 0 1 BIT_MASK 0x1 ECU_ADDRESS 0xFFF893EA DISPLAY_IDENTIFIER f_SDButtonRawOn.MultAccess /end MEASUREMENT
/begin MEASUREMENT MultAccess.f_SportButton "sport button pressed" UBYTE SBW_STANDARD_S1_S3 1 100 0 1 BIT_MASK 0x1 ECU_ADDRESS 0xFFF893F7 DISPLAY_IDENTIFIER f_SportButton.MultAccess /end MEASUREMENT
/begin MEASUREMENT MultAccess.f_SportButtonRaw "sport button pressed continous signal" UBYTE SBW_STANDARD_S1_S3 1 100 0 1 BIT_MASK 0x1 ECU_ADDRESS 0xFFF893F5 DISPLAY_IDENTIFIER f_SportButtonRaw.MultAccess /end MEASUREMENT
/begin MEASUREMENT MultAccess.f_SportButtonRawOld "old value of f_SportButtonRaw" UBYTE SBW_STANDARD_S1_S3 1 100 0 1 BIT_MASK 0x1 ECU_ADDRESS 0xFFF893F4 DISPLAY_IDENTIFIER f_SportButtonRawOld.MultAccess /end MEASUREMENT
/begin MEASUREMENT MultAccess.f_SportButtonTrig "sport button pressed event" UBYTE SBW_STANDARD_S1_S3 1 100 0 1 BIT_MASK 0x1 ECU_ADDRESS 0xFFF893F6 DISPLAY_IDENTIFIER f_SportButtonTrig.MultAccess /end MEASUREMENT
/begin MEASUREMENT MultAccess.st_EmfP_Old "Old value of st_EmfP" UBYTE SBW_STANDARD_S1_S3 1 100 0 2 ECU_ADDRESS 0xFFF893FB DISPLAY_IDENTIFIER st_EmfP_Old.MultAccess /end MEASUREMENT
/begin MEASUREMENT MultAccess.st_EmfP_Trig "event for EMF-help call" UBYTE SBW_STANDARD_S1_S3 1 100 0 2 ECU_ADDRESS 0xFFF893FC DISPLAY_IDENTIFIER st_EmfP_Trig.MultAccess /end MEASUREMENT
/begin MEASUREMENT MultAccess.st_TipMinus1 "tip minus from shift lever 0=noTip 1=singleTip 2=doubleTip" UBYTE SBW_STANDARD_S1_S3 1 100 0 2 ECU_ADDRESS 0xFFF893DF DISPLAY_IDENTIFIER st_TipMinus1.MultAccess /end MEASUREMENT
/begin MEASUREMENT MultAccess.st_TipMinus1Old "old value of st_TipMinus1" UBYTE SBW_STANDARD_S1_S3 1 100 0 2 ECU_ADDRESS 0xFFF893DD DISPLAY_IDENTIFIER st_TipMinus1Old.MultAccess /end MEASUREMENT
/begin MEASUREMENT MultAccess.st_TipMinus1Trig "tip minus event from shift lever 0=noTip 1=singleTip 2=doubleTip" UBYTE SBW_STANDARD_S1_S3 1 100 0 2 ECU_ADDRESS 0xFFF893DE DISPLAY_IDENTIFIER st_TipMinus1Trig.MultAccess /end MEASUREMENT
/begin MEASUREMENT MultAccess.st_TipMinus2 "tip minus from steering wheel 0=noTip 1=singleTip 2=doubleTip" UBYTE SBW_STANDARD_S1_S3 1 100 0 2 ECU_ADDRESS 0xFFF893E5 DISPLAY_IDENTIFIER st_TipMinus2.MultAccess /end MEASUREMENT
/begin MEASUREMENT MultAccess.st_TipMinus2Old "old value of st_TipMinus2" UBYTE SBW_STANDARD_S1_S3 1 100 0 2 ECU_ADDRESS 0xFFF893E3 DISPLAY_IDENTIFIER st_TipMinus2Old.MultAccess /end MEASUREMENT
/begin MEASUREMENT MultAccess.st_TipMinus2Trig "tip minus event from steering wheel 0=noTip 1=singleTip 2=doubleTip" UBYTE SBW_STANDARD_S1_S3 1 100 0 2 ECU_ADDRESS 0xFFF893E4 DISPLAY_IDENTIFIER st_TipMinus2Trig.MultAccess /end MEASUREMENT
/begin MEASUREMENT MultAccess.st_TipPlus1 "tip plus from shift lever 0=noTip 1=singleTip 2=doubleTip" UBYTE SBW_STANDARD_S1_S3 1 100 0 2 ECU_ADDRESS 0xFFF893E2 DISPLAY_IDENTIFIER st_TipPlus1.MultAccess /end MEASUREMENT
/begin MEASUREMENT MultAccess.st_TipPlus1Old "old value of st_TipPlus1" UBYTE SBW_STANDARD_S1_S3 1 100 0 2 ECU_ADDRESS 0xFFF893E0 DISPLAY_IDENTIFIER st_TipPlus1Old.MultAccess /end MEASUREMENT
/begin MEASUREMENT MultAccess.st_TipPlus1Trig "tip plus event from shift lever 0=noTip 1=singleTip 2=doubleTip" UBYTE SBW_STANDARD_S1_S3 1 100 0 2 ECU_ADDRESS 0xFFF893E1 DISPLAY_IDENTIFIER st_TipPlus1Trig.MultAccess /end MEASUREMENT
/begin MEASUREMENT MultAccess.st_TipPlus2 "tip plus from steering wheel 0=noTip 1=singleTip 2=doubleTip" UBYTE SBW_STANDARD_S1_S3 1 100 0 2 ECU_ADDRESS 0xFFF893E8 DISPLAY_IDENTIFIER st_TipPlus2.MultAccess /end MEASUREMENT
/begin MEASUREMENT MultAccess.st_TipPlus2Old "old value of st_TipPlus2" UBYTE SBW_STANDARD_S1_S3 1 100 0 2 ECU_ADDRESS 0xFFF893E6 DISPLAY_IDENTIFIER st_TipPlus2Old.MultAccess /end MEASUREMENT
/begin MEASUREMENT MultAccess.st_TipPlus2Trig "tip plus event from steering wheel 0=noTip 1=singleTip 2=doubleTip" UBYTE SBW_STANDARD_S1_S3 1 100 0 2 ECU_ADDRESS 0xFFF893E7 DISPLAY_IDENTIFIER st_TipPlus2Trig.MultAccess /end MEASUREMENT
/begin AXIS_PTS SSTSKL_E "" 0x1DD190 W_DKKD _REC_A2AXS_31_u2_S2 120 _CNV_R_R_Umr_10_zu__9_CM_S2 15 0 120 DEPOSIT ABSOLUTE FORMAT "%3.1" /end AXIS_PTS
/begin AXIS_PTS SSTSKL_ECO "" 0x1DD1B0 W_DKKD _REC_A2AXS_31_u2_S2 120 _CNV_R_R_Umr_10_zu__9_CM_S2 15 0 120 DEPOSIT ABSOLUTE FORMAT "%3.1" /end AXIS_PTS
/begin AXIS_PTS SSTSKL_ECOA1 "" 0x1DD1D0 W_DKKD _REC_A2AXS_31_u2_S2 120 _CNV_R_R_Umr_10_zu__9_CM_S2 15 0 120 DEPOSIT ABSOLUTE FORMAT "%3.1" /end AXIS_PTS
/begin AXIS_PTS SSTSKL_ECOA2 "" 0x1DD1F0 W_DKKD _REC_A2AXS_31_u2_S2 120 _CNV_R_R_Umr_10_zu__9_CM_S2 15 0 120 DEPOSIT ABSOLUTE FORMAT "%3.1" /end AXIS_PTS
/begin AXIS_PTS SSTSKL_ECOWL2 "" 0x1DD210 W_DKKD _REC_A2AXS_31_u2_S2 120 _CNV_R_R_Umr_10_zu__9_CM_S2 15 0 120 DEPOSIT ABSOLUTE FORMAT "%3.1" /end AXIS_PTS
/begin RECORD_LAYOUT _REC_A1CUR_1_u2_u2_S2 FNC_VALUES 1 UWORD COLUMN_DIR DIRECT /end RECORD_LAYOUT
/begin RECORD_LAYOUT _REC_A2AXS_31_u2_S2 AXIS_PTS_X 2 UWORD INDEX_INCR DIRECT NO_AXIS_PTS_X 1 UWORD /end RECORD_LAYOUT
/end MODULE
/end PROJECT
