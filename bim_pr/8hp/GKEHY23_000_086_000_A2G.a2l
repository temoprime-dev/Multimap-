ASAP2_VERSION 1 51
/begin PROJECT ZHBC8600 "Gen2_BMW_System_Supplier_Lib"
/begin MODULE CPP ""
/begin MOD_COMMON "" BYTE_ORDER MSB_FIRST ALIGNMENT_BYTE 1 ALIGNMENT_WORD 2 ALIGNMENT_LONG 4 ALIGNMENT_FLOAT32_IEEE 4 ALIGNMENT_FLOAT64_IEEE 1 /end MOD_COMMON
/begin COMPU_VTAB _CNV_S_2_Enum_ERSP__136_S2 "" TAB_VERB 2 0 "RSP_NOT_STEPTR" 1 "RSP_STEPTR" DEFAULT_VALUE "" /end COMPU_VTAB
/begin COMPU_VTAB _CNV_S_2_Enum_EWKMA_127_S2 "" TAB_VERB 2 0 "WKMAX_AUF" 1 "WKMAX_GER" DEFAULT_VALUE "" /end COMPU_VTAB
/begin COMPU_VTAB _CNV_S_2_EnumMINMAX_269_S2 "" TAB_VERB 2 0 "MIN" 1 "MAX" DEFAULT_VALUE "" /end COMPU_VTAB
/begin COMPU_VTAB _CNV_S_3_Enum_EDNWK_270_S2 "" TAB_VERB 3 0 "KEIN_HOTMODE_KEINE_SCHALTUNG" 1 "HOTMODE" 2 "KEIN_HOTMODE_SCHALTUNG" DEFAULT_VALUE "" /end COMPU_VTAB
/begin COMPU_VTAB _CNV_S_3_Enum_EWKZ__126_S2 "" TAB_VERB 3 0 "WKZ" 1 "WKZNT" 2 "WKZFENSTER" DEFAULT_VALUE "" /end COMPU_VTAB
/begin COMPU_METHOD _CNV_S_2_Enum_ERSP__136_CM_S2 "" TAB_VERB "%6.3" "" COMPU_TAB_REF _CNV_S_2_Enum_ERSP__136_S2 /end COMPU_METHOD
/begin COMPU_METHOD _CNV_S_2_Enum_EWKMA_127_CM_S2 "" TAB_VERB "%6.3" "" COMPU_TAB_REF _CNV_S_2_Enum_EWKMA_127_S2 /end COMPU_METHOD
/begin COMPU_METHOD _CNV_S_2_EnumMINMAX_269_CM_S2 "" TAB_VERB "%6.3" "" COMPU_TAB_REF _CNV_S_2_EnumMINMAX_269_S2 /end COMPU_METHOD
/begin COMPU_METHOD _CNV_S_3_Enum_EDNWK_270_CM_S2 "" TAB_VERB "%6.3" "" COMPU_TAB_REF _CNV_S_3_Enum_EDNWK_270_S2 /end COMPU_METHOD
/begin COMPU_METHOD _CNV_S_3_Enum_EWKZ__126_CM_S2 "" TAB_VERB "%6.3" "" COMPU_TAB_REF _CNV_S_3_Enum_EWKZ__126_S2 /end COMPU_METHOD
/begin COMPU_METHOD UMR___1_100_0_S5_S3 "int = ((phys * 100) / 1) - (0) [-]" RAT_FUNC "%3.2" "[-]" COEFFS 0 100 0 0 0 1 /end COMPU_METHOD
/begin COMPU_METHOD UMR___1_1_0_S5_S3 "int = ((phys * 1) / 1) - (0) [-]" RAT_FUNC "%1.0" "[-]" COEFFS 0 1 0 0 0 1 /end COMPU_METHOD
/begin COMPU_METHOD UMR_BAR__1_1000_0_S5_S3 "int = ((phys * 1000) / 1) - (0) [bar]" RAT_FUNC "%4.3" "[bar]" COEFFS 0 1000 0 0 0 1 /end COMPU_METHOD
/begin COMPU_METHOD UMR_BAR__1_100_0_S5_S3 "int = ((phys * 100) / 1) - (0) [bar]" RAT_FUNC "%3.2" "[bar]" COEFFS 0 100 0 0 0 1 /end COMPU_METHOD
/begin COMPU_METHOD UMR_BAR__1_1_0_S5_S3 "int = ((phys * 1) / 1) - (0) [bar]" RAT_FUNC "%1.0" "[bar]" COEFFS 0 1 0 0 0 1 /end COMPU_METHOD
/begin COMPU_METHOD UMR_BAR_SEC_1_1000_0_S5_S3 "int = ((phys * 1000) / 1) - (0) [bar/s]" RAT_FUNC "%5.4" "[bar/s]" COEFFS 0 1000 0 0 0 1 /end COMPU_METHOD
/begin COMPU_METHOD UMR_BAR_SEC_1_10_0_S5_S3 "int = ((phys * 10) / 1) - (0) [bar/s]" RAT_FUNC "%2.1" "[bar/s]" COEFFS 0 10 0 0 0 1 /end COMPU_METHOD
/begin COMPU_METHOD UMR_BAR_SEC_1_1_0_S5_S3 "int = ((phys * 1) / 1) - (0) [bar/s]" RAT_FUNC "%1.0" "[bar/s]" COEFFS 0 1 0 0 0 1 /end COMPU_METHOD
/begin COMPU_METHOD UMR_GRADC__1_1_0_S5_S3 "int = ((phys * 1) / 1) - (0) [°C]" RAT_FUNC "%1.0" "[°C]" COEFFS 0 1 0 0 0 1 /end COMPU_METHOD
/begin COMPU_METHOD UMR_GRADC__1_1_M40_S5_S3 "int = ((phys * 1) / 1) - (-40) [°C]" RAT_FUNC "%1.0" "[°C]" COEFFS 0 1 40 0 0 1 /end COMPU_METHOD
/begin COMPU_METHOD UMR_LITER_MIN_1_10_0_S5_S3 "int = ((phys * 10) / 1) - (0) [Liter/min]" RAT_FUNC "%2.1" "[Liter/min]" COEFFS 0 10 0 0 0 1 /end COMPU_METHOD
/begin COMPU_METHOD UMR_M_SEC2_1_32_0_S5_S3 "int = ((phys * 32) / 1) - (0) [m/s^2]" RAT_FUNC "%3.2" "[m/s^2]" COEFFS 0 32 0 0 0 1 /end COMPU_METHOD
/begin COMPU_METHOD UMR_MSEC__10_1_0_S5_S3 "int = ((phys * 1) / 10) - (0) [ms]" RAT_FUNC "%1.0" "[ms]" COEFFS 0 0.1 0 0 0 1 /end COMPU_METHOD
/begin COMPU_METHOD UMR_MSEC__1_1_0_S5_S3 "int = ((phys * 1) / 1) - (0) [ms]" RAT_FUNC "%1.0" "[ms]" COEFFS 0 1 0 0 0 1 /end COMPU_METHOD
/begin COMPU_METHOD UMR_NM__1_1_0_S5_S3 "int = ((phys * 1) / 1) - (0) [Nm]" RAT_FUNC "%1.0" "[Nm]" COEFFS 0 1 0 0 0 1 /end COMPU_METHOD
/begin COMPU_METHOD UMR_NM_BAR_1_1_0_S5_S3 "int = ((phys * 1) / 1) - (0) [Nm/bar]" RAT_FUNC "%1.0" "[Nm/bar]" COEFFS 0 1 0 0 0 1 /end COMPU_METHOD
/begin COMPU_METHOD UMR_NM_SEC_1_1_0_S5_S3 "int = ((phys * 1) / 1) - (0) [Nm/s]" RAT_FUNC "%1.0" "[Nm/s]" COEFFS 0 1 0 0 0 1 /end COMPU_METHOD
/begin COMPU_METHOD UMR_PROZENT__20_51_0_S5_S3 "int = ((phys * 51) / 20) - (0) [%]" RAT_FUNC "%5.4" "[%]" COEFFS 0 2.55 0 0 0 1 /end COMPU_METHOD
/begin COMPU_METHOD UMR_SEC__1_1_0_S5_S3 "int = ((phys * 1) / 1) - (0) [s]" RAT_FUNC "%1.0" "[s]" COEFFS 0 1 0 0 0 1 /end COMPU_METHOD
/begin COMPU_METHOD UMR_U_MIN_1_1_0_S5_S3 "int = ((phys * 1) / 1) - (0) [U/min]" RAT_FUNC "%1.0" "[U/min]" COEFFS 0 1 0 0 0 1 /end COMPU_METHOD
/begin COMPU_METHOD UMR_U_MINSEC_1_1_0_S5_S3 "int = ((phys * 1) / 1) - (0) [U/(min*s)]" RAT_FUNC "%1.0" "[U/(min*s)]" COEFFS 0 1 0 0 0 1 /end COMPU_METHOD
/begin CHARACTERISTIC AL_AXREF_ADAOFF "Schwelle um Ada-Bew-Verbot durch Laengs-Beschleunigung zu deaktivieren" VALUE 0x1D7693 ZF_kw_ui8_S5_S3 5 UMR_M_SEC2_1_32_0_S5_S3 0 5 /end CHARACTERISTIC
/begin CHARACTERISTIC CGETR_MAX_APADA_IAE "obere Temp-Schwelle" VALUE 0x1D76A0 ZF_kw_ui8_S5_S3 215 UMR_GRADC__1_1_M40_S5_S3 0 215 /end CHARACTERISTIC
/begin CHARACTERISTIC CS_ADPSOB "Obere c_getr-Schwelle fuer Schaltungsbewertung" VALUE 0x1D7684 ZF_kw_ui8_S5_S3 190 UMR_GRADC__1_1_M40_S5_S3 -40 150 /end CHARACTERISTIC
/begin CHARACTERISTIC CS_ADPSUN "Untere c_getr-Schwelle fuer Schaltungsbewertung" VALUE 0x1D7685 ZF_kw_ui8_S5_S3 190 UMR_GRADC__1_1_M40_S5_S3 -40 150 /end CHARACTERISTIC
/begin CHARACTERISTIC CS_HYS_STADA "Hysterese fuer obere Temp. Schwelle CS_OB_STADA" VALUE 0x1D7708 ZF_kw_ui8_S5_S3 50 UMR_GRADC__1_1_0_S5_S3 0 50 /end CHARACTERISTIC
/begin CHARACTERISTIC CS_LOCK "Temperatur-Schwelle fuer Puls-Ada K0 Lock" VALUE 0x1D768D ZF_kw_ui8_S5_S3 190 UMR_GRADC__1_1_M40_S5_S3 -40 150 /end CHARACTERISTIC
/begin CHARACTERISTIC CS_MAXDRIFT_APADA_IAE "maximale zulaessige Temp- Aenderung waehrend Prueframpe" VALUE 0x1D76A1 ZF_kw_ui8_S5_S3 200 UMR_GRADC__1_1_0_S5_S3 0 200 /end CHARACTERISTIC
/begin CHARACTERISTIC CS_OB_STADA "obere c_getr-Schwelle fuer Tester Pulsadapton" VALUE 0x1D7707 ZF_kw_ui8_S5_S3 190 UMR_GRADC__1_1_M40_S5_S3 -40 150 /end CHARACTERISTIC
/begin CHARACTERISTIC CS_PFADOB "Obere Grenztemperatur fuer Adaption" VALUE 0x1D76B2 ZF_kw_ui8_S5_S3 190 UMR_GRADC__1_1_M40_S5_S3 -40 150 /end CHARACTERISTIC
/begin CHARACTERISTIC CS_PFADRSUN "Untere Grenztemperatur fuer Adaption RS" VALUE 0x1D76B1 ZF_kw_ui8_S5_S3 190 UMR_GRADC__1_1_M40_S5_S3 -40 150 /end CHARACTERISTIC
/begin CHARACTERISTIC CS_UN_STADA "untere c_getr-Schwelle fuer Tester Pulsadapton" VALUE 0x1D7706 ZF_kw_ui8_S5_S3 190 UMR_GRADC__1_1_M40_S5_S3 -40 150 /end CHARACTERISTIC
/begin CHARACTERISTIC C_DELTA_MAX_APADA "Temperatur-Differenz als Eingangskriterium fuer IAE-APADA" VALUE 0x1D769B ZF_kw_ui8_S5_S3 100 UMR_GRADC__1_1_0_S5_S3 0 100 /end CHARACTERISTIC
/begin CHARACTERISTIC DKIS_ABBRUCH_APERK_IAE "dki Abbruchschwelle der APERK" VALUE 0x1D769C ZF_kw_ui8_S5_S3 100 UMR_PROZENT__20_51_0_S5_S3 0 100 /end CHARACTERISTIC
/begin CHARACTERISTIC DKIS_MOTPFADRS "DKI-Schwelle bei RS PFAD" VALUE 0x1D76B3 ZF_kw_ui8_S5_S3 100 UMR_PROZENT__20_51_0_S5_S3 0 100 /end CHARACTERISTIC
/begin CHARACTERISTIC DKIS_STADA "DKI Schwelle fuer Testeradaption" VALUE 0x1D7705 ZF_kw_ui8_S5_S3 100 UMR_PROZENT__20_51_0_S5_S3 0 100 /end CHARACTERISTIC
/begin CHARACTERISTIC DKI_PSGLSADHS "Zul. Differenz zum Anfangswert von DKI bei HS" VALUE 0x1D7686 ZF_kw_ui8_S5_S3 100 UMR_PROZENT__20_51_0_S5_S3 0 100 /end CHARACTERISTIC
/begin CHARACTERISTIC DKI_PSGLSADRS "Zul. Differenz zum Anfangswert von DKI bei RS" VALUE 0x1D7687 ZF_kw_ui8_S5_S3 100 UMR_PROZENT__20_51_0_S5_S3 0 100 /end CHARACTERISTIC
/begin CHARACTERISTIC FI_ADANEU_STADA "Filteranzahl f.Gewichtung des neuen ADA-Werts" VALUE 0x1D770C ZF_kw_ui8_S5_S3 9 UMR___1_1_0_S5_S3 1 10 /end CHARACTERISTIC
/begin CHARACTERISTIC F_TVABBR "Faktor fuer Verbotszeit auf Abfrage ND_ADABBR" VALUE 0x1D770D ZF_kw_ui8_S5_S3 99.6078 UMR_PROZENT__20_51_0_S5_S3 0 99.6078431373 /end CHARACTERISTIC
/begin CHARACTERISTIC F_TVABBR_PF_STADA "Faktor fuer Verbotszeit auf Abfrage ND_ADABBR bei SF" VALUE 0x1D76BB ZF_kw_ui8_S5_S3 99.6078 UMR_PROZENT__20_51_0_S5_S3 0 99.6078431373 /end CHARACTERISTIC
/begin CHARACTERISTIC F_TVABBR_SF_STADA "Faktor fuer Verbotszeit auf Abfrage ND_ADABBR bei PF" VALUE 0x1D76BC ZF_kw_ui8_S5_S3 99.6078 UMR_PROZENT__20_51_0_S5_S3 0 99.6078431373 /end CHARACTERISTIC
/begin CHARACTERISTIC GANG_LOCK "Gang fuer Puls-Ada K0 Lock" VALUE 0x1D768E ZF_kw_ui8_S5_S3 7 UMR___1_1_0_S5_S3 1 8 /end CHARACTERISTIC
/begin CHARACTERISTIC KF_PFADMTHS12 "Adaptionswert PFAD fuer xy-Schaltung" MAP 0x199654 ZF_kf_si16_S5_S3 2.5 UMR_BAR__1_1000_0_S5_S3 -1.25 1.25
 /begin AXIS_DESCR STD_AXIS iAdaPfusf.td_pfad UMR_MSEC__10_1_0_S5_S3 8 -3000 3000 DEPOSIT ABSOLUTE /end AXIS_DESCR
 /begin AXIS_DESCR STD_AXIS iAdaPfusf.m_t_pfad UMR_NM__1_1_0_S5_S3 6 -200 1300 DEPOSIT ABSOLUTE /end AXIS_DESCR
/end CHARACTERISTIC
/begin CHARACTERISTIC KF_PFADMTHS23 "Adaptionswert PFAD fuer xy-Schaltung" MAP 0x199718 ZF_kf_si16_S5_S3 2.5 UMR_BAR__1_1000_0_S5_S3 -1.25 1.25
 /begin AXIS_DESCR STD_AXIS iAdaPfusf.td_pfad UMR_MSEC__10_1_0_S5_S3 8 -3000 3000 DEPOSIT ABSOLUTE /end AXIS_DESCR
 /begin AXIS_DESCR STD_AXIS iAdaPfusf.m_t_pfad UMR_NM__1_1_0_S5_S3 6 -200 1300 DEPOSIT ABSOLUTE /end AXIS_DESCR
/end CHARACTERISTIC
/begin CHARACTERISTIC KF_PFADMTHS34 "Adaptionswert PFAD fuer xy-Schaltung" MAP 0x1997DC ZF_kf_si16_S5_S3 2.5 UMR_BAR__1_1000_0_S5_S3 -1.25 1.25
 /begin AXIS_DESCR STD_AXIS iAdaPfusf.td_pfad UMR_MSEC__10_1_0_S5_S3 8 -3000 3000 DEPOSIT ABSOLUTE /end AXIS_DESCR
 /begin AXIS_DESCR STD_AXIS iAdaPfusf.m_t_pfad UMR_NM__1_1_0_S5_S3 6 -200 1300 DEPOSIT ABSOLUTE /end AXIS_DESCR
/end CHARACTERISTIC
/begin CHARACTERISTIC KF_PFADMTHS45 "Adaptionswert PFAD fuer xy-Schaltung" MAP 0x1998A0 ZF_kf_si16_S5_S3 2.5 UMR_BAR__1_1000_0_S5_S3 -1.25 1.25
 /begin AXIS_DESCR STD_AXIS iAdaPfusf.td_pfad UMR_MSEC__10_1_0_S5_S3 8 -3000 3000 DEPOSIT ABSOLUTE /end AXIS_DESCR
 /begin AXIS_DESCR STD_AXIS iAdaPfusf.m_t_pfad UMR_NM__1_1_0_S5_S3 6 -200 1300 DEPOSIT ABSOLUTE /end AXIS_DESCR
/end CHARACTERISTIC
/begin CHARACTERISTIC KF_PFADMTHS56 "Adaptionswert PFAD fuer xy-Schaltung" MAP 0x199964 ZF_kf_si16_S5_S3 2.5 UMR_BAR__1_1000_0_S5_S3 -1.25 1.25
 /begin AXIS_DESCR STD_AXIS iAdaPfusf.td_pfad UMR_MSEC__10_1_0_S5_S3 8 -3000 3000 DEPOSIT ABSOLUTE /end AXIS_DESCR
 /begin AXIS_DESCR STD_AXIS iAdaPfusf.m_t_pfad UMR_NM__1_1_0_S5_S3 6 -200 1300 DEPOSIT ABSOLUTE /end AXIS_DESCR
/end CHARACTERISTIC
/begin CHARACTERISTIC KF_PFADMTHS67 "Adaptionswert PFAD fuer xy-Schaltung" MAP 0x199A28 ZF_kf_si16_S5_S3 2.5 UMR_BAR__1_1000_0_S5_S3 -1.25 1.25
 /begin AXIS_DESCR STD_AXIS iAdaPfusf.td_pfad UMR_MSEC__10_1_0_S5_S3 8 -3000 3000 DEPOSIT ABSOLUTE /end AXIS_DESCR
 /begin AXIS_DESCR STD_AXIS iAdaPfusf.m_t_pfad UMR_NM__1_1_0_S5_S3 6 -200 1300 DEPOSIT ABSOLUTE /end AXIS_DESCR
/end CHARACTERISTIC
/begin CHARACTERISTIC KF_PFADMTHS78 "Adaptionswert PFAD fuer xy-Schaltung" MAP 0x199AEC ZF_kf_si16_S5_S3 2.5 UMR_BAR__1_1000_0_S5_S3 -1.25 1.25
 /begin AXIS_DESCR STD_AXIS iAdaPfusf.td_pfad UMR_MSEC__10_1_0_S5_S3 8 -3000 3000 DEPOSIT ABSOLUTE /end AXIS_DESCR
 /begin AXIS_DESCR STD_AXIS iAdaPfusf.m_t_pfad UMR_NM__1_1_0_S5_S3 6 -200 1300 DEPOSIT ABSOLUTE /end AXIS_DESCR
/end CHARACTERISTIC
/begin CHARACTERISTIC KF_PFADRS21 "Schaltungsabhaengiger Adaptionswert PF ADAPFN" MAP 0x199BBC ZF_kf_si16_S5_S3 2.5 UMR_BAR__1_100_0_S5_S3 -1.25 1.25
 /begin AXIS_DESCR STD_AXIS iAdaPfusf.td_pfadtsyn UMR_MSEC__10_1_0_S5_S3 8 -300 300 DEPOSIT ABSOLUTE /end AXIS_DESCR
 /begin AXIS_DESCR STD_AXIS iAdaPfusf.pm_gls_pfad UMR_BAR__1_100_0_S5_S3 4 -1.25 1.25 DEPOSIT ABSOLUTE /end AXIS_DESCR
/end CHARACTERISTIC
/begin CHARACTERISTIC KF_PFADRS32 "Schaltungsabhaengiger Adaptionswert PF ADAPFN" MAP 0x199C28 ZF_kf_si16_S5_S3 2.5 UMR_BAR__1_100_0_S5_S3 -1.25 1.25
 /begin AXIS_DESCR STD_AXIS iAdaPfusf.td_pfadtsyn UMR_MSEC__10_1_0_S5_S3 8 -300 300 DEPOSIT ABSOLUTE /end AXIS_DESCR
 /begin AXIS_DESCR STD_AXIS iAdaPfusf.pm_gls_pfad UMR_BAR__1_100_0_S5_S3 4 -1.25 1.25 DEPOSIT ABSOLUTE /end AXIS_DESCR
/end CHARACTERISTIC
/begin CHARACTERISTIC KF_PFADRS43 "Schaltungsabhaengiger Adaptionswert PF ADAPFN" MAP 0x199C94 ZF_kf_si16_S5_S3 2.5 UMR_BAR__1_100_0_S5_S3 -1.25 1.25
 /begin AXIS_DESCR STD_AXIS iAdaPfusf.td_pfadtsyn UMR_MSEC__10_1_0_S5_S3 8 -300 300 DEPOSIT ABSOLUTE /end AXIS_DESCR
 /begin AXIS_DESCR STD_AXIS iAdaPfusf.pm_gls_pfad UMR_BAR__1_100_0_S5_S3 4 -1.25 1.25 DEPOSIT ABSOLUTE /end AXIS_DESCR
/end CHARACTERISTIC
/begin CHARACTERISTIC KF_PFADRS54 "Schaltungsabhaengiger Adaptionswert PF ADAPFN" MAP 0x199D00 ZF_kf_si16_S5_S3 2.5 UMR_BAR__1_100_0_S5_S3 -1.25 1.25
 /begin AXIS_DESCR STD_AXIS iAdaPfusf.td_pfadtsyn UMR_MSEC__10_1_0_S5_S3 8 -300 300 DEPOSIT ABSOLUTE /end AXIS_DESCR
 /begin AXIS_DESCR STD_AXIS iAdaPfusf.pm_gls_pfad UMR_BAR__1_100_0_S5_S3 4 -1.25 1.25 DEPOSIT ABSOLUTE /end AXIS_DESCR
/end CHARACTERISTIC
/begin CHARACTERISTIC KF_PFADRS65 "Schaltungsabhaengiger Adaptionswert PF ADAPFN" MAP 0x199D6C ZF_kf_si16_S5_S3 2.5 UMR_BAR__1_100_0_S5_S3 -1.25 1.25
 /begin AXIS_DESCR STD_AXIS iAdaPfusf.td_pfadtsyn UMR_MSEC__10_1_0_S5_S3 8 -300 300 DEPOSIT ABSOLUTE /end AXIS_DESCR
 /begin AXIS_DESCR STD_AXIS iAdaPfusf.pm_gls_pfad UMR_BAR__1_100_0_S5_S3 4 -1.25 1.25 DEPOSIT ABSOLUTE /end AXIS_DESCR
/end CHARACTERISTIC
/begin CHARACTERISTIC KF_PFADRS76 "Schaltungsabhaengiger Adaptionswert PF ADAPFN" MAP 0x199DD8 ZF_kf_si16_S5_S3 2.5 UMR_BAR__1_100_0_S5_S3 -1.25 1.25
 /begin AXIS_DESCR STD_AXIS iAdaPfusf.td_pfadtsyn UMR_MSEC__10_1_0_S5_S3 8 -300 300 DEPOSIT ABSOLUTE /end AXIS_DESCR
 /begin AXIS_DESCR STD_AXIS iAdaPfusf.pm_gls_pfad UMR_BAR__1_100_0_S5_S3 4 -1.25 1.25 DEPOSIT ABSOLUTE /end AXIS_DESCR
/end CHARACTERISTIC
/begin CHARACTERISTIC KF_PFADRS87 "Schaltungsabhaengiger Adaptionswert PF ADAPFN" MAP 0x199E44 ZF_kf_si16_S5_S3 2.5 UMR_BAR__1_100_0_S5_S3 -1.25 1.25
 /begin AXIS_DESCR STD_AXIS iAdaPfusf.td_pfadtsyn UMR_MSEC__10_1_0_S5_S3 8 -300 300 DEPOSIT ABSOLUTE /end AXIS_DESCR
 /begin AXIS_DESCR STD_AXIS iAdaPfusf.pm_gls_pfad UMR_BAR__1_100_0_S5_S3 4 -1.25 1.25 DEPOSIT ABSOLUTE /end AXIS_DESCR
/end CHARACTERISTIC
/begin CHARACTERISTIC KF_PGLSADNT21 "Ada-Wert abh. mittl. Regeleingr. und n_t 21 Sp." MAP 0x1984B8 ZF_kf_si16_S5_S3 2.5 UMR_BAR__1_100_0_S5_S3 -1.25 1.25
 /begin AXIS_DESCR STD_AXIS iAdaGlast.pm_gls UMR_BAR__1_100_0_S5_S3 8 -2.55 2.55 DEPOSIT ABSOLUTE /end AXIS_DESCR
 /begin AXIS_DESCR STD_AXIS iAdaGlast.n_tsyn_gls UMR_U_MIN_1_1_0_S5_S3 4 0 8200 DEPOSIT ABSOLUTE /end AXIS_DESCR
/end CHARACTERISTIC
/begin CHARACTERISTIC KF_PGLSADNT32 "Ada-Wert abh. mittl. Regeleingr. und n_t 21 Sp." MAP 0x198518 ZF_kf_si16_S5_S3 2.5 UMR_BAR__1_100_0_S5_S3 -1.25 1.25
 /begin AXIS_DESCR STD_AXIS iAdaGlast.pm_gls UMR_BAR__1_100_0_S5_S3 8 -2.55 2.55 DEPOSIT ABSOLUTE /end AXIS_DESCR
 /begin AXIS_DESCR STD_AXIS iAdaGlast.n_tsyn_gls UMR_U_MIN_1_1_0_S5_S3 4 0 8200 DEPOSIT ABSOLUTE /end AXIS_DESCR
/end CHARACTERISTIC
/begin CHARACTERISTIC KF_PGLSADNT43 "Ada-Wert abh. mittl. Regeleingr. und n_t 21 Sp." MAP 0x198578 ZF_kf_si16_S5_S3 2.5 UMR_BAR__1_100_0_S5_S3 -1.25 1.25
 /begin AXIS_DESCR STD_AXIS iAdaGlast.pm_gls UMR_BAR__1_100_0_S5_S3 8 -2.55 2.55 DEPOSIT ABSOLUTE /end AXIS_DESCR
 /begin AXIS_DESCR STD_AXIS iAdaGlast.n_tsyn_gls UMR_U_MIN_1_1_0_S5_S3 4 0 8200 DEPOSIT ABSOLUTE /end AXIS_DESCR
/end CHARACTERISTIC
/begin CHARACTERISTIC KF_PGLSADNT54 "Ada-Wert abh. mittl. Regeleingr. und n_t 21 Sp." MAP 0x1985D8 ZF_kf_si16_S5_S3 2.5 UMR_BAR__1_100_0_S5_S3 -1.25 1.25
 /begin AXIS_DESCR STD_AXIS iAdaGlast.pm_gls UMR_BAR__1_100_0_S5_S3 8 -2.55 2.55 DEPOSIT ABSOLUTE /end AXIS_DESCR
 /begin AXIS_DESCR STD_AXIS iAdaGlast.n_tsyn_gls UMR_U_MIN_1_1_0_S5_S3 4 0 8200 DEPOSIT ABSOLUTE /end AXIS_DESCR
/end CHARACTERISTIC
/begin CHARACTERISTIC KF_PGLSADNT65 "Ada-Wert abh. mittl. Regeleingr. und n_t 21 Sp." MAP 0x198638 ZF_kf_si16_S5_S3 2.5 UMR_BAR__1_100_0_S5_S3 -1.25 1.25
 /begin AXIS_DESCR STD_AXIS iAdaGlast.pm_gls UMR_BAR__1_100_0_S5_S3 8 -2.55 2.55 DEPOSIT ABSOLUTE /end AXIS_DESCR
 /begin AXIS_DESCR STD_AXIS iAdaGlast.n_tsyn_gls UMR_U_MIN_1_1_0_S5_S3 4 0 8200 DEPOSIT ABSOLUTE /end AXIS_DESCR
/end CHARACTERISTIC
/begin CHARACTERISTIC KF_PGLSADNT76 "Ada-Wert abh. mittl. Regeleingr. und n_t 21 Sp." MAP 0x198698 ZF_kf_si16_S5_S3 2.5 UMR_BAR__1_100_0_S5_S3 -1.25 1.25
 /begin AXIS_DESCR STD_AXIS iAdaGlast.pm_gls UMR_BAR__1_100_0_S5_S3 8 -2.55 2.55 DEPOSIT ABSOLUTE /end AXIS_DESCR
 /begin AXIS_DESCR STD_AXIS iAdaGlast.n_tsyn_gls UMR_U_MIN_1_1_0_S5_S3 4 0 8200 DEPOSIT ABSOLUTE /end AXIS_DESCR
/end CHARACTERISTIC
/begin CHARACTERISTIC KF_PGLSADNT87 "Ada-Wert abh. mittl. Regeleingr. und n_t 21 Sp." MAP 0x1986F8 ZF_kf_si16_S5_S3 2.5 UMR_BAR__1_100_0_S5_S3 -1.25 1.25
 /begin AXIS_DESCR STD_AXIS iAdaGlast.pm_gls UMR_BAR__1_100_0_S5_S3 8 -2.55 2.55 DEPOSIT ABSOLUTE /end AXIS_DESCR
 /begin AXIS_DESCR STD_AXIS iAdaGlast.n_tsyn_gls UMR_U_MIN_1_1_0_S5_S3 4 0 8200 DEPOSIT ABSOLUTE /end AXIS_DESCR
/end CHARACTERISTIC
/begin CHARACTERISTIC KF_PGLSADNTSP21 "Ada-Wert abh. mittl. Regeleingr. und n_t 21 Sp." MAP 0x198758 ZF_kf_si16_S5_S3 2.5 UMR_BAR__1_100_0_S5_S3 -1.25 1.25
 /begin AXIS_DESCR STD_AXIS iAdaGlast.pm_gls UMR_BAR__1_100_0_S5_S3 8 -2.55 2.55 DEPOSIT ABSOLUTE /end AXIS_DESCR
 /begin AXIS_DESCR STD_AXIS iAdaGlast.n_tsyn_gls UMR_U_MIN_1_1_0_S5_S3 4 0 8200 DEPOSIT ABSOLUTE /end AXIS_DESCR
/end CHARACTERISTIC
/begin CHARACTERISTIC KF_PGLSADNTSP31 "Ada-Wert abh. mittl. Regeleingr. und n_t 21 Sp." MAP 0x1989F8 ZF_kf_si16_S5_S3 2.5 UMR_BAR__1_100_0_S5_S3 -1.25 1.25
 /begin AXIS_DESCR STD_AXIS iAdaGlast.pm_gls UMR_BAR__1_100_0_S5_S3 8 -2.55 2.55 DEPOSIT ABSOLUTE /end AXIS_DESCR
 /begin AXIS_DESCR STD_AXIS iAdaGlast.n_tsyn_gls UMR_U_MIN_1_1_0_S5_S3 4 0 8200 DEPOSIT ABSOLUTE /end AXIS_DESCR
/end CHARACTERISTIC
/begin CHARACTERISTIC KF_PGLSADNTSP32 "Ada-Wert abh. mittl. Regeleingr. und n_t 21 Sp." MAP 0x1987B8 ZF_kf_si16_S5_S3 2.5 UMR_BAR__1_100_0_S5_S3 -1.25 1.25
 /begin AXIS_DESCR STD_AXIS iAdaGlast.pm_gls UMR_BAR__1_100_0_S5_S3 8 -2.55 2.55 DEPOSIT ABSOLUTE /end AXIS_DESCR
 /begin AXIS_DESCR STD_AXIS iAdaGlast.n_tsyn_gls UMR_U_MIN_1_1_0_S5_S3 4 0 8200 DEPOSIT ABSOLUTE /end AXIS_DESCR
/end CHARACTERISTIC
/begin CHARACTERISTIC KF_PGLSADNTSP42 "Ada-Wert abh. mittl. Regeleingr. und n_t 21 Sp." MAP 0x198A58 ZF_kf_si16_S5_S3 2.5 UMR_BAR__1_100_0_S5_S3 -1.25 1.25
 /begin AXIS_DESCR STD_AXIS iAdaGlast.pm_gls UMR_BAR__1_100_0_S5_S3 8 -2.55 2.55 DEPOSIT ABSOLUTE /end AXIS_DESCR
 /begin AXIS_DESCR STD_AXIS iAdaGlast.n_tsyn_gls UMR_U_MIN_1_1_0_S5_S3 4 0 8200 DEPOSIT ABSOLUTE /end AXIS_DESCR
/end CHARACTERISTIC
/begin CHARACTERISTIC KF_PGLSADNTSP43 "Ada-Wert abh. mittl. Regeleingr. und n_t 21 Sp." MAP 0x198818 ZF_kf_si16_S5_S3 2.5 UMR_BAR__1_100_0_S5_S3 -1.25 1.25
 /begin AXIS_DESCR STD_AXIS iAdaGlast.pm_gls UMR_BAR__1_100_0_S5_S3 8 -2.55 2.55 DEPOSIT ABSOLUTE /end AXIS_DESCR
 /begin AXIS_DESCR STD_AXIS iAdaGlast.n_tsyn_gls UMR_U_MIN_1_1_0_S5_S3 4 0 8200 DEPOSIT ABSOLUTE /end AXIS_DESCR
/end CHARACTERISTIC
/begin CHARACTERISTIC KF_PGLSADNTSP51 "Ada-Wert abh. mittl. Regeleingr. und n_t 21 Sp." MAP 0x198AB8 ZF_kf_si16_S5_S3 2.5 UMR_BAR__1_100_0_S5_S3 -1.25 1.25
 /begin AXIS_DESCR STD_AXIS iAdaGlast.pm_gls UMR_BAR__1_100_0_S5_S3 8 -2.55 2.55 DEPOSIT ABSOLUTE /end AXIS_DESCR
 /begin AXIS_DESCR STD_AXIS iAdaGlast.n_tsyn_gls UMR_U_MIN_1_1_0_S5_S3 4 0 8200 DEPOSIT ABSOLUTE /end AXIS_DESCR
/end CHARACTERISTIC
/begin CHARACTERISTIC KF_PGLSADNTSP53 "Ada-Wert abh. mittl. Regeleingr. und n_t 21 Sp." MAP 0x198B18 ZF_kf_si16_S5_S3 2.5 UMR_BAR__1_100_0_S5_S3 -1.25 1.25
 /begin AXIS_DESCR STD_AXIS iAdaGlast.pm_gls UMR_BAR__1_100_0_S5_S3 8 -2.55 2.55 DEPOSIT ABSOLUTE /end AXIS_DESCR
 /begin AXIS_DESCR STD_AXIS iAdaGlast.n_tsyn_gls UMR_U_MIN_1_1_0_S5_S3 4 0 8200 DEPOSIT ABSOLUTE /end AXIS_DESCR
/end CHARACTERISTIC
/begin CHARACTERISTIC KF_PGLSADNTSP54 "Ada-Wert abh. mittl. Regeleingr. und n_t 21 Sp." MAP 0x198878 ZF_kf_si16_S5_S3 2.5 UMR_BAR__1_100_0_S5_S3 -1.25 1.25
 /begin AXIS_DESCR STD_AXIS iAdaGlast.pm_gls UMR_BAR__1_100_0_S5_S3 8 -2.55 2.55 DEPOSIT ABSOLUTE /end AXIS_DESCR
 /begin AXIS_DESCR STD_AXIS iAdaGlast.n_tsyn_gls UMR_U_MIN_1_1_0_S5_S3 4 0 8200 DEPOSIT ABSOLUTE /end AXIS_DESCR
/end CHARACTERISTIC
/begin CHARACTERISTIC KF_PGLSADNTSP63 "Ada-Wert abh. mittl. Regeleingr. und n_t 21 Sp." MAP 0x198B78 ZF_kf_si16_S5_S3 2.5 UMR_BAR__1_100_0_S5_S3 -1.25 1.25
 /begin AXIS_DESCR STD_AXIS iAdaGlast.pm_gls UMR_BAR__1_100_0_S5_S3 8 -2.55 2.55 DEPOSIT ABSOLUTE /end AXIS_DESCR
 /begin AXIS_DESCR STD_AXIS iAdaGlast.n_tsyn_gls UMR_U_MIN_1_1_0_S5_S3 4 0 8200 DEPOSIT ABSOLUTE /end AXIS_DESCR
/end CHARACTERISTIC
/begin CHARACTERISTIC KF_PGLSADNTSP64 "Ada-Wert abh. mittl. Regeleingr. und n_t 21 Sp." MAP 0x198BD8 ZF_kf_si16_S5_S3 2.5 UMR_BAR__1_100_0_S5_S3 -1.25 1.25
 /begin AXIS_DESCR STD_AXIS iAdaGlast.pm_gls UMR_BAR__1_100_0_S5_S3 8 -2.55 2.55 DEPOSIT ABSOLUTE /end AXIS_DESCR
 /begin AXIS_DESCR STD_AXIS iAdaGlast.n_tsyn_gls UMR_U_MIN_1_1_0_S5_S3 4 0 8200 DEPOSIT ABSOLUTE /end AXIS_DESCR
/end CHARACTERISTIC
/begin CHARACTERISTIC KF_PGLSADNTSP65 "Ada-Wert abh. mittl. Regeleingr. und n_t 21 Sp." MAP 0x1988D8 ZF_kf_si16_S5_S3 2.5 UMR_BAR__1_100_0_S5_S3 -1.25 1.25
 /begin AXIS_DESCR STD_AXIS iAdaGlast.pm_gls UMR_BAR__1_100_0_S5_S3 8 -2.55 2.55 DEPOSIT ABSOLUTE /end AXIS_DESCR
 /begin AXIS_DESCR STD_AXIS iAdaGlast.n_tsyn_gls UMR_U_MIN_1_1_0_S5_S3 4 0 8200 DEPOSIT ABSOLUTE /end AXIS_DESCR
/end CHARACTERISTIC
/begin CHARACTERISTIC KF_PGLSADNTSP71 "Ada-Wert abh. mittl. Regeleingr. und n_t 21 Sp." MAP 0x198C38 ZF_kf_si16_S5_S3 2.5 UMR_BAR__1_100_0_S5_S3 -1.25 1.25
 /begin AXIS_DESCR STD_AXIS iAdaGlast.pm_gls UMR_BAR__1_100_0_S5_S3 8 -2.55 2.55 DEPOSIT ABSOLUTE /end AXIS_DESCR
 /begin AXIS_DESCR STD_AXIS iAdaGlast.n_tsyn_gls UMR_U_MIN_1_1_0_S5_S3 4 0 8200 DEPOSIT ABSOLUTE /end AXIS_DESCR
/end CHARACTERISTIC
/begin CHARACTERISTIC KF_PGLSADNTSP75 "Ada-Wert abh. mittl. Regeleingr. und n_t 21 Sp." MAP 0x198C98 ZF_kf_si16_S5_S3 2.5 UMR_BAR__1_100_0_S5_S3 -1.25 1.25
 /begin AXIS_DESCR STD_AXIS iAdaGlast.pm_gls UMR_BAR__1_100_0_S5_S3 8 -2.55 2.55 DEPOSIT ABSOLUTE /end AXIS_DESCR
 /begin AXIS_DESCR STD_AXIS iAdaGlast.n_tsyn_gls UMR_U_MIN_1_1_0_S5_S3 4 0 8200 DEPOSIT ABSOLUTE /end AXIS_DESCR
/end CHARACTERISTIC
/begin CHARACTERISTIC KF_PGLSADNTSP76 "Ada-Wert abh. mittl. Regeleingr. und n_t 21 Sp." MAP 0x198938 ZF_kf_si16_S5_S3 2.5 UMR_BAR__1_100_0_S5_S3 -1.25 1.25
 /begin AXIS_DESCR STD_AXIS iAdaGlast.pm_gls UMR_BAR__1_100_0_S5_S3 8 -2.55 2.55 DEPOSIT ABSOLUTE /end AXIS_DESCR
 /begin AXIS_DESCR STD_AXIS iAdaGlast.n_tsyn_gls UMR_U_MIN_1_1_0_S5_S3 4 0 8200 DEPOSIT ABSOLUTE /end AXIS_DESCR
/end CHARACTERISTIC
/begin CHARACTERISTIC KF_PGLSADNTSP82 "Ada-Wert abh. mittl. Regeleingr. und n_t 21 Sp." MAP 0x198CF8 ZF_kf_si16_S5_S3 2.5 UMR_BAR__1_100_0_S5_S3 -1.25 1.25
 /begin AXIS_DESCR STD_AXIS iAdaGlast.pm_gls UMR_BAR__1_100_0_S5_S3 8 -2.55 2.55 DEPOSIT ABSOLUTE /end AXIS_DESCR
 /begin AXIS_DESCR STD_AXIS iAdaGlast.n_tsyn_gls UMR_U_MIN_1_1_0_S5_S3 4 0 8200 DEPOSIT ABSOLUTE /end AXIS_DESCR
/end CHARACTERISTIC
/begin CHARACTERISTIC KF_PGLSADNTSP84 "Ada-Wert abh. mittl. Regeleingr. und n_t 21 Sp." MAP 0x198D58 ZF_kf_si16_S5_S3 2.5 UMR_BAR__1_100_0_S5_S3 -1.25 1.25
 /begin AXIS_DESCR STD_AXIS iAdaGlast.pm_gls UMR_BAR__1_100_0_S5_S3 8 -2.55 2.55 DEPOSIT ABSOLUTE /end AXIS_DESCR
 /begin AXIS_DESCR STD_AXIS iAdaGlast.n_tsyn_gls UMR_U_MIN_1_1_0_S5_S3 4 0 8200 DEPOSIT ABSOLUTE /end AXIS_DESCR
/end CHARACTERISTIC
/begin CHARACTERISTIC KF_PGLSADNTSP86 "Ada-Wert abh. mittl. Regeleingr. und n_t 21 Sp." MAP 0x198DB8 ZF_kf_si16_S5_S3 2.5 UMR_BAR__1_100_0_S5_S3 -1.25 1.25
 /begin AXIS_DESCR STD_AXIS iAdaGlast.pm_gls UMR_BAR__1_100_0_S5_S3 8 -2.55 2.55 DEPOSIT ABSOLUTE /end AXIS_DESCR
 /begin AXIS_DESCR STD_AXIS iAdaGlast.n_tsyn_gls UMR_U_MIN_1_1_0_S5_S3 4 0 8200 DEPOSIT ABSOLUTE /end AXIS_DESCR
/end CHARACTERISTIC
/begin CHARACTERISTIC KF_PGLSADNTSP87 "Ada-Wert abh. mittl. Regeleingr. und n_t 21 Sp." MAP 0x198998 ZF_kf_si16_S5_S3 2.5 UMR_BAR__1_100_0_S5_S3 -1.25 1.25
 /begin AXIS_DESCR STD_AXIS iAdaGlast.pm_gls UMR_BAR__1_100_0_S5_S3 8 -2.55 2.55 DEPOSIT ABSOLUTE /end AXIS_DESCR
 /begin AXIS_DESCR STD_AXIS iAdaGlast.n_tsyn_gls UMR_U_MIN_1_1_0_S5_S3 4 0 8200 DEPOSIT ABSOLUTE /end AXIS_DESCR
/end CHARACTERISTIC
/begin CHARACTERISTIC KF_PGLSADNTSPORT31 "Ada-Wert abh. mittl. Regeleingr. und n_t 21 Sp." MAP 0x198E18 ZF_kf_si16_S5_S3 2.5 UMR_BAR__1_100_0_S5_S3 -1.25 1.25
 /begin AXIS_DESCR STD_AXIS iAdaGlast.pm_gls UMR_BAR__1_100_0_S5_S3 8 -2.55 2.55 DEPOSIT ABSOLUTE /end AXIS_DESCR
 /begin AXIS_DESCR STD_AXIS iAdaGlast.n_tsyn_gls UMR_U_MIN_1_1_0_S5_S3 4 0 8200 DEPOSIT ABSOLUTE /end AXIS_DESCR
/end CHARACTERISTIC
/begin CHARACTERISTIC KF_PGLSADNTSPORT42 "Ada-Wert abh. mittl. Regeleingr. und n_t 21 Sp." MAP 0x198E78 ZF_kf_si16_S5_S3 2.5 UMR_BAR__1_100_0_S5_S3 -1.25 1.25
 /begin AXIS_DESCR STD_AXIS iAdaGlast.pm_gls UMR_BAR__1_100_0_S5_S3 8 -2.55 2.55 DEPOSIT ABSOLUTE /end AXIS_DESCR
 /begin AXIS_DESCR STD_AXIS iAdaGlast.n_tsyn_gls UMR_U_MIN_1_1_0_S5_S3 4 0 8200 DEPOSIT ABSOLUTE /end AXIS_DESCR
/end CHARACTERISTIC
/begin CHARACTERISTIC KF_PGLSADNTSPORT51 "Ada-Wert abh. mittl. Regeleingr. und n_t 21 Sp." MAP 0x198ED8 ZF_kf_si16_S5_S3 2.5 UMR_BAR__1_100_0_S5_S3 -1.25 1.25
 /begin AXIS_DESCR STD_AXIS iAdaGlast.pm_gls UMR_BAR__1_100_0_S5_S3 8 -2.55 2.55 DEPOSIT ABSOLUTE /end AXIS_DESCR
 /begin AXIS_DESCR STD_AXIS iAdaGlast.n_tsyn_gls UMR_U_MIN_1_1_0_S5_S3 4 0 8200 DEPOSIT ABSOLUTE /end AXIS_DESCR
/end CHARACTERISTIC
/begin CHARACTERISTIC KF_PGLSADNTSPORT53 "Ada-Wert abh. mittl. Regeleingr. und n_t 21 Sp." MAP 0x198F38 ZF_kf_si16_S5_S3 2.5 UMR_BAR__1_100_0_S5_S3 -1.25 1.25
 /begin AXIS_DESCR STD_AXIS iAdaGlast.pm_gls UMR_BAR__1_100_0_S5_S3 8 -2.55 2.55 DEPOSIT ABSOLUTE /end AXIS_DESCR
 /begin AXIS_DESCR STD_AXIS iAdaGlast.n_tsyn_gls UMR_U_MIN_1_1_0_S5_S3 4 0 8200 DEPOSIT ABSOLUTE /end AXIS_DESCR
/end CHARACTERISTIC
/begin CHARACTERISTIC KF_PGLSADNTSPORT63 "Ada-Wert abh. mittl. Regeleingr. und n_t 21 Sp." MAP 0x198F98 ZF_kf_si16_S5_S3 2.5 UMR_BAR__1_100_0_S5_S3 -1.25 1.25
 /begin AXIS_DESCR STD_AXIS iAdaGlast.pm_gls UMR_BAR__1_100_0_S5_S3 8 -2.55 2.55 DEPOSIT ABSOLUTE /end AXIS_DESCR
 /begin AXIS_DESCR STD_AXIS iAdaGlast.n_tsyn_gls UMR_U_MIN_1_1_0_S5_S3 4 0 8200 DEPOSIT ABSOLUTE /end AXIS_DESCR
/end CHARACTERISTIC
/begin CHARACTERISTIC KF_PGLSADNTSPORT64 "Ada-Wert abh. mittl. Regeleingr. und n_t 21 Sp." MAP 0x198FF8 ZF_kf_si16_S5_S3 2.5 UMR_BAR__1_100_0_S5_S3 -1.25 1.25
 /begin AXIS_DESCR STD_AXIS iAdaGlast.pm_gls UMR_BAR__1_100_0_S5_S3 8 -2.55 2.55 DEPOSIT ABSOLUTE /end AXIS_DESCR
 /begin AXIS_DESCR STD_AXIS iAdaGlast.n_tsyn_gls UMR_U_MIN_1_1_0_S5_S3 4 0 8200 DEPOSIT ABSOLUTE /end AXIS_DESCR
/end CHARACTERISTIC
/begin CHARACTERISTIC KF_PGLSADNTSPORT71 "Ada-Wert abh. mittl. Regeleingr. und n_t 21 Sp." MAP 0x199058 ZF_kf_si16_S5_S3 2.5 UMR_BAR__1_100_0_S5_S3 -1.25 1.25
 /begin AXIS_DESCR STD_AXIS iAdaGlast.pm_gls UMR_BAR__1_100_0_S5_S3 8 -2.55 2.55 DEPOSIT ABSOLUTE /end AXIS_DESCR
 /begin AXIS_DESCR STD_AXIS iAdaGlast.n_tsyn_gls UMR_U_MIN_1_1_0_S5_S3 4 0 8200 DEPOSIT ABSOLUTE /end AXIS_DESCR
/end CHARACTERISTIC
/begin CHARACTERISTIC KF_PGLSADNTSPORT75 "Ada-Wert abh. mittl. Regeleingr. und n_t 21 Sp." MAP 0x1990B8 ZF_kf_si16_S5_S3 2.5 UMR_BAR__1_100_0_S5_S3 -1.25 1.25
 /begin AXIS_DESCR STD_AXIS iAdaGlast.pm_gls UMR_BAR__1_100_0_S5_S3 8 -2.55 2.55 DEPOSIT ABSOLUTE /end AXIS_DESCR
 /begin AXIS_DESCR STD_AXIS iAdaGlast.n_tsyn_gls UMR_U_MIN_1_1_0_S5_S3 4 0 8200 DEPOSIT ABSOLUTE /end AXIS_DESCR
/end CHARACTERISTIC
/begin CHARACTERISTIC KF_PGLSADNTSPORT82 "Ada-Wert abh. mittl. Regeleingr. und n_t 21 Sp." MAP 0x199118 ZF_kf_si16_S5_S3 2.5 UMR_BAR__1_100_0_S5_S3 -1.25 1.25
 /begin AXIS_DESCR STD_AXIS iAdaGlast.pm_gls UMR_BAR__1_100_0_S5_S3 8 -2.55 2.55 DEPOSIT ABSOLUTE /end AXIS_DESCR
 /begin AXIS_DESCR STD_AXIS iAdaGlast.n_tsyn_gls UMR_U_MIN_1_1_0_S5_S3 4 0 8200 DEPOSIT ABSOLUTE /end AXIS_DESCR
/end CHARACTERISTIC
/begin CHARACTERISTIC KF_PGLSADNTSPORT84 "Ada-Wert abh. mittl. Regeleingr. und n_t 21 Sp." MAP 0x199178 ZF_kf_si16_S5_S3 2.5 UMR_BAR__1_100_0_S5_S3 -1.25 1.25
 /begin AXIS_DESCR STD_AXIS iAdaGlast.pm_gls UMR_BAR__1_100_0_S5_S3 8 -2.55 2.55 DEPOSIT ABSOLUTE /end AXIS_DESCR
 /begin AXIS_DESCR STD_AXIS iAdaGlast.n_tsyn_gls UMR_U_MIN_1_1_0_S5_S3 4 0 8200 DEPOSIT ABSOLUTE /end AXIS_DESCR
/end CHARACTERISTIC
/begin CHARACTERISTIC KF_PGLSADNTSPORT86 "Ada-Wert abh. mittl. Regeleingr. und n_t 21 Sp." MAP 0x1991D8 ZF_kf_si16_S5_S3 2.5 UMR_BAR__1_100_0_S5_S3 -1.25 1.25
 /begin AXIS_DESCR STD_AXIS iAdaGlast.pm_gls UMR_BAR__1_100_0_S5_S3 8 -2.55 2.55 DEPOSIT ABSOLUTE /end AXIS_DESCR
 /begin AXIS_DESCR STD_AXIS iAdaGlast.n_tsyn_gls UMR_U_MIN_1_1_0_S5_S3 4 0 8200 DEPOSIT ABSOLUTE /end AXIS_DESCR
/end CHARACTERISTIC
/begin CHARACTERISTIC KL_ADAKORPF "Beeinflussungsfaktor der KUP-Adaptionen" CURVE 0x199308 ZF_kl_ui16_S5_S3 655.35 UMR___1_100_0_S5_S3 0 655.35
 /begin AXIS_DESCR STD_AXIS NO_INPUT_QUANTITY UMR___1_1_0_S5_S3 4 0 65535 DEPOSIT ABSOLUTE /end AXIS_DESCR
/end CHARACTERISTIC
/begin CHARACTERISTIC KL_BEIFL_BEWZ_APERK_IAE "Gewichtungsanteil Kup-Ada durch ADA IaeAP" CURVE 0x199514 ZF_kl_ui16_S5_S3 1 UMR___1_100_0_S5_S3 0 1
 /begin AXIS_DESCR STD_AXIS NO_INPUT_QUANTITY UMR___1_1_0_S5_S3 4 0 65535 DEPOSIT ABSOLUTE /end AXIS_DESCR
/end CHARACTERISTIC
/begin CHARACTERISTIC KL_BEIFL_KBPZ_APERK_IAE "Gewichtungsanteil Kup-Ada durch Kup Bef Pruef CTR" CURVE 0x199500 ZF_kl_ui16_S5_S3 1 UMR___1_100_0_S5_S3 0 1
 /begin AXIS_DESCR STD_AXIS NO_INPUT_QUANTITY UMR___1_1_0_S5_S3 4 0 65535 DEPOSIT ABSOLUTE /end AXIS_DESCR
/end CHARACTERISTIC
/begin CHARACTERISTIC KL_CGETR_MIN_APADA_IAE "untere Temp-Schwelle in Abh. von Anzahl Bewertungen" CURVE 0x199528 ZF_kl_ui16_S5_S3 140 UMR_GRADC__1_1_M40_S5_S3 -40 100
 /begin AXIS_DESCR STD_AXIS NO_INPUT_QUANTITY UMR___1_1_0_S5_S3 4 0 65535 DEPOSIT ABSOLUTE /end AXIS_DESCR
/end CHARACTERISTIC
/begin CHARACTERISTIC KL_CSPFADHSUN "Untere Grenztemperatur fuer Adaption HS" CURVE 0x199570 ZF_kl_ui16_S5_S3 190 UMR_GRADC__1_1_M40_S5_S3 -40 150
 /begin AXIS_DESCR STD_AXIS NO_INPUT_QUANTITY UMR___1_1_0_S5_S3 3 0 65535 DEPOSIT ABSOLUTE /end AXIS_DESCR
/end CHARACTERISTIC
/begin CHARACTERISTIC KL_CTRSTART_APERK_IAE "Zaehlerschwelle zur Aktivierung der Ada" CURVE 0x1994EC ZF_kl_ui16_S5_S3 10000 UMR___1_1_0_S5_S3 0 10000
 /begin AXIS_DESCR STD_AXIS NO_INPUT_QUANTITY UMR___1_1_0_S5_S3 4 0 65535 DEPOSIT ABSOLUTE /end AXIS_DESCR
/end CHARACTERISTIC
/begin CHARACTERISTIC KL_DKISPFADMTHS "Grenzwert Lastaenderung fuer PF-Adaption" CURVE 0x1995C8 ZF_kl_si16_S5_S3 100 UMR_PROZENT__20_51_0_S5_S3 0 100
 /begin AXIS_DESCR STD_AXIS zff_atsys._.iSignale._.obj.sig_m_t UMR_NM__1_1_0_S5_S3 3 -200 1300 DEPOSIT ABSOLUTE /end AXIS_DESCR
/end CHARACTERISTIC
/begin CHARACTERISTIC KL_FD_APADA_IAE "Daempfungsfaktor Abh. von Anzahl Bewertungen" CURVE 0x1994D4 ZF_kl_ui16_S5_S3 1 UMR___1_100_0_S5_S3 0 1
 /begin AXIS_DESCR STD_AXIS NO_INPUT_QUANTITY UMR___1_1_0_S5_S3 5 0 65535 DEPOSIT ABSOLUTE /end AXIS_DESCR
/end CHARACTERISTIC
/begin CHARACTERISTIC KL_FIADAAKT_NPRUEFZYKL_NEG_STADA "Filteranzahl f.Gewichtung des alten ADA-Werts bei neg. Abweichung" CURVE 0x19A014 ZF_kl_ui8_S5_S3 10 UMR___1_1_0_S5_S3 0 10
 /begin AXIS_DESCR STD_AXIS NO_INPUT_QUANTITY UMR___1_1_0_S5_S3 3 0 255 DEPOSIT ABSOLUTE /end AXIS_DESCR
/end CHARACTERISTIC
/begin CHARACTERISTIC KL_FIADAAKT_NPRUEFZYKL_POS_STADA "Filteranzahl f.Gewichtung des alten ADA-Werts bei pos. Abweichung" CURVE 0x19A008 ZF_kl_ui8_S5_S3 10 UMR___1_1_0_S5_S3 0 10
 /begin AXIS_DESCR STD_AXIS NO_INPUT_QUANTITY UMR___1_1_0_S5_S3 3 0 255 DEPOSIT ABSOLUTE /end AXIS_DESCR
/end CHARACTERISTIC
/begin CHARACTERISTIC KL_FPFADLZ "Gewichtungsfaktor des Adaptionswertes" CURVE 0x199580 ZF_kl_ui16_S5_S3 1 UMR___1_100_0_S5_S3 0 1
 /begin AXIS_DESCR STD_AXIS NO_INPUT_QUANTITY UMR___1_1_0_S5_S3 5 0 65535 DEPOSIT ABSOLUTE /end AXIS_DESCR
/end CHARACTERISTIC
/begin CHARACTERISTIC KL_FSDADLZ "Daempfungsfaktor Abh. von Anzahl Schaltungen" CURVE 0x1982A8 ZF_kl_ui16_S5_S3 1 UMR___1_100_0_S5_S3 0 1
 /begin AXIS_DESCR STD_AXIS NO_INPUT_QUANTITY UMR___1_1_0_S5_S3 5 0 65535 DEPOSIT ABSOLUTE /end AXIS_DESCR
/end CHARACTERISTIC
/begin CHARACTERISTIC KL_MTPFADHSOB12 "Obere schaltungsabhaengige Momentenschwelle bei xy-Schaltung" CURVE 0x1996D8 ZF_kl_si16_S5_S3 1500 UMR_NM__1_1_0_S5_S3 -200 1300
 /begin AXIS_DESCR STD_AXIS NO_INPUT_QUANTITY UMR___1_1_0_S5_S3 3 0 32767 DEPOSIT ABSOLUTE /end AXIS_DESCR
/end CHARACTERISTIC
/begin CHARACTERISTIC KL_MTPFADHSOB23 "Obere schaltungsabhaengige Momentenschwelle bei xy-Schaltung" CURVE 0x19979C ZF_kl_si16_S5_S3 1500 UMR_NM__1_1_0_S5_S3 -200 1300
 /begin AXIS_DESCR STD_AXIS NO_INPUT_QUANTITY UMR___1_1_0_S5_S3 3 0 32767 DEPOSIT ABSOLUTE /end AXIS_DESCR
/end CHARACTERISTIC
/begin CHARACTERISTIC KL_MTPFADHSOB34 "Obere schaltungsabhaengige Momentenschwelle bei xy-Schaltung" CURVE 0x199860 ZF_kl_si16_S5_S3 1500 UMR_NM__1_1_0_S5_S3 -200 1300
 /begin AXIS_DESCR STD_AXIS NO_INPUT_QUANTITY UMR___1_1_0_S5_S3 3 0 32767 DEPOSIT ABSOLUTE /end AXIS_DESCR
/end CHARACTERISTIC
/begin CHARACTERISTIC KL_MTPFADHSOB45 "Obere schaltungsabhaengige Momentenschwelle bei xy-Schaltung" CURVE 0x199924 ZF_kl_si16_S5_S3 1500 UMR_NM__1_1_0_S5_S3 -200 1300
 /begin AXIS_DESCR STD_AXIS NO_INPUT_QUANTITY UMR___1_1_0_S5_S3 3 0 32767 DEPOSIT ABSOLUTE /end AXIS_DESCR
/end CHARACTERISTIC
/begin CHARACTERISTIC KL_MTPFADHSOB56 "Obere schaltungsabhaengige Momentenschwelle bei xy-Schaltung" CURVE 0x1999E8 ZF_kl_si16_S5_S3 1500 UMR_NM__1_1_0_S5_S3 -200 1300
 /begin AXIS_DESCR STD_AXIS NO_INPUT_QUANTITY UMR___1_1_0_S5_S3 3 0 32767 DEPOSIT ABSOLUTE /end AXIS_DESCR
/end CHARACTERISTIC
/begin CHARACTERISTIC KL_MTPFADHSOB67 "Obere schaltungsabhaengige Momentenschwelle bei xy-Schaltung" CURVE 0x199AAC ZF_kl_si16_S5_S3 1500 UMR_NM__1_1_0_S5_S3 -200 1300
 /begin AXIS_DESCR STD_AXIS NO_INPUT_QUANTITY UMR___1_1_0_S5_S3 3 0 32767 DEPOSIT ABSOLUTE /end AXIS_DESCR
/end CHARACTERISTIC
/begin CHARACTERISTIC KL_MTPFADHSOB78 "Obere schaltungsabhaengige Momentenschwelle bei xy-Schaltung" CURVE 0x199B70 ZF_kl_si16_S5_S3 1500 UMR_NM__1_1_0_S5_S3 -200 1300
 /begin AXIS_DESCR STD_AXIS NO_INPUT_QUANTITY UMR___1_1_0_S5_S3 3 0 32767 DEPOSIT ABSOLUTE /end AXIS_DESCR
/end CHARACTERISTIC
/begin CHARACTERISTIC KL_MTPFADHSUN12 "Untere schaltungsabhaengige Momentenschwelle bei xy-Schaltung" CURVE 0x1996E8 ZF_kl_si16_S5_S3 1500 UMR_NM__1_1_0_S5_S3 -200 1300
 /begin AXIS_DESCR STD_AXIS NO_INPUT_QUANTITY UMR___1_1_0_S5_S3 3 0 32767 DEPOSIT ABSOLUTE /end AXIS_DESCR
/end CHARACTERISTIC
/begin CHARACTERISTIC KL_MTPFADHSUN23 "Untere schaltungsabhaengige Momentenschwelle bei xy-Schaltung" CURVE 0x1997AC ZF_kl_si16_S5_S3 1500 UMR_NM__1_1_0_S5_S3 -200 1300
 /begin AXIS_DESCR STD_AXIS NO_INPUT_QUANTITY UMR___1_1_0_S5_S3 3 0 32767 DEPOSIT ABSOLUTE /end AXIS_DESCR
/end CHARACTERISTIC
/begin CHARACTERISTIC KL_MTPFADHSUN34 "Untere schaltungsabhaengige Momentenschwelle bei xy-Schaltung" CURVE 0x199870 ZF_kl_si16_S5_S3 1500 UMR_NM__1_1_0_S5_S3 -200 1300
 /begin AXIS_DESCR STD_AXIS NO_INPUT_QUANTITY UMR___1_1_0_S5_S3 3 0 32767 DEPOSIT ABSOLUTE /end AXIS_DESCR
/end CHARACTERISTIC
/begin CHARACTERISTIC KL_MTPFADHSUN45 "Untere schaltungsabhaengige Momentenschwelle bei xy-Schaltung" CURVE 0x199934 ZF_kl_si16_S5_S3 1500 UMR_NM__1_1_0_S5_S3 -200 1300
 /begin AXIS_DESCR STD_AXIS NO_INPUT_QUANTITY UMR___1_1_0_S5_S3 3 0 32767 DEPOSIT ABSOLUTE /end AXIS_DESCR
/end CHARACTERISTIC
/begin CHARACTERISTIC KL_MTPFADHSUN56 "Untere schaltungsabhaengige Momentenschwelle bei xy-Schaltung" CURVE 0x1999F8 ZF_kl_si16_S5_S3 1500 UMR_NM__1_1_0_S5_S3 -200 1300
 /begin AXIS_DESCR STD_AXIS NO_INPUT_QUANTITY UMR___1_1_0_S5_S3 3 0 32767 DEPOSIT ABSOLUTE /end AXIS_DESCR
/end CHARACTERISTIC
/begin CHARACTERISTIC KL_MTPFADHSUN67 "Untere schaltungsabhaengige Momentenschwelle bei xy-Schaltung" CURVE 0x199ABC ZF_kl_si16_S5_S3 1500 UMR_NM__1_1_0_S5_S3 -200 1300
 /begin AXIS_DESCR STD_AXIS NO_INPUT_QUANTITY UMR___1_1_0_S5_S3 3 0 32767 DEPOSIT ABSOLUTE /end AXIS_DESCR
/end CHARACTERISTIC
/begin CHARACTERISTIC KL_MTPFADHSUN78 "Untere schaltungsabhaengige Momentenschwelle bei xy-Schaltung" CURVE 0x199B80 ZF_kl_si16_S5_S3 1500 UMR_NM__1_1_0_S5_S3 -200 1300
 /begin AXIS_DESCR STD_AXIS NO_INPUT_QUANTITY UMR___1_1_0_S5_S3 3 0 32767 DEPOSIT ABSOLUTE /end AXIS_DESCR
/end CHARACTERISTIC
/begin CHARACTERISTIC KL_NGSABPFADMTHSOB "Obere Abtriebsdrehzahlgradientenschwelle Fuelldruckadaption HS" CURVE 0x1995E8 ZF_kl_si16_S5_S3 10000 UMR_U_MINSEC_1_1_0_S5_S3 -5000 5000
 /begin AXIS_DESCR STD_AXIS zff_atsys._.iSignale._.obj.sig_m_t UMR_NM__1_1_0_S5_S3 3 -200 1300 DEPOSIT ABSOLUTE /end AXIS_DESCR
/end CHARACTERISTIC
/begin CHARACTERISTIC KL_NGSABPFADMTHSUN "Untere Abtriebsdrehzahlgradientenschwelle Fuelldruckadaption HS" CURVE 0x1995D8 ZF_kl_si16_S5_S3 10000 UMR_U_MINSEC_1_1_0_S5_S3 -5000 5000
 /begin AXIS_DESCR STD_AXIS zff_atsys._.iSignale._.obj.sig_m_t UMR_NM__1_1_0_S5_S3 3 -200 1300 DEPOSIT ABSOLUTE /end AXIS_DESCR
/end CHARACTERISTIC
/begin CHARACTERISTIC KL_NTPFADHSOB12 "Obere schaltungsabhaengige Drehzahlschwelle bei xy-Schaltung" CURVE 0x1996F8 ZF_kl_ui16_S5_S3 8200 UMR_U_MIN_1_1_0_S5_S3 0 8200
 /begin AXIS_DESCR STD_AXIS NO_INPUT_QUANTITY UMR___1_1_0_S5_S3 3 0 65535 DEPOSIT ABSOLUTE /end AXIS_DESCR
/end CHARACTERISTIC
/begin CHARACTERISTIC KL_NTPFADHSOB23 "Obere schaltungsabhaengige Drehzahlschwelle bei xy-Schaltung" CURVE 0x1997BC ZF_kl_ui16_S5_S3 8200 UMR_U_MIN_1_1_0_S5_S3 0 8200
 /begin AXIS_DESCR STD_AXIS NO_INPUT_QUANTITY UMR___1_1_0_S5_S3 3 0 65535 DEPOSIT ABSOLUTE /end AXIS_DESCR
/end CHARACTERISTIC
/begin CHARACTERISTIC KL_NTPFADHSOB34 "Obere schaltungsabhaengige Drehzahlschwelle bei xy-Schaltung" CURVE 0x199880 ZF_kl_ui16_S5_S3 8200 UMR_U_MIN_1_1_0_S5_S3 0 8200
 /begin AXIS_DESCR STD_AXIS NO_INPUT_QUANTITY UMR___1_1_0_S5_S3 3 0 65535 DEPOSIT ABSOLUTE /end AXIS_DESCR
/end CHARACTERISTIC
/begin CHARACTERISTIC KL_NTPFADHSOB45 "Obere schaltungsabhaengige Drehzahlschwelle bei xy-Schaltung" CURVE 0x199944 ZF_kl_ui16_S5_S3 8200 UMR_U_MIN_1_1_0_S5_S3 0 8200
 /begin AXIS_DESCR STD_AXIS NO_INPUT_QUANTITY UMR___1_1_0_S5_S3 3 0 65535 DEPOSIT ABSOLUTE /end AXIS_DESCR
/end CHARACTERISTIC
/begin CHARACTERISTIC KL_NTPFADHSOB56 "Obere schaltungsabhaengige Drehzahlschwelle bei xy-Schaltung" CURVE 0x199A08 ZF_kl_ui16_S5_S3 8200 UMR_U_MIN_1_1_0_S5_S3 0 8200
 /begin AXIS_DESCR STD_AXIS NO_INPUT_QUANTITY UMR___1_1_0_S5_S3 3 0 65535 DEPOSIT ABSOLUTE /end AXIS_DESCR
/end CHARACTERISTIC
/begin CHARACTERISTIC KL_NTPFADHSOB67 "Obere schaltungsabhaengige Drehzahlschwelle bei xy-Schaltung" CURVE 0x199ACC ZF_kl_ui16_S5_S3 8200 UMR_U_MIN_1_1_0_S5_S3 0 8200
 /begin AXIS_DESCR STD_AXIS NO_INPUT_QUANTITY UMR___1_1_0_S5_S3 3 0 65535 DEPOSIT ABSOLUTE /end AXIS_DESCR
/end CHARACTERISTIC
/begin CHARACTERISTIC KL_NTPFADHSOB78 "Obere schaltungsabhaengige Drehzahlschwelle bei xy-Schaltung" CURVE 0x199B90 ZF_kl_ui16_S5_S3 8200 UMR_U_MIN_1_1_0_S5_S3 0 8200
 /begin AXIS_DESCR STD_AXIS NO_INPUT_QUANTITY UMR___1_1_0_S5_S3 3 0 65535 DEPOSIT ABSOLUTE /end AXIS_DESCR
/end CHARACTERISTIC
/begin CHARACTERISTIC KL_NTPFADHSUN12 "Untere schaltungsabhaengige Drehzahlschwelle bei xy-Schaltung" CURVE 0x199708 ZF_kl_ui16_S5_S3 8200 UMR_U_MIN_1_1_0_S5_S3 0 8200
 /begin AXIS_DESCR STD_AXIS NO_INPUT_QUANTITY UMR___1_1_0_S5_S3 3 0 65535 DEPOSIT ABSOLUTE /end AXIS_DESCR
/end CHARACTERISTIC
/begin CHARACTERISTIC KL_NTPFADHSUN23 "Untere schaltungsabhaengige Drehzahlschwelle bei xy-Schaltung" CURVE 0x1997CC ZF_kl_ui16_S5_S3 8200 UMR_U_MIN_1_1_0_S5_S3 0 8200
 /begin AXIS_DESCR STD_AXIS NO_INPUT_QUANTITY UMR___1_1_0_S5_S3 3 0 65535 DEPOSIT ABSOLUTE /end AXIS_DESCR
/end CHARACTERISTIC
/begin CHARACTERISTIC KL_NTPFADHSUN34 "Untere schaltungsabhaengige Drehzahlschwelle bei xy-Schaltung" CURVE 0x199890 ZF_kl_ui16_S5_S3 8200 UMR_U_MIN_1_1_0_S5_S3 0 8200
 /begin AXIS_DESCR STD_AXIS NO_INPUT_QUANTITY UMR___1_1_0_S5_S3 3 0 65535 DEPOSIT ABSOLUTE /end AXIS_DESCR
/end CHARACTERISTIC
/begin CHARACTERISTIC KL_NTPFADHSUN45 "Untere schaltungsabhaengige Drehzahlschwelle bei xy-Schaltung" CURVE 0x199954 ZF_kl_ui16_S5_S3 8200 UMR_U_MIN_1_1_0_S5_S3 0 8200
 /begin AXIS_DESCR STD_AXIS NO_INPUT_QUANTITY UMR___1_1_0_S5_S3 3 0 65535 DEPOSIT ABSOLUTE /end AXIS_DESCR
/end CHARACTERISTIC
/begin CHARACTERISTIC KL_NTPFADHSUN56 "Untere schaltungsabhaengige Drehzahlschwelle bei xy-Schaltung" CURVE 0x199A18 ZF_kl_ui16_S5_S3 8200 UMR_U_MIN_1_1_0_S5_S3 0 8200
 /begin AXIS_DESCR STD_AXIS NO_INPUT_QUANTITY UMR___1_1_0_S5_S3 3 0 65535 DEPOSIT ABSOLUTE /end AXIS_DESCR
/end CHARACTERISTIC
/begin CHARACTERISTIC KL_NTPFADHSUN67 "Untere schaltungsabhaengige Drehzahlschwelle bei xy-Schaltung" CURVE 0x199ADC ZF_kl_ui16_S5_S3 8200 UMR_U_MIN_1_1_0_S5_S3 0 8200
 /begin AXIS_DESCR STD_AXIS NO_INPUT_QUANTITY UMR___1_1_0_S5_S3 3 0 65535 DEPOSIT ABSOLUTE /end AXIS_DESCR
/end CHARACTERISTIC
/begin CHARACTERISTIC KL_NTPFADHSUN78 "Untere schaltungsabhaengige Drehzahlschwelle bei xy-Schaltung" CURVE 0x199BA0 ZF_kl_ui16_S5_S3 8200 UMR_U_MIN_1_1_0_S5_S3 0 8200
 /begin AXIS_DESCR STD_AXIS NO_INPUT_QUANTITY UMR___1_1_0_S5_S3 3 0 65535 DEPOSIT ABSOLUTE /end AXIS_DESCR
/end CHARACTERISTIC
/begin CHARACTERISTIC KL_PFADTSYN21 "Schaltungsabhaengige Sollschleifzeit PF Ada" CURVE 0x199BB0 ZF_kl_ui16_S5_S3 2550 UMR_MSEC__10_1_0_S5_S3 0 2550
 /begin AXIS_DESCR STD_AXIS zff_atsys._.iSignale._.obj.sig_n_t UMR_U_MIN_1_1_0_S5_S3 2 0 8200 DEPOSIT ABSOLUTE /end AXIS_DESCR
/end CHARACTERISTIC
/begin CHARACTERISTIC KL_PFADTSYN32 "Schaltungsabhaengige Sollschleifzeit PF Ada" CURVE 0x199C1C ZF_kl_ui16_S5_S3 2550 UMR_MSEC__10_1_0_S5_S3 0 2550
 /begin AXIS_DESCR STD_AXIS zff_atsys._.iSignale._.obj.sig_n_t UMR_U_MIN_1_1_0_S5_S3 2 0 8200 DEPOSIT ABSOLUTE /end AXIS_DESCR
/end CHARACTERISTIC
/begin CHARACTERISTIC KL_PFADTSYN43 "Schaltungsabhaengige Sollschleifzeit PF Ada" CURVE 0x199C88 ZF_kl_ui16_S5_S3 2550 UMR_MSEC__10_1_0_S5_S3 0 2550
 /begin AXIS_DESCR STD_AXIS zff_atsys._.iSignale._.obj.sig_n_t UMR_U_MIN_1_1_0_S5_S3 2 0 8200 DEPOSIT ABSOLUTE /end AXIS_DESCR
/end CHARACTERISTIC
/begin CHARACTERISTIC KL_PFADTSYN54 "Schaltungsabhaengige Sollschleifzeit PF Ada" CURVE 0x199CF4 ZF_kl_ui16_S5_S3 2550 UMR_MSEC__10_1_0_S5_S3 0 2550
 /begin AXIS_DESCR STD_AXIS zff_atsys._.iSignale._.obj.sig_n_t UMR_U_MIN_1_1_0_S5_S3 2 0 8200 DEPOSIT ABSOLUTE /end AXIS_DESCR
/end CHARACTERISTIC
/begin CHARACTERISTIC KL_PFADTSYN65 "Schaltungsabhaengige Sollschleifzeit PF Ada" CURVE 0x199D60 ZF_kl_ui16_S5_S3 2550 UMR_MSEC__10_1_0_S5_S3 0 2550
 /begin AXIS_DESCR STD_AXIS zff_atsys._.iSignale._.obj.sig_n_t UMR_U_MIN_1_1_0_S5_S3 2 0 8200 DEPOSIT ABSOLUTE /end AXIS_DESCR
/end CHARACTERISTIC
/begin CHARACTERISTIC KL_PFADTSYN76 "Schaltungsabhaengige Sollschleifzeit PF Ada" CURVE 0x199DCC ZF_kl_ui16_S5_S3 2550 UMR_MSEC__10_1_0_S5_S3 0 2550
 /begin AXIS_DESCR STD_AXIS zff_atsys._.iSignale._.obj.sig_n_t UMR_U_MIN_1_1_0_S5_S3 2 0 8200 DEPOSIT ABSOLUTE /end AXIS_DESCR
/end CHARACTERISTIC
/begin CHARACTERISTIC KL_PFADTSYN87 "Schaltungsabhaengige Sollschleifzeit PF Ada" CURVE 0x199E38 ZF_kl_ui16_S5_S3 2550 UMR_MSEC__10_1_0_S5_S3 0 2550
 /begin AXIS_DESCR STD_AXIS zff_atsys._.iSignale._.obj.sig_n_t UMR_U_MIN_1_1_0_S5_S3 2 0 8200 DEPOSIT ABSOLUTE /end AXIS_DESCR
/end CHARACTERISTIC
/begin CHARACTERISTIC KL_PF_MAXADAWERTDELTA "Maximal zulässige Änderung des Adaptionswertes" CURVE 0x199284 ZF_kl_si16_S5_S3 1 UMR_BAR__1_1000_0_S5_S3 0 1
 /begin AXIS_DESCR STD_AXIS NO_INPUT_QUANTITY UMR___1_1_0_S5_S3 3 0 255 DEPOSIT ABSOLUTE /end AXIS_DESCR
/end CHARACTERISTIC
/begin CHARACTERISTIC KL_PF_MAXADAWERTDELTA_STADA "Maximal zulässige Änderung des Adaptionswertes" CURVE 0x199F74 ZF_kl_si16_S5_S3 1 UMR_BAR__1_1000_0_S5_S3 0 1
 /begin AXIS_DESCR STD_AXIS NO_INPUT_QUANTITY UMR___1_1_0_S5_S3 3 0 255 DEPOSIT ABSOLUTE /end AXIS_DESCR
/end CHARACTERISTIC
/begin CHARACTERISTIC KL_PGLSAD12 "Adaptionswert in Abh. des mittl. Regeleingr. 12 Sp." CURVE 0x1982C0 ZF_kl_si16_S5_S3 2.5 UMR_BAR__1_100_0_S5_S3 -1.25 1.25
 /begin AXIS_DESCR STD_AXIS iAdaGlast.pm_gls UMR_BAR__1_100_0_S5_S3 8 -2.55 2.55 DEPOSIT ABSOLUTE /end AXIS_DESCR
/end CHARACTERISTIC
/begin CHARACTERISTIC KL_PGLSAD23 "Adaptionswert in Abh. des mittl. Regeleingr. 12 Sp." CURVE 0x1982E4 ZF_kl_si16_S5_S3 2.5 UMR_BAR__1_100_0_S5_S3 -1.25 1.25
 /begin AXIS_DESCR STD_AXIS iAdaGlast.pm_gls UMR_BAR__1_100_0_S5_S3 8 -2.55 2.55 DEPOSIT ABSOLUTE /end AXIS_DESCR
/end CHARACTERISTIC
/begin CHARACTERISTIC KL_PGLSAD34 "Adaptionswert in Abh. des mittl. Regeleingr. 12 Sp." CURVE 0x198308 ZF_kl_si16_S5_S3 2.5 UMR_BAR__1_100_0_S5_S3 -1.25 1.25
 /begin AXIS_DESCR STD_AXIS iAdaGlast.pm_gls UMR_BAR__1_100_0_S5_S3 8 -2.55 2.55 DEPOSIT ABSOLUTE /end AXIS_DESCR
/end CHARACTERISTIC
/begin CHARACTERISTIC KL_PGLSAD45 "Adaptionswert in Abh. des mittl. Regeleingr. 12 Sp." CURVE 0x19832C ZF_kl_si16_S5_S3 2.5 UMR_BAR__1_100_0_S5_S3 -1.25 1.25
 /begin AXIS_DESCR STD_AXIS iAdaGlast.pm_gls UMR_BAR__1_100_0_S5_S3 8 -2.55 2.55 DEPOSIT ABSOLUTE /end AXIS_DESCR
/end CHARACTERISTIC
/begin CHARACTERISTIC KL_PGLSAD56 "Adaptionswert in Abh. des mittl. Regeleingr. 12 Sp." CURVE 0x198350 ZF_kl_si16_S5_S3 2.5 UMR_BAR__1_100_0_S5_S3 -1.25 1.25
 /begin AXIS_DESCR STD_AXIS iAdaGlast.pm_gls UMR_BAR__1_100_0_S5_S3 8 -2.55 2.55 DEPOSIT ABSOLUTE /end AXIS_DESCR
/end CHARACTERISTIC
/begin CHARACTERISTIC KL_PGLSAD67 "Adaptionswert in Abh. des mittl. Regeleingr. 12 Sp." CURVE 0x198374 ZF_kl_si16_S5_S3 2.5 UMR_BAR__1_100_0_S5_S3 -1.25 1.25
 /begin AXIS_DESCR STD_AXIS iAdaGlast.pm_gls UMR_BAR__1_100_0_S5_S3 8 -2.55 2.55 DEPOSIT ABSOLUTE /end AXIS_DESCR
/end CHARACTERISTIC
/begin CHARACTERISTIC KL_PGLSAD78 "Adaptionswert in Abh. des mittl. Regeleingr. 12 Sp." CURVE 0x198398 ZF_kl_si16_S5_S3 2.5 UMR_BAR__1_100_0_S5_S3 -1.25 1.25
 /begin AXIS_DESCR STD_AXIS iAdaGlast.pm_gls UMR_BAR__1_100_0_S5_S3 8 -2.55 2.55 DEPOSIT ABSOLUTE /end AXIS_DESCR
/end CHARACTERISTIC
/begin CHARACTERISTIC KL_PGLSADSP12 "Adaptionswert in Abh. des mittl. Regeleingr. 12 Sp." CURVE 0x1983BC ZF_kl_si16_S5_S3 2.5 UMR_BAR__1_100_0_S5_S3 -1.25 1.25
 /begin AXIS_DESCR STD_AXIS iAdaGlast.pm_gls UMR_BAR__1_100_0_S5_S3 8 -2.55 2.55 DEPOSIT ABSOLUTE /end AXIS_DESCR
/end CHARACTERISTIC
/begin CHARACTERISTIC KL_PGLSADSP23 "Adaptionswert in Abh. des mittl. Regeleingr. 12 Sp." CURVE 0x1983E0 ZF_kl_si16_S5_S3 2.5 UMR_BAR__1_100_0_S5_S3 -1.25 1.25
 /begin AXIS_DESCR STD_AXIS iAdaGlast.pm_gls UMR_BAR__1_100_0_S5_S3 8 -2.55 2.55 DEPOSIT ABSOLUTE /end AXIS_DESCR
/end CHARACTERISTIC
/begin CHARACTERISTIC KL_PGLSADSP34 "Adaptionswert in Abh. des mittl. Regeleingr. 12 Sp." CURVE 0x198404 ZF_kl_si16_S5_S3 2.5 UMR_BAR__1_100_0_S5_S3 -1.25 1.25
 /begin AXIS_DESCR STD_AXIS iAdaGlast.pm_gls UMR_BAR__1_100_0_S5_S3 8 -2.55 2.55 DEPOSIT ABSOLUTE /end AXIS_DESCR
/end CHARACTERISTIC
/begin CHARACTERISTIC KL_PGLSADSP45 "Adaptionswert in Abh. des mittl. Regeleingr. 12 Sp." CURVE 0x198428 ZF_kl_si16_S5_S3 2.5 UMR_BAR__1_100_0_S5_S3 -1.25 1.25
 /begin AXIS_DESCR STD_AXIS iAdaGlast.pm_gls UMR_BAR__1_100_0_S5_S3 8 -2.55 2.55 DEPOSIT ABSOLUTE /end AXIS_DESCR
/end CHARACTERISTIC
/begin CHARACTERISTIC KL_PGLSADSP56 "Adaptionswert in Abh. des mittl. Regeleingr. 12 Sp." CURVE 0x19844C ZF_kl_si16_S5_S3 2.5 UMR_BAR__1_100_0_S5_S3 -1.25 1.25
 /begin AXIS_DESCR STD_AXIS iAdaGlast.pm_gls UMR_BAR__1_100_0_S5_S3 8 -2.55 2.55 DEPOSIT ABSOLUTE /end AXIS_DESCR
/end CHARACTERISTIC
/begin CHARACTERISTIC KL_PGLSADSP67 "Adaptionswert in Abh. des mittl. Regeleingr. 12 Sp." CURVE 0x198470 ZF_kl_si16_S5_S3 2.5 UMR_BAR__1_100_0_S5_S3 -1.25 1.25
 /begin AXIS_DESCR STD_AXIS iAdaGlast.pm_gls UMR_BAR__1_100_0_S5_S3 8 -2.55 2.55 DEPOSIT ABSOLUTE /end AXIS_DESCR
/end CHARACTERISTIC
/begin CHARACTERISTIC KL_PGLSADSP78 "Adaptionswert in Abh. des mittl. Regeleingr. 12 Sp." CURVE 0x198494 ZF_kl_si16_S5_S3 2.5 UMR_BAR__1_100_0_S5_S3 -1.25 1.25
 /begin AXIS_DESCR STD_AXIS iAdaGlast.pm_gls UMR_BAR__1_100_0_S5_S3 8 -2.55 2.55 DEPOSIT ABSOLUTE /end AXIS_DESCR
/end CHARACTERISTIC
/begin CHARACTERISTIC KL_PO_APERK_IAE "negativer Druck Offset fuer Ada-Wert Berechnung" CURVE 0x199474 ZF_kl_si16_S5_S3 1 UMR_BAR__1_1000_0_S5_S3 -1 0
 /begin AXIS_DESCR STD_AXIS zff_atsys._.iSignale._.obj.sig_c_getr UMR_GRADC__1_1_M40_S5_S3 8 -40 215 DEPOSIT ABSOLUTE /end AXIS_DESCR
/end CHARACTERISTIC
/begin CHARACTERISTIC KL_PO_RAMPENINIT_APERK_IAE "Druckoffset Rampenstartwert, relativ zu po_apada_eeprom" CURVE 0x199498 ZF_kl_si16_S5_S3 2 UMR_BAR__1_1000_0_S5_S3 -1 1
 /begin AXIS_DESCR STD_AXIS NO_INPUT_QUANTITY UMR_NM__1_1_0_S5_S3 4 -200 1300 DEPOSIT ABSOLUTE /end AXIS_DESCR
/end CHARACTERISTIC
/begin CHARACTERISTIC KL_PRUEFKAD_PULS_PF_A "Kennlinie zur Bestimmg d.Pruefintervalls der PF- Pulspruefung (x-Achse: kuppl.bez.Befuellpruefzaehler)" CURVE 0x199330 ZF_kl_ui16_S5_S3 9999 UMR___1_1_0_S5_S3 1 10000
 /begin AXIS_DESCR STD_AXIS NO_INPUT_QUANTITY UMR___1_1_0_S5_S3 4 0 255 DEPOSIT ABSOLUTE /end AXIS_DESCR
/end CHARACTERISTIC
/begin CHARACTERISTIC KL_PRUEFKAD_PULS_PF_B "Kennlinie zur Bestimmg d.Pruefintervalls der PF- Pulspruefung (x-Achse: kuppl.bez.Befuellpruefzaehler)" CURVE 0x199358 ZF_kl_ui16_S5_S3 9999 UMR___1_1_0_S5_S3 1 10000
 /begin AXIS_DESCR STD_AXIS NO_INPUT_QUANTITY UMR___1_1_0_S5_S3 4 0 255 DEPOSIT ABSOLUTE /end AXIS_DESCR
/end CHARACTERISTIC
/begin CHARACTERISTIC KL_PRUEFKAD_PULS_PF_C "Kennlinie zur Bestimmg d.Pruefintervalls der PF- Pulspruefung (x-Achse: kuppl.bez.Befuellpruefzaehler)" CURVE 0x199380 ZF_kl_ui16_S5_S3 9999 UMR___1_1_0_S5_S3 1 10000
 /begin AXIS_DESCR STD_AXIS NO_INPUT_QUANTITY UMR___1_1_0_S5_S3 4 0 255 DEPOSIT ABSOLUTE /end AXIS_DESCR
/end CHARACTERISTIC
/begin CHARACTERISTIC KL_PRUEFKAD_PULS_PF_D "Kennlinie zur Bestimmg d.Pruefintervalls der PF- Pulspruefung (x-Achse: kuppl.bez.Befuellpruefzaehler)" CURVE 0x1993A8 ZF_kl_ui16_S5_S3 9999 UMR___1_1_0_S5_S3 1 10000
 /begin AXIS_DESCR STD_AXIS NO_INPUT_QUANTITY UMR___1_1_0_S5_S3 4 0 255 DEPOSIT ABSOLUTE /end AXIS_DESCR
/end CHARACTERISTIC
/begin CHARACTERISTIC KL_PRUEFKAD_PULS_PF_E "Kennlinie zur Bestimmg d.Pruefintervalls der PF- Pulspruefung (x-Achse: kuppl.bez.Befuellpruefzaehler)" CURVE 0x1993D0 ZF_kl_ui16_S5_S3 9999 UMR___1_1_0_S5_S3 1 10000
 /begin AXIS_DESCR STD_AXIS NO_INPUT_QUANTITY UMR___1_1_0_S5_S3 4 0 255 DEPOSIT ABSOLUTE /end AXIS_DESCR
/end CHARACTERISTIC
/begin CHARACTERISTIC KL_PRUEFKAD_PULS_PF_K0 "Kennlinie zur Bestimmg d.Pruefintervalls der PF- Pulspruefung (x-Achse: kuppl.bez.Befuellpruefzaehler)" CURVE 0x1993F8 ZF_kl_ui16_S5_S3 9999 UMR___1_1_0_S5_S3 1 10000
 /begin AXIS_DESCR STD_AXIS NO_INPUT_QUANTITY UMR___1_1_0_S5_S3 4 0 255 DEPOSIT ABSOLUTE /end AXIS_DESCR
/end CHARACTERISTIC
/begin CHARACTERISTIC KL_PRUEFKAD_PULS_TSF_A "Kennlinie zur Bestimmg d.Pruefintervalls der SF- Pulspruefung (x-Achse: kuppl.bez.Befuellpruefzaehler)" CURVE 0x19931C ZF_kl_ui16_S5_S3 9999 UMR___1_1_0_S5_S3 1 10000
 /begin AXIS_DESCR STD_AXIS NO_INPUT_QUANTITY UMR___1_1_0_S5_S3 4 0 255 DEPOSIT ABSOLUTE /end AXIS_DESCR
/end CHARACTERISTIC
/begin CHARACTERISTIC KL_PRUEFKAD_PULS_TSF_B "Kennlinie zur Bestimmg d.Pruefintervalls der SF- Pulspruefung (x-Achse: kuppl.bez.Befuellpruefzaehler)" CURVE 0x199344 ZF_kl_ui16_S5_S3 9999 UMR___1_1_0_S5_S3 1 10000
 /begin AXIS_DESCR STD_AXIS NO_INPUT_QUANTITY UMR___1_1_0_S5_S3 4 0 255 DEPOSIT ABSOLUTE /end AXIS_DESCR
/end CHARACTERISTIC
/begin CHARACTERISTIC KL_PRUEFKAD_PULS_TSF_C "Kennlinie zur Bestimmg d.Pruefintervalls der SF- Pulspruefung (x-Achse: kuppl.bez.Befuellpruefzaehler)" CURVE 0x19936C ZF_kl_ui16_S5_S3 9999 UMR___1_1_0_S5_S3 1 10000
 /begin AXIS_DESCR STD_AXIS NO_INPUT_QUANTITY UMR___1_1_0_S5_S3 4 0 255 DEPOSIT ABSOLUTE /end AXIS_DESCR
/end CHARACTERISTIC
/begin CHARACTERISTIC KL_PRUEFKAD_PULS_TSF_D "Kennlinie zur Bestimmg d.Pruefintervalls der SF- Pulspruefung (x-Achse: kuppl.bez.Befuellpruefzaehler)" CURVE 0x199394 ZF_kl_ui16_S5_S3 9999 UMR___1_1_0_S5_S3 1 10000
 /begin AXIS_DESCR STD_AXIS NO_INPUT_QUANTITY UMR___1_1_0_S5_S3 4 0 255 DEPOSIT ABSOLUTE /end AXIS_DESCR
/end CHARACTERISTIC
/begin CHARACTERISTIC KL_PRUEFKAD_PULS_TSF_E "Kennlinie zur Bestimmg d.Pruefintervalls der SF- Pulspruefung (x-Achse: kuppl.bez.Befuellpruefzaehler)" CURVE 0x1993BC ZF_kl_ui16_S5_S3 9999 UMR___1_1_0_S5_S3 1 10000
 /begin AXIS_DESCR STD_AXIS NO_INPUT_QUANTITY UMR___1_1_0_S5_S3 4 0 255 DEPOSIT ABSOLUTE /end AXIS_DESCR
/end CHARACTERISTIC
/begin CHARACTERISTIC KL_PRUEFKAD_PULS_TSF_K0 "Kennlinie zur Bestimmg d.Pruefintervalls der SF- Pulspruefung (x-Achse: kuppl.bez.Befuellpruefzaehler)" CURVE 0x1993E4 ZF_kl_ui16_S5_S3 9999 UMR___1_1_0_S5_S3 1 10000
 /begin AXIS_DESCR STD_AXIS NO_INPUT_QUANTITY UMR___1_1_0_S5_S3 4 0 255 DEPOSIT ABSOLUTE /end AXIS_DESCR
/end CHARACTERISTIC
/begin CHARACTERISTIC KL_SBAKLZ_GLS "Uebersprechfaktor Abh. von Anzahl Schaltungen" CURVE 0x1981F0 ZF_kl_ui16_S5_S3 1 UMR___1_100_0_S5_S3 0 1
 /begin AXIS_DESCR STD_AXIS NO_INPUT_QUANTITY UMR___1_1_0_S5_S3 8 0 65535 DEPOSIT ABSOLUTE /end AXIS_DESCR
/end CHARACTERISTIC
/begin CHARACTERISTIC KL_TSF_MAXADAWERTDELTA "Maximal zulässige Änderung des Adaptionswertes" CURVE 0x1992D8 ZF_kl_si16_S5_S3 200 UMR_MSEC__1_1_0_S5_S3 0 200
 /begin AXIS_DESCR STD_AXIS NO_INPUT_QUANTITY UMR___1_1_0_S5_S3 3 0 255 DEPOSIT ABSOLUTE /end AXIS_DESCR
/end CHARACTERISTIC
/begin CHARACTERISTIC KL_TSF_MAXADAWERTDELTA_STADA "Maximal zulässige Änderung des Adaptionswertes" CURVE 0x199FB4 ZF_kl_si16_S5_S3 200 UMR_MSEC__1_1_0_S5_S3 0 200
 /begin AXIS_DESCR STD_AXIS NO_INPUT_QUANTITY UMR___1_1_0_S5_S3 3 0 255 DEPOSIT ABSOLUTE /end AXIS_DESCR
/end CHARACTERISTIC
/begin CHARACTERISTIC KL_UEF_ABSENK_APERK_IAE "Ueberfuehrung auf Startniveau der Ada-Rampe, relativ zu po_apada_eeprom" CURVE 0x1994AC ZF_kl_si16_S5_S3 1 UMR___1_100_0_S5_S3 0 1
 /begin AXIS_DESCR STD_AXIS NO_INPUT_QUANTITY UMR_MSEC__10_1_0_S5_S3 4 0 1000 DEPOSIT ABSOLUTE /end AXIS_DESCR
/end CHARACTERISTIC
/begin CHARACTERISTIC KL_UEF_ABSENK_START_APERK_IAE "Ueberfuehrung auf Absenk-Niveau" CURVE 0x1994C0 ZF_kl_si16_S5_S3 1 UMR___1_100_0_S5_S3 0 1
 /begin AXIS_DESCR STD_AXIS NO_INPUT_QUANTITY UMR_MSEC__10_1_0_S5_S3 4 0 1000 DEPOSIT ABSOLUTE /end AXIS_DESCR
/end CHARACTERISTIC
/begin CHARACTERISTIC MDS_MMOT_APERK_IAE "Momentenschwelle Erkennungskriterium" VALUE 0x1D815C ZF_kw_si16_S5_S3 20 UMR_NM__1_1_0_S5_S3 0 20 /end CHARACTERISTIC
/begin CHARACTERISTIC MDT_MGMOTIST_APERK_IAE "Filterzeitkonstante der Gradientenbildung Momentengradient mg_motist_intern" VALUE 0x1D76A4 ZF_kw_ui8_S5_S3 1 UMR___1_100_0_S5_S3 0 1 /end CHARACTERISTIC
/begin CHARACTERISTIC MDT_NGMOT_APERK_IAE "Filterzeitkonstante der Gradientenbildung Drehzahlgradient ng_mot_intern" VALUE 0x1D76A5 ZF_kw_ui8_S5_S3 1 UMR___1_100_0_S5_S3 0 1 /end CHARACTERISTIC
/begin CHARACTERISTIC MGS_ABS_MMOT_ABBRUCH_APERK_IAE "Betragsschwelle Momentengradient, Abbruchkriterium" VALUE 0x1D813E ZF_kw_si16_S5_S3 100 UMR_NM_SEC_1_1_0_S5_S3 0 100 /end CHARACTERISTIC
/begin CHARACTERISTIC MGS_ABS_MMOT_APERK_IAE "Betragsschwelle Momentengradient, Startbedingung" VALUE 0x1D813C ZF_kw_si16_S5_S3 100 UMR_NM_SEC_1_1_0_S5_S3 0 100 /end CHARACTERISTIC
/begin CHARACTERISTIC MG_MREF_APERK_IAE "Gradient zur Nachführung der Momentenreferenz" VALUE 0x1D815E ZF_kw_si16_S5_S3 100 UMR_NM_SEC_1_1_0_S5_S3 0 100 /end CHARACTERISTIC
/begin CHARACTERISTIC MIN_TPADA_UEFIAE "Mindestanzahl TP-Adaptionen" VALUE 0x1D76A8 ZF_kw_ui8_S5_S3 100 UMR___1_1_0_S5_S3 0 100 /end CHARACTERISTIC
/begin CHARACTERISTIC MO_STELL_ABBRUCH_APERK_IAE "Abbruch Differenz-Schwelle zu m_stell_start_ada_iae" VALUE 0x1D8144 ZF_kw_si16_S5_S3 1000 UMR_NM__1_1_0_S5_S3 0 1000 /end CHARACTERISTIC
/begin CHARACTERISTIC MPT_AXREF_ADAOFF "Filterkonstante fuer Laengs-Beschleunigung um Ada-Bew zu verbieten" VALUE 0x1D7694 ZF_kw_ui8_S5_S3 1 UMR___1_100_0_S5_S3 0 1 /end CHARACTERISTIC
/begin CHARACTERISTIC MPT_MMOTIST_APERK_IAE "Filterzeitkonstante m_motist der IAE-Ada" VALUE 0x1D76A3 ZF_kw_ui8_S5_S3 0.99 UMR___1_100_0_S5_S3 0.01 1 /end CHARACTERISTIC
/begin CHARACTERISTIC MPT_NMOT_APERK_IAE "Filterzeitkonstante n_mot der IAE-Ada" VALUE 0x1D76A2 ZF_kw_ui8_S5_S3 0.99 UMR___1_100_0_S5_S3 0.01 1 /end CHARACTERISTIC
/begin CHARACTERISTIC MS_LLPRUEF_APERK_IAE "Momentenschwelle Schleppmoment Motor-Pruefung (IAE-Ada)" VALUE 0x1D76A6 ZF_kw_si8_S5_S3 200 UMR_NM__1_1_0_S5_S3 -100 100 /end CHARACTERISTIC
/begin CHARACTERISTIC MS_MMOT_ABBRUCH_APERK_IAE "Momentenschwelle fuer max. zulaessiges Motor-Moment waehrend Prueframpe" VALUE 0x1D769D ZF_kw_ui8_S5_S3 100 UMR_NM__1_1_0_S5_S3 0 100 /end CHARACTERISTIC
/begin CHARACTERISTIC MS_MOT_ABSENK_APERK_IAE "Motoristmomentschwelle fuer Absenkrampe (IAE-Ada)" VALUE 0x1D76A7 ZF_kw_ui8_S5_S3 100 UMR_NM__1_1_0_S5_S3 0 100 /end CHARACTERISTIC
/begin CHARACTERISTIC MUE_KOR_MAX_UEFIAE "Max-Grenze für Adaptionsoffset" VALUE 0x1D76AA ZF_kw_si8_S5_S3 100 UMR_NM_BAR_1_1_0_S5_S3 0 100 /end CHARACTERISTIC
/begin CHARACTERISTIC MUE_KOR_MIN_UEFIAE "Min-Grenze für Adaptionsoffset" VALUE 0x1D76AB ZF_kw_si8_S5_S3 100 UMR_NM_BAR_1_1_0_S5_S3 -100 0 /end CHARACTERISTIC
/begin CHARACTERISTIC NDS_NMOTSOLL_LL_APERK_IAE "Max Abstand der Istdrehzahl zur Soll-LL Drehzahl" VALUE 0x1D813A ZF_kw_ui16_S5_S3 1000 UMR_U_MIN_1_1_0_S5_S3 0 1000 /end CHARACTERISTIC
/begin CHARACTERISTIC NDS_NMOT_APERK_IAE "Drehzahlschwelle Erkennungskriterium" VALUE 0x1D815A ZF_kw_si16_S5_S3 200 UMR_U_MIN_1_1_0_S5_S3 -100 100 /end CHARACTERISTIC
/begin CHARACTERISTIC ND_PFADHS "Differenzdrehzahl zu Synchron alter Gang zur Erkenng Drehzahleinzug" VALUE 0x1D8188 ZF_kw_ui16_S5_S3 8200 UMR_U_MIN_1_1_0_S5_S3 0 8200 /end CHARACTERISTIC
/begin CHARACTERISTIC ND_PFADRS21 "Schaltungsabhaengige Differenzdrehzahl zu Synchron alter Gang PF Ada" VALUE 0x1D8194 ZF_kw_ui16_S5_S3 8200 UMR_U_MIN_1_1_0_S5_S3 0 8200 /end CHARACTERISTIC
/begin CHARACTERISTIC ND_PFADRS32 "Schaltungsabhaengige Differenzdrehzahl zu Synchron alter Gang PF Ada" VALUE 0x1D8196 ZF_kw_ui16_S5_S3 8200 UMR_U_MIN_1_1_0_S5_S3 0 8200 /end CHARACTERISTIC
/begin CHARACTERISTIC ND_PFADRS43 "Schaltungsabhaengige Differenzdrehzahl zu Synchron alter Gang PF Ada" VALUE 0x1D8198 ZF_kw_ui16_S5_S3 8200 UMR_U_MIN_1_1_0_S5_S3 0 8200 /end CHARACTERISTIC
/begin CHARACTERISTIC ND_PFADRS54 "Schaltungsabhaengige Differenzdrehzahl zu Synchron alter Gang PF Ada" VALUE 0x1D819A ZF_kw_ui16_S5_S3 8200 UMR_U_MIN_1_1_0_S5_S3 0 8200 /end CHARACTERISTIC
/begin CHARACTERISTIC ND_PFADRS65 "Schaltungsabhaengige Differenzdrehzahl zu Synchron alter Gang PF Ada" VALUE 0x1D819C ZF_kw_ui16_S5_S3 8200 UMR_U_MIN_1_1_0_S5_S3 0 8200 /end CHARACTERISTIC
/begin CHARACTERISTIC ND_PFADRS76 "Schaltungsabhaengige Differenzdrehzahl zu Synchron alter Gang PF Ada" VALUE 0x1D819E ZF_kw_ui16_S5_S3 8200 UMR_U_MIN_1_1_0_S5_S3 0 8200 /end CHARACTERISTIC
/begin CHARACTERISTIC ND_PFADRS87 "Schaltungsabhaengige Differenzdrehzahl zu Synchron alter Gang PF Ada" VALUE 0x1D81A0 ZF_kw_ui16_S5_S3 8200 UMR_U_MIN_1_1_0_S5_S3 0 8200 /end CHARACTERISTIC
/begin CHARACTERISTIC ND_SYNISTGANG_KEINMTABBR "Diff-Drehzahl-Schwelle zur Deaktivierung m_t-Kriterium PFAD" VALUE 0x1D8192 ZF_kw_si16_S5_S3 8000 UMR_U_MIN_1_1_0_S5_S3 -8000 0 /end CHARACTERISTIC
/begin CHARACTERISTIC NGS_ABPFADRSOB "Obere Abtriebsdrehzahlgradientenschwelle Fuelldruckadaption RS" VALUE 0x1D818C ZF_kw_si16_S5_S3 10000 UMR_U_MINSEC_1_1_0_S5_S3 -5000 5000 /end CHARACTERISTIC
/begin CHARACTERISTIC NGS_ABPFADRSUN "Untere Abtriebsdrehzahlgradientenschwelle Fuelldruckadaption RS" VALUE 0x1D818A ZF_kw_si16_S5_S3 10000 UMR_U_MINSEC_1_1_0_S5_S3 -5000 5000 /end CHARACTERISTIC
/begin CHARACTERISTIC NGS_ABS_NMOT_ABBRUCH_APERK_IAE "Betragsschwelle Drehzahlgradient, Abbruchkriterium" VALUE 0x1D8142 ZF_kw_si16_S5_S3 500 UMR_U_MIN_1_1_0_S5_S3 0 500 /end CHARACTERISTIC
/begin CHARACTERISTIC NGS_ABS_NMOT_APERK_IAE "Betragsschwelle Drehzahlgradient, Startbedingung" VALUE 0x1D8140 ZF_kw_si16_S5_S3 500 UMR_U_MIN_1_1_0_S5_S3 0 500 /end CHARACTERISTIC
/begin CHARACTERISTIC NG_NREF_APERK_IAE "Gradient zur Nachführung der Drehzahlreferenz" VALUE 0x1D8160 ZF_kw_si16_S5_S3 100 UMR_U_MIN_1_1_0_S5_S3 -100 0 /end CHARACTERISTIC
/begin CHARACTERISTIC NS_AB_STADA "Abtriebsdrehzahlschwelle" VALUE 0x1D8210 ZF_kw_ui16_S5_S3 250 UMR_U_MIN_1_1_0_S5_S3 0 250 /end CHARACTERISTIC
/begin CHARACTERISTIC NS_EMDELTA_STADA "Max zulaessige Motordrehzal Aenderung EM" VALUE 0x1D8214 ZF_kw_ui16_S5_S3 1000 UMR_U_MIN_1_1_0_S5_S3 0 1000 /end CHARACTERISTIC
/begin CHARACTERISTIC NS_EMOB_STADA "Obere Drehzahlschwelle EM" VALUE 0x1D821C ZF_kw_ui16_S5_S3 1550 UMR_U_MIN_1_1_0_S5_S3 0 1550 /end CHARACTERISTIC
/begin CHARACTERISTIC NS_EMUN_STADA "Untere Drehzahlschelle EM" VALUE 0x1D821A ZF_kw_ui16_S5_S3 1550 UMR_U_MIN_1_1_0_S5_S3 0 1550 /end CHARACTERISTIC
/begin CHARACTERISTIC NS_MOTDELTA_STADA "Max zulaessige Motordrehzal Aenderung VM" VALUE 0x1D8212 ZF_kw_ui16_S5_S3 1000 UMR_U_MIN_1_1_0_S5_S3 0 1000 /end CHARACTERISTIC
/begin CHARACTERISTIC NS_MOTOB_STADA "Obere Drehzahlschwelle VM" VALUE 0x1D8218 ZF_kw_ui16_S5_S3 1550 UMR_U_MIN_1_1_0_S5_S3 0 1550 /end CHARACTERISTIC
/begin CHARACTERISTIC NS_MOTPFADRS "Motordrehzahlschwellwert fuer Adaptionsbewertung" VALUE 0x1D818E ZF_kw_ui16_S5_S3 8200 UMR_U_MIN_1_1_0_S5_S3 0 8200 /end CHARACTERISTIC
/begin CHARACTERISTIC NS_MOTSOLL_LL_MIN_APERK_IAE "Mindest Leerlauf-Drehzahl AdaIae" VALUE 0x1D8138 ZF_kw_ui16_S5_S3 1000 UMR_U_MIN_1_1_0_S5_S3 0 1000 /end CHARACTERISTIC
/begin CHARACTERISTIC NS_MOTUN_STADA "Untere Drehzahlschelle VM" VALUE 0x1D8216 ZF_kw_ui16_S5_S3 1550 UMR_U_MIN_1_1_0_S5_S3 0 1550 /end CHARACTERISTIC
/begin CHARACTERISTIC NS_NAB_ABBRUCH_APERK_IAE "Drehzahlschwelle Abbruch- und Startbedingung" VALUE 0x1D8136 ZF_kw_ui16_S5_S3 500 UMR_U_MIN_1_1_0_S5_S3 0 500 /end CHARACTERISTIC
/begin CHARACTERISTIC NS_PFADRS "Drehzahlschwellwert fuer Adaptionsbewertung" VALUE 0x1D8190 ZF_kw_ui16_S5_S3 8200 UMR_U_MIN_1_1_0_S5_S3 0 8200 /end CHARACTERISTIC
/begin CHARACTERISTIC NS_VMPULS_STADA "Drehzahlschwelle Verbrennungsmotor" VALUE 0x1D8220 ZF_kw_ui16_S5_S3 1000 UMR_U_MIN_1_1_0_S5_S3 0 1000 /end CHARACTERISTIC
/begin CHARACTERISTIC N_PULSGRENZ_STADA "max. Anzahl Pulse pro Pruefzyklus" VALUE 0x1D7709 ZF_kw_ui8_S5_S3 255 UMR___1_1_0_S5_S3 0 255 /end CHARACTERISTIC
/begin CHARACTERISTIC PG_ABSENK_APERK_IAE "Druckgradient in der Absenkphase (IAE-Ada)" VALUE 0x1D8182 ZF_kw_si16_S5_S3 2 UMR_BAR_SEC_1_1000_0_S5_S3 -2 0 /end CHARACTERISTIC
/begin CHARACTERISTIC PG_BREMS_ABBRUCH_APERK_IAE "Brems-Gradientenschwelle, Abbruchkriterium" VALUE 0x1D8148 ZF_kw_si16_S5_S3 10000 UMR_BAR_SEC_1_1_0_S5_S3 -10000 0 /end CHARACTERISTIC
/begin CHARACTERISTIC PG_NEG_ABBRUCH_APERK_IAE "Druckgradient Überführung im Abbruchfall, neg Richtung" VALUE 0x1D8162 ZF_kw_si16_S5_S3 100 UMR_BAR_SEC_1_10_0_S5_S3 -100 0 /end CHARACTERISTIC
/begin CHARACTERISTIC PG_NEG_HYS_APERK_IAE "Druckgradient Überführung im Erkennungsfall, neg Richtung" VALUE 0x1D8166 ZF_kw_si16_S5_S3 100.1 UMR_BAR_SEC_1_10_0_S5_S3 -100 0.1 /end CHARACTERISTIC
/begin CHARACTERISTIC PG_POS_ABBRUCH_APERK_IAE "Druckgradient Überführung im Abbruchfall, pos Richtung" VALUE 0x1D8164 ZF_kw_si16_S5_S3 99.9 UMR_BAR_SEC_1_10_0_S5_S3 0.1 100 /end CHARACTERISTIC
/begin CHARACTERISTIC PG_POS_HYS_APERK_IAE "Druckgradient Überführung im Erkennungsfall, pos Richtung" VALUE 0x1D8168 ZF_kw_si16_S5_S3 100 UMR_BAR_SEC_1_10_0_S5_S3 0 100 /end CHARACTERISTIC
/begin CHARACTERISTIC PG_PRUEF_APERK_IAE "Gradient der Testrampe" VALUE 0x1D816A ZF_kw_si16_S5_S3 10 UMR_BAR_SEC_1_1000_0_S5_S3 0 10 /end CHARACTERISTIC
/begin CHARACTERISTIC PO_ABSENK_APERK_IAE "Druckabsenkung in Zustand Abgesenkt, relativ zu po_apada_eeprom" VALUE 0x1D8170 ZF_kw_si16_S5_S3 1 UMR_BAR__1_1000_0_S5_S3 -1 0 /end CHARACTERISTIC
/begin CHARACTERISTIC PO_BREMS_ABBRUCH_APERK_IAE "Offset auf Bremsdruckschwelle, Abbruchkriterium" VALUE 0x1D8146 ZF_kw_si16_S5_S3 100 UMR_BAR__1_100_0_S5_S3 0 100 /end CHARACTERISTIC
/begin CHARACTERISTIC PO_DELTA_MAX_APADA_IAE "Maximale Aenderung eines Ada-Wertes" VALUE 0x1D8176 ZF_kw_si16_S5_S3 1 UMR_BAR__1_1000_0_S5_S3 0 1 /end CHARACTERISTIC
/begin CHARACTERISTIC PO_FNACHADA_A "Offset auf Zwischenspeicher vor Eintrag in Adaspeicher" VALUE 0x1D823C ZF_kw_si16_S5_S3 12 UMR_BAR__1_1000_0_S5_S3 -6 6 /end CHARACTERISTIC
/begin CHARACTERISTIC PO_FNACHADA_B "Offset auf Zwischenspeicher vor Eintrag in Adaspeicher" VALUE 0x1D8248 ZF_kw_si16_S5_S3 12 UMR_BAR__1_1000_0_S5_S3 -6 6 /end CHARACTERISTIC
/begin CHARACTERISTIC PO_FNACHADA_C "Offset auf Zwischenspeicher vor Eintrag in Adaspeicher" VALUE 0x1D8254 ZF_kw_si16_S5_S3 12 UMR_BAR__1_1000_0_S5_S3 -6 6 /end CHARACTERISTIC
/begin CHARACTERISTIC PO_FNACHADA_D "Offset auf Zwischenspeicher vor Eintrag in Adaspeicher" VALUE 0x1D8260 ZF_kw_si16_S5_S3 12 UMR_BAR__1_1000_0_S5_S3 -6 6 /end CHARACTERISTIC
/begin CHARACTERISTIC PO_FNACHADA_E "Offset auf Zwischenspeicher vor Eintrag in Adaspeicher" VALUE 0x1D826C ZF_kw_si16_S5_S3 12 UMR_BAR__1_1000_0_S5_S3 -6 6 /end CHARACTERISTIC
/begin CHARACTERISTIC PO_FNACHADA_K0 "Offset auf Zwischenspeicher vor Eintrag in Adaspeicher" VALUE 0x1D8278 ZF_kw_si16_S5_S3 12 UMR_BAR__1_1000_0_S5_S3 -6 6 /end CHARACTERISTIC
/begin CHARACTERISTIC PO_FNACHADA_STADA_A "Offset auf Zwischenspeicher vor Eintrag in Adaspeicher" VALUE 0x1D81AC ZF_kw_si16_S5_S3 12 UMR_BAR__1_1000_0_S5_S3 -6 6 /end CHARACTERISTIC
/begin CHARACTERISTIC PO_FNACHADA_STADA_B "Offset auf Zwischenspeicher vor Eintrag in Adaspeicher" VALUE 0x1D81B6 ZF_kw_si16_S5_S3 12 UMR_BAR__1_1000_0_S5_S3 -6 6 /end CHARACTERISTIC
/begin CHARACTERISTIC PO_FNACHADA_STADA_C "Offset auf Zwischenspeicher vor Eintrag in Adaspeicher" VALUE 0x1D81C0 ZF_kw_si16_S5_S3 12 UMR_BAR__1_1000_0_S5_S3 -6 6 /end CHARACTERISTIC
/begin CHARACTERISTIC PO_FNACHADA_STADA_D "Offset auf Zwischenspeicher vor Eintrag in Adaspeicher" VALUE 0x1D81CA ZF_kw_si16_S5_S3 12 UMR_BAR__1_1000_0_S5_S3 -6 6 /end CHARACTERISTIC
/begin CHARACTERISTIC PO_FNACHADA_STADA_E "Offset auf Zwischenspeicher vor Eintrag in Adaspeicher" VALUE 0x1D81D4 ZF_kw_si16_S5_S3 12 UMR_BAR__1_1000_0_S5_S3 -6 6 /end CHARACTERISTIC
/begin CHARACTERISTIC PO_FNACHADA_STADA_K0 "Offset auf Zwischenspeicher vor Eintrag in Adaspeicher" VALUE 0x1D81DE ZF_kw_si16_S5_S3 12 UMR_BAR__1_1000_0_S5_S3 -6 6 /end CHARACTERISTIC
/begin CHARACTERISTIC PO_FVORADASTART_A "Offset auf PF-Puls bei 1.Puls zu Beginn der Getriebelaufzeit" VALUE 0x1D823A ZF_kw_si16_S5_S3 12 UMR_BAR__1_1000_0_S5_S3 -6 6 /end CHARACTERISTIC
/begin CHARACTERISTIC PO_FVORADASTART_B "Offset auf PF-Puls bei 1.Puls zu Beginn der Getriebelaufzeit" VALUE 0x1D8246 ZF_kw_si16_S5_S3 12 UMR_BAR__1_1000_0_S5_S3 -6 6 /end CHARACTERISTIC
/begin CHARACTERISTIC PO_FVORADASTART_C "Offset auf PF-Puls bei 1.Puls zu Beginn der Getriebelaufzeit" VALUE 0x1D8252 ZF_kw_si16_S5_S3 12 UMR_BAR__1_1000_0_S5_S3 -6 6 /end CHARACTERISTIC
/begin CHARACTERISTIC PO_FVORADASTART_D "Offset auf PF-Puls bei 1.Puls zu Beginn der Getriebelaufzeit" VALUE 0x1D825E ZF_kw_si16_S5_S3 12 UMR_BAR__1_1000_0_S5_S3 -6 6 /end CHARACTERISTIC
/begin CHARACTERISTIC PO_FVORADASTART_E "Offset auf PF-Puls bei 1.Puls zu Beginn der Getriebelaufzeit" VALUE 0x1D826A ZF_kw_si16_S5_S3 12 UMR_BAR__1_1000_0_S5_S3 -6 6 /end CHARACTERISTIC
/begin CHARACTERISTIC PO_FVORADASTART_K0 "Offset auf PF-Puls bei 1.Puls zu Beginn der Getriebelaufzeit" VALUE 0x1D8276 ZF_kw_si16_S5_S3 12 UMR_BAR__1_1000_0_S5_S3 -6 6 /end CHARACTERISTIC
/begin CHARACTERISTIC PO_FVORADA_A "Offset auf PF-Puls bei 1.Puls" VALUE 0x1D8238 ZF_kw_si16_S5_S3 12 UMR_BAR__1_1000_0_S5_S3 -6 6 /end CHARACTERISTIC
/begin CHARACTERISTIC PO_FVORADA_B "Offset auf PF-Puls bei 1.Puls" VALUE 0x1D8244 ZF_kw_si16_S5_S3 12 UMR_BAR__1_1000_0_S5_S3 -6 6 /end CHARACTERISTIC
/begin CHARACTERISTIC PO_FVORADA_C "Offset auf PF-Puls bei 1.Puls" VALUE 0x1D8250 ZF_kw_si16_S5_S3 12 UMR_BAR__1_1000_0_S5_S3 -6 6 /end CHARACTERISTIC
/begin CHARACTERISTIC PO_FVORADA_D "Offset auf PF-Puls bei 1.Puls" VALUE 0x1D825C ZF_kw_si16_S5_S3 12 UMR_BAR__1_1000_0_S5_S3 -6 6 /end CHARACTERISTIC
/begin CHARACTERISTIC PO_FVORADA_E "Offset auf PF-Puls bei 1.Puls" VALUE 0x1D8268 ZF_kw_si16_S5_S3 12 UMR_BAR__1_1000_0_S5_S3 -6 6 /end CHARACTERISTIC
/begin CHARACTERISTIC PO_FVORADA_K0 "Offset auf PF-Puls bei 1.Puls" VALUE 0x1D8274 ZF_kw_si16_S5_S3 12 UMR_BAR__1_1000_0_S5_S3 -6 6 /end CHARACTERISTIC
/begin CHARACTERISTIC PO_FVORADA_STADA_A "Offset auf PF-Puls bei 1.Puls" VALUE 0x1D81AA ZF_kw_si16_S5_S3 12 UMR_BAR__1_1000_0_S5_S3 -6 6 /end CHARACTERISTIC
/begin CHARACTERISTIC PO_FVORADA_STADA_B "Offset auf PF-Puls bei 1.Puls" VALUE 0x1D81B4 ZF_kw_si16_S5_S3 12 UMR_BAR__1_1000_0_S5_S3 -6 6 /end CHARACTERISTIC
/begin CHARACTERISTIC PO_FVORADA_STADA_C "Offset auf PF-Puls bei 1.Puls" VALUE 0x1D81BE ZF_kw_si16_S5_S3 12 UMR_BAR__1_1000_0_S5_S3 -6 6 /end CHARACTERISTIC
/begin CHARACTERISTIC PO_FVORADA_STADA_D "Offset auf PF-Puls bei 1.Puls" VALUE 0x1D81C8 ZF_kw_si16_S5_S3 12 UMR_BAR__1_1000_0_S5_S3 -6 6 /end CHARACTERISTIC
/begin CHARACTERISTIC PO_FVORADA_STADA_E "Offset auf PF-Puls bei 1.Puls" VALUE 0x1D81D2 ZF_kw_si16_S5_S3 12 UMR_BAR__1_1000_0_S5_S3 -6 6 /end CHARACTERISTIC
/begin CHARACTERISTIC PO_FVORADA_STADA_K0 "Offset auf PF-Puls bei 1.Puls" VALUE 0x1D81DC ZF_kw_si16_S5_S3 12 UMR_BAR__1_1000_0_S5_S3 -6 6 /end CHARACTERISTIC
/begin CHARACTERISTIC PO_HYSSCHLEIFE_APERK_IAE "Druckoffset der Hysschleife im Fall ANGELEGT" VALUE 0x1D816C ZF_kw_si16_S5_S3 20 UMR_BAR__1_1000_0_S5_S3 -10 10 /end CHARACTERISTIC
/begin CHARACTERISTIC PO_NEG_APERK_IAE "Abzug bei zu hoch erkanntem Touchpoint" VALUE 0x1D8178 ZF_kw_si16_S5_S3 1 UMR_BAR__1_1000_0_S5_S3 -1 0 /end CHARACTERISTIC
/begin CHARACTERISTIC PO_PRUEF_MAX_APERK_IAE "Druckoffset Rampenstartwert, relativ zu po_apada_eeprom" VALUE 0x1D816E ZF_kw_si16_S5_S3 10 UMR_BAR__1_1000_0_S5_S3 0 10 /end CHARACTERISTIC
/begin CHARACTERISTIC PO_SFSTUFE_A "Offset auf minimalen Fuelldruck fuer Druckstufe" VALUE 0x1D8288 ZF_kw_si16_S5_S3 6 UMR_BAR__1_1000_0_S5_S3 0 6 /end CHARACTERISTIC
/begin CHARACTERISTIC PO_SFSTUFE_STADA_A "Offset auf minimalen Fuelldruck fuer Druckstufe" VALUE 0x1D81EC ZF_kw_si16_S5_S3 6 UMR_BAR__1_1000_0_S5_S3 0 6 /end CHARACTERISTIC
/begin CHARACTERISTIC PO_SFSTUFE_STADA_B "Offset auf minimalen Fuelldruck fuer Druckstufe" VALUE 0x1D81F2 ZF_kw_si16_S5_S3 6 UMR_BAR__1_1000_0_S5_S3 0 6 /end CHARACTERISTIC
/begin CHARACTERISTIC PO_SFSTUFE_STADA_C "Offset auf minimalen Fuelldruck fuer Druckstufe" VALUE 0x1D81F8 ZF_kw_si16_S5_S3 6 UMR_BAR__1_1000_0_S5_S3 0 6 /end CHARACTERISTIC
/begin CHARACTERISTIC PO_SFSTUFE_STADA_D "Offset auf minimalen Fuelldruck fuer Druckstufe" VALUE 0x1D81FE ZF_kw_si16_S5_S3 6 UMR_BAR__1_1000_0_S5_S3 0 6 /end CHARACTERISTIC
/begin CHARACTERISTIC PO_SFSTUFE_STADA_E "Offset auf minimalen Fuelldruck fuer Druckstufe" VALUE 0x1D8204 ZF_kw_si16_S5_S3 6 UMR_BAR__1_1000_0_S5_S3 0 6 /end CHARACTERISTIC
/begin CHARACTERISTIC PO_SFSTUFE_STADA_K0 "Offset auf minimalen Fuelldruck fuer Druckstufe" VALUE 0x1D820A ZF_kw_si16_S5_S3 6 UMR_BAR__1_1000_0_S5_S3 0 6 /end CHARACTERISTIC
/begin CHARACTERISTIC PO_TABMAX_APADA_IAE "Obere Grenze fuer Ada-Wert" VALUE 0x1D8172 ZF_kw_si16_S5_S3 20 UMR_BAR__1_1000_0_S5_S3 0 20 /end CHARACTERISTIC
/begin CHARACTERISTIC PO_TABMIN_APADA_IAE "Untere Grenze fuer Ada-Wert" VALUE 0x1D8174 ZF_kw_si16_S5_S3 20 UMR_BAR__1_1000_0_S5_S3 -20 0 /end CHARACTERISTIC
/begin CHARACTERISTIC PS_MIN_ABSENK_APERK_IAE "Minimaler Absolutdruck in der IAE waehrend Absenkphase (IAE-Ada)" VALUE 0x1D8184 ZF_kw_ui16_S5_S3 2 UMR_BAR__1_1000_0_S5_S3 0 2 /end CHARACTERISTIC
/begin CHARACTERISTIC PS_PFADRS "Bremsdruck Schwelle fuer Adaption RS" VALUE 0x1D76B0 ZF_kw_ui8_S5_S3 100 UMR_BAR__1_1_0_S5_S3 0 100 /end CHARACTERISTIC
/begin CHARACTERISTIC PS_STADA "Bremsdruchschwelle" VALUE 0x1D820E ZF_kw_si16_S5_S3 99 UMR_BAR__1_1_0_S5_S3 1 100 /end CHARACTERISTIC
/begin CHARACTERISTIC P_PFPULS_A "Pulshoehe PF-Puls" VALUE 0x1D8242 ZF_kw_si16_S5_S3 6 UMR_BAR__1_1000_0_S5_S3 0 6 /end CHARACTERISTIC
/begin CHARACTERISTIC P_PFPULS_B "Pulshoehe PF-Puls" VALUE 0x1D824E ZF_kw_si16_S5_S3 6 UMR_BAR__1_1000_0_S5_S3 0 6 /end CHARACTERISTIC
/begin CHARACTERISTIC P_PFPULS_C "Pulshoehe PF-Puls" VALUE 0x1D825A ZF_kw_si16_S5_S3 6 UMR_BAR__1_1000_0_S5_S3 0 6 /end CHARACTERISTIC
/begin CHARACTERISTIC P_PFPULS_D "Pulshoehe PF-Puls" VALUE 0x1D8266 ZF_kw_si16_S5_S3 6 UMR_BAR__1_1000_0_S5_S3 0 6 /end CHARACTERISTIC
/begin CHARACTERISTIC P_PFPULS_E "Pulshoehe PF-Puls" VALUE 0x1D8272 ZF_kw_si16_S5_S3 6 UMR_BAR__1_1000_0_S5_S3 0 6 /end CHARACTERISTIC
/begin CHARACTERISTIC P_PFPULS_K0 "Pulshoehe PF-Puls" VALUE 0x1D827E ZF_kw_si16_S5_S3 6 UMR_BAR__1_1000_0_S5_S3 0 6 /end CHARACTERISTIC
/begin CHARACTERISTIC P_PFPULS_STADA_A "Pulshoehe PF-Puls" VALUE 0x1D81B0 ZF_kw_si16_S5_S3 6 UMR_BAR__1_1000_0_S5_S3 0 6 /end CHARACTERISTIC
/begin CHARACTERISTIC P_PFPULS_STADA_B "Pulshoehe PF-Puls" VALUE 0x1D81BA ZF_kw_si16_S5_S3 6 UMR_BAR__1_1000_0_S5_S3 0 6 /end CHARACTERISTIC
/begin CHARACTERISTIC P_PFPULS_STADA_C "Pulshoehe PF-Puls" VALUE 0x1D81C4 ZF_kw_si16_S5_S3 6 UMR_BAR__1_1000_0_S5_S3 0 6 /end CHARACTERISTIC
/begin CHARACTERISTIC P_PFPULS_STADA_D "Pulshoehe PF-Puls" VALUE 0x1D81CE ZF_kw_si16_S5_S3 6 UMR_BAR__1_1000_0_S5_S3 0 6 /end CHARACTERISTIC
/begin CHARACTERISTIC P_PFPULS_STADA_E "Pulshoehe PF-Puls" VALUE 0x1D81D8 ZF_kw_si16_S5_S3 6 UMR_BAR__1_1000_0_S5_S3 0 6 /end CHARACTERISTIC
/begin CHARACTERISTIC P_PFPULS_STADA_K0 "Pulshoehe PF-Puls" VALUE 0x1D81E2 ZF_kw_si16_S5_S3 6 UMR_BAR__1_1000_0_S5_S3 0 6 /end CHARACTERISTIC
/begin CHARACTERISTIC P_RAINCPF "Schrittweite fuer Rueckadaption" VALUE 0x1D8232 ZF_kw_si16_S5_S3 6 UMR_BAR__1_1000_0_S5_S3 -6 0 /end CHARACTERISTIC
/begin CHARACTERISTIC P_RAINCPF_STADA "Schrittweite fuer Rueckadaption" VALUE 0x1D81A2 ZF_kw_si16_S5_S3 6 UMR_BAR__1_1000_0_S5_S3 -6 0 /end CHARACTERISTIC
/begin CHARACTERISTIC P_RAUEBINCPF "Schrittweite Rueckadaption Ueberpruefgsschleife" VALUE 0x1D8236 ZF_kw_si16_S5_S3 6 UMR_BAR__1_1000_0_S5_S3 -6 0 /end CHARACTERISTIC
/begin CHARACTERISTIC P_RAUEBINCPF_STADA "Schrittweite Rueckadaption Ueberpruefgsschleife" VALUE 0x1D81A6 ZF_kw_si16_S5_S3 6 UMR_BAR__1_1000_0_S5_S3 -6 0 /end CHARACTERISTIC
/begin CHARACTERISTIC P_SDADMAX "Maximal zulaessiger Adaptionsdruck" VALUE 0x1D8130 ZF_kw_si16_S5_S3 1.25 UMR_BAR__1_100_0_S5_S3 0 1.25 /end CHARACTERISTIC
/begin CHARACTERISTIC P_SDADMIN "Minimal zulaessiger Adaptionsdruck" VALUE 0x1D8132 ZF_kw_si16_S5_S3 1.25 UMR_BAR__1_100_0_S5_S3 -1.25 0 /end CHARACTERISTIC
/begin CHARACTERISTIC P_ZWPFINC "Schrittweite fuer Zwangsrueckadaption" VALUE 0x1D8234 ZF_kw_si16_S5_S3 6 UMR_BAR__1_1000_0_S5_S3 -6 0 /end CHARACTERISTIC
/begin CHARACTERISTIC P_ZWPFINC_STADA "Schrittweite fuer Zwangsrueckadaption" VALUE 0x1D81A4 ZF_kw_si16_S5_S3 6 UMR_BAR__1_1000_0_S5_S3 -6 0 /end CHARACTERISTIC
/begin CHARACTERISTIC SBAKLZ_ND_UEFIAE "Breitenfaktor Übersprechfunktion" VALUE 0x1D76A9 ZF_kw_ui8_S5_S3 1 UMR___1_100_0_S5_S3 0 1 /end CHARACTERISTIC
/begin CHARACTERISTIC SHIFTCOUNTERGLSRSHS_TRIM "GLS-Trimm Fkt: Schwelle GLS-Ada HS Kennfeld 1/2 gilt als bewertet" VALUE 0x1D7681 ZF_kw_ui8_S5_S3 255 UMR___1_1_0_S5_S3 0 255 /end CHARACTERISTIC
/begin CHARACTERISTIC SHIFTCOUNTERGLSRSKF1_TRIM "GLS-Trimm Fkt: Schwelle GLS-Ada RS Kennfeld 1 gilt als bewertet" VALUE 0x1D767F ZF_kw_ui8_S5_S3 255 UMR___1_1_0_S5_S3 0 255 /end CHARACTERISTIC
/begin CHARACTERISTIC SHIFTCOUNTERGLSRSKF2_TRIM "GLS-Trimm Fkt: Schwelle GLS-Ada RS Kennfeld 2 gilt als bewertet" VALUE 0x1D7680 ZF_kw_ui8_S5_S3 255 UMR___1_1_0_S5_S3 0 255 /end CHARACTERISTIC
/begin CHARACTERISTIC SWI_ABBRGLS_PFADA "Schalter fuer Abbruch GLS-Ada, wenn PF-Ada waehrend HS aktiv 0=deakt., 1=akt." VALUE 0x1D7683 ZF_kw_bool8_S5_S3 1 UMR___1_1_0_S5_S3 0 1 /end CHARACTERISTIC
/begin CHARACTERISTIC SWI_ADAIAE_KPLBINN "Schalter um den Ada-Wert fuer N zu Aktivieren IAE-APADA" VALUE 0x1D7697 ZF_kw_bool8_S5_S3 1 UMR___1_1_0_S5_S3 0 1 /end CHARACTERISTIC
/begin CHARACTERISTIC SWI_ADAKORPF "Auswahl-Switch Schaltqualitaets-Adaption" VALUE 0x1D768C ZF_kw_ui8_S5_S3 1 UMR___1_1_0_S5_S3 0 1 /end CHARACTERISTIC
/begin CHARACTERISTIC SWI_ADA_LOESCH "Auswahl-Switch um einzelne Adaspeicher zu loeschen" VALUE 0x1D7691 ZF_kw_ui8_S5_S3 255 UMR___1_1_0_S5_S3 0 255 /end CHARACTERISTIC
/begin CHARACTERISTIC SWI_APERK_IAE "Schalter zur Aktivierung und Aufschaltung der IAE-APADA" VALUE 0x1D7698 ZF_kw_bool8_S5_S3 1 UMR___1_1_0_S5_S3 0 1 /end CHARACTERISTIC
/begin CHARACTERISTIC SWI_AXREF_ADAOFF "Schalter um Ada-Bew-Verbot durch Laengs-Beschleunigung zu aktivieren" VALUE 0x1D7692 ZF_kw_bool8_S5_S3 1 UMR___1_1_0_S5_S3 0 1 /end CHARACTERISTIC
/begin CHARACTERISTIC SWI_GE_APERK_IAE "Beschraenkung der APERK-Durchführung auf Wechsel aus INAKTIV, nach Gangeinlegen" VALUE 0x1D7696 ZF_kw_bool8_S5_S3 1 UMR___1_1_0_S5_S3 0 1 /end CHARACTERISTIC
/begin CHARACTERISTIC SWI_GLS_ADA_LOESCH_ISTGANG "Switch zum Loeschen von ADA-GLS Kennfelder" VALUE 0x1D7688 ZF_kw_ui8_S5_S3 8 UMR___1_1_0_S5_S3 0 8 /end CHARACTERISTIC
/begin CHARACTERISTIC SWI_GLS_ADA_LOESCH_ZIELGANG "Switch zum Loeschen von ADA-GLS Kennfelder" VALUE 0x1D7689 ZF_kw_ui8_S5_S3 8 UMR___1_1_0_S5_S3 0 8 /end CHARACTERISTIC
/begin CHARACTERISTIC SWI_GLS_ADA_SPSPORT "Switch zur Einstellung des Bewertungsprogramms GLS-ADA" VALUE 0x1D768A ZF_kw_ui8_S5_S3 3 UMR___1_1_0_S5_S3 0 3 /end CHARACTERISTIC
/begin CHARACTERISTIC SWI_GLS_TRIM "Schalter zur Aktivierung der GLS Trimm Dich Funktion 0=Aus 1=VerschRS 2=DRS/MRS 3=On" VALUE 0x1D767E ZF_kw_ui8_S5_S3 3 UMR___1_1_0_S5_S3 0 3 /end CHARACTERISTIC
/begin CHARACTERISTIC SWI_KPL_LOCK "Auswahl-Switch fuer Puls-Ada K0 Lock" VALUE 0x1D768F ZF_kw_ui8_S5_S3 1 UMR___1_1_0_S5_S3 0 1 /end CHARACTERISTIC
/begin CHARACTERISTIC SWI_KUPADASTART_SCHLECHTWEG "Auswahl-Switch Schlechtwege Funktion aktiv" VALUE 0x1D768B ZF_kw_bool8_S5_S3 1 UMR___1_1_0_S5_S3 0 1 /end CHARACTERISTIC
/begin CHARACTERISTIC SWI_PARTFILTAKTIV "Ada Abbruchkriterium Partikelfilter-Regeneration applizierbar" VALUE 0x1D7695 ZF_kw_bool8_S5_S3 1 UMR___1_1_0_S5_S3 0 1 /end CHARACTERISTIC
/begin CHARACTERISTIC SWI_PFADHSSPABBR "Abbruch Fuelldruckadaption bei kurze HS" VALUE 0x1D76AC ZF_kw_bool8_S5_S3 1 UMR___1_1_0_S5_S3 0 1 /end CHARACTERISTIC
/begin CHARACTERISTIC SWI_PFADRSSPABBR "Abbruch Fuelldruckadaption bei kurze RS" VALUE 0x1D76AD ZF_kw_bool8_S5_S3 1 UMR___1_1_0_S5_S3 0 1 /end CHARACTERISTIC
/begin CHARACTERISTIC SWI_SDAD "Schalter GLS-Adaption 0=Off, 1=On, 2=nur VM, 3=nur EM" VALUE 0x1D767D ZF_kw_ui8_S5_S3 3 UMR___1_1_0_S5_S3 0 3 /end CHARACTERISTIC
/begin CHARACTERISTIC SWI_VORINFO_APERK_IAE "Vorabausgabe der Drehzahlanforderung der IAE-APADA" VALUE 0x1D7699 ZF_kw_bool8_S5_S3 1 UMR___1_1_0_S5_S3 0 1 /end CHARACTERISTIC
/begin CHARACTERISTIC SWI_ZKINDEX_GLS "Zugkraft-Korrektur-Kriterium fuer GLS ADA" VALUE 0x1D7682 ZF_kw_bool8_S5_S3 1 UMR___1_1_0_S5_S3 0 1 /end CHARACTERISTIC
/begin CHARACTERISTIC SWI_ZKINDEX_PFHS "Zugkraft-Korrektur-Kriterium fuer PF HS ADA" VALUE 0x1D76AE ZF_kw_bool8_S5_S3 1 UMR___1_1_0_S5_S3 0 1 /end CHARACTERISTIC
/begin CHARACTERISTIC SWI_ZKINDEX_PFRS "Zugkraft-Korrektur-Kriterium fuer PF RS ADA" VALUE 0x1D76AF ZF_kw_bool8_S5_S3 1 UMR___1_1_0_S5_S3 0 1 /end CHARACTERISTIC
/begin CHARACTERISTIC T3_BEW_ABSCHALTKPAD_PF "Bewertgsfenster nach Erkenng MAX-Wert von n_guete" VALUE 0x1D8230 ZF_kw_ui16_S5_S3 2500 UMR_MSEC__10_1_0_S5_S3 0 2500 /end CHARACTERISTIC
/begin CHARACTERISTIC T3_BEW_ABSCHALTKPAD_TSF "Bewertgsfenster nach Erkenng MAX-Wert von n_guete" VALUE 0x1D822E ZF_kw_ui16_S5_S3 2500 UMR_MSEC__10_1_0_S5_S3 0 2500 /end CHARACTERISTIC
/begin CHARACTERISTIC TAB_HAINCPF "Schrittweite fuer Hochadaption PF-Adaption (0=K_A, 1=K_B, ...)" CURVE 0x19A120 ZF_tab_si16_S5_S3 6 UMR_BAR__1_1000_0_S5_S3 0 6
 /begin AXIS_DESCR FIX_AXIS iAdaPulzs.kup_puls UMR___1_1_0_S5_S3 6 1 6 READ_ONLY FIX_AXIS_PAR_DIST 1 1 6 /end AXIS_DESCR
/end CHARACTERISTIC
/begin CHARACTERISTIC TAB_HAINCPF_STADA "Schrittweite fuer Hochadaption PF-Adaption (0=K_A, 1=K_B, ...)" CURVE 0x199F44 ZF_tab_si16_S5_S3 6 UMR_BAR__1_1000_0_S5_S3 0 6
 /begin AXIS_DESCR FIX_AXIS iAdaPstzs.kup_puls_stada UMR___1_1_0_S5_S3 6 1 6 READ_ONLY FIX_AXIS_PAR_DIST 1 1 6 /end AXIS_DESCR
/end CHARACTERISTIC
/begin CHARACTERISTIC TAB_HAINCTSF "Schrittweite fuer Hochadaption TSF-Adaption (0=K_A, 1=K_B, ...)" CURVE 0x19A1B0 ZF_tab_si16_S5_S3 2000 UMR_MSEC__1_1_0_S5_S3 0 2000
 /begin AXIS_DESCR FIX_AXIS iAdaPulzs.kup_puls UMR___1_1_0_S5_S3 6 1 6 READ_ONLY FIX_AXIS_PAR_DIST 1 1 6 /end AXIS_DESCR
/end CHARACTERISTIC
/begin CHARACTERISTIC TAB_HAINCTSF_STADA "Schrittweite fuer Hochadaption TSF-Adaption (0=K_A, 1=K_B, ...)" CURVE 0x199F84 ZF_tab_si16_S5_S3 2000 UMR_MSEC__1_1_0_S5_S3 0 2000
 /begin AXIS_DESCR FIX_AXIS iAdaPstzs.kup_puls_stada UMR___1_1_0_S5_S3 6 1 6 READ_ONLY FIX_AXIS_PAR_DIST 1 1 6 /end AXIS_DESCR
/end CHARACTERISTIC
/begin CHARACTERISTIC TAB_KUPADA_SCHLECHTWEG "Offset auf Schalungsschwelle zur reaktivierung der Startadaption" CURVE 0x19925C ZF_tab_ui16_S5_S3 10000 UMR___1_1_0_S5_S3 0 10000
 /begin AXIS_DESCR FIX_AXIS NO_INPUT_QUANTITY UMR___1_1_0_S5_S3 6 0 5 READ_ONLY FIX_AXIS_PAR_DIST 0 1 6 /end AXIS_DESCR
/end CHARACTERISTIC
/begin CHARACTERISTIC TAB_MAXFLARE_ADAPF "maximales Flare waehrend PF Adaption fuer Zwangsbewertung HS" CURVE 0x1995A4 ZF_tab_ui16_S5_S3 500 UMR_U_MIN_1_1_0_S5_S3 0 500
 /begin AXIS_DESCR FIX_AXIS NO_INPUT_QUANTITY UMR___1_1_0_S5_S3 7 0 6 READ_ONLY FIX_AXIS_PAR_DIST 0 1 7 /end AXIS_DESCR
/end CHARACTERISTIC
/begin CHARACTERISTIC TAB_MTPFADRSOB "Obere schaltungsabhaengige Momentenschwelle bei RS" CURVE 0x199640 ZF_tab_si16_S5_S3 1500 UMR_NM__1_1_0_S5_S3 -200 1300
 /begin AXIS_DESCR FIX_AXIS NO_INPUT_QUANTITY UMR___1_1_0_S5_S3 7 0 6 READ_ONLY FIX_AXIS_PAR_DIST 0 1 7 /end AXIS_DESCR
/end CHARACTERISTIC
/begin CHARACTERISTIC TAB_MTPFADRSUN "Untere schaltungsabhaengige Momentenschwelle bei RS" CURVE 0x19962C ZF_tab_si16_S5_S3 1500 UMR_NM__1_1_0_S5_S3 -200 1300
 /begin AXIS_DESCR FIX_AXIS NO_INPUT_QUANTITY UMR___1_1_0_S5_S3 7 0 6 READ_ONLY FIX_AXIS_PAR_DIST 0 1 7 /end AXIS_DESCR
/end CHARACTERISTIC
/begin CHARACTERISTIC TAB_MT_SDADGR_DRS "Turbinenmomentklassengrenze GLS Adaption DRS" CURVE 0x198264 ZF_tab_si16_S5_S3 1500 UMR_NM__1_1_0_S5_S3 -200 1300
 /begin AXIS_DESCR FIX_AXIS NO_INPUT_QUANTITY UMR___1_1_0_S5_S3 8 0 7 READ_ONLY FIX_AXIS_PAR_DIST 0 1 8 /end AXIS_DESCR
/end CHARACTERISTIC
/begin CHARACTERISTIC TAB_MT_SDADGR_HS "Turbinenmomentklassengrenze GLS Adaption EHS" CURVE 0x198214 ZF_tab_si16_S5_S3 1500 UMR_NM__1_1_0_S5_S3 -200 1300
 /begin AXIS_DESCR FIX_AXIS NO_INPUT_QUANTITY UMR___1_1_0_S5_S3 8 0 7 READ_ONLY FIX_AXIS_PAR_DIST 0 1 8 /end AXIS_DESCR
/end CHARACTERISTIC
/begin CHARACTERISTIC TAB_MT_SDADGR_NFRS "Turbinenmomentklassengrenze GLS Adaption NFRS" CURVE 0x19828C ZF_tab_si16_S5_S3 1500 UMR_NM__1_1_0_S5_S3 -200 1300
 /begin AXIS_DESCR FIX_AXIS NO_INPUT_QUANTITY UMR___1_1_0_S5_S3 6 0 5 READ_ONLY FIX_AXIS_PAR_DIST 0 1 6 /end AXIS_DESCR
/end CHARACTERISTIC
/begin CHARACTERISTIC TAB_MT_SDADGR_RS "Turbinenmomentklassengrenze GLS Adaption ERS" CURVE 0x19823C ZF_tab_si16_S5_S3 1500 UMR_NM__1_1_0_S5_S3 -200 1300
 /begin AXIS_DESCR FIX_AXIS NO_INPUT_QUANTITY UMR___1_1_0_S5_S3 8 0 7 READ_ONLY FIX_AXIS_PAR_DIST 0 1 8 /end AXIS_DESCR
/end CHARACTERISTIC
/begin CHARACTERISTIC TAB_NDS_NMOT_ABBRUCH_APERK_IAE "n_mot Abbruch-Schwelle der IAE Ada - Abhaengig vom IAE-Modus" CURVE 0x19953C ZF_tab_si16_S5_S3 2000 UMR_U_MIN_1_1_0_S5_S3 -1000 1000
 /begin AXIS_DESCR FIX_AXIS NO_INPUT_QUANTITY UMR___1_1_0_S5_S3 3 0 2 READ_ONLY FIX_AXIS_PAR_DIST 0 1 3 /end AXIS_DESCR
/end CHARACTERISTIC
/begin CHARACTERISTIC TAB_ND_ADABBR_STADA "ND-Schwelle fuer Abbruch Befuellpruefung gangabhaengig" CURVE 0x199FC4 ZF_tab_si16_S5_S3 2000 UMR_U_MIN_1_1_0_S5_S3 -1000 1000
 /begin AXIS_DESCR FIX_AXIS zff_atsys._.iSignale._.obj.sig_istgang UMR___1_1_0_S5_S3 10 -1 8 READ_ONLY FIX_AXIS_PAR_DIST -1 1 10 /end AXIS_DESCR
/end CHARACTERISTIC
/begin CHARACTERISTIC TAB_ND_PULSAMP_PF "ND-Schwelle zur Ausgleichsgeraden im Überwachungsfenster (0=K_A, 1=K_B, ...)" CURVE 0x19A0A0 ZF_tab_si16_S5_S3 1000 UMR_U_MIN_1_1_0_S5_S3 0 1000
 /begin AXIS_DESCR FIX_AXIS iAdaPulzs.kup_puls UMR___1_1_0_S5_S3 6 1 6 READ_ONLY FIX_AXIS_PAR_DIST 1 1 6 /end AXIS_DESCR
/end CHARACTERISTIC
/begin CHARACTERISTIC TAB_ND_PULSAMP_SEK_PF "ND-Schwelle zur Ausgleichsgeraden im Überwachungsfenster (0=K_A, 1=K_B, ...)" CURVE 0x19A0F0 ZF_tab_si16_S5_S3 1000 UMR_U_MIN_1_1_0_S5_S3 0 1000
 /begin AXIS_DESCR FIX_AXIS iAdaPulzs.kup_puls UMR___1_1_0_S5_S3 6 1 6 READ_ONLY FIX_AXIS_PAR_DIST 1 1 6 /end AXIS_DESCR
/end CHARACTERISTIC
/begin CHARACTERISTIC TAB_ND_PULSAMP_SEK_TSF "ND-Schwelle zur Ausgleichsgeraden im Überwachungsfenster (0=K_A, 1=K_B, ...)" CURVE 0x19A070 ZF_tab_si16_S5_S3 1000 UMR_U_MIN_1_1_0_S5_S3 0 1000
 /begin AXIS_DESCR FIX_AXIS iAdaPulzs.kup_puls UMR___1_1_0_S5_S3 6 1 6 READ_ONLY FIX_AXIS_PAR_DIST 1 1 6 /end AXIS_DESCR
/end CHARACTERISTIC
/begin CHARACTERISTIC TAB_ND_PULSAMP_STADA_PF "ND-Schwelle zur Ausgleichsgeraden im Überwachungsfenster (0=K_A, 1=K_B, ...)" CURVE 0x199EF4 ZF_tab_si16_S5_S3 1000 UMR_U_MIN_1_1_0_S5_S3 0 1000
 /begin AXIS_DESCR FIX_AXIS iAdaPstzs.kup_puls_stada UMR___1_1_0_S5_S3 6 1 6 READ_ONLY FIX_AXIS_PAR_DIST 1 1 6 /end AXIS_DESCR
/end CHARACTERISTIC
/begin CHARACTERISTIC TAB_ND_PULSAMP_STADA_TSF "ND-Schwelle zur Ausgleichsgeraden im Überwachungsfenster (0=K_A, 1=K_B, ...)" CURVE 0x199EA4 ZF_tab_si16_S5_S3 1000 UMR_U_MIN_1_1_0_S5_S3 0 1000
 /begin AXIS_DESCR FIX_AXIS iAdaPstzs.kup_puls_stada UMR___1_1_0_S5_S3 6 1 6 READ_ONLY FIX_AXIS_PAR_DIST 1 1 6 /end AXIS_DESCR
/end CHARACTERISTIC
/begin CHARACTERISTIC TAB_ND_PULSAMP_TSF "ND-Schwelle zur Ausgleichsgeraden im Überwachungsfenster (0=K_A, 1=K_B, ...)" CURVE 0x19A020 ZF_tab_si16_S5_S3 1000 UMR_U_MIN_1_1_0_S5_S3 0 1000
 /begin AXIS_DESCR FIX_AXIS iAdaPulzs.kup_puls UMR___1_1_0_S5_S3 6 1 6 READ_ONLY FIX_AXIS_PAR_DIST 1 1 6 /end AXIS_DESCR
/end CHARACTERISTIC
/begin CHARACTERISTIC TAB_ND_PULSNEG_PF "negative ND-Schwelle zur Ausgleichsgeraden im Überwachungsfenster (0=K_A, 1=K_B, ...)" CURVE 0x19A0B0 ZF_tab_si16_S5_S3 1000 UMR_U_MIN_1_1_0_S5_S3 0 1000
 /begin AXIS_DESCR FIX_AXIS iAdaPulzs.kup_puls UMR___1_1_0_S5_S3 6 1 6 READ_ONLY FIX_AXIS_PAR_DIST 1 1 6 /end AXIS_DESCR
/end CHARACTERISTIC
/begin CHARACTERISTIC TAB_ND_PULSNEG_SEK_PF "negative ND-Schwelle zur Ausgleichsgeraden im Überwachungsfenster (0=K_A, 1=K_B, ...)" CURVE 0x19A110 ZF_tab_si16_S5_S3 1000 UMR_U_MIN_1_1_0_S5_S3 0 1000
 /begin AXIS_DESCR FIX_AXIS iAdaPulzs.kup_puls UMR___1_1_0_S5_S3 6 1 6 READ_ONLY FIX_AXIS_PAR_DIST 1 1 6 /end AXIS_DESCR
/end CHARACTERISTIC
/begin CHARACTERISTIC TAB_ND_PULSNEG_SEK_TSF "negative ND-Schwelle zur Ausgleichsgeraden im Überwachungsfenster (0=K_A, 1=K_B, ...)" CURVE 0x19A090 ZF_tab_si16_S5_S3 1000 UMR_U_MIN_1_1_0_S5_S3 0 1000
 /begin AXIS_DESCR FIX_AXIS iAdaPulzs.kup_puls UMR___1_1_0_S5_S3 6 1 6 READ_ONLY FIX_AXIS_PAR_DIST 1 1 6 /end AXIS_DESCR
/end CHARACTERISTIC
/begin CHARACTERISTIC TAB_ND_PULSNEG_STADA_PF "negative ND-Schwelle zur Ausgleichsgeraden im Überwachungsfenster (0=K_A, 1=K_B, ...)" CURVE 0x199F04 ZF_tab_si16_S5_S3 1000 UMR_U_MIN_1_1_0_S5_S3 0 1000
 /begin AXIS_DESCR FIX_AXIS iAdaPstzs.kup_puls_stada UMR___1_1_0_S5_S3 6 1 6 READ_ONLY FIX_AXIS_PAR_DIST 1 1 6 /end AXIS_DESCR
/end CHARACTERISTIC
/begin CHARACTERISTIC TAB_ND_PULSNEG_STADA_TSF "negative ND-Schwelle zur Ausgleichsgeraden im Überwachungsfenster (0=K_A, 1=K_B, ...)" CURVE 0x199EB4 ZF_tab_si16_S5_S3 1000 UMR_U_MIN_1_1_0_S5_S3 0 1000
 /begin AXIS_DESCR FIX_AXIS iAdaPstzs.kup_puls_stada UMR___1_1_0_S5_S3 6 1 6 READ_ONLY FIX_AXIS_PAR_DIST 1 1 6 /end AXIS_DESCR
/end CHARACTERISTIC
/begin CHARACTERISTIC TAB_ND_PULSNEG_TSF "negative ND-Schwelle zur Ausgleichsgeraden im Überwachungsfenster (0=K_A, 1=K_B, ...)" CURVE 0x19A030 ZF_tab_si16_S5_S3 1000 UMR_U_MIN_1_1_0_S5_S3 0 1000
 /begin AXIS_DESCR FIX_AXIS iAdaPulzs.kup_puls UMR___1_1_0_S5_S3 6 1 6 READ_ONLY FIX_AXIS_PAR_DIST 1 1 6 /end AXIS_DESCR
/end CHARACTERISTIC
/begin CHARACTERISTIC TAB_ND_PULSPOS_PF "positive ND-Schwelle zur Ausgleichsgeraden im Überwachungsfenster (0=K_A, 1=K_B, ...)" CURVE 0x19A0C0 ZF_tab_si16_S5_S3 1000 UMR_U_MIN_1_1_0_S5_S3 0 1000
 /begin AXIS_DESCR FIX_AXIS iAdaPulzs.kup_puls UMR___1_1_0_S5_S3 6 1 6 READ_ONLY FIX_AXIS_PAR_DIST 1 1 6 /end AXIS_DESCR
/end CHARACTERISTIC
/begin CHARACTERISTIC TAB_ND_PULSPOS_SEK_PF "positive ND-Schwelle zur Ausgleichsgeraden im Überwachungsfenster (0=K_A, 1=K_B, ...)" CURVE 0x19A100 ZF_tab_si16_S5_S3 1000 UMR_U_MIN_1_1_0_S5_S3 0 1000
 /begin AXIS_DESCR FIX_AXIS iAdaPulzs.kup_puls UMR___1_1_0_S5_S3 6 1 6 READ_ONLY FIX_AXIS_PAR_DIST 1 1 6 /end AXIS_DESCR
/end CHARACTERISTIC
/begin CHARACTERISTIC TAB_ND_PULSPOS_SEK_TSF "positive ND-Schwelle zur Ausgleichsgeraden im Überwachungsfenster (0=K_A, 1=K_B, ...)" CURVE 0x19A080 ZF_tab_si16_S5_S3 1000 UMR_U_MIN_1_1_0_S5_S3 0 1000
 /begin AXIS_DESCR FIX_AXIS iAdaPulzs.kup_puls UMR___1_1_0_S5_S3 6 1 6 READ_ONLY FIX_AXIS_PAR_DIST 1 1 6 /end AXIS_DESCR
/end CHARACTERISTIC
/begin CHARACTERISTIC TAB_ND_PULSPOS_STADA_PF "positive ND-Schwelle zur Ausgleichsgeraden im Überwachungsfenster (0=K_A, 1=K_B, ...)" CURVE 0x199F14 ZF_tab_si16_S5_S3 1000 UMR_U_MIN_1_1_0_S5_S3 0 1000
 /begin AXIS_DESCR FIX_AXIS iAdaPstzs.kup_puls_stada UMR___1_1_0_S5_S3 6 1 6 READ_ONLY FIX_AXIS_PAR_DIST 1 1 6 /end AXIS_DESCR
/end CHARACTERISTIC
/begin CHARACTERISTIC TAB_ND_PULSPOS_STADA_TSF "positive ND-Schwelle zur Ausgleichsgeraden im Überwachungsfenster (0=K_A, 1=K_B, ...)" CURVE 0x199EC4 ZF_tab_si16_S5_S3 1000 UMR_U_MIN_1_1_0_S5_S3 0 1000
 /begin AXIS_DESCR FIX_AXIS iAdaPstzs.kup_puls_stada UMR___1_1_0_S5_S3 6 1 6 READ_ONLY FIX_AXIS_PAR_DIST 1 1 6 /end AXIS_DESCR
/end CHARACTERISTIC
/begin CHARACTERISTIC TAB_ND_PULSPOS_TSF "positive ND-Schwelle zur Ausgleichsgeraden im Überwachungsfenster (0=K_A, 1=K_B, ...)" CURVE 0x19A040 ZF_tab_si16_S5_S3 1000 UMR_U_MIN_1_1_0_S5_S3 0 1000
 /begin AXIS_DESCR FIX_AXIS iAdaPulzs.kup_puls UMR___1_1_0_S5_S3 6 1 6 READ_ONLY FIX_AXIS_PAR_DIST 1 1 6 /end AXIS_DESCR
/end CHARACTERISTIC
/begin CHARACTERISTIC TAB_ND_PULSZWNEG_PF "negative ND-Schwelle fuer Zwangsrueckadaption (0=K_A, 1=K_B, ...)" CURVE 0x19A0D0 ZF_tab_si16_S5_S3 1000 UMR_U_MIN_1_1_0_S5_S3 0 1000
 /begin AXIS_DESCR FIX_AXIS iAdaPulzs.kup_puls UMR___1_1_0_S5_S3 6 1 6 READ_ONLY FIX_AXIS_PAR_DIST 1 1 6 /end AXIS_DESCR
/end CHARACTERISTIC
/begin CHARACTERISTIC TAB_ND_PULSZWNEG_STADA_PF "negative ND-Schwelle fuer Zwangsrueckadaption (0=K_A, 1=K_B, ...)" CURVE 0x199F24 ZF_tab_si16_S5_S3 1000 UMR_U_MIN_1_1_0_S5_S3 0 1000
 /begin AXIS_DESCR FIX_AXIS iAdaPstzs.kup_puls_stada UMR___1_1_0_S5_S3 6 1 6 READ_ONLY FIX_AXIS_PAR_DIST 1 1 6 /end AXIS_DESCR
/end CHARACTERISTIC
/begin CHARACTERISTIC TAB_ND_PULSZWNEG_STADA_TSF "negative ND-Schwelle fuer Zwangsrueckadaption (0=K_A, 1=K_B, ...)" CURVE 0x199ED4 ZF_tab_si16_S5_S3 1000 UMR_U_MIN_1_1_0_S5_S3 0 1000
 /begin AXIS_DESCR FIX_AXIS iAdaPstzs.kup_puls_stada UMR___1_1_0_S5_S3 6 1 6 READ_ONLY FIX_AXIS_PAR_DIST 1 1 6 /end AXIS_DESCR
/end CHARACTERISTIC
/begin CHARACTERISTIC TAB_ND_PULSZWNEG_TSF "negative ND-Schwelle fuer Zwangsrueckadaption (0=K_A, 1=K_B, ...)" CURVE 0x19A050 ZF_tab_si16_S5_S3 1000 UMR_U_MIN_1_1_0_S5_S3 0 1000
 /begin AXIS_DESCR FIX_AXIS iAdaPulzs.kup_puls UMR___1_1_0_S5_S3 6 1 6 READ_ONLY FIX_AXIS_PAR_DIST 1 1 6 /end AXIS_DESCR
/end CHARACTERISTIC
/begin CHARACTERISTIC TAB_ND_PULSZWPOS_PF "positive ND-Schwelle fuer Zwangsrueckadaption (0=K_A, 1=K_B, ...)" CURVE 0x19A0E0 ZF_tab_si16_S5_S3 1000 UMR_U_MIN_1_1_0_S5_S3 0 1000
 /begin AXIS_DESCR FIX_AXIS iAdaPulzs.kup_puls UMR___1_1_0_S5_S3 6 1 6 READ_ONLY FIX_AXIS_PAR_DIST 1 1 6 /end AXIS_DESCR
/end CHARACTERISTIC
/begin CHARACTERISTIC TAB_ND_PULSZWPOS_STADA_PF "positive ND-Schwelle fuer Zwangsrueckadaption (0=K_A, 1=K_B, ...)" CURVE 0x199F34 ZF_tab_si16_S5_S3 1000 UMR_U_MIN_1_1_0_S5_S3 0 1000
 /begin AXIS_DESCR FIX_AXIS iAdaPstzs.kup_puls_stada UMR___1_1_0_S5_S3 6 1 6 READ_ONLY FIX_AXIS_PAR_DIST 1 1 6 /end AXIS_DESCR
/end CHARACTERISTIC
/begin CHARACTERISTIC TAB_ND_PULSZWPOS_STADA_TSF "positive ND-Schwelle fuer Zwangsrueckadaption (0=K_A, 1=K_B, ...)" CURVE 0x199EE4 ZF_tab_si16_S5_S3 1000 UMR_U_MIN_1_1_0_S5_S3 0 1000
 /begin AXIS_DESCR FIX_AXIS iAdaPstzs.kup_puls_stada UMR___1_1_0_S5_S3 6 1 6 READ_ONLY FIX_AXIS_PAR_DIST 1 1 6 /end AXIS_DESCR
/end CHARACTERISTIC
/begin CHARACTERISTIC TAB_ND_PULSZWPOS_TSF "positive ND-Schwelle fuer Zwangsrueckadaption (0=K_A, 1=K_B, ...)" CURVE 0x19A060 ZF_tab_si16_S5_S3 1000 UMR_U_MIN_1_1_0_S5_S3 0 1000
 /begin AXIS_DESCR FIX_AXIS iAdaPulzs.kup_puls UMR___1_1_0_S5_S3 6 1 6 READ_ONLY FIX_AXIS_PAR_DIST 1 1 6 /end AXIS_DESCR
/end CHARACTERISTIC
/begin CHARACTERISTIC TAB_NSEKPRUEF_KUPADA_PF "Anzahl Befuellpruefzyklen f. die die SEK Pulsada aktiv ist" CURVE 0x199278 ZF_tab_ui8_S5_S3 100 UMR___1_1_0_S5_S3 0 100
 /begin AXIS_DESCR FIX_AXIS NO_INPUT_QUANTITY UMR___1_1_0_S5_S3 6 0 5 READ_ONLY FIX_AXIS_PAR_DIST 0 1 6 /end AXIS_DESCR
/end CHARACTERISTIC
/begin CHARACTERISTIC TAB_NSEKPRUEF_KUPADA_TSF "Anzahl Befuellpruefzyklen f. die die SEK Pulsada aktiv ist" CURVE 0x1992CC ZF_tab_ui8_S5_S3 100 UMR___1_1_0_S5_S3 0 100
 /begin AXIS_DESCR FIX_AXIS NO_INPUT_QUANTITY UMR___1_1_0_S5_S3 6 0 5 READ_ONLY FIX_AXIS_PAR_DIST 0 1 6 /end AXIS_DESCR
/end CHARACTERISTIC
/begin CHARACTERISTIC TAB_NSTARTPRUEF_KUPADA_PF "Anzahl Befuellpruefzyklen f. die zu Beginn der Getriebelaufzeit eine andere PF-Adaption gewaehlt wird" CURVE 0x19926C ZF_tab_ui8_S5_S3 100 UMR___1_1_0_S5_S3 0 100
 /begin AXIS_DESCR FIX_AXIS NO_INPUT_QUANTITY UMR___1_1_0_S5_S3 6 0 5 READ_ONLY FIX_AXIS_PAR_DIST 0 1 6 /end AXIS_DESCR
/end CHARACTERISTIC
/begin CHARACTERISTIC TAB_NTPFADRSOB "Obere schaltungsabhaengige Drehzahlschwelle bei RS" CURVE 0x199618 ZF_tab_ui16_S5_S3 8200 UMR_U_MIN_1_1_0_S5_S3 0 8200
 /begin AXIS_DESCR FIX_AXIS NO_INPUT_QUANTITY UMR___1_1_0_S5_S3 7 0 6 READ_ONLY FIX_AXIS_PAR_DIST 0 1 7 /end AXIS_DESCR
/end CHARACTERISTIC
/begin CHARACTERISTIC TAB_NTPFADRSUN "Untere schaltungsabhaengige Drehzahlschwelle bei RS" CURVE 0x199604 ZF_tab_ui16_S5_S3 8200 UMR_U_MIN_1_1_0_S5_S3 0 8200
 /begin AXIS_DESCR FIX_AXIS NO_INPUT_QUANTITY UMR___1_1_0_S5_S3 7 0 6 READ_ONLY FIX_AXIS_PAR_DIST 0 1 7 /end AXIS_DESCR
/end CHARACTERISTIC
/begin CHARACTERISTIC TAB_NT_SDADGR_DRS "Turbinendrehzahlklassengrenze GLS Adaption DRS" CURVE 0x198278 ZF_tab_ui16_S5_S3 8160 UMR_U_MIN_1_1_0_S5_S3 0 8160
 /begin AXIS_DESCR FIX_AXIS NO_INPUT_QUANTITY UMR___1_1_0_S5_S3 8 0 7 READ_ONLY FIX_AXIS_PAR_DIST 0 1 8 /end AXIS_DESCR
/end CHARACTERISTIC
/begin CHARACTERISTIC TAB_NT_SDADGR_HS "Turbinendrehzahlklassengrenze GLS Adaption EHS" CURVE 0x198228 ZF_tab_ui16_S5_S3 8160 UMR_U_MIN_1_1_0_S5_S3 0 8160
 /begin AXIS_DESCR FIX_AXIS NO_INPUT_QUANTITY UMR___1_1_0_S5_S3 8 0 7 READ_ONLY FIX_AXIS_PAR_DIST 0 1 8 /end AXIS_DESCR
/end CHARACTERISTIC
/begin CHARACTERISTIC TAB_NT_SDADGR_NFRS "Turbinendrehzahlklassengrenze GLS Adaption NFRS" CURVE 0x19829C ZF_tab_ui16_S5_S3 8160 UMR_U_MIN_1_1_0_S5_S3 0 8160
 /begin AXIS_DESCR FIX_AXIS NO_INPUT_QUANTITY UMR___1_1_0_S5_S3 4 0 3 READ_ONLY FIX_AXIS_PAR_DIST 0 1 4 /end AXIS_DESCR
/end CHARACTERISTIC
/begin CHARACTERISTIC TAB_NT_SDADGR_RS "Turbinendrehzahlklassengrenze GLS Adaption ERS" CURVE 0x198250 ZF_tab_ui16_S5_S3 8160 UMR_U_MIN_1_1_0_S5_S3 0 8160
 /begin AXIS_DESCR FIX_AXIS NO_INPUT_QUANTITY UMR___1_1_0_S5_S3 8 0 7 READ_ONLY FIX_AXIS_PAR_DIST 0 1 8 /end AXIS_DESCR
/end CHARACTERISTIC
/begin CHARACTERISTIC TAB_PF_ADMAX "Obere Begrenzung PF-Adaptionswerte KUP 0=A...4=E(, 5=F)" CURVE 0x1992A4 ZF_tab_si16_S5_S3 6 UMR_BAR__1_1000_0_S5_S3 0 6
 /begin AXIS_DESCR FIX_AXIS NO_INPUT_QUANTITY UMR___1_1_0_S5_S3 6 0 5 READ_ONLY FIX_AXIS_PAR_DIST 0 1 6 /end AXIS_DESCR
/end CHARACTERISTIC
/begin CHARACTERISTIC TAB_PF_ADMAX_STADA "Tabelle zur Bestimmung des maximalen \\n Fülldruckadaptions-offsetwerts einer Kupplung.\\n (0=K_A, 1=K_B, ...)" CURVE 0x199F54 ZF_tab_si16_S5_S3 6 UMR_BAR__1_1000_0_S5_S3 0 6
 /begin AXIS_DESCR FIX_AXIS iAdaPstzs.kup_puls_stada UMR___1_1_0_S5_S3 6 1 6 READ_ONLY FIX_AXIS_PAR_DIST 1 1 6 /end AXIS_DESCR
/end CHARACTERISTIC
/begin CHARACTERISTIC TAB_PF_ADMIN "Untere Begrenzung PF-Adaptionswerte KUP 0=A...4=E(, 5=F)" CURVE 0x199294 ZF_tab_si16_S5_S3 6 UMR_BAR__1_1000_0_S5_S3 -6 0
 /begin AXIS_DESCR FIX_AXIS NO_INPUT_QUANTITY UMR___1_1_0_S5_S3 6 0 5 READ_ONLY FIX_AXIS_PAR_DIST 0 1 6 /end AXIS_DESCR
/end CHARACTERISTIC
/begin CHARACTERISTIC TAB_PF_ADMIN_STADA "Tabelle zur Bestimmung des minimalen \\n Fülldruckadaptions-offsetwerts einer Kupplung.\\n (0=K_A, 1=K_B, ...)" CURVE 0x199F64 ZF_tab_si16_S5_S3 6 UMR_BAR__1_1000_0_S5_S3 -6 0
 /begin AXIS_DESCR FIX_AXIS iAdaPstzs.kup_puls_stada UMR___1_1_0_S5_S3 6 1 6 READ_ONLY FIX_AXIS_PAR_DIST 1 1 6 /end AXIS_DESCR
/end CHARACTERISTIC
/begin CHARACTERISTIC TAB_POPULSADAGANG "Gangabhängiges Offset auf den Fülldruck" MAP 0x19A130 ZF_tab2d_si16_S5_S3 2 UMR_BAR__1_1000_0_S5_S3 -1 1
 /begin AXIS_DESCR FIX_AXIS iAdaPulzs.kup_puls UMR___1_1_0_S5_S3 6 1 6 READ_ONLY FIX_AXIS_PAR_DIST 1 1 6 /end AXIS_DESCR
 /begin AXIS_DESCR FIX_AXIS zff_atsys._.iSignale._.obj.sig_istgang UMR___1_1_0_S5_S3 10 -1 8 READ_ONLY FIX_AXIS_PAR_DIST -1 1 10 /end AXIS_DESCR
/end CHARACTERISTIC
/begin CHARACTERISTIC TAB_STUETZ_MSTELL_UEFIAE "Adaptionsklassen von m_stell_iae" CURVE 0x199560 ZF_tab_si16_S5_S3 1000 UMR_NM__1_1_0_S5_S3 0 1000
 /begin AXIS_DESCR FIX_AXIS NO_INPUT_QUANTITY UMR___1_1_0_S5_S3 6 0 5 READ_ONLY FIX_AXIS_PAR_DIST 0 1 6 /end AXIS_DESCR
/end CHARACTERISTIC
/begin CHARACTERISTIC TAB_STUETZ_ND_UEFIAE "Adaptionsklassen von nd_iae" CURVE 0x199550 ZF_tab_si16_S5_S3 6000 UMR_U_MIN_1_1_0_S5_S3 -3000 3000
 /begin AXIS_DESCR FIX_AXIS NO_INPUT_QUANTITY UMR___1_1_0_S5_S3 6 0 5 READ_ONLY FIX_AXIS_PAR_DIST 0 1 6 /end AXIS_DESCR
/end CHARACTERISTIC
/begin CHARACTERISTIC TAB_SWIPFADHS "Schaltungsabhaengige Aktivierung der Adaption bei HS" CURVE 0x199598 ZF_tab_bool8_S5_S3 1 UMR___1_1_0_S5_S3 0 1
 /begin AXIS_DESCR FIX_AXIS NO_INPUT_QUANTITY UMR___1_1_0_S5_S3 7 0 6 READ_ONLY FIX_AXIS_PAR_DIST 0 1 7 /end AXIS_DESCR
/end CHARACTERISTIC
/begin CHARACTERISTIC TAB_SWIPFADRS "Schaltungsabhaengige Aktivierung der Adaption bei RS" CURVE 0x1995F8 ZF_tab_bool8_S5_S3 1 UMR___1_1_0_S5_S3 0 1
 /begin AXIS_DESCR FIX_AXIS NO_INPUT_QUANTITY UMR___1_1_0_S5_S3 7 0 6 READ_ONLY FIX_AXIS_PAR_DIST 0 1 7 /end AXIS_DESCR
/end CHARACTERISTIC
/begin CHARACTERISTIC TAB_SWIPRUEF_STADA_PF "Kupplunsspezifische aktivierung der PF Stillstandsadaption KUP A-E(F/K0): 0=keine Pruefung, 1=Pruefung" CURVE 0x199FE8 ZF_tab_bool8_S5_S3 1 UMR___1_1_0_S5_S3 0 1
 /begin AXIS_DESCR FIX_AXIS iAdaPstzs.kup_puls_stada UMR___1_1_0_S5_S3 6 1 6 READ_ONLY FIX_AXIS_PAR_DIST 1 1 6 /end AXIS_DESCR
/end CHARACTERISTIC
/begin CHARACTERISTIC TAB_SWIPRUEF_STADA_TSF "Kupplunsspezifische aktivierung der TSF Stillstandsadaption KUP A-E(F/K0): 0=keine Pruefung, 1=Pruefung" CURVE 0x199FDC ZF_tab_bool8_S5_S3 1 UMR___1_1_0_S5_S3 0 1
 /begin AXIS_DESCR FIX_AXIS iAdaPstzs.kup_puls_stada UMR___1_1_0_S5_S3 6 1 6 READ_ONLY FIX_AXIS_PAR_DIST 1 1 6 /end AXIS_DESCR
/end CHARACTERISTIC
/begin CHARACTERISTIC TAB_SWI_KUPADA_PF "Adaption KUP A-E(F)(k0): 0=keine, 1=PULS, 2=PF-Schaltung, 3=SAD, 4=IaeTP, 5=GE-Ada" CURVE 0x199250 ZF_tab_ui8_S5_S3 5 UMR___1_1_0_S5_S3 0 5
 /begin AXIS_DESCR FIX_AXIS NO_INPUT_QUANTITY UMR___1_1_0_S5_S3 6 0 5 READ_ONLY FIX_AXIS_PAR_DIST 0 1 6 /end AXIS_DESCR
/end CHARACTERISTIC
/begin CHARACTERISTIC TAB_SWI_KUPADA_START_PF "Adaption zu Beginn der Getriebelaufzeit KUP A-E(F): 0=keine, 2=PF-Schaltung, 3=SAD, 4=IaeTP, 5=GE-Ada" CURVE 0x199238 ZF_tab_ui8_S5_S3 5 UMR___1_1_0_S5_S3 0 5
 /begin AXIS_DESCR FIX_AXIS NO_INPUT_QUANTITY UMR___1_1_0_S5_S3 6 0 5 READ_ONLY FIX_AXIS_PAR_DIST 0 1 6 /end AXIS_DESCR
/end CHARACTERISTIC
/begin CHARACTERISTIC TAB_SWI_KUPADA_TSF "Adaption KUP A-E(F): 0=keine, 1=PULS" CURVE 0x1992B4 ZF_tab_ui8_S5_S3 1 UMR___1_1_0_S5_S3 0 1
 /begin AXIS_DESCR FIX_AXIS NO_INPUT_QUANTITY UMR___1_1_0_S5_S3 6 0 5 READ_ONLY FIX_AXIS_PAR_DIST 0 1 6 /end AXIS_DESCR
/end CHARACTERISTIC
/begin CHARACTERISTIC TAB_SWI_SEK_KUPADA_PF "Auswahl des Funktionstyps der SEK Pulsadaption KUP A-E(F): 0=keine, 1=SEK ueber BPZ, 2=SEK immer aktiv" CURVE 0x199244 ZF_tab_ui8_S5_S3 2 UMR___1_1_0_S5_S3 0 2
 /begin AXIS_DESCR FIX_AXIS NO_INPUT_QUANTITY UMR___1_1_0_S5_S3 6 0 5 READ_ONLY FIX_AXIS_PAR_DIST 0 1 6 /end AXIS_DESCR
/end CHARACTERISTIC
/begin CHARACTERISTIC TAB_SWI_SEK_KUPADA_TSF "Auswahl des Funktionstyps der SEK Pulsadaption KUP A-E(F): 0=keine, 1=SEK ueber BPZ, 2=SEK immer aktiv" CURVE 0x1992C0 ZF_tab_ui8_S5_S3 2 UMR___1_1_0_S5_S3 0 2
 /begin AXIS_DESCR FIX_AXIS NO_INPUT_QUANTITY UMR___1_1_0_S5_S3 6 0 5 READ_ONLY FIX_AXIS_PAR_DIST 0 1 6 /end AXIS_DESCR
/end CHARACTERISTIC
/begin CHARACTERISTIC TAB_SWI_SPS_ADAOFF "Aktivierung einiger Adaptionen in Abhaengigkeit des index_sps" CURVE 0x19940C ZF_tab_bool8_S5_S3 1 UMR___1_1_0_S5_S3 0 1
 /begin AXIS_DESCR FIX_AXIS zff_atsys._.iSignale._.obj.sig_index_sp_sps UMR___1_1_0_S5_S3 100 0 99 READ_ONLY FIX_AXIS_PAR_DIST 0 1 100 /end AXIS_DESCR
/end CHARACTERISTIC
/begin CHARACTERISTIC TAB_TESTFALL_KUPADA_STADA "Aktivierung der Moeglichen Testfaelle aus der Testfalltabelle 0=nicht aktiv , 1=aktiv" CURVE 0x199FF4 ZF_tab_bool8_S5_S3 1 UMR___1_1_0_S5_S3 0 1
 /begin AXIS_DESCR FIX_AXIS iAdaPstzs.testfall_ind_stada UMR___1_1_0_S5_S3 13 0 12 READ_ONLY FIX_AXIS_PAR_DIST 0 1 13 /end AXIS_DESCR
/end CHARACTERISTIC
/begin CHARACTERISTIC TAB_TOPULSADAGANG "Gangabhängiges Offset auf die Schnellfüllzeit" MAP 0x19A1C0 ZF_tab2d_si16_S5_S3 200 UMR_MSEC__1_1_0_S5_S3 -100 100
 /begin AXIS_DESCR FIX_AXIS iAdaPulzs.kup_puls UMR___1_1_0_S5_S3 6 1 6 READ_ONLY FIX_AXIS_PAR_DIST 1 1 6 /end AXIS_DESCR
 /begin AXIS_DESCR FIX_AXIS zff_atsys._.iSignale._.obj.sig_istgang UMR___1_1_0_S5_S3 10 -1 8 READ_ONLY FIX_AXIS_PAR_DIST -1 1 10 /end AXIS_DESCR
/end CHARACTERISTIC
/begin CHARACTERISTIC TAB_TSF_ADMAX "Obere Begrenzung TSF-Adaptionswerte KUP 0=A...4=E(, 5=F)" CURVE 0x1992F8 ZF_tab_si16_S5_S3 1000 UMR_MSEC__1_1_0_S5_S3 0 1000
 /begin AXIS_DESCR FIX_AXIS NO_INPUT_QUANTITY UMR___1_1_0_S5_S3 6 0 5 READ_ONLY FIX_AXIS_PAR_DIST 0 1 6 /end AXIS_DESCR
/end CHARACTERISTIC
/begin CHARACTERISTIC TAB_TSF_ADMAX_STADA "Tabelle zur Bestimmung des maximalen \\n Schnellfüllzeitadaptions-offsetwerts einer \\n Kupplung (0=K_A, 1=K_B, ...)" CURVE 0x199F94 ZF_tab_si16_S5_S3 1000 UMR_MSEC__1_1_0_S5_S3 0 1000
 /begin AXIS_DESCR FIX_AXIS iAdaPstzs.kup_puls_stada UMR___1_1_0_S5_S3 6 1 6 READ_ONLY FIX_AXIS_PAR_DIST 1 1 6 /end AXIS_DESCR
/end CHARACTERISTIC
/begin CHARACTERISTIC TAB_TSF_ADMIN "Untere Begrenzung TSF-Adaptionswerte KUP 0=A...4=E(, 5=F)" CURVE 0x1992E8 ZF_tab_si16_S5_S3 1000 UMR_MSEC__1_1_0_S5_S3 -1000 0
 /begin AXIS_DESCR FIX_AXIS NO_INPUT_QUANTITY UMR___1_1_0_S5_S3 6 0 5 READ_ONLY FIX_AXIS_PAR_DIST 0 1 6 /end AXIS_DESCR
/end CHARACTERISTIC
/begin CHARACTERISTIC TAB_TSF_ADMIN_STADA "Tabelle zur Bestimmung des minimalen \\n Schnellfüllzeitadaptions-offsetwerts einer \\n Kupplung (0=K_A, 1=K_B, ...)" CURVE 0x199FA4 ZF_tab_si16_S5_S3 1000 UMR_MSEC__1_1_0_S5_S3 -1000 0
 /begin AXIS_DESCR FIX_AXIS iAdaPstzs.kup_puls_stada UMR___1_1_0_S5_S3 6 1 6 READ_ONLY FIX_AXIS_PAR_DIST 1 1 6 /end AXIS_DESCR
/end CHARACTERISTIC
/begin CHARACTERISTIC TAB_ZWANGSBEW_ADAPF "Fuelldruck Zwangsbewertung PF Adaption HS (=minimales Adaptions-Delta)" CURVE 0x1995B8 ZF_tab_si16_S5_S3 1 UMR_BAR__1_1000_0_S5_S3 0 1
 /begin AXIS_DESCR FIX_AXIS NO_INPUT_QUANTITY UMR___1_1_0_S5_S3 5 0 4 READ_ONLY FIX_AXIS_PAR_DIST 0 1 5 /end AXIS_DESCR
/end CHARACTERISTIC
/begin CHARACTERISTIC TAB_Z_MODUS_IAE_APERK_IAE "Aktivierung der Ada in Abhaengigkeit der Hybrid Betriebsart" CURVE 0x199548 ZF_tab_bool8_S5_S3 1 UMR___1_1_0_S5_S3 0 1
 /begin AXIS_DESCR FIX_AXIS NO_INPUT_QUANTITY UMR___1_1_0_S5_S3 3 0 2 READ_ONLY FIX_AXIS_PAR_DIST 0 1 3 /end AXIS_DESCR
/end CHARACTERISTIC
/begin CHARACTERISTIC TO_SFNACHADA_A "Offset auf SF-Puls nach Adaption" VALUE 0x1D772C ZF_kw_si8_S5_S3 2000 UMR_MSEC__10_1_0_S5_S3 -1000 1000 /end CHARACTERISTIC
/begin CHARACTERISTIC TO_SFNACHADA_STADA_A "Offset auf SF-Puls nach Adaption" VALUE 0x1D76DB ZF_kw_si8_S5_S3 2000 UMR_MSEC__10_1_0_S5_S3 -1000 1000 /end CHARACTERISTIC
/begin CHARACTERISTIC TO_SFNACHADA_STADA_B "Offset auf SF-Puls nach Adaption" VALUE 0x1D76E2 ZF_kw_si8_S5_S3 2000 UMR_MSEC__10_1_0_S5_S3 -1000 1000 /end CHARACTERISTIC
/begin CHARACTERISTIC TO_SFNACHADA_STADA_C "Offset auf SF-Puls nach Adaption" VALUE 0x1D76E9 ZF_kw_si8_S5_S3 2000 UMR_MSEC__10_1_0_S5_S3 -1000 1000 /end CHARACTERISTIC
/begin CHARACTERISTIC TO_SFNACHADA_STADA_D "Offset auf SF-Puls nach Adaption" VALUE 0x1D76F0 ZF_kw_si8_S5_S3 2000 UMR_MSEC__10_1_0_S5_S3 -1000 1000 /end CHARACTERISTIC
/begin CHARACTERISTIC TO_SFNACHADA_STADA_E "Offset auf SF-Puls nach Adaption" VALUE 0x1D76F7 ZF_kw_si8_S5_S3 2000 UMR_MSEC__10_1_0_S5_S3 -1000 1000 /end CHARACTERISTIC
/begin CHARACTERISTIC TO_SFNACHADA_STADA_K0 "Offset auf SF-Puls nach Adaption" VALUE 0x1D76FE ZF_kw_si8_S5_S3 2000 UMR_MSEC__10_1_0_S5_S3 -1000 1000 /end CHARACTERISTIC
/begin CHARACTERISTIC TO_SFRED_STADA_A "Offset zur TSF Reduktion während PF Prüfpuls" VALUE 0x1D81EE ZF_kw_si16_S5_S3 2000 UMR_MSEC__1_1_0_S5_S3 -1000 1000 /end CHARACTERISTIC
/begin CHARACTERISTIC TO_SFRED_STADA_B "Offset zur TSF Reduktion während PF Prüfpuls" VALUE 0x1D81F4 ZF_kw_si16_S5_S3 2000 UMR_MSEC__1_1_0_S5_S3 -1000 1000 /end CHARACTERISTIC
/begin CHARACTERISTIC TO_SFRED_STADA_C "Offset zur TSF Reduktion während PF Prüfpuls" VALUE 0x1D81FA ZF_kw_si16_S5_S3 2000 UMR_MSEC__1_1_0_S5_S3 -1000 1000 /end CHARACTERISTIC
/begin CHARACTERISTIC TO_SFRED_STADA_D "Offset zur TSF Reduktion während PF Prüfpuls" VALUE 0x1D8200 ZF_kw_si16_S5_S3 2000 UMR_MSEC__1_1_0_S5_S3 -1000 1000 /end CHARACTERISTIC
/begin CHARACTERISTIC TO_SFRED_STADA_E "Offset zur TSF Reduktion während PF Prüfpuls" VALUE 0x1D8206 ZF_kw_si16_S5_S3 2000 UMR_MSEC__1_1_0_S5_S3 -1000 1000 /end CHARACTERISTIC
/begin CHARACTERISTIC TO_SFRED_STADA_K0 "Offset zur TSF Reduktion während PF Prüfpuls" VALUE 0x1D820C ZF_kw_si16_S5_S3 2000 UMR_MSEC__1_1_0_S5_S3 -1000 1000 /end CHARACTERISTIC
/begin CHARACTERISTIC TO_SFVORADA_A "Offset auf SF-Puls bei 1.Puls" VALUE 0x1D8286 ZF_kw_si16_S5_S3 2000 UMR_MSEC__1_1_0_S5_S3 -1000 1000 /end CHARACTERISTIC
/begin CHARACTERISTIC TO_SFVORADA_STADA_A "Offset auf SF-Puls bei 1.Puls" VALUE 0x1D81EA ZF_kw_si16_S5_S3 2000 UMR_MSEC__1_1_0_S5_S3 -1000 1000 /end CHARACTERISTIC
/begin CHARACTERISTIC TO_SFVORADA_STADA_B "Offset auf SF-Puls bei 1.Puls" VALUE 0x1D81F0 ZF_kw_si16_S5_S3 2000 UMR_MSEC__1_1_0_S5_S3 -1000 1000 /end CHARACTERISTIC
/begin CHARACTERISTIC TO_SFVORADA_STADA_C "Offset auf SF-Puls bei 1.Puls" VALUE 0x1D81F6 ZF_kw_si16_S5_S3 2000 UMR_MSEC__1_1_0_S5_S3 -1000 1000 /end CHARACTERISTIC
/begin CHARACTERISTIC TO_SFVORADA_STADA_D "Offset auf SF-Puls bei 1.Puls" VALUE 0x1D81FC ZF_kw_si16_S5_S3 2000 UMR_MSEC__1_1_0_S5_S3 -1000 1000 /end CHARACTERISTIC
/begin CHARACTERISTIC TO_SFVORADA_STADA_E "Offset auf SF-Puls bei 1.Puls" VALUE 0x1D8202 ZF_kw_si16_S5_S3 2000 UMR_MSEC__1_1_0_S5_S3 -1000 1000 /end CHARACTERISTIC
/begin CHARACTERISTIC TO_SFVORADA_STADA_K0 "Offset auf SF-Puls bei 1.Puls" VALUE 0x1D8208 ZF_kw_si16_S5_S3 2000 UMR_MSEC__1_1_0_S5_S3 -1000 1000 /end CHARACTERISTIC
/begin CHARACTERISTIC TS_LLPRUEF_APERK_IAE "Verweildauer zur Beurteilung innerhalb Motor-Pruefung (IAE-Ada)" VALUE 0x1D8180 ZF_kw_ui16_S5_S3 9990 UMR_MSEC__10_1_0_S5_S3 10 10000 /end CHARACTERISTIC
/begin CHARACTERISTIC TS_LOCK "Schwelle fuer Timer: AdaK0.Timer.Lock (Puls-Ada K0 Lock)" VALUE 0x1D7690 ZF_kw_ui8_S5_S3 250 UMR_SEC__1_1_0_S5_S3 0 250 /end CHARACTERISTIC
/begin CHARACTERISTIC TS_MAX_INIT_STADA "Zeitschwelle fuer Maxzeit im Zustand Initialisierung" VALUE 0x1D770B ZF_kw_ui8_S5_S3 100 UMR_SEC__1_1_0_S5_S3 0 100 /end CHARACTERISTIC
/begin CHARACTERISTIC TS_MAX_LOCK "Schwelle fuer Timer: AdaK0.Timer.Maxlock (Puls-Ada K0 Lock)" VALUE 0x1D8134 ZF_kw_ui16_S5_S3 10000 UMR___1_1_0_S5_S3 0 10000 /end CHARACTERISTIC
/begin CHARACTERISTIC TS_NMOTLEERSOLL_AKTIV_STADA "Zeitschwelle für Start Pulsausgabe nach Leerlaufdrehzahlanhebung" VALUE 0x1D821E ZF_kw_ui16_S5_S3 10000 UMR_MSEC__10_1_0_S5_S3 0 10000 /end CHARACTERISTIC
/begin CHARACTERISTIC TS_PRUEFEN_APERK_IAE "Maximale Verweilzeit im Zustand EINSTIEG_PRUEFEN" VALUE 0x1D8156 ZF_kw_ui16_S5_S3 9990 UMR_MSEC__10_1_0_S5_S3 10 10000 /end CHARACTERISTIC
/begin CHARACTERISTIC T_FNGABADA "Filterzeit Gradientenfilter Abtriebsdrehzahl" VALUE 0x1D8186 ZF_kw_ui16_S5_S3 1000 UMR_MSEC__1_1_0_S5_S3 0 1000 /end CHARACTERISTIC
/begin CHARACTERISTIC T_HALTE_M_ANGELEGT_APERK_IAE "Haltedauer der Teilerkennung. Warten auf Momentenerkennung" VALUE 0x1D814E ZF_kw_ui16_S5_S3 1000 UMR_MSEC__10_1_0_S5_S3 0 1000 /end CHARACTERISTIC
/begin CHARACTERISTIC T_HALTE_N_ANGELEGT_APERK_IAE "Haltedauer der Teilerkennung.Warten auf Drehzahlerkennung" VALUE 0x1D8150 ZF_kw_ui16_S5_S3 10000 UMR_MSEC__10_1_0_S5_S3 0 10000 /end CHARACTERISTIC
/begin CHARACTERISTIC T_HALTE_RAMPENINIT_APERK_IAE "Zeit der konstanten Ansteuerung wahrend Zustand -Prueframpe-" VALUE 0x1D8152 ZF_kw_ui16_S5_S3 60000 UMR_MSEC__10_1_0_S5_S3 0 60000 /end CHARACTERISTIC
/begin CHARACTERISTIC T_HYSSCHLEIFE_APERK_IAE "Dauer der Hysschleife im Fall ANGELEGT" VALUE 0x1D8154 ZF_kw_ui16_S5_S3 60000 UMR_MSEC__10_1_0_S5_S3 0 60000 /end CHARACTERISTIC
/begin CHARACTERISTIC T_MAXWARTEN_APERK_IAE "maximale Dauer der Signalprüfung vor Beginn der APERK" VALUE 0x1D814C ZF_kw_ui16_S5_S3 60000 UMR_MSEC__10_1_0_S5_S3 0 60000 /end CHARACTERISTIC
/begin CHARACTERISTIC T_PFPULS_A "Pulsdauer PF-Puls" VALUE 0x1D823E ZF_kw_ui16_S5_S3 2500 UMR_MSEC__10_1_0_S5_S3 0 2500 /end CHARACTERISTIC
/begin CHARACTERISTIC T_PFPULS_B "Pulsdauer PF-Puls" VALUE 0x1D824A ZF_kw_ui16_S5_S3 2500 UMR_MSEC__10_1_0_S5_S3 0 2500 /end CHARACTERISTIC
/begin CHARACTERISTIC T_PFPULS_C "Pulsdauer PF-Puls" VALUE 0x1D8256 ZF_kw_ui16_S5_S3 2500 UMR_MSEC__10_1_0_S5_S3 0 2500 /end CHARACTERISTIC
/begin CHARACTERISTIC T_PFPULS_D "Pulsdauer PF-Puls" VALUE 0x1D8262 ZF_kw_ui16_S5_S3 2500 UMR_MSEC__10_1_0_S5_S3 0 2500 /end CHARACTERISTIC
/begin CHARACTERISTIC T_PFPULS_E "Pulsdauer PF-Puls" VALUE 0x1D826E ZF_kw_ui16_S5_S3 2500 UMR_MSEC__10_1_0_S5_S3 0 2500 /end CHARACTERISTIC
/begin CHARACTERISTIC T_PFPULS_K0 "Pulsdauer PF-Puls" VALUE 0x1D827A ZF_kw_ui16_S5_S3 2500 UMR_MSEC__10_1_0_S5_S3 0 2500 /end CHARACTERISTIC
/begin CHARACTERISTIC T_PFPULS_STADA_A "Pulsdauer PF-Puls" VALUE 0x1D81AE ZF_kw_ui16_S5_S3 2550 UMR_MSEC__10_1_0_S5_S3 0 2550 /end CHARACTERISTIC
/begin CHARACTERISTIC T_PFPULS_STADA_B "Pulsdauer PF-Puls" VALUE 0x1D81B8 ZF_kw_ui16_S5_S3 2550 UMR_MSEC__10_1_0_S5_S3 0 2550 /end CHARACTERISTIC
/begin CHARACTERISTIC T_PFPULS_STADA_C "Pulsdauer PF-Puls" VALUE 0x1D81C2 ZF_kw_ui16_S5_S3 2550 UMR_MSEC__10_1_0_S5_S3 0 2550 /end CHARACTERISTIC
/begin CHARACTERISTIC T_PFPULS_STADA_D "Pulsdauer PF-Puls" VALUE 0x1D81CC ZF_kw_ui16_S5_S3 2550 UMR_MSEC__10_1_0_S5_S3 0 2550 /end CHARACTERISTIC
/begin CHARACTERISTIC T_PFPULS_STADA_E "Pulsdauer PF-Puls" VALUE 0x1D81D6 ZF_kw_ui16_S5_S3 2550 UMR_MSEC__10_1_0_S5_S3 0 2550 /end CHARACTERISTIC
/begin CHARACTERISTIC T_PFPULS_STADA_K0 "Pulsdauer PF-Puls" VALUE 0x1D81E0 ZF_kw_ui16_S5_S3 2550 UMR_MSEC__10_1_0_S5_S3 0 2550 /end CHARACTERISTIC
/begin CHARACTERISTIC T_RAINCTSF "Schrittweite fuer Rueckadaption" VALUE 0x1D8280 ZF_kw_si16_S5_S3 2000 UMR_MSEC__1_1_0_S5_S3 -2000 0 /end CHARACTERISTIC
/begin CHARACTERISTIC T_RAINCTSF_STADA "Schrittweite fuer Rueckadaption" VALUE 0x1D81E4 ZF_kw_si16_S5_S3 2000 UMR_MSEC__1_1_0_S5_S3 -2000 0 /end CHARACTERISTIC
/begin CHARACTERISTIC T_RAUEBINCTSF "Schrittweite Rueckadaption Ueberpruefschleife" VALUE 0x1D8284 ZF_kw_si16_S5_S3 2000 UMR_MSEC__1_1_0_S5_S3 -2000 0 /end CHARACTERISTIC
/begin CHARACTERISTIC T_RAUEBINCTSF_STADA "Schrittweite Rueckadaption Ueberpruefschleife" VALUE 0x1D81E8 ZF_kw_si16_S5_S3 2000 UMR_MSEC__1_1_0_S5_S3 -2000 0 /end CHARACTERISTIC
/begin CHARACTERISTIC T_RUN_LLPRUEF_APERK_IAE "Verweilsdauer in Motor-Pruefung (IAE-Ada)" VALUE 0x1D817C ZF_kw_ui16_S5_S3 9990 UMR_MSEC__10_1_0_S5_S3 10 10000 /end CHARACTERISTIC
/begin CHARACTERISTIC T_SFSTUFE_A "Zeitdauer Druckstufe nach SF-Puls" VALUE 0x1D772D ZF_kw_ui8_S5_S3 2550 UMR_MSEC__10_1_0_S5_S3 0 2550 /end CHARACTERISTIC
/begin CHARACTERISTIC T_SFSTUFE_STADA_A "Zeitdauer Druckstufe nach SF-Puls" VALUE 0x1D76DC ZF_kw_ui8_S5_S3 2500 UMR_MSEC__10_1_0_S5_S3 0 2500 /end CHARACTERISTIC
/begin CHARACTERISTIC T_SFSTUFE_STADA_B "Zeitdauer Druckstufe nach SF-Puls" VALUE 0x1D76E3 ZF_kw_ui8_S5_S3 2500 UMR_MSEC__10_1_0_S5_S3 0 2500 /end CHARACTERISTIC
/begin CHARACTERISTIC T_SFSTUFE_STADA_C "Zeitdauer Druckstufe nach SF-Puls" VALUE 0x1D76EA ZF_kw_ui8_S5_S3 2500 UMR_MSEC__10_1_0_S5_S3 0 2500 /end CHARACTERISTIC
/begin CHARACTERISTIC T_SFSTUFE_STADA_D "Zeitdauer Druckstufe nach SF-Puls" VALUE 0x1D76F1 ZF_kw_ui8_S5_S3 2500 UMR_MSEC__10_1_0_S5_S3 0 2500 /end CHARACTERISTIC
/begin CHARACTERISTIC T_SFSTUFE_STADA_E "Zeitdauer Druckstufe nach SF-Puls" VALUE 0x1D76F8 ZF_kw_ui8_S5_S3 2500 UMR_MSEC__10_1_0_S5_S3 0 2500 /end CHARACTERISTIC
/begin CHARACTERISTIC T_SFSTUFE_STADA_K0 "Zeitdauer Druckstufe nach SF-Puls" VALUE 0x1D76FF ZF_kw_ui8_S5_S3 2500 UMR_MSEC__10_1_0_S5_S3 0 2500 /end CHARACTERISTIC
/begin CHARACTERISTIC T_SPERR_APERK_IAE "Sperrzeit zum Start der Adaption bei IAE Stillstand" VALUE 0x1D8158 ZF_kw_ui16_S5_S3 10000 UMR_MSEC__10_1_0_S5_S3 0 10000 /end CHARACTERISTIC
/begin CHARACTERISTIC T_SPTSFPULS_STADA_A "Sperrzeit nach letzter Schaltung oder Pruefung" VALUE 0x1D8222 ZF_kw_ui16_S5_S3 2500 UMR_MSEC__10_1_0_S5_S3 0 2500 /end CHARACTERISTIC
/begin CHARACTERISTIC T_SPTSFPULS_STADA_B "Sperrzeit nach letzter Schaltung oder Pruefung" VALUE 0x1D8224 ZF_kw_ui16_S5_S3 2500 UMR_MSEC__10_1_0_S5_S3 0 2500 /end CHARACTERISTIC
/begin CHARACTERISTIC T_SPTSFPULS_STADA_C "Sperrzeit nach letzter Schaltung oder Pruefung" VALUE 0x1D8226 ZF_kw_ui16_S5_S3 2500 UMR_MSEC__10_1_0_S5_S3 0 2500 /end CHARACTERISTIC
/begin CHARACTERISTIC T_SPTSFPULS_STADA_D "Sperrzeit nach letzter Schaltung oder Pruefung" VALUE 0x1D8228 ZF_kw_ui16_S5_S3 2500 UMR_MSEC__10_1_0_S5_S3 0 2500 /end CHARACTERISTIC
/begin CHARACTERISTIC T_SPTSFPULS_STADA_E "Sperrzeit nach letzter Schaltung oder Pruefung" VALUE 0x1D822A ZF_kw_ui16_S5_S3 2500 UMR_MSEC__10_1_0_S5_S3 0 2500 /end CHARACTERISTIC
/begin CHARACTERISTIC T_SPTSFPULS_STADA_K0 "Sperrzeit nach letzter Schaltung oder Pruefung" VALUE 0x1D822C ZF_kw_ui16_S5_S3 2500 UMR_MSEC__10_1_0_S5_S3 0 2500 /end CHARACTERISTIC
/begin CHARACTERISTIC T_UEAMPPF_A "Zeitfenster f.Erkennung Amplitude" VALUE 0x1D7712 ZF_kw_ui8_S5_S3 2500 UMR_MSEC__10_1_0_S5_S3 0 2500 /end CHARACTERISTIC
/begin CHARACTERISTIC T_UEAMPPF_B "Zeitfenster f.Erkennung Amplitude" VALUE 0x1D7717 ZF_kw_ui8_S5_S3 2500 UMR_MSEC__10_1_0_S5_S3 0 2500 /end CHARACTERISTIC
/begin CHARACTERISTIC T_UEAMPPF_C "Zeitfenster f.Erkennung Amplitude" VALUE 0x1D771C ZF_kw_ui8_S5_S3 2500 UMR_MSEC__10_1_0_S5_S3 0 2500 /end CHARACTERISTIC
/begin CHARACTERISTIC T_UEAMPPF_D "Zeitfenster f.Erkennung Amplitude" VALUE 0x1D7721 ZF_kw_ui8_S5_S3 2500 UMR_MSEC__10_1_0_S5_S3 0 2500 /end CHARACTERISTIC
/begin CHARACTERISTIC T_UEAMPPF_E "Zeitfenster f.Erkennung Amplitude" VALUE 0x1D7726 ZF_kw_ui8_S5_S3 2500 UMR_MSEC__10_1_0_S5_S3 0 2500 /end CHARACTERISTIC
/begin CHARACTERISTIC T_UEAMPPF_K0 "Zeitfenster f.Erkennung Amplitude" VALUE 0x1D772B ZF_kw_ui8_S5_S3 2500 UMR_MSEC__10_1_0_S5_S3 0 2500 /end CHARACTERISTIC
/begin CHARACTERISTIC T_UEAMPPF_STADA_A "Zeitfenster f.Erkennung Amplitude" VALUE 0x1D76C1 ZF_kw_ui8_S5_S3 2500 UMR_MSEC__10_1_0_S5_S3 0 2500 /end CHARACTERISTIC
/begin CHARACTERISTIC T_UEAMPPF_STADA_B "Zeitfenster f.Erkennung Amplitude" VALUE 0x1D76C6 ZF_kw_ui8_S5_S3 2500 UMR_MSEC__10_1_0_S5_S3 0 2500 /end CHARACTERISTIC
/begin CHARACTERISTIC T_UEAMPPF_STADA_C "Zeitfenster f.Erkennung Amplitude" VALUE 0x1D76CB ZF_kw_ui8_S5_S3 2500 UMR_MSEC__10_1_0_S5_S3 0 2500 /end CHARACTERISTIC
/begin CHARACTERISTIC T_UEAMPPF_STADA_D "Zeitfenster f.Erkennung Amplitude" VALUE 0x1D76D0 ZF_kw_ui8_S5_S3 2500 UMR_MSEC__10_1_0_S5_S3 0 2500 /end CHARACTERISTIC
/begin CHARACTERISTIC T_UEAMPPF_STADA_E "Zeitfenster f.Erkennung Amplitude" VALUE 0x1D76D5 ZF_kw_ui8_S5_S3 2500 UMR_MSEC__10_1_0_S5_S3 0 2500 /end CHARACTERISTIC
/begin CHARACTERISTIC T_UEAMPPF_STADA_K0 "Zeitfenster f.Erkennung Amplitude" VALUE 0x1D76DA ZF_kw_ui8_S5_S3 2500 UMR_MSEC__10_1_0_S5_S3 0 2500 /end CHARACTERISTIC
/begin CHARACTERISTIC T_UEAMPTSF_A "Zeitfenster f.Erkennung Amplitude" VALUE 0x1D7732 ZF_kw_ui8_S5_S3 2500 UMR_MSEC__10_1_0_S5_S3 0 2500 /end CHARACTERISTIC
/begin CHARACTERISTIC T_UEAMPTSF_STADA_A "Zeitfenster f.Erkennung Amplitude" VALUE 0x1D76E1 ZF_kw_ui8_S5_S3 2500 UMR_MSEC__10_1_0_S5_S3 0 2500 /end CHARACTERISTIC
/begin CHARACTERISTIC T_UEAMPTSF_STADA_B "Zeitfenster f.Erkennung Amplitude" VALUE 0x1D76E8 ZF_kw_ui8_S5_S3 2500 UMR_MSEC__10_1_0_S5_S3 0 2500 /end CHARACTERISTIC
/begin CHARACTERISTIC T_UEAMPTSF_STADA_C "Zeitfenster f.Erkennung Amplitude" VALUE 0x1D76EF ZF_kw_ui8_S5_S3 2500 UMR_MSEC__10_1_0_S5_S3 0 2500 /end CHARACTERISTIC
/begin CHARACTERISTIC T_UEAMPTSF_STADA_D "Zeitfenster f.Erkennung Amplitude" VALUE 0x1D76F6 ZF_kw_ui8_S5_S3 2500 UMR_MSEC__10_1_0_S5_S3 0 2500 /end CHARACTERISTIC
/begin CHARACTERISTIC T_UEAMPTSF_STADA_E "Zeitfenster f.Erkennung Amplitude" VALUE 0x1D76FD ZF_kw_ui8_S5_S3 2500 UMR_MSEC__10_1_0_S5_S3 0 2500 /end CHARACTERISTIC
/begin CHARACTERISTIC T_UEAMPTSF_STADA_K0 "Zeitfenster f.Erkennung Amplitude" VALUE 0x1D7704 ZF_kw_ui8_S5_S3 2500 UMR_MSEC__10_1_0_S5_S3 0 2500 /end CHARACTERISTIC
/begin CHARACTERISTIC T_UEBEWNEGBPF_A "Start negatives Ueberwachungsfenster" VALUE 0x1D770E ZF_kw_ui8_S5_S3 2500 UMR_MSEC__10_1_0_S5_S3 0 2500 /end CHARACTERISTIC
/begin CHARACTERISTIC T_UEBEWNEGBPF_B "Start negatives Ueberwachungsfenster" VALUE 0x1D7713 ZF_kw_ui8_S5_S3 2500 UMR_MSEC__10_1_0_S5_S3 0 2500 /end CHARACTERISTIC
/begin CHARACTERISTIC T_UEBEWNEGBPF_C "Start negatives Ueberwachungsfenster" VALUE 0x1D7718 ZF_kw_ui8_S5_S3 2500 UMR_MSEC__10_1_0_S5_S3 0 2500 /end CHARACTERISTIC
/begin CHARACTERISTIC T_UEBEWNEGBPF_D "Start negatives Ueberwachungsfenster" VALUE 0x1D771D ZF_kw_ui8_S5_S3 2500 UMR_MSEC__10_1_0_S5_S3 0 2500 /end CHARACTERISTIC
/begin CHARACTERISTIC T_UEBEWNEGBPF_E "Start negatives Ueberwachungsfenster" VALUE 0x1D7722 ZF_kw_ui8_S5_S3 2500 UMR_MSEC__10_1_0_S5_S3 0 2500 /end CHARACTERISTIC
/begin CHARACTERISTIC T_UEBEWNEGBPF_K0 "Start negatives Ueberwachungsfenster" VALUE 0x1D7727 ZF_kw_ui8_S5_S3 2500 UMR_MSEC__10_1_0_S5_S3 0 2500 /end CHARACTERISTIC
/begin CHARACTERISTIC T_UEBEWNEGBPF_STADA_A "Start negatives Ueberwachungsfenster" VALUE 0x1D76BD ZF_kw_ui8_S5_S3 2500 UMR_MSEC__10_1_0_S5_S3 0 2500 /end CHARACTERISTIC
/begin CHARACTERISTIC T_UEBEWNEGBPF_STADA_B "Start negatives Ueberwachungsfenster" VALUE 0x1D76C2 ZF_kw_ui8_S5_S3 2500 UMR_MSEC__10_1_0_S5_S3 0 2500 /end CHARACTERISTIC
/begin CHARACTERISTIC T_UEBEWNEGBPF_STADA_C "Start negatives Ueberwachungsfenster" VALUE 0x1D76C7 ZF_kw_ui8_S5_S3 2500 UMR_MSEC__10_1_0_S5_S3 0 2500 /end CHARACTERISTIC
/begin CHARACTERISTIC T_UEBEWNEGBPF_STADA_D "Start negatives Ueberwachungsfenster" VALUE 0x1D76CC ZF_kw_ui8_S5_S3 2500 UMR_MSEC__10_1_0_S5_S3 0 2500 /end CHARACTERISTIC
/begin CHARACTERISTIC T_UEBEWNEGBPF_STADA_E "Start negatives Ueberwachungsfenster" VALUE 0x1D76D1 ZF_kw_ui8_S5_S3 2500 UMR_MSEC__10_1_0_S5_S3 0 2500 /end CHARACTERISTIC
/begin CHARACTERISTIC T_UEBEWNEGBPF_STADA_K0 "Start negatives Ueberwachungsfenster" VALUE 0x1D76D6 ZF_kw_ui8_S5_S3 2500 UMR_MSEC__10_1_0_S5_S3 0 2500 /end CHARACTERISTIC
/begin CHARACTERISTIC T_UEBEWNEGBTSF_A "Start negatives Ueberwachungsfenster" VALUE 0x1D772E ZF_kw_ui8_S5_S3 2500 UMR_MSEC__10_1_0_S5_S3 0 2500 /end CHARACTERISTIC
/begin CHARACTERISTIC T_UEBEWNEGBTSF_STADA_A "Start negatives Ueberwachungsfenster" VALUE 0x1D76DD ZF_kw_ui8_S5_S3 2550 UMR_MSEC__10_1_0_S5_S3 0 2550 /end CHARACTERISTIC
/begin CHARACTERISTIC T_UEBEWNEGBTSF_STADA_B "Start negatives Ueberwachungsfenster" VALUE 0x1D76E4 ZF_kw_ui8_S5_S3 2550 UMR_MSEC__10_1_0_S5_S3 0 2550 /end CHARACTERISTIC
/begin CHARACTERISTIC T_UEBEWNEGBTSF_STADA_C "Start negatives Ueberwachungsfenster" VALUE 0x1D76EB ZF_kw_ui8_S5_S3 2550 UMR_MSEC__10_1_0_S5_S3 0 2550 /end CHARACTERISTIC
/begin CHARACTERISTIC T_UEBEWNEGBTSF_STADA_D "Start negatives Ueberwachungsfenster" VALUE 0x1D76F2 ZF_kw_ui8_S5_S3 2550 UMR_MSEC__10_1_0_S5_S3 0 2550 /end CHARACTERISTIC
/begin CHARACTERISTIC T_UEBEWNEGBTSF_STADA_E "Start negatives Ueberwachungsfenster" VALUE 0x1D76F9 ZF_kw_ui8_S5_S3 2550 UMR_MSEC__10_1_0_S5_S3 0 2550 /end CHARACTERISTIC
/begin CHARACTERISTIC T_UEBEWNEGBTSF_STADA_K0 "Start negatives Ueberwachungsfenster" VALUE 0x1D7700 ZF_kw_ui8_S5_S3 2550 UMR_MSEC__10_1_0_S5_S3 0 2550 /end CHARACTERISTIC
/begin CHARACTERISTIC T_UEBEWNEGEPF_A "Ende negatives Ueberwachungsfenster" VALUE 0x1D770F ZF_kw_ui8_S5_S3 2500 UMR_MSEC__10_1_0_S5_S3 0 2500 /end CHARACTERISTIC
/begin CHARACTERISTIC T_UEBEWNEGEPF_B "Ende negatives Ueberwachungsfenster" VALUE 0x1D7714 ZF_kw_ui8_S5_S3 2500 UMR_MSEC__10_1_0_S5_S3 0 2500 /end CHARACTERISTIC
/begin CHARACTERISTIC T_UEBEWNEGEPF_C "Ende negatives Ueberwachungsfenster" VALUE 0x1D7719 ZF_kw_ui8_S5_S3 2500 UMR_MSEC__10_1_0_S5_S3 0 2500 /end CHARACTERISTIC
/begin CHARACTERISTIC T_UEBEWNEGEPF_D "Ende negatives Ueberwachungsfenster" VALUE 0x1D771E ZF_kw_ui8_S5_S3 2500 UMR_MSEC__10_1_0_S5_S3 0 2500 /end CHARACTERISTIC
/begin CHARACTERISTIC T_UEBEWNEGEPF_E "Ende negatives Ueberwachungsfenster" VALUE 0x1D7723 ZF_kw_ui8_S5_S3 2500 UMR_MSEC__10_1_0_S5_S3 0 2500 /end CHARACTERISTIC
/begin CHARACTERISTIC T_UEBEWNEGEPF_K0 "Ende negatives Ueberwachungsfenster" VALUE 0x1D7728 ZF_kw_ui8_S5_S3 2500 UMR_MSEC__10_1_0_S5_S3 0 2500 /end CHARACTERISTIC
/begin CHARACTERISTIC T_UEBEWNEGEPF_STADA_A "Ende negatives Ueberwachungsfenster" VALUE 0x1D76BE ZF_kw_ui8_S5_S3 2500 UMR_MSEC__10_1_0_S5_S3 0 2500 /end CHARACTERISTIC
/begin CHARACTERISTIC T_UEBEWNEGEPF_STADA_B "Ende negatives Ueberwachungsfenster" VALUE 0x1D76C3 ZF_kw_ui8_S5_S3 2500 UMR_MSEC__10_1_0_S5_S3 0 2500 /end CHARACTERISTIC
/begin CHARACTERISTIC T_UEBEWNEGEPF_STADA_C "Ende negatives Ueberwachungsfenster" VALUE 0x1D76C8 ZF_kw_ui8_S5_S3 2500 UMR_MSEC__10_1_0_S5_S3 0 2500 /end CHARACTERISTIC
/begin CHARACTERISTIC T_UEBEWNEGEPF_STADA_D "Ende negatives Ueberwachungsfenster" VALUE 0x1D76CD ZF_kw_ui8_S5_S3 2500 UMR_MSEC__10_1_0_S5_S3 0 2500 /end CHARACTERISTIC
/begin CHARACTERISTIC T_UEBEWNEGEPF_STADA_E "Ende negatives Ueberwachungsfenster" VALUE 0x1D76D2 ZF_kw_ui8_S5_S3 2500 UMR_MSEC__10_1_0_S5_S3 0 2500 /end CHARACTERISTIC
/begin CHARACTERISTIC T_UEBEWNEGEPF_STADA_K0 "Ende negatives Ueberwachungsfenster" VALUE 0x1D76D7 ZF_kw_ui8_S5_S3 2500 UMR_MSEC__10_1_0_S5_S3 0 2500 /end CHARACTERISTIC
/begin CHARACTERISTIC T_UEBEWNEGETSF_A "Ende negatives Ueberwachungsfenster" VALUE 0x1D772F ZF_kw_ui8_S5_S3 2500 UMR_MSEC__10_1_0_S5_S3 0 2500 /end CHARACTERISTIC
/begin CHARACTERISTIC T_UEBEWNEGETSF_STADA_A "Ende negatives Ueberwachungsfenster" VALUE 0x1D76DE ZF_kw_ui8_S5_S3 2550 UMR_MSEC__10_1_0_S5_S3 0 2550 /end CHARACTERISTIC
/begin CHARACTERISTIC T_UEBEWNEGETSF_STADA_B "Ende negatives Ueberwachungsfenster" VALUE 0x1D76E5 ZF_kw_ui8_S5_S3 2550 UMR_MSEC__10_1_0_S5_S3 0 2550 /end CHARACTERISTIC
/begin CHARACTERISTIC T_UEBEWNEGETSF_STADA_C "Ende negatives Ueberwachungsfenster" VALUE 0x1D76EC ZF_kw_ui8_S5_S3 2550 UMR_MSEC__10_1_0_S5_S3 0 2550 /end CHARACTERISTIC
/begin CHARACTERISTIC T_UEBEWNEGETSF_STADA_D "Ende negatives Ueberwachungsfenster" VALUE 0x1D76F3 ZF_kw_ui8_S5_S3 2550 UMR_MSEC__10_1_0_S5_S3 0 2550 /end CHARACTERISTIC
/begin CHARACTERISTIC T_UEBEWNEGETSF_STADA_E "Ende negatives Ueberwachungsfenster" VALUE 0x1D76FA ZF_kw_ui8_S5_S3 2550 UMR_MSEC__10_1_0_S5_S3 0 2550 /end CHARACTERISTIC
/begin CHARACTERISTIC T_UEBEWNEGETSF_STADA_K0 "Ende negatives Ueberwachungsfenster" VALUE 0x1D7701 ZF_kw_ui8_S5_S3 2550 UMR_MSEC__10_1_0_S5_S3 0 2550 /end CHARACTERISTIC
/begin CHARACTERISTIC T_UEBEWPOSBPF_A "Start positives Ueberwachungsfenster" VALUE 0x1D7710 ZF_kw_ui8_S5_S3 2500 UMR_MSEC__10_1_0_S5_S3 0 2500 /end CHARACTERISTIC
/begin CHARACTERISTIC T_UEBEWPOSBPF_B "Start positives Ueberwachungsfenster" VALUE 0x1D7715 ZF_kw_ui8_S5_S3 2500 UMR_MSEC__10_1_0_S5_S3 0 2500 /end CHARACTERISTIC
/begin CHARACTERISTIC T_UEBEWPOSBPF_C "Start positives Ueberwachungsfenster" VALUE 0x1D771A ZF_kw_ui8_S5_S3 2500 UMR_MSEC__10_1_0_S5_S3 0 2500 /end CHARACTERISTIC
/begin CHARACTERISTIC T_UEBEWPOSBPF_D "Start positives Ueberwachungsfenster" VALUE 0x1D771F ZF_kw_ui8_S5_S3 2500 UMR_MSEC__10_1_0_S5_S3 0 2500 /end CHARACTERISTIC
/begin CHARACTERISTIC T_UEBEWPOSBPF_E "Start positives Ueberwachungsfenster" VALUE 0x1D7724 ZF_kw_ui8_S5_S3 2500 UMR_MSEC__10_1_0_S5_S3 0 2500 /end CHARACTERISTIC
/begin CHARACTERISTIC T_UEBEWPOSBPF_K0 "Start positives Ueberwachungsfenster" VALUE 0x1D7729 ZF_kw_ui8_S5_S3 2500 UMR_MSEC__10_1_0_S5_S3 0 2500 /end CHARACTERISTIC
/begin CHARACTERISTIC T_UEBEWPOSBPF_STADA_A "Start positives Ueberwachungsfenster" VALUE 0x1D76BF ZF_kw_ui8_S5_S3 2500 UMR_MSEC__10_1_0_S5_S3 0 2500 /end CHARACTERISTIC
/begin CHARACTERISTIC T_UEBEWPOSBPF_STADA_B "Start positives Ueberwachungsfenster" VALUE 0x1D76C4 ZF_kw_ui8_S5_S3 2500 UMR_MSEC__10_1_0_S5_S3 0 2500 /end CHARACTERISTIC
/begin CHARACTERISTIC T_UEBEWPOSBPF_STADA_C "Start positives Ueberwachungsfenster" VALUE 0x1D76C9 ZF_kw_ui8_S5_S3 2500 UMR_MSEC__10_1_0_S5_S3 0 2500 /end CHARACTERISTIC
/begin CHARACTERISTIC T_UEBEWPOSBPF_STADA_D "Start positives Ueberwachungsfenster" VALUE 0x1D76CE ZF_kw_ui8_S5_S3 2500 UMR_MSEC__10_1_0_S5_S3 0 2500 /end CHARACTERISTIC
/begin CHARACTERISTIC T_UEBEWPOSBPF_STADA_E "Start positives Ueberwachungsfenster" VALUE 0x1D76D3 ZF_kw_ui8_S5_S3 2500 UMR_MSEC__10_1_0_S5_S3 0 2500 /end CHARACTERISTIC
/begin CHARACTERISTIC T_UEBEWPOSBPF_STADA_K0 "Start positives Ueberwachungsfenster" VALUE 0x1D76D8 ZF_kw_ui8_S5_S3 2500 UMR_MSEC__10_1_0_S5_S3 0 2500 /end CHARACTERISTIC
/begin CHARACTERISTIC T_UEBEWPOSBTSF_A "Start positives Ueberwachungsfenster" VALUE 0x1D7730 ZF_kw_ui8_S5_S3 2500 UMR_MSEC__10_1_0_S5_S3 0 2500 /end CHARACTERISTIC
/begin CHARACTERISTIC T_UEBEWPOSBTSF_STADA_A "Start positives Ueberwachungsfenster" VALUE 0x1D76DF ZF_kw_ui8_S5_S3 2500 UMR_MSEC__10_1_0_S5_S3 0 2500 /end CHARACTERISTIC
/begin CHARACTERISTIC T_UEBEWPOSBTSF_STADA_B "Start positives Ueberwachungsfenster" VALUE 0x1D76E6 ZF_kw_ui8_S5_S3 2500 UMR_MSEC__10_1_0_S5_S3 0 2500 /end CHARACTERISTIC
/begin CHARACTERISTIC T_UEBEWPOSBTSF_STADA_C "Start positives Ueberwachungsfenster" VALUE 0x1D76ED ZF_kw_ui8_S5_S3 2500 UMR_MSEC__10_1_0_S5_S3 0 2500 /end CHARACTERISTIC
/begin CHARACTERISTIC T_UEBEWPOSBTSF_STADA_D "Start positives Ueberwachungsfenster" VALUE 0x1D76F4 ZF_kw_ui8_S5_S3 2500 UMR_MSEC__10_1_0_S5_S3 0 2500 /end CHARACTERISTIC
/begin CHARACTERISTIC T_UEBEWPOSBTSF_STADA_E "Start positives Ueberwachungsfenster" VALUE 0x1D76FB ZF_kw_ui8_S5_S3 2500 UMR_MSEC__10_1_0_S5_S3 0 2500 /end CHARACTERISTIC
/begin CHARACTERISTIC T_UEBEWPOSBTSF_STADA_K0 "Start positives Ueberwachungsfenster" VALUE 0x1D7702 ZF_kw_ui8_S5_S3 2500 UMR_MSEC__10_1_0_S5_S3 0 2500 /end CHARACTERISTIC
/begin CHARACTERISTIC T_UEBEWPOSEPF_A "Ende positives Ueberwachungsfenster" VALUE 0x1D7711 ZF_kw_ui8_S5_S3 2500 UMR_MSEC__10_1_0_S5_S3 0 2500 /end CHARACTERISTIC
/begin CHARACTERISTIC T_UEBEWPOSEPF_B "Ende positives Ueberwachungsfenster" VALUE 0x1D7716 ZF_kw_ui8_S5_S3 2500 UMR_MSEC__10_1_0_S5_S3 0 2500 /end CHARACTERISTIC
/begin CHARACTERISTIC T_UEBEWPOSEPF_C "Ende positives Ueberwachungsfenster" VALUE 0x1D771B ZF_kw_ui8_S5_S3 2500 UMR_MSEC__10_1_0_S5_S3 0 2500 /end CHARACTERISTIC
/begin CHARACTERISTIC T_UEBEWPOSEPF_D "Ende positives Ueberwachungsfenster" VALUE 0x1D7720 ZF_kw_ui8_S5_S3 2500 UMR_MSEC__10_1_0_S5_S3 0 2500 /end CHARACTERISTIC
/begin CHARACTERISTIC T_UEBEWPOSEPF_E "Ende positives Ueberwachungsfenster" VALUE 0x1D7725 ZF_kw_ui8_S5_S3 2500 UMR_MSEC__10_1_0_S5_S3 0 2500 /end CHARACTERISTIC
/begin CHARACTERISTIC T_UEBEWPOSEPF_K0 "Ende positives Ueberwachungsfenster" VALUE 0x1D772A ZF_kw_ui8_S5_S3 2500 UMR_MSEC__10_1_0_S5_S3 0 2500 /end CHARACTERISTIC
/begin CHARACTERISTIC T_UEBEWPOSEPF_STADA_A "Ende positives Ueberwachungsfenster" VALUE 0x1D76C0 ZF_kw_ui8_S5_S3 2500 UMR_MSEC__10_1_0_S5_S3 0 2500 /end CHARACTERISTIC
/begin CHARACTERISTIC T_UEBEWPOSEPF_STADA_B "Ende positives Ueberwachungsfenster" VALUE 0x1D76C5 ZF_kw_ui8_S5_S3 2500 UMR_MSEC__10_1_0_S5_S3 0 2500 /end CHARACTERISTIC
/begin CHARACTERISTIC T_UEBEWPOSEPF_STADA_C "Ende positives Ueberwachungsfenster" VALUE 0x1D76CA ZF_kw_ui8_S5_S3 2500 UMR_MSEC__10_1_0_S5_S3 0 2500 /end CHARACTERISTIC
/begin CHARACTERISTIC T_UEBEWPOSEPF_STADA_D "Ende positives Ueberwachungsfenster" VALUE 0x1D76CF ZF_kw_ui8_S5_S3 2500 UMR_MSEC__10_1_0_S5_S3 0 2500 /end CHARACTERISTIC
/begin CHARACTERISTIC T_UEBEWPOSEPF_STADA_E "Ende positives Ueberwachungsfenster" VALUE 0x1D76D4 ZF_kw_ui8_S5_S3 2500 UMR_MSEC__10_1_0_S5_S3 0 2500 /end CHARACTERISTIC
/begin CHARACTERISTIC T_UEBEWPOSEPF_STADA_K0 "Ende positives Ueberwachungsfenster" VALUE 0x1D76D9 ZF_kw_ui8_S5_S3 2500 UMR_MSEC__10_1_0_S5_S3 0 2500 /end CHARACTERISTIC
/begin CHARACTERISTIC T_UEBEWPOSETSF_A "Ende positives Ueberwachungsfenster" VALUE 0x1D7731 ZF_kw_ui8_S5_S3 2500 UMR_MSEC__10_1_0_S5_S3 0 2500 /end CHARACTERISTIC
/begin CHARACTERISTIC T_UEBEWPOSETSF_STADA_A "Ende positives Ueberwachungsfenster" VALUE 0x1D76E0 ZF_kw_ui8_S5_S3 2500 UMR_MSEC__10_1_0_S5_S3 0 2500 /end CHARACTERISTIC
/begin CHARACTERISTIC T_UEBEWPOSETSF_STADA_B "Ende positives Ueberwachungsfenster" VALUE 0x1D76E7 ZF_kw_ui8_S5_S3 2500 UMR_MSEC__10_1_0_S5_S3 0 2500 /end CHARACTERISTIC
/begin CHARACTERISTIC T_UEBEWPOSETSF_STADA_C "Ende positives Ueberwachungsfenster" VALUE 0x1D76EE ZF_kw_ui8_S5_S3 2500 UMR_MSEC__10_1_0_S5_S3 0 2500 /end CHARACTERISTIC
/begin CHARACTERISTIC T_UEBEWPOSETSF_STADA_D "Ende positives Ueberwachungsfenster" VALUE 0x1D76F5 ZF_kw_ui8_S5_S3 2500 UMR_MSEC__10_1_0_S5_S3 0 2500 /end CHARACTERISTIC
/begin CHARACTERISTIC T_UEBEWPOSETSF_STADA_E "Ende positives Ueberwachungsfenster" VALUE 0x1D76FC ZF_kw_ui8_S5_S3 2500 UMR_MSEC__10_1_0_S5_S3 0 2500 /end CHARACTERISTIC
/begin CHARACTERISTIC T_UEBEWPOSETSF_STADA_K0 "Ende positives Ueberwachungsfenster" VALUE 0x1D7703 ZF_kw_ui8_S5_S3 2500 UMR_MSEC__10_1_0_S5_S3 0 2500 /end CHARACTERISTIC
/begin CHARACTERISTIC T_UEF_ABSENK_APERK_IAE "Dauer der Überführungsphase in ABSENKEN" VALUE 0x1D769E ZF_kw_ui8_S5_S3 1000 UMR_MSEC__10_1_0_S5_S3 0 1000 /end CHARACTERISTIC
/begin CHARACTERISTIC T_UEF_ABSENK_START_APERK_IAE "Dauer der Ueberführungsphase zum ABSENKEN" VALUE 0x1D769F ZF_kw_ui8_S5_S3 1000 UMR_MSEC__10_1_0_S5_S3 0 1000 /end CHARACTERISTIC
/begin CHARACTERISTIC T_VPFADHS12 "Verzoegerungszeit Bewertung Schaltung xy" VALUE 0x1D76B4 ZF_kw_ui8_S5_S3 1000 UMR_MSEC__10_1_0_S5_S3 0 1000 /end CHARACTERISTIC
/begin CHARACTERISTIC T_VPFADHS23 "Verzoegerungszeit Bewertung Schaltung xy" VALUE 0x1D76B5 ZF_kw_ui8_S5_S3 1000 UMR_MSEC__10_1_0_S5_S3 0 1000 /end CHARACTERISTIC
/begin CHARACTERISTIC T_VPFADHS34 "Verzoegerungszeit Bewertung Schaltung xy" VALUE 0x1D76B6 ZF_kw_ui8_S5_S3 1000 UMR_MSEC__10_1_0_S5_S3 0 1000 /end CHARACTERISTIC
/begin CHARACTERISTIC T_VPFADHS45 "Verzoegerungszeit Bewertung Schaltung xy" VALUE 0x1D76B7 ZF_kw_ui8_S5_S3 1000 UMR_MSEC__10_1_0_S5_S3 0 1000 /end CHARACTERISTIC
/begin CHARACTERISTIC T_VPFADHS56 "Verzoegerungszeit Bewertung Schaltung xy" VALUE 0x1D76B8 ZF_kw_ui8_S5_S3 1000 UMR_MSEC__10_1_0_S5_S3 0 1000 /end CHARACTERISTIC
/begin CHARACTERISTIC T_VPFADHS67 "Verzoegerungszeit Bewertung Schaltung xy" VALUE 0x1D76B9 ZF_kw_ui8_S5_S3 1000 UMR_MSEC__10_1_0_S5_S3 0 1000 /end CHARACTERISTIC
/begin CHARACTERISTIC T_VPFADHS78 "Verzoegerungszeit Bewertung Schaltung xy" VALUE 0x1D76BA ZF_kw_ui8_S5_S3 1000 UMR_MSEC__10_1_0_S5_S3 0 1000 /end CHARACTERISTIC
/begin CHARACTERISTIC T_VPFPULS_A "Verzoegerungszeit fuer PF-Puls" VALUE 0x1D8240 ZF_kw_ui16_S5_S3 2500 UMR_MSEC__10_1_0_S5_S3 0 2500 /end CHARACTERISTIC
/begin CHARACTERISTIC T_VPFPULS_B "Verzoegerungszeit fuer PF-Puls" VALUE 0x1D824C ZF_kw_ui16_S5_S3 2500 UMR_MSEC__10_1_0_S5_S3 0 2500 /end CHARACTERISTIC
/begin CHARACTERISTIC T_VPFPULS_C "Verzoegerungszeit fuer PF-Puls" VALUE 0x1D8258 ZF_kw_ui16_S5_S3 2500 UMR_MSEC__10_1_0_S5_S3 0 2500 /end CHARACTERISTIC
/begin CHARACTERISTIC T_VPFPULS_D "Verzoegerungszeit fuer PF-Puls" VALUE 0x1D8264 ZF_kw_ui16_S5_S3 2500 UMR_MSEC__10_1_0_S5_S3 0 2500 /end CHARACTERISTIC
/begin CHARACTERISTIC T_VPFPULS_E "Verzoegerungszeit fuer PF-Puls" VALUE 0x1D8270 ZF_kw_ui16_S5_S3 2500 UMR_MSEC__10_1_0_S5_S3 0 2500 /end CHARACTERISTIC
/begin CHARACTERISTIC T_VPFPULS_K0 "Verzoegerungszeit fuer PF-Puls" VALUE 0x1D827C ZF_kw_ui16_S5_S3 2500 UMR_MSEC__10_1_0_S5_S3 0 2500 /end CHARACTERISTIC
/begin CHARACTERISTIC T_VPFPULS_STADA_A "Verzoegerungszeit fuer PF-Puls" VALUE 0x1D81A8 ZF_kw_ui16_S5_S3 2500 UMR_MSEC__10_1_0_S5_S3 0 2500 /end CHARACTERISTIC
/begin CHARACTERISTIC T_VPFPULS_STADA_B "Verzoegerungszeit fuer PF-Puls" VALUE 0x1D81B2 ZF_kw_ui16_S5_S3 2500 UMR_MSEC__10_1_0_S5_S3 0 2500 /end CHARACTERISTIC
/begin CHARACTERISTIC T_VPFPULS_STADA_C "Verzoegerungszeit fuer PF-Puls" VALUE 0x1D81BC ZF_kw_ui16_S5_S3 2500 UMR_MSEC__10_1_0_S5_S3 0 2500 /end CHARACTERISTIC
/begin CHARACTERISTIC T_VPFPULS_STADA_D "Verzoegerungszeit fuer PF-Puls" VALUE 0x1D81C6 ZF_kw_ui16_S5_S3 2500 UMR_MSEC__10_1_0_S5_S3 0 2500 /end CHARACTERISTIC
/begin CHARACTERISTIC T_VPFPULS_STADA_E "Verzoegerungszeit fuer PF-Puls" VALUE 0x1D81D0 ZF_kw_ui16_S5_S3 2500 UMR_MSEC__10_1_0_S5_S3 0 2500 /end CHARACTERISTIC
/begin CHARACTERISTIC T_VPFPULS_STADA_K0 "Verzoegerungszeit fuer PF-Puls" VALUE 0x1D81DA ZF_kw_ui16_S5_S3 2500 UMR_MSEC__10_1_0_S5_S3 0 2500 /end CHARACTERISTIC
/begin CHARACTERISTIC T_VPSYSPULS_STADA "Wartezeit für Systemdruckanhebung vor Puls" VALUE 0x1D770A ZF_kw_ui8_S5_S3 1000 UMR_MSEC__10_1_0_S5_S3 0 1000 /end CHARACTERISTIC
/begin CHARACTERISTIC T_WAIT_LLPRUEF_APERK_IAE "Wartedauer vor Motor-Pruefung (IAE-Ada)" VALUE 0x1D817E ZF_kw_ui16_S5_S3 9990 UMR_MSEC__10_1_0_S5_S3 10 10000 /end CHARACTERISTIC
/begin CHARACTERISTIC T_WARTEN_APERK_IAE "Dauer der Signalprüfung vor Beginn der APERK" VALUE 0x1D814A ZF_kw_ui16_S5_S3 60000 UMR_MSEC__10_1_0_S5_S3 0 60000 /end CHARACTERISTIC
/begin CHARACTERISTIC T_ZWTSFINC "Schrittweite fuer Zwangsrueckadaption" VALUE 0x1D8282 ZF_kw_si16_S5_S3 2000 UMR_MSEC__1_1_0_S5_S3 -2000 0 /end CHARACTERISTIC
/begin CHARACTERISTIC T_ZWTSFINC_STADA "Schrittweite fuer Zwangsrueckadaption" VALUE 0x1D81E6 ZF_kw_si16_S5_S3 2000 UMR_MSEC__1_1_0_S5_S3 -2000 0 /end CHARACTERISTIC
/begin CHARACTERISTIC VPS_MAX_KUEHL_APERK_IAE "Max-Schwelle der B-Kuehlung zum Start der IAE-Ada" VALUE 0x1D817A ZF_kw_si16_S5_S3 30 UMR_LITER_MIN_1_10_0_S5_S3 0 30 /end CHARACTERISTIC
/begin CHARACTERISTIC ZIELGANG_APERK_IAE "IAE-APADA darf nur in diesem Gang durchgeführt werden" VALUE 0x1D769A ZF_kw_si8_S5_S3 9 UMR___1_1_0_S5_S3 -1 8 /end CHARACTERISTIC
/begin FUNCTION Funktionskomponenten.cSignale "cSignale"
 /begin IN_MEASUREMENT zff_atsys._.iSignale._.obj.sig_c_getr zff_atsys._.iSignale._.obj.sig_c_getr_fl32 zff_atsys._.iSignale._.obj.sig_c_mot zff_atsys._.iSignale._.obj.sig_dki zff_atsys._.iSignale._.obj.sig_dki_fl32 zff_atsys._.iSignale._.obj.sig_dki_mmotsoll zff_atsys._.iSignale._.obj.sig_dki_mmotsoll_fl32 zff_atsys._.iSignale._.obj.sig_e_fahren zff_atsys._.iSignale._.obj.sig_index_sp_sps zff_atsys._.iSignale._.obj.sig_istgang zff_atsys._.iSignale._.obj.sig_istgang_idx zff_atsys._.iSignale._.obj.sig_istgang_vorw zff_atsys._.iSignale._.obj.sig_kfl_ist zff_atsys._.iSignale._.obj.sig_kfl_ziel zff_atsys._.iSignale._.obj.sig_m_t zff_atsys._.iSignale._.obj.sig_m_t8 zff_atsys._.iSignale._.obj.sig_n_ab zff_atsys._.iSignale._.obj.sig_n_ab8 zff_atsys._.iSignale._.obj.sig_n_mot zff_atsys._.iSignale._.obj.sig_n_mot8 zff_atsys._.iSignale._.obj.sig_n_t zff_atsys._.iSignale._.obj.sig_n_t8 zff_atsys._.iSignale._.obj.sig_neigung_iae zff_atsys._.iSignale._.obj.sig_serapflag zff_atsys._.iSignale._.obj.sig_serapflag_komp zff_atsys._.iSignale._.obj.sig_zielgang zff_atsys._.iSignale._.obj.sig_zielgang_idx zff_atsys._.iSignale._.obj.sig_zielgang_sas zff_atsys._.iSignale._.obj.sig_zielgang_sas_idx zff_atsys._.iSignale._.obj.sig_zielgang_sas_komp zff_atsys._.iSignale._.obj.sig_zielgang_sas_vorw zff_atsys._.iSignale._.obj.sig_zielgang_vorw /end IN_MEASUREMENT
/end FUNCTION
/begin FUNCTION GEA "Sub-Paket GEA"
 /begin IN_MEASUREMENT iGeaKordi.timer_gega_laeuft iSasAnGeaKraftschl.dauer_ra1_ge_kzu iSasAnGeaKraftschl.ende_kab_gestartet iSasAnGeaKraftschl.erste_schaltung iSasAnGeaKraftschl.f_pfmin_erreicht iSasAnGeaKraftschl.f_pokzu_kfl_zuletzt_wechsel iSasAnGeaKraftschl.f_schnellfuellung_gestartet iSasAnGeaKraftschl.f_timeout iSasAnGeaKraftschl.f_verb_ada_erste_bef iSasAnGeaKraftschl.fa_kzu_gestartet iSasAnGeaKraftschl.gea_ablauf_aktiv iSasAnGeaKraftschl.instanz_nr iSasAnGeaKraftschl.kup_ga iSasAnGeaKraftschl.kup_ge iSasAnGeaKraftschl.kzu_voll_bei_start iSasAnGeaKraftschl.nd_nmotnt_init_ga iSasAnGeaKraftschl.p_0stgea iSasAnGeaKraftschl.p_adaptgea iSasAnGeaKraftschl.p_gea iSasAnGeaKraftschl.p_offgea iSasAnGeaKraftschl.p_stgea iSasAnGeaKraftschl.pgo_gea_rampe.cBibRampeGradSi16._.letzter_ms_timer iSasAnGeaKraftschl.pgo_gea_rampe.cBibRampeGradSi16._.letzter_wert iSasAnGeaKraftschl.pgo_gea_rampe.cBibRampeGradSi16._.maximum iSasAnGeaKraftschl.pgo_gea_rampe.cBibRampeGradSi16._.minimum iSasAnGeaKraftschl.pgo_nabgea iSasAnGeaKraftschl.po_fkzu_aktiv iSasAnGeaKraftschl.po_mtgea iSasAnGeaKraftschl.ra1_ge_gestartet iSasAnGeaKraftschl.ra2_ge_gestartet iSasAnGeaKraftschl.ra3_ge_gestartet iSasAnGeaKraftschl.schalttyp_gea iSasAnGeaKraftschl.schliessen_kup_in_n_gestartet iSasAnGeaKraftschl.schnellfuellung_beendet iSasAnGeaKraftschl.statisch_gea iSasAnGeaKraftschl.synchron_verboten iSasAnGeaKraftschl.t_0kzu_gea iSasAnGeaKraftschl.t_maxgea iSasAnGeaKraftschl.t_timeout iSasAnGeaKraftschl.t_zgea iSasAnGeaKraftschl.timer16_ra1_ge iSasAnGeaKraftschl.timer_start_fa_kzu iSasAnGeaKraftschl.timer_zgea iSasAnGeaKraftschl.z_gea iSasAnGeaKraftschl.z_modus_gea iSasAnGeaKraftschl.zaehler_zgea iSasAnGeaNichtKraftschl1.dauer_ra1_ge_kzu iSasAnGeaNichtKraftschl1.ende_kab_gestartet iSasAnGeaNichtKraftschl1.erste_schaltung iSasAnGeaNichtKraftschl1.f_pfmin_erreicht iSasAnGeaNichtKraftschl1.f_pokzu_kfl_zuletzt_wechsel iSasAnGeaNichtKraftschl1.f_schnellfuellung_gestartet iSasAnGeaNichtKraftschl1.f_timeout iSasAnGeaNichtKraftschl1.f_verb_ada_erste_bef iSasAnGeaNichtKraftschl1.fa_kzu_gestartet iSasAnGeaNichtKraftschl1.gea_ablauf_aktiv iSasAnGeaNichtKraftschl1.instanz_nr iSasAnGeaNichtKraftschl1.kup_ga iSasAnGeaNichtKraftschl1.kup_ge iSasAnGeaNichtKraftschl1.kzu_voll_bei_start iSasAnGeaNichtKraftschl1.nd_nmotnt_init_ga iSasAnGeaNichtKraftschl1.p_0stgea iSasAnGeaNichtKraftschl1.p_adaptgea iSasAnGeaNichtKraftschl1.p_gea iSasAnGeaNichtKraftschl1.p_offgea iSasAnGeaNichtKraftschl1.p_stgea iSasAnGeaNichtKraftschl1.pgo_gea_rampe.cBibRampeGradSi16._.letzter_ms_timer iSasAnGeaNichtKraftschl1.pgo_gea_rampe.cBibRampeGradSi16._.letzter_wert iSasAnGeaNichtKraftschl1.pgo_gea_rampe.cBibRampeGradSi16._.maximum iSasAnGeaNichtKraftschl1.pgo_gea_rampe.cBibRampeGradSi16._.minimum iSasAnGeaNichtKraftschl1.pgo_nabgea iSasAnGeaNichtKraftschl1.po_fkzu_aktiv iSasAnGeaNichtKraftschl1.po_mtgea iSasAnGeaNichtKraftschl1.ra1_ge_gestartet iSasAnGeaNichtKraftschl1.ra2_ge_gestartet iSasAnGeaNichtKraftschl1.ra3_ge_gestartet iSasAnGeaNichtKraftschl1.schalttyp_gea iSasAnGeaNichtKraftschl1.schliessen_kup_in_n_gestartet iSasAnGeaNichtKraftschl1.schnellfuellung_beendet iSasAnGeaNichtKraftschl1.statisch_gea iSasAnGeaNichtKraftschl1.synchron_verboten iSasAnGeaNichtKraftschl1.t_0kzu_gea iSasAnGeaNichtKraftschl1.t_maxgea iSasAnGeaNichtKraftschl1.t_timeout iSasAnGeaNichtKraftschl1.t_zgea iSasAnGeaNichtKraftschl1.timer16_ra1_ge iSasAnGeaNichtKraftschl1.timer_start_fa_kzu iSasAnGeaNichtKraftschl1.timer_zgea iSasAnGeaNichtKraftschl1.z_gea iSasAnGeaNichtKraftschl1.z_modus_gea iSasAnGeaNichtKraftschl1.zaehler_zgea iSasAnGeaNichtKraftschl2.dauer_ra1_ge_kzu iSasAnGeaNichtKraftschl2.ende_kab_gestartet iSasAnGeaNichtKraftschl2.erste_schaltung iSasAnGeaNichtKraftschl2.f_pfmin_erreicht iSasAnGeaNichtKraftschl2.f_pokzu_kfl_zuletzt_wechsel iSasAnGeaNichtKraftschl2.f_schnellfuellung_gestartet iSasAnGeaNichtKraftschl2.f_timeout iSasAnGeaNichtKraftschl2.f_verb_ada_erste_bef iSasAnGeaNichtKraftschl2.fa_kzu_gestartet iSasAnGeaNichtKraftschl2.gea_ablauf_aktiv iSasAnGeaNichtKraftschl2.instanz_nr iSasAnGeaNichtKraftschl2.kup_ga iSasAnGeaNichtKraftschl2.kup_ge iSasAnGeaNichtKraftschl2.kzu_voll_bei_start iSasAnGeaNichtKraftschl2.nd_nmotnt_init_ga iSasAnGeaNichtKraftschl2.p_0stgea iSasAnGeaNichtKraftschl2.p_adaptgea iSasAnGeaNichtKraftschl2.p_gea iSasAnGeaNichtKraftschl2.p_offgea iSasAnGeaNichtKraftschl2.p_stgea iSasAnGeaNichtKraftschl2.pgo_gea_rampe.cBibRampeGradSi16._.letzter_ms_timer iSasAnGeaNichtKraftschl2.pgo_gea_rampe.cBibRampeGradSi16._.letzter_wert iSasAnGeaNichtKraftschl2.pgo_gea_rampe.cBibRampeGradSi16._.maximum iSasAnGeaNichtKraftschl2.pgo_gea_rampe.cBibRampeGradSi16._.minimum iSasAnGeaNichtKraftschl2.pgo_nabgea iSasAnGeaNichtKraftschl2.po_fkzu_aktiv iSasAnGeaNichtKraftschl2.po_mtgea iSasAnGeaNichtKraftschl2.ra1_ge_gestartet iSasAnGeaNichtKraftschl2.ra2_ge_gestartet iSasAnGeaNichtKraftschl2.ra3_ge_gestartet iSasAnGeaNichtKraftschl2.schalttyp_gea iSasAnGeaNichtKraftschl2.schliessen_kup_in_n_gestartet iSasAnGeaNichtKraftschl2.schnellfuellung_beendet iSasAnGeaNichtKraftschl2.statisch_gea iSasAnGeaNichtKraftschl2.synchron_verboten iSasAnGeaNichtKraftschl2.t_0kzu_gea iSasAnGeaNichtKraftschl2.t_maxgea iSasAnGeaNichtKraftschl2.t_timeout iSasAnGeaNichtKraftschl2.t_zgea iSasAnGeaNichtKraftschl2.timer16_ra1_ge iSasAnGeaNichtKraftschl2.timer_start_fa_kzu iSasAnGeaNichtKraftschl2.timer_zgea iSasAnGeaNichtKraftschl2.z_gea iSasAnGeaNichtKraftschl2.z_modus_gea iSasAnGeaNichtKraftschl2.zaehler_zgea /end IN_MEASUREMENT
/end FUNCTION
/begin FUNCTION HYD "Das Paket HYD enthält Klassen und Funktionalitäten, welche zur Hydraulikansteuerung und -nachbildung notwendig sind. Alle Klassen lassen sich den Untergruppen Kupplungsansteuerung (HYD_ANSTEUERUNG) und Hydrauliknachbildung (HYD_NACHBILDUNG) zuordnen." /begin SUB_FUNCTION HYD_ANSTEUERUNG HYD_NACHBILDUNG /end SUB_FUNCTION /end FUNCTION
/begin FUNCTION HYD_ANSTEUERUNG "Dokumentation des Pakets"
 /begin IN_MEASUREMENT iKorDraus.druckausgabe_kup_pf_in_n_aktiv iKorDraus.druckausgabe_kup_zu_in_n_aktiv iKorDraus.gang_kfl_zuletzt iKorDraus.gwk_moeglich iKorDraus.k0_hydraulisch_moeglich iKorDraus.kfl_zuletzt iKorDraus.kup_pf_in_n iKorDraus.kup_pruefpuls iKorDraus.kup_zu_in_n iKorDraus.p_kup_pf_in_n iKorDraus.posv_uew_hyd_aktiv iKorDraus.statisch_p_kup_pf_in_n iKorDraus.timer_cruise iKorDraus.timer_iedsofpsv iKorDraus.timer_pof1kplbinn iKorDraus.z_pof1kplbinn iMvsZentr.iTimerKeinKfl.timer iMvsZentr.iTimerMagnet.timer iMvsZentr.iTimerParksp.timer iMvsZentr.ps_aktiv iMvsZentr.ps_aktiv_permanent iMvsZentr.ps_magnet_timeout iMvsZentr.ps_zustand /end IN_MEASUREMENT
/end FUNCTION
/begin FUNCTION HYD_NACHBILDUNG "Dokumentation des Pakets"
 /begin IN_MEASUREMENT iKupA.cModPVorg._.f_anst_statisch iKupA.cModPVorg._.f_druck_vorgegeben iKupA.cModPVorg._.fktn_druckvorgabe iKupA.cModPVorg._.p_abssoll iKupA.cModPVorg._.p_abssoll_sys iKupA.cModPVorg._.p_vorgabe iKupA.cModPVorg._.typ_druckvorgabe iKupA.f_erste_bef iKupA.f_erste_bef_aus_sb iKupA.f_fuellopt iKupA.f_fuellred iKupA.f_geschlossen iKupA.f_kolben_anlegen iKupA.f_sf_ausgabe_aktiv iKupA.f_sf_vorhanden iKupA.f_strom_pre_puls_erf iKupA.f_stromschl_angefordert iKupA.kolben_pos iKupA.kolben_pos_gelesen iKupA.kolben_posbas iKupA.kpl_inaktiv iKupA.kup_index_spsas iKupA.kup_schaltart_sas iKupA.kv_nummer iKupA.n_kup_zbeg iKupA.p_absist iKupA.p_filter.letzter_ms_timer iKupA.p_filter.x iKupA.p_fmin iKupA.t0_sf iKupA.t_kpl_aktiv.timer iKupA.t_kpl_inaktiv.timer iKupA.t_lauf_entleer iKupA.t_lauf_fuell iKupA.timer_sas_ende_mit_pmax.timer iKupA.totzeit iKupA.zustand iKupA.zustandstimer.timer iKupB.cModPVorg._.f_anst_statisch iKupB.cModPVorg._.f_druck_vorgegeben iKupB.cModPVorg._.fktn_druckvorgabe iKupB.cModPVorg._.p_abssoll iKupB.cModPVorg._.p_abssoll_sys iKupB.cModPVorg._.p_vorgabe iKupB.cModPVorg._.typ_druckvorgabe iKupB.f_erste_bef iKupB.f_erste_bef_aus_sb iKupB.f_fuellopt iKupB.f_fuellred iKupB.f_geschlossen iKupB.f_kolben_anlegen iKupB.f_sf_ausgabe_aktiv iKupB.f_sf_vorhanden iKupB.f_strom_pre_puls_erf iKupB.f_stromschl_angefordert iKupB.kolben_pos iKupB.kolben_pos_gelesen iKupB.kolben_posbas iKupB.kpl_inaktiv iKupB.kup_index_spsas iKupB.kup_schaltart_sas iKupB.kv_nummer iKupB.n_kup_zbeg iKupB.p_absist iKupB.p_filter.letzter_ms_timer iKupB.p_filter.x iKupB.p_fmin iKupB.t0_sf iKupB.t_kpl_aktiv.timer iKupB.t_kpl_inaktiv.timer iKupB.t_lauf_entleer iKupB.t_lauf_fuell iKupB.timer_sas_ende_mit_pmax.timer iKupB.totzeit iKupB.zustand iKupB.zustandstimer.timer iKupC.cModPVorg._.f_anst_statisch iKupC.cModPVorg._.f_druck_vorgegeben iKupC.cModPVorg._.fktn_druckvorgabe iKupC.cModPVorg._.p_abssoll iKupC.cModPVorg._.p_abssoll_sys iKupC.cModPVorg._.p_vorgabe iKupC.cModPVorg._.typ_druckvorgabe iKupC.f_erste_bef iKupC.f_erste_bef_aus_sb iKupC.f_fuellopt iKupC.f_fuellred iKupC.f_geschlossen iKupC.f_kolben_anlegen iKupC.f_sf_ausgabe_aktiv iKupC.f_sf_vorhanden iKupC.f_strom_pre_puls_erf iKupC.f_stromschl_angefordert iKupC.kolben_pos iKupC.kolben_pos_gelesen iKupC.kolben_posbas iKupC.kpl_inaktiv iKupC.kup_index_spsas iKupC.kup_schaltart_sas iKupC.kv_nummer iKupC.n_kup_zbeg iKupC.p_absist iKupC.p_filter.letzter_ms_timer iKupC.p_filter.x iKupC.p_fmin iKupC.t0_sf iKupC.t_kpl_aktiv.timer iKupC.t_kpl_inaktiv.timer iKupC.t_lauf_entleer iKupC.t_lauf_fuell iKupC.timer_sas_ende_mit_pmax.timer iKupC.totzeit iKupC.zustand iKupC.zustandstimer.timer iKupD.cModPVorg._.f_anst_statisch iKupD.cModPVorg._.f_druck_vorgegeben iKupD.cModPVorg._.fktn_druckvorgabe iKupD.cModPVorg._.p_abssoll iKupD.cModPVorg._.p_abssoll_sys iKupD.cModPVorg._.p_vorgabe iKupD.cModPVorg._.typ_druckvorgabe iKupD.f_erste_bef iKupD.f_erste_bef_aus_sb iKupD.f_fuellopt iKupD.f_fuellred iKupD.f_geschlossen iKupD.f_kolben_anlegen iKupD.f_sf_ausgabe_aktiv iKupD.f_sf_vorhanden iKupD.f_strom_pre_puls_erf iKupD.f_stromschl_angefordert iKupD.kolben_pos iKupD.kolben_pos_gelesen iKupD.kolben_posbas iKupD.kpl_inaktiv iKupD.kup_index_spsas iKupD.kup_schaltart_sas iKupD.kv_nummer iKupD.n_kup_zbeg iKupD.p_absist iKupD.p_filter.letzter_ms_timer iKupD.p_filter.x iKupD.p_fmin iKupD.t0_sf iKupD.t_kpl_aktiv.timer iKupD.t_kpl_inaktiv.timer iKupD.t_lauf_entleer iKupD.t_lauf_fuell iKupD.timer_sas_ende_mit_pmax.timer iKupD.totzeit iKupD.zustand iKupD.zustandstimer.timer iKupE.cModPVorg._.f_anst_statisch iKupE.cModPVorg._.f_druck_vorgegeben iKupE.cModPVorg._.fktn_druckvorgabe iKupE.cModPVorg._.p_abssoll iKupE.cModPVorg._.p_abssoll_sys iKupE.cModPVorg._.p_vorgabe iKupE.cModPVorg._.typ_druckvorgabe iKupE.f_erste_bef iKupE.f_erste_bef_aus_sb iKupE.f_fuellopt iKupE.f_fuellred iKupE.f_geschlossen iKupE.f_kolben_anlegen iKupE.f_sf_ausgabe_aktiv iKupE.f_sf_vorhanden iKupE.f_strom_pre_puls_erf iKupE.f_stromschl_angefordert iKupE.kolben_pos iKupE.kolben_pos_gelesen iKupE.kolben_posbas iKupE.kpl_inaktiv iKupE.kup_index_spsas iKupE.kup_schaltart_sas iKupE.kv_nummer iKupE.n_kup_zbeg iKupE.p_absist iKupE.p_filter.letzter_ms_timer iKupE.p_filter.x iKupE.p_fmin iKupE.t0_sf iKupE.t_kpl_aktiv.timer iKupE.t_kpl_inaktiv.timer iKupE.t_lauf_entleer iKupE.t_lauf_fuell iKupE.timer_sas_ende_mit_pmax.timer iKupE.totzeit iKupE.zustand iKupE.zustandstimer.timer iKupHysA.f_ig_eds iKupHysA.f_pg_abssoll iKupHysA.iDt1IEds.Pt1Si16.x iKupHysA.iDt1IEds.xp iKupHysA.iDt1PAbssoll.Pt1Fl32.x iKupHysA.iDt1PAbssoll.xp iKupHysA.iDt1Verz.Pt1Fl32.x iKupHysA.iDt1Verz.xp iKupHysA.iPt2IoKomp.x iKupHysA.iPt2IoKomp.xp iKupHysA.iPt2MoKomp.x iKupHysA.iPt2MoKomp.xp iKupHysA.i_eds iKupHysA.i_umkehr iKupHysA.i_umkehr_alt iKupHysA.ig_eds iKupHysA.ig_wechsel_erkannt iKupHysA.io_stg iKupHysA.k_kf_out iKupHysA.k_rampe_out iKupHysA.mo_kpl iKupHysA.p_abssoll iKupHysA.p_umkehr iKupHysA.p_umkehr_alt iKupHysA.pg_abssoll iKupHysA.pg_wechsel_erkannt iKupHysA.pg_wirk iKupHysA.po_kpl iKupHysA.po_vhyskomp iKupHysA.po_wirk iKupHysA.trajekfort_kpl iKupHysA.trajekfort_stg iKupHysA.z_rampe iKupHysB.f_ig_eds iKupHysB.f_pg_abssoll iKupHysB.iDt1IEds.Pt1Si16.x iKupHysB.iDt1IEds.xp iKupHysB.iDt1PAbssoll.Pt1Fl32.x iKupHysB.iDt1PAbssoll.xp iKupHysB.iDt1Verz.Pt1Fl32.x iKupHysB.iDt1Verz.xp iKupHysB.iPt2IoKomp.x iKupHysB.iPt2IoKomp.xp iKupHysB.iPt2MoKomp.x iKupHysB.iPt2MoKomp.xp iKupHysB.i_eds iKupHysB.i_umkehr iKupHysB.i_umkehr_alt iKupHysB.ig_eds iKupHysB.ig_wechsel_erkannt iKupHysB.io_stg iKupHysB.k_kf_out iKupHysB.k_rampe_out iKupHysB.mo_kpl iKupHysB.p_abssoll iKupHysB.p_umkehr iKupHysB.p_umkehr_alt iKupHysB.pg_abssoll iKupHysB.pg_wechsel_erkannt iKupHysB.pg_wirk iKupHysB.po_kpl iKupHysB.po_vhyskomp iKupHysB.po_wirk iKupHysB.trajekfort_kpl iKupHysB.trajekfort_stg iKupHysB.z_rampe iKupHysC.f_ig_eds iKupHysC.f_pg_abssoll iKupHysC.iDt1IEds.Pt1Si16.x iKupHysC.iDt1IEds.xp iKupHysC.iDt1PAbssoll.Pt1Fl32.x iKupHysC.iDt1PAbssoll.xp iKupHysC.iDt1Verz.Pt1Fl32.x iKupHysC.iDt1Verz.xp iKupHysC.iPt2IoKomp.x iKupHysC.iPt2IoKomp.xp iKupHysC.iPt2MoKomp.x iKupHysC.iPt2MoKomp.xp iKupHysC.i_eds iKupHysC.i_umkehr iKupHysC.i_umkehr_alt iKupHysC.ig_eds iKupHysC.ig_wechsel_erkannt iKupHysC.io_stg iKupHysC.k_kf_out iKupHysC.k_rampe_out iKupHysC.mo_kpl iKupHysC.p_abssoll iKupHysC.p_umkehr iKupHysC.p_umkehr_alt iKupHysC.pg_abssoll iKupHysC.pg_wechsel_erkannt iKupHysC.pg_wirk iKupHysC.po_kpl iKupHysC.po_vhyskomp iKupHysC.po_wirk iKupHysC.trajekfort_kpl iKupHysC.trajekfort_stg iKupHysC.z_rampe iKupHysD.f_ig_eds iKupHysD.f_pg_abssoll iKupHysD.iDt1IEds.Pt1Si16.x iKupHysD.iDt1IEds.xp iKupHysD.iDt1PAbssoll.Pt1Fl32.x iKupHysD.iDt1PAbssoll.xp iKupHysD.iDt1Verz.Pt1Fl32.x iKupHysD.iDt1Verz.xp iKupHysD.iPt2IoKomp.x iKupHysD.iPt2IoKomp.xp iKupHysD.iPt2MoKomp.x iKupHysD.iPt2MoKomp.xp iKupHysD.i_eds iKupHysD.i_umkehr iKupHysD.i_umkehr_alt iKupHysD.ig_eds iKupHysD.ig_wechsel_erkannt iKupHysD.io_stg iKupHysD.k_kf_out iKupHysD.k_rampe_out iKupHysD.mo_kpl iKupHysD.p_abssoll iKupHysD.p_umkehr iKupHysD.p_umkehr_alt iKupHysD.pg_abssoll iKupHysD.pg_wechsel_erkannt iKupHysD.pg_wirk iKupHysD.po_kpl iKupHysD.po_vhyskomp iKupHysD.po_wirk iKupHysD.trajekfort_kpl iKupHysD.trajekfort_stg iKupHysD.z_rampe iKupHysE.f_ig_eds iKupHysE.f_pg_abssoll iKupHysE.iDt1IEds.Pt1Si16.x iKupHysE.iDt1IEds.xp iKupHysE.iDt1PAbssoll.Pt1Fl32.x iKupHysE.iDt1PAbssoll.xp iKupHysE.iDt1Verz.Pt1Fl32.x iKupHysE.iDt1Verz.xp iKupHysE.iPt2IoKomp.x iKupHysE.iPt2IoKomp.xp iKupHysE.iPt2MoKomp.x iKupHysE.iPt2MoKomp.xp iKupHysE.i_eds iKupHysE.i_umkehr iKupHysE.i_umkehr_alt iKupHysE.ig_eds iKupHysE.ig_wechsel_erkannt iKupHysE.io_stg iKupHysE.k_kf_out iKupHysE.k_rampe_out iKupHysE.mo_kpl iKupHysE.p_abssoll iKupHysE.p_umkehr iKupHysE.p_umkehr_alt iKupHysE.pg_abssoll iKupHysE.pg_wechsel_erkannt iKupHysE.pg_wirk iKupHysE.po_kpl iKupHysE.po_vhyskomp iKupHysE.po_wirk iKupHysE.trajekfort_kpl iKupHysE.trajekfort_stg iKupHysE.z_rampe iKupHysK0.f_ig_eds iKupHysK0.f_pg_abssoll iKupHysK0.iDt1IEds.Pt1Si16.x iKupHysK0.iDt1IEds.xp iKupHysK0.iDt1PAbssoll.Pt1Fl32.x iKupHysK0.iDt1PAbssoll.xp iKupHysK0.iDt1Verz.Pt1Fl32.x iKupHysK0.iDt1Verz.xp iKupHysK0.iPt2IoKomp.x iKupHysK0.iPt2IoKomp.xp iKupHysK0.iPt2MoKomp.x iKupHysK0.iPt2MoKomp.xp iKupHysK0.i_eds iKupHysK0.i_umkehr iKupHysK0.i_umkehr_alt iKupHysK0.ig_eds iKupHysK0.ig_wechsel_erkannt iKupHysK0.io_stg iKupHysK0.k_kf_out iKupHysK0.k_rampe_out iKupHysK0.mo_kpl iKupHysK0.p_abssoll iKupHysK0.p_umkehr iKupHysK0.p_umkehr_alt iKupHysK0.pg_abssoll iKupHysK0.pg_wechsel_erkannt iKupHysK0.pg_wirk iKupHysK0.po_kpl iKupHysK0.po_vhyskomp iKupHysK0.po_wirk iKupHysK0.trajekfort_kpl iKupHysK0.trajekfort_stg iKupHysK0.z_rampe iKupK0.cModPVorg._.f_anst_statisch iKupK0.cModPVorg._.f_druck_vorgegeben iKupK0.cModPVorg._.fktn_druckvorgabe iKupK0.cModPVorg._.p_abssoll iKupK0.cModPVorg._.p_abssoll_sys iKupK0.cModPVorg._.p_vorgabe iKupK0.cModPVorg._.typ_druckvorgabe iKupK0.f_erste_bef iKupK0.f_erste_bef_aus_sb iKupK0.f_fuellopt iKupK0.f_fuellred iKupK0.f_geschlossen iKupK0.f_kolben_anlegen iKupK0.f_sf_ausgabe_aktiv iKupK0.f_sf_vorhanden iKupK0.f_strom_pre_puls_erf iKupK0.f_stromschl_angefordert iKupK0.kolben_pos iKupK0.kolben_pos_gelesen iKupK0.kolben_posbas iKupK0.kpl_inaktiv iKupK0.kup_index_spsas iKupK0.kup_schaltart_sas iKupK0.kv_nummer iKupK0.n_kup_zbeg iKupK0.p_absist iKupK0.p_filter.letzter_ms_timer iKupK0.p_filter.x iKupK0.p_fmin iKupK0.t0_sf iKupK0.t_kpl_aktiv.timer iKupK0.t_kpl_inaktiv.timer iKupK0.t_lauf_entleer iKupK0.t_lauf_fuell iKupK0.timer_sas_ende_mit_pmax.timer iKupK0.totzeit iKupK0.zustand iKupK0.zustandstimer.timer iModHydlg.err_v_nr_abgldat iModHydlg.status_pruef_abgldat iModHydlg.version_abgleichdaten iModHydlg.vnr_abgldat_im_boot iModHydlg.zugriff_abgleichdaten iPAnzeige.befuellung_schaltelement_aktiv iPAnzeige.kzu_beob_kup_ada iPAnzeige.p_abs_gsk iPAnzeige.p_abs_kab iPAnzeige.p_abs_kzu_puls iPAnzeige.p_abs_v2kab iPAnzeige.p_abs_v2kzu iPAnzeige.p_abs_vkab iPAnzeige.p_abs_vkzu iPAnzeige.po_fkup_ada iPAnzeige.to_sfkup_ada iPSystem.f_anst_statisch iPSystem.f_druck_vorgegeben iPSystem.fktn_druckvorgabe iPSystem.p_abssoll iPSystem.p_abssoll_sys iPSystem.p_vorgabe iPSystem.typ_druckvorgabe iPWk.f_anst_statisch iPWk.f_druck_vorgegeben iPWk.fktn_druckvorgabe iPWk.p_abssoll iPWk.p_abssoll_sys iPWk.p_vorgabe iPWk.typ_druckvorgabe /end IN_MEASUREMENT
/end FUNCTION
/begin FUNCTION IAE "In IAE sind die Funktionen zum integrierten Anfahrelement enthalten"
 /begin IN_MEASUREMENT iIaeAdauf.iTLaufUefiae.timer iIaeAdauf.kfl_ziel_start_uefiea iIaeAdauf.m_motist_mw_uefiae iIaeAdauf.m_motist_start_uefiae iIaeAdauf.m_soll_mw_uefiae iIaeAdauf.m_soll_start_uefiae iIaeAdauf.m_stell_mw_uefiae iIaeAdauf.m_stell_start_uefiae iIaeAdauf.mue_adawert_lesen iIaeAdauf.mue_adawert_schreiben iIaeAdauf.mue_diff iIaeAdauf.mue_ist_uefiae iIaeAdauf.mue_kor_j_uefiae iIaeAdauf.mue_mw_uefiae iIaeAdauf.mue_start_uefiae iIaeAdauf.nd_mw_uefiae iIaeAdauf.nd_start_uefiae iIaeAdauf.ng_mot_mw_uefiae iIaeAdauf.ng_mot_start_uefiae iIaeAdauf.p_stell_start_uefiae iIaeAdauf.z_ada_uefiae iIaeAdauf.zielgang_start_uefiae iIaeDiagn.Pt1Axrefiae.x iIaeDiagn.Pt1Mdidiagiae.x iIaeDiagn.TimerCloseBewAktiv.maxtime iIaeDiagn.TimerCloseBewAktiv.time iIaeDiagn.TimerCloseNgab.maxtime iIaeDiagn.TimerCloseNgab.time iIaeDiagn.TimerCloseRueckF.maxtime iIaeDiagn.TimerCloseRueckF.time iIaeDiagn.TimerHotDiagiae.time iIaeDiagn.TimerNoCloseDiagiae.maxtime iIaeDiagn.TimerNoCloseDiagiae.time iIaeDiagn.TimerNoOpenDiagiae.maxtime iIaeDiagn.TimerNoOpenDiagiae.time iIaeDiagn.TimerNocloseBewAktiv.maxtime iIaeDiagn.TimerNocloseBewAktiv.time iIaeDiagn.TimerNoopenBewAktiv.maxtime iIaeDiagn.TimerNoopenBewAktiv.time iIaeDiagn.TimerNoopenRueckF.maxtime iIaeDiagn.TimerNoopenRueckF.time iIaeDiagn.ax_integral_diagiae iIaeDiagn.flag_close_bew_aktiv_diagiae iIaeDiagn.flag_close_diagiae iIaeDiagn.flag_hot_diagiae iIaeDiagn.flag_max_p_haupt_diagiae iIaeDiagn.flag_mmot_gespeichert_diagiae iIaeDiagn.flag_noclose_bew_aktiv_diagiae iIaeDiagn.flag_noclose_diagiae iIaeDiagn.flag_noclose_hogez_diagiae iIaeDiagn.flag_noopen_bew_aktiv_diagiae iIaeDiagn.flag_noopen_diagiae iIaeDiagn.flag_rueckf_mmot_diagiae iIaeDiagn.flag_rueckf_msollnmot_diagiae iIaeDiagn.flag_sammelbed_diagiae iIaeDiagn.flag_spassfahrt_diagiae iIaeDiagn.flag_timer_hot_diagiae iIaeDiagn.index_mot_diagiae iIaeDiagn.m_motistoe_temp_diagiae iIaeDiagn.mdi_diagiae iIaeDiagn.n_stoer_noclose_diagiae iIaeDiagn.status_iae_hotinfo iIaeDiagn.z_close_diagiae iIaeDraus.Dt1PGStell.Pt1Si16.x iIaeDraus.Dt1PGStell.xp iIaeDraus.Pt1Mue.x iIaeDraus.Pt1PDStellHysS.x iIaeDraus.Pt1PStellbasis.x iIaeDraus.Pt1PoDyn.x iIaeDraus.Pt1PoHysKoStill.x iIaeDraus.Pt2PIst.x iIaeDraus.Pt2PIst.xp iIaeDraus.TimerHysSchl.maxtime iIaeDraus.TimerHysSchl.time iIaeDraus.TimerHyskompan.maxtime iIaeDraus.TimerHyskompan.time iIaeDraus.TimerPoDyn.maxtime iIaeDraus.TimerPoDyn.time iIaeDraus.f_hysschleife_aktiv_iae iIaeDraus.f_hysschleife_moeglich_iae iIaeDraus.flag_init_ausinaktiv_iae iIaeDraus.flag_m_max_alt iIaeDraus.flag_po_dyn_aktiv_iae iIaeDraus.mpt_po_dyn_iae iIaeDraus.mue_iae iIaeDraus.nd_iae_kf_mue iIaeDraus.p_ist_basis_iae iIaeDraus.p_ofmin_iae iIaeDraus.p_stell_basis_iae iIaeDraus.p_stell_iae iIaeDraus.p_stellalt_iae iIaeDraus.pd_hysschleife_iae iIaeDraus.po_dyn_iae iIaeDraus.po_hys_iae iIaeDraus.po_hyskomp_angelegt_iae iIaeDraus.po_hyskomp_max_iae iIaeDraus.po_hyskomp_min_iae iIaeDraus.t_po_dyn_iae iIaeDraus.z_hyskompstillunten_iae iIaeKordi.TimerZIae.maxtime iIaeKordi.TimerZIae.time iIaeKordi.f_torqfuse_iae iIaeKordi.flag_zu_gewesen_iae iIaeKordi.kup_status_iae iIaeKordi.t_angelegt_iae iIaeKordi.t_nds_zu_iae iIaeKordi.timer_z_iae iIaeKordi.z_iae iIaeKordi.z_iae_temp iIaeKuehl.Pt1Vpsoll.x iIaeKuehl.TimerZModusIae.maxtime iIaeKuehl.TimerZModusIae.time iIaeKuehl.f_min_em_kuehl_iae iIaeKuehl.flag_kuehlung_im_inaktiv iIaeKuehl.p_kuehl_soll_iae iIaeKuehl.vp_kuehl_korr_iae iIaeKuehl.vp_kuehl_max_iae iIaeKuehl.vp_kuehl_soll_iae iIaeKuehl.vp_sek_k0_iae iIaeMomen.BibPIDIae.faktor_d iIaeMomen.BibPIDIae.faktor_i iIaeMomen.BibPIDIae.faktor_p iIaeMomen.BibPIDIae.faktor_t1 iIaeMomen.BibPIDIae.regel_diff_alt iIaeMomen.BibPIDIae.stell_max iIaeMomen.BibPIDIae.stell_min iIaeMomen.BibPIDIae.stellgr_alt iIaeMomen.BibPIDIae.stellgr_d_alt iIaeMomen.BibPIDIae.stellgr_i_alt iIaeMomen.BibPIDIae.stellgr_i_modulo iIaeMomen.Pt1IStuetz.x iIaeMomen.Pt1NMotAnfah.x iIaeMomen.Pt2MIstVorstIae.x iIaeMomen.Pt2MIstVorstIae.xp iIaeMomen.Pt2NMotAnfahrt.x iIaeMomen.Pt2NMotAnfahrt.xp iIaeMomen.TimerKflMiaeauf.maxtime iIaeMomen.TimerKflMiaeauf.time iIaeMomen.TimerMiaeaufAnfahr.maxtime iIaeMomen.TimerMiaeaufAnfahr.time iIaeMomen.TimerNachMmaxHas.maxtime iIaeMomen.TimerNachMmaxHas.time iIaeMomen.TimerPulsCue.maxtime iIaeMomen.TimerPulsCue.time iIaeMomen.TimerPulsCueAktiv.maxtime iIaeMomen.TimerPulsCueAktiv.time iIaeMomen.TimerUefIstuetz.maxtime iIaeMomen.TimerUefIstuetz.time iIaeMomen.TimerUefKriechen.maxtime iIaeMomen.TimerUefKriechen.time iIaeMomen.TimerUefMVorKriechen.maxtime iIaeMomen.TimerUefMVorKriechen.time iIaeMomen.cd_iae iIaeMomen.ci_iae iIaeMomen.cp_iae iIaeMomen.ct1_iae iIaeMomen.dki_maxiae iIaeMomen.f_m_basis_anfahrt_iae iIaeMomen.f_miaeaufdki_iae iIaeMomen.f_mschlepp_iae iIaeMomen.f_nganfahrt_iae iIaeMomen.f_sign_puls_iae iIaeMomen.flag_first_reglerinit_iae iIaeMomen.flag_initmistvorst_iae iIaeMomen.flag_initsollanfahr_iae iIaeMomen.flag_kaltanfahren_aktiv_iae iIaeMomen.flag_mvorberechnug_aktiv_iae iIaeMomen.flag_nsmotmaxc_iae iIaeMomen.flag_pulscue_aktiv_iae iIaeMomen.flag_regler_aktiv iIaeMomen.flag_schaltung_aktiv_iae iIaeMomen.flag_schrittschaltung_iae iIaeMomen.flag_t_ueffix_iae iIaeMomen.flag_ueflaeuft_iae iIaeMomen.flag_zu_erreicht_iae iIaeMomen.i_stuetz_iae iIaeMomen.i_stuetzalt_iae iIaeMomen.i_stuetzziel_iae iIaeMomen.kd_iae iIaeMomen.kfl_ziel_tmp_iae iIaeMomen.ki_iae iIaeMomen.kp_iae iIaeMomen.m_alt_iae iIaeMomen.m_basis_anfahrt_iae iIaeMomen.m_iaeauf iIaeMomen.m_iaeauf_alt iIaeMomen.m_iaeauf_frozen iIaeMomen.m_iaeauf_ramp iIaeMomen.m_ist_iae iIaeMomen.m_ist_vorst_alt_iae iIaeMomen.m_ist_vorst_iae iIaeMomen.m_ist_vorst_iae_froz iIaeMomen.m_ist_vorst_max_anfahr_iae iIaeMomen.m_kriech_max_iae iIaeMomen.m_kriech_min_iae iIaeMomen.m_motistoe_iae_init iIaeMomen.m_puls_cueber_iae iIaeMomen.m_regler_d_iae iIaeMomen.m_regler_i_iae iIaeMomen.m_regler_iae iIaeMomen.m_regler_p_iae iIaeMomen.m_schlepp_iae iIaeMomen.m_soll_iae iIaeMomen.m_soll_iae_init iIaeMomen.m_soll_still_iae iIaeMomen.m_stell_iae iIaeMomen.m_vorkriechziel_iae iIaeMomen.m_vorsteuer_iae iIaeMomen.mo_soll_iae iIaeMomen.mo_vorstkreichen_iae iIaeMomen.ms_motanfahrinit_iae iIaeMomen.n_emknick_iae iIaeMomen.n_grenzentk_iae iIaeMomen.n_motanfahr_gef_iae iIaeMomen.n_motanfahr_grad_iae iIaeMomen.n_motsollanfahr_iae iIaeMomen.n_motsollanfahr_roh_iae iIaeMomen.nd_kriechsoll_iae iIaeMomen.nd_kriechstart_iae iIaeMomen.nd_kriechziel_iae iIaeMomen.nd_motentkoppeln_init_iae iIaeMomen.nd_motsollanfahr_iae iIaeMomen.ng_motanfahr_gef_iae iIaeMomen.ns_motanfahrinit_iae iIaeMomen.sig_rampe_miaeauf iIaeMomen.st_anfagradbegrenz_iae iIaeMomen.status_uef_zu_kriech_init_iae iIaeMomen.t_dauer_iuef_hs_iae iIaeMomen.t_syn_temp_iae iIaeMomen.t_uef_m_iae iIaeMomen.t_uef_m_zu_kriech_iae iIaeMomen.t_uef_miaeaufanf_iae iIaeMomen.t_uef_nd_iae iIaeMomen.typ_uef_m iIaeMomen.typ_uef_miaeaufanf_iae iIaeMomen.xd_iae iIaeMomen.z_mo_kriech_aktiv_iae iIaeMomen.z_modusiae_temp iIaeMomen.z_rampe_miaeauf iIaeMotmx.Pt1MMotmax.x iIaeMotmx.TimerStallIae.maxtime iIaeMotmx.TimerStallIae.time iIaeMotmx.flag_motmaxndiff_iae iIaeMotmx.flag_motmaxregdiff_iae iIaeMotmx.flag_motmaxstall_iae iIaeMotmx.flag_motmaxtemp_iae iIaeMotmx.flag_stallspeed_iae iIaeMotmx.i_stuetz_mmax_iae iIaeMotmx.m_motmax100_iae iIaeMotmx.m_motmax_iae iIaeMotmx.m_motmax_max_iae iIaeMotmx.m_motmax_roh_iae iIaeMotmx.m_motmaxmax100_iae iIaeMotmx.m_motmaxndiff100_iae iIaeMotmx.m_motmaxndiff_iae iIaeMotmx.m_motmaxregdiff100_iae iIaeMotmx.m_motmaxregdiff_iae iIaeMotmx.m_motmaxstall100_iae iIaeMotmx.m_motmaxstall_iae iIaeMotmx.m_motmaxtemp100_iae iIaeMotmx.m_motmaxtemp_iae iIaeMotmx.timer_stallspeed_iae iIaeSigna.DelayMMotgem.write_index iIaeSigna.DelayMMotist.write_index iIaeSigna.DelayMMotistoe.write_index iIaeSigna.DelayMMotsolloe.write_index iIaeSigna.DelayNab.write_index iIaeSigna.DelayNt.write_index iIaeSigna.Dt1Dkig.Pt1Si16.x iIaeSigna.Dt1Dkig.xp iIaeSigna.Dt1MgMotist.Pt1Si16.x iIaeSigna.Dt1MgMotist.xp iIaeSigna.Dt1NdgIae.Pt1Si16.x iIaeSigna.Dt1NdgIae.xp iIaeSigna.Dt1NgAb.Pt1Si16.x iIaeSigna.Dt1NgAb.xp iIaeSigna.Dt1NgGetrein.Pt1Si16.x iIaeSigna.Dt1NgGetrein.xp iIaeSigna.Dt1NgMot.Pt1Si16.x iIaeSigna.Dt1NgMot.xp iIaeSigna.Dt1Pbremsg.Pt1Si16.x iIaeSigna.Dt1Pbremsg.xp iIaeSigna.Pt1AxrefIae.x iIaeSigna.Pt1Dki.x iIaeSigna.Pt1MMotgem.x iIaeSigna.Pt1MMotist.x iIaeSigna.Pt1MMotistoe.x iIaeSigna.Pt1MMotsolloe.x iIaeSigna.Pt1NAb.x iIaeSigna.Pt1NMot.x iIaeSigna.Pt1NT.x iIaeSigna.Pt1NdGetrein.x iIaeSigna.Pt1NdIae.x iIaeSigna.Pt1NdMot.x iIaeSigna.Pt1Nue.x iIaeSigna.Pt1PBrems.x iIaeSigna.Pt2NeigungIae.x iIaeSigna.Pt2NeigungIae.xp iIaeSigna.asr_regelt_iae iIaeSigna.ax_ref_filt_diagiae iIaeSigna.dki_iae iIaeSigna.dkig_iae iIaeSigna.flag_init_signa_iae iIaeSigna.flag_mreibzumstell_iae iIaeSigna.kfl_sollneutral_iae iIaeSigna.m_motgemoe_iae iIaeSigna.m_motist_iae iIaeSigna.m_motistoe_iae iIaeSigna.m_motsolloe_iae iIaeSigna.m_reib_iae iIaeSigna.mg_motist_iae iIaeSigna.mot_stress_iae iIaeSigna.n_ab_dir_iae iIaeSigna.n_ab_iae iIaeSigna.n_getrein_iae iIaeSigna.n_mot_iae iIaeSigna.n_motanfahr_basis_iae iIaeSigna.n_motsoll_ll_iae iIaeSigna.n_motsollmax_iae iIaeSigna.n_t_iae iIaeSigna.nd_getrein_basis_ll_iae iIaeSigna.nd_getrein_iae iIaeSigna.nd_iae iIaeSigna.nd_iae_betrag iIaeSigna.nd_iae_kf iIaeSigna.nd_mot_iae iIaeSigna.ndg_iae iIaeSigna.neigung_iae iIaeSigna.neigung_nmin_iae iIaeSigna.ng_ab_iae iIaeSigna.ng_getrein_iae iIaeSigna.ng_mot_iae iIaeSigna.ns_getrein_oeffnen_iae iIaeSigna.ns_getrein_schliess_iae iIaeSigna.nue_iae iIaeSigna.p_brems_iae iIaeSigna.pg_brems_iae iIaeSigna.pw_reib_iae iIaeSigna.x_kf_ns_sync_iae iIaeSigna.z_nmotll_aktiv_iae iIaeTempm.TimerVzInit.maxtime iIaeTempm.TimerVzInit.time iIaeTempm.c_iae iIaeTempm.c_iae_fl iIaeTempm.flag_tempsperr_timerini_iae iIaeTempm.q_ab_iae iIaeTempm.z_temp_init_iae /end IN_MEASUREMENT
/end FUNCTION
/begin FUNCTION IEP "Inegrierte elektrische Zusatzpumpe"
 /begin IN_MEASUREMENT iIepBerLp.f_has_aktiv_iep iIepBerLp.f_iep_ext iIepBerLp.f_iep_has iIepBerLp.f_iep_sab iIepBerLp.f_iep_tes iIepBerLp.f_kmn_enpg iIepBerLp.f_nmin_iep iIepBerLp.f_senken_LP3_iep iIepBerLp.iTimerNminIep.timer iIepBerLp.iTimerSenkenLP3.timer iIepBerLp.iep_soll iIepBerLp.iep_soll_ext iIepBerLp.iep_soll_ext_intern iIepBerLp.iep_soll_intern iIepBerLp.m_getr_iep iIepBerLp.schaltung_iep iIepBerLp.z_nmin_iep iIepBerLp.z_senken_lp3 iIepKordi.bed_in_fehler iIepKordi.cnt_LP1_iep iIepKordi.cnt_LP2_iep iIepKordi.cnt_LP3_iep iIepKordi.elektrisch_pumpe_laeuft iIepKordi.fehler_iep iIepKordi.iTimerGesamtLP1.maxtime iIepKordi.iTimerGesamtLP1.time iIepKordi.iTimerGesamtLP2.maxtime iIepKordi.iTimerGesamtLP2.time iIepKordi.iTimerGesamtLP3.maxtime iIepKordi.iTimerGesamtLP3.time iIepKordi.iep_ist iIepKordi.iep_ist_manuell iIepKordi.iep_ist_pwm iIepKordi.t_an_LP1_iep iIepKordi.t_an_LP2_iep iIepKordi.t_an_LP3_iep iIepKordi.zustand_iep iIepLeckagemodell.Pt1NgMotIep.x iIepLeckagemodell.Pt1NsMotAnKorrIep.x iIepLeckagemodell.ng_mot_iep iIepLeckagemodell.ns_mot_an_iep iIepLeckagemodell.ns_mot_an_korr_iep iIepLeckagemodell.ns_mot_an_korr_iep_gef iIepLeckagemodell.ns_mot_an_korr_iep_roh iIepLeckagemodell.ns_mot_hys_iep iIepLeckagemodell.q_bedarf_iep iIepLeckagemodell.q_leckage_fzp_iep iIepLeckagemodell.q_leckage_ges_iep iIepLeckagemodell.q_leckage_hsg_iep iIepSchuz.f_cgetr_aus_iep iIepSchuz.f_cgetr_fehler_iep iIepSchuz.f_psys_max_iep iIepSchuz.f_tmax_aus_iep iIepSchuz.f_ts_LP_iep iIepSchuz.iTimerGesamt.timer iIepSchuz.iTimerLP.time iIepSchuz.t_an_iep iIepSigna.Pt1NeigungsFilterIep.x iIepSigna.f_an_aus_iep iIepSigna.f_ansteuerung_iep iIepSigna.f_einmal_aus iIepSigna.f_gefaelle_erfuellt_iep iIepSigna.f_luft_erfuellt_iep iIepSigna.f_nab_erfuellt_iep iIepSigna.f_nab_gegeben_iep iIepSigna.f_ns_iep iIepSigna.f_pow_down_enable_atsys_iep iIepSigna.f_psys_stuetzen_iep iIepSigna.f_sleep_iep iIepSigna.f_wash_fkt_aktiv_iep iIepSigna.iTimerFehlerReset.time iIepSigna.iTimerGefaelleIep.timer iIepSigna.iTimerLuftAktiv.timer iIepSigna.iTimerLuftSperr.timer iIepSigna.iTimerNabIep.timer iIepSigna.iTimerPsysPssIep.time iIepSigna.iTimerWstr.timer iIepSigna.neigung_gef_iep iIepSigna.z_f_stuetzen_iep iIepSigna.z_fehler_reset_iep iIepSigna.z_gefaelle_iep iIepSigna.z_luft_iep iIepSigna.z_nab_iep iIepSigna.z_wstr_iep iIepStSig.f_erststart_iep iIepStSig.iTimerStatusIep.timer iIepStSig.status_iep iIepStSig.t_vstatusiep iIepStSig.zustand_status_iep /end IN_MEASUREMENT
/end FUNCTION
/begin FUNCTION jAdaGlast_Fktn "Applikationesgroessen Instanz jAdaGlast"
 /begin DEF_CHARACTERISTIC CS_ADPSOB CS_ADPSUN DKI_PSGLSADHS DKI_PSGLSADRS KL_FSDADLZ KL_SBAKLZ_GLS P_SDADMAX P_SDADMIN SHIFTCOUNTERGLSRSHS_TRIM SHIFTCOUNTERGLSRSKF1_TRIM SHIFTCOUNTERGLSRSKF2_TRIM SWI_ABBRGLS_PFADA SWI_GLS_ADA_LOESCH_ISTGANG SWI_GLS_ADA_LOESCH_ZIELGANG SWI_GLS_ADA_SPSPORT SWI_GLS_TRIM SWI_SDAD SWI_ZKINDEX_GLS TAB_MT_SDADGR_DRS TAB_MT_SDADGR_HS TAB_MT_SDADGR_NFRS TAB_MT_SDADGR_RS TAB_NT_SDADGR_DRS TAB_NT_SDADGR_HS TAB_NT_SDADGR_NFRS TAB_NT_SDADGR_RS /end DEF_CHARACTERISTIC
/end FUNCTION
/begin FUNCTION jAdaGlastHSP112_Fktn "Applikationesgroessen Instanz jAdaGlastHSP112" /begin DEF_CHARACTERISTIC KL_PGLSAD12 /end DEF_CHARACTERISTIC /end FUNCTION
/begin FUNCTION jAdaGlastHSP123_Fktn "Applikationesgroessen Instanz jAdaGlastHSP123" /begin DEF_CHARACTERISTIC KL_PGLSAD23 /end DEF_CHARACTERISTIC /end FUNCTION
/begin FUNCTION jAdaGlastHSP134_Fktn "Applikationesgroessen Instanz jAdaGlastHSP134" /begin DEF_CHARACTERISTIC KL_PGLSAD34 /end DEF_CHARACTERISTIC /end FUNCTION
/begin FUNCTION jAdaGlastHSP145_Fktn "Applikationesgroessen Instanz jAdaGlastHSP145" /begin DEF_CHARACTERISTIC KL_PGLSAD45 /end DEF_CHARACTERISTIC /end FUNCTION
/begin FUNCTION jAdaGlastHSP156_Fktn "Applikationesgroessen Instanz jAdaGlastHSP156" /begin DEF_CHARACTERISTIC KL_PGLSAD56 /end DEF_CHARACTERISTIC /end FUNCTION
/begin FUNCTION jAdaGlastHSP167_Fktn "Applikationesgroessen Instanz jAdaGlastHSP167" /begin DEF_CHARACTERISTIC KL_PGLSAD67 /end DEF_CHARACTERISTIC /end FUNCTION
/begin FUNCTION jAdaGlastHSP178_Fktn "Applikationesgroessen Instanz jAdaGlastHSP178" /begin DEF_CHARACTERISTIC KL_PGLSAD78 /end DEF_CHARACTERISTIC /end FUNCTION
/begin FUNCTION jAdaGlastHSP212_Fktn "Applikationesgroessen Instanz jAdaGlastHSP212" /begin DEF_CHARACTERISTIC KL_PGLSADSP12 /end DEF_CHARACTERISTIC /end FUNCTION
/begin FUNCTION jAdaGlastHSP223_Fktn "Applikationesgroessen Instanz jAdaGlastHSP223" /begin DEF_CHARACTERISTIC KL_PGLSADSP23 /end DEF_CHARACTERISTIC /end FUNCTION
/begin FUNCTION jAdaGlastHSP234_Fktn "Applikationesgroessen Instanz jAdaGlastHSP234" /begin DEF_CHARACTERISTIC KL_PGLSADSP34 /end DEF_CHARACTERISTIC /end FUNCTION
/begin FUNCTION jAdaGlastHSP245_Fktn "Applikationesgroessen Instanz jAdaGlastHSP245" /begin DEF_CHARACTERISTIC KL_PGLSADSP45 /end DEF_CHARACTERISTIC /end FUNCTION
/begin FUNCTION jAdaGlastHSP256_Fktn "Applikationesgroessen Instanz jAdaGlastHSP256" /begin DEF_CHARACTERISTIC KL_PGLSADSP56 /end DEF_CHARACTERISTIC /end FUNCTION
/begin FUNCTION jAdaGlastHSP267_Fktn "Applikationesgroessen Instanz jAdaGlastHSP267" /begin DEF_CHARACTERISTIC KL_PGLSADSP67 /end DEF_CHARACTERISTIC /end FUNCTION
/begin FUNCTION jAdaGlastHSP278_Fktn "Applikationesgroessen Instanz jAdaGlastHSP278" /begin DEF_CHARACTERISTIC KL_PGLSADSP78 /end DEF_CHARACTERISTIC /end FUNCTION
/begin FUNCTION jAdaGlastRSP121_Fktn "Applikationesgroessen Instanz jAdaGlastRSP121" /begin DEF_CHARACTERISTIC KF_PGLSADNT21 /end DEF_CHARACTERISTIC /end FUNCTION
/begin FUNCTION jAdaGlastRSP132_Fktn "Applikationesgroessen Instanz jAdaGlastRSP132" /begin DEF_CHARACTERISTIC KF_PGLSADNT32 /end DEF_CHARACTERISTIC /end FUNCTION
/begin FUNCTION jAdaGlastRSP143_Fktn "Applikationesgroessen Instanz jAdaGlastRSP143" /begin DEF_CHARACTERISTIC KF_PGLSADNT43 /end DEF_CHARACTERISTIC /end FUNCTION
/begin FUNCTION jAdaGlastRSP154_Fktn "Applikationesgroessen Instanz jAdaGlastRSP154" /begin DEF_CHARACTERISTIC KF_PGLSADNT54 /end DEF_CHARACTERISTIC /end FUNCTION
/begin FUNCTION jAdaGlastRSP165_Fktn "Applikationesgroessen Instanz jAdaGlastRSP165" /begin DEF_CHARACTERISTIC KF_PGLSADNT65 /end DEF_CHARACTERISTIC /end FUNCTION
/begin FUNCTION jAdaGlastRSP176_Fktn "Applikationesgroessen Instanz jAdaGlastRSP176" /begin DEF_CHARACTERISTIC KF_PGLSADNT76 /end DEF_CHARACTERISTIC /end FUNCTION
/begin FUNCTION jAdaGlastRSP187_Fktn "Applikationesgroessen Instanz jAdaGlastRSP187" /begin DEF_CHARACTERISTIC KF_PGLSADNT87 /end DEF_CHARACTERISTIC /end FUNCTION
/begin FUNCTION jAdaGlastRSP221_Fktn "Applikationesgroessen Instanz jAdaGlastRSP221" /begin DEF_CHARACTERISTIC KF_PGLSADNTSP21 /end DEF_CHARACTERISTIC /end FUNCTION
/begin FUNCTION jAdaGlastRSP231_Fktn "Applikationesgroessen Instanz jAdaGlastRSP231" /begin DEF_CHARACTERISTIC KF_PGLSADNTSP31 /end DEF_CHARACTERISTIC /end FUNCTION
/begin FUNCTION jAdaGlastRSP232_Fktn "Applikationesgroessen Instanz jAdaGlastRSP232" /begin DEF_CHARACTERISTIC KF_PGLSADNTSP32 /end DEF_CHARACTERISTIC /end FUNCTION
/begin FUNCTION jAdaGlastRSP242_Fktn "Applikationesgroessen Instanz jAdaGlastRSP242" /begin DEF_CHARACTERISTIC KF_PGLSADNTSP42 /end DEF_CHARACTERISTIC /end FUNCTION
/begin FUNCTION jAdaGlastRSP243_Fktn "Applikationesgroessen Instanz jAdaGlastRSP243" /begin DEF_CHARACTERISTIC KF_PGLSADNTSP43 /end DEF_CHARACTERISTIC /end FUNCTION
/begin FUNCTION jAdaGlastRSP251_Fktn "Applikationesgroessen Instanz jAdaGlastRSP251" /begin DEF_CHARACTERISTIC KF_PGLSADNTSP51 /end DEF_CHARACTERISTIC /end FUNCTION
/begin FUNCTION jAdaGlastRSP253_Fktn "Applikationesgroessen Instanz jAdaGlastRSP253" /begin DEF_CHARACTERISTIC KF_PGLSADNTSP53 /end DEF_CHARACTERISTIC /end FUNCTION
/begin FUNCTION jAdaGlastRSP254_Fktn "Applikationesgroessen Instanz jAdaGlastRSP254" /begin DEF_CHARACTERISTIC KF_PGLSADNTSP54 /end DEF_CHARACTERISTIC /end FUNCTION
/begin FUNCTION jAdaGlastRSP263_Fktn "Applikationesgroessen Instanz jAdaGlastRSP263" /begin DEF_CHARACTERISTIC KF_PGLSADNTSP63 /end DEF_CHARACTERISTIC /end FUNCTION
/begin FUNCTION jAdaGlastRSP264_Fktn "Applikationesgroessen Instanz jAdaGlastRSP264" /begin DEF_CHARACTERISTIC KF_PGLSADNTSP64 /end DEF_CHARACTERISTIC /end FUNCTION
/begin FUNCTION jAdaGlastRSP265_Fktn "Applikationesgroessen Instanz jAdaGlastRSP265" /begin DEF_CHARACTERISTIC KF_PGLSADNTSP65 /end DEF_CHARACTERISTIC /end FUNCTION
/begin FUNCTION jAdaGlastRSP271_Fktn "Applikationesgroessen Instanz jAdaGlastRSP271" /begin DEF_CHARACTERISTIC KF_PGLSADNTSP71 /end DEF_CHARACTERISTIC /end FUNCTION
/begin FUNCTION jAdaGlastRSP275_Fktn "Applikationesgroessen Instanz jAdaGlastRSP275" /begin DEF_CHARACTERISTIC KF_PGLSADNTSP75 /end DEF_CHARACTERISTIC /end FUNCTION
/begin FUNCTION jAdaGlastRSP276_Fktn "Applikationesgroessen Instanz jAdaGlastRSP276" /begin DEF_CHARACTERISTIC KF_PGLSADNTSP76 /end DEF_CHARACTERISTIC /end FUNCTION
/begin FUNCTION jAdaGlastRSP282_Fktn "Applikationesgroessen Instanz jAdaGlastRSP282" /begin DEF_CHARACTERISTIC KF_PGLSADNTSP82 /end DEF_CHARACTERISTIC /end FUNCTION
/begin FUNCTION jAdaGlastRSP284_Fktn "Applikationesgroessen Instanz jAdaGlastRSP284" /begin DEF_CHARACTERISTIC KF_PGLSADNTSP84 /end DEF_CHARACTERISTIC /end FUNCTION
/begin FUNCTION jAdaGlastRSP286_Fktn "Applikationesgroessen Instanz jAdaGlastRSP286" /begin DEF_CHARACTERISTIC KF_PGLSADNTSP86 /end DEF_CHARACTERISTIC /end FUNCTION
/begin FUNCTION jAdaGlastRSP287_Fktn "Applikationesgroessen Instanz jAdaGlastRSP287" /begin DEF_CHARACTERISTIC KF_PGLSADNTSP87 /end DEF_CHARACTERISTIC /end FUNCTION
/begin FUNCTION jAdaGlastRSP331_Fktn "Applikationesgroessen Instanz jAdaGlastRSP331" /begin DEF_CHARACTERISTIC KF_PGLSADNTSPORT31 /end DEF_CHARACTERISTIC /end FUNCTION
/begin FUNCTION jAdaGlastRSP342_Fktn "Applikationesgroessen Instanz jAdaGlastRSP342" /begin DEF_CHARACTERISTIC KF_PGLSADNTSPORT42 /end DEF_CHARACTERISTIC /end FUNCTION
/begin FUNCTION jAdaGlastRSP351_Fktn "Applikationesgroessen Instanz jAdaGlastRSP351" /begin DEF_CHARACTERISTIC KF_PGLSADNTSPORT51 /end DEF_CHARACTERISTIC /end FUNCTION
/begin FUNCTION jAdaGlastRSP353_Fktn "Applikationesgroessen Instanz jAdaGlastRSP353" /begin DEF_CHARACTERISTIC KF_PGLSADNTSPORT53 /end DEF_CHARACTERISTIC /end FUNCTION
/begin FUNCTION jAdaGlastRSP363_Fktn "Applikationesgroessen Instanz jAdaGlastRSP363" /begin DEF_CHARACTERISTIC KF_PGLSADNTSPORT63 /end DEF_CHARACTERISTIC /end FUNCTION
/begin FUNCTION jAdaGlastRSP364_Fktn "Applikationesgroessen Instanz jAdaGlastRSP364" /begin DEF_CHARACTERISTIC KF_PGLSADNTSPORT64 /end DEF_CHARACTERISTIC /end FUNCTION
/begin FUNCTION jAdaGlastRSP371_Fktn "Applikationesgroessen Instanz jAdaGlastRSP371" /begin DEF_CHARACTERISTIC KF_PGLSADNTSPORT71 /end DEF_CHARACTERISTIC /end FUNCTION
/begin FUNCTION jAdaGlastRSP375_Fktn "Applikationesgroessen Instanz jAdaGlastRSP375" /begin DEF_CHARACTERISTIC KF_PGLSADNTSPORT75 /end DEF_CHARACTERISTIC /end FUNCTION
/begin FUNCTION jAdaGlastRSP382_Fktn "Applikationesgroessen Instanz jAdaGlastRSP382" /begin DEF_CHARACTERISTIC KF_PGLSADNTSPORT82 /end DEF_CHARACTERISTIC /end FUNCTION
/begin FUNCTION jAdaGlastRSP384_Fktn "Applikationesgroessen Instanz jAdaGlastRSP384" /begin DEF_CHARACTERISTIC KF_PGLSADNTSPORT84 /end DEF_CHARACTERISTIC /end FUNCTION
/begin FUNCTION jAdaGlastRSP386_Fktn "Applikationesgroessen Instanz jAdaGlastRSP386" /begin DEF_CHARACTERISTIC KF_PGLSADNTSPORT86 /end DEF_CHARACTERISTIC /end FUNCTION
/begin FUNCTION jAdaGloku_Fktn "Applikationesgroessen Instanz jAdaGloku"
 /begin DEF_CHARACTERISTIC CS_LOCK GANG_LOCK KL_ADAKORPF KL_PF_MAXADAWERTDELTA KL_TSF_MAXADAWERTDELTA SWI_ADAKORPF SWI_KPL_LOCK SWI_KUPADASTART_SCHLECHTWEG TAB_KUPADA_SCHLECHTWEG TAB_NSEKPRUEF_KUPADA_PF TAB_NSEKPRUEF_KUPADA_TSF TAB_NSTARTPRUEF_KUPADA_PF TAB_PF_ADMAX TAB_PF_ADMIN TAB_SWI_KUPADA_PF TAB_SWI_KUPADA_START_PF TAB_SWI_KUPADA_TSF TAB_SWI_SEK_KUPADA_PF TAB_SWI_SEK_KUPADA_TSF TAB_TSF_ADMAX TAB_TSF_ADMIN TS_LOCK TS_MAX_LOCK /end DEF_CHARACTERISTIC
/end FUNCTION
/begin FUNCTION jAdaGlokuKA_Fktn "Applikationesgroessen Instanz jAdaGlokuKA" /begin DEF_CHARACTERISTIC KL_PRUEFKAD_PULS_PF_A KL_PRUEFKAD_PULS_TSF_A /end DEF_CHARACTERISTIC /end FUNCTION
/begin FUNCTION jAdaGlokuKB_Fktn "Applikationesgroessen Instanz jAdaGlokuKB" /begin DEF_CHARACTERISTIC KL_PRUEFKAD_PULS_PF_B KL_PRUEFKAD_PULS_TSF_B /end DEF_CHARACTERISTIC /end FUNCTION
/begin FUNCTION jAdaGlokuKC_Fktn "Applikationesgroessen Instanz jAdaGlokuKC" /begin DEF_CHARACTERISTIC KL_PRUEFKAD_PULS_PF_C KL_PRUEFKAD_PULS_TSF_C /end DEF_CHARACTERISTIC /end FUNCTION
/begin FUNCTION jAdaGlokuKD_Fktn "Applikationesgroessen Instanz jAdaGlokuKD" /begin DEF_CHARACTERISTIC KL_PRUEFKAD_PULS_PF_D KL_PRUEFKAD_PULS_TSF_D /end DEF_CHARACTERISTIC /end FUNCTION
/begin FUNCTION jAdaGlokuKE_Fktn "Applikationesgroessen Instanz jAdaGlokuKE" /begin DEF_CHARACTERISTIC KL_PRUEFKAD_PULS_PF_E KL_PRUEFKAD_PULS_TSF_E /end DEF_CHARACTERISTIC /end FUNCTION
/begin FUNCTION jAdaGlokuKK0_Fktn "Applikationesgroessen Instanz jAdaGlokuKK0" /begin DEF_CHARACTERISTIC KL_PRUEFKAD_PULS_PF_K0 KL_PRUEFKAD_PULS_TSF_K0 /end DEF_CHARACTERISTIC /end FUNCTION
/begin FUNCTION jAdaGlosc_Fktn "Applikationesgroessen Instanz jAdaGlosc"
 /begin DEF_CHARACTERISTIC AL_AXREF_ADAOFF MPT_AXREF_ADAOFF SWI_ADA_LOESCH SWI_AXREF_ADAOFF SWI_PARTFILTAKTIV TAB_SWI_SPS_ADAOFF /end DEF_CHARACTERISTIC
/end FUNCTION
/begin FUNCTION jAdaIaeap_Fktn "Applikationesgroessen Instanz jAdaIaeap"
 /begin DEF_CHARACTERISTIC CGETR_MAX_APADA_IAE CS_MAXDRIFT_APADA_IAE C_DELTA_MAX_APADA DKIS_ABBRUCH_APERK_IAE KL_BEIFL_BEWZ_APERK_IAE KL_BEIFL_KBPZ_APERK_IAE KL_CGETR_MIN_APADA_IAE KL_CTRSTART_APERK_IAE KL_FD_APADA_IAE KL_PO_APERK_IAE KL_PO_RAMPENINIT_APERK_IAE KL_UEF_ABSENK_APERK_IAE KL_UEF_ABSENK_START_APERK_IAE MDS_MMOT_APERK_IAE MDT_MGMOTIST_APERK_IAE MDT_NGMOT_APERK_IAE MGS_ABS_MMOT_ABBRUCH_APERK_IAE MGS_ABS_MMOT_APERK_IAE MG_MREF_APERK_IAE MO_STELL_ABBRUCH_APERK_IAE MPT_MMOTIST_APERK_IAE MPT_NMOT_APERK_IAE MS_LLPRUEF_APERK_IAE MS_MMOT_ABBRUCH_APERK_IAE MS_MOT_ABSENK_APERK_IAE NDS_NMOTSOLL_LL_APERK_IAE NDS_NMOT_APERK_IAE NGS_ABS_NMOT_ABBRUCH_APERK_IAE NGS_ABS_NMOT_APERK_IAE NG_NREF_APERK_IAE NS_MOTSOLL_LL_MIN_APERK_IAE NS_NAB_ABBRUCH_APERK_IAE PG_ABSENK_APERK_IAE PG_BREMS_ABBRUCH_APERK_IAE PG_NEG_ABBRUCH_APERK_IAE PG_NEG_HYS_APERK_IAE PG_POS_ABBRUCH_APERK_IAE PG_POS_HYS_APERK_IAE PG_PRUEF_APERK_IAE PO_ABSENK_APERK_IAE PO_BREMS_ABBRUCH_APERK_IAE PO_DELTA_MAX_APADA_IAE PO_HYSSCHLEIFE_APERK_IAE PO_NEG_APERK_IAE PO_PRUEF_MAX_APERK_IAE PO_TABMAX_APADA_IAE PO_TABMIN_APADA_IAE PS_MIN_ABSENK_APERK_IAE SWI_ADAIAE_KPLBINN SWI_APERK_IAE SWI_GE_APERK_IAE SWI_VORINFO_APERK_IAE TAB_NDS_NMOT_ABBRUCH_APERK_IAE TAB_Z_MODUS_IAE_APERK_IAE TS_LLPRUEF_APERK_IAE TS_PRUEFEN_APERK_IAE T_HALTE_M_ANGELEGT_APERK_IAE T_HALTE_N_ANGELEGT_APERK_IAE T_HALTE_RAMPENINIT_APERK_IAE T_HYSSCHLEIFE_APERK_IAE T_MAXWARTEN_APERK_IAE T_RUN_LLPRUEF_APERK_IAE T_SPERR_APERK_IAE T_UEF_ABSENK_APERK_IAE T_UEF_ABSENK_START_APERK_IAE T_WAIT_LLPRUEF_APERK_IAE T_WARTEN_APERK_IAE VPS_MAX_KUEHL_APERK_IAE ZIELGANG_APERK_IAE /end DEF_CHARACTERISTIC
/end FUNCTION
/begin FUNCTION jAdaIaeuf_Fktn "Applikationesgroessen Instanz jAdaIaeuf"
 /begin DEF_CHARACTERISTIC MIN_TPADA_UEFIAE MUE_KOR_MAX_UEFIAE MUE_KOR_MIN_UEFIAE SBAKLZ_ND_UEFIAE TAB_STUETZ_MSTELL_UEFIAE TAB_STUETZ_ND_UEFIAE /end DEF_CHARACTERISTIC
/end FUNCTION
/begin FUNCTION jAdaPfusf_Fktn "Applikationesgroessen Instanz jAdaPfusf"
 /begin DEF_CHARACTERISTIC CS_PFADOB CS_PFADRSUN DKIS_MOTPFADRS KL_CSPFADHSUN KL_DKISPFADMTHS KL_FPFADLZ KL_NGSABPFADMTHSOB KL_NGSABPFADMTHSUN ND_PFADHS ND_SYNISTGANG_KEINMTABBR NGS_ABPFADRSOB NGS_ABPFADRSUN NS_MOTPFADRS NS_PFADRS PS_PFADRS SWI_PFADHSSPABBR SWI_PFADRSSPABBR SWI_ZKINDEX_PFHS SWI_ZKINDEX_PFRS TAB_MAXFLARE_ADAPF TAB_MTPFADRSOB TAB_MTPFADRSUN TAB_NTPFADRSOB TAB_NTPFADRSUN TAB_SWIPFADHS TAB_SWIPFADRS TAB_ZWANGSBEW_ADAPF T_FNGABADA /end DEF_CHARACTERISTIC
/end FUNCTION
/begin FUNCTION jAdaPfusfEHS12_Fktn "Applikationesgroessen Instanz jAdaPfusfEHS12"
 /begin DEF_CHARACTERISTIC KF_PFADMTHS12 KL_MTPFADHSOB12 KL_MTPFADHSUN12 KL_NTPFADHSOB12 KL_NTPFADHSUN12 T_VPFADHS12 /end DEF_CHARACTERISTIC
/end FUNCTION
/begin FUNCTION jAdaPfusfEHS23_Fktn "Applikationesgroessen Instanz jAdaPfusfEHS23"
 /begin DEF_CHARACTERISTIC KF_PFADMTHS23 KL_MTPFADHSOB23 KL_MTPFADHSUN23 KL_NTPFADHSOB23 KL_NTPFADHSUN23 T_VPFADHS23 /end DEF_CHARACTERISTIC
/end FUNCTION
/begin FUNCTION jAdaPfusfEHS34_Fktn "Applikationesgroessen Instanz jAdaPfusfEHS34"
 /begin DEF_CHARACTERISTIC KF_PFADMTHS34 KL_MTPFADHSOB34 KL_MTPFADHSUN34 KL_NTPFADHSOB34 KL_NTPFADHSUN34 T_VPFADHS34 /end DEF_CHARACTERISTIC
/end FUNCTION
/begin FUNCTION jAdaPfusfEHS45_Fktn "Applikationesgroessen Instanz jAdaPfusfEHS45"
 /begin DEF_CHARACTERISTIC KF_PFADMTHS45 KL_MTPFADHSOB45 KL_MTPFADHSUN45 KL_NTPFADHSOB45 KL_NTPFADHSUN45 T_VPFADHS45 /end DEF_CHARACTERISTIC
/end FUNCTION
/begin FUNCTION jAdaPfusfEHS56_Fktn "Applikationesgroessen Instanz jAdaPfusfEHS56"
 /begin DEF_CHARACTERISTIC KF_PFADMTHS56 KL_MTPFADHSOB56 KL_MTPFADHSUN56 KL_NTPFADHSOB56 KL_NTPFADHSUN56 T_VPFADHS56 /end DEF_CHARACTERISTIC
/end FUNCTION
/begin FUNCTION jAdaPfusfEHS67_Fktn "Applikationesgroessen Instanz jAdaPfusfEHS67"
 /begin DEF_CHARACTERISTIC KF_PFADMTHS67 KL_MTPFADHSOB67 KL_MTPFADHSUN67 KL_NTPFADHSOB67 KL_NTPFADHSUN67 T_VPFADHS67 /end DEF_CHARACTERISTIC
/end FUNCTION
/begin FUNCTION jAdaPfusfEHS78_Fktn "Applikationesgroessen Instanz jAdaPfusfEHS78"
 /begin DEF_CHARACTERISTIC KF_PFADMTHS78 KL_MTPFADHSOB78 KL_MTPFADHSUN78 KL_NTPFADHSOB78 KL_NTPFADHSUN78 T_VPFADHS78 /end DEF_CHARACTERISTIC
/end FUNCTION
/begin FUNCTION jAdaPfusfERS21_Fktn "Applikationesgroessen Instanz jAdaPfusfERS21" /begin DEF_CHARACTERISTIC KF_PFADRS21 KL_PFADTSYN21 ND_PFADRS21 /end DEF_CHARACTERISTIC /end FUNCTION
/begin FUNCTION jAdaPfusfERS32_Fktn "Applikationesgroessen Instanz jAdaPfusfERS32" /begin DEF_CHARACTERISTIC KF_PFADRS32 KL_PFADTSYN32 ND_PFADRS32 /end DEF_CHARACTERISTIC /end FUNCTION
/begin FUNCTION jAdaPfusfERS43_Fktn "Applikationesgroessen Instanz jAdaPfusfERS43" /begin DEF_CHARACTERISTIC KF_PFADRS43 KL_PFADTSYN43 ND_PFADRS43 /end DEF_CHARACTERISTIC /end FUNCTION
/begin FUNCTION jAdaPfusfERS54_Fktn "Applikationesgroessen Instanz jAdaPfusfERS54" /begin DEF_CHARACTERISTIC KF_PFADRS54 KL_PFADTSYN54 ND_PFADRS54 /end DEF_CHARACTERISTIC /end FUNCTION
/begin FUNCTION jAdaPfusfERS65_Fktn "Applikationesgroessen Instanz jAdaPfusfERS65" /begin DEF_CHARACTERISTIC KF_PFADRS65 KL_PFADTSYN65 ND_PFADRS65 /end DEF_CHARACTERISTIC /end FUNCTION
/begin FUNCTION jAdaPfusfERS76_Fktn "Applikationesgroessen Instanz jAdaPfusfERS76" /begin DEF_CHARACTERISTIC KF_PFADRS76 KL_PFADTSYN76 ND_PFADRS76 /end DEF_CHARACTERISTIC /end FUNCTION
/begin FUNCTION jAdaPfusfERS87_Fktn "Applikationesgroessen Instanz jAdaPfusfERS87" /begin DEF_CHARACTERISTIC KF_PFADRS87 KL_PFADTSYN87 ND_PFADRS87 /end DEF_CHARACTERISTIC /end FUNCTION
/begin FUNCTION jAdaPstbwXPF_Fktn "Applikationesgroessen Instanz jAdaPstbwXPF"
 /begin DEF_CHARACTERISTIC TAB_ND_PULSAMP_STADA_PF TAB_ND_PULSNEG_STADA_PF TAB_ND_PULSPOS_STADA_PF TAB_ND_PULSZWNEG_STADA_PF TAB_ND_PULSZWPOS_STADA_PF /end DEF_CHARACTERISTIC
/end FUNCTION
/begin FUNCTION jAdaPstbwXSF_Fktn "Applikationesgroessen Instanz jAdaPstbwXSF"
 /begin DEF_CHARACTERISTIC TAB_ND_PULSAMP_STADA_TSF TAB_ND_PULSNEG_STADA_TSF TAB_ND_PULSPOS_STADA_TSF TAB_ND_PULSZWNEG_STADA_TSF TAB_ND_PULSZWPOS_STADA_TSF /end DEF_CHARACTERISTIC
/end FUNCTION
/begin FUNCTION jAdaPstpf_Fktn "Applikationesgroessen Instanz jAdaPstpf"
 /begin DEF_CHARACTERISTIC F_TVABBR_PF_STADA F_TVABBR_SF_STADA KL_PF_MAXADAWERTDELTA_STADA P_RAINCPF_STADA P_RAUEBINCPF_STADA P_ZWPFINC_STADA TAB_HAINCPF_STADA TAB_PF_ADMAX_STADA TAB_PF_ADMIN_STADA /end DEF_CHARACTERISTIC
/end FUNCTION
/begin FUNCTION jAdaPstpfKA_Fktn "Applikationesgroessen Instanz jAdaPstpfKA"
 /begin DEF_CHARACTERISTIC PO_FNACHADA_STADA_A PO_FVORADA_STADA_A P_PFPULS_STADA_A T_PFPULS_STADA_A T_UEAMPPF_STADA_A T_UEBEWNEGBPF_STADA_A T_UEBEWNEGEPF_STADA_A T_UEBEWPOSBPF_STADA_A T_UEBEWPOSEPF_STADA_A T_VPFPULS_STADA_A /end DEF_CHARACTERISTIC
/end FUNCTION
/begin FUNCTION jAdaPstpfKB_Fktn "Applikationesgroessen Instanz jAdaPstpfKB"
 /begin DEF_CHARACTERISTIC PO_FNACHADA_STADA_B PO_FVORADA_STADA_B P_PFPULS_STADA_B T_PFPULS_STADA_B T_UEAMPPF_STADA_B T_UEBEWNEGBPF_STADA_B T_UEBEWNEGEPF_STADA_B T_UEBEWPOSBPF_STADA_B T_UEBEWPOSEPF_STADA_B T_VPFPULS_STADA_B /end DEF_CHARACTERISTIC
/end FUNCTION
/begin FUNCTION jAdaPstpfKC_Fktn "Applikationesgroessen Instanz jAdaPstpfKC"
 /begin DEF_CHARACTERISTIC PO_FNACHADA_STADA_C PO_FVORADA_STADA_C P_PFPULS_STADA_C T_PFPULS_STADA_C T_UEAMPPF_STADA_C T_UEBEWNEGBPF_STADA_C T_UEBEWNEGEPF_STADA_C T_UEBEWPOSBPF_STADA_C T_UEBEWPOSEPF_STADA_C T_VPFPULS_STADA_C /end DEF_CHARACTERISTIC
/end FUNCTION
/begin FUNCTION jAdaPstpfKD_Fktn "Applikationesgroessen Instanz jAdaPstpfKD"
 /begin DEF_CHARACTERISTIC PO_FNACHADA_STADA_D PO_FVORADA_STADA_D P_PFPULS_STADA_D T_PFPULS_STADA_D T_UEAMPPF_STADA_D T_UEBEWNEGBPF_STADA_D T_UEBEWNEGEPF_STADA_D T_UEBEWPOSBPF_STADA_D T_UEBEWPOSEPF_STADA_D T_VPFPULS_STADA_D /end DEF_CHARACTERISTIC
/end FUNCTION
/begin FUNCTION jAdaPstpfKE_Fktn "Applikationesgroessen Instanz jAdaPstpfKE"
 /begin DEF_CHARACTERISTIC PO_FNACHADA_STADA_E PO_FVORADA_STADA_E P_PFPULS_STADA_E T_PFPULS_STADA_E T_UEAMPPF_STADA_E T_UEBEWNEGBPF_STADA_E T_UEBEWNEGEPF_STADA_E T_UEBEWPOSBPF_STADA_E T_UEBEWPOSEPF_STADA_E T_VPFPULS_STADA_E /end DEF_CHARACTERISTIC
/end FUNCTION
/begin FUNCTION jAdaPstpfKK0_Fktn "Applikationesgroessen Instanz jAdaPstpfKK0"
 /begin DEF_CHARACTERISTIC PO_FNACHADA_STADA_K0 PO_FVORADA_STADA_K0 P_PFPULS_STADA_K0 T_PFPULS_STADA_K0 T_UEAMPPF_STADA_K0 T_UEBEWNEGBPF_STADA_K0 T_UEBEWNEGEPF_STADA_K0 T_UEBEWPOSBPF_STADA_K0 T_UEBEWPOSEPF_STADA_K0 T_VPFPULS_STADA_K0 /end DEF_CHARACTERISTIC
/end FUNCTION
/begin FUNCTION jAdaPstsf_Fktn "Applikationesgroessen Instanz jAdaPstsf"
 /begin DEF_CHARACTERISTIC KL_TSF_MAXADAWERTDELTA_STADA TAB_HAINCTSF_STADA TAB_TSF_ADMAX_STADA TAB_TSF_ADMIN_STADA T_RAINCTSF_STADA T_RAUEBINCTSF_STADA T_ZWTSFINC_STADA /end DEF_CHARACTERISTIC
/end FUNCTION
/begin FUNCTION jAdaPstsfKA_Fktn "Applikationesgroessen Instanz jAdaPstsfKA"
 /begin DEF_CHARACTERISTIC PO_SFSTUFE_STADA_A TO_SFNACHADA_STADA_A TO_SFRED_STADA_A TO_SFVORADA_STADA_A T_SFSTUFE_STADA_A T_UEAMPTSF_STADA_A T_UEBEWNEGBTSF_STADA_A T_UEBEWNEGETSF_STADA_A T_UEBEWPOSBTSF_STADA_A T_UEBEWPOSETSF_STADA_A /end DEF_CHARACTERISTIC
/end FUNCTION
/begin FUNCTION jAdaPstsfKB_Fktn "Applikationesgroessen Instanz jAdaPstsfKB"
 /begin DEF_CHARACTERISTIC PO_SFSTUFE_STADA_B TO_SFNACHADA_STADA_B TO_SFRED_STADA_B TO_SFVORADA_STADA_B T_SFSTUFE_STADA_B T_UEAMPTSF_STADA_B T_UEBEWNEGBTSF_STADA_B T_UEBEWNEGETSF_STADA_B T_UEBEWPOSBTSF_STADA_B T_UEBEWPOSETSF_STADA_B /end DEF_CHARACTERISTIC
/end FUNCTION
/begin FUNCTION jAdaPstsfKC_Fktn "Applikationesgroessen Instanz jAdaPstsfKC"
 /begin DEF_CHARACTERISTIC PO_SFSTUFE_STADA_C TO_SFNACHADA_STADA_C TO_SFRED_STADA_C TO_SFVORADA_STADA_C T_SFSTUFE_STADA_C T_UEAMPTSF_STADA_C T_UEBEWNEGBTSF_STADA_C T_UEBEWNEGETSF_STADA_C T_UEBEWPOSBTSF_STADA_C T_UEBEWPOSETSF_STADA_C /end DEF_CHARACTERISTIC
/end FUNCTION
/begin FUNCTION jAdaPstsfKD_Fktn "Applikationesgroessen Instanz jAdaPstsfKD"
 /begin DEF_CHARACTERISTIC PO_SFSTUFE_STADA_D TO_SFNACHADA_STADA_D TO_SFRED_STADA_D TO_SFVORADA_STADA_D T_SFSTUFE_STADA_D T_UEAMPTSF_STADA_D T_UEBEWNEGBTSF_STADA_D T_UEBEWNEGETSF_STADA_D T_UEBEWPOSBTSF_STADA_D T_UEBEWPOSETSF_STADA_D /end DEF_CHARACTERISTIC
/end FUNCTION
/begin FUNCTION jAdaPstsfKE_Fktn "Applikationesgroessen Instanz jAdaPstsfKE"
 /begin DEF_CHARACTERISTIC PO_SFSTUFE_STADA_E TO_SFNACHADA_STADA_E TO_SFRED_STADA_E TO_SFVORADA_STADA_E T_SFSTUFE_STADA_E T_UEAMPTSF_STADA_E T_UEBEWNEGBTSF_STADA_E T_UEBEWNEGETSF_STADA_E T_UEBEWPOSBTSF_STADA_E T_UEBEWPOSETSF_STADA_E /end DEF_CHARACTERISTIC
/end FUNCTION
/begin FUNCTION jAdaPstsfKK0_Fktn "Applikationesgroessen Instanz jAdaPstsfKK0"
 /begin DEF_CHARACTERISTIC PO_SFSTUFE_STADA_K0 TO_SFNACHADA_STADA_K0 TO_SFRED_STADA_K0 TO_SFVORADA_STADA_K0 T_SFSTUFE_STADA_K0 T_UEAMPTSF_STADA_K0 T_UEBEWNEGBTSF_STADA_K0 T_UEBEWNEGETSF_STADA_K0 T_UEBEWPOSBTSF_STADA_K0 T_UEBEWPOSETSF_STADA_K0 /end DEF_CHARACTERISTIC
/end FUNCTION
/begin FUNCTION jAdaPstzs_Fktn "Applikationesgroessen Instanz jAdaPstzs"
 /begin DEF_CHARACTERISTIC CS_HYS_STADA CS_OB_STADA CS_UN_STADA DKIS_STADA FI_ADANEU_STADA KL_FIADAAKT_NPRUEFZYKL_NEG_STADA KL_FIADAAKT_NPRUEFZYKL_POS_STADA NS_AB_STADA NS_EMDELTA_STADA NS_EMOB_STADA NS_EMUN_STADA NS_MOTDELTA_STADA NS_MOTOB_STADA NS_MOTUN_STADA NS_VMPULS_STADA N_PULSGRENZ_STADA PS_STADA TAB_ND_ADABBR_STADA TAB_SWIPRUEF_STADA_PF TAB_SWIPRUEF_STADA_TSF TAB_TESTFALL_KUPADA_STADA TS_MAX_INIT_STADA TS_NMOTLEERSOLL_AKTIV_STADA T_VPSYSPULS_STADA /end DEF_CHARACTERISTIC
/end FUNCTION
/begin FUNCTION jAdaPstzsKA_Fktn "Applikationesgroessen Instanz jAdaPstzsKA" /begin DEF_CHARACTERISTIC T_SPTSFPULS_STADA_A /end DEF_CHARACTERISTIC /end FUNCTION
/begin FUNCTION jAdaPstzsKB_Fktn "Applikationesgroessen Instanz jAdaPstzsKB" /begin DEF_CHARACTERISTIC T_SPTSFPULS_STADA_B /end DEF_CHARACTERISTIC /end FUNCTION
/begin FUNCTION jAdaPstzsKC_Fktn "Applikationesgroessen Instanz jAdaPstzsKC" /begin DEF_CHARACTERISTIC T_SPTSFPULS_STADA_C /end DEF_CHARACTERISTIC /end FUNCTION
/begin FUNCTION jAdaPstzsKD_Fktn "Applikationesgroessen Instanz jAdaPstzsKD" /begin DEF_CHARACTERISTIC T_SPTSFPULS_STADA_D /end DEF_CHARACTERISTIC /end FUNCTION
/begin FUNCTION jAdaPstzsKE_Fktn "Applikationesgroessen Instanz jAdaPstzsKE" /begin DEF_CHARACTERISTIC T_SPTSFPULS_STADA_E /end DEF_CHARACTERISTIC /end FUNCTION
/begin FUNCTION jAdaPstzsKK0_Fktn "Applikationesgroessen Instanz jAdaPstzsKK0" /begin DEF_CHARACTERISTIC T_SPTSFPULS_STADA_K0 /end DEF_CHARACTERISTIC /end FUNCTION
/begin FUNCTION jAdaPulbwXPF_Fktn "Applikationesgroessen Instanz jAdaPulbwXPF"
 /begin DEF_CHARACTERISTIC T3_BEW_ABSCHALTKPAD_PF TAB_ND_PULSAMP_PF TAB_ND_PULSAMP_SEK_PF TAB_ND_PULSNEG_PF TAB_ND_PULSNEG_SEK_PF TAB_ND_PULSPOS_PF TAB_ND_PULSPOS_SEK_PF TAB_ND_PULSZWNEG_PF TAB_ND_PULSZWPOS_PF /end DEF_CHARACTERISTIC
/end FUNCTION
/begin FUNCTION jAdaPulbwXSF_Fktn "Applikationesgroessen Instanz jAdaPulbwXSF"
 /begin DEF_CHARACTERISTIC T3_BEW_ABSCHALTKPAD_TSF TAB_ND_PULSAMP_SEK_TSF TAB_ND_PULSAMP_TSF TAB_ND_PULSNEG_SEK_TSF TAB_ND_PULSNEG_TSF TAB_ND_PULSPOS_SEK_TSF TAB_ND_PULSPOS_TSF TAB_ND_PULSZWNEG_TSF TAB_ND_PULSZWPOS_TSF /end DEF_CHARACTERISTIC
/end FUNCTION
/begin FUNCTION jAdaPulpf_Fktn "Applikationesgroessen Instanz jAdaPulpf"
 /begin DEF_CHARACTERISTIC F_TVABBR P_RAINCPF P_RAUEBINCPF P_ZWPFINC TAB_HAINCPF TAB_POPULSADAGANG /end DEF_CHARACTERISTIC
/end FUNCTION
/begin FUNCTION jAdaPulpfKA_Fktn "Applikationesgroessen Instanz jAdaPulpfKA"
 /begin DEF_CHARACTERISTIC PO_FNACHADA_A PO_FVORADASTART_A PO_FVORADA_A P_PFPULS_A T_PFPULS_A T_UEAMPPF_A T_UEBEWNEGBPF_A T_UEBEWNEGEPF_A T_UEBEWPOSBPF_A T_UEBEWPOSEPF_A T_VPFPULS_A /end DEF_CHARACTERISTIC
/end FUNCTION
/begin FUNCTION jAdaPulpfKB_Fktn "Applikationesgroessen Instanz jAdaPulpfKB"
 /begin DEF_CHARACTERISTIC PO_FNACHADA_B PO_FVORADASTART_B PO_FVORADA_B P_PFPULS_B T_PFPULS_B T_UEAMPPF_B T_UEBEWNEGBPF_B T_UEBEWNEGEPF_B T_UEBEWPOSBPF_B T_UEBEWPOSEPF_B T_VPFPULS_B /end DEF_CHARACTERISTIC
/end FUNCTION
/begin FUNCTION jAdaPulpfKC_Fktn "Applikationesgroessen Instanz jAdaPulpfKC"
 /begin DEF_CHARACTERISTIC PO_FNACHADA_C PO_FVORADASTART_C PO_FVORADA_C P_PFPULS_C T_PFPULS_C T_UEAMPPF_C T_UEBEWNEGBPF_C T_UEBEWNEGEPF_C T_UEBEWPOSBPF_C T_UEBEWPOSEPF_C T_VPFPULS_C /end DEF_CHARACTERISTIC
/end FUNCTION
/begin FUNCTION jAdaPulpfKD_Fktn "Applikationesgroessen Instanz jAdaPulpfKD"
 /begin DEF_CHARACTERISTIC PO_FNACHADA_D PO_FVORADASTART_D PO_FVORADA_D P_PFPULS_D T_PFPULS_D T_UEAMPPF_D T_UEBEWNEGBPF_D T_UEBEWNEGEPF_D T_UEBEWPOSBPF_D T_UEBEWPOSEPF_D T_VPFPULS_D /end DEF_CHARACTERISTIC
/end FUNCTION
/begin FUNCTION jAdaPulpfKE_Fktn "Applikationesgroessen Instanz jAdaPulpfKE"
 /begin DEF_CHARACTERISTIC PO_FNACHADA_E PO_FVORADASTART_E PO_FVORADA_E P_PFPULS_E T_PFPULS_E T_UEAMPPF_E T_UEBEWNEGBPF_E T_UEBEWNEGEPF_E T_UEBEWPOSBPF_E T_UEBEWPOSEPF_E T_VPFPULS_E /end DEF_CHARACTERISTIC
/end FUNCTION
/begin FUNCTION jAdaPulpfKK0_Fktn "Applikationesgroessen Instanz jAdaPulpfKK0"
 /begin DEF_CHARACTERISTIC PO_FNACHADA_K0 PO_FVORADASTART_K0 PO_FVORADA_K0 P_PFPULS_K0 T_PFPULS_K0 T_UEAMPPF_K0 T_UEBEWNEGBPF_K0 T_UEBEWNEGEPF_K0 T_UEBEWPOSBPF_K0 T_UEBEWPOSEPF_K0 T_VPFPULS_K0 /end DEF_CHARACTERISTIC
/end FUNCTION
/begin FUNCTION jAdaPulsf_Fktn "Applikationesgroessen Instanz jAdaPulsf"
 /begin DEF_CHARACTERISTIC TAB_HAINCTSF TAB_TOPULSADAGANG T_RAINCTSF T_RAUEBINCTSF T_ZWTSFINC /end DEF_CHARACTERISTIC
/end FUNCTION
/begin FUNCTION jAdaPulsfKA_Fktn "Applikationesgroessen Instanz jAdaPulsfKA"
 /begin DEF_CHARACTERISTIC PO_SFSTUFE_A TO_SFNACHADA_A TO_SFVORADA_A T_SFSTUFE_A T_UEAMPTSF_A T_UEBEWNEGBTSF_A T_UEBEWNEGETSF_A T_UEBEWPOSBTSF_A T_UEBEWPOSETSF_A /end DEF_CHARACTERISTIC
/end FUNCTION
/begin RECORD_LAYOUT ZF_kf_si16_S5_S3 FNC_VALUES 5 SWORD ROW_DIR DIRECT AXIS_PTS_X 3 SWORD INDEX_INCR DIRECT AXIS_PTS_Y 4 SWORD INDEX_INCR DIRECT NO_AXIS_PTS_X 1 ULONG NO_AXIS_PTS_Y 2 ULONG /end RECORD_LAYOUT
/begin RECORD_LAYOUT ZF_kl_si16_S5_S3 FNC_VALUES 3 SWORD COLUMN_DIR DIRECT AXIS_PTS_X 2 SWORD INDEX_INCR DIRECT NO_AXIS_PTS_X 1 ULONG /end RECORD_LAYOUT
/begin RECORD_LAYOUT ZF_kl_ui16_S5_S3 FNC_VALUES 3 UWORD COLUMN_DIR DIRECT AXIS_PTS_X 2 UWORD INDEX_INCR DIRECT NO_AXIS_PTS_X 1 ULONG /end RECORD_LAYOUT
/begin RECORD_LAYOUT ZF_kl_ui8_S5_S3 FNC_VALUES 3 UBYTE COLUMN_DIR DIRECT AXIS_PTS_X 2 UBYTE INDEX_INCR DIRECT NO_AXIS_PTS_X 1 ULONG /end RECORD_LAYOUT
/begin RECORD_LAYOUT ZF_kw_bool8_S5_S3 FNC_VALUES 1 UBYTE COLUMN_DIR DIRECT /end RECORD_LAYOUT
/begin RECORD_LAYOUT ZF_kw_si16_S5_S3 FNC_VALUES 1 SWORD COLUMN_DIR DIRECT /end RECORD_LAYOUT
/begin RECORD_LAYOUT ZF_kw_si8_S5_S3 FNC_VALUES 1 SBYTE COLUMN_DIR DIRECT /end RECORD_LAYOUT
/begin RECORD_LAYOUT ZF_kw_ui16_S5_S3 FNC_VALUES 1 UWORD COLUMN_DIR DIRECT /end RECORD_LAYOUT
/begin RECORD_LAYOUT ZF_kw_ui8_S5_S3 FNC_VALUES 1 UBYTE COLUMN_DIR DIRECT /end RECORD_LAYOUT
/begin RECORD_LAYOUT ZF_tab2d_si16_S5_S3 FNC_VALUES 3 SWORD ROW_DIR DIRECT NO_AXIS_PTS_X 1 ULONG NO_AXIS_PTS_Y 2 ULONG /end RECORD_LAYOUT
/begin RECORD_LAYOUT ZF_tab_bool8_S5_S3 FNC_VALUES 2 UBYTE COLUMN_DIR DIRECT NO_AXIS_PTS_X 1 ULONG /end RECORD_LAYOUT
/begin RECORD_LAYOUT ZF_tab_si16_S5_S3 FNC_VALUES 2 SWORD COLUMN_DIR DIRECT NO_AXIS_PTS_X 1 ULONG /end RECORD_LAYOUT
/begin RECORD_LAYOUT ZF_tab_ui16_S5_S3 FNC_VALUES 2 UWORD COLUMN_DIR DIRECT NO_AXIS_PTS_X 1 ULONG /end RECORD_LAYOUT
/begin RECORD_LAYOUT ZF_tab_ui8_S5_S3 FNC_VALUES 2 UBYTE COLUMN_DIR DIRECT NO_AXIS_PTS_X 1 ULONG /end RECORD_LAYOUT
/end MODULE
/end PROJECT
