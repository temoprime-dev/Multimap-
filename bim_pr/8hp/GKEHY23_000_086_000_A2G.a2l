ASAP2_VERSION 1 51
/begin PROJECT ZHBC8600 "Gen2_BMW_System_Supplier_Lib"
/begin MODULE CPP ""
/begin MOD_COMMON "" BYTE_ORDER MSB_FIRST ALIGNMENT_BYTE 1 ALIGNMENT_WORD 2 ALIGNMENT_LONG 4 ALIGNMENT_FLOAT32_IEEE 4 ALIGNMENT_FLOAT64_IEEE 1 /end MOD_COMMON
/begin COMPU_VTAB Conv.cBasFehlerErfolgFl._.flag_fehler_S5_S3 "Umrechnung fuer Messgroesse cBasFehlerErfolgFl::flag_fehler" TAB_VERB 2 0 "keine Fehler vorhanden" 1 "Fehler vorhanden" DEFAULT_VALUE "" /end COMPU_VTAB
/begin COMPU_VTAB Conv.cBasFehlerErfolgInt._.flag_fehler_S5_S3 "Umrechnung fuer Messgroesse cBasFehlerErfolgInt::flag_fehler" TAB_VERB 2 0 "keine Fehler vorhanden" 1 "Fehler vorhanden" DEFAULT_VALUE "" /end COMPU_VTAB
/begin COMPU_VTAB Conv.cUl2KraftschlussFl._.zustand_gespeichert_S5_S3 "Umrechnung fuer Messgroesse cUl2KraftschlussFl::zustand_gespeichert" TAB_VERB 2 85 "Kraftfluss Rückwärts NICHT erkannt" 170 "Kraftfluss Rückwärts erkannt" DEFAULT_VALUE "" /end COMPU_VTAB
/begin COMPU_VTAB Conv.cUl2KraftschlussFl._.zustand_S5_S3 "Umrechnung fuer Messgroesse cUl2KraftschlussFl::zustand" TAB_VERB 2 85 "(nicht) Kraftfluss Rückwärts erkannt" 170 "Kraftfluss Rückwärts erkannt" DEFAULT_VALUE "" /end COMPU_VTAB
/begin COMPU_VTAB Conv.cUl2KraftschlussInt._.kup_b_geschl_S5_S3 "Umrechnung fuer Messgroesse cUl2KraftschlussInt::kup_b_geschl" TAB_VERB 2 0 "offen" 1 "geschlossen" DEFAULT_VALUE "" /end COMPU_VTAB
/begin COMPU_VTAB Conv.cUl2KraftschlussInt._.kup_d_geschl_S5_S3 "Umrechnung fuer Messgroesse cUl2KraftschlussInt::kup_d_geschl" TAB_VERB 2 0 "offen" 1 "geschlossen" DEFAULT_VALUE "" /end COMPU_VTAB
/begin COMPU_VTAB Conv.cUl2KraftschlussInt._.zustand_gespeichert_S5_S3 "Umrechnung fuer Messgroesse cUl2KraftschlussInt::zustand_gespeichert" TAB_VERB 2 85 "(nicht) Kraftfluss Rückwärts erkannt" 170 "Kraftfluss Rückwärts erkannt" DEFAULT_VALUE "" /end COMPU_VTAB
/begin COMPU_VTAB Conv.cUl2KraftschlussInt._.zustand_S5_S3 "Umrechnung fuer Messgroesse cUl2KraftschlussInt::zustand" TAB_VERB 2 85 "(nicht) Kraftfluss Rückwärts erkannt" 170 "Kraftfluss Rückwärts erkannt" DEFAULT_VALUE "" /end COMPU_VTAB
/begin COMPU_VTAB Conv.cUl2KupplAbsInt._.typ_S5_S3 "Umrechnung fuer Messgroesse cUl2KupplAbsInt::typ" TAB_VERB 2 0 "hart geschaltet erkennen: Steigend >= 850mA/Fallend <= 50mA" 1 "hart offen erkennen: Steigend <=50mA/ Fallend >=850 mA" DEFAULT_VALUE "" /end COMPU_VTAB
/begin COMPU_VTAB Conv.cUl2KupplAbsInt._.zustand_S5_S3 "Umrechnung fuer Messgroesse cUl2KupplAbsInt::zustand" TAB_VERB 2 0 "offen" 1 "geschlossen" DEFAULT_VALUE "" /end COMPU_VTAB
/begin COMPU_VTAB Conv.cUl2KupplBSfktFl._.n_kup_zu_edslogik_anfahrkup_S5_S3 "Umrechnung fuer Messgroesse cUl2KupplBSfktFl::n_kup_zu_edslogik_anfahrkup" TAB_VERB 2 0 "offen" 1 "geschlossen" DEFAULT_VALUE "" /end COMPU_VTAB
/begin COMPU_VTAB Conv.cUl2KupplBSfktInt._.n_kup_zu_edslogik_anfahrkup_S5_S3 "Umrechnung fuer Messgroesse cUl2KupplBSfktInt::n_kup_zu_edslogik_anfahrkup" TAB_VERB 2 0 "offen" 1 "geschlossen" DEFAULT_VALUE "" /end COMPU_VTAB
/begin COMPU_VTAB Conv.cUl2MeKoordFl._.err_neg_me_S5_S3 "Umrechnung fuer Messgroesse cUl2MeKoordFl::err_neg_me" TAB_VERB 2 0 "Keine Fehler bei neg. ME" 1 "Fehler in neg. ME" DEFAULT_VALUE "" /end COMPU_VTAB
/begin COMPU_VTAB Conv.cUl2MeKoordFl._.err_pos_me_S5_S3 "Umrechnung fuer Messgroesse cUl2MeKoordFl::err_pos_me" TAB_VERB 2 0 "Keine Fehler bei pos. ME" 1 "Fehler in pos. ME" DEFAULT_VALUE "" /end COMPU_VTAB
/begin COMPU_VTAB Conv.cUl2MeKoordInt._.err_grad_pos_me_S5_S3 "Umrechnung fuer Messgroesse cUl2MeKoordInt::err_grad_pos_me" TAB_VERB 2 0 "FALSE" 1 "TRUE" DEFAULT_VALUE "" /end COMPU_VTAB
/begin COMPU_VTAB Conv.cUl2MeKoordInt._.err_int_neg_me_S5_S3 "Umrechnung fuer Messgroesse cUl2MeKoordInt::err_int_neg_me" TAB_VERB 2 0 "FALSE" 1 "TRUE" DEFAULT_VALUE "" /end COMPU_VTAB
/begin COMPU_VTAB Conv.cUl2MeKoordInt._.err_int_pos_me_S5_S3 "Umrechnung fuer Messgroesse cUl2MeKoordInt::err_int_pos_me" TAB_VERB 2 0 "FALSE" 1 "TRUE" DEFAULT_VALUE "" /end COMPU_VTAB
/begin COMPU_VTAB Conv.cUl2MeKoordInt._.err_neg_me_S5_S3 "Umrechnung fuer Messgroesse cUl2MeKoordInt::err_neg_me" TAB_VERB 2 0 "Keine Fehler bei neg. ME" 1 "Fehler in neg. ME" DEFAULT_VALUE "" /end COMPU_VTAB
/begin COMPU_VTAB Conv.cUl2MeKoordInt._.err_pos_me_S5_S3 "Umrechnung fuer Messgroesse cUl2MeKoordInt::err_pos_me" TAB_VERB 2 0 "Keine Fehler bei pos. ME" 1 "Fehler in pos. ME" DEFAULT_VALUE "" /end COMPU_VTAB
/begin COMPU_VTAB Conv.cUl2MeKoordInt._.err_sig_neg_me_S5_S3 "Umrechnung fuer Messgroesse cUl2MeKoordInt::err_sig_neg_me" TAB_VERB 2 0 "FALSE" 1 "TRUE" DEFAULT_VALUE "" /end COMPU_VTAB
/begin COMPU_VTAB Conv.cUl2MeKoordInt._.err_sig_pos_me_S5_S3 "Umrechnung fuer Messgroesse cUl2MeKoordInt::err_sig_pos_me" TAB_VERB 2 0 "FALSE" 1 "TRUE" DEFAULT_VALUE "" /end COMPU_VTAB
/begin COMPU_VTAB Conv.cUl2Nmotu._.dsc_fehler_alt_komp_S5_S3 "Umrechnung fuer Messgroesse cUl2Nmotu::dsc_fehler_alt_komp" TAB_VERB 2 0 "im vorherigen Programmzyklus lag KEIN DSC-Fehler vor" 1 "im vorherigen Programmzyklus lag ein DSC-Fehler vor" DEFAULT_VALUE "" /end COMPU_VTAB
/begin COMPU_VTAB Conv.cUl2Nmotu._.dsc_fehler_alt_S5_S3 "Umrechnung fuer Messgroesse cUl2Nmotu::dsc_fehler_alt" TAB_VERB 2 0 "im vorherigen Programmzyklus lag KEIN DSC-Fehler vor" 1 "im vorherigen Programmzyklus lag ein DSC-Fehler vor" DEFAULT_VALUE "" /end COMPU_VTAB
/begin COMPU_VTAB Conv.cUl2Nmotu._.ntmaxzg_verz_aktiv_komp_S5_S3 "Umrechnung fuer Messgroesse cUl2Nmotu::ntmaxzg_verz_aktiv_komp" TAB_VERB 2 0 "keine Verzoegerung der Zielgangabhaengige N_T-Grenzdrehzahl bei Reduzierung aktiv" 1 "Verzoegerung der Zielgangabhaengige N_T-Grenzdrehzahl bei Reduzierung aktiv" DEFAULT_VALUE "" /end COMPU_VTAB
/begin COMPU_VTAB Conv.cUl2Nmotu._.ntmaxzg_verz_aktiv_S5_S3 "Umrechnung fuer Messgroesse cUl2Nmotu::ntmaxzg_verz_aktiv" TAB_VERB 2 0 "keine Verzoegerung der Zielgangabhaengige N_T-Grenzdrehzahl bei Reduzierung aktiv" 1 "Verzoegerung der Zielgangabhaengige N_T-Grenzdrehzahl bei Reduzierung aktiv" DEFAULT_VALUE "" /end COMPU_VTAB
/begin COMPU_VTAB Conv.cUl2Nmotu._.pruefbed_nmotueb_l2_komp_S5_S3 "Umrechnung fuer Messgroesse cUl2Nmotu::pruefbed_nmotueb_l2_komp" TAB_VERB 2 0 "NMOTUEB Puefbed. NICHT erfuellt" 1 "NMOTUEB Puefbed. erfuellt" DEFAULT_VALUE "" /end COMPU_VTAB
/begin COMPU_VTAB Conv.cUl2Nmotu._.pruefbed_nmotueb_l2_S5_S3 "Umrechnung fuer Messgroesse cUl2Nmotu::pruefbed_nmotueb_l2" TAB_VERB 2 0 "NMOTUEB Puefbed. NICHT erfuellt" 1 "NMOTUEB Puefbed. erfuellt" DEFAULT_VALUE "" /end COMPU_VTAB
/begin COMPU_VTAB Conv.cUl2Nmotu._.z_nmotabreg_l2_komp_S5_S3 "Umrechnung fuer Messgroesse cUl2Nmotu::z_nmotabreg_l2_komp" TAB_VERB 3 0 "N_Mot-Abregeldrehzahl statisch konstant" 1 "Verzoegerung der Reduzierung der N_Mot-Abregeldrehzahl" 2 "Reduzierung der N_Mot-Abregeldrehzahl durch Minwertnachfuehrung aktiv" DEFAULT_VALUE "" /end COMPU_VTAB
/begin COMPU_VTAB Conv.cUl2Nmotu._.z_nmotabreg_l2_S5_S3 "Umrechnung fuer Messgroesse cUl2Nmotu::z_nmotabreg_l2" TAB_VERB 3 0 "N_Mot-Abregeldrehzahl statisch konstant" 1 "Verzoegerung der Reduzierung der N_Mot-Abregeldrehzahl" 2 "Reduzierung der N_Mot-Abregeldrehzahl durch Minwertnachfuehrung aktiv" DEFAULT_VALUE "" /end COMPU_VTAB
/begin COMPU_VTAB Conv.cUl2Nmotu._.z_nt_max_zg_l2_komp_S5_S3 "Umrechnung fuer Messgroesse cUl2Nmotu::z_nt_max_zg_l2_komp" TAB_VERB 3 0 "Zielgangabhaengige N_T-Grenzdrehzahl statisch konstant" 1 "Verzoegerung der Reduzierung der N_T-Grenzdrehzahl" 2 "Reduzierung der N_T-Grenzdrehzahl durch Minwertnachfuehrung aktiv" DEFAULT_VALUE "" /end COMPU_VTAB
/begin COMPU_VTAB Conv.cUl2Nmotu._.z_nt_max_zg_l2_S5_S3 "Umrechnung fuer Messgroesse cUl2Nmotu::z_nt_max_zg_l2" TAB_VERB 3 0 "Zielgangabhaengige N_T-Grenzdrehzahl statisch konstant" 1 "Verzoegerung der Reduzierung der N_T-Grenzdrehzahl" 2 "Reduzierung der N_T-Grenzdrehzahl durch Minwertnachfuehrung aktiv" DEFAULT_VALUE "" /end COMPU_VTAB
/begin COMPU_VTAB Conv.cUl2Nmotu._.zielgang_sas_alt_l2_komp_S5_S3 "Umrechnung fuer Messgroesse cUl2Nmotu::zielgang_sas_alt_l2_komp" TAB_VERB 10 -1 "GR1" 0 "KEIN_GANG" 1 "G1" 2 "G2" 3 "G3" 4 "G4" 5 "G5" 6 "G6" 7 "G7" 8 "G8" DEFAULT_VALUE "" /end COMPU_VTAB
/begin COMPU_VTAB Conv.cUl2Nmotu._.zielgang_sas_alt_l2_S5_S3 "Umrechnung fuer Messgroesse cUl2Nmotu::zielgang_sas_alt_l2" TAB_VERB 10 -1 "GR1" 0 "KEIN_GANG" 1 "G1" 2 "G2" 3 "G3" 4 "G4" 5 "G5" 6 "G6" 7 "G7" 8 "G8" DEFAULT_VALUE "" /end COMPU_VTAB
/begin COMPU_VTAB Conv.cUl2PAbsicherungAuslPFl._.einst_bed_einmalig_S5_S3 "Umrechnung fuer Messgroesse cUl2PAbsicherungAuslPFl::einst_bed_einmalig" TAB_VERB 2 0 "P u. Sensorsignal NICHT einmalig gesetzt" 1 "P u. Sensorsignal einmalig gesetzt" DEFAULT_VALUE "" /end COMPU_VTAB
/begin COMPU_VTAB Conv.cUl2PAbsicherungAuslPFl._.f_call_ext_S5_S3 "Umrechnung fuer Messgroesse cUl2PAbsicherungAuslPFl::f_call_ext" TAB_VERB 2 0 "Fehlerfunktion wurde NICHT aufgerufen" 1 "Fehlerfunktion wurde aufgerufen" DEFAULT_VALUE "" /end COMPU_VTAB
/begin COMPU_VTAB Conv.cUl2PAbsicherungAuslPInt._.einst_bed_einmalig_S5_S3 "Umrechnung fuer Messgroesse cUl2PAbsicherungAuslPInt::einst_bed_einmalig" TAB_VERB 2 0 "P u. Sensorsignal NICHT einmalig gesetzt" 1 "P u. Sensorsignal einmalig gesetzt" DEFAULT_VALUE "" /end COMPU_VTAB
/begin COMPU_VTAB Conv.cUl2PAbsicherungAuslPInt._.f_call_ext_S5_S3 "Umrechnung fuer Messgroesse cUl2PAbsicherungAuslPInt::f_call_ext" TAB_VERB 2 0 "Fehlerfunktion wurde NICHT aufgerufen" 1 "Fehlerfunktion wurde aufgerufen" DEFAULT_VALUE "" /end COMPU_VTAB
/begin COMPU_VTAB Conv.cUl2PosMeIntenFl._.schwellen_variante_S5_S3 "Umrechnung fuer Messgroesse cUl2PosMeIntenFl::schwellen_variante" TAB_VERB 2 1 "Variante 1 mit KL_MMOTUEBPOSME1 und N_MAXSTOERPOSMEINT1" 2 "Variante 2 mit KL_MMOTUEBPOSME2 und N_MAXSTOERPOSMEINT2" DEFAULT_VALUE "" /end COMPU_VTAB
/begin COMPU_VTAB Conv.cUl2PosMeIntenInt._.schwellen_variante_S5_S3 "Umrechnung fuer Messgroesse cUl2PosMeIntenInt::schwellen_variante" TAB_VERB 2 1 "Variante 1 mit KL_MMOTUEBPOSME1 und N_MAXSTOERPOSMEINT1" 2 "Variante 2 mit KL_MMOTUEBPOSME2 und N_MAXSTOERPOSMEINT2" DEFAULT_VALUE "" /end COMPU_VTAB
/begin COMPU_VTAB Conv.cUl2PosNPlFl._.f_phase_b_aktiv_S5_S3 "Umrechnung fuer Messgroesse cUl2PosNPlFl::f_phase_b_aktiv" TAB_VERB 2 0 "Ueberwachung prueft Phase A" 1 "Ueberwachung prueft Phase B" DEFAULT_VALUE "" /end COMPU_VTAB
/begin COMPU_VTAB Conv.cUl2PosNPlInt._.f_phase_b_aktiv_S5_S3 "Umrechnung fuer Messgroesse cUl2PosNPlInt::f_phase_b_aktiv" TAB_VERB 2 0 "Ueberwachung prueft Phase A" 1 "Ueberwachung prueft Phase B" DEFAULT_VALUE "" /end COMPU_VTAB
/begin COMPU_VTAB Conv.cUl2StromlosAusserPsFl._.alt_stromlos_ausser_ps_l2_S5_S3 "Umrechnung fuer Messgroesse cUl2StromlosAusserPsFl::alt_stromlos_ausser_ps_l2" TAB_VERB 2 0 "alle relevanten Druckregler >50mA" 1 "alle relevanten Druckregler <=50mA (Stromlos)" DEFAULT_VALUE "" /end COMPU_VTAB
/begin COMPU_VTAB Conv.cUl2StromlosAusserPsFl._.stromlos_ausser_ps_l2_S5_S3 "Umrechnung fuer Messgroesse cUl2StromlosAusserPsFl::stromlos_ausser_ps_l2" TAB_VERB 2 0 "alle relevanten Druckregler >50mA" 1 "alle relevanten Druckregler <=50mA (Stromlos)" DEFAULT_VALUE "" /end COMPU_VTAB
/begin COMPU_VTAB Conv.cUl2StromlosAusserPsInt._.alt_stromlos_ausser_ps_l2_S5_S3 "Umrechnung fuer Messgroesse cUl2StromlosAusserPsInt::alt_stromlos_ausser_ps_l2" TAB_VERB 2 0 "alle relevanten Druckregler >50mA" 1 "alle relevanten Druckregler <=50mA (Stromlos)" DEFAULT_VALUE "" /end COMPU_VTAB
/begin COMPU_VTAB Conv.cUl2StromlosAusserPsInt._.stromlos_ausser_ps_l2_S5_S3 "Umrechnung fuer Messgroesse cUl2StromlosAusserPsInt::stromlos_ausser_ps_l2" TAB_VERB 2 0 "alle relevanten Druckregler >50mA" 1 "alle relevanten Druckregler <=50mA (Stromlos)" DEFAULT_VALUE "" /end COMPU_VTAB
/begin COMPU_VTAB Conv.mv_1_S5_S3 "Umrechnung fuer Messgroesse mv_1" TAB_VERB 2 0 "OFF" 1 "ON" DEFAULT_VALUE "" /end COMPU_VTAB
/begin COMPU_VTAB Conv.mv_2_S5_S3 "Umrechnung fuer Messgroesse mv_2" TAB_VERB 2 0 "OFF" 1 "ON" DEFAULT_VALUE "" /end COMPU_VTAB
/begin COMPU_VTAB Conv.mv_3_S5_S3 "Umrechnung fuer Messgroesse mv_3" TAB_VERB 2 0 "OFF" 1 "ON" DEFAULT_VALUE "" /end COMPU_VTAB
/begin COMPU_VTAB Conv.zff_atsys._.cSignale._.sig_e_fahren_S5_S3 "Umrechnung fuer Messgroesse zff_atsys::cSignale::sig_e_fahren" TAB_VERB 2 0 "V_FAHREN_AKTIV" 1 "E_FAHREN_AKTIV" DEFAULT_VALUE "" /end COMPU_VTAB
/begin COMPU_VTAB Conv.zff_atsys._.cSignale._.sig_istgang_idx_S5_S3 "Umrechnung fuer Messgroesse zff_atsys::cSignale::sig_istgang_idx" TAB_VERB 10 0 "GR1" 1 "KEIN_GANG" 2 "G1" 3 "G2" 4 "G3" 5 "G4" 6 "G5" 7 "G6" 8 "G7" 9 "G8" DEFAULT_VALUE "" /end COMPU_VTAB
/begin COMPU_VTAB Conv.zff_atsys._.cSignale._.sig_istgang_S5_S3 "Umrechnung fuer Messgroesse zff_atsys::cSignale::sig_istgang" TAB_VERB 10 -1 "GR1" 0 "KEIN_GANG" 1 "G1" 2 "G2" 3 "G3" 4 "G4" 5 "G5" 6 "G6" 7 "G7" 8 "G8" DEFAULT_VALUE "" /end COMPU_VTAB
/begin COMPU_VTAB Conv.zff_atsys._.cSignale._.sig_istgang_vorw_S5_S3 "Umrechnung fuer Messgroesse zff_atsys::cSignale::sig_istgang_vorw" TAB_VERB 9 0 "KEIN_GANG" 1 "G1" 2 "G2" 3 "G3" 4 "G4" 5 "G5" 6 "G6" 7 "G7" 8 "G8" DEFAULT_VALUE "" /end COMPU_VTAB
/begin COMPU_VTAB Conv.zff_atsys._.cSignale._.sig_kfl_ist_S5_S3 "Umrechnung fuer Messgroesse zff_atsys::cSignale::sig_kfl_ist" TAB_VERB 3 0 "KEIN_KFL" 1 "KFL_VORWAERTS" 2 "KFL_RUECKWAERTS" DEFAULT_VALUE "" /end COMPU_VTAB
/begin COMPU_VTAB Conv.zff_atsys._.cSignale._.sig_kfl_ziel_S5_S3 "Umrechnung fuer Messgroesse zff_atsys::cSignale::sig_kfl_ziel" TAB_VERB 3 0 "KEIN_KFL" 1 "KFL_VORWAERTS" 2 "KFL_RUECKWAERTS" DEFAULT_VALUE "" /end COMPU_VTAB
/begin COMPU_VTAB Conv.zff_atsys._.cSignale._.sig_serapflag_komp_S5_S3 "Umrechnung fuer Messgroesse zff_atsys::cSignale::sig_serapflag_komp" TAB_VERB 2 254 "Referenzseite aktiv" 255 "Arbeitsseite aktiv" DEFAULT_VALUE "" /end COMPU_VTAB
/begin COMPU_VTAB Conv.zff_atsys._.cSignale._.sig_serapflag_S5_S3 "Umrechnung fuer Messgroesse zff_atsys::cSignale::sig_serapflag" TAB_VERB 2 0 "Referenzseite aktiv" 1 "Arbeitsseite aktiv" DEFAULT_VALUE "" /end COMPU_VTAB
/begin COMPU_VTAB Conv.zff_atsys._.cSignale._.sig_zielgang_idx_S5_S3 "Umrechnung fuer Messgroesse zff_atsys::cSignale::sig_zielgang_idx" TAB_VERB 10 0 "GR1" 1 "KEIN_GANG" 2 "G1" 3 "G2" 4 "G3" 5 "G4" 6 "G5" 7 "G6" 8 "G7" 9 "G8" DEFAULT_VALUE "" /end COMPU_VTAB
/begin COMPU_VTAB Conv.zff_atsys._.cSignale._.sig_zielgang_S5_S3 "Umrechnung fuer Messgroesse zff_atsys::cSignale::sig_zielgang" TAB_VERB 10 -1 "GR1" 0 "KEIN_GANG" 1 "G1" 2 "G2" 3 "G3" 4 "G4" 5 "G5" 6 "G6" 7 "G7" 8 "G8" DEFAULT_VALUE "" /end COMPU_VTAB
/begin COMPU_VTAB Conv.zff_atsys._.cSignale._.sig_zielgang_sas_idx_S5_S3 "Umrechnung fuer Messgroesse zff_atsys::cSignale::sig_zielgang_sas_idx" TAB_VERB 10 0 "GR1" 1 "KEIN_GANG" 2 "G1" 3 "G2" 4 "G3" 5 "G4" 6 "G5" 7 "G6" 8 "G7" 9 "G8" DEFAULT_VALUE "" /end COMPU_VTAB
/begin COMPU_VTAB Conv.zff_atsys._.cSignale._.sig_zielgang_sas_komp_S5_S3 "Umrechnung fuer Messgroesse zff_atsys::cSignale::sig_zielgang_sas_komp" TAB_VERB 10 -9 "8. Gang" -8 "7. Gang" -7 "6. Gang" -6 "5. Gang" -5 "4. Gang" -4 "3. Gang" -3 "2. Gang" -2 "1. Gang" -1 "R-Gang" 0 "R-Gang" DEFAULT_VALUE "" /end COMPU_VTAB
/begin COMPU_VTAB Conv.zff_atsys._.cSignale._.sig_zielgang_sas_S5_S3 "Umrechnung fuer Messgroesse zff_atsys::cSignale::sig_zielgang_sas" TAB_VERB 10 -1 "GR1" 0 "KEIN_GANG" 1 "G1" 2 "G2" 3 "G3" 4 "G4" 5 "G5" 6 "G6" 7 "G7" 8 "G8" DEFAULT_VALUE "" /end COMPU_VTAB
/begin COMPU_VTAB Conv.zff_atsys._.cSignale._.sig_zielgang_sas_vorw_S5_S3 "Umrechnung fuer Messgroesse zff_atsys::cSignale::sig_zielgang_sas_vorw" TAB_VERB 9 0 "KEIN_GANG" 1 "G1" 2 "G2" 3 "G3" 4 "G4" 5 "G5" 6 "G6" 7 "G7" 8 "G8" DEFAULT_VALUE "" /end COMPU_VTAB
/begin COMPU_VTAB Conv.zff_atsys._.cSignale._.sig_zielgang_vorw_S5_S3 "Umrechnung fuer Messgroesse zff_atsys::cSignale::sig_zielgang_vorw" TAB_VERB 9 0 "KEIN_GANG" 1 "G1" 2 "G2" 3 "G3" 4 "G4" 5 "G5" 6 "G6" 7 "G7" 8 "G8" DEFAULT_VALUE "" /end COMPU_VTAB
/begin COMPU_METHOD Conv.cBasFehlerErfolgFl._.flag_fehler_S5_S3 "Umrechnung fuer Messgroesse cBasFehlerErfolgFl::flag_fehler" TAB_VERB "%4.0" "" COMPU_TAB_REF Conv.cBasFehlerErfolgFl._.flag_fehler_S5_S3 /end COMPU_METHOD
/begin COMPU_METHOD Conv.cBasFehlerErfolgInt._.flag_fehler_S5_S3 "Umrechnung fuer Messgroesse cBasFehlerErfolgInt::flag_fehler" TAB_VERB "%4.0" "" COMPU_TAB_REF Conv.cBasFehlerErfolgInt._.flag_fehler_S5_S3 /end COMPU_METHOD
/begin COMPU_METHOD Conv.cUl2KraftschlussFl._.zustand_gespeichert_S5_S3 "Umrechnung fuer Messgroesse cUl2KraftschlussFl::zustand_gespeichert" TAB_VERB "%4.0" "" COMPU_TAB_REF Conv.cUl2KraftschlussFl._.zustand_gespeichert_S5_S3 /end COMPU_METHOD
/begin COMPU_METHOD Conv.cUl2KraftschlussFl._.zustand_S5_S3 "Umrechnung fuer Messgroesse cUl2KraftschlussFl::zustand" TAB_VERB "%4.0" "" COMPU_TAB_REF Conv.cUl2KraftschlussFl._.zustand_S5_S3 /end COMPU_METHOD
/begin COMPU_METHOD Conv.cUl2KraftschlussInt._.kup_b_geschl_S5_S3 "Umrechnung fuer Messgroesse cUl2KraftschlussInt::kup_b_geschl" TAB_VERB "%4.0" "" COMPU_TAB_REF Conv.cUl2KraftschlussInt._.kup_b_geschl_S5_S3 /end COMPU_METHOD
/begin COMPU_METHOD Conv.cUl2KraftschlussInt._.kup_d_geschl_S5_S3 "Umrechnung fuer Messgroesse cUl2KraftschlussInt::kup_d_geschl" TAB_VERB "%4.0" "" COMPU_TAB_REF Conv.cUl2KraftschlussInt._.kup_d_geschl_S5_S3 /end COMPU_METHOD
/begin COMPU_METHOD Conv.cUl2KraftschlussInt._.zustand_gespeichert_S5_S3 "Umrechnung fuer Messgroesse cUl2KraftschlussInt::zustand_gespeichert" TAB_VERB "%4.0" "" COMPU_TAB_REF Conv.cUl2KraftschlussInt._.zustand_gespeichert_S5_S3 /end COMPU_METHOD
/begin COMPU_METHOD Conv.cUl2KraftschlussInt._.zustand_S5_S3 "Umrechnung fuer Messgroesse cUl2KraftschlussInt::zustand" TAB_VERB "%4.0" "" COMPU_TAB_REF Conv.cUl2KraftschlussInt._.zustand_S5_S3 /end COMPU_METHOD
/begin COMPU_METHOD Conv.cUl2KupplAbsInt._.typ_S5_S3 "Umrechnung fuer Messgroesse cUl2KupplAbsInt::typ" TAB_VERB "%4.0" "" COMPU_TAB_REF Conv.cUl2KupplAbsInt._.typ_S5_S3 /end COMPU_METHOD
/begin COMPU_METHOD Conv.cUl2KupplAbsInt._.zustand_S5_S3 "Umrechnung fuer Messgroesse cUl2KupplAbsInt::zustand" TAB_VERB "%4.0" "" COMPU_TAB_REF Conv.cUl2KupplAbsInt._.zustand_S5_S3 /end COMPU_METHOD
/begin COMPU_METHOD Conv.cUl2KupplBSfktFl._.n_kup_zu_edslogik_anfahrkup_S5_S3 "Umrechnung fuer Messgroesse cUl2KupplBSfktFl::n_kup_zu_edslogik_anfahrkup" TAB_VERB "%4.0" "" COMPU_TAB_REF Conv.cUl2KupplBSfktFl._.n_kup_zu_edslogik_anfahrkup_S5_S3 /end COMPU_METHOD
/begin COMPU_METHOD Conv.cUl2KupplBSfktInt._.n_kup_zu_edslogik_anfahrkup_S5_S3 "Umrechnung fuer Messgroesse cUl2KupplBSfktInt::n_kup_zu_edslogik_anfahrkup" TAB_VERB "%4.0" "" COMPU_TAB_REF Conv.cUl2KupplBSfktInt._.n_kup_zu_edslogik_anfahrkup_S5_S3 /end COMPU_METHOD
/begin COMPU_METHOD Conv.cUl2MeKoordFl._.err_neg_me_S5_S3 "Umrechnung fuer Messgroesse cUl2MeKoordFl::err_neg_me" TAB_VERB "%4.0" "" COMPU_TAB_REF Conv.cUl2MeKoordFl._.err_neg_me_S5_S3 /end COMPU_METHOD
/begin COMPU_METHOD Conv.cUl2MeKoordFl._.err_pos_me_S5_S3 "Umrechnung fuer Messgroesse cUl2MeKoordFl::err_pos_me" TAB_VERB "%4.0" "" COMPU_TAB_REF Conv.cUl2MeKoordFl._.err_pos_me_S5_S3 /end COMPU_METHOD
/begin COMPU_METHOD Conv.cUl2MeKoordInt._.err_grad_pos_me_S5_S3 "Umrechnung fuer Messgroesse cUl2MeKoordInt::err_grad_pos_me" TAB_VERB "%4.0" "" COMPU_TAB_REF Conv.cUl2MeKoordInt._.err_grad_pos_me_S5_S3 /end COMPU_METHOD
/begin COMPU_METHOD Conv.cUl2MeKoordInt._.err_int_neg_me_S5_S3 "Umrechnung fuer Messgroesse cUl2MeKoordInt::err_int_neg_me" TAB_VERB "%4.0" "" COMPU_TAB_REF Conv.cUl2MeKoordInt._.err_int_neg_me_S5_S3 /end COMPU_METHOD
/begin COMPU_METHOD Conv.cUl2MeKoordInt._.err_int_pos_me_S5_S3 "Umrechnung fuer Messgroesse cUl2MeKoordInt::err_int_pos_me" TAB_VERB "%4.0" "" COMPU_TAB_REF Conv.cUl2MeKoordInt._.err_int_pos_me_S5_S3 /end COMPU_METHOD
/begin COMPU_METHOD Conv.cUl2MeKoordInt._.err_neg_me_S5_S3 "Umrechnung fuer Messgroesse cUl2MeKoordInt::err_neg_me" TAB_VERB "%4.0" "" COMPU_TAB_REF Conv.cUl2MeKoordInt._.err_neg_me_S5_S3 /end COMPU_METHOD
/begin COMPU_METHOD Conv.cUl2MeKoordInt._.err_pos_me_S5_S3 "Umrechnung fuer Messgroesse cUl2MeKoordInt::err_pos_me" TAB_VERB "%4.0" "" COMPU_TAB_REF Conv.cUl2MeKoordInt._.err_pos_me_S5_S3 /end COMPU_METHOD
/begin COMPU_METHOD Conv.cUl2MeKoordInt._.err_sig_neg_me_S5_S3 "Umrechnung fuer Messgroesse cUl2MeKoordInt::err_sig_neg_me" TAB_VERB "%4.0" "" COMPU_TAB_REF Conv.cUl2MeKoordInt._.err_sig_neg_me_S5_S3 /end COMPU_METHOD
/begin COMPU_METHOD Conv.cUl2MeKoordInt._.err_sig_pos_me_S5_S3 "Umrechnung fuer Messgroesse cUl2MeKoordInt::err_sig_pos_me" TAB_VERB "%4.0" "" COMPU_TAB_REF Conv.cUl2MeKoordInt._.err_sig_pos_me_S5_S3 /end COMPU_METHOD
/begin COMPU_METHOD Conv.cUl2Nmotu._.dsc_fehler_alt_komp_S5_S3 "Umrechnung fuer Messgroesse cUl2Nmotu::dsc_fehler_alt_komp" TAB_VERB "%4.0" "" COMPU_TAB_REF Conv.cUl2Nmotu._.dsc_fehler_alt_komp_S5_S3 /end COMPU_METHOD
/begin COMPU_METHOD Conv.cUl2Nmotu._.dsc_fehler_alt_S5_S3 "Umrechnung fuer Messgroesse cUl2Nmotu::dsc_fehler_alt" TAB_VERB "%4.0" "" COMPU_TAB_REF Conv.cUl2Nmotu._.dsc_fehler_alt_S5_S3 /end COMPU_METHOD
/begin COMPU_METHOD Conv.cUl2Nmotu._.ntmaxzg_verz_aktiv_komp_S5_S3 "Umrechnung fuer Messgroesse cUl2Nmotu::ntmaxzg_verz_aktiv_komp" TAB_VERB "%4.0" "" COMPU_TAB_REF Conv.cUl2Nmotu._.ntmaxzg_verz_aktiv_komp_S5_S3 /end COMPU_METHOD
/begin COMPU_METHOD Conv.cUl2Nmotu._.ntmaxzg_verz_aktiv_S5_S3 "Umrechnung fuer Messgroesse cUl2Nmotu::ntmaxzg_verz_aktiv" TAB_VERB "%4.0" "" COMPU_TAB_REF Conv.cUl2Nmotu._.ntmaxzg_verz_aktiv_S5_S3 /end COMPU_METHOD
/begin COMPU_METHOD Conv.cUl2Nmotu._.pruefbed_nmotueb_l2_komp_S5_S3 "Umrechnung fuer Messgroesse cUl2Nmotu::pruefbed_nmotueb_l2_komp" TAB_VERB "%4.0" "" COMPU_TAB_REF Conv.cUl2Nmotu._.pruefbed_nmotueb_l2_komp_S5_S3 /end COMPU_METHOD
/begin COMPU_METHOD Conv.cUl2Nmotu._.pruefbed_nmotueb_l2_S5_S3 "Umrechnung fuer Messgroesse cUl2Nmotu::pruefbed_nmotueb_l2" TAB_VERB "%4.0" "" COMPU_TAB_REF Conv.cUl2Nmotu._.pruefbed_nmotueb_l2_S5_S3 /end COMPU_METHOD
/begin COMPU_METHOD Conv.cUl2Nmotu._.z_nmotabreg_l2_komp_S5_S3 "Umrechnung fuer Messgroesse cUl2Nmotu::z_nmotabreg_l2_komp" TAB_VERB "%4.0" "" COMPU_TAB_REF Conv.cUl2Nmotu._.z_nmotabreg_l2_komp_S5_S3 /end COMPU_METHOD
/begin COMPU_METHOD Conv.cUl2Nmotu._.z_nmotabreg_l2_S5_S3 "Umrechnung fuer Messgroesse cUl2Nmotu::z_nmotabreg_l2" TAB_VERB "%4.0" "" COMPU_TAB_REF Conv.cUl2Nmotu._.z_nmotabreg_l2_S5_S3 /end COMPU_METHOD
/begin COMPU_METHOD Conv.cUl2Nmotu._.z_nt_max_zg_l2_komp_S5_S3 "Umrechnung fuer Messgroesse cUl2Nmotu::z_nt_max_zg_l2_komp" TAB_VERB "%4.0" "" COMPU_TAB_REF Conv.cUl2Nmotu._.z_nt_max_zg_l2_komp_S5_S3 /end COMPU_METHOD
/begin COMPU_METHOD Conv.cUl2Nmotu._.z_nt_max_zg_l2_S5_S3 "Umrechnung fuer Messgroesse cUl2Nmotu::z_nt_max_zg_l2" TAB_VERB "%4.0" "" COMPU_TAB_REF Conv.cUl2Nmotu._.z_nt_max_zg_l2_S5_S3 /end COMPU_METHOD
/begin COMPU_METHOD Conv.cUl2Nmotu._.zielgang_sas_alt_l2_komp_S5_S3 "Umrechnung fuer Messgroesse cUl2Nmotu::zielgang_sas_alt_l2_komp" TAB_VERB "%4.0" "" COMPU_TAB_REF Conv.cUl2Nmotu._.zielgang_sas_alt_l2_komp_S5_S3 /end COMPU_METHOD
/begin COMPU_METHOD Conv.cUl2Nmotu._.zielgang_sas_alt_l2_S5_S3 "Umrechnung fuer Messgroesse cUl2Nmotu::zielgang_sas_alt_l2" TAB_VERB "%4.0" "" COMPU_TAB_REF Conv.cUl2Nmotu._.zielgang_sas_alt_l2_S5_S3 /end COMPU_METHOD
/begin COMPU_METHOD Conv.cUl2PAbsicherungAuslPFl._.einst_bed_einmalig_S5_S3 "Umrechnung fuer Messgroesse cUl2PAbsicherungAuslPFl::einst_bed_einmalig" TAB_VERB "%4.0" "" COMPU_TAB_REF Conv.cUl2PAbsicherungAuslPFl._.einst_bed_einmalig_S5_S3 /end COMPU_METHOD
/begin COMPU_METHOD Conv.cUl2PAbsicherungAuslPFl._.f_call_ext_S5_S3 "Umrechnung fuer Messgroesse cUl2PAbsicherungAuslPFl::f_call_ext" TAB_VERB "%4.0" "" COMPU_TAB_REF Conv.cUl2PAbsicherungAuslPFl._.f_call_ext_S5_S3 /end COMPU_METHOD
/begin COMPU_METHOD Conv.cUl2PAbsicherungAuslPInt._.einst_bed_einmalig_S5_S3 "Umrechnung fuer Messgroesse cUl2PAbsicherungAuslPInt::einst_bed_einmalig" TAB_VERB "%4.0" "" COMPU_TAB_REF Conv.cUl2PAbsicherungAuslPInt._.einst_bed_einmalig_S5_S3 /end COMPU_METHOD
/begin COMPU_METHOD Conv.cUl2PAbsicherungAuslPInt._.f_call_ext_S5_S3 "Umrechnung fuer Messgroesse cUl2PAbsicherungAuslPInt::f_call_ext" TAB_VERB "%4.0" "" COMPU_TAB_REF Conv.cUl2PAbsicherungAuslPInt._.f_call_ext_S5_S3 /end COMPU_METHOD
/begin COMPU_METHOD Conv.cUl2PosMeIntenFl._.schwellen_variante_S5_S3 "Umrechnung fuer Messgroesse cUl2PosMeIntenFl::schwellen_variante" TAB_VERB "%4.0" "" COMPU_TAB_REF Conv.cUl2PosMeIntenFl._.schwellen_variante_S5_S3 /end COMPU_METHOD
/begin COMPU_METHOD Conv.cUl2PosMeIntenInt._.schwellen_variante_S5_S3 "Umrechnung fuer Messgroesse cUl2PosMeIntenInt::schwellen_variante" TAB_VERB "%4.0" "" COMPU_TAB_REF Conv.cUl2PosMeIntenInt._.schwellen_variante_S5_S3 /end COMPU_METHOD
/begin COMPU_METHOD Conv.cUl2PosNPlFl._.f_phase_b_aktiv_S5_S3 "Umrechnung fuer Messgroesse cUl2PosNPlFl::f_phase_b_aktiv" TAB_VERB "%4.0" "" COMPU_TAB_REF Conv.cUl2PosNPlFl._.f_phase_b_aktiv_S5_S3 /end COMPU_METHOD
/begin COMPU_METHOD Conv.cUl2PosNPlInt._.f_phase_b_aktiv_S5_S3 "Umrechnung fuer Messgroesse cUl2PosNPlInt::f_phase_b_aktiv" TAB_VERB "%4.0" "" COMPU_TAB_REF Conv.cUl2PosNPlInt._.f_phase_b_aktiv_S5_S3 /end COMPU_METHOD
/begin COMPU_METHOD Conv.cUl2StromlosAusserPsFl._.alt_stromlos_ausser_ps_l2_S5_S3 "Umrechnung fuer Messgroesse cUl2StromlosAusserPsFl::alt_stromlos_ausser_ps_l2" TAB_VERB "%4.0" "" COMPU_TAB_REF Conv.cUl2StromlosAusserPsFl._.alt_stromlos_ausser_ps_l2_S5_S3 /end COMPU_METHOD
/begin COMPU_METHOD Conv.cUl2StromlosAusserPsFl._.stromlos_ausser_ps_l2_S5_S3 "Umrechnung fuer Messgroesse cUl2StromlosAusserPsFl::stromlos_ausser_ps_l2" TAB_VERB "%4.0" "" COMPU_TAB_REF Conv.cUl2StromlosAusserPsFl._.stromlos_ausser_ps_l2_S5_S3 /end COMPU_METHOD
/begin COMPU_METHOD Conv.cUl2StromlosAusserPsInt._.alt_stromlos_ausser_ps_l2_S5_S3 "Umrechnung fuer Messgroesse cUl2StromlosAusserPsInt::alt_stromlos_ausser_ps_l2" TAB_VERB "%4.0" "" COMPU_TAB_REF Conv.cUl2StromlosAusserPsInt._.alt_stromlos_ausser_ps_l2_S5_S3 /end COMPU_METHOD
/begin COMPU_METHOD Conv.cUl2StromlosAusserPsInt._.stromlos_ausser_ps_l2_S5_S3 "Umrechnung fuer Messgroesse cUl2StromlosAusserPsInt::stromlos_ausser_ps_l2" TAB_VERB "%4.0" "" COMPU_TAB_REF Conv.cUl2StromlosAusserPsInt._.stromlos_ausser_ps_l2_S5_S3 /end COMPU_METHOD
/begin COMPU_METHOD Conv.mv_1_S5_S3 "Umrechnung fuer Messgroesse mv_1" TAB_VERB "%4.0" "" COMPU_TAB_REF Conv.mv_1_S5_S3 /end COMPU_METHOD
/begin COMPU_METHOD Conv.mv_2_S5_S3 "Umrechnung fuer Messgroesse mv_2" TAB_VERB "%4.0" "" COMPU_TAB_REF Conv.mv_2_S5_S3 /end COMPU_METHOD
/begin COMPU_METHOD Conv.mv_3_S5_S3 "Umrechnung fuer Messgroesse mv_3" TAB_VERB "%4.0" "" COMPU_TAB_REF Conv.mv_3_S5_S3 /end COMPU_METHOD
/begin COMPU_METHOD Conv.zff_atsys._.cSignale._.sig_e_fahren_S5_S3 "Umrechnung fuer Messgroesse zff_atsys::cSignale::sig_e_fahren" TAB_VERB "%4.0" "" COMPU_TAB_REF Conv.zff_atsys._.cSignale._.sig_e_fahren_S5_S3 /end COMPU_METHOD
/begin COMPU_METHOD Conv.zff_atsys._.cSignale._.sig_istgang_idx_S5_S3 "Umrechnung fuer Messgroesse zff_atsys::cSignale::sig_istgang_idx" TAB_VERB "%4.0" "" COMPU_TAB_REF Conv.zff_atsys._.cSignale._.sig_istgang_idx_S5_S3 /end COMPU_METHOD
/begin COMPU_METHOD Conv.zff_atsys._.cSignale._.sig_istgang_S5_S3 "Umrechnung fuer Messgroesse zff_atsys::cSignale::sig_istgang" TAB_VERB "%4.0" "" COMPU_TAB_REF Conv.zff_atsys._.cSignale._.sig_istgang_S5_S3 /end COMPU_METHOD
/begin COMPU_METHOD Conv.zff_atsys._.cSignale._.sig_istgang_vorw_S5_S3 "Umrechnung fuer Messgroesse zff_atsys::cSignale::sig_istgang_vorw" TAB_VERB "%4.0" "" COMPU_TAB_REF Conv.zff_atsys._.cSignale._.sig_istgang_vorw_S5_S3 /end COMPU_METHOD
/begin COMPU_METHOD Conv.zff_atsys._.cSignale._.sig_kfl_ist_S5_S3 "Umrechnung fuer Messgroesse zff_atsys::cSignale::sig_kfl_ist" TAB_VERB "%4.0" "" COMPU_TAB_REF Conv.zff_atsys._.cSignale._.sig_kfl_ist_S5_S3 /end COMPU_METHOD
/begin COMPU_METHOD Conv.zff_atsys._.cSignale._.sig_kfl_ziel_S5_S3 "Umrechnung fuer Messgroesse zff_atsys::cSignale::sig_kfl_ziel" TAB_VERB "%4.0" "" COMPU_TAB_REF Conv.zff_atsys._.cSignale._.sig_kfl_ziel_S5_S3 /end COMPU_METHOD
/begin COMPU_METHOD Conv.zff_atsys._.cSignale._.sig_serapflag_komp_S5_S3 "Umrechnung fuer Messgroesse zff_atsys::cSignale::sig_serapflag_komp" TAB_VERB "%4.0" "" COMPU_TAB_REF Conv.zff_atsys._.cSignale._.sig_serapflag_komp_S5_S3 /end COMPU_METHOD
/begin COMPU_METHOD Conv.zff_atsys._.cSignale._.sig_serapflag_S5_S3 "Umrechnung fuer Messgroesse zff_atsys::cSignale::sig_serapflag" TAB_VERB "%4.0" "" COMPU_TAB_REF Conv.zff_atsys._.cSignale._.sig_serapflag_S5_S3 /end COMPU_METHOD
/begin COMPU_METHOD Conv.zff_atsys._.cSignale._.sig_zielgang_idx_S5_S3 "Umrechnung fuer Messgroesse zff_atsys::cSignale::sig_zielgang_idx" TAB_VERB "%4.0" "" COMPU_TAB_REF Conv.zff_atsys._.cSignale._.sig_zielgang_idx_S5_S3 /end COMPU_METHOD
/begin COMPU_METHOD Conv.zff_atsys._.cSignale._.sig_zielgang_S5_S3 "Umrechnung fuer Messgroesse zff_atsys::cSignale::sig_zielgang" TAB_VERB "%4.0" "" COMPU_TAB_REF Conv.zff_atsys._.cSignale._.sig_zielgang_S5_S3 /end COMPU_METHOD
/begin COMPU_METHOD Conv.zff_atsys._.cSignale._.sig_zielgang_sas_idx_S5_S3 "Umrechnung fuer Messgroesse zff_atsys::cSignale::sig_zielgang_sas_idx" TAB_VERB "%4.0" "" COMPU_TAB_REF Conv.zff_atsys._.cSignale._.sig_zielgang_sas_idx_S5_S3 /end COMPU_METHOD
/begin COMPU_METHOD Conv.zff_atsys._.cSignale._.sig_zielgang_sas_komp_S5_S3 "Umrechnung fuer Messgroesse zff_atsys::cSignale::sig_zielgang_sas_komp" TAB_VERB "%4.0" "" COMPU_TAB_REF Conv.zff_atsys._.cSignale._.sig_zielgang_sas_komp_S5_S3 /end COMPU_METHOD
/begin COMPU_METHOD Conv.zff_atsys._.cSignale._.sig_zielgang_sas_S5_S3 "Umrechnung fuer Messgroesse zff_atsys::cSignale::sig_zielgang_sas" TAB_VERB "%4.0" "" COMPU_TAB_REF Conv.zff_atsys._.cSignale._.sig_zielgang_sas_S5_S3 /end COMPU_METHOD
/begin COMPU_METHOD Conv.zff_atsys._.cSignale._.sig_zielgang_sas_vorw_S5_S3 "Umrechnung fuer Messgroesse zff_atsys::cSignale::sig_zielgang_sas_vorw" TAB_VERB "%4.0" "" COMPU_TAB_REF Conv.zff_atsys._.cSignale._.sig_zielgang_sas_vorw_S5_S3 /end COMPU_METHOD
/begin COMPU_METHOD Conv.zff_atsys._.cSignale._.sig_zielgang_vorw_S5_S3 "Umrechnung fuer Messgroesse zff_atsys::cSignale::sig_zielgang_vorw" TAB_VERB "%4.0" "" COMPU_TAB_REF Conv.zff_atsys._.cSignale._.sig_zielgang_vorw_S5_S3 /end COMPU_METHOD
/begin COMPU_METHOD EH_STANDARD_S4_S3 "int = ((phys * 1) / 1) - (0) -" RAT_FUNC "%1.0" "-" COEFFS 0 1 0 0 0 1 /end COMPU_METHOD
/begin COMPU_METHOD SBW_STANDARD_S1_S3 "int = ((phys * 1) / 1) - (0) -" RAT_FUNC "%1.0" "-" COEFFS 0 1 0 0 0 1 /end COMPU_METHOD
/begin COMPU_METHOD SBW_TIMER_10MS_S1_S3 "int = ((phys * 1) / 10) - (0) ms" RAT_FUNC "%1.0" "ms" COEFFS 0 0.1 0 0 0 1 /end COMPU_METHOD
/begin COMPU_METHOD UMR___1_1_0_S5_S3 "int = ((phys * 1) / 1) - (0) [-]" RAT_FUNC "%1.0" "[-]" COEFFS 0 1 0 0 0 1 /end COMPU_METHOD
/begin COMPU_METHOD UMR_GRAD__1_3_M128_S5_S3 "int = ((phys * 3) / 1) - (-128) [Grad]" RAT_FUNC "%4.3" "[Grad]" COEFFS 0 3 128 0 0 1 /end COMPU_METHOD
/begin COMPU_METHOD UMR_GRADC__1_1_0_S5_S3 "int = ((phys * 1) / 1) - (0) [°C]" RAT_FUNC "%1.0" "[°C]" COEFFS 0 1 0 0 0 1 /end COMPU_METHOD
/begin COMPU_METHOD UMR_GRADC__1_1_M40_S5_S3 "int = ((phys * 1) / 1) - (-40) [°C]" RAT_FUNC "%1.0" "[°C]" COEFFS 0 1 40 0 0 1 /end COMPU_METHOD
/begin COMPU_METHOD UMR_GRADC__1_1_M48_S5_S3 "int = ((phys * 1) / 1) - (-48) [°C]" RAT_FUNC "%1.0" "[°C]" COEFFS 0 1 48 0 0 1 /end COMPU_METHOD
/begin COMPU_METHOD UMR_MA__1_10_0_S5_S3 "int = ((phys * 10) / 1) - (0) [mA]" RAT_FUNC "%2.1" "[mA]" COEFFS 0 10 0 0 0 1 /end COMPU_METHOD
/begin COMPU_METHOD UMR_NM__1_1_0_S5_S3 "int = ((phys * 1) / 1) - (0) [Nm]" RAT_FUNC "%1.0" "[Nm]" COEFFS 0 1 0 0 0 1 /end COMPU_METHOD
/begin COMPU_METHOD UMR_NM__6_1_M34_S5_S3 "int = ((phys * 1) / 6) - (-34) [Nm]" RAT_FUNC "%1.0" "[Nm]" COEFFS 0 0.166666666667 34 0 0 1 /end COMPU_METHOD
/begin COMPU_METHOD UMR_PROZENT__1_1_0_S5_S3 "int = ((phys * 1) / 1) - (0) [%]" RAT_FUNC "%1.0" "[%]" COEFFS 0 1 0 0 0 1 /end COMPU_METHOD
/begin COMPU_METHOD UMR_PROZENT__20_51_0_S5_S3 "int = ((phys * 51) / 20) - (0) [%]" RAT_FUNC "%5.4" "[%]" COEFFS 0 2.55 0 0 0 1 /end COMPU_METHOD
/begin COMPU_METHOD UMR_U_MIN_1_1_0_S5_S3 "int = ((phys * 1) / 1) - (0) [U/min]" RAT_FUNC "%1.0" "[U/min]" COEFFS 0 1 0 0 0 1 /end COMPU_METHOD
/begin COMPU_METHOD UMR_U_MIN_32_1_0_S5_S3 "int = ((phys * 1) / 32) - (0) [U/min]" RAT_FUNC "%1.0" "[U/min]" COEFFS 0 0.03125 0 0 0 1 /end COMPU_METHOD
/begin COMPU_METHOD UMR_U_MINTASK_1_100_0_S5_S3 "int = ((phys * 100) / 1) - (0) [U/(min*task)]" RAT_FUNC "%3.2" "[U/(min*task)]" COEFFS 0 100 0 0 0 1 /end COMPU_METHOD
/begin MEASUREMENT iUl2KoordKupplFl.maxstoercgdeltai_edslogik_max "Liefert den größten Wert der in KF_MAXSTOERCGDELTAI_EDSLOGIK_x (X = Kupplung) bzgl. aller Kupplungen appliziert ist. Hier wird die K0, falls vorhanden nicht mitbetrachtet." FLOAT32_IEEE UMR___1_1_0_S5_S3 1 100 0 65535 ECU_ADDRESS 0xFFF8C654 FORMAT "%3.2" DISPLAY_IDENTIFIER maxstoercgdeltai_edslogik_max.iUl2KoordKupplFl /end MEASUREMENT
/begin MEASUREMENT iUl2KoordKupplFl.n_kup_zu_edslogik "Der Zaehler zeigt die Anzahl der geschlossenen Kupplungen an. (nur K_A bis K_E)" FLOAT32_IEEE UMR___1_1_0_S5_S3 1 100 0 5 ECU_ADDRESS 0xFFF8C65C FORMAT "%3.2" DISPLAY_IDENTIFIER n_kup_zu_edslogik.iUl2KoordKupplFl /end MEASUREMENT
/begin MEASUREMENT iUl2KoordKupplFl.n_kup_zu_edslogik_summe "Der Zaehler zeigt die Anzahl der geschlossenen Kupplungen an. Darüber hinaus wird die Kupplung B als IAE bei einer applizierten Schwelle schon als geschlossen erkannt" FLOAT32_IEEE UMR___1_1_0_S5_S3 1 100 0 5 ECU_ADDRESS 0xFFF8C658 FORMAT "%3.2" DISPLAY_IDENTIFIER n_kup_zu_edslogik_summe.iUl2KoordKupplFl /end MEASUREMENT
/begin MEASUREMENT iUl2KoordKupplInt.maxstoercgdeltai_edslogik_max "Liefert den größten Wert der in KF_MAXSTOERCGDELTAI_EDSLOGIK_x (X = Kupplung) bzgl. aller Kupplungen appliziert ist. Hier wird die K0, falls vorhanden nicht mitbetrachtet." UWORD UMR___1_1_0_S5_S3 1 100 0 65535 ECU_ADDRESS 0xFFF8C650 DISPLAY_IDENTIFIER maxstoercgdeltai_edslogik_max.iUl2KoordKupplInt /end MEASUREMENT
/begin MEASUREMENT iUl2KoordKupplInt.n_kup_zu_edslogik "Der Zaehler zeigt die Anzahl der geschlossenen Kupplungen an." UBYTE UMR___1_1_0_S5_S3 1 100 0 5 ECU_ADDRESS 0xFFF8C653 DISPLAY_IDENTIFIER n_kup_zu_edslogik.iUl2KoordKupplInt /end MEASUREMENT
/begin MEASUREMENT iUl2KoordKupplInt.n_kup_zu_edslogik_summe "Der Zaehler zeigt die Anzahl der geschlossenen Kupplungen an. Darüber hinaus wird die Kupplung B als IAE bei einer applizierten Schwelle schon als geschlossen erkannt" UBYTE UMR___1_1_0_S5_S3 1 100 0 5 ECU_ADDRESS 0xFFF8C652 DISPLAY_IDENTIFIER n_kup_zu_edslogik_summe.iUl2KoordKupplInt /end MEASUREMENT
/begin MEASUREMENT iUl2KraftschlussFl.iKupAbsA.eds_nr "Nummer der EDS" FLOAT32_IEEE UMR___1_1_0_S5_S3 1 100 0 11 ECU_ADDRESS 0xFFF8C868 FORMAT "%3.2" DISPLAY_IDENTIFIER eds_nr.iKupAbsA.iUl2KraftschlussFl /end MEASUREMENT
/begin MEASUREMENT iUl2KraftschlussFl.iKupAbsA.typ "Art der Erkennung ob Kupplung offen/geschlossen ist" FLOAT32_IEEE UMR___1_1_0_S5_S3 1 100 0 1 ECU_ADDRESS 0xFFF8C86C FORMAT "%3.2" DISPLAY_IDENTIFIER typ.iKupAbsA.iUl2KraftschlussFl /end MEASUREMENT
/begin MEASUREMENT iUl2KraftschlussFl.iKupAbsA.zustand "Kupplung gilt als offen o. geschlosen" FLOAT32_IEEE UMR___1_1_0_S5_S3 1 100 0 1 ECU_ADDRESS 0xFFF8C870 FORMAT "%3.2" DISPLAY_IDENTIFIER zustand.iKupAbsA.iUl2KraftschlussFl /end MEASUREMENT
/begin MEASUREMENT iUl2KraftschlussFl.iKupAbsC.eds_nr "Nummer der EDS" FLOAT32_IEEE UMR___1_1_0_S5_S3 1 100 0 11 ECU_ADDRESS 0xFFF8C874 FORMAT "%3.2" DISPLAY_IDENTIFIER eds_nr.iKupAbsC.iUl2KraftschlussFl /end MEASUREMENT
/begin MEASUREMENT iUl2KraftschlussFl.iKupAbsC.typ "Art der Erkennung ob Kupplung offen/geschlossen ist" FLOAT32_IEEE UMR___1_1_0_S5_S3 1 100 0 1 ECU_ADDRESS 0xFFF8C878 FORMAT "%3.2" DISPLAY_IDENTIFIER typ.iKupAbsC.iUl2KraftschlussFl /end MEASUREMENT
/begin MEASUREMENT iUl2KraftschlussFl.iKupAbsC.zustand "Kupplung gilt als offen o. geschlosen" FLOAT32_IEEE UMR___1_1_0_S5_S3 1 100 0 1 ECU_ADDRESS 0xFFF8C87C FORMAT "%3.2" DISPLAY_IDENTIFIER zustand.iKupAbsC.iUl2KraftschlussFl /end MEASUREMENT
/begin MEASUREMENT iUl2KraftschlussFl.iKupAbsE.eds_nr "Nummer der EDS" FLOAT32_IEEE UMR___1_1_0_S5_S3 1 100 0 11 ECU_ADDRESS 0xFFF8C880 FORMAT "%3.2" DISPLAY_IDENTIFIER eds_nr.iKupAbsE.iUl2KraftschlussFl /end MEASUREMENT
/begin MEASUREMENT iUl2KraftschlussFl.iKupAbsE.typ "Art der Erkennung ob Kupplung offen/geschlossen ist" FLOAT32_IEEE UMR___1_1_0_S5_S3 1 100 0 1 ECU_ADDRESS 0xFFF8C884 FORMAT "%3.2" DISPLAY_IDENTIFIER typ.iKupAbsE.iUl2KraftschlussFl /end MEASUREMENT
/begin MEASUREMENT iUl2KraftschlussFl.iKupAbsE.zustand "Kupplung gilt als offen o. geschlosen" FLOAT32_IEEE UMR___1_1_0_S5_S3 1 100 0 1 ECU_ADDRESS 0xFFF8C888 FORMAT "%3.2" DISPLAY_IDENTIFIER zustand.iKupAbsE.iUl2KraftschlussFl /end MEASUREMENT
/begin MEASUREMENT iUl2KraftschlussFl.kup_b_geschl "gibt an ob Kupplung B geschlossen ist" FLOAT32_IEEE UMR___1_1_0_S5_S3 1 100 0 1 ECU_ADDRESS 0xFFF8C88C FORMAT "%3.2" DISPLAY_IDENTIFIER kup_b_geschl.iUl2KraftschlussFl /end MEASUREMENT
/begin MEASUREMENT iUl2KraftschlussFl.kup_d_geschl "gibt an ob Kupplung D geschlossen ist" FLOAT32_IEEE UMR___1_1_0_S5_S3 1 100 0 1 ECU_ADDRESS 0xFFF8C890 FORMAT "%3.2" DISPLAY_IDENTIFIER kup_d_geschl.iUl2KraftschlussFl /end MEASUREMENT
/begin MEASUREMENT iUl2KraftschlussFl.n_maxkabpos_c_zaehler "Zähler der beim Öffnen der Kupplung C hochzählt" FLOAT32_IEEE UMR___1_1_0_S5_S3 1 100 0 65535 ECU_ADDRESS 0xFFF8C860 FORMAT "%3.2" DISPLAY_IDENTIFIER n_maxkabpos_c_zaehler.iUl2KraftschlussFl /end MEASUREMENT
/begin MEASUREMENT iUl2KraftschlussFl.n_maxkabpos_e_zaehler "Zähler der beim Öffnen der Kupplung E hochzählt" FLOAT32_IEEE UMR___1_1_0_S5_S3 1 100 0 65535 ECU_ADDRESS 0xFFF8C864 FORMAT "%3.2" DISPLAY_IDENTIFIER n_maxkabpos_e_zaehler.iUl2KraftschlussFl /end MEASUREMENT
/begin MEASUREMENT iUl2KraftschlussFl.n_verz_edslogik "Entprellzähler für Kraftschlusserkennung" FLOAT32_IEEE UMR___1_1_0_S5_S3 1 100 0 65535 ECU_ADDRESS 0xFFF8C894 FORMAT "%3.2" DISPLAY_IDENTIFIER n_verz_edslogik.iUl2KraftschlussFl /end MEASUREMENT
/begin MEASUREMENT iUl2KraftschlussFl.zustand "Speichert den aktuellen Kraftschlusszustand" FLOAT32_IEEE Conv.cUl2KraftschlussFl._.zustand_S5_S3 1 100 0 255 ECU_ADDRESS 0xFFF8C898 FORMAT "%3.2" DISPLAY_IDENTIFIER zustand.iUl2KraftschlussFl /end MEASUREMENT
/begin MEASUREMENT iUl2KraftschlussFl.zustand_gespeichert "Speichert den alten Kraftschlusszustand" FLOAT32_IEEE Conv.cUl2KraftschlussFl._.zustand_gespeichert_S5_S3 1 100 0 255 ECU_ADDRESS 0xFFF8C89C FORMAT "%3.2" DISPLAY_IDENTIFIER zustand_gespeichert.iUl2KraftschlussFl /end MEASUREMENT
/begin MEASUREMENT iUl2KraftschlussInt.iKupAbsA.eds_nr "Nummer der EDS" UBYTE UMR___1_1_0_S5_S3 1 100 0 11 ECU_ADDRESS 0xFFF8C850 DISPLAY_IDENTIFIER eds_nr.iKupAbsA.iUl2KraftschlussInt /end MEASUREMENT
/begin MEASUREMENT iUl2KraftschlussInt.iKupAbsA.typ "Art der Erkennung ob Kupplung offen/geschlossen ist" UBYTE Conv.cUl2KupplAbsInt._.typ_S5_S3 1 100 0 1 ECU_ADDRESS 0xFFF8C851 DISPLAY_IDENTIFIER typ.iKupAbsA.iUl2KraftschlussInt /end MEASUREMENT
/begin MEASUREMENT iUl2KraftschlussInt.iKupAbsA.zustand "Kupplung gilt als offen o. geschlosen" UBYTE Conv.cUl2KupplAbsInt._.zustand_S5_S3 1 100 0 1 ECU_ADDRESS 0xFFF8C852 DISPLAY_IDENTIFIER zustand.iKupAbsA.iUl2KraftschlussInt /end MEASUREMENT
/begin MEASUREMENT iUl2KraftschlussInt.iKupAbsC.eds_nr "Nummer der EDS" UBYTE UMR___1_1_0_S5_S3 1 100 0 11 ECU_ADDRESS 0xFFF8C853 DISPLAY_IDENTIFIER eds_nr.iKupAbsC.iUl2KraftschlussInt /end MEASUREMENT
/begin MEASUREMENT iUl2KraftschlussInt.iKupAbsC.typ "Art der Erkennung ob Kupplung offen/geschlossen ist" UBYTE Conv.cUl2KupplAbsInt._.typ_S5_S3 1 100 0 1 ECU_ADDRESS 0xFFF8C854 DISPLAY_IDENTIFIER typ.iKupAbsC.iUl2KraftschlussInt /end MEASUREMENT
/begin MEASUREMENT iUl2KraftschlussInt.iKupAbsC.zustand "Kupplung gilt als offen o. geschlosen" UBYTE Conv.cUl2KupplAbsInt._.zustand_S5_S3 1 100 0 1 ECU_ADDRESS 0xFFF8C855 DISPLAY_IDENTIFIER zustand.iKupAbsC.iUl2KraftschlussInt /end MEASUREMENT
/begin MEASUREMENT iUl2KraftschlussInt.iKupAbsE.eds_nr "Nummer der EDS" UBYTE UMR___1_1_0_S5_S3 1 100 0 11 ECU_ADDRESS 0xFFF8C856 DISPLAY_IDENTIFIER eds_nr.iKupAbsE.iUl2KraftschlussInt /end MEASUREMENT
/begin MEASUREMENT iUl2KraftschlussInt.iKupAbsE.typ "Art der Erkennung ob Kupplung offen/geschlossen ist" UBYTE Conv.cUl2KupplAbsInt._.typ_S5_S3 1 100 0 1 ECU_ADDRESS 0xFFF8C857 DISPLAY_IDENTIFIER typ.iKupAbsE.iUl2KraftschlussInt /end MEASUREMENT
/begin MEASUREMENT iUl2KraftschlussInt.iKupAbsE.zustand "Kupplung gilt als offen o. geschlosen" UBYTE Conv.cUl2KupplAbsInt._.zustand_S5_S3 1 100 0 1 ECU_ADDRESS 0xFFF8C858 DISPLAY_IDENTIFIER zustand.iKupAbsE.iUl2KraftschlussInt /end MEASUREMENT
/begin MEASUREMENT iUl2KraftschlussInt.kup_b_geschl "gibt an ob Kupplung B geschlossen ist" UBYTE Conv.cUl2KraftschlussInt._.kup_b_geschl_S5_S3 1 100 0 1 BIT_MASK 0x1 ECU_ADDRESS 0xFFF8C859 DISPLAY_IDENTIFIER kup_b_geschl.iUl2KraftschlussInt /end MEASUREMENT
/begin MEASUREMENT iUl2KraftschlussInt.kup_d_geschl "gibt an ob Kupplung D geschlossen ist" UBYTE Conv.cUl2KraftschlussInt._.kup_d_geschl_S5_S3 1 100 0 1 BIT_MASK 0x1 ECU_ADDRESS 0xFFF8C85A DISPLAY_IDENTIFIER kup_d_geschl.iUl2KraftschlussInt /end MEASUREMENT
/begin MEASUREMENT iUl2KraftschlussInt.n_maxkabpos_c_zaehler "Zähler der beim Öffnen der Kupplung C hochzählt" UWORD UMR___1_1_0_S5_S3 1 100 0 65535 ECU_ADDRESS 0xFFF8C84C DISPLAY_IDENTIFIER n_maxkabpos_c_zaehler.iUl2KraftschlussInt /end MEASUREMENT
/begin MEASUREMENT iUl2KraftschlussInt.n_maxkabpos_e_zaehler "Zähler der beim Öffnen der Kupplung E hochzählt" UWORD UMR___1_1_0_S5_S3 1 100 0 65535 ECU_ADDRESS 0xFFF8C84E DISPLAY_IDENTIFIER n_maxkabpos_e_zaehler.iUl2KraftschlussInt /end MEASUREMENT
/begin MEASUREMENT iUl2KraftschlussInt.n_verz_edslogik "Entprellzähler für Kraftschlusserkennung" UWORD UMR___1_1_0_S5_S3 1 100 0 65535 ECU_ADDRESS 0xFFF8C85C DISPLAY_IDENTIFIER n_verz_edslogik.iUl2KraftschlussInt /end MEASUREMENT
/begin MEASUREMENT iUl2KraftschlussInt.zustand "Speichert den aktuellen Kraftschlusszustand" UBYTE Conv.cUl2KraftschlussInt._.zustand_S5_S3 1 100 0 255 ECU_ADDRESS 0xFFF8C85E DISPLAY_IDENTIFIER zustand.iUl2KraftschlussInt /end MEASUREMENT
/begin MEASUREMENT iUl2KraftschlussInt.zustand_gespeichert "Speichert den alten Kraftschlusszustand" UBYTE Conv.cUl2KraftschlussInt._.zustand_gespeichert_S5_S3 1 100 0 255 ECU_ADDRESS 0xFFF8C85F DISPLAY_IDENTIFIER zustand_gespeichert.iUl2KraftschlussInt /end MEASUREMENT
/begin MEASUREMENT iUl2KupplAFl.cUl2KupBasisFl._.eds_nr "Nummer der EDS" FLOAT32_IEEE UMR___1_1_0_S5_S3 1 100 0 11 ECU_ADDRESS 0xFFF8C684 FORMAT "%3.2" DISPLAY_IDENTIFIER eds_nr._.cUl2KupBasisFl.iUl2KupplAFl /end MEASUREMENT
/begin MEASUREMENT iUl2KupplAFl.cUl2KupBasisFl._.f_geschlossen "Das Flag zeigt an ob die Kupplung geschlossen ist" FLOAT32_IEEE UMR___1_1_0_S5_S3 1 100 0 1 ECU_ADDRESS 0xFFF8C688 FORMAT "%3.2" DISPLAY_IDENTIFIER f_geschlossen._.cUl2KupBasisFl.iUl2KupplAFl /end MEASUREMENT
/begin MEASUREMENT iUl2KupplAFl.cUl2KupBasisFl._.kup_nr "Nummer der Kupplung" FLOAT32_IEEE UMR___1_1_0_S5_S3 1 100 1 6 ECU_ADDRESS 0xFFF8C680 FORMAT "%3.2" DISPLAY_IDENTIFIER kup_nr._.cUl2KupBasisFl.iUl2KupplAFl /end MEASUREMENT
/begin MEASUREMENT iUl2KupplAFl.delta_i_edslogik "Differenz zwischen Kupplungsstrom u. Stromschwelle (KF_IEDSMAXMMOTCGLOGIKUEB bzw. KF_IEDSMINMMOTCGLOGIKUEB)" FLOAT32_IEEE UMR_MA__1_10_0_S5_S3 1 100 0 1000 ECU_ADDRESS 0xFFF8C6B8 DISPLAY_IDENTIFIER delta_i_edslogik.iUl2KupplAFl /end MEASUREMENT
/begin MEASUREMENT iUl2KupplAFl.f_erste_bef_erk "Das Flag zeigt an, dass die erste Befüllung erkannt wurde." FLOAT32_IEEE UMR___1_1_0_S5_S3 1 100 0 1 ECU_ADDRESS 0xFFF8C6BC FORMAT "%3.2" DISPLAY_IDENTIFIER f_erste_bef_erk.iUl2KupplAFl /end MEASUREMENT
/begin MEASUREMENT iUl2KupplAFl.f_init "Gibt an ob die Kupplungswerte Initialisiert wurden sind." FLOAT32_IEEE UMR___1_1_0_S5_S3 1 100 0 1 ECU_ADDRESS 0xFFF8C694 FORMAT "%3.2" DISPLAY_IDENTIFIER f_init.iUl2KupplAFl /end MEASUREMENT
/begin MEASUREMENT iUl2KupplAFl.i_sw_kup_oeffnet "aktuelle Stromschwelle, die überschritten/unterschritten werden muss um die Kupplung als geöffnet zu erkennen" FLOAT32_IEEE UMR_MA__1_10_0_S5_S3 1 100 0 3276.7 ECU_ADDRESS 0xFFF8C6A8 DISPLAY_IDENTIFIER i_sw_kup_oeffnet.iUl2KupplAFl /end MEASUREMENT
/begin MEASUREMENT iUl2KupplAFl.i_sw_kup_schliesst "aktuelle Stromschwelle, die überschritten/unterschritten werden muss um die Kupplung als geschlossen zu erkennen" FLOAT32_IEEE UMR_MA__1_10_0_S5_S3 1 100 0 3276.7 ECU_ADDRESS 0xFFF8C6A4 DISPLAY_IDENTIFIER i_sw_kup_schliesst.iUl2KupplAFl /end MEASUREMENT
/begin MEASUREMENT iUl2KupplAFl.n_kup_basis_korrektur "Zähler zur Verzögerung der Korrektur des Störzählers durch Basisstrombedingung" FLOAT32_IEEE UMR___1_1_0_S5_S3 1 100 0 255 ECU_ADDRESS 0xFFF8C6B4 FORMAT "%3.2" DISPLAY_IDENTIFIER n_kup_basis_korrektur.iUl2KupplAFl /end MEASUREMENT
/begin MEASUREMENT iUl2KupplAFl.n_kup_oeffnet "Zähler zur Verzögerung der Erkennung - Schaltelement nicht geschaltet" FLOAT32_IEEE UMR___1_1_0_S5_S3 1 100 0 255 ECU_ADDRESS 0xFFF8C6AC FORMAT "%3.2" DISPLAY_IDENTIFIER n_kup_oeffnet.iUl2KupplAFl /end MEASUREMENT
/begin MEASUREMENT iUl2KupplAFl.n_kup_oeffnet_stromlos "Zähler zur Verzögerung der Erkennung - Schaltelement nicht geschaltet" FLOAT32_IEEE UMR___1_1_0_S5_S3 1 100 0 255 ECU_ADDRESS 0xFFF8C6B0 FORMAT "%3.2" DISPLAY_IDENTIFIER n_kup_oeffnet_stromlos.iUl2KupplAFl /end MEASUREMENT
/begin MEASUREMENT iUl2KupplAFl.n_stoeredslogik "Stoerzaehler für falsch bestromte Kupplung" FLOAT32_IEEE UMR___1_1_0_S5_S3 1 100 0 32767 ECU_ADDRESS 0xFFF8C6A0 FORMAT "%3.2" DISPLAY_IDENTIFIER n_stoeredslogik.iUl2KupplAFl /end MEASUREMENT
/begin MEASUREMENT iUl2KupplAFl.n_stoeredslogik_init "Kleinster Wert auf dem Feld KF_MAXSTOERCGDELTAI_EDSLOGIK" FLOAT32_IEEE UMR___1_1_0_S5_S3 1 100 0 255 ECU_ADDRESS 0xFFF8C69C FORMAT "%3.2" DISPLAY_IDENTIFIER n_stoeredslogik_init.iUl2KupplAFl /end MEASUREMENT
/begin MEASUREMENT iUl2KupplAFl.n_stoeredslogik_schwelle "Schwelle die Überschritten werden muss um die Kupplung als geschlossen zu erkennen" FLOAT32_IEEE UMR___1_1_0_S5_S3 1 100 0 510 ECU_ADDRESS 0xFFF8C698 FORMAT "%3.2" DISPLAY_IDENTIFIER n_stoeredslogik_schwelle.iUl2KupplAFl /end MEASUREMENT
/begin MEASUREMENT iUl2KupplAInt.cUl2KupBasisInt._.eds_nr "Nummer der EDS" UBYTE UMR___1_1_0_S5_S3 1 100 0 11 ECU_ADDRESS 0xFFF8C661 DISPLAY_IDENTIFIER eds_nr._.cUl2KupBasisInt.iUl2KupplAInt /end MEASUREMENT
/begin MEASUREMENT iUl2KupplAInt.cUl2KupBasisInt._.f_geschlossen "Das Flag zeigt an ob die Kupplung geschlossen ist" UBYTE UMR___1_1_0_S5_S3 1 100 0 1 ECU_ADDRESS 0xFFF8C662 DISPLAY_IDENTIFIER f_geschlossen._.cUl2KupBasisInt.iUl2KupplAInt /end MEASUREMENT
/begin MEASUREMENT iUl2KupplAInt.cUl2KupBasisInt._.kup_nr "Nummer der Kupplung" UBYTE UMR___1_1_0_S5_S3 1 100 1 6 ECU_ADDRESS 0xFFF8C660 DISPLAY_IDENTIFIER kup_nr._.cUl2KupBasisInt.iUl2KupplAInt /end MEASUREMENT
/begin MEASUREMENT iUl2KupplAInt.delta_i_edslogik "Differenz zwischen Kupplungsstrom u. Stromschwelle (KF_IEDSMAXMMOTCGLOGIKUEB bzw. KF_IEDSMINMMOTCGLOGIKUEB)" SWORD UMR_MA__1_10_0_S5_S3 1 100 0 1000 ECU_ADDRESS 0xFFF8C67C DISPLAY_IDENTIFIER delta_i_edslogik.iUl2KupplAInt /end MEASUREMENT
/begin MEASUREMENT iUl2KupplAInt.f_erste_bef_erk "Das Flag zeigt an, dass die erste Befüllung erkannt wurde." UBYTE UMR___1_1_0_S5_S3 1 100 0 1 ECU_ADDRESS 0xFFF8C67E DISPLAY_IDENTIFIER f_erste_bef_erk.iUl2KupplAInt /end MEASUREMENT
/begin MEASUREMENT iUl2KupplAInt.f_init "Gibt an ob die Kupplungswerte Initialisiert wurden sind." UBYTE UMR___1_1_0_S5_S3 1 100 0 1 ECU_ADDRESS 0xFFF8C66C DISPLAY_IDENTIFIER f_init.iUl2KupplAInt /end MEASUREMENT
/begin MEASUREMENT iUl2KupplAInt.i_sw_kup_oeffnet "aktuelle Stromschwelle, die überschritten/unterschritten werden muss um die Kupplung als geöffnet zu erkennen" SWORD UMR_MA__1_10_0_S5_S3 1 100 0 3276.7 ECU_ADDRESS 0xFFF8C676 DISPLAY_IDENTIFIER i_sw_kup_oeffnet.iUl2KupplAInt /end MEASUREMENT
/begin MEASUREMENT iUl2KupplAInt.i_sw_kup_schliesst "aktuelle Stromschwelle, die überschritten/unterschritten werden muss um die Kupplung als geschlossen zu erkennen" SWORD UMR_MA__1_10_0_S5_S3 1 100 0 3276.7 ECU_ADDRESS 0xFFF8C674 DISPLAY_IDENTIFIER i_sw_kup_schliesst.iUl2KupplAInt /end MEASUREMENT
/begin MEASUREMENT iUl2KupplAInt.n_kup_basis_korrektur "Zähler zur Verzögerung der Korrektur des Störzählers durch Basisstrombedingung" UBYTE UMR___1_1_0_S5_S3 1 100 0 255 ECU_ADDRESS 0xFFF8C67A DISPLAY_IDENTIFIER n_kup_basis_korrektur.iUl2KupplAInt /end MEASUREMENT
/begin MEASUREMENT iUl2KupplAInt.n_kup_oeffnet "Zähler zur Verzögerung der Erkennung - Schaltelement nicht geschaltet" UBYTE UMR___1_1_0_S5_S3 1 100 0 255 ECU_ADDRESS 0xFFF8C678 DISPLAY_IDENTIFIER n_kup_oeffnet.iUl2KupplAInt /end MEASUREMENT
/begin MEASUREMENT iUl2KupplAInt.n_kup_oeffnet_stromlos "Zähler zur Verzögerung der Erkennung - Schaltelement nicht geschaltet" UBYTE UMR___1_1_0_S5_S3 1 100 0 255 ECU_ADDRESS 0xFFF8C679 DISPLAY_IDENTIFIER n_kup_oeffnet_stromlos.iUl2KupplAInt /end MEASUREMENT
/begin MEASUREMENT iUl2KupplAInt.n_stoeredslogik "Stoerzaehler für falsch bestromte Kupplung" SWORD UMR___1_1_0_S5_S3 1 100 0 32767 ECU_ADDRESS 0xFFF8C672 DISPLAY_IDENTIFIER n_stoeredslogik.iUl2KupplAInt /end MEASUREMENT
/begin MEASUREMENT iUl2KupplAInt.n_stoeredslogik_init "Kleinster Wert auf dem Feld KF_MAXSTOERCGDELTAI_EDSLOGIK" SWORD UMR___1_1_0_S5_S3 1 100 0 255 ECU_ADDRESS 0xFFF8C670 DISPLAY_IDENTIFIER n_stoeredslogik_init.iUl2KupplAInt /end MEASUREMENT
/begin MEASUREMENT iUl2KupplAInt.n_stoeredslogik_schwelle "Schwelle die Überschritten werden muss um die Kupplung als geschlossen zu erkennen" SWORD UMR___1_1_0_S5_S3 1 100 0 510 ECU_ADDRESS 0xFFF8C66E DISPLAY_IDENTIFIER n_stoeredslogik_schwelle.iUl2KupplAInt /end MEASUREMENT
/begin MEASUREMENT iUl2KupplBFl.cUl2KupBasisFl._.eds_nr "Nummer der EDS" FLOAT32_IEEE UMR___1_1_0_S5_S3 1 100 0 11 ECU_ADDRESS 0xFFF8C6E4 FORMAT "%3.2" DISPLAY_IDENTIFIER eds_nr._.cUl2KupBasisFl.iUl2KupplBFl /end MEASUREMENT
/begin MEASUREMENT iUl2KupplBFl.cUl2KupBasisFl._.f_geschlossen "Das Flag zeigt an ob die Kupplung geschlossen ist" FLOAT32_IEEE UMR___1_1_0_S5_S3 1 100 0 1 ECU_ADDRESS 0xFFF8C6E8 FORMAT "%3.2" DISPLAY_IDENTIFIER f_geschlossen._.cUl2KupBasisFl.iUl2KupplBFl /end MEASUREMENT
/begin MEASUREMENT iUl2KupplBFl.cUl2KupBasisFl._.kup_nr "Nummer der Kupplung" FLOAT32_IEEE UMR___1_1_0_S5_S3 1 100 1 6 ECU_ADDRESS 0xFFF8C6E0 FORMAT "%3.2" DISPLAY_IDENTIFIER kup_nr._.cUl2KupBasisFl.iUl2KupplBFl /end MEASUREMENT
/begin MEASUREMENT iUl2KupplBFl.delta_i_edslogik "Differenz zwischen Kupplungsstrom u. Stromschwelle (KF_IEDSMAXMMOTCGLOGIKUEB bzw. KF_IEDSMINMMOTCGLOGIKUEB)" FLOAT32_IEEE UMR_MA__1_10_0_S5_S3 1 100 0 1000 ECU_ADDRESS 0xFFF8C718 DISPLAY_IDENTIFIER delta_i_edslogik.iUl2KupplBFl /end MEASUREMENT
/begin MEASUREMENT iUl2KupplBFl.f_erste_bef_erk "Das Flag zeigt an, dass die erste Befüllung erkannt wurde." FLOAT32_IEEE UMR___1_1_0_S5_S3 1 100 0 1 ECU_ADDRESS 0xFFF8C71C FORMAT "%3.2" DISPLAY_IDENTIFIER f_erste_bef_erk.iUl2KupplBFl /end MEASUREMENT
/begin MEASUREMENT iUl2KupplBFl.f_init "Gibt an ob die Kupplungswerte Initialisiert wurden sind." FLOAT32_IEEE UMR___1_1_0_S5_S3 1 100 0 1 ECU_ADDRESS 0xFFF8C6F4 FORMAT "%3.2" DISPLAY_IDENTIFIER f_init.iUl2KupplBFl /end MEASUREMENT
/begin MEASUREMENT iUl2KupplBFl.i_sw_kup_oeffnet "aktuelle Stromschwelle, die überschritten/unterschritten werden muss um die Kupplung als geöffnet zu erkennen" FLOAT32_IEEE UMR_MA__1_10_0_S5_S3 1 100 0 3276.7 ECU_ADDRESS 0xFFF8C708 DISPLAY_IDENTIFIER i_sw_kup_oeffnet.iUl2KupplBFl /end MEASUREMENT
/begin MEASUREMENT iUl2KupplBFl.i_sw_kup_schliesst "aktuelle Stromschwelle, die überschritten/unterschritten werden muss um die Kupplung als geschlossen zu erkennen" FLOAT32_IEEE UMR_MA__1_10_0_S5_S3 1 100 0 3276.7 ECU_ADDRESS 0xFFF8C704 DISPLAY_IDENTIFIER i_sw_kup_schliesst.iUl2KupplBFl /end MEASUREMENT
/begin MEASUREMENT iUl2KupplBFl.n_kup_basis_korrektur "Zähler zur Verzögerung der Korrektur des Störzählers durch Basisstrombedingung" FLOAT32_IEEE UMR___1_1_0_S5_S3 1 100 0 255 ECU_ADDRESS 0xFFF8C714 FORMAT "%3.2" DISPLAY_IDENTIFIER n_kup_basis_korrektur.iUl2KupplBFl /end MEASUREMENT
/begin MEASUREMENT iUl2KupplBFl.n_kup_oeffnet "Zähler zur Verzögerung der Erkennung - Schaltelement nicht geschaltet" FLOAT32_IEEE UMR___1_1_0_S5_S3 1 100 0 255 ECU_ADDRESS 0xFFF8C70C FORMAT "%3.2" DISPLAY_IDENTIFIER n_kup_oeffnet.iUl2KupplBFl /end MEASUREMENT
/begin MEASUREMENT iUl2KupplBFl.n_kup_oeffnet_stromlos "Zähler zur Verzögerung der Erkennung - Schaltelement nicht geschaltet" FLOAT32_IEEE UMR___1_1_0_S5_S3 1 100 0 255 ECU_ADDRESS 0xFFF8C710 FORMAT "%3.2" DISPLAY_IDENTIFIER n_kup_oeffnet_stromlos.iUl2KupplBFl /end MEASUREMENT
/begin MEASUREMENT iUl2KupplBFl.n_stoeredslogik "Stoerzaehler für falsch bestromte Kupplung" FLOAT32_IEEE UMR___1_1_0_S5_S3 1 100 0 32767 ECU_ADDRESS 0xFFF8C700 FORMAT "%3.2" DISPLAY_IDENTIFIER n_stoeredslogik.iUl2KupplBFl /end MEASUREMENT
/begin MEASUREMENT iUl2KupplBFl.n_stoeredslogik_init "Kleinster Wert auf dem Feld KF_MAXSTOERCGDELTAI_EDSLOGIK" FLOAT32_IEEE UMR___1_1_0_S5_S3 1 100 0 255 ECU_ADDRESS 0xFFF8C6FC FORMAT "%3.2" DISPLAY_IDENTIFIER n_stoeredslogik_init.iUl2KupplBFl /end MEASUREMENT
/begin MEASUREMENT iUl2KupplBFl.n_stoeredslogik_schwelle "Schwelle die Überschritten werden muss um die Kupplung als geschlossen zu erkennen" FLOAT32_IEEE UMR___1_1_0_S5_S3 1 100 0 510 ECU_ADDRESS 0xFFF8C6F8 FORMAT "%3.2" DISPLAY_IDENTIFIER n_stoeredslogik_schwelle.iUl2KupplBFl /end MEASUREMENT
/begin MEASUREMENT iUl2KupplBInt.cUl2KupBasisInt._.eds_nr "Nummer der EDS" UBYTE UMR___1_1_0_S5_S3 1 100 0 11 ECU_ADDRESS 0xFFF8C6C1 DISPLAY_IDENTIFIER eds_nr._.cUl2KupBasisInt.iUl2KupplBInt /end MEASUREMENT
/begin MEASUREMENT iUl2KupplBInt.cUl2KupBasisInt._.f_geschlossen "Das Flag zeigt an ob die Kupplung geschlossen ist" UBYTE UMR___1_1_0_S5_S3 1 100 0 1 ECU_ADDRESS 0xFFF8C6C2 DISPLAY_IDENTIFIER f_geschlossen._.cUl2KupBasisInt.iUl2KupplBInt /end MEASUREMENT
/begin MEASUREMENT iUl2KupplBInt.cUl2KupBasisInt._.kup_nr "Nummer der Kupplung" UBYTE UMR___1_1_0_S5_S3 1 100 1 6 ECU_ADDRESS 0xFFF8C6C0 DISPLAY_IDENTIFIER kup_nr._.cUl2KupBasisInt.iUl2KupplBInt /end MEASUREMENT
/begin MEASUREMENT iUl2KupplBInt.delta_i_edslogik "Differenz zwischen Kupplungsstrom u. Stromschwelle (KF_IEDSMAXMMOTCGLOGIKUEB bzw. KF_IEDSMINMMOTCGLOGIKUEB)" SWORD UMR_MA__1_10_0_S5_S3 1 100 0 1000 ECU_ADDRESS 0xFFF8C6DC DISPLAY_IDENTIFIER delta_i_edslogik.iUl2KupplBInt /end MEASUREMENT
/begin MEASUREMENT iUl2KupplBInt.f_erste_bef_erk "Das Flag zeigt an, dass die erste Befüllung erkannt wurde." UBYTE UMR___1_1_0_S5_S3 1 100 0 1 ECU_ADDRESS 0xFFF8C6DE DISPLAY_IDENTIFIER f_erste_bef_erk.iUl2KupplBInt /end MEASUREMENT
/begin MEASUREMENT iUl2KupplBInt.f_init "Gibt an ob die Kupplungswerte Initialisiert wurden sind." UBYTE UMR___1_1_0_S5_S3 1 100 0 1 ECU_ADDRESS 0xFFF8C6CC DISPLAY_IDENTIFIER f_init.iUl2KupplBInt /end MEASUREMENT
/begin MEASUREMENT iUl2KupplBInt.i_sw_kup_oeffnet "aktuelle Stromschwelle, die überschritten/unterschritten werden muss um die Kupplung als geöffnet zu erkennen" SWORD UMR_MA__1_10_0_S5_S3 1 100 0 3276.7 ECU_ADDRESS 0xFFF8C6D6 DISPLAY_IDENTIFIER i_sw_kup_oeffnet.iUl2KupplBInt /end MEASUREMENT
/begin MEASUREMENT iUl2KupplBInt.i_sw_kup_schliesst "aktuelle Stromschwelle, die überschritten/unterschritten werden muss um die Kupplung als geschlossen zu erkennen" SWORD UMR_MA__1_10_0_S5_S3 1 100 0 3276.7 ECU_ADDRESS 0xFFF8C6D4 DISPLAY_IDENTIFIER i_sw_kup_schliesst.iUl2KupplBInt /end MEASUREMENT
/begin MEASUREMENT iUl2KupplBInt.n_kup_basis_korrektur "Zähler zur Verzögerung der Korrektur des Störzählers durch Basisstrombedingung" UBYTE UMR___1_1_0_S5_S3 1 100 0 255 ECU_ADDRESS 0xFFF8C6DA DISPLAY_IDENTIFIER n_kup_basis_korrektur.iUl2KupplBInt /end MEASUREMENT
/begin MEASUREMENT iUl2KupplBInt.n_kup_oeffnet "Zähler zur Verzögerung der Erkennung - Schaltelement nicht geschaltet" UBYTE UMR___1_1_0_S5_S3 1 100 0 255 ECU_ADDRESS 0xFFF8C6D8 DISPLAY_IDENTIFIER n_kup_oeffnet.iUl2KupplBInt /end MEASUREMENT
/begin MEASUREMENT iUl2KupplBInt.n_kup_oeffnet_stromlos "Zähler zur Verzögerung der Erkennung - Schaltelement nicht geschaltet" UBYTE UMR___1_1_0_S5_S3 1 100 0 255 ECU_ADDRESS 0xFFF8C6D9 DISPLAY_IDENTIFIER n_kup_oeffnet_stromlos.iUl2KupplBInt /end MEASUREMENT
/begin MEASUREMENT iUl2KupplBInt.n_stoeredslogik "Stoerzaehler für falsch bestromte Kupplung" SWORD UMR___1_1_0_S5_S3 1 100 0 32767 ECU_ADDRESS 0xFFF8C6D2 DISPLAY_IDENTIFIER n_stoeredslogik.iUl2KupplBInt /end MEASUREMENT
/begin MEASUREMENT iUl2KupplBInt.n_stoeredslogik_init "Kleinster Wert auf dem Feld KF_MAXSTOERCGDELTAI_EDSLOGIK" SWORD UMR___1_1_0_S5_S3 1 100 0 255 ECU_ADDRESS 0xFFF8C6D0 DISPLAY_IDENTIFIER n_stoeredslogik_init.iUl2KupplBInt /end MEASUREMENT
/begin MEASUREMENT iUl2KupplBInt.n_stoeredslogik_schwelle "Schwelle die Überschritten werden muss um die Kupplung als geschlossen zu erkennen" SWORD UMR___1_1_0_S5_S3 1 100 0 510 ECU_ADDRESS 0xFFF8C6CE DISPLAY_IDENTIFIER n_stoeredslogik_schwelle.iUl2KupplBInt /end MEASUREMENT
/begin MEASUREMENT iUl2KupplBSfktFl.n_kup_zu_edslogik_anfahrkup "Kupplung gilt als offen o. geschlosen" FLOAT32_IEEE Conv.cUl2KupplBSfktFl._.n_kup_zu_edslogik_anfahrkup_S5_S3 1 100 0 1 ECU_ADDRESS 0xFFF8C848 FORMAT "%3.2" DISPLAY_IDENTIFIER n_kup_zu_edslogik_anfahrkup.iUl2KupplBSfktFl /end MEASUREMENT
/begin MEASUREMENT iUl2KupplBSfktFl.n_verz_edslogik "Verzögerung bis Kupplung als geschlossen gilt" FLOAT32_IEEE UMR___1_1_0_S5_S3 1 100 0 256 ECU_ADDRESS 0xFFF8C844 FORMAT "%3.2" DISPLAY_IDENTIFIER n_verz_edslogik.iUl2KupplBSfktFl /end MEASUREMENT
/begin MEASUREMENT iUl2KupplBSfktInt.n_kup_zu_edslogik_anfahrkup "Kupplung gilt als offen o. geschlosen" UBYTE Conv.cUl2KupplBSfktInt._.n_kup_zu_edslogik_anfahrkup_S5_S3 1 100 0 1 ECU_ADDRESS 0xFFF8C842 DISPLAY_IDENTIFIER n_kup_zu_edslogik_anfahrkup.iUl2KupplBSfktInt /end MEASUREMENT
/begin MEASUREMENT iUl2KupplBSfktInt.n_verz_edslogik "Verzögerung bis Kupplung als geschlossen gilt" UWORD UMR___1_1_0_S5_S3 1 100 0 256 ECU_ADDRESS 0xFFF8C840 DISPLAY_IDENTIFIER n_verz_edslogik.iUl2KupplBSfktInt /end MEASUREMENT
/begin MEASUREMENT iUl2KupplCFl.cUl2KupBasisFl._.eds_nr "Nummer der EDS" FLOAT32_IEEE UMR___1_1_0_S5_S3 1 100 0 11 ECU_ADDRESS 0xFFF8C744 FORMAT "%3.2" DISPLAY_IDENTIFIER eds_nr._.cUl2KupBasisFl.iUl2KupplCFl /end MEASUREMENT
/begin MEASUREMENT iUl2KupplCFl.cUl2KupBasisFl._.f_geschlossen "Das Flag zeigt an ob die Kupplung geschlossen ist" FLOAT32_IEEE UMR___1_1_0_S5_S3 1 100 0 1 ECU_ADDRESS 0xFFF8C748 FORMAT "%3.2" DISPLAY_IDENTIFIER f_geschlossen._.cUl2KupBasisFl.iUl2KupplCFl /end MEASUREMENT
/begin MEASUREMENT iUl2KupplCFl.cUl2KupBasisFl._.kup_nr "Nummer der Kupplung" FLOAT32_IEEE UMR___1_1_0_S5_S3 1 100 1 6 ECU_ADDRESS 0xFFF8C740 FORMAT "%3.2" DISPLAY_IDENTIFIER kup_nr._.cUl2KupBasisFl.iUl2KupplCFl /end MEASUREMENT
/begin MEASUREMENT iUl2KupplCFl.delta_i_edslogik "Differenz zwischen Kupplungsstrom u. Stromschwelle (KF_IEDSMAXMMOTCGLOGIKUEB bzw. KF_IEDSMINMMOTCGLOGIKUEB)" FLOAT32_IEEE UMR_MA__1_10_0_S5_S3 1 100 0 1000 ECU_ADDRESS 0xFFF8C778 DISPLAY_IDENTIFIER delta_i_edslogik.iUl2KupplCFl /end MEASUREMENT
/begin MEASUREMENT iUl2KupplCFl.f_erste_bef_erk "Das Flag zeigt an, dass die erste Befüllung erkannt wurde." FLOAT32_IEEE UMR___1_1_0_S5_S3 1 100 0 1 ECU_ADDRESS 0xFFF8C77C FORMAT "%3.2" DISPLAY_IDENTIFIER f_erste_bef_erk.iUl2KupplCFl /end MEASUREMENT
/begin MEASUREMENT iUl2KupplCFl.f_init "Gibt an ob die Kupplungswerte Initialisiert wurden sind." FLOAT32_IEEE UMR___1_1_0_S5_S3 1 100 0 1 ECU_ADDRESS 0xFFF8C754 FORMAT "%3.2" DISPLAY_IDENTIFIER f_init.iUl2KupplCFl /end MEASUREMENT
/begin MEASUREMENT iUl2KupplCFl.i_sw_kup_oeffnet "aktuelle Stromschwelle, die überschritten/unterschritten werden muss um die Kupplung als geöffnet zu erkennen" FLOAT32_IEEE UMR_MA__1_10_0_S5_S3 1 100 0 3276.7 ECU_ADDRESS 0xFFF8C768 DISPLAY_IDENTIFIER i_sw_kup_oeffnet.iUl2KupplCFl /end MEASUREMENT
/begin MEASUREMENT iUl2KupplCFl.i_sw_kup_schliesst "aktuelle Stromschwelle, die überschritten/unterschritten werden muss um die Kupplung als geschlossen zu erkennen" FLOAT32_IEEE UMR_MA__1_10_0_S5_S3 1 100 0 3276.7 ECU_ADDRESS 0xFFF8C764 DISPLAY_IDENTIFIER i_sw_kup_schliesst.iUl2KupplCFl /end MEASUREMENT
/begin MEASUREMENT iUl2KupplCFl.n_kup_basis_korrektur "Zähler zur Verzögerung der Korrektur des Störzählers durch Basisstrombedingung" FLOAT32_IEEE UMR___1_1_0_S5_S3 1 100 0 255 ECU_ADDRESS 0xFFF8C774 FORMAT "%3.2" DISPLAY_IDENTIFIER n_kup_basis_korrektur.iUl2KupplCFl /end MEASUREMENT
/begin MEASUREMENT iUl2KupplCFl.n_kup_oeffnet "Zähler zur Verzögerung der Erkennung - Schaltelement nicht geschaltet" FLOAT32_IEEE UMR___1_1_0_S5_S3 1 100 0 255 ECU_ADDRESS 0xFFF8C76C FORMAT "%3.2" DISPLAY_IDENTIFIER n_kup_oeffnet.iUl2KupplCFl /end MEASUREMENT
/begin MEASUREMENT iUl2KupplCFl.n_kup_oeffnet_stromlos "Zähler zur Verzögerung der Erkennung - Schaltelement nicht geschaltet" FLOAT32_IEEE UMR___1_1_0_S5_S3 1 100 0 255 ECU_ADDRESS 0xFFF8C770 FORMAT "%3.2" DISPLAY_IDENTIFIER n_kup_oeffnet_stromlos.iUl2KupplCFl /end MEASUREMENT
/begin MEASUREMENT iUl2KupplCFl.n_stoeredslogik "Stoerzaehler für falsch bestromte Kupplung" FLOAT32_IEEE UMR___1_1_0_S5_S3 1 100 0 32767 ECU_ADDRESS 0xFFF8C760 FORMAT "%3.2" DISPLAY_IDENTIFIER n_stoeredslogik.iUl2KupplCFl /end MEASUREMENT
/begin MEASUREMENT iUl2KupplCFl.n_stoeredslogik_init "Kleinster Wert auf dem Feld KF_MAXSTOERCGDELTAI_EDSLOGIK" FLOAT32_IEEE UMR___1_1_0_S5_S3 1 100 0 255 ECU_ADDRESS 0xFFF8C75C FORMAT "%3.2" DISPLAY_IDENTIFIER n_stoeredslogik_init.iUl2KupplCFl /end MEASUREMENT
/begin MEASUREMENT iUl2KupplCFl.n_stoeredslogik_schwelle "Schwelle die Überschritten werden muss um die Kupplung als geschlossen zu erkennen" FLOAT32_IEEE UMR___1_1_0_S5_S3 1 100 0 510 ECU_ADDRESS 0xFFF8C758 FORMAT "%3.2" DISPLAY_IDENTIFIER n_stoeredslogik_schwelle.iUl2KupplCFl /end MEASUREMENT
/begin MEASUREMENT iUl2KupplCInt.cUl2KupBasisInt._.eds_nr "Nummer der EDS" UBYTE UMR___1_1_0_S5_S3 1 100 0 11 ECU_ADDRESS 0xFFF8C721 DISPLAY_IDENTIFIER eds_nr._.cUl2KupBasisInt.iUl2KupplCInt /end MEASUREMENT
/begin MEASUREMENT iUl2KupplCInt.cUl2KupBasisInt._.f_geschlossen "Das Flag zeigt an ob die Kupplung geschlossen ist" UBYTE UMR___1_1_0_S5_S3 1 100 0 1 ECU_ADDRESS 0xFFF8C722 DISPLAY_IDENTIFIER f_geschlossen._.cUl2KupBasisInt.iUl2KupplCInt /end MEASUREMENT
/begin MEASUREMENT iUl2KupplCInt.cUl2KupBasisInt._.kup_nr "Nummer der Kupplung" UBYTE UMR___1_1_0_S5_S3 1 100 1 6 ECU_ADDRESS 0xFFF8C720 DISPLAY_IDENTIFIER kup_nr._.cUl2KupBasisInt.iUl2KupplCInt /end MEASUREMENT
/begin MEASUREMENT iUl2KupplCInt.delta_i_edslogik "Differenz zwischen Kupplungsstrom u. Stromschwelle (KF_IEDSMAXMMOTCGLOGIKUEB bzw. KF_IEDSMINMMOTCGLOGIKUEB)" SWORD UMR_MA__1_10_0_S5_S3 1 100 0 1000 ECU_ADDRESS 0xFFF8C73C DISPLAY_IDENTIFIER delta_i_edslogik.iUl2KupplCInt /end MEASUREMENT
/begin MEASUREMENT iUl2KupplCInt.f_erste_bef_erk "Das Flag zeigt an, dass die erste Befüllung erkannt wurde." UBYTE UMR___1_1_0_S5_S3 1 100 0 1 ECU_ADDRESS 0xFFF8C73E DISPLAY_IDENTIFIER f_erste_bef_erk.iUl2KupplCInt /end MEASUREMENT
/begin MEASUREMENT iUl2KupplCInt.f_init "Gibt an ob die Kupplungswerte Initialisiert wurden sind." UBYTE UMR___1_1_0_S5_S3 1 100 0 1 ECU_ADDRESS 0xFFF8C72C DISPLAY_IDENTIFIER f_init.iUl2KupplCInt /end MEASUREMENT
/begin MEASUREMENT iUl2KupplCInt.i_sw_kup_oeffnet "aktuelle Stromschwelle, die überschritten/unterschritten werden muss um die Kupplung als geöffnet zu erkennen" SWORD UMR_MA__1_10_0_S5_S3 1 100 0 3276.7 ECU_ADDRESS 0xFFF8C736 DISPLAY_IDENTIFIER i_sw_kup_oeffnet.iUl2KupplCInt /end MEASUREMENT
/begin MEASUREMENT iUl2KupplCInt.i_sw_kup_schliesst "aktuelle Stromschwelle, die überschritten/unterschritten werden muss um die Kupplung als geschlossen zu erkennen" SWORD UMR_MA__1_10_0_S5_S3 1 100 0 3276.7 ECU_ADDRESS 0xFFF8C734 DISPLAY_IDENTIFIER i_sw_kup_schliesst.iUl2KupplCInt /end MEASUREMENT
/begin MEASUREMENT iUl2KupplCInt.n_kup_basis_korrektur "Zähler zur Verzögerung der Korrektur des Störzählers durch Basisstrombedingung" UBYTE UMR___1_1_0_S5_S3 1 100 0 255 ECU_ADDRESS 0xFFF8C73A DISPLAY_IDENTIFIER n_kup_basis_korrektur.iUl2KupplCInt /end MEASUREMENT
/begin MEASUREMENT iUl2KupplCInt.n_kup_oeffnet "Zähler zur Verzögerung der Erkennung - Schaltelement nicht geschaltet" UBYTE UMR___1_1_0_S5_S3 1 100 0 255 ECU_ADDRESS 0xFFF8C738 DISPLAY_IDENTIFIER n_kup_oeffnet.iUl2KupplCInt /end MEASUREMENT
/begin MEASUREMENT iUl2KupplCInt.n_kup_oeffnet_stromlos "Zähler zur Verzögerung der Erkennung - Schaltelement nicht geschaltet" UBYTE UMR___1_1_0_S5_S3 1 100 0 255 ECU_ADDRESS 0xFFF8C739 DISPLAY_IDENTIFIER n_kup_oeffnet_stromlos.iUl2KupplCInt /end MEASUREMENT
/begin MEASUREMENT iUl2KupplCInt.n_stoeredslogik "Stoerzaehler für falsch bestromte Kupplung" SWORD UMR___1_1_0_S5_S3 1 100 0 32767 ECU_ADDRESS 0xFFF8C732 DISPLAY_IDENTIFIER n_stoeredslogik.iUl2KupplCInt /end MEASUREMENT
/begin MEASUREMENT iUl2KupplCInt.n_stoeredslogik_init "Kleinster Wert auf dem Feld KF_MAXSTOERCGDELTAI_EDSLOGIK" SWORD UMR___1_1_0_S5_S3 1 100 0 255 ECU_ADDRESS 0xFFF8C730 DISPLAY_IDENTIFIER n_stoeredslogik_init.iUl2KupplCInt /end MEASUREMENT
/begin MEASUREMENT iUl2KupplCInt.n_stoeredslogik_schwelle "Schwelle die Überschritten werden muss um die Kupplung als geschlossen zu erkennen" SWORD UMR___1_1_0_S5_S3 1 100 0 510 ECU_ADDRESS 0xFFF8C72E DISPLAY_IDENTIFIER n_stoeredslogik_schwelle.iUl2KupplCInt /end MEASUREMENT
/begin MEASUREMENT iUl2KupplDFl.cUl2KupBasisFl._.eds_nr "Nummer der EDS" FLOAT32_IEEE UMR___1_1_0_S5_S3 1 100 0 11 ECU_ADDRESS 0xFFF8C7A4 FORMAT "%3.2" DISPLAY_IDENTIFIER eds_nr._.cUl2KupBasisFl.iUl2KupplDFl /end MEASUREMENT
/begin MEASUREMENT iUl2KupplDFl.cUl2KupBasisFl._.f_geschlossen "Das Flag zeigt an ob die Kupplung geschlossen ist" FLOAT32_IEEE UMR___1_1_0_S5_S3 1 100 0 1 ECU_ADDRESS 0xFFF8C7A8 FORMAT "%3.2" DISPLAY_IDENTIFIER f_geschlossen._.cUl2KupBasisFl.iUl2KupplDFl /end MEASUREMENT
/begin MEASUREMENT iUl2KupplDFl.cUl2KupBasisFl._.kup_nr "Nummer der Kupplung" FLOAT32_IEEE UMR___1_1_0_S5_S3 1 100 1 6 ECU_ADDRESS 0xFFF8C7A0 FORMAT "%3.2" DISPLAY_IDENTIFIER kup_nr._.cUl2KupBasisFl.iUl2KupplDFl /end MEASUREMENT
/begin MEASUREMENT iUl2KupplDFl.delta_i_edslogik "Differenz zwischen Kupplungsstrom u. Stromschwelle (KF_IEDSMAXMMOTCGLOGIKUEB bzw. KF_IEDSMINMMOTCGLOGIKUEB)" FLOAT32_IEEE UMR_MA__1_10_0_S5_S3 1 100 0 1000 ECU_ADDRESS 0xFFF8C7D8 DISPLAY_IDENTIFIER delta_i_edslogik.iUl2KupplDFl /end MEASUREMENT
/begin MEASUREMENT iUl2KupplDFl.f_erste_bef_erk "Das Flag zeigt an, dass die erste Befüllung erkannt wurde." FLOAT32_IEEE UMR___1_1_0_S5_S3 1 100 0 1 ECU_ADDRESS 0xFFF8C7DC FORMAT "%3.2" DISPLAY_IDENTIFIER f_erste_bef_erk.iUl2KupplDFl /end MEASUREMENT
/begin MEASUREMENT iUl2KupplDFl.f_init "Gibt an ob die Kupplungswerte Initialisiert wurden sind." FLOAT32_IEEE UMR___1_1_0_S5_S3 1 100 0 1 ECU_ADDRESS 0xFFF8C7B4 FORMAT "%3.2" DISPLAY_IDENTIFIER f_init.iUl2KupplDFl /end MEASUREMENT
/begin MEASUREMENT iUl2KupplDFl.i_sw_kup_oeffnet "aktuelle Stromschwelle, die überschritten/unterschritten werden muss um die Kupplung als geöffnet zu erkennen" FLOAT32_IEEE UMR_MA__1_10_0_S5_S3 1 100 0 3276.7 ECU_ADDRESS 0xFFF8C7C8 DISPLAY_IDENTIFIER i_sw_kup_oeffnet.iUl2KupplDFl /end MEASUREMENT
/begin MEASUREMENT iUl2KupplDFl.i_sw_kup_schliesst "aktuelle Stromschwelle, die überschritten/unterschritten werden muss um die Kupplung als geschlossen zu erkennen" FLOAT32_IEEE UMR_MA__1_10_0_S5_S3 1 100 0 3276.7 ECU_ADDRESS 0xFFF8C7C4 DISPLAY_IDENTIFIER i_sw_kup_schliesst.iUl2KupplDFl /end MEASUREMENT
/begin MEASUREMENT iUl2KupplDFl.n_kup_basis_korrektur "Zähler zur Verzögerung der Korrektur des Störzählers durch Basisstrombedingung" FLOAT32_IEEE UMR___1_1_0_S5_S3 1 100 0 255 ECU_ADDRESS 0xFFF8C7D4 FORMAT "%3.2" DISPLAY_IDENTIFIER n_kup_basis_korrektur.iUl2KupplDFl /end MEASUREMENT
/begin MEASUREMENT iUl2KupplDFl.n_kup_oeffnet "Zähler zur Verzögerung der Erkennung - Schaltelement nicht geschaltet" FLOAT32_IEEE UMR___1_1_0_S5_S3 1 100 0 255 ECU_ADDRESS 0xFFF8C7CC FORMAT "%3.2" DISPLAY_IDENTIFIER n_kup_oeffnet.iUl2KupplDFl /end MEASUREMENT
/begin MEASUREMENT iUl2KupplDFl.n_kup_oeffnet_stromlos "Zähler zur Verzögerung der Erkennung - Schaltelement nicht geschaltet" FLOAT32_IEEE UMR___1_1_0_S5_S3 1 100 0 255 ECU_ADDRESS 0xFFF8C7D0 FORMAT "%3.2" DISPLAY_IDENTIFIER n_kup_oeffnet_stromlos.iUl2KupplDFl /end MEASUREMENT
/begin MEASUREMENT iUl2KupplDFl.n_stoeredslogik "Stoerzaehler für falsch bestromte Kupplung" FLOAT32_IEEE UMR___1_1_0_S5_S3 1 100 0 32767 ECU_ADDRESS 0xFFF8C7C0 FORMAT "%3.2" DISPLAY_IDENTIFIER n_stoeredslogik.iUl2KupplDFl /end MEASUREMENT
/begin MEASUREMENT iUl2KupplDFl.n_stoeredslogik_init "Kleinster Wert auf dem Feld KF_MAXSTOERCGDELTAI_EDSLOGIK" FLOAT32_IEEE UMR___1_1_0_S5_S3 1 100 0 255 ECU_ADDRESS 0xFFF8C7BC FORMAT "%3.2" DISPLAY_IDENTIFIER n_stoeredslogik_init.iUl2KupplDFl /end MEASUREMENT
/begin MEASUREMENT iUl2KupplDFl.n_stoeredslogik_schwelle "Schwelle die Überschritten werden muss um die Kupplung als geschlossen zu erkennen" FLOAT32_IEEE UMR___1_1_0_S5_S3 1 100 0 510 ECU_ADDRESS 0xFFF8C7B8 FORMAT "%3.2" DISPLAY_IDENTIFIER n_stoeredslogik_schwelle.iUl2KupplDFl /end MEASUREMENT
/begin MEASUREMENT iUl2KupplDInt.cUl2KupBasisInt._.eds_nr "Nummer der EDS" UBYTE UMR___1_1_0_S5_S3 1 100 0 11 ECU_ADDRESS 0xFFF8C781 DISPLAY_IDENTIFIER eds_nr._.cUl2KupBasisInt.iUl2KupplDInt /end MEASUREMENT
/begin MEASUREMENT iUl2KupplDInt.cUl2KupBasisInt._.f_geschlossen "Das Flag zeigt an ob die Kupplung geschlossen ist" UBYTE UMR___1_1_0_S5_S3 1 100 0 1 ECU_ADDRESS 0xFFF8C782 DISPLAY_IDENTIFIER f_geschlossen._.cUl2KupBasisInt.iUl2KupplDInt /end MEASUREMENT
/begin MEASUREMENT iUl2KupplDInt.cUl2KupBasisInt._.kup_nr "Nummer der Kupplung" UBYTE UMR___1_1_0_S5_S3 1 100 1 6 ECU_ADDRESS 0xFFF8C780 DISPLAY_IDENTIFIER kup_nr._.cUl2KupBasisInt.iUl2KupplDInt /end MEASUREMENT
/begin MEASUREMENT iUl2KupplDInt.delta_i_edslogik "Differenz zwischen Kupplungsstrom u. Stromschwelle (KF_IEDSMAXMMOTCGLOGIKUEB bzw. KF_IEDSMINMMOTCGLOGIKUEB)" SWORD UMR_MA__1_10_0_S5_S3 1 100 0 1000 ECU_ADDRESS 0xFFF8C79C DISPLAY_IDENTIFIER delta_i_edslogik.iUl2KupplDInt /end MEASUREMENT
/begin MEASUREMENT iUl2KupplDInt.f_erste_bef_erk "Das Flag zeigt an, dass die erste Befüllung erkannt wurde." UBYTE UMR___1_1_0_S5_S3 1 100 0 1 ECU_ADDRESS 0xFFF8C79E DISPLAY_IDENTIFIER f_erste_bef_erk.iUl2KupplDInt /end MEASUREMENT
/begin MEASUREMENT iUl2KupplDInt.f_init "Gibt an ob die Kupplungswerte Initialisiert wurden sind." UBYTE UMR___1_1_0_S5_S3 1 100 0 1 ECU_ADDRESS 0xFFF8C78C DISPLAY_IDENTIFIER f_init.iUl2KupplDInt /end MEASUREMENT
/begin MEASUREMENT iUl2KupplDInt.i_sw_kup_oeffnet "aktuelle Stromschwelle, die überschritten/unterschritten werden muss um die Kupplung als geöffnet zu erkennen" SWORD UMR_MA__1_10_0_S5_S3 1 100 0 3276.7 ECU_ADDRESS 0xFFF8C796 DISPLAY_IDENTIFIER i_sw_kup_oeffnet.iUl2KupplDInt /end MEASUREMENT
/begin MEASUREMENT iUl2KupplDInt.i_sw_kup_schliesst "aktuelle Stromschwelle, die überschritten/unterschritten werden muss um die Kupplung als geschlossen zu erkennen" SWORD UMR_MA__1_10_0_S5_S3 1 100 0 3276.7 ECU_ADDRESS 0xFFF8C794 DISPLAY_IDENTIFIER i_sw_kup_schliesst.iUl2KupplDInt /end MEASUREMENT
/begin MEASUREMENT iUl2KupplDInt.n_kup_basis_korrektur "Zähler zur Verzögerung der Korrektur des Störzählers durch Basisstrombedingung" UBYTE UMR___1_1_0_S5_S3 1 100 0 255 ECU_ADDRESS 0xFFF8C79A DISPLAY_IDENTIFIER n_kup_basis_korrektur.iUl2KupplDInt /end MEASUREMENT
/begin MEASUREMENT iUl2KupplDInt.n_kup_oeffnet "Zähler zur Verzögerung der Erkennung - Schaltelement nicht geschaltet" UBYTE UMR___1_1_0_S5_S3 1 100 0 255 ECU_ADDRESS 0xFFF8C798 DISPLAY_IDENTIFIER n_kup_oeffnet.iUl2KupplDInt /end MEASUREMENT
/begin MEASUREMENT iUl2KupplDInt.n_kup_oeffnet_stromlos "Zähler zur Verzögerung der Erkennung - Schaltelement nicht geschaltet" UBYTE UMR___1_1_0_S5_S3 1 100 0 255 ECU_ADDRESS 0xFFF8C799 DISPLAY_IDENTIFIER n_kup_oeffnet_stromlos.iUl2KupplDInt /end MEASUREMENT
/begin MEASUREMENT iUl2KupplDInt.n_stoeredslogik "Stoerzaehler für falsch bestromte Kupplung" SWORD UMR___1_1_0_S5_S3 1 100 0 32767 ECU_ADDRESS 0xFFF8C792 DISPLAY_IDENTIFIER n_stoeredslogik.iUl2KupplDInt /end MEASUREMENT
/begin MEASUREMENT iUl2KupplDInt.n_stoeredslogik_init "Kleinster Wert auf dem Feld KF_MAXSTOERCGDELTAI_EDSLOGIK" SWORD UMR___1_1_0_S5_S3 1 100 0 255 ECU_ADDRESS 0xFFF8C790 DISPLAY_IDENTIFIER n_stoeredslogik_init.iUl2KupplDInt /end MEASUREMENT
/begin MEASUREMENT iUl2KupplDInt.n_stoeredslogik_schwelle "Schwelle die Überschritten werden muss um die Kupplung als geschlossen zu erkennen" SWORD UMR___1_1_0_S5_S3 1 100 0 510 ECU_ADDRESS 0xFFF8C78E DISPLAY_IDENTIFIER n_stoeredslogik_schwelle.iUl2KupplDInt /end MEASUREMENT
/begin MEASUREMENT iUl2KupplEFl.cUl2KupBasisFl._.eds_nr "Nummer der EDS" FLOAT32_IEEE UMR___1_1_0_S5_S3 1 100 0 11 ECU_ADDRESS 0xFFF8C804 FORMAT "%3.2" DISPLAY_IDENTIFIER eds_nr._.cUl2KupBasisFl.iUl2KupplEFl /end MEASUREMENT
/begin MEASUREMENT iUl2KupplEFl.cUl2KupBasisFl._.f_geschlossen "Das Flag zeigt an ob die Kupplung geschlossen ist" FLOAT32_IEEE UMR___1_1_0_S5_S3 1 100 0 1 ECU_ADDRESS 0xFFF8C808 FORMAT "%3.2" DISPLAY_IDENTIFIER f_geschlossen._.cUl2KupBasisFl.iUl2KupplEFl /end MEASUREMENT
/begin MEASUREMENT iUl2KupplEFl.cUl2KupBasisFl._.kup_nr "Nummer der Kupplung" FLOAT32_IEEE UMR___1_1_0_S5_S3 1 100 1 6 ECU_ADDRESS 0xFFF8C800 FORMAT "%3.2" DISPLAY_IDENTIFIER kup_nr._.cUl2KupBasisFl.iUl2KupplEFl /end MEASUREMENT
/begin MEASUREMENT iUl2KupplEFl.delta_i_edslogik "Differenz zwischen Kupplungsstrom u. Stromschwelle (KF_IEDSMAXMMOTCGLOGIKUEB bzw. KF_IEDSMINMMOTCGLOGIKUEB)" FLOAT32_IEEE UMR_MA__1_10_0_S5_S3 1 100 0 1000 ECU_ADDRESS 0xFFF8C838 DISPLAY_IDENTIFIER delta_i_edslogik.iUl2KupplEFl /end MEASUREMENT
/begin MEASUREMENT iUl2KupplEFl.f_erste_bef_erk "Das Flag zeigt an, dass die erste Befüllung erkannt wurde." FLOAT32_IEEE UMR___1_1_0_S5_S3 1 100 0 1 ECU_ADDRESS 0xFFF8C83C FORMAT "%3.2" DISPLAY_IDENTIFIER f_erste_bef_erk.iUl2KupplEFl /end MEASUREMENT
/begin MEASUREMENT iUl2KupplEFl.f_init "Gibt an ob die Kupplungswerte Initialisiert wurden sind." FLOAT32_IEEE UMR___1_1_0_S5_S3 1 100 0 1 ECU_ADDRESS 0xFFF8C814 FORMAT "%3.2" DISPLAY_IDENTIFIER f_init.iUl2KupplEFl /end MEASUREMENT
/begin MEASUREMENT iUl2KupplEFl.i_sw_kup_oeffnet "aktuelle Stromschwelle, die überschritten/unterschritten werden muss um die Kupplung als geöffnet zu erkennen" FLOAT32_IEEE UMR_MA__1_10_0_S5_S3 1 100 0 3276.7 ECU_ADDRESS 0xFFF8C828 DISPLAY_IDENTIFIER i_sw_kup_oeffnet.iUl2KupplEFl /end MEASUREMENT
/begin MEASUREMENT iUl2KupplEFl.i_sw_kup_schliesst "aktuelle Stromschwelle, die überschritten/unterschritten werden muss um die Kupplung als geschlossen zu erkennen" FLOAT32_IEEE UMR_MA__1_10_0_S5_S3 1 100 0 3276.7 ECU_ADDRESS 0xFFF8C824 DISPLAY_IDENTIFIER i_sw_kup_schliesst.iUl2KupplEFl /end MEASUREMENT
/begin MEASUREMENT iUl2KupplEFl.n_kup_basis_korrektur "Zähler zur Verzögerung der Korrektur des Störzählers durch Basisstrombedingung" FLOAT32_IEEE UMR___1_1_0_S5_S3 1 100 0 255 ECU_ADDRESS 0xFFF8C834 FORMAT "%3.2" DISPLAY_IDENTIFIER n_kup_basis_korrektur.iUl2KupplEFl /end MEASUREMENT
/begin MEASUREMENT iUl2KupplEFl.n_kup_oeffnet "Zähler zur Verzögerung der Erkennung - Schaltelement nicht geschaltet" FLOAT32_IEEE UMR___1_1_0_S5_S3 1 100 0 255 ECU_ADDRESS 0xFFF8C82C FORMAT "%3.2" DISPLAY_IDENTIFIER n_kup_oeffnet.iUl2KupplEFl /end MEASUREMENT
/begin MEASUREMENT iUl2KupplEFl.n_kup_oeffnet_stromlos "Zähler zur Verzögerung der Erkennung - Schaltelement nicht geschaltet" FLOAT32_IEEE UMR___1_1_0_S5_S3 1 100 0 255 ECU_ADDRESS 0xFFF8C830 FORMAT "%3.2" DISPLAY_IDENTIFIER n_kup_oeffnet_stromlos.iUl2KupplEFl /end MEASUREMENT
/begin MEASUREMENT iUl2KupplEFl.n_stoeredslogik "Stoerzaehler für falsch bestromte Kupplung" FLOAT32_IEEE UMR___1_1_0_S5_S3 1 100 0 32767 ECU_ADDRESS 0xFFF8C820 FORMAT "%3.2" DISPLAY_IDENTIFIER n_stoeredslogik.iUl2KupplEFl /end MEASUREMENT
/begin MEASUREMENT iUl2KupplEFl.n_stoeredslogik_init "Kleinster Wert auf dem Feld KF_MAXSTOERCGDELTAI_EDSLOGIK" FLOAT32_IEEE UMR___1_1_0_S5_S3 1 100 0 255 ECU_ADDRESS 0xFFF8C81C FORMAT "%3.2" DISPLAY_IDENTIFIER n_stoeredslogik_init.iUl2KupplEFl /end MEASUREMENT
/begin MEASUREMENT iUl2KupplEFl.n_stoeredslogik_schwelle "Schwelle die Überschritten werden muss um die Kupplung als geschlossen zu erkennen" FLOAT32_IEEE UMR___1_1_0_S5_S3 1 100 0 510 ECU_ADDRESS 0xFFF8C818 FORMAT "%3.2" DISPLAY_IDENTIFIER n_stoeredslogik_schwelle.iUl2KupplEFl /end MEASUREMENT
/begin MEASUREMENT iUl2KupplEInt.cUl2KupBasisInt._.eds_nr "Nummer der EDS" UBYTE UMR___1_1_0_S5_S3 1 100 0 11 ECU_ADDRESS 0xFFF8C7E1 DISPLAY_IDENTIFIER eds_nr._.cUl2KupBasisInt.iUl2KupplEInt /end MEASUREMENT
/begin MEASUREMENT iUl2KupplEInt.cUl2KupBasisInt._.f_geschlossen "Das Flag zeigt an ob die Kupplung geschlossen ist" UBYTE UMR___1_1_0_S5_S3 1 100 0 1 ECU_ADDRESS 0xFFF8C7E2 DISPLAY_IDENTIFIER f_geschlossen._.cUl2KupBasisInt.iUl2KupplEInt /end MEASUREMENT
/begin MEASUREMENT iUl2KupplEInt.cUl2KupBasisInt._.kup_nr "Nummer der Kupplung" UBYTE UMR___1_1_0_S5_S3 1 100 1 6 ECU_ADDRESS 0xFFF8C7E0 DISPLAY_IDENTIFIER kup_nr._.cUl2KupBasisInt.iUl2KupplEInt /end MEASUREMENT
/begin MEASUREMENT iUl2KupplEInt.delta_i_edslogik "Differenz zwischen Kupplungsstrom u. Stromschwelle (KF_IEDSMAXMMOTCGLOGIKUEB bzw. KF_IEDSMINMMOTCGLOGIKUEB)" SWORD UMR_MA__1_10_0_S5_S3 1 100 0 1000 ECU_ADDRESS 0xFFF8C7FC DISPLAY_IDENTIFIER delta_i_edslogik.iUl2KupplEInt /end MEASUREMENT
/begin MEASUREMENT iUl2KupplEInt.f_erste_bef_erk "Das Flag zeigt an, dass die erste Befüllung erkannt wurde." UBYTE UMR___1_1_0_S5_S3 1 100 0 1 ECU_ADDRESS 0xFFF8C7FE DISPLAY_IDENTIFIER f_erste_bef_erk.iUl2KupplEInt /end MEASUREMENT
/begin MEASUREMENT iUl2KupplEInt.f_init "Gibt an ob die Kupplungswerte Initialisiert wurden sind." UBYTE UMR___1_1_0_S5_S3 1 100 0 1 ECU_ADDRESS 0xFFF8C7EC DISPLAY_IDENTIFIER f_init.iUl2KupplEInt /end MEASUREMENT
/begin MEASUREMENT iUl2KupplEInt.i_sw_kup_oeffnet "aktuelle Stromschwelle, die überschritten/unterschritten werden muss um die Kupplung als geöffnet zu erkennen" SWORD UMR_MA__1_10_0_S5_S3 1 100 0 3276.7 ECU_ADDRESS 0xFFF8C7F6 DISPLAY_IDENTIFIER i_sw_kup_oeffnet.iUl2KupplEInt /end MEASUREMENT
/begin MEASUREMENT iUl2KupplEInt.i_sw_kup_schliesst "aktuelle Stromschwelle, die überschritten/unterschritten werden muss um die Kupplung als geschlossen zu erkennen" SWORD UMR_MA__1_10_0_S5_S3 1 100 0 3276.7 ECU_ADDRESS 0xFFF8C7F4 DISPLAY_IDENTIFIER i_sw_kup_schliesst.iUl2KupplEInt /end MEASUREMENT
/begin MEASUREMENT iUl2KupplEInt.n_kup_basis_korrektur "Zähler zur Verzögerung der Korrektur des Störzählers durch Basisstrombedingung" UBYTE UMR___1_1_0_S5_S3 1 100 0 255 ECU_ADDRESS 0xFFF8C7FA DISPLAY_IDENTIFIER n_kup_basis_korrektur.iUl2KupplEInt /end MEASUREMENT
/begin MEASUREMENT iUl2KupplEInt.n_kup_oeffnet "Zähler zur Verzögerung der Erkennung - Schaltelement nicht geschaltet" UBYTE UMR___1_1_0_S5_S3 1 100 0 255 ECU_ADDRESS 0xFFF8C7F8 DISPLAY_IDENTIFIER n_kup_oeffnet.iUl2KupplEInt /end MEASUREMENT
/begin MEASUREMENT iUl2KupplEInt.n_kup_oeffnet_stromlos "Zähler zur Verzögerung der Erkennung - Schaltelement nicht geschaltet" UBYTE UMR___1_1_0_S5_S3 1 100 0 255 ECU_ADDRESS 0xFFF8C7F9 DISPLAY_IDENTIFIER n_kup_oeffnet_stromlos.iUl2KupplEInt /end MEASUREMENT
/begin MEASUREMENT iUl2KupplEInt.n_stoeredslogik "Stoerzaehler für falsch bestromte Kupplung" SWORD UMR___1_1_0_S5_S3 1 100 0 32767 ECU_ADDRESS 0xFFF8C7F2 DISPLAY_IDENTIFIER n_stoeredslogik.iUl2KupplEInt /end MEASUREMENT
/begin MEASUREMENT iUl2KupplEInt.n_stoeredslogik_init "Kleinster Wert auf dem Feld KF_MAXSTOERCGDELTAI_EDSLOGIK" SWORD UMR___1_1_0_S5_S3 1 100 0 255 ECU_ADDRESS 0xFFF8C7F0 DISPLAY_IDENTIFIER n_stoeredslogik_init.iUl2KupplEInt /end MEASUREMENT
/begin MEASUREMENT iUl2KupplEInt.n_stoeredslogik_schwelle "Schwelle die Überschritten werden muss um die Kupplung als geschlossen zu erkennen" SWORD UMR___1_1_0_S5_S3 1 100 0 510 ECU_ADDRESS 0xFFF8C7EE DISPLAY_IDENTIFIER n_stoeredslogik_schwelle.iUl2KupplEInt /end MEASUREMENT
/begin MEASUREMENT iUl2KupplPosNPlAFl.cUl2KupplPosNPlFl._.n_stoerposneds "Stoerzaehler fuer falsch bestromte Kupplung waehrend GA." FLOAT32_IEEE UMR___1_1_0_S5_S3 1 100 0 255 ECU_ADDRESS 0xFFF8D478 FORMAT "%3.2" DISPLAY_IDENTIFIER n_stoerposneds._.cUl2KupplPosNPlFl.iUl2KupplPosNPlAFl /end MEASUREMENT
/begin MEASUREMENT iUl2KupplPosNPlAInt.cUl2KupplPosNPlInt._.n_stoerposneds "Stoerzaehler fuer falsch bestromte Kupplung waehrend GA." UBYTE UMR___1_1_0_S5_S3 1 100 0 255 ECU_ADDRESS 0xFFF8D465 DISPLAY_IDENTIFIER n_stoerposneds._.cUl2KupplPosNPlInt.iUl2KupplPosNPlAInt /end MEASUREMENT
/begin MEASUREMENT iUl2KupplPosNPlBFl.cUl2KupplPosNPlFl._.n_stoerposneds "Stoerzaehler fuer falsch bestromte Kupplung waehrend GA." FLOAT32_IEEE UMR___1_1_0_S5_S3 1 100 0 255 ECU_ADDRESS 0xFFF8D49C FORMAT "%3.2" DISPLAY_IDENTIFIER n_stoerposneds._.cUl2KupplPosNPlFl.iUl2KupplPosNPlBFl /end MEASUREMENT
/begin MEASUREMENT iUl2KupplPosNPlBInt.cUl2KupplPosNPlInt._.n_stoerposneds "Stoerzaehler fuer falsch bestromte Kupplung waehrend GA." UBYTE UMR___1_1_0_S5_S3 1 100 0 255 ECU_ADDRESS 0xFFF8D489 DISPLAY_IDENTIFIER n_stoerposneds._.cUl2KupplPosNPlInt.iUl2KupplPosNPlBInt /end MEASUREMENT
/begin MEASUREMENT iUl2KupplPosNPlCFl.cUl2KupplPosNPlFl._.n_stoerposneds "Stoerzaehler fuer falsch bestromte Kupplung waehrend GA." FLOAT32_IEEE UMR___1_1_0_S5_S3 1 100 0 255 ECU_ADDRESS 0xFFF8D4C0 FORMAT "%3.2" DISPLAY_IDENTIFIER n_stoerposneds._.cUl2KupplPosNPlFl.iUl2KupplPosNPlCFl /end MEASUREMENT
/begin MEASUREMENT iUl2KupplPosNPlCInt.cUl2KupplPosNPlInt._.n_stoerposneds "Stoerzaehler fuer falsch bestromte Kupplung waehrend GA." UBYTE UMR___1_1_0_S5_S3 1 100 0 255 ECU_ADDRESS 0xFFF8D4AD DISPLAY_IDENTIFIER n_stoerposneds._.cUl2KupplPosNPlInt.iUl2KupplPosNPlCInt /end MEASUREMENT
/begin MEASUREMENT iUl2KupplPosNPlDFl.cUl2KupplPosNPlFl._.n_stoerposneds "Stoerzaehler fuer falsch bestromte Kupplung waehrend GA." FLOAT32_IEEE UMR___1_1_0_S5_S3 1 100 0 255 ECU_ADDRESS 0xFFF8D4E4 FORMAT "%3.2" DISPLAY_IDENTIFIER n_stoerposneds._.cUl2KupplPosNPlFl.iUl2KupplPosNPlDFl /end MEASUREMENT
/begin MEASUREMENT iUl2KupplPosNPlDInt.cUl2KupplPosNPlInt._.n_stoerposneds "Stoerzaehler fuer falsch bestromte Kupplung waehrend GA." UBYTE UMR___1_1_0_S5_S3 1 100 0 255 ECU_ADDRESS 0xFFF8D4D1 DISPLAY_IDENTIFIER n_stoerposneds._.cUl2KupplPosNPlInt.iUl2KupplPosNPlDInt /end MEASUREMENT
/begin MEASUREMENT iUl2KupplPosNPlEFl.cUl2KupplPosNPlFl._.n_stoerposneds "Stoerzaehler fuer falsch bestromte Kupplung waehrend GA." FLOAT32_IEEE UMR___1_1_0_S5_S3 1 100 0 255 ECU_ADDRESS 0xFFF8D508 FORMAT "%3.2" DISPLAY_IDENTIFIER n_stoerposneds._.cUl2KupplPosNPlFl.iUl2KupplPosNPlEFl /end MEASUREMENT
/begin MEASUREMENT iUl2KupplPosNPlEInt.cUl2KupplPosNPlInt._.n_stoerposneds "Stoerzaehler fuer falsch bestromte Kupplung waehrend GA." UBYTE UMR___1_1_0_S5_S3 1 100 0 255 ECU_ADDRESS 0xFFF8D4F5 DISPLAY_IDENTIFIER n_stoerposneds._.cUl2KupplPosNPlInt.iUl2KupplPosNPlEInt /end MEASUREMENT
/begin MEASUREMENT iUl2MeKoordFl.err_neg_me "FLAG: Fehler in der Ueberwachung negativer Motoreingriff" FLOAT32_IEEE Conv.cUl2MeKoordFl._.err_neg_me_S5_S3 1 100 0 1 ECU_ADDRESS 0xFFF8C8C4 FORMAT "%3.2" DISPLAY_IDENTIFIER err_neg_me.iUl2MeKoordFl /end MEASUREMENT
/begin MEASUREMENT iUl2MeKoordFl.err_pos_me "FLAG: Fehler in der Ueberwachung positiver Motoreingriff" FLOAT32_IEEE Conv.cUl2MeKoordFl._.err_pos_me_S5_S3 1 100 0 1 ECU_ADDRESS 0xFFF8C8C0 FORMAT "%3.2" DISPLAY_IDENTIFIER err_pos_me.iUl2MeKoordFl /end MEASUREMENT
/begin MEASUREMENT iUl2MeKoordInt.err_grad_pos_me "Fehlerflag für PosMe-Gradientenüberwachung" UBYTE Conv.cUl2MeKoordInt._.err_grad_pos_me_S5_S3 1 100 0 1 BIT_MASK 0x1 ECU_ADDRESS 0xFFF8C8B4 DISPLAY_IDENTIFIER err_grad_pos_me.iUl2MeKoordInt /end MEASUREMENT
/begin MEASUREMENT iUl2MeKoordInt.err_int_neg_me "Fehlerflag für NegMe-Intensitätsüberwachung" UBYTE Conv.cUl2MeKoordInt._.err_int_neg_me_S5_S3 1 100 0 1 BIT_MASK 0x1 ECU_ADDRESS 0xFFF8C8BC DISPLAY_IDENTIFIER err_int_neg_me.iUl2MeKoordInt /end MEASUREMENT
/begin MEASUREMENT iUl2MeKoordInt.err_int_pos_me "Fehlerflag für PosMe-Intensitätsüberwachung" UBYTE Conv.cUl2MeKoordInt._.err_int_pos_me_S5_S3 1 100 0 1 BIT_MASK 0x1 ECU_ADDRESS 0xFFF8C8AA DISPLAY_IDENTIFIER err_int_pos_me.iUl2MeKoordInt /end MEASUREMENT
/begin MEASUREMENT iUl2MeKoordInt.err_neg_me "FLAG: Fehler in der Ueberwachung negativer Motoreingriff." UBYTE Conv.cUl2MeKoordInt._.err_neg_me_S5_S3 1 100 0 1 BIT_MASK 0x1 ECU_ADDRESS 0xFFF8C8A1 DISPLAY_IDENTIFIER err_neg_me.iUl2MeKoordInt /end MEASUREMENT
/begin MEASUREMENT iUl2MeKoordInt.err_pos_me "FLAG: Fehler in der Ueberwachung positiver Motoreingriff." UBYTE Conv.cUl2MeKoordInt._.err_pos_me_S5_S3 1 100 0 1 BIT_MASK 0x1 ECU_ADDRESS 0xFFF8C8A0 DISPLAY_IDENTIFIER err_pos_me.iUl2MeKoordInt /end MEASUREMENT
/begin MEASUREMENT iUl2MeKoordInt.err_sig_neg_me "Fehlerflag für NegMe-Signalüberwachung" UBYTE Conv.cUl2MeKoordInt._.err_sig_neg_me_S5_S3 1 100 0 1 BIT_MASK 0x1 ECU_ADDRESS 0xFFF8C8B8 DISPLAY_IDENTIFIER err_sig_neg_me.iUl2MeKoordInt /end MEASUREMENT
/begin MEASUREMENT iUl2MeKoordInt.err_sig_pos_me "Fehlerflag für PosMe-Signalüberwachung" UBYTE Conv.cUl2MeKoordInt._.err_sig_pos_me_S5_S3 1 100 0 1 BIT_MASK 0x1 ECU_ADDRESS 0xFFF8C8A4 DISPLAY_IDENTIFIER err_sig_pos_me.iUl2MeKoordInt /end MEASUREMENT
/begin MEASUREMENT iUl2MeKoordInt.n_maxstoernegmeaus "Störzähler NegMe Signalüberwachung" UWORD UMR___1_1_0_S5_S3 1 100 0 65535 ECU_ADDRESS 0xFFF8C8B6 DISPLAY_IDENTIFIER n_maxstoernegmeaus.iUl2MeKoordInt /end MEASUREMENT
/begin MEASUREMENT iUl2MeKoordInt.n_maxstoernegmeint1 "Störzähler NegMe Intensitätsüberwachung" UWORD UMR___1_1_0_S5_S3 1 100 0 65535 ECU_ADDRESS 0xFFF8C8BA DISPLAY_IDENTIFIER n_maxstoernegmeint1.iUl2MeKoordInt /end MEASUREMENT
/begin MEASUREMENT iUl2MeKoordInt.n_maxstoerposmeaus "Störzähler PosMe Signalüberwachung" UWORD UMR___1_1_0_S5_S3 1 100 0 65535 ECU_ADDRESS 0xFFF8C8A2 DISPLAY_IDENTIFIER n_maxstoerposmeaus.iUl2MeKoordInt /end MEASUREMENT
/begin MEASUREMENT iUl2MeKoordInt.n_maxstoerposmeint1 "Störzähler PosMe Intensitätsüberwachung 1. Schwelle" UWORD UMR___1_1_0_S5_S3 1 100 0 65535 ECU_ADDRESS 0xFFF8C8A6 DISPLAY_IDENTIFIER n_maxstoerposmeint1.iUl2MeKoordInt /end MEASUREMENT
/begin MEASUREMENT iUl2MeKoordInt.n_maxstoerposmeint2 "Störzähler PosMe Intensitätsüberwachung 2. Schwelle" UWORD UMR___1_1_0_S5_S3 1 100 0 65535 ECU_ADDRESS 0xFFF8C8A8 DISPLAY_IDENTIFIER n_maxstoerposmeint2.iUl2MeKoordInt /end MEASUREMENT
/begin MEASUREMENT iUl2MeKoordInt.n_stoerposmegradient "Störzähler Gradientenüberwachung PosMe" UWORD UMR___1_1_0_S5_S3 1 100 0 65535 ECU_ADDRESS 0xFFF8C8AC DISPLAY_IDENTIFIER n_stoerposmegradient.iUl2MeKoordInt /end MEASUREMENT
/begin MEASUREMENT iUl2MeKoordInt.ng_meueb "Drehzahlgradient Überwachung Gradientenüberwachung POSME" SLONG UMR_U_MINTASK_1_100_0_S5_S3 1 100 -21474836.48 21474836.47 ECU_ADDRESS 0xFFF8C8B0 DISPLAY_IDENTIFIER ng_meueb.iUl2MeKoordInt /end MEASUREMENT
/begin MEASUREMENT iUl2NegMeIntenFl.cBasFehlerErfolgFl._.flag_fehler "Das Flag zeigt an ob die Ueberwachungen einen Fehler entdeckt hat." FLOAT32_IEEE Conv.cBasFehlerErfolgFl._.flag_fehler_S5_S3 1 100 0 1 ECU_ADDRESS 0xFFF8C9AC FORMAT "%3.2" DISPLAY_IDENTIFIER flag_fehler.iUl2NegMeIntenFl /end MEASUREMENT
/begin MEASUREMENT iUl2NegMeIntenFl.cBasFehlerErfolgFl._.zaehler_erfolge "Erfolgszaehler der Überwachungsfunktion" FLOAT32_IEEE UMR___1_1_0_S5_S3 1 100 0 65535 ECU_ADDRESS 0xFFF8C9B4 FORMAT "%3.2" DISPLAY_IDENTIFIER zaehler_erfolge.iUl2NegMeIntenFl /end MEASUREMENT
/begin MEASUREMENT iUl2NegMeIntenFl.cBasFehlerErfolgFl._.zaehler_fehler "Fehlerzaehler der Überwachungsfunktion" FLOAT32_IEEE UMR___1_1_0_S5_S3 1 100 0 65535 ECU_ADDRESS 0xFFF8C9B0 FORMAT "%3.2" DISPLAY_IDENTIFIER zaehler_fehler.iUl2NegMeIntenFl /end MEASUREMENT
/begin MEASUREMENT iUl2NegMeIntenInt.cBasFehlerErfolgInt._.flag_fehler "Das Flag zeigt an ob die Ueberwachungen einen Fehler entdeckt hat." UBYTE Conv.cBasFehlerErfolgInt._.flag_fehler_S5_S3 1 100 0 1 BIT_MASK 0x1 ECU_ADDRESS 0xFFF8C99C DISPLAY_IDENTIFIER flag_fehler.iUl2NegMeIntenInt /end MEASUREMENT
/begin MEASUREMENT iUl2NegMeIntenInt.cBasFehlerErfolgInt._.zaehler_erfolge "Erfolgszaehler der Überwachungsfunktion" ULONG UMR___1_1_0_S5_S3 1 100 0 65535 ECU_ADDRESS 0xFFF8C9A4 DISPLAY_IDENTIFIER zaehler_erfolge.iUl2NegMeIntenInt /end MEASUREMENT
/begin MEASUREMENT iUl2NegMeIntenInt.cBasFehlerErfolgInt._.zaehler_fehler "Fehlerzaehler der Überwachungsfunktion" ULONG UMR___1_1_0_S5_S3 1 100 0 65535 ECU_ADDRESS 0xFFF8C9A0 DISPLAY_IDENTIFIER zaehler_fehler.iUl2NegMeIntenInt /end MEASUREMENT
/begin MEASUREMENT iUl2NegMeSigFl.cBasFehlerErfolgFl._.flag_fehler "Das Flag zeigt an ob die Ueberwachungen einen Fehler entdeckt hat." FLOAT32_IEEE Conv.cBasFehlerErfolgFl._.flag_fehler_S5_S3 1 100 0 1 ECU_ADDRESS 0xFFF8C98C FORMAT "%3.2" DISPLAY_IDENTIFIER flag_fehler.iUl2NegMeSigFl /end MEASUREMENT
/begin MEASUREMENT iUl2NegMeSigFl.cBasFehlerErfolgFl._.zaehler_erfolge "Erfolgszaehler der Überwachungsfunktion" FLOAT32_IEEE UMR___1_1_0_S5_S3 1 100 0 65535 ECU_ADDRESS 0xFFF8C994 FORMAT "%3.2" DISPLAY_IDENTIFIER zaehler_erfolge.iUl2NegMeSigFl /end MEASUREMENT
/begin MEASUREMENT iUl2NegMeSigFl.cBasFehlerErfolgFl._.zaehler_fehler "Fehlerzaehler der Überwachungsfunktion" FLOAT32_IEEE UMR___1_1_0_S5_S3 1 100 0 65535 ECU_ADDRESS 0xFFF8C990 FORMAT "%3.2" DISPLAY_IDENTIFIER zaehler_fehler.iUl2NegMeSigFl /end MEASUREMENT
/begin MEASUREMENT iUl2NegMeSigInt.cBasFehlerErfolgInt._.flag_fehler "Das Flag zeigt an ob die Ueberwachungen einen Fehler entdeckt hat." UBYTE Conv.cBasFehlerErfolgInt._.flag_fehler_S5_S3 1 100 0 1 BIT_MASK 0x1 ECU_ADDRESS 0xFFF8C97C DISPLAY_IDENTIFIER flag_fehler.iUl2NegMeSigInt /end MEASUREMENT
/begin MEASUREMENT iUl2NegMeSigInt.cBasFehlerErfolgInt._.zaehler_erfolge "Erfolgszaehler der Überwachungsfunktion" ULONG UMR___1_1_0_S5_S3 1 100 0 65535 ECU_ADDRESS 0xFFF8C984 DISPLAY_IDENTIFIER zaehler_erfolge.iUl2NegMeSigInt /end MEASUREMENT
/begin MEASUREMENT iUl2NegMeSigInt.cBasFehlerErfolgInt._.zaehler_fehler "Fehlerzaehler der Überwachungsfunktion" ULONG UMR___1_1_0_S5_S3 1 100 0 65535 ECU_ADDRESS 0xFFF8C980 DISPLAY_IDENTIFIER zaehler_fehler.iUl2NegMeSigInt /end MEASUREMENT
/begin MEASUREMENT iUl2Nmotu.dsc_fehler_alt "Flag: Alter Wert vom vorherigen Programmzyklus von dsc_fehler" UBYTE Conv.cUl2Nmotu._.dsc_fehler_alt_S5_S3 1 100 0 1 ECU_ADDRESS 0xFFF8D53B DISPLAY_IDENTIFIER dsc_fehler_alt.iUl2Nmotu /end MEASUREMENT
/begin MEASUREMENT iUl2Nmotu.dsc_fehler_alt_komp "Flag: Alter Wert vom vorherigen Programmzyklus von dsc_fehler" FLOAT32_IEEE Conv.cUl2Nmotu._.dsc_fehler_alt_komp_S5_S3 1 100 0 1 ECU_ADDRESS 0xFFF8D584 FORMAT "%3.2" DISPLAY_IDENTIFIER dsc_fehler_alt_komp.iUl2Nmotu /end MEASUREMENT
/begin MEASUREMENT iUl2Nmotu.n_mot_max_ul2 "aktuell berechnete maximal zulässige Motordrehzahl für Level2" UWORD UMR_U_MIN_1_1_0_S5_S3 1 100 0 10000 ECU_ADDRESS 0xFFF8D522 DISPLAY_IDENTIFIER n_mot_max_ul2.iUl2Nmotu /end MEASUREMENT
/begin MEASUREMENT iUl2Nmotu.n_mot_max_ul2_alt "alte/zuletzt berechnete maximal zulässige Motordrehzahl für Level2" UWORD UMR_U_MIN_1_1_0_S5_S3 1 100 0 10000 ECU_ADDRESS 0xFFF8D524 DISPLAY_IDENTIFIER n_mot_max_ul2_alt.iUl2Nmotu /end MEASUREMENT
/begin MEASUREMENT iUl2Nmotu.n_mot_max_ul2_alt_komp "alte/zuletzt berechnete maximal zulässige Motordrehzahl für Level2" FLOAT32_IEEE UMR_U_MIN_1_1_0_S5_S3 1 100 0 10000 ECU_ADDRESS 0xFFF8D554 DISPLAY_IDENTIFIER n_mot_max_ul2_alt_komp.iUl2Nmotu /end MEASUREMENT
/begin MEASUREMENT iUl2Nmotu.n_mot_max_ul2_komp "aktuell berechnete maximal zulässige Motordrehzahl für Level2" FLOAT32_IEEE UMR_U_MIN_1_1_0_S5_S3 1 100 0 10000 ECU_ADDRESS 0xFFF8D550 DISPLAY_IDENTIFIER n_mot_max_ul2_komp.iUl2Nmotu /end MEASUREMENT
/begin MEASUREMENT iUl2Nmotu.n_mot_min_l2 "Minimale Motordrehzahl waehrend der Reduzierung der max zul. Motordrehzahlgrenze bie Level2" UWORD UMR_U_MIN_1_1_0_S5_S3 1 100 0 10000 ECU_ADDRESS 0xFFF8D528 DISPLAY_IDENTIFIER n_mot_min_l2.iUl2Nmotu /end MEASUREMENT
/begin MEASUREMENT iUl2Nmotu.n_mot_min_l2_komp "Minimale Motordrehzahl waehrend der Reduzierung der max zul. Motordrehzahlgrenze bie Level2" FLOAT32_IEEE UMR_U_MIN_1_1_0_S5_S3 1 100 0 10000 ECU_ADDRESS 0xFFF8D55C DISPLAY_IDENTIFIER n_mot_min_l2_komp.iUl2Nmotu /end MEASUREMENT
/begin MEASUREMENT iUl2Nmotu.n_mot_obergrenze "neuer Zielwert aus GET_N_MOTABREGEL x F_NMOTUEB für NMOT-Überwachung (Level2)" UWORD UMR_U_MIN_1_1_0_S5_S3 1 100 0 10000 ECU_ADDRESS 0xFFF8D526 DISPLAY_IDENTIFIER n_mot_obergrenze.iUl2Nmotu /end MEASUREMENT
/begin MEASUREMENT iUl2Nmotu.n_mot_obergrenze_komp "neuer Zielwert aus GET_N_MOTABREGEL x F_NMOTUEB für NMOT-Überwachung (Level2)" FLOAT32_IEEE UMR_U_MIN_1_1_0_S5_S3 1 100 0 10000 ECU_ADDRESS 0xFFF8D558 DISPLAY_IDENTIFIER n_mot_obergrenze_komp.iUl2Nmotu /end MEASUREMENT
/begin MEASUREMENT iUl2Nmotu.n_stoer_nmotueb "Zaehler Fehlerfilter NMOT-Ueberwachung" UWORD UMR___1_1_0_S5_S3 1 100 0 65535 ECU_ADDRESS 0xFFF8D51C DISPLAY_IDENTIFIER n_stoer_nmotueb.iUl2Nmotu /end MEASUREMENT
/begin MEASUREMENT iUl2Nmotu.n_stoer_nmotueb_komp "Zaehler Fehlerfilter NMOT-Ueberwachung" FLOAT32_IEEE UMR___1_1_0_S5_S3 1 100 0 65535 ECU_ADDRESS 0xFFF8D540 FORMAT "%3.2" DISPLAY_IDENTIFIER n_stoer_nmotueb_komp.iUl2Nmotu /end MEASUREMENT
/begin MEASUREMENT iUl2Nmotu.n_stoer_nmotueb_rueckfilter "Zaehler Rueckfilterzeit NMOT-Ueberwachung" UWORD UMR___1_1_0_S5_S3 1 100 0 65535 ECU_ADDRESS 0xFFF8D51E DISPLAY_IDENTIFIER n_stoer_nmotueb_rueckfilter.iUl2Nmotu /end MEASUREMENT
/begin MEASUREMENT iUl2Nmotu.n_stoer_nmotueb_rueckfilter_komp "Zaehler Rueckfilterzeit NMOT-Ueberwachung als Komplement" FLOAT32_IEEE UMR___1_1_0_S5_S3 1 100 0 65535 ECU_ADDRESS 0xFFF8D544 FORMAT "%3.2" DISPLAY_IDENTIFIER n_stoer_nmotueb_rueckfilter_komp.iUl2Nmotu /end MEASUREMENT
/begin MEASUREMENT iUl2Nmotu.n_stoer_red_nmotabreg "Verzoegerungszaehler bis Reduzierung der N_Mot-Abregeldrehzahl aktiv wird" UWORD UMR___1_1_0_S5_S3 1 100 0 65535 ECU_ADDRESS 0xFFF8D52A DISPLAY_IDENTIFIER n_stoer_red_nmotabreg.iUl2Nmotu /end MEASUREMENT
/begin MEASUREMENT iUl2Nmotu.n_stoer_red_nmotabreg_komp "Verzoegerungszaehler bis Reduzierung der N_Mot-Abregeldrehzahl aktiv wird" FLOAT32_IEEE UMR___1_1_0_S5_S3 1 100 0 65535 ECU_ADDRESS 0xFFF8D560 FORMAT "%3.2" DISPLAY_IDENTIFIER n_stoer_red_nmotabreg_komp.iUl2Nmotu /end MEASUREMENT
/begin MEASUREMENT iUl2Nmotu.n_stoer_red_ntmaxzg "Verzoegerungszaehler bis Reduzierung der N_T-Grenzdrehzahl aktiv wird" UWORD UMR___1_1_0_S5_S3 1 100 0 65535 ECU_ADDRESS 0xFFF8D538 DISPLAY_IDENTIFIER n_stoer_red_ntmaxzg.iUl2Nmotu /end MEASUREMENT
/begin MEASUREMENT iUl2Nmotu.n_stoer_red_ntmaxzg_komp "Verzoegerungszaehler bis Reduzierung der N_T-Grenzdrehzahl aktiv wird" FLOAT32_IEEE UMR___1_1_0_S5_S3 1 100 0 65535 ECU_ADDRESS 0xFFF8D57C FORMAT "%3.2" DISPLAY_IDENTIFIER n_stoer_red_ntmaxzg_komp.iUl2Nmotu /end MEASUREMENT
/begin MEASUREMENT iUl2Nmotu.n_t_max_zg_l2 "aktuell berechnete maximal (zielgangabhaengig berechnete) Turbinendrehzahl für Level2" UWORD UMR_U_MIN_1_1_0_S5_S3 1 100 0 10000 ECU_ADDRESS 0xFFF8D52E DISPLAY_IDENTIFIER n_t_max_zg_l2.iUl2Nmotu /end MEASUREMENT
/begin MEASUREMENT iUl2Nmotu.n_t_max_zg_l2_alt "alte/zuletzt berechnete maximal zulässige zielgangabhaengig berechnete) Turbinendrehzahl für Level2" UWORD UMR_U_MIN_1_1_0_S5_S3 1 100 0 10000 ECU_ADDRESS 0xFFF8D530 DISPLAY_IDENTIFIER n_t_max_zg_l2_alt.iUl2Nmotu /end MEASUREMENT
/begin MEASUREMENT iUl2Nmotu.n_t_max_zg_l2_alt_komp "alte/zuletzt berechnete maximal zulässige zielgangabhaengig berechnete) Turbinendrehzahl für Level2" FLOAT32_IEEE UMR_U_MIN_1_1_0_S5_S3 1 100 0 10000 ECU_ADDRESS 0xFFF8D56C DISPLAY_IDENTIFIER n_t_max_zg_l2_alt_komp.iUl2Nmotu /end MEASUREMENT
/begin MEASUREMENT iUl2Nmotu.n_t_max_zg_l2_komp "aktuell berechnete maximal (zielgangabhaengig berechnete) Turbinendrehzahl für Level2" FLOAT32_IEEE UMR_U_MIN_1_1_0_S5_S3 1 100 0 10000 ECU_ADDRESS 0xFFF8D568 DISPLAY_IDENTIFIER n_t_max_zg_l2_komp.iUl2Nmotu /end MEASUREMENT
/begin MEASUREMENT iUl2Nmotu.n_t_min_zg_l2 "Minimale Motordrehzahl waehrend der Reduzierung der max zul. Turbinendrehzahlgrenze bie Level2" UWORD UMR_U_MIN_1_1_0_S5_S3 1 100 0 10000 ECU_ADDRESS 0xFFF8D536 DISPLAY_IDENTIFIER n_t_min_zg_l2.iUl2Nmotu /end MEASUREMENT
/begin MEASUREMENT iUl2Nmotu.n_t_min_zg_l2_komp "Minimale Motordrehzahl waehrend der Reduzierung der max zul. Turbinendrehzahlgrenze bie Level2" FLOAT32_IEEE UMR_U_MIN_1_1_0_S5_S3 1 100 0 10000 ECU_ADDRESS 0xFFF8D578 DISPLAY_IDENTIFIER n_t_min_zg_l2_komp.iUl2Nmotu /end MEASUREMENT
/begin MEASUREMENT iUl2Nmotu.n_t_zg_obergrenze "neuer Zielwert aus TAB_NMOTUEBDSCOFF oder GET_N_MOTABREGEL x F_NMOTUEB für NMOT-Überwachung (Level2)" UWORD UMR_U_MIN_1_1_0_S5_S3 1 100 0 10000 ECU_ADDRESS 0xFFF8D532 DISPLAY_IDENTIFIER n_t_zg_obergrenze.iUl2Nmotu /end MEASUREMENT
/begin MEASUREMENT iUl2Nmotu.n_t_zg_obergrenze_alt "alter Zielwert aus TAB_NMOTUEBDSCOFF oder GET_N_MOTABREGEL x F_NMOTUEB für NMOT-Überwachung (Level2)" UWORD UMR_U_MIN_1_1_0_S5_S3 1 100 0 10000 ECU_ADDRESS 0xFFF8D534 DISPLAY_IDENTIFIER n_t_zg_obergrenze_alt.iUl2Nmotu /end MEASUREMENT
/begin MEASUREMENT iUl2Nmotu.n_t_zg_obergrenze_alt_komp "alter Zielwert aus TAB_NMOTUEBDSCOFF oder GET_N_MOTABREGEL x F_NMOTUEB für NMOT-Überwachung (Level2)" FLOAT32_IEEE UMR_U_MIN_1_1_0_S5_S3 1 100 0 10000 ECU_ADDRESS 0xFFF8D574 DISPLAY_IDENTIFIER n_t_zg_obergrenze_alt_komp.iUl2Nmotu /end MEASUREMENT
/begin MEASUREMENT iUl2Nmotu.n_t_zg_obergrenze_komp "neuer Zielwert aus TAB_NMOTUEBDSCOFF oder GET_N_MOTABREGEL x F_NMOTUEB für NMOT-Überwachung (Level2)" FLOAT32_IEEE UMR_U_MIN_1_1_0_S5_S3 1 100 0 10000 ECU_ADDRESS 0xFFF8D570 DISPLAY_IDENTIFIER n_t_zg_obergrenze_komp.iUl2Nmotu /end MEASUREMENT
/begin MEASUREMENT iUl2Nmotu.ntmaxzg_verz_aktiv "Flag: Verzoegerung der Zielgangabhaengige N_T-Grenzdrehzahl bei Reduzierung aktiv" UBYTE Conv.cUl2Nmotu._.ntmaxzg_verz_aktiv_S5_S3 1 100 0 1 BIT_MASK 0x1 ECU_ADDRESS 0xFFF8D53A DISPLAY_IDENTIFIER ntmaxzg_verz_aktiv.iUl2Nmotu /end MEASUREMENT
/begin MEASUREMENT iUl2Nmotu.ntmaxzg_verz_aktiv_komp "Flag: Verzoegerung der Zielgangabhaengige N_T-Grenzdrehzahl bei Reduzierung aktiv" FLOAT32_IEEE Conv.cUl2Nmotu._.ntmaxzg_verz_aktiv_komp_S5_S3 1 100 0 1 ECU_ADDRESS 0xFFF8D580 FORMAT "%3.2" DISPLAY_IDENTIFIER ntmaxzg_verz_aktiv_komp.iUl2Nmotu /end MEASUREMENT
/begin MEASUREMENT iUl2Nmotu.pruefbed_nmotueb_l2 "Lev2 FLAG: Pruefbed. der NMOTUEB erfuellt." UBYTE Conv.cUl2Nmotu._.pruefbed_nmotueb_l2_S5_S3 1 100 0 1 BIT_MASK 0x1 ECU_ADDRESS 0xFFF8D520 DISPLAY_IDENTIFIER pruefbed_nmotueb_l2.iUl2Nmotu /end MEASUREMENT
/begin MEASUREMENT iUl2Nmotu.pruefbed_nmotueb_l2_komp "Lev2 FLAG: Pruefbed. der NMOTUEB erfuellt." FLOAT32_IEEE Conv.cUl2Nmotu._.pruefbed_nmotueb_l2_komp_S5_S3 1 100 0 1 ECU_ADDRESS 0xFFF8D548 FORMAT "%3.2" DISPLAY_IDENTIFIER pruefbed_nmotueb_l2_komp.iUl2Nmotu /end MEASUREMENT
/begin MEASUREMENT iUl2Nmotu.z_nmotabreg_l2 "Zustand N_MOTABREGEL-Bestimmung zur Level2 Fkt Motorueberdrehzahlueberwachung" UBYTE Conv.cUl2Nmotu._.z_nmotabreg_l2_S5_S3 1 100 0 2 ECU_ADDRESS 0xFFF8D521 DISPLAY_IDENTIFIER z_nmotabreg_l2.iUl2Nmotu /end MEASUREMENT
/begin MEASUREMENT iUl2Nmotu.z_nmotabreg_l2_komp "Zustand N_MOTABREGEL-Bestimmung zur Level2 Fkt Motorueberdrehzahlueberwachung" FLOAT32_IEEE Conv.cUl2Nmotu._.z_nmotabreg_l2_komp_S5_S3 1 100 0 2 ECU_ADDRESS 0xFFF8D54C FORMAT "%3.2" DISPLAY_IDENTIFIER z_nmotabreg_l2_komp.iUl2Nmotu /end MEASUREMENT
/begin MEASUREMENT iUl2Nmotu.z_nt_max_zg_l2 "Zustand N_T_MAX_ZG-Bestimmung zur Level2 Fkt. Motorueberdrehzahlueberwachung/Zielgangplausipruefung" UBYTE Conv.cUl2Nmotu._.z_nt_max_zg_l2_S5_S3 1 100 0 2 ECU_ADDRESS 0xFFF8D52C DISPLAY_IDENTIFIER z_nt_max_zg_l2.iUl2Nmotu /end MEASUREMENT
/begin MEASUREMENT iUl2Nmotu.z_nt_max_zg_l2_komp "Zustand N_T_MAX_ZG-Bestimmung zur Level2 Fkt. Motorueberdrehzahlueberwachung/Zielgangplausipruefung" FLOAT32_IEEE Conv.cUl2Nmotu._.z_nt_max_zg_l2_komp_S5_S3 1 100 0 2 ECU_ADDRESS 0xFFF8D564 FORMAT "%3.2" DISPLAY_IDENTIFIER z_nt_max_zg_l2_komp.iUl2Nmotu /end MEASUREMENT
/begin MEASUREMENT iUl2Nmotu.zielgang_sas_alt_l2 "Level2: alter Wert von zielgang_sas" SBYTE Conv.cUl2Nmotu._.zielgang_sas_alt_l2_S5_S3 1 100 -1 8 ECU_ADDRESS 0xFFF8D53C DISPLAY_IDENTIFIER zielgang_sas_alt_l2.iUl2Nmotu /end MEASUREMENT
/begin MEASUREMENT iUl2Nmotu.zielgang_sas_alt_l2_komp "Level2: alter Wert von zielgang_sas" FLOAT32_IEEE Conv.cUl2Nmotu._.zielgang_sas_alt_l2_komp_S5_S3 1 100 -1 8 ECU_ADDRESS 0xFFF8D588 FORMAT "%3.2" DISPLAY_IDENTIFIER zielgang_sas_alt_l2_komp.iUl2Nmotu /end MEASUREMENT
/begin MEASUREMENT iUl2PAbsicherungAuslPFl.einst_bed_einmalig "Wird auf 1 gesetzt wenn P u. Sensorsignal einmalig gesetzt sind u. wieder auf 0 wenn P ausgelegt wird" FLOAT32_IEEE Conv.cUl2PAbsicherungAuslPFl._.einst_bed_einmalig_S5_S3 1 100 0 1 ECU_ADDRESS 0xFFF8D634 FORMAT "%3.2" DISPLAY_IDENTIFIER einst_bed_einmalig.iUl2PAbsicherungAuslPFl /end MEASUREMENT
/begin MEASUREMENT iUl2PAbsicherungAuslPFl.f_call_ext "Signalisiert ob die Fehlerfunktion aufgerufen wurde" FLOAT32_IEEE Conv.cUl2PAbsicherungAuslPFl._.f_call_ext_S5_S3 1 100 0 1 ECU_ADDRESS 0xFFF8D630 FORMAT "%3.2" DISPLAY_IDENTIFIER f_call_ext.iUl2PAbsicherungAuslPFl /end MEASUREMENT
/begin MEASUREMENT iUl2PAbsicherungAuslPFl.n_richtigpos_p "Gutzähler bis Fehlerreaktion zurückgenommen wird." FLOAT32_IEEE UMR___1_1_0_S5_S3 1 100 0 256 ECU_ADDRESS 0xFFF8D63C FORMAT "%3.2" DISPLAY_IDENTIFIER n_richtigpos_p.iUl2PAbsicherungAuslPFl /end MEASUREMENT
/begin MEASUREMENT iUl2PAbsicherungAuslPFl.n_stoerpos_p "Stoerzaehler bis Fehlerreaktion beginnt." FLOAT32_IEEE UMR___1_1_0_S5_S3 1 100 0 256 ECU_ADDRESS 0xFFF8D638 FORMAT "%3.2" DISPLAY_IDENTIFIER n_stoerpos_p.iUl2PAbsicherungAuslPFl /end MEASUREMENT
/begin MEASUREMENT iUl2PAbsicherungAuslPFl.n_vpospueb "Verzögerungszähler, der mit dem Wechsel auf pos_l2 startet" FLOAT32_IEEE UMR___1_1_0_S5_S3 1 100 0 65535 ECU_ADDRESS 0xFFF8D640 FORMAT "%3.2" DISPLAY_IDENTIFIER n_vpospueb.iUl2PAbsicherungAuslPFl /end MEASUREMENT
/begin MEASUREMENT iUl2PAbsicherungAuslPInt.einst_bed_einmalig "Wird auf 1 gesetzt wenn P u. Sensorsignal einmalig gesetzt sind u. wieder auf 0 wenn P ausgelegt wird" UBYTE Conv.cUl2PAbsicherungAuslPInt._.einst_bed_einmalig_S5_S3 1 100 0 1 ECU_ADDRESS 0xFFF8D629 DISPLAY_IDENTIFIER einst_bed_einmalig.iUl2PAbsicherungAuslPInt /end MEASUREMENT
/begin MEASUREMENT iUl2PAbsicherungAuslPInt.f_call_ext "Signalisiert ob die Fehlerfunktion aufgerufen wurde" UBYTE Conv.cUl2PAbsicherungAuslPInt._.f_call_ext_S5_S3 1 100 0 1 ECU_ADDRESS 0xFFF8D628 DISPLAY_IDENTIFIER f_call_ext.iUl2PAbsicherungAuslPInt /end MEASUREMENT
/begin MEASUREMENT iUl2PAbsicherungAuslPInt.n_richtigpos_p "Gutzähler bis Fehlerreaktion zurückgenommen wird." UWORD UMR___1_1_0_S5_S3 1 100 0 256 ECU_ADDRESS 0xFFF8D62C DISPLAY_IDENTIFIER n_richtigpos_p.iUl2PAbsicherungAuslPInt /end MEASUREMENT
/begin MEASUREMENT iUl2PAbsicherungAuslPInt.n_stoerpos_p "Stoerzaehler bis Fehlerreaktion beginnt." UWORD UMR___1_1_0_S5_S3 1 100 0 256 ECU_ADDRESS 0xFFF8D62A DISPLAY_IDENTIFIER n_stoerpos_p.iUl2PAbsicherungAuslPInt /end MEASUREMENT
/begin MEASUREMENT iUl2PAbsicherungAuslPInt.n_vpospueb "Verzögerungszähler, der mit dem Wechsel auf pos_l2 startet" UWORD UMR___1_1_0_S5_S3 1 100 0 65535 ECU_ADDRESS 0xFFF8D62E DISPLAY_IDENTIFIER n_vpospueb.iUl2PAbsicherungAuslPInt /end MEASUREMENT
/begin MEASUREMENT iUl2PAbsicherungEinlPFl.f_call_ext "Signalisiert ob die Fehlerfunktion aufgerufen wurde" FLOAT32_IEEE UMR___1_1_0_S5_S3 1 100 0 1 ECU_ADDRESS 0xFFF8D644 FORMAT "%3.2" DISPLAY_IDENTIFIER f_call_ext.iUl2PAbsicherungEinlPFl /end MEASUREMENT
/begin MEASUREMENT iUl2PAbsicherungEinlPFl.n_richtigvplausipos_p "Gutzähler für Ueberwachung unzulaessiges Auslegen Pos. P" FLOAT32_IEEE UMR___1_1_0_S5_S3 1 100 0 256 ECU_ADDRESS 0xFFF8D64C FORMAT "%3.2" DISPLAY_IDENTIFIER n_richtigvplausipos_p.iUl2PAbsicherungEinlPFl /end MEASUREMENT
/begin MEASUREMENT iUl2PAbsicherungEinlPFl.n_stoervplausipos_p "Störzähler für Ueberwachung unzulaessiges Auslegen Pos. P" FLOAT32_IEEE UMR___1_1_0_S5_S3 1 100 0 256 ECU_ADDRESS 0xFFF8D648 FORMAT "%3.2" DISPLAY_IDENTIFIER n_stoervplausipos_p.iUl2PAbsicherungEinlPFl /end MEASUREMENT
/begin MEASUREMENT iUl2PAbsicherungEinlPInt.f_call_ext "Signalisiert ob die Fehlerfunktion aufgerufen wurde" UBYTE UMR___1_1_0_S5_S3 1 100 0 1 ECU_ADDRESS 0xFFF8D854 DISPLAY_IDENTIFIER f_call_ext.iUl2PAbsicherungEinlPInt /end MEASUREMENT
/begin MEASUREMENT iUl2PAbsicherungEinlPInt.n_richtigvplausipos_p "Gutzähler für Ueberwachung unzulaessiges Auslegen Pos. P" UWORD UMR___1_1_0_S5_S3 1 100 0 256 ECU_ADDRESS 0xFFF8D858 DISPLAY_IDENTIFIER n_richtigvplausipos_p.iUl2PAbsicherungEinlPInt /end MEASUREMENT
/begin MEASUREMENT iUl2PAbsicherungEinlPInt.n_stoervplausipos_p "Störzähler für Ueberwachung unzulaessiges Auslegen Pos. P" UWORD UMR___1_1_0_S5_S3 1 100 0 256 ECU_ADDRESS 0xFFF8D856 DISPLAY_IDENTIFIER n_stoervplausipos_p.iUl2PAbsicherungEinlPInt /end MEASUREMENT
/begin MEASUREMENT iUl2PosMeGradientFl.cBasFehlerErfolgFl._.flag_fehler "Das Flag zeigt an ob die Ueberwachungen einen Fehler entdeckt hat." FLOAT32_IEEE Conv.cBasFehlerErfolgFl._.flag_fehler_S5_S3 1 100 0 1 ECU_ADDRESS 0xFFF8C958 FORMAT "%3.2" DISPLAY_IDENTIFIER flag_fehler.iUl2PosMeGradientFl /end MEASUREMENT
/begin MEASUREMENT iUl2PosMeGradientFl.cBasFehlerErfolgFl._.zaehler_erfolge "Erfolgszaehler der Überwachungsfunktion" FLOAT32_IEEE UMR___1_1_0_S5_S3 1 100 0 65535 ECU_ADDRESS 0xFFF8C960 FORMAT "%3.2" DISPLAY_IDENTIFIER zaehler_erfolge.iUl2PosMeGradientFl /end MEASUREMENT
/begin MEASUREMENT iUl2PosMeGradientFl.cBasFehlerErfolgFl._.zaehler_fehler "Fehlerzaehler der Überwachungsfunktion" FLOAT32_IEEE UMR___1_1_0_S5_S3 1 100 0 65535 ECU_ADDRESS 0xFFF8C95C FORMAT "%3.2" DISPLAY_IDENTIFIER zaehler_fehler.iUl2PosMeGradientFl /end MEASUREMENT
/begin MEASUREMENT iUl2PosMeGradientFl.me_mot_anford "Momentenabforderung der ATSYS" FLOAT32_IEEE UMR_NM__1_1_0_S5_S3 1 100 0 65535 ECU_ADDRESS 0xFFF8C96C DISPLAY_IDENTIFIER me_mot_anford.iUl2PosMeGradientFl /end MEASUREMENT
/begin MEASUREMENT iUl2PosMeGradientFl.me_mot_rueckm "Rueckgemeldeter Getriebe-Motoreingriff Floatberechnung" FLOAT32_IEEE UMR_NM__1_1_0_S5_S3 1 100 0 65535 ECU_ADDRESS 0xFFF8C968 DISPLAY_IDENTIFIER me_mot_rueckm.iUl2PosMeGradientFl /end MEASUREMENT
/begin MEASUREMENT iUl2PosMeGradientFl.ng_ab_fl.n_f "Filterparameter" FLOAT32_IEEE UMR___1_1_0_S5_S3 1 100 -2147483648 2147483647 ECU_ADDRESS 0xFFF8C978 FORMAT "%3.2" DISPLAY_IDENTIFIER n_f.ng_ab_fl.iUl2PosMeGradientFl /end MEASUREMENT
/begin MEASUREMENT iUl2PosMeGradientFl.ng_meueb "Drehzahlgradient Überwachung Gradientenüberwachung POSME Floatberechnung" FLOAT32_IEEE UMR_U_MINTASK_1_100_0_S5_S3 1 100 -327.68 327.67 ECU_ADDRESS 0xFFF8C970 DISPLAY_IDENTIFIER ng_meueb.iUl2PosMeGradientFl /end MEASUREMENT
/begin MEASUREMENT iUl2PosMeGradientFl.ng_t_fl.n_f "Filterparameter" FLOAT32_IEEE UMR___1_1_0_S5_S3 1 100 -2147483648 2147483647 ECU_ADDRESS 0xFFF8C974 FORMAT "%3.2" DISPLAY_IDENTIFIER n_f.ng_t_fl.iUl2PosMeGradientFl /end MEASUREMENT
/begin MEASUREMENT iUl2PosMeGradientInt.cBasFehlerErfolgInt._.flag_fehler "Das Flag zeigt an ob die Ueberwachungen einen Fehler entdeckt hat." UBYTE Conv.cBasFehlerErfolgInt._.flag_fehler_S5_S3 1 100 0 1 BIT_MASK 0x1 ECU_ADDRESS 0xFFF8C938 DISPLAY_IDENTIFIER flag_fehler.iUl2PosMeGradientInt /end MEASUREMENT
/begin MEASUREMENT iUl2PosMeGradientInt.cBasFehlerErfolgInt._.zaehler_erfolge "Erfolgszaehler der Überwachungsfunktion" ULONG UMR___1_1_0_S5_S3 1 100 0 65535 ECU_ADDRESS 0xFFF8C940 DISPLAY_IDENTIFIER zaehler_erfolge.iUl2PosMeGradientInt /end MEASUREMENT
/begin MEASUREMENT iUl2PosMeGradientInt.cBasFehlerErfolgInt._.zaehler_fehler "Fehlerzaehler der Überwachungsfunktion" ULONG UMR___1_1_0_S5_S3 1 100 0 65535 ECU_ADDRESS 0xFFF8C93C DISPLAY_IDENTIFIER zaehler_fehler.iUl2PosMeGradientInt /end MEASUREMENT
/begin MEASUREMENT iUl2PosMeGradientInt.me_mot_anford "Momentenabforderung der ATSYS" UWORD UMR_NM__1_1_0_S5_S3 1 100 0 65535 ECU_ADDRESS 0xFFF8C94A DISPLAY_IDENTIFIER me_mot_anford.iUl2PosMeGradientInt /end MEASUREMENT
/begin MEASUREMENT iUl2PosMeGradientInt.me_mot_rueckm "Rueckgemeldeter Getriebe-Motoreingriff" UWORD UMR_NM__1_1_0_S5_S3 1 100 0 65535 ECU_ADDRESS 0xFFF8C948 DISPLAY_IDENTIFIER me_mot_rueckm.iUl2PosMeGradientInt /end MEASUREMENT
/begin MEASUREMENT iUl2PosMeGradientInt.ng_ab_l2.n_f "Filterparameter" SLONG UMR___1_1_0_S5_S3 1 100 -2147483648 2147483647 ECU_ADDRESS 0xFFF8C954 DISPLAY_IDENTIFIER n_f.ng_ab_l2.iUl2PosMeGradientInt /end MEASUREMENT
/begin MEASUREMENT iUl2PosMeGradientInt.ng_meueb "Drehzahlgradient Überwachung Gradientenüberwachung POSME" SLONG UMR_U_MINTASK_1_100_0_S5_S3 1 100 -21474836.48 21474836.47 ECU_ADDRESS 0xFFF8C94C DISPLAY_IDENTIFIER ng_meueb.iUl2PosMeGradientInt /end MEASUREMENT
/begin MEASUREMENT iUl2PosMeGradientInt.ng_t_l2.n_f "Filterparameter" SLONG UMR___1_1_0_S5_S3 1 100 -2147483648 2147483647 ECU_ADDRESS 0xFFF8C950 DISPLAY_IDENTIFIER n_f.ng_t_l2.iUl2PosMeGradientInt /end MEASUREMENT
/begin MEASUREMENT iUl2PosMeIntenVar1Fl.cBasFehlerErfolgFl._.flag_fehler "Das Flag zeigt an ob die Ueberwachungen einen Fehler entdeckt hat." FLOAT32_IEEE Conv.cBasFehlerErfolgFl._.flag_fehler_S5_S3 1 100 0 1 ECU_ADDRESS 0xFFF8C8FC FORMAT "%3.2" DISPLAY_IDENTIFIER flag_fehler.iUl2PosMeIntenVar1Fl /end MEASUREMENT
/begin MEASUREMENT iUl2PosMeIntenVar1Fl.cBasFehlerErfolgFl._.zaehler_erfolge "Erfolgszaehler der Überwachungsfunktion" FLOAT32_IEEE UMR___1_1_0_S5_S3 1 100 0 65535 ECU_ADDRESS 0xFFF8C904 FORMAT "%3.2" DISPLAY_IDENTIFIER zaehler_erfolge.iUl2PosMeIntenVar1Fl /end MEASUREMENT
/begin MEASUREMENT iUl2PosMeIntenVar1Fl.cBasFehlerErfolgFl._.zaehler_fehler "Fehlerzaehler der Überwachungsfunktion" FLOAT32_IEEE UMR___1_1_0_S5_S3 1 100 0 65535 ECU_ADDRESS 0xFFF8C900 FORMAT "%3.2" DISPLAY_IDENTIFIER zaehler_fehler.iUl2PosMeIntenVar1Fl /end MEASUREMENT
/begin MEASUREMENT iUl2PosMeIntenVar1Fl.schwellen_variante "Wird beim Instanzieren gesetzt und definiert die Überwachungsvariante, die genutzt wird. Die Varianten unterscheiden sich dabei in den Zahlerschwellen." FLOAT32_IEEE Conv.cUl2PosMeIntenFl._.schwellen_variante_S5_S3 1 100 1 2 ECU_ADDRESS 0xFFF8C90C FORMAT "%3.2" DISPLAY_IDENTIFIER schwellen_variante.iUl2PosMeIntenVar1Fl /end MEASUREMENT
/begin MEASUREMENT iUl2PosMeIntenVar1Int.cBasFehlerErfolgInt._.flag_fehler "Das Flag zeigt an ob die Ueberwachungen einen Fehler entdeckt hat." UBYTE Conv.cBasFehlerErfolgInt._.flag_fehler_S5_S3 1 100 0 1 BIT_MASK 0x1 ECU_ADDRESS 0xFFF8C8E8 DISPLAY_IDENTIFIER flag_fehler.iUl2PosMeIntenVar1Int /end MEASUREMENT
/begin MEASUREMENT iUl2PosMeIntenVar1Int.cBasFehlerErfolgInt._.zaehler_erfolge "Erfolgszaehler der Überwachungsfunktion" ULONG UMR___1_1_0_S5_S3 1 100 0 65535 ECU_ADDRESS 0xFFF8C8F0 DISPLAY_IDENTIFIER zaehler_erfolge.iUl2PosMeIntenVar1Int /end MEASUREMENT
/begin MEASUREMENT iUl2PosMeIntenVar1Int.cBasFehlerErfolgInt._.zaehler_fehler "Fehlerzaehler der Überwachungsfunktion" ULONG UMR___1_1_0_S5_S3 1 100 0 65535 ECU_ADDRESS 0xFFF8C8EC DISPLAY_IDENTIFIER zaehler_fehler.iUl2PosMeIntenVar1Int /end MEASUREMENT
/begin MEASUREMENT iUl2PosMeIntenVar1Int.schwellen_variante "Wird beim Instanzieren gesetzt und definiert die Überwachungsvariante, die genutzt wird. Die Varianten unterscheiden sich dabei in den Zahlerschwellen." UBYTE Conv.cUl2PosMeIntenInt._.schwellen_variante_S5_S3 1 100 1 2 ECU_ADDRESS 0xFFF8C8F8 DISPLAY_IDENTIFIER schwellen_variante.iUl2PosMeIntenVar1Int /end MEASUREMENT
/begin MEASUREMENT iUl2PosMeIntenVar2Fl.cBasFehlerErfolgFl._.flag_fehler "Das Flag zeigt an ob die Ueberwachungen einen Fehler entdeckt hat." FLOAT32_IEEE Conv.cBasFehlerErfolgFl._.flag_fehler_S5_S3 1 100 0 1 ECU_ADDRESS 0xFFF8C924 FORMAT "%3.2" DISPLAY_IDENTIFIER flag_fehler.iUl2PosMeIntenVar2Fl /end MEASUREMENT
/begin MEASUREMENT iUl2PosMeIntenVar2Fl.cBasFehlerErfolgFl._.zaehler_erfolge "Erfolgszaehler der Überwachungsfunktion" FLOAT32_IEEE UMR___1_1_0_S5_S3 1 100 0 65535 ECU_ADDRESS 0xFFF8C92C FORMAT "%3.2" DISPLAY_IDENTIFIER zaehler_erfolge.iUl2PosMeIntenVar2Fl /end MEASUREMENT
/begin MEASUREMENT iUl2PosMeIntenVar2Fl.cBasFehlerErfolgFl._.zaehler_fehler "Fehlerzaehler der Überwachungsfunktion" FLOAT32_IEEE UMR___1_1_0_S5_S3 1 100 0 65535 ECU_ADDRESS 0xFFF8C928 FORMAT "%3.2" DISPLAY_IDENTIFIER zaehler_fehler.iUl2PosMeIntenVar2Fl /end MEASUREMENT
/begin MEASUREMENT iUl2PosMeIntenVar2Fl.schwellen_variante "Wird beim Instanzieren gesetzt und definiert die Überwachungsvariante, die genutzt wird. Die Varianten unterscheiden sich dabei in den Zahlerschwellen." FLOAT32_IEEE Conv.cUl2PosMeIntenFl._.schwellen_variante_S5_S3 1 100 1 2 ECU_ADDRESS 0xFFF8C934 FORMAT "%3.2" DISPLAY_IDENTIFIER schwellen_variante.iUl2PosMeIntenVar2Fl /end MEASUREMENT
/begin MEASUREMENT iUl2PosMeIntenVar2Int.cBasFehlerErfolgInt._.flag_fehler "Das Flag zeigt an ob die Ueberwachungen einen Fehler entdeckt hat." UBYTE Conv.cBasFehlerErfolgInt._.flag_fehler_S5_S3 1 100 0 1 BIT_MASK 0x1 ECU_ADDRESS 0xFFF8C910 DISPLAY_IDENTIFIER flag_fehler.iUl2PosMeIntenVar2Int /end MEASUREMENT
/begin MEASUREMENT iUl2PosMeIntenVar2Int.cBasFehlerErfolgInt._.zaehler_erfolge "Erfolgszaehler der Überwachungsfunktion" ULONG UMR___1_1_0_S5_S3 1 100 0 65535 ECU_ADDRESS 0xFFF8C918 DISPLAY_IDENTIFIER zaehler_erfolge.iUl2PosMeIntenVar2Int /end MEASUREMENT
/begin MEASUREMENT iUl2PosMeIntenVar2Int.cBasFehlerErfolgInt._.zaehler_fehler "Fehlerzaehler der Überwachungsfunktion" ULONG UMR___1_1_0_S5_S3 1 100 0 65535 ECU_ADDRESS 0xFFF8C914 DISPLAY_IDENTIFIER zaehler_fehler.iUl2PosMeIntenVar2Int /end MEASUREMENT
/begin MEASUREMENT iUl2PosMeIntenVar2Int.schwellen_variante "Wird beim Instanzieren gesetzt und definiert die Überwachungsvariante, die genutzt wird. Die Varianten unterscheiden sich dabei in den Zahlerschwellen." UBYTE Conv.cUl2PosMeIntenInt._.schwellen_variante_S5_S3 1 100 1 2 ECU_ADDRESS 0xFFF8C920 DISPLAY_IDENTIFIER schwellen_variante.iUl2PosMeIntenVar2Int /end MEASUREMENT
/begin MEASUREMENT iUl2PosMeSigFl.cBasFehlerErfolgFl._.flag_fehler "Das Flag zeigt an ob die Ueberwachungen einen Fehler entdeckt hat." FLOAT32_IEEE Conv.cBasFehlerErfolgFl._.flag_fehler_S5_S3 1 100 0 1 ECU_ADDRESS 0xFFF8C8D8 FORMAT "%3.2" DISPLAY_IDENTIFIER flag_fehler.iUl2PosMeSigFl /end MEASUREMENT
/begin MEASUREMENT iUl2PosMeSigFl.cBasFehlerErfolgFl._.zaehler_erfolge "Erfolgszaehler der Überwachungsfunktion" FLOAT32_IEEE UMR___1_1_0_S5_S3 1 100 0 65535 ECU_ADDRESS 0xFFF8C8E0 FORMAT "%3.2" DISPLAY_IDENTIFIER zaehler_erfolge.iUl2PosMeSigFl /end MEASUREMENT
/begin MEASUREMENT iUl2PosMeSigFl.cBasFehlerErfolgFl._.zaehler_fehler "Fehlerzaehler der Überwachungsfunktion" FLOAT32_IEEE UMR___1_1_0_S5_S3 1 100 0 65535 ECU_ADDRESS 0xFFF8C8DC FORMAT "%3.2" DISPLAY_IDENTIFIER zaehler_fehler.iUl2PosMeSigFl /end MEASUREMENT
/begin MEASUREMENT iUl2PosMeSigInt.cBasFehlerErfolgInt._.flag_fehler "Das Flag zeigt an ob die Ueberwachungen einen Fehler entdeckt hat." UBYTE Conv.cBasFehlerErfolgInt._.flag_fehler_S5_S3 1 100 0 1 BIT_MASK 0x1 ECU_ADDRESS 0xFFF8C8C8 DISPLAY_IDENTIFIER flag_fehler.iUl2PosMeSigInt /end MEASUREMENT
/begin MEASUREMENT iUl2PosMeSigInt.cBasFehlerErfolgInt._.zaehler_erfolge "Erfolgszaehler der Überwachungsfunktion" ULONG UMR___1_1_0_S5_S3 1 100 0 65535 ECU_ADDRESS 0xFFF8C8D0 DISPLAY_IDENTIFIER zaehler_erfolge.iUl2PosMeSigInt /end MEASUREMENT
/begin MEASUREMENT iUl2PosMeSigInt.cBasFehlerErfolgInt._.zaehler_fehler "Fehlerzaehler der Überwachungsfunktion" ULONG UMR___1_1_0_S5_S3 1 100 0 65535 ECU_ADDRESS 0xFFF8C8CC DISPLAY_IDENTIFIER zaehler_fehler.iUl2PosMeSigInt /end MEASUREMENT
/begin MEASUREMENT iUl2PosNPlFl.ctr_posn_ok "Anzahl Gut-gepruefter Durchlaeufe der PosN-Plausi." FLOAT32_IEEE UMR___1_1_0_S5_S3 1 100 0 4 ECU_ADDRESS 0xFFF8D454 FORMAT "%3.2" DISPLAY_IDENTIFIER ctr_posn_ok.iUl2PosNPlFl /end MEASUREMENT
/begin MEASUREMENT iUl2PosNPlFl.f_fehler_vorhanden "Signalisiert ob die Fehlerfunktion aufgerufen wurde" FLOAT32_IEEE UMR___1_1_0_S5_S3 1 100 0 1 ECU_ADDRESS 0xFFF8D458 FORMAT "%3.2" DISPLAY_IDENTIFIER f_fehler_vorhanden.iUl2PosNPlFl /end MEASUREMENT
/begin MEASUREMENT iUl2PosNPlFl.f_phase_b_aktiv "Phase B der Ueberwachung laeuft (Gang ausgelegt)." FLOAT32_IEEE Conv.cUl2PosNPlFl._.f_phase_b_aktiv_S5_S3 1 100 0 1 ECU_ADDRESS 0xFFF8D450 FORMAT "%3.2" DISPLAY_IDENTIFIER f_phase_b_aktiv.iUl2PosNPlFl /end MEASUREMENT
/begin MEASUREMENT iUl2PosNPlFl.n_stoerposneds_phase_a "Stoerzaehler fuer unerlaubten Kraftfluss in Phase A." FLOAT32_IEEE UMR___1_1_0_S5_S3 1 100 0 255 ECU_ADDRESS 0xFFF8D448 FORMAT "%3.2" DISPLAY_IDENTIFIER n_stoerposneds_phase_a.iUl2PosNPlFl /end MEASUREMENT
/begin MEASUREMENT iUl2PosNPlFl.n_stoerposneds_phase_b "Stoerzaehler fuer unerlaubten Kraftfluss in Phase B." FLOAT32_IEEE UMR___1_1_0_S5_S3 1 100 0 255 ECU_ADDRESS 0xFFF8D44C FORMAT "%3.2" DISPLAY_IDENTIFIER n_stoerposneds_phase_b.iUl2PosNPlFl /end MEASUREMENT
/begin MEASUREMENT iUl2PosNPlInt.ctr_posn_ok "Anzahl Gut-gepruefter Durchlaeufe der PosN-Plausi." UBYTE UMR___1_1_0_S5_S3 1 100 0 4 ECU_ADDRESS 0xFFF8974C DISPLAY_IDENTIFIER ctr_posn_ok.iUl2PosNPlInt /end MEASUREMENT
/begin MEASUREMENT iUl2PosNPlInt.f_fehler_vorhanden "Signalisiert ob die Fehlerfunktion aufgerufen wurde" UBYTE UMR___1_1_0_S5_S3 1 100 0 1 ECU_ADDRESS 0xFFF8974D DISPLAY_IDENTIFIER f_fehler_vorhanden.iUl2PosNPlInt /end MEASUREMENT
/begin MEASUREMENT iUl2PosNPlInt.f_phase_b_aktiv "Phase B der Ueberwachung laeuft (Gang ausgelegt)." UBYTE Conv.cUl2PosNPlInt._.f_phase_b_aktiv_S5_S3 1 100 0 1 ECU_ADDRESS 0xFFF8974B DISPLAY_IDENTIFIER f_phase_b_aktiv.iUl2PosNPlInt /end MEASUREMENT
/begin MEASUREMENT iUl2PosNPlInt.n_stoerposneds_phase_a "Stoerzaehler fuer unerlaubten Kraftfluss in Phase A." UBYTE UMR___1_1_0_S5_S3 1 100 0 255 ECU_ADDRESS 0xFFF89749 DISPLAY_IDENTIFIER n_stoerposneds_phase_a.iUl2PosNPlInt /end MEASUREMENT
/begin MEASUREMENT iUl2PosNPlInt.n_stoerposneds_phase_b "Stoerzaehler fuer unerlaubten Kraftfluss in Phase B." UBYTE UMR___1_1_0_S5_S3 1 100 0 255 ECU_ADDRESS 0xFFF8974A DISPLAY_IDENTIFIER n_stoerposneds_phase_b.iUl2PosNPlInt /end MEASUREMENT
/begin MEASUREMENT iUl2RGangSicherungFl.f_call_ext "Signalisiert ob die Fehlerfunktion aufgerufen wurde" FLOAT32_IEEE UMR___1_1_0_S5_S3 1 100 0 1 ECU_ADDRESS 0xFFF8D650 FORMAT "%3.2" DISPLAY_IDENTIFIER f_call_ext.iUl2RGangSicherungFl /end MEASUREMENT
/begin MEASUREMENT iUl2RGangSicherungInt.f_call_ext "Signalisiert ob die Fehlerfunktion aufgerufen wurde" UBYTE UMR___1_1_0_S5_S3 1 100 0 1 ECU_ADDRESS 0xFFF89751 DISPLAY_IDENTIFIER f_call_ext.iUl2RGangSicherungInt /end MEASUREMENT
/begin MEASUREMENT iUl2StromlosAusserPsFl.alt_stromlos_ausser_ps_l2 "Speichert den Wert von stromlos_ausser_ps_l2 des vorherigen Zyklus." FLOAT32_IEEE Conv.cUl2StromlosAusserPsFl._.alt_stromlos_ausser_ps_l2_S5_S3 1 100 0 1 ECU_ADDRESS 0xFFF8D590 FORMAT "%3.2" DISPLAY_IDENTIFIER alt_stromlos_ausser_ps_l2.iUl2StromlosAusserPsFl /end MEASUREMENT
/begin MEASUREMENT iUl2StromlosAusserPsFl.stromlos_ausser_ps_l2 "Die Messgröße wird gesetzt, wenn alle Druckregler u. Magnetventile, außer dem Parksperrenmagnet u. MSA-MV kleiner, gleich 50mA sind" FLOAT32_IEEE Conv.cUl2StromlosAusserPsFl._.stromlos_ausser_ps_l2_S5_S3 1 100 0 1 ECU_ADDRESS 0xFFF8D58C FORMAT "%3.2" DISPLAY_IDENTIFIER stromlos_ausser_ps_l2.iUl2StromlosAusserPsFl /end MEASUREMENT
/begin MEASUREMENT iUl2StromlosAusserPsInt.alt_stromlos_ausser_ps_l2 "Speichert den Wert von stromlos_ausser_ps_l2 des vorherigen Zyklus." UBYTE Conv.cUl2StromlosAusserPsInt._.alt_stromlos_ausser_ps_l2_S5_S3 1 100 0 1 ECU_ADDRESS 0xFFF8D853 DISPLAY_IDENTIFIER alt_stromlos_ausser_ps_l2.iUl2StromlosAusserPsInt /end MEASUREMENT
/begin MEASUREMENT iUl2StromlosAusserPsInt.stromlos_ausser_ps_l2 "Die Messgröße wird gesetzt, wenn alle Druckregler u. Magnetventile, außer dem Parksperrenmagnet u. MSA-MV kleiner, gleich 50mA sind" UBYTE Conv.cUl2StromlosAusserPsInt._.stromlos_ausser_ps_l2_S5_S3 1 100 0 1 ECU_ADDRESS 0xFFF8D852 DISPLAY_IDENTIFIER stromlos_ausser_ps_l2.iUl2StromlosAusserPsInt /end MEASUREMENT
/begin MEASUREMENT i_eds0 "EDS 0 Strom" UWORD UMR_MA__1_10_0_S5_S3 1 100 0 1200 ECU_ADDRESS 0xFFF84F9A /end MEASUREMENT
/begin MEASUREMENT i_eds0_komp "Komplementsignal zu EDS 0 Strom" UWORD UMR_MA__1_10_0_S5_S3 1 100 0 6553.5 ECU_ADDRESS 0xFFF84F9C /end MEASUREMENT
/begin MEASUREMENT i_eds1 "EDS 1 Strom" UWORD UMR_MA__1_10_0_S5_S3 1 100 0 1200 ECU_ADDRESS 0xFFF84F7E /end MEASUREMENT
/begin MEASUREMENT i_eds10 "EDS 10 Strom" UWORD UMR_MA__1_10_0_S5_S3 1 100 0 1200 ECU_ADDRESS 0xFFF84FA6 /end MEASUREMENT
/begin MEASUREMENT i_eds10_komp "Komplementsignal zu EDS 10 Strom" UWORD UMR_MA__1_10_0_S5_S3 1 100 0 6553.5 ECU_ADDRESS 0xFFF84FA8 /end MEASUREMENT
/begin MEASUREMENT i_eds11 "EDS 11 Strom" UWORD UMR_MA__1_10_0_S5_S3 1 100 0 1200 ECU_ADDRESS 0xFFF84FAA /end MEASUREMENT
/begin MEASUREMENT i_eds11_komp "Komplementsignal zu EDS 11 Strom" UWORD UMR_MA__1_10_0_S5_S3 1 100 0 6553.5 ECU_ADDRESS 0xFFF84FAC /end MEASUREMENT
/begin MEASUREMENT i_eds1_komp "Komplementsignal zu EDS 1 Strom" UWORD UMR_MA__1_10_0_S5_S3 1 100 0 6553.5 ECU_ADDRESS 0xFFF84F8C /end MEASUREMENT
/begin MEASUREMENT i_eds2 "EDS 2 Strom" UWORD UMR_MA__1_10_0_S5_S3 1 100 0 1200 ECU_ADDRESS 0xFFF84F80 /end MEASUREMENT
/begin MEASUREMENT i_eds2_komp "Komplementsignal zu EDS 2 Strom" UWORD UMR_MA__1_10_0_S5_S3 1 100 0 6553.5 ECU_ADDRESS 0xFFF84F8E /end MEASUREMENT
/begin MEASUREMENT i_eds3 "EDS 3 Strom" UWORD UMR_MA__1_10_0_S5_S3 1 100 0 1200 ECU_ADDRESS 0xFFF84F82 /end MEASUREMENT
/begin MEASUREMENT i_eds3_komp "Komplementsignal zu EDS 3 Strom" UWORD UMR_MA__1_10_0_S5_S3 1 100 0 6553.5 ECU_ADDRESS 0xFFF84F90 /end MEASUREMENT
/begin MEASUREMENT i_eds4 "EDS 4 Strom" UWORD UMR_MA__1_10_0_S5_S3 1 100 0 1200 ECU_ADDRESS 0xFFF84F84 /end MEASUREMENT
/begin MEASUREMENT i_eds4_komp "Komplementsignal zu EDS 4 Strom" UWORD UMR_MA__1_10_0_S5_S3 1 100 0 6553.5 ECU_ADDRESS 0xFFF84F92 /end MEASUREMENT
/begin MEASUREMENT i_eds5 "EDS 5 Strom" UWORD UMR_MA__1_10_0_S5_S3 1 100 0 1200 ECU_ADDRESS 0xFFF84F86 /end MEASUREMENT
/begin MEASUREMENT i_eds5_komp "Komplementsignal zu EDS 5 Strom" UWORD UMR_MA__1_10_0_S5_S3 1 100 0 6553.5 ECU_ADDRESS 0xFFF84F94 /end MEASUREMENT
/begin MEASUREMENT i_eds6 "EDS 6 Strom" UWORD UMR_MA__1_10_0_S5_S3 1 100 0 1200 ECU_ADDRESS 0xFFF84F88 /end MEASUREMENT
/begin MEASUREMENT i_eds6_komp "Komplementsignal zu EDS 6 Strom" UWORD UMR_MA__1_10_0_S5_S3 1 100 0 6553.5 ECU_ADDRESS 0xFFF84F96 /end MEASUREMENT
/begin MEASUREMENT i_eds7 "EDS 7 Strom" UWORD UMR_MA__1_10_0_S5_S3 1 100 0 1200 ECU_ADDRESS 0xFFF84F8A /end MEASUREMENT
/begin MEASUREMENT i_eds7_komp "Komplementsignal zu EDS 7 Strom" UWORD UMR_MA__1_10_0_S5_S3 1 100 0 6553.5 ECU_ADDRESS 0xFFF84F98 /end MEASUREMENT
/begin MEASUREMENT i_eds8 "EDS 8 Strom" UWORD UMR_MA__1_10_0_S5_S3 1 100 0 1200 ECU_ADDRESS 0xFFF84F9E /end MEASUREMENT
/begin MEASUREMENT i_eds8_komp "Komplementsignal zu EDS 8 Strom" UWORD UMR_MA__1_10_0_S5_S3 1 100 0 6553.5 ECU_ADDRESS 0xFFF84FA0 /end MEASUREMENT
/begin MEASUREMENT i_eds9 "EDS 9 Strom" UWORD UMR_MA__1_10_0_S5_S3 1 100 0 1200 ECU_ADDRESS 0xFFF84FA2 /end MEASUREMENT
/begin MEASUREMENT i_eds9_komp "Komplementsignal zu EDS 9 Strom" UWORD UMR_MA__1_10_0_S5_S3 1 100 0 6553.5 ECU_ADDRESS 0xFFF84FA4 /end MEASUREMENT
/begin MEASUREMENT i_eds_k0 "EDS Strom für K0-Trennkupplung" UWORD UMR_MA__1_10_0_S5_S3 1 100 0 1200 ECU_ADDRESS 0xFFF84FB8 /end MEASUREMENT
/begin MEASUREMENT i_eds_kupa "EDS Strom für Kupplung A" UWORD UMR_MA__1_10_0_S5_S3 1 100 0 1200 ECU_ADDRESS 0xFFF84FAE /end MEASUREMENT
/begin MEASUREMENT i_eds_kupb "EDS Strom für Kupplung B" UWORD UMR_MA__1_10_0_S5_S3 1 100 0 1200 ECU_ADDRESS 0xFFF84FB0 /end MEASUREMENT
/begin MEASUREMENT i_eds_kupc "EDS Strom für Kupplung C" UWORD UMR_MA__1_10_0_S5_S3 1 100 0 1200 ECU_ADDRESS 0xFFF84FB2 /end MEASUREMENT
/begin MEASUREMENT i_eds_kupd "EDS Strom für Kupplung D" UWORD UMR_MA__1_10_0_S5_S3 1 100 0 1200 ECU_ADDRESS 0xFFF84FB4 /end MEASUREMENT
/begin MEASUREMENT i_eds_kupe "EDS Strom für Kupplung E" UWORD UMR_MA__1_10_0_S5_S3 1 100 0 1200 ECU_ADDRESS 0xFFF84FB6 /end MEASUREMENT
/begin MEASUREMENT i_eds_psys "EDS Strom für Systemdruck" UWORD UMR_MA__1_10_0_S5_S3 1 100 0 1200 ECU_ADDRESS 0xFFF84FBA /end MEASUREMENT
/begin MEASUREMENT kraftschluss "Zustandssignal Kraftschluss des Getriebes" UBYTE UMR___1_1_0_S5_S3 1 100 0 6 ECU_ADDRESS 0xFFF893C8 /end MEASUREMENT
/begin MEASUREMENT m_hotmodemax "maximal zulaessiges Motormoment aus Hot-Mode Funktion" SWORD UMR_NM__1_1_0_S5_S3 1 100 -200 1300 ECU_ADDRESS 0xFFF84F7C /end MEASUREMENT
/begin MEASUREMENT m_motmax "maximal zulaessiges Motormoment" SWORD UMR_NM__1_1_0_S5_S3 1 100 -200 1300 ECU_ADDRESS 0xFFF84F7A /end MEASUREMENT
/begin MEASUREMENT max_kuehlung_anfordern "max. Kuehlung anfordern" UBYTE UMR___1_1_0_S5_S3 1 100 0 3 ECU_ADDRESS 0xFFF893CB /end MEASUREMENT
/begin MEASUREMENT me_komp "Komplementsiganl zu me_red_abs (Bitweise invertiert)" SWORD UMR_NM__1_1_0_S5_S3 1 100 -1500 1500 ECU_ADDRESS 0xFFF84F78 /end MEASUREMENT
/begin MEASUREMENT me_red_abs "ausgegebene Momentenreduzierung als Absolutmoment" SWORD UMR_NM__1_1_0_S5_S3 1 100 -1500 1500 ECU_ADDRESS 0xFFF84F76 /end MEASUREMENT
/begin MEASUREMENT me_red_status "Status Momentenvorgabe" UBYTE UMR___1_1_0_S5_S3 1 100 0 3 ECU_ADDRESS 0xFFF84FF8 /end MEASUREMENT
/begin MEASUREMENT me_status_komp "Komplementsiganl zu me_red_status (Bitweise invertiert)" UBYTE UMR___1_1_0_S5_S3 1 100 252 255 ECU_ADDRESS 0xFFF84FF9 /end MEASUREMENT
/begin MEASUREMENT mv_1 "Zustand Magntventil 1" UBYTE Conv.mv_1_S5_S3 1 100 0 1 BIT_MASK 0x1 ECU_ADDRESS 0xFFF893D0 /end MEASUREMENT
/begin MEASUREMENT mv_2 "Zustand Magntventil 2" UBYTE Conv.mv_2_S5_S3 1 100 0 1 BIT_MASK 0x1 ECU_ADDRESS 0xFFF893D1 /end MEASUREMENT
/begin MEASUREMENT mv_3 "Zustand Magntventil 3" UBYTE Conv.mv_3_S5_S3 1 100 0 1 BIT_MASK 0x1 ECU_ADDRESS 0xFFF893D2 /end MEASUREMENT
/begin MEASUREMENT reihenschaltung_moeglich "FLAG: Reihenschaltung moeglich" UBYTE UMR___1_1_0_S5_S3 1 100 0 1 BIT_MASK 0x1 ECU_ADDRESS 0xFFF893CA /end MEASUREMENT
/begin MEASUREMENT sbc_info "Zustandsgroesse SBC fuer Softwarepartner" UBYTE UMR___1_1_0_S5_S3 1 100 0 2 ECU_ADDRESS 0xFFF893D3 /end MEASUREMENT
/begin MEASUREMENT sollgang_pruefung "FLAG: Sollgang akzeptiert" UBYTE UMR___1_1_0_S5_S3 1 100 0 1 BIT_MASK 0x1 ECU_ADDRESS 0xFFF893C9 /end MEASUREMENT
/begin MEASUREMENT tmr_StarterReleaseBPRam.f_IsExpired "test_timer" UBYTE SBW_STANDARD_S1_S3 1 100 0 255 ECU_ADDRESS 0xFFF835D6 DISPLAY_IDENTIFIER f_IsExpired.tmr_StarterReleaseBPRam /end MEASUREMENT
/begin MEASUREMENT tmr_StarterReleaseBPRam.timeBuf "test_timer" UWORD SBW_TIMER_10MS_S1_S3 1 100 0 655350 ECU_ADDRESS 0xFFF835D2 DISPLAY_IDENTIFIER timeBuf.tmr_StarterReleaseBPRam /end MEASUREMENT
/begin MEASUREMENT tmr_StarterReleaseBPRam.timeBuf_ "test_timer" UWORD SBW_TIMER_10MS_S1_S3 1 100 0 655350 ECU_ADDRESS 0xFFF835D4 DISPLAY_IDENTIFIER timeBuf_.tmr_StarterReleaseBPRam /end MEASUREMENT
/begin MEASUREMENT ydiFilter_xau16[0] "current filter value of error code [0 .. 254-1]" UWORD EH_STANDARD_S4_S3 1 100 0 65535 ECU_ADDRESS 0xFFF89D90 /end MEASUREMENT
/begin MEASUREMENT ydiFilter_xau16[100] "current filter value of error code [0 .. 254-1]" UWORD EH_STANDARD_S4_S3 1 100 0 65535 ECU_ADDRESS 0xFFF89E58 /end MEASUREMENT
/begin MEASUREMENT ydiFilter_xau16[101] "current filter value of error code [0 .. 254-1]" UWORD EH_STANDARD_S4_S3 1 100 0 65535 ECU_ADDRESS 0xFFF89E5A /end MEASUREMENT
/begin MEASUREMENT ydiFilter_xau16[102] "current filter value of error code [0 .. 254-1]" UWORD EH_STANDARD_S4_S3 1 100 0 65535 ECU_ADDRESS 0xFFF89E5C /end MEASUREMENT
/begin MEASUREMENT ydiFilter_xau16[103] "current filter value of error code [0 .. 254-1]" UWORD EH_STANDARD_S4_S3 1 100 0 65535 ECU_ADDRESS 0xFFF89E5E /end MEASUREMENT
/begin MEASUREMENT ydiFilter_xau16[104] "current filter value of error code [0 .. 254-1]" UWORD EH_STANDARD_S4_S3 1 100 0 65535 ECU_ADDRESS 0xFFF89E60 /end MEASUREMENT
/begin MEASUREMENT ydiFilter_xau16[105] "current filter value of error code [0 .. 254-1]" UWORD EH_STANDARD_S4_S3 1 100 0 65535 ECU_ADDRESS 0xFFF89E62 /end MEASUREMENT
/begin MEASUREMENT ydiFilter_xau16[106] "current filter value of error code [0 .. 254-1]" UWORD EH_STANDARD_S4_S3 1 100 0 65535 ECU_ADDRESS 0xFFF89E64 /end MEASUREMENT
/begin MEASUREMENT ydiFilter_xau16[107] "current filter value of error code [0 .. 254-1]" UWORD EH_STANDARD_S4_S3 1 100 0 65535 ECU_ADDRESS 0xFFF89E66 /end MEASUREMENT
/begin MEASUREMENT ydiFilter_xau16[108] "current filter value of error code [0 .. 254-1]" UWORD EH_STANDARD_S4_S3 1 100 0 65535 ECU_ADDRESS 0xFFF89E68 /end MEASUREMENT
/begin MEASUREMENT ydiFilter_xau16[109] "current filter value of error code [0 .. 254-1]" UWORD EH_STANDARD_S4_S3 1 100 0 65535 ECU_ADDRESS 0xFFF89E6A /end MEASUREMENT
/begin MEASUREMENT ydiFilter_xau16[10] "current filter value of error code [0 .. 254-1]" UWORD EH_STANDARD_S4_S3 1 100 0 65535 ECU_ADDRESS 0xFFF89DA4 /end MEASUREMENT
/begin MEASUREMENT ydiFilter_xau16[110] "current filter value of error code [0 .. 254-1]" UWORD EH_STANDARD_S4_S3 1 100 0 65535 ECU_ADDRESS 0xFFF89E6C /end MEASUREMENT
/begin MEASUREMENT ydiFilter_xau16[111] "current filter value of error code [0 .. 254-1]" UWORD EH_STANDARD_S4_S3 1 100 0 65535 ECU_ADDRESS 0xFFF89E6E /end MEASUREMENT
/begin MEASUREMENT ydiFilter_xau16[112] "current filter value of error code [0 .. 254-1]" UWORD EH_STANDARD_S4_S3 1 100 0 65535 ECU_ADDRESS 0xFFF89E70 /end MEASUREMENT
/begin MEASUREMENT ydiFilter_xau16[113] "current filter value of error code [0 .. 254-1]" UWORD EH_STANDARD_S4_S3 1 100 0 65535 ECU_ADDRESS 0xFFF89E72 /end MEASUREMENT
/begin MEASUREMENT ydiFilter_xau16[114] "current filter value of error code [0 .. 254-1]" UWORD EH_STANDARD_S4_S3 1 100 0 65535 ECU_ADDRESS 0xFFF89E74 /end MEASUREMENT
/begin MEASUREMENT ydiFilter_xau16[115] "current filter value of error code [0 .. 254-1]" UWORD EH_STANDARD_S4_S3 1 100 0 65535 ECU_ADDRESS 0xFFF89E76 /end MEASUREMENT
/begin MEASUREMENT ydiFilter_xau16[116] "current filter value of error code [0 .. 254-1]" UWORD EH_STANDARD_S4_S3 1 100 0 65535 ECU_ADDRESS 0xFFF89E78 /end MEASUREMENT
/begin MEASUREMENT ydiFilter_xau16[117] "current filter value of error code [0 .. 254-1]" UWORD EH_STANDARD_S4_S3 1 100 0 65535 ECU_ADDRESS 0xFFF89E7A /end MEASUREMENT
/begin MEASUREMENT ydiFilter_xau16[118] "current filter value of error code [0 .. 254-1]" UWORD EH_STANDARD_S4_S3 1 100 0 65535 ECU_ADDRESS 0xFFF89E7C /end MEASUREMENT
/begin MEASUREMENT ydiFilter_xau16[119] "current filter value of error code [0 .. 254-1]" UWORD EH_STANDARD_S4_S3 1 100 0 65535 ECU_ADDRESS 0xFFF89E7E /end MEASUREMENT
/begin MEASUREMENT ydiFilter_xau16[11] "current filter value of error code [0 .. 254-1]" UWORD EH_STANDARD_S4_S3 1 100 0 65535 ECU_ADDRESS 0xFFF89DA6 /end MEASUREMENT
/begin MEASUREMENT ydiFilter_xau16[120] "current filter value of error code [0 .. 254-1]" UWORD EH_STANDARD_S4_S3 1 100 0 65535 ECU_ADDRESS 0xFFF89E80 /end MEASUREMENT
/begin MEASUREMENT ydiFilter_xau16[121] "current filter value of error code [0 .. 254-1]" UWORD EH_STANDARD_S4_S3 1 100 0 65535 ECU_ADDRESS 0xFFF89E82 /end MEASUREMENT
/begin MEASUREMENT ydiFilter_xau16[122] "current filter value of error code [0 .. 254-1]" UWORD EH_STANDARD_S4_S3 1 100 0 65535 ECU_ADDRESS 0xFFF89E84 /end MEASUREMENT
/begin MEASUREMENT ydiFilter_xau16[123] "current filter value of error code [0 .. 254-1]" UWORD EH_STANDARD_S4_S3 1 100 0 65535 ECU_ADDRESS 0xFFF89E86 /end MEASUREMENT
/begin MEASUREMENT ydiFilter_xau16[124] "current filter value of error code [0 .. 254-1]" UWORD EH_STANDARD_S4_S3 1 100 0 65535 ECU_ADDRESS 0xFFF89E88 /end MEASUREMENT
/begin MEASUREMENT ydiFilter_xau16[125] "current filter value of error code [0 .. 254-1]" UWORD EH_STANDARD_S4_S3 1 100 0 65535 ECU_ADDRESS 0xFFF89E8A /end MEASUREMENT
/begin MEASUREMENT ydiFilter_xau16[126] "current filter value of error code [0 .. 254-1]" UWORD EH_STANDARD_S4_S3 1 100 0 65535 ECU_ADDRESS 0xFFF89E8C /end MEASUREMENT
/begin MEASUREMENT ydiFilter_xau16[127] "current filter value of error code [0 .. 254-1]" UWORD EH_STANDARD_S4_S3 1 100 0 65535 ECU_ADDRESS 0xFFF89E8E /end MEASUREMENT
/begin MEASUREMENT ydiFilter_xau16[128] "current filter value of error code [0 .. 254-1]" UWORD EH_STANDARD_S4_S3 1 100 0 65535 ECU_ADDRESS 0xFFF89E90 /end MEASUREMENT
/begin MEASUREMENT ydiFilter_xau16[129] "current filter value of error code [0 .. 254-1]" UWORD EH_STANDARD_S4_S3 1 100 0 65535 ECU_ADDRESS 0xFFF89E92 /end MEASUREMENT
/begin MEASUREMENT ydiFilter_xau16[12] "current filter value of error code [0 .. 254-1]" UWORD EH_STANDARD_S4_S3 1 100 0 65535 ECU_ADDRESS 0xFFF89DA8 /end MEASUREMENT
/begin MEASUREMENT ydiFilter_xau16[130] "current filter value of error code [0 .. 254-1]" UWORD EH_STANDARD_S4_S3 1 100 0 65535 ECU_ADDRESS 0xFFF89E94 /end MEASUREMENT
/begin MEASUREMENT ydiFilter_xau16[131] "current filter value of error code [0 .. 254-1]" UWORD EH_STANDARD_S4_S3 1 100 0 65535 ECU_ADDRESS 0xFFF89E96 /end MEASUREMENT
/begin MEASUREMENT ydiFilter_xau16[132] "current filter value of error code [0 .. 254-1]" UWORD EH_STANDARD_S4_S3 1 100 0 65535 ECU_ADDRESS 0xFFF89E98 /end MEASUREMENT
/begin MEASUREMENT ydiFilter_xau16[133] "current filter value of error code [0 .. 254-1]" UWORD EH_STANDARD_S4_S3 1 100 0 65535 ECU_ADDRESS 0xFFF89E9A /end MEASUREMENT
/begin MEASUREMENT ydiFilter_xau16[134] "current filter value of error code [0 .. 254-1]" UWORD EH_STANDARD_S4_S3 1 100 0 65535 ECU_ADDRESS 0xFFF89E9C /end MEASUREMENT
/begin MEASUREMENT ydiFilter_xau16[135] "current filter value of error code [0 .. 254-1]" UWORD EH_STANDARD_S4_S3 1 100 0 65535 ECU_ADDRESS 0xFFF89E9E /end MEASUREMENT
/begin MEASUREMENT ydiFilter_xau16[136] "current filter value of error code [0 .. 254-1]" UWORD EH_STANDARD_S4_S3 1 100 0 65535 ECU_ADDRESS 0xFFF89EA0 /end MEASUREMENT
/begin MEASUREMENT ydiFilter_xau16[137] "current filter value of error code [0 .. 254-1]" UWORD EH_STANDARD_S4_S3 1 100 0 65535 ECU_ADDRESS 0xFFF89EA2 /end MEASUREMENT
/begin MEASUREMENT ydiFilter_xau16[138] "current filter value of error code [0 .. 254-1]" UWORD EH_STANDARD_S4_S3 1 100 0 65535 ECU_ADDRESS 0xFFF89EA4 /end MEASUREMENT
/begin MEASUREMENT ydiFilter_xau16[139] "current filter value of error code [0 .. 254-1]" UWORD EH_STANDARD_S4_S3 1 100 0 65535 ECU_ADDRESS 0xFFF89EA6 /end MEASUREMENT
/begin MEASUREMENT ydiFilter_xau16[13] "current filter value of error code [0 .. 254-1]" UWORD EH_STANDARD_S4_S3 1 100 0 65535 ECU_ADDRESS 0xFFF89DAA /end MEASUREMENT
/begin MEASUREMENT ydiFilter_xau16[140] "current filter value of error code [0 .. 254-1]" UWORD EH_STANDARD_S4_S3 1 100 0 65535 ECU_ADDRESS 0xFFF89EA8 /end MEASUREMENT
/begin MEASUREMENT ydiFilter_xau16[141] "current filter value of error code [0 .. 254-1]" UWORD EH_STANDARD_S4_S3 1 100 0 65535 ECU_ADDRESS 0xFFF89EAA /end MEASUREMENT
/begin MEASUREMENT ydiFilter_xau16[142] "current filter value of error code [0 .. 254-1]" UWORD EH_STANDARD_S4_S3 1 100 0 65535 ECU_ADDRESS 0xFFF89EAC /end MEASUREMENT
/begin MEASUREMENT ydiFilter_xau16[143] "current filter value of error code [0 .. 254-1]" UWORD EH_STANDARD_S4_S3 1 100 0 65535 ECU_ADDRESS 0xFFF89EAE /end MEASUREMENT
/begin MEASUREMENT ydiFilter_xau16[144] "current filter value of error code [0 .. 254-1]" UWORD EH_STANDARD_S4_S3 1 100 0 65535 ECU_ADDRESS 0xFFF89EB0 /end MEASUREMENT
/begin MEASUREMENT ydiFilter_xau16[145] "current filter value of error code [0 .. 254-1]" UWORD EH_STANDARD_S4_S3 1 100 0 65535 ECU_ADDRESS 0xFFF89EB2 /end MEASUREMENT
/begin MEASUREMENT ydiFilter_xau16[146] "current filter value of error code [0 .. 254-1]" UWORD EH_STANDARD_S4_S3 1 100 0 65535 ECU_ADDRESS 0xFFF89EB4 /end MEASUREMENT
/begin MEASUREMENT ydiFilter_xau16[147] "current filter value of error code [0 .. 254-1]" UWORD EH_STANDARD_S4_S3 1 100 0 65535 ECU_ADDRESS 0xFFF89EB6 /end MEASUREMENT
/begin MEASUREMENT ydiFilter_xau16[148] "current filter value of error code [0 .. 254-1]" UWORD EH_STANDARD_S4_S3 1 100 0 65535 ECU_ADDRESS 0xFFF89EB8 /end MEASUREMENT
/begin MEASUREMENT ydiFilter_xau16[149] "current filter value of error code [0 .. 254-1]" UWORD EH_STANDARD_S4_S3 1 100 0 65535 ECU_ADDRESS 0xFFF89EBA /end MEASUREMENT
/begin MEASUREMENT ydiFilter_xau16[14] "current filter value of error code [0 .. 254-1]" UWORD EH_STANDARD_S4_S3 1 100 0 65535 ECU_ADDRESS 0xFFF89DAC /end MEASUREMENT
/begin MEASUREMENT ydiFilter_xau16[150] "current filter value of error code [0 .. 254-1]" UWORD EH_STANDARD_S4_S3 1 100 0 65535 ECU_ADDRESS 0xFFF89EBC /end MEASUREMENT
/begin MEASUREMENT ydiFilter_xau16[151] "current filter value of error code [0 .. 254-1]" UWORD EH_STANDARD_S4_S3 1 100 0 65535 ECU_ADDRESS 0xFFF89EBE /end MEASUREMENT
/begin MEASUREMENT ydiFilter_xau16[152] "current filter value of error code [0 .. 254-1]" UWORD EH_STANDARD_S4_S3 1 100 0 65535 ECU_ADDRESS 0xFFF89EC0 /end MEASUREMENT
/begin MEASUREMENT ydiFilter_xau16[153] "current filter value of error code [0 .. 254-1]" UWORD EH_STANDARD_S4_S3 1 100 0 65535 ECU_ADDRESS 0xFFF89EC2 /end MEASUREMENT
/begin MEASUREMENT ydiFilter_xau16[154] "current filter value of error code [0 .. 254-1]" UWORD EH_STANDARD_S4_S3 1 100 0 65535 ECU_ADDRESS 0xFFF89EC4 /end MEASUREMENT
/begin MEASUREMENT ydiFilter_xau16[155] "current filter value of error code [0 .. 254-1]" UWORD EH_STANDARD_S4_S3 1 100 0 65535 ECU_ADDRESS 0xFFF89EC6 /end MEASUREMENT
/begin MEASUREMENT ydiFilter_xau16[156] "current filter value of error code [0 .. 254-1]" UWORD EH_STANDARD_S4_S3 1 100 0 65535 ECU_ADDRESS 0xFFF89EC8 /end MEASUREMENT
/begin MEASUREMENT ydiFilter_xau16[157] "current filter value of error code [0 .. 254-1]" UWORD EH_STANDARD_S4_S3 1 100 0 65535 ECU_ADDRESS 0xFFF89ECA /end MEASUREMENT
/begin MEASUREMENT ydiFilter_xau16[158] "current filter value of error code [0 .. 254-1]" UWORD EH_STANDARD_S4_S3 1 100 0 65535 ECU_ADDRESS 0xFFF89ECC /end MEASUREMENT
/begin MEASUREMENT ydiFilter_xau16[159] "current filter value of error code [0 .. 254-1]" UWORD EH_STANDARD_S4_S3 1 100 0 65535 ECU_ADDRESS 0xFFF89ECE /end MEASUREMENT
/begin MEASUREMENT ydiFilter_xau16[15] "current filter value of error code [0 .. 254-1]" UWORD EH_STANDARD_S4_S3 1 100 0 65535 ECU_ADDRESS 0xFFF89DAE /end MEASUREMENT
/begin MEASUREMENT ydiFilter_xau16[160] "current filter value of error code [0 .. 254-1]" UWORD EH_STANDARD_S4_S3 1 100 0 65535 ECU_ADDRESS 0xFFF89ED0 /end MEASUREMENT
/begin MEASUREMENT ydiFilter_xau16[161] "current filter value of error code [0 .. 254-1]" UWORD EH_STANDARD_S4_S3 1 100 0 65535 ECU_ADDRESS 0xFFF89ED2 /end MEASUREMENT
/begin MEASUREMENT ydiFilter_xau16[162] "current filter value of error code [0 .. 254-1]" UWORD EH_STANDARD_S4_S3 1 100 0 65535 ECU_ADDRESS 0xFFF89ED4 /end MEASUREMENT
/begin MEASUREMENT ydiFilter_xau16[163] "current filter value of error code [0 .. 254-1]" UWORD EH_STANDARD_S4_S3 1 100 0 65535 ECU_ADDRESS 0xFFF89ED6 /end MEASUREMENT
/begin MEASUREMENT ydiFilter_xau16[164] "current filter value of error code [0 .. 254-1]" UWORD EH_STANDARD_S4_S3 1 100 0 65535 ECU_ADDRESS 0xFFF89ED8 /end MEASUREMENT
/begin MEASUREMENT ydiFilter_xau16[165] "current filter value of error code [0 .. 254-1]" UWORD EH_STANDARD_S4_S3 1 100 0 65535 ECU_ADDRESS 0xFFF89EDA /end MEASUREMENT
/begin MEASUREMENT ydiFilter_xau16[166] "current filter value of error code [0 .. 254-1]" UWORD EH_STANDARD_S4_S3 1 100 0 65535 ECU_ADDRESS 0xFFF89EDC /end MEASUREMENT
/begin MEASUREMENT ydiFilter_xau16[167] "current filter value of error code [0 .. 254-1]" UWORD EH_STANDARD_S4_S3 1 100 0 65535 ECU_ADDRESS 0xFFF89EDE /end MEASUREMENT
/begin MEASUREMENT ydiFilter_xau16[168] "current filter value of error code [0 .. 254-1]" UWORD EH_STANDARD_S4_S3 1 100 0 65535 ECU_ADDRESS 0xFFF89EE0 /end MEASUREMENT
/begin MEASUREMENT ydiFilter_xau16[169] "current filter value of error code [0 .. 254-1]" UWORD EH_STANDARD_S4_S3 1 100 0 65535 ECU_ADDRESS 0xFFF89EE2 /end MEASUREMENT
/begin MEASUREMENT ydiFilter_xau16[16] "current filter value of error code [0 .. 254-1]" UWORD EH_STANDARD_S4_S3 1 100 0 65535 ECU_ADDRESS 0xFFF89DB0 /end MEASUREMENT
/begin MEASUREMENT ydiFilter_xau16[170] "current filter value of error code [0 .. 254-1]" UWORD EH_STANDARD_S4_S3 1 100 0 65535 ECU_ADDRESS 0xFFF89EE4 /end MEASUREMENT
/begin MEASUREMENT ydiFilter_xau16[171] "current filter value of error code [0 .. 254-1]" UWORD EH_STANDARD_S4_S3 1 100 0 65535 ECU_ADDRESS 0xFFF89EE6 /end MEASUREMENT
/begin MEASUREMENT ydiFilter_xau16[172] "current filter value of error code [0 .. 254-1]" UWORD EH_STANDARD_S4_S3 1 100 0 65535 ECU_ADDRESS 0xFFF89EE8 /end MEASUREMENT
/begin MEASUREMENT ydiFilter_xau16[173] "current filter value of error code [0 .. 254-1]" UWORD EH_STANDARD_S4_S3 1 100 0 65535 ECU_ADDRESS 0xFFF89EEA /end MEASUREMENT
/begin MEASUREMENT ydiFilter_xau16[174] "current filter value of error code [0 .. 254-1]" UWORD EH_STANDARD_S4_S3 1 100 0 65535 ECU_ADDRESS 0xFFF89EEC /end MEASUREMENT
/begin MEASUREMENT ydiFilter_xau16[175] "current filter value of error code [0 .. 254-1]" UWORD EH_STANDARD_S4_S3 1 100 0 65535 ECU_ADDRESS 0xFFF89EEE /end MEASUREMENT
/begin MEASUREMENT ydiFilter_xau16[176] "current filter value of error code [0 .. 254-1]" UWORD EH_STANDARD_S4_S3 1 100 0 65535 ECU_ADDRESS 0xFFF89EF0 /end MEASUREMENT
/begin MEASUREMENT ydiFilter_xau16[177] "current filter value of error code [0 .. 254-1]" UWORD EH_STANDARD_S4_S3 1 100 0 65535 ECU_ADDRESS 0xFFF89EF2 /end MEASUREMENT
/begin MEASUREMENT ydiFilter_xau16[178] "current filter value of error code [0 .. 254-1]" UWORD EH_STANDARD_S4_S3 1 100 0 65535 ECU_ADDRESS 0xFFF89EF4 /end MEASUREMENT
/begin MEASUREMENT ydiFilter_xau16[179] "current filter value of error code [0 .. 254-1]" UWORD EH_STANDARD_S4_S3 1 100 0 65535 ECU_ADDRESS 0xFFF89EF6 /end MEASUREMENT
/begin MEASUREMENT ydiFilter_xau16[17] "current filter value of error code [0 .. 254-1]" UWORD EH_STANDARD_S4_S3 1 100 0 65535 ECU_ADDRESS 0xFFF89DB2 /end MEASUREMENT
/begin MEASUREMENT ydiFilter_xau16[180] "current filter value of error code [0 .. 254-1]" UWORD EH_STANDARD_S4_S3 1 100 0 65535 ECU_ADDRESS 0xFFF89EF8 /end MEASUREMENT
/begin MEASUREMENT ydiFilter_xau16[181] "current filter value of error code [0 .. 254-1]" UWORD EH_STANDARD_S4_S3 1 100 0 65535 ECU_ADDRESS 0xFFF89EFA /end MEASUREMENT
/begin MEASUREMENT ydiFilter_xau16[182] "current filter value of error code [0 .. 254-1]" UWORD EH_STANDARD_S4_S3 1 100 0 65535 ECU_ADDRESS 0xFFF89EFC /end MEASUREMENT
/begin MEASUREMENT ydiFilter_xau16[183] "current filter value of error code [0 .. 254-1]" UWORD EH_STANDARD_S4_S3 1 100 0 65535 ECU_ADDRESS 0xFFF89EFE /end MEASUREMENT
/begin MEASUREMENT ydiFilter_xau16[184] "current filter value of error code [0 .. 254-1]" UWORD EH_STANDARD_S4_S3 1 100 0 65535 ECU_ADDRESS 0xFFF89F00 /end MEASUREMENT
/begin MEASUREMENT ydiFilter_xau16[185] "current filter value of error code [0 .. 254-1]" UWORD EH_STANDARD_S4_S3 1 100 0 65535 ECU_ADDRESS 0xFFF89F02 /end MEASUREMENT
/begin MEASUREMENT ydiFilter_xau16[186] "current filter value of error code [0 .. 254-1]" UWORD EH_STANDARD_S4_S3 1 100 0 65535 ECU_ADDRESS 0xFFF89F04 /end MEASUREMENT
/begin MEASUREMENT ydiFilter_xau16[187] "current filter value of error code [0 .. 254-1]" UWORD EH_STANDARD_S4_S3 1 100 0 65535 ECU_ADDRESS 0xFFF89F06 /end MEASUREMENT
/begin MEASUREMENT ydiFilter_xau16[188] "current filter value of error code [0 .. 254-1]" UWORD EH_STANDARD_S4_S3 1 100 0 65535 ECU_ADDRESS 0xFFF89F08 /end MEASUREMENT
/begin MEASUREMENT ydiFilter_xau16[189] "current filter value of error code [0 .. 254-1]" UWORD EH_STANDARD_S4_S3 1 100 0 65535 ECU_ADDRESS 0xFFF89F0A /end MEASUREMENT
/begin MEASUREMENT ydiFilter_xau16[18] "current filter value of error code [0 .. 254-1]" UWORD EH_STANDARD_S4_S3 1 100 0 65535 ECU_ADDRESS 0xFFF89DB4 /end MEASUREMENT
/begin MEASUREMENT ydiFilter_xau16[190] "current filter value of error code [0 .. 254-1]" UWORD EH_STANDARD_S4_S3 1 100 0 65535 ECU_ADDRESS 0xFFF89F0C /end MEASUREMENT
/begin MEASUREMENT ydiFilter_xau16[191] "current filter value of error code [0 .. 254-1]" UWORD EH_STANDARD_S4_S3 1 100 0 65535 ECU_ADDRESS 0xFFF89F0E /end MEASUREMENT
/begin MEASUREMENT ydiFilter_xau16[192] "current filter value of error code [0 .. 254-1]" UWORD EH_STANDARD_S4_S3 1 100 0 65535 ECU_ADDRESS 0xFFF89F10 /end MEASUREMENT
/begin MEASUREMENT ydiFilter_xau16[193] "current filter value of error code [0 .. 254-1]" UWORD EH_STANDARD_S4_S3 1 100 0 65535 ECU_ADDRESS 0xFFF89F12 /end MEASUREMENT
/begin MEASUREMENT ydiFilter_xau16[194] "current filter value of error code [0 .. 254-1]" UWORD EH_STANDARD_S4_S3 1 100 0 65535 ECU_ADDRESS 0xFFF89F14 /end MEASUREMENT
/begin MEASUREMENT ydiFilter_xau16[195] "current filter value of error code [0 .. 254-1]" UWORD EH_STANDARD_S4_S3 1 100 0 65535 ECU_ADDRESS 0xFFF89F16 /end MEASUREMENT
/begin MEASUREMENT ydiFilter_xau16[196] "current filter value of error code [0 .. 254-1]" UWORD EH_STANDARD_S4_S3 1 100 0 65535 ECU_ADDRESS 0xFFF89F18 /end MEASUREMENT
/begin MEASUREMENT ydiFilter_xau16[197] "current filter value of error code [0 .. 254-1]" UWORD EH_STANDARD_S4_S3 1 100 0 65535 ECU_ADDRESS 0xFFF89F1A /end MEASUREMENT
/begin MEASUREMENT ydiFilter_xau16[198] "current filter value of error code [0 .. 254-1]" UWORD EH_STANDARD_S4_S3 1 100 0 65535 ECU_ADDRESS 0xFFF89F1C /end MEASUREMENT
/begin MEASUREMENT ydiFilter_xau16[199] "current filter value of error code [0 .. 254-1]" UWORD EH_STANDARD_S4_S3 1 100 0 65535 ECU_ADDRESS 0xFFF89F1E /end MEASUREMENT
/begin MEASUREMENT ydiFilter_xau16[19] "current filter value of error code [0 .. 254-1]" UWORD EH_STANDARD_S4_S3 1 100 0 65535 ECU_ADDRESS 0xFFF89DB6 /end MEASUREMENT
/begin MEASUREMENT ydiFilter_xau16[1] "current filter value of error code [0 .. 254-1]" UWORD EH_STANDARD_S4_S3 1 100 0 65535 ECU_ADDRESS 0xFFF89D92 /end MEASUREMENT
/begin MEASUREMENT ydiFilter_xau16[200] "current filter value of error code [0 .. 254-1]" UWORD EH_STANDARD_S4_S3 1 100 0 65535 ECU_ADDRESS 0xFFF89F20 /end MEASUREMENT
/begin MEASUREMENT ydiFilter_xau16[201] "current filter value of error code [0 .. 254-1]" UWORD EH_STANDARD_S4_S3 1 100 0 65535 ECU_ADDRESS 0xFFF89F22 /end MEASUREMENT
/begin MEASUREMENT ydiFilter_xau16[202] "current filter value of error code [0 .. 254-1]" UWORD EH_STANDARD_S4_S3 1 100 0 65535 ECU_ADDRESS 0xFFF89F24 /end MEASUREMENT
/begin MEASUREMENT ydiFilter_xau16[203] "current filter value of error code [0 .. 254-1]" UWORD EH_STANDARD_S4_S3 1 100 0 65535 ECU_ADDRESS 0xFFF89F26 /end MEASUREMENT
/begin MEASUREMENT ydiFilter_xau16[204] "current filter value of error code [0 .. 254-1]" UWORD EH_STANDARD_S4_S3 1 100 0 65535 ECU_ADDRESS 0xFFF89F28 /end MEASUREMENT
/begin MEASUREMENT ydiFilter_xau16[205] "current filter value of error code [0 .. 254-1]" UWORD EH_STANDARD_S4_S3 1 100 0 65535 ECU_ADDRESS 0xFFF89F2A /end MEASUREMENT
/begin MEASUREMENT ydiFilter_xau16[206] "current filter value of error code [0 .. 254-1]" UWORD EH_STANDARD_S4_S3 1 100 0 65535 ECU_ADDRESS 0xFFF89F2C /end MEASUREMENT
/begin MEASUREMENT ydiFilter_xau16[207] "current filter value of error code [0 .. 254-1]" UWORD EH_STANDARD_S4_S3 1 100 0 65535 ECU_ADDRESS 0xFFF89F2E /end MEASUREMENT
/begin MEASUREMENT ydiFilter_xau16[208] "current filter value of error code [0 .. 254-1]" UWORD EH_STANDARD_S4_S3 1 100 0 65535 ECU_ADDRESS 0xFFF89F30 /end MEASUREMENT
/begin MEASUREMENT ydiFilter_xau16[209] "current filter value of error code [0 .. 254-1]" UWORD EH_STANDARD_S4_S3 1 100 0 65535 ECU_ADDRESS 0xFFF89F32 /end MEASUREMENT
/begin MEASUREMENT ydiFilter_xau16[20] "current filter value of error code [0 .. 254-1]" UWORD EH_STANDARD_S4_S3 1 100 0 65535 ECU_ADDRESS 0xFFF89DB8 /end MEASUREMENT
/begin MEASUREMENT ydiFilter_xau16[210] "current filter value of error code [0 .. 254-1]" UWORD EH_STANDARD_S4_S3 1 100 0 65535 ECU_ADDRESS 0xFFF89F34 /end MEASUREMENT
/begin MEASUREMENT ydiFilter_xau16[211] "current filter value of error code [0 .. 254-1]" UWORD EH_STANDARD_S4_S3 1 100 0 65535 ECU_ADDRESS 0xFFF89F36 /end MEASUREMENT
/begin MEASUREMENT ydiFilter_xau16[212] "current filter value of error code [0 .. 254-1]" UWORD EH_STANDARD_S4_S3 1 100 0 65535 ECU_ADDRESS 0xFFF89F38 /end MEASUREMENT
/begin MEASUREMENT ydiFilter_xau16[213] "current filter value of error code [0 .. 254-1]" UWORD EH_STANDARD_S4_S3 1 100 0 65535 ECU_ADDRESS 0xFFF89F3A /end MEASUREMENT
/begin MEASUREMENT ydiFilter_xau16[214] "current filter value of error code [0 .. 254-1]" UWORD EH_STANDARD_S4_S3 1 100 0 65535 ECU_ADDRESS 0xFFF89F3C /end MEASUREMENT
/begin MEASUREMENT ydiFilter_xau16[215] "current filter value of error code [0 .. 254-1]" UWORD EH_STANDARD_S4_S3 1 100 0 65535 ECU_ADDRESS 0xFFF89F3E /end MEASUREMENT
/begin MEASUREMENT ydiFilter_xau16[216] "current filter value of error code [0 .. 254-1]" UWORD EH_STANDARD_S4_S3 1 100 0 65535 ECU_ADDRESS 0xFFF89F40 /end MEASUREMENT
/begin MEASUREMENT ydiFilter_xau16[217] "current filter value of error code [0 .. 254-1]" UWORD EH_STANDARD_S4_S3 1 100 0 65535 ECU_ADDRESS 0xFFF89F42 /end MEASUREMENT
/begin MEASUREMENT ydiFilter_xau16[218] "current filter value of error code [0 .. 254-1]" UWORD EH_STANDARD_S4_S3 1 100 0 65535 ECU_ADDRESS 0xFFF89F44 /end MEASUREMENT
/begin MEASUREMENT ydiFilter_xau16[219] "current filter value of error code [0 .. 254-1]" UWORD EH_STANDARD_S4_S3 1 100 0 65535 ECU_ADDRESS 0xFFF89F46 /end MEASUREMENT
/begin MEASUREMENT ydiFilter_xau16[21] "current filter value of error code [0 .. 254-1]" UWORD EH_STANDARD_S4_S3 1 100 0 65535 ECU_ADDRESS 0xFFF89DBA /end MEASUREMENT
/begin MEASUREMENT ydiFilter_xau16[220] "current filter value of error code [0 .. 254-1]" UWORD EH_STANDARD_S4_S3 1 100 0 65535 ECU_ADDRESS 0xFFF89F48 /end MEASUREMENT
/begin MEASUREMENT ydiFilter_xau16[221] "current filter value of error code [0 .. 254-1]" UWORD EH_STANDARD_S4_S3 1 100 0 65535 ECU_ADDRESS 0xFFF89F4A /end MEASUREMENT
/begin MEASUREMENT ydiFilter_xau16[222] "current filter value of error code [0 .. 254-1]" UWORD EH_STANDARD_S4_S3 1 100 0 65535 ECU_ADDRESS 0xFFF89F4C /end MEASUREMENT
/begin MEASUREMENT ydiFilter_xau16[223] "current filter value of error code [0 .. 254-1]" UWORD EH_STANDARD_S4_S3 1 100 0 65535 ECU_ADDRESS 0xFFF89F4E /end MEASUREMENT
/begin MEASUREMENT ydiFilter_xau16[224] "current filter value of error code [0 .. 254-1]" UWORD EH_STANDARD_S4_S3 1 100 0 65535 ECU_ADDRESS 0xFFF89F50 /end MEASUREMENT
/begin MEASUREMENT ydiFilter_xau16[225] "current filter value of error code [0 .. 254-1]" UWORD EH_STANDARD_S4_S3 1 100 0 65535 ECU_ADDRESS 0xFFF89F52 /end MEASUREMENT
/begin MEASUREMENT ydiFilter_xau16[226] "current filter value of error code [0 .. 254-1]" UWORD EH_STANDARD_S4_S3 1 100 0 65535 ECU_ADDRESS 0xFFF89F54 /end MEASUREMENT
/begin MEASUREMENT ydiFilter_xau16[227] "current filter value of error code [0 .. 254-1]" UWORD EH_STANDARD_S4_S3 1 100 0 65535 ECU_ADDRESS 0xFFF89F56 /end MEASUREMENT
/begin MEASUREMENT ydiFilter_xau16[228] "current filter value of error code [0 .. 254-1]" UWORD EH_STANDARD_S4_S3 1 100 0 65535 ECU_ADDRESS 0xFFF89F58 /end MEASUREMENT
/begin MEASUREMENT ydiFilter_xau16[229] "current filter value of error code [0 .. 254-1]" UWORD EH_STANDARD_S4_S3 1 100 0 65535 ECU_ADDRESS 0xFFF89F5A /end MEASUREMENT
/begin MEASUREMENT ydiFilter_xau16[22] "current filter value of error code [0 .. 254-1]" UWORD EH_STANDARD_S4_S3 1 100 0 65535 ECU_ADDRESS 0xFFF89DBC /end MEASUREMENT
/begin MEASUREMENT ydiFilter_xau16[230] "current filter value of error code [0 .. 254-1]" UWORD EH_STANDARD_S4_S3 1 100 0 65535 ECU_ADDRESS 0xFFF89F5C /end MEASUREMENT
/begin MEASUREMENT ydiFilter_xau16[231] "current filter value of error code [0 .. 254-1]" UWORD EH_STANDARD_S4_S3 1 100 0 65535 ECU_ADDRESS 0xFFF89F5E /end MEASUREMENT
/begin MEASUREMENT ydiFilter_xau16[232] "current filter value of error code [0 .. 254-1]" UWORD EH_STANDARD_S4_S3 1 100 0 65535 ECU_ADDRESS 0xFFF89F60 /end MEASUREMENT
/begin MEASUREMENT ydiFilter_xau16[233] "current filter value of error code [0 .. 254-1]" UWORD EH_STANDARD_S4_S3 1 100 0 65535 ECU_ADDRESS 0xFFF89F62 /end MEASUREMENT
/begin MEASUREMENT ydiFilter_xau16[234] "current filter value of error code [0 .. 254-1]" UWORD EH_STANDARD_S4_S3 1 100 0 65535 ECU_ADDRESS 0xFFF89F64 /end MEASUREMENT
/begin MEASUREMENT ydiFilter_xau16[235] "current filter value of error code [0 .. 254-1]" UWORD EH_STANDARD_S4_S3 1 100 0 65535 ECU_ADDRESS 0xFFF89F66 /end MEASUREMENT
/begin MEASUREMENT ydiFilter_xau16[236] "current filter value of error code [0 .. 254-1]" UWORD EH_STANDARD_S4_S3 1 100 0 65535 ECU_ADDRESS 0xFFF89F68 /end MEASUREMENT
/begin MEASUREMENT ydiFilter_xau16[237] "current filter value of error code [0 .. 254-1]" UWORD EH_STANDARD_S4_S3 1 100 0 65535 ECU_ADDRESS 0xFFF89F6A /end MEASUREMENT
/begin MEASUREMENT ydiFilter_xau16[238] "current filter value of error code [0 .. 254-1]" UWORD EH_STANDARD_S4_S3 1 100 0 65535 ECU_ADDRESS 0xFFF89F6C /end MEASUREMENT
/begin MEASUREMENT ydiFilter_xau16[239] "current filter value of error code [0 .. 254-1]" UWORD EH_STANDARD_S4_S3 1 100 0 65535 ECU_ADDRESS 0xFFF89F6E /end MEASUREMENT
/begin MEASUREMENT ydiFilter_xau16[23] "current filter value of error code [0 .. 254-1]" UWORD EH_STANDARD_S4_S3 1 100 0 65535 ECU_ADDRESS 0xFFF89DBE /end MEASUREMENT
/begin MEASUREMENT ydiFilter_xau16[240] "current filter value of error code [0 .. 254-1]" UWORD EH_STANDARD_S4_S3 1 100 0 65535 ECU_ADDRESS 0xFFF89F70 /end MEASUREMENT
/begin MEASUREMENT ydiFilter_xau16[241] "current filter value of error code [0 .. 254-1]" UWORD EH_STANDARD_S4_S3 1 100 0 65535 ECU_ADDRESS 0xFFF89F72 /end MEASUREMENT
/begin MEASUREMENT ydiFilter_xau16[242] "current filter value of error code [0 .. 254-1]" UWORD EH_STANDARD_S4_S3 1 100 0 65535 ECU_ADDRESS 0xFFF89F74 /end MEASUREMENT
/begin MEASUREMENT ydiFilter_xau16[243] "current filter value of error code [0 .. 254-1]" UWORD EH_STANDARD_S4_S3 1 100 0 65535 ECU_ADDRESS 0xFFF89F76 /end MEASUREMENT
/begin MEASUREMENT ydiFilter_xau16[244] "current filter value of error code [0 .. 254-1]" UWORD EH_STANDARD_S4_S3 1 100 0 65535 ECU_ADDRESS 0xFFF89F78 /end MEASUREMENT
/begin MEASUREMENT ydiFilter_xau16[245] "current filter value of error code [0 .. 254-1]" UWORD EH_STANDARD_S4_S3 1 100 0 65535 ECU_ADDRESS 0xFFF89F7A /end MEASUREMENT
/begin MEASUREMENT ydiFilter_xau16[246] "current filter value of error code [0 .. 254-1]" UWORD EH_STANDARD_S4_S3 1 100 0 65535 ECU_ADDRESS 0xFFF89F7C /end MEASUREMENT
/begin MEASUREMENT ydiFilter_xau16[247] "current filter value of error code [0 .. 254-1]" UWORD EH_STANDARD_S4_S3 1 100 0 65535 ECU_ADDRESS 0xFFF89F7E /end MEASUREMENT
/begin MEASUREMENT ydiFilter_xau16[248] "current filter value of error code [0 .. 254-1]" UWORD EH_STANDARD_S4_S3 1 100 0 65535 ECU_ADDRESS 0xFFF89F80 /end MEASUREMENT
/begin MEASUREMENT ydiFilter_xau16[249] "current filter value of error code [0 .. 254-1]" UWORD EH_STANDARD_S4_S3 1 100 0 65535 ECU_ADDRESS 0xFFF89F82 /end MEASUREMENT
/begin MEASUREMENT ydiFilter_xau16[24] "current filter value of error code [0 .. 254-1]" UWORD EH_STANDARD_S4_S3 1 100 0 65535 ECU_ADDRESS 0xFFF89DC0 /end MEASUREMENT
/begin MEASUREMENT ydiFilter_xau16[250] "current filter value of error code [0 .. 254-1]" UWORD EH_STANDARD_S4_S3 1 100 0 65535 ECU_ADDRESS 0xFFF89F84 /end MEASUREMENT
/begin MEASUREMENT ydiFilter_xau16[251] "current filter value of error code [0 .. 254-1]" UWORD EH_STANDARD_S4_S3 1 100 0 65535 ECU_ADDRESS 0xFFF89F86 /end MEASUREMENT
/begin MEASUREMENT ydiFilter_xau16[252] "current filter value of error code [0 .. 254-1]" UWORD EH_STANDARD_S4_S3 1 100 0 65535 ECU_ADDRESS 0xFFF89F88 /end MEASUREMENT
/begin MEASUREMENT ydiFilter_xau16[253] "current filter value of error code [0 .. 254-1]" UWORD EH_STANDARD_S4_S3 1 100 0 65535 ECU_ADDRESS 0xFFF89F8A /end MEASUREMENT
/begin MEASUREMENT ydiFilter_xau16[25] "current filter value of error code [0 .. 254-1]" UWORD EH_STANDARD_S4_S3 1 100 0 65535 ECU_ADDRESS 0xFFF89DC2 /end MEASUREMENT
/begin MEASUREMENT ydiFilter_xau16[26] "current filter value of error code [0 .. 254-1]" UWORD EH_STANDARD_S4_S3 1 100 0 65535 ECU_ADDRESS 0xFFF89DC4 /end MEASUREMENT
/begin MEASUREMENT ydiFilter_xau16[27] "current filter value of error code [0 .. 254-1]" UWORD EH_STANDARD_S4_S3 1 100 0 65535 ECU_ADDRESS 0xFFF89DC6 /end MEASUREMENT
/begin MEASUREMENT ydiFilter_xau16[28] "current filter value of error code [0 .. 254-1]" UWORD EH_STANDARD_S4_S3 1 100 0 65535 ECU_ADDRESS 0xFFF89DC8 /end MEASUREMENT
/begin MEASUREMENT ydiFilter_xau16[29] "current filter value of error code [0 .. 254-1]" UWORD EH_STANDARD_S4_S3 1 100 0 65535 ECU_ADDRESS 0xFFF89DCA /end MEASUREMENT
/begin MEASUREMENT ydiFilter_xau16[2] "current filter value of error code [0 .. 254-1]" UWORD EH_STANDARD_S4_S3 1 100 0 65535 ECU_ADDRESS 0xFFF89D94 /end MEASUREMENT
/begin MEASUREMENT ydiFilter_xau16[30] "current filter value of error code [0 .. 254-1]" UWORD EH_STANDARD_S4_S3 1 100 0 65535 ECU_ADDRESS 0xFFF89DCC /end MEASUREMENT
/begin MEASUREMENT ydiFilter_xau16[31] "current filter value of error code [0 .. 254-1]" UWORD EH_STANDARD_S4_S3 1 100 0 65535 ECU_ADDRESS 0xFFF89DCE /end MEASUREMENT
/begin MEASUREMENT ydiFilter_xau16[32] "current filter value of error code [0 .. 254-1]" UWORD EH_STANDARD_S4_S3 1 100 0 65535 ECU_ADDRESS 0xFFF89DD0 /end MEASUREMENT
/begin MEASUREMENT ydiFilter_xau16[33] "current filter value of error code [0 .. 254-1]" UWORD EH_STANDARD_S4_S3 1 100 0 65535 ECU_ADDRESS 0xFFF89DD2 /end MEASUREMENT
/begin MEASUREMENT ydiFilter_xau16[34] "current filter value of error code [0 .. 254-1]" UWORD EH_STANDARD_S4_S3 1 100 0 65535 ECU_ADDRESS 0xFFF89DD4 /end MEASUREMENT
/begin MEASUREMENT ydiFilter_xau16[35] "current filter value of error code [0 .. 254-1]" UWORD EH_STANDARD_S4_S3 1 100 0 65535 ECU_ADDRESS 0xFFF89DD6 /end MEASUREMENT
/begin MEASUREMENT ydiFilter_xau16[36] "current filter value of error code [0 .. 254-1]" UWORD EH_STANDARD_S4_S3 1 100 0 65535 ECU_ADDRESS 0xFFF89DD8 /end MEASUREMENT
/begin MEASUREMENT ydiFilter_xau16[37] "current filter value of error code [0 .. 254-1]" UWORD EH_STANDARD_S4_S3 1 100 0 65535 ECU_ADDRESS 0xFFF89DDA /end MEASUREMENT
/begin MEASUREMENT ydiFilter_xau16[38] "current filter value of error code [0 .. 254-1]" UWORD EH_STANDARD_S4_S3 1 100 0 65535 ECU_ADDRESS 0xFFF89DDC /end MEASUREMENT
/begin MEASUREMENT ydiFilter_xau16[39] "current filter value of error code [0 .. 254-1]" UWORD EH_STANDARD_S4_S3 1 100 0 65535 ECU_ADDRESS 0xFFF89DDE /end MEASUREMENT
/begin MEASUREMENT ydiFilter_xau16[3] "current filter value of error code [0 .. 254-1]" UWORD EH_STANDARD_S4_S3 1 100 0 65535 ECU_ADDRESS 0xFFF89D96 /end MEASUREMENT
/begin MEASUREMENT ydiFilter_xau16[40] "current filter value of error code [0 .. 254-1]" UWORD EH_STANDARD_S4_S3 1 100 0 65535 ECU_ADDRESS 0xFFF89DE0 /end MEASUREMENT
/begin MEASUREMENT ydiFilter_xau16[41] "current filter value of error code [0 .. 254-1]" UWORD EH_STANDARD_S4_S3 1 100 0 65535 ECU_ADDRESS 0xFFF89DE2 /end MEASUREMENT
/begin MEASUREMENT ydiFilter_xau16[42] "current filter value of error code [0 .. 254-1]" UWORD EH_STANDARD_S4_S3 1 100 0 65535 ECU_ADDRESS 0xFFF89DE4 /end MEASUREMENT
/begin MEASUREMENT ydiFilter_xau16[43] "current filter value of error code [0 .. 254-1]" UWORD EH_STANDARD_S4_S3 1 100 0 65535 ECU_ADDRESS 0xFFF89DE6 /end MEASUREMENT
/begin MEASUREMENT ydiFilter_xau16[44] "current filter value of error code [0 .. 254-1]" UWORD EH_STANDARD_S4_S3 1 100 0 65535 ECU_ADDRESS 0xFFF89DE8 /end MEASUREMENT
/begin MEASUREMENT ydiFilter_xau16[45] "current filter value of error code [0 .. 254-1]" UWORD EH_STANDARD_S4_S3 1 100 0 65535 ECU_ADDRESS 0xFFF89DEA /end MEASUREMENT
/begin MEASUREMENT ydiFilter_xau16[46] "current filter value of error code [0 .. 254-1]" UWORD EH_STANDARD_S4_S3 1 100 0 65535 ECU_ADDRESS 0xFFF89DEC /end MEASUREMENT
/begin MEASUREMENT ydiFilter_xau16[47] "current filter value of error code [0 .. 254-1]" UWORD EH_STANDARD_S4_S3 1 100 0 65535 ECU_ADDRESS 0xFFF89DEE /end MEASUREMENT
/begin MEASUREMENT ydiFilter_xau16[48] "current filter value of error code [0 .. 254-1]" UWORD EH_STANDARD_S4_S3 1 100 0 65535 ECU_ADDRESS 0xFFF89DF0 /end MEASUREMENT
/begin MEASUREMENT ydiFilter_xau16[49] "current filter value of error code [0 .. 254-1]" UWORD EH_STANDARD_S4_S3 1 100 0 65535 ECU_ADDRESS 0xFFF89DF2 /end MEASUREMENT
/begin MEASUREMENT ydiFilter_xau16[4] "current filter value of error code [0 .. 254-1]" UWORD EH_STANDARD_S4_S3 1 100 0 65535 ECU_ADDRESS 0xFFF89D98 /end MEASUREMENT
/begin MEASUREMENT ydiFilter_xau16[50] "current filter value of error code [0 .. 254-1]" UWORD EH_STANDARD_S4_S3 1 100 0 65535 ECU_ADDRESS 0xFFF89DF4 /end MEASUREMENT
/begin MEASUREMENT ydiFilter_xau16[51] "current filter value of error code [0 .. 254-1]" UWORD EH_STANDARD_S4_S3 1 100 0 65535 ECU_ADDRESS 0xFFF89DF6 /end MEASUREMENT
/begin MEASUREMENT ydiFilter_xau16[52] "current filter value of error code [0 .. 254-1]" UWORD EH_STANDARD_S4_S3 1 100 0 65535 ECU_ADDRESS 0xFFF89DF8 /end MEASUREMENT
/begin MEASUREMENT ydiFilter_xau16[53] "current filter value of error code [0 .. 254-1]" UWORD EH_STANDARD_S4_S3 1 100 0 65535 ECU_ADDRESS 0xFFF89DFA /end MEASUREMENT
/begin MEASUREMENT ydiFilter_xau16[54] "current filter value of error code [0 .. 254-1]" UWORD EH_STANDARD_S4_S3 1 100 0 65535 ECU_ADDRESS 0xFFF89DFC /end MEASUREMENT
/begin MEASUREMENT ydiFilter_xau16[55] "current filter value of error code [0 .. 254-1]" UWORD EH_STANDARD_S4_S3 1 100 0 65535 ECU_ADDRESS 0xFFF89DFE /end MEASUREMENT
/begin MEASUREMENT ydiFilter_xau16[56] "current filter value of error code [0 .. 254-1]" UWORD EH_STANDARD_S4_S3 1 100 0 65535 ECU_ADDRESS 0xFFF89E00 /end MEASUREMENT
/begin MEASUREMENT ydiFilter_xau16[57] "current filter value of error code [0 .. 254-1]" UWORD EH_STANDARD_S4_S3 1 100 0 65535 ECU_ADDRESS 0xFFF89E02 /end MEASUREMENT
/begin MEASUREMENT ydiFilter_xau16[58] "current filter value of error code [0 .. 254-1]" UWORD EH_STANDARD_S4_S3 1 100 0 65535 ECU_ADDRESS 0xFFF89E04 /end MEASUREMENT
/begin MEASUREMENT ydiFilter_xau16[59] "current filter value of error code [0 .. 254-1]" UWORD EH_STANDARD_S4_S3 1 100 0 65535 ECU_ADDRESS 0xFFF89E06 /end MEASUREMENT
/begin MEASUREMENT ydiFilter_xau16[5] "current filter value of error code [0 .. 254-1]" UWORD EH_STANDARD_S4_S3 1 100 0 65535 ECU_ADDRESS 0xFFF89D9A /end MEASUREMENT
/begin MEASUREMENT ydiFilter_xau16[60] "current filter value of error code [0 .. 254-1]" UWORD EH_STANDARD_S4_S3 1 100 0 65535 ECU_ADDRESS 0xFFF89E08 /end MEASUREMENT
/begin MEASUREMENT ydiFilter_xau16[61] "current filter value of error code [0 .. 254-1]" UWORD EH_STANDARD_S4_S3 1 100 0 65535 ECU_ADDRESS 0xFFF89E0A /end MEASUREMENT
/begin MEASUREMENT ydiFilter_xau16[62] "current filter value of error code [0 .. 254-1]" UWORD EH_STANDARD_S4_S3 1 100 0 65535 ECU_ADDRESS 0xFFF89E0C /end MEASUREMENT
/begin MEASUREMENT ydiFilter_xau16[63] "current filter value of error code [0 .. 254-1]" UWORD EH_STANDARD_S4_S3 1 100 0 65535 ECU_ADDRESS 0xFFF89E0E /end MEASUREMENT
/begin MEASUREMENT ydiFilter_xau16[64] "current filter value of error code [0 .. 254-1]" UWORD EH_STANDARD_S4_S3 1 100 0 65535 ECU_ADDRESS 0xFFF89E10 /end MEASUREMENT
/begin MEASUREMENT ydiFilter_xau16[65] "current filter value of error code [0 .. 254-1]" UWORD EH_STANDARD_S4_S3 1 100 0 65535 ECU_ADDRESS 0xFFF89E12 /end MEASUREMENT
/begin MEASUREMENT ydiFilter_xau16[66] "current filter value of error code [0 .. 254-1]" UWORD EH_STANDARD_S4_S3 1 100 0 65535 ECU_ADDRESS 0xFFF89E14 /end MEASUREMENT
/begin MEASUREMENT ydiFilter_xau16[67] "current filter value of error code [0 .. 254-1]" UWORD EH_STANDARD_S4_S3 1 100 0 65535 ECU_ADDRESS 0xFFF89E16 /end MEASUREMENT
/begin MEASUREMENT ydiFilter_xau16[68] "current filter value of error code [0 .. 254-1]" UWORD EH_STANDARD_S4_S3 1 100 0 65535 ECU_ADDRESS 0xFFF89E18 /end MEASUREMENT
/begin MEASUREMENT ydiFilter_xau16[69] "current filter value of error code [0 .. 254-1]" UWORD EH_STANDARD_S4_S3 1 100 0 65535 ECU_ADDRESS 0xFFF89E1A /end MEASUREMENT
/begin MEASUREMENT ydiFilter_xau16[6] "current filter value of error code [0 .. 254-1]" UWORD EH_STANDARD_S4_S3 1 100 0 65535 ECU_ADDRESS 0xFFF89D9C /end MEASUREMENT
/begin MEASUREMENT ydiFilter_xau16[70] "current filter value of error code [0 .. 254-1]" UWORD EH_STANDARD_S4_S3 1 100 0 65535 ECU_ADDRESS 0xFFF89E1C /end MEASUREMENT
/begin MEASUREMENT ydiFilter_xau16[71] "current filter value of error code [0 .. 254-1]" UWORD EH_STANDARD_S4_S3 1 100 0 65535 ECU_ADDRESS 0xFFF89E1E /end MEASUREMENT
/begin MEASUREMENT ydiFilter_xau16[72] "current filter value of error code [0 .. 254-1]" UWORD EH_STANDARD_S4_S3 1 100 0 65535 ECU_ADDRESS 0xFFF89E20 /end MEASUREMENT
/begin MEASUREMENT ydiFilter_xau16[73] "current filter value of error code [0 .. 254-1]" UWORD EH_STANDARD_S4_S3 1 100 0 65535 ECU_ADDRESS 0xFFF89E22 /end MEASUREMENT
/begin MEASUREMENT ydiFilter_xau16[74] "current filter value of error code [0 .. 254-1]" UWORD EH_STANDARD_S4_S3 1 100 0 65535 ECU_ADDRESS 0xFFF89E24 /end MEASUREMENT
/begin MEASUREMENT ydiFilter_xau16[75] "current filter value of error code [0 .. 254-1]" UWORD EH_STANDARD_S4_S3 1 100 0 65535 ECU_ADDRESS 0xFFF89E26 /end MEASUREMENT
/begin MEASUREMENT ydiFilter_xau16[76] "current filter value of error code [0 .. 254-1]" UWORD EH_STANDARD_S4_S3 1 100 0 65535 ECU_ADDRESS 0xFFF89E28 /end MEASUREMENT
/begin MEASUREMENT ydiFilter_xau16[77] "current filter value of error code [0 .. 254-1]" UWORD EH_STANDARD_S4_S3 1 100 0 65535 ECU_ADDRESS 0xFFF89E2A /end MEASUREMENT
/begin MEASUREMENT ydiFilter_xau16[78] "current filter value of error code [0 .. 254-1]" UWORD EH_STANDARD_S4_S3 1 100 0 65535 ECU_ADDRESS 0xFFF89E2C /end MEASUREMENT
/begin MEASUREMENT ydiFilter_xau16[79] "current filter value of error code [0 .. 254-1]" UWORD EH_STANDARD_S4_S3 1 100 0 65535 ECU_ADDRESS 0xFFF89E2E /end MEASUREMENT
/begin MEASUREMENT ydiFilter_xau16[7] "current filter value of error code [0 .. 254-1]" UWORD EH_STANDARD_S4_S3 1 100 0 65535 ECU_ADDRESS 0xFFF89D9E /end MEASUREMENT
/begin MEASUREMENT ydiFilter_xau16[80] "current filter value of error code [0 .. 254-1]" UWORD EH_STANDARD_S4_S3 1 100 0 65535 ECU_ADDRESS 0xFFF89E30 /end MEASUREMENT
/begin MEASUREMENT ydiFilter_xau16[81] "current filter value of error code [0 .. 254-1]" UWORD EH_STANDARD_S4_S3 1 100 0 65535 ECU_ADDRESS 0xFFF89E32 /end MEASUREMENT
/begin MEASUREMENT ydiFilter_xau16[82] "current filter value of error code [0 .. 254-1]" UWORD EH_STANDARD_S4_S3 1 100 0 65535 ECU_ADDRESS 0xFFF89E34 /end MEASUREMENT
/begin MEASUREMENT ydiFilter_xau16[83] "current filter value of error code [0 .. 254-1]" UWORD EH_STANDARD_S4_S3 1 100 0 65535 ECU_ADDRESS 0xFFF89E36 /end MEASUREMENT
/begin MEASUREMENT ydiFilter_xau16[84] "current filter value of error code [0 .. 254-1]" UWORD EH_STANDARD_S4_S3 1 100 0 65535 ECU_ADDRESS 0xFFF89E38 /end MEASUREMENT
/begin MEASUREMENT ydiFilter_xau16[85] "current filter value of error code [0 .. 254-1]" UWORD EH_STANDARD_S4_S3 1 100 0 65535 ECU_ADDRESS 0xFFF89E3A /end MEASUREMENT
/begin MEASUREMENT ydiFilter_xau16[86] "current filter value of error code [0 .. 254-1]" UWORD EH_STANDARD_S4_S3 1 100 0 65535 ECU_ADDRESS 0xFFF89E3C /end MEASUREMENT
/begin MEASUREMENT ydiFilter_xau16[87] "current filter value of error code [0 .. 254-1]" UWORD EH_STANDARD_S4_S3 1 100 0 65535 ECU_ADDRESS 0xFFF89E3E /end MEASUREMENT
/begin MEASUREMENT ydiFilter_xau16[88] "current filter value of error code [0 .. 254-1]" UWORD EH_STANDARD_S4_S3 1 100 0 65535 ECU_ADDRESS 0xFFF89E40 /end MEASUREMENT
/begin MEASUREMENT ydiFilter_xau16[89] "current filter value of error code [0 .. 254-1]" UWORD EH_STANDARD_S4_S3 1 100 0 65535 ECU_ADDRESS 0xFFF89E42 /end MEASUREMENT
/begin MEASUREMENT ydiFilter_xau16[8] "current filter value of error code [0 .. 254-1]" UWORD EH_STANDARD_S4_S3 1 100 0 65535 ECU_ADDRESS 0xFFF89DA0 /end MEASUREMENT
/begin MEASUREMENT ydiFilter_xau16[90] "current filter value of error code [0 .. 254-1]" UWORD EH_STANDARD_S4_S3 1 100 0 65535 ECU_ADDRESS 0xFFF89E44 /end MEASUREMENT
/begin MEASUREMENT ydiFilter_xau16[91] "current filter value of error code [0 .. 254-1]" UWORD EH_STANDARD_S4_S3 1 100 0 65535 ECU_ADDRESS 0xFFF89E46 /end MEASUREMENT
/begin MEASUREMENT ydiFilter_xau16[92] "current filter value of error code [0 .. 254-1]" UWORD EH_STANDARD_S4_S3 1 100 0 65535 ECU_ADDRESS 0xFFF89E48 /end MEASUREMENT
/begin MEASUREMENT ydiFilter_xau16[93] "current filter value of error code [0 .. 254-1]" UWORD EH_STANDARD_S4_S3 1 100 0 65535 ECU_ADDRESS 0xFFF89E4A /end MEASUREMENT
/begin MEASUREMENT ydiFilter_xau16[94] "current filter value of error code [0 .. 254-1]" UWORD EH_STANDARD_S4_S3 1 100 0 65535 ECU_ADDRESS 0xFFF89E4C /end MEASUREMENT
/begin MEASUREMENT ydiFilter_xau16[95] "current filter value of error code [0 .. 254-1]" UWORD EH_STANDARD_S4_S3 1 100 0 65535 ECU_ADDRESS 0xFFF89E4E /end MEASUREMENT
/begin MEASUREMENT ydiFilter_xau16[96] "current filter value of error code [0 .. 254-1]" UWORD EH_STANDARD_S4_S3 1 100 0 65535 ECU_ADDRESS 0xFFF89E50 /end MEASUREMENT
/begin MEASUREMENT ydiFilter_xau16[97] "current filter value of error code [0 .. 254-1]" UWORD EH_STANDARD_S4_S3 1 100 0 65535 ECU_ADDRESS 0xFFF89E52 /end MEASUREMENT
/begin MEASUREMENT ydiFilter_xau16[98] "current filter value of error code [0 .. 254-1]" UWORD EH_STANDARD_S4_S3 1 100 0 65535 ECU_ADDRESS 0xFFF89E54 /end MEASUREMENT
/begin MEASUREMENT ydiFilter_xau16[99] "current filter value of error code [0 .. 254-1]" UWORD EH_STANDARD_S4_S3 1 100 0 65535 ECU_ADDRESS 0xFFF89E56 /end MEASUREMENT
/begin MEASUREMENT ydiFilter_xau16[9] "current filter value of error code [0 .. 254-1]" UWORD EH_STANDARD_S4_S3 1 100 0 65535 ECU_ADDRESS 0xFFF89DA2 /end MEASUREMENT
/begin MEASUREMENT z_n_mot_llsoll_iae "Ausgabe min. EM-Drehzahl" UBYTE UMR___1_1_0_S5_S3 1 100 0 2 ECU_ADDRESS 0xFFF893CE /end MEASUREMENT
/begin MEASUREMENT zff_atsys._.iSignale._.obj.sig_c_getr "Die Getriebetemperatur" UBYTE UMR_GRADC__1_1_M40_S5_S3 1 100 -40 215 ECU_ADDRESS 0xFFF8AEA7 DISPLAY_IDENTIFIER sig_c_getr.obj._.iSignale._.zff_atsys /end MEASUREMENT
/begin MEASUREMENT zff_atsys._.iSignale._.obj.sig_c_getr_fl32 "Die Getriebetemperatur (Float)" FLOAT32_IEEE UMR_GRADC__1_1_0_S5_S3 1 100 -40 215 ECU_ADDRESS 0xFFF8AEA8 DISPLAY_IDENTIFIER sig_c_getr_fl32.obj._.iSignale._.zff_atsys /end MEASUREMENT
/begin MEASUREMENT zff_atsys._.iSignale._.obj.sig_c_mot "Die Motortemperatur" UBYTE UMR_GRADC__1_1_M48_S5_S3 1 100 -48 207 ECU_ADDRESS 0xFFF8AEAC DISPLAY_IDENTIFIER sig_c_mot.obj._.iSignale._.zff_atsys /end MEASUREMENT
/begin MEASUREMENT zff_atsys._.iSignale._.obj.sig_dki "Die Drosselklappenstellung" UBYTE UMR_PROZENT__20_51_0_S5_S3 1 100 0 100 ECU_ADDRESS 0xFFF8AEB8 DISPLAY_IDENTIFIER sig_dki.obj._.iSignale._.zff_atsys /end MEASUREMENT
/begin MEASUREMENT zff_atsys._.iSignale._.obj.sig_dki_fl32 "Die Drosselklappenstellung (Float)" FLOAT32_IEEE UMR_PROZENT__1_1_0_S5_S3 1 100 0 100 ECU_ADDRESS 0xFFF8AEBC DISPLAY_IDENTIFIER sig_dki_fl32.obj._.iSignale._.zff_atsys /end MEASUREMENT
/begin MEASUREMENT zff_atsys._.iSignale._.obj.sig_dki_mmotsoll "dki oder mmotsoll_mod je nach SWI_UMSCHALTDKI" SWORD UMR___1_1_0_S5_S3 1 100 -400 1640 ECU_ADDRESS 0xFFF8AEB2 DISPLAY_IDENTIFIER sig_dki_mmotsoll.obj._.iSignale._.zff_atsys /end MEASUREMENT
/begin MEASUREMENT zff_atsys._.iSignale._.obj.sig_dki_mmotsoll_fl32 "dki oder mmotsoll_mod je nach SWI_UMSCHALTDKI" FLOAT32_IEEE UMR___1_1_0_S5_S3 1 100 -400 1640 ECU_ADDRESS 0xFFF8AEB4 FORMAT "%3.2" DISPLAY_IDENTIFIER sig_dki_mmotsoll_fl32.obj._.iSignale._.zff_atsys /end MEASUREMENT
/begin MEASUREMENT zff_atsys._.iSignale._.obj.sig_e_fahren "Umschaltung Verbrennungs/E-Fahren Datensätze" UBYTE Conv.zff_atsys._.cSignale._.sig_e_fahren_S5_S3 1 100 0 1 ECU_ADDRESS 0xFFF8AE9A DISPLAY_IDENTIFIER sig_e_fahren.obj._.iSignale._.zff_atsys /end MEASUREMENT
/begin MEASUREMENT zff_atsys._.iSignale._.obj.sig_index_sp_sps "Der Spontanitätsindex" UBYTE UMR___1_1_0_S5_S3 1 100 0 99 ECU_ADDRESS 0xFFF8AEC0 DISPLAY_IDENTIFIER sig_index_sp_sps.obj._.iSignale._.zff_atsys /end MEASUREMENT
/begin MEASUREMENT zff_atsys._.iSignale._.obj.sig_istgang "Der Istgang" SBYTE Conv.zff_atsys._.cSignale._.sig_istgang_S5_S3 1 100 -1 8 ECU_ADDRESS 0xFFF8AEC1 DISPLAY_IDENTIFIER sig_istgang.obj._.iSignale._.zff_atsys /end MEASUREMENT
/begin MEASUREMENT zff_atsys._.iSignale._.obj.sig_istgang_idx "Der Istgang als Index für Tabellen (mit offset)" UBYTE Conv.zff_atsys._.cSignale._.sig_istgang_idx_S5_S3 1 100 0 9 ECU_ADDRESS 0xFFF8AEC2 DISPLAY_IDENTIFIER sig_istgang_idx.obj._.iSignale._.zff_atsys /end MEASUREMENT
/begin MEASUREMENT zff_atsys._.iSignale._.obj.sig_istgang_vorw "Der Istagang (nur positive Werte ansonsten 0)" UBYTE Conv.zff_atsys._.cSignale._.sig_istgang_vorw_S5_S3 1 100 0 8 ECU_ADDRESS 0xFFF8AEC3 DISPLAY_IDENTIFIER sig_istgang_vorw.obj._.iSignale._.zff_atsys /end MEASUREMENT
/begin MEASUREMENT zff_atsys._.iSignale._.obj.sig_kfl_ist "Kraftfluss-Ist" UBYTE Conv.zff_atsys._.cSignale._.sig_kfl_ist_S5_S3 1 100 0 2 ECU_ADDRESS 0xFFF8AECB DISPLAY_IDENTIFIER sig_kfl_ist.obj._.iSignale._.zff_atsys /end MEASUREMENT
/begin MEASUREMENT zff_atsys._.iSignale._.obj.sig_kfl_ziel "Kraftfluss-Ziel" UBYTE Conv.zff_atsys._.cSignale._.sig_kfl_ziel_S5_S3 1 100 0 2 ECU_ADDRESS 0xFFF8AECC DISPLAY_IDENTIFIER sig_kfl_ziel.obj._.iSignale._.zff_atsys /end MEASUREMENT
/begin MEASUREMENT zff_atsys._.iSignale._.obj.sig_m_t "Das Motormoment" SWORD UMR_NM__1_1_0_S5_S3 1 100 -200 1300 ECU_ADDRESS 0xFFF8AEAE DISPLAY_IDENTIFIER sig_m_t.obj._.iSignale._.zff_atsys /end MEASUREMENT
/begin MEASUREMENT zff_atsys._.iSignale._.obj.sig_m_t8 "Das Motormoment" UBYTE UMR_NM__6_1_M34_S5_S3 1 100 -204 1326 ECU_ADDRESS 0xFFF8AEB0 DISPLAY_IDENTIFIER sig_m_t8.obj._.iSignale._.zff_atsys /end MEASUREMENT
/begin MEASUREMENT zff_atsys._.iSignale._.obj.sig_n_ab "Die Abtriebsdrehzahl" UWORD UMR_U_MIN_1_1_0_S5_S3 1 100 0 8160 ECU_ADDRESS 0xFFF8AE9C DISPLAY_IDENTIFIER sig_n_ab.obj._.iSignale._.zff_atsys /end MEASUREMENT
/begin MEASUREMENT zff_atsys._.iSignale._.obj.sig_n_ab8 "Die Abtriebsdrehzahl (8Bit)" UBYTE UMR_U_MIN_32_1_0_S5_S3 1 100 0 8160 ECU_ADDRESS 0xFFF8AE9E DISPLAY_IDENTIFIER sig_n_ab8.obj._.iSignale._.zff_atsys /end MEASUREMENT
/begin MEASUREMENT zff_atsys._.iSignale._.obj.sig_n_mot "Die Motordrehzahl" UWORD UMR_U_MIN_1_1_0_S5_S3 1 100 0 8160 ECU_ADDRESS 0xFFF8AEA4 DISPLAY_IDENTIFIER sig_n_mot.obj._.iSignale._.zff_atsys /end MEASUREMENT
/begin MEASUREMENT zff_atsys._.iSignale._.obj.sig_n_mot8 "Die Motordrehzahl (8Bit)" UBYTE UMR_U_MIN_32_1_0_S5_S3 1 100 0 8160 ECU_ADDRESS 0xFFF8AEA6 DISPLAY_IDENTIFIER sig_n_mot8.obj._.iSignale._.zff_atsys /end MEASUREMENT
/begin MEASUREMENT zff_atsys._.iSignale._.obj.sig_n_t "Die Turbinendrehzahl" UWORD UMR_U_MIN_1_1_0_S5_S3 1 100 0 8160 ECU_ADDRESS 0xFFF8AEA0 DISPLAY_IDENTIFIER sig_n_t.obj._.iSignale._.zff_atsys /end MEASUREMENT
/begin MEASUREMENT zff_atsys._.iSignale._.obj.sig_n_t8 "Die Turbinendrehzahl (8Bit)" UBYTE UMR_U_MIN_32_1_0_S5_S3 1 100 0 8160 ECU_ADDRESS 0xFFF8AEA2 DISPLAY_IDENTIFIER sig_n_t8.obj._.iSignale._.zff_atsys /end MEASUREMENT
/begin MEASUREMENT zff_atsys._.iSignale._.obj.sig_neigung_iae "Neigung in Grad Steigung" SWORD UMR_GRAD__1_3_M128_S5_S3 1 100 -42.6666666667 42 ECU_ADDRESS 0xFFF8AECE DISPLAY_IDENTIFIER sig_neigung_iae.obj._.iSignale._.zff_atsys /end MEASUREMENT
/begin MEASUREMENT zff_atsys._.iSignale._.obj.sig_serapflag "Das Serapflag" UBYTE Conv.zff_atsys._.cSignale._.sig_serapflag_S5_S3 1 100 0 1 BIT_MASK 0x1 ECU_ADDRESS 0xFFF8AE98 DISPLAY_IDENTIFIER sig_serapflag.obj._.iSignale._.zff_atsys /end MEASUREMENT
/begin MEASUREMENT zff_atsys._.iSignale._.obj.sig_serapflag_komp "Das Serapflag" UBYTE Conv.zff_atsys._.cSignale._.sig_serapflag_komp_S5_S3 1 100 254 255 ECU_ADDRESS 0xFFF8AE99 DISPLAY_IDENTIFIER sig_serapflag_komp.obj._.iSignale._.zff_atsys /end MEASUREMENT
/begin MEASUREMENT zff_atsys._.iSignale._.obj.sig_zielgang "Der Zielgang" SBYTE Conv.zff_atsys._.cSignale._.sig_zielgang_S5_S3 1 100 -1 8 ECU_ADDRESS 0xFFF8AEC4 DISPLAY_IDENTIFIER sig_zielgang.obj._.iSignale._.zff_atsys /end MEASUREMENT
/begin MEASUREMENT zff_atsys._.iSignale._.obj.sig_zielgang_idx "Der Zielgang als Index für Tabellen (mit offset)" UBYTE Conv.zff_atsys._.cSignale._.sig_zielgang_idx_S5_S3 1 100 0 9 ECU_ADDRESS 0xFFF8AEC5 DISPLAY_IDENTIFIER sig_zielgang_idx.obj._.iSignale._.zff_atsys /end MEASUREMENT
/begin MEASUREMENT zff_atsys._.iSignale._.obj.sig_zielgang_sas "Der Zielgang_sas" SBYTE Conv.zff_atsys._.cSignale._.sig_zielgang_sas_S5_S3 1 100 -1 8 ECU_ADDRESS 0xFFF8AEC7 DISPLAY_IDENTIFIER sig_zielgang_sas.obj._.iSignale._.zff_atsys /end MEASUREMENT
/begin MEASUREMENT zff_atsys._.iSignale._.obj.sig_zielgang_sas_idx "Der Zielgang_sas als Index für Tabellen (mit offset)" UBYTE Conv.zff_atsys._.cSignale._.sig_zielgang_sas_idx_S5_S3 1 100 0 9 ECU_ADDRESS 0xFFF8AEC8 DISPLAY_IDENTIFIER sig_zielgang_sas_idx.obj._.iSignale._.zff_atsys /end MEASUREMENT
/begin MEASUREMENT zff_atsys._.iSignale._.obj.sig_zielgang_sas_komp "Zielgang_sas_komp bitinvertiertes Signal zu zielgang_sas Signal" SBYTE Conv.zff_atsys._.cSignale._.sig_zielgang_sas_komp_S5_S3 1 100 -9 0 ECU_ADDRESS 0xFFF8AECA DISPLAY_IDENTIFIER sig_zielgang_sas_komp.obj._.iSignale._.zff_atsys /end MEASUREMENT
/begin MEASUREMENT zff_atsys._.iSignale._.obj.sig_zielgang_sas_vorw "Der Istagang (nur positive Werte ansonsten 0)" UBYTE Conv.zff_atsys._.cSignale._.sig_zielgang_sas_vorw_S5_S3 1 100 0 8 ECU_ADDRESS 0xFFF8AEC9 DISPLAY_IDENTIFIER sig_zielgang_sas_vorw.obj._.iSignale._.zff_atsys /end MEASUREMENT
/begin MEASUREMENT zff_atsys._.iSignale._.obj.sig_zielgang_vorw "Der Istagang (nur positive Werte ansonsten 0)" UBYTE Conv.zff_atsys._.cSignale._.sig_zielgang_vorw_S5_S3 1 100 0 8 ECU_ADDRESS 0xFFF8AEC6 DISPLAY_IDENTIFIER sig_zielgang_vorw.obj._.iSignale._.zff_atsys /end MEASUREMENT
/begin RECORD_LAYOUT ZF_TAB_OI_NAT8_S2_S3 FNC_VALUES 1 UBYTE COLUMN_DIR DIRECT /end RECORD_LAYOUT
/begin RECORD_LAYOUT ZF_TAB_OI_NAT8_S3_S3 FNC_VALUES 1 UBYTE COLUMN_DIR DIRECT /end RECORD_LAYOUT
/begin RECORD_LAYOUT ZF_TAB_OI_NAT8_S4_S3 FNC_VALUES 1 UBYTE COLUMN_DIR DIRECT /end RECORD_LAYOUT
/begin RECORD_LAYOUT ZF_tab_si8_S5_S3 FNC_VALUES 2 SBYTE COLUMN_DIR DIRECT NO_AXIS_PTS_X 1 ULONG /end RECORD_LAYOUT
/begin RECORD_LAYOUT ZF_tab_tGang_S5_S3 FNC_VALUES 2 SBYTE COLUMN_DIR DIRECT NO_AXIS_PTS_X 1 ULONG /end RECORD_LAYOUT
/begin RECORD_LAYOUT __UBYTE_Z FNC_VALUES 1 UBYTE ROW_DIR DIRECT /end RECORD_LAYOUT
/begin RECORD_LAYOUT __UWORD_Z FNC_VALUES 1 UWORD ROW_DIR DIRECT /end RECORD_LAYOUT
/begin RECORD_LAYOUT __ULONG_Z FNC_VALUES 1 ULONG ROW_DIR DIRECT /end RECORD_LAYOUT
/begin RECORD_LAYOUT __SBYTE_Z FNC_VALUES 1 SBYTE ROW_DIR DIRECT /end RECORD_LAYOUT
/begin RECORD_LAYOUT __SWORD_Z FNC_VALUES 1 SWORD ROW_DIR DIRECT /end RECORD_LAYOUT
/begin RECORD_LAYOUT __SLONG_Z FNC_VALUES 1 SLONG ROW_DIR DIRECT /end RECORD_LAYOUT
/begin RECORD_LAYOUT __FLOAT32_IEEE_Z FNC_VALUES 1 FLOAT32_IEEE ROW_DIR DIRECT /end RECORD_LAYOUT
/begin RECORD_LAYOUT __FLOAT64_IEEE_Z FNC_VALUES 1 FLOAT64_IEEE ROW_DIR DIRECT /end RECORD_LAYOUT
/begin RECORD_LAYOUT __UBYTE_S FNC_VALUES 1 UBYTE COLUMN_DIR DIRECT /end RECORD_LAYOUT
/begin RECORD_LAYOUT __UWORD_S FNC_VALUES 1 UWORD COLUMN_DIR DIRECT /end RECORD_LAYOUT
/begin RECORD_LAYOUT __ULONG_S FNC_VALUES 1 ULONG COLUMN_DIR DIRECT /end RECORD_LAYOUT
/begin RECORD_LAYOUT __SBYTE_S FNC_VALUES 1 SBYTE COLUMN_DIR DIRECT /end RECORD_LAYOUT
/begin RECORD_LAYOUT __SWORD_S FNC_VALUES 1 SWORD COLUMN_DIR DIRECT /end RECORD_LAYOUT
/begin RECORD_LAYOUT __SLONG_S FNC_VALUES 1 SLONG COLUMN_DIR DIRECT /end RECORD_LAYOUT
/begin RECORD_LAYOUT __FLOAT32_IEEE_S FNC_VALUES 1 FLOAT32_IEEE COLUMN_DIR DIRECT /end RECORD_LAYOUT
/begin RECORD_LAYOUT __FLOAT64_IEEE_S FNC_VALUES 1 FLOAT64_IEEE COLUMN_DIR DIRECT /end RECORD_LAYOUT
/begin RECORD_LAYOUT SSV__UBYTE_S AXIS_PTS_X 1 UBYTE INDEX_INCR DIRECT /end RECORD_LAYOUT
/begin RECORD_LAYOUT SSV__UWORD_S AXIS_PTS_X 1 UWORD INDEX_INCR DIRECT /end RECORD_LAYOUT
/begin RECORD_LAYOUT SSV__ULONG_S AXIS_PTS_X 1 ULONG INDEX_INCR DIRECT /end RECORD_LAYOUT
/begin RECORD_LAYOUT SSV__SBYTE_S AXIS_PTS_X 1 SBYTE INDEX_INCR DIRECT /end RECORD_LAYOUT
/begin RECORD_LAYOUT SSV__SWORD_S AXIS_PTS_X 1 SWORD INDEX_INCR DIRECT /end RECORD_LAYOUT
/begin RECORD_LAYOUT SSV__SLONG_S AXIS_PTS_X 1 SLONG INDEX_INCR DIRECT /end RECORD_LAYOUT
/begin RECORD_LAYOUT SSV__FLOAT32_IEEE_S AXIS_PTS_X 1 FLOAT32_IEEE INDEX_INCR DIRECT /end RECORD_LAYOUT
/begin RECORD_LAYOUT SSV__FLOAT64_IEEE_S AXIS_PTS_X 1 FLOAT64_IEEE INDEX_INCR DIRECT /end RECORD_LAYOUT
/end MODULE
/end PROJECT
