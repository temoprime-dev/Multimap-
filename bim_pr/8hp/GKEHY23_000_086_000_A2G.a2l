ASAP2_VERSION 1 51
/begin PROJECT ZHBC8600 "Gen2_BMW_System_Supplier_Lib"
/begin MODULE CPP ""
/begin MOD_COMMON "" BYTE_ORDER MSB_FIRST ALIGNMENT_BYTE 1 ALIGNMENT_WORD 2 ALIGNMENT_LONG 4 ALIGNMENT_FLOAT32_IEEE 4 ALIGNMENT_FLOAT64_IEEE 1 /end MOD_COMMON
/begin COMPU_VTAB CONV_TAB_E_FEHLERIEP_S6_S3 "Conversion table" TAB_VERB 2 0 "NORMALBETRIEB" 1 "FEHLER" DEFAULT_VALUE "" /end COMPU_VTAB
/begin COMPU_VTAB CONV_TAB_E_HYBFKT_S6_S3 "Conversion table" TAB_VERB 16 0 "PASSIV" 1 "ANKOPPELN_VM" 2 "ABKOPPELN_VM" 3 "GANGEINLEGEN" 4 "GANGAUSLEGEN" 5 "OHNABLAUFFKT" 6 "DIREKTSTART" 7 "VM_ZUSTART" 8 "ABSTELLEN_VM" 9 "NICHTDEFINIERT_4" 10 "VM_SCHLEPPSTART" 11 "VM_NOTSTART" 12 "VM_EIN" 13 "VM_AUS" 14 "NICHTDEFINIERT_3" 15 "FEHLER" DEFAULT_VALUE "" /end COMPU_VTAB
/begin COMPU_VTAB CONV_TAB_E_POS_S6_S3 "Conversion table" TAB_VERB 9 0 "D1" 1 "D2" 2 "D3" 3 "D4" 4 "D5" 5 "D" 6 "N" 7 "R" 8 "P" DEFAULT_VALUE "" /end COMPU_VTAB
/begin COMPU_VTAB CONV_TAB_E_SIGSTATUS_S6_S3 "Conversion table" TAB_VERB 3 0 "SIGNAL_OK" 1 "ERSATZWERT" 2 "SIGNAL_FEHLER" DEFAULT_VALUE "" /end COMPU_VTAB
/begin COMPU_VTAB CONV_TAB_E_STATUSADA_S6_S3 "Conversion table" TAB_VERB 3 0 "KEINADAPTION" 1 "TOUCHPOINT_ADAPTION" 2 "REIBWERT_ADAPTION" DEFAULT_VALUE "" /end COMPU_VTAB
/begin COMPU_VTAB CONV_TAB_E_STATUSIAE_S6_S3 "Conversion table" TAB_VERB 9 0 "NICHTDEFINIERT" 1 "OFFEN" 2 "ANGELEGT" 3 "ANFAHREN" 4 "ENTKOPPELT" 5 "ENTKOPPELT_ANFAHREN" 6 "SYNCHRONISIEREN" 7 "GESCHLOSSEN" 8 "OEFFNEN" DEFAULT_VALUE "" /end COMPU_VTAB
/begin COMPU_VTAB CONV_TAB_E_STATUSIEP_S6_S3 "Conversion table" TAB_VERB 5 0 "AUS" 1 "SLEEP" 2 "LP1" 3 "LP2" 4 "LP3" DEFAULT_VALUE "" /end COMPU_VTAB
/begin COMPU_VTAB CONV_TAB_E_STATUSK0_S6_S3 "Conversion table" TAB_VERB 6 0 "OFFEN" 1 "ANGELEGT" 2 "DRUCKSTELLUNG" 3 "SCHLUPFGEREGELT" 4 "GEREGELTGESCHL" 5 "GESCHLOSSEN" DEFAULT_VALUE "" /end COMPU_VTAB
/begin COMPU_VTAB CONV_TAB_E_STATUSKSL_S6_S3 "Conversion table" TAB_VERB 7 0 "KEIN_KRAFTSCHLUSS" 1 "VORW_AUF_ABBAUEND" 2 "VORWAERTS" 3 "RUECKW_AUF_ABBAUEND" 4 "RUECKWAERTS" 5 "VORWAERTS_SCHLUPF" 6 "RUECKWAERTS_SCHLUPF" DEFAULT_VALUE "" /end COMPU_VTAB
/begin COMPU_VTAB CONV_TAB_E_STATUSPSY_S6_S3 "Conversion table" TAB_VERB 5 0 "AUS" 1 "NICHTDEFINIERT" 2 "LP1" 3 "LP2" 4 "LP3" DEFAULT_VALUE "" /end COMPU_VTAB
/begin COMPU_VTAB CONV_TAB_E_STBZHAS_S6_S3 "Conversion table" TAB_VERB 16 0 "INIT_INAKTIV" 1 "ANGEKOPPELT" 2 "ENTKOPPELT" 3 "EFAHREN" 4 "STOP" 5 "LADEN" 6 "ENTK_VMEIN" 7 "EFAHREN_VMEIN" 8 "HYBRID" 9 "NICHTDEFINIERT_1" 10 "NICHTDEFINIERT_2" 11 "NICHTDEFINIERT_3" 12 "NICHTDEFINIERT_4" 13 "NICHTDEFINIERT_5" 14 "INIT_KL15" 15 "FEHLER" DEFAULT_VALUE "" /end COMPU_VTAB
/begin COMPU_VTAB CONV_TAB_E_ZIEP_S6_S3 "Conversion table" TAB_VERB 5 0 "AUS" 1 "SLEEP" 2 "LP1" 3 "LP2" 4 "LP3" DEFAULT_VALUE "" /end COMPU_VTAB
/begin COMPU_VTAB CONV_TAB_E_ZK0_S6_S3 "Conversion table" TAB_VERB 6 0 "OEFFNENSW" 1 "BEFUELLEN" 2 "DRUCKSTELLUNG" 3 "SCHLUPFREGELUNG" 4 "GEREGELTGESCHL" 5 "GESCHLOSSEN" DEFAULT_VALUE "" /end COMPU_VTAB
/begin COMPU_VTAB CONV_TAB_E_ZK0FSTIN_S6_S3 "Conversion table" TAB_VERB 4 0 "OFFEN" 1 "SCHLUPFGEREGELT" 2 "GEREGELTGESCHL" 3 "GESCHLOSSEN" DEFAULT_VALUE "" /end COMPU_VTAB
/begin COMPU_VTAB CONV_TAB_E_ZMODUSIAE_S6_S3 "Conversion table" TAB_VERB 3 0 "EFAHREN_SCHLUPF" 1 "EFAHREN_KRAFTSCHL" 2 "HYBRIDFAHREN" DEFAULT_VALUE "" /end COMPU_VTAB
/begin COMPU_VTAB CONV_TAB_E_ZMODUSIEP_S6_S3 "Conversion table" TAB_VERB 5 0 "KEINVORGABE" 1 "AUS" 2 "LP1" 3 "LP2" 4 "LP3" DEFAULT_VALUE "" /end COMPU_VTAB
/begin COMPU_VTAB CONV_TAB_E_ZNLLSOLL_S6_S3 "Conversion table" TAB_VERB 3 0 "KEINANF" 1 "ANF_ADAP" 2 "ANF_ALLG" DEFAULT_VALUE "" /end COMPU_VTAB
/begin COMPU_METHOD b_int_S6_S3 "Bit Feld" RAT_FUNC "%10.0" "-" COEFFS 0 1 0 0 0 1 /end COMPU_METHOD
/begin COMPU_METHOD c_int_S6_S3 "Temperatur" RAT_FUNC "%12.6" "°C" COEFFS 0 1 0 0 0 1 /end COMPU_METHOD
/begin COMPU_METHOD E_FEHLERIEP_S6_S3 "" TAB_VERB "%12.6" "" COMPU_TAB_REF CONV_TAB_E_FEHLERIEP_S6_S3 /end COMPU_METHOD
/begin COMPU_METHOD E_HYBFKT_S6_S3 "" TAB_VERB "%12.6" "" COMPU_TAB_REF CONV_TAB_E_HYBFKT_S6_S3 /end COMPU_METHOD
/begin COMPU_METHOD E_POS_S6_S3 "" TAB_VERB "%12.6" "" COMPU_TAB_REF CONV_TAB_E_POS_S6_S3 /end COMPU_METHOD
/begin COMPU_METHOD E_SIGSTATUS_S6_S3 "" TAB_VERB "%12.6" "" COMPU_TAB_REF CONV_TAB_E_SIGSTATUS_S6_S3 /end COMPU_METHOD
/begin COMPU_METHOD E_STATUSADA_S6_S3 "" TAB_VERB "%12.6" "" COMPU_TAB_REF CONV_TAB_E_STATUSADA_S6_S3 /end COMPU_METHOD
/begin COMPU_METHOD E_STATUSIAE_S6_S3 "" TAB_VERB "%12.6" "" COMPU_TAB_REF CONV_TAB_E_STATUSIAE_S6_S3 /end COMPU_METHOD
/begin COMPU_METHOD E_STATUSIEP_S6_S3 "" TAB_VERB "%12.6" "" COMPU_TAB_REF CONV_TAB_E_STATUSIEP_S6_S3 /end COMPU_METHOD
/begin COMPU_METHOD E_STATUSK0_S6_S3 "" TAB_VERB "%12.6" "" COMPU_TAB_REF CONV_TAB_E_STATUSK0_S6_S3 /end COMPU_METHOD
/begin COMPU_METHOD E_STATUSKSL_S6_S3 "" TAB_VERB "%12.6" "" COMPU_TAB_REF CONV_TAB_E_STATUSKSL_S6_S3 /end COMPU_METHOD
/begin COMPU_METHOD E_STATUSPSY_S6_S3 "" TAB_VERB "%12.6" "" COMPU_TAB_REF CONV_TAB_E_STATUSPSY_S6_S3 /end COMPU_METHOD
/begin COMPU_METHOD E_STBZHAS_S6_S3 "" TAB_VERB "%12.6" "" COMPU_TAB_REF CONV_TAB_E_STBZHAS_S6_S3 /end COMPU_METHOD
/begin COMPU_METHOD E_ZIEP_S6_S3 "" TAB_VERB "%12.6" "" COMPU_TAB_REF CONV_TAB_E_ZIEP_S6_S3 /end COMPU_METHOD
/begin COMPU_METHOD E_ZK0_S6_S3 "" TAB_VERB "%12.6" "" COMPU_TAB_REF CONV_TAB_E_ZK0_S6_S3 /end COMPU_METHOD
/begin COMPU_METHOD E_ZK0FSTIN_S6_S3 "" TAB_VERB "%12.6" "" COMPU_TAB_REF CONV_TAB_E_ZK0FSTIN_S6_S3 /end COMPU_METHOD
/begin COMPU_METHOD E_ZMODUSIAE_S6_S3 "" TAB_VERB "%12.6" "" COMPU_TAB_REF CONV_TAB_E_ZMODUSIAE_S6_S3 /end COMPU_METHOD
/begin COMPU_METHOD E_ZMODUSIEP_S6_S3 "" TAB_VERB "%12.6" "" COMPU_TAB_REF CONV_TAB_E_ZMODUSIEP_S6_S3 /end COMPU_METHOD
/begin COMPU_METHOD E_ZNLLSOLL_S6_S3 "" TAB_VERB "%12.6" "" COMPU_TAB_REF CONV_TAB_E_ZNLLSOLL_S6_S3 /end COMPU_METHOD
/begin COMPU_METHOD n_fl_S6_S3 "Drehzahl" RAT_FUNC "%12.6" "1/min" COEFFS 0 1 0 0 0 1 /end COMPU_METHOD
/begin COMPU_METHOD ng_fl_S6_S3 "Drehzahlgradient" RAT_FUNC "%12.6" "1/min/s" COEFFS 0 1 0 0 0 1 /end COMPU_METHOD
/begin COMPU_METHOD p_fl_S6_S3 "Druck" RAT_FUNC "%12.6" "bar" COEFFS 0 1 0 0 0 1 /end COMPU_METHOD
/begin COMPU_METHOD SAB2_K10_S3_S3 "int = ((phys * 10) / 1) - (0) -" RAT_FUNC "%4.3" "-" COEFFS 0 10 0 0 0 1 /end COMPU_METHOD
/begin COMPU_METHOD SAB2_K128_S3_S3 "int = ((phys * 128) / 1) - (0) -" RAT_FUNC "%4.3" "-" COEFFS 0 128 0 0 0 1 /end COMPU_METHOD
/begin COMPU_METHOD t_fl_S6_S3 "Zeit" RAT_FUNC "%12.6" "s" COEFFS 0 1 0 0 0 1 /end COMPU_METHOD
/begin COMPU_METHOD t_int_S6_S3 "Zeit" RAT_FUNC "%11.2" "s" COEFFS 0 100 0 0 0 1 /end COMPU_METHOD
/begin COMPU_METHOD trq_fl_a_S6_S3 "Moment" RAT_FUNC "%12.6" "Nm" COEFFS 0 1 0 0 0 1 /end COMPU_METHOD
/begin COMPU_METHOD trqg_fl_c_S6_S3 "Momentengradient" RAT_FUNC "%12.6" "Nm/s" COEFFS 0 1 0 0 0 1 /end COMPU_METHOD
/begin COMPU_METHOD v_fl_S6_S3 "Geschwindigkeit" RAT_FUNC "%12.6" "km/h" COEFFS 0 1 0 0 0 1 /end COMPU_METHOD
/begin COMPU_METHOD vg_fl_S6_S3 "Geschwindigkeitsgradient" RAT_FUNC "%12.6" "km/h/s" COEFFS 0 1 0 0 0 1 /end COMPU_METHOD
/begin COMPU_METHOD void_fl_S6_S3 "ohne Umrechnung" RAT_FUNC "%12.6" "-" COEFFS 0 1 0 0 0 1 /end COMPU_METHOD
/begin COMPU_METHOD void_int_b_S6_S3 "ohne Umrechnung" RAT_FUNC "%5.0" "-" COEFFS 0 1 0 0 0 1 /end COMPU_METHOD
/begin COMPU_METHOD void_int_e_S6_S3 "ohne Umrechnung" RAT_FUNC "%1.0" "-" COEFFS 0 1 0 0 0 1 /end COMPU_METHOD
/begin COMPU_METHOD void_int_S6_S3 "ohne Umrechnung" RAT_FUNC "%3.0" "-" COEFFS 0 1 0 0 0 1 /end COMPU_METHOD
/begin COMPU_METHOD VOID_SCALING_f_S6_S3 "Void scaling for unscaled variables" RAT_FUNC "%12.6" "" COEFFS 0 1 0 0 0 1 /end COMPU_METHOD
/begin COMPU_METHOD VOID_SCALING_S6_S3 "Void scaling for unscaled variables" RAT_FUNC "%1.0" "" COEFFS 0 1 0 0 0 1 /end COMPU_METHOD
/begin CHARACTERISTIC BM_SCHALTARTNEMMODRS_SYN_ZUS "Bitmaske zur Festlegung der Schaltart der RS zur Anhebung der modifizierten EM- Drehzahl als Basisdrehzahl zur Bestimmung der VM Solldrehzahl bei RS beim K0 Synchronisieren beim Zustart" VALUE 0x1D8015 UBYTE_COL_DIRECT_S6_S3 0 void_int_S6_S3 0 255 /end CHARACTERISTIC
/begin MEASUREMENT DD_SFOp_VME5_z__bed_zst_vme_mes "Timer zur Erkennung VM läuft als Übergangsbedingung nach Übergabe im Zustand Zustarten der Hybridfunktion VM ein" UBYTE void_int_S6_S3 1 100 0 10 ECU_ADDRESS 0xFFF96DD7 /end MEASUREMENT
/begin CHARACTERISTIC FK_NDGSOLLVMNVM_SYN_ZUS "Filterkonstante zur Bestimmung des Gradienten der Differenz zwischen VM-Soll- und Ist-Drehzahl im Zustand K0 Synchronisieren beim Zustart" VALUE 0x1D5D78 FLOAT32_IEEE_COL_DIRECT_S6_S3 0 void_fl_S6_S3 0 1 /end CHARACTERISTIC
/begin CHARACTERISTIC FK_NGNSOLLVMVE_ANS "Filterkonstante zur Filterung von n_soll_vm_has für voreilendes Signal" VALUE 0x1D1964 FLOAT32_IEEE_COL_DIRECT_S6_S3 0 void_fl_S6_S3 -3.40282e+038 3.40282e+038 /end CHARACTERISTIC
/begin CHARACTERISTIC FK_NSOLLVMVE_ANS "Faktor um welchen n_soll_vm_has pro Task voreilen soll" VALUE 0x1D1970 FLOAT32_IEEE_COL_DIRECT_S6_S3 0 void_fl_S6_S3 -3.40282e+038 3.40282e+038 /end CHARACTERISTIC
/begin CHARACTERISTIC FK_NSOLLVM_ANH_ZUS "Filterung der VM Solldrehzahl beim VM Start Variante Zustarten" VALUE 0x1D5D80 FLOAT32_IEEE_COL_DIRECT_S6_S3 0 void_fl_S6_S3 0 1 /end CHARACTERISTIC
/begin CHARACTERISTIC FK_NSOLLVM_SAK_ZUS "Filterung der VM-Solldrehzahl im Zustand Schaltung aktiv beim Zustart" VALUE 0x1D5D84 FLOAT32_IEEE_COL_DIRECT_S6_S3 0 void_fl_S6_S3 0 1 /end CHARACTERISTIC
/begin CHARACTERISTIC FK_NSOLLVM_ZST_ZUS "Filterung der VM Solldrehzahl beim VM Start Variante Zustarten" VALUE 0x1D5D88 FLOAT32_IEEE_COL_DIRECT_S6_S3 0 void_fl_S6_S3 0 1 /end CHARACTERISTIC
/begin CHARACTERISTIC KF_FFKMSTOERKPL_ANS_W "Faktor auf KF_FFKMSTOERKPL_ANS = f(z_ablaufvariante_has_stg,status_k0_in)" MAP 0x1D462C FLOAT32_IEEE_COL_DIRECT_S6_S3 0 trq_fl_a_S6_S3 0 100
 /begin AXIS_DESCR COM_AXIS z_ablaufvariante_has_stg void_int_S6_S3 8 0 255 DEPOSIT ABSOLUTE AXIS_PTS_REF KF_FFKMSTOERKPL_ANS_X /end AXIS_DESCR
 /begin AXIS_DESCR COM_AXIS status_k0_in void_int_S6_S3 6 0 255 DEPOSIT ABSOLUTE AXIS_PTS_REF KF_FFKMSTOERKPL_ANS_Y /end AXIS_DESCR
/end CHARACTERISTIC
/begin AXIS_PTS KF_FFKMSTOERKPL_ANS_X "X-Achse: z_ablaufvariante_has_stg" 0x1D5BA4 z_ablaufvariante_has_stg UBYTE_X_INCR_DIRECT_S6_S3 0 void_int_S6_S3 8 0 255 DEPOSIT ABSOLUTE /end AXIS_PTS
/begin AXIS_PTS KF_FFKMSTOERKPL_ANS_Y "Y-Achse: status_k0_in" 0x1D8C4C status_k0_in UBYTE_X_INCR_DIRECT_S6_S3 0 void_int_S6_S3 6 0 255 DEPOSIT ABSOLUTE /end AXIS_PTS
/begin CHARACTERISTIC KF_FKMSTOERKPL_ANS_W "Filterzeitkonstante m_stoer_k0_em =f(c_getriebe_egs_in, m_stoer_k0_em_fil)" MAP 0x1D46EC FLOAT32_IEEE_COL_DIRECT_S6_S3 0 t_fl_S6_S3 -3.40282e+038 3.40282e+038
 /begin AXIS_DESCR COM_AXIS c_getriebe_egs_in c_int_S6_S3 8 -3.40282e+038 3.40282e+038 DEPOSIT ABSOLUTE AXIS_PTS_REF KF_FKMSTOERKPL_ANS_X /end AXIS_DESCR
 /begin AXIS_DESCR COM_AXIS NO_INPUT_QUANTITY trq_fl_a_S6_S3 8 -3.40282e+038 3.40282e+038 DEPOSIT ABSOLUTE AXIS_PTS_REF KF_FKMSTOERKPL_ANS_Y /end AXIS_DESCR
/end CHARACTERISTIC
/begin AXIS_PTS KF_FKMSTOERKPL_ANS_X "X-Achse: c_getriebe_egs_in" 0x1D47EC c_getriebe_egs_in FLOAT32_IEEE_X_INCR_DIRECT_S6_S3 0 c_int_S6_S3 8 -3.40282e+038 3.40282e+038 DEPOSIT ABSOLUTE /end AXIS_PTS
/begin AXIS_PTS KF_FKMSTOERKPL_ANS_Y "Y-Achse: m_stoer_k0_em_fil" 0x1D480C NO_INPUT_QUANTITY FLOAT32_IEEE_X_INCR_DIRECT_S6_S3 0 trq_fl_a_S6_S3 8 -3.40282e+038 3.40282e+038 DEPOSIT ABSOLUTE /end AXIS_PTS
/begin CHARACTERISTIC KF_FMOSTOERKPL_ANS_W "Faktor für KF_15OMSTOERKPL_ANS" MAP 0x1D482C FLOAT32_IEEE_COL_DIRECT_S6_S3 0 void_fl_S6_S3 -3.40282e+038 3.40282e+038
 /begin AXIS_DESCR COM_AXIS nd_k0_in t_fl_S6_S3 10 -3.40282e+038 3.40282e+038 DEPOSIT ABSOLUTE AXIS_PTS_REF KF_FMOSTOERKPL_ANS_X /end AXIS_DESCR
 /begin AXIS_DESCR COM_AXIS n_em_in trq_fl_a_S6_S3 8 -3.40282e+038 3.40282e+038 DEPOSIT ABSOLUTE AXIS_PTS_REF KF_FMOSTOERKPL_ANS_Y /end AXIS_DESCR
/end CHARACTERISTIC
/begin AXIS_PTS KF_FMOSTOERKPL_ANS_X "X-Achse:t_mstoerk0emfil_ans" 0x1D496C nd_k0_in FLOAT32_IEEE_X_INCR_DIRECT_S6_S3 0 t_fl_S6_S3 10 -3.40282e+038 3.40282e+038 DEPOSIT ABSOLUTE /end AXIS_PTS
/begin AXIS_PTS KF_FMOSTOERKPL_ANS_Y "Y-Achse: m_stoer_k0_em_has_alt" 0x1D4994 n_em_in FLOAT32_IEEE_X_INCR_DIRECT_S6_S3 0 trq_fl_a_S6_S3 8 -3.40282e+038 3.40282e+038 DEPOSIT ABSOLUTE /end AXIS_PTS
/begin CHARACTERISTIC KF_FMSTOERKPL_ANS_W "Faktor zur Berechnung EM-Vorsteuermoment vor PT2 Filter" MAP 0x1D49B4 FLOAT32_IEEE_COL_DIRECT_S6_S3 0 void_fl_S6_S3 0 1
 /begin AXIS_DESCR COM_AXIS NO_INPUT_QUANTITY t_fl_S6_S3 10 -3.40282e+038 3.40282e+038 DEPOSIT ABSOLUTE AXIS_PTS_REF KF_FMSTOERKPL_ANS_X /end AXIS_DESCR
 /begin AXIS_DESCR COM_AXIS NO_INPUT_QUANTITY trq_fl_a_S6_S3 8 -3.40282e+038 3.40282e+038 DEPOSIT ABSOLUTE AXIS_PTS_REF KF_FMSTOERKPL_ANS_Y /end AXIS_DESCR
/end CHARACTERISTIC
/begin AXIS_PTS KF_FMSTOERKPL_ANS_X "X-Achse: Norm. Zeit aus Timer t_mstoerk0emfil" 0x1D4AF4 NO_INPUT_QUANTITY FLOAT32_IEEE_X_INCR_DIRECT_S6_S3 0 t_fl_S6_S3 10 -3.40282e+038 3.40282e+038 DEPOSIT ABSOLUTE /end AXIS_PTS
/begin AXIS_PTS KF_FMSTOERKPL_ANS_Y "Y-Achse: m_stoer_k0_em_has_alt" 0x1D4B1C NO_INPUT_QUANTITY FLOAT32_IEEE_X_INCR_DIRECT_S6_S3 0 trq_fl_a_S6_S3 8 -3.40282e+038 3.40282e+038 DEPOSIT ABSOLUTE /end AXIS_PTS
/begin CHARACTERISTIC KF_FMSTOERND_VMS_ANS_W "Bestimmung k_mtoer" MAP 0x1D4B3C FLOAT32_IEEE_COL_DIRECT_S6_S3 0 void_fl_S6_S3 -3.40282e+038 3.40282e+038
 /begin AXIS_DESCR COM_AXIS nd_k0_in n_fl_S6_S3 10 -3.40282e+038 3.40282e+038 DEPOSIT ABSOLUTE AXIS_PTS_REF KF_FMSTOERND_VMS_ANS_X /end AXIS_DESCR
 /begin AXIS_DESCR COM_AXIS n_em_in n_fl_S6_S3 8 -3.40282e+038 3.40282e+038 DEPOSIT ABSOLUTE AXIS_PTS_REF KF_FMSTOERND_VMS_ANS_Y /end AXIS_DESCR
/end CHARACTERISTIC
/begin AXIS_PTS KF_FMSTOERND_VMS_ANS_X "X-Achse: nd_k0_in" 0x1D4C7C nd_k0_in FLOAT32_IEEE_X_INCR_DIRECT_S6_S3 0 n_fl_S6_S3 10 -3.40282e+038 3.40282e+038 DEPOSIT ABSOLUTE /end AXIS_PTS
/begin AXIS_PTS KF_FMSTOERND_VMS_ANS_Y "Y-Achse: n_em_in" 0x1D4CA4 n_em_in FLOAT32_IEEE_X_INCR_DIRECT_S6_S3 0 n_fl_S6_S3 8 -3.40282e+038 3.40282e+038 DEPOSIT ABSOLUTE /end AXIS_PTS
/begin CHARACTERISTIC KF_IAEENTK_STIAEKRAFTFL_ANS_W "Teil der Bestimmung z_iae_entkoppelt" MAP 0x1D7DA3 UBYTE_COL_DIRECT_S6_S3 0 void_int_S6_S3 0 255
 /begin AXIS_DESCR COM_AXIS status_iae_in void_int_S6_S3 9 0 255 DEPOSIT ABSOLUTE AXIS_PTS_REF KF_IAEENTK_STIAEKRAFTFL_ANS_X /end AXIS_DESCR
 /begin AXIS_DESCR COM_AXIS status_kraftfluss_egs_in void_int_S6_S3 7 0 255 DEPOSIT ABSOLUTE AXIS_PTS_REF KF_IAEENTK_STIAEKRAFTFL_ANS_Y /end AXIS_DESCR
/end CHARACTERISTIC
/begin AXIS_PTS KF_IAEENTK_STIAEKRAFTFL_ANS_X "X-Achse: stauts_iae_in" 0x1D7DE2 status_iae_in UBYTE_X_INCR_DIRECT_S6_S3 0 void_int_S6_S3 9 0 255 DEPOSIT ABSOLUTE /end AXIS_PTS
/begin AXIS_PTS KF_IAEENTK_STIAEKRAFTFL_ANS_Y "Y-Achse: status_kraftfluss_egs_in" 0x1D7DEB status_kraftfluss_egs_in UBYTE_X_INCR_DIRECT_S6_S3 0 void_int_S6_S3 7 0 255 DEPOSIT ABSOLUTE /end AXIS_PTS
/begin CHARACTERISTIC KF_KOLBPOSINITTIMER_ANS_W "Kolbenpositionsschwelle zur Aktiveriung von m_stoer_k0_em_fil in Prozent" MAP 0x1D5BAC UBYTE_COL_DIRECT_S6_S3 0 void_int_S6_S3 0 100
 /begin AXIS_DESCR COM_AXIS c_getriebe_egs_in c_int_S6_S3 8 -3.40282e+038 3.40282e+038 DEPOSIT ABSOLUTE AXIS_PTS_REF KF_KOLBPOSINITTIMER_ANS_X /end AXIS_DESCR
 /begin AXIS_DESCR COM_AXIS NO_INPUT_QUANTITY trq_fl_a_S6_S3 8 -3.40282e+038 3.40282e+038 DEPOSIT ABSOLUTE AXIS_PTS_REF KF_KOLBPOSINITTIMER_ANS_Y /end AXIS_DESCR
/end CHARACTERISTIC
/begin AXIS_PTS KF_KOLBPOSINITTIMER_ANS_X "X-Achse: c_getriebe_egs_in" 0x1D4CC4 c_getriebe_egs_in FLOAT32_IEEE_X_INCR_DIRECT_S6_S3 0 c_int_S6_S3 8 -3.40282e+038 3.40282e+038 DEPOSIT ABSOLUTE /end AXIS_PTS
/begin AXIS_PTS KF_KOLBPOSINITTIMER_ANS_Y "Y-Achse: m_soll_k0_has_alt" 0x1D4CE4 NO_INPUT_QUANTITY FLOAT32_IEEE_X_INCR_DIRECT_S6_S3 0 trq_fl_a_S6_S3 8 -3.40282e+038 3.40282e+038 DEPOSIT ABSOLUTE /end AXIS_PTS
/begin CHARACTERISTIC KF_MGK0NDK0M_IAEREG_SYN_ZUS_W "Gradient des K0-Sollmoments in Abhängigkeit der K0 Differenzdrehzahl und dem VM Zielmoment bei aktiver IAE-Regelung im Zustand K0 Synchronisieren beim Zustart" MAP 0x1D61E4 FLOAT32_IEEE_COL_DIRECT_S6_S3 0 trqg_fl_c_S6_S3 0 50000
 /begin AXIS_DESCR COM_AXIS NO_INPUT_QUANTITY n_fl_S6_S3 7 -3.40282e+038 3.40282e+038 DEPOSIT ABSOLUTE AXIS_PTS_REF KF_MGK0NDK0M_IAEREG_SYN_ZUS_X /end AXIS_DESCR
 /begin AXIS_DESCR COM_AXIS NO_INPUT_QUANTITY trq_fl_a_S6_S3 6 -3.40282e+038 3.40282e+038 DEPOSIT ABSOLUTE AXIS_PTS_REF KF_MGK0NDK0M_IAEREG_SYN_ZUS_Y /end AXIS_DESCR
/end CHARACTERISTIC
/begin AXIS_PTS KF_MGK0NDK0M_IAEREG_SYN_ZUS_X "Gradient des K0-Sollmoments in Abhängigkeit der K0 Differenzdrehzahl und dem VM Zielmoment bei aktiver IAE-Regelung im Zustand K0 Synchronisieren beim Zustart" 0x1D628C NO_INPUT_QUANTITY FLOAT32_IEEE_X_INCR_DIRECT_S6_S3 0 n_fl_S6_S3 7 -3.40282e+038 3.40282e+038 DEPOSIT ABSOLUTE /end AXIS_PTS
/begin AXIS_PTS KF_MGK0NDK0M_IAEREG_SYN_ZUS_Y "Gradient des K0-Sollmoments in Abhängigkeit der K0 Differenzdrehzahl und dem VM Zielmoment bei aktiver IAE-Regelung im Zustand K0 Synchronisieren beim Zustart" 0x1D62A8 NO_INPUT_QUANTITY FLOAT32_IEEE_X_INCR_DIRECT_S6_S3 0 trq_fl_a_S6_S3 6 -3.40282e+038 3.40282e+038 DEPOSIT ABSOLUTE /end AXIS_PTS
/begin CHARACTERISTIC KF_MGK0NDK0M_MRS_SYN_ZUS_W "Gradient des K0-Sollmoments in Abhängigkeit der K0 Differenzdrehzahl und dem VM Zielmoment  bei Mehrfachrückschaltungen beim K0 Synchronisieren beim Zustart " MAP 0x1D62C0 FLOAT32_IEEE_COL_DIRECT_S6_S3 0 trqg_fl_c_S6_S3 0 50000
 /begin AXIS_DESCR COM_AXIS NO_INPUT_QUANTITY n_fl_S6_S3 7 -3.40282e+038 3.40282e+038 DEPOSIT ABSOLUTE AXIS_PTS_REF KF_MGK0NDK0M_MRS_SYN_ZUS_X /end AXIS_DESCR
 /begin AXIS_DESCR COM_AXIS NO_INPUT_QUANTITY trq_fl_a_S6_S3 6 -3.40282e+038 3.40282e+038 DEPOSIT ABSOLUTE AXIS_PTS_REF KF_MGK0NDK0M_MRS_SYN_ZUS_Y /end AXIS_DESCR
/end CHARACTERISTIC
/begin AXIS_PTS KF_MGK0NDK0M_MRS_SYN_ZUS_X "Gradient des K0-Sollmoments in Abhängigkeit der K0 Differenzdrehzahl und dem VM Zielmoment  bei Mehrfachrückschaltungen beim K0 Synchronisieren beim Zustart " 0x1D6368 NO_INPUT_QUANTITY FLOAT32_IEEE_X_INCR_DIRECT_S6_S3 0 n_fl_S6_S3 7 -3.40282e+038 3.40282e+038 DEPOSIT ABSOLUTE /end AXIS_PTS
/begin AXIS_PTS KF_MGK0NDK0M_MRS_SYN_ZUS_Y "Gradient des K0-Sollmoments in Abhängigkeit der K0 Differenzdrehzahl und dem VM Zielmoment  bei Mehrfachrückschaltungen beim K0 Synchronisieren beim Zustart " 0x1D6384 NO_INPUT_QUANTITY FLOAT32_IEEE_X_INCR_DIRECT_S6_S3 0 trq_fl_a_S6_S3 6 -3.40282e+038 3.40282e+038 DEPOSIT ABSOLUTE /end AXIS_PTS
/begin CHARACTERISTIC KF_MGK0NDK0M_RS_SYN_ZUS_W "Gradient des K0-Sollmoments in Abhängigkeit der K0 Differenzdrehzahl und dem VM Zielmoment  bei Rückschaltungen beim K0 Synchronisieren beim Zustart " MAP 0x1D639C FLOAT32_IEEE_COL_DIRECT_S6_S3 0 trqg_fl_c_S6_S3 0 50000
 /begin AXIS_DESCR COM_AXIS NO_INPUT_QUANTITY n_fl_S6_S3 7 -3.40282e+038 3.40282e+038 DEPOSIT ABSOLUTE AXIS_PTS_REF KF_MGK0NDK0M_RS_SYN_ZUS_X /end AXIS_DESCR
 /begin AXIS_DESCR COM_AXIS NO_INPUT_QUANTITY trq_fl_a_S6_S3 6 -3.40282e+038 3.40282e+038 DEPOSIT ABSOLUTE AXIS_PTS_REF KF_MGK0NDK0M_RS_SYN_ZUS_Y /end AXIS_DESCR
/end CHARACTERISTIC
/begin AXIS_PTS KF_MGK0NDK0M_RS_SYN_ZUS_X "Gradient des K0-Sollmoments in Abhängigkeit der K0 Differenzdrehzahl und dem VM Zielmoment  bei Rückschaltungen beim K0 Synchronisieren beim Zustart " 0x1D6444 NO_INPUT_QUANTITY FLOAT32_IEEE_X_INCR_DIRECT_S6_S3 0 n_fl_S6_S3 7 -3.40282e+038 3.40282e+038 DEPOSIT ABSOLUTE /end AXIS_PTS
/begin AXIS_PTS KF_MGK0NDK0M_RS_SYN_ZUS_Y "Gradient des K0-Sollmoments in Abhängigkeit der K0 Differenzdrehzahl und dem VM Zielmoment  bei Rückschaltungen beim K0 Synchronisieren beim Zustart " 0x1D6460 NO_INPUT_QUANTITY FLOAT32_IEEE_X_INCR_DIRECT_S6_S3 0 trq_fl_a_S6_S3 6 -3.40282e+038 3.40282e+038 DEPOSIT ABSOLUTE /end AXIS_PTS
/begin CHARACTERISTIC KF_MGK0NDK0M_SYN_ZUS_W "Gradient des K0 Sollmoments in Abhängigkeit der K0 Differenzdrehzahl und VM Zielmoment beim K0 Synchronisieren beim Zustart" MAP 0x1D6478 FLOAT32_IEEE_COL_DIRECT_S6_S3 0 trqg_fl_c_S6_S3 0 50000
 /begin AXIS_DESCR COM_AXIS NO_INPUT_QUANTITY n_fl_S6_S3 7 -3.40282e+038 3.40282e+038 DEPOSIT ABSOLUTE AXIS_PTS_REF KF_MGK0NDK0M_SYN_ZUS_X /end AXIS_DESCR
 /begin AXIS_DESCR COM_AXIS NO_INPUT_QUANTITY trq_fl_a_S6_S3 6 -3.40282e+038 3.40282e+038 DEPOSIT ABSOLUTE AXIS_PTS_REF KF_MGK0NDK0M_SYN_ZUS_Y /end AXIS_DESCR
/end CHARACTERISTIC
/begin AXIS_PTS KF_MGK0NDK0M_SYN_ZUS_X "Gradient des K0 Sollmoments in Abhängigkeit der K0 Differenzdrehzahl und VM Zielmoment beim K0 Synchronisieren beim Zustart" 0x1D6520 NO_INPUT_QUANTITY FLOAT32_IEEE_X_INCR_DIRECT_S6_S3 0 n_fl_S6_S3 7 -3.40282e+038 3.40282e+038 DEPOSIT ABSOLUTE /end AXIS_PTS
/begin AXIS_PTS KF_MGK0NDK0M_SYN_ZUS_Y "Gradient des K0 Sollmoments in Abhängigkeit der K0 Differenzdrehzahl und VM Zielmoment beim K0 Synchronisieren beim Zustart" 0x1D653C NO_INPUT_QUANTITY FLOAT32_IEEE_X_INCR_DIRECT_S6_S3 0 trq_fl_a_S6_S3 6 -3.40282e+038 3.40282e+038 DEPOSIT ABSOLUTE /end AXIS_PTS
/begin CHARACTERISTIC KF_MGK0NDK0M_ZMANH_SYN_ZUS_W "Gradient des K0-Sollmoments in Abhängigkeit der K0 Differenzdrehzahl und dem VM Zielmoment bei aktiver Zusatzdrehmomentanhebung beim K0 Synchronisieren beim Zustart " MAP 0x1D6554 FLOAT32_IEEE_COL_DIRECT_S6_S3 0 trqg_fl_c_S6_S3 0 50000
 /begin AXIS_DESCR COM_AXIS NO_INPUT_QUANTITY n_fl_S6_S3 7 -3.40282e+038 3.40282e+038 DEPOSIT ABSOLUTE AXIS_PTS_REF KF_MGK0NDK0M_ZMANH_SYN_ZUS_X /end AXIS_DESCR
 /begin AXIS_DESCR COM_AXIS NO_INPUT_QUANTITY trq_fl_a_S6_S3 6 -3.40282e+038 3.40282e+038 DEPOSIT ABSOLUTE AXIS_PTS_REF KF_MGK0NDK0M_ZMANH_SYN_ZUS_Y /end AXIS_DESCR
/end CHARACTERISTIC
/begin AXIS_PTS KF_MGK0NDK0M_ZMANH_SYN_ZUS_X "Gradient des K0-Sollmoments in Abhängigkeit der K0 Differenzdrehzahl und dem VM Zielmoment bei aktiver Zusatzdrehmomentanhebung beim K0 Synchronisieren beim Zustart " 0x1D65FC NO_INPUT_QUANTITY FLOAT32_IEEE_X_INCR_DIRECT_S6_S3 0 n_fl_S6_S3 7 -3.40282e+038 3.40282e+038 DEPOSIT ABSOLUTE /end AXIS_PTS
/begin AXIS_PTS KF_MGK0NDK0M_ZMANH_SYN_ZUS_Y "Gradient des K0-Sollmoments in Abhängigkeit der K0 Differenzdrehzahl und dem VM Zielmoment bei aktiver Zusatzdrehmomentanhebung beim K0 Synchronisieren beim Zustart " 0x1D6618 NO_INPUT_QUANTITY FLOAT32_IEEE_X_INCR_DIRECT_S6_S3 0 trq_fl_a_S6_S3 6 -3.40282e+038 3.40282e+038 DEPOSIT ABSOLUTE /end AXIS_PTS
/begin CHARACTERISTIC KF_MGK0NDK0NGVM_SYN_ZUS_W "Gradient des K0 Sollmoments in Abhängigkeit der K0 Differenzdrehzahl und des VM Drehzahlgradienten beim K0 Synchronisieren beim Zustart" MAP 0x1D6630 FLOAT32_IEEE_COL_DIRECT_S6_S3 0 trqg_fl_c_S6_S3 0 50000
 /begin AXIS_DESCR COM_AXIS NO_INPUT_QUANTITY n_fl_S6_S3 7 -3.40282e+038 3.40282e+038 DEPOSIT ABSOLUTE AXIS_PTS_REF KF_MGK0NDK0NGVM_SYN_ZUS_X /end AXIS_DESCR
 /begin AXIS_DESCR COM_AXIS NO_INPUT_QUANTITY trq_fl_a_S6_S3 9 -3.40282e+038 3.40282e+038 DEPOSIT ABSOLUTE AXIS_PTS_REF KF_MGK0NDK0NGVM_SYN_ZUS_Y /end AXIS_DESCR
/end CHARACTERISTIC
/begin AXIS_PTS KF_MGK0NDK0NGVM_SYN_ZUS_X "Gradient des K0 Sollmoments in Abhängigkeit der K0 Differenzdrehzahl und des VM Drehzahlgradienten beim K0 Synchronisieren beim Zustart" 0x1D672C NO_INPUT_QUANTITY FLOAT32_IEEE_X_INCR_DIRECT_S6_S3 0 n_fl_S6_S3 7 -3.40282e+038 3.40282e+038 DEPOSIT ABSOLUTE /end AXIS_PTS
/begin AXIS_PTS KF_MGK0NDK0NGVM_SYN_ZUS_Y "Gradient des K0 Sollmoments in Abhängigkeit der K0 Differenzdrehzahl und des VM Drehzahlgradienten beim K0 Synchronisieren beim Zustart" 0x1D6748 NO_INPUT_QUANTITY FLOAT32_IEEE_X_INCR_DIRECT_S6_S3 0 trq_fl_a_S6_S3 9 -3.40282e+038 3.40282e+038 DEPOSIT ABSOLUTE /end AXIS_PTS
/begin CHARACTERISTIC KF_MOIAEENTKERK1_ANS_W "1. Momentenoffset für die Erkennung IAE entkoppelt (status_iae_in = 8) " MAP 0x1D4E44 FLOAT32_IEEE_COL_DIRECT_S6_S3 0 trq_fl_a_S6_S3 -3.40282e+038 3.40282e+038
 /begin AXIS_DESCR COM_AXIS m_mot_in trq_fl_a_S6_S3 8 -3.40282e+038 3.40282e+038 DEPOSIT ABSOLUTE AXIS_PTS_REF KF_MOIAEENTKERK1_ANS_X /end AXIS_DESCR
 /begin AXIS_DESCR COM_AXIS istgang_egs_in void_int_S6_S3 7 -128 127 DEPOSIT ABSOLUTE AXIS_PTS_REF KF_MOIAEENTKERK1_ANS_Y /end AXIS_DESCR
/end CHARACTERISTIC
/begin AXIS_PTS KF_MOIAEENTKERK1_ANS_X "X-Achse: m_mot_in" 0x1D4F24 m_mot_in FLOAT32_IEEE_X_INCR_DIRECT_S6_S3 0 trq_fl_a_S6_S3 8 -3.40282e+038 3.40282e+038 DEPOSIT ABSOLUTE /end AXIS_PTS
/begin AXIS_PTS KF_MOIAEENTKERK1_ANS_Y "Y-Achse: istgang_egs_in" 0x1D7DF2 istgang_egs_in SBYTE_X_INCR_DIRECT_S6_S3 0 void_int_S6_S3 7 -128 127 DEPOSIT ABSOLUTE /end AXIS_PTS
/begin CHARACTERISTIC KF_MOIAEENTKERK2_ANS_W "2. Momentenoffset für die Erkennung IAE entkoppelt (status_iae_in = 8) " MAP 0x1D4F44 FLOAT32_IEEE_COL_DIRECT_S6_S3 0 void_fl_S6_S3 -3.40282e+038 3.40282e+038
 /begin AXIS_DESCR COM_AXIS m_mot_in trq_fl_a_S6_S3 8 -3.40282e+038 3.40282e+038 DEPOSIT ABSOLUTE AXIS_PTS_REF KF_MOIAEENTKERK2_ANS_X /end AXIS_DESCR
 /begin AXIS_DESCR COM_AXIS istgang_egs_in void_int_S6_S3 7 -128 127 DEPOSIT ABSOLUTE AXIS_PTS_REF KF_MOIAEENTKERK2_ANS_Y /end AXIS_DESCR
/end CHARACTERISTIC
/begin AXIS_PTS KF_MOIAEENTKERK2_ANS_X "X-Achse: m_mot_in" 0x1D5024 m_mot_in FLOAT32_IEEE_X_INCR_DIRECT_S6_S3 0 trq_fl_a_S6_S3 8 -3.40282e+038 3.40282e+038 DEPOSIT ABSOLUTE /end AXIS_PTS
/begin AXIS_PTS KF_MOIAEENTKERK2_ANS_Y "Y-Achse: istgang_egs_in" 0x1D7DF9 istgang_egs_in SBYTE_X_INCR_DIRECT_S6_S3 0 void_int_S6_S3 7 -128 127 DEPOSIT ABSOLUTE /end AXIS_PTS
/begin CHARACTERISTIC KF_MOSTOERKPL_ANS_W "Momentoffset auf m_stoer_k0_em_has = f(z_ablaufvariante_has_stg, status_k0_in)" MAP 0x1D5044 FLOAT32_IEEE_COL_DIRECT_S6_S3 0 trq_fl_a_S6_S3 0 100
 /begin AXIS_DESCR COM_AXIS z_ablaufvariante_has_stg void_int_S6_S3 8 0 255 DEPOSIT ABSOLUTE AXIS_PTS_REF KF_MOSTOERKPL_ANS_X /end AXIS_DESCR
 /begin AXIS_DESCR COM_AXIS status_k0_in void_int_S6_S3 6 0 255 DEPOSIT ABSOLUTE AXIS_PTS_REF KF_MOSTOERKPL_ANS_Y /end AXIS_DESCR
/end CHARACTERISTIC
/begin AXIS_PTS KF_MOSTOERKPL_ANS_X "X-Achse: z_ablaufvariante_has_stg" 0x1D5BEC z_ablaufvariante_has_stg UBYTE_X_INCR_DIRECT_S6_S3 0 void_int_S6_S3 8 0 255 DEPOSIT ABSOLUTE /end AXIS_PTS
/begin AXIS_PTS KF_MOSTOERKPL_ANS_Y "Y-Achse: status_k0_in" 0x1D8C52 status_k0_in UBYTE_X_INCR_DIRECT_S6_S3 0 void_int_S6_S3 6 0 255 DEPOSIT ABSOLUTE /end AXIS_PTS
/begin CHARACTERISTIC KF_MSOLLK0BEF_2_SAK_ZUS_W "Vorgabe des K0-Sollmoments bei angelegter K0 in Abhängigkeit des VM-Zielmoments und des maximalen dynamischen EM Moments im Zustand Schaltung aktiv beim VM Zustart" MAP 0x1D676C FLOAT32_IEEE_COL_DIRECT_S6_S3 0 trq_fl_a_S6_S3 0 100
 /begin AXIS_DESCR COM_AXIS NO_INPUT_QUANTITY trq_fl_a_S6_S3 5 -3.40282e+038 3.40282e+038 DEPOSIT ABSOLUTE AXIS_PTS_REF KF_MSOLLK0BEF_2_SAK_ZUS_X /end AXIS_DESCR
 /begin AXIS_DESCR COM_AXIS NO_INPUT_QUANTITY trq_fl_a_S6_S3 5 -3.40282e+038 3.40282e+038 DEPOSIT ABSOLUTE AXIS_PTS_REF KF_MSOLLK0BEF_2_SAK_ZUS_Y /end AXIS_DESCR
/end CHARACTERISTIC
/begin AXIS_PTS KF_MSOLLK0BEF_2_SAK_ZUS_X "Vorgabe des K0-Sollmoments bei angelegter K0 in Abhängigkeit des VM-Zielmoments und des maximalen dynamischen EM Moments im Zustand Schaltung aktiv beim VM Zustart" 0x1D67D0 NO_INPUT_QUANTITY FLOAT32_IEEE_X_INCR_DIRECT_S6_S3 0 trq_fl_a_S6_S3 5 -3.40282e+038 3.40282e+038 DEPOSIT ABSOLUTE /end AXIS_PTS
/begin AXIS_PTS KF_MSOLLK0BEF_2_SAK_ZUS_Y "Vorgabe des K0-Sollmoments bei angelegter K0 in Abhängigkeit des VM-Zielmoments und des maximalen dynamischen EM Moments im Zustand Schaltung aktiv beim VM Zustart" 0x1D67E4 NO_INPUT_QUANTITY FLOAT32_IEEE_X_INCR_DIRECT_S6_S3 0 trq_fl_a_S6_S3 5 -3.40282e+038 3.40282e+038 DEPOSIT ABSOLUTE /end AXIS_PTS
/begin CHARACTERISTIC KF_MSOLLK0BEF_2_ZST_ZUS_W "Vorgabe des K0-Sollmoments bei angelegter K0 in Abhängigkeit des VM-Zielmoments und des maximalen dynamischen EM Moments im Zustand Zustart beim VM Zustart" MAP 0x1D67F8 FLOAT32_IEEE_COL_DIRECT_S6_S3 0 trq_fl_a_S6_S3 0 100
 /begin AXIS_DESCR COM_AXIS NO_INPUT_QUANTITY trq_fl_a_S6_S3 5 -3.40282e+038 3.40282e+038 DEPOSIT ABSOLUTE AXIS_PTS_REF KF_MSOLLK0BEF_2_ZST_ZUS_X /end AXIS_DESCR
 /begin AXIS_DESCR COM_AXIS NO_INPUT_QUANTITY trq_fl_a_S6_S3 5 -3.40282e+038 3.40282e+038 DEPOSIT ABSOLUTE AXIS_PTS_REF KF_MSOLLK0BEF_2_ZST_ZUS_Y /end AXIS_DESCR
/end CHARACTERISTIC
/begin AXIS_PTS KF_MSOLLK0BEF_2_ZST_ZUS_X "Vorgabe des K0-Sollmoments bei angelegter K0 in Abhängigkeit des VM-Zielmoments und des maximalen dynamischen EM Moments im Zustand Zustart beim VM Zustart" 0x1D685C NO_INPUT_QUANTITY FLOAT32_IEEE_X_INCR_DIRECT_S6_S3 0 trq_fl_a_S6_S3 5 -3.40282e+038 3.40282e+038 DEPOSIT ABSOLUTE /end AXIS_PTS
/begin AXIS_PTS KF_MSOLLK0BEF_2_ZST_ZUS_Y "Vorgabe des K0-Sollmoments bei angelegter K0 in Abhängigkeit des VM-Zielmoments und des maximalen dynamischen EM Moments im Zustand Zustart beim VM Zustart" 0x1D6870 NO_INPUT_QUANTITY FLOAT32_IEEE_X_INCR_DIRECT_S6_S3 0 trq_fl_a_S6_S3 5 -3.40282e+038 3.40282e+038 DEPOSIT ABSOLUTE /end AXIS_PTS
/begin CHARACTERISTIC KF_MSOLLK0BEF_ABF_ZUS_W "Vorgabe des K0-Sollmoments in der Füllausgleichsphase in Abhängigkeit des VM-Zielmoments und des maximalen dynamischen EM Moments im Zustand VM Abfangen beim VM Zustart" MAP 0x1D6884 FLOAT32_IEEE_COL_DIRECT_S6_S3 0 trq_fl_a_S6_S3 0 100
 /begin AXIS_DESCR COM_AXIS NO_INPUT_QUANTITY trq_fl_a_S6_S3 5 -3.40282e+038 3.40282e+038 DEPOSIT ABSOLUTE AXIS_PTS_REF KF_MSOLLK0BEF_ABF_ZUS_X /end AXIS_DESCR
 /begin AXIS_DESCR COM_AXIS NO_INPUT_QUANTITY trq_fl_a_S6_S3 5 -3.40282e+038 3.40282e+038 DEPOSIT ABSOLUTE AXIS_PTS_REF KF_MSOLLK0BEF_ABF_ZUS_Y /end AXIS_DESCR
/end CHARACTERISTIC
/begin AXIS_PTS KF_MSOLLK0BEF_ABF_ZUS_X "Vorgabe des K0-Sollmoments in der Füllausgleichsphase in Abhängigkeit des VM-Zielmoments und des maximalen dynamischen EM Moments im Zustand VM Abfangen beim VM Zustart" 0x1D68E8 NO_INPUT_QUANTITY FLOAT32_IEEE_X_INCR_DIRECT_S6_S3 0 trq_fl_a_S6_S3 5 -3.40282e+038 3.40282e+038 DEPOSIT ABSOLUTE /end AXIS_PTS
/begin AXIS_PTS KF_MSOLLK0BEF_ABF_ZUS_Y "Vorgabe des K0-Sollmoments in der Füllausgleichsphase in Abhängigkeit des VM-Zielmoments und des maximalen dynamischen EM Moments im Zustand VM Abfangen beim VM Zustart" 0x1D68FC NO_INPUT_QUANTITY FLOAT32_IEEE_X_INCR_DIRECT_S6_S3 0 trq_fl_a_S6_S3 5 -3.40282e+038 3.40282e+038 DEPOSIT ABSOLUTE /end AXIS_PTS
/begin CHARACTERISTIC KF_MSOLLK0BEF_SAK_ZUS_W "Vorgabe des K0-Sollmoments in der Füllausgleichsphase in Abhängigkeit des VM-Zielmoments und des maximalen dynamischen EM Moments im Zustand Schaltung aktiv beim VM Zustart" MAP 0x1D699C FLOAT32_IEEE_COL_DIRECT_S6_S3 0 trq_fl_a_S6_S3 0 100
 /begin AXIS_DESCR COM_AXIS NO_INPUT_QUANTITY trq_fl_a_S6_S3 5 -3.40282e+038 3.40282e+038 DEPOSIT ABSOLUTE AXIS_PTS_REF KF_MSOLLK0BEF_SAK_ZUS_X /end AXIS_DESCR
 /begin AXIS_DESCR COM_AXIS NO_INPUT_QUANTITY trq_fl_a_S6_S3 5 -3.40282e+038 3.40282e+038 DEPOSIT ABSOLUTE AXIS_PTS_REF KF_MSOLLK0BEF_SAK_ZUS_Y /end AXIS_DESCR
/end CHARACTERISTIC
/begin AXIS_PTS KF_MSOLLK0BEF_SAK_ZUS_X "Vorgabe des K0-Sollmoments in der Füllausgleichsphase in Abhängigkeit des VM-Zielmoments und des maximalen dynamischen EM Moments im Zustand Schaltung aktiv beim VM Zustart" 0x1D6A00 NO_INPUT_QUANTITY FLOAT32_IEEE_X_INCR_DIRECT_S6_S3 0 trq_fl_a_S6_S3 5 -3.40282e+038 3.40282e+038 DEPOSIT ABSOLUTE /end AXIS_PTS
/begin AXIS_PTS KF_MSOLLK0BEF_SAK_ZUS_Y "Vorgabe des K0-Sollmoments in der Füllausgleichsphase in Abhängigkeit des VM-Zielmoments und des maximalen dynamischen EM Moments im Zustand Schaltung aktiv beim VM Zustart" 0x1D6A14 NO_INPUT_QUANTITY FLOAT32_IEEE_X_INCR_DIRECT_S6_S3 0 trq_fl_a_S6_S3 5 -3.40282e+038 3.40282e+038 DEPOSIT ABSOLUTE /end AXIS_PTS
/begin CHARACTERISTIC KF_MSOLLK0BEF_ZST_ZUS_W "Vorgabe des K0-Sollmoments in der Füllausgleichsphase in Abhängigkeit des VM-Zielmoments und des maximalen dynamischen EM Moments im Zustand Zustart beim VM Zustart" MAP 0x1D6A28 FLOAT32_IEEE_COL_DIRECT_S6_S3 0 trq_fl_a_S6_S3 0 100
 /begin AXIS_DESCR COM_AXIS NO_INPUT_QUANTITY trq_fl_a_S6_S3 5 -3.40282e+038 3.40282e+038 DEPOSIT ABSOLUTE AXIS_PTS_REF KF_MSOLLK0BEF_ZST_ZUS_X /end AXIS_DESCR
 /begin AXIS_DESCR COM_AXIS NO_INPUT_QUANTITY trq_fl_a_S6_S3 5 -3.40282e+038 3.40282e+038 DEPOSIT ABSOLUTE AXIS_PTS_REF KF_MSOLLK0BEF_ZST_ZUS_Y /end AXIS_DESCR
/end CHARACTERISTIC
/begin AXIS_PTS KF_MSOLLK0BEF_ZST_ZUS_X "Vorgabe des K0-Sollmoments in der Füllausgleichsphase in Abhängigkeit des VM-Zielmoments und des maximalen dynamischen EM Moments im Zustand Zustart beim VM Zustart" 0x1D6A8C NO_INPUT_QUANTITY FLOAT32_IEEE_X_INCR_DIRECT_S6_S3 0 trq_fl_a_S6_S3 5 -3.40282e+038 3.40282e+038 DEPOSIT ABSOLUTE /end AXIS_PTS
/begin AXIS_PTS KF_MSOLLK0BEF_ZST_ZUS_Y "Vorgabe des K0-Sollmoments in der Füllausgleichsphase in Abhängigkeit des VM-Zielmoments und des maximalen dynamischen EM Moments im Zustand Zustart beim VM Zustart" 0x1D6AA0 NO_INPUT_QUANTITY FLOAT32_IEEE_X_INCR_DIRECT_S6_S3 0 trq_fl_a_S6_S3 5 -3.40282e+038 3.40282e+038 DEPOSIT ABSOLUTE /end AXIS_PTS
/begin CHARACTERISTIC KF_NDEMNSOLLVM_ANH_ZUS_W "Differenzdrehzahl zum Abbau des Drehzahloffset auf die Basis-Drehzahl zur Berechnung des Zielwerts der VM Solldrehzahl ab dem Zustand Drehzahlanhebung und in den Zustand VM Abfangen beim Zustart" MAP 0x1D6AB4 FLOAT32_IEEE_COL_DIRECT_S6_S3 0 n_fl_S6_S3 0 10000
 /begin AXIS_DESCR COM_AXIS NO_INPUT_QUANTITY n_fl_S6_S3 10 -3.40282e+038 3.40282e+038 DEPOSIT ABSOLUTE AXIS_PTS_REF KF_NDEMNSOLLVM_ANH_ZUS_X /end AXIS_DESCR
 /begin AXIS_DESCR COM_AXIS NO_INPUT_QUANTITY trq_fl_a_S6_S3 7 -3.40282e+038 3.40282e+038 DEPOSIT ABSOLUTE AXIS_PTS_REF KF_NDEMNSOLLVM_ANH_ZUS_Y /end AXIS_DESCR
/end CHARACTERISTIC
/begin AXIS_PTS KF_NDEMNSOLLVM_ANH_ZUS_X "Differenzdrehzahl zum Abbau des Drehzahloffset auf die Basis-Drehzahl zur Berechnung des Zielwerts der VM Solldrehzahl ab dem Zustand Drehzahlanhebung und in den Zustand VM Abfangen beim Zustart" 0x1D6BCC NO_INPUT_QUANTITY FLOAT32_IEEE_X_INCR_DIRECT_S6_S3 0 n_fl_S6_S3 10 -3.40282e+038 3.40282e+038 DEPOSIT ABSOLUTE /end AXIS_PTS
/begin AXIS_PTS KF_NDEMNSOLLVM_ANH_ZUS_Y "Differenzdrehzahl zum Abbau des Drehzahloffset auf die Basis-Drehzahl zur Berechnung des Zielwerts der VM Solldrehzahl ab dem Zustand Drehzahlanhebung und in den Zustand VM Abfangen beim Zustart" 0x1D6BF4 NO_INPUT_QUANTITY FLOAT32_IEEE_X_INCR_DIRECT_S6_S3 0 trq_fl_a_S6_S3 7 -3.40282e+038 3.40282e+038 DEPOSIT ABSOLUTE /end AXIS_PTS
/begin CHARACTERISTIC KF_NGEMMODRSMAX_SYN_ZUS_W "Maximaler Gradient der modifizierten EM-Drehzahl als Basisdrehzahl zur Bestimmung der VM Solldrehzahl bei RS beim K0 Synchronisieren beim Zustart" MAP 0x1D6C10 FLOAT32_IEEE_COL_DIRECT_S6_S3 0 ng_fl_S6_S3 0 50000
 /begin AXIS_DESCR COM_AXIS NO_INPUT_QUANTITY n_fl_S6_S3 5 -3.40282e+038 3.40282e+038 DEPOSIT ABSOLUTE AXIS_PTS_REF KF_NGEMMODRSMAX_SYN_ZUS_X /end AXIS_DESCR
 /begin AXIS_DESCR COM_AXIS nd_sec_iae_syn_zus n_fl_S6_S3 4 -3.40282e+038 3.40282e+038 DEPOSIT ABSOLUTE AXIS_PTS_REF KF_NGEMMODRSMAX_SYN_ZUS_Y /end AXIS_DESCR
/end CHARACTERISTIC
/begin AXIS_PTS KF_NGEMMODRSMAX_SYN_ZUS_X "Maximaler Gradient der modifizierten EM-Drehzahl als Basisdrehzahl zur Bestimmung der VM Solldrehzahl bei RS beim K0 Synchronisieren beim Zustart" 0x1D6C60 NO_INPUT_QUANTITY FLOAT32_IEEE_X_INCR_DIRECT_S6_S3 0 n_fl_S6_S3 5 -3.40282e+038 3.40282e+038 DEPOSIT ABSOLUTE /end AXIS_PTS
/begin AXIS_PTS KF_NGEMMODRSMAX_SYN_ZUS_Y "Maximaler Gradient der modifizierten EM-Drehzahl als Basisdrehzahl zur Bestimmung der VM Solldrehzahl bei RS beim K0 Synchronisieren beim Zustart" 0x1D6C74 nd_sec_iae_syn_zus FLOAT32_IEEE_X_INCR_DIRECT_S6_S3 0 n_fl_S6_S3 4 -3.40282e+038 3.40282e+038 DEPOSIT ABSOLUTE /end AXIS_PTS
/begin CHARACTERISTIC KF_NOEMNSOLLVM_ZST_ZUS_W "Drehzahloffset auf die Basis-Drehzahl zur Berechnung des Zielwerts der VM Solldrehzahl ab dem Zustand Zustarten und in den Zuständen Schaltung aktiv und VM Abfangen beim Zustart" MAP 0x1D6C84 FLOAT32_IEEE_COL_DIRECT_S6_S3 0 n_fl_S6_S3 0 10000
 /begin AXIS_DESCR COM_AXIS NO_INPUT_QUANTITY n_fl_S6_S3 10 -3.40282e+038 3.40282e+038 DEPOSIT ABSOLUTE AXIS_PTS_REF KF_NOEMNSOLLVM_ZST_ZUS_X /end AXIS_DESCR
 /begin AXIS_DESCR COM_AXIS NO_INPUT_QUANTITY trq_fl_a_S6_S3 7 -3.40282e+038 3.40282e+038 DEPOSIT ABSOLUTE AXIS_PTS_REF KF_NOEMNSOLLVM_ZST_ZUS_Y /end AXIS_DESCR
/end CHARACTERISTIC
/begin AXIS_PTS KF_NOEMNSOLLVM_ZST_ZUS_X "Drehzahloffset auf die Basis-Drehzahl zur Berechnung des Zielwerts der VM Solldrehzahl ab dem Zustand Zustarten und in den Zuständen Schaltung aktiv und VM Abfangen beim Zustart" 0x1D6D9C NO_INPUT_QUANTITY FLOAT32_IEEE_X_INCR_DIRECT_S6_S3 0 n_fl_S6_S3 10 -3.40282e+038 3.40282e+038 DEPOSIT ABSOLUTE /end AXIS_PTS
/begin AXIS_PTS KF_NOEMNSOLLVM_ZST_ZUS_Y "Drehzahloffset auf die Basis-Drehzahl zur Berechnung des Zielwerts der VM Solldrehzahl ab dem Zustand Zustarten und in den Zuständen Schaltung aktiv und VM Abfangen beim Zustart" 0x1D6DC4 NO_INPUT_QUANTITY FLOAT32_IEEE_X_INCR_DIRECT_S6_S3 0 trq_fl_a_S6_S3 7 -3.40282e+038 3.40282e+038 DEPOSIT ABSOLUTE /end AXIS_PTS
/begin CHARACTERISTIC KF_STATUS_IAE_PLAUS_ANS_W "Bestimmung Umschaltkriterium status_iae_plausi" MAP 0x1D7E4F UBYTE_COL_DIRECT_S6_S3 0 void_int_S6_S3 0 1
 /begin AXIS_DESCR COM_AXIS status_iae_in void_int_S6_S3 9 0 255 DEPOSIT ABSOLUTE AXIS_PTS_REF KF_STATUS_IAE_PLAUS_ANS_X /end AXIS_DESCR
 /begin AXIS_DESCR COM_AXIS status_kraftfluss_egs_in void_int_S6_S3 7 0 255 DEPOSIT ABSOLUTE AXIS_PTS_REF KF_STATUS_IAE_PLAUS_ANS_Y /end AXIS_DESCR
/end CHARACTERISTIC
/begin AXIS_PTS KF_STATUS_IAE_PLAUS_ANS_X "X-Achse: status_iae_in" 0x1D7E8E status_iae_in UBYTE_X_INCR_DIRECT_S6_S3 0 void_int_S6_S3 9 0 255 DEPOSIT ABSOLUTE /end AXIS_PTS
/begin AXIS_PTS KF_STATUS_IAE_PLAUS_ANS_Y "Y-Achse: status_kraftfluss_egs_in" 0x1D7E97 status_kraftfluss_egs_in UBYTE_X_INCR_DIRECT_S6_S3 0 void_int_S6_S3 7 0 255 DEPOSIT ABSOLUTE /end AXIS_PTS
/begin CHARACTERISTIC KF_TVMSTOERK0EMFIL_ANS_W "Timerzeit zur Aktiveriung von m_stoer_k0_em_fil, begrenzt auf min. 20ms" MAP 0x1D5244 FLOAT32_IEEE_COL_DIRECT_S6_S3 0 t_fl_S6_S3 0.02 1
 /begin AXIS_DESCR COM_AXIS c_getriebe_egs_in c_int_S6_S3 8 -3.40282e+038 3.40282e+038 DEPOSIT ABSOLUTE AXIS_PTS_REF KF_TVMSTOERK0EMFIL_ANS_X /end AXIS_DESCR
 /begin AXIS_DESCR COM_AXIS NO_INPUT_QUANTITY trq_fl_a_S6_S3 8 -3.40282e+038 3.40282e+038 DEPOSIT ABSOLUTE AXIS_PTS_REF KF_TVMSTOERK0EMFIL_ANS_Y /end AXIS_DESCR
/end CHARACTERISTIC
/begin AXIS_PTS KF_TVMSTOERK0EMFIL_ANS_X "X-Achse: c_getriebe_egs_in" 0x1D5344 c_getriebe_egs_in FLOAT32_IEEE_X_INCR_DIRECT_S6_S3 0 c_int_S6_S3 8 -3.40282e+038 3.40282e+038 DEPOSIT ABSOLUTE /end AXIS_PTS
/begin AXIS_PTS KF_TVMSTOERK0EMFIL_ANS_Y "Y-Achse: m_soll_k0_has_alt" 0x1D5364 NO_INPUT_QUANTITY FLOAT32_IEEE_X_INCR_DIRECT_S6_S3 0 trq_fl_a_S6_S3 8 -3.40282e+038 3.40282e+038 DEPOSIT ABSOLUTE /end AXIS_PTS
/begin CHARACTERISTIC KF_ZMMAXABLVARNLLVM_ANS_W "Aktivierung z_mmaxiaeaktiv = f(istgang, ablaufvar)" MAP 0x1D5C58 UBYTE_COL_DIRECT_S6_S3 0 void_int_S6_S3 0 255
 /begin AXIS_DESCR COM_AXIS istgang_egs_in void_int_S6_S3 10 -128 127 DEPOSIT ABSOLUTE AXIS_PTS_REF KF_ZMMAXABLVARNLLVM_ANS_X /end AXIS_DESCR
 /begin AXIS_DESCR COM_AXIS NO_INPUT_QUANTITY void_int_S6_S3 6 0 255 DEPOSIT ABSOLUTE AXIS_PTS_REF KF_ZMMAXABLVARNLLVM_ANS_Y /end AXIS_DESCR
/end CHARACTERISTIC
/begin AXIS_PTS KF_ZMMAXABLVARNLLVM_ANS_X "X: istgang_egs_in" 0x1D8C6C istgang_egs_in SBYTE_X_INCR_DIRECT_S6_S3 0 void_int_S6_S3 10 -128 127 DEPOSIT ABSOLUTE /end AXIS_PTS
/begin AXIS_PTS KF_ZMMAXABLVARNLLVM_ANS_Y "Y: z_ablaufvariante_has_stg" 0x1D8C76 NO_INPUT_QUANTITY UBYTE_X_INCR_DIRECT_S6_S3 0 void_int_S6_S3 6 0 255 DEPOSIT ABSOLUTE /end AXIS_PTS
/begin CHARACTERISTIC KF_ZMMAXIAEISTGANGABLVAR_ANS_W "Ansteuerung IAE in Abhängigkeit der Ablaufvariante" MAP 0x1D5C94 UBYTE_COL_DIRECT_S6_S3 0 void_int_S6_S3 0 255
 /begin AXIS_DESCR COM_AXIS istgang_egs_in void_int_S6_S3 10 -128 127 DEPOSIT ABSOLUTE AXIS_PTS_REF KF_ZMMAXIAEISTGANGABLVAR_ANS_X /end AXIS_DESCR
 /begin AXIS_DESCR COM_AXIS NO_INPUT_QUANTITY void_int_S6_S3 6 0 255 DEPOSIT ABSOLUTE AXIS_PTS_REF KF_ZMMAXIAEISTGANGABLVAR_ANS_Y /end AXIS_DESCR
/end CHARACTERISTIC
/begin AXIS_PTS KF_ZMMAXIAEISTGANGABLVAR_ANS_X "X: Ansteuerung IAE in Abhängigkeit der Ablaufvariante(istgang_egs_in)" 0x1D8C7C istgang_egs_in SBYTE_X_INCR_DIRECT_S6_S3 0 void_int_S6_S3 10 -128 127 DEPOSIT ABSOLUTE /end AXIS_PTS
/begin AXIS_PTS KF_ZMMAXIAEISTGANGABLVAR_ANS_Y "Y: Ansteuerung IAE in Abhängigkeit der Ablaufvariante(z_ablaufvariante_has_stg)" 0x1D8C86 NO_INPUT_QUANTITY UBYTE_X_INCR_DIRECT_S6_S3 0 void_int_S6_S3 6 0 255 DEPOSIT ABSOLUTE /end AXIS_PTS
/begin CHARACTERISTIC KF_ZMMAXSTSIAE_ANS_W "Anforderung Entkopplung der IAE als f=(status_iae_in, status_kraftfluss_egs_in)" MAP 0x1D7EED UBYTE_COL_DIRECT_S6_S3 0 void_int_S6_S3 0 1
 /begin AXIS_DESCR COM_AXIS status_iae_in void_int_S6_S3 9 0 8 DEPOSIT ABSOLUTE AXIS_PTS_REF KF_ZMMAXSTSIAE_ANS_X /end AXIS_DESCR
 /begin AXIS_DESCR COM_AXIS status_kraftfluss_egs_in void_int_S6_S3 7 0 6 DEPOSIT ABSOLUTE AXIS_PTS_REF KF_ZMMAXSTSIAE_ANS_Y /end AXIS_DESCR
/end CHARACTERISTIC
/begin AXIS_PTS KF_ZMMAXSTSIAE_ANS_X "X-Achse: status_iae_in" 0x1D7F2C status_iae_in UBYTE_X_INCR_DIRECT_S6_S3 0 void_int_S6_S3 9 0 8 DEPOSIT ABSOLUTE /end AXIS_PTS
/begin AXIS_PTS KF_ZMMAXSTSIAE_ANS_Y "Y-Achse: status_kraftfluss_egs_in" 0x1D7F35 status_kraftfluss_egs_in UBYTE_X_INCR_DIRECT_S6_S3 0 void_int_S6_S3 7 0 6 DEPOSIT ABSOLUTE /end AXIS_PTS
/begin CHARACTERISTIC KF_ZNSOLLEM_STIAEKRAFTFL_ANS_W "Teil der Bestimmung z_n_soll_em_aktiv_has" MAP 0x1D7F3C UBYTE_COL_DIRECT_S6_S3 0 void_int_S6_S3 0 255
 /begin AXIS_DESCR COM_AXIS status_iae_in void_int_S6_S3 9 0 255 DEPOSIT ABSOLUTE AXIS_PTS_REF KF_ZNSOLLEM_STIAEKRAFTFL_ANS_X /end AXIS_DESCR
 /begin AXIS_DESCR COM_AXIS status_kraftfluss_egs_in void_int_S6_S3 7 0 255 DEPOSIT ABSOLUTE AXIS_PTS_REF KF_ZNSOLLEM_STIAEKRAFTFL_ANS_Y /end AXIS_DESCR
/end CHARACTERISTIC
/begin AXIS_PTS KF_ZNSOLLEM_STIAEKRAFTFL_ANS_X "X-Achse: stauts_iae_in" 0x1D7F7B status_iae_in UBYTE_X_INCR_DIRECT_S6_S3 0 void_int_S6_S3 9 0 255 DEPOSIT ABSOLUTE /end AXIS_PTS
/begin AXIS_PTS KF_ZNSOLLEM_STIAEKRAFTFL_ANS_Y "Y-Achse: status_kraftfluss_egs_in" 0x1D7F84 status_kraftfluss_egs_in UBYTE_X_INCR_DIRECT_S6_S3 0 void_int_S6_S3 7 0 255 DEPOSIT ABSOLUTE /end AXIS_PTS
/begin CHARACTERISTIC KF_ZSCHLEPPSCHALTABLVAR_ANS_W "z_schleppschaltaktiv_ans = f(istgang_egs_in, z_ablaufvariante_has_stg)" MAP 0x1D5CD0 UBYTE_COL_DIRECT_S6_S3 0 void_int_S6_S3 0 255
 /begin AXIS_DESCR COM_AXIS istgang_egs_in void_int_S6_S3 10 -128 127 DEPOSIT ABSOLUTE AXIS_PTS_REF KF_ZSCHLEPPSCHALTABLVAR_ANS_X /end AXIS_DESCR
 /begin AXIS_DESCR COM_AXIS z_ablaufvariante_has_stg void_int_S6_S3 6 0 255 DEPOSIT ABSOLUTE AXIS_PTS_REF KF_ZSCHLEPPSCHALTABLVAR_ANS_Y /end AXIS_DESCR
/end CHARACTERISTIC
/begin AXIS_PTS KF_ZSCHLEPPSCHALTABLVAR_ANS_X "X: istgang_egs_in" 0x1D8C8C istgang_egs_in SBYTE_X_INCR_DIRECT_S6_S3 0 void_int_S6_S3 10 -128 127 DEPOSIT ABSOLUTE /end AXIS_PTS
/begin AXIS_PTS KF_ZSCHLEPPSCHALTABLVAR_ANS_Y "Y: z_ablaufvariante_has_stg" 0x1D8C96 z_ablaufvariante_has_stg UBYTE_X_INCR_DIRECT_S6_S3 0 void_int_S6_S3 6 0 255 DEPOSIT ABSOLUTE /end AXIS_PTS
/begin CHARACTERISTIC KF_Z_MOMAXIAE_ANS_W "Wird keine Beeinflussung der IAE gewünscht, dann muss für den 
entsprechenden Zustand eine 1 eingetragen werden " MAP 0x1D7F8B UBYTE_COL_DIRECT_S6_S3 0 void_int_S6_S3 0 1
 /begin AXIS_DESCR COM_AXIS status_iae_in void_int_S6_S3 9 0 8 DEPOSIT ABSOLUTE AXIS_PTS_REF KF_Z_MOMAXIAE_ANS_X /end AXIS_DESCR
 /begin AXIS_DESCR COM_AXIS status_kraftfluss_egs_in void_int_S6_S3 7 0 6 DEPOSIT ABSOLUTE AXIS_PTS_REF KF_Z_MOMAXIAE_ANS_Y /end AXIS_DESCR
/end CHARACTERISTIC
/begin AXIS_PTS KF_Z_MOMAXIAE_ANS_X "X-Achse: status_iae_in" 0x1D7FCA status_iae_in UBYTE_X_INCR_DIRECT_S6_S3 0 void_int_S6_S3 9 0 8 DEPOSIT ABSOLUTE /end AXIS_PTS
/begin AXIS_PTS KF_Z_MOMAXIAE_ANS_Y "Y-Achse: status_kraftfluss_egs_in" 0x1D7FD3 status_kraftfluss_egs_in UBYTE_X_INCR_DIRECT_S6_S3 0 void_int_S6_S3 7 0 6 DEPOSIT ABSOLUTE /end AXIS_PTS
/begin AXIS_PTS KL_ENTKMOEGLIAESTIAEKRAFT_ANS_X "X-Achse: status_kraftfluss_egs_in" 0x1D8D96 status_kraftfluss_egs_in UBYTE_X_INCR_DIRECT_S6_S3 0 void_int_S6_S3 10 0 99 DEPOSIT ABSOLUTE /end AXIS_PTS
/begin CHARACTERISTIC KL_ENTKMOEGLIAESTIAEKRAFT_ANS_Y "Flag zur Aktivierung IAE Entkopplung moeglich" CURVE 0x1D8DA0 UBYTE_COL_DIRECT_S6_S3 0 void_int_S6_S3 0 1
 /begin AXIS_DESCR COM_AXIS status_kraftfluss_egs_in void_int_S6_S3 10 0 99 DEPOSIT ABSOLUTE AXIS_PTS_REF KL_ENTKMOEGLIAESTIAEKRAFT_ANS_X /end AXIS_DESCR
/end CHARACTERISTIC
/begin AXIS_PTS KL_FMSTOERNDZABLVAR_ANS_X "X-Achse: z_ablaufvariante" 0x1D5D2C z_ablaufvariante_has_stg UBYTE_X_INCR_DIRECT_S6_S3 0 void_int_S6_S3 8 0 99 DEPOSIT ABSOLUTE /end AXIS_PTS
/begin CHARACTERISTIC KL_FMSTOERNDZABLVAR_ANS_Y "KL_10FNDGSOLLIAE_ANS_Y" CURVE 0x1D5A14 FLOAT32_IEEE_COL_DIRECT_S6_S3 0 void_fl_S6_S3 0 8
 /begin AXIS_DESCR COM_AXIS z_ablaufvariante_has_stg void_int_S6_S3 8 0 99 DEPOSIT ABSOLUTE AXIS_PTS_REF KL_FMSTOERNDZABLVAR_ANS_X /end AXIS_DESCR
/end CHARACTERISTIC
/begin AXIS_PTS KL_IAEENTK_ISTGANG_ANS_X "X-Achse: istgang_egs_in" 0x1D8DAA istgang_egs_in SBYTE_X_INCR_DIRECT_S6_S3 0 void_int_S6_S3 10 -128 127 DEPOSIT ABSOLUTE /end AXIS_PTS
/begin CHARACTERISTIC KL_IAEENTK_ISTGANG_ANS_Y "Teil der Bestimmung z_iae_entkoppelt" CURVE 0x1D8DB4 UBYTE_COL_DIRECT_S6_S3 0 void_int_S6_S3 0 255
 /begin AXIS_DESCR COM_AXIS istgang_egs_in void_int_S6_S3 10 -128 127 DEPOSIT ABSOLUTE AXIS_PTS_REF KL_IAEENTK_ISTGANG_ANS_X /end AXIS_DESCR
/end CHARACTERISTIC
/begin AXIS_PTS KL_KSVHABBRLAUSFST_ZUS_X "Festlegung der Schaltart der von der Fahrstrategie abzubrechenden  laufenden Schaltungen in Abhängigkeit des aktuellen Zustands beim Zustart -> Bit-Codierung wie z_ablauf_shv_reset_has" 0x1D8E1C NO_INPUT_QUANTITY UWORD_X_INCR_DIRECT_S6_S3 0 void_int_b_S6_S3 7 0 65535 DEPOSIT ABSOLUTE /end AXIS_PTS
/begin CHARACTERISTIC KL_KSVHABBRLAUSFST_ZUS_Y "Festlegung der Schaltart der von der Fahrstrategie abzubrechenden  laufenden Schaltungen in Abhängigkeit des aktuellen Zustands beim Zustart -> Bit-Codierung wie z_ablauf_shv_reset_has" CURVE 0x1D8042 UBYTE_COL_DIRECT_S6_S3 0 void_int_S6_S3 0 255
 /begin AXIS_DESCR COM_AXIS NO_INPUT_QUANTITY void_int_b_S6_S3 7 0 65535 DEPOSIT ABSOLUTE AXIS_PTS_REF KL_KSVHABBRLAUSFST_ZUS_X /end AXIS_DESCR
/end CHARACTERISTIC
/begin AXIS_PTS KL_KSVHPALAUSNACHVSI_SAK_ZUS_X "Festlegung der Schaltart der zum Rest des Zustart-Ablaufs parallel laufenden Schaltungen in Abhängigkeit des Istgangs nach Verlassen Synchron Istgang im Zustand Schaltung aktiv beim Zustart -> Bit-Codierung wie z_ablauf_shv_reset_has" 0x1D7280 NO_INPUT_QUANTITY SBYTE_X_INCR_DIRECT_S6_S3 0 void_int_S6_S3 8 -1 8 DEPOSIT ABSOLUTE /end AXIS_PTS
/begin CHARACTERISTIC KL_KSVHPALAUSNACHVSI_SAK_ZUS_Y "Festlegung der Schaltart der zum Rest des Zustart-Ablaufs parallel laufenden Schaltungen in Abhängigkeit des Istgangs nach Verlassen Synchron Istgang im Zustand Schaltung aktiv beim Zustart -> Bit-Codierung wie z_ablauf_shv_reset_has" CURVE 0x1D7288 UBYTE_COL_DIRECT_S6_S3 0 void_int_S6_S3 0 255
 /begin AXIS_DESCR COM_AXIS NO_INPUT_QUANTITY void_int_S6_S3 8 -1 8 DEPOSIT ABSOLUTE AXIS_PTS_REF KL_KSVHPALAUSNACHVSI_SAK_ZUS_X /end AXIS_DESCR
/end CHARACTERISTIC
/begin AXIS_PTS KL_KSVHPALAUSVORVSI_SAK_ZUS_X "Festlegung der Schaltart der zum Rest des Zustart-Ablaufs parallel laufenden Schaltungen in Abhängigkeit des Istgangs vor Verlassen Synchron Istgang im Zustand Schaltung aktiv beim Zustart -> Bit-Codierung wie z_ablauf_shv_reset_has" 0x1D7290 NO_INPUT_QUANTITY SBYTE_X_INCR_DIRECT_S6_S3 0 void_int_S6_S3 8 -1 8 DEPOSIT ABSOLUTE /end AXIS_PTS
/begin CHARACTERISTIC KL_KSVHPALAUSVORVSI_SAK_ZUS_Y "Festlegung der Schaltart der zum Rest des Zustart-Ablaufs parallel laufenden Schaltungen in Abhängigkeit des Istgangs vor Verlassen Synchron Istgang im Zustand Schaltung aktiv beim Zustart -> Bit-Codierung wie z_ablauf_shv_reset_has" CURVE 0x1D7298 UBYTE_COL_DIRECT_S6_S3 0 void_int_S6_S3 0 255
 /begin AXIS_DESCR COM_AXIS NO_INPUT_QUANTITY void_int_S6_S3 8 -1 8 DEPOSIT ABSOLUTE AXIS_PTS_REF KL_KSVHPALAUSVORVSI_SAK_ZUS_X /end AXIS_DESCR
/end CHARACTERISTIC
/begin AXIS_PTS KL_KSVHRESETAUSZST_SAK_ZUS_X "Bedingtes Rücksetzen einer Schaltverhinderung während VM-Zustart in Abhängigkeit des Istgangs im Zustand Schaltung aktiv (255 = alle Arten von Schaltungen zurücksetzen, 0 = keine Schaltung zurücksetzen) -> Bit-Codierung siehe Handbuch" 0x1D72A0 NO_INPUT_QUANTITY SBYTE_X_INCR_DIRECT_S6_S3 0 void_int_S6_S3 8 -1 8 DEPOSIT ABSOLUTE /end AXIS_PTS
/begin CHARACTERISTIC KL_KSVHRESETAUSZST_SAK_ZUS_Y "Bedingtes Rücksetzen einer Schaltverhinderung während VM-Zustart in Abhängigkeit des Istgangs im Zustand Schaltung aktiv (255 = alle Arten von Schaltungen zurücksetzen, 0 = keine Schaltung zurücksetzen) -> Bit-Codierung siehe Handbuch" CURVE 0x1D72A8 UBYTE_COL_DIRECT_S6_S3 0 void_int_S6_S3 0 255
 /begin AXIS_DESCR COM_AXIS NO_INPUT_QUANTITY void_int_S6_S3 8 -1 8 DEPOSIT ABSOLUTE AXIS_PTS_REF KL_KSVHRESETAUSZST_SAK_ZUS_X /end AXIS_DESCR
/end CHARACTERISTIC
/begin AXIS_PTS KL_KSVHRESETNACHVSI_SAK_ZUS_X "Ruecksetzen einer Schaltverhinderung in Abhängigkeit des Istgangs nach Verlassen Synchron Istgang im Zustand Schaltung aktiv beim Zustart (255 = alle Arten von Schaltungen zuruecksetzen, 0 = keine Schaltung zuruecksetzen) -> Bit-Codierung siehe Handbuch" 0x1D72B0 NO_INPUT_QUANTITY SBYTE_X_INCR_DIRECT_S6_S3 0 void_int_S6_S3 8 -1 8 DEPOSIT ABSOLUTE /end AXIS_PTS
/begin CHARACTERISTIC KL_KSVHRESETNACHVSI_SAK_ZUS_Y "Ruecksetzen einer Schaltverhinderung in Abhängigkeit des Istgangs nach Verlassen Synchron Istgang im Zustand Schaltung aktiv beim Zustart (255 = alle Arten von Schaltungen zuruecksetzen, 0 = keine Schaltung zuruecksetzen) -> Bit-Codierung siehe Handbuch" CURVE 0x1D72B8 UBYTE_COL_DIRECT_S6_S3 0 void_int_S6_S3 0 255
 /begin AXIS_DESCR COM_AXIS NO_INPUT_QUANTITY void_int_S6_S3 8 -1 8 DEPOSIT ABSOLUTE AXIS_PTS_REF KL_KSVHRESETNACHVSI_SAK_ZUS_X /end AXIS_DESCR
/end CHARACTERISTIC
/begin AXIS_PTS KL_KSVHRESETVORVSI_SAK_ZUS_X "Ruecksetzen einer Schaltverhinderung in Abhängigkeit des Istgangs vor Verlassen Synchron Istgang im Zustand Schaltung aktiv beim Zustart (255 = alle Arten von Schaltungen zuruecksetzen, 0 = keine Schaltung zuruecksetzen) -> Bit-Codierung siehe Handbuch" 0x1D72C0 NO_INPUT_QUANTITY SBYTE_X_INCR_DIRECT_S6_S3 0 void_int_S6_S3 8 -1 8 DEPOSIT ABSOLUTE /end AXIS_PTS
/begin CHARACTERISTIC KL_KSVHRESETVORVSI_SAK_ZUS_Y "Ruecksetzen einer Schaltverhinderung in Abhängigkeit des Istgangs vor Verlassen Synchron Istgang im Zustand Schaltung aktiv beim Zustart (255 = alle Arten von Schaltungen zuruecksetzen, 0 = keine Schaltung zuruecksetzen) -> Bit-Codierung siehe Handbuch" CURVE 0x1D72C8 UBYTE_COL_DIRECT_S6_S3 0 void_int_S6_S3 0 255
 /begin AXIS_DESCR COM_AXIS NO_INPUT_QUANTITY void_int_S6_S3 8 -1 8 DEPOSIT ABSOLUTE AXIS_PTS_REF KL_KSVHRESETVORVSI_SAK_ZUS_X /end AXIS_DESCR
/end CHARACTERISTIC
/begin AXIS_PTS KL_KSVHRESET_ABF_ZUS_X "Ruecksetzen einer Schaltverhinderung in Abhängigkeit des Istgangs im Zustand VM-Abfangen beim Zustart (255 = alle Arten von Schaltungen zuruecksetzen, 0 = keine Schaltung zuruecksetzen) -> Bit-Codierung siehe Handbuch" 0x1D72D0 NO_INPUT_QUANTITY SBYTE_X_INCR_DIRECT_S6_S3 0 void_int_S6_S3 8 -1 8 DEPOSIT ABSOLUTE /end AXIS_PTS
/begin CHARACTERISTIC KL_KSVHRESET_ABF_ZUS_Y "Ruecksetzen einer Schaltverhinderung in Abhängigkeit des Istgangs im Zustand VM-Abfangen beim Zustart (255 = alle Arten von Schaltungen zuruecksetzen, 0 = keine Schaltung zuruecksetzen) -> Bit-Codierung siehe Handbuch" CURVE 0x1D72D8 UBYTE_COL_DIRECT_S6_S3 0 void_int_S6_S3 0 255
 /begin AXIS_DESCR COM_AXIS NO_INPUT_QUANTITY void_int_S6_S3 8 -1 8 DEPOSIT ABSOLUTE AXIS_PTS_REF KL_KSVHRESET_ABF_ZUS_X /end AXIS_DESCR
/end CHARACTERISTIC
/begin AXIS_PTS KL_KSVHRESET_SCL_ZUS_X "Ruecksetzen einer Schaltverhinderung in Abhängigkeit des Istgangs im Zustand K0-Schliessen beim Zustart (255 = alle Arten von Schaltungen zuruecksetzen, 0 = keine Schaltung zuruecksetzen) -> Bit-Codierung siehe Handbuch" 0x1D72F0 NO_INPUT_QUANTITY SBYTE_X_INCR_DIRECT_S6_S3 0 void_int_S6_S3 8 -1 8 DEPOSIT ABSOLUTE /end AXIS_PTS
/begin CHARACTERISTIC KL_KSVHRESET_SCL_ZUS_Y "Ruecksetzen einer Schaltverhinderung in Abhängigkeit des Istgangs im Zustand K0-Schliessen beim Zustart (255 = alle Arten von Schaltungen zuruecksetzen, 0 = keine Schaltung zuruecksetzen) -> Bit-Codierung siehe Handbuch" CURVE 0x1D72F8 UBYTE_COL_DIRECT_S6_S3 0 void_int_S6_S3 0 255
 /begin AXIS_DESCR COM_AXIS NO_INPUT_QUANTITY void_int_S6_S3 8 -1 8 DEPOSIT ABSOLUTE AXIS_PTS_REF KL_KSVHRESET_SCL_ZUS_X /end AXIS_DESCR
/end CHARACTERISTIC
/begin AXIS_PTS KL_KSVHRESET_SYN_ZUS_X "Ruecksetzen einer Schaltverhinderung in Abhängigkeit des Istgangs im Zustand K0-Synchronisieren beim Zustart (255 = alle Arten von Schaltungen zuruecksetzen, 0 = keine Schaltung zuruecksetzen) -> Bit-Codierung siehe Handbuch" 0x1D7300 NO_INPUT_QUANTITY SBYTE_X_INCR_DIRECT_S6_S3 0 void_int_S6_S3 8 -1 8 DEPOSIT ABSOLUTE /end AXIS_PTS
/begin CHARACTERISTIC KL_KSVHRESET_SYN_ZUS_Y "Ruecksetzen einer Schaltverhinderung in Abhängigkeit des Istgangs im Zustand K0-Synchronisieren beim Zustart (255 = alle Arten von Schaltungen zuruecksetzen, 0 = keine Schaltung zuruecksetzen) -> Bit-Codierung siehe Handbuch" CURVE 0x1D7308 UBYTE_COL_DIRECT_S6_S3 0 void_int_S6_S3 0 255
 /begin AXIS_DESCR COM_AXIS NO_INPUT_QUANTITY void_int_S6_S3 8 -1 8 DEPOSIT ABSOLUTE AXIS_PTS_REF KL_KSVHRESET_SYN_ZUS_X /end AXIS_DESCR
/end CHARACTERISTIC
/begin AXIS_PTS KL_KSVHRESET_ZST_ZUS_X "Ruecksetzen einer Schaltverhinderung in Abhängigkeit des Istgangs im Zustand Zustarten beim Zustart (255 = alle Arten von Schaltungen zuruecksetzen, 0 = keine Schaltung zuruecksetzen) -> Bit-Codierung siehe Handbuch" 0x1D7310 NO_INPUT_QUANTITY SBYTE_X_INCR_DIRECT_S6_S3 0 void_int_S6_S3 8 -1 8 DEPOSIT ABSOLUTE /end AXIS_PTS
/begin CHARACTERISTIC KL_KSVHRESET_ZST_ZUS_Y "Ruecksetzen einer Schaltverhinderung in Abhängigkeit des Istgangs im Zustand Zustarten beim Zustart (255 = alle Arten von Schaltungen zuruecksetzen, 0 = keine Schaltung zuruecksetzen) -> Bit-Codierung siehe Handbuch" CURVE 0x1D7318 UBYTE_COL_DIRECT_S6_S3 0 void_int_S6_S3 0 255
 /begin AXIS_DESCR COM_AXIS NO_INPUT_QUANTITY void_int_S6_S3 8 -1 8 DEPOSIT ABSOLUTE AXIS_PTS_REF KL_KSVHRESET_ZST_ZUS_X /end AXIS_DESCR
/end CHARACTERISTIC
/begin AXIS_PTS KL_MGK0MODHASMAX_SCL_ZUS_X "Maximaler Gradienten des modifizierten K0-Moments der HAS in Anhängigkeit des VM-Zielmoments im Zustand K0-Schliessen beim Zustart" 0x1D6DE0 NO_INPUT_QUANTITY FLOAT32_IEEE_X_INCR_DIRECT_S6_S3 0 trq_fl_a_S6_S3 6 -3.40282e+038 3.40282e+038 DEPOSIT ABSOLUTE /end AXIS_PTS
/begin CHARACTERISTIC KL_MGK0MODHASMAX_SCL_ZUS_Y "Maximaler Gradienten des modifizierten K0-Moments der HAS in Anhängigkeit des VM-Zielmoments im Zustand K0-Schliessen beim Zustart" CURVE 0x1D6DF8 FLOAT32_IEEE_COL_DIRECT_S6_S3 0 trqg_fl_c_S6_S3 0 50000
 /begin AXIS_DESCR COM_AXIS NO_INPUT_QUANTITY trq_fl_a_S6_S3 6 -3.40282e+038 3.40282e+038 DEPOSIT ABSOLUTE AXIS_PTS_REF KL_MGK0MODHASMAX_SCL_ZUS_X /end AXIS_DESCR
/end CHARACTERISTIC
/begin AXIS_PTS KL_MGK0MODMAXMAX_SYN_ZUS_X "Maximaler Gradienten des Maximalwerts des modifizierten K0-Moments der HAS in Abhängigkeit des Gradienten des K0 Sollmoments im Zustand K0-Synchronisieren beim Zustart" 0x1D6E10 mg_soll_k0_syn_zus FLOAT32_IEEE_X_INCR_DIRECT_S6_S3 0 trqg_fl_c_S6_S3 6 -3.40282e+038 3.40282e+038 DEPOSIT ABSOLUTE /end AXIS_PTS
/begin CHARACTERISTIC KL_MGK0MODMAXMAX_SYN_ZUS_Y "Maximaler Gradienten des Maximalwerts des modifizierten K0-Moments der HAS in Abhängigkeit des Gradienten des K0 Sollmoments im Zustand K0-Synchronisieren beim Zustart" CURVE 0x1D6E28 FLOAT32_IEEE_COL_DIRECT_S6_S3 0 trqg_fl_c_S6_S3 0 50000
 /begin AXIS_DESCR COM_AXIS mg_soll_k0_syn_zus trqg_fl_c_S6_S3 6 -3.40282e+038 3.40282e+038 DEPOSIT ABSOLUTE AXIS_PTS_REF KL_MGK0MODMAXMAX_SYN_ZUS_X /end AXIS_DESCR
/end CHARACTERISTIC
/begin AXIS_PTS KL_MGSOLLK0HASMAX_SCL_ZUS_X "Maximaler Gradienten des K0-Sollmoments der HAS in Anhängigkeit des VM-Zielmoments im Zustand K0-Schliessen beim Zustart" 0x1D6E40 NO_INPUT_QUANTITY FLOAT32_IEEE_X_INCR_DIRECT_S6_S3 0 trq_fl_a_S6_S3 6 -3.40282e+038 3.40282e+038 DEPOSIT ABSOLUTE /end AXIS_PTS
/begin CHARACTERISTIC KL_MGSOLLK0HASMAX_SCL_ZUS_Y "Maximaler Gradienten des K0-Sollmoments der HAS in Anhängigkeit des VM-Zielmoments im Zustand K0-Schliessen beim Zustart" CURVE 0x1D6E58 FLOAT32_IEEE_COL_DIRECT_S6_S3 0 trqg_fl_c_S6_S3 0 50000
 /begin AXIS_DESCR COM_AXIS NO_INPUT_QUANTITY trq_fl_a_S6_S3 6 -3.40282e+038 3.40282e+038 DEPOSIT ABSOLUTE AXIS_PTS_REF KL_MGSOLLK0HASMAX_SCL_ZUS_X /end AXIS_DESCR
/end CHARACTERISTIC
/begin AXIS_PTS KL_MGSOLLK0SUS_SYN_ZUS_X "Gradienten zur Anhebung des K0-Sollmoments der Funktion zur Synchronisationsunterstützung (SUS) in Anhängigkeit des VM-Zielmoments im Zustand K0-Synchronisieren beim Zustart" 0x1D6E70 NO_INPUT_QUANTITY FLOAT32_IEEE_X_INCR_DIRECT_S6_S3 0 trq_fl_a_S6_S3 8 -3.40282e+038 3.40282e+038 DEPOSIT ABSOLUTE /end AXIS_PTS
/begin CHARACTERISTIC KL_MGSOLLK0SUS_SYN_ZUS_Y "Maximaler Gradienten des K0-Sollmoments der HAS in Anhängigkeit des VM-Zielmoments im Zustand K0-Schliessen beim Zustart" CURVE 0x1D6E90 FLOAT32_IEEE_COL_DIRECT_S6_S3 0 trqg_fl_c_S6_S3 0 50000
 /begin AXIS_DESCR COM_AXIS NO_INPUT_QUANTITY trq_fl_a_S6_S3 8 -3.40282e+038 3.40282e+038 DEPOSIT ABSOLUTE AXIS_PTS_REF KL_MGSOLLK0SUS_SYN_ZUS_X /end AXIS_DESCR
/end CHARACTERISTIC
/begin AXIS_PTS KL_MK0MODK0BEF_ZUS_X "Modifiziertes K0-Moment der HAS in Abhängigkeit des K0 Istmoments in den Zustaenden der K0-Befüllung ZST, SAK, ANH, ABF beim Zustart" 0x1D6EB0 NO_INPUT_QUANTITY FLOAT32_IEEE_X_INCR_DIRECT_S6_S3 0 trq_fl_a_S6_S3 6 -3.40282e+038 3.40282e+038 DEPOSIT ABSOLUTE /end AXIS_PTS
/begin CHARACTERISTIC KL_MK0MODK0BEF_ZUS_Y "Modifiziertes K0-Moment der HAS in Abhängigkeit des K0 Istmoments in den Zustaenden der K0-Befüllung ZST, SAK, ANH, ABF beim Zustart" CURVE 0x1D6EC8 FLOAT32_IEEE_COL_DIRECT_S6_S3 0 trq_fl_a_S6_S3 0 1000
 /begin AXIS_DESCR COM_AXIS NO_INPUT_QUANTITY trq_fl_a_S6_S3 6 -3.40282e+038 3.40282e+038 DEPOSIT ABSOLUTE AXIS_PTS_REF KL_MK0MODK0BEF_ZUS_X /end AXIS_DESCR
/end CHARACTERISTIC
/begin AXIS_PTS KL_MK0MODUVS_ZST_ZUS_X "Modifiziertes K0-Moment der HAS bei Anforderung einer K0-Unterstützung des VM Startsystems durch die HAS Zustandssteuerung (OML) in Abhängigkeit des K0 Istmoments im Zustand Zustart beim VM Zustart" 0x1D6EE0 NO_INPUT_QUANTITY FLOAT32_IEEE_X_INCR_DIRECT_S6_S3 0 trq_fl_a_S6_S3 6 -3.40282e+038 3.40282e+038 DEPOSIT ABSOLUTE /end AXIS_PTS
/begin CHARACTERISTIC KL_MK0MODUVS_ZST_ZUS_Y "Modifiziertes K0-Moment der HAS bei Anforderung einer K0-Unterstützung des VM Startsystems durch die HAS Zustandssteuerung (OML) in Abhängigkeit des K0 Istmoments im Zustand Zustart beim VM Zustart" CURVE 0x1D6EF8 FLOAT32_IEEE_COL_DIRECT_S6_S3 0 trq_fl_a_S6_S3 0 1000
 /begin AXIS_DESCR COM_AXIS NO_INPUT_QUANTITY trq_fl_a_S6_S3 6 -3.40282e+038 3.40282e+038 DEPOSIT ABSOLUTE AXIS_PTS_REF KL_MK0MODUVS_ZST_ZUS_X /end AXIS_DESCR
/end CHARACTERISTIC
/begin AXIS_PTS KL_MK0ZIEL_ABF_ZUS_X "Zielwert des K0-Moments zum Abfangen des VM bei einem Abbruch VM Abstellen im Zustand VM Abfangen beim Zustart in Abhängigkeit des VM Minimalmoments" 0x1D6F10 NO_INPUT_QUANTITY FLOAT32_IEEE_X_INCR_DIRECT_S6_S3 0 trq_fl_a_S6_S3 6 -3.40282e+038 3.40282e+038 DEPOSIT ABSOLUTE /end AXIS_PTS
/begin CHARACTERISTIC KL_MK0ZIEL_ABF_ZUS_Y "Zielwert des K0-Moments zum Abfangen des VM bei einem Abbruch VM Abstellen im Zustand VM Abfangen beim Zustart in Abhängigkeit des VM Minimalmoments" CURVE 0x1D6F28 FLOAT32_IEEE_COL_DIRECT_S6_S3 0 trq_fl_a_S6_S3 -1000 1000
 /begin AXIS_DESCR COM_AXIS NO_INPUT_QUANTITY trq_fl_a_S6_S3 6 -3.40282e+038 3.40282e+038 DEPOSIT ABSOLUTE AXIS_PTS_REF KL_MK0ZIEL_ABF_ZUS_X /end AXIS_DESCR
/end CHARACTERISTIC
/begin AXIS_PTS KL_MOZIELK0ZMANHMAX_SYN_ZUS_X "Festlegung des Maximalwerts der K0-Drehmomentoffsets  der Zusatzdrehmomentanhebung im Zustand K0 Synchronisieren beim Zustart in Abhängigkeit  der maximal möglichen EM-Drehmomentabsenkung" 0x1D6F40 NO_INPUT_QUANTITY FLOAT32_IEEE_X_INCR_DIRECT_S6_S3 0 trq_fl_a_S6_S3 4 -3.40282e+038 3.40282e+038 DEPOSIT ABSOLUTE /end AXIS_PTS
/begin CHARACTERISTIC KL_MOZIELK0ZMANHMAX_SYN_ZUS_Y "Festlegung des Maximalwerts der K0-Drehmomentoffsets  der Zusatzdrehmomentanhebung im Zustand K0 Synchronisieren beim Zustart in Abhängigkeit  der maximal möglichen EM-Drehmomentabsenkung" CURVE 0x1D6F50 FLOAT32_IEEE_COL_DIRECT_S6_S3 0 trq_fl_a_S6_S3 0 1000
 /begin AXIS_DESCR COM_AXIS NO_INPUT_QUANTITY trq_fl_a_S6_S3 4 -3.40282e+038 3.40282e+038 DEPOSIT ABSOLUTE AXIS_PTS_REF KL_MOZIELK0ZMANHMAX_SYN_ZUS_X /end AXIS_DESCR
/end CHARACTERISTIC
/begin AXIS_PTS KL_MOZIELK0ZMANH_SYN_ZUS_X "Festlegung des K0-Drehmomentoffsets  zur Bestimmung des K0-Zielmoments der Zusatzdrehmomentanhebung im Zustand K0 Synchronisieren beim Zustart in Abhängigkeit  des VM-Zielmoments" 0x1D6F60 NO_INPUT_QUANTITY FLOAT32_IEEE_X_INCR_DIRECT_S6_S3 0 trq_fl_a_S6_S3 8 -3.40282e+038 3.40282e+038 DEPOSIT ABSOLUTE /end AXIS_PTS
/begin CHARACTERISTIC KL_MOZIELK0ZMANH_SYN_ZUS_Y "Festlegung des K0-Drehmomentoffsets  zur Bestimmung des K0-Zielmoments der Zusatzdrehmomentanhebung im Zustand K0 Synchronisieren beim Zustart in Abhängigkeit  des VM-Zielmoments" CURVE 0x1D6F80 FLOAT32_IEEE_COL_DIRECT_S6_S3 0 trq_fl_a_S6_S3 -1000 1000
 /begin AXIS_DESCR COM_AXIS NO_INPUT_QUANTITY trq_fl_a_S6_S3 8 -3.40282e+038 3.40282e+038 DEPOSIT ABSOLUTE AXIS_PTS_REF KL_MOZIELK0ZMANH_SYN_ZUS_X /end AXIS_DESCR
/end CHARACTERISTIC
/begin AXIS_PTS KL_MSOLLK0MIN_SYN_ZUS_X "Minimalwert zur Initialisierung des K0-Sollmoments in Anhängigkeit des VM-Zielmoments im Zustand K0 Synchronisieren beim Zustart" 0x1D7020 NO_INPUT_QUANTITY FLOAT32_IEEE_X_INCR_DIRECT_S6_S3 0 trq_fl_a_S6_S3 5 0 1000 DEPOSIT ABSOLUTE /end AXIS_PTS
/begin CHARACTERISTIC KL_MSOLLK0MIN_SYN_ZUS_Y "Minimalwert zur Initialisierung des K0-Sollmoments in Anhängigkeit des VM-Zielmoments im Zustand K0 Synchronisieren beim Zustart" CURVE 0x1D7034 FLOAT32_IEEE_COL_DIRECT_S6_S3 0 trq_fl_a_S6_S3 0 100
 /begin AXIS_DESCR COM_AXIS NO_INPUT_QUANTITY trq_fl_a_S6_S3 5 0 1000 DEPOSIT ABSOLUTE AXIS_PTS_REF KL_MSOLLK0MIN_SYN_ZUS_X /end AXIS_DESCR
/end CHARACTERISTIC
/begin AXIS_PTS KL_MSSOLLEMAKTIVSTKRAFTFL_ANS_X "X-Achse: status_kraftfluss_egs_in" 0x1D8DBE NO_INPUT_QUANTITY UBYTE_X_INCR_DIRECT_S6_S3 0 void_int_S6_S3 10 0 99 DEPOSIT ABSOLUTE /end AXIS_PTS
/begin CHARACTERISTIC KL_MSSOLLEMAKTIVSTKRAFTFL_ANS_Y "Flag zur Deaktivierung des Timers für mstoerk0em" CURVE 0x1D8DC8 UBYTE_COL_DIRECT_S6_S3 0 void_int_S6_S3 0 1
 /begin AXIS_DESCR COM_AXIS NO_INPUT_QUANTITY void_int_S6_S3 10 0 99 DEPOSIT ABSOLUTE AXIS_PTS_REF KL_MSSOLLEMAKTIVSTKRAFTFL_ANS_X /end AXIS_DESCR
/end CHARACTERISTIC
/begin AXIS_PTS KL_MSSOLLEMAKTIV_ANS_X "X-Achse: istgang_egs_in" 0x1D8DD2 NO_INPUT_QUANTITY SBYTE_X_INCR_DIRECT_S6_S3 0 void_int_S6_S3 10 -1 10 DEPOSIT ABSOLUTE /end AXIS_PTS
/begin CHARACTERISTIC KL_MSSOLLEMAKTIV_ANS_Y "Momentschwelle für Aktiveriung EM-Sollmomentüberwachung" CURVE 0x1D5AC4 FLOAT32_IEEE_COL_DIRECT_S6_S3 0 trq_fl_a_S6_S3 -3.40282e+038 3.40282e+038
 /begin AXIS_DESCR COM_AXIS NO_INPUT_QUANTITY void_int_S6_S3 10 -1 10 DEPOSIT ABSOLUTE AXIS_PTS_REF KL_MSSOLLEMAKTIV_ANS_X /end AXIS_DESCR
/end CHARACTERISTIC
/begin AXIS_PTS KL_MVMVOLLASTSAUG_SYN_ZUS_X "Maximales Saug-Vollastmoment des VM zur Begrenzung des K0-Sollmoments im Zustand K0 Synchronisieren beim Zustart in Abhängigkeit der VM Drehzahl" 0x1D7070 NO_INPUT_QUANTITY FLOAT32_IEEE_X_INCR_DIRECT_S6_S3 0 n_fl_S6_S3 10 -3.40282e+038 3.40282e+038 DEPOSIT ABSOLUTE /end AXIS_PTS
/begin CHARACTERISTIC KL_MVMVOLLASTSAUG_SYN_ZUS_Y "Maximales Saug-Vollastmoment des VM zur Begrenzung des K0-Sollmoments im Zustand K0 Synchronisieren beim Zustart in Abhängigkeit der VM Drehzahl" CURVE 0x1D7098 FLOAT32_IEEE_COL_DIRECT_S6_S3 0 trq_fl_a_S6_S3 0 1000
 /begin AXIS_DESCR COM_AXIS NO_INPUT_QUANTITY n_fl_S6_S3 10 -3.40282e+038 3.40282e+038 DEPOSIT ABSOLUTE AXIS_PTS_REF KL_MVMVOLLASTSAUG_SYN_ZUS_X /end AXIS_DESCR
/end CHARACTERISTIC
/begin AXIS_PTS KL_MZIELK0MIN_SYN_ZUS_X "Festlegung des minimalen K0-Zielmoments zur Bestimmung des K0 Sollmoments im Zustand K0 Synchronisieren beim Zustart in Abhängigkeit  des VM-Zielmoments" 0x1D70C0 NO_INPUT_QUANTITY FLOAT32_IEEE_X_INCR_DIRECT_S6_S3 0 trq_fl_a_S6_S3 8 -3.40282e+038 3.40282e+038 DEPOSIT ABSOLUTE /end AXIS_PTS
/begin CHARACTERISTIC KL_MZIELK0MIN_SYN_ZUS_Y "Festlegung des minimalen K0-Zielmoments zur Bestimmung des K0 Sollmoments im Zustand K0 Synchronisieren beim Zustart in Abhängigkeit  des VM-Zielmoments" CURVE 0x1D70E0 FLOAT32_IEEE_COL_DIRECT_S6_S3 0 trq_fl_a_S6_S3 0 1000
 /begin AXIS_DESCR COM_AXIS NO_INPUT_QUANTITY trq_fl_a_S6_S3 8 -3.40282e+038 3.40282e+038 DEPOSIT ABSOLUTE AXIS_PTS_REF KL_MZIELK0MIN_SYN_ZUS_X /end AXIS_DESCR
/end CHARACTERISTIC
/begin AXIS_PTS KL_NDSK0K0SREG_SYN_ZUS_X "K0-Differenzdrehzahlschwelle zur Bestimmung des Zeitpunkts der Anforderung der Aktivierung der K0-Schlupfregelung in Abhängigkeit des K0 Sollmoments im Zustand K0 Synchronisieren beim Zustart" 0x1D7150 NO_INPUT_QUANTITY FLOAT32_IEEE_X_INCR_DIRECT_S6_S3 0 trq_fl_a_S6_S3 5 -3.40282e+038 3.40282e+038 DEPOSIT ABSOLUTE /end AXIS_PTS
/begin CHARACTERISTIC KL_NDSK0K0SREG_SYN_ZUS_Y "K0-Differenzdrehzahlschwelle zur Bestimmung des Zeitpunkts der Anforderung der Aktivierung der K0-Schlupfregelung in Abhängigkeit des K0 Sollmoments im Zustand K0 Synchronisieren beim Zustart" CURVE 0x1D7164 FLOAT32_IEEE_COL_DIRECT_S6_S3 0 n_fl_S6_S3 0 10000
 /begin AXIS_DESCR COM_AXIS NO_INPUT_QUANTITY trq_fl_a_S6_S3 5 -3.40282e+038 3.40282e+038 DEPOSIT ABSOLUTE AXIS_PTS_REF KL_NDSK0K0SREG_SYN_ZUS_X /end AXIS_DESCR
/end CHARACTERISTIC
/begin AXIS_PTS KL_NDSK0SYNCERK_SYN_ZUS_X "Schwellwert zur Erkennung Synchron beim VM-Zustart in Abhängigkeit des EM-Drehzahlgradienten " 0x1D71C8 NO_INPUT_QUANTITY FLOAT32_IEEE_X_INCR_DIRECT_S6_S3 0 ng_fl_S6_S3 5 -3.40282e+038 3.40282e+038 DEPOSIT ABSOLUTE /end AXIS_PTS
/begin CHARACTERISTIC KL_NDSK0SYNCERK_SYN_ZUS_Y "Schwellwert zur Erkennung Synchron beim VM-Zustart in Abhängigkeit des EM-Drehzahlgradienten " CURVE 0x1D71DC FLOAT32_IEEE_COL_DIRECT_S6_S3 0 n_fl_S6_S3 0 10000
 /begin AXIS_DESCR COM_AXIS NO_INPUT_QUANTITY ng_fl_S6_S3 5 -3.40282e+038 3.40282e+038 DEPOSIT ABSOLUTE AXIS_PTS_REF KL_NDSK0SYNCERK_SYN_ZUS_X /end AXIS_DESCR
/end CHARACTERISTIC
/begin AXIS_PTS KL_NDZIELK0K0SREG_SYN_ZUS_X "K0-Zieldifferenzdrehzahl zur Bestimmung der VM-Solldrehzahl bei der Aktivierung der K0-Schlupfregelung in Abhängigkeit des K0 Sollmoments im Zustand K0 Synchronisieren beim Zustart" 0x1D71F0 NO_INPUT_QUANTITY FLOAT32_IEEE_X_INCR_DIRECT_S6_S3 0 trq_fl_a_S6_S3 5 -3.40282e+038 3.40282e+038 DEPOSIT ABSOLUTE /end AXIS_PTS
/begin CHARACTERISTIC KL_NDZIELK0K0SREG_SYN_ZUS_Y "K0-Zieldifferenzdrehzahl zur Bestimmung der VM-Solldrehzahl bei der Aktivierung der K0-Schlupfregelung in Abhängigkeit des K0 Sollmoments im Zustand K0 Synchronisieren beim Zustart" CURVE 0x1D7204 FLOAT32_IEEE_COL_DIRECT_S6_S3 0 n_fl_S6_S3 0 10000
 /begin AXIS_DESCR COM_AXIS NO_INPUT_QUANTITY trq_fl_a_S6_S3 5 -3.40282e+038 3.40282e+038 DEPOSIT ABSOLUTE AXIS_PTS_REF KL_NDZIELK0K0SREG_SYN_ZUS_X /end AXIS_DESCR
/end CHARACTERISTIC
/begin AXIS_PTS KL_SCHALTARTK0BEFVERZ_SAK_ZUS_X "Festlegung der Schaltart der Schaltungen die zu einer Verzoegerung der K0-Befuellung im führen in Abhängigkeit des Istgangs im Zustand Schaltung aktiv beim Zustart -> Bit-Codierung wie z_ablauf_shv_reset_has" 0x1D7320 NO_INPUT_QUANTITY SBYTE_X_INCR_DIRECT_S6_S3 0 void_int_S6_S3 8 -1 8 DEPOSIT ABSOLUTE /end AXIS_PTS
/begin CHARACTERISTIC KL_SCHALTARTK0BEFVERZ_SAK_ZUS_Y "Festlegung der Schaltart der Schaltungen die zu einer Verzoegerung der K0-Befuellung im führen in Abhängigkeit des Istgangs im Zustand Schaltung aktiv beim Zustart -> Bit-Codierung wie z_ablauf_shv_reset_has" CURVE 0x1D7328 UBYTE_COL_DIRECT_S6_S3 0 void_int_S6_S3 0 255
 /begin AXIS_DESCR COM_AXIS NO_INPUT_QUANTITY void_int_S6_S3 8 -1 8 DEPOSIT ABSOLUTE AXIS_PTS_REF KL_SCHALTARTK0BEFVERZ_SAK_ZUS_X /end AXIS_DESCR
/end CHARACTERISTIC
/begin AXIS_PTS KL_SVHSTKRAFTFLUSS_ANS_X "X-Achse: status_kraftfluss_egs_in" 0x1D8DDC NO_INPUT_QUANTITY UBYTE_X_INCR_DIRECT_S6_S3 0 void_int_S6_S3 10 0 255 DEPOSIT ABSOLUTE /end AXIS_PTS
/begin CHARACTERISTIC KL_SVHSTKRAFTFLUSS_ANS_Y "Mod. z_ablauf_svh_reset_has = f(status_kraftfluss_egs)" CURVE 0x1D8DE6 UBYTE_COL_DIRECT_S6_S3 0 void_int_S6_S3 0 255
 /begin AXIS_DESCR COM_AXIS NO_INPUT_QUANTITY void_int_S6_S3 10 0 255 DEPOSIT ABSOLUTE AXIS_PTS_REF KL_SVHSTKRAFTFLUSS_ANS_X /end AXIS_DESCR
/end CHARACTERISTIC
/begin AXIS_PTS KL_TK0SYNCERKUMS_SYN_ZUS_X "Zeit bis zur Umschaltung der Differenzdrehzahlschwelle zur Erkennung Synchron beim VM-Zustart in Abhängigkeit des VM-Zielmoments" 0x1D7218 NO_INPUT_QUANTITY FLOAT32_IEEE_X_INCR_DIRECT_S6_S3 0 trq_fl_a_S6_S3 5 -3.40282e+038 3.40282e+038 DEPOSIT ABSOLUTE /end AXIS_PTS
/begin CHARACTERISTIC KL_TK0SYNCERKUMS_SYN_ZUS_Y "Zeit bis zur Umschaltung der Differenzdrehzahlschwelle zur Erkennung Synchron beim VM-Zustart in Abhängigkeit des VM-Zielmoments" CURVE 0x1D722C FLOAT32_IEEE_COL_DIRECT_S6_S3 0 t_fl_S6_S3 0 10
 /begin AXIS_DESCR COM_AXIS NO_INPUT_QUANTITY trq_fl_a_S6_S3 5 -3.40282e+038 3.40282e+038 DEPOSIT ABSOLUTE AXIS_PTS_REF KL_TK0SYNCERKUMS_SYN_ZUS_X /end AXIS_DESCR
/end CHARACTERISTIC
/begin AXIS_PTS KL_TMAXIAEOEFCGETR_ANS_X "X-Achse: c_getriebe_egs_in" 0x1D5B3C c_getriebe_egs_in FLOAT32_IEEE_X_INCR_DIRECT_S6_S3 0 c_int_S6_S3 8 -40 140 DEPOSIT ABSOLUTE /end AXIS_PTS
/begin CHARACTERISTIC KL_TMAXIAEOEFCGETR_ANS_Y "Max-Timer in SLST-Input für IAE oeffnen" CURVE 0x1D5B5C FLOAT32_IEEE_COL_DIRECT_S6_S3 0 t_fl_S6_S3 -3.40282e+038 3.40282e+038
 /begin AXIS_DESCR COM_AXIS c_getriebe_egs_in c_int_S6_S3 8 -40 140 DEPOSIT ABSOLUTE AXIS_PTS_REF KL_TMAXIAEOEFCGETR_ANS_X /end AXIS_DESCR
/end CHARACTERISTIC
/begin AXIS_PTS KL_UMSCHZMMAXIAE_STKRAFT_ANS_X "X-Achse: status_kraftfluss_egs_in" 0x1D7FF6 status_kraftfluss_egs_in UBYTE_X_INCR_DIRECT_S6_S3 0 void_int_S6_S3 7 0 255 DEPOSIT ABSOLUTE /end AXIS_PTS
/begin CHARACTERISTIC KL_UMSCHZMMAXIAE_STKRAFT_ANS_Y "Umschaltung für Bestimmung z_m_may_iae_has in Abh. vom Kraftfluss" CURVE 0x1D7FFD UBYTE_COL_DIRECT_S6_S3 0 void_int_S6_S3 0 255
 /begin AXIS_DESCR COM_AXIS status_kraftfluss_egs_in void_int_S6_S3 7 0 255 DEPOSIT ABSOLUTE AXIS_PTS_REF KL_UMSCHZMMAXIAE_STKRAFT_ANS_X /end AXIS_DESCR
/end CHARACTERISTIC
/begin AXIS_PTS KL_ZK0ENTKAKTIVABLVAR_ANS_X "X: z_ablaufvariante_has_stg" 0x1D8DF0 NO_INPUT_QUANTITY UBYTE_X_INCR_DIRECT_S6_S3 0 void_int_S6_S3 6 0 255 DEPOSIT ABSOLUTE /end AXIS_PTS
/begin CHARACTERISTIC KL_ZK0ENTKAKTIVABLVAR_ANS_Y "Y: z_k0entkaktiv_ans" CURVE 0x1D8DF6 UBYTE_COL_DIRECT_S6_S3 0 void_int_S6_S3 0 255
 /begin AXIS_DESCR COM_AXIS NO_INPUT_QUANTITY void_int_S6_S3 6 0 255 DEPOSIT ABSOLUTE AXIS_PTS_REF KL_ZK0ENTKAKTIVABLVAR_ANS_X /end AXIS_DESCR
/end CHARACTERISTIC
/begin AXIS_PTS KL_ZNSOLLEM_ISTGANG_ANS_X "X-Achse: istgang_egs_in" 0x1D8DFC istgang_egs_in SBYTE_X_INCR_DIRECT_S6_S3 0 void_int_S6_S3 10 -128 127 DEPOSIT ABSOLUTE /end AXIS_PTS
/begin CHARACTERISTIC KL_ZNSOLLEM_ISTGANG_ANS_Y "Teil der Bestimmung z_n_soll_em_aktiv" CURVE 0x1D8E06 UBYTE_COL_DIRECT_S6_S3 0 void_int_S6_S3 0 255
 /begin AXIS_DESCR COM_AXIS istgang_egs_in void_int_S6_S3 10 -128 127 DEPOSIT ABSOLUTE AXIS_PTS_REF KL_ZNSOLLEM_ISTGANG_ANS_X /end AXIS_DESCR
/end CHARACTERISTIC
/begin AXIS_PTS KL_ZNSOLLVMAKTIVABLVAR_ANS_X "X: z_ablaufvariante_has_stg" 0x1D8E10 NO_INPUT_QUANTITY UBYTE_X_INCR_DIRECT_S6_S3 0 void_int_S6_S3 6 0 255 DEPOSIT ABSOLUTE /end AXIS_PTS
/begin CHARACTERISTIC KL_ZNSOLLVMAKTIVABLVAR_ANS_Y "Y: z_nsollvmaktiv_ans" CURVE 0x1D8E16 UBYTE_COL_DIRECT_S6_S3 0 void_int_S6_S3 0 255
 /begin AXIS_DESCR COM_AXIS NO_INPUT_QUANTITY void_int_S6_S3 6 0 255 DEPOSIT ABSOLUTE AXIS_PTS_REF KL_ZNSOLLVMAKTIVABLVAR_ANS_X /end AXIS_DESCR
/end CHARACTERISTIC
/begin CHARACTERISTIC K_KFMGK0RS_SYN_ZUS "Gangsprung zur Auswahl des Kennfelds der Schaltungsabhängigkeit beim K0 Sollmomentgradienten beim K0 Synchronisieren beim Zustart" VALUE 0x1D8016 SBYTE_COL_DIRECT_S6_S3 0 void_int_S6_S3 -8 0 /end CHARACTERISTIC
/begin CHARACTERISTIC K_MZIELNOEMNSOLLVM_ZST_ZUS "Faktor zur Gewichtung des VM-Zielmoment der HAS aus der Fahrpedal-Interpretation zur  Bestimmung der VM-Solldrehzahl ab dem Zustand Zustarten und in den Zuständen Schaltung aktiv und VM Abfangen beim Zustart" VALUE 0x1D5D8C FLOAT32_IEEE_COL_DIRECT_S6_S3 0 void_fl_S6_S3 0 10 /end CHARACTERISTIC
/begin CHARACTERISTIC K_NOEMNSOLLVMOKS_ZST_ZUS "Faktor für Gewichstung des Drehzahloffsets bei der Bestimmung der VM-Solldrehzahl ohne Kraftschluss ab dem Zustand Zustarten und in den Zuständen Schaltung aktiv und VM Abfangen beim Zustart." VALUE 0x1D5D90 FLOAT32_IEEE_COL_DIRECT_S6_S3 0 void_fl_S6_S3 0 1 /end CHARACTERISTIC
/begin CHARACTERISTIC K_SVH_RESETABLABBR_SAK_ZUS "Ruecksetzen Schaltverhinderung bei vorherigem Ablauf-Abbruch im Zustand Schaltung aktiv beim Zustart (255 = alle Arten von Schaltungen zuruecksetzen, 0 = keine Schaltung zuruecksetzen)  Bit-Codierung siehe Handbuch" VALUE 0x1D8017 UBYTE_COL_DIRECT_S6_S3 0 void_int_S6_S3 0 255 /end CHARACTERISTIC
/begin CHARACTERISTIC K_SVH_RESET_ABB_ZUS "Rücksetzen einer Schaltverhinderung während VM-Zustart beim Abbruch Zustart (255 = alle Arten von Schaltungen zurücksetzen, 0 = keine Schaltung zurücksetzen) -> Bit-Codierung siehe Handbuch" VALUE 0x1D801A UBYTE_COL_DIRECT_S6_S3 0 void_int_S6_S3 0 255 /end CHARACTERISTIC
/begin CHARACTERISTIC K_SVH_RESET_AST_VMA "Bedingtes Rücksetzen einer Schaltverhinderung im Zustand VM-Abstellen der Hybridfunktion VM aus (255 = alle Arten von Schaltungen zurücksetzen, 0 = keine Schal-tung zurücksetzen)  Bit-Codierung siehe Handbuch" VALUE 0x1D8004 UBYTE_COL_DIRECT_S6_S3 0 void_int_S6_S3 0 255 /end CHARACTERISTIC
/begin CHARACTERISTIC K_SVH_RESET_SRT_VMA "Bedingtes Rücksetzen einer Schaltverhinderung im Zustand Start der Hybridfunk-tion VM aus (255 = alle Arten von Schaltungen zurücksetzen, 0 = keine Schaltung zurücksetzen) Bit-Codierung siehe Handbuch" VALUE 0x1D8005 UBYTE_COL_DIRECT_S6_S3 0 void_int_S6_S3 0 255 /end CHARACTERISTIC
/begin CHARACTERISTIC K_SVH_RESET_SRT_VME "Bedingtes Rücksetzen einer Schaltverhinderung im Zustand Start der Hybridfunk-tion VM ein (255 = alle Arten von Schaltungen zurücksetzen, 0 = keine Schaltung zurücksetzen) Bit-Codierung siehe Handbuch" VALUE 0x1D8008 UBYTE_COL_DIRECT_S6_S3 0 void_int_S6_S3 0 255 /end CHARACTERISTIC
/begin CHARACTERISTIC K_SVH_RESET_ZST_VME "Bedingtes Rücksetzen einer Schaltverhinderung im Zustand Zustarten der Hybrid-funktion VM ein (255 = alle Arten von Schaltungen zurücksetzen, 0 = keine Schaltung zurücksetzen) Bit-Codierung siehe Handbuch" VALUE 0x1D8009 UBYTE_COL_DIRECT_S6_S3 0 void_int_S6_S3 0 255 /end CHARACTERISTIC
/begin CHARACTERISTIC MDS_SOLLK0MVMK0SREG_SYN_ZUS "Differenz zwischen dem K0-Sollmoment der HAS und dem VM-Moment zur Bestimmung des Zeitpunkts der Anforderung der Aktivierung der K0-Schlupfregelung im Zustand K0 Synchronisieren beim Zustart" VALUE 0x1D5D94 FLOAT32_IEEE_COL_DIRECT_S6_S3 0 trq_fl_a_S6_S3 0 1000 /end CHARACTERISTIC
/begin CHARACTERISTIC MDS_ZIELK0NSOLLVMINIT_SYN_ZUS "Differenz zwischen K0 Ziel- und ZIelmoment aus der letzten Task  zur Initialisierung der VM Solldrehzahl beim Zustarten" VALUE 0x1D5D98 FLOAT32_IEEE_COL_DIRECT_S6_S3 0 trq_fl_a_S6_S3 0 1000 /end CHARACTERISTIC
/begin CHARACTERISTIC MD_ZIELSOLLK0_SYN_ZUS "Differenz zwischen K0 Ziel- und Sollmoment zur Initialisierung der VM Solldrehzahl beim Zustarten" VALUE 0x1D5D9C FLOAT32_IEEE_COL_DIRECT_S6_S3 0 trq_fl_a_S6_S3 0 1000 /end CHARACTERISTIC
/begin CHARACTERISTIC MGS_WUNSCHFPW_ANH_ZUS "Gradientenschwelle zur Initialisierung der VM Solldrehzahl im Zustand Drehzahlanhebung beim Zustart" VALUE 0x1D5DA0 FLOAT32_IEEE_COL_DIRECT_S6_S3 0 trqg_fl_c_S6_S3 -25000 25000 /end CHARACTERISTIC
/begin CHARACTERISTIC MGS_WUNSCHFPW_SYN_ZUS "Gradientenschwelle zur Initialisierung der VM Solldrehzahl im Zustand Synchronisieren beim Zustart" VALUE 0x1D5DA4 FLOAT32_IEEE_COL_DIRECT_S6_S3 0 trqg_fl_c_S6_S3 -25000 25000 /end CHARACTERISTIC
/begin CHARACTERISTIC MG_K0MODHASMAXABBR_SCL_ZUS "Maximaler Gradienten des modifizierten K0-Moments der HAS bei einem direkten Übergang STR nach SCL im Zustand K0-Schliessen beim Zustart" VALUE 0x1D5DA8 FLOAT32_IEEE_COL_DIRECT_S6_S3 0 trqg_fl_c_S6_S3 0 50000 /end CHARACTERISTIC
/begin CHARACTERISTIC MG_K0MODHASMAXFUWKALT_SCL_ZUS "Maximaler Gradienten des modifizierten K0-Moments der HAS bei aktiver FUW oder bei Kaltstart mit abgesenkter EM-Drehzahl im Zustand K0-Schliessen beim Zustart" VALUE 0x1D5DAC FLOAT32_IEEE_COL_DIRECT_S6_S3 0 trqg_fl_c_S6_S3 0 50000 /end CHARACTERISTIC
/begin CHARACTERISTIC MG_K0MODHASMAXK0SREG_SCL_ZUS "Maximaler Gradienten des modifizierten K0-Moments der HAS bei aktiver K0 Schlupfregelung im Zustand K0-Schliessen beim Zustart" VALUE 0x1D5DB0 FLOAT32_IEEE_COL_DIRECT_S6_S3 0 trqg_fl_c_S6_S3 0 50000 /end CHARACTERISTIC
/begin CHARACTERISTIC MG_K0SYNCMK0ERHDIAG_SYN_ZUS "Gradient des K0 Sollmoments diagnoseseitiger Anhebung des K0-Sollmoments im Zustand K0 Synchronisieren beim VM Zustart" VALUE 0x1D5DB4 FLOAT32_IEEE_COL_DIRECT_S6_S3 0 trqg_fl_c_S6_S3 0 10000 /end CHARACTERISTIC
/begin CHARACTERISTIC MG_K0SYNCVMVOLLAST_SYN_ZUS "Gradient des K0 Sollmoments bei Momenten über der Saug-Vollastkennlinie des VM im Zustand K0 Synchronisieren beim VM Zustart" VALUE 0x1D5DB8 FLOAT32_IEEE_COL_DIRECT_S6_S3 0 trqg_fl_c_S6_S3 0 10000 /end CHARACTERISTIC
/begin CHARACTERISTIC MG_SOLLK0HASMAXABBR_SCL_ZUS "Maximaler Gradienten des K0-Sollmoments der HAS bei einem direkten Übergang STR nach SCL im Zustand K0-Schliessen beim Zustart" VALUE 0x1D5DC0 FLOAT32_IEEE_COL_DIRECT_S6_S3 0 trqg_fl_c_S6_S3 0 50000 /end CHARACTERISTIC
/begin CHARACTERISTIC MG_SOLLK0HASMAXFUWKALT_SCL_ZUS "Maximaler Gradienten des K0-Sollmoments der HAS bei aktiver FUW oder bei Kaltstart mit abgesenkter EM-Drehzahl im Zustand K0-Schliessen beim Zustart" VALUE 0x1D5DC4 FLOAT32_IEEE_COL_DIRECT_S6_S3 0 trqg_fl_c_S6_S3 0 50000 /end CHARACTERISTIC
/begin CHARACTERISTIC MG_SOLLK0MIN_SYN_ZUS "Minimaler Gradient des K0-Sollmoments im Zustand K0 Synchronisieren beim Zustart" VALUE 0x1D5DC8 FLOAT32_IEEE_COL_DIRECT_S6_S3 0 trqg_fl_c_S6_S3 -10000 0 /end CHARACTERISTIC
/begin CHARACTERISTIC MG_SOLLK0NEG_2_SAK_ZUS "Negativer Gradient des K0 Sollmoments zur Begrenzung der K0 Vorsteuerung bei angelegter K0 im Zustand Schaltung aktiv beim VM Zustart" VALUE 0x1D5DCC FLOAT32_IEEE_COL_DIRECT_S6_S3 0 trqg_fl_c_S6_S3 -10000 0 /end CHARACTERISTIC
/begin CHARACTERISTIC MG_SOLLK0NEG_2_ZST_ZUS "Negativer Gradient des K0 Sollmoments zur Begrenzung der K0 Vorsteuerung bei angelegter K0 im Zustand Zustarten beim VM Zustart" VALUE 0x1D5DD0 FLOAT32_IEEE_COL_DIRECT_S6_S3 0 trqg_fl_c_S6_S3 -10000 0 /end CHARACTERISTIC
/begin CHARACTERISTIC MG_SOLLK0NEG_ABF_ZUS "Negativer Gradient des K0 Sollmoments zum Abfangen des VM bei einem Abbruch VM Abstellen im Zustand VM Abfangen beim Zustart" VALUE 0x1D5DD4 FLOAT32_IEEE_COL_DIRECT_S6_S3 0 trqg_fl_c_S6_S3 -10000 0 /end CHARACTERISTIC
/begin CHARACTERISTIC MG_SOLLK0NEG_SAK_ZUS "Negativer Gradient des K0 Sollmoments zur Begrenzung der K0 Vorsteuerung während K0 Befüllung im Zustand Schaltung aktiv beim VM Zustart" VALUE 0x1D5DDC FLOAT32_IEEE_COL_DIRECT_S6_S3 0 trqg_fl_c_S6_S3 -10000 0 /end CHARACTERISTIC
/begin CHARACTERISTIC MG_SOLLK0NEG_ZST_ZUS "Negativer Gradient des K0 Sollmoments zur Begrenzung der K0 Vorsteuerung während K0 Befüllung im Zustand Zustarten beim VM Zustart" VALUE 0x1D5DE0 FLOAT32_IEEE_COL_DIRECT_S6_S3 0 trqg_fl_c_S6_S3 -10000 0 /end CHARACTERISTIC
/begin CHARACTERISTIC MG_SOLLK0POS_2_SAK_ZUS "Positiver Gradient des K0 Sollmoments zur Begrenzung der K0 Vorsteuerung bei angelegter K0 im Zustand Schaltung aktiv beim VM Zustart" VALUE 0x1D5DE8 FLOAT32_IEEE_COL_DIRECT_S6_S3 0 trqg_fl_c_S6_S3 0 10000 /end CHARACTERISTIC
/begin CHARACTERISTIC MG_SOLLK0POS_2_ZST_ZUS "Positiver Gradient des K0 Sollmoments zur Begrenzung der K0 Vorsteuerung bei angelegter K0 im Zustand Zustarten beim VM Zustart" VALUE 0x1D5DEC FLOAT32_IEEE_COL_DIRECT_S6_S3 0 trqg_fl_c_S6_S3 0 10000 /end CHARACTERISTIC
/begin CHARACTERISTIC MG_SOLLK0POS_ABF_ZUS "Positiver Gradient des K0 Sollmoments zum Abfangen des VM bei einem Abbruch VM Abstellen im Zustand VM Abfangen beim Zustart" VALUE 0x1D5DF0 FLOAT32_IEEE_COL_DIRECT_S6_S3 0 trqg_fl_c_S6_S3 0 10000 /end CHARACTERISTIC
/begin CHARACTERISTIC MG_SOLLK0POS_SAK_ZUS "Positiver Gradient des K0 Sollmoments zur Begrenzung der K0 Vorsteuerung während K0 Befüllung im Zustand Schaltung aktiv beim VM Zustart" VALUE 0x1D5DF8 FLOAT32_IEEE_COL_DIRECT_S6_S3 0 trqg_fl_c_S6_S3 0 10000 /end CHARACTERISTIC
/begin CHARACTERISTIC MG_SOLLK0POS_ZST_ZUS "Positiver Gradient des K0 Sollmoments zur Begrenzung der K0 Vorsteuerung während K0 Befüllung im Zustand Zustarten beim VM Zustart" VALUE 0x1D5DFC FLOAT32_IEEE_COL_DIRECT_S6_S3 0 trqg_fl_c_S6_S3 0 10000 /end CHARACTERISTIC
/begin CHARACTERISTIC MG_SOLLK0UVSNEG_ZST_ZUS "Negativer Gradient des K0 Sollmoments bei Anforderung einer K0-Unterstützung des VM Startsystems durch die HAS Zustandssteuerung (OML) im Zustand Zustarten beim VM Zustart" VALUE 0x1D5E00 FLOAT32_IEEE_COL_DIRECT_S6_S3 0 trqg_fl_c_S6_S3 -10000 0 /end CHARACTERISTIC
/begin CHARACTERISTIC MG_SOLLK0UVSPOS_ZST_ZUS "Positiver Gradient des K0 Sollmoments bei Anforderung einer K0-Unterstützung des VM Startsystems durch die HAS Zustandssteuerung (OML) im Zustand Zustarten beim VM Zustart" VALUE 0x1D5E04 FLOAT32_IEEE_COL_DIRECT_S6_S3 0 trqg_fl_c_S6_S3 0 10000 /end CHARACTERISTIC
/begin CHARACTERISTIC MG_SOLLK0_ABB_ZUS "Gradienten für das K0-Sollmoments der HAS im Zustand Abbruch Zustart beim Zustart" VALUE 0x1D5E08 FLOAT32_IEEE_COL_DIRECT_S6_S3 0 trqg_fl_c_S6_S3 0 50000 /end CHARACTERISTIC
/begin CHARACTERISTIC MO_SOLLVMHSTMSOLLK0_SCL_ZUS "Offset auf das VM-Sollmoment der HST zum Vergleich mit dem K0-Sollmoment der HAS als Aktivierungsbedingung der Ansteuerung K0 Schliessen im Zustand K0 Schliessen beim Zustart" VALUE 0x1D5E10 FLOAT32_IEEE_COL_DIRECT_S6_S3 0 trq_fl_a_S6_S3 -1000 1000 /end CHARACTERISTIC
/begin CHARACTERISTIC MO_SOLLVMLHSTMSOLLK0_SCL_ZUS "Offset auf das VM-Luftpfadsollmoment der HST zum Vergleich mit dem K0-Sollmoment der HAS als Aktivierungsbedingung der Ansteuerung K0 Schliessen im Zustand K0 Schliessen beim Zustart" VALUE 0x1D5E18 FLOAT32_IEEE_COL_DIRECT_S6_S3 0 trq_fl_a_S6_S3 -1000 1000 /end CHARACTERISTIC
/begin CHARACTERISTIC MO_VMMGSOLLK0_SYN_ZUS "Offset zur Reduzierung des VM-Istmoments bei der Bestimmung des K0 Sollmomentgradienten im Zustand K0 Synchronisieren beim Zustart" VALUE 0x1D5E1C FLOAT32_IEEE_COL_DIRECT_S6_S3 0 trq_fl_a_S6_S3 -1000 1000 /end CHARACTERISTIC
/begin CHARACTERISTIC MO_ZIELK0MINZMANH_SYN_ZUS "Offset zur Aktivierung des separaten Kennfelds der K0 Sollmomentgradienten bei aktiver Zusatzdrehmomentanhebung im Zustand K0 Synchronisieren beim Zustart" VALUE 0x1D5E20 FLOAT32_IEEE_COL_DIRECT_S6_S3 0 trq_fl_a_S6_S3 -1000 1000 /end CHARACTERISTIC
/begin CHARACTERISTIC MS_SOLLEMVORSTEUER_ZUS "Drehmomentschwelle des EM Vorsteuermoments zur Aktivierung der Vorgabe des EM-Sollmoments beim Zustart" VALUE 0x1D5E34 FLOAT32_IEEE_COL_DIRECT_S6_S3 0 trq_fl_a_S6_S3 -1000 1000 /end CHARACTERISTIC
/begin CHARACTERISTIC MS_SOLLK0K0SREG_SYN_ZUS "Schwelle für das K0-Sollmoment der HAS als Basisbedingung für die Anforderung der Aktivierung der K0-Schlupfregelung im Zustand K0 Synchronisieren beim Zustart" VALUE 0x1D5E38 FLOAT32_IEEE_COL_DIRECT_S6_S3 0 trq_fl_a_S6_S3 -1000 1000 /end CHARACTERISTIC
/begin CHARACTERISTIC MS_WUNSCHK0HYS_ANH_ZUS "Schwelle für das gefilterte Fahrerwunschmoment der HST zum Setzen des K0-Hystereseflags der HAS im Zustand VM-Drehzahlanhebung beim Zustart" VALUE 0x1D5E3C FLOAT32_IEEE_COL_DIRECT_S6_S3 0 trq_fl_a_S6_S3 -1000 1000 /end CHARACTERISTIC
/begin CHARACTERISTIC MS_ZIELVMHASK0HYS_ANH_ZUS "Schwelle für das VM-Zielmoment zum Setzen des K0-Hystereseflags der HAS im Zustand VM-Drehzahlanhebung beim Zustart" VALUE 0x1D5E40 FLOAT32_IEEE_COL_DIRECT_S6_S3 0 trq_fl_a_S6_S3 -1000 1000 /end CHARACTERISTIC
/begin CHARACTERISTIC MS_ZIELVMK0SREG_SYN_ZUS "Schwelle für das VM-Zielmoment als Basisbedingung für die Anforderung der Aktivierung der K0-Schlupfregelung im Zustand K0 Synchronisieren beim Zustart" VALUE 0x1D5E44 FLOAT32_IEEE_COL_DIRECT_S6_S3 0 trq_fl_a_S6_S3 -1000 1000 /end CHARACTERISTIC
/begin CHARACTERISTIC M_SOLLK0UVS_ZST_ZUS "K0 Sollmoment bei Anforderung einer K0-Unterstützung des VM Startsystems durch die HAS Zustandssteuerung (OML) im Zustand Zustarten beim VM Zustart" VALUE 0x1D5E48 FLOAT32_IEEE_COL_DIRECT_S6_S3 0 trq_fl_a_S6_S3 0 1000 /end CHARACTERISTIC
/begin CHARACTERISTIC NDGS_K0K0SREG_SYN_ZUS "Maximaler Betrag des K0-Differenzdrehzahlgradienten zur Bestimmung des Zeitpunkts der Anforderung der Aktivierung der K0-Schlupfregelung im Zustand K0 Synchronisieren beim Zustart" VALUE 0x1D5E4C FLOAT32_IEEE_COL_DIRECT_S6_S3 0 ng_fl_S6_S3 0 10000 /end CHARACTERISTIC
/begin CHARACTERISTIC NDGS_SOLLVMNVMK0SREG_SYN_ZUS "Gradientenschwelle der Differenz zwischen VM-Soll- und Ist-Drehzahl zur Bestimmung des Zeitpunkts der Anforderung der Aktivierung der K0-Schlupfregelung im Zustand K0 Synchronisieren beim Zustart" VALUE 0x1D5E54 FLOAT32_IEEE_COL_DIRECT_S6_S3 0 ng_fl_S6_S3 -25000 25000 /end CHARACTERISTIC
/begin CHARACTERISTIC NDS_15ZNSOLLEM_INAKTIV_ANS "Drehzahlschwelle für Deaktivierung Entkopplungsvorgabe der IAE" VALUE 0x1D1A1C FLOAT32_IEEE_COL_DIRECT_S6_S3 0 n_fl_S6_S3 -3.40282e+038 3.40282e+038 /end CHARACTERISTIC
/begin CHARACTERISTIC NDS_IAE_PLAUS_ANS "Drehzahldifferenzschwelle fuer Aktivierung nd_iae Plausi" VALUE 0x1D1A24 FLOAT32_IEEE_COL_DIRECT_S6_S3 0 n_fl_S6_S3 -3.40282e+038 3.40282e+038 /end CHARACTERISTIC
/begin CHARACTERISTIC NDS_K0GESCHL_SCL_ZUS "Differenzdrehzahlschwelle Kupplung K0 zur Überprüfung K0-Geschlossen als Aktivierungsbedingung der Ansteuerung K0 Schliessen im Zustand K0 Schliessen beim Zustart" VALUE 0x1D5E5C FLOAT32_IEEE_COL_DIRECT_S6_S3 0 n_fl_S6_S3 -10000 10000 /end CHARACTERISTIC
/begin CHARACTERISTIC NDS_K0MK0ANH_ABF_ZUS "K0-Differenzdrehzahlschwelle zur Aktivierung der K0-Momentenanhebung im Zustand VM Abfangen beim Zustart" VALUE 0x1D5E68 FLOAT32_IEEE_COL_DIRECT_S6_S3 0 n_fl_S6_S3 -1000 1000 /end CHARACTERISTIC
/begin CHARACTERISTIC NDS_K0SYNCERKMAX_SYN_ZUS "Schwellwert nach Umschaltung der Differenzdrehzahl zur Erkennung Synchron beim VM-Zustart" VALUE 0x1D5E6C FLOAT32_IEEE_COL_DIRECT_S6_S3 0 n_fl_S6_S3 0 10000 /end CHARACTERISTIC
/begin CHARACTERISTIC NDS_SOLLIAE_PLAUS_ANS "Drehzahldifferenzschwelle fuer Aktivierung nd_soll_iae Plausi" VALUE 0x1D1A2C FLOAT32_IEEE_COL_DIRECT_S6_S3 0 n_fl_S6_S3 -3.40282e+038 3.40282e+038 /end CHARACTERISTIC
/begin CHARACTERISTIC NDS_SOLLVMNVMK0SREG_SYN_ZUS "Differenzdrehzahlschwelle zwischen VM-Soll- und Ist-Drehzahl zur Bestimmung des Zeitpunkts der Anforderung der Aktivierung der K0-Schlupfregelung im Zustand K0 Synchronisieren beim Zustart" VALUE 0x1D5E74 FLOAT32_IEEE_COL_DIRECT_S6_S3 0 n_fl_S6_S3 0 10000 /end CHARACTERISTIC
/begin CHARACTERISTIC NDS_VMNEMBED_ANH_ZUS "Schwellwert der Differenzdrehzahl zwischen VM und EM Drehzahl als Übergangsbedingung nach K0 Synchronisieren im Zustand Drehzahlanhebung beim Zustart" VALUE 0x1D5E78 FLOAT32_IEEE_COL_DIRECT_S6_S3 0 n_fl_S6_S3 -10000 0 /end CHARACTERISTIC
/begin CHARACTERISTIC NDS_VMNEMK0HYS_SAK_ZUS "Schwellwert der Differenzdrehzahl zwischen VM und der EM Drehzahl zur Aktivierung der Logik zur Rücknahme des K0-Hystereseflags im Zustand 'Schaltung aktiv' beim Zustart" VALUE 0x1D5E80 FLOAT32_IEEE_COL_DIRECT_S6_S3 0 n_fl_S6_S3 -10000 10000 /end CHARACTERISTIC
/begin CHARACTERISTIC NGS_VMMK0ANH_ABF_ZUS "Maximaler VM-Drehzahlgradient zur Aktivierung der K0-Momentenanhebung im Zustand VM Abfangen beim Zustart" VALUE 0x1D5E88 FLOAT32_IEEE_COL_DIRECT_S6_S3 0 n_fl_S6_S3 -30000 30000 /end CHARACTERISTIC
/begin CHARACTERISTIC NG_EMMODRSMIN_SYN_ZUS "Minimaler Gradient der modifizierten EM-Drehzahl als Basisdrehzahl zur Bestimmung der VM Solldrehzahl bei RS beim K0 Synchronisieren beim Zustart" VALUE 0x1D5E90 FLOAT32_IEEE_COL_DIRECT_S6_S3 0 ng_fl_S6_S3 -50000 0 /end CHARACTERISTIC
/begin CHARACTERISTIC NG_SOLLVMMAXVE_ANS "Drehzahlgradient für no_sollvmve_ans" VALUE 0x1D1A40 FLOAT32_IEEE_COL_DIRECT_S6_S3 0 ng_fl_S6_S3 -10000 10000 /end CHARACTERISTIC
/begin CHARACTERISTIC NOS_EMNSOLLVMK0SREG_SYN_ZUS "Schwelle des Drehzahloffsets der VM-Solldrehzahl zur EM-Drehzahl zur Bestimmung des Zeitpunkts der Anforderung der Aktivierung der K0-Schlupfregelung im Zustand K0 Synchronisieren beim Zustart" VALUE 0x1D5E94 FLOAT32_IEEE_COL_DIRECT_S6_S3 0 n_fl_S6_S3 0 10000 /end CHARACTERISTIC
/begin CHARACTERISTIC NOS_EMNSOLLVM_SYN_ZUS "Schwelle zur Initialisierung des Timers für die Umschaltung der Differenzdrehzahlschwelle zur Erkennung Synchron beim VM Zustart" VALUE 0x1D5E98 FLOAT32_IEEE_COL_DIRECT_S6_S3 0 n_fl_S6_S3 0 10000 /end CHARACTERISTIC
/begin CHARACTERISTIC NO_NSOLLVMBEGRLOWVE_ANS "untere Maximalbegrenzung von no_sollvmbegrve_ans" VALUE 0x1D5B7C FLOAT32_IEEE_COL_DIRECT_S6_S3 0 n_fl_S6_S3 -3.40282e+038 3.40282e+038 /end CHARACTERISTIC
/begin CHARACTERISTIC NO_NSOLLVMBEGRUPVE_ANS "obere Maximalbegrenzung von no_sollvmbegrve_ans" VALUE 0x1D5B80 FLOAT32_IEEE_COL_DIRECT_S6_S3 0 n_fl_S6_S3 -3.40282e+038 3.40282e+038 /end CHARACTERISTIC
/begin CHARACTERISTIC NS_2VMDREHT_ANS "Drehzahlschwelle n_VN dreht" VALUE 0x1D1A64 FLOAT32_IEEE_COL_DIRECT_S6_S3 0 n_fl_S6_S3 -10000 10000 /end CHARACTERISTIC
/begin CHARACTERISTIC NS_2VMLAEUFT_ANS "VM Drehzahlschwelle n_VM laeuft" VALUE 0x1D1A68 FLOAT32_IEEE_COL_DIRECT_S6_S3 0 n_fl_S6_S3 -10000 10000 /end CHARACTERISTIC
/begin CHARACTERISTIC NS_EMEMAKTIV_FUW_ZUS "EM Drehzahlschwelle zur Erkennung der EM Fehlfunktion der Funktionsüberwachung der EM Funktion beim Zustart" VALUE 0x1D5E9C FLOAT32_IEEE_COL_DIRECT_S6_S3 0 n_fl_S6_S3 0 10000 /end CHARACTERISTIC
/begin CHARACTERISTIC NS_EMEMFEHLER_FUW_ZUS "EM Drehzahlschwelle zur Berücksichtigung der EM-Fehleranzeige durch die Diagnose in der Funktionsüberwachung der EM-Funktion beim Zustart" VALUE 0x1D5EA0 FLOAT32_IEEE_COL_DIRECT_S6_S3 0 n_fl_S6_S3 0 10000 /end CHARACTERISTIC
/begin CHARACTERISTIC NS_EMK0HYS_ANH_ZUS "EM-Drehzahlschwelle zur Aktivierung der Logik zur Rücknahme des K0 Hystereseflags im Zustand VM Drehzahlanhebung beim Zustart" VALUE 0x1D5EA4 FLOAT32_IEEE_COL_DIRECT_S6_S3 0 n_fl_S6_S3 0 2000 /end CHARACTERISTIC
/begin CHARACTERISTIC NS_EMKALTNEM_ZST_ZUS "EM-Drehzahlschwelle zur Erkennung der ausreichenden Ölversorgung zur K0 Befüllung beim Kaltstart mit abgesenkter EM-Drehzahl im Zustand Zustarten beim Zustart" VALUE 0x1D5EA8 FLOAT32_IEEE_COL_DIRECT_S6_S3 0 n_fl_S6_S3 0 10000 /end CHARACTERISTIC
/begin CHARACTERISTIC NS_EMMINBED_SYN_ZUS "EM-Drehzahlschwelle zur Erkennung 'EM läuft noch' als Übergangsbedingung nach K0-Schliessen im Zustand K0 Synchronisieren beim Zustart" VALUE 0x1D5EB0 FLOAT32_IEEE_COL_DIRECT_S6_S3 0 n_fl_S6_S3 0 2000 /end CHARACTERISTIC
/begin CHARACTERISTIC NS_EMMINUVS_ZST_ZUS "EM-Drehzahlschwelle zur Erkennung -EM dreht schnell genug- bei der Aktivierung der K0-Unterstützung des VM Startsystems im Zustand Zustarten beim Zustart" VALUE 0x1D5EB8 FLOAT32_IEEE_COL_DIRECT_S6_S3 0 n_fl_S6_S3 0 2000 /end CHARACTERISTIC
/begin CHARACTERISTIC NS_NEMSTATUSWECHSELIAE_ANS "Drehzahlschwelle ab der Entkopplung der IAE möglich ist" VALUE 0x1D1A74 FLOAT32_IEEE_COL_DIRECT_S6_S3 0 n_fl_S6_S3 -10000 10000 /end CHARACTERISTIC
/begin CHARACTERISTIC NS_SOLLEMKALTNEM_ZST_ZUS "EM-Solldrehzahlschwelle zur Erkennung der Sicherstellung der ausreichenden Ölversorgung zur K0 Befüllung beim Kaltstart mit abgesenkter EM-Drehzahl im Zustand Zustarten beim Zustart" VALUE 0x1D5EC4 FLOAT32_IEEE_COL_DIRECT_S6_S3 0 n_fl_S6_S3 0 10000 /end CHARACTERISTIC
/begin CHARACTERISTIC NS_VMAUSERK_AST_VMA "VM-Drehzahlschwelle zur Erkennung VM aus im Zustand VM-Abstellen der Hybrid-funktion VM aus" VALUE 0x1D5D44 FLOAT32_IEEE_COL_DIRECT_S6_S3 0 n_fl_S6_S3 0 10000 /end CHARACTERISTIC
/begin CHARACTERISTIC NS_VMEINERK_ZST_VME "VM-Drehzahlschwelle zur Erkennung VM läuft im Zustand Zustarten der Hybridfunkti-on VM ein" VALUE 0x1D5D4C FLOAT32_IEEE_COL_DIRECT_S6_S3 0 n_fl_S6_S3 0 10000 /end CHARACTERISTIC
/begin CHARACTERISTIC NS_VMMINUVS_ZST_ZUS "VM-Drehzahlschwelle zur Berücksichtigung -VM Startsystem dreht- bei der Aktivierung der K0-Unterstützung des VM Startsystems im Zustand Zustarten beim Zustart" VALUE 0x1D5ED0 FLOAT32_IEEE_COL_DIRECT_S6_S3 0 n_fl_S6_S3 0 2000 /end CHARACTERISTIC
/begin CHARACTERISTIC NS_VMMRESAUS_ANS "Drehzahlschwelle n_vm fuer wegnehmen m_res" VALUE 0x1D1A84 FLOAT32_IEEE_COL_DIRECT_S6_S3 0 n_fl_S6_S3 -10000 10000 /end CHARACTERISTIC
/begin CHARACTERISTIC NS_VMUVS_ZST_ZUS "VM-Drehzahlschwelle zur Deaktivierung der K0-Unterstützung des VM Startsystems im Zustand Zustarten beim Zustart" VALUE 0x1D5ED4 FLOAT32_IEEE_COL_DIRECT_S6_S3 0 n_fl_S6_S3 0 2000 /end CHARACTERISTIC
/begin CHARACTERISTIC N_MINEMNSOLLVM_ZST_ZUS "Minimale EM-Drehzahl als Basis für die Bestimmung der VM-Solldrehzahl ab dem Zustand Zustarten und in den Zuständen Schaltung aktiv und VM Abfangen beim Zustart" VALUE 0x1D5ED8 FLOAT32_IEEE_COL_DIRECT_S6_S3 0 n_fl_S6_S3 0 2000 /end CHARACTERISTIC
/begin MEASUREMENT SFOp_SLST110_K__IAEENTKERK1_ANS "" FLOAT32_IEEE VOID_SCALING_f_S6_S3 1 100 -3.40282e+038 3.40282e+038 ECU_ADDRESS 0xFFF96864 /end MEASUREMENT
/begin MEASUREMENT SFOp_SLST110_K__IAEENTKERK2_ANS "" FLOAT32_IEEE VOID_SCALING_f_S6_S3 1 100 -3.40282e+038 3.40282e+038 ECU_ADDRESS 0xFFF96868 /end MEASUREMENT
/begin MEASUREMENT SFOp_VMA30_isActive_ "" UBYTE VOID_SCALING_S6_S3 1 100 0 1 ECU_ADDRESS 0xFFF8653A /end MEASUREMENT
/begin MEASUREMENT SFOp_VME33_isActive_ "" UBYTE VOID_SCALING_S6_S3 1 100 0 1 ECU_ADDRESS 0xFFF86556 /end MEASUREMENT
/begin MEASUREMENT SFOp_Zus124_KL__ABBRLAUSFST_ZUS "" UBYTE void_int_S6_S3 1 100 0 255 ECU_ADDRESS 0xFFF96DD8 /end MEASUREMENT
/begin MEASUREMENT SFOp_Zus139_KF__NSOLLVM_ZST_ZUS "" FLOAT32_IEEE VOID_SCALING_f_S6_S3 1 100 -3.40282e+038 3.40282e+038 ECU_ADDRESS 0xFFF96AC8 /end MEASUREMENT
/begin MEASUREMENT SFOp_Zus142_KL_MK0MODK0BEF_ZUS "" FLOAT32_IEEE VOID_SCALING_f_S6_S3 1 100 -3.40282e+038 3.40282e+038 ECU_ADDRESS 0xFFF96ACC /end MEASUREMENT
/begin MEASUREMENT SFOp_Zus142_KL__BEFVERZ_SAK_ZUS "" UBYTE void_int_S6_S3 1 100 0 255 ECU_ADDRESS 0xFFF96DD9 /end MEASUREMENT
/begin MEASUREMENT SFOp_Zus143_KL__NACHVSI_SAK_ZUS "" UBYTE void_int_S6_S3 1 100 0 255 ECU_ADDRESS 0xFFF96DDA /end MEASUREMENT
/begin MEASUREMENT SFOp_Zus143_KL__NACHVSI_SAK_Z_a "" UBYTE void_int_S6_S3 1 100 0 255 ECU_ADDRESS 0xFFF96DDB /end MEASUREMENT
/begin MEASUREMENT SFOp_Zus143_KL__SVORVSI_SAK_ZUS "" UBYTE void_int_S6_S3 1 100 0 255 ECU_ADDRESS 0xFFF96DDC /end MEASUREMENT
/begin MEASUREMENT SFOp_Zus143_KL__TAUSZST_SAK_ZUS "" UBYTE void_int_S6_S3 1 100 0 255 ECU_ADDRESS 0xFFF96DDD /end MEASUREMENT
/begin MEASUREMENT SFOp_Zus143_KL__TVORVSI_SAK_ZUS "" UBYTE void_int_S6_S3 1 100 0 255 ECU_ADDRESS 0xFFF96DDE /end MEASUREMENT
/begin MEASUREMENT SFOp_Zus145_x_ "" FLOAT32_IEEE VOID_SCALING_f_S6_S3 1 100 -3.40282e+038 3.40282e+038 ECU_ADDRESS 0xFFF96B68 /end MEASUREMENT
/begin MEASUREMENT SFOp_Zus151_out_ "" FLOAT32_IEEE VOID_SCALING_f_S6_S3 1 100 -3.40282e+038 3.40282e+038 ECU_ADDRESS 0xFFF96B70 /end MEASUREMENT
/begin MEASUREMENT SFOp_Zus170_KL__VHRESET_SCL_ZUS "" UBYTE void_int_S6_S3 1 100 0 255 ECU_ADDRESS 0xFFF96DDF /end MEASUREMENT
/begin MEASUREMENT SFOp_Zus171_isActive_ "" UBYTE VOID_SCALING_S6_S3 1 100 0 1 ECU_ADDRESS 0xFFF86574 /end MEASUREMENT
/begin MEASUREMENT SFOp_Zus172_KL__0HASMAX_SCL_ZUS "" FLOAT32_IEEE VOID_SCALING_f_S6_S3 1 100 -3.40282e+038 3.40282e+038 ECU_ADDRESS 0xFFF96AD4 /end MEASUREMENT
/begin MEASUREMENT SFOp_Zus172_KL__DHASMAX_SCL_ZUS "" FLOAT32_IEEE VOID_SCALING_f_S6_S3 1 100 -3.40282e+038 3.40282e+038 ECU_ADDRESS 0xFFF96AD8 /end MEASUREMENT
/begin MEASUREMENT SFOp_Zus173_out_ "" FLOAT32_IEEE VOID_SCALING_f_S6_S3 1 100 -3.40282e+038 3.40282e+038 ECU_ADDRESS 0xFFF96B7C /end MEASUREMENT
/begin MEASUREMENT SFOp_Zus198_KL__DMAXMAX_SYN_ZUS "" FLOAT32_IEEE VOID_SCALING_f_S6_S3 1 100 -3.40282e+038 3.40282e+038 ECU_ADDRESS 0xFFF96ADC /end MEASUREMENT
/begin MEASUREMENT SFOp_Zus198_KL__ELK0MIN_SYN_ZUS "" FLOAT32_IEEE VOID_SCALING_f_S6_S3 1 100 -3.40282e+038 3.40282e+038 ECU_ADDRESS 0xFFF96AE0 /end MEASUREMENT
/begin MEASUREMENT SFOp_Zus198_KL__K0ZMANH_SYN_ZUS "" FLOAT32_IEEE VOID_SCALING_f_S6_S3 1 100 -3.40282e+038 3.40282e+038 ECU_ADDRESS 0xFFF96AE4 /end MEASUREMENT
/begin MEASUREMENT SFOp_Zus198_KL__LLK0MIN_SYN_ZUS "" FLOAT32_IEEE VOID_SCALING_f_S6_S3 1 100 -3.40282e+038 3.40282e+038 ECU_ADDRESS 0xFFF96AE8 /end MEASUREMENT
/begin MEASUREMENT SFOp_Zus198_KL__MANHMAX_SYN_ZUS "" FLOAT32_IEEE VOID_SCALING_f_S6_S3 1 100 -3.40282e+038 3.40282e+038 ECU_ADDRESS 0xFFF96AEC /end MEASUREMENT
/begin MEASUREMENT SFOp_Zus199_KL__VHRESET_SYN_ZUS "" UBYTE void_int_S6_S3 1 100 0 255 ECU_ADDRESS 0xFFF96DE0 /end MEASUREMENT
/begin MEASUREMENT SFOp_Zus200_KL__SYNCERK_SYN_ZUS "" FLOAT32_IEEE VOID_SCALING_f_S6_S3 1 100 -3.40282e+038 3.40282e+038 ECU_ADDRESS 0xFFF96AF0 /end MEASUREMENT
/begin MEASUREMENT SFOp_Zus203_KL__0K0SREG_SYN_ZUS "" FLOAT32_IEEE VOID_SCALING_f_S6_S3 1 100 -3.40282e+038 3.40282e+038 ECU_ADDRESS 0xFFF96AF4 /end MEASUREMENT
/begin MEASUREMENT SFOp_Zus205_isActive_ "" UBYTE VOID_SCALING_S6_S3 1 100 0 1 ECU_ADDRESS 0xFFF86576 /end MEASUREMENT
/begin MEASUREMENT SFOp_Zus229_KF__DK0M_RS_SYN_ZUS "" FLOAT32_IEEE VOID_SCALING_f_S6_S3 1 100 -3.40282e+038 3.40282e+038 ECU_ADDRESS 0xFFF96AF8 /end MEASUREMENT
/begin MEASUREMENT SFOp_Zus229_KF__DK0NGVM_SYN_ZUS "" FLOAT32_IEEE VOID_SCALING_f_S6_S3 1 100 -3.40282e+038 3.40282e+038 ECU_ADDRESS 0xFFF96AFC /end MEASUREMENT
/begin MEASUREMENT SFOp_Zus229_KF__K0M_MRS_SYN_ZUS "" FLOAT32_IEEE VOID_SCALING_f_S6_S3 1 100 -3.40282e+038 3.40282e+038 ECU_ADDRESS 0xFFF96B00 /end MEASUREMENT
/begin MEASUREMENT SFOp_Zus229_KF__K0NDK0M_SYN_ZUS "" FLOAT32_IEEE VOID_SCALING_f_S6_S3 1 100 -3.40282e+038 3.40282e+038 ECU_ADDRESS 0xFFF96B04 /end MEASUREMENT
/begin MEASUREMENT SFOp_Zus229_KF__M_ZMANH_SYN_ZUS "" FLOAT32_IEEE VOID_SCALING_f_S6_S3 1 100 -3.40282e+038 3.40282e+038 ECU_ADDRESS 0xFFF96B08 /end MEASUREMENT
/begin MEASUREMENT SFOp_Zus229_KF___IAEREG_SYN_ZUS "" FLOAT32_IEEE VOID_SCALING_f_S6_S3 1 100 -3.40282e+038 3.40282e+038 ECU_ADDRESS 0xFFF96B0C /end MEASUREMENT
/begin MEASUREMENT SFOp_Zus229_KL__ASTSAUG_SYN_ZUS "" FLOAT32_IEEE VOID_SCALING_f_S6_S3 1 100 -3.40282e+038 3.40282e+038 ECU_ADDRESS 0xFFF96B10 /end MEASUREMENT
/begin MEASUREMENT SFOp_Zus229_KL__LLK0SUS_SYN_ZUS "" FLOAT32_IEEE VOID_SCALING_f_S6_S3 1 100 -3.40282e+038 3.40282e+038 ECU_ADDRESS 0xFFF96B14 /end MEASUREMENT
/begin MEASUREMENT SFOp_Zus231_out_ "" FLOAT32_IEEE VOID_SCALING_f_S6_S3 1 100 -3.40282e+038 3.40282e+038 ECU_ADDRESS 0xFFF96BB0 /end MEASUREMENT
/begin MEASUREMENT SFOp_Zus239_isActive_ "" UBYTE VOID_SCALING_S6_S3 1 100 0 1 ECU_ADDRESS 0xFFF86579 /end MEASUREMENT
/begin MEASUREMENT SFOp_Zus240_KL__CERKUMS_SYN_ZUS "" FLOAT32_IEEE VOID_SCALING_f_S6_S3 1 100 -3.40282e+038 3.40282e+038 ECU_ADDRESS 0xFFF96B18 /end MEASUREMENT
/begin MEASUREMENT SFOp_Zus243_isActive_ "" UBYTE VOID_SCALING_S6_S3 1 100 0 1 ECU_ADDRESS 0xFFF8657A /end MEASUREMENT
/begin MEASUREMENT SFOp_Zus246_KF__NSOLLVM_ANH_ZUS "" FLOAT32_IEEE VOID_SCALING_f_S6_S3 1 100 -3.40282e+038 3.40282e+038 ECU_ADDRESS 0xFFF96B1C /end MEASUREMENT
/begin MEASUREMENT SFOp_Zus246_KF__NSOLLVM_ZST_ZUS "" FLOAT32_IEEE VOID_SCALING_f_S6_S3 1 100 -3.40282e+038 3.40282e+038 ECU_ADDRESS 0xFFF96B20 /end MEASUREMENT
/begin MEASUREMENT SFOp_Zus246_KL__0K0SREG_SYN_ZUS "" FLOAT32_IEEE VOID_SCALING_f_S6_S3 1 100 -3.40282e+038 3.40282e+038 ECU_ADDRESS 0xFFF96B24 /end MEASUREMENT
/begin MEASUREMENT SFOp_Zus247_x_ "" FLOAT32_IEEE VOID_SCALING_f_S6_S3 1 100 -3.40282e+038 3.40282e+038 ECU_ADDRESS 0xFFF96BC8 /end MEASUREMENT
/begin MEASUREMENT SFOp_Zus248_KF__DRSMAX_SYN_ZUS_ "" FLOAT32_IEEE VOID_SCALING_f_S6_S3 1 100 -3.40282e+038 3.40282e+038 ECU_ADDRESS 0xFFF96B28 /end MEASUREMENT
/begin MEASUREMENT SFOp_Zus253_isActive_ "" UBYTE VOID_SCALING_S6_S3 1 100 0 1 ECU_ADDRESS 0xFFF8657B /end MEASUREMENT
/begin MEASUREMENT SFOp_Zus274_KL_MK0MODK0BEF_ZUS "" FLOAT32_IEEE VOID_SCALING_f_S6_S3 1 100 -3.40282e+038 3.40282e+038 ECU_ADDRESS 0xFFF96B2C /end MEASUREMENT
/begin MEASUREMENT SFOp_Zus277_KL__VHRESET_ABF_ZUS "" UBYTE void_int_S6_S3 1 100 0 255 ECU_ADDRESS 0xFFF96DE1 /end MEASUREMENT
/begin MEASUREMENT SFOp_Zus278_isActive_ "" UBYTE VOID_SCALING_S6_S3 1 100 0 1 ECU_ADDRESS 0xFFF8657C /end MEASUREMENT
/begin MEASUREMENT SFOp_Zus279_out_ "" FLOAT32_IEEE VOID_SCALING_f_S6_S3 1 100 -3.40282e+038 3.40282e+038 ECU_ADDRESS 0xFFF96BE0 /end MEASUREMENT
/begin MEASUREMENT SFOp_Zus283_KF__SOLLVM_ANH_ZUS_ "" FLOAT32_IEEE VOID_SCALING_f_S6_S3 1 100 -3.40282e+038 3.40282e+038 ECU_ADDRESS 0xFFF96B30 /end MEASUREMENT
/begin MEASUREMENT SFOp_Zus283_KF__SOLLVM_ZST_ZUS_ "" FLOAT32_IEEE VOID_SCALING_f_S6_S3 1 100 -3.40282e+038 3.40282e+038 ECU_ADDRESS 0xFFF96B34 /end MEASUREMENT
/begin MEASUREMENT SFOp_Zus284_x_ "" FLOAT32_IEEE VOID_SCALING_f_S6_S3 1 100 -3.40282e+038 3.40282e+038 ECU_ADDRESS 0xFFF96BE8 /end MEASUREMENT
/begin MEASUREMENT SFOp_Zus300_isActive_ "" UBYTE VOID_SCALING_S6_S3 1 100 0 1 ECU_ADDRESS 0xFFF8657D /end MEASUREMENT
/begin MEASUREMENT SFOp_Zus301_KF__NSOLLVM_ANH_ZUS "" FLOAT32_IEEE VOID_SCALING_f_S6_S3 1 100 -3.40282e+038 3.40282e+038 ECU_ADDRESS 0xFFF96B38 /end MEASUREMENT
/begin MEASUREMENT SFOp_Zus301_KF__NSOLLVM_ZST_ZUS "" FLOAT32_IEEE VOID_SCALING_f_S6_S3 1 100 -3.40282e+038 3.40282e+038 ECU_ADDRESS 0xFFF96B3C /end MEASUREMENT
/begin MEASUREMENT SFOp_Zus302_x_ "" FLOAT32_IEEE VOID_SCALING_f_S6_S3 1 100 -3.40282e+038 3.40282e+038 ECU_ADDRESS 0xFFF96BF4 /end MEASUREMENT
/begin MEASUREMENT SFOp_Zus313_out_ "" FLOAT32_IEEE VOID_SCALING_f_S6_S3 1 100 -3.40282e+038 3.40282e+038 ECU_ADDRESS 0xFFF96C00 /end MEASUREMENT
/begin MEASUREMENT SFOp_Zus327_isActive_ "" UBYTE VOID_SCALING_S6_S3 1 100 0 1 ECU_ADDRESS 0xFFF8657F /end MEASUREMENT
/begin MEASUREMENT SFOp_Zus340_KL_MK0MODK0BEF_ZUS "" FLOAT32_IEEE VOID_SCALING_f_S6_S3 1 100 -3.40282e+038 3.40282e+038 ECU_ADDRESS 0xFFF96B50 /end MEASUREMENT
/begin MEASUREMENT SFOp_Zus340_KL__0MODUVS_ZST_ZUS "" FLOAT32_IEEE VOID_SCALING_f_S6_S3 1 100 -3.40282e+038 3.40282e+038 ECU_ADDRESS 0xFFF96B54 /end MEASUREMENT
/begin MEASUREMENT SFOp_Zus344_KL__VHRESET_ZST_ZUS "" UBYTE void_int_S6_S3 1 100 0 255 ECU_ADDRESS 0xFFF96DE2 /end MEASUREMENT
/begin MEASUREMENT SFOp_Zus345_out_ "" FLOAT32_IEEE VOID_SCALING_f_S6_S3 1 100 -3.40282e+038 3.40282e+038 ECU_ADDRESS 0xFFF96C14 /end MEASUREMENT
/begin MEASUREMENT SFOp_Zus356_KF__SOLLVM_ZST_ZUS_ "" FLOAT32_IEEE VOID_SCALING_f_S6_S3 1 100 -3.40282e+038 3.40282e+038 ECU_ADDRESS 0xFFF96B58 /end MEASUREMENT
/begin MEASUREMENT SFOp_Zus357_x_ "" FLOAT32_IEEE VOID_SCALING_f_S6_S3 1 100 -3.40282e+038 3.40282e+038 ECU_ADDRESS 0xFFF96C28 /end MEASUREMENT
/begin MEASUREMENT SFOp_Zus78_xp_ "" FLOAT32_IEEE VOID_SCALING_f_S6_S3 1 100 -3.40282e+038 3.40282e+038 ECU_ADDRESS 0xFFF96C38 /end MEASUREMENT
/begin CHARACTERISTIC STATUS_2ABLVMDREHT_HST_ANS "Anzeige der Strategie für VM dreht" VALUE 0x1D7D04 UBYTE_COL_DIRECT_S6_S3 0 void_int_S6_S3 0 8 /end CHARACTERISTIC
/begin CHARACTERISTIC STATUS_2ABLVMLAEUFT_HST_ANS "Anzeige der Strategie für VM laeuft" VALUE 0x1D7D06 UBYTE_COL_DIRECT_S6_S3 0 void_int_S6_S3 0 8 /end CHARACTERISTIC
/begin CHARACTERISTIC STATUS_ABL_101_ZIAEENTK_HST_ANS "Projektspezifische Vorgabe des Zahlenwerts für den Ablaufstatus status_ablauf_has in den einzelnen Zuständen eines Hybridablaufs" VALUE 0x1D7D0C UBYTE_COL_DIRECT_S6_S3 0 void_int_S6_S3 0 255 /end CHARACTERISTIC
/begin CHARACTERISTIC STATUS_ABL_ABBRUCH_AKTIV "Status Ablauf Abbruch aktiv" VALUE 0x1D7428 UBYTE_COL_DIRECT_S6_S3 0 void_int_S6_S3 0 255 /end CHARACTERISTIC
/begin CHARACTERISTIC STATUS_ABL_ABBRUCH_FERTIG "Status Ablauf Abbruch fertig" VALUE 0x1D7429 UBYTE_COL_DIRECT_S6_S3 0 void_int_S6_S3 0 255 /end CHARACTERISTIC
/begin CHARACTERISTIC STATUS_ABL_ABF_ZUS "Projektspezifische Statusrückmeldung an HST im Zustand VM Abfangen beim Zustart" VALUE 0x1D801E UBYTE_COL_DIRECT_S6_S3 0 void_int_S6_S3 0 255 /end CHARACTERISTIC
/begin CHARACTERISTIC STATUS_ABL_ANH_ZUS "Projektspezifische Statusrückmeldung an HST im Zustand Drehzahlanhebung beim Zustart" VALUE 0x1D801F UBYTE_COL_DIRECT_S6_S3 0 void_int_S6_S3 0 255 /end CHARACTERISTIC
/begin CHARACTERISTIC STATUS_ABL_AST_VMA "Projektspezifische Statusrückmeldung an HST im Zustand VM-Abstellen der Hybrid-funktion VM aus" VALUE 0x1D8006 UBYTE_COL_DIRECT_S6_S3 0 void_int_S6_S3 0 255 /end CHARACTERISTIC
/begin CHARACTERISTIC STATUS_ABL_SAK_ZUS "Projektspezifische Statusrückmeldung an HST im Zustand Schaltung aktiv beim Zustart" VALUE 0x1D8020 UBYTE_COL_DIRECT_S6_S3 0 void_int_S6_S3 0 255 /end CHARACTERISTIC
/begin CHARACTERISTIC STATUS_ABL_SCL_ZUS "Projektspezifische Statusrückmeldung an HST im Zustand K0-Schliessen beim Zustart" VALUE 0x1D8021 UBYTE_COL_DIRECT_S6_S3 0 void_int_S6_S3 0 255 /end CHARACTERISTIC
/begin CHARACTERISTIC STATUS_ABL_SYN_ZUS "Projektspezifische Statusrückmeldung an HST im Zustand K0-Synchronisieren beim Zustart" VALUE 0x1D8022 UBYTE_COL_DIRECT_S6_S3 0 void_int_S6_S3 0 255 /end CHARACTERISTIC
/begin CHARACTERISTIC STATUS_ABL_ZST_VME "Projektspezifische Statusrückmeldung an HST im Zustand Zustarten der Hybridfunkti-on VM ein" VALUE 0x1D800A UBYTE_COL_DIRECT_S6_S3 0 void_int_S6_S3 0 255 /end CHARACTERISTIC
/begin CHARACTERISTIC STATUS_ABL_ZST_ZUS "Projektspezifische Vorgabe des Zahlenwerts für den Ablaufstatus status_ablauf_has in den einzelnen Zuständen eines Hybridablaufs" VALUE 0x1D8023 UBYTE_COL_DIRECT_S6_S3 0 void_int_S6_S3 0 255 /end CHARACTERISTIC
/begin CHARACTERISTIC SWI_ABFZMMAXIAEHAS_ANS "Einschalten der Abfrage z_m_max_iae_has == 1 für Bestimmung z_iaeoeffnen_ans" VALUE 0x1D7D44 UBYTE_COL_DIRECT_S6_S3 0 void_int_e_S6_S3 0 1 /end CHARACTERISTIC
/begin CHARACTERISTIC SWI_AUSW_NSOLLVMVE_ANS "SWI zum Einschalten der voreilenden VM Drehzahl" VALUE 0x1D7D46 UBYTE_COL_DIRECT_S6_S3 0 void_int_e_S6_S3 0 1 /end CHARACTERISTIC
/begin CHARACTERISTIC SWI_K0SREGBASIS_SYN_ZUS "Aktivierung und Konfiguration der Aktivierung der K0 Schlupfregelung beim K0 Synchronisieren beim Zustart: bit0 = K0SREG aktiv, bit1 = Berücksichtigung IAE, bit2 = Ber. Schaltung, bit3 = Ber. FST" VALUE 0x1D8025 UBYTE_COL_DIRECT_S6_S3 0 void_int_S6_S3 0 15 /end CHARACTERISTIC
/begin CHARACTERISTIC SWI_KFMGK0AUSWAHL_SYN_ZUS "Auswahl des KF_MGK0xxx_ZUS - FALSE = xxxNDK0M_x, TRUE = xxxNDK0NGVM_x im Zustand K0 Synchronisieren beim Zustart" VALUE 0x1D8026 UBYTE_COL_DIRECT_S6_S3 0 void_int_e_S6_S3 0 1 /end CHARACTERISTIC
/begin CHARACTERISTIC SWI_MGK0RSKF_SYN_ZUS "Aktivierung der Schaltungsabhängigkeit beim K0 Sollmomentgradienten beim K0 Synchronisieren beim Zustart" VALUE 0x1D8027 UBYTE_COL_DIRECT_S6_S3 0 void_int_e_S6_S3 0 1 /end CHARACTERISTIC
/begin CHARACTERISTIC SWI_MK0MODBEGR_ABF_ZUS "Aktivierung der Null-Setzung des modifizierten K0-Moments der HAS im Zustand VM Abfangen beim Zustart" VALUE 0x1D8028 UBYTE_COL_DIRECT_S6_S3 0 void_int_e_S6_S3 0 1 /end CHARACTERISTIC
/begin CHARACTERISTIC SWI_MK0MODBEGR_SAK_ZUS "Aktivierung der Null-Setzung des modifizierten K0-Moments der HAS im Zustand Schaltung aktiv beim Zustart" VALUE 0x1D802A UBYTE_COL_DIRECT_S6_S3 0 void_int_e_S6_S3 0 1 /end CHARACTERISTIC
/begin CHARACTERISTIC SWI_MK0MODBEGR_SYN_ZUS "Aktivierung der Maximalwertbegrenzung des modifizierten K0-Moments der HAS im Zustand K0-Synchronisieren beim Zustart" VALUE 0x1D802B UBYTE_COL_DIRECT_S6_S3 0 void_int_e_S6_S3 0 1 /end CHARACTERISTIC
/begin CHARACTERISTIC SWI_MK0MODBEGR_ZST_ZUS "Aktivierung der Null-Setzung des modifizierten K0-Moments der HAS im Zustand Zustart beim Zustart" VALUE 0x1D802C UBYTE_COL_DIRECT_S6_S3 0 void_int_e_S6_S3 0 1 /end CHARACTERISTIC
/begin CHARACTERISTIC SWI_RESPSCHLE_SCHALT_ANS "Schalter zum aktivieren des Response Schleppstarts" VALUE 0x1D742A UBYTE_COL_DIRECT_S6_S3 0 void_int_S6_S3 0 255 /end CHARACTERISTIC
/begin CHARACTERISTIC SWI_STATUSIAE_PLAUS_ANS "SWI zur Aktiverung der IAE-Schlupfüberwachung 
bei status_iae_in = 4 (IAE entkoppelt)" VALUE 0x1D7D4D UBYTE_COL_DIRECT_S6_S3 0 void_int_e_S6_S3 0 1 /end CHARACTERISTIC
/begin CHARACTERISTIC SWI_TESTABLVAR_ANS "TEST: Ablaufvar. während Ablauf umschaltbar" VALUE 0x1D7D4E UBYTE_COL_DIRECT_S6_S3 0 void_int_e_S6_S3 0 1 /end CHARACTERISTIC
/begin CHARACTERISTIC SWI_UMSCH_NDIAENEM_ANS "Umschaltung Berechnung nd_znsollem = f(nd_iae) oder f=(nem)" VALUE 0x1D7D4F UBYTE_COL_DIRECT_S6_S3 0 void_int_e_S6_S3 0 1 /end CHARACTERISTIC
/begin CHARACTERISTIC SWI_VZMSOLLK0AKTIV_ANS "SWI zum Einschalten der Verzoegerung von m_soll_k0_has" VALUE 0x1D7D51 UBYTE_COL_DIRECT_S6_S3 0 void_int_e_S6_S3 0 1 /end CHARACTERISTIC
/begin CHARACTERISTIC SWI_ZK0SREGMODUS_SYN_ZUS "Festlegung des Modus zur Bestimmung des Zeitpunkts der Aktivierung der K0 Schlupfregelung beim K0 Synchronisieren beim Zustart: 0 = NDSK0, 1 = NVMEINZUG" VALUE 0x1D802E UBYTE_COL_DIRECT_S6_S3 0 void_int_e_S6_S3 0 1 /end CHARACTERISTIC
/begin CHARACTERISTIC SWI_ZMODUSVMN_SAK_ZUS "Aktivierung der VM-Solldrehzahlregelung bei Schaltung aktiv beim Zustart" VALUE 0x1D802F UBYTE_COL_DIRECT_S6_S3 0 void_int_e_S6_S3 0 1 /end CHARACTERISTIC
/begin CHARACTERISTIC SWI_ZMSOLLEM_ABF_ZUS "Schalter zur Aktivierung der EM-Sollmomentvorgabe im Zustand VM- Abfangen beim Zustart" VALUE 0x1D8030 UBYTE_COL_DIRECT_S6_S3 0 void_int_e_S6_S3 0 1 /end CHARACTERISTIC
/begin CHARACTERISTIC SWI_ZMSOLLEM_ANH_ZUS "Schalter zur Aktivierung der EM-Sollmomentvorgabe im Zustand Drehzahlanhebung beim Zustart" VALUE 0x1D8031 UBYTE_COL_DIRECT_S6_S3 0 void_int_e_S6_S3 0 1 /end CHARACTERISTIC
/begin CHARACTERISTIC SWI_ZMSOLLEM_SAK_ZUS "Schalter zur Aktivierung der EM-Sollmomentvorgabe im Zustand Schaltung aktiv beim Zustart" VALUE 0x1D8032 UBYTE_COL_DIRECT_S6_S3 0 void_int_e_S6_S3 0 1 /end CHARACTERISTIC
/begin CHARACTERISTIC SWI_ZMSOLLEM_SYN_ZUS "Schalter zur Aktivierung der EM-Sollmomentvorgabe im Zustand K0-Synchronisieren beim Zustart" VALUE 0x1D8033 UBYTE_COL_DIRECT_S6_S3 0 void_int_e_S6_S3 0 1 /end CHARACTERISTIC
/begin CHARACTERISTIC SWI_ZMSOLLEM_ZST_ZUS "Schalter zur Aktivierung der EM-Sollmomentvorgabe im Zustand Zustarten beim Zustart" VALUE 0x1D8034 UBYTE_COL_DIRECT_S6_S3 0 void_int_e_S6_S3 0 1 /end CHARACTERISTIC
/begin CHARACTERISTIC SWI_ZPHYSK0_ABF_ZUS "SWI für die Hysteresekompensation K0 im Zustand VM Abfangen beim VM Zustarten: 0 = Druckanteil p_hys_k0_has inaktiv, 1 = Druckanteil p_hys_k0_has aktiv" VALUE 0x1D8036 UBYTE_COL_DIRECT_S6_S3 0 void_int_e_S6_S3 0 1 /end CHARACTERISTIC
/begin CHARACTERISTIC SWI_ZPHYSK0_SAK_ZUS "SWI für die Hysteresekompensation K0 im Zustand Schaltung aktiv beim Zustart: 0 : Druckanteil p_hys_k0_has inaktiv 1 : Druckanteil p_hys_k0_has aktiv " VALUE 0x1D8038 UBYTE_COL_DIRECT_S6_S3 0 void_int_e_S6_S3 0 1 /end CHARACTERISTIC
/begin CHARACTERISTIC SWI_ZPHYSK0_SCL_ZUS "SWI für die Hysteresekompensation K0 im Zustand K0 Schliessen beim VM Zustarten: 0 = Druckanteil p_hys_k0_has inaktiv, 1 = Druckanteil p_hys_k0_has aktiv" VALUE 0x1D8039 UBYTE_COL_DIRECT_S6_S3 0 void_int_e_S6_S3 0 1 /end CHARACTERISTIC
/begin CHARACTERISTIC SWI_ZPHYSK0_SYN_ZUS "SWI für die Hysteresekompensation K0 im Zustand K0 Synchronisieren beim VM Zustarten: 0 = Druckanteil p_hys_k0_has inaktiv, 1 = Druckanteil p_hys_k0_has aktiv" VALUE 0x1D803B UBYTE_COL_DIRECT_S6_S3 0 void_int_e_S6_S3 0 1 /end CHARACTERISTIC
/begin CHARACTERISTIC SWI_ZPHYSK0_UAB_ZUS "SWI für die Hysteresekompensation K0 im Zustand Zustarten bei Abbruch Übergabe: 0 = Druckanteil p_hys_k0_has inaktiv, 1 = Druckanteil p_hys_k0_has aktiv" VALUE 0x1D803C UBYTE_COL_DIRECT_S6_S3 0 void_int_e_S6_S3 0 1 /end CHARACTERISTIC
/begin CHARACTERISTIC TAB_KFMGK0STATUSIAE_SYN_ZUS "Tabelle zur Aktivierung des Kennfelds KF_MGK0NDK0M_IAEREG_SYN_ZUS in Abhängigkeit des IAE Status im Zustand K0 Synchronisieren beim Zustart" VAL_BLK 0x1D800C UBYTE_COL_DIRECT_S6_S3 0 void_int_e_S6_S3 0 1 MATRIX_DIM 9 1 1 /end CHARACTERISTIC
/begin CHARACTERISTIC T_K0SREGBASISMAX_SYN_ZUS "Maximalzeit zum Setzen der Basisbedingung zur Aktivierung der K0-Schlupfregelung im Zustand K0 Synchronisieren beim Zustart" VALUE 0x1D5EDC FLOAT32_IEEE_COL_DIRECT_S6_S3 0 t_fl_S6_S3 0 10 /end CHARACTERISTIC
/begin CHARACTERISTIC T_MAX_ABB_ZUS "Maximale Verweildauer im Zustand Abbruch beim Zustart" VALUE 0x1D5EE0 FLOAT32_IEEE_COL_DIRECT_S6_S3 0 t_fl_S6_S3 0 10 /end CHARACTERISTIC
/begin CHARACTERISTIC T_MAX_SAK_ZUS "Max-Timer in Phase Schaltung Aktiv (100)" VALUE 0x1D5EE8 FLOAT32_IEEE_COL_DIRECT_S6_S3 0 t_fl_S6_S3 0 10 /end CHARACTERISTIC
/begin CHARACTERISTIC T_MAX_SCL_ZUS "Maximale Verweildauer im Zustand K0 Schliessen im Zustand Zustart" VALUE 0x1D5EEC FLOAT32_IEEE_COL_DIRECT_S6_S3 0 t_fl_S6_S3 0 10 /end CHARACTERISTIC
/begin CHARACTERISTIC T_MK0MODZIEL_SCL_ZUS "Dauer der Berücksichtigung des K0-Istmoments als Zielmoment für das modifizierte K0-Sollmoment beim K0-Schliessen beim Zustart" VALUE 0x1D5EF0 FLOAT32_IEEE_COL_DIRECT_S6_S3 0 t_fl_S6_S3 0 10 /end CHARACTERISTIC
/begin CHARACTERISTIC T_MSOLLEMAKTIV_ANS "Überwachung Ausgabe m_soll_em_has (Max.-Zeit)" VALUE 0x1D1AB8 FLOAT32_IEEE_COL_DIRECT_S6_S3 0 t_fl_S6_S3 -3.40282e+038 3.40282e+038 /end CHARACTERISTIC
/begin CHARACTERISTIC T_MSOLLK0ANSTMAX_SCL_ZUS "Maximale Dauer der K0-Ansteuerung HAS beim K0-Schliessen im Zustand K0 Schliessen beim Zustart" VALUE 0x1D5EF8 FLOAT32_IEEE_COL_DIRECT_S6_S3 0 t_fl_S6_S3 0 10 /end CHARACTERISTIC
/begin CHARACTERISTIC T_NDGK0K0SREGMIN_SYN_ZUS "Mindestdauer bei der Abfrage des K0-Differenzdrehzahlgradienten zur Bestimmung des Zeitpunkt der Anforderung der Aktivierung der K0-Schlupfregelung im Zustand K0 Synchronisieren beim Zustart" VALUE 0x1D5EFC FLOAT32_IEEE_COL_DIRECT_S6_S3 0 t_fl_S6_S3 0 5 /end CHARACTERISTIC
/begin CHARACTERISTIC T_NVMAUSERK_AST_VMA "Dauer zur Abfrage der VM-Drehzahlschwelle zur Erkennung VM aus im Zustand VM-Abstellen der Hybridfunktion VM aus" VALUE 0x1D5D48 FLOAT32_IEEE_COL_DIRECT_S6_S3 0 t_fl_S6_S3 0 10 /end CHARACTERISTIC
/begin CHARACTERISTIC T_NVMEINERK_ZST_VME "Dauer zur Abfrage der VM-Drehzahlschwelle zur Erkennung VM läuft im Zustand Zustarten der Hybridfunktion VM ein" VALUE 0x1D5D50 FLOAT32_IEEE_COL_DIRECT_S6_S3 0 t_fl_S6_S3 0 10 /end CHARACTERISTIC
/begin CHARACTERISTIC T_STATUSIAE_PLAUS_ANS "Zeit zur Anfilterung für nicht erreichten 
IAE-Schlupf nd_iae bei 
status_iae_in = 4 (IAE entkoppelt)" VALUE 0x1D1AC0 FLOAT32_IEEE_COL_DIRECT_S6_S3 0 t_fl_S6_S3 0 2 /end CHARACTERISTIC
/begin CHARACTERISTIC T_STATUSWECHSELIAE_ANS "Verzögerungszeit bis Entkopplungsanfrage zurueckgenommen wird" VALUE 0x1D1AC4 FLOAT32_IEEE_COL_DIRECT_S6_S3 0 t_fl_S6_S3 -3.40282e+038 3.40282e+038 /end CHARACTERISTIC
/begin CHARACTERISTIC T_TESTABLVAR_ANS "TEST: Zeit des Timers" VALUE 0x1D1AC8 FLOAT32_IEEE_COL_DIRECT_S6_S3 0 t_fl_S6_S3 -3.40282e+038 3.40282e+038 /end CHARACTERISTIC
/begin CHARACTERISTIC T_VK0BEFKALTNEM_ZST_ZUS "Verzögerungszeit zur Sicherstellung der Ölversorgung zur Befüllung der K0 bei einem Kaltstart-Ablauf mit abgesenkter EM-Drehzahl im Zustand Zustarten beim Zustart" VALUE 0x1D5F00 FLOAT32_IEEE_COL_DIRECT_S6_S3 0 t_fl_S6_S3 0 5 /end CHARACTERISTIC
/begin CHARACTERISTIC T_VK0SREGAKTIV_SYN_ZUS "Verzögerungszeit zur Aktivierung der K0-Schlupfregelung nach Eintritt in den Zustand K0 Synchronisieren beim Zustart" VALUE 0x1D5F04 FLOAT32_IEEE_COL_DIRECT_S6_S3 0 t_fl_S6_S3 0 5 /end CHARACTERISTIC
/begin CHARACTERISTIC T_VK0SYNCERK_SYN_ZUS "Timer zur K0 Synchronerkennung im Zustand K0 Synchronisieren beim Zustart" VALUE 0x1D5F08 FLOAT32_IEEE_COL_DIRECT_S6_S3 0 t_fl_S6_S3 0 10 /end CHARACTERISTIC
/begin CHARACTERISTIC T_VMDZIELSOLLK0_SYN_ZUS "Verzögerungszeit zur Initialisierung der VM Solldrehzahl beim K0 Synchronisieren beim Zustart" VALUE 0x1D5F10 FLOAT32_IEEE_COL_DIRECT_S6_S3 0 t_fl_S6_S3 0 5 /end CHARACTERISTIC
/begin CHARACTERISTIC T_VMSTATUSMAX_ABF_ZUS "Maximalzeit der Beruecksichtigung der Anzeige VM selbstlauffaehig als Uebergangsbedingung nach K0- Synchronisieren im Zustand VM-Abfangen beim Zustart" VALUE 0x1D5F14 FLOAT32_IEEE_COL_DIRECT_S6_S3 0 t_fl_S6_S3 0 5 /end CHARACTERISTIC
/begin CHARACTERISTIC T_VMSTATUSMAX_ANH_ZUS "Maximalzeit der Beruecksichtigung der Anzeige VM selbstlauffaehig als Uebergangsbedingung nach K0- Synchronisieren im Zustand VM-Drehzahlanhebung beim Zustart" VALUE 0x1D5F18 FLOAT32_IEEE_COL_DIRECT_S6_S3 0 t_fl_S6_S3 0 5 /end CHARACTERISTIC
/begin CHARACTERISTIC Z_ABLAUFHASHST_VMAUSERK_VMA "Wert zur Anzeige VM aus durch die Hybrid-strategie als Übergangsbedingung nach Übergabe im Zustand VM-Abstellen der Hybridfunktion VM aus" VALUE 0x1D8007 UBYTE_COL_DIRECT_S6_S3 0 void_int_S6_S3 0 255 /end CHARACTERISTIC
/begin CHARACTERISTIC Z_ABLAUFHASHST_VMEINERK_VME "Wert zur Anzeige VM läuft durch die Hybrid-strategie als Übergangsbedingung nach Übergabe im Zustand Zustarten der Hybrid-funktion VM ein" VALUE 0x1D800B UBYTE_COL_DIRECT_S6_S3 0 void_int_S6_S3 0 255 /end CHARACTERISTIC
/begin CHARACTERISTIC Z_ABLAUFVARIANTE_UVS_ZUS "Anforderung einer K0-Unterstützung des VM Startsystems durch die HAS Zustandssteuerung (OML) beim Zustart (z_ablaufvariante_has_stg) " VALUE 0x1D8040 UBYTE_COL_DIRECT_S6_S3 0 void_int_S6_S3 0 100 /end CHARACTERISTIC
/begin CHARACTERISTIC Z_ABLAUF_ABBRUCH_ZUS "Anzeigen eines Abbruchs durch die HAS-Zustandssteuerung (OML) beim Zustart" VALUE 0x1D8041 UBYTE_COL_DIRECT_S6_S3 0 void_int_S6_S3 0 255 /end CHARACTERISTIC
/begin CHARACTERISTIC Z_MMAXIAEZMODUSIAE_ANS "Erkennung gebrücktes Anfahren (keine IAE Entkopplung)" VALUE 0x1D7D52 UBYTE_COL_DIRECT_S6_S3 0 void_int_S6_S3 0 255 /end CHARACTERISTIC
/begin CHARACTERISTIC Z_TESTABLVAR_ANS "TEST: Wert von z_ablvar... wenn Timer abgelaufen" VALUE 0x1D7D53 UBYTE_COL_DIRECT_S6_S3 0 void_int_S6_S3 0 255 /end CHARACTERISTIC
/begin MEASUREMENT abstellpos_vm_in "Abstellposition VM vor nächstem ZOT" UBYTE void_int_S6_S3 1 100 0 180 ECU_ADDRESS 0xFFF86698 /end MEASUREMENT
/begin MEASUREMENT abstellpos_vm_status_in "Status Abstellposition VM" UBYTE void_int_S6_S3 1 100 0 2 ECU_ADDRESS 0xFFF86699 /end MEASUREMENT
/begin MEASUREMENT bErrorHybrid "" UBYTE void_int_S6_S3 1 100 0 15 ECU_ADDRESS 0xFFF86666 /end MEASUREMENT
/begin MEASUREMENT bExceptionHybrid "" UBYTE void_int_S6_S3 1 100 0 15 ECU_ADDRESS 0xFFF86667 /end MEASUREMENT
/begin MEASUREMENT c_getriebe_egs_in "" FLOAT32_IEEE c_int_S6_S3 1 100 -40 215 ECU_ADDRESS 0xFFF85DDC /end MEASUREMENT
/begin MEASUREMENT c_vm_in "" FLOAT32_IEEE c_int_S6_S3 1 100 -3.40282e+038 3.40282e+038 ECU_ADDRESS 0xFFF85E38 /end MEASUREMENT
/begin MEASUREMENT gangwechsel_egs_in "Flag während laufender Schaltung, bei synchron verlassen bis synchron erreicht" UBYTE void_int_S6_S3 1 100 0 1 ECU_ADDRESS 0xFFF86677 /end MEASUREMENT
/begin MEASUREMENT i_istgang_egs "" FLOAT32_IEEE void_fl_S6_S3 1 100 0 8 ECU_ADDRESS 0xFFF85D8C /end MEASUREMENT
/begin MEASUREMENT i_zielgang_egs "" FLOAT32_IEEE void_fl_S6_S3 1 100 0 8 ECU_ADDRESS 0xFFF85D90 /end MEASUREMENT
/begin MEASUREMENT istgang_egs_in "" SBYTE void_int_S6_S3 1 100 -128 127 ECU_ADDRESS 0xFFF86678 /end MEASUREMENT
/begin MEASUREMENT k_mstoerk0em_zus "Faktor zur Modifikation des K0-Störmoments zur Bestimmung des EM-Vorsteuermoments beim Zustart" FLOAT32_IEEE void_fl_S6_S3 1 100 0 2 ECU_ADDRESS 0xFFF85B50 /end MEASUREMENT
/begin MEASUREMENT m_em_in "" FLOAT32_IEEE trq_fl_a_S6_S3 1 100 -1024 1024 ECU_ADDRESS 0xFFF85DE0 /end MEASUREMENT
/begin MEASUREMENT m_iae_in "" FLOAT32_IEEE trq_fl_a_S6_S3 1 100 -32768 32767 ECU_ADDRESS 0xFFF85DE4 /end MEASUREMENT
/begin MEASUREMENT m_k0_in "" FLOAT32_IEEE trq_fl_a_S6_S3 1 100 -32768 32767 ECU_ADDRESS 0xFFF85DE8 /end MEASUREMENT
/begin MEASUREMENT m_k0_mber_has_sbe "K0-Moment der HAS zur Motormomentbegrenzung in der SAB" FLOAT32_IEEE trq_fl_a_S6_S3 1 100 -3.40282e+038 3.40282e+038 ECU_ADDRESS 0xFFF85DC4 /end MEASUREMENT
/begin MEASUREMENT m_k0_mod_has_fkt "" FLOAT32_IEEE trq_fl_a_S6_S3 1 100 -1200 1200 ECU_ADDRESS 0xFFF85D4C /end MEASUREMENT
/begin MEASUREMENT m_k0_mod_max_syn_zus "Maximalwert des modifizierten K0-Istmoments der HAS beim K0 Synchronisieren beim Zustart" FLOAT32_IEEE trq_fl_a_S6_S3 1 100 -1000 1000 ECU_ADDRESS 0xFFF85B54 /end MEASUREMENT
/begin MEASUREMENT m_max_dyn_em_in "" FLOAT32_IEEE trq_fl_a_S6_S3 1 100 -32768 32767 ECU_ADDRESS 0xFFF85DEC /end MEASUREMENT
/begin MEASUREMENT m_min_dyn_em_in "" FLOAT32_IEEE trq_fl_a_S6_S3 1 100 -3.40282e+038 3.40282e+038 ECU_ADDRESS 0xFFF85DF0 /end MEASUREMENT
/begin MEASUREMENT m_min_vm_in "" FLOAT32_IEEE trq_fl_a_S6_S3 1 100 -3.40282e+038 3.40282e+038 ECU_ADDRESS 0xFFF85E3C /end MEASUREMENT
/begin MEASUREMENT m_mot_in "" FLOAT32_IEEE trq_fl_a_S6_S3 1 100 -1024 1024 ECU_ADDRESS 0xFFF85DF4 /end MEASUREMENT
/begin MEASUREMENT m_motmax_has "" FLOAT32_IEEE trq_fl_a_S6_S3 1 100 -1200 1200 ECU_ADDRESS 0xFFF85DC8 /end MEASUREMENT
/begin MEASUREMENT m_soll_em_hst_in "" FLOAT32_IEEE trq_fl_a_S6_S3 1 100 -32768 32767 ECU_ADDRESS 0xFFF85DF8 /end MEASUREMENT
/begin MEASUREMENT m_soll_k0_has_fkt "" FLOAT32_IEEE trq_fl_a_S6_S3 1 100 -1200 1200 ECU_ADDRESS 0xFFF85D60 /end MEASUREMENT
/begin MEASUREMENT m_soll_k0_min_uvs_zus "Minimalwert des K0 Sollmoment bei Anforderung einer K0-Unterstützung des VM Startsystems durch die HAS Zustandssteuerung (OML) beim VM Zustart" FLOAT32_IEEE trq_fl_a_S6_S3 1 100 -1000 1000 ECU_ADDRESS 0xFFF85B58 /end MEASUREMENT
/begin MEASUREMENT m_soll_res_em_bas_sbe "" FLOAT32_IEEE trq_fl_a_S6_S3 1 100 -3.40282e+038 3.40282e+038 ECU_ADDRESS 0xFFF85DCC /end MEASUREMENT
/begin MEASUREMENT m_soll_res_em_has_sbe "" FLOAT32_IEEE trq_fl_a_S6_S3 1 100 -3.40282e+038 3.40282e+038 ECU_ADDRESS 0xFFF85DD0 /end MEASUREMENT
/begin MEASUREMENT m_soll_vm_hst_in "" FLOAT32_IEEE trq_fl_a_S6_S3 1 100 -32768 32767 ECU_ADDRESS 0xFFF85DFC /end MEASUREMENT
/begin MEASUREMENT m_soll_vm_l_hst_in "" FLOAT32_IEEE trq_fl_a_S6_S3 1 100 -3.40282e+038 3.40282e+038 ECU_ADDRESS 0xFFF85E40 /end MEASUREMENT
/begin MEASUREMENT m_sollk0has_nverz_mes "Gem. in Output vor CDelay" FLOAT32_IEEE trq_fl_a_S6_S3 1 100 -3.40282e+038 3.40282e+038 ECU_ADDRESS 0xFFF969DC /end MEASUREMENT
/begin MEASUREMENT m_stoer_k0_em_fil "Gefiltertes Stoermoment der K0 im Schleppstart" FLOAT32_IEEE trq_fl_a_S6_S3 1 100 -3.40282e+038 3.40282e+038 ECU_ADDRESS 0xFFF969E4 /end MEASUREMENT
/begin MEASUREMENT m_stoerk0em_fil_zus "Gefiltertes K0-Störmoment zur Bestimmung des EM-Vorsteuermoments beim Zustart" FLOAT32_IEEE trq_fl_a_S6_S3 1 100 -1000 1000 ECU_ADDRESS 0xFFF85B5C /end MEASUREMENT
/begin MEASUREMENT m_vm_in "" FLOAT32_IEEE trq_fl_a_S6_S3 1 100 -1024 1023.5 ECU_ADDRESS 0xFFF85E00 /end MEASUREMENT
/begin MEASUREMENT m_vm_start_in "" FLOAT32_IEEE trq_fl_a_S6_S3 1 100 -1024 1023.5 ECU_ADDRESS 0xFFF85E04 /end MEASUREMENT
/begin MEASUREMENT m_wunsch_fpw_hst_fil "" FLOAT32_IEEE trqg_fl_c_S6_S3 1 100 -2000 2000 ECU_ADDRESS 0xFFF85D94 /end MEASUREMENT
/begin MEASUREMENT m_wunsch_fpw_hst_in "" FLOAT32_IEEE trq_fl_a_S6_S3 1 100 -3.40282e+038 3.40282e+038 ECU_ADDRESS 0xFFF85E44 /end MEASUREMENT
/begin MEASUREMENT m_wunsch_fpw_in "" FLOAT32_IEEE trq_fl_a_S6_S3 1 100 -32768 32767 ECU_ADDRESS 0xFFF85E08 /end MEASUREMENT
/begin MEASUREMENT m_ziel_k0_min_syn_zus "Minimalwert des  Zielmoment der Trennkupplung K0 zur Realisierung des Fahrerwunschmoments beim K0 Synchronisieren beim Zustart" FLOAT32_IEEE trq_fl_a_S6_S3 1 100 -1000 1000 ECU_ADDRESS 0xFFF85B68 /end MEASUREMENT
/begin MEASUREMENT m_ziel_vm_has_ans "Zielmoment des VM beim Schleppstart" FLOAT32_IEEE trq_fl_a_S6_S3 1 100 -3.40282e+038 3.40282e+038 ECU_ADDRESS 0xFFF969E8 /end MEASUREMENT
/begin MEASUREMENT m_ziel_vm_has_zus "Zielmoment des VM bei Zustart" FLOAT32_IEEE trq_fl_a_S6_S3 1 100 -3.40282e+038 3.40282e+038 ECU_ADDRESS 0xFFF96C58 /end MEASUREMENT
/begin MEASUREMENT mg_k0_mod_max_zus "Maximaler Gradient des modifizierten K0-Moments der HAS im K0 Schliessen beim Zustart" FLOAT32_IEEE trqg_fl_c_S6_S3 1 100 0 50000 ECU_ADDRESS 0xFFF85B6C /end MEASUREMENT
/begin MEASUREMENT mg_soll_k0_max_zus "Maximaler Gradient des K0-Soll-Moments der HAS im K0 Schliessen beim Zustart" FLOAT32_IEEE trqg_fl_c_S6_S3 1 100 -3.40282e+038 3.40282e+038 ECU_ADDRESS 0xFFF96C5C /end MEASUREMENT
/begin MEASUREMENT mg_soll_k0_syn_zus "Gradient des K0-Soll-Moments im K0 Synchronisieren beim Zustart" FLOAT32_IEEE trqg_fl_c_S6_S3 1 100 -3.40282e+038 3.40282e+038 ECU_ADDRESS 0xFFF96C60 /end MEASUREMENT
/begin MEASUREMENT mg_wunsch_fpw "" FLOAT32_IEEE trqg_fl_c_S6_S3 1 100 -2000 2000 ECU_ADDRESS 0xFFF85D98 /end MEASUREMENT
/begin MEASUREMENT mg_wunsch_fpw_hst "" FLOAT32_IEEE trqg_fl_c_S6_S3 1 100 -2000 2000 ECU_ADDRESS 0xFFF85D9C /end MEASUREMENT
/begin MEASUREMENT mo_ziel_k0_zmanh_syn_zus "Offset auf das VM-Zielmoment zur Bestimmung des K0-Zielmoments der Zusatzdrehmomentanhebung (ZMANH) beim K0 Synchronisieren beim Zustart" FLOAT32_IEEE trq_fl_a_S6_S3 1 100 -1000 1000 ECU_ADDRESS 0xFFF85B70 /end MEASUREMENT
/begin MEASUREMENT msollresem_stat_mes "Gem. in Input nach Getr. Subsystem" FLOAT32_IEEE trq_fl_a_S6_S3 1 100 -3.40282e+038 3.40282e+038 ECU_ADDRESS 0xFFF969F0 /end MEASUREMENT
/begin MEASUREMENT n_ab_egs_in "" FLOAT32_IEEE n_fl_S6_S3 1 100 0 65535 ECU_ADDRESS 0xFFF85E0C /end MEASUREMENT
/begin MEASUREMENT n_em_in "" FLOAT32_IEEE n_fl_S6_S3 1 100 -3.40282e+038 3.40282e+038 ECU_ADDRESS 0xFFF85E10 /end MEASUREMENT
/begin MEASUREMENT n_em_mod_syn_zus "Wirksame DifferenzdrehModifizierte EM-Drehzahl als Basisdrehzahl zur Bestimmung der VM Solldrehzahl bei RS beim K0 Synchronisieren beim Zustartzahlschwelle zur Erkennung Synchron beim VM-Zustart" FLOAT32_IEEE n_fl_S6_S3 1 100 0 10000 ECU_ADDRESS 0xFFF96C64 /end MEASUREMENT
/begin MEASUREMENT n_em_ref_syn_zus "EM Referenzdrehzahl zur Bestimmung der modifizierten EM-Drehzahl als Basisdrehzahl zur Bestimmung der VM Solldrehzahl bei RS beim K0 Synchronisieren beim Zustart" FLOAT32_IEEE n_fl_S6_S3 1 100 0 10000 ECU_ADDRESS 0xFFF96C68 /end MEASUREMENT
/begin MEASUREMENT n_min_em_has_sbe "Minimale EM Drehzahl der Leerlaufsimulation der HAS (LLS)" FLOAT32_IEEE n_fl_S6_S3 1 100 -32767 32767 ECU_ADDRESS 0xFFF85DD4 /end MEASUREMENT
/begin MEASUREMENT n_min_psys_em_has_sbe "Minimale EM Drehzahl zur Sicherstellung Ölversorgung" FLOAT32_IEEE n_fl_S6_S3 1 100 -32767 32767 ECU_ADDRESS 0xFFF85DA0 /end MEASUREMENT
/begin MEASUREMENT n_mot_soll_iae_in "" FLOAT32_IEEE n_fl_S6_S3 1 100 -3.40282e+038 3.40282e+038 ECU_ADDRESS 0xFFF85E14 /end MEASUREMENT
/begin MEASUREMENT n_sec_iae "" FLOAT32_IEEE n_fl_S6_S3 1 100 -10000 10000 ECU_ADDRESS 0xFFF85DA4 /end MEASUREMENT
/begin MEASUREMENT n_sec_iae_ist_zus "Abtriebsseitige IAE-Drehzahl bezogen auf den Getriebeeeingang und den aktuellen  Istgang während einer Schaltung beim Zustart" FLOAT32_IEEE n_fl_S6_S3 1 100 0 10000 ECU_ADDRESS 0xFFF96C6C /end MEASUREMENT
/begin MEASUREMENT n_sec_iae_ziel_zus "Abtriebsseitige IAE Zieldrehzahl bezogen auf den Getriebeeingang während einer Schaltung beim Zustart" FLOAT32_IEEE n_fl_S6_S3 1 100 -3.40282e+038 3.40282e+038 ECU_ADDRESS 0xFFF96C70 /end MEASUREMENT
/begin MEASUREMENT n_soll_em_hst_in "" FLOAT32_IEEE n_fl_S6_S3 1 100 -3.40282e+038 3.40282e+038 ECU_ADDRESS 0xFFF85E48 /end MEASUREMENT
/begin MEASUREMENT n_soll_ll_vm_in "" FLOAT32_IEEE n_fl_S6_S3 1 100 0 2540 ECU_ADDRESS 0xFFF85E18 /end MEASUREMENT
/begin MEASUREMENT n_soll_vm_bas_ve_ans "Gemessen in Output. Regulaere Solldrehzahl" FLOAT32_IEEE n_fl_S6_S3 1 100 -3.40282e+038 3.40282e+038 ECU_ADDRESS 0xFFF96A08 /end MEASUREMENT
/begin MEASUREMENT n_t_egs_in "" FLOAT32_IEEE n_fl_S6_S3 1 100 0 65535 ECU_ADDRESS 0xFFF85E1C /end MEASUREMENT
/begin MEASUREMENT n_vm_in "" FLOAT32_IEEE n_fl_S6_S3 1 100 0 65535 ECU_ADDRESS 0xFFF85E20 /end MEASUREMENT
/begin MEASUREMENT nd_iae "" FLOAT32_IEEE n_fl_S6_S3 1 100 -10000 10000 ECU_ADDRESS 0xFFF85DA8 /end MEASUREMENT
/begin MEASUREMENT nd_k0_in "" FLOAT32_IEEE n_fl_S6_S3 1 100 -10000 10000 ECU_ADDRESS 0xFFF85DAC /end MEASUREMENT
/begin MEASUREMENT nd_sec_iae_syn_zus "Abtriebsseitiger IAE-Drehzahlsprung bezogen auf den Getriebeeeingang während einer Schaltung im Zustand K0 Synchronisieren beim Zustart" FLOAT32_IEEE n_fl_S6_S3 1 100 -10000 10000 ECU_ADDRESS 0xFFF85B74 /end MEASUREMENT
/begin MEASUREMENT nd_sollvmnvm_syn_zus "Differenz zwischen VM-Soll- und Ist-Drehzahl zur Bestimmung des Zeitpunkts der Anforderung der Aktivierung der K0-Schlupfregelung im Zustand K0 Synchronisieren beim Zustart" FLOAT32_IEEE n_fl_S6_S3 1 100 -10000 10000 ECU_ADDRESS 0xFFF85B78 /end MEASUREMENT
/begin MEASUREMENT ndg_k0_in "" FLOAT32_IEEE ng_fl_S6_S3 1 100 -10000 10000 ECU_ADDRESS 0xFFF85DB0 /end MEASUREMENT
/begin MEASUREMENT ndg_sollvmnvm_syn_zus "Gradient der Differenz zwischen VM-Soll- und Ist-Drehzahl zur Bestimmung des Zeitpunkts der Anforderung der Aktivierung der K0-Schlupfregelung im Zustand K0 Synchronisieren beim Zustart" FLOAT32_IEEE n_fl_S6_S3 1 100 -25000 25000 ECU_ADDRESS 0xFFF85B7C /end MEASUREMENT
/begin MEASUREMENT nds_k0syncerk_syn_zus "Wirksame Differenzdrehzahlschwelle zur Erkennung Synchron beim VM-Zustart" FLOAT32_IEEE n_fl_S6_S3 1 100 -3.40282e+038 3.40282e+038 ECU_ADDRESS 0xFFF96C74 /end MEASUREMENT
/begin MEASUREMENT ng_emmodrsmax_syn_zus "Maximaler Gradient der modifizierten EM-Drehzahl als Basisdrehzahl zur Bestimmung der VM Solldrehzahl bei RS beim K0 Synchronisieren beim Zustart" FLOAT32_IEEE ng_fl_S6_S3 1 100 -50000 50000 ECU_ADDRESS 0xFFF85B80 /end MEASUREMENT
/begin MEASUREMENT ng_sollvmdt1ve_ans "Gemessen in Output. Gradient der Basisdrehzahl n_soll_vm_bas_ve_has" FLOAT32_IEEE ng_fl_S6_S3 1 100 -3.40282e+038 3.40282e+038 ECU_ADDRESS 0xFFF96A20 /end MEASUREMENT
/begin MEASUREMENT ng_vm "" FLOAT32_IEEE ng_fl_S6_S3 1 100 -10000 10000 ECU_ADDRESS 0xFFF85DB4 /end MEASUREMENT
/begin MEASUREMENT no_nsollvmve_ans "Gemessen in Output. Nach Gradientenbegrenzer" FLOAT32_IEEE n_fl_S6_S3 1 100 -3.40282e+038 3.40282e+038 ECU_ADDRESS 0xFFF96A24 /end MEASUREMENT
/begin MEASUREMENT no_sollvmbegrve_ans "Gemessen in Output. Nach Saturation von ng_sollvmdt1ve_ans" FLOAT32_IEEE n_fl_S6_S3 1 100 -3.40282e+038 3.40282e+038 ECU_ADDRESS 0xFFF96A28 /end MEASUREMENT
/begin MEASUREMENT osmode_next_in "" UBYTE void_int_S6_S3 1 100 1 3 ECU_ADDRESS 0xFFF86679 /end MEASUREMENT
/begin MEASUREMENT p_bremse_fzg_in "" FLOAT32_IEEE p_fl_S6_S3 1 100 -32000 0 ECU_ADDRESS 0xFFF85E24 /end MEASUREMENT
/begin MEASUREMENT phi_neigung_in "Fahrzeug-Neigungswinkel" FLOAT32_IEEE void_fl_S6_S3 1 100 -3.40282e+038 3.40282e+038 ECU_ADDRESS 0xFFF85E28 /end MEASUREMENT
/begin MEASUREMENT pos_egs_in "Waehlhebelposition" UBYTE E_POS_S6_S3 1 100 0 8 ECU_ADDRESS 0xFFF8667A /end MEASUREMENT
/begin MEASUREMENT sollgang_egs_in "" SBYTE void_int_S6_S3 1 100 -128 127 ECU_ADDRESS 0xFFF8667B /end MEASUREMENT
/begin MEASUREMENT st_OMLID_act_stg "Innere Zustände der OML" UWORD void_int_b_S6_S3 1 100 0 4999 ECU_ADDRESS 0xFFF860CA /end MEASUREMENT
/begin MEASUREMENT st_ist_bz_has_stg "Istzustand OML" UBYTE E_STBZHAS_S6_S3 1 100 0 15 ECU_ADDRESS 0xFFF86635 /end MEASUREMENT
/begin MEASUREMENT st_ist_bz_hst_sta "Ist-Betriebszustand aus der Startegieanpassung als Eingangsgroesse der Hybridzustandssteuerung (OML)" UBYTE E_STBZHAS_S6_S3 1 100 0 15 ECU_ADDRESS 0xFFF86668 /end MEASUREMENT
/begin MEASUREMENT st_soll_bz_has_hst "interner HST Soll-Betriebszustand der Strategieanpassung (variantenunabhaengig)" UBYTE void_int_S6_S3 1 100 0 1 ECU_ADDRESS 0xFFF8669A /end MEASUREMENT
/begin MEASUREMENT st_soll_bz_hst_sta "Soll-Betriebszustand aus der Startegieanpassung als Eingangsgroesse der Hybridzustandssteuerung (OML)" UBYTE E_STBZHAS_S6_S3 1 100 0 15 ECU_ADDRESS 0xFFF86669 /end MEASUREMENT
/begin MEASUREMENT st_ziel_bz_has_stg "Zielzustand OML" UBYTE E_STBZHAS_S6_S3 1 100 0 15 ECU_ADDRESS 0xFFF86636 /end MEASUREMENT
/begin MEASUREMENT status_alaengs_adaoff_in "Information, ob die Adaptionen aufgrund erkannter Laengsbeschleunigung deaktiviert wird. 0 = Adaption aktiv aufgrund erkannter Laengsbeschleunigung
1 = Adaption inaktiv aufgrund nicht erkannter Laengsbeschleunigung" UBYTE void_int_S6_S3 1 100 0 1 ECU_ADDRESS 0xFFF8667C /end MEASUREMENT
/begin MEASUREMENT status_betriebsbereit_hst_in "" UBYTE void_int_S6_S3 1 100 0 1 ECU_ADDRESS 0xFFF8669B /end MEASUREMENT
/begin MEASUREMENT status_efahren_has_sbe "Status E-Fahren der HAS zur Festlegung der entsprechenden Portout-Größe in der HAS Signalaufbereitung_Out" UBYTE void_int_S6_S3 1 100 0 1 ECU_ADDRESS 0xFFF8665A /end MEASUREMENT
/begin MEASUREMENT status_fehler15_eh_diagin "Info vom Errorhandler ob Ersatzfkt. aktiv" UBYTE void_int_S6_S3 1 100 0 1 ECU_ADDRESS 0xFFF8662E /end MEASUREMENT
/begin MEASUREMENT status_fehler_iep_in "" UBYTE E_FEHLERIEP_S6_S3 1 100 0 1 ECU_ADDRESS 0xFFF8667D /end MEASUREMENT
/begin MEASUREMENT status_iae_adap_in "Status der Adaption des Integrierten Anfahrelements IAE" UBYTE E_STATUSADA_S6_S3 1 100 0 2 ECU_ADDRESS 0xFFF8667E /end MEASUREMENT
/begin MEASUREMENT status_iae_in "" UBYTE E_STATUSIAE_S6_S3 1 100 0 8 ECU_ADDRESS 0xFFF8667F /end MEASUREMENT
/begin MEASUREMENT status_iep_in "" UBYTE E_STATUSIEP_S6_S3 1 100 0 4 ECU_ADDRESS 0xFFF86680 /end MEASUREMENT
/begin MEASUREMENT status_k0_adap_in "" UBYTE E_STATUSADA_S6_S3 1 100 0 2 ECU_ADDRESS 0xFFF86681 /end MEASUREMENT
/begin MEASUREMENT status_k0_in "" UBYTE E_STATUSK0_S6_S3 1 100 0 5 ECU_ADDRESS 0xFFF86682 /end MEASUREMENT
/begin MEASUREMENT status_kl15_in "" UBYTE void_int_S6_S3 1 100 0 1 ECU_ADDRESS 0xFFF8669C /end MEASUREMENT
/begin MEASUREMENT status_kolbenpos_k0_in "" UBYTE void_int_S6_S3 1 100 0 255 ECU_ADDRESS 0xFFF86683 /end MEASUREMENT
/begin MEASUREMENT status_kraftfluss_egs_in "" UBYTE E_STATUSKSL_S6_S3 1 100 0 6 ECU_ADDRESS 0xFFF86684 /end MEASUREMENT
/begin MEASUREMENT status_kraftfluss_egs_roh_in "" UBYTE void_int_S6_S3 1 100 0 255 ECU_ADDRESS 0xFFF86685 /end MEASUREMENT
/begin MEASUREMENT status_ll_vm_in "" UBYTE void_int_S6_S3 1 100 0 255 ECU_ADDRESS 0xFFF86686 /end MEASUREMENT
/begin MEASUREMENT status_nem_in "Status zur Drehzahl E-Motor" UBYTE E_SIGSTATUS_S6_S3 1 100 0 2 ECU_ADDRESS 0xFFF86687 /end MEASUREMENT
/begin MEASUREMENT status_nreg_em_hst_in "Status E-Motor Drehzahlregelung der HST" UBYTE void_int_S6_S3 1 100 0 255 ECU_ADDRESS 0xFFF8669D /end MEASUREMENT
/begin MEASUREMENT status_nvm_in "Status zur Drehzahl VM-Motor" UBYTE E_SIGSTATUS_S6_S3 1 100 0 2 ECU_ADDRESS 0xFFF86688 /end MEASUREMENT
/begin MEASUREMENT status_posvueb_in "Erkennung PosV Diagnose" UBYTE void_int_S6_S3 1 100 0 255 ECU_ADDRESS 0xFFF86689 /end MEASUREMENT
/begin MEASUREMENT status_psys_has_sbe "" UBYTE E_STATUSPSY_S6_S3 1 100 0 4 ECU_ADDRESS 0xFFF86654 /end MEASUREMENT
/begin MEASUREMENT status_sa_vm_in "00 Keine Beeinflussung; 01 Schubabschaltung aktiv; 10 Nicht stellbarer Bereich; 11 Signal ungültig" UBYTE void_int_S6_S3 1 100 0 3 ECU_ADDRESS 0xFFF8669E /end MEASUREMENT
/begin MEASUREMENT status_schaltart_svh_has_sbe "Schaltart der angeforderten Schaltung der Schaltverhinderung der HAS (0 = keine Schaltung angefordert) - Bit-Codierung (m/oL=mit/ohne Lanstanh.)=: bit0=ZRSmL,1=ZHSmL,2=SRSmL,3=SHSmL,4=ZRSoL,5=ZHSoL,6=SRSoL,7=SHSoL" UBYTE void_int_S6_S3 1 100 0 255 ECU_ADDRESS 0xFFF8665B /end MEASUREMENT
/begin MEASUREMENT status_schaltung_egs_in "" SBYTE void_int_S6_S3 1 100 -9 9 ECU_ADDRESS 0xFFF86655 /end MEASUREMENT
/begin MEASUREMENT status_sync_schaltung_sbe "Anzeige der Synchronerkennung der aktuellen Schaltung innerhalb der HAS" UBYTE void_int_S6_S3 1 100 0 1 ECU_ADDRESS 0xFFF86656 /end MEASUREMENT
/begin MEASUREMENT status_waschstr_in "" UBYTE void_int_S6_S3 1 100 0 255 ECU_ADDRESS 0xFFF8668A /end MEASUREMENT
/begin MEASUREMENT status_zug_svh_sbe "Status für Anzeige Zug/Schub" UBYTE void_int_S6_S3 1 100 0 1 ECU_ADDRESS 0xFFF8665C /end MEASUREMENT
/begin MEASUREMENT staus_iae_plaus_ans "Plausibilisierung status_iae für Berechnung z_m_max_iae" UBYTE void_int_S6_S3 1 100 0 255 ECU_ADDRESS 0xFFF96DC4 /end MEASUREMENT
/begin MEASUREMENT t_23msollk0_ans_mes "Gemessen in im Output" FLOAT32_IEEE t_fl_S6_S3 1 100 -3.40282e+038 3.40282e+038 ECU_ADDRESS 0xFFF96A38 /end MEASUREMENT
/begin MEASUREMENT t_betrieb_pvu_has_ee_in "" ULONG t_int_S6_S3 1 100 0 10000 ECU_ADDRESS 0xFFF85E2C /end MEASUREMENT
/begin MEASUREMENT t_betrieb_pvu_has_sbe "Betriebsdauer seit dem letzten Ablauf der Diagnosefunktion \"Positionsventil-Überwachung\" der Funktion zur Unterstüt-zung der Positionsventil-Überwachung der HAS" FLOAT32_IEEE t_fl_S6_S3 1 100 0 1000000 ECU_ADDRESS 0xFFF85DB8 /end MEASUREMENT
/begin MEASUREMENT t_emaktiv_fuw_zus "Timer zur Funktionsüberwachung der EM-Funktion beim Zustart" FLOAT32_IEEE t_fl_S6_S3 1 100 0 1000 ECU_ADDRESS 0xFFF85B84 /end MEASUREMENT
/begin MEASUREMENT t_k0bef_kaltnem_zst_zus "Timer zur Sicherstellung der Ölversorgung zur Befüllung der K0 bei einem Kaltstart-Ablauf mit abgesenkter EM-Drehzahl im Zustand Zustarten beim Zustart" FLOAT32_IEEE t_fl_S6_S3 1 100 -3.40282e+038 3.40282e+038 ECU_ADDRESS 0xFFF96C78 /end MEASUREMENT
/begin MEASUREMENT t_k0sregaktiv_syn_zus "Timer der Verzögerungszeit zur Aktivierung der K0-Schlupfregelung nach Eintritt in den Zustand K0 Synchronisieren beim Zustart" FLOAT32_IEEE t_fl_S6_S3 1 100 0 5 ECU_ADDRESS 0xFFF85B88 /end MEASUREMENT
/begin MEASUREMENT t_k0sregbasis_syn_zus "Timer der Maximalzeit zum Setzen der Basisbedingung zur Aktivierung der K0-Schlupfregelung im Zustand K0 Synchronisieren beim Zustartart" FLOAT32_IEEE t_fl_S6_S3 1 100 0 10 ECU_ADDRESS 0xFFF85B8C /end MEASUREMENT
/begin MEASUREMENT t_k0syncerk_syn_zus "Timer zur Initialisierung der VM Solldrehzahlberechnung beim K0 Synchronisieren beim Zustart" FLOAT32_IEEE t_fl_S6_S3 1 100 -3.40282e+038 3.40282e+038 ECU_ADDRESS 0xFFF96C7C /end MEASUREMENT
/begin MEASUREMENT t_k0syncerkums_syn_zus "Timer für die Umschaltung der Differenzdrehzahlschwelle zur Erkennung Synchron bei VM-Zustart" FLOAT32_IEEE t_fl_S6_S3 1 100 -3.40282e+038 3.40282e+038 ECU_ADDRESS 0xFFF96C80 /end MEASUREMENT
/begin MEASUREMENT t_m_k0_mod_ziel_zus "Timer zur Berücksichtigung des K0-Istmoments als Zielmoment für das modifizierte K0-Sollmoment beim K0-Schliessen beim VM-Zustart" FLOAT32_IEEE t_fl_S6_S3 1 100 -3.40282e+038 3.40282e+038 ECU_ADDRESS 0xFFF96C84 /end MEASUREMENT
/begin MEASUREMENT t_m_soll_k0_anst_zus "Timer zur Erkennung Synchron beim K0 Synchronisieren beim Zustart" FLOAT32_IEEE t_fl_S6_S3 1 100 -3.40282e+038 3.40282e+038 ECU_ADDRESS 0xFFF96C88 /end MEASUREMENT
/begin MEASUREMENT t_maxbed_abb_zus "Timer zur Überwachung der maximalen Verweildauer im Zustand zustart_abbruch_zus im Zustart" FLOAT32_IEEE t_fl_S6_S3 1 100 -3.40282e+038 3.40282e+038 ECU_ADDRESS 0xFFF96C8C /end MEASUREMENT
/begin MEASUREMENT t_maxbed_scl_zus "Timer zur Überwachung der maximalen VErweildauer im Zustand Schaltung aktiv im Zustart" FLOAT32_IEEE t_fl_S6_S3 1 100 -3.40282e+038 3.40282e+038 ECU_ADDRESS 0xFFF96C90 /end MEASUREMENT
/begin MEASUREMENT t_mdzielsollk0_syn_zus "Timer zur Überwachung der maximalen Verweildauer im Zustand Schliessen im Zustart" FLOAT32_IEEE t_fl_S6_S3 1 100 -3.40282e+038 3.40282e+038 ECU_ADDRESS 0xFFF96C94 /end MEASUREMENT
/begin MEASUREMENT t_msollemaktiv_ans_mes "Timer Überwachung Ausgabe m_soll_em_has (Max.-Zeit)" FLOAT32_IEEE t_fl_S6_S3 1 100 -3.40282e+038 3.40282e+038 ECU_ADDRESS 0xFFF96A54 /end MEASUREMENT
/begin MEASUREMENT t_mstoerk0emfil_ans "Timerzeit zur Init. m_stoer_k0" FLOAT32_IEEE t_fl_S6_S3 1 100 -3.40282e+038 3.40282e+038 ECU_ADDRESS 0xFFF96A58 /end MEASUREMENT
/begin MEASUREMENT t_ndgk0k0sreg_syn_zus "Timer der Mindestdauer bei der Abfrage des K0-Differenzdrehzahlgradienten zur Bestimmung des Zeitpunkt der Anforderung der Aktivierung der K0-Schlupfregelung im Zustand K0 Synchronisieren beim Zustart" FLOAT32_IEEE t_fl_S6_S3 1 100 0 5 ECU_ADDRESS 0xFFF85BA0 /end MEASUREMENT
/begin MEASUREMENT t_statusiaeplaus_ans "Zeit zur Anfilterung für nicht erreichten 
IAE-Schlupf nd_iae bei 
status_iae_in = 4 (IAE entkoppelt)" FLOAT32_IEEE t_fl_S6_S3 1 100 -3.40282e+038 3.40282e+038 ECU_ADDRESS 0xFFF96A5C /end MEASUREMENT
/begin MEASUREMENT t_vmstatus_abf_zus "Timer der Maximalzeit der Beruecksichtigung der Anzeige VM selbstlauffaehig als Uebergangsbedingung nach K0- Synchronisieren im Zustand VM-Abfangen beim Zustart" FLOAT32_IEEE t_fl_S6_S3 1 100 0 5 ECU_ADDRESS 0xFFF85BA4 /end MEASUREMENT
/begin MEASUREMENT t_vmstatus_anh_zus "Timer der Maximalzeit der Beruecksichtigung der Anzeige VM selbstlauffaehig als Uebergangsbedingung nach K0- Synchronisieren im Zustand VM-Drehzahlanhebung beim Zustart" FLOAT32_IEEE t_fl_S6_S3 1 100 0 5 ECU_ADDRESS 0xFFF85BA8 /end MEASUREMENT
/begin MEASUREMENT v_f_sbe "Fahrzeuggeschwindigkeit auf Basis der Getriebeabtriebsdrehzahl in der  Hybridablaufsteuerung" FLOAT32_IEEE v_fl_S6_S3 1 100 -3.40282e+038 3.40282e+038 ECU_ADDRESS 0xFFF85DBC /end MEASUREMENT
/begin MEASUREMENT vg_f_sbe "Fahrzeuggeschwindigkeitsgradient auf Basis der Getriebeabtriebsdrehzahl in der  Hybridablaufsteuerung" FLOAT32_IEEE vg_fl_S6_S3 1 100 -3.40282e+038 3.40282e+038 ECU_ADDRESS 0xFFF85DC0 /end MEASUREMENT
/begin MEASUREMENT z_ablauf_has_hst_in "" UBYTE void_int_S6_S3 1 100 0 15 ECU_ADDRESS 0xFFF8668B /end MEASUREMENT
/begin MEASUREMENT z_ablauf_has_stg "Zusaetzliche Steuergroesse zur Ablaufsteuerung" UBYTE void_int_S6_S3 1 100 0 15 ECU_ADDRESS 0xFFF86637 /end MEASUREMENT
/begin MEASUREMENT z_ablauf_svh_reset_has_fkt "" UBYTE void_int_S6_S3 1 100 0 255 ECU_ADDRESS 0xFFF8663D /end MEASUREMENT
/begin MEASUREMENT z_ablaufreinit_frk_dihi "Zeigt an, dass der aktuelle HAS-Ablauf erneut begonnen werden soll" UBYTE void_int_S6_S3 1 100 0 1 ECU_ADDRESS 0xFFF8662F /end MEASUREMENT
/begin MEASUREMENT z_ablaufvariante_has_hst_in "" UBYTE void_int_S6_S3 1 100 0 15 ECU_ADDRESS 0xFFF8668C /end MEASUREMENT
/begin MEASUREMENT z_ablaufvariante_has_stg "Ablaufvariante, die  die OML ausgibt" UBYTE void_int_S6_S3 1 100 0 99 ECU_ADDRESS 0xFFF86638 /end MEASUREMENT
/begin MEASUREMENT z_ba_has_k0_hst_in "" UBYTE void_int_S6_S3 1 100 0 1 ECU_ADDRESS 0xFFF8669F /end MEASUREMENT
/begin MEASUREMENT z_ba_has_vm_hst_in "" UBYTE void_int_S6_S3 1 100 0 1 ECU_ADDRESS 0xFFF866A0 /end MEASUREMENT
/begin MEASUREMENT z_diag_ersfkt_has_in "Funktionsschnittstelle zur Ermittlung ob irgendeine Ersatzmaßnahme in der Diagnoseverwaltung aktiv ist" ULONG b_int_S6_S3 1 100 0 4294967295 ECU_ADDRESS 0xFFF85E30 /end MEASUREMENT
/begin MEASUREMENT z_diag_ersfkt_hi_has_in "Funktionsschnittstelle zur Ermittlung ob irgendeine Ersatzmaßnahme in der Diagnoseverwaltung aktiv ist" ULONG b_int_S6_S3 1 100 0 4294967295 ECU_ADDRESS 0xFFF85E34 /end MEASUREMENT
/begin MEASUREMENT z_diag_notgang_has_in "Notganginformation" UBYTE void_int_S6_S3 1 100 0 255 ECU_ADDRESS 0xFFF8668D /end MEASUREMENT
/begin MEASUREMENT z_emfehler_frk_dihi "Zeigt an, dass eine EM Fehlfunktion erkannt wurde, die in der HAS ausgewertet werden soll" UBYTE void_int_S6_S3 1 100 0 1 ECU_ADDRESS 0xFFF86630 /end MEASUREMENT
/begin MEASUREMENT z_freigabe_pvu_has_sbe "Freigabe zur Aktivierung der Diagnosefunktion \"Positionsventil-Überwachung\" der Funktion zur Unterstützung der Positi-onsventil-Überwachung der HAS" UBYTE void_int_S6_S3 1 100 0 1 ECU_ADDRESS 0xFFF86657 /end MEASUREMENT
/begin MEASUREMENT z_fuwdeakt_frk_dihi "Zeigt an, dass die FUW-Funktion nicht aktiviert werden darf" UBYTE void_int_S6_S3 1 100 0 1 ECU_ADDRESS 0xFFF86631 /end MEASUREMENT
/begin MEASUREMENT z_hybfkt_stg "Anforderung der Aktivierung einer Hybridfunktion durch die Hyrid-Zustandssteuerung" UBYTE E_HYBFKT_S6_S3 1 100 0 15 ECU_ADDRESS 0xFFF86639 /end MEASUREMENT
/begin MEASUREMENT z_iae_entkoppelt_has "Gemessen in Zustart Out" UBYTE void_int_S6_S3 1 100 0 255 ECU_ADDRESS 0xFFF96DC7 /end MEASUREMENT
/begin MEASUREMENT z_iaeoeffnen_ans "Gemessen in Input-Steuersignale-status_iae_oeffnen" UBYTE void_int_S6_S3 1 100 0 255 ECU_ADDRESS 0xFFF96DC8 /end MEASUREMENT
/begin MEASUREMENT z_iep_in "" UBYTE E_ZIEP_S6_S3 1 100 0 4 ECU_ADDRESS 0xFFF8668E /end MEASUREMENT
/begin MEASUREMENT z_init_sta "Anforderung der Initialisierung der Zustandssteuerung (OML) durch die Strategieanpassung" UBYTE void_int_S6_S3 1 100 0 15 ECU_ADDRESS 0xFFF8666A /end MEASUREMENT
/begin MEASUREMENT z_k0_befuellopt_has "Gemessen in Zustart/Output" UBYTE void_int_S6_S3 1 100 0 255 ECU_ADDRESS 0xFFF96DC9 /end MEASUREMENT
/begin MEASUREMENT z_k0_fst_in "" UBYTE E_ZK0FSTIN_S6_S3 1 100 0 3 ECU_ADDRESS 0xFFF8668F /end MEASUREMENT
/begin MEASUREMENT z_k0_has_fkt "" UBYTE E_ZK0_S6_S3 1 100 0 5 ECU_ADDRESS 0xFFF86643 /end MEASUREMENT
/begin MEASUREMENT z_k0_has_sbe "" UBYTE E_ZK0_S6_S3 1 100 0 5 ECU_ADDRESS 0xFFF8665D /end MEASUREMENT
/begin MEASUREMENT z_k0sus_syn_zus "Anzeige der Aktivierung der Funktion zur Synchronisationsunterstützung (SUS) im Zustand K0 Synchronisieren beim Zustart" UBYTE void_int_e_S6_S3 1 100 0 1 ECU_ADDRESS 0xFFF86586 /end MEASUREMENT
/begin MEASUREMENT z_k0syncmk0erh_frk_dihi "Zeigt an, dass eine K0-Zwangsynchronisation mittels Erhöhung des K0-Moments erfolgen soll" UBYTE void_int_S6_S3 1 100 0 1 ECU_ADDRESS 0xFFF86632 /end MEASUREMENT
/begin MEASUREMENT z_kps_stada_in "Sollvorgabe für die Trennkupplung K0 durch die Stillstandsadaption" UBYTE void_int_S6_S3 1 100 0 255 ECU_ADDRESS 0xFFF86690 /end MEASUREMENT
/begin MEASUREMENT z_m_max_iae_ablvar_has "Gemessen in St_Konditionieren_En_St" UBYTE void_int_S6_S3 1 100 0 255 ECU_ADDRESS 0xFFF96DCA /end MEASUREMENT
/begin MEASUREMENT z_modus_em_hst_in "" UBYTE void_int_S6_S3 1 100 0 255 ECU_ADDRESS 0xFFF86691 /end MEASUREMENT
/begin MEASUREMENT z_modus_iae_has_sbe "" UBYTE E_ZMODUSIAE_S6_S3 1 100 0 2 ECU_ADDRESS 0xFFF8665E /end MEASUREMENT
/begin MEASUREMENT z_modus_iep_has_sbe "Vorgabe des Betriebsmodus der IEP durch die HAS" UBYTE E_ZMODUSIEP_S6_S3 1 100 0 4 ECU_ADDRESS 0xFFF8665F /end MEASUREMENT
/begin MEASUREMENT z_msa_avh_moni_has_sbe "Anforderung einer Schaltverhinderung der HAS" UBYTE void_int_S6_S3 1 100 0 255 ECU_ADDRESS 0xFFF86660 /end MEASUREMENT
/begin MEASUREMENT z_msa_eaf_moni_has_sbe "Anforderung einer Schaltverhinderung der HAS" UBYTE void_int_S6_S3 1 100 0 255 ECU_ADDRESS 0xFFF86661 /end MEASUREMENT
/begin MEASUREMENT z_msa_fst_in "Anforderung einer Abschaltverhinderung durch die Fahrstrategie ASIS" UBYTE void_int_S6_S3 1 100 0 255 ECU_ADDRESS 0xFFF86692 /end MEASUREMENT
/begin MEASUREMENT z_msa_has_sbe "Anforderung der Beeinflussung der MSA-Funktionalität durch die Hybridablaufsteuerung - Codierung: bit0 = AVZ, bit1 = AVH, bit2 = EAF, bit3 = EVH, bit4 = Deaktivierung, bit7 = Störungsbedingt" UBYTE void_int_S6_S3 1 100 0 255 ECU_ADDRESS 0xFFF86662 /end MEASUREMENT
/begin MEASUREMENT z_msa_stada_in "" UBYTE void_int_S6_S3 1 100 0 6 ECU_ADDRESS 0xFFF866A1 /end MEASUREMENT
/begin MEASUREMENT z_n_min_em_parksp_has_in "Anforderung einer EM-Drehzahlanhebung beim Auslegen der Parksperre infolge unzureichender Ölversorgung" UBYTE void_int_S6_S3 1 100 0 1 ECU_ADDRESS 0xFFF86693 /end MEASUREMENT
/begin MEASUREMENT z_n_min_iep_in "Anforderung Ausgabe EM-Mindestdrehzahl zur Sicherstellung der Ölversorgung durch die IEP" UBYTE void_int_S6_S3 1 100 0 1 ECU_ADDRESS 0xFFF86694 /end MEASUREMENT
/begin MEASUREMENT z_n_soll_em_aktiv_ans_mes "Gemessen in SLST Input" UBYTE void_int_S6_S3 1 100 0 1 ECU_ADDRESS 0xFFF96DCB /end MEASUREMENT
/begin MEASUREMENT z_ndsk0k0sreg_syn_zus "Anzeige des Aktivierungszeitpunkts im Bestimmungsmodus \"NDSK0\" zur Anforderung der Aktivierung der K0-Schlupfregelung im Zustand K0 Synchronisieren beim Zustart" UBYTE void_int_S6_S3 1 100 0 1 ECU_ADDRESS 0xFFF86587 /end MEASUREMENT
/begin MEASUREMENT z_nllsoll_iae_in "Anforderung der IAE, dass eine definierte LL-Drehzahl durch den Motor eingestellt werden soll" UBYTE E_ZNLLSOLL_S6_S3 1 100 0 2 ECU_ADDRESS 0xFFF86695 /end MEASUREMENT
/begin MEASUREMENT z_nminemnull_frk_dihi "Zeigt an, dass die Ausgabe der minimalen EM Drehzahl der HAS unterdrückt werden soll." UBYTE void_int_S6_S3 1 100 0 1 ECU_ADDRESS 0xFFF86633 /end MEASUREMENT
/begin MEASUREMENT z_nvmausbed_ast_vma "Timer zur Erkennung VM aus als Übergangsbedingung nach Übergabe im Zustand Zustarten der Hybridfunktion VM aus" UBYTE void_int_S6_S3 1 100 0 10 ECU_ADDRESS 0xFFF8653B /end MEASUREMENT
/begin MEASUREMENT z_nvmeinzugk0sreg_syn_zus "Anzeige des Aktivierungszeitpunkts im Bestimmungsmodus \"NVMEINZUG\" zur Anforderung der Aktivierung der K0-Schlupfregelung im Zustand K0 Synchronisieren beim Zustart" UBYTE void_int_S6_S3 1 100 0 1 ECU_ADDRESS 0xFFF86588 /end MEASUREMENT
/begin MEASUREMENT z_nvmsollbegr_frk_dihi "Zeigt an, dass die VM-Solldrehzahl auf die EM-Istdrehzahl be-grenzt werden soll" UBYTE void_int_S6_S3 1 100 0 1 ECU_ADDRESS 0xFFF86634 /end MEASUREMENT
/begin MEASUREMENT z_pvu_has_sbe "Beeinflussung des Hybridsystems zur Unterstützung der Positionsventil- Überwachung der HAS-Codierung: 0 = keine Beeinflussung, 1 = Beeinflussung Stufe 1, 2 = Beeinflussung Stufe 2" UBYTE void_int_S6_S3 1 100 0 2 ECU_ADDRESS 0xFFF86658 /end MEASUREMENT
/begin MEASUREMENT z_respschleschaltaktiv_ans "Gemessen in Schleppstart/Input" UBYTE void_int_S6_S3 1 100 0 255 ECU_ADDRESS 0xFFF96DCC /end MEASUREMENT
/begin MEASUREMENT z_sas_has_sbe "Ändert im Wahrheitsfall die KupplungsBefüllreihenfolge" UBYTE void_int_S6_S3 1 100 0 1 ECU_ADDRESS 0xFFF86663 /end MEASUREMENT
/begin MEASUREMENT z_start_modus_has_sbe "Anforderung eines Anlasserstarts" UBYTE void_int_S6_S3 1 100 0 255 ECU_ADDRESS 0xFFF86664 /end MEASUREMENT
/begin MEASUREMENT z_status_psys_mps_sbe "Flag, das eine Modifikation des Pumpendruckstatus anzeigt" UBYTE void_int_S6_S3 1 100 0 1 ECU_ADDRESS 0xFFF86659 /end MEASUREMENT
/begin MEASUREMENT z_svh_abbrlaus_fst_zus "Anzeige des Abbruchs einer laufenden Schaltung durch die Fahrstrategie beim Zustart" UBYTE void_int_S6_S3 1 100 0 1 ECU_ADDRESS 0xFFF86589 /end MEASUREMENT
/begin MEASUREMENT z_svh_has_sbe "Anforderung einer Schaltverhinderung der HAS" UBYTE void_int_S6_S3 1 100 0 1 ECU_ADDRESS 0xFFF86665 /end MEASUREMENT
/begin MEASUREMENT z_svh_reset_palaus_zus "Anzeige der Schaltart der, zum Zustart-Ablaufs parallel laufend, freigegebenen Schaltungen beim Zustart -> Bit-Codierung wie z_ablauf_shv_reset_has" UBYTE void_int_S6_S3 1 100 0 255 ECU_ADDRESS 0xFFF8658B /end MEASUREMENT
/begin MEASUREMENT z_t_iaeentkoppelt_statusiae "Timer für Wartezeit - status_iae 8 in Verbindung mit Entkopplungsversuch" UBYTE void_int_S6_S3 1 100 0 1 ECU_ADDRESS 0xFFF96DB0 /end MEASUREMENT
/begin MEASUREMENT z_t_k0zunemfehlerbed_fuw_zus "Bedingung Timer bei  fehlerhafter EM-Drehzahl der Funktionsüberwachung der EM-Funktion beim Zustart " UBYTE void_int_S6_S3 1 100 0 255 ECU_ADDRESS 0xFFF96DE7 /end MEASUREMENT
/begin MEASUREMENT z_t_maxbed_sak_zus "Bedingung Timer zur Überwachung der maximalen VErweildauer im Zustand Schaltung aktiv im Zustart" UBYTE void_int_S6_S3 1 100 0 255 ECU_ADDRESS 0xFFF96DE9 /end MEASUREMENT
/begin MEASUREMENT z_t_msollemaktiv_ans "Timer Überwachung Ausgabe m_soll_em_has (Max.-Zeit)" UBYTE void_int_S6_S3 1 100 0 255 ECU_ADDRESS 0xFFF96DD4 /end MEASUREMENT
/begin MEASUREMENT z_tmaxiaeoeffnen_ans "Zustand Maxtimer IAE oeffnen" UBYTE void_int_S6_S3 1 100 0 255 ECU_ADDRESS 0xFFF96DD5 /end MEASUREMENT
/begin MEASUREMENT z_ziel_kraftfluss_egs_in "" UBYTE void_int_S6_S3 1 100 0 255 ECU_ADDRESS 0xFFF86696 /end MEASUREMENT
/begin MEASUREMENT zielgang_egs_in "" SBYTE void_int_S6_S3 1 100 -128 127 ECU_ADDRESS 0xFFF86697 /end MEASUREMENT
/begin FUNCTION SFOp_SLST6_Input ""
 /begin SUB_FUNCTION SFOp_SLST35_st__psys_em_has_sbe SFOp_SLST34_m_ziel_vm_has_zus Run_SFOp_SLST1__PPELT_STATUS_8_ Run_SFOp_SLST1__ger_TMAXIAEOEFF Run_SFOp_SLST1__imer_testablvar Run_SFOp_SLST9___statusiaeplaus Run_SFOp_SLST8__t_mstoerk0emfil Run_SFOp_SLST8__T1_m_stoer_em_2 Run_SFOp_SLST8__T1_m_stoer_em_1 SFOp_SLST81_Triggered_Subsystem /end SUB_FUNCTION
 /begin DEF_CHARACTERISTIC KF_FFKMSTOERKPL_ANS_W KF_FFKMSTOERKPL_ANS_X KF_FFKMSTOERKPL_ANS_Y KF_FKMSTOERKPL_ANS_W KF_FKMSTOERKPL_ANS_X KF_FKMSTOERKPL_ANS_Y KF_FMOSTOERKPL_ANS_W KF_FMOSTOERKPL_ANS_X KF_FMOSTOERKPL_ANS_Y KF_FMSTOERKPL_ANS_W KF_FMSTOERKPL_ANS_X KF_FMSTOERKPL_ANS_Y KF_FMSTOERND_VMS_ANS_W KF_FMSTOERND_VMS_ANS_X KF_FMSTOERND_VMS_ANS_Y KF_IAEENTK_STIAEKRAFTFL_ANS_W KF_IAEENTK_STIAEKRAFTFL_ANS_X KF_IAEENTK_STIAEKRAFTFL_ANS_Y KF_KOLBPOSINITTIMER_ANS_W KF_KOLBPOSINITTIMER_ANS_X KF_KOLBPOSINITTIMER_ANS_Y KF_MOIAEENTKERK1_ANS_W KF_MOIAEENTKERK1_ANS_X KF_MOIAEENTKERK1_ANS_Y KF_MOIAEENTKERK2_ANS_W KF_MOIAEENTKERK2_ANS_X KF_MOIAEENTKERK2_ANS_Y KF_MOSTOERKPL_ANS_W KF_MOSTOERKPL_ANS_X KF_MOSTOERKPL_ANS_Y KF_STATUS_IAE_PLAUS_ANS_W KF_STATUS_IAE_PLAUS_ANS_X KF_STATUS_IAE_PLAUS_ANS_Y KF_TVMSTOERK0EMFIL_ANS_W KF_TVMSTOERK0EMFIL_ANS_X KF_TVMSTOERK0EMFIL_ANS_Y KF_ZMMAXABLVARNLLVM_ANS_W KF_ZMMAXABLVARNLLVM_ANS_X KF_ZMMAXABLVARNLLVM_ANS_Y KF_ZMMAXIAEISTGANGABLVAR_ANS_W KF_ZMMAXIAEISTGANGABLVAR_ANS_X KF_ZMMAXIAEISTGANGABLVAR_ANS_Y KF_ZMMAXSTSIAE_ANS_W KF_ZMMAXSTSIAE_ANS_X KF_ZMMAXSTSIAE_ANS_Y KF_ZNSOLLEM_STIAEKRAFTFL_ANS_W KF_ZNSOLLEM_STIAEKRAFTFL_ANS_X KF_ZNSOLLEM_STIAEKRAFTFL_ANS_Y KF_ZSCHLEPPSCHALTABLVAR_ANS_W KF_ZSCHLEPPSCHALTABLVAR_ANS_X KF_ZSCHLEPPSCHALTABLVAR_ANS_Y KF_Z_MOMAXIAE_ANS_W KF_Z_MOMAXIAE_ANS_X KF_Z_MOMAXIAE_ANS_Y KL_ENTKMOEGLIAESTIAEKRAFT_ANS_X KL_ENTKMOEGLIAESTIAEKRAFT_ANS_Y KL_FMSTOERNDZABLVAR_ANS_X KL_FMSTOERNDZABLVAR_ANS_Y KL_IAEENTK_ISTGANG_ANS_X KL_IAEENTK_ISTGANG_ANS_Y KL_TMAXIAEOEFCGETR_ANS_X KL_TMAXIAEOEFCGETR_ANS_Y KL_UMSCHZMMAXIAE_STKRAFT_ANS_X KL_UMSCHZMMAXIAE_STKRAFT_ANS_Y KL_ZK0ENTKAKTIVABLVAR_ANS_X KL_ZK0ENTKAKTIVABLVAR_ANS_Y KL_ZNSOLLEM_ISTGANG_ANS_X KL_ZNSOLLEM_ISTGANG_ANS_Y KL_ZNSOLLVMAKTIVABLVAR_ANS_X KL_ZNSOLLVMAKTIVABLVAR_ANS_Y NDS_15ZNSOLLEM_INAKTIV_ANS NDS_IAE_PLAUS_ANS NDS_SOLLIAE_PLAUS_ANS NS_2VMDREHT_ANS NS_2VMLAEUFT_ANS NS_NEMSTATUSWECHSELIAE_ANS NS_VMMRESAUS_ANS STATUS_2ABLVMDREHT_HST_ANS STATUS_2ABLVMLAEUFT_HST_ANS STATUS_ABL_101_ZIAEENTK_HST_ANS SWI_ABFZMMAXIAEHAS_ANS SWI_RESPSCHLE_SCHALT_ANS SWI_STATUSIAE_PLAUS_ANS SWI_TESTABLVAR_ANS SWI_UMSCH_NDIAENEM_ANS T_STATUSIAE_PLAUS_ANS T_STATUSWECHSELIAE_ANS T_TESTABLVAR_ANS Z_MMAXIAEZMODUSIAE_ANS Z_TESTABLVAR_ANS /end DEF_CHARACTERISTIC
 /begin LOC_MEASUREMENT SFOp_SLST110_K__IAEENTKERK1_ANS SFOp_SLST110_K__IAEENTKERK2_ANS abstellpos_vm_in abstellpos_vm_status_in bErrorHybrid bExceptionHybrid c_getriebe_egs_in c_vm_in gangwechsel_egs_in i_istgang_egs i_zielgang_egs istgang_egs_in m_em_in m_iae_in m_k0_in m_k0_mber_has_sbe m_max_dyn_em_in m_min_dyn_em_in m_min_vm_in m_mot_in m_motmax_has m_soll_em_hst_in m_soll_res_em_bas_sbe m_soll_res_em_has_sbe m_soll_vm_hst_in m_soll_vm_l_hst_in m_stoer_k0_em_fil m_vm_in m_vm_start_in m_wunsch_fpw_hst_fil m_wunsch_fpw_hst_in m_wunsch_fpw_in mg_wunsch_fpw mg_wunsch_fpw_hst msollresem_stat_mes n_ab_egs_in n_em_in n_min_em_has_sbe n_min_psys_em_has_sbe n_mot_soll_iae_in n_sec_iae n_soll_em_hst_in n_soll_ll_vm_in n_t_egs_in n_vm_in nd_iae nd_k0_in ndg_k0_in ng_vm osmode_next_in p_bremse_fzg_in phi_neigung_in pos_egs_in sollgang_egs_in st_OMLID_act_stg st_ist_bz_has_stg st_ist_bz_hst_sta st_soll_bz_has_hst st_soll_bz_hst_sta st_ziel_bz_has_stg status_alaengs_adaoff_in status_betriebsbereit_hst_in status_efahren_has_sbe status_fehler15_eh_diagin status_fehler_iep_in status_iae_adap_in status_iae_in status_iep_in status_k0_adap_in status_k0_in status_kl15_in status_kolbenpos_k0_in status_kraftfluss_egs_in status_kraftfluss_egs_roh_in status_ll_vm_in status_nem_in status_nreg_em_hst_in status_nvm_in status_posvueb_in status_psys_has_sbe status_sa_vm_in status_schaltart_svh_has_sbe status_schaltung_egs_in status_sync_schaltung_sbe status_waschstr_in status_zug_svh_sbe staus_iae_plaus_ans t_betrieb_pvu_has_ee_in t_betrieb_pvu_has_sbe t_mstoerk0emfil_ans t_statusiaeplaus_ans v_f_sbe vg_f_sbe z_ablauf_has_hst_in z_ablauf_has_stg z_ablaufreinit_frk_dihi z_ablaufvariante_has_hst_in z_ablaufvariante_has_stg z_ba_has_k0_hst_in z_ba_has_vm_hst_in z_diag_ersfkt_has_in z_diag_ersfkt_hi_has_in z_diag_notgang_has_in z_emfehler_frk_dihi z_freigabe_pvu_has_sbe z_fuwdeakt_frk_dihi z_hybfkt_stg z_iae_entkoppelt_has z_iaeoeffnen_ans z_iep_in z_init_sta z_k0_fst_in z_k0_has_sbe z_k0syncmk0erh_frk_dihi z_kps_stada_in z_m_max_iae_ablvar_has z_modus_em_hst_in z_modus_iae_has_sbe z_modus_iep_has_sbe z_msa_avh_moni_has_sbe z_msa_eaf_moni_has_sbe z_msa_fst_in z_msa_has_sbe z_msa_stada_in z_n_min_em_parksp_has_in z_n_min_iep_in z_n_soll_em_aktiv_ans_mes z_nllsoll_iae_in z_nminemnull_frk_dihi z_nvmsollbegr_frk_dihi z_pvu_has_sbe z_respschleschaltaktiv_ans z_sas_has_sbe z_start_modus_has_sbe z_status_psys_mps_sbe z_svh_has_sbe z_t_iaeentkoppelt_statusiae z_tmaxiaeoeffnen_ans z_ziel_kraftfluss_egs_in zielgang_egs_in /end LOC_MEASUREMENT
/end FUNCTION
/begin FUNCTION SFOp_SLST7_Output ""
 /begin SUB_FUNCTION Run_SFOp_SLST156_cDelay_vm Run_SFOp_SLST1__r_ve_nsollvmhas Run_SFOp_SLST146_CL_DT1_ngvm Run_SFOp_SLST1__sollemaktiv_ans /end SUB_FUNCTION
 /begin DEF_CHARACTERISTIC FK_NGNSOLLVMVE_ANS FK_NSOLLVMVE_ANS KL_MSSOLLEMAKTIVSTKRAFTFL_ANS_X KL_MSSOLLEMAKTIVSTKRAFTFL_ANS_Y KL_MSSOLLEMAKTIV_ANS_X KL_MSSOLLEMAKTIV_ANS_Y KL_SVHSTKRAFTFLUSS_ANS_X KL_SVHSTKRAFTFLUSS_ANS_Y NG_SOLLVMMAXVE_ANS NO_NSOLLVMBEGRLOWVE_ANS NO_NSOLLVMBEGRUPVE_ANS SWI_AUSW_NSOLLVMVE_ANS SWI_VZMSOLLK0AKTIV_ANS T_MSOLLEMAKTIV_ANS /end DEF_CHARACTERISTIC
 /begin LOC_MEASUREMENT abstellpos_vm_in abstellpos_vm_status_in c_getriebe_egs_in c_vm_in gangwechsel_egs_in i_istgang_egs i_zielgang_egs istgang_egs_in m_em_in m_iae_in m_k0_in m_max_dyn_em_in m_min_vm_in m_mot_in m_soll_em_hst_in m_soll_vm_hst_in m_soll_vm_l_hst_in m_sollk0has_nverz_mes m_stoer_k0_em_fil m_vm_in m_vm_start_in m_wunsch_fpw_hst_fil m_wunsch_fpw_hst_in m_wunsch_fpw_in m_ziel_vm_has_ans n_ab_egs_in n_em_in n_min_psys_em_has_sbe n_mot_soll_iae_in n_sec_iae n_soll_ll_vm_in n_soll_vm_bas_ve_ans n_vm_in nd_iae nd_k0_in ndg_k0_in ng_sollvmdt1ve_ans ng_vm no_nsollvmve_ans no_sollvmbegrve_ans sollgang_egs_in status_iae_in status_k0_in status_kraftfluss_egs_in status_ll_vm_in status_schaltung_egs_in status_sync_schaltung_sbe status_zug_svh_sbe t_23msollk0_ans_mes t_msollemaktiv_ans_mes z_ablauf_has_hst_in z_ablauf_has_stg z_ablaufvariante_has_stg z_iae_entkoppelt_has z_k0_befuellopt_has z_modus_em_hst_in z_n_soll_em_aktiv_ans_mes z_respschleschaltaktiv_ans z_svh_has_sbe z_t_msollemaktiv_ans zielgang_egs_in /end LOC_MEASUREMENT
/end FUNCTION
/begin FUNCTION SFOp_SLST81_Triggered_Subsystem "" /begin LOC_MEASUREMENT m_soll_res_em_bas_sbe /end LOC_MEASUREMENT /end FUNCTION
/begin FUNCTION SFOp_SLST9_St_Ablauf ""
 /begin SUB_FUNCTION SFOp_SLST162_St_Uebergabe SFOp_SLST161_St_Schaltung_aktiv SFOp_SLST160_Schleppstart /end SUB_FUNCTION
/end FUNCTION
/begin FUNCTION SFOp_VMA10_St_Start "" /begin SUB_FUNCTION SFOp_VMA36_Entry /end SUB_FUNCTION /begin DEF_CHARACTERISTIC K_SVH_RESET_SRT_VMA /end DEF_CHARACTERISTIC /end FUNCTION
/begin FUNCTION SFOp_VMA23_st_abstellen_vma "" /begin SUB_FUNCTION Run_SFOp_VMA30_cTimer_trigger_ SFOp_VMA25_Entry /end SUB_FUNCTION
 /begin DEF_CHARACTERISTIC K_SVH_RESET_AST_VMA NS_VMAUSERK_AST_VMA STATUS_ABL_AST_VMA T_NVMAUSERK_AST_VMA /end DEF_CHARACTERISTIC
 /begin LOC_MEASUREMENT SFOp_VMA30_isActive_ n_vm_in z_ablauf_has_hst_in /end LOC_MEASUREMENT
/end FUNCTION
/begin FUNCTION SFOp_VMA24_st_uebergabe_vma "" /begin SUB_FUNCTION SFOp_VMA33_Entry /end SUB_FUNCTION /end FUNCTION
/begin FUNCTION SFOp_VMA25_Entry "" /begin DEF_CHARACTERISTIC K_SVH_RESET_AST_VMA STATUS_ABL_AST_VMA /end DEF_CHARACTERISTIC /begin LOC_MEASUREMENT n_vm_in z_ablauf_has_hst_in /end LOC_MEASUREMENT /end FUNCTION
/begin FUNCTION SFOp_VMA2_FOp_VMA "" /begin SUB_FUNCTION SFOp_VMA10_St_Start SFOp_VMA9_St_Ablauf SFOp_VMA6_Input /end SUB_FUNCTION /begin DEF_CHARACTERISTIC Z_ABLAUFHASHST_VMAUSERK_VMA /end DEF_CHARACTERISTIC
 /begin LOC_MEASUREMENT abstellpos_vm_in abstellpos_vm_status_in c_getriebe_egs_in c_vm_in gangwechsel_egs_in i_istgang_egs i_zielgang_egs istgang_egs_in m_em_in m_iae_in m_k0_in m_k0_mber_has_sbe m_k0_mod_has_fkt m_max_dyn_em_in m_min_dyn_em_in m_min_vm_in m_mot_in m_motmax_has m_soll_em_hst_in m_soll_k0_has_fkt m_soll_res_em_bas_sbe m_soll_res_em_has_sbe m_soll_vm_hst_in m_soll_vm_l_hst_in m_vm_in m_vm_start_in m_wunsch_fpw_hst_fil m_wunsch_fpw_hst_in m_wunsch_fpw_in mg_wunsch_fpw mg_wunsch_fpw_hst n_ab_egs_in n_em_in n_min_em_has_sbe n_min_psys_em_has_sbe n_mot_soll_iae_in n_sec_iae n_soll_em_hst_in n_soll_ll_vm_in n_t_egs_in n_vm_in nd_iae nd_k0_in ndg_k0_in ng_vm osmode_next_in p_bremse_fzg_in phi_neigung_in pos_egs_in sollgang_egs_in st_OMLID_act_stg st_ist_bz_has_stg st_soll_bz_has_hst st_ziel_bz_has_stg status_alaengs_adaoff_in status_betriebsbereit_hst_in status_efahren_has_sbe status_fehler15_eh_diagin status_fehler_iep_in status_iae_adap_in status_iae_in status_iep_in status_k0_adap_in status_k0_in status_kl15_in status_kolbenpos_k0_in status_kraftfluss_egs_in status_kraftfluss_egs_roh_in status_ll_vm_in status_nem_in status_nreg_em_hst_in status_nvm_in status_posvueb_in status_psys_has_sbe status_sa_vm_in status_schaltart_svh_has_sbe status_schaltung_egs_in status_sync_schaltung_sbe status_waschstr_in status_zug_svh_sbe t_betrieb_pvu_has_ee_in t_betrieb_pvu_has_sbe v_f_sbe vg_f_sbe z_ablauf_has_hst_in z_ablauf_has_stg z_ablaufreinit_frk_dihi z_ablaufvariante_has_hst_in z_ablaufvariante_has_stg z_ba_has_k0_hst_in z_ba_has_vm_hst_in z_diag_ersfkt_has_in z_diag_ersfkt_hi_has_in z_diag_notgang_has_in z_emfehler_frk_dihi z_freigabe_pvu_has_sbe z_fuwdeakt_frk_dihi z_hybfkt_stg z_iep_in z_k0_fst_in z_k0_has_fkt z_k0_has_sbe z_k0syncmk0erh_frk_dihi z_kps_stada_in z_modus_em_hst_in z_modus_iae_has_sbe z_modus_iep_has_sbe z_msa_avh_moni_has_sbe z_msa_eaf_moni_has_sbe z_msa_fst_in z_msa_has_sbe z_msa_stada_in z_n_min_em_parksp_has_in z_n_min_iep_in z_nllsoll_iae_in z_nminemnull_frk_dihi z_nvmausbed_ast_vma z_nvmsollbegr_frk_dihi z_pvu_has_sbe z_sas_has_sbe z_start_modus_has_sbe z_status_psys_mps_sbe z_svh_has_sbe z_ziel_kraftfluss_egs_in zielgang_egs_in /end LOC_MEASUREMENT
/end FUNCTION
/begin FUNCTION SFOp_VMA33_Entry "" /begin LOC_MEASUREMENT n_vm_in z_ablauf_has_hst_in /end LOC_MEASUREMENT /end FUNCTION
/begin FUNCTION SFOp_VMA36_Entry "" /begin DEF_CHARACTERISTIC K_SVH_RESET_SRT_VMA /end DEF_CHARACTERISTIC /begin LOC_MEASUREMENT n_vm_in z_ablauf_has_hst_in /end LOC_MEASUREMENT /end FUNCTION
/begin FUNCTION SFOp_VMA6_Input ""
 /begin LOC_MEASUREMENT abstellpos_vm_in abstellpos_vm_status_in c_getriebe_egs_in c_vm_in gangwechsel_egs_in i_istgang_egs i_zielgang_egs istgang_egs_in m_em_in m_iae_in m_k0_in m_k0_mber_has_sbe m_k0_mod_has_fkt m_max_dyn_em_in m_min_dyn_em_in m_min_vm_in m_mot_in m_motmax_has m_soll_em_hst_in m_soll_k0_has_fkt m_soll_res_em_bas_sbe m_soll_res_em_has_sbe m_soll_vm_hst_in m_soll_vm_l_hst_in m_vm_in m_vm_start_in m_wunsch_fpw_hst_fil m_wunsch_fpw_hst_in m_wunsch_fpw_in mg_wunsch_fpw mg_wunsch_fpw_hst n_ab_egs_in n_em_in n_min_em_has_sbe n_min_psys_em_has_sbe n_mot_soll_iae_in n_sec_iae n_soll_em_hst_in n_soll_ll_vm_in n_t_egs_in n_vm_in nd_iae nd_k0_in ndg_k0_in ng_vm osmode_next_in p_bremse_fzg_in phi_neigung_in pos_egs_in sollgang_egs_in st_OMLID_act_stg st_ist_bz_has_stg st_soll_bz_has_hst st_ziel_bz_has_stg status_alaengs_adaoff_in status_betriebsbereit_hst_in status_efahren_has_sbe status_fehler15_eh_diagin status_fehler_iep_in status_iae_adap_in status_iae_in status_iep_in status_k0_adap_in status_k0_in status_kl15_in status_kolbenpos_k0_in status_kraftfluss_egs_in status_kraftfluss_egs_roh_in status_ll_vm_in status_nem_in status_nreg_em_hst_in status_nvm_in status_posvueb_in status_psys_has_sbe status_sa_vm_in status_schaltart_svh_has_sbe status_schaltung_egs_in status_sync_schaltung_sbe status_waschstr_in status_zug_svh_sbe t_betrieb_pvu_has_ee_in t_betrieb_pvu_has_sbe v_f_sbe vg_f_sbe z_ablauf_has_hst_in z_ablauf_has_stg z_ablaufreinit_frk_dihi z_ablaufvariante_has_hst_in z_ablaufvariante_has_stg z_ba_has_k0_hst_in z_ba_has_vm_hst_in z_diag_ersfkt_has_in z_diag_ersfkt_hi_has_in z_diag_notgang_has_in z_emfehler_frk_dihi z_freigabe_pvu_has_sbe z_fuwdeakt_frk_dihi z_hybfkt_stg z_iep_in z_k0_fst_in z_k0_has_fkt z_k0_has_sbe z_k0syncmk0erh_frk_dihi z_kps_stada_in z_modus_em_hst_in z_modus_iae_has_sbe z_modus_iep_has_sbe z_msa_avh_moni_has_sbe z_msa_eaf_moni_has_sbe z_msa_fst_in z_msa_has_sbe z_msa_stada_in z_n_min_em_parksp_has_in z_n_min_iep_in z_nllsoll_iae_in z_nminemnull_frk_dihi z_nvmsollbegr_frk_dihi z_pvu_has_sbe z_sas_has_sbe z_start_modus_has_sbe z_status_psys_mps_sbe z_svh_has_sbe z_ziel_kraftfluss_egs_in zielgang_egs_in /end LOC_MEASUREMENT
/end FUNCTION
/begin FUNCTION SFOp_VMA9_St_Ablauf "" /begin SUB_FUNCTION SFOp_VMA24_st_uebergabe_vma SFOp_VMA23_st_abstellen_vma /end SUB_FUNCTION /end FUNCTION
/begin FUNCTION SFOp_VME10_St_Start "" /begin SUB_FUNCTION SFOp_VME36_Entry /end SUB_FUNCTION /begin DEF_CHARACTERISTIC K_SVH_RESET_SRT_VME /end DEF_CHARACTERISTIC /end FUNCTION
/begin FUNCTION SFOp_VME23_st_uebergabe_vme "" /begin SUB_FUNCTION SFOp_VME25_Entry /end SUB_FUNCTION /end FUNCTION
/begin FUNCTION SFOp_VME24_st_zustarten_vme "" /begin SUB_FUNCTION Run_SFOp_VME33_cTimer_trigger_ SFOp_VME28_Entry /end SUB_FUNCTION
 /begin DEF_CHARACTERISTIC K_SVH_RESET_ZST_VME NS_VMEINERK_ZST_VME STATUS_ABL_ZST_VME T_NVMEINERK_ZST_VME /end DEF_CHARACTERISTIC
 /begin LOC_MEASUREMENT SFOp_VME33_isActive_ n_vm_in z_ablauf_has_hst_in /end LOC_MEASUREMENT
/end FUNCTION
/begin FUNCTION SFOp_VME25_Entry "" /begin LOC_MEASUREMENT n_vm_in z_ablauf_has_hst_in /end LOC_MEASUREMENT /end FUNCTION
/begin FUNCTION SFOp_VME28_Entry "" /begin DEF_CHARACTERISTIC K_SVH_RESET_ZST_VME STATUS_ABL_ZST_VME /end DEF_CHARACTERISTIC /begin LOC_MEASUREMENT n_vm_in z_ablauf_has_hst_in /end LOC_MEASUREMENT /end FUNCTION
/begin FUNCTION SFOp_VME2_FOp_VME "" /begin SUB_FUNCTION SFOp_VME10_St_Start SFOp_VME9_St_Ablauf SFOp_VME6_Input /end SUB_FUNCTION /begin DEF_CHARACTERISTIC Z_ABLAUFHASHST_VMEINERK_VME /end DEF_CHARACTERISTIC
 /begin LOC_MEASUREMENT DD_SFOp_VME5_z__bed_zst_vme_mes abstellpos_vm_in abstellpos_vm_status_in c_getriebe_egs_in c_vm_in gangwechsel_egs_in i_istgang_egs i_zielgang_egs istgang_egs_in m_em_in m_iae_in m_k0_in m_k0_mber_has_sbe m_k0_mod_has_fkt m_max_dyn_em_in m_min_dyn_em_in m_min_vm_in m_mot_in m_motmax_has m_soll_em_hst_in m_soll_k0_has_fkt m_soll_res_em_bas_sbe m_soll_res_em_has_sbe m_soll_vm_hst_in m_soll_vm_l_hst_in m_vm_in m_vm_start_in m_wunsch_fpw_hst_fil m_wunsch_fpw_hst_in m_wunsch_fpw_in mg_wunsch_fpw mg_wunsch_fpw_hst n_ab_egs_in n_em_in n_min_em_has_sbe n_min_psys_em_has_sbe n_mot_soll_iae_in n_sec_iae n_soll_em_hst_in n_soll_ll_vm_in n_t_egs_in n_vm_in nd_iae nd_k0_in ndg_k0_in ng_vm osmode_next_in p_bremse_fzg_in phi_neigung_in pos_egs_in sollgang_egs_in st_OMLID_act_stg st_ist_bz_has_stg st_soll_bz_has_hst st_ziel_bz_has_stg status_alaengs_adaoff_in status_betriebsbereit_hst_in status_efahren_has_sbe status_fehler15_eh_diagin status_fehler_iep_in status_iae_adap_in status_iae_in status_iep_in status_k0_adap_in status_k0_in status_kl15_in status_kolbenpos_k0_in status_kraftfluss_egs_in status_kraftfluss_egs_roh_in status_ll_vm_in status_nem_in status_nreg_em_hst_in status_nvm_in status_posvueb_in status_psys_has_sbe status_sa_vm_in status_schaltart_svh_has_sbe status_schaltung_egs_in status_sync_schaltung_sbe status_waschstr_in status_zug_svh_sbe t_betrieb_pvu_has_ee_in t_betrieb_pvu_has_sbe v_f_sbe vg_f_sbe z_ablauf_has_hst_in z_ablauf_has_stg z_ablaufreinit_frk_dihi z_ablaufvariante_has_hst_in z_ablaufvariante_has_stg z_ba_has_k0_hst_in z_ba_has_vm_hst_in z_diag_ersfkt_has_in z_diag_ersfkt_hi_has_in z_diag_notgang_has_in z_emfehler_frk_dihi z_freigabe_pvu_has_sbe z_fuwdeakt_frk_dihi z_hybfkt_stg z_iep_in z_k0_fst_in z_k0_has_fkt z_k0_has_sbe z_k0syncmk0erh_frk_dihi z_kps_stada_in z_modus_em_hst_in z_modus_iae_has_sbe z_modus_iep_has_sbe z_msa_avh_moni_has_sbe z_msa_eaf_moni_has_sbe z_msa_fst_in z_msa_has_sbe z_msa_stada_in z_n_min_em_parksp_has_in z_n_min_iep_in z_nllsoll_iae_in z_nminemnull_frk_dihi z_nvmsollbegr_frk_dihi z_pvu_has_sbe z_sas_has_sbe z_start_modus_has_sbe z_status_psys_mps_sbe z_svh_has_sbe z_ziel_kraftfluss_egs_in zielgang_egs_in /end LOC_MEASUREMENT
/end FUNCTION
/begin FUNCTION SFOp_VME36_Entry "" /begin DEF_CHARACTERISTIC K_SVH_RESET_SRT_VME /end DEF_CHARACTERISTIC /begin LOC_MEASUREMENT n_vm_in z_ablauf_has_hst_in /end LOC_MEASUREMENT /end FUNCTION
/begin FUNCTION SFOp_VME6_Input ""
 /begin LOC_MEASUREMENT abstellpos_vm_in abstellpos_vm_status_in c_getriebe_egs_in c_vm_in gangwechsel_egs_in i_istgang_egs i_zielgang_egs istgang_egs_in m_em_in m_iae_in m_k0_in m_k0_mber_has_sbe m_k0_mod_has_fkt m_max_dyn_em_in m_min_dyn_em_in m_min_vm_in m_mot_in m_motmax_has m_soll_em_hst_in m_soll_k0_has_fkt m_soll_res_em_bas_sbe m_soll_res_em_has_sbe m_soll_vm_hst_in m_soll_vm_l_hst_in m_vm_in m_vm_start_in m_wunsch_fpw_hst_fil m_wunsch_fpw_hst_in m_wunsch_fpw_in mg_wunsch_fpw mg_wunsch_fpw_hst n_ab_egs_in n_em_in n_min_em_has_sbe n_min_psys_em_has_sbe n_mot_soll_iae_in n_sec_iae n_soll_em_hst_in n_soll_ll_vm_in n_t_egs_in n_vm_in nd_iae nd_k0_in ndg_k0_in ng_vm osmode_next_in p_bremse_fzg_in phi_neigung_in pos_egs_in sollgang_egs_in st_OMLID_act_stg st_ist_bz_has_stg st_soll_bz_has_hst st_ziel_bz_has_stg status_alaengs_adaoff_in status_betriebsbereit_hst_in status_efahren_has_sbe status_fehler15_eh_diagin status_fehler_iep_in status_iae_adap_in status_iae_in status_iep_in status_k0_adap_in status_k0_in status_kl15_in status_kolbenpos_k0_in status_kraftfluss_egs_in status_kraftfluss_egs_roh_in status_ll_vm_in status_nem_in status_nreg_em_hst_in status_nvm_in status_posvueb_in status_psys_has_sbe status_sa_vm_in status_schaltart_svh_has_sbe status_schaltung_egs_in status_sync_schaltung_sbe status_waschstr_in status_zug_svh_sbe t_betrieb_pvu_has_ee_in t_betrieb_pvu_has_sbe v_f_sbe vg_f_sbe z_ablauf_has_hst_in z_ablauf_has_stg z_ablaufreinit_frk_dihi z_ablaufvariante_has_hst_in z_ablaufvariante_has_stg z_ba_has_k0_hst_in z_ba_has_vm_hst_in z_diag_ersfkt_has_in z_diag_ersfkt_hi_has_in z_diag_notgang_has_in z_emfehler_frk_dihi z_freigabe_pvu_has_sbe z_fuwdeakt_frk_dihi z_hybfkt_stg z_iep_in z_k0_fst_in z_k0_has_fkt z_k0_has_sbe z_k0syncmk0erh_frk_dihi z_kps_stada_in z_modus_em_hst_in z_modus_iae_has_sbe z_modus_iep_has_sbe z_msa_avh_moni_has_sbe z_msa_eaf_moni_has_sbe z_msa_fst_in z_msa_has_sbe z_msa_stada_in z_n_min_em_parksp_has_in z_n_min_iep_in z_nllsoll_iae_in z_nminemnull_frk_dihi z_nvmsollbegr_frk_dihi z_pvu_has_sbe z_sas_has_sbe z_start_modus_has_sbe z_status_psys_mps_sbe z_svh_has_sbe z_ziel_kraftfluss_egs_in zielgang_egs_in /end LOC_MEASUREMENT
/end FUNCTION
/begin FUNCTION SFOp_VME9_St_Ablauf "" /begin SUB_FUNCTION SFOp_VME24_st_zustarten_vme SFOp_VME23_st_uebergabe_vme /end SUB_FUNCTION /end FUNCTION
/begin FUNCTION SFOp_Zus100_Sc__gsbeeinflussung "" /begin SUB_FUNCTION SFOp_Zus125_Bitwise_OR_ui8_ SFOp_Zus127_Bitwise_AND_ui8_ /end SUB_FUNCTION /begin DEF_CHARACTERISTIC KL_KSVHABBRLAUSFST_ZUS_X KL_KSVHABBRLAUSFST_ZUS_Y /end DEF_CHARACTERISTIC
 /begin LOC_MEASUREMENT SFOp_Zus124_KL__ABBRLAUSFST_ZUS istgang_egs_in sollgang_egs_in status_schaltart_svh_has_sbe status_schaltung_egs_in z_svh_abbrlaus_fst_zus z_svh_has_sbe z_svh_reset_palaus_zus /end LOC_MEASUREMENT
/end FUNCTION
/begin FUNCTION SFOp_Zus10_st_start "" /begin SUB_FUNCTION SFOp_Zus369_ac_start_en /end SUB_FUNCTION /end FUNCTION
/begin FUNCTION SFOp_Zus125_Bitwise_OR_ui8_ "" /begin LOC_MEASUREMENT z_ablauf_svh_reset_has_fkt /end LOC_MEASUREMENT /end FUNCTION
/begin FUNCTION SFOp_Zus127_Bitwise_AND_ui8_ "" /begin LOC_MEASUREMENT SFOp_Zus124_KL__ABBRLAUSFST_ZUS /end LOC_MEASUREMENT /end FUNCTION
/begin FUNCTION SFOp_Zus129_St_Schaltung_aktiv ""
 /begin SUB_FUNCTION SFOp_Zus135_ac__ung_aktiv_en_st SFOp_Zus134_ac__altung_aktiv_en /end SUB_FUNCTION
 /begin DEF_CHARACTERISTIC STATUS_ABL_SAK_ZUS /end DEF_CHARACTERISTIC
 /begin LOC_MEASUREMENT SFOp_Zus139_KF__NSOLLVM_ZST_ZUS SFOp_Zus145_x_ SFOp_Zus151_out_ z_t_maxbed_sak_zus /end LOC_MEASUREMENT
/end FUNCTION
/begin FUNCTION SFOp_Zus130_Zustart ""
 /begin SUB_FUNCTION SFOp_Zus163_st_zustarten_zus SFOp_Zus162_st__art_abbruch_zus SFOp_Zus161_st__zahlanheben_zus SFOp_Zus160_st_vm_abfangen_zus SFOp_Zus159_st__art_abbruch_zus SFOp_Zus158_st__hronisieren_zus SFOp_Zus157_st___schliessen_zus /end SUB_FUNCTION
/end FUNCTION
/begin FUNCTION SFOp_Zus132_st_uebergabe "" /begin SUB_FUNCTION SFOp_Zus362_Entry /end SUB_FUNCTION /end FUNCTION
/begin FUNCTION SFOp_Zus134_ac__altung_aktiv_en "" /begin DEF_CHARACTERISTIC STATUS_ABL_SAK_ZUS SWI_ZMODUSVMN_SAK_ZUS /end DEF_CHARACTERISTIC /end FUNCTION
/begin FUNCTION SFOp_Zus135_ac__ung_aktiv_en_st ""
 /begin SUB_FUNCTION Run_SFOp_Zus14__e_t_max_sak_zus Run_SFOp_Zus15__t_m_soll_k0_has SFOp_Zus150_Bitwise_AND_ui8_ Run_SFOp_Zus145_cPT1_NVMSoll /end SUB_FUNCTION
 /begin DEF_CHARACTERISTIC FK_NSOLLVM_SAK_ZUS KF_MSOLLK0BEF_2_SAK_ZUS_W KF_MSOLLK0BEF_2_SAK_ZUS_X KF_MSOLLK0BEF_2_SAK_ZUS_Y KF_MSOLLK0BEF_SAK_ZUS_W KF_MSOLLK0BEF_SAK_ZUS_X KF_MSOLLK0BEF_SAK_ZUS_Y KF_NOEMNSOLLVM_ZST_ZUS_W KF_NOEMNSOLLVM_ZST_ZUS_X KF_NOEMNSOLLVM_ZST_ZUS_Y KL_KSVHPALAUSNACHVSI_SAK_ZUS_X KL_KSVHPALAUSNACHVSI_SAK_ZUS_Y KL_KSVHPALAUSVORVSI_SAK_ZUS_X KL_KSVHPALAUSVORVSI_SAK_ZUS_Y KL_KSVHRESETAUSZST_SAK_ZUS_X KL_KSVHRESETAUSZST_SAK_ZUS_Y KL_KSVHRESETNACHVSI_SAK_ZUS_X KL_KSVHRESETNACHVSI_SAK_ZUS_Y KL_KSVHRESETVORVSI_SAK_ZUS_X KL_KSVHRESETVORVSI_SAK_ZUS_Y KL_MK0MODK0BEF_ZUS_X KL_MK0MODK0BEF_ZUS_Y KL_SCHALTARTK0BEFVERZ_SAK_ZUS_X KL_SCHALTARTK0BEFVERZ_SAK_ZUS_Y K_MZIELNOEMNSOLLVM_ZST_ZUS K_NOEMNSOLLVMOKS_ZST_ZUS K_SVH_RESETABLABBR_SAK_ZUS MG_SOLLK0NEG_2_SAK_ZUS MG_SOLLK0NEG_SAK_ZUS MG_SOLLK0POS_2_SAK_ZUS MG_SOLLK0POS_SAK_ZUS MS_SOLLEMVORSTEUER_ZUS MS_WUNSCHK0HYS_ANH_ZUS MS_ZIELVMHASK0HYS_ANH_ZUS NDS_VMNEMBED_ANH_ZUS NDS_VMNEMK0HYS_SAK_ZUS NS_EMK0HYS_ANH_ZUS N_MINEMNSOLLVM_ZST_ZUS SWI_MK0MODBEGR_SAK_ZUS SWI_ZMODUSVMN_SAK_ZUS SWI_ZMSOLLEM_SAK_ZUS SWI_ZPHYSK0_SAK_ZUS T_MAX_SAK_ZUS Z_ABLAUF_ABBRUCH_ZUS /end DEF_CHARACTERISTIC
 /begin LOC_MEASUREMENT SFOp_Zus139_KF__NSOLLVM_ZST_ZUS SFOp_Zus142_KL_MK0MODK0BEF_ZUS SFOp_Zus142_KL__BEFVERZ_SAK_ZUS SFOp_Zus143_KL__NACHVSI_SAK_ZUS SFOp_Zus143_KL__NACHVSI_SAK_Z_a SFOp_Zus143_KL__SVORVSI_SAK_ZUS SFOp_Zus143_KL__TAUSZST_SAK_ZUS SFOp_Zus143_KL__TVORVSI_SAK_ZUS SFOp_Zus145_x_ SFOp_Zus151_out_ SFOp_Zus78_xp_ c_getriebe_egs_in gangwechsel_egs_in i_zielgang_egs istgang_egs_in k_mstoerk0em_zus m_em_in m_k0_in m_k0_mod_has_fkt m_max_dyn_em_in m_min_dyn_em_in m_min_vm_in m_soll_k0_has_fkt m_soll_vm_hst_in m_soll_vm_l_hst_in m_stoerk0em_fil_zus m_vm_in m_vm_start_in m_wunsch_fpw_hst_in m_wunsch_fpw_in m_ziel_vm_has_zus mg_wunsch_fpw_hst n_ab_egs_in n_em_in n_sec_iae_ist_zus n_sec_iae_ziel_zus n_soll_em_hst_in n_soll_ll_vm_in n_vm_in nd_k0_in ndg_k0_in ng_vm pos_egs_in sollgang_egs_in status_iae_in status_k0_in status_kraftfluss_egs_in status_nem_in status_nreg_em_hst_in status_psys_has_sbe status_schaltart_svh_has_sbe status_schaltung_egs_in status_sync_schaltung_sbe t_emaktiv_fuw_zus z_ablauf_has_hst_in z_ablauf_has_stg z_ablaufvariante_has_stg z_emfehler_frk_dihi z_fuwdeakt_frk_dihi z_k0_fst_in z_k0_has_fkt z_k0syncmk0erh_frk_dihi z_pvu_has_sbe z_svh_has_sbe z_t_maxbed_sak_zus /end LOC_MEASUREMENT
/end FUNCTION
/begin FUNCTION SFOp_Zus150_Bitwise_AND_ui8_ "" /begin LOC_MEASUREMENT SFOp_Zus142_KL__BEFVERZ_SAK_ZUS /end LOC_MEASUREMENT /end FUNCTION
/begin FUNCTION SFOp_Zus157_st___schliessen_zus ""
 /begin SUB_FUNCTION Run_SFOp_Zus171_cTimer_trigger_ Run_SFOp_Zus186_cTimer_trigger_ SFOp_Zus175_ti__oll_k0_anst_zus Run_SFOp_Zus17__t_m_soll_k0_has Run_SFOp_Zus17__dient_m_mod_has SFOp_Zus164_Entry /end SUB_FUNCTION
 /begin DEF_CHARACTERISTIC KL_KSVHRESET_SCL_ZUS_X KL_KSVHRESET_SCL_ZUS_Y KL_MGK0MODHASMAX_SCL_ZUS_X KL_MGK0MODHASMAX_SCL_ZUS_Y KL_MGSOLLK0HASMAX_SCL_ZUS_X KL_MGSOLLK0HASMAX_SCL_ZUS_Y MG_K0MODHASMAXABBR_SCL_ZUS MG_K0MODHASMAXFUWKALT_SCL_ZUS MG_K0MODHASMAXK0SREG_SCL_ZUS MG_SOLLK0HASMAXABBR_SCL_ZUS MG_SOLLK0HASMAXFUWKALT_SCL_ZUS MO_SOLLVMHSTMSOLLK0_SCL_ZUS MO_SOLLVMLHSTMSOLLK0_SCL_ZUS NDS_K0GESCHL_SCL_ZUS STATUS_ABL_SCL_ZUS T_MAX_SCL_ZUS T_MK0MODZIEL_SCL_ZUS /end DEF_CHARACTERISTIC
 /begin LOC_MEASUREMENT SFOp_Zus170_KL__VHRESET_SCL_ZUS SFOp_Zus171_isActive_ SFOp_Zus172_KL__0HASMAX_SCL_ZUS SFOp_Zus172_KL__DHASMAX_SCL_ZUS SFOp_Zus173_out_ SFOp_Zus78_xp_ c_getriebe_egs_in gangwechsel_egs_in i_zielgang_egs istgang_egs_in k_mstoerk0em_zus m_em_in m_k0_in m_k0_mod_has_fkt m_max_dyn_em_in m_min_dyn_em_in m_min_vm_in m_soll_k0_has_fkt m_soll_vm_hst_in m_soll_vm_l_hst_in m_stoerk0em_fil_zus m_vm_in m_vm_start_in m_wunsch_fpw_hst_in m_wunsch_fpw_in m_ziel_vm_has_zus mg_k0_mod_max_zus mg_soll_k0_max_zus mg_wunsch_fpw_hst n_ab_egs_in n_em_in n_sec_iae_ist_zus n_sec_iae_ziel_zus n_soll_em_hst_in n_soll_ll_vm_in n_vm_in nd_k0_in ndg_k0_in ng_vm pos_egs_in sollgang_egs_in status_iae_in status_k0_in status_kraftfluss_egs_in status_nem_in status_nreg_em_hst_in status_psys_has_sbe status_schaltart_svh_has_sbe status_schaltung_egs_in status_sync_schaltung_sbe t_emaktiv_fuw_zus t_m_k0_mod_ziel_zus t_maxbed_scl_zus z_ablauf_has_hst_in z_ablauf_has_stg z_ablaufvariante_has_stg z_emfehler_frk_dihi z_fuwdeakt_frk_dihi z_k0_fst_in z_k0_has_fkt z_k0syncmk0erh_frk_dihi z_pvu_has_sbe z_svh_has_sbe /end LOC_MEASUREMENT
/end FUNCTION
/begin FUNCTION SFOp_Zus158_st__hronisieren_zus ""
 /begin SUB_FUNCTION Run_SFOp_Zus25__radient_MSollK0 SFOp_Zus260_Bitwise_AND_ui8_ Run_SFOp_Zus247_cPT1_NVMSoll Run_SFOp_Zus25__mer_NSollVMInit Run_SFOp_Zus24__erkums_syn_zus_ Run_SFOp_Zus23__yncerk_syn_zus_ Run_SFOp_Zus23__nt_m_k0_mod_has Run_SFOp_Zus23__radient_MSollK0 Run_SFOp_Zus20__egaktiv_syn_zus Run_SFOp_Zus219_CL_DT1 Run_SFOp_Zus21__0k0sreg_syn_zus Run_SFOp_Zus21__egbasis_syn_zus SFOp_Zus209_Bitwise_AND_ui8_ SFOp_Zus213_Bitwise_AND_ui8_1 SFOp_Zus212_Bitwise_AND_ui8_1 SFOp_Zus211_Bitwise_AND_ui8_1 SFOp_Zus191_Entry /end SUB_FUNCTION
 /begin DEF_CHARACTERISTIC BM_SCHALTARTNEMMODRS_SYN_ZUS FK_NDGSOLLVMNVM_SYN_ZUS FK_NSOLLVM_ANH_ZUS KF_MGK0NDK0M_IAEREG_SYN_ZUS_W KF_MGK0NDK0M_IAEREG_SYN_ZUS_X KF_MGK0NDK0M_IAEREG_SYN_ZUS_Y KF_MGK0NDK0M_MRS_SYN_ZUS_W KF_MGK0NDK0M_MRS_SYN_ZUS_X KF_MGK0NDK0M_MRS_SYN_ZUS_Y KF_MGK0NDK0M_RS_SYN_ZUS_W KF_MGK0NDK0M_RS_SYN_ZUS_X KF_MGK0NDK0M_RS_SYN_ZUS_Y KF_MGK0NDK0M_SYN_ZUS_W KF_MGK0NDK0M_SYN_ZUS_X KF_MGK0NDK0M_SYN_ZUS_Y KF_MGK0NDK0M_ZMANH_SYN_ZUS_W KF_MGK0NDK0M_ZMANH_SYN_ZUS_X KF_MGK0NDK0M_ZMANH_SYN_ZUS_Y KF_MGK0NDK0NGVM_SYN_ZUS_W KF_MGK0NDK0NGVM_SYN_ZUS_X KF_MGK0NDK0NGVM_SYN_ZUS_Y KF_NDEMNSOLLVM_ANH_ZUS_W KF_NDEMNSOLLVM_ANH_ZUS_X KF_NDEMNSOLLVM_ANH_ZUS_Y KF_NGEMMODRSMAX_SYN_ZUS_W KF_NGEMMODRSMAX_SYN_ZUS_X KF_NGEMMODRSMAX_SYN_ZUS_Y KF_NOEMNSOLLVM_ZST_ZUS_W KF_NOEMNSOLLVM_ZST_ZUS_X KF_NOEMNSOLLVM_ZST_ZUS_Y KL_KSVHRESET_SYN_ZUS_X KL_KSVHRESET_SYN_ZUS_Y KL_MGK0MODMAXMAX_SYN_ZUS_X KL_MGK0MODMAXMAX_SYN_ZUS_Y KL_MGSOLLK0SUS_SYN_ZUS_X KL_MGSOLLK0SUS_SYN_ZUS_Y KL_MOZIELK0ZMANHMAX_SYN_ZUS_X KL_MOZIELK0ZMANHMAX_SYN_ZUS_Y KL_MOZIELK0ZMANH_SYN_ZUS_X KL_MOZIELK0ZMANH_SYN_ZUS_Y KL_MSOLLK0MIN_SYN_ZUS_X KL_MSOLLK0MIN_SYN_ZUS_Y KL_MVMVOLLASTSAUG_SYN_ZUS_X KL_MVMVOLLASTSAUG_SYN_ZUS_Y KL_MZIELK0MIN_SYN_ZUS_X KL_MZIELK0MIN_SYN_ZUS_Y KL_NDSK0K0SREG_SYN_ZUS_X KL_NDSK0K0SREG_SYN_ZUS_Y KL_NDSK0SYNCERK_SYN_ZUS_X KL_NDSK0SYNCERK_SYN_ZUS_Y KL_NDZIELK0K0SREG_SYN_ZUS_X KL_NDZIELK0K0SREG_SYN_ZUS_Y KL_TK0SYNCERKUMS_SYN_ZUS_X KL_TK0SYNCERKUMS_SYN_ZUS_Y K_KFMGK0RS_SYN_ZUS K_MZIELNOEMNSOLLVM_ZST_ZUS K_NOEMNSOLLVMOKS_ZST_ZUS MDS_SOLLK0MVMK0SREG_SYN_ZUS MDS_ZIELK0NSOLLVMINIT_SYN_ZUS MD_ZIELSOLLK0_SYN_ZUS MGS_WUNSCHFPW_SYN_ZUS MG_K0SYNCMK0ERHDIAG_SYN_ZUS MG_K0SYNCVMVOLLAST_SYN_ZUS MG_SOLLK0MIN_SYN_ZUS MO_VMMGSOLLK0_SYN_ZUS MO_ZIELK0MINZMANH_SYN_ZUS MS_SOLLEMVORSTEUER_ZUS MS_SOLLK0K0SREG_SYN_ZUS MS_ZIELVMHASK0HYS_ANH_ZUS MS_ZIELVMK0SREG_SYN_ZUS NDGS_K0K0SREG_SYN_ZUS NDGS_SOLLVMNVMK0SREG_SYN_ZUS NDS_K0SYNCERKMAX_SYN_ZUS NDS_SOLLVMNVMK0SREG_SYN_ZUS NG_EMMODRSMIN_SYN_ZUS NOS_EMNSOLLVMK0SREG_SYN_ZUS NOS_EMNSOLLVM_SYN_ZUS NS_EMMINBED_SYN_ZUS N_MINEMNSOLLVM_ZST_ZUS STATUS_ABL_SYN_ZUS SWI_K0SREGBASIS_SYN_ZUS SWI_KFMGK0AUSWAHL_SYN_ZUS SWI_MGK0RSKF_SYN_ZUS SWI_MK0MODBEGR_SYN_ZUS SWI_ZK0SREGMODUS_SYN_ZUS SWI_ZMSOLLEM_SYN_ZUS SWI_ZPHYSK0_SYN_ZUS TAB_KFMGK0STATUSIAE_SYN_ZUS T_K0SREGBASISMAX_SYN_ZUS T_NDGK0K0SREGMIN_SYN_ZUS T_VK0SREGAKTIV_SYN_ZUS T_VK0SYNCERK_SYN_ZUS T_VMDZIELSOLLK0_SYN_ZUS /end DEF_CHARACTERISTIC
 /begin LOC_MEASUREMENT SFOp_Zus198_KL__DMAXMAX_SYN_ZUS SFOp_Zus198_KL__ELK0MIN_SYN_ZUS SFOp_Zus198_KL__K0ZMANH_SYN_ZUS SFOp_Zus198_KL__LLK0MIN_SYN_ZUS SFOp_Zus198_KL__MANHMAX_SYN_ZUS SFOp_Zus199_KL__VHRESET_SYN_ZUS SFOp_Zus200_KL__SYNCERK_SYN_ZUS SFOp_Zus203_KL__0K0SREG_SYN_ZUS SFOp_Zus205_isActive_ SFOp_Zus229_KF__DK0M_RS_SYN_ZUS SFOp_Zus229_KF__DK0NGVM_SYN_ZUS SFOp_Zus229_KF__K0M_MRS_SYN_ZUS SFOp_Zus229_KF__K0NDK0M_SYN_ZUS SFOp_Zus229_KF__M_ZMANH_SYN_ZUS SFOp_Zus229_KF___IAEREG_SYN_ZUS SFOp_Zus229_KL__ASTSAUG_SYN_ZUS SFOp_Zus229_KL__LLK0SUS_SYN_ZUS SFOp_Zus231_out_ SFOp_Zus239_isActive_ SFOp_Zus240_KL__CERKUMS_SYN_ZUS SFOp_Zus243_isActive_ SFOp_Zus246_KF__NSOLLVM_ANH_ZUS SFOp_Zus246_KF__NSOLLVM_ZST_ZUS SFOp_Zus246_KL__0K0SREG_SYN_ZUS SFOp_Zus247_x_ SFOp_Zus248_KF__DRSMAX_SYN_ZUS_ SFOp_Zus253_isActive_ SFOp_Zus78_xp_ c_getriebe_egs_in gangwechsel_egs_in i_zielgang_egs istgang_egs_in k_mstoerk0em_zus m_em_in m_k0_in m_k0_mod_has_fkt m_k0_mod_max_syn_zus m_max_dyn_em_in m_min_dyn_em_in m_min_vm_in m_soll_k0_has_fkt m_soll_vm_hst_in m_soll_vm_l_hst_in m_stoerk0em_fil_zus m_vm_in m_vm_start_in m_wunsch_fpw_hst_in m_wunsch_fpw_in m_ziel_k0_min_syn_zus m_ziel_vm_has_zus mg_soll_k0_syn_zus mg_wunsch_fpw_hst mo_ziel_k0_zmanh_syn_zus n_ab_egs_in n_em_in n_em_mod_syn_zus n_em_ref_syn_zus n_sec_iae_ist_zus n_sec_iae_ziel_zus n_soll_em_hst_in n_soll_ll_vm_in n_vm_in nd_k0_in nd_sec_iae_syn_zus nd_sollvmnvm_syn_zus ndg_k0_in ndg_sollvmnvm_syn_zus nds_k0syncerk_syn_zus ng_emmodrsmax_syn_zus ng_vm pos_egs_in sollgang_egs_in status_iae_in status_k0_in status_kraftfluss_egs_in status_nem_in status_nreg_em_hst_in status_psys_has_sbe status_schaltart_svh_has_sbe status_schaltung_egs_in status_sync_schaltung_sbe t_emaktiv_fuw_zus t_k0sregaktiv_syn_zus t_k0sregbasis_syn_zus t_k0syncerk_syn_zus t_k0syncerkums_syn_zus t_mdzielsollk0_syn_zus t_ndgk0k0sreg_syn_zus z_ablauf_has_hst_in z_ablauf_has_stg z_ablaufvariante_has_stg z_emfehler_frk_dihi z_fuwdeakt_frk_dihi z_k0_fst_in z_k0_has_fkt z_k0sus_syn_zus z_k0syncmk0erh_frk_dihi z_ndsk0k0sreg_syn_zus z_nvmeinzugk0sreg_syn_zus z_pvu_has_sbe z_svh_has_sbe /end LOC_MEASUREMENT
/end FUNCTION
/begin FUNCTION SFOp_Zus159_st__art_abbruch_zus "" /begin SUB_FUNCTION SFOp_Zus264_Entry /end SUB_FUNCTION /begin DEF_CHARACTERISTIC STATUS_ABL_ABBRUCH_FERTIG /end DEF_CHARACTERISTIC
 /begin LOC_MEASUREMENT SFOp_Zus78_xp_ c_getriebe_egs_in gangwechsel_egs_in i_zielgang_egs istgang_egs_in k_mstoerk0em_zus m_em_in m_k0_in m_k0_mod_has_fkt m_max_dyn_em_in m_min_dyn_em_in m_min_vm_in m_soll_k0_has_fkt m_soll_vm_hst_in m_soll_vm_l_hst_in m_stoerk0em_fil_zus m_vm_in m_vm_start_in m_wunsch_fpw_hst_in m_wunsch_fpw_in m_ziel_vm_has_zus mg_wunsch_fpw_hst n_ab_egs_in n_em_in n_sec_iae_ist_zus n_sec_iae_ziel_zus n_soll_em_hst_in n_soll_ll_vm_in n_vm_in nd_k0_in ndg_k0_in ng_vm pos_egs_in sollgang_egs_in status_iae_in status_k0_in status_kraftfluss_egs_in status_nem_in status_nreg_em_hst_in status_psys_has_sbe status_schaltart_svh_has_sbe status_schaltung_egs_in status_sync_schaltung_sbe t_emaktiv_fuw_zus z_ablauf_has_hst_in z_ablauf_has_stg z_ablaufvariante_has_stg z_emfehler_frk_dihi z_fuwdeakt_frk_dihi z_k0_fst_in z_k0_has_fkt z_k0syncmk0erh_frk_dihi z_pvu_has_sbe z_svh_has_sbe /end LOC_MEASUREMENT
/end FUNCTION
/begin FUNCTION SFOp_Zus160_st_vm_abfangen_zus ""
 /begin SUB_FUNCTION Run_SFOp_Zus278_cTimer_trigger_ Run_SFOp_Zus284_cPT1_NVMSoll Run_SFOp_Zus27__adient_m_k0_has SFOp_Zus270_ac__abfangen_zus_en /end SUB_FUNCTION
 /begin DEF_CHARACTERISTIC FK_NSOLLVM_ANH_ZUS KF_MSOLLK0BEF_ABF_ZUS_W KF_MSOLLK0BEF_ABF_ZUS_X KF_MSOLLK0BEF_ABF_ZUS_Y KF_NDEMNSOLLVM_ANH_ZUS_W KF_NDEMNSOLLVM_ANH_ZUS_X KF_NDEMNSOLLVM_ANH_ZUS_Y KF_NOEMNSOLLVM_ZST_ZUS_W KF_NOEMNSOLLVM_ZST_ZUS_X KF_NOEMNSOLLVM_ZST_ZUS_Y KL_KSVHRESET_ABF_ZUS_X KL_KSVHRESET_ABF_ZUS_Y KL_MK0MODK0BEF_ZUS_X KL_MK0MODK0BEF_ZUS_Y KL_MK0ZIEL_ABF_ZUS_X KL_MK0ZIEL_ABF_ZUS_Y K_MZIELNOEMNSOLLVM_ZST_ZUS K_NOEMNSOLLVMOKS_ZST_ZUS MGS_WUNSCHFPW_ANH_ZUS MG_SOLLK0NEG_ABF_ZUS MG_SOLLK0POS_ABF_ZUS MS_SOLLEMVORSTEUER_ZUS NDS_K0MK0ANH_ABF_ZUS NGS_VMMK0ANH_ABF_ZUS N_MINEMNSOLLVM_ZST_ZUS STATUS_ABL_ABF_ZUS SWI_MK0MODBEGR_ABF_ZUS SWI_ZMSOLLEM_ABF_ZUS T_VMSTATUSMAX_ABF_ZUS /end DEF_CHARACTERISTIC
 /begin LOC_MEASUREMENT SFOp_Zus274_KL_MK0MODK0BEF_ZUS SFOp_Zus277_KL__VHRESET_ABF_ZUS SFOp_Zus278_isActive_ SFOp_Zus279_out_ SFOp_Zus283_KF__SOLLVM_ANH_ZUS_ SFOp_Zus283_KF__SOLLVM_ZST_ZUS_ SFOp_Zus284_x_ SFOp_Zus78_xp_ c_getriebe_egs_in gangwechsel_egs_in i_zielgang_egs istgang_egs_in k_mstoerk0em_zus m_em_in m_k0_in m_k0_mod_has_fkt m_max_dyn_em_in m_min_dyn_em_in m_min_vm_in m_soll_k0_has_fkt m_soll_vm_hst_in m_soll_vm_l_hst_in m_stoerk0em_fil_zus m_vm_in m_vm_start_in m_wunsch_fpw_hst_in m_wunsch_fpw_in m_ziel_vm_has_zus mg_wunsch_fpw_hst n_ab_egs_in n_em_in n_sec_iae_ist_zus n_sec_iae_ziel_zus n_soll_em_hst_in n_soll_ll_vm_in n_vm_in nd_k0_in ndg_k0_in ng_vm pos_egs_in sollgang_egs_in status_iae_in status_k0_in status_kraftfluss_egs_in status_nem_in status_nreg_em_hst_in status_psys_has_sbe status_schaltart_svh_has_sbe status_schaltung_egs_in status_sync_schaltung_sbe t_emaktiv_fuw_zus t_vmstatus_abf_zus z_ablauf_has_hst_in z_ablauf_has_stg z_ablaufvariante_has_stg z_emfehler_frk_dihi z_fuwdeakt_frk_dihi z_k0_fst_in z_k0_has_fkt z_k0syncmk0erh_frk_dihi z_pvu_has_sbe z_svh_has_sbe /end LOC_MEASUREMENT
/end FUNCTION
/begin FUNCTION SFOp_Zus161_st__zahlanheben_zus ""
 /begin SUB_FUNCTION Run_SFOp_Zus300_cTimer_trigger_ SFOp_Zus299_Sc__gsbeeinflussung SFOp_Zus298_K0_Ansteuerung SFOp_Zus297_EM_Ansteuerung SFOp_Zus296_Ansteuerung_VM SFOp_Zus291_Entry /end SUB_FUNCTION
 /begin DEF_CHARACTERISTIC STATUS_ABL_ANH_ZUS T_VMSTATUSMAX_ANH_ZUS /end DEF_CHARACTERISTIC
 /begin LOC_MEASUREMENT SFOp_Zus300_isActive_ SFOp_Zus302_x_ SFOp_Zus313_out_ SFOp_Zus78_xp_ c_getriebe_egs_in gangwechsel_egs_in i_zielgang_egs istgang_egs_in k_mstoerk0em_zus m_em_in m_k0_in m_k0_mod_has_fkt m_max_dyn_em_in m_min_dyn_em_in m_min_vm_in m_soll_k0_has_fkt m_soll_vm_hst_in m_soll_vm_l_hst_in m_stoerk0em_fil_zus m_vm_in m_vm_start_in m_wunsch_fpw_hst_in m_wunsch_fpw_in m_ziel_vm_has_zus mg_wunsch_fpw_hst n_ab_egs_in n_em_in n_sec_iae_ist_zus n_sec_iae_ziel_zus n_soll_em_hst_in n_soll_ll_vm_in n_vm_in nd_k0_in ndg_k0_in ng_vm pos_egs_in sollgang_egs_in status_iae_in status_k0_in status_kraftfluss_egs_in status_nem_in status_nreg_em_hst_in status_psys_has_sbe status_schaltart_svh_has_sbe status_schaltung_egs_in status_sync_schaltung_sbe t_emaktiv_fuw_zus t_vmstatus_anh_zus z_ablauf_has_hst_in z_ablauf_has_stg z_ablaufvariante_has_stg z_emfehler_frk_dihi z_fuwdeakt_frk_dihi z_k0_fst_in z_k0_has_fkt z_k0syncmk0erh_frk_dihi z_pvu_has_sbe z_svh_has_sbe z_t_k0zunemfehlerbed_fuw_zus /end LOC_MEASUREMENT
/end FUNCTION
/begin FUNCTION SFOp_Zus162_st__art_abbruch_zus ""
 /begin SUB_FUNCTION Run_SFOp_Zus32__r_t_max_abb_zus Run_SFOp_Zus32__radient_MSollK0 SFOp_Zus321_Entry /end SUB_FUNCTION
 /begin DEF_CHARACTERISTIC K_SVH_RESET_ABB_ZUS MG_SOLLK0_ABB_ZUS STATUS_ABL_ABBRUCH_AKTIV T_MAX_ABB_ZUS /end DEF_CHARACTERISTIC
 /begin LOC_MEASUREMENT SFOp_Zus327_isActive_ SFOp_Zus78_xp_ c_getriebe_egs_in gangwechsel_egs_in i_zielgang_egs istgang_egs_in k_mstoerk0em_zus m_em_in m_k0_in m_k0_mod_has_fkt m_max_dyn_em_in m_min_dyn_em_in m_min_vm_in m_soll_k0_has_fkt m_soll_vm_hst_in m_soll_vm_l_hst_in m_stoerk0em_fil_zus m_vm_in m_vm_start_in m_wunsch_fpw_hst_in m_wunsch_fpw_in m_ziel_vm_has_zus mg_wunsch_fpw_hst n_ab_egs_in n_em_in n_sec_iae_ist_zus n_sec_iae_ziel_zus n_soll_em_hst_in n_soll_ll_vm_in n_vm_in nd_k0_in ndg_k0_in ng_vm pos_egs_in sollgang_egs_in status_iae_in status_k0_in status_kraftfluss_egs_in status_nem_in status_nreg_em_hst_in status_psys_has_sbe status_schaltart_svh_has_sbe status_schaltung_egs_in status_sync_schaltung_sbe t_emaktiv_fuw_zus t_maxbed_abb_zus z_ablauf_has_hst_in z_ablauf_has_stg z_ablaufvariante_has_stg z_emfehler_frk_dihi z_fuwdeakt_frk_dihi z_k0_fst_in z_k0_has_fkt z_k0syncmk0erh_frk_dihi z_pvu_has_sbe z_svh_has_sbe /end LOC_MEASUREMENT
/end FUNCTION
/begin FUNCTION SFOp_Zus163_st_zustarten_zus ""
 /begin SUB_FUNCTION Run_SFOp_Zus357_cPT1_NVMSoll Run_SFOp_Zus347_cTimer_trigger_ Run_SFOp_Zus34___k0_min_uvs_zus Run_SFOp_Zus34__t_m_soll_k0_has SFOp_Zus336_ac_zustarten_zus_en /end SUB_FUNCTION
 /begin DEF_CHARACTERISTIC FK_NSOLLVM_ZST_ZUS KF_MSOLLK0BEF_2_ZST_ZUS_W KF_MSOLLK0BEF_2_ZST_ZUS_X KF_MSOLLK0BEF_2_ZST_ZUS_Y KF_MSOLLK0BEF_ZST_ZUS_W KF_MSOLLK0BEF_ZST_ZUS_X KF_MSOLLK0BEF_ZST_ZUS_Y KF_NOEMNSOLLVM_ZST_ZUS_W KF_NOEMNSOLLVM_ZST_ZUS_X KF_NOEMNSOLLVM_ZST_ZUS_Y KL_KSVHRESET_ZST_ZUS_X KL_KSVHRESET_ZST_ZUS_Y KL_MK0MODK0BEF_ZUS_X KL_MK0MODK0BEF_ZUS_Y KL_MK0MODUVS_ZST_ZUS_X KL_MK0MODUVS_ZST_ZUS_Y K_MZIELNOEMNSOLLVM_ZST_ZUS K_NOEMNSOLLVMOKS_ZST_ZUS MG_SOLLK0NEG_2_ZST_ZUS MG_SOLLK0NEG_ZST_ZUS MG_SOLLK0POS_2_ZST_ZUS MG_SOLLK0POS_ZST_ZUS MG_SOLLK0UVSNEG_ZST_ZUS MG_SOLLK0UVSPOS_ZST_ZUS MS_SOLLEMVORSTEUER_ZUS M_SOLLK0UVS_ZST_ZUS NS_EMEMAKTIV_FUW_ZUS NS_EMEMFEHLER_FUW_ZUS NS_EMKALTNEM_ZST_ZUS NS_EMMINUVS_ZST_ZUS NS_SOLLEMKALTNEM_ZST_ZUS NS_VMMINUVS_ZST_ZUS NS_VMUVS_ZST_ZUS N_MINEMNSOLLVM_ZST_ZUS STATUS_ABL_ZST_ZUS SWI_MK0MODBEGR_ZST_ZUS SWI_ZMODUSVMN_SAK_ZUS SWI_ZMSOLLEM_ZST_ZUS T_VK0BEFKALTNEM_ZST_ZUS Z_ABLAUFVARIANTE_UVS_ZUS /end DEF_CHARACTERISTIC
 /begin LOC_MEASUREMENT SFOp_Zus340_KL_MK0MODK0BEF_ZUS SFOp_Zus340_KL__0MODUVS_ZST_ZUS SFOp_Zus344_KL__VHRESET_ZST_ZUS SFOp_Zus345_out_ SFOp_Zus356_KF__SOLLVM_ZST_ZUS_ SFOp_Zus357_x_ SFOp_Zus78_xp_ c_getriebe_egs_in gangwechsel_egs_in i_zielgang_egs istgang_egs_in k_mstoerk0em_zus m_em_in m_k0_in m_k0_mod_has_fkt m_max_dyn_em_in m_min_dyn_em_in m_min_vm_in m_soll_k0_has_fkt m_soll_k0_min_uvs_zus m_soll_vm_hst_in m_soll_vm_l_hst_in m_stoerk0em_fil_zus m_vm_in m_vm_start_in m_wunsch_fpw_hst_in m_wunsch_fpw_in m_ziel_vm_has_zus mg_wunsch_fpw_hst n_ab_egs_in n_em_in n_sec_iae_ist_zus n_sec_iae_ziel_zus n_soll_em_hst_in n_soll_ll_vm_in n_vm_in nd_k0_in ndg_k0_in ng_vm pos_egs_in sollgang_egs_in status_iae_in status_k0_in status_kraftfluss_egs_in status_nem_in status_nreg_em_hst_in status_psys_has_sbe status_schaltart_svh_has_sbe status_schaltung_egs_in status_sync_schaltung_sbe t_emaktiv_fuw_zus t_k0bef_kaltnem_zst_zus z_ablauf_has_hst_in z_ablauf_has_stg z_ablaufvariante_has_stg z_emfehler_frk_dihi z_fuwdeakt_frk_dihi z_k0_fst_in z_k0_has_fkt z_k0syncmk0erh_frk_dihi z_pvu_has_sbe z_svh_has_sbe /end LOC_MEASUREMENT
/end FUNCTION
/begin FUNCTION SFOp_Zus164_Entry "" /begin DEF_CHARACTERISTIC STATUS_ABL_SCL_ZUS SWI_ZPHYSK0_SCL_ZUS /end DEF_CHARACTERISTIC /end FUNCTION
/begin FUNCTION SFOp_Zus175_ti__oll_k0_anst_zus "" /begin SUB_FUNCTION Run_SFOp_Zus18__oll_k0_anst_zus /end SUB_FUNCTION /begin DEF_CHARACTERISTIC T_MSOLLK0ANSTMAX_SCL_ZUS /end DEF_CHARACTERISTIC /begin LOC_MEASUREMENT t_m_soll_k0_anst_zus /end LOC_MEASUREMENT /end FUNCTION
/begin FUNCTION SFOp_Zus191_Entry "" /begin DEF_CHARACTERISTIC STATUS_ABL_SYN_ZUS /end DEF_CHARACTERISTIC /end FUNCTION
/begin FUNCTION SFOp_Zus209_Bitwise_AND_ui8_ "" /begin DEF_CHARACTERISTIC SWI_K0SREGBASIS_SYN_ZUS /end DEF_CHARACTERISTIC /end FUNCTION
/begin FUNCTION SFOp_Zus211_Bitwise_AND_ui8_1 "" /begin DEF_CHARACTERISTIC SWI_K0SREGBASIS_SYN_ZUS /end DEF_CHARACTERISTIC /end FUNCTION
/begin FUNCTION SFOp_Zus212_Bitwise_AND_ui8_1 "" /begin DEF_CHARACTERISTIC SWI_K0SREGBASIS_SYN_ZUS /end DEF_CHARACTERISTIC /end FUNCTION
/begin FUNCTION SFOp_Zus213_Bitwise_AND_ui8_1 "" /begin DEF_CHARACTERISTIC SWI_K0SREGBASIS_SYN_ZUS /end DEF_CHARACTERISTIC /end FUNCTION
/begin FUNCTION SFOp_Zus260_Bitwise_AND_ui8_ "" /begin DEF_CHARACTERISTIC BM_SCHALTARTNEMMODRS_SYN_ZUS /end DEF_CHARACTERISTIC /end FUNCTION
/begin FUNCTION SFOp_Zus264_Entry "" /begin DEF_CHARACTERISTIC STATUS_ABL_ABBRUCH_FERTIG SWI_ZPHYSK0_UAB_ZUS /end DEF_CHARACTERISTIC /end FUNCTION
/begin FUNCTION SFOp_Zus270_ac__abfangen_zus_en "" /begin DEF_CHARACTERISTIC STATUS_ABL_ABF_ZUS SWI_ZPHYSK0_ABF_ZUS /end DEF_CHARACTERISTIC /end FUNCTION
/begin FUNCTION SFOp_Zus291_Entry "" /begin DEF_CHARACTERISTIC STATUS_ABL_ANH_ZUS /end DEF_CHARACTERISTIC /end FUNCTION
/begin FUNCTION SFOp_Zus296_Ansteuerung_VM "" /begin SUB_FUNCTION Run_SFOp_Zus302_cPT1_NVMSoll /end SUB_FUNCTION
 /begin DEF_CHARACTERISTIC FK_NSOLLVM_ANH_ZUS KF_NDEMNSOLLVM_ANH_ZUS_W KF_NDEMNSOLLVM_ANH_ZUS_X KF_NDEMNSOLLVM_ANH_ZUS_Y KF_NOEMNSOLLVM_ZST_ZUS_W KF_NOEMNSOLLVM_ZST_ZUS_X KF_NOEMNSOLLVM_ZST_ZUS_Y K_MZIELNOEMNSOLLVM_ZST_ZUS K_NOEMNSOLLVMOKS_ZST_ZUS MGS_WUNSCHFPW_ANH_ZUS N_MINEMNSOLLVM_ZST_ZUS /end DEF_CHARACTERISTIC
 /begin LOC_MEASUREMENT SFOp_Zus301_KF__NSOLLVM_ANH_ZUS SFOp_Zus301_KF__NSOLLVM_ZST_ZUS m_max_dyn_em_in m_wunsch_fpw_in m_ziel_vm_has_zus mg_wunsch_fpw_hst n_em_in /end LOC_MEASUREMENT
/end FUNCTION
/begin FUNCTION SFOp_Zus297_EM_Ansteuerung "" /begin DEF_CHARACTERISTIC MS_SOLLEMVORSTEUER_ZUS SWI_ZMSOLLEM_ANH_ZUS /end DEF_CHARACTERISTIC /begin LOC_MEASUREMENT m_max_dyn_em_in /end LOC_MEASUREMENT /end FUNCTION
/begin RECORD_LAYOUT FLOAT32_IEEE_COL_DIRECT_S6_S3 FNC_VALUES 1 FLOAT32_IEEE COLUMN_DIR DIRECT /end RECORD_LAYOUT
/begin RECORD_LAYOUT FLOAT32_IEEE_X_INCR_DIRECT_S6_S3 AXIS_PTS_X 1 FLOAT32_IEEE INDEX_INCR DIRECT /end RECORD_LAYOUT
/begin RECORD_LAYOUT SBYTE_COL_DIRECT_S6_S3 FNC_VALUES 1 SBYTE COLUMN_DIR DIRECT /end RECORD_LAYOUT
/begin RECORD_LAYOUT SBYTE_X_INCR_DIRECT_S6_S3 AXIS_PTS_X 1 SBYTE INDEX_INCR DIRECT /end RECORD_LAYOUT
/begin RECORD_LAYOUT UBYTE_COL_DIRECT_S6_S3 FNC_VALUES 1 UBYTE COLUMN_DIR DIRECT /end RECORD_LAYOUT
/begin RECORD_LAYOUT UBYTE_X_INCR_DIRECT_S6_S3 AXIS_PTS_X 1 UBYTE INDEX_INCR DIRECT /end RECORD_LAYOUT
/begin RECORD_LAYOUT UWORD_X_INCR_DIRECT_S6_S3 AXIS_PTS_X 1 UWORD INDEX_INCR DIRECT /end RECORD_LAYOUT
/end MODULE
/end PROJECT
