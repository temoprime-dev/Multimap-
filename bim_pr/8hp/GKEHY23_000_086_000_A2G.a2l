ASAP2_VERSION 1 51
/begin PROJECT ZHBC8600 "Gen2_BMW_System_Supplier_Lib"
/begin MODULE CPP ""
/begin MOD_COMMON "" BYTE_ORDER MSB_FIRST ALIGNMENT_BYTE 1 ALIGNMENT_WORD 2 ALIGNMENT_LONG 4 ALIGNMENT_FLOAT32_IEEE 4 ALIGNMENT_FLOAT64_IEEE 1 /end MOD_COMMON
/begin COMPU_TAB _CNV_P_2_A_I_140_S2 "" TAB_INTP 2 0 0 65535 65535 /end COMPU_TAB
/begin COMPU_TAB _CNV_P_2_A_I_5_S2 "" TAB_INTP 2 0 0 255 255 /end COMPU_TAB
/begin COMPU_VTAB _CNV_S_100_Enum_EPRIS_25_S2 "" TAB_VERB 100 0 "PRISQ_1" 1 "PRISQ_2" 2 "PRISQ_3" 3 "PRISQ_4" 4 "PRISQ_5" 5 "PRISQ_6" 6 "PRISQ_7" 7 "PRISQ_8" 8 "PRISQ_9" 9 "PRISQ_10" 10 "PRISQ_11" 11 "PRISQ_12" 12 "PRISQ_13" 13 "PRISQ_14" 14 "PRISQ_15" 15 "PRISQ_16" 16 "PRISQ_17" 17 "PRISQ_18" 18 "PRISQ_19" 19 "PRISQ_20" 20 "PRISQ_21" 21 "PRISQ_22" 22 "PRISQ_23" 23 "PRISQ_24" 24 "PRISQ_25" 25 "PRISQ_26" 26 "PRISQ_27" 27 "PRISQ_28" 28 "PRISQ_29" 29 "PRISQ_30" 30 "PRISQ_31" 31 "PRISQ_32" 32 "PRISQ_33" 33 "PRISQ_34" 34 "PRISQ_35" 35 "PRISQ_36" 36 "PRISQ_37" 37 "PRISQ_38" 38 "PRISQ_39" 39 "PRISQ_40" 40 "PRISQ_41" 41 "PRISQ_42" 42 "PRISQ_43" 43 "PRISQ_44" 44 "PRISQ_45" 45 "PRISQ_46" 46 "PRISQ_47" 47 "PRISQ_48" 48 "PRISQ_49" 49 "PRISQ_50" 50 "PRISQ_51" 51 "PRISQ_52" 52 "PRISQ_53" 53 "PRISQ_54" 54 "PRISQ_55" 55 "PRISQ_56" 56 "PRISQ_57" 57 "PRISQ_58" 58 "PRISQ_59" 59 "PRISQ_60" 60 "PRISQ_61" 61 "PRISQ_62" 62 "PRISQ_63" 63 "PRISQ_64" 64 "PRISQ_65" 65 "PRISQ_66" 66 "PRISQ_67" 67 "PRISQ_68" 68 "PRISQ_69" 69 "PRISQ_70" 70 "PRISQ_71" 71 "PRISQ_72" 72 "PRISQ_73" 73 "PRISQ_74" 74 "PRISQ_75" 75 "PRISQ_76" 76 "PRISQ_77" 77 "PRISQ_78" 78 "PRISQ_79" 79 "PRISQ_80" 80 "PRISQ_81" 81 "PRISQ_82" 82 "PRISQ_83" 83 "PRISQ_84" 84 "PRISQ_85" 85 "PRISQ_86" 86 "PRISQ_87" 87 "PRISQ_88" 88 "PRISQ_89" 89 "PRISQ_90" 90 "PRISQ_91" 91 "PRISQ_92" 92 "PRISQ_93" 93 "PRISQ_94" 94 "PRISQ_95" 95 "PRISQ_96" 96 "PRISQ_97" 97 "PRISQ_98" 98 "PRISQ_99" 99 "PRISQ_100" DEFAULT_VALUE "" /end COMPU_VTAB
/begin COMPU_VTAB _CNV_S_10_Enum_EDMRS_264_S2 "" TAB_VERB 10 0 "DMRS_ZIELGANG" 1 "DMRS_PRUEFGANG" 2 "DMRS_A_AGS" 3 "DMRS_S_AGS" 4 "DMRS_STEPTR" 5 "DMRS_FDC" 6 "NAB_MAX_MIT_RESTWEG" 7 "NAB_MAX_OHNE_RESTWEG" 8 "NAB_MAX_MIT_RESTWEG_ECO" 9 "NAB_MAX_OHNE_RESTWEG_ECO" DEFAULT_VALUE "" /end COMPU_VTAB
/begin COMPU_VTAB _CNV_S_11_Enum_EFKT__272_S2 "" TAB_VERB 11 0 "XE_FKT" 1 "ECO" 2 "DPF_REG" 3 "WL1" 4 "WL2" 5 "BERG_A1" 6 "BERG_A2" 7 "BERG_A3" 8 "EFAHREN_1" 9 "EFAHREN_2" 10 "REKUP" DEFAULT_VALUE "" /end COMPU_VTAB
/begin COMPU_VTAB _CNV_S_12_Enum_EKOPF_86_S2 "" TAB_VERB 12 0 "BAB" 1 "BGR_WHL" 2 "MAB" 3 "STOPGO" 4 "BRS" 5 "ANF_GANG2FL" 6 "ANF_GANG2" 7 "ZRS_GANG1" 8 "RSU_BGH" 9 "ZRS_GANG1EXT" 10 "RSU_MUELOW" 11 "FREI_1" DEFAULT_VALUE "" /end COMPU_VTAB
/begin COMPU_VTAB _CNV_S_13_Enum_EADDF_85_S2 "" TAB_VERB 13 0 "QSHIFT" 1 "NIC" 2 "HSEARLIER" 3 "HSLATER" 4 "WKZUSCHALT" 5 "GWK_FDYN" 6 "DYN_WKANB" 7 "DMRS" 8 "DERS" 9 "AFU" 10 "WKMAX" 11 "SEGELN" 12 "MSA" DEFAULT_VALUE "" /end COMPU_VTAB
/begin COMPU_VTAB _CNV_S_13_Enum_EHSUR_14_S2 "" TAB_VERB 13 0 "HSURE_VOR" 1 "HSURE_FOF" 2 "HSURE_INSTAT" 3 "HSURE_BRS" 4 "HSURE_NL" 5 "HSURE_BAB" 6 "HSURE_KUVORHALT" 7 "HSURE_KU" 8 "HSURE_RS" 9 "HSURE_HS" 10 "HSURE_ADAPT" 11 "HSURE_NABNEGATIV" 12 "HSURE_SCHLUPF" DEFAULT_VALUE "" /end COMPU_VTAB
/begin COMPU_VTAB _CNV_S_14_Enum_EDYND_131_S2 "" TAB_VERB 14 0 "QS0" 1 "QS1" 2 "QS2" 3 "M_MOT1" 4 "M_MOT2" 5 "WK_AUF" 6 "WK_GER" 7 "WK_ZU" 8 "SCHALTUNG" 9 "EFAHREN_AKTIV" 10 "WARTEZEIT" 11 "GRADIENT" 12 "FILTER_WK" 13 "FILTER_DAEMPF" DEFAULT_VALUE "" /end COMPU_VTAB
/begin COMPU_VTAB _CNV_S_15_Enum_EDYNA_160_S2 "" TAB_VERB 15 0 "HS_KOMFORT" 1 "HS_QS1" 2 "HS_QS2" 3 "HS_QS3" 4 "RS_KOMFORT" 5 "RS_PME_KOMFORT" 6 "RS_PME_QS1" 7 "RS_PME_QS2" 8 "DMRS_PME_QS1" 9 "DMRS_PME_QS2" 10 "FPKF_KOMFORT" 11 "FPKF_ECO" 12 "FPKF_SPORT" 13 "WKANBIND_KOMFORT" 14 "WKANBIND_DIREKT" DEFAULT_VALUE "" /end COMPU_VTAB
/begin COMPU_VTAB _CNV_S_15_Enum_EPRIS_274_S2 "" TAB_VERB 15 0 "SPA_PRSIQ_1" 1 "SPA_PRSIQ_2" 2 "SPA_PRSIQ_3" 3 "SPA_PRSIQ_4" 4 "SPA_PRSIQ_5" 5 "SPA_PRSIQ_6" 6 "SPA_PRSIQ_7" 7 "SPA_PRSIQ_8" 8 "SPA_PRSIQ_9" 9 "SPA_PRSIQ_10" 10 "SPA_PRSIQ_11" 11 "SPA_PRSIQ_12" 12 "SPA_PRSIQ_13" 13 "SPA_PRSIQ_14" 14 "SPA_PRSIQ_15" DEFAULT_VALUE "" /end COMPU_VTAB
/begin COMPU_VTAB _CNV_S_16_Enum_EIDXG_169_S2 "" TAB_VERB 16 0 "Index_0" 1 "Index_1" 2 "Index_2" 3 "Index_3" 4 "Index_4" 5 "Index_5" 6 "Index_6" 7 "Index_7" 8 "Index_8" 9 "Index_9" 10 "Index_10" 11 "Index_11" 12 "Index_12" 13 "Index_13" 14 "Index_14" 15 "SIGNAL_UNGUELTIG" DEFAULT_VALUE "0" /end COMPU_VTAB
/begin COMPU_VTAB _CNV_S_16_Enum_EPROG_79_S2 "" TAB_VERB 16 0 "DS2_XE" 1 "DS2_E" 2 "DS2_S" 3 "DS2_XS" 4 "DS2_A1" 5 "DS2_A2" 6 "DS2_A3" 7 "DS2_A4" 8 "DS2_STEPTR" 9 "DS2_SO" 10 "DS2_B0" 11 "DS2_LM" 12 "DS2_WL" 13 "DS2_LD" 14 "DS2_LDM" 15 "DS2_A5" DEFAULT_VALUE "" /end COMPU_VTAB
/begin COMPU_VTAB _CNV_S_20_Enum_EGLBE_84_S2 "" TAB_VERB 20 0 "MIN_EXC" 1 "MAX_EXC" 2 "MIN_RFWS" 3 "MAX_RFWS" 4 "MIN_CMOPLUFT" 5 "MIN_DPFREG" 6 "MIN_AEP" 7 "MIN_HOTMODE" 8 "MIN_MOTSOLLLL" 9 "MIN_CGT" 10 "MAX_EMHIGH" 11 "MAX_EMLOW" 12 "MAX_TMS" 13 "MAX_HOTMODE" 14 "MIN_ARSDYN" 15 "MAX_ECO" 16 "MAX_DYNSPV" 17 "MIN_REKUPRS" 18 "MARS_DBM" 19 "K0_DBM" DEFAULT_VALUE "" /end COMPU_VTAB
/begin COMPU_VTAB _CNV_S_21_Enum_EPROG_27_S2 "" TAB_VERB 21 0 "EXTREME_ECONOMY_PROG" 1 "ECONOMY_PROG" 2 "SPORT_PROG" 3 "EXTREME_SPORT_PROG" 4 "A1_PROG" 5 "A2_PROG" 6 "A3_PROG" 7 "A4_PROG" 8 "A5_PROG" 9 "SA1_PROG" 10 "SA2_PROG" 11 "SA3_PROG" 12 "SA4_PROG" 13 "WL1_PROG" 14 "WL2_PROG" 15 "ECO_PROG" 16 "ECOA1_PROG" 17 "ECOA2_PROG" 18 "ECOWL2_PROG" 19 "SO1_PROG" 20 "SO2_PROG" DEFAULT_VALUE "" /end COMPU_VTAB
/begin COMPU_VTAB _CNV_S_2_Enum_EAGS_18_S2 "" TAB_VERB 2 0 "A_AGS" 1 "S_AGS" DEFAULT_VALUE "" /end COMPU_VTAB
/begin COMPU_VTAB _CNV_S_2_Enum_EDYNH_202_S2 "" TAB_VERB 2 0 "PT1_FILT" 1 "PT2_FILT" DEFAULT_VALUE "" /end COMPU_VTAB
/begin COMPU_VTAB _CNV_S_2_Enum_EGNMT_201_S2 "" TAB_VERB 2 0 "Korfakt_in_Schaltung_einfrieren" 1 "Korfakt_in_Schaltung_XFAKT_FILTKORSCHALT_DYNHSPV" DEFAULT_VALUE "0" /end COMPU_VTAB
/begin COMPU_VTAB _CNV_S_2_Enum_EGW_F_273_S2 "" TAB_VERB 2 0 "MIN_SPA" 1 "MAX_SPA" DEFAULT_VALUE "" /end COMPU_VTAB
/begin COMPU_VTAB _CNV_S_2_Enum_ESIGN_230_S2 "" TAB_VERB 2 0 "SIGNAL_SCHNITTSTELLE" 1 "SIGNAL_SIMULATE" DEFAULT_VALUE "" /end COMPU_VTAB
/begin COMPU_VTAB _CNV_S_2_Enum_ESIGN_231_S2 "" TAB_VERB 2 0 "SIGNAL_SIMULATE" 1 "SIGNAL_SCHNITTSTELLE" DEFAULT_VALUE "" /end COMPU_VTAB
/begin COMPU_VTAB _CNV_S_2_Enum_ESPER_182_S2 "" TAB_VERB 2 0 "FLANKE_LDM_ERK" 1 "FLANKE_LDMBAB_ERK" DEFAULT_VALUE "" /end COMPU_VTAB
/begin COMPU_VTAB _CNV_S_2_Enum_ESTOP_123_S2 "" TAB_VERB 2 0 "Deaktivierung_Stop_Go_bei_aktivem_MSA" 1 "Stop_Go_bei_aktivem_MSA_moeglich" DEFAULT_VALUE "" /end COMPU_VTAB
/begin COMPU_VTAB _CNV_S_2_Enum_EWL2_122_S2 "" TAB_VERB 2 0 "WL2_nichtaktiv" 1 "WL2_aktiv" DEFAULT_VALUE "" /end COMPU_VTAB
/begin COMPU_VTAB _CNV_S_2_Schalter_A_4_S2 "Schalter: 0 = AUS, 1 = EIN" TAB_VERB 2 0 "AUS" 1 "EIN" DEFAULT_VALUE "" /end COMPU_VTAB
/begin COMPU_VTAB _CNV_S_3_Enum_EANH_51_S2 "" TAB_VERB 3 0 "KEIN_ANHAENGER" 1 "ANHAENGER" 2 "ANHAENGER_ODER_KEIN_ANHAENGER" DEFAULT_VALUE "" /end COMPU_VTAB
/begin COMPU_VTAB _CNV_S_3_Enum_EDYND_129_S2 "" TAB_VERB 3 -1 "KEINE_PHASE6_7_DYNDZM" 0 "SEGELN_DYNDZM" 1 "EFAHREN_DYNDZM" DEFAULT_VALUE "" /end COMPU_VTAB
/begin COMPU_VTAB _CNV_S_42_Enum_EQSHI_164_S2 "" TAB_VERB 42 0 "ZWANGSCH_STEP" 1 "FT_BR_E" 2 "FT_BR_S" 3 "FT_BR_XS" 4 "GWDKKD1" 5 "GWDKKD2" 6 "MFRS" 7 "MFHS" 8 "WDKKD1" 9 "WDKKD2" 10 "WDKKD3" 11 "NULLAST" 12 "DSC_DTC" 13 "DSC_AUS" 14 "S_QS3_SOLL" 15 "ANH" 16 "ASC" 17 "TEMP1" 18 "TEMP2" 19 "WL2" 20 "ECO" 21 "COD_GETRTYP" 22 "EXCFKT1" 23 "EXCFKT2" 24 "EXCFKT3" 25 "EXCFKT4" 26 "EXCFKT5" 27 "EXCFKT6" 28 "EXCFKT7" 29 "EXCFKT8" 30 "HOCHSCH" 31 "RUECKSCH" 32 "ISTGANG_1" 33 "ISTGANG_2" 34 "ISTGANG_3" 35 "ISTGANG_4" 36 "ISTGANG_5" 37 "ISTGANG_6" 38 "ISTGANG_7" 39 "ISTGANG_8" 40 "ISTGANG_9" 41 "DYNAMIK" DEFAULT_VALUE "" /end COMPU_VTAB
/begin COMPU_VTAB _CNV_S_4_Enum_EAGS__17_S2 "" TAB_VERB 4 0 "A_AGS" 1 "S_AGS" 2 "ECO" 3 "E_FAHREN" DEFAULT_VALUE "" /end COMPU_VTAB
/begin COMPU_VTAB _CNV_S_4_Enum_EEXCF_91_S2 "" TAB_VERB 4 0 "AUTOMAT" 1 "MANUELL" 2 "FAHRERASSISTENT" 3 "ZUGKRAFTALGO" DEFAULT_VALUE "" /end COMPU_VTAB
/begin COMPU_VTAB _CNV_S_4_Enum_EFWSS_240_S2 "" TAB_VERB 4 0 "KEIN_BREMSE_KEIN_ANHAENGER" 1 "BREMSE_AN_KEIN_ANHAENGER" 2 "KEIN_BREMSE_MIT_ANHAENGER" 3 "BREMSE_AN_MIT_ANHAENGER" DEFAULT_VALUE "" /end COMPU_VTAB
/begin COMPU_VTAB _CNV_S_4_Enum_EKURV_247_S2 "" TAB_VERB 4 0 "KURVEVORL_A_AGS" 1 "KURVEVORL_S_AGS" 2 "KURVEVORL_LDM" 3 "KURVEVORL_TID" DEFAULT_VALUE "" /end COMPU_VTAB
/begin COMPU_VTAB _CNV_S_4_Enum_EVALI_262_S2 "" TAB_VERB 4 0 "INVALID" 2 "INVALID_LDM" 5 "DREHZAHLGRENZEN" 10 "VALID" DEFAULT_VALUE "" /end COMPU_VTAB
/begin COMPU_VTAB _CNV_S_5_Enum_EGWDK_161_S2 "" TAB_VERB 5 0 "GWDKKD1_QS" 1 "GWDKKD2_QS" 2 "GWDKKD3_QS" 3 "GWDKKD4_QS" 4 "GWDKKD5_QS" DEFAULT_VALUE "" /end COMPU_VTAB
/begin COMPU_VTAB _CNV_S_5_Enum_EKURV_246_S2 "" TAB_VERB 5 0 "KURVETYP_NORMAL" 1 "KURVETYP_NORMAL_S_AGS" 2 "KURVETYP_SERP" 3 "KURVETYP_LDM" 4 "KURVETYP_NORMAL_TID" DEFAULT_VALUE "" /end COMPU_VTAB
/begin COMPU_VTAB _CNV_S_5_Enum_EVALI_187_S2 "" TAB_VERB 5 0 "INVALID" 2 "INVALID_LDM" 5 "DREHZAHLGRENZEN" 10 "DREHZAHLEN" 30 "BEWERTUNG" DEFAULT_VALUE "" /end COMPU_VTAB
/begin COMPU_VTAB _CNV_S_5_Enum_EZKAT_184_S2 "" TAB_VERB 5 0 "ZKA_IDX1" 1 "ZKA_IDX2" 2 "ZKA_IDX3" 3 "ZKA_IDX4" 4 "ZKA_IDX5" DEFAULT_VALUE "" /end COMPU_VTAB
/begin COMPU_VTAB _CNV_S_6_Enum_EBERG_47_S2 "" TAB_VERB 6 0 "BERGANH_OFF" 1 "BERGANH_A1" 2 "BERGANH_A2" 3 "BERGANH_A3" 4 "BERGANH_A4" 5 "BERGANH_A5" DEFAULT_VALUE "" /end COMPU_VTAB
/begin COMPU_VTAB _CNV_S_6_Enum_EDL_11_S2 "" TAB_VERB 6 1 "DL_1" 2 "DL_2" 3 "DL_3" 4 "DL_4" 5 "DL_5" 6 "DL_6" DEFAULT_VALUE "" /end COMPU_VTAB
/begin COMPU_VTAB _CNV_S_9_Enum_EGANG_21_S2 "" TAB_VERB 9 0 "GANG_1" 1 "GANG_2" 2 "GANG_3" 3 "GANG_4" 4 "GANG_5" 5 "GANG_6" 6 "GANG_7" 7 "GANG_8" 8 "GANG_9" DEFAULT_VALUE "" /end COMPU_VTAB
/begin COMPU_METHOD _CNV_P_2_A_I_140_CM_S2 "" TAB_INTP "%6.3" "U/min" COMPU_TAB_REF _CNV_P_2_A_I_140_S2 /end COMPU_METHOD
/begin COMPU_METHOD _CNV_P_2_A_I_5_CM_S2 "" TAB_INTP "%6.3" "" COMPU_TAB_REF _CNV_P_2_A_I_5_S2 /end COMPU_METHOD
/begin COMPU_METHOD _CNV_R_R_Umr_1000_z_36_CM_S2 "" RAT_FUNC "%6.3" "" COEFFS 0 1000 0 0 0 1 /end COMPU_METHOD
/begin COMPU_METHOD _CNV_R_R_Umr_100_zu_194_CM_S2 "" RAT_FUNC "%6.3" "U/(min*ms)" COEFFS 0 100 0 0 0 1 /end COMPU_METHOD
/begin COMPU_METHOD _CNV_R_R_Umr_100_zu_204_CM_S2 "" RAT_FUNC "%6.3" "m*m/s*s*s*s" COEFFS 0 100 0 0 0 1 /end COMPU_METHOD
/begin COMPU_METHOD _CNV_R_R_Umr_100_zu_207_CM_S2 "" RAT_FUNC "%6.3" "m/s" COEFFS 0 100 0 0 0 1 /end COMPU_METHOD
/begin COMPU_METHOD _CNV_R_R_Umr_100_zu_42_CM_S2 "" RAT_FUNC "%6.3" "" COEFFS 0 100 0 0 0 1 /end COMPU_METHOD
/begin COMPU_METHOD _CNV_R_R_Umr_100_zu_88_CM_S2 "" RAT_FUNC "%6.3" "%" COEFFS 0 100 0 0 0 1 /end COMPU_METHOD
/begin COMPU_METHOD _CNV_R_R_Umr_10_zu__10_CM_S2 "" RAT_FUNC "%6.3" "°" COEFFS 0 10 0 0 0 1 /end COMPU_METHOD
/begin COMPU_METHOD _CNV_R_R_Umr_10_zu__117_CM_S2 "" RAT_FUNC "%6.3" "s" COEFFS 0 10 0 0 0 1 /end COMPU_METHOD
/begin COMPU_METHOD _CNV_R_R_Umr_10_zu__138_CM_S2 "" RAT_FUNC "%6.3" "1/s²" COEFFS 0 10 0 0 0 1 /end COMPU_METHOD
/begin COMPU_METHOD _CNV_R_R_Umr_10_zu__206_CM_S2 "" RAT_FUNC "%6.3" "m/s" COEFFS 0 10 0 0 0 1 /end COMPU_METHOD
/begin COMPU_METHOD _CNV_R_R_Umr_10_zu__37_CM_S2 "" RAT_FUNC "%6.3" "m/s*s" COEFFS 0 10 0 0 0 1 /end COMPU_METHOD
/begin COMPU_METHOD _CNV_R_R_Umr_10_zu__9_CM_S2 "" RAT_FUNC "%6.3" "%" COEFFS 0 10 0 0 0 1 /end COMPU_METHOD
/begin COMPU_METHOD _CNV_R_R_Umr_16_zu__141_CM_S2 "" RAT_FUNC "%6.3" "km/h" COEFFS 0 16 0 0 0 1 /end COMPU_METHOD
/begin COMPU_METHOD _CNV_R_R_Umr_1_zu_1_0_CM_S2 "" RAT_FUNC "%6.3" "hPa" COEFFS 0 1 0 0 0 1 /end COMPU_METHOD
/begin COMPU_METHOD _CNV_R_R_Umr_1_zu_1_190_CM_S2 "" RAT_FUNC "%6.3" "Nm" COEFFS 0 0.1 0 0 0 1 /end COMPU_METHOD
/begin COMPU_METHOD _CNV_R_R_Umr_1_zu_1_1_CM_S2 "" RAT_FUNC "%6.3" "°C" COEFFS 0 1 0 0 0 1 /end COMPU_METHOD
/begin COMPU_METHOD _CNV_R_R_Umr_1_zu_1_205_CM_S2 "" RAT_FUNC "%6.3" "0.1g" COEFFS 0 1 0 0 0 1 /end COMPU_METHOD
/begin COMPU_METHOD _CNV_R_R_Umr_1_zu_1_214_CM_S2 "" RAT_FUNC "%6.3" "kg" COEFFS 0 1 0 0 0 1 /end COMPU_METHOD
/begin COMPU_METHOD _CNV_R_R_Umr_1_zu_1_242_CM_S2 "" RAT_FUNC "%6.3" "%/s" COEFFS 0 0.1 0 0 0 1 /end COMPU_METHOD
/begin COMPU_METHOD _CNV_R_R_Umr_1_zu_1_245_CM_S2 "" RAT_FUNC "%6.3" "Nm/s" COEFFS 0 0.01 0 0 0 1 /end COMPU_METHOD
/begin COMPU_METHOD _CNV_R_R_Umr_1_zu_1_266_CM_S2 "" RAT_FUNC "%6.3" "% von %" COEFFS 0 1 0 0 0 1 /end COMPU_METHOD
/begin COMPU_METHOD _CNV_R_R_Umr_1_zu_1_2_CM_S2 "" RAT_FUNC "%6.3" "" COEFFS 0 1 0 0 0 1 /end COMPU_METHOD
/begin COMPU_METHOD _CNV_R_R_Umr_1_zu_1_30_CM_S2 "" RAT_FUNC "%6.3" "%" COEFFS 0 1 0 0 0 1 /end COMPU_METHOD
/begin COMPU_METHOD _CNV_R_R_Umr_1_zu_1_38_CM_S2 "" RAT_FUNC "%6.3" "Nm" COEFFS 0 1 0 0 0 1 /end COMPU_METHOD
/begin COMPU_METHOD _CNV_R_R_Umr_1_zu_1_3_CM_S2 "" RAT_FUNC "%6.3" "U/min" COEFFS 0 1 0 0 0 1 /end COMPU_METHOD
/begin COMPU_METHOD _CNV_R_R_Umr_1_zu_1_6_CM_S2 "" RAT_FUNC "%6.3" "ms" COEFFS 0 1 0 0 0 1 /end COMPU_METHOD
/begin COMPU_METHOD _CNV_R_R_Umr_1_zu_1_7_CM_S2 "" RAT_FUNC "%6.3" "%/s" COEFFS 0 1 0 0 0 1 /end COMPU_METHOD
/begin COMPU_METHOD _CNV_R_R_Umr_1_zu_1_8_CM_S2 "" RAT_FUNC "%6.3" "km/h" COEFFS 0 1 0 0 0 1 /end COMPU_METHOD
/begin COMPU_METHOD _CNV_R_R_Umr_2_zu_1_179_CM_S2 "" RAT_FUNC "%6.3" "Bar" COEFFS 0 2 0 0 0 1 /end COMPU_METHOD
/begin COMPU_METHOD _CNV_R_R_Umr_32_zu__147_CM_S2 "" RAT_FUNC "%6.3" "m/s*s" COEFFS 0 32 0 0 0 1 /end COMPU_METHOD
/begin COMPU_METHOD _CNV_R_R_Umr_64_zu__82_CM_S2 "" RAT_FUNC "%6.3" "km/h" COEFFS 0 64 0 0 0 1 /end COMPU_METHOD
/begin COMPU_METHOD _CNV_S_100_Enum_EPRIS_25_CM_S2 "" TAB_VERB "%6.3" "" COMPU_TAB_REF _CNV_S_100_Enum_EPRIS_25_S2 /end COMPU_METHOD
/begin COMPU_METHOD _CNV_S_10_Enum_EDMRS_264_CM_S2 "" TAB_VERB "%6.3" "" COMPU_TAB_REF _CNV_S_10_Enum_EDMRS_264_S2 /end COMPU_METHOD
/begin COMPU_METHOD _CNV_S_11_Enum_EFKT__272_CM_S2 "" TAB_VERB "%6.3" "" COMPU_TAB_REF _CNV_S_11_Enum_EFKT__272_S2 /end COMPU_METHOD
/begin COMPU_METHOD _CNV_S_12_Enum_EKOPF_86_CM_S2 "" TAB_VERB "%6.3" "" COMPU_TAB_REF _CNV_S_12_Enum_EKOPF_86_S2 /end COMPU_METHOD
/begin COMPU_METHOD _CNV_S_13_Enum_EADDF_85_CM_S2 "" TAB_VERB "%6.3" "" COMPU_TAB_REF _CNV_S_13_Enum_EADDF_85_S2 /end COMPU_METHOD
/begin COMPU_METHOD _CNV_S_13_Enum_EHSUR_14_CM_S2 "" TAB_VERB "%6.3" "" COMPU_TAB_REF _CNV_S_13_Enum_EHSUR_14_S2 /end COMPU_METHOD
/begin COMPU_METHOD _CNV_S_14_Enum_EDYND_131_CM_S2 "" TAB_VERB "%6.3" "" COMPU_TAB_REF _CNV_S_14_Enum_EDYND_131_S2 /end COMPU_METHOD
/begin COMPU_METHOD _CNV_S_15_Enum_EDYNA_160_CM_S2 "" TAB_VERB "%6.3" "" COMPU_TAB_REF _CNV_S_15_Enum_EDYNA_160_S2 /end COMPU_METHOD
/begin COMPU_METHOD _CNV_S_15_Enum_EPRIS_274_CM_S2 "" TAB_VERB "%6.3" "" COMPU_TAB_REF _CNV_S_15_Enum_EPRIS_274_S2 /end COMPU_METHOD
/begin COMPU_METHOD _CNV_S_16_Enum_EIDXG_169_CM_S2 "" TAB_VERB "%6.3" "" COMPU_TAB_REF _CNV_S_16_Enum_EIDXG_169_S2 /end COMPU_METHOD
/begin COMPU_METHOD _CNV_S_16_Enum_EPROG_79_CM_S2 "" TAB_VERB "%6.3" "" COMPU_TAB_REF _CNV_S_16_Enum_EPROG_79_S2 /end COMPU_METHOD
/begin COMPU_METHOD _CNV_S_20_Enum_EGLBE_84_CM_S2 "" TAB_VERB "%6.3" "" COMPU_TAB_REF _CNV_S_20_Enum_EGLBE_84_S2 /end COMPU_METHOD
/begin COMPU_METHOD _CNV_S_21_Enum_EPROG_27_CM_S2 "" TAB_VERB "%6.3" "" COMPU_TAB_REF _CNV_S_21_Enum_EPROG_27_S2 /end COMPU_METHOD
/begin COMPU_METHOD _CNV_S_2_Enum_EAGS_18_CM_S2 "" TAB_VERB "%6.3" "" COMPU_TAB_REF _CNV_S_2_Enum_EAGS_18_S2 /end COMPU_METHOD
/begin COMPU_METHOD _CNV_S_2_Enum_EDYNH_202_CM_S2 "" TAB_VERB "%6.3" "" COMPU_TAB_REF _CNV_S_2_Enum_EDYNH_202_S2 /end COMPU_METHOD
/begin COMPU_METHOD _CNV_S_2_Enum_EGNMT_201_CM_S2 "" TAB_VERB "%6.3" "" COMPU_TAB_REF _CNV_S_2_Enum_EGNMT_201_S2 /end COMPU_METHOD
/begin COMPU_METHOD _CNV_S_2_Enum_EGW_F_273_CM_S2 "" TAB_VERB "%6.3" "" COMPU_TAB_REF _CNV_S_2_Enum_EGW_F_273_S2 /end COMPU_METHOD
/begin COMPU_METHOD _CNV_S_2_Enum_ESIGN_230_CM_S2 "" TAB_VERB "%6.3" "" COMPU_TAB_REF _CNV_S_2_Enum_ESIGN_230_S2 /end COMPU_METHOD
/begin COMPU_METHOD _CNV_S_2_Enum_ESIGN_231_CM_S2 "" TAB_VERB "%6.3" "" COMPU_TAB_REF _CNV_S_2_Enum_ESIGN_231_S2 /end COMPU_METHOD
/begin COMPU_METHOD _CNV_S_2_Enum_ESPER_182_CM_S2 "" TAB_VERB "%6.3" "" COMPU_TAB_REF _CNV_S_2_Enum_ESPER_182_S2 /end COMPU_METHOD
/begin COMPU_METHOD _CNV_S_2_Enum_ESTOP_123_CM_S2 "" TAB_VERB "%6.3" "" COMPU_TAB_REF _CNV_S_2_Enum_ESTOP_123_S2 /end COMPU_METHOD
/begin COMPU_METHOD _CNV_S_2_Enum_EWL2_122_CM_S2 "" TAB_VERB "%6.3" "" COMPU_TAB_REF _CNV_S_2_Enum_EWL2_122_S2 /end COMPU_METHOD
/begin COMPU_METHOD _CNV_S_2_Schalter_A_4_CM_S2 "Schalter: 0 = AUS, 1 = EIN" TAB_VERB "%6.3" "" COMPU_TAB_REF _CNV_S_2_Schalter_A_4_S2 /end COMPU_METHOD
/begin COMPU_METHOD _CNV_S_3_Enum_EANH_51_CM_S2 "" TAB_VERB "%6.3" "" COMPU_TAB_REF _CNV_S_3_Enum_EANH_51_S2 /end COMPU_METHOD
/begin COMPU_METHOD _CNV_S_3_Enum_EDYND_129_CM_S2 "" TAB_VERB "%6.3" "" COMPU_TAB_REF _CNV_S_3_Enum_EDYND_129_S2 /end COMPU_METHOD
/begin COMPU_METHOD _CNV_S_42_Enum_EQSHI_164_CM_S2 "" TAB_VERB "%6.3" "" COMPU_TAB_REF _CNV_S_42_Enum_EQSHI_164_S2 /end COMPU_METHOD
/begin COMPU_METHOD _CNV_S_4_Enum_EAGS__17_CM_S2 "" TAB_VERB "%6.3" "" COMPU_TAB_REF _CNV_S_4_Enum_EAGS__17_S2 /end COMPU_METHOD
/begin COMPU_METHOD _CNV_S_4_Enum_EEXCF_91_CM_S2 "" TAB_VERB "%6.3" "" COMPU_TAB_REF _CNV_S_4_Enum_EEXCF_91_S2 /end COMPU_METHOD
/begin COMPU_METHOD _CNV_S_4_Enum_EFWSS_240_CM_S2 "" TAB_VERB "%6.3" "" COMPU_TAB_REF _CNV_S_4_Enum_EFWSS_240_S2 /end COMPU_METHOD
/begin COMPU_METHOD _CNV_S_4_Enum_EKURV_247_CM_S2 "" TAB_VERB "%6.3" "" COMPU_TAB_REF _CNV_S_4_Enum_EKURV_247_S2 /end COMPU_METHOD
/begin COMPU_METHOD _CNV_S_4_Enum_EVALI_262_CM_S2 "" TAB_VERB "%6.3" "" COMPU_TAB_REF _CNV_S_4_Enum_EVALI_262_S2 /end COMPU_METHOD
/begin COMPU_METHOD _CNV_S_5_Enum_EGWDK_161_CM_S2 "" TAB_VERB "%6.3" "" COMPU_TAB_REF _CNV_S_5_Enum_EGWDK_161_S2 /end COMPU_METHOD
/begin COMPU_METHOD _CNV_S_5_Enum_EKURV_246_CM_S2 "" TAB_VERB "%6.3" "" COMPU_TAB_REF _CNV_S_5_Enum_EKURV_246_S2 /end COMPU_METHOD
/begin COMPU_METHOD _CNV_S_5_Enum_EVALI_187_CM_S2 "" TAB_VERB "%6.3" "" COMPU_TAB_REF _CNV_S_5_Enum_EVALI_187_S2 /end COMPU_METHOD
/begin COMPU_METHOD _CNV_S_5_Enum_EZKAT_184_CM_S2 "" TAB_VERB "%6.3" "" COMPU_TAB_REF _CNV_S_5_Enum_EZKAT_184_S2 /end COMPU_METHOD
/begin COMPU_METHOD _CNV_S_6_Enum_EBERG_47_CM_S2 "" TAB_VERB "%6.3" "" COMPU_TAB_REF _CNV_S_6_Enum_EBERG_47_S2 /end COMPU_METHOD
/begin COMPU_METHOD _CNV_S_6_Enum_EDL_11_CM_S2 "" TAB_VERB "%6.3" "" COMPU_TAB_REF _CNV_S_6_Enum_EDL_11_S2 /end COMPU_METHOD
/begin COMPU_METHOD _CNV_S_9_Enum_EGANG_21_CM_S2 "" TAB_VERB "%6.3" "" COMPU_TAB_REF _CNV_S_9_Enum_EGANG_21_S2 /end COMPU_METHOD
/begin COMPU_METHOD SAB_A_1MPSS40_M2048_S2_S3 "int = ((phys * 40) / 1) - (-2048) m/s^2" RAT_FUNC "%4.3" "m/s^2" COEFFS 0 40 2048 0 0 1 /end COMPU_METHOD
/begin COMPU_METHOD SAB_A_204G100000_M2049_S2_S3 "int = ((phys * 100000) / 204) - (-2049) g" RAT_FUNC "%4.3" "g" COEFFS 0 490.196078431 2049 0 0 1 /end COMPU_METHOD
/begin COMPU_METHOD SAB_A_24MPSS1000_2016M1000_S2_S3 "int = ((phys * 1000) / 24) - (-84) m/s^2" RAT_FUNC "%4.3" "m/s^2" COEFFS 0 41.6666666667 84 0 0 1 /end COMPU_METHOD
/begin COMPU_METHOD SAB_A_24MPSS1000_3984M1000_S2_S3 "int = ((phys * 1000) / 24) - (-166) m/s^2" RAT_FUNC "%4.3" "m/s^2" COEFFS 0 41.6666666667 166 0 0 1 /end COMPU_METHOD
/begin COMPU_METHOD SAB_A_24MPSS1000_398M100_S2_S3 "int = ((phys * 1000) / 24) - (-166) m/s^2" RAT_FUNC "%4.3" "m/s^2" COEFFS 0 41.6666666667 166 0 0 1 /end COMPU_METHOD
/begin COMPU_METHOD SAB_A_24MPSS1000_M2016_S2_S3 "int = ((phys * 1000) / 24) - (-84) m/s^2" RAT_FUNC "%4.3" "m/s^2" COEFFS 0 41.6666666667 84 0 0 1 /end COMPU_METHOD
/begin COMPU_METHOD SAB_A_24MPSS1000_M3980_S2_S3 "int = ((phys * 1000) / 24) - (-166) m/s^2" RAT_FUNC "%4.3" "m/s^2" COEFFS 0 41.6666666667 166 0 0 1 /end COMPU_METHOD
/begin COMPU_METHOD SAB_A_24MPSS1000_S2_S3 "int = ((phys * 1000) / 24) - (0) m/s^2" RAT_FUNC "%4.3" "m/s^2" COEFFS 0 41.6666666667 0 0 0 1 /end COMPU_METHOD
/begin COMPU_METHOD SAB_A_2MPSS100_4096M100_S2_S3 "int = ((phys * 100) / 2) - (-2048) m/s^2" RAT_FUNC "%4.3" "m/s^2" COEFFS 0 50 2048 0 0 1 /end COMPU_METHOD
/begin COMPU_METHOD SAB_A_478G10000_M512_S2_S3 "int = ((phys * 10000) / 478) - (-512) m/s^2" RAT_FUNC "%4.3" "m/s^2" COEFFS 0 20.9205020921 512 0 0 1 /end COMPU_METHOD
/begin COMPU_METHOD SAB_A_4G1000_131068M1000_S2_S3 "int = ((phys * 1000) / 4) - (-32767) g" RAT_FUNC "%4.3" "g" COEFFS 0 250 32767 0 0 1 /end COMPU_METHOD
/begin COMPU_METHOD SAB_A_981G10000_M127_S2_S3 "int = ((phys * 1.0E6) / 981) - (-1295) g" RAT_FUNC "%7.6" "g" COEFFS 0 1019.36799185 1295 0 0 1 /end COMPU_METHOD
/begin COMPU_METHOD SAB_A_G100_127M100_S2_S3 "int = ((phys * 100) / 1) - (-127) g" RAT_FUNC "%4.3" "g" COEFFS 0 100 127 0 0 1 /end COMPU_METHOD
/begin COMPU_METHOD SAB_A_G100_18M10_S2_S3 "int = ((phys * 100) / 1) - (-180) g" RAT_FUNC "%4.3" "g" COEFFS 0 100 180 0 0 1 /end COMPU_METHOD
/begin COMPU_METHOD SAB_A_G100_23M100_S2_S3 "int = ((phys * 100) / 1) - (-23) g" RAT_FUNC "%4.3" "g" COEFFS 0 100 23 0 0 1 /end COMPU_METHOD
/begin COMPU_METHOD SAB_A_G100_M23_S2_S3 "int = ((phys * 100) / 1) - (-23) g" RAT_FUNC "%4.3" "g" COEFFS 0 100 23 0 0 1 /end COMPU_METHOD
/begin COMPU_METHOD SAB_A_G100_M30_S2_S3 "int = ((phys * 100) / 1) - (-30) g" RAT_FUNC "%4.3" "g" COEFFS 0 100 30 0 0 1 /end COMPU_METHOD
/begin COMPU_METHOD SAB_A_MPSS10_M11_S2_S3 "int = ((phys * 10) / 1) - (-11) m/s^2" RAT_FUNC "%4.3" "m/s^2" COEFFS 0 10 11 0 0 1 /end COMPU_METHOD
/begin COMPU_METHOD SAB_A_MPSS10_M150_S2_S3 "int = ((phys * 10) / 1) - (-15) m/s^2" RAT_FUNC "%4.3" "m/s^2" COEFFS 0 10 15 0 0 1 /end COMPU_METHOD
/begin COMPU_METHOD SAB_A_MPSS10_S2_S3 "int = ((phys * 10) / 1) - (0) m/s^2" RAT_FUNC "%4.3" "m/s^2" COEFFS 0 10 0 0 0 1 /end COMPU_METHOD
/begin COMPU_METHOD SAB_A_MPSS128_S2_S3 "int = ((phys * 128) / 1) - (0) m/s^2" RAT_FUNC "%4.3" "m/s^2" COEFFS 0 128 0 0 0 1 /end COMPU_METHOD
/begin COMPU_METHOD SAB_A_MPSS32_M126_S2_S3 "int = ((phys * 32) / 1) - (-126) m/s^2" RAT_FUNC "%4.3" "m/s^2" COEFFS 0 32 126 0 0 1 /end COMPU_METHOD
/begin COMPU_METHOD SAB_A_MPSS32_M16_S2_S3 "int = ((phys * 32) / 1) - (-512) m/s^2" RAT_FUNC "%4.3" "m/s^2" COEFFS 0 32 512 0 0 1 /end COMPU_METHOD
/begin COMPU_METHOD SAB_A_MPSS32_M512_S2_S3 "int = ((phys * 32) / 1) - (-512) m/s^2" RAT_FUNC "%4.3" "m/s^2" COEFFS 0 32 512 0 0 1 /end COMPU_METHOD
/begin COMPU_METHOD SAB_A_MPSS40_S2_S3 "int = ((phys * 40) / 1) - (0) m/s^2" RAT_FUNC "%4.3" "m/s^2" COEFFS 0 40 0 0 0 1 /end COMPU_METHOD
/begin COMPU_METHOD SAB_A_MPSS50_65536M100_S2_S3 "int = ((phys * 50) / 1) - (-32768) m/s^2" RAT_FUNC "%4.3" "m/s^2" COEFFS 0 50 32768 0 0 1 /end COMPU_METHOD
/begin COMPU_METHOD SAB_A_MPSS800_1024M100_S2_S3 "int = ((phys * 100) / 8) - (-128) m/s^2" RAT_FUNC "%4.3" "m/s^2" COEFFS 0 12.5 128 0 0 1 /end COMPU_METHOD
/begin COMPU_METHOD SAB_A_MPSS_S2_S3 "int = ((phys * 1) / 1) - (0) m/s^2" RAT_FUNC "%1.0" "m/s^2" COEFFS 0 1 0 0 0 1 /end COMPU_METHOD
/begin COMPU_METHOD SAB_C_1CEL_M50_S2_S3 "int = ((phys * 1) / 1) - (-50) Grad Celsius" RAT_FUNC "%1.0" "Grad Celsius" COEFFS 0 1 50 0 0 1 /end COMPU_METHOD
/begin COMPU_METHOD SAB_C_1CEL_M55_S2_S3 "int = ((phys * 1) / 1) - (-55) Grad Celsius" RAT_FUNC "%1.0" "Grad Celsius" COEFFS 0 1 55 0 0 1 /end COMPU_METHOD
/begin COMPU_METHOD SAB_C_1CEL_M58_S2_S3 "int = ((phys * 1) / 1) - (-58) Grad Celsius" RAT_FUNC "%1.0" "Grad Celsius" COEFFS 0 1 58 0 0 1 /end COMPU_METHOD
/begin COMPU_METHOD SAB_C_1CEL_M60_S2_S3 "int = ((phys * 1) / 1) - (-60) Grad Celsius" RAT_FUNC "%1.0" "Grad Celsius" COEFFS 0 1 60 0 0 1 /end COMPU_METHOD
/begin COMPU_METHOD SAB_C_1K1000_S2_S3 "int = ((phys * 1000) / 1) - (0) Kelvin" RAT_FUNC "%4.3" "Kelvin" COEFFS 0 1000 0 0 0 1 /end COMPU_METHOD
/begin COMPU_METHOD SAB_C_1K100_S2_S3 "int = ((phys * 100) / 1) - (0) Kelvin" RAT_FUNC "%4.3" "Kelvin" COEFFS 0 100 0 0 0 1 /end COMPU_METHOD
/begin COMPU_METHOD SAB_C_1K_S2_S3 "int = ((phys * 1) / 1) - (0) Kelvin" RAT_FUNC "%1.0" "Kelvin" COEFFS 0 1 0 0 0 1 /end COMPU_METHOD
/begin COMPU_METHOD SAB_C_3CEL4_S2_S3 "int = ((phys * 4) / 3) - (0) Grad Celsius" RAT_FUNC "%4.3" "Grad Celsius" COEFFS 0 1.33333333333 0 0 0 1 /end COMPU_METHOD
/begin COMPU_METHOD SAB_C_3CEL_M40_S2_S3 "int = ((phys * 1) / 3) - (-13.3333333333333) Grad Celsius" RAT_FUNC "%4.3" "Grad Celsius" COEFFS 0 0.333333333333 13.3333333333 0 0 1 /end COMPU_METHOD
/begin COMPU_METHOD SAB_C_75CEL100_M48_S2_S3 "int = ((phys * 100) / 75) - (-64) Grad Celsius" RAT_FUNC "%4.3" "Grad Celsius" COEFFS 0 1.33333333333 64 0 0 1 /end COMPU_METHOD
/begin COMPU_METHOD SBW_CGT40_M_S1_S3 "int = ((phys * 1) / 1) - (-40) Grad Celsius" RAT_FUNC "%1.0" "Grad Celsius" COEFFS 0 1 40 0 0 1 /end COMPU_METHOD
/begin COMPU_METHOD SBW_STANDARD_S1_S3 "int = ((phys * 1) / 1) - (0) -" RAT_FUNC "%1.0" "-" COEFFS 0 1 0 0 0 1 /end COMPU_METHOD
/begin COMPU_METHOD UMR_MSEC__10_1_0_S5_S3 "int = ((phys * 1) / 10) - (0) [ms]" RAT_FUNC "%1.0" "[ms]" COEFFS 0 0.1 0 0 0 1 /end COMPU_METHOD
/begin AXIS_PTS SSTSKL_WL1 "" 0x1DD310 W_DKKD _REC_A2AXS_31_u2_S2 120 _CNV_R_R_Umr_10_zu__9_CM_S2 15 0 120 DEPOSIT ABSOLUTE FORMAT "%3.1" /end AXIS_PTS
/begin AXIS_PTS SSTSKL_WL2 "" 0x1DD330 W_DKKD _REC_A2AXS_31_u2_S2 120 _CNV_R_R_Umr_10_zu__9_CM_S2 15 0 120 DEPOSIT ABSOLUTE FORMAT "%3.1" /end AXIS_PTS
/begin AXIS_PTS SSTSKL_XE "" 0x1DD350 W_DKKD _REC_A2AXS_31_u2_S2 120 _CNV_R_R_Umr_10_zu__9_CM_S2 15 0 120 DEPOSIT ABSOLUTE FORMAT "%3.1" /end AXIS_PTS
/begin AXIS_PTS SSTSKL_XS "" 0x1DD370 W_DKKD _REC_A2AXS_31_u2_S2 120 _CNV_R_R_Umr_10_zu__9_CM_S2 15 0 120 DEPOSIT ABSOLUTE FORMAT "%3.1" /end AXIS_PTS
/begin AXIS_PTS SSTTAB_MRADOPTZ_GANG1 "" 0x1DDAEC N_AB _REC_A2AXS_31_u2_S2 65535 _CNV_R_R_Umr_1_zu_1_3_CM_S2 15 0 65535 DEPOSIT ABSOLUTE /end AXIS_PTS
/begin AXIS_PTS SSTTAB_MRADOPTZ_GANG2 "" 0x1DDB0C N_AB _REC_A2AXS_31_u2_S2 65535 _CNV_R_R_Umr_1_zu_1_3_CM_S2 15 0 65535 DEPOSIT ABSOLUTE /end AXIS_PTS
/begin AXIS_PTS SSTTAB_MRADOPTZ_GANG3 "" 0x1DDB2C N_AB _REC_A2AXS_31_u2_S2 65535 _CNV_R_R_Umr_1_zu_1_3_CM_S2 15 0 65535 DEPOSIT ABSOLUTE /end AXIS_PTS
/begin AXIS_PTS SSTTAB_MRADOPTZ_GANG4 "" 0x1DDB4C N_AB _REC_A2AXS_31_u2_S2 65535 _CNV_R_R_Umr_1_zu_1_3_CM_S2 15 0 65535 DEPOSIT ABSOLUTE /end AXIS_PTS
/begin AXIS_PTS SSTTAB_MRADOPTZ_GANG5 "" 0x1DDB6C N_AB _REC_A2AXS_31_u2_S2 65535 _CNV_R_R_Umr_1_zu_1_3_CM_S2 15 0 65535 DEPOSIT ABSOLUTE /end AXIS_PTS
/begin AXIS_PTS SSTTAB_MRADOPTZ_GANG6 "" 0x1DDB8C N_AB _REC_A2AXS_31_u2_S2 65535 _CNV_R_R_Umr_1_zu_1_3_CM_S2 15 0 65535 DEPOSIT ABSOLUTE /end AXIS_PTS
/begin AXIS_PTS SSTTAB_MRADOPTZ_GANG7 "" 0x1DDBAC N_AB _REC_A2AXS_31_u2_S2 65535 _CNV_R_R_Umr_1_zu_1_3_CM_S2 15 0 65535 DEPOSIT ABSOLUTE /end AXIS_PTS
/begin AXIS_PTS SSTTAB_MRADOPTZ_GANG8 "" 0x1DDBCC N_AB _REC_A2AXS_31_u2_S2 65535 _CNV_R_R_Umr_1_zu_1_3_CM_S2 15 0 65535 DEPOSIT ABSOLUTE /end AXIS_PTS
/begin AXIS_PTS SSTTAB_MRADOPTZ_GANG9 "" 0x1DDBEC N_AB _REC_A2AXS_31_u2_S2 65535 _CNV_R_R_Umr_1_zu_1_3_CM_S2 15 0 65535 DEPOSIT ABSOLUTE /end AXIS_PTS
/begin AXIS_PTS SSTW_DKKD_BPL5 "" 0x1E3578 N_AB _REC_S2AXS_51_u2_S2 20000 _CNV_R_R_Umr_1_zu_1_3_CM_S2 10 0 20000 DEPOSIT ABSOLUTE FORMAT "%2.0" /end AXIS_PTS
/begin AXIS_PTS SSTW_DKKD_BPLOTHER "" 0x1E358E N_AB _REC_S2AXS_51_u2_S2 20000 _CNV_R_R_Umr_1_zu_1_3_CM_S2 6 0 20000 DEPOSIT ABSOLUTE FORMAT "%2.0" /end AXIS_PTS
/begin MEASUREMENT T_VORWAHL_MINUS "" UWORD _CNV_R_R_Umr_1_zu_1_6_CM_S2 1 0 0 65535 ECU_ADDRESS 0xFFF8E3F0 FORMAT "%2.0" /end MEASUREMENT
/begin MEASUREMENT T_VORWAHL_PLUS "" UWORD _CNV_R_R_Umr_1_zu_1_6_CM_S2 1 0 0 65535 ECU_ADDRESS 0xFFF8E3F2 FORMAT "%2.0" /end MEASUREMENT
/begin MEASUREMENT T_V_RSZBAB "" SLONG _CNV_R_R_Umr_1_zu_1_6_CM_S2 1 0 -2147483647 2147483647 ECU_ADDRESS 0xFFF8F2A8 FORMAT "%2.0" /end MEASUREMENT
/begin MEASUREMENT T_WAIT_HSURENL "" ULONG _CNV_R_R_Umr_1_zu_1_6_CM_S2 1 0 0 25000 ECU_ADDRESS 0xFFF8F058 FORMAT "%2.0" /end MEASUREMENT
/begin MEASUREMENT T_WAIT_RS "" SLONG _CNV_R_R_Umr_1_zu_1_6_CM_S2 1 0 -2147483647 2147483647 ECU_ADDRESS 0xFFF8F128 FORMAT "%2.0" /end MEASUREMENT
/begin MEASUREMENT T_WARTEZEIT_PHASE3_DYNDZM "" ULONG _CNV_R_R_Umr_1_zu_1_6_CM_S2 1 0 0 4294967295 ECU_ADDRESS 0xFFF8EEA0 FORMAT "%2.0" /end MEASUREMENT
/begin MEASUREMENT T_WDKKD_SPA "" UWORD _CNV_R_R_Umr_1_zu_1_6_CM_S2 1 0 0 65535 ECU_ADDRESS 0xFFF8E7D2 FORMAT "%2.0" /end MEASUREMENT
/begin MEASUREMENT T_WL "" SLONG _CNV_R_R_Umr_1_zu_1_6_CM_S2 1 0 -2147483647 2147483647 ECU_ADDRESS 0xFFF8F1DC FORMAT "%2.0" /end MEASUREMENT
/begin MEASUREMENT T_WL2 "" ULONG _CNV_R_R_Umr_1_zu_1_6_CM_S2 1 0 0 4294967295 ECU_ADDRESS 0xFFF8F1D0 FORMAT "%2.0" /end MEASUREMENT
/begin MEASUREMENT T_WLPRED "" ULONG _CNV_R_R_Umr_1_zu_1_6_CM_S2 1 0 0 4294967295 ECU_ADDRESS 0xFFF8F1D4 FORMAT "%2.0" /end MEASUREMENT
/begin MEASUREMENT T_ZWANG_HSRS_STPTRsport "" ULONG _CNV_R_R_Umr_1_zu_1_6_CM_S2 1 0 0 2147483647 ECU_ADDRESS 0xFFF8EDF0 FORMAT "%2.0" /end MEASUREMENT
/begin MEASUREMENT TesterAccess.DiagTestLever "DiagTester value current Lever: 0=Mid 5=D 6=N 7=R 21=V 22=VV 23=H 23=HH 31=SD 32=M- 33=M+ 128=undef" UBYTE SBW_STANDARD_S1_S3 1 100 0 255 ECU_ADDRESS 0xFFF8D690 DISPLAY_IDENTIFIER DiagTestLever.TesterAccess /end MEASUREMENT
/begin MEASUREMENT TesterAccess.DiagTestSBW "DiagTester value current SBW: b15=free b14=Brake b13=Door b12=Belt b11=Seat b10=Key b9=Ign b8=HoldN b7 to 4=PosDrvReq b3=DiagP b2=DiagN b1=AutoP b0=AutoN" UWORD SBW_STANDARD_S1_S3 1 100 0 65535 ECU_ADDRESS 0xFFF8D692 DISPLAY_IDENTIFIER DiagTestSBW.TesterAccess /end MEASUREMENT
/begin MEASUREMENT TesterAccess.DiagTestSteptronic "DiagTester value current steptronic: b7=RL b6=n.c. b5=P b4=S b3=Tip2- b2=Tip2+ b1=Tip1- b0=Tip1+" UBYTE SBW_STANDARD_S1_S3 1 100 0 255 ECU_ADDRESS 0xFFF8D68F DISPLAY_IDENTIFIER DiagTestSteptronic.TesterAccess /end MEASUREMENT
/begin MEASUREMENT TesterAccess.DummyUI8 "Dummy-Groesse fuer DAMOS" UBYTE SBW_STANDARD_S1_S3 1 100 0 255 ECU_ADDRESS 0xFFF8D696 DISPLAY_IDENTIFIER DummyUI8.TesterAccess /end MEASUREMENT
/begin MEASUREMENT TesterAccess.DummyUI8_SBW_CGT40_M "Dummy-Groesse fuer DAMOS" UBYTE SBW_CGT40_M_S1_S3 1 100 -40 215 ECU_ADDRESS 0xFFF8D697 DISPLAY_IDENTIFIER DummyUI8_SBW_CGT40_M.TesterAccess /end MEASUREMENT
/begin MEASUREMENT TesterAccess.Faulttype "Faulttype of an Faultcode" UBYTE SBW_STANDARD_S1_S3 1 100 0 255 ECU_ADDRESS 0xFFF8D695 DISPLAY_IDENTIFIER Faulttype.TesterAccess /end MEASUREMENT
/begin MEASUREMENT TesterAccess.st_VehicleAutoP "DiagTester value current SBW: b4=Seat b3=Door b2=Belt b1=Brake b0=AcceleratorPedal" UBYTE SBW_STANDARD_S1_S3 1 100 0 1 ECU_ADDRESS 0xFFF8D694 DISPLAY_IDENTIFIER st_VehicleAutoP.TesterAccess /end MEASUREMENT
/begin MEASUREMENT Ueberwachungen.Parksperrenmagnet.TmaxPmueb "EepromStd[3424 ... 3427]: Zeitdauer nach der eine Ueberpruefung des Parksperrenmagnet erfolgen soll [(x=1/UMR___1_1_0)]" ULONG UMR_MSEC__10_1_0_S5_S3 1 100 0 42949672950 ECU_ADDRESS 0xFFF81D98 DISPLAY_IDENTIFIER TmaxPmueb.Parksperrenmagnet.Ueberwachungen /end MEASUREMENT
/begin MEASUREMENT VALID_GEARS_DBM "" SWORD _CNV_S_4_Enum_EVALI_262_CM_S2 1 0 0 10 ECU_ADDRESS 0xFFF8E326 MATRIX_DIM 9 1 1 /end MEASUREMENT
/begin MEASUREMENT VALID_GEARS_ZKA "" SWORD _CNV_S_5_Enum_EVALI_187_CM_S2 1 0 0 30 ECU_ADDRESS 0xFFF8E81C MATRIX_DIM 9 1 1 /end MEASUREMENT
/begin MEASUREMENT VM_MOT_HKOR "" UWORD _CNV_R_R_Umr_1_zu_1_30_CM_S2 1 0 0 200 ECU_ADDRESS 0xFFF8E602 FORMAT "%2.0" /end MEASUREMENT
/begin MEASUREMENT VM_MOT_HKORROH "" UWORD _CNV_R_R_Umr_1_zu_1_30_CM_S2 1 0 0 200 ECU_ADDRESS 0xFFF8E604 FORMAT "%2.0" /end MEASUREMENT
/begin MEASUREMENT VM_MOT_HKOR_FILTREST "" UWORD _CNV_R_R_Umr_1_zu_1_30_CM_S2 1 0 0 65535 ECU_ADDRESS 0xFFF8E606 FORMAT "%2.0" /end MEASUREMENT
/begin MEASUREMENT VM_MOT_ISTFW "" UWORD _CNV_R_R_Umr_100_zu_88_CM_S2 1 0 0 3 ECU_ADDRESS 0xFFF8E608 FORMAT "%4.2" /end MEASUREMENT
/begin MEASUREMENT VM_MOT_ISTFW_FILT "" UWORD _CNV_R_R_Umr_100_zu_88_CM_S2 1 0 0 3 ECU_ADDRESS 0xFFF8E60A FORMAT "%4.2" /end MEASUREMENT
/begin MEASUREMENT VM_MOT_ISTFW_FILTREST "" UWORD _CNV_R_R_Umr_1_zu_1_2_CM_S2 1 0 0 65535 ECU_ADDRESS 0xFFF8E60C FORMAT "%2.0" /end MEASUREMENT
/begin MEASUREMENT VM_MOT_ISTFW_KOR "" UWORD _CNV_R_R_Umr_100_zu_88_CM_S2 1 0 0 2 ECU_ADDRESS 0xFFF8E60E FORMAT "%4.2" /end MEASUREMENT
/begin MEASUREMENT V_FZG "" UWORD _CNV_R_R_Umr_1_zu_1_8_CM_S2 1 0 0 400 ECU_ADDRESS 0xFFF8E552 FORMAT "%2.0" /end MEASUREMENT
/begin MEASUREMENT V_FZG_ALTMODAFB "" UWORD _CNV_R_R_Umr_1_zu_1_8_CM_S2 1 0 0 400 ECU_ADDRESS 0xFFF8E726 FORMAT "%2.0" /end MEASUREMENT
/begin MEASUREMENT V_FZG_BER "" UWORD _CNV_R_R_Umr_1_zu_1_8_CM_S2 1 0 0 400 ECU_ADDRESS 0xFFF8E554 FORMAT "%2.0" /end MEASUREMENT
/begin MEASUREMENT V_FZG_BRANF "" UWORD _CNV_R_R_Umr_1_zu_1_8_CM_S2 1 0 0 400 ECU_ADDRESS 0xFFF8E862 FORMAT "%2.0" /end MEASUREMENT
/begin MEASUREMENT V_FZG_COG "" UWORD _CNV_R_R_Umr_64_zu__82_CM_S2 1 0 0 350 ECU_ADDRESS 0xFFF8E6F4 FORMAT "%3.1" /end MEASUREMENT
/begin MEASUREMENT V_FZG_COG_ROH "" UWORD _CNV_R_R_Umr_1_zu_1_2_CM_S2 1 0 0 22400 ECU_ADDRESS 0xFFF8E3BA /end MEASUREMENT
/begin MEASUREMENT V_FZG_FILT "" UWORD _CNV_R_R_Umr_1_zu_1_8_CM_S2 1 0 0 400 ECU_ADDRESS 0xFFF8E556 FORMAT "%2.0" /end MEASUREMENT
/begin MEASUREMENT V_FZG_FILTREST "" UWORD _CNV_R_R_Umr_1_zu_1_8_CM_S2 1 0 0 65535 ECU_ADDRESS 0xFFF8E558 FORMAT "%2.0" /end MEASUREMENT
/begin MEASUREMENT V_FZG_HSURESCHLUPF "" UWORD _CNV_R_R_Umr_1_zu_1_8_CM_S2 1 0 0 400 ECU_ADDRESS 0xFFF8E66A FORMAT "%2.0" /end MEASUREMENT
/begin MEASUREMENT V_FZG_HSURESCHLUPF_OFFSET "" UWORD _CNV_R_R_Umr_1_zu_1_8_CM_S2 1 0 0 50 ECU_ADDRESS 0xFFF8E66C FORMAT "%2.0" /end MEASUREMENT
/begin MEASUREMENT V_FZG_MSBUFFER "" UWORD _CNV_R_R_Umr_10_zu__206_CM_S2 1 0 0 300 ECU_ADDRESS 0xFFF8EE28 FORMAT "%3.1" MATRIX_DIM 6 1 1 /end MEASUREMENT
/begin MEASUREMENT V_FZG_MSMUELOWBUFFER "" UWORD _CNV_R_R_Umr_10_zu__206_CM_S2 1 0 0 300 ECU_ADDRESS 0xFFF8EE34 FORMAT "%3.1" MATRIX_DIM 6 1 1 /end MEASUREMENT
/begin MEASUREMENT V_FZG_OHNEABS "" UWORD _CNV_R_R_Umr_1_zu_1_8_CM_S2 1 0 0 400 ECU_ADDRESS 0xFFF8E55A FORMAT "%2.0" /end MEASUREMENT
/begin MEASUREMENT V_FZG_OHNEABSFILT "" UWORD _CNV_R_R_Umr_1_zu_1_8_CM_S2 1 0 0 400 ECU_ADDRESS 0xFFF8E55C FORMAT "%2.0" /end MEASUREMENT
/begin MEASUREMENT V_FZG_OHNEABSFILTREST "" UWORD _CNV_R_R_Umr_1_zu_1_8_CM_S2 1 0 0 65535 ECU_ADDRESS 0xFFF8E55E FORMAT "%2.0" /end MEASUREMENT
/begin MEASUREMENT V_FZG_STABKRI_START_ZKA "" SLONG _CNV_R_R_Umr_1_zu_1_8_CM_S2 1 0 -2147483648 2147483647 ECU_ADDRESS 0xFFF8F27C FORMAT "%2.0" /end MEASUREMENT
/begin MEASUREMENT V_RAD_FAKT "" UWORD _CNV_R_R_Umr_1_zu_1_2_CM_S2 1 0 0 65535 ECU_ADDRESS 0xFFF8E560 FORMAT "%2.0" /end MEASUREMENT
/begin MEASUREMENT V_RAD_HL "" UWORD _CNV_R_R_Umr_16_zu__141_CM_S2 1 0 0 400 ECU_ADDRESS 0xFFF8E6F6 FORMAT "%4.2" /end MEASUREMENT
/begin MEASUREMENT V_RAD_HLRTKOR "" UWORD _CNV_R_R_Umr_16_zu__141_CM_S2 1 0 0 400 ECU_ADDRESS 0xFFF8E562 FORMAT "%4.2" /end MEASUREMENT
/begin MEASUREMENT V_RAD_HLRTKORBUFFER "" UWORD _CNV_R_R_Umr_16_zu__141_CM_S2 1 0 0 400 ECU_ADDRESS 0xFFF8EEE4 FORMAT "%4.2" MATRIX_DIM 10 1 1 /end MEASUREMENT
/begin MEASUREMENT V_RAD_HLRTKORMAX "" UWORD _CNV_R_R_Umr_16_zu__141_CM_S2 1 0 0 400 ECU_ADDRESS 0xFFF8E564 FORMAT "%4.2" /end MEASUREMENT
/begin MEASUREMENT V_RAD_HLRTKORMIN "" UWORD _CNV_R_R_Umr_16_zu__141_CM_S2 1 0 0 400 ECU_ADDRESS 0xFFF8E566 FORMAT "%4.2" /end MEASUREMENT
/begin MEASUREMENT V_RAD_HLRTKORMIT "" UWORD _CNV_R_R_Umr_16_zu__141_CM_S2 1 0 0 400 ECU_ADDRESS 0xFFF8E568 FORMAT "%4.2" /end MEASUREMENT
/begin MEASUREMENT V_RAD_HL_ROH "" UWORD _CNV_R_R_Umr_1_zu_1_2_CM_S2 1 0 0 65535 ECU_ADDRESS 0xFFF8E3BC /end MEASUREMENT
/begin MEASUREMENT V_RAD_HR "" UWORD _CNV_R_R_Umr_16_zu__141_CM_S2 1 0 0 400 ECU_ADDRESS 0xFFF8E6F8 FORMAT "%4.2" /end MEASUREMENT
/begin MEASUREMENT V_RAD_HRRTKOR "" UWORD _CNV_R_R_Umr_16_zu__141_CM_S2 1 0 0 400 ECU_ADDRESS 0xFFF8E56A FORMAT "%4.2" /end MEASUREMENT
/begin MEASUREMENT V_RAD_HRRTKORBUFFER "" UWORD _CNV_R_R_Umr_16_zu__141_CM_S2 1 0 0 400 ECU_ADDRESS 0xFFF8EEF8 FORMAT "%4.2" MATRIX_DIM 10 1 1 /end MEASUREMENT
/begin MEASUREMENT V_RAD_HRRTKORMAX "" UWORD _CNV_R_R_Umr_16_zu__141_CM_S2 1 0 0 400 ECU_ADDRESS 0xFFF8E56C FORMAT "%4.2" /end MEASUREMENT
/begin MEASUREMENT V_RAD_HRRTKORMIN "" UWORD _CNV_R_R_Umr_16_zu__141_CM_S2 1 0 0 400 ECU_ADDRESS 0xFFF8E56E FORMAT "%4.2" /end MEASUREMENT
/begin MEASUREMENT V_RAD_HRRTKORMIT "" UWORD _CNV_R_R_Umr_16_zu__141_CM_S2 1 0 0 400 ECU_ADDRESS 0xFFF8E570 FORMAT "%4.2" /end MEASUREMENT
/begin MEASUREMENT V_RAD_HR_ROH "" UWORD _CNV_R_R_Umr_1_zu_1_2_CM_S2 1 0 0 65535 ECU_ADDRESS 0xFFF8E3BE /end MEASUREMENT
/begin MEASUREMENT V_RAD_MAXMAX "" UWORD _CNV_R_R_Umr_16_zu__141_CM_S2 1 0 0 400 ECU_ADDRESS 0xFFF8E572 FORMAT "%4.2" /end MEASUREMENT
/begin MEASUREMENT V_RAD_MIN "" UWORD _CNV_R_R_Umr_16_zu__141_CM_S2 1 0 0 400 ECU_ADDRESS 0xFFF8E574 FORMAT "%4.2" /end MEASUREMENT
/begin MEASUREMENT V_RAD_OHNEABS "" UWORD _CNV_R_R_Umr_16_zu__141_CM_S2 1 0 0 400 ECU_ADDRESS 0xFFF8E576 FORMAT "%4.2" /end MEASUREMENT
/begin MEASUREMENT V_RAD_OHNEABSFILT "" UWORD _CNV_R_R_Umr_16_zu__141_CM_S2 1 0 0 400 ECU_ADDRESS 0xFFF8E578 FORMAT "%4.2" /end MEASUREMENT
/begin MEASUREMENT V_RAD_OHNEABSFILTREST "" UWORD _CNV_R_R_Umr_16_zu__141_CM_S2 1 0 0 4095.9375 ECU_ADDRESS 0xFFF8E57A FORMAT "%4.2" /end MEASUREMENT
/begin MEASUREMENT V_RAD_VA2FILT "" UWORD _CNV_R_R_Umr_16_zu__141_CM_S2 1 0 0 400 ECU_ADDRESS 0xFFF8E57C FORMAT "%4.2" /end MEASUREMENT
/begin MEASUREMENT V_RAD_VA2FILTREST "" UWORD _CNV_R_R_Umr_16_zu__141_CM_S2 1 0 0 4095.9375 ECU_ADDRESS 0xFFF8E57E FORMAT "%4.2" /end MEASUREMENT
/begin MEASUREMENT V_RAD_VABUFFER "" UWORD _CNV_R_R_Umr_1_zu_1_8_CM_S2 1 0 0 400 ECU_ADDRESS 0xFFF8EF0C FORMAT "%2.0" MATRIX_DIM 4 1 1 /end MEASUREMENT
/begin MEASUREMENT V_RAD_VAFILT "" UWORD _CNV_R_R_Umr_16_zu__141_CM_S2 1 0 0 400 ECU_ADDRESS 0xFFF8E580 FORMAT "%4.2" /end MEASUREMENT
/begin MEASUREMENT V_RAD_VL "" UWORD _CNV_R_R_Umr_16_zu__141_CM_S2 1 0 0 400 ECU_ADDRESS 0xFFF8E6FA FORMAT "%4.2" /end MEASUREMENT
/begin MEASUREMENT V_RAD_VLRTKOR "" UWORD _CNV_R_R_Umr_16_zu__141_CM_S2 1 0 0 400 ECU_ADDRESS 0xFFF8E582 FORMAT "%4.2" /end MEASUREMENT
/begin MEASUREMENT V_RAD_VLRTKORALT "" UWORD _CNV_R_R_Umr_16_zu__141_CM_S2 1 0 0 400 ECU_ADDRESS 0xFFF8E584 FORMAT "%4.2" /end MEASUREMENT
/begin MEASUREMENT V_RAD_VLRTKORBUFFER "" UWORD _CNV_R_R_Umr_16_zu__141_CM_S2 1 0 0 400 ECU_ADDRESS 0xFFF8EF14 FORMAT "%4.2" MATRIX_DIM 10 1 1 /end MEASUREMENT
/begin MEASUREMENT V_RAD_VLRTKORERSATZ "" UWORD _CNV_R_R_Umr_16_zu__141_CM_S2 1 0 0 400 ECU_ADDRESS 0xFFF8E586 FORMAT "%4.2" /end MEASUREMENT
/begin MEASUREMENT V_RAD_VLRTKORMAX "" UWORD _CNV_R_R_Umr_16_zu__141_CM_S2 1 0 0 400 ECU_ADDRESS 0xFFF8E588 FORMAT "%4.2" /end MEASUREMENT
/begin MEASUREMENT V_RAD_VLRTKORMIN "" UWORD _CNV_R_R_Umr_16_zu__141_CM_S2 1 0 0 400 ECU_ADDRESS 0xFFF8E58A FORMAT "%4.2" /end MEASUREMENT
/begin MEASUREMENT V_RAD_VLRTKORMIT "" UWORD _CNV_R_R_Umr_16_zu__141_CM_S2 1 0 0 400 ECU_ADDRESS 0xFFF8E58C FORMAT "%4.2" /end MEASUREMENT
/begin MEASUREMENT V_RAD_VLRTKORMSBUFFER "" UWORD _CNV_R_R_Umr_100_zu_207_CM_S2 1 0 0 120 ECU_ADDRESS 0xFFF8EF28 FORMAT "%4.2" MATRIX_DIM 2 1 1 /end MEASUREMENT
/begin MEASUREMENT V_RAD_VLRTKORMSERSATZ "" UWORD _CNV_R_R_Umr_100_zu_207_CM_S2 1 0 0 120 ECU_ADDRESS 0xFFF8E58E FORMAT "%4.2" /end MEASUREMENT
/begin MEASUREMENT V_RAD_VL_ROH "" UWORD _CNV_R_R_Umr_1_zu_1_2_CM_S2 1 0 0 65535 ECU_ADDRESS 0xFFF8E3C0 /end MEASUREMENT
/begin MEASUREMENT V_RAD_VR "" UWORD _CNV_R_R_Umr_16_zu__141_CM_S2 1 0 0 400 ECU_ADDRESS 0xFFF8E6FC FORMAT "%4.2" /end MEASUREMENT
/begin MEASUREMENT V_RAD_VRRTKOR "" UWORD _CNV_R_R_Umr_16_zu__141_CM_S2 1 0 0 400 ECU_ADDRESS 0xFFF8E590 FORMAT "%4.2" /end MEASUREMENT
/begin MEASUREMENT V_RAD_VRRTKORALT "" UWORD _CNV_R_R_Umr_16_zu__141_CM_S2 1 0 0 400 ECU_ADDRESS 0xFFF8E592 FORMAT "%4.2" /end MEASUREMENT
/begin MEASUREMENT V_RAD_VRRTKORBUFFER "" UWORD _CNV_R_R_Umr_16_zu__141_CM_S2 1 0 0 400 ECU_ADDRESS 0xFFF8EF2C FORMAT "%4.2" MATRIX_DIM 10 1 1 /end MEASUREMENT
/begin MEASUREMENT V_RAD_VRRTKORERSATZ "" UWORD _CNV_R_R_Umr_16_zu__141_CM_S2 1 0 0 400 ECU_ADDRESS 0xFFF8E594 FORMAT "%4.2" /end MEASUREMENT
/begin MEASUREMENT V_RAD_VRRTKORMAX "" UWORD _CNV_R_R_Umr_16_zu__141_CM_S2 1 0 0 400 ECU_ADDRESS 0xFFF8E596 FORMAT "%4.2" /end MEASUREMENT
/begin MEASUREMENT V_RAD_VRRTKORMIN "" UWORD _CNV_R_R_Umr_16_zu__141_CM_S2 1 0 0 400 ECU_ADDRESS 0xFFF8E598 FORMAT "%4.2" /end MEASUREMENT
/begin MEASUREMENT V_RAD_VRRTKORMIT "" UWORD _CNV_R_R_Umr_16_zu__141_CM_S2 1 0 0 400 ECU_ADDRESS 0xFFF8E59A FORMAT "%4.2" /end MEASUREMENT
/begin MEASUREMENT V_RAD_VRRTKORMSBUFFER "" UWORD _CNV_R_R_Umr_100_zu_207_CM_S2 1 0 0 120 ECU_ADDRESS 0xFFF8EF40 FORMAT "%4.2" MATRIX_DIM 2 1 1 /end MEASUREMENT
/begin MEASUREMENT V_RAD_VRRTKORMSERSATZ "" UWORD _CNV_R_R_Umr_100_zu_207_CM_S2 1 0 0 120 ECU_ADDRESS 0xFFF8E59C FORMAT "%4.2" /end MEASUREMENT
/begin MEASUREMENT V_RAD_VR_ROH "" UWORD _CNV_R_R_Umr_1_zu_1_2_CM_S2 1 0 0 65535 ECU_ADDRESS 0xFFF8E3C2 /end MEASUREMENT
/begin CHARACTERISTIC WL112 "" CURVE 0x1E0E1E _REC_A1CUR_1_u2_u2_S2 15000 _CNV_R_R_Umr_1_zu_1_3_CM_S2 0 15000
 /begin AXIS_DESCR COM_AXIS W_DKKD _CNV_R_R_Umr_10_zu__9_CM_S2 15 0 120 DEPOSIT ABSOLUTE FORMAT "%3.1" AXIS_PTS_REF SSTSKL_WL1 /end AXIS_DESCR
 FORMAT "%2.0" /end CHARACTERISTIC
/begin CHARACTERISTIC WL121 "" CURVE 0x1E0E3C _REC_A1CUR_1_u2_u2_S2 15000 _CNV_R_R_Umr_1_zu_1_3_CM_S2 0 15000
 /begin AXIS_DESCR COM_AXIS W_DKKD _CNV_R_R_Umr_10_zu__9_CM_S2 15 0 120 DEPOSIT ABSOLUTE FORMAT "%3.1" AXIS_PTS_REF SSTSKL_WL1 /end AXIS_DESCR
 FORMAT "%2.0" /end CHARACTERISTIC
/begin CHARACTERISTIC WL123 "" CURVE 0x1E0E5A _REC_A1CUR_1_u2_u2_S2 15000 _CNV_R_R_Umr_1_zu_1_3_CM_S2 0 15000
 /begin AXIS_DESCR COM_AXIS W_DKKD _CNV_R_R_Umr_10_zu__9_CM_S2 15 0 120 DEPOSIT ABSOLUTE FORMAT "%3.1" AXIS_PTS_REF SSTSKL_WL1 /end AXIS_DESCR
 FORMAT "%2.0" /end CHARACTERISTIC
/begin CHARACTERISTIC WL132 "" CURVE 0x1E0E78 _REC_A1CUR_1_u2_u2_S2 15000 _CNV_R_R_Umr_1_zu_1_3_CM_S2 0 15000
 /begin AXIS_DESCR COM_AXIS W_DKKD _CNV_R_R_Umr_10_zu__9_CM_S2 15 0 120 DEPOSIT ABSOLUTE FORMAT "%3.1" AXIS_PTS_REF SSTSKL_WL1 /end AXIS_DESCR
 FORMAT "%2.0" /end CHARACTERISTIC
/begin CHARACTERISTIC WL134 "" CURVE 0x1E0E96 _REC_A1CUR_1_u2_u2_S2 15000 _CNV_R_R_Umr_1_zu_1_3_CM_S2 0 15000
 /begin AXIS_DESCR COM_AXIS W_DKKD _CNV_R_R_Umr_10_zu__9_CM_S2 15 0 120 DEPOSIT ABSOLUTE FORMAT "%3.1" AXIS_PTS_REF SSTSKL_WL1 /end AXIS_DESCR
 FORMAT "%2.0" /end CHARACTERISTIC
/begin CHARACTERISTIC WL143 "" CURVE 0x1E0EB4 _REC_A1CUR_1_u2_u2_S2 15000 _CNV_R_R_Umr_1_zu_1_3_CM_S2 0 15000
 /begin AXIS_DESCR COM_AXIS W_DKKD _CNV_R_R_Umr_10_zu__9_CM_S2 15 0 120 DEPOSIT ABSOLUTE FORMAT "%3.1" AXIS_PTS_REF SSTSKL_WL1 /end AXIS_DESCR
 FORMAT "%2.0" /end CHARACTERISTIC
/begin CHARACTERISTIC WL145 "" CURVE 0x1E0ED2 _REC_A1CUR_1_u2_u2_S2 15000 _CNV_R_R_Umr_1_zu_1_3_CM_S2 0 15000
 /begin AXIS_DESCR COM_AXIS W_DKKD _CNV_R_R_Umr_10_zu__9_CM_S2 15 0 120 DEPOSIT ABSOLUTE FORMAT "%3.1" AXIS_PTS_REF SSTSKL_WL1 /end AXIS_DESCR
 FORMAT "%2.0" /end CHARACTERISTIC
/begin CHARACTERISTIC WL154 "" CURVE 0x1E0EF0 _REC_A1CUR_1_u2_u2_S2 15000 _CNV_R_R_Umr_1_zu_1_3_CM_S2 0 15000
 /begin AXIS_DESCR COM_AXIS W_DKKD _CNV_R_R_Umr_10_zu__9_CM_S2 15 0 120 DEPOSIT ABSOLUTE FORMAT "%3.1" AXIS_PTS_REF SSTSKL_WL1 /end AXIS_DESCR
 FORMAT "%2.0" /end CHARACTERISTIC
/begin CHARACTERISTIC WL156 "" CURVE 0x1E0F0E _REC_A1CUR_1_u2_u2_S2 15000 _CNV_R_R_Umr_1_zu_1_3_CM_S2 0 15000
 /begin AXIS_DESCR COM_AXIS W_DKKD _CNV_R_R_Umr_10_zu__9_CM_S2 15 0 120 DEPOSIT ABSOLUTE FORMAT "%3.1" AXIS_PTS_REF SSTSKL_WL1 /end AXIS_DESCR
 FORMAT "%2.0" /end CHARACTERISTIC
/begin CHARACTERISTIC WL165 "" CURVE 0x1E0F2C _REC_A1CUR_1_u2_u2_S2 15000 _CNV_R_R_Umr_1_zu_1_3_CM_S2 0 15000
 /begin AXIS_DESCR COM_AXIS W_DKKD _CNV_R_R_Umr_10_zu__9_CM_S2 15 0 120 DEPOSIT ABSOLUTE FORMAT "%3.1" AXIS_PTS_REF SSTSKL_WL1 /end AXIS_DESCR
 FORMAT "%2.0" /end CHARACTERISTIC
/begin CHARACTERISTIC WL167 "" CURVE 0x1E16CA _REC_A1CUR_1_u2_u2_S2 15000 _CNV_R_R_Umr_1_zu_1_3_CM_S2 0 15000
 /begin AXIS_DESCR COM_AXIS W_DKKD _CNV_R_R_Umr_10_zu__9_CM_S2 15 0 120 DEPOSIT ABSOLUTE FORMAT "%3.1" AXIS_PTS_REF SSTSKL_WL1 /end AXIS_DESCR
 FORMAT "%2.0" /end CHARACTERISTIC
/begin CHARACTERISTIC WL176 "" CURVE 0x1E16E8 _REC_A1CUR_1_u2_u2_S2 15000 _CNV_R_R_Umr_1_zu_1_3_CM_S2 0 15000
 /begin AXIS_DESCR COM_AXIS W_DKKD _CNV_R_R_Umr_10_zu__9_CM_S2 15 0 120 DEPOSIT ABSOLUTE FORMAT "%3.1" AXIS_PTS_REF SSTSKL_WL1 /end AXIS_DESCR
 FORMAT "%2.0" /end CHARACTERISTIC
/begin CHARACTERISTIC WL178 "" CURVE 0x1E1BB6 _REC_A1CUR_1_u2_u2_S2 15000 _CNV_R_R_Umr_1_zu_1_3_CM_S2 0 15000
 /begin AXIS_DESCR COM_AXIS W_DKKD _CNV_R_R_Umr_10_zu__9_CM_S2 15 0 120 DEPOSIT ABSOLUTE FORMAT "%3.1" AXIS_PTS_REF SSTSKL_WL1 /end AXIS_DESCR
 FORMAT "%2.0" /end CHARACTERISTIC
/begin CHARACTERISTIC WL187 "" CURVE 0x1E1BD4 _REC_A1CUR_1_u2_u2_S2 15000 _CNV_R_R_Umr_1_zu_1_3_CM_S2 0 15000
 /begin AXIS_DESCR COM_AXIS W_DKKD _CNV_R_R_Umr_10_zu__9_CM_S2 15 0 120 DEPOSIT ABSOLUTE FORMAT "%3.1" AXIS_PTS_REF SSTSKL_WL1 /end AXIS_DESCR
 FORMAT "%2.0" /end CHARACTERISTIC
/begin CHARACTERISTIC WL212 "" CURVE 0x1E0F4A _REC_A1CUR_1_u2_u2_S2 15000 _CNV_R_R_Umr_1_zu_1_3_CM_S2 0 15000
 /begin AXIS_DESCR COM_AXIS W_DKKD _CNV_R_R_Umr_10_zu__9_CM_S2 15 0 120 DEPOSIT ABSOLUTE FORMAT "%3.1" AXIS_PTS_REF SSTSKL_WL2 /end AXIS_DESCR
 FORMAT "%2.0" /end CHARACTERISTIC
/begin CHARACTERISTIC WL221 "" CURVE 0x1E0F68 _REC_A1CUR_1_u2_u2_S2 15000 _CNV_R_R_Umr_1_zu_1_3_CM_S2 0 15000
 /begin AXIS_DESCR COM_AXIS W_DKKD _CNV_R_R_Umr_10_zu__9_CM_S2 15 0 120 DEPOSIT ABSOLUTE FORMAT "%3.1" AXIS_PTS_REF SSTSKL_WL2 /end AXIS_DESCR
 FORMAT "%2.0" /end CHARACTERISTIC
/begin CHARACTERISTIC WL223 "" CURVE 0x1E0F86 _REC_A1CUR_1_u2_u2_S2 15000 _CNV_R_R_Umr_1_zu_1_3_CM_S2 0 15000
 /begin AXIS_DESCR COM_AXIS W_DKKD _CNV_R_R_Umr_10_zu__9_CM_S2 15 0 120 DEPOSIT ABSOLUTE FORMAT "%3.1" AXIS_PTS_REF SSTSKL_WL2 /end AXIS_DESCR
 FORMAT "%2.0" /end CHARACTERISTIC
/begin CHARACTERISTIC WL232 "" CURVE 0x1E0FA4 _REC_A1CUR_1_u2_u2_S2 15000 _CNV_R_R_Umr_1_zu_1_3_CM_S2 0 15000
 /begin AXIS_DESCR COM_AXIS W_DKKD _CNV_R_R_Umr_10_zu__9_CM_S2 15 0 120 DEPOSIT ABSOLUTE FORMAT "%3.1" AXIS_PTS_REF SSTSKL_WL2 /end AXIS_DESCR
 FORMAT "%2.0" /end CHARACTERISTIC
/begin CHARACTERISTIC WL234 "" CURVE 0x1E0FC2 _REC_A1CUR_1_u2_u2_S2 15000 _CNV_R_R_Umr_1_zu_1_3_CM_S2 0 15000
 /begin AXIS_DESCR COM_AXIS W_DKKD _CNV_R_R_Umr_10_zu__9_CM_S2 15 0 120 DEPOSIT ABSOLUTE FORMAT "%3.1" AXIS_PTS_REF SSTSKL_WL2 /end AXIS_DESCR
 FORMAT "%2.0" /end CHARACTERISTIC
/begin CHARACTERISTIC WL243 "" CURVE 0x1E0FE0 _REC_A1CUR_1_u2_u2_S2 15000 _CNV_R_R_Umr_1_zu_1_3_CM_S2 0 15000
 /begin AXIS_DESCR COM_AXIS W_DKKD _CNV_R_R_Umr_10_zu__9_CM_S2 15 0 120 DEPOSIT ABSOLUTE FORMAT "%3.1" AXIS_PTS_REF SSTSKL_WL2 /end AXIS_DESCR
 FORMAT "%2.0" /end CHARACTERISTIC
/begin CHARACTERISTIC WL245 "" CURVE 0x1E0FFE _REC_A1CUR_1_u2_u2_S2 15000 _CNV_R_R_Umr_1_zu_1_3_CM_S2 0 15000
 /begin AXIS_DESCR COM_AXIS W_DKKD _CNV_R_R_Umr_10_zu__9_CM_S2 15 0 120 DEPOSIT ABSOLUTE FORMAT "%3.1" AXIS_PTS_REF SSTSKL_WL2 /end AXIS_DESCR
 FORMAT "%2.0" /end CHARACTERISTIC
/begin CHARACTERISTIC WL254 "" CURVE 0x1E101C _REC_A1CUR_1_u2_u2_S2 15000 _CNV_R_R_Umr_1_zu_1_3_CM_S2 0 15000
 /begin AXIS_DESCR COM_AXIS W_DKKD _CNV_R_R_Umr_10_zu__9_CM_S2 15 0 120 DEPOSIT ABSOLUTE FORMAT "%3.1" AXIS_PTS_REF SSTSKL_WL2 /end AXIS_DESCR
 FORMAT "%2.0" /end CHARACTERISTIC
/begin CHARACTERISTIC WL256 "" CURVE 0x1E103A _REC_A1CUR_1_u2_u2_S2 15000 _CNV_R_R_Umr_1_zu_1_3_CM_S2 0 15000
 /begin AXIS_DESCR COM_AXIS W_DKKD _CNV_R_R_Umr_10_zu__9_CM_S2 15 0 120 DEPOSIT ABSOLUTE FORMAT "%3.1" AXIS_PTS_REF SSTSKL_WL2 /end AXIS_DESCR
 FORMAT "%2.0" /end CHARACTERISTIC
/begin CHARACTERISTIC WL265 "" CURVE 0x1E1058 _REC_A1CUR_1_u2_u2_S2 15000 _CNV_R_R_Umr_1_zu_1_3_CM_S2 0 15000
 /begin AXIS_DESCR COM_AXIS W_DKKD _CNV_R_R_Umr_10_zu__9_CM_S2 15 0 120 DEPOSIT ABSOLUTE FORMAT "%3.1" AXIS_PTS_REF SSTSKL_WL2 /end AXIS_DESCR
 FORMAT "%2.0" /end CHARACTERISTIC
/begin CHARACTERISTIC WL267 "" CURVE 0x1E1706 _REC_A1CUR_1_u2_u2_S2 15000 _CNV_R_R_Umr_1_zu_1_3_CM_S2 0 15000
 /begin AXIS_DESCR COM_AXIS W_DKKD _CNV_R_R_Umr_10_zu__9_CM_S2 15 0 120 DEPOSIT ABSOLUTE FORMAT "%3.1" AXIS_PTS_REF SSTSKL_WL2 /end AXIS_DESCR
 FORMAT "%2.0" /end CHARACTERISTIC
/begin CHARACTERISTIC WL276 "" CURVE 0x1E1724 _REC_A1CUR_1_u2_u2_S2 15000 _CNV_R_R_Umr_1_zu_1_3_CM_S2 0 15000
 /begin AXIS_DESCR COM_AXIS W_DKKD _CNV_R_R_Umr_10_zu__9_CM_S2 15 0 120 DEPOSIT ABSOLUTE FORMAT "%3.1" AXIS_PTS_REF SSTSKL_WL2 /end AXIS_DESCR
 FORMAT "%2.0" /end CHARACTERISTIC
/begin CHARACTERISTIC WL278 "" CURVE 0x1E1BF2 _REC_A1CUR_1_u2_u2_S2 15000 _CNV_R_R_Umr_1_zu_1_3_CM_S2 0 15000
 /begin AXIS_DESCR COM_AXIS W_DKKD _CNV_R_R_Umr_10_zu__9_CM_S2 15 0 120 DEPOSIT ABSOLUTE FORMAT "%3.1" AXIS_PTS_REF SSTSKL_WL2 /end AXIS_DESCR
 FORMAT "%2.0" /end CHARACTERISTIC
/begin CHARACTERISTIC WL287 "" CURVE 0x1E1C10 _REC_A1CUR_1_u2_u2_S2 15000 _CNV_R_R_Umr_1_zu_1_3_CM_S2 0 15000
 /begin AXIS_DESCR COM_AXIS W_DKKD _CNV_R_R_Umr_10_zu__9_CM_S2 15 0 120 DEPOSIT ABSOLUTE FORMAT "%3.1" AXIS_PTS_REF SSTSKL_WL2 /end AXIS_DESCR
 FORMAT "%2.0" /end CHARACTERISTIC
/begin MEASUREMENT W_BESCHLEUNIGUNG "" SWORD _CNV_R_R_Umr_10_zu__9_CM_S2 1 0 -3276.8 3276.7 ECU_ADDRESS 0xFFF8E7D6 FORMAT "%3.1" /end MEASUREMENT
/begin MEASUREMENT W_DK "" UWORD _CNV_R_R_Umr_10_zu__9_CM_S2 1 0 0 110 ECU_ADDRESS 0xFFF8E6FE FORMAT "%3.1" /end MEASUREMENT
/begin MEASUREMENT W_DKKD "" UWORD _CNV_R_R_Umr_10_zu__9_CM_S2 1 0 0 110 ECU_ADDRESS 0xFFF8E4C4 FORMAT "%3.1" /end MEASUREMENT
/begin MEASUREMENT W_DKKD_ALT "" UWORD _CNV_R_R_Umr_10_zu__9_CM_S2 1 0 0 110 ECU_ADDRESS 0xFFF8E3E0 FORMAT "%3.1" /end MEASUREMENT
/begin MEASUREMENT W_DKKD_BPL "" UWORD _CNV_R_R_Umr_10_zu__9_CM_S2 1 0 0 110 ECU_ADDRESS 0xFFF8E8B0 FORMAT "%3.1" /end MEASUREMENT
/begin MEASUREMENT W_DKKD_DDRS_NTMIN "" UWORD _CNV_R_R_Umr_10_zu__9_CM_S2 1 0 0 110 ECU_ADDRESS 0xFFF8E88C FORMAT "%3.1" /end MEASUREMENT
/begin MEASUREMENT W_DKKD_DERS "" UWORD _CNV_R_R_Umr_10_zu__9_CM_S2 1 0 0 6553.5 ECU_ADDRESS 0xFFF8E896 FORMAT "%3.1" /end MEASUREMENT
/begin MEASUREMENT W_DKKD_DERSALT "" UWORD _CNV_R_R_Umr_10_zu__9_CM_S2 1 0 0 6553.5 ECU_ADDRESS 0xFFF8E898 FORMAT "%3.1" /end MEASUREMENT
/begin MEASUREMENT W_DKKD_DMRS "" UWORD _CNV_R_R_Umr_10_zu__9_CM_S2 1 0 0 110 ECU_ADDRESS 0xFFF8E486 FORMAT "%3.1" /end MEASUREMENT
/begin MEASUREMENT W_DKKD_DMRSSTART "" UWORD _CNV_R_R_Umr_10_zu__9_CM_S2 1 0 0 110 ECU_ADDRESS 0xFFF8E488 FORMAT "%3.1" /end MEASUREMENT
/begin MEASUREMENT W_DKKD_FFG "" UWORD _CNV_R_R_Umr_10_zu__9_CM_S2 1 0 0 110 ECU_ADDRESS 0xFFF8E228 FORMAT "%3.1" /end MEASUREMENT
/begin MEASUREMENT W_DKKD_FILT "" UWORD _CNV_R_R_Umr_10_zu__9_CM_S2 1 0 0 110 ECU_ADDRESS 0xFFF8E22A FORMAT "%3.1" /end MEASUREMENT
/begin MEASUREMENT W_DKKD_FILTALT "" UWORD _CNV_R_R_Umr_10_zu__9_CM_S2 1 0 0 110 ECU_ADDRESS 0xFFF8E22C FORMAT "%3.1" /end MEASUREMENT
/begin MEASUREMENT W_DKKD_FILTBUF "" UWORD _CNV_R_R_Umr_10_zu__9_CM_S2 1 0 0 110 ECU_ADDRESS 0xFFF8E22E FORMAT "%3.1" MATRIX_DIM 5 1 1 /end MEASUREMENT
/begin MEASUREMENT W_DKKD_HSURE "" UWORD _CNV_R_R_Umr_10_zu__9_CM_S2 1 0 0 110 ECU_ADDRESS 0xFFF8E63A FORMAT "%3.1" /end MEASUREMENT
/begin MEASUREMENT W_DKKD_OPLUFT "" SWORD _CNV_R_R_Umr_10_zu__9_CM_S2 1 0 -110 110 ECU_ADDRESS 0xFFF8E238 FORMAT "%3.1" /end MEASUREMENT
/begin MEASUREMENT W_DKKD_PLUFT "" UWORD _CNV_R_R_Umr_10_zu__9_CM_S2 1 0 0 110 ECU_ADDRESS 0xFFF8E23A FORMAT "%3.1" /end MEASUREMENT
/begin MEASUREMENT W_DKKD_PS "" UWORD _CNV_R_R_Umr_10_zu__9_CM_S2 1 0 0 110 ECU_ADDRESS 0xFFF8E23C FORMAT "%3.1" /end MEASUREMENT
/begin MEASUREMENT W_DKKD_REF_RSUBGH "" UWORD _CNV_R_R_Umr_10_zu__9_CM_S2 1 0 0 110 ECU_ADDRESS 0xFFF8E7C2 FORMAT "%3.1" /end MEASUREMENT
/begin MEASUREMENT W_DK_LIN "" UWORD _CNV_R_R_Umr_10_zu__9_CM_S2 1 0 0 110 ECU_ADDRESS 0xFFF8E4C6 FORMAT "%3.1" /end MEASUREMENT
/begin MEASUREMENT W_DK_LINBUFFER "" UWORD _CNV_R_R_Umr_10_zu__9_CM_S2 1 0 0 110 ECU_ADDRESS 0xFFF8EEB8 FORMAT "%3.1" MATRIX_DIM 2 1 1 /end MEASUREMENT
/begin MEASUREMENT W_DK_REAL "" UWORD _CNV_R_R_Umr_10_zu__9_CM_S2 1 0 0 110 ECU_ADDRESS 0xFFF8E700 FORMAT "%3.1" /end MEASUREMENT
/begin MEASUREMENT W_DK_REAL_ROH "" UBYTE _CNV_R_R_Umr_1_zu_1_2_CM_S2 1 0 0 255 ECU_ADDRESS 0xFFF8E95F FORMAT "%2.0" /end MEASUREMENT
/begin MEASUREMENT W_DK_VIRT "" UWORD _CNV_R_R_Umr_10_zu__9_CM_S2 1 0 0 110 ECU_ADDRESS 0xFFF8E702 FORMAT "%3.1" /end MEASUREMENT
/begin MEASUREMENT W_DK_VIRT_ROH "" UBYTE _CNV_R_R_Umr_1_zu_1_2_CM_S2 1 0 0 255 ECU_ADDRESS 0xFFF8E960 /end MEASUREMENT
/begin MEASUREMENT W_FP_HSURE_BRS "" UWORD _CNV_R_R_Umr_10_zu__9_CM_S2 1 0 0 100 ECU_ADDRESS 0xFFF8E614 FORMAT "%3.1" /end MEASUREMENT
/begin MEASUREMENT W_LWVA_EFF "" SWORD _CNV_R_R_Umr_10_zu__10_CM_S2 1 0 -90 90 ECU_ADDRESS 0xFFF8E716 FORMAT "%3.1" /end MEASUREMENT
/begin MEASUREMENT W_LWVA_EFF_FILT "" SWORD _CNV_R_R_Umr_10_zu__10_CM_S2 1 0 -90 90 ECU_ADDRESS 0xFFF8E718 FORMAT "%3.1" /end MEASUREMENT
/begin MEASUREMENT W_LWVA_EFF_FILTREST "" SWORD _CNV_R_R_Umr_1_zu_1_2_CM_S2 1 0 -32768 32767 ECU_ADDRESS 0xFFF8E71A FORMAT "%3.1" /end MEASUREMENT
/begin MEASUREMENT W_LWVA_EFF_ROH "" UWORD _CNV_R_R_Umr_1_zu_1_2_CM_S2 1 0 0 0 ECU_ADDRESS 0xFFF8E3C4 FORMAT "%2.0" /end MEASUREMENT
/begin MEASUREMENT W_NICK "" SWORD _CNV_R_R_Umr_10_zu__9_CM_S2 1 0 -3276.8 3276.7 ECU_ADDRESS 0xFFF8E7D8 FORMAT "%3.1" /end MEASUREMENT
/begin MEASUREMENT W_STEIGUNG "" SWORD _CNV_R_R_Umr_10_zu__9_CM_S2 1 0 -200 200 ECU_ADDRESS 0xFFF8E704 FORMAT "%3.1" /end MEASUREMENT
/begin MEASUREMENT W_STEIGUNG_FILT "" SWORD _CNV_R_R_Umr_10_zu__9_CM_S2 1 0 -200 200 ECU_ADDRESS 0xFFF8E7DA FORMAT "%3.1" /end MEASUREMENT
/begin MEASUREMENT W_STEIGUNG_FILT_REST "" SWORD _CNV_R_R_Umr_10_zu__9_CM_S2 1 0 -200 200 ECU_ADDRESS 0xFFF8E7DC FORMAT "%3.1" /end MEASUREMENT
/begin MEASUREMENT W_STEIGUNG_GEW_MSA "" SWORD _CNV_R_R_Umr_10_zu__9_CM_S2 1 0 -200 200 ECU_ADDRESS 0xFFF8E3D2 FORMAT "%3.1" /end MEASUREMENT
/begin MEASUREMENT W_STEIGUNG_KOR "" SWORD _CNV_R_R_Umr_10_zu__9_CM_S2 1 0 -200 200 ECU_ADDRESS 0xFFF8E7DE FORMAT "%3.1" /end MEASUREMENT
/begin MEASUREMENT W_STEIGUNG_KORFILT "" SWORD _CNV_R_R_Umr_10_zu__9_CM_S2 1 0 -200 200 ECU_ADDRESS 0xFFF8E7E0 FORMAT "%3.1" /end MEASUREMENT
/begin MEASUREMENT W_STEIGUNG_KORFILT_REST "" SWORD _CNV_R_R_Umr_10_zu__9_CM_S2 1 0 -200 200 ECU_ADDRESS 0xFFF8E7E2 FORMAT "%3.1" /end MEASUREMENT
/begin MEASUREMENT W_STEIGUNG_KORFILT_SLOW "" SWORD _CNV_R_R_Umr_10_zu__9_CM_S2 1 0 -200 200 ECU_ADDRESS 0xFFF8E432 FORMAT "%3.1" /end MEASUREMENT
/begin MEASUREMENT W_STEIGUNG_KORFILT_SLOW_REST "" SWORD _CNV_R_R_Umr_10_zu__9_CM_S2 1 0 -200 200 ECU_ADDRESS 0xFFF8E434 FORMAT "%3.1" /end MEASUREMENT
/begin MEASUREMENT W_STEIGUNG_ROH "" UWORD _CNV_R_R_Umr_1_zu_1_2_CM_S2 1 0 0 65535 ECU_ADDRESS 0xFFF8E3C6 /end MEASUREMENT
/begin CHARACTERISTIC XA_L_INGEW "" VALUE 0x1DE8E0 _REC_S1VAL_1_s2_S2 65535 _CNV_R_R_Umr_1_zu_1_2_CM_S2 -32768 32767 FORMAT "%2.0" /end CHARACTERISTIC
/begin CHARACTERISTIC XA_L_MUELOWFILT_INGEW "" VALUE 0x1DE8E2 _REC_S1VAL_1_s2_S2 2500 _CNV_R_R_Umr_1_zu_1_2_CM_S2 0 2500 /end CHARACTERISTIC
/begin CHARACTERISTIC XA_L_MUELOWFILT_OUTGEW "" VALUE 0x1DE8E4 _REC_S1VAL_1_s2_S2 2500 _CNV_R_R_Umr_1_zu_1_2_CM_S2 0 2500 /end CHARACTERISTIC
/begin CHARACTERISTIC XA_L_OUTGEW "" VALUE 0x1DE8E6 _REC_S1VAL_1_s2_S2 65535 _CNV_R_R_Umr_1_zu_1_2_CM_S2 -32768 32767 FORMAT "%2.0" /end CHARACTERISTIC
/begin CHARACTERISTIC XA_L_REFINGEW "" VALUE 0x1DE8E8 _REC_S1VAL_1_s2_S2 65535 _CNV_R_R_Umr_1_zu_1_2_CM_S2 -32768 32767 FORMAT "%2.0" /end CHARACTERISTIC
/begin CHARACTERISTIC XA_L_REFOUTGEW "" VALUE 0x1DE8EA _REC_S1VAL_1_s2_S2 65535 _CNV_R_R_Umr_1_zu_1_2_CM_S2 -32768 32767 FORMAT "%2.0" /end CHARACTERISTIC
/begin CHARACTERISTIC XA_QGIER_INGEW "" VALUE 0x1DE8EC _REC_S1VAL_1_s2_S2 65535 _CNV_R_R_Umr_1_zu_1_2_CM_S2 -32768 32767 FORMAT "%2.0" /end CHARACTERISTIC
/begin CHARACTERISTIC XA_QGIER_OUTGEW "" VALUE 0x1DE8EE _REC_S1VAL_1_s2_S2 65535 _CNV_R_R_Umr_1_zu_1_2_CM_S2 -32768 32767 FORMAT "%2.0" /end CHARACTERISTIC
/begin CHARACTERISTIC XA_Q_INGEW "" VALUE 0x1DE8F0 _REC_S1VAL_1_s2_S2 65535 _CNV_R_R_Umr_1_zu_1_2_CM_S2 -32768 32767 FORMAT "%2.0" /end CHARACTERISTIC
/begin CHARACTERISTIC XA_Q_KURVE "" CURVE 0x1DF276 _REC_A1CUR_30_u2_u2_S2 6553.5 _CNV_R_R_Umr_10_zu__37_CM_S2 0 6553.5
 /begin AXIS_DESCR FIX_AXIS NO_INPUT_QUANTITY _CNV_S_5_Enum_EKURV_246_CM_S2 5 0 4 READ_ONLY FIX_AXIS_PAR_DIST 0 1 5 /end AXIS_DESCR
 FORMAT "%3.1" /end CHARACTERISTIC
/begin CHARACTERISTIC XA_Q_OUTGEW "" VALUE 0x1DE8F2 _REC_S1VAL_1_s2_S2 65535 _CNV_R_R_Umr_1_zu_1_2_CM_S2 -32768 32767 FORMAT "%2.0" /end CHARACTERISTIC
/begin CHARACTERISTIC XA_RAD_BRFAKT "" VALUE 0x1DE8F4 _REC_S1VAL_1_u2_S2 65535 _CNV_R_R_Umr_1_zu_1_2_CM_S2 0 65535 FORMAT "%2.0" /end CHARACTERISTIC
/begin CHARACTERISTIC XCA_Q_KURVE "" VALUE 0x1DF318 _REC_S1VAL_1_u2_S2 19 _CNV_R_R_Umr_1_zu_1_2_CM_S2 1 20 FORMAT "%2.0" /end CHARACTERISTIC
/begin CHARACTERISTIC XC_ABREGLERINIT "" VALUE 0x1DF3AE _REC_S1VAL_1_u2_S2 65535 _CNV_R_R_Umr_1_zu_1_2_CM_S2 0 65535 FORMAT "%2.0" /end CHARACTERISTIC
/begin CHARACTERISTIC XC_CR_MINUS "" VALUE 0x1E25FA _REC_S1VAL_1_s2_S2 65535 _CNV_R_R_Umr_1_zu_1_2_CM_S2 -32768 32767 FORMAT "%2.0" /end CHARACTERISTIC
/begin CHARACTERISTIC XC_CR_PLUS "" VALUE 0x1E25FC _REC_S1VAL_1_s2_S2 65535 _CNV_R_R_Umr_1_zu_1_2_CM_S2 -32768 32767 FORMAT "%2.0" /end CHARACTERISTIC
/begin CHARACTERISTIC XC_GANGMAX_SP_STAND "" VALUE 0x1D910D _REC_S1VAL_1_u1_S2 8 _CNV_S_9_Enum_EGANG_21_CM_S2 0 8 /end CHARACTERISTIC
/begin CHARACTERISTIC XC_HSUREHS_DECRVALLDM "" VALUE 0x1D95C5 _REC_S1VAL_1_u1_S2 255 _CNV_R_R_Umr_1_zu_1_2_CM_S2 0 255 FORMAT "%2.0" /end CHARACTERISTIC
/begin CHARACTERISTIC XC_HSUREKUVOR_DECRVAL "" VALUE 0x1D95C7 _REC_S1VAL_1_u1_S2 255 _CNV_R_R_Umr_1_zu_1_2_CM_S2 0 255 FORMAT "%2.0" /end CHARACTERISTIC
/begin CHARACTERISTIC XC_HSURERS_DECRVALLDM "" VALUE 0x1D95C9 _REC_S1VAL_1_u1_S2 255 _CNV_R_R_Umr_1_zu_1_2_CM_S2 0 255 FORMAT "%2.0" /end CHARACTERISTIC
/begin CHARACTERISTIC XC_HSURE_INITVAL "" VALUE 0x1DEDDE _REC_S1VAL_1_u2_S2 65535 _CNV_R_R_Umr_1_zu_1_2_CM_S2 0 65535 FORMAT "%2.0" /end CHARACTERISTIC
/begin CHARACTERISTIC XC_NABMAX_SP_STAND_OBEN "" VALUE 0x1DE608 _REC_S1VAL_1_u2_S2 2000 _CNV_R_R_Umr_1_zu_1_3_CM_S2 0 2000 FORMAT "%2.0" /end CHARACTERISTIC
/begin CHARACTERISTIC XC_NABMAX_SP_STAND_UNTEN "" VALUE 0x1DE60A _REC_S1VAL_1_u2_S2 2000 _CNV_R_R_Umr_1_zu_1_3_CM_S2 0 2000 FORMAT "%2.0" /end CHARACTERISTIC
/begin CHARACTERISTIC XC_SCHLUPF_BUFFER "" VALUE 0x1DF44A _REC_S1VAL_1_u2_S2 65534 _CNV_R_R_Umr_1_zu_1_2_CM_S2 1 65535 FORMAT "%2.0" /end CHARACTERISTIC
/begin CHARACTERISTIC XC_SUM_G3WAB_FWSFILTBUFFER "" VALUE 0x1D957C _REC_S1VAL_1_s1_S2 2 _CNV_R_R_Umr_1_zu_1_2_CM_S2 3 5 /end CHARACTERISTIC
/begin CHARACTERISTIC XC_W_DKKDFILT "" VALUE 0x1DDEE0 _REC_S1VAL_1_u2_S2 4 _CNV_R_R_Umr_1_zu_1_2_CM_S2 1 5 FORMAT "%2.0" /end CHARACTERISTIC
/begin CHARACTERISTIC XDA_Q_KURVE "" CURVE 0x1DC948 _REC_A1CUR_30_s2_u1_S2 40 _CNV_R_R_Umr_10_zu__37_CM_S2 -20 20
 /begin AXIS_DESCR FIX_AXIS Z_MOD_KURVE _CNV_S_4_Enum_EKURV_247_CM_S2 4 0 3 READ_ONLY FIX_AXIS_PAR_DIST 0 1 4 /end AXIS_DESCR
 FORMAT "%3.1" /end CHARACTERISTIC
/begin CHARACTERISTIC XDGANG_MAX_RSU_DSCERR "" VALUE 0x1D8F74 _REC_S1VAL_1_u1_S2 3 _CNV_R_R_Umr_1_zu_1_2_CM_S2 1 4 /end CHARACTERISTIC
/begin CHARACTERISTIC XDGANG_MAX_SPA "" VALUE 0x1D9125 _REC_S1VAL_1_u1_S2 6 _CNV_R_R_Umr_1_zu_1_2_CM_S2 1 7 FORMAT "%2.0" /end CHARACTERISTIC
/begin CHARACTERISTIC XDGW_FP_HSURE_BRS "" VALUE 0x1DED88 _REC_S1VAL_1_s2_S2 500 _CNV_R_R_Umr_1_zu_1_7_CM_S2 0 500 /end CHARACTERISTIC
/begin CHARACTERISTIC XDIFF_MUE_UEBER "" VALUE 0x1DEC86 _REC_S1VAL_1_u2_S2 65.535 _CNV_R_R_Umr_1000_z_36_CM_S2 0 65.535 FORMAT "%5.3" /end CHARACTERISTIC
/begin CHARACTERISTIC XDK_FILT_DOWNINGEW "" VALUE 0x1DDEE2 _REC_S1VAL_1_u2_S2 999 _CNV_R_R_Umr_1_zu_1_2_CM_S2 1 1000 FORMAT "%2.0" /end CHARACTERISTIC
/begin CHARACTERISTIC XDK_FILT_DOWNOUTGEW "" VALUE 0x1DDEE4 _REC_S1VAL_1_u2_S2 1000 _CNV_R_R_Umr_1_zu_1_2_CM_S2 0 1000 FORMAT "%2.0" /end CHARACTERISTIC
/begin CHARACTERISTIC XDM_AB_FWSALT_FILTINGEW "" VALUE 0x1DEC88 _REC_S1VAL_1_s2_S2 65535 _CNV_R_R_Umr_1_zu_1_2_CM_S2 -32768 32767 FORMAT "%2.0" /end CHARACTERISTIC
/begin CHARACTERISTIC XDM_AB_FWSALT_FILTOUTGEW "" VALUE 0x1DEC8A _REC_S1VAL_1_s2_S2 65535 _CNV_R_R_Umr_1_zu_1_2_CM_S2 -32768 32767 FORMAT "%2.0" /end CHARACTERISTIC
/begin CHARACTERISTIC XDM_AB_FWSFILTINGEW "" VALUE 0x1DEC8C _REC_S1VAL_1_s2_S2 65535 _CNV_R_R_Umr_1_zu_1_2_CM_S2 -32768 32767 FORMAT "%2.0" /end CHARACTERISTIC
/begin CHARACTERISTIC XDM_AB_FWSFILTOUTGEW "" VALUE 0x1DEC8E _REC_S1VAL_1_s2_S2 65535 _CNV_R_R_Umr_1_zu_1_2_CM_S2 -32768 32767 FORMAT "%2.0" /end CHARACTERISTIC
/begin CHARACTERISTIC XDM_AB_FWSOFFSET "" VALUE 0x1DE808 _REC_S1VAL_1_s2_S2 65535 _CNV_R_R_Umr_1_zu_1_38_CM_S2 -32768 32767 FORMAT "%2.0" /end CHARACTERISTIC
/begin CHARACTERISTIC XDM_AB_MUEFILTGEW "" VALUE 0x1DEC90 _REC_S1VAL_1_s2_S2 65535 _CNV_R_R_Umr_1_zu_1_2_CM_S2 -32768 32767 FORMAT "%2.0" /end CHARACTERISTIC
/begin CHARACTERISTIC XDM_AB_MUEGEW "" VALUE 0x1DEC92 _REC_S1VAL_1_s2_S2 65535 _CNV_R_R_Umr_1_zu_1_2_CM_S2 -32768 32767 FORMAT "%2.0" /end CHARACTERISTIC
/begin CHARACTERISTIC XDM_RADSOLL_STABKRI_ZKA "" VALUE 0x1E248C _REC_S1VAL_1_u2_S2 30000 _CNV_R_R_Umr_1_zu_1_38_CM_S2 0 30000 FORMAT "%2.0" /end CHARACTERISTIC
/begin CHARACTERISTIC XDM_RAD_KOMPGRAD_MAX "" VALUE 0x1DF272 _REC_S1VAL_1_s2_S2 9900 _CNV_R_R_Umr_1_zu_1_245_CM_S2 100 10000 FORMAT "%2.0" /end CHARACTERISTIC
/begin CHARACTERISTIC XDM_RAD_KOMPGRAD_MIN "" VALUE 0x1DF274 _REC_S1VAL_1_s2_S2 9900 _CNV_R_R_Umr_1_zu_1_245_CM_S2 -10000 -100 FORMAT "%2.0" /end CHARACTERISTIC
/begin CHARACTERISTIC XDN_AB_EINBAB "" VALUE 0x1DE7B6 _REC_S1VAL_1_u2_S2 20000 _CNV_R_R_Umr_1_zu_1_3_CM_S2 0 20000 FORMAT "%2.0" /end CHARACTERISTIC
/begin CHARACTERISTIC XDN_AB_REFBAB "" VALUE 0x1DE7B8 _REC_S1VAL_1_u2_S2 20000 _CNV_R_R_Umr_1_zu_1_3_CM_S2 0 20000 FORMAT "%2.0" /end CHARACTERISTIC
/begin CHARACTERISTIC XDN_K0_MAX_1 "" VALUE 0x1DE378 _REC_S1VAL_1_s2_S2 10000 _CNV_R_R_Umr_1_zu_1_3_CM_S2 0 10000 FORMAT "%2.0" /end CHARACTERISTIC
/begin CHARACTERISTIC XDN_K0_MAX_2 "" VALUE 0x1DE37A _REC_S1VAL_1_s2_S2 10000 _CNV_R_R_Umr_1_zu_1_3_CM_S2 0 10000 FORMAT "%2.0" /end CHARACTERISTIC
/begin CHARACTERISTIC XDN_K0_SOLL "" VALUE 0x1DE3C2 _REC_S1VAL_1_u2_S2 10000 _CNV_R_R_Umr_1_zu_1_3_CM_S2 0 10000 FORMAT "%2.0" /end CHARACTERISTIC
/begin CHARACTERISTIC XDN_MOT_INGEW "" VALUE 0x1DECD8 _REC_S1VAL_1_s2_S2 65535 _CNV_R_R_Umr_1_zu_1_2_CM_S2 -32768 32767 FORMAT "%2.0" /end CHARACTERISTIC
/begin CHARACTERISTIC XDN_MOT_OUTGEW "" VALUE 0x1DECDA _REC_S1VAL_1_s2_S2 65535 _CNV_R_R_Umr_1_zu_1_2_CM_S2 -32768 32767 FORMAT "%2.0" /end CHARACTERISTIC
/begin CHARACTERISTIC XE12 "" CURVE 0x1E1076 _REC_A1CUR_1_u2_u2_S2 15000 _CNV_R_R_Umr_1_zu_1_3_CM_S2 0 15000
 /begin AXIS_DESCR COM_AXIS W_DKKD _CNV_R_R_Umr_10_zu__9_CM_S2 15 0 120 DEPOSIT ABSOLUTE FORMAT "%3.1" AXIS_PTS_REF SSTSKL_XE /end AXIS_DESCR
 FORMAT "%2.0" /end CHARACTERISTIC
/begin CHARACTERISTIC XE21 "" CURVE 0x1E1094 _REC_A1CUR_1_u2_u2_S2 15000 _CNV_R_R_Umr_1_zu_1_3_CM_S2 0 15000
 /begin AXIS_DESCR COM_AXIS W_DKKD _CNV_R_R_Umr_10_zu__9_CM_S2 15 0 120 DEPOSIT ABSOLUTE FORMAT "%3.1" AXIS_PTS_REF SSTSKL_XE /end AXIS_DESCR
 FORMAT "%2.0" /end CHARACTERISTIC
/begin CHARACTERISTIC XE23 "" CURVE 0x1E10B2 _REC_A1CUR_1_u2_u2_S2 15000 _CNV_R_R_Umr_1_zu_1_3_CM_S2 0 15000
 /begin AXIS_DESCR COM_AXIS W_DKKD _CNV_R_R_Umr_10_zu__9_CM_S2 15 0 120 DEPOSIT ABSOLUTE FORMAT "%3.1" AXIS_PTS_REF SSTSKL_XE /end AXIS_DESCR
 FORMAT "%2.0" /end CHARACTERISTIC
/begin CHARACTERISTIC XE32 "" CURVE 0x1E10D0 _REC_A1CUR_1_u2_u2_S2 15000 _CNV_R_R_Umr_1_zu_1_3_CM_S2 0 15000
 /begin AXIS_DESCR COM_AXIS W_DKKD _CNV_R_R_Umr_10_zu__9_CM_S2 15 0 120 DEPOSIT ABSOLUTE FORMAT "%3.1" AXIS_PTS_REF SSTSKL_XE /end AXIS_DESCR
 FORMAT "%2.0" /end CHARACTERISTIC
/begin CHARACTERISTIC XE34 "" CURVE 0x1E10EE _REC_A1CUR_1_u2_u2_S2 15000 _CNV_R_R_Umr_1_zu_1_3_CM_S2 0 15000
 /begin AXIS_DESCR COM_AXIS W_DKKD _CNV_R_R_Umr_10_zu__9_CM_S2 15 0 120 DEPOSIT ABSOLUTE FORMAT "%3.1" AXIS_PTS_REF SSTSKL_XE /end AXIS_DESCR
 FORMAT "%2.0" /end CHARACTERISTIC
/begin CHARACTERISTIC XE43 "" CURVE 0x1E110C _REC_A1CUR_1_u2_u2_S2 15000 _CNV_R_R_Umr_1_zu_1_3_CM_S2 0 15000
 /begin AXIS_DESCR COM_AXIS W_DKKD _CNV_R_R_Umr_10_zu__9_CM_S2 15 0 120 DEPOSIT ABSOLUTE FORMAT "%3.1" AXIS_PTS_REF SSTSKL_XE /end AXIS_DESCR
 FORMAT "%2.0" /end CHARACTERISTIC
/begin CHARACTERISTIC XE45 "" CURVE 0x1E112A _REC_A1CUR_1_u2_u2_S2 15000 _CNV_R_R_Umr_1_zu_1_3_CM_S2 0 15000
 /begin AXIS_DESCR COM_AXIS W_DKKD _CNV_R_R_Umr_10_zu__9_CM_S2 15 0 120 DEPOSIT ABSOLUTE FORMAT "%3.1" AXIS_PTS_REF SSTSKL_XE /end AXIS_DESCR
 FORMAT "%2.0" /end CHARACTERISTIC
/begin CHARACTERISTIC XE54 "" CURVE 0x1E1148 _REC_A1CUR_1_u2_u2_S2 15000 _CNV_R_R_Umr_1_zu_1_3_CM_S2 0 15000
 /begin AXIS_DESCR COM_AXIS W_DKKD _CNV_R_R_Umr_10_zu__9_CM_S2 15 0 120 DEPOSIT ABSOLUTE FORMAT "%3.1" AXIS_PTS_REF SSTSKL_XE /end AXIS_DESCR
 FORMAT "%2.0" /end CHARACTERISTIC
/begin CHARACTERISTIC XE56 "" CURVE 0x1E1166 _REC_A1CUR_1_u2_u2_S2 15000 _CNV_R_R_Umr_1_zu_1_3_CM_S2 0 15000
 /begin AXIS_DESCR COM_AXIS W_DKKD _CNV_R_R_Umr_10_zu__9_CM_S2 15 0 120 DEPOSIT ABSOLUTE FORMAT "%3.1" AXIS_PTS_REF SSTSKL_XE /end AXIS_DESCR
 FORMAT "%2.0" /end CHARACTERISTIC
/begin CHARACTERISTIC XE65 "" CURVE 0x1E1184 _REC_A1CUR_1_u2_u2_S2 15000 _CNV_R_R_Umr_1_zu_1_3_CM_S2 0 15000
 /begin AXIS_DESCR COM_AXIS W_DKKD _CNV_R_R_Umr_10_zu__9_CM_S2 15 0 120 DEPOSIT ABSOLUTE FORMAT "%3.1" AXIS_PTS_REF SSTSKL_XE /end AXIS_DESCR
 FORMAT "%2.0" /end CHARACTERISTIC
/begin CHARACTERISTIC XE67 "" CURVE 0x1E1742 _REC_A1CUR_1_u2_u2_S2 15000 _CNV_R_R_Umr_1_zu_1_3_CM_S2 0 15000
 /begin AXIS_DESCR COM_AXIS W_DKKD _CNV_R_R_Umr_10_zu__9_CM_S2 15 0 120 DEPOSIT ABSOLUTE FORMAT "%3.1" AXIS_PTS_REF SSTSKL_XE /end AXIS_DESCR
 FORMAT "%2.0" /end CHARACTERISTIC
/begin CHARACTERISTIC XE76 "" CURVE 0x1E1760 _REC_A1CUR_1_u2_u2_S2 15000 _CNV_R_R_Umr_1_zu_1_3_CM_S2 0 15000
 /begin AXIS_DESCR COM_AXIS W_DKKD _CNV_R_R_Umr_10_zu__9_CM_S2 15 0 120 DEPOSIT ABSOLUTE FORMAT "%3.1" AXIS_PTS_REF SSTSKL_XE /end AXIS_DESCR
 FORMAT "%2.0" /end CHARACTERISTIC
/begin CHARACTERISTIC XE78 "" CURVE 0x1E1C2E _REC_A1CUR_1_u2_u2_S2 15000 _CNV_R_R_Umr_1_zu_1_3_CM_S2 0 15000
 /begin AXIS_DESCR COM_AXIS W_DKKD _CNV_R_R_Umr_10_zu__9_CM_S2 15 0 120 DEPOSIT ABSOLUTE FORMAT "%3.1" AXIS_PTS_REF SSTSKL_XE /end AXIS_DESCR
 FORMAT "%2.0" /end CHARACTERISTIC
/begin CHARACTERISTIC XE87 "" CURVE 0x1E1C4C _REC_A1CUR_1_u2_u2_S2 15000 _CNV_R_R_Umr_1_zu_1_3_CM_S2 0 15000
 /begin AXIS_DESCR COM_AXIS W_DKKD _CNV_R_R_Umr_10_zu__9_CM_S2 15 0 120 DEPOSIT ABSOLUTE FORMAT "%3.1" AXIS_PTS_REF SSTSKL_XE /end AXIS_DESCR
 FORMAT "%2.0" /end CHARACTERISTIC
/begin CHARACTERISTIC XFAKT_ACHSLASTVERTEILG "" VALUE 0x1DEC94 _REC_S1VAL_1_u2_S2 100 _CNV_R_R_Umr_1_zu_1_30_CM_S2 0 100 FORMAT "%2.0" /end CHARACTERISTIC
/begin CHARACTERISTIC XFAKT_DYNDZM_HS_WARTEZEIT_P1 "" VALUE 0x1D9532 _REC_S1VAL_1_u1_S2 200 _CNV_R_R_Umr_1_zu_1_30_CM_S2 0 200 FORMAT "%2.0" /end CHARACTERISTIC
/begin CHARACTERISTIC XFAKT_DYNDZM_RS_WARTEZEIT_P1 "" VALUE 0x1D9533 _REC_S1VAL_1_u1_S2 200 _CNV_R_R_Umr_1_zu_1_30_CM_S2 0 200 FORMAT "%2.0" /end CHARACTERISTIC
/begin CHARACTERISTIC XFAKT_DYNDZM_WARTEZEIT_FS "" VALUE 0x1D9534 _REC_S1VAL_1_u1_S2 200 _CNV_R_R_Umr_1_zu_1_30_CM_S2 0 200 FORMAT "%2.0" /end CHARACTERISTIC
/begin CHARACTERISTIC XFAKT_FILTKORSCHALT_DYNHSPV "" VALUE 0x1DF696 _REC_S1VAL_1_u2_S2 50000 _CNV_R_R_Umr_1_zu_1_30_CM_S2 0 50000 FORMAT "%2.0" /end CHARACTERISTIC
/begin CHARACTERISTIC XFAKT_GK0_FDYN "" VALUE 0x1D8F4A _REC_S1VAL_1_u1_S2 100 _CNV_R_R_Umr_1_zu_1_30_CM_S2 0 100 FORMAT "%2.0" /end CHARACTERISTIC
/begin CHARACTERISTIC XFAKT_HEISSHOCH_OBEN "" VALUE 0x1E2136 _REC_S1VAL_1_u2_S2 250 _CNV_R_R_Umr_1_zu_1_30_CM_S2 0 250 FORMAT "%2.0" /end CHARACTERISTIC
/begin CHARACTERISTIC XFAKT_HEISSHOCH_UNTEN "" VALUE 0x1E2138 _REC_S1VAL_1_u2_S2 250 _CNV_R_R_Umr_1_zu_1_30_CM_S2 0 250 FORMAT "%2.0" /end CHARACTERISTIC
/begin CHARACTERISTIC XFAKT_MEM1MAX_AVLPRED_ZKA "" VALUE 0x1E2220 _REC_S1VAL_1_s2_S2 100 _CNV_R_R_Umr_1_zu_1_30_CM_S2 0 100 FORMAT "%2.0" /end CHARACTERISTIC
/begin CHARACTERISTIC XFAKT_MEM1MIN_AVLPRED_ZKA "" VALUE 0x1E2222 _REC_S1VAL_1_s2_S2 100 _CNV_R_R_Umr_1_zu_1_30_CM_S2 0 100 FORMAT "%2.0" /end CHARACTERISTIC
/begin CHARACTERISTIC XFAKT_NWA_DYNDZM "" VALUE 0x1D9535 _REC_S1VAL_1_u1_S2 200 _CNV_R_R_Umr_1_zu_1_30_CM_S2 0 200 FORMAT "%2.0" /end CHARACTERISTIC
/begin CHARACTERISTIC XFAKT_SCHLUPF_DYNHSPV "" VALUE 0x1D963D _REC_S1VAL_1_u1_S2 2.5 _CNV_R_R_Umr_100_zu_42_CM_S2 0 2.5 FORMAT "%4.2" /end CHARACTERISTIC
/begin CHARACTERISTIC XFAKT_SCHLUPF_MDS "" VALUE 0x1D9623 _REC_S1VAL_1_u1_S2 1 _CNV_R_R_Umr_1_zu_1_2_CM_S2 0 1 FORMAT "%2.0" /end CHARACTERISTIC
/begin CHARACTERISTIC XF_NMOTABREGEL_DUENE_MDS "" VALUE 0x1D9624 _REC_S1VAL_1_u1_S2 15 _CNV_R_R_Umr_1_zu_1_30_CM_S2 100 115 FORMAT "%2.0" /end CHARACTERISTIC
/begin CHARACTERISTIC XF_NMOTABREGEL_ZHSVERBOT_MDS "" VALUE 0x1D9625 _REC_S1VAL_1_u1_S2 15 _CNV_R_R_Umr_1_zu_1_30_CM_S2 100 115 FORMAT "%2.0" /end CHARACTERISTIC
/begin CHARACTERISTIC XF_NMOT_ANZEIGE_BAND "" VALUE 0x1DE3CA _REC_S1VAL_1_u2_S2 1 _CNV_R_R_Umr_1000_z_36_CM_S2 0 1 FORMAT "%5.3" /end CHARACTERISTIC
/begin CHARACTERISTIC XG2W_AB_FILTMARS_INGEW "" VALUE 0x1DECC4 _REC_S1VAL_1_s2_S2 2500 _CNV_R_R_Umr_1_zu_1_2_CM_S2 0 2500 FORMAT "%2.0" /end CHARACTERISTIC
/begin CHARACTERISTIC XG2W_AB_FILTMARS_OUTGEW "" VALUE 0x1DECC6 _REC_S1VAL_1_s2_S2 2500 _CNV_R_R_Umr_1_zu_1_2_CM_S2 0 2500 FORMAT "%2.0" /end CHARACTERISTIC
/begin CHARACTERISTIC XG2W_AB_FWSINGEW "" VALUE 0x1DECC8 _REC_S1VAL_1_s2_S2 65535 _CNV_R_R_Umr_1_zu_1_2_CM_S2 -32768 32767 FORMAT "%2.0" /end CHARACTERISTIC
/begin CHARACTERISTIC XG2W_AB_FWSOUTGEW "" VALUE 0x1DECCA _REC_S1VAL_1_s2_S2 65535 _CNV_R_R_Umr_1_zu_1_2_CM_S2 -32768 32767 FORMAT "%2.0" /end CHARACTERISTIC
/begin CHARACTERISTIC XG2W_AB_INGEW "" VALUE 0x1DECCC _REC_S1VAL_1_s2_S2 65535 _CNV_R_R_Umr_1_zu_1_2_CM_S2 -32768 32767 FORMAT "%2.0" /end CHARACTERISTIC
/begin CHARACTERISTIC XG2W_AB_OUTGEW "" VALUE 0x1DECCE _REC_S1VAL_1_s2_S2 65535 _CNV_R_R_Umr_1_zu_1_2_CM_S2 -32768 32767 FORMAT "%2.0" /end CHARACTERISTIC
/begin CHARACTERISTIC XGANG_ANZAHL_TIPP "" VALUE 0x1D910E _REC_S1VAL_1_u1_S2 255 _CNV_R_R_Umr_1_zu_1_2_CM_S2 0 255 /end CHARACTERISTIC
/begin CHARACTERISTIC XGANG_DMHSMAX "" VALUE 0x1D8F76 _REC_S1VAL_1_u1_S2 5 _CNV_R_R_Umr_1_zu_1_2_CM_S2 1 6 FORMAT "%2.0" /end CHARACTERISTIC
/begin CHARACTERISTIC XGANG_DMRSMAX "" VALUE 0x1D8F77 _REC_S1VAL_1_u1_S2 5 _CNV_R_R_Umr_1_zu_1_2_CM_S2 1 6 FORMAT "%2.0" /end CHARACTERISTIC
/begin CHARACTERISTIC XGANG_MAX_DUE "" VALUE 0x1D97A0 _REC_S1VAL_1_u1_S2 8 _CNV_S_9_Enum_EGANG_21_CM_S2 0 8 /end CHARACTERISTIC
/begin CHARACTERISTIC XGANG_MIN_RSU_DSCERR "" VALUE 0x1D8F75 _REC_S1VAL_1_u1_S2 8 _CNV_S_9_Enum_EGANG_21_CM_S2 0 8 /end CHARACTERISTIC
/begin CHARACTERISTIC XGKLY10W_DKKD_BPL5A_0 "" CURVE 0x1DDD80 _REC_A1CUR_1_u2_u2_S2 110 _CNV_R_R_Umr_10_zu__9_CM_S2 0 110
 /begin AXIS_DESCR COM_AXIS N_AB _CNV_R_R_Umr_1_zu_1_3_CM_S2 10 0 20000 DEPOSIT ABSOLUTE FORMAT "%2.0" AXIS_PTS_REF SSTW_DKKD_BPL5 /end AXIS_DESCR
 FORMAT "%3.1" /end CHARACTERISTIC
/begin CHARACTERISTIC XGKLY10W_DKKD_BPL5A_1 "" CURVE 0x1DDD94 _REC_A1CUR_1_u2_u2_S2 110 _CNV_R_R_Umr_10_zu__9_CM_S2 0 110
 /begin AXIS_DESCR COM_AXIS N_AB _CNV_R_R_Umr_1_zu_1_3_CM_S2 10 0 20000 DEPOSIT ABSOLUTE FORMAT "%2.0" AXIS_PTS_REF SSTW_DKKD_BPL5 /end AXIS_DESCR
 FORMAT "%3.1" /end CHARACTERISTIC
/begin CHARACTERISTIC XGKLY10W_DKKD_BPL5A_2 "" CURVE 0x1DDDA8 _REC_A1CUR_1_u2_u2_S2 110 _CNV_R_R_Umr_10_zu__9_CM_S2 0 110
 /begin AXIS_DESCR COM_AXIS N_AB _CNV_R_R_Umr_1_zu_1_3_CM_S2 10 0 20000 DEPOSIT ABSOLUTE FORMAT "%2.0" AXIS_PTS_REF SSTW_DKKD_BPL5 /end AXIS_DESCR
 FORMAT "%3.1" /end CHARACTERISTIC
/begin CHARACTERISTIC XGKLY10W_DKKD_BPL5S_0 "" CURVE 0x1DDDBC _REC_A1CUR_1_u2_u2_S2 110 _CNV_R_R_Umr_10_zu__9_CM_S2 0 110
 /begin AXIS_DESCR COM_AXIS N_AB _CNV_R_R_Umr_1_zu_1_3_CM_S2 10 0 20000 DEPOSIT ABSOLUTE FORMAT "%2.0" AXIS_PTS_REF SSTW_DKKD_BPL5 /end AXIS_DESCR
 FORMAT "%3.1" /end CHARACTERISTIC
/begin CHARACTERISTIC XGKLY10W_DKKD_BPL5S_1 "" CURVE 0x1DDDD0 _REC_A1CUR_1_u2_u2_S2 110 _CNV_R_R_Umr_10_zu__9_CM_S2 0 110
 /begin AXIS_DESCR COM_AXIS N_AB _CNV_R_R_Umr_1_zu_1_3_CM_S2 10 0 20000 DEPOSIT ABSOLUTE FORMAT "%2.0" AXIS_PTS_REF SSTW_DKKD_BPL5 /end AXIS_DESCR
 FORMAT "%3.1" /end CHARACTERISTIC
/begin CHARACTERISTIC XGKLY10W_DKKD_BPL5S_2 "" CURVE 0x1DDDE4 _REC_A1CUR_1_u2_u2_S2 110 _CNV_R_R_Umr_10_zu__9_CM_S2 0 110
 /begin AXIS_DESCR COM_AXIS N_AB _CNV_R_R_Umr_1_zu_1_3_CM_S2 10 0 20000 DEPOSIT ABSOLUTE FORMAT "%2.0" AXIS_PTS_REF SSTW_DKKD_BPL5 /end AXIS_DESCR
 FORMAT "%3.1" /end CHARACTERISTIC
/begin CHARACTERISTIC XGKLY6W_DKKD_BPLOTHERA_0 "" CURVE 0x1DDDF8 _REC_A1CUR_1_u2_u2_S2 110 _CNV_R_R_Umr_10_zu__9_CM_S2 0 110
 /begin AXIS_DESCR COM_AXIS N_AB _CNV_R_R_Umr_1_zu_1_3_CM_S2 6 0 20000 DEPOSIT ABSOLUTE FORMAT "%2.0" AXIS_PTS_REF SSTW_DKKD_BPLOTHER /end AXIS_DESCR
 FORMAT "%3.1" /end CHARACTERISTIC
/begin CHARACTERISTIC XGKLY6W_DKKD_BPLOTHERA_1 "" CURVE 0x1DDE04 _REC_A1CUR_1_u2_u2_S2 110 _CNV_R_R_Umr_10_zu__9_CM_S2 0 110
 /begin AXIS_DESCR COM_AXIS N_AB _CNV_R_R_Umr_1_zu_1_3_CM_S2 6 0 20000 DEPOSIT ABSOLUTE FORMAT "%2.0" AXIS_PTS_REF SSTW_DKKD_BPLOTHER /end AXIS_DESCR
 FORMAT "%3.1" /end CHARACTERISTIC
/begin CHARACTERISTIC XGKLY6W_DKKD_BPLOTHERA_2 "" CURVE 0x1DDE10 _REC_A1CUR_1_u2_u2_S2 110 _CNV_R_R_Umr_10_zu__9_CM_S2 0 110
 /begin AXIS_DESCR COM_AXIS N_AB _CNV_R_R_Umr_1_zu_1_3_CM_S2 6 0 20000 DEPOSIT ABSOLUTE FORMAT "%2.0" AXIS_PTS_REF SSTW_DKKD_BPLOTHER /end AXIS_DESCR
 FORMAT "%3.1" /end CHARACTERISTIC
/begin CHARACTERISTIC XGKLY6W_DKKD_BPLOTHERS_0 "" CURVE 0x1DDE1C _REC_A1CUR_1_u2_u2_S2 110 _CNV_R_R_Umr_10_zu__9_CM_S2 0 110
 /begin AXIS_DESCR COM_AXIS N_AB _CNV_R_R_Umr_1_zu_1_3_CM_S2 6 0 20000 DEPOSIT ABSOLUTE FORMAT "%2.0" AXIS_PTS_REF SSTW_DKKD_BPLOTHER /end AXIS_DESCR
 FORMAT "%3.1" /end CHARACTERISTIC
/begin CHARACTERISTIC XGKLY6W_DKKD_BPLOTHERS_1 "" CURVE 0x1DDE28 _REC_A1CUR_1_u2_u2_S2 110 _CNV_R_R_Umr_10_zu__9_CM_S2 0 110
 /begin AXIS_DESCR COM_AXIS N_AB _CNV_R_R_Umr_1_zu_1_3_CM_S2 6 0 20000 DEPOSIT ABSOLUTE FORMAT "%2.0" AXIS_PTS_REF SSTW_DKKD_BPLOTHER /end AXIS_DESCR
 FORMAT "%3.1" /end CHARACTERISTIC
/begin CHARACTERISTIC XGKLY6W_DKKD_BPLOTHERS_2 "" CURVE 0x1DDE34 _REC_A1CUR_1_u2_u2_S2 110 _CNV_R_R_Umr_10_zu__9_CM_S2 0 110
 /begin AXIS_DESCR COM_AXIS N_AB _CNV_R_R_Umr_1_zu_1_3_CM_S2 6 0 20000 DEPOSIT ABSOLUTE FORMAT "%2.0" AXIS_PTS_REF SSTW_DKKD_BPLOTHER /end AXIS_DESCR
 FORMAT "%3.1" /end CHARACTERISTIC
/begin CHARACTERISTIC XGM_LDM_SOLLFILT_OUTGEW "" VALUE 0x1DF348 _REC_S1VAL_1_s2_S2 250 _CNV_R_R_Umr_1_zu_1_2_CM_S2 0 250 FORMAT "%2.0" /end CHARACTERISTIC
/begin CHARACTERISTIC XGN_DYNDZM_PHASE1 "" VALUE 0x1D9536 _REC_S1VAL_1_u1_S2 249 _CNV_R_R_Umr_1_zu_1_3_CM_S2 1 250 FORMAT "%2.0" /end CHARACTERISTIC
/begin CHARACTERISTIC XGN_DYNDZM_PHASE6 "" VALUE 0x1D97A3 _REC_S1VAL_1_u1_S2 249 _CNV_R_R_Umr_1_zu_1_3_CM_S2 1 250 FORMAT "%2.0" /end CHARACTERISTIC
/begin CHARACTERISTIC XGN_T_INGEW "" VALUE 0x1DECDC _REC_S1VAL_1_s2_S2 10000 _CNV_R_R_Umr_1_zu_1_2_CM_S2 0 10000 FORMAT "%2.0" /end CHARACTERISTIC
/begin CHARACTERISTIC XGN_T_OUTGEW "" VALUE 0x1DECDE _REC_S1VAL_1_s2_S2 10000 _CNV_R_R_Umr_1_zu_1_2_CM_S2 0 10000 FORMAT "%2.0" /end CHARACTERISTIC
/begin CHARACTERISTIC XGWFP_HSURE_GEWFILT "" VALUE 0x1DEAA6 _REC_S1VAL_1_s2_S2 65535 _CNV_R_R_Umr_1_zu_1_2_CM_S2 -32768 32767 FORMAT "%2.0" /end CHARACTERISTIC
/begin CHARACTERISTIC XGWFP_HSURE_GEWROH "" VALUE 0x1DEAA8 _REC_S1VAL_1_s2_S2 65535 _CNV_R_R_Umr_1_zu_1_2_CM_S2 -32768 32767 FORMAT "%2.0" /end CHARACTERISTIC
/begin CHARACTERISTIC XGW_FPFILT_DMRS_INGEW "" VALUE 0x1DE968 _REC_S1VAL_1_s2_S2 250 _CNV_R_R_Umr_1_zu_1_2_CM_S2 0 250 FORMAT "%2.0" /end CHARACTERISTIC
/begin CHARACTERISTIC XGW_FPFILT_DMRS_OUTGEW "" VALUE 0x1DE96A _REC_S1VAL_1_s2_S2 250 _CNV_R_R_Umr_1_zu_1_2_CM_S2 0 250 FORMAT "%2.0" /end CHARACTERISTIC
/begin CHARACTERISTIC XGW_FP_CR "" VALUE 0x1E25FE _REC_S1VAL_1_s2_S2 65535 _CNV_R_R_Umr_1_zu_1_7_CM_S2 -32768 32767 FORMAT "%2.0" /end CHARACTERISTIC
/begin CHARACTERISTIC XGW_FP_FILTSCHLEPP "" VALUE 0x1E2658 _REC_S1VAL_1_s2_S2 65535 _CNV_R_R_Umr_1_zu_1_7_CM_S2 -32768 32767 FORMAT "%2.0" /end CHARACTERISTIC
/begin CHARACTERISTIC XGW_FP_FILT_OUTGEW_SPA "" VALUE 0x1E20FC _REC_S1VAL_1_s2_S2 65535 _CNV_R_R_Umr_1_zu_1_2_CM_S2 -32768 32767 FORMAT "%2.0" /end CHARACTERISTIC
/begin CHARACTERISTIC XGW_FP_GEWFILT "" VALUE 0x1DEAAA _REC_S1VAL_1_s2_S2 65535 _CNV_R_R_Umr_1_zu_1_2_CM_S2 -32768 32767 FORMAT "%2.0" /end CHARACTERISTIC
/begin CHARACTERISTIC XGW_FP_GEWROH "" VALUE 0x1DEAAC _REC_S1VAL_1_s2_S2 65535 _CNV_R_R_Umr_1_zu_1_2_CM_S2 -32768 32767 FORMAT "%2.0" /end CHARACTERISTIC
/begin CHARACTERISTIC XHA_L_BERGANH "" VALUE 0x1DE80A _REC_S1VAL_1_s2_S2 6553.5 _CNV_R_R_Umr_10_zu__37_CM_S2 -3276.8 3276.7 FORMAT "%3.1" /end CHARACTERISTIC
/begin CHARACTERISTIC XHA_Q_EINLENK "" VALUE 0x1DF31A _REC_S1VAL_1_u2_S2 6553.5 _CNV_R_R_Umr_10_zu__37_CM_S2 0 6553.5 FORMAT "%3.1" /end CHARACTERISTIC
/begin CHARACTERISTIC XHA_Q_KURVE "" CURVE 0x1DF280 _REC_A1CUR_30_u2_u2_S2 6553.5 _CNV_R_R_Umr_10_zu__37_CM_S2 0 6553.5
 /begin AXIS_DESCR FIX_AXIS NO_INPUT_QUANTITY _CNV_S_5_Enum_EKURV_246_CM_S2 5 0 4 READ_ONLY FIX_AXIS_PAR_DIST 0 1 5 /end AXIS_DESCR
 FORMAT "%3.1" /end CHARACTERISTIC
/begin CHARACTERISTIC XHA_Q_SPA "" VALUE 0x1E20FE _REC_S1VAL_1_s2_S2 200 _CNV_R_R_Umr_10_zu__37_CM_S2 -100 100 FORMAT "%3.1" /end CHARACTERISTIC
/begin CHARACTERISTIC XHDM_RFWS_AUS_DBM "" VALUE 0x1DE37C _REC_S1VAL_1_s2_S2 65535 _CNV_R_R_Umr_1_zu_1_38_CM_S2 -32768 32767 FORMAT "%2.0" /end CHARACTERISTIC
/begin CHARACTERISTIC XHDN_SCHLUPF "" VALUE 0x1E20E8 _REC_S1VAL_1_u2_S2 20000 _CNV_R_R_Umr_1_zu_1_3_CM_S2 0 20000 FORMAT "%2.0" /end CHARACTERISTIC
/begin CHARACTERISTIC XHM_BR_SOLL_FESTBREMS "" VALUE 0x1DE8FC _REC_S1VAL_1_u2_S2 10000 _CNV_R_R_Umr_1_zu_1_38_CM_S2 0 10000 FORMAT "%2.0" /end CHARACTERISTIC
/begin CHARACTERISTIC XHM_BR_SPA "" VALUE 0x1E2100 _REC_S1VAL_1_s2_S2 10000 _CNV_R_R_Umr_1_zu_1_38_CM_S2 0 10000 FORMAT "%2.0" /end CHARACTERISTIC
/begin CHARACTERISTIC XHM_FZGSCHUB "" VALUE 0x1DECAE _REC_S1VAL_1_s2_S2 65535 _CNV_R_R_Umr_1_zu_1_38_CM_S2 -32768 32767 FORMAT "%2.0" /end CHARACTERISTIC
/begin CHARACTERISTIC XHM_FZGZUG "" VALUE 0x1DECB0 _REC_S1VAL_1_s2_S2 65535 _CNV_R_R_Umr_1_zu_1_38_CM_S2 -32768 32767 FORMAT "%2.0" /end CHARACTERISTIC
/begin CHARACTERISTIC XHM_MOT_FW_HKOR "" VALUE 0x1D9599 _REC_S1VAL_1_u1_S2 250 _CNV_R_R_Umr_1_zu_1_38_CM_S2 0 250 FORMAT "%2.0" /end CHARACTERISTIC
/begin CHARACTERISTIC XHM_RAD_WUNSCH_ZKA "" VALUE 0x1E2490 _REC_S1VAL_1_s2_S2 500 _CNV_R_R_Umr_1_zu_1_38_CM_S2 0 500 FORMAT "%2.0" /end CHARACTERISTIC
/begin CHARACTERISTIC XHN_AB_HSRS "" VALUE 0x1DE7AA _REC_S1VAL_1_u2_S2 20000 _CNV_R_R_Umr_1_zu_1_3_CM_S2 0 20000 FORMAT "%2.0" /end CHARACTERISTIC
/begin CHARACTERISTIC XHN_AB_TID_IM_STAND "" VALUE 0x1E3572 _REC_S1VAL_1_u2_S2 2000 _CNV_R_R_Umr_1_zu_1_3_CM_S2 0 2000 FORMAT "%2.0" /end CHARACTERISTIC
/begin CHARACTERISTIC XHN_T_WKANBIND "" VALUE 0x1DE41E _REC_S1VAL_1_u2_S2 8160 _CNV_R_R_Umr_1_zu_1_3_CM_S2 0 8160 FORMAT "%2.0" /end CHARACTERISTIC
/begin CHARACTERISTIC XHSCHN_T_CGT_DBM "" VALUE 0x1DE37E _REC_S1VAL_1_s2_S2 32000 _CNV_R_R_Umr_1_zu_1_3_CM_S2 0 32000 FORMAT "%2.0" /end CHARACTERISTIC
/begin CHARACTERISTIC XHSCHN_T_NMOTSOLLLL_DBM "" VALUE 0x1DE380 _REC_S1VAL_1_s2_S2 32000 _CNV_R_R_Umr_1_zu_1_3_CM_S2 0 32000 FORMAT "%2.0" /end CHARACTERISTIC
/begin CHARACTERISTIC XHSCHP_LUFT_HEISSHOCH "" VALUE 0x1E213A _REC_S1VAL_1_u2_S2 150 _CNV_R_R_Umr_1_zu_1_0_CM_S2 0 150 FORMAT "%2.0" /end CHARACTERISTIC
/begin CHARACTERISTIC XHSCHTEMP_UMG_DUE "" VALUE 0x1D97A1 _REC_S1VAL_1_u1_S2 250 _CNV_R_R_Umr_1_zu_1_1_CM_S2 0 250 FORMAT "%2.0" /end CHARACTERISTIC
/begin CHARACTERISTIC XHSCHTEMP_UMG_HEISSHOCH "" VALUE 0x1E213C _REC_S1VAL_1_u2_S2 20 _CNV_R_R_Umr_1_zu_1_1_CM_S2 0 20 FORMAT "%2.0" /end CHARACTERISTIC
/begin CHARACTERISTIC XHTEMP_GETR_ANFAHRENOBEN "" VALUE 0x1DE62A _REC_S1VAL_1_u2_S2 20 _CNV_R_R_Umr_1_zu_1_1_CM_S2 0 20 FORMAT "%2.0" /end CHARACTERISTIC
/begin CHARACTERISTIC XHV_FZG_HKOR "" VALUE 0x1DED38 _REC_S1VAL_1_u2_S2 400 _CNV_R_R_Umr_1_zu_1_8_CM_S2 0 400 FORMAT "%2.0" /end CHARACTERISTIC
/begin CHARACTERISTIC XHV_FZG_STEHTOBEN "" VALUE 0x1DECB2 _REC_S1VAL_1_u2_S2 400 _CNV_R_R_Umr_1_zu_1_8_CM_S2 0 400 FORMAT "%2.0" /end CHARACTERISTIC
/begin CHARACTERISTIC XHV_FZG_STEHTUNTEN "" VALUE 0x1DECB4 _REC_S1VAL_1_u2_S2 400 _CNV_R_R_Umr_1_zu_1_8_CM_S2 0 400 FORMAT "%2.0" /end CHARACTERISTIC
/begin CHARACTERISTIC XHW_DKKD_SPA "" VALUE 0x1E2102 _REC_S1VAL_1_u2_S2 200 _CNV_R_R_Umr_10_zu__9_CM_S2 0 200 FORMAT "%3.1" /end CHARACTERISTIC
/begin CHARACTERISTIC XHW_LWVA_EFF_EINLENK "" VALUE 0x1DF312 _REC_S1VAL_1_u2_S2 50 _CNV_R_R_Umr_10_zu__10_CM_S2 0 50 FORMAT "%3.1" /end CHARACTERISTIC
/begin CHARACTERISTIC XHW_LWVA_EFF_KURVE "" VALUE 0x1DF314 _REC_S1VAL_1_s2_S2 50 _CNV_R_R_Umr_10_zu__10_CM_S2 0 50 FORMAT "%3.1" /end CHARACTERISTIC
/begin CHARACTERISTIC XHW_LWVA_EFF_SERP "" VALUE 0x1DF316 _REC_S1VAL_1_s2_S2 50 _CNV_R_R_Umr_10_zu__10_CM_S2 0 50 FORMAT "%3.1" /end CHARACTERISTIC
/begin CHARACTERISTIC XHW_STEIGUNG_STEPS "" VALUE 0x1DE60C _REC_S1VAL_1_u2_S2 200 _CNV_R_R_Umr_10_zu__9_CM_S2 0 200 FORMAT "%3.1" /end CHARACTERISTIC
/begin CHARACTERISTIC XIG_VTHIGH "" VALUE 0x1DECB6 _REC_S1VAL_1_u2_S2 655.35 _CNV_R_R_Umr_100_zu_42_CM_S2 0 655.35 FORMAT "%4.2" /end CHARACTERISTIC
/begin CHARACTERISTIC XKLKORR_SCHGW_FP_DMRS_GANG4 "" CURVE 0x1E2892 _REC_S7CUR_53_u2_u2_S2 200 _CNV_R_R_Umr_1_zu_1_30_CM_S2 0 200
 /begin AXIS_DESCR STD_AXIS N_AB _CNV_R_R_Umr_1_zu_1_3_CM_S2 5 0 10000 DEPOSIT ABSOLUTE FORMAT "%2.0" /end AXIS_DESCR
 FORMAT "%2.0" /end CHARACTERISTIC
/begin CHARACTERISTIC XKLKORR_SCHGW_FP_DMRS_GANG5 "" CURVE 0x1E28A8 _REC_S7CUR_53_u2_u2_S2 200 _CNV_R_R_Umr_1_zu_1_30_CM_S2 0 200
 /begin AXIS_DESCR STD_AXIS N_AB _CNV_R_R_Umr_1_zu_1_3_CM_S2 5 0 10000 DEPOSIT ABSOLUTE FORMAT "%2.0" /end AXIS_DESCR
 FORMAT "%2.0" /end CHARACTERISTIC
/begin CHARACTERISTIC XKLKORR_SCHGW_FP_DMRS_GANG6 "" CURVE 0x1E28BE _REC_S7CUR_53_u2_u2_S2 200 _CNV_R_R_Umr_1_zu_1_30_CM_S2 0 200
 /begin AXIS_DESCR STD_AXIS N_AB _CNV_R_R_Umr_1_zu_1_3_CM_S2 5 0 10000 DEPOSIT ABSOLUTE FORMAT "%2.0" /end AXIS_DESCR
 FORMAT "%2.0" /end CHARACTERISTIC
/begin CHARACTERISTIC XKLKORR_SCHGW_FP_DMRS_GANG7 "" CURVE 0x1E28D4 _REC_S7CUR_53_u2_u2_S2 200 _CNV_R_R_Umr_1_zu_1_30_CM_S2 0 200
 /begin AXIS_DESCR STD_AXIS N_AB _CNV_R_R_Umr_1_zu_1_3_CM_S2 5 0 10000 DEPOSIT ABSOLUTE FORMAT "%2.0" /end AXIS_DESCR
 FORMAT "%2.0" /end CHARACTERISTIC
/begin CHARACTERISTIC XKLKORR_SCHGW_FP_DMRS_GANG8 "" CURVE 0x1E28EA _REC_S7CUR_53_u2_u2_S2 200 _CNV_R_R_Umr_1_zu_1_30_CM_S2 0 200
 /begin AXIS_DESCR STD_AXIS N_AB _CNV_R_R_Umr_1_zu_1_3_CM_S2 5 0 10000 DEPOSIT ABSOLUTE FORMAT "%2.0" /end AXIS_DESCR
 FORMAT "%2.0" /end CHARACTERISTIC
/begin CHARACTERISTIC XKLKORR_SCHGW_FP_DMRS_GANG9 "" CURVE 0x1E2900 _REC_S7CUR_53_u2_u2_S2 200 _CNV_R_R_Umr_1_zu_1_30_CM_S2 0 200
 /begin AXIS_DESCR STD_AXIS N_AB _CNV_R_R_Umr_1_zu_1_3_CM_S2 5 0 10000 DEPOSIT ABSOLUTE FORMAT "%2.0" /end AXIS_DESCR
 FORMAT "%2.0" /end CHARACTERISTIC
/begin CHARACTERISTIC XKLY2X4C_SCHLEPP_FT_0 "" CURVE 0x1E2634 _REC_S7CUR_53_s2_s2_S2 65535 _CNV_R_R_Umr_1_zu_1_2_CM_S2 -32768 32767
 /begin AXIS_DESCR STD_AXIS C_SCHLEPP_FT _CNV_R_R_Umr_1_zu_1_2_CM_S2 4 0 32767 DEPOSIT ABSOLUTE FORMAT "%2.0" /end AXIS_DESCR
 FORMAT "%2.0" /end CHARACTERISTIC
/begin CHARACTERISTIC XKLY2X4C_SCHLEPP_FT_1 "" CURVE 0x1E2646 _REC_S7CUR_53_s2_s2_S2 65535 _CNV_R_R_Umr_1_zu_1_2_CM_S2 -32768 32767
 /begin AXIS_DESCR STD_AXIS C_SCHLEPP_FT _CNV_R_R_Umr_1_zu_1_2_CM_S2 4 0 32767 DEPOSIT ABSOLUTE FORMAT "%2.0" /end AXIS_DESCR
 FORMAT "%2.0" /end CHARACTERISTIC
/begin CHARACTERISTIC XKLY5DC_SCHLEPP_KURVEAAGS "" CURVE 0x1E2608 _REC_S7CUR_53_s2_s2_S2 65535 _CNV_R_R_Umr_1_zu_1_2_CM_S2 -32768 32767
 /begin AXIS_DESCR STD_AXIS A_Q_FILT _CNV_R_R_Umr_10_zu__37_CM_S2 5 -3276.8 3276.7 DEPOSIT ABSOLUTE FORMAT "%3.1" /end AXIS_DESCR
 FORMAT "%2.0" /end CHARACTERISTIC
/begin CHARACTERISTIC XKLY5DC_SCHLEPP_KURVESAGS "" CURVE 0x1E261E _REC_S7CUR_53_s2_s2_S2 65535 _CNV_R_R_Umr_1_zu_1_2_CM_S2 -32768 32767
 /begin AXIS_DESCR STD_AXIS A_Q_FILT _CNV_R_R_Umr_10_zu__37_CM_S2 5 -3276.8 3276.7 DEPOSIT ABSOLUTE FORMAT "%3.1" /end AXIS_DESCR
 FORMAT "%2.0" /end CHARACTERISTIC
/begin CHARACTERISTIC XKLY5DN_RAD_HAKURVE "" CURVE 0x1DE814 _REC_S7CUR_53_u2_u2_S2 20000 _CNV_R_R_Umr_1_zu_1_3_CM_S2 0 20000
 /begin AXIS_DESCR STD_AXIS MN_RAD_HA _CNV_R_R_Umr_1_zu_1_3_CM_S2 5 0 65535 DEPOSIT ABSOLUTE FORMAT "%2.0" /end AXIS_DESCR
 FORMAT "%2.0" /end CHARACTERISTIC
/begin CHARACTERISTIC XKLYSCHDN_SCHLUPF_HA "" CURVE 0x1DE82A _REC_S7CUR_53_u2_s2_S2 20000 _CNV_R_R_Umr_1_zu_1_3_CM_S2 0 20000
 /begin AXIS_DESCR STD_AXIS DN_RAD_HA _CNV_R_R_Umr_1_zu_1_3_CM_S2 6 0 20000 DEPOSIT ABSOLUTE FORMAT "%2.0" /end AXIS_DESCR
 FORMAT "%2.0" /end CHARACTERISTIC
/begin CHARACTERISTIC XKLYSCHDN_SCHLUPF_VA "" CURVE 0x1DE844 _REC_S7CUR_53_u2_s2_S2 20000 _CNV_R_R_Umr_1_zu_1_3_CM_S2 0 20000
 /begin AXIS_DESCR STD_AXIS DN_RAD_VA _CNV_R_R_Umr_1_zu_1_3_CM_S2 6 0 20000 DEPOSIT ABSOLUTE FORMAT "%2.0" /end AXIS_DESCR
 FORMAT "%2.0" /end CHARACTERISTIC
/begin CHARACTERISTIC XKLYSCHDN_SCHLUPF_VFZG "" CURVE 0x1DE85E _REC_S7CUR_53_u2_u2_S2 20000 _CNV_R_R_Umr_1_zu_1_3_CM_S2 0 20000
 /begin AXIS_DESCR STD_AXIS V_FZG _CNV_R_R_Umr_1_zu_1_8_CM_S2 7 0 400 DEPOSIT ABSOLUTE FORMAT "%2.0" /end AXIS_DESCR
 FORMAT "%2.0" /end CHARACTERISTIC
/begin CHARACTERISTIC XKL_DWDKKD_DMRS_0 "" CURVE 0x1E2916 _REC_S7CUR_53_s2_u2_S2 200 _CNV_R_R_Umr_1_zu_1_266_CM_S2 -100 100
 /begin AXIS_DESCR STD_AXIS N_AB _CNV_R_R_Umr_1_zu_1_3_CM_S2 8 0 20000 DEPOSIT ABSOLUTE FORMAT "%2.0" /end AXIS_DESCR
 FORMAT "%2.0" /end CHARACTERISTIC
/begin CHARACTERISTIC XKL_DWDKKD_DMRS_1 "" CURVE 0x1E2938 _REC_S7CUR_53_s2_u2_S2 200 _CNV_R_R_Umr_1_zu_1_266_CM_S2 -100 100
 /begin AXIS_DESCR STD_AXIS N_AB _CNV_R_R_Umr_1_zu_1_3_CM_S2 8 0 20000 DEPOSIT ABSOLUTE FORMAT "%2.0" /end AXIS_DESCR
 FORMAT "%2.0" /end CHARACTERISTIC
/begin CHARACTERISTIC XKL_DWDKKD_DMRS_2 "" CURVE 0x1E295A _REC_S7CUR_53_s2_u2_S2 200 _CNV_R_R_Umr_1_zu_1_266_CM_S2 -100 100
 /begin AXIS_DESCR STD_AXIS N_AB _CNV_R_R_Umr_1_zu_1_3_CM_S2 8 0 20000 DEPOSIT ABSOLUTE FORMAT "%2.0" /end AXIS_DESCR
 FORMAT "%2.0" /end CHARACTERISTIC
/begin CHARACTERISTIC XKL_DWDKKD_DMRS_3 "" CURVE 0x1E297C _REC_S7CUR_53_s2_u2_S2 200 _CNV_R_R_Umr_1_zu_1_266_CM_S2 -100 100
 /begin AXIS_DESCR STD_AXIS N_AB _CNV_R_R_Umr_1_zu_1_3_CM_S2 8 0 20000 DEPOSIT ABSOLUTE FORMAT "%2.0" /end AXIS_DESCR
 FORMAT "%2.0" /end CHARACTERISTIC
/begin CHARACTERISTIC XKL_DWDKKD_DMRS_4 "" CURVE 0x1E299E _REC_S7CUR_53_s2_u2_S2 200 _CNV_R_R_Umr_1_zu_1_266_CM_S2 -100 100
 /begin AXIS_DESCR STD_AXIS N_AB _CNV_R_R_Umr_1_zu_1_3_CM_S2 8 0 20000 DEPOSIT ABSOLUTE FORMAT "%2.0" /end AXIS_DESCR
 FORMAT "%2.0" /end CHARACTERISTIC
/begin CHARACTERISTIC XKL_DWDKKD_DMRS_5 "" CURVE 0x1E29C0 _REC_S7CUR_53_s2_u2_S2 200 _CNV_R_R_Umr_1_zu_1_266_CM_S2 -100 100
 /begin AXIS_DESCR STD_AXIS N_AB _CNV_R_R_Umr_1_zu_1_3_CM_S2 8 0 20000 DEPOSIT ABSOLUTE FORMAT "%2.0" /end AXIS_DESCR
 FORMAT "%2.0" /end CHARACTERISTIC
/begin CHARACTERISTIC XKL_DWDKKD_DMRS_6 "" CURVE 0x1E29E2 _REC_S7CUR_53_s2_u2_S2 200 _CNV_R_R_Umr_1_zu_1_266_CM_S2 -100 100
 /begin AXIS_DESCR STD_AXIS N_AB _CNV_R_R_Umr_1_zu_1_3_CM_S2 8 0 20000 DEPOSIT ABSOLUTE FORMAT "%2.0" /end AXIS_DESCR
 FORMAT "%2.0" /end CHARACTERISTIC
/begin CHARACTERISTIC XKL_DWDKKD_DMRS_7 "" CURVE 0x1E2A04 _REC_S7CUR_53_s2_u2_S2 200 _CNV_R_R_Umr_1_zu_1_266_CM_S2 -100 100
 /begin AXIS_DESCR STD_AXIS N_AB _CNV_R_R_Umr_1_zu_1_3_CM_S2 8 0 20000 DEPOSIT ABSOLUTE FORMAT "%2.0" /end AXIS_DESCR
 FORMAT "%2.0" /end CHARACTERISTIC
/begin CHARACTERISTIC XKL_DWDKKD_DMRS_8 "" CURVE 0x1E2A26 _REC_S7CUR_53_s2_u2_S2 200 _CNV_R_R_Umr_1_zu_1_266_CM_S2 -100 100
 /begin AXIS_DESCR STD_AXIS N_AB _CNV_R_R_Umr_1_zu_1_3_CM_S2 8 0 20000 DEPOSIT ABSOLUTE FORMAT "%2.0" /end AXIS_DESCR
 FORMAT "%2.0" /end CHARACTERISTIC
/begin CHARACTERISTIC XKL_DWDKKD_DMRS_9 "" CURVE 0x1E2A48 _REC_S7CUR_53_s2_u2_S2 200 _CNV_R_R_Umr_1_zu_1_266_CM_S2 -100 100
 /begin AXIS_DESCR STD_AXIS N_AB _CNV_R_R_Umr_1_zu_1_3_CM_S2 8 0 20000 DEPOSIT ABSOLUTE FORMAT "%2.0" /end AXIS_DESCR
 FORMAT "%2.0" /end CHARACTERISTIC
/begin CHARACTERISTIC XLASTWEFILT_DYNDZM_INGEW "" VALUE 0x1DEA8C _REC_S1VAL_1_u2_S2 65535 _CNV_R_R_Umr_1_zu_1_2_CM_S2 0 65535 FORMAT "%2.0" /end CHARACTERISTIC
/begin CHARACTERISTIC XLASTWEFILT_DYNDZM_OUTGEW "" VALUE 0x1DEA8E _REC_S1VAL_1_u2_S2 65535 _CNV_R_R_Umr_1_zu_1_2_CM_S2 0 65535 FORMAT "%2.0" /end CHARACTERISTIC
/begin CHARACTERISTIC XL_SPUR_VA "" VALUE 0x1DE8F6 _REC_S1VAL_1_u2_S2 65535 _CNV_R_R_Umr_1_zu_1_2_CM_S2 0 65535 FORMAT "%2.0" /end CHARACTERISTIC
/begin CHARACTERISTIC XMASSE_ANH "" VALUE 0x1E27A8 _REC_S1VAL_1_u2_S2 2000 _CNV_R_R_Umr_1_zu_1_214_CM_S2 0 2000 FORMAT "%2.0" /end CHARACTERISTIC
/begin CHARACTERISTIC XMASSE_FZG "" VALUE 0x1E27AA _REC_S1VAL_1_u2_S2 3200 _CNV_R_R_Umr_1_zu_1_214_CM_S2 800 4000 FORMAT "%2.0" /end CHARACTERISTIC
/begin CHARACTERISTIC XMASSE_FZG_EST_MAX "" VALUE 0x1E27AC _REC_S1VAL_1_u2_S2 5000 _CNV_R_R_Umr_1_zu_1_214_CM_S2 0 5000 FORMAT "%2.0" /end CHARACTERISTIC
/begin CHARACTERISTIC XMASSE_FZG_EST_MIN "" VALUE 0x1E27AE _REC_S1VAL_1_u2_S2 5000 _CNV_R_R_Umr_1_zu_1_214_CM_S2 0 5000 FORMAT "%2.0" /end CHARACTERISTIC
/begin CHARACTERISTIC XMASSE_FZG_FILTINGEW "" VALUE 0x1E27B0 _REC_S1VAL_1_s2_S2 65535 _CNV_R_R_Umr_1_zu_1_2_CM_S2 -32768 32767 FORMAT "%2.0" /end CHARACTERISTIC
/begin CHARACTERISTIC XMASSE_FZG_FILTOUTGEW "" VALUE 0x1E27B2 _REC_S1VAL_1_s2_S2 65535 _CNV_R_R_Umr_1_zu_1_2_CM_S2 -32768 32767 FORMAT "%2.0" /end CHARACTERISTIC
/begin CHARACTERISTIC XMUE_DYN_MUELOW_SEQUENZER "" VALUE 0x1DF41E _REC_S1VAL_1_u2_S2 10 _CNV_R_R_Umr_1000_z_36_CM_S2 0 10 FORMAT "%5.3" /end CHARACTERISTIC
/begin CHARACTERISTIC XMUE_GRENZ_MUELOWAUSMUE "" VALUE 0x1DF44C _REC_S1VAL_1_u2_S2 2 _CNV_R_R_Umr_1000_z_36_CM_S2 0 2 FORMAT "%5.3" /end CHARACTERISTIC
/begin CHARACTERISTIC XM_AB_REKUPMAX_FILTINGEW "" VALUE 0x1E24E8 _REC_S1VAL_1_u2_S2 5000 _CNV_R_R_Umr_1_zu_1_2_CM_S2 0 5000 /end CHARACTERISTIC
/begin CHARACTERISTIC XM_AB_REKUPMAX_FILTOUTGEW "" VALUE 0x1E24EA _REC_S1VAL_1_u2_S2 5000 _CNV_R_R_Umr_1_zu_1_2_CM_S2 0 5000 /end CHARACTERISTIC
/begin CHARACTERISTIC XM_COMPRISE_SSINITDEF "" VALUE 0x1DE3CE _REC_S1VAL_1_u2_S2 4095 _CNV_R_R_Umr_1_zu_1_2_CM_S2 0 4095 /end CHARACTERISTIC
/begin CHARACTERISTIC XM_EM1_MIN_ZKA "" VALUE 0x1E2224 _REC_S1VAL_1_s2_S2 500 _CNV_R_R_Umr_1_zu_1_38_CM_S2 -500 0 FORMAT "%2.0" /end CHARACTERISTIC
/begin CHARACTERISTIC XM_MOTFW_FILT_INGEW "" VALUE 0x1D959A _REC_S1VAL_1_u1_S2 250 _CNV_R_R_Umr_1_zu_1_2_CM_S2 0 250 FORMAT "%2.0" /end CHARACTERISTIC
/begin CHARACTERISTIC XM_MOTFW_FILT_OUTGEW "" VALUE 0x1D959B _REC_S1VAL_1_u1_S2 250 _CNV_R_R_Umr_1_zu_1_2_CM_S2 0 250 FORMAT "%2.0" /end CHARACTERISTIC
/begin CHARACTERISTIC XM_MOT_MIN_ZKA "" VALUE 0x1DD608 _REC_S1VAL_1_s4_S2 200 _CNV_R_R_Umr_1_zu_1_2_CM_S2 -200 0 FORMAT "%2.0" /end CHARACTERISTIC
/begin CHARACTERISTIC XN_AB_FILT_INGEW "" VALUE 0x1DECD0 _REC_S1VAL_1_u2_S2 250 _CNV_R_R_Umr_1_zu_1_2_CM_S2 0 250 FORMAT "%2.0" /end CHARACTERISTIC
/begin CHARACTERISTIC XN_AB_FILT_OUTGEW "" VALUE 0x1DECD2 _REC_S1VAL_1_u2_S2 250 _CNV_R_R_Umr_1_zu_1_2_CM_S2 0 250 FORMAT "%2.0" /end CHARACTERISTIC
/begin CHARACTERISTIC XN_AB_INGEW "" VALUE 0x1DE628 _REC_S1VAL_1_u2_S2 250 _CNV_R_R_Umr_1_zu_1_2_CM_S2 0 250 FORMAT "%2.0" /end CHARACTERISTIC
/begin CHARACTERISTIC XN_DYNDZM_SSINITDEF "" VALUE 0x1DE3D4 _REC_S1VAL_1_u2_S2 4095 _CNV_R_R_Umr_1_zu_1_2_CM_S2 0 4095 /end CHARACTERISTIC
/begin CHARACTERISTIC XN_MOTGEW_DYNHSPV "" VALUE 0x1D963E _REC_S1VAL_1_u1_S2 250 _CNV_R_R_Umr_1_zu_1_2_CM_S2 0 250 FORMAT "%2.0" /end CHARACTERISTIC
/begin CHARACTERISTIC XN_MOTTURGEW_DYNHSPV "" VALUE 0x1D963F _REC_S1VAL_1_u1_S2 250 _CNV_R_R_Umr_1_zu_1_2_CM_S2 0 250 FORMAT "%2.0" /end CHARACTERISTIC
/begin CHARACTERISTIC XN_MOT_SOLLLL_STEPTR "" VALUE 0x1DE60E _REC_S1VAL_1_u2_S2 3000 _CNV_P_2_A_I_140_CM_S2 0 3000 FORMAT "%2.0" /end CHARACTERISTIC
/begin CHARACTERISTIC XN_TURGEW_DYNHSPV "" VALUE 0x1D9640 _REC_S1VAL_1_u1_S2 250 _CNV_R_R_Umr_1_zu_1_2_CM_S2 0 250 FORMAT "%2.0" /end CHARACTERISTIC
/begin CHARACTERISTIC XN_TURRADGEW_DYNHSPV "" VALUE 0x1D9641 _REC_S1VAL_1_u1_S2 250 _CNV_R_R_Umr_1_zu_1_2_CM_S2 0 250 FORMAT "%2.0" /end CHARACTERISTIC
/begin CHARACTERISTIC XOC_FT_MAX "" VALUE 0x1E2600 _REC_S1VAL_1_s2_S2 65535 _CNV_R_R_Umr_1_zu_1_2_CM_S2 -32768 32767 FORMAT "%2.0" /end CHARACTERISTIC
/begin CHARACTERISTIC XODM_RFWS_ROLLE_DBM "" VALUE 0x1DE382 _REC_S1VAL_1_s2_S2 32767 _CNV_R_R_Umr_1_zu_1_38_CM_S2 0 32767 FORMAT "%2.0" /end CHARACTERISTIC
/begin CHARACTERISTIC XOM_EMLAD_HSVERZ "" VALUE 0x1DE90A _REC_S1VAL_1_s2_S2 100 _CNV_R_R_Umr_1_zu_1_38_CM_S2 0 100 FORMAT "%2.0" /end CHARACTERISTIC
/begin CHARACTERISTIC XOM_RAD_OPTSCHUB_ZKA "" VALUE 0x1E2492 _REC_S1VAL_1_u2_S2 65535 _CNV_R_R_Umr_1_zu_1_38_CM_S2 0 65535 FORMAT "%2.0" /end CHARACTERISTIC
/begin CHARACTERISTIC XOM_RAD_OPT_ZKA "" VALUE 0x1E2494 _REC_S1VAL_1_u2_S2 65535 _CNV_R_R_Umr_1_zu_1_38_CM_S2 0 65535 FORMAT "%2.0" /end CHARACTERISTIC
/begin CHARACTERISTIC XOM_RAD_REKUP_REKUPRS "" VALUE 0x1E20EA _REC_S1VAL_1_s2_S2 100 _CNV_R_R_Umr_1_zu_1_38_CM_S2 0 100 FORMAT "%2.0" /end CHARACTERISTIC
/begin CHARACTERISTIC XOM_REKUPRS_DBM "" VALUE 0x1DE384 _REC_S1VAL_1_s2_S2 1023 _CNV_R_R_Umr_1_zu_1_38_CM_S2 0 1023 FORMAT "%2.0" /end CHARACTERISTIC
/begin CHARACTERISTIC XON_AB_DELTANMOTHS_RESET "" VALUE 0x1DE7AC _REC_S1VAL_1_u2_S2 10000 _CNV_R_R_Umr_1_zu_1_3_CM_S2 0 10000 FORMAT "%2.0" /end CHARACTERISTIC
/begin CHARACTERISTIC XON_SCHLUPF_MDS "" VALUE 0x1DF418 _REC_S1VAL_1_u2_S2 3000 _CNV_R_R_Umr_1_zu_1_3_CM_S2 0 3000 FORMAT "%2.0" /end CHARACTERISTIC
/begin CHARACTERISTIC XOW_STEIGUNG_BABEIN "" VALUE 0x1DE7BA _REC_S1VAL_1_s2_S2 200 _CNV_R_R_Umr_10_zu__9_CM_S2 -200 0 FORMAT "%3.1" /end CHARACTERISTIC
/begin CHARACTERISTIC XP_LUFT_NORM "" VALUE 0x1DED3A _REC_S1VAL_1_u2_S2 510 _CNV_R_R_Umr_1_zu_1_0_CM_S2 598 1108 FORMAT "%2.0" /end CHARACTERISTIC
/begin CHARACTERISTIC XP_LUFT_SIMULATE "" VALUE 0x1DF340 _REC_S1VAL_1_u2_S2 700 _CNV_R_R_Umr_1_zu_1_0_CM_S2 500 1200 FORMAT "%2.0" /end CHARACTERISTIC
/begin CHARACTERISTIC XS12 "" CURVE 0x1E11A2 _REC_A1CUR_1_u2_u2_S2 15000 _CNV_R_R_Umr_1_zu_1_3_CM_S2 0 15000
 /begin AXIS_DESCR COM_AXIS W_DKKD _CNV_R_R_Umr_10_zu__9_CM_S2 15 0 120 DEPOSIT ABSOLUTE FORMAT "%3.1" AXIS_PTS_REF SSTSKL_XS /end AXIS_DESCR
 FORMAT "%2.0" /end CHARACTERISTIC
/begin CHARACTERISTIC XS21 "" CURVE 0x1E11C0 _REC_A1CUR_1_u2_u2_S2 15000 _CNV_R_R_Umr_1_zu_1_3_CM_S2 0 15000
 /begin AXIS_DESCR COM_AXIS W_DKKD _CNV_R_R_Umr_10_zu__9_CM_S2 15 0 120 DEPOSIT ABSOLUTE FORMAT "%3.1" AXIS_PTS_REF SSTSKL_XS /end AXIS_DESCR
 FORMAT "%2.0" /end CHARACTERISTIC
/begin CHARACTERISTIC XS23 "" CURVE 0x1E11DE _REC_A1CUR_1_u2_u2_S2 15000 _CNV_R_R_Umr_1_zu_1_3_CM_S2 0 15000
 /begin AXIS_DESCR COM_AXIS W_DKKD _CNV_R_R_Umr_10_zu__9_CM_S2 15 0 120 DEPOSIT ABSOLUTE FORMAT "%3.1" AXIS_PTS_REF SSTSKL_XS /end AXIS_DESCR
 FORMAT "%2.0" /end CHARACTERISTIC
/begin CHARACTERISTIC XS32 "" CURVE 0x1E11FC _REC_A1CUR_1_u2_u2_S2 15000 _CNV_R_R_Umr_1_zu_1_3_CM_S2 0 15000
 /begin AXIS_DESCR COM_AXIS W_DKKD _CNV_R_R_Umr_10_zu__9_CM_S2 15 0 120 DEPOSIT ABSOLUTE FORMAT "%3.1" AXIS_PTS_REF SSTSKL_XS /end AXIS_DESCR
 FORMAT "%2.0" /end CHARACTERISTIC
/begin CHARACTERISTIC XS34 "" CURVE 0x1E121A _REC_A1CUR_1_u2_u2_S2 15000 _CNV_R_R_Umr_1_zu_1_3_CM_S2 0 15000
 /begin AXIS_DESCR COM_AXIS W_DKKD _CNV_R_R_Umr_10_zu__9_CM_S2 15 0 120 DEPOSIT ABSOLUTE FORMAT "%3.1" AXIS_PTS_REF SSTSKL_XS /end AXIS_DESCR
 FORMAT "%2.0" /end CHARACTERISTIC
/begin CHARACTERISTIC XS43 "" CURVE 0x1E1238 _REC_A1CUR_1_u2_u2_S2 15000 _CNV_R_R_Umr_1_zu_1_3_CM_S2 0 15000
 /begin AXIS_DESCR COM_AXIS W_DKKD _CNV_R_R_Umr_10_zu__9_CM_S2 15 0 120 DEPOSIT ABSOLUTE FORMAT "%3.1" AXIS_PTS_REF SSTSKL_XS /end AXIS_DESCR
 FORMAT "%2.0" /end CHARACTERISTIC
/begin CHARACTERISTIC XS45 "" CURVE 0x1E1256 _REC_A1CUR_1_u2_u2_S2 15000 _CNV_R_R_Umr_1_zu_1_3_CM_S2 0 15000
 /begin AXIS_DESCR COM_AXIS W_DKKD _CNV_R_R_Umr_10_zu__9_CM_S2 15 0 120 DEPOSIT ABSOLUTE FORMAT "%3.1" AXIS_PTS_REF SSTSKL_XS /end AXIS_DESCR
 FORMAT "%2.0" /end CHARACTERISTIC
/begin CHARACTERISTIC XS54 "" CURVE 0x1E1274 _REC_A1CUR_1_u2_u2_S2 15000 _CNV_R_R_Umr_1_zu_1_3_CM_S2 0 15000
 /begin AXIS_DESCR COM_AXIS W_DKKD _CNV_R_R_Umr_10_zu__9_CM_S2 15 0 120 DEPOSIT ABSOLUTE FORMAT "%3.1" AXIS_PTS_REF SSTSKL_XS /end AXIS_DESCR
 FORMAT "%2.0" /end CHARACTERISTIC
/begin CHARACTERISTIC XS56 "" CURVE 0x1E1292 _REC_A1CUR_1_u2_u2_S2 15000 _CNV_R_R_Umr_1_zu_1_3_CM_S2 0 15000
 /begin AXIS_DESCR COM_AXIS W_DKKD _CNV_R_R_Umr_10_zu__9_CM_S2 15 0 120 DEPOSIT ABSOLUTE FORMAT "%3.1" AXIS_PTS_REF SSTSKL_XS /end AXIS_DESCR
 FORMAT "%2.0" /end CHARACTERISTIC
/begin CHARACTERISTIC XS65 "" CURVE 0x1E12B0 _REC_A1CUR_1_u2_u2_S2 15000 _CNV_R_R_Umr_1_zu_1_3_CM_S2 0 15000
 /begin AXIS_DESCR COM_AXIS W_DKKD _CNV_R_R_Umr_10_zu__9_CM_S2 15 0 120 DEPOSIT ABSOLUTE FORMAT "%3.1" AXIS_PTS_REF SSTSKL_XS /end AXIS_DESCR
 FORMAT "%2.0" /end CHARACTERISTIC
/begin CHARACTERISTIC XS67 "" CURVE 0x1E177E _REC_A1CUR_1_u2_u2_S2 15000 _CNV_R_R_Umr_1_zu_1_3_CM_S2 0 15000
 /begin AXIS_DESCR COM_AXIS W_DKKD _CNV_R_R_Umr_10_zu__9_CM_S2 15 0 120 DEPOSIT ABSOLUTE FORMAT "%3.1" AXIS_PTS_REF SSTSKL_XS /end AXIS_DESCR
 FORMAT "%2.0" /end CHARACTERISTIC
/begin CHARACTERISTIC XS76 "" CURVE 0x1E179C _REC_A1CUR_1_u2_u2_S2 15000 _CNV_R_R_Umr_1_zu_1_3_CM_S2 0 15000
 /begin AXIS_DESCR COM_AXIS W_DKKD _CNV_R_R_Umr_10_zu__9_CM_S2 15 0 120 DEPOSIT ABSOLUTE FORMAT "%3.1" AXIS_PTS_REF SSTSKL_XS /end AXIS_DESCR
 FORMAT "%2.0" /end CHARACTERISTIC
/begin CHARACTERISTIC XS78 "" CURVE 0x1E1C6A _REC_A1CUR_1_u2_u2_S2 15000 _CNV_R_R_Umr_1_zu_1_3_CM_S2 0 15000
 /begin AXIS_DESCR COM_AXIS W_DKKD _CNV_R_R_Umr_10_zu__9_CM_S2 15 0 120 DEPOSIT ABSOLUTE FORMAT "%3.1" AXIS_PTS_REF SSTSKL_XS /end AXIS_DESCR
 FORMAT "%2.0" /end CHARACTERISTIC
/begin CHARACTERISTIC XS87 "" CURVE 0x1E1C88 _REC_A1CUR_1_u2_u2_S2 15000 _CNV_R_R_Umr_1_zu_1_3_CM_S2 0 15000
 /begin AXIS_DESCR COM_AXIS W_DKKD _CNV_R_R_Umr_10_zu__9_CM_S2 15 0 120 DEPOSIT ABSOLUTE FORMAT "%3.1" AXIS_PTS_REF SSTSKL_XS /end AXIS_DESCR
 FORMAT "%2.0" /end CHARACTERISTIC
/begin CHARACTERISTIC XSCHA_FZGMIN_ABS "" VALUE 0x1DF44E _REC_S1VAL_1_u2_S2 6553.5 _CNV_R_R_Umr_10_zu__37_CM_S2 0 6553.5 FORMAT "%3.1" /end CHARACTERISTIC
/begin CHARACTERISTIC XSCHA_FZGMIN_LVMUELOW "" VALUE 0x1DF450 _REC_S1VAL_1_u2_S2 6553.5 _CNV_R_R_Umr_10_zu__37_CM_S2 0 6553.5 FORMAT "%3.1" /end CHARACTERISTIC
/begin CHARACTERISTIC XSCHA_FZG_MAXMUELOW "" VALUE 0x1DF452 _REC_S1VAL_1_u2_S2 6553.5 _CNV_R_R_Umr_10_zu__37_CM_S2 0 6553.5 FORMAT "%3.1" /end CHARACTERISTIC
/begin CHARACTERISTIC XSCHA_FZG_MUELOWAUS "" VALUE 0x1DF454 _REC_S1VAL_1_u2_S2 6553.5 _CNV_R_R_Umr_10_zu__37_CM_S2 0 6553.5 FORMAT "%3.1" /end CHARACTERISTIC
/begin CHARACTERISTIC XSCHA_L_BERGANH "" VALUE 0x1DE80C _REC_S1VAL_1_s2_S2 6553.5 _CNV_R_R_Umr_10_zu__37_CM_S2 -3276.8 3276.7 FORMAT "%3.1" /end CHARACTERISTIC
/begin CHARACTERISTIC XSCHA_L_MUELOWOFF "" VALUE 0x1DF456 _REC_S1VAL_1_s2_S2 6553.5 _CNV_R_R_Umr_10_zu__37_CM_S2 -3276.8 3276.7 FORMAT "%3.1" /end CHARACTERISTIC
/begin CHARACTERISTIC XSCHA_Q_FILTREF "" VALUE 0x1DE8F8 _REC_S1VAL_1_s2_S2 6553.5 _CNV_R_R_Umr_10_zu__37_CM_S2 -3276.8 3276.7 FORMAT "%3.1" /end CHARACTERISTIC
/begin CHARACTERISTIC XSCHA_Q_SPA "" VALUE 0x1E2104 _REC_S1VAL_1_s2_S2 200 _CNV_R_R_Umr_10_zu__37_CM_S2 -100 100 FORMAT "%3.1" /end CHARACTERISTIC
/begin CHARACTERISTIC XSCHA_RAD_ABS "" VALUE 0x1DECB8 _REC_S1VAL_1_s2_S2 65535 _CNV_R_R_Umr_1_zu_1_205_CM_S2 -32768 32767 FORMAT "%3.1" /end CHARACTERISTIC
/begin CHARACTERISTIC XSCHA_SCHUBZUG_ZKA "" VALUE 0x1E2496 _REC_S1VAL_1_s2_S2 6553.5 _CNV_R_R_Umr_10_zu__37_CM_S2 -3276.8 3276.7 FORMAT "%2.0" /end CHARACTERISTIC
/begin CHARACTERISTIC XSCHA_STEIGUNG_FILT "" VALUE 0x1E2128 _REC_S1VAL_1_s2_S2 2047.97 _CNV_R_R_Umr_32_zu__147_CM_S2 -1024 1023.96875 FORMAT "%4.2" /end CHARACTERISTIC
/begin CHARACTERISTIC XSCHA_ZUGSCHUB_ZKA "" VALUE 0x1E2498 _REC_S1VAL_1_s2_S2 6553.5 _CNV_R_R_Umr_10_zu__37_CM_S2 -3276.8 3276.7 FORMAT "%2.0" /end CHARACTERISTIC
/begin CHARACTERISTIC XSCHBERGANH_SERP "" VALUE 0x1D912F _REC_S1VAL_1_u1_S2 5 _CNV_S_6_Enum_EBERG_47_CM_S2 0 5 /end CHARACTERISTIC
/begin CHARACTERISTIC XSCHC_FILT_LENGTHG2WAB "" VALUE 0x1DECD4 _REC_S1VAL_1_u2_S2 8 _CNV_R_R_Umr_1_zu_1_2_CM_S2 1 9 FORMAT "%2.0" /end CHARACTERISTIC
/begin CHARACTERISTIC XSCHC_FILT_LENGTHG2WABMED "" VALUE 0x1DECD6 _REC_S1VAL_1_u2_S2 8 _CNV_R_R_Umr_1_zu_1_2_CM_S2 1 9 FORMAT "%2.0" /end CHARACTERISTIC
/begin CHARACTERISTIC XSCHC_FILT_LENGTHGNT "" VALUE 0x1DECE0 _REC_S1VAL_1_u2_S2 15 _CNV_R_R_Umr_1_zu_1_2_CM_S2 1 16 FORMAT "%2.0" /end CHARACTERISTIC
/begin CHARACTERISTIC XSCHC_FILT_LENGTHGNTMED "" VALUE 0x1DECE2 _REC_S1VAL_1_u2_S2 16 _CNV_R_R_Umr_1_zu_1_2_CM_S2 1 17 FORMAT "%2.0" /end CHARACTERISTIC
/begin CHARACTERISTIC XSCHC_FILT_MEDTASK "" VALUE 0x1D958B _REC_S1VAL_1_u1_S2 254 _CNV_R_R_Umr_1_zu_1_2_CM_S2 1 255 FORMAT "%2.0" /end CHARACTERISTIC
/begin CHARACTERISTIC XSCHC_QWSTEIGUNG "" VALUE 0x1D971D _REC_S1VAL_1_u1_S2 255 _CNV_R_R_Umr_1_zu_1_2_CM_S2 0 255 FORMAT "%2.0" /end CHARACTERISTIC
/begin CHARACTERISTIC XSCHC_SCHLEPP_REFMAX "" VALUE 0x1E265A _REC_S1VAL_1_s2_S2 65535 _CNV_R_R_Umr_1_zu_1_2_CM_S2 -32768 32767 FORMAT "%2.0" /end CHARACTERISTIC
/begin CHARACTERISTIC XSCHDM_ABFWSMUELOWOFF "" VALUE 0x1DF458 _REC_S1VAL_1_s2_S2 1000 _CNV_R_R_Umr_1_zu_1_38_CM_S2 -500 500 FORMAT "%2.0" /end CHARACTERISTIC
/begin CHARACTERISTIC XSCHDM_ABFWS_DELTA_RSUBGH "" VALUE 0x1E20EE _REC_S1VAL_1_s2_S2 250 _CNV_R_R_Umr_1_zu_1_38_CM_S2 0 250 FORMAT "%2.0" /end CHARACTERISTIC
/begin CHARACTERISTIC XSCHDM_ABFWS_MAX_MSA "" VALUE 0x1DE3D8 _REC_S1VAL_1_s2_S2 20000 _CNV_R_R_Umr_1_zu_1_38_CM_S2 -10000 10000 FORMAT "%2.0" /end CHARACTERISTIC
/begin CHARACTERISTIC XSCHDM_ABFWS_MIN_MSA "" VALUE 0x1DE3DA _REC_S1VAL_1_s2_S2 20000 _CNV_R_R_Umr_1_zu_1_38_CM_S2 -10000 10000 FORMAT "%2.0" /end CHARACTERISTIC
/begin CHARACTERISTIC XSCHG2W_AB_ZRS_STEP "" VALUE 0x1DE610 _REC_S1VAL_1_s2_S2 3000 _CNV_R_R_Umr_10_zu__138_CM_S2 -3000 0 FORMAT "%3.1" /end CHARACTERISTIC
/begin CHARACTERISTIC XSCHG2W_MARS_AUS "" VALUE 0x1DF38A _REC_S1VAL_1_s2_S2 3276.8 _CNV_R_R_Umr_10_zu__138_CM_S2 -3276.8 0 FORMAT "%3.1" /end CHARACTERISTIC
/begin CHARACTERISTIC XSCHG2W_MARS_EIN "" VALUE 0x1DF38C _REC_S1VAL_1_s2_S2 3276.8 _CNV_R_R_Umr_10_zu__138_CM_S2 -3276.8 0 FORMAT "%2.0" /end CHARACTERISTIC
/begin CHARACTERISTIC XSCHGN_MTTRAD_MAX "" VALUE 0x1DF698 _REC_S1VAL_1_s2_S2 100 _CNV_R_R_Umr_100_zu_194_CM_S2 0 100 FORMAT "%4.2" /end CHARACTERISTIC
/begin CHARACTERISTIC XSCHGW_FPFILT_RSUBGH "" VALUE 0x1E20F0 _REC_S1VAL_1_s2_S2 2500 _CNV_R_R_Umr_1_zu_1_7_CM_S2 0 2500 FORMAT "%2.0" /end CHARACTERISTIC
/begin CHARACTERISTIC XSCHGW_FPWLSPV "" VALUE 0x1E2198 _REC_S1VAL_1_s2_S2 65535 _CNV_R_R_Umr_1_zu_1_7_CM_S2 -32768 32767 FORMAT "%2.0" /end CHARACTERISTIC
/begin CHARACTERISTIC XSCHGW_FP_BPLBEW "" VALUE 0x1E359C _REC_S1VAL_1_s2_S2 65535 _CNV_R_R_Umr_1_zu_1_7_CM_S2 -32768 32767 FORMAT "%2.0" /end CHARACTERISTIC
/begin CHARACTERISTIC XSCHGW_FP_HSURE_BRS "" VALUE 0x1DED8A _REC_S1VAL_1_s2_S2 10000 _CNV_R_R_Umr_1_zu_1_7_CM_S2 0 10000 /end CHARACTERISTIC
/begin CHARACTERISTIC XSCHGW_FP_LASTWE_NEG_DYNDZM "" VALUE 0x1DEA90 _REC_S1VAL_1_s2_S2 65535 _CNV_R_R_Umr_1_zu_1_7_CM_S2 -32768 32767 FORMAT "%2.0" /end CHARACTERISTIC
/begin CHARACTERISTIC XSCHGW_FP_LASTWE_POS_DYNDZM "" VALUE 0x1DEA92 _REC_S1VAL_1_s2_S2 65535 _CNV_R_R_Umr_1_zu_1_7_CM_S2 -32768 32767 FORMAT "%2.0" /end CHARACTERISTIC
/begin CHARACTERISTIC XSCHGW_FP_MAXFILTBPLBEW "" VALUE 0x1E359E _REC_S1VAL_1_s2_S2 65535 _CNV_R_R_Umr_1_zu_1_7_CM_S2 -32768 32767 FORMAT "%2.0" /end CHARACTERISTIC
/begin CHARACTERISTIC XSCHGW_FP_MFRSAUS_ZKA "" VALUE 0x1E249A _REC_S1VAL_1_s2_S2 4000 _CNV_R_R_Umr_1_zu_1_7_CM_S2 -2000 2000 FORMAT "%2.0" /end CHARACTERISTIC
/begin CHARACTERISTIC XSCHGW_FP_MFRSEIN_ZKA "" VALUE 0x1E249C _REC_S1VAL_1_s2_S2 2000 _CNV_R_R_Umr_1_zu_1_7_CM_S2 0 2000 FORMAT "%2.0" /end CHARACTERISTIC
/begin CHARACTERISTIC XSCHGW_FP_STOPGO "" VALUE 0x1E213E _REC_S1VAL_1_s2_S2 65535 _CNV_R_R_Umr_1_zu_1_7_CM_S2 -32768 32767 FORMAT "%2.0" /end CHARACTERISTIC
/begin CHARACTERISTIC XSCHGW_FP_VALIDFWSNEGATIV "" VALUE 0x1DEC96 _REC_S1VAL_1_s2_S2 10000 _CNV_R_R_Umr_1_zu_1_242_CM_S2 -10000 0 /end CHARACTERISTIC
/begin CHARACTERISTIC XSCHGW_FP_VALIDFWSPOSITIV "" VALUE 0x1DEC98 _REC_S1VAL_1_u2_S2 10000 _CNV_R_R_Umr_1_zu_1_242_CM_S2 0 10000 /end CHARACTERISTIC
/begin CHARACTERISTIC XSCHM_BR_ABS "" VALUE 0x1E27B4 _REC_S1VAL_1_s2_S2 65535 _CNV_R_R_Umr_1_zu_1_38_CM_S2 -32768 32767 FORMAT "%3.1" /end CHARACTERISTIC
/begin CHARACTERISTIC XSCHM_BR_MARS_AUS "" VALUE 0x1DF38E _REC_S1VAL_1_s2_S2 10000 _CNV_R_R_Umr_1_zu_1_38_CM_S2 -10000 0 FORMAT "%2.0" /end CHARACTERISTIC
/begin CHARACTERISTIC XSCHM_BR_MARS_EIN "" VALUE 0x1DF390 _REC_S1VAL_1_s2_S2 10000 _CNV_R_R_Umr_1_zu_1_38_CM_S2 -10000 0 FORMAT "%2.0" /end CHARACTERISTIC
/begin CHARACTERISTIC XSCHM_BR_SOLL_FESTBREMS "" VALUE 0x1DE8FE _REC_S1VAL_1_s2_S2 10000 _CNV_R_R_Umr_1_zu_1_38_CM_S2 -10000 0 FORMAT "%2.0" /end CHARACTERISTIC
/begin CHARACTERISTIC XSCHM_BR_SPA "" VALUE 0x1E2106 _REC_S1VAL_1_s2_S2 20000 _CNV_R_R_Umr_1_zu_1_38_CM_S2 -10000 10000 FORMAT "%2.0" /end CHARACTERISTIC
/begin CHARACTERISTIC XSCHM_BR_STEIGUNG "" VALUE 0x1E212A _REC_S1VAL_1_s2_S2 65535 _CNV_R_R_Umr_1_zu_1_38_CM_S2 -32768 32767 FORMAT "%2.0" /end CHARACTERISTIC
/begin CHARACTERISTIC XSCHM_EMLAD_HSVERZ "" VALUE 0x1DE90C _REC_S1VAL_1_s2_S2 500 _CNV_R_R_Umr_1_zu_1_38_CM_S2 -500 0 FORMAT "%2.0" /end CHARACTERISTIC
/begin CHARACTERISTIC XSCHM_RADMIN_LDMDYN_ZKA "" VALUE 0x1E249E _REC_S1VAL_1_s2_S2 2500 _CNV_R_R_Umr_1_zu_1_190_CM_S2 -2500 0 FORMAT "%2.0" /end CHARACTERISTIC
/begin CHARACTERISTIC XSCHM_RAD_HDCGH "" VALUE 0x1DED1A _REC_S1VAL_1_s2_S2 2000 _CNV_R_R_Umr_1_zu_1_38_CM_S2 -1000 1000 FORMAT "%2.0" /end CHARACTERISTIC
/begin CHARACTERISTIC XSCHM_RAD_REKUP_REKUPRS "" VALUE 0x1E20EC _REC_S1VAL_1_s2_S2 2046 _CNV_R_R_Umr_1_zu_1_38_CM_S2 -1023 1023 FORMAT "%2.0" /end CHARACTERISTIC
/begin CHARACTERISTIC XSCHM_RAD_SCHUBZUG_ZKA "" VALUE 0x1E24A0 _REC_S1VAL_1_s2_S2 65535 _CNV_R_R_Umr_1_zu_1_38_CM_S2 -32768 32767 FORMAT "%2.0" /end CHARACTERISTIC
/begin CHARACTERISTIC XSCHM_RAD_ZUGSCHUB_ZKA "" VALUE 0x1E24A2 _REC_S1VAL_1_s2_S2 65535 _CNV_R_R_Umr_1_zu_1_38_CM_S2 -32768 32767 FORMAT "%2.0" /end CHARACTERISTIC
/begin CHARACTERISTIC XSCHM_T_AUS_FLM "" VALUE 0x1DE62C _REC_S1VAL_1_s2_S2 64000 _CNV_R_R_Umr_1_zu_1_38_CM_S2 -32000 32000 FORMAT "%2.0" /end CHARACTERISTIC
/begin CHARACTERISTIC XSCHM_T_FESTBREMS "" VALUE 0x1DE900 _REC_S1VAL_1_s2_S2 64000 _CNV_R_R_Umr_1_zu_1_38_CM_S2 -32000 32000 FORMAT "%2.0" /end CHARACTERISTIC
/begin CHARACTERISTIC XSCHN_AB_AUS_FLM "" VALUE 0x1DE62E _REC_S1VAL_1_u2_S2 20000 _CNV_R_R_Umr_1_zu_1_3_CM_S2 0 20000 FORMAT "%2.0" /end CHARACTERISTIC
/begin CHARACTERISTIC XSCHN_AB_DYNDZM_ARS "" VALUE 0x1D8EBE _REC_S1VAL_1_u2_S2 10000 _CNV_R_R_Umr_1_zu_1_3_CM_S2 0 10000 FORMAT "%2.0" /end CHARACTERISTIC
/begin CHARACTERISTIC XSCHN_AB_EIN_FLM "" VALUE 0x1DE630 _REC_S1VAL_1_u2_S2 10000 _CNV_R_R_Umr_1_zu_1_3_CM_S2 0 10000 FORMAT "%2.0" /end CHARACTERISTIC
/begin CHARACTERISTIC XSCHN_AB_FWSVALID_MSAFZGSTOP "" VALUE 0x1DECA4 _REC_S1VAL_1_u2_S2 10000 _CNV_R_R_Umr_1_zu_1_3_CM_S2 0 10000 FORMAT "%2.0" /end CHARACTERISTIC
/begin CHARACTERISTIC XSCHN_AB_FWSVALID_MSASTART "" VALUE 0x1DECA6 _REC_S1VAL_1_u2_S2 10000 _CNV_R_R_Umr_1_zu_1_3_CM_S2 0 10000 FORMAT "%2.0" /end CHARACTERISTIC
/begin CHARACTERISTIC XSCHN_AB_GN_TRAD "" VALUE 0x1DF69A _REC_S1VAL_1_u2_S2 1000 _CNV_R_R_Umr_1_zu_1_3_CM_S2 0 1000 FORMAT "%2.0" /end CHARACTERISTIC
/begin CHARACTERISTIC XSCHN_AB_MIN_DYNDZM "" VALUE 0x1DEA94 _REC_S1VAL_1_u2_S2 20000 _CNV_R_R_Umr_1_zu_1_3_CM_S2 0 20000 FORMAT "%2.0" /end CHARACTERISTIC
/begin CHARACTERISTIC XSCHN_AB_QSHIFT "" VALUE 0x1DE3E2 _REC_S1VAL_1_u2_S2 20000 _CNV_R_R_Umr_1_zu_1_3_CM_S2 0 20000 FORMAT "%2.0" /end CHARACTERISTIC
/begin CHARACTERISTIC XSCHN_AB_TID_AUS "" VALUE 0x1E3574 _REC_S1VAL_1_u2_S2 20000 _CNV_R_R_Umr_1_zu_1_3_CM_S2 0 20000 FORMAT "%2.0" /end CHARACTERISTIC
/begin CHARACTERISTIC XSCHN_AB_VERW_N_MOT_DYNDZM "" VALUE 0x1DEA96 _REC_S1VAL_1_u2_S2 10000 _CNV_R_R_Umr_1_zu_1_2_CM_S2 0 10000 FORMAT "%2.0" /end CHARACTERISTIC
/begin CHARACTERISTIC XSCHN_AB_VERW_N_MOT_DYNDZM_MIN "" VALUE 0x1DEA98 _REC_S1VAL_1_u2_S2 10000 _CNV_R_R_Umr_1_zu_1_3_CM_S2 0 10000 FORMAT "%2.0" /end CHARACTERISTIC
/begin CHARACTERISTIC XSCHN_GEMAXAKT_VMSTART_DBM "" VALUE 0x1DE386 _REC_S1VAL_1_s2_S2 10000 _CNV_R_R_Umr_1_zu_1_3_CM_S2 0 10000 FORMAT "%2.0" /end CHARACTERISTIC
/begin CHARACTERISTIC XSCHN_GEMAXHI_VMSTART_DBM "" VALUE 0x1DE388 _REC_S1VAL_1_s2_S2 10000 _CNV_R_R_Umr_1_zu_1_3_CM_S2 0 10000 FORMAT "%2.0" /end CHARACTERISTIC
/begin CHARACTERISTIC XSCHN_GE_MAXGRENZ_DBM "" VALUE 0x1DE38A _REC_S1VAL_1_s2_S2 10000 _CNV_R_R_Umr_1_zu_1_3_CM_S2 0 10000 FORMAT "%2.0" /end CHARACTERISTIC
/begin CHARACTERISTIC XSCHN_GE_MINGRENZ_DBM "" VALUE 0x1DE38C _REC_S1VAL_1_s2_S2 10000 _CNV_R_R_Umr_1_zu_1_3_CM_S2 0 10000 FORMAT "%2.0" /end CHARACTERISTIC
/begin CHARACTERISTIC XSCHN_MAXAKT_EMHIGH_DBM "" VALUE 0x1DE38E _REC_S1VAL_1_s2_S2 65535 _CNV_R_R_Umr_1_zu_1_3_CM_S2 -32768 32767 FORMAT "%2.0" /end CHARACTERISTIC
/begin CHARACTERISTIC XSCHN_MAXAKT_EMLOW_DBM "" VALUE 0x1DE390 _REC_S1VAL_1_s2_S2 65535 _CNV_R_R_Umr_1_zu_1_3_CM_S2 -32768 32767 FORMAT "%2.0" /end CHARACTERISTIC
/begin CHARACTERISTIC XSCHN_MAXHI_EMHIGH_DBM "" VALUE 0x1DE392 _REC_S1VAL_1_s2_S2 65535 _CNV_R_R_Umr_1_zu_1_3_CM_S2 -32768 32767 FORMAT "%2.0" /end CHARACTERISTIC
/begin CHARACTERISTIC XSCHN_MAXHI_EMLOW_DBM "" VALUE 0x1DE394 _REC_S1VAL_1_s2_S2 65535 _CNV_R_R_Umr_1_zu_1_3_CM_S2 -32768 32767 FORMAT "%2.0" /end CHARACTERISTIC
/begin CHARACTERISTIC XSCHN_MOT_AUSHSURE "" VALUE 0x1DEDE0 _REC_S1VAL_1_u2_S2 20000 _CNV_R_R_Umr_1_zu_1_3_CM_S2 0 20000 FORMAT "%2.0" /end CHARACTERISTIC
/begin CHARACTERISTIC XSCHN_MOT_FWSVALID_MSAFZGSTOP "" VALUE 0x1DECA8 _REC_S1VAL_1_u2_S2 10000 _CNV_R_R_Umr_1_zu_1_3_CM_S2 0 10000 FORMAT "%2.0" /end CHARACTERISTIC
/begin CHARACTERISTIC XSCHN_MOT_FWSVALID_MSASTART "" VALUE 0x1DECAA _REC_S1VAL_1_u2_S2 10000 _CNV_R_R_Umr_1_zu_1_3_CM_S2 0 10000 FORMAT "%2.0" /end CHARACTERISTIC
/begin CHARACTERISTIC XSCHN_MOT_HSURENL_BREMSE "" VALUE 0x1DEFF6 _REC_S1VAL_1_u2_S2 10000 _CNV_R_R_Umr_1_zu_1_3_CM_S2 0 10000 FORMAT "%2.0" /end CHARACTERISTIC
/begin CHARACTERISTIC XSCHN_MOT_LAEUFT "" VALUE 0x1DF352 _REC_S1VAL_1_u2_S2 1400 _CNV_R_R_Umr_1_zu_1_3_CM_S2 100 1500 FORMAT "%2.0" /end CHARACTERISTIC
/begin CHARACTERISTIC XSCHN_MOT_LM "" VALUE 0x1DF354 _REC_S1VAL_1_u2_S2 5000 _CNV_R_R_Umr_1_zu_1_3_CM_S2 0 5000 FORMAT "%2.0" /end CHARACTERISTIC
/begin CHARACTERISTIC XSCHN_MOT_MARSBR "" VALUE 0x1DF392 _REC_S1VAL_1_u2_S2 9000 _CNV_R_R_Umr_1_zu_1_3_CM_S2 0 9000 FORMAT "%2.0" /end CHARACTERISTIC
/begin CHARACTERISTIC XSCHN_MOT_MARSG2W "" VALUE 0x1DF394 _REC_S1VAL_1_u2_S2 9000 _CNV_R_R_Umr_1_zu_1_3_CM_S2 0 9000 FORMAT "%2.0" /end CHARACTERISTIC
/begin CHARACTERISTIC XSCHN_MOT_MAX_DMRS "" VALUE 0x1DE96C _REC_S1VAL_1_u2_S2 10000 _CNV_R_R_Umr_1_zu_1_3_CM_S2 0 10000 FORMAT "%2.0" /end CHARACTERISTIC
/begin CHARACTERISTIC XSCHN_MOT_MDSMAXHS "" VALUE 0x1DF41A _REC_S1VAL_1_u2_S2 20000 _CNV_R_R_Umr_1_zu_1_3_CM_S2 0 20000 FORMAT "%2.0" /end CHARACTERISTIC
/begin CHARACTERISTIC XSCHN_MOT_MDSSCHUB_AUS "" VALUE 0x1E2888 _REC_S1VAL_1_u2_S2 10000 _CNV_R_R_Umr_1_zu_1_3_CM_S2 0 10000 FORMAT "%2.0" /end CHARACTERISTIC
/begin CHARACTERISTIC XSCHN_MOT_MDSSCHUB_EIN "" VALUE 0x1E288A _REC_S1VAL_1_u2_S2 10000 _CNV_R_R_Umr_1_zu_1_3_CM_S2 0 10000 FORMAT "%2.0" /end CHARACTERISTIC
/begin CHARACTERISTIC XSCHN_MOT_SERPKURVE_HSUREBAB "" VALUE 0x1E2886 _REC_S1VAL_1_u2_S2 10000 _CNV_R_R_Umr_1_zu_1_3_CM_S2 0 10000 FORMAT "%2.0" /end CHARACTERISTIC
/begin CHARACTERISTIC XSCHN_SCHLUPF_MAXGES "" VALUE 0x1DF45A _REC_S1VAL_1_u2_S2 65535 _CNV_R_R_Umr_1_zu_1_2_CM_S2 0 65535 FORMAT "%2.0" /end CHARACTERISTIC
/begin CHARACTERISTIC XSCHN_SCHLUPF_MINGES "" VALUE 0x1DF45C _REC_S1VAL_1_u2_S2 65535 _CNV_R_R_Umr_1_zu_1_2_CM_S2 0 65535 FORMAT "%2.0" /end CHARACTERISTIC
/begin CHARACTERISTIC XSCHN_SCHLUPF_MINMUE "" VALUE 0x1D9632 _REC_S1VAL_1_u1_S2 255 _CNV_R_R_Umr_1_zu_1_2_CM_S2 0 255 FORMAT "%2.0" /end CHARACTERISTIC
/begin CHARACTERISTIC XSCHN_SCHLUPF_NACHL_MAX "" VALUE 0x1DF45E _REC_S1VAL_1_u2_S2 65535 _CNV_R_R_Umr_1_zu_1_2_CM_S2 0 65535 FORMAT "%2.0" /end CHARACTERISTIC
/begin CHARACTERISTIC XSCHN_T_HSWK "" VALUE 0x1DE7AE _REC_S1VAL_1_u2_S2 15000 _CNV_R_R_Umr_1_zu_1_3_CM_S2 0 15000 FORMAT "%2.0" /end CHARACTERISTIC
/begin CHARACTERISTIC XSCHN_T_MDSMAXRS "" VALUE 0x1DF41C _REC_S1VAL_1_u2_S2 20000 _CNV_R_R_Umr_1_zu_1_3_CM_S2 0 20000 FORMAT "%2.0" /end CHARACTERISTIC
/begin CHARACTERISTIC XSCHN_VM_DYNDZM "" VALUE 0x1E271A _REC_S1VAL_1_u2_S2 1000 _CNV_R_R_Umr_1_zu_1_3_CM_S2 0 1000 FORMAT "%2.0" /end CHARACTERISTIC
/begin CHARACTERISTIC XSCHP_BR_MARS_AUS "" VALUE 0x1DF396 _REC_S1VAL_1_u2_S2 200 _CNV_R_R_Umr_2_zu_1_179_CM_S2 0 200 FORMAT "%3.1" /end CHARACTERISTIC
/begin CHARACTERISTIC XSCHP_BR_MARS_EIN "" VALUE 0x1DF398 _REC_S1VAL_1_u2_S2 200 _CNV_R_R_Umr_2_zu_1_179_CM_S2 0 200 FORMAT "%3.1" /end CHARACTERISTIC
/begin CHARACTERISTIC XSCHP_BR_STEIGUNG "" VALUE 0x1E212C _REC_S1VAL_1_u2_S2 32767 _CNV_R_R_Umr_2_zu_1_179_CM_S2 0 32767 FORMAT "%3.1" /end CHARACTERISTIC
/begin CHARACTERISTIC XSCHP_LUFT_HEISSHOCH "" VALUE 0x1E2140 _REC_S1VAL_1_u2_S2 522 _CNV_R_R_Umr_1_zu_1_0_CM_S2 598 1120 FORMAT "%2.0" /end CHARACTERISTIC
/begin CHARACTERISTIC XSCHP_LUFT_MODAFB "" VALUE 0x1DF382 _REC_S1VAL_1_u2_S2 522 _CNV_R_R_Umr_1_zu_1_0_CM_S2 598 1120 FORMAT "%2.0" /end CHARACTERISTIC
/begin CHARACTERISTIC XSCHTEMP_GETR_ANFAHRENOBEN "" VALUE 0x1DE632 _REC_S1VAL_1_s2_S2 400 _CNV_R_R_Umr_1_zu_1_1_CM_S2 -200 200 FORMAT "%2.0" /end CHARACTERISTIC
/begin CHARACTERISTIC XSCHTEMP_GETR_ANFAHRENUNTEN "" VALUE 0x1DE634 _REC_S1VAL_1_s2_S2 400 _CNV_R_R_Umr_1_zu_1_1_CM_S2 -200 200 FORMAT "%2.0" /end CHARACTERISTIC
/begin CHARACTERISTIC XSCHTEMP_GETR_DYNAMIKZYK "" VALUE 0x1DE420 _REC_S1VAL_1_s2_S2 400 _CNV_R_R_Umr_1_zu_1_1_CM_S2 -200 200 FORMAT "%2.0" /end CHARACTERISTIC
/begin CHARACTERISTIC XSCHTEMP_GETR_MIN_DYNDZM "" VALUE 0x1DEA9A _REC_S1VAL_1_s2_S2 400 _CNV_R_R_Umr_1_zu_1_1_CM_S2 -200 200 FORMAT "%2.0" /end CHARACTERISTIC
/begin CHARACTERISTIC XSCHTEMP_GETR_NABMAXRS "" VALUE 0x1DE7B0 _REC_S1VAL_1_s2_S2 400 _CNV_R_R_Umr_1_zu_1_1_CM_S2 -200 200 FORMAT "%2.0" /end CHARACTERISTIC
/begin CHARACTERISTIC XSCHTEMP_GETR_STOPGOOBEN "" VALUE 0x1E2142 _REC_S1VAL_1_s2_S2 400 _CNV_R_R_Umr_1_zu_1_1_CM_S2 -200 200 FORMAT "%2.0" /end CHARACTERISTIC
/begin CHARACTERISTIC XSCHTEMP_GETR_STOPGOUNTEN "" VALUE 0x1E2144 _REC_S1VAL_1_s2_S2 400 _CNV_R_R_Umr_1_zu_1_1_CM_S2 -200 200 FORMAT "%2.0" /end CHARACTERISTIC
/begin CHARACTERISTIC XSCHTEMP_GETR_WL2_AUS "" VALUE 0x1E2154 _REC_S1VAL_1_s2_S2 400 _CNV_R_R_Umr_1_zu_1_1_CM_S2 -200 200 FORMAT "%2.0" /end CHARACTERISTIC
/begin CHARACTERISTIC XSCHTEMP_GETR_WL2_MAX "" VALUE 0x1E2156 _REC_S1VAL_1_s2_S2 400 _CNV_R_R_Umr_1_zu_1_1_CM_S2 -200 200 FORMAT "%2.0" /end CHARACTERISTIC
/begin CHARACTERISTIC XSCHTEMP_GETR_WL2_MIN "" VALUE 0x1E2158 _REC_S1VAL_1_s2_S2 400 _CNV_R_R_Umr_1_zu_1_1_CM_S2 -200 200 FORMAT "%2.0" /end CHARACTERISTIC
/begin CHARACTERISTIC XSCHTEMP_GETR_WLSPV "" VALUE 0x1E219A _REC_S1VAL_1_s2_S2 400 _CNV_R_R_Umr_1_zu_1_1_CM_S2 -200 200 FORMAT "%2.0" /end CHARACTERISTIC
/begin CHARACTERISTIC XSCHTEMP_GETR_ZRSGANG1 "" VALUE 0x1E24A6 _REC_S1VAL_1_s2_S2 500 _CNV_R_R_Umr_1_zu_1_1_CM_S2 -100 400 FORMAT "%2.0" /end CHARACTERISTIC
/begin CHARACTERISTIC XSCHTEMP_MOT_BERGANH "" VALUE 0x1DE80E _REC_S1VAL_1_s2_S2 400 _CNV_R_R_Umr_1_zu_1_1_CM_S2 -200 200 FORMAT "%2.0" /end CHARACTERISTIC
/begin CHARACTERISTIC XSCHTEMP_MOT_DPF_REG "" VALUE 0x1E219C _REC_S1VAL_1_s2_S2 400 _CNV_R_R_Umr_1_zu_1_1_CM_S2 -200 200 FORMAT "%2.0" /end CHARACTERISTIC
/begin CHARACTERISTIC XSCHTEMP_MOT_SGENBL "" VALUE 0x1E2146 _REC_S1VAL_1_s2_S2 450 _CNV_R_R_Umr_1_zu_1_1_CM_S2 -50 400 FORMAT "%2.0" /end CHARACTERISTIC
/begin CHARACTERISTIC XSCHTEMP_MOT_WL2_AUS "" VALUE 0x1E215A _REC_S1VAL_1_s2_S2 200 _CNV_R_R_Umr_1_zu_1_1_CM_S2 -50 150 FORMAT "%2.0" /end CHARACTERISTIC
/begin CHARACTERISTIC XSCHTEMP_MOT_WL2_MAX "" VALUE 0x1E215C _REC_S1VAL_1_s2_S2 200 _CNV_R_R_Umr_1_zu_1_1_CM_S2 -50 150 FORMAT "%2.0" /end CHARACTERISTIC
/begin CHARACTERISTIC XSCHTEMP_UMG_DUE "" VALUE 0x1E2710 _REC_S1VAL_1_s2_S2 400 _CNV_R_R_Umr_1_zu_1_1_CM_S2 -200 200 FORMAT "%2.0" /end CHARACTERISTIC
/begin CHARACTERISTIC XSCHTEMP_UMG_HEISSHOCH "" VALUE 0x1E2148 _REC_S1VAL_1_s2_S2 130 _CNV_R_R_Umr_1_zu_1_1_CM_S2 -50 80 FORMAT "%2.0" /end CHARACTERISTIC
/begin CHARACTERISTIC XSCHTEMP_UMG_MUELOW_EINSTIEG "" VALUE 0x1DF460 _REC_S1VAL_1_s2_S2 130 _CNV_R_R_Umr_1_zu_1_1_CM_S2 -50 80 FORMAT "%2.0" /end CHARACTERISTIC
/begin CHARACTERISTIC XSCHTEMP_WLPRED_AUS "" VALUE 0x1E215E _REC_S1VAL_1_s2_S2 400 _CNV_R_R_Umr_1_zu_1_1_CM_S2 -200 200 FORMAT "%2.0" /end CHARACTERISTIC
/begin CHARACTERISTIC XSCHTEMP_WLPRED_EIN "" VALUE 0x1E2160 _REC_S1VAL_1_s2_S2 400 _CNV_R_R_Umr_1_zu_1_1_CM_S2 -200 200 FORMAT "%2.0" /end CHARACTERISTIC
/begin CHARACTERISTIC XSCHV_FZG_AUS_MODAFB_CHN "" VALUE 0x1DF384 _REC_S1VAL_1_u2_S2 400 _CNV_R_R_Umr_1_zu_1_8_CM_S2 0 400 FORMAT "%2.0" /end CHARACTERISTIC
/begin CHARACTERISTIC XSCHV_FZG_BERGANH "" VALUE 0x1DE810 _REC_S1VAL_1_u2_S2 400 _CNV_R_R_Umr_1_zu_1_8_CM_S2 0 400 FORMAT "%2.0" /end CHARACTERISTIC
/begin CHARACTERISTIC XSCHV_FZG_BGHINAKTIV "" VALUE 0x1DE812 _REC_S1VAL_1_u2_S2 400 _CNV_R_R_Umr_1_zu_1_8_CM_S2 0 400 FORMAT "%2.0" /end CHARACTERISTIC
/begin CHARACTERISTIC XSCHV_FZG_DYNAMIKZYK "" VALUE 0x1DE422 _REC_S1VAL_1_u2_S2 400 _CNV_R_R_Umr_1_zu_1_8_CM_S2 0 400 FORMAT "%2.0" /end CHARACTERISTIC
/begin CHARACTERISTIC XSCHV_FZG_EINTRAKTION_OBEN "" VALUE 0x1D97A9 _REC_S1VAL_1_u1_S2 250 _CNV_R_R_Umr_1_zu_1_8_CM_S2 0 250 FORMAT "%2.0" /end CHARACTERISTIC
/begin CHARACTERISTIC XSCHV_FZG_EINTRAKTION_UNTEN "" VALUE 0x1D97AA _REC_S1VAL_1_u1_S2 250 _CNV_R_R_Umr_1_zu_1_8_CM_S2 0 250 FORMAT "%2.0" /end CHARACTERISTIC
/begin CHARACTERISTIC XSCHV_FZG_EIN_MODAFB_CHN "" VALUE 0x1DF386 _REC_S1VAL_1_u2_S2 400 _CNV_R_R_Umr_1_zu_1_8_CM_S2 0 400 FORMAT "%2.0" /end CHARACTERISTIC
/begin CHARACTERISTIC XSCHV_FZG_HKOR "" VALUE 0x1DED3C _REC_S1VAL_1_u2_S2 400 _CNV_R_R_Umr_1_zu_1_8_CM_S2 0 400 FORMAT "%2.0" /end CHARACTERISTIC
/begin CHARACTERISTIC XSCHV_FZG_KURVE "" VALUE 0x1DE8FA _REC_S1VAL_1_u2_S2 400 _CNV_R_R_Umr_1_zu_1_8_CM_S2 0 400 FORMAT "%2.0" /end CHARACTERISTIC
/begin CHARACTERISTIC XSCHV_FZG_MAX_FLM "" VALUE 0x1DE636 _REC_S1VAL_1_u2_S2 10000 _CNV_R_R_Umr_1_zu_1_8_CM_S2 0 10000 FORMAT "%2.0" /end CHARACTERISTIC
/begin CHARACTERISTIC XSCHV_FZG_MSA "" VALUE 0x1DE3DC _REC_S1VAL_1_u2_S2 400 _CNV_R_R_Umr_1_zu_1_8_CM_S2 0 400 FORMAT "%2.0" /end CHARACTERISTIC
/begin CHARACTERISTIC XSCHV_FZG_PMA_AUS "" VALUE 0x1DE39A _REC_S1VAL_1_u2_S2 255 _CNV_R_R_Umr_64_zu__82_CM_S2 0 255 FORMAT "%3.1" /end CHARACTERISTIC
/begin CHARACTERISTIC XSCHV_FZG_PMA_ERLAUBT "" VALUE 0x1DE39C _REC_S1VAL_1_u2_S2 255 _CNV_R_R_Umr_64_zu__82_CM_S2 0 255 FORMAT "%3.1" /end CHARACTERISTIC
/begin CHARACTERISTIC XSCHV_FZG_SGENBL "" VALUE 0x1E214A _REC_S1VAL_1_u2_S2 400 _CNV_R_R_Umr_1_zu_1_8_CM_S2 0 400 FORMAT "%2.0" /end CHARACTERISTIC
/begin CHARACTERISTIC XSCHV_FZG_WL "" VALUE 0x1E219E _REC_S1VAL_1_u2_S2 400 _CNV_R_R_Umr_1_zu_1_8_CM_S2 0 400 FORMAT "%2.0" /end CHARACTERISTIC
/begin CHARACTERISTIC XSCHV_FZG_WL2 "" VALUE 0x1E2162 _REC_S1VAL_1_u2_S2 400 _CNV_R_R_Umr_1_zu_1_8_CM_S2 0 400 FORMAT "%2.0" /end CHARACTERISTIC
/begin CHARACTERISTIC XSCHV_FZG_WLPRED "" VALUE 0x1E2164 _REC_S1VAL_1_u2_S2 300 _CNV_R_R_Umr_1_zu_1_8_CM_S2 0 300 FORMAT "%2.0" /end CHARACTERISTIC
/begin CHARACTERISTIC XSCHV_RAD_DSCPLAUSI "" VALUE 0x1D9665 _REC_S1VAL_1_u1_S2 20 _CNV_R_R_Umr_1_zu_1_8_CM_S2 0 20 FORMAT "%2.0" /end CHARACTERISTIC
/begin CHARACTERISTIC XSCHWGWFP_MIN_HSUREHS "" VALUE 0x1DEEF8 _REC_S1VAL_1_s2_S2 65535 _CNV_R_R_Umr_1_zu_1_7_CM_S2 -32768 32767 FORMAT "%2.0" /end CHARACTERISTIC
/begin CHARACTERISTIC XSCHWNL_BRS "" VALUE 0x1DE906 _REC_S1VAL_1_u2_S2 110 _CNV_R_R_Umr_10_zu__9_CM_S2 0 110 FORMAT "%3.1" /end CHARACTERISTIC
/begin CHARACTERISTIC XSCHWNL_HSUREFOF "" VALUE 0x1DEE2A _REC_S1VAL_1_u2_S2 110 _CNV_R_R_Umr_10_zu__9_CM_S2 0 110 FORMAT "%3.1" /end CHARACTERISTIC
/begin CHARACTERISTIC XSCHWNL_HSURE_BRS "" VALUE 0x1DED8C _REC_S1VAL_1_u2_S2 110 _CNV_R_R_Umr_10_zu__9_CM_S2 0 110 FORMAT "%3.1" /end CHARACTERISTIC
/begin CHARACTERISTIC XSCHW_DKKD_AUSMODAFB "" VALUE 0x1DF388 _REC_S1VAL_1_u2_S2 120 _CNV_R_R_Umr_10_zu__9_CM_S2 0 120 FORMAT "%3.1" /end CHARACTERISTIC
/begin CHARACTERISTIC XSCHW_DKKD_AUSROLL "" VALUE 0x1E214C _REC_S1VAL_1_u2_S2 110 _CNV_R_R_Umr_10_zu__9_CM_S2 0 110 FORMAT "%3.1" /end CHARACTERISTIC
/begin CHARACTERISTIC XSCHW_DKKD_AUS_FESTBREMS "" VALUE 0x1DE902 _REC_S1VAL_1_u2_S2 110 _CNV_R_R_Umr_10_zu__9_CM_S2 0 110 FORMAT "%2.0" /end CHARACTERISTIC
/begin CHARACTERISTIC XSCHW_DKKD_DELTA_RSUBGH "" VALUE 0x1E20F2 _REC_S1VAL_1_u2_S2 110 _CNV_R_R_Umr_10_zu__9_CM_S2 0 110 FORMAT "%3.1" /end CHARACTERISTIC
/begin CHARACTERISTIC XSCHW_DKKD_DMRSDOWNSPERR "" VALUE 0x1DE96E _REC_S1VAL_1_u2_S2 110 _CNV_R_R_Umr_10_zu__9_CM_S2 0 110 FORMAT "%3.1" /end CHARACTERISTIC
/begin CHARACTERISTIC XSCHW_DKKD_DMRSMAX "" VALUE 0x1DE970 _REC_S1VAL_1_u2_S2 110 _CNV_R_R_Umr_10_zu__9_CM_S2 0 110 FORMAT "%3.1" /end CHARACTERISTIC
/begin CHARACTERISTIC XSCHW_DKKD_DMRSMIN "" VALUE 0x1DE972 _REC_S1VAL_1_u2_S2 110 _CNV_R_R_Umr_10_zu__9_CM_S2 0 110 FORMAT "%3.1" /end CHARACTERISTIC
/begin CHARACTERISTIC XSCHW_DKKD_DUE "" VALUE 0x1E2712 _REC_S1VAL_1_u2_S2 110 _CNV_R_R_Umr_10_zu__9_CM_S2 0 110 FORMAT "%3.1" /end CHARACTERISTIC
/begin CHARACTERISTIC XSCHW_DKKD_DUEAUS "" VALUE 0x1E2714 _REC_S1VAL_1_u2_S2 110 _CNV_R_R_Umr_10_zu__9_CM_S2 0 110 FORMAT "%3.1" /end CHARACTERISTIC
/begin CHARACTERISTIC XSCHW_DKKD_DYNAMIKZYK "" VALUE 0x1DE424 _REC_S1VAL_1_u2_S2 110 _CNV_R_R_Umr_10_zu__9_CM_S2 0 110 FORMAT "%3.1" /end CHARACTERISTIC
/begin CHARACTERISTIC XSCHW_DKKD_DYNDZM_ARS "" VALUE 0x1D8EC0 _REC_S1VAL_1_u2_S2 110 _CNV_R_R_Umr_10_zu__9_CM_S2 0 110 FORMAT "%3.1" /end CHARACTERISTIC
/begin CHARACTERISTIC XSCHW_DKKD_EIN_FESTBREMS "" VALUE 0x1DE904 _REC_S1VAL_1_u2_S2 110 _CNV_R_R_Umr_10_zu__9_CM_S2 0 110 FORMAT "%3.1" /end CHARACTERISTIC
/begin CHARACTERISTIC XSCHW_DKKD_FLM_AUS "" VALUE 0x1DE638 _REC_S1VAL_1_u2_S2 110 _CNV_R_R_Umr_10_zu__9_CM_S2 0 110 FORMAT "%2.0" /end CHARACTERISTIC
/begin CHARACTERISTIC XSCHW_DKKD_HSURENL "" VALUE 0x1DEFF8 _REC_S1VAL_1_u2_S2 100 _CNV_R_R_Umr_10_zu__9_CM_S2 0 100 FORMAT "%3.1" /end CHARACTERISTIC
/begin CHARACTERISTIC XSCHW_DKKD_HSURERS "" VALUE 0x1DF0FC _REC_S1VAL_1_u2_S2 100 _CNV_R_R_Umr_10_zu__9_CM_S2 0 100 FORMAT "%3.1" /end CHARACTERISTIC
/begin CHARACTERISTIC XSCHW_DKKD_KOMBI "" VALUE 0x1DE3CC _REC_S1VAL_1_u2_S2 110 _CNV_R_R_Umr_10_zu__9_CM_S2 0 110 FORMAT "%3.1" /end CHARACTERISTIC
/begin CHARACTERISTIC XSCHW_DKKD_MARS "" VALUE 0x1DF39A _REC_S1VAL_1_u2_S2 110 _CNV_R_R_Umr_10_zu__9_CM_S2 0 110 FORMAT "%3.1" /end CHARACTERISTIC
/begin CHARACTERISTIC XSCHW_DKKD_MDSSCHUB "" VALUE 0x1E288C _REC_S1VAL_1_u2_S2 110 _CNV_R_R_Umr_10_zu__9_CM_S2 0 110 FORMAT "%3.1" /end CHARACTERISTIC
/begin CHARACTERISTIC XSCHW_DKKD_MUELOWVOLLAST "" VALUE 0x1DF420 _REC_S1VAL_1_u2_S2 110 _CNV_R_R_Umr_10_zu__9_CM_S2 0 110 FORMAT "%3.1" /end CHARACTERISTIC
/begin CHARACTERISTIC XSCHW_DKKD_NMOTHSVLSTEPTR "" VALUE 0x1DE7B2 _REC_S1VAL_1_u2_S2 110 _CNV_R_R_Umr_10_zu__9_CM_S2 0 110 FORMAT "%3.1" /end CHARACTERISTIC
/begin CHARACTERISTIC XSCHW_DKKD_NMOTHSVOLLAST "" VALUE 0x1DE7B4 _REC_S1VAL_1_u2_S2 110 _CNV_R_R_Umr_10_zu__9_CM_S2 0 110 FORMAT "%3.1" /end CHARACTERISTIC
/begin CHARACTERISTIC XSCHW_DKKD_NULLAST_BAB "" VALUE 0x1DE7BC _REC_S1VAL_1_u2_S2 110 _CNV_R_R_Umr_10_zu__9_CM_S2 0 110 FORMAT "%3.1" /end CHARACTERISTIC
/begin CHARACTERISTIC XSCHW_DKKD_OBEN_RSUBGH "" VALUE 0x1E20F4 _REC_S1VAL_1_u2_S2 110 _CNV_R_R_Umr_10_zu__9_CM_S2 0 110 FORMAT "%3.1" /end CHARACTERISTIC
/begin CHARACTERISTIC XSCHW_DKKD_QSHIFT "" VALUE 0x1DE3E4 _REC_S1VAL_1_u2_S2 110 _CNV_R_R_Umr_10_zu__9_CM_S2 0 110 FORMAT "%3.1" /end CHARACTERISTIC
/begin CHARACTERISTIC XSCHW_DKKD_REKUPRS_DBM "" VALUE 0x1DE396 _REC_S1VAL_1_u2_S2 110 _CNV_R_R_Umr_10_zu__9_CM_S2 0 110 FORMAT "%3.1" /end CHARACTERISTIC
/begin CHARACTERISTIC XSCHW_DKKD_RSMAX_DYNSPV "" VALUE 0x1DE398 _REC_S1VAL_1_u2_S2 110 _CNV_R_R_Umr_10_zu__9_CM_S2 0 110 FORMAT "%3.1" /end CHARACTERISTIC
/begin CHARACTERISTIC XSCHW_DKKD_RSU_DSCERR "" VALUE 0x1DE3D0 _REC_S1VAL_1_u2_S2 110 _CNV_R_R_Umr_10_zu__9_CM_S2 0 110 FORMAT "%3.1" /end CHARACTERISTIC
/begin CHARACTERISTIC XSCHW_DKKD_SDYNNULLAST "" VALUE 0x1E20E6 _REC_S1VAL_1_u2_S2 110 _CNV_R_R_Umr_10_zu__9_CM_S2 0 110 FORMAT "%3.1" /end CHARACTERISTIC
/begin CHARACTERISTIC XSCHW_DKKD_SGENBL "" VALUE 0x1E214E _REC_S1VAL_1_u2_S2 110 _CNV_R_R_Umr_10_zu__9_CM_S2 0 110 FORMAT "%3.1" /end CHARACTERISTIC
/begin CHARACTERISTIC XSCHW_DKKD_STEIGUNG "" VALUE 0x1E212E _REC_S1VAL_1_u2_S2 110 _CNV_R_R_Umr_10_zu__9_CM_S2 0 110 FORMAT "%3.1" /end CHARACTERISTIC
/begin CHARACTERISTIC XSCHW_DKKD_STEPSNULLAST "" VALUE 0x1DE612 _REC_S1VAL_1_u2_S2 110 _CNV_R_R_Umr_10_zu__9_CM_S2 0 110 FORMAT "%3.1" /end CHARACTERISTIC
/begin CHARACTERISTIC XSCHW_DKKD_TID_AUSMIN "" VALUE 0x1E3576 _REC_S1VAL_1_u2_S2 110 _CNV_R_R_Umr_10_zu__9_CM_S2 0 110 FORMAT "%3.1" /end CHARACTERISTIC
/begin CHARACTERISTIC XSCHW_DKKD_UNTEN_RSUBGH "" VALUE 0x1E20F6 _REC_S1VAL_1_u2_S2 110 _CNV_R_R_Umr_10_zu__9_CM_S2 0 110 FORMAT "%3.1" /end CHARACTERISTIC
/begin CHARACTERISTIC XSCHW_DKKD_WL2_AUS "" VALUE 0x1E2166 _REC_S1VAL_1_u2_S2 120 _CNV_R_R_Umr_10_zu__9_CM_S2 0 120 FORMAT "%3.1" /end CHARACTERISTIC
/begin CHARACTERISTIC XSCHW_DK_KD "" VALUE 0x1DEAAE _REC_S1VAL_1_u2_S2 110 _CNV_R_R_Umr_10_zu__9_CM_S2 0 110 FORMAT "%3.1" /end CHARACTERISTIC
/begin CHARACTERISTIC XSCHW_LWVA_WL2_AUS "" VALUE 0x1E216A _REC_S1VAL_1_u2_S2 90 _CNV_R_R_Umr_10_zu__10_CM_S2 0 90 FORMAT "%3.1" /end CHARACTERISTIC
/begin CHARACTERISTIC XSCHW_STEIGUNGGEW_MAX_MSA "" VALUE 0x1DE3DE _REC_S1VAL_1_s2_S2 400 _CNV_R_R_Umr_10_zu__9_CM_S2 -200 200 FORMAT "%3.1" /end CHARACTERISTIC
/begin CHARACTERISTIC XSCHW_STEIGUNGGEW_MIN_MSA "" VALUE 0x1DE3E0 _REC_S1VAL_1_s2_S2 400 _CNV_R_R_Umr_10_zu__9_CM_S2 -200 200 FORMAT "%3.1" /end CHARACTERISTIC
/begin CHARACTERISTIC XSCHW_STEIGUNG_HKOR "" VALUE 0x1DED3E _REC_S1VAL_1_s2_S2 400 _CNV_R_R_Umr_10_zu__9_CM_S2 -200 200 FORMAT "%3.1" /end CHARACTERISTIC
/begin CHARACTERISTIC XSCHW_STEIGUNG_STEPS "" VALUE 0x1DE614 _REC_S1VAL_1_s2_S2 400 _CNV_R_R_Umr_10_zu__9_CM_S2 -200 200 FORMAT "%3.1" /end CHARACTERISTIC
/begin CHARACTERISTIC XSCHW_STEIGUNG_STOPGO "" VALUE 0x1E2150 _REC_S1VAL_1_s2_S2 400 _CNV_R_R_Umr_10_zu__9_CM_S2 -200 200 FORMAT "%3.1" /end CHARACTERISTIC
/begin CHARACTERISTIC XSCHW_STEIGUNG_WL2_AUS "" VALUE 0x1E2168 _REC_S1VAL_1_u2_S2 200 _CNV_R_R_Umr_10_zu__9_CM_S2 0 200 FORMAT "%3.1" /end CHARACTERISTIC
/begin CHARACTERISTIC XSCHZ_GANG_MAX_RSUBGH "" VALUE 0x1D9662 _REC_S1VAL_1_u1_S2 8 _CNV_S_9_Enum_EGANG_21_CM_S2 0 8 /end CHARACTERISTIC
/begin CHARACTERISTIC XSCHZ_PROGBGH_MIN_RSUBGH "" VALUE 0x1D9663 _REC_S1VAL_1_u1_S2 5 _CNV_S_6_Enum_EBERG_47_CM_S2 0 5 /end CHARACTERISTIC
/begin CHARACTERISTIC XSCH_DRIVELOGIC_WLPRED "" VALUE 0x1D9722 _REC_S1VAL_1_u1_S2 5 _CNV_S_6_Enum_EDL_11_CM_S2 1 6 /end CHARACTERISTIC
/begin CHARACTERISTIC XSCH_HOTMODE_AKTIV "" VALUE 0x1DED4A _REC_S1VAL_1_u2_S2 2 _CNV_R_R_Umr_1_zu_1_2_CM_S2 0 2 FORMAT "%2.0" /end CHARACTERISTIC
/begin CHARACTERISTIC XSCH_HOTMODE_ANFGANG2 "" VALUE 0x1D9121 _REC_S1VAL_1_u1_S2 4 _CNV_R_R_Umr_1_zu_1_2_CM_S2 0 4 FORMAT "%2.0" /end CHARACTERISTIC
/begin CHARACTERISTIC XSCH_HOTMODE_SCHALTVERBOT "" VALUE 0x1D910F _REC_S1VAL_1_u1_S2 3 _CNV_R_R_Umr_1_zu_1_2_CM_S2 0 3 FORMAT "%2.0" /end CHARACTERISTIC
/begin CHARACTERISTIC XSCH_HOTMODE_STEPS "" VALUE 0x1D9110 _REC_S1VAL_1_u1_S2 3 _CNV_R_R_Umr_1_zu_1_2_CM_S2 0 3 FORMAT "%2.0" /end CHARACTERISTIC
/begin CHARACTERISTIC XSCH_HOTMODE_STEPSZRS1 "" VALUE 0x1D9111 _REC_S1VAL_1_u1_S2 3 _CNV_R_R_Umr_1_zu_1_2_CM_S2 0 3 FORMAT "%2.0" /end CHARACTERISTIC
/begin CHARACTERISTIC XSCH_HOTMODE_ZRSGANG1 "" VALUE 0x1D977F _REC_S1VAL_1_u1_S2 2 _CNV_R_R_Umr_1_zu_1_2_CM_S2 0 2 FORMAT "%2.0" /end CHARACTERISTIC
/begin CHARACTERISTIC XSCH_MUEDYN_AUS_RSUMUELOW "" VALUE 0x1E20F8 _REC_S1VAL_1_u2_S2 65.535 _CNV_R_R_Umr_1000_z_36_CM_S2 0 65.535 FORMAT "%5.3" /end CHARACTERISTIC
/begin CHARACTERISTIC XSCH_MUEDYN_EIN_RSUMUELOW "" VALUE 0x1E20FA _REC_S1VAL_1_u2_S2 65.535 _CNV_R_R_Umr_1000_z_36_CM_S2 0 65.535 FORMAT "%5.3" /end CHARACTERISTIC
/begin CHARACTERISTIC XS_ABREGLER_ABBRUCH_HS "" VALUE 0x1D9620 _REC_S1VAL_1_u1_S2 1 _CNV_S_2_Schalter_A_4_CM_S2 0 1 /end CHARACTERISTIC
/begin CHARACTERISTIC XS_ALMUELOWOFF_USE75MSMUELOWFILT "" VALUE 0x1D9633 _REC_S1VAL_1_u1_S2 1 _CNV_R_R_Umr_1_zu_1_2_CM_S2 0 1 FORMAT "%2.0" /end CHARACTERISTIC
/begin CHARACTERISTIC XS_ARSSTD_FASZKA_DBM "" VALUE 0x1D8F33 _REC_S1VAL_1_u1_S2 1 _CNV_R_R_Umr_1_zu_1_2_CM_S2 0 1 FORMAT "%2.0" /end CHARACTERISTIC
/begin CHARACTERISTIC XS_A_LFILT "" VALUE 0x1D9134 _REC_S1VAL_1_u1_S2 1 _CNV_R_R_Umr_1_zu_1_2_CM_S2 0 1 FORMAT "%2.0" /end CHARACTERISTIC
/begin CHARACTERISTIC XS_BPL "" VALUE 0x1D97C6 _REC_S1VAL_1_u1_S2 1 _CNV_R_R_Umr_1_zu_1_2_CM_S2 0 1 FORMAT "%2.0" /end CHARACTERISTIC
/begin CHARACTERISTIC XS_BRS_2RSENBL "" VALUE 0x1D978F _REC_S1VAL_1_u1_S2 1 _CNV_R_R_Umr_1_zu_1_2_CM_S2 0 1 FORMAT "%2.0" /end CHARACTERISTIC
/begin CHARACTERISTIC XS_BRS_GANG1EIN "" VALUE 0x1D9790 _REC_S1VAL_1_u1_S2 1 _CNV_R_R_Umr_1_zu_1_2_CM_S2 0 1 FORMAT "%2.0" /end CHARACTERISTIC
/begin CHARACTERISTIC XS_DERS_BAB_AKTIV "" VALUE 0x1D979E _REC_S1VAL_1_u1_S2 1 _CNV_R_R_Umr_1_zu_1_2_CM_S2 0 1 FORMAT "%2.0" /end CHARACTERISTIC
/begin CHARACTERISTIC XS_DERS_DYNDZM "" VALUE 0x1D9537 _REC_S1VAL_1_u1_S2 1 _CNV_R_R_Umr_1_zu_1_2_CM_S2 0 1 FORMAT "%2.0" /end CHARACTERISTIC
/begin CHARACTERISTIC XS_DMRS_PRUEFUNG_DBM "" VALUE 0x1D8F34 _REC_S1VAL_1_u1_S2 1 _CNV_R_R_Umr_1_zu_1_2_CM_S2 0 1 FORMAT "%2.0" /end CHARACTERISTIC
/begin CHARACTERISTIC XS_DRIVELOGICIDX_SOURCE "" VALUE 0x1D9578 _REC_S1VAL_1_u1_S2 1 _CNV_S_2_Enum_ESIGN_230_CM_S2 0 1 /end CHARACTERISTIC
/begin CHARACTERISTIC XS_DYNDZM_ANG_PHASE1_0 "" VALUE 0x1D9538 _REC_S1VAL_1_u1_S2 1 _CNV_S_2_Schalter_A_4_CM_S2 0 1 /end CHARACTERISTIC
/begin CHARACTERISTIC XS_DYNDZM_ANG_PHASE1_2 "" VALUE 0x1D9539 _REC_S1VAL_1_u1_S2 1 _CNV_S_2_Schalter_A_4_CM_S2 0 1 /end CHARACTERISTIC
/begin CHARACTERISTIC XS_DYNDZM_SSINITDEF "" VALUE 0x1D8F7B _REC_S1VAL_1_u1_S2 1 _CNV_R_R_Umr_1_zu_1_2_CM_S2 0 1 /end CHARACTERISTIC
/begin CHARACTERISTIC XS_DYN_RS_PME_ENBL "" VALUE 0x1D9108 _REC_S1VAL_1_u1_S2 1 _CNV_S_2_Schalter_A_4_CM_S2 0 1 /end CHARACTERISTIC
/begin CHARACTERISTIC XS_EMPOTZUG_KD_ZKA "" VALUE 0x1D976D _REC_S1VAL_1_u1_S2 1 _CNV_R_R_Umr_1_zu_1_2_CM_S2 0 1 FORMAT "%2.0" /end CHARACTERISTIC
/begin CHARACTERISTIC XS_FAHRERTYP "" VALUE 0x1D9796 _REC_S1VAL_1_u1_S2 1 _CNV_R_R_Umr_1_zu_1_2_CM_S2 0 1 FORMAT "%2.0" /end CHARACTERISTIC
/begin CHARACTERISTIC XS_FBIT_RESET "" VALUE 0x1D9589 _REC_S1VAL_1_u1_S2 1 _CNV_R_R_Umr_1_zu_1_2_CM_S2 0 1 FORMAT "%2.0" /end CHARACTERISTIC
/begin CHARACTERISTIC XS_FDS_ZRS_STAND_STEPS "" VALUE 0x1D9112 _REC_S1VAL_1_u1_S2 1 _CNV_S_2_Schalter_A_4_CM_S2 0 1 /end CHARACTERISTIC
/begin CHARACTERISTIC XS_FWSRESERVE_ZKA "" VALUE 0x1D976E _REC_S1VAL_1_u1_S2 1 _CNV_R_R_Umr_1_zu_1_2_CM_S2 0 1 FORMAT "%2.0" /end CHARACTERISTIC
/begin CHARACTERISTIC XS_G2W_ABFILT "" VALUE 0x1D958C _REC_S1VAL_1_u1_S2 1 _CNV_R_R_Umr_1_zu_1_2_CM_S2 0 1 FORMAT "%2.0" /end CHARACTERISTIC
/begin CHARACTERISTIC XS_GK0_FAHRDYNAMIK "" VALUE 0x1D8F4B _REC_S1VAL_1_u1_S2 1 _CNV_R_R_Umr_1_zu_1_2_CM_S2 0 1 FORMAT "%2.0" /end CHARACTERISTIC
/begin CHARACTERISTIC XS_GNMTTRAD_FILTKORSCHALT "" VALUE 0x1D9642 _REC_S1VAL_1_u1_S2 1 _CNV_S_2_Enum_EGNMT_201_CM_S2 0 1 /end CHARACTERISTIC
/begin CHARACTERISTIC XS_HSURE_FZGSTEHT "" VALUE 0x1D95C3 _REC_S1VAL_1_u1_S2 1 _CNV_R_R_Umr_1_zu_1_2_CM_S2 0 1 FORMAT "%2.0" /end CHARACTERISTIC
/begin CHARACTERISTIC XS_HSZIEL_FLM "" VALUE 0x1D9645 _REC_S1VAL_1_u1_S2 1 _CNV_S_2_Schalter_A_4_CM_S2 0 1 /end CHARACTERISTIC
/begin CHARACTERISTIC XS_K0_IST_DYNDZM "" VALUE 0x1D97A4 _REC_S1VAL_1_u1_S2 1 _CNV_R_R_Umr_1_zu_1_2_CM_S2 0 1 FORMAT "%2.0" /end CHARACTERISTIC
/begin CHARACTERISTIC XS_KDRS_STAND_STEPS "" VALUE 0x1D9113 _REC_S1VAL_1_u1_S2 1 _CNV_S_2_Schalter_A_4_CM_S2 0 1 /end CHARACTERISTIC
/begin CHARACTERISTIC XS_KDRS_STEPS "" VALUE 0x1D9114 _REC_S1VAL_1_u1_S2 1 _CNV_S_2_Schalter_A_4_CM_S2 0 1 /end CHARACTERISTIC
/begin CHARACTERISTIC XS_KDTippRS_AKTIV "" VALUE 0x1D9115 _REC_S1VAL_1_u1_S2 1 _CNV_S_2_Schalter_A_4_CM_S2 0 1 /end CHARACTERISTIC
/begin CHARACTERISTIC XS_KICKFAST "" VALUE 0x1D979A _REC_S1VAL_1_u1_S2 1 _CNV_R_R_Umr_1_zu_1_2_CM_S2 0 1 FORMAT "%2.0" /end CHARACTERISTIC
/begin CHARACTERISTIC XS_KURVE_BEW "" VALUE 0x1D979B _REC_S1VAL_1_u1_S2 1 _CNV_R_R_Umr_1_zu_1_2_CM_S2 0 1 FORMAT "%2.0" /end CHARACTERISTIC
/begin CHARACTERISTIC XS_KURVE_HSUREBAB "" VALUE 0x1D97BB _REC_S1VAL_1_u1_S2 1 _CNV_S_2_Schalter_A_4_CM_S2 0 1 /end CHARACTERISTIC
/begin CHARACTERISTIC XS_MAB_USE_TAB_VFZG "" VALUE 0x1D960C _REC_S1VAL_1_u1_S2 1 _CNV_R_R_Umr_1_zu_1_2_CM_S2 0 1 FORMAT "%2.0" /end CHARACTERISTIC
/begin CHARACTERISTIC XS_MBR_MRADWUNSCH_ZKA "" VALUE 0x1D976F _REC_S1VAL_1_u1_S2 1 _CNV_R_R_Umr_1_zu_1_2_CM_S2 0 1 FORMAT "%2.0" /end CHARACTERISTIC
/begin CHARACTERISTIC XS_MBR_PBR "" VALUE 0x1D95EE _REC_S1VAL_1_u1_S2 1 _CNV_S_2_Schalter_A_4_CM_S2 0 1 /end CHARACTERISTIC
/begin CHARACTERISTIC XS_MEM1_MAX_ZKA "" VALUE 0x1D976B _REC_S1VAL_1_u1_S2 1 _CNV_R_R_Umr_1_zu_1_2_CM_S2 0 1 FORMAT "%2.0" /end CHARACTERISTIC
/begin CHARACTERISTIC XS_MINMAX_LDM_SCHUB_DBM "" VALUE 0x1D8F35 _REC_S1VAL_1_u1_S2 1 _CNV_R_R_Umr_1_zu_1_2_CM_S2 0 1 FORMAT "%2.0" /end CHARACTERISTIC
/begin CHARACTERISTIC XS_MINMAX_LDM_ZUG_DBM "" VALUE 0x1D8F36 _REC_S1VAL_1_u1_S2 1 _CNV_R_R_Umr_1_zu_1_2_CM_S2 0 1 FORMAT "%2.0" /end CHARACTERISTIC
/begin CHARACTERISTIC XS_MMOT_MAX_ZKA "" VALUE 0x1D9769 _REC_S1VAL_1_u1_S2 1 _CNV_R_R_Umr_1_zu_1_2_CM_S2 0 1 FORMAT "%2.0" /end CHARACTERISTIC
/begin CHARACTERISTIC XS_MMOT_MIN_ZKA "" VALUE 0x1D976A _REC_S1VAL_1_u1_S2 1 _CNV_R_R_Umr_1_zu_1_2_CM_S2 0 1 FORMAT "%2.0" /end CHARACTERISTIC
/begin CHARACTERISTIC XS_MODUS_PHASE67_DYNDZM "" VALUE 0x1D97A5 _REC_S1VAL_1_u1_S2 1 _CNV_R_R_Umr_1_zu_1_2_CM_S2 0 1 FORMAT "%2.0" /end CHARACTERISTIC
/begin CHARACTERISTIC XS_MODUS_PHASE76_DYNDZM "" VALUE 0x1D97A6 _REC_S1VAL_1_u1_S2 1 _CNV_R_R_Umr_1_zu_1_2_CM_S2 0 1 FORMAT "%2.0" /end CHARACTERISTIC
/begin CHARACTERISTIC XS_MUELOWABW_SS "" VALUE 0x1D963B _REC_S1VAL_1_u1_S2 1 _CNV_R_R_Umr_1_zu_1_2_CM_S2 0 1 FORMAT "%2.0" /end CHARACTERISTIC
/begin CHARACTERISTIC XS_MUELOWAUSLAST_AKTIV "" VALUE 0x1D9634 _REC_S1VAL_1_u1_S2 1 _CNV_R_R_Umr_1_zu_1_2_CM_S2 0 1 FORMAT "%2.0" /end CHARACTERISTIC
/begin CHARACTERISTIC XS_MUELOWERKSS_RSU_MUELOW "" VALUE 0x1D9664 _REC_S1VAL_1_u1_S2 1 _CNV_R_R_Umr_1_zu_1_2_CM_S2 0 1 FORMAT "%2.0" /end CHARACTERISTIC
/begin CHARACTERISTIC XS_MUELOWERK_SS "" VALUE 0x1D963C _REC_S1VAL_1_u1_S2 1 _CNV_R_R_Umr_1_zu_1_2_CM_S2 0 1 FORMAT "%2.0" /end CHARACTERISTIC
/begin CHARACTERISTIC XS_MUELOW_ZRSGANG1_SS "" VALUE 0x1D9781 _REC_S1VAL_1_u1_S2 1 _CNV_R_R_Umr_1_zu_1_2_CM_S2 0 1 FORMAT "%2.0" /end CHARACTERISTIC
/begin CHARACTERISTIC XS_M_MOT_STAT "" VALUE 0x1D95EF _REC_S1VAL_1_u1_S2 1 _CNV_R_R_Umr_1_zu_1_2_CM_S2 0 1 /end CHARACTERISTIC
/begin CHARACTERISTIC XS_M_RADOPT_BEGRENZT "" VALUE 0x1D9770 _REC_S1VAL_1_u1_S2 1 _CNV_R_R_Umr_1_zu_1_2_CM_S2 0 1 FORMAT "%2.0" /end CHARACTERISTIC
/begin CHARACTERISTIC XS_NABRAD_NAB "" VALUE 0x1D912C _REC_S1VAL_1_u1_S2 1 _CNV_R_R_Umr_1_zu_1_2_CM_S2 0 1 FORMAT "%2.0" /end CHARACTERISTIC
/begin CHARACTERISTIC XS_NVM_DYNDZM "" VALUE 0x1D97A7 _REC_S1VAL_1_u1_S2 1 _CNV_R_R_Umr_1_zu_1_2_CM_S2 0 1 FORMAT "%2.0" /end CHARACTERISTIC
/begin CHARACTERISTIC XS_PMA_ENBL "" VALUE 0x1D8F48 _REC_S1VAL_1_u1_S2 1 _CNV_R_R_Umr_1_zu_1_2_CM_S2 0 1 /end CHARACTERISTIC
/begin CHARACTERISTIC XS_PRUEFMETHODE_HIGHLOW_ZKA "" VALUE 0x1D9771 _REC_S1VAL_1_u1_S2 1 _CNV_R_R_Umr_1_zu_1_2_CM_S2 0 1 FORMAT "%2.0" /end CHARACTERISTIC
/begin CHARACTERISTIC XS_PRUEF_RSSKLDERS_DMRS "" VALUE 0x1D9148 _REC_S1VAL_1_u1_S2 1 _CNV_R_R_Umr_1_zu_1_2_CM_S2 0 1 FORMAT "%2.0" /end CHARACTERISTIC
/begin CHARACTERISTIC XS_P_LUFT_SOURCE "" VALUE 0x1D95F9 _REC_S1VAL_1_u1_S2 1 _CNV_S_2_Enum_ESIGN_230_CM_S2 0 1 /end CHARACTERISTIC
/begin CHARACTERISTIC XS_RSSEQ_MUELOW_FKT "" VALUE 0x1D9630 _REC_S1VAL_1_u1_S2 1 _CNV_R_R_Umr_1_zu_1_2_CM_S2 0 1 FORMAT "%2.0" /end CHARACTERISTIC
/begin CHARACTERISTIC XS_SCHLEPP "" VALUE 0x1D979C _REC_S1VAL_1_u1_S2 2 _CNV_R_R_Umr_1_zu_1_2_CM_S2 0 2 FORMAT "%2.0" /end CHARACTERISTIC
/begin CHARACTERISTIC XS_SCHUB_LDMBAB_ZKA "" VALUE 0x1D9772 _REC_S1VAL_1_u1_S2 1 _CNV_R_R_Umr_1_zu_1_2_CM_S2 0 1 FORMAT "%2.0" /end CHARACTERISTIC
/begin CHARACTERISTIC XS_SDYN_MINQSMODE_MARS "" VALUE 0x1D9661 _REC_S1VAL_1_u1_S2 1 _CNV_S_2_Schalter_A_4_CM_S2 0 1 /end CHARACTERISTIC
/begin CHARACTERISTIC XS_SERP_HSUREBAB "" VALUE 0x1D97BC _REC_S1VAL_1_u1_S2 1 _CNV_S_2_Schalter_A_4_CM_S2 0 1 /end CHARACTERISTIC
/begin CHARACTERISTIC XS_SORTPRIO "" VALUE 0x1D8F31 _REC_S1VAL_1_u1_S2 1 _CNV_S_2_Schalter_A_4_CM_S2 0 1 /end CHARACTERISTIC
/begin CHARACTERISTIC XS_SOURCE_FWSBER_MRADIST "" VALUE 0x1D957D _REC_S1VAL_1_u1_S2 1 _CNV_R_R_Umr_1_zu_1_2_CM_S2 0 1 /end CHARACTERISTIC
/begin CHARACTERISTIC XS_SOURCE_FZGMASSEBESTIMMUNG "" VALUE 0x1D957E _REC_S1VAL_1_u1_S2 1 _CNV_R_R_Umr_1_zu_1_2_CM_S2 0 1 FORMAT "%2.0" /end CHARACTERISTIC
/begin CHARACTERISTIC XS_SOURCE_GNT_ZKA "" VALUE 0x1D9773 _REC_S1VAL_1_u1_S2 1 _CNV_R_R_Umr_1_zu_1_2_CM_S2 0 1 FORMAT "%2.0" /end CHARACTERISTIC
/begin CHARACTERISTIC XS_SOURCE_KLOPT_GANG_ZKA "" VALUE 0x1D9774 _REC_S1VAL_1_u1_S2 1 _CNV_R_R_Umr_1_zu_1_2_CM_S2 0 1 FORMAT "%2.0" /end CHARACTERISTIC
/begin CHARACTERISTIC XS_SOURCE_KS "" VALUE 0x1D9601 _REC_S1VAL_1_u1_S2 1 _CNV_S_2_Enum_ESIGN_231_CM_S2 0 1 /end CHARACTERISTIC
/begin CHARACTERISTIC XS_SOURCE_MREKUP_DBM "" VALUE 0x1D8F37 _REC_S1VAL_1_u1_S2 1 _CNV_R_R_Umr_1_zu_1_2_CM_S2 0 1 FORMAT "%2.0" /end CHARACTERISTIC
/begin CHARACTERISTIC XS_SOURCE_NGENAB_DBM "" VALUE 0x1D8F38 _REC_S1VAL_1_u1_S2 1 _CNV_R_R_Umr_1_zu_1_2_CM_S2 0 1 FORMAT "%2.0" /end CHARACTERISTIC
/begin CHARACTERISTIC XS_SOURCE_NMOTSOLLLL_STEPTR "" VALUE 0x1D9116 _REC_S1VAL_1_u1_S2 1 _CNV_R_R_Umr_1_zu_1_2_CM_S2 0 1 /end CHARACTERISTIC
/begin CHARACTERISTIC XS_SOURCE_V_FZG_COG "" VALUE 0x1D958A _REC_S1VAL_1_u1_S2 1 _CNV_R_R_Umr_1_zu_1_2_CM_S2 0 1 /end CHARACTERISTIC
/begin CHARACTERISTIC XS_SOURCE_ZMOTSTART_TYP "" VALUE 0x1D9602 _REC_S1VAL_1_u1_S2 1 _CNV_R_R_Umr_1_zu_1_2_CM_S2 0 1 FORMAT "%2.0" /end CHARACTERISTIC
/begin CHARACTERISTIC XS_STABIKRIT_ZKA "" VALUE 0x1D9775 _REC_S1VAL_1_u1_S2 1 _CNV_R_R_Umr_1_zu_1_2_CM_S2 0 1 FORMAT "%2.0" /end CHARACTERISTIC
/begin CHARACTERISTIC XS_STABI_SCHALTUNG_DBM "" VALUE 0x1D8F39 _REC_S1VAL_1_u1_S2 1 _CNV_R_R_Umr_1_zu_1_2_CM_S2 0 1 FORMAT "%2.0" /end CHARACTERISTIC
/begin CHARACTERISTIC XS_STAT_SPORT_SSINITDEF "" VALUE 0x1D8F78 _REC_S1VAL_1_u1_S2 15 _CNV_R_R_Umr_1_zu_1_2_CM_S2 0 15 /end CHARACTERISTIC
/begin CHARACTERISTIC XS_STAT_ZHS_SSINITDEF "" VALUE 0x1D8F79 _REC_S1VAL_1_u1_S2 3 _CNV_R_R_Umr_1_zu_1_2_CM_S2 0 3 /end CHARACTERISTIC
/begin CHARACTERISTIC XS_STEIGUNGSKOR "" VALUE 0x1D971E _REC_S1VAL_1_u1_S2 1 _CNV_S_2_Schalter_A_4_CM_S2 0 1 /end CHARACTERISTIC
/begin CHARACTERISTIC XS_STOPGO_MSA "" VALUE 0x1D9720 _REC_S1VAL_1_u1_S2 1 _CNV_S_2_Enum_ESTOP_123_CM_S2 0 1 /end CHARACTERISTIC
/begin CHARACTERISTIC XS_S_EFAHREN_ERK "" VALUE 0x1D95E6 _REC_S1VAL_1_u1_S2 255 _CNV_R_R_Umr_1_zu_1_2_CM_S2 0 255 /end CHARACTERISTIC
/begin CHARACTERISTIC XS_TEMP_UMG_SOURCE "" VALUE 0x1D95FA _REC_S1VAL_1_u1_S2 1 _CNV_S_2_Enum_ESIGN_230_CM_S2 0 1 /end CHARACTERISTIC
/begin CHARACTERISTIC XS_TIPP_VORWAHL_MINUS "" VALUE 0x1D9117 _REC_S1VAL_1_u1_S2 1 _CNV_S_2_Schalter_A_4_CM_S2 0 1 /end CHARACTERISTIC
/begin CHARACTERISTIC XS_TIPP_VORWAHL_PLUS "" VALUE 0x1D9118 _REC_S1VAL_1_u1_S2 1 _CNV_S_2_Schalter_A_4_CM_S2 0 1 /end CHARACTERISTIC
/begin CHARACTERISTIC XS_TIPP_VORWAHL_STAND "" VALUE 0x1D9119 _REC_S1VAL_1_u1_S2 1 _CNV_S_2_Schalter_A_4_CM_S2 0 1 /end CHARACTERISTIC
/begin CHARACTERISTIC XS_TMS_SIMULATE "" VALUE 0x1D8F47 _REC_S1VAL_1_u1_S2 1 _CNV_R_R_Umr_1_zu_1_2_CM_S2 0 1 FORMAT "%2.0" /end CHARACTERISTIC
/begin CHARACTERISTIC XS_USE_ABREGLER_SCHLUPF "" VALUE 0x1D9621 _REC_S1VAL_1_u1_S2 1 _CNV_S_2_Schalter_A_4_CM_S2 0 1 /end CHARACTERISTIC
/begin CHARACTERISTIC XS_USE_AGS_N_POS "" VALUE 0x1D8ECC _REC_S1VAL_1_u1_S2 1 _CNV_S_2_Schalter_A_4_CM_S2 0 1 /end CHARACTERISTIC
/begin CHARACTERISTIC XS_USE_ANFGANG2_ALLRAD "" VALUE 0x1D9122 _REC_S1VAL_1_u1_S2 1 _CNV_S_2_Schalter_A_4_CM_S2 0 1 /end CHARACTERISTIC
/begin CHARACTERISTIC XS_USE_ANHSTEPSZRS1 "" VALUE 0x1D911A _REC_S1VAL_1_u1_S2 1 _CNV_S_2_Schalter_A_4_CM_S2 0 1 /end CHARACTERISTIC
/begin CHARACTERISTIC XS_USE_ANHZRS1 "" VALUE 0x1D9780 _REC_S1VAL_1_u1_S2 1 _CNV_S_2_Schalter_A_4_CM_S2 0 1 /end CHARACTERISTIC
/begin CHARACTERISTIC XS_USE_BABDSCERRAUSSTIEG "" VALUE 0x1D978D _REC_S1VAL_1_u1_S2 1 _CNV_R_R_Umr_1_zu_1_2_CM_S2 0 1 FORMAT "%2.0" /end CHARACTERISTIC
/begin CHARACTERISTIC XS_USE_BABSERP "" VALUE 0x1D912D _REC_S1VAL_1_u1_S2 1 _CNV_S_2_Schalter_A_4_CM_S2 0 1 /end CHARACTERISTIC
/begin CHARACTERISTIC XS_USE_BCA "" VALUE 0x1D9136 _REC_S1VAL_1_u1_S2 1 _CNV_R_R_Umr_1_zu_1_2_CM_S2 0 1 FORMAT "%2.0" /end CHARACTERISTIC
/begin CHARACTERISTIC XS_USE_BERGANH_SERP "" VALUE 0x1D9130 _REC_S1VAL_1_u1_S2 1 _CNV_S_2_Schalter_A_4_CM_S2 0 1 /end CHARACTERISTIC
/begin CHARACTERISTIC XS_USE_BGHSCHINAKTIV "" VALUE 0x1D9131 _REC_S1VAL_1_u1_S2 1 _CNV_R_R_Umr_1_zu_1_2_CM_S2 0 1 FORMAT "%2.0" /end CHARACTERISTIC
/begin CHARACTERISTIC XS_USE_BGH_SCHALTUNG "" VALUE 0x1D9132 _REC_S1VAL_1_u1_S2 1 _CNV_S_2_Schalter_A_4_CM_S2 0 1 /end CHARACTERISTIC
/begin CHARACTERISTIC XS_USE_BGH_STAND "" VALUE 0x1D9133 _REC_S1VAL_1_u1_S2 1 _CNV_S_2_Schalter_A_4_CM_S2 0 1 /end CHARACTERISTIC
/begin CHARACTERISTIC XS_USE_BREMSENSTATUS_FWSBER "" VALUE 0x1D957F _REC_S1VAL_1_u1_S2 1 _CNV_R_R_Umr_1_zu_1_2_CM_S2 0 1 /end CHARACTERISTIC
/begin CHARACTERISTIC XS_USE_BRSDSCERRAUSSTIEG "" VALUE 0x1D9137 _REC_S1VAL_1_u1_S2 1 _CNV_R_R_Umr_1_zu_1_2_CM_S2 0 1 FORMAT "%2.0" /end CHARACTERISTIC
/begin CHARACTERISTIC XS_USE_BRSMARS "" VALUE 0x1D95EC _REC_S1VAL_1_u1_S2 1 _CNV_S_2_Schalter_A_4_CM_S2 0 1 /end CHARACTERISTIC
/begin CHARACTERISTIC XS_USE_CODGETRTYP_KDTippRS "" VALUE 0x1D911B _REC_S1VAL_1_u1_S2 1 _CNV_S_2_Schalter_A_4_CM_S2 0 1 /end CHARACTERISTIC
/begin CHARACTERISTIC XS_USE_DKFILT_ECO "" VALUE 0x1D8F32 _REC_S1VAL_1_u1_S2 1 _CNV_S_2_Schalter_A_4_CM_S2 0 1 /end CHARACTERISTIC
/begin CHARACTERISTIC XS_USE_DMFS_TIPP "" VALUE 0x1D911C _REC_S1VAL_1_u1_S2 1 _CNV_S_2_Schalter_A_4_CM_S2 0 1 /end CHARACTERISTIC
/begin CHARACTERISTIC XS_USE_DMRSVG_SKLKD "" VALUE 0x1D9149 _REC_S1VAL_1_u1_S2 1 _CNV_S_2_Schalter_A_4_CM_S2 0 1 /end CHARACTERISTIC
/begin CHARACTERISTIC XS_USE_DMRSVG_TIMERRESET "" VALUE 0x1D914A _REC_S1VAL_1_u1_S2 1 _CNV_S_2_Schalter_A_4_CM_S2 0 1 /end CHARACTERISTIC
/begin CHARACTERISTIC XS_USE_DSCAUS_ABREGLERSCHLUPF "" VALUE 0x1D9622 _REC_S1VAL_1_u1_S2 1 _CNV_S_2_Schalter_A_4_CM_S2 0 1 /end CHARACTERISTIC
/begin CHARACTERISTIC XS_USE_DSCEINMUELOW "" VALUE 0x1D9635 _REC_S1VAL_1_u1_S2 1 _CNV_R_R_Umr_1_zu_1_2_CM_S2 0 1 FORMAT "%2.0" /end CHARACTERISTIC
/begin CHARACTERISTIC XS_USE_DSC_STATUS_FDS "" VALUE 0x1D957B _REC_S1VAL_1_u1_S2 1 _CNV_R_R_Umr_1_zu_1_2_CM_S2 0 1 FORMAT "%2.0" /end CHARACTERISTIC
/begin CHARACTERISTIC XS_USE_DUENESSTEP "" VALUE 0x1D97A2 _REC_S1VAL_1_u1_S2 1 _CNV_S_2_Schalter_A_4_CM_S2 0 1 /end CHARACTERISTIC
/begin CHARACTERISTIC XS_USE_DYNAMIKIDX_DKG "" VALUE 0x1D9660 _REC_S1VAL_1_u1_S2 1 _CNV_S_2_Schalter_A_4_CM_S2 0 1 /end CHARACTERISTIC
/begin CHARACTERISTIC XS_USE_DYNAMIKZYK_WL2 "" VALUE 0x1D9109 _REC_S1VAL_1_u1_S2 1 _CNV_R_R_Umr_1_zu_1_2_CM_S2 0 1 FORMAT "%2.0" /end CHARACTERISTIC
/begin CHARACTERISTIC XS_USE_DYNDZM_EGS "" VALUE 0x1D953A _REC_S1VAL_1_u1_S2 1 _CNV_R_R_Umr_1_zu_1_2_CM_S2 0 1 /end CHARACTERISTIC
/begin CHARACTERISTIC XS_USE_DYNDZM_HSTIME_HS "" VALUE 0x1D953B _REC_S1VAL_1_u1_S2 1 _CNV_R_R_Umr_1_zu_1_2_CM_S2 0 1 /end CHARACTERISTIC
/begin CHARACTERISTIC XS_USE_DYNDZM_HSTIME_RS "" VALUE 0x1D953C _REC_S1VAL_1_u1_S2 1 _CNV_R_R_Umr_1_zu_1_2_CM_S2 0 1 /end CHARACTERISTIC
/begin CHARACTERISTIC XS_USE_DYNHSPVFILT "" VALUE 0x1D9643 _REC_S1VAL_1_u1_S2 1 _CNV_S_2_Enum_EDYNH_202_CM_S2 0 1 /end CHARACTERISTIC
/begin CHARACTERISTIC XS_USE_DYNHSPV_HS "" VALUE 0x1D9126 _REC_S1VAL_1_u1_S2 1 _CNV_S_2_Schalter_A_4_CM_S2 0 1 /end CHARACTERISTIC
/begin CHARACTERISTIC XS_USE_DYNHSPV_RS "" VALUE 0x1D9127 _REC_S1VAL_1_u1_S2 1 _CNV_S_2_Schalter_A_4_CM_S2 0 1 /end CHARACTERISTIC
/begin CHARACTERISTIC XS_USE_EFAHREN_ERK "" VALUE 0x1D95E7 _REC_S1VAL_1_u1_S2 255 _CNV_R_R_Umr_1_zu_1_2_CM_S2 0 255 /end CHARACTERISTIC
/begin CHARACTERISTIC XS_USE_EM1POT_ZKA "" VALUE 0x1D9776 _REC_S1VAL_1_u1_S2 1 _CNV_R_R_Umr_1_zu_1_2_CM_S2 0 1 FORMAT "%2.0" /end CHARACTERISTIC
/begin CHARACTERISTIC XS_USE_EM2POT_ZKA "" VALUE 0x1D9777 _REC_S1VAL_1_u1_S2 1 _CNV_R_R_Umr_1_zu_1_2_CM_S2 0 1 FORMAT "%2.0" /end CHARACTERISTIC
/begin CHARACTERISTIC XS_USE_FREEZE_FWS "" VALUE 0x1D9580 _REC_S1VAL_1_u1_S2 1 _CNV_R_R_Umr_1_zu_1_2_CM_S2 0 1 FORMAT "%2.0" /end CHARACTERISTIC
/begin CHARACTERISTIC XS_USE_FREEZE_FWSFAST "" VALUE 0x1D9581 _REC_S1VAL_1_u1_S2 1 _CNV_R_R_Umr_1_zu_1_2_CM_S2 0 1 FORMAT "%2.0" /end CHARACTERISTIC
/begin CHARACTERISTIC XS_USE_FREEZE_FWSSLOW "" VALUE 0x1D9582 _REC_S1VAL_1_u1_S2 1 _CNV_R_R_Umr_1_zu_1_2_CM_S2 0 1 FORMAT "%2.0" /end CHARACTERISTIC
/begin CHARACTERISTIC XS_USE_FWS_EINLENK "" VALUE 0x1D9583 _REC_S1VAL_1_u1_S2 1 _CNV_S_2_Schalter_A_4_CM_S2 0 1 /end CHARACTERISTIC
/begin CHARACTERISTIC XS_USE_FWS_STEIGUNG "" VALUE 0x1D9584 _REC_S1VAL_1_u1_S2 1 _CNV_S_2_Schalter_A_4_CM_S2 0 1 /end CHARACTERISTIC
/begin CHARACTERISTIC XS_USE_G2WABMEDFILT "" VALUE 0x1D958D _REC_S1VAL_1_u1_S2 1 _CNV_R_R_Umr_1_zu_1_2_CM_S2 0 1 FORMAT "%2.0" /end CHARACTERISTIC
/begin CHARACTERISTIC XS_USE_G2W_AB_VALIDFWS "" VALUE 0x1D9585 _REC_S1VAL_1_u1_S2 1 _CNV_R_R_Umr_1_zu_1_2_CM_S2 0 1 FORMAT "%2.0" /end CHARACTERISTIC
/begin CHARACTERISTIC XS_USE_GANG_GANGWECHSEL_FLM "" VALUE 0x1D9103 _REC_S1VAL_1_u1_S2 1 _CNV_R_R_Umr_1_zu_1_2_CM_S2 0 1 FORMAT "%2.0" /end CHARACTERISTIC
/begin CHARACTERISTIC XS_USE_GANG_STAND_STEPS "" VALUE 0x1D911D _REC_S1VAL_1_u1_S2 1 _CNV_S_2_Schalter_A_4_CM_S2 0 1 /end CHARACTERISTIC
/begin CHARACTERISTIC XS_USE_GWFPFILT "" VALUE 0x1D9723 _REC_S1VAL_1_u1_S2 1 _CNV_R_R_Umr_1_zu_1_2_CM_S2 0 1 FORMAT "%2.0" /end CHARACTERISTIC
/begin CHARACTERISTIC XS_USE_HSEARLIERLATERDSC "" VALUE 0x1D958E _REC_S1VAL_1_u1_S2 1 _CNV_R_R_Umr_1_zu_1_2_CM_S2 0 1 FORMAT "%2.0" /end CHARACTERISTIC
/begin CHARACTERISTIC XS_USE_HSEARLIERVVT "" VALUE 0x1D9128 _REC_S1VAL_1_u1_S2 1 _CNV_R_R_Umr_1_zu_1_2_CM_S2 0 1 FORMAT "%2.0" /end CHARACTERISTIC
/begin CHARACTERISTIC XS_USE_HSUREHS_SCHALTUNG "" VALUE 0x1D95C6 _REC_S1VAL_1_u1_S2 1 _CNV_S_2_Schalter_A_4_CM_S2 0 1 /end CHARACTERISTIC
/begin CHARACTERISTIC XS_USE_HSURERS_SCHALTUNG "" VALUE 0x1D95CA _REC_S1VAL_1_u1_S2 1 _CNV_S_2_Schalter_A_4_CM_S2 0 1 /end CHARACTERISTIC
/begin CHARACTERISTIC XS_USE_HSWK "" VALUE 0x1D9129 _REC_S1VAL_1_u1_S2 1 _CNV_R_R_Umr_1_zu_1_2_CM_S2 0 1 FORMAT "%2.0" /end CHARACTERISTIC
/begin CHARACTERISTIC XS_USE_HS_WAEHREND_SCHALTUNG "" VALUE 0x1D912A _REC_S1VAL_1_u1_S2 1 _CNV_R_R_Umr_1_zu_1_2_CM_S2 0 1 FORMAT "%2.0" /end CHARACTERISTIC
/begin CHARACTERISTIC XS_USE_KD_ZKA "" VALUE 0x1D9778 _REC_S1VAL_1_u1_S2 1 _CNV_R_R_Umr_1_zu_1_2_CM_S2 0 1 FORMAT "%2.0" /end CHARACTERISTIC
/begin CHARACTERISTIC XS_USE_KURVENVORL "" VALUE 0x1D9135 _REC_S1VAL_1_u1_S2 1 _CNV_R_R_Umr_1_zu_1_2_CM_S2 0 1 FORMAT "%2.0" /end CHARACTERISTIC
/begin CHARACTERISTIC XS_USE_LDMSTATUS "" VALUE 0x1D9608 _REC_S1VAL_1_u1_S2 1 _CNV_R_R_Umr_1_zu_1_2_CM_S2 0 1 FORMAT "%2.0" /end CHARACTERISTIC
/begin CHARACTERISTIC XS_USE_LWVA_XT_DERS "" VALUE 0x1D979D _REC_S1VAL_1_u1_S2 1 _CNV_R_R_Umr_1_zu_1_2_CM_S2 0 1 FORMAT "%2.0" /end CHARACTERISTIC
/begin CHARACTERISTIC XS_USE_MABBREMS "" VALUE 0x1D97AB _REC_S1VAL_1_u1_S2 1 _CNV_R_R_Umr_1_zu_1_2_CM_S2 0 1 FORMAT "%2.0" /end CHARACTERISTIC
/begin CHARACTERISTIC XS_USE_MARS "" VALUE 0x1D960D _REC_S1VAL_1_u1_S2 1 _CNV_S_2_Schalter_A_4_CM_S2 0 1 /end CHARACTERISTIC
/begin CHARACTERISTIC XS_USE_MAXGANG_POSR "" VALUE 0x1D8ECD _REC_S1VAL_1_u1_S2 1 _CNV_R_R_Umr_1_zu_1_2_CM_S2 0 1 FORMAT "%2.0" /end CHARACTERISTIC
/begin CHARACTERISTIC XS_USE_MBR4MRADWUNSCH_ZKA "" VALUE 0x1D9779 _REC_S1VAL_1_u1_S2 1 _CNV_R_R_Umr_1_zu_1_2_CM_S2 0 1 FORMAT "%2.0" /end CHARACTERISTIC
/begin CHARACTERISTIC XS_USE_MDSRSDYN "" VALUE 0x1D9626 _REC_S1VAL_1_u1_S2 1 _CNV_S_2_Schalter_A_4_CM_S2 0 1 /end CHARACTERISTIC
/begin CHARACTERISTIC XS_USE_MFRSPRUEFUNG_ZKA "" VALUE 0x1D977A _REC_S1VAL_1_u1_S2 1 _CNV_R_R_Umr_1_zu_1_2_CM_S2 0 1 FORMAT "%2.0" /end CHARACTERISTIC
/begin CHARACTERISTIC XS_USE_MUELOWAUSAL "" VALUE 0x1D9636 _REC_S1VAL_1_u1_S2 1 _CNV_R_R_Umr_1_zu_1_2_CM_S2 0 1 FORMAT "%2.0" /end CHARACTERISTIC
/begin CHARACTERISTIC XS_USE_MUELOWAUSMUE "" VALUE 0x1D9637 _REC_S1VAL_1_u1_S2 1 _CNV_R_R_Umr_1_zu_1_2_CM_S2 0 1 FORMAT "%2.0" /end CHARACTERISTIC
/begin CHARACTERISTIC XS_USE_NMOTHSVIRT_SCHALTNEU "" VALUE 0x1D9644 _REC_S1VAL_1_u1_S2 1 _CNV_S_2_Schalter_A_4_CM_S2 0 1 /end CHARACTERISTIC
/begin CHARACTERISTIC XS_USE_NMOTVIRT_DBM "" VALUE 0x1D8F3A _REC_S1VAL_1_u1_S2 2 _CNV_R_R_Umr_1_zu_1_2_CM_S2 0 2 FORMAT "%2.0" /end CHARACTERISTIC
/begin CHARACTERISTIC XS_USE_PRISQDBM_LDM_DBM "" VALUE 0x1D8F3B _REC_S1VAL_1_u1_S2 1 _CNV_R_R_Umr_1_zu_1_2_CM_S2 0 1 FORMAT "%2.0" /end CHARACTERISTIC
/begin CHARACTERISTIC XS_USE_PRISQZKA_LDM_ZKA "" VALUE 0x1D977B _REC_S1VAL_1_u1_S2 1 _CNV_R_R_Umr_1_zu_1_2_CM_S2 0 1 FORMAT "%2.0" /end CHARACTERISTIC
/begin CHARACTERISTIC XS_USE_REGELBREMSUNG "" VALUE 0x1D97AC _REC_S1VAL_1_u1_S2 1 _CNV_R_R_Umr_1_zu_1_2_CM_S2 0 1 FORMAT "%2.0" /end CHARACTERISTIC
/begin CHARACTERISTIC XS_USE_RENNSTARTGANG2 "" VALUE 0x1D911E _REC_S1VAL_1_u1_S2 1 _CNV_S_2_Schalter_A_4_CM_S2 0 1 /end CHARACTERISTIC
/begin CHARACTERISTIC XS_USE_RESETGWFPLDMMOD "" VALUE 0x1D9609 _REC_S1VAL_1_u1_S2 1 _CNV_S_2_Schalter_A_4_CM_S2 0 1 /end CHARACTERISTIC
/begin CHARACTERISTIC XS_USE_ROLLE "" VALUE 0x1D9666 _REC_S1VAL_1_u1_S2 1 _CNV_R_R_Umr_1_zu_1_2_CM_S2 0 1 FORMAT "%2.0" /end CHARACTERISTIC
/begin CHARACTERISTIC XS_USE_ROLLEMUELOWRESET "" VALUE 0x1D9638 _REC_S1VAL_1_u1_S2 1 _CNV_R_R_Umr_1_zu_1_2_CM_S2 0 1 FORMAT "%2.0" /end CHARACTERISTIC
/begin CHARACTERISTIC XS_USE_ROLLE_CAN "" VALUE 0x1D9667 _REC_S1VAL_1_u1_S2 1 _CNV_R_R_Umr_1_zu_1_2_CM_S2 0 1 FORMAT "%2.0" /end CHARACTERISTIC
/begin CHARACTERISTIC XS_USE_SCHALTDYN_FREEZE "" VALUE 0x1D910A _REC_S1VAL_1_u1_S2 1 _CNV_S_2_Schalter_A_4_CM_S2 0 1 /end CHARACTERISTIC
/begin CHARACTERISTIC XS_USE_SCHLUPFBUFFER_ABS "" VALUE 0x1D9639 _REC_S1VAL_1_u1_S2 1 _CNV_R_R_Umr_1_zu_1_2_CM_S2 0 1 FORMAT "%2.0" /end CHARACTERISTIC
/begin CHARACTERISTIC XS_USE_SCHLUPFNACHLAUFZWEI_SSTEP "" VALUE 0x1D911F _REC_S1VAL_1_u1_S2 1 _CNV_R_R_Umr_1_zu_1_2_CM_S2 0 1 FORMAT "%2.0" /end CHARACTERISTIC
/begin CHARACTERISTIC XS_USE_SCHLUPF_FWSFREEZE "" VALUE 0x1D9586 _REC_S1VAL_1_u1_S2 1 _CNV_R_R_Umr_1_zu_1_2_CM_S2 0 1 FORMAT "%2.0" /end CHARACTERISTIC
/begin CHARACTERISTIC XS_USE_SEQDDHS_ZKA "" VALUE 0x1D977C _REC_S1VAL_1_u1_S2 1 _CNV_R_R_Umr_1_zu_1_2_CM_S2 0 1 FORMAT "%2.0" /end CHARACTERISTIC
/begin CHARACTERISTIC XS_USE_SEQ_ZKA "" VALUE 0x1D977D _REC_S1VAL_1_u1_S2 1 _CNV_R_R_Umr_1_zu_1_2_CM_S2 0 1 FORMAT "%2.0" /end CHARACTERISTIC
/begin CHARACTERISTIC XS_USE_SPA "" VALUE 0x1D971C _REC_S1VAL_1_u1_S2 1 _CNV_S_2_Schalter_A_4_CM_S2 0 1 /end CHARACTERISTIC
/begin CHARACTERISTIC XS_USE_STEIGUNG_FWSKOMP "" VALUE 0x1D95EB _REC_S1VAL_1_u1_S2 1 _CNV_S_2_Schalter_A_4_CM_S2 0 1 /end CHARACTERISTIC
/begin CHARACTERISTIC XS_USE_TIPP_PADDLE "" VALUE 0x1D9721 _REC_S1VAL_1_u1_S2 1 _CNV_R_R_Umr_1_zu_1_2_CM_S2 0 1 FORMAT "%2.0" /end CHARACTERISTIC
/begin CHARACTERISTIC XS_USE_VALIDFWS "" VALUE 0x1D9587 _REC_S1VAL_1_u1_S2 1 _CNV_R_R_Umr_1_zu_1_2_CM_S2 0 1 FORMAT "%2.0" /end CHARACTERISTIC
/begin CHARACTERISTIC XS_USE_WLSPV "" VALUE 0x1D9724 _REC_S1VAL_1_u1_S2 1 _CNV_R_R_Umr_1_zu_1_2_CM_S2 0 1 FORMAT "%2.0" /end CHARACTERISTIC
/begin CHARACTERISTIC XS_USE_Z_GANG_IST_ANZEIGE_FREEZE "" VALUE 0x1D8F55 _REC_S1VAL_1_u1_S2 1 _CNV_S_2_Schalter_A_4_CM_S2 0 1 /end CHARACTERISTIC
/begin CHARACTERISTIC XS_USE_Z_GANG_ZIEL_ANZEIGE_FREEZ "" VALUE 0x1D8F56 _REC_S1VAL_1_u1_S2 1 _CNV_S_2_Schalter_A_4_CM_S2 0 1 /end CHARACTERISTIC
/begin CHARACTERISTIC XS_WARTEZEIT_ZWHS_DYNDZM "" VALUE 0x1D953D _REC_S1VAL_1_u1_S2 1 _CNV_R_R_Umr_1_zu_1_2_CM_S2 0 1 /end CHARACTERISTIC
/begin CHARACTERISTIC XS_WDKKDPS_HSURE "" VALUE 0x1D95C4 _REC_S1VAL_1_u1_S2 1 _CNV_R_R_Umr_1_zu_1_2_CM_S2 0 1 FORMAT "%2.0" /end CHARACTERISTIC
/begin CHARACTERISTIC XS_WKSCHLUPF_HIGANG_ZKA "" VALUE 0x1D8F3C _REC_S1VAL_1_u1_S2 1 _CNV_S_2_Schalter_A_4_CM_S2 0 1 /end CHARACTERISTIC
/begin CHARACTERISTIC XS_ZHS_VERBOT_STEPS "" VALUE 0x1D9120 _REC_S1VAL_1_u1_S2 1 _CNV_S_2_Schalter_A_4_CM_S2 0 1 /end CHARACTERISTIC
/begin CHARACTERISTIC XS_ZIELGANG_AGS_ANZEIGEGANG "" VALUE 0x1D95F0 _REC_S1VAL_1_u1_S2 1 _CNV_R_R_Umr_1_zu_1_2_CM_S2 0 1 FORMAT "%2.0" /end CHARACTERISTIC
/begin CHARACTERISTIC XS_ZIELGANG_AGS_DBM "" VALUE 0x1D95F1 _REC_S1VAL_1_u1_S2 1 _CNV_R_R_Umr_1_zu_1_2_CM_S2 0 1 FORMAT "%2.0" /end CHARACTERISTIC
/begin CHARACTERISTIC XS_ZIELGANG_AGS_DYNDZM "" VALUE 0x1D95F2 _REC_S1VAL_1_u1_S2 1 _CNV_R_R_Umr_1_zu_1_2_CM_S2 0 1 FORMAT "%2.0" /end CHARACTERISTIC
/begin CHARACTERISTIC XS_ZIELGANG_AGS_HSURE "" VALUE 0x1D95F3 _REC_S1VAL_1_u1_S2 1 _CNV_R_R_Umr_1_zu_1_2_CM_S2 0 1 FORMAT "%2.0" /end CHARACTERISTIC
/begin CHARACTERISTIC XS_ZIELGANG_AGS_REST "" VALUE 0x1D95F4 _REC_S1VAL_1_u1_S2 1 _CNV_R_R_Umr_1_zu_1_2_CM_S2 0 1 FORMAT "%2.0" /end CHARACTERISTIC
/begin CHARACTERISTIC XS_ZIELGANG_AGS_SKL "" VALUE 0x1D95F5 _REC_S1VAL_1_u1_S2 1 _CNV_R_R_Umr_1_zu_1_2_CM_S2 0 1 FORMAT "%2.0" /end CHARACTERISTIC
/begin CHARACTERISTIC XS_ZIELGANG_AGS_SSTEP "" VALUE 0x1D95F6 _REC_S1VAL_1_u1_S2 1 _CNV_R_R_Umr_1_zu_1_2_CM_S2 0 1 FORMAT "%2.0" /end CHARACTERISTIC
/begin CHARACTERISTIC XS_ZIELGANG_AGS_WK "" VALUE 0x1D95F7 _REC_S1VAL_1_u1_S2 1 _CNV_R_R_Umr_1_zu_1_2_CM_S2 0 1 FORMAT "%2.0" /end CHARACTERISTIC
/begin CHARACTERISTIC XS_ZIELGANG_AGS_ZKA "" VALUE 0x1D95F8 _REC_S1VAL_1_u1_S2 1 _CNV_R_R_Umr_1_zu_1_2_CM_S2 0 1 FORMAT "%2.0" /end CHARACTERISTIC
/begin CHARACTERISTIC XS_Z_DYNAMIK_IDXGRBDYN "" VALUE 0x1D910B _REC_S1VAL_1_u1_S2 1 _CNV_S_2_Schalter_A_4_CM_S2 0 1 /end CHARACTERISTIC
/begin CHARACTERISTIC XTAB100S_PRISQ_FIND "" CURVE 0x1D97C8 _REC_A1CUR_30_u4_u1_S2 4294970000 _CNV_R_R_Umr_1_zu_1_2_CM_S2 0 4294967295
 /begin AXIS_DESCR FIX_AXIS Z_PRISQ_PRIOIDX _CNV_S_100_Enum_EPRIS_25_CM_S2 100 0 99 READ_ONLY FIX_AXIS_PAR_DIST 0 1 100 /end AXIS_DESCR
 FORMAT "%2.0" /end CHARACTERISTIC
/begin CHARACTERISTIC XTAB100X12S_PRISQ_KOEN "" MAP 0x1D9C14 _REC_A1MAP_8_u1_u2_u1_S2 1 _CNV_R_R_Umr_1_zu_1_2_CM_S2 0 1
 /begin AXIS_DESCR FIX_AXIS NO_INPUT_QUANTITY _CNV_S_12_Enum_EKOPF_86_CM_S2 12 0 11 READ_ONLY FIX_AXIS_PAR_DIST 0 1 12 /end AXIS_DESCR
 /begin AXIS_DESCR FIX_AXIS Z_PRISQ_PRIOIDX _CNV_S_100_Enum_EPRIS_25_CM_S2 100 0 99 READ_ONLY FIX_AXIS_PAR_DIST 0 1 100 /end AXIS_DESCR
 FORMAT "%2.0" /end CHARACTERISTIC
/begin CHARACTERISTIC XTAB100X13S_ADD_FKTENBL "" MAP 0x1DA0C4 _REC_A1MAP_8_u1_u2_u1_S2 100 _CNV_R_R_Umr_1_zu_1_2_CM_S2 0 100
 /begin AXIS_DESCR FIX_AXIS NO_INPUT_QUANTITY _CNV_S_13_Enum_EADDF_85_CM_S2 13 0 12 READ_ONLY FIX_AXIS_PAR_DIST 0 1 13 /end AXIS_DESCR
 /begin AXIS_DESCR FIX_AXIS Z_PRISQ_PRIOIDX _CNV_S_100_Enum_EPRIS_25_CM_S2 100 0 99 READ_ONLY FIX_AXIS_PAR_DIST 0 1 100 /end AXIS_DESCR
 FORMAT "%2.0" /end CHARACTERISTIC
/begin CHARACTERISTIC XTAB100X13S_PRISQ_HSURE "" MAP 0x1DA5D8 _REC_A1MAP_8_u1_u2_u1_S2 3 _CNV_R_R_Umr_1_zu_1_2_CM_S2 0 3
 /begin AXIS_DESCR FIX_AXIS NO_INPUT_QUANTITY _CNV_S_13_Enum_EHSUR_14_CM_S2 13 0 12 READ_ONLY FIX_AXIS_PAR_DIST 0 1 13 /end AXIS_DESCR
 /begin AXIS_DESCR FIX_AXIS Z_PRISQ_PRIOIDX _CNV_S_100_Enum_EPRIS_25_CM_S2 100 0 99 READ_ONLY FIX_AXIS_PAR_DIST 0 1 100 /end AXIS_DESCR
 FORMAT "%2.0" /end CHARACTERISTIC
/begin CHARACTERISTIC XTAB100X2Z_PRISQ_ZKAIDX_DBM "" MAP 0x1DAAEC _REC_A1MAP_9_u1_u1_u1_S2 9 _CNV_R_R_Umr_1_zu_1_2_CM_S2 1 10
 /begin AXIS_DESCR FIX_AXIS NO_INPUT_QUANTITY _CNV_S_20_Enum_EGLBE_84_CM_S2 2 0 19 READ_ONLY FIX_AXIS_PAR_DIST 0 1 2 /end AXIS_DESCR
 /begin AXIS_DESCR FIX_AXIS Z_PRISQ_PRIOIDX _CNV_S_100_Enum_EPRIS_25_CM_S2 100 0 99 READ_ONLY FIX_AXIS_PAR_DIST 0 1 100 /end AXIS_DESCR
 FORMAT "%2.0" /end CHARACTERISTIC
/begin CHARACTERISTIC XTAB100X2Z_PRISQ_ZKAIDX_ZKA "" MAP 0x1DABB4 _REC_A1MAP_9_u1_u1_u1_S2 4 _CNV_R_R_Umr_1_zu_1_2_CM_S2 1 5
 /begin AXIS_DESCR FIX_AXIS Z_SCHUB_ERK_ZKA _CNV_R_R_Umr_1_zu_1_2_CM_S2 2 0 255 READ_ONLY FIX_AXIS_PAR_DIST 0 1 2 /end AXIS_DESCR
 /begin AXIS_DESCR FIX_AXIS Z_PRISQ_PRIOIDX _CNV_S_100_Enum_EPRIS_25_CM_S2 100 0 99 READ_ONLY FIX_AXIS_PAR_DIST 0 1 100 /end AXIS_DESCR
 FORMAT "%2.0" /end CHARACTERISTIC
/begin CHARACTERISTIC XTAB100Z_PRISQ_DKFILT "" CURVE 0x1D9958 _REC_A1CUR_30_u1_u1_S2 3 _CNV_R_R_Umr_1_zu_1_2_CM_S2 0 3
 /begin AXIS_DESCR FIX_AXIS Z_PRISQ_PRIOIDX _CNV_S_100_Enum_EPRIS_25_CM_S2 100 0 99 READ_ONLY FIX_AXIS_PAR_DIST 0 1 100 /end AXIS_DESCR
 FORMAT "%2.0" /end CHARACTERISTIC
/begin CHARACTERISTIC XTAB100Z_PRISQ_DKPT1 "" CURVE 0x1D99BC _REC_A1CUR_30_u1_u1_S2 3 _CNV_R_R_Umr_1_zu_1_2_CM_S2 0 3
 /begin AXIS_DESCR FIX_AXIS Z_PRISQ_PRIOIDX _CNV_S_100_Enum_EPRIS_25_CM_S2 100 0 99 READ_ONLY FIX_AXIS_PAR_DIST 0 1 100 /end AXIS_DESCR
 FORMAT "%2.0" /end CHARACTERISTIC
/begin CHARACTERISTIC XTAB100Z_PRISQ_DYNDZM "" CURVE 0x1DACE0 _REC_A1CUR_30_u1_u1_S2 1 _CNV_R_R_Umr_1_zu_1_2_CM_S2 0 1
 /begin AXIS_DESCR FIX_AXIS Z_PRISQ_PRIOIDX _CNV_S_100_Enum_EPRIS_25_CM_S2 100 0 99 READ_ONLY FIX_AXIS_PAR_DIST 0 1 100 /end AXIS_DESCR
 FORMAT "%2.0" /end CHARACTERISTIC
/begin CHARACTERISTIC XTAB100Z_PRISQ_FUNK "" CURVE 0x1D9A20 _REC_A1CUR_30_u1_u1_S2 3 _CNV_R_R_Umr_1_zu_1_2_CM_S2 0 3
 /begin AXIS_DESCR FIX_AXIS Z_PRISQ_PRIOIDX _CNV_S_100_Enum_EPRIS_25_CM_S2 100 0 99 READ_ONLY FIX_AXIS_PAR_DIST 0 1 100 /end AXIS_DESCR
 FORMAT "%2.0" /end CHARACTERISTIC
/begin CHARACTERISTIC XTAB100Z_PRISQ_FUNKERW "" CURVE 0x1D9A84 _REC_A1CUR_30_u1_u1_S2 8 _CNV_R_R_Umr_1_zu_1_2_CM_S2 0 8
 /begin AXIS_DESCR FIX_AXIS Z_PRISQ_PRIOIDX _CNV_S_100_Enum_EPRIS_25_CM_S2 100 0 99 READ_ONLY FIX_AXIS_PAR_DIST 0 1 100 /end AXIS_DESCR
 FORMAT "%2.0" /end CHARACTERISTIC
/begin CHARACTERISTIC XTAB100Z_PRISQ_MOTZKA "" CURVE 0x1DAC7C _REC_A1CUR_30_u1_u1_S2 14 _CNV_R_R_Umr_1_zu_1_2_CM_S2 0 14
 /begin AXIS_DESCR FIX_AXIS Z_PRISQ_PRIOIDX _CNV_S_100_Enum_EPRIS_25_CM_S2 100 0 99 READ_ONLY FIX_AXIS_PAR_DIST 0 1 100 /end AXIS_DESCR
 FORMAT "%2.0" /end CHARACTERISTIC
/begin CHARACTERISTIC XTAB100Z_PRISQ_NMOTHSTUPEL "" CURVE 0x1D9AE8 _REC_A1CUR_30_u1_u1_S2 4 _CNV_R_R_Umr_1_zu_1_2_CM_S2 0 4
 /begin AXIS_DESCR FIX_AXIS Z_PRISQ_PRIOIDX _CNV_S_100_Enum_EPRIS_25_CM_S2 100 0 99 READ_ONLY FIX_AXIS_PAR_DIST 0 1 100 /end AXIS_DESCR
 FORMAT "%2.0" /end CHARACTERISTIC
/begin CHARACTERISTIC XTAB100Z_PRISQ_PROG "" CURVE 0x1D9B4C _REC_A1CUR_30_u1_u1_S2 20 _CNV_R_R_Umr_1_zu_1_2_CM_S2 0 20
 /begin AXIS_DESCR FIX_AXIS Z_PRISQ_PRIOIDX _CNV_S_100_Enum_EPRIS_25_CM_S2 100 0 99 READ_ONLY FIX_AXIS_PAR_DIST 0 1 100 /end AXIS_DESCR
 FORMAT "%2.0" /end CHARACTERISTIC
/begin CHARACTERISTIC XTAB100Z_PRISQ_ZHS "" CURVE 0x1D9BB0 _REC_A1CUR_30_u1_u1_S2 1 _CNV_R_R_Umr_1_zu_1_2_CM_S2 0 1
 /begin AXIS_DESCR FIX_AXIS Z_PRISQ_PRIOIDX _CNV_S_100_Enum_EPRIS_25_CM_S2 100 0 99 READ_ONLY FIX_AXIS_PAR_DIST 0 1 100 /end AXIS_DESCR
 FORMAT "%2.0" /end CHARACTERISTIC
/begin CHARACTERISTIC XTAB100_PRISQ_PRIO "" CURVE 0x1DAD44 _REC_A1CUR_30_u2_u1_S2 65535 _CNV_R_R_Umr_1_zu_1_2_CM_S2 0 65535
 /begin AXIS_DESCR FIX_AXIS Z_PRISQ_PRIOIDX _CNV_S_100_Enum_EPRIS_25_CM_S2 100 0 99 READ_ONLY FIX_AXIS_PAR_DIST 0 1 100 /end AXIS_DESCR
 FORMAT "%2.0" /end CHARACTERISTIC
/begin CHARACTERISTIC XTAB10F_MRESERVE_SCHUB_ZKA "" CURVE 0x1E2226 _REC_S7CUR_53_u2_u2_S2 500 _CNV_R_R_Umr_1_zu_1_30_CM_S2 0 500
 /begin AXIS_DESCR STD_AXIS N_AB _CNV_R_R_Umr_1_zu_1_3_CM_S2 10 0 65535 DEPOSIT ABSOLUTE FORMAT "%2.0" /end AXIS_DESCR
 FORMAT "%2.0" /end CHARACTERISTIC
/begin CHARACTERISTIC XTAB10F_MRESERVE_ZUG_ZKA "" CURVE 0x1E2250 _REC_S7CUR_53_u2_u2_S2 500 _CNV_R_R_Umr_1_zu_1_30_CM_S2 0 500
 /begin AXIS_DESCR STD_AXIS N_AB _CNV_R_R_Umr_1_zu_1_3_CM_S2 10 0 65535 DEPOSIT ABSOLUTE FORMAT "%2.0" /end AXIS_DESCR
 FORMAT "%2.0" /end CHARACTERISTIC
/begin CHARACTERISTIC XTAB10M_EM1_POTSCHUB_ZKA "" CURVE 0x1E21A0 _REC_S7CUR_53_u2_u2_S2 200 _CNV_R_R_Umr_1_zu_1_30_CM_S2 0 200
 /begin AXIS_DESCR STD_AXIS DBG_NGE_G_ZKA _CNV_R_R_Umr_1_zu_1_2_CM_S2 10 0 65535 DEPOSIT ABSOLUTE FORMAT "%2.0" /end AXIS_DESCR
 FORMAT "%2.0" /end CHARACTERISTIC
/begin CHARACTERISTIC XTAB10M_EM1_POTZUG_ZKA "" CURVE 0x1E21CA _REC_S7CUR_53_u2_u2_S2 200 _CNV_R_R_Umr_1_zu_1_30_CM_S2 0 200
 /begin AXIS_DESCR STD_AXIS DBG_NGE_G_ZKA _CNV_R_R_Umr_1_zu_1_2_CM_S2 10 0 65535 DEPOSIT ABSOLUTE FORMAT "%2.0" /end AXIS_DESCR
 FORMAT "%2.0" /end CHARACTERISTIC
/begin CHARACTERISTIC XTAB10M_VM_POTSCHUB_ZKA "" CURVE 0x1E227A _REC_S7CUR_53_u2_u2_S2 200 _CNV_R_R_Umr_1_zu_1_30_CM_S2 0 200
 /begin AXIS_DESCR STD_AXIS DBG_NGE_G_ZKA _CNV_R_R_Umr_1_zu_1_2_CM_S2 10 0 65535 DEPOSIT ABSOLUTE FORMAT "%2.0" /end AXIS_DESCR
 FORMAT "%2.0" /end CHARACTERISTIC
/begin CHARACTERISTIC XTAB10M_VM_POTZUG_ZKA "" CURVE 0x1E22A4 _REC_S7CUR_53_u2_u2_S2 200 _CNV_R_R_Umr_1_zu_1_30_CM_S2 0 200
 /begin AXIS_DESCR STD_AXIS DBG_NGE_G_ZKA _CNV_R_R_Umr_1_zu_1_2_CM_S2 10 0 65535 DEPOSIT ABSOLUTE FORMAT "%2.0" /end AXIS_DESCR
 FORMAT "%2.0" /end CHARACTERISTIC
/begin CHARACTERISTIC XTAB10OM_RAD_FWS_ZKA "" CURVE 0x1E22CE _REC_S7CUR_53_u2_u2_S2 32767 _CNV_R_R_Umr_1_zu_1_30_CM_S2 0 32767
 /begin AXIS_DESCR STD_AXIS N_AB _CNV_R_R_Umr_1_zu_1_3_CM_S2 10 0 65535 DEPOSIT ABSOLUTE FORMAT "%2.0" /end AXIS_DESCR
 FORMAT "%2.0" /end CHARACTERISTIC
/begin CHARACTERISTIC XTAB10X2DM_FWSKOMP_FILT_GEW "" MAP 0x1DF1A2 _REC_S3MAP_54_u2_u2_u1_S2 65535 _CNV_R_R_Umr_1_zu_1_30_CM_S2 0 65535
 /begin AXIS_DESCR STD_AXIS V_FZG _CNV_R_R_Umr_1_zu_1_8_CM_S2 10 0 65535 DEPOSIT ABSOLUTE /end AXIS_DESCR
 /begin AXIS_DESCR FIX_AXIS Z_AGS_MODBEDEL _CNV_S_2_Enum_EAGS_18_CM_S2 2 0 1 READ_ONLY FIX_AXIS_PAR_DIST 0 1 2 /end AXIS_DESCR
 FORMAT "%2.0" /end CHARACTERISTIC
/begin CHARACTERISTIC XTAB10X4FAKT_FWSSTEIGUNG_GEW "" MAP 0x1DEAB0 _REC_S7MAP_53_s2_u2_s2_S2 1 _CNV_R_R_Umr_100_zu_42_CM_S2 0 1
 /begin AXIS_DESCR STD_AXIS V_FZG _CNV_R_R_Umr_1_zu_1_8_CM_S2 10 0 500 DEPOSIT ABSOLUTE FORMAT "%2.0" /end AXIS_DESCR
 /begin AXIS_DESCR STD_AXIS NO_INPUT_QUANTITY _CNV_S_4_Enum_EFWSS_240_CM_S2 4 0 3 READ_ONLY DEPOSIT ABSOLUTE /end AXIS_DESCR
 FORMAT "%4.2" /end CHARACTERISTIC
/begin CHARACTERISTIC XTAB10X5M_RADWUNSCH_BRMAX_ZKA "" MAP 0x1E22F8 _REC_S3MAP_54_s2_s2_u2_S2 64000 _CNV_R_R_Umr_1_zu_1_38_CM_S2 -32000 32000
 /begin AXIS_DESCR STD_AXIS NO_INPUT_QUANTITY _CNV_R_R_Umr_1_zu_1_8_CM_S2 10 -32768 32767 DEPOSIT ABSOLUTE FORMAT "%2.0" /end AXIS_DESCR
 /begin AXIS_DESCR FIX_AXIS NO_INPUT_QUANTITY _CNV_S_5_Enum_EZKAT_184_CM_S2 5 0 4 READ_ONLY /begin FIX_AXIS_PAR_LIST 0 1 2 3 4 /end FIX_AXIS_PAR_LIST /end AXIS_DESCR
 FORMAT "%2.0" /end CHARACTERISTIC
/begin CHARACTERISTIC XTAB10X5M_RADWUNSCH_BRMIN_ZKA "" MAP 0x1E2372 _REC_S3MAP_54_s2_s2_u2_S2 64000 _CNV_R_R_Umr_1_zu_1_38_CM_S2 -32000 32000
 /begin AXIS_DESCR STD_AXIS NO_INPUT_QUANTITY _CNV_R_R_Umr_1_zu_1_8_CM_S2 10 -32768 32767 DEPOSIT ABSOLUTE FORMAT "%2.0" /end AXIS_DESCR
 /begin AXIS_DESCR FIX_AXIS NO_INPUT_QUANTITY _CNV_S_5_Enum_EZKAT_184_CM_S2 5 0 4 READ_ONLY /begin FIX_AXIS_PAR_LIST 0 1 2 3 4 /end FIX_AXIS_PAR_LIST /end AXIS_DESCR
 FORMAT "%2.0" /end CHARACTERISTIC
/begin CHARACTERISTIC XTAB12S_KOPFKT_BDLENB_D "" CURVE 0x1DCAC0 _REC_A1CUR_30_u1_u2_S2 1 _CNV_R_R_Umr_1_zu_1_2_CM_S2 0 1
 /begin AXIS_DESCR FIX_AXIS NO_INPUT_QUANTITY _CNV_S_12_Enum_EKOPF_86_CM_S2 12 0 11 READ_ONLY FIX_AXIS_PAR_DIST 0 1 12 /end AXIS_DESCR
 FORMAT "%2.0" /end CHARACTERISTIC
/begin CHARACTERISTIC XTAB12S_KOPFKT_BDLENB_N "" CURVE 0x1DCACC _REC_A1CUR_30_u1_u2_S2 1 _CNV_R_R_Umr_1_zu_1_2_CM_S2 0 1
 /begin AXIS_DESCR FIX_AXIS NO_INPUT_QUANTITY _CNV_S_12_Enum_EKOPF_86_CM_S2 12 0 11 READ_ONLY FIX_AXIS_PAR_DIST 0 1 12 /end AXIS_DESCR
 FORMAT "%2.0" /end CHARACTERISTIC
/begin CHARACTERISTIC XTAB12S_KOPFKT_BDLENB_P "" CURVE 0x1DCAD8 _REC_A1CUR_30_u1_u2_S2 1 _CNV_R_R_Umr_1_zu_1_2_CM_S2 0 1
 /begin AXIS_DESCR FIX_AXIS NO_INPUT_QUANTITY _CNV_S_12_Enum_EKOPF_86_CM_S2 12 0 11 READ_ONLY FIX_AXIS_PAR_DIST 0 1 12 /end AXIS_DESCR
 FORMAT "%2.0" /end CHARACTERISTIC
/begin CHARACTERISTIC XTAB12S_KOPFKT_BDLENB_R "" CURVE 0x1DCAE4 _REC_A1CUR_30_u1_u2_S2 1 _CNV_R_R_Umr_1_zu_1_2_CM_S2 0 1
 /begin AXIS_DESCR FIX_AXIS NO_INPUT_QUANTITY _CNV_S_12_Enum_EKOPF_86_CM_S2 12 0 11 READ_ONLY FIX_AXIS_PAR_DIST 0 1 12 /end AXIS_DESCR
 FORMAT "%2.0" /end CHARACTERISTIC
/begin CHARACTERISTIC XTAB12S_KOPFKT_GLBENBL "" CURVE 0x1DAE0C _REC_A1CUR_30_u1_u2_S2 1 _CNV_R_R_Umr_1_zu_1_2_CM_S2 0 1
 /begin AXIS_DESCR FIX_AXIS NO_INPUT_QUANTITY _CNV_S_12_Enum_EKOPF_86_CM_S2 12 0 11 READ_ONLY FIX_AXIS_PAR_DIST 0 1 12 /end AXIS_DESCR
 FORMAT "%2.0" /end CHARACTERISTIC
/begin CHARACTERISTIC XTAB13GANGMIN_HSURE_TYPE "" CURVE 0x1D95A9 _REC_A1CUR_30_u1_u2_S2 8 _CNV_S_9_Enum_EGANG_21_CM_S2 0 8
 /begin AXIS_DESCR FIX_AXIS NO_INPUT_QUANTITY _CNV_S_13_Enum_EHSUR_14_CM_S2 13 0 12 READ_ONLY FIX_AXIS_PAR_DIST 0 1 13 /end AXIS_DESCR
/end CHARACTERISTIC
/begin CHARACTERISTIC XTAB13M_MOT_MAXSCHLEPP_HDC "" CURVE 0x1DECE4 _REC_S7CUR_53_u2_u2_S2 1024 _CNV_R_R_Umr_1_zu_1_38_CM_S2 0 1024
 /begin AXIS_DESCR STD_AXIS N_MOT_NACHRS_HDC _CNV_R_R_Umr_1_zu_1_3_CM_S2 13 0 20000 DEPOSIT ABSOLUTE FORMAT "%2.0" /end AXIS_DESCR
 FORMAT "%2.0" /end CHARACTERISTIC
/begin CHARACTERISTIC XTAB13SCHSCHLUPF_HSURE "" CURVE 0x1DED8E _REC_A1CUR_30_u2_u2_S2 65535 _CNV_R_R_Umr_1_zu_1_2_CM_S2 0 65535
 /begin AXIS_DESCR FIX_AXIS NO_INPUT_QUANTITY _CNV_S_13_Enum_EHSUR_14_CM_S2 13 0 12 READ_ONLY FIX_AXIS_PAR_DIST 0 1 13 /end AXIS_DESCR
 FORMAT "%2.0" /end CHARACTERISTIC
/begin CHARACTERISTIC XTAB13S_ADDFKT_GLBENBL "" CURVE 0x1D8F17 _REC_A1CUR_30_u1_u2_S2 1 _CNV_R_R_Umr_1_zu_1_2_CM_S2 0 1
 /begin AXIS_DESCR FIX_AXIS NO_INPUT_QUANTITY _CNV_S_13_Enum_EADDF_85_CM_S2 13 0 12 READ_ONLY FIX_AXIS_PAR_DIST 0 1 13 /end AXIS_DESCR
 FORMAT "%2.0" /end CHARACTERISTIC
/begin CHARACTERISTIC XTAB13S_KOOP_HSURE_BDLENB_D "" CURVE 0x1D8ECE _REC_A1CUR_30_u1_u2_S2 1 _CNV_R_R_Umr_1_zu_1_2_CM_S2 0 1
 /begin AXIS_DESCR FIX_AXIS NO_INPUT_QUANTITY _CNV_S_13_Enum_EHSUR_14_CM_S2 13 0 12 READ_ONLY FIX_AXIS_PAR_DIST 0 1 13 /end AXIS_DESCR
 FORMAT "%2.0" /end CHARACTERISTIC
/begin CHARACTERISTIC XTAB13S_KOOP_HSURE_BDLENB_N "" CURVE 0x1D8EDB _REC_A1CUR_30_u1_u2_S2 1 _CNV_R_R_Umr_1_zu_1_2_CM_S2 0 1
 /begin AXIS_DESCR FIX_AXIS NO_INPUT_QUANTITY _CNV_S_13_Enum_EHSUR_14_CM_S2 13 0 12 READ_ONLY FIX_AXIS_PAR_DIST 0 1 13 /end AXIS_DESCR
 FORMAT "%2.0" /end CHARACTERISTIC
/begin CHARACTERISTIC XTAB13S_KOOP_HSURE_BDLENB_P "" CURVE 0x1D8EE8 _REC_A1CUR_30_u1_u2_S2 1 _CNV_R_R_Umr_1_zu_1_2_CM_S2 0 1
 /begin AXIS_DESCR FIX_AXIS NO_INPUT_QUANTITY _CNV_S_13_Enum_EHSUR_14_CM_S2 13 0 12 READ_ONLY FIX_AXIS_PAR_DIST 0 1 13 /end AXIS_DESCR
 FORMAT "%2.0" /end CHARACTERISTIC
/begin CHARACTERISTIC XTAB13S_KOOP_HSURE_BDLENB_R "" CURVE 0x1D8EF5 _REC_A1CUR_30_u1_u2_S2 1 _CNV_R_R_Umr_1_zu_1_2_CM_S2 0 1
 /begin AXIS_DESCR FIX_AXIS NO_INPUT_QUANTITY _CNV_S_13_Enum_EHSUR_14_CM_S2 13 0 12 READ_ONLY FIX_AXIS_PAR_DIST 0 1 13 /end AXIS_DESCR
 FORMAT "%2.0" /end CHARACTERISTIC
/begin CHARACTERISTIC XTAB13S_KOOP_HSURE_GLBENBL "" CURVE 0x1D8F24 _REC_A1CUR_30_u1_u2_S2 1 _CNV_R_R_Umr_1_zu_1_2_CM_S2 0 1
 /begin AXIS_DESCR FIX_AXIS NO_INPUT_QUANTITY _CNV_S_13_Enum_EHSUR_14_CM_S2 13 0 12 READ_ONLY FIX_AXIS_PAR_DIST 0 1 13 /end AXIS_DESCR
 FORMAT "%2.0" /end CHARACTERISTIC
/begin CHARACTERISTIC XTAB13S_SOC_FAKT_HSURETYPE "" CURVE 0x1D95B6 _REC_A1CUR_30_u1_u2_S2 1 _CNV_R_R_Umr_1_zu_1_2_CM_S2 0 1
 /begin AXIS_DESCR FIX_AXIS NO_INPUT_QUANTITY _CNV_S_13_Enum_EHSUR_14_CM_S2 13 0 12 READ_ONLY FIX_AXIS_PAR_DIST 0 1 13 /end AXIS_DESCR
 FORMAT "%2.0" /end CHARACTERISTIC
/begin CHARACTERISTIC XTAB13X4SCHNMOT_HSURE_TYPE "" MAP 0x1DC6FC _REC_A1MAP_9_u2_u2_u1_S2 20000 _CNV_R_R_Umr_1_zu_1_3_CM_S2 0 20000
 /begin AXIS_DESCR FIX_AXIS NO_INPUT_QUANTITY _CNV_S_13_Enum_EHSUR_14_CM_S2 13 0 12 READ_ONLY FIX_AXIS_PAR_DIST 0 1 13 /end AXIS_DESCR
 /begin AXIS_DESCR FIX_AXIS Z_AGSMOD_ECO_EFAHREN _CNV_S_4_Enum_EAGS__17_CM_S2 4 0 3 READ_ONLY FIX_AXIS_PAR_DIST 0 1 4 /end AXIS_DESCR
 FORMAT "%2.0" /end CHARACTERISTIC
/begin CHARACTERISTIC XTAB14X19Z_DYNDZM_FIND "" MAP 0x1DE974 _REC_A1MAP_8_u1_u1_u1_S2 255 _CNV_R_R_Umr_1_zu_1_2_CM_S2 0 255
 /begin AXIS_DESCR FIX_AXIS NO_INPUT_QUANTITY _CNV_S_14_Enum_EDYND_131_CM_S2 14 0 13 READ_ONLY FIX_AXIS_PAR_DIST 0 1 14 /end AXIS_DESCR
 /begin AXIS_DESCR FIX_AXIS NO_INPUT_QUANTITY _CNV_R_R_Umr_1_zu_1_2_CM_S2 19 0 18 READ_ONLY FIX_AXIS_PAR_DIST 0 1 19 /end AXIS_DESCR
/end CHARACTERISTIC
/begin CHARACTERISTIC XTAB15S_DYNAMIK_GLBENBL "" CURVE 0x1D8F7D _REC_A1CUR_30_u1_u2_S2 1 _CNV_R_R_Umr_1_zu_1_2_CM_S2 0 1
 /begin AXIS_DESCR FIX_AXIS NO_INPUT_QUANTITY _CNV_S_15_Enum_EDYNA_160_CM_S2 15 0 14 READ_ONLY FIX_AXIS_PAR_DIST 0 1 15 /end AXIS_DESCR
 FORMAT "%2.0" /end CHARACTERISTIC
/begin CHARACTERISTIC XTAB15X11S_PRISQ_SPA_FIND "" MAP 0x1D9668 _REC_A1MAP_8_u1_u1_u1_S2 1 _CNV_R_R_Umr_1_zu_1_2_CM_S2 0 1
 /begin AXIS_DESCR FIX_AXIS NO_INPUT_QUANTITY _CNV_S_11_Enum_EFKT__272_CM_S2 11 0 10 READ_ONLY FIX_AXIS_PAR_DIST 0 1 11 /end AXIS_DESCR
 /begin AXIS_DESCR FIX_AXIS Z_PRISQ_SPA_PRIOIDX _CNV_S_15_Enum_EPRIS_274_CM_S2 15 0 14 READ_ONLY FIX_AXIS_PAR_DIST 0 1 15 /end AXIS_DESCR
 FORMAT "%2.0" /end CHARACTERISTIC
/begin CHARACTERISTIC XTAB15X5M_RADOPTZ_AKTGANG1_ZKA "" MAP 0x1E2A6A _REC_A1MAP_8_u2_u2_u2_S2 1000 _CNV_R_R_Umr_1_zu_1_30_CM_S2 0 1000
 /begin AXIS_DESCR COM_AXIS N_AB _CNV_R_R_Umr_1_zu_1_3_CM_S2 15 0 65535 DEPOSIT ABSOLUTE AXIS_PTS_REF SSTTAB_MRADOPTZ_GANG1 /end AXIS_DESCR
 /begin AXIS_DESCR FIX_AXIS NO_INPUT_QUANTITY _CNV_S_5_Enum_EZKAT_184_CM_S2 5 0 4 READ_ONLY /begin FIX_AXIS_PAR_LIST 0 1 2 3 4 /end FIX_AXIS_PAR_LIST /end AXIS_DESCR
 FORMAT "%2.0" /end CHARACTERISTIC
/begin CHARACTERISTIC XTAB15X5M_RADOPTZ_AKTGANG2_ZKA "" MAP 0x1E2B00 _REC_A1MAP_8_u2_u2_u2_S2 1000 _CNV_R_R_Umr_1_zu_1_30_CM_S2 0 1000
 /begin AXIS_DESCR COM_AXIS N_AB _CNV_R_R_Umr_1_zu_1_3_CM_S2 15 0 65535 DEPOSIT ABSOLUTE AXIS_PTS_REF SSTTAB_MRADOPTZ_GANG2 /end AXIS_DESCR
 /begin AXIS_DESCR FIX_AXIS NO_INPUT_QUANTITY _CNV_S_5_Enum_EZKAT_184_CM_S2 5 0 4 READ_ONLY /begin FIX_AXIS_PAR_LIST 0 1 2 3 4 /end FIX_AXIS_PAR_LIST /end AXIS_DESCR
 FORMAT "%2.0" /end CHARACTERISTIC
/begin CHARACTERISTIC XTAB15X5M_RADOPTZ_AKTGANG3_ZKA "" MAP 0x1E2B96 _REC_A1MAP_8_u2_u2_u2_S2 1000 _CNV_R_R_Umr_1_zu_1_30_CM_S2 0 1000
 /begin AXIS_DESCR COM_AXIS N_AB _CNV_R_R_Umr_1_zu_1_3_CM_S2 15 0 65535 DEPOSIT ABSOLUTE AXIS_PTS_REF SSTTAB_MRADOPTZ_GANG3 /end AXIS_DESCR
 /begin AXIS_DESCR FIX_AXIS NO_INPUT_QUANTITY _CNV_S_5_Enum_EZKAT_184_CM_S2 5 0 4 READ_ONLY /begin FIX_AXIS_PAR_LIST 0 1 2 3 4 /end FIX_AXIS_PAR_LIST /end AXIS_DESCR
 FORMAT "%2.0" /end CHARACTERISTIC
/begin CHARACTERISTIC XTAB15X5M_RADOPTZ_AKTGANG4_ZKA "" MAP 0x1E2C2C _REC_A1MAP_8_u2_u2_u2_S2 1000 _CNV_R_R_Umr_1_zu_1_30_CM_S2 0 1000
 /begin AXIS_DESCR COM_AXIS N_AB _CNV_R_R_Umr_1_zu_1_3_CM_S2 15 0 65535 DEPOSIT ABSOLUTE AXIS_PTS_REF SSTTAB_MRADOPTZ_GANG4 /end AXIS_DESCR
 /begin AXIS_DESCR FIX_AXIS NO_INPUT_QUANTITY _CNV_S_5_Enum_EZKAT_184_CM_S2 5 0 4 READ_ONLY /begin FIX_AXIS_PAR_LIST 0 1 2 3 4 /end FIX_AXIS_PAR_LIST /end AXIS_DESCR
 FORMAT "%2.0" /end CHARACTERISTIC
/begin CHARACTERISTIC XTAB15X5M_RADOPTZ_AKTGANG5_ZKA "" MAP 0x1E2CC2 _REC_A1MAP_8_u2_u2_u2_S2 1000 _CNV_R_R_Umr_1_zu_1_30_CM_S2 0 1000
 /begin AXIS_DESCR COM_AXIS N_AB _CNV_R_R_Umr_1_zu_1_3_CM_S2 15 0 65535 DEPOSIT ABSOLUTE AXIS_PTS_REF SSTTAB_MRADOPTZ_GANG5 /end AXIS_DESCR
 /begin AXIS_DESCR FIX_AXIS NO_INPUT_QUANTITY _CNV_S_5_Enum_EZKAT_184_CM_S2 5 0 4 READ_ONLY /begin FIX_AXIS_PAR_LIST 0 1 2 3 4 /end FIX_AXIS_PAR_LIST /end AXIS_DESCR
 FORMAT "%2.0" /end CHARACTERISTIC
/begin CHARACTERISTIC XTAB15X5M_RADOPTZ_AKTGANG6_ZKA "" MAP 0x1E2D58 _REC_A1MAP_8_u2_u2_u2_S2 1000 _CNV_R_R_Umr_1_zu_1_30_CM_S2 0 1000
 /begin AXIS_DESCR COM_AXIS N_AB _CNV_R_R_Umr_1_zu_1_3_CM_S2 15 0 65535 DEPOSIT ABSOLUTE AXIS_PTS_REF SSTTAB_MRADOPTZ_GANG6 /end AXIS_DESCR
 /begin AXIS_DESCR FIX_AXIS NO_INPUT_QUANTITY _CNV_S_5_Enum_EZKAT_184_CM_S2 5 0 4 READ_ONLY /begin FIX_AXIS_PAR_LIST 0 1 2 3 4 /end FIX_AXIS_PAR_LIST /end AXIS_DESCR
 FORMAT "%2.0" /end CHARACTERISTIC
/begin CHARACTERISTIC XTAB15X5M_RADOPTZ_AKTGANG7_ZKA "" MAP 0x1E2DEE _REC_A1MAP_8_u2_u2_u2_S2 1000 _CNV_R_R_Umr_1_zu_1_30_CM_S2 0 1000
 /begin AXIS_DESCR COM_AXIS N_AB _CNV_R_R_Umr_1_zu_1_3_CM_S2 15 0 65535 DEPOSIT ABSOLUTE AXIS_PTS_REF SSTTAB_MRADOPTZ_GANG7 /end AXIS_DESCR
 /begin AXIS_DESCR FIX_AXIS NO_INPUT_QUANTITY _CNV_S_5_Enum_EZKAT_184_CM_S2 5 0 4 READ_ONLY /begin FIX_AXIS_PAR_LIST 0 1 2 3 4 /end FIX_AXIS_PAR_LIST /end AXIS_DESCR
 FORMAT "%2.0" /end CHARACTERISTIC
/begin CHARACTERISTIC XTAB15X5M_RADOPTZ_AKTGANG8_ZKA "" MAP 0x1E2E84 _REC_A1MAP_8_u2_u2_u2_S2 1000 _CNV_R_R_Umr_1_zu_1_30_CM_S2 0 1000
 /begin AXIS_DESCR COM_AXIS N_AB _CNV_R_R_Umr_1_zu_1_3_CM_S2 15 0 65535 DEPOSIT ABSOLUTE AXIS_PTS_REF SSTTAB_MRADOPTZ_GANG8 /end AXIS_DESCR
 /begin AXIS_DESCR FIX_AXIS NO_INPUT_QUANTITY _CNV_S_5_Enum_EZKAT_184_CM_S2 5 0 4 READ_ONLY /begin FIX_AXIS_PAR_LIST 0 1 2 3 4 /end FIX_AXIS_PAR_LIST /end AXIS_DESCR
 FORMAT "%2.0" /end CHARACTERISTIC
/begin CHARACTERISTIC XTAB15X5M_RADOPTZ_AKTGANG9_ZKA "" MAP 0x1E2F1A _REC_A1MAP_8_u2_u2_u2_S2 1000 _CNV_R_R_Umr_1_zu_1_30_CM_S2 0 1000
 /begin AXIS_DESCR COM_AXIS N_AB _CNV_R_R_Umr_1_zu_1_3_CM_S2 15 0 65535 DEPOSIT ABSOLUTE AXIS_PTS_REF SSTTAB_MRADOPTZ_GANG9 /end AXIS_DESCR
 /begin AXIS_DESCR FIX_AXIS NO_INPUT_QUANTITY _CNV_S_5_Enum_EZKAT_184_CM_S2 5 0 4 READ_ONLY /begin FIX_AXIS_PAR_LIST 0 1 2 3 4 /end FIX_AXIS_PAR_LIST /end AXIS_DESCR
 FORMAT "%2.0" /end CHARACTERISTIC
/begin CHARACTERISTIC XTAB15X5M_RADOPTZ_LOWGANG1_ZKA "" MAP 0x1E2FB0 _REC_A1MAP_8_u2_u2_u2_S2 1000 _CNV_R_R_Umr_1_zu_1_30_CM_S2 0 1000
 /begin AXIS_DESCR COM_AXIS N_AB _CNV_R_R_Umr_1_zu_1_3_CM_S2 15 0 65535 DEPOSIT ABSOLUTE AXIS_PTS_REF SSTTAB_MRADOPTZ_GANG1 /end AXIS_DESCR
 /begin AXIS_DESCR FIX_AXIS NO_INPUT_QUANTITY _CNV_S_5_Enum_EZKAT_184_CM_S2 5 0 4 READ_ONLY /begin FIX_AXIS_PAR_LIST 0 1 2 3 4 /end FIX_AXIS_PAR_LIST /end AXIS_DESCR
 FORMAT "%2.0" /end CHARACTERISTIC
/begin CHARACTERISTIC XTAB15X5M_RADOPTZ_LOWGANG2_ZKA "" MAP 0x1E3046 _REC_A1MAP_8_u2_u2_u2_S2 1000 _CNV_R_R_Umr_1_zu_1_30_CM_S2 0 1000
 /begin AXIS_DESCR COM_AXIS N_AB _CNV_R_R_Umr_1_zu_1_3_CM_S2 15 0 65535 DEPOSIT ABSOLUTE AXIS_PTS_REF SSTTAB_MRADOPTZ_GANG2 /end AXIS_DESCR
 /begin AXIS_DESCR FIX_AXIS NO_INPUT_QUANTITY _CNV_S_5_Enum_EZKAT_184_CM_S2 5 0 4 READ_ONLY /begin FIX_AXIS_PAR_LIST 0 1 2 3 4 /end FIX_AXIS_PAR_LIST /end AXIS_DESCR
 FORMAT "%2.0" /end CHARACTERISTIC
/begin CHARACTERISTIC XTAB15X5M_RADOPTZ_LOWGANG3_ZKA "" MAP 0x1E30DC _REC_A1MAP_8_u2_u2_u2_S2 1000 _CNV_R_R_Umr_1_zu_1_30_CM_S2 0 1000
 /begin AXIS_DESCR COM_AXIS N_AB _CNV_R_R_Umr_1_zu_1_3_CM_S2 15 0 65535 DEPOSIT ABSOLUTE AXIS_PTS_REF SSTTAB_MRADOPTZ_GANG3 /end AXIS_DESCR
 /begin AXIS_DESCR FIX_AXIS NO_INPUT_QUANTITY _CNV_S_5_Enum_EZKAT_184_CM_S2 5 0 4 READ_ONLY /begin FIX_AXIS_PAR_LIST 0 1 2 3 4 /end FIX_AXIS_PAR_LIST /end AXIS_DESCR
 FORMAT "%2.0" /end CHARACTERISTIC
/begin CHARACTERISTIC XTAB15X5M_RADOPTZ_LOWGANG4_ZKA "" MAP 0x1E3172 _REC_A1MAP_8_u2_u2_u2_S2 1000 _CNV_R_R_Umr_1_zu_1_30_CM_S2 0 1000
 /begin AXIS_DESCR COM_AXIS N_AB _CNV_R_R_Umr_1_zu_1_3_CM_S2 15 0 65535 DEPOSIT ABSOLUTE AXIS_PTS_REF SSTTAB_MRADOPTZ_GANG4 /end AXIS_DESCR
 /begin AXIS_DESCR FIX_AXIS NO_INPUT_QUANTITY _CNV_S_5_Enum_EZKAT_184_CM_S2 5 0 4 READ_ONLY /begin FIX_AXIS_PAR_LIST 0 1 2 3 4 /end FIX_AXIS_PAR_LIST /end AXIS_DESCR
 FORMAT "%2.0" /end CHARACTERISTIC
/begin CHARACTERISTIC XTAB15X5M_RADOPTZ_LOWGANG5_ZKA "" MAP 0x1E3208 _REC_A1MAP_8_u2_u2_u2_S2 1000 _CNV_R_R_Umr_1_zu_1_30_CM_S2 0 1000
 /begin AXIS_DESCR COM_AXIS N_AB _CNV_R_R_Umr_1_zu_1_3_CM_S2 15 0 65535 DEPOSIT ABSOLUTE AXIS_PTS_REF SSTTAB_MRADOPTZ_GANG5 /end AXIS_DESCR
 /begin AXIS_DESCR FIX_AXIS NO_INPUT_QUANTITY _CNV_S_5_Enum_EZKAT_184_CM_S2 5 0 4 READ_ONLY /begin FIX_AXIS_PAR_LIST 0 1 2 3 4 /end FIX_AXIS_PAR_LIST /end AXIS_DESCR
 FORMAT "%2.0" /end CHARACTERISTIC
/begin CHARACTERISTIC XTAB15X5M_RADOPTZ_LOWGANG6_ZKA "" MAP 0x1E329E _REC_A1MAP_8_u2_u2_u2_S2 1000 _CNV_R_R_Umr_1_zu_1_30_CM_S2 0 1000
 /begin AXIS_DESCR COM_AXIS N_AB _CNV_R_R_Umr_1_zu_1_3_CM_S2 15 0 65535 DEPOSIT ABSOLUTE AXIS_PTS_REF SSTTAB_MRADOPTZ_GANG6 /end AXIS_DESCR
 /begin AXIS_DESCR FIX_AXIS NO_INPUT_QUANTITY _CNV_S_5_Enum_EZKAT_184_CM_S2 5 0 4 READ_ONLY /begin FIX_AXIS_PAR_LIST 0 1 2 3 4 /end FIX_AXIS_PAR_LIST /end AXIS_DESCR
 FORMAT "%2.0" /end CHARACTERISTIC
/begin CHARACTERISTIC XTAB15X5M_RADOPTZ_LOWGANG7_ZKA "" MAP 0x1E3334 _REC_A1MAP_8_u2_u2_u2_S2 1000 _CNV_R_R_Umr_1_zu_1_30_CM_S2 0 1000
 /begin AXIS_DESCR COM_AXIS N_AB _CNV_R_R_Umr_1_zu_1_3_CM_S2 15 0 65535 DEPOSIT ABSOLUTE AXIS_PTS_REF SSTTAB_MRADOPTZ_GANG7 /end AXIS_DESCR
 /begin AXIS_DESCR FIX_AXIS NO_INPUT_QUANTITY _CNV_S_5_Enum_EZKAT_184_CM_S2 5 0 4 READ_ONLY /begin FIX_AXIS_PAR_LIST 0 1 2 3 4 /end FIX_AXIS_PAR_LIST /end AXIS_DESCR
 FORMAT "%2.0" /end CHARACTERISTIC
/begin CHARACTERISTIC XTAB15X5M_RADOPTZ_LOWGANG8_ZKA "" MAP 0x1E33CA _REC_A1MAP_8_u2_u2_u2_S2 1000 _CNV_R_R_Umr_1_zu_1_30_CM_S2 0 1000
 /begin AXIS_DESCR COM_AXIS N_AB _CNV_R_R_Umr_1_zu_1_3_CM_S2 15 0 65535 DEPOSIT ABSOLUTE AXIS_PTS_REF SSTTAB_MRADOPTZ_GANG8 /end AXIS_DESCR
 /begin AXIS_DESCR FIX_AXIS NO_INPUT_QUANTITY _CNV_S_5_Enum_EZKAT_184_CM_S2 5 0 4 READ_ONLY /begin FIX_AXIS_PAR_LIST 0 1 2 3 4 /end FIX_AXIS_PAR_LIST /end AXIS_DESCR
 FORMAT "%2.0" /end CHARACTERISTIC
/begin CHARACTERISTIC XTAB15X5M_RADOPTZ_LOWGANG9_ZKA "" MAP 0x1E3460 _REC_A1MAP_8_u2_u2_u2_S2 1000 _CNV_R_R_Umr_1_zu_1_30_CM_S2 0 1000
 /begin AXIS_DESCR COM_AXIS N_AB _CNV_R_R_Umr_1_zu_1_3_CM_S2 15 0 65535 DEPOSIT ABSOLUTE AXIS_PTS_REF SSTTAB_MRADOPTZ_GANG9 /end AXIS_DESCR
 /begin AXIS_DESCR FIX_AXIS NO_INPUT_QUANTITY _CNV_S_5_Enum_EZKAT_184_CM_S2 5 0 4 READ_ONLY /begin FIX_AXIS_PAR_LIST 0 1 2 3 4 /end FIX_AXIS_PAR_LIST /end AXIS_DESCR
 FORMAT "%2.0" /end CHARACTERISTIC
/begin CHARACTERISTIC XTAB15Z_PRISQ_SPA_PROG "" CURVE 0x1D970D _REC_A1CUR_30_u1_u1_S2 20 _CNV_R_R_Umr_1_zu_1_2_CM_S2 0 20
 /begin AXIS_DESCR FIX_AXIS Z_PRISQ_SPA_PRIOIDX _CNV_S_15_Enum_EPRIS_274_CM_S2 15 0 14 READ_ONLY FIX_AXIS_PAR_DIST 0 1 15 /end AXIS_DESCR
 FORMAT "%2.0" /end CHARACTERISTIC
/begin CHARACTERISTIC XTAB17SQRT_AFZG "" CURVE 0x1DE87C _REC_S7CUR_53_u2_u2_S2 6553.5 _CNV_R_R_Umr_10_zu__37_CM_S2 0 6553.5
 /begin AXIS_DESCR STD_AXIS A_FZGSQ _CNV_R_R_Umr_100_zu_204_CM_S2 17 0 655.35 DEPOSIT ABSOLUTE FORMAT "%4.2" /end AXIS_DESCR
 FORMAT "%3.1" /end CHARACTERISTIC
/begin CHARACTERISTIC XTAB19X4Z_GLBENBL_DBM "" MAP 0x1DAEE8 _REC_A1MAP_8_s1_s2_u1_S2 1 _CNV_R_R_Umr_1_zu_1_2_CM_S2 0 1
 /begin AXIS_DESCR FIX_AXIS NO_INPUT_QUANTITY _CNV_S_20_Enum_EGLBE_84_CM_S2 20 0 19 READ_ONLY /begin FIX_AXIS_PAR_LIST 0 1 2 3 4 5 6 7 8 9 10 11 12 13 14 15 16 17 18 19 /end FIX_AXIS_PAR_LIST /end AXIS_DESCR
 /begin AXIS_DESCR FIX_AXIS Z_EXCFKT_DBM _CNV_S_4_Enum_EEXCF_91_CM_S2 4 0 3 READ_ONLY /begin FIX_AXIS_PAR_LIST 0 1 2 3 /end FIX_AXIS_PAR_LIST /end AXIS_DESCR
 FORMAT "%2.0" /end CHARACTERISTIC
/begin CHARACTERISTIC XTAB20M_RAD_FWSREF "" CURVE 0x1E271C _REC_S7CUR_53_u2_u2_S2 1500 _CNV_R_R_Umr_1_zu_1_38_CM_S2 0 1500
 /begin AXIS_DESCR STD_AXIS V_FZG _CNV_R_R_Umr_1_zu_1_8_CM_S2 20 0 300 DEPOSIT ABSOLUTE FORMAT "%2.0" /end AXIS_DESCR
 FORMAT "%2.0" /end CHARACTERISTIC
/begin CHARACTERISTIC XTAB20X10S_DMRS_FIND "" MAP 0x1DC1C4 _REC_A1MAP_8_u2_u2_u1_S2 8160 _CNV_R_R_Umr_1_zu_1_2_CM_S2 0 8160
 /begin AXIS_DESCR FIX_AXIS NO_INPUT_QUANTITY _CNV_S_10_Enum_EDMRS_264_CM_S2 10 0 9 READ_ONLY FIX_AXIS_PAR_DIST 0 1 10 /end AXIS_DESCR
 /begin AXIS_DESCR FIX_AXIS Z_DMRS_FINDTABIDX _CNV_R_R_Umr_1_zu_1_2_CM_S2 20 0 19 READ_ONLY FIX_AXIS_PAR_DIST 0 1 20 /end AXIS_DESCR
 FORMAT "%2.0" /end CHARACTERISTIC
/begin CHARACTERISTIC XTAB21SCHN_T_MIN_PROG_DDRS "" CURVE 0x1E265E _REC_A1CUR_30_u2_u1_S2 10000 _CNV_R_R_Umr_1_zu_1_3_CM_S2 0 10000
 /begin AXIS_DESCR FIX_AXIS Z_PROG_FFG _CNV_S_21_Enum_EPROG_27_CM_S2 21 0 20 READ_ONLY FIX_AXIS_PAR_DIST 0 1 21 /end AXIS_DESCR
 FORMAT "%2.0" /end CHARACTERISTIC
/begin CHARACTERISTIC XTAB21S_ON_AB_HS_PROG "" CURVE 0x1DE63A _REC_A1CUR_30_u2_u1_S2 255 _CNV_R_R_Umr_1_zu_1_2_CM_S2 0 255
 /begin AXIS_DESCR FIX_AXIS Z_PROG_FFG _CNV_S_21_Enum_EPROG_27_CM_S2 21 0 20 READ_ONLY FIX_AXIS_PAR_DIST 0 1 21 /end AXIS_DESCR
/end CHARACTERISTIC
/begin CHARACTERISTIC XTAB21Z_PROG_DS2 "" CURVE 0x1D8F02 _REC_A1CUR_30_u1_u1_S2 15 _CNV_S_16_Enum_EPROG_79_CM_S2 0 15
 /begin AXIS_DESCR FIX_AXIS Z_PROG_FFG _CNV_S_21_Enum_EPROG_27_CM_S2 21 0 20 READ_ONLY FIX_AXIS_PAR_DIST 0 1 21 /end AXIS_DESCR
/end CHARACTERISTIC
/begin CHARACTERISTIC XTAB25X15Z_DYNAMIK_FIND "" MAP 0x1D8F8C _REC_A1MAP_8_u1_u2_u1_S2 1 _CNV_R_R_Umr_1_zu_1_2_CM_S2 0 1
 /begin AXIS_DESCR FIX_AXIS NO_INPUT_QUANTITY _CNV_S_15_Enum_EDYNA_160_CM_S2 15 0 14 READ_ONLY FIX_AXIS_PAR_DIST 0 1 15 /end AXIS_DESCR
 /begin AXIS_DESCR FIX_AXIS Z_DYNAMIK_YIDX _CNV_R_R_Umr_1_zu_1_2_CM_S2 25 0 24 READ_ONLY FIX_AXIS_PAR_DIST 0 1 25 /end AXIS_DESCR
 FORMAT "%2.0" /end CHARACTERISTIC
/begin CHARACTERISTIC XTAB25X42Z_SDYN_FIND "" MAP 0x1E1CA6 _REC_A1MAP_8_u1_u1_u1_S2 6 _CNV_R_R_Umr_1_zu_1_2_CM_S2 0 6
 /begin AXIS_DESCR FIX_AXIS Z_QSHIFT_XIDX _CNV_S_42_Enum_EQSHI_164_CM_S2 42 0 41 READ_ONLY FIX_AXIS_PAR_DIST 0 1 42 /end AXIS_DESCR
 /begin AXIS_DESCR FIX_AXIS Z_QSHIFT_YIDX _CNV_R_R_Umr_1_zu_1_2_CM_S2 25 0 24 READ_ONLY FORMAT "%2.0" FIX_AXIS_PAR_DIST 0 1 25 /end AXIS_DESCR
 FORMAT "%2.0" /end CHARACTERISTIC
/begin CHARACTERISTIC XTAB25Z_DYNAMIK_IDXGRBDYN "" CURVE 0x1D9647 _REC_A1CUR_30_u1_u1_S2 15 _CNV_S_16_Enum_EIDXG_169_CM_S2 0 15
 /begin AXIS_DESCR FIX_AXIS Z_DYNAMIK_YIDX _CNV_R_R_Umr_1_zu_1_2_CM_S2 25 0 24 READ_ONLY FIX_AXIS_PAR_DIST 0 1 25 /end AXIS_DESCR
/end CHARACTERISTIC
/begin CHARACTERISTIC XTAB2C_AUSROLL_RS21 "" CURVE 0x1DD530 _REC_A1CUR_30_u2_u2_S2 65535 _CNV_R_R_Umr_1_zu_1_2_CM_S2 0 65535
 /begin AXIS_DESCR FIX_AXIS NO_INPUT_QUANTITY _CNV_S_2_Enum_EWL2_122_CM_S2 2 0 1 READ_ONLY FIX_AXIS_PAR_DIST 0 1 2 /end AXIS_DESCR
 FORMAT "%2.0" /end CHARACTERISTIC
/begin CHARACTERISTIC XTAB2C_BER_MAX "" CURVE 0x1DD8E4 _REC_A1CUR_30_s2_u1_S2 65535 _CNV_R_R_Umr_1_zu_1_2_CM_S2 -32768 32767
 /begin AXIS_DESCR FIX_AXIS Z_AGS_MODBEDEL _CNV_S_2_Enum_EAGS_18_CM_S2 2 0 1 READ_ONLY FIX_AXIS_PAR_DIST 0 1 2 /end AXIS_DESCR
 FORMAT "%2.0" /end CHARACTERISTIC
/begin CHARACTERISTIC XTAB2C_BER_MIN "" CURVE 0x1DD8E8 _REC_A1CUR_30_s2_u1_S2 65535 _CNV_R_R_Umr_1_zu_1_2_CM_S2 -32768 32767
 /begin AXIS_DESCR FIX_AXIS Z_AGS_MODBEDEL _CNV_S_2_Enum_EAGS_18_CM_S2 2 0 1 READ_ONLY FIX_AXIS_PAR_DIST 0 1 2 /end AXIS_DESCR
 FORMAT "%2.0" /end CHARACTERISTIC
/begin CHARACTERISTIC XTAB2GWFP_SPA "" CURVE 0x1DD4D8 _REC_A1CUR_30_s2_u1_S2 20000 _CNV_R_R_Umr_1_zu_1_7_CM_S2 -10000 10000
 /begin AXIS_DESCR FIX_AXIS NO_INPUT_QUANTITY _CNV_S_2_Enum_EGW_F_273_CM_S2 2 0 1 READ_ONLY FIX_AXIS_PAR_DIST 0 1 2 /end AXIS_DESCR
 FORMAT "%2.0" /end CHARACTERISTIC
/begin CHARACTERISTIC XTAB2M_FWSMAX_EINLENK "" CURVE 0x1DC558 _REC_A1CUR_30_s2_u1_S2 400 _CNV_R_R_Umr_1_zu_1_38_CM_S2 0 400
 /begin AXIS_DESCR FIX_AXIS Z_FZG_ANH _CNV_S_3_Enum_EANH_51_CM_S2 2 0 2 READ_ONLY FIX_AXIS_PAR_DIST 0 1 2 /end AXIS_DESCR
 FORMAT "%2.0" /end CHARACTERISTIC
/begin CHARACTERISTIC XTAB2SCHA_QKURVE_KFMODAFB "" CURVE 0x1DC9D4 _REC_A1CUR_30_s2_u1_S2 6553.5 _CNV_R_R_Umr_10_zu__37_CM_S2 -3276.8 3276.7
 /begin AXIS_DESCR FIX_AXIS S_COD_MAB _CNV_R_R_Umr_1_zu_1_2_CM_S2 2 0 255 READ_ONLY FIX_AXIS_PAR_DIST 0 1 2 /end AXIS_DESCR
 FORMAT "%3.1" /end CHARACTERISTIC
/begin CHARACTERISTIC XTAB2SCHDA_QKURVE_KFMODAFB "" CURVE 0x1DC9D8 _REC_A1CUR_30_s2_u1_S2 6553.5 _CNV_R_R_Umr_10_zu__37_CM_S2 -3276.8 3276.7
 /begin AXIS_DESCR FIX_AXIS S_COD_MAB _CNV_R_R_Umr_1_zu_1_2_CM_S2 2 0 255 READ_ONLY FIX_AXIS_PAR_DIST 0 1 2 /end AXIS_DESCR
 FORMAT "%3.1" /end CHARACTERISTIC
/begin CHARACTERISTIC XTAB2SCHDM_ABFWS_KFMODAFB "" CURVE 0x1DC9DC _REC_A1CUR_30_s2_u1_S2 20000 _CNV_R_R_Umr_1_zu_1_38_CM_S2 -10000 10000
 /begin AXIS_DESCR FIX_AXIS S_COD_MAB _CNV_R_R_Umr_1_zu_1_2_CM_S2 2 0 255 READ_ONLY FIX_AXIS_PAR_DIST 0 1 2 /end AXIS_DESCR
 FORMAT "%2.0" /end CHARACTERISTIC
/begin CHARACTERISTIC XTAB2SCHDM_ABFWS_MODAFB "" CURVE 0x1DC9E0 _REC_A1CUR_30_s2_u1_S2 20000 _CNV_R_R_Umr_1_zu_1_38_CM_S2 -10000 10000
 /begin AXIS_DESCR FIX_AXIS S_COD_MAB _CNV_R_R_Umr_1_zu_1_2_CM_S2 2 0 255 READ_ONLY FIX_AXIS_PAR_DIST 0 1 2 /end AXIS_DESCR
 FORMAT "%2.0" /end CHARACTERISTIC
/begin CHARACTERISTIC XTAB2SCHGWFP_HSUREFPVORPOS "" CURVE 0x1DC940 _REC_A1CUR_30_s2_u1_S2 32767 _CNV_R_R_Umr_1_zu_1_7_CM_S2 0 32767
 /begin AXIS_DESCR FIX_AXIS Z_AGS_MODBEDEL _CNV_S_2_Enum_EAGS_18_CM_S2 2 0 1 READ_ONLY FIX_AXIS_PAR_DIST 0 1 2 /end AXIS_DESCR
 FORMAT "%2.0" /end CHARACTERISTIC
/begin CHARACTERISTIC XTAB2SCHGW_FPOBEN "" CURVE 0x1DD978 _REC_A1CUR_30_s2_u1_S2 65535 _CNV_R_R_Umr_1_zu_1_7_CM_S2 -32768 32767
 /begin AXIS_DESCR FIX_AXIS Z_AGS_MODBEDEL _CNV_S_2_Enum_EAGS_18_CM_S2 2 0 1 READ_ONLY FIX_AXIS_PAR_DIST 0 1 2 /end AXIS_DESCR
 FORMAT "%2.0" /end CHARACTERISTIC
/begin CHARACTERISTIC XTAB2SCHGW_FPUNTEN "" CURVE 0x1DD97C _REC_A1CUR_30_s2_u1_S2 65535 _CNV_R_R_Umr_1_zu_1_7_CM_S2 -32768 32767
 /begin AXIS_DESCR FIX_AXIS Z_AGS_MODBEDEL _CNV_S_2_Enum_EAGS_18_CM_S2 2 0 1 READ_ONLY FIX_AXIS_PAR_DIST 0 1 2 /end AXIS_DESCR
 FORMAT "%2.0" /end CHARACTERISTIC
/begin CHARACTERISTIC XTAB2SCHM_MOT_SUMSCHUBMAX_ZKA "" CURVE 0x1DD59C _REC_A1CUR_30_s2_u1_S2 20000 _CNV_R_R_Umr_1_zu_1_2_CM_S2 -20000 0
 /begin AXIS_DESCR FIX_AXIS S_B_BCA _CNV_P_2_A_I_5_CM_S2 2 0 255 READ_ONLY /begin FIX_AXIS_PAR_LIST 0 1 /end FIX_AXIS_PAR_LIST /end AXIS_DESCR
 FORMAT "%2.0" /end CHARACTERISTIC
/begin CHARACTERISTIC XTAB2SCHM_MOT_SUMZUGMAX_ZKA "" CURVE 0x1DD5A0 _REC_A1CUR_30_s2_u1_S2 2000 _CNV_R_R_Umr_1_zu_1_2_CM_S2 0 2000
 /begin AXIS_DESCR FIX_AXIS S_KD _CNV_P_2_A_I_5_CM_S2 2 0 255 READ_ONLY /begin FIX_AXIS_PAR_LIST 0 1 /end FIX_AXIS_PAR_LIST /end AXIS_DESCR
 FORMAT "%2.0" /end CHARACTERISTIC
/begin CHARACTERISTIC XTAB2SCHTEMP_UMG_MODAFB "" CURVE 0x1DC9E4 _REC_A1CUR_30_s2_u1_S2 130 _CNV_R_R_Umr_1_zu_1_1_CM_S2 -50 80
 /begin AXIS_DESCR FIX_AXIS S_COD_MAB _CNV_R_R_Umr_1_zu_1_2_CM_S2 2 0 255 READ_ONLY FIX_AXIS_PAR_DIST 0 1 2 /end AXIS_DESCR
 FORMAT "%2.0" /end CHARACTERISTIC
/begin CHARACTERISTIC XTAB2SCHV_FZG_AUS1MODAFB "" CURVE 0x1DC9E8 _REC_A1CUR_30_u2_u1_S2 400 _CNV_R_R_Umr_1_zu_1_8_CM_S2 0 400
 /begin AXIS_DESCR FIX_AXIS S_COD_MAB _CNV_R_R_Umr_1_zu_1_2_CM_S2 2 0 255 READ_ONLY FIX_AXIS_PAR_DIST 0 1 2 /end AXIS_DESCR
 FORMAT "%2.0" /end CHARACTERISTIC
/begin CHARACTERISTIC XTAB2SCHV_FZG_AUS2MODAFB "" CURVE 0x1DC9EC _REC_A1CUR_30_u2_u1_S2 400 _CNV_R_R_Umr_1_zu_1_8_CM_S2 0 400
 /begin AXIS_DESCR FIX_AXIS S_COD_MAB _CNV_R_R_Umr_1_zu_1_2_CM_S2 2 0 255 READ_ONLY FIX_AXIS_PAR_DIST 0 1 2 /end AXIS_DESCR
 FORMAT "%2.0" /end CHARACTERISTIC
/begin CHARACTERISTIC XTAB2SCHV_FZG_BETRBERAUSMODAFB "" CURVE 0x1DC9F0 _REC_A1CUR_30_u2_u1_S2 400 _CNV_R_R_Umr_1_zu_1_8_CM_S2 0 400
 /begin AXIS_DESCR FIX_AXIS S_COD_MAB _CNV_R_R_Umr_1_zu_1_2_CM_S2 2 0 255 READ_ONLY FIX_AXIS_PAR_DIST 0 1 2 /end AXIS_DESCR
 FORMAT "%2.0" /end CHARACTERISTIC
/begin CHARACTERISTIC XTAB2SCHV_FZG_BETRBEREINMODAFB "" CURVE 0x1DC9F4 _REC_A1CUR_30_u2_u1_S2 400 _CNV_R_R_Umr_1_zu_1_8_CM_S2 0 400
 /begin AXIS_DESCR FIX_AXIS S_COD_MAB _CNV_R_R_Umr_1_zu_1_2_CM_S2 2 0 255 READ_ONLY FIX_AXIS_PAR_DIST 0 1 2 /end AXIS_DESCR
 FORMAT "%2.0" /end CHARACTERISTIC
/begin CHARACTERISTIC XTAB2SCHV_FZG_EIN1MODAFB "" CURVE 0x1DC9F8 _REC_A1CUR_30_u2_u1_S2 400 _CNV_R_R_Umr_1_zu_1_8_CM_S2 0 400
 /begin AXIS_DESCR FIX_AXIS S_COD_MAB _CNV_R_R_Umr_1_zu_1_2_CM_S2 2 0 255 READ_ONLY FIX_AXIS_PAR_DIST 0 1 2 /end AXIS_DESCR
 FORMAT "%2.0" /end CHARACTERISTIC
/begin CHARACTERISTIC XTAB2SCHV_FZG_EIN2MODAFB "" CURVE 0x1DC9FC _REC_A1CUR_30_u2_u1_S2 400 _CNV_R_R_Umr_1_zu_1_8_CM_S2 0 400
 /begin AXIS_DESCR FIX_AXIS S_COD_MAB _CNV_R_R_Umr_1_zu_1_2_CM_S2 2 0 255 READ_ONLY FIX_AXIS_PAR_DIST 0 1 2 /end AXIS_DESCR
 FORMAT "%2.0" /end CHARACTERISTIC
/begin CHARACTERISTIC XTAB2SCHW_DKKD_AUSGWFP_MODAFB "" CURVE 0x1DCA00 _REC_A1CUR_30_u2_u1_S2 110 _CNV_R_R_Umr_10_zu__9_CM_S2 0 110
 /begin AXIS_DESCR FIX_AXIS S_COD_MAB _CNV_R_R_Umr_1_zu_1_2_CM_S2 2 0 255 READ_ONLY FIX_AXIS_PAR_DIST 0 1 2 /end AXIS_DESCR
 FORMAT "%3.1" /end CHARACTERISTIC
/begin CHARACTERISTIC XTAB2SCHW_DKKD_EINMODAFB "" CURVE 0x1DCA04 _REC_A1CUR_30_u2_u1_S2 110 _CNV_R_R_Umr_10_zu__9_CM_S2 0 110
 /begin AXIS_DESCR FIX_AXIS S_COD_MAB _CNV_R_R_Umr_1_zu_1_2_CM_S2 2 0 255 READ_ONLY FIX_AXIS_PAR_DIST 0 1 2 /end AXIS_DESCR
 FORMAT "%3.1" /end CHARACTERISTIC
/begin CHARACTERISTIC XTAB2SCHW_DKKD_NLMODAFB "" CURVE 0x1DCA08 _REC_A1CUR_30_u2_u1_S2 110 _CNV_R_R_Umr_10_zu__9_CM_S2 0 110
 /begin AXIS_DESCR FIX_AXIS S_COD_MAB _CNV_R_R_Umr_1_zu_1_2_CM_S2 2 0 255 READ_ONLY FIX_AXIS_PAR_DIST 0 1 2 /end AXIS_DESCR
 FORMAT "%3.1" /end CHARACTERISTIC
/begin CHARACTERISTIC XTAB2SCHW_DKKD_SDYNGWFP "" CURVE 0x1DD490 _REC_A1CUR_30_u2_u2_S2 110 _CNV_R_R_Umr_10_zu__9_CM_S2 0 110
 /begin AXIS_DESCR FIX_AXIS NO_INPUT_QUANTITY _CNV_S_5_Enum_EGWDK_161_CM_S2 2 0 4 READ_ONLY FIX_AXIS_PAR_DIST 0 1 2 /end AXIS_DESCR
 FORMAT "%3.1" /end CHARACTERISTIC
/begin CHARACTERISTIC XTAB2SCHW_DKKD_SPA "" CURVE 0x1DD4DC _REC_A1CUR_30_u2_u1_S2 200 _CNV_R_R_Umr_10_zu__9_CM_S2 0 200
 /begin AXIS_DESCR FIX_AXIS NO_INPUT_QUANTITY _CNV_S_2_Enum_EGW_F_273_CM_S2 2 0 1 READ_ONLY FIX_AXIS_PAR_DIST 0 1 2 /end AXIS_DESCR
 FORMAT "%3.1" /end CHARACTERISTIC
/begin CHARACTERISTIC XTAB2SCHW_LWVA_KFMODAFB "" CURVE 0x1DCA3C _REC_A1CUR_30_u2_u1_S2 90 _CNV_R_R_Umr_10_zu__10_CM_S2 0 90
 /begin AXIS_DESCR FIX_AXIS S_COD_MAB _CNV_R_R_Umr_1_zu_1_2_CM_S2 2 0 255 READ_ONLY FIX_AXIS_PAR_DIST 0 1 2 /end AXIS_DESCR
 FORMAT "%3.1" /end CHARACTERISTIC
/begin CHARACTERISTIC XTAB2SCHW_LWVA_MODAFB "" CURVE 0x1DCA40 _REC_A1CUR_30_u2_u1_S2 90 _CNV_R_R_Umr_10_zu__10_CM_S2 0 90
 /begin AXIS_DESCR FIX_AXIS S_COD_MAB _CNV_R_R_Umr_1_zu_1_2_CM_S2 2 0 255 READ_ONLY FIX_AXIS_PAR_DIST 0 1 2 /end AXIS_DESCR
 FORMAT "%3.1" /end CHARACTERISTIC
/begin CHARACTERISTIC XTAB2SCHW_STEIGUNG_KFMODAFB "" CURVE 0x1DCA0C _REC_A1CUR_30_s2_u1_S2 400 _CNV_R_R_Umr_10_zu__9_CM_S2 -200 200
 /begin AXIS_DESCR FIX_AXIS S_COD_MAB _CNV_R_R_Umr_1_zu_1_2_CM_S2 2 0 255 READ_ONLY FIX_AXIS_PAR_DIST 0 1 2 /end AXIS_DESCR
 FORMAT "%3.1" /end CHARACTERISTIC
/begin CHARACTERISTIC XTAB2SCHW_STEIGUNG_MODAFB "" CURVE 0x1DCA10 _REC_A1CUR_30_s2_u1_S2 400 _CNV_R_R_Umr_10_zu__9_CM_S2 -200 200
 /begin AXIS_DESCR FIX_AXIS S_COD_MAB _CNV_R_R_Umr_1_zu_1_2_CM_S2 2 0 255 READ_ONLY FIX_AXIS_PAR_DIST 0 1 2 /end AXIS_DESCR
 FORMAT "%3.1" /end CHARACTERISTIC
/begin CHARACTERISTIC XTAB2S_USE_MAB_S_B_STILLSTAND "" CURVE 0x1DF35A _REC_A1CUR_30_u1_u1_S2 1 _CNV_R_R_Umr_1_zu_1_2_CM_S2 0 1
 /begin AXIS_DESCR FIX_AXIS S_COD_MAB _CNV_R_R_Umr_1_zu_1_2_CM_S2 2 0 255 READ_ONLY FIX_AXIS_PAR_DIST 0 1 2 /end AXIS_DESCR
 FORMAT "%2.0" /end CHARACTERISTIC
/begin CHARACTERISTIC XTAB2T_BESCHL_MODAFB "" CURVE 0x1DCA14 _REC_A1CUR_30_u4_u1_S2 36000 _CNV_R_R_Umr_10_zu__117_CM_S2 0 36000
 /begin AXIS_DESCR FIX_AXIS S_COD_MAB _CNV_R_R_Umr_1_zu_1_2_CM_S2 2 0 255 READ_ONLY FIX_AXIS_PAR_DIST 0 1 2 /end AXIS_DESCR
 FORMAT "%3.1" /end CHARACTERISTIC
/begin CHARACTERISTIC XTAB2T_BETRBEREINMODAFB "" CURVE 0x1DCA1C _REC_A1CUR_30_u4_u1_S2 36000 _CNV_R_R_Umr_10_zu__117_CM_S2 0 36000
 /begin AXIS_DESCR FIX_AXIS S_COD_MAB _CNV_R_R_Umr_1_zu_1_2_CM_S2 2 0 255 READ_ONLY FIX_AXIS_PAR_DIST 0 1 2 /end AXIS_DESCR
 FORMAT "%3.1" /end CHARACTERISTIC
/begin CHARACTERISTIC XTAB2T_DYNDZM_PHASE6_AUS "" CURVE 0x1D8EC4 _REC_A1CUR_30_s2_s1_S2 1000 _CNV_R_R_Umr_1_zu_1_6_CM_S2 0 1000
 /begin AXIS_DESCR FIX_AXIS NO_INPUT_QUANTITY _CNV_S_3_Enum_EDYND_129_CM_S2 2 -1 1 READ_ONLY /begin FIX_AXIS_PAR_LIST 0 1 /end FIX_AXIS_PAR_LIST /end AXIS_DESCR
 FORMAT "%2.0" /end CHARACTERISTIC
/begin CHARACTERISTIC XTAB2T_DYNDZM_PHASE6_EIN "" CURVE 0x1D8EC8 _REC_A1CUR_30_s2_s1_S2 1000 _CNV_R_R_Umr_1_zu_1_6_CM_S2 0 1000
 /begin AXIS_DESCR FIX_AXIS NO_INPUT_QUANTITY _CNV_S_3_Enum_EDYND_129_CM_S2 2 -1 1 READ_ONLY /begin FIX_AXIS_PAR_LIST 0 1 /end FIX_AXIS_PAR_LIST /end AXIS_DESCR
 FORMAT "%2.0" /end CHARACTERISTIC
/begin CHARACTERISTIC XTAB2T_KFINIT_MODAFB "" CURVE 0x1DCA24 _REC_A1CUR_30_u4_u1_S2 36000 _CNV_R_R_Umr_10_zu__117_CM_S2 0 36000
 /begin AXIS_DESCR FIX_AXIS S_COD_MAB _CNV_R_R_Umr_1_zu_1_2_CM_S2 2 0 255 READ_ONLY FIX_AXIS_PAR_DIST 0 1 2 /end AXIS_DESCR
 FORMAT "%3.1" /end CHARACTERISTIC
/begin CHARACTERISTIC XTAB2T_KF_MODAFB "" CURVE 0x1DCA2C _REC_A1CUR_30_u4_u1_S2 36000 _CNV_R_R_Umr_10_zu__117_CM_S2 0 36000
 /begin AXIS_DESCR FIX_AXIS S_COD_MAB _CNV_R_R_Umr_1_zu_1_2_CM_S2 2 0 255 READ_ONLY FIX_AXIS_PAR_DIST 0 1 2 /end AXIS_DESCR
 FORMAT "%3.1" /end CHARACTERISTIC
/begin CHARACTERISTIC XTAB2T_NACHL_BAB "" CURVE 0x1DC174 _REC_A1CUR_30_u4_u1_S2 2147480000 _CNV_R_R_Umr_1_zu_1_6_CM_S2 0 2147483647
 /begin AXIS_DESCR FIX_AXIS Z_AGS_MODBEDEL _CNV_S_2_Enum_EAGS_18_CM_S2 2 0 1 READ_ONLY FIX_AXIS_PAR_DIST 0 1 2 /end AXIS_DESCR
 FORMAT "%2.0" /end CHARACTERISTIC
/begin CHARACTERISTIC XTAB2T_SCHLEPP "" CURVE 0x1DD984 _REC_A1CUR_30_u4_u1_S2 4294970000 _CNV_R_R_Umr_1_zu_1_6_CM_S2 0 4294967295
 /begin AXIS_DESCR FIX_AXIS Z_AGS_MODBEDEL _CNV_S_2_Enum_EAGS_18_CM_S2 2 0 1 READ_ONLY FIX_AXIS_PAR_DIST 0 1 2 /end AXIS_DESCR
 FORMAT "%2.0" /end CHARACTERISTIC
/begin CHARACTERISTIC XTAB2T_SPERRHS_LDMMODEW_ZKA "" CURVE 0x1DD5A4 _REC_A1CUR_30_s4_u2_S2 5000 _CNV_R_R_Umr_1_zu_1_6_CM_S2 0 5000
 /begin AXIS_DESCR FIX_AXIS NO_INPUT_QUANTITY _CNV_S_2_Enum_ESPER_182_CM_S2 2 0 1 READ_ONLY /begin FIX_AXIS_PAR_LIST 0 1 /end FIX_AXIS_PAR_LIST /end AXIS_DESCR
 FORMAT "%2.0" /end CHARACTERISTIC
/begin CHARACTERISTIC XTAB2T_VERBOT_SCHLEPP "" CURVE 0x1DD98C _REC_A1CUR_30_u4_u1_S2 4294970000 _CNV_R_R_Umr_1_zu_1_6_CM_S2 0 4294967295
 /begin AXIS_DESCR FIX_AXIS Z_AGS_MODBEDEL _CNV_S_2_Enum_EAGS_18_CM_S2 2 0 1 READ_ONLY FIX_AXIS_PAR_DIST 0 1 2 /end AXIS_DESCR
 FORMAT "%2.0" /end CHARACTERISTIC
/begin CHARACTERISTIC XTAB2V_FZG_STOPGO1 "" CURVE 0x1DD534 _REC_A1CUR_30_u2_u2_S2 400 _CNV_R_R_Umr_1_zu_1_8_CM_S2 0 400
 /begin AXIS_DESCR FIX_AXIS NO_INPUT_QUANTITY _CNV_S_2_Enum_EWL2_122_CM_S2 2 0 1 READ_ONLY FIX_AXIS_PAR_DIST 0 1 2 /end AXIS_DESCR
 FORMAT "%2.0" /end CHARACTERISTIC
/begin CHARACTERISTIC XTAB2V_FZG_STOPGO2 "" CURVE 0x1DD538 _REC_A1CUR_30_u2_u2_S2 400 _CNV_R_R_Umr_1_zu_1_8_CM_S2 0 400
 /begin AXIS_DESCR FIX_AXIS NO_INPUT_QUANTITY _CNV_S_2_Enum_EWL2_122_CM_S2 2 0 1 READ_ONLY FIX_AXIS_PAR_DIST 0 1 2 /end AXIS_DESCR
 FORMAT "%2.0" /end CHARACTERISTIC
/begin CHARACTERISTIC XTAB2W_DKKD_STOPGO1 "" CURVE 0x1DD53C _REC_A1CUR_30_u2_u2_S2 110 _CNV_R_R_Umr_10_zu__9_CM_S2 0 110
 /begin AXIS_DESCR FIX_AXIS NO_INPUT_QUANTITY _CNV_S_2_Enum_EWL2_122_CM_S2 2 0 1 READ_ONLY FIX_AXIS_PAR_DIST 0 1 2 /end AXIS_DESCR
 FORMAT "%2.0" /end CHARACTERISTIC
/begin RECORD_LAYOUT _REC_A1CUR_1_u2_u2_S2 FNC_VALUES 1 UWORD COLUMN_DIR DIRECT /end RECORD_LAYOUT
/begin RECORD_LAYOUT _REC_A1CUR_30_s2_s1_S2 FNC_VALUES 1 SWORD COLUMN_DIR DIRECT /end RECORD_LAYOUT
/begin RECORD_LAYOUT _REC_A1CUR_30_s2_u1_S2 FNC_VALUES 1 SWORD COLUMN_DIR DIRECT /end RECORD_LAYOUT
/begin RECORD_LAYOUT _REC_A1CUR_30_s4_u2_S2 FNC_VALUES 1 SLONG COLUMN_DIR DIRECT /end RECORD_LAYOUT
/begin RECORD_LAYOUT _REC_A1CUR_30_u1_u1_S2 FNC_VALUES 1 UBYTE COLUMN_DIR DIRECT /end RECORD_LAYOUT
/begin RECORD_LAYOUT _REC_A1CUR_30_u1_u2_S2 FNC_VALUES 1 UBYTE COLUMN_DIR DIRECT /end RECORD_LAYOUT
/begin RECORD_LAYOUT _REC_A1CUR_30_u2_u1_S2 FNC_VALUES 1 UWORD COLUMN_DIR DIRECT /end RECORD_LAYOUT
/begin RECORD_LAYOUT _REC_A1CUR_30_u2_u2_S2 FNC_VALUES 1 UWORD COLUMN_DIR DIRECT /end RECORD_LAYOUT
/begin RECORD_LAYOUT _REC_A1CUR_30_u4_u1_S2 FNC_VALUES 1 ULONG COLUMN_DIR DIRECT /end RECORD_LAYOUT
/begin RECORD_LAYOUT _REC_A1MAP_8_s1_s2_u1_S2 FNC_VALUES 1 SBYTE ROW_DIR DIRECT /end RECORD_LAYOUT
/begin RECORD_LAYOUT _REC_A1MAP_8_u1_u1_u1_S2 FNC_VALUES 1 UBYTE ROW_DIR DIRECT /end RECORD_LAYOUT
/begin RECORD_LAYOUT _REC_A1MAP_8_u1_u2_u1_S2 FNC_VALUES 1 UBYTE ROW_DIR DIRECT /end RECORD_LAYOUT
/begin RECORD_LAYOUT _REC_A1MAP_8_u2_u2_u1_S2 FNC_VALUES 1 UWORD ROW_DIR DIRECT /end RECORD_LAYOUT
/begin RECORD_LAYOUT _REC_A1MAP_8_u2_u2_u2_S2 FNC_VALUES 1 UWORD ROW_DIR DIRECT /end RECORD_LAYOUT
/begin RECORD_LAYOUT _REC_A1MAP_9_u1_u1_u1_S2 FNC_VALUES 1 UBYTE COLUMN_DIR DIRECT /end RECORD_LAYOUT
/begin RECORD_LAYOUT _REC_A1MAP_9_u2_u2_u1_S2 FNC_VALUES 1 UWORD COLUMN_DIR DIRECT /end RECORD_LAYOUT
/begin RECORD_LAYOUT _REC_A2AXS_31_u2_S2 AXIS_PTS_X 2 UWORD INDEX_INCR DIRECT NO_AXIS_PTS_X 1 UWORD /end RECORD_LAYOUT
/begin RECORD_LAYOUT _REC_S1VAL_1_s1_S2 FNC_VALUES 1 SBYTE COLUMN_DIR DIRECT /end RECORD_LAYOUT
/begin RECORD_LAYOUT _REC_S1VAL_1_s2_S2 FNC_VALUES 1 SWORD COLUMN_DIR DIRECT /end RECORD_LAYOUT
/begin RECORD_LAYOUT _REC_S1VAL_1_s4_S2 FNC_VALUES 1 SLONG COLUMN_DIR DIRECT /end RECORD_LAYOUT
/begin RECORD_LAYOUT _REC_S1VAL_1_u1_S2 FNC_VALUES 1 UBYTE COLUMN_DIR DIRECT /end RECORD_LAYOUT
/begin RECORD_LAYOUT _REC_S1VAL_1_u2_S2 FNC_VALUES 1 UWORD COLUMN_DIR DIRECT /end RECORD_LAYOUT
/begin RECORD_LAYOUT _REC_S2AXS_51_u2_S2 AXIS_PTS_X 2 UWORD INDEX_INCR DIRECT NO_AXIS_PTS_X 1 UWORD /end RECORD_LAYOUT
/begin RECORD_LAYOUT _REC_S3MAP_54_s2_s2_u2_S2 FNC_VALUES 3 SWORD ROW_DIR DIRECT AXIS_PTS_X 2 SWORD INDEX_INCR DIRECT NO_AXIS_PTS_X 1 UBYTE /end RECORD_LAYOUT
/begin RECORD_LAYOUT _REC_S3MAP_54_u2_u2_u1_S2 FNC_VALUES 3 UWORD ROW_DIR DIRECT AXIS_PTS_X 2 UWORD INDEX_INCR DIRECT NO_AXIS_PTS_X 1 UBYTE /end RECORD_LAYOUT
/begin RECORD_LAYOUT _REC_S7CUR_53_s2_s2_S2 FNC_VALUES 3 SWORD COLUMN_DIR DIRECT AXIS_PTS_X 2 SWORD INDEX_INCR DIRECT NO_AXIS_PTS_X 1 UBYTE /end RECORD_LAYOUT
/begin RECORD_LAYOUT _REC_S7CUR_53_s2_u2_S2 FNC_VALUES 3 SWORD COLUMN_DIR DIRECT AXIS_PTS_X 2 UWORD INDEX_INCR DIRECT NO_AXIS_PTS_X 1 UBYTE /end RECORD_LAYOUT
/begin RECORD_LAYOUT _REC_S7CUR_53_u2_s2_S2 FNC_VALUES 3 UWORD COLUMN_DIR DIRECT AXIS_PTS_X 2 SWORD INDEX_INCR DIRECT NO_AXIS_PTS_X 1 UBYTE /end RECORD_LAYOUT
/begin RECORD_LAYOUT _REC_S7CUR_53_u2_u2_S2 FNC_VALUES 3 UWORD COLUMN_DIR DIRECT AXIS_PTS_X 2 UWORD INDEX_INCR DIRECT NO_AXIS_PTS_X 1 UBYTE /end RECORD_LAYOUT
/begin RECORD_LAYOUT _REC_S7MAP_53_s2_u2_s2_S2 FNC_VALUES 5 SWORD COLUMN_DIR DIRECT AXIS_PTS_X 3 UWORD INDEX_INCR DIRECT AXIS_PTS_Y 4 SWORD INDEX_INCR DIRECT NO_AXIS_PTS_X 1 UBYTE NO_AXIS_PTS_Y 2 UBYTE /end RECORD_LAYOUT
/end MODULE
/end PROJECT
