ASAP2_VERSION 1 51
/begin PROJECT ZHBC8600 "Gen2_BMW_System_Supplier_Lib"
/begin MODULE CPP ""
/begin MOD_COMMON "" BYTE_ORDER MSB_FIRST ALIGNMENT_BYTE 1 ALIGNMENT_WORD 2 ALIGNMENT_LONG 4 ALIGNMENT_FLOAT32_IEEE 4 ALIGNMENT_FLOAT64_IEEE 1 /end MOD_COMMON
/begin COMPU_METHOD SAB2_14PROZENT100_S3_S3 "int = ((phys * 14) / 100) - (0) %" RAT_FUNC "%4.3" "%" COEFFS 0 0.14 0 0 0 1 /end COMPU_METHOD
/begin COMPU_METHOD SAB2_1PROZENT_M100_S3_S3 "int = ((phys * 1) / 1) - (-100) %" RAT_FUNC "%1.0" "%" COEFFS 0 1 100 0 0 1 /end COMPU_METHOD
/begin COMPU_METHOD SAB2_1PROZENT_M125_S3_S3 "int = ((phys * 1) / 1) - (-125) %" RAT_FUNC "%1.0" "%" COEFFS 0 1 125 0 0 1 /end COMPU_METHOD
/begin COMPU_METHOD UMR___1_100_0_S5_S3 "int = ((phys * 100) / 1) - (0) [-]" RAT_FUNC "%3.2" "[-]" COEFFS 0 100 0 0 0 1 /end COMPU_METHOD
/begin COMPU_METHOD UMR_BAR__1_1000_0_S5_S3 "int = ((phys * 1000) / 1) - (0) [bar]" RAT_FUNC "%4.3" "[bar]" COEFFS 0 1000 0 0 0 1 /end COMPU_METHOD
/begin COMPU_METHOD UMR_BAR_SEC_1_10_0_S5_S3 "int = ((phys * 10) / 1) - (0) [bar/s]" RAT_FUNC "%2.1" "[bar/s]" COEFFS 0 10 0 0 0 1 /end COMPU_METHOD
/begin COMPU_METHOD UMR_GRADC__1_1_M40_S5_S3 "int = ((phys * 1) / 1) - (-40) [°C]" RAT_FUNC "%1.0" "[°C]" COEFFS 0 1 40 0 0 1 /end COMPU_METHOD
/begin COMPU_METHOD UMR_MSEC__10_1_0_S5_S3 "int = ((phys * 1) / 10) - (0) [ms]" RAT_FUNC "%1.0" "[ms]" COEFFS 0 0.1 0 0 0 1 /end COMPU_METHOD
/begin COMPU_METHOD UMR_MSEC__10_1_M128_S5_S3 "int = ((phys * 1) / 10) - (-128) [ms]" RAT_FUNC "%1.0" "[ms]" COEFFS 0 0.1 128 0 0 1 /end COMPU_METHOD
/begin COMPU_METHOD UMR_NM__1_1_0_S5_S3 "int = ((phys * 1) / 1) - (0) [Nm]" RAT_FUNC "%1.0" "[Nm]" COEFFS 0 1 0 0 0 1 /end COMPU_METHOD
/begin COMPU_METHOD UMR_NM__6_1_M34_S5_S3 "int = ((phys * 1) / 6) - (-34) [Nm]" RAT_FUNC "%1.0" "[Nm]" COEFFS 0 0.166666666667 34 0 0 1 /end COMPU_METHOD
/begin COMPU_METHOD UMR_U_MIN_1_1_0_S5_S3 "int = ((phys * 1) / 1) - (0) [U/min]" RAT_FUNC "%1.0" "[U/min]" COEFFS 0 1 0 0 0 1 /end COMPU_METHOD
/begin COMPU_METHOD UMR_U_MIN_32_1_0_S5_S3 "int = ((phys * 1) / 32) - (0) [U/min]" RAT_FUNC "%1.0" "[U/min]" COEFFS 0 0.03125 0 0 0 1 /end COMPU_METHOD
/begin COMPU_METHOD UMR_U_MINSEC_1_1_0_S5_S3 "int = ((phys * 1) / 1) - (0) [U/(min*s)]" RAT_FUNC "%1.0" "[U/(min*s)]" COEFFS 0 1 0 0 0 1 /end COMPU_METHOD
/begin CHARACTERISTIC F_PRA32 "Druckfaktor waehrend Rampe auf Schaltdruck" VALUE 0x1D7B13 ZF_kw_ui8_S5_S3 1 UMR___1_100_0_S5_S3 0 1 /end CHARACTERISTIC
/begin CHARACTERISTIC F_PRA32_EL "Druckfaktor waehrend Rampe auf Schaltdruck" VALUE 0x1D7B14 ZF_kw_ui8_S5_S3 1 UMR___1_100_0_S5_S3 0 1 /end CHARACTERISTIC
/begin CHARACTERISTIC F_PRA43 "Druckfaktor waehrend Rampe auf Schaltdruck" VALUE 0x1D7B19 ZF_kw_ui8_S5_S3 1 UMR___1_100_0_S5_S3 0 1 /end CHARACTERISTIC
/begin CHARACTERISTIC F_PRA43_EL "Druckfaktor waehrend Rampe auf Schaltdruck" VALUE 0x1D7B1A ZF_kw_ui8_S5_S3 1 UMR___1_100_0_S5_S3 0 1 /end CHARACTERISTIC
/begin CHARACTERISTIC F_PRA54 "Druckfaktor waehrend Rampe auf Schaltdruck" VALUE 0x1D7B1F ZF_kw_ui8_S5_S3 1 UMR___1_100_0_S5_S3 0 1 /end CHARACTERISTIC
/begin CHARACTERISTIC F_PRA54_EL "Druckfaktor waehrend Rampe auf Schaltdruck" VALUE 0x1D7B20 ZF_kw_ui8_S5_S3 1 UMR___1_100_0_S5_S3 0 1 /end CHARACTERISTIC
/begin CHARACTERISTIC F_PRA65 "Druckfaktor waehrend Rampe auf Schaltdruck" VALUE 0x1D7B25 ZF_kw_ui8_S5_S3 1 UMR___1_100_0_S5_S3 0 1 /end CHARACTERISTIC
/begin CHARACTERISTIC F_PRA65_EL "Druckfaktor waehrend Rampe auf Schaltdruck" VALUE 0x1D7B26 ZF_kw_ui8_S5_S3 1 UMR___1_100_0_S5_S3 0 1 /end CHARACTERISTIC
/begin CHARACTERISTIC F_PRA76 "Druckfaktor waehrend Rampe auf Schaltdruck" VALUE 0x1D7B2B ZF_kw_ui8_S5_S3 1 UMR___1_100_0_S5_S3 0 1 /end CHARACTERISTIC
/begin CHARACTERISTIC F_PRA76_EL "Druckfaktor waehrend Rampe auf Schaltdruck" VALUE 0x1D7B2C ZF_kw_ui8_S5_S3 1 UMR___1_100_0_S5_S3 0 1 /end CHARACTERISTIC
/begin CHARACTERISTIC F_PRA87 "Druckfaktor waehrend Rampe auf Schaltdruck" VALUE 0x1D7B31 ZF_kw_ui8_S5_S3 1 UMR___1_100_0_S5_S3 0 1 /end CHARACTERISTIC
/begin CHARACTERISTIC F_PRA87_EL "Druckfaktor waehrend Rampe auf Schaltdruck" VALUE 0x1D7B32 ZF_kw_ui8_S5_S3 1 UMR___1_100_0_S5_S3 0 1 /end CHARACTERISTIC
/begin CHARACTERISTIC F_PRASP21 "Druckfaktor waehrend Rampe auf Schaltdruck" VALUE 0x1D7B37 ZF_kw_ui8_S5_S3 1 UMR___1_100_0_S5_S3 0 1 /end CHARACTERISTIC
/begin CHARACTERISTIC F_PRASP31 "Druckfaktor waehrend Rampe auf Schaltdruck" VALUE 0x1D7B4C ZF_kw_ui8_S5_S3 1 UMR___1_100_0_S5_S3 0 1 /end CHARACTERISTIC
/begin CHARACTERISTIC F_PRASP32 "Druckfaktor waehrend Rampe auf Schaltdruck" VALUE 0x1D7B3A ZF_kw_ui8_S5_S3 1 UMR___1_100_0_S5_S3 0 1 /end CHARACTERISTIC
/begin CHARACTERISTIC F_PRASP42 "Druckfaktor waehrend Rampe auf Schaltdruck" VALUE 0x1D7B4F ZF_kw_ui8_S5_S3 1 UMR___1_100_0_S5_S3 0 1 /end CHARACTERISTIC
/begin CHARACTERISTIC F_PRASP43 "Druckfaktor waehrend Rampe auf Schaltdruck" VALUE 0x1D7B3D ZF_kw_ui8_S5_S3 1 UMR___1_100_0_S5_S3 0 1 /end CHARACTERISTIC
/begin CHARACTERISTIC F_PRASP51 "Druckfaktor waehrend Rampe auf Schaltdruck" VALUE 0x1D7B52 ZF_kw_ui8_S5_S3 1 UMR___1_100_0_S5_S3 0 1 /end CHARACTERISTIC
/begin CHARACTERISTIC F_PRASP53 "Druckfaktor waehrend Rampe auf Schaltdruck" VALUE 0x1D7B55 ZF_kw_ui8_S5_S3 1 UMR___1_100_0_S5_S3 0 1 /end CHARACTERISTIC
/begin CHARACTERISTIC F_PRASP54 "Druckfaktor waehrend Rampe auf Schaltdruck" VALUE 0x1D7B40 ZF_kw_ui8_S5_S3 1 UMR___1_100_0_S5_S3 0 1 /end CHARACTERISTIC
/begin CHARACTERISTIC F_PRASP63 "Druckfaktor waehrend Rampe auf Schaltdruck" VALUE 0x1D7B58 ZF_kw_ui8_S5_S3 1 UMR___1_100_0_S5_S3 0 1 /end CHARACTERISTIC
/begin CHARACTERISTIC F_PRASP64 "Druckfaktor waehrend Rampe auf Schaltdruck" VALUE 0x1D7B5B ZF_kw_ui8_S5_S3 1 UMR___1_100_0_S5_S3 0 1 /end CHARACTERISTIC
/begin CHARACTERISTIC F_PRASP65 "Druckfaktor waehrend Rampe auf Schaltdruck" VALUE 0x1D7B43 ZF_kw_ui8_S5_S3 1 UMR___1_100_0_S5_S3 0 1 /end CHARACTERISTIC
/begin CHARACTERISTIC F_PRASP71 "Druckfaktor waehrend Rampe auf Schaltdruck" VALUE 0x1D7B5E ZF_kw_ui8_S5_S3 1 UMR___1_100_0_S5_S3 0 1 /end CHARACTERISTIC
/begin CHARACTERISTIC F_PRASP75 "Druckfaktor waehrend Rampe auf Schaltdruck" VALUE 0x1D7B61 ZF_kw_ui8_S5_S3 1 UMR___1_100_0_S5_S3 0 1 /end CHARACTERISTIC
/begin CHARACTERISTIC F_PRASP76 "Druckfaktor waehrend Rampe auf Schaltdruck" VALUE 0x1D7B46 ZF_kw_ui8_S5_S3 1 UMR___1_100_0_S5_S3 0 1 /end CHARACTERISTIC
/begin CHARACTERISTIC F_PRASP82 "Druckfaktor waehrend Rampe auf Schaltdruck" VALUE 0x1D7B64 ZF_kw_ui8_S5_S3 1 UMR___1_100_0_S5_S3 0 1 /end CHARACTERISTIC
/begin CHARACTERISTIC F_PRASP84 "Druckfaktor waehrend Rampe auf Schaltdruck" VALUE 0x1D7B67 ZF_kw_ui8_S5_S3 1 UMR___1_100_0_S5_S3 0 1 /end CHARACTERISTIC
/begin CHARACTERISTIC F_PRASP86 "Druckfaktor waehrend Rampe auf Schaltdruck" VALUE 0x1D7B6A ZF_kw_ui8_S5_S3 1 UMR___1_100_0_S5_S3 0 1 /end CHARACTERISTIC
/begin CHARACTERISTIC F_PRASP87 "Druckfaktor waehrend Rampe auf Schaltdruck" VALUE 0x1D7B49 ZF_kw_ui8_S5_S3 1 UMR___1_100_0_S5_S3 0 1 /end CHARACTERISTIC
/begin CHARACTERISTIC F_PRASPORT21 "Druckfaktor waehrend Rampe auf Schaltdruck" VALUE 0x1D7B6D ZF_kw_ui8_S5_S3 1 UMR___1_100_0_S5_S3 0 1 /end CHARACTERISTIC
/begin CHARACTERISTIC F_PRASPORT31 "Druckfaktor waehrend Rampe auf Schaltdruck" VALUE 0x1D7B82 ZF_kw_ui8_S5_S3 1 UMR___1_100_0_S5_S3 0 1 /end CHARACTERISTIC
/begin CHARACTERISTIC F_PRASPORT32 "Druckfaktor waehrend Rampe auf Schaltdruck" VALUE 0x1D7B70 ZF_kw_ui8_S5_S3 1 UMR___1_100_0_S5_S3 0 1 /end CHARACTERISTIC
/begin CHARACTERISTIC F_PRASPORT42 "Druckfaktor waehrend Rampe auf Schaltdruck" VALUE 0x1D7B85 ZF_kw_ui8_S5_S3 1 UMR___1_100_0_S5_S3 0 1 /end CHARACTERISTIC
/begin CHARACTERISTIC F_PRASPORT43 "Druckfaktor waehrend Rampe auf Schaltdruck" VALUE 0x1D7B73 ZF_kw_ui8_S5_S3 1 UMR___1_100_0_S5_S3 0 1 /end CHARACTERISTIC
/begin CHARACTERISTIC F_PRASPORT51 "Druckfaktor waehrend Rampe auf Schaltdruck" VALUE 0x1D7B88 ZF_kw_ui8_S5_S3 1 UMR___1_100_0_S5_S3 0 1 /end CHARACTERISTIC
/begin CHARACTERISTIC F_PRASPORT53 "Druckfaktor waehrend Rampe auf Schaltdruck" VALUE 0x1D7B8B ZF_kw_ui8_S5_S3 1 UMR___1_100_0_S5_S3 0 1 /end CHARACTERISTIC
/begin CHARACTERISTIC F_PRASPORT54 "Druckfaktor waehrend Rampe auf Schaltdruck" VALUE 0x1D7B76 ZF_kw_ui8_S5_S3 1 UMR___1_100_0_S5_S3 0 1 /end CHARACTERISTIC
/begin CHARACTERISTIC F_PRASPORT63 "Druckfaktor waehrend Rampe auf Schaltdruck" VALUE 0x1D7B8E ZF_kw_ui8_S5_S3 1 UMR___1_100_0_S5_S3 0 1 /end CHARACTERISTIC
/begin CHARACTERISTIC F_PRASPORT64 "Druckfaktor waehrend Rampe auf Schaltdruck" VALUE 0x1D7B91 ZF_kw_ui8_S5_S3 1 UMR___1_100_0_S5_S3 0 1 /end CHARACTERISTIC
/begin CHARACTERISTIC F_PRASPORT65 "Druckfaktor waehrend Rampe auf Schaltdruck" VALUE 0x1D7B79 ZF_kw_ui8_S5_S3 1 UMR___1_100_0_S5_S3 0 1 /end CHARACTERISTIC
/begin CHARACTERISTIC F_PRASPORT71 "Druckfaktor waehrend Rampe auf Schaltdruck" VALUE 0x1D7B94 ZF_kw_ui8_S5_S3 1 UMR___1_100_0_S5_S3 0 1 /end CHARACTERISTIC
/begin CHARACTERISTIC F_PRASPORT75 "Druckfaktor waehrend Rampe auf Schaltdruck" VALUE 0x1D7B97 ZF_kw_ui8_S5_S3 1 UMR___1_100_0_S5_S3 0 1 /end CHARACTERISTIC
/begin CHARACTERISTIC F_PRASPORT76 "Druckfaktor waehrend Rampe auf Schaltdruck" VALUE 0x1D7B7C ZF_kw_ui8_S5_S3 1 UMR___1_100_0_S5_S3 0 1 /end CHARACTERISTIC
/begin CHARACTERISTIC F_PRASPORT82 "Druckfaktor waehrend Rampe auf Schaltdruck" VALUE 0x1D7B9A ZF_kw_ui8_S5_S3 1 UMR___1_100_0_S5_S3 0 1 /end CHARACTERISTIC
/begin CHARACTERISTIC F_PRASPORT84 "Druckfaktor waehrend Rampe auf Schaltdruck" VALUE 0x1D7B9D ZF_kw_ui8_S5_S3 1 UMR___1_100_0_S5_S3 0 1 /end CHARACTERISTIC
/begin CHARACTERISTIC F_PRASPORT86 "Druckfaktor waehrend Rampe auf Schaltdruck" VALUE 0x1D7BA0 ZF_kw_ui8_S5_S3 1 UMR___1_100_0_S5_S3 0 1 /end CHARACTERISTIC
/begin CHARACTERISTIC F_PRASPORT87 "Druckfaktor waehrend Rampe auf Schaltdruck" VALUE 0x1D7B7F ZF_kw_ui8_S5_S3 1 UMR___1_100_0_S5_S3 0 1 /end CHARACTERISTIC
/begin CHARACTERISTIC F_TRA32 "Zeitfaktor waehrend Rampe auf Schaltdruck" VALUE 0x1D7B15 ZF_kw_ui8_S5_S3 1 UMR___1_100_0_S5_S3 0 1 /end CHARACTERISTIC
/begin CHARACTERISTIC F_TRA32_EL "Zeitfaktor waehrend Rampe auf Schaltdruck" VALUE 0x1D7B16 ZF_kw_ui8_S5_S3 1 UMR___1_100_0_S5_S3 0 1 /end CHARACTERISTIC
/begin CHARACTERISTIC F_TRA43 "Zeitfaktor waehrend Rampe auf Schaltdruck" VALUE 0x1D7B1B ZF_kw_ui8_S5_S3 1 UMR___1_100_0_S5_S3 0 1 /end CHARACTERISTIC
/begin CHARACTERISTIC F_TRA43_EL "Zeitfaktor waehrend Rampe auf Schaltdruck" VALUE 0x1D7B1C ZF_kw_ui8_S5_S3 1 UMR___1_100_0_S5_S3 0 1 /end CHARACTERISTIC
/begin CHARACTERISTIC F_TRA54 "Zeitfaktor waehrend Rampe auf Schaltdruck" VALUE 0x1D7B21 ZF_kw_ui8_S5_S3 1 UMR___1_100_0_S5_S3 0 1 /end CHARACTERISTIC
/begin CHARACTERISTIC F_TRA54_EL "Zeitfaktor waehrend Rampe auf Schaltdruck" VALUE 0x1D7B22 ZF_kw_ui8_S5_S3 1 UMR___1_100_0_S5_S3 0 1 /end CHARACTERISTIC
/begin CHARACTERISTIC F_TRA65 "Zeitfaktor waehrend Rampe auf Schaltdruck" VALUE 0x1D7B27 ZF_kw_ui8_S5_S3 1 UMR___1_100_0_S5_S3 0 1 /end CHARACTERISTIC
/begin CHARACTERISTIC F_TRA65_EL "Zeitfaktor waehrend Rampe auf Schaltdruck" VALUE 0x1D7B28 ZF_kw_ui8_S5_S3 1 UMR___1_100_0_S5_S3 0 1 /end CHARACTERISTIC
/begin CHARACTERISTIC F_TRA76 "Zeitfaktor waehrend Rampe auf Schaltdruck" VALUE 0x1D7B2D ZF_kw_ui8_S5_S3 1 UMR___1_100_0_S5_S3 0 1 /end CHARACTERISTIC
/begin CHARACTERISTIC F_TRA76_EL "Zeitfaktor waehrend Rampe auf Schaltdruck" VALUE 0x1D7B2E ZF_kw_ui8_S5_S3 1 UMR___1_100_0_S5_S3 0 1 /end CHARACTERISTIC
/begin CHARACTERISTIC F_TRA87 "Zeitfaktor waehrend Rampe auf Schaltdruck" VALUE 0x1D7B33 ZF_kw_ui8_S5_S3 1 UMR___1_100_0_S5_S3 0 1 /end CHARACTERISTIC
/begin CHARACTERISTIC F_TRA87_EL "Zeitfaktor waehrend Rampe auf Schaltdruck" VALUE 0x1D7B34 ZF_kw_ui8_S5_S3 1 UMR___1_100_0_S5_S3 0 1 /end CHARACTERISTIC
/begin CHARACTERISTIC F_TRASP21 "Zeitfaktor waehrend Rampe auf Schaltdruck" VALUE 0x1D7B38 ZF_kw_ui8_S5_S3 1 UMR___1_100_0_S5_S3 0 1 /end CHARACTERISTIC
/begin CHARACTERISTIC F_TRASP31 "Zeitfaktor waehrend Rampe auf Schaltdruck" VALUE 0x1D7B4D ZF_kw_ui8_S5_S3 1 UMR___1_100_0_S5_S3 0 1 /end CHARACTERISTIC
/begin CHARACTERISTIC F_TRASP32 "Zeitfaktor waehrend Rampe auf Schaltdruck" VALUE 0x1D7B3B ZF_kw_ui8_S5_S3 1 UMR___1_100_0_S5_S3 0 1 /end CHARACTERISTIC
/begin CHARACTERISTIC F_TRASP42 "Zeitfaktor waehrend Rampe auf Schaltdruck" VALUE 0x1D7B50 ZF_kw_ui8_S5_S3 1 UMR___1_100_0_S5_S3 0 1 /end CHARACTERISTIC
/begin CHARACTERISTIC F_TRASP43 "Zeitfaktor waehrend Rampe auf Schaltdruck" VALUE 0x1D7B3E ZF_kw_ui8_S5_S3 1 UMR___1_100_0_S5_S3 0 1 /end CHARACTERISTIC
/begin CHARACTERISTIC F_TRASP51 "Zeitfaktor waehrend Rampe auf Schaltdruck" VALUE 0x1D7B53 ZF_kw_ui8_S5_S3 1 UMR___1_100_0_S5_S3 0 1 /end CHARACTERISTIC
/begin CHARACTERISTIC F_TRASP53 "Zeitfaktor waehrend Rampe auf Schaltdruck" VALUE 0x1D7B56 ZF_kw_ui8_S5_S3 1 UMR___1_100_0_S5_S3 0 1 /end CHARACTERISTIC
/begin CHARACTERISTIC F_TRASP54 "Zeitfaktor waehrend Rampe auf Schaltdruck" VALUE 0x1D7B41 ZF_kw_ui8_S5_S3 1 UMR___1_100_0_S5_S3 0 1 /end CHARACTERISTIC
/begin CHARACTERISTIC F_TRASP63 "Zeitfaktor waehrend Rampe auf Schaltdruck" VALUE 0x1D7B59 ZF_kw_ui8_S5_S3 1 UMR___1_100_0_S5_S3 0 1 /end CHARACTERISTIC
/begin CHARACTERISTIC F_TRASP64 "Zeitfaktor waehrend Rampe auf Schaltdruck" VALUE 0x1D7B5C ZF_kw_ui8_S5_S3 1 UMR___1_100_0_S5_S3 0 1 /end CHARACTERISTIC
/begin CHARACTERISTIC F_TRASP65 "Zeitfaktor waehrend Rampe auf Schaltdruck" VALUE 0x1D7B44 ZF_kw_ui8_S5_S3 1 UMR___1_100_0_S5_S3 0 1 /end CHARACTERISTIC
/begin CHARACTERISTIC F_TRASP71 "Zeitfaktor waehrend Rampe auf Schaltdruck" VALUE 0x1D7B5F ZF_kw_ui8_S5_S3 1 UMR___1_100_0_S5_S3 0 1 /end CHARACTERISTIC
/begin CHARACTERISTIC F_TRASP75 "Zeitfaktor waehrend Rampe auf Schaltdruck" VALUE 0x1D7B62 ZF_kw_ui8_S5_S3 1 UMR___1_100_0_S5_S3 0 1 /end CHARACTERISTIC
/begin CHARACTERISTIC F_TRASP76 "Zeitfaktor waehrend Rampe auf Schaltdruck" VALUE 0x1D7B47 ZF_kw_ui8_S5_S3 1 UMR___1_100_0_S5_S3 0 1 /end CHARACTERISTIC
/begin CHARACTERISTIC F_TRASP82 "Zeitfaktor waehrend Rampe auf Schaltdruck" VALUE 0x1D7B65 ZF_kw_ui8_S5_S3 1 UMR___1_100_0_S5_S3 0 1 /end CHARACTERISTIC
/begin CHARACTERISTIC F_TRASP84 "Zeitfaktor waehrend Rampe auf Schaltdruck" VALUE 0x1D7B68 ZF_kw_ui8_S5_S3 1 UMR___1_100_0_S5_S3 0 1 /end CHARACTERISTIC
/begin CHARACTERISTIC F_TRASP86 "Zeitfaktor waehrend Rampe auf Schaltdruck" VALUE 0x1D7B6B ZF_kw_ui8_S5_S3 1 UMR___1_100_0_S5_S3 0 1 /end CHARACTERISTIC
/begin CHARACTERISTIC F_TRASP87 "Zeitfaktor waehrend Rampe auf Schaltdruck" VALUE 0x1D7B4A ZF_kw_ui8_S5_S3 1 UMR___1_100_0_S5_S3 0 1 /end CHARACTERISTIC
/begin CHARACTERISTIC F_TRASPORT21 "Zeitfaktor waehrend Rampe auf Schaltdruck" VALUE 0x1D7B6E ZF_kw_ui8_S5_S3 1 UMR___1_100_0_S5_S3 0 1 /end CHARACTERISTIC
/begin CHARACTERISTIC F_TRASPORT31 "Zeitfaktor waehrend Rampe auf Schaltdruck" VALUE 0x1D7B83 ZF_kw_ui8_S5_S3 1 UMR___1_100_0_S5_S3 0 1 /end CHARACTERISTIC
/begin CHARACTERISTIC F_TRASPORT32 "Zeitfaktor waehrend Rampe auf Schaltdruck" VALUE 0x1D7B71 ZF_kw_ui8_S5_S3 1 UMR___1_100_0_S5_S3 0 1 /end CHARACTERISTIC
/begin CHARACTERISTIC F_TRASPORT42 "Zeitfaktor waehrend Rampe auf Schaltdruck" VALUE 0x1D7B86 ZF_kw_ui8_S5_S3 1 UMR___1_100_0_S5_S3 0 1 /end CHARACTERISTIC
/begin CHARACTERISTIC F_TRASPORT43 "Zeitfaktor waehrend Rampe auf Schaltdruck" VALUE 0x1D7B74 ZF_kw_ui8_S5_S3 1 UMR___1_100_0_S5_S3 0 1 /end CHARACTERISTIC
/begin CHARACTERISTIC F_TRASPORT51 "Zeitfaktor waehrend Rampe auf Schaltdruck" VALUE 0x1D7B89 ZF_kw_ui8_S5_S3 1 UMR___1_100_0_S5_S3 0 1 /end CHARACTERISTIC
/begin CHARACTERISTIC F_TRASPORT53 "Zeitfaktor waehrend Rampe auf Schaltdruck" VALUE 0x1D7B8C ZF_kw_ui8_S5_S3 1 UMR___1_100_0_S5_S3 0 1 /end CHARACTERISTIC
/begin CHARACTERISTIC F_TRASPORT54 "Zeitfaktor waehrend Rampe auf Schaltdruck" VALUE 0x1D7B77 ZF_kw_ui8_S5_S3 1 UMR___1_100_0_S5_S3 0 1 /end CHARACTERISTIC
/begin CHARACTERISTIC F_TRASPORT63 "Zeitfaktor waehrend Rampe auf Schaltdruck" VALUE 0x1D7B8F ZF_kw_ui8_S5_S3 1 UMR___1_100_0_S5_S3 0 1 /end CHARACTERISTIC
/begin CHARACTERISTIC F_TRASPORT64 "Zeitfaktor waehrend Rampe auf Schaltdruck" VALUE 0x1D7B92 ZF_kw_ui8_S5_S3 1 UMR___1_100_0_S5_S3 0 1 /end CHARACTERISTIC
/begin CHARACTERISTIC F_TRASPORT65 "Zeitfaktor waehrend Rampe auf Schaltdruck" VALUE 0x1D7B7A ZF_kw_ui8_S5_S3 1 UMR___1_100_0_S5_S3 0 1 /end CHARACTERISTIC
/begin CHARACTERISTIC F_TRASPORT71 "Zeitfaktor waehrend Rampe auf Schaltdruck" VALUE 0x1D7B95 ZF_kw_ui8_S5_S3 1 UMR___1_100_0_S5_S3 0 1 /end CHARACTERISTIC
/begin CHARACTERISTIC F_TRASPORT75 "Zeitfaktor waehrend Rampe auf Schaltdruck" VALUE 0x1D7B98 ZF_kw_ui8_S5_S3 1 UMR___1_100_0_S5_S3 0 1 /end CHARACTERISTIC
/begin CHARACTERISTIC F_TRASPORT76 "Zeitfaktor waehrend Rampe auf Schaltdruck" VALUE 0x1D7B7D ZF_kw_ui8_S5_S3 1 UMR___1_100_0_S5_S3 0 1 /end CHARACTERISTIC
/begin CHARACTERISTIC F_TRASPORT82 "Zeitfaktor waehrend Rampe auf Schaltdruck" VALUE 0x1D7B9B ZF_kw_ui8_S5_S3 1 UMR___1_100_0_S5_S3 0 1 /end CHARACTERISTIC
/begin CHARACTERISTIC F_TRASPORT84 "Zeitfaktor waehrend Rampe auf Schaltdruck" VALUE 0x1D7B9E ZF_kw_ui8_S5_S3 1 UMR___1_100_0_S5_S3 0 1 /end CHARACTERISTIC
/begin CHARACTERISTIC F_TRASPORT86 "Zeitfaktor waehrend Rampe auf Schaltdruck" VALUE 0x1D7BA1 ZF_kw_ui8_S5_S3 1 UMR___1_100_0_S5_S3 0 1 /end CHARACTERISTIC
/begin CHARACTERISTIC F_TRASPORT87 "Zeitfaktor waehrend Rampe auf Schaltdruck" VALUE 0x1D7B80 ZF_kw_ui8_S5_S3 1 UMR___1_100_0_S5_S3 0 1 /end CHARACTERISTIC
/begin CHARACTERISTIC KF_PKZU32 "Schaltdruck zuschaltende Kupplung" MAP 0x1C6CC4 ZF_kf_si16_S5_S3 12.75 UMR_BAR__1_1000_0_S5_S3 0 12.75
 /begin AXIS_DESCR STD_AXIS iSasZentr.iSchaltend.n_tkf UMR_U_MIN_32_1_0_S5_S3 8 0 8160 DEPOSIT ABSOLUTE /end AXIS_DESCR
 /begin AXIS_DESCR STD_AXIS zff_atsys._.iSignale._.obj.sig_m_t UMR_NM__1_1_0_S5_S3 8 -200 1300 DEPOSIT ABSOLUTE /end AXIS_DESCR
/end CHARACTERISTIC
/begin CHARACTERISTIC KF_PKZU32_EL "Schaltdruck zuschaltende Kupplung" MAP 0x1C6D6C ZF_kf_si16_S5_S3 12.75 UMR_BAR__1_1000_0_S5_S3 0 12.75
 /begin AXIS_DESCR STD_AXIS iSasZentr.iSchaltend.n_tkf UMR_U_MIN_32_1_0_S5_S3 8 0 8160 DEPOSIT ABSOLUTE /end AXIS_DESCR
 /begin AXIS_DESCR STD_AXIS zff_atsys._.iSignale._.obj.sig_m_t UMR_NM__1_1_0_S5_S3 8 -200 1300 DEPOSIT ABSOLUTE /end AXIS_DESCR
/end CHARACTERISTIC
/begin CHARACTERISTIC KF_PKZU43 "Schaltdruck zuschaltende Kupplung" MAP 0x1C6F70 ZF_kf_si16_S5_S3 12.75 UMR_BAR__1_1000_0_S5_S3 0 12.75
 /begin AXIS_DESCR STD_AXIS iSasZentr.iSchaltend.n_tkf UMR_U_MIN_32_1_0_S5_S3 8 0 8160 DEPOSIT ABSOLUTE /end AXIS_DESCR
 /begin AXIS_DESCR STD_AXIS zff_atsys._.iSignale._.obj.sig_m_t UMR_NM__1_1_0_S5_S3 8 -200 1300 DEPOSIT ABSOLUTE /end AXIS_DESCR
/end CHARACTERISTIC
/begin CHARACTERISTIC KF_PKZU43_EL "Schaltdruck zuschaltende Kupplung" MAP 0x1C7018 ZF_kf_si16_S5_S3 12.75 UMR_BAR__1_1000_0_S5_S3 0 12.75
 /begin AXIS_DESCR STD_AXIS iSasZentr.iSchaltend.n_tkf UMR_U_MIN_32_1_0_S5_S3 8 0 8160 DEPOSIT ABSOLUTE /end AXIS_DESCR
 /begin AXIS_DESCR STD_AXIS zff_atsys._.iSignale._.obj.sig_m_t UMR_NM__1_1_0_S5_S3 8 -200 1300 DEPOSIT ABSOLUTE /end AXIS_DESCR
/end CHARACTERISTIC
/begin CHARACTERISTIC KF_PKZU54 "Schaltdruck zuschaltende Kupplung" MAP 0x1C721C ZF_kf_si16_S5_S3 12.75 UMR_BAR__1_1000_0_S5_S3 0 12.75
 /begin AXIS_DESCR STD_AXIS iSasZentr.iSchaltend.n_tkf UMR_U_MIN_32_1_0_S5_S3 8 0 8160 DEPOSIT ABSOLUTE /end AXIS_DESCR
 /begin AXIS_DESCR STD_AXIS zff_atsys._.iSignale._.obj.sig_m_t UMR_NM__1_1_0_S5_S3 8 -200 1300 DEPOSIT ABSOLUTE /end AXIS_DESCR
/end CHARACTERISTIC
/begin CHARACTERISTIC KF_PKZU54_EL "Schaltdruck zuschaltende Kupplung" MAP 0x1C72C4 ZF_kf_si16_S5_S3 12.75 UMR_BAR__1_1000_0_S5_S3 0 12.75
 /begin AXIS_DESCR STD_AXIS iSasZentr.iSchaltend.n_tkf UMR_U_MIN_32_1_0_S5_S3 8 0 8160 DEPOSIT ABSOLUTE /end AXIS_DESCR
 /begin AXIS_DESCR STD_AXIS zff_atsys._.iSignale._.obj.sig_m_t UMR_NM__1_1_0_S5_S3 8 -200 1300 DEPOSIT ABSOLUTE /end AXIS_DESCR
/end CHARACTERISTIC
/begin CHARACTERISTIC KF_PKZU65 "Schaltdruck zuschaltende Kupplung" MAP 0x1C74C8 ZF_kf_si16_S5_S3 12.75 UMR_BAR__1_1000_0_S5_S3 0 12.75
 /begin AXIS_DESCR STD_AXIS iSasZentr.iSchaltend.n_tkf UMR_U_MIN_32_1_0_S5_S3 8 0 8160 DEPOSIT ABSOLUTE /end AXIS_DESCR
 /begin AXIS_DESCR STD_AXIS zff_atsys._.iSignale._.obj.sig_m_t UMR_NM__1_1_0_S5_S3 8 -200 1300 DEPOSIT ABSOLUTE /end AXIS_DESCR
/end CHARACTERISTIC
/begin CHARACTERISTIC KF_PKZU65_EL "Schaltdruck zuschaltende Kupplung" MAP 0x1C7570 ZF_kf_si16_S5_S3 12.75 UMR_BAR__1_1000_0_S5_S3 0 12.75
 /begin AXIS_DESCR STD_AXIS iSasZentr.iSchaltend.n_tkf UMR_U_MIN_32_1_0_S5_S3 8 0 8160 DEPOSIT ABSOLUTE /end AXIS_DESCR
 /begin AXIS_DESCR STD_AXIS zff_atsys._.iSignale._.obj.sig_m_t UMR_NM__1_1_0_S5_S3 8 -200 1300 DEPOSIT ABSOLUTE /end AXIS_DESCR
/end CHARACTERISTIC
/begin CHARACTERISTIC KF_PKZU76 "Schaltdruck zuschaltende Kupplung" MAP 0x1C7774 ZF_kf_si16_S5_S3 12.75 UMR_BAR__1_1000_0_S5_S3 0 12.75
 /begin AXIS_DESCR STD_AXIS iSasZentr.iSchaltend.n_tkf UMR_U_MIN_32_1_0_S5_S3 8 0 8160 DEPOSIT ABSOLUTE /end AXIS_DESCR
 /begin AXIS_DESCR STD_AXIS zff_atsys._.iSignale._.obj.sig_m_t UMR_NM__1_1_0_S5_S3 8 -200 1300 DEPOSIT ABSOLUTE /end AXIS_DESCR
/end CHARACTERISTIC
/begin CHARACTERISTIC KF_PKZU76_EL "Schaltdruck zuschaltende Kupplung" MAP 0x1C781C ZF_kf_si16_S5_S3 12.75 UMR_BAR__1_1000_0_S5_S3 0 12.75
 /begin AXIS_DESCR STD_AXIS iSasZentr.iSchaltend.n_tkf UMR_U_MIN_32_1_0_S5_S3 8 0 8160 DEPOSIT ABSOLUTE /end AXIS_DESCR
 /begin AXIS_DESCR STD_AXIS zff_atsys._.iSignale._.obj.sig_m_t UMR_NM__1_1_0_S5_S3 8 -200 1300 DEPOSIT ABSOLUTE /end AXIS_DESCR
/end CHARACTERISTIC
/begin CHARACTERISTIC KF_PKZU87 "Schaltdruck zuschaltende Kupplung" MAP 0x1C7A20 ZF_kf_si16_S5_S3 12.75 UMR_BAR__1_1000_0_S5_S3 0 12.75
 /begin AXIS_DESCR STD_AXIS iSasZentr.iSchaltend.n_tkf UMR_U_MIN_32_1_0_S5_S3 8 0 8160 DEPOSIT ABSOLUTE /end AXIS_DESCR
 /begin AXIS_DESCR STD_AXIS zff_atsys._.iSignale._.obj.sig_m_t UMR_NM__1_1_0_S5_S3 8 -200 1300 DEPOSIT ABSOLUTE /end AXIS_DESCR
/end CHARACTERISTIC
/begin CHARACTERISTIC KF_PKZU87_EL "Schaltdruck zuschaltende Kupplung" MAP 0x1C7AC8 ZF_kf_si16_S5_S3 12.75 UMR_BAR__1_1000_0_S5_S3 0 12.75
 /begin AXIS_DESCR STD_AXIS iSasZentr.iSchaltend.n_tkf UMR_U_MIN_32_1_0_S5_S3 8 0 8160 DEPOSIT ABSOLUTE /end AXIS_DESCR
 /begin AXIS_DESCR STD_AXIS zff_atsys._.iSignale._.obj.sig_m_t UMR_NM__1_1_0_S5_S3 8 -200 1300 DEPOSIT ABSOLUTE /end AXIS_DESCR
/end CHARACTERISTIC
/begin CHARACTERISTIC KF_PKZUSP21 "Schaltdruck zuschaltende Kupplung" MAP 0x1C7C74 ZF_kf_si16_S5_S3 12.75 UMR_BAR__1_1000_0_S5_S3 0 12.75
 /begin AXIS_DESCR STD_AXIS iSasZentr.iSchaltend.n_tkf UMR_U_MIN_32_1_0_S5_S3 8 0 8160 DEPOSIT ABSOLUTE /end AXIS_DESCR
 /begin AXIS_DESCR STD_AXIS zff_atsys._.iSignale._.obj.sig_m_t UMR_NM__1_1_0_S5_S3 8 -200 1300 DEPOSIT ABSOLUTE /end AXIS_DESCR
/end CHARACTERISTIC
/begin CHARACTERISTIC KF_PKZUSP31 "Schaltdruck zuschaltende Kupplung" MAP 0x1C8828 ZF_kf_si16_S5_S3 12.75 UMR_BAR__1_1000_0_S5_S3 0 12.75
 /begin AXIS_DESCR STD_AXIS iSasZentr.iSchaltend.n_tkf UMR_U_MIN_32_1_0_S5_S3 8 0 8160 DEPOSIT ABSOLUTE /end AXIS_DESCR
 /begin AXIS_DESCR STD_AXIS zff_atsys._.iSignale._.obj.sig_m_t UMR_NM__1_1_0_S5_S3 8 -200 1300 DEPOSIT ABSOLUTE /end AXIS_DESCR
/end CHARACTERISTIC
/begin CHARACTERISTIC KF_PKZUSP32 "Schaltdruck zuschaltende Kupplung" MAP 0x1C7E20 ZF_kf_si16_S5_S3 12.75 UMR_BAR__1_1000_0_S5_S3 0 12.75
 /begin AXIS_DESCR STD_AXIS iSasZentr.iSchaltend.n_tkf UMR_U_MIN_32_1_0_S5_S3 8 0 8160 DEPOSIT ABSOLUTE /end AXIS_DESCR
 /begin AXIS_DESCR STD_AXIS zff_atsys._.iSignale._.obj.sig_m_t UMR_NM__1_1_0_S5_S3 8 -200 1300 DEPOSIT ABSOLUTE /end AXIS_DESCR
/end CHARACTERISTIC
/begin CHARACTERISTIC KF_PKZUSP42 "Schaltdruck zuschaltende Kupplung" MAP 0x1C89D4 ZF_kf_si16_S5_S3 12.75 UMR_BAR__1_1000_0_S5_S3 0 12.75
 /begin AXIS_DESCR STD_AXIS iSasZentr.iSchaltend.n_tkf UMR_U_MIN_32_1_0_S5_S3 8 0 8160 DEPOSIT ABSOLUTE /end AXIS_DESCR
 /begin AXIS_DESCR STD_AXIS zff_atsys._.iSignale._.obj.sig_m_t UMR_NM__1_1_0_S5_S3 8 -200 1300 DEPOSIT ABSOLUTE /end AXIS_DESCR
/end CHARACTERISTIC
/begin CHARACTERISTIC KF_PKZUSP43 "Schaltdruck zuschaltende Kupplung" MAP 0x1C7FCC ZF_kf_si16_S5_S3 12.75 UMR_BAR__1_1000_0_S5_S3 0 12.75
 /begin AXIS_DESCR STD_AXIS iSasZentr.iSchaltend.n_tkf UMR_U_MIN_32_1_0_S5_S3 8 0 8160 DEPOSIT ABSOLUTE /end AXIS_DESCR
 /begin AXIS_DESCR STD_AXIS zff_atsys._.iSignale._.obj.sig_m_t UMR_NM__1_1_0_S5_S3 8 -200 1300 DEPOSIT ABSOLUTE /end AXIS_DESCR
/end CHARACTERISTIC
/begin CHARACTERISTIC KF_PKZUSP51 "Schaltdruck zuschaltende Kupplung" MAP 0x1C8B80 ZF_kf_si16_S5_S3 12.75 UMR_BAR__1_1000_0_S5_S3 0 12.75
 /begin AXIS_DESCR STD_AXIS iSasZentr.iSchaltend.n_tkf UMR_U_MIN_32_1_0_S5_S3 8 0 8160 DEPOSIT ABSOLUTE /end AXIS_DESCR
 /begin AXIS_DESCR STD_AXIS zff_atsys._.iSignale._.obj.sig_m_t UMR_NM__1_1_0_S5_S3 8 -200 1300 DEPOSIT ABSOLUTE /end AXIS_DESCR
/end CHARACTERISTIC
/begin CHARACTERISTIC KF_PKZUSP53 "Schaltdruck zuschaltende Kupplung" MAP 0x1C8D2C ZF_kf_si16_S5_S3 12.75 UMR_BAR__1_1000_0_S5_S3 0 12.75
 /begin AXIS_DESCR STD_AXIS iSasZentr.iSchaltend.n_tkf UMR_U_MIN_32_1_0_S5_S3 8 0 8160 DEPOSIT ABSOLUTE /end AXIS_DESCR
 /begin AXIS_DESCR STD_AXIS zff_atsys._.iSignale._.obj.sig_m_t UMR_NM__1_1_0_S5_S3 8 -200 1300 DEPOSIT ABSOLUTE /end AXIS_DESCR
/end CHARACTERISTIC
/begin CHARACTERISTIC KF_PKZUSP54 "Schaltdruck zuschaltende Kupplung" MAP 0x1C8178 ZF_kf_si16_S5_S3 12.75 UMR_BAR__1_1000_0_S5_S3 0 12.75
 /begin AXIS_DESCR STD_AXIS iSasZentr.iSchaltend.n_tkf UMR_U_MIN_32_1_0_S5_S3 8 0 8160 DEPOSIT ABSOLUTE /end AXIS_DESCR
 /begin AXIS_DESCR STD_AXIS zff_atsys._.iSignale._.obj.sig_m_t UMR_NM__1_1_0_S5_S3 8 -200 1300 DEPOSIT ABSOLUTE /end AXIS_DESCR
/end CHARACTERISTIC
/begin CHARACTERISTIC KF_PKZUSP63 "Schaltdruck zuschaltende Kupplung" MAP 0x1C8ED8 ZF_kf_si16_S5_S3 12.75 UMR_BAR__1_1000_0_S5_S3 0 12.75
 /begin AXIS_DESCR STD_AXIS iSasZentr.iSchaltend.n_tkf UMR_U_MIN_32_1_0_S5_S3 8 0 8160 DEPOSIT ABSOLUTE /end AXIS_DESCR
 /begin AXIS_DESCR STD_AXIS zff_atsys._.iSignale._.obj.sig_m_t UMR_NM__1_1_0_S5_S3 8 -200 1300 DEPOSIT ABSOLUTE /end AXIS_DESCR
/end CHARACTERISTIC
/begin CHARACTERISTIC KF_PKZUSP64 "Schaltdruck zuschaltende Kupplung" MAP 0x1C9084 ZF_kf_si16_S5_S3 12.75 UMR_BAR__1_1000_0_S5_S3 0 12.75
 /begin AXIS_DESCR STD_AXIS iSasZentr.iSchaltend.n_tkf UMR_U_MIN_32_1_0_S5_S3 8 0 8160 DEPOSIT ABSOLUTE /end AXIS_DESCR
 /begin AXIS_DESCR STD_AXIS zff_atsys._.iSignale._.obj.sig_m_t UMR_NM__1_1_0_S5_S3 8 -200 1300 DEPOSIT ABSOLUTE /end AXIS_DESCR
/end CHARACTERISTIC
/begin CHARACTERISTIC KF_PKZUSP65 "Schaltdruck zuschaltende Kupplung" MAP 0x1C8324 ZF_kf_si16_S5_S3 12.75 UMR_BAR__1_1000_0_S5_S3 0 12.75
 /begin AXIS_DESCR STD_AXIS iSasZentr.iSchaltend.n_tkf UMR_U_MIN_32_1_0_S5_S3 8 0 8160 DEPOSIT ABSOLUTE /end AXIS_DESCR
 /begin AXIS_DESCR STD_AXIS zff_atsys._.iSignale._.obj.sig_m_t UMR_NM__1_1_0_S5_S3 8 -200 1300 DEPOSIT ABSOLUTE /end AXIS_DESCR
/end CHARACTERISTIC
/begin CHARACTERISTIC KF_PKZUSP71 "Schaltdruck zuschaltende Kupplung" MAP 0x1C9230 ZF_kf_si16_S5_S3 12.75 UMR_BAR__1_1000_0_S5_S3 0 12.75
 /begin AXIS_DESCR STD_AXIS iSasZentr.iSchaltend.n_tkf UMR_U_MIN_32_1_0_S5_S3 8 0 8160 DEPOSIT ABSOLUTE /end AXIS_DESCR
 /begin AXIS_DESCR STD_AXIS zff_atsys._.iSignale._.obj.sig_m_t UMR_NM__1_1_0_S5_S3 8 -200 1300 DEPOSIT ABSOLUTE /end AXIS_DESCR
/end CHARACTERISTIC
/begin CHARACTERISTIC KF_PKZUSP75 "Schaltdruck zuschaltende Kupplung" MAP 0x1C93DC ZF_kf_si16_S5_S3 12.75 UMR_BAR__1_1000_0_S5_S3 0 12.75
 /begin AXIS_DESCR STD_AXIS iSasZentr.iSchaltend.n_tkf UMR_U_MIN_32_1_0_S5_S3 8 0 8160 DEPOSIT ABSOLUTE /end AXIS_DESCR
 /begin AXIS_DESCR STD_AXIS zff_atsys._.iSignale._.obj.sig_m_t UMR_NM__1_1_0_S5_S3 8 -200 1300 DEPOSIT ABSOLUTE /end AXIS_DESCR
/end CHARACTERISTIC
/begin CHARACTERISTIC KF_PKZUSP76 "Schaltdruck zuschaltende Kupplung" MAP 0x1C84D0 ZF_kf_si16_S5_S3 12.75 UMR_BAR__1_1000_0_S5_S3 0 12.75
 /begin AXIS_DESCR STD_AXIS iSasZentr.iSchaltend.n_tkf UMR_U_MIN_32_1_0_S5_S3 8 0 8160 DEPOSIT ABSOLUTE /end AXIS_DESCR
 /begin AXIS_DESCR STD_AXIS zff_atsys._.iSignale._.obj.sig_m_t UMR_NM__1_1_0_S5_S3 8 -200 1300 DEPOSIT ABSOLUTE /end AXIS_DESCR
/end CHARACTERISTIC
/begin CHARACTERISTIC KF_PKZUSP82 "Schaltdruck zuschaltende Kupplung" MAP 0x1C9588 ZF_kf_si16_S5_S3 12.75 UMR_BAR__1_1000_0_S5_S3 0 12.75
 /begin AXIS_DESCR STD_AXIS iSasZentr.iSchaltend.n_tkf UMR_U_MIN_32_1_0_S5_S3 8 0 8160 DEPOSIT ABSOLUTE /end AXIS_DESCR
 /begin AXIS_DESCR STD_AXIS zff_atsys._.iSignale._.obj.sig_m_t UMR_NM__1_1_0_S5_S3 8 -200 1300 DEPOSIT ABSOLUTE /end AXIS_DESCR
/end CHARACTERISTIC
/begin CHARACTERISTIC KF_PKZUSP84 "Schaltdruck zuschaltende Kupplung" MAP 0x1C9734 ZF_kf_si16_S5_S3 12.75 UMR_BAR__1_1000_0_S5_S3 0 12.75
 /begin AXIS_DESCR STD_AXIS iSasZentr.iSchaltend.n_tkf UMR_U_MIN_32_1_0_S5_S3 8 0 8160 DEPOSIT ABSOLUTE /end AXIS_DESCR
 /begin AXIS_DESCR STD_AXIS zff_atsys._.iSignale._.obj.sig_m_t UMR_NM__1_1_0_S5_S3 8 -200 1300 DEPOSIT ABSOLUTE /end AXIS_DESCR
/end CHARACTERISTIC
/begin CHARACTERISTIC KF_PKZUSP86 "Schaltdruck zuschaltende Kupplung" MAP 0x1C98E0 ZF_kf_si16_S5_S3 12.75 UMR_BAR__1_1000_0_S5_S3 0 12.75
 /begin AXIS_DESCR STD_AXIS iSasZentr.iSchaltend.n_tkf UMR_U_MIN_32_1_0_S5_S3 8 0 8160 DEPOSIT ABSOLUTE /end AXIS_DESCR
 /begin AXIS_DESCR STD_AXIS zff_atsys._.iSignale._.obj.sig_m_t UMR_NM__1_1_0_S5_S3 8 -200 1300 DEPOSIT ABSOLUTE /end AXIS_DESCR
/end CHARACTERISTIC
/begin CHARACTERISTIC KF_PKZUSP87 "Schaltdruck zuschaltende Kupplung" MAP 0x1C867C ZF_kf_si16_S5_S3 12.75 UMR_BAR__1_1000_0_S5_S3 0 12.75
 /begin AXIS_DESCR STD_AXIS iSasZentr.iSchaltend.n_tkf UMR_U_MIN_32_1_0_S5_S3 8 0 8160 DEPOSIT ABSOLUTE /end AXIS_DESCR
 /begin AXIS_DESCR STD_AXIS zff_atsys._.iSignale._.obj.sig_m_t UMR_NM__1_1_0_S5_S3 8 -200 1300 DEPOSIT ABSOLUTE /end AXIS_DESCR
/end CHARACTERISTIC
/begin CHARACTERISTIC KF_PKZUSPORT21 "Schaltdruck zuschaltende Kupplung" MAP 0x1C9A8C ZF_kf_si16_S5_S3 12.75 UMR_BAR__1_1000_0_S5_S3 0 12.75
 /begin AXIS_DESCR STD_AXIS iSasZentr.iSchaltend.n_tkf UMR_U_MIN_32_1_0_S5_S3 8 0 8160 DEPOSIT ABSOLUTE /end AXIS_DESCR
 /begin AXIS_DESCR STD_AXIS zff_atsys._.iSignale._.obj.sig_m_t UMR_NM__1_1_0_S5_S3 8 -200 1300 DEPOSIT ABSOLUTE /end AXIS_DESCR
/end CHARACTERISTIC
/begin CHARACTERISTIC KF_PKZUSPORT31 "Schaltdruck zuschaltende Kupplung" MAP 0x1CA640 ZF_kf_si16_S5_S3 12.75 UMR_BAR__1_1000_0_S5_S3 0 12.75
 /begin AXIS_DESCR STD_AXIS iSasZentr.iSchaltend.n_tkf UMR_U_MIN_32_1_0_S5_S3 8 0 8160 DEPOSIT ABSOLUTE /end AXIS_DESCR
 /begin AXIS_DESCR STD_AXIS zff_atsys._.iSignale._.obj.sig_m_t UMR_NM__1_1_0_S5_S3 8 -200 1300 DEPOSIT ABSOLUTE /end AXIS_DESCR
/end CHARACTERISTIC
/begin CHARACTERISTIC KF_PKZUSPORT32 "Schaltdruck zuschaltende Kupplung" MAP 0x1C9C38 ZF_kf_si16_S5_S3 12.75 UMR_BAR__1_1000_0_S5_S3 0 12.75
 /begin AXIS_DESCR STD_AXIS iSasZentr.iSchaltend.n_tkf UMR_U_MIN_32_1_0_S5_S3 8 0 8160 DEPOSIT ABSOLUTE /end AXIS_DESCR
 /begin AXIS_DESCR STD_AXIS zff_atsys._.iSignale._.obj.sig_m_t UMR_NM__1_1_0_S5_S3 8 -200 1300 DEPOSIT ABSOLUTE /end AXIS_DESCR
/end CHARACTERISTIC
/begin CHARACTERISTIC KF_PKZUSPORT42 "Schaltdruck zuschaltende Kupplung" MAP 0x1CA7EC ZF_kf_si16_S5_S3 12.75 UMR_BAR__1_1000_0_S5_S3 0 12.75
 /begin AXIS_DESCR STD_AXIS iSasZentr.iSchaltend.n_tkf UMR_U_MIN_32_1_0_S5_S3 8 0 8160 DEPOSIT ABSOLUTE /end AXIS_DESCR
 /begin AXIS_DESCR STD_AXIS zff_atsys._.iSignale._.obj.sig_m_t UMR_NM__1_1_0_S5_S3 8 -200 1300 DEPOSIT ABSOLUTE /end AXIS_DESCR
/end CHARACTERISTIC
/begin CHARACTERISTIC KF_PKZUSPORT43 "Schaltdruck zuschaltende Kupplung" MAP 0x1C9DE4 ZF_kf_si16_S5_S3 12.75 UMR_BAR__1_1000_0_S5_S3 0 12.75
 /begin AXIS_DESCR STD_AXIS iSasZentr.iSchaltend.n_tkf UMR_U_MIN_32_1_0_S5_S3 8 0 8160 DEPOSIT ABSOLUTE /end AXIS_DESCR
 /begin AXIS_DESCR STD_AXIS zff_atsys._.iSignale._.obj.sig_m_t UMR_NM__1_1_0_S5_S3 8 -200 1300 DEPOSIT ABSOLUTE /end AXIS_DESCR
/end CHARACTERISTIC
/begin CHARACTERISTIC KF_PKZUSPORT51 "Schaltdruck zuschaltende Kupplung" MAP 0x1CA998 ZF_kf_si16_S5_S3 12.75 UMR_BAR__1_1000_0_S5_S3 0 12.75
 /begin AXIS_DESCR STD_AXIS iSasZentr.iSchaltend.n_tkf UMR_U_MIN_32_1_0_S5_S3 8 0 8160 DEPOSIT ABSOLUTE /end AXIS_DESCR
 /begin AXIS_DESCR STD_AXIS zff_atsys._.iSignale._.obj.sig_m_t UMR_NM__1_1_0_S5_S3 8 -200 1300 DEPOSIT ABSOLUTE /end AXIS_DESCR
/end CHARACTERISTIC
/begin CHARACTERISTIC KF_PKZUSPORT53 "Schaltdruck zuschaltende Kupplung" MAP 0x1CAB44 ZF_kf_si16_S5_S3 12.75 UMR_BAR__1_1000_0_S5_S3 0 12.75
 /begin AXIS_DESCR STD_AXIS iSasZentr.iSchaltend.n_tkf UMR_U_MIN_32_1_0_S5_S3 8 0 8160 DEPOSIT ABSOLUTE /end AXIS_DESCR
 /begin AXIS_DESCR STD_AXIS zff_atsys._.iSignale._.obj.sig_m_t UMR_NM__1_1_0_S5_S3 8 -200 1300 DEPOSIT ABSOLUTE /end AXIS_DESCR
/end CHARACTERISTIC
/begin CHARACTERISTIC KF_PKZUSPORT54 "Schaltdruck zuschaltende Kupplung" MAP 0x1C9F90 ZF_kf_si16_S5_S3 12.75 UMR_BAR__1_1000_0_S5_S3 0 12.75
 /begin AXIS_DESCR STD_AXIS iSasZentr.iSchaltend.n_tkf UMR_U_MIN_32_1_0_S5_S3 8 0 8160 DEPOSIT ABSOLUTE /end AXIS_DESCR
 /begin AXIS_DESCR STD_AXIS zff_atsys._.iSignale._.obj.sig_m_t UMR_NM__1_1_0_S5_S3 8 -200 1300 DEPOSIT ABSOLUTE /end AXIS_DESCR
/end CHARACTERISTIC
/begin CHARACTERISTIC KF_PKZUSPORT63 "Schaltdruck zuschaltende Kupplung" MAP 0x1CACF0 ZF_kf_si16_S5_S3 12.75 UMR_BAR__1_1000_0_S5_S3 0 12.75
 /begin AXIS_DESCR STD_AXIS iSasZentr.iSchaltend.n_tkf UMR_U_MIN_32_1_0_S5_S3 8 0 8160 DEPOSIT ABSOLUTE /end AXIS_DESCR
 /begin AXIS_DESCR STD_AXIS zff_atsys._.iSignale._.obj.sig_m_t UMR_NM__1_1_0_S5_S3 8 -200 1300 DEPOSIT ABSOLUTE /end AXIS_DESCR
/end CHARACTERISTIC
/begin CHARACTERISTIC KF_PKZUSPORT64 "Schaltdruck zuschaltende Kupplung" MAP 0x1CAE9C ZF_kf_si16_S5_S3 12.75 UMR_BAR__1_1000_0_S5_S3 0 12.75
 /begin AXIS_DESCR STD_AXIS iSasZentr.iSchaltend.n_tkf UMR_U_MIN_32_1_0_S5_S3 8 0 8160 DEPOSIT ABSOLUTE /end AXIS_DESCR
 /begin AXIS_DESCR STD_AXIS zff_atsys._.iSignale._.obj.sig_m_t UMR_NM__1_1_0_S5_S3 8 -200 1300 DEPOSIT ABSOLUTE /end AXIS_DESCR
/end CHARACTERISTIC
/begin CHARACTERISTIC KF_PKZUSPORT65 "Schaltdruck zuschaltende Kupplung" MAP 0x1CA13C ZF_kf_si16_S5_S3 12.75 UMR_BAR__1_1000_0_S5_S3 0 12.75
 /begin AXIS_DESCR STD_AXIS iSasZentr.iSchaltend.n_tkf UMR_U_MIN_32_1_0_S5_S3 8 0 8160 DEPOSIT ABSOLUTE /end AXIS_DESCR
 /begin AXIS_DESCR STD_AXIS zff_atsys._.iSignale._.obj.sig_m_t UMR_NM__1_1_0_S5_S3 8 -200 1300 DEPOSIT ABSOLUTE /end AXIS_DESCR
/end CHARACTERISTIC
/begin CHARACTERISTIC KF_PKZUSPORT71 "Schaltdruck zuschaltende Kupplung" MAP 0x1CB048 ZF_kf_si16_S5_S3 12.75 UMR_BAR__1_1000_0_S5_S3 0 12.75
 /begin AXIS_DESCR STD_AXIS iSasZentr.iSchaltend.n_tkf UMR_U_MIN_32_1_0_S5_S3 8 0 8160 DEPOSIT ABSOLUTE /end AXIS_DESCR
 /begin AXIS_DESCR STD_AXIS zff_atsys._.iSignale._.obj.sig_m_t UMR_NM__1_1_0_S5_S3 8 -200 1300 DEPOSIT ABSOLUTE /end AXIS_DESCR
/end CHARACTERISTIC
/begin CHARACTERISTIC KF_PKZUSPORT75 "Schaltdruck zuschaltende Kupplung" MAP 0x1CB1F4 ZF_kf_si16_S5_S3 12.75 UMR_BAR__1_1000_0_S5_S3 0 12.75
 /begin AXIS_DESCR STD_AXIS iSasZentr.iSchaltend.n_tkf UMR_U_MIN_32_1_0_S5_S3 8 0 8160 DEPOSIT ABSOLUTE /end AXIS_DESCR
 /begin AXIS_DESCR STD_AXIS zff_atsys._.iSignale._.obj.sig_m_t UMR_NM__1_1_0_S5_S3 8 -200 1300 DEPOSIT ABSOLUTE /end AXIS_DESCR
/end CHARACTERISTIC
/begin CHARACTERISTIC KF_PKZUSPORT76 "Schaltdruck zuschaltende Kupplung" MAP 0x1CA2E8 ZF_kf_si16_S5_S3 12.75 UMR_BAR__1_1000_0_S5_S3 0 12.75
 /begin AXIS_DESCR STD_AXIS iSasZentr.iSchaltend.n_tkf UMR_U_MIN_32_1_0_S5_S3 8 0 8160 DEPOSIT ABSOLUTE /end AXIS_DESCR
 /begin AXIS_DESCR STD_AXIS zff_atsys._.iSignale._.obj.sig_m_t UMR_NM__1_1_0_S5_S3 8 -200 1300 DEPOSIT ABSOLUTE /end AXIS_DESCR
/end CHARACTERISTIC
/begin CHARACTERISTIC KF_PKZUSPORT82 "Schaltdruck zuschaltende Kupplung" MAP 0x1CB3A0 ZF_kf_si16_S5_S3 12.75 UMR_BAR__1_1000_0_S5_S3 0 12.75
 /begin AXIS_DESCR STD_AXIS iSasZentr.iSchaltend.n_tkf UMR_U_MIN_32_1_0_S5_S3 8 0 8160 DEPOSIT ABSOLUTE /end AXIS_DESCR
 /begin AXIS_DESCR STD_AXIS zff_atsys._.iSignale._.obj.sig_m_t UMR_NM__1_1_0_S5_S3 8 -200 1300 DEPOSIT ABSOLUTE /end AXIS_DESCR
/end CHARACTERISTIC
/begin CHARACTERISTIC KF_PKZUSPORT84 "Schaltdruck zuschaltende Kupplung" MAP 0x1CB54C ZF_kf_si16_S5_S3 12.75 UMR_BAR__1_1000_0_S5_S3 0 12.75
 /begin AXIS_DESCR STD_AXIS iSasZentr.iSchaltend.n_tkf UMR_U_MIN_32_1_0_S5_S3 8 0 8160 DEPOSIT ABSOLUTE /end AXIS_DESCR
 /begin AXIS_DESCR STD_AXIS zff_atsys._.iSignale._.obj.sig_m_t UMR_NM__1_1_0_S5_S3 8 -200 1300 DEPOSIT ABSOLUTE /end AXIS_DESCR
/end CHARACTERISTIC
/begin CHARACTERISTIC KF_PKZUSPORT86 "Schaltdruck zuschaltende Kupplung" MAP 0x1CB6F8 ZF_kf_si16_S5_S3 12.75 UMR_BAR__1_1000_0_S5_S3 0 12.75
 /begin AXIS_DESCR STD_AXIS iSasZentr.iSchaltend.n_tkf UMR_U_MIN_32_1_0_S5_S3 8 0 8160 DEPOSIT ABSOLUTE /end AXIS_DESCR
 /begin AXIS_DESCR STD_AXIS zff_atsys._.iSignale._.obj.sig_m_t UMR_NM__1_1_0_S5_S3 8 -200 1300 DEPOSIT ABSOLUTE /end AXIS_DESCR
/end CHARACTERISTIC
/begin CHARACTERISTIC KF_PKZUSPORT87 "Schaltdruck zuschaltende Kupplung" MAP 0x1CA494 ZF_kf_si16_S5_S3 12.75 UMR_BAR__1_1000_0_S5_S3 0 12.75
 /begin AXIS_DESCR STD_AXIS iSasZentr.iSchaltend.n_tkf UMR_U_MIN_32_1_0_S5_S3 8 0 8160 DEPOSIT ABSOLUTE /end AXIS_DESCR
 /begin AXIS_DESCR STD_AXIS zff_atsys._.iSignale._.obj.sig_m_t UMR_NM__1_1_0_S5_S3 8 -200 1300 DEPOSIT ABSOLUTE /end AXIS_DESCR
/end CHARACTERISTIC
/begin CHARACTERISTIC KF_PKZUWS21 "Schaltdruckkennfeld (n_tkf, m_t)" MAP 0x1CB940 ZF_kf_si16_S5_S3 12.75 UMR_BAR__1_1000_0_S5_S3 0 12.75
 /begin AXIS_DESCR STD_AXIS iSasZentr.iSchaltend.n_tkf UMR_U_MIN_32_1_0_S5_S3 8 0 8160 DEPOSIT ABSOLUTE /end AXIS_DESCR
 /begin AXIS_DESCR STD_AXIS zff_atsys._.iSignale._.obj.sig_m_t UMR_NM__1_1_0_S5_S3 8 -200 1300 DEPOSIT ABSOLUTE /end AXIS_DESCR
/end CHARACTERISTIC
/begin CHARACTERISTIC KF_PKZUWS32 "Schaltdruckkennfeld (n_tkf, m_t)" MAP 0x1CBB8C ZF_kf_si16_S5_S3 12.75 UMR_BAR__1_1000_0_S5_S3 0 12.75
 /begin AXIS_DESCR STD_AXIS iSasZentr.iSchaltend.n_tkf UMR_U_MIN_32_1_0_S5_S3 8 0 8160 DEPOSIT ABSOLUTE /end AXIS_DESCR
 /begin AXIS_DESCR STD_AXIS zff_atsys._.iSignale._.obj.sig_m_t UMR_NM__1_1_0_S5_S3 8 -200 1300 DEPOSIT ABSOLUTE /end AXIS_DESCR
/end CHARACTERISTIC
/begin CHARACTERISTIC KF_PKZUWS43 "Schaltdruckkennfeld (n_tkf, m_t)" MAP 0x1CBDD8 ZF_kf_si16_S5_S3 12.75 UMR_BAR__1_1000_0_S5_S3 0 12.75
 /begin AXIS_DESCR STD_AXIS iSasZentr.iSchaltend.n_tkf UMR_U_MIN_32_1_0_S5_S3 8 0 8160 DEPOSIT ABSOLUTE /end AXIS_DESCR
 /begin AXIS_DESCR STD_AXIS zff_atsys._.iSignale._.obj.sig_m_t UMR_NM__1_1_0_S5_S3 8 -200 1300 DEPOSIT ABSOLUTE /end AXIS_DESCR
/end CHARACTERISTIC
/begin CHARACTERISTIC KF_PKZUWS54 "Schaltdruckkennfeld (n_tkf, m_t)" MAP 0x1CC024 ZF_kf_si16_S5_S3 12.75 UMR_BAR__1_1000_0_S5_S3 0 12.75
 /begin AXIS_DESCR STD_AXIS iSasZentr.iSchaltend.n_tkf UMR_U_MIN_32_1_0_S5_S3 8 0 8160 DEPOSIT ABSOLUTE /end AXIS_DESCR
 /begin AXIS_DESCR STD_AXIS zff_atsys._.iSignale._.obj.sig_m_t UMR_NM__1_1_0_S5_S3 8 -200 1300 DEPOSIT ABSOLUTE /end AXIS_DESCR
/end CHARACTERISTIC
/begin CHARACTERISTIC KF_PKZUWSSP31 "Schaltdruckkennfeld (n_tkf, m_t)" MAP 0x1CC954 ZF_kf_si16_S5_S3 12.75 UMR_BAR__1_1000_0_S5_S3 0 12.75
 /begin AXIS_DESCR STD_AXIS iSasZentr.iSchaltend.n_tkf UMR_U_MIN_32_1_0_S5_S3 8 0 8160 DEPOSIT ABSOLUTE /end AXIS_DESCR
 /begin AXIS_DESCR STD_AXIS zff_atsys._.iSignale._.obj.sig_m_t UMR_NM__1_1_0_S5_S3 8 -200 1300 DEPOSIT ABSOLUTE /end AXIS_DESCR
/end CHARACTERISTIC
/begin CHARACTERISTIC KF_PKZUWSSP42 "Schaltdruckkennfeld (n_tkf, m_t)" MAP 0x1CCBA0 ZF_kf_si16_S5_S3 12.75 UMR_BAR__1_1000_0_S5_S3 0 12.75
 /begin AXIS_DESCR STD_AXIS iSasZentr.iSchaltend.n_tkf UMR_U_MIN_32_1_0_S5_S3 8 0 8160 DEPOSIT ABSOLUTE /end AXIS_DESCR
 /begin AXIS_DESCR STD_AXIS zff_atsys._.iSignale._.obj.sig_m_t UMR_NM__1_1_0_S5_S3 8 -200 1300 DEPOSIT ABSOLUTE /end AXIS_DESCR
/end CHARACTERISTIC
/begin CHARACTERISTIC KF_PKZUWSSP51 "Schaltdruckkennfeld (n_tkf, m_t)" MAP 0x1CCDEC ZF_kf_si16_S5_S3 12.75 UMR_BAR__1_1000_0_S5_S3 0 12.75
 /begin AXIS_DESCR STD_AXIS iSasZentr.iSchaltend.n_tkf UMR_U_MIN_32_1_0_S5_S3 8 0 8160 DEPOSIT ABSOLUTE /end AXIS_DESCR
 /begin AXIS_DESCR STD_AXIS zff_atsys._.iSignale._.obj.sig_m_t UMR_NM__1_1_0_S5_S3 8 -200 1300 DEPOSIT ABSOLUTE /end AXIS_DESCR
/end CHARACTERISTIC
/begin CHARACTERISTIC KF_PKZUWSSP53 "Schaltdruckkennfeld (n_tkf, m_t)" MAP 0x1CD038 ZF_kf_si16_S5_S3 12.75 UMR_BAR__1_1000_0_S5_S3 0 12.75
 /begin AXIS_DESCR STD_AXIS iSasZentr.iSchaltend.n_tkf UMR_U_MIN_32_1_0_S5_S3 8 0 8160 DEPOSIT ABSOLUTE /end AXIS_DESCR
 /begin AXIS_DESCR STD_AXIS zff_atsys._.iSignale._.obj.sig_m_t UMR_NM__1_1_0_S5_S3 8 -200 1300 DEPOSIT ABSOLUTE /end AXIS_DESCR
/end CHARACTERISTIC
/begin CHARACTERISTIC KF_PKZUWSSP63 "Schaltdruckkennfeld (n_tkf, m_t)" MAP 0x1CD284 ZF_kf_si16_S5_S3 12.75 UMR_BAR__1_1000_0_S5_S3 0 12.75
 /begin AXIS_DESCR STD_AXIS iSasZentr.iSchaltend.n_tkf UMR_U_MIN_32_1_0_S5_S3 8 0 8160 DEPOSIT ABSOLUTE /end AXIS_DESCR
 /begin AXIS_DESCR STD_AXIS zff_atsys._.iSignale._.obj.sig_m_t UMR_NM__1_1_0_S5_S3 8 -200 1300 DEPOSIT ABSOLUTE /end AXIS_DESCR
/end CHARACTERISTIC
/begin CHARACTERISTIC KF_POFMTN32 "Kennfeld Fuelldruckoffset(n_t, m_t)" MAP 0x1C6C2C ZF_kf_si16_S5_S3 12.75 UMR_BAR__1_1000_0_S5_S3 -6.4 6.35
 /begin AXIS_DESCR STD_AXIS zff_atsys._.iSignale._.obj.sig_n_t UMR_U_MIN_1_1_0_S5_S3 4 0 8160 DEPOSIT ABSOLUTE /end AXIS_DESCR
 /begin AXIS_DESCR STD_AXIS zff_atsys._.iSignale._.obj.sig_m_t UMR_NM__1_1_0_S5_S3 6 -200 1300 DEPOSIT ABSOLUTE /end AXIS_DESCR
/end CHARACTERISTIC
/begin CHARACTERISTIC KF_POFMTN32_EL "Kennfeld Fuelldruckoffset(n_t, m_t)" MAP 0x1C6C78 ZF_kf_si16_S5_S3 12.75 UMR_BAR__1_1000_0_S5_S3 -6.4 6.35
 /begin AXIS_DESCR STD_AXIS zff_atsys._.iSignale._.obj.sig_n_t UMR_U_MIN_1_1_0_S5_S3 4 0 8160 DEPOSIT ABSOLUTE /end AXIS_DESCR
 /begin AXIS_DESCR STD_AXIS zff_atsys._.iSignale._.obj.sig_m_t UMR_NM__1_1_0_S5_S3 6 -200 1300 DEPOSIT ABSOLUTE /end AXIS_DESCR
/end CHARACTERISTIC
/begin CHARACTERISTIC KF_POFMTN43 "Kennfeld Fuelldruckoffset(n_t, m_t)" MAP 0x1C6ED8 ZF_kf_si16_S5_S3 12.75 UMR_BAR__1_1000_0_S5_S3 -6.4 6.35
 /begin AXIS_DESCR STD_AXIS zff_atsys._.iSignale._.obj.sig_n_t UMR_U_MIN_1_1_0_S5_S3 4 0 8160 DEPOSIT ABSOLUTE /end AXIS_DESCR
 /begin AXIS_DESCR STD_AXIS zff_atsys._.iSignale._.obj.sig_m_t UMR_NM__1_1_0_S5_S3 6 -200 1300 DEPOSIT ABSOLUTE /end AXIS_DESCR
/end CHARACTERISTIC
/begin CHARACTERISTIC KF_POFMTN43_EL "Kennfeld Fuelldruckoffset(n_t, m_t)" MAP 0x1C6F24 ZF_kf_si16_S5_S3 12.75 UMR_BAR__1_1000_0_S5_S3 -6.4 6.35
 /begin AXIS_DESCR STD_AXIS zff_atsys._.iSignale._.obj.sig_n_t UMR_U_MIN_1_1_0_S5_S3 4 0 8160 DEPOSIT ABSOLUTE /end AXIS_DESCR
 /begin AXIS_DESCR STD_AXIS zff_atsys._.iSignale._.obj.sig_m_t UMR_NM__1_1_0_S5_S3 6 -200 1300 DEPOSIT ABSOLUTE /end AXIS_DESCR
/end CHARACTERISTIC
/begin CHARACTERISTIC KF_POFMTN54 "Kennfeld Fuelldruckoffset(n_t, m_t)" MAP 0x1C7184 ZF_kf_si16_S5_S3 12.75 UMR_BAR__1_1000_0_S5_S3 -6.4 6.35
 /begin AXIS_DESCR STD_AXIS zff_atsys._.iSignale._.obj.sig_n_t UMR_U_MIN_1_1_0_S5_S3 4 0 8160 DEPOSIT ABSOLUTE /end AXIS_DESCR
 /begin AXIS_DESCR STD_AXIS zff_atsys._.iSignale._.obj.sig_m_t UMR_NM__1_1_0_S5_S3 6 -200 1300 DEPOSIT ABSOLUTE /end AXIS_DESCR
/end CHARACTERISTIC
/begin CHARACTERISTIC KF_POFMTN54_EL "Kennfeld Fuelldruckoffset(n_t, m_t)" MAP 0x1C71D0 ZF_kf_si16_S5_S3 12.75 UMR_BAR__1_1000_0_S5_S3 -6.4 6.35
 /begin AXIS_DESCR STD_AXIS zff_atsys._.iSignale._.obj.sig_n_t UMR_U_MIN_1_1_0_S5_S3 4 0 8160 DEPOSIT ABSOLUTE /end AXIS_DESCR
 /begin AXIS_DESCR STD_AXIS zff_atsys._.iSignale._.obj.sig_m_t UMR_NM__1_1_0_S5_S3 6 -200 1300 DEPOSIT ABSOLUTE /end AXIS_DESCR
/end CHARACTERISTIC
/begin CHARACTERISTIC KF_POFMTN65 "Kennfeld Fuelldruckoffset(n_t, m_t)" MAP 0x1C7430 ZF_kf_si16_S5_S3 12.75 UMR_BAR__1_1000_0_S5_S3 -6.4 6.35
 /begin AXIS_DESCR STD_AXIS zff_atsys._.iSignale._.obj.sig_n_t UMR_U_MIN_1_1_0_S5_S3 4 0 8160 DEPOSIT ABSOLUTE /end AXIS_DESCR
 /begin AXIS_DESCR STD_AXIS zff_atsys._.iSignale._.obj.sig_m_t UMR_NM__1_1_0_S5_S3 6 -200 1300 DEPOSIT ABSOLUTE /end AXIS_DESCR
/end CHARACTERISTIC
/begin CHARACTERISTIC KF_POFMTN65_EL "Kennfeld Fuelldruckoffset(n_t, m_t)" MAP 0x1C747C ZF_kf_si16_S5_S3 12.75 UMR_BAR__1_1000_0_S5_S3 -6.4 6.35
 /begin AXIS_DESCR STD_AXIS zff_atsys._.iSignale._.obj.sig_n_t UMR_U_MIN_1_1_0_S5_S3 4 0 8160 DEPOSIT ABSOLUTE /end AXIS_DESCR
 /begin AXIS_DESCR STD_AXIS zff_atsys._.iSignale._.obj.sig_m_t UMR_NM__1_1_0_S5_S3 6 -200 1300 DEPOSIT ABSOLUTE /end AXIS_DESCR
/end CHARACTERISTIC
/begin CHARACTERISTIC KF_POFMTN76 "Kennfeld Fuelldruckoffset(n_t, m_t)" MAP 0x1C76DC ZF_kf_si16_S5_S3 12.75 UMR_BAR__1_1000_0_S5_S3 -6.4 6.35
 /begin AXIS_DESCR STD_AXIS zff_atsys._.iSignale._.obj.sig_n_t UMR_U_MIN_1_1_0_S5_S3 4 0 8160 DEPOSIT ABSOLUTE /end AXIS_DESCR
 /begin AXIS_DESCR STD_AXIS zff_atsys._.iSignale._.obj.sig_m_t UMR_NM__1_1_0_S5_S3 6 -200 1300 DEPOSIT ABSOLUTE /end AXIS_DESCR
/end CHARACTERISTIC
/begin CHARACTERISTIC KF_POFMTN76_EL "Kennfeld Fuelldruckoffset(n_t, m_t)" MAP 0x1C7728 ZF_kf_si16_S5_S3 12.75 UMR_BAR__1_1000_0_S5_S3 -6.4 6.35
 /begin AXIS_DESCR STD_AXIS zff_atsys._.iSignale._.obj.sig_n_t UMR_U_MIN_1_1_0_S5_S3 4 0 8160 DEPOSIT ABSOLUTE /end AXIS_DESCR
 /begin AXIS_DESCR STD_AXIS zff_atsys._.iSignale._.obj.sig_m_t UMR_NM__1_1_0_S5_S3 6 -200 1300 DEPOSIT ABSOLUTE /end AXIS_DESCR
/end CHARACTERISTIC
/begin CHARACTERISTIC KF_POFMTN87 "Kennfeld Fuelldruckoffset(n_t, m_t)" MAP 0x1C7988 ZF_kf_si16_S5_S3 12.75 UMR_BAR__1_1000_0_S5_S3 -6.4 6.35
 /begin AXIS_DESCR STD_AXIS zff_atsys._.iSignale._.obj.sig_n_t UMR_U_MIN_1_1_0_S5_S3 4 0 8160 DEPOSIT ABSOLUTE /end AXIS_DESCR
 /begin AXIS_DESCR STD_AXIS zff_atsys._.iSignale._.obj.sig_m_t UMR_NM__1_1_0_S5_S3 6 -200 1300 DEPOSIT ABSOLUTE /end AXIS_DESCR
/end CHARACTERISTIC
/begin CHARACTERISTIC KF_POFMTN87_EL "Kennfeld Fuelldruckoffset(n_t, m_t)" MAP 0x1C79D4 ZF_kf_si16_S5_S3 12.75 UMR_BAR__1_1000_0_S5_S3 -6.4 6.35
 /begin AXIS_DESCR STD_AXIS zff_atsys._.iSignale._.obj.sig_n_t UMR_U_MIN_1_1_0_S5_S3 4 0 8160 DEPOSIT ABSOLUTE /end AXIS_DESCR
 /begin AXIS_DESCR STD_AXIS zff_atsys._.iSignale._.obj.sig_m_t UMR_NM__1_1_0_S5_S3 6 -200 1300 DEPOSIT ABSOLUTE /end AXIS_DESCR
/end CHARACTERISTIC
/begin CHARACTERISTIC KF_POFMTNFUELLRED21 "Kennfeld Fuelldruckoffset(n_t, m_t)" MAP 0x1CB9E8 ZF_kf_si16_S5_S3 12.75 UMR_BAR__1_1000_0_S5_S3 -6.4 6.35
 /begin AXIS_DESCR STD_AXIS zff_atsys._.iSignale._.obj.sig_n_t UMR_U_MIN_1_1_0_S5_S3 4 0 8160 DEPOSIT ABSOLUTE /end AXIS_DESCR
 /begin AXIS_DESCR STD_AXIS zff_atsys._.iSignale._.obj.sig_m_t UMR_NM__1_1_0_S5_S3 6 -200 1300 DEPOSIT ABSOLUTE /end AXIS_DESCR
/end CHARACTERISTIC
/begin CHARACTERISTIC KF_POFMTNFUELLRED32 "Kennfeld Fuelldruckoffset(n_t, m_t)" MAP 0x1CBC34 ZF_kf_si16_S5_S3 12.75 UMR_BAR__1_1000_0_S5_S3 -6.4 6.35
 /begin AXIS_DESCR STD_AXIS zff_atsys._.iSignale._.obj.sig_n_t UMR_U_MIN_1_1_0_S5_S3 4 0 8160 DEPOSIT ABSOLUTE /end AXIS_DESCR
 /begin AXIS_DESCR STD_AXIS zff_atsys._.iSignale._.obj.sig_m_t UMR_NM__1_1_0_S5_S3 6 -200 1300 DEPOSIT ABSOLUTE /end AXIS_DESCR
/end CHARACTERISTIC
/begin CHARACTERISTIC KF_POFMTNFUELLRED43 "Kennfeld Fuelldruckoffset(n_t, m_t)" MAP 0x1CBE80 ZF_kf_si16_S5_S3 12.75 UMR_BAR__1_1000_0_S5_S3 -6.4 6.35
 /begin AXIS_DESCR STD_AXIS zff_atsys._.iSignale._.obj.sig_n_t UMR_U_MIN_1_1_0_S5_S3 4 0 8160 DEPOSIT ABSOLUTE /end AXIS_DESCR
 /begin AXIS_DESCR STD_AXIS zff_atsys._.iSignale._.obj.sig_m_t UMR_NM__1_1_0_S5_S3 6 -200 1300 DEPOSIT ABSOLUTE /end AXIS_DESCR
/end CHARACTERISTIC
/begin CHARACTERISTIC KF_POFMTNFUELLRED54 "Kennfeld Fuelldruckoffset(n_t, m_t)" MAP 0x1CC0CC ZF_kf_si16_S5_S3 12.75 UMR_BAR__1_1000_0_S5_S3 -6.4 6.35
 /begin AXIS_DESCR STD_AXIS zff_atsys._.iSignale._.obj.sig_n_t UMR_U_MIN_1_1_0_S5_S3 4 0 8160 DEPOSIT ABSOLUTE /end AXIS_DESCR
 /begin AXIS_DESCR STD_AXIS zff_atsys._.iSignale._.obj.sig_m_t UMR_NM__1_1_0_S5_S3 6 -200 1300 DEPOSIT ABSOLUTE /end AXIS_DESCR
/end CHARACTERISTIC
/begin CHARACTERISTIC KF_POFMTNFUELLREDSP31 "Kennfeld Fuelldruckoffset(n_t, m_t)" MAP 0x1CC9FC ZF_kf_si16_S5_S3 12.75 UMR_BAR__1_1000_0_S5_S3 -6.4 6.35
 /begin AXIS_DESCR STD_AXIS zff_atsys._.iSignale._.obj.sig_n_t UMR_U_MIN_1_1_0_S5_S3 4 0 8160 DEPOSIT ABSOLUTE /end AXIS_DESCR
 /begin AXIS_DESCR STD_AXIS zff_atsys._.iSignale._.obj.sig_m_t UMR_NM__1_1_0_S5_S3 6 -200 1300 DEPOSIT ABSOLUTE /end AXIS_DESCR
/end CHARACTERISTIC
/begin CHARACTERISTIC KF_POFMTNFUELLREDSP42 "Kennfeld Fuelldruckoffset(n_t, m_t)" MAP 0x1CCC48 ZF_kf_si16_S5_S3 12.75 UMR_BAR__1_1000_0_S5_S3 -6.4 6.35
 /begin AXIS_DESCR STD_AXIS zff_atsys._.iSignale._.obj.sig_n_t UMR_U_MIN_1_1_0_S5_S3 4 0 8160 DEPOSIT ABSOLUTE /end AXIS_DESCR
 /begin AXIS_DESCR STD_AXIS zff_atsys._.iSignale._.obj.sig_m_t UMR_NM__1_1_0_S5_S3 6 -200 1300 DEPOSIT ABSOLUTE /end AXIS_DESCR
/end CHARACTERISTIC
/begin CHARACTERISTIC KF_POFMTNFUELLREDSP51 "Kennfeld Fuelldruckoffset(n_t, m_t)" MAP 0x1CCE94 ZF_kf_si16_S5_S3 12.75 UMR_BAR__1_1000_0_S5_S3 -6.4 6.35
 /begin AXIS_DESCR STD_AXIS zff_atsys._.iSignale._.obj.sig_n_t UMR_U_MIN_1_1_0_S5_S3 4 0 8160 DEPOSIT ABSOLUTE /end AXIS_DESCR
 /begin AXIS_DESCR STD_AXIS zff_atsys._.iSignale._.obj.sig_m_t UMR_NM__1_1_0_S5_S3 6 -200 1300 DEPOSIT ABSOLUTE /end AXIS_DESCR
/end CHARACTERISTIC
/begin CHARACTERISTIC KF_POFMTNFUELLREDSP53 "Kennfeld Fuelldruckoffset(n_t, m_t)" MAP 0x1CD0E0 ZF_kf_si16_S5_S3 12.75 UMR_BAR__1_1000_0_S5_S3 -6.4 6.35
 /begin AXIS_DESCR STD_AXIS zff_atsys._.iSignale._.obj.sig_n_t UMR_U_MIN_1_1_0_S5_S3 4 0 8160 DEPOSIT ABSOLUTE /end AXIS_DESCR
 /begin AXIS_DESCR STD_AXIS zff_atsys._.iSignale._.obj.sig_m_t UMR_NM__1_1_0_S5_S3 6 -200 1300 DEPOSIT ABSOLUTE /end AXIS_DESCR
/end CHARACTERISTIC
/begin CHARACTERISTIC KF_POFMTNFUELLREDSP63 "Kennfeld Fuelldruckoffset(n_t, m_t)" MAP 0x1CD32C ZF_kf_si16_S5_S3 12.75 UMR_BAR__1_1000_0_S5_S3 -6.4 6.35
 /begin AXIS_DESCR STD_AXIS zff_atsys._.iSignale._.obj.sig_n_t UMR_U_MIN_1_1_0_S5_S3 4 0 8160 DEPOSIT ABSOLUTE /end AXIS_DESCR
 /begin AXIS_DESCR STD_AXIS zff_atsys._.iSignale._.obj.sig_m_t UMR_NM__1_1_0_S5_S3 6 -200 1300 DEPOSIT ABSOLUTE /end AXIS_DESCR
/end CHARACTERISTIC
/begin CHARACTERISTIC KF_POFMTNSP21 "Kennfeld Fuelldruckoffset(n_t, m_t)" MAP 0x1C7C28 ZF_kf_si16_S5_S3 12.75 UMR_BAR__1_1000_0_S5_S3 -6.4 6.35
 /begin AXIS_DESCR STD_AXIS zff_atsys._.iSignale._.obj.sig_n_t UMR_U_MIN_1_1_0_S5_S3 4 0 8160 DEPOSIT ABSOLUTE /end AXIS_DESCR
 /begin AXIS_DESCR STD_AXIS zff_atsys._.iSignale._.obj.sig_m_t UMR_NM__1_1_0_S5_S3 6 -200 1300 DEPOSIT ABSOLUTE /end AXIS_DESCR
/end CHARACTERISTIC
/begin CHARACTERISTIC KF_POFMTNSP31 "Kennfeld Fuelldruckoffset(n_t, m_t)" MAP 0x1C87DC ZF_kf_si16_S5_S3 12.75 UMR_BAR__1_1000_0_S5_S3 -6.4 6.35
 /begin AXIS_DESCR STD_AXIS zff_atsys._.iSignale._.obj.sig_n_t UMR_U_MIN_1_1_0_S5_S3 4 0 8160 DEPOSIT ABSOLUTE /end AXIS_DESCR
 /begin AXIS_DESCR STD_AXIS zff_atsys._.iSignale._.obj.sig_m_t UMR_NM__1_1_0_S5_S3 6 -200 1300 DEPOSIT ABSOLUTE /end AXIS_DESCR
/end CHARACTERISTIC
/begin CHARACTERISTIC KF_POFMTNSP32 "Kennfeld Fuelldruckoffset(n_t, m_t)" MAP 0x1C7DD4 ZF_kf_si16_S5_S3 12.75 UMR_BAR__1_1000_0_S5_S3 -6.4 6.35
 /begin AXIS_DESCR STD_AXIS zff_atsys._.iSignale._.obj.sig_n_t UMR_U_MIN_1_1_0_S5_S3 4 0 8160 DEPOSIT ABSOLUTE /end AXIS_DESCR
 /begin AXIS_DESCR STD_AXIS zff_atsys._.iSignale._.obj.sig_m_t UMR_NM__1_1_0_S5_S3 6 -200 1300 DEPOSIT ABSOLUTE /end AXIS_DESCR
/end CHARACTERISTIC
/begin CHARACTERISTIC KF_POFMTNSP42 "Kennfeld Fuelldruckoffset(n_t, m_t)" MAP 0x1C8988 ZF_kf_si16_S5_S3 12.75 UMR_BAR__1_1000_0_S5_S3 -6.4 6.35
 /begin AXIS_DESCR STD_AXIS zff_atsys._.iSignale._.obj.sig_n_t UMR_U_MIN_1_1_0_S5_S3 4 0 8160 DEPOSIT ABSOLUTE /end AXIS_DESCR
 /begin AXIS_DESCR STD_AXIS zff_atsys._.iSignale._.obj.sig_m_t UMR_NM__1_1_0_S5_S3 6 -200 1300 DEPOSIT ABSOLUTE /end AXIS_DESCR
/end CHARACTERISTIC
/begin CHARACTERISTIC KF_POFMTNSP43 "Kennfeld Fuelldruckoffset(n_t, m_t)" MAP 0x1C7F80 ZF_kf_si16_S5_S3 12.75 UMR_BAR__1_1000_0_S5_S3 -6.4 6.35
 /begin AXIS_DESCR STD_AXIS zff_atsys._.iSignale._.obj.sig_n_t UMR_U_MIN_1_1_0_S5_S3 4 0 8160 DEPOSIT ABSOLUTE /end AXIS_DESCR
 /begin AXIS_DESCR STD_AXIS zff_atsys._.iSignale._.obj.sig_m_t UMR_NM__1_1_0_S5_S3 6 -200 1300 DEPOSIT ABSOLUTE /end AXIS_DESCR
/end CHARACTERISTIC
/begin CHARACTERISTIC KF_POFMTNSP51 "Kennfeld Fuelldruckoffset(n_t, m_t)" MAP 0x1C8B34 ZF_kf_si16_S5_S3 12.75 UMR_BAR__1_1000_0_S5_S3 -6.4 6.35
 /begin AXIS_DESCR STD_AXIS zff_atsys._.iSignale._.obj.sig_n_t UMR_U_MIN_1_1_0_S5_S3 4 0 8160 DEPOSIT ABSOLUTE /end AXIS_DESCR
 /begin AXIS_DESCR STD_AXIS zff_atsys._.iSignale._.obj.sig_m_t UMR_NM__1_1_0_S5_S3 6 -200 1300 DEPOSIT ABSOLUTE /end AXIS_DESCR
/end CHARACTERISTIC
/begin CHARACTERISTIC KF_POFMTNSP53 "Kennfeld Fuelldruckoffset(n_t, m_t)" MAP 0x1C8CE0 ZF_kf_si16_S5_S3 12.75 UMR_BAR__1_1000_0_S5_S3 -6.4 6.35
 /begin AXIS_DESCR STD_AXIS zff_atsys._.iSignale._.obj.sig_n_t UMR_U_MIN_1_1_0_S5_S3 4 0 8160 DEPOSIT ABSOLUTE /end AXIS_DESCR
 /begin AXIS_DESCR STD_AXIS zff_atsys._.iSignale._.obj.sig_m_t UMR_NM__1_1_0_S5_S3 6 -200 1300 DEPOSIT ABSOLUTE /end AXIS_DESCR
/end CHARACTERISTIC
/begin CHARACTERISTIC KF_POFMTNSP54 "Kennfeld Fuelldruckoffset(n_t, m_t)" MAP 0x1C812C ZF_kf_si16_S5_S3 12.75 UMR_BAR__1_1000_0_S5_S3 -6.4 6.35
 /begin AXIS_DESCR STD_AXIS zff_atsys._.iSignale._.obj.sig_n_t UMR_U_MIN_1_1_0_S5_S3 4 0 8160 DEPOSIT ABSOLUTE /end AXIS_DESCR
 /begin AXIS_DESCR STD_AXIS zff_atsys._.iSignale._.obj.sig_m_t UMR_NM__1_1_0_S5_S3 6 -200 1300 DEPOSIT ABSOLUTE /end AXIS_DESCR
/end CHARACTERISTIC
/begin CHARACTERISTIC KF_POFMTNSP63 "Kennfeld Fuelldruckoffset(n_t, m_t)" MAP 0x1C8E8C ZF_kf_si16_S5_S3 12.75 UMR_BAR__1_1000_0_S5_S3 -6.4 6.35
 /begin AXIS_DESCR STD_AXIS zff_atsys._.iSignale._.obj.sig_n_t UMR_U_MIN_1_1_0_S5_S3 4 0 8160 DEPOSIT ABSOLUTE /end AXIS_DESCR
 /begin AXIS_DESCR STD_AXIS zff_atsys._.iSignale._.obj.sig_m_t UMR_NM__1_1_0_S5_S3 6 -200 1300 DEPOSIT ABSOLUTE /end AXIS_DESCR
/end CHARACTERISTIC
/begin CHARACTERISTIC KF_POFMTNSP64 "Kennfeld Fuelldruckoffset(n_t, m_t)" MAP 0x1C9038 ZF_kf_si16_S5_S3 12.75 UMR_BAR__1_1000_0_S5_S3 -6.4 6.35
 /begin AXIS_DESCR STD_AXIS zff_atsys._.iSignale._.obj.sig_n_t UMR_U_MIN_1_1_0_S5_S3 4 0 8160 DEPOSIT ABSOLUTE /end AXIS_DESCR
 /begin AXIS_DESCR STD_AXIS zff_atsys._.iSignale._.obj.sig_m_t UMR_NM__1_1_0_S5_S3 6 -200 1300 DEPOSIT ABSOLUTE /end AXIS_DESCR
/end CHARACTERISTIC
/begin CHARACTERISTIC KF_POFMTNSP65 "Kennfeld Fuelldruckoffset(n_t, m_t)" MAP 0x1C82D8 ZF_kf_si16_S5_S3 12.75 UMR_BAR__1_1000_0_S5_S3 -6.4 6.35
 /begin AXIS_DESCR STD_AXIS zff_atsys._.iSignale._.obj.sig_n_t UMR_U_MIN_1_1_0_S5_S3 4 0 8160 DEPOSIT ABSOLUTE /end AXIS_DESCR
 /begin AXIS_DESCR STD_AXIS zff_atsys._.iSignale._.obj.sig_m_t UMR_NM__1_1_0_S5_S3 6 -200 1300 DEPOSIT ABSOLUTE /end AXIS_DESCR
/end CHARACTERISTIC
/begin CHARACTERISTIC KF_POFMTNSP71 "Kennfeld Fuelldruckoffset(n_t, m_t)" MAP 0x1C91E4 ZF_kf_si16_S5_S3 12.75 UMR_BAR__1_1000_0_S5_S3 -6.4 6.35
 /begin AXIS_DESCR STD_AXIS zff_atsys._.iSignale._.obj.sig_n_t UMR_U_MIN_1_1_0_S5_S3 4 0 8160 DEPOSIT ABSOLUTE /end AXIS_DESCR
 /begin AXIS_DESCR STD_AXIS zff_atsys._.iSignale._.obj.sig_m_t UMR_NM__1_1_0_S5_S3 6 -200 1300 DEPOSIT ABSOLUTE /end AXIS_DESCR
/end CHARACTERISTIC
/begin CHARACTERISTIC KF_POFMTNSP75 "Kennfeld Fuelldruckoffset(n_t, m_t)" MAP 0x1C9390 ZF_kf_si16_S5_S3 12.75 UMR_BAR__1_1000_0_S5_S3 -6.4 6.35
 /begin AXIS_DESCR STD_AXIS zff_atsys._.iSignale._.obj.sig_n_t UMR_U_MIN_1_1_0_S5_S3 4 0 8160 DEPOSIT ABSOLUTE /end AXIS_DESCR
 /begin AXIS_DESCR STD_AXIS zff_atsys._.iSignale._.obj.sig_m_t UMR_NM__1_1_0_S5_S3 6 -200 1300 DEPOSIT ABSOLUTE /end AXIS_DESCR
/end CHARACTERISTIC
/begin CHARACTERISTIC KF_POFMTNSP76 "Kennfeld Fuelldruckoffset(n_t, m_t)" MAP 0x1C8484 ZF_kf_si16_S5_S3 12.75 UMR_BAR__1_1000_0_S5_S3 -6.4 6.35
 /begin AXIS_DESCR STD_AXIS zff_atsys._.iSignale._.obj.sig_n_t UMR_U_MIN_1_1_0_S5_S3 4 0 8160 DEPOSIT ABSOLUTE /end AXIS_DESCR
 /begin AXIS_DESCR STD_AXIS zff_atsys._.iSignale._.obj.sig_m_t UMR_NM__1_1_0_S5_S3 6 -200 1300 DEPOSIT ABSOLUTE /end AXIS_DESCR
/end CHARACTERISTIC
/begin CHARACTERISTIC KF_POFMTNSP82 "Kennfeld Fuelldruckoffset(n_t, m_t)" MAP 0x1C953C ZF_kf_si16_S5_S3 12.75 UMR_BAR__1_1000_0_S5_S3 -6.4 6.35
 /begin AXIS_DESCR STD_AXIS zff_atsys._.iSignale._.obj.sig_n_t UMR_U_MIN_1_1_0_S5_S3 4 0 8160 DEPOSIT ABSOLUTE /end AXIS_DESCR
 /begin AXIS_DESCR STD_AXIS zff_atsys._.iSignale._.obj.sig_m_t UMR_NM__1_1_0_S5_S3 6 -200 1300 DEPOSIT ABSOLUTE /end AXIS_DESCR
/end CHARACTERISTIC
/begin CHARACTERISTIC KF_POFMTNSP84 "Kennfeld Fuelldruckoffset(n_t, m_t)" MAP 0x1C96E8 ZF_kf_si16_S5_S3 12.75 UMR_BAR__1_1000_0_S5_S3 -6.4 6.35
 /begin AXIS_DESCR STD_AXIS zff_atsys._.iSignale._.obj.sig_n_t UMR_U_MIN_1_1_0_S5_S3 4 0 8160 DEPOSIT ABSOLUTE /end AXIS_DESCR
 /begin AXIS_DESCR STD_AXIS zff_atsys._.iSignale._.obj.sig_m_t UMR_NM__1_1_0_S5_S3 6 -200 1300 DEPOSIT ABSOLUTE /end AXIS_DESCR
/end CHARACTERISTIC
/begin CHARACTERISTIC KF_POFMTNSP86 "Kennfeld Fuelldruckoffset(n_t, m_t)" MAP 0x1C9894 ZF_kf_si16_S5_S3 12.75 UMR_BAR__1_1000_0_S5_S3 -6.4 6.35
 /begin AXIS_DESCR STD_AXIS zff_atsys._.iSignale._.obj.sig_n_t UMR_U_MIN_1_1_0_S5_S3 4 0 8160 DEPOSIT ABSOLUTE /end AXIS_DESCR
 /begin AXIS_DESCR STD_AXIS zff_atsys._.iSignale._.obj.sig_m_t UMR_NM__1_1_0_S5_S3 6 -200 1300 DEPOSIT ABSOLUTE /end AXIS_DESCR
/end CHARACTERISTIC
/begin CHARACTERISTIC KF_POFMTNSP87 "Kennfeld Fuelldruckoffset(n_t, m_t)" MAP 0x1C8630 ZF_kf_si16_S5_S3 12.75 UMR_BAR__1_1000_0_S5_S3 -6.4 6.35
 /begin AXIS_DESCR STD_AXIS zff_atsys._.iSignale._.obj.sig_n_t UMR_U_MIN_1_1_0_S5_S3 4 0 8160 DEPOSIT ABSOLUTE /end AXIS_DESCR
 /begin AXIS_DESCR STD_AXIS zff_atsys._.iSignale._.obj.sig_m_t UMR_NM__1_1_0_S5_S3 6 -200 1300 DEPOSIT ABSOLUTE /end AXIS_DESCR
/end CHARACTERISTIC
/begin CHARACTERISTIC KF_POFMTNSPORT21 "Kennfeld Fuelldruckoffset(n_t, m_t)" MAP 0x1C9A40 ZF_kf_si16_S5_S3 12.75 UMR_BAR__1_1000_0_S5_S3 -6.4 6.35
 /begin AXIS_DESCR STD_AXIS zff_atsys._.iSignale._.obj.sig_n_t UMR_U_MIN_1_1_0_S5_S3 4 0 8160 DEPOSIT ABSOLUTE /end AXIS_DESCR
 /begin AXIS_DESCR STD_AXIS zff_atsys._.iSignale._.obj.sig_m_t UMR_NM__1_1_0_S5_S3 6 -200 1300 DEPOSIT ABSOLUTE /end AXIS_DESCR
/end CHARACTERISTIC
/begin CHARACTERISTIC KF_POFMTNSPORT31 "Kennfeld Fuelldruckoffset(n_t, m_t)" MAP 0x1CA5F4 ZF_kf_si16_S5_S3 12.75 UMR_BAR__1_1000_0_S5_S3 -6.4 6.35
 /begin AXIS_DESCR STD_AXIS zff_atsys._.iSignale._.obj.sig_n_t UMR_U_MIN_1_1_0_S5_S3 4 0 8160 DEPOSIT ABSOLUTE /end AXIS_DESCR
 /begin AXIS_DESCR STD_AXIS zff_atsys._.iSignale._.obj.sig_m_t UMR_NM__1_1_0_S5_S3 6 -200 1300 DEPOSIT ABSOLUTE /end AXIS_DESCR
/end CHARACTERISTIC
/begin CHARACTERISTIC KF_POFMTNSPORT32 "Kennfeld Fuelldruckoffset(n_t, m_t)" MAP 0x1C9BEC ZF_kf_si16_S5_S3 12.75 UMR_BAR__1_1000_0_S5_S3 -6.4 6.35
 /begin AXIS_DESCR STD_AXIS zff_atsys._.iSignale._.obj.sig_n_t UMR_U_MIN_1_1_0_S5_S3 4 0 8160 DEPOSIT ABSOLUTE /end AXIS_DESCR
 /begin AXIS_DESCR STD_AXIS zff_atsys._.iSignale._.obj.sig_m_t UMR_NM__1_1_0_S5_S3 6 -200 1300 DEPOSIT ABSOLUTE /end AXIS_DESCR
/end CHARACTERISTIC
/begin CHARACTERISTIC KF_POFMTNSPORT42 "Kennfeld Fuelldruckoffset(n_t, m_t)" MAP 0x1CA7A0 ZF_kf_si16_S5_S3 12.75 UMR_BAR__1_1000_0_S5_S3 -6.4 6.35
 /begin AXIS_DESCR STD_AXIS zff_atsys._.iSignale._.obj.sig_n_t UMR_U_MIN_1_1_0_S5_S3 4 0 8160 DEPOSIT ABSOLUTE /end AXIS_DESCR
 /begin AXIS_DESCR STD_AXIS zff_atsys._.iSignale._.obj.sig_m_t UMR_NM__1_1_0_S5_S3 6 -200 1300 DEPOSIT ABSOLUTE /end AXIS_DESCR
/end CHARACTERISTIC
/begin CHARACTERISTIC KF_POFMTNSPORT43 "Kennfeld Fuelldruckoffset(n_t, m_t)" MAP 0x1C9D98 ZF_kf_si16_S5_S3 12.75 UMR_BAR__1_1000_0_S5_S3 -6.4 6.35
 /begin AXIS_DESCR STD_AXIS zff_atsys._.iSignale._.obj.sig_n_t UMR_U_MIN_1_1_0_S5_S3 4 0 8160 DEPOSIT ABSOLUTE /end AXIS_DESCR
 /begin AXIS_DESCR STD_AXIS zff_atsys._.iSignale._.obj.sig_m_t UMR_NM__1_1_0_S5_S3 6 -200 1300 DEPOSIT ABSOLUTE /end AXIS_DESCR
/end CHARACTERISTIC
/begin CHARACTERISTIC KF_POFMTNSPORT51 "Kennfeld Fuelldruckoffset(n_t, m_t)" MAP 0x1CA94C ZF_kf_si16_S5_S3 12.75 UMR_BAR__1_1000_0_S5_S3 -6.4 6.35
 /begin AXIS_DESCR STD_AXIS zff_atsys._.iSignale._.obj.sig_n_t UMR_U_MIN_1_1_0_S5_S3 4 0 8160 DEPOSIT ABSOLUTE /end AXIS_DESCR
 /begin AXIS_DESCR STD_AXIS zff_atsys._.iSignale._.obj.sig_m_t UMR_NM__1_1_0_S5_S3 6 -200 1300 DEPOSIT ABSOLUTE /end AXIS_DESCR
/end CHARACTERISTIC
/begin CHARACTERISTIC KF_POFMTNSPORT53 "Kennfeld Fuelldruckoffset(n_t, m_t)" MAP 0x1CAAF8 ZF_kf_si16_S5_S3 12.75 UMR_BAR__1_1000_0_S5_S3 -6.4 6.35
 /begin AXIS_DESCR STD_AXIS zff_atsys._.iSignale._.obj.sig_n_t UMR_U_MIN_1_1_0_S5_S3 4 0 8160 DEPOSIT ABSOLUTE /end AXIS_DESCR
 /begin AXIS_DESCR STD_AXIS zff_atsys._.iSignale._.obj.sig_m_t UMR_NM__1_1_0_S5_S3 6 -200 1300 DEPOSIT ABSOLUTE /end AXIS_DESCR
/end CHARACTERISTIC
/begin CHARACTERISTIC KF_POFMTNSPORT54 "Kennfeld Fuelldruckoffset(n_t, m_t)" MAP 0x1C9F44 ZF_kf_si16_S5_S3 12.75 UMR_BAR__1_1000_0_S5_S3 -6.4 6.35
 /begin AXIS_DESCR STD_AXIS zff_atsys._.iSignale._.obj.sig_n_t UMR_U_MIN_1_1_0_S5_S3 4 0 8160 DEPOSIT ABSOLUTE /end AXIS_DESCR
 /begin AXIS_DESCR STD_AXIS zff_atsys._.iSignale._.obj.sig_m_t UMR_NM__1_1_0_S5_S3 6 -200 1300 DEPOSIT ABSOLUTE /end AXIS_DESCR
/end CHARACTERISTIC
/begin CHARACTERISTIC KF_POFMTNSPORT63 "Kennfeld Fuelldruckoffset(n_t, m_t)" MAP 0x1CACA4 ZF_kf_si16_S5_S3 12.75 UMR_BAR__1_1000_0_S5_S3 -6.4 6.35
 /begin AXIS_DESCR STD_AXIS zff_atsys._.iSignale._.obj.sig_n_t UMR_U_MIN_1_1_0_S5_S3 4 0 8160 DEPOSIT ABSOLUTE /end AXIS_DESCR
 /begin AXIS_DESCR STD_AXIS zff_atsys._.iSignale._.obj.sig_m_t UMR_NM__1_1_0_S5_S3 6 -200 1300 DEPOSIT ABSOLUTE /end AXIS_DESCR
/end CHARACTERISTIC
/begin CHARACTERISTIC KF_POFMTNSPORT64 "Kennfeld Fuelldruckoffset(n_t, m_t)" MAP 0x1CAE50 ZF_kf_si16_S5_S3 12.75 UMR_BAR__1_1000_0_S5_S3 -6.4 6.35
 /begin AXIS_DESCR STD_AXIS zff_atsys._.iSignale._.obj.sig_n_t UMR_U_MIN_1_1_0_S5_S3 4 0 8160 DEPOSIT ABSOLUTE /end AXIS_DESCR
 /begin AXIS_DESCR STD_AXIS zff_atsys._.iSignale._.obj.sig_m_t UMR_NM__1_1_0_S5_S3 6 -200 1300 DEPOSIT ABSOLUTE /end AXIS_DESCR
/end CHARACTERISTIC
/begin CHARACTERISTIC KF_POFMTNSPORT65 "Kennfeld Fuelldruckoffset(n_t, m_t)" MAP 0x1CA0F0 ZF_kf_si16_S5_S3 12.75 UMR_BAR__1_1000_0_S5_S3 -6.4 6.35
 /begin AXIS_DESCR STD_AXIS zff_atsys._.iSignale._.obj.sig_n_t UMR_U_MIN_1_1_0_S5_S3 4 0 8160 DEPOSIT ABSOLUTE /end AXIS_DESCR
 /begin AXIS_DESCR STD_AXIS zff_atsys._.iSignale._.obj.sig_m_t UMR_NM__1_1_0_S5_S3 6 -200 1300 DEPOSIT ABSOLUTE /end AXIS_DESCR
/end CHARACTERISTIC
/begin CHARACTERISTIC KF_POFMTNSPORT71 "Kennfeld Fuelldruckoffset(n_t, m_t)" MAP 0x1CAFFC ZF_kf_si16_S5_S3 12.75 UMR_BAR__1_1000_0_S5_S3 -6.4 6.35
 /begin AXIS_DESCR STD_AXIS zff_atsys._.iSignale._.obj.sig_n_t UMR_U_MIN_1_1_0_S5_S3 4 0 8160 DEPOSIT ABSOLUTE /end AXIS_DESCR
 /begin AXIS_DESCR STD_AXIS zff_atsys._.iSignale._.obj.sig_m_t UMR_NM__1_1_0_S5_S3 6 -200 1300 DEPOSIT ABSOLUTE /end AXIS_DESCR
/end CHARACTERISTIC
/begin CHARACTERISTIC KF_POFMTNSPORT75 "Kennfeld Fuelldruckoffset(n_t, m_t)" MAP 0x1CB1A8 ZF_kf_si16_S5_S3 12.75 UMR_BAR__1_1000_0_S5_S3 -6.4 6.35
 /begin AXIS_DESCR STD_AXIS zff_atsys._.iSignale._.obj.sig_n_t UMR_U_MIN_1_1_0_S5_S3 4 0 8160 DEPOSIT ABSOLUTE /end AXIS_DESCR
 /begin AXIS_DESCR STD_AXIS zff_atsys._.iSignale._.obj.sig_m_t UMR_NM__1_1_0_S5_S3 6 -200 1300 DEPOSIT ABSOLUTE /end AXIS_DESCR
/end CHARACTERISTIC
/begin CHARACTERISTIC KF_POFMTNSPORT76 "Kennfeld Fuelldruckoffset(n_t, m_t)" MAP 0x1CA29C ZF_kf_si16_S5_S3 12.75 UMR_BAR__1_1000_0_S5_S3 -6.4 6.35
 /begin AXIS_DESCR STD_AXIS zff_atsys._.iSignale._.obj.sig_n_t UMR_U_MIN_1_1_0_S5_S3 4 0 8160 DEPOSIT ABSOLUTE /end AXIS_DESCR
 /begin AXIS_DESCR STD_AXIS zff_atsys._.iSignale._.obj.sig_m_t UMR_NM__1_1_0_S5_S3 6 -200 1300 DEPOSIT ABSOLUTE /end AXIS_DESCR
/end CHARACTERISTIC
/begin CHARACTERISTIC KF_POFMTNSPORT82 "Kennfeld Fuelldruckoffset(n_t, m_t)" MAP 0x1CB354 ZF_kf_si16_S5_S3 12.75 UMR_BAR__1_1000_0_S5_S3 -6.4 6.35
 /begin AXIS_DESCR STD_AXIS zff_atsys._.iSignale._.obj.sig_n_t UMR_U_MIN_1_1_0_S5_S3 4 0 8160 DEPOSIT ABSOLUTE /end AXIS_DESCR
 /begin AXIS_DESCR STD_AXIS zff_atsys._.iSignale._.obj.sig_m_t UMR_NM__1_1_0_S5_S3 6 -200 1300 DEPOSIT ABSOLUTE /end AXIS_DESCR
/end CHARACTERISTIC
/begin CHARACTERISTIC KF_POFMTNSPORT84 "Kennfeld Fuelldruckoffset(n_t, m_t)" MAP 0x1CB500 ZF_kf_si16_S5_S3 12.75 UMR_BAR__1_1000_0_S5_S3 -6.4 6.35
 /begin AXIS_DESCR STD_AXIS zff_atsys._.iSignale._.obj.sig_n_t UMR_U_MIN_1_1_0_S5_S3 4 0 8160 DEPOSIT ABSOLUTE /end AXIS_DESCR
 /begin AXIS_DESCR STD_AXIS zff_atsys._.iSignale._.obj.sig_m_t UMR_NM__1_1_0_S5_S3 6 -200 1300 DEPOSIT ABSOLUTE /end AXIS_DESCR
/end CHARACTERISTIC
/begin CHARACTERISTIC KF_POFMTNSPORT86 "Kennfeld Fuelldruckoffset(n_t, m_t)" MAP 0x1CB6AC ZF_kf_si16_S5_S3 12.75 UMR_BAR__1_1000_0_S5_S3 -6.4 6.35
 /begin AXIS_DESCR STD_AXIS zff_atsys._.iSignale._.obj.sig_n_t UMR_U_MIN_1_1_0_S5_S3 4 0 8160 DEPOSIT ABSOLUTE /end AXIS_DESCR
 /begin AXIS_DESCR STD_AXIS zff_atsys._.iSignale._.obj.sig_m_t UMR_NM__1_1_0_S5_S3 6 -200 1300 DEPOSIT ABSOLUTE /end AXIS_DESCR
/end CHARACTERISTIC
/begin CHARACTERISTIC KF_POFMTNSPORT87 "Kennfeld Fuelldruckoffset(n_t, m_t)" MAP 0x1CA448 ZF_kf_si16_S5_S3 12.75 UMR_BAR__1_1000_0_S5_S3 -6.4 6.35
 /begin AXIS_DESCR STD_AXIS zff_atsys._.iSignale._.obj.sig_n_t UMR_U_MIN_1_1_0_S5_S3 4 0 8160 DEPOSIT ABSOLUTE /end AXIS_DESCR
 /begin AXIS_DESCR STD_AXIS zff_atsys._.iSignale._.obj.sig_m_t UMR_NM__1_1_0_S5_S3 6 -200 1300 DEPOSIT ABSOLUTE /end AXIS_DESCR
/end CHARACTERISTIC
/begin CHARACTERISTIC KF_POHINSYNKZU32 "Kennfeld Haltedruckoffset(n_tkf, m_t) bei Haltephase in Synchron" MAP 0x1C6E14 ZF_kf_si16_S5_S3 12.75 UMR_BAR__1_1000_0_S5_S3 -6.4 6.35
 /begin AXIS_DESCR STD_AXIS iSasZentr.iSchaltend.n_tkf UMR_U_MIN_32_1_0_S5_S3 6 0 8160 DEPOSIT ABSOLUTE /end AXIS_DESCR
 /begin AXIS_DESCR STD_AXIS zff_atsys._.iSignale._.obj.sig_m_t UMR_NM__1_1_0_S5_S3 6 -200 1300 DEPOSIT ABSOLUTE /end AXIS_DESCR
/end CHARACTERISTIC
/begin CHARACTERISTIC KF_POHINSYNKZU43 "Kennfeld Haltedruckoffset(n_tkf, m_t) bei Haltephase in Synchron" MAP 0x1C70C0 ZF_kf_si16_S5_S3 12.75 UMR_BAR__1_1000_0_S5_S3 -6.4 6.35
 /begin AXIS_DESCR STD_AXIS iSasZentr.iSchaltend.n_tkf UMR_U_MIN_32_1_0_S5_S3 6 0 8160 DEPOSIT ABSOLUTE /end AXIS_DESCR
 /begin AXIS_DESCR STD_AXIS zff_atsys._.iSignale._.obj.sig_m_t UMR_NM__1_1_0_S5_S3 6 -200 1300 DEPOSIT ABSOLUTE /end AXIS_DESCR
/end CHARACTERISTIC
/begin CHARACTERISTIC KF_POHINSYNKZU54 "Kennfeld Haltedruckoffset(n_tkf, m_t) bei Haltephase in Synchron" MAP 0x1C736C ZF_kf_si16_S5_S3 12.75 UMR_BAR__1_1000_0_S5_S3 -6.4 6.35
 /begin AXIS_DESCR STD_AXIS iSasZentr.iSchaltend.n_tkf UMR_U_MIN_32_1_0_S5_S3 6 0 8160 DEPOSIT ABSOLUTE /end AXIS_DESCR
 /begin AXIS_DESCR STD_AXIS zff_atsys._.iSignale._.obj.sig_m_t UMR_NM__1_1_0_S5_S3 6 -200 1300 DEPOSIT ABSOLUTE /end AXIS_DESCR
/end CHARACTERISTIC
/begin CHARACTERISTIC KF_POHINSYNKZU65 "Kennfeld Haltedruckoffset(n_tkf, m_t) bei Haltephase in Synchron" MAP 0x1C7618 ZF_kf_si16_S5_S3 12.75 UMR_BAR__1_1000_0_S5_S3 -6.4 6.35
 /begin AXIS_DESCR STD_AXIS iSasZentr.iSchaltend.n_tkf UMR_U_MIN_32_1_0_S5_S3 6 0 8160 DEPOSIT ABSOLUTE /end AXIS_DESCR
 /begin AXIS_DESCR STD_AXIS zff_atsys._.iSignale._.obj.sig_m_t UMR_NM__1_1_0_S5_S3 6 -200 1300 DEPOSIT ABSOLUTE /end AXIS_DESCR
/end CHARACTERISTIC
/begin CHARACTERISTIC KF_POHINSYNKZU76 "Kennfeld Haltedruckoffset(n_tkf, m_t) bei Haltephase in Synchron" MAP 0x1C78C4 ZF_kf_si16_S5_S3 12.75 UMR_BAR__1_1000_0_S5_S3 -6.4 6.35
 /begin AXIS_DESCR STD_AXIS iSasZentr.iSchaltend.n_tkf UMR_U_MIN_32_1_0_S5_S3 6 0 8160 DEPOSIT ABSOLUTE /end AXIS_DESCR
 /begin AXIS_DESCR STD_AXIS zff_atsys._.iSignale._.obj.sig_m_t UMR_NM__1_1_0_S5_S3 6 -200 1300 DEPOSIT ABSOLUTE /end AXIS_DESCR
/end CHARACTERISTIC
/begin CHARACTERISTIC KF_POHINSYNKZU87 "Kennfeld Haltedruckoffset(n_tkf, m_t) bei Haltephase in Synchron" MAP 0x1C7B70 ZF_kf_si16_S5_S3 12.75 UMR_BAR__1_1000_0_S5_S3 -6.4 6.35
 /begin AXIS_DESCR STD_AXIS iSasZentr.iSchaltend.n_tkf UMR_U_MIN_32_1_0_S5_S3 6 0 8160 DEPOSIT ABSOLUTE /end AXIS_DESCR
 /begin AXIS_DESCR STD_AXIS zff_atsys._.iSignale._.obj.sig_m_t UMR_NM__1_1_0_S5_S3 6 -200 1300 DEPOSIT ABSOLUTE /end AXIS_DESCR
/end CHARACTERISTIC
/begin CHARACTERISTIC KF_POHINSYNKZUSP21 "Kennfeld Haltedruckoffset(n_tkf, m_t) bei Haltephase in Synchron" MAP 0x1C7D1C ZF_kf_si16_S5_S3 12.75 UMR_BAR__1_1000_0_S5_S3 -6.4 6.35
 /begin AXIS_DESCR STD_AXIS iSasZentr.iSchaltend.n_tkf UMR_U_MIN_32_1_0_S5_S3 6 0 8160 DEPOSIT ABSOLUTE /end AXIS_DESCR
 /begin AXIS_DESCR STD_AXIS zff_atsys._.iSignale._.obj.sig_m_t UMR_NM__1_1_0_S5_S3 6 -200 1300 DEPOSIT ABSOLUTE /end AXIS_DESCR
/end CHARACTERISTIC
/begin CHARACTERISTIC KF_POHINSYNKZUSP31 "Kennfeld Haltedruckoffset(n_tkf, m_t) bei Haltephase in Synchron" MAP 0x1C88D0 ZF_kf_si16_S5_S3 12.75 UMR_BAR__1_1000_0_S5_S3 -6.4 6.35
 /begin AXIS_DESCR STD_AXIS iSasZentr.iSchaltend.n_tkf UMR_U_MIN_32_1_0_S5_S3 6 0 8160 DEPOSIT ABSOLUTE /end AXIS_DESCR
 /begin AXIS_DESCR STD_AXIS zff_atsys._.iSignale._.obj.sig_m_t UMR_NM__1_1_0_S5_S3 6 -200 1300 DEPOSIT ABSOLUTE /end AXIS_DESCR
/end CHARACTERISTIC
/begin CHARACTERISTIC KF_POHINSYNKZUSP32 "Kennfeld Haltedruckoffset(n_tkf, m_t) bei Haltephase in Synchron" MAP 0x1C7EC8 ZF_kf_si16_S5_S3 12.75 UMR_BAR__1_1000_0_S5_S3 -6.4 6.35
 /begin AXIS_DESCR STD_AXIS iSasZentr.iSchaltend.n_tkf UMR_U_MIN_32_1_0_S5_S3 6 0 8160 DEPOSIT ABSOLUTE /end AXIS_DESCR
 /begin AXIS_DESCR STD_AXIS zff_atsys._.iSignale._.obj.sig_m_t UMR_NM__1_1_0_S5_S3 6 -200 1300 DEPOSIT ABSOLUTE /end AXIS_DESCR
/end CHARACTERISTIC
/begin CHARACTERISTIC KF_POHINSYNKZUSP42 "Kennfeld Haltedruckoffset(n_tkf, m_t) bei Haltephase in Synchron" MAP 0x1C8A7C ZF_kf_si16_S5_S3 12.75 UMR_BAR__1_1000_0_S5_S3 -6.4 6.35
 /begin AXIS_DESCR STD_AXIS iSasZentr.iSchaltend.n_tkf UMR_U_MIN_32_1_0_S5_S3 6 0 8160 DEPOSIT ABSOLUTE /end AXIS_DESCR
 /begin AXIS_DESCR STD_AXIS zff_atsys._.iSignale._.obj.sig_m_t UMR_NM__1_1_0_S5_S3 6 -200 1300 DEPOSIT ABSOLUTE /end AXIS_DESCR
/end CHARACTERISTIC
/begin CHARACTERISTIC KF_POHINSYNKZUSP43 "Kennfeld Haltedruckoffset(n_tkf, m_t) bei Haltephase in Synchron" MAP 0x1C8074 ZF_kf_si16_S5_S3 12.75 UMR_BAR__1_1000_0_S5_S3 -6.4 6.35
 /begin AXIS_DESCR STD_AXIS iSasZentr.iSchaltend.n_tkf UMR_U_MIN_32_1_0_S5_S3 6 0 8160 DEPOSIT ABSOLUTE /end AXIS_DESCR
 /begin AXIS_DESCR STD_AXIS zff_atsys._.iSignale._.obj.sig_m_t UMR_NM__1_1_0_S5_S3 6 -200 1300 DEPOSIT ABSOLUTE /end AXIS_DESCR
/end CHARACTERISTIC
/begin CHARACTERISTIC KF_POHINSYNKZUSP51 "Kennfeld Haltedruckoffset(n_tkf, m_t) bei Haltephase in Synchron" MAP 0x1C8C28 ZF_kf_si16_S5_S3 12.75 UMR_BAR__1_1000_0_S5_S3 -6.4 6.35
 /begin AXIS_DESCR STD_AXIS iSasZentr.iSchaltend.n_tkf UMR_U_MIN_32_1_0_S5_S3 6 0 8160 DEPOSIT ABSOLUTE /end AXIS_DESCR
 /begin AXIS_DESCR STD_AXIS zff_atsys._.iSignale._.obj.sig_m_t UMR_NM__1_1_0_S5_S3 6 -200 1300 DEPOSIT ABSOLUTE /end AXIS_DESCR
/end CHARACTERISTIC
/begin CHARACTERISTIC KF_POHINSYNKZUSP53 "Kennfeld Haltedruckoffset(n_tkf, m_t) bei Haltephase in Synchron" MAP 0x1C8DD4 ZF_kf_si16_S5_S3 12.75 UMR_BAR__1_1000_0_S5_S3 -6.4 6.35
 /begin AXIS_DESCR STD_AXIS iSasZentr.iSchaltend.n_tkf UMR_U_MIN_32_1_0_S5_S3 6 0 8160 DEPOSIT ABSOLUTE /end AXIS_DESCR
 /begin AXIS_DESCR STD_AXIS zff_atsys._.iSignale._.obj.sig_m_t UMR_NM__1_1_0_S5_S3 6 -200 1300 DEPOSIT ABSOLUTE /end AXIS_DESCR
/end CHARACTERISTIC
/begin CHARACTERISTIC KF_POHINSYNKZUSP54 "Kennfeld Haltedruckoffset(n_tkf, m_t) bei Haltephase in Synchron" MAP 0x1C8220 ZF_kf_si16_S5_S3 12.75 UMR_BAR__1_1000_0_S5_S3 -6.4 6.35
 /begin AXIS_DESCR STD_AXIS iSasZentr.iSchaltend.n_tkf UMR_U_MIN_32_1_0_S5_S3 6 0 8160 DEPOSIT ABSOLUTE /end AXIS_DESCR
 /begin AXIS_DESCR STD_AXIS zff_atsys._.iSignale._.obj.sig_m_t UMR_NM__1_1_0_S5_S3 6 -200 1300 DEPOSIT ABSOLUTE /end AXIS_DESCR
/end CHARACTERISTIC
/begin CHARACTERISTIC KF_POHINSYNKZUSP63 "Kennfeld Haltedruckoffset(n_tkf, m_t) bei Haltephase in Synchron" MAP 0x1C8F80 ZF_kf_si16_S5_S3 12.75 UMR_BAR__1_1000_0_S5_S3 -6.4 6.35
 /begin AXIS_DESCR STD_AXIS iSasZentr.iSchaltend.n_tkf UMR_U_MIN_32_1_0_S5_S3 6 0 8160 DEPOSIT ABSOLUTE /end AXIS_DESCR
 /begin AXIS_DESCR STD_AXIS zff_atsys._.iSignale._.obj.sig_m_t UMR_NM__1_1_0_S5_S3 6 -200 1300 DEPOSIT ABSOLUTE /end AXIS_DESCR
/end CHARACTERISTIC
/begin CHARACTERISTIC KF_POHINSYNKZUSP64 "Kennfeld Haltedruckoffset(n_tkf, m_t) bei Haltephase in Synchron" MAP 0x1C912C ZF_kf_si16_S5_S3 12.75 UMR_BAR__1_1000_0_S5_S3 -6.4 6.35
 /begin AXIS_DESCR STD_AXIS iSasZentr.iSchaltend.n_tkf UMR_U_MIN_32_1_0_S5_S3 6 0 8160 DEPOSIT ABSOLUTE /end AXIS_DESCR
 /begin AXIS_DESCR STD_AXIS zff_atsys._.iSignale._.obj.sig_m_t UMR_NM__1_1_0_S5_S3 6 -200 1300 DEPOSIT ABSOLUTE /end AXIS_DESCR
/end CHARACTERISTIC
/begin CHARACTERISTIC KF_POHINSYNKZUSP65 "Kennfeld Haltedruckoffset(n_tkf, m_t) bei Haltephase in Synchron" MAP 0x1C83CC ZF_kf_si16_S5_S3 12.75 UMR_BAR__1_1000_0_S5_S3 -6.4 6.35
 /begin AXIS_DESCR STD_AXIS iSasZentr.iSchaltend.n_tkf UMR_U_MIN_32_1_0_S5_S3 6 0 8160 DEPOSIT ABSOLUTE /end AXIS_DESCR
 /begin AXIS_DESCR STD_AXIS zff_atsys._.iSignale._.obj.sig_m_t UMR_NM__1_1_0_S5_S3 6 -200 1300 DEPOSIT ABSOLUTE /end AXIS_DESCR
/end CHARACTERISTIC
/begin CHARACTERISTIC KF_POHINSYNKZUSP71 "Kennfeld Haltedruckoffset(n_tkf, m_t) bei Haltephase in Synchron" MAP 0x1C92D8 ZF_kf_si16_S5_S3 12.75 UMR_BAR__1_1000_0_S5_S3 -6.4 6.35
 /begin AXIS_DESCR STD_AXIS iSasZentr.iSchaltend.n_tkf UMR_U_MIN_32_1_0_S5_S3 6 0 8160 DEPOSIT ABSOLUTE /end AXIS_DESCR
 /begin AXIS_DESCR STD_AXIS zff_atsys._.iSignale._.obj.sig_m_t UMR_NM__1_1_0_S5_S3 6 -200 1300 DEPOSIT ABSOLUTE /end AXIS_DESCR
/end CHARACTERISTIC
/begin CHARACTERISTIC KF_POHINSYNKZUSP75 "Kennfeld Haltedruckoffset(n_tkf, m_t) bei Haltephase in Synchron" MAP 0x1C9484 ZF_kf_si16_S5_S3 12.75 UMR_BAR__1_1000_0_S5_S3 -6.4 6.35
 /begin AXIS_DESCR STD_AXIS iSasZentr.iSchaltend.n_tkf UMR_U_MIN_32_1_0_S5_S3 6 0 8160 DEPOSIT ABSOLUTE /end AXIS_DESCR
 /begin AXIS_DESCR STD_AXIS zff_atsys._.iSignale._.obj.sig_m_t UMR_NM__1_1_0_S5_S3 6 -200 1300 DEPOSIT ABSOLUTE /end AXIS_DESCR
/end CHARACTERISTIC
/begin CHARACTERISTIC KF_POHINSYNKZUSP76 "Kennfeld Haltedruckoffset(n_tkf, m_t) bei Haltephase in Synchron" MAP 0x1C8578 ZF_kf_si16_S5_S3 12.75 UMR_BAR__1_1000_0_S5_S3 -6.4 6.35
 /begin AXIS_DESCR STD_AXIS iSasZentr.iSchaltend.n_tkf UMR_U_MIN_32_1_0_S5_S3 6 0 8160 DEPOSIT ABSOLUTE /end AXIS_DESCR
 /begin AXIS_DESCR STD_AXIS zff_atsys._.iSignale._.obj.sig_m_t UMR_NM__1_1_0_S5_S3 6 -200 1300 DEPOSIT ABSOLUTE /end AXIS_DESCR
/end CHARACTERISTIC
/begin CHARACTERISTIC KF_POHINSYNKZUSP82 "Kennfeld Haltedruckoffset(n_tkf, m_t) bei Haltephase in Synchron" MAP 0x1C9630 ZF_kf_si16_S5_S3 12.75 UMR_BAR__1_1000_0_S5_S3 -6.4 6.35
 /begin AXIS_DESCR STD_AXIS iSasZentr.iSchaltend.n_tkf UMR_U_MIN_32_1_0_S5_S3 6 0 8160 DEPOSIT ABSOLUTE /end AXIS_DESCR
 /begin AXIS_DESCR STD_AXIS zff_atsys._.iSignale._.obj.sig_m_t UMR_NM__1_1_0_S5_S3 6 -200 1300 DEPOSIT ABSOLUTE /end AXIS_DESCR
/end CHARACTERISTIC
/begin CHARACTERISTIC KF_POHINSYNKZUSP84 "Kennfeld Haltedruckoffset(n_tkf, m_t) bei Haltephase in Synchron" MAP 0x1C97DC ZF_kf_si16_S5_S3 12.75 UMR_BAR__1_1000_0_S5_S3 -6.4 6.35
 /begin AXIS_DESCR STD_AXIS iSasZentr.iSchaltend.n_tkf UMR_U_MIN_32_1_0_S5_S3 6 0 8160 DEPOSIT ABSOLUTE /end AXIS_DESCR
 /begin AXIS_DESCR STD_AXIS zff_atsys._.iSignale._.obj.sig_m_t UMR_NM__1_1_0_S5_S3 6 -200 1300 DEPOSIT ABSOLUTE /end AXIS_DESCR
/end CHARACTERISTIC
/begin CHARACTERISTIC KF_POHINSYNKZUSP86 "Kennfeld Haltedruckoffset(n_tkf, m_t) bei Haltephase in Synchron" MAP 0x1C9988 ZF_kf_si16_S5_S3 12.75 UMR_BAR__1_1000_0_S5_S3 -6.4 6.35
 /begin AXIS_DESCR STD_AXIS iSasZentr.iSchaltend.n_tkf UMR_U_MIN_32_1_0_S5_S3 6 0 8160 DEPOSIT ABSOLUTE /end AXIS_DESCR
 /begin AXIS_DESCR STD_AXIS zff_atsys._.iSignale._.obj.sig_m_t UMR_NM__1_1_0_S5_S3 6 -200 1300 DEPOSIT ABSOLUTE /end AXIS_DESCR
/end CHARACTERISTIC
/begin CHARACTERISTIC KF_POHINSYNKZUSP87 "Kennfeld Haltedruckoffset(n_tkf, m_t) bei Haltephase in Synchron" MAP 0x1C8724 ZF_kf_si16_S5_S3 12.75 UMR_BAR__1_1000_0_S5_S3 -6.4 6.35
 /begin AXIS_DESCR STD_AXIS iSasZentr.iSchaltend.n_tkf UMR_U_MIN_32_1_0_S5_S3 6 0 8160 DEPOSIT ABSOLUTE /end AXIS_DESCR
 /begin AXIS_DESCR STD_AXIS zff_atsys._.iSignale._.obj.sig_m_t UMR_NM__1_1_0_S5_S3 6 -200 1300 DEPOSIT ABSOLUTE /end AXIS_DESCR
/end CHARACTERISTIC
/begin CHARACTERISTIC KF_POHINSYNKZUSPORT21 "Kennfeld Haltedruckoffset(n_tkf, m_t) bei Haltephase in Synchron" MAP 0x1C9B34 ZF_kf_si16_S5_S3 12.75 UMR_BAR__1_1000_0_S5_S3 -6.4 6.35
 /begin AXIS_DESCR STD_AXIS iSasZentr.iSchaltend.n_tkf UMR_U_MIN_32_1_0_S5_S3 6 0 8160 DEPOSIT ABSOLUTE /end AXIS_DESCR
 /begin AXIS_DESCR STD_AXIS zff_atsys._.iSignale._.obj.sig_m_t UMR_NM__1_1_0_S5_S3 6 -200 1300 DEPOSIT ABSOLUTE /end AXIS_DESCR
/end CHARACTERISTIC
/begin CHARACTERISTIC KF_POHINSYNKZUSPORT31 "Kennfeld Haltedruckoffset(n_tkf, m_t) bei Haltephase in Synchron" MAP 0x1CA6E8 ZF_kf_si16_S5_S3 12.75 UMR_BAR__1_1000_0_S5_S3 -6.4 6.35
 /begin AXIS_DESCR STD_AXIS iSasZentr.iSchaltend.n_tkf UMR_U_MIN_32_1_0_S5_S3 6 0 8160 DEPOSIT ABSOLUTE /end AXIS_DESCR
 /begin AXIS_DESCR STD_AXIS zff_atsys._.iSignale._.obj.sig_m_t UMR_NM__1_1_0_S5_S3 6 -200 1300 DEPOSIT ABSOLUTE /end AXIS_DESCR
/end CHARACTERISTIC
/begin CHARACTERISTIC KF_POHINSYNKZUSPORT32 "Kennfeld Haltedruckoffset(n_tkf, m_t) bei Haltephase in Synchron" MAP 0x1C9CE0 ZF_kf_si16_S5_S3 12.75 UMR_BAR__1_1000_0_S5_S3 -6.4 6.35
 /begin AXIS_DESCR STD_AXIS iSasZentr.iSchaltend.n_tkf UMR_U_MIN_32_1_0_S5_S3 6 0 8160 DEPOSIT ABSOLUTE /end AXIS_DESCR
 /begin AXIS_DESCR STD_AXIS zff_atsys._.iSignale._.obj.sig_m_t UMR_NM__1_1_0_S5_S3 6 -200 1300 DEPOSIT ABSOLUTE /end AXIS_DESCR
/end CHARACTERISTIC
/begin CHARACTERISTIC KF_POHINSYNKZUSPORT42 "Kennfeld Haltedruckoffset(n_tkf, m_t) bei Haltephase in Synchron" MAP 0x1CA894 ZF_kf_si16_S5_S3 12.75 UMR_BAR__1_1000_0_S5_S3 -6.4 6.35
 /begin AXIS_DESCR STD_AXIS iSasZentr.iSchaltend.n_tkf UMR_U_MIN_32_1_0_S5_S3 6 0 8160 DEPOSIT ABSOLUTE /end AXIS_DESCR
 /begin AXIS_DESCR STD_AXIS zff_atsys._.iSignale._.obj.sig_m_t UMR_NM__1_1_0_S5_S3 6 -200 1300 DEPOSIT ABSOLUTE /end AXIS_DESCR
/end CHARACTERISTIC
/begin CHARACTERISTIC KF_POHINSYNKZUSPORT43 "Kennfeld Haltedruckoffset(n_tkf, m_t) bei Haltephase in Synchron" MAP 0x1C9E8C ZF_kf_si16_S5_S3 12.75 UMR_BAR__1_1000_0_S5_S3 -6.4 6.35
 /begin AXIS_DESCR STD_AXIS iSasZentr.iSchaltend.n_tkf UMR_U_MIN_32_1_0_S5_S3 6 0 8160 DEPOSIT ABSOLUTE /end AXIS_DESCR
 /begin AXIS_DESCR STD_AXIS zff_atsys._.iSignale._.obj.sig_m_t UMR_NM__1_1_0_S5_S3 6 -200 1300 DEPOSIT ABSOLUTE /end AXIS_DESCR
/end CHARACTERISTIC
/begin CHARACTERISTIC KF_POHINSYNKZUSPORT51 "Kennfeld Haltedruckoffset(n_tkf, m_t) bei Haltephase in Synchron" MAP 0x1CAA40 ZF_kf_si16_S5_S3 12.75 UMR_BAR__1_1000_0_S5_S3 -6.4 6.35
 /begin AXIS_DESCR STD_AXIS iSasZentr.iSchaltend.n_tkf UMR_U_MIN_32_1_0_S5_S3 6 0 8160 DEPOSIT ABSOLUTE /end AXIS_DESCR
 /begin AXIS_DESCR STD_AXIS zff_atsys._.iSignale._.obj.sig_m_t UMR_NM__1_1_0_S5_S3 6 -200 1300 DEPOSIT ABSOLUTE /end AXIS_DESCR
/end CHARACTERISTIC
/begin CHARACTERISTIC KF_POHINSYNKZUSPORT53 "Kennfeld Haltedruckoffset(n_tkf, m_t) bei Haltephase in Synchron" MAP 0x1CABEC ZF_kf_si16_S5_S3 12.75 UMR_BAR__1_1000_0_S5_S3 -6.4 6.35
 /begin AXIS_DESCR STD_AXIS iSasZentr.iSchaltend.n_tkf UMR_U_MIN_32_1_0_S5_S3 6 0 8160 DEPOSIT ABSOLUTE /end AXIS_DESCR
 /begin AXIS_DESCR STD_AXIS zff_atsys._.iSignale._.obj.sig_m_t UMR_NM__1_1_0_S5_S3 6 -200 1300 DEPOSIT ABSOLUTE /end AXIS_DESCR
/end CHARACTERISTIC
/begin CHARACTERISTIC KF_POHINSYNKZUSPORT54 "Kennfeld Haltedruckoffset(n_tkf, m_t) bei Haltephase in Synchron" MAP 0x1CA038 ZF_kf_si16_S5_S3 12.75 UMR_BAR__1_1000_0_S5_S3 -6.4 6.35
 /begin AXIS_DESCR STD_AXIS iSasZentr.iSchaltend.n_tkf UMR_U_MIN_32_1_0_S5_S3 6 0 8160 DEPOSIT ABSOLUTE /end AXIS_DESCR
 /begin AXIS_DESCR STD_AXIS zff_atsys._.iSignale._.obj.sig_m_t UMR_NM__1_1_0_S5_S3 6 -200 1300 DEPOSIT ABSOLUTE /end AXIS_DESCR
/end CHARACTERISTIC
/begin CHARACTERISTIC KF_POHINSYNKZUSPORT63 "Kennfeld Haltedruckoffset(n_tkf, m_t) bei Haltephase in Synchron" MAP 0x1CAD98 ZF_kf_si16_S5_S3 12.75 UMR_BAR__1_1000_0_S5_S3 -6.4 6.35
 /begin AXIS_DESCR STD_AXIS iSasZentr.iSchaltend.n_tkf UMR_U_MIN_32_1_0_S5_S3 6 0 8160 DEPOSIT ABSOLUTE /end AXIS_DESCR
 /begin AXIS_DESCR STD_AXIS zff_atsys._.iSignale._.obj.sig_m_t UMR_NM__1_1_0_S5_S3 6 -200 1300 DEPOSIT ABSOLUTE /end AXIS_DESCR
/end CHARACTERISTIC
/begin CHARACTERISTIC KF_POHINSYNKZUSPORT64 "Kennfeld Haltedruckoffset(n_tkf, m_t) bei Haltephase in Synchron" MAP 0x1CAF44 ZF_kf_si16_S5_S3 12.75 UMR_BAR__1_1000_0_S5_S3 -6.4 6.35
 /begin AXIS_DESCR STD_AXIS iSasZentr.iSchaltend.n_tkf UMR_U_MIN_32_1_0_S5_S3 6 0 8160 DEPOSIT ABSOLUTE /end AXIS_DESCR
 /begin AXIS_DESCR STD_AXIS zff_atsys._.iSignale._.obj.sig_m_t UMR_NM__1_1_0_S5_S3 6 -200 1300 DEPOSIT ABSOLUTE /end AXIS_DESCR
/end CHARACTERISTIC
/begin CHARACTERISTIC KF_POHINSYNKZUSPORT65 "Kennfeld Haltedruckoffset(n_tkf, m_t) bei Haltephase in Synchron" MAP 0x1CA1E4 ZF_kf_si16_S5_S3 12.75 UMR_BAR__1_1000_0_S5_S3 -6.4 6.35
 /begin AXIS_DESCR STD_AXIS iSasZentr.iSchaltend.n_tkf UMR_U_MIN_32_1_0_S5_S3 6 0 8160 DEPOSIT ABSOLUTE /end AXIS_DESCR
 /begin AXIS_DESCR STD_AXIS zff_atsys._.iSignale._.obj.sig_m_t UMR_NM__1_1_0_S5_S3 6 -200 1300 DEPOSIT ABSOLUTE /end AXIS_DESCR
/end CHARACTERISTIC
/begin CHARACTERISTIC KF_POHINSYNKZUSPORT71 "Kennfeld Haltedruckoffset(n_tkf, m_t) bei Haltephase in Synchron" MAP 0x1CB0F0 ZF_kf_si16_S5_S3 12.75 UMR_BAR__1_1000_0_S5_S3 -6.4 6.35
 /begin AXIS_DESCR STD_AXIS iSasZentr.iSchaltend.n_tkf UMR_U_MIN_32_1_0_S5_S3 6 0 8160 DEPOSIT ABSOLUTE /end AXIS_DESCR
 /begin AXIS_DESCR STD_AXIS zff_atsys._.iSignale._.obj.sig_m_t UMR_NM__1_1_0_S5_S3 6 -200 1300 DEPOSIT ABSOLUTE /end AXIS_DESCR
/end CHARACTERISTIC
/begin CHARACTERISTIC KF_POHINSYNKZUSPORT75 "Kennfeld Haltedruckoffset(n_tkf, m_t) bei Haltephase in Synchron" MAP 0x1CB29C ZF_kf_si16_S5_S3 12.75 UMR_BAR__1_1000_0_S5_S3 -6.4 6.35
 /begin AXIS_DESCR STD_AXIS iSasZentr.iSchaltend.n_tkf UMR_U_MIN_32_1_0_S5_S3 6 0 8160 DEPOSIT ABSOLUTE /end AXIS_DESCR
 /begin AXIS_DESCR STD_AXIS zff_atsys._.iSignale._.obj.sig_m_t UMR_NM__1_1_0_S5_S3 6 -200 1300 DEPOSIT ABSOLUTE /end AXIS_DESCR
/end CHARACTERISTIC
/begin CHARACTERISTIC KF_POHINSYNKZUSPORT76 "Kennfeld Haltedruckoffset(n_tkf, m_t) bei Haltephase in Synchron" MAP 0x1CA390 ZF_kf_si16_S5_S3 12.75 UMR_BAR__1_1000_0_S5_S3 -6.4 6.35
 /begin AXIS_DESCR STD_AXIS iSasZentr.iSchaltend.n_tkf UMR_U_MIN_32_1_0_S5_S3 6 0 8160 DEPOSIT ABSOLUTE /end AXIS_DESCR
 /begin AXIS_DESCR STD_AXIS zff_atsys._.iSignale._.obj.sig_m_t UMR_NM__1_1_0_S5_S3 6 -200 1300 DEPOSIT ABSOLUTE /end AXIS_DESCR
/end CHARACTERISTIC
/begin CHARACTERISTIC KF_POHINSYNKZUSPORT82 "Kennfeld Haltedruckoffset(n_tkf, m_t) bei Haltephase in Synchron" MAP 0x1CB448 ZF_kf_si16_S5_S3 12.75 UMR_BAR__1_1000_0_S5_S3 -6.4 6.35
 /begin AXIS_DESCR STD_AXIS iSasZentr.iSchaltend.n_tkf UMR_U_MIN_32_1_0_S5_S3 6 0 8160 DEPOSIT ABSOLUTE /end AXIS_DESCR
 /begin AXIS_DESCR STD_AXIS zff_atsys._.iSignale._.obj.sig_m_t UMR_NM__1_1_0_S5_S3 6 -200 1300 DEPOSIT ABSOLUTE /end AXIS_DESCR
/end CHARACTERISTIC
/begin CHARACTERISTIC KF_POHINSYNKZUSPORT84 "Kennfeld Haltedruckoffset(n_tkf, m_t) bei Haltephase in Synchron" MAP 0x1CB5F4 ZF_kf_si16_S5_S3 12.75 UMR_BAR__1_1000_0_S5_S3 -6.4 6.35
 /begin AXIS_DESCR STD_AXIS iSasZentr.iSchaltend.n_tkf UMR_U_MIN_32_1_0_S5_S3 6 0 8160 DEPOSIT ABSOLUTE /end AXIS_DESCR
 /begin AXIS_DESCR STD_AXIS zff_atsys._.iSignale._.obj.sig_m_t UMR_NM__1_1_0_S5_S3 6 -200 1300 DEPOSIT ABSOLUTE /end AXIS_DESCR
/end CHARACTERISTIC
/begin CHARACTERISTIC KF_POHINSYNKZUSPORT86 "Kennfeld Haltedruckoffset(n_tkf, m_t) bei Haltephase in Synchron" MAP 0x1CB7A0 ZF_kf_si16_S5_S3 12.75 UMR_BAR__1_1000_0_S5_S3 -6.4 6.35
 /begin AXIS_DESCR STD_AXIS iSasZentr.iSchaltend.n_tkf UMR_U_MIN_32_1_0_S5_S3 6 0 8160 DEPOSIT ABSOLUTE /end AXIS_DESCR
 /begin AXIS_DESCR STD_AXIS zff_atsys._.iSignale._.obj.sig_m_t UMR_NM__1_1_0_S5_S3 6 -200 1300 DEPOSIT ABSOLUTE /end AXIS_DESCR
/end CHARACTERISTIC
/begin CHARACTERISTIC KF_POHINSYNKZUSPORT87 "Kennfeld Haltedruckoffset(n_tkf, m_t) bei Haltephase in Synchron" MAP 0x1CA53C ZF_kf_si16_S5_S3 12.75 UMR_BAR__1_1000_0_S5_S3 -6.4 6.35
 /begin AXIS_DESCR STD_AXIS iSasZentr.iSchaltend.n_tkf UMR_U_MIN_32_1_0_S5_S3 6 0 8160 DEPOSIT ABSOLUTE /end AXIS_DESCR
 /begin AXIS_DESCR STD_AXIS zff_atsys._.iSignale._.obj.sig_m_t UMR_NM__1_1_0_S5_S3 6 -200 1300 DEPOSIT ABSOLUTE /end AXIS_DESCR
/end CHARACTERISTIC
/begin CHARACTERISTIC KF_TSYNMTNTRAKZUWS21 "Zeit vor sync. Ende Schaltdruck/Start 3. Rampe KZU bei Weiterschaltung (n_tkf, m_t8)" MAP 0x1CBA40 ZF_kf_ui8_S5_S3 1280 UMR_MSEC__10_1_M128_S5_S3 -1280 0
 /begin AXIS_DESCR STD_AXIS zff_atsys._.iSignale._.obj.sig_m_t8 UMR_NM__6_1_M34_S5_S3 4 -204 1326 DEPOSIT ABSOLUTE /end AXIS_DESCR
 /begin AXIS_DESCR STD_AXIS iSasZentr.iSchaltend.n_tkf UMR_U_MIN_32_1_0_S5_S3 4 0 8160 DEPOSIT ABSOLUTE /end AXIS_DESCR
/end CHARACTERISTIC
/begin CHARACTERISTIC KF_TSYNMTNTRAKZUWS32 "Zeit vor sync. Ende Schaltdruck/Start 3. Rampe KZU bei Weiterschaltung (n_tkf, m_t8)" MAP 0x1CBC8C ZF_kf_ui8_S5_S3 1280 UMR_MSEC__10_1_M128_S5_S3 -1280 0
 /begin AXIS_DESCR STD_AXIS zff_atsys._.iSignale._.obj.sig_m_t8 UMR_NM__6_1_M34_S5_S3 4 -204 1326 DEPOSIT ABSOLUTE /end AXIS_DESCR
 /begin AXIS_DESCR STD_AXIS iSasZentr.iSchaltend.n_tkf UMR_U_MIN_32_1_0_S5_S3 4 0 8160 DEPOSIT ABSOLUTE /end AXIS_DESCR
/end CHARACTERISTIC
/begin CHARACTERISTIC KF_TSYNMTNTRAKZUWS43 "Zeit vor sync. Ende Schaltdruck/Start 3. Rampe KZU bei Weiterschaltung (n_tkf, m_t8)" MAP 0x1CBED8 ZF_kf_ui8_S5_S3 1280 UMR_MSEC__10_1_M128_S5_S3 -1280 0
 /begin AXIS_DESCR STD_AXIS zff_atsys._.iSignale._.obj.sig_m_t8 UMR_NM__6_1_M34_S5_S3 4 -204 1326 DEPOSIT ABSOLUTE /end AXIS_DESCR
 /begin AXIS_DESCR STD_AXIS iSasZentr.iSchaltend.n_tkf UMR_U_MIN_32_1_0_S5_S3 4 0 8160 DEPOSIT ABSOLUTE /end AXIS_DESCR
/end CHARACTERISTIC
/begin CHARACTERISTIC KF_TSYNMTNTRAKZUWS54 "Zeit vor sync. Ende Schaltdruck/Start 3. Rampe KZU bei Weiterschaltung (n_tkf, m_t8)" MAP 0x1CC124 ZF_kf_ui8_S5_S3 1280 UMR_MSEC__10_1_M128_S5_S3 -1280 0
 /begin AXIS_DESCR STD_AXIS zff_atsys._.iSignale._.obj.sig_m_t8 UMR_NM__6_1_M34_S5_S3 4 -204 1326 DEPOSIT ABSOLUTE /end AXIS_DESCR
 /begin AXIS_DESCR STD_AXIS iSasZentr.iSchaltend.n_tkf UMR_U_MIN_32_1_0_S5_S3 4 0 8160 DEPOSIT ABSOLUTE /end AXIS_DESCR
/end CHARACTERISTIC
/begin CHARACTERISTIC KF_TSYNMTNTRAKZUWSSP31 "Zeit vor sync. Ende Schaltdruck/Start 3. Rampe KZU bei Weiterschaltung (n_tkf, m_t8)" MAP 0x1CCA54 ZF_kf_ui8_S5_S3 1280 UMR_MSEC__10_1_M128_S5_S3 -1280 0
 /begin AXIS_DESCR STD_AXIS zff_atsys._.iSignale._.obj.sig_m_t8 UMR_NM__6_1_M34_S5_S3 4 -204 1326 DEPOSIT ABSOLUTE /end AXIS_DESCR
 /begin AXIS_DESCR STD_AXIS iSasZentr.iSchaltend.n_tkf UMR_U_MIN_32_1_0_S5_S3 4 0 8160 DEPOSIT ABSOLUTE /end AXIS_DESCR
/end CHARACTERISTIC
/begin CHARACTERISTIC KF_TSYNMTNTRAKZUWSSP42 "Zeit vor sync. Ende Schaltdruck/Start 3. Rampe KZU bei Weiterschaltung (n_tkf, m_t8)" MAP 0x1CCCA0 ZF_kf_ui8_S5_S3 1280 UMR_MSEC__10_1_M128_S5_S3 -1280 0
 /begin AXIS_DESCR STD_AXIS zff_atsys._.iSignale._.obj.sig_m_t8 UMR_NM__6_1_M34_S5_S3 4 -204 1326 DEPOSIT ABSOLUTE /end AXIS_DESCR
 /begin AXIS_DESCR STD_AXIS iSasZentr.iSchaltend.n_tkf UMR_U_MIN_32_1_0_S5_S3 4 0 8160 DEPOSIT ABSOLUTE /end AXIS_DESCR
/end CHARACTERISTIC
/begin CHARACTERISTIC KF_TSYNMTNTRAKZUWSSP51 "Zeit vor sync. Ende Schaltdruck/Start 3. Rampe KZU bei Weiterschaltung (n_tkf, m_t8)" MAP 0x1CCEEC ZF_kf_ui8_S5_S3 1280 UMR_MSEC__10_1_M128_S5_S3 -1280 0
 /begin AXIS_DESCR STD_AXIS zff_atsys._.iSignale._.obj.sig_m_t8 UMR_NM__6_1_M34_S5_S3 4 -204 1326 DEPOSIT ABSOLUTE /end AXIS_DESCR
 /begin AXIS_DESCR STD_AXIS iSasZentr.iSchaltend.n_tkf UMR_U_MIN_32_1_0_S5_S3 4 0 8160 DEPOSIT ABSOLUTE /end AXIS_DESCR
/end CHARACTERISTIC
/begin CHARACTERISTIC KF_TSYNMTNTRAKZUWSSP53 "Zeit vor sync. Ende Schaltdruck/Start 3. Rampe KZU bei Weiterschaltung (n_tkf, m_t8)" MAP 0x1CD138 ZF_kf_ui8_S5_S3 1280 UMR_MSEC__10_1_M128_S5_S3 -1280 0
 /begin AXIS_DESCR STD_AXIS zff_atsys._.iSignale._.obj.sig_m_t8 UMR_NM__6_1_M34_S5_S3 4 -204 1326 DEPOSIT ABSOLUTE /end AXIS_DESCR
 /begin AXIS_DESCR STD_AXIS iSasZentr.iSchaltend.n_tkf UMR_U_MIN_32_1_0_S5_S3 4 0 8160 DEPOSIT ABSOLUTE /end AXIS_DESCR
/end CHARACTERISTIC
/begin CHARACTERISTIC KF_TSYNMTNTRAKZUWSSP63 "Zeit vor sync. Ende Schaltdruck/Start 3. Rampe KZU bei Weiterschaltung (n_tkf, m_t8)" MAP 0x1CD384 ZF_kf_ui8_S5_S3 1280 UMR_MSEC__10_1_M128_S5_S3 -1280 0
 /begin AXIS_DESCR STD_AXIS zff_atsys._.iSignale._.obj.sig_m_t8 UMR_NM__6_1_M34_S5_S3 4 -204 1326 DEPOSIT ABSOLUTE /end AXIS_DESCR
 /begin AXIS_DESCR STD_AXIS iSasZentr.iSchaltend.n_tkf UMR_U_MIN_32_1_0_S5_S3 4 0 8160 DEPOSIT ABSOLUTE /end AXIS_DESCR
/end CHARACTERISTIC
/begin CHARACTERISTIC KF_TSYN_DT_IG_CHANGE32 "Kennfeld für T_SYN-Vorhalt für Übergabe Synchronrampenzeit" MAP 0x1C6E88 ZF_kf_si16_S5_S3 2540 UMR_MSEC__10_1_0_S5_S3 0 2540
 /begin AXIS_DESCR STD_AXIS zff_atsys._.iSignale._.obj.sig_n_t UMR_U_MIN_1_1_0_S5_S3 4 0 8160 DEPOSIT ABSOLUTE /end AXIS_DESCR
 /begin AXIS_DESCR STD_AXIS zff_atsys._.iSignale._.obj.sig_m_t UMR_NM__1_1_0_S5_S3 4 -200 1300 DEPOSIT ABSOLUTE /end AXIS_DESCR
/end CHARACTERISTIC
/begin CHARACTERISTIC KF_TSYN_DT_IG_CHANGE43 "Kennfeld für T_SYN-Vorhalt für Übergabe Synchronrampenzeit" MAP 0x1C7134 ZF_kf_si16_S5_S3 2540 UMR_MSEC__10_1_0_S5_S3 0 2540
 /begin AXIS_DESCR STD_AXIS zff_atsys._.iSignale._.obj.sig_n_t UMR_U_MIN_1_1_0_S5_S3 4 0 8160 DEPOSIT ABSOLUTE /end AXIS_DESCR
 /begin AXIS_DESCR STD_AXIS zff_atsys._.iSignale._.obj.sig_m_t UMR_NM__1_1_0_S5_S3 4 -200 1300 DEPOSIT ABSOLUTE /end AXIS_DESCR
/end CHARACTERISTIC
/begin CHARACTERISTIC KF_TSYN_DT_IG_CHANGE54 "Kennfeld für T_SYN-Vorhalt für Übergabe Synchronrampenzeit" MAP 0x1C73E0 ZF_kf_si16_S5_S3 2540 UMR_MSEC__10_1_0_S5_S3 0 2540
 /begin AXIS_DESCR STD_AXIS zff_atsys._.iSignale._.obj.sig_n_t UMR_U_MIN_1_1_0_S5_S3 4 0 8160 DEPOSIT ABSOLUTE /end AXIS_DESCR
 /begin AXIS_DESCR STD_AXIS zff_atsys._.iSignale._.obj.sig_m_t UMR_NM__1_1_0_S5_S3 4 -200 1300 DEPOSIT ABSOLUTE /end AXIS_DESCR
/end CHARACTERISTIC
/begin CHARACTERISTIC KF_TSYN_DT_IG_CHANGE65 "Kennfeld für T_SYN-Vorhalt für Übergabe Synchronrampenzeit" MAP 0x1C768C ZF_kf_si16_S5_S3 2540 UMR_MSEC__10_1_0_S5_S3 0 2540
 /begin AXIS_DESCR STD_AXIS zff_atsys._.iSignale._.obj.sig_n_t UMR_U_MIN_1_1_0_S5_S3 4 0 8160 DEPOSIT ABSOLUTE /end AXIS_DESCR
 /begin AXIS_DESCR STD_AXIS zff_atsys._.iSignale._.obj.sig_m_t UMR_NM__1_1_0_S5_S3 4 -200 1300 DEPOSIT ABSOLUTE /end AXIS_DESCR
/end CHARACTERISTIC
/begin CHARACTERISTIC KF_TSYN_DT_IG_CHANGE76 "Kennfeld für T_SYN-Vorhalt für Übergabe Synchronrampenzeit" MAP 0x1C7938 ZF_kf_si16_S5_S3 2540 UMR_MSEC__10_1_0_S5_S3 0 2540
 /begin AXIS_DESCR STD_AXIS zff_atsys._.iSignale._.obj.sig_n_t UMR_U_MIN_1_1_0_S5_S3 4 0 8160 DEPOSIT ABSOLUTE /end AXIS_DESCR
 /begin AXIS_DESCR STD_AXIS zff_atsys._.iSignale._.obj.sig_m_t UMR_NM__1_1_0_S5_S3 4 -200 1300 DEPOSIT ABSOLUTE /end AXIS_DESCR
/end CHARACTERISTIC
/begin CHARACTERISTIC KF_TSYN_DT_IG_CHANGE87 "Kennfeld für T_SYN-Vorhalt für Übergabe Synchronrampenzeit" MAP 0x1C7BE4 ZF_kf_si16_S5_S3 2540 UMR_MSEC__10_1_0_S5_S3 0 2540
 /begin AXIS_DESCR STD_AXIS zff_atsys._.iSignale._.obj.sig_n_t UMR_U_MIN_1_1_0_S5_S3 4 0 8160 DEPOSIT ABSOLUTE /end AXIS_DESCR
 /begin AXIS_DESCR STD_AXIS zff_atsys._.iSignale._.obj.sig_m_t UMR_NM__1_1_0_S5_S3 4 -200 1300 DEPOSIT ABSOLUTE /end AXIS_DESCR
/end CHARACTERISTIC
/begin CHARACTERISTIC KF_TSYN_DT_IG_CHANGESP21 "Kennfeld für T_SYN-Vorhalt für Übergabe Synchronrampenzeit" MAP 0x1C7D90 ZF_kf_si16_S5_S3 2540 UMR_MSEC__10_1_0_S5_S3 0 2540
 /begin AXIS_DESCR STD_AXIS zff_atsys._.iSignale._.obj.sig_n_t UMR_U_MIN_1_1_0_S5_S3 4 0 8160 DEPOSIT ABSOLUTE /end AXIS_DESCR
 /begin AXIS_DESCR STD_AXIS zff_atsys._.iSignale._.obj.sig_m_t UMR_NM__1_1_0_S5_S3 4 -200 1300 DEPOSIT ABSOLUTE /end AXIS_DESCR
/end CHARACTERISTIC
/begin CHARACTERISTIC KF_TSYN_DT_IG_CHANGESP31 "Kennfeld für T_SYN-Vorhalt für Übergabe Synchronrampenzeit" MAP 0x1C8944 ZF_kf_si16_S5_S3 2540 UMR_MSEC__10_1_0_S5_S3 0 2540
 /begin AXIS_DESCR STD_AXIS zff_atsys._.iSignale._.obj.sig_n_t UMR_U_MIN_1_1_0_S5_S3 4 0 8160 DEPOSIT ABSOLUTE /end AXIS_DESCR
 /begin AXIS_DESCR STD_AXIS zff_atsys._.iSignale._.obj.sig_m_t UMR_NM__1_1_0_S5_S3 4 -200 1300 DEPOSIT ABSOLUTE /end AXIS_DESCR
/end CHARACTERISTIC
/begin CHARACTERISTIC KF_TSYN_DT_IG_CHANGESP32 "Kennfeld für T_SYN-Vorhalt für Übergabe Synchronrampenzeit" MAP 0x1C7F3C ZF_kf_si16_S5_S3 2540 UMR_MSEC__10_1_0_S5_S3 0 2540
 /begin AXIS_DESCR STD_AXIS zff_atsys._.iSignale._.obj.sig_n_t UMR_U_MIN_1_1_0_S5_S3 4 0 8160 DEPOSIT ABSOLUTE /end AXIS_DESCR
 /begin AXIS_DESCR STD_AXIS zff_atsys._.iSignale._.obj.sig_m_t UMR_NM__1_1_0_S5_S3 4 -200 1300 DEPOSIT ABSOLUTE /end AXIS_DESCR
/end CHARACTERISTIC
/begin CHARACTERISTIC KF_TSYN_DT_IG_CHANGESP42 "Kennfeld für T_SYN-Vorhalt für Übergabe Synchronrampenzeit" MAP 0x1C8AF0 ZF_kf_si16_S5_S3 2540 UMR_MSEC__10_1_0_S5_S3 0 2540
 /begin AXIS_DESCR STD_AXIS zff_atsys._.iSignale._.obj.sig_n_t UMR_U_MIN_1_1_0_S5_S3 4 0 8160 DEPOSIT ABSOLUTE /end AXIS_DESCR
 /begin AXIS_DESCR STD_AXIS zff_atsys._.iSignale._.obj.sig_m_t UMR_NM__1_1_0_S5_S3 4 -200 1300 DEPOSIT ABSOLUTE /end AXIS_DESCR
/end CHARACTERISTIC
/begin CHARACTERISTIC KF_TSYN_DT_IG_CHANGESP43 "Kennfeld für T_SYN-Vorhalt für Übergabe Synchronrampenzeit" MAP 0x1C80E8 ZF_kf_si16_S5_S3 2540 UMR_MSEC__10_1_0_S5_S3 0 2540
 /begin AXIS_DESCR STD_AXIS zff_atsys._.iSignale._.obj.sig_n_t UMR_U_MIN_1_1_0_S5_S3 4 0 8160 DEPOSIT ABSOLUTE /end AXIS_DESCR
 /begin AXIS_DESCR STD_AXIS zff_atsys._.iSignale._.obj.sig_m_t UMR_NM__1_1_0_S5_S3 4 -200 1300 DEPOSIT ABSOLUTE /end AXIS_DESCR
/end CHARACTERISTIC
/begin CHARACTERISTIC KF_TSYN_DT_IG_CHANGESP51 "Kennfeld für T_SYN-Vorhalt für Übergabe Synchronrampenzeit" MAP 0x1C8C9C ZF_kf_si16_S5_S3 2540 UMR_MSEC__10_1_0_S5_S3 0 2540
 /begin AXIS_DESCR STD_AXIS zff_atsys._.iSignale._.obj.sig_n_t UMR_U_MIN_1_1_0_S5_S3 4 0 8160 DEPOSIT ABSOLUTE /end AXIS_DESCR
 /begin AXIS_DESCR STD_AXIS zff_atsys._.iSignale._.obj.sig_m_t UMR_NM__1_1_0_S5_S3 4 -200 1300 DEPOSIT ABSOLUTE /end AXIS_DESCR
/end CHARACTERISTIC
/begin CHARACTERISTIC KF_TSYN_DT_IG_CHANGESP53 "Kennfeld für T_SYN-Vorhalt für Übergabe Synchronrampenzeit" MAP 0x1C8E48 ZF_kf_si16_S5_S3 2540 UMR_MSEC__10_1_0_S5_S3 0 2540
 /begin AXIS_DESCR STD_AXIS zff_atsys._.iSignale._.obj.sig_n_t UMR_U_MIN_1_1_0_S5_S3 4 0 8160 DEPOSIT ABSOLUTE /end AXIS_DESCR
 /begin AXIS_DESCR STD_AXIS zff_atsys._.iSignale._.obj.sig_m_t UMR_NM__1_1_0_S5_S3 4 -200 1300 DEPOSIT ABSOLUTE /end AXIS_DESCR
/end CHARACTERISTIC
/begin CHARACTERISTIC KF_TSYN_DT_IG_CHANGESP54 "Kennfeld für T_SYN-Vorhalt für Übergabe Synchronrampenzeit" MAP 0x1C8294 ZF_kf_si16_S5_S3 2540 UMR_MSEC__10_1_0_S5_S3 0 2540
 /begin AXIS_DESCR STD_AXIS zff_atsys._.iSignale._.obj.sig_n_t UMR_U_MIN_1_1_0_S5_S3 4 0 8160 DEPOSIT ABSOLUTE /end AXIS_DESCR
 /begin AXIS_DESCR STD_AXIS zff_atsys._.iSignale._.obj.sig_m_t UMR_NM__1_1_0_S5_S3 4 -200 1300 DEPOSIT ABSOLUTE /end AXIS_DESCR
/end CHARACTERISTIC
/begin CHARACTERISTIC KF_TSYN_DT_IG_CHANGESP63 "Kennfeld für T_SYN-Vorhalt für Übergabe Synchronrampenzeit" MAP 0x1C8FF4 ZF_kf_si16_S5_S3 2540 UMR_MSEC__10_1_0_S5_S3 0 2540
 /begin AXIS_DESCR STD_AXIS zff_atsys._.iSignale._.obj.sig_n_t UMR_U_MIN_1_1_0_S5_S3 4 0 8160 DEPOSIT ABSOLUTE /end AXIS_DESCR
 /begin AXIS_DESCR STD_AXIS zff_atsys._.iSignale._.obj.sig_m_t UMR_NM__1_1_0_S5_S3 4 -200 1300 DEPOSIT ABSOLUTE /end AXIS_DESCR
/end CHARACTERISTIC
/begin CHARACTERISTIC KF_TSYN_DT_IG_CHANGESP64 "Kennfeld für T_SYN-Vorhalt für Übergabe Synchronrampenzeit" MAP 0x1C91A0 ZF_kf_si16_S5_S3 2540 UMR_MSEC__10_1_0_S5_S3 0 2540
 /begin AXIS_DESCR STD_AXIS zff_atsys._.iSignale._.obj.sig_n_t UMR_U_MIN_1_1_0_S5_S3 4 0 8160 DEPOSIT ABSOLUTE /end AXIS_DESCR
 /begin AXIS_DESCR STD_AXIS zff_atsys._.iSignale._.obj.sig_m_t UMR_NM__1_1_0_S5_S3 4 -200 1300 DEPOSIT ABSOLUTE /end AXIS_DESCR
/end CHARACTERISTIC
/begin CHARACTERISTIC KF_TSYN_DT_IG_CHANGESP65 "Kennfeld für T_SYN-Vorhalt für Übergabe Synchronrampenzeit" MAP 0x1C8440 ZF_kf_si16_S5_S3 2540 UMR_MSEC__10_1_0_S5_S3 0 2540
 /begin AXIS_DESCR STD_AXIS zff_atsys._.iSignale._.obj.sig_n_t UMR_U_MIN_1_1_0_S5_S3 4 0 8160 DEPOSIT ABSOLUTE /end AXIS_DESCR
 /begin AXIS_DESCR STD_AXIS zff_atsys._.iSignale._.obj.sig_m_t UMR_NM__1_1_0_S5_S3 4 -200 1300 DEPOSIT ABSOLUTE /end AXIS_DESCR
/end CHARACTERISTIC
/begin CHARACTERISTIC KF_TSYN_DT_IG_CHANGESP71 "Kennfeld für T_SYN-Vorhalt für Übergabe Synchronrampenzeit" MAP 0x1C934C ZF_kf_si16_S5_S3 2540 UMR_MSEC__10_1_0_S5_S3 0 2540
 /begin AXIS_DESCR STD_AXIS zff_atsys._.iSignale._.obj.sig_n_t UMR_U_MIN_1_1_0_S5_S3 4 0 8160 DEPOSIT ABSOLUTE /end AXIS_DESCR
 /begin AXIS_DESCR STD_AXIS zff_atsys._.iSignale._.obj.sig_m_t UMR_NM__1_1_0_S5_S3 4 -200 1300 DEPOSIT ABSOLUTE /end AXIS_DESCR
/end CHARACTERISTIC
/begin CHARACTERISTIC KF_TSYN_DT_IG_CHANGESP75 "Kennfeld für T_SYN-Vorhalt für Übergabe Synchronrampenzeit" MAP 0x1C94F8 ZF_kf_si16_S5_S3 2540 UMR_MSEC__10_1_0_S5_S3 0 2540
 /begin AXIS_DESCR STD_AXIS zff_atsys._.iSignale._.obj.sig_n_t UMR_U_MIN_1_1_0_S5_S3 4 0 8160 DEPOSIT ABSOLUTE /end AXIS_DESCR
 /begin AXIS_DESCR STD_AXIS zff_atsys._.iSignale._.obj.sig_m_t UMR_NM__1_1_0_S5_S3 4 -200 1300 DEPOSIT ABSOLUTE /end AXIS_DESCR
/end CHARACTERISTIC
/begin CHARACTERISTIC KF_TSYN_DT_IG_CHANGESP76 "Kennfeld für T_SYN-Vorhalt für Übergabe Synchronrampenzeit" MAP 0x1C85EC ZF_kf_si16_S5_S3 2540 UMR_MSEC__10_1_0_S5_S3 0 2540
 /begin AXIS_DESCR STD_AXIS zff_atsys._.iSignale._.obj.sig_n_t UMR_U_MIN_1_1_0_S5_S3 4 0 8160 DEPOSIT ABSOLUTE /end AXIS_DESCR
 /begin AXIS_DESCR STD_AXIS zff_atsys._.iSignale._.obj.sig_m_t UMR_NM__1_1_0_S5_S3 4 -200 1300 DEPOSIT ABSOLUTE /end AXIS_DESCR
/end CHARACTERISTIC
/begin CHARACTERISTIC KF_TSYN_DT_IG_CHANGESP82 "Kennfeld für T_SYN-Vorhalt für Übergabe Synchronrampenzeit" MAP 0x1C96A4 ZF_kf_si16_S5_S3 2540 UMR_MSEC__10_1_0_S5_S3 0 2540
 /begin AXIS_DESCR STD_AXIS zff_atsys._.iSignale._.obj.sig_n_t UMR_U_MIN_1_1_0_S5_S3 4 0 8160 DEPOSIT ABSOLUTE /end AXIS_DESCR
 /begin AXIS_DESCR STD_AXIS zff_atsys._.iSignale._.obj.sig_m_t UMR_NM__1_1_0_S5_S3 4 -200 1300 DEPOSIT ABSOLUTE /end AXIS_DESCR
/end CHARACTERISTIC
/begin CHARACTERISTIC KF_TSYN_DT_IG_CHANGESP84 "Kennfeld für T_SYN-Vorhalt für Übergabe Synchronrampenzeit" MAP 0x1C9850 ZF_kf_si16_S5_S3 2540 UMR_MSEC__10_1_0_S5_S3 0 2540
 /begin AXIS_DESCR STD_AXIS zff_atsys._.iSignale._.obj.sig_n_t UMR_U_MIN_1_1_0_S5_S3 4 0 8160 DEPOSIT ABSOLUTE /end AXIS_DESCR
 /begin AXIS_DESCR STD_AXIS zff_atsys._.iSignale._.obj.sig_m_t UMR_NM__1_1_0_S5_S3 4 -200 1300 DEPOSIT ABSOLUTE /end AXIS_DESCR
/end CHARACTERISTIC
/begin CHARACTERISTIC KF_TSYN_DT_IG_CHANGESP86 "Kennfeld für T_SYN-Vorhalt für Übergabe Synchronrampenzeit" MAP 0x1C99FC ZF_kf_si16_S5_S3 2540 UMR_MSEC__10_1_0_S5_S3 0 2540
 /begin AXIS_DESCR STD_AXIS zff_atsys._.iSignale._.obj.sig_n_t UMR_U_MIN_1_1_0_S5_S3 4 0 8160 DEPOSIT ABSOLUTE /end AXIS_DESCR
 /begin AXIS_DESCR STD_AXIS zff_atsys._.iSignale._.obj.sig_m_t UMR_NM__1_1_0_S5_S3 4 -200 1300 DEPOSIT ABSOLUTE /end AXIS_DESCR
/end CHARACTERISTIC
/begin CHARACTERISTIC KF_TSYN_DT_IG_CHANGESP87 "Kennfeld für T_SYN-Vorhalt für Übergabe Synchronrampenzeit" MAP 0x1C8798 ZF_kf_si16_S5_S3 2540 UMR_MSEC__10_1_0_S5_S3 0 2540
 /begin AXIS_DESCR STD_AXIS zff_atsys._.iSignale._.obj.sig_n_t UMR_U_MIN_1_1_0_S5_S3 4 0 8160 DEPOSIT ABSOLUTE /end AXIS_DESCR
 /begin AXIS_DESCR STD_AXIS zff_atsys._.iSignale._.obj.sig_m_t UMR_NM__1_1_0_S5_S3 4 -200 1300 DEPOSIT ABSOLUTE /end AXIS_DESCR
/end CHARACTERISTIC
/begin CHARACTERISTIC KF_TSYN_DT_IG_CHANGESPORT21 "Kennfeld für T_SYN-Vorhalt für Übergabe Synchronrampenzeit" MAP 0x1C9BA8 ZF_kf_si16_S5_S3 2540 UMR_MSEC__10_1_0_S5_S3 0 2540
 /begin AXIS_DESCR STD_AXIS zff_atsys._.iSignale._.obj.sig_n_t UMR_U_MIN_1_1_0_S5_S3 4 0 8160 DEPOSIT ABSOLUTE /end AXIS_DESCR
 /begin AXIS_DESCR STD_AXIS zff_atsys._.iSignale._.obj.sig_m_t UMR_NM__1_1_0_S5_S3 4 -200 1300 DEPOSIT ABSOLUTE /end AXIS_DESCR
/end CHARACTERISTIC
/begin CHARACTERISTIC KF_TSYN_DT_IG_CHANGESPORT31 "Kennfeld für T_SYN-Vorhalt für Übergabe Synchronrampenzeit" MAP 0x1CA75C ZF_kf_si16_S5_S3 2540 UMR_MSEC__10_1_0_S5_S3 0 2540
 /begin AXIS_DESCR STD_AXIS zff_atsys._.iSignale._.obj.sig_n_t UMR_U_MIN_1_1_0_S5_S3 4 0 8160 DEPOSIT ABSOLUTE /end AXIS_DESCR
 /begin AXIS_DESCR STD_AXIS zff_atsys._.iSignale._.obj.sig_m_t UMR_NM__1_1_0_S5_S3 4 -200 1300 DEPOSIT ABSOLUTE /end AXIS_DESCR
/end CHARACTERISTIC
/begin CHARACTERISTIC KF_TSYN_DT_IG_CHANGESPORT32 "Kennfeld für T_SYN-Vorhalt für Übergabe Synchronrampenzeit" MAP 0x1C9D54 ZF_kf_si16_S5_S3 2540 UMR_MSEC__10_1_0_S5_S3 0 2540
 /begin AXIS_DESCR STD_AXIS zff_atsys._.iSignale._.obj.sig_n_t UMR_U_MIN_1_1_0_S5_S3 4 0 8160 DEPOSIT ABSOLUTE /end AXIS_DESCR
 /begin AXIS_DESCR STD_AXIS zff_atsys._.iSignale._.obj.sig_m_t UMR_NM__1_1_0_S5_S3 4 -200 1300 DEPOSIT ABSOLUTE /end AXIS_DESCR
/end CHARACTERISTIC
/begin CHARACTERISTIC KF_TSYN_DT_IG_CHANGESPORT42 "Kennfeld für T_SYN-Vorhalt für Übergabe Synchronrampenzeit" MAP 0x1CA908 ZF_kf_si16_S5_S3 2540 UMR_MSEC__10_1_0_S5_S3 0 2540
 /begin AXIS_DESCR STD_AXIS zff_atsys._.iSignale._.obj.sig_n_t UMR_U_MIN_1_1_0_S5_S3 4 0 8160 DEPOSIT ABSOLUTE /end AXIS_DESCR
 /begin AXIS_DESCR STD_AXIS zff_atsys._.iSignale._.obj.sig_m_t UMR_NM__1_1_0_S5_S3 4 -200 1300 DEPOSIT ABSOLUTE /end AXIS_DESCR
/end CHARACTERISTIC
/begin CHARACTERISTIC KF_TSYN_DT_IG_CHANGESPORT43 "Kennfeld für T_SYN-Vorhalt für Übergabe Synchronrampenzeit" MAP 0x1C9F00 ZF_kf_si16_S5_S3 2540 UMR_MSEC__10_1_0_S5_S3 0 2540
 /begin AXIS_DESCR STD_AXIS zff_atsys._.iSignale._.obj.sig_n_t UMR_U_MIN_1_1_0_S5_S3 4 0 8160 DEPOSIT ABSOLUTE /end AXIS_DESCR
 /begin AXIS_DESCR STD_AXIS zff_atsys._.iSignale._.obj.sig_m_t UMR_NM__1_1_0_S5_S3 4 -200 1300 DEPOSIT ABSOLUTE /end AXIS_DESCR
/end CHARACTERISTIC
/begin CHARACTERISTIC KF_TSYN_DT_IG_CHANGESPORT51 "Kennfeld für T_SYN-Vorhalt für Übergabe Synchronrampenzeit" MAP 0x1CAAB4 ZF_kf_si16_S5_S3 2540 UMR_MSEC__10_1_0_S5_S3 0 2540
 /begin AXIS_DESCR STD_AXIS zff_atsys._.iSignale._.obj.sig_n_t UMR_U_MIN_1_1_0_S5_S3 4 0 8160 DEPOSIT ABSOLUTE /end AXIS_DESCR
 /begin AXIS_DESCR STD_AXIS zff_atsys._.iSignale._.obj.sig_m_t UMR_NM__1_1_0_S5_S3 4 -200 1300 DEPOSIT ABSOLUTE /end AXIS_DESCR
/end CHARACTERISTIC
/begin CHARACTERISTIC KF_TSYN_DT_IG_CHANGESPORT53 "Kennfeld für T_SYN-Vorhalt für Übergabe Synchronrampenzeit" MAP 0x1CAC60 ZF_kf_si16_S5_S3 2540 UMR_MSEC__10_1_0_S5_S3 0 2540
 /begin AXIS_DESCR STD_AXIS zff_atsys._.iSignale._.obj.sig_n_t UMR_U_MIN_1_1_0_S5_S3 4 0 8160 DEPOSIT ABSOLUTE /end AXIS_DESCR
 /begin AXIS_DESCR STD_AXIS zff_atsys._.iSignale._.obj.sig_m_t UMR_NM__1_1_0_S5_S3 4 -200 1300 DEPOSIT ABSOLUTE /end AXIS_DESCR
/end CHARACTERISTIC
/begin CHARACTERISTIC KF_TSYN_DT_IG_CHANGESPORT54 "Kennfeld für T_SYN-Vorhalt für Übergabe Synchronrampenzeit" MAP 0x1CA0AC ZF_kf_si16_S5_S3 2540 UMR_MSEC__10_1_0_S5_S3 0 2540
 /begin AXIS_DESCR STD_AXIS zff_atsys._.iSignale._.obj.sig_n_t UMR_U_MIN_1_1_0_S5_S3 4 0 8160 DEPOSIT ABSOLUTE /end AXIS_DESCR
 /begin AXIS_DESCR STD_AXIS zff_atsys._.iSignale._.obj.sig_m_t UMR_NM__1_1_0_S5_S3 4 -200 1300 DEPOSIT ABSOLUTE /end AXIS_DESCR
/end CHARACTERISTIC
/begin CHARACTERISTIC KF_TSYN_DT_IG_CHANGESPORT63 "Kennfeld für T_SYN-Vorhalt für Übergabe Synchronrampenzeit" MAP 0x1CAE0C ZF_kf_si16_S5_S3 2540 UMR_MSEC__10_1_0_S5_S3 0 2540
 /begin AXIS_DESCR STD_AXIS zff_atsys._.iSignale._.obj.sig_n_t UMR_U_MIN_1_1_0_S5_S3 4 0 8160 DEPOSIT ABSOLUTE /end AXIS_DESCR
 /begin AXIS_DESCR STD_AXIS zff_atsys._.iSignale._.obj.sig_m_t UMR_NM__1_1_0_S5_S3 4 -200 1300 DEPOSIT ABSOLUTE /end AXIS_DESCR
/end CHARACTERISTIC
/begin CHARACTERISTIC KF_TSYN_DT_IG_CHANGESPORT64 "Kennfeld für T_SYN-Vorhalt für Übergabe Synchronrampenzeit" MAP 0x1CAFB8 ZF_kf_si16_S5_S3 2540 UMR_MSEC__10_1_0_S5_S3 0 2540
 /begin AXIS_DESCR STD_AXIS zff_atsys._.iSignale._.obj.sig_n_t UMR_U_MIN_1_1_0_S5_S3 4 0 8160 DEPOSIT ABSOLUTE /end AXIS_DESCR
 /begin AXIS_DESCR STD_AXIS zff_atsys._.iSignale._.obj.sig_m_t UMR_NM__1_1_0_S5_S3 4 -200 1300 DEPOSIT ABSOLUTE /end AXIS_DESCR
/end CHARACTERISTIC
/begin CHARACTERISTIC KF_TSYN_DT_IG_CHANGESPORT65 "Kennfeld für T_SYN-Vorhalt für Übergabe Synchronrampenzeit" MAP 0x1CA258 ZF_kf_si16_S5_S3 2540 UMR_MSEC__10_1_0_S5_S3 0 2540
 /begin AXIS_DESCR STD_AXIS zff_atsys._.iSignale._.obj.sig_n_t UMR_U_MIN_1_1_0_S5_S3 4 0 8160 DEPOSIT ABSOLUTE /end AXIS_DESCR
 /begin AXIS_DESCR STD_AXIS zff_atsys._.iSignale._.obj.sig_m_t UMR_NM__1_1_0_S5_S3 4 -200 1300 DEPOSIT ABSOLUTE /end AXIS_DESCR
/end CHARACTERISTIC
/begin CHARACTERISTIC KF_TSYN_DT_IG_CHANGESPORT71 "Kennfeld für T_SYN-Vorhalt für Übergabe Synchronrampenzeit" MAP 0x1CB164 ZF_kf_si16_S5_S3 2540 UMR_MSEC__10_1_0_S5_S3 0 2540
 /begin AXIS_DESCR STD_AXIS zff_atsys._.iSignale._.obj.sig_n_t UMR_U_MIN_1_1_0_S5_S3 4 0 8160 DEPOSIT ABSOLUTE /end AXIS_DESCR
 /begin AXIS_DESCR STD_AXIS zff_atsys._.iSignale._.obj.sig_m_t UMR_NM__1_1_0_S5_S3 4 -200 1300 DEPOSIT ABSOLUTE /end AXIS_DESCR
/end CHARACTERISTIC
/begin CHARACTERISTIC KF_TSYN_DT_IG_CHANGESPORT75 "Kennfeld für T_SYN-Vorhalt für Übergabe Synchronrampenzeit" MAP 0x1CB310 ZF_kf_si16_S5_S3 2540 UMR_MSEC__10_1_0_S5_S3 0 2540
 /begin AXIS_DESCR STD_AXIS zff_atsys._.iSignale._.obj.sig_n_t UMR_U_MIN_1_1_0_S5_S3 4 0 8160 DEPOSIT ABSOLUTE /end AXIS_DESCR
 /begin AXIS_DESCR STD_AXIS zff_atsys._.iSignale._.obj.sig_m_t UMR_NM__1_1_0_S5_S3 4 -200 1300 DEPOSIT ABSOLUTE /end AXIS_DESCR
/end CHARACTERISTIC
/begin CHARACTERISTIC KF_TSYN_DT_IG_CHANGESPORT76 "Kennfeld für T_SYN-Vorhalt für Übergabe Synchronrampenzeit" MAP 0x1CA404 ZF_kf_si16_S5_S3 2540 UMR_MSEC__10_1_0_S5_S3 0 2540
 /begin AXIS_DESCR STD_AXIS zff_atsys._.iSignale._.obj.sig_n_t UMR_U_MIN_1_1_0_S5_S3 4 0 8160 DEPOSIT ABSOLUTE /end AXIS_DESCR
 /begin AXIS_DESCR STD_AXIS zff_atsys._.iSignale._.obj.sig_m_t UMR_NM__1_1_0_S5_S3 4 -200 1300 DEPOSIT ABSOLUTE /end AXIS_DESCR
/end CHARACTERISTIC
/begin CHARACTERISTIC KF_TSYN_DT_IG_CHANGESPORT82 "Kennfeld für T_SYN-Vorhalt für Übergabe Synchronrampenzeit" MAP 0x1CB4BC ZF_kf_si16_S5_S3 2540 UMR_MSEC__10_1_0_S5_S3 0 2540
 /begin AXIS_DESCR STD_AXIS zff_atsys._.iSignale._.obj.sig_n_t UMR_U_MIN_1_1_0_S5_S3 4 0 8160 DEPOSIT ABSOLUTE /end AXIS_DESCR
 /begin AXIS_DESCR STD_AXIS zff_atsys._.iSignale._.obj.sig_m_t UMR_NM__1_1_0_S5_S3 4 -200 1300 DEPOSIT ABSOLUTE /end AXIS_DESCR
/end CHARACTERISTIC
/begin CHARACTERISTIC KF_TSYN_DT_IG_CHANGESPORT84 "Kennfeld für T_SYN-Vorhalt für Übergabe Synchronrampenzeit" MAP 0x1CB668 ZF_kf_si16_S5_S3 2540 UMR_MSEC__10_1_0_S5_S3 0 2540
 /begin AXIS_DESCR STD_AXIS zff_atsys._.iSignale._.obj.sig_n_t UMR_U_MIN_1_1_0_S5_S3 4 0 8160 DEPOSIT ABSOLUTE /end AXIS_DESCR
 /begin AXIS_DESCR STD_AXIS zff_atsys._.iSignale._.obj.sig_m_t UMR_NM__1_1_0_S5_S3 4 -200 1300 DEPOSIT ABSOLUTE /end AXIS_DESCR
/end CHARACTERISTIC
/begin CHARACTERISTIC KF_TSYN_DT_IG_CHANGESPORT86 "Kennfeld für T_SYN-Vorhalt für Übergabe Synchronrampenzeit" MAP 0x1CB814 ZF_kf_si16_S5_S3 2540 UMR_MSEC__10_1_0_S5_S3 0 2540
 /begin AXIS_DESCR STD_AXIS zff_atsys._.iSignale._.obj.sig_n_t UMR_U_MIN_1_1_0_S5_S3 4 0 8160 DEPOSIT ABSOLUTE /end AXIS_DESCR
 /begin AXIS_DESCR STD_AXIS zff_atsys._.iSignale._.obj.sig_m_t UMR_NM__1_1_0_S5_S3 4 -200 1300 DEPOSIT ABSOLUTE /end AXIS_DESCR
/end CHARACTERISTIC
/begin CHARACTERISTIC KF_TSYN_DT_IG_CHANGESPORT87 "Kennfeld für T_SYN-Vorhalt für Übergabe Synchronrampenzeit" MAP 0x1CA5B0 ZF_kf_si16_S5_S3 2540 UMR_MSEC__10_1_0_S5_S3 0 2540
 /begin AXIS_DESCR STD_AXIS zff_atsys._.iSignale._.obj.sig_n_t UMR_U_MIN_1_1_0_S5_S3 4 0 8160 DEPOSIT ABSOLUTE /end AXIS_DESCR
 /begin AXIS_DESCR STD_AXIS zff_atsys._.iSignale._.obj.sig_m_t UMR_NM__1_1_0_S5_S3 4 -200 1300 DEPOSIT ABSOLUTE /end AXIS_DESCR
/end CHARACTERISTIC
/begin CHARACTERISTIC KL_PGOKZU21 "Druckgradient in Abhaengigkeit von m_t" CURVE 0x1CB8D8 ZF_kl_si16_S5_S3 200 UMR_BAR_SEC_1_10_0_S5_S3 -100 100
 /begin AXIS_DESCR STD_AXIS zff_atsys._.iSignale._.obj.sig_m_t UMR_NM__1_1_0_S5_S3 6 -200 1300 DEPOSIT ABSOLUTE /end AXIS_DESCR
/end CHARACTERISTIC
/begin CHARACTERISTIC KL_PGOKZU32 "Druckgradient in Abhaengigkeit von m_t" CURVE 0x1CBB24 ZF_kl_si16_S5_S3 200 UMR_BAR_SEC_1_10_0_S5_S3 -100 100
 /begin AXIS_DESCR STD_AXIS zff_atsys._.iSignale._.obj.sig_m_t UMR_NM__1_1_0_S5_S3 6 -200 1300 DEPOSIT ABSOLUTE /end AXIS_DESCR
/end CHARACTERISTIC
/begin CHARACTERISTIC KL_PGOKZU43 "Druckgradient in Abhaengigkeit von m_t" CURVE 0x1CBD70 ZF_kl_si16_S5_S3 200 UMR_BAR_SEC_1_10_0_S5_S3 -100 100
 /begin AXIS_DESCR STD_AXIS zff_atsys._.iSignale._.obj.sig_m_t UMR_NM__1_1_0_S5_S3 6 -200 1300 DEPOSIT ABSOLUTE /end AXIS_DESCR
/end CHARACTERISTIC
/begin CHARACTERISTIC KL_PGOKZU54 "Druckgradient in Abhaengigkeit von m_t" CURVE 0x1CBFBC ZF_kl_si16_S5_S3 200 UMR_BAR_SEC_1_10_0_S5_S3 -100 100
 /begin AXIS_DESCR STD_AXIS zff_atsys._.iSignale._.obj.sig_m_t UMR_NM__1_1_0_S5_S3 6 -200 1300 DEPOSIT ABSOLUTE /end AXIS_DESCR
/end CHARACTERISTIC
/begin CHARACTERISTIC KL_PGOKZUSP31 "Druckgradient in Abhaengigkeit von m_t" CURVE 0x1CC8EC ZF_kl_si16_S5_S3 200 UMR_BAR_SEC_1_10_0_S5_S3 -100 100
 /begin AXIS_DESCR STD_AXIS zff_atsys._.iSignale._.obj.sig_m_t UMR_NM__1_1_0_S5_S3 6 -200 1300 DEPOSIT ABSOLUTE /end AXIS_DESCR
/end CHARACTERISTIC
/begin CHARACTERISTIC KL_PGOKZUSP42 "Druckgradient in Abhaengigkeit von m_t" CURVE 0x1CCB38 ZF_kl_si16_S5_S3 200 UMR_BAR_SEC_1_10_0_S5_S3 -100 100
 /begin AXIS_DESCR STD_AXIS zff_atsys._.iSignale._.obj.sig_m_t UMR_NM__1_1_0_S5_S3 6 -200 1300 DEPOSIT ABSOLUTE /end AXIS_DESCR
/end CHARACTERISTIC
/begin CHARACTERISTIC KL_PGOKZUSP51 "Druckgradient in Abhaengigkeit von m_t" CURVE 0x1CCD84 ZF_kl_si16_S5_S3 200 UMR_BAR_SEC_1_10_0_S5_S3 -100 100
 /begin AXIS_DESCR STD_AXIS zff_atsys._.iSignale._.obj.sig_m_t UMR_NM__1_1_0_S5_S3 6 -200 1300 DEPOSIT ABSOLUTE /end AXIS_DESCR
/end CHARACTERISTIC
/begin CHARACTERISTIC KL_PGOKZUSP53 "Druckgradient in Abhaengigkeit von m_t" CURVE 0x1CCFD0 ZF_kl_si16_S5_S3 200 UMR_BAR_SEC_1_10_0_S5_S3 -100 100
 /begin AXIS_DESCR STD_AXIS zff_atsys._.iSignale._.obj.sig_m_t UMR_NM__1_1_0_S5_S3 6 -200 1300 DEPOSIT ABSOLUTE /end AXIS_DESCR
/end CHARACTERISTIC
/begin CHARACTERISTIC KL_PGOKZUSP63 "Druckgradient in Abhaengigkeit von m_t" CURVE 0x1CD21C ZF_kl_si16_S5_S3 200 UMR_BAR_SEC_1_10_0_S5_S3 -100 100
 /begin AXIS_DESCR STD_AXIS zff_atsys._.iSignale._.obj.sig_m_t UMR_NM__1_1_0_S5_S3 6 -200 1300 DEPOSIT ABSOLUTE /end AXIS_DESCR
/end CHARACTERISTIC
/begin CHARACTERISTIC KL_PGOKZUWS21 "Druckgradient in Abhaengigkeit von m_t" CURVE 0x1CB8F4 ZF_kl_si16_S5_S3 200 UMR_BAR_SEC_1_10_0_S5_S3 -100 100
 /begin AXIS_DESCR STD_AXIS zff_atsys._.iSignale._.obj.sig_m_t UMR_NM__1_1_0_S5_S3 6 -200 1300 DEPOSIT ABSOLUTE /end AXIS_DESCR
/end CHARACTERISTIC
/begin CHARACTERISTIC KL_PGOKZUWS32 "Druckgradient in Abhaengigkeit von m_t" CURVE 0x1CBB40 ZF_kl_si16_S5_S3 200 UMR_BAR_SEC_1_10_0_S5_S3 -100 100
 /begin AXIS_DESCR STD_AXIS zff_atsys._.iSignale._.obj.sig_m_t UMR_NM__1_1_0_S5_S3 6 -200 1300 DEPOSIT ABSOLUTE /end AXIS_DESCR
/end CHARACTERISTIC
/begin CHARACTERISTIC KL_PGOKZUWS43 "Druckgradient in Abhaengigkeit von m_t" CURVE 0x1CBD8C ZF_kl_si16_S5_S3 200 UMR_BAR_SEC_1_10_0_S5_S3 -100 100
 /begin AXIS_DESCR STD_AXIS zff_atsys._.iSignale._.obj.sig_m_t UMR_NM__1_1_0_S5_S3 6 -200 1300 DEPOSIT ABSOLUTE /end AXIS_DESCR
/end CHARACTERISTIC
/begin CHARACTERISTIC KL_PGOKZUWS54 "Druckgradient in Abhaengigkeit von m_t" CURVE 0x1CBFD8 ZF_kl_si16_S5_S3 200 UMR_BAR_SEC_1_10_0_S5_S3 -100 100
 /begin AXIS_DESCR STD_AXIS zff_atsys._.iSignale._.obj.sig_m_t UMR_NM__1_1_0_S5_S3 6 -200 1300 DEPOSIT ABSOLUTE /end AXIS_DESCR
/end CHARACTERISTIC
/begin CHARACTERISTIC KL_PGOKZUWSSP31 "Druckgradient in Abhaengigkeit von m_t" CURVE 0x1CC908 ZF_kl_si16_S5_S3 200 UMR_BAR_SEC_1_10_0_S5_S3 -100 100
 /begin AXIS_DESCR STD_AXIS zff_atsys._.iSignale._.obj.sig_m_t UMR_NM__1_1_0_S5_S3 6 -200 1300 DEPOSIT ABSOLUTE /end AXIS_DESCR
/end CHARACTERISTIC
/begin CHARACTERISTIC KL_PGOKZUWSSP42 "Druckgradient in Abhaengigkeit von m_t" CURVE 0x1CCB54 ZF_kl_si16_S5_S3 200 UMR_BAR_SEC_1_10_0_S5_S3 -100 100
 /begin AXIS_DESCR STD_AXIS zff_atsys._.iSignale._.obj.sig_m_t UMR_NM__1_1_0_S5_S3 6 -200 1300 DEPOSIT ABSOLUTE /end AXIS_DESCR
/end CHARACTERISTIC
/begin CHARACTERISTIC KL_PGOKZUWSSP51 "Druckgradient in Abhaengigkeit von m_t" CURVE 0x1CCDA0 ZF_kl_si16_S5_S3 200 UMR_BAR_SEC_1_10_0_S5_S3 -100 100
 /begin AXIS_DESCR STD_AXIS zff_atsys._.iSignale._.obj.sig_m_t UMR_NM__1_1_0_S5_S3 6 -200 1300 DEPOSIT ABSOLUTE /end AXIS_DESCR
/end CHARACTERISTIC
/begin CHARACTERISTIC KL_PGOKZUWSSP53 "Druckgradient in Abhaengigkeit von m_t" CURVE 0x1CCFEC ZF_kl_si16_S5_S3 200 UMR_BAR_SEC_1_10_0_S5_S3 -100 100
 /begin AXIS_DESCR STD_AXIS zff_atsys._.iSignale._.obj.sig_m_t UMR_NM__1_1_0_S5_S3 6 -200 1300 DEPOSIT ABSOLUTE /end AXIS_DESCR
/end CHARACTERISTIC
/begin CHARACTERISTIC KL_PGOKZUWSSP63 "Druckgradient in Abhaengigkeit von m_t" CURVE 0x1CD238 ZF_kl_si16_S5_S3 200 UMR_BAR_SEC_1_10_0_S5_S3 -100 100
 /begin AXIS_DESCR STD_AXIS zff_atsys._.iSignale._.obj.sig_m_t UMR_NM__1_1_0_S5_S3 6 -200 1300 DEPOSIT ABSOLUTE /end AXIS_DESCR
/end CHARACTERISTIC
/begin CHARACTERISTIC KL_PGRASYN21 "Schliessrampenradient" CURVE 0x1CB910 ZF_kl_si16_S5_S3 6553.4 UMR_BAR_SEC_1_10_0_S5_S3 -3276.7 3276.7
 /begin AXIS_DESCR STD_AXIS zff_atsys._.iSignale._.obj.sig_m_t UMR_NM__1_1_0_S5_S3 6 -200 1300 DEPOSIT ABSOLUTE /end AXIS_DESCR
/end CHARACTERISTIC
/begin CHARACTERISTIC KL_PGRASYN32 "Schliessrampenradient" CURVE 0x1CBB5C ZF_kl_si16_S5_S3 6553.4 UMR_BAR_SEC_1_10_0_S5_S3 -3276.7 3276.7
 /begin AXIS_DESCR STD_AXIS zff_atsys._.iSignale._.obj.sig_m_t UMR_NM__1_1_0_S5_S3 6 -200 1300 DEPOSIT ABSOLUTE /end AXIS_DESCR
/end CHARACTERISTIC
/begin CHARACTERISTIC KL_PGRASYN43 "Schliessrampenradient" CURVE 0x1CBDA8 ZF_kl_si16_S5_S3 6553.4 UMR_BAR_SEC_1_10_0_S5_S3 -3276.7 3276.7
 /begin AXIS_DESCR STD_AXIS zff_atsys._.iSignale._.obj.sig_m_t UMR_NM__1_1_0_S5_S3 6 -200 1300 DEPOSIT ABSOLUTE /end AXIS_DESCR
/end CHARACTERISTIC
/begin CHARACTERISTIC KL_PGRASYN54 "Schliessrampenradient" CURVE 0x1CBFF4 ZF_kl_si16_S5_S3 6553.4 UMR_BAR_SEC_1_10_0_S5_S3 -3276.7 3276.7
 /begin AXIS_DESCR STD_AXIS zff_atsys._.iSignale._.obj.sig_m_t UMR_NM__1_1_0_S5_S3 6 -200 1300 DEPOSIT ABSOLUTE /end AXIS_DESCR
/end CHARACTERISTIC
/begin CHARACTERISTIC KL_PGRASYNSP31 "Schliessrampenradient" CURVE 0x1CC924 ZF_kl_si16_S5_S3 6553.4 UMR_BAR_SEC_1_10_0_S5_S3 -3276.7 3276.7
 /begin AXIS_DESCR STD_AXIS zff_atsys._.iSignale._.obj.sig_m_t UMR_NM__1_1_0_S5_S3 6 -200 1300 DEPOSIT ABSOLUTE /end AXIS_DESCR
/end CHARACTERISTIC
/begin CHARACTERISTIC KL_PGRASYNSP42 "Schliessrampenradient" CURVE 0x1CCB70 ZF_kl_si16_S5_S3 6553.4 UMR_BAR_SEC_1_10_0_S5_S3 -3276.7 3276.7
 /begin AXIS_DESCR STD_AXIS zff_atsys._.iSignale._.obj.sig_m_t UMR_NM__1_1_0_S5_S3 6 -200 1300 DEPOSIT ABSOLUTE /end AXIS_DESCR
/end CHARACTERISTIC
/begin CHARACTERISTIC KL_PGRASYNSP51 "Schliessrampenradient" CURVE 0x1CCDBC ZF_kl_si16_S5_S3 6553.4 UMR_BAR_SEC_1_10_0_S5_S3 -3276.7 3276.7
 /begin AXIS_DESCR STD_AXIS zff_atsys._.iSignale._.obj.sig_m_t UMR_NM__1_1_0_S5_S3 6 -200 1300 DEPOSIT ABSOLUTE /end AXIS_DESCR
/end CHARACTERISTIC
/begin CHARACTERISTIC KL_PGRASYNSP53 "Schliessrampenradient" CURVE 0x1CD008 ZF_kl_si16_S5_S3 6553.4 UMR_BAR_SEC_1_10_0_S5_S3 -3276.7 3276.7
 /begin AXIS_DESCR STD_AXIS zff_atsys._.iSignale._.obj.sig_m_t UMR_NM__1_1_0_S5_S3 6 -200 1300 DEPOSIT ABSOLUTE /end AXIS_DESCR
/end CHARACTERISTIC
/begin CHARACTERISTIC KL_PGRASYNSP63 "Schliessrampenradient" CURVE 0x1CD254 ZF_kl_si16_S5_S3 6553.4 UMR_BAR_SEC_1_10_0_S5_S3 -3276.7 3276.7
 /begin AXIS_DESCR STD_AXIS zff_atsys._.iSignale._.obj.sig_m_t UMR_NM__1_1_0_S5_S3 6 -200 1300 DEPOSIT ABSOLUTE /end AXIS_DESCR
/end CHARACTERISTIC
/begin CHARACTERISTIC KL_POFCG21 "Kennlinie Fuelldruckoffset" CURVE 0x1CB878 ZF_kl_si16_S5_S3 12.75 UMR_BAR__1_1000_0_S5_S3 -6.4 6.35
 /begin AXIS_DESCR STD_AXIS zff_atsys._.iSignale._.obj.sig_c_getr UMR_GRADC__1_1_M40_S5_S3 10 -40 150 DEPOSIT ABSOLUTE /end AXIS_DESCR
/end CHARACTERISTIC
/begin CHARACTERISTIC KL_POFCG32 "Kennlinie Fuelldruckoffset" CURVE 0x1CBAC4 ZF_kl_si16_S5_S3 12.75 UMR_BAR__1_1000_0_S5_S3 -6.4 6.35
 /begin AXIS_DESCR STD_AXIS zff_atsys._.iSignale._.obj.sig_c_getr UMR_GRADC__1_1_M40_S5_S3 10 -40 150 DEPOSIT ABSOLUTE /end AXIS_DESCR
/end CHARACTERISTIC
/begin CHARACTERISTIC KL_POFCG43 "Kennlinie Fuelldruckoffset" CURVE 0x1CBD10 ZF_kl_si16_S5_S3 12.75 UMR_BAR__1_1000_0_S5_S3 -6.4 6.35
 /begin AXIS_DESCR STD_AXIS zff_atsys._.iSignale._.obj.sig_c_getr UMR_GRADC__1_1_M40_S5_S3 10 -40 150 DEPOSIT ABSOLUTE /end AXIS_DESCR
/end CHARACTERISTIC
/begin CHARACTERISTIC KL_POFCG54 "Kennlinie Fuelldruckoffset" CURVE 0x1CBF5C ZF_kl_si16_S5_S3 12.75 UMR_BAR__1_1000_0_S5_S3 -6.4 6.35
 /begin AXIS_DESCR STD_AXIS zff_atsys._.iSignale._.obj.sig_c_getr UMR_GRADC__1_1_M40_S5_S3 10 -40 150 DEPOSIT ABSOLUTE /end AXIS_DESCR
/end CHARACTERISTIC
/begin CHARACTERISTIC KL_POFCGSP31 "Kennlinie Fuelldruckoffset" CURVE 0x1CC88C ZF_kl_si16_S5_S3 12.75 UMR_BAR__1_1000_0_S5_S3 -6.4 6.35
 /begin AXIS_DESCR STD_AXIS zff_atsys._.iSignale._.obj.sig_c_getr UMR_GRADC__1_1_M40_S5_S3 10 -40 150 DEPOSIT ABSOLUTE /end AXIS_DESCR
/end CHARACTERISTIC
/begin CHARACTERISTIC KL_POFCGSP42 "Kennlinie Fuelldruckoffset" CURVE 0x1CCAD8 ZF_kl_si16_S5_S3 12.75 UMR_BAR__1_1000_0_S5_S3 -6.4 6.35
 /begin AXIS_DESCR STD_AXIS zff_atsys._.iSignale._.obj.sig_c_getr UMR_GRADC__1_1_M40_S5_S3 10 -40 150 DEPOSIT ABSOLUTE /end AXIS_DESCR
/end CHARACTERISTIC
/begin CHARACTERISTIC KL_POFCGSP51 "Kennlinie Fuelldruckoffset" CURVE 0x1CCD24 ZF_kl_si16_S5_S3 12.75 UMR_BAR__1_1000_0_S5_S3 -6.4 6.35
 /begin AXIS_DESCR STD_AXIS zff_atsys._.iSignale._.obj.sig_c_getr UMR_GRADC__1_1_M40_S5_S3 10 -40 150 DEPOSIT ABSOLUTE /end AXIS_DESCR
/end CHARACTERISTIC
/begin CHARACTERISTIC KL_POFCGSP53 "Kennlinie Fuelldruckoffset" CURVE 0x1CCF70 ZF_kl_si16_S5_S3 12.75 UMR_BAR__1_1000_0_S5_S3 -6.4 6.35
 /begin AXIS_DESCR STD_AXIS zff_atsys._.iSignale._.obj.sig_c_getr UMR_GRADC__1_1_M40_S5_S3 10 -40 150 DEPOSIT ABSOLUTE /end AXIS_DESCR
/end CHARACTERISTIC
/begin CHARACTERISTIC KL_POFCGSP63 "Kennlinie Fuelldruckoffset" CURVE 0x1CD1BC ZF_kl_si16_S5_S3 12.75 UMR_BAR__1_1000_0_S5_S3 -6.4 6.35
 /begin AXIS_DESCR STD_AXIS zff_atsys._.iSignale._.obj.sig_c_getr UMR_GRADC__1_1_M40_S5_S3 10 -40 150 DEPOSIT ABSOLUTE /end AXIS_DESCR
/end CHARACTERISTIC
/begin CHARACTERISTIC KL_POFMDMOTSOLL21 "Fuelldruckoffset f(Erhoehung Motorsollmoment)" CURVE 0x1CBA60 ZF_kl_si16_S5_S3 12.75 UMR_BAR__1_1000_0_S5_S3 -6.4 6.35
 /begin AXIS_DESCR STD_AXIS NO_INPUT_QUANTITY UMR_NM__1_1_0_S5_S3 6 -1500 1500 DEPOSIT ABSOLUTE /end AXIS_DESCR
/end CHARACTERISTIC
/begin CHARACTERISTIC KL_POFMDMOTSOLL32 "Fuelldruckoffset f(Erhoehung Motorsollmoment)" CURVE 0x1CBCAC ZF_kl_si16_S5_S3 12.75 UMR_BAR__1_1000_0_S5_S3 -6.4 6.35
 /begin AXIS_DESCR STD_AXIS NO_INPUT_QUANTITY UMR_NM__1_1_0_S5_S3 6 -1500 1500 DEPOSIT ABSOLUTE /end AXIS_DESCR
/end CHARACTERISTIC
/begin CHARACTERISTIC KL_POFMDMOTSOLL43 "Fuelldruckoffset f(Erhoehung Motorsollmoment)" CURVE 0x1CBEF8 ZF_kl_si16_S5_S3 12.75 UMR_BAR__1_1000_0_S5_S3 -6.4 6.35
 /begin AXIS_DESCR STD_AXIS NO_INPUT_QUANTITY UMR_NM__1_1_0_S5_S3 6 -1500 1500 DEPOSIT ABSOLUTE /end AXIS_DESCR
/end CHARACTERISTIC
/begin CHARACTERISTIC KL_POFMDMOTSOLL54 "Fuelldruckoffset f(Erhoehung Motorsollmoment)" CURVE 0x1CC144 ZF_kl_si16_S5_S3 12.75 UMR_BAR__1_1000_0_S5_S3 -6.4 6.35
 /begin AXIS_DESCR STD_AXIS NO_INPUT_QUANTITY UMR_NM__1_1_0_S5_S3 6 -1500 1500 DEPOSIT ABSOLUTE /end AXIS_DESCR
/end CHARACTERISTIC
/begin CHARACTERISTIC KL_POFMDMOTSOLLSP31 "Fuelldruckoffset f(Erhoehung Motorsollmoment)" CURVE 0x1CCA74 ZF_kl_si16_S5_S3 12.75 UMR_BAR__1_1000_0_S5_S3 -6.4 6.35
 /begin AXIS_DESCR STD_AXIS NO_INPUT_QUANTITY UMR_NM__1_1_0_S5_S3 6 -1500 1500 DEPOSIT ABSOLUTE /end AXIS_DESCR
/end CHARACTERISTIC
/begin CHARACTERISTIC KL_POFMDMOTSOLLSP42 "Fuelldruckoffset f(Erhoehung Motorsollmoment)" CURVE 0x1CCCC0 ZF_kl_si16_S5_S3 12.75 UMR_BAR__1_1000_0_S5_S3 -6.4 6.35
 /begin AXIS_DESCR STD_AXIS NO_INPUT_QUANTITY UMR_NM__1_1_0_S5_S3 6 -1500 1500 DEPOSIT ABSOLUTE /end AXIS_DESCR
/end CHARACTERISTIC
/begin CHARACTERISTIC KL_POFMDMOTSOLLSP51 "Fuelldruckoffset f(Erhoehung Motorsollmoment)" CURVE 0x1CCF0C ZF_kl_si16_S5_S3 12.75 UMR_BAR__1_1000_0_S5_S3 -6.4 6.35
 /begin AXIS_DESCR STD_AXIS NO_INPUT_QUANTITY UMR_NM__1_1_0_S5_S3 6 -1500 1500 DEPOSIT ABSOLUTE /end AXIS_DESCR
/end CHARACTERISTIC
/begin CHARACTERISTIC KL_POFMDMOTSOLLSP53 "Fuelldruckoffset f(Erhoehung Motorsollmoment)" CURVE 0x1CD158 ZF_kl_si16_S5_S3 12.75 UMR_BAR__1_1000_0_S5_S3 -6.4 6.35
 /begin AXIS_DESCR STD_AXIS NO_INPUT_QUANTITY UMR_NM__1_1_0_S5_S3 6 -1500 1500 DEPOSIT ABSOLUTE /end AXIS_DESCR
/end CHARACTERISTIC
/begin CHARACTERISTIC KL_POFMDMOTSOLLSP63 "Fuelldruckoffset f(Erhoehung Motorsollmoment)" CURVE 0x1CD3A4 ZF_kl_si16_S5_S3 12.75 UMR_BAR__1_1000_0_S5_S3 -6.4 6.35
 /begin AXIS_DESCR STD_AXIS NO_INPUT_QUANTITY UMR_NM__1_1_0_S5_S3 6 -1500 1500 DEPOSIT ABSOLUTE /end AXIS_DESCR
/end CHARACTERISTIC
/begin CHARACTERISTIC KL_POKZUCG21 "Schaltdruckoffset" CURVE 0x1CB84C ZF_kl_si16_S5_S3 12.75 UMR_BAR__1_1000_0_S5_S3 -6.4 6.35
 /begin AXIS_DESCR STD_AXIS zff_atsys._.iSignale._.obj.sig_c_getr UMR_GRADC__1_1_M40_S5_S3 10 -40 150 DEPOSIT ABSOLUTE /end AXIS_DESCR
/end CHARACTERISTIC
/begin CHARACTERISTIC KL_POKZUCG32 "Schaltdruckoffset" CURVE 0x1CBA98 ZF_kl_si16_S5_S3 12.75 UMR_BAR__1_1000_0_S5_S3 -6.4 6.35
 /begin AXIS_DESCR STD_AXIS zff_atsys._.iSignale._.obj.sig_c_getr UMR_GRADC__1_1_M40_S5_S3 10 -40 150 DEPOSIT ABSOLUTE /end AXIS_DESCR
/end CHARACTERISTIC
/begin CHARACTERISTIC KL_POKZUCG43 "Schaltdruckoffset" CURVE 0x1CBCE4 ZF_kl_si16_S5_S3 12.75 UMR_BAR__1_1000_0_S5_S3 -6.4 6.35
 /begin AXIS_DESCR STD_AXIS zff_atsys._.iSignale._.obj.sig_c_getr UMR_GRADC__1_1_M40_S5_S3 10 -40 150 DEPOSIT ABSOLUTE /end AXIS_DESCR
/end CHARACTERISTIC
/begin CHARACTERISTIC KL_POKZUCG54 "Schaltdruckoffset" CURVE 0x1CBF30 ZF_kl_si16_S5_S3 12.75 UMR_BAR__1_1000_0_S5_S3 -6.4 6.35
 /begin AXIS_DESCR STD_AXIS zff_atsys._.iSignale._.obj.sig_c_getr UMR_GRADC__1_1_M40_S5_S3 10 -40 150 DEPOSIT ABSOLUTE /end AXIS_DESCR
/end CHARACTERISTIC
/begin CHARACTERISTIC KL_POKZUCGSP31 "Schaltdruckoffset" CURVE 0x1CC860 ZF_kl_si16_S5_S3 12.75 UMR_BAR__1_1000_0_S5_S3 -6.4 6.35
 /begin AXIS_DESCR STD_AXIS zff_atsys._.iSignale._.obj.sig_c_getr UMR_GRADC__1_1_M40_S5_S3 10 -40 150 DEPOSIT ABSOLUTE /end AXIS_DESCR
/end CHARACTERISTIC
/begin CHARACTERISTIC KL_POKZUCGSP42 "Schaltdruckoffset" CURVE 0x1CCAAC ZF_kl_si16_S5_S3 12.75 UMR_BAR__1_1000_0_S5_S3 -6.4 6.35
 /begin AXIS_DESCR STD_AXIS zff_atsys._.iSignale._.obj.sig_c_getr UMR_GRADC__1_1_M40_S5_S3 10 -40 150 DEPOSIT ABSOLUTE /end AXIS_DESCR
/end CHARACTERISTIC
/begin CHARACTERISTIC KL_POKZUCGSP51 "Schaltdruckoffset" CURVE 0x1CCCF8 ZF_kl_si16_S5_S3 12.75 UMR_BAR__1_1000_0_S5_S3 -6.4 6.35
 /begin AXIS_DESCR STD_AXIS zff_atsys._.iSignale._.obj.sig_c_getr UMR_GRADC__1_1_M40_S5_S3 10 -40 150 DEPOSIT ABSOLUTE /end AXIS_DESCR
/end CHARACTERISTIC
/begin CHARACTERISTIC KL_POKZUCGSP53 "Schaltdruckoffset" CURVE 0x1CCF44 ZF_kl_si16_S5_S3 12.75 UMR_BAR__1_1000_0_S5_S3 -6.4 6.35
 /begin AXIS_DESCR STD_AXIS zff_atsys._.iSignale._.obj.sig_c_getr UMR_GRADC__1_1_M40_S5_S3 10 -40 150 DEPOSIT ABSOLUTE /end AXIS_DESCR
/end CHARACTERISTIC
/begin CHARACTERISTIC KL_POKZUCGSP63 "Schaltdruckoffset" CURVE 0x1CD190 ZF_kl_si16_S5_S3 12.75 UMR_BAR__1_1000_0_S5_S3 -6.4 6.35
 /begin AXIS_DESCR STD_AXIS zff_atsys._.iSignale._.obj.sig_c_getr UMR_GRADC__1_1_M40_S5_S3 10 -40 150 DEPOSIT ABSOLUTE /end AXIS_DESCR
/end CHARACTERISTIC
/begin CHARACTERISTIC KL_POKZUMDMOTSOLL21 "Schaltdruckoffset in Abhaengigkeit von md_motsoll_sas" CURVE 0x1CBA7C ZF_kl_si16_S5_S3 12.75 UMR_BAR__1_1000_0_S5_S3 -6.4 6.35
 /begin AXIS_DESCR STD_AXIS NO_INPUT_QUANTITY UMR_NM__1_1_0_S5_S3 6 -1500 1500 DEPOSIT ABSOLUTE /end AXIS_DESCR
/end CHARACTERISTIC
/begin CHARACTERISTIC KL_POKZUMDMOTSOLL32 "Schaltdruckoffset in Abhaengigkeit von md_motsoll_sas" CURVE 0x1CBCC8 ZF_kl_si16_S5_S3 12.75 UMR_BAR__1_1000_0_S5_S3 -6.4 6.35
 /begin AXIS_DESCR STD_AXIS NO_INPUT_QUANTITY UMR_NM__1_1_0_S5_S3 6 -1500 1500 DEPOSIT ABSOLUTE /end AXIS_DESCR
/end CHARACTERISTIC
/begin CHARACTERISTIC KL_POKZUMDMOTSOLL43 "Schaltdruckoffset in Abhaengigkeit von md_motsoll_sas" CURVE 0x1CBF14 ZF_kl_si16_S5_S3 12.75 UMR_BAR__1_1000_0_S5_S3 -6.4 6.35
 /begin AXIS_DESCR STD_AXIS NO_INPUT_QUANTITY UMR_NM__1_1_0_S5_S3 6 -1500 1500 DEPOSIT ABSOLUTE /end AXIS_DESCR
/end CHARACTERISTIC
/begin CHARACTERISTIC KL_POKZUMDMOTSOLL54 "Schaltdruckoffset in Abhaengigkeit von md_motsoll_sas" CURVE 0x1CC160 ZF_kl_si16_S5_S3 12.75 UMR_BAR__1_1000_0_S5_S3 -6.4 6.35
 /begin AXIS_DESCR STD_AXIS NO_INPUT_QUANTITY UMR_NM__1_1_0_S5_S3 6 -1500 1500 DEPOSIT ABSOLUTE /end AXIS_DESCR
/end CHARACTERISTIC
/begin CHARACTERISTIC KL_POKZUMDMOTSOLLSP31 "Schaltdruckoffset in Abhaengigkeit von md_motsoll_sas" CURVE 0x1CCA90 ZF_kl_si16_S5_S3 12.75 UMR_BAR__1_1000_0_S5_S3 -6.4 6.35
 /begin AXIS_DESCR STD_AXIS NO_INPUT_QUANTITY UMR_NM__1_1_0_S5_S3 6 -1500 1500 DEPOSIT ABSOLUTE /end AXIS_DESCR
/end CHARACTERISTIC
/begin CHARACTERISTIC KL_POKZUMDMOTSOLLSP42 "Schaltdruckoffset in Abhaengigkeit von md_motsoll_sas" CURVE 0x1CCCDC ZF_kl_si16_S5_S3 12.75 UMR_BAR__1_1000_0_S5_S3 -6.4 6.35
 /begin AXIS_DESCR STD_AXIS NO_INPUT_QUANTITY UMR_NM__1_1_0_S5_S3 6 -1500 1500 DEPOSIT ABSOLUTE /end AXIS_DESCR
/end CHARACTERISTIC
/begin CHARACTERISTIC KL_POKZUMDMOTSOLLSP51 "Schaltdruckoffset in Abhaengigkeit von md_motsoll_sas" CURVE 0x1CCF28 ZF_kl_si16_S5_S3 12.75 UMR_BAR__1_1000_0_S5_S3 -6.4 6.35
 /begin AXIS_DESCR STD_AXIS NO_INPUT_QUANTITY UMR_NM__1_1_0_S5_S3 6 -1500 1500 DEPOSIT ABSOLUTE /end AXIS_DESCR
/end CHARACTERISTIC
/begin CHARACTERISTIC KL_POKZUMDMOTSOLLSP53 "Schaltdruckoffset in Abhaengigkeit von md_motsoll_sas" CURVE 0x1CD174 ZF_kl_si16_S5_S3 12.75 UMR_BAR__1_1000_0_S5_S3 -6.4 6.35
 /begin AXIS_DESCR STD_AXIS NO_INPUT_QUANTITY UMR_NM__1_1_0_S5_S3 6 -1500 1500 DEPOSIT ABSOLUTE /end AXIS_DESCR
/end CHARACTERISTIC
/begin CHARACTERISTIC KL_POKZUMDMOTSOLLSP63 "Schaltdruckoffset in Abhaengigkeit von md_motsoll_sas" CURVE 0x1CD3C0 ZF_kl_si16_S5_S3 12.75 UMR_BAR__1_1000_0_S5_S3 -6.4 6.35
 /begin AXIS_DESCR STD_AXIS NO_INPUT_QUANTITY UMR_NM__1_1_0_S5_S3 6 -1500 1500 DEPOSIT ABSOLUTE /end AXIS_DESCR
/end CHARACTERISTIC
/begin CHARACTERISTIC KL_POKZUNGAB21 "Druckoffset in Abhaengigkeit von ng_ab" CURVE 0x1CB8B4 ZF_kl_si16_S5_S3 12.75 UMR_BAR__1_1000_0_S5_S3 -6.4 6.35
 /begin AXIS_DESCR STD_AXIS iItfInput.ng_ab UMR_U_MINSEC_1_1_0_S5_S3 4 -5000 1000 DEPOSIT ABSOLUTE /end AXIS_DESCR
/end CHARACTERISTIC
/begin CHARACTERISTIC KL_POKZUNGAB32 "Druckoffset in Abhaengigkeit von ng_ab" CURVE 0x1CBB00 ZF_kl_si16_S5_S3 12.75 UMR_BAR__1_1000_0_S5_S3 -6.4 6.35
 /begin AXIS_DESCR STD_AXIS iItfInput.ng_ab UMR_U_MINSEC_1_1_0_S5_S3 4 -5000 1000 DEPOSIT ABSOLUTE /end AXIS_DESCR
/end CHARACTERISTIC
/begin CHARACTERISTIC KL_POKZUNGAB43 "Druckoffset in Abhaengigkeit von ng_ab" CURVE 0x1CBD4C ZF_kl_si16_S5_S3 12.75 UMR_BAR__1_1000_0_S5_S3 -6.4 6.35
 /begin AXIS_DESCR STD_AXIS iItfInput.ng_ab UMR_U_MINSEC_1_1_0_S5_S3 4 -5000 1000 DEPOSIT ABSOLUTE /end AXIS_DESCR
/end CHARACTERISTIC
/begin CHARACTERISTIC KL_POKZUNGAB54 "Druckoffset in Abhaengigkeit von ng_ab" CURVE 0x1CBF98 ZF_kl_si16_S5_S3 12.75 UMR_BAR__1_1000_0_S5_S3 -6.4 6.35
 /begin AXIS_DESCR STD_AXIS iItfInput.ng_ab UMR_U_MINSEC_1_1_0_S5_S3 4 -5000 1000 DEPOSIT ABSOLUTE /end AXIS_DESCR
/end CHARACTERISTIC
/begin CHARACTERISTIC KL_POKZUNGABSP31 "Druckoffset in Abhaengigkeit von ng_ab" CURVE 0x1CC8C8 ZF_kl_si16_S5_S3 12.75 UMR_BAR__1_1000_0_S5_S3 -6.4 6.35
 /begin AXIS_DESCR STD_AXIS iItfInput.ng_ab UMR_U_MINSEC_1_1_0_S5_S3 4 -5000 1000 DEPOSIT ABSOLUTE /end AXIS_DESCR
/end CHARACTERISTIC
/begin CHARACTERISTIC KL_POKZUNGABSP42 "Druckoffset in Abhaengigkeit von ng_ab" CURVE 0x1CCB14 ZF_kl_si16_S5_S3 12.75 UMR_BAR__1_1000_0_S5_S3 -6.4 6.35
 /begin AXIS_DESCR STD_AXIS iItfInput.ng_ab UMR_U_MINSEC_1_1_0_S5_S3 4 -5000 1000 DEPOSIT ABSOLUTE /end AXIS_DESCR
/end CHARACTERISTIC
/begin CHARACTERISTIC KL_POKZUNGABSP51 "Druckoffset in Abhaengigkeit von ng_ab" CURVE 0x1CCD60 ZF_kl_si16_S5_S3 12.75 UMR_BAR__1_1000_0_S5_S3 -6.4 6.35
 /begin AXIS_DESCR STD_AXIS iItfInput.ng_ab UMR_U_MINSEC_1_1_0_S5_S3 4 -5000 1000 DEPOSIT ABSOLUTE /end AXIS_DESCR
/end CHARACTERISTIC
/begin CHARACTERISTIC KL_POKZUNGABSP53 "Druckoffset in Abhaengigkeit von ng_ab" CURVE 0x1CCFAC ZF_kl_si16_S5_S3 12.75 UMR_BAR__1_1000_0_S5_S3 -6.4 6.35
 /begin AXIS_DESCR STD_AXIS iItfInput.ng_ab UMR_U_MINSEC_1_1_0_S5_S3 4 -5000 1000 DEPOSIT ABSOLUTE /end AXIS_DESCR
/end CHARACTERISTIC
/begin CHARACTERISTIC KL_POKZUNGABSP63 "Druckoffset in Abhaengigkeit von ng_ab" CURVE 0x1CD1F8 ZF_kl_si16_S5_S3 12.75 UMR_BAR__1_1000_0_S5_S3 -6.4 6.35
 /begin AXIS_DESCR STD_AXIS iItfInput.ng_ab UMR_U_MINSEC_1_1_0_S5_S3 4 -5000 1000 DEPOSIT ABSOLUTE /end AXIS_DESCR
/end CHARACTERISTIC
/begin CHARACTERISTIC KL_POMDTSYN21 "Druckoffset Schliessphase f(delta_m_t seit synchron)" CURVE 0x1CB92C ZF_kl_si16_S5_S3 12 UMR_BAR__1_1000_0_S5_S3 -6 6
 /begin AXIS_DESCR STD_AXIS iSasZentr.md_tpgrasyn UMR_NM__1_1_0_S5_S3 4 -1500 1500 DEPOSIT ABSOLUTE /end AXIS_DESCR
/end CHARACTERISTIC
/begin CHARACTERISTIC KL_POMDTSYN32 "Druckoffset Schliessphase f(delta_m_t seit synchron)" CURVE 0x1CBB78 ZF_kl_si16_S5_S3 12 UMR_BAR__1_1000_0_S5_S3 -6 6
 /begin AXIS_DESCR STD_AXIS iSasZentr.md_tpgrasyn UMR_NM__1_1_0_S5_S3 4 -1500 1500 DEPOSIT ABSOLUTE /end AXIS_DESCR
/end CHARACTERISTIC
/begin CHARACTERISTIC KL_POMDTSYN43 "Druckoffset Schliessphase f(delta_m_t seit synchron)" CURVE 0x1CBDC4 ZF_kl_si16_S5_S3 12 UMR_BAR__1_1000_0_S5_S3 -6 6
 /begin AXIS_DESCR STD_AXIS iSasZentr.md_tpgrasyn UMR_NM__1_1_0_S5_S3 4 -1500 1500 DEPOSIT ABSOLUTE /end AXIS_DESCR
/end CHARACTERISTIC
/begin CHARACTERISTIC KL_POMDTSYN54 "Druckoffset Schliessphase f(delta_m_t seit synchron)" CURVE 0x1CC010 ZF_kl_si16_S5_S3 12 UMR_BAR__1_1000_0_S5_S3 -6 6
 /begin AXIS_DESCR STD_AXIS iSasZentr.md_tpgrasyn UMR_NM__1_1_0_S5_S3 4 -1500 1500 DEPOSIT ABSOLUTE /end AXIS_DESCR
/end CHARACTERISTIC
/begin CHARACTERISTIC KL_POMDTSYNSP31 "Druckoffset Schliessphase f(delta_m_t seit synchron)" CURVE 0x1CC940 ZF_kl_si16_S5_S3 12 UMR_BAR__1_1000_0_S5_S3 -6 6
 /begin AXIS_DESCR STD_AXIS iSasZentr.md_tpgrasyn UMR_NM__1_1_0_S5_S3 4 -1500 1500 DEPOSIT ABSOLUTE /end AXIS_DESCR
/end CHARACTERISTIC
/begin CHARACTERISTIC KL_POMDTSYNSP42 "Druckoffset Schliessphase f(delta_m_t seit synchron)" CURVE 0x1CCB8C ZF_kl_si16_S5_S3 12 UMR_BAR__1_1000_0_S5_S3 -6 6
 /begin AXIS_DESCR STD_AXIS iSasZentr.md_tpgrasyn UMR_NM__1_1_0_S5_S3 4 -1500 1500 DEPOSIT ABSOLUTE /end AXIS_DESCR
/end CHARACTERISTIC
/begin CHARACTERISTIC KL_POMDTSYNSP51 "Druckoffset Schliessphase f(delta_m_t seit synchron)" CURVE 0x1CCDD8 ZF_kl_si16_S5_S3 12 UMR_BAR__1_1000_0_S5_S3 -6 6
 /begin AXIS_DESCR STD_AXIS iSasZentr.md_tpgrasyn UMR_NM__1_1_0_S5_S3 4 -1500 1500 DEPOSIT ABSOLUTE /end AXIS_DESCR
/end CHARACTERISTIC
/begin CHARACTERISTIC KL_POMDTSYNSP53 "Druckoffset Schliessphase f(delta_m_t seit synchron)" CURVE 0x1CD024 ZF_kl_si16_S5_S3 12 UMR_BAR__1_1000_0_S5_S3 -6 6
 /begin AXIS_DESCR STD_AXIS iSasZentr.md_tpgrasyn UMR_NM__1_1_0_S5_S3 4 -1500 1500 DEPOSIT ABSOLUTE /end AXIS_DESCR
/end CHARACTERISTIC
/begin CHARACTERISTIC KL_POMDTSYNSP63 "Druckoffset Schliessphase f(delta_m_t seit synchron)" CURVE 0x1CD270 ZF_kl_si16_S5_S3 12 UMR_BAR__1_1000_0_S5_S3 -6 6
 /begin AXIS_DESCR STD_AXIS iSasZentr.md_tpgrasyn UMR_NM__1_1_0_S5_S3 4 -1500 1500 DEPOSIT ABSOLUTE /end AXIS_DESCR
/end CHARACTERISTIC
/begin CHARACTERISTIC KL_PORAKZU21 "Schaltdruckoffset" CURVE 0x1CB8C8 ZF_kl_si16_S5_S3 12.75 UMR_BAR__1_1000_0_S5_S3 -6.4 6.35
 /begin AXIS_DESCR STD_AXIS iSasZentr.iSchaltend.iKzu.timer_zkzu UMR_MSEC__10_1_0_S5_S3 3 0 2540 DEPOSIT ABSOLUTE /end AXIS_DESCR
/end CHARACTERISTIC
/begin CHARACTERISTIC KL_PORAKZU32 "Schaltdruckoffset" CURVE 0x1CBB14 ZF_kl_si16_S5_S3 12.75 UMR_BAR__1_1000_0_S5_S3 -6.4 6.35
 /begin AXIS_DESCR STD_AXIS iSasZentr.iSchaltend.iKzu.timer_zkzu UMR_MSEC__10_1_0_S5_S3 3 0 2540 DEPOSIT ABSOLUTE /end AXIS_DESCR
/end CHARACTERISTIC
/begin CHARACTERISTIC KL_PORAKZU43 "Schaltdruckoffset" CURVE 0x1CBD60 ZF_kl_si16_S5_S3 12.75 UMR_BAR__1_1000_0_S5_S3 -6.4 6.35
 /begin AXIS_DESCR STD_AXIS iSasZentr.iSchaltend.iKzu.timer_zkzu UMR_MSEC__10_1_0_S5_S3 3 0 2540 DEPOSIT ABSOLUTE /end AXIS_DESCR
/end CHARACTERISTIC
/begin CHARACTERISTIC KL_PORAKZU54 "Schaltdruckoffset" CURVE 0x1CBFAC ZF_kl_si16_S5_S3 12.75 UMR_BAR__1_1000_0_S5_S3 -6.4 6.35
 /begin AXIS_DESCR STD_AXIS iSasZentr.iSchaltend.iKzu.timer_zkzu UMR_MSEC__10_1_0_S5_S3 3 0 2540 DEPOSIT ABSOLUTE /end AXIS_DESCR
/end CHARACTERISTIC
/begin CHARACTERISTIC KL_PORAKZUSP31 "Schaltdruckoffset" CURVE 0x1CC8DC ZF_kl_si16_S5_S3 12.75 UMR_BAR__1_1000_0_S5_S3 -6.4 6.35
 /begin AXIS_DESCR STD_AXIS iSasZentr.iSchaltend.iKzu.timer_zkzu UMR_MSEC__10_1_0_S5_S3 3 0 2540 DEPOSIT ABSOLUTE /end AXIS_DESCR
/end CHARACTERISTIC
/begin CHARACTERISTIC KL_PORAKZUSP42 "Schaltdruckoffset" CURVE 0x1CCB28 ZF_kl_si16_S5_S3 12.75 UMR_BAR__1_1000_0_S5_S3 -6.4 6.35
 /begin AXIS_DESCR STD_AXIS iSasZentr.iSchaltend.iKzu.timer_zkzu UMR_MSEC__10_1_0_S5_S3 3 0 2540 DEPOSIT ABSOLUTE /end AXIS_DESCR
/end CHARACTERISTIC
/begin CHARACTERISTIC KL_PORAKZUSP51 "Schaltdruckoffset" CURVE 0x1CCD74 ZF_kl_si16_S5_S3 12.75 UMR_BAR__1_1000_0_S5_S3 -6.4 6.35
 /begin AXIS_DESCR STD_AXIS iSasZentr.iSchaltend.iKzu.timer_zkzu UMR_MSEC__10_1_0_S5_S3 3 0 2540 DEPOSIT ABSOLUTE /end AXIS_DESCR
/end CHARACTERISTIC
/begin CHARACTERISTIC KL_PORAKZUSP53 "Schaltdruckoffset" CURVE 0x1CCFC0 ZF_kl_si16_S5_S3 12.75 UMR_BAR__1_1000_0_S5_S3 -6.4 6.35
 /begin AXIS_DESCR STD_AXIS iSasZentr.iSchaltend.iKzu.timer_zkzu UMR_MSEC__10_1_0_S5_S3 3 0 2540 DEPOSIT ABSOLUTE /end AXIS_DESCR
/end CHARACTERISTIC
/begin CHARACTERISTIC KL_PORAKZUSP63 "Schaltdruckoffset" CURVE 0x1CD20C ZF_kl_si16_S5_S3 12.75 UMR_BAR__1_1000_0_S5_S3 -6.4 6.35
 /begin AXIS_DESCR STD_AXIS iSasZentr.iSchaltend.iKzu.timer_zkzu UMR_MSEC__10_1_0_S5_S3 3 0 2540 DEPOSIT ABSOLUTE /end AXIS_DESCR
/end CHARACTERISTIC
/begin CHARACTERISTIC KL_PORASYN21 "Rampe n.Syn.->l.Stuetzst. y PMAX" CURVE 0x1CB8A4 ZF_kl_si16_S5_S3 12.75 UMR_BAR__1_1000_0_S5_S3 0 12.75
 /begin AXIS_DESCR STD_AXIS iSasZentr.iSchaltend.iKzu.timer_zkzu UMR_MSEC__10_1_0_S5_S3 3 0 2540 DEPOSIT ABSOLUTE /end AXIS_DESCR
/end CHARACTERISTIC
/begin CHARACTERISTIC KL_PORASYN32 "Rampe n.Syn.->l.Stuetzst. y PMAX" CURVE 0x1CBAF0 ZF_kl_si16_S5_S3 12.75 UMR_BAR__1_1000_0_S5_S3 0 12.75
 /begin AXIS_DESCR STD_AXIS iSasZentr.iSchaltend.iKzu.timer_zkzu UMR_MSEC__10_1_0_S5_S3 3 0 2540 DEPOSIT ABSOLUTE /end AXIS_DESCR
/end CHARACTERISTIC
/begin CHARACTERISTIC KL_PORASYN43 "Rampe n.Syn.->l.Stuetzst. y PMAX" CURVE 0x1CBD3C ZF_kl_si16_S5_S3 12.75 UMR_BAR__1_1000_0_S5_S3 0 12.75
 /begin AXIS_DESCR STD_AXIS iSasZentr.iSchaltend.iKzu.timer_zkzu UMR_MSEC__10_1_0_S5_S3 3 0 2540 DEPOSIT ABSOLUTE /end AXIS_DESCR
/end CHARACTERISTIC
/begin CHARACTERISTIC KL_PORASYN54 "Rampe n.Syn.->l.Stuetzst. y PMAX" CURVE 0x1CBF88 ZF_kl_si16_S5_S3 12.75 UMR_BAR__1_1000_0_S5_S3 0 12.75
 /begin AXIS_DESCR STD_AXIS iSasZentr.iSchaltend.iKzu.timer_zkzu UMR_MSEC__10_1_0_S5_S3 3 0 2540 DEPOSIT ABSOLUTE /end AXIS_DESCR
/end CHARACTERISTIC
/begin CHARACTERISTIC KL_PORASYNSP31 "Rampe n.Syn.->l.Stuetzst. y PMAX" CURVE 0x1CC8B8 ZF_kl_si16_S5_S3 12.75 UMR_BAR__1_1000_0_S5_S3 0 12.75
 /begin AXIS_DESCR STD_AXIS iSasZentr.iSchaltend.iKzu.timer_zkzu UMR_MSEC__10_1_0_S5_S3 3 0 2540 DEPOSIT ABSOLUTE /end AXIS_DESCR
/end CHARACTERISTIC
/begin CHARACTERISTIC KL_PORASYNSP42 "Rampe n.Syn.->l.Stuetzst. y PMAX" CURVE 0x1CCB04 ZF_kl_si16_S5_S3 12.75 UMR_BAR__1_1000_0_S5_S3 0 12.75
 /begin AXIS_DESCR STD_AXIS iSasZentr.iSchaltend.iKzu.timer_zkzu UMR_MSEC__10_1_0_S5_S3 3 0 2540 DEPOSIT ABSOLUTE /end AXIS_DESCR
/end CHARACTERISTIC
/begin CHARACTERISTIC KL_PORASYNSP51 "Rampe n.Syn.->l.Stuetzst. y PMAX" CURVE 0x1CCD50 ZF_kl_si16_S5_S3 12.75 UMR_BAR__1_1000_0_S5_S3 0 12.75
 /begin AXIS_DESCR STD_AXIS iSasZentr.iSchaltend.iKzu.timer_zkzu UMR_MSEC__10_1_0_S5_S3 3 0 2540 DEPOSIT ABSOLUTE /end AXIS_DESCR
/end CHARACTERISTIC
/begin CHARACTERISTIC KL_PORASYNSP53 "Rampe n.Syn.->l.Stuetzst. y PMAX" CURVE 0x1CCF9C ZF_kl_si16_S5_S3 12.75 UMR_BAR__1_1000_0_S5_S3 0 12.75
 /begin AXIS_DESCR STD_AXIS iSasZentr.iSchaltend.iKzu.timer_zkzu UMR_MSEC__10_1_0_S5_S3 3 0 2540 DEPOSIT ABSOLUTE /end AXIS_DESCR
/end CHARACTERISTIC
/begin CHARACTERISTIC KL_PORASYNSP63 "Rampe n.Syn.->l.Stuetzst. y PMAX" CURVE 0x1CD1E8 ZF_kl_si16_S5_S3 12.75 UMR_BAR__1_1000_0_S5_S3 0 12.75
 /begin AXIS_DESCR STD_AXIS iSasZentr.iSchaltend.iKzu.timer_zkzu UMR_MSEC__10_1_0_S5_S3 3 0 2540 DEPOSIT ABSOLUTE /end AXIS_DESCR
/end CHARACTERISTIC
/begin CHARACTERISTIC KL_TRA32 "Kennlinie Zeit Erste Rampe" CURVE 0x1C6C14 ZF_kl_ui8_S5_S3 2540 UMR_MSEC__10_1_0_S5_S3 0 2540
 /begin AXIS_DESCR STD_AXIS zff_atsys._.iSignale._.obj.sig_m_t8 UMR_NM__6_1_M34_S5_S3 4 -204 1326 DEPOSIT ABSOLUTE /end AXIS_DESCR
/end CHARACTERISTIC
/begin CHARACTERISTIC KL_TRA32_EL "Kennlinie Zeit Erste Rampe" CURVE 0x1C6C20 ZF_kl_ui8_S5_S3 2540 UMR_MSEC__10_1_0_S5_S3 0 2540
 /begin AXIS_DESCR STD_AXIS zff_atsys._.iSignale._.obj.sig_m_t8 UMR_NM__6_1_M34_S5_S3 4 -204 1326 DEPOSIT ABSOLUTE /end AXIS_DESCR
/end CHARACTERISTIC
/begin CHARACTERISTIC KL_TRA43 "Kennlinie Zeit Erste Rampe" CURVE 0x1C6EC0 ZF_kl_ui8_S5_S3 2540 UMR_MSEC__10_1_0_S5_S3 0 2540
 /begin AXIS_DESCR STD_AXIS zff_atsys._.iSignale._.obj.sig_m_t8 UMR_NM__6_1_M34_S5_S3 4 -204 1326 DEPOSIT ABSOLUTE /end AXIS_DESCR
/end CHARACTERISTIC
/begin CHARACTERISTIC KL_TRA43_EL "Kennlinie Zeit Erste Rampe" CURVE 0x1C6ECC ZF_kl_ui8_S5_S3 2540 UMR_MSEC__10_1_0_S5_S3 0 2540
 /begin AXIS_DESCR STD_AXIS zff_atsys._.iSignale._.obj.sig_m_t8 UMR_NM__6_1_M34_S5_S3 4 -204 1326 DEPOSIT ABSOLUTE /end AXIS_DESCR
/end CHARACTERISTIC
/begin CHARACTERISTIC KL_TRA54 "Kennlinie Zeit Erste Rampe" CURVE 0x1C716C ZF_kl_ui8_S5_S3 2540 UMR_MSEC__10_1_0_S5_S3 0 2540
 /begin AXIS_DESCR STD_AXIS zff_atsys._.iSignale._.obj.sig_m_t8 UMR_NM__6_1_M34_S5_S3 4 -204 1326 DEPOSIT ABSOLUTE /end AXIS_DESCR
/end CHARACTERISTIC
/begin CHARACTERISTIC KL_TRA54_EL "Kennlinie Zeit Erste Rampe" CURVE 0x1C7178 ZF_kl_ui8_S5_S3 2540 UMR_MSEC__10_1_0_S5_S3 0 2540
 /begin AXIS_DESCR STD_AXIS zff_atsys._.iSignale._.obj.sig_m_t8 UMR_NM__6_1_M34_S5_S3 4 -204 1326 DEPOSIT ABSOLUTE /end AXIS_DESCR
/end CHARACTERISTIC
/begin CHARACTERISTIC KL_TRA65 "Kennlinie Zeit Erste Rampe" CURVE 0x1C7418 ZF_kl_ui8_S5_S3 2540 UMR_MSEC__10_1_0_S5_S3 0 2540
 /begin AXIS_DESCR STD_AXIS zff_atsys._.iSignale._.obj.sig_m_t8 UMR_NM__6_1_M34_S5_S3 4 -204 1326 DEPOSIT ABSOLUTE /end AXIS_DESCR
/end CHARACTERISTIC
/begin CHARACTERISTIC KL_TRA65_EL "Kennlinie Zeit Erste Rampe" CURVE 0x1C7424 ZF_kl_ui8_S5_S3 2540 UMR_MSEC__10_1_0_S5_S3 0 2540
 /begin AXIS_DESCR STD_AXIS zff_atsys._.iSignale._.obj.sig_m_t8 UMR_NM__6_1_M34_S5_S3 4 -204 1326 DEPOSIT ABSOLUTE /end AXIS_DESCR
/end CHARACTERISTIC
/begin CHARACTERISTIC KL_TRA76 "Kennlinie Zeit Erste Rampe" CURVE 0x1C76C4 ZF_kl_ui8_S5_S3 2540 UMR_MSEC__10_1_0_S5_S3 0 2540
 /begin AXIS_DESCR STD_AXIS zff_atsys._.iSignale._.obj.sig_m_t8 UMR_NM__6_1_M34_S5_S3 4 -204 1326 DEPOSIT ABSOLUTE /end AXIS_DESCR
/end CHARACTERISTIC
/begin CHARACTERISTIC KL_TRA76_EL "Kennlinie Zeit Erste Rampe" CURVE 0x1C76D0 ZF_kl_ui8_S5_S3 2540 UMR_MSEC__10_1_0_S5_S3 0 2540
 /begin AXIS_DESCR STD_AXIS zff_atsys._.iSignale._.obj.sig_m_t8 UMR_NM__6_1_M34_S5_S3 4 -204 1326 DEPOSIT ABSOLUTE /end AXIS_DESCR
/end CHARACTERISTIC
/begin CHARACTERISTIC KL_TRA87 "Kennlinie Zeit Erste Rampe" CURVE 0x1C7970 ZF_kl_ui8_S5_S3 2540 UMR_MSEC__10_1_0_S5_S3 0 2540
 /begin AXIS_DESCR STD_AXIS zff_atsys._.iSignale._.obj.sig_m_t8 UMR_NM__6_1_M34_S5_S3 4 -204 1326 DEPOSIT ABSOLUTE /end AXIS_DESCR
/end CHARACTERISTIC
/begin CHARACTERISTIC KL_TRA87_EL "Kennlinie Zeit Erste Rampe" CURVE 0x1C797C ZF_kl_ui8_S5_S3 2540 UMR_MSEC__10_1_0_S5_S3 0 2540
 /begin AXIS_DESCR STD_AXIS zff_atsys._.iSignale._.obj.sig_m_t8 UMR_NM__6_1_M34_S5_S3 4 -204 1326 DEPOSIT ABSOLUTE /end AXIS_DESCR
/end CHARACTERISTIC
/begin CHARACTERISTIC KL_TRASP21 "Kennlinie Zeit Erste Rampe" CURVE 0x1C7C1C ZF_kl_ui8_S5_S3 2540 UMR_MSEC__10_1_0_S5_S3 0 2540
 /begin AXIS_DESCR STD_AXIS zff_atsys._.iSignale._.obj.sig_m_t8 UMR_NM__6_1_M34_S5_S3 4 -204 1326 DEPOSIT ABSOLUTE /end AXIS_DESCR
/end CHARACTERISTIC
/begin CHARACTERISTIC KL_TRASP31 "Kennlinie Zeit Erste Rampe" CURVE 0x1C87D0 ZF_kl_ui8_S5_S3 2540 UMR_MSEC__10_1_0_S5_S3 0 2540
 /begin AXIS_DESCR STD_AXIS zff_atsys._.iSignale._.obj.sig_m_t8 UMR_NM__6_1_M34_S5_S3 4 -204 1326 DEPOSIT ABSOLUTE /end AXIS_DESCR
/end CHARACTERISTIC
/begin CHARACTERISTIC KL_TRASP32 "Kennlinie Zeit Erste Rampe" CURVE 0x1C7DC8 ZF_kl_ui8_S5_S3 2540 UMR_MSEC__10_1_0_S5_S3 0 2540
 /begin AXIS_DESCR STD_AXIS zff_atsys._.iSignale._.obj.sig_m_t8 UMR_NM__6_1_M34_S5_S3 4 -204 1326 DEPOSIT ABSOLUTE /end AXIS_DESCR
/end CHARACTERISTIC
/begin CHARACTERISTIC KL_TRASP42 "Kennlinie Zeit Erste Rampe" CURVE 0x1C897C ZF_kl_ui8_S5_S3 2540 UMR_MSEC__10_1_0_S5_S3 0 2540
 /begin AXIS_DESCR STD_AXIS zff_atsys._.iSignale._.obj.sig_m_t8 UMR_NM__6_1_M34_S5_S3 4 -204 1326 DEPOSIT ABSOLUTE /end AXIS_DESCR
/end CHARACTERISTIC
/begin CHARACTERISTIC KL_TRASP43 "Kennlinie Zeit Erste Rampe" CURVE 0x1C7F74 ZF_kl_ui8_S5_S3 2540 UMR_MSEC__10_1_0_S5_S3 0 2540
 /begin AXIS_DESCR STD_AXIS zff_atsys._.iSignale._.obj.sig_m_t8 UMR_NM__6_1_M34_S5_S3 4 -204 1326 DEPOSIT ABSOLUTE /end AXIS_DESCR
/end CHARACTERISTIC
/begin CHARACTERISTIC KL_TRASP51 "Kennlinie Zeit Erste Rampe" CURVE 0x1C8B28 ZF_kl_ui8_S5_S3 2540 UMR_MSEC__10_1_0_S5_S3 0 2540
 /begin AXIS_DESCR STD_AXIS zff_atsys._.iSignale._.obj.sig_m_t8 UMR_NM__6_1_M34_S5_S3 4 -204 1326 DEPOSIT ABSOLUTE /end AXIS_DESCR
/end CHARACTERISTIC
/begin CHARACTERISTIC KL_TRASP53 "Kennlinie Zeit Erste Rampe" CURVE 0x1C8CD4 ZF_kl_ui8_S5_S3 2540 UMR_MSEC__10_1_0_S5_S3 0 2540
 /begin AXIS_DESCR STD_AXIS zff_atsys._.iSignale._.obj.sig_m_t8 UMR_NM__6_1_M34_S5_S3 4 -204 1326 DEPOSIT ABSOLUTE /end AXIS_DESCR
/end CHARACTERISTIC
/begin CHARACTERISTIC KL_TRASP54 "Kennlinie Zeit Erste Rampe" CURVE 0x1C8120 ZF_kl_ui8_S5_S3 2540 UMR_MSEC__10_1_0_S5_S3 0 2540
 /begin AXIS_DESCR STD_AXIS zff_atsys._.iSignale._.obj.sig_m_t8 UMR_NM__6_1_M34_S5_S3 4 -204 1326 DEPOSIT ABSOLUTE /end AXIS_DESCR
/end CHARACTERISTIC
/begin CHARACTERISTIC KL_TRASP63 "Kennlinie Zeit Erste Rampe" CURVE 0x1C8E80 ZF_kl_ui8_S5_S3 2540 UMR_MSEC__10_1_0_S5_S3 0 2540
 /begin AXIS_DESCR STD_AXIS zff_atsys._.iSignale._.obj.sig_m_t8 UMR_NM__6_1_M34_S5_S3 4 -204 1326 DEPOSIT ABSOLUTE /end AXIS_DESCR
/end CHARACTERISTIC
/begin CHARACTERISTIC KL_TRASP64 "Kennlinie Zeit Erste Rampe" CURVE 0x1C902C ZF_kl_ui8_S5_S3 2540 UMR_MSEC__10_1_0_S5_S3 0 2540
 /begin AXIS_DESCR STD_AXIS zff_atsys._.iSignale._.obj.sig_m_t8 UMR_NM__6_1_M34_S5_S3 4 -204 1326 DEPOSIT ABSOLUTE /end AXIS_DESCR
/end CHARACTERISTIC
/begin CHARACTERISTIC KL_TRASP65 "Kennlinie Zeit Erste Rampe" CURVE 0x1C82CC ZF_kl_ui8_S5_S3 2540 UMR_MSEC__10_1_0_S5_S3 0 2540
 /begin AXIS_DESCR STD_AXIS zff_atsys._.iSignale._.obj.sig_m_t8 UMR_NM__6_1_M34_S5_S3 4 -204 1326 DEPOSIT ABSOLUTE /end AXIS_DESCR
/end CHARACTERISTIC
/begin CHARACTERISTIC KL_TRASP71 "Kennlinie Zeit Erste Rampe" CURVE 0x1C91D8 ZF_kl_ui8_S5_S3 2540 UMR_MSEC__10_1_0_S5_S3 0 2540
 /begin AXIS_DESCR STD_AXIS zff_atsys._.iSignale._.obj.sig_m_t8 UMR_NM__6_1_M34_S5_S3 4 -204 1326 DEPOSIT ABSOLUTE /end AXIS_DESCR
/end CHARACTERISTIC
/begin CHARACTERISTIC KL_TRASP75 "Kennlinie Zeit Erste Rampe" CURVE 0x1C9384 ZF_kl_ui8_S5_S3 2540 UMR_MSEC__10_1_0_S5_S3 0 2540
 /begin AXIS_DESCR STD_AXIS zff_atsys._.iSignale._.obj.sig_m_t8 UMR_NM__6_1_M34_S5_S3 4 -204 1326 DEPOSIT ABSOLUTE /end AXIS_DESCR
/end CHARACTERISTIC
/begin CHARACTERISTIC KL_TRASP76 "Kennlinie Zeit Erste Rampe" CURVE 0x1C8478 ZF_kl_ui8_S5_S3 2540 UMR_MSEC__10_1_0_S5_S3 0 2540
 /begin AXIS_DESCR STD_AXIS zff_atsys._.iSignale._.obj.sig_m_t8 UMR_NM__6_1_M34_S5_S3 4 -204 1326 DEPOSIT ABSOLUTE /end AXIS_DESCR
/end CHARACTERISTIC
/begin CHARACTERISTIC KL_TRASP82 "Kennlinie Zeit Erste Rampe" CURVE 0x1C9530 ZF_kl_ui8_S5_S3 2540 UMR_MSEC__10_1_0_S5_S3 0 2540
 /begin AXIS_DESCR STD_AXIS zff_atsys._.iSignale._.obj.sig_m_t8 UMR_NM__6_1_M34_S5_S3 4 -204 1326 DEPOSIT ABSOLUTE /end AXIS_DESCR
/end CHARACTERISTIC
/begin CHARACTERISTIC KL_TRASP84 "Kennlinie Zeit Erste Rampe" CURVE 0x1C96DC ZF_kl_ui8_S5_S3 2540 UMR_MSEC__10_1_0_S5_S3 0 2540
 /begin AXIS_DESCR STD_AXIS zff_atsys._.iSignale._.obj.sig_m_t8 UMR_NM__6_1_M34_S5_S3 4 -204 1326 DEPOSIT ABSOLUTE /end AXIS_DESCR
/end CHARACTERISTIC
/begin CHARACTERISTIC KL_TRASP86 "Kennlinie Zeit Erste Rampe" CURVE 0x1C9888 ZF_kl_ui8_S5_S3 2540 UMR_MSEC__10_1_0_S5_S3 0 2540
 /begin AXIS_DESCR STD_AXIS zff_atsys._.iSignale._.obj.sig_m_t8 UMR_NM__6_1_M34_S5_S3 4 -204 1326 DEPOSIT ABSOLUTE /end AXIS_DESCR
/end CHARACTERISTIC
/begin CHARACTERISTIC KL_TRASP87 "Kennlinie Zeit Erste Rampe" CURVE 0x1C8624 ZF_kl_ui8_S5_S3 2540 UMR_MSEC__10_1_0_S5_S3 0 2540
 /begin AXIS_DESCR STD_AXIS zff_atsys._.iSignale._.obj.sig_m_t8 UMR_NM__6_1_M34_S5_S3 4 -204 1326 DEPOSIT ABSOLUTE /end AXIS_DESCR
/end CHARACTERISTIC
/begin CHARACTERISTIC KL_TRASPORT21 "Kennlinie Zeit Erste Rampe" CURVE 0x1C9A34 ZF_kl_ui8_S5_S3 2540 UMR_MSEC__10_1_0_S5_S3 0 2540
 /begin AXIS_DESCR STD_AXIS zff_atsys._.iSignale._.obj.sig_m_t8 UMR_NM__6_1_M34_S5_S3 4 -204 1326 DEPOSIT ABSOLUTE /end AXIS_DESCR
/end CHARACTERISTIC
/begin CHARACTERISTIC KL_TRASPORT31 "Kennlinie Zeit Erste Rampe" CURVE 0x1CA5E8 ZF_kl_ui8_S5_S3 2540 UMR_MSEC__10_1_0_S5_S3 0 2540
 /begin AXIS_DESCR STD_AXIS zff_atsys._.iSignale._.obj.sig_m_t8 UMR_NM__6_1_M34_S5_S3 4 -204 1326 DEPOSIT ABSOLUTE /end AXIS_DESCR
/end CHARACTERISTIC
/begin CHARACTERISTIC KL_TRASPORT32 "Kennlinie Zeit Erste Rampe" CURVE 0x1C9BE0 ZF_kl_ui8_S5_S3 2540 UMR_MSEC__10_1_0_S5_S3 0 2540
 /begin AXIS_DESCR STD_AXIS zff_atsys._.iSignale._.obj.sig_m_t8 UMR_NM__6_1_M34_S5_S3 4 -204 1326 DEPOSIT ABSOLUTE /end AXIS_DESCR
/end CHARACTERISTIC
/begin CHARACTERISTIC KL_TRASPORT42 "Kennlinie Zeit Erste Rampe" CURVE 0x1CA794 ZF_kl_ui8_S5_S3 2540 UMR_MSEC__10_1_0_S5_S3 0 2540
 /begin AXIS_DESCR STD_AXIS zff_atsys._.iSignale._.obj.sig_m_t8 UMR_NM__6_1_M34_S5_S3 4 -204 1326 DEPOSIT ABSOLUTE /end AXIS_DESCR
/end CHARACTERISTIC
/begin CHARACTERISTIC KL_TRASPORT43 "Kennlinie Zeit Erste Rampe" CURVE 0x1C9D8C ZF_kl_ui8_S5_S3 2540 UMR_MSEC__10_1_0_S5_S3 0 2540
 /begin AXIS_DESCR STD_AXIS zff_atsys._.iSignale._.obj.sig_m_t8 UMR_NM__6_1_M34_S5_S3 4 -204 1326 DEPOSIT ABSOLUTE /end AXIS_DESCR
/end CHARACTERISTIC
/begin CHARACTERISTIC KL_TRASPORT51 "Kennlinie Zeit Erste Rampe" CURVE 0x1CA940 ZF_kl_ui8_S5_S3 2540 UMR_MSEC__10_1_0_S5_S3 0 2540
 /begin AXIS_DESCR STD_AXIS zff_atsys._.iSignale._.obj.sig_m_t8 UMR_NM__6_1_M34_S5_S3 4 -204 1326 DEPOSIT ABSOLUTE /end AXIS_DESCR
/end CHARACTERISTIC
/begin CHARACTERISTIC KL_TRASPORT53 "Kennlinie Zeit Erste Rampe" CURVE 0x1CAAEC ZF_kl_ui8_S5_S3 2540 UMR_MSEC__10_1_0_S5_S3 0 2540
 /begin AXIS_DESCR STD_AXIS zff_atsys._.iSignale._.obj.sig_m_t8 UMR_NM__6_1_M34_S5_S3 4 -204 1326 DEPOSIT ABSOLUTE /end AXIS_DESCR
/end CHARACTERISTIC
/begin CHARACTERISTIC KL_TRASPORT54 "Kennlinie Zeit Erste Rampe" CURVE 0x1C9F38 ZF_kl_ui8_S5_S3 2540 UMR_MSEC__10_1_0_S5_S3 0 2540
 /begin AXIS_DESCR STD_AXIS zff_atsys._.iSignale._.obj.sig_m_t8 UMR_NM__6_1_M34_S5_S3 4 -204 1326 DEPOSIT ABSOLUTE /end AXIS_DESCR
/end CHARACTERISTIC
/begin CHARACTERISTIC KL_TRASPORT63 "Kennlinie Zeit Erste Rampe" CURVE 0x1CAC98 ZF_kl_ui8_S5_S3 2540 UMR_MSEC__10_1_0_S5_S3 0 2540
 /begin AXIS_DESCR STD_AXIS zff_atsys._.iSignale._.obj.sig_m_t8 UMR_NM__6_1_M34_S5_S3 4 -204 1326 DEPOSIT ABSOLUTE /end AXIS_DESCR
/end CHARACTERISTIC
/begin CHARACTERISTIC KL_TRASPORT64 "Kennlinie Zeit Erste Rampe" CURVE 0x1CAE44 ZF_kl_ui8_S5_S3 2540 UMR_MSEC__10_1_0_S5_S3 0 2540
 /begin AXIS_DESCR STD_AXIS zff_atsys._.iSignale._.obj.sig_m_t8 UMR_NM__6_1_M34_S5_S3 4 -204 1326 DEPOSIT ABSOLUTE /end AXIS_DESCR
/end CHARACTERISTIC
/begin CHARACTERISTIC KL_TRASPORT65 "Kennlinie Zeit Erste Rampe" CURVE 0x1CA0E4 ZF_kl_ui8_S5_S3 2540 UMR_MSEC__10_1_0_S5_S3 0 2540
 /begin AXIS_DESCR STD_AXIS zff_atsys._.iSignale._.obj.sig_m_t8 UMR_NM__6_1_M34_S5_S3 4 -204 1326 DEPOSIT ABSOLUTE /end AXIS_DESCR
/end CHARACTERISTIC
/begin CHARACTERISTIC KL_TRASPORT71 "Kennlinie Zeit Erste Rampe" CURVE 0x1CAFF0 ZF_kl_ui8_S5_S3 2540 UMR_MSEC__10_1_0_S5_S3 0 2540
 /begin AXIS_DESCR STD_AXIS zff_atsys._.iSignale._.obj.sig_m_t8 UMR_NM__6_1_M34_S5_S3 4 -204 1326 DEPOSIT ABSOLUTE /end AXIS_DESCR
/end CHARACTERISTIC
/begin CHARACTERISTIC KL_TRASPORT75 "Kennlinie Zeit Erste Rampe" CURVE 0x1CB19C ZF_kl_ui8_S5_S3 2540 UMR_MSEC__10_1_0_S5_S3 0 2540
 /begin AXIS_DESCR STD_AXIS zff_atsys._.iSignale._.obj.sig_m_t8 UMR_NM__6_1_M34_S5_S3 4 -204 1326 DEPOSIT ABSOLUTE /end AXIS_DESCR
/end CHARACTERISTIC
/begin CHARACTERISTIC KL_TRASPORT76 "Kennlinie Zeit Erste Rampe" CURVE 0x1CA290 ZF_kl_ui8_S5_S3 2540 UMR_MSEC__10_1_0_S5_S3 0 2540
 /begin AXIS_DESCR STD_AXIS zff_atsys._.iSignale._.obj.sig_m_t8 UMR_NM__6_1_M34_S5_S3 4 -204 1326 DEPOSIT ABSOLUTE /end AXIS_DESCR
/end CHARACTERISTIC
/begin CHARACTERISTIC KL_TRASPORT82 "Kennlinie Zeit Erste Rampe" CURVE 0x1CB348 ZF_kl_ui8_S5_S3 2540 UMR_MSEC__10_1_0_S5_S3 0 2540
 /begin AXIS_DESCR STD_AXIS zff_atsys._.iSignale._.obj.sig_m_t8 UMR_NM__6_1_M34_S5_S3 4 -204 1326 DEPOSIT ABSOLUTE /end AXIS_DESCR
/end CHARACTERISTIC
/begin CHARACTERISTIC KL_TRASPORT84 "Kennlinie Zeit Erste Rampe" CURVE 0x1CB4F4 ZF_kl_ui8_S5_S3 2540 UMR_MSEC__10_1_0_S5_S3 0 2540
 /begin AXIS_DESCR STD_AXIS zff_atsys._.iSignale._.obj.sig_m_t8 UMR_NM__6_1_M34_S5_S3 4 -204 1326 DEPOSIT ABSOLUTE /end AXIS_DESCR
/end CHARACTERISTIC
/begin CHARACTERISTIC KL_TRASPORT86 "Kennlinie Zeit Erste Rampe" CURVE 0x1CB6A0 ZF_kl_ui8_S5_S3 2540 UMR_MSEC__10_1_0_S5_S3 0 2540
 /begin AXIS_DESCR STD_AXIS zff_atsys._.iSignale._.obj.sig_m_t8 UMR_NM__6_1_M34_S5_S3 4 -204 1326 DEPOSIT ABSOLUTE /end AXIS_DESCR
/end CHARACTERISTIC
/begin CHARACTERISTIC KL_TRASPORT87 "Kennlinie Zeit Erste Rampe" CURVE 0x1CA43C ZF_kl_ui8_S5_S3 2540 UMR_MSEC__10_1_0_S5_S3 0 2540
 /begin AXIS_DESCR STD_AXIS zff_atsys._.iSignale._.obj.sig_m_t8 UMR_NM__6_1_M34_S5_S3 4 -204 1326 DEPOSIT ABSOLUTE /end AXIS_DESCR
/end CHARACTERISTIC
/begin CHARACTERISTIC KL_TSYNCGHINSYNEKZU32 "Zeit fuer Ende Haltephase in Synchron KZU" CURVE 0x1C6E7C ZF_kl_ui8_S5_S3 2550 UMR_MSEC__10_1_M128_S5_S3 -1280 1270
 /begin AXIS_DESCR STD_AXIS zff_atsys._.iSignale._.obj.sig_c_getr UMR_GRADC__1_1_M40_S5_S3 4 -40 150 DEPOSIT ABSOLUTE /end AXIS_DESCR
/end CHARACTERISTIC
/begin CHARACTERISTIC KL_TSYNCGHINSYNEKZU43 "Zeit fuer Ende Haltephase in Synchron KZU" CURVE 0x1C7128 ZF_kl_ui8_S5_S3 2550 UMR_MSEC__10_1_M128_S5_S3 -1280 1270
 /begin AXIS_DESCR STD_AXIS zff_atsys._.iSignale._.obj.sig_c_getr UMR_GRADC__1_1_M40_S5_S3 4 -40 150 DEPOSIT ABSOLUTE /end AXIS_DESCR
/end CHARACTERISTIC
/begin CHARACTERISTIC KL_TSYNCGHINSYNEKZU54 "Zeit fuer Ende Haltephase in Synchron KZU" CURVE 0x1C73D4 ZF_kl_ui8_S5_S3 2550 UMR_MSEC__10_1_M128_S5_S3 -1280 1270
 /begin AXIS_DESCR STD_AXIS zff_atsys._.iSignale._.obj.sig_c_getr UMR_GRADC__1_1_M40_S5_S3 4 -40 150 DEPOSIT ABSOLUTE /end AXIS_DESCR
/end CHARACTERISTIC
/begin CHARACTERISTIC KL_TSYNCGHINSYNEKZU65 "Zeit fuer Ende Haltephase in Synchron KZU" CURVE 0x1C7680 ZF_kl_ui8_S5_S3 2550 UMR_MSEC__10_1_M128_S5_S3 -1280 1270
 /begin AXIS_DESCR STD_AXIS zff_atsys._.iSignale._.obj.sig_c_getr UMR_GRADC__1_1_M40_S5_S3 4 -40 150 DEPOSIT ABSOLUTE /end AXIS_DESCR
/end CHARACTERISTIC
/begin CHARACTERISTIC KL_TSYNCGHINSYNEKZU76 "Zeit fuer Ende Haltephase in Synchron KZU" CURVE 0x1C792C ZF_kl_ui8_S5_S3 2550 UMR_MSEC__10_1_M128_S5_S3 -1280 1270
 /begin AXIS_DESCR STD_AXIS zff_atsys._.iSignale._.obj.sig_c_getr UMR_GRADC__1_1_M40_S5_S3 4 -40 150 DEPOSIT ABSOLUTE /end AXIS_DESCR
/end CHARACTERISTIC
/begin CHARACTERISTIC KL_TSYNCGHINSYNEKZU87 "Zeit fuer Ende Haltephase in Synchron KZU" CURVE 0x1C7BD8 ZF_kl_ui8_S5_S3 2550 UMR_MSEC__10_1_M128_S5_S3 -1280 1270
 /begin AXIS_DESCR STD_AXIS zff_atsys._.iSignale._.obj.sig_c_getr UMR_GRADC__1_1_M40_S5_S3 4 -40 150 DEPOSIT ABSOLUTE /end AXIS_DESCR
/end CHARACTERISTIC
/begin CHARACTERISTIC KL_TSYNCGHINSYNEKZUSP21 "Zeit fuer Ende Haltephase in Synchron KZU" CURVE 0x1C7D84 ZF_kl_ui8_S5_S3 2550 UMR_MSEC__10_1_M128_S5_S3 -1280 1270
 /begin AXIS_DESCR STD_AXIS zff_atsys._.iSignale._.obj.sig_c_getr UMR_GRADC__1_1_M40_S5_S3 4 -40 150 DEPOSIT ABSOLUTE /end AXIS_DESCR
/end CHARACTERISTIC
/begin CHARACTERISTIC KL_TSYNCGHINSYNEKZUSP31 "Zeit fuer Ende Haltephase in Synchron KZU" CURVE 0x1C8938 ZF_kl_ui8_S5_S3 2550 UMR_MSEC__10_1_M128_S5_S3 -1280 1270
 /begin AXIS_DESCR STD_AXIS zff_atsys._.iSignale._.obj.sig_c_getr UMR_GRADC__1_1_M40_S5_S3 4 -40 150 DEPOSIT ABSOLUTE /end AXIS_DESCR
/end CHARACTERISTIC
/begin CHARACTERISTIC KL_TSYNCGHINSYNEKZUSP32 "Zeit fuer Ende Haltephase in Synchron KZU" CURVE 0x1C7F30 ZF_kl_ui8_S5_S3 2550 UMR_MSEC__10_1_M128_S5_S3 -1280 1270
 /begin AXIS_DESCR STD_AXIS zff_atsys._.iSignale._.obj.sig_c_getr UMR_GRADC__1_1_M40_S5_S3 4 -40 150 DEPOSIT ABSOLUTE /end AXIS_DESCR
/end CHARACTERISTIC
/begin CHARACTERISTIC KL_TSYNCGHINSYNEKZUSP42 "Zeit fuer Ende Haltephase in Synchron KZU" CURVE 0x1C8AE4 ZF_kl_ui8_S5_S3 2550 UMR_MSEC__10_1_M128_S5_S3 -1280 1270
 /begin AXIS_DESCR STD_AXIS zff_atsys._.iSignale._.obj.sig_c_getr UMR_GRADC__1_1_M40_S5_S3 4 -40 150 DEPOSIT ABSOLUTE /end AXIS_DESCR
/end CHARACTERISTIC
/begin CHARACTERISTIC KL_TSYNCGHINSYNEKZUSP43 "Zeit fuer Ende Haltephase in Synchron KZU" CURVE 0x1C80DC ZF_kl_ui8_S5_S3 2550 UMR_MSEC__10_1_M128_S5_S3 -1280 1270
 /begin AXIS_DESCR STD_AXIS zff_atsys._.iSignale._.obj.sig_c_getr UMR_GRADC__1_1_M40_S5_S3 4 -40 150 DEPOSIT ABSOLUTE /end AXIS_DESCR
/end CHARACTERISTIC
/begin CHARACTERISTIC KL_TSYNCGHINSYNEKZUSP51 "Zeit fuer Ende Haltephase in Synchron KZU" CURVE 0x1C8C90 ZF_kl_ui8_S5_S3 2550 UMR_MSEC__10_1_M128_S5_S3 -1280 1270
 /begin AXIS_DESCR STD_AXIS zff_atsys._.iSignale._.obj.sig_c_getr UMR_GRADC__1_1_M40_S5_S3 4 -40 150 DEPOSIT ABSOLUTE /end AXIS_DESCR
/end CHARACTERISTIC
/begin CHARACTERISTIC KL_TSYNCGHINSYNEKZUSP53 "Zeit fuer Ende Haltephase in Synchron KZU" CURVE 0x1C8E3C ZF_kl_ui8_S5_S3 2550 UMR_MSEC__10_1_M128_S5_S3 -1280 1270
 /begin AXIS_DESCR STD_AXIS zff_atsys._.iSignale._.obj.sig_c_getr UMR_GRADC__1_1_M40_S5_S3 4 -40 150 DEPOSIT ABSOLUTE /end AXIS_DESCR
/end CHARACTERISTIC
/begin CHARACTERISTIC KL_TSYNCGHINSYNEKZUSP54 "Zeit fuer Ende Haltephase in Synchron KZU" CURVE 0x1C8288 ZF_kl_ui8_S5_S3 2550 UMR_MSEC__10_1_M128_S5_S3 -1280 1270
 /begin AXIS_DESCR STD_AXIS zff_atsys._.iSignale._.obj.sig_c_getr UMR_GRADC__1_1_M40_S5_S3 4 -40 150 DEPOSIT ABSOLUTE /end AXIS_DESCR
/end CHARACTERISTIC
/begin CHARACTERISTIC KL_TSYNCGHINSYNEKZUSP63 "Zeit fuer Ende Haltephase in Synchron KZU" CURVE 0x1C8FE8 ZF_kl_ui8_S5_S3 2550 UMR_MSEC__10_1_M128_S5_S3 -1280 1270
 /begin AXIS_DESCR STD_AXIS zff_atsys._.iSignale._.obj.sig_c_getr UMR_GRADC__1_1_M40_S5_S3 4 -40 150 DEPOSIT ABSOLUTE /end AXIS_DESCR
/end CHARACTERISTIC
/begin CHARACTERISTIC KL_TSYNCGHINSYNEKZUSP64 "Zeit fuer Ende Haltephase in Synchron KZU" CURVE 0x1C9194 ZF_kl_ui8_S5_S3 2550 UMR_MSEC__10_1_M128_S5_S3 -1280 1270
 /begin AXIS_DESCR STD_AXIS zff_atsys._.iSignale._.obj.sig_c_getr UMR_GRADC__1_1_M40_S5_S3 4 -40 150 DEPOSIT ABSOLUTE /end AXIS_DESCR
/end CHARACTERISTIC
/begin CHARACTERISTIC KL_TSYNCGHINSYNEKZUSP65 "Zeit fuer Ende Haltephase in Synchron KZU" CURVE 0x1C8434 ZF_kl_ui8_S5_S3 2550 UMR_MSEC__10_1_M128_S5_S3 -1280 1270
 /begin AXIS_DESCR STD_AXIS zff_atsys._.iSignale._.obj.sig_c_getr UMR_GRADC__1_1_M40_S5_S3 4 -40 150 DEPOSIT ABSOLUTE /end AXIS_DESCR
/end CHARACTERISTIC
/begin CHARACTERISTIC KL_TSYNCGHINSYNEKZUSP71 "Zeit fuer Ende Haltephase in Synchron KZU" CURVE 0x1C9340 ZF_kl_ui8_S5_S3 2550 UMR_MSEC__10_1_M128_S5_S3 -1280 1270
 /begin AXIS_DESCR STD_AXIS zff_atsys._.iSignale._.obj.sig_c_getr UMR_GRADC__1_1_M40_S5_S3 4 -40 150 DEPOSIT ABSOLUTE /end AXIS_DESCR
/end CHARACTERISTIC
/begin CHARACTERISTIC KL_TSYNCGHINSYNEKZUSP75 "Zeit fuer Ende Haltephase in Synchron KZU" CURVE 0x1C94EC ZF_kl_ui8_S5_S3 2550 UMR_MSEC__10_1_M128_S5_S3 -1280 1270
 /begin AXIS_DESCR STD_AXIS zff_atsys._.iSignale._.obj.sig_c_getr UMR_GRADC__1_1_M40_S5_S3 4 -40 150 DEPOSIT ABSOLUTE /end AXIS_DESCR
/end CHARACTERISTIC
/begin CHARACTERISTIC KL_TSYNCGHINSYNEKZUSP76 "Zeit fuer Ende Haltephase in Synchron KZU" CURVE 0x1C85E0 ZF_kl_ui8_S5_S3 2550 UMR_MSEC__10_1_M128_S5_S3 -1280 1270
 /begin AXIS_DESCR STD_AXIS zff_atsys._.iSignale._.obj.sig_c_getr UMR_GRADC__1_1_M40_S5_S3 4 -40 150 DEPOSIT ABSOLUTE /end AXIS_DESCR
/end CHARACTERISTIC
/begin CHARACTERISTIC KL_TSYNCGHINSYNEKZUSP82 "Zeit fuer Ende Haltephase in Synchron KZU" CURVE 0x1C9698 ZF_kl_ui8_S5_S3 2550 UMR_MSEC__10_1_M128_S5_S3 -1280 1270
 /begin AXIS_DESCR STD_AXIS zff_atsys._.iSignale._.obj.sig_c_getr UMR_GRADC__1_1_M40_S5_S3 4 -40 150 DEPOSIT ABSOLUTE /end AXIS_DESCR
/end CHARACTERISTIC
/begin CHARACTERISTIC KL_TSYNCGHINSYNEKZUSP84 "Zeit fuer Ende Haltephase in Synchron KZU" CURVE 0x1C9844 ZF_kl_ui8_S5_S3 2550 UMR_MSEC__10_1_M128_S5_S3 -1280 1270
 /begin AXIS_DESCR STD_AXIS zff_atsys._.iSignale._.obj.sig_c_getr UMR_GRADC__1_1_M40_S5_S3 4 -40 150 DEPOSIT ABSOLUTE /end AXIS_DESCR
/end CHARACTERISTIC
/begin CHARACTERISTIC KL_TSYNCGHINSYNEKZUSP86 "Zeit fuer Ende Haltephase in Synchron KZU" CURVE 0x1C99F0 ZF_kl_ui8_S5_S3 2550 UMR_MSEC__10_1_M128_S5_S3 -1280 1270
 /begin AXIS_DESCR STD_AXIS zff_atsys._.iSignale._.obj.sig_c_getr UMR_GRADC__1_1_M40_S5_S3 4 -40 150 DEPOSIT ABSOLUTE /end AXIS_DESCR
/end CHARACTERISTIC
/begin CHARACTERISTIC KL_TSYNCGHINSYNEKZUSP87 "Zeit fuer Ende Haltephase in Synchron KZU" CURVE 0x1C878C ZF_kl_ui8_S5_S3 2550 UMR_MSEC__10_1_M128_S5_S3 -1280 1270
 /begin AXIS_DESCR STD_AXIS zff_atsys._.iSignale._.obj.sig_c_getr UMR_GRADC__1_1_M40_S5_S3 4 -40 150 DEPOSIT ABSOLUTE /end AXIS_DESCR
/end CHARACTERISTIC
/begin CHARACTERISTIC KL_TSYNCGHINSYNEKZUSPORT21 "Zeit fuer Ende Haltephase in Synchron KZU" CURVE 0x1C9B9C ZF_kl_ui8_S5_S3 2550 UMR_MSEC__10_1_M128_S5_S3 -1280 1270
 /begin AXIS_DESCR STD_AXIS zff_atsys._.iSignale._.obj.sig_c_getr UMR_GRADC__1_1_M40_S5_S3 4 -40 150 DEPOSIT ABSOLUTE /end AXIS_DESCR
/end CHARACTERISTIC
/begin CHARACTERISTIC KL_TSYNCGHINSYNEKZUSPORT31 "Zeit fuer Ende Haltephase in Synchron KZU" CURVE 0x1CA750 ZF_kl_ui8_S5_S3 2550 UMR_MSEC__10_1_M128_S5_S3 -1280 1270
 /begin AXIS_DESCR STD_AXIS zff_atsys._.iSignale._.obj.sig_c_getr UMR_GRADC__1_1_M40_S5_S3 4 -40 150 DEPOSIT ABSOLUTE /end AXIS_DESCR
/end CHARACTERISTIC
/begin CHARACTERISTIC KL_TSYNCGHINSYNEKZUSPORT32 "Zeit fuer Ende Haltephase in Synchron KZU" CURVE 0x1C9D48 ZF_kl_ui8_S5_S3 2550 UMR_MSEC__10_1_M128_S5_S3 -1280 1270
 /begin AXIS_DESCR STD_AXIS zff_atsys._.iSignale._.obj.sig_c_getr UMR_GRADC__1_1_M40_S5_S3 4 -40 150 DEPOSIT ABSOLUTE /end AXIS_DESCR
/end CHARACTERISTIC
/begin CHARACTERISTIC KL_TSYNCGHINSYNEKZUSPORT42 "Zeit fuer Ende Haltephase in Synchron KZU" CURVE 0x1CA8FC ZF_kl_ui8_S5_S3 2550 UMR_MSEC__10_1_M128_S5_S3 -1280 1270
 /begin AXIS_DESCR STD_AXIS zff_atsys._.iSignale._.obj.sig_c_getr UMR_GRADC__1_1_M40_S5_S3 4 -40 150 DEPOSIT ABSOLUTE /end AXIS_DESCR
/end CHARACTERISTIC
/begin CHARACTERISTIC KL_TSYNCGHINSYNEKZUSPORT43 "Zeit fuer Ende Haltephase in Synchron KZU" CURVE 0x1C9EF4 ZF_kl_ui8_S5_S3 2550 UMR_MSEC__10_1_M128_S5_S3 -1280 1270
 /begin AXIS_DESCR STD_AXIS zff_atsys._.iSignale._.obj.sig_c_getr UMR_GRADC__1_1_M40_S5_S3 4 -40 150 DEPOSIT ABSOLUTE /end AXIS_DESCR
/end CHARACTERISTIC
/begin CHARACTERISTIC KL_TSYNCGHINSYNEKZUSPORT51 "Zeit fuer Ende Haltephase in Synchron KZU" CURVE 0x1CAAA8 ZF_kl_ui8_S5_S3 2550 UMR_MSEC__10_1_M128_S5_S3 -1280 1270
 /begin AXIS_DESCR STD_AXIS zff_atsys._.iSignale._.obj.sig_c_getr UMR_GRADC__1_1_M40_S5_S3 4 -40 150 DEPOSIT ABSOLUTE /end AXIS_DESCR
/end CHARACTERISTIC
/begin CHARACTERISTIC KL_TSYNCGHINSYNEKZUSPORT53 "Zeit fuer Ende Haltephase in Synchron KZU" CURVE 0x1CAC54 ZF_kl_ui8_S5_S3 2550 UMR_MSEC__10_1_M128_S5_S3 -1280 1270
 /begin AXIS_DESCR STD_AXIS zff_atsys._.iSignale._.obj.sig_c_getr UMR_GRADC__1_1_M40_S5_S3 4 -40 150 DEPOSIT ABSOLUTE /end AXIS_DESCR
/end CHARACTERISTIC
/begin CHARACTERISTIC KL_TSYNCGHINSYNEKZUSPORT54 "Zeit fuer Ende Haltephase in Synchron KZU" CURVE 0x1CA0A0 ZF_kl_ui8_S5_S3 2550 UMR_MSEC__10_1_M128_S5_S3 -1280 1270
 /begin AXIS_DESCR STD_AXIS zff_atsys._.iSignale._.obj.sig_c_getr UMR_GRADC__1_1_M40_S5_S3 4 -40 150 DEPOSIT ABSOLUTE /end AXIS_DESCR
/end CHARACTERISTIC
/begin CHARACTERISTIC KL_TSYNCGHINSYNEKZUSPORT63 "Zeit fuer Ende Haltephase in Synchron KZU" CURVE 0x1CAE00 ZF_kl_ui8_S5_S3 2550 UMR_MSEC__10_1_M128_S5_S3 -1280 1270
 /begin AXIS_DESCR STD_AXIS zff_atsys._.iSignale._.obj.sig_c_getr UMR_GRADC__1_1_M40_S5_S3 4 -40 150 DEPOSIT ABSOLUTE /end AXIS_DESCR
/end CHARACTERISTIC
/begin CHARACTERISTIC KL_TSYNCGHINSYNEKZUSPORT64 "Zeit fuer Ende Haltephase in Synchron KZU" CURVE 0x1CAFAC ZF_kl_ui8_S5_S3 2550 UMR_MSEC__10_1_M128_S5_S3 -1280 1270
 /begin AXIS_DESCR STD_AXIS zff_atsys._.iSignale._.obj.sig_c_getr UMR_GRADC__1_1_M40_S5_S3 4 -40 150 DEPOSIT ABSOLUTE /end AXIS_DESCR
/end CHARACTERISTIC
/begin CHARACTERISTIC KL_TSYNCGHINSYNEKZUSPORT65 "Zeit fuer Ende Haltephase in Synchron KZU" CURVE 0x1CA24C ZF_kl_ui8_S5_S3 2550 UMR_MSEC__10_1_M128_S5_S3 -1280 1270
 /begin AXIS_DESCR STD_AXIS zff_atsys._.iSignale._.obj.sig_c_getr UMR_GRADC__1_1_M40_S5_S3 4 -40 150 DEPOSIT ABSOLUTE /end AXIS_DESCR
/end CHARACTERISTIC
/begin CHARACTERISTIC KL_TSYNCGHINSYNEKZUSPORT71 "Zeit fuer Ende Haltephase in Synchron KZU" CURVE 0x1CB158 ZF_kl_ui8_S5_S3 2550 UMR_MSEC__10_1_M128_S5_S3 -1280 1270
 /begin AXIS_DESCR STD_AXIS zff_atsys._.iSignale._.obj.sig_c_getr UMR_GRADC__1_1_M40_S5_S3 4 -40 150 DEPOSIT ABSOLUTE /end AXIS_DESCR
/end CHARACTERISTIC
/begin CHARACTERISTIC KL_TSYNCGHINSYNEKZUSPORT75 "Zeit fuer Ende Haltephase in Synchron KZU" CURVE 0x1CB304 ZF_kl_ui8_S5_S3 2550 UMR_MSEC__10_1_M128_S5_S3 -1280 1270
 /begin AXIS_DESCR STD_AXIS zff_atsys._.iSignale._.obj.sig_c_getr UMR_GRADC__1_1_M40_S5_S3 4 -40 150 DEPOSIT ABSOLUTE /end AXIS_DESCR
/end CHARACTERISTIC
/begin CHARACTERISTIC KL_TSYNCGHINSYNEKZUSPORT76 "Zeit fuer Ende Haltephase in Synchron KZU" CURVE 0x1CA3F8 ZF_kl_ui8_S5_S3 2550 UMR_MSEC__10_1_M128_S5_S3 -1280 1270
 /begin AXIS_DESCR STD_AXIS zff_atsys._.iSignale._.obj.sig_c_getr UMR_GRADC__1_1_M40_S5_S3 4 -40 150 DEPOSIT ABSOLUTE /end AXIS_DESCR
/end CHARACTERISTIC
/begin CHARACTERISTIC KL_TSYNCGHINSYNEKZUSPORT82 "Zeit fuer Ende Haltephase in Synchron KZU" CURVE 0x1CB4B0 ZF_kl_ui8_S5_S3 2550 UMR_MSEC__10_1_M128_S5_S3 -1280 1270
 /begin AXIS_DESCR STD_AXIS zff_atsys._.iSignale._.obj.sig_c_getr UMR_GRADC__1_1_M40_S5_S3 4 -40 150 DEPOSIT ABSOLUTE /end AXIS_DESCR
/end CHARACTERISTIC
/begin CHARACTERISTIC KL_TSYNCGHINSYNEKZUSPORT84 "Zeit fuer Ende Haltephase in Synchron KZU" CURVE 0x1CB65C ZF_kl_ui8_S5_S3 2550 UMR_MSEC__10_1_M128_S5_S3 -1280 1270
 /begin AXIS_DESCR STD_AXIS zff_atsys._.iSignale._.obj.sig_c_getr UMR_GRADC__1_1_M40_S5_S3 4 -40 150 DEPOSIT ABSOLUTE /end AXIS_DESCR
/end CHARACTERISTIC
/begin CHARACTERISTIC KL_TSYNCGHINSYNEKZUSPORT86 "Zeit fuer Ende Haltephase in Synchron KZU" CURVE 0x1CB808 ZF_kl_ui8_S5_S3 2550 UMR_MSEC__10_1_M128_S5_S3 -1280 1270
 /begin AXIS_DESCR STD_AXIS zff_atsys._.iSignale._.obj.sig_c_getr UMR_GRADC__1_1_M40_S5_S3 4 -40 150 DEPOSIT ABSOLUTE /end AXIS_DESCR
/end CHARACTERISTIC
/begin CHARACTERISTIC KL_TSYNCGHINSYNEKZUSPORT87 "Zeit fuer Ende Haltephase in Synchron KZU" CURVE 0x1CA5A4 ZF_kl_ui8_S5_S3 2550 UMR_MSEC__10_1_M128_S5_S3 -1280 1270
 /begin AXIS_DESCR STD_AXIS zff_atsys._.iSignale._.obj.sig_c_getr UMR_GRADC__1_1_M40_S5_S3 4 -40 150 DEPOSIT ABSOLUTE /end AXIS_DESCR
/end CHARACTERISTIC
/begin CHARACTERISTIC KL_TSYNCGRAKZU21 "Zeit vor sync. Ende Schaltdruck/Start 3. Rampe KZU" CURVE 0x1CBA34 ZF_kl_ui8_S5_S3 1280 UMR_MSEC__10_1_M128_S5_S3 -1280 0
 /begin AXIS_DESCR STD_AXIS zff_atsys._.iSignale._.obj.sig_c_getr UMR_GRADC__1_1_M40_S5_S3 4 -40 215 DEPOSIT ABSOLUTE /end AXIS_DESCR
/end CHARACTERISTIC
/begin CHARACTERISTIC KL_TSYNCGRAKZU32 "Zeit vor sync. Ende Schaltdruck/Start 3. Rampe KZU" CURVE 0x1CBC80 ZF_kl_ui8_S5_S3 1280 UMR_MSEC__10_1_M128_S5_S3 -1280 0
 /begin AXIS_DESCR STD_AXIS zff_atsys._.iSignale._.obj.sig_c_getr UMR_GRADC__1_1_M40_S5_S3 4 -40 215 DEPOSIT ABSOLUTE /end AXIS_DESCR
/end CHARACTERISTIC
/begin CHARACTERISTIC KL_TSYNCGRAKZU43 "Zeit vor sync. Ende Schaltdruck/Start 3. Rampe KZU" CURVE 0x1CBECC ZF_kl_ui8_S5_S3 1280 UMR_MSEC__10_1_M128_S5_S3 -1280 0
 /begin AXIS_DESCR STD_AXIS zff_atsys._.iSignale._.obj.sig_c_getr UMR_GRADC__1_1_M40_S5_S3 4 -40 215 DEPOSIT ABSOLUTE /end AXIS_DESCR
/end CHARACTERISTIC
/begin CHARACTERISTIC KL_TSYNCGRAKZU54 "Zeit vor sync. Ende Schaltdruck/Start 3. Rampe KZU" CURVE 0x1CC118 ZF_kl_ui8_S5_S3 1280 UMR_MSEC__10_1_M128_S5_S3 -1280 0
 /begin AXIS_DESCR STD_AXIS zff_atsys._.iSignale._.obj.sig_c_getr UMR_GRADC__1_1_M40_S5_S3 4 -40 215 DEPOSIT ABSOLUTE /end AXIS_DESCR
/end CHARACTERISTIC
/begin CHARACTERISTIC KL_TSYNCGRAKZUSP31 "Zeit vor sync. Ende Schaltdruck/Start 3. Rampe KZU" CURVE 0x1CCA48 ZF_kl_ui8_S5_S3 1280 UMR_MSEC__10_1_M128_S5_S3 -1280 0
 /begin AXIS_DESCR STD_AXIS zff_atsys._.iSignale._.obj.sig_c_getr UMR_GRADC__1_1_M40_S5_S3 4 -40 215 DEPOSIT ABSOLUTE /end AXIS_DESCR
/end CHARACTERISTIC
/begin CHARACTERISTIC KL_TSYNCGRAKZUSP42 "Zeit vor sync. Ende Schaltdruck/Start 3. Rampe KZU" CURVE 0x1CCC94 ZF_kl_ui8_S5_S3 1280 UMR_MSEC__10_1_M128_S5_S3 -1280 0
 /begin AXIS_DESCR STD_AXIS zff_atsys._.iSignale._.obj.sig_c_getr UMR_GRADC__1_1_M40_S5_S3 4 -40 215 DEPOSIT ABSOLUTE /end AXIS_DESCR
/end CHARACTERISTIC
/begin CHARACTERISTIC KL_TSYNCGRAKZUSP51 "Zeit vor sync. Ende Schaltdruck/Start 3. Rampe KZU" CURVE 0x1CCEE0 ZF_kl_ui8_S5_S3 1280 UMR_MSEC__10_1_M128_S5_S3 -1280 0
 /begin AXIS_DESCR STD_AXIS zff_atsys._.iSignale._.obj.sig_c_getr UMR_GRADC__1_1_M40_S5_S3 4 -40 215 DEPOSIT ABSOLUTE /end AXIS_DESCR
/end CHARACTERISTIC
/begin CHARACTERISTIC KL_TSYNCGRAKZUSP53 "Zeit vor sync. Ende Schaltdruck/Start 3. Rampe KZU" CURVE 0x1CD12C ZF_kl_ui8_S5_S3 1280 UMR_MSEC__10_1_M128_S5_S3 -1280 0
 /begin AXIS_DESCR STD_AXIS zff_atsys._.iSignale._.obj.sig_c_getr UMR_GRADC__1_1_M40_S5_S3 4 -40 215 DEPOSIT ABSOLUTE /end AXIS_DESCR
/end CHARACTERISTIC
/begin CHARACTERISTIC KL_TSYNCGRAKZUSP63 "Zeit vor sync. Ende Schaltdruck/Start 3. Rampe KZU" CURVE 0x1CD378 ZF_kl_ui8_S5_S3 1280 UMR_MSEC__10_1_M128_S5_S3 -1280 0
 /begin AXIS_DESCR STD_AXIS zff_atsys._.iSignale._.obj.sig_c_getr UMR_GRADC__1_1_M40_S5_S3 4 -40 215 DEPOSIT ABSOLUTE /end AXIS_DESCR
/end CHARACTERISTIC
/begin CHARACTERISTIC T_F32 "Fuellzeit" VALUE 0x1D7B17 ZF_kw_ui8_S5_S3 2540 UMR_MSEC__10_1_0_S5_S3 0 2540 /end CHARACTERISTIC
/begin CHARACTERISTIC T_F32_EL "Fuellzeit" VALUE 0x1D7B18 ZF_kw_ui8_S5_S3 2540 UMR_MSEC__10_1_0_S5_S3 0 2540 /end CHARACTERISTIC
/begin CHARACTERISTIC T_F43 "Fuellzeit" VALUE 0x1D7B1D ZF_kw_ui8_S5_S3 2540 UMR_MSEC__10_1_0_S5_S3 0 2540 /end CHARACTERISTIC
/begin CHARACTERISTIC T_F43_EL "Fuellzeit" VALUE 0x1D7B1E ZF_kw_ui8_S5_S3 2540 UMR_MSEC__10_1_0_S5_S3 0 2540 /end CHARACTERISTIC
/begin CHARACTERISTIC T_F54 "Fuellzeit" VALUE 0x1D7B23 ZF_kw_ui8_S5_S3 2540 UMR_MSEC__10_1_0_S5_S3 0 2540 /end CHARACTERISTIC
/begin CHARACTERISTIC T_F54_EL "Fuellzeit" VALUE 0x1D7B24 ZF_kw_ui8_S5_S3 2540 UMR_MSEC__10_1_0_S5_S3 0 2540 /end CHARACTERISTIC
/begin CHARACTERISTIC T_F65 "Fuellzeit" VALUE 0x1D7B29 ZF_kw_ui8_S5_S3 2540 UMR_MSEC__10_1_0_S5_S3 0 2540 /end CHARACTERISTIC
/begin CHARACTERISTIC T_F65_EL "Fuellzeit" VALUE 0x1D7B2A ZF_kw_ui8_S5_S3 2540 UMR_MSEC__10_1_0_S5_S3 0 2540 /end CHARACTERISTIC
/begin CHARACTERISTIC T_F76 "Fuellzeit" VALUE 0x1D7B2F ZF_kw_ui8_S5_S3 2540 UMR_MSEC__10_1_0_S5_S3 0 2540 /end CHARACTERISTIC
/begin CHARACTERISTIC T_F76_EL "Fuellzeit" VALUE 0x1D7B30 ZF_kw_ui8_S5_S3 2540 UMR_MSEC__10_1_0_S5_S3 0 2540 /end CHARACTERISTIC
/begin CHARACTERISTIC T_F87 "Fuellzeit" VALUE 0x1D7B35 ZF_kw_ui8_S5_S3 2540 UMR_MSEC__10_1_0_S5_S3 0 2540 /end CHARACTERISTIC
/begin CHARACTERISTIC T_F87_EL "Fuellzeit" VALUE 0x1D7B36 ZF_kw_ui8_S5_S3 2540 UMR_MSEC__10_1_0_S5_S3 0 2540 /end CHARACTERISTIC
/begin CHARACTERISTIC T_FFUELLRED21 "Fuellzeit reduzierte Befüllung" VALUE 0x1D7BA5 ZF_kw_ui8_S5_S3 2540 UMR_MSEC__10_1_0_S5_S3 0 2540 /end CHARACTERISTIC
/begin CHARACTERISTIC T_FFUELLRED32 "Fuellzeit reduzierte Befüllung" VALUE 0x1D7BA9 ZF_kw_ui8_S5_S3 2540 UMR_MSEC__10_1_0_S5_S3 0 2540 /end CHARACTERISTIC
/begin CHARACTERISTIC T_FFUELLRED43 "Fuellzeit reduzierte Befüllung" VALUE 0x1D7BAD ZF_kw_ui8_S5_S3 2540 UMR_MSEC__10_1_0_S5_S3 0 2540 /end CHARACTERISTIC
/begin CHARACTERISTIC T_FFUELLRED54 "Fuellzeit reduzierte Befüllung" VALUE 0x1D7BB1 ZF_kw_ui8_S5_S3 2540 UMR_MSEC__10_1_0_S5_S3 0 2540 /end CHARACTERISTIC
/begin CHARACTERISTIC T_FFUELLREDSP31 "Fuellzeit reduzierte Befüllung" VALUE 0x1D7BC1 ZF_kw_ui8_S5_S3 2540 UMR_MSEC__10_1_0_S5_S3 0 2540 /end CHARACTERISTIC
/begin CHARACTERISTIC T_FFUELLREDSP42 "Fuellzeit reduzierte Befüllung" VALUE 0x1D7BC5 ZF_kw_ui8_S5_S3 2540 UMR_MSEC__10_1_0_S5_S3 0 2540 /end CHARACTERISTIC
/begin CHARACTERISTIC T_FFUELLREDSP51 "Fuellzeit reduzierte Befüllung" VALUE 0x1D7BC9 ZF_kw_ui8_S5_S3 2540 UMR_MSEC__10_1_0_S5_S3 0 2540 /end CHARACTERISTIC
/begin CHARACTERISTIC T_FFUELLREDSP53 "Fuellzeit reduzierte Befüllung" VALUE 0x1D7BCD ZF_kw_ui8_S5_S3 2540 UMR_MSEC__10_1_0_S5_S3 0 2540 /end CHARACTERISTIC
/begin CHARACTERISTIC T_FFUELLREDSP63 "Fuellzeit reduzierte Befüllung" VALUE 0x1D7BD1 ZF_kw_ui8_S5_S3 2540 UMR_MSEC__10_1_0_S5_S3 0 2540 /end CHARACTERISTIC
/begin CHARACTERISTIC T_FSP21 "Fuellzeit" VALUE 0x1D7B39 ZF_kw_ui8_S5_S3 2540 UMR_MSEC__10_1_0_S5_S3 0 2540 /end CHARACTERISTIC
/begin CHARACTERISTIC T_FSP31 "Fuellzeit" VALUE 0x1D7B4E ZF_kw_ui8_S5_S3 2540 UMR_MSEC__10_1_0_S5_S3 0 2540 /end CHARACTERISTIC
/begin CHARACTERISTIC T_FSP32 "Fuellzeit" VALUE 0x1D7B3C ZF_kw_ui8_S5_S3 2540 UMR_MSEC__10_1_0_S5_S3 0 2540 /end CHARACTERISTIC
/begin CHARACTERISTIC T_FSP42 "Fuellzeit" VALUE 0x1D7B51 ZF_kw_ui8_S5_S3 2540 UMR_MSEC__10_1_0_S5_S3 0 2540 /end CHARACTERISTIC
/begin CHARACTERISTIC T_FSP43 "Fuellzeit" VALUE 0x1D7B3F ZF_kw_ui8_S5_S3 2540 UMR_MSEC__10_1_0_S5_S3 0 2540 /end CHARACTERISTIC
/begin CHARACTERISTIC T_FSP51 "Fuellzeit" VALUE 0x1D7B54 ZF_kw_ui8_S5_S3 2540 UMR_MSEC__10_1_0_S5_S3 0 2540 /end CHARACTERISTIC
/begin CHARACTERISTIC T_FSP53 "Fuellzeit" VALUE 0x1D7B57 ZF_kw_ui8_S5_S3 2540 UMR_MSEC__10_1_0_S5_S3 0 2540 /end CHARACTERISTIC
/begin CHARACTERISTIC T_FSP54 "Fuellzeit" VALUE 0x1D7B42 ZF_kw_ui8_S5_S3 2540 UMR_MSEC__10_1_0_S5_S3 0 2540 /end CHARACTERISTIC
/begin CHARACTERISTIC T_FSP63 "Fuellzeit" VALUE 0x1D7B5A ZF_kw_ui8_S5_S3 2540 UMR_MSEC__10_1_0_S5_S3 0 2540 /end CHARACTERISTIC
/begin CHARACTERISTIC T_FSP64 "Fuellzeit" VALUE 0x1D7B5D ZF_kw_ui8_S5_S3 2540 UMR_MSEC__10_1_0_S5_S3 0 2540 /end CHARACTERISTIC
/begin CHARACTERISTIC T_FSP65 "Fuellzeit" VALUE 0x1D7B45 ZF_kw_ui8_S5_S3 2540 UMR_MSEC__10_1_0_S5_S3 0 2540 /end CHARACTERISTIC
/begin CHARACTERISTIC T_FSP71 "Fuellzeit" VALUE 0x1D7B60 ZF_kw_ui8_S5_S3 2540 UMR_MSEC__10_1_0_S5_S3 0 2540 /end CHARACTERISTIC
/begin CHARACTERISTIC T_FSP75 "Fuellzeit" VALUE 0x1D7B63 ZF_kw_ui8_S5_S3 2540 UMR_MSEC__10_1_0_S5_S3 0 2540 /end CHARACTERISTIC
/begin CHARACTERISTIC T_FSP76 "Fuellzeit" VALUE 0x1D7B48 ZF_kw_ui8_S5_S3 2540 UMR_MSEC__10_1_0_S5_S3 0 2540 /end CHARACTERISTIC
/begin CHARACTERISTIC T_FSP82 "Fuellzeit" VALUE 0x1D7B66 ZF_kw_ui8_S5_S3 2540 UMR_MSEC__10_1_0_S5_S3 0 2540 /end CHARACTERISTIC
/begin CHARACTERISTIC T_FSP84 "Fuellzeit" VALUE 0x1D7B69 ZF_kw_ui8_S5_S3 2540 UMR_MSEC__10_1_0_S5_S3 0 2540 /end CHARACTERISTIC
/begin CHARACTERISTIC T_FSP86 "Fuellzeit" VALUE 0x1D7B6C ZF_kw_ui8_S5_S3 2540 UMR_MSEC__10_1_0_S5_S3 0 2540 /end CHARACTERISTIC
/begin CHARACTERISTIC T_FSP87 "Fuellzeit" VALUE 0x1D7B4B ZF_kw_ui8_S5_S3 2540 UMR_MSEC__10_1_0_S5_S3 0 2540 /end CHARACTERISTIC
/begin CHARACTERISTIC T_FSPORT21 "Fuellzeit" VALUE 0x1D7B6F ZF_kw_ui8_S5_S3 2540 UMR_MSEC__10_1_0_S5_S3 0 2540 /end CHARACTERISTIC
/begin CHARACTERISTIC T_FSPORT31 "Fuellzeit" VALUE 0x1D7B84 ZF_kw_ui8_S5_S3 2540 UMR_MSEC__10_1_0_S5_S3 0 2540 /end CHARACTERISTIC
/begin CHARACTERISTIC T_FSPORT32 "Fuellzeit" VALUE 0x1D7B72 ZF_kw_ui8_S5_S3 2540 UMR_MSEC__10_1_0_S5_S3 0 2540 /end CHARACTERISTIC
/begin CHARACTERISTIC T_FSPORT42 "Fuellzeit" VALUE 0x1D7B87 ZF_kw_ui8_S5_S3 2540 UMR_MSEC__10_1_0_S5_S3 0 2540 /end CHARACTERISTIC
/begin CHARACTERISTIC T_FSPORT43 "Fuellzeit" VALUE 0x1D7B75 ZF_kw_ui8_S5_S3 2540 UMR_MSEC__10_1_0_S5_S3 0 2540 /end CHARACTERISTIC
/begin CHARACTERISTIC T_FSPORT51 "Fuellzeit" VALUE 0x1D7B8A ZF_kw_ui8_S5_S3 2540 UMR_MSEC__10_1_0_S5_S3 0 2540 /end CHARACTERISTIC
/begin CHARACTERISTIC T_FSPORT53 "Fuellzeit" VALUE 0x1D7B8D ZF_kw_ui8_S5_S3 2540 UMR_MSEC__10_1_0_S5_S3 0 2540 /end CHARACTERISTIC
/begin CHARACTERISTIC T_FSPORT54 "Fuellzeit" VALUE 0x1D7B78 ZF_kw_ui8_S5_S3 2540 UMR_MSEC__10_1_0_S5_S3 0 2540 /end CHARACTERISTIC
/begin CHARACTERISTIC T_FSPORT63 "Fuellzeit" VALUE 0x1D7B90 ZF_kw_ui8_S5_S3 2540 UMR_MSEC__10_1_0_S5_S3 0 2540 /end CHARACTERISTIC
/begin CHARACTERISTIC T_FSPORT64 "Fuellzeit" VALUE 0x1D7B93 ZF_kw_ui8_S5_S3 2540 UMR_MSEC__10_1_0_S5_S3 0 2540 /end CHARACTERISTIC
/begin CHARACTERISTIC T_FSPORT65 "Fuellzeit" VALUE 0x1D7B7B ZF_kw_ui8_S5_S3 2540 UMR_MSEC__10_1_0_S5_S3 0 2540 /end CHARACTERISTIC
/begin CHARACTERISTIC T_FSPORT71 "Fuellzeit" VALUE 0x1D7B96 ZF_kw_ui8_S5_S3 2540 UMR_MSEC__10_1_0_S5_S3 0 2540 /end CHARACTERISTIC
/begin CHARACTERISTIC T_FSPORT75 "Fuellzeit" VALUE 0x1D7B99 ZF_kw_ui8_S5_S3 2540 UMR_MSEC__10_1_0_S5_S3 0 2540 /end CHARACTERISTIC
/begin CHARACTERISTIC T_FSPORT76 "Fuellzeit" VALUE 0x1D7B7E ZF_kw_ui8_S5_S3 2540 UMR_MSEC__10_1_0_S5_S3 0 2540 /end CHARACTERISTIC
/begin CHARACTERISTIC T_FSPORT82 "Fuellzeit" VALUE 0x1D7B9C ZF_kw_ui8_S5_S3 2540 UMR_MSEC__10_1_0_S5_S3 0 2540 /end CHARACTERISTIC
/begin CHARACTERISTIC T_FSPORT84 "Fuellzeit" VALUE 0x1D7B9F ZF_kw_ui8_S5_S3 2540 UMR_MSEC__10_1_0_S5_S3 0 2540 /end CHARACTERISTIC
/begin CHARACTERISTIC T_FSPORT86 "Fuellzeit" VALUE 0x1D7BA2 ZF_kw_ui8_S5_S3 2540 UMR_MSEC__10_1_0_S5_S3 0 2540 /end CHARACTERISTIC
/begin CHARACTERISTIC T_FSPORT87 "Fuellzeit" VALUE 0x1D7B81 ZF_kw_ui8_S5_S3 2540 UMR_MSEC__10_1_0_S5_S3 0 2540 /end CHARACTERISTIC
/begin CHARACTERISTIC T_RA2SSCHR21 "Zeit 2.Rampe bei Schrittschaltung" VALUE 0x1D7BA6 ZF_kw_ui8_S5_S3 2540 UMR_MSEC__10_1_0_S5_S3 0 2540 /end CHARACTERISTIC
/begin CHARACTERISTIC T_RA2SSCHR32 "Zeit 2.Rampe bei Schrittschaltung" VALUE 0x1D7BAA ZF_kw_ui8_S5_S3 2540 UMR_MSEC__10_1_0_S5_S3 0 2540 /end CHARACTERISTIC
/begin CHARACTERISTIC T_RA2SSCHR43 "Zeit 2.Rampe bei Schrittschaltung" VALUE 0x1D7BAE ZF_kw_ui8_S5_S3 2540 UMR_MSEC__10_1_0_S5_S3 0 2540 /end CHARACTERISTIC
/begin CHARACTERISTIC T_RA2SSCHR54 "Zeit 2.Rampe bei Schrittschaltung" VALUE 0x1D7BB2 ZF_kw_ui8_S5_S3 2540 UMR_MSEC__10_1_0_S5_S3 0 2540 /end CHARACTERISTIC
/begin CHARACTERISTIC T_RA2SSCHRSP31 "Zeit 2.Rampe bei Schrittschaltung" VALUE 0x1D7BC2 ZF_kw_ui8_S5_S3 2540 UMR_MSEC__10_1_0_S5_S3 0 2540 /end CHARACTERISTIC
/begin CHARACTERISTIC T_RA2SSCHRSP42 "Zeit 2.Rampe bei Schrittschaltung" VALUE 0x1D7BC6 ZF_kw_ui8_S5_S3 2540 UMR_MSEC__10_1_0_S5_S3 0 2540 /end CHARACTERISTIC
/begin CHARACTERISTIC T_RA2SSCHRSP51 "Zeit 2.Rampe bei Schrittschaltung" VALUE 0x1D7BCA ZF_kw_ui8_S5_S3 2540 UMR_MSEC__10_1_0_S5_S3 0 2540 /end CHARACTERISTIC
/begin CHARACTERISTIC T_RA2SSCHRSP53 "Zeit 2.Rampe bei Schrittschaltung" VALUE 0x1D7BCE ZF_kw_ui8_S5_S3 2540 UMR_MSEC__10_1_0_S5_S3 0 2540 /end CHARACTERISTIC
/begin CHARACTERISTIC T_RA2SSCHRSP63 "Zeit 2.Rampe bei Schrittschaltung" VALUE 0x1D7BD2 ZF_kw_ui8_S5_S3 2540 UMR_MSEC__10_1_0_S5_S3 0 2540 /end CHARACTERISTIC
/begin CHARACTERISTIC T_SYN21 "Zeit n_t innerhalb Synchronschwelle bis Start Rampe 4" VALUE 0x1D7BA3 ZF_kw_ui8_S5_S3 2540 UMR_MSEC__10_1_0_S5_S3 0 2540 /end CHARACTERISTIC
/begin CHARACTERISTIC T_SYN32 "Zeit n_t innerhalb Synchronschwelle bis Start Rampe 4" VALUE 0x1D7BA7 ZF_kw_ui8_S5_S3 2540 UMR_MSEC__10_1_0_S5_S3 0 2540 /end CHARACTERISTIC
/begin CHARACTERISTIC T_SYN43 "Zeit n_t innerhalb Synchronschwelle bis Start Rampe 4" VALUE 0x1D7BAB ZF_kw_ui8_S5_S3 2540 UMR_MSEC__10_1_0_S5_S3 0 2540 /end CHARACTERISTIC
/begin CHARACTERISTIC T_SYN54 "Zeit n_t innerhalb Synchronschwelle bis Start Rampe 4" VALUE 0x1D7BAF ZF_kw_ui8_S5_S3 2540 UMR_MSEC__10_1_0_S5_S3 0 2540 /end CHARACTERISTIC
/begin CHARACTERISTIC T_SYNSP31 "Zeit n_t innerhalb Synchronschwelle bis Start Rampe 4" VALUE 0x1D7BBF ZF_kw_ui8_S5_S3 2540 UMR_MSEC__10_1_0_S5_S3 0 2540 /end CHARACTERISTIC
/begin CHARACTERISTIC T_SYNSP42 "Zeit n_t innerhalb Synchronschwelle bis Start Rampe 4" VALUE 0x1D7BC3 ZF_kw_ui8_S5_S3 2540 UMR_MSEC__10_1_0_S5_S3 0 2540 /end CHARACTERISTIC
/begin CHARACTERISTIC T_SYNSP51 "Zeit n_t innerhalb Synchronschwelle bis Start Rampe 4" VALUE 0x1D7BC7 ZF_kw_ui8_S5_S3 2540 UMR_MSEC__10_1_0_S5_S3 0 2540 /end CHARACTERISTIC
/begin CHARACTERISTIC T_SYNSP53 "Zeit n_t innerhalb Synchronschwelle bis Start Rampe 4" VALUE 0x1D7BCB ZF_kw_ui8_S5_S3 2540 UMR_MSEC__10_1_0_S5_S3 0 2540 /end CHARACTERISTIC
/begin CHARACTERISTIC T_SYNSP63 "Zeit n_t innerhalb Synchronschwelle bis Start Rampe 4" VALUE 0x1D7BCF ZF_kw_ui8_S5_S3 2540 UMR_MSEC__10_1_0_S5_S3 0 2540 /end CHARACTERISTIC
/begin CHARACTERISTIC T_VKZU21 "Verzoegerungszeit Start SF zuschaltende Kupplung" VALUE 0x1D7BA4 ZF_kw_ui8_S5_S3 2540 UMR_MSEC__10_1_0_S5_S3 0 2540 /end CHARACTERISTIC
/begin CHARACTERISTIC T_VKZU32 "Verzoegerungszeit Start SF zuschaltende Kupplung" VALUE 0x1D7BA8 ZF_kw_ui8_S5_S3 2540 UMR_MSEC__10_1_0_S5_S3 0 2540 /end CHARACTERISTIC
/begin CHARACTERISTIC T_VKZU43 "Verzoegerungszeit Start SF zuschaltende Kupplung" VALUE 0x1D7BAC ZF_kw_ui8_S5_S3 2540 UMR_MSEC__10_1_0_S5_S3 0 2540 /end CHARACTERISTIC
/begin CHARACTERISTIC T_VKZU54 "Verzoegerungszeit Start SF zuschaltende Kupplung" VALUE 0x1D7BB0 ZF_kw_ui8_S5_S3 2540 UMR_MSEC__10_1_0_S5_S3 0 2540 /end CHARACTERISTIC
/begin CHARACTERISTIC T_VKZUSP31 "Verzoegerungszeit Start SF zuschaltende Kupplung" VALUE 0x1D7BC0 ZF_kw_ui8_S5_S3 2540 UMR_MSEC__10_1_0_S5_S3 0 2540 /end CHARACTERISTIC
/begin CHARACTERISTIC T_VKZUSP42 "Verzoegerungszeit Start SF zuschaltende Kupplung" VALUE 0x1D7BC4 ZF_kw_ui8_S5_S3 2540 UMR_MSEC__10_1_0_S5_S3 0 2540 /end CHARACTERISTIC
/begin CHARACTERISTIC T_VKZUSP51 "Verzoegerungszeit Start SF zuschaltende Kupplung" VALUE 0x1D7BC8 ZF_kw_ui8_S5_S3 2540 UMR_MSEC__10_1_0_S5_S3 0 2540 /end CHARACTERISTIC
/begin CHARACTERISTIC T_VKZUSP53 "Verzoegerungszeit Start SF zuschaltende Kupplung" VALUE 0x1D7BCC ZF_kw_ui8_S5_S3 2540 UMR_MSEC__10_1_0_S5_S3 0 2540 /end CHARACTERISTIC
/begin CHARACTERISTIC T_VKZUSP63 "Verzoegerungszeit Start SF zuschaltende Kupplung" VALUE 0x1D7BD0 ZF_kw_ui8_S5_S3 2540 UMR_MSEC__10_1_0_S5_S3 0 2540 /end CHARACTERISTIC
/begin FUNCTION jSasKzuRSP132_Fktn "Applikationesgroessen Instanz jSasKzuRSP132"
 /begin DEF_CHARACTERISTIC F_PRA32 F_PRA32_EL F_TRA32 F_TRA32_EL KF_PKZU32 KF_PKZU32_EL KF_POFMTN32 KF_POFMTN32_EL KF_POHINSYNKZU32 KF_TSYN_DT_IG_CHANGE32 KL_TRA32 KL_TRA32_EL KL_TSYNCGHINSYNEKZU32 T_F32 T_F32_EL /end DEF_CHARACTERISTIC
/end FUNCTION
/begin FUNCTION jSasKzuRSP143_Fktn "Applikationesgroessen Instanz jSasKzuRSP143"
 /begin DEF_CHARACTERISTIC F_PRA43 F_PRA43_EL F_TRA43 F_TRA43_EL KF_PKZU43 KF_PKZU43_EL KF_POFMTN43 KF_POFMTN43_EL KF_POHINSYNKZU43 KF_TSYN_DT_IG_CHANGE43 KL_TRA43 KL_TRA43_EL KL_TSYNCGHINSYNEKZU43 T_F43 T_F43_EL /end DEF_CHARACTERISTIC
/end FUNCTION
/begin FUNCTION jSasKzuRSP154_Fktn "Applikationesgroessen Instanz jSasKzuRSP154"
 /begin DEF_CHARACTERISTIC F_PRA54 F_PRA54_EL F_TRA54 F_TRA54_EL KF_PKZU54 KF_PKZU54_EL KF_POFMTN54 KF_POFMTN54_EL KF_POHINSYNKZU54 KF_TSYN_DT_IG_CHANGE54 KL_TRA54 KL_TRA54_EL KL_TSYNCGHINSYNEKZU54 T_F54 T_F54_EL /end DEF_CHARACTERISTIC
/end FUNCTION
/begin FUNCTION jSasKzuRSP165_Fktn "Applikationesgroessen Instanz jSasKzuRSP165"
 /begin DEF_CHARACTERISTIC F_PRA65 F_PRA65_EL F_TRA65 F_TRA65_EL KF_PKZU65 KF_PKZU65_EL KF_POFMTN65 KF_POFMTN65_EL KF_POHINSYNKZU65 KF_TSYN_DT_IG_CHANGE65 KL_TRA65 KL_TRA65_EL KL_TSYNCGHINSYNEKZU65 T_F65 T_F65_EL /end DEF_CHARACTERISTIC
/end FUNCTION
/begin FUNCTION jSasKzuRSP176_Fktn "Applikationesgroessen Instanz jSasKzuRSP176"
 /begin DEF_CHARACTERISTIC F_PRA76 F_PRA76_EL F_TRA76 F_TRA76_EL KF_PKZU76 KF_PKZU76_EL KF_POFMTN76 KF_POFMTN76_EL KF_POHINSYNKZU76 KF_TSYN_DT_IG_CHANGE76 KL_TRA76 KL_TRA76_EL KL_TSYNCGHINSYNEKZU76 T_F76 T_F76_EL /end DEF_CHARACTERISTIC
/end FUNCTION
/begin FUNCTION jSasKzuRSP187_Fktn "Applikationesgroessen Instanz jSasKzuRSP187"
 /begin DEF_CHARACTERISTIC F_PRA87 F_PRA87_EL F_TRA87 F_TRA87_EL KF_PKZU87 KF_PKZU87_EL KF_POFMTN87 KF_POFMTN87_EL KF_POHINSYNKZU87 KF_TSYN_DT_IG_CHANGE87 KL_TRA87 KL_TRA87_EL KL_TSYNCGHINSYNEKZU87 T_F87 T_F87_EL /end DEF_CHARACTERISTIC
/end FUNCTION
/begin FUNCTION jSasKzuRSP221_Fktn "Applikationesgroessen Instanz jSasKzuRSP221"
 /begin DEF_CHARACTERISTIC F_PRASP21 F_TRASP21 KF_PKZUSP21 KF_POFMTNSP21 KF_POHINSYNKZUSP21 KF_TSYN_DT_IG_CHANGESP21 KL_TRASP21 KL_TSYNCGHINSYNEKZUSP21 T_FSP21 /end DEF_CHARACTERISTIC
/end FUNCTION
/begin FUNCTION jSasKzuRSP231_Fktn "Applikationesgroessen Instanz jSasKzuRSP231"
 /begin DEF_CHARACTERISTIC F_PRASP31 F_TRASP31 KF_PKZUSP31 KF_POFMTNSP31 KF_POHINSYNKZUSP31 KF_TSYN_DT_IG_CHANGESP31 KL_TRASP31 KL_TSYNCGHINSYNEKZUSP31 T_FSP31 /end DEF_CHARACTERISTIC
/end FUNCTION
/begin FUNCTION jSasKzuRSP232_Fktn "Applikationesgroessen Instanz jSasKzuRSP232"
 /begin DEF_CHARACTERISTIC F_PRASP32 F_TRASP32 KF_PKZUSP32 KF_POFMTNSP32 KF_POHINSYNKZUSP32 KF_TSYN_DT_IG_CHANGESP32 KL_TRASP32 KL_TSYNCGHINSYNEKZUSP32 T_FSP32 /end DEF_CHARACTERISTIC
/end FUNCTION
/begin FUNCTION jSasKzuRSP242_Fktn "Applikationesgroessen Instanz jSasKzuRSP242"
 /begin DEF_CHARACTERISTIC F_PRASP42 F_TRASP42 KF_PKZUSP42 KF_POFMTNSP42 KF_POHINSYNKZUSP42 KF_TSYN_DT_IG_CHANGESP42 KL_TRASP42 KL_TSYNCGHINSYNEKZUSP42 T_FSP42 /end DEF_CHARACTERISTIC
/end FUNCTION
/begin FUNCTION jSasKzuRSP243_Fktn "Applikationesgroessen Instanz jSasKzuRSP243"
 /begin DEF_CHARACTERISTIC F_PRASP43 F_TRASP43 KF_PKZUSP43 KF_POFMTNSP43 KF_POHINSYNKZUSP43 KF_TSYN_DT_IG_CHANGESP43 KL_TRASP43 KL_TSYNCGHINSYNEKZUSP43 T_FSP43 /end DEF_CHARACTERISTIC
/end FUNCTION
/begin FUNCTION jSasKzuRSP251_Fktn "Applikationesgroessen Instanz jSasKzuRSP251"
 /begin DEF_CHARACTERISTIC F_PRASP51 F_TRASP51 KF_PKZUSP51 KF_POFMTNSP51 KF_POHINSYNKZUSP51 KF_TSYN_DT_IG_CHANGESP51 KL_TRASP51 KL_TSYNCGHINSYNEKZUSP51 T_FSP51 /end DEF_CHARACTERISTIC
/end FUNCTION
/begin FUNCTION jSasKzuRSP253_Fktn "Applikationesgroessen Instanz jSasKzuRSP253"
 /begin DEF_CHARACTERISTIC F_PRASP53 F_TRASP53 KF_PKZUSP53 KF_POFMTNSP53 KF_POHINSYNKZUSP53 KF_TSYN_DT_IG_CHANGESP53 KL_TRASP53 KL_TSYNCGHINSYNEKZUSP53 T_FSP53 /end DEF_CHARACTERISTIC
/end FUNCTION
/begin FUNCTION jSasKzuRSP254_Fktn "Applikationesgroessen Instanz jSasKzuRSP254"
 /begin DEF_CHARACTERISTIC F_PRASP54 F_TRASP54 KF_PKZUSP54 KF_POFMTNSP54 KF_POHINSYNKZUSP54 KF_TSYN_DT_IG_CHANGESP54 KL_TRASP54 KL_TSYNCGHINSYNEKZUSP54 T_FSP54 /end DEF_CHARACTERISTIC
/end FUNCTION
/begin FUNCTION jSasKzuRSP263_Fktn "Applikationesgroessen Instanz jSasKzuRSP263"
 /begin DEF_CHARACTERISTIC F_PRASP63 F_TRASP63 KF_PKZUSP63 KF_POFMTNSP63 KF_POHINSYNKZUSP63 KF_TSYN_DT_IG_CHANGESP63 KL_TRASP63 KL_TSYNCGHINSYNEKZUSP63 T_FSP63 /end DEF_CHARACTERISTIC
/end FUNCTION
/begin FUNCTION jSasKzuRSP264_Fktn "Applikationesgroessen Instanz jSasKzuRSP264"
 /begin DEF_CHARACTERISTIC F_PRASP64 F_TRASP64 KF_PKZUSP64 KF_POFMTNSP64 KF_POHINSYNKZUSP64 KF_TSYN_DT_IG_CHANGESP64 KL_TRASP64 KL_TSYNCGHINSYNEKZUSP64 T_FSP64 /end DEF_CHARACTERISTIC
/end FUNCTION
/begin FUNCTION jSasKzuRSP265_Fktn "Applikationesgroessen Instanz jSasKzuRSP265"
 /begin DEF_CHARACTERISTIC F_PRASP65 F_TRASP65 KF_PKZUSP65 KF_POFMTNSP65 KF_POHINSYNKZUSP65 KF_TSYN_DT_IG_CHANGESP65 KL_TRASP65 KL_TSYNCGHINSYNEKZUSP65 T_FSP65 /end DEF_CHARACTERISTIC
/end FUNCTION
/begin FUNCTION jSasKzuRSP271_Fktn "Applikationesgroessen Instanz jSasKzuRSP271"
 /begin DEF_CHARACTERISTIC F_PRASP71 F_TRASP71 KF_PKZUSP71 KF_POFMTNSP71 KF_POHINSYNKZUSP71 KF_TSYN_DT_IG_CHANGESP71 KL_TRASP71 KL_TSYNCGHINSYNEKZUSP71 T_FSP71 /end DEF_CHARACTERISTIC
/end FUNCTION
/begin FUNCTION jSasKzuRSP275_Fktn "Applikationesgroessen Instanz jSasKzuRSP275"
 /begin DEF_CHARACTERISTIC F_PRASP75 F_TRASP75 KF_PKZUSP75 KF_POFMTNSP75 KF_POHINSYNKZUSP75 KF_TSYN_DT_IG_CHANGESP75 KL_TRASP75 KL_TSYNCGHINSYNEKZUSP75 T_FSP75 /end DEF_CHARACTERISTIC
/end FUNCTION
/begin FUNCTION jSasKzuRSP276_Fktn "Applikationesgroessen Instanz jSasKzuRSP276"
 /begin DEF_CHARACTERISTIC F_PRASP76 F_TRASP76 KF_PKZUSP76 KF_POFMTNSP76 KF_POHINSYNKZUSP76 KF_TSYN_DT_IG_CHANGESP76 KL_TRASP76 KL_TSYNCGHINSYNEKZUSP76 T_FSP76 /end DEF_CHARACTERISTIC
/end FUNCTION
/begin FUNCTION jSasKzuRSP282_Fktn "Applikationesgroessen Instanz jSasKzuRSP282"
 /begin DEF_CHARACTERISTIC F_PRASP82 F_TRASP82 KF_PKZUSP82 KF_POFMTNSP82 KF_POHINSYNKZUSP82 KF_TSYN_DT_IG_CHANGESP82 KL_TRASP82 KL_TSYNCGHINSYNEKZUSP82 T_FSP82 /end DEF_CHARACTERISTIC
/end FUNCTION
/begin FUNCTION jSasKzuRSP284_Fktn "Applikationesgroessen Instanz jSasKzuRSP284"
 /begin DEF_CHARACTERISTIC F_PRASP84 F_TRASP84 KF_PKZUSP84 KF_POFMTNSP84 KF_POHINSYNKZUSP84 KF_TSYN_DT_IG_CHANGESP84 KL_TRASP84 KL_TSYNCGHINSYNEKZUSP84 T_FSP84 /end DEF_CHARACTERISTIC
/end FUNCTION
/begin FUNCTION jSasKzuRSP286_Fktn "Applikationesgroessen Instanz jSasKzuRSP286"
 /begin DEF_CHARACTERISTIC F_PRASP86 F_TRASP86 KF_PKZUSP86 KF_POFMTNSP86 KF_POHINSYNKZUSP86 KF_TSYN_DT_IG_CHANGESP86 KL_TRASP86 KL_TSYNCGHINSYNEKZUSP86 T_FSP86 /end DEF_CHARACTERISTIC
/end FUNCTION
/begin FUNCTION jSasKzuRSP287_Fktn "Applikationesgroessen Instanz jSasKzuRSP287"
 /begin DEF_CHARACTERISTIC F_PRASP87 F_TRASP87 KF_PKZUSP87 KF_POFMTNSP87 KF_POHINSYNKZUSP87 KF_TSYN_DT_IG_CHANGESP87 KL_TRASP87 KL_TSYNCGHINSYNEKZUSP87 T_FSP87 /end DEF_CHARACTERISTIC
/end FUNCTION
/begin FUNCTION jSasKzuRSP321_Fktn "Applikationesgroessen Instanz jSasKzuRSP321"
 /begin DEF_CHARACTERISTIC F_PRASPORT21 F_TRASPORT21 KF_PKZUSPORT21 KF_POFMTNSPORT21 KF_POHINSYNKZUSPORT21 KF_TSYN_DT_IG_CHANGESPORT21 KL_TRASPORT21 KL_TSYNCGHINSYNEKZUSPORT21 T_FSPORT21 /end DEF_CHARACTERISTIC
/end FUNCTION
/begin FUNCTION jSasKzuRSP331_Fktn "Applikationesgroessen Instanz jSasKzuRSP331"
 /begin DEF_CHARACTERISTIC F_PRASPORT31 F_TRASPORT31 KF_PKZUSPORT31 KF_POFMTNSPORT31 KF_POHINSYNKZUSPORT31 KF_TSYN_DT_IG_CHANGESPORT31 KL_TRASPORT31 KL_TSYNCGHINSYNEKZUSPORT31 T_FSPORT31 /end DEF_CHARACTERISTIC
/end FUNCTION
/begin FUNCTION jSasKzuRSP332_Fktn "Applikationesgroessen Instanz jSasKzuRSP332"
 /begin DEF_CHARACTERISTIC F_PRASPORT32 F_TRASPORT32 KF_PKZUSPORT32 KF_POFMTNSPORT32 KF_POHINSYNKZUSPORT32 KF_TSYN_DT_IG_CHANGESPORT32 KL_TRASPORT32 KL_TSYNCGHINSYNEKZUSPORT32 T_FSPORT32 /end DEF_CHARACTERISTIC
/end FUNCTION
/begin FUNCTION jSasKzuRSP342_Fktn "Applikationesgroessen Instanz jSasKzuRSP342"
 /begin DEF_CHARACTERISTIC F_PRASPORT42 F_TRASPORT42 KF_PKZUSPORT42 KF_POFMTNSPORT42 KF_POHINSYNKZUSPORT42 KF_TSYN_DT_IG_CHANGESPORT42 KL_TRASPORT42 KL_TSYNCGHINSYNEKZUSPORT42 T_FSPORT42 /end DEF_CHARACTERISTIC
/end FUNCTION
/begin FUNCTION jSasKzuRSP343_Fktn "Applikationesgroessen Instanz jSasKzuRSP343"
 /begin DEF_CHARACTERISTIC F_PRASPORT43 F_TRASPORT43 KF_PKZUSPORT43 KF_POFMTNSPORT43 KF_POHINSYNKZUSPORT43 KF_TSYN_DT_IG_CHANGESPORT43 KL_TRASPORT43 KL_TSYNCGHINSYNEKZUSPORT43 T_FSPORT43 /end DEF_CHARACTERISTIC
/end FUNCTION
/begin FUNCTION jSasKzuRSP351_Fktn "Applikationesgroessen Instanz jSasKzuRSP351"
 /begin DEF_CHARACTERISTIC F_PRASPORT51 F_TRASPORT51 KF_PKZUSPORT51 KF_POFMTNSPORT51 KF_POHINSYNKZUSPORT51 KF_TSYN_DT_IG_CHANGESPORT51 KL_TRASPORT51 KL_TSYNCGHINSYNEKZUSPORT51 T_FSPORT51 /end DEF_CHARACTERISTIC
/end FUNCTION
/begin FUNCTION jSasKzuRSP353_Fktn "Applikationesgroessen Instanz jSasKzuRSP353"
 /begin DEF_CHARACTERISTIC F_PRASPORT53 F_TRASPORT53 KF_PKZUSPORT53 KF_POFMTNSPORT53 KF_POHINSYNKZUSPORT53 KF_TSYN_DT_IG_CHANGESPORT53 KL_TRASPORT53 KL_TSYNCGHINSYNEKZUSPORT53 T_FSPORT53 /end DEF_CHARACTERISTIC
/end FUNCTION
/begin FUNCTION jSasKzuRSP354_Fktn "Applikationesgroessen Instanz jSasKzuRSP354"
 /begin DEF_CHARACTERISTIC F_PRASPORT54 F_TRASPORT54 KF_PKZUSPORT54 KF_POFMTNSPORT54 KF_POHINSYNKZUSPORT54 KF_TSYN_DT_IG_CHANGESPORT54 KL_TRASPORT54 KL_TSYNCGHINSYNEKZUSPORT54 T_FSPORT54 /end DEF_CHARACTERISTIC
/end FUNCTION
/begin FUNCTION jSasKzuRSP363_Fktn "Applikationesgroessen Instanz jSasKzuRSP363"
 /begin DEF_CHARACTERISTIC F_PRASPORT63 F_TRASPORT63 KF_PKZUSPORT63 KF_POFMTNSPORT63 KF_POHINSYNKZUSPORT63 KF_TSYN_DT_IG_CHANGESPORT63 KL_TRASPORT63 KL_TSYNCGHINSYNEKZUSPORT63 T_FSPORT63 /end DEF_CHARACTERISTIC
/end FUNCTION
/begin FUNCTION jSasKzuRSP364_Fktn "Applikationesgroessen Instanz jSasKzuRSP364"
 /begin DEF_CHARACTERISTIC F_PRASPORT64 F_TRASPORT64 KF_PKZUSPORT64 KF_POFMTNSPORT64 KF_POHINSYNKZUSPORT64 KF_TSYN_DT_IG_CHANGESPORT64 KL_TRASPORT64 KL_TSYNCGHINSYNEKZUSPORT64 T_FSPORT64 /end DEF_CHARACTERISTIC
/end FUNCTION
/begin FUNCTION jSasKzuRSP365_Fktn "Applikationesgroessen Instanz jSasKzuRSP365"
 /begin DEF_CHARACTERISTIC F_PRASPORT65 F_TRASPORT65 KF_PKZUSPORT65 KF_POFMTNSPORT65 KF_POHINSYNKZUSPORT65 KF_TSYN_DT_IG_CHANGESPORT65 KL_TRASPORT65 KL_TSYNCGHINSYNEKZUSPORT65 T_FSPORT65 /end DEF_CHARACTERISTIC
/end FUNCTION
/begin FUNCTION jSasKzuRSP371_Fktn "Applikationesgroessen Instanz jSasKzuRSP371"
 /begin DEF_CHARACTERISTIC F_PRASPORT71 F_TRASPORT71 KF_PKZUSPORT71 KF_POFMTNSPORT71 KF_POHINSYNKZUSPORT71 KF_TSYN_DT_IG_CHANGESPORT71 KL_TRASPORT71 KL_TSYNCGHINSYNEKZUSPORT71 T_FSPORT71 /end DEF_CHARACTERISTIC
/end FUNCTION
/begin FUNCTION jSasKzuRSP375_Fktn "Applikationesgroessen Instanz jSasKzuRSP375"
 /begin DEF_CHARACTERISTIC F_PRASPORT75 F_TRASPORT75 KF_PKZUSPORT75 KF_POFMTNSPORT75 KF_POHINSYNKZUSPORT75 KF_TSYN_DT_IG_CHANGESPORT75 KL_TRASPORT75 KL_TSYNCGHINSYNEKZUSPORT75 T_FSPORT75 /end DEF_CHARACTERISTIC
/end FUNCTION
/begin FUNCTION jSasKzuRSP376_Fktn "Applikationesgroessen Instanz jSasKzuRSP376"
 /begin DEF_CHARACTERISTIC F_PRASPORT76 F_TRASPORT76 KF_PKZUSPORT76 KF_POFMTNSPORT76 KF_POHINSYNKZUSPORT76 KF_TSYN_DT_IG_CHANGESPORT76 KL_TRASPORT76 KL_TSYNCGHINSYNEKZUSPORT76 T_FSPORT76 /end DEF_CHARACTERISTIC
/end FUNCTION
/begin FUNCTION jSasKzuRSP382_Fktn "Applikationesgroessen Instanz jSasKzuRSP382"
 /begin DEF_CHARACTERISTIC F_PRASPORT82 F_TRASPORT82 KF_PKZUSPORT82 KF_POFMTNSPORT82 KF_POHINSYNKZUSPORT82 KF_TSYN_DT_IG_CHANGESPORT82 KL_TRASPORT82 KL_TSYNCGHINSYNEKZUSPORT82 T_FSPORT82 /end DEF_CHARACTERISTIC
/end FUNCTION
/begin FUNCTION jSasKzuRSP384_Fktn "Applikationesgroessen Instanz jSasKzuRSP384"
 /begin DEF_CHARACTERISTIC F_PRASPORT84 F_TRASPORT84 KF_PKZUSPORT84 KF_POFMTNSPORT84 KF_POHINSYNKZUSPORT84 KF_TSYN_DT_IG_CHANGESPORT84 KL_TRASPORT84 KL_TSYNCGHINSYNEKZUSPORT84 T_FSPORT84 /end DEF_CHARACTERISTIC
/end FUNCTION
/begin FUNCTION jSasKzuRSP386_Fktn "Applikationesgroessen Instanz jSasKzuRSP386"
 /begin DEF_CHARACTERISTIC F_PRASPORT86 F_TRASPORT86 KF_PKZUSPORT86 KF_POFMTNSPORT86 KF_POHINSYNKZUSPORT86 KF_TSYN_DT_IG_CHANGESPORT86 KL_TRASPORT86 KL_TSYNCGHINSYNEKZUSPORT86 T_FSPORT86 /end DEF_CHARACTERISTIC
/end FUNCTION
/begin FUNCTION jSasKzuRSP387_Fktn "Applikationesgroessen Instanz jSasKzuRSP387"
 /begin DEF_CHARACTERISTIC F_PRASPORT87 F_TRASPORT87 KF_PKZUSPORT87 KF_POFMTNSPORT87 KF_POHINSYNKZUSPORT87 KF_TSYN_DT_IG_CHANGESPORT87 KL_TRASPORT87 KL_TSYNCGHINSYNEKZUSPORT87 T_FSPORT87 /end DEF_CHARACTERISTIC
/end FUNCTION
/begin FUNCTION jSasKzuRSS21_Fktn "Applikationesgroessen Instanz jSasKzuRSS21"
 /begin DEF_CHARACTERISTIC KF_PKZUWS21 KF_POFMTNFUELLRED21 KF_TSYNMTNTRAKZUWS21 KL_PGOKZU21 KL_PGOKZUWS21 KL_PGRASYN21 KL_POFCG21 KL_POFMDMOTSOLL21 KL_POKZUCG21 KL_POKZUMDMOTSOLL21 KL_POKZUNGAB21 KL_POMDTSYN21 KL_PORAKZU21 KL_PORASYN21 KL_TSYNCGRAKZU21 T_FFUELLRED21 T_RA2SSCHR21 T_SYN21 T_VKZU21 /end DEF_CHARACTERISTIC
/end FUNCTION
/begin FUNCTION jSasKzuRSS31_Fktn "Applikationesgroessen Instanz jSasKzuRSS31"
 /begin DEF_CHARACTERISTIC KF_PKZUWSSP31 KF_POFMTNFUELLREDSP31 KF_TSYNMTNTRAKZUWSSP31 KL_PGOKZUSP31 KL_PGOKZUWSSP31 KL_PGRASYNSP31 KL_POFCGSP31 KL_POFMDMOTSOLLSP31 KL_POKZUCGSP31 KL_POKZUMDMOTSOLLSP31 KL_POKZUNGABSP31 KL_POMDTSYNSP31 KL_PORAKZUSP31 KL_PORASYNSP31 KL_TSYNCGRAKZUSP31 T_FFUELLREDSP31 T_RA2SSCHRSP31 T_SYNSP31 T_VKZUSP31 /end DEF_CHARACTERISTIC
/end FUNCTION
/begin FUNCTION jSasKzuRSS32_Fktn "Applikationesgroessen Instanz jSasKzuRSS32"
 /begin DEF_CHARACTERISTIC KF_PKZUWS32 KF_POFMTNFUELLRED32 KF_TSYNMTNTRAKZUWS32 KL_PGOKZU32 KL_PGOKZUWS32 KL_PGRASYN32 KL_POFCG32 KL_POFMDMOTSOLL32 KL_POKZUCG32 KL_POKZUMDMOTSOLL32 KL_POKZUNGAB32 KL_POMDTSYN32 KL_PORAKZU32 KL_PORASYN32 KL_TSYNCGRAKZU32 T_FFUELLRED32 T_RA2SSCHR32 T_SYN32 T_VKZU32 /end DEF_CHARACTERISTIC
/end FUNCTION
/begin FUNCTION jSasKzuRSS42_Fktn "Applikationesgroessen Instanz jSasKzuRSS42"
 /begin DEF_CHARACTERISTIC KF_PKZUWSSP42 KF_POFMTNFUELLREDSP42 KF_TSYNMTNTRAKZUWSSP42 KL_PGOKZUSP42 KL_PGOKZUWSSP42 KL_PGRASYNSP42 KL_POFCGSP42 KL_POFMDMOTSOLLSP42 KL_POKZUCGSP42 KL_POKZUMDMOTSOLLSP42 KL_POKZUNGABSP42 KL_POMDTSYNSP42 KL_PORAKZUSP42 KL_PORASYNSP42 KL_TSYNCGRAKZUSP42 T_FFUELLREDSP42 T_RA2SSCHRSP42 T_SYNSP42 T_VKZUSP42 /end DEF_CHARACTERISTIC
/end FUNCTION
/begin FUNCTION jSasKzuRSS43_Fktn "Applikationesgroessen Instanz jSasKzuRSS43"
 /begin DEF_CHARACTERISTIC KF_PKZUWS43 KF_POFMTNFUELLRED43 KF_TSYNMTNTRAKZUWS43 KL_PGOKZU43 KL_PGOKZUWS43 KL_PGRASYN43 KL_POFCG43 KL_POFMDMOTSOLL43 KL_POKZUCG43 KL_POKZUMDMOTSOLL43 KL_POKZUNGAB43 KL_POMDTSYN43 KL_PORAKZU43 KL_PORASYN43 KL_TSYNCGRAKZU43 T_FFUELLRED43 T_RA2SSCHR43 T_SYN43 T_VKZU43 /end DEF_CHARACTERISTIC
/end FUNCTION
/begin FUNCTION jSasKzuRSS51_Fktn "Applikationesgroessen Instanz jSasKzuRSS51"
 /begin DEF_CHARACTERISTIC KF_PKZUWSSP51 KF_POFMTNFUELLREDSP51 KF_TSYNMTNTRAKZUWSSP51 KL_PGOKZUSP51 KL_PGOKZUWSSP51 KL_PGRASYNSP51 KL_POFCGSP51 KL_POFMDMOTSOLLSP51 KL_POKZUCGSP51 KL_POKZUMDMOTSOLLSP51 KL_POKZUNGABSP51 KL_POMDTSYNSP51 KL_PORAKZUSP51 KL_PORASYNSP51 KL_TSYNCGRAKZUSP51 T_FFUELLREDSP51 T_RA2SSCHRSP51 T_SYNSP51 T_VKZUSP51 /end DEF_CHARACTERISTIC
/end FUNCTION
/begin FUNCTION jSasKzuRSS53_Fktn "Applikationesgroessen Instanz jSasKzuRSS53"
 /begin DEF_CHARACTERISTIC KF_PKZUWSSP53 KF_POFMTNFUELLREDSP53 KF_TSYNMTNTRAKZUWSSP53 KL_PGOKZUSP53 KL_PGOKZUWSSP53 KL_PGRASYNSP53 KL_POFCGSP53 KL_POFMDMOTSOLLSP53 KL_POKZUCGSP53 KL_POKZUMDMOTSOLLSP53 KL_POKZUNGABSP53 KL_POMDTSYNSP53 KL_PORAKZUSP53 KL_PORASYNSP53 KL_TSYNCGRAKZUSP53 T_FFUELLREDSP53 T_RA2SSCHRSP53 T_SYNSP53 T_VKZUSP53 /end DEF_CHARACTERISTIC
/end FUNCTION
/begin FUNCTION jSasKzuRSS54_Fktn "Applikationesgroessen Instanz jSasKzuRSS54"
 /begin DEF_CHARACTERISTIC KF_PKZUWS54 KF_POFMTNFUELLRED54 KF_TSYNMTNTRAKZUWS54 KL_PGOKZU54 KL_PGOKZUWS54 KL_PGRASYN54 KL_POFCG54 KL_POFMDMOTSOLL54 KL_POKZUCG54 KL_POKZUMDMOTSOLL54 KL_POKZUNGAB54 KL_POMDTSYN54 KL_PORAKZU54 KL_PORASYN54 KL_TSYNCGRAKZU54 T_FFUELLRED54 T_RA2SSCHR54 T_SYN54 T_VKZU54 /end DEF_CHARACTERISTIC
/end FUNCTION
/begin FUNCTION jSasKzuRSS63_Fktn "Applikationesgroessen Instanz jSasKzuRSS63"
 /begin DEF_CHARACTERISTIC KF_PKZUWSSP63 KF_POFMTNFUELLREDSP63 KF_TSYNMTNTRAKZUWSSP63 KL_PGOKZUSP63 KL_PGOKZUWSSP63 KL_PGRASYNSP63 KL_POFCGSP63 KL_POFMDMOTSOLLSP63 KL_POKZUCGSP63 KL_POKZUMDMOTSOLLSP63 KL_POKZUNGABSP63 KL_POMDTSYNSP63 KL_PORAKZUSP63 KL_PORASYNSP63 KL_TSYNCGRAKZUSP63 T_FFUELLREDSP63 T_RA2SSCHRSP63 T_SYNSP63 T_VKZUSP63 /end DEF_CHARACTERISTIC
/end FUNCTION
/begin RECORD_LAYOUT ZF_kf_si16_S5_S3 FNC_VALUES 5 SWORD ROW_DIR DIRECT AXIS_PTS_X 3 SWORD INDEX_INCR DIRECT AXIS_PTS_Y 4 SWORD INDEX_INCR DIRECT NO_AXIS_PTS_X 1 ULONG NO_AXIS_PTS_Y 2 ULONG /end RECORD_LAYOUT
/begin RECORD_LAYOUT ZF_kf_ui8_S5_S3 FNC_VALUES 5 UBYTE ROW_DIR DIRECT AXIS_PTS_X 3 UBYTE INDEX_INCR DIRECT AXIS_PTS_Y 4 UBYTE INDEX_INCR DIRECT NO_AXIS_PTS_X 1 ULONG NO_AXIS_PTS_Y 2 ULONG /end RECORD_LAYOUT
/begin RECORD_LAYOUT ZF_kl_si16_S5_S3 FNC_VALUES 3 SWORD COLUMN_DIR DIRECT AXIS_PTS_X 2 SWORD INDEX_INCR DIRECT NO_AXIS_PTS_X 1 ULONG /end RECORD_LAYOUT
/begin RECORD_LAYOUT ZF_kl_ui8_S5_S3 FNC_VALUES 3 UBYTE COLUMN_DIR DIRECT AXIS_PTS_X 2 UBYTE INDEX_INCR DIRECT NO_AXIS_PTS_X 1 ULONG /end RECORD_LAYOUT
/begin RECORD_LAYOUT ZF_kw_ui8_S5_S3 FNC_VALUES 1 UBYTE COLUMN_DIR DIRECT /end RECORD_LAYOUT
/end MODULE
/end PROJECT
