ASAP2_VERSION 1 51
/begin PROJECT ZHBC8600 "Gen2_BMW_System_Supplier_Lib"
/begin MODULE CPP ""
/begin MOD_COMMON "" BYTE_ORDER MSB_FIRST ALIGNMENT_BYTE 1 ALIGNMENT_WORD 2 ALIGNMENT_LONG 4 ALIGNMENT_FLOAT32_IEEE 4 ALIGNMENT_FLOAT64_IEEE 1 /end MOD_COMMON
/begin COMPU_METHOD defaultAscii_M "" RAT_FUNC "%6.2" "" COEFFS 0 1 0 0 0 1 /end COMPU_METHOD
/begin COMPU_METHOD UMR___1_1000_0_S5_S3 "int = ((phys * 1000) / 1) - (0) [-]" RAT_FUNC "%4.3" "[-]" COEFFS 0 1000 0 0 0 1 /end COMPU_METHOD
/begin COMPU_METHOD UMR___1_100_0_S5_S3 "int = ((phys * 100) / 1) - (0) [-]" RAT_FUNC "%3.2" "[-]" COEFFS 0 100 0 0 0 1 /end COMPU_METHOD
/begin COMPU_METHOD UMR___1_1_0_S5_S3 "int = ((phys * 1) / 1) - (0) [-]" RAT_FUNC "%1.0" "[-]" COEFFS 0 1 0 0 0 1 /end COMPU_METHOD
/begin COMPU_METHOD UMR_BAR__1_1000_0_S5_S3 "int = ((phys * 1000) / 1) - (0) [bar]" RAT_FUNC "%4.3" "[bar]" COEFFS 0 1000 0 0 0 1 /end COMPU_METHOD
/begin COMPU_METHOD UMR_BAR_NM_1_1_0_S5_S3 "int = ((phys * 1) / 1) - (0) [bar/Nm]" RAT_FUNC "%1.0" "[bar/Nm]" COEFFS 0 1 0 0 0 1 /end COMPU_METHOD
/begin COMPU_METHOD UMR_BAR_SEC_1_1000_0_S5_S3 "int = ((phys * 1000) / 1) - (0) [bar/s]" RAT_FUNC "%5.4" "[bar/s]" COEFFS 0 1000 0 0 0 1 /end COMPU_METHOD
/begin COMPU_METHOD UMR_BAR_SEC_1_1_0_S5_S3 "int = ((phys * 1) / 1) - (0) [bar/s]" RAT_FUNC "%1.0" "[bar/s]" COEFFS 0 1 0 0 0 1 /end COMPU_METHOD
/begin COMPU_METHOD UMR_GRADC__1_1_M40_S5_S3 "int = ((phys * 1) / 1) - (-40) [°C]" RAT_FUNC "%1.0" "[°C]" COEFFS 0 1 40 0 0 1 /end COMPU_METHOD
/begin COMPU_METHOD UMR_GRADC__1_1_M48_S5_S3 "int = ((phys * 1) / 1) - (-48) [°C]" RAT_FUNC "%1.0" "[°C]" COEFFS 0 1 48 0 0 1 /end COMPU_METHOD
/begin COMPU_METHOD UMR_MA__1_10_0_S5_S3 "int = ((phys * 10) / 1) - (0) [mA]" RAT_FUNC "%2.1" "[mA]" COEFFS 0 10 0 0 0 1 /end COMPU_METHOD
/begin COMPU_METHOD UMR_MA_SEC_1_1_0_S5_S3 "int = ((phys * 1) / 1) - (0) [mA/s]" RAT_FUNC "%1.0" "[mA/s]" COEFFS 0 1 0 0 0 1 /end COMPU_METHOD
/begin COMPU_METHOD UMR_MBAR__1_1_0_S5_S3 "int = ((phys * 1) / 1) - (0) [mbar]" RAT_FUNC "%1.0" "[mbar]" COEFFS 0 1 0 0 0 1 /end COMPU_METHOD
/begin COMPU_METHOD UMR_MSEC__10_1_0_S5_S3 "int = ((phys * 1) / 10) - (0) [ms]" RAT_FUNC "%1.0" "[ms]" COEFFS 0 0.1 0 0 0 1 /end COMPU_METHOD
/begin COMPU_METHOD UMR_MSEC__10_1_M128_S5_S3 "int = ((phys * 1) / 10) - (-128) [ms]" RAT_FUNC "%1.0" "[ms]" COEFFS 0 0.1 128 0 0 1 /end COMPU_METHOD
/begin COMPU_METHOD UMR_MSEC__1_1_0_S5_S3 "int = ((phys * 1) / 1) - (0) [ms]" RAT_FUNC "%1.0" "[ms]" COEFFS 0 1 0 0 0 1 /end COMPU_METHOD
/begin COMPU_METHOD UMR_NM__1_1_0_S5_S3 "int = ((phys * 1) / 1) - (0) [Nm]" RAT_FUNC "%1.0" "[Nm]" COEFFS 0 1 0 0 0 1 /end COMPU_METHOD
/begin COMPU_METHOD UMR_NM__6_1_M128_S5_S3 "int = ((phys * 1) / 6) - (-128) [Nm]" RAT_FUNC "%1.0" "[Nm]" COEFFS 0 0.166666666667 128 0 0 1 /end COMPU_METHOD
/begin COMPU_METHOD UMR_NM__6_1_M34_S5_S3 "int = ((phys * 1) / 6) - (-34) [Nm]" RAT_FUNC "%1.0" "[Nm]" COEFFS 0 0.166666666667 34 0 0 1 /end COMPU_METHOD
/begin COMPU_METHOD UMR_NM_BAR_1_1_0_S5_S3 "int = ((phys * 1) / 1) - (0) [Nm/bar]" RAT_FUNC "%1.0" "[Nm/bar]" COEFFS 0 1 0 0 0 1 /end COMPU_METHOD
/begin COMPU_METHOD UMR_NM_SEC_1_1_0_S5_S3 "int = ((phys * 1) / 1) - (0) [Nm/s]" RAT_FUNC "%1.0" "[Nm/s]" COEFFS 0 1 0 0 0 1 /end COMPU_METHOD
/begin COMPU_METHOD UMR_PROZENT__20_51_0_S5_S3 "int = ((phys * 51) / 20) - (0) [%]" RAT_FUNC "%5.4" "[%]" COEFFS 0 2.55 0 0 0 1 /end COMPU_METHOD
/begin COMPU_METHOD UMR_SEC__1_100_0_S5_S3 "int = ((phys * 100) / 1) - (0) [s]" RAT_FUNC "%3.2" "[s]" COEFFS 0 100 0 0 0 1 /end COMPU_METHOD
/begin COMPU_METHOD UMR_SEC__1_1_0_S5_S3 "int = ((phys * 1) / 1) - (0) [s]" RAT_FUNC "%1.0" "[s]" COEFFS 0 1 0 0 0 1 /end COMPU_METHOD
/begin COMPU_METHOD UMR_U_MIN_1_1_0_S5_S3 "int = ((phys * 1) / 1) - (0) [U/min]" RAT_FUNC "%1.0" "[U/min]" COEFFS 0 1 0 0 0 1 /end COMPU_METHOD
/begin COMPU_METHOD UMR_U_MIN_32_1_0_S5_S3 "int = ((phys * 1) / 32) - (0) [U/min]" RAT_FUNC "%1.0" "[U/min]" COEFFS 0 0.03125 0 0 0 1 /end COMPU_METHOD
/begin COMPU_METHOD UMR_U_MINSEC_1_1_0_S5_S3 "int = ((phys * 1) / 1) - (0) [U/(min*s)]" RAT_FUNC "%1.0" "[U/(min*s)]" COEFFS 0 1 0 0 0 1 /end COMPU_METHOD
/begin CHARACTERISTIC CS_MEPOS "Getriebetemperaturschwelle fuer Momentenerhoehung" VALUE 0x1D7854 ZF_kw_ui8_S5_S3 190 UMR_GRADC__1_1_M40_S5_S3 -40 150 /end CHARACTERISTIC
/begin CHARACTERISTIC D_PT2_MSCHALTAB_K0_SP "Dämpfungskonstante für Standardsollwertfilter" VALUE 0x1A23F4 ZF_kw_fl32_S5_S3 1.98 UMR___1_1_0_S5_S3 0.02 2 FORMAT "%3.2" /end CHARACTERISTIC
/begin CHARACTERISTIC F_TSFADAESTARTSTART_E "Faktor für Schnellfüllzeitadaptionswert Kup. E ESTART" VALUE 0x1D7846 ZF_kw_ui8_S5_S3 1 UMR___1_100_0_S5_S3 0 1 /end CHARACTERISTIC
/begin CHARACTERISTIC F_TSFADAFUELLOPT_A "Faktor für Schnellfüllzeitadaptionswert opt. Befüllung" VALUE 0x1D7847 ZF_kw_ui8_S5_S3 1 UMR___1_100_0_S5_S3 0 1 /end CHARACTERISTIC
/begin CHARACTERISTIC F_TSFADAFUELLOPT_B "Faktor für Schnellfüllzeitadaptionswert opt. Befüllung" VALUE 0x1D7849 ZF_kw_ui8_S5_S3 1 UMR___1_100_0_S5_S3 0 1 /end CHARACTERISTIC
/begin CHARACTERISTIC F_TSFADAFUELLOPT_C "Faktor für Schnellfüllzeitadaptionswert opt. Befüllung" VALUE 0x1D784B ZF_kw_ui8_S5_S3 1 UMR___1_100_0_S5_S3 0 1 /end CHARACTERISTIC
/begin CHARACTERISTIC F_TSFADAFUELLOPT_D "Faktor für Schnellfüllzeitadaptionswert opt. Befüllung" VALUE 0x1D784D ZF_kw_ui8_S5_S3 1 UMR___1_100_0_S5_S3 0 1 /end CHARACTERISTIC
/begin CHARACTERISTIC F_TSFADAFUELLOPT_E "Faktor für Schnellfüllzeitadaptionswert opt. Befüllung" VALUE 0x1D784F ZF_kw_ui8_S5_S3 1 UMR___1_100_0_S5_S3 0 1 /end CHARACTERISTIC
/begin CHARACTERISTIC F_TSFADAFUELLOPT_K0 "Faktor für Schnellfüllzeitadaptionswert opt. Befüllung" VALUE 0x1D7851 ZF_kw_ui8_S5_S3 1 UMR___1_100_0_S5_S3 0 1 /end CHARACTERISTIC
/begin CHARACTERISTIC F_TSFADAFUELLRED_A "Faktor für Schnellfüllzeitadaptionswert red. Befüllung" VALUE 0x1D7848 ZF_kw_ui8_S5_S3 2 UMR___1_100_0_S5_S3 0 2 /end CHARACTERISTIC
/begin CHARACTERISTIC F_TSFADAFUELLRED_B "Faktor für Schnellfüllzeitadaptionswert red. Befüllung" VALUE 0x1D784A ZF_kw_ui8_S5_S3 2 UMR___1_100_0_S5_S3 0 2 /end CHARACTERISTIC
/begin CHARACTERISTIC F_TSFADAFUELLRED_C "Faktor für Schnellfüllzeitadaptionswert red. Befüllung" VALUE 0x1D784C ZF_kw_ui8_S5_S3 2 UMR___1_100_0_S5_S3 0 2 /end CHARACTERISTIC
/begin CHARACTERISTIC F_TSFADAFUELLRED_D "Faktor für Schnellfüllzeitadaptionswert red. Befüllung" VALUE 0x1D784E ZF_kw_ui8_S5_S3 2 UMR___1_100_0_S5_S3 0 2 /end CHARACTERISTIC
/begin CHARACTERISTIC F_TSFADAFUELLRED_E "Faktor für Schnellfüllzeitadaptionswert red. Befüllung" VALUE 0x1D7850 ZF_kw_ui8_S5_S3 2 UMR___1_100_0_S5_S3 0 2 /end CHARACTERISTIC
/begin CHARACTERISTIC F_TSFADAFUELLRED_K0 "Faktor für Schnellfüllzeitadaptionswert red. Befüllung" VALUE 0x1D7852 ZF_kw_ui8_S5_S3 2 UMR___1_100_0_S5_S3 0 2 /end CHARACTERISTIC
/begin CHARACTERISTIC HYS_NDS_ENTKOPPL "Hystereseschwelle auf Differenzdrehzahlschwelle für Schlupferkennung in der Entkopplungsfunktion" VALUE 0x1D842C ZF_kw_si16_S5_S3 100 UMR_U_MIN_1_1_0_S5_S3 0 100 /end CHARACTERISTIC
/begin CHARACTERISTIC IGS_A_HYSKOMP "Gradientenschwelle für Richtungsumschaltung" VALUE 0x1D8434 ZF_kw_si16_S5_S3 999 UMR_MA_SEC_1_1_0_S5_S3 1 1000 /end CHARACTERISTIC
/begin CHARACTERISTIC IGS_B_HYSKOMP "Gradientenschwelle für Richtungsumschaltung" VALUE 0x1D8444 ZF_kw_si16_S5_S3 999 UMR_MA_SEC_1_1_0_S5_S3 1 1000 /end CHARACTERISTIC
/begin CHARACTERISTIC IGS_C_HYSKOMP "Gradientenschwelle für Richtungsumschaltung" VALUE 0x1D8454 ZF_kw_si16_S5_S3 999 UMR_MA_SEC_1_1_0_S5_S3 1 1000 /end CHARACTERISTIC
/begin CHARACTERISTIC IGS_D_HYSKOMP "Gradientenschwelle für Richtungsumschaltung" VALUE 0x1D8464 ZF_kw_si16_S5_S3 999 UMR_MA_SEC_1_1_0_S5_S3 1 1000 /end CHARACTERISTIC
/begin CHARACTERISTIC IGS_E_HYSKOMP "Gradientenschwelle für Richtungsumschaltung" VALUE 0x1D8474 ZF_kw_si16_S5_S3 999 UMR_MA_SEC_1_1_0_S5_S3 1 1000 /end CHARACTERISTIC
/begin CHARACTERISTIC IGS_K0_HYSKOMP "Gradientenschwelle für Richtungsumschaltung" VALUE 0x1D8484 ZF_kw_si16_S5_S3 999 UMR_MA_SEC_1_1_0_S5_S3 1 1000 /end CHARACTERISTIC
/begin CHARACTERISTIC IS_IMAX_A_HYSKOMP "Stromschwelle(max) für Berechnung des Trajektorienfortschritts" VALUE 0x1D8438 ZF_kw_si16_S5_S3 850 UMR_MA__1_10_0_S5_S3 0 850 /end CHARACTERISTIC
/begin CHARACTERISTIC IS_IMAX_B_HYSKOMP "Stromschwelle(max) für Berechnung des Trajektorienfortschritts" VALUE 0x1D8448 ZF_kw_si16_S5_S3 850 UMR_MA__1_10_0_S5_S3 0 850 /end CHARACTERISTIC
/begin CHARACTERISTIC IS_IMAX_C_HYSKOMP "Stromschwelle(max) für Berechnung des Trajektorienfortschritts" VALUE 0x1D8458 ZF_kw_si16_S5_S3 850 UMR_MA__1_10_0_S5_S3 0 850 /end CHARACTERISTIC
/begin CHARACTERISTIC IS_IMAX_D_HYSKOMP "Stromschwelle(max) für Berechnung des Trajektorienfortschritts" VALUE 0x1D8468 ZF_kw_si16_S5_S3 850 UMR_MA__1_10_0_S5_S3 0 850 /end CHARACTERISTIC
/begin CHARACTERISTIC IS_IMAX_E_HYSKOMP "Stromschwelle(max) für Berechnung des Trajektorienfortschritts" VALUE 0x1D8478 ZF_kw_si16_S5_S3 850 UMR_MA__1_10_0_S5_S3 0 850 /end CHARACTERISTIC
/begin CHARACTERISTIC IS_IMAX_K0_HYSKOMP "Stromschwelle(max) für Berechnung des Trajektorienfortschritts" VALUE 0x1D8488 ZF_kw_si16_S5_S3 850 UMR_MA__1_10_0_S5_S3 0 850 /end CHARACTERISTIC
/begin CHARACTERISTIC IS_IMIN_A_HYSKOMP "Stromschwelle(min) für Berechnung des Trajektorienfortschritts" VALUE 0x1D8436 ZF_kw_si16_S5_S3 850 UMR_MA__1_10_0_S5_S3 0 850 /end CHARACTERISTIC
/begin CHARACTERISTIC IS_IMIN_B_HYSKOMP "Stromschwelle(min) für Berechnung des Trajektorienfortschritts" VALUE 0x1D8446 ZF_kw_si16_S5_S3 850 UMR_MA__1_10_0_S5_S3 0 850 /end CHARACTERISTIC
/begin CHARACTERISTIC IS_IMIN_C_HYSKOMP "Stromschwelle(min) für Berechnung des Trajektorienfortschritts" VALUE 0x1D8456 ZF_kw_si16_S5_S3 850 UMR_MA__1_10_0_S5_S3 0 850 /end CHARACTERISTIC
/begin CHARACTERISTIC IS_IMIN_D_HYSKOMP "Stromschwelle(min) für Berechnung des Trajektorienfortschritts" VALUE 0x1D8466 ZF_kw_si16_S5_S3 850 UMR_MA__1_10_0_S5_S3 0 850 /end CHARACTERISTIC
/begin CHARACTERISTIC IS_IMIN_E_HYSKOMP "Stromschwelle(min) für Berechnung des Trajektorienfortschritts" VALUE 0x1D8476 ZF_kw_si16_S5_S3 850 UMR_MA__1_10_0_S5_S3 0 850 /end CHARACTERISTIC
/begin CHARACTERISTIC IS_IMIN_K0_HYSKOMP "Stromschwelle(min) für Berechnung des Trajektorienfortschritts" VALUE 0x1D8486 ZF_kw_si16_S5_S3 850 UMR_MA__1_10_0_S5_S3 0 850 /end CHARACTERISTIC
/begin CHARACTERISTIC I_EDSPOSV "Stromwert für Umschaltpunkt Positonsventil" VALUE 0x1A3CC8 ZF_kw_ui32_S5_S3 1000 UMR_MA__1_10_0_S5_S3 0 1000 /end CHARACTERISTIC
/begin CHARACTERISTIC I_EDSPSV "Stromwert für Umschaltpunkt Parksperrenventil" VALUE 0x1A3CCC ZF_kw_ui32_S5_S3 1000 UMR_MA__1_10_0_S5_S3 0 1000 /end CHARACTERISTIC
/begin CHARACTERISTIC KF_FMEHAUPTGEDKINMOT_1 "Faktor auf Haupt-ME f(dki) Gangeinlegen D1 bis D6" MAP 0x1A9664 ZF_kf_ui8_S5_S3 100 UMR_PROZENT__20_51_0_S5_S3 0 100
 /begin AXIS_DESCR STD_AXIS zff_atsys._.iSignale._.obj.sig_dki UMR_PROZENT__20_51_0_S5_S3 4 0 100 DEPOSIT ABSOLUTE /end AXIS_DESCR
 /begin AXIS_DESCR STD_AXIS zff_atsys._.iSignale._.obj.sig_n_mot8 UMR_U_MIN_32_1_0_S5_S3 4 0 8160 DEPOSIT ABSOLUTE /end AXIS_DESCR
/end CHARACTERISTIC
/begin CHARACTERISTIC KF_FMEHAUPTGEDKINMOT_2 "Faktor auf Haupt-ME f(dki) Gangeinlegen D1 bis D6" MAP 0x1A9728 ZF_kf_ui8_S5_S3 100 UMR_PROZENT__20_51_0_S5_S3 0 100
 /begin AXIS_DESCR STD_AXIS zff_atsys._.iSignale._.obj.sig_dki UMR_PROZENT__20_51_0_S5_S3 4 0 100 DEPOSIT ABSOLUTE /end AXIS_DESCR
 /begin AXIS_DESCR STD_AXIS zff_atsys._.iSignale._.obj.sig_n_mot8 UMR_U_MIN_32_1_0_S5_S3 4 0 8160 DEPOSIT ABSOLUTE /end AXIS_DESCR
/end CHARACTERISTIC
/begin CHARACTERISTIC KF_FMEHAUPTGEDKINMOT_3 "Faktor auf Haupt-ME f(dki) Gangeinlegen D1 bis D6" MAP 0x1A97EC ZF_kf_ui8_S5_S3 100 UMR_PROZENT__20_51_0_S5_S3 0 100
 /begin AXIS_DESCR STD_AXIS zff_atsys._.iSignale._.obj.sig_dki UMR_PROZENT__20_51_0_S5_S3 4 0 100 DEPOSIT ABSOLUTE /end AXIS_DESCR
 /begin AXIS_DESCR STD_AXIS zff_atsys._.iSignale._.obj.sig_n_mot8 UMR_U_MIN_32_1_0_S5_S3 4 0 8160 DEPOSIT ABSOLUTE /end AXIS_DESCR
/end CHARACTERISTIC
/begin CHARACTERISTIC KF_FMEHAUPTGEDKINMOT_4 "Faktor auf Haupt-ME f(dki) Gangeinlegen D1 bis D6" MAP 0x1A98B0 ZF_kf_ui8_S5_S3 100 UMR_PROZENT__20_51_0_S5_S3 0 100
 /begin AXIS_DESCR STD_AXIS zff_atsys._.iSignale._.obj.sig_dki UMR_PROZENT__20_51_0_S5_S3 4 0 100 DEPOSIT ABSOLUTE /end AXIS_DESCR
 /begin AXIS_DESCR STD_AXIS zff_atsys._.iSignale._.obj.sig_n_mot8 UMR_U_MIN_32_1_0_S5_S3 4 0 8160 DEPOSIT ABSOLUTE /end AXIS_DESCR
/end CHARACTERISTIC
/begin CHARACTERISTIC KF_FMEHAUPTGEDKINMOT_5 "Faktor auf Haupt-ME f(dki) Gangeinlegen D1 bis D6" MAP 0x1A9974 ZF_kf_ui8_S5_S3 100 UMR_PROZENT__20_51_0_S5_S3 0 100
 /begin AXIS_DESCR STD_AXIS zff_atsys._.iSignale._.obj.sig_dki UMR_PROZENT__20_51_0_S5_S3 4 0 100 DEPOSIT ABSOLUTE /end AXIS_DESCR
 /begin AXIS_DESCR STD_AXIS zff_atsys._.iSignale._.obj.sig_n_mot8 UMR_U_MIN_32_1_0_S5_S3 4 0 8160 DEPOSIT ABSOLUTE /end AXIS_DESCR
/end CHARACTERISTIC
/begin CHARACTERISTIC KF_FMEHAUPTGEDKINMOT_6 "Faktor auf Haupt-ME f(dki) Gangeinlegen D1 bis D6" MAP 0x1A9A38 ZF_kf_ui8_S5_S3 100 UMR_PROZENT__20_51_0_S5_S3 0 100
 /begin AXIS_DESCR STD_AXIS zff_atsys._.iSignale._.obj.sig_dki UMR_PROZENT__20_51_0_S5_S3 4 0 100 DEPOSIT ABSOLUTE /end AXIS_DESCR
 /begin AXIS_DESCR STD_AXIS zff_atsys._.iSignale._.obj.sig_n_mot8 UMR_U_MIN_32_1_0_S5_S3 4 0 8160 DEPOSIT ABSOLUTE /end AXIS_DESCR
/end CHARACTERISTIC
/begin CHARACTERISTIC KF_FMEHAUPTGEDKINMOT_7 "Faktor auf Haupt-ME f(dki) Gangeinlegen D1 bis D6" MAP 0x1A9AFC ZF_kf_ui8_S5_S3 100 UMR_PROZENT__20_51_0_S5_S3 0 100
 /begin AXIS_DESCR STD_AXIS zff_atsys._.iSignale._.obj.sig_dki UMR_PROZENT__20_51_0_S5_S3 4 0 100 DEPOSIT ABSOLUTE /end AXIS_DESCR
 /begin AXIS_DESCR STD_AXIS zff_atsys._.iSignale._.obj.sig_n_mot8 UMR_U_MIN_32_1_0_S5_S3 4 0 8160 DEPOSIT ABSOLUTE /end AXIS_DESCR
/end CHARACTERISTIC
/begin CHARACTERISTIC KF_FTSYNNTMEHAUPTE_1 "Faktor auf Haupt-ME fuer Nach-ME" MAP 0x1A96BC ZF_kf_si16_S5_S3 1 UMR___1_100_0_S5_S3 0 1
 /begin AXIS_DESCR STD_AXIS iSasZentr.iSchaltend.t_syn UMR_MSEC__10_1_0_S5_S3 4 -5000 5000 DEPOSIT ABSOLUTE /end AXIS_DESCR
 /begin AXIS_DESCR STD_AXIS zff_atsys._.iSignale._.obj.sig_n_t UMR_U_MIN_1_1_0_S5_S3 4 0 8160 DEPOSIT ABSOLUTE /end AXIS_DESCR
/end CHARACTERISTIC
/begin CHARACTERISTIC KF_FTSYNNTMEHAUPTE_2 "Faktor auf Haupt-ME fuer Nach-ME" MAP 0x1A9780 ZF_kf_si16_S5_S3 1 UMR___1_100_0_S5_S3 0 1
 /begin AXIS_DESCR STD_AXIS iSasZentr.iSchaltend.t_syn UMR_MSEC__10_1_0_S5_S3 4 -5000 5000 DEPOSIT ABSOLUTE /end AXIS_DESCR
 /begin AXIS_DESCR STD_AXIS zff_atsys._.iSignale._.obj.sig_n_t UMR_U_MIN_1_1_0_S5_S3 4 0 8160 DEPOSIT ABSOLUTE /end AXIS_DESCR
/end CHARACTERISTIC
/begin CHARACTERISTIC KF_FTSYNNTMEHAUPTE_3 "Faktor auf Haupt-ME fuer Nach-ME" MAP 0x1A9844 ZF_kf_si16_S5_S3 1 UMR___1_100_0_S5_S3 0 1
 /begin AXIS_DESCR STD_AXIS iSasZentr.iSchaltend.t_syn UMR_MSEC__10_1_0_S5_S3 4 -5000 5000 DEPOSIT ABSOLUTE /end AXIS_DESCR
 /begin AXIS_DESCR STD_AXIS zff_atsys._.iSignale._.obj.sig_n_t UMR_U_MIN_1_1_0_S5_S3 4 0 8160 DEPOSIT ABSOLUTE /end AXIS_DESCR
/end CHARACTERISTIC
/begin CHARACTERISTIC KF_FTSYNNTMEHAUPTE_4 "Faktor auf Haupt-ME fuer Nach-ME" MAP 0x1A9908 ZF_kf_si16_S5_S3 1 UMR___1_100_0_S5_S3 0 1
 /begin AXIS_DESCR STD_AXIS iSasZentr.iSchaltend.t_syn UMR_MSEC__10_1_0_S5_S3 4 -5000 5000 DEPOSIT ABSOLUTE /end AXIS_DESCR
 /begin AXIS_DESCR STD_AXIS zff_atsys._.iSignale._.obj.sig_n_t UMR_U_MIN_1_1_0_S5_S3 4 0 8160 DEPOSIT ABSOLUTE /end AXIS_DESCR
/end CHARACTERISTIC
/begin CHARACTERISTIC KF_FTSYNNTMEHAUPTE_5 "Faktor auf Haupt-ME fuer Nach-ME" MAP 0x1A99CC ZF_kf_si16_S5_S3 1 UMR___1_100_0_S5_S3 0 1
 /begin AXIS_DESCR STD_AXIS iSasZentr.iSchaltend.t_syn UMR_MSEC__10_1_0_S5_S3 4 -5000 5000 DEPOSIT ABSOLUTE /end AXIS_DESCR
 /begin AXIS_DESCR STD_AXIS zff_atsys._.iSignale._.obj.sig_n_t UMR_U_MIN_1_1_0_S5_S3 4 0 8160 DEPOSIT ABSOLUTE /end AXIS_DESCR
/end CHARACTERISTIC
/begin CHARACTERISTIC KF_FTSYNNTMEHAUPTE_6 "Faktor auf Haupt-ME fuer Nach-ME" MAP 0x1A9A90 ZF_kf_si16_S5_S3 1 UMR___1_100_0_S5_S3 0 1
 /begin AXIS_DESCR STD_AXIS iSasZentr.iSchaltend.t_syn UMR_MSEC__10_1_0_S5_S3 4 -5000 5000 DEPOSIT ABSOLUTE /end AXIS_DESCR
 /begin AXIS_DESCR STD_AXIS zff_atsys._.iSignale._.obj.sig_n_t UMR_U_MIN_1_1_0_S5_S3 4 0 8160 DEPOSIT ABSOLUTE /end AXIS_DESCR
/end CHARACTERISTIC
/begin CHARACTERISTIC KF_FTSYNNTMEHAUPTE_7 "Faktor auf Haupt-ME fuer Nach-ME" MAP 0x1A9B54 ZF_kf_si16_S5_S3 1 UMR___1_100_0_S5_S3 0 1
 /begin AXIS_DESCR STD_AXIS iSasZentr.iSchaltend.t_syn UMR_MSEC__10_1_0_S5_S3 4 -5000 5000 DEPOSIT ABSOLUTE /end AXIS_DESCR
 /begin AXIS_DESCR STD_AXIS zff_atsys._.iSignale._.obj.sig_n_t UMR_U_MIN_1_1_0_S5_S3 4 0 8160 DEPOSIT ABSOLUTE /end AXIS_DESCR
/end CHARACTERISTIC
/begin CHARACTERISTIC KF_F_GRAD_STG_A_HYSKOMP "Faktor Hysteresebreite" MAP 0x1A40D8 ZF_kf_si16_S5_S3 3 UMR___1_100_0_S5_S3 0 3
 /begin AXIS_DESCR STD_AXIS NO_INPUT_QUANTITY UMR_MA_SEC_1_1_0_S5_S3 6 -32768 32767 DEPOSIT ABSOLUTE /end AXIS_DESCR
 /begin AXIS_DESCR STD_AXIS zff_atsys._.iSignale._.obj.sig_c_getr UMR_GRADC__1_1_M40_S5_S3 4 -40 150 DEPOSIT ABSOLUTE /end AXIS_DESCR
/end CHARACTERISTIC
/begin CHARACTERISTIC KF_F_GRAD_STG_B_HYSKOMP "Faktor Hysteresebreite" MAP 0x1A42DC ZF_kf_si16_S5_S3 3 UMR___1_100_0_S5_S3 0 3
 /begin AXIS_DESCR STD_AXIS NO_INPUT_QUANTITY UMR_MA_SEC_1_1_0_S5_S3 6 -32768 32767 DEPOSIT ABSOLUTE /end AXIS_DESCR
 /begin AXIS_DESCR STD_AXIS zff_atsys._.iSignale._.obj.sig_c_getr UMR_GRADC__1_1_M40_S5_S3 4 -40 150 DEPOSIT ABSOLUTE /end AXIS_DESCR
/end CHARACTERISTIC
/begin CHARACTERISTIC KF_F_GRAD_STG_C_HYSKOMP "Faktor Hysteresebreite" MAP 0x1A44E0 ZF_kf_si16_S5_S3 3 UMR___1_100_0_S5_S3 0 3
 /begin AXIS_DESCR STD_AXIS NO_INPUT_QUANTITY UMR_MA_SEC_1_1_0_S5_S3 6 -32768 32767 DEPOSIT ABSOLUTE /end AXIS_DESCR
 /begin AXIS_DESCR STD_AXIS zff_atsys._.iSignale._.obj.sig_c_getr UMR_GRADC__1_1_M40_S5_S3 4 -40 150 DEPOSIT ABSOLUTE /end AXIS_DESCR
/end CHARACTERISTIC
/begin CHARACTERISTIC KF_F_GRAD_STG_D_HYSKOMP "Faktor Hysteresebreite" MAP 0x1A46E4 ZF_kf_si16_S5_S3 3 UMR___1_100_0_S5_S3 0 3
 /begin AXIS_DESCR STD_AXIS NO_INPUT_QUANTITY UMR_MA_SEC_1_1_0_S5_S3 6 -32768 32767 DEPOSIT ABSOLUTE /end AXIS_DESCR
 /begin AXIS_DESCR STD_AXIS zff_atsys._.iSignale._.obj.sig_c_getr UMR_GRADC__1_1_M40_S5_S3 4 -40 150 DEPOSIT ABSOLUTE /end AXIS_DESCR
/end CHARACTERISTIC
/begin CHARACTERISTIC KF_F_GRAD_STG_E_HYSKOMP "Faktor Hysteresebreite" MAP 0x1A48E8 ZF_kf_si16_S5_S3 3 UMR___1_100_0_S5_S3 0 3
 /begin AXIS_DESCR STD_AXIS NO_INPUT_QUANTITY UMR_MA_SEC_1_1_0_S5_S3 6 -32768 32767 DEPOSIT ABSOLUTE /end AXIS_DESCR
 /begin AXIS_DESCR STD_AXIS zff_atsys._.iSignale._.obj.sig_c_getr UMR_GRADC__1_1_M40_S5_S3 4 -40 150 DEPOSIT ABSOLUTE /end AXIS_DESCR
/end CHARACTERISTIC
/begin CHARACTERISTIC KF_F_GRAD_STG_K0_HYSKOMP "Faktor Hysteresebreite" MAP 0x1A4AD0 ZF_kf_si16_S5_S3 3 UMR___1_100_0_S5_S3 0 3
 /begin AXIS_DESCR STD_AXIS NO_INPUT_QUANTITY UMR_MA_SEC_1_1_0_S5_S3 6 -32768 32767 DEPOSIT ABSOLUTE /end AXIS_DESCR
 /begin AXIS_DESCR STD_AXIS zff_atsys._.iSignale._.obj.sig_c_getr UMR_GRADC__1_1_M40_S5_S3 4 -40 150 DEPOSIT ABSOLUTE /end AXIS_DESCR
/end CHARACTERISTIC
/begin CHARACTERISTIC KF_F_MOLW_K0 "Korrekturfaktor für das Momentenoffset bei Lastwechsel" MAP 0x1A33E8 ZF_kf_fl32_S5_S3 5 UMR___1_1_0_S5_S3 0 5
 /begin AXIS_DESCR STD_AXIS NO_INPUT_QUANTITY UMR___1_1_0_S5_S3 4 -40 215 DEPOSIT ABSOLUTE FORMAT "%3.2" /end AXIS_DESCR
 /begin AXIS_DESCR STD_AXIS NO_INPUT_QUANTITY UMR___1_1_0_S5_S3 10 -1 8 DEPOSIT ABSOLUTE FORMAT "%3.2" /end AXIS_DESCR
 FORMAT "%3.2" /end CHARACTERISTIC
/begin CHARACTERISTIC KF_F_MOLW_K0_SP "Korrekturfaktor für das Momentenoffset bei Lastwechsel" MAP 0x1A36A8 ZF_kf_fl32_S5_S3 5 UMR___1_1_0_S5_S3 0 5
 /begin AXIS_DESCR STD_AXIS NO_INPUT_QUANTITY UMR___1_1_0_S5_S3 4 -40 215 DEPOSIT ABSOLUTE FORMAT "%3.2" /end AXIS_DESCR
 /begin AXIS_DESCR STD_AXIS NO_INPUT_QUANTITY UMR___1_1_0_S5_S3 10 -1 8 DEPOSIT ABSOLUTE FORMAT "%3.2" /end AXIS_DESCR
 FORMAT "%3.2" /end CHARACTERISTIC
/begin CHARACTERISTIC KF_F_RAMPEOEFFNEN_ENTKOPPL "Faktor auf Anfahrvorsteuermoment in Abhängigkeit des Motordrückens unter die Sollleerlaufdrehzahl der Entkopplungfunktion" MAP 0x1A37F0 ZF_kf_si16_S5_S3 20 UMR___1_100_0_S5_S3 -10 10
 /begin AXIS_DESCR STD_AXIS NO_INPUT_QUANTITY UMR_GRADC__1_1_M40_S5_S3 6 -10040 9960 DEPOSIT ABSOLUTE /end AXIS_DESCR
 /begin AXIS_DESCR STD_AXIS NO_INPUT_QUANTITY UMR___1_1_0_S5_S3 6 -1 8 DEPOSIT ABSOLUTE /end AXIS_DESCR
/end CHARACTERISTIC
/begin CHARACTERISTIC KF_F_SCHLIESSEN_ENTKOPPL "Faktor auf Schliessmomentenaufbau aus Schliessen_Entkoppeln" MAP 0x1A3974 ZF_kf_si16_S5_S3 10 UMR___1_100_0_S5_S3 0 10
 /begin AXIS_DESCR STD_AXIS iAzsIstgang.istgang UMR___1_1_0_S5_S3 6 -1 8 DEPOSIT ABSOLUTE /end AXIS_DESCR
 /begin AXIS_DESCR STD_AXIS NO_INPUT_QUANTITY UMR_GRADC__1_1_M40_S5_S3 6 -80 500 DEPOSIT ABSOLUTE /end AXIS_DESCR
/end CHARACTERISTIC
/begin CHARACTERISTIC KF_F_V_A_HYSKOMP "Faktorisierung des DT1-Filterausgangs Verzugskompensation" MAP 0x1A4140 ZF_kf_si16_S5_S3 2 UMR___1_1000_0_S5_S3 0 2
 /begin AXIS_DESCR STD_AXIS NO_INPUT_QUANTITY UMR_BAR__1_1000_0_S5_S3 8 0 32.767 DEPOSIT ABSOLUTE /end AXIS_DESCR
 /begin AXIS_DESCR STD_AXIS zff_atsys._.iSignale._.obj.sig_c_getr UMR_GRADC__1_1_M40_S5_S3 5 -40 150 DEPOSIT ABSOLUTE /end AXIS_DESCR
/end CHARACTERISTIC
/begin CHARACTERISTIC KF_F_V_B_HYSKOMP "Faktorisierung des DT1-Filterausgangs Verzugskompensation" MAP 0x1A4344 ZF_kf_si16_S5_S3 2 UMR___1_1000_0_S5_S3 0 2
 /begin AXIS_DESCR STD_AXIS NO_INPUT_QUANTITY UMR_BAR__1_1000_0_S5_S3 8 0 32.767 DEPOSIT ABSOLUTE /end AXIS_DESCR
 /begin AXIS_DESCR STD_AXIS zff_atsys._.iSignale._.obj.sig_c_getr UMR_GRADC__1_1_M40_S5_S3 5 -40 150 DEPOSIT ABSOLUTE /end AXIS_DESCR
/end CHARACTERISTIC
/begin CHARACTERISTIC KF_F_V_C_HYSKOMP "Faktorisierung des DT1-Filterausgangs Verzugskompensation" MAP 0x1A4548 ZF_kf_si16_S5_S3 2 UMR___1_1000_0_S5_S3 0 2
 /begin AXIS_DESCR STD_AXIS NO_INPUT_QUANTITY UMR_BAR__1_1000_0_S5_S3 8 0 32.767 DEPOSIT ABSOLUTE /end AXIS_DESCR
 /begin AXIS_DESCR STD_AXIS zff_atsys._.iSignale._.obj.sig_c_getr UMR_GRADC__1_1_M40_S5_S3 5 -40 150 DEPOSIT ABSOLUTE /end AXIS_DESCR
/end CHARACTERISTIC
/begin CHARACTERISTIC KF_F_V_D_HYSKOMP "Faktorisierung des DT1-Filterausgangs Verzugskompensation" MAP 0x1A474C ZF_kf_si16_S5_S3 2 UMR___1_1000_0_S5_S3 0 2
 /begin AXIS_DESCR STD_AXIS NO_INPUT_QUANTITY UMR_BAR__1_1000_0_S5_S3 8 0 32.767 DEPOSIT ABSOLUTE /end AXIS_DESCR
 /begin AXIS_DESCR STD_AXIS zff_atsys._.iSignale._.obj.sig_c_getr UMR_GRADC__1_1_M40_S5_S3 5 -40 150 DEPOSIT ABSOLUTE /end AXIS_DESCR
/end CHARACTERISTIC
/begin CHARACTERISTIC KF_F_V_E_HYSKOMP "Faktorisierung des DT1-Filterausgangs Verzugskompensation" MAP 0x1A4950 ZF_kf_si16_S5_S3 2 UMR___1_1000_0_S5_S3 0 2
 /begin AXIS_DESCR STD_AXIS NO_INPUT_QUANTITY UMR_BAR__1_1000_0_S5_S3 8 0 32.767 DEPOSIT ABSOLUTE /end AXIS_DESCR
 /begin AXIS_DESCR STD_AXIS zff_atsys._.iSignale._.obj.sig_c_getr UMR_GRADC__1_1_M40_S5_S3 5 -40 150 DEPOSIT ABSOLUTE /end AXIS_DESCR
/end CHARACTERISTIC
/begin CHARACTERISTIC KF_F_V_K0_HYSKOMP "Faktorisierung des DT1-Filterausgangs Verzugskompensation" MAP 0x1A4B38 ZF_kf_si16_S5_S3 2 UMR___1_1000_0_S5_S3 0 2
 /begin AXIS_DESCR STD_AXIS NO_INPUT_QUANTITY UMR_BAR__1_1000_0_S5_S3 8 0 32.767 DEPOSIT ABSOLUTE /end AXIS_DESCR
 /begin AXIS_DESCR STD_AXIS zff_atsys._.iSignale._.obj.sig_c_getr UMR_GRADC__1_1_M40_S5_S3 5 -40 150 DEPOSIT ABSOLUTE /end AXIS_DESCR
/end CHARACTERISTIC
/begin CHARACTERISTIC KF_KIEDSCGFAACE "Korrekurkennfeld fallender ACE Druckregler" MAP 0x1A3CD0 ZF_kf_si16_S5_S3 400 UMR_MA__1_10_0_S5_S3 -200 200
 /begin AXIS_DESCR STD_AXIS i_eds1 UMR_MA__1_10_0_S5_S3 12 0 1275 DEPOSIT ABSOLUTE /end AXIS_DESCR
 /begin AXIS_DESCR STD_AXIS zff_atsys._.iSignale._.obj.sig_c_getr UMR_GRADC__1_1_M40_S5_S3 5 -40 215 DEPOSIT ABSOLUTE /end AXIS_DESCR
/end CHARACTERISTIC
/begin CHARACTERISTIC KF_KIEDSCGKOR "Korrekturkennfeld auf druckreglertypabhängige Temperaturkorrektur" MAP 0x1A3A84 ZF_kf_si16_S5_S3 400 UMR_MA__1_10_0_S5_S3 -200 200
 /begin AXIS_DESCR STD_AXIS i_eds_kupb UMR_MA__1_10_0_S5_S3 12 0 1275 DEPOSIT ABSOLUTE /end AXIS_DESCR
 /begin AXIS_DESCR STD_AXIS zff_atsys._.iSignale._.obj.sig_c_getr UMR_GRADC__1_1_M40_S5_S3 5 -40 215 DEPOSIT ABSOLUTE /end AXIS_DESCR
/end CHARACTERISTIC
/begin CHARACTERISTIC KF_KIEDSCGSTACE "Korrekurkennfeld steigender ACE Druckregler" MAP 0x1A3D74 ZF_kf_si16_S5_S3 400 UMR_MA__1_10_0_S5_S3 -200 200
 /begin AXIS_DESCR STD_AXIS i_eds1 UMR_MA__1_10_0_S5_S3 12 0 1275 DEPOSIT ABSOLUTE /end AXIS_DESCR
 /begin AXIS_DESCR STD_AXIS zff_atsys._.iSignale._.obj.sig_c_getr UMR_GRADC__1_1_M40_S5_S3 5 -40 215 DEPOSIT ABSOLUTE /end AXIS_DESCR
/end CHARACTERISTIC
/begin CHARACTERISTIC KF_KIEDSPSYSKORFAACE "Systemdruckabhaengiges Korrekturkennfeld" MAP 0x1A3E58 ZF_kf_fl32_S5_S3 400 UMR_MA__1_10_0_S5_S3 -200 200
 /begin AXIS_DESCR STD_AXIS NO_INPUT_QUANTITY UMR_MA__1_10_0_S5_S3 4 0 1275 DEPOSIT ABSOLUTE /end AXIS_DESCR
 /begin AXIS_DESCR STD_AXIS iSasPsyst.p_sysist UMR_BAR__1_1000_0_S5_S3 2 0 20 DEPOSIT ABSOLUTE /end AXIS_DESCR
/end CHARACTERISTIC
/begin CHARACTERISTIC KF_KIEDSPSYSKORSTACE "Systemdruckabhaengiges Korrekturkennfeld" MAP 0x1A3E18 ZF_kf_fl32_S5_S3 400 UMR_MA__1_10_0_S5_S3 -200 200
 /begin AXIS_DESCR STD_AXIS NO_INPUT_QUANTITY UMR_MA__1_10_0_S5_S3 4 0 1275 DEPOSIT ABSOLUTE /end AXIS_DESCR
 /begin AXIS_DESCR STD_AXIS iSasPsyst.p_sysist UMR_BAR__1_1000_0_S5_S3 2 0 20 DEPOSIT ABSOLUTE /end AXIS_DESCR
/end CHARACTERISTIC
/begin CHARACTERISTIC KF_MEHAUPT_1 "Hauptmotoreingriff Schaltablauf" MAP 0x1A9684 ZF_kf_ui8_S5_S3 768 UMR_NM__6_1_M128_S5_S3 -768 0
 /begin AXIS_DESCR STD_AXIS NO_INPUT_QUANTITY UMR_U_MIN_32_1_0_S5_S3 6 0 8160 DEPOSIT ABSOLUTE /end AXIS_DESCR
 /begin AXIS_DESCR STD_AXIS zff_atsys._.iSignale._.obj.sig_m_t8 UMR_NM__6_1_M34_S5_S3 6 -204 1326 DEPOSIT ABSOLUTE /end AXIS_DESCR
/end CHARACTERISTIC
/begin CHARACTERISTIC KF_MEHAUPT_2 "Hauptmotoreingriff Schaltablauf" MAP 0x1A9748 ZF_kf_ui8_S5_S3 768 UMR_NM__6_1_M128_S5_S3 -768 0
 /begin AXIS_DESCR STD_AXIS NO_INPUT_QUANTITY UMR_U_MIN_32_1_0_S5_S3 6 0 8160 DEPOSIT ABSOLUTE /end AXIS_DESCR
 /begin AXIS_DESCR STD_AXIS zff_atsys._.iSignale._.obj.sig_m_t8 UMR_NM__6_1_M34_S5_S3 6 -204 1326 DEPOSIT ABSOLUTE /end AXIS_DESCR
/end CHARACTERISTIC
/begin CHARACTERISTIC KF_MEHAUPT_3 "Hauptmotoreingriff Schaltablauf" MAP 0x1A980C ZF_kf_ui8_S5_S3 768 UMR_NM__6_1_M128_S5_S3 -768 0
 /begin AXIS_DESCR STD_AXIS NO_INPUT_QUANTITY UMR_U_MIN_32_1_0_S5_S3 6 0 8160 DEPOSIT ABSOLUTE /end AXIS_DESCR
 /begin AXIS_DESCR STD_AXIS zff_atsys._.iSignale._.obj.sig_m_t8 UMR_NM__6_1_M34_S5_S3 6 -204 1326 DEPOSIT ABSOLUTE /end AXIS_DESCR
/end CHARACTERISTIC
/begin CHARACTERISTIC KF_MEHAUPT_4 "Hauptmotoreingriff Schaltablauf" MAP 0x1A98D0 ZF_kf_ui8_S5_S3 768 UMR_NM__6_1_M128_S5_S3 -768 0
 /begin AXIS_DESCR STD_AXIS NO_INPUT_QUANTITY UMR_U_MIN_32_1_0_S5_S3 6 0 8160 DEPOSIT ABSOLUTE /end AXIS_DESCR
 /begin AXIS_DESCR STD_AXIS zff_atsys._.iSignale._.obj.sig_m_t8 UMR_NM__6_1_M34_S5_S3 6 -204 1326 DEPOSIT ABSOLUTE /end AXIS_DESCR
/end CHARACTERISTIC
/begin CHARACTERISTIC KF_MEHAUPT_5 "Hauptmotoreingriff Schaltablauf" MAP 0x1A9994 ZF_kf_ui8_S5_S3 768 UMR_NM__6_1_M128_S5_S3 -768 0
 /begin AXIS_DESCR STD_AXIS NO_INPUT_QUANTITY UMR_U_MIN_32_1_0_S5_S3 6 0 8160 DEPOSIT ABSOLUTE /end AXIS_DESCR
 /begin AXIS_DESCR STD_AXIS zff_atsys._.iSignale._.obj.sig_m_t8 UMR_NM__6_1_M34_S5_S3 6 -204 1326 DEPOSIT ABSOLUTE /end AXIS_DESCR
/end CHARACTERISTIC
/begin CHARACTERISTIC KF_MEHAUPT_6 "Hauptmotoreingriff Schaltablauf" MAP 0x1A9A58 ZF_kf_ui8_S5_S3 768 UMR_NM__6_1_M128_S5_S3 -768 0
 /begin AXIS_DESCR STD_AXIS NO_INPUT_QUANTITY UMR_U_MIN_32_1_0_S5_S3 6 0 8160 DEPOSIT ABSOLUTE /end AXIS_DESCR
 /begin AXIS_DESCR STD_AXIS zff_atsys._.iSignale._.obj.sig_m_t8 UMR_NM__6_1_M34_S5_S3 6 -204 1326 DEPOSIT ABSOLUTE /end AXIS_DESCR
/end CHARACTERISTIC
/begin CHARACTERISTIC KF_MEHAUPT_7 "Hauptmotoreingriff Schaltablauf" MAP 0x1A9B1C ZF_kf_ui8_S5_S3 768 UMR_NM__6_1_M128_S5_S3 -768 0
 /begin AXIS_DESCR STD_AXIS NO_INPUT_QUANTITY UMR_U_MIN_32_1_0_S5_S3 6 0 8160 DEPOSIT ABSOLUTE /end AXIS_DESCR
 /begin AXIS_DESCR STD_AXIS zff_atsys._.iSignale._.obj.sig_m_t8 UMR_NM__6_1_M34_S5_S3 6 -204 1326 DEPOSIT ABSOLUTE /end AXIS_DESCR
/end CHARACTERISTIC
/begin CHARACTERISTIC KF_MENACHFOLNACHMRS21 "Nachmotoreingriff fuer Folgeschaltung nach DRS" MAP 0x1A89D0 ZF_kf_ui8_S5_S3 768 UMR_NM__6_1_M128_S5_S3 -768 0
 /begin AXIS_DESCR STD_AXIS NO_INPUT_QUANTITY UMR_U_MIN_32_1_0_S5_S3 6 0 8160 DEPOSIT ABSOLUTE /end AXIS_DESCR
 /begin AXIS_DESCR STD_AXIS zff_atsys._.iSignale._.obj.sig_m_t8 UMR_NM__6_1_M34_S5_S3 6 -204 1326 DEPOSIT ABSOLUTE /end AXIS_DESCR
/end CHARACTERISTIC
/begin CHARACTERISTIC KF_MENACHFOLNACHMRS21_EL "Nachmotoreingriff fuer Folgeschaltung nach DRS" MAP 0x1A8A08 ZF_kf_ui8_S5_S3 768 UMR_NM__6_1_M128_S5_S3 -768 0
 /begin AXIS_DESCR STD_AXIS NO_INPUT_QUANTITY UMR_U_MIN_32_1_0_S5_S3 6 0 8160 DEPOSIT ABSOLUTE /end AXIS_DESCR
 /begin AXIS_DESCR STD_AXIS zff_atsys._.iSignale._.obj.sig_m_t8 UMR_NM__6_1_M34_S5_S3 6 -204 1326 DEPOSIT ABSOLUTE /end AXIS_DESCR
/end CHARACTERISTIC
/begin CHARACTERISTIC KF_MENACHFOLNACHMRS32 "Nachmotoreingriff fuer Folgeschaltung nach DRS" MAP 0x1A8B90 ZF_kf_ui8_S5_S3 768 UMR_NM__6_1_M128_S5_S3 -768 0
 /begin AXIS_DESCR STD_AXIS NO_INPUT_QUANTITY UMR_U_MIN_32_1_0_S5_S3 6 0 8160 DEPOSIT ABSOLUTE /end AXIS_DESCR
 /begin AXIS_DESCR STD_AXIS zff_atsys._.iSignale._.obj.sig_m_t8 UMR_NM__6_1_M34_S5_S3 6 -204 1326 DEPOSIT ABSOLUTE /end AXIS_DESCR
/end CHARACTERISTIC
/begin CHARACTERISTIC KF_MENACHFOLNACHMRS32_EL "Nachmotoreingriff fuer Folgeschaltung nach DRS" MAP 0x1A8BC8 ZF_kf_ui8_S5_S3 768 UMR_NM__6_1_M128_S5_S3 -768 0
 /begin AXIS_DESCR STD_AXIS NO_INPUT_QUANTITY UMR_U_MIN_32_1_0_S5_S3 6 0 8160 DEPOSIT ABSOLUTE /end AXIS_DESCR
 /begin AXIS_DESCR STD_AXIS zff_atsys._.iSignale._.obj.sig_m_t8 UMR_NM__6_1_M34_S5_S3 6 -204 1326 DEPOSIT ABSOLUTE /end AXIS_DESCR
/end CHARACTERISTIC
/begin CHARACTERISTIC KF_MENACHFOLNACHMRS43 "Nachmotoreingriff fuer Folgeschaltung nach DRS" MAP 0x1A8D50 ZF_kf_ui8_S5_S3 768 UMR_NM__6_1_M128_S5_S3 -768 0
 /begin AXIS_DESCR STD_AXIS NO_INPUT_QUANTITY UMR_U_MIN_32_1_0_S5_S3 6 0 8160 DEPOSIT ABSOLUTE /end AXIS_DESCR
 /begin AXIS_DESCR STD_AXIS zff_atsys._.iSignale._.obj.sig_m_t8 UMR_NM__6_1_M34_S5_S3 6 -204 1326 DEPOSIT ABSOLUTE /end AXIS_DESCR
/end CHARACTERISTIC
/begin CHARACTERISTIC KF_MENACHFOLNACHMRS43_EL "Nachmotoreingriff fuer Folgeschaltung nach DRS" MAP 0x1A8D88 ZF_kf_ui8_S5_S3 768 UMR_NM__6_1_M128_S5_S3 -768 0
 /begin AXIS_DESCR STD_AXIS NO_INPUT_QUANTITY UMR_U_MIN_32_1_0_S5_S3 6 0 8160 DEPOSIT ABSOLUTE /end AXIS_DESCR
 /begin AXIS_DESCR STD_AXIS zff_atsys._.iSignale._.obj.sig_m_t8 UMR_NM__6_1_M34_S5_S3 6 -204 1326 DEPOSIT ABSOLUTE /end AXIS_DESCR
/end CHARACTERISTIC
/begin CHARACTERISTIC KF_MENACHFOLNACHMRS54 "Nachmotoreingriff fuer Folgeschaltung nach DRS" MAP 0x1A8F10 ZF_kf_ui8_S5_S3 768 UMR_NM__6_1_M128_S5_S3 -768 0
 /begin AXIS_DESCR STD_AXIS NO_INPUT_QUANTITY UMR_U_MIN_32_1_0_S5_S3 6 0 8160 DEPOSIT ABSOLUTE /end AXIS_DESCR
 /begin AXIS_DESCR STD_AXIS zff_atsys._.iSignale._.obj.sig_m_t8 UMR_NM__6_1_M34_S5_S3 6 -204 1326 DEPOSIT ABSOLUTE /end AXIS_DESCR
/end CHARACTERISTIC
/begin CHARACTERISTIC KF_MENACHFOLNACHMRS54_EL "Nachmotoreingriff fuer Folgeschaltung nach DRS" MAP 0x1A8F48 ZF_kf_ui8_S5_S3 768 UMR_NM__6_1_M128_S5_S3 -768 0
 /begin AXIS_DESCR STD_AXIS NO_INPUT_QUANTITY UMR_U_MIN_32_1_0_S5_S3 6 0 8160 DEPOSIT ABSOLUTE /end AXIS_DESCR
 /begin AXIS_DESCR STD_AXIS zff_atsys._.iSignale._.obj.sig_m_t8 UMR_NM__6_1_M34_S5_S3 6 -204 1326 DEPOSIT ABSOLUTE /end AXIS_DESCR
/end CHARACTERISTIC
/begin CHARACTERISTIC KF_MENACHFOLNACHMRS65 "Nachmotoreingriff fuer Folgeschaltung nach DRS" MAP 0x1A90D0 ZF_kf_ui8_S5_S3 768 UMR_NM__6_1_M128_S5_S3 -768 0
 /begin AXIS_DESCR STD_AXIS NO_INPUT_QUANTITY UMR_U_MIN_32_1_0_S5_S3 6 0 8160 DEPOSIT ABSOLUTE /end AXIS_DESCR
 /begin AXIS_DESCR STD_AXIS zff_atsys._.iSignale._.obj.sig_m_t8 UMR_NM__6_1_M34_S5_S3 6 -204 1326 DEPOSIT ABSOLUTE /end AXIS_DESCR
/end CHARACTERISTIC
/begin CHARACTERISTIC KF_MENACHFOLNACHMRS65_EL "Nachmotoreingriff fuer Folgeschaltung nach DRS" MAP 0x1A9108 ZF_kf_ui8_S5_S3 768 UMR_NM__6_1_M128_S5_S3 -768 0
 /begin AXIS_DESCR STD_AXIS NO_INPUT_QUANTITY UMR_U_MIN_32_1_0_S5_S3 6 0 8160 DEPOSIT ABSOLUTE /end AXIS_DESCR
 /begin AXIS_DESCR STD_AXIS zff_atsys._.iSignale._.obj.sig_m_t8 UMR_NM__6_1_M34_S5_S3 6 -204 1326 DEPOSIT ABSOLUTE /end AXIS_DESCR
/end CHARACTERISTIC
/begin CHARACTERISTIC KF_MENACHFOLNACHMRS76 "Nachmotoreingriff fuer Folgeschaltung nach DRS" MAP 0x1A9290 ZF_kf_ui8_S5_S3 768 UMR_NM__6_1_M128_S5_S3 -768 0
 /begin AXIS_DESCR STD_AXIS NO_INPUT_QUANTITY UMR_U_MIN_32_1_0_S5_S3 6 0 8160 DEPOSIT ABSOLUTE /end AXIS_DESCR
 /begin AXIS_DESCR STD_AXIS zff_atsys._.iSignale._.obj.sig_m_t8 UMR_NM__6_1_M34_S5_S3 6 -204 1326 DEPOSIT ABSOLUTE /end AXIS_DESCR
/end CHARACTERISTIC
/begin CHARACTERISTIC KF_MENACHFOLNACHMRS76_EL "Nachmotoreingriff fuer Folgeschaltung nach DRS" MAP 0x1A92C8 ZF_kf_ui8_S5_S3 768 UMR_NM__6_1_M128_S5_S3 -768 0
 /begin AXIS_DESCR STD_AXIS NO_INPUT_QUANTITY UMR_U_MIN_32_1_0_S5_S3 6 0 8160 DEPOSIT ABSOLUTE /end AXIS_DESCR
 /begin AXIS_DESCR STD_AXIS zff_atsys._.iSignale._.obj.sig_m_t8 UMR_NM__6_1_M34_S5_S3 6 -204 1326 DEPOSIT ABSOLUTE /end AXIS_DESCR
/end CHARACTERISTIC
/begin CHARACTERISTIC KF_MENACHFOLNACHMRS87 "Nachmotoreingriff fuer Folgeschaltung nach DRS" MAP 0x1A9450 ZF_kf_ui8_S5_S3 768 UMR_NM__6_1_M128_S5_S3 -768 0
 /begin AXIS_DESCR STD_AXIS NO_INPUT_QUANTITY UMR_U_MIN_32_1_0_S5_S3 6 0 8160 DEPOSIT ABSOLUTE /end AXIS_DESCR
 /begin AXIS_DESCR STD_AXIS zff_atsys._.iSignale._.obj.sig_m_t8 UMR_NM__6_1_M34_S5_S3 6 -204 1326 DEPOSIT ABSOLUTE /end AXIS_DESCR
/end CHARACTERISTIC
/begin CHARACTERISTIC KF_MENACHFOLNACHMRS87_EL "Nachmotoreingriff fuer Folgeschaltung nach DRS" MAP 0x1A9488 ZF_kf_ui8_S5_S3 768 UMR_NM__6_1_M128_S5_S3 -768 0
 /begin AXIS_DESCR STD_AXIS NO_INPUT_QUANTITY UMR_U_MIN_32_1_0_S5_S3 6 0 8160 DEPOSIT ABSOLUTE /end AXIS_DESCR
 /begin AXIS_DESCR STD_AXIS zff_atsys._.iSignale._.obj.sig_m_t8 UMR_NM__6_1_M34_S5_S3 6 -204 1326 DEPOSIT ABSOLUTE /end AXIS_DESCR
/end CHARACTERISTIC
/begin CHARACTERISTIC KF_MENACHFOLNACHMRSSP21 "Nachmotoreingriff fuer Folgeschaltung nach DRS" MAP 0x1A8A78 ZF_kf_ui8_S5_S3 768 UMR_NM__6_1_M128_S5_S3 -768 0
 /begin AXIS_DESCR STD_AXIS NO_INPUT_QUANTITY UMR_U_MIN_32_1_0_S5_S3 6 0 8160 DEPOSIT ABSOLUTE /end AXIS_DESCR
 /begin AXIS_DESCR STD_AXIS zff_atsys._.iSignale._.obj.sig_m_t8 UMR_NM__6_1_M34_S5_S3 6 -204 1326 DEPOSIT ABSOLUTE /end AXIS_DESCR
/end CHARACTERISTIC
/begin CHARACTERISTIC KF_MENACHFOLNACHMRSSP32 "Nachmotoreingriff fuer Folgeschaltung nach DRS" MAP 0x1A8C38 ZF_kf_ui8_S5_S3 768 UMR_NM__6_1_M128_S5_S3 -768 0
 /begin AXIS_DESCR STD_AXIS NO_INPUT_QUANTITY UMR_U_MIN_32_1_0_S5_S3 6 0 8160 DEPOSIT ABSOLUTE /end AXIS_DESCR
 /begin AXIS_DESCR STD_AXIS zff_atsys._.iSignale._.obj.sig_m_t8 UMR_NM__6_1_M34_S5_S3 6 -204 1326 DEPOSIT ABSOLUTE /end AXIS_DESCR
/end CHARACTERISTIC
/begin CHARACTERISTIC KF_MENACHFOLNACHMRSSP43 "Nachmotoreingriff fuer Folgeschaltung nach DRS" MAP 0x1A8DF8 ZF_kf_ui8_S5_S3 768 UMR_NM__6_1_M128_S5_S3 -768 0
 /begin AXIS_DESCR STD_AXIS NO_INPUT_QUANTITY UMR_U_MIN_32_1_0_S5_S3 6 0 8160 DEPOSIT ABSOLUTE /end AXIS_DESCR
 /begin AXIS_DESCR STD_AXIS zff_atsys._.iSignale._.obj.sig_m_t8 UMR_NM__6_1_M34_S5_S3 6 -204 1326 DEPOSIT ABSOLUTE /end AXIS_DESCR
/end CHARACTERISTIC
/begin CHARACTERISTIC KF_MENACHFOLNACHMRSSP54 "Nachmotoreingriff fuer Folgeschaltung nach DRS" MAP 0x1A8FB8 ZF_kf_ui8_S5_S3 768 UMR_NM__6_1_M128_S5_S3 -768 0
 /begin AXIS_DESCR STD_AXIS NO_INPUT_QUANTITY UMR_U_MIN_32_1_0_S5_S3 6 0 8160 DEPOSIT ABSOLUTE /end AXIS_DESCR
 /begin AXIS_DESCR STD_AXIS zff_atsys._.iSignale._.obj.sig_m_t8 UMR_NM__6_1_M34_S5_S3 6 -204 1326 DEPOSIT ABSOLUTE /end AXIS_DESCR
/end CHARACTERISTIC
/begin CHARACTERISTIC KF_MENACHFOLNACHMRSSP65 "Nachmotoreingriff fuer Folgeschaltung nach DRS" MAP 0x1A9178 ZF_kf_ui8_S5_S3 768 UMR_NM__6_1_M128_S5_S3 -768 0
 /begin AXIS_DESCR STD_AXIS NO_INPUT_QUANTITY UMR_U_MIN_32_1_0_S5_S3 6 0 8160 DEPOSIT ABSOLUTE /end AXIS_DESCR
 /begin AXIS_DESCR STD_AXIS zff_atsys._.iSignale._.obj.sig_m_t8 UMR_NM__6_1_M34_S5_S3 6 -204 1326 DEPOSIT ABSOLUTE /end AXIS_DESCR
/end CHARACTERISTIC
/begin CHARACTERISTIC KF_MENACHFOLNACHMRSSP76 "Nachmotoreingriff fuer Folgeschaltung nach DRS" MAP 0x1A9338 ZF_kf_ui8_S5_S3 768 UMR_NM__6_1_M128_S5_S3 -768 0
 /begin AXIS_DESCR STD_AXIS NO_INPUT_QUANTITY UMR_U_MIN_32_1_0_S5_S3 6 0 8160 DEPOSIT ABSOLUTE /end AXIS_DESCR
 /begin AXIS_DESCR STD_AXIS zff_atsys._.iSignale._.obj.sig_m_t8 UMR_NM__6_1_M34_S5_S3 6 -204 1326 DEPOSIT ABSOLUTE /end AXIS_DESCR
/end CHARACTERISTIC
/begin CHARACTERISTIC KF_MENACHFOLNACHMRSSP87 "Nachmotoreingriff fuer Folgeschaltung nach DRS" MAP 0x1A94F8 ZF_kf_ui8_S5_S3 768 UMR_NM__6_1_M128_S5_S3 -768 0
 /begin AXIS_DESCR STD_AXIS NO_INPUT_QUANTITY UMR_U_MIN_32_1_0_S5_S3 6 0 8160 DEPOSIT ABSOLUTE /end AXIS_DESCR
 /begin AXIS_DESCR STD_AXIS zff_atsys._.iSignale._.obj.sig_m_t8 UMR_NM__6_1_M34_S5_S3 6 -204 1326 DEPOSIT ABSOLUTE /end AXIS_DESCR
/end CHARACTERISTIC
/begin CHARACTERISTIC KF_MENACHFOLNACHMRSSPORT21 "Nachmotoreingriff fuer Folgeschaltung nach DRS" MAP 0x1A8AE8 ZF_kf_ui8_S5_S3 768 UMR_NM__6_1_M128_S5_S3 -768 0
 /begin AXIS_DESCR STD_AXIS NO_INPUT_QUANTITY UMR_U_MIN_32_1_0_S5_S3 6 0 8160 DEPOSIT ABSOLUTE /end AXIS_DESCR
 /begin AXIS_DESCR STD_AXIS zff_atsys._.iSignale._.obj.sig_m_t8 UMR_NM__6_1_M34_S5_S3 6 -204 1326 DEPOSIT ABSOLUTE /end AXIS_DESCR
/end CHARACTERISTIC
/begin CHARACTERISTIC KF_MENACHFOLNACHMRSSPORT32 "Nachmotoreingriff fuer Folgeschaltung nach DRS" MAP 0x1A8CA8 ZF_kf_ui8_S5_S3 768 UMR_NM__6_1_M128_S5_S3 -768 0
 /begin AXIS_DESCR STD_AXIS NO_INPUT_QUANTITY UMR_U_MIN_32_1_0_S5_S3 6 0 8160 DEPOSIT ABSOLUTE /end AXIS_DESCR
 /begin AXIS_DESCR STD_AXIS zff_atsys._.iSignale._.obj.sig_m_t8 UMR_NM__6_1_M34_S5_S3 6 -204 1326 DEPOSIT ABSOLUTE /end AXIS_DESCR
/end CHARACTERISTIC
/begin CHARACTERISTIC KF_MENACHFOLNACHMRSSPORT43 "Nachmotoreingriff fuer Folgeschaltung nach DRS" MAP 0x1A8E68 ZF_kf_ui8_S5_S3 768 UMR_NM__6_1_M128_S5_S3 -768 0
 /begin AXIS_DESCR STD_AXIS NO_INPUT_QUANTITY UMR_U_MIN_32_1_0_S5_S3 6 0 8160 DEPOSIT ABSOLUTE /end AXIS_DESCR
 /begin AXIS_DESCR STD_AXIS zff_atsys._.iSignale._.obj.sig_m_t8 UMR_NM__6_1_M34_S5_S3 6 -204 1326 DEPOSIT ABSOLUTE /end AXIS_DESCR
/end CHARACTERISTIC
/begin CHARACTERISTIC KF_MENACHFOLNACHMRSSPORT54 "Nachmotoreingriff fuer Folgeschaltung nach DRS" MAP 0x1A9028 ZF_kf_ui8_S5_S3 768 UMR_NM__6_1_M128_S5_S3 -768 0
 /begin AXIS_DESCR STD_AXIS NO_INPUT_QUANTITY UMR_U_MIN_32_1_0_S5_S3 6 0 8160 DEPOSIT ABSOLUTE /end AXIS_DESCR
 /begin AXIS_DESCR STD_AXIS zff_atsys._.iSignale._.obj.sig_m_t8 UMR_NM__6_1_M34_S5_S3 6 -204 1326 DEPOSIT ABSOLUTE /end AXIS_DESCR
/end CHARACTERISTIC
/begin CHARACTERISTIC KF_MENACHFOLNACHMRSSPORT65 "Nachmotoreingriff fuer Folgeschaltung nach DRS" MAP 0x1A91E8 ZF_kf_ui8_S5_S3 768 UMR_NM__6_1_M128_S5_S3 -768 0
 /begin AXIS_DESCR STD_AXIS NO_INPUT_QUANTITY UMR_U_MIN_32_1_0_S5_S3 6 0 8160 DEPOSIT ABSOLUTE /end AXIS_DESCR
 /begin AXIS_DESCR STD_AXIS zff_atsys._.iSignale._.obj.sig_m_t8 UMR_NM__6_1_M34_S5_S3 6 -204 1326 DEPOSIT ABSOLUTE /end AXIS_DESCR
/end CHARACTERISTIC
/begin CHARACTERISTIC KF_MENACHFOLNACHMRSSPORT76 "Nachmotoreingriff fuer Folgeschaltung nach DRS" MAP 0x1A93A8 ZF_kf_ui8_S5_S3 768 UMR_NM__6_1_M128_S5_S3 -768 0
 /begin AXIS_DESCR STD_AXIS NO_INPUT_QUANTITY UMR_U_MIN_32_1_0_S5_S3 6 0 8160 DEPOSIT ABSOLUTE /end AXIS_DESCR
 /begin AXIS_DESCR STD_AXIS zff_atsys._.iSignale._.obj.sig_m_t8 UMR_NM__6_1_M34_S5_S3 6 -204 1326 DEPOSIT ABSOLUTE /end AXIS_DESCR
/end CHARACTERISTIC
/begin CHARACTERISTIC KF_MENACHFOLNACHMRSSPORT87 "Nachmotoreingriff fuer Folgeschaltung nach DRS" MAP 0x1A9568 ZF_kf_ui8_S5_S3 768 UMR_NM__6_1_M128_S5_S3 -768 0
 /begin AXIS_DESCR STD_AXIS NO_INPUT_QUANTITY UMR_U_MIN_32_1_0_S5_S3 6 0 8160 DEPOSIT ABSOLUTE /end AXIS_DESCR
 /begin AXIS_DESCR STD_AXIS zff_atsys._.iSignale._.obj.sig_m_t8 UMR_NM__6_1_M34_S5_S3 6 -204 1326 DEPOSIT ABSOLUTE /end AXIS_DESCR
/end CHARACTERISTIC
/begin CHARACTERISTIC KF_MENACHFOLNACHRS21 "Nachmotoreingriff fuer Folgeschaltung nach RS" MAP 0x1A8960 ZF_kf_ui8_S5_S3 768 UMR_NM__6_1_M128_S5_S3 -768 0
 /begin AXIS_DESCR STD_AXIS NO_INPUT_QUANTITY UMR_U_MIN_32_1_0_S5_S3 6 0 8160 DEPOSIT ABSOLUTE /end AXIS_DESCR
 /begin AXIS_DESCR STD_AXIS zff_atsys._.iSignale._.obj.sig_m_t8 UMR_NM__6_1_M34_S5_S3 6 -204 1326 DEPOSIT ABSOLUTE /end AXIS_DESCR
/end CHARACTERISTIC
/begin CHARACTERISTIC KF_MENACHFOLNACHRS21_EL "Nachmotoreingriff fuer Folgeschaltung nach RS" MAP 0x1A8998 ZF_kf_ui8_S5_S3 768 UMR_NM__6_1_M128_S5_S3 -768 0
 /begin AXIS_DESCR STD_AXIS NO_INPUT_QUANTITY UMR_U_MIN_32_1_0_S5_S3 6 0 8160 DEPOSIT ABSOLUTE /end AXIS_DESCR
 /begin AXIS_DESCR STD_AXIS zff_atsys._.iSignale._.obj.sig_m_t8 UMR_NM__6_1_M34_S5_S3 6 -204 1326 DEPOSIT ABSOLUTE /end AXIS_DESCR
/end CHARACTERISTIC
/begin CHARACTERISTIC KF_MENACHFOLNACHRS32 "Nachmotoreingriff fuer Folgeschaltung nach RS" MAP 0x1A8B20 ZF_kf_ui8_S5_S3 768 UMR_NM__6_1_M128_S5_S3 -768 0
 /begin AXIS_DESCR STD_AXIS NO_INPUT_QUANTITY UMR_U_MIN_32_1_0_S5_S3 6 0 8160 DEPOSIT ABSOLUTE /end AXIS_DESCR
 /begin AXIS_DESCR STD_AXIS zff_atsys._.iSignale._.obj.sig_m_t8 UMR_NM__6_1_M34_S5_S3 6 -204 1326 DEPOSIT ABSOLUTE /end AXIS_DESCR
/end CHARACTERISTIC
/begin CHARACTERISTIC KF_MENACHFOLNACHRS32_EL "Nachmotoreingriff fuer Folgeschaltung nach RS" MAP 0x1A8B58 ZF_kf_ui8_S5_S3 768 UMR_NM__6_1_M128_S5_S3 -768 0
 /begin AXIS_DESCR STD_AXIS NO_INPUT_QUANTITY UMR_U_MIN_32_1_0_S5_S3 6 0 8160 DEPOSIT ABSOLUTE /end AXIS_DESCR
 /begin AXIS_DESCR STD_AXIS zff_atsys._.iSignale._.obj.sig_m_t8 UMR_NM__6_1_M34_S5_S3 6 -204 1326 DEPOSIT ABSOLUTE /end AXIS_DESCR
/end CHARACTERISTIC
/begin CHARACTERISTIC KF_MENACHFOLNACHRS43 "Nachmotoreingriff fuer Folgeschaltung nach RS" MAP 0x1A8CE0 ZF_kf_ui8_S5_S3 768 UMR_NM__6_1_M128_S5_S3 -768 0
 /begin AXIS_DESCR STD_AXIS NO_INPUT_QUANTITY UMR_U_MIN_32_1_0_S5_S3 6 0 8160 DEPOSIT ABSOLUTE /end AXIS_DESCR
 /begin AXIS_DESCR STD_AXIS zff_atsys._.iSignale._.obj.sig_m_t8 UMR_NM__6_1_M34_S5_S3 6 -204 1326 DEPOSIT ABSOLUTE /end AXIS_DESCR
/end CHARACTERISTIC
/begin CHARACTERISTIC KF_MENACHFOLNACHRS43_EL "Nachmotoreingriff fuer Folgeschaltung nach RS" MAP 0x1A8D18 ZF_kf_ui8_S5_S3 768 UMR_NM__6_1_M128_S5_S3 -768 0
 /begin AXIS_DESCR STD_AXIS NO_INPUT_QUANTITY UMR_U_MIN_32_1_0_S5_S3 6 0 8160 DEPOSIT ABSOLUTE /end AXIS_DESCR
 /begin AXIS_DESCR STD_AXIS zff_atsys._.iSignale._.obj.sig_m_t8 UMR_NM__6_1_M34_S5_S3 6 -204 1326 DEPOSIT ABSOLUTE /end AXIS_DESCR
/end CHARACTERISTIC
/begin CHARACTERISTIC KF_MENACHFOLNACHRS54 "Nachmotoreingriff fuer Folgeschaltung nach RS" MAP 0x1A8EA0 ZF_kf_ui8_S5_S3 768 UMR_NM__6_1_M128_S5_S3 -768 0
 /begin AXIS_DESCR STD_AXIS NO_INPUT_QUANTITY UMR_U_MIN_32_1_0_S5_S3 6 0 8160 DEPOSIT ABSOLUTE /end AXIS_DESCR
 /begin AXIS_DESCR STD_AXIS zff_atsys._.iSignale._.obj.sig_m_t8 UMR_NM__6_1_M34_S5_S3 6 -204 1326 DEPOSIT ABSOLUTE /end AXIS_DESCR
/end CHARACTERISTIC
/begin CHARACTERISTIC KF_MENACHFOLNACHRS54_EL "Nachmotoreingriff fuer Folgeschaltung nach RS" MAP 0x1A8ED8 ZF_kf_ui8_S5_S3 768 UMR_NM__6_1_M128_S5_S3 -768 0
 /begin AXIS_DESCR STD_AXIS NO_INPUT_QUANTITY UMR_U_MIN_32_1_0_S5_S3 6 0 8160 DEPOSIT ABSOLUTE /end AXIS_DESCR
 /begin AXIS_DESCR STD_AXIS zff_atsys._.iSignale._.obj.sig_m_t8 UMR_NM__6_1_M34_S5_S3 6 -204 1326 DEPOSIT ABSOLUTE /end AXIS_DESCR
/end CHARACTERISTIC
/begin CHARACTERISTIC KF_MENACHFOLNACHRS65 "Nachmotoreingriff fuer Folgeschaltung nach RS" MAP 0x1A9060 ZF_kf_ui8_S5_S3 768 UMR_NM__6_1_M128_S5_S3 -768 0
 /begin AXIS_DESCR STD_AXIS NO_INPUT_QUANTITY UMR_U_MIN_32_1_0_S5_S3 6 0 8160 DEPOSIT ABSOLUTE /end AXIS_DESCR
 /begin AXIS_DESCR STD_AXIS zff_atsys._.iSignale._.obj.sig_m_t8 UMR_NM__6_1_M34_S5_S3 6 -204 1326 DEPOSIT ABSOLUTE /end AXIS_DESCR
/end CHARACTERISTIC
/begin CHARACTERISTIC KF_MENACHFOLNACHRS65_EL "Nachmotoreingriff fuer Folgeschaltung nach RS" MAP 0x1A9098 ZF_kf_ui8_S5_S3 768 UMR_NM__6_1_M128_S5_S3 -768 0
 /begin AXIS_DESCR STD_AXIS NO_INPUT_QUANTITY UMR_U_MIN_32_1_0_S5_S3 6 0 8160 DEPOSIT ABSOLUTE /end AXIS_DESCR
 /begin AXIS_DESCR STD_AXIS zff_atsys._.iSignale._.obj.sig_m_t8 UMR_NM__6_1_M34_S5_S3 6 -204 1326 DEPOSIT ABSOLUTE /end AXIS_DESCR
/end CHARACTERISTIC
/begin CHARACTERISTIC KF_MENACHFOLNACHRS76 "Nachmotoreingriff fuer Folgeschaltung nach RS" MAP 0x1A9220 ZF_kf_ui8_S5_S3 768 UMR_NM__6_1_M128_S5_S3 -768 0
 /begin AXIS_DESCR STD_AXIS NO_INPUT_QUANTITY UMR_U_MIN_32_1_0_S5_S3 6 0 8160 DEPOSIT ABSOLUTE /end AXIS_DESCR
 /begin AXIS_DESCR STD_AXIS zff_atsys._.iSignale._.obj.sig_m_t8 UMR_NM__6_1_M34_S5_S3 6 -204 1326 DEPOSIT ABSOLUTE /end AXIS_DESCR
/end CHARACTERISTIC
/begin CHARACTERISTIC KF_MENACHFOLNACHRS76_EL "Nachmotoreingriff fuer Folgeschaltung nach RS" MAP 0x1A9258 ZF_kf_ui8_S5_S3 768 UMR_NM__6_1_M128_S5_S3 -768 0
 /begin AXIS_DESCR STD_AXIS NO_INPUT_QUANTITY UMR_U_MIN_32_1_0_S5_S3 6 0 8160 DEPOSIT ABSOLUTE /end AXIS_DESCR
 /begin AXIS_DESCR STD_AXIS zff_atsys._.iSignale._.obj.sig_m_t8 UMR_NM__6_1_M34_S5_S3 6 -204 1326 DEPOSIT ABSOLUTE /end AXIS_DESCR
/end CHARACTERISTIC
/begin CHARACTERISTIC KF_MENACHFOLNACHRS87 "Nachmotoreingriff fuer Folgeschaltung nach RS" MAP 0x1A93E0 ZF_kf_ui8_S5_S3 768 UMR_NM__6_1_M128_S5_S3 -768 0
 /begin AXIS_DESCR STD_AXIS NO_INPUT_QUANTITY UMR_U_MIN_32_1_0_S5_S3 6 0 8160 DEPOSIT ABSOLUTE /end AXIS_DESCR
 /begin AXIS_DESCR STD_AXIS zff_atsys._.iSignale._.obj.sig_m_t8 UMR_NM__6_1_M34_S5_S3 6 -204 1326 DEPOSIT ABSOLUTE /end AXIS_DESCR
/end CHARACTERISTIC
/begin CHARACTERISTIC KF_MENACHFOLNACHRS87_EL "Nachmotoreingriff fuer Folgeschaltung nach RS" MAP 0x1A9418 ZF_kf_ui8_S5_S3 768 UMR_NM__6_1_M128_S5_S3 -768 0
 /begin AXIS_DESCR STD_AXIS NO_INPUT_QUANTITY UMR_U_MIN_32_1_0_S5_S3 6 0 8160 DEPOSIT ABSOLUTE /end AXIS_DESCR
 /begin AXIS_DESCR STD_AXIS zff_atsys._.iSignale._.obj.sig_m_t8 UMR_NM__6_1_M34_S5_S3 6 -204 1326 DEPOSIT ABSOLUTE /end AXIS_DESCR
/end CHARACTERISTIC
/begin CHARACTERISTIC KF_MENACHFOLNACHRSSP21 "Nachmotoreingriff fuer Folgeschaltung nach RS" MAP 0x1A8A40 ZF_kf_ui8_S5_S3 768 UMR_NM__6_1_M128_S5_S3 -768 0
 /begin AXIS_DESCR STD_AXIS NO_INPUT_QUANTITY UMR_U_MIN_32_1_0_S5_S3 6 0 8160 DEPOSIT ABSOLUTE /end AXIS_DESCR
 /begin AXIS_DESCR STD_AXIS zff_atsys._.iSignale._.obj.sig_m_t8 UMR_NM__6_1_M34_S5_S3 6 -204 1326 DEPOSIT ABSOLUTE /end AXIS_DESCR
/end CHARACTERISTIC
/begin CHARACTERISTIC KF_MENACHFOLNACHRSSP32 "Nachmotoreingriff fuer Folgeschaltung nach RS" MAP 0x1A8C00 ZF_kf_ui8_S5_S3 768 UMR_NM__6_1_M128_S5_S3 -768 0
 /begin AXIS_DESCR STD_AXIS NO_INPUT_QUANTITY UMR_U_MIN_32_1_0_S5_S3 6 0 8160 DEPOSIT ABSOLUTE /end AXIS_DESCR
 /begin AXIS_DESCR STD_AXIS zff_atsys._.iSignale._.obj.sig_m_t8 UMR_NM__6_1_M34_S5_S3 6 -204 1326 DEPOSIT ABSOLUTE /end AXIS_DESCR
/end CHARACTERISTIC
/begin CHARACTERISTIC KF_MENACHFOLNACHRSSP43 "Nachmotoreingriff fuer Folgeschaltung nach RS" MAP 0x1A8DC0 ZF_kf_ui8_S5_S3 768 UMR_NM__6_1_M128_S5_S3 -768 0
 /begin AXIS_DESCR STD_AXIS NO_INPUT_QUANTITY UMR_U_MIN_32_1_0_S5_S3 6 0 8160 DEPOSIT ABSOLUTE /end AXIS_DESCR
 /begin AXIS_DESCR STD_AXIS zff_atsys._.iSignale._.obj.sig_m_t8 UMR_NM__6_1_M34_S5_S3 6 -204 1326 DEPOSIT ABSOLUTE /end AXIS_DESCR
/end CHARACTERISTIC
/begin CHARACTERISTIC KF_MENACHFOLNACHRSSP54 "Nachmotoreingriff fuer Folgeschaltung nach RS" MAP 0x1A8F80 ZF_kf_ui8_S5_S3 768 UMR_NM__6_1_M128_S5_S3 -768 0
 /begin AXIS_DESCR STD_AXIS NO_INPUT_QUANTITY UMR_U_MIN_32_1_0_S5_S3 6 0 8160 DEPOSIT ABSOLUTE /end AXIS_DESCR
 /begin AXIS_DESCR STD_AXIS zff_atsys._.iSignale._.obj.sig_m_t8 UMR_NM__6_1_M34_S5_S3 6 -204 1326 DEPOSIT ABSOLUTE /end AXIS_DESCR
/end CHARACTERISTIC
/begin CHARACTERISTIC KF_MENACHFOLNACHRSSP65 "Nachmotoreingriff fuer Folgeschaltung nach RS" MAP 0x1A9140 ZF_kf_ui8_S5_S3 768 UMR_NM__6_1_M128_S5_S3 -768 0
 /begin AXIS_DESCR STD_AXIS NO_INPUT_QUANTITY UMR_U_MIN_32_1_0_S5_S3 6 0 8160 DEPOSIT ABSOLUTE /end AXIS_DESCR
 /begin AXIS_DESCR STD_AXIS zff_atsys._.iSignale._.obj.sig_m_t8 UMR_NM__6_1_M34_S5_S3 6 -204 1326 DEPOSIT ABSOLUTE /end AXIS_DESCR
/end CHARACTERISTIC
/begin CHARACTERISTIC KF_MENACHFOLNACHRSSP76 "Nachmotoreingriff fuer Folgeschaltung nach RS" MAP 0x1A9300 ZF_kf_ui8_S5_S3 768 UMR_NM__6_1_M128_S5_S3 -768 0
 /begin AXIS_DESCR STD_AXIS NO_INPUT_QUANTITY UMR_U_MIN_32_1_0_S5_S3 6 0 8160 DEPOSIT ABSOLUTE /end AXIS_DESCR
 /begin AXIS_DESCR STD_AXIS zff_atsys._.iSignale._.obj.sig_m_t8 UMR_NM__6_1_M34_S5_S3 6 -204 1326 DEPOSIT ABSOLUTE /end AXIS_DESCR
/end CHARACTERISTIC
/begin CHARACTERISTIC KF_MENACHFOLNACHRSSP87 "Nachmotoreingriff fuer Folgeschaltung nach RS" MAP 0x1A94C0 ZF_kf_ui8_S5_S3 768 UMR_NM__6_1_M128_S5_S3 -768 0
 /begin AXIS_DESCR STD_AXIS NO_INPUT_QUANTITY UMR_U_MIN_32_1_0_S5_S3 6 0 8160 DEPOSIT ABSOLUTE /end AXIS_DESCR
 /begin AXIS_DESCR STD_AXIS zff_atsys._.iSignale._.obj.sig_m_t8 UMR_NM__6_1_M34_S5_S3 6 -204 1326 DEPOSIT ABSOLUTE /end AXIS_DESCR
/end CHARACTERISTIC
/begin CHARACTERISTIC KF_MENACHFOLNACHRSSPORT21 "Nachmotoreingriff fuer Folgeschaltung nach RS" MAP 0x1A8AB0 ZF_kf_ui8_S5_S3 768 UMR_NM__6_1_M128_S5_S3 -768 0
 /begin AXIS_DESCR STD_AXIS NO_INPUT_QUANTITY UMR_U_MIN_32_1_0_S5_S3 6 0 8160 DEPOSIT ABSOLUTE /end AXIS_DESCR
 /begin AXIS_DESCR STD_AXIS zff_atsys._.iSignale._.obj.sig_m_t8 UMR_NM__6_1_M34_S5_S3 6 -204 1326 DEPOSIT ABSOLUTE /end AXIS_DESCR
/end CHARACTERISTIC
/begin CHARACTERISTIC KF_MENACHFOLNACHRSSPORT32 "Nachmotoreingriff fuer Folgeschaltung nach RS" MAP 0x1A8C70 ZF_kf_ui8_S5_S3 768 UMR_NM__6_1_M128_S5_S3 -768 0
 /begin AXIS_DESCR STD_AXIS NO_INPUT_QUANTITY UMR_U_MIN_32_1_0_S5_S3 6 0 8160 DEPOSIT ABSOLUTE /end AXIS_DESCR
 /begin AXIS_DESCR STD_AXIS zff_atsys._.iSignale._.obj.sig_m_t8 UMR_NM__6_1_M34_S5_S3 6 -204 1326 DEPOSIT ABSOLUTE /end AXIS_DESCR
/end CHARACTERISTIC
/begin CHARACTERISTIC KF_MENACHFOLNACHRSSPORT43 "Nachmotoreingriff fuer Folgeschaltung nach RS" MAP 0x1A8E30 ZF_kf_ui8_S5_S3 768 UMR_NM__6_1_M128_S5_S3 -768 0
 /begin AXIS_DESCR STD_AXIS NO_INPUT_QUANTITY UMR_U_MIN_32_1_0_S5_S3 6 0 8160 DEPOSIT ABSOLUTE /end AXIS_DESCR
 /begin AXIS_DESCR STD_AXIS zff_atsys._.iSignale._.obj.sig_m_t8 UMR_NM__6_1_M34_S5_S3 6 -204 1326 DEPOSIT ABSOLUTE /end AXIS_DESCR
/end CHARACTERISTIC
/begin CHARACTERISTIC KF_MENACHFOLNACHRSSPORT54 "Nachmotoreingriff fuer Folgeschaltung nach RS" MAP 0x1A8FF0 ZF_kf_ui8_S5_S3 768 UMR_NM__6_1_M128_S5_S3 -768 0
 /begin AXIS_DESCR STD_AXIS NO_INPUT_QUANTITY UMR_U_MIN_32_1_0_S5_S3 6 0 8160 DEPOSIT ABSOLUTE /end AXIS_DESCR
 /begin AXIS_DESCR STD_AXIS zff_atsys._.iSignale._.obj.sig_m_t8 UMR_NM__6_1_M34_S5_S3 6 -204 1326 DEPOSIT ABSOLUTE /end AXIS_DESCR
/end CHARACTERISTIC
/begin CHARACTERISTIC KF_MENACHFOLNACHRSSPORT65 "Nachmotoreingriff fuer Folgeschaltung nach RS" MAP 0x1A91B0 ZF_kf_ui8_S5_S3 768 UMR_NM__6_1_M128_S5_S3 -768 0
 /begin AXIS_DESCR STD_AXIS NO_INPUT_QUANTITY UMR_U_MIN_32_1_0_S5_S3 6 0 8160 DEPOSIT ABSOLUTE /end AXIS_DESCR
 /begin AXIS_DESCR STD_AXIS zff_atsys._.iSignale._.obj.sig_m_t8 UMR_NM__6_1_M34_S5_S3 6 -204 1326 DEPOSIT ABSOLUTE /end AXIS_DESCR
/end CHARACTERISTIC
/begin CHARACTERISTIC KF_MENACHFOLNACHRSSPORT76 "Nachmotoreingriff fuer Folgeschaltung nach RS" MAP 0x1A9370 ZF_kf_ui8_S5_S3 768 UMR_NM__6_1_M128_S5_S3 -768 0
 /begin AXIS_DESCR STD_AXIS NO_INPUT_QUANTITY UMR_U_MIN_32_1_0_S5_S3 6 0 8160 DEPOSIT ABSOLUTE /end AXIS_DESCR
 /begin AXIS_DESCR STD_AXIS zff_atsys._.iSignale._.obj.sig_m_t8 UMR_NM__6_1_M34_S5_S3 6 -204 1326 DEPOSIT ABSOLUTE /end AXIS_DESCR
/end CHARACTERISTIC
/begin CHARACTERISTIC KF_MENACHFOLNACHRSSPORT87 "Nachmotoreingriff fuer Folgeschaltung nach RS" MAP 0x1A9530 ZF_kf_ui8_S5_S3 768 UMR_NM__6_1_M128_S5_S3 -768 0
 /begin AXIS_DESCR STD_AXIS NO_INPUT_QUANTITY UMR_U_MIN_32_1_0_S5_S3 6 0 8160 DEPOSIT ABSOLUTE /end AXIS_DESCR
 /begin AXIS_DESCR STD_AXIS zff_atsys._.iSignale._.obj.sig_m_t8 UMR_NM__6_1_M34_S5_S3 6 -204 1326 DEPOSIT ABSOLUTE /end AXIS_DESCR
/end CHARACTERISTIC
/begin CHARACTERISTIC KF_MGSOLL_MDIF_ENTKOPPL "Schließrampe im Entkoppeln, gesteuerter Anteil der Entkopplungfunktion" MAP 0x1A38C0 ZF_kf_si16_S5_S3 1000 UMR_NM_SEC_1_1_0_S5_S3 0 1000
 /begin AXIS_DESCR STD_AXIS NO_INPUT_QUANTITY UMR_PROZENT__20_51_0_S5_S3 4 0 100 DEPOSIT ABSOLUTE /end AXIS_DESCR
 /begin AXIS_DESCR STD_AXIS NO_INPUT_QUANTITY UMR_NM__1_1_0_S5_S3 6 -2000 2000 DEPOSIT ABSOLUTE /end AXIS_DESCR
/end CHARACTERISTIC
/begin CHARACTERISTIC KF_MGSOLL_NDG_ENTKOPPL "Schließrampe im Entkoppeln, geregelter Anteil der Entkopplungfunktion" MAP 0x1A390C ZF_kf_si16_S5_S3 1000 UMR_NM_SEC_1_1_0_S5_S3 0 1000
 /begin AXIS_DESCR STD_AXIS NO_INPUT_QUANTITY UMR_PROZENT__20_51_0_S5_S3 4 0 100 DEPOSIT ABSOLUTE /end AXIS_DESCR
 /begin AXIS_DESCR STD_AXIS iIaeSigna.ndg_iae UMR_U_MINSEC_1_1_0_S5_S3 4 -30000 30000 DEPOSIT ABSOLUTE /end AXIS_DESCR
/end CHARACTERISTIC
/begin CHARACTERISTIC KF_MOLWGERGESK0S "Gesteuertes Momentenoffset bei Lastwechseln in GEREGELTGESCHLOSSEN (in Schub hinein)" MAP 0x1A3248 ZF_kf_fl32_S5_S3 3000 UMR_NM__1_1_0_S5_S3 -1500 1500
 /begin AXIS_DESCR STD_AXIS iK0sKorSignale.n_em_sync_k0_fl UMR_U_MIN_1_1_0_S5_S3 4 0 10000 DEPOSIT ABSOLUTE /end AXIS_DESCR
 /begin AXIS_DESCR STD_AXIS NO_INPUT_QUANTITY UMR___1_1_0_S5_S3 4 -400 1640 DEPOSIT ABSOLUTE FORMAT "%3.2" /end AXIS_DESCR
/end CHARACTERISTIC
/begin CHARACTERISTIC KF_MOLWGERGESK0S_SP "Gesteuertes Momentenoffset bei Lastwechseln in GEREGELTGESCHLOSSEN (in Schub hinein)" MAP 0x1A3508 ZF_kf_fl32_S5_S3 3000 UMR_NM__1_1_0_S5_S3 -1500 1500
 /begin AXIS_DESCR STD_AXIS iK0sKorSignale.n_em_sync_k0_fl UMR_U_MIN_1_1_0_S5_S3 4 0 10000 DEPOSIT ABSOLUTE /end AXIS_DESCR
 /begin AXIS_DESCR STD_AXIS NO_INPUT_QUANTITY UMR___1_1_0_S5_S3 4 -400 1640 DEPOSIT ABSOLUTE FORMAT "%3.2" /end AXIS_DESCR
/end CHARACTERISTIC
/begin CHARACTERISTIC KF_MOLWGERGESK0Z "Gesteuertes Momentenoffset bei Lastwechseln in GEREGELTGESCHLOSSEN (in Zug hinein)" MAP 0x1A3318 ZF_kf_fl32_S5_S3 3000 UMR_NM__1_1_0_S5_S3 -1500 1500
 /begin AXIS_DESCR STD_AXIS iK0sKorSignale.n_em_sync_k0_fl UMR_U_MIN_1_1_0_S5_S3 4 0 10000 DEPOSIT ABSOLUTE /end AXIS_DESCR
 /begin AXIS_DESCR STD_AXIS NO_INPUT_QUANTITY UMR___1_1_0_S5_S3 4 -400 1640 DEPOSIT ABSOLUTE FORMAT "%3.2" /end AXIS_DESCR
/end CHARACTERISTIC
/begin CHARACTERISTIC KF_MOLWGERGESK0Z_SP "Gesteuertes Momentenoffset bei Lastwechseln in GEREGELTGESCHLOSSEN (in Zug hinein)" MAP 0x1A35D8 ZF_kf_fl32_S5_S3 3000 UMR_NM__1_1_0_S5_S3 -1500 1500
 /begin AXIS_DESCR STD_AXIS iK0sKorSignale.n_em_sync_k0_fl UMR_U_MIN_1_1_0_S5_S3 4 0 10000 DEPOSIT ABSOLUTE /end AXIS_DESCR
 /begin AXIS_DESCR STD_AXIS NO_INPUT_QUANTITY UMR___1_1_0_S5_S3 4 -400 1640 DEPOSIT ABSOLUTE FORMAT "%3.2" /end AXIS_DESCR
/end CHARACTERISTIC
/begin CHARACTERISTIC KF_MOLWSPFGERK0S "Momentenoffset beim wechsel nach Schub" MAP 0x1A32B0 ZF_kf_fl32_S5_S3 3000 UMR_NM__1_1_0_S5_S3 -1500 1500
 /begin AXIS_DESCR STD_AXIS iK0sKorSignale.n_em_sync_k0_fl UMR_U_MIN_1_1_0_S5_S3 4 0 10000 DEPOSIT ABSOLUTE /end AXIS_DESCR
 /begin AXIS_DESCR STD_AXIS NO_INPUT_QUANTITY UMR___1_1_0_S5_S3 4 -400 1640 DEPOSIT ABSOLUTE FORMAT "%3.2" /end AXIS_DESCR
/end CHARACTERISTIC
/begin CHARACTERISTIC KF_MOLWSPFGERK0S_SP "Momentenoffset beim wechsel nach Schub" MAP 0x1A3570 ZF_kf_fl32_S5_S3 3000 UMR_NM__1_1_0_S5_S3 -1500 1500
 /begin AXIS_DESCR STD_AXIS iK0sKorSignale.n_em_sync_k0_fl UMR_U_MIN_1_1_0_S5_S3 4 0 10000 DEPOSIT ABSOLUTE /end AXIS_DESCR
 /begin AXIS_DESCR STD_AXIS NO_INPUT_QUANTITY UMR___1_1_0_S5_S3 4 -400 1640 DEPOSIT ABSOLUTE FORMAT "%3.2" /end AXIS_DESCR
/end CHARACTERISTIC
/begin CHARACTERISTIC KF_MOLWSPFGERK0Z "Momentenoffset beim Ausstieg aus LASTFREI im Zug" MAP 0x1A3380 ZF_kf_fl32_S5_S3 3000 UMR_NM__1_1_0_S5_S3 -1500 1500
 /begin AXIS_DESCR STD_AXIS iK0sKorSignale.n_em_sync_k0_fl UMR_U_MIN_1_1_0_S5_S3 4 0 10000 DEPOSIT ABSOLUTE /end AXIS_DESCR
 /begin AXIS_DESCR STD_AXIS NO_INPUT_QUANTITY UMR___1_1_0_S5_S3 4 -400 1640 DEPOSIT ABSOLUTE FORMAT "%3.2" /end AXIS_DESCR
/end CHARACTERISTIC
/begin CHARACTERISTIC KF_MOLWSPFGERK0Z_SP "Momentenoffset beim Ausstieg aus LASTFREI im Zug" MAP 0x1A3640 ZF_kf_fl32_S5_S3 3000 UMR_NM__1_1_0_S5_S3 -1500 1500
 /begin AXIS_DESCR STD_AXIS iK0sKorSignale.n_em_sync_k0_fl UMR_U_MIN_1_1_0_S5_S3 4 0 10000 DEPOSIT ABSOLUTE /end AXIS_DESCR
 /begin AXIS_DESCR STD_AXIS NO_INPUT_QUANTITY UMR___1_1_0_S5_S3 4 -400 1640 DEPOSIT ABSOLUTE FORMAT "%3.2" /end AXIS_DESCR
/end CHARACTERISTIC
/begin CHARACTERISTIC KF_MOSOLLLASTNMOT_ENTKOPPL "Momentenoffset bei Laständerung in Synchronisieren der Entkopplungfunktion" MAP 0x1A3858 ZF_kf_si16_S5_S3 2000 UMR_NM__1_1_0_S5_S3 -1000 1000
 /begin AXIS_DESCR STD_AXIS NO_INPUT_QUANTITY UMR_NM__1_1_0_S5_S3 6 -200 1300 DEPOSIT ABSOLUTE /end AXIS_DESCR
 /begin AXIS_DESCR STD_AXIS iIaeSigna.n_mot_iae UMR_U_MIN_1_1_0_S5_S3 6 0 10000 DEPOSIT ABSOLUTE /end AXIS_DESCR
/end CHARACTERISTIC
/begin CHARACTERISTIC KF_MOSOLLNDIAETIMER_ENTKOPPL "Momentenoffset bei zunehmendem nd_iae_kf und Timerwert im Schliessen_Entkoppeln" MAP 0x1A3A1C ZF_kf_si16_S5_S3 1000 UMR_NM__1_1_0_S5_S3 0 1000
 /begin AXIS_DESCR STD_AXIS NO_INPUT_QUANTITY UMR_MSEC__10_1_0_S5_S3 6 0 300000 DEPOSIT ABSOLUTE /end AXIS_DESCR
 /begin AXIS_DESCR STD_AXIS iIaeSigna.nd_iae UMR_U_MIN_1_1_0_S5_S3 6 0 10000 DEPOSIT ABSOLUTE /end AXIS_DESCR
/end CHARACTERISTIC
/begin CHARACTERISTIC KF_MSCHALTK012_SP "[Nm] Schaltmoment" MAP 0x1A23F8 ZF_kf_fl32_S5_S3 3000 UMR_NM__1_1_0_S5_S3 -1500 1500
 /begin AXIS_DESCR STD_AXIS iK0sKorSignale.n_em_sync_k0_fl UMR_U_MIN_1_1_0_S5_S3 4 0 10000 DEPOSIT ABSOLUTE /end AXIS_DESCR
 /begin AXIS_DESCR STD_AXIS NO_INPUT_QUANTITY UMR___1_1_0_S5_S3 6 -400 1640 DEPOSIT ABSOLUTE FORMAT "%3.2" /end AXIS_DESCR
/end CHARACTERISTIC
/begin CHARACTERISTIC KF_MSCHALTK021_SP "[Nm] Schaltmoment" MAP 0x1A2908 ZF_kf_fl32_S5_S3 3000 UMR_NM__1_1_0_S5_S3 -1500 1500
 /begin AXIS_DESCR STD_AXIS iK0sKorSignale.n_em_sync_k0_fl UMR_U_MIN_1_1_0_S5_S3 4 0 10000 DEPOSIT ABSOLUTE /end AXIS_DESCR
 /begin AXIS_DESCR STD_AXIS NO_INPUT_QUANTITY UMR___1_1_0_S5_S3 6 -400 1640 DEPOSIT ABSOLUTE FORMAT "%3.2" /end AXIS_DESCR
/end CHARACTERISTIC
/begin CHARACTERISTIC KF_MSCHALTK023_SP "[Nm] Schaltmoment" MAP 0x1A2488 ZF_kf_fl32_S5_S3 3000 UMR_NM__1_1_0_S5_S3 -1500 1500
 /begin AXIS_DESCR STD_AXIS iK0sKorSignale.n_em_sync_k0_fl UMR_U_MIN_1_1_0_S5_S3 4 0 10000 DEPOSIT ABSOLUTE /end AXIS_DESCR
 /begin AXIS_DESCR STD_AXIS NO_INPUT_QUANTITY UMR___1_1_0_S5_S3 6 -400 1640 DEPOSIT ABSOLUTE FORMAT "%3.2" /end AXIS_DESCR
/end CHARACTERISTIC
/begin CHARACTERISTIC KF_MSCHALTK031_SP "[Nm] Schaltmoment" MAP 0x1A2B48 ZF_kf_fl32_S5_S3 3000 UMR_NM__1_1_0_S5_S3 -1500 1500
 /begin AXIS_DESCR STD_AXIS iK0sKorSignale.n_em_sync_k0_fl UMR_U_MIN_1_1_0_S5_S3 4 0 10000 DEPOSIT ABSOLUTE /end AXIS_DESCR
 /begin AXIS_DESCR STD_AXIS NO_INPUT_QUANTITY UMR___1_1_0_S5_S3 6 -400 1640 DEPOSIT ABSOLUTE FORMAT "%3.2" /end AXIS_DESCR
/end CHARACTERISTIC
/begin CHARACTERISTIC KF_MSCHALTK032_SP "[Nm] Schaltmoment" MAP 0x1A2878 ZF_kf_fl32_S5_S3 3000 UMR_NM__1_1_0_S5_S3 -1500 1500
 /begin AXIS_DESCR STD_AXIS iK0sKorSignale.n_em_sync_k0_fl UMR_U_MIN_1_1_0_S5_S3 4 0 10000 DEPOSIT ABSOLUTE /end AXIS_DESCR
 /begin AXIS_DESCR STD_AXIS NO_INPUT_QUANTITY UMR___1_1_0_S5_S3 6 -400 1640 DEPOSIT ABSOLUTE FORMAT "%3.2" /end AXIS_DESCR
/end CHARACTERISTIC
/begin CHARACTERISTIC KF_MSCHALTK034_SP "[Nm] Schaltmoment" MAP 0x1A2518 ZF_kf_fl32_S5_S3 3000 UMR_NM__1_1_0_S5_S3 -1500 1500
 /begin AXIS_DESCR STD_AXIS iK0sKorSignale.n_em_sync_k0_fl UMR_U_MIN_1_1_0_S5_S3 4 0 10000 DEPOSIT ABSOLUTE /end AXIS_DESCR
 /begin AXIS_DESCR STD_AXIS NO_INPUT_QUANTITY UMR___1_1_0_S5_S3 6 -400 1640 DEPOSIT ABSOLUTE FORMAT "%3.2" /end AXIS_DESCR
/end CHARACTERISTIC
/begin CHARACTERISTIC KF_MSCHALTK042_SP "[Nm] Schaltmoment" MAP 0x1A2AB8 ZF_kf_fl32_S5_S3 3000 UMR_NM__1_1_0_S5_S3 -1500 1500
 /begin AXIS_DESCR STD_AXIS iK0sKorSignale.n_em_sync_k0_fl UMR_U_MIN_1_1_0_S5_S3 4 0 10000 DEPOSIT ABSOLUTE /end AXIS_DESCR
 /begin AXIS_DESCR STD_AXIS NO_INPUT_QUANTITY UMR___1_1_0_S5_S3 6 -400 1640 DEPOSIT ABSOLUTE FORMAT "%3.2" /end AXIS_DESCR
/end CHARACTERISTIC
/begin CHARACTERISTIC KF_MSCHALTK043_SP "[Nm] Schaltmoment" MAP 0x1A27E8 ZF_kf_fl32_S5_S3 3000 UMR_NM__1_1_0_S5_S3 -1500 1500
 /begin AXIS_DESCR STD_AXIS iK0sKorSignale.n_em_sync_k0_fl UMR_U_MIN_1_1_0_S5_S3 4 0 10000 DEPOSIT ABSOLUTE /end AXIS_DESCR
 /begin AXIS_DESCR STD_AXIS NO_INPUT_QUANTITY UMR___1_1_0_S5_S3 6 -400 1640 DEPOSIT ABSOLUTE FORMAT "%3.2" /end AXIS_DESCR
/end CHARACTERISTIC
/begin CHARACTERISTIC KF_MSCHALTK045_SP "[Nm] Schaltmoment" MAP 0x1A25A8 ZF_kf_fl32_S5_S3 3000 UMR_NM__1_1_0_S5_S3 -1500 1500
 /begin AXIS_DESCR STD_AXIS iK0sKorSignale.n_em_sync_k0_fl UMR_U_MIN_1_1_0_S5_S3 4 0 10000 DEPOSIT ABSOLUTE /end AXIS_DESCR
 /begin AXIS_DESCR STD_AXIS NO_INPUT_QUANTITY UMR___1_1_0_S5_S3 6 -400 1640 DEPOSIT ABSOLUTE FORMAT "%3.2" /end AXIS_DESCR
/end CHARACTERISTIC
/begin CHARACTERISTIC KF_MSCHALTK051_SP "[Nm] Schaltmoment" MAP 0x1A2F38 ZF_kf_fl32_S5_S3 3000 UMR_NM__1_1_0_S5_S3 -1500 1500
 /begin AXIS_DESCR STD_AXIS iK0sKorSignale.n_em_sync_k0_fl UMR_U_MIN_1_1_0_S5_S3 4 0 10000 DEPOSIT ABSOLUTE /end AXIS_DESCR
 /begin AXIS_DESCR STD_AXIS NO_INPUT_QUANTITY UMR___1_1_0_S5_S3 6 -400 1640 DEPOSIT ABSOLUTE FORMAT "%3.2" /end AXIS_DESCR
/end CHARACTERISTIC
/begin CHARACTERISTIC KF_MSCHALTK053_SP "[Nm] Schaltmoment" MAP 0x1A2A28 ZF_kf_fl32_S5_S3 3000 UMR_NM__1_1_0_S5_S3 -1500 1500
 /begin AXIS_DESCR STD_AXIS iK0sKorSignale.n_em_sync_k0_fl UMR_U_MIN_1_1_0_S5_S3 4 0 10000 DEPOSIT ABSOLUTE /end AXIS_DESCR
 /begin AXIS_DESCR STD_AXIS NO_INPUT_QUANTITY UMR___1_1_0_S5_S3 6 -400 1640 DEPOSIT ABSOLUTE FORMAT "%3.2" /end AXIS_DESCR
/end CHARACTERISTIC
/begin CHARACTERISTIC KF_MSCHALTK054_SP "[Nm] Schaltmoment" MAP 0x1A2758 ZF_kf_fl32_S5_S3 3000 UMR_NM__1_1_0_S5_S3 -1500 1500
 /begin AXIS_DESCR STD_AXIS iK0sKorSignale.n_em_sync_k0_fl UMR_U_MIN_1_1_0_S5_S3 4 0 10000 DEPOSIT ABSOLUTE /end AXIS_DESCR
 /begin AXIS_DESCR STD_AXIS NO_INPUT_QUANTITY UMR___1_1_0_S5_S3 6 -400 1640 DEPOSIT ABSOLUTE FORMAT "%3.2" /end AXIS_DESCR
/end CHARACTERISTIC
/begin CHARACTERISTIC KF_MSCHALTK056_SP "[Nm] Schaltmoment" MAP 0x1A2638 ZF_kf_fl32_S5_S3 3000 UMR_NM__1_1_0_S5_S3 -1500 1500
 /begin AXIS_DESCR STD_AXIS iK0sKorSignale.n_em_sync_k0_fl UMR_U_MIN_1_1_0_S5_S3 4 0 10000 DEPOSIT ABSOLUTE /end AXIS_DESCR
 /begin AXIS_DESCR STD_AXIS NO_INPUT_QUANTITY UMR___1_1_0_S5_S3 6 -400 1640 DEPOSIT ABSOLUTE FORMAT "%3.2" /end AXIS_DESCR
/end CHARACTERISTIC
/begin CHARACTERISTIC KF_MSCHALTK063_SP "[Nm] Schaltmoment" MAP 0x1A2EA8 ZF_kf_fl32_S5_S3 3000 UMR_NM__1_1_0_S5_S3 -1500 1500
 /begin AXIS_DESCR STD_AXIS iK0sKorSignale.n_em_sync_k0_fl UMR_U_MIN_1_1_0_S5_S3 4 0 10000 DEPOSIT ABSOLUTE /end AXIS_DESCR
 /begin AXIS_DESCR STD_AXIS NO_INPUT_QUANTITY UMR___1_1_0_S5_S3 6 -400 1640 DEPOSIT ABSOLUTE FORMAT "%3.2" /end AXIS_DESCR
/end CHARACTERISTIC
/begin CHARACTERISTIC KF_MSCHALTK064_SP "[Nm] Schaltmoment" MAP 0x1A2998 ZF_kf_fl32_S5_S3 3000 UMR_NM__1_1_0_S5_S3 -1500 1500
 /begin AXIS_DESCR STD_AXIS iK0sKorSignale.n_em_sync_k0_fl UMR_U_MIN_1_1_0_S5_S3 4 0 10000 DEPOSIT ABSOLUTE /end AXIS_DESCR
 /begin AXIS_DESCR STD_AXIS NO_INPUT_QUANTITY UMR___1_1_0_S5_S3 6 -400 1640 DEPOSIT ABSOLUTE FORMAT "%3.2" /end AXIS_DESCR
/end CHARACTERISTIC
/begin CHARACTERISTIC KF_MSCHALTK065_SP "[Nm] Schaltmoment" MAP 0x1A26C8 ZF_kf_fl32_S5_S3 3000 UMR_NM__1_1_0_S5_S3 -1500 1500
 /begin AXIS_DESCR STD_AXIS iK0sKorSignale.n_em_sync_k0_fl UMR_U_MIN_1_1_0_S5_S3 4 0 10000 DEPOSIT ABSOLUTE /end AXIS_DESCR
 /begin AXIS_DESCR STD_AXIS NO_INPUT_QUANTITY UMR___1_1_0_S5_S3 6 -400 1640 DEPOSIT ABSOLUTE FORMAT "%3.2" /end AXIS_DESCR
/end CHARACTERISTIC
/begin CHARACTERISTIC KF_MSCHALTK067_SP "[Nm] Schaltmoment" MAP 0x1A3178 ZF_kf_fl32_S5_S3 3000 UMR_NM__1_1_0_S5_S3 -1500 1500
 /begin AXIS_DESCR STD_AXIS iK0sKorSignale.n_em_sync_k0_fl UMR_U_MIN_1_1_0_S5_S3 4 0 10000 DEPOSIT ABSOLUTE /end AXIS_DESCR
 /begin AXIS_DESCR STD_AXIS NO_INPUT_QUANTITY UMR___1_1_0_S5_S3 6 -400 1640 DEPOSIT ABSOLUTE FORMAT "%3.2" /end AXIS_DESCR
/end CHARACTERISTIC
/begin CHARACTERISTIC KF_MSCHALTK071_SP "[Nm] Schaltmoment" MAP 0x1A30E8 ZF_kf_fl32_S5_S3 3000 UMR_NM__1_1_0_S5_S3 -1500 1500
 /begin AXIS_DESCR STD_AXIS iK0sKorSignale.n_em_sync_k0_fl UMR_U_MIN_1_1_0_S5_S3 4 0 10000 DEPOSIT ABSOLUTE /end AXIS_DESCR
 /begin AXIS_DESCR STD_AXIS NO_INPUT_QUANTITY UMR___1_1_0_S5_S3 6 -400 1640 DEPOSIT ABSOLUTE FORMAT "%3.2" /end AXIS_DESCR
/end CHARACTERISTIC
/begin CHARACTERISTIC KF_MSCHALTK075_SP "[Nm] Schaltmoment" MAP 0x1A3058 ZF_kf_fl32_S5_S3 3000 UMR_NM__1_1_0_S5_S3 -1500 1500
 /begin AXIS_DESCR STD_AXIS iK0sKorSignale.n_em_sync_k0_fl UMR_U_MIN_1_1_0_S5_S3 4 0 10000 DEPOSIT ABSOLUTE /end AXIS_DESCR
 /begin AXIS_DESCR STD_AXIS NO_INPUT_QUANTITY UMR___1_1_0_S5_S3 6 -400 1640 DEPOSIT ABSOLUTE FORMAT "%3.2" /end AXIS_DESCR
/end CHARACTERISTIC
/begin CHARACTERISTIC KF_MSCHALTK076_SP "[Nm] Schaltmoment" MAP 0x1A2FC8 ZF_kf_fl32_S5_S3 3000 UMR_NM__1_1_0_S5_S3 -1500 1500
 /begin AXIS_DESCR STD_AXIS iK0sKorSignale.n_em_sync_k0_fl UMR_U_MIN_1_1_0_S5_S3 4 0 10000 DEPOSIT ABSOLUTE /end AXIS_DESCR
 /begin AXIS_DESCR STD_AXIS NO_INPUT_QUANTITY UMR___1_1_0_S5_S3 6 -400 1640 DEPOSIT ABSOLUTE FORMAT "%3.2" /end AXIS_DESCR
/end CHARACTERISTIC
/begin CHARACTERISTIC KF_MSCHALTK078_SP "[Nm] Schaltmoment" MAP 0x1A2E18 ZF_kf_fl32_S5_S3 3000 UMR_NM__1_1_0_S5_S3 -1500 1500
 /begin AXIS_DESCR STD_AXIS iK0sKorSignale.n_em_sync_k0_fl UMR_U_MIN_1_1_0_S5_S3 4 0 10000 DEPOSIT ABSOLUTE /end AXIS_DESCR
 /begin AXIS_DESCR STD_AXIS NO_INPUT_QUANTITY UMR___1_1_0_S5_S3 6 -400 1640 DEPOSIT ABSOLUTE FORMAT "%3.2" /end AXIS_DESCR
/end CHARACTERISTIC
/begin CHARACTERISTIC KF_MSCHALTK082_SP "[Nm] Schaltmoment" MAP 0x1A2D88 ZF_kf_fl32_S5_S3 3000 UMR_NM__1_1_0_S5_S3 -1500 1500
 /begin AXIS_DESCR STD_AXIS iK0sKorSignale.n_em_sync_k0_fl UMR_U_MIN_1_1_0_S5_S3 4 0 10000 DEPOSIT ABSOLUTE /end AXIS_DESCR
 /begin AXIS_DESCR STD_AXIS NO_INPUT_QUANTITY UMR___1_1_0_S5_S3 6 -400 1640 DEPOSIT ABSOLUTE FORMAT "%3.2" /end AXIS_DESCR
/end CHARACTERISTIC
/begin CHARACTERISTIC KF_MSCHALTK084_SP "[Nm] Schaltmoment" MAP 0x1A2CF8 ZF_kf_fl32_S5_S3 3000 UMR_NM__1_1_0_S5_S3 -1500 1500
 /begin AXIS_DESCR STD_AXIS iK0sKorSignale.n_em_sync_k0_fl UMR_U_MIN_1_1_0_S5_S3 4 0 10000 DEPOSIT ABSOLUTE /end AXIS_DESCR
 /begin AXIS_DESCR STD_AXIS NO_INPUT_QUANTITY UMR___1_1_0_S5_S3 6 -400 1640 DEPOSIT ABSOLUTE FORMAT "%3.2" /end AXIS_DESCR
/end CHARACTERISTIC
/begin CHARACTERISTIC KF_MSCHALTK086_SP "[Nm] Schaltmoment" MAP 0x1A2C68 ZF_kf_fl32_S5_S3 3000 UMR_NM__1_1_0_S5_S3 -1500 1500
 /begin AXIS_DESCR STD_AXIS iK0sKorSignale.n_em_sync_k0_fl UMR_U_MIN_1_1_0_S5_S3 4 0 10000 DEPOSIT ABSOLUTE /end AXIS_DESCR
 /begin AXIS_DESCR STD_AXIS NO_INPUT_QUANTITY UMR___1_1_0_S5_S3 6 -400 1640 DEPOSIT ABSOLUTE FORMAT "%3.2" /end AXIS_DESCR
/end CHARACTERISTIC
/begin CHARACTERISTIC KF_MSCHALTK087_SP "[Nm] Schaltmoment" MAP 0x1A2BD8 ZF_kf_fl32_S5_S3 3000 UMR_NM__1_1_0_S5_S3 -1500 1500
 /begin AXIS_DESCR STD_AXIS iK0sKorSignale.n_em_sync_k0_fl UMR_U_MIN_1_1_0_S5_S3 4 0 10000 DEPOSIT ABSOLUTE /end AXIS_DESCR
 /begin AXIS_DESCR STD_AXIS NO_INPUT_QUANTITY UMR___1_1_0_S5_S3 6 -400 1640 DEPOSIT ABSOLUTE FORMAT "%3.2" /end AXIS_DESCR
/end CHARACTERISTIC
/begin CHARACTERISTIC KF_MUEKPL_IAE_HYSKOMP "Übertragungswert der Kupplung" MAP 0x1A3E98 ZF_kf_fl32_S5_S3 1000 UMR_NM_BAR_1_1_0_S5_S3 0 1000
 /begin AXIS_DESCR STD_AXIS NO_INPUT_QUANTITY UMR_BAR__1_1000_0_S5_S3 6 0 65.535 DEPOSIT ABSOLUTE /end AXIS_DESCR
 /begin AXIS_DESCR STD_AXIS NO_INPUT_QUANTITY UMR_U_MIN_1_1_0_S5_S3 6 -32768 32767 DEPOSIT ABSOLUTE /end AXIS_DESCR
 FORMAT "%4.3" /end CHARACTERISTIC
/begin CHARACTERISTIC KF_MUEKPL_K0_HYSKOMP "Übertragungswert der Kupplung" MAP 0x1A3F60 ZF_kf_fl32_S5_S3 1000 UMR_NM_BAR_1_1_0_S5_S3 0 1000
 /begin AXIS_DESCR STD_AXIS NO_INPUT_QUANTITY UMR_BAR__1_1000_0_S5_S3 6 0 65.535 DEPOSIT ABSOLUTE /end AXIS_DESCR
 /begin AXIS_DESCR STD_AXIS NO_INPUT_QUANTITY UMR_U_MIN_1_1_0_S5_S3 6 -8000 8000 DEPOSIT ABSOLUTE /end AXIS_DESCR
 FORMAT "%4.3" /end CHARACTERISTIC
/begin CHARACTERISTIC KF_PFCGNMOT_K0 "Fülldruck" MAP 0x1A7490 ZF_kf_si16_S5_S3 12.75 UMR_BAR__1_1000_0_S5_S3 0 12.75
 /begin AXIS_DESCR STD_AXIS zff_atsys._.iSignale._.obj.sig_c_getr UMR_GRADC__1_1_M40_S5_S3 10 -40 150 DEPOSIT ABSOLUTE /end AXIS_DESCR
 /begin AXIS_DESCR STD_AXIS zff_atsys._.iSignale._.obj.sig_n_mot UMR_U_MIN_1_1_0_S5_S3 4 0 8160 DEPOSIT ABSOLUTE /end AXIS_DESCR
/end CHARACTERISTIC
/begin CHARACTERISTIC KF_POSFCGNAB_A "Kennfeld Schnellfülldruckoffset" MAP 0x1A4EFC ZF_kf_si16_S5_S3 5 UMR_BAR__1_1000_0_S5_S3 -5 0
 /begin AXIS_DESCR STD_AXIS zff_atsys._.iSignale._.obj.sig_c_getr UMR_GRADC__1_1_M40_S5_S3 2 -40 150 DEPOSIT ABSOLUTE /end AXIS_DESCR
 /begin AXIS_DESCR STD_AXIS zff_atsys._.iSignale._.obj.sig_n_ab8 UMR_U_MIN_32_1_0_S5_S3 2 0 8160 DEPOSIT ABSOLUTE /end AXIS_DESCR
/end CHARACTERISTIC
/begin CHARACTERISTIC KF_POSFCGNAB_B "Kennfeld Schnellfülldruckoffset" MAP 0x1A55D8 ZF_kf_si16_S5_S3 5 UMR_BAR__1_1000_0_S5_S3 -5 0
 /begin AXIS_DESCR STD_AXIS zff_atsys._.iSignale._.obj.sig_c_getr UMR_GRADC__1_1_M40_S5_S3 2 -40 150 DEPOSIT ABSOLUTE /end AXIS_DESCR
 /begin AXIS_DESCR STD_AXIS zff_atsys._.iSignale._.obj.sig_n_ab8 UMR_U_MIN_32_1_0_S5_S3 2 0 8160 DEPOSIT ABSOLUTE /end AXIS_DESCR
/end CHARACTERISTIC
/begin CHARACTERISTIC KF_POSFCGNAB_C "Kennfeld Schnellfülldruckoffset" MAP 0x1A5CB4 ZF_kf_si16_S5_S3 5 UMR_BAR__1_1000_0_S5_S3 -5 0
 /begin AXIS_DESCR STD_AXIS zff_atsys._.iSignale._.obj.sig_c_getr UMR_GRADC__1_1_M40_S5_S3 2 -40 150 DEPOSIT ABSOLUTE /end AXIS_DESCR
 /begin AXIS_DESCR STD_AXIS zff_atsys._.iSignale._.obj.sig_n_ab8 UMR_U_MIN_32_1_0_S5_S3 2 0 8160 DEPOSIT ABSOLUTE /end AXIS_DESCR
/end CHARACTERISTIC
/begin CHARACTERISTIC KF_POSFCGNAB_D "Kennfeld Schnellfülldruckoffset" MAP 0x1A6390 ZF_kf_si16_S5_S3 5 UMR_BAR__1_1000_0_S5_S3 -5 0
 /begin AXIS_DESCR STD_AXIS zff_atsys._.iSignale._.obj.sig_c_getr UMR_GRADC__1_1_M40_S5_S3 2 -40 150 DEPOSIT ABSOLUTE /end AXIS_DESCR
 /begin AXIS_DESCR STD_AXIS zff_atsys._.iSignale._.obj.sig_n_ab8 UMR_U_MIN_32_1_0_S5_S3 2 0 8160 DEPOSIT ABSOLUTE /end AXIS_DESCR
/end CHARACTERISTIC
/begin CHARACTERISTIC KF_POSFCGNAB_E "Kennfeld Schnellfülldruckoffset" MAP 0x1A6A6C ZF_kf_si16_S5_S3 5 UMR_BAR__1_1000_0_S5_S3 -5 0
 /begin AXIS_DESCR STD_AXIS zff_atsys._.iSignale._.obj.sig_c_getr UMR_GRADC__1_1_M40_S5_S3 2 -40 150 DEPOSIT ABSOLUTE /end AXIS_DESCR
 /begin AXIS_DESCR STD_AXIS zff_atsys._.iSignale._.obj.sig_n_ab8 UMR_U_MIN_32_1_0_S5_S3 2 0 8160 DEPOSIT ABSOLUTE /end AXIS_DESCR
/end CHARACTERISTIC
/begin CHARACTERISTIC KF_POSFCGNAB_K0 "Kennfeld Schnellfülldruckoffset" MAP 0x1A7148 ZF_kf_si16_S5_S3 5 UMR_BAR__1_1000_0_S5_S3 -5 0
 /begin AXIS_DESCR STD_AXIS zff_atsys._.iSignale._.obj.sig_c_getr UMR_GRADC__1_1_M40_S5_S3 2 -40 150 DEPOSIT ABSOLUTE /end AXIS_DESCR
 /begin AXIS_DESCR STD_AXIS zff_atsys._.iSignale._.obj.sig_n_ab8 UMR_U_MIN_32_1_0_S5_S3 2 0 8160 DEPOSIT ABSOLUTE /end AXIS_DESCR
/end CHARACTERISTIC
/begin CHARACTERISTIC KF_PSFCGMTESTART_E "Kennfeld Schnellfülldruck Kup. E ESTART" MAP 0x1A4D20 ZF_kf_si16_S5_S3 12.75 UMR_BAR__1_1000_0_S5_S3 0 12.75
 /begin AXIS_DESCR STD_AXIS zff_atsys._.iSignale._.obj.sig_c_getr UMR_GRADC__1_1_M40_S5_S3 8 -40 150 DEPOSIT ABSOLUTE /end AXIS_DESCR
 /begin AXIS_DESCR STD_AXIS zff_atsys._.iSignale._.obj.sig_m_t8 UMR_NM__6_1_M34_S5_S3 4 -204 1326 DEPOSIT ABSOLUTE /end AXIS_DESCR
/end CHARACTERISTIC
/begin CHARACTERISTIC KF_PSFCGMTFUELLOPT_A "Kennfeld Schnellfülldruck" MAP 0x1A4E9C ZF_kf_si16_S5_S3 12.75 UMR_BAR__1_1000_0_S5_S3 0 12.75
 /begin AXIS_DESCR STD_AXIS zff_atsys._.iSignale._.obj.sig_c_getr UMR_GRADC__1_1_M40_S5_S3 8 -40 150 DEPOSIT ABSOLUTE /end AXIS_DESCR
 /begin AXIS_DESCR STD_AXIS zff_atsys._.iSignale._.obj.sig_m_t8 UMR_NM__6_1_M34_S5_S3 4 -204 1326 DEPOSIT ABSOLUTE /end AXIS_DESCR
/end CHARACTERISTIC
/begin CHARACTERISTIC KF_PSFCGMTFUELLOPT_B "Kennfeld Schnellfülldruck" MAP 0x1A5578 ZF_kf_si16_S5_S3 12.75 UMR_BAR__1_1000_0_S5_S3 0 12.75
 /begin AXIS_DESCR STD_AXIS zff_atsys._.iSignale._.obj.sig_c_getr UMR_GRADC__1_1_M40_S5_S3 8 -40 150 DEPOSIT ABSOLUTE /end AXIS_DESCR
 /begin AXIS_DESCR STD_AXIS zff_atsys._.iSignale._.obj.sig_m_t8 UMR_NM__6_1_M34_S5_S3 4 -204 1326 DEPOSIT ABSOLUTE /end AXIS_DESCR
/end CHARACTERISTIC
/begin CHARACTERISTIC KF_PSFCGMTFUELLOPT_C "Kennfeld Schnellfülldruck" MAP 0x1A5C54 ZF_kf_si16_S5_S3 12.75 UMR_BAR__1_1000_0_S5_S3 0 12.75
 /begin AXIS_DESCR STD_AXIS zff_atsys._.iSignale._.obj.sig_c_getr UMR_GRADC__1_1_M40_S5_S3 8 -40 150 DEPOSIT ABSOLUTE /end AXIS_DESCR
 /begin AXIS_DESCR STD_AXIS zff_atsys._.iSignale._.obj.sig_m_t8 UMR_NM__6_1_M34_S5_S3 4 -204 1326 DEPOSIT ABSOLUTE /end AXIS_DESCR
/end CHARACTERISTIC
/begin CHARACTERISTIC KF_PSFCGMTFUELLOPT_D "Kennfeld Schnellfülldruck" MAP 0x1A6330 ZF_kf_si16_S5_S3 12.75 UMR_BAR__1_1000_0_S5_S3 0 12.75
 /begin AXIS_DESCR STD_AXIS zff_atsys._.iSignale._.obj.sig_c_getr UMR_GRADC__1_1_M40_S5_S3 8 -40 150 DEPOSIT ABSOLUTE /end AXIS_DESCR
 /begin AXIS_DESCR STD_AXIS zff_atsys._.iSignale._.obj.sig_m_t8 UMR_NM__6_1_M34_S5_S3 4 -204 1326 DEPOSIT ABSOLUTE /end AXIS_DESCR
/end CHARACTERISTIC
/begin CHARACTERISTIC KF_PSFCGMTFUELLOPT_E "Kennfeld Schnellfülldruck" MAP 0x1A6A0C ZF_kf_si16_S5_S3 12.75 UMR_BAR__1_1000_0_S5_S3 0 12.75
 /begin AXIS_DESCR STD_AXIS zff_atsys._.iSignale._.obj.sig_c_getr UMR_GRADC__1_1_M40_S5_S3 8 -40 150 DEPOSIT ABSOLUTE /end AXIS_DESCR
 /begin AXIS_DESCR STD_AXIS zff_atsys._.iSignale._.obj.sig_m_t8 UMR_NM__6_1_M34_S5_S3 4 -204 1326 DEPOSIT ABSOLUTE /end AXIS_DESCR
/end CHARACTERISTIC
/begin CHARACTERISTIC KF_PSFCGMTFUELLOPT_K0 "Kennfeld Schnellfülldruck" MAP 0x1A70E8 ZF_kf_si16_S5_S3 12.75 UMR_BAR__1_1000_0_S5_S3 0 12.75
 /begin AXIS_DESCR STD_AXIS zff_atsys._.iSignale._.obj.sig_c_getr UMR_GRADC__1_1_M40_S5_S3 8 -40 150 DEPOSIT ABSOLUTE /end AXIS_DESCR
 /begin AXIS_DESCR STD_AXIS zff_atsys._.iSignale._.obj.sig_m_t8 UMR_NM__6_1_M34_S5_S3 4 -204 1326 DEPOSIT ABSOLUTE /end AXIS_DESCR
/end CHARACTERISTIC
/begin CHARACTERISTIC KF_PSFCGMTFUELLRED_A "Kennfeld Schnellfülldruck" MAP 0x1A4E3C ZF_kf_si16_S5_S3 12.75 UMR_BAR__1_1000_0_S5_S3 0 12.75
 /begin AXIS_DESCR STD_AXIS zff_atsys._.iSignale._.obj.sig_c_getr UMR_GRADC__1_1_M40_S5_S3 8 -40 150 DEPOSIT ABSOLUTE /end AXIS_DESCR
 /begin AXIS_DESCR STD_AXIS zff_atsys._.iSignale._.obj.sig_m_t8 UMR_NM__6_1_M34_S5_S3 4 -204 1326 DEPOSIT ABSOLUTE /end AXIS_DESCR
/end CHARACTERISTIC
/begin CHARACTERISTIC KF_PSFCGMTFUELLRED_B "Kennfeld Schnellfülldruck" MAP 0x1A5518 ZF_kf_si16_S5_S3 12.75 UMR_BAR__1_1000_0_S5_S3 0 12.75
 /begin AXIS_DESCR STD_AXIS zff_atsys._.iSignale._.obj.sig_c_getr UMR_GRADC__1_1_M40_S5_S3 8 -40 150 DEPOSIT ABSOLUTE /end AXIS_DESCR
 /begin AXIS_DESCR STD_AXIS zff_atsys._.iSignale._.obj.sig_m_t8 UMR_NM__6_1_M34_S5_S3 4 -204 1326 DEPOSIT ABSOLUTE /end AXIS_DESCR
/end CHARACTERISTIC
/begin CHARACTERISTIC KF_PSFCGMTFUELLRED_C "Kennfeld Schnellfülldruck" MAP 0x1A5BF4 ZF_kf_si16_S5_S3 12.75 UMR_BAR__1_1000_0_S5_S3 0 12.75
 /begin AXIS_DESCR STD_AXIS zff_atsys._.iSignale._.obj.sig_c_getr UMR_GRADC__1_1_M40_S5_S3 8 -40 150 DEPOSIT ABSOLUTE /end AXIS_DESCR
 /begin AXIS_DESCR STD_AXIS zff_atsys._.iSignale._.obj.sig_m_t8 UMR_NM__6_1_M34_S5_S3 4 -204 1326 DEPOSIT ABSOLUTE /end AXIS_DESCR
/end CHARACTERISTIC
/begin CHARACTERISTIC KF_PSFCGMTFUELLRED_D "Kennfeld Schnellfülldruck" MAP 0x1A62D0 ZF_kf_si16_S5_S3 12.75 UMR_BAR__1_1000_0_S5_S3 0 12.75
 /begin AXIS_DESCR STD_AXIS zff_atsys._.iSignale._.obj.sig_c_getr UMR_GRADC__1_1_M40_S5_S3 8 -40 150 DEPOSIT ABSOLUTE /end AXIS_DESCR
 /begin AXIS_DESCR STD_AXIS zff_atsys._.iSignale._.obj.sig_m_t8 UMR_NM__6_1_M34_S5_S3 4 -204 1326 DEPOSIT ABSOLUTE /end AXIS_DESCR
/end CHARACTERISTIC
/begin CHARACTERISTIC KF_PSFCGMTFUELLRED_E "Kennfeld Schnellfülldruck" MAP 0x1A69AC ZF_kf_si16_S5_S3 12.75 UMR_BAR__1_1000_0_S5_S3 0 12.75
 /begin AXIS_DESCR STD_AXIS zff_atsys._.iSignale._.obj.sig_c_getr UMR_GRADC__1_1_M40_S5_S3 8 -40 150 DEPOSIT ABSOLUTE /end AXIS_DESCR
 /begin AXIS_DESCR STD_AXIS zff_atsys._.iSignale._.obj.sig_m_t8 UMR_NM__6_1_M34_S5_S3 4 -204 1326 DEPOSIT ABSOLUTE /end AXIS_DESCR
/end CHARACTERISTIC
/begin CHARACTERISTIC KF_PSFCGMTFUELLRED_K0 "Kennfeld Schnellfülldruck" MAP 0x1A7088 ZF_kf_si16_S5_S3 12.75 UMR_BAR__1_1000_0_S5_S3 0 12.75
 /begin AXIS_DESCR STD_AXIS zff_atsys._.iSignale._.obj.sig_c_getr UMR_GRADC__1_1_M40_S5_S3 8 -40 150 DEPOSIT ABSOLUTE /end AXIS_DESCR
 /begin AXIS_DESCR STD_AXIS zff_atsys._.iSignale._.obj.sig_m_t8 UMR_NM__6_1_M34_S5_S3 4 -204 1326 DEPOSIT ABSOLUTE /end AXIS_DESCR
/end CHARACTERISTIC
/begin CHARACTERISTIC KF_PSFCGMT_A "Kennfeld Schnellfülldruck" MAP 0x1A4DDC ZF_kf_si16_S5_S3 12.75 UMR_BAR__1_1000_0_S5_S3 0 12.75
 /begin AXIS_DESCR STD_AXIS zff_atsys._.iSignale._.obj.sig_c_getr UMR_GRADC__1_1_M40_S5_S3 8 -40 150 DEPOSIT ABSOLUTE /end AXIS_DESCR
 /begin AXIS_DESCR STD_AXIS zff_atsys._.iSignale._.obj.sig_m_t8 UMR_NM__6_1_M34_S5_S3 4 -204 1326 DEPOSIT ABSOLUTE /end AXIS_DESCR
/end CHARACTERISTIC
/begin CHARACTERISTIC KF_PSFCGMT_B "Kennfeld Schnellfülldruck" MAP 0x1A54B8 ZF_kf_si16_S5_S3 12.75 UMR_BAR__1_1000_0_S5_S3 0 12.75
 /begin AXIS_DESCR STD_AXIS zff_atsys._.iSignale._.obj.sig_c_getr UMR_GRADC__1_1_M40_S5_S3 8 -40 150 DEPOSIT ABSOLUTE /end AXIS_DESCR
 /begin AXIS_DESCR STD_AXIS zff_atsys._.iSignale._.obj.sig_m_t8 UMR_NM__6_1_M34_S5_S3 4 -204 1326 DEPOSIT ABSOLUTE /end AXIS_DESCR
/end CHARACTERISTIC
/begin CHARACTERISTIC KF_PSFCGMT_C "Kennfeld Schnellfülldruck" MAP 0x1A5B94 ZF_kf_si16_S5_S3 12.75 UMR_BAR__1_1000_0_S5_S3 0 12.75
 /begin AXIS_DESCR STD_AXIS zff_atsys._.iSignale._.obj.sig_c_getr UMR_GRADC__1_1_M40_S5_S3 8 -40 150 DEPOSIT ABSOLUTE /end AXIS_DESCR
 /begin AXIS_DESCR STD_AXIS zff_atsys._.iSignale._.obj.sig_m_t8 UMR_NM__6_1_M34_S5_S3 4 -204 1326 DEPOSIT ABSOLUTE /end AXIS_DESCR
/end CHARACTERISTIC
/begin CHARACTERISTIC KF_PSFCGMT_D "Kennfeld Schnellfülldruck" MAP 0x1A6270 ZF_kf_si16_S5_S3 12.75 UMR_BAR__1_1000_0_S5_S3 0 12.75
 /begin AXIS_DESCR STD_AXIS zff_atsys._.iSignale._.obj.sig_c_getr UMR_GRADC__1_1_M40_S5_S3 8 -40 150 DEPOSIT ABSOLUTE /end AXIS_DESCR
 /begin AXIS_DESCR STD_AXIS zff_atsys._.iSignale._.obj.sig_m_t8 UMR_NM__6_1_M34_S5_S3 4 -204 1326 DEPOSIT ABSOLUTE /end AXIS_DESCR
/end CHARACTERISTIC
/begin CHARACTERISTIC KF_PSFCGMT_E "Kennfeld Schnellfülldruck" MAP 0x1A694C ZF_kf_si16_S5_S3 12.75 UMR_BAR__1_1000_0_S5_S3 0 12.75
 /begin AXIS_DESCR STD_AXIS zff_atsys._.iSignale._.obj.sig_c_getr UMR_GRADC__1_1_M40_S5_S3 8 -40 150 DEPOSIT ABSOLUTE /end AXIS_DESCR
 /begin AXIS_DESCR STD_AXIS zff_atsys._.iSignale._.obj.sig_m_t8 UMR_NM__6_1_M34_S5_S3 4 -204 1326 DEPOSIT ABSOLUTE /end AXIS_DESCR
/end CHARACTERISTIC
/begin CHARACTERISTIC KF_PSFCGMT_K0 "Kennfeld Schnellfülldruck" MAP 0x1A7028 ZF_kf_si16_S5_S3 12.75 UMR_BAR__1_1000_0_S5_S3 0 12.75
 /begin AXIS_DESCR STD_AXIS zff_atsys._.iSignale._.obj.sig_c_getr UMR_GRADC__1_1_M40_S5_S3 8 -40 150 DEPOSIT ABSOLUTE /end AXIS_DESCR
 /begin AXIS_DESCR STD_AXIS zff_atsys._.iSignale._.obj.sig_m_t8 UMR_NM__6_1_M34_S5_S3 4 -204 1326 DEPOSIT ABSOLUTE /end AXIS_DESCR
/end CHARACTERISTIC
/begin CHARACTERISTIC KF_RAMPEOEFFNEN_ENTKOPPL "Momentenrampe zum Kupplungsöffnen in der Entkopplungsfunktion" MAP 0x1A3788 ZF_kf_si16_S5_S3 2000 UMR_NM__1_1_0_S5_S3 -1000 1000
 /begin AXIS_DESCR STD_AXIS NO_INPUT_QUANTITY UMR_MSEC__10_1_0_S5_S3 6 0 5000 DEPOSIT ABSOLUTE /end AXIS_DESCR
 /begin AXIS_DESCR STD_AXIS NO_INPUT_QUANTITY UMR___1_1_0_S5_S3 6 -1 8 DEPOSIT ABSOLUTE /end AXIS_DESCR
/end CHARACTERISTIC
/begin CHARACTERISTIC KF_TENTLEER_A "Entleerzeit der Kupplung" MAP 0x1A52E4 ZF_kf_ui16_S5_S3 20000 UMR_MSEC__10_1_0_S5_S3 0 20000
 /begin AXIS_DESCR STD_AXIS zff_atsys._.iSignale._.obj.sig_c_getr UMR_GRADC__1_1_M40_S5_S3 10 -40 150 DEPOSIT ABSOLUTE /end AXIS_DESCR
 /begin AXIS_DESCR STD_AXIS NO_INPUT_QUANTITY UMR_U_MIN_1_1_0_S5_S3 8 0 11000 DEPOSIT ABSOLUTE /end AXIS_DESCR
/end CHARACTERISTIC
/begin CHARACTERISTIC KF_TENTLEER_B "Entleerzeit der Kupplung" MAP 0x1A59C0 ZF_kf_ui16_S5_S3 20000 UMR_MSEC__10_1_0_S5_S3 0 20000
 /begin AXIS_DESCR STD_AXIS zff_atsys._.iSignale._.obj.sig_c_getr UMR_GRADC__1_1_M40_S5_S3 10 -40 150 DEPOSIT ABSOLUTE /end AXIS_DESCR
 /begin AXIS_DESCR STD_AXIS NO_INPUT_QUANTITY UMR_U_MIN_1_1_0_S5_S3 8 0 11000 DEPOSIT ABSOLUTE /end AXIS_DESCR
/end CHARACTERISTIC
/begin CHARACTERISTIC KF_TENTLEER_C "Entleerzeit der Kupplung" MAP 0x1A609C ZF_kf_ui16_S5_S3 20000 UMR_MSEC__10_1_0_S5_S3 0 20000
 /begin AXIS_DESCR STD_AXIS zff_atsys._.iSignale._.obj.sig_c_getr UMR_GRADC__1_1_M40_S5_S3 10 -40 150 DEPOSIT ABSOLUTE /end AXIS_DESCR
 /begin AXIS_DESCR STD_AXIS NO_INPUT_QUANTITY UMR_U_MIN_1_1_0_S5_S3 8 0 11000 DEPOSIT ABSOLUTE /end AXIS_DESCR
/end CHARACTERISTIC
/begin CHARACTERISTIC KF_TENTLEER_D "Entleerzeit der Kupplung" MAP 0x1A6778 ZF_kf_ui16_S5_S3 20000 UMR_MSEC__10_1_0_S5_S3 0 20000
 /begin AXIS_DESCR STD_AXIS zff_atsys._.iSignale._.obj.sig_c_getr UMR_GRADC__1_1_M40_S5_S3 10 -40 150 DEPOSIT ABSOLUTE /end AXIS_DESCR
 /begin AXIS_DESCR STD_AXIS NO_INPUT_QUANTITY UMR_U_MIN_1_1_0_S5_S3 8 0 11000 DEPOSIT ABSOLUTE /end AXIS_DESCR
/end CHARACTERISTIC
/begin CHARACTERISTIC KF_TENTLEER_E "Entleerzeit der Kupplung" MAP 0x1A6E54 ZF_kf_ui16_S5_S3 20000 UMR_MSEC__10_1_0_S5_S3 0 20000
 /begin AXIS_DESCR STD_AXIS zff_atsys._.iSignale._.obj.sig_c_getr UMR_GRADC__1_1_M40_S5_S3 10 -40 150 DEPOSIT ABSOLUTE /end AXIS_DESCR
 /begin AXIS_DESCR STD_AXIS NO_INPUT_QUANTITY UMR_U_MIN_1_1_0_S5_S3 8 0 11000 DEPOSIT ABSOLUTE /end AXIS_DESCR
/end CHARACTERISTIC
/begin CHARACTERISTIC KF_TENTLEER_K0 "Entleerzeit der Kupplung" MAP 0x1A7300 ZF_kf_ui16_S5_S3 20000 UMR_MSEC__10_1_0_S5_S3 0 20000
 /begin AXIS_DESCR STD_AXIS zff_atsys._.iSignale._.obj.sig_c_getr UMR_GRADC__1_1_M40_S5_S3 10 -40 150 DEPOSIT ABSOLUTE /end AXIS_DESCR
 /begin AXIS_DESCR STD_AXIS NO_INPUT_QUANTITY UMR_U_MIN_1_1_0_S5_S3 8 0 11000 DEPOSIT ABSOLUTE /end AXIS_DESCR
/end CHARACTERISTIC
/begin CHARACTERISTIC KF_TO1SFCG_A "Schnellfüllzeitoffset erste Befüllung" MAP 0x1A5234 ZF_kf_si16_S5_S3 2550 UMR_MSEC__1_1_0_S5_S3 -1280 1270
 /begin AXIS_DESCR STD_AXIS zff_atsys._.iSignale._.obj.sig_c_getr UMR_GRADC__1_1_M40_S5_S3 10 -40 150 DEPOSIT ABSOLUTE /end AXIS_DESCR
 /begin AXIS_DESCR STD_AXIS iItfInput.c_getrabst UMR_GRADC__1_1_M40_S5_S3 6 -40 150 DEPOSIT ABSOLUTE /end AXIS_DESCR
/end CHARACTERISTIC
/begin CHARACTERISTIC KF_TO1SFCG_B "Schnellfüllzeitoffset erste Befüllung" MAP 0x1A5910 ZF_kf_si16_S5_S3 2550 UMR_MSEC__1_1_0_S5_S3 -1280 1270
 /begin AXIS_DESCR STD_AXIS zff_atsys._.iSignale._.obj.sig_c_getr UMR_GRADC__1_1_M40_S5_S3 10 -40 150 DEPOSIT ABSOLUTE /end AXIS_DESCR
 /begin AXIS_DESCR STD_AXIS iItfInput.c_getrabst UMR_GRADC__1_1_M40_S5_S3 6 -40 150 DEPOSIT ABSOLUTE /end AXIS_DESCR
/end CHARACTERISTIC
/begin CHARACTERISTIC KF_TO1SFCG_C "Schnellfüllzeitoffset erste Befüllung" MAP 0x1A5FEC ZF_kf_si16_S5_S3 2550 UMR_MSEC__1_1_0_S5_S3 -1280 1270
 /begin AXIS_DESCR STD_AXIS zff_atsys._.iSignale._.obj.sig_c_getr UMR_GRADC__1_1_M40_S5_S3 10 -40 150 DEPOSIT ABSOLUTE /end AXIS_DESCR
 /begin AXIS_DESCR STD_AXIS iItfInput.c_getrabst UMR_GRADC__1_1_M40_S5_S3 6 -40 150 DEPOSIT ABSOLUTE /end AXIS_DESCR
/end CHARACTERISTIC
/begin CHARACTERISTIC KF_TO1SFCG_D "Schnellfüllzeitoffset erste Befüllung" MAP 0x1A66C8 ZF_kf_si16_S5_S3 2550 UMR_MSEC__1_1_0_S5_S3 -1280 1270
 /begin AXIS_DESCR STD_AXIS zff_atsys._.iSignale._.obj.sig_c_getr UMR_GRADC__1_1_M40_S5_S3 10 -40 150 DEPOSIT ABSOLUTE /end AXIS_DESCR
 /begin AXIS_DESCR STD_AXIS iItfInput.c_getrabst UMR_GRADC__1_1_M40_S5_S3 6 -40 150 DEPOSIT ABSOLUTE /end AXIS_DESCR
/end CHARACTERISTIC
/begin CHARACTERISTIC KF_TO1SFCG_E "Schnellfüllzeitoffset erste Befüllung" MAP 0x1A6DA4 ZF_kf_si16_S5_S3 2550 UMR_MSEC__1_1_0_S5_S3 -1280 1270
 /begin AXIS_DESCR STD_AXIS zff_atsys._.iSignale._.obj.sig_c_getr UMR_GRADC__1_1_M40_S5_S3 10 -40 150 DEPOSIT ABSOLUTE /end AXIS_DESCR
 /begin AXIS_DESCR STD_AXIS iItfInput.c_getrabst UMR_GRADC__1_1_M40_S5_S3 6 -40 150 DEPOSIT ABSOLUTE /end AXIS_DESCR
/end CHARACTERISTIC
/begin CHARACTERISTIC KF_TO1SFCG_K0 "Schnellfüllzeitoffset erste Befüllung" MAP 0x1A7250 ZF_kf_si16_S5_S3 2550 UMR_MSEC__1_1_0_S5_S3 -1280 1270
 /begin AXIS_DESCR STD_AXIS zff_atsys._.iSignale._.obj.sig_c_getr UMR_GRADC__1_1_M40_S5_S3 10 -40 150 DEPOSIT ABSOLUTE /end AXIS_DESCR
 /begin AXIS_DESCR STD_AXIS iItfInput.c_getrabst UMR_GRADC__1_1_M40_S5_S3 6 -40 150 DEPOSIT ABSOLUTE /end AXIS_DESCR
/end CHARACTERISTIC
/begin CHARACTERISTIC KF_TOENTLEERCGADA_A "Entleerzeit der Kupplung" MAP 0x1A53B0 ZF_kf_si16_S5_S3 21000 UMR_MSEC__10_1_0_S5_S3 -1000 20000
 /begin AXIS_DESCR STD_AXIS zff_atsys._.iSignale._.obj.sig_c_getr UMR_GRADC__1_1_M40_S5_S3 8 -40 150 DEPOSIT ABSOLUTE /end AXIS_DESCR
 /begin AXIS_DESCR STD_AXIS NO_INPUT_QUANTITY UMR_MSEC__1_1_0_S5_S3 6 -32768 32767 DEPOSIT ABSOLUTE /end AXIS_DESCR
/end CHARACTERISTIC
/begin CHARACTERISTIC KF_TOENTLEERCGADA_B "Entleerzeit der Kupplung" MAP 0x1A5A8C ZF_kf_si16_S5_S3 21000 UMR_MSEC__10_1_0_S5_S3 -1000 20000
 /begin AXIS_DESCR STD_AXIS zff_atsys._.iSignale._.obj.sig_c_getr UMR_GRADC__1_1_M40_S5_S3 8 -40 150 DEPOSIT ABSOLUTE /end AXIS_DESCR
 /begin AXIS_DESCR STD_AXIS NO_INPUT_QUANTITY UMR_MSEC__1_1_0_S5_S3 6 -32768 32767 DEPOSIT ABSOLUTE /end AXIS_DESCR
/end CHARACTERISTIC
/begin CHARACTERISTIC KF_TOENTLEERCGADA_C "Entleerzeit der Kupplung" MAP 0x1A6168 ZF_kf_si16_S5_S3 21000 UMR_MSEC__10_1_0_S5_S3 -1000 20000
 /begin AXIS_DESCR STD_AXIS zff_atsys._.iSignale._.obj.sig_c_getr UMR_GRADC__1_1_M40_S5_S3 8 -40 150 DEPOSIT ABSOLUTE /end AXIS_DESCR
 /begin AXIS_DESCR STD_AXIS NO_INPUT_QUANTITY UMR_MSEC__1_1_0_S5_S3 6 -32768 32767 DEPOSIT ABSOLUTE /end AXIS_DESCR
/end CHARACTERISTIC
/begin CHARACTERISTIC KF_TOENTLEERCGADA_D "Entleerzeit der Kupplung" MAP 0x1A6844 ZF_kf_si16_S5_S3 21000 UMR_MSEC__10_1_0_S5_S3 -1000 20000
 /begin AXIS_DESCR STD_AXIS zff_atsys._.iSignale._.obj.sig_c_getr UMR_GRADC__1_1_M40_S5_S3 8 -40 150 DEPOSIT ABSOLUTE /end AXIS_DESCR
 /begin AXIS_DESCR STD_AXIS NO_INPUT_QUANTITY UMR_MSEC__1_1_0_S5_S3 6 -32768 32767 DEPOSIT ABSOLUTE /end AXIS_DESCR
/end CHARACTERISTIC
/begin CHARACTERISTIC KF_TOENTLEERCGADA_E "Entleerzeit der Kupplung" MAP 0x1A6F20 ZF_kf_si16_S5_S3 21000 UMR_MSEC__10_1_0_S5_S3 -1000 20000
 /begin AXIS_DESCR STD_AXIS zff_atsys._.iSignale._.obj.sig_c_getr UMR_GRADC__1_1_M40_S5_S3 8 -40 150 DEPOSIT ABSOLUTE /end AXIS_DESCR
 /begin AXIS_DESCR STD_AXIS NO_INPUT_QUANTITY UMR_MSEC__1_1_0_S5_S3 6 -32768 32767 DEPOSIT ABSOLUTE /end AXIS_DESCR
/end CHARACTERISTIC
/begin CHARACTERISTIC KF_TOENTLEERCGADA_K0 "Entleerzeit der Kupplung" MAP 0x1A73CC ZF_kf_si16_S5_S3 21000 UMR_MSEC__10_1_0_S5_S3 -1000 20000
 /begin AXIS_DESCR STD_AXIS zff_atsys._.iSignale._.obj.sig_c_getr UMR_GRADC__1_1_M40_S5_S3 8 -40 150 DEPOSIT ABSOLUTE /end AXIS_DESCR
 /begin AXIS_DESCR STD_AXIS NO_INPUT_QUANTITY UMR_MSEC__1_1_0_S5_S3 6 -32768 32767 DEPOSIT ABSOLUTE /end AXIS_DESCR
/end CHARACTERISTIC
/begin CHARACTERISTIC KF_TOSFGE_A "Schnellfüllzeitoffset GE" MAP 0x1A5004 ZF_kf_si16_S5_S3 2000 UMR_MSEC__1_1_0_S5_S3 -1000 1000
 /begin AXIS_DESCR STD_AXIS zff_atsys._.iSignale._.obj.sig_n_t UMR_U_MIN_1_1_0_S5_S3 4 0 8160 DEPOSIT ABSOLUTE /end AXIS_DESCR
 /begin AXIS_DESCR STD_AXIS zff_atsys._.iSignale._.obj.sig_m_t UMR_NM__1_1_0_S5_S3 4 -200 1300 DEPOSIT ABSOLUTE /end AXIS_DESCR
/end CHARACTERISTIC
/begin CHARACTERISTIC KF_TOSFGE_B "Schnellfüllzeitoffset GE" MAP 0x1A56E0 ZF_kf_si16_S5_S3 2000 UMR_MSEC__1_1_0_S5_S3 -1000 1000
 /begin AXIS_DESCR STD_AXIS zff_atsys._.iSignale._.obj.sig_n_t UMR_U_MIN_1_1_0_S5_S3 4 0 8160 DEPOSIT ABSOLUTE /end AXIS_DESCR
 /begin AXIS_DESCR STD_AXIS zff_atsys._.iSignale._.obj.sig_m_t UMR_NM__1_1_0_S5_S3 4 -200 1300 DEPOSIT ABSOLUTE /end AXIS_DESCR
/end CHARACTERISTIC
/begin CHARACTERISTIC KF_TOSFGE_C "Schnellfüllzeitoffset GE" MAP 0x1A5DBC ZF_kf_si16_S5_S3 2000 UMR_MSEC__1_1_0_S5_S3 -1000 1000
 /begin AXIS_DESCR STD_AXIS zff_atsys._.iSignale._.obj.sig_n_t UMR_U_MIN_1_1_0_S5_S3 4 0 8160 DEPOSIT ABSOLUTE /end AXIS_DESCR
 /begin AXIS_DESCR STD_AXIS zff_atsys._.iSignale._.obj.sig_m_t UMR_NM__1_1_0_S5_S3 4 -200 1300 DEPOSIT ABSOLUTE /end AXIS_DESCR
/end CHARACTERISTIC
/begin CHARACTERISTIC KF_TOSFGE_D "Schnellfüllzeitoffset GE" MAP 0x1A6498 ZF_kf_si16_S5_S3 2000 UMR_MSEC__1_1_0_S5_S3 -1000 1000
 /begin AXIS_DESCR STD_AXIS zff_atsys._.iSignale._.obj.sig_n_t UMR_U_MIN_1_1_0_S5_S3 4 0 8160 DEPOSIT ABSOLUTE /end AXIS_DESCR
 /begin AXIS_DESCR STD_AXIS zff_atsys._.iSignale._.obj.sig_m_t UMR_NM__1_1_0_S5_S3 4 -200 1300 DEPOSIT ABSOLUTE /end AXIS_DESCR
/end CHARACTERISTIC
/begin CHARACTERISTIC KF_TOSFGE_E "Schnellfüllzeitoffset GE" MAP 0x1A6B74 ZF_kf_si16_S5_S3 2000 UMR_MSEC__1_1_0_S5_S3 -1000 1000
 /begin AXIS_DESCR STD_AXIS zff_atsys._.iSignale._.obj.sig_n_t UMR_U_MIN_1_1_0_S5_S3 4 0 8160 DEPOSIT ABSOLUTE /end AXIS_DESCR
 /begin AXIS_DESCR STD_AXIS zff_atsys._.iSignale._.obj.sig_m_t UMR_NM__1_1_0_S5_S3 4 -200 1300 DEPOSIT ABSOLUTE /end AXIS_DESCR
/end CHARACTERISTIC
/begin CHARACTERISTIC KF_TOSFHSFUELLOPT_A "Schnellfüllzeitoffset HS mit opt. Befüllung" MAP 0x1A511C ZF_kf_si16_S5_S3 2000 UMR_MSEC__1_1_0_S5_S3 -1000 1000
 /begin AXIS_DESCR STD_AXIS zff_atsys._.iSignale._.obj.sig_n_t UMR_U_MIN_1_1_0_S5_S3 4 0 8160 DEPOSIT ABSOLUTE /end AXIS_DESCR
 /begin AXIS_DESCR STD_AXIS zff_atsys._.iSignale._.obj.sig_m_t UMR_NM__1_1_0_S5_S3 4 -200 1300 DEPOSIT ABSOLUTE /end AXIS_DESCR
/end CHARACTERISTIC
/begin CHARACTERISTIC KF_TOSFHSFUELLOPT_B "Schnellfüllzeitoffset HS mit opt. Befüllung" MAP 0x1A57F8 ZF_kf_si16_S5_S3 2000 UMR_MSEC__1_1_0_S5_S3 -1000 1000
 /begin AXIS_DESCR STD_AXIS zff_atsys._.iSignale._.obj.sig_n_t UMR_U_MIN_1_1_0_S5_S3 4 0 8160 DEPOSIT ABSOLUTE /end AXIS_DESCR
 /begin AXIS_DESCR STD_AXIS zff_atsys._.iSignale._.obj.sig_m_t UMR_NM__1_1_0_S5_S3 4 -200 1300 DEPOSIT ABSOLUTE /end AXIS_DESCR
/end CHARACTERISTIC
/begin CHARACTERISTIC KF_TOSFHSFUELLOPT_C "Schnellfüllzeitoffset HS mit opt. Befüllung" MAP 0x1A5ED4 ZF_kf_si16_S5_S3 2000 UMR_MSEC__1_1_0_S5_S3 -1000 1000
 /begin AXIS_DESCR STD_AXIS zff_atsys._.iSignale._.obj.sig_n_t UMR_U_MIN_1_1_0_S5_S3 4 0 8160 DEPOSIT ABSOLUTE /end AXIS_DESCR
 /begin AXIS_DESCR STD_AXIS zff_atsys._.iSignale._.obj.sig_m_t UMR_NM__1_1_0_S5_S3 4 -200 1300 DEPOSIT ABSOLUTE /end AXIS_DESCR
/end CHARACTERISTIC
/begin CHARACTERISTIC KF_TOSFHSFUELLOPT_D "Schnellfüllzeitoffset HS mit opt. Befüllung" MAP 0x1A65B0 ZF_kf_si16_S5_S3 2000 UMR_MSEC__1_1_0_S5_S3 -1000 1000
 /begin AXIS_DESCR STD_AXIS zff_atsys._.iSignale._.obj.sig_n_t UMR_U_MIN_1_1_0_S5_S3 4 0 8160 DEPOSIT ABSOLUTE /end AXIS_DESCR
 /begin AXIS_DESCR STD_AXIS zff_atsys._.iSignale._.obj.sig_m_t UMR_NM__1_1_0_S5_S3 4 -200 1300 DEPOSIT ABSOLUTE /end AXIS_DESCR
/end CHARACTERISTIC
/begin CHARACTERISTIC KF_TOSFHSFUELLOPT_E "Schnellfüllzeitoffset HS mit opt. Befüllung" MAP 0x1A6C8C ZF_kf_si16_S5_S3 2000 UMR_MSEC__1_1_0_S5_S3 -1000 1000
 /begin AXIS_DESCR STD_AXIS zff_atsys._.iSignale._.obj.sig_n_t UMR_U_MIN_1_1_0_S5_S3 4 0 8160 DEPOSIT ABSOLUTE /end AXIS_DESCR
 /begin AXIS_DESCR STD_AXIS zff_atsys._.iSignale._.obj.sig_m_t UMR_NM__1_1_0_S5_S3 4 -200 1300 DEPOSIT ABSOLUTE /end AXIS_DESCR
/end CHARACTERISTIC
/begin CHARACTERISTIC KF_TOSFHSSPORT_A "Schnellfüllzeitoffset sportliche HS" MAP 0x1A50E4 ZF_kf_si16_S5_S3 2000 UMR_MSEC__1_1_0_S5_S3 -1000 1000
 /begin AXIS_DESCR STD_AXIS zff_atsys._.iSignale._.obj.sig_n_t UMR_U_MIN_1_1_0_S5_S3 4 0 8160 DEPOSIT ABSOLUTE /end AXIS_DESCR
 /begin AXIS_DESCR STD_AXIS zff_atsys._.iSignale._.obj.sig_m_t UMR_NM__1_1_0_S5_S3 4 -200 1300 DEPOSIT ABSOLUTE /end AXIS_DESCR
/end CHARACTERISTIC
/begin CHARACTERISTIC KF_TOSFHSSPORT_B "Schnellfüllzeitoffset sportliche HS" MAP 0x1A57C0 ZF_kf_si16_S5_S3 2000 UMR_MSEC__1_1_0_S5_S3 -1000 1000
 /begin AXIS_DESCR STD_AXIS zff_atsys._.iSignale._.obj.sig_n_t UMR_U_MIN_1_1_0_S5_S3 4 0 8160 DEPOSIT ABSOLUTE /end AXIS_DESCR
 /begin AXIS_DESCR STD_AXIS zff_atsys._.iSignale._.obj.sig_m_t UMR_NM__1_1_0_S5_S3 4 -200 1300 DEPOSIT ABSOLUTE /end AXIS_DESCR
/end CHARACTERISTIC
/begin CHARACTERISTIC KF_TOSFHSSPORT_C "Schnellfüllzeitoffset sportliche HS" MAP 0x1A5E9C ZF_kf_si16_S5_S3 2000 UMR_MSEC__1_1_0_S5_S3 -1000 1000
 /begin AXIS_DESCR STD_AXIS zff_atsys._.iSignale._.obj.sig_n_t UMR_U_MIN_1_1_0_S5_S3 4 0 8160 DEPOSIT ABSOLUTE /end AXIS_DESCR
 /begin AXIS_DESCR STD_AXIS zff_atsys._.iSignale._.obj.sig_m_t UMR_NM__1_1_0_S5_S3 4 -200 1300 DEPOSIT ABSOLUTE /end AXIS_DESCR
/end CHARACTERISTIC
/begin CHARACTERISTIC KF_TOSFHSSPORT_D "Schnellfüllzeitoffset sportliche HS" MAP 0x1A6578 ZF_kf_si16_S5_S3 2000 UMR_MSEC__1_1_0_S5_S3 -1000 1000
 /begin AXIS_DESCR STD_AXIS zff_atsys._.iSignale._.obj.sig_n_t UMR_U_MIN_1_1_0_S5_S3 4 0 8160 DEPOSIT ABSOLUTE /end AXIS_DESCR
 /begin AXIS_DESCR STD_AXIS zff_atsys._.iSignale._.obj.sig_m_t UMR_NM__1_1_0_S5_S3 4 -200 1300 DEPOSIT ABSOLUTE /end AXIS_DESCR
/end CHARACTERISTIC
/begin CHARACTERISTIC KF_TOSFHSSPORT_E "Schnellfüllzeitoffset sportliche HS" MAP 0x1A6C54 ZF_kf_si16_S5_S3 2000 UMR_MSEC__1_1_0_S5_S3 -1000 1000
 /begin AXIS_DESCR STD_AXIS zff_atsys._.iSignale._.obj.sig_n_t UMR_U_MIN_1_1_0_S5_S3 4 0 8160 DEPOSIT ABSOLUTE /end AXIS_DESCR
 /begin AXIS_DESCR STD_AXIS zff_atsys._.iSignale._.obj.sig_m_t UMR_NM__1_1_0_S5_S3 4 -200 1300 DEPOSIT ABSOLUTE /end AXIS_DESCR
/end CHARACTERISTIC
/begin CHARACTERISTIC KF_TOSFHSSP_A "Schnellfüllzeitoffset spontane HS" MAP 0x1A50AC ZF_kf_si16_S5_S3 2000 UMR_MSEC__1_1_0_S5_S3 -1000 1000
 /begin AXIS_DESCR STD_AXIS zff_atsys._.iSignale._.obj.sig_n_t UMR_U_MIN_1_1_0_S5_S3 4 0 8160 DEPOSIT ABSOLUTE /end AXIS_DESCR
 /begin AXIS_DESCR STD_AXIS zff_atsys._.iSignale._.obj.sig_m_t UMR_NM__1_1_0_S5_S3 4 -200 1300 DEPOSIT ABSOLUTE /end AXIS_DESCR
/end CHARACTERISTIC
/begin CHARACTERISTIC KF_TOSFHSSP_B "Schnellfüllzeitoffset spontane HS" MAP 0x1A5788 ZF_kf_si16_S5_S3 2000 UMR_MSEC__1_1_0_S5_S3 -1000 1000
 /begin AXIS_DESCR STD_AXIS zff_atsys._.iSignale._.obj.sig_n_t UMR_U_MIN_1_1_0_S5_S3 4 0 8160 DEPOSIT ABSOLUTE /end AXIS_DESCR
 /begin AXIS_DESCR STD_AXIS zff_atsys._.iSignale._.obj.sig_m_t UMR_NM__1_1_0_S5_S3 4 -200 1300 DEPOSIT ABSOLUTE /end AXIS_DESCR
/end CHARACTERISTIC
/begin CHARACTERISTIC KF_TOSFHSSP_C "Schnellfüllzeitoffset spontane HS" MAP 0x1A5E64 ZF_kf_si16_S5_S3 2000 UMR_MSEC__1_1_0_S5_S3 -1000 1000
 /begin AXIS_DESCR STD_AXIS zff_atsys._.iSignale._.obj.sig_n_t UMR_U_MIN_1_1_0_S5_S3 4 0 8160 DEPOSIT ABSOLUTE /end AXIS_DESCR
 /begin AXIS_DESCR STD_AXIS zff_atsys._.iSignale._.obj.sig_m_t UMR_NM__1_1_0_S5_S3 4 -200 1300 DEPOSIT ABSOLUTE /end AXIS_DESCR
/end CHARACTERISTIC
/begin CHARACTERISTIC KF_TOSFHSSP_D "Schnellfüllzeitoffset spontane HS" MAP 0x1A6540 ZF_kf_si16_S5_S3 2000 UMR_MSEC__1_1_0_S5_S3 -1000 1000
 /begin AXIS_DESCR STD_AXIS zff_atsys._.iSignale._.obj.sig_n_t UMR_U_MIN_1_1_0_S5_S3 4 0 8160 DEPOSIT ABSOLUTE /end AXIS_DESCR
 /begin AXIS_DESCR STD_AXIS zff_atsys._.iSignale._.obj.sig_m_t UMR_NM__1_1_0_S5_S3 4 -200 1300 DEPOSIT ABSOLUTE /end AXIS_DESCR
/end CHARACTERISTIC
/begin CHARACTERISTIC KF_TOSFHSSP_E "Schnellfüllzeitoffset spontane HS" MAP 0x1A6C1C ZF_kf_si16_S5_S3 2000 UMR_MSEC__1_1_0_S5_S3 -1000 1000
 /begin AXIS_DESCR STD_AXIS zff_atsys._.iSignale._.obj.sig_n_t UMR_U_MIN_1_1_0_S5_S3 4 0 8160 DEPOSIT ABSOLUTE /end AXIS_DESCR
 /begin AXIS_DESCR STD_AXIS zff_atsys._.iSignale._.obj.sig_m_t UMR_NM__1_1_0_S5_S3 4 -200 1300 DEPOSIT ABSOLUTE /end AXIS_DESCR
/end CHARACTERISTIC
/begin CHARACTERISTIC KF_TOSFHS_A "Schnellfüllzeitoffset HS" MAP 0x1A503C ZF_kf_si16_S5_S3 2000 UMR_MSEC__1_1_0_S5_S3 -1000 1000
 /begin AXIS_DESCR STD_AXIS zff_atsys._.iSignale._.obj.sig_n_t UMR_U_MIN_1_1_0_S5_S3 4 0 8160 DEPOSIT ABSOLUTE /end AXIS_DESCR
 /begin AXIS_DESCR STD_AXIS zff_atsys._.iSignale._.obj.sig_m_t UMR_NM__1_1_0_S5_S3 4 -200 1300 DEPOSIT ABSOLUTE /end AXIS_DESCR
/end CHARACTERISTIC
/begin CHARACTERISTIC KF_TOSFHS_A_EL "Schnellfüllzeitoffset HS" MAP 0x1A5074 ZF_kf_si16_S5_S3 2000 UMR_MSEC__1_1_0_S5_S3 -1000 1000
 /begin AXIS_DESCR STD_AXIS zff_atsys._.iSignale._.obj.sig_n_t UMR_U_MIN_1_1_0_S5_S3 4 0 8160 DEPOSIT ABSOLUTE /end AXIS_DESCR
 /begin AXIS_DESCR STD_AXIS zff_atsys._.iSignale._.obj.sig_m_t UMR_NM__1_1_0_S5_S3 4 -200 1300 DEPOSIT ABSOLUTE /end AXIS_DESCR
/end CHARACTERISTIC
/begin CHARACTERISTIC KF_TOSFHS_B "Schnellfüllzeitoffset HS" MAP 0x1A5718 ZF_kf_si16_S5_S3 2000 UMR_MSEC__1_1_0_S5_S3 -1000 1000
 /begin AXIS_DESCR STD_AXIS zff_atsys._.iSignale._.obj.sig_n_t UMR_U_MIN_1_1_0_S5_S3 4 0 8160 DEPOSIT ABSOLUTE /end AXIS_DESCR
 /begin AXIS_DESCR STD_AXIS zff_atsys._.iSignale._.obj.sig_m_t UMR_NM__1_1_0_S5_S3 4 -200 1300 DEPOSIT ABSOLUTE /end AXIS_DESCR
/end CHARACTERISTIC
/begin CHARACTERISTIC KF_TOSFHS_B_EL "Schnellfüllzeitoffset HS" MAP 0x1A5750 ZF_kf_si16_S5_S3 2000 UMR_MSEC__1_1_0_S5_S3 -1000 1000
 /begin AXIS_DESCR STD_AXIS zff_atsys._.iSignale._.obj.sig_n_t UMR_U_MIN_1_1_0_S5_S3 4 0 8160 DEPOSIT ABSOLUTE /end AXIS_DESCR
 /begin AXIS_DESCR STD_AXIS zff_atsys._.iSignale._.obj.sig_m_t UMR_NM__1_1_0_S5_S3 4 -200 1300 DEPOSIT ABSOLUTE /end AXIS_DESCR
/end CHARACTERISTIC
/begin CHARACTERISTIC KF_TOSFHS_C "Schnellfüllzeitoffset HS" MAP 0x1A5DF4 ZF_kf_si16_S5_S3 2000 UMR_MSEC__1_1_0_S5_S3 -1000 1000
 /begin AXIS_DESCR STD_AXIS zff_atsys._.iSignale._.obj.sig_n_t UMR_U_MIN_1_1_0_S5_S3 4 0 8160 DEPOSIT ABSOLUTE /end AXIS_DESCR
 /begin AXIS_DESCR STD_AXIS zff_atsys._.iSignale._.obj.sig_m_t UMR_NM__1_1_0_S5_S3 4 -200 1300 DEPOSIT ABSOLUTE /end AXIS_DESCR
/end CHARACTERISTIC
/begin CHARACTERISTIC KF_TOSFHS_C_EL "Schnellfüllzeitoffset HS" MAP 0x1A5E2C ZF_kf_si16_S5_S3 2000 UMR_MSEC__1_1_0_S5_S3 -1000 1000
 /begin AXIS_DESCR STD_AXIS zff_atsys._.iSignale._.obj.sig_n_t UMR_U_MIN_1_1_0_S5_S3 4 0 8160 DEPOSIT ABSOLUTE /end AXIS_DESCR
 /begin AXIS_DESCR STD_AXIS zff_atsys._.iSignale._.obj.sig_m_t UMR_NM__1_1_0_S5_S3 4 -200 1300 DEPOSIT ABSOLUTE /end AXIS_DESCR
/end CHARACTERISTIC
/begin CHARACTERISTIC KF_TOSFHS_D "Schnellfüllzeitoffset HS" MAP 0x1A64D0 ZF_kf_si16_S5_S3 2000 UMR_MSEC__1_1_0_S5_S3 -1000 1000
 /begin AXIS_DESCR STD_AXIS zff_atsys._.iSignale._.obj.sig_n_t UMR_U_MIN_1_1_0_S5_S3 4 0 8160 DEPOSIT ABSOLUTE /end AXIS_DESCR
 /begin AXIS_DESCR STD_AXIS zff_atsys._.iSignale._.obj.sig_m_t UMR_NM__1_1_0_S5_S3 4 -200 1300 DEPOSIT ABSOLUTE /end AXIS_DESCR
/end CHARACTERISTIC
/begin CHARACTERISTIC KF_TOSFHS_D_EL "Schnellfüllzeitoffset HS" MAP 0x1A6508 ZF_kf_si16_S5_S3 2000 UMR_MSEC__1_1_0_S5_S3 -1000 1000
 /begin AXIS_DESCR STD_AXIS zff_atsys._.iSignale._.obj.sig_n_t UMR_U_MIN_1_1_0_S5_S3 4 0 8160 DEPOSIT ABSOLUTE /end AXIS_DESCR
 /begin AXIS_DESCR STD_AXIS zff_atsys._.iSignale._.obj.sig_m_t UMR_NM__1_1_0_S5_S3 4 -200 1300 DEPOSIT ABSOLUTE /end AXIS_DESCR
/end CHARACTERISTIC
/begin CHARACTERISTIC KF_TOSFHS_E "Schnellfüllzeitoffset HS" MAP 0x1A6BAC ZF_kf_si16_S5_S3 2000 UMR_MSEC__1_1_0_S5_S3 -1000 1000
 /begin AXIS_DESCR STD_AXIS zff_atsys._.iSignale._.obj.sig_n_t UMR_U_MIN_1_1_0_S5_S3 4 0 8160 DEPOSIT ABSOLUTE /end AXIS_DESCR
 /begin AXIS_DESCR STD_AXIS zff_atsys._.iSignale._.obj.sig_m_t UMR_NM__1_1_0_S5_S3 4 -200 1300 DEPOSIT ABSOLUTE /end AXIS_DESCR
/end CHARACTERISTIC
/begin CHARACTERISTIC KF_TOSFHS_E_EL "Schnellfüllzeitoffset HS" MAP 0x1A6BE4 ZF_kf_si16_S5_S3 2000 UMR_MSEC__1_1_0_S5_S3 -1000 1000
 /begin AXIS_DESCR STD_AXIS zff_atsys._.iSignale._.obj.sig_n_t UMR_U_MIN_1_1_0_S5_S3 4 0 8160 DEPOSIT ABSOLUTE /end AXIS_DESCR
 /begin AXIS_DESCR STD_AXIS zff_atsys._.iSignale._.obj.sig_m_t UMR_NM__1_1_0_S5_S3 4 -200 1300 DEPOSIT ABSOLUTE /end AXIS_DESCR
/end CHARACTERISTIC
/begin CHARACTERISTIC KF_TOSFRSSPORT_A "Schnellfüllzeitoffset sportliche RS" MAP 0x1A51FC ZF_kf_si16_S5_S3 2000 UMR_MSEC__1_1_0_S5_S3 -1000 1000
 /begin AXIS_DESCR STD_AXIS zff_atsys._.iSignale._.obj.sig_n_t UMR_U_MIN_1_1_0_S5_S3 4 0 8160 DEPOSIT ABSOLUTE /end AXIS_DESCR
 /begin AXIS_DESCR STD_AXIS zff_atsys._.iSignale._.obj.sig_m_t UMR_NM__1_1_0_S5_S3 4 -200 1300 DEPOSIT ABSOLUTE /end AXIS_DESCR
/end CHARACTERISTIC
/begin CHARACTERISTIC KF_TOSFRSSPORT_B "Schnellfüllzeitoffset sportliche RS" MAP 0x1A58D8 ZF_kf_si16_S5_S3 2000 UMR_MSEC__1_1_0_S5_S3 -1000 1000
 /begin AXIS_DESCR STD_AXIS zff_atsys._.iSignale._.obj.sig_n_t UMR_U_MIN_1_1_0_S5_S3 4 0 8160 DEPOSIT ABSOLUTE /end AXIS_DESCR
 /begin AXIS_DESCR STD_AXIS zff_atsys._.iSignale._.obj.sig_m_t UMR_NM__1_1_0_S5_S3 4 -200 1300 DEPOSIT ABSOLUTE /end AXIS_DESCR
/end CHARACTERISTIC
/begin CHARACTERISTIC KF_TOSFRSSPORT_C "Schnellfüllzeitoffset sportliche RS" MAP 0x1A5FB4 ZF_kf_si16_S5_S3 2000 UMR_MSEC__1_1_0_S5_S3 -1000 1000
 /begin AXIS_DESCR STD_AXIS zff_atsys._.iSignale._.obj.sig_n_t UMR_U_MIN_1_1_0_S5_S3 4 0 8160 DEPOSIT ABSOLUTE /end AXIS_DESCR
 /begin AXIS_DESCR STD_AXIS zff_atsys._.iSignale._.obj.sig_m_t UMR_NM__1_1_0_S5_S3 4 -200 1300 DEPOSIT ABSOLUTE /end AXIS_DESCR
/end CHARACTERISTIC
/begin CHARACTERISTIC KF_TOSFRSSPORT_D "Schnellfüllzeitoffset sportliche RS" MAP 0x1A6690 ZF_kf_si16_S5_S3 2000 UMR_MSEC__1_1_0_S5_S3 -1000 1000
 /begin AXIS_DESCR STD_AXIS zff_atsys._.iSignale._.obj.sig_n_t UMR_U_MIN_1_1_0_S5_S3 4 0 8160 DEPOSIT ABSOLUTE /end AXIS_DESCR
 /begin AXIS_DESCR STD_AXIS zff_atsys._.iSignale._.obj.sig_m_t UMR_NM__1_1_0_S5_S3 4 -200 1300 DEPOSIT ABSOLUTE /end AXIS_DESCR
/end CHARACTERISTIC
/begin CHARACTERISTIC KF_TOSFRSSPORT_E "Schnellfüllzeitoffset sportliche RS" MAP 0x1A6D6C ZF_kf_si16_S5_S3 2000 UMR_MSEC__1_1_0_S5_S3 -1000 1000
 /begin AXIS_DESCR STD_AXIS zff_atsys._.iSignale._.obj.sig_n_t UMR_U_MIN_1_1_0_S5_S3 4 0 8160 DEPOSIT ABSOLUTE /end AXIS_DESCR
 /begin AXIS_DESCR STD_AXIS zff_atsys._.iSignale._.obj.sig_m_t UMR_NM__1_1_0_S5_S3 4 -200 1300 DEPOSIT ABSOLUTE /end AXIS_DESCR
/end CHARACTERISTIC
/begin CHARACTERISTIC KF_TOSFRSSP_A "Schnellfüllzeitoffset spontane RS" MAP 0x1A51C4 ZF_kf_si16_S5_S3 2000 UMR_MSEC__1_1_0_S5_S3 -1000 1000
 /begin AXIS_DESCR STD_AXIS zff_atsys._.iSignale._.obj.sig_n_t UMR_U_MIN_1_1_0_S5_S3 4 0 8160 DEPOSIT ABSOLUTE /end AXIS_DESCR
 /begin AXIS_DESCR STD_AXIS zff_atsys._.iSignale._.obj.sig_m_t UMR_NM__1_1_0_S5_S3 4 -200 1300 DEPOSIT ABSOLUTE /end AXIS_DESCR
/end CHARACTERISTIC
/begin CHARACTERISTIC KF_TOSFRSSP_B "Schnellfüllzeitoffset spontane RS" MAP 0x1A58A0 ZF_kf_si16_S5_S3 2000 UMR_MSEC__1_1_0_S5_S3 -1000 1000
 /begin AXIS_DESCR STD_AXIS zff_atsys._.iSignale._.obj.sig_n_t UMR_U_MIN_1_1_0_S5_S3 4 0 8160 DEPOSIT ABSOLUTE /end AXIS_DESCR
 /begin AXIS_DESCR STD_AXIS zff_atsys._.iSignale._.obj.sig_m_t UMR_NM__1_1_0_S5_S3 4 -200 1300 DEPOSIT ABSOLUTE /end AXIS_DESCR
/end CHARACTERISTIC
/begin CHARACTERISTIC KF_TOSFRSSP_C "Schnellfüllzeitoffset spontane RS" MAP 0x1A5F7C ZF_kf_si16_S5_S3 2000 UMR_MSEC__1_1_0_S5_S3 -1000 1000
 /begin AXIS_DESCR STD_AXIS zff_atsys._.iSignale._.obj.sig_n_t UMR_U_MIN_1_1_0_S5_S3 4 0 8160 DEPOSIT ABSOLUTE /end AXIS_DESCR
 /begin AXIS_DESCR STD_AXIS zff_atsys._.iSignale._.obj.sig_m_t UMR_NM__1_1_0_S5_S3 4 -200 1300 DEPOSIT ABSOLUTE /end AXIS_DESCR
/end CHARACTERISTIC
/begin CHARACTERISTIC KF_TOSFRSSP_D "Schnellfüllzeitoffset spontane RS" MAP 0x1A6658 ZF_kf_si16_S5_S3 2000 UMR_MSEC__1_1_0_S5_S3 -1000 1000
 /begin AXIS_DESCR STD_AXIS zff_atsys._.iSignale._.obj.sig_n_t UMR_U_MIN_1_1_0_S5_S3 4 0 8160 DEPOSIT ABSOLUTE /end AXIS_DESCR
 /begin AXIS_DESCR STD_AXIS zff_atsys._.iSignale._.obj.sig_m_t UMR_NM__1_1_0_S5_S3 4 -200 1300 DEPOSIT ABSOLUTE /end AXIS_DESCR
/end CHARACTERISTIC
/begin CHARACTERISTIC KF_TOSFRSSP_E "Schnellfüllzeitoffset spontane RS" MAP 0x1A6D34 ZF_kf_si16_S5_S3 2000 UMR_MSEC__1_1_0_S5_S3 -1000 1000
 /begin AXIS_DESCR STD_AXIS zff_atsys._.iSignale._.obj.sig_n_t UMR_U_MIN_1_1_0_S5_S3 4 0 8160 DEPOSIT ABSOLUTE /end AXIS_DESCR
 /begin AXIS_DESCR STD_AXIS zff_atsys._.iSignale._.obj.sig_m_t UMR_NM__1_1_0_S5_S3 4 -200 1300 DEPOSIT ABSOLUTE /end AXIS_DESCR
/end CHARACTERISTIC
/begin CHARACTERISTIC KF_TOSFRS_A "Schnellfüllzeitoffset RS" MAP 0x1A5154 ZF_kf_si16_S5_S3 2000 UMR_MSEC__1_1_0_S5_S3 -1000 1000
 /begin AXIS_DESCR STD_AXIS zff_atsys._.iSignale._.obj.sig_n_t UMR_U_MIN_1_1_0_S5_S3 4 0 8160 DEPOSIT ABSOLUTE /end AXIS_DESCR
 /begin AXIS_DESCR STD_AXIS zff_atsys._.iSignale._.obj.sig_m_t UMR_NM__1_1_0_S5_S3 4 -200 1300 DEPOSIT ABSOLUTE /end AXIS_DESCR
/end CHARACTERISTIC
/begin CHARACTERISTIC KF_TOSFRS_A_EL "Schnellfüllzeitoffset RS" MAP 0x1A518C ZF_kf_si16_S5_S3 2000 UMR_MSEC__1_1_0_S5_S3 -1000 1000
 /begin AXIS_DESCR STD_AXIS zff_atsys._.iSignale._.obj.sig_n_t UMR_U_MIN_1_1_0_S5_S3 4 0 8160 DEPOSIT ABSOLUTE /end AXIS_DESCR
 /begin AXIS_DESCR STD_AXIS zff_atsys._.iSignale._.obj.sig_m_t UMR_NM__1_1_0_S5_S3 4 -200 1300 DEPOSIT ABSOLUTE /end AXIS_DESCR
/end CHARACTERISTIC
/begin CHARACTERISTIC KF_TOSFRS_B "Schnellfüllzeitoffset RS" MAP 0x1A5830 ZF_kf_si16_S5_S3 2000 UMR_MSEC__1_1_0_S5_S3 -1000 1000
 /begin AXIS_DESCR STD_AXIS zff_atsys._.iSignale._.obj.sig_n_t UMR_U_MIN_1_1_0_S5_S3 4 0 8160 DEPOSIT ABSOLUTE /end AXIS_DESCR
 /begin AXIS_DESCR STD_AXIS zff_atsys._.iSignale._.obj.sig_m_t UMR_NM__1_1_0_S5_S3 4 -200 1300 DEPOSIT ABSOLUTE /end AXIS_DESCR
/end CHARACTERISTIC
/begin CHARACTERISTIC KF_TOSFRS_B_EL "Schnellfüllzeitoffset RS" MAP 0x1A5868 ZF_kf_si16_S5_S3 2000 UMR_MSEC__1_1_0_S5_S3 -1000 1000
 /begin AXIS_DESCR STD_AXIS zff_atsys._.iSignale._.obj.sig_n_t UMR_U_MIN_1_1_0_S5_S3 4 0 8160 DEPOSIT ABSOLUTE /end AXIS_DESCR
 /begin AXIS_DESCR STD_AXIS zff_atsys._.iSignale._.obj.sig_m_t UMR_NM__1_1_0_S5_S3 4 -200 1300 DEPOSIT ABSOLUTE /end AXIS_DESCR
/end CHARACTERISTIC
/begin CHARACTERISTIC KF_TOSFRS_C "Schnellfüllzeitoffset RS" MAP 0x1A5F0C ZF_kf_si16_S5_S3 2000 UMR_MSEC__1_1_0_S5_S3 -1000 1000
 /begin AXIS_DESCR STD_AXIS zff_atsys._.iSignale._.obj.sig_n_t UMR_U_MIN_1_1_0_S5_S3 4 0 8160 DEPOSIT ABSOLUTE /end AXIS_DESCR
 /begin AXIS_DESCR STD_AXIS zff_atsys._.iSignale._.obj.sig_m_t UMR_NM__1_1_0_S5_S3 4 -200 1300 DEPOSIT ABSOLUTE /end AXIS_DESCR
/end CHARACTERISTIC
/begin CHARACTERISTIC KF_TOSFRS_C_EL "Schnellfüllzeitoffset RS" MAP 0x1A5F44 ZF_kf_si16_S5_S3 2000 UMR_MSEC__1_1_0_S5_S3 -1000 1000
 /begin AXIS_DESCR STD_AXIS zff_atsys._.iSignale._.obj.sig_n_t UMR_U_MIN_1_1_0_S5_S3 4 0 8160 DEPOSIT ABSOLUTE /end AXIS_DESCR
 /begin AXIS_DESCR STD_AXIS zff_atsys._.iSignale._.obj.sig_m_t UMR_NM__1_1_0_S5_S3 4 -200 1300 DEPOSIT ABSOLUTE /end AXIS_DESCR
/end CHARACTERISTIC
/begin CHARACTERISTIC KF_TOSFRS_D "Schnellfüllzeitoffset RS" MAP 0x1A65E8 ZF_kf_si16_S5_S3 2000 UMR_MSEC__1_1_0_S5_S3 -1000 1000
 /begin AXIS_DESCR STD_AXIS zff_atsys._.iSignale._.obj.sig_n_t UMR_U_MIN_1_1_0_S5_S3 4 0 8160 DEPOSIT ABSOLUTE /end AXIS_DESCR
 /begin AXIS_DESCR STD_AXIS zff_atsys._.iSignale._.obj.sig_m_t UMR_NM__1_1_0_S5_S3 4 -200 1300 DEPOSIT ABSOLUTE /end AXIS_DESCR
/end CHARACTERISTIC
/begin CHARACTERISTIC KF_TOSFRS_D_EL "Schnellfüllzeitoffset RS" MAP 0x1A6620 ZF_kf_si16_S5_S3 2000 UMR_MSEC__1_1_0_S5_S3 -1000 1000
 /begin AXIS_DESCR STD_AXIS zff_atsys._.iSignale._.obj.sig_n_t UMR_U_MIN_1_1_0_S5_S3 4 0 8160 DEPOSIT ABSOLUTE /end AXIS_DESCR
 /begin AXIS_DESCR STD_AXIS zff_atsys._.iSignale._.obj.sig_m_t UMR_NM__1_1_0_S5_S3 4 -200 1300 DEPOSIT ABSOLUTE /end AXIS_DESCR
/end CHARACTERISTIC
/begin CHARACTERISTIC KF_TOSFRS_E "Schnellfüllzeitoffset RS" MAP 0x1A6CC4 ZF_kf_si16_S5_S3 2000 UMR_MSEC__1_1_0_S5_S3 -1000 1000
 /begin AXIS_DESCR STD_AXIS zff_atsys._.iSignale._.obj.sig_n_t UMR_U_MIN_1_1_0_S5_S3 4 0 8160 DEPOSIT ABSOLUTE /end AXIS_DESCR
 /begin AXIS_DESCR STD_AXIS zff_atsys._.iSignale._.obj.sig_m_t UMR_NM__1_1_0_S5_S3 4 -200 1300 DEPOSIT ABSOLUTE /end AXIS_DESCR
/end CHARACTERISTIC
/begin CHARACTERISTIC KF_TOSFRS_E_EL "Schnellfüllzeitoffset RS" MAP 0x1A6CFC ZF_kf_si16_S5_S3 2000 UMR_MSEC__1_1_0_S5_S3 -1000 1000
 /begin AXIS_DESCR STD_AXIS zff_atsys._.iSignale._.obj.sig_n_t UMR_U_MIN_1_1_0_S5_S3 4 0 8160 DEPOSIT ABSOLUTE /end AXIS_DESCR
 /begin AXIS_DESCR STD_AXIS zff_atsys._.iSignale._.obj.sig_m_t UMR_NM__1_1_0_S5_S3 4 -200 1300 DEPOSIT ABSOLUTE /end AXIS_DESCR
/end CHARACTERISTIC
/begin CHARACTERISTIC KF_T_RAMPE_V_A_HYSKOMP "Anstiegszeit der Rampe" MAP 0x1A41B4 ZF_kf_ui16_S5_S3 100 UMR_SEC__1_100_0_S5_S3 0 100
 /begin AXIS_DESCR STD_AXIS NO_INPUT_QUANTITY UMR_BAR__1_1000_0_S5_S3 6 0 20 DEPOSIT ABSOLUTE /end AXIS_DESCR
 /begin AXIS_DESCR STD_AXIS zff_atsys._.iSignale._.obj.sig_c_getr UMR_GRADC__1_1_M40_S5_S3 5 -40 150 DEPOSIT ABSOLUTE /end AXIS_DESCR
/end CHARACTERISTIC
/begin CHARACTERISTIC KF_T_RAMPE_V_B_HYSKOMP "Anstiegszeit der Rampe" MAP 0x1A43B8 ZF_kf_ui16_S5_S3 100 UMR_SEC__1_100_0_S5_S3 0 100
 /begin AXIS_DESCR STD_AXIS NO_INPUT_QUANTITY UMR_BAR__1_1000_0_S5_S3 6 0 20 DEPOSIT ABSOLUTE /end AXIS_DESCR
 /begin AXIS_DESCR STD_AXIS zff_atsys._.iSignale._.obj.sig_c_getr UMR_GRADC__1_1_M40_S5_S3 5 -40 150 DEPOSIT ABSOLUTE /end AXIS_DESCR
/end CHARACTERISTIC
/begin CHARACTERISTIC KF_T_RAMPE_V_C_HYSKOMP "Anstiegszeit der Rampe" MAP 0x1A45BC ZF_kf_ui16_S5_S3 100 UMR_SEC__1_100_0_S5_S3 0 100
 /begin AXIS_DESCR STD_AXIS NO_INPUT_QUANTITY UMR_BAR__1_1000_0_S5_S3 6 0 20 DEPOSIT ABSOLUTE /end AXIS_DESCR
 /begin AXIS_DESCR STD_AXIS zff_atsys._.iSignale._.obj.sig_c_getr UMR_GRADC__1_1_M40_S5_S3 5 -40 150 DEPOSIT ABSOLUTE /end AXIS_DESCR
/end CHARACTERISTIC
/begin CHARACTERISTIC KF_T_RAMPE_V_D_HYSKOMP "Anstiegszeit der Rampe" MAP 0x1A47C0 ZF_kf_ui16_S5_S3 100 UMR_SEC__1_100_0_S5_S3 0 100
 /begin AXIS_DESCR STD_AXIS NO_INPUT_QUANTITY UMR_BAR__1_1000_0_S5_S3 6 0 20 DEPOSIT ABSOLUTE /end AXIS_DESCR
 /begin AXIS_DESCR STD_AXIS zff_atsys._.iSignale._.obj.sig_c_getr UMR_GRADC__1_1_M40_S5_S3 5 -40 150 DEPOSIT ABSOLUTE /end AXIS_DESCR
/end CHARACTERISTIC
/begin CHARACTERISTIC KF_T_RAMPE_V_E_HYSKOMP "Anstiegszeit der Rampe" MAP 0x1A49C4 ZF_kf_ui16_S5_S3 100 UMR_SEC__1_100_0_S5_S3 0 100
 /begin AXIS_DESCR STD_AXIS NO_INPUT_QUANTITY UMR_BAR__1_1000_0_S5_S3 6 0 20 DEPOSIT ABSOLUTE /end AXIS_DESCR
 /begin AXIS_DESCR STD_AXIS zff_atsys._.iSignale._.obj.sig_c_getr UMR_GRADC__1_1_M40_S5_S3 5 -40 150 DEPOSIT ABSOLUTE /end AXIS_DESCR
/end CHARACTERISTIC
/begin CHARACTERISTIC KF_T_RAMPE_V_K0_HYSKOMP "Anstiegszeit der Rampe" MAP 0x1A4BAC ZF_kf_ui16_S5_S3 100 UMR_SEC__1_100_0_S5_S3 0 100
 /begin AXIS_DESCR STD_AXIS NO_INPUT_QUANTITY UMR_BAR__1_1000_0_S5_S3 6 0 20 DEPOSIT ABSOLUTE /end AXIS_DESCR
 /begin AXIS_DESCR STD_AXIS zff_atsys._.iSignale._.obj.sig_c_getr UMR_GRADC__1_1_M40_S5_S3 5 -40 150 DEPOSIT ABSOLUTE /end AXIS_DESCR
/end CHARACTERISTIC
/begin CHARACTERISTIC KL_EDSKVA "EDS Kupplungsventil A" CURVE 0x1A3B28 ZF_kl_ui16_S5_S3 1000 UMR_MA__1_10_0_S5_S3 0 1000
 /begin AXIS_DESCR STD_AXIS NO_INPUT_QUANTITY UMR_MBAR__1_1_0_S5_S3 12 0 65535 DEPOSIT ABSOLUTE /end AXIS_DESCR
/end CHARACTERISTIC
/begin CHARACTERISTIC KL_EDSKVB "EDS Kupplungsventil B" CURVE 0x1A3B5C ZF_kl_ui16_S5_S3 1000 UMR_MA__1_10_0_S5_S3 0 1000
 /begin AXIS_DESCR STD_AXIS NO_INPUT_QUANTITY UMR_MBAR__1_1_0_S5_S3 12 0 65535 DEPOSIT ABSOLUTE /end AXIS_DESCR
/end CHARACTERISTIC
/begin CHARACTERISTIC KL_EDSKVC "EDS Kupplungsventil C" CURVE 0x1A3B90 ZF_kl_ui16_S5_S3 1000 UMR_MA__1_10_0_S5_S3 0 1000
 /begin AXIS_DESCR STD_AXIS NO_INPUT_QUANTITY UMR_MBAR__1_1_0_S5_S3 12 0 65535 DEPOSIT ABSOLUTE /end AXIS_DESCR
/end CHARACTERISTIC
/begin CHARACTERISTIC KL_EDSKVD "EDS Kupplungsventil D" CURVE 0x1A3BC4 ZF_kl_ui16_S5_S3 1000 UMR_MA__1_10_0_S5_S3 0 1000
 /begin AXIS_DESCR STD_AXIS NO_INPUT_QUANTITY UMR_MBAR__1_1_0_S5_S3 12 0 65535 DEPOSIT ABSOLUTE /end AXIS_DESCR
/end CHARACTERISTIC
/begin CHARACTERISTIC KL_EDSKVE "EDS Kupplungsventil E" CURVE 0x1A3BF8 ZF_kl_ui16_S5_S3 1000 UMR_MA__1_10_0_S5_S3 0 1000
 /begin AXIS_DESCR STD_AXIS NO_INPUT_QUANTITY UMR_MBAR__1_1_0_S5_S3 12 0 65535 DEPOSIT ABSOLUTE /end AXIS_DESCR
/end CHARACTERISTIC
/begin CHARACTERISTIC KL_EDSKVK0 "EDS Kupplungsventil K0" CURVE 0x1A3C60 ZF_kl_ui16_S5_S3 1000 UMR_MA__1_10_0_S5_S3 0 1000
 /begin AXIS_DESCR STD_AXIS NO_INPUT_QUANTITY UMR_MBAR__1_1_0_S5_S3 12 0 65535 DEPOSIT ABSOLUTE /end AXIS_DESCR
/end CHARACTERISTIC
/begin CHARACTERISTIC KL_EDSKVPOS "EDS Positionsventil / Kuehloelvolumenstrom" CURVE 0x1A3C94 ZF_kl_ui16_S5_S3 1000 UMR_MA__1_10_0_S5_S3 0 1000
 /begin AXIS_DESCR STD_AXIS NO_INPUT_QUANTITY UMR_MBAR__1_1_0_S5_S3 12 0 65535 DEPOSIT ABSOLUTE /end AXIS_DESCR
/end CHARACTERISTIC
/begin CHARACTERISTIC KL_EDSKVSYS "EDS Kupplungsventil SYS" CURVE 0x1A3C2C ZF_kl_ui16_S5_S3 1000 UMR_MA__1_10_0_S5_S3 0 1000
 /begin AXIS_DESCR STD_AXIS NO_INPUT_QUANTITY UMR_MBAR__1_1_0_S5_S3 12 0 65535 DEPOSIT ABSOLUTE /end AXIS_DESCR
/end CHARACTERISTIC
/begin CHARACTERISTIC KL_FMENDIAE "Faktor Motoreingriff IAE offen/geregelt fuer RS" CURVE 0x1A87AC ZF_kl_si16_S5_S3 100 UMR_PROZENT__20_51_0_S5_S3 0 100
 /begin AXIS_DESCR STD_AXIS iIaeSigna.nd_iae UMR_U_MIN_1_1_0_S5_S3 4 -8160 8160 DEPOSIT ABSOLUTE /end AXIS_DESCR
/end CHARACTERISTIC
/begin CHARACTERISTIC KL_F_GRAD_KPL_A_HYSKOMP "Faktor Hysteresebreite" CURVE 0x1A4068 ZF_kl_si16_S5_S3 3 UMR___1_100_0_S5_S3 0 3
 /begin AXIS_DESCR STD_AXIS NO_INPUT_QUANTITY UMR_BAR_SEC_1_1000_0_S5_S3 6 -32.768 32.767 DEPOSIT ABSOLUTE /end AXIS_DESCR
/end CHARACTERISTIC
/begin CHARACTERISTIC KL_F_GRAD_KPL_B_HYSKOMP "Faktor Hysteresebreite" CURVE 0x1A426C ZF_kl_si16_S5_S3 3 UMR___1_100_0_S5_S3 0 3
 /begin AXIS_DESCR STD_AXIS NO_INPUT_QUANTITY UMR_BAR_SEC_1_1000_0_S5_S3 6 -32.768 32.767 DEPOSIT ABSOLUTE /end AXIS_DESCR
/end CHARACTERISTIC
/begin CHARACTERISTIC KL_F_GRAD_KPL_C_HYSKOMP "Faktor Hysteresebreite" CURVE 0x1A4470 ZF_kl_si16_S5_S3 3 UMR___1_100_0_S5_S3 0 3
 /begin AXIS_DESCR STD_AXIS NO_INPUT_QUANTITY UMR_BAR_SEC_1_1000_0_S5_S3 6 -32.768 32.767 DEPOSIT ABSOLUTE /end AXIS_DESCR
/end CHARACTERISTIC
/begin CHARACTERISTIC KL_F_GRAD_KPL_D_HYSKOMP "Faktor Hysteresebreite" CURVE 0x1A4674 ZF_kl_si16_S5_S3 3 UMR___1_100_0_S5_S3 0 3
 /begin AXIS_DESCR STD_AXIS NO_INPUT_QUANTITY UMR_BAR_SEC_1_1000_0_S5_S3 6 -32.768 32.767 DEPOSIT ABSOLUTE /end AXIS_DESCR
/end CHARACTERISTIC
/begin CHARACTERISTIC KL_F_GRAD_KPL_E_HYSKOMP "Faktor Hysteresebreite" CURVE 0x1A4878 ZF_kl_si16_S5_S3 3 UMR___1_100_0_S5_S3 0 3
 /begin AXIS_DESCR STD_AXIS NO_INPUT_QUANTITY UMR_BAR_SEC_1_1000_0_S5_S3 6 -32.768 32.767 DEPOSIT ABSOLUTE /end AXIS_DESCR
/end CHARACTERISTIC
/begin CHARACTERISTIC KL_F_GRAD_KPL_K0_HYSKOMP "Faktor Hysteresebreite" CURVE 0x1A4A7C ZF_kl_si16_S5_S3 3 UMR___1_100_0_S5_S3 0 3
 /begin AXIS_DESCR STD_AXIS NO_INPUT_QUANTITY UMR_BAR_SEC_1_1000_0_S5_S3 6 -32.768 32.767 DEPOSIT ABSOLUTE /end AXIS_DESCR
/end CHARACTERISTIC
/begin CHARACTERISTIC KL_F_TRAJEK_KPL_A_HYSKOMP "Trajekorienform der Kupplungshysteresekompensationsfkt" CURVE 0x1A4028 ZF_kl_ui8_S5_S3 1 UMR___1_100_0_S5_S3 0 1
 /begin AXIS_DESCR STD_AXIS NO_INPUT_QUANTITY UMR___1_100_0_S5_S3 12 0 1 DEPOSIT ABSOLUTE /end AXIS_DESCR
/end CHARACTERISTIC
/begin CHARACTERISTIC KL_F_TRAJEK_KPL_B_HYSKOMP "Trajekorienform der Kupplungshysteresekompensationsfkt" CURVE 0x1A422C ZF_kl_ui8_S5_S3 1 UMR___1_100_0_S5_S3 0 1
 /begin AXIS_DESCR STD_AXIS NO_INPUT_QUANTITY UMR___1_100_0_S5_S3 12 0 1 DEPOSIT ABSOLUTE /end AXIS_DESCR
/end CHARACTERISTIC
/begin CHARACTERISTIC KL_F_TRAJEK_KPL_C_HYSKOMP "Trajekorienform der Kupplungshysteresekompensationsfkt" CURVE 0x1A4430 ZF_kl_ui8_S5_S3 1 UMR___1_100_0_S5_S3 0 1
 /begin AXIS_DESCR STD_AXIS NO_INPUT_QUANTITY UMR___1_100_0_S5_S3 12 0 1 DEPOSIT ABSOLUTE /end AXIS_DESCR
/end CHARACTERISTIC
/begin CHARACTERISTIC KL_F_TRAJEK_KPL_D_HYSKOMP "Trajekorienform der Kupplungshysteresekompensationsfkt" CURVE 0x1A4634 ZF_kl_ui8_S5_S3 1 UMR___1_100_0_S5_S3 0 1
 /begin AXIS_DESCR STD_AXIS NO_INPUT_QUANTITY UMR___1_100_0_S5_S3 12 0 1 DEPOSIT ABSOLUTE /end AXIS_DESCR
/end CHARACTERISTIC
/begin CHARACTERISTIC KL_F_TRAJEK_KPL_E_HYSKOMP "Trajekorienform der Kupplungshysteresekompensationsfkt" CURVE 0x1A4838 ZF_kl_ui8_S5_S3 1 UMR___1_100_0_S5_S3 0 1
 /begin AXIS_DESCR STD_AXIS NO_INPUT_QUANTITY UMR___1_100_0_S5_S3 12 0 1 DEPOSIT ABSOLUTE /end AXIS_DESCR
/end CHARACTERISTIC
/begin CHARACTERISTIC KL_F_TRAJEK_KPL_K0_HYSKOMP "Trajekorienform der Kupplungshysteresekompensationsfkt" CURVE 0x1A4A3C ZF_kl_ui8_S5_S3 1 UMR___1_100_0_S5_S3 0 1
 /begin AXIS_DESCR STD_AXIS NO_INPUT_QUANTITY UMR___1_100_0_S5_S3 12 0 1 DEPOSIT ABSOLUTE /end AXIS_DESCR
/end CHARACTERISTIC
/begin CHARACTERISTIC KL_F_TRAJEK_STG_A_HYSKOMP "Trajekorienform der Steuerungshysteresekompensationsfkt" CURVE 0x1A40BC ZF_kl_ui8_S5_S3 1 UMR___1_100_0_S5_S3 0 1
 /begin AXIS_DESCR STD_AXIS NO_INPUT_QUANTITY UMR___1_100_0_S5_S3 12 0 1 DEPOSIT ABSOLUTE /end AXIS_DESCR
/end CHARACTERISTIC
/begin CHARACTERISTIC KL_F_TRAJEK_STG_B_HYSKOMP "Trajekorienform der Steuerungshysteresekompensationsfkt" CURVE 0x1A42C0 ZF_kl_ui8_S5_S3 1 UMR___1_100_0_S5_S3 0 1
 /begin AXIS_DESCR STD_AXIS NO_INPUT_QUANTITY UMR___1_100_0_S5_S3 12 0 1 DEPOSIT ABSOLUTE /end AXIS_DESCR
/end CHARACTERISTIC
/begin CHARACTERISTIC KL_F_TRAJEK_STG_C_HYSKOMP "Trajekorienform der Steuerungshysteresekompensationsfkt" CURVE 0x1A44C4 ZF_kl_ui8_S5_S3 1 UMR___1_100_0_S5_S3 0 1
 /begin AXIS_DESCR STD_AXIS NO_INPUT_QUANTITY UMR___1_100_0_S5_S3 12 0 1 DEPOSIT ABSOLUTE /end AXIS_DESCR
/end CHARACTERISTIC
/begin CHARACTERISTIC KL_F_TRAJEK_STG_D_HYSKOMP "Trajekorienform der Steuerungshysteresekompensationsfkt" CURVE 0x1A46C8 ZF_kl_ui8_S5_S3 1 UMR___1_100_0_S5_S3 0 1
 /begin AXIS_DESCR STD_AXIS NO_INPUT_QUANTITY UMR___1_100_0_S5_S3 12 0 1 DEPOSIT ABSOLUTE /end AXIS_DESCR
/end CHARACTERISTIC
/begin CHARACTERISTIC KL_F_TRAJEK_STG_E_HYSKOMP "Trajekorienform der Steuerungshysteresekompensationsfkt" CURVE 0x1A48CC ZF_kl_ui8_S5_S3 1 UMR___1_100_0_S5_S3 0 1
 /begin AXIS_DESCR STD_AXIS NO_INPUT_QUANTITY UMR___1_100_0_S5_S3 12 0 1 DEPOSIT ABSOLUTE /end AXIS_DESCR
/end CHARACTERISTIC
/begin CHARACTERISTIC KL_F_TRAJEK_STG_K0_HYSKOMP "Trajekorienform der Steuerungshysteresekompensationsfkt" CURVE 0x1A4AB4 ZF_kl_ui8_S5_S3 1 UMR___1_100_0_S5_S3 0 1
 /begin AXIS_DESCR STD_AXIS NO_INPUT_QUANTITY UMR___1_100_0_S5_S3 12 0 1 DEPOSIT ABSOLUTE /end AXIS_DESCR
/end CHARACTERISTIC
/begin CHARACTERISTIC KL_HYSB_KPL_A_HYSKOMP "Hysteresebreite Kupplung" CURVE 0x1A4044 ZF_kl_ui16_S5_S3 150 UMR_NM__1_1_0_S5_S3 0 150
 /begin AXIS_DESCR STD_AXIS NO_INPUT_QUANTITY UMR_BAR__1_1000_0_S5_S3 8 0 65.535 DEPOSIT ABSOLUTE /end AXIS_DESCR
/end CHARACTERISTIC
/begin CHARACTERISTIC KL_HYSB_KPL_B_HYSKOMP "Hysteresebreite Kupplung" CURVE 0x1A4248 ZF_kl_ui16_S5_S3 150 UMR_NM__1_1_0_S5_S3 0 150
 /begin AXIS_DESCR STD_AXIS NO_INPUT_QUANTITY UMR_BAR__1_1000_0_S5_S3 8 0 65.535 DEPOSIT ABSOLUTE /end AXIS_DESCR
/end CHARACTERISTIC
/begin CHARACTERISTIC KL_HYSB_KPL_C_HYSKOMP "Hysteresebreite Kupplung" CURVE 0x1A444C ZF_kl_ui16_S5_S3 150 UMR_NM__1_1_0_S5_S3 0 150
 /begin AXIS_DESCR STD_AXIS NO_INPUT_QUANTITY UMR_BAR__1_1000_0_S5_S3 8 0 65.535 DEPOSIT ABSOLUTE /end AXIS_DESCR
/end CHARACTERISTIC
/begin CHARACTERISTIC KL_HYSB_KPL_D_HYSKOMP "Hysteresebreite Kupplung" CURVE 0x1A4650 ZF_kl_ui16_S5_S3 150 UMR_NM__1_1_0_S5_S3 0 150
 /begin AXIS_DESCR STD_AXIS NO_INPUT_QUANTITY UMR_BAR__1_1000_0_S5_S3 8 0 65.535 DEPOSIT ABSOLUTE /end AXIS_DESCR
/end CHARACTERISTIC
/begin CHARACTERISTIC KL_HYSB_KPL_E_HYSKOMP "Hysteresebreite Kupplung" CURVE 0x1A4854 ZF_kl_ui16_S5_S3 150 UMR_NM__1_1_0_S5_S3 0 150
 /begin AXIS_DESCR STD_AXIS NO_INPUT_QUANTITY UMR_BAR__1_1000_0_S5_S3 8 0 65.535 DEPOSIT ABSOLUTE /end AXIS_DESCR
/end CHARACTERISTIC
/begin CHARACTERISTIC KL_HYSB_KPL_K0_HYSKOMP "Hysteresebreite Kupplung" CURVE 0x1A4A58 ZF_kl_ui16_S5_S3 150 UMR_NM__1_1_0_S5_S3 0 150
 /begin AXIS_DESCR STD_AXIS NO_INPUT_QUANTITY UMR_BAR__1_1000_0_S5_S3 8 0 65.535 DEPOSIT ABSOLUTE /end AXIS_DESCR
/end CHARACTERISTIC
/begin CHARACTERISTIC KL_INIT_V_A_HYSKOMP "Initialisierungswert fuer Rampe" CURVE 0x1A4210 ZF_kl_ui16_S5_S3 1 UMR_BAR__1_1000_0_S5_S3 0 1
 /begin AXIS_DESCR STD_AXIS NO_INPUT_QUANTITY UMR_BAR__1_1000_0_S5_S3 6 0 20 DEPOSIT ABSOLUTE /end AXIS_DESCR
/end CHARACTERISTIC
/begin CHARACTERISTIC KL_INIT_V_B_HYSKOMP "Initialisierungswert fuer Rampe" CURVE 0x1A4414 ZF_kl_ui16_S5_S3 1 UMR_BAR__1_1000_0_S5_S3 0 1
 /begin AXIS_DESCR STD_AXIS NO_INPUT_QUANTITY UMR_BAR__1_1000_0_S5_S3 6 0 20 DEPOSIT ABSOLUTE /end AXIS_DESCR
/end CHARACTERISTIC
/begin CHARACTERISTIC KL_INIT_V_C_HYSKOMP "Initialisierungswert fuer Rampe" CURVE 0x1A4618 ZF_kl_ui16_S5_S3 1 UMR_BAR__1_1000_0_S5_S3 0 1
 /begin AXIS_DESCR STD_AXIS NO_INPUT_QUANTITY UMR_BAR__1_1000_0_S5_S3 6 0 20 DEPOSIT ABSOLUTE /end AXIS_DESCR
/end CHARACTERISTIC
/begin CHARACTERISTIC KL_INIT_V_D_HYSKOMP "Initialisierungswert fuer Rampe" CURVE 0x1A481C ZF_kl_ui16_S5_S3 1 UMR_BAR__1_1000_0_S5_S3 0 1
 /begin AXIS_DESCR STD_AXIS NO_INPUT_QUANTITY UMR_BAR__1_1000_0_S5_S3 6 0 20 DEPOSIT ABSOLUTE /end AXIS_DESCR
/end CHARACTERISTIC
/begin CHARACTERISTIC KL_INIT_V_E_HYSKOMP "Initialisierungswert fuer Rampe" CURVE 0x1A4A20 ZF_kl_ui16_S5_S3 1 UMR_BAR__1_1000_0_S5_S3 0 1
 /begin AXIS_DESCR STD_AXIS NO_INPUT_QUANTITY UMR_BAR__1_1000_0_S5_S3 6 0 20 DEPOSIT ABSOLUTE /end AXIS_DESCR
/end CHARACTERISTIC
/begin CHARACTERISTIC KL_INIT_V_K0_HYSKOMP "Initialisierungswert fuer Rampe" CURVE 0x1A4C08 ZF_kl_ui16_S5_S3 1 UMR_BAR__1_1000_0_S5_S3 0 1
 /begin AXIS_DESCR STD_AXIS NO_INPUT_QUANTITY UMR_BAR__1_1000_0_S5_S3 6 0 20 DEPOSIT ABSOLUTE /end AXIS_DESCR
/end CHARACTERISTIC
/begin CHARACTERISTIC KL_MEKREDCM_D "Reduzierfaktor ME f(Mot.temp) Gangeinlegen D1 bis D6" CURVE 0x1A8794 ZF_kl_ui8_S5_S3 100 UMR_PROZENT__20_51_0_S5_S3 0 100
 /begin AXIS_DESCR STD_AXIS zff_atsys._.iSignale._.obj.sig_c_mot UMR_GRADC__1_1_M48_S5_S3 4 -48 144 DEPOSIT ABSOLUTE /end AXIS_DESCR
/end CHARACTERISTIC
/begin CHARACTERISTIC KL_MEKREDCM_R "Reduzierfaktor ME f(Mot.temp) Gangeinlegen nach R" CURVE 0x1A87A0 ZF_kl_ui8_S5_S3 100 UMR_PROZENT__20_51_0_S5_S3 0 100
 /begin AXIS_DESCR STD_AXIS zff_atsys._.iSignale._.obj.sig_c_mot UMR_GRADC__1_1_M48_S5_S3 4 -48 144 DEPOSIT ABSOLUTE /end AXIS_DESCR
/end CHARACTERISTIC
/begin CHARACTERISTIC KL_MO_KORRMSCHALT_K0_SP "Faktor zum korrigieren von m_schalt_k0" CURVE 0x1A2388 ZF_kl_fl32_S5_S3 200 UMR_NM__1_1_0_S5_S3 -100 100
 /begin AXIS_DESCR STD_AXIS iK0sVorst.f_korrmschalt_k0 UMR___1_1_0_S5_S3 7 -100 100 DEPOSIT ABSOLUTE FORMAT "%3.2" /end AXIS_DESCR
/end CHARACTERISTIC
/begin CHARACTERISTIC KL_MUEKPL_A_HYSKOMP "Übertragungswert der Kupplung" CURVE 0x1A40A0 ZF_kl_ui16_S5_S3 1000 UMR_BAR_NM_1_1_0_S5_S3 0 1000
 /begin AXIS_DESCR STD_AXIS NO_INPUT_QUANTITY UMR_BAR__1_1000_0_S5_S3 6 0 20 DEPOSIT ABSOLUTE /end AXIS_DESCR
/end CHARACTERISTIC
/begin CHARACTERISTIC KL_MUEKPL_B_HYSKOMP "Übertragungswert der Kupplung" CURVE 0x1A42A4 ZF_kl_ui16_S5_S3 1000 UMR_BAR_NM_1_1_0_S5_S3 0 1000
 /begin AXIS_DESCR STD_AXIS NO_INPUT_QUANTITY UMR_BAR__1_1000_0_S5_S3 6 0 20 DEPOSIT ABSOLUTE /end AXIS_DESCR
/end CHARACTERISTIC
/begin CHARACTERISTIC KL_MUEKPL_C_HYSKOMP "Übertragungswert der Kupplung" CURVE 0x1A44A8 ZF_kl_ui16_S5_S3 1000 UMR_BAR_NM_1_1_0_S5_S3 0 1000
 /begin AXIS_DESCR STD_AXIS NO_INPUT_QUANTITY UMR_BAR__1_1000_0_S5_S3 6 0 20 DEPOSIT ABSOLUTE /end AXIS_DESCR
/end CHARACTERISTIC
/begin CHARACTERISTIC KL_MUEKPL_D_HYSKOMP "Übertragungswert der Kupplung" CURVE 0x1A46AC ZF_kl_ui16_S5_S3 1000 UMR_BAR_NM_1_1_0_S5_S3 0 1000
 /begin AXIS_DESCR STD_AXIS NO_INPUT_QUANTITY UMR_BAR__1_1000_0_S5_S3 6 0 20 DEPOSIT ABSOLUTE /end AXIS_DESCR
/end CHARACTERISTIC
/begin CHARACTERISTIC KL_MUEKPL_E_HYSKOMP "Übertragungswert der Kupplung" CURVE 0x1A48B0 ZF_kl_ui16_S5_S3 1000 UMR_BAR_NM_1_1_0_S5_S3 0 1000
 /begin AXIS_DESCR STD_AXIS NO_INPUT_QUANTITY UMR_BAR__1_1000_0_S5_S3 6 0 20 DEPOSIT ABSOLUTE /end AXIS_DESCR
/end CHARACTERISTIC
/begin CHARACTERISTIC KL_PFCG_A "Fülldruck" CURVE 0x1A5480 ZF_kl_si16_S5_S3 12.75 UMR_BAR__1_1000_0_S5_S3 0 12.75
 /begin AXIS_DESCR STD_AXIS zff_atsys._.iSignale._.obj.sig_c_getr UMR_GRADC__1_1_M40_S5_S3 10 -40 150 DEPOSIT ABSOLUTE /end AXIS_DESCR
/end CHARACTERISTIC
/begin CHARACTERISTIC KL_PFCG_B "Fülldruck" CURVE 0x1A5B5C ZF_kl_si16_S5_S3 12.75 UMR_BAR__1_1000_0_S5_S3 0 12.75
 /begin AXIS_DESCR STD_AXIS zff_atsys._.iSignale._.obj.sig_c_getr UMR_GRADC__1_1_M40_S5_S3 10 -40 150 DEPOSIT ABSOLUTE /end AXIS_DESCR
/end CHARACTERISTIC
/begin CHARACTERISTIC KL_PFCG_C "Fülldruck" CURVE 0x1A6238 ZF_kl_si16_S5_S3 12.75 UMR_BAR__1_1000_0_S5_S3 0 12.75
 /begin AXIS_DESCR STD_AXIS zff_atsys._.iSignale._.obj.sig_c_getr UMR_GRADC__1_1_M40_S5_S3 10 -40 150 DEPOSIT ABSOLUTE /end AXIS_DESCR
/end CHARACTERISTIC
/begin CHARACTERISTIC KL_PFCG_D "Fülldruck" CURVE 0x1A6914 ZF_kl_si16_S5_S3 12.75 UMR_BAR__1_1000_0_S5_S3 0 12.75
 /begin AXIS_DESCR STD_AXIS zff_atsys._.iSignale._.obj.sig_c_getr UMR_GRADC__1_1_M40_S5_S3 10 -40 150 DEPOSIT ABSOLUTE /end AXIS_DESCR
/end CHARACTERISTIC
/begin CHARACTERISTIC KL_PFCG_E "Fülldruck" CURVE 0x1A6FF0 ZF_kl_si16_S5_S3 12.75 UMR_BAR__1_1000_0_S5_S3 0 12.75
 /begin AXIS_DESCR STD_AXIS zff_atsys._.iSignale._.obj.sig_c_getr UMR_GRADC__1_1_M40_S5_S3 10 -40 150 DEPOSIT ABSOLUTE /end AXIS_DESCR
/end CHARACTERISTIC
/begin CHARACTERISTIC KL_PFHYSCG_A "Fülldruckhysterese" CURVE 0x1A5434 ZF_kl_si16_S5_S3 12.7 UMR_BAR__1_1000_0_S5_S3 0 12.7
 /begin AXIS_DESCR STD_AXIS zff_atsys._.iSignale._.obj.sig_c_getr UMR_GRADC__1_1_M40_S5_S3 10 -40 150 DEPOSIT ABSOLUTE /end AXIS_DESCR
/end CHARACTERISTIC
/begin CHARACTERISTIC KL_PFHYSCG_B "Fülldruckhysterese" CURVE 0x1A5B10 ZF_kl_si16_S5_S3 12.7 UMR_BAR__1_1000_0_S5_S3 0 12.7
 /begin AXIS_DESCR STD_AXIS zff_atsys._.iSignale._.obj.sig_c_getr UMR_GRADC__1_1_M40_S5_S3 10 -40 150 DEPOSIT ABSOLUTE /end AXIS_DESCR
/end CHARACTERISTIC
/begin CHARACTERISTIC KL_PFHYSCG_C "Fülldruckhysterese" CURVE 0x1A61EC ZF_kl_si16_S5_S3 12.7 UMR_BAR__1_1000_0_S5_S3 0 12.7
 /begin AXIS_DESCR STD_AXIS zff_atsys._.iSignale._.obj.sig_c_getr UMR_GRADC__1_1_M40_S5_S3 10 -40 150 DEPOSIT ABSOLUTE /end AXIS_DESCR
/end CHARACTERISTIC
/begin CHARACTERISTIC KL_PFHYSCG_D "Fülldruckhysterese" CURVE 0x1A68C8 ZF_kl_si16_S5_S3 12.7 UMR_BAR__1_1000_0_S5_S3 0 12.7
 /begin AXIS_DESCR STD_AXIS zff_atsys._.iSignale._.obj.sig_c_getr UMR_GRADC__1_1_M40_S5_S3 10 -40 150 DEPOSIT ABSOLUTE /end AXIS_DESCR
/end CHARACTERISTIC
/begin CHARACTERISTIC KL_PFHYSCG_E "Fülldruckhysterese" CURVE 0x1A6FA4 ZF_kl_si16_S5_S3 12.7 UMR_BAR__1_1000_0_S5_S3 0 12.7
 /begin AXIS_DESCR STD_AXIS zff_atsys._.iSignale._.obj.sig_c_getr UMR_GRADC__1_1_M40_S5_S3 10 -40 150 DEPOSIT ABSOLUTE /end AXIS_DESCR
/end CHARACTERISTIC
/begin CHARACTERISTIC KL_PFHYSCG_K0 "Fülldruckhysterese" CURVE 0x1A7450 ZF_kl_si16_S5_S3 12.7 UMR_BAR__1_1000_0_S5_S3 0 12.7
 /begin AXIS_DESCR STD_AXIS zff_atsys._.iSignale._.obj.sig_c_getr UMR_GRADC__1_1_M40_S5_S3 10 -40 150 DEPOSIT ABSOLUTE /end AXIS_DESCR
/end CHARACTERISTIC
/begin CHARACTERISTIC KL_PKUPPSTROM_A "Druckwert für Stromschleife" CURVE 0x1A546C ZF_kl_ui16_S5_S3 5 UMR_BAR__1_1000_0_S5_S3 0 5
 /begin AXIS_DESCR STD_AXIS zff_atsys._.iSignale._.obj.sig_c_getr UMR_GRADC__1_1_M40_S5_S3 4 -40 150 DEPOSIT ABSOLUTE /end AXIS_DESCR
/end CHARACTERISTIC
/begin CHARACTERISTIC KL_PKUPPSTROM_B "Druckwert für Stromschleife" CURVE 0x1A5B48 ZF_kl_ui16_S5_S3 5 UMR_BAR__1_1000_0_S5_S3 0 5
 /begin AXIS_DESCR STD_AXIS zff_atsys._.iSignale._.obj.sig_c_getr UMR_GRADC__1_1_M40_S5_S3 4 -40 150 DEPOSIT ABSOLUTE /end AXIS_DESCR
/end CHARACTERISTIC
/begin CHARACTERISTIC KL_PKUPPSTROM_C "Druckwert für Stromschleife" CURVE 0x1A6224 ZF_kl_ui16_S5_S3 5 UMR_BAR__1_1000_0_S5_S3 0 5
 /begin AXIS_DESCR STD_AXIS zff_atsys._.iSignale._.obj.sig_c_getr UMR_GRADC__1_1_M40_S5_S3 4 -40 150 DEPOSIT ABSOLUTE /end AXIS_DESCR
/end CHARACTERISTIC
/begin CHARACTERISTIC KL_PKUPPSTROM_D "Druckwert für Stromschleife" CURVE 0x1A6900 ZF_kl_ui16_S5_S3 5 UMR_BAR__1_1000_0_S5_S3 0 5
 /begin AXIS_DESCR STD_AXIS zff_atsys._.iSignale._.obj.sig_c_getr UMR_GRADC__1_1_M40_S5_S3 4 -40 150 DEPOSIT ABSOLUTE /end AXIS_DESCR
/end CHARACTERISTIC
/begin CHARACTERISTIC KL_PKUPPSTROM_E "Druckwert für Stromschleife" CURVE 0x1A6FDC ZF_kl_ui16_S5_S3 5 UMR_BAR__1_1000_0_S5_S3 0 5
 /begin AXIS_DESCR STD_AXIS zff_atsys._.iSignale._.obj.sig_c_getr UMR_GRADC__1_1_M40_S5_S3 4 -40 150 DEPOSIT ABSOLUTE /end AXIS_DESCR
/end CHARACTERISTIC
/begin CHARACTERISTIC KL_PKUPPSTROM_K0 "Druckwert für Stromschleife" CURVE 0x1A747C ZF_kl_ui16_S5_S3 5 UMR_BAR__1_1000_0_S5_S3 0 5
 /begin AXIS_DESCR STD_AXIS zff_atsys._.iSignale._.obj.sig_c_getr UMR_GRADC__1_1_M40_S5_S3 4 -40 150 DEPOSIT ABSOLUTE /end AXIS_DESCR
/end CHARACTERISTIC
/begin CHARACTERISTIC KL_TFPWIRK_A "Filterzeit für Kupplungswirkdruck in ms" CURVE 0x1A4DD0 ZF_kl_ui8_S5_S3 254 UMR_MSEC__1_1_0_S5_S3 0 254
 /begin AXIS_DESCR STD_AXIS zff_atsys._.iSignale._.obj.sig_c_getr UMR_GRADC__1_1_M40_S5_S3 3 -40 150 DEPOSIT ABSOLUTE /end AXIS_DESCR
/end CHARACTERISTIC
/begin CHARACTERISTIC KL_TFPWIRK_B "Filterzeit für Kupplungswirkdruck in ms" CURVE 0x1A54AC ZF_kl_ui8_S5_S3 254 UMR_MSEC__1_1_0_S5_S3 0 254
 /begin AXIS_DESCR STD_AXIS zff_atsys._.iSignale._.obj.sig_c_getr UMR_GRADC__1_1_M40_S5_S3 3 -40 150 DEPOSIT ABSOLUTE /end AXIS_DESCR
/end CHARACTERISTIC
/begin CHARACTERISTIC KL_TFPWIRK_C "Filterzeit für Kupplungswirkdruck in ms" CURVE 0x1A5B88 ZF_kl_ui8_S5_S3 254 UMR_MSEC__1_1_0_S5_S3 0 254
 /begin AXIS_DESCR STD_AXIS zff_atsys._.iSignale._.obj.sig_c_getr UMR_GRADC__1_1_M40_S5_S3 3 -40 150 DEPOSIT ABSOLUTE /end AXIS_DESCR
/end CHARACTERISTIC
/begin CHARACTERISTIC KL_TFPWIRK_D "Filterzeit für Kupplungswirkdruck in ms" CURVE 0x1A6264 ZF_kl_ui8_S5_S3 254 UMR_MSEC__1_1_0_S5_S3 0 254
 /begin AXIS_DESCR STD_AXIS zff_atsys._.iSignale._.obj.sig_c_getr UMR_GRADC__1_1_M40_S5_S3 3 -40 150 DEPOSIT ABSOLUTE /end AXIS_DESCR
/end CHARACTERISTIC
/begin CHARACTERISTIC KL_TFPWIRK_E "Filterzeit für Kupplungswirkdruck in ms" CURVE 0x1A6940 ZF_kl_ui8_S5_S3 254 UMR_MSEC__1_1_0_S5_S3 0 254
 /begin AXIS_DESCR STD_AXIS zff_atsys._.iSignale._.obj.sig_c_getr UMR_GRADC__1_1_M40_S5_S3 3 -40 150 DEPOSIT ABSOLUTE /end AXIS_DESCR
/end CHARACTERISTIC
/begin CHARACTERISTIC KL_TFPWIRK_K0 "Filterzeit für Kupplungswirkdruck in ms" CURVE 0x1A701C ZF_kl_ui8_S5_S3 254 UMR_MSEC__1_1_0_S5_S3 0 254
 /begin AXIS_DESCR STD_AXIS zff_atsys._.iSignale._.obj.sig_c_getr UMR_GRADC__1_1_M40_S5_S3 3 -40 150 DEPOSIT ABSOLUTE /end AXIS_DESCR
/end CHARACTERISTIC
/begin CHARACTERISTIC KL_TOSFNKESTART "Schnellfüllzeitoffset Kup. E ESTART" CURVE 0x1A4DAC ZF_kl_si16_S5_S3 3540 UMR_MSEC__1_1_0_S5_S3 -1000 2540
 /begin AXIS_DESCR STD_AXIS NO_INPUT_QUANTITY UMR_U_MIN_1_1_0_S5_S3 8 0 11000 DEPOSIT ABSOLUTE /end AXIS_DESCR
/end CHARACTERISTIC
/begin CHARACTERISTIC KL_TOSFNKFUELLOPT_A "Schnellfüllzeitoffset optimierte Befüllung" CURVE 0x1A4FE0 ZF_kl_si16_S5_S3 3540 UMR_MSEC__1_1_0_S5_S3 -1000 2540
 /begin AXIS_DESCR STD_AXIS NO_INPUT_QUANTITY UMR_U_MIN_1_1_0_S5_S3 8 0 11000 DEPOSIT ABSOLUTE /end AXIS_DESCR
/end CHARACTERISTIC
/begin CHARACTERISTIC KL_TOSFNKFUELLOPT_B "Schnellfüllzeitoffset optimierte Befüllung" CURVE 0x1A56BC ZF_kl_si16_S5_S3 3540 UMR_MSEC__1_1_0_S5_S3 -1000 2540
 /begin AXIS_DESCR STD_AXIS NO_INPUT_QUANTITY UMR_U_MIN_1_1_0_S5_S3 8 0 11000 DEPOSIT ABSOLUTE /end AXIS_DESCR
/end CHARACTERISTIC
/begin CHARACTERISTIC KL_TOSFNKFUELLOPT_C "Schnellfüllzeitoffset optimierte Befüllung" CURVE 0x1A5D98 ZF_kl_si16_S5_S3 3540 UMR_MSEC__1_1_0_S5_S3 -1000 2540
 /begin AXIS_DESCR STD_AXIS NO_INPUT_QUANTITY UMR_U_MIN_1_1_0_S5_S3 8 0 11000 DEPOSIT ABSOLUTE /end AXIS_DESCR
/end CHARACTERISTIC
/begin CHARACTERISTIC KL_TOSFNKFUELLOPT_D "Schnellfüllzeitoffset optimierte Befüllung" CURVE 0x1A6474 ZF_kl_si16_S5_S3 3540 UMR_MSEC__1_1_0_S5_S3 -1000 2540
 /begin AXIS_DESCR STD_AXIS NO_INPUT_QUANTITY UMR_U_MIN_1_1_0_S5_S3 8 0 11000 DEPOSIT ABSOLUTE /end AXIS_DESCR
/end CHARACTERISTIC
/begin CHARACTERISTIC KL_TOSFNKFUELLOPT_E "Schnellfüllzeitoffset optimierte Befüllung" CURVE 0x1A6B50 ZF_kl_si16_S5_S3 3540 UMR_MSEC__1_1_0_S5_S3 -1000 2540
 /begin AXIS_DESCR STD_AXIS NO_INPUT_QUANTITY UMR_U_MIN_1_1_0_S5_S3 8 0 11000 DEPOSIT ABSOLUTE /end AXIS_DESCR
/end CHARACTERISTIC
/begin CHARACTERISTIC KL_TOSFNKFUELLOPT_K0 "Schnellfüllzeitoffset optimierte Befüllung" CURVE 0x1A722C ZF_kl_si16_S5_S3 3540 UMR_MSEC__1_1_0_S5_S3 -1000 2540
 /begin AXIS_DESCR STD_AXIS NO_INPUT_QUANTITY UMR_U_MIN_1_1_0_S5_S3 8 0 11000 DEPOSIT ABSOLUTE /end AXIS_DESCR
/end CHARACTERISTIC
/begin CHARACTERISTIC KL_TOSFNKFUELLRED_A "Schnellfüllzeitoffset reduzierte Befüllung" CURVE 0x1A4FBC ZF_kl_si16_S5_S3 3540 UMR_MSEC__1_1_0_S5_S3 -1000 2540
 /begin AXIS_DESCR STD_AXIS NO_INPUT_QUANTITY UMR_U_MIN_1_1_0_S5_S3 8 0 11000 DEPOSIT ABSOLUTE /end AXIS_DESCR
/end CHARACTERISTIC
/begin CHARACTERISTIC KL_TOSFNKFUELLRED_B "Schnellfüllzeitoffset reduzierte Befüllung" CURVE 0x1A5698 ZF_kl_si16_S5_S3 3540 UMR_MSEC__1_1_0_S5_S3 -1000 2540
 /begin AXIS_DESCR STD_AXIS NO_INPUT_QUANTITY UMR_U_MIN_1_1_0_S5_S3 8 0 11000 DEPOSIT ABSOLUTE /end AXIS_DESCR
/end CHARACTERISTIC
/begin CHARACTERISTIC KL_TOSFNKFUELLRED_C "Schnellfüllzeitoffset reduzierte Befüllung" CURVE 0x1A5D74 ZF_kl_si16_S5_S3 3540 UMR_MSEC__1_1_0_S5_S3 -1000 2540
 /begin AXIS_DESCR STD_AXIS NO_INPUT_QUANTITY UMR_U_MIN_1_1_0_S5_S3 8 0 11000 DEPOSIT ABSOLUTE /end AXIS_DESCR
/end CHARACTERISTIC
/begin CHARACTERISTIC KL_TOSFNKFUELLRED_D "Schnellfüllzeitoffset reduzierte Befüllung" CURVE 0x1A6450 ZF_kl_si16_S5_S3 3540 UMR_MSEC__1_1_0_S5_S3 -1000 2540
 /begin AXIS_DESCR STD_AXIS NO_INPUT_QUANTITY UMR_U_MIN_1_1_0_S5_S3 8 0 11000 DEPOSIT ABSOLUTE /end AXIS_DESCR
/end CHARACTERISTIC
/begin CHARACTERISTIC KL_TOSFNKFUELLRED_E "Schnellfüllzeitoffset reduzierte Befüllung" CURVE 0x1A6B2C ZF_kl_si16_S5_S3 3540 UMR_MSEC__1_1_0_S5_S3 -1000 2540
 /begin AXIS_DESCR STD_AXIS NO_INPUT_QUANTITY UMR_U_MIN_1_1_0_S5_S3 8 0 11000 DEPOSIT ABSOLUTE /end AXIS_DESCR
/end CHARACTERISTIC
/begin CHARACTERISTIC KL_TOSFNKFUELLRED_K0 "Schnellfüllzeitoffset reduzierte Befüllung" CURVE 0x1A7208 ZF_kl_si16_S5_S3 3540 UMR_MSEC__1_1_0_S5_S3 -1000 2540
 /begin AXIS_DESCR STD_AXIS NO_INPUT_QUANTITY UMR_U_MIN_1_1_0_S5_S3 8 0 11000 DEPOSIT ABSOLUTE /end AXIS_DESCR
/end CHARACTERISTIC
/begin CHARACTERISTIC KL_TOSFNK_A "Schnellfüllzeitoffset" CURVE 0x1A4F98 ZF_kl_si16_S5_S3 3540 UMR_MSEC__1_1_0_S5_S3 -1000 2540
 /begin AXIS_DESCR STD_AXIS NO_INPUT_QUANTITY UMR_U_MIN_1_1_0_S5_S3 8 0 11000 DEPOSIT ABSOLUTE /end AXIS_DESCR
/end CHARACTERISTIC
/begin CHARACTERISTIC KL_TOSFNK_B "Schnellfüllzeitoffset" CURVE 0x1A5674 ZF_kl_si16_S5_S3 3540 UMR_MSEC__1_1_0_S5_S3 -1000 2540
 /begin AXIS_DESCR STD_AXIS NO_INPUT_QUANTITY UMR_U_MIN_1_1_0_S5_S3 8 0 11000 DEPOSIT ABSOLUTE /end AXIS_DESCR
/end CHARACTERISTIC
/begin CHARACTERISTIC KL_TOSFNK_C "Schnellfüllzeitoffset" CURVE 0x1A5D50 ZF_kl_si16_S5_S3 3540 UMR_MSEC__1_1_0_S5_S3 -1000 2540
 /begin AXIS_DESCR STD_AXIS NO_INPUT_QUANTITY UMR_U_MIN_1_1_0_S5_S3 8 0 11000 DEPOSIT ABSOLUTE /end AXIS_DESCR
/end CHARACTERISTIC
/begin CHARACTERISTIC KL_TOSFNK_D "Schnellfüllzeitoffset" CURVE 0x1A642C ZF_kl_si16_S5_S3 3540 UMR_MSEC__1_1_0_S5_S3 -1000 2540
 /begin AXIS_DESCR STD_AXIS NO_INPUT_QUANTITY UMR_U_MIN_1_1_0_S5_S3 8 0 11000 DEPOSIT ABSOLUTE /end AXIS_DESCR
/end CHARACTERISTIC
/begin CHARACTERISTIC KL_TOSFNK_E "Schnellfüllzeitoffset" CURVE 0x1A6B08 ZF_kl_si16_S5_S3 3540 UMR_MSEC__1_1_0_S5_S3 -1000 2540
 /begin AXIS_DESCR STD_AXIS NO_INPUT_QUANTITY UMR_U_MIN_1_1_0_S5_S3 8 0 11000 DEPOSIT ABSOLUTE /end AXIS_DESCR
/end CHARACTERISTIC
/begin CHARACTERISTIC KL_TOSFNK_K0 "Schnellfüllzeitoffset" CURVE 0x1A71E4 ZF_kl_si16_S5_S3 3540 UMR_MSEC__1_1_0_S5_S3 -1000 2540
 /begin AXIS_DESCR STD_AXIS NO_INPUT_QUANTITY UMR_U_MIN_1_1_0_S5_S3 8 0 11000 DEPOSIT ABSOLUTE /end AXIS_DESCR
/end CHARACTERISTIC
/begin CHARACTERISTIC KL_TSFCGESTART_E "Schnellfüllzeit Kup. E ESTART" CURVE 0x1A4D80 ZF_kl_ui16_S5_S3 2540 UMR_MSEC__1_1_0_S5_S3 0 2540
 /begin AXIS_DESCR STD_AXIS zff_atsys._.iSignale._.obj.sig_c_getr UMR_GRADC__1_1_M40_S5_S3 10 -40 150 DEPOSIT ABSOLUTE /end AXIS_DESCR
/end CHARACTERISTIC
/begin CHARACTERISTIC KL_TSFCGFUELLOPT_A "Schnellfüllzeit optimierte Befüllung" CURVE 0x1A4F6C ZF_kl_ui16_S5_S3 2540 UMR_MSEC__1_1_0_S5_S3 0 2540
 /begin AXIS_DESCR STD_AXIS zff_atsys._.iSignale._.obj.sig_c_getr UMR_GRADC__1_1_M40_S5_S3 10 -40 150 DEPOSIT ABSOLUTE /end AXIS_DESCR
/end CHARACTERISTIC
/begin CHARACTERISTIC KL_TSFCGFUELLOPT_B "Schnellfüllzeit optimierte Befüllung" CURVE 0x1A5648 ZF_kl_ui16_S5_S3 2540 UMR_MSEC__1_1_0_S5_S3 0 2540
 /begin AXIS_DESCR STD_AXIS zff_atsys._.iSignale._.obj.sig_c_getr UMR_GRADC__1_1_M40_S5_S3 10 -40 150 DEPOSIT ABSOLUTE /end AXIS_DESCR
/end CHARACTERISTIC
/begin CHARACTERISTIC KL_TSFCGFUELLOPT_C "Schnellfüllzeit optimierte Befüllung" CURVE 0x1A5D24 ZF_kl_ui16_S5_S3 2540 UMR_MSEC__1_1_0_S5_S3 0 2540
 /begin AXIS_DESCR STD_AXIS zff_atsys._.iSignale._.obj.sig_c_getr UMR_GRADC__1_1_M40_S5_S3 10 -40 150 DEPOSIT ABSOLUTE /end AXIS_DESCR
/end CHARACTERISTIC
/begin CHARACTERISTIC KL_TSFCGFUELLOPT_D "Schnellfüllzeit optimierte Befüllung" CURVE 0x1A6400 ZF_kl_ui16_S5_S3 2540 UMR_MSEC__1_1_0_S5_S3 0 2540
 /begin AXIS_DESCR STD_AXIS zff_atsys._.iSignale._.obj.sig_c_getr UMR_GRADC__1_1_M40_S5_S3 10 -40 150 DEPOSIT ABSOLUTE /end AXIS_DESCR
/end CHARACTERISTIC
/begin CHARACTERISTIC KL_TSFCGFUELLOPT_E "Schnellfüllzeit optimierte Befüllung" CURVE 0x1A6ADC ZF_kl_ui16_S5_S3 2540 UMR_MSEC__1_1_0_S5_S3 0 2540
 /begin AXIS_DESCR STD_AXIS zff_atsys._.iSignale._.obj.sig_c_getr UMR_GRADC__1_1_M40_S5_S3 10 -40 150 DEPOSIT ABSOLUTE /end AXIS_DESCR
/end CHARACTERISTIC
/begin CHARACTERISTIC KL_TSFCGFUELLOPT_K0 "Schnellfüllzeit optimierte Befüllung" CURVE 0x1A71B8 ZF_kl_ui16_S5_S3 2540 UMR_MSEC__1_1_0_S5_S3 0 2540
 /begin AXIS_DESCR STD_AXIS zff_atsys._.iSignale._.obj.sig_c_getr UMR_GRADC__1_1_M40_S5_S3 10 -40 150 DEPOSIT ABSOLUTE /end AXIS_DESCR
/end CHARACTERISTIC
/begin CHARACTERISTIC KL_TSFCGFUELLRED_A "Schnellfüllzeit reduzierte Befüllung" CURVE 0x1A4F40 ZF_kl_ui16_S5_S3 2540 UMR_MSEC__1_1_0_S5_S3 0 2540
 /begin AXIS_DESCR STD_AXIS zff_atsys._.iSignale._.obj.sig_c_getr UMR_GRADC__1_1_M40_S5_S3 10 -40 150 DEPOSIT ABSOLUTE /end AXIS_DESCR
/end CHARACTERISTIC
/begin CHARACTERISTIC KL_TSFCGFUELLRED_B "Schnellfüllzeit reduzierte Befüllung" CURVE 0x1A561C ZF_kl_ui16_S5_S3 2540 UMR_MSEC__1_1_0_S5_S3 0 2540
 /begin AXIS_DESCR STD_AXIS zff_atsys._.iSignale._.obj.sig_c_getr UMR_GRADC__1_1_M40_S5_S3 10 -40 150 DEPOSIT ABSOLUTE /end AXIS_DESCR
/end CHARACTERISTIC
/begin CHARACTERISTIC KL_TSFCGFUELLRED_C "Schnellfüllzeit reduzierte Befüllung" CURVE 0x1A5CF8 ZF_kl_ui16_S5_S3 2540 UMR_MSEC__1_1_0_S5_S3 0 2540
 /begin AXIS_DESCR STD_AXIS zff_atsys._.iSignale._.obj.sig_c_getr UMR_GRADC__1_1_M40_S5_S3 10 -40 150 DEPOSIT ABSOLUTE /end AXIS_DESCR
/end CHARACTERISTIC
/begin CHARACTERISTIC KL_TSFCGFUELLRED_D "Schnellfüllzeit reduzierte Befüllung" CURVE 0x1A63D4 ZF_kl_ui16_S5_S3 2540 UMR_MSEC__1_1_0_S5_S3 0 2540
 /begin AXIS_DESCR STD_AXIS zff_atsys._.iSignale._.obj.sig_c_getr UMR_GRADC__1_1_M40_S5_S3 10 -40 150 DEPOSIT ABSOLUTE /end AXIS_DESCR
/end CHARACTERISTIC
/begin CHARACTERISTIC KL_TSFCGFUELLRED_E "Schnellfüllzeit reduzierte Befüllung" CURVE 0x1A6AB0 ZF_kl_ui16_S5_S3 2540 UMR_MSEC__1_1_0_S5_S3 0 2540
 /begin AXIS_DESCR STD_AXIS zff_atsys._.iSignale._.obj.sig_c_getr UMR_GRADC__1_1_M40_S5_S3 10 -40 150 DEPOSIT ABSOLUTE /end AXIS_DESCR
/end CHARACTERISTIC
/begin CHARACTERISTIC KL_TSFCGFUELLRED_K0 "Schnellfüllzeit reduzierte Befüllung" CURVE 0x1A718C ZF_kl_ui16_S5_S3 2540 UMR_MSEC__1_1_0_S5_S3 0 2540
 /begin AXIS_DESCR STD_AXIS zff_atsys._.iSignale._.obj.sig_c_getr UMR_GRADC__1_1_M40_S5_S3 10 -40 150 DEPOSIT ABSOLUTE /end AXIS_DESCR
/end CHARACTERISTIC
/begin CHARACTERISTIC KL_TSFCG_A "Schnellfüllzeit" CURVE 0x1A4F14 ZF_kl_ui16_S5_S3 2540 UMR_MSEC__1_1_0_S5_S3 0 2540
 /begin AXIS_DESCR STD_AXIS zff_atsys._.iSignale._.obj.sig_c_getr UMR_GRADC__1_1_M40_S5_S3 10 -40 150 DEPOSIT ABSOLUTE /end AXIS_DESCR
/end CHARACTERISTIC
/begin CHARACTERISTIC KL_TSFCG_B "Schnellfüllzeit" CURVE 0x1A55F0 ZF_kl_ui16_S5_S3 2540 UMR_MSEC__1_1_0_S5_S3 0 2540
 /begin AXIS_DESCR STD_AXIS zff_atsys._.iSignale._.obj.sig_c_getr UMR_GRADC__1_1_M40_S5_S3 10 -40 150 DEPOSIT ABSOLUTE /end AXIS_DESCR
/end CHARACTERISTIC
/begin CHARACTERISTIC KL_TSFCG_C "Schnellfüllzeit" CURVE 0x1A5CCC ZF_kl_ui16_S5_S3 2540 UMR_MSEC__1_1_0_S5_S3 0 2540
 /begin AXIS_DESCR STD_AXIS zff_atsys._.iSignale._.obj.sig_c_getr UMR_GRADC__1_1_M40_S5_S3 10 -40 150 DEPOSIT ABSOLUTE /end AXIS_DESCR
/end CHARACTERISTIC
/begin CHARACTERISTIC KL_TSFCG_D "Schnellfüllzeit" CURVE 0x1A63A8 ZF_kl_ui16_S5_S3 2540 UMR_MSEC__1_1_0_S5_S3 0 2540
 /begin AXIS_DESCR STD_AXIS zff_atsys._.iSignale._.obj.sig_c_getr UMR_GRADC__1_1_M40_S5_S3 10 -40 150 DEPOSIT ABSOLUTE /end AXIS_DESCR
/end CHARACTERISTIC
/begin CHARACTERISTIC KL_TSFCG_E "Schnellfüllzeit" CURVE 0x1A6A84 ZF_kl_ui16_S5_S3 2540 UMR_MSEC__1_1_0_S5_S3 0 2540
 /begin AXIS_DESCR STD_AXIS zff_atsys._.iSignale._.obj.sig_c_getr UMR_GRADC__1_1_M40_S5_S3 10 -40 150 DEPOSIT ABSOLUTE /end AXIS_DESCR
/end CHARACTERISTIC
/begin CHARACTERISTIC KL_TSFCG_K0 "Schnellfüllzeit" CURVE 0x1A7160 ZF_kl_ui16_S5_S3 2540 UMR_MSEC__1_1_0_S5_S3 0 2540
 /begin AXIS_DESCR STD_AXIS zff_atsys._.iSignale._.obj.sig_c_getr UMR_GRADC__1_1_M40_S5_S3 10 -40 150 DEPOSIT ABSOLUTE /end AXIS_DESCR
/end CHARACTERISTIC
/begin CHARACTERISTIC KL_TSYNMTMEHAUPTE_1 "Zeit vor Erkennen synchron fuer Ende Haupt-ME" CURVE 0x1A96F4 ZF_kl_ui8_S5_S3 1280 UMR_MSEC__10_1_M128_S5_S3 -1280 0
 /begin AXIS_DESCR STD_AXIS zff_atsys._.iSignale._.obj.sig_m_t8 UMR_NM__6_1_M34_S5_S3 6 -204 1326 DEPOSIT ABSOLUTE /end AXIS_DESCR
/end CHARACTERISTIC
/begin CHARACTERISTIC KL_TSYNMTMEHAUPTE_2 "Zeit vor Erkennen synchron fuer Ende Haupt-ME" CURVE 0x1A97B8 ZF_kl_ui8_S5_S3 1280 UMR_MSEC__10_1_M128_S5_S3 -1280 0
 /begin AXIS_DESCR STD_AXIS zff_atsys._.iSignale._.obj.sig_m_t8 UMR_NM__6_1_M34_S5_S3 6 -204 1326 DEPOSIT ABSOLUTE /end AXIS_DESCR
/end CHARACTERISTIC
/begin CHARACTERISTIC KL_TSYNMTMEHAUPTE_3 "Zeit vor Erkennen synchron fuer Ende Haupt-ME" CURVE 0x1A987C ZF_kl_ui8_S5_S3 1280 UMR_MSEC__10_1_M128_S5_S3 -1280 0
 /begin AXIS_DESCR STD_AXIS zff_atsys._.iSignale._.obj.sig_m_t8 UMR_NM__6_1_M34_S5_S3 6 -204 1326 DEPOSIT ABSOLUTE /end AXIS_DESCR
/end CHARACTERISTIC
/begin CHARACTERISTIC KL_TSYNMTMEHAUPTE_4 "Zeit vor Erkennen synchron fuer Ende Haupt-ME" CURVE 0x1A9940 ZF_kl_ui8_S5_S3 1280 UMR_MSEC__10_1_M128_S5_S3 -1280 0
 /begin AXIS_DESCR STD_AXIS zff_atsys._.iSignale._.obj.sig_m_t8 UMR_NM__6_1_M34_S5_S3 6 -204 1326 DEPOSIT ABSOLUTE /end AXIS_DESCR
/end CHARACTERISTIC
/begin CHARACTERISTIC KL_TSYNMTMEHAUPTE_5 "Zeit vor Erkennen synchron fuer Ende Haupt-ME" CURVE 0x1A9A04 ZF_kl_ui8_S5_S3 1280 UMR_MSEC__10_1_M128_S5_S3 -1280 0
 /begin AXIS_DESCR STD_AXIS zff_atsys._.iSignale._.obj.sig_m_t8 UMR_NM__6_1_M34_S5_S3 6 -204 1326 DEPOSIT ABSOLUTE /end AXIS_DESCR
/end CHARACTERISTIC
/begin CHARACTERISTIC KL_TSYNMTMEHAUPTE_6 "Zeit vor Erkennen synchron fuer Ende Haupt-ME" CURVE 0x1A9AC8 ZF_kl_ui8_S5_S3 1280 UMR_MSEC__10_1_M128_S5_S3 -1280 0
 /begin AXIS_DESCR STD_AXIS zff_atsys._.iSignale._.obj.sig_m_t8 UMR_NM__6_1_M34_S5_S3 6 -204 1326 DEPOSIT ABSOLUTE /end AXIS_DESCR
/end CHARACTERISTIC
/begin CHARACTERISTIC KL_TSYNMTMEHAUPTE_7 "Zeit vor Erkennen synchron fuer Ende Haupt-ME" CURVE 0x1A9B8C ZF_kl_ui8_S5_S3 1280 UMR_MSEC__10_1_M128_S5_S3 -1280 0
 /begin AXIS_DESCR STD_AXIS zff_atsys._.iSignale._.obj.sig_m_t8 UMR_NM__6_1_M34_S5_S3 6 -204 1326 DEPOSIT ABSOLUTE /end AXIS_DESCR
/end CHARACTERISTIC
/begin CHARACTERISTIC KL_TTOTFUELL_A "Totzeit" CURVE 0x1A52D4 ZF_kl_ui8_S5_S3 2000 UMR_MSEC__10_1_0_S5_S3 0 2000
 /begin AXIS_DESCR STD_AXIS zff_atsys._.iSignale._.obj.sig_c_getr UMR_GRADC__1_1_M40_S5_S3 5 -40 150 DEPOSIT ABSOLUTE /end AXIS_DESCR
/end CHARACTERISTIC
/begin CHARACTERISTIC KL_TTOTFUELL_B "Totzeit" CURVE 0x1A59B0 ZF_kl_ui8_S5_S3 2000 UMR_MSEC__10_1_0_S5_S3 0 2000
 /begin AXIS_DESCR STD_AXIS zff_atsys._.iSignale._.obj.sig_c_getr UMR_GRADC__1_1_M40_S5_S3 5 -40 150 DEPOSIT ABSOLUTE /end AXIS_DESCR
/end CHARACTERISTIC
/begin CHARACTERISTIC KL_TTOTFUELL_C "Totzeit" CURVE 0x1A608C ZF_kl_ui8_S5_S3 2000 UMR_MSEC__10_1_0_S5_S3 0 2000
 /begin AXIS_DESCR STD_AXIS zff_atsys._.iSignale._.obj.sig_c_getr UMR_GRADC__1_1_M40_S5_S3 5 -40 150 DEPOSIT ABSOLUTE /end AXIS_DESCR
/end CHARACTERISTIC
/begin CHARACTERISTIC KL_TTOTFUELL_D "Totzeit" CURVE 0x1A6768 ZF_kl_ui8_S5_S3 2000 UMR_MSEC__10_1_0_S5_S3 0 2000
 /begin AXIS_DESCR STD_AXIS zff_atsys._.iSignale._.obj.sig_c_getr UMR_GRADC__1_1_M40_S5_S3 5 -40 150 DEPOSIT ABSOLUTE /end AXIS_DESCR
/end CHARACTERISTIC
/begin CHARACTERISTIC KL_TTOTFUELL_E "Totzeit" CURVE 0x1A6E44 ZF_kl_ui8_S5_S3 2000 UMR_MSEC__10_1_0_S5_S3 0 2000
 /begin AXIS_DESCR STD_AXIS zff_atsys._.iSignale._.obj.sig_c_getr UMR_GRADC__1_1_M40_S5_S3 5 -40 150 DEPOSIT ABSOLUTE /end AXIS_DESCR
/end CHARACTERISTIC
/begin CHARACTERISTIC KL_TTOTFUELL_K0 "Totzeit" CURVE 0x1A72F0 ZF_kl_ui8_S5_S3 2000 UMR_MSEC__10_1_0_S5_S3 0 2000
 /begin AXIS_DESCR STD_AXIS zff_atsys._.iSignale._.obj.sig_c_getr UMR_GRADC__1_1_M40_S5_S3 5 -40 150 DEPOSIT ABSOLUTE /end AXIS_DESCR
/end CHARACTERISTIC
/begin CHARACTERISTIC KL_TVCGSAEND_A "Verzögerungszeit für Umstellung auf Schaltungsende" CURVE 0x1A5460 ZF_kl_ui8_S5_S3 2000 UMR_MSEC__10_1_0_S5_S3 0 2000
 /begin AXIS_DESCR STD_AXIS zff_atsys._.iSignale._.obj.sig_c_getr UMR_GRADC__1_1_M40_S5_S3 3 -40 150 DEPOSIT ABSOLUTE /end AXIS_DESCR
/end CHARACTERISTIC
/begin CHARACTERISTIC KL_TVCGSAEND_B "Verzögerungszeit für Umstellung auf Schaltungsende" CURVE 0x1A5B3C ZF_kl_ui8_S5_S3 2000 UMR_MSEC__10_1_0_S5_S3 0 2000
 /begin AXIS_DESCR STD_AXIS zff_atsys._.iSignale._.obj.sig_c_getr UMR_GRADC__1_1_M40_S5_S3 3 -40 150 DEPOSIT ABSOLUTE /end AXIS_DESCR
/end CHARACTERISTIC
/begin CHARACTERISTIC KL_TVCGSAEND_C "Verzögerungszeit für Umstellung auf Schaltungsende" CURVE 0x1A6218 ZF_kl_ui8_S5_S3 2000 UMR_MSEC__10_1_0_S5_S3 0 2000
 /begin AXIS_DESCR STD_AXIS zff_atsys._.iSignale._.obj.sig_c_getr UMR_GRADC__1_1_M40_S5_S3 3 -40 150 DEPOSIT ABSOLUTE /end AXIS_DESCR
/end CHARACTERISTIC
/begin CHARACTERISTIC KL_TVCGSAEND_D "Verzögerungszeit für Umstellung auf Schaltungsende" CURVE 0x1A68F4 ZF_kl_ui8_S5_S3 2000 UMR_MSEC__10_1_0_S5_S3 0 2000
 /begin AXIS_DESCR STD_AXIS zff_atsys._.iSignale._.obj.sig_c_getr UMR_GRADC__1_1_M40_S5_S3 3 -40 150 DEPOSIT ABSOLUTE /end AXIS_DESCR
/end CHARACTERISTIC
/begin CHARACTERISTIC KL_TVCGSAEND_E "Verzögerungszeit für Umstellung auf Schaltungsende" CURVE 0x1A6FD0 ZF_kl_ui8_S5_S3 2000 UMR_MSEC__10_1_0_S5_S3 0 2000
 /begin AXIS_DESCR STD_AXIS zff_atsys._.iSignale._.obj.sig_c_getr UMR_GRADC__1_1_M40_S5_S3 3 -40 150 DEPOSIT ABSOLUTE /end AXIS_DESCR
/end CHARACTERISTIC
/begin CHARACTERISTIC KL_TVMEA_1 "Verzoegerungszeit fuer Beginn Haupt-ME" CURVE 0x1A9704 ZF_kl_si16_S5_S3 2000 UMR_MSEC__10_1_0_S5_S3 -1000 1000
 /begin AXIS_DESCR STD_AXIS zff_atsys._.iSignale._.obj.sig_n_t8 UMR_U_MIN_32_1_0_S5_S3 8 0 8160 DEPOSIT ABSOLUTE /end AXIS_DESCR
/end CHARACTERISTIC
/begin CHARACTERISTIC KL_TVMEA_2 "Verzoegerungszeit fuer Beginn Haupt-ME" CURVE 0x1A97C8 ZF_kl_si16_S5_S3 2000 UMR_MSEC__10_1_0_S5_S3 -1000 1000
 /begin AXIS_DESCR STD_AXIS zff_atsys._.iSignale._.obj.sig_n_t8 UMR_U_MIN_32_1_0_S5_S3 8 0 8160 DEPOSIT ABSOLUTE /end AXIS_DESCR
/end CHARACTERISTIC
/begin CHARACTERISTIC KL_TVMEA_3 "Verzoegerungszeit fuer Beginn Haupt-ME" CURVE 0x1A988C ZF_kl_si16_S5_S3 2000 UMR_MSEC__10_1_0_S5_S3 -1000 1000
 /begin AXIS_DESCR STD_AXIS zff_atsys._.iSignale._.obj.sig_n_t8 UMR_U_MIN_32_1_0_S5_S3 8 0 8160 DEPOSIT ABSOLUTE /end AXIS_DESCR
/end CHARACTERISTIC
/begin CHARACTERISTIC KL_TVMEA_4 "Verzoegerungszeit fuer Beginn Haupt-ME" CURVE 0x1A9950 ZF_kl_si16_S5_S3 2000 UMR_MSEC__10_1_0_S5_S3 -1000 1000
 /begin AXIS_DESCR STD_AXIS zff_atsys._.iSignale._.obj.sig_n_t8 UMR_U_MIN_32_1_0_S5_S3 8 0 8160 DEPOSIT ABSOLUTE /end AXIS_DESCR
/end CHARACTERISTIC
/begin CHARACTERISTIC KL_TVMEA_5 "Verzoegerungszeit fuer Beginn Haupt-ME" CURVE 0x1A9A14 ZF_kl_si16_S5_S3 2000 UMR_MSEC__10_1_0_S5_S3 -1000 1000
 /begin AXIS_DESCR STD_AXIS zff_atsys._.iSignale._.obj.sig_n_t8 UMR_U_MIN_32_1_0_S5_S3 8 0 8160 DEPOSIT ABSOLUTE /end AXIS_DESCR
/end CHARACTERISTIC
/begin CHARACTERISTIC KL_TVMEA_6 "Verzoegerungszeit fuer Beginn Haupt-ME" CURVE 0x1A9AD8 ZF_kl_si16_S5_S3 2000 UMR_MSEC__10_1_0_S5_S3 -1000 1000
 /begin AXIS_DESCR STD_AXIS zff_atsys._.iSignale._.obj.sig_n_t8 UMR_U_MIN_32_1_0_S5_S3 8 0 8160 DEPOSIT ABSOLUTE /end AXIS_DESCR
/end CHARACTERISTIC
/begin CHARACTERISTIC KL_TVMEA_7 "Verzoegerungszeit fuer Beginn Haupt-ME" CURVE 0x1A9B9C ZF_kl_si16_S5_S3 2000 UMR_MSEC__10_1_0_S5_S3 -1000 1000
 /begin AXIS_DESCR STD_AXIS zff_atsys._.iSignale._.obj.sig_n_t8 UMR_U_MIN_32_1_0_S5_S3 8 0 8160 DEPOSIT ABSOLUTE /end AXIS_DESCR
/end CHARACTERISTIC
/begin CHARACTERISTIC KL_T_KPL_A_HYSKOMP "Filterzeitkonstante zum Abfiltern des Momentenoffsets" CURVE 0x1A4084 ZF_kl_si16_S5_S3 0.99 UMR___1_100_0_S5_S3 0.01 1
 /begin AXIS_DESCR STD_AXIS NO_INPUT_QUANTITY UMR_BAR_SEC_1_1_0_S5_S3 6 -32768 32767 DEPOSIT ABSOLUTE /end AXIS_DESCR
/end CHARACTERISTIC
/begin CHARACTERISTIC KL_T_KPL_B_HYSKOMP "Filterzeitkonstante zum Abfiltern des Momentenoffsets" CURVE 0x1A4288 ZF_kl_si16_S5_S3 0.99 UMR___1_100_0_S5_S3 0.01 1
 /begin AXIS_DESCR STD_AXIS NO_INPUT_QUANTITY UMR_BAR_SEC_1_1_0_S5_S3 6 -32768 32767 DEPOSIT ABSOLUTE /end AXIS_DESCR
/end CHARACTERISTIC
/begin CHARACTERISTIC KL_T_KPL_C_HYSKOMP "Filterzeitkonstante zum Abfiltern des Momentenoffsets" CURVE 0x1A448C ZF_kl_si16_S5_S3 0.99 UMR___1_100_0_S5_S3 0.01 1
 /begin AXIS_DESCR STD_AXIS NO_INPUT_QUANTITY UMR_BAR_SEC_1_1_0_S5_S3 6 -32768 32767 DEPOSIT ABSOLUTE /end AXIS_DESCR
/end CHARACTERISTIC
/begin CHARACTERISTIC KL_T_KPL_D_HYSKOMP "Filterzeitkonstante zum Abfiltern des Momentenoffsets" CURVE 0x1A4690 ZF_kl_si16_S5_S3 0.99 UMR___1_100_0_S5_S3 0.01 1
 /begin AXIS_DESCR STD_AXIS NO_INPUT_QUANTITY UMR_BAR_SEC_1_1_0_S5_S3 6 -32768 32767 DEPOSIT ABSOLUTE /end AXIS_DESCR
/end CHARACTERISTIC
/begin CHARACTERISTIC KL_T_KPL_E_HYSKOMP "Filterzeitkonstante zum Abfiltern des Momentenoffsets" CURVE 0x1A4894 ZF_kl_si16_S5_S3 0.99 UMR___1_100_0_S5_S3 0.01 1
 /begin AXIS_DESCR STD_AXIS NO_INPUT_QUANTITY UMR_BAR_SEC_1_1_0_S5_S3 6 -32768 32767 DEPOSIT ABSOLUTE /end AXIS_DESCR
/end CHARACTERISTIC
/begin CHARACTERISTIC KL_T_KPL_K0_HYSKOMP "Filterzeitkonstante zum Abfiltern des Momentenoffsets" CURVE 0x1A4A98 ZF_kl_si16_S5_S3 0.99 UMR___1_100_0_S5_S3 0.01 1
 /begin AXIS_DESCR STD_AXIS NO_INPUT_QUANTITY UMR_BAR_SEC_1_1_0_S5_S3 6 -32768 32767 DEPOSIT ABSOLUTE /end AXIS_DESCR
/end CHARACTERISTIC
/begin CHARACTERISTIC KL_T_STG_A_HYSKOMP "Filterzeitkonstante zum Abfiltern des Stromoffsets" CURVE 0x1A4124 ZF_kl_si16_S5_S3 0.99 UMR___1_100_0_S5_S3 0.01 1
 /begin AXIS_DESCR STD_AXIS NO_INPUT_QUANTITY UMR_MA_SEC_1_1_0_S5_S3 6 -32768 32767 DEPOSIT ABSOLUTE /end AXIS_DESCR
/end CHARACTERISTIC
/begin CHARACTERISTIC KL_T_STG_B_HYSKOMP "Filterzeitkonstante zum Abfiltern des Stromoffsets" CURVE 0x1A4328 ZF_kl_si16_S5_S3 0.99 UMR___1_100_0_S5_S3 0.01 1
 /begin AXIS_DESCR STD_AXIS NO_INPUT_QUANTITY UMR_MA_SEC_1_1_0_S5_S3 6 -32768 32767 DEPOSIT ABSOLUTE /end AXIS_DESCR
/end CHARACTERISTIC
/begin CHARACTERISTIC KL_T_STG_C_HYSKOMP "Filterzeitkonstante zum Abfiltern des Stromoffsets" CURVE 0x1A452C ZF_kl_si16_S5_S3 0.99 UMR___1_100_0_S5_S3 0.01 1
 /begin AXIS_DESCR STD_AXIS NO_INPUT_QUANTITY UMR_MA_SEC_1_1_0_S5_S3 6 -32768 32767 DEPOSIT ABSOLUTE /end AXIS_DESCR
/end CHARACTERISTIC
/begin CHARACTERISTIC KL_T_STG_D_HYSKOMP "Filterzeitkonstante zum Abfiltern des Stromoffsets" CURVE 0x1A4730 ZF_kl_si16_S5_S3 0.99 UMR___1_100_0_S5_S3 0.01 1
 /begin AXIS_DESCR STD_AXIS NO_INPUT_QUANTITY UMR_MA_SEC_1_1_0_S5_S3 6 -32768 32767 DEPOSIT ABSOLUTE /end AXIS_DESCR
/end CHARACTERISTIC
/begin CHARACTERISTIC KL_T_STG_E_HYSKOMP "Filterzeitkonstante zum Abfiltern des Stromoffsets" CURVE 0x1A4934 ZF_kl_si16_S5_S3 0.99 UMR___1_100_0_S5_S3 0.01 1
 /begin AXIS_DESCR STD_AXIS NO_INPUT_QUANTITY UMR_MA_SEC_1_1_0_S5_S3 6 -32768 32767 DEPOSIT ABSOLUTE /end AXIS_DESCR
/end CHARACTERISTIC
/begin CHARACTERISTIC KL_T_STG_K0_HYSKOMP "Filterzeitkonstante zum Abfiltern des Stromoffsets" CURVE 0x1A4B1C ZF_kl_si16_S5_S3 0.99 UMR___1_100_0_S5_S3 0.01 1
 /begin AXIS_DESCR STD_AXIS NO_INPUT_QUANTITY UMR_MA_SEC_1_1_0_S5_S3 6 -32768 32767 DEPOSIT ABSOLUTE /end AXIS_DESCR
/end CHARACTERISTIC
/begin CHARACTERISTIC KL_UNTERDRNGNMOT "VM-Gradientenabhängiger Offset für Reduzierender ME bei Unterschreitung von n_mot_solleer" CURVE 0x1A8780 ZF_kl_si16_S5_S3 1000 UMR_U_MIN_1_1_0_S5_S3 0 1000
 /begin AXIS_DESCR STD_AXIS iItfInput.ng_mot UMR_U_MINSEC_1_1_0_S5_S3 4 -10000 10000 DEPOSIT ABSOLUTE /end AXIS_DESCR
/end CHARACTERISTIC
/begin CHARACTERISTIC K_FMEHAUPTA_1 "Filterkonstante (aehnl INPT) Start Hauptmotoreingriff" VALUE 0x1D8516 ZF_kw_si16_S5_S3 65.535 UMR___1_1000_0_S5_S3 -32.768 32.767 /end CHARACTERISTIC
/begin CHARACTERISTIC K_FMEHAUPTA_2 "Filterkonstante (aehnl INPT) Start Hauptmotoreingriff" VALUE 0x1D851C ZF_kw_si16_S5_S3 65.535 UMR___1_1000_0_S5_S3 -32.768 32.767 /end CHARACTERISTIC
/begin CHARACTERISTIC K_FMEHAUPTA_3 "Filterkonstante (aehnl INPT) Start Hauptmotoreingriff" VALUE 0x1D8522 ZF_kw_si16_S5_S3 65.535 UMR___1_1000_0_S5_S3 -32.768 32.767 /end CHARACTERISTIC
/begin CHARACTERISTIC K_FMEHAUPTA_4 "Filterkonstante (aehnl INPT) Start Hauptmotoreingriff" VALUE 0x1D8528 ZF_kw_si16_S5_S3 65.535 UMR___1_1000_0_S5_S3 -32.768 32.767 /end CHARACTERISTIC
/begin CHARACTERISTIC K_FMEHAUPTA_5 "Filterkonstante (aehnl INPT) Start Hauptmotoreingriff" VALUE 0x1D852E ZF_kw_si16_S5_S3 65.535 UMR___1_1000_0_S5_S3 -32.768 32.767 /end CHARACTERISTIC
/begin CHARACTERISTIC K_FMEHAUPTA_6 "Filterkonstante (aehnl INPT) Start Hauptmotoreingriff" VALUE 0x1D8534 ZF_kw_si16_S5_S3 65.535 UMR___1_1000_0_S5_S3 -32.768 32.767 /end CHARACTERISTIC
/begin CHARACTERISTIC K_FMEHAUPTA_7 "Filterkonstante (aehnl INPT) Start Hauptmotoreingriff" VALUE 0x1D853A ZF_kw_si16_S5_S3 65.535 UMR___1_1000_0_S5_S3 -32.768 32.767 /end CHARACTERISTIC
/begin CHARACTERISTIC MDT_IGEDS_HYSKOMP "Filterzeit Sollstromgradient" VALUE 0x1D7837 ZF_kw_ui8_S5_S3 0.99 UMR___1_100_0_S5_S3 0.01 1 /end CHARACTERISTIC
/begin CHARACTERISTIC MDT_PGABSSOLL_HYSKOMP "Filterzeit Solldruckgradient" VALUE 0x1D7836 ZF_kw_ui8_S5_S3 0.99 UMR___1_100_0_S5_S3 0.01 1 /end CHARACTERISTIC
/begin CHARACTERISTIC MDT_V_HYSKOMP "DT1-Filterkonstante zur Gradientenberechnung des po_wirk" VALUE 0x1D7838 ZF_kw_ui8_S5_S3 0.99 UMR___1_100_0_S5_S3 0.01 1 /end CHARACTERISTIC
/begin CHARACTERISTIC M_SOLL_MIN_ENTKOPPL "Min-Begrenzung von m_soll_iae nach unten" VALUE 0x1D8430 ZF_kw_si16_S5_S3 1000 UMR_NM__1_1_0_S5_S3 -1000 0 /end CHARACTERISTIC
/begin CHARACTERISTIC NDS_ZU_ENTKOPPL "Differenzdrehzahlschwelle für Geschlossen-Erkennung in der Entkopplungsfunktion" VALUE 0x1D842A ZF_kw_si16_S5_S3 100 UMR_U_MIN_1_1_0_S5_S3 0 100 /end CHARACTERISTIC
/begin CHARACTERISTIC ND_MEHAUPTAGE_1 "Drehzahlkriterium Start Haupt-ME Gangeinlegen" VALUE 0x1D8512 ZF_kw_si16_S5_S3 1000 UMR_U_MIN_1_1_0_S5_S3 0 1000 /end CHARACTERISTIC
/begin CHARACTERISTIC ND_MEHAUPTAGE_2 "Drehzahlkriterium Start Haupt-ME Gangeinlegen" VALUE 0x1D8518 ZF_kw_si16_S5_S3 1000 UMR_U_MIN_1_1_0_S5_S3 0 1000 /end CHARACTERISTIC
/begin CHARACTERISTIC ND_MEHAUPTAGE_3 "Drehzahlkriterium Start Haupt-ME Gangeinlegen" VALUE 0x1D851E ZF_kw_si16_S5_S3 1000 UMR_U_MIN_1_1_0_S5_S3 0 1000 /end CHARACTERISTIC
/begin CHARACTERISTIC ND_MEHAUPTAGE_4 "Drehzahlkriterium Start Haupt-ME Gangeinlegen" VALUE 0x1D8524 ZF_kw_si16_S5_S3 1000 UMR_U_MIN_1_1_0_S5_S3 0 1000 /end CHARACTERISTIC
/begin CHARACTERISTIC ND_MEHAUPTAGE_5 "Drehzahlkriterium Start Haupt-ME Gangeinlegen" VALUE 0x1D852A ZF_kw_si16_S5_S3 1000 UMR_U_MIN_1_1_0_S5_S3 0 1000 /end CHARACTERISTIC
/begin CHARACTERISTIC ND_MEHAUPTAGE_6 "Drehzahlkriterium Start Haupt-ME Gangeinlegen" VALUE 0x1D8530 ZF_kw_si16_S5_S3 1000 UMR_U_MIN_1_1_0_S5_S3 0 1000 /end CHARACTERISTIC
/begin CHARACTERISTIC ND_MEHAUPTAGE_7 "Drehzahlkriterium Start Haupt-ME Gangeinlegen" VALUE 0x1D8536 ZF_kw_si16_S5_S3 1000 UMR_U_MIN_1_1_0_S5_S3 0 1000 /end CHARACTERISTIC
/begin CHARACTERISTIC ND_MEPOSHAUPTA "Drehzahlkriterium für Start Hauptmotoreingriff bei POSME Anforderung" VALUE 0x1D850A ZF_kw_ui16_S5_S3 8000 UMR_U_MIN_1_1_0_S5_S3 0 8000 /end CHARACTERISTIC
/begin CHARACTERISTIC NS_HYS_UNTERDR_ME "Hysterese der Drehzahlschwelle für deaktivierung Motoreingriffsunterdrückung" VALUE 0x1D8506 ZF_kw_ui16_S5_S3 500 UMR_U_MIN_1_1_0_S5_S3 0 500 /end CHARACTERISTIC
/begin CHARACTERISTIC PGS_A_HYSKOMP "Gradientenschwelle für Richtungsumschaltung" VALUE 0x1D8432 ZF_kw_ui16_S5_S3 0.999 UMR_BAR_SEC_1_1000_0_S5_S3 0.001 1 /end CHARACTERISTIC
/begin CHARACTERISTIC PGS_B_HYSKOMP "Gradientenschwelle für Richtungsumschaltung" VALUE 0x1D8442 ZF_kw_ui16_S5_S3 0.999 UMR_BAR_SEC_1_1000_0_S5_S3 0.001 1 /end CHARACTERISTIC
/begin CHARACTERISTIC PGS_C_HYSKOMP "Gradientenschwelle für Richtungsumschaltung" VALUE 0x1D8452 ZF_kw_ui16_S5_S3 0.999 UMR_BAR_SEC_1_1000_0_S5_S3 0.001 1 /end CHARACTERISTIC
/begin CHARACTERISTIC PGS_D_HYSKOMP "Gradientenschwelle für Richtungsumschaltung" VALUE 0x1D8462 ZF_kw_ui16_S5_S3 0.999 UMR_BAR_SEC_1_1000_0_S5_S3 0.001 1 /end CHARACTERISTIC
/begin CHARACTERISTIC PGS_E_HYSKOMP "Gradientenschwelle für Richtungsumschaltung" VALUE 0x1D8472 ZF_kw_ui16_S5_S3 0.999 UMR_BAR_SEC_1_1000_0_S5_S3 0.001 1 /end CHARACTERISTIC
/begin CHARACTERISTIC PGS_K0_HYSKOMP "Gradientenschwelle für Richtungsumschaltung" VALUE 0x1D8482 ZF_kw_ui16_S5_S3 0.999 UMR_BAR_SEC_1_1000_0_S5_S3 0.001 1 /end CHARACTERISTIC
/begin CHARACTERISTIC PO_MAX_V_A_HYSKOMP "Obere Verzugskompensationsbreitenbegrenzung" VALUE 0x1D843A ZF_kw_si16_S5_S3 1 UMR_BAR__1_1000_0_S5_S3 0 1 /end CHARACTERISTIC
/begin CHARACTERISTIC PO_MAX_V_B_HYSKOMP "Obere Verzugskompensationsbreitenbegrenzung" VALUE 0x1D844A ZF_kw_si16_S5_S3 1 UMR_BAR__1_1000_0_S5_S3 0 1 /end CHARACTERISTIC
/begin CHARACTERISTIC PO_MAX_V_C_HYSKOMP "Obere Verzugskompensationsbreitenbegrenzung" VALUE 0x1D845A ZF_kw_si16_S5_S3 1 UMR_BAR__1_1000_0_S5_S3 0 1 /end CHARACTERISTIC
/begin CHARACTERISTIC PO_MAX_V_D_HYSKOMP "Obere Verzugskompensationsbreitenbegrenzung" VALUE 0x1D846A ZF_kw_si16_S5_S3 1 UMR_BAR__1_1000_0_S5_S3 0 1 /end CHARACTERISTIC
/begin CHARACTERISTIC PO_MAX_V_E_HYSKOMP "Obere Verzugskompensationsbreitenbegrenzung" VALUE 0x1D847A ZF_kw_si16_S5_S3 1 UMR_BAR__1_1000_0_S5_S3 0 1 /end CHARACTERISTIC
/begin CHARACTERISTIC PO_MAX_V_K0_HYSKOMP "Obere Verzugskompensationsbreitenbegrenzung" VALUE 0x1D848A ZF_kw_si16_S5_S3 1 UMR_BAR__1_1000_0_S5_S3 0 1 /end CHARACTERISTIC
/begin CHARACTERISTIC PO_MIN_V_A_HYSKOMP "Untere Verzugskompensationsbreitenbegrenzung" VALUE 0x1D843C ZF_kw_si16_S5_S3 1 UMR_BAR__1_1000_0_S5_S3 -1 0 /end CHARACTERISTIC
/begin CHARACTERISTIC PO_MIN_V_B_HYSKOMP "Untere Verzugskompensationsbreitenbegrenzung" VALUE 0x1D844C ZF_kw_si16_S5_S3 1 UMR_BAR__1_1000_0_S5_S3 -1 0 /end CHARACTERISTIC
/begin CHARACTERISTIC PO_MIN_V_C_HYSKOMP "Untere Verzugskompensationsbreitenbegrenzung" VALUE 0x1D845C ZF_kw_si16_S5_S3 1 UMR_BAR__1_1000_0_S5_S3 -1 0 /end CHARACTERISTIC
/begin CHARACTERISTIC PO_MIN_V_D_HYSKOMP "Untere Verzugskompensationsbreitenbegrenzung" VALUE 0x1D846C ZF_kw_si16_S5_S3 1 UMR_BAR__1_1000_0_S5_S3 -1 0 /end CHARACTERISTIC
/begin CHARACTERISTIC PO_MIN_V_E_HYSKOMP "Untere Verzugskompensationsbreitenbegrenzung" VALUE 0x1D847C ZF_kw_si16_S5_S3 1 UMR_BAR__1_1000_0_S5_S3 -1 0 /end CHARACTERISTIC
/begin CHARACTERISTIC PO_MIN_V_K0_HYSKOMP "Untere Verzugskompensationsbreitenbegrenzung" VALUE 0x1D848C ZF_kw_si16_S5_S3 1 UMR_BAR__1_1000_0_S5_S3 -1 0 /end CHARACTERISTIC
/begin CHARACTERISTIC PO_SAEND "Druckoffset auf max. Gesamtdruck" VALUE 0x1D8492 ZF_kw_si16_S5_S3 12.7 UMR_BAR__1_1000_0_S5_S3 0 12.7 /end CHARACTERISTIC
/begin CHARACTERISTIC PS_INIT_HYS_V_A_HYSKOMP "Initialisierungsschwelle Hysterese fuer den Funktionsausstieg" VALUE 0x1D8440 ZF_kw_si16_S5_S3 2 UMR_BAR__1_1000_0_S5_S3 0 2 /end CHARACTERISTIC
/begin CHARACTERISTIC PS_INIT_HYS_V_B_HYSKOMP "Initialisierungsschwelle Hysterese fuer den Funktionsausstieg" VALUE 0x1D8450 ZF_kw_si16_S5_S3 2 UMR_BAR__1_1000_0_S5_S3 0 2 /end CHARACTERISTIC
/begin CHARACTERISTIC PS_INIT_HYS_V_C_HYSKOMP "Initialisierungsschwelle Hysterese fuer den Funktionsausstieg" VALUE 0x1D8460 ZF_kw_si16_S5_S3 2 UMR_BAR__1_1000_0_S5_S3 0 2 /end CHARACTERISTIC
/begin CHARACTERISTIC PS_INIT_HYS_V_D_HYSKOMP "Initialisierungsschwelle Hysterese fuer den Funktionsausstieg" VALUE 0x1D8470 ZF_kw_si16_S5_S3 2 UMR_BAR__1_1000_0_S5_S3 0 2 /end CHARACTERISTIC
/begin CHARACTERISTIC PS_INIT_HYS_V_E_HYSKOMP "Initialisierungsschwelle Hysterese fuer den Funktionsausstieg" VALUE 0x1D8480 ZF_kw_si16_S5_S3 2 UMR_BAR__1_1000_0_S5_S3 0 2 /end CHARACTERISTIC
/begin CHARACTERISTIC PS_INIT_HYS_V_K0_HYSKOMP "Initialisierungsschwelle Hysterese fuer den Funktionsausstieg" VALUE 0x1D8490 ZF_kw_si16_S5_S3 2 UMR_BAR__1_1000_0_S5_S3 0 2 /end CHARACTERISTIC
/begin CHARACTERISTIC PS_INIT_V_A_HYSKOMP "Initialisierungsdruckschwelle fuer den Funktionseinstieg" VALUE 0x1D843E ZF_kw_si16_S5_S3 4 UMR_BAR__1_1000_0_S5_S3 -2 2 /end CHARACTERISTIC
/begin CHARACTERISTIC PS_INIT_V_B_HYSKOMP "Initialisierungsdruckschwelle fuer den Funktionseinstieg" VALUE 0x1D844E ZF_kw_si16_S5_S3 4 UMR_BAR__1_1000_0_S5_S3 -2 2 /end CHARACTERISTIC
/begin CHARACTERISTIC PS_INIT_V_C_HYSKOMP "Initialisierungsdruckschwelle fuer den Funktionseinstieg" VALUE 0x1D845E ZF_kw_si16_S5_S3 4 UMR_BAR__1_1000_0_S5_S3 -2 2 /end CHARACTERISTIC
/begin CHARACTERISTIC PS_INIT_V_D_HYSKOMP "Initialisierungsdruckschwelle fuer den Funktionseinstieg" VALUE 0x1D846E ZF_kw_si16_S5_S3 4 UMR_BAR__1_1000_0_S5_S3 -2 2 /end CHARACTERISTIC
/begin CHARACTERISTIC PS_INIT_V_E_HYSKOMP "Initialisierungsdruckschwelle fuer den Funktionseinstieg" VALUE 0x1D847E ZF_kw_si16_S5_S3 4 UMR_BAR__1_1000_0_S5_S3 -2 2 /end CHARACTERISTIC
/begin CHARACTERISTIC PS_INIT_V_K0_HYSKOMP "Initialisierungsdruckschwelle fuer den Funktionseinstieg" VALUE 0x1D848E ZF_kw_si16_S5_S3 4 UMR_BAR__1_1000_0_S5_S3 -2 2 /end CHARACTERISTIC
/begin CHARACTERISTIC SWI_ABGLDAT "Schalter Verwendung appl. Daten (Mittelkl.) der EDSKV-KL" VALUE 0x1D7835 ZF_kw_bool8_S5_S3 1 UMR___1_1_0_S5_S3 0 1 /end CHARACTERISTIC
/begin CHARACTERISTIC SWI_AKTIV_A_HYSKOMP "Kompensation 0=aus, 1=KUP aktiv, 2=STG aktiv, 3=Beide aktiv" VALUE 0x1D7839 ZF_kw_ui8_S5_S3 3 UMR___1_1_0_S5_S3 0 3 /end CHARACTERISTIC
/begin CHARACTERISTIC SWI_AKTIV_B_HYSKOMP "Kompensation 0=aus, 1=KUP aktiv, 2=STG aktiv, 3=Beide aktiv" VALUE 0x1D783B ZF_kw_ui8_S5_S3 3 UMR___1_1_0_S5_S3 0 3 /end CHARACTERISTIC
/begin CHARACTERISTIC SWI_AKTIV_C_HYSKOMP "Kompensation 0=aus, 1=KUP aktiv, 2=STG aktiv, 3=Beide aktiv" VALUE 0x1D783D ZF_kw_ui8_S5_S3 3 UMR___1_1_0_S5_S3 0 3 /end CHARACTERISTIC
/begin CHARACTERISTIC SWI_AKTIV_D_HYSKOMP "Kompensation 0=aus, 1=KUP aktiv, 2=STG aktiv, 3=Beide aktiv" VALUE 0x1D783F ZF_kw_ui8_S5_S3 3 UMR___1_1_0_S5_S3 0 3 /end CHARACTERISTIC
/begin CHARACTERISTIC SWI_AKTIV_E_HYSKOMP "Kompensation 0=aus, 1=KUP aktiv, 2=STG aktiv, 3=Beide aktiv" VALUE 0x1D7841 ZF_kw_ui8_S5_S3 3 UMR___1_1_0_S5_S3 0 3 /end CHARACTERISTIC
/begin CHARACTERISTIC SWI_AKTIV_K0_HYSKOMP "Kompensation 0=aus, 1=KUP aktiv, 2=STG aktiv, 3=Beide aktiv" VALUE 0x1D7843 ZF_kw_ui8_S5_S3 3 UMR___1_1_0_S5_S3 0 3 /end CHARACTERISTIC
/begin CHARACTERISTIC SWI_AKTIV_V_A_HYSKOMP "Kupplungsverzugskompensation 0=aus, 1=KUP aktiv" VALUE 0x1D783A ZF_kw_ui8_S5_S3 1 UMR___1_1_0_S5_S3 0 1 /end CHARACTERISTIC
/begin CHARACTERISTIC SWI_AKTIV_V_B_HYSKOMP "Kupplungsverzugskompensation 0=aus, 1=KUP aktiv" VALUE 0x1D783C ZF_kw_ui8_S5_S3 1 UMR___1_1_0_S5_S3 0 1 /end CHARACTERISTIC
/begin CHARACTERISTIC SWI_AKTIV_V_C_HYSKOMP "Kupplungsverzugskompensation 0=aus, 1=KUP aktiv" VALUE 0x1D783E ZF_kw_ui8_S5_S3 1 UMR___1_1_0_S5_S3 0 1 /end CHARACTERISTIC
/begin CHARACTERISTIC SWI_AKTIV_V_D_HYSKOMP "Kupplungsverzugskompensation 0=aus, 1=KUP aktiv" VALUE 0x1D7840 ZF_kw_ui8_S5_S3 1 UMR___1_1_0_S5_S3 0 1 /end CHARACTERISTIC
/begin CHARACTERISTIC SWI_AKTIV_V_E_HYSKOMP "Kupplungsverzugskompensation 0=aus, 1=KUP aktiv" VALUE 0x1D7842 ZF_kw_ui8_S5_S3 1 UMR___1_1_0_S5_S3 0 1 /end CHARACTERISTIC
/begin CHARACTERISTIC SWI_AKTIV_V_K0_HYSKOMP "Kupplungsverzugskompensation 0=aus, 1=KUP aktiv" VALUE 0x1D7844 ZF_kw_ui8_S5_S3 1 UMR___1_1_0_S5_S3 0 1 /end CHARACTERISTIC
/begin CHARACTERISTIC SWI_GLOBALSTROMSCHL "Übergeordnete Zuordnung Stromschleife." VALUE 0x1D7845 ZF_kw_ui8_S5_S3 2 UMR_SEC__1_1_0_S5_S3 0 2 /end CHARACTERISTIC
/begin CHARACTERISTIC SWI_MESCHLEPP "Schalter für wieder Ausgabe ME bei Schleppstart" VALUE 0x1D7858 ZF_kw_bool8_S5_S3 1 UMR___1_1_0_S5_S3 0 1 /end CHARACTERISTIC
/begin CHARACTERISTIC SWI_MO_ENTKOPPL "Schalter zur Aktivierung des Momentenoffsets im Entkoppeln" VALUE 0x1D7834 ZF_kw_bool8_S5_S3 1 UMR___1_1_0_S5_S3 0 1 /end CHARACTERISTIC
/begin CHARACTERISTIC SWI_MSTSSCHR "Schalter Motoreingriff bei Schrittschaltung" VALUE 0x1D7855 ZF_kw_bool8_S5_S3 1 UMR___1_1_0_S5_S3 0 1 /end CHARACTERISTIC
/begin CHARACTERISTIC SWI_UNTERDR_ME "Schalter zur aktivierung Motoreingriffsunterdrückung bei unterschrittener Motorleerlaufdrehzahl" VALUE 0x1D7853 ZF_kw_bool8_S5_S3 1 UMR___1_1_0_S5_S3 0 1 /end CHARACTERISTIC
/begin CHARACTERISTIC TAB_F_MGVMSOLLGEMVOR_K0 "[-], Gewichtungsfaktor für D-Anteil der Vorsteuerung. 0: für Lastrücknahme, 1: für Lastzugabe" MAP 0x1A3220 ZF_tab2d_fl32_S5_S3 2 UMR___1_1_0_S5_S3 -1 1
 /begin AXIS_DESCR FIX_AXIS iK0sKorSignale.idx_zs_zug_k0 UMR___1_1_0_S5_S3 2 0 1 READ_ONLY FIX_AXIS_PAR_DIST 0 1 2 /end AXIS_DESCR
 /begin AXIS_DESCR FIX_AXIS NO_INPUT_QUANTITY UMR___1_1_0_S5_S3 2 0 1 READ_ONLY FORMAT "%3.2" FIX_AXIS_PAR_DIST 0 1 2 /end AXIS_DESCR
 FORMAT "%3.2" /end CHARACTERISTIC
/begin CHARACTERISTIC TAB_F_MGVMSOLLGEMVOR_K0_SP "[-], Gewichtungsfaktor für D-Anteil der Vorsteuerung. 0: für Lastrücknahme, 1: für Lastzugabe" MAP 0x1A34E0 ZF_tab2d_fl32_S5_S3 2 UMR___1_1_0_S5_S3 -1 1
 /begin AXIS_DESCR FIX_AXIS iK0sKorSignale.idx_zs_zug_k0 UMR___1_1_0_S5_S3 2 0 1 READ_ONLY FIX_AXIS_PAR_DIST 0 1 2 /end AXIS_DESCR
 /begin AXIS_DESCR FIX_AXIS NO_INPUT_QUANTITY UMR___1_1_0_S5_S3 2 0 1 READ_ONLY FORMAT "%3.2" FIX_AXIS_PAR_DIST 0 1 2 /end AXIS_DESCR
 FORMAT "%3.2" /end CHARACTERISTIC
/begin CHARACTERISTIC TAB_MOZIEL_ENTKOPPL "Momentenendwert des Momentenoffsets im Entkoppeln" CURVE 0x1A39F4 ZF_tab_si16_S5_S3 2000 UMR_NM__1_1_0_S5_S3 -1000 1000
 /begin AXIS_DESCR FIX_AXIS NO_INPUT_QUANTITY UMR___1_1_0_S5_S3 10 -1 8 READ_ONLY FIX_AXIS_PAR_DIST -1 1 10 /end AXIS_DESCR
/end CHARACTERISTIC
/begin CHARACTERISTIC TAB_MPT_MOLWGERGES_K0 "Filterkonstante zum Abfiltern des gesteuerten Momentenoffsets in GEREGELTGESCHLOSSEN" CURVE 0x1A3214 ZF_tab_fl32_S5_S3 0.99 UMR___1_1_0_S5_S3 0.01 1
 /begin AXIS_DESCR FIX_AXIS iK0sKorSignale.idx_zs_zug_k0 UMR___1_1_0_S5_S3 2 0 1 READ_ONLY FIX_AXIS_PAR_DIST 0 1 2 /end AXIS_DESCR
 FORMAT "%3.2" /end CHARACTERISTIC
/begin CHARACTERISTIC TAB_MPT_MOLWGERGES_K0_SP "Filterkonstante zum Abfiltern des gesteuerten Momentenoffsets in GEREGELTGESCHLOSSEN" CURVE 0x1A34D4 ZF_tab_fl32_S5_S3 0.99 UMR___1_1_0_S5_S3 0.01 1
 /begin AXIS_DESCR FIX_AXIS iK0sKorSignale.idx_zs_zug_k0 UMR___1_1_0_S5_S3 2 0 1 READ_ONLY FIX_AXIS_PAR_DIST 0 1 2 /end AXIS_DESCR
 FORMAT "%3.2" /end CHARACTERISTIC
/begin CHARACTERISTIC TAB_MPT_MOLWSPFGER_K0 "[-], Gewichtungsfaktor für D-Anteil der Vorsteuerung. 0: für Lastrücknahme, 1: für Lastzugabe" CURVE 0x1A3208 ZF_tab_fl32_S5_S3 0.99 UMR___1_1_0_S5_S3 0.01 1
 /begin AXIS_DESCR FIX_AXIS iK0sKorSignale.idx_zs_zug_k0 UMR___1_1_0_S5_S3 2 0 1 READ_ONLY FIX_AXIS_PAR_DIST 0 1 2 /end AXIS_DESCR
 FORMAT "%3.2" /end CHARACTERISTIC
/begin CHARACTERISTIC TAB_MPT_MOLWSPFGER_K0_SP "[-], Gewichtungsfaktor für D-Anteil der Vorsteuerung. 0: für Lastrücknahme, 1: für Lastzugabe" CURVE 0x1A34C8 ZF_tab_fl32_S5_S3 0.99 UMR___1_1_0_S5_S3 0.01 1
 /begin AXIS_DESCR FIX_AXIS iK0sKorSignale.idx_zs_zug_k0 UMR___1_1_0_S5_S3 2 0 1 READ_ONLY FIX_AXIS_PAR_DIST 0 1 2 /end AXIS_DESCR
 FORMAT "%3.2" /end CHARACTERISTIC
/begin CHARACTERISTIC TAB_MPT_MO_ENTKOPPL "Filterwert des Momentenoffsets im Entkoppeln" CURVE 0x1A3A0C ZF_tab_ui8_S5_S3 0.99 UMR___1_100_0_S5_S3 0.01 1
 /begin AXIS_DESCR FIX_AXIS NO_INPUT_QUANTITY UMR___1_1_0_S5_S3 10 -1 8 READ_ONLY FIX_AXIS_PAR_DIST -1 1 10 /end AXIS_DESCR
/end CHARACTERISTIC
/begin CHARACTERISTIC TAB_MPT_MSCHALTAUF_K0_SP "Filterzeitkonstante für PT1-Filter für Aufschaltung Schaltmoment" MAP 0x1A2358 ZF_tab2d_fl32_S5_S3 0.99 UMR___1_1_0_S5_S3 0.01 1
 /begin AXIS_DESCR FIX_AXIS iK0sKorSignale.zs_zug_k0 UMR___1_1_0_S5_S3 2 0 1 READ_ONLY FIX_AXIS_PAR_DIST 0 1 2 /end AXIS_DESCR
 /begin AXIS_DESCR FIX_AXIS iK0sShLog.idx_schaltung_k0 UMR___1_1_0_S5_S3 5 0 4 READ_ONLY FIX_AXIS_PAR_DIST 0 1 5 /end AXIS_DESCR
 FORMAT "%3.2" /end CHARACTERISTIC
/begin CHARACTERISTIC TAB_MSLASTFREI_ENTKOPPL "Momentenschwellwert, innerhalb welchem der lastfreie Bereich der Entkopplungsfunktion erkannt wird" CURVE 0x1A3944 ZF_tab_si16_S5_S3 255 UMR_NM__1_1_0_S5_S3 0 255
 /begin AXIS_DESCR FIX_AXIS NO_INPUT_QUANTITY UMR___1_1_0_S5_S3 10 -1 8 READ_ONLY FIX_AXIS_PAR_DIST -1 1 10 /end AXIS_DESCR
/end CHARACTERISTIC
/begin CHARACTERISTIC TAB_MS_MOSTART_ENTKOPPL "Momentenschwelle zur Aktivierung des Momentenoffsets im Entkoppeln" CURVE 0x1A39DC ZF_tab_si16_S5_S3 2000 UMR_NM__1_1_0_S5_S3 -1000 1000
 /begin AXIS_DESCR FIX_AXIS NO_INPUT_QUANTITY UMR___1_1_0_S5_S3 10 -1 8 READ_ONLY FIX_AXIS_PAR_DIST -1 1 10 /end AXIS_DESCR
/end CHARACTERISTIC
/begin CHARACTERISTIC TAB_PMAXKV "Max.druck 0-2=Dummy; 3=KV_A; 4=KV_B; 5=Dummy; 6=KV_C; 7=Dummy; 8=KV_D; 9=KV_E;" CURVE 0x1A4C9C ZF_tab_ui16_S5_S3 12.7 UMR_BAR__1_1000_0_S5_S3 0 12.7
 /begin AXIS_DESCR FIX_AXIS NO_INPUT_QUANTITY UMR___1_1_0_S5_S3 10 0 9 READ_ONLY FIX_AXIS_PAR_DIST 0 1 10 /end AXIS_DESCR
/end CHARACTERISTIC
/begin CHARACTERISTIC TAB_SWIKUPPSTROMSCHL "Schalter kupplungsabhängige Stromschleife (0=aus, 1=ein)" CURVE 0x1A4C90 ZF_tab_bool8_S5_S3 1 UMR___1_1_0_S5_S3 0 1
 /begin AXIS_DESCR FIX_AXIS NO_INPUT_QUANTITY UMR___1_1_0_S5_S3 6 0 5 READ_ONLY FIX_AXIS_PAR_DIST 0 1 6 /end AXIS_DESCR
/end CHARACTERISTIC
/begin CHARACTERISTIC TAB_SWISTROMSCHL "Schalter gangabhängige Stromschleife (0=aus, 1=ein, 2=sp aus, 3=sport/amax aus)" MAP 0x1A4C24 ZF_tab2d_ui8_S5_S3 3 UMR___1_1_0_S5_S3 0 3
 /begin AXIS_DESCR FIX_AXIS zff_atsys._.iSignale._.obj.sig_istgang UMR___1_1_0_S5_S3 10 -1 8 READ_ONLY FIX_AXIS_PAR_DIST -1 1 10 /end AXIS_DESCR
 /begin AXIS_DESCR FIX_AXIS zff_atsys._.iSignale._.obj.sig_zielgang UMR___1_1_0_S5_S3 10 -1 8 READ_ONLY FIX_AXIS_PAR_DIST -1 1 10 /end AXIS_DESCR
/end CHARACTERISTIC
/begin CHARACTERISTIC TAB_SWI_MEPOSHS "Aktivierung positiver Motoreingriff aus Index" CURVE 0x1A8828 ZF_tab_bool8_S5_S3 1 UMR___1_1_0_S5_S3 0 1
 /begin AXIS_DESCR FIX_AXIS zff_atsys._.iSignale._.obj.sig_index_sp_sps UMR___1_1_0_S5_S3 100 0 99 READ_ONLY FIX_AXIS_PAR_DIST 0 1 100 /end AXIS_DESCR
/end CHARACTERISTIC
/begin CHARACTERISTIC TAB_SWI_MEPOSHSVOR "Aktivierung positiver voreilender ME aus Index" CURVE 0x1A88F8 ZF_tab_bool8_S5_S3 1 UMR___1_1_0_S5_S3 0 1
 /begin AXIS_DESCR FIX_AXIS zff_atsys._.iSignale._.obj.sig_index_sp_sps UMR___1_1_0_S5_S3 100 0 99 READ_ONLY FIX_AXIS_PAR_DIST 0 1 100 /end AXIS_DESCR
/end CHARACTERISTIC
/begin CHARACTERISTIC TAB_SWI_MEPOSRS "Aktivierung positiver Motoreingriff aus Index" CURVE 0x1A87C0 ZF_tab_bool8_S5_S3 1 UMR___1_1_0_S5_S3 0 1
 /begin AXIS_DESCR FIX_AXIS zff_atsys._.iSignale._.obj.sig_index_sp_sps UMR___1_1_0_S5_S3 100 0 99 READ_ONLY FIX_AXIS_PAR_DIST 0 1 100 /end AXIS_DESCR
/end CHARACTERISTIC
/begin CHARACTERISTIC TAB_SWI_MEPOSRSVOR "Aktivierung positiver voreilender ME aus Index" CURVE 0x1A8890 ZF_tab_bool8_S5_S3 1 UMR___1_1_0_S5_S3 0 1
 /begin AXIS_DESCR FIX_AXIS zff_atsys._.iSignale._.obj.sig_index_sp_sps UMR___1_1_0_S5_S3 100 0 99 READ_ONLY FIX_AXIS_PAR_DIST 0 1 100 /end AXIS_DESCR
/end CHARACTERISTIC
/begin CHARACTERISTIC TAB_SWI_PREPULS "Schalter Prepuls Schnellfuellung (0=inaktiv, 1=aktiv, 2=norm/sp aktiv, 3=sport/sp aktiv, 4=sport aktiv)" MAP 0x1A4CB4 ZF_tab2d_ui8_S5_S3 4 UMR___1_1_0_S5_S3 0 4
 /begin AXIS_DESCR FIX_AXIS zff_atsys._.iSignale._.obj.sig_istgang UMR___1_1_0_S5_S3 10 -1 8 READ_ONLY FIX_AXIS_PAR_DIST -1 1 10 /end AXIS_DESCR
 /begin AXIS_DESCR FIX_AXIS zff_atsys._.iSignale._.obj.sig_zielgang UMR___1_1_0_S5_S3 10 -1 8 READ_ONLY FIX_AXIS_PAR_DIST -1 1 10 /end AXIS_DESCR
/end CHARACTERISTIC
/begin CHARACTERISTIC TAB_TSLASTFREI_ENTKOPPL "Rampenzeit, innerhalb des lastfreien Bereichs der Entkopplungsfunktion" CURVE 0x1A395C ZF_tab_ui16_S5_S3 2550 UMR_MSEC__10_1_0_S5_S3 0 2550
 /begin AXIS_DESCR FIX_AXIS NO_INPUT_QUANTITY UMR___1_1_0_S5_S3 10 -1 8 READ_ONLY FIX_AXIS_PAR_DIST -1 1 10 /end AXIS_DESCR
/end CHARACTERISTIC
/begin CHARACTERISTIC TAB_T_MOLWGERGES_K0 "Dauer des Gesteuerten Momentenoffset in GEREGELTGESCHLOSSEN" CURVE 0x1A3240 ZF_tab_ui8_S5_S3 1990 UMR_MSEC__10_1_0_S5_S3 10 2000
 /begin AXIS_DESCR FIX_AXIS iK0sKorSignale.idx_zs_zug_k0 UMR___1_1_0_S5_S3 2 0 1 READ_ONLY FIX_AXIS_PAR_DIST 0 1 2 /end AXIS_DESCR
/end CHARACTERISTIC
/begin CHARACTERISTIC TAB_T_MOLWGERGES_K0_SP "Dauer des Gesteuerten Momentenoffset in GEREGELTGESCHLOSSEN" CURVE 0x1A3500 ZF_tab_ui8_S5_S3 1990 UMR_MSEC__10_1_0_S5_S3 10 2000
 /begin AXIS_DESCR FIX_AXIS iK0sKorSignale.idx_zs_zug_k0 UMR___1_1_0_S5_S3 2 0 1 READ_ONLY FIX_AXIS_PAR_DIST 0 1 2 /end AXIS_DESCR
/end CHARACTERISTIC
/begin CHARACTERISTIC TAB_T_MOLWSPFGER_K0 "[ms]. Dauer des Momentenoffset beim Zug/Schub Wechsel in SCHLUPFGEREGELT" CURVE 0x1A3238 ZF_tab_ui8_S5_S3 1990 UMR_MSEC__10_1_0_S5_S3 10 2000
 /begin AXIS_DESCR FIX_AXIS iK0sKorSignale.idx_zs_zug_k0 UMR___1_1_0_S5_S3 2 0 1 READ_ONLY FIX_AXIS_PAR_DIST 0 1 2 /end AXIS_DESCR
/end CHARACTERISTIC
/begin CHARACTERISTIC TAB_T_MOLWSPFGER_K0_SP "[ms]. Dauer des Momentenoffset beim Zug/Schub Wechsel in SCHLUPFGEREGELT" CURVE 0x1A34F8 ZF_tab_ui8_S5_S3 1990 UMR_MSEC__10_1_0_S5_S3 10 2000
 /begin AXIS_DESCR FIX_AXIS iK0sKorSignale.idx_zs_zug_k0 UMR___1_1_0_S5_S3 2 0 1 READ_ONLY FIX_AXIS_PAR_DIST 0 1 2 /end AXIS_DESCR
/end CHARACTERISTIC
/begin CHARACTERISTIC TAB_T_PT2_MSCHALTAB_K0_SP "Filterzeitkonstante für PT2-Filter für Abschaltung Schaltmoment" MAP 0x1A23C4 ZF_tab2d_fl32_S5_S3 1.98 UMR_SEC__1_1_0_S5_S3 0.02 2
 /begin AXIS_DESCR FIX_AXIS iK0sKorSignale.zs_zug_k0 UMR___1_1_0_S5_S3 2 0 1 READ_ONLY FIX_AXIS_PAR_DIST 0 1 2 /end AXIS_DESCR
 /begin AXIS_DESCR FIX_AXIS iK0sShLog.idx_schaltung_k0 UMR___1_1_0_S5_S3 5 0 4 READ_ONLY FIX_AXIS_PAR_DIST 0 1 5 /end AXIS_DESCR
 FORMAT "%4.3" /end CHARACTERISTIC
/begin CHARACTERISTIC TS_KPL_AKTIV "Zeit bis 'Kupplung aktiv' erkannt wird." VALUE 0x1D8494 ZF_kw_ui16_S5_S3 31999 UMR_SEC__1_1_0_S5_S3 1 32000 /end CHARACTERISTIC
/begin CHARACTERISTIC TS_KPL_INAKTIV "Zeit bis 'Kupplung inaktiv' erkannt wird." VALUE 0x1D8496 ZF_kw_ui16_S5_S3 31999 UMR_SEC__1_1_0_S5_S3 1 32000 /end CHARACTERISTIC
/begin CHARACTERISTIC T_FMEHAUPTA_1 "Filterzeit Start Hauptmotoreingriff" VALUE 0x1D8514 ZF_kw_si16_S5_S3 508 UMR_MSEC__1_1_0_S5_S3 -254 254 /end CHARACTERISTIC
/begin CHARACTERISTIC T_FMEHAUPTA_2 "Filterzeit Start Hauptmotoreingriff" VALUE 0x1D851A ZF_kw_si16_S5_S3 508 UMR_MSEC__1_1_0_S5_S3 -254 254 /end CHARACTERISTIC
/begin CHARACTERISTIC T_FMEHAUPTA_3 "Filterzeit Start Hauptmotoreingriff" VALUE 0x1D8520 ZF_kw_si16_S5_S3 508 UMR_MSEC__1_1_0_S5_S3 -254 254 /end CHARACTERISTIC
/begin CHARACTERISTIC T_FMEHAUPTA_4 "Filterzeit Start Hauptmotoreingriff" VALUE 0x1D8526 ZF_kw_si16_S5_S3 508 UMR_MSEC__1_1_0_S5_S3 -254 254 /end CHARACTERISTIC
/begin CHARACTERISTIC T_FMEHAUPTA_5 "Filterzeit Start Hauptmotoreingriff" VALUE 0x1D852C ZF_kw_si16_S5_S3 508 UMR_MSEC__1_1_0_S5_S3 -254 254 /end CHARACTERISTIC
/begin CHARACTERISTIC T_FMEHAUPTA_6 "Filterzeit Start Hauptmotoreingriff" VALUE 0x1D8532 ZF_kw_si16_S5_S3 508 UMR_MSEC__1_1_0_S5_S3 -254 254 /end CHARACTERISTIC
/begin CHARACTERISTIC T_FMEHAUPTA_7 "Filterzeit Start Hauptmotoreingriff" VALUE 0x1D8538 ZF_kw_si16_S5_S3 508 UMR_MSEC__1_1_0_S5_S3 -254 254 /end CHARACTERISTIC
/begin CHARACTERISTIC T_FNGABMESAS "Filterzeit Abtriebsdrehzahlgradient Motoreingriff" VALUE 0x1D8508 ZF_kw_ui16_S5_S3 999 UMR_MSEC__1_1_0_S5_S3 1 1000 /end CHARACTERISTIC
/begin CHARACTERISTIC T_MEMAXHSGE "Maximaldauer Motoreingriff bei Hochschaltungen und Gangeinlegen" VALUE 0x1D7856 ZF_kw_ui8_S5_S3 2540 UMR_MSEC__10_1_0_S5_S3 0 2540 /end CHARACTERISTIC
/begin CHARACTERISTIC T_MEMAXRS "Maximaldauer Motoreingriff bei Rueckschaltungen" VALUE 0x1D7857 ZF_kw_ui8_S5_S3 2540 UMR_MSEC__10_1_0_S5_S3 0 2540 /end CHARACTERISTIC
/begin CHARACTERISTIC T_MSCHALT_K0_SP "[ms] Rampenzeit zum stehen lasssen vom Schaltmoment vordem Abfiltern" VALUE 0x1D8428 ZF_kw_ui16_S5_S3 2000 UMR_MSEC__10_1_0_S5_S3 0 2000 /end CHARACTERISTIC
/begin CHARACTERISTIC T_NDS_ZU_ENTKOPPL "Dauer für Schlupferkennung in der Entkopplungsfunktion" VALUE 0x1D842E ZF_kw_ui16_S5_S3 2550 UMR_MSEC__10_1_0_S5_S3 0 2550 /end CHARACTERISTIC
/begin CHARACTERISTIC T_O1SFAUSSB_A "Schnellfüllzeitoffset erste Befüllung nach Neustart aus Standby" VALUE 0x1D8498 ZF_kw_si16_S5_S3 1270 UMR_MSEC__1_1_0_S5_S3 0 1270 /end CHARACTERISTIC
/begin CHARACTERISTIC T_O1SFAUSSB_B "Schnellfüllzeitoffset erste Befüllung nach Neustart aus Standby" VALUE 0x1D849A ZF_kw_si16_S5_S3 1270 UMR_MSEC__1_1_0_S5_S3 0 1270 /end CHARACTERISTIC
/begin CHARACTERISTIC T_O1SFAUSSB_C "Schnellfüllzeitoffset erste Befüllung nach Neustart aus Standby" VALUE 0x1D849C ZF_kw_si16_S5_S3 1270 UMR_MSEC__1_1_0_S5_S3 0 1270 /end CHARACTERISTIC
/begin CHARACTERISTIC T_O1SFAUSSB_D "Schnellfüllzeitoffset erste Befüllung nach Neustart aus Standby" VALUE 0x1D849E ZF_kw_si16_S5_S3 1270 UMR_MSEC__1_1_0_S5_S3 0 1270 /end CHARACTERISTIC
/begin CHARACTERISTIC T_O1SFAUSSB_E "Schnellfüllzeitoffset erste Befüllung nach Neustart aus Standby" VALUE 0x1D84A0 ZF_kw_si16_S5_S3 1270 UMR_MSEC__1_1_0_S5_S3 0 1270 /end CHARACTERISTIC
/begin CHARACTERISTIC T_O1SFAUSSB_K0 "Schnellfüllzeitoffset erste Befüllung nach Neustart aus Standby" VALUE 0x1D84A2 ZF_kw_si16_S5_S3 1270 UMR_MSEC__1_1_0_S5_S3 0 1270 /end CHARACTERISTIC
/begin CHARACTERISTIC T_RAMEE_1 "Dauer Rampe ME bei Ende Gangeinlegen" VALUE 0x1D785A ZF_kw_ui8_S5_S3 2540 UMR_MSEC__10_1_0_S5_S3 0 2540 /end CHARACTERISTIC
/begin CHARACTERISTIC T_RAMEE_2 "Dauer Rampe ME bei Ende Gangeinlegen" VALUE 0x1D785B ZF_kw_ui8_S5_S3 2540 UMR_MSEC__10_1_0_S5_S3 0 2540 /end CHARACTERISTIC
/begin CHARACTERISTIC T_RAMEE_3 "Dauer Rampe ME bei Ende Gangeinlegen" VALUE 0x1D785C ZF_kw_ui8_S5_S3 2540 UMR_MSEC__10_1_0_S5_S3 0 2540 /end CHARACTERISTIC
/begin CHARACTERISTIC T_RAMEE_4 "Dauer Rampe ME bei Ende Gangeinlegen" VALUE 0x1D785D ZF_kw_ui8_S5_S3 2540 UMR_MSEC__10_1_0_S5_S3 0 2540 /end CHARACTERISTIC
/begin CHARACTERISTIC T_RAMEE_5 "Dauer Rampe ME bei Ende Gangeinlegen" VALUE 0x1D785E ZF_kw_ui8_S5_S3 2540 UMR_MSEC__10_1_0_S5_S3 0 2540 /end CHARACTERISTIC
/begin CHARACTERISTIC T_RAMEE_6 "Dauer Rampe ME bei Ende Gangeinlegen" VALUE 0x1D785F ZF_kw_ui8_S5_S3 2540 UMR_MSEC__10_1_0_S5_S3 0 2540 /end CHARACTERISTIC
/begin CHARACTERISTIC T_RAMEE_7 "Dauer Rampe ME bei Ende Gangeinlegen" VALUE 0x1D7860 ZF_kw_ui8_S5_S3 2540 UMR_MSEC__10_1_0_S5_S3 0 2540 /end CHARACTERISTIC
/begin FUNCTION jK0sSteurSP1_Fktn "Applikationesgroessen Instanz jK0sSteurSP1"
 /begin DEF_CHARACTERISTIC D_PT2_MSCHALTAB_K0_SP KF_MSCHALTK012_SP KF_MSCHALTK021_SP KF_MSCHALTK023_SP KF_MSCHALTK031_SP KF_MSCHALTK032_SP KF_MSCHALTK034_SP KF_MSCHALTK042_SP KF_MSCHALTK043_SP KF_MSCHALTK045_SP KF_MSCHALTK051_SP KF_MSCHALTK053_SP KF_MSCHALTK054_SP KF_MSCHALTK056_SP KF_MSCHALTK063_SP KF_MSCHALTK064_SP KF_MSCHALTK065_SP KF_MSCHALTK067_SP KF_MSCHALTK071_SP KF_MSCHALTK075_SP KF_MSCHALTK076_SP KF_MSCHALTK078_SP KF_MSCHALTK082_SP KF_MSCHALTK084_SP KF_MSCHALTK086_SP KF_MSCHALTK087_SP KL_MO_KORRMSCHALT_K0_SP TAB_MPT_MSCHALTAUF_K0_SP TAB_T_PT2_MSCHALTAB_K0_SP T_MSCHALT_K0_SP /end DEF_CHARACTERISTIC
/end FUNCTION
/begin FUNCTION jK0sSteurX1_Fktn "Applikationesgroessen Instanz jK0sSteurX1"
 /begin DEF_CHARACTERISTIC KF_F_MOLW_K0 KF_MOLWGERGESK0S KF_MOLWGERGESK0Z KF_MOLWSPFGERK0S KF_MOLWSPFGERK0Z TAB_F_MGVMSOLLGEMVOR_K0 TAB_MPT_MOLWGERGES_K0 TAB_MPT_MOLWSPFGER_K0 TAB_T_MOLWGERGES_K0 TAB_T_MOLWSPFGER_K0 /end DEF_CHARACTERISTIC
/end FUNCTION
/begin FUNCTION jK0sSteurX2_Fktn "Applikationesgroessen Instanz jK0sSteurX2"
 /begin DEF_CHARACTERISTIC KF_F_MOLW_K0_SP KF_MOLWGERGESK0S_SP KF_MOLWGERGESK0Z_SP KF_MOLWSPFGERK0S_SP KF_MOLWSPFGERK0Z_SP TAB_F_MGVMSOLLGEMVOR_K0_SP TAB_MPT_MOLWGERGES_K0_SP TAB_MPT_MOLWSPFGER_K0_SP TAB_T_MOLWGERGES_K0_SP TAB_T_MOLWSPFGER_K0_SP /end DEF_CHARACTERISTIC
/end FUNCTION
/begin FUNCTION jKasEkopl_Fktn "Applikationesgroessen Instanz jKasEkopl"
 /begin DEF_CHARACTERISTIC HYS_NDS_ENTKOPPL KF_F_RAMPEOEFFNEN_ENTKOPPL KF_F_SCHLIESSEN_ENTKOPPL KF_MGSOLL_MDIF_ENTKOPPL KF_MGSOLL_NDG_ENTKOPPL KF_MOSOLLLASTNMOT_ENTKOPPL KF_MOSOLLNDIAETIMER_ENTKOPPL KF_RAMPEOEFFNEN_ENTKOPPL M_SOLL_MIN_ENTKOPPL NDS_ZU_ENTKOPPL SWI_MO_ENTKOPPL TAB_MOZIEL_ENTKOPPL TAB_MPT_MO_ENTKOPPL TAB_MSLASTFREI_ENTKOPPL TAB_MS_MOSTART_ENTKOPPL TAB_TSLASTFREI_ENTKOPPL T_NDS_ZU_ENTKOPPL /end DEF_CHARACTERISTIC
/end FUNCTION
/begin FUNCTION jModHydlg_Fktn "Applikationesgroessen Instanz jModHydlg"
 /begin DEF_CHARACTERISTIC I_EDSPOSV I_EDSPSV KF_KIEDSCGFAACE KF_KIEDSCGKOR KF_KIEDSCGSTACE KF_KIEDSPSYSKORFAACE KF_KIEDSPSYSKORSTACE KL_EDSKVA KL_EDSKVB KL_EDSKVC KL_EDSKVD KL_EDSKVE KL_EDSKVK0 KL_EDSKVPOS KL_EDSKVSYS SWI_ABGLDAT /end DEF_CHARACTERISTIC
/end FUNCTION
/begin FUNCTION jModHysKo_Fktn "Applikationesgroessen Instanz jModHysKo"
 /begin DEF_CHARACTERISTIC KF_MUEKPL_IAE_HYSKOMP KF_MUEKPL_K0_HYSKOMP MDT_IGEDS_HYSKOMP MDT_PGABSSOLL_HYSKOMP MDT_V_HYSKOMP /end DEF_CHARACTERISTIC
/end FUNCTION
/begin FUNCTION jModHysKoKA_Fktn "Applikationesgroessen Instanz jModHysKoKA"
 /begin DEF_CHARACTERISTIC IGS_A_HYSKOMP IS_IMAX_A_HYSKOMP IS_IMIN_A_HYSKOMP KF_F_GRAD_STG_A_HYSKOMP KF_F_V_A_HYSKOMP KF_T_RAMPE_V_A_HYSKOMP KL_F_GRAD_KPL_A_HYSKOMP KL_F_TRAJEK_KPL_A_HYSKOMP KL_F_TRAJEK_STG_A_HYSKOMP KL_HYSB_KPL_A_HYSKOMP KL_INIT_V_A_HYSKOMP KL_MUEKPL_A_HYSKOMP KL_T_KPL_A_HYSKOMP KL_T_STG_A_HYSKOMP PGS_A_HYSKOMP PO_MAX_V_A_HYSKOMP PO_MIN_V_A_HYSKOMP PS_INIT_HYS_V_A_HYSKOMP PS_INIT_V_A_HYSKOMP SWI_AKTIV_A_HYSKOMP SWI_AKTIV_V_A_HYSKOMP /end DEF_CHARACTERISTIC
/end FUNCTION
/begin FUNCTION jModHysKoKB_Fktn "Applikationesgroessen Instanz jModHysKoKB"
 /begin DEF_CHARACTERISTIC IGS_B_HYSKOMP IS_IMAX_B_HYSKOMP IS_IMIN_B_HYSKOMP KF_F_GRAD_STG_B_HYSKOMP KF_F_V_B_HYSKOMP KF_T_RAMPE_V_B_HYSKOMP KL_F_GRAD_KPL_B_HYSKOMP KL_F_TRAJEK_KPL_B_HYSKOMP KL_F_TRAJEK_STG_B_HYSKOMP KL_HYSB_KPL_B_HYSKOMP KL_INIT_V_B_HYSKOMP KL_MUEKPL_B_HYSKOMP KL_T_KPL_B_HYSKOMP KL_T_STG_B_HYSKOMP PGS_B_HYSKOMP PO_MAX_V_B_HYSKOMP PO_MIN_V_B_HYSKOMP PS_INIT_HYS_V_B_HYSKOMP PS_INIT_V_B_HYSKOMP SWI_AKTIV_B_HYSKOMP SWI_AKTIV_V_B_HYSKOMP /end DEF_CHARACTERISTIC
/end FUNCTION
/begin FUNCTION jModHysKoKC_Fktn "Applikationesgroessen Instanz jModHysKoKC"
 /begin DEF_CHARACTERISTIC IGS_C_HYSKOMP IS_IMAX_C_HYSKOMP IS_IMIN_C_HYSKOMP KF_F_GRAD_STG_C_HYSKOMP KF_F_V_C_HYSKOMP KF_T_RAMPE_V_C_HYSKOMP KL_F_GRAD_KPL_C_HYSKOMP KL_F_TRAJEK_KPL_C_HYSKOMP KL_F_TRAJEK_STG_C_HYSKOMP KL_HYSB_KPL_C_HYSKOMP KL_INIT_V_C_HYSKOMP KL_MUEKPL_C_HYSKOMP KL_T_KPL_C_HYSKOMP KL_T_STG_C_HYSKOMP PGS_C_HYSKOMP PO_MAX_V_C_HYSKOMP PO_MIN_V_C_HYSKOMP PS_INIT_HYS_V_C_HYSKOMP PS_INIT_V_C_HYSKOMP SWI_AKTIV_C_HYSKOMP SWI_AKTIV_V_C_HYSKOMP /end DEF_CHARACTERISTIC
/end FUNCTION
/begin FUNCTION jModHysKoKD_Fktn "Applikationesgroessen Instanz jModHysKoKD"
 /begin DEF_CHARACTERISTIC IGS_D_HYSKOMP IS_IMAX_D_HYSKOMP IS_IMIN_D_HYSKOMP KF_F_GRAD_STG_D_HYSKOMP KF_F_V_D_HYSKOMP KF_T_RAMPE_V_D_HYSKOMP KL_F_GRAD_KPL_D_HYSKOMP KL_F_TRAJEK_KPL_D_HYSKOMP KL_F_TRAJEK_STG_D_HYSKOMP KL_HYSB_KPL_D_HYSKOMP KL_INIT_V_D_HYSKOMP KL_MUEKPL_D_HYSKOMP KL_T_KPL_D_HYSKOMP KL_T_STG_D_HYSKOMP PGS_D_HYSKOMP PO_MAX_V_D_HYSKOMP PO_MIN_V_D_HYSKOMP PS_INIT_HYS_V_D_HYSKOMP PS_INIT_V_D_HYSKOMP SWI_AKTIV_D_HYSKOMP SWI_AKTIV_V_D_HYSKOMP /end DEF_CHARACTERISTIC
/end FUNCTION
/begin FUNCTION jModHysKoKE_Fktn "Applikationesgroessen Instanz jModHysKoKE"
 /begin DEF_CHARACTERISTIC IGS_E_HYSKOMP IS_IMAX_E_HYSKOMP IS_IMIN_E_HYSKOMP KF_F_GRAD_STG_E_HYSKOMP KF_F_V_E_HYSKOMP KF_T_RAMPE_V_E_HYSKOMP KL_F_GRAD_KPL_E_HYSKOMP KL_F_TRAJEK_KPL_E_HYSKOMP KL_F_TRAJEK_STG_E_HYSKOMP KL_HYSB_KPL_E_HYSKOMP KL_INIT_V_E_HYSKOMP KL_MUEKPL_E_HYSKOMP KL_T_KPL_E_HYSKOMP KL_T_STG_E_HYSKOMP PGS_E_HYSKOMP PO_MAX_V_E_HYSKOMP PO_MIN_V_E_HYSKOMP PS_INIT_HYS_V_E_HYSKOMP PS_INIT_V_E_HYSKOMP SWI_AKTIV_E_HYSKOMP SWI_AKTIV_V_E_HYSKOMP /end DEF_CHARACTERISTIC
/end FUNCTION
/begin FUNCTION jModHysKoKK0_Fktn "Applikationesgroessen Instanz jModHysKoKK0"
 /begin DEF_CHARACTERISTIC IGS_K0_HYSKOMP IS_IMAX_K0_HYSKOMP IS_IMIN_K0_HYSKOMP KF_F_GRAD_STG_K0_HYSKOMP KF_F_V_K0_HYSKOMP KF_T_RAMPE_V_K0_HYSKOMP KL_F_GRAD_KPL_K0_HYSKOMP KL_F_TRAJEK_KPL_K0_HYSKOMP KL_F_TRAJEK_STG_K0_HYSKOMP KL_HYSB_KPL_K0_HYSKOMP KL_INIT_V_K0_HYSKOMP KL_T_KPL_K0_HYSKOMP KL_T_STG_K0_HYSKOMP PGS_K0_HYSKOMP PO_MAX_V_K0_HYSKOMP PO_MIN_V_K0_HYSKOMP PS_INIT_HYS_V_K0_HYSKOMP PS_INIT_V_K0_HYSKOMP SWI_AKTIV_K0_HYSKOMP SWI_AKTIV_V_K0_HYSKOMP /end DEF_CHARACTERISTIC
/end FUNCTION
/begin FUNCTION jModKuppl_Fktn "Applikationesgroessen Instanz jModKuppl"
 /begin DEF_CHARACTERISTIC F_TSFADAESTARTSTART_E KF_PSFCGMTESTART_E KL_TOSFNKESTART KL_TSFCGESTART_E PO_SAEND SWI_GLOBALSTROMSCHL TAB_PMAXKV TAB_SWIKUPPSTROMSCHL TAB_SWISTROMSCHL TAB_SWI_PREPULS TS_KPL_AKTIV TS_KPL_INAKTIV /end DEF_CHARACTERISTIC
/end FUNCTION
/begin FUNCTION jModKupplK0_Fktn "Applikationesgroessen Instanz jModKupplK0"
 /begin DEF_CHARACTERISTIC F_TSFADAFUELLOPT_K0 F_TSFADAFUELLRED_K0 KF_PFCGNMOT_K0 KF_POSFCGNAB_K0 KF_PSFCGMTFUELLOPT_K0 KF_PSFCGMTFUELLRED_K0 KF_PSFCGMT_K0 KF_TENTLEER_K0 KF_TO1SFCG_K0 KF_TOENTLEERCGADA_K0 KL_PFHYSCG_K0 KL_PKUPPSTROM_K0 KL_TFPWIRK_K0 KL_TOSFNKFUELLOPT_K0 KL_TOSFNKFUELLRED_K0 KL_TOSFNK_K0 KL_TSFCGFUELLOPT_K0 KL_TSFCGFUELLRED_K0 KL_TSFCG_K0 KL_TTOTFUELL_K0 T_O1SFAUSSB_K0 /end DEF_CHARACTERISTIC
/end FUNCTION
/begin FUNCTION jModKupplKA_Fktn "Applikationesgroessen Instanz jModKupplKA"
 /begin DEF_CHARACTERISTIC F_TSFADAFUELLOPT_A F_TSFADAFUELLRED_A KF_POSFCGNAB_A KF_PSFCGMTFUELLOPT_A KF_PSFCGMTFUELLRED_A KF_PSFCGMT_A KF_TENTLEER_A KF_TO1SFCG_A KF_TOENTLEERCGADA_A KF_TOSFGE_A KF_TOSFHSFUELLOPT_A KF_TOSFHSSPORT_A KF_TOSFHSSP_A KF_TOSFHS_A KF_TOSFHS_A_EL KF_TOSFRSSPORT_A KF_TOSFRSSP_A KF_TOSFRS_A KF_TOSFRS_A_EL KL_PFCG_A KL_PFHYSCG_A KL_PKUPPSTROM_A KL_TFPWIRK_A KL_TOSFNKFUELLOPT_A KL_TOSFNKFUELLRED_A KL_TOSFNK_A KL_TSFCGFUELLOPT_A KL_TSFCGFUELLRED_A KL_TSFCG_A KL_TTOTFUELL_A KL_TVCGSAEND_A T_O1SFAUSSB_A /end DEF_CHARACTERISTIC
/end FUNCTION
/begin FUNCTION jModKupplKB_Fktn "Applikationesgroessen Instanz jModKupplKB"
 /begin DEF_CHARACTERISTIC F_TSFADAFUELLOPT_B F_TSFADAFUELLRED_B KF_POSFCGNAB_B KF_PSFCGMTFUELLOPT_B KF_PSFCGMTFUELLRED_B KF_PSFCGMT_B KF_TENTLEER_B KF_TO1SFCG_B KF_TOENTLEERCGADA_B KF_TOSFGE_B KF_TOSFHSFUELLOPT_B KF_TOSFHSSPORT_B KF_TOSFHSSP_B KF_TOSFHS_B KF_TOSFHS_B_EL KF_TOSFRSSPORT_B KF_TOSFRSSP_B KF_TOSFRS_B KF_TOSFRS_B_EL KL_PFCG_B KL_PFHYSCG_B KL_PKUPPSTROM_B KL_TFPWIRK_B KL_TOSFNKFUELLOPT_B KL_TOSFNKFUELLRED_B KL_TOSFNK_B KL_TSFCGFUELLOPT_B KL_TSFCGFUELLRED_B KL_TSFCG_B KL_TTOTFUELL_B KL_TVCGSAEND_B T_O1SFAUSSB_B /end DEF_CHARACTERISTIC
/end FUNCTION
/begin FUNCTION jModKupplKC_Fktn "Applikationesgroessen Instanz jModKupplKC"
 /begin DEF_CHARACTERISTIC F_TSFADAFUELLOPT_C F_TSFADAFUELLRED_C KF_POSFCGNAB_C KF_PSFCGMTFUELLOPT_C KF_PSFCGMTFUELLRED_C KF_PSFCGMT_C KF_TENTLEER_C KF_TO1SFCG_C KF_TOENTLEERCGADA_C KF_TOSFGE_C KF_TOSFHSFUELLOPT_C KF_TOSFHSSPORT_C KF_TOSFHSSP_C KF_TOSFHS_C KF_TOSFHS_C_EL KF_TOSFRSSPORT_C KF_TOSFRSSP_C KF_TOSFRS_C KF_TOSFRS_C_EL KL_PFCG_C KL_PFHYSCG_C KL_PKUPPSTROM_C KL_TFPWIRK_C KL_TOSFNKFUELLOPT_C KL_TOSFNKFUELLRED_C KL_TOSFNK_C KL_TSFCGFUELLOPT_C KL_TSFCGFUELLRED_C KL_TSFCG_C KL_TTOTFUELL_C KL_TVCGSAEND_C T_O1SFAUSSB_C /end DEF_CHARACTERISTIC
/end FUNCTION
/begin FUNCTION jModKupplKD_Fktn "Applikationesgroessen Instanz jModKupplKD"
 /begin DEF_CHARACTERISTIC F_TSFADAFUELLOPT_D F_TSFADAFUELLRED_D KF_POSFCGNAB_D KF_PSFCGMTFUELLOPT_D KF_PSFCGMTFUELLRED_D KF_PSFCGMT_D KF_TENTLEER_D KF_TO1SFCG_D KF_TOENTLEERCGADA_D KF_TOSFGE_D KF_TOSFHSFUELLOPT_D KF_TOSFHSSPORT_D KF_TOSFHSSP_D KF_TOSFHS_D KF_TOSFHS_D_EL KF_TOSFRSSPORT_D KF_TOSFRSSP_D KF_TOSFRS_D KF_TOSFRS_D_EL KL_PFCG_D KL_PFHYSCG_D KL_PKUPPSTROM_D KL_TFPWIRK_D KL_TOSFNKFUELLOPT_D KL_TOSFNKFUELLRED_D KL_TOSFNK_D KL_TSFCGFUELLOPT_D KL_TSFCGFUELLRED_D KL_TSFCG_D KL_TTOTFUELL_D KL_TVCGSAEND_D T_O1SFAUSSB_D /end DEF_CHARACTERISTIC
/end FUNCTION
/begin FUNCTION jModKupplKE_Fktn "Applikationesgroessen Instanz jModKupplKE"
 /begin DEF_CHARACTERISTIC F_TSFADAFUELLOPT_E F_TSFADAFUELLRED_E KF_POSFCGNAB_E KF_PSFCGMTFUELLOPT_E KF_PSFCGMTFUELLRED_E KF_PSFCGMT_E KF_TENTLEER_E KF_TO1SFCG_E KF_TOENTLEERCGADA_E KF_TOSFGE_E KF_TOSFHSFUELLOPT_E KF_TOSFHSSPORT_E KF_TOSFHSSP_E KF_TOSFHS_E KF_TOSFHS_E_EL KF_TOSFRSSPORT_E KF_TOSFRSSP_E KF_TOSFRS_E KF_TOSFRS_E_EL KL_PFCG_E KL_PFHYSCG_E KL_PKUPPSTROM_E KL_TFPWIRK_E KL_TOSFNKFUELLOPT_E KL_TOSFNKFUELLRED_E KL_TOSFNK_E KL_TSFCGFUELLOPT_E KL_TSFCGFUELLRED_E KL_TSFCG_E KL_TTOTFUELL_E KL_TVCGSAEND_E T_O1SFAUSSB_E /end DEF_CHARACTERISTIC
/end FUNCTION
/begin FUNCTION jMoeSasAl_Fktn "Applikationesgroessen Instanz jMoeSasAl"
 /begin DEF_CHARACTERISTIC CS_MEPOS KL_FMENDIAE KL_MEKREDCM_D KL_MEKREDCM_R KL_UNTERDRNGNMOT ND_MEPOSHAUPTA NS_HYS_UNTERDR_ME SWI_MESCHLEPP SWI_MSTSSCHR SWI_UNTERDR_ME TAB_SWI_MEPOSHS TAB_SWI_MEPOSHSVOR TAB_SWI_MEPOSRS TAB_SWI_MEPOSRSVOR T_FNGABMESAS T_MEMAXHSGE T_MEMAXRS /end DEF_CHARACTERISTIC
/end FUNCTION
/begin FUNCTION jMoeSasERS21_Fktn "Applikationesgroessen Instanz jMoeSasERS21"
 /begin DEF_CHARACTERISTIC KF_MENACHFOLNACHMRS21 KF_MENACHFOLNACHMRS21_EL KF_MENACHFOLNACHMRSSP21 KF_MENACHFOLNACHMRSSPORT21 KF_MENACHFOLNACHRS21 KF_MENACHFOLNACHRS21_EL KF_MENACHFOLNACHRSSP21 KF_MENACHFOLNACHRSSPORT21 /end DEF_CHARACTERISTIC
/end FUNCTION
/begin FUNCTION jMoeSasERS32_Fktn "Applikationesgroessen Instanz jMoeSasERS32"
 /begin DEF_CHARACTERISTIC KF_MENACHFOLNACHMRS32 KF_MENACHFOLNACHMRS32_EL KF_MENACHFOLNACHMRSSP32 KF_MENACHFOLNACHMRSSPORT32 KF_MENACHFOLNACHRS32 KF_MENACHFOLNACHRS32_EL KF_MENACHFOLNACHRSSP32 KF_MENACHFOLNACHRSSPORT32 /end DEF_CHARACTERISTIC
/end FUNCTION
/begin FUNCTION jMoeSasERS43_Fktn "Applikationesgroessen Instanz jMoeSasERS43"
 /begin DEF_CHARACTERISTIC KF_MENACHFOLNACHMRS43 KF_MENACHFOLNACHMRS43_EL KF_MENACHFOLNACHMRSSP43 KF_MENACHFOLNACHMRSSPORT43 KF_MENACHFOLNACHRS43 KF_MENACHFOLNACHRS43_EL KF_MENACHFOLNACHRSSP43 KF_MENACHFOLNACHRSSPORT43 /end DEF_CHARACTERISTIC
/end FUNCTION
/begin FUNCTION jMoeSasERS54_Fktn "Applikationesgroessen Instanz jMoeSasERS54"
 /begin DEF_CHARACTERISTIC KF_MENACHFOLNACHMRS54 KF_MENACHFOLNACHMRS54_EL KF_MENACHFOLNACHMRSSP54 KF_MENACHFOLNACHMRSSPORT54 KF_MENACHFOLNACHRS54 KF_MENACHFOLNACHRS54_EL KF_MENACHFOLNACHRSSP54 KF_MENACHFOLNACHRSSPORT54 /end DEF_CHARACTERISTIC
/end FUNCTION
/begin FUNCTION jMoeSasERS65_Fktn "Applikationesgroessen Instanz jMoeSasERS65"
 /begin DEF_CHARACTERISTIC KF_MENACHFOLNACHMRS65 KF_MENACHFOLNACHMRS65_EL KF_MENACHFOLNACHMRSSP65 KF_MENACHFOLNACHMRSSPORT65 KF_MENACHFOLNACHRS65 KF_MENACHFOLNACHRS65_EL KF_MENACHFOLNACHRSSP65 KF_MENACHFOLNACHRSSPORT65 /end DEF_CHARACTERISTIC
/end FUNCTION
/begin FUNCTION jMoeSasERS76_Fktn "Applikationesgroessen Instanz jMoeSasERS76"
 /begin DEF_CHARACTERISTIC KF_MENACHFOLNACHMRS76 KF_MENACHFOLNACHMRS76_EL KF_MENACHFOLNACHMRSSP76 KF_MENACHFOLNACHMRSSPORT76 KF_MENACHFOLNACHRS76 KF_MENACHFOLNACHRS76_EL KF_MENACHFOLNACHRSSP76 KF_MENACHFOLNACHRSSPORT76 /end DEF_CHARACTERISTIC
/end FUNCTION
/begin FUNCTION jMoeSasERS87_Fktn "Applikationesgroessen Instanz jMoeSasERS87"
 /begin DEF_CHARACTERISTIC KF_MENACHFOLNACHMRS87 KF_MENACHFOLNACHMRS87_EL KF_MENACHFOLNACHMRSSP87 KF_MENACHFOLNACHMRSSPORT87 KF_MENACHFOLNACHRS87 KF_MENACHFOLNACHRS87_EL KF_MENACHFOLNACHRSSP87 KF_MENACHFOLNACHRSSPORT87 /end DEF_CHARACTERISTIC
/end FUNCTION
/begin FUNCTION jMoeSasGeG1_Fktn "Applikationesgroessen Instanz jMoeSasGeG1"
 /begin DEF_CHARACTERISTIC KF_FMEHAUPTGEDKINMOT_1 KF_FTSYNNTMEHAUPTE_1 KF_MEHAUPT_1 KL_TSYNMTMEHAUPTE_1 KL_TVMEA_1 K_FMEHAUPTA_1 ND_MEHAUPTAGE_1 T_FMEHAUPTA_1 T_RAMEE_1 /end DEF_CHARACTERISTIC
/end FUNCTION
/begin FUNCTION jMoeSasGeG2_Fktn "Applikationesgroessen Instanz jMoeSasGeG2"
 /begin DEF_CHARACTERISTIC KF_FMEHAUPTGEDKINMOT_2 KF_FTSYNNTMEHAUPTE_2 KF_MEHAUPT_2 KL_TSYNMTMEHAUPTE_2 KL_TVMEA_2 K_FMEHAUPTA_2 ND_MEHAUPTAGE_2 T_FMEHAUPTA_2 T_RAMEE_2 /end DEF_CHARACTERISTIC
/end FUNCTION
/begin FUNCTION jMoeSasGeG3_Fktn "Applikationesgroessen Instanz jMoeSasGeG3"
 /begin DEF_CHARACTERISTIC KF_FMEHAUPTGEDKINMOT_3 KF_FTSYNNTMEHAUPTE_3 KF_MEHAUPT_3 KL_TSYNMTMEHAUPTE_3 KL_TVMEA_3 K_FMEHAUPTA_3 ND_MEHAUPTAGE_3 T_FMEHAUPTA_3 T_RAMEE_3 /end DEF_CHARACTERISTIC
/end FUNCTION
/begin FUNCTION jMoeSasGeG4_Fktn "Applikationesgroessen Instanz jMoeSasGeG4"
 /begin DEF_CHARACTERISTIC KF_FMEHAUPTGEDKINMOT_4 KF_FTSYNNTMEHAUPTE_4 KF_MEHAUPT_4 KL_TSYNMTMEHAUPTE_4 KL_TVMEA_4 K_FMEHAUPTA_4 ND_MEHAUPTAGE_4 T_FMEHAUPTA_4 T_RAMEE_4 /end DEF_CHARACTERISTIC
/end FUNCTION
/begin FUNCTION jMoeSasGeG5_Fktn "Applikationesgroessen Instanz jMoeSasGeG5"
 /begin DEF_CHARACTERISTIC KF_FMEHAUPTGEDKINMOT_5 KF_FTSYNNTMEHAUPTE_5 KF_MEHAUPT_5 KL_TSYNMTMEHAUPTE_5 KL_TVMEA_5 K_FMEHAUPTA_5 ND_MEHAUPTAGE_5 T_FMEHAUPTA_5 T_RAMEE_5 /end DEF_CHARACTERISTIC
/end FUNCTION
/begin FUNCTION jMoeSasGeG6_Fktn "Applikationesgroessen Instanz jMoeSasGeG6"
 /begin DEF_CHARACTERISTIC KF_FMEHAUPTGEDKINMOT_6 KF_FTSYNNTMEHAUPTE_6 KF_MEHAUPT_6 KL_TSYNMTMEHAUPTE_6 KL_TVMEA_6 K_FMEHAUPTA_6 ND_MEHAUPTAGE_6 T_FMEHAUPTA_6 T_RAMEE_6 /end DEF_CHARACTERISTIC
/end FUNCTION
/begin FUNCTION jMoeSasGeG7_Fktn "Applikationesgroessen Instanz jMoeSasGeG7"
 /begin DEF_CHARACTERISTIC KF_FMEHAUPTGEDKINMOT_7 KF_FTSYNNTMEHAUPTE_7 KF_MEHAUPT_7 KL_TSYNMTMEHAUPTE_7 KL_TVMEA_7 K_FMEHAUPTA_7 ND_MEHAUPTAGE_7 T_FMEHAUPTA_7 T_RAMEE_7 /end DEF_CHARACTERISTIC
/end FUNCTION
/begin RECORD_LAYOUT ZF_kf_fl32_S5_S3 FNC_VALUES 5 FLOAT32_IEEE ROW_DIR DIRECT AXIS_PTS_X 3 FLOAT32_IEEE INDEX_INCR DIRECT AXIS_PTS_Y 4 FLOAT32_IEEE INDEX_INCR DIRECT NO_AXIS_PTS_X 1 ULONG NO_AXIS_PTS_Y 2 ULONG /end RECORD_LAYOUT
/begin RECORD_LAYOUT ZF_kf_si16_S5_S3 FNC_VALUES 5 SWORD ROW_DIR DIRECT AXIS_PTS_X 3 SWORD INDEX_INCR DIRECT AXIS_PTS_Y 4 SWORD INDEX_INCR DIRECT NO_AXIS_PTS_X 1 ULONG NO_AXIS_PTS_Y 2 ULONG /end RECORD_LAYOUT
/begin RECORD_LAYOUT ZF_kf_ui16_S5_S3 FNC_VALUES 5 UWORD ROW_DIR DIRECT AXIS_PTS_X 3 UWORD INDEX_INCR DIRECT AXIS_PTS_Y 4 UWORD INDEX_INCR DIRECT NO_AXIS_PTS_X 1 ULONG NO_AXIS_PTS_Y 2 ULONG /end RECORD_LAYOUT
/begin RECORD_LAYOUT ZF_kf_ui8_S5_S3 FNC_VALUES 5 UBYTE ROW_DIR DIRECT AXIS_PTS_X 3 UBYTE INDEX_INCR DIRECT AXIS_PTS_Y 4 UBYTE INDEX_INCR DIRECT NO_AXIS_PTS_X 1 ULONG NO_AXIS_PTS_Y 2 ULONG /end RECORD_LAYOUT
/begin RECORD_LAYOUT ZF_kl_fl32_S5_S3 FNC_VALUES 3 FLOAT32_IEEE COLUMN_DIR DIRECT AXIS_PTS_X 2 FLOAT32_IEEE INDEX_INCR DIRECT NO_AXIS_PTS_X 1 ULONG /end RECORD_LAYOUT
/begin RECORD_LAYOUT ZF_kl_si16_S5_S3 FNC_VALUES 3 SWORD COLUMN_DIR DIRECT AXIS_PTS_X 2 SWORD INDEX_INCR DIRECT NO_AXIS_PTS_X 1 ULONG /end RECORD_LAYOUT
/begin RECORD_LAYOUT ZF_kl_ui16_S5_S3 FNC_VALUES 3 UWORD COLUMN_DIR DIRECT AXIS_PTS_X 2 UWORD INDEX_INCR DIRECT NO_AXIS_PTS_X 1 ULONG /end RECORD_LAYOUT
/begin RECORD_LAYOUT ZF_kl_ui8_S5_S3 FNC_VALUES 3 UBYTE COLUMN_DIR DIRECT AXIS_PTS_X 2 UBYTE INDEX_INCR DIRECT NO_AXIS_PTS_X 1 ULONG /end RECORD_LAYOUT
/begin RECORD_LAYOUT ZF_kw_bool8_S5_S3 FNC_VALUES 1 UBYTE COLUMN_DIR DIRECT /end RECORD_LAYOUT
/begin RECORD_LAYOUT ZF_kw_fl32_S5_S3 FNC_VALUES 1 FLOAT32_IEEE COLUMN_DIR DIRECT /end RECORD_LAYOUT
/begin RECORD_LAYOUT ZF_kw_si16_S5_S3 FNC_VALUES 1 SWORD COLUMN_DIR DIRECT /end RECORD_LAYOUT
/begin RECORD_LAYOUT ZF_kw_ui16_S5_S3 FNC_VALUES 1 UWORD COLUMN_DIR DIRECT /end RECORD_LAYOUT
/begin RECORD_LAYOUT ZF_kw_ui32_S5_S3 FNC_VALUES 1 ULONG COLUMN_DIR DIRECT /end RECORD_LAYOUT
/begin RECORD_LAYOUT ZF_kw_ui8_S5_S3 FNC_VALUES 1 UBYTE COLUMN_DIR DIRECT /end RECORD_LAYOUT
/begin RECORD_LAYOUT ZF_tab2d_fl32_S5_S3 FNC_VALUES 3 FLOAT32_IEEE ROW_DIR DIRECT NO_AXIS_PTS_X 1 ULONG NO_AXIS_PTS_Y 2 ULONG /end RECORD_LAYOUT
/begin RECORD_LAYOUT ZF_tab2d_ui8_S5_S3 FNC_VALUES 3 UBYTE ROW_DIR DIRECT NO_AXIS_PTS_X 1 ULONG NO_AXIS_PTS_Y 2 ULONG /end RECORD_LAYOUT
/begin RECORD_LAYOUT ZF_tab_bool8_S5_S3 FNC_VALUES 2 UBYTE COLUMN_DIR DIRECT NO_AXIS_PTS_X 1 ULONG /end RECORD_LAYOUT
/begin RECORD_LAYOUT ZF_tab_fl32_S5_S3 FNC_VALUES 2 FLOAT32_IEEE COLUMN_DIR DIRECT NO_AXIS_PTS_X 1 ULONG /end RECORD_LAYOUT
/begin RECORD_LAYOUT ZF_tab_si16_S5_S3 FNC_VALUES 2 SWORD COLUMN_DIR DIRECT NO_AXIS_PTS_X 1 ULONG /end RECORD_LAYOUT
/begin RECORD_LAYOUT ZF_tab_ui16_S5_S3 FNC_VALUES 2 UWORD COLUMN_DIR DIRECT NO_AXIS_PTS_X 1 ULONG /end RECORD_LAYOUT
/begin RECORD_LAYOUT ZF_tab_ui8_S5_S3 FNC_VALUES 2 UBYTE COLUMN_DIR DIRECT NO_AXIS_PTS_X 1 ULONG /end RECORD_LAYOUT
/end MODULE
/end PROJECT
