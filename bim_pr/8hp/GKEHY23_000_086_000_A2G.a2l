ASAP2_VERSION 1 51
/begin PROJECT ZHBC8600 "Gen2_BMW_System_Supplier_Lib"
/begin MODULE CPP ""
/begin MOD_COMMON "" BYTE_ORDER MSB_FIRST ALIGNMENT_BYTE 1 ALIGNMENT_WORD 2 ALIGNMENT_LONG 4 ALIGNMENT_FLOAT32_IEEE 4 ALIGNMENT_FLOAT64_IEEE 1 /end MOD_COMMON
/begin FUNCTION zff_EH_ErrorMemoryInformation "desc_en"
 /begin IN_MEASUREMENT ZFEH_EepromData.ydiBackupMemory_xau16[0].amb_cond.ambient_condition[0][0] ZFEH_EepromData.ydiBackupMemory_xau16[0].amb_cond.ambient_condition[0][10] ZFEH_EepromData.ydiBackupMemory_xau16[0].amb_cond.ambient_condition[0][11] ZFEH_EepromData.ydiBackupMemory_xau16[0].amb_cond.ambient_condition[0][12] ZFEH_EepromData.ydiBackupMemory_xau16[0].amb_cond.ambient_condition[0][13] ZFEH_EepromData.ydiBackupMemory_xau16[0].amb_cond.ambient_condition[0][14] ZFEH_EepromData.ydiBackupMemory_xau16[0].amb_cond.ambient_condition[0][15] ZFEH_EepromData.ydiBackupMemory_xau16[0].amb_cond.ambient_condition[0][16] ZFEH_EepromData.ydiBackupMemory_xau16[0].amb_cond.ambient_condition[0][17] ZFEH_EepromData.ydiBackupMemory_xau16[0].amb_cond.ambient_condition[0][18] ZFEH_EepromData.ydiBackupMemory_xau16[0].amb_cond.ambient_condition[0][19] ZFEH_EepromData.ydiBackupMemory_xau16[0].amb_cond.ambient_condition[0][1] ZFEH_EepromData.ydiBackupMemory_xau16[0].amb_cond.ambient_condition[0][20] ZFEH_EepromData.ydiBackupMemory_xau16[0].amb_cond.ambient_condition[0][21] ZFEH_EepromData.ydiBackupMemory_xau16[0].amb_cond.ambient_condition[0][22] ZFEH_EepromData.ydiBackupMemory_xau16[0].amb_cond.ambient_condition[0][23] ZFEH_EepromData.ydiBackupMemory_xau16[0].amb_cond.ambient_condition[0][24] ZFEH_EepromData.ydiBackupMemory_xau16[0].amb_cond.ambient_condition[0][2] ZFEH_EepromData.ydiBackupMemory_xau16[0].amb_cond.ambient_condition[0][3] ZFEH_EepromData.ydiBackupMemory_xau16[0].amb_cond.ambient_condition[0][4] ZFEH_EepromData.ydiBackupMemory_xau16[0].amb_cond.ambient_condition[0][5] ZFEH_EepromData.ydiBackupMemory_xau16[0].amb_cond.ambient_condition[0][6] ZFEH_EepromData.ydiBackupMemory_xau16[0].amb_cond.ambient_condition[0][7] ZFEH_EepromData.ydiBackupMemory_xau16[0].amb_cond.ambient_condition[0][8] ZFEH_EepromData.ydiBackupMemory_xau16[0].amb_cond.ambient_condition[0][9] ZFEH_EepromData.ydiBackupMemory_xau16[0].amb_cond.ambient_condition[1][0] ZFEH_EepromData.ydiBackupMemory_xau16[0].amb_cond.ambient_condition[1][10] ZFEH_EepromData.ydiBackupMemory_xau16[0].amb_cond.ambient_condition[1][11] ZFEH_EepromData.ydiBackupMemory_xau16[0].amb_cond.ambient_condition[1][12] ZFEH_EepromData.ydiBackupMemory_xau16[0].amb_cond.ambient_condition[1][13] ZFEH_EepromData.ydiBackupMemory_xau16[0].amb_cond.ambient_condition[1][14] ZFEH_EepromData.ydiBackupMemory_xau16[0].amb_cond.ambient_condition[1][15] ZFEH_EepromData.ydiBackupMemory_xau16[0].amb_cond.ambient_condition[1][16] ZFEH_EepromData.ydiBackupMemory_xau16[0].amb_cond.ambient_condition[1][17] ZFEH_EepromData.ydiBackupMemory_xau16[0].amb_cond.ambient_condition[1][18] ZFEH_EepromData.ydiBackupMemory_xau16[0].amb_cond.ambient_condition[1][19] ZFEH_EepromData.ydiBackupMemory_xau16[0].amb_cond.ambient_condition[1][1] ZFEH_EepromData.ydiBackupMemory_xau16[0].amb_cond.ambient_condition[1][20] ZFEH_EepromData.ydiBackupMemory_xau16[0].amb_cond.ambient_condition[1][21] ZFEH_EepromData.ydiBackupMemory_xau16[0].amb_cond.ambient_condition[1][22] ZFEH_EepromData.ydiBackupMemory_xau16[0].amb_cond.ambient_condition[1][23] ZFEH_EepromData.ydiBackupMemory_xau16[0].amb_cond.ambient_condition[1][24] ZFEH_EepromData.ydiBackupMemory_xau16[0].amb_cond.ambient_condition[1][2] ZFEH_EepromData.ydiBackupMemory_xau16[0].amb_cond.ambient_condition[1][3] ZFEH_EepromData.ydiBackupMemory_xau16[0].amb_cond.ambient_condition[1][4] ZFEH_EepromData.ydiBackupMemory_xau16[0].amb_cond.ambient_condition[1][5] ZFEH_EepromData.ydiBackupMemory_xau16[0].amb_cond.ambient_condition[1][6] ZFEH_EepromData.ydiBackupMemory_xau16[0].amb_cond.ambient_condition[1][7] ZFEH_EepromData.ydiBackupMemory_xau16[0].amb_cond.ambient_condition[1][8] ZFEH_EepromData.ydiBackupMemory_xau16[0].amb_cond.ambient_condition[1][9] ZFEH_EepromData.ydiBackupMemory_xau16[0].amb_cond.status_of_ambient_conditions[0] ZFEH_EepromData.ydiBackupMemory_xau16[0].amb_cond.status_of_ambient_conditions[1] ZFEH_EepromData.ydiBackupMemory_xau16[0].backwards_counter ZFEH_EepromData.ydiBackupMemory_xau16[0].condition_byte ZFEH_EepromData.ydiBackupMemory_xau16[0].error_code ZFEH_EepromData.ydiBackupMemory_xau16[0].error_type ZFEH_EepromData.ydiBackupMemory_xau16[0].frequency_counter ZFEH_EepromData.ydiBackupMemory_xau16[0].master_time ZFEH_EepromData.ydiBackupMemory_xau16[0].obd_driving_cycle_counter ZFEH_EepromData.ydiBackupMemory_xau16[0].permanent_counter ZFEH_EepromData.ydiBackupMemory_xau16[0].sequence_counter ZFEH_EepromData.ydiBackupMemory_xau16[0].status_word ZFEH_EepromData.ydiBackupMemory_xau16[1].amb_cond.ambient_condition[0][0] ZFEH_EepromData.ydiBackupMemory_xau16[1].amb_cond.ambient_condition[0][10] ZFEH_EepromData.ydiBackupMemory_xau16[1].amb_cond.ambient_condition[0][11] ZFEH_EepromData.ydiBackupMemory_xau16[1].amb_cond.ambient_condition[0][12] ZFEH_EepromData.ydiBackupMemory_xau16[1].amb_cond.ambient_condition[0][13] ZFEH_EepromData.ydiBackupMemory_xau16[1].amb_cond.ambient_condition[0][14] ZFEH_EepromData.ydiBackupMemory_xau16[1].amb_cond.ambient_condition[0][15] ZFEH_EepromData.ydiBackupMemory_xau16[1].amb_cond.ambient_condition[0][16] ZFEH_EepromData.ydiBackupMemory_xau16[1].amb_cond.ambient_condition[0][17] ZFEH_EepromData.ydiBackupMemory_xau16[1].amb_cond.ambient_condition[0][18] ZFEH_EepromData.ydiBackupMemory_xau16[1].amb_cond.ambient_condition[0][19] ZFEH_EepromData.ydiBackupMemory_xau16[1].amb_cond.ambient_condition[0][1] ZFEH_EepromData.ydiBackupMemory_xau16[1].amb_cond.ambient_condition[0][20] ZFEH_EepromData.ydiBackupMemory_xau16[1].amb_cond.ambient_condition[0][21] ZFEH_EepromData.ydiBackupMemory_xau16[1].amb_cond.ambient_condition[0][22] ZFEH_EepromData.ydiBackupMemory_xau16[1].amb_cond.ambient_condition[0][23] ZFEH_EepromData.ydiBackupMemory_xau16[1].amb_cond.ambient_condition[0][24] ZFEH_EepromData.ydiBackupMemory_xau16[1].amb_cond.ambient_condition[0][2] ZFEH_EepromData.ydiBackupMemory_xau16[1].amb_cond.ambient_condition[0][3] ZFEH_EepromData.ydiBackupMemory_xau16[1].amb_cond.ambient_condition[0][4] ZFEH_EepromData.ydiBackupMemory_xau16[1].amb_cond.ambient_condition[0][5] ZFEH_EepromData.ydiBackupMemory_xau16[1].amb_cond.ambient_condition[0][6] ZFEH_EepromData.ydiBackupMemory_xau16[1].amb_cond.ambient_condition[0][7] ZFEH_EepromData.ydiBackupMemory_xau16[1].amb_cond.ambient_condition[0][8] ZFEH_EepromData.ydiBackupMemory_xau16[1].amb_cond.ambient_condition[0][9] ZFEH_EepromData.ydiBackupMemory_xau16[1].amb_cond.ambient_condition[1][0] ZFEH_EepromData.ydiBackupMemory_xau16[1].amb_cond.ambient_condition[1][10] ZFEH_EepromData.ydiBackupMemory_xau16[1].amb_cond.ambient_condition[1][11] ZFEH_EepromData.ydiBackupMemory_xau16[1].amb_cond.ambient_condition[1][12] ZFEH_EepromData.ydiBackupMemory_xau16[1].amb_cond.ambient_condition[1][13] ZFEH_EepromData.ydiBackupMemory_xau16[1].amb_cond.ambient_condition[1][14] ZFEH_EepromData.ydiBackupMemory_xau16[1].amb_cond.ambient_condition[1][15] ZFEH_EepromData.ydiBackupMemory_xau16[1].amb_cond.ambient_condition[1][16] ZFEH_EepromData.ydiBackupMemory_xau16[1].amb_cond.ambient_condition[1][17] ZFEH_EepromData.ydiBackupMemory_xau16[1].amb_cond.ambient_condition[1][18] ZFEH_EepromData.ydiBackupMemory_xau16[1].amb_cond.ambient_condition[1][19] ZFEH_EepromData.ydiBackupMemory_xau16[1].amb_cond.ambient_condition[1][1] ZFEH_EepromData.ydiBackupMemory_xau16[1].amb_cond.ambient_condition[1][20] ZFEH_EepromData.ydiBackupMemory_xau16[1].amb_cond.ambient_condition[1][21] ZFEH_EepromData.ydiBackupMemory_xau16[1].amb_cond.ambient_condition[1][22] ZFEH_EepromData.ydiBackupMemory_xau16[1].amb_cond.ambient_condition[1][23] ZFEH_EepromData.ydiBackupMemory_xau16[1].amb_cond.ambient_condition[1][24] ZFEH_EepromData.ydiBackupMemory_xau16[1].amb_cond.ambient_condition[1][2] ZFEH_EepromData.ydiBackupMemory_xau16[1].amb_cond.ambient_condition[1][3] ZFEH_EepromData.ydiBackupMemory_xau16[1].amb_cond.ambient_condition[1][4] ZFEH_EepromData.ydiBackupMemory_xau16[1].amb_cond.ambient_condition[1][5] ZFEH_EepromData.ydiBackupMemory_xau16[1].amb_cond.ambient_condition[1][6] ZFEH_EepromData.ydiBackupMemory_xau16[1].amb_cond.ambient_condition[1][7] ZFEH_EepromData.ydiBackupMemory_xau16[1].amb_cond.ambient_condition[1][8] ZFEH_EepromData.ydiBackupMemory_xau16[1].amb_cond.ambient_condition[1][9] ZFEH_EepromData.ydiBackupMemory_xau16[1].amb_cond.status_of_ambient_conditions[0] ZFEH_EepromData.ydiBackupMemory_xau16[1].amb_cond.status_of_ambient_conditions[1] ZFEH_EepromData.ydiBackupMemory_xau16[1].backwards_counter ZFEH_EepromData.ydiBackupMemory_xau16[1].condition_byte ZFEH_EepromData.ydiBackupMemory_xau16[1].error_code ZFEH_EepromData.ydiBackupMemory_xau16[1].error_type ZFEH_EepromData.ydiBackupMemory_xau16[1].frequency_counter ZFEH_EepromData.ydiBackupMemory_xau16[1].master_time ZFEH_EepromData.ydiBackupMemory_xau16[1].obd_driving_cycle_counter ZFEH_EepromData.ydiBackupMemory_xau16[1].permanent_counter ZFEH_EepromData.ydiBackupMemory_xau16[1].sequence_counter ZFEH_EepromData.ydiBackupMemory_xau16[1].status_word ZFEH_EepromData.ydiBackupMemory_xau16[2].amb_cond.ambient_condition[0][0] ZFEH_EepromData.ydiBackupMemory_xau16[2].amb_cond.ambient_condition[0][10] ZFEH_EepromData.ydiBackupMemory_xau16[2].amb_cond.ambient_condition[0][11] ZFEH_EepromData.ydiBackupMemory_xau16[2].amb_cond.ambient_condition[0][12] ZFEH_EepromData.ydiBackupMemory_xau16[2].amb_cond.ambient_condition[0][13] ZFEH_EepromData.ydiBackupMemory_xau16[2].amb_cond.ambient_condition[0][14] ZFEH_EepromData.ydiBackupMemory_xau16[2].amb_cond.ambient_condition[0][15] ZFEH_EepromData.ydiBackupMemory_xau16[2].amb_cond.ambient_condition[0][16] ZFEH_EepromData.ydiBackupMemory_xau16[2].amb_cond.ambient_condition[0][17] ZFEH_EepromData.ydiBackupMemory_xau16[2].amb_cond.ambient_condition[0][18] ZFEH_EepromData.ydiBackupMemory_xau16[2].amb_cond.ambient_condition[0][19] ZFEH_EepromData.ydiBackupMemory_xau16[2].amb_cond.ambient_condition[0][1] ZFEH_EepromData.ydiBackupMemory_xau16[2].amb_cond.ambient_condition[0][20] ZFEH_EepromData.ydiBackupMemory_xau16[2].amb_cond.ambient_condition[0][21] ZFEH_EepromData.ydiBackupMemory_xau16[2].amb_cond.ambient_condition[0][22] ZFEH_EepromData.ydiBackupMemory_xau16[2].amb_cond.ambient_condition[0][23] ZFEH_EepromData.ydiBackupMemory_xau16[2].amb_cond.ambient_condition[0][24] ZFEH_EepromData.ydiBackupMemory_xau16[2].amb_cond.ambient_condition[0][2] ZFEH_EepromData.ydiBackupMemory_xau16[2].amb_cond.ambient_condition[0][3] ZFEH_EepromData.ydiBackupMemory_xau16[2].amb_cond.ambient_condition[0][4] ZFEH_EepromData.ydiBackupMemory_xau16[2].amb_cond.ambient_condition[0][5] ZFEH_EepromData.ydiBackupMemory_xau16[2].amb_cond.ambient_condition[0][6] ZFEH_EepromData.ydiBackupMemory_xau16[2].amb_cond.ambient_condition[0][7] ZFEH_EepromData.ydiBackupMemory_xau16[2].amb_cond.ambient_condition[0][8] ZFEH_EepromData.ydiBackupMemory_xau16[2].amb_cond.ambient_condition[0][9] ZFEH_EepromData.ydiBackupMemory_xau16[2].amb_cond.ambient_condition[1][0] ZFEH_EepromData.ydiBackupMemory_xau16[2].amb_cond.ambient_condition[1][10] ZFEH_EepromData.ydiBackupMemory_xau16[2].amb_cond.ambient_condition[1][11] ZFEH_EepromData.ydiBackupMemory_xau16[2].amb_cond.ambient_condition[1][12] ZFEH_EepromData.ydiBackupMemory_xau16[2].amb_cond.ambient_condition[1][13] ZFEH_EepromData.ydiBackupMemory_xau16[2].amb_cond.ambient_condition[1][14] ZFEH_EepromData.ydiBackupMemory_xau16[2].amb_cond.ambient_condition[1][15] ZFEH_EepromData.ydiBackupMemory_xau16[2].amb_cond.ambient_condition[1][16] ZFEH_EepromData.ydiBackupMemory_xau16[2].amb_cond.ambient_condition[1][17] ZFEH_EepromData.ydiBackupMemory_xau16[2].amb_cond.ambient_condition[1][18] ZFEH_EepromData.ydiBackupMemory_xau16[2].amb_cond.ambient_condition[1][19] ZFEH_EepromData.ydiBackupMemory_xau16[2].amb_cond.ambient_condition[1][1] ZFEH_EepromData.ydiBackupMemory_xau16[2].amb_cond.ambient_condition[1][20] ZFEH_EepromData.ydiBackupMemory_xau16[2].amb_cond.ambient_condition[1][21] ZFEH_EepromData.ydiBackupMemory_xau16[2].amb_cond.ambient_condition[1][22] ZFEH_EepromData.ydiBackupMemory_xau16[2].amb_cond.ambient_condition[1][23] ZFEH_EepromData.ydiBackupMemory_xau16[2].amb_cond.ambient_condition[1][24] ZFEH_EepromData.ydiBackupMemory_xau16[2].amb_cond.ambient_condition[1][2] ZFEH_EepromData.ydiBackupMemory_xau16[2].amb_cond.ambient_condition[1][3] ZFEH_EepromData.ydiBackupMemory_xau16[2].amb_cond.ambient_condition[1][4] ZFEH_EepromData.ydiBackupMemory_xau16[2].amb_cond.ambient_condition[1][5] ZFEH_EepromData.ydiBackupMemory_xau16[2].amb_cond.ambient_condition[1][6] ZFEH_EepromData.ydiBackupMemory_xau16[2].amb_cond.ambient_condition[1][7] ZFEH_EepromData.ydiBackupMemory_xau16[2].amb_cond.ambient_condition[1][8] ZFEH_EepromData.ydiBackupMemory_xau16[2].amb_cond.ambient_condition[1][9] ZFEH_EepromData.ydiBackupMemory_xau16[2].amb_cond.status_of_ambient_conditions[0] ZFEH_EepromData.ydiBackupMemory_xau16[2].amb_cond.status_of_ambient_conditions[1] ZFEH_EepromData.ydiBackupMemory_xau16[2].backwards_counter ZFEH_EepromData.ydiBackupMemory_xau16[2].condition_byte ZFEH_EepromData.ydiBackupMemory_xau16[2].error_code ZFEH_EepromData.ydiBackupMemory_xau16[2].error_type ZFEH_EepromData.ydiBackupMemory_xau16[2].frequency_counter ZFEH_EepromData.ydiBackupMemory_xau16[2].master_time ZFEH_EepromData.ydiBackupMemory_xau16[2].obd_driving_cycle_counter ZFEH_EepromData.ydiBackupMemory_xau16[2].permanent_counter ZFEH_EepromData.ydiBackupMemory_xau16[2].sequence_counter ZFEH_EepromData.ydiBackupMemory_xau16[2].status_word ZFEH_EepromData.ydiBackupMemory_xau16[3].amb_cond.ambient_condition[0][0] ZFEH_EepromData.ydiBackupMemory_xau16[3].amb_cond.ambient_condition[0][10] ZFEH_EepromData.ydiBackupMemory_xau16[3].amb_cond.ambient_condition[0][11] ZFEH_EepromData.ydiBackupMemory_xau16[3].amb_cond.ambient_condition[0][12] ZFEH_EepromData.ydiBackupMemory_xau16[3].amb_cond.ambient_condition[0][13] ZFEH_EepromData.ydiBackupMemory_xau16[3].amb_cond.ambient_condition[0][14] ZFEH_EepromData.ydiBackupMemory_xau16[3].amb_cond.ambient_condition[0][15] ZFEH_EepromData.ydiBackupMemory_xau16[3].amb_cond.ambient_condition[0][16] ZFEH_EepromData.ydiBackupMemory_xau16[3].amb_cond.ambient_condition[0][17] ZFEH_EepromData.ydiBackupMemory_xau16[3].amb_cond.ambient_condition[0][18] ZFEH_EepromData.ydiBackupMemory_xau16[3].amb_cond.ambient_condition[0][19] ZFEH_EepromData.ydiBackupMemory_xau16[3].amb_cond.ambient_condition[0][1] ZFEH_EepromData.ydiBackupMemory_xau16[3].amb_cond.ambient_condition[0][20] ZFEH_EepromData.ydiBackupMemory_xau16[3].amb_cond.ambient_condition[0][21] ZFEH_EepromData.ydiBackupMemory_xau16[3].amb_cond.ambient_condition[0][22] ZFEH_EepromData.ydiBackupMemory_xau16[3].amb_cond.ambient_condition[0][23] ZFEH_EepromData.ydiBackupMemory_xau16[3].amb_cond.ambient_condition[0][24] ZFEH_EepromData.ydiBackupMemory_xau16[3].amb_cond.ambient_condition[0][2] ZFEH_EepromData.ydiBackupMemory_xau16[3].amb_cond.ambient_condition[0][3] ZFEH_EepromData.ydiBackupMemory_xau16[3].amb_cond.ambient_condition[0][4] ZFEH_EepromData.ydiBackupMemory_xau16[3].amb_cond.ambient_condition[0][5] ZFEH_EepromData.ydiBackupMemory_xau16[3].amb_cond.ambient_condition[0][6] ZFEH_EepromData.ydiBackupMemory_xau16[3].amb_cond.ambient_condition[0][7] ZFEH_EepromData.ydiBackupMemory_xau16[3].amb_cond.ambient_condition[0][8] ZFEH_EepromData.ydiBackupMemory_xau16[3].amb_cond.ambient_condition[0][9] ZFEH_EepromData.ydiBackupMemory_xau16[3].amb_cond.ambient_condition[1][0] ZFEH_EepromData.ydiBackupMemory_xau16[3].amb_cond.ambient_condition[1][10] ZFEH_EepromData.ydiBackupMemory_xau16[3].amb_cond.ambient_condition[1][11] ZFEH_EepromData.ydiBackupMemory_xau16[3].amb_cond.ambient_condition[1][12] ZFEH_EepromData.ydiBackupMemory_xau16[3].amb_cond.ambient_condition[1][13] ZFEH_EepromData.ydiBackupMemory_xau16[3].amb_cond.ambient_condition[1][14] ZFEH_EepromData.ydiBackupMemory_xau16[3].amb_cond.ambient_condition[1][15] ZFEH_EepromData.ydiBackupMemory_xau16[3].amb_cond.ambient_condition[1][16] ZFEH_EepromData.ydiBackupMemory_xau16[3].amb_cond.ambient_condition[1][17] ZFEH_EepromData.ydiBackupMemory_xau16[3].amb_cond.ambient_condition[1][18] ZFEH_EepromData.ydiBackupMemory_xau16[3].amb_cond.ambient_condition[1][19] ZFEH_EepromData.ydiBackupMemory_xau16[3].amb_cond.ambient_condition[1][1] ZFEH_EepromData.ydiBackupMemory_xau16[3].amb_cond.ambient_condition[1][20] ZFEH_EepromData.ydiBackupMemory_xau16[3].amb_cond.ambient_condition[1][21] ZFEH_EepromData.ydiBackupMemory_xau16[3].amb_cond.ambient_condition[1][22] ZFEH_EepromData.ydiBackupMemory_xau16[3].amb_cond.ambient_condition[1][23] ZFEH_EepromData.ydiBackupMemory_xau16[3].amb_cond.ambient_condition[1][24] ZFEH_EepromData.ydiBackupMemory_xau16[3].amb_cond.ambient_condition[1][2] ZFEH_EepromData.ydiBackupMemory_xau16[3].amb_cond.ambient_condition[1][3] ZFEH_EepromData.ydiBackupMemory_xau16[3].amb_cond.ambient_condition[1][4] ZFEH_EepromData.ydiBackupMemory_xau16[3].amb_cond.ambient_condition[1][5] ZFEH_EepromData.ydiBackupMemory_xau16[3].amb_cond.ambient_condition[1][6] ZFEH_EepromData.ydiBackupMemory_xau16[3].amb_cond.ambient_condition[1][7] ZFEH_EepromData.ydiBackupMemory_xau16[3].amb_cond.ambient_condition[1][8] ZFEH_EepromData.ydiBackupMemory_xau16[3].amb_cond.ambient_condition[1][9] ZFEH_EepromData.ydiBackupMemory_xau16[3].amb_cond.status_of_ambient_conditions[0] ZFEH_EepromData.ydiBackupMemory_xau16[3].amb_cond.status_of_ambient_conditions[1] ZFEH_EepromData.ydiBackupMemory_xau16[3].backwards_counter ZFEH_EepromData.ydiBackupMemory_xau16[3].condition_byte ZFEH_EepromData.ydiBackupMemory_xau16[3].error_code ZFEH_EepromData.ydiBackupMemory_xau16[3].error_type ZFEH_EepromData.ydiBackupMemory_xau16[3].frequency_counter ZFEH_EepromData.ydiBackupMemory_xau16[3].master_time ZFEH_EepromData.ydiBackupMemory_xau16[3].obd_driving_cycle_counter ZFEH_EepromData.ydiBackupMemory_xau16[3].permanent_counter ZFEH_EepromData.ydiBackupMemory_xau16[3].sequence_counter ZFEH_EepromData.ydiBackupMemory_xau16[3].status_word ZFEH_EepromData.ydiBackupMemory_xau16[4].amb_cond.ambient_condition[0][0] ZFEH_EepromData.ydiBackupMemory_xau16[4].amb_cond.ambient_condition[0][10] ZFEH_EepromData.ydiBackupMemory_xau16[4].amb_cond.ambient_condition[0][11] ZFEH_EepromData.ydiBackupMemory_xau16[4].amb_cond.ambient_condition[0][12] ZFEH_EepromData.ydiBackupMemory_xau16[4].amb_cond.ambient_condition[0][13] ZFEH_EepromData.ydiBackupMemory_xau16[4].amb_cond.ambient_condition[0][14] ZFEH_EepromData.ydiBackupMemory_xau16[4].amb_cond.ambient_condition[0][15] ZFEH_EepromData.ydiBackupMemory_xau16[4].amb_cond.ambient_condition[0][16] ZFEH_EepromData.ydiBackupMemory_xau16[4].amb_cond.ambient_condition[0][17] ZFEH_EepromData.ydiBackupMemory_xau16[4].amb_cond.ambient_condition[0][18] ZFEH_EepromData.ydiBackupMemory_xau16[4].amb_cond.ambient_condition[0][19] ZFEH_EepromData.ydiBackupMemory_xau16[4].amb_cond.ambient_condition[0][1] ZFEH_EepromData.ydiBackupMemory_xau16[4].amb_cond.ambient_condition[0][20] ZFEH_EepromData.ydiBackupMemory_xau16[4].amb_cond.ambient_condition[0][21] ZFEH_EepromData.ydiBackupMemory_xau16[4].amb_cond.ambient_condition[0][22] ZFEH_EepromData.ydiBackupMemory_xau16[4].amb_cond.ambient_condition[0][23] ZFEH_EepromData.ydiBackupMemory_xau16[4].amb_cond.ambient_condition[0][24] ZFEH_EepromData.ydiBackupMemory_xau16[4].amb_cond.ambient_condition[0][2] ZFEH_EepromData.ydiBackupMemory_xau16[4].amb_cond.ambient_condition[0][3] ZFEH_EepromData.ydiBackupMemory_xau16[4].amb_cond.ambient_condition[0][4] ZFEH_EepromData.ydiBackupMemory_xau16[4].amb_cond.ambient_condition[0][5] ZFEH_EepromData.ydiBackupMemory_xau16[4].amb_cond.ambient_condition[0][6] ZFEH_EepromData.ydiBackupMemory_xau16[4].amb_cond.ambient_condition[0][7] ZFEH_EepromData.ydiBackupMemory_xau16[4].amb_cond.ambient_condition[0][8] ZFEH_EepromData.ydiBackupMemory_xau16[4].amb_cond.ambient_condition[0][9] ZFEH_EepromData.ydiBackupMemory_xau16[4].amb_cond.ambient_condition[1][0] ZFEH_EepromData.ydiBackupMemory_xau16[4].amb_cond.ambient_condition[1][10] ZFEH_EepromData.ydiBackupMemory_xau16[4].amb_cond.ambient_condition[1][11] ZFEH_EepromData.ydiBackupMemory_xau16[4].amb_cond.ambient_condition[1][12] ZFEH_EepromData.ydiBackupMemory_xau16[4].amb_cond.ambient_condition[1][13] ZFEH_EepromData.ydiBackupMemory_xau16[4].amb_cond.ambient_condition[1][14] ZFEH_EepromData.ydiBackupMemory_xau16[4].amb_cond.ambient_condition[1][15] ZFEH_EepromData.ydiBackupMemory_xau16[4].amb_cond.ambient_condition[1][16] ZFEH_EepromData.ydiBackupMemory_xau16[4].amb_cond.ambient_condition[1][17] ZFEH_EepromData.ydiBackupMemory_xau16[4].amb_cond.ambient_condition[1][18] ZFEH_EepromData.ydiBackupMemory_xau16[4].amb_cond.ambient_condition[1][19] ZFEH_EepromData.ydiBackupMemory_xau16[4].amb_cond.ambient_condition[1][1] ZFEH_EepromData.ydiBackupMemory_xau16[4].amb_cond.ambient_condition[1][20] ZFEH_EepromData.ydiBackupMemory_xau16[4].amb_cond.ambient_condition[1][21] ZFEH_EepromData.ydiBackupMemory_xau16[4].amb_cond.ambient_condition[1][22] ZFEH_EepromData.ydiBackupMemory_xau16[4].amb_cond.ambient_condition[1][23] ZFEH_EepromData.ydiBackupMemory_xau16[4].amb_cond.ambient_condition[1][24] ZFEH_EepromData.ydiBackupMemory_xau16[4].amb_cond.ambient_condition[1][2] ZFEH_EepromData.ydiBackupMemory_xau16[4].amb_cond.ambient_condition[1][3] ZFEH_EepromData.ydiBackupMemory_xau16[4].amb_cond.ambient_condition[1][4] ZFEH_EepromData.ydiBackupMemory_xau16[4].amb_cond.ambient_condition[1][5] ZFEH_EepromData.ydiBackupMemory_xau16[4].amb_cond.ambient_condition[1][6] ZFEH_EepromData.ydiBackupMemory_xau16[4].amb_cond.ambient_condition[1][7] ZFEH_EepromData.ydiBackupMemory_xau16[4].amb_cond.ambient_condition[1][8] ZFEH_EepromData.ydiBackupMemory_xau16[4].amb_cond.ambient_condition[1][9] ZFEH_EepromData.ydiBackupMemory_xau16[4].amb_cond.status_of_ambient_conditions[0] ZFEH_EepromData.ydiBackupMemory_xau16[4].amb_cond.status_of_ambient_conditions[1] ZFEH_EepromData.ydiBackupMemory_xau16[4].backwards_counter ZFEH_EepromData.ydiBackupMemory_xau16[4].condition_byte ZFEH_EepromData.ydiBackupMemory_xau16[4].error_code ZFEH_EepromData.ydiBackupMemory_xau16[4].error_type ZFEH_EepromData.ydiBackupMemory_xau16[4].frequency_counter ZFEH_EepromData.ydiBackupMemory_xau16[4].master_time ZFEH_EepromData.ydiBackupMemory_xau16[4].obd_driving_cycle_counter ZFEH_EepromData.ydiBackupMemory_xau16[4].permanent_counter ZFEH_EepromData.ydiBackupMemory_xau16[4].sequence_counter ZFEH_EepromData.ydiBackupMemory_xau16[4].status_word ZFEH_EepromData.ydiBackupMemory_xau16[5].amb_cond.ambient_condition[0][0] ZFEH_EepromData.ydiBackupMemory_xau16[5].amb_cond.ambient_condition[0][10] ZFEH_EepromData.ydiBackupMemory_xau16[5].amb_cond.ambient_condition[0][11] ZFEH_EepromData.ydiBackupMemory_xau16[5].amb_cond.ambient_condition[0][12] ZFEH_EepromData.ydiBackupMemory_xau16[5].amb_cond.ambient_condition[0][13] ZFEH_EepromData.ydiBackupMemory_xau16[5].amb_cond.ambient_condition[0][14] ZFEH_EepromData.ydiBackupMemory_xau16[5].amb_cond.ambient_condition[0][15] ZFEH_EepromData.ydiBackupMemory_xau16[5].amb_cond.ambient_condition[0][16] ZFEH_EepromData.ydiBackupMemory_xau16[5].amb_cond.ambient_condition[0][17] ZFEH_EepromData.ydiBackupMemory_xau16[5].amb_cond.ambient_condition[0][18] ZFEH_EepromData.ydiBackupMemory_xau16[5].amb_cond.ambient_condition[0][19] ZFEH_EepromData.ydiBackupMemory_xau16[5].amb_cond.ambient_condition[0][1] ZFEH_EepromData.ydiBackupMemory_xau16[5].amb_cond.ambient_condition[0][20] ZFEH_EepromData.ydiBackupMemory_xau16[5].amb_cond.ambient_condition[0][21] ZFEH_EepromData.ydiBackupMemory_xau16[5].amb_cond.ambient_condition[0][22] ZFEH_EepromData.ydiBackupMemory_xau16[5].amb_cond.ambient_condition[0][23] ZFEH_EepromData.ydiBackupMemory_xau16[5].amb_cond.ambient_condition[0][24] ZFEH_EepromData.ydiBackupMemory_xau16[5].amb_cond.ambient_condition[0][2] ZFEH_EepromData.ydiBackupMemory_xau16[5].amb_cond.ambient_condition[0][3] ZFEH_EepromData.ydiBackupMemory_xau16[5].amb_cond.ambient_condition[0][4] ZFEH_EepromData.ydiBackupMemory_xau16[5].amb_cond.ambient_condition[0][5] ZFEH_EepromData.ydiBackupMemory_xau16[5].amb_cond.ambient_condition[0][6] ZFEH_EepromData.ydiBackupMemory_xau16[5].amb_cond.ambient_condition[0][7] ZFEH_EepromData.ydiBackupMemory_xau16[5].amb_cond.ambient_condition[0][8] ZFEH_EepromData.ydiBackupMemory_xau16[5].amb_cond.ambient_condition[0][9] ZFEH_EepromData.ydiBackupMemory_xau16[5].amb_cond.ambient_condition[1][0] ZFEH_EepromData.ydiBackupMemory_xau16[5].amb_cond.ambient_condition[1][10] ZFEH_EepromData.ydiBackupMemory_xau16[5].amb_cond.ambient_condition[1][11] ZFEH_EepromData.ydiBackupMemory_xau16[5].amb_cond.ambient_condition[1][12] ZFEH_EepromData.ydiBackupMemory_xau16[5].amb_cond.ambient_condition[1][13] ZFEH_EepromData.ydiBackupMemory_xau16[5].amb_cond.ambient_condition[1][14] ZFEH_EepromData.ydiBackupMemory_xau16[5].amb_cond.ambient_condition[1][15] ZFEH_EepromData.ydiBackupMemory_xau16[5].amb_cond.ambient_condition[1][16] ZFEH_EepromData.ydiBackupMemory_xau16[5].amb_cond.ambient_condition[1][17] ZFEH_EepromData.ydiBackupMemory_xau16[5].amb_cond.ambient_condition[1][18] ZFEH_EepromData.ydiBackupMemory_xau16[5].amb_cond.ambient_condition[1][19] ZFEH_EepromData.ydiBackupMemory_xau16[5].amb_cond.ambient_condition[1][1] ZFEH_EepromData.ydiBackupMemory_xau16[5].amb_cond.ambient_condition[1][20] ZFEH_EepromData.ydiBackupMemory_xau16[5].amb_cond.ambient_condition[1][21] ZFEH_EepromData.ydiBackupMemory_xau16[5].amb_cond.ambient_condition[1][22] ZFEH_EepromData.ydiBackupMemory_xau16[5].amb_cond.ambient_condition[1][23] ZFEH_EepromData.ydiBackupMemory_xau16[5].amb_cond.ambient_condition[1][24] ZFEH_EepromData.ydiBackupMemory_xau16[5].amb_cond.ambient_condition[1][2] ZFEH_EepromData.ydiBackupMemory_xau16[5].amb_cond.ambient_condition[1][3] ZFEH_EepromData.ydiBackupMemory_xau16[5].amb_cond.ambient_condition[1][4] ZFEH_EepromData.ydiBackupMemory_xau16[5].amb_cond.ambient_condition[1][5] ZFEH_EepromData.ydiBackupMemory_xau16[5].amb_cond.ambient_condition[1][6] ZFEH_EepromData.ydiBackupMemory_xau16[5].amb_cond.ambient_condition[1][7] ZFEH_EepromData.ydiBackupMemory_xau16[5].amb_cond.ambient_condition[1][8] ZFEH_EepromData.ydiBackupMemory_xau16[5].amb_cond.ambient_condition[1][9] ZFEH_EepromData.ydiBackupMemory_xau16[5].amb_cond.status_of_ambient_conditions[0] ZFEH_EepromData.ydiBackupMemory_xau16[5].amb_cond.status_of_ambient_conditions[1] ZFEH_EepromData.ydiBackupMemory_xau16[5].backwards_counter ZFEH_EepromData.ydiBackupMemory_xau16[5].condition_byte ZFEH_EepromData.ydiBackupMemory_xau16[5].error_code ZFEH_EepromData.ydiBackupMemory_xau16[5].error_type ZFEH_EepromData.ydiBackupMemory_xau16[5].frequency_counter ZFEH_EepromData.ydiBackupMemory_xau16[5].master_time ZFEH_EepromData.ydiBackupMemory_xau16[5].obd_driving_cycle_counter ZFEH_EepromData.ydiBackupMemory_xau16[5].permanent_counter ZFEH_EepromData.ydiBackupMemory_xau16[5].sequence_counter ZFEH_EepromData.ydiBackupMemory_xau16[5].status_word ZFEH_EepromData.ydiBackupMemory_xau16[6].amb_cond.ambient_condition[0][0] ZFEH_EepromData.ydiBackupMemory_xau16[6].amb_cond.ambient_condition[0][10] ZFEH_EepromData.ydiBackupMemory_xau16[6].amb_cond.ambient_condition[0][11] ZFEH_EepromData.ydiBackupMemory_xau16[6].amb_cond.ambient_condition[0][12] ZFEH_EepromData.ydiBackupMemory_xau16[6].amb_cond.ambient_condition[0][13] ZFEH_EepromData.ydiBackupMemory_xau16[6].amb_cond.ambient_condition[0][14] ZFEH_EepromData.ydiBackupMemory_xau16[6].amb_cond.ambient_condition[0][15] ZFEH_EepromData.ydiBackupMemory_xau16[6].amb_cond.ambient_condition[0][16] ZFEH_EepromData.ydiBackupMemory_xau16[6].amb_cond.ambient_condition[0][17] ZFEH_EepromData.ydiBackupMemory_xau16[6].amb_cond.ambient_condition[0][18] ZFEH_EepromData.ydiBackupMemory_xau16[6].amb_cond.ambient_condition[0][19] ZFEH_EepromData.ydiBackupMemory_xau16[6].amb_cond.ambient_condition[0][1] ZFEH_EepromData.ydiBackupMemory_xau16[6].amb_cond.ambient_condition[0][20] ZFEH_EepromData.ydiBackupMemory_xau16[6].amb_cond.ambient_condition[0][21] ZFEH_EepromData.ydiBackupMemory_xau16[6].amb_cond.ambient_condition[0][22] ZFEH_EepromData.ydiBackupMemory_xau16[6].amb_cond.ambient_condition[0][23] ZFEH_EepromData.ydiBackupMemory_xau16[6].amb_cond.ambient_condition[0][24] ZFEH_EepromData.ydiBackupMemory_xau16[6].amb_cond.ambient_condition[0][2] ZFEH_EepromData.ydiBackupMemory_xau16[6].amb_cond.ambient_condition[0][3] ZFEH_EepromData.ydiBackupMemory_xau16[6].amb_cond.ambient_condition[0][4] ZFEH_EepromData.ydiBackupMemory_xau16[6].amb_cond.ambient_condition[0][5] ZFEH_EepromData.ydiBackupMemory_xau16[6].amb_cond.ambient_condition[0][6] ZFEH_EepromData.ydiBackupMemory_xau16[6].amb_cond.ambient_condition[0][7] ZFEH_EepromData.ydiBackupMemory_xau16[6].amb_cond.ambient_condition[0][8] ZFEH_EepromData.ydiBackupMemory_xau16[6].amb_cond.ambient_condition[0][9] ZFEH_EepromData.ydiBackupMemory_xau16[6].amb_cond.ambient_condition[1][0] ZFEH_EepromData.ydiBackupMemory_xau16[6].amb_cond.ambient_condition[1][10] ZFEH_EepromData.ydiBackupMemory_xau16[6].amb_cond.ambient_condition[1][11] ZFEH_EepromData.ydiBackupMemory_xau16[6].amb_cond.ambient_condition[1][12] ZFEH_EepromData.ydiBackupMemory_xau16[6].amb_cond.ambient_condition[1][13] ZFEH_EepromData.ydiBackupMemory_xau16[6].amb_cond.ambient_condition[1][14] ZFEH_EepromData.ydiBackupMemory_xau16[6].amb_cond.ambient_condition[1][15] ZFEH_EepromData.ydiBackupMemory_xau16[6].amb_cond.ambient_condition[1][16] ZFEH_EepromData.ydiBackupMemory_xau16[6].amb_cond.ambient_condition[1][17] ZFEH_EepromData.ydiBackupMemory_xau16[6].amb_cond.ambient_condition[1][18] ZFEH_EepromData.ydiBackupMemory_xau16[6].amb_cond.ambient_condition[1][19] ZFEH_EepromData.ydiBackupMemory_xau16[6].amb_cond.ambient_condition[1][1] ZFEH_EepromData.ydiBackupMemory_xau16[6].amb_cond.ambient_condition[1][20] ZFEH_EepromData.ydiBackupMemory_xau16[6].amb_cond.ambient_condition[1][21] ZFEH_EepromData.ydiBackupMemory_xau16[6].amb_cond.ambient_condition[1][22] ZFEH_EepromData.ydiBackupMemory_xau16[6].amb_cond.ambient_condition[1][23] ZFEH_EepromData.ydiBackupMemory_xau16[6].amb_cond.ambient_condition[1][24] ZFEH_EepromData.ydiBackupMemory_xau16[6].amb_cond.ambient_condition[1][2] ZFEH_EepromData.ydiBackupMemory_xau16[6].amb_cond.ambient_condition[1][3] ZFEH_EepromData.ydiBackupMemory_xau16[6].amb_cond.ambient_condition[1][4] ZFEH_EepromData.ydiBackupMemory_xau16[6].amb_cond.ambient_condition[1][5] ZFEH_EepromData.ydiBackupMemory_xau16[6].amb_cond.ambient_condition[1][6] ZFEH_EepromData.ydiBackupMemory_xau16[6].amb_cond.ambient_condition[1][7] ZFEH_EepromData.ydiBackupMemory_xau16[6].amb_cond.ambient_condition[1][8] ZFEH_EepromData.ydiBackupMemory_xau16[6].amb_cond.ambient_condition[1][9] ZFEH_EepromData.ydiBackupMemory_xau16[6].amb_cond.status_of_ambient_conditions[0] ZFEH_EepromData.ydiBackupMemory_xau16[6].amb_cond.status_of_ambient_conditions[1] ZFEH_EepromData.ydiBackupMemory_xau16[6].backwards_counter ZFEH_EepromData.ydiBackupMemory_xau16[6].condition_byte ZFEH_EepromData.ydiBackupMemory_xau16[6].error_code ZFEH_EepromData.ydiBackupMemory_xau16[6].error_type ZFEH_EepromData.ydiBackupMemory_xau16[6].frequency_counter ZFEH_EepromData.ydiBackupMemory_xau16[6].master_time ZFEH_EepromData.ydiBackupMemory_xau16[6].obd_driving_cycle_counter ZFEH_EepromData.ydiBackupMemory_xau16[6].permanent_counter ZFEH_EepromData.ydiBackupMemory_xau16[6].sequence_counter ZFEH_EepromData.ydiBackupMemory_xau16[6].status_word ZFEH_EepromData.ydiBackupMemory_xau16[7].amb_cond.ambient_condition[0][0] ZFEH_EepromData.ydiBackupMemory_xau16[7].amb_cond.ambient_condition[0][10] ZFEH_EepromData.ydiBackupMemory_xau16[7].amb_cond.ambient_condition[0][11] ZFEH_EepromData.ydiBackupMemory_xau16[7].amb_cond.ambient_condition[0][12] ZFEH_EepromData.ydiBackupMemory_xau16[7].amb_cond.ambient_condition[0][13] ZFEH_EepromData.ydiBackupMemory_xau16[7].amb_cond.ambient_condition[0][14] ZFEH_EepromData.ydiBackupMemory_xau16[7].amb_cond.ambient_condition[0][15] ZFEH_EepromData.ydiBackupMemory_xau16[7].amb_cond.ambient_condition[0][16] ZFEH_EepromData.ydiBackupMemory_xau16[7].amb_cond.ambient_condition[0][17] ZFEH_EepromData.ydiBackupMemory_xau16[7].amb_cond.ambient_condition[0][18] ZFEH_EepromData.ydiBackupMemory_xau16[7].amb_cond.ambient_condition[0][19] ZFEH_EepromData.ydiBackupMemory_xau16[7].amb_cond.ambient_condition[0][1] ZFEH_EepromData.ydiBackupMemory_xau16[7].amb_cond.ambient_condition[0][20] ZFEH_EepromData.ydiBackupMemory_xau16[7].amb_cond.ambient_condition[0][21] ZFEH_EepromData.ydiBackupMemory_xau16[7].amb_cond.ambient_condition[0][22] ZFEH_EepromData.ydiBackupMemory_xau16[7].amb_cond.ambient_condition[0][23] ZFEH_EepromData.ydiBackupMemory_xau16[7].amb_cond.ambient_condition[0][24] ZFEH_EepromData.ydiBackupMemory_xau16[7].amb_cond.ambient_condition[0][2] ZFEH_EepromData.ydiBackupMemory_xau16[7].amb_cond.ambient_condition[0][3] ZFEH_EepromData.ydiBackupMemory_xau16[7].amb_cond.ambient_condition[0][4] ZFEH_EepromData.ydiBackupMemory_xau16[7].amb_cond.ambient_condition[0][5] ZFEH_EepromData.ydiBackupMemory_xau16[7].amb_cond.ambient_condition[0][6] ZFEH_EepromData.ydiBackupMemory_xau16[7].amb_cond.ambient_condition[0][7] ZFEH_EepromData.ydiBackupMemory_xau16[7].amb_cond.ambient_condition[0][8] ZFEH_EepromData.ydiBackupMemory_xau16[7].amb_cond.ambient_condition[0][9] ZFEH_EepromData.ydiBackupMemory_xau16[7].amb_cond.ambient_condition[1][0] ZFEH_EepromData.ydiBackupMemory_xau16[7].amb_cond.ambient_condition[1][10] ZFEH_EepromData.ydiBackupMemory_xau16[7].amb_cond.ambient_condition[1][11] ZFEH_EepromData.ydiBackupMemory_xau16[7].amb_cond.ambient_condition[1][12] ZFEH_EepromData.ydiBackupMemory_xau16[7].amb_cond.ambient_condition[1][13] ZFEH_EepromData.ydiBackupMemory_xau16[7].amb_cond.ambient_condition[1][14] ZFEH_EepromData.ydiBackupMemory_xau16[7].amb_cond.ambient_condition[1][15] ZFEH_EepromData.ydiBackupMemory_xau16[7].amb_cond.ambient_condition[1][16] ZFEH_EepromData.ydiBackupMemory_xau16[7].amb_cond.ambient_condition[1][17] ZFEH_EepromData.ydiBackupMemory_xau16[7].amb_cond.ambient_condition[1][18] ZFEH_EepromData.ydiBackupMemory_xau16[7].amb_cond.ambient_condition[1][19] ZFEH_EepromData.ydiBackupMemory_xau16[7].amb_cond.ambient_condition[1][1] ZFEH_EepromData.ydiBackupMemory_xau16[7].amb_cond.ambient_condition[1][20] ZFEH_EepromData.ydiBackupMemory_xau16[7].amb_cond.ambient_condition[1][21] ZFEH_EepromData.ydiBackupMemory_xau16[7].amb_cond.ambient_condition[1][22] ZFEH_EepromData.ydiBackupMemory_xau16[7].amb_cond.ambient_condition[1][23] ZFEH_EepromData.ydiBackupMemory_xau16[7].amb_cond.ambient_condition[1][24] ZFEH_EepromData.ydiBackupMemory_xau16[7].amb_cond.ambient_condition[1][2] ZFEH_EepromData.ydiBackupMemory_xau16[7].amb_cond.ambient_condition[1][3] ZFEH_EepromData.ydiBackupMemory_xau16[7].amb_cond.ambient_condition[1][4] ZFEH_EepromData.ydiBackupMemory_xau16[7].amb_cond.ambient_condition[1][5] ZFEH_EepromData.ydiBackupMemory_xau16[7].amb_cond.ambient_condition[1][6] ZFEH_EepromData.ydiBackupMemory_xau16[7].amb_cond.ambient_condition[1][7] ZFEH_EepromData.ydiBackupMemory_xau16[7].amb_cond.ambient_condition[1][8] ZFEH_EepromData.ydiBackupMemory_xau16[7].amb_cond.ambient_condition[1][9] ZFEH_EepromData.ydiBackupMemory_xau16[7].amb_cond.status_of_ambient_conditions[0] ZFEH_EepromData.ydiBackupMemory_xau16[7].amb_cond.status_of_ambient_conditions[1] ZFEH_EepromData.ydiBackupMemory_xau16[7].backwards_counter ZFEH_EepromData.ydiBackupMemory_xau16[7].condition_byte ZFEH_EepromData.ydiBackupMemory_xau16[7].error_code ZFEH_EepromData.ydiBackupMemory_xau16[7].error_type ZFEH_EepromData.ydiBackupMemory_xau16[7].frequency_counter ZFEH_EepromData.ydiBackupMemory_xau16[7].master_time ZFEH_EepromData.ydiBackupMemory_xau16[7].obd_driving_cycle_counter ZFEH_EepromData.ydiBackupMemory_xau16[7].permanent_counter ZFEH_EepromData.ydiBackupMemory_xau16[7].sequence_counter ZFEH_EepromData.ydiBackupMemory_xau16[7].status_word ZFEH_EepromData.ydiBackupMemory_xau16[8].amb_cond.ambient_condition[0][0] ZFEH_EepromData.ydiBackupMemory_xau16[8].amb_cond.ambient_condition[0][10] ZFEH_EepromData.ydiBackupMemory_xau16[8].amb_cond.ambient_condition[0][11] ZFEH_EepromData.ydiBackupMemory_xau16[8].amb_cond.ambient_condition[0][12] ZFEH_EepromData.ydiBackupMemory_xau16[8].amb_cond.ambient_condition[0][13] ZFEH_EepromData.ydiBackupMemory_xau16[8].amb_cond.ambient_condition[0][14] ZFEH_EepromData.ydiBackupMemory_xau16[8].amb_cond.ambient_condition[0][15] ZFEH_EepromData.ydiBackupMemory_xau16[8].amb_cond.ambient_condition[0][16] ZFEH_EepromData.ydiBackupMemory_xau16[8].amb_cond.ambient_condition[0][17] ZFEH_EepromData.ydiBackupMemory_xau16[8].amb_cond.ambient_condition[0][18] ZFEH_EepromData.ydiBackupMemory_xau16[8].amb_cond.ambient_condition[0][19] ZFEH_EepromData.ydiBackupMemory_xau16[8].amb_cond.ambient_condition[0][1] ZFEH_EepromData.ydiBackupMemory_xau16[8].amb_cond.ambient_condition[0][20] ZFEH_EepromData.ydiBackupMemory_xau16[8].amb_cond.ambient_condition[0][21] ZFEH_EepromData.ydiBackupMemory_xau16[8].amb_cond.ambient_condition[0][22] ZFEH_EepromData.ydiBackupMemory_xau16[8].amb_cond.ambient_condition[0][23] ZFEH_EepromData.ydiBackupMemory_xau16[8].amb_cond.ambient_condition[0][24] ZFEH_EepromData.ydiBackupMemory_xau16[8].amb_cond.ambient_condition[0][2] ZFEH_EepromData.ydiBackupMemory_xau16[8].amb_cond.ambient_condition[0][3] ZFEH_EepromData.ydiBackupMemory_xau16[8].amb_cond.ambient_condition[0][4] ZFEH_EepromData.ydiBackupMemory_xau16[8].amb_cond.ambient_condition[0][5] ZFEH_EepromData.ydiBackupMemory_xau16[8].amb_cond.ambient_condition[0][6] ZFEH_EepromData.ydiBackupMemory_xau16[8].amb_cond.ambient_condition[0][7] ZFEH_EepromData.ydiBackupMemory_xau16[8].amb_cond.ambient_condition[0][8] ZFEH_EepromData.ydiBackupMemory_xau16[8].amb_cond.ambient_condition[0][9] ZFEH_EepromData.ydiBackupMemory_xau16[8].amb_cond.ambient_condition[1][0] ZFEH_EepromData.ydiBackupMemory_xau16[8].amb_cond.ambient_condition[1][10] ZFEH_EepromData.ydiBackupMemory_xau16[8].amb_cond.ambient_condition[1][11] ZFEH_EepromData.ydiBackupMemory_xau16[8].amb_cond.ambient_condition[1][12] ZFEH_EepromData.ydiBackupMemory_xau16[8].amb_cond.ambient_condition[1][13] ZFEH_EepromData.ydiBackupMemory_xau16[8].amb_cond.ambient_condition[1][14] ZFEH_EepromData.ydiBackupMemory_xau16[8].amb_cond.ambient_condition[1][15] ZFEH_EepromData.ydiBackupMemory_xau16[8].amb_cond.ambient_condition[1][16] ZFEH_EepromData.ydiBackupMemory_xau16[8].amb_cond.ambient_condition[1][17] ZFEH_EepromData.ydiBackupMemory_xau16[8].amb_cond.ambient_condition[1][18] ZFEH_EepromData.ydiBackupMemory_xau16[8].amb_cond.ambient_condition[1][19] ZFEH_EepromData.ydiBackupMemory_xau16[8].amb_cond.ambient_condition[1][1] ZFEH_EepromData.ydiBackupMemory_xau16[8].amb_cond.ambient_condition[1][20] ZFEH_EepromData.ydiBackupMemory_xau16[8].amb_cond.ambient_condition[1][21] ZFEH_EepromData.ydiBackupMemory_xau16[8].amb_cond.ambient_condition[1][22] ZFEH_EepromData.ydiBackupMemory_xau16[8].amb_cond.ambient_condition[1][23] ZFEH_EepromData.ydiBackupMemory_xau16[8].amb_cond.ambient_condition[1][24] ZFEH_EepromData.ydiBackupMemory_xau16[8].amb_cond.ambient_condition[1][2] ZFEH_EepromData.ydiBackupMemory_xau16[8].amb_cond.ambient_condition[1][3] ZFEH_EepromData.ydiBackupMemory_xau16[8].amb_cond.ambient_condition[1][4] ZFEH_EepromData.ydiBackupMemory_xau16[8].amb_cond.ambient_condition[1][5] ZFEH_EepromData.ydiBackupMemory_xau16[8].amb_cond.ambient_condition[1][6] ZFEH_EepromData.ydiBackupMemory_xau16[8].amb_cond.ambient_condition[1][7] ZFEH_EepromData.ydiBackupMemory_xau16[8].amb_cond.ambient_condition[1][8] ZFEH_EepromData.ydiBackupMemory_xau16[8].amb_cond.ambient_condition[1][9] ZFEH_EepromData.ydiBackupMemory_xau16[8].amb_cond.status_of_ambient_conditions[0] ZFEH_EepromData.ydiBackupMemory_xau16[8].amb_cond.status_of_ambient_conditions[1] ZFEH_EepromData.ydiBackupMemory_xau16[8].backwards_counter ZFEH_EepromData.ydiBackupMemory_xau16[8].condition_byte ZFEH_EepromData.ydiBackupMemory_xau16[8].error_code ZFEH_EepromData.ydiBackupMemory_xau16[8].error_type ZFEH_EepromData.ydiBackupMemory_xau16[8].frequency_counter ZFEH_EepromData.ydiBackupMemory_xau16[8].master_time ZFEH_EepromData.ydiBackupMemory_xau16[8].obd_driving_cycle_counter ZFEH_EepromData.ydiBackupMemory_xau16[8].permanent_counter ZFEH_EepromData.ydiBackupMemory_xau16[8].sequence_counter ZFEH_EepromData.ydiBackupMemory_xau16[8].status_word ZFEH_EepromData.ydiBackupMemory_xau16[9].amb_cond.ambient_condition[0][0] ZFEH_EepromData.ydiBackupMemory_xau16[9].amb_cond.ambient_condition[0][10] ZFEH_EepromData.ydiBackupMemory_xau16[9].amb_cond.ambient_condition[0][11] ZFEH_EepromData.ydiBackupMemory_xau16[9].amb_cond.ambient_condition[0][12] ZFEH_EepromData.ydiBackupMemory_xau16[9].amb_cond.ambient_condition[0][13] ZFEH_EepromData.ydiBackupMemory_xau16[9].amb_cond.ambient_condition[0][14] ZFEH_EepromData.ydiBackupMemory_xau16[9].amb_cond.ambient_condition[0][15] ZFEH_EepromData.ydiBackupMemory_xau16[9].amb_cond.ambient_condition[0][16] ZFEH_EepromData.ydiBackupMemory_xau16[9].amb_cond.ambient_condition[0][17] ZFEH_EepromData.ydiBackupMemory_xau16[9].amb_cond.ambient_condition[0][18] ZFEH_EepromData.ydiBackupMemory_xau16[9].amb_cond.ambient_condition[0][19] ZFEH_EepromData.ydiBackupMemory_xau16[9].amb_cond.ambient_condition[0][1] ZFEH_EepromData.ydiBackupMemory_xau16[9].amb_cond.ambient_condition[0][20] ZFEH_EepromData.ydiBackupMemory_xau16[9].amb_cond.ambient_condition[0][21] ZFEH_EepromData.ydiBackupMemory_xau16[9].amb_cond.ambient_condition[0][22] ZFEH_EepromData.ydiBackupMemory_xau16[9].amb_cond.ambient_condition[0][23] ZFEH_EepromData.ydiBackupMemory_xau16[9].amb_cond.ambient_condition[0][24] ZFEH_EepromData.ydiBackupMemory_xau16[9].amb_cond.ambient_condition[0][2] ZFEH_EepromData.ydiBackupMemory_xau16[9].amb_cond.ambient_condition[0][3] ZFEH_EepromData.ydiBackupMemory_xau16[9].amb_cond.ambient_condition[0][4] ZFEH_EepromData.ydiBackupMemory_xau16[9].amb_cond.ambient_condition[0][5] ZFEH_EepromData.ydiBackupMemory_xau16[9].amb_cond.ambient_condition[0][6] ZFEH_EepromData.ydiBackupMemory_xau16[9].amb_cond.ambient_condition[0][7] ZFEH_EepromData.ydiBackupMemory_xau16[9].amb_cond.ambient_condition[0][8] ZFEH_EepromData.ydiBackupMemory_xau16[9].amb_cond.ambient_condition[0][9] ZFEH_EepromData.ydiBackupMemory_xau16[9].amb_cond.ambient_condition[1][0] ZFEH_EepromData.ydiBackupMemory_xau16[9].amb_cond.ambient_condition[1][10] ZFEH_EepromData.ydiBackupMemory_xau16[9].amb_cond.ambient_condition[1][11] ZFEH_EepromData.ydiBackupMemory_xau16[9].amb_cond.ambient_condition[1][12] ZFEH_EepromData.ydiBackupMemory_xau16[9].amb_cond.ambient_condition[1][13] ZFEH_EepromData.ydiBackupMemory_xau16[9].amb_cond.ambient_condition[1][14] ZFEH_EepromData.ydiBackupMemory_xau16[9].amb_cond.ambient_condition[1][15] ZFEH_EepromData.ydiBackupMemory_xau16[9].amb_cond.ambient_condition[1][16] ZFEH_EepromData.ydiBackupMemory_xau16[9].amb_cond.ambient_condition[1][17] ZFEH_EepromData.ydiBackupMemory_xau16[9].amb_cond.ambient_condition[1][18] ZFEH_EepromData.ydiBackupMemory_xau16[9].amb_cond.ambient_condition[1][19] ZFEH_EepromData.ydiBackupMemory_xau16[9].amb_cond.ambient_condition[1][1] ZFEH_EepromData.ydiBackupMemory_xau16[9].amb_cond.ambient_condition[1][20] ZFEH_EepromData.ydiBackupMemory_xau16[9].amb_cond.ambient_condition[1][21] ZFEH_EepromData.ydiBackupMemory_xau16[9].amb_cond.ambient_condition[1][22] ZFEH_EepromData.ydiBackupMemory_xau16[9].amb_cond.ambient_condition[1][23] ZFEH_EepromData.ydiBackupMemory_xau16[9].amb_cond.ambient_condition[1][24] ZFEH_EepromData.ydiBackupMemory_xau16[9].amb_cond.ambient_condition[1][2] ZFEH_EepromData.ydiBackupMemory_xau16[9].amb_cond.ambient_condition[1][3] ZFEH_EepromData.ydiBackupMemory_xau16[9].amb_cond.ambient_condition[1][4] ZFEH_EepromData.ydiBackupMemory_xau16[9].amb_cond.ambient_condition[1][5] ZFEH_EepromData.ydiBackupMemory_xau16[9].amb_cond.ambient_condition[1][6] ZFEH_EepromData.ydiBackupMemory_xau16[9].amb_cond.ambient_condition[1][7] ZFEH_EepromData.ydiBackupMemory_xau16[9].amb_cond.ambient_condition[1][8] ZFEH_EepromData.ydiBackupMemory_xau16[9].amb_cond.ambient_condition[1][9] ZFEH_EepromData.ydiBackupMemory_xau16[9].amb_cond.status_of_ambient_conditions[0] ZFEH_EepromData.ydiBackupMemory_xau16[9].amb_cond.status_of_ambient_conditions[1] ZFEH_EepromData.ydiBackupMemory_xau16[9].backwards_counter ZFEH_EepromData.ydiBackupMemory_xau16[9].condition_byte ZFEH_EepromData.ydiBackupMemory_xau16[9].error_code ZFEH_EepromData.ydiBackupMemory_xau16[9].error_type ZFEH_EepromData.ydiBackupMemory_xau16[9].frequency_counter ZFEH_EepromData.ydiBackupMemory_xau16[9].master_time ZFEH_EepromData.ydiBackupMemory_xau16[9].obd_driving_cycle_counter ZFEH_EepromData.ydiBackupMemory_xau16[9].permanent_counter ZFEH_EepromData.ydiBackupMemory_xau16[9].sequence_counter ZFEH_EepromData.ydiBackupMemory_xau16[9].status_word ZFEH_EepromData.ydiMemory_xau16[0].amb_cond.ambient_condition[0][0] ZFEH_EepromData.ydiMemory_xau16[0].amb_cond.ambient_condition[0][10] ZFEH_EepromData.ydiMemory_xau16[0].amb_cond.ambient_condition[0][11] ZFEH_EepromData.ydiMemory_xau16[0].amb_cond.ambient_condition[0][12] ZFEH_EepromData.ydiMemory_xau16[0].amb_cond.ambient_condition[0][13] ZFEH_EepromData.ydiMemory_xau16[0].amb_cond.ambient_condition[0][14] ZFEH_EepromData.ydiMemory_xau16[0].amb_cond.ambient_condition[0][15] ZFEH_EepromData.ydiMemory_xau16[0].amb_cond.ambient_condition[0][16] ZFEH_EepromData.ydiMemory_xau16[0].amb_cond.ambient_condition[0][17] ZFEH_EepromData.ydiMemory_xau16[0].amb_cond.ambient_condition[0][18] ZFEH_EepromData.ydiMemory_xau16[0].amb_cond.ambient_condition[0][19] ZFEH_EepromData.ydiMemory_xau16[0].amb_cond.ambient_condition[0][1] ZFEH_EepromData.ydiMemory_xau16[0].amb_cond.ambient_condition[0][20] ZFEH_EepromData.ydiMemory_xau16[0].amb_cond.ambient_condition[0][21] ZFEH_EepromData.ydiMemory_xau16[0].amb_cond.ambient_condition[0][22] ZFEH_EepromData.ydiMemory_xau16[0].amb_cond.ambient_condition[0][23] ZFEH_EepromData.ydiMemory_xau16[0].amb_cond.ambient_condition[0][24] ZFEH_EepromData.ydiMemory_xau16[0].amb_cond.ambient_condition[0][2] ZFEH_EepromData.ydiMemory_xau16[0].amb_cond.ambient_condition[0][3] ZFEH_EepromData.ydiMemory_xau16[0].amb_cond.ambient_condition[0][4] ZFEH_EepromData.ydiMemory_xau16[0].amb_cond.ambient_condition[0][5] ZFEH_EepromData.ydiMemory_xau16[0].amb_cond.ambient_condition[0][6] ZFEH_EepromData.ydiMemory_xau16[0].amb_cond.ambient_condition[0][7] ZFEH_EepromData.ydiMemory_xau16[0].amb_cond.ambient_condition[0][8] ZFEH_EepromData.ydiMemory_xau16[0].amb_cond.ambient_condition[0][9] ZFEH_EepromData.ydiMemory_xau16[0].amb_cond.ambient_condition[1][0] ZFEH_EepromData.ydiMemory_xau16[0].amb_cond.ambient_condition[1][10] ZFEH_EepromData.ydiMemory_xau16[0].amb_cond.ambient_condition[1][11] ZFEH_EepromData.ydiMemory_xau16[0].amb_cond.ambient_condition[1][12] ZFEH_EepromData.ydiMemory_xau16[0].amb_cond.ambient_condition[1][13] ZFEH_EepromData.ydiMemory_xau16[0].amb_cond.ambient_condition[1][14] ZFEH_EepromData.ydiMemory_xau16[0].amb_cond.ambient_condition[1][15] ZFEH_EepromData.ydiMemory_xau16[0].amb_cond.ambient_condition[1][16] ZFEH_EepromData.ydiMemory_xau16[0].amb_cond.ambient_condition[1][17] ZFEH_EepromData.ydiMemory_xau16[0].amb_cond.ambient_condition[1][18] ZFEH_EepromData.ydiMemory_xau16[0].amb_cond.ambient_condition[1][19] ZFEH_EepromData.ydiMemory_xau16[0].amb_cond.ambient_condition[1][1] ZFEH_EepromData.ydiMemory_xau16[0].amb_cond.ambient_condition[1][20] ZFEH_EepromData.ydiMemory_xau16[0].amb_cond.ambient_condition[1][21] ZFEH_EepromData.ydiMemory_xau16[0].amb_cond.ambient_condition[1][22] ZFEH_EepromData.ydiMemory_xau16[0].amb_cond.ambient_condition[1][23] ZFEH_EepromData.ydiMemory_xau16[0].amb_cond.ambient_condition[1][24] ZFEH_EepromData.ydiMemory_xau16[0].amb_cond.ambient_condition[1][2] ZFEH_EepromData.ydiMemory_xau16[0].amb_cond.ambient_condition[1][3] ZFEH_EepromData.ydiMemory_xau16[0].amb_cond.ambient_condition[1][4] ZFEH_EepromData.ydiMemory_xau16[0].amb_cond.ambient_condition[1][5] ZFEH_EepromData.ydiMemory_xau16[0].amb_cond.ambient_condition[1][6] ZFEH_EepromData.ydiMemory_xau16[0].amb_cond.ambient_condition[1][7] ZFEH_EepromData.ydiMemory_xau16[0].amb_cond.ambient_condition[1][8] ZFEH_EepromData.ydiMemory_xau16[0].amb_cond.ambient_condition[1][9] ZFEH_EepromData.ydiMemory_xau16[0].amb_cond.status_of_ambient_conditions[0] ZFEH_EepromData.ydiMemory_xau16[0].amb_cond.status_of_ambient_conditions[1] ZFEH_EepromData.ydiMemory_xau16[0].backwards_counter ZFEH_EepromData.ydiMemory_xau16[0].condition_byte ZFEH_EepromData.ydiMemory_xau16[0].error_code ZFEH_EepromData.ydiMemory_xau16[0].error_type ZFEH_EepromData.ydiMemory_xau16[0].frequency_counter ZFEH_EepromData.ydiMemory_xau16[0].master_time ZFEH_EepromData.ydiMemory_xau16[0].obd_driving_cycle_counter ZFEH_EepromData.ydiMemory_xau16[0].permanent_counter ZFEH_EepromData.ydiMemory_xau16[0].sequence_counter ZFEH_EepromData.ydiMemory_xau16[0].status_word ZFEH_EepromData.ydiMemory_xau16[10].amb_cond.ambient_condition[0][0] ZFEH_EepromData.ydiMemory_xau16[10].amb_cond.ambient_condition[0][10] ZFEH_EepromData.ydiMemory_xau16[10].amb_cond.ambient_condition[0][11] ZFEH_EepromData.ydiMemory_xau16[10].amb_cond.ambient_condition[0][12] ZFEH_EepromData.ydiMemory_xau16[10].amb_cond.ambient_condition[0][13] ZFEH_EepromData.ydiMemory_xau16[10].amb_cond.ambient_condition[0][14] ZFEH_EepromData.ydiMemory_xau16[10].amb_cond.ambient_condition[0][15] ZFEH_EepromData.ydiMemory_xau16[10].amb_cond.ambient_condition[0][16] ZFEH_EepromData.ydiMemory_xau16[10].amb_cond.ambient_condition[0][17] ZFEH_EepromData.ydiMemory_xau16[10].amb_cond.ambient_condition[0][18] ZFEH_EepromData.ydiMemory_xau16[10].amb_cond.ambient_condition[0][19] ZFEH_EepromData.ydiMemory_xau16[10].amb_cond.ambient_condition[0][1] ZFEH_EepromData.ydiMemory_xau16[10].amb_cond.ambient_condition[0][20] ZFEH_EepromData.ydiMemory_xau16[10].amb_cond.ambient_condition[0][21] ZFEH_EepromData.ydiMemory_xau16[10].amb_cond.ambient_condition[0][22] ZFEH_EepromData.ydiMemory_xau16[10].amb_cond.ambient_condition[0][23] ZFEH_EepromData.ydiMemory_xau16[10].amb_cond.ambient_condition[0][24] ZFEH_EepromData.ydiMemory_xau16[10].amb_cond.ambient_condition[0][2] ZFEH_EepromData.ydiMemory_xau16[10].amb_cond.ambient_condition[0][3] ZFEH_EepromData.ydiMemory_xau16[10].amb_cond.ambient_condition[0][4] ZFEH_EepromData.ydiMemory_xau16[10].amb_cond.ambient_condition[0][5] ZFEH_EepromData.ydiMemory_xau16[10].amb_cond.ambient_condition[0][6] ZFEH_EepromData.ydiMemory_xau16[10].amb_cond.ambient_condition[0][7] ZFEH_EepromData.ydiMemory_xau16[10].amb_cond.ambient_condition[0][8] ZFEH_EepromData.ydiMemory_xau16[10].amb_cond.ambient_condition[0][9] ZFEH_EepromData.ydiMemory_xau16[10].amb_cond.ambient_condition[1][0] ZFEH_EepromData.ydiMemory_xau16[10].amb_cond.ambient_condition[1][10] ZFEH_EepromData.ydiMemory_xau16[10].amb_cond.ambient_condition[1][11] ZFEH_EepromData.ydiMemory_xau16[10].amb_cond.ambient_condition[1][12] ZFEH_EepromData.ydiMemory_xau16[10].amb_cond.ambient_condition[1][13] ZFEH_EepromData.ydiMemory_xau16[10].amb_cond.ambient_condition[1][14] ZFEH_EepromData.ydiMemory_xau16[10].amb_cond.ambient_condition[1][15] ZFEH_EepromData.ydiMemory_xau16[10].amb_cond.ambient_condition[1][16] ZFEH_EepromData.ydiMemory_xau16[10].amb_cond.ambient_condition[1][17] ZFEH_EepromData.ydiMemory_xau16[10].amb_cond.ambient_condition[1][18] ZFEH_EepromData.ydiMemory_xau16[10].amb_cond.ambient_condition[1][19] ZFEH_EepromData.ydiMemory_xau16[10].amb_cond.ambient_condition[1][1] ZFEH_EepromData.ydiMemory_xau16[10].amb_cond.ambient_condition[1][20] ZFEH_EepromData.ydiMemory_xau16[10].amb_cond.ambient_condition[1][21] ZFEH_EepromData.ydiMemory_xau16[10].amb_cond.ambient_condition[1][22] ZFEH_EepromData.ydiMemory_xau16[10].amb_cond.ambient_condition[1][23] ZFEH_EepromData.ydiMemory_xau16[10].amb_cond.ambient_condition[1][24] ZFEH_EepromData.ydiMemory_xau16[10].amb_cond.ambient_condition[1][2] ZFEH_EepromData.ydiMemory_xau16[10].amb_cond.ambient_condition[1][3] ZFEH_EepromData.ydiMemory_xau16[10].amb_cond.ambient_condition[1][4] ZFEH_EepromData.ydiMemory_xau16[10].amb_cond.ambient_condition[1][5] ZFEH_EepromData.ydiMemory_xau16[10].amb_cond.ambient_condition[1][6] ZFEH_EepromData.ydiMemory_xau16[10].amb_cond.ambient_condition[1][7] ZFEH_EepromData.ydiMemory_xau16[10].amb_cond.ambient_condition[1][8] ZFEH_EepromData.ydiMemory_xau16[10].amb_cond.ambient_condition[1][9] ZFEH_EepromData.ydiMemory_xau16[10].amb_cond.status_of_ambient_conditions[0] ZFEH_EepromData.ydiMemory_xau16[10].amb_cond.status_of_ambient_conditions[1] ZFEH_EepromData.ydiMemory_xau16[10].backwards_counter ZFEH_EepromData.ydiMemory_xau16[10].condition_byte ZFEH_EepromData.ydiMemory_xau16[10].error_code ZFEH_EepromData.ydiMemory_xau16[10].error_type ZFEH_EepromData.ydiMemory_xau16[10].frequency_counter ZFEH_EepromData.ydiMemory_xau16[10].master_time ZFEH_EepromData.ydiMemory_xau16[10].obd_driving_cycle_counter ZFEH_EepromData.ydiMemory_xau16[10].permanent_counter ZFEH_EepromData.ydiMemory_xau16[10].sequence_counter ZFEH_EepromData.ydiMemory_xau16[10].status_word ZFEH_EepromData.ydiMemory_xau16[11].amb_cond.ambient_condition[0][0] ZFEH_EepromData.ydiMemory_xau16[11].amb_cond.ambient_condition[0][10] ZFEH_EepromData.ydiMemory_xau16[11].amb_cond.ambient_condition[0][11] ZFEH_EepromData.ydiMemory_xau16[11].amb_cond.ambient_condition[0][12] ZFEH_EepromData.ydiMemory_xau16[11].amb_cond.ambient_condition[0][13] ZFEH_EepromData.ydiMemory_xau16[11].amb_cond.ambient_condition[0][14] ZFEH_EepromData.ydiMemory_xau16[11].amb_cond.ambient_condition[0][15] ZFEH_EepromData.ydiMemory_xau16[11].amb_cond.ambient_condition[0][16] ZFEH_EepromData.ydiMemory_xau16[11].amb_cond.ambient_condition[0][17] ZFEH_EepromData.ydiMemory_xau16[11].amb_cond.ambient_condition[0][18] ZFEH_EepromData.ydiMemory_xau16[11].amb_cond.ambient_condition[0][19] ZFEH_EepromData.ydiMemory_xau16[11].amb_cond.ambient_condition[0][1] ZFEH_EepromData.ydiMemory_xau16[11].amb_cond.ambient_condition[0][20] ZFEH_EepromData.ydiMemory_xau16[11].amb_cond.ambient_condition[0][21] ZFEH_EepromData.ydiMemory_xau16[11].amb_cond.ambient_condition[0][22] ZFEH_EepromData.ydiMemory_xau16[11].amb_cond.ambient_condition[0][23] ZFEH_EepromData.ydiMemory_xau16[11].amb_cond.ambient_condition[0][24] ZFEH_EepromData.ydiMemory_xau16[11].amb_cond.ambient_condition[0][2] ZFEH_EepromData.ydiMemory_xau16[11].amb_cond.ambient_condition[0][3] ZFEH_EepromData.ydiMemory_xau16[11].amb_cond.ambient_condition[0][4] ZFEH_EepromData.ydiMemory_xau16[11].amb_cond.ambient_condition[0][5] ZFEH_EepromData.ydiMemory_xau16[11].amb_cond.ambient_condition[0][6] ZFEH_EepromData.ydiMemory_xau16[11].amb_cond.ambient_condition[0][7] ZFEH_EepromData.ydiMemory_xau16[11].amb_cond.ambient_condition[0][8] ZFEH_EepromData.ydiMemory_xau16[11].amb_cond.ambient_condition[0][9] ZFEH_EepromData.ydiMemory_xau16[11].amb_cond.ambient_condition[1][0] ZFEH_EepromData.ydiMemory_xau16[11].amb_cond.ambient_condition[1][10] ZFEH_EepromData.ydiMemory_xau16[11].amb_cond.ambient_condition[1][11] ZFEH_EepromData.ydiMemory_xau16[11].amb_cond.ambient_condition[1][12] ZFEH_EepromData.ydiMemory_xau16[11].amb_cond.ambient_condition[1][13] ZFEH_EepromData.ydiMemory_xau16[11].amb_cond.ambient_condition[1][14] ZFEH_EepromData.ydiMemory_xau16[11].amb_cond.ambient_condition[1][15] ZFEH_EepromData.ydiMemory_xau16[11].amb_cond.ambient_condition[1][16] ZFEH_EepromData.ydiMemory_xau16[11].amb_cond.ambient_condition[1][17] ZFEH_EepromData.ydiMemory_xau16[11].amb_cond.ambient_condition[1][18] ZFEH_EepromData.ydiMemory_xau16[11].amb_cond.ambient_condition[1][19] ZFEH_EepromData.ydiMemory_xau16[11].amb_cond.ambient_condition[1][1] ZFEH_EepromData.ydiMemory_xau16[11].amb_cond.ambient_condition[1][20] ZFEH_EepromData.ydiMemory_xau16[11].amb_cond.ambient_condition[1][21] ZFEH_EepromData.ydiMemory_xau16[11].amb_cond.ambient_condition[1][22] ZFEH_EepromData.ydiMemory_xau16[11].amb_cond.ambient_condition[1][23] ZFEH_EepromData.ydiMemory_xau16[11].amb_cond.ambient_condition[1][24] ZFEH_EepromData.ydiMemory_xau16[11].amb_cond.ambient_condition[1][2] ZFEH_EepromData.ydiMemory_xau16[11].amb_cond.ambient_condition[1][3] ZFEH_EepromData.ydiMemory_xau16[11].amb_cond.ambient_condition[1][4] ZFEH_EepromData.ydiMemory_xau16[11].amb_cond.ambient_condition[1][5] ZFEH_EepromData.ydiMemory_xau16[11].amb_cond.ambient_condition[1][6] ZFEH_EepromData.ydiMemory_xau16[11].amb_cond.ambient_condition[1][7] ZFEH_EepromData.ydiMemory_xau16[11].amb_cond.ambient_condition[1][8] ZFEH_EepromData.ydiMemory_xau16[11].amb_cond.ambient_condition[1][9] ZFEH_EepromData.ydiMemory_xau16[11].amb_cond.status_of_ambient_conditions[0] ZFEH_EepromData.ydiMemory_xau16[11].amb_cond.status_of_ambient_conditions[1] ZFEH_EepromData.ydiMemory_xau16[11].backwards_counter ZFEH_EepromData.ydiMemory_xau16[11].condition_byte ZFEH_EepromData.ydiMemory_xau16[11].error_code ZFEH_EepromData.ydiMemory_xau16[11].error_type ZFEH_EepromData.ydiMemory_xau16[11].frequency_counter ZFEH_EepromData.ydiMemory_xau16[11].master_time ZFEH_EepromData.ydiMemory_xau16[11].obd_driving_cycle_counter ZFEH_EepromData.ydiMemory_xau16[11].permanent_counter ZFEH_EepromData.ydiMemory_xau16[11].sequence_counter ZFEH_EepromData.ydiMemory_xau16[11].status_word ZFEH_EepromData.ydiMemory_xau16[12].amb_cond.ambient_condition[0][0] ZFEH_EepromData.ydiMemory_xau16[12].amb_cond.ambient_condition[0][10] ZFEH_EepromData.ydiMemory_xau16[12].amb_cond.ambient_condition[0][11] ZFEH_EepromData.ydiMemory_xau16[12].amb_cond.ambient_condition[0][12] ZFEH_EepromData.ydiMemory_xau16[12].amb_cond.ambient_condition[0][13] ZFEH_EepromData.ydiMemory_xau16[12].amb_cond.ambient_condition[0][14] ZFEH_EepromData.ydiMemory_xau16[12].amb_cond.ambient_condition[0][15] ZFEH_EepromData.ydiMemory_xau16[12].amb_cond.ambient_condition[0][16] ZFEH_EepromData.ydiMemory_xau16[12].amb_cond.ambient_condition[0][17] ZFEH_EepromData.ydiMemory_xau16[12].amb_cond.ambient_condition[0][18] ZFEH_EepromData.ydiMemory_xau16[12].amb_cond.ambient_condition[0][19] ZFEH_EepromData.ydiMemory_xau16[12].amb_cond.ambient_condition[0][1] ZFEH_EepromData.ydiMemory_xau16[12].amb_cond.ambient_condition[0][20] ZFEH_EepromData.ydiMemory_xau16[12].amb_cond.ambient_condition[0][21] ZFEH_EepromData.ydiMemory_xau16[12].amb_cond.ambient_condition[0][22] ZFEH_EepromData.ydiMemory_xau16[12].amb_cond.ambient_condition[0][23] ZFEH_EepromData.ydiMemory_xau16[12].amb_cond.ambient_condition[0][24] ZFEH_EepromData.ydiMemory_xau16[12].amb_cond.ambient_condition[0][2] ZFEH_EepromData.ydiMemory_xau16[12].amb_cond.ambient_condition[0][3] ZFEH_EepromData.ydiMemory_xau16[12].amb_cond.ambient_condition[0][4] ZFEH_EepromData.ydiMemory_xau16[12].amb_cond.ambient_condition[0][5] ZFEH_EepromData.ydiMemory_xau16[12].amb_cond.ambient_condition[0][6] ZFEH_EepromData.ydiMemory_xau16[12].amb_cond.ambient_condition[0][7] ZFEH_EepromData.ydiMemory_xau16[12].amb_cond.ambient_condition[0][8] ZFEH_EepromData.ydiMemory_xau16[12].amb_cond.ambient_condition[0][9] ZFEH_EepromData.ydiMemory_xau16[12].amb_cond.ambient_condition[1][0] ZFEH_EepromData.ydiMemory_xau16[12].amb_cond.ambient_condition[1][10] ZFEH_EepromData.ydiMemory_xau16[12].amb_cond.ambient_condition[1][11] ZFEH_EepromData.ydiMemory_xau16[12].amb_cond.ambient_condition[1][12] ZFEH_EepromData.ydiMemory_xau16[12].amb_cond.ambient_condition[1][13] ZFEH_EepromData.ydiMemory_xau16[12].amb_cond.ambient_condition[1][14] ZFEH_EepromData.ydiMemory_xau16[12].amb_cond.ambient_condition[1][15] ZFEH_EepromData.ydiMemory_xau16[12].amb_cond.ambient_condition[1][16] ZFEH_EepromData.ydiMemory_xau16[12].amb_cond.ambient_condition[1][17] ZFEH_EepromData.ydiMemory_xau16[12].amb_cond.ambient_condition[1][18] ZFEH_EepromData.ydiMemory_xau16[12].amb_cond.ambient_condition[1][19] ZFEH_EepromData.ydiMemory_xau16[12].amb_cond.ambient_condition[1][1] ZFEH_EepromData.ydiMemory_xau16[12].amb_cond.ambient_condition[1][20] ZFEH_EepromData.ydiMemory_xau16[12].amb_cond.ambient_condition[1][21] ZFEH_EepromData.ydiMemory_xau16[12].amb_cond.ambient_condition[1][22] ZFEH_EepromData.ydiMemory_xau16[12].amb_cond.ambient_condition[1][23] ZFEH_EepromData.ydiMemory_xau16[12].amb_cond.ambient_condition[1][24] ZFEH_EepromData.ydiMemory_xau16[12].amb_cond.ambient_condition[1][2] ZFEH_EepromData.ydiMemory_xau16[12].amb_cond.ambient_condition[1][3] ZFEH_EepromData.ydiMemory_xau16[12].amb_cond.ambient_condition[1][4] ZFEH_EepromData.ydiMemory_xau16[12].amb_cond.ambient_condition[1][5] ZFEH_EepromData.ydiMemory_xau16[12].amb_cond.ambient_condition[1][6] ZFEH_EepromData.ydiMemory_xau16[12].amb_cond.ambient_condition[1][7] ZFEH_EepromData.ydiMemory_xau16[12].amb_cond.ambient_condition[1][8] ZFEH_EepromData.ydiMemory_xau16[12].amb_cond.ambient_condition[1][9] ZFEH_EepromData.ydiMemory_xau16[12].amb_cond.status_of_ambient_conditions[0] ZFEH_EepromData.ydiMemory_xau16[12].amb_cond.status_of_ambient_conditions[1] ZFEH_EepromData.ydiMemory_xau16[12].backwards_counter ZFEH_EepromData.ydiMemory_xau16[12].condition_byte ZFEH_EepromData.ydiMemory_xau16[12].error_code ZFEH_EepromData.ydiMemory_xau16[12].error_type ZFEH_EepromData.ydiMemory_xau16[12].frequency_counter ZFEH_EepromData.ydiMemory_xau16[12].master_time ZFEH_EepromData.ydiMemory_xau16[12].obd_driving_cycle_counter ZFEH_EepromData.ydiMemory_xau16[12].permanent_counter ZFEH_EepromData.ydiMemory_xau16[12].sequence_counter ZFEH_EepromData.ydiMemory_xau16[12].status_word ZFEH_EepromData.ydiMemory_xau16[13].amb_cond.ambient_condition[0][0] ZFEH_EepromData.ydiMemory_xau16[13].amb_cond.ambient_condition[0][10] ZFEH_EepromData.ydiMemory_xau16[13].amb_cond.ambient_condition[0][11] ZFEH_EepromData.ydiMemory_xau16[13].amb_cond.ambient_condition[0][12] ZFEH_EepromData.ydiMemory_xau16[13].amb_cond.ambient_condition[0][13] ZFEH_EepromData.ydiMemory_xau16[13].amb_cond.ambient_condition[0][14] ZFEH_EepromData.ydiMemory_xau16[13].amb_cond.ambient_condition[0][15] ZFEH_EepromData.ydiMemory_xau16[13].amb_cond.ambient_condition[0][16] ZFEH_EepromData.ydiMemory_xau16[13].amb_cond.ambient_condition[0][17] ZFEH_EepromData.ydiMemory_xau16[13].amb_cond.ambient_condition[0][18] ZFEH_EepromData.ydiMemory_xau16[13].amb_cond.ambient_condition[0][19] ZFEH_EepromData.ydiMemory_xau16[13].amb_cond.ambient_condition[0][1] ZFEH_EepromData.ydiMemory_xau16[13].amb_cond.ambient_condition[0][20] ZFEH_EepromData.ydiMemory_xau16[13].amb_cond.ambient_condition[0][21] ZFEH_EepromData.ydiMemory_xau16[13].amb_cond.ambient_condition[0][22] ZFEH_EepromData.ydiMemory_xau16[13].amb_cond.ambient_condition[0][23] ZFEH_EepromData.ydiMemory_xau16[13].amb_cond.ambient_condition[0][24] ZFEH_EepromData.ydiMemory_xau16[13].amb_cond.ambient_condition[0][2] ZFEH_EepromData.ydiMemory_xau16[13].amb_cond.ambient_condition[0][3] ZFEH_EepromData.ydiMemory_xau16[13].amb_cond.ambient_condition[0][4] ZFEH_EepromData.ydiMemory_xau16[13].amb_cond.ambient_condition[0][5] ZFEH_EepromData.ydiMemory_xau16[13].amb_cond.ambient_condition[0][6] ZFEH_EepromData.ydiMemory_xau16[13].amb_cond.ambient_condition[0][7] ZFEH_EepromData.ydiMemory_xau16[13].amb_cond.ambient_condition[0][8] ZFEH_EepromData.ydiMemory_xau16[13].amb_cond.ambient_condition[0][9] ZFEH_EepromData.ydiMemory_xau16[13].amb_cond.ambient_condition[1][0] ZFEH_EepromData.ydiMemory_xau16[13].amb_cond.ambient_condition[1][10] ZFEH_EepromData.ydiMemory_xau16[13].amb_cond.ambient_condition[1][11] ZFEH_EepromData.ydiMemory_xau16[13].amb_cond.ambient_condition[1][12] ZFEH_EepromData.ydiMemory_xau16[13].amb_cond.ambient_condition[1][13] ZFEH_EepromData.ydiMemory_xau16[13].amb_cond.ambient_condition[1][14] ZFEH_EepromData.ydiMemory_xau16[13].amb_cond.ambient_condition[1][15] ZFEH_EepromData.ydiMemory_xau16[13].amb_cond.ambient_condition[1][16] ZFEH_EepromData.ydiMemory_xau16[13].amb_cond.ambient_condition[1][17] ZFEH_EepromData.ydiMemory_xau16[13].amb_cond.ambient_condition[1][18] ZFEH_EepromData.ydiMemory_xau16[13].amb_cond.ambient_condition[1][19] ZFEH_EepromData.ydiMemory_xau16[13].amb_cond.ambient_condition[1][1] ZFEH_EepromData.ydiMemory_xau16[13].amb_cond.ambient_condition[1][20] ZFEH_EepromData.ydiMemory_xau16[13].amb_cond.ambient_condition[1][21] ZFEH_EepromData.ydiMemory_xau16[13].amb_cond.ambient_condition[1][22] ZFEH_EepromData.ydiMemory_xau16[13].amb_cond.ambient_condition[1][23] ZFEH_EepromData.ydiMemory_xau16[13].amb_cond.ambient_condition[1][24] ZFEH_EepromData.ydiMemory_xau16[13].amb_cond.ambient_condition[1][2] ZFEH_EepromData.ydiMemory_xau16[13].amb_cond.ambient_condition[1][3] ZFEH_EepromData.ydiMemory_xau16[13].amb_cond.ambient_condition[1][4] ZFEH_EepromData.ydiMemory_xau16[13].amb_cond.ambient_condition[1][5] ZFEH_EepromData.ydiMemory_xau16[13].amb_cond.ambient_condition[1][6] ZFEH_EepromData.ydiMemory_xau16[13].amb_cond.ambient_condition[1][7] ZFEH_EepromData.ydiMemory_xau16[13].amb_cond.ambient_condition[1][8] ZFEH_EepromData.ydiMemory_xau16[13].amb_cond.ambient_condition[1][9] ZFEH_EepromData.ydiMemory_xau16[13].amb_cond.status_of_ambient_conditions[0] ZFEH_EepromData.ydiMemory_xau16[13].amb_cond.status_of_ambient_conditions[1] ZFEH_EepromData.ydiMemory_xau16[13].backwards_counter ZFEH_EepromData.ydiMemory_xau16[13].condition_byte ZFEH_EepromData.ydiMemory_xau16[13].error_code ZFEH_EepromData.ydiMemory_xau16[13].error_type ZFEH_EepromData.ydiMemory_xau16[13].frequency_counter ZFEH_EepromData.ydiMemory_xau16[13].master_time ZFEH_EepromData.ydiMemory_xau16[13].obd_driving_cycle_counter ZFEH_EepromData.ydiMemory_xau16[13].permanent_counter ZFEH_EepromData.ydiMemory_xau16[13].sequence_counter ZFEH_EepromData.ydiMemory_xau16[13].status_word ZFEH_EepromData.ydiMemory_xau16[14].amb_cond.ambient_condition[0][0] ZFEH_EepromData.ydiMemory_xau16[14].amb_cond.ambient_condition[0][10] ZFEH_EepromData.ydiMemory_xau16[14].amb_cond.ambient_condition[0][11] ZFEH_EepromData.ydiMemory_xau16[14].amb_cond.ambient_condition[0][12] ZFEH_EepromData.ydiMemory_xau16[14].amb_cond.ambient_condition[0][13] ZFEH_EepromData.ydiMemory_xau16[14].amb_cond.ambient_condition[0][14] ZFEH_EepromData.ydiMemory_xau16[14].amb_cond.ambient_condition[0][15] ZFEH_EepromData.ydiMemory_xau16[14].amb_cond.ambient_condition[0][16] ZFEH_EepromData.ydiMemory_xau16[14].amb_cond.ambient_condition[0][17] ZFEH_EepromData.ydiMemory_xau16[14].amb_cond.ambient_condition[0][18] ZFEH_EepromData.ydiMemory_xau16[14].amb_cond.ambient_condition[0][19] ZFEH_EepromData.ydiMemory_xau16[14].amb_cond.ambient_condition[0][1] ZFEH_EepromData.ydiMemory_xau16[14].amb_cond.ambient_condition[0][20] ZFEH_EepromData.ydiMemory_xau16[14].amb_cond.ambient_condition[0][21] ZFEH_EepromData.ydiMemory_xau16[14].amb_cond.ambient_condition[0][22] ZFEH_EepromData.ydiMemory_xau16[14].amb_cond.ambient_condition[0][23] ZFEH_EepromData.ydiMemory_xau16[14].amb_cond.ambient_condition[0][24] ZFEH_EepromData.ydiMemory_xau16[14].amb_cond.ambient_condition[0][2] ZFEH_EepromData.ydiMemory_xau16[14].amb_cond.ambient_condition[0][3] ZFEH_EepromData.ydiMemory_xau16[14].amb_cond.ambient_condition[0][4] ZFEH_EepromData.ydiMemory_xau16[14].amb_cond.ambient_condition[0][5] ZFEH_EepromData.ydiMemory_xau16[14].amb_cond.ambient_condition[0][6] ZFEH_EepromData.ydiMemory_xau16[14].amb_cond.ambient_condition[0][7] ZFEH_EepromData.ydiMemory_xau16[14].amb_cond.ambient_condition[0][8] ZFEH_EepromData.ydiMemory_xau16[14].amb_cond.ambient_condition[0][9] ZFEH_EepromData.ydiMemory_xau16[14].amb_cond.ambient_condition[1][0] ZFEH_EepromData.ydiMemory_xau16[14].amb_cond.ambient_condition[1][10] ZFEH_EepromData.ydiMemory_xau16[14].amb_cond.ambient_condition[1][11] ZFEH_EepromData.ydiMemory_xau16[14].amb_cond.ambient_condition[1][12] ZFEH_EepromData.ydiMemory_xau16[14].amb_cond.ambient_condition[1][13] ZFEH_EepromData.ydiMemory_xau16[14].amb_cond.ambient_condition[1][14] ZFEH_EepromData.ydiMemory_xau16[14].amb_cond.ambient_condition[1][15] ZFEH_EepromData.ydiMemory_xau16[14].amb_cond.ambient_condition[1][16] ZFEH_EepromData.ydiMemory_xau16[14].amb_cond.ambient_condition[1][17] ZFEH_EepromData.ydiMemory_xau16[14].amb_cond.ambient_condition[1][18] ZFEH_EepromData.ydiMemory_xau16[14].amb_cond.ambient_condition[1][19] ZFEH_EepromData.ydiMemory_xau16[14].amb_cond.ambient_condition[1][1] ZFEH_EepromData.ydiMemory_xau16[14].amb_cond.ambient_condition[1][20] ZFEH_EepromData.ydiMemory_xau16[14].amb_cond.ambient_condition[1][21] ZFEH_EepromData.ydiMemory_xau16[14].amb_cond.ambient_condition[1][22] ZFEH_EepromData.ydiMemory_xau16[14].amb_cond.ambient_condition[1][23] ZFEH_EepromData.ydiMemory_xau16[14].amb_cond.ambient_condition[1][24] ZFEH_EepromData.ydiMemory_xau16[14].amb_cond.ambient_condition[1][2] ZFEH_EepromData.ydiMemory_xau16[14].amb_cond.ambient_condition[1][3] ZFEH_EepromData.ydiMemory_xau16[14].amb_cond.ambient_condition[1][4] ZFEH_EepromData.ydiMemory_xau16[14].amb_cond.ambient_condition[1][5] ZFEH_EepromData.ydiMemory_xau16[14].amb_cond.ambient_condition[1][6] ZFEH_EepromData.ydiMemory_xau16[14].amb_cond.ambient_condition[1][7] ZFEH_EepromData.ydiMemory_xau16[14].amb_cond.ambient_condition[1][8] ZFEH_EepromData.ydiMemory_xau16[14].amb_cond.ambient_condition[1][9] ZFEH_EepromData.ydiMemory_xau16[14].amb_cond.status_of_ambient_conditions[0] ZFEH_EepromData.ydiMemory_xau16[14].amb_cond.status_of_ambient_conditions[1] ZFEH_EepromData.ydiMemory_xau16[14].backwards_counter ZFEH_EepromData.ydiMemory_xau16[14].condition_byte ZFEH_EepromData.ydiMemory_xau16[14].error_code ZFEH_EepromData.ydiMemory_xau16[14].error_type ZFEH_EepromData.ydiMemory_xau16[14].frequency_counter ZFEH_EepromData.ydiMemory_xau16[14].master_time ZFEH_EepromData.ydiMemory_xau16[14].obd_driving_cycle_counter ZFEH_EepromData.ydiMemory_xau16[14].permanent_counter ZFEH_EepromData.ydiMemory_xau16[14].sequence_counter ZFEH_EepromData.ydiMemory_xau16[14].status_word ZFEH_EepromData.ydiMemory_xau16[15].amb_cond.ambient_condition[0][0] ZFEH_EepromData.ydiMemory_xau16[15].amb_cond.ambient_condition[0][10] ZFEH_EepromData.ydiMemory_xau16[15].amb_cond.ambient_condition[0][11] ZFEH_EepromData.ydiMemory_xau16[15].amb_cond.ambient_condition[0][12] ZFEH_EepromData.ydiMemory_xau16[15].amb_cond.ambient_condition[0][13] ZFEH_EepromData.ydiMemory_xau16[15].amb_cond.ambient_condition[0][14] ZFEH_EepromData.ydiMemory_xau16[15].amb_cond.ambient_condition[0][15] ZFEH_EepromData.ydiMemory_xau16[15].amb_cond.ambient_condition[0][16] ZFEH_EepromData.ydiMemory_xau16[15].amb_cond.ambient_condition[0][17] ZFEH_EepromData.ydiMemory_xau16[15].amb_cond.ambient_condition[0][18] ZFEH_EepromData.ydiMemory_xau16[15].amb_cond.ambient_condition[0][19] ZFEH_EepromData.ydiMemory_xau16[15].amb_cond.ambient_condition[0][1] ZFEH_EepromData.ydiMemory_xau16[15].amb_cond.ambient_condition[0][20] ZFEH_EepromData.ydiMemory_xau16[15].amb_cond.ambient_condition[0][21] ZFEH_EepromData.ydiMemory_xau16[15].amb_cond.ambient_condition[0][22] ZFEH_EepromData.ydiMemory_xau16[15].amb_cond.ambient_condition[0][23] ZFEH_EepromData.ydiMemory_xau16[15].amb_cond.ambient_condition[0][24] ZFEH_EepromData.ydiMemory_xau16[15].amb_cond.ambient_condition[0][2] ZFEH_EepromData.ydiMemory_xau16[15].amb_cond.ambient_condition[0][3] ZFEH_EepromData.ydiMemory_xau16[15].amb_cond.ambient_condition[0][4] ZFEH_EepromData.ydiMemory_xau16[15].amb_cond.ambient_condition[0][5] ZFEH_EepromData.ydiMemory_xau16[15].amb_cond.ambient_condition[0][6] ZFEH_EepromData.ydiMemory_xau16[15].amb_cond.ambient_condition[0][7] ZFEH_EepromData.ydiMemory_xau16[15].amb_cond.ambient_condition[0][8] ZFEH_EepromData.ydiMemory_xau16[15].amb_cond.ambient_condition[0][9] ZFEH_EepromData.ydiMemory_xau16[15].amb_cond.ambient_condition[1][0] ZFEH_EepromData.ydiMemory_xau16[15].amb_cond.ambient_condition[1][10] ZFEH_EepromData.ydiMemory_xau16[15].amb_cond.ambient_condition[1][11] ZFEH_EepromData.ydiMemory_xau16[15].amb_cond.ambient_condition[1][12] ZFEH_EepromData.ydiMemory_xau16[15].amb_cond.ambient_condition[1][13] ZFEH_EepromData.ydiMemory_xau16[15].amb_cond.ambient_condition[1][14] ZFEH_EepromData.ydiMemory_xau16[15].amb_cond.ambient_condition[1][15] ZFEH_EepromData.ydiMemory_xau16[15].amb_cond.ambient_condition[1][16] ZFEH_EepromData.ydiMemory_xau16[15].amb_cond.ambient_condition[1][17] ZFEH_EepromData.ydiMemory_xau16[15].amb_cond.ambient_condition[1][18] ZFEH_EepromData.ydiMemory_xau16[15].amb_cond.ambient_condition[1][19] ZFEH_EepromData.ydiMemory_xau16[15].amb_cond.ambient_condition[1][1] ZFEH_EepromData.ydiMemory_xau16[15].amb_cond.ambient_condition[1][20] ZFEH_EepromData.ydiMemory_xau16[15].amb_cond.ambient_condition[1][21] ZFEH_EepromData.ydiMemory_xau16[15].amb_cond.ambient_condition[1][22] ZFEH_EepromData.ydiMemory_xau16[15].amb_cond.ambient_condition[1][23] ZFEH_EepromData.ydiMemory_xau16[15].amb_cond.ambient_condition[1][24] ZFEH_EepromData.ydiMemory_xau16[15].amb_cond.ambient_condition[1][2] ZFEH_EepromData.ydiMemory_xau16[15].amb_cond.ambient_condition[1][3] ZFEH_EepromData.ydiMemory_xau16[15].amb_cond.ambient_condition[1][4] ZFEH_EepromData.ydiMemory_xau16[15].amb_cond.ambient_condition[1][5] ZFEH_EepromData.ydiMemory_xau16[15].amb_cond.ambient_condition[1][6] ZFEH_EepromData.ydiMemory_xau16[15].amb_cond.ambient_condition[1][7] ZFEH_EepromData.ydiMemory_xau16[15].amb_cond.ambient_condition[1][8] ZFEH_EepromData.ydiMemory_xau16[15].amb_cond.ambient_condition[1][9] ZFEH_EepromData.ydiMemory_xau16[15].amb_cond.status_of_ambient_conditions[0] ZFEH_EepromData.ydiMemory_xau16[15].amb_cond.status_of_ambient_conditions[1] ZFEH_EepromData.ydiMemory_xau16[15].backwards_counter ZFEH_EepromData.ydiMemory_xau16[15].condition_byte ZFEH_EepromData.ydiMemory_xau16[15].error_code ZFEH_EepromData.ydiMemory_xau16[15].error_type ZFEH_EepromData.ydiMemory_xau16[15].frequency_counter ZFEH_EepromData.ydiMemory_xau16[15].master_time ZFEH_EepromData.ydiMemory_xau16[15].obd_driving_cycle_counter ZFEH_EepromData.ydiMemory_xau16[15].permanent_counter ZFEH_EepromData.ydiMemory_xau16[15].sequence_counter ZFEH_EepromData.ydiMemory_xau16[15].status_word ZFEH_EepromData.ydiMemory_xau16[16].amb_cond.ambient_condition[0][0] ZFEH_EepromData.ydiMemory_xau16[16].amb_cond.ambient_condition[0][10] ZFEH_EepromData.ydiMemory_xau16[16].amb_cond.ambient_condition[0][11] ZFEH_EepromData.ydiMemory_xau16[16].amb_cond.ambient_condition[0][12] ZFEH_EepromData.ydiMemory_xau16[16].amb_cond.ambient_condition[0][13] ZFEH_EepromData.ydiMemory_xau16[16].amb_cond.ambient_condition[0][14] ZFEH_EepromData.ydiMemory_xau16[16].amb_cond.ambient_condition[0][15] ZFEH_EepromData.ydiMemory_xau16[16].amb_cond.ambient_condition[0][16] ZFEH_EepromData.ydiMemory_xau16[16].amb_cond.ambient_condition[0][17] ZFEH_EepromData.ydiMemory_xau16[16].amb_cond.ambient_condition[0][18] ZFEH_EepromData.ydiMemory_xau16[16].amb_cond.ambient_condition[0][19] ZFEH_EepromData.ydiMemory_xau16[16].amb_cond.ambient_condition[0][1] ZFEH_EepromData.ydiMemory_xau16[16].amb_cond.ambient_condition[0][20] ZFEH_EepromData.ydiMemory_xau16[16].amb_cond.ambient_condition[0][21] ZFEH_EepromData.ydiMemory_xau16[16].amb_cond.ambient_condition[0][22] ZFEH_EepromData.ydiMemory_xau16[16].amb_cond.ambient_condition[0][23] ZFEH_EepromData.ydiMemory_xau16[16].amb_cond.ambient_condition[0][24] ZFEH_EepromData.ydiMemory_xau16[16].amb_cond.ambient_condition[0][2] ZFEH_EepromData.ydiMemory_xau16[16].amb_cond.ambient_condition[0][3] ZFEH_EepromData.ydiMemory_xau16[16].amb_cond.ambient_condition[0][4] ZFEH_EepromData.ydiMemory_xau16[16].amb_cond.ambient_condition[0][5] ZFEH_EepromData.ydiMemory_xau16[16].amb_cond.ambient_condition[0][6] ZFEH_EepromData.ydiMemory_xau16[16].amb_cond.ambient_condition[0][7] ZFEH_EepromData.ydiMemory_xau16[16].amb_cond.ambient_condition[0][8] ZFEH_EepromData.ydiMemory_xau16[16].amb_cond.ambient_condition[0][9] ZFEH_EepromData.ydiMemory_xau16[16].amb_cond.ambient_condition[1][0] ZFEH_EepromData.ydiMemory_xau16[16].amb_cond.ambient_condition[1][10] ZFEH_EepromData.ydiMemory_xau16[16].amb_cond.ambient_condition[1][11] ZFEH_EepromData.ydiMemory_xau16[16].amb_cond.ambient_condition[1][12] ZFEH_EepromData.ydiMemory_xau16[16].amb_cond.ambient_condition[1][13] ZFEH_EepromData.ydiMemory_xau16[16].amb_cond.ambient_condition[1][14] ZFEH_EepromData.ydiMemory_xau16[16].amb_cond.ambient_condition[1][15] ZFEH_EepromData.ydiMemory_xau16[16].amb_cond.ambient_condition[1][16] ZFEH_EepromData.ydiMemory_xau16[16].amb_cond.ambient_condition[1][17] ZFEH_EepromData.ydiMemory_xau16[16].amb_cond.ambient_condition[1][18] ZFEH_EepromData.ydiMemory_xau16[16].amb_cond.ambient_condition[1][19] ZFEH_EepromData.ydiMemory_xau16[16].amb_cond.ambient_condition[1][1] ZFEH_EepromData.ydiMemory_xau16[16].amb_cond.ambient_condition[1][20] ZFEH_EepromData.ydiMemory_xau16[16].amb_cond.ambient_condition[1][21] ZFEH_EepromData.ydiMemory_xau16[16].amb_cond.ambient_condition[1][22] ZFEH_EepromData.ydiMemory_xau16[16].amb_cond.ambient_condition[1][23] ZFEH_EepromData.ydiMemory_xau16[16].amb_cond.ambient_condition[1][24] ZFEH_EepromData.ydiMemory_xau16[16].amb_cond.ambient_condition[1][2] ZFEH_EepromData.ydiMemory_xau16[16].amb_cond.ambient_condition[1][3] ZFEH_EepromData.ydiMemory_xau16[16].amb_cond.ambient_condition[1][4] ZFEH_EepromData.ydiMemory_xau16[16].amb_cond.ambient_condition[1][5] ZFEH_EepromData.ydiMemory_xau16[16].amb_cond.ambient_condition[1][6] ZFEH_EepromData.ydiMemory_xau16[16].amb_cond.ambient_condition[1][7] ZFEH_EepromData.ydiMemory_xau16[16].amb_cond.ambient_condition[1][8] ZFEH_EepromData.ydiMemory_xau16[16].amb_cond.ambient_condition[1][9] ZFEH_EepromData.ydiMemory_xau16[16].amb_cond.status_of_ambient_conditions[0] ZFEH_EepromData.ydiMemory_xau16[16].amb_cond.status_of_ambient_conditions[1] ZFEH_EepromData.ydiMemory_xau16[16].backwards_counter ZFEH_EepromData.ydiMemory_xau16[16].condition_byte ZFEH_EepromData.ydiMemory_xau16[16].error_code ZFEH_EepromData.ydiMemory_xau16[16].error_type ZFEH_EepromData.ydiMemory_xau16[16].frequency_counter ZFEH_EepromData.ydiMemory_xau16[16].master_time ZFEH_EepromData.ydiMemory_xau16[16].obd_driving_cycle_counter ZFEH_EepromData.ydiMemory_xau16[16].permanent_counter ZFEH_EepromData.ydiMemory_xau16[16].sequence_counter ZFEH_EepromData.ydiMemory_xau16[16].status_word ZFEH_EepromData.ydiMemory_xau16[17].amb_cond.ambient_condition[0][0] ZFEH_EepromData.ydiMemory_xau16[17].amb_cond.ambient_condition[0][10] ZFEH_EepromData.ydiMemory_xau16[17].amb_cond.ambient_condition[0][11] ZFEH_EepromData.ydiMemory_xau16[17].amb_cond.ambient_condition[0][12] ZFEH_EepromData.ydiMemory_xau16[17].amb_cond.ambient_condition[0][13] ZFEH_EepromData.ydiMemory_xau16[17].amb_cond.ambient_condition[0][14] ZFEH_EepromData.ydiMemory_xau16[17].amb_cond.ambient_condition[0][15] ZFEH_EepromData.ydiMemory_xau16[17].amb_cond.ambient_condition[0][16] ZFEH_EepromData.ydiMemory_xau16[17].amb_cond.ambient_condition[0][17] ZFEH_EepromData.ydiMemory_xau16[17].amb_cond.ambient_condition[0][18] ZFEH_EepromData.ydiMemory_xau16[17].amb_cond.ambient_condition[0][19] ZFEH_EepromData.ydiMemory_xau16[17].amb_cond.ambient_condition[0][1] ZFEH_EepromData.ydiMemory_xau16[17].amb_cond.ambient_condition[0][20] ZFEH_EepromData.ydiMemory_xau16[17].amb_cond.ambient_condition[0][21] ZFEH_EepromData.ydiMemory_xau16[17].amb_cond.ambient_condition[0][22] ZFEH_EepromData.ydiMemory_xau16[17].amb_cond.ambient_condition[0][23] ZFEH_EepromData.ydiMemory_xau16[17].amb_cond.ambient_condition[0][24] ZFEH_EepromData.ydiMemory_xau16[17].amb_cond.ambient_condition[0][2] ZFEH_EepromData.ydiMemory_xau16[17].amb_cond.ambient_condition[0][3] ZFEH_EepromData.ydiMemory_xau16[17].amb_cond.ambient_condition[0][4] ZFEH_EepromData.ydiMemory_xau16[17].amb_cond.ambient_condition[0][5] ZFEH_EepromData.ydiMemory_xau16[17].amb_cond.ambient_condition[0][6] ZFEH_EepromData.ydiMemory_xau16[17].amb_cond.ambient_condition[0][7] ZFEH_EepromData.ydiMemory_xau16[17].amb_cond.ambient_condition[0][8] ZFEH_EepromData.ydiMemory_xau16[17].amb_cond.ambient_condition[0][9] ZFEH_EepromData.ydiMemory_xau16[17].amb_cond.ambient_condition[1][0] ZFEH_EepromData.ydiMemory_xau16[17].amb_cond.ambient_condition[1][10] ZFEH_EepromData.ydiMemory_xau16[17].amb_cond.ambient_condition[1][11] ZFEH_EepromData.ydiMemory_xau16[17].amb_cond.ambient_condition[1][12] ZFEH_EepromData.ydiMemory_xau16[17].amb_cond.ambient_condition[1][13] ZFEH_EepromData.ydiMemory_xau16[17].amb_cond.ambient_condition[1][14] ZFEH_EepromData.ydiMemory_xau16[17].amb_cond.ambient_condition[1][15] ZFEH_EepromData.ydiMemory_xau16[17].amb_cond.ambient_condition[1][16] ZFEH_EepromData.ydiMemory_xau16[17].amb_cond.ambient_condition[1][17] ZFEH_EepromData.ydiMemory_xau16[17].amb_cond.ambient_condition[1][18] ZFEH_EepromData.ydiMemory_xau16[17].amb_cond.ambient_condition[1][19] ZFEH_EepromData.ydiMemory_xau16[17].amb_cond.ambient_condition[1][1] ZFEH_EepromData.ydiMemory_xau16[17].amb_cond.ambient_condition[1][20] ZFEH_EepromData.ydiMemory_xau16[17].amb_cond.ambient_condition[1][21] ZFEH_EepromData.ydiMemory_xau16[17].amb_cond.ambient_condition[1][22] ZFEH_EepromData.ydiMemory_xau16[17].amb_cond.ambient_condition[1][23] ZFEH_EepromData.ydiMemory_xau16[17].amb_cond.ambient_condition[1][24] ZFEH_EepromData.ydiMemory_xau16[17].amb_cond.ambient_condition[1][2] ZFEH_EepromData.ydiMemory_xau16[17].amb_cond.ambient_condition[1][3] ZFEH_EepromData.ydiMemory_xau16[17].amb_cond.ambient_condition[1][4] ZFEH_EepromData.ydiMemory_xau16[17].amb_cond.ambient_condition[1][5] ZFEH_EepromData.ydiMemory_xau16[17].amb_cond.ambient_condition[1][6] ZFEH_EepromData.ydiMemory_xau16[17].amb_cond.ambient_condition[1][7] ZFEH_EepromData.ydiMemory_xau16[17].amb_cond.ambient_condition[1][8] ZFEH_EepromData.ydiMemory_xau16[17].amb_cond.ambient_condition[1][9] ZFEH_EepromData.ydiMemory_xau16[17].amb_cond.status_of_ambient_conditions[0] ZFEH_EepromData.ydiMemory_xau16[17].amb_cond.status_of_ambient_conditions[1] ZFEH_EepromData.ydiMemory_xau16[17].backwards_counter ZFEH_EepromData.ydiMemory_xau16[17].condition_byte ZFEH_EepromData.ydiMemory_xau16[17].error_code ZFEH_EepromData.ydiMemory_xau16[17].error_type ZFEH_EepromData.ydiMemory_xau16[17].frequency_counter ZFEH_EepromData.ydiMemory_xau16[17].master_time ZFEH_EepromData.ydiMemory_xau16[17].obd_driving_cycle_counter ZFEH_EepromData.ydiMemory_xau16[17].permanent_counter ZFEH_EepromData.ydiMemory_xau16[17].sequence_counter ZFEH_EepromData.ydiMemory_xau16[17].status_word ZFEH_EepromData.ydiMemory_xau16[18].amb_cond.ambient_condition[0][0] ZFEH_EepromData.ydiMemory_xau16[18].amb_cond.ambient_condition[0][10] ZFEH_EepromData.ydiMemory_xau16[18].amb_cond.ambient_condition[0][11] ZFEH_EepromData.ydiMemory_xau16[18].amb_cond.ambient_condition[0][12] ZFEH_EepromData.ydiMemory_xau16[18].amb_cond.ambient_condition[0][13] ZFEH_EepromData.ydiMemory_xau16[18].amb_cond.ambient_condition[0][14] ZFEH_EepromData.ydiMemory_xau16[18].amb_cond.ambient_condition[0][15] ZFEH_EepromData.ydiMemory_xau16[18].amb_cond.ambient_condition[0][16] ZFEH_EepromData.ydiMemory_xau16[18].amb_cond.ambient_condition[0][17] ZFEH_EepromData.ydiMemory_xau16[18].amb_cond.ambient_condition[0][18] ZFEH_EepromData.ydiMemory_xau16[18].amb_cond.ambient_condition[0][19] ZFEH_EepromData.ydiMemory_xau16[18].amb_cond.ambient_condition[0][1] ZFEH_EepromData.ydiMemory_xau16[18].amb_cond.ambient_condition[0][20] ZFEH_EepromData.ydiMemory_xau16[18].amb_cond.ambient_condition[0][21] ZFEH_EepromData.ydiMemory_xau16[18].amb_cond.ambient_condition[0][22] ZFEH_EepromData.ydiMemory_xau16[18].amb_cond.ambient_condition[0][23] ZFEH_EepromData.ydiMemory_xau16[18].amb_cond.ambient_condition[0][24] ZFEH_EepromData.ydiMemory_xau16[18].amb_cond.ambient_condition[0][2] ZFEH_EepromData.ydiMemory_xau16[18].amb_cond.ambient_condition[0][3] ZFEH_EepromData.ydiMemory_xau16[18].amb_cond.ambient_condition[0][4] ZFEH_EepromData.ydiMemory_xau16[18].amb_cond.ambient_condition[0][5] ZFEH_EepromData.ydiMemory_xau16[18].amb_cond.ambient_condition[0][6] ZFEH_EepromData.ydiMemory_xau16[18].amb_cond.ambient_condition[0][7] ZFEH_EepromData.ydiMemory_xau16[18].amb_cond.ambient_condition[0][8] ZFEH_EepromData.ydiMemory_xau16[18].amb_cond.ambient_condition[0][9] ZFEH_EepromData.ydiMemory_xau16[18].amb_cond.ambient_condition[1][0] ZFEH_EepromData.ydiMemory_xau16[18].amb_cond.ambient_condition[1][10] ZFEH_EepromData.ydiMemory_xau16[18].amb_cond.ambient_condition[1][11] ZFEH_EepromData.ydiMemory_xau16[18].amb_cond.ambient_condition[1][12] ZFEH_EepromData.ydiMemory_xau16[18].amb_cond.ambient_condition[1][13] ZFEH_EepromData.ydiMemory_xau16[18].amb_cond.ambient_condition[1][14] ZFEH_EepromData.ydiMemory_xau16[18].amb_cond.ambient_condition[1][15] ZFEH_EepromData.ydiMemory_xau16[18].amb_cond.ambient_condition[1][16] ZFEH_EepromData.ydiMemory_xau16[18].amb_cond.ambient_condition[1][17] ZFEH_EepromData.ydiMemory_xau16[18].amb_cond.ambient_condition[1][18] ZFEH_EepromData.ydiMemory_xau16[18].amb_cond.ambient_condition[1][19] ZFEH_EepromData.ydiMemory_xau16[18].amb_cond.ambient_condition[1][1] ZFEH_EepromData.ydiMemory_xau16[18].amb_cond.ambient_condition[1][20] ZFEH_EepromData.ydiMemory_xau16[18].amb_cond.ambient_condition[1][21] ZFEH_EepromData.ydiMemory_xau16[18].amb_cond.ambient_condition[1][22] ZFEH_EepromData.ydiMemory_xau16[18].amb_cond.ambient_condition[1][23] ZFEH_EepromData.ydiMemory_xau16[18].amb_cond.ambient_condition[1][24] ZFEH_EepromData.ydiMemory_xau16[18].amb_cond.ambient_condition[1][2] ZFEH_EepromData.ydiMemory_xau16[18].amb_cond.ambient_condition[1][3] ZFEH_EepromData.ydiMemory_xau16[18].amb_cond.ambient_condition[1][4] ZFEH_EepromData.ydiMemory_xau16[18].amb_cond.ambient_condition[1][5] ZFEH_EepromData.ydiMemory_xau16[18].amb_cond.ambient_condition[1][6] ZFEH_EepromData.ydiMemory_xau16[18].amb_cond.ambient_condition[1][7] ZFEH_EepromData.ydiMemory_xau16[18].amb_cond.ambient_condition[1][8] ZFEH_EepromData.ydiMemory_xau16[18].amb_cond.ambient_condition[1][9] ZFEH_EepromData.ydiMemory_xau16[18].amb_cond.status_of_ambient_conditions[0] ZFEH_EepromData.ydiMemory_xau16[18].amb_cond.status_of_ambient_conditions[1] ZFEH_EepromData.ydiMemory_xau16[18].backwards_counter ZFEH_EepromData.ydiMemory_xau16[18].condition_byte ZFEH_EepromData.ydiMemory_xau16[18].error_code ZFEH_EepromData.ydiMemory_xau16[18].error_type ZFEH_EepromData.ydiMemory_xau16[18].frequency_counter ZFEH_EepromData.ydiMemory_xau16[18].master_time ZFEH_EepromData.ydiMemory_xau16[18].obd_driving_cycle_counter ZFEH_EepromData.ydiMemory_xau16[18].permanent_counter ZFEH_EepromData.ydiMemory_xau16[18].sequence_counter ZFEH_EepromData.ydiMemory_xau16[18].status_word ZFEH_EepromData.ydiMemory_xau16[19].amb_cond.ambient_condition[0][0] ZFEH_EepromData.ydiMemory_xau16[19].amb_cond.ambient_condition[0][10] ZFEH_EepromData.ydiMemory_xau16[19].amb_cond.ambient_condition[0][11] ZFEH_EepromData.ydiMemory_xau16[19].amb_cond.ambient_condition[0][12] ZFEH_EepromData.ydiMemory_xau16[19].amb_cond.ambient_condition[0][13] ZFEH_EepromData.ydiMemory_xau16[19].amb_cond.ambient_condition[0][14] ZFEH_EepromData.ydiMemory_xau16[19].amb_cond.ambient_condition[0][15] ZFEH_EepromData.ydiMemory_xau16[19].amb_cond.ambient_condition[0][16] ZFEH_EepromData.ydiMemory_xau16[19].amb_cond.ambient_condition[0][17] ZFEH_EepromData.ydiMemory_xau16[19].amb_cond.ambient_condition[0][18] ZFEH_EepromData.ydiMemory_xau16[19].amb_cond.ambient_condition[0][19] ZFEH_EepromData.ydiMemory_xau16[19].amb_cond.ambient_condition[0][1] ZFEH_EepromData.ydiMemory_xau16[19].amb_cond.ambient_condition[0][20] ZFEH_EepromData.ydiMemory_xau16[19].amb_cond.ambient_condition[0][21] ZFEH_EepromData.ydiMemory_xau16[19].amb_cond.ambient_condition[0][22] ZFEH_EepromData.ydiMemory_xau16[19].amb_cond.ambient_condition[0][23] ZFEH_EepromData.ydiMemory_xau16[19].amb_cond.ambient_condition[0][24] ZFEH_EepromData.ydiMemory_xau16[19].amb_cond.ambient_condition[0][2] ZFEH_EepromData.ydiMemory_xau16[19].amb_cond.ambient_condition[0][3] ZFEH_EepromData.ydiMemory_xau16[19].amb_cond.ambient_condition[0][4] ZFEH_EepromData.ydiMemory_xau16[19].amb_cond.ambient_condition[0][5] ZFEH_EepromData.ydiMemory_xau16[19].amb_cond.ambient_condition[0][6] ZFEH_EepromData.ydiMemory_xau16[19].amb_cond.ambient_condition[0][7] ZFEH_EepromData.ydiMemory_xau16[19].amb_cond.ambient_condition[0][8] ZFEH_EepromData.ydiMemory_xau16[19].amb_cond.ambient_condition[0][9] ZFEH_EepromData.ydiMemory_xau16[19].amb_cond.ambient_condition[1][0] ZFEH_EepromData.ydiMemory_xau16[19].amb_cond.ambient_condition[1][10] ZFEH_EepromData.ydiMemory_xau16[19].amb_cond.ambient_condition[1][11] ZFEH_EepromData.ydiMemory_xau16[19].amb_cond.ambient_condition[1][12] ZFEH_EepromData.ydiMemory_xau16[19].amb_cond.ambient_condition[1][13] ZFEH_EepromData.ydiMemory_xau16[19].amb_cond.ambient_condition[1][14] ZFEH_EepromData.ydiMemory_xau16[19].amb_cond.ambient_condition[1][15] ZFEH_EepromData.ydiMemory_xau16[19].amb_cond.ambient_condition[1][16] ZFEH_EepromData.ydiMemory_xau16[19].amb_cond.ambient_condition[1][17] ZFEH_EepromData.ydiMemory_xau16[19].amb_cond.ambient_condition[1][18] ZFEH_EepromData.ydiMemory_xau16[19].amb_cond.ambient_condition[1][19] ZFEH_EepromData.ydiMemory_xau16[19].amb_cond.ambient_condition[1][1] ZFEH_EepromData.ydiMemory_xau16[19].amb_cond.ambient_condition[1][20] ZFEH_EepromData.ydiMemory_xau16[19].amb_cond.ambient_condition[1][21] ZFEH_EepromData.ydiMemory_xau16[19].amb_cond.ambient_condition[1][22] ZFEH_EepromData.ydiMemory_xau16[19].amb_cond.ambient_condition[1][23] ZFEH_EepromData.ydiMemory_xau16[19].amb_cond.ambient_condition[1][24] ZFEH_EepromData.ydiMemory_xau16[19].amb_cond.ambient_condition[1][2] ZFEH_EepromData.ydiMemory_xau16[19].amb_cond.ambient_condition[1][3] ZFEH_EepromData.ydiMemory_xau16[19].amb_cond.ambient_condition[1][4] ZFEH_EepromData.ydiMemory_xau16[19].amb_cond.ambient_condition[1][5] ZFEH_EepromData.ydiMemory_xau16[19].amb_cond.ambient_condition[1][6] ZFEH_EepromData.ydiMemory_xau16[19].amb_cond.ambient_condition[1][7] ZFEH_EepromData.ydiMemory_xau16[19].amb_cond.ambient_condition[1][8] ZFEH_EepromData.ydiMemory_xau16[19].amb_cond.ambient_condition[1][9] ZFEH_EepromData.ydiMemory_xau16[19].amb_cond.status_of_ambient_conditions[0] ZFEH_EepromData.ydiMemory_xau16[19].amb_cond.status_of_ambient_conditions[1] ZFEH_EepromData.ydiMemory_xau16[19].backwards_counter ZFEH_EepromData.ydiMemory_xau16[19].condition_byte ZFEH_EepromData.ydiMemory_xau16[19].error_code ZFEH_EepromData.ydiMemory_xau16[19].error_type ZFEH_EepromData.ydiMemory_xau16[19].frequency_counter ZFEH_EepromData.ydiMemory_xau16[19].master_time ZFEH_EepromData.ydiMemory_xau16[19].obd_driving_cycle_counter ZFEH_EepromData.ydiMemory_xau16[19].permanent_counter ZFEH_EepromData.ydiMemory_xau16[19].sequence_counter ZFEH_EepromData.ydiMemory_xau16[19].status_word ZFEH_EepromData.ydiMemory_xau16[1].amb_cond.ambient_condition[0][0] ZFEH_EepromData.ydiMemory_xau16[1].amb_cond.ambient_condition[0][10] ZFEH_EepromData.ydiMemory_xau16[1].amb_cond.ambient_condition[0][11] ZFEH_EepromData.ydiMemory_xau16[1].amb_cond.ambient_condition[0][12] ZFEH_EepromData.ydiMemory_xau16[1].amb_cond.ambient_condition[0][13] ZFEH_EepromData.ydiMemory_xau16[1].amb_cond.ambient_condition[0][14] ZFEH_EepromData.ydiMemory_xau16[1].amb_cond.ambient_condition[0][15] ZFEH_EepromData.ydiMemory_xau16[1].amb_cond.ambient_condition[0][16] ZFEH_EepromData.ydiMemory_xau16[1].amb_cond.ambient_condition[0][17] ZFEH_EepromData.ydiMemory_xau16[1].amb_cond.ambient_condition[0][18] ZFEH_EepromData.ydiMemory_xau16[1].amb_cond.ambient_condition[0][19] ZFEH_EepromData.ydiMemory_xau16[1].amb_cond.ambient_condition[0][1] ZFEH_EepromData.ydiMemory_xau16[1].amb_cond.ambient_condition[0][20] ZFEH_EepromData.ydiMemory_xau16[1].amb_cond.ambient_condition[0][21] ZFEH_EepromData.ydiMemory_xau16[1].amb_cond.ambient_condition[0][22] ZFEH_EepromData.ydiMemory_xau16[1].amb_cond.ambient_condition[0][23] ZFEH_EepromData.ydiMemory_xau16[1].amb_cond.ambient_condition[0][24] ZFEH_EepromData.ydiMemory_xau16[1].amb_cond.ambient_condition[0][2] ZFEH_EepromData.ydiMemory_xau16[1].amb_cond.ambient_condition[0][3] ZFEH_EepromData.ydiMemory_xau16[1].amb_cond.ambient_condition[0][4] ZFEH_EepromData.ydiMemory_xau16[1].amb_cond.ambient_condition[0][5] ZFEH_EepromData.ydiMemory_xau16[1].amb_cond.ambient_condition[0][6] ZFEH_EepromData.ydiMemory_xau16[1].amb_cond.ambient_condition[0][7] ZFEH_EepromData.ydiMemory_xau16[1].amb_cond.ambient_condition[0][8] ZFEH_EepromData.ydiMemory_xau16[1].amb_cond.ambient_condition[0][9] ZFEH_EepromData.ydiMemory_xau16[1].amb_cond.ambient_condition[1][0] ZFEH_EepromData.ydiMemory_xau16[1].amb_cond.ambient_condition[1][10] ZFEH_EepromData.ydiMemory_xau16[1].amb_cond.ambient_condition[1][11] ZFEH_EepromData.ydiMemory_xau16[1].amb_cond.ambient_condition[1][12] ZFEH_EepromData.ydiMemory_xau16[1].amb_cond.ambient_condition[1][13] ZFEH_EepromData.ydiMemory_xau16[1].amb_cond.ambient_condition[1][14] ZFEH_EepromData.ydiMemory_xau16[1].amb_cond.ambient_condition[1][15] ZFEH_EepromData.ydiMemory_xau16[1].amb_cond.ambient_condition[1][16] ZFEH_EepromData.ydiMemory_xau16[1].amb_cond.ambient_condition[1][17] ZFEH_EepromData.ydiMemory_xau16[1].amb_cond.ambient_condition[1][18] ZFEH_EepromData.ydiMemory_xau16[1].amb_cond.ambient_condition[1][19] ZFEH_EepromData.ydiMemory_xau16[1].amb_cond.ambient_condition[1][1] ZFEH_EepromData.ydiMemory_xau16[1].amb_cond.ambient_condition[1][20] ZFEH_EepromData.ydiMemory_xau16[1].amb_cond.ambient_condition[1][21] ZFEH_EepromData.ydiMemory_xau16[1].amb_cond.ambient_condition[1][22] ZFEH_EepromData.ydiMemory_xau16[1].amb_cond.ambient_condition[1][23] ZFEH_EepromData.ydiMemory_xau16[1].amb_cond.ambient_condition[1][24] ZFEH_EepromData.ydiMemory_xau16[1].amb_cond.ambient_condition[1][2] ZFEH_EepromData.ydiMemory_xau16[1].amb_cond.ambient_condition[1][3] ZFEH_EepromData.ydiMemory_xau16[1].amb_cond.ambient_condition[1][4] ZFEH_EepromData.ydiMemory_xau16[1].amb_cond.ambient_condition[1][5] ZFEH_EepromData.ydiMemory_xau16[1].amb_cond.ambient_condition[1][6] ZFEH_EepromData.ydiMemory_xau16[1].amb_cond.ambient_condition[1][7] ZFEH_EepromData.ydiMemory_xau16[1].amb_cond.ambient_condition[1][8] ZFEH_EepromData.ydiMemory_xau16[1].amb_cond.ambient_condition[1][9] ZFEH_EepromData.ydiMemory_xau16[1].amb_cond.status_of_ambient_conditions[0] ZFEH_EepromData.ydiMemory_xau16[1].amb_cond.status_of_ambient_conditions[1] ZFEH_EepromData.ydiMemory_xau16[1].backwards_counter ZFEH_EepromData.ydiMemory_xau16[1].condition_byte ZFEH_EepromData.ydiMemory_xau16[1].error_code ZFEH_EepromData.ydiMemory_xau16[1].error_type ZFEH_EepromData.ydiMemory_xau16[1].frequency_counter ZFEH_EepromData.ydiMemory_xau16[1].master_time ZFEH_EepromData.ydiMemory_xau16[1].obd_driving_cycle_counter ZFEH_EepromData.ydiMemory_xau16[1].permanent_counter ZFEH_EepromData.ydiMemory_xau16[1].sequence_counter ZFEH_EepromData.ydiMemory_xau16[1].status_word ZFEH_EepromData.ydiMemory_xau16[2].amb_cond.ambient_condition[0][0] ZFEH_EepromData.ydiMemory_xau16[2].amb_cond.ambient_condition[0][10] ZFEH_EepromData.ydiMemory_xau16[2].amb_cond.ambient_condition[0][11] ZFEH_EepromData.ydiMemory_xau16[2].amb_cond.ambient_condition[0][12] ZFEH_EepromData.ydiMemory_xau16[2].amb_cond.ambient_condition[0][13] ZFEH_EepromData.ydiMemory_xau16[2].amb_cond.ambient_condition[0][14] ZFEH_EepromData.ydiMemory_xau16[2].amb_cond.ambient_condition[0][15] ZFEH_EepromData.ydiMemory_xau16[2].amb_cond.ambient_condition[0][16] ZFEH_EepromData.ydiMemory_xau16[2].amb_cond.ambient_condition[0][17] ZFEH_EepromData.ydiMemory_xau16[2].amb_cond.ambient_condition[0][18] ZFEH_EepromData.ydiMemory_xau16[2].amb_cond.ambient_condition[0][19] ZFEH_EepromData.ydiMemory_xau16[2].amb_cond.ambient_condition[0][1] ZFEH_EepromData.ydiMemory_xau16[2].amb_cond.ambient_condition[0][20] ZFEH_EepromData.ydiMemory_xau16[2].amb_cond.ambient_condition[0][21] ZFEH_EepromData.ydiMemory_xau16[2].amb_cond.ambient_condition[0][22] ZFEH_EepromData.ydiMemory_xau16[2].amb_cond.ambient_condition[0][23] ZFEH_EepromData.ydiMemory_xau16[2].amb_cond.ambient_condition[0][24] ZFEH_EepromData.ydiMemory_xau16[2].amb_cond.ambient_condition[0][2] ZFEH_EepromData.ydiMemory_xau16[2].amb_cond.ambient_condition[0][3] ZFEH_EepromData.ydiMemory_xau16[2].amb_cond.ambient_condition[0][4] ZFEH_EepromData.ydiMemory_xau16[2].amb_cond.ambient_condition[0][5] ZFEH_EepromData.ydiMemory_xau16[2].amb_cond.ambient_condition[0][6] ZFEH_EepromData.ydiMemory_xau16[2].amb_cond.ambient_condition[0][7] ZFEH_EepromData.ydiMemory_xau16[2].amb_cond.ambient_condition[0][8] ZFEH_EepromData.ydiMemory_xau16[2].amb_cond.ambient_condition[0][9] ZFEH_EepromData.ydiMemory_xau16[2].amb_cond.ambient_condition[1][0] ZFEH_EepromData.ydiMemory_xau16[2].amb_cond.ambient_condition[1][10] ZFEH_EepromData.ydiMemory_xau16[2].amb_cond.ambient_condition[1][11] ZFEH_EepromData.ydiMemory_xau16[2].amb_cond.ambient_condition[1][12] ZFEH_EepromData.ydiMemory_xau16[2].amb_cond.ambient_condition[1][13] ZFEH_EepromData.ydiMemory_xau16[2].amb_cond.ambient_condition[1][14] ZFEH_EepromData.ydiMemory_xau16[2].amb_cond.ambient_condition[1][15] ZFEH_EepromData.ydiMemory_xau16[2].amb_cond.ambient_condition[1][16] ZFEH_EepromData.ydiMemory_xau16[2].amb_cond.ambient_condition[1][17] ZFEH_EepromData.ydiMemory_xau16[2].amb_cond.ambient_condition[1][18] ZFEH_EepromData.ydiMemory_xau16[2].amb_cond.ambient_condition[1][19] ZFEH_EepromData.ydiMemory_xau16[2].amb_cond.ambient_condition[1][1] ZFEH_EepromData.ydiMemory_xau16[2].amb_cond.ambient_condition[1][20] ZFEH_EepromData.ydiMemory_xau16[2].amb_cond.ambient_condition[1][21] ZFEH_EepromData.ydiMemory_xau16[2].amb_cond.ambient_condition[1][22] ZFEH_EepromData.ydiMemory_xau16[2].amb_cond.ambient_condition[1][23] ZFEH_EepromData.ydiMemory_xau16[2].amb_cond.ambient_condition[1][24] ZFEH_EepromData.ydiMemory_xau16[2].amb_cond.ambient_condition[1][2] ZFEH_EepromData.ydiMemory_xau16[2].amb_cond.ambient_condition[1][3] ZFEH_EepromData.ydiMemory_xau16[2].amb_cond.ambient_condition[1][4] ZFEH_EepromData.ydiMemory_xau16[2].amb_cond.ambient_condition[1][5] ZFEH_EepromData.ydiMemory_xau16[2].amb_cond.ambient_condition[1][6] ZFEH_EepromData.ydiMemory_xau16[2].amb_cond.ambient_condition[1][7] ZFEH_EepromData.ydiMemory_xau16[2].amb_cond.ambient_condition[1][8] ZFEH_EepromData.ydiMemory_xau16[2].amb_cond.ambient_condition[1][9] ZFEH_EepromData.ydiMemory_xau16[2].amb_cond.status_of_ambient_conditions[0] ZFEH_EepromData.ydiMemory_xau16[2].amb_cond.status_of_ambient_conditions[1] ZFEH_EepromData.ydiMemory_xau16[2].backwards_counter ZFEH_EepromData.ydiMemory_xau16[2].condition_byte ZFEH_EepromData.ydiMemory_xau16[2].error_code ZFEH_EepromData.ydiMemory_xau16[2].error_type ZFEH_EepromData.ydiMemory_xau16[2].frequency_counter ZFEH_EepromData.ydiMemory_xau16[2].master_time ZFEH_EepromData.ydiMemory_xau16[2].obd_driving_cycle_counter ZFEH_EepromData.ydiMemory_xau16[2].permanent_counter ZFEH_EepromData.ydiMemory_xau16[2].sequence_counter ZFEH_EepromData.ydiMemory_xau16[2].status_word ZFEH_EepromData.ydiMemory_xau16[3].amb_cond.ambient_condition[0][0] ZFEH_EepromData.ydiMemory_xau16[3].amb_cond.ambient_condition[0][10] ZFEH_EepromData.ydiMemory_xau16[3].amb_cond.ambient_condition[0][11] ZFEH_EepromData.ydiMemory_xau16[3].amb_cond.ambient_condition[0][12] ZFEH_EepromData.ydiMemory_xau16[3].amb_cond.ambient_condition[0][13] ZFEH_EepromData.ydiMemory_xau16[3].amb_cond.ambient_condition[0][14] ZFEH_EepromData.ydiMemory_xau16[3].amb_cond.ambient_condition[0][15] ZFEH_EepromData.ydiMemory_xau16[3].amb_cond.ambient_condition[0][16] ZFEH_EepromData.ydiMemory_xau16[3].amb_cond.ambient_condition[0][17] ZFEH_EepromData.ydiMemory_xau16[3].amb_cond.ambient_condition[0][18] ZFEH_EepromData.ydiMemory_xau16[3].amb_cond.ambient_condition[0][19] ZFEH_EepromData.ydiMemory_xau16[3].amb_cond.ambient_condition[0][1] ZFEH_EepromData.ydiMemory_xau16[3].amb_cond.ambient_condition[0][20] ZFEH_EepromData.ydiMemory_xau16[3].amb_cond.ambient_condition[0][21] ZFEH_EepromData.ydiMemory_xau16[3].amb_cond.ambient_condition[0][22] ZFEH_EepromData.ydiMemory_xau16[3].amb_cond.ambient_condition[0][23] ZFEH_EepromData.ydiMemory_xau16[3].amb_cond.ambient_condition[0][24] ZFEH_EepromData.ydiMemory_xau16[3].amb_cond.ambient_condition[0][2] ZFEH_EepromData.ydiMemory_xau16[3].amb_cond.ambient_condition[0][3] ZFEH_EepromData.ydiMemory_xau16[3].amb_cond.ambient_condition[0][4] ZFEH_EepromData.ydiMemory_xau16[3].amb_cond.ambient_condition[0][5] ZFEH_EepromData.ydiMemory_xau16[3].amb_cond.ambient_condition[0][6] ZFEH_EepromData.ydiMemory_xau16[3].amb_cond.ambient_condition[0][7] ZFEH_EepromData.ydiMemory_xau16[3].amb_cond.ambient_condition[0][8] ZFEH_EepromData.ydiMemory_xau16[3].amb_cond.ambient_condition[0][9] ZFEH_EepromData.ydiMemory_xau16[3].amb_cond.ambient_condition[1][0] ZFEH_EepromData.ydiMemory_xau16[3].amb_cond.ambient_condition[1][10] ZFEH_EepromData.ydiMemory_xau16[3].amb_cond.ambient_condition[1][11] ZFEH_EepromData.ydiMemory_xau16[3].amb_cond.ambient_condition[1][12] ZFEH_EepromData.ydiMemory_xau16[3].amb_cond.ambient_condition[1][13] ZFEH_EepromData.ydiMemory_xau16[3].amb_cond.ambient_condition[1][14] ZFEH_EepromData.ydiMemory_xau16[3].amb_cond.ambient_condition[1][15] ZFEH_EepromData.ydiMemory_xau16[3].amb_cond.ambient_condition[1][16] ZFEH_EepromData.ydiMemory_xau16[3].amb_cond.ambient_condition[1][17] ZFEH_EepromData.ydiMemory_xau16[3].amb_cond.ambient_condition[1][18] ZFEH_EepromData.ydiMemory_xau16[3].amb_cond.ambient_condition[1][19] ZFEH_EepromData.ydiMemory_xau16[3].amb_cond.ambient_condition[1][1] ZFEH_EepromData.ydiMemory_xau16[3].amb_cond.ambient_condition[1][20] ZFEH_EepromData.ydiMemory_xau16[3].amb_cond.ambient_condition[1][21] ZFEH_EepromData.ydiMemory_xau16[3].amb_cond.ambient_condition[1][22] ZFEH_EepromData.ydiMemory_xau16[3].amb_cond.ambient_condition[1][23] ZFEH_EepromData.ydiMemory_xau16[3].amb_cond.ambient_condition[1][24] ZFEH_EepromData.ydiMemory_xau16[3].amb_cond.ambient_condition[1][2] ZFEH_EepromData.ydiMemory_xau16[3].amb_cond.ambient_condition[1][3] ZFEH_EepromData.ydiMemory_xau16[3].amb_cond.ambient_condition[1][4] ZFEH_EepromData.ydiMemory_xau16[3].amb_cond.ambient_condition[1][5] ZFEH_EepromData.ydiMemory_xau16[3].amb_cond.ambient_condition[1][6] ZFEH_EepromData.ydiMemory_xau16[3].amb_cond.ambient_condition[1][7] ZFEH_EepromData.ydiMemory_xau16[3].amb_cond.ambient_condition[1][8] ZFEH_EepromData.ydiMemory_xau16[3].amb_cond.ambient_condition[1][9] ZFEH_EepromData.ydiMemory_xau16[3].amb_cond.status_of_ambient_conditions[0] ZFEH_EepromData.ydiMemory_xau16[3].amb_cond.status_of_ambient_conditions[1] ZFEH_EepromData.ydiMemory_xau16[3].backwards_counter ZFEH_EepromData.ydiMemory_xau16[3].condition_byte ZFEH_EepromData.ydiMemory_xau16[3].error_code ZFEH_EepromData.ydiMemory_xau16[3].error_type ZFEH_EepromData.ydiMemory_xau16[3].frequency_counter ZFEH_EepromData.ydiMemory_xau16[3].master_time ZFEH_EepromData.ydiMemory_xau16[3].obd_driving_cycle_counter ZFEH_EepromData.ydiMemory_xau16[3].permanent_counter ZFEH_EepromData.ydiMemory_xau16[3].sequence_counter ZFEH_EepromData.ydiMemory_xau16[3].status_word ZFEH_EepromData.ydiMemory_xau16[4].amb_cond.ambient_condition[0][0] ZFEH_EepromData.ydiMemory_xau16[4].amb_cond.ambient_condition[0][10] ZFEH_EepromData.ydiMemory_xau16[4].amb_cond.ambient_condition[0][11] ZFEH_EepromData.ydiMemory_xau16[4].amb_cond.ambient_condition[0][12] ZFEH_EepromData.ydiMemory_xau16[4].amb_cond.ambient_condition[0][13] ZFEH_EepromData.ydiMemory_xau16[4].amb_cond.ambient_condition[0][14] ZFEH_EepromData.ydiMemory_xau16[4].amb_cond.ambient_condition[0][15] ZFEH_EepromData.ydiMemory_xau16[4].amb_cond.ambient_condition[0][16] ZFEH_EepromData.ydiMemory_xau16[4].amb_cond.ambient_condition[0][17] ZFEH_EepromData.ydiMemory_xau16[4].amb_cond.ambient_condition[0][18] ZFEH_EepromData.ydiMemory_xau16[4].amb_cond.ambient_condition[0][19] ZFEH_EepromData.ydiMemory_xau16[4].amb_cond.ambient_condition[0][1] ZFEH_EepromData.ydiMemory_xau16[4].amb_cond.ambient_condition[0][20] ZFEH_EepromData.ydiMemory_xau16[4].amb_cond.ambient_condition[0][21] ZFEH_EepromData.ydiMemory_xau16[4].amb_cond.ambient_condition[0][22] ZFEH_EepromData.ydiMemory_xau16[4].amb_cond.ambient_condition[0][23] ZFEH_EepromData.ydiMemory_xau16[4].amb_cond.ambient_condition[0][24] ZFEH_EepromData.ydiMemory_xau16[4].amb_cond.ambient_condition[0][2] ZFEH_EepromData.ydiMemory_xau16[4].amb_cond.ambient_condition[0][3] ZFEH_EepromData.ydiMemory_xau16[4].amb_cond.ambient_condition[0][4] ZFEH_EepromData.ydiMemory_xau16[4].amb_cond.ambient_condition[0][5] ZFEH_EepromData.ydiMemory_xau16[4].amb_cond.ambient_condition[0][6] ZFEH_EepromData.ydiMemory_xau16[4].amb_cond.ambient_condition[0][7] ZFEH_EepromData.ydiMemory_xau16[4].amb_cond.ambient_condition[0][8] ZFEH_EepromData.ydiMemory_xau16[4].amb_cond.ambient_condition[0][9] ZFEH_EepromData.ydiMemory_xau16[4].amb_cond.ambient_condition[1][0] ZFEH_EepromData.ydiMemory_xau16[4].amb_cond.ambient_condition[1][10] ZFEH_EepromData.ydiMemory_xau16[4].amb_cond.ambient_condition[1][11] ZFEH_EepromData.ydiMemory_xau16[4].amb_cond.ambient_condition[1][12] ZFEH_EepromData.ydiMemory_xau16[4].amb_cond.ambient_condition[1][13] ZFEH_EepromData.ydiMemory_xau16[4].amb_cond.ambient_condition[1][14] ZFEH_EepromData.ydiMemory_xau16[4].amb_cond.ambient_condition[1][15] ZFEH_EepromData.ydiMemory_xau16[4].amb_cond.ambient_condition[1][16] ZFEH_EepromData.ydiMemory_xau16[4].amb_cond.ambient_condition[1][17] ZFEH_EepromData.ydiMemory_xau16[4].amb_cond.ambient_condition[1][18] ZFEH_EepromData.ydiMemory_xau16[4].amb_cond.ambient_condition[1][19] ZFEH_EepromData.ydiMemory_xau16[4].amb_cond.ambient_condition[1][1] ZFEH_EepromData.ydiMemory_xau16[4].amb_cond.ambient_condition[1][20] ZFEH_EepromData.ydiMemory_xau16[4].amb_cond.ambient_condition[1][21] ZFEH_EepromData.ydiMemory_xau16[4].amb_cond.ambient_condition[1][22] ZFEH_EepromData.ydiMemory_xau16[4].amb_cond.ambient_condition[1][23] ZFEH_EepromData.ydiMemory_xau16[4].amb_cond.ambient_condition[1][24] ZFEH_EepromData.ydiMemory_xau16[4].amb_cond.ambient_condition[1][2] ZFEH_EepromData.ydiMemory_xau16[4].amb_cond.ambient_condition[1][3] ZFEH_EepromData.ydiMemory_xau16[4].amb_cond.ambient_condition[1][4] ZFEH_EepromData.ydiMemory_xau16[4].amb_cond.ambient_condition[1][5] ZFEH_EepromData.ydiMemory_xau16[4].amb_cond.ambient_condition[1][6] ZFEH_EepromData.ydiMemory_xau16[4].amb_cond.ambient_condition[1][7] ZFEH_EepromData.ydiMemory_xau16[4].amb_cond.ambient_condition[1][8] ZFEH_EepromData.ydiMemory_xau16[4].amb_cond.ambient_condition[1][9] ZFEH_EepromData.ydiMemory_xau16[4].amb_cond.status_of_ambient_conditions[0] ZFEH_EepromData.ydiMemory_xau16[4].amb_cond.status_of_ambient_conditions[1] ZFEH_EepromData.ydiMemory_xau16[4].backwards_counter ZFEH_EepromData.ydiMemory_xau16[4].condition_byte ZFEH_EepromData.ydiMemory_xau16[4].error_code ZFEH_EepromData.ydiMemory_xau16[4].error_type ZFEH_EepromData.ydiMemory_xau16[4].frequency_counter ZFEH_EepromData.ydiMemory_xau16[4].master_time ZFEH_EepromData.ydiMemory_xau16[4].obd_driving_cycle_counter ZFEH_EepromData.ydiMemory_xau16[4].permanent_counter ZFEH_EepromData.ydiMemory_xau16[4].sequence_counter ZFEH_EepromData.ydiMemory_xau16[4].status_word ZFEH_EepromData.ydiMemory_xau16[5].amb_cond.ambient_condition[0][0] ZFEH_EepromData.ydiMemory_xau16[5].amb_cond.ambient_condition[0][10] ZFEH_EepromData.ydiMemory_xau16[5].amb_cond.ambient_condition[0][11] ZFEH_EepromData.ydiMemory_xau16[5].amb_cond.ambient_condition[0][12] ZFEH_EepromData.ydiMemory_xau16[5].amb_cond.ambient_condition[0][13] ZFEH_EepromData.ydiMemory_xau16[5].amb_cond.ambient_condition[0][14] ZFEH_EepromData.ydiMemory_xau16[5].amb_cond.ambient_condition[0][15] ZFEH_EepromData.ydiMemory_xau16[5].amb_cond.ambient_condition[0][16] ZFEH_EepromData.ydiMemory_xau16[5].amb_cond.ambient_condition[0][17] ZFEH_EepromData.ydiMemory_xau16[5].amb_cond.ambient_condition[0][18] ZFEH_EepromData.ydiMemory_xau16[5].amb_cond.ambient_condition[0][19] ZFEH_EepromData.ydiMemory_xau16[5].amb_cond.ambient_condition[0][1] ZFEH_EepromData.ydiMemory_xau16[5].amb_cond.ambient_condition[0][20] ZFEH_EepromData.ydiMemory_xau16[5].amb_cond.ambient_condition[0][21] ZFEH_EepromData.ydiMemory_xau16[5].amb_cond.ambient_condition[0][22] ZFEH_EepromData.ydiMemory_xau16[5].amb_cond.ambient_condition[0][23] ZFEH_EepromData.ydiMemory_xau16[5].amb_cond.ambient_condition[0][24] ZFEH_EepromData.ydiMemory_xau16[5].amb_cond.ambient_condition[0][2] ZFEH_EepromData.ydiMemory_xau16[5].amb_cond.ambient_condition[0][3] ZFEH_EepromData.ydiMemory_xau16[5].amb_cond.ambient_condition[0][4] ZFEH_EepromData.ydiMemory_xau16[5].amb_cond.ambient_condition[0][5] ZFEH_EepromData.ydiMemory_xau16[5].amb_cond.ambient_condition[0][6] ZFEH_EepromData.ydiMemory_xau16[5].amb_cond.ambient_condition[0][7] ZFEH_EepromData.ydiMemory_xau16[5].amb_cond.ambient_condition[0][8] ZFEH_EepromData.ydiMemory_xau16[5].amb_cond.ambient_condition[0][9] ZFEH_EepromData.ydiMemory_xau16[5].amb_cond.ambient_condition[1][0] ZFEH_EepromData.ydiMemory_xau16[5].amb_cond.ambient_condition[1][10] ZFEH_EepromData.ydiMemory_xau16[5].amb_cond.ambient_condition[1][11] ZFEH_EepromData.ydiMemory_xau16[5].amb_cond.ambient_condition[1][12] ZFEH_EepromData.ydiMemory_xau16[5].amb_cond.ambient_condition[1][13] ZFEH_EepromData.ydiMemory_xau16[5].amb_cond.ambient_condition[1][14] ZFEH_EepromData.ydiMemory_xau16[5].amb_cond.ambient_condition[1][15] ZFEH_EepromData.ydiMemory_xau16[5].amb_cond.ambient_condition[1][16] ZFEH_EepromData.ydiMemory_xau16[5].amb_cond.ambient_condition[1][17] ZFEH_EepromData.ydiMemory_xau16[5].amb_cond.ambient_condition[1][18] ZFEH_EepromData.ydiMemory_xau16[5].amb_cond.ambient_condition[1][19] ZFEH_EepromData.ydiMemory_xau16[5].amb_cond.ambient_condition[1][1] ZFEH_EepromData.ydiMemory_xau16[5].amb_cond.ambient_condition[1][20] ZFEH_EepromData.ydiMemory_xau16[5].amb_cond.ambient_condition[1][21] ZFEH_EepromData.ydiMemory_xau16[5].amb_cond.ambient_condition[1][22] ZFEH_EepromData.ydiMemory_xau16[5].amb_cond.ambient_condition[1][23] ZFEH_EepromData.ydiMemory_xau16[5].amb_cond.ambient_condition[1][24] ZFEH_EepromData.ydiMemory_xau16[5].amb_cond.ambient_condition[1][2] ZFEH_EepromData.ydiMemory_xau16[5].amb_cond.ambient_condition[1][3] ZFEH_EepromData.ydiMemory_xau16[5].amb_cond.ambient_condition[1][4] ZFEH_EepromData.ydiMemory_xau16[5].amb_cond.ambient_condition[1][5] ZFEH_EepromData.ydiMemory_xau16[5].amb_cond.ambient_condition[1][6] ZFEH_EepromData.ydiMemory_xau16[5].amb_cond.ambient_condition[1][7] ZFEH_EepromData.ydiMemory_xau16[5].amb_cond.ambient_condition[1][8] ZFEH_EepromData.ydiMemory_xau16[5].amb_cond.ambient_condition[1][9] ZFEH_EepromData.ydiMemory_xau16[5].amb_cond.status_of_ambient_conditions[0] ZFEH_EepromData.ydiMemory_xau16[5].amb_cond.status_of_ambient_conditions[1] ZFEH_EepromData.ydiMemory_xau16[5].backwards_counter ZFEH_EepromData.ydiMemory_xau16[5].condition_byte ZFEH_EepromData.ydiMemory_xau16[5].error_code ZFEH_EepromData.ydiMemory_xau16[5].error_type ZFEH_EepromData.ydiMemory_xau16[5].frequency_counter ZFEH_EepromData.ydiMemory_xau16[5].master_time ZFEH_EepromData.ydiMemory_xau16[5].obd_driving_cycle_counter ZFEH_EepromData.ydiMemory_xau16[5].permanent_counter ZFEH_EepromData.ydiMemory_xau16[5].sequence_counter ZFEH_EepromData.ydiMemory_xau16[5].status_word ZFEH_EepromData.ydiMemory_xau16[6].amb_cond.ambient_condition[0][0] ZFEH_EepromData.ydiMemory_xau16[6].amb_cond.ambient_condition[0][10] ZFEH_EepromData.ydiMemory_xau16[6].amb_cond.ambient_condition[0][11] ZFEH_EepromData.ydiMemory_xau16[6].amb_cond.ambient_condition[0][12] ZFEH_EepromData.ydiMemory_xau16[6].amb_cond.ambient_condition[0][13] ZFEH_EepromData.ydiMemory_xau16[6].amb_cond.ambient_condition[0][14] ZFEH_EepromData.ydiMemory_xau16[6].amb_cond.ambient_condition[0][15] ZFEH_EepromData.ydiMemory_xau16[6].amb_cond.ambient_condition[0][16] ZFEH_EepromData.ydiMemory_xau16[6].amb_cond.ambient_condition[0][17] ZFEH_EepromData.ydiMemory_xau16[6].amb_cond.ambient_condition[0][18] ZFEH_EepromData.ydiMemory_xau16[6].amb_cond.ambient_condition[0][19] ZFEH_EepromData.ydiMemory_xau16[6].amb_cond.ambient_condition[0][1] ZFEH_EepromData.ydiMemory_xau16[6].amb_cond.ambient_condition[0][20] ZFEH_EepromData.ydiMemory_xau16[6].amb_cond.ambient_condition[0][21] ZFEH_EepromData.ydiMemory_xau16[6].amb_cond.ambient_condition[0][22] ZFEH_EepromData.ydiMemory_xau16[6].amb_cond.ambient_condition[0][23] ZFEH_EepromData.ydiMemory_xau16[6].amb_cond.ambient_condition[0][24] ZFEH_EepromData.ydiMemory_xau16[6].amb_cond.ambient_condition[0][2] ZFEH_EepromData.ydiMemory_xau16[6].amb_cond.ambient_condition[0][3] ZFEH_EepromData.ydiMemory_xau16[6].amb_cond.ambient_condition[0][4] ZFEH_EepromData.ydiMemory_xau16[6].amb_cond.ambient_condition[0][5] ZFEH_EepromData.ydiMemory_xau16[6].amb_cond.ambient_condition[0][6] ZFEH_EepromData.ydiMemory_xau16[6].amb_cond.ambient_condition[0][7] ZFEH_EepromData.ydiMemory_xau16[6].amb_cond.ambient_condition[0][8] ZFEH_EepromData.ydiMemory_xau16[6].amb_cond.ambient_condition[0][9] ZFEH_EepromData.ydiMemory_xau16[6].amb_cond.ambient_condition[1][0] ZFEH_EepromData.ydiMemory_xau16[6].amb_cond.ambient_condition[1][10] ZFEH_EepromData.ydiMemory_xau16[6].amb_cond.ambient_condition[1][11] ZFEH_EepromData.ydiMemory_xau16[6].amb_cond.ambient_condition[1][12] ZFEH_EepromData.ydiMemory_xau16[6].amb_cond.ambient_condition[1][13] ZFEH_EepromData.ydiMemory_xau16[6].amb_cond.ambient_condition[1][14] ZFEH_EepromData.ydiMemory_xau16[6].amb_cond.ambient_condition[1][15] ZFEH_EepromData.ydiMemory_xau16[6].amb_cond.ambient_condition[1][16] ZFEH_EepromData.ydiMemory_xau16[6].amb_cond.ambient_condition[1][17] ZFEH_EepromData.ydiMemory_xau16[6].amb_cond.ambient_condition[1][18] ZFEH_EepromData.ydiMemory_xau16[6].amb_cond.ambient_condition[1][19] ZFEH_EepromData.ydiMemory_xau16[6].amb_cond.ambient_condition[1][1] ZFEH_EepromData.ydiMemory_xau16[6].amb_cond.ambient_condition[1][20] ZFEH_EepromData.ydiMemory_xau16[6].amb_cond.ambient_condition[1][21] ZFEH_EepromData.ydiMemory_xau16[6].amb_cond.ambient_condition[1][22] ZFEH_EepromData.ydiMemory_xau16[6].amb_cond.ambient_condition[1][23] ZFEH_EepromData.ydiMemory_xau16[6].amb_cond.ambient_condition[1][24] ZFEH_EepromData.ydiMemory_xau16[6].amb_cond.ambient_condition[1][2] ZFEH_EepromData.ydiMemory_xau16[6].amb_cond.ambient_condition[1][3] ZFEH_EepromData.ydiMemory_xau16[6].amb_cond.ambient_condition[1][4] ZFEH_EepromData.ydiMemory_xau16[6].amb_cond.ambient_condition[1][5] ZFEH_EepromData.ydiMemory_xau16[6].amb_cond.ambient_condition[1][6] ZFEH_EepromData.ydiMemory_xau16[6].amb_cond.ambient_condition[1][7] ZFEH_EepromData.ydiMemory_xau16[6].amb_cond.ambient_condition[1][8] ZFEH_EepromData.ydiMemory_xau16[6].amb_cond.ambient_condition[1][9] ZFEH_EepromData.ydiMemory_xau16[6].amb_cond.status_of_ambient_conditions[0] ZFEH_EepromData.ydiMemory_xau16[6].amb_cond.status_of_ambient_conditions[1] ZFEH_EepromData.ydiMemory_xau16[6].backwards_counter ZFEH_EepromData.ydiMemory_xau16[6].condition_byte ZFEH_EepromData.ydiMemory_xau16[6].error_code ZFEH_EepromData.ydiMemory_xau16[6].error_type ZFEH_EepromData.ydiMemory_xau16[6].frequency_counter ZFEH_EepromData.ydiMemory_xau16[6].master_time ZFEH_EepromData.ydiMemory_xau16[6].obd_driving_cycle_counter ZFEH_EepromData.ydiMemory_xau16[6].permanent_counter ZFEH_EepromData.ydiMemory_xau16[6].sequence_counter ZFEH_EepromData.ydiMemory_xau16[6].status_word ZFEH_EepromData.ydiMemory_xau16[7].amb_cond.ambient_condition[0][0] ZFEH_EepromData.ydiMemory_xau16[7].amb_cond.ambient_condition[0][10] ZFEH_EepromData.ydiMemory_xau16[7].amb_cond.ambient_condition[0][11] ZFEH_EepromData.ydiMemory_xau16[7].amb_cond.ambient_condition[0][12] ZFEH_EepromData.ydiMemory_xau16[7].amb_cond.ambient_condition[0][13] ZFEH_EepromData.ydiMemory_xau16[7].amb_cond.ambient_condition[0][14] ZFEH_EepromData.ydiMemory_xau16[7].amb_cond.ambient_condition[0][15] ZFEH_EepromData.ydiMemory_xau16[7].amb_cond.ambient_condition[0][16] ZFEH_EepromData.ydiMemory_xau16[7].amb_cond.ambient_condition[0][17] ZFEH_EepromData.ydiMemory_xau16[7].amb_cond.ambient_condition[0][18] ZFEH_EepromData.ydiMemory_xau16[7].amb_cond.ambient_condition[0][19] ZFEH_EepromData.ydiMemory_xau16[7].amb_cond.ambient_condition[0][1] ZFEH_EepromData.ydiMemory_xau16[7].amb_cond.ambient_condition[0][20] ZFEH_EepromData.ydiMemory_xau16[7].amb_cond.ambient_condition[0][21] ZFEH_EepromData.ydiMemory_xau16[7].amb_cond.ambient_condition[0][22] ZFEH_EepromData.ydiMemory_xau16[7].amb_cond.ambient_condition[0][23] ZFEH_EepromData.ydiMemory_xau16[7].amb_cond.ambient_condition[0][24] ZFEH_EepromData.ydiMemory_xau16[7].amb_cond.ambient_condition[0][2] ZFEH_EepromData.ydiMemory_xau16[7].amb_cond.ambient_condition[0][3] ZFEH_EepromData.ydiMemory_xau16[7].amb_cond.ambient_condition[0][4] ZFEH_EepromData.ydiMemory_xau16[7].amb_cond.ambient_condition[0][5] ZFEH_EepromData.ydiMemory_xau16[7].amb_cond.ambient_condition[0][6] ZFEH_EepromData.ydiMemory_xau16[7].amb_cond.ambient_condition[0][7] ZFEH_EepromData.ydiMemory_xau16[7].amb_cond.ambient_condition[0][8] ZFEH_EepromData.ydiMemory_xau16[7].amb_cond.ambient_condition[0][9] ZFEH_EepromData.ydiMemory_xau16[7].amb_cond.ambient_condition[1][0] ZFEH_EepromData.ydiMemory_xau16[7].amb_cond.ambient_condition[1][10] ZFEH_EepromData.ydiMemory_xau16[7].amb_cond.ambient_condition[1][11] ZFEH_EepromData.ydiMemory_xau16[7].amb_cond.ambient_condition[1][12] ZFEH_EepromData.ydiMemory_xau16[7].amb_cond.ambient_condition[1][13] ZFEH_EepromData.ydiMemory_xau16[7].amb_cond.ambient_condition[1][14] ZFEH_EepromData.ydiMemory_xau16[7].amb_cond.ambient_condition[1][15] ZFEH_EepromData.ydiMemory_xau16[7].amb_cond.ambient_condition[1][16] ZFEH_EepromData.ydiMemory_xau16[7].amb_cond.ambient_condition[1][17] ZFEH_EepromData.ydiMemory_xau16[7].amb_cond.ambient_condition[1][18] ZFEH_EepromData.ydiMemory_xau16[7].amb_cond.ambient_condition[1][19] ZFEH_EepromData.ydiMemory_xau16[7].amb_cond.ambient_condition[1][1] ZFEH_EepromData.ydiMemory_xau16[7].amb_cond.ambient_condition[1][20] ZFEH_EepromData.ydiMemory_xau16[7].amb_cond.ambient_condition[1][21] ZFEH_EepromData.ydiMemory_xau16[7].amb_cond.ambient_condition[1][22] ZFEH_EepromData.ydiMemory_xau16[7].amb_cond.ambient_condition[1][23] ZFEH_EepromData.ydiMemory_xau16[7].amb_cond.ambient_condition[1][24] ZFEH_EepromData.ydiMemory_xau16[7].amb_cond.ambient_condition[1][2] ZFEH_EepromData.ydiMemory_xau16[7].amb_cond.ambient_condition[1][3] ZFEH_EepromData.ydiMemory_xau16[7].amb_cond.ambient_condition[1][4] ZFEH_EepromData.ydiMemory_xau16[7].amb_cond.ambient_condition[1][5] ZFEH_EepromData.ydiMemory_xau16[7].amb_cond.ambient_condition[1][6] ZFEH_EepromData.ydiMemory_xau16[7].amb_cond.ambient_condition[1][7] ZFEH_EepromData.ydiMemory_xau16[7].amb_cond.ambient_condition[1][8] ZFEH_EepromData.ydiMemory_xau16[7].amb_cond.ambient_condition[1][9] ZFEH_EepromData.ydiMemory_xau16[7].amb_cond.status_of_ambient_conditions[0] ZFEH_EepromData.ydiMemory_xau16[7].amb_cond.status_of_ambient_conditions[1] ZFEH_EepromData.ydiMemory_xau16[7].backwards_counter ZFEH_EepromData.ydiMemory_xau16[7].condition_byte ZFEH_EepromData.ydiMemory_xau16[7].error_code ZFEH_EepromData.ydiMemory_xau16[7].error_type ZFEH_EepromData.ydiMemory_xau16[7].frequency_counter ZFEH_EepromData.ydiMemory_xau16[7].master_time ZFEH_EepromData.ydiMemory_xau16[7].obd_driving_cycle_counter ZFEH_EepromData.ydiMemory_xau16[7].permanent_counter ZFEH_EepromData.ydiMemory_xau16[7].sequence_counter ZFEH_EepromData.ydiMemory_xau16[7].status_word ZFEH_EepromData.ydiMemory_xau16[8].amb_cond.ambient_condition[0][0] ZFEH_EepromData.ydiMemory_xau16[8].amb_cond.ambient_condition[0][10] ZFEH_EepromData.ydiMemory_xau16[8].amb_cond.ambient_condition[0][11] ZFEH_EepromData.ydiMemory_xau16[8].amb_cond.ambient_condition[0][12] ZFEH_EepromData.ydiMemory_xau16[8].amb_cond.ambient_condition[0][13] ZFEH_EepromData.ydiMemory_xau16[8].amb_cond.ambient_condition[0][14] ZFEH_EepromData.ydiMemory_xau16[8].amb_cond.ambient_condition[0][15] ZFEH_EepromData.ydiMemory_xau16[8].amb_cond.ambient_condition[0][16] ZFEH_EepromData.ydiMemory_xau16[8].amb_cond.ambient_condition[0][17] ZFEH_EepromData.ydiMemory_xau16[8].amb_cond.ambient_condition[0][18] ZFEH_EepromData.ydiMemory_xau16[8].amb_cond.ambient_condition[0][19] ZFEH_EepromData.ydiMemory_xau16[8].amb_cond.ambient_condition[0][1] ZFEH_EepromData.ydiMemory_xau16[8].amb_cond.ambient_condition[0][20] ZFEH_EepromData.ydiMemory_xau16[8].amb_cond.ambient_condition[0][21] ZFEH_EepromData.ydiMemory_xau16[8].amb_cond.ambient_condition[0][22] ZFEH_EepromData.ydiMemory_xau16[8].amb_cond.ambient_condition[0][23] ZFEH_EepromData.ydiMemory_xau16[8].amb_cond.ambient_condition[0][24] ZFEH_EepromData.ydiMemory_xau16[8].amb_cond.ambient_condition[0][2] ZFEH_EepromData.ydiMemory_xau16[8].amb_cond.ambient_condition[0][3] ZFEH_EepromData.ydiMemory_xau16[8].amb_cond.ambient_condition[0][4] ZFEH_EepromData.ydiMemory_xau16[8].amb_cond.ambient_condition[0][5] ZFEH_EepromData.ydiMemory_xau16[8].amb_cond.ambient_condition[0][6] ZFEH_EepromData.ydiMemory_xau16[8].amb_cond.ambient_condition[0][7] ZFEH_EepromData.ydiMemory_xau16[8].amb_cond.ambient_condition[0][8] ZFEH_EepromData.ydiMemory_xau16[8].amb_cond.ambient_condition[0][9] ZFEH_EepromData.ydiMemory_xau16[8].amb_cond.ambient_condition[1][0] ZFEH_EepromData.ydiMemory_xau16[8].amb_cond.ambient_condition[1][10] ZFEH_EepromData.ydiMemory_xau16[8].amb_cond.ambient_condition[1][11] ZFEH_EepromData.ydiMemory_xau16[8].amb_cond.ambient_condition[1][12] ZFEH_EepromData.ydiMemory_xau16[8].amb_cond.ambient_condition[1][13] ZFEH_EepromData.ydiMemory_xau16[8].amb_cond.ambient_condition[1][14] ZFEH_EepromData.ydiMemory_xau16[8].amb_cond.ambient_condition[1][15] ZFEH_EepromData.ydiMemory_xau16[8].amb_cond.ambient_condition[1][16] ZFEH_EepromData.ydiMemory_xau16[8].amb_cond.ambient_condition[1][17] ZFEH_EepromData.ydiMemory_xau16[8].amb_cond.ambient_condition[1][18] ZFEH_EepromData.ydiMemory_xau16[8].amb_cond.ambient_condition[1][19] ZFEH_EepromData.ydiMemory_xau16[8].amb_cond.ambient_condition[1][1] ZFEH_EepromData.ydiMemory_xau16[8].amb_cond.ambient_condition[1][20] ZFEH_EepromData.ydiMemory_xau16[8].amb_cond.ambient_condition[1][21] ZFEH_EepromData.ydiMemory_xau16[8].amb_cond.ambient_condition[1][22] ZFEH_EepromData.ydiMemory_xau16[8].amb_cond.ambient_condition[1][23] ZFEH_EepromData.ydiMemory_xau16[8].amb_cond.ambient_condition[1][24] ZFEH_EepromData.ydiMemory_xau16[8].amb_cond.ambient_condition[1][2] ZFEH_EepromData.ydiMemory_xau16[8].amb_cond.ambient_condition[1][3] ZFEH_EepromData.ydiMemory_xau16[8].amb_cond.ambient_condition[1][4] ZFEH_EepromData.ydiMemory_xau16[8].amb_cond.ambient_condition[1][5] ZFEH_EepromData.ydiMemory_xau16[8].amb_cond.ambient_condition[1][6] ZFEH_EepromData.ydiMemory_xau16[8].amb_cond.ambient_condition[1][7] ZFEH_EepromData.ydiMemory_xau16[8].amb_cond.ambient_condition[1][8] ZFEH_EepromData.ydiMemory_xau16[8].amb_cond.ambient_condition[1][9] ZFEH_EepromData.ydiMemory_xau16[8].amb_cond.status_of_ambient_conditions[0] ZFEH_EepromData.ydiMemory_xau16[8].amb_cond.status_of_ambient_conditions[1] ZFEH_EepromData.ydiMemory_xau16[8].backwards_counter ZFEH_EepromData.ydiMemory_xau16[8].condition_byte ZFEH_EepromData.ydiMemory_xau16[8].error_code ZFEH_EepromData.ydiMemory_xau16[8].error_type ZFEH_EepromData.ydiMemory_xau16[8].frequency_counter ZFEH_EepromData.ydiMemory_xau16[8].master_time ZFEH_EepromData.ydiMemory_xau16[8].obd_driving_cycle_counter ZFEH_EepromData.ydiMemory_xau16[8].permanent_counter ZFEH_EepromData.ydiMemory_xau16[8].sequence_counter ZFEH_EepromData.ydiMemory_xau16[8].status_word ZFEH_EepromData.ydiMemory_xau16[9].amb_cond.ambient_condition[0][0] ZFEH_EepromData.ydiMemory_xau16[9].amb_cond.ambient_condition[0][10] ZFEH_EepromData.ydiMemory_xau16[9].amb_cond.ambient_condition[0][11] ZFEH_EepromData.ydiMemory_xau16[9].amb_cond.ambient_condition[0][12] ZFEH_EepromData.ydiMemory_xau16[9].amb_cond.ambient_condition[0][13] ZFEH_EepromData.ydiMemory_xau16[9].amb_cond.ambient_condition[0][14] ZFEH_EepromData.ydiMemory_xau16[9].amb_cond.ambient_condition[0][15] ZFEH_EepromData.ydiMemory_xau16[9].amb_cond.ambient_condition[0][16] ZFEH_EepromData.ydiMemory_xau16[9].amb_cond.ambient_condition[0][17] ZFEH_EepromData.ydiMemory_xau16[9].amb_cond.ambient_condition[0][18] ZFEH_EepromData.ydiMemory_xau16[9].amb_cond.ambient_condition[0][19] ZFEH_EepromData.ydiMemory_xau16[9].amb_cond.ambient_condition[0][1] ZFEH_EepromData.ydiMemory_xau16[9].amb_cond.ambient_condition[0][20] ZFEH_EepromData.ydiMemory_xau16[9].amb_cond.ambient_condition[0][21] ZFEH_EepromData.ydiMemory_xau16[9].amb_cond.ambient_condition[0][22] ZFEH_EepromData.ydiMemory_xau16[9].amb_cond.ambient_condition[0][23] ZFEH_EepromData.ydiMemory_xau16[9].amb_cond.ambient_condition[0][24] ZFEH_EepromData.ydiMemory_xau16[9].amb_cond.ambient_condition[0][2] ZFEH_EepromData.ydiMemory_xau16[9].amb_cond.ambient_condition[0][3] ZFEH_EepromData.ydiMemory_xau16[9].amb_cond.ambient_condition[0][4] ZFEH_EepromData.ydiMemory_xau16[9].amb_cond.ambient_condition[0][5] ZFEH_EepromData.ydiMemory_xau16[9].amb_cond.ambient_condition[0][6] ZFEH_EepromData.ydiMemory_xau16[9].amb_cond.ambient_condition[0][7] ZFEH_EepromData.ydiMemory_xau16[9].amb_cond.ambient_condition[0][8] ZFEH_EepromData.ydiMemory_xau16[9].amb_cond.ambient_condition[0][9] ZFEH_EepromData.ydiMemory_xau16[9].amb_cond.ambient_condition[1][0] ZFEH_EepromData.ydiMemory_xau16[9].amb_cond.ambient_condition[1][10] ZFEH_EepromData.ydiMemory_xau16[9].amb_cond.ambient_condition[1][11] ZFEH_EepromData.ydiMemory_xau16[9].amb_cond.ambient_condition[1][12] ZFEH_EepromData.ydiMemory_xau16[9].amb_cond.ambient_condition[1][13] ZFEH_EepromData.ydiMemory_xau16[9].amb_cond.ambient_condition[1][14] ZFEH_EepromData.ydiMemory_xau16[9].amb_cond.ambient_condition[1][15] ZFEH_EepromData.ydiMemory_xau16[9].amb_cond.ambient_condition[1][16] ZFEH_EepromData.ydiMemory_xau16[9].amb_cond.ambient_condition[1][17] ZFEH_EepromData.ydiMemory_xau16[9].amb_cond.ambient_condition[1][18] ZFEH_EepromData.ydiMemory_xau16[9].amb_cond.ambient_condition[1][19] ZFEH_EepromData.ydiMemory_xau16[9].amb_cond.ambient_condition[1][1] ZFEH_EepromData.ydiMemory_xau16[9].amb_cond.ambient_condition[1][20] ZFEH_EepromData.ydiMemory_xau16[9].amb_cond.ambient_condition[1][21] ZFEH_EepromData.ydiMemory_xau16[9].amb_cond.ambient_condition[1][22] ZFEH_EepromData.ydiMemory_xau16[9].amb_cond.ambient_condition[1][23] ZFEH_EepromData.ydiMemory_xau16[9].amb_cond.ambient_condition[1][24] ZFEH_EepromData.ydiMemory_xau16[9].amb_cond.ambient_condition[1][2] ZFEH_EepromData.ydiMemory_xau16[9].amb_cond.ambient_condition[1][3] ZFEH_EepromData.ydiMemory_xau16[9].amb_cond.ambient_condition[1][4] ZFEH_EepromData.ydiMemory_xau16[9].amb_cond.ambient_condition[1][5] ZFEH_EepromData.ydiMemory_xau16[9].amb_cond.ambient_condition[1][6] ZFEH_EepromData.ydiMemory_xau16[9].amb_cond.ambient_condition[1][7] ZFEH_EepromData.ydiMemory_xau16[9].amb_cond.ambient_condition[1][8] ZFEH_EepromData.ydiMemory_xau16[9].amb_cond.ambient_condition[1][9] ZFEH_EepromData.ydiMemory_xau16[9].amb_cond.status_of_ambient_conditions[0] ZFEH_EepromData.ydiMemory_xau16[9].amb_cond.status_of_ambient_conditions[1] ZFEH_EepromData.ydiMemory_xau16[9].backwards_counter ZFEH_EepromData.ydiMemory_xau16[9].condition_byte ZFEH_EepromData.ydiMemory_xau16[9].error_code ZFEH_EepromData.ydiMemory_xau16[9].error_type ZFEH_EepromData.ydiMemory_xau16[9].frequency_counter ZFEH_EepromData.ydiMemory_xau16[9].master_time ZFEH_EepromData.ydiMemory_xau16[9].obd_driving_cycle_counter ZFEH_EepromData.ydiMemory_xau16[9].permanent_counter ZFEH_EepromData.ydiMemory_xau16[9].sequence_counter ZFEH_EepromData.ydiMemory_xau16[9].status_word /end IN_MEASUREMENT
/end FUNCTION
/begin FUNCTION zff_EH_FaultInformation "desc_en"
 /begin IN_MEASUREMENT ZFEH_Diagnosis.ctl_CalibrateableTestCond ZFEH_Diagnosis.gl_err_rea ZFEH_Diagnosis.gl_err_rea_hi ZFEH_EepromData.di_obd_dc_specific_readiness[0] ZFEH_EepromData.di_obd_dc_specific_readiness[10] ZFEH_EepromData.di_obd_dc_specific_readiness[11] ZFEH_EepromData.di_obd_dc_specific_readiness[12] ZFEH_EepromData.di_obd_dc_specific_readiness[13] ZFEH_EepromData.di_obd_dc_specific_readiness[14] ZFEH_EepromData.di_obd_dc_specific_readiness[15] ZFEH_EepromData.di_obd_dc_specific_readiness[1] ZFEH_EepromData.di_obd_dc_specific_readiness[2] ZFEH_EepromData.di_obd_dc_specific_readiness[3] ZFEH_EepromData.di_obd_dc_specific_readiness[4] ZFEH_EepromData.di_obd_dc_specific_readiness[5] ZFEH_EepromData.di_obd_dc_specific_readiness[6] ZFEH_EepromData.di_obd_dc_specific_readiness[7] ZFEH_EepromData.di_obd_dc_specific_readiness[8] ZFEH_EepromData.di_obd_dc_specific_readiness[9] ZFEH_EepromData.di_obd_readiness[0] ZFEH_EepromData.di_obd_readiness[10] ZFEH_EepromData.di_obd_readiness[11] ZFEH_EepromData.di_obd_readiness[12] ZFEH_EepromData.di_obd_readiness[13] ZFEH_EepromData.di_obd_readiness[14] ZFEH_EepromData.di_obd_readiness[15] ZFEH_EepromData.di_obd_readiness[1] ZFEH_EepromData.di_obd_readiness[2] ZFEH_EepromData.di_obd_readiness[3] ZFEH_EepromData.di_obd_readiness[4] ZFEH_EepromData.di_obd_readiness[5] ZFEH_EepromData.di_obd_readiness[6] ZFEH_EepromData.di_obd_readiness[7] ZFEH_EepromData.di_obd_readiness[8] ZFEH_EepromData.di_obd_readiness[9] ZFEH_EepromData.di_roe_new_entries_sent[0] ZFEH_EepromData.di_roe_new_entries_sent[10] ZFEH_EepromData.di_roe_new_entries_sent[11] ZFEH_EepromData.di_roe_new_entries_sent[12] ZFEH_EepromData.di_roe_new_entries_sent[13] ZFEH_EepromData.di_roe_new_entries_sent[14] ZFEH_EepromData.di_roe_new_entries_sent[15] ZFEH_EepromData.di_roe_new_entries_sent[1] ZFEH_EepromData.di_roe_new_entries_sent[2] ZFEH_EepromData.di_roe_new_entries_sent[3] ZFEH_EepromData.di_roe_new_entries_sent[4] ZFEH_EepromData.di_roe_new_entries_sent[5] ZFEH_EepromData.di_roe_new_entries_sent[6] ZFEH_EepromData.di_roe_new_entries_sent[7] ZFEH_EepromData.di_roe_new_entries_sent[8] ZFEH_EepromData.di_roe_new_entries_sent[9] ZFEH_EepromData.di_statusOfDTC[0] ZFEH_EepromData.di_statusOfDTC[100] ZFEH_EepromData.di_statusOfDTC[101] ZFEH_EepromData.di_statusOfDTC[102] ZFEH_EepromData.di_statusOfDTC[103] ZFEH_EepromData.di_statusOfDTC[104] ZFEH_EepromData.di_statusOfDTC[105] ZFEH_EepromData.di_statusOfDTC[106] ZFEH_EepromData.di_statusOfDTC[107] ZFEH_EepromData.di_statusOfDTC[108] ZFEH_EepromData.di_statusOfDTC[109] ZFEH_EepromData.di_statusOfDTC[10] ZFEH_EepromData.di_statusOfDTC[110] ZFEH_EepromData.di_statusOfDTC[111] ZFEH_EepromData.di_statusOfDTC[112] ZFEH_EepromData.di_statusOfDTC[113] ZFEH_EepromData.di_statusOfDTC[114] ZFEH_EepromData.di_statusOfDTC[115] ZFEH_EepromData.di_statusOfDTC[116] ZFEH_EepromData.di_statusOfDTC[117] ZFEH_EepromData.di_statusOfDTC[118] ZFEH_EepromData.di_statusOfDTC[119] ZFEH_EepromData.di_statusOfDTC[11] ZFEH_EepromData.di_statusOfDTC[120] ZFEH_EepromData.di_statusOfDTC[121] ZFEH_EepromData.di_statusOfDTC[122] ZFEH_EepromData.di_statusOfDTC[123] ZFEH_EepromData.di_statusOfDTC[124] ZFEH_EepromData.di_statusOfDTC[125] ZFEH_EepromData.di_statusOfDTC[126] ZFEH_EepromData.di_statusOfDTC[127] ZFEH_EepromData.di_statusOfDTC[128] ZFEH_EepromData.di_statusOfDTC[129] ZFEH_EepromData.di_statusOfDTC[12] ZFEH_EepromData.di_statusOfDTC[130] ZFEH_EepromData.di_statusOfDTC[131] ZFEH_EepromData.di_statusOfDTC[132] ZFEH_EepromData.di_statusOfDTC[133] ZFEH_EepromData.di_statusOfDTC[134] ZFEH_EepromData.di_statusOfDTC[135] ZFEH_EepromData.di_statusOfDTC[136] ZFEH_EepromData.di_statusOfDTC[137] ZFEH_EepromData.di_statusOfDTC[138] ZFEH_EepromData.di_statusOfDTC[139] ZFEH_EepromData.di_statusOfDTC[13] ZFEH_EepromData.di_statusOfDTC[140] ZFEH_EepromData.di_statusOfDTC[141] ZFEH_EepromData.di_statusOfDTC[142] ZFEH_EepromData.di_statusOfDTC[143] ZFEH_EepromData.di_statusOfDTC[144] ZFEH_EepromData.di_statusOfDTC[145] ZFEH_EepromData.di_statusOfDTC[146] ZFEH_EepromData.di_statusOfDTC[147] ZFEH_EepromData.di_statusOfDTC[148] ZFEH_EepromData.di_statusOfDTC[149] ZFEH_EepromData.di_statusOfDTC[14] ZFEH_EepromData.di_statusOfDTC[150] ZFEH_EepromData.di_statusOfDTC[151] ZFEH_EepromData.di_statusOfDTC[152] ZFEH_EepromData.di_statusOfDTC[153] ZFEH_EepromData.di_statusOfDTC[154] ZFEH_EepromData.di_statusOfDTC[155] ZFEH_EepromData.di_statusOfDTC[156] ZFEH_EepromData.di_statusOfDTC[157] ZFEH_EepromData.di_statusOfDTC[158] ZFEH_EepromData.di_statusOfDTC[159] ZFEH_EepromData.di_statusOfDTC[15] ZFEH_EepromData.di_statusOfDTC[160] ZFEH_EepromData.di_statusOfDTC[161] ZFEH_EepromData.di_statusOfDTC[162] ZFEH_EepromData.di_statusOfDTC[163] ZFEH_EepromData.di_statusOfDTC[164] ZFEH_EepromData.di_statusOfDTC[165] ZFEH_EepromData.di_statusOfDTC[166] ZFEH_EepromData.di_statusOfDTC[167] ZFEH_EepromData.di_statusOfDTC[168] ZFEH_EepromData.di_statusOfDTC[169] ZFEH_EepromData.di_statusOfDTC[16] ZFEH_EepromData.di_statusOfDTC[170] ZFEH_EepromData.di_statusOfDTC[171] ZFEH_EepromData.di_statusOfDTC[172] ZFEH_EepromData.di_statusOfDTC[173] ZFEH_EepromData.di_statusOfDTC[174] ZFEH_EepromData.di_statusOfDTC[175] ZFEH_EepromData.di_statusOfDTC[176] ZFEH_EepromData.di_statusOfDTC[177] ZFEH_EepromData.di_statusOfDTC[178] ZFEH_EepromData.di_statusOfDTC[179] ZFEH_EepromData.di_statusOfDTC[17] ZFEH_EepromData.di_statusOfDTC[180] ZFEH_EepromData.di_statusOfDTC[181] ZFEH_EepromData.di_statusOfDTC[182] ZFEH_EepromData.di_statusOfDTC[183] ZFEH_EepromData.di_statusOfDTC[184] ZFEH_EepromData.di_statusOfDTC[185] ZFEH_EepromData.di_statusOfDTC[186] ZFEH_EepromData.di_statusOfDTC[187] ZFEH_EepromData.di_statusOfDTC[188] ZFEH_EepromData.di_statusOfDTC[189] ZFEH_EepromData.di_statusOfDTC[18] ZFEH_EepromData.di_statusOfDTC[190] ZFEH_EepromData.di_statusOfDTC[191] ZFEH_EepromData.di_statusOfDTC[192] ZFEH_EepromData.di_statusOfDTC[193] ZFEH_EepromData.di_statusOfDTC[194] ZFEH_EepromData.di_statusOfDTC[195] ZFEH_EepromData.di_statusOfDTC[196] ZFEH_EepromData.di_statusOfDTC[197] ZFEH_EepromData.di_statusOfDTC[198] ZFEH_EepromData.di_statusOfDTC[199] ZFEH_EepromData.di_statusOfDTC[19] ZFEH_EepromData.di_statusOfDTC[1] ZFEH_EepromData.di_statusOfDTC[200] ZFEH_EepromData.di_statusOfDTC[201] ZFEH_EepromData.di_statusOfDTC[202] ZFEH_EepromData.di_statusOfDTC[203] ZFEH_EepromData.di_statusOfDTC[204] ZFEH_EepromData.di_statusOfDTC[205] ZFEH_EepromData.di_statusOfDTC[206] ZFEH_EepromData.di_statusOfDTC[207] ZFEH_EepromData.di_statusOfDTC[208] ZFEH_EepromData.di_statusOfDTC[209] ZFEH_EepromData.di_statusOfDTC[20] ZFEH_EepromData.di_statusOfDTC[210] ZFEH_EepromData.di_statusOfDTC[211] ZFEH_EepromData.di_statusOfDTC[212] ZFEH_EepromData.di_statusOfDTC[213] ZFEH_EepromData.di_statusOfDTC[214] ZFEH_EepromData.di_statusOfDTC[215] ZFEH_EepromData.di_statusOfDTC[216] ZFEH_EepromData.di_statusOfDTC[217] ZFEH_EepromData.di_statusOfDTC[218] ZFEH_EepromData.di_statusOfDTC[219] ZFEH_EepromData.di_statusOfDTC[21] ZFEH_EepromData.di_statusOfDTC[220] ZFEH_EepromData.di_statusOfDTC[221] ZFEH_EepromData.di_statusOfDTC[222] ZFEH_EepromData.di_statusOfDTC[223] ZFEH_EepromData.di_statusOfDTC[224] ZFEH_EepromData.di_statusOfDTC[225] ZFEH_EepromData.di_statusOfDTC[226] ZFEH_EepromData.di_statusOfDTC[227] ZFEH_EepromData.di_statusOfDTC[228] ZFEH_EepromData.di_statusOfDTC[229] ZFEH_EepromData.di_statusOfDTC[22] ZFEH_EepromData.di_statusOfDTC[230] ZFEH_EepromData.di_statusOfDTC[231] ZFEH_EepromData.di_statusOfDTC[232] ZFEH_EepromData.di_statusOfDTC[233] ZFEH_EepromData.di_statusOfDTC[234] ZFEH_EepromData.di_statusOfDTC[235] ZFEH_EepromData.di_statusOfDTC[236] ZFEH_EepromData.di_statusOfDTC[237] ZFEH_EepromData.di_statusOfDTC[238] ZFEH_EepromData.di_statusOfDTC[239] ZFEH_EepromData.di_statusOfDTC[23] ZFEH_EepromData.di_statusOfDTC[240] ZFEH_EepromData.di_statusOfDTC[241] ZFEH_EepromData.di_statusOfDTC[242] ZFEH_EepromData.di_statusOfDTC[243] ZFEH_EepromData.di_statusOfDTC[244] ZFEH_EepromData.di_statusOfDTC[245] ZFEH_EepromData.di_statusOfDTC[246] ZFEH_EepromData.di_statusOfDTC[247] ZFEH_EepromData.di_statusOfDTC[248] ZFEH_EepromData.di_statusOfDTC[249] ZFEH_EepromData.di_statusOfDTC[24] ZFEH_EepromData.di_statusOfDTC[250] ZFEH_EepromData.di_statusOfDTC[251] ZFEH_EepromData.di_statusOfDTC[252] ZFEH_EepromData.di_statusOfDTC[253] ZFEH_EepromData.di_statusOfDTC[25] ZFEH_EepromData.di_statusOfDTC[26] ZFEH_EepromData.di_statusOfDTC[27] ZFEH_EepromData.di_statusOfDTC[28] ZFEH_EepromData.di_statusOfDTC[29] ZFEH_EepromData.di_statusOfDTC[2] ZFEH_EepromData.di_statusOfDTC[30] ZFEH_EepromData.di_statusOfDTC[31] ZFEH_EepromData.di_statusOfDTC[32] ZFEH_EepromData.di_statusOfDTC[33] ZFEH_EepromData.di_statusOfDTC[34] ZFEH_EepromData.di_statusOfDTC[35] ZFEH_EepromData.di_statusOfDTC[36] ZFEH_EepromData.di_statusOfDTC[37] ZFEH_EepromData.di_statusOfDTC[38] ZFEH_EepromData.di_statusOfDTC[39] ZFEH_EepromData.di_statusOfDTC[3] ZFEH_EepromData.di_statusOfDTC[40] ZFEH_EepromData.di_statusOfDTC[41] ZFEH_EepromData.di_statusOfDTC[42] ZFEH_EepromData.di_statusOfDTC[43] ZFEH_EepromData.di_statusOfDTC[44] ZFEH_EepromData.di_statusOfDTC[45] ZFEH_EepromData.di_statusOfDTC[46] ZFEH_EepromData.di_statusOfDTC[47] ZFEH_EepromData.di_statusOfDTC[48] ZFEH_EepromData.di_statusOfDTC[49] ZFEH_EepromData.di_statusOfDTC[4] ZFEH_EepromData.di_statusOfDTC[50] ZFEH_EepromData.di_statusOfDTC[51] ZFEH_EepromData.di_statusOfDTC[52] ZFEH_EepromData.di_statusOfDTC[53] ZFEH_EepromData.di_statusOfDTC[54] ZFEH_EepromData.di_statusOfDTC[55] ZFEH_EepromData.di_statusOfDTC[56] ZFEH_EepromData.di_statusOfDTC[57] ZFEH_EepromData.di_statusOfDTC[58] ZFEH_EepromData.di_statusOfDTC[59] ZFEH_EepromData.di_statusOfDTC[5] ZFEH_EepromData.di_statusOfDTC[60] ZFEH_EepromData.di_statusOfDTC[61] ZFEH_EepromData.di_statusOfDTC[62] ZFEH_EepromData.di_statusOfDTC[63] ZFEH_EepromData.di_statusOfDTC[64] ZFEH_EepromData.di_statusOfDTC[65] ZFEH_EepromData.di_statusOfDTC[66] ZFEH_EepromData.di_statusOfDTC[67] ZFEH_EepromData.di_statusOfDTC[68] ZFEH_EepromData.di_statusOfDTC[69] ZFEH_EepromData.di_statusOfDTC[6] ZFEH_EepromData.di_statusOfDTC[70] ZFEH_EepromData.di_statusOfDTC[71] ZFEH_EepromData.di_statusOfDTC[72] ZFEH_EepromData.di_statusOfDTC[73] ZFEH_EepromData.di_statusOfDTC[74] ZFEH_EepromData.di_statusOfDTC[75] ZFEH_EepromData.di_statusOfDTC[76] ZFEH_EepromData.di_statusOfDTC[77] ZFEH_EepromData.di_statusOfDTC[78] ZFEH_EepromData.di_statusOfDTC[79] ZFEH_EepromData.di_statusOfDTC[7] ZFEH_EepromData.di_statusOfDTC[80] ZFEH_EepromData.di_statusOfDTC[81] ZFEH_EepromData.di_statusOfDTC[82] ZFEH_EepromData.di_statusOfDTC[83] ZFEH_EepromData.di_statusOfDTC[84] ZFEH_EepromData.di_statusOfDTC[85] ZFEH_EepromData.di_statusOfDTC[86] ZFEH_EepromData.di_statusOfDTC[87] ZFEH_EepromData.di_statusOfDTC[88] ZFEH_EepromData.di_statusOfDTC[89] ZFEH_EepromData.di_statusOfDTC[8] ZFEH_EepromData.di_statusOfDTC[90] ZFEH_EepromData.di_statusOfDTC[91] ZFEH_EepromData.di_statusOfDTC[92] ZFEH_EepromData.di_statusOfDTC[93] ZFEH_EepromData.di_statusOfDTC[94] ZFEH_EepromData.di_statusOfDTC[95] ZFEH_EepromData.di_statusOfDTC[96] ZFEH_EepromData.di_statusOfDTC[97] ZFEH_EepromData.di_statusOfDTC[98] ZFEH_EepromData.di_statusOfDTC[99] ZFEH_EepromData.di_statusOfDTC[9] di_err_deb[0] di_err_deb[10] di_err_deb[11] di_err_deb[12] di_err_deb[13] di_err_deb[14] di_err_deb[15] di_err_deb[1] di_err_deb[2] di_err_deb[3] di_err_deb[4] di_err_deb[5] di_err_deb[6] di_err_deb[7] di_err_deb[8] di_err_deb[9] di_err_det[0] di_err_det[10] di_err_det[11] di_err_det[12] di_err_det[13] di_err_det[14] di_err_det[15] di_err_det[1] di_err_det[2] di_err_det[3] di_err_det[4] di_err_det[5] di_err_det[6] di_err_det[7] di_err_det[8] di_err_det[9] di_err_state_info[0] di_err_state_info[100] di_err_state_info[101] di_err_state_info[102] di_err_state_info[103] di_err_state_info[104] di_err_state_info[105] di_err_state_info[106] di_err_state_info[107] di_err_state_info[108] di_err_state_info[109] di_err_state_info[10] di_err_state_info[110] di_err_state_info[111] di_err_state_info[112] di_err_state_info[113] di_err_state_info[114] di_err_state_info[115] di_err_state_info[116] di_err_state_info[117] di_err_state_info[118] di_err_state_info[119] di_err_state_info[11] di_err_state_info[120] di_err_state_info[121] di_err_state_info[122] di_err_state_info[123] di_err_state_info[124] di_err_state_info[125] di_err_state_info[126] di_err_state_info[127] di_err_state_info[128] di_err_state_info[129] di_err_state_info[12] di_err_state_info[130] di_err_state_info[131] di_err_state_info[132] di_err_state_info[133] di_err_state_info[134] di_err_state_info[135] di_err_state_info[136] di_err_state_info[137] di_err_state_info[138] di_err_state_info[139] di_err_state_info[13] di_err_state_info[140] di_err_state_info[141] di_err_state_info[142] di_err_state_info[143] di_err_state_info[144] di_err_state_info[145] di_err_state_info[146] di_err_state_info[147] di_err_state_info[148] di_err_state_info[149] di_err_state_info[14] di_err_state_info[150] di_err_state_info[151] di_err_state_info[152] di_err_state_info[153] di_err_state_info[154] di_err_state_info[155] di_err_state_info[156] di_err_state_info[157] di_err_state_info[158] di_err_state_info[159] di_err_state_info[15] di_err_state_info[160] di_err_state_info[161] di_err_state_info[162] di_err_state_info[163] di_err_state_info[164] di_err_state_info[165] di_err_state_info[166] di_err_state_info[167] di_err_state_info[168] di_err_state_info[169] di_err_state_info[16] di_err_state_info[170] di_err_state_info[171] di_err_state_info[172] di_err_state_info[173] di_err_state_info[174] di_err_state_info[175] di_err_state_info[176] di_err_state_info[177] di_err_state_info[178] di_err_state_info[179] di_err_state_info[17] di_err_state_info[180] di_err_state_info[181] di_err_state_info[182] di_err_state_info[183] di_err_state_info[184] di_err_state_info[185] di_err_state_info[186] di_err_state_info[187] di_err_state_info[188] di_err_state_info[189] di_err_state_info[18] di_err_state_info[190] di_err_state_info[191] di_err_state_info[192] di_err_state_info[193] di_err_state_info[194] di_err_state_info[195] di_err_state_info[196] di_err_state_info[197] di_err_state_info[198] di_err_state_info[199] di_err_state_info[19] di_err_state_info[1] di_err_state_info[200] di_err_state_info[201] di_err_state_info[202] di_err_state_info[203] di_err_state_info[204] di_err_state_info[205] di_err_state_info[206] di_err_state_info[207] di_err_state_info[208] di_err_state_info[209] di_err_state_info[20] di_err_state_info[210] di_err_state_info[211] di_err_state_info[212] di_err_state_info[213] di_err_state_info[214] di_err_state_info[215] di_err_state_info[216] di_err_state_info[217] di_err_state_info[218] di_err_state_info[219] di_err_state_info[21] di_err_state_info[220] di_err_state_info[221] di_err_state_info[222] di_err_state_info[223] di_err_state_info[224] di_err_state_info[225] di_err_state_info[226] di_err_state_info[227] di_err_state_info[228] di_err_state_info[229] di_err_state_info[22] di_err_state_info[230] di_err_state_info[231] di_err_state_info[232] di_err_state_info[233] di_err_state_info[234] di_err_state_info[235] di_err_state_info[236] di_err_state_info[237] di_err_state_info[238] di_err_state_info[239] di_err_state_info[23] di_err_state_info[240] di_err_state_info[241] di_err_state_info[242] di_err_state_info[243] di_err_state_info[244] di_err_state_info[245] di_err_state_info[246] di_err_state_info[247] di_err_state_info[248] di_err_state_info[249] di_err_state_info[24] di_err_state_info[250] di_err_state_info[251] di_err_state_info[252] di_err_state_info[253] di_err_state_info[25] di_err_state_info[26] di_err_state_info[27] di_err_state_info[28] di_err_state_info[29] di_err_state_info[2] di_err_state_info[30] di_err_state_info[31] di_err_state_info[32] di_err_state_info[33] di_err_state_info[34] di_err_state_info[35] di_err_state_info[36] di_err_state_info[37] di_err_state_info[38] di_err_state_info[39] di_err_state_info[3] di_err_state_info[40] di_err_state_info[41] di_err_state_info[42] di_err_state_info[43] di_err_state_info[44] di_err_state_info[45] di_err_state_info[46] di_err_state_info[47] di_err_state_info[48] di_err_state_info[49] di_err_state_info[4] di_err_state_info[50] di_err_state_info[51] di_err_state_info[52] di_err_state_info[53] di_err_state_info[54] di_err_state_info[55] di_err_state_info[56] di_err_state_info[57] di_err_state_info[58] di_err_state_info[59] di_err_state_info[5] di_err_state_info[60] di_err_state_info[61] di_err_state_info[62] di_err_state_info[63] di_err_state_info[64] di_err_state_info[65] di_err_state_info[66] di_err_state_info[67] di_err_state_info[68] di_err_state_info[69] di_err_state_info[6] di_err_state_info[70] di_err_state_info[71] di_err_state_info[72] di_err_state_info[73] di_err_state_info[74] di_err_state_info[75] di_err_state_info[76] di_err_state_info[77] di_err_state_info[78] di_err_state_info[79] di_err_state_info[7] di_err_state_info[80] di_err_state_info[81] di_err_state_info[82] di_err_state_info[83] di_err_state_info[84] di_err_state_info[85] di_err_state_info[86] di_err_state_info[87] di_err_state_info[88] di_err_state_info[89] di_err_state_info[8] di_err_state_info[90] di_err_state_info[91] di_err_state_info[92] di_err_state_info[93] di_err_state_info[94] di_err_state_info[95] di_err_state_info[96] di_err_state_info[97] di_err_state_info[98] di_err_state_info[99] di_err_state_info[9] di_filter_max_val[0] di_filter_max_val[100] di_filter_max_val[101] di_filter_max_val[102] di_filter_max_val[103] di_filter_max_val[104] di_filter_max_val[105] di_filter_max_val[106] di_filter_max_val[107] di_filter_max_val[108] di_filter_max_val[109] di_filter_max_val[10] di_filter_max_val[110] di_filter_max_val[111] di_filter_max_val[112] di_filter_max_val[113] di_filter_max_val[114] di_filter_max_val[115] di_filter_max_val[116] di_filter_max_val[117] di_filter_max_val[118] di_filter_max_val[119] di_filter_max_val[11] di_filter_max_val[120] di_filter_max_val[121] di_filter_max_val[122] di_filter_max_val[123] di_filter_max_val[124] di_filter_max_val[125] di_filter_max_val[126] di_filter_max_val[127] di_filter_max_val[128] di_filter_max_val[129] di_filter_max_val[12] di_filter_max_val[130] di_filter_max_val[131] di_filter_max_val[132] di_filter_max_val[133] di_filter_max_val[134] di_filter_max_val[135] di_filter_max_val[136] di_filter_max_val[137] di_filter_max_val[138] di_filter_max_val[139] di_filter_max_val[13] di_filter_max_val[140] di_filter_max_val[141] di_filter_max_val[142] di_filter_max_val[143] di_filter_max_val[144] di_filter_max_val[145] di_filter_max_val[146] di_filter_max_val[147] di_filter_max_val[148] di_filter_max_val[149] di_filter_max_val[14] di_filter_max_val[150] di_filter_max_val[151] di_filter_max_val[152] di_filter_max_val[153] di_filter_max_val[154] di_filter_max_val[155] di_filter_max_val[156] di_filter_max_val[157] di_filter_max_val[158] di_filter_max_val[159] di_filter_max_val[15] di_filter_max_val[160] di_filter_max_val[161] di_filter_max_val[162] di_filter_max_val[163] di_filter_max_val[164] di_filter_max_val[165] di_filter_max_val[166] di_filter_max_val[167] di_filter_max_val[168] di_filter_max_val[169] di_filter_max_val[16] di_filter_max_val[170] di_filter_max_val[171] di_filter_max_val[172] di_filter_max_val[173] di_filter_max_val[174] di_filter_max_val[175] di_filter_max_val[176] di_filter_max_val[177] di_filter_max_val[178] di_filter_max_val[179] di_filter_max_val[17] di_filter_max_val[180] di_filter_max_val[181] di_filter_max_val[182] di_filter_max_val[183] di_filter_max_val[184] di_filter_max_val[185] di_filter_max_val[186] di_filter_max_val[187] di_filter_max_val[188] di_filter_max_val[189] di_filter_max_val[18] di_filter_max_val[190] di_filter_max_val[191] di_filter_max_val[192] di_filter_max_val[193] di_filter_max_val[194] di_filter_max_val[195] di_filter_max_val[196] di_filter_max_val[197] di_filter_max_val[198] di_filter_max_val[199] di_filter_max_val[19] di_filter_max_val[1] di_filter_max_val[200] di_filter_max_val[201] di_filter_max_val[202] di_filter_max_val[203] di_filter_max_val[204] di_filter_max_val[205] di_filter_max_val[206] di_filter_max_val[207] di_filter_max_val[208] di_filter_max_val[209] di_filter_max_val[20] di_filter_max_val[210] di_filter_max_val[211] di_filter_max_val[212] di_filter_max_val[213] di_filter_max_val[214] di_filter_max_val[215] di_filter_max_val[216] di_filter_max_val[217] di_filter_max_val[218] di_filter_max_val[219] di_filter_max_val[21] di_filter_max_val[220] di_filter_max_val[221] di_filter_max_val[222] di_filter_max_val[223] di_filter_max_val[224] di_filter_max_val[225] di_filter_max_val[226] di_filter_max_val[227] di_filter_max_val[228] di_filter_max_val[229] di_filter_max_val[22] di_filter_max_val[230] di_filter_max_val[231] di_filter_max_val[232] di_filter_max_val[233] di_filter_max_val[234] di_filter_max_val[235] di_filter_max_val[236] di_filter_max_val[237] di_filter_max_val[238] di_filter_max_val[239] di_filter_max_val[23] di_filter_max_val[240] di_filter_max_val[241] di_filter_max_val[242] di_filter_max_val[243] di_filter_max_val[244] di_filter_max_val[245] di_filter_max_val[246] di_filter_max_val[247] di_filter_max_val[248] di_filter_max_val[249] di_filter_max_val[24] di_filter_max_val[250] di_filter_max_val[251] di_filter_max_val[252] di_filter_max_val[253] di_filter_max_val[25] di_filter_max_val[26] di_filter_max_val[27] di_filter_max_val[28] di_filter_max_val[29] di_filter_max_val[2] di_filter_max_val[30] di_filter_max_val[31] di_filter_max_val[32] di_filter_max_val[33] di_filter_max_val[34] di_filter_max_val[35] di_filter_max_val[36] di_filter_max_val[37] di_filter_max_val[38] di_filter_max_val[39] di_filter_max_val[3] di_filter_max_val[40] di_filter_max_val[41] di_filter_max_val[42] di_filter_max_val[43] di_filter_max_val[44] di_filter_max_val[45] di_filter_max_val[46] di_filter_max_val[47] di_filter_max_val[48] di_filter_max_val[49] di_filter_max_val[4] di_filter_max_val[50] di_filter_max_val[51] di_filter_max_val[52] di_filter_max_val[53] di_filter_max_val[54] di_filter_max_val[55] di_filter_max_val[56] di_filter_max_val[57] di_filter_max_val[58] di_filter_max_val[59] di_filter_max_val[5] di_filter_max_val[60] di_filter_max_val[61] di_filter_max_val[62] di_filter_max_val[63] di_filter_max_val[64] di_filter_max_val[65] di_filter_max_val[66] di_filter_max_val[67] di_filter_max_val[68] di_filter_max_val[69] di_filter_max_val[6] di_filter_max_val[70] di_filter_max_val[71] di_filter_max_val[72] di_filter_max_val[73] di_filter_max_val[74] di_filter_max_val[75] di_filter_max_val[76] di_filter_max_val[77] di_filter_max_val[78] di_filter_max_val[79] di_filter_max_val[7] di_filter_max_val[80] di_filter_max_val[81] di_filter_max_val[82] di_filter_max_val[83] di_filter_max_val[84] di_filter_max_val[85] di_filter_max_val[86] di_filter_max_val[87] di_filter_max_val[88] di_filter_max_val[89] di_filter_max_val[8] di_filter_max_val[90] di_filter_max_val[91] di_filter_max_val[92] di_filter_max_val[93] di_filter_max_val[94] di_filter_max_val[95] di_filter_max_val[96] di_filter_max_val[97] di_filter_max_val[98] di_filter_max_val[99] di_filter_max_val[9] ydiFilter_xau16[0] ydiFilter_xau16[100] ydiFilter_xau16[101] ydiFilter_xau16[102] ydiFilter_xau16[103] ydiFilter_xau16[104] ydiFilter_xau16[105] ydiFilter_xau16[106] ydiFilter_xau16[107] ydiFilter_xau16[108] ydiFilter_xau16[109] ydiFilter_xau16[10] ydiFilter_xau16[110] ydiFilter_xau16[111] ydiFilter_xau16[112] ydiFilter_xau16[113] ydiFilter_xau16[114] ydiFilter_xau16[115] ydiFilter_xau16[116] ydiFilter_xau16[117] ydiFilter_xau16[118] ydiFilter_xau16[119] ydiFilter_xau16[11] ydiFilter_xau16[120] ydiFilter_xau16[121] ydiFilter_xau16[122] ydiFilter_xau16[123] ydiFilter_xau16[124] ydiFilter_xau16[125] ydiFilter_xau16[126] ydiFilter_xau16[127] ydiFilter_xau16[128] ydiFilter_xau16[129] ydiFilter_xau16[12] ydiFilter_xau16[130] ydiFilter_xau16[131] ydiFilter_xau16[132] ydiFilter_xau16[133] ydiFilter_xau16[134] ydiFilter_xau16[135] ydiFilter_xau16[136] ydiFilter_xau16[137] ydiFilter_xau16[138] ydiFilter_xau16[139] ydiFilter_xau16[13] ydiFilter_xau16[140] ydiFilter_xau16[141] ydiFilter_xau16[142] ydiFilter_xau16[143] ydiFilter_xau16[144] ydiFilter_xau16[145] ydiFilter_xau16[146] ydiFilter_xau16[147] ydiFilter_xau16[148] ydiFilter_xau16[149] ydiFilter_xau16[14] ydiFilter_xau16[150] ydiFilter_xau16[151] ydiFilter_xau16[152] ydiFilter_xau16[153] ydiFilter_xau16[154] ydiFilter_xau16[155] ydiFilter_xau16[156] ydiFilter_xau16[157] ydiFilter_xau16[158] ydiFilter_xau16[159] ydiFilter_xau16[15] ydiFilter_xau16[160] ydiFilter_xau16[161] ydiFilter_xau16[162] ydiFilter_xau16[163] ydiFilter_xau16[164] ydiFilter_xau16[165] ydiFilter_xau16[166] ydiFilter_xau16[167] ydiFilter_xau16[168] ydiFilter_xau16[169] ydiFilter_xau16[16] ydiFilter_xau16[170] ydiFilter_xau16[171] ydiFilter_xau16[172] ydiFilter_xau16[173] ydiFilter_xau16[174] ydiFilter_xau16[175] ydiFilter_xau16[176] ydiFilter_xau16[177] ydiFilter_xau16[178] ydiFilter_xau16[179] ydiFilter_xau16[17] ydiFilter_xau16[180] ydiFilter_xau16[181] ydiFilter_xau16[182] ydiFilter_xau16[183] ydiFilter_xau16[184] ydiFilter_xau16[185] ydiFilter_xau16[186] ydiFilter_xau16[187] ydiFilter_xau16[188] ydiFilter_xau16[189] ydiFilter_xau16[18] ydiFilter_xau16[190] ydiFilter_xau16[191] ydiFilter_xau16[192] ydiFilter_xau16[193] ydiFilter_xau16[194] ydiFilter_xau16[195] ydiFilter_xau16[196] ydiFilter_xau16[197] ydiFilter_xau16[198] ydiFilter_xau16[199] ydiFilter_xau16[19] ydiFilter_xau16[1] ydiFilter_xau16[200] ydiFilter_xau16[201] ydiFilter_xau16[202] ydiFilter_xau16[203] ydiFilter_xau16[204] ydiFilter_xau16[205] ydiFilter_xau16[206] ydiFilter_xau16[207] ydiFilter_xau16[208] ydiFilter_xau16[209] ydiFilter_xau16[20] ydiFilter_xau16[210] ydiFilter_xau16[211] ydiFilter_xau16[212] ydiFilter_xau16[213] ydiFilter_xau16[214] ydiFilter_xau16[215] ydiFilter_xau16[216] ydiFilter_xau16[217] ydiFilter_xau16[218] ydiFilter_xau16[219] ydiFilter_xau16[21] ydiFilter_xau16[220] ydiFilter_xau16[221] ydiFilter_xau16[222] ydiFilter_xau16[223] ydiFilter_xau16[224] ydiFilter_xau16[225] ydiFilter_xau16[226] ydiFilter_xau16[227] ydiFilter_xau16[228] ydiFilter_xau16[229] ydiFilter_xau16[22] ydiFilter_xau16[230] ydiFilter_xau16[231] ydiFilter_xau16[232] ydiFilter_xau16[233] ydiFilter_xau16[234] ydiFilter_xau16[235] ydiFilter_xau16[236] ydiFilter_xau16[237] ydiFilter_xau16[238] ydiFilter_xau16[239] ydiFilter_xau16[23] ydiFilter_xau16[240] ydiFilter_xau16[241] ydiFilter_xau16[242] ydiFilter_xau16[243] ydiFilter_xau16[244] ydiFilter_xau16[245] ydiFilter_xau16[246] ydiFilter_xau16[247] ydiFilter_xau16[248] ydiFilter_xau16[249] ydiFilter_xau16[24] ydiFilter_xau16[250] ydiFilter_xau16[251] ydiFilter_xau16[252] ydiFilter_xau16[253] ydiFilter_xau16[25] ydiFilter_xau16[26] ydiFilter_xau16[27] ydiFilter_xau16[28] ydiFilter_xau16[29] ydiFilter_xau16[2] ydiFilter_xau16[30] ydiFilter_xau16[31] ydiFilter_xau16[32] ydiFilter_xau16[33] ydiFilter_xau16[34] ydiFilter_xau16[35] ydiFilter_xau16[36] ydiFilter_xau16[37] ydiFilter_xau16[38] ydiFilter_xau16[39] ydiFilter_xau16[3] ydiFilter_xau16[40] ydiFilter_xau16[41] ydiFilter_xau16[42] ydiFilter_xau16[43] ydiFilter_xau16[44] ydiFilter_xau16[45] ydiFilter_xau16[46] ydiFilter_xau16[47] ydiFilter_xau16[48] ydiFilter_xau16[49] ydiFilter_xau16[4] ydiFilter_xau16[50] ydiFilter_xau16[51] ydiFilter_xau16[52] ydiFilter_xau16[53] ydiFilter_xau16[54] ydiFilter_xau16[55] ydiFilter_xau16[56] ydiFilter_xau16[57] ydiFilter_xau16[58] ydiFilter_xau16[59] ydiFilter_xau16[5] ydiFilter_xau16[60] ydiFilter_xau16[61] ydiFilter_xau16[62] ydiFilter_xau16[63] ydiFilter_xau16[64] ydiFilter_xau16[65] ydiFilter_xau16[66] ydiFilter_xau16[67] ydiFilter_xau16[68] ydiFilter_xau16[69] ydiFilter_xau16[6] ydiFilter_xau16[70] ydiFilter_xau16[71] ydiFilter_xau16[72] ydiFilter_xau16[73] ydiFilter_xau16[74] ydiFilter_xau16[75] ydiFilter_xau16[76] ydiFilter_xau16[77] ydiFilter_xau16[78] ydiFilter_xau16[79] ydiFilter_xau16[7] ydiFilter_xau16[80] ydiFilter_xau16[81] ydiFilter_xau16[82] ydiFilter_xau16[83] ydiFilter_xau16[84] ydiFilter_xau16[85] ydiFilter_xau16[86] ydiFilter_xau16[87] ydiFilter_xau16[88] ydiFilter_xau16[89] ydiFilter_xau16[8] ydiFilter_xau16[90] ydiFilter_xau16[91] ydiFilter_xau16[92] ydiFilter_xau16[93] ydiFilter_xau16[94] ydiFilter_xau16[95] ydiFilter_xau16[96] ydiFilter_xau16[97] ydiFilter_xau16[98] ydiFilter_xau16[99] ydiFilter_xau16[9] /end IN_MEASUREMENT
/end FUNCTION
/begin FUNCTION zff_EH_Interfi "desc_en"
 /begin IN_MEASUREMENT ZFEH_Interfi.arg_idx ZFEH_Interfi.arg_idx_komp ZFEH_Interfi.iv_CodingMilCycles ZFEH_Interfi.iv_ThrottlePosition ZFEH_Interfi.iv_f_Ignition ZFEH_Interfi.iv_n_AbFilt ZFEH_Interfi.iv_n_Eng ZFEH_Interfi.iv_u_BattFilt /end IN_MEASUREMENT
/end FUNCTION
/begin FUNCTION zff_EH_Messgroessen "all measurements of Errorhandler"
 /begin SUB_FUNCTION zff_EH_ErrorMemoryInformation zff_EH_ObdErrorMemoryInformation zff_EH_FaultInformation zff_EH_Obd zff_EH_Interfi zff_EH_CommonInformation zff_EH_Statemachine zff_EH_Eeprom zff_EH_Erm zff_EH_CarbHandler zff_EH_CvnCalculation /end SUB_FUNCTION
/end FUNCTION
/end MODULE
/end PROJECT
