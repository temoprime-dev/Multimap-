ASAP2_VERSION 1 51
/begin PROJECT ZHBC8600 "Gen2_BMW_System_Supplier_Lib"
/begin MODULE CPP ""
/begin MOD_COMMON "" BYTE_ORDER MSB_FIRST ALIGNMENT_BYTE 1 ALIGNMENT_WORD 2 ALIGNMENT_LONG 4 ALIGNMENT_FLOAT32_IEEE 4 ALIGNMENT_FLOAT64_IEEE 1 /end MOD_COMMON
/begin COMPU_METHOD SAB2_1PROZENT_S3_S3 "int = ((phys * 1) / 1) - (0) %" RAT_FUNC "%1.0" "%" COEFFS 0 1 0 0 0 1 /end COMPU_METHOD
/begin COMPU_METHOD SAB2_M_1NM_S3_S3 "int = ((phys * 1) / 1) - (0) Nm" RAT_FUNC "%1.0" "Nm" COEFFS 0 1 0 0 0 1 /end COMPU_METHOD
/begin COMPU_METHOD SAB2_MINTEGRAL_NMS100_S3_S3 "int = ((phys * 100) / 1) - (0) Nms" RAT_FUNC "%4.3" "Nms" COEFFS 0 100 0 0 0 1 /end COMPU_METHOD
/begin COMPU_METHOD SAB2_N_10RPM_S3_S3 "int = ((phys * 1) / 10) - (0) 1/min" RAT_FUNC "%4.3" "1/min" COEFFS 0 0.1 0 0 0 1 /end COMPU_METHOD
/begin COMPU_METHOD SAB2_N_8RPM_S3_S3 "int = ((phys * 1) / 8) - (0) 1/min" RAT_FUNC "%4.3" "1/min" COEFFS 0 0.125 0 0 0 1 /end COMPU_METHOD
/begin COMPU_METHOD SAB2_STANDARD_S3_S3 "int = ((phys * 1) / 1) - (0) -" RAT_FUNC "%1.0" "-" COEFFS 0 1 0 0 0 1 /end COMPU_METHOD
/begin COMPU_METHOD SAB2_T_10MS_S3_S3 "int = ((phys * 1) / 10) - (0) ms" RAT_FUNC "%4.3" "ms" COEFFS 0 0.1 0 0 0 1 /end COMPU_METHOD
/begin COMPU_METHOD SAB2_T_TIMER_10MS_S3_S3 "int = ((phys * 1) / 10) - (0) ms" RAT_FUNC "%4.3" "ms" COEFFS 0 0.1 0 0 0 1 /end COMPU_METHOD
/begin COMPU_METHOD SAB_C_CGT_100CEL_M4000_S2_S3 "int = ((phys * 100) / 1) - (-4000) Grad Celsius" RAT_FUNC "%4.3" "Grad Celsius" COEFFS 0 100 4000 0 0 1 /end COMPU_METHOD
/begin COMPU_METHOD SAB_C_CGT_1CEL_M40_S2_S3 "int = ((phys * 1) / 1) - (-40) Grad Celsius" RAT_FUNC "%1.0" "Grad Celsius" COEFFS 0 1 40 0 0 1 /end COMPU_METHOD
/begin COMPU_METHOD SAB_C_TEMPEXTERN_CEL2_M40_S2_S3 "int = ((phys * 2) / 1) - (-80) Grad Celsius" RAT_FUNC "%4.3" "Grad Celsius" COEFFS 0 2 80 0 0 1 /end COMPU_METHOD
/begin COMPU_METHOD SAB_FRQ_1HZ_S2_S3 "int = ((phys * 1) / 1) - (0) Hz" RAT_FUNC "%1.0" "Hz" COEFFS 0 1 0 0 0 1 /end COMPU_METHOD
/begin COMPU_METHOD SAB_K1000_S2_S3 "int = ((phys * 1000) / 1) - (0) -" RAT_FUNC "%4.3" "-" COEFFS 0 1000 0 0 0 1 /end COMPU_METHOD
/begin COMPU_METHOD SAB_K100_S2_S3 "int = ((phys * 100) / 1) - (0) -" RAT_FUNC "%4.3" "-" COEFFS 0 100 0 0 0 1 /end COMPU_METHOD
/begin COMPU_METHOD SAB_L_1KM_S2_S3 "int = ((phys * 1) / 1) - (0) km" RAT_FUNC "%1.0" "km" COEFFS 0 1 0 0 0 1 /end COMPU_METHOD
/begin COMPU_METHOD SAB_L_1MM_S2_S3 "int = ((phys * 1) / 1) - (0) mm" RAT_FUNC "%1.0" "mm" COEFFS 0 1 0 0 0 1 /end COMPU_METHOD
/begin COMPU_METHOD SAB_M_1NM_S2_S3 "int = ((phys * 1) / 1) - (0) Nm" RAT_FUNC "%1.0" "Nm" COEFFS 0 1 0 0 0 1 /end COMPU_METHOD
/begin COMPU_METHOD SAB_M_NM2_M2047_S2_S3 "int = ((phys * 2) / 1) - (-2047) Nm" RAT_FUNC "%4.3" "Nm" COEFFS 0 2 2047 0 0 1 /end COMPU_METHOD
/begin COMPU_METHOD SAB_N_1RPM_S2_S3 "int = ((phys * 1) / 1) - (0) 1/min" RAT_FUNC "%1.0" "1/min" COEFFS 0 1 0 0 0 1 /end COMPU_METHOD
/begin COMPU_METHOD SAB_N_RADPS64_M32767_S2_S3 "int = ((phys * 64) / 1) - (-32767) rad/s" RAT_FUNC "%4.3" "rad/s" COEFFS 0 64 32767 0 0 1 /end COMPU_METHOD
/begin COMPU_METHOD SAB_N_RPM100_S2_S3 "int = ((phys * 100) / 1) - (0) 1/min" RAT_FUNC "%4.3" "1/min" COEFFS 0 100 0 0 0 1 /end COMPU_METHOD
/begin COMPU_METHOD SAB_N_RPM_M2000_S2_S3 "int = ((phys * 1) / 1) - (-2000) 1/min" RAT_FUNC "%1.0" "1/min" COEFFS 0 1 2000 0 0 1 /end COMPU_METHOD
/begin COMPU_METHOD SAB_OM_YAWRATE_GRADPS200_M32768_S2_S3 "int = ((phys * 200) / 1) - (-32768) Grad/s" RAT_FUNC "%4.3" "Grad/s" COEFFS 0 200 32768 0 0 1 /end COMPU_METHOD
/begin COMPU_METHOD SAB_OM_YAWRATE_GRADPS20_S2_S3 "int = ((phys * 20) / 1) - (0) Grad/s" RAT_FUNC "%4.3" "Grad/s" COEFFS 0 20 0 0 0 1 /end COMPU_METHOD
/begin COMPU_METHOD SAB_PHI_STEERING_ANGLE_2747GRAD1000000_M32763_S2_S3 "int = ((phys * 1.0E6) / 2747) - (-32763) grad" RAT_FUNC "%4.3" "grad" COEFFS 0 364.033491081 32763 0 0 1 /end COMPU_METHOD
/begin COMPU_METHOD SAB_PROZENT10_S2_S3 "int = ((phys * 10) / 1) - (0) %" RAT_FUNC "%4.3" "%" COEFFS 0 10 0 0 0 1 /end COMPU_METHOD
/begin COMPU_METHOD SAB_STANDARD_S2_S3 "int = ((phys * 1) / 1) - (0) -" RAT_FUNC "%1.0" "-" COEFFS 0 1 0 0 0 1 /end COMPU_METHOD
/begin COMPU_METHOD SAB_T_TIMER_10MS_S2_S3 "int = ((phys * 1) / 10) - (0) ms" RAT_FUNC "%4.3" "ms" COEFFS 0 0.1 0 0 0 1 /end COMPU_METHOD
/begin COMPU_METHOD SAB_T_TIMER_1S_S2_S3 "int = ((phys * 1) / 1) - (0) s" RAT_FUNC "%1.0" "s" COEFFS 0 1 0 0 0 1 /end COMPU_METHOD
/begin COMPU_METHOD SAB_T_TIMER_1US_S2_S3 "int = ((phys * 1) / 1) - (0) us" RAT_FUNC "%1.0" "us" COEFFS 0 1 0 0 0 1 /end COMPU_METHOD
/begin COMPU_METHOD SAB_T_TIMER_5MS_S2_S3 "int = ((phys * 1) / 5) - (0) ms" RAT_FUNC "%4.3" "ms" COEFFS 0 0.2 0 0 0 1 /end COMPU_METHOD
/begin COMPU_METHOD SAB_T_TIMER_S10_S2_S3 "int = ((phys * 10) / 1) - (0) s" RAT_FUNC "%4.3" "s" COEFFS 0 10 0 0 0 1 /end COMPU_METHOD
/begin COMPU_METHOD SAB_U_1VOLT1000_S2_S3 "int = ((phys * 1000) / 1) - (0) Volt" RAT_FUNC "%4.3" "Volt" COEFFS 0 1000 0 0 0 1 /end COMPU_METHOD
/begin COMPU_METHOD SAB_U_VOLT1000_S2_S3 "int = ((phys * 1000) / 1) - (0) V" RAT_FUNC "%4.3" "V" COEFFS 0 1000 0 0 0 1 /end COMPU_METHOD
/begin COMPU_METHOD SAB_V_1KMH_S2_S3 "int = ((phys * 1) / 1) - (0) km/h" RAT_FUNC "%1.0" "km/h" COEFFS 0 1 0 0 0 1 /end COMPU_METHOD
/begin COMPU_METHOD SAB_V_KMH10_S2_S3 "int = ((phys * 10) / 1) - (0) km/h" RAT_FUNC "%4.3" "km/h" COEFFS 0 10 0 0 0 1 /end COMPU_METHOD
/begin COMPU_METHOD SAB_V_KMH16_S2_S3 "int = ((phys * 16) / 1) - (0) km/h" RAT_FUNC "%4.3" "km/h" COEFFS 0 16 0 0 0 1 /end COMPU_METHOD
/begin COMPU_METHOD SAB_V_KMH64_S2_S3 "int = ((phys * 64) / 1) - (0) km/h" RAT_FUNC "%4.3" "km/h" COEFFS 0 64 0 0 0 1 /end COMPU_METHOD
/begin COMPU_METHOD SBW_POW_360000_S1_S3 "int = ((phys * 360000) / 1) - (0) mAh" RAT_FUNC "%7.6" "mAh" COEFFS 0 360000 0 0 0 1 /end COMPU_METHOD
/begin COMPU_METHOD SBW_PROZENT_S1_S3 "int = ((phys * 1) / 1) - (0) %" RAT_FUNC "%1.0" "%" COEFFS 0 1 0 0 0 1 /end COMPU_METHOD
/begin COMPU_METHOD SBW_TAUSENDSTEL_S1_S3 "int = ((phys * 1000) / 1) - (0) -" RAT_FUNC "%4.3" "-" COEFFS 0 1000 0 0 0 1 /end COMPU_METHOD
/begin COMPU_METHOD SBW_TIMER_10S_S1_S3 "int = ((phys * 1) / 10) - (0) s" RAT_FUNC "%1.0" "s" COEFFS 0 0.1 0 0 0 1 /end COMPU_METHOD
/begin COMPU_METHOD SBW_TIMER_20MS_S1_S3 "int = ((phys * 1) / 20) - (0) ms" RAT_FUNC "%1.0" "ms" COEFFS 0 0.05 0 0 0 1 /end COMPU_METHOD
/begin COMPU_METHOD SBW_TIMER_STD_S1_S3 "int = ((phys * 1) / 1) - (0) ms" RAT_FUNC "%1.0" "ms" COEFFS 0 1 0 0 0 1 /end COMPU_METHOD
/begin COMPU_METHOD SBW_VKMH_S1_S3 "int = ((phys * 1) / 1) - (0) km/h" RAT_FUNC "%1.0" "km/h" COEFFS 0 1 0 0 0 1 /end COMPU_METHOD
/begin COMPU_METHOD SBW_VWL_20_S1_S3 "int = ((phys * 20) / 1) - (0) Grad/s" RAT_FUNC "%3.2" "Grad/s" COEFFS 0 20 0 0 0 1 /end COMPU_METHOD
/begin COMPU_METHOD SBW_VWL_M_S1_S3 "int = ((phys * 1) / 1) - (0) Grad/s" RAT_FUNC "%1.0" "Grad/s" COEFFS 0 1 0 0 0 1 /end COMPU_METHOD
/begin COMPU_METHOD SBW_WL_M_S1_S3 "int = ((phys * 160) / 7) - (0) Grad" RAT_FUNC "%4.3" "Grad" COEFFS 0 22.8571428571 0 0 0 1 /end COMPU_METHOD
/begin COMPU_METHOD UMR___100_1_0_S5_S3 "int = ((phys * 1) / 100) - (0) [-]" RAT_FUNC "%1.0" "[-]" COEFFS 0 0.01 0 0 0 1 /end COMPU_METHOD
/begin COMPU_METHOD UMR___1_1_M1_S5_S3 "int = ((phys * 1) / 1) - (-1) [-]" RAT_FUNC "%1.0" "[-]" COEFFS 0 1 1 0 0 1 /end COMPU_METHOD
/begin COMPU_METHOD UMR___300_1_0_S5_S3 "int = ((phys * 1) / 300) - (0) [-]" RAT_FUNC "%1.0" "[-]" COEFFS 0 0.00333333333333 0 0 0 1 /end COMPU_METHOD
/begin COMPU_METHOD UMR__SEC_1_10000_0_S5_S3 "int = ((phys * 10000) / 1) - (0) [1/s]" RAT_FUNC "%5.4" "[1/s]" COEFFS 0 10000 0 0 0 1 /end COMPU_METHOD
/begin COMPU_METHOD UMR__SEC_1_100_0_S5_S3 "int = ((phys * 100) / 1) - (0) [1/s]" RAT_FUNC "%3.2" "[1/s]" COEFFS 0 100 0 0 0 1 /end COMPU_METHOD
/begin COMPU_METHOD UMR_BAR__1_10_0_S5_S3 "int = ((phys * 10) / 1) - (0) [bar]" RAT_FUNC "%2.1" "[bar]" COEFFS 0 10 0 0 0 1 /end COMPU_METHOD
/begin COMPU_METHOD UMR_BAR_NM_1_100000_0_S5_S3 "int = ((phys * 100000) / 1) - (0) [bar/Nm]" RAT_FUNC "%6.5" "[bar/Nm]" COEFFS 0 100000 0 0 0 1 /end COMPU_METHOD
/begin COMPU_METHOD UMR_BAR_SEC_10_1_0_S5_S3 "int = ((phys * 1) / 10) - (0) [bar/s]" RAT_FUNC "%1.0" "[bar/s]" COEFFS 0 0.1 0 0 0 1 /end COMPU_METHOD
/begin COMPU_METHOD UMR_GRADC__1_1_M50_S5_S3 "int = ((phys * 1) / 1) - (-50) [°C]" RAT_FUNC "%1.0" "[°C]" COEFFS 0 1 50 0 0 1 /end COMPU_METHOD
/begin COMPU_METHOD UMR_J__1_100000_0_S5_S3 "int = ((phys * 100000) / 1) - (0) [J]" RAT_FUNC "%7.6" "[J]" COEFFS 0 100000 0 0 0 1 /end COMPU_METHOD
/begin COMPU_METHOD UMR_J__1_1000_0_S5_S3 "int = ((phys * 1000) / 1) - (0) [J]" RAT_FUNC "%5.4" "[J]" COEFFS 0 1000 0 0 0 1 /end COMPU_METHOD
/begin COMPU_METHOD UMR_J__1_100_0_S5_S3 "int = ((phys * 100) / 1) - (0) [J]" RAT_FUNC "%4.3" "[J]" COEFFS 0 100 0 0 0 1 /end COMPU_METHOD
/begin COMPU_METHOD UMR_J__1_1_0_3_S5_S3 "int = ((phys * 1) / 1) - (0) [J]" RAT_FUNC "%1.0" "[J]" COEFFS 0 1 0 0 0 1 /end COMPU_METHOD
/begin COMPU_METHOD UMR_J__1_1_0_S5_S3 "int = ((phys * 1) / 1) - (0) [J]" RAT_FUNC "%1.0" "[J]" COEFFS 0 1 0 0 0 1 /end COMPU_METHOD
/begin COMPU_METHOD UMR_J_G_1_1000_0_S5_S3 "int = ((phys * 1000) / 1) - (0) [J/(g)]" RAT_FUNC "%4.3" "[J/(g)]" COEFFS 0 1000 0 0 0 1 /end COMPU_METHOD
/begin COMPU_METHOD UMR_J_G_1_10_0_S5_S3 "int = ((phys * 10) / 1) - (0) [J/(g)]" RAT_FUNC "%2.1" "[J/(g)]" COEFFS 0 10 0 0 0 1 /end COMPU_METHOD
/begin COMPU_METHOD UMR_J_K_1_1000_0_S5_S3 "int = ((phys * 1000) / 1) - (0) [J/(K)]" RAT_FUNC "%4.3" "[J/(K)]" COEFFS 0 1000 0 0 0 1 /end COMPU_METHOD
/begin COMPU_METHOD UMR_J_LITERK_1_1_0_2_S5_S3 "int = ((phys * 1) / 1) - (0) [J/(Liter*K)]" RAT_FUNC "%1.0" "[J/(Liter*K)]" COEFFS 0 1 0 0 0 1 /end COMPU_METHOD
/begin COMPU_METHOD UMR_J_MM2_1_100000_0_S5_S3 "int = ((phys * 100000) / 1) - (0) [J/(mm^2)]" RAT_FUNC "%7.6" "[J/(mm^2)]" COEFFS 0 100000 0 0 0 1 /end COMPU_METHOD
/begin COMPU_METHOD UMR_J_MM2_1_1000_0_S5_S3 "int = ((phys * 1000) / 1) - (0) [J/(mm^2)]" RAT_FUNC "%5.4" "[J/(mm^2)]" COEFFS 0 1000 0 0 0 1 /end COMPU_METHOD
/begin MEASUREMENT ZFFSAB._.RPM_SensingIn.Ab.sv_sts_DirectionSts "Status of direction" UBYTE SAB_STANDARD_S2_S3 1 100 0 255 ECU_ADDRESS 0xFFF8D8AA DISPLAY_IDENTIFIER sv_sts_DirectionSts.Ab.RPM_SensingIn._.ZFFSAB /end MEASUREMENT
/begin MEASUREMENT ZFFSAB._.RPM_SensingIn.Ab.t_n_Offset.time "Description for this variable only in SW documentation possible not in asap2" ULONG SAB_T_TIMER_10MS_S2_S3 1 100 0 42949672950 ECU_ADDRESS 0xFFF8D8AC DISPLAY_IDENTIFIER time.t_n_Offset.Ab.RPM_SensingIn._.ZFFSAB /end MEASUREMENT
/begin MEASUREMENT ZFFSAB._.RPM_SensingIn.Ab.t_n_Offset.time_ "Description for this variable only in SW documentation possible not in asap2" ULONG SAB_T_TIMER_10MS_S2_S3 1 100 0 42949672950 ECU_ADDRESS 0xFFF8D8B0 DISPLAY_IDENTIFIER time_.t_n_Offset.Ab.RPM_SensingIn._.ZFFSAB /end MEASUREMENT
/begin MEASUREMENT ZFFSAB._.RPM_SensingIn.Tu.St_RPMSensing "current state of tooth sensing.St_RESET_OR_RUNUP = 0 St_STANDSTILL = 1 St_ONE_TOOTH_RISING_RPM = 2 St_ONE_TOOTH_FALLING_RPM = 3 St_NORMAL_DRIVE 4" UBYTE SAB_STANDARD_S2_S3 1 100 0 255 ECU_ADDRESS 0xFFF8D8B4 DISPLAY_IDENTIFIER St_RPMSensing.Tu.RPM_SensingIn._.ZFFSAB /end MEASUREMENT
/begin MEASUREMENT ZFFSAB._.RPM_SensingIn.Tu.cnt_total_teeth "Number of the trigger-wheels teeth" UBYTE SAB_STANDARD_S2_S3 1 100 0 255 ECU_ADDRESS 0xFFF8D8B5 DISPLAY_IDENTIFIER cnt_total_teeth.Tu.RPM_SensingIn._.ZFFSAB /end MEASUREMENT
/begin MEASUREMENT ZFFSAB._.RPM_SensingIn.Tu.f_FirstVirtualCalc "Internal flag to detect first virtual calculation" UBYTE SAB_STANDARD_S2_S3 1 100 0 1 ECU_ADDRESS 0xFFF8D8D2 DISPLAY_IDENTIFIER f_FirstVirtualCalc.Tu.RPM_SensingIn._.ZFFSAB /end MEASUREMENT
/begin MEASUREMENT ZFFSAB._.RPM_SensingIn.Tu.f_NeverOnePulse "Internal flag to detect if no pulse was detected during last task and until now" UBYTE SAB_STANDARD_S2_S3 1 100 0 1 ECU_ADDRESS 0xFFF8D8D3 DISPLAY_IDENTIFIER f_NeverOnePulse.Tu.RPM_SensingIn._.ZFFSAB /end MEASUREMENT
/begin MEASUREMENT ZFFSAB._.RPM_SensingIn.Tu.frq_SpeedSensor "Frequency of the speed-sensor" UWORD SAB_FRQ_1HZ_S2_S3 1 100 0 65535 ECU_ADDRESS 0xFFF8D8D8 DISPLAY_IDENTIFIER frq_SpeedSensor.Tu.RPM_SensingIn._.ZFFSAB /end MEASUREMENT
/begin MEASUREMENT ZFFSAB._.RPM_SensingIn.Tu.iv_ESts "Input variable for RPM-sensor electrical status" UBYTE SAB_STANDARD_S2_S3 1 100 0 255 ECU_ADDRESS 0xFFF8D8C9 DISPLAY_IDENTIFIER iv_ESts.Tu.RPM_SensingIn._.ZFFSAB /end MEASUREMENT
/begin MEASUREMENT ZFFSAB._.RPM_SensingIn.Tu.iv_PulseWidth "Input variable for direction detection pulsewidth" UBYTE SAB_T_TIMER_1US_S2_S3 1 100 0 255 ECU_ADDRESS 0xFFF8D8CA DISPLAY_IDENTIFIER iv_PulseWidth.Tu.RPM_SensingIn._.ZFFSAB /end MEASUREMENT
/begin MEASUREMENT ZFFSAB._.RPM_SensingIn.Tu.iv_f_Diag "Input flag shows if a diagnosis is possible or not" UBYTE SAB_STANDARD_S2_S3 1 100 0 1 ECU_ADDRESS 0xFFF8D8C8 DISPLAY_IDENTIFIER iv_f_Diag.Tu.RPM_SensingIn._.ZFFSAB /end MEASUREMENT
/begin MEASUREMENT ZFFSAB._.RPM_SensingIn.Tu.iv_n_Pulses "Input variable for number of pulses detected during iv_t_Pulses" UBYTE SAB_STANDARD_S2_S3 1 100 0 255 ECU_ADDRESS 0xFFF8D8C0 DISPLAY_IDENTIFIER iv_n_Pulses.Tu.RPM_SensingIn._.ZFFSAB /end MEASUREMENT
/begin MEASUREMENT ZFFSAB._.RPM_SensingIn.Tu.iv_t_Pulses "Input variable for exact time needed for counting iv_n_Pulses" ULONG SAB_T_TIMER_1US_S2_S3 1 100 0 4294967295 ECU_ADDRESS 0xFFF8D8BC DISPLAY_IDENTIFIER iv_t_Pulses.Tu.RPM_SensingIn._.ZFFSAB /end MEASUREMENT
/begin MEASUREMENT ZFFSAB._.RPM_SensingIn.Tu.iv_t_Pulses_old "Input variable for last valid iv_t_Pulses needed for virtual RPMs" ULONG SAB_STANDARD_S2_S3 1 100 0 4294967295 ECU_ADDRESS 0xFFF8D8C4 DISPLAY_IDENTIFIER iv_t_Pulses_old.Tu.RPM_SensingIn._.ZFFSAB /end MEASUREMENT
/begin MEASUREMENT ZFFSAB._.RPM_SensingIn.Tu.k_nenner "Part of potential factor e.g. for a fix transmission" UWORD SAB_STANDARD_S2_S3 1 100 0 65535 ECU_ADDRESS 0xFFF8D8B6 DISPLAY_IDENTIFIER k_nenner.Tu.RPM_SensingIn._.ZFFSAB /end MEASUREMENT
/begin MEASUREMENT ZFFSAB._.RPM_SensingIn.Tu.k_zaehler "Part of potential factor e.g. for a fix transmission" UWORD SAB_STANDARD_S2_S3 1 100 0 65535 ECU_ADDRESS 0xFFF8D8B8 DISPLAY_IDENTIFIER k_zaehler.Tu.RPM_SensingIn._.ZFFSAB /end MEASUREMENT
/begin MEASUREMENT ZFFSAB._.RPM_SensingIn.Tu.n_Offset "Fix RPM-offset (not appliable in car)" UBYTE SAB_N_1RPM_S2_S3 1 100 0 255 ECU_ADDRESS 0xFFF8D8D1 DISPLAY_IDENTIFIER n_Offset.Tu.RPM_SensingIn._.ZFFSAB /end MEASUREMENT
/begin MEASUREMENT ZFFSAB._.RPM_SensingIn.Tu.n_RPM "Intermediate RPM (not yet usable for reliable RPM Sensing!)" UWORD SAB_N_1RPM_S2_S3 1 100 0 65535 ECU_ADDRESS 0xFFF8D8CC DISPLAY_IDENTIFIER n_RPM.Tu.RPM_SensingIn._.ZFFSAB /end MEASUREMENT
/begin MEASUREMENT ZFFSAB._.RPM_SensingIn.Tu.n_RPM_Old "Old RPM from last task" UWORD SAB_N_1RPM_S2_S3 1 100 0 65535 ECU_ADDRESS 0xFFF8D8CE DISPLAY_IDENTIFIER n_RPM_Old.Tu.RPM_SensingIn._.ZFFSAB /end MEASUREMENT
/begin MEASUREMENT ZFFSAB._.RPM_SensingIn.Tu.n_RPM_min "Minimum detectable RPM (under this value a zero will be provided)" UWORD SAB_N_1RPM_S2_S3 1 100 0 65535 ECU_ADDRESS 0xFFF8D8BA DISPLAY_IDENTIFIER n_RPM_min.Tu.RPM_SensingIn._.ZFFSAB /end MEASUREMENT
/begin MEASUREMENT ZFFSAB._.RPM_SensingIn.Tu.n_Sts "Electrical status of RPM sensor" UBYTE SAB_STANDARD_S2_S3 1 100 0 255 ECU_ADDRESS 0xFFF8D8D0 DISPLAY_IDENTIFIER n_Sts.Tu.RPM_SensingIn._.ZFFSAB /end MEASUREMENT
/begin MEASUREMENT ZFFSAB._.RPM_SensingIn.Tu.sts_Direction "Intermediate value of direction" UBYTE SAB_STANDARD_S2_S3 1 100 0 255 ECU_ADDRESS 0xFFF8D8D4 DISPLAY_IDENTIFIER sts_Direction.Tu.RPM_SensingIn._.ZFFSAB /end MEASUREMENT
/begin MEASUREMENT ZFFSAB._.RPM_SensingIn.Tu.sts_DirectionDiag "diag-information of the direction-detection" UBYTE SAB_STANDARD_S2_S3 1 100 0 5 ECU_ADDRESS 0xFFF8D8D6 DISPLAY_IDENTIFIER sts_DirectionDiag.Tu.RPM_SensingIn._.ZFFSAB /end MEASUREMENT
/begin MEASUREMENT ZFFSAB._.RPM_SensingIn.Tu.sts_DirectionSts "Intermediate value of direction status" UBYTE SAB_STANDARD_S2_S3 1 100 0 255 ECU_ADDRESS 0xFFF8D8D5 DISPLAY_IDENTIFIER sts_DirectionSts.Tu.RPM_SensingIn._.ZFFSAB /end MEASUREMENT
/begin MEASUREMENT ZFFSAB._.RPM_SensingIn.Tu.sv_n_RPM "Output RPM" UWORD SAB_N_1RPM_S2_S3 1 100 0 65535 ECU_ADDRESS 0xFFF8D8DA DISPLAY_IDENTIFIER sv_n_RPM.Tu.RPM_SensingIn._.ZFFSAB /end MEASUREMENT
/begin MEASUREMENT ZFFSAB._.RPM_SensingIn.Tu.sv_n_Sts "Electrical status of the RPM sensor" UBYTE SAB_STANDARD_S2_S3 1 100 0 255 ECU_ADDRESS 0xFFF8D8DC DISPLAY_IDENTIFIER sv_n_Sts.Tu.RPM_SensingIn._.ZFFSAB /end MEASUREMENT
/begin MEASUREMENT ZFFSAB._.RPM_SensingIn.Tu.sv_sts_Direction "Direction (FORWARD=forward BACKWARD=backward)" UBYTE SAB_STANDARD_S2_S3 1 100 0 255 ECU_ADDRESS 0xFFF8D8DD DISPLAY_IDENTIFIER sv_sts_Direction.Tu.RPM_SensingIn._.ZFFSAB /end MEASUREMENT
/begin MEASUREMENT ZFFSAB._.RPM_SensingIn.Tu.sv_sts_DirectionSts "Status of direction" UBYTE SAB_STANDARD_S2_S3 1 100 0 255 ECU_ADDRESS 0xFFF8D8DE DISPLAY_IDENTIFIER sv_sts_DirectionSts.Tu.RPM_SensingIn._.ZFFSAB /end MEASUREMENT
/begin MEASUREMENT ZFFSAB._.RPM_SensingIn.Tu.t_n_Offset.time "Description for this variable only in SW documentation possible not in asap2" ULONG SAB_T_TIMER_10MS_S2_S3 1 100 0 42949672950 ECU_ADDRESS 0xFFF8D8E0 DISPLAY_IDENTIFIER time.t_n_Offset.Tu.RPM_SensingIn._.ZFFSAB /end MEASUREMENT
/begin MEASUREMENT ZFFSAB._.RPM_SensingIn.Tu.t_n_Offset.time_ "Description for this variable only in SW documentation possible not in asap2" ULONG SAB_T_TIMER_10MS_S2_S3 1 100 0 42949672950 ECU_ADDRESS 0xFFF8D8E4 DISPLAY_IDENTIFIER time_.t_n_Offset.Tu.RPM_SensingIn._.ZFFSAB /end MEASUREMENT
/begin MEASUREMENT ZFFSAB._.RPM_SensingIn.f_first_init "flag to determine if the Init-method has already been called 0 = first call 1 = second or later call" UBYTE SAB_STANDARD_S2_S3 1 100 0 1 ECU_ADDRESS 0xFFF8D87E DISPLAY_IDENTIFIER f_first_init.RPM_SensingIn._.ZFFSAB /end MEASUREMENT
/begin MEASUREMENT ZFFSAB._.RPM_SensingIn.iv_Pos "position" UBYTE SAB_STANDARD_S2_S3 1 100 0 4 ECU_ADDRESS 0xFFF8D87C DISPLAY_IDENTIFIER iv_Pos.RPM_SensingIn._.ZFFSAB /end MEASUREMENT
/begin MEASUREMENT ZFFSAB._.RPM_SensingIn.iv_PosSts "status of POS" UBYTE SAB_STANDARD_S2_S3 1 100 0 1 ECU_ADDRESS 0xFFF8D87D DISPLAY_IDENTIFIER iv_PosSts.RPM_SensingIn._.ZFFSAB /end MEASUREMENT
/begin MEASUREMENT ZFFSAB._.RearAxleRatioIn.f_IgnitionOff2On "Ignition Off to On" UBYTE SAB_STANDARD_S2_S3 1 100 0 1 ECU_ADDRESS 0xFFF95BEC DISPLAY_IDENTIFIER f_IgnitionOff2On.RearAxleRatioIn._.ZFFSAB /end MEASUREMENT
/begin MEASUREMENT ZFFSAB._.RearAxleRatioIn.iv_Pos "position" UBYTE SAB_STANDARD_S2_S3 1 100 0 4 ECU_ADDRESS 0xFFF95C5E DISPLAY_IDENTIFIER iv_Pos.RearAxleRatioIn._.ZFFSAB /end MEASUREMENT
/begin MEASUREMENT ZFFSAB._.RearAxleRatioIn.iv_Pos_ "Complement of Input value for position of Gear Lever" UBYTE SAB_STANDARD_S2_S3 1 100 0 255 ECU_ADDRESS 0xFFF95C5F DISPLAY_IDENTIFIER iv_Pos_.RearAxleRatioIn._.ZFFSAB /end MEASUREMENT
/begin MEASUREMENT ZFFSAB._.RearAxleRatioIn.sv_RearAxleRatio_Value "Calculated value for rear axle ratio" UWORD SAB_K100_S2_S3 1 100 0 10 ECU_ADDRESS 0xFFF95C60 DISPLAY_IDENTIFIER sv_RearAxleRatio_Value.RearAxleRatioIn._.ZFFSAB /end MEASUREMENT
/begin MEASUREMENT ZFFSAB._.RearAxleRatioIn.sv_RearAxleRatio_ValueLearnedFlag "Flag is set if the rear axle ratio is learned finally" UBYTE SAB_STANDARD_S2_S3 1 100 0 255 ECU_ADDRESS 0xFFF95C63 DISPLAY_IDENTIFIER sv_RearAxleRatio_ValueLearnedFlag.RearAxleRatioIn._.ZFFSAB /end MEASUREMENT
/begin MEASUREMENT ZFFSAB._.RearAxleRatioIn.sv_RearAxleRatio_ValueLearnedFlag_ "Flag is set if the rear axle ratio is learned finally" UBYTE SAB_STANDARD_S2_S3 1 100 0 255 ECU_ADDRESS 0xFFF95C64 DISPLAY_IDENTIFIER sv_RearAxleRatio_ValueLearnedFlag_.RearAxleRatioIn._.ZFFSAB /end MEASUREMENT
/begin MEASUREMENT ZFFSAB._.RearAxleRatioIn.sv_RearAxleRatio_ValueNumact "Current number of learn cycles for rear axle ratio" UBYTE SAB_STANDARD_S2_S3 1 100 0 255 ECU_ADDRESS 0xFFF95C62 DISPLAY_IDENTIFIER sv_RearAxleRatio_ValueNumact.RearAxleRatioIn._.ZFFSAB /end MEASUREMENT
/begin MEASUREMENT ZFFSAB._.RearAxleRatioIn.tmr_ForceLearnRearAxleRatio.time "Description for this variable only in SW documentation possible not in asap2" ULONG SAB_T_TIMER_10MS_S2_S3 1 100 0 42949672950 ECU_ADDRESS 0xFFF95BFC DISPLAY_IDENTIFIER time.tmr_ForceLearnRearAxleRatio.RearAxleRatioIn._.ZFFSAB /end MEASUREMENT
/begin MEASUREMENT ZFFSAB._.RearAxleRatioIn.tmr_ForceLearnRearAxleRatio.time_ "Description for this variable only in SW documentation possible not in asap2" ULONG SAB_T_TIMER_10MS_S2_S3 1 100 0 42949672950 ECU_ADDRESS 0xFFF95C00 DISPLAY_IDENTIFIER time_.tmr_ForceLearnRearAxleRatio.RearAxleRatioIn._.ZFFSAB /end MEASUREMENT
/begin MEASUREMENT ZFFSAB._.RearAxleRatioIn.tmr_IG_HA_LearnDif.time "Description for this variable only in SW documentation possible not in asap2" ULONG SAB_T_TIMER_10MS_S2_S3 1 100 0 42949672950 ECU_ADDRESS 0xFFF95BF4 DISPLAY_IDENTIFIER time.tmr_IG_HA_LearnDif.RearAxleRatioIn._.ZFFSAB /end MEASUREMENT
/begin MEASUREMENT ZFFSAB._.RearAxleRatioIn.tmr_IG_HA_LearnDif.time_ "Description for this variable only in SW documentation possible not in asap2" ULONG SAB_T_TIMER_10MS_S2_S3 1 100 0 42949672950 ECU_ADDRESS 0xFFF95BF8 DISPLAY_IDENTIFIER time_.tmr_IG_HA_LearnDif.RearAxleRatioIn._.ZFFSAB /end MEASUREMENT
/begin MEASUREMENT ZFFSAB._.RegPartFilterIn.f_PartfiltAktivErr "Error flag of PartfiltAktiv-signal" UBYTE SAB_STANDARD_S2_S3 1 100 0 1 ECU_ADDRESS 0xFFF96D16 DISPLAY_IDENTIFIER f_PartfiltAktivErr.RegPartFilterIn._.ZFFSAB /end MEASUREMENT
/begin MEASUREMENT ZFFSAB._.RegPartFilterIn.iv_PartfiltAktiv "Input value providing the information if the particlefilter is regenerating" UBYTE SAB_STANDARD_S2_S3 1 100 0 3 ECU_ADDRESS 0xFFF96D12 DISPLAY_IDENTIFIER iv_PartfiltAktiv.RegPartFilterIn._.ZFFSAB /end MEASUREMENT
/begin MEASUREMENT ZFFSAB._.RegPartFilterIn.iv_PartfiltAktivSts "Input value for iv_PartfiltAktiv signal status" UBYTE SAB_STANDARD_S2_S3 1 100 0 255 ECU_ADDRESS 0xFFF96D13 DISPLAY_IDENTIFIER iv_PartfiltAktivSts.RegPartFilterIn._.ZFFSAB /end MEASUREMENT
/begin MEASUREMENT ZFFSAB._.RegPartFilterIn.sv_PartfiltAktiv "Output value of RegPartFilterIn:" UBYTE SAB_STANDARD_S2_S3 1 100 0 2 ECU_ADDRESS 0xFFF96D14 DISPLAY_IDENTIFIER sv_PartfiltAktiv.RegPartFilterIn._.ZFFSAB /end MEASUREMENT
/begin MEASUREMENT ZFFSAB._.RegPartFilterIn.sv_PartfiltAktivSts "Output signal status of RegPartFilterIn:" UBYTE SAB_STANDARD_S2_S3 1 100 0 2 ECU_ADDRESS 0xFFF96D15 DISPLAY_IDENTIFIER sv_PartfiltAktivSts.RegPartFilterIn._.ZFFSAB /end MEASUREMENT
/begin MEASUREMENT ZFFSAB._.RollPreventIn.FzgRollPreventActiveFilt "filtered Input value of signal rollprevent active" UBYTE SAB_STANDARD_S2_S3 1 100 0 255 ECU_ADDRESS 0xFFF95D1F DISPLAY_IDENTIFIER FzgRollPreventActiveFilt.RollPreventIn._.ZFFSAB /end MEASUREMENT
/begin MEASUREMENT ZFFSAB._.RollPreventIn.f_FzgRollPreventActiveErr "Errorflag" UBYTE SAB_STANDARD_S2_S3 1 100 0 1 ECU_ADDRESS 0xFFF95D1D DISPLAY_IDENTIFIER f_FzgRollPreventActiveErr.RollPreventIn._.ZFFSAB /end MEASUREMENT
/begin MEASUREMENT ZFFSAB._.RollPreventIn.f_HillHolderOrAutoHoldactive "Internal flag for HillHolder or AutoHold (0: not active 1: active)" UBYTE SAB_STANDARD_S2_S3 1 100 0 1 ECU_ADDRESS 0xFFF95D1E DISPLAY_IDENTIFIER f_HillHolderOrAutoHoldactive.RollPreventIn._.ZFFSAB /end MEASUREMENT
/begin MEASUREMENT ZFFSAB._.RollPreventIn.iv_Brake "Input value brake information signal from CAN" UBYTE SAB_STANDARD_S2_S3 1 100 0 63 ECU_ADDRESS 0xFFF95D19 DISPLAY_IDENTIFIER iv_Brake.RollPreventIn._.ZFFSAB /end MEASUREMENT
/begin MEASUREMENT ZFFSAB._.RollPreventIn.iv_BrakeSts "Input value message status of brake information from CAN" UBYTE SAB_STANDARD_S2_S3 1 100 0 255 ECU_ADDRESS 0xFFF95D1A DISPLAY_IDENTIFIER iv_BrakeSts.RollPreventIn._.ZFFSAB /end MEASUREMENT
/begin MEASUREMENT ZFFSAB._.RollPreventIn.iv_FzgRollPreventActive "Input value from CAN" UBYTE SAB_STANDARD_S2_S3 1 100 0 255 ECU_ADDRESS 0xFFF95D15 DISPLAY_IDENTIFIER iv_FzgRollPreventActive.RollPreventIn._.ZFFSAB /end MEASUREMENT
/begin MEASUREMENT ZFFSAB._.RollPreventIn.iv_FzgRollPreventActive2 "Input value No 2 from CAN" UBYTE SAB_STANDARD_S2_S3 1 100 0 255 ECU_ADDRESS 0xFFF95D17 DISPLAY_IDENTIFIER iv_FzgRollPreventActive2.RollPreventIn._.ZFFSAB /end MEASUREMENT
/begin MEASUREMENT ZFFSAB._.RollPreventIn.iv_FzgRollPreventActive2Sts "Input value message status of RollPreventIn" UBYTE SAB_STANDARD_S2_S3 1 100 0 255 ECU_ADDRESS 0xFFF95D18 DISPLAY_IDENTIFIER iv_FzgRollPreventActive2Sts.RollPreventIn._.ZFFSAB /end MEASUREMENT
/begin MEASUREMENT ZFFSAB._.RollPreventIn.iv_FzgRollPreventActiveSts "Input value message status of RollPreventIn" UBYTE SAB_STANDARD_S2_S3 1 100 0 255 ECU_ADDRESS 0xFFF95D16 DISPLAY_IDENTIFIER iv_FzgRollPreventActiveSts.RollPreventIn._.ZFFSAB /end MEASUREMENT
/begin MEASUREMENT ZFFSAB._.RollPreventIn.sv_FzgRollPreventActive "Output value" UBYTE SAB_STANDARD_S2_S3 1 100 0 3 ECU_ADDRESS 0xFFF95D1B DISPLAY_IDENTIFIER sv_FzgRollPreventActive.RollPreventIn._.ZFFSAB /end MEASUREMENT
/begin MEASUREMENT ZFFSAB._.RollPreventIn.sv_FzgRollPreventActiveSts "Output value signal status" UBYTE SAB_STANDARD_S2_S3 1 100 0 2 ECU_ADDRESS 0xFFF95D1C DISPLAY_IDENTIFIER sv_FzgRollPreventActiveSts.RollPreventIn._.ZFFSAB /end MEASUREMENT
/begin MEASUREMENT ZFFSAB._.RollPreventIn.tmr_hillholdDelay.time "Description for this variable only in SW documentation possible not in asap2" UBYTE SAB_T_TIMER_10MS_S2_S3 1 100 0 2550 ECU_ADDRESS 0xFFF95D14 DISPLAY_IDENTIFIER time.tmr_hillholdDelay.RollPreventIn._.ZFFSAB /end MEASUREMENT
/begin MEASUREMENT ZFFSAB._.RoutineControlUDS.AbortCustomerReason "abort reason" UBYTE SAB_STANDARD_S2_S3 1 100 0 255 ECU_ADDRESS 0xFFF958F6 DISPLAY_IDENTIFIER AbortCustomerReason.RoutineControlUDS._.ZFFSAB /end MEASUREMENT
/begin MEASUREMENT ZFFSAB._.RoutineControlUDS.f_ReadyToBSS_NOT_RUNNING "flag indicate Preadaption routine ready to go to state BSS_NOT_RUNNING" UBYTE SAB_STANDARD_S2_S3 1 100 0 1 ECU_ADDRESS 0xFFF958F4 DISPLAY_IDENTIFIER f_ReadyToBSS_NOT_RUNNING.RoutineControlUDS._.ZFFSAB /end MEASUREMENT
/begin MEASUREMENT ZFFSAB._.RoutineControlUDS.iv_PreadaptionCondition "Input variable for Preadaption Condition" UBYTE SAB_STANDARD_S2_S3 1 100 0 255 ECU_ADDRESS 0xFFF958F1 DISPLAY_IDENTIFIER iv_PreadaptionCondition.RoutineControlUDS._.ZFFSAB /end MEASUREMENT
/begin MEASUREMENT ZFFSAB._.RoutineControlUDS.iv_PreadaptionState "Input variable for Preadaption State" UBYTE SAB_STANDARD_S2_S3 1 100 0 255 ECU_ADDRESS 0xFFF958F0 DISPLAY_IDENTIFIER iv_PreadaptionState.RoutineControlUDS._.ZFFSAB /end MEASUREMENT
/begin MEASUREMENT ZFFSAB._.RoutineControlUDS.st_IEP_test "state IEP test routine" UBYTE SAB_STANDARD_S2_S3 1 100 0 255 ECU_ADDRESS 0xFFF958F7 DISPLAY_IDENTIFIER st_IEP_test.RoutineControlUDS._.ZFFSAB /end MEASUREMENT
/begin MEASUREMENT ZFFSAB._.RoutineControlUDS.st_basicsettings "state routine Control service" UBYTE SAB_STANDARD_S2_S3 1 100 0 255 ECU_ADDRESS 0xFFF958F8 DISPLAY_IDENTIFIER st_basicsettings.RoutineControlUDS._.ZFFSAB /end MEASUREMENT
/begin MEASUREMENT ZFFSAB._.RoutineControlUDS.st_basicsettings_preadap "state routine Control service preadaption" UBYTE SAB_STANDARD_S2_S3 1 100 0 255 ECU_ADDRESS 0xFFF958F5 DISPLAY_IDENTIFIER st_basicsettings_preadap.RoutineControlUDS._.ZFFSAB /end MEASUREMENT
/begin MEASUREMENT ZFFSAB._.RoutineControlUDS.sv_EPumpCtrlByTester "value for setting the electrical pump 0= no request 1=working point 1 2= working point 2 3= working point 3" UBYTE SAB_STANDARD_S2_S3 1 100 0 3 ECU_ADDRESS 0xFFF958F3 DISPLAY_IDENTIFIER sv_EPumpCtrlByTester.RoutineControlUDS._.ZFFSAB /end MEASUREMENT
/begin MEASUREMENT ZFFSAB._.RoutineControlUDS.sv_PreadaptionRequest "Output signal for pradaption request:" UBYTE SAB_STANDARD_S2_S3 1 100 0 255 ECU_ADDRESS 0xFFF958F2 DISPLAY_IDENTIFIER sv_PreadaptionRequest.RoutineControlUDS._.ZFFSAB /end MEASUREMENT
/begin MEASUREMENT ZFFSAB._.RoutineControlUDS.tmr_IEP_Test.time "Description for this variable only in SW documentation possible not in asap2" UWORD SAB_T_TIMER_10MS_S2_S3 1 100 0 655350 ECU_ADDRESS 0xFFF958EE DISPLAY_IDENTIFIER time.tmr_IEP_Test.RoutineControlUDS._.ZFFSAB /end MEASUREMENT
/begin MEASUREMENT ZFFSAB._.RoutineControlUDS.tmr_PreadaptionSOC0x80.time "Description for this variable only in SW documentation possible not in asap2" UWORD SAB_T_TIMER_10MS_S2_S3 1 100 0 655350 ECU_ADDRESS 0xFFF958EC DISPLAY_IDENTIFIER time.tmr_PreadaptionSOC0x80.RoutineControlUDS._.ZFFSAB /end MEASUREMENT
/begin MEASUREMENT ZFFSAB._.SABEeprom.EepromData.IgnPlausiErr "actual state of plausibility check for KL15 CAN against hardware signal" UBYTE SAB_STANDARD_S2_S3 1 100 0 2 ECU_ADDRESS 0xFFF81F9E DISPLAY_IDENTIFIER IgnPlausiErr.EepromData.SABEeprom._.ZFFSAB /end MEASUREMENT
/begin MEASUREMENT ZFFSAB._.SABEeprom.EepromData.IgnPlausiErr_ "Complement of active OBD variant" UBYTE SAB_STANDARD_S2_S3 1 100 0 255 ECU_ADDRESS 0xFFF81F9F DISPLAY_IDENTIFIER IgnPlausiErr_.EepromData.SABEeprom._.ZFFSAB /end MEASUREMENT
/begin MEASUREMENT ZFFSAB._.SABEeprom.EepromData.Mileage1kmBuf "Mileage eeprom buffer" ULONG SAB_L_1KM_S2_S3 1 100 0 4294967295 ECU_ADDRESS 0xFFF81ED8 DISPLAY_IDENTIFIER Mileage1kmBuf.EepromData.SABEeprom._.ZFFSAB /end MEASUREMENT
/begin MEASUREMENT ZFFSAB._.SABEeprom.EepromData.Mileage1kmBuf_ "Bit complement of mileage eeprom buffer" ULONG SAB_STANDARD_S2_S3 1 100 0 4294967295 ECU_ADDRESS 0xFFF81EDC DISPLAY_IDENTIFIER Mileage1kmBuf_.EepromData.SABEeprom._.ZFFSAB /end MEASUREMENT
/begin MEASUREMENT ZFFSAB._.SABEeprom.EepromData.MileageFromNabBuf "MileageFromNab eeprom buffer" ULONG SAB_L_1KM_S2_S3 1 100 0 65535 ECU_ADDRESS 0xFFF81EE0 DISPLAY_IDENTIFIER MileageFromNabBuf.EepromData.SABEeprom._.ZFFSAB /end MEASUREMENT
/begin MEASUREMENT ZFFSAB._.SABEeprom.EepromData.MileageFromNabBuf_ "Bit complement of MileageFromNab" ULONG SAB_STANDARD_S2_S3 1 100 0 65535 ECU_ADDRESS 0xFFF81EE4 DISPLAY_IDENTIFIER MileageFromNabBuf_.EepromData.SABEeprom._.ZFFSAB /end MEASUREMENT
/begin MEASUREMENT ZFFSAB._.SABEeprom.EepromData.RearAxleRatioBuf "RearAxleRatio eeprom buffer" UWORD SAB_STANDARD_S2_S3 1 100 0 65535 ECU_ADDRESS 0xFFF81EEC DISPLAY_IDENTIFIER RearAxleRatioBuf.EepromData.SABEeprom._.ZFFSAB /end MEASUREMENT
/begin MEASUREMENT ZFFSAB._.SABEeprom.EepromData.RearAxleRatioBuf_ "Bit complement of RearAxleRatio eeprom buffer" UWORD SAB_STANDARD_S2_S3 1 100 0 65535 ECU_ADDRESS 0xFFF81EEE DISPLAY_IDENTIFIER RearAxleRatioBuf_.EepromData.SABEeprom._.ZFFSAB /end MEASUREMENT
/begin MEASUREMENT ZFFSAB._.SABEeprom.EepromData.RearAxleRatio_ValueNumact_ "Number of already performed learning cycles" UBYTE SAB_STANDARD_S2_S3 1 100 0 255 ECU_ADDRESS 0xFFF81F71 DISPLAY_IDENTIFIER RearAxleRatio_ValueNumact_.EepromData.SABEeprom._.ZFFSAB /end MEASUREMENT
/begin MEASUREMENT ZFFSAB._.SABEeprom.EepromData.RearAxleRatio_Value_ "Calculated value for rear axle ratio" UWORD SAB_STANDARD_S2_S3 1 100 0 65535 ECU_ADDRESS 0xFFF81F6E DISPLAY_IDENTIFIER RearAxleRatio_Value_.EepromData.SABEeprom._.ZFFSAB /end MEASUREMENT
/begin MEASUREMENT ZFFSAB._.SABEeprom.EepromData.cnt_ForcedShiftups "Byte counter for forced shiftups by the DME" UBYTE SAB_STANDARD_S2_S3 1 100 0 255 ECU_ADDRESS 0xFFF81F84 DISPLAY_IDENTIFIER cnt_ForcedShiftups.EepromData.SABEeprom._.ZFFSAB /end MEASUREMENT
/begin MEASUREMENT ZFFSAB._.SABEeprom.EepromData.cnt_ForcedShiftups_ "Complemented byte counter for forced shiftups by the DME" UBYTE SAB_STANDARD_S2_S3 1 100 0 255 ECU_ADDRESS 0xFFF81F85 DISPLAY_IDENTIFIER cnt_ForcedShiftups_.EepromData.SABEeprom._.ZFFSAB /end MEASUREMENT
/begin MEASUREMENT ZFFSAB._.SABEeprom.EepromData.cnt_RstFailSumBuf "Sum of failed RzN resets over the whole car life" UWORD SAB_STANDARD_S2_S3 1 100 0 65535 ECU_ADDRESS 0xFFF81FA4 DISPLAY_IDENTIFIER cnt_RstFailSumBuf.EepromData.SABEeprom._.ZFFSAB /end MEASUREMENT
/begin MEASUREMENT ZFFSAB._.SABEeprom.EepromData.cnt_RstFailSumBuf_ "Complement of sum of failed RzN resets over the whole car life" UWORD SAB_STANDARD_S2_S3 1 100 0 65535 ECU_ADDRESS 0xFFF81FA6 DISPLAY_IDENTIFIER cnt_RstFailSumBuf_.EepromData.SABEeprom._.ZFFSAB /end MEASUREMENT
/begin MEASUREMENT ZFFSAB._.SABEeprom.EepromData.cnt_RstSuccessSumBuf "Sum of successful RzN resets over the whole car life" UWORD SAB_STANDARD_S2_S3 1 100 0 65535 ECU_ADDRESS 0xFFF81FA0 DISPLAY_IDENTIFIER cnt_RstSuccessSumBuf.EepromData.SABEeprom._.ZFFSAB /end MEASUREMENT
/begin MEASUREMENT ZFFSAB._.SABEeprom.EepromData.cnt_RstSuccessSumBuf_ "Complement of sum of successful RzN resets over the whole car life" UWORD SAB_STANDARD_S2_S3 1 100 0 65535 ECU_ADDRESS 0xFFF81FA2 DISPLAY_IDENTIFIER cnt_RstSuccessSumBuf_.EepromData.SABEeprom._.ZFFSAB /end MEASUREMENT
/begin MEASUREMENT ZFFSAB._.SABEeprom.EepromData.cnt_info_memory_entries "Counter for internal information memory entries" UWORD SAB_STANDARD_S2_S3 1 100 0 255 ECU_ADDRESS 0xFFF81FB8 DISPLAY_IDENTIFIER cnt_info_memory_entries.EepromData.SABEeprom._.ZFFSAB /end MEASUREMENT
/begin MEASUREMENT ZFFSAB._.SABEeprom.EepromData.f_AnalogPaddleLearned "Flag analog paddle learned" UBYTE SAB_STANDARD_S2_S3 1 100 0 255 ECU_ADDRESS 0xFFF81EE8 DISPLAY_IDENTIFIER f_AnalogPaddleLearned.EepromData.SABEeprom._.ZFFSAB /end MEASUREMENT
/begin MEASUREMENT ZFFSAB._.SABEeprom.EepromData.f_AnalogPaddleLearned_ "Flag analog paddle learned" UBYTE SAB_STANDARD_S2_S3 1 100 0 255 ECU_ADDRESS 0xFFF81EE9 DISPLAY_IDENTIFIER f_AnalogPaddleLearned_.EepromData.SABEeprom._.ZFFSAB /end MEASUREMENT
/begin MEASUREMENT ZFFSAB._.SABEeprom.EepromData.f_CANPaddleLearned "Flag can paddle learned" UBYTE SAB_STANDARD_S2_S3 1 100 0 255 ECU_ADDRESS 0xFFF81EEA DISPLAY_IDENTIFIER f_CANPaddleLearned.EepromData.SABEeprom._.ZFFSAB /end MEASUREMENT
/begin MEASUREMENT ZFFSAB._.SABEeprom.EepromData.f_CANPaddleLearned_ "Flag can paddle learned" UBYTE SAB_STANDARD_S2_S3 1 100 0 255 ECU_ADDRESS 0xFFF81EEB DISPLAY_IDENTIFIER f_CANPaddleLearned_.EepromData.SABEeprom._.ZFFSAB /end MEASUREMENT
/begin MEASUREMENT ZFFSAB._.SABEeprom.EepromData.f_PMAModeLearned "Learned flag of PMA mode" UBYTE SAB_STANDARD_S2_S3 1 100 0 255 ECU_ADDRESS 0xFFF81F9C DISPLAY_IDENTIFIER f_PMAModeLearned.EepromData.SABEeprom._.ZFFSAB /end MEASUREMENT
/begin MEASUREMENT ZFFSAB._.SABEeprom.EepromData.f_PMAModeLearned_ "Complement of learned flag of PMA mode" UBYTE SAB_STANDARD_S2_S3 1 100 0 255 ECU_ADDRESS 0xFFF81F9D DISPLAY_IDENTIFIER f_PMAModeLearned_.EepromData.SABEeprom._.ZFFSAB /end MEASUREMENT
/begin MEASUREMENT ZFFSAB._.SABEeprom.EepromData.f_c_CgtPlausiErr "Error flag of Sensor CGT" UBYTE SAB_STANDARD_S2_S3 1 100 0 255 ECU_ADDRESS 0xFFF81F90 DISPLAY_IDENTIFIER f_c_CgtPlausiErr.EepromData.SABEeprom._.ZFFSAB /end MEASUREMENT
/begin MEASUREMENT ZFFSAB._.SABEeprom.EepromData.f_c_CgtPlausiErr_ "complement of corresponding variable" UBYTE SAB_STANDARD_S2_S3 1 100 0 255 ECU_ADDRESS 0xFFF81F91 DISPLAY_IDENTIFIER f_c_CgtPlausiErr_.EepromData.SABEeprom._.ZFFSAB /end MEASUREMENT
/begin MEASUREMENT ZFFSAB._.SABEeprom.EepromData.f_c_Chip1CGT "error flag of Sensor plausibility check between Chip1 and CGT temperature" UBYTE SAB_STANDARD_S2_S3 1 100 0 255 ECU_ADDRESS 0xFFF81F86 DISPLAY_IDENTIFIER f_c_Chip1CGT.EepromData.SABEeprom._.ZFFSAB /end MEASUREMENT
/begin MEASUREMENT ZFFSAB._.SABEeprom.EepromData.f_c_Chip1CGT_ "complement of corresponding variable" UBYTE SAB_STANDARD_S2_S3 1 100 0 255 ECU_ADDRESS 0xFFF81F87 DISPLAY_IDENTIFIER f_c_Chip1CGT_.EepromData.SABEeprom._.ZFFSAB /end MEASUREMENT
/begin MEASUREMENT ZFFSAB._.SABEeprom.EepromData.f_c_Chip1Chip2 "error flag of Sensor plausibility check between Chip1 and Chip2 temperature" UBYTE SAB_STANDARD_S2_S3 1 100 0 255 ECU_ADDRESS 0xFFF81F8A DISPLAY_IDENTIFIER f_c_Chip1Chip2.EepromData.SABEeprom._.ZFFSAB /end MEASUREMENT
/begin MEASUREMENT ZFFSAB._.SABEeprom.EepromData.f_c_Chip1Chip2_ "complement of corresponding variable" UBYTE SAB_STANDARD_S2_S3 1 100 0 255 ECU_ADDRESS 0xFFF81F8B DISPLAY_IDENTIFIER f_c_Chip1Chip2_.EepromData.SABEeprom._.ZFFSAB /end MEASUREMENT
/begin MEASUREMENT ZFFSAB._.SABEeprom.EepromData.f_c_Chip1PlausiErr "Error flag of Sensor Chip1" UBYTE SAB_STANDARD_S2_S3 1 100 0 255 ECU_ADDRESS 0xFFF81F8C DISPLAY_IDENTIFIER f_c_Chip1PlausiErr.EepromData.SABEeprom._.ZFFSAB /end MEASUREMENT
/begin MEASUREMENT ZFFSAB._.SABEeprom.EepromData.f_c_Chip1PlausiErr_ "complement of corresponding variable" UBYTE SAB_STANDARD_S2_S3 1 100 0 255 ECU_ADDRESS 0xFFF81F8D DISPLAY_IDENTIFIER f_c_Chip1PlausiErr_.EepromData.SABEeprom._.ZFFSAB /end MEASUREMENT
/begin MEASUREMENT ZFFSAB._.SABEeprom.EepromData.f_c_Chip2CGT "error flag of Sensor plausibility check between Chip2 and CGT temperature" UBYTE SAB_STANDARD_S2_S3 1 100 0 255 ECU_ADDRESS 0xFFF81F88 DISPLAY_IDENTIFIER f_c_Chip2CGT.EepromData.SABEeprom._.ZFFSAB /end MEASUREMENT
/begin MEASUREMENT ZFFSAB._.SABEeprom.EepromData.f_c_Chip2CGT_ "complement of corresponding variable" UBYTE SAB_STANDARD_S2_S3 1 100 0 255 ECU_ADDRESS 0xFFF81F89 DISPLAY_IDENTIFIER f_c_Chip2CGT_.EepromData.SABEeprom._.ZFFSAB /end MEASUREMENT
/begin MEASUREMENT ZFFSAB._.SABEeprom.EepromData.f_c_Chip2PlausiErr "Error flag of Sensor Chip2" UBYTE SAB_STANDARD_S2_S3 1 100 0 255 ECU_ADDRESS 0xFFF81F8E DISPLAY_IDENTIFIER f_c_Chip2PlausiErr.EepromData.SABEeprom._.ZFFSAB /end MEASUREMENT
/begin MEASUREMENT ZFFSAB._.SABEeprom.EepromData.f_c_Chip2PlausiErr_ "complement of corresponding variable" UBYTE SAB_STANDARD_S2_S3 1 100 0 255 ECU_ADDRESS 0xFFF81F8F DISPLAY_IDENTIFIER f_c_Chip2PlausiErr_.EepromData.SABEeprom._.ZFFSAB /end MEASUREMENT
/begin MEASUREMENT ZFFSAB._.SABEeprom.EepromData.f_c_PlausiErr "Error flag double Sensor Error" UBYTE SAB_STANDARD_S2_S3 1 100 0 255 ECU_ADDRESS 0xFFF81F92 DISPLAY_IDENTIFIER f_c_PlausiErr.EepromData.SABEeprom._.ZFFSAB /end MEASUREMENT
/begin MEASUREMENT ZFFSAB._.SABEeprom.EepromData.f_c_PlausiErr_ "complement of corresponding variable" UBYTE SAB_STANDARD_S2_S3 1 100 0 255 ECU_ADDRESS 0xFFF81F93 DISPLAY_IDENTIFIER f_c_PlausiErr_.EepromData.SABEeprom._.ZFFSAB /end MEASUREMENT
/begin MEASUREMENT ZFFSAB._.SABEeprom.EepromData.f_n_xErrFlags "Bitfield with rpm error flags" UBYTE SAB_STANDARD_S2_S3 1 100 0 255 ECU_ADDRESS 0xFFF81ED4 DISPLAY_IDENTIFIER f_n_xErrFlags.EepromData.SABEeprom._.ZFFSAB /end MEASUREMENT
/begin MEASUREMENT ZFFSAB._.SABEeprom.EepromData.f_n_xErrFlags_ "bit complement f_n_xErrFlags" UBYTE SAB_STANDARD_S2_S3 1 100 0 255 ECU_ADDRESS 0xFFF81ED5 DISPLAY_IDENTIFIER f_n_xErrFlags_.EepromData.SABEeprom._.ZFFSAB /end MEASUREMENT
/begin MEASUREMENT ZFFSAB._.SABEeprom.EepromData.info_memory[0].errorID "Error code - specified in calling module" UBYTE SAB_STANDARD_S2_S3 1 100 0 255 ECU_ADDRESS 0xFFF81FA9 DISPLAY_IDENTIFIER errorID.info_memory[0].EepromData.SABEeprom._.ZFFSAB /end MEASUREMENT
/begin MEASUREMENT ZFFSAB._.SABEeprom.EepromData.info_memory[0].moduleID "ID of the calling module" UBYTE SAB_STANDARD_S2_S3 1 100 0 255 ECU_ADDRESS 0xFFF81FA8 DISPLAY_IDENTIFIER moduleID.info_memory[0].EepromData.SABEeprom._.ZFFSAB /end MEASUREMENT
/begin MEASUREMENT ZFFSAB._.SABEeprom.EepromData.info_memory[1].errorID "Error code - specified in calling module" UBYTE SAB_STANDARD_S2_S3 1 100 0 255 ECU_ADDRESS 0xFFF81FAB DISPLAY_IDENTIFIER errorID.info_memory[1].EepromData.SABEeprom._.ZFFSAB /end MEASUREMENT
/begin MEASUREMENT ZFFSAB._.SABEeprom.EepromData.info_memory[1].moduleID "ID of the calling module" UBYTE SAB_STANDARD_S2_S3 1 100 0 255 ECU_ADDRESS 0xFFF81FAA DISPLAY_IDENTIFIER moduleID.info_memory[1].EepromData.SABEeprom._.ZFFSAB /end MEASUREMENT
/begin MEASUREMENT ZFFSAB._.SABEeprom.EepromData.info_memory[2].errorID "Error code - specified in calling module" UBYTE SAB_STANDARD_S2_S3 1 100 0 255 ECU_ADDRESS 0xFFF81FAD DISPLAY_IDENTIFIER errorID.info_memory[2].EepromData.SABEeprom._.ZFFSAB /end MEASUREMENT
/begin MEASUREMENT ZFFSAB._.SABEeprom.EepromData.info_memory[2].moduleID "ID of the calling module" UBYTE SAB_STANDARD_S2_S3 1 100 0 255 ECU_ADDRESS 0xFFF81FAC DISPLAY_IDENTIFIER moduleID.info_memory[2].EepromData.SABEeprom._.ZFFSAB /end MEASUREMENT
/begin MEASUREMENT ZFFSAB._.SABEeprom.EepromData.info_memory[3].errorID "Error code - specified in calling module" UBYTE SAB_STANDARD_S2_S3 1 100 0 255 ECU_ADDRESS 0xFFF81FAF DISPLAY_IDENTIFIER errorID.info_memory[3].EepromData.SABEeprom._.ZFFSAB /end MEASUREMENT
/begin MEASUREMENT ZFFSAB._.SABEeprom.EepromData.info_memory[3].moduleID "ID of the calling module" UBYTE SAB_STANDARD_S2_S3 1 100 0 255 ECU_ADDRESS 0xFFF81FAE DISPLAY_IDENTIFIER moduleID.info_memory[3].EepromData.SABEeprom._.ZFFSAB /end MEASUREMENT
/begin MEASUREMENT ZFFSAB._.SABEeprom.EepromData.info_memory[4].errorID "Error code - specified in calling module" UBYTE SAB_STANDARD_S2_S3 1 100 0 255 ECU_ADDRESS 0xFFF81FB1 DISPLAY_IDENTIFIER errorID.info_memory[4].EepromData.SABEeprom._.ZFFSAB /end MEASUREMENT
/begin MEASUREMENT ZFFSAB._.SABEeprom.EepromData.info_memory[4].moduleID "ID of the calling module" UBYTE SAB_STANDARD_S2_S3 1 100 0 255 ECU_ADDRESS 0xFFF81FB0 DISPLAY_IDENTIFIER moduleID.info_memory[4].EepromData.SABEeprom._.ZFFSAB /end MEASUREMENT
/begin MEASUREMENT ZFFSAB._.SABEeprom.EepromData.info_memory[5].errorID "Error code - specified in calling module" UBYTE SAB_STANDARD_S2_S3 1 100 0 255 ECU_ADDRESS 0xFFF81FB3 DISPLAY_IDENTIFIER errorID.info_memory[5].EepromData.SABEeprom._.ZFFSAB /end MEASUREMENT
/begin MEASUREMENT ZFFSAB._.SABEeprom.EepromData.info_memory[5].moduleID "ID of the calling module" UBYTE SAB_STANDARD_S2_S3 1 100 0 255 ECU_ADDRESS 0xFFF81FB2 DISPLAY_IDENTIFIER moduleID.info_memory[5].EepromData.SABEeprom._.ZFFSAB /end MEASUREMENT
/begin MEASUREMENT ZFFSAB._.SABEeprom.EepromData.info_memory[6].errorID "Error code - specified in calling module" UBYTE SAB_STANDARD_S2_S3 1 100 0 255 ECU_ADDRESS 0xFFF81FB5 DISPLAY_IDENTIFIER errorID.info_memory[6].EepromData.SABEeprom._.ZFFSAB /end MEASUREMENT
/begin MEASUREMENT ZFFSAB._.SABEeprom.EepromData.info_memory[6].moduleID "ID of the calling module" UBYTE SAB_STANDARD_S2_S3 1 100 0 255 ECU_ADDRESS 0xFFF81FB4 DISPLAY_IDENTIFIER moduleID.info_memory[6].EepromData.SABEeprom._.ZFFSAB /end MEASUREMENT
/begin MEASUREMENT ZFFSAB._.SABEeprom.EepromData.info_memory[7].errorID "Error code - specified in calling module" UBYTE SAB_STANDARD_S2_S3 1 100 0 255 ECU_ADDRESS 0xFFF81FB7 DISPLAY_IDENTIFIER errorID.info_memory[7].EepromData.SABEeprom._.ZFFSAB /end MEASUREMENT
/begin MEASUREMENT ZFFSAB._.SABEeprom.EepromData.info_memory[7].moduleID "ID of the calling module" UBYTE SAB_STANDARD_S2_S3 1 100 0 255 ECU_ADDRESS 0xFFF81FB6 DISPLAY_IDENTIFIER moduleID.info_memory[7].EepromData.SABEeprom._.ZFFSAB /end MEASUREMENT
/begin MEASUREMENT ZFFSAB._.SABEeprom.EepromData.info_memory_checksum "Checksum for internal information memory" UWORD SAB_STANDARD_S2_S3 1 100 0 65535 ECU_ADDRESS 0xFFF81FBA DISPLAY_IDENTIFIER info_memory_checksum.EepromData.SABEeprom._.ZFFSAB /end MEASUREMENT
/begin MEASUREMENT ZFFSAB._.SABEeprom.EepromData.st_ReceiveBitmaskCANMsg1 "Bit mask for receiving CAN messages [bit x = 1 -> CAN message received]" ULONG SAB_STANDARD_S2_S3 1 100 0 4294967295 ECU_ADDRESS 0xFFF81F7C DISPLAY_IDENTIFIER st_ReceiveBitmaskCANMsg1.EepromData.SABEeprom._.ZFFSAB /end MEASUREMENT
/begin MEASUREMENT ZFFSAB._.SABEeprom.EepromData.st_ReceiveBitmaskCANMsg1_ "Bit-complement of bit mask for receiving CAN messages" ULONG SAB_STANDARD_S2_S3 1 100 0 4294967295 ECU_ADDRESS 0xFFF81F80 DISPLAY_IDENTIFIER st_ReceiveBitmaskCANMsg1_.EepromData.SABEeprom._.ZFFSAB /end MEASUREMENT
/begin MEASUREMENT ZFFSAB._.SABEeprom.EepromData.st_ReceiveBitmaskCANMsg2 "Bit mask for receiving CAN messages [bit x = 1 -> CAN message received]" ULONG SAB_STANDARD_S2_S3 1 100 0 4294967295 ECU_ADDRESS 0xFFF81F74 DISPLAY_IDENTIFIER st_ReceiveBitmaskCANMsg2.EepromData.SABEeprom._.ZFFSAB /end MEASUREMENT
/begin MEASUREMENT ZFFSAB._.SABEeprom.EepromData.st_ReceiveBitmaskCANMsg2_ "Bit-complement of bit mask for receiving CAN messages" ULONG SAB_STANDARD_S2_S3 1 100 0 4294967295 ECU_ADDRESS 0xFFF81F78 DISPLAY_IDENTIFIER st_ReceiveBitmaskCANMsg2_.EepromData.SABEeprom._.ZFFSAB /end MEASUREMENT
/begin MEASUREMENT ZFFSAB._.SABEeprom.EepromData.sv_RearAxleRatio_Value "Calculated value for rear axle ratio" UWORD SAB_STANDARD_S2_S3 1 100 0 65535 ECU_ADDRESS 0xFFF81F6C DISPLAY_IDENTIFIER sv_RearAxleRatio_Value.EepromData.SABEeprom._.ZFFSAB /end MEASUREMENT
/begin MEASUREMENT ZFFSAB._.SABEeprom.EepromData.sv_RearAxleRatio_ValueLearnedFlag "If this flag is set to 1 all required learning cycles have been performed" UBYTE SAB_STANDARD_S2_S3 1 100 0 255 ECU_ADDRESS 0xFFF81F72 DISPLAY_IDENTIFIER sv_RearAxleRatio_ValueLearnedFlag.EepromData.SABEeprom._.ZFFSAB /end MEASUREMENT
/begin MEASUREMENT ZFFSAB._.SABEeprom.EepromData.sv_RearAxleRatio_ValueLearnedFlag_ "If this flag is set to 254 all required learning cycles have been performed" UBYTE SAB_STANDARD_S2_S3 1 100 0 255 ECU_ADDRESS 0xFFF81F73 DISPLAY_IDENTIFIER sv_RearAxleRatio_ValueLearnedFlag_.EepromData.SABEeprom._.ZFFSAB /end MEASUREMENT
/begin MEASUREMENT ZFFSAB._.SABEeprom.EepromData.sv_RearAxleRatio_ValueNumact "Number of already performed learning cycles" UBYTE SAB_STANDARD_S2_S3 1 100 0 255 ECU_ADDRESS 0xFFF81F70 DISPLAY_IDENTIFIER sv_RearAxleRatio_ValueNumact.EepromData.SABEeprom._.ZFFSAB /end MEASUREMENT
/begin MEASUREMENT ZFFSAB._.SABEeprom.EepromData.t_SystimeCurBuf "Last valid system time" ULONG SAB_STANDARD_S2_S3 1 100 0 4294967295 ECU_ADDRESS 0xFFF81F94 DISPLAY_IDENTIFIER t_SystimeCurBuf.EepromData.SABEeprom._.ZFFSAB /end MEASUREMENT
/begin MEASUREMENT ZFFSAB._.SABEeprom.EepromData.t_SystimeCurBuf_ "Complement of last valid system time" ULONG SAB_STANDARD_S2_S3 1 100 0 4294967295 ECU_ADDRESS 0xFFF81F98 DISPLAY_IDENTIFIER t_SystimeCurBuf_.EepromData.SABEeprom._.ZFFSAB /end MEASUREMENT
/begin MEASUREMENT ZFFSAB._.SABEepromBPRAM.f_ForceEEPROM_Update "Force EEPROM Update if set" UBYTE SAB_STANDARD_S2_S3 1 100 0 255 ECU_ADDRESS 0xFFF835CC DISPLAY_IDENTIFIER f_ForceEEPROM_Update.SABEepromBPRAM._.ZFFSAB /end MEASUREMENT
/begin MEASUREMENT ZFFSAB._.SABEepromBPRAM.f_ForceEEPROM_Update_ "Complement of Force EEPROM Update" UBYTE SAB_STANDARD_S2_S3 1 100 0 255 ECU_ADDRESS 0xFFF835CD DISPLAY_IDENTIFIER f_ForceEEPROM_Update_.SABEepromBPRAM._.ZFFSAB /end MEASUREMENT
/begin MEASUREMENT ZFFSAB._.SensorSupplyMonitoring.iv_u_Sens1ESts "Input voltage sensor1 electrical status" UBYTE SAB_STANDARD_S2_S3 1 100 0 255 ECU_ADDRESS 0xFFF8DD1C DISPLAY_IDENTIFIER iv_u_Sens1ESts.SensorSupplyMonitoring._.ZFFSAB /end MEASUREMENT
/begin MEASUREMENT ZFFSAB._.SensorSupplyMonitoring.iv_u_Sens1ESts_ "Complementary input voltage sensor1 electrical status" UBYTE SAB_STANDARD_S2_S3 1 100 0 255 ECU_ADDRESS 0xFFF8DD1D DISPLAY_IDENTIFIER iv_u_Sens1ESts_.SensorSupplyMonitoring._.ZFFSAB /end MEASUREMENT
/begin MEASUREMENT ZFFSAB._.SensorSupplyMonitoring.tmr_t_delay_USENS.time "Description for this variable only in SW documentation possible not in asap2" ULONG SAB_T_TIMER_10MS_S2_S3 1 100 0 42949672950 ECU_ADDRESS 0xFFF8DD14 DISPLAY_IDENTIFIER time.tmr_t_delay_USENS.SensorSupplyMonitoring._.ZFFSAB /end MEASUREMENT
/begin MEASUREMENT ZFFSAB._.SensorSupplyMonitoring.tmr_t_delay_USENS.time_ "Description for this variable only in SW documentation possible not in asap2" ULONG SAB_T_TIMER_10MS_S2_S3 1 100 0 42949672950 ECU_ADDRESS 0xFFF8DD18 DISPLAY_IDENTIFIER time_.tmr_t_delay_USENS.SensorSupplyMonitoring._.ZFFSAB /end MEASUREMENT
/begin MEASUREMENT ZFFSAB._.ShiftlockRequestExternalIn.f_PNErr "Error flag of shiftlock request" UBYTE SAB_STANDARD_S2_S3 1 100 0 1 ECU_ADDRESS 0xFFF96D1B DISPLAY_IDENTIFIER f_PNErr.ShiftlockRequestExternalIn._.ZFFSAB /end MEASUREMENT
/begin MEASUREMENT ZFFSAB._.ShiftlockRequestExternalIn.iv_PN "Input value shiftlock request from CAN" UBYTE SAB_STANDARD_S2_S3 1 100 0 3 ECU_ADDRESS 0xFFF96D17 DISPLAY_IDENTIFIER iv_PN.ShiftlockRequestExternalIn._.ZFFSAB /end MEASUREMENT
/begin MEASUREMENT ZFFSAB._.ShiftlockRequestExternalIn.iv_PNSts "Input value message status of shiftlock request" UBYTE SAB_STANDARD_S2_S3 1 100 0 255 ECU_ADDRESS 0xFFF96D18 DISPLAY_IDENTIFIER iv_PNSts.ShiftlockRequestExternalIn._.ZFFSAB /end MEASUREMENT
/begin MEASUREMENT ZFFSAB._.ShiftlockRequestExternalIn.sv_PNSts "Output value signal status of shiftlock request" UBYTE SAB_STANDARD_S2_S3 1 100 0 2 ECU_ADDRESS 0xFFF96D1A DISPLAY_IDENTIFIER sv_PNSts.ShiftlockRequestExternalIn._.ZFFSAB /end MEASUREMENT
/begin MEASUREMENT ZFFSAB._.ShiftlockRequestExternalIn.sv_f_PN "Output value of shiftlock request" UBYTE SAB_STANDARD_S2_S3 1 100 0 1 ECU_ADDRESS 0xFFF96D19 DISPLAY_IDENTIFIER sv_f_PN.ShiftlockRequestExternalIn._.ZFFSAB /end MEASUREMENT
/begin MEASUREMENT ZFFSAB._.SpeedPlausibilityIn.f_n_AbGra_VUNPLAUSILEV2 "forbidden negative gradient" UBYTE SAB_STANDARD_S2_S3 1 100 0 1 ECU_ADDRESS 0xFFF8DC77 DISPLAY_IDENTIFIER f_n_AbGra_VUNPLAUSILEV2.SpeedPlausibilityIn._.ZFFSAB /end MEASUREMENT
/begin MEASUREMENT ZFFSAB._.SpeedPlausibilityIn.sv_n_AbOld "output value signal of vehicle speed of the cycle before" UWORD SAB_N_1RPM_S2_S3 1 100 0 65535 ECU_ADDRESS 0xFFF8DC74 DISPLAY_IDENTIFIER sv_n_AbOld.SpeedPlausibilityIn._.ZFFSAB /end MEASUREMENT
/begin MEASUREMENT ZFFSAB._.SpeedPlausibilityIn.sv_n_Ab_plausibel "Last valid output value signal of vehicle speed" UWORD SAB_N_1RPM_S2_S3 1 100 0 65535 ECU_ADDRESS 0xFFF8DC72 DISPLAY_IDENTIFIER sv_n_Ab_plausibel.SpeedPlausibilityIn._.ZFFSAB /end MEASUREMENT
/begin MEASUREMENT ZFFSAB._.SpeedPlausibilityIn.sv_v_unplausi "flag to determine whether the vehicle speed is unplausi" UBYTE SAB_STANDARD_S2_S3 1 100 0 1 ECU_ADDRESS 0xFFF8DC70 DISPLAY_IDENTIFIER sv_v_unplausi.SpeedPlausibilityIn._.ZFFSAB /end MEASUREMENT
/begin MEASUREMENT ZFFSAB._.SpeedPlausibilityIn.sv_v_unplausi_ "flag to determine whether the vehicle speed is unplausi" UBYTE SAB_STANDARD_S2_S3 1 100 0 255 ECU_ADDRESS 0xFFF8DC71 DISPLAY_IDENTIFIER sv_v_unplausi_.SpeedPlausibilityIn._.ZFFSAB /end MEASUREMENT
/begin MEASUREMENT ZFFSAB._.SpeedPlausibilityIn.tmr_DelayBrake_VUNPLAUSILEV2.time "Description for this variable only in SW documentation possible not in asap2" ULONG SAB_T_TIMER_10MS_S2_S3 1 100 0 42949672950 ECU_ADDRESS 0xFFF8DC58 DISPLAY_IDENTIFIER time.tmr_DelayBrake_VUNPLAUSILEV2.SpeedPlausibilityIn._.ZFFSAB /end MEASUREMENT
/begin MEASUREMENT ZFFSAB._.SpeedPlausibilityIn.tmr_DelayBrake_VUNPLAUSILEV2.time_ "Description for this variable only in SW documentation possible not in asap2" ULONG SAB_T_TIMER_10MS_S2_S3 1 100 0 42949672950 ECU_ADDRESS 0xFFF8DC5C DISPLAY_IDENTIFIER time_.tmr_DelayBrake_VUNPLAUSILEV2.SpeedPlausibilityIn._.ZFFSAB /end MEASUREMENT
/begin MEASUREMENT ZFFSAB._.SpeedPlausibilityIn.tmr_DelayDeactGra_VUNPLAUSILEV2.time "Description for this variable only in SW documentation possible not in asap2" ULONG SAB_T_TIMER_10MS_S2_S3 1 100 0 42949672950 ECU_ADDRESS 0xFFF8DC68 DISPLAY_IDENTIFIER time.tmr_DelayDeactGra_VUNPLAUSILEV2.SpeedPlausibilityIn._.ZFFSAB /end MEASUREMENT
/begin MEASUREMENT ZFFSAB._.SpeedPlausibilityIn.tmr_DelayDeactGra_VUNPLAUSILEV2.time_ "Description for this variable only in SW documentation possible not in asap2" ULONG SAB_T_TIMER_10MS_S2_S3 1 100 0 42949672950 ECU_ADDRESS 0xFFF8DC6C DISPLAY_IDENTIFIER time_.tmr_DelayDeactGra_VUNPLAUSILEV2.SpeedPlausibilityIn._.ZFFSAB /end MEASUREMENT
/begin MEASUREMENT ZFFSAB._.SpeedPlausibilityIn.tmr_DelayGra_VUNPLAUSILEV2.time "Description for this variable only in SW documentation possible not in asap2" ULONG SAB_T_TIMER_10MS_S2_S3 1 100 0 42949672950 ECU_ADDRESS 0xFFF8DC50 DISPLAY_IDENTIFIER time.tmr_DelayGra_VUNPLAUSILEV2.SpeedPlausibilityIn._.ZFFSAB /end MEASUREMENT
/begin MEASUREMENT ZFFSAB._.SpeedPlausibilityIn.tmr_DelayGra_VUNPLAUSILEV2.time_ "Description for this variable only in SW documentation possible not in asap2" ULONG SAB_T_TIMER_10MS_S2_S3 1 100 0 42949672950 ECU_ADDRESS 0xFFF8DC54 DISPLAY_IDENTIFIER time_.tmr_DelayGra_VUNPLAUSILEV2.SpeedPlausibilityIn._.ZFFSAB /end MEASUREMENT
/begin MEASUREMENT ZFFSAB._.SpeedPlausibilityIn.tmr_DelayTo_VUNPLAUSILEV2.time "Description for this variable only in SW documentation possible not in asap2" ULONG SAB_T_TIMER_10MS_S2_S3 1 100 0 42949672950 ECU_ADDRESS 0xFFF8DC60 DISPLAY_IDENTIFIER time.tmr_DelayTo_VUNPLAUSILEV2.SpeedPlausibilityIn._.ZFFSAB /end MEASUREMENT
/begin MEASUREMENT ZFFSAB._.SpeedPlausibilityIn.tmr_DelayTo_VUNPLAUSILEV2.time_ "Description for this variable only in SW documentation possible not in asap2" ULONG SAB_T_TIMER_10MS_S2_S3 1 100 0 42949672950 ECU_ADDRESS 0xFFF8DC64 DISPLAY_IDENTIFIER time_.tmr_DelayTo_VUNPLAUSILEV2.SpeedPlausibilityIn._.ZFFSAB /end MEASUREMENT
/begin MEASUREMENT ZFFSAB._.SpeedPlausibilityIn.v_unplausiOld "value of v_unplausi in the cycle before" UBYTE SAB_STANDARD_S2_S3 1 100 0 1 ECU_ADDRESS 0xFFF8DC76 DISPLAY_IDENTIFIER v_unplausiOld.SpeedPlausibilityIn._.ZFFSAB /end MEASUREMENT
/begin MEASUREMENT ZFFSAB._.SpeedometerSpeedIn.f_v_SpeedometerErr "Error flag of speedometer" UBYTE SAB_STANDARD_S2_S3 1 100 0 255 ECU_ADDRESS 0xFFF95D3A DISPLAY_IDENTIFIER f_v_SpeedometerErr.SpeedometerSpeedIn._.ZFFSAB /end MEASUREMENT
/begin MEASUREMENT ZFFSAB._.SpeedometerSpeedIn.iv_v_Speedometer "Input value speedometer from CAN" UWORD SAB_V_KMH10_S2_S3 1 100 0 409.5 ECU_ADDRESS 0xFFF95D38 DISPLAY_IDENTIFIER iv_v_Speedometer.SpeedometerSpeedIn._.ZFFSAB /end MEASUREMENT
/begin MEASUREMENT ZFFSAB._.SpeedometerSpeedIn.iv_v_SpeedometerSts "Input value message status of speedometer" UBYTE SAB_STANDARD_S2_S3 1 100 0 255 ECU_ADDRESS 0xFFF95D37 DISPLAY_IDENTIFIER iv_v_SpeedometerSts.SpeedometerSpeedIn._.ZFFSAB /end MEASUREMENT
/begin MEASUREMENT ZFFSAB._.SpeedometerSpeedIn.sv_v_Speedometer "Intermediate value of speedometer" UWORD SAB_V_KMH10_S2_S3 1 100 0 409.5 ECU_ADDRESS 0xFFF95D34 DISPLAY_IDENTIFIER sv_v_Speedometer.SpeedometerSpeedIn._.ZFFSAB /end MEASUREMENT
/begin MEASUREMENT ZFFSAB._.SpeedometerSpeedIn.sv_v_SpeedometerSts "Intermediate value signal status of speedometer" UBYTE SAB_STANDARD_S2_S3 1 100 0 255 ECU_ADDRESS 0xFFF95D36 DISPLAY_IDENTIFIER sv_v_SpeedometerSts.SpeedometerSpeedIn._.ZFFSAB /end MEASUREMENT
/begin MEASUREMENT ZFFSAB._.SportButtonIn.iv_DriveLogicRaw "Sport-Wippen Information" UBYTE SAB_STANDARD_S2_S3 1 100 0 255 ECU_ADDRESS 0xFFF95D64 DISPLAY_IDENTIFIER iv_DriveLogicRaw.SportButtonIn._.ZFFSAB /end MEASUREMENT
/begin MEASUREMENT ZFFSAB._.SportButtonIn.iv_DriveLogicRawSts "state of iv_DriveLogicRaw" UBYTE SAB_STANDARD_S2_S3 1 100 0 255 ECU_ADDRESS 0xFFF95D65 DISPLAY_IDENTIFIER iv_DriveLogicRawSts.SportButtonIn._.ZFFSAB /end MEASUREMENT
/begin MEASUREMENT ZFFSAB._.SportButtonIn.iv_DriveLogicS1 "Drive-Logic-Signal from Source 1" UBYTE SAB_STANDARD_S2_S3 1 100 0 255 ECU_ADDRESS 0xFFF95D69 DISPLAY_IDENTIFIER iv_DriveLogicS1.SportButtonIn._.ZFFSAB /end MEASUREMENT
/begin MEASUREMENT ZFFSAB._.SportButtonIn.iv_DriveLogicS2 "Drive-Logic-Signal from Source 2" UBYTE SAB_STANDARD_S2_S3 1 100 0 255 ECU_ADDRESS 0xFFF95D68 DISPLAY_IDENTIFIER iv_DriveLogicS2.SportButtonIn._.ZFFSAB /end MEASUREMENT
/begin MEASUREMENT ZFFSAB._.SportButtonIn.iv_DriveLogicStsS1 "Drive-Logic-Status from Source 1" UBYTE SAB_STANDARD_S2_S3 1 100 0 255 ECU_ADDRESS 0xFFF95D6B DISPLAY_IDENTIFIER iv_DriveLogicStsS1.SportButtonIn._.ZFFSAB /end MEASUREMENT
/begin MEASUREMENT ZFFSAB._.SportButtonIn.iv_DriveLogicStsS2 "Drive-Logic-Status from Source 2" UBYTE SAB_STANDARD_S2_S3 1 100 0 255 ECU_ADDRESS 0xFFF95D6A DISPLAY_IDENTIFIER iv_DriveLogicStsS2.SportButtonIn._.ZFFSAB /end MEASUREMENT
/begin MEASUREMENT ZFFSAB._.SportButtonIn.iv_GWS_S_ButtonRaw "sport taster information from CAN BN2" UBYTE SAB_STANDARD_S2_S3 1 100 0 255 ECU_ADDRESS 0xFFF95D66 DISPLAY_IDENTIFIER iv_GWS_S_ButtonRaw.SportButtonIn._.ZFFSAB /end MEASUREMENT
/begin MEASUREMENT ZFFSAB._.SportButtonIn.iv_GWS_S_ButtonRawSts "status of iv_GWS_S_ButtonRaw" UBYTE SAB_STANDARD_S2_S3 1 100 0 255 ECU_ADDRESS 0xFFF95D67 DISPLAY_IDENTIFIER iv_GWS_S_ButtonRawSts.SportButtonIn._.ZFFSAB /end MEASUREMENT
/begin MEASUREMENT ZFFSAB._.SportButtonIn.iv_GWS_S_ButtonS1 "S-Button-Signal from Source 1" UBYTE SAB_STANDARD_S2_S3 1 100 0 255 ECU_ADDRESS 0xFFF95D6D DISPLAY_IDENTIFIER iv_GWS_S_ButtonS1.SportButtonIn._.ZFFSAB /end MEASUREMENT
/begin MEASUREMENT ZFFSAB._.SportButtonIn.iv_GWS_S_ButtonS2 "S-Button-Signal from Source 2" UBYTE SAB_STANDARD_S2_S3 1 100 0 255 ECU_ADDRESS 0xFFF95D6C DISPLAY_IDENTIFIER iv_GWS_S_ButtonS2.SportButtonIn._.ZFFSAB /end MEASUREMENT
/begin MEASUREMENT ZFFSAB._.SportButtonIn.iv_GWS_S_ButtonStsS1 "S-Button-Status from Source 1" UBYTE SAB_STANDARD_S2_S3 1 100 0 255 ECU_ADDRESS 0xFFF95D6F DISPLAY_IDENTIFIER iv_GWS_S_ButtonStsS1.SportButtonIn._.ZFFSAB /end MEASUREMENT
/begin MEASUREMENT ZFFSAB._.SportButtonIn.iv_GWS_S_ButtonStsS2 "S-Button-Status from Source 2" UBYTE SAB_STANDARD_S2_S3 1 100 0 255 ECU_ADDRESS 0xFFF95D6E DISPLAY_IDENTIFIER iv_GWS_S_ButtonStsS2.SportButtonIn._.ZFFSAB /end MEASUREMENT
/begin MEASUREMENT ZFFSAB._.SportButtonIn.iv_ICM_S_ButtonRaw "drive dynmics information from CAN" UWORD SAB_STANDARD_S2_S3 1 100 0 65535 ECU_ADDRESS 0xFFF95D70 DISPLAY_IDENTIFIER iv_ICM_S_ButtonRaw.SportButtonIn._.ZFFSAB /end MEASUREMENT
/begin MEASUREMENT ZFFSAB._.SportButtonIn.iv_ICM_S_ButtonRawSts "state of iv_ICM_S_ButtonRaw" UBYTE SAB_STANDARD_S2_S3 1 100 0 255 ECU_ADDRESS 0xFFF95D72 DISPLAY_IDENTIFIER iv_ICM_S_ButtonRawSts.SportButtonIn._.ZFFSAB /end MEASUREMENT
/begin MEASUREMENT ZFFSAB._.SportButtonIn.sv_DriveDynamics "information about Drive Dynamics" UWORD SAB_STANDARD_S2_S3 1 100 0 65535 ECU_ADDRESS 0xFFF95D74 DISPLAY_IDENTIFIER sv_DriveDynamics.SportButtonIn._.ZFFSAB /end MEASUREMENT
/begin MEASUREMENT ZFFSAB._.SportButtonIn.sv_DriveDynamicsSts "State of sv_DriveDynamics" UBYTE SAB_STANDARD_S2_S3 1 100 0 1 ECU_ADDRESS 0xFFF95D76 DISPLAY_IDENTIFIER sv_DriveDynamicsSts.SportButtonIn._.ZFFSAB /end MEASUREMENT
/begin MEASUREMENT ZFFSAB._.SportButtonIn.sv_DriveLogic "Sport-Wippen Information" UBYTE SAB_STANDARD_S2_S3 1 100 0 255 ECU_ADDRESS 0xFFF95D77 DISPLAY_IDENTIFIER sv_DriveLogic.SportButtonIn._.ZFFSAB /end MEASUREMENT
/begin MEASUREMENT ZFFSAB._.SportButtonIn.sv_SWI_GWS_Dlg "returns applicable SWI_GWS_DriveLogic" UBYTE SAB_STANDARD_S2_S3 1 100 0 1 ECU_ADDRESS 0xFFF95D79 DISPLAY_IDENTIFIER sv_SWI_GWS_Dlg.SportButtonIn._.ZFFSAB /end MEASUREMENT
/begin MEASUREMENT ZFFSAB._.SportButtonIn.sv_SWI_GWS_S_Btn "returns applicable SWI_GWS_S_Button" UBYTE SAB_STANDARD_S2_S3 1 100 0 1 ECU_ADDRESS 0xFFF95D7A DISPLAY_IDENTIFIER sv_SWI_GWS_S_Btn.SportButtonIn._.ZFFSAB /end MEASUREMENT
/begin MEASUREMENT ZFFSAB._.SportButtonIn.sv_S_Button "sport-button information" UBYTE SAB_STANDARD_S2_S3 1 100 0 255 ECU_ADDRESS 0xFFF95D78 DISPLAY_IDENTIFIER sv_S_Button.SportButtonIn._.ZFFSAB /end MEASUREMENT
/begin MEASUREMENT ZFFSAB._.SteeringWheelAngleIn.f_SteerAngleErr "Error flag steering-wheel angle" UBYTE SAB_STANDARD_S2_S3 1 100 0 1 ECU_ADDRESS 0xFFF8DC83 DISPLAY_IDENTIFIER f_SteerAngleErr.SteeringWheelAngleIn._.ZFFSAB /end MEASUREMENT
/begin MEASUREMENT ZFFSAB._.SteeringWheelAngleIn.iv_SteerAngle "Input value steering-wheel angle from CAN" UWORD SAB_PHI_STEERING_ANGLE_2747GRAD1000000_M32763_S2_S3 1 100 -89.999961 90.024684 ECU_ADDRESS 0xFFF8DC7C DISPLAY_IDENTIFIER iv_SteerAngle.SteeringWheelAngleIn._.ZFFSAB /end MEASUREMENT
/begin MEASUREMENT ZFFSAB._.SteeringWheelAngleIn.iv_SteerAngleErr "Input value steering-wheel angle error from CAN" UBYTE SAB_STANDARD_S2_S3 1 100 0 15 ECU_ADDRESS 0xFFF8DC7E DISPLAY_IDENTIFIER iv_SteerAngleErr.SteeringWheelAngleIn._.ZFFSAB /end MEASUREMENT
/begin MEASUREMENT ZFFSAB._.SteeringWheelAngleIn.iv_SteerAngleSts "Input value message status of steering-wheel angle" UBYTE SAB_STANDARD_S2_S3 1 100 0 255 ECU_ADDRESS 0xFFF8DC7F DISPLAY_IDENTIFIER iv_SteerAngleSts.SteeringWheelAngleIn._.ZFFSAB /end MEASUREMENT
/begin MEASUREMENT ZFFSAB._.SteeringWheelAngleIn.sv_AGS_LwVaEff "Output value of steering-wheel angle to AGS layer" UWORD SAB_PHI_STEERING_ANGLE_2747GRAD1000000_M32763_S2_S3 1 100 -89.999961 0.010988 ECU_ADDRESS 0xFFF8DC80 DISPLAY_IDENTIFIER sv_AGS_LwVaEff.SteeringWheelAngleIn._.ZFFSAB /end MEASUREMENT
/begin MEASUREMENT ZFFSAB._.SteeringWheelAngleIn.sv_AGS_LwVaStat "Output value of steering-wheel angle signal status to AGS layer" UBYTE SAB_STANDARD_S2_S3 1 100 0 2 ECU_ADDRESS 0xFFF8DC82 DISPLAY_IDENTIFIER sv_AGS_LwVaStat.SteeringWheelAngleIn._.ZFFSAB /end MEASUREMENT
/begin MEASUREMENT ZFFSAB._.SubstTempIn.PAK_counter_end "counter Pak calls in 10 ms Task" UBYTE SAB_STANDARD_S2_S3 1 100 0 19 ECU_ADDRESS 0xFFF95B5D DISPLAY_IDENTIFIER PAK_counter_end.SubstTempIn._.ZFFSAB /end MEASUREMENT
/begin MEASUREMENT ZFFSAB._.SubstTempIn.PAK_counter_end_ "complement of counter Pak calls in 10 ms Task" UBYTE SAB_STANDARD_S2_S3 1 100 0 19 ECU_ADDRESS 0xFFF95B5E DISPLAY_IDENTIFIER PAK_counter_end_.SubstTempIn._.ZFFSAB /end MEASUREMENT
/begin MEASUREMENT ZFFSAB._.SubstTempIn.PAK_counter_start "counter Pak calls in 10 ms Task" UBYTE SAB_STANDARD_S2_S3 1 100 0 19 ECU_ADDRESS 0xFFF95B5B DISPLAY_IDENTIFIER PAK_counter_start.SubstTempIn._.ZFFSAB /end MEASUREMENT
/begin MEASUREMENT ZFFSAB._.SubstTempIn.PAK_counter_start_ "complement of counter Pak calls in 10 ms Task" UBYTE SAB_STANDARD_S2_S3 1 100 0 19 ECU_ADDRESS 0xFFF95B5C DISPLAY_IDENTIFIER PAK_counter_start_.SubstTempIn._.ZFFSAB /end MEASUREMENT
/begin MEASUREMENT ZFFSAB._.SubstTempIn.iv_c_Chip1TransESts "Input raw signal EStatus Chiptemperature Sensor 1 (CG130)" UBYTE SAB_STANDARD_S2_S3 1 100 0 255 ECU_ADDRESS 0xFFF95B54 DISPLAY_IDENTIFIER iv_c_Chip1TransESts.SubstTempIn._.ZFFSAB /end MEASUREMENT
/begin MEASUREMENT ZFFSAB._.SubstTempIn.iv_c_Chip2TransESts "Input raw signal EStatus Chiptemperature Sensor 2 (LM71)" UBYTE SAB_STANDARD_S2_S3 1 100 0 255 ECU_ADDRESS 0xFFF95B55 DISPLAY_IDENTIFIER iv_c_Chip2TransESts.SubstTempIn._.ZFFSAB /end MEASUREMENT
/begin MEASUREMENT ZFFSAB._.SubstTempIn.iv_hot_modeLevel "Required temperaturmode from Gear transmission control by driving strategie" UBYTE SAB_STANDARD_S2_S3 1 100 0 2 ECU_ADDRESS 0xFFF95B56 DISPLAY_IDENTIFIER iv_hot_modeLevel.SubstTempIn._.ZFFSAB /end MEASUREMENT
/begin MEASUREMENT ZFFSAB._.SubstTempIn.iv_n_Eng "input signal engine speed" UWORD SAB_STANDARD_S2_S3 1 100 0 65535 ECU_ADDRESS 0xFFF95B58 DISPLAY_IDENTIFIER iv_n_Eng.SubstTempIn._.ZFFSAB /end MEASUREMENT
/begin MEASUREMENT ZFFSAB._.SubstTempIn.iv_n_EngSts "input signal engine speed" UBYTE SAB_STANDARD_S2_S3 1 100 0 255 ECU_ADDRESS 0xFFF95B5A DISPLAY_IDENTIFIER iv_n_EngSts.SubstTempIn._.ZFFSAB /end MEASUREMENT
/begin MEASUREMENT ZFFSAB._.TempDiagnosis_AT.PAK_counter_end "counter Pak calls in 10 ms Task" UBYTE SAB_STANDARD_S2_S3 1 100 0 19 ECU_ADDRESS 0xFFF8E05F DISPLAY_IDENTIFIER PAK_counter_end.TempDiagnosis_AT._.ZFFSAB /end MEASUREMENT
/begin MEASUREMENT ZFFSAB._.TempDiagnosis_AT.PAK_counter_end_ "complement of counter Pak calls in 10 ms Task" UBYTE SAB_STANDARD_S2_S3 1 100 0 19 ECU_ADDRESS 0xFFF8E060 DISPLAY_IDENTIFIER PAK_counter_end_.TempDiagnosis_AT._.ZFFSAB /end MEASUREMENT
/begin MEASUREMENT ZFFSAB._.TempDiagnosis_AT.PAK_counter_start "counter Pak calls in 10 ms Task" UBYTE SAB_STANDARD_S2_S3 1 100 0 19 ECU_ADDRESS 0xFFF8E05D DISPLAY_IDENTIFIER PAK_counter_start.TempDiagnosis_AT._.ZFFSAB /end MEASUREMENT
/begin MEASUREMENT ZFFSAB._.TempDiagnosis_AT.PAK_counter_start_ "complement of counter Pak calls in 10 ms Task" UBYTE SAB_STANDARD_S2_S3 1 100 0 19 ECU_ADDRESS 0xFFF8E05E DISPLAY_IDENTIFIER PAK_counter_start_.TempDiagnosis_AT._.ZFFSAB /end MEASUREMENT
/begin MEASUREMENT ZFFSAB._.TempDiagnosis_AT.TempDiagnosis_AT_Fl.c_OilTransCor "corrected gear oil temperature" FLOAT32_IEEE SAB_C_CGT_1CEL_M40_S2_S3 1 100 -40 215 ECU_ADDRESS 0xFFF8DFCC FORMAT "%4.3" DISPLAY_IDENTIFIER c_OilTransCor.TempDiagnosis_AT_Fl.TempDiagnosis_AT._.ZFFSAB /end MEASUREMENT
/begin MEASUREMENT ZFFSAB._.TempDiagnosis_AT.TempDiagnosis_AT_Fl.c_OilTransCorInt "gear oil temperature for gradient limitation" FLOAT32_IEEE SAB_C_CGT_100CEL_M4000_S2_S3 1 100 -40 615.35 ECU_ADDRESS 0xFFF8DFC8 DISPLAY_IDENTIFIER c_OilTransCorInt.TempDiagnosis_AT_Fl.TempDiagnosis_AT._.ZFFSAB /end MEASUREMENT
/begin MEASUREMENT ZFFSAB._.TempDiagnosis_AT.TempDiagnosis_AT_Fl.c_OilTrans_old "Last plausible temperature measured" FLOAT32_IEEE SAB_C_CGT_1CEL_M40_S2_S3 1 100 -40 215 ECU_ADDRESS 0xFFF8DFD8 FORMAT "%4.3" DISPLAY_IDENTIFIER c_OilTrans_old.TempDiagnosis_AT_Fl.TempDiagnosis_AT._.ZFFSAB /end MEASUREMENT
/begin MEASUREMENT ZFFSAB._.TempDiagnosis_AT.TempDiagnosis_AT_Fl.c_OilTrans_old_ "complement of last plausible temperature measured" FLOAT32_IEEE SAB_C_CGT_1CEL_M40_S2_S3 1 100 -40 215 ECU_ADDRESS 0xFFF8DFDC FORMAT "%4.3" DISPLAY_IDENTIFIER c_OilTrans_old_.TempDiagnosis_AT_Fl.TempDiagnosis_AT._.ZFFSAB /end MEASUREMENT
/begin MEASUREMENT ZFFSAB._.TempDiagnosis_AT.TempDiagnosis_AT_Fl.cnt_ToleranceErr1.time "Description for this variable only in SW documentation possible not in asap2" ULONG SAB_T_TIMER_S10_S2_S3 1 100 0 429496729.5 ECU_ADDRESS 0xFFF8DF90 DISPLAY_IDENTIFIER time.cnt_ToleranceErr1.TempDiagnosis_AT_Fl.TempDiagnosis_AT._.ZFFSAB /end MEASUREMENT
/begin MEASUREMENT ZFFSAB._.TempDiagnosis_AT.TempDiagnosis_AT_Fl.cnt_ToleranceErr1.time_ "Description for this variable only in SW documentation possible not in asap2" ULONG SAB_T_TIMER_S10_S2_S3 1 100 0 429496729.5 ECU_ADDRESS 0xFFF8DF94 DISPLAY_IDENTIFIER time_.cnt_ToleranceErr1.TempDiagnosis_AT_Fl.TempDiagnosis_AT._.ZFFSAB /end MEASUREMENT
/begin MEASUREMENT ZFFSAB._.TempDiagnosis_AT.TempDiagnosis_AT_Fl.cnt_ToleranceErr2.time "Description for this variable only in SW documentation possible not in asap2" ULONG SAB_T_TIMER_S10_S2_S3 1 100 0 429496729.5 ECU_ADDRESS 0xFFF8DF98 DISPLAY_IDENTIFIER time.cnt_ToleranceErr2.TempDiagnosis_AT_Fl.TempDiagnosis_AT._.ZFFSAB /end MEASUREMENT
/begin MEASUREMENT ZFFSAB._.TempDiagnosis_AT.TempDiagnosis_AT_Fl.cnt_ToleranceErr2.time_ "Description for this variable only in SW documentation possible not in asap2" ULONG SAB_T_TIMER_S10_S2_S3 1 100 0 429496729.5 ECU_ADDRESS 0xFFF8DF9C DISPLAY_IDENTIFIER time_.cnt_ToleranceErr2.TempDiagnosis_AT_Fl.TempDiagnosis_AT._.ZFFSAB /end MEASUREMENT
/begin MEASUREMENT ZFFSAB._.TempDiagnosis_AT.TempDiagnosis_AT_Fl.f_CChipdelta "flag for delta error previous cycle" FLOAT32_IEEE SAB_STANDARD_S2_S3 1 100 0 1 ECU_ADDRESS 0xFFF8DFFC FORMAT "%4.3" DISPLAY_IDENTIFIER f_CChipdelta.TempDiagnosis_AT_Fl.TempDiagnosis_AT._.ZFFSAB /end MEASUREMENT
/begin MEASUREMENT ZFFSAB._.TempDiagnosis_AT.TempDiagnosis_AT_Fl.f_CChipdelta_old "complement flag for delta error previous cycle" FLOAT32_IEEE SAB_STANDARD_S2_S3 1 100 0 1 ECU_ADDRESS 0xFFF8E000 FORMAT "%4.3" DISPLAY_IDENTIFIER f_CChipdelta_old.TempDiagnosis_AT_Fl.TempDiagnosis_AT._.ZFFSAB /end MEASUREMENT
/begin MEASUREMENT ZFFSAB._.TempDiagnosis_AT.TempDiagnosis_AT_Fl.f_CChipdelta_old_ "complement flag for delta error previous cycle" FLOAT32_IEEE SAB_STANDARD_S2_S3 1 100 0 1 ECU_ADDRESS 0xFFF8E004 FORMAT "%4.3" DISPLAY_IDENTIFIER f_CChipdelta_old_.TempDiagnosis_AT_Fl.TempDiagnosis_AT._.ZFFSAB /end MEASUREMENT
/begin MEASUREMENT ZFFSAB._.TempDiagnosis_AT.TempDiagnosis_AT_Fl.f_CGT_Tolerance "Flag to switch close/wide tolerance" FLOAT32_IEEE SAB_STANDARD_S2_S3 1 100 0 1 ECU_ADDRESS 0xFFF8DFEC FORMAT "%4.3" DISPLAY_IDENTIFIER f_CGT_Tolerance.TempDiagnosis_AT_Fl.TempDiagnosis_AT._.ZFFSAB /end MEASUREMENT
/begin MEASUREMENT ZFFSAB._.TempDiagnosis_AT.TempDiagnosis_AT_Fl.f_c_CGT_JumpErr "Error flag for Temperature Jump" FLOAT32_IEEE SAB_STANDARD_S2_S3 1 100 0 1 ECU_ADDRESS 0xFFF8DFE0 FORMAT "%4.3" DISPLAY_IDENTIFIER f_c_CGT_JumpErr.TempDiagnosis_AT_Fl.TempDiagnosis_AT._.ZFFSAB /end MEASUREMENT
/begin MEASUREMENT ZFFSAB._.TempDiagnosis_AT.TempDiagnosis_AT_Fl.f_c_CGT_JumpErr_old "Error flag for Temperature Jump last cycle" FLOAT32_IEEE SAB_STANDARD_S2_S3 1 100 0 1 ECU_ADDRESS 0xFFF8DFE4 FORMAT "%4.3" DISPLAY_IDENTIFIER f_c_CGT_JumpErr_old.TempDiagnosis_AT_Fl.TempDiagnosis_AT._.ZFFSAB /end MEASUREMENT
/begin MEASUREMENT ZFFSAB._.TempDiagnosis_AT.TempDiagnosis_AT_Fl.f_c_CGT_JumpErr_old_ "complement Error flag for Temperature Jump last cycle" FLOAT32_IEEE SAB_STANDARD_S2_S3 1 100 0 1 ECU_ADDRESS 0xFFF8DFE8 FORMAT "%4.3" DISPLAY_IDENTIFIER f_c_CGT_JumpErr_old_.TempDiagnosis_AT_Fl.TempDiagnosis_AT._.ZFFSAB /end MEASUREMENT
/begin MEASUREMENT ZFFSAB._.TempDiagnosis_AT.TempDiagnosis_AT_Fl.f_c_CgtPlausiErr "Error flag for Sensor CGT" FLOAT32_IEEE SAB_STANDARD_S2_S3 1 100 0 1 ECU_ADDRESS 0xFFF8E010 FORMAT "%4.3" DISPLAY_IDENTIFIER f_c_CgtPlausiErr.TempDiagnosis_AT_Fl.TempDiagnosis_AT._.ZFFSAB /end MEASUREMENT
/begin MEASUREMENT ZFFSAB._.TempDiagnosis_AT.TempDiagnosis_AT_Fl.f_c_Chip1CGT "Error flag for Sensor Plausi Chip1CGT" FLOAT32_IEEE SAB_STANDARD_S2_S3 1 100 0 1 ECU_ADDRESS 0xFFF8DFF0 FORMAT "%4.3" DISPLAY_IDENTIFIER f_c_Chip1CGT.TempDiagnosis_AT_Fl.TempDiagnosis_AT._.ZFFSAB /end MEASUREMENT
/begin MEASUREMENT ZFFSAB._.TempDiagnosis_AT.TempDiagnosis_AT_Fl.f_c_Chip1Chip2 "Error flag for Sensor Plausi Chip1Chip2" FLOAT32_IEEE SAB_STANDARD_S2_S3 1 100 0 1 ECU_ADDRESS 0xFFF8DFF8 FORMAT "%4.3" DISPLAY_IDENTIFIER f_c_Chip1Chip2.TempDiagnosis_AT_Fl.TempDiagnosis_AT._.ZFFSAB /end MEASUREMENT
/begin MEASUREMENT ZFFSAB._.TempDiagnosis_AT.TempDiagnosis_AT_Fl.f_c_Chip1PlausiErr "Error flag for Sensor Chip1" FLOAT32_IEEE SAB_STANDARD_S2_S3 1 100 0 1 ECU_ADDRESS 0xFFF8E008 FORMAT "%4.3" DISPLAY_IDENTIFIER f_c_Chip1PlausiErr.TempDiagnosis_AT_Fl.TempDiagnosis_AT._.ZFFSAB /end MEASUREMENT
/begin MEASUREMENT ZFFSAB._.TempDiagnosis_AT.TempDiagnosis_AT_Fl.f_c_Chip2CGT "Error flag for Sensor Plausi Chip2CGT" FLOAT32_IEEE SAB_STANDARD_S2_S3 1 100 0 1 ECU_ADDRESS 0xFFF8DFF4 FORMAT "%4.3" DISPLAY_IDENTIFIER f_c_Chip2CGT.TempDiagnosis_AT_Fl.TempDiagnosis_AT._.ZFFSAB /end MEASUREMENT
/begin MEASUREMENT ZFFSAB._.TempDiagnosis_AT.TempDiagnosis_AT_Fl.f_c_Chip2PlausiErr "Error flag for Sensor Chip2" FLOAT32_IEEE SAB_STANDARD_S2_S3 1 100 0 1 ECU_ADDRESS 0xFFF8E00C FORMAT "%4.3" DISPLAY_IDENTIFIER f_c_Chip2PlausiErr.TempDiagnosis_AT_Fl.TempDiagnosis_AT._.ZFFSAB /end MEASUREMENT
/begin MEASUREMENT ZFFSAB._.TempDiagnosis_AT.TempDiagnosis_AT_Fl.f_c_PlausiErr "Error flag double Sensor Error" FLOAT32_IEEE SAB_STANDARD_S2_S3 1 100 0 1 ECU_ADDRESS 0xFFF8E014 FORMAT "%4.3" DISPLAY_IDENTIFIER f_c_PlausiErr.TempDiagnosis_AT_Fl.TempDiagnosis_AT._.ZFFSAB /end MEASUREMENT
/begin MEASUREMENT ZFFSAB._.TempDiagnosis_AT.TempDiagnosis_AT_Fl.iv_c_Chip1Trans "Input raw signal Chiptemperature Sensor 1 (CG130)" FLOAT32_IEEE SAB_C_CGT_1CEL_M40_S2_S3 1 100 -40 215 ECU_ADDRESS 0xFFF8DFB8 FORMAT "%4.3" DISPLAY_IDENTIFIER iv_c_Chip1Trans.TempDiagnosis_AT_Fl.TempDiagnosis_AT._.ZFFSAB /end MEASUREMENT
/begin MEASUREMENT ZFFSAB._.TempDiagnosis_AT.TempDiagnosis_AT_Fl.iv_c_Chip1TransESts "Input raw signal EStatus Chiptemperature Sensor 1 (CG130)" FLOAT32_IEEE SAB_STANDARD_S2_S3 1 100 0 255 ECU_ADDRESS 0xFFF8DFAC FORMAT "%4.3" DISPLAY_IDENTIFIER iv_c_Chip1TransESts.TempDiagnosis_AT_Fl.TempDiagnosis_AT._.ZFFSAB /end MEASUREMENT
/begin MEASUREMENT ZFFSAB._.TempDiagnosis_AT.TempDiagnosis_AT_Fl.iv_c_Chip2Trans "Input raw signal Chiptemperature Sensor 2(LM71)" FLOAT32_IEEE SAB_C_CGT_1CEL_M40_S2_S3 1 100 -40 215 ECU_ADDRESS 0xFFF8DFA8 FORMAT "%4.3" DISPLAY_IDENTIFIER iv_c_Chip2Trans.TempDiagnosis_AT_Fl.TempDiagnosis_AT._.ZFFSAB /end MEASUREMENT
/begin MEASUREMENT ZFFSAB._.TempDiagnosis_AT.TempDiagnosis_AT_Fl.iv_c_Chip2TransESts "Input raw signal EStatus Chiptemperature Sensor 1(LM71)" FLOAT32_IEEE SAB_STANDARD_S2_S3 1 100 0 255 ECU_ADDRESS 0xFFF8DFB0 FORMAT "%4.3" DISPLAY_IDENTIFIER iv_c_Chip2TransESts.TempDiagnosis_AT_Fl.TempDiagnosis_AT._.ZFFSAB /end MEASUREMENT
/begin MEASUREMENT ZFFSAB._.TempDiagnosis_AT.TempDiagnosis_AT_Fl.iv_c_Chip2Trans_old "Input raw signal temperature chip2" FLOAT32_IEEE SAB_C_CGT_1CEL_M40_S2_S3 1 100 -40 215 ECU_ADDRESS 0xFFF8DFD0 FORMAT "%4.3" DISPLAY_IDENTIFIER iv_c_Chip2Trans_old.TempDiagnosis_AT_Fl.TempDiagnosis_AT._.ZFFSAB /end MEASUREMENT
/begin MEASUREMENT ZFFSAB._.TempDiagnosis_AT.TempDiagnosis_AT_Fl.iv_c_Chip2Trans_old_ "complement of Input raw signal temperature chip2" FLOAT32_IEEE SAB_C_CGT_1CEL_M40_S2_S3 1 100 -40 215 ECU_ADDRESS 0xFFF8DFD4 FORMAT "%4.3" DISPLAY_IDENTIFIER iv_c_Chip2Trans_old_.TempDiagnosis_AT_Fl.TempDiagnosis_AT._.ZFFSAB /end MEASUREMENT
/begin MEASUREMENT ZFFSAB._.TempDiagnosis_AT.TempDiagnosis_AT_Fl.iv_c_OilTrans "Input raw signal Oeltemperature Sensor" FLOAT32_IEEE SAB_C_CGT_1CEL_M40_S2_S3 1 100 -40 215 ECU_ADDRESS 0xFFF8DFB4 FORMAT "%4.3" DISPLAY_IDENTIFIER iv_c_OilTrans.TempDiagnosis_AT_Fl.TempDiagnosis_AT._.ZFFSAB /end MEASUREMENT
/begin MEASUREMENT ZFFSAB._.TempDiagnosis_AT.TempDiagnosis_AT_Fl.iv_c_OilTransESts "Input raw signal EStatus Oeltemperature Sensor" FLOAT32_IEEE SAB_STANDARD_S2_S3 1 100 0 255 ECU_ADDRESS 0xFFF8DFBC FORMAT "%4.3" DISPLAY_IDENTIFIER iv_c_OilTransESts.TempDiagnosis_AT_Fl.TempDiagnosis_AT._.ZFFSAB /end MEASUREMENT
/begin MEASUREMENT ZFFSAB._.TempDiagnosis_AT.TempDiagnosis_AT_Fl.iv_c_OilTransESts_old "Input raw signal EStatus Oeltemperature Sensor previous cycle" FLOAT32_IEEE SAB_STANDARD_S2_S3 1 100 0 255 ECU_ADDRESS 0xFFF8DFC0 FORMAT "%4.3" DISPLAY_IDENTIFIER iv_c_OilTransESts_old.TempDiagnosis_AT_Fl.TempDiagnosis_AT._.ZFFSAB /end MEASUREMENT
/begin MEASUREMENT ZFFSAB._.TempDiagnosis_AT.TempDiagnosis_AT_Fl.iv_c_OilTransESts_old_ "complement of input raw signal EStatus Oeltemperature Sensor previous cycle" FLOAT32_IEEE SAB_STANDARD_S2_S3 1 100 0 255 ECU_ADDRESS 0xFFF8DFC4 FORMAT "%4.3" DISPLAY_IDENTIFIER iv_c_OilTransESts_old_.TempDiagnosis_AT_Fl.TempDiagnosis_AT._.ZFFSAB /end MEASUREMENT
/begin MEASUREMENT ZFFSAB._.TempDiagnosis_AT.TempDiagnosis_AT_Fl.tmr_DiagDelay.time "Description for this variable only in SW documentation possible not in asap2" ULONG SAB_T_TIMER_S10_S2_S3 1 100 0 429496729.5 ECU_ADDRESS 0xFFF8DFA0 DISPLAY_IDENTIFIER time.tmr_DiagDelay.TempDiagnosis_AT_Fl.TempDiagnosis_AT._.ZFFSAB /end MEASUREMENT
/begin MEASUREMENT ZFFSAB._.TempDiagnosis_AT.TempDiagnosis_AT_Fl.tmr_DiagDelay.time_ "Description for this variable only in SW documentation possible not in asap2" ULONG SAB_T_TIMER_S10_S2_S3 1 100 0 429496729.5 ECU_ADDRESS 0xFFF8DFA4 DISPLAY_IDENTIFIER time_.tmr_DiagDelay.TempDiagnosis_AT_Fl.TempDiagnosis_AT._.ZFFSAB /end MEASUREMENT
/begin MEASUREMENT ZFFSAB._.TempDiagnosis_AT.TempDiagnosis_AT_Fl.tmr_TolCheck_CGTLEV2.time "Description for this variable only in SW documentation possible not in asap2" ULONG SAB_T_TIMER_S10_S2_S3 1 100 0 429496729.5 ECU_ADDRESS 0xFFF8DF88 DISPLAY_IDENTIFIER time.tmr_TolCheck_CGTLEV2.TempDiagnosis_AT_Fl.TempDiagnosis_AT._.ZFFSAB /end MEASUREMENT
/begin MEASUREMENT ZFFSAB._.TempDiagnosis_AT.TempDiagnosis_AT_Fl.tmr_TolCheck_CGTLEV2.time_ "Description for this variable only in SW documentation possible not in asap2" ULONG SAB_T_TIMER_S10_S2_S3 1 100 0 429496729.5 ECU_ADDRESS 0xFFF8DF8C DISPLAY_IDENTIFIER time_.tmr_TolCheck_CGTLEV2.TempDiagnosis_AT_Fl.TempDiagnosis_AT._.ZFFSAB /end MEASUREMENT
/begin MEASUREMENT ZFFSAB._.TempDiagnosis_AT.c_OilTransCor "corrected gear oil temperature" UBYTE SAB_C_CGT_1CEL_M40_S2_S3 1 100 -40 215 ECU_ADDRESS 0xFFF8E046 DISPLAY_IDENTIFIER c_OilTransCor.TempDiagnosis_AT._.ZFFSAB /end MEASUREMENT
/begin MEASUREMENT ZFFSAB._.TempDiagnosis_AT.c_OilTransCorInt "gear oil temperature for gradient limitation" UWORD SAB_C_CGT_100CEL_M4000_S2_S3 1 100 -40 615.35 ECU_ADDRESS 0xFFF8E044 DISPLAY_IDENTIFIER c_OilTransCorInt.TempDiagnosis_AT._.ZFFSAB /end MEASUREMENT
/begin MEASUREMENT ZFFSAB._.TempDiagnosis_AT.c_OilTransCor_ "corrected gear oil temperature" UBYTE SAB_C_CGT_1CEL_M40_S2_S3 1 100 -40 215 ECU_ADDRESS 0xFFF8E047 DISPLAY_IDENTIFIER c_OilTransCor_.TempDiagnosis_AT._.ZFFSAB /end MEASUREMENT
/begin MEASUREMENT ZFFSAB._.TempDiagnosis_AT.c_OilTrans_old "Last plausible temperature measured" UBYTE SAB_C_CGT_1CEL_M40_S2_S3 1 100 -40 215 ECU_ADDRESS 0xFFF8E04A DISPLAY_IDENTIFIER c_OilTrans_old.TempDiagnosis_AT._.ZFFSAB /end MEASUREMENT
/begin MEASUREMENT ZFFSAB._.TempDiagnosis_AT.c_OilTrans_old_ "complement Last plausible temperature measured" UBYTE SAB_C_CGT_1CEL_M40_S2_S3 1 100 -40 215 ECU_ADDRESS 0xFFF8E04B DISPLAY_IDENTIFIER c_OilTrans_old_.TempDiagnosis_AT._.ZFFSAB /end MEASUREMENT
/begin MEASUREMENT ZFFSAB._.TempDiagnosis_AT.cnt_ToleranceErr1.time "Description for this variable only in SW documentation possible not in asap2" ULONG SAB_T_TIMER_S10_S2_S3 1 100 0 429496729.5 ECU_ADDRESS 0xFFF8E024 DISPLAY_IDENTIFIER time.cnt_ToleranceErr1.TempDiagnosis_AT._.ZFFSAB /end MEASUREMENT
/begin MEASUREMENT ZFFSAB._.TempDiagnosis_AT.cnt_ToleranceErr1.time_ "Description for this variable only in SW documentation possible not in asap2" ULONG SAB_T_TIMER_S10_S2_S3 1 100 0 429496729.5 ECU_ADDRESS 0xFFF8E028 DISPLAY_IDENTIFIER time_.cnt_ToleranceErr1.TempDiagnosis_AT._.ZFFSAB /end MEASUREMENT
/begin MEASUREMENT ZFFSAB._.TempDiagnosis_AT.cnt_ToleranceErr2.time "Description for this variable only in SW documentation possible not in asap2" ULONG SAB_T_TIMER_S10_S2_S3 1 100 0 429496729.5 ECU_ADDRESS 0xFFF8E02C DISPLAY_IDENTIFIER time.cnt_ToleranceErr2.TempDiagnosis_AT._.ZFFSAB /end MEASUREMENT
/begin MEASUREMENT ZFFSAB._.TempDiagnosis_AT.cnt_ToleranceErr2.time_ "Description for this variable only in SW documentation possible not in asap2" ULONG SAB_T_TIMER_S10_S2_S3 1 100 0 429496729.5 ECU_ADDRESS 0xFFF8E030 DISPLAY_IDENTIFIER time_.cnt_ToleranceErr2.TempDiagnosis_AT._.ZFFSAB /end MEASUREMENT
/begin MEASUREMENT ZFFSAB._.TempDiagnosis_AT.f_CChipdelta "flag for delta error previous cycle" UBYTE SAB_STANDARD_S2_S3 1 100 0 1 ECU_ADDRESS 0xFFF8E053 DISPLAY_IDENTIFIER f_CChipdelta.TempDiagnosis_AT._.ZFFSAB /end MEASUREMENT
/begin MEASUREMENT ZFFSAB._.TempDiagnosis_AT.f_CChipdelta_old "complement flag for delta error previous cycle" UBYTE SAB_STANDARD_S2_S3 1 100 0 1 ECU_ADDRESS 0xFFF8E054 DISPLAY_IDENTIFIER f_CChipdelta_old.TempDiagnosis_AT._.ZFFSAB /end MEASUREMENT
/begin MEASUREMENT ZFFSAB._.TempDiagnosis_AT.f_CChipdelta_old_ "complement flag for delta error previous cycle" UBYTE SAB_STANDARD_S2_S3 1 100 0 1 ECU_ADDRESS 0xFFF8E055 DISPLAY_IDENTIFIER f_CChipdelta_old_.TempDiagnosis_AT._.ZFFSAB /end MEASUREMENT
/begin MEASUREMENT ZFFSAB._.TempDiagnosis_AT.f_CGT_Tolerance "Flag to switch close/wide tolerance" UBYTE SAB_STANDARD_S2_S3 1 100 0 1 ECU_ADDRESS 0xFFF8E04F DISPLAY_IDENTIFIER f_CGT_Tolerance.TempDiagnosis_AT._.ZFFSAB /end MEASUREMENT
/begin MEASUREMENT ZFFSAB._.TempDiagnosis_AT.f_c_CGT_JumpErr "Error flag for Temperature Jump" UBYTE SAB_STANDARD_S2_S3 1 100 0 1 ECU_ADDRESS 0xFFF8E04C DISPLAY_IDENTIFIER f_c_CGT_JumpErr.TempDiagnosis_AT._.ZFFSAB /end MEASUREMENT
/begin MEASUREMENT ZFFSAB._.TempDiagnosis_AT.f_c_CGT_JumpErr_old "Error flag for Temperature Jump last cycle" UBYTE SAB_STANDARD_S2_S3 1 100 0 1 ECU_ADDRESS 0xFFF8E04D DISPLAY_IDENTIFIER f_c_CGT_JumpErr_old.TempDiagnosis_AT._.ZFFSAB /end MEASUREMENT
/begin MEASUREMENT ZFFSAB._.TempDiagnosis_AT.f_c_CGT_JumpErr_old_ "complement Error flag for Temperature Jump last cycle" UBYTE SAB_STANDARD_S2_S3 1 100 0 1 ECU_ADDRESS 0xFFF8E04E DISPLAY_IDENTIFIER f_c_CGT_JumpErr_old_.TempDiagnosis_AT._.ZFFSAB /end MEASUREMENT
/begin MEASUREMENT ZFFSAB._.TempDiagnosis_AT.f_c_CgtPlausiErr "Error flag for Sensor CGT" UBYTE SAB_STANDARD_S2_S3 1 100 0 1 ECU_ADDRESS 0xFFF8E059 DISPLAY_IDENTIFIER f_c_CgtPlausiErr.TempDiagnosis_AT._.ZFFSAB /end MEASUREMENT
/begin MEASUREMENT ZFFSAB._.TempDiagnosis_AT.f_c_CgtPlausiErr_ "complement Error flag for Sensor CGT" UBYTE SAB_STANDARD_S2_S3 1 100 0 1 ECU_ADDRESS 0xFFF8E05A DISPLAY_IDENTIFIER f_c_CgtPlausiErr_.TempDiagnosis_AT._.ZFFSAB /end MEASUREMENT
/begin MEASUREMENT ZFFSAB._.TempDiagnosis_AT.f_c_Chip1CGT "Error flag for Sensor Plausi Chip1CGT" UBYTE SAB_STANDARD_S2_S3 1 100 0 1 ECU_ADDRESS 0xFFF8E050 DISPLAY_IDENTIFIER f_c_Chip1CGT.TempDiagnosis_AT._.ZFFSAB /end MEASUREMENT
/begin MEASUREMENT ZFFSAB._.TempDiagnosis_AT.f_c_Chip1Chip2 "Error flag for Sensor Plausi Chip1Chip2" UBYTE SAB_STANDARD_S2_S3 1 100 0 1 ECU_ADDRESS 0xFFF8E052 DISPLAY_IDENTIFIER f_c_Chip1Chip2.TempDiagnosis_AT._.ZFFSAB /end MEASUREMENT
/begin MEASUREMENT ZFFSAB._.TempDiagnosis_AT.f_c_Chip1PlausiErr "Error flag for Sensor Chip1" UBYTE SAB_STANDARD_S2_S3 1 100 0 1 ECU_ADDRESS 0xFFF8E056 DISPLAY_IDENTIFIER f_c_Chip1PlausiErr.TempDiagnosis_AT._.ZFFSAB /end MEASUREMENT
/begin MEASUREMENT ZFFSAB._.TempDiagnosis_AT.f_c_Chip2CGT "Error flag for Sensor Plausi Chip2CGT" UBYTE SAB_STANDARD_S2_S3 1 100 0 1 ECU_ADDRESS 0xFFF8E051 DISPLAY_IDENTIFIER f_c_Chip2CGT.TempDiagnosis_AT._.ZFFSAB /end MEASUREMENT
/begin MEASUREMENT ZFFSAB._.TempDiagnosis_AT.f_c_Chip2PlausiErr "Error flag for Sensor Chip2" UBYTE SAB_STANDARD_S2_S3 1 100 0 1 ECU_ADDRESS 0xFFF8E057 DISPLAY_IDENTIFIER f_c_Chip2PlausiErr.TempDiagnosis_AT._.ZFFSAB /end MEASUREMENT
/begin MEASUREMENT ZFFSAB._.TempDiagnosis_AT.f_c_Chip2PlausiErr_ "complement Error flag for Sensor Chip2" UBYTE SAB_STANDARD_S2_S3 1 100 0 1 ECU_ADDRESS 0xFFF8E058 DISPLAY_IDENTIFIER f_c_Chip2PlausiErr_.TempDiagnosis_AT._.ZFFSAB /end MEASUREMENT
/begin MEASUREMENT ZFFSAB._.TempDiagnosis_AT.f_c_PlausiErr "Error flag double Sensor Error" UBYTE SAB_STANDARD_S2_S3 1 100 0 1 ECU_ADDRESS 0xFFF8E05B DISPLAY_IDENTIFIER f_c_PlausiErr.TempDiagnosis_AT._.ZFFSAB /end MEASUREMENT
/begin MEASUREMENT ZFFSAB._.TempDiagnosis_AT.f_c_PlausiErr_ "complement Error flag double Sensor Error" UBYTE SAB_STANDARD_S2_S3 1 100 0 1 ECU_ADDRESS 0xFFF8E05C DISPLAY_IDENTIFIER f_c_PlausiErr_.TempDiagnosis_AT._.ZFFSAB /end MEASUREMENT
/begin MEASUREMENT ZFFSAB._.TempDiagnosis_AT.iv_c_Chip1Trans "Input raw signal Chiptemperature Sensor 1 (CG130)" UBYTE SAB_C_CGT_1CEL_M40_S2_S3 1 100 -40 215 ECU_ADDRESS 0xFFF8E03C DISPLAY_IDENTIFIER iv_c_Chip1Trans.TempDiagnosis_AT._.ZFFSAB /end MEASUREMENT
/begin MEASUREMENT ZFFSAB._.TempDiagnosis_AT.iv_c_Chip1TransESts "Input raw signal EStatus Chiptemperature Sensor 1 (CG130)" UBYTE SAB_STANDARD_S2_S3 1 100 0 255 ECU_ADDRESS 0xFFF8E03D DISPLAY_IDENTIFIER iv_c_Chip1TransESts.TempDiagnosis_AT._.ZFFSAB /end MEASUREMENT
/begin MEASUREMENT ZFFSAB._.TempDiagnosis_AT.iv_c_Chip2Trans "Input raw signal Chiptemperature Sensor 2(LM71)" UBYTE SAB_C_CGT_1CEL_M40_S2_S3 1 100 -40 215 ECU_ADDRESS 0xFFF8E03E DISPLAY_IDENTIFIER iv_c_Chip2Trans.TempDiagnosis_AT._.ZFFSAB /end MEASUREMENT
/begin MEASUREMENT ZFFSAB._.TempDiagnosis_AT.iv_c_Chip2TransESts "Input raw signal EStatus Chiptemperature Sensor 1(LM71)" UBYTE SAB_STANDARD_S2_S3 1 100 0 255 ECU_ADDRESS 0xFFF8E03F DISPLAY_IDENTIFIER iv_c_Chip2TransESts.TempDiagnosis_AT._.ZFFSAB /end MEASUREMENT
/begin MEASUREMENT ZFFSAB._.TempDiagnosis_AT.iv_c_Chip2Trans_old "Input raw signal temperature chip2 last cycle" UBYTE SAB_C_CGT_1CEL_M40_S2_S3 1 100 -40 215 ECU_ADDRESS 0xFFF8E048 DISPLAY_IDENTIFIER iv_c_Chip2Trans_old.TempDiagnosis_AT._.ZFFSAB /end MEASUREMENT
/begin MEASUREMENT ZFFSAB._.TempDiagnosis_AT.iv_c_Chip2Trans_old_ "complemnet Input raw signal temperature chip2 last cycle" UBYTE SAB_C_CGT_1CEL_M40_S2_S3 1 100 -40 215 ECU_ADDRESS 0xFFF8E049 DISPLAY_IDENTIFIER iv_c_Chip2Trans_old_.TempDiagnosis_AT._.ZFFSAB /end MEASUREMENT
/begin MEASUREMENT ZFFSAB._.TempDiagnosis_AT.iv_c_OilTrans "Input raw signal Oeltemperature Sensor" UBYTE SAB_C_CGT_1CEL_M40_S2_S3 1 100 -40 215 ECU_ADDRESS 0xFFF8E040 DISPLAY_IDENTIFIER iv_c_OilTrans.TempDiagnosis_AT._.ZFFSAB /end MEASUREMENT
/begin MEASUREMENT ZFFSAB._.TempDiagnosis_AT.iv_c_OilTransESts "Input raw signal EStatus Oeltemperature Sensor" UBYTE SAB_STANDARD_S2_S3 1 100 0 255 ECU_ADDRESS 0xFFF8E041 DISPLAY_IDENTIFIER iv_c_OilTransESts.TempDiagnosis_AT._.ZFFSAB /end MEASUREMENT
/begin MEASUREMENT ZFFSAB._.TempDiagnosis_AT.iv_c_OilTransESts_old "Input raw signal EStatus Oeltemperature Sensor previous cycle" UBYTE SAB_STANDARD_S2_S3 1 100 0 255 ECU_ADDRESS 0xFFF8E042 DISPLAY_IDENTIFIER iv_c_OilTransESts_old.TempDiagnosis_AT._.ZFFSAB /end MEASUREMENT
/begin MEASUREMENT ZFFSAB._.TempDiagnosis_AT.iv_c_OilTransESts_old_ "complement Input raw signal EStatus Oeltemperature Sensor previous cycle" UBYTE SAB_STANDARD_S2_S3 1 100 0 255 ECU_ADDRESS 0xFFF8E043 DISPLAY_IDENTIFIER iv_c_OilTransESts_old_.TempDiagnosis_AT._.ZFFSAB /end MEASUREMENT
/begin MEASUREMENT ZFFSAB._.TempDiagnosis_AT.tmr_DiagDelay.time "Description for this variable only in SW documentation possible not in asap2" ULONG SAB_T_TIMER_S10_S2_S3 1 100 0 429496729.5 ECU_ADDRESS 0xFFF8E034 DISPLAY_IDENTIFIER time.tmr_DiagDelay.TempDiagnosis_AT._.ZFFSAB /end MEASUREMENT
/begin MEASUREMENT ZFFSAB._.TempDiagnosis_AT.tmr_DiagDelay.time_ "Description for this variable only in SW documentation possible not in asap2" ULONG SAB_T_TIMER_S10_S2_S3 1 100 0 429496729.5 ECU_ADDRESS 0xFFF8E038 DISPLAY_IDENTIFIER time_.tmr_DiagDelay.TempDiagnosis_AT._.ZFFSAB /end MEASUREMENT
/begin MEASUREMENT ZFFSAB._.TempDiagnosis_AT.tmr_TolCheck_CGTLEV2.time "Description for this variable only in SW documentation possible not in asap2" ULONG SAB_T_TIMER_S10_S2_S3 1 100 0 429496729.5 ECU_ADDRESS 0xFFF8E01C DISPLAY_IDENTIFIER time.tmr_TolCheck_CGTLEV2.TempDiagnosis_AT._.ZFFSAB /end MEASUREMENT
/begin MEASUREMENT ZFFSAB._.TempDiagnosis_AT.tmr_TolCheck_CGTLEV2.time_ "Description for this variable only in SW documentation possible not in asap2" ULONG SAB_T_TIMER_S10_S2_S3 1 100 0 429496729.5 ECU_ADDRESS 0xFFF8E020 DISPLAY_IDENTIFIER time_.tmr_TolCheck_CGTLEV2.TempDiagnosis_AT._.ZFFSAB /end MEASUREMENT
/begin MEASUREMENT ZFFSAB._.TempExternIn.f_c_AmbientErr "Error flag of c_Ambient-signal" UBYTE SAB_STANDARD_S2_S3 1 100 0 1 ECU_ADDRESS 0xFFF96D25 DISPLAY_IDENTIFIER f_c_AmbientErr.TempExternIn._.ZFFSAB /end MEASUREMENT
/begin MEASUREMENT ZFFSAB._.TempExternIn.iv_c_Ambient "Input value ambient temperature from CAN" UBYTE SAB_C_TEMPEXTERN_CEL2_M40_S2_S3 1 100 -40 87.5 ECU_ADDRESS 0xFFF96D21 DISPLAY_IDENTIFIER iv_c_Ambient.TempExternIn._.ZFFSAB /end MEASUREMENT
/begin MEASUREMENT ZFFSAB._.TempExternIn.iv_c_AmbientSts "Input value of ambient temperature message status" UBYTE SAB_STANDARD_S2_S3 1 100 0 255 ECU_ADDRESS 0xFFF96D22 DISPLAY_IDENTIFIER iv_c_AmbientSts.TempExternIn._.ZFFSAB /end MEASUREMENT
/begin MEASUREMENT ZFFSAB._.TempExternIn.sv_c_Ambient "Output value for ambient temperature" UBYTE SAB_C_TEMPEXTERN_CEL2_M40_S2_S3 1 100 -40 87.5 ECU_ADDRESS 0xFFF96D23 DISPLAY_IDENTIFIER sv_c_Ambient.TempExternIn._.ZFFSAB /end MEASUREMENT
/begin MEASUREMENT ZFFSAB._.TempExternIn.sv_c_AmbientSts "Output value for of ambient temperature signal status" UBYTE SAB_STANDARD_S2_S3 1 100 0 2 ECU_ADDRESS 0xFFF96D24 DISPLAY_IDENTIFIER sv_c_AmbientSts.TempExternIn._.ZFFSAB /end MEASUREMENT
/begin MEASUREMENT ZFFSAB._.TimeEGSOffIn.f_TimeEGSOffCalculated "Flag for TimeEGSOff calculation (0=could not be done; 1=could be done)" UBYTE SAB_STANDARD_S2_S3 1 100 0 1 ECU_ADDRESS 0xFFF95F28 DISPLAY_IDENTIFIER f_TimeEGSOffCalculated.TimeEGSOffIn._.ZFFSAB /end MEASUREMENT
/begin MEASUREMENT ZFFSAB._.TimeEGSOffIn.iv_Systime "Current system time" ULONG SAB_T_TIMER_1S_S2_S3 1 100 0 4294967295 ECU_ADDRESS 0xFFF95F14 DISPLAY_IDENTIFIER iv_Systime.TimeEGSOffIn._.ZFFSAB /end MEASUREMENT
/begin MEASUREMENT ZFFSAB._.TimeEGSOffIn.sv_TimeEGSOff "Output signal of EGSOff: time the EGS was switched off" ULONG SAB_T_TIMER_1S_S2_S3 1 100 0 4294967295 ECU_ADDRESS 0xFFF95F18 DISPLAY_IDENTIFIER sv_TimeEGSOff.TimeEGSOffIn._.ZFFSAB /end MEASUREMENT
/begin MEASUREMENT ZFFSAB._.TimeEGSOffIn.sv_TimeEGSOffSts "Output status of EGSOff: status of the EGS off time" UBYTE SAB_STANDARD_S2_S3 1 100 0 2 ECU_ADDRESS 0xFFF95F1C DISPLAY_IDENTIFIER sv_TimeEGSOffSts.TimeEGSOffIn._.ZFFSAB /end MEASUREMENT
/begin MEASUREMENT ZFFSAB._.TimeEGSOffIn.t_SystimeCurBuf "Contains the current valid system time to store into the EEPROM" ULONG SAB_T_TIMER_1S_S2_S3 1 100 0 4294967295 ECU_ADDRESS 0xFFF95F20 DISPLAY_IDENTIFIER t_SystimeCurBuf.TimeEGSOffIn._.ZFFSAB /end MEASUREMENT
/begin MEASUREMENT ZFFSAB._.TimeEGSOffIn.t_SystimeOldBuf "Contains the last valid system time read from the EEPROM at start" ULONG SAB_T_TIMER_1S_S2_S3 1 100 0 4294967295 ECU_ADDRESS 0xFFF95F24 DISPLAY_IDENTIFIER t_SystimeOldBuf.TimeEGSOffIn._.ZFFSAB /end MEASUREMENT
/begin MEASUREMENT ZFFSAB._.TipTasterIn.Analog.f_TipErr "Output value mapped on to the outboxes. Error flag for manual shift requests of the selected source." UBYTE SAB_STANDARD_S2_S3 1 100 0 1 ECU_ADDRESS 0xFFF95DBA DISPLAY_IDENTIFIER f_TipErr.Analog.TipTasterIn._.ZFFSAB /end MEASUREMENT
/begin MEASUREMENT ZFFSAB._.TipTasterIn.Analog.f_TipMinus "Output value for the manual downshift request" UBYTE SAB_STANDARD_S2_S3 1 100 0 2 ECU_ADDRESS 0xFFF95DB7 DISPLAY_IDENTIFIER f_TipMinus.Analog.TipTasterIn._.ZFFSAB /end MEASUREMENT
/begin MEASUREMENT ZFFSAB._.TipTasterIn.Analog.f_TipMinusErr "Output value mapped on to the outboxes. Error flag for manual downshift request of the selected source." UBYTE SAB_STANDARD_S2_S3 1 100 0 1 ECU_ADDRESS 0xFFF95DB9 DISPLAY_IDENTIFIER f_TipMinusErr.Analog.TipTasterIn._.ZFFSAB /end MEASUREMENT
/begin MEASUREMENT ZFFSAB._.TipTasterIn.Analog.f_TipPlus "Output value for the manual upshift request" UBYTE SAB_STANDARD_S2_S3 1 100 0 2 ECU_ADDRESS 0xFFF95DB6 DISPLAY_IDENTIFIER f_TipPlus.Analog.TipTasterIn._.ZFFSAB /end MEASUREMENT
/begin MEASUREMENT ZFFSAB._.TipTasterIn.Analog.f_TipPlusErr "Output value mapped on to the outboxes. Error flag for manual upshift request of the selected source." UBYTE SAB_STANDARD_S2_S3 1 100 0 1 ECU_ADDRESS 0xFFF95DB8 DISPLAY_IDENTIFIER f_TipPlusErr.Analog.TipTasterIn._.ZFFSAB /end MEASUREMENT
/begin MEASUREMENT ZFFSAB._.TipTasterIn.Analog.iv_Tip "Binary encoded input value for the manual downshift and upshift request" UBYTE SAB_STANDARD_S2_S3 1 100 0 255 ECU_ADDRESS 0xFFF95DB4 DISPLAY_IDENTIFIER iv_Tip.Analog.TipTasterIn._.ZFFSAB /end MEASUREMENT
/begin MEASUREMENT ZFFSAB._.TipTasterIn.Analog.iv_TipSts "Binary encoded Input value for status of the manual downshift and manual upshift request" UBYTE SAB_STANDARD_S2_S3 1 100 0 255 ECU_ADDRESS 0xFFF95DB5 DISPLAY_IDENTIFIER iv_TipSts.Analog.TipTasterIn._.ZFFSAB /end MEASUREMENT
/begin MEASUREMENT ZFFSAB._.TipTasterIn.Analog.iv_f_TipMinus "Input value for the manual downshift request" UBYTE SAB_STANDARD_S2_S3 1 100 0 3 ECU_ADDRESS 0xFFF95DB0 DISPLAY_IDENTIFIER iv_f_TipMinus.Analog.TipTasterIn._.ZFFSAB /end MEASUREMENT
/begin MEASUREMENT ZFFSAB._.TipTasterIn.Analog.iv_f_TipMinusSts "Input value for status of the manual downshift Request" UBYTE SAB_STANDARD_S2_S3 1 100 0 1 ECU_ADDRESS 0xFFF95DB2 DISPLAY_IDENTIFIER iv_f_TipMinusSts.Analog.TipTasterIn._.ZFFSAB /end MEASUREMENT
/begin MEASUREMENT ZFFSAB._.TipTasterIn.Analog.iv_f_TipPlus "Input value for the manual upshift request" UBYTE SAB_STANDARD_S2_S3 1 100 0 3 ECU_ADDRESS 0xFFF95DB1 DISPLAY_IDENTIFIER iv_f_TipPlus.Analog.TipTasterIn._.ZFFSAB /end MEASUREMENT
/begin MEASUREMENT ZFFSAB._.TipTasterIn.Analog.iv_f_TipPlusSts "Input value for status of the manual upshift Request" UBYTE SAB_STANDARD_S2_S3 1 100 0 1 ECU_ADDRESS 0xFFF95DB3 DISPLAY_IDENTIFIER iv_f_TipPlusSts.Analog.TipTasterIn._.ZFFSAB /end MEASUREMENT
/begin MEASUREMENT ZFFSAB._.TipTasterIn.CAN.f_TipErr "Output value mapped on to the outboxes. Error flag for manual shift requests of the selected source." UBYTE SAB_STANDARD_S2_S3 1 100 0 1 ECU_ADDRESS 0xFFF95DA4 DISPLAY_IDENTIFIER f_TipErr.CAN.TipTasterIn._.ZFFSAB /end MEASUREMENT
/begin MEASUREMENT ZFFSAB._.TipTasterIn.CAN.f_TipMinus "Output value for the manual downshift request" UBYTE SAB_STANDARD_S2_S3 1 100 0 2 ECU_ADDRESS 0xFFF95DA1 DISPLAY_IDENTIFIER f_TipMinus.CAN.TipTasterIn._.ZFFSAB /end MEASUREMENT
/begin MEASUREMENT ZFFSAB._.TipTasterIn.CAN.f_TipMinusErr "Output value mapped on to the outboxes. Error flag for manual downshift request of the selected source." UBYTE SAB_STANDARD_S2_S3 1 100 0 1 ECU_ADDRESS 0xFFF95DA3 DISPLAY_IDENTIFIER f_TipMinusErr.CAN.TipTasterIn._.ZFFSAB /end MEASUREMENT
/begin MEASUREMENT ZFFSAB._.TipTasterIn.CAN.f_TipPlus "Output value for the manual upshift request" UBYTE SAB_STANDARD_S2_S3 1 100 0 2 ECU_ADDRESS 0xFFF95DA0 DISPLAY_IDENTIFIER f_TipPlus.CAN.TipTasterIn._.ZFFSAB /end MEASUREMENT
/begin MEASUREMENT ZFFSAB._.TipTasterIn.CAN.f_TipPlusErr "Output value mapped on to the outboxes. Error flag for manual upshift request of the selected source." UBYTE SAB_STANDARD_S2_S3 1 100 0 1 ECU_ADDRESS 0xFFF95DA2 DISPLAY_IDENTIFIER f_TipPlusErr.CAN.TipTasterIn._.ZFFSAB /end MEASUREMENT
/begin MEASUREMENT ZFFSAB._.TipTasterIn.CAN.iv_Tip "Binary encoded input value for the manual downshift and upshift request" UBYTE SAB_STANDARD_S2_S3 1 100 0 255 ECU_ADDRESS 0xFFF95D9E DISPLAY_IDENTIFIER iv_Tip.CAN.TipTasterIn._.ZFFSAB /end MEASUREMENT
/begin MEASUREMENT ZFFSAB._.TipTasterIn.CAN.iv_TipSts "Binary encoded Input value for status of the manual downshift and manual upshift request" UBYTE SAB_STANDARD_S2_S3 1 100 0 255 ECU_ADDRESS 0xFFF95D9F DISPLAY_IDENTIFIER iv_TipSts.CAN.TipTasterIn._.ZFFSAB /end MEASUREMENT
/begin MEASUREMENT ZFFSAB._.TipTasterIn.CAN.iv_f_TipMinus "Input value for the manual downshift request" UBYTE SAB_STANDARD_S2_S3 1 100 0 3 ECU_ADDRESS 0xFFF95D9A DISPLAY_IDENTIFIER iv_f_TipMinus.CAN.TipTasterIn._.ZFFSAB /end MEASUREMENT
/begin MEASUREMENT ZFFSAB._.TipTasterIn.CAN.iv_f_TipMinusSts "Input value for status of the manual downshift Request" UBYTE SAB_STANDARD_S2_S3 1 100 0 1 ECU_ADDRESS 0xFFF95D9C DISPLAY_IDENTIFIER iv_f_TipMinusSts.CAN.TipTasterIn._.ZFFSAB /end MEASUREMENT
/begin MEASUREMENT ZFFSAB._.TipTasterIn.CAN.iv_f_TipPlus "Input value for the manual upshift request" UBYTE SAB_STANDARD_S2_S3 1 100 0 3 ECU_ADDRESS 0xFFF95D9B DISPLAY_IDENTIFIER iv_f_TipPlus.CAN.TipTasterIn._.ZFFSAB /end MEASUREMENT
/begin MEASUREMENT ZFFSAB._.TipTasterIn.CAN.iv_f_TipPlusSts "Input value for status of the manual upshift Request" UBYTE SAB_STANDARD_S2_S3 1 100 0 1 ECU_ADDRESS 0xFFF95D9D DISPLAY_IDENTIFIER iv_f_TipPlusSts.CAN.TipTasterIn._.ZFFSAB /end MEASUREMENT
/begin MEASUREMENT ZFFSAB._.TipTasterIn.Out[0].f_TipMinus "intermediate value for the manual downshift request mapped on to the outbox1 and outbox2." UBYTE SAB_STANDARD_S2_S3 1 100 0 2 ECU_ADDRESS 0xFFF95D8B DISPLAY_IDENTIFIER f_TipMinus.Out[0].TipTasterIn._.ZFFSAB /end MEASUREMENT
/begin MEASUREMENT ZFFSAB._.TipTasterIn.Out[0].f_TipMinusErr "intermediate value mapped on to the outboxes. Error flag for manual downshift request" UBYTE SAB_STANDARD_S2_S3 1 100 0 1 ECU_ADDRESS 0xFFF95D8D DISPLAY_IDENTIFIER f_TipMinusErr.Out[0].TipTasterIn._.ZFFSAB /end MEASUREMENT
/begin MEASUREMENT ZFFSAB._.TipTasterIn.Out[0].f_TipPlus "intermediate value for the manual upshift request mapped on to the outbox1 and outbox2." UBYTE SAB_STANDARD_S2_S3 1 100 0 2 ECU_ADDRESS 0xFFF95D8A DISPLAY_IDENTIFIER f_TipPlus.Out[0].TipTasterIn._.ZFFSAB /end MEASUREMENT
/begin MEASUREMENT ZFFSAB._.TipTasterIn.Out[0].f_TipPlusErr "intermediate value mapped on to the outboxes. Error flag for manual upshift request" UBYTE SAB_STANDARD_S2_S3 1 100 0 1 ECU_ADDRESS 0xFFF95D8C DISPLAY_IDENTIFIER f_TipPlusErr.Out[0].TipTasterIn._.ZFFSAB /end MEASUREMENT
/begin MEASUREMENT ZFFSAB._.TipTasterIn.Out[0].sv_f_TipMinusErr "provided output value mapped on to the outboxes. Error flag for manual downshift request" UBYTE SAB_STANDARD_S2_S3 1 100 0 1 ECU_ADDRESS 0xFFF95D91 DISPLAY_IDENTIFIER sv_f_TipMinusErr.Out[0].TipTasterIn._.ZFFSAB /end MEASUREMENT
/begin MEASUREMENT ZFFSAB._.TipTasterIn.Out[0].sv_f_TipMinusRaw "provided output value for the manual downshift request mapped on to the outbox1 and outbox2." UBYTE SAB_STANDARD_S2_S3 1 100 0 2 ECU_ADDRESS 0xFFF95D8F DISPLAY_IDENTIFIER sv_f_TipMinusRaw.Out[0].TipTasterIn._.ZFFSAB /end MEASUREMENT
/begin MEASUREMENT ZFFSAB._.TipTasterIn.Out[0].sv_f_TipPlusErr "provided output value mapped on to the outboxes. Error flag for manual upshift request" UBYTE SAB_STANDARD_S2_S3 1 100 0 1 ECU_ADDRESS 0xFFF95D90 DISPLAY_IDENTIFIER sv_f_TipPlusErr.Out[0].TipTasterIn._.ZFFSAB /end MEASUREMENT
/begin MEASUREMENT ZFFSAB._.TipTasterIn.Out[0].sv_f_TipPlusRaw "provided output value for the manual upshift request mapped on to the outbox1 and outbox2." UBYTE SAB_STANDARD_S2_S3 1 100 0 2 ECU_ADDRESS 0xFFF95D8E DISPLAY_IDENTIFIER sv_f_TipPlusRaw.Out[0].TipTasterIn._.ZFFSAB /end MEASUREMENT
/begin MEASUREMENT ZFFSAB._.TipTasterIn.Out[1].f_TipMinus "intermediate value for the manual downshift request mapped on to the outbox1 and outbox2." UBYTE SAB_STANDARD_S2_S3 1 100 0 2 ECU_ADDRESS 0xFFF95D93 DISPLAY_IDENTIFIER f_TipMinus.Out[1].TipTasterIn._.ZFFSAB /end MEASUREMENT
/begin MEASUREMENT ZFFSAB._.TipTasterIn.Out[1].f_TipMinusErr "intermediate value mapped on to the outboxes. Error flag for manual downshift request" UBYTE SAB_STANDARD_S2_S3 1 100 0 1 ECU_ADDRESS 0xFFF95D95 DISPLAY_IDENTIFIER f_TipMinusErr.Out[1].TipTasterIn._.ZFFSAB /end MEASUREMENT
/begin MEASUREMENT ZFFSAB._.TipTasterIn.Out[1].f_TipPlus "intermediate value for the manual upshift request mapped on to the outbox1 and outbox2." UBYTE SAB_STANDARD_S2_S3 1 100 0 2 ECU_ADDRESS 0xFFF95D92 DISPLAY_IDENTIFIER f_TipPlus.Out[1].TipTasterIn._.ZFFSAB /end MEASUREMENT
/begin MEASUREMENT ZFFSAB._.TipTasterIn.Out[1].f_TipPlusErr "intermediate value mapped on to the outboxes. Error flag for manual upshift request" UBYTE SAB_STANDARD_S2_S3 1 100 0 1 ECU_ADDRESS 0xFFF95D94 DISPLAY_IDENTIFIER f_TipPlusErr.Out[1].TipTasterIn._.ZFFSAB /end MEASUREMENT
/begin MEASUREMENT ZFFSAB._.TipTasterIn.Out[1].sv_f_TipMinusErr "provided output value mapped on to the outboxes. Error flag for manual downshift request" UBYTE SAB_STANDARD_S2_S3 1 100 0 1 ECU_ADDRESS 0xFFF95D99 DISPLAY_IDENTIFIER sv_f_TipMinusErr.Out[1].TipTasterIn._.ZFFSAB /end MEASUREMENT
/begin MEASUREMENT ZFFSAB._.TipTasterIn.Out[1].sv_f_TipMinusRaw "provided output value for the manual downshift request mapped on to the outbox1 and outbox2." UBYTE SAB_STANDARD_S2_S3 1 100 0 2 ECU_ADDRESS 0xFFF95D97 DISPLAY_IDENTIFIER sv_f_TipMinusRaw.Out[1].TipTasterIn._.ZFFSAB /end MEASUREMENT
/begin MEASUREMENT ZFFSAB._.TipTasterIn.Out[1].sv_f_TipPlusErr "provided output value mapped on to the outboxes. Error flag for manual upshift request" UBYTE SAB_STANDARD_S2_S3 1 100 0 1 ECU_ADDRESS 0xFFF95D98 DISPLAY_IDENTIFIER sv_f_TipPlusErr.Out[1].TipTasterIn._.ZFFSAB /end MEASUREMENT
/begin MEASUREMENT ZFFSAB._.TipTasterIn.Out[1].sv_f_TipPlusRaw "provided output value for the manual upshift request mapped on to the outbox1 and outbox2." UBYTE SAB_STANDARD_S2_S3 1 100 0 2 ECU_ADDRESS 0xFFF95D96 DISPLAY_IDENTIFIER sv_f_TipPlusRaw.Out[1].TipTasterIn._.ZFFSAB /end MEASUREMENT
/begin MEASUREMENT ZFFSAB._.TipTasterIn.SBW.f_TipErr "Output value mapped on to the outboxes. Error flag for manual shift requests of the selected source." UBYTE SAB_STANDARD_S2_S3 1 100 0 1 ECU_ADDRESS 0xFFF95DAF DISPLAY_IDENTIFIER f_TipErr.SBW.TipTasterIn._.ZFFSAB /end MEASUREMENT
/begin MEASUREMENT ZFFSAB._.TipTasterIn.SBW.f_TipMinus "Output value for the manual downshift request" UBYTE SAB_STANDARD_S2_S3 1 100 0 2 ECU_ADDRESS 0xFFF95DAC DISPLAY_IDENTIFIER f_TipMinus.SBW.TipTasterIn._.ZFFSAB /end MEASUREMENT
/begin MEASUREMENT ZFFSAB._.TipTasterIn.SBW.f_TipMinusErr "Output value mapped on to the outboxes. Error flag for manual downshift request of the selected source." UBYTE SAB_STANDARD_S2_S3 1 100 0 1 ECU_ADDRESS 0xFFF95DAE DISPLAY_IDENTIFIER f_TipMinusErr.SBW.TipTasterIn._.ZFFSAB /end MEASUREMENT
/begin MEASUREMENT ZFFSAB._.TipTasterIn.SBW.f_TipPlus "Output value for the manual upshift request" UBYTE SAB_STANDARD_S2_S3 1 100 0 2 ECU_ADDRESS 0xFFF95DAB DISPLAY_IDENTIFIER f_TipPlus.SBW.TipTasterIn._.ZFFSAB /end MEASUREMENT
/begin MEASUREMENT ZFFSAB._.TipTasterIn.SBW.f_TipPlusErr "Output value mapped on to the outboxes. Error flag for manual upshift request of the selected source." UBYTE SAB_STANDARD_S2_S3 1 100 0 1 ECU_ADDRESS 0xFFF95DAD DISPLAY_IDENTIFIER f_TipPlusErr.SBW.TipTasterIn._.ZFFSAB /end MEASUREMENT
/begin MEASUREMENT ZFFSAB._.TipTasterIn.SBW.iv_Tip "Binary encoded input value for the manual downshift and upshift request" UBYTE SAB_STANDARD_S2_S3 1 100 0 255 ECU_ADDRESS 0xFFF95DA9 DISPLAY_IDENTIFIER iv_Tip.SBW.TipTasterIn._.ZFFSAB /end MEASUREMENT
/begin MEASUREMENT ZFFSAB._.TipTasterIn.SBW.iv_TipSts "Binary encoded Input value for status of the manual downshift and manual upshift request" UBYTE SAB_STANDARD_S2_S3 1 100 0 255 ECU_ADDRESS 0xFFF95DAA DISPLAY_IDENTIFIER iv_TipSts.SBW.TipTasterIn._.ZFFSAB /end MEASUREMENT
/begin MEASUREMENT ZFFSAB._.TipTasterIn.SBW.iv_f_TipMinus "Input value for the manual downshift request" UBYTE SAB_STANDARD_S2_S3 1 100 0 3 ECU_ADDRESS 0xFFF95DA5 DISPLAY_IDENTIFIER iv_f_TipMinus.SBW.TipTasterIn._.ZFFSAB /end MEASUREMENT
/begin MEASUREMENT ZFFSAB._.TipTasterIn.SBW.iv_f_TipMinusSts "Input value for status of the manual downshift Request" UBYTE SAB_STANDARD_S2_S3 1 100 0 1 ECU_ADDRESS 0xFFF95DA7 DISPLAY_IDENTIFIER iv_f_TipMinusSts.SBW.TipTasterIn._.ZFFSAB /end MEASUREMENT
/begin MEASUREMENT ZFFSAB._.TipTasterIn.SBW.iv_f_TipPlus "Input value for the manual upshift request" UBYTE SAB_STANDARD_S2_S3 1 100 0 3 ECU_ADDRESS 0xFFF95DA6 DISPLAY_IDENTIFIER iv_f_TipPlus.SBW.TipTasterIn._.ZFFSAB /end MEASUREMENT
/begin MEASUREMENT ZFFSAB._.TipTasterIn.SBW.iv_f_TipPlusSts "Input value for status of the manual upshift Request" UBYTE SAB_STANDARD_S2_S3 1 100 0 1 ECU_ADDRESS 0xFFF95DA8 DISPLAY_IDENTIFIER iv_f_TipPlusSts.SBW.TipTasterIn._.ZFFSAB /end MEASUREMENT
/begin MEASUREMENT ZFFSAB._.TipTasterIn.iv_u_Batt_Diag "Filtered battery voltage used for test conditions" UWORD SAB_U_VOLT1000_S2_S3 1 100 0 65.535 ECU_ADDRESS 0xFFF95D84 DISPLAY_IDENTIFIER iv_u_Batt_Diag.TipTasterIn._.ZFFSAB /end MEASUREMENT
/begin MEASUREMENT ZFFSAB._.TipTasterIn.sv_f_Tip1MinusRaw "provided output value for the manual downshift request" UBYTE SAB_STANDARD_S2_S3 1 100 0 1 ECU_ADDRESS 0xFFF95D87 DISPLAY_IDENTIFIER sv_f_Tip1MinusRaw.TipTasterIn._.ZFFSAB /end MEASUREMENT
/begin MEASUREMENT ZFFSAB._.TipTasterIn.sv_f_Tip1PlusRaw "provided output value for the manual upshift request" UBYTE SAB_STANDARD_S2_S3 1 100 0 1 ECU_ADDRESS 0xFFF95D86 DISPLAY_IDENTIFIER sv_f_Tip1PlusRaw.TipTasterIn._.ZFFSAB /end MEASUREMENT
/begin MEASUREMENT ZFFSAB._.TipTasterIn.sv_f_Tip2MinusRaw "provided output value for the manual downshift request" UBYTE SAB_STANDARD_S2_S3 1 100 0 1 ECU_ADDRESS 0xFFF95D89 DISPLAY_IDENTIFIER sv_f_Tip2MinusRaw.TipTasterIn._.ZFFSAB /end MEASUREMENT
/begin MEASUREMENT ZFFSAB._.TipTasterIn.sv_f_Tip2PlusRaw "provided output value for the manual upshift request" UBYTE SAB_STANDARD_S2_S3 1 100 0 1 ECU_ADDRESS 0xFFF95D88 DISPLAY_IDENTIFIER sv_f_Tip2PlusRaw.TipTasterIn._.ZFFSAB /end MEASUREMENT
/begin MEASUREMENT ZFFSAB._.TipTasterIn.tmr_AnalogPaddleDebounceFunction.time "Description for this variable only in SW documentation possible not in asap2" UBYTE SAB_T_TIMER_10MS_S2_S3 1 100 0 2550 ECU_ADDRESS 0xFFF95D81 DISPLAY_IDENTIFIER time.tmr_AnalogPaddleDebounceFunction.TipTasterIn._.ZFFSAB /end MEASUREMENT
/begin MEASUREMENT ZFFSAB._.TipTasterIn.tmr_AnalogPaddleLearnFunction.time "Description for this variable only in SW documentation possible not in asap2" UBYTE SAB_T_TIMER_10MS_S2_S3 1 100 0 2550 ECU_ADDRESS 0xFFF95D80 DISPLAY_IDENTIFIER time.tmr_AnalogPaddleLearnFunction.TipTasterIn._.ZFFSAB /end MEASUREMENT
/begin MEASUREMENT ZFFSAB._.TipTasterIn.tmr_CANPaddleAllowableReceived.time "Description for this variable only in SW documentation possible not in asap2" UWORD SAB_T_TIMER_10MS_S2_S3 1 100 0 655350 ECU_ADDRESS 0xFFF95D82 DISPLAY_IDENTIFIER time.tmr_CANPaddleAllowableReceived.TipTasterIn._.ZFFSAB /end MEASUREMENT
/begin MEASUREMENT ZFFSAB._.TorqueReserveIn.f_m_ReserveErr "Errorflag for torque reserve" UBYTE SAB_STANDARD_S2_S3 1 100 0 1 ECU_ADDRESS 0xFFF95ABC DISPLAY_IDENTIFIER f_m_ReserveErr.TorqueReserveIn._.ZFFSAB /end MEASUREMENT
/begin MEASUREMENT ZFFSAB._.TorqueReserveIn.iv_m_Reserve "Input value torque reserve from CAN" UWORD SAB_M_NM2_M2047_S2_S3 1 100 -1023.5 1023.5 ECU_ADDRESS 0xFFF95ABE DISPLAY_IDENTIFIER iv_m_Reserve.TorqueReserveIn._.ZFFSAB /end MEASUREMENT
/begin MEASUREMENT ZFFSAB._.TorqueReserveIn.iv_m_ReserveSts "Input value message status of torque reserve" UBYTE SAB_STANDARD_S2_S3 1 100 0 255 ECU_ADDRESS 0xFFF95AC0 DISPLAY_IDENTIFIER iv_m_ReserveSts.TorqueReserveIn._.ZFFSAB /end MEASUREMENT
/begin MEASUREMENT ZFFSAB._.TorqueReserveIn.sv_m_Reserve "Output value of torque reserve" SWORD SAB_M_1NM_S2_S3 1 100 -32768 32767 ECU_ADDRESS 0xFFF95AC2 DISPLAY_IDENTIFIER sv_m_Reserve.TorqueReserveIn._.ZFFSAB /end MEASUREMENT
/begin MEASUREMENT ZFFSAB._.TorqueReserveIn.sv_m_ReserveSts "Output value of signal status of torque reserve signal" UBYTE SAB_STANDARD_S2_S3 1 100 0 2 ECU_ADDRESS 0xFFF95AC4 DISPLAY_IDENTIFIER sv_m_ReserveSts.TorqueReserveIn._.ZFFSAB /end MEASUREMENT
/begin MEASUREMENT ZFFSAB._.TractionControlIn.f_EingriffTraktionErr "Error flag of EingriffTraktion-signal" UBYTE SAB_STANDARD_S2_S3 1 100 0 1 ECU_ADDRESS 0xFFF96D20 DISPLAY_IDENTIFIER f_EingriffTraktionErr.TractionControlIn._.ZFFSAB /end MEASUREMENT
/begin MEASUREMENT ZFFSAB._.TractionControlIn.iv_EingriffTraktion "Input raw signal Traction Control" UBYTE SAB_STANDARD_S2_S3 1 100 0 15 ECU_ADDRESS 0xFFF96D1C DISPLAY_IDENTIFIER iv_EingriffTraktion.TractionControlIn._.ZFFSAB /end MEASUREMENT
/begin MEASUREMENT ZFFSAB._.TractionControlIn.iv_EingriffTraktionSts "Input CAN message status Traction Control" UBYTE SAB_STANDARD_S2_S3 1 100 0 255 ECU_ADDRESS 0xFFF96D1D DISPLAY_IDENTIFIER iv_EingriffTraktionSts.TractionControlIn._.ZFFSAB /end MEASUREMENT
/begin MEASUREMENT ZFFSAB._.TractionControlIn.sv_AGS_EingriffTraktion "Output signal of Traction Control" UBYTE SAB_STANDARD_S2_S3 1 100 0 3 ECU_ADDRESS 0xFFF96D1E DISPLAY_IDENTIFIER sv_AGS_EingriffTraktion.TractionControlIn._.ZFFSAB /end MEASUREMENT
/begin MEASUREMENT ZFFSAB._.TractionControlIn.sv_EingriffTraktionSts "Output value signal status of Traction Control" UBYTE SAB_STANDARD_S2_S3 1 100 0 2 ECU_ADDRESS 0xFFF96D1F DISPLAY_IDENTIFIER sv_EingriffTraktionSts.TractionControlIn._.ZFFSAB /end MEASUREMENT
/begin MEASUREMENT ZFFSAB._.TransmissionOutputSpeedIn.Ab_f_DirectionErr "Error flag of the direction-detection" UBYTE SAB_STANDARD_S2_S3 1 100 0 1 ECU_ADDRESS 0xFFF8E0E4 DISPLAY_IDENTIFIER Ab_f_DirectionErr.TransmissionOutputSpeedIn._.ZFFSAB /end MEASUREMENT
/begin MEASUREMENT ZFFSAB._.TransmissionOutputSpeedIn.TransmissionOutputSpeedIn_Fl.f_n_AbPlausiErr "local variable for the transmission outputspeed value plausibility flag" FLOAT32_IEEE SAB_STANDARD_S2_S3 1 100 0 1 ECU_ADDRESS 0xFFF8E0AC FORMAT "%4.3" DISPLAY_IDENTIFIER f_n_AbPlausiErr.TransmissionOutputSpeedIn_Fl.TransmissionOutputSpeedIn._.ZFFSAB /end MEASUREMENT
/begin MEASUREMENT ZFFSAB._.TransmissionOutputSpeedIn.TransmissionOutputSpeedIn_Fl.f_n_AbWheelErr "local variable for f_n_AbWheelErr from GearRatioByCurrentsAT" FLOAT32_IEEE SAB_STANDARD_S2_S3 1 100 0 4294967295 ECU_ADDRESS 0xFFF8E0A4 FORMAT "%4.3" DISPLAY_IDENTIFIER f_n_AbWheelErr.TransmissionOutputSpeedIn_Fl.TransmissionOutputSpeedIn._.ZFFSAB /end MEASUREMENT
/begin MEASUREMENT ZFFSAB._.TransmissionOutputSpeedIn.TransmissionOutputSpeedIn_Fl.f_n_WheelPlausiErr "local variable for Wheel plausibility flag from module GearRatioByCurrents" FLOAT32_IEEE SAB_STANDARD_S2_S3 1 100 0 1 ECU_ADDRESS 0xFFF8E0B0 FORMAT "%4.3" DISPLAY_IDENTIFIER f_n_WheelPlausiErr.TransmissionOutputSpeedIn_Fl.TransmissionOutputSpeedIn._.ZFFSAB /end MEASUREMENT
/begin MEASUREMENT ZFFSAB._.TransmissionOutputSpeedIn.TransmissionOutputSpeedIn_Fl.iGang "local variable to check if transmission is in a gear or not" FLOAT32_IEEE SAB_STANDARD_S2_S3 1 100 0 4294967295 ECU_ADDRESS 0xFFF8E0A0 FORMAT "%4.3" DISPLAY_IDENTIFIER iGang.TransmissionOutputSpeedIn_Fl.TransmissionOutputSpeedIn._.ZFFSAB /end MEASUREMENT
/begin MEASUREMENT ZFFSAB._.TransmissionOutputSpeedIn.TransmissionOutputSpeedIn_Fl.iv_n_Ab "Input signal from RPM_Sensing GetImV_n_Ab" FLOAT32_IEEE SAB_N_1RPM_S2_S3 1 100 0 65535 ECU_ADDRESS 0xFFF8E070 FORMAT "%4.3" DISPLAY_IDENTIFIER iv_n_Ab.TransmissionOutputSpeedIn_Fl.TransmissionOutputSpeedIn._.ZFFSAB /end MEASUREMENT
/begin MEASUREMENT ZFFSAB._.TransmissionOutputSpeedIn.TransmissionOutputSpeedIn_Fl.iv_n_AbESts "Status of Input signal from RPM_Sensing GetImV_n_AbSts" FLOAT32_IEEE SAB_STANDARD_S2_S3 1 100 0 2 ECU_ADDRESS 0xFFF8E074 FORMAT "%4.3" DISPLAY_IDENTIFIER iv_n_AbESts.TransmissionOutputSpeedIn_Fl.TransmissionOutputSpeedIn._.ZFFSAB /end MEASUREMENT
/begin MEASUREMENT ZFFSAB._.TransmissionOutputSpeedIn.TransmissionOutputSpeedIn_Fl.iv_n_AbESts_ "Status of Input signal from RPM_Sensing GetImV_n_AbSts complement" FLOAT32_IEEE SAB_STANDARD_S2_S3 1 100 0 1 ECU_ADDRESS 0xFFF8E07C FORMAT "%4.3" DISPLAY_IDENTIFIER iv_n_AbESts_.TransmissionOutputSpeedIn_Fl.TransmissionOutputSpeedIn._.ZFFSAB /end MEASUREMENT
/begin MEASUREMENT ZFFSAB._.TransmissionOutputSpeedIn.TransmissionOutputSpeedIn_Fl.iv_n_Ab_ "Input signal from RPM_Sensing GetImV_n_Ab complement" FLOAT32_IEEE SAB_N_1RPM_S2_S3 1 100 0 65535 ECU_ADDRESS 0xFFF8E078 FORMAT "%4.3" DISPLAY_IDENTIFIER iv_n_Ab_.TransmissionOutputSpeedIn_Fl.TransmissionOutputSpeedIn._.ZFFSAB /end MEASUREMENT
/begin MEASUREMENT ZFFSAB._.TransmissionOutputSpeedIn.TransmissionOutputSpeedIn_Fl.iv_u_SensESts "voltage sensor status" FLOAT32_IEEE SAB_STANDARD_S2_S3 1 100 0 255 ECU_ADDRESS 0xFFF8E080 FORMAT "%4.3" DISPLAY_IDENTIFIER iv_u_SensESts.TransmissionOutputSpeedIn_Fl.TransmissionOutputSpeedIn._.ZFFSAB /end MEASUREMENT
/begin MEASUREMENT ZFFSAB._.TransmissionOutputSpeedIn.TransmissionOutputSpeedIn_Fl.iv_u_SensESts_ "voltage sensor status" FLOAT32_IEEE SAB_STANDARD_S2_S3 1 100 0 255 ECU_ADDRESS 0xFFF8E084 FORMAT "%4.3" DISPLAY_IDENTIFIER iv_u_SensESts_.TransmissionOutputSpeedIn_Fl.TransmissionOutputSpeedIn._.ZFFSAB /end MEASUREMENT
/begin MEASUREMENT ZFFSAB._.TransmissionOutputSpeedIn.TransmissionOutputSpeedIn_Fl.loc_RearAxleRatio "Output signal from module RearAxleRatioIn" FLOAT32_IEEE SAB_K100_S2_S3 1 100 0 655.35 ECU_ADDRESS 0xFFF8E098 DISPLAY_IDENTIFIER loc_RearAxleRatio.TransmissionOutputSpeedIn_Fl.TransmissionOutputSpeedIn._.ZFFSAB /end MEASUREMENT
/begin MEASUREMENT ZFFSAB._.TransmissionOutputSpeedIn.TransmissionOutputSpeedIn_Fl.n_AbByNWheel "calculated n_ab value by wheel rpm" FLOAT32_IEEE SAB_N_1RPM_S2_S3 1 100 0 65535 ECU_ADDRESS 0xFFF8E0A8 FORMAT "%4.3" DISPLAY_IDENTIFIER n_AbByNWheel.TransmissionOutputSpeedIn_Fl.TransmissionOutputSpeedIn._.ZFFSAB /end MEASUREMENT
/begin MEASUREMENT ZFFSAB._.TransmissionOutputSpeedIn.TransmissionOutputSpeedIn_Fl.n_WheelAvg "Average Wheel rpm of all driven wheels" FLOAT32_IEEE SAB_N_RPM100_S2_S3 1 100 0 42949672.95 ECU_ADDRESS 0xFFF8E0B4 DISPLAY_IDENTIFIER n_WheelAvg.TransmissionOutputSpeedIn_Fl.TransmissionOutputSpeedIn._.ZFFSAB /end MEASUREMENT
/begin MEASUREMENT ZFFSAB._.TransmissionOutputSpeedIn.TransmissionOutputSpeedIn_Fl.n_WheelAvgSts "Status of average Wheel rpm derived from driven wheels" FLOAT32_IEEE SAB_STANDARD_S2_S3 1 100 0 2 ECU_ADDRESS 0xFFF8E0B8 FORMAT "%4.3" DISPLAY_IDENTIFIER n_WheelAvgSts.TransmissionOutputSpeedIn_Fl.TransmissionOutputSpeedIn._.ZFFSAB /end MEASUREMENT
/begin MEASUREMENT ZFFSAB._.TransmissionOutputSpeedIn.TransmissionOutputSpeedIn_Fl.sv_n_Ab "Output signal of transmission output speed" FLOAT32_IEEE SAB_N_1RPM_S2_S3 1 100 0 65535 ECU_ADDRESS 0xFFF8E088 FORMAT "%4.3" DISPLAY_IDENTIFIER sv_n_Ab.TransmissionOutputSpeedIn_Fl.TransmissionOutputSpeedIn._.ZFFSAB /end MEASUREMENT
/begin MEASUREMENT ZFFSAB._.TransmissionOutputSpeedIn.TransmissionOutputSpeedIn_Fl.sv_n_AbMax "Output signal of MAX selection between sv_n_Ab and n_AbByNWheel" FLOAT32_IEEE SAB_N_1RPM_S2_S3 1 100 0 65535 ECU_ADDRESS 0xFFF8E090 FORMAT "%4.3" DISPLAY_IDENTIFIER sv_n_AbMax.TransmissionOutputSpeedIn_Fl.TransmissionOutputSpeedIn._.ZFFSAB /end MEASUREMENT
/begin MEASUREMENT ZFFSAB._.TransmissionOutputSpeedIn.TransmissionOutputSpeedIn_Fl.sv_n_AbMaxSts "Stauts signal of MAX selection between sv_n_Ab and n_AbByNWheel" FLOAT32_IEEE SAB_STANDARD_S2_S3 1 100 0 2 ECU_ADDRESS 0xFFF8E094 FORMAT "%4.3" DISPLAY_IDENTIFIER sv_n_AbMaxSts.TransmissionOutputSpeedIn_Fl.TransmissionOutputSpeedIn._.ZFFSAB /end MEASUREMENT
/begin MEASUREMENT ZFFSAB._.TransmissionOutputSpeedIn.TransmissionOutputSpeedIn_Fl.sv_n_AbSts "Output signal of Transmission Output Speed" FLOAT32_IEEE SAB_STANDARD_S2_S3 1 100 0 2 ECU_ADDRESS 0xFFF8E08C FORMAT "%4.3" DISPLAY_IDENTIFIER sv_n_AbSts.TransmissionOutputSpeedIn_Fl.TransmissionOutputSpeedIn._.ZFFSAB /end MEASUREMENT
/begin MEASUREMENT ZFFSAB._.TransmissionOutputSpeedIn.TransmissionOutputSpeedIn_Fl.tmr_DelayNAbMaxCalc.time "Description for this variable only in SW documentation possible not in asap2" ULONG SAB_T_TIMER_5MS_S2_S3 1 100 0 21474836475 ECU_ADDRESS 0xFFF8E068 DISPLAY_IDENTIFIER time.tmr_DelayNAbMaxCalc.TransmissionOutputSpeedIn_Fl.TransmissionOutputSpeedIn._.ZFFSAB /end MEASUREMENT
/begin MEASUREMENT ZFFSAB._.TransmissionOutputSpeedIn.TransmissionOutputSpeedIn_Fl.tmr_DelayNAbMaxCalc.time_ "Description for this variable only in SW documentation possible not in asap2" ULONG SAB_T_TIMER_5MS_S2_S3 1 100 0 21474836475 ECU_ADDRESS 0xFFF8E06C DISPLAY_IDENTIFIER time_.tmr_DelayNAbMaxCalc.TransmissionOutputSpeedIn_Fl.TransmissionOutputSpeedIn._.ZFFSAB /end MEASUREMENT
/begin MEASUREMENT ZFFSAB._.TransmissionOutputSpeedIn.f_n_AbPlausiErr "local variable for the transmission outputspeed value plausibility flag" UBYTE SAB_STANDARD_S2_S3 1 100 0 1 ECU_ADDRESS 0xFFF8E0F2 DISPLAY_IDENTIFIER f_n_AbPlausiErr.TransmissionOutputSpeedIn._.ZFFSAB /end MEASUREMENT
/begin MEASUREMENT ZFFSAB._.TransmissionOutputSpeedIn.f_n_AbPlausiErr_ "local variable for the transmission outputspeed value plausibility flag complement" UBYTE SAB_STANDARD_S2_S3 1 100 0 1 ECU_ADDRESS 0xFFF8E0F3 DISPLAY_IDENTIFIER f_n_AbPlausiErr_.TransmissionOutputSpeedIn._.ZFFSAB /end MEASUREMENT
/begin MEASUREMENT ZFFSAB._.TransmissionOutputSpeedIn.f_n_AbWheelErr "local variable for f_n_AbWheelErr from GearRatioByCurrentsAT" UBYTE SAB_STANDARD_S2_S3 1 100 0 255 ECU_ADDRESS 0xFFF8E102 DISPLAY_IDENTIFIER f_n_AbWheelErr.TransmissionOutputSpeedIn._.ZFFSAB /end MEASUREMENT
/begin MEASUREMENT ZFFSAB._.TransmissionOutputSpeedIn.f_n_WheelPlausiErr "local variable for Wheel plausibility flag from module GearRatioByCurrents" UBYTE SAB_STANDARD_S2_S3 1 100 0 1 ECU_ADDRESS 0xFFF8E0F4 DISPLAY_IDENTIFIER f_n_WheelPlausiErr.TransmissionOutputSpeedIn._.ZFFSAB /end MEASUREMENT
/begin MEASUREMENT ZFFSAB._.TransmissionOutputSpeedIn.iGang "local variable to check if transmission is in a gear or not" UWORD SAB_STANDARD_S2_S3 1 100 0 65535 ECU_ADDRESS 0xFFF8E100 DISPLAY_IDENTIFIER iGang.TransmissionOutputSpeedIn._.ZFFSAB /end MEASUREMENT
/begin MEASUREMENT ZFFSAB._.TransmissionOutputSpeedIn.iv_n_Ab "Input signal from RPM_Sensing GetImV_n_Ab" UWORD SAB_N_1RPM_S2_S3 1 100 0 65535 ECU_ADDRESS 0xFFF8E0E6 DISPLAY_IDENTIFIER iv_n_Ab.TransmissionOutputSpeedIn._.ZFFSAB /end MEASUREMENT
/begin MEASUREMENT ZFFSAB._.TransmissionOutputSpeedIn.iv_n_AbESts "Status of Input signal from RPM_Sensing GetImV_n_AbSts" UBYTE SAB_STANDARD_S2_S3 1 100 0 2 ECU_ADDRESS 0xFFF8E0E8 DISPLAY_IDENTIFIER iv_n_AbESts.TransmissionOutputSpeedIn._.ZFFSAB /end MEASUREMENT
/begin MEASUREMENT ZFFSAB._.TransmissionOutputSpeedIn.iv_n_AbESts_ "Status of Input signal from RPM_Sensing GetImV_n_AbSts complement" UBYTE SAB_STANDARD_S2_S3 1 100 0 1 ECU_ADDRESS 0xFFF8E0EC DISPLAY_IDENTIFIER iv_n_AbESts_.TransmissionOutputSpeedIn._.ZFFSAB /end MEASUREMENT
/begin MEASUREMENT ZFFSAB._.TransmissionOutputSpeedIn.iv_n_Ab_ "Input signal from RPM_Sensing GetImV_n_Ab complement" UWORD SAB_N_1RPM_S2_S3 1 100 0 65535 ECU_ADDRESS 0xFFF8E0EA DISPLAY_IDENTIFIER iv_n_Ab_.TransmissionOutputSpeedIn._.ZFFSAB /end MEASUREMENT
/begin MEASUREMENT ZFFSAB._.TransmissionOutputSpeedIn.iv_u_SensESts "state of iv_PSens1" UBYTE SAB_STANDARD_S2_S3 1 100 0 255 ECU_ADDRESS 0xFFF8E0D0 DISPLAY_IDENTIFIER iv_u_SensESts.TransmissionOutputSpeedIn._.ZFFSAB /end MEASUREMENT
/begin MEASUREMENT ZFFSAB._.TransmissionOutputSpeedIn.iv_u_SensESts_ "state of iv_PSens1 complement" UBYTE SAB_STANDARD_S2_S3 1 100 0 255 ECU_ADDRESS 0xFFF8E0D1 DISPLAY_IDENTIFIER iv_u_SensESts_.TransmissionOutputSpeedIn._.ZFFSAB /end MEASUREMENT
/begin MEASUREMENT ZFFSAB._.TransmissionOutputSpeedIn.loc_RearAxleRatio "Output signal from module RearAxleRatioIn" UWORD SAB_K100_S2_S3 1 100 0 655.35 ECU_ADDRESS 0xFFF8E0F0 DISPLAY_IDENTIFIER loc_RearAxleRatio.TransmissionOutputSpeedIn._.ZFFSAB /end MEASUREMENT
/begin MEASUREMENT ZFFSAB._.TransmissionOutputSpeedIn.n_AbByNWheel "calculated n_ab value by wheel rpm" UWORD SAB_N_1RPM_S2_S3 1 100 0 65535 ECU_ADDRESS 0xFFF8E0EE DISPLAY_IDENTIFIER n_AbByNWheel.TransmissionOutputSpeedIn._.ZFFSAB /end MEASUREMENT
/begin MEASUREMENT ZFFSAB._.TransmissionOutputSpeedIn.n_AbFilt_CAN "filtered signal derived from iv_n_Ab" UWORD SAB_N_1RPM_S2_S3 1 100 0 65535 ECU_ADDRESS 0xFFF8E104 DISPLAY_IDENTIFIER n_AbFilt_CAN.TransmissionOutputSpeedIn._.ZFFSAB /end MEASUREMENT
/begin MEASUREMENT ZFFSAB._.TransmissionOutputSpeedIn.n_AbFilt_CAN_ "filtered signal derived from iv_n_Ab_ complement" UWORD SAB_N_1RPM_S2_S3 1 100 0 65535 ECU_ADDRESS 0xFFF8E106 DISPLAY_IDENTIFIER n_AbFilt_CAN_.TransmissionOutputSpeedIn._.ZFFSAB /end MEASUREMENT
/begin MEASUREMENT ZFFSAB._.TransmissionOutputSpeedIn.n_WheelAvg "Average Wheel rpm of all driven wheels" ULONG SAB_N_RPM100_S2_S3 1 100 0 42949672.95 ECU_ADDRESS 0xFFF8E0F8 DISPLAY_IDENTIFIER n_WheelAvg.TransmissionOutputSpeedIn._.ZFFSAB /end MEASUREMENT
/begin MEASUREMENT ZFFSAB._.TransmissionOutputSpeedIn.n_WheelAvgSts "Status of average Wheel rpm derived from driven wheels" UBYTE SAB_STANDARD_S2_S3 1 100 0 2 ECU_ADDRESS 0xFFF8E0FC DISPLAY_IDENTIFIER n_WheelAvgSts.TransmissionOutputSpeedIn._.ZFFSAB /end MEASUREMENT
/begin MEASUREMENT ZFFSAB._.TransmissionOutputSpeedIn.sv_n_Ab "Output signal of transmission output speed" UWORD SAB_N_1RPM_S2_S3 1 100 0 65535 ECU_ADDRESS 0xFFF8E0D2 DISPLAY_IDENTIFIER sv_n_Ab.TransmissionOutputSpeedIn._.ZFFSAB /end MEASUREMENT
/begin MEASUREMENT ZFFSAB._.TransmissionOutputSpeedIn.sv_n_AbFilt "Output value for filtered n_Ab" UWORD SAB_N_1RPM_S2_S3 1 100 0 65535 ECU_ADDRESS 0xFFF8E0DA DISPLAY_IDENTIFIER sv_n_AbFilt.TransmissionOutputSpeedIn._.ZFFSAB /end MEASUREMENT
/begin MEASUREMENT ZFFSAB._.TransmissionOutputSpeedIn.sv_n_AbMax "Output signal of the max selection between n_Ab and n_WheelAvg" UWORD SAB_N_1RPM_S2_S3 1 100 0 65535 ECU_ADDRESS 0xFFF8E0DE DISPLAY_IDENTIFIER sv_n_AbMax.TransmissionOutputSpeedIn._.ZFFSAB /end MEASUREMENT
/begin MEASUREMENT ZFFSAB._.TransmissionOutputSpeedIn.sv_n_AbMaxSts "Output signal of the max selection status" UBYTE SAB_STANDARD_S2_S3 1 100 0 2 ECU_ADDRESS 0xFFF8E0E2 DISPLAY_IDENTIFIER sv_n_AbMaxSts.TransmissionOutputSpeedIn._.ZFFSAB /end MEASUREMENT
/begin MEASUREMENT ZFFSAB._.TransmissionOutputSpeedIn.sv_n_AbMaxSts_ "Output signal of the max selection status" UBYTE SAB_STANDARD_S2_S3 1 100 0 2 ECU_ADDRESS 0xFFF8E0E3 DISPLAY_IDENTIFIER sv_n_AbMaxSts_.TransmissionOutputSpeedIn._.ZFFSAB /end MEASUREMENT
/begin MEASUREMENT ZFFSAB._.TransmissionOutputSpeedIn.sv_n_AbMax_ "Output signal of the max selection between n_Ab and n_WheelAvg" UWORD SAB_N_1RPM_S2_S3 1 100 0 65535 ECU_ADDRESS 0xFFF8E0E0 DISPLAY_IDENTIFIER sv_n_AbMax_.TransmissionOutputSpeedIn._.ZFFSAB /end MEASUREMENT
/begin MEASUREMENT ZFFSAB._.TransmissionOutputSpeedIn.sv_n_AbSts "Output signal of Transmission Output Speed" UBYTE SAB_STANDARD_S2_S3 1 100 0 2 ECU_ADDRESS 0xFFF8E0DC DISPLAY_IDENTIFIER sv_n_AbSts.TransmissionOutputSpeedIn._.ZFFSAB /end MEASUREMENT
/begin MEASUREMENT ZFFSAB._.TransmissionOutputSpeedIn.sv_n_AbSts_ "Output signal of Transmission Output Speed" UBYTE SAB_STANDARD_S2_S3 1 100 0 2 ECU_ADDRESS 0xFFF8E0DD DISPLAY_IDENTIFIER sv_n_AbSts_.TransmissionOutputSpeedIn._.ZFFSAB /end MEASUREMENT
/begin MEASUREMENT ZFFSAB._.TransmissionOutputSpeedIn.sv_n_Ab_ "Output signal of transmission outputspeed complement" UWORD SAB_N_1RPM_S2_S3 1 100 0 65535 ECU_ADDRESS 0xFFF8E0D4 DISPLAY_IDENTIFIER sv_n_Ab_.TransmissionOutputSpeedIn._.ZFFSAB /end MEASUREMENT
/begin MEASUREMENT ZFFSAB._.TransmissionOutputSpeedIn.sv_n_Ab_Tx "Output value for n_Ab to CAN" UWORD SAB_N_RPM_M2000_S2_S3 1 100 -2000 63535 ECU_ADDRESS 0xFFF8E0D6 DISPLAY_IDENTIFIER sv_n_Ab_Tx.TransmissionOutputSpeedIn._.ZFFSAB /end MEASUREMENT
/begin MEASUREMENT ZFFSAB._.TransmissionOutputSpeedIn.sv_n_Ab_Tx_ "Output value for n_Ab to CAN" UWORD SAB_STANDARD_S2_S3 1 100 0 65535 ECU_ADDRESS 0xFFF8E0D8 DISPLAY_IDENTIFIER sv_n_Ab_Tx_.TransmissionOutputSpeedIn._.ZFFSAB /end MEASUREMENT
/begin MEASUREMENT ZFFSAB._.TransmissionOutputSpeedIn.tmr_DelayNAbMaxCalc.time "Description for this variable only in SW documentation possible not in asap2" ULONG SAB_T_TIMER_5MS_S2_S3 1 100 0 21474836475 ECU_ADDRESS 0xFFF8E0C8 DISPLAY_IDENTIFIER time.tmr_DelayNAbMaxCalc.TransmissionOutputSpeedIn._.ZFFSAB /end MEASUREMENT
/begin MEASUREMENT ZFFSAB._.TransmissionOutputSpeedIn.tmr_DelayNAbMaxCalc.time_ "Description for this variable only in SW documentation possible not in asap2" ULONG SAB_T_TIMER_5MS_S2_S3 1 100 0 21474836475 ECU_ADDRESS 0xFFF8E0CC DISPLAY_IDENTIFIER time_.tmr_DelayNAbMaxCalc.TransmissionOutputSpeedIn._.ZFFSAB /end MEASUREMENT
/begin MEASUREMENT ZFFSAB._.TransmissionOutputSpeedIn.tmr_nAbFiltAktiv.time "Description for this variable only in SW documentation possible not in asap2" ULONG SAB_T_TIMER_10MS_S2_S3 1 100 0 42949672950 ECU_ADDRESS 0xFFF8E0C0 DISPLAY_IDENTIFIER time.tmr_nAbFiltAktiv.TransmissionOutputSpeedIn._.ZFFSAB /end MEASUREMENT
/begin MEASUREMENT ZFFSAB._.TransmissionOutputSpeedIn.tmr_nAbFiltAktiv.time_ "Description for this variable only in SW documentation possible not in asap2" ULONG SAB_T_TIMER_10MS_S2_S3 1 100 0 42949672950 ECU_ADDRESS 0xFFF8E0C4 DISPLAY_IDENTIFIER time_.tmr_nAbFiltAktiv.TransmissionOutputSpeedIn._.ZFFSAB /end MEASUREMENT
/begin MEASUREMENT ZFFSAB._.TurbineSpeedIn.Ab_sts_DirectionDiag "local variable for the Transmission DirectionDiag State from RPM_Sensing" UBYTE SAB_STANDARD_S2_S3 1 100 0 5 ECU_ADDRESS 0xFFF8E1AA DISPLAY_IDENTIFIER Ab_sts_DirectionDiag.TurbineSpeedIn._.ZFFSAB /end MEASUREMENT
/begin MEASUREMENT ZFFSAB._.TurbineSpeedIn.Tu_f_DirectionErr "Error flag of the direction-detection" UBYTE SAB_STANDARD_S2_S3 1 100 0 1 ECU_ADDRESS 0xFFF8E194 DISPLAY_IDENTIFIER Tu_f_DirectionErr.TurbineSpeedIn._.ZFFSAB /end MEASUREMENT
/begin MEASUREMENT ZFFSAB._.TurbineSpeedIn.Tu_sts_DirectionDiag "local variable for the Turbine or N6 DirectionDiag State from RPM_Sensing" UBYTE SAB_STANDARD_S2_S3 1 100 0 5 ECU_ADDRESS 0xFFF8E1A9 DISPLAY_IDENTIFIER Tu_sts_DirectionDiag.TurbineSpeedIn._.ZFFSAB /end MEASUREMENT
/begin MEASUREMENT ZFFSAB._.TurbineSpeedIn.TurbineSpeedIn_Fl.Tu_f_DirectionErr "Error flag of the direction-detection" FLOAT32_IEEE SAB_STANDARD_S2_S3 1 100 0 1 ECU_ADDRESS 0xFFF8E12C FORMAT "%4.3" DISPLAY_IDENTIFIER Tu_f_DirectionErr.TurbineSpeedIn_Fl.TurbineSpeedIn._.ZFFSAB /end MEASUREMENT
/begin MEASUREMENT ZFFSAB._.TurbineSpeedIn.TurbineSpeedIn_Fl.f_OverallPlausiState "local variable for a overall state consisting of iv_u_SensESts sv_n_EngSts sv_PSensSts f_n_TuVirtPlausiErr f_n_TuPlausiErr f_n_AbPlausiErr f_n_TuPlausiErr_active 0=all valid 1= at least one faulty" FLOAT32_IEEE SAB_STANDARD_S2_S3 1 100 0 1 ECU_ADDRESS 0xFFF8E138 FORMAT "%4.3" DISPLAY_IDENTIFIER f_OverallPlausiState.TurbineSpeedIn_Fl.TurbineSpeedIn._.ZFFSAB /end MEASUREMENT
/begin MEASUREMENT ZFFSAB._.TurbineSpeedIn.TurbineSpeedIn_Fl.f_n_TuPlausiErr "local variable for the turbinespeed value plausibility flag" FLOAT32_IEEE SAB_STANDARD_S2_S3 1 100 0 1 ECU_ADDRESS 0xFFF8E134 FORMAT "%4.3" DISPLAY_IDENTIFIER f_n_TuPlausiErr.TurbineSpeedIn_Fl.TurbineSpeedIn._.ZFFSAB /end MEASUREMENT
/begin MEASUREMENT ZFFSAB._.TurbineSpeedIn.TurbineSpeedIn_Fl.f_n_Tu_PlausiErr_active "variable contains the information if KFC_NTUPLAUSILEV2 is active or not" FLOAT32_IEEE SAB_STANDARD_S2_S3 1 100 0 1 ECU_ADDRESS 0xFFF8E144 FORMAT "%4.3" DISPLAY_IDENTIFIER f_n_Tu_PlausiErr_active.TurbineSpeedIn_Fl.TurbineSpeedIn._.ZFFSAB /end MEASUREMENT
/begin MEASUREMENT ZFFSAB._.TurbineSpeedIn.TurbineSpeedIn_Fl.f_n_Tu_PlausiErr_active_ "variable contains the information if KFC_NTUPLAUSILEV2 is active or not (complement)" FLOAT32_IEEE SAB_STANDARD_S2_S3 1 100 0 255 ECU_ADDRESS 0xFFF8E148 FORMAT "%4.3" DISPLAY_IDENTIFIER f_n_Tu_PlausiErr_active_.TurbineSpeedIn_Fl.TurbineSpeedIn._.ZFFSAB /end MEASUREMENT
/begin MEASUREMENT ZFFSAB._.TurbineSpeedIn.TurbineSpeedIn_Fl.iv_n_Tu "Input value turbine Speed" FLOAT32_IEEE SAB_N_1RPM_S2_S3 1 100 0 65535 ECU_ADDRESS 0xFFF8E118 FORMAT "%4.3" DISPLAY_IDENTIFIER iv_n_Tu.TurbineSpeedIn_Fl.TurbineSpeedIn._.ZFFSAB /end MEASUREMENT
/begin MEASUREMENT ZFFSAB._.TurbineSpeedIn.TurbineSpeedIn_Fl.iv_n_TuESts "Input CAN message status for turbine" FLOAT32_IEEE SAB_STANDARD_S2_S3 1 100 0 2 ECU_ADDRESS 0xFFF8E11C FORMAT "%4.3" DISPLAY_IDENTIFIER iv_n_TuESts.TurbineSpeedIn_Fl.TurbineSpeedIn._.ZFFSAB /end MEASUREMENT
/begin MEASUREMENT ZFFSAB._.TurbineSpeedIn.TurbineSpeedIn_Fl.iv_n_TuESts_ "Input CAN message status for turbine complement" FLOAT32_IEEE SAB_STANDARD_S2_S3 1 100 0 2 ECU_ADDRESS 0xFFF8E124 FORMAT "%4.3" DISPLAY_IDENTIFIER iv_n_TuESts_.TurbineSpeedIn_Fl.TurbineSpeedIn._.ZFFSAB /end MEASUREMENT
/begin MEASUREMENT ZFFSAB._.TurbineSpeedIn.TurbineSpeedIn_Fl.iv_n_Tu_ "Input value turbine Speed complement" FLOAT32_IEEE SAB_N_1RPM_S2_S3 1 100 0 65535 ECU_ADDRESS 0xFFF8E120 FORMAT "%4.3" DISPLAY_IDENTIFIER iv_n_Tu_.TurbineSpeedIn_Fl.TurbineSpeedIn._.ZFFSAB /end MEASUREMENT
/begin MEASUREMENT ZFFSAB._.TurbineSpeedIn.TurbineSpeedIn_Fl.iv_u_SensESts "state of iv_PSens1" FLOAT32_IEEE SAB_STANDARD_S2_S3 1 100 0 4294967295 ECU_ADDRESS 0xFFF8E110 FORMAT "%4.3" DISPLAY_IDENTIFIER iv_u_SensESts.TurbineSpeedIn_Fl.TurbineSpeedIn._.ZFFSAB /end MEASUREMENT
/begin MEASUREMENT ZFFSAB._.TurbineSpeedIn.TurbineSpeedIn_Fl.iv_u_SensESts_ "state of iv_PSens1 complement" FLOAT32_IEEE SAB_STANDARD_S2_S3 1 100 0 4294967295 ECU_ADDRESS 0xFFF8E10C FORMAT "%4.3" DISPLAY_IDENTIFIER iv_u_SensESts_.TurbineSpeedIn_Fl.TurbineSpeedIn._.ZFFSAB /end MEASUREMENT
/begin MEASUREMENT ZFFSAB._.TurbineSpeedIn.TurbineSpeedIn_Fl.n_EngLev2TSI "local variable for the engine speed substitute value" FLOAT32_IEEE SAB_STANDARD_S2_S3 1 100 0 65535 ECU_ADDRESS 0xFFF8E13C FORMAT "%4.3" DISPLAY_IDENTIFIER n_EngLev2TSI.TurbineSpeedIn_Fl.TurbineSpeedIn._.ZFFSAB /end MEASUREMENT
/begin MEASUREMENT ZFFSAB._.TurbineSpeedIn.TurbineSpeedIn_Fl.n_EngLev2TSISts "local variable for the engine speed status substitute value" FLOAT32_IEEE SAB_STANDARD_S2_S3 1 100 0 2 ECU_ADDRESS 0xFFF8E140 FORMAT "%4.3" DISPLAY_IDENTIFIER n_EngLev2TSISts.TurbineSpeedIn_Fl.TurbineSpeedIn._.ZFFSAB /end MEASUREMENT
/begin MEASUREMENT ZFFSAB._.TurbineSpeedIn.TurbineSpeedIn_Fl.n_Tu_Filt2 "filtered value turbine speed for CAN output" FLOAT32_IEEE SAB_N_1RPM_S2_S3 1 100 0 4294967295 ECU_ADDRESS 0xFFF8E128 FORMAT "%4.3" DISPLAY_IDENTIFIER n_Tu_Filt2.TurbineSpeedIn_Fl.TurbineSpeedIn._.ZFFSAB /end MEASUREMENT
/begin MEASUREMENT ZFFSAB._.TurbineSpeedIn.TurbineSpeedIn_Fl.n_Tu_Filt_CAN "filtered value turbine speed for CAN output after CAN-Init filter" FLOAT32_IEEE SAB_N_1RPM_S2_S3 1 100 0 4294967295 ECU_ADDRESS 0xFFF8E130 FORMAT "%4.3" DISPLAY_IDENTIFIER n_Tu_Filt_CAN.TurbineSpeedIn_Fl.TurbineSpeedIn._.ZFFSAB /end MEASUREMENT
/begin MEASUREMENT ZFFSAB._.TurbineSpeedIn.TurbineSpeedIn_Fl.n_Tu_detected "loc variable to detect the first time a revolution (n_Tu) != 0 is received" FLOAT32_IEEE SAB_STANDARD_S2_S3 1 100 0 1 ECU_ADDRESS 0xFFF8E114 FORMAT "%4.3" DISPLAY_IDENTIFIER n_Tu_detected.TurbineSpeedIn_Fl.TurbineSpeedIn._.ZFFSAB /end MEASUREMENT
/begin MEASUREMENT ZFFSAB._.TurbineSpeedIn.TurbineSpeedIn_Fl.sv_n_TuLev2 "Output value turbine speed lev2" FLOAT32_IEEE SAB_N_1RPM_S2_S3 1 100 0 65535 ECU_ADDRESS 0xFFF8E14C FORMAT "%4.3" DISPLAY_IDENTIFIER sv_n_TuLev2.TurbineSpeedIn_Fl.TurbineSpeedIn._.ZFFSAB /end MEASUREMENT
/begin MEASUREMENT ZFFSAB._.TurbineSpeedIn.TurbineSpeedIn_Fl.sv_n_TuLev2Sts "Output value signal status of turbine speed lev2" FLOAT32_IEEE SAB_STANDARD_S2_S3 1 100 0 2 ECU_ADDRESS 0xFFF8E150 FORMAT "%4.3" DISPLAY_IDENTIFIER sv_n_TuLev2Sts.TurbineSpeedIn_Fl.TurbineSpeedIn._.ZFFSAB /end MEASUREMENT
/begin MEASUREMENT ZFFSAB._.TurbineSpeedIn.f_OverallPlausiState "local variable for a overall state consisting of iv_u_SensESts sv_n_EngSts sv_PSensSts f_n_TuVirtPlausiErr f_n_TuPlausiErr f_n_AbPlausiErr f_n_TuPlausiErr_active 0=all valid 1= at least one faulty" UBYTE SAB_STANDARD_S2_S3 1 100 0 1 ECU_ADDRESS 0xFFF8E1AB DISPLAY_IDENTIFIER f_OverallPlausiState.TurbineSpeedIn._.ZFFSAB /end MEASUREMENT
/begin MEASUREMENT ZFFSAB._.TurbineSpeedIn.f_n_TuPlausiErr "local variable for the turbinespeed value plausibility flag" UBYTE SAB_STANDARD_S2_S3 1 100 0 1 ECU_ADDRESS 0xFFF8E19A DISPLAY_IDENTIFIER f_n_TuPlausiErr.TurbineSpeedIn._.ZFFSAB /end MEASUREMENT
/begin MEASUREMENT ZFFSAB._.TurbineSpeedIn.f_n_Tu_PlausiErr_active "variable contains the information if KFC_NTUPLAUSILEV2 is active or not" UBYTE SAB_STANDARD_S2_S3 1 100 0 1 ECU_ADDRESS 0xFFF8E1A3 DISPLAY_IDENTIFIER f_n_Tu_PlausiErr_active.TurbineSpeedIn._.ZFFSAB /end MEASUREMENT
/begin MEASUREMENT ZFFSAB._.TurbineSpeedIn.f_n_Tu_PlausiErr_active_ "variable contains the information if KFC_NTUPLAUSILEV2 is active or not (complement)" UBYTE SAB_STANDARD_S2_S3 1 100 0 255 ECU_ADDRESS 0xFFF8E1A4 DISPLAY_IDENTIFIER f_n_Tu_PlausiErr_active_.TurbineSpeedIn._.ZFFSAB /end MEASUREMENT
/begin MEASUREMENT ZFFSAB._.TurbineSpeedIn.iv_n_Tu "Input value turbine Speed" UWORD SAB_N_1RPM_S2_S3 1 100 0 65535 ECU_ADDRESS 0xFFF8E188 DISPLAY_IDENTIFIER iv_n_Tu.TurbineSpeedIn._.ZFFSAB /end MEASUREMENT
/begin MEASUREMENT ZFFSAB._.TurbineSpeedIn.iv_n_TuESts "Input CAN message status for turbine" UBYTE SAB_STANDARD_S2_S3 1 100 0 4 ECU_ADDRESS 0xFFF8E18A DISPLAY_IDENTIFIER iv_n_TuESts.TurbineSpeedIn._.ZFFSAB /end MEASUREMENT
/begin MEASUREMENT ZFFSAB._.TurbineSpeedIn.iv_n_TuESts_ "Input CAN message status for turbine complement" UBYTE SAB_STANDARD_S2_S3 1 100 0 255 ECU_ADDRESS 0xFFF8E18E DISPLAY_IDENTIFIER iv_n_TuESts_.TurbineSpeedIn._.ZFFSAB /end MEASUREMENT
/begin MEASUREMENT ZFFSAB._.TurbineSpeedIn.iv_n_Tu_ "Input value turbine Speed complement" UWORD SAB_N_1RPM_S2_S3 1 100 0 65535 ECU_ADDRESS 0xFFF8E18C DISPLAY_IDENTIFIER iv_n_Tu_.TurbineSpeedIn._.ZFFSAB /end MEASUREMENT
/begin MEASUREMENT ZFFSAB._.TurbineSpeedIn.iv_u_SensESts "state of iv_PSens1" UBYTE SAB_STANDARD_S2_S3 1 100 0 255 ECU_ADDRESS 0xFFF8E170 DISPLAY_IDENTIFIER iv_u_SensESts.TurbineSpeedIn._.ZFFSAB /end MEASUREMENT
/begin MEASUREMENT ZFFSAB._.TurbineSpeedIn.iv_u_SensESts_ "state of iv_PSens1 complement" UBYTE SAB_STANDARD_S2_S3 1 100 0 255 ECU_ADDRESS 0xFFF8E171 DISPLAY_IDENTIFIER iv_u_SensESts_.TurbineSpeedIn._.ZFFSAB /end MEASUREMENT
/begin MEASUREMENT ZFFSAB._.TurbineSpeedIn.n_EngLev2TSI "local variable for the engine speed substitute value" UWORD SAB_N_1RPM_S2_S3 1 100 0 65535 ECU_ADDRESS 0xFFF8E19C DISPLAY_IDENTIFIER n_EngLev2TSI.TurbineSpeedIn._.ZFFSAB /end MEASUREMENT
/begin MEASUREMENT ZFFSAB._.TurbineSpeedIn.n_EngLev2TSISts "local variable for the engine speed status substitute value" UBYTE SAB_STANDARD_S2_S3 1 100 0 255 ECU_ADDRESS 0xFFF8E19E DISPLAY_IDENTIFIER n_EngLev2TSISts.TurbineSpeedIn._.ZFFSAB /end MEASUREMENT
/begin MEASUREMENT ZFFSAB._.TurbineSpeedIn.n_EngLev2TSISts_ "local variable for the engine speed status substitute value (complement)" UBYTE SAB_STANDARD_S2_S3 1 100 0 255 ECU_ADDRESS 0xFFF8E1A2 DISPLAY_IDENTIFIER n_EngLev2TSISts_.TurbineSpeedIn._.ZFFSAB /end MEASUREMENT
/begin MEASUREMENT ZFFSAB._.TurbineSpeedIn.n_EngLev2TSI_ "local variable for the engine speed substitute value (complement)" UWORD SAB_N_1RPM_S2_S3 1 100 0 65535 ECU_ADDRESS 0xFFF8E1A0 DISPLAY_IDENTIFIER n_EngLev2TSI_.TurbineSpeedIn._.ZFFSAB /end MEASUREMENT
/begin MEASUREMENT ZFFSAB._.TurbineSpeedIn.n_TuSts_ "local variable contains information of complement the signal status" UBYTE SAB_STANDARD_S2_S3 1 100 0 255 ECU_ADDRESS 0xFFF8E1A8 DISPLAY_IDENTIFIER n_TuSts_.TurbineSpeedIn._.ZFFSAB /end MEASUREMENT
/begin MEASUREMENT ZFFSAB._.TurbineSpeedIn.n_Tu_ "local variable contains" UWORD SAB_STANDARD_S2_S3 1 100 0 65535 ECU_ADDRESS 0xFFF8E1A6 DISPLAY_IDENTIFIER n_Tu_.TurbineSpeedIn._.ZFFSAB /end MEASUREMENT
/begin MEASUREMENT ZFFSAB._.TurbineSpeedIn.n_Tu_Filt2 "filtered value turbine speed for CAN output" UWORD SAB_N_1RPM_S2_S3 1 100 0 65535 ECU_ADDRESS 0xFFF8E190 DISPLAY_IDENTIFIER n_Tu_Filt2.TurbineSpeedIn._.ZFFSAB /end MEASUREMENT
/begin MEASUREMENT ZFFSAB._.TurbineSpeedIn.n_Tu_Filt2_ "filtered value turbine speed for CAN output (complement)" UWORD SAB_N_1RPM_S2_S3 1 100 0 65535 ECU_ADDRESS 0xFFF8E192 DISPLAY_IDENTIFIER n_Tu_Filt2_.TurbineSpeedIn._.ZFFSAB /end MEASUREMENT
/begin MEASUREMENT ZFFSAB._.TurbineSpeedIn.n_Tu_Filt_CAN "filtered value turbine speed for CAN output after CAN-Init filter" UWORD SAB_N_1RPM_S2_S3 1 100 0 65535 ECU_ADDRESS 0xFFF8E196 DISPLAY_IDENTIFIER n_Tu_Filt_CAN.TurbineSpeedIn._.ZFFSAB /end MEASUREMENT
/begin MEASUREMENT ZFFSAB._.TurbineSpeedIn.n_Tu_Filt_CAN_ "filtered value turbine speed for CAN output after CAN-Init filter(complement)" UWORD SAB_N_1RPM_S2_S3 1 100 0 65535 ECU_ADDRESS 0xFFF8E198 DISPLAY_IDENTIFIER n_Tu_Filt_CAN_.TurbineSpeedIn._.ZFFSAB /end MEASUREMENT
/begin MEASUREMENT ZFFSAB._.TurbineSpeedIn.n_Tu_detected "loc variable to detect the first time a revolution (n_Tu) != 0 is received" UBYTE SAB_STANDARD_S2_S3 1 100 0 1 ECU_ADDRESS 0xFFF8E186 DISPLAY_IDENTIFIER n_Tu_detected.TurbineSpeedIn._.ZFFSAB /end MEASUREMENT
/begin MEASUREMENT ZFFSAB._.TurbineSpeedIn.n_Tu_detected_ "loc variable to detect the first time a revolution (n_Tu) != 0 is received (complement)" UBYTE SAB_STANDARD_S2_S3 1 100 0 1 ECU_ADDRESS 0xFFF8E187 DISPLAY_IDENTIFIER n_Tu_detected_.TurbineSpeedIn._.ZFFSAB /end MEASUREMENT
/begin MEASUREMENT ZFFSAB._.TurbineSpeedIn.sv_Tu_sts_Direction "Direction (FORWARD=forward BACKWARD=backward)" UBYTE SAB_STANDARD_S2_S3 1 100 0 255 ECU_ADDRESS 0xFFF8E184 DISPLAY_IDENTIFIER sv_Tu_sts_Direction.TurbineSpeedIn._.ZFFSAB /end MEASUREMENT
/begin MEASUREMENT ZFFSAB._.TurbineSpeedIn.sv_Tu_sts_DirectionSts "Status of direction" UBYTE SAB_STANDARD_S2_S3 1 100 0 255 ECU_ADDRESS 0xFFF8E185 DISPLAY_IDENTIFIER sv_Tu_sts_DirectionSts.TurbineSpeedIn._.ZFFSAB /end MEASUREMENT
/begin MEASUREMENT ZFFSAB._.TurbineSpeedIn.sv_n_Tu "Output value turbine speed" UWORD SAB_N_1RPM_S2_S3 1 100 0 65535 ECU_ADDRESS 0xFFF8E172 DISPLAY_IDENTIFIER sv_n_Tu.TurbineSpeedIn._.ZFFSAB /end MEASUREMENT
/begin MEASUREMENT ZFFSAB._.TurbineSpeedIn.sv_n_TuFilt "Output value for filtered turbine speed" UWORD SAB_N_1RPM_S2_S3 1 100 0 65535 ECU_ADDRESS 0xFFF8E17E DISPLAY_IDENTIFIER sv_n_TuFilt.TurbineSpeedIn._.ZFFSAB /end MEASUREMENT
/begin MEASUREMENT ZFFSAB._.TurbineSpeedIn.sv_n_TuLev2 "Output value turbine speed lev2" UWORD SAB_N_1RPM_S2_S3 1 100 0 65535 ECU_ADDRESS 0xFFF8E176 DISPLAY_IDENTIFIER sv_n_TuLev2.TurbineSpeedIn._.ZFFSAB /end MEASUREMENT
/begin MEASUREMENT ZFFSAB._.TurbineSpeedIn.sv_n_TuLev2Sts "Output value signal status level2 of turbine speed" UBYTE SAB_STANDARD_S2_S3 1 100 0 2 ECU_ADDRESS 0xFFF8E178 DISPLAY_IDENTIFIER sv_n_TuLev2Sts.TurbineSpeedIn._.ZFFSAB /end MEASUREMENT
/begin MEASUREMENT ZFFSAB._.TurbineSpeedIn.sv_n_TuLev2Sts_ "Output value signal status level2 of turbine speed" UBYTE SAB_STANDARD_S2_S3 1 100 0 2 ECU_ADDRESS 0xFFF8E17C DISPLAY_IDENTIFIER sv_n_TuLev2Sts_.TurbineSpeedIn._.ZFFSAB /end MEASUREMENT
/begin MEASUREMENT ZFFSAB._.TurbineSpeedIn.sv_n_TuLev2_ "Output value turbine speed (complement)" UWORD SAB_N_1RPM_S2_S3 1 100 0 65535 ECU_ADDRESS 0xFFF8E17A DISPLAY_IDENTIFIER sv_n_TuLev2_.TurbineSpeedIn._.ZFFSAB /end MEASUREMENT
/begin MEASUREMENT ZFFSAB._.TurbineSpeedIn.sv_n_TuSts "Output value signal status of turbine speed" UBYTE SAB_STANDARD_S2_S3 1 100 0 2 ECU_ADDRESS 0xFFF8E174 DISPLAY_IDENTIFIER sv_n_TuSts.TurbineSpeedIn._.ZFFSAB /end MEASUREMENT
/begin MEASUREMENT ZFFSAB._.TurbineSpeedIn.sv_n_Tu_Tx "Output value turbine speed send on CAN" UWORD SAB_N_RPM_M2000_S2_S3 1 100 -2000 14000 ECU_ADDRESS 0xFFF8E180 DISPLAY_IDENTIFIER sv_n_Tu_Tx.TurbineSpeedIn._.ZFFSAB /end MEASUREMENT
/begin MEASUREMENT ZFFSAB._.TurbineSpeedIn.sv_n_Tu_Tx_ "Output value turbine speed send on CAN" UWORD SAB_N_RPM_M2000_S2_S3 1 100 -2000 14000 ECU_ADDRESS 0xFFF8E182 DISPLAY_IDENTIFIER sv_n_Tu_Tx_.TurbineSpeedIn._.ZFFSAB /end MEASUREMENT
/begin MEASUREMENT ZFFSAB._.TurbineSpeedIn.tmr_Delay_TurbineSpeedTx.time "Description for this variable only in SW documentation possible not in asap2" ULONG SAB_T_TIMER_10MS_S2_S3 1 100 0 42949672950 ECU_ADDRESS 0xFFF8E168 DISPLAY_IDENTIFIER time.tmr_Delay_TurbineSpeedTx.TurbineSpeedIn._.ZFFSAB /end MEASUREMENT
/begin MEASUREMENT ZFFSAB._.TurbineSpeedIn.tmr_Delay_TurbineSpeedTx.time_ "Description for this variable only in SW documentation possible not in asap2" ULONG SAB_T_TIMER_10MS_S2_S3 1 100 0 42949672950 ECU_ADDRESS 0xFFF8E16C DISPLAY_IDENTIFIER time_.tmr_Delay_TurbineSpeedTx.TurbineSpeedIn._.ZFFSAB /end MEASUREMENT
/begin MEASUREMENT ZFFSAB._.TurbineSpeedIn.tmr_nTuFiltAktiv.time "Description for this variable only in SW documentation possible not in asap2" ULONG SAB_T_TIMER_10MS_S2_S3 1 100 0 42949672950 ECU_ADDRESS 0xFFF8E158 DISPLAY_IDENTIFIER time.tmr_nTuFiltAktiv.TurbineSpeedIn._.ZFFSAB /end MEASUREMENT
/begin MEASUREMENT ZFFSAB._.TurbineSpeedIn.tmr_nTuFiltAktiv.time_ "Description for this variable only in SW documentation possible not in asap2" ULONG SAB_T_TIMER_10MS_S2_S3 1 100 0 42949672950 ECU_ADDRESS 0xFFF8E15C DISPLAY_IDENTIFIER time_.tmr_nTuFiltAktiv.TurbineSpeedIn._.ZFFSAB /end MEASUREMENT
/begin MEASUREMENT ZFFSAB._.TurbineSpeedIn.tmr_nTuFiltAktiv2ndPath.time "Description for this variable only in SW documentation possible not in asap2" ULONG SAB_T_TIMER_10MS_S2_S3 1 100 0 42949672950 ECU_ADDRESS 0xFFF8E160 DISPLAY_IDENTIFIER time.tmr_nTuFiltAktiv2ndPath.TurbineSpeedIn._.ZFFSAB /end MEASUREMENT
/begin MEASUREMENT ZFFSAB._.TurbineSpeedIn.tmr_nTuFiltAktiv2ndPath.time_ "Description for this variable only in SW documentation possible not in asap2" ULONG SAB_T_TIMER_10MS_S2_S3 1 100 0 42949672950 ECU_ADDRESS 0xFFF8E164 DISPLAY_IDENTIFIER time_.tmr_nTuFiltAktiv2ndPath.TurbineSpeedIn._.ZFFSAB /end MEASUREMENT
/begin MEASUREMENT ZFFSAB._.TurbineSpeedVirtualIn.SF_n4_ig "Parameter SF_n4_ig" FLOAT32_IEEE SAB_STANDARD_S2_S3 1 100 0 2.464 ECU_ADDRESS 0xFFF8D914 FORMAT "%4.3" DISPLAY_IDENTIFIER SF_n4_ig.TurbineSpeedVirtualIn._.ZFFSAB /end MEASUREMENT
/begin MEASUREMENT ZFFSAB._.TurbineSpeedVirtualIn.SF_n4_zg "Parameter SF_n4_zg" FLOAT32_IEEE SAB_STANDARD_S2_S3 1 100 0 2.464 ECU_ADDRESS 0xFFF8D918 FORMAT "%4.3" DISPLAY_IDENTIFIER SF_n4_zg.TurbineSpeedVirtualIn._.ZFFSAB /end MEASUREMENT
/begin MEASUREMENT ZFFSAB._.TurbineSpeedVirtualIn.f_gangnachfuehrung_aktiv "Flag zur Anzeige des Zustands Gangnachfuehrung bzw. Neutral" UBYTE SAB_STANDARD_S2_S3 1 100 0 255 ECU_ADDRESS 0xFFF8D931 DISPLAY_IDENTIFIER f_gangnachfuehrung_aktiv.TurbineSpeedVirtualIn._.ZFFSAB /end MEASUREMENT
/begin MEASUREMENT ZFFSAB._.TurbineSpeedVirtualIn.f_nulldurchgang_sv_n_Dif_IAE "Zwischengroesse der Berechnung der Drehrichtungsanzeige sv_n_Dif_IAE_virt_Dir" UBYTE SAB_STANDARD_S2_S3 1 100 0 255 ECU_ADDRESS 0xFFF8D930 DISPLAY_IDENTIFIER f_nulldurchgang_sv_n_Dif_IAE.TurbineSpeedVirtualIn._.ZFFSAB /end MEASUREMENT
/begin MEASUREMENT ZFFSAB._.TurbineSpeedVirtualIn.i_IstGang "Parameter i_IstGang" FLOAT32_IEEE SAB_STANDARD_S2_S3 1 100 0 4.696 ECU_ADDRESS 0xFFF8D90C FORMAT "%4.3" DISPLAY_IDENTIFIER i_IstGang.TurbineSpeedVirtualIn._.ZFFSAB /end MEASUREMENT
/begin MEASUREMENT ZFFSAB._.TurbineSpeedVirtualIn.i_ZielGang "Parameter i_ZielGang" FLOAT32_IEEE SAB_STANDARD_S2_S3 1 100 0 4.696 ECU_ADDRESS 0xFFF8D910 FORMAT "%4.3" DISPLAY_IDENTIFIER i_ZielGang.TurbineSpeedVirtualIn._.ZFFSAB /end MEASUREMENT
/begin MEASUREMENT ZFFSAB._.TurbineSpeedVirtualIn.iv_ActualGear "Istgang" SBYTE SAB_STANDARD_S2_S3 1 100 -1 8 ECU_ADDRESS 0xFFF8D8EC DISPLAY_IDENTIFIER iv_ActualGear.TurbineSpeedVirtualIn._.ZFFSAB /end MEASUREMENT
/begin MEASUREMENT ZFFSAB._.TurbineSpeedVirtualIn.iv_Pos "Input value for position of GearLever" UBYTE SAB_STANDARD_S2_S3 1 100 0 255 ECU_ADDRESS 0xFFF8D8EF DISPLAY_IDENTIFIER iv_Pos.TurbineSpeedVirtualIn._.ZFFSAB /end MEASUREMENT
/begin MEASUREMENT ZFFSAB._.TurbineSpeedVirtualIn.iv_TargetGearInfo "Zielgang" SBYTE SAB_STANDARD_S2_S3 1 100 -1 8 ECU_ADDRESS 0xFFF8D8ED DISPLAY_IDENTIFIER iv_TargetGearInfo.TurbineSpeedVirtualIn._.ZFFSAB /end MEASUREMENT
/begin MEASUREMENT ZFFSAB._.TurbineSpeedVirtualIn.iv_in_Gear "Input value for gearRatio of actual gear" UWORD SAB_K1000_S2_S3 1 100 0 65.535 ECU_ADDRESS 0xFFF8D91C DISPLAY_IDENTIFIER iv_in_Gear.TurbineSpeedVirtualIn._.ZFFSAB /end MEASUREMENT
/begin MEASUREMENT ZFFSAB._.TurbineSpeedVirtualIn.iv_kraftschluss "signalizes if gearbox is kraftschluessig" UBYTE SAB_STANDARD_S2_S3 1 100 0 6 ECU_ADDRESS 0xFFF8D8EE DISPLAY_IDENTIFIER iv_kraftschluss.TurbineSpeedVirtualIn._.ZFFSAB /end MEASUREMENT
/begin MEASUREMENT ZFFSAB._.TurbineSpeedVirtualIn.iv_n6 "Drehzahl am Sensor n6" UWORD SAB_N_1RPM_S2_S3 1 100 0 65535 ECU_ADDRESS 0xFFF8D8FE DISPLAY_IDENTIFIER iv_n6.TurbineSpeedVirtualIn._.ZFFSAB /end MEASUREMENT
/begin MEASUREMENT ZFFSAB._.TurbineSpeedVirtualIn.iv_n6TuVirtFilt "Gefilterte n6-Drehzahl" UWORD SAB_N_1RPM_S2_S3 1 100 0 65535 ECU_ADDRESS 0xFFF8D938 DISPLAY_IDENTIFIER iv_n6TuVirtFilt.TurbineSpeedVirtualIn._.ZFFSAB /end MEASUREMENT
/begin MEASUREMENT ZFFSAB._.TurbineSpeedVirtualIn.iv_n6TuVirtFiltSync "Gefilterte und synchronisierte n6-Drehzahl" UWORD SAB_N_1RPM_S2_S3 1 100 0 65535 ECU_ADDRESS 0xFFF8D93E DISPLAY_IDENTIFIER iv_n6TuVirtFiltSync.TurbineSpeedVirtualIn._.ZFFSAB /end MEASUREMENT
/begin MEASUREMENT ZFFSAB._.TurbineSpeedVirtualIn.iv_n6_Dir "Drehrichtungsanzeige n6-Sensor" SBYTE SAB_STANDARD_S2_S3 1 100 -128 127 ECU_ADDRESS 0xFFF8D922 DISPLAY_IDENTIFIER iv_n6_Dir.TurbineSpeedVirtualIn._.ZFFSAB /end MEASUREMENT
/begin MEASUREMENT ZFFSAB._.TurbineSpeedVirtualIn.iv_st_IAE "IAE Kupplungsstatus" UBYTE SAB_STANDARD_S2_S3 1 100 0 255 ECU_ADDRESS 0xFFF8D8F0 DISPLAY_IDENTIFIER iv_st_IAE.TurbineSpeedVirtualIn._.ZFFSAB /end MEASUREMENT
/begin MEASUREMENT ZFFSAB._.TurbineSpeedVirtualIn.iv_z_modus_IAE "IAE modus" UBYTE SAB_STANDARD_S2_S3 1 100 0 255 ECU_ADDRESS 0xFFF8D8F1 DISPLAY_IDENTIFIER iv_z_modus_IAE.TurbineSpeedVirtualIn._.ZFFSAB /end MEASUREMENT
/begin MEASUREMENT ZFFSAB._.TurbineSpeedVirtualIn.k_n6 "Parameter k_n6" FLOAT32_IEEE SAB_STANDARD_S2_S3 1 100 -2.196 7.4452 ECU_ADDRESS 0xFFF8D908 FORMAT "%4.3" DISPLAY_IDENTIFIER k_n6.TurbineSpeedVirtualIn._.ZFFSAB /end MEASUREMENT
/begin MEASUREMENT ZFFSAB._.TurbineSpeedVirtualIn.k_nab "Parameter k_nab" FLOAT32_IEEE SAB_STANDARD_S2_S3 1 100 -4.945 4.6957 ECU_ADDRESS 0xFFF8D904 FORMAT "%4.3" DISPLAY_IDENTIFIER k_nab.TurbineSpeedVirtualIn._.ZFFSAB /end MEASUREMENT
/begin MEASUREMENT ZFFSAB._.TurbineSpeedVirtualIn.k_nmot "Parameter k_nmot" FLOAT32_IEEE SAB_STANDARD_S2_S3 1 100 -1.5 0 ECU_ADDRESS 0xFFF8D900 FORMAT "%4.3" DISPLAY_IDENTIFIER k_nmot.TurbineSpeedVirtualIn._.ZFFSAB /end MEASUREMENT
/begin MEASUREMENT ZFFSAB._.TurbineSpeedVirtualIn.n_TuVirtOptSts "0 = alle anderen Faelle [k-Faktoren] 1 = waehrend Schaltung und IAE geschlossen [n_em] 2 = waehrend Schaltung und IAE im Schlupf [k-Faktoren] 3 = ausserhalb Schaltungen und Kraftschluss und kleiner 6. Gang [n_ab * i_Gang] 4 = ausserhalb Schaltungen und Kr" UBYTE SAB_STANDARD_S2_S3 1 100 0 255 ECU_ADDRESS 0xFFF8D91E DISPLAY_IDENTIFIER n_TuVirtOptSts.TurbineSpeedVirtualIn._.ZFFSAB /end MEASUREMENT
/begin MEASUREMENT ZFFSAB._.TurbineSpeedVirtualIn.pos_fl "Gefiltertes Waehlhebelpositionssignal" UBYTE SAB_STANDARD_S2_S3 1 100 0 255 ECU_ADDRESS 0xFFF8D932 DISPLAY_IDENTIFIER pos_fl.TurbineSpeedVirtualIn._.ZFFSAB /end MEASUREMENT
/begin MEASUREMENT ZFFSAB._.TurbineSpeedVirtualIn.sv_n6 "Drehzahl an der Baugruppe 6" UWORD SAB_N_1RPM_S2_S3 1 100 0 65535 ECU_ADDRESS 0xFFF8D8FA DISPLAY_IDENTIFIER sv_n6.TurbineSpeedVirtualIn._.ZFFSAB /end MEASUREMENT
/begin MEASUREMENT ZFFSAB._.TurbineSpeedVirtualIn.sv_n6_Sts "Status Drehzahl an der Baugruppe 6" UBYTE SAB_STANDARD_S2_S3 1 100 0 2 ECU_ADDRESS 0xFFF8D8FC DISPLAY_IDENTIFIER sv_n6_Sts.TurbineSpeedVirtualIn._.ZFFSAB /end MEASUREMENT
/begin MEASUREMENT ZFFSAB._.TurbineSpeedVirtualIn.sv_n_AbTuVirtFilt "Gefilterte Abtriebsdrehzahl" UWORD SAB_N_1RPM_S2_S3 1 100 0 65535 ECU_ADDRESS 0xFFF8D936 DISPLAY_IDENTIFIER sv_n_AbTuVirtFilt.TurbineSpeedVirtualIn._.ZFFSAB /end MEASUREMENT
/begin MEASUREMENT ZFFSAB._.TurbineSpeedVirtualIn.sv_n_AbTuVirtFiltSync "Gefilterte und synchronisierte Abtriebsdrehzahl" UWORD SAB_N_1RPM_S2_S3 1 100 0 65535 ECU_ADDRESS 0xFFF8D93C DISPLAY_IDENTIFIER sv_n_AbTuVirtFiltSync.TurbineSpeedVirtualIn._.ZFFSAB /end MEASUREMENT
/begin MEASUREMENT ZFFSAB._.TurbineSpeedVirtualIn.sv_n_Ab_Dir "Drehrichtungsanzeige n_ab-Sensor" SBYTE SAB_STANDARD_S2_S3 1 100 -128 127 ECU_ADDRESS 0xFFF8D923 DISPLAY_IDENTIFIER sv_n_Ab_Dir.TurbineSpeedVirtualIn._.ZFFSAB /end MEASUREMENT
/begin MEASUREMENT ZFFSAB._.TurbineSpeedVirtualIn.sv_n_Dif_IAE "Bauteildifferenzdrehzahl IAE" SWORD SAB_N_1RPM_S2_S3 1 100 -32768 32767 ECU_ADDRESS 0xFFF8D920 DISPLAY_IDENTIFIER sv_n_Dif_IAE.TurbineSpeedVirtualIn._.ZFFSAB /end MEASUREMENT
/begin MEASUREMENT ZFFSAB._.TurbineSpeedVirtualIn.sv_n_Dif_IAEFilt "Gefilterte Bauteildifferenzdrehzahl IAE fuer Vorzeichenbestimmung" SWORD SAB_N_1RPM_S2_S3 1 100 -32768 32767 ECU_ADDRESS 0xFFF8D92A DISPLAY_IDENTIFIER sv_n_Dif_IAEFilt.TurbineSpeedVirtualIn._.ZFFSAB /end MEASUREMENT
/begin MEASUREMENT ZFFSAB._.TurbineSpeedVirtualIn.sv_n_Dif_IAEOpt "Optimierte Bauteildifferenzdrehzahl IAE" SWORD SAB_N_1RPM_S2_S3 1 100 -32768 32767 ECU_ADDRESS 0xFFF8D8F4 DISPLAY_IDENTIFIER sv_n_Dif_IAEOpt.TurbineSpeedVirtualIn._.ZFFSAB /end MEASUREMENT
/begin MEASUREMENT ZFFSAB._.TurbineSpeedVirtualIn.sv_n_Dif_IAE_Dir "Drehrichtungsanzeige Bauteildifferenzdrehzahl sv_n_Dif_IAE" SBYTE SAB_STANDARD_S2_S3 1 100 -128 127 ECU_ADDRESS 0xFFF8D924 DISPLAY_IDENTIFIER sv_n_Dif_IAE_Dir.TurbineSpeedVirtualIn._.ZFFSAB /end MEASUREMENT
/begin MEASUREMENT ZFFSAB._.TurbineSpeedVirtualIn.sv_n_Dif_IAE_Dir_alt "Drehrichtungsanzeige Bauteildifferenzdrehzahl sv_n_Dif_IAE des vorherigen Zyklus" SBYTE SAB_STANDARD_S2_S3 1 100 -128 127 ECU_ADDRESS 0xFFF8D925 DISPLAY_IDENTIFIER sv_n_Dif_IAE_Dir_alt.TurbineSpeedVirtualIn._.ZFFSAB /end MEASUREMENT
/begin MEASUREMENT ZFFSAB._.TurbineSpeedVirtualIn.sv_n_Dif_IAE_virt "Virtuelle Bauteildifferenzdrehzahl IAE" SWORD SAB_N_1RPM_S2_S3 1 100 -32768 32767 ECU_ADDRESS 0xFFF8D8F2 DISPLAY_IDENTIFIER sv_n_Dif_IAE_virt.TurbineSpeedVirtualIn._.ZFFSAB /end MEASUREMENT
/begin MEASUREMENT ZFFSAB._.TurbineSpeedVirtualIn.sv_n_Dif_IAE_virt_Dir "Drehrichtungsanzeige virtuelle Differenzdrehzahl sv_n_Dif_IAE" SBYTE SAB_STANDARD_S2_S3 1 100 -128 127 ECU_ADDRESS 0xFFF8D926 DISPLAY_IDENTIFIER sv_n_Dif_IAE_virt_Dir.TurbineSpeedVirtualIn._.ZFFSAB /end MEASUREMENT
/begin MEASUREMENT ZFFSAB._.TurbineSpeedVirtualIn.sv_n_Dif_IAE_virt_DirSts "Status der Drehrichtungsanzeige sv_n_Dif_IAE_virt_Dir der virtuellen Differenzdrehzahl sv_n_Dif_IAE_virt" UBYTE SAB_STANDARD_S2_S3 1 100 0 255 ECU_ADDRESS 0xFFF8D928 DISPLAY_IDENTIFIER sv_n_Dif_IAE_virt_DirSts.TurbineSpeedVirtualIn._.ZFFSAB /end MEASUREMENT
/begin MEASUREMENT ZFFSAB._.TurbineSpeedVirtualIn.sv_n_Dif_IAE_virt_Dir_alt "Drehrichtungsanzeige virtuelle Differenzdrehzahl sv_n_Dif_IAE des vorherigen Zyklus" SBYTE SAB_STANDARD_S2_S3 1 100 -128 127 ECU_ADDRESS 0xFFF8D927 DISPLAY_IDENTIFIER sv_n_Dif_IAE_virt_Dir_alt.TurbineSpeedVirtualIn._.ZFFSAB /end MEASUREMENT
/begin MEASUREMENT ZFFSAB._.TurbineSpeedVirtualIn.sv_n_EngTuVirtFilt "Gefilterte Getriebeingangsdrehzahl" UWORD SAB_N_1RPM_S2_S3 1 100 0 65535 ECU_ADDRESS 0xFFF8D934 DISPLAY_IDENTIFIER sv_n_EngTuVirtFilt.TurbineSpeedVirtualIn._.ZFFSAB /end MEASUREMENT
/begin MEASUREMENT ZFFSAB._.TurbineSpeedVirtualIn.sv_n_EngTuVirtFiltSync "Gefilterte und synchronisierte Getriebeingangsdrehzahl" UWORD SAB_N_1RPM_S2_S3 1 100 0 65535 ECU_ADDRESS 0xFFF8D93A DISPLAY_IDENTIFIER sv_n_EngTuVirtFiltSync.TurbineSpeedVirtualIn._.ZFFSAB /end MEASUREMENT
/begin MEASUREMENT ZFFSAB._.TurbineSpeedVirtualIn.sv_n_TuVirt "Virtuelle Turbinendrehzahl" UWORD SAB_N_1RPM_S2_S3 1 100 0 65535 ECU_ADDRESS 0xFFF8D8F8 DISPLAY_IDENTIFIER sv_n_TuVirt.TurbineSpeedVirtualIn._.ZFFSAB /end MEASUREMENT
/begin MEASUREMENT ZFFSAB._.TurbineSpeedVirtualIn.sv_n_TuVirtOpt "Optimierte Virtuelle Turbinendrehzahl" UWORD SAB_N_1RPM_S2_S3 1 100 0 65535 ECU_ADDRESS 0xFFF8D8F6 DISPLAY_IDENTIFIER sv_n_TuVirtOpt.TurbineSpeedVirtualIn._.ZFFSAB /end MEASUREMENT
/begin MEASUREMENT ZFFSAB._.TurbineSpeedVirtualIn.sv_n_TuVirtVz "Vorzeichenbehaftete virtuelle Turbinendrehzahl sv_n_TuVirtVz fuer Vorzeichenbestimmung" SWORD SAB_N_1RPM_S2_S3 1 100 -32768 32767 ECU_ADDRESS 0xFFF8D92C DISPLAY_IDENTIFIER sv_n_TuVirtVz.TurbineSpeedVirtualIn._.ZFFSAB /end MEASUREMENT
/begin MEASUREMENT ZFFSAB._.TurbineSpeedVirtualIn.sv_n_TuVirtVzFilt "Gefilterte vorzeichenbehaftete virtuelle Turbinendrehzahl sv_n_TuVirtVz fuer Vorzeichenbestimmung" SWORD SAB_N_1RPM_S2_S3 1 100 -32768 32767 ECU_ADDRESS 0xFFF8D92E DISPLAY_IDENTIFIER sv_n_TuVirtVzFilt.TurbineSpeedVirtualIn._.ZFFSAB /end MEASUREMENT
/begin MEASUREMENT ZFFSAB._.TurbineSpeedVirtualIn.sv_n_TuVirt_Dir "Drehrichtungsanzeige virtuelle Turbinendrehzahl sv_n_TuVirt" SBYTE SAB_STANDARD_S2_S3 1 100 -128 127 ECU_ADDRESS 0xFFF8D929 DISPLAY_IDENTIFIER sv_n_TuVirt_Dir.TurbineSpeedVirtualIn._.ZFFSAB /end MEASUREMENT
/begin MEASUREMENT ZFFSAB._.TurbineTorqueIn.dc_TrqFaultInfo "Error Info of DcTrq-signal xxxxxxx1 means problem on EGS side xxxxxx1x means problem on sensor side" UBYTE SAB_STANDARD_S2_S3 1 100 0 2 ECU_ADDRESS 0xFFF95B4F DISPLAY_IDENTIFIER dc_TrqFaultInfo.TurbineTorqueIn._.ZFFSAB /end MEASUREMENT
/begin MEASUREMENT ZFFSAB._.TurbineTorqueIn.iv_dc_Trq "Input raw signal from Turbine Torque Sensor" UWORD SAB_PROZENT10_S2_S3 1 100 0 100 ECU_ADDRESS 0xFFF95B48 DISPLAY_IDENTIFIER iv_dc_Trq.TurbineTorqueIn._.ZFFSAB /end MEASUREMENT
/begin MEASUREMENT ZFFSAB._.TurbineTorqueIn.iv_dc_TrqESts "Input raw signal status from Turbine Torque Sensor" UBYTE SAB_STANDARD_S2_S3 1 100 0 255 ECU_ADDRESS 0xFFF95B4A DISPLAY_IDENTIFIER iv_dc_TrqESts.TurbineTorqueIn._.ZFFSAB /end MEASUREMENT
/begin MEASUREMENT ZFFSAB._.TurbineTorqueIn.sv_dc_MotTrq "Output signal of Turbine Torque" UWORD SAB_PROZENT10_S2_S3 1 100 0 100 ECU_ADDRESS 0xFFF95B4C DISPLAY_IDENTIFIER sv_dc_MotTrq.TurbineTorqueIn._.ZFFSAB /end MEASUREMENT
/begin MEASUREMENT ZFFSAB._.TurbineTorqueIn.sv_dc_MotTrqSts "Output status signal of Turbine Torque" UBYTE SAB_STANDARD_S2_S3 1 100 0 2 ECU_ADDRESS 0xFFF95B4E DISPLAY_IDENTIFIER sv_dc_MotTrqSts.TurbineTorqueIn._.ZFFSAB /end MEASUREMENT
/begin MEASUREMENT ZFFSAB._.VehicleSpeedIn.VehicleSpeedInFL.iv_u_SensESts "electrical status of parklock sensor" FLOAT32_IEEE SAB_STANDARD_S2_S3 1 100 0 1 ECU_ADDRESS 0xFFF8DC8C FORMAT "%4.3" DISPLAY_IDENTIFIER iv_u_SensESts.VehicleSpeedInFL.VehicleSpeedIn._.ZFFSAB /end MEASUREMENT
/begin MEASUREMENT ZFFSAB._.VehicleSpeedIn.VehicleSpeedInFL.n_WheelAvg "Average Wheel rpm of all driven wheels" FLOAT32_IEEE SAB_N_RPM100_S2_S3 1 100 0 655.35 ECU_ADDRESS 0xFFF8DCB0 DISPLAY_IDENTIFIER n_WheelAvg.VehicleSpeedInFL.VehicleSpeedIn._.ZFFSAB /end MEASUREMENT
/begin MEASUREMENT ZFFSAB._.VehicleSpeedIn.VehicleSpeedInFL.n_WheelAvgSts "Status of average Wheel rpm derived from driven wheels" FLOAT32_IEEE SAB_STANDARD_S2_S3 1 100 0 2 ECU_ADDRESS 0xFFF8DCB4 FORMAT "%4.3" DISPLAY_IDENTIFIER n_WheelAvgSts.VehicleSpeedInFL.VehicleSpeedIn._.ZFFSAB /end MEASUREMENT
/begin MEASUREMENT ZFFSAB._.VehicleSpeedIn.VehicleSpeedInFL.sv_v_FzgByNab "Intermediate value vehicle speed by nAb" FLOAT32_IEEE SAB_STANDARD_S2_S3 1 100 0 65535 ECU_ADDRESS 0xFFF8DCA8 FORMAT "%4.3" DISPLAY_IDENTIFIER sv_v_FzgByNab.VehicleSpeedInFL.VehicleSpeedIn._.ZFFSAB /end MEASUREMENT
/begin MEASUREMENT ZFFSAB._.VehicleSpeedIn.VehicleSpeedInFL.sv_v_FzgByNabSts "Intermediate value status of vehicle speed by nAb" FLOAT32_IEEE SAB_STANDARD_S2_S3 1 100 0 1 ECU_ADDRESS 0xFFF8DCAC FORMAT "%4.3" DISPLAY_IDENTIFIER sv_v_FzgByNabSts.VehicleSpeedInFL.VehicleSpeedIn._.ZFFSAB /end MEASUREMENT
/begin MEASUREMENT ZFFSAB._.VehicleSpeedIn.VehicleSpeedInFL.sv_v_Ist "Intermediate value vehicle speed" FLOAT32_IEEE SAB_V_1KMH_S2_S3 1 100 0 65535 ECU_ADDRESS 0xFFF8DC98 FORMAT "%4.3" DISPLAY_IDENTIFIER sv_v_Ist.VehicleSpeedInFL.VehicleSpeedIn._.ZFFSAB /end MEASUREMENT
/begin MEASUREMENT ZFFSAB._.VehicleSpeedIn.VehicleSpeedInFL.sv_v_IstMax "Intermediate value vehicle speed maximum selection" FLOAT32_IEEE SAB_V_1KMH_S2_S3 1 100 0 65535 ECU_ADDRESS 0xFFF8DCA0 FORMAT "%4.3" DISPLAY_IDENTIFIER sv_v_IstMax.VehicleSpeedInFL.VehicleSpeedIn._.ZFFSAB /end MEASUREMENT
/begin MEASUREMENT ZFFSAB._.VehicleSpeedIn.VehicleSpeedInFL.sv_v_IstMaxSts "Intermediate value signal status of vehicle speed maximum selection" FLOAT32_IEEE SAB_STANDARD_S2_S3 1 100 0 1 ECU_ADDRESS 0xFFF8DCA4 FORMAT "%4.3" DISPLAY_IDENTIFIER sv_v_IstMaxSts.VehicleSpeedInFL.VehicleSpeedIn._.ZFFSAB /end MEASUREMENT
/begin MEASUREMENT ZFFSAB._.VehicleSpeedIn.VehicleSpeedInFL.sv_v_IstSts "Intermediate value signal status of vehicle speed" FLOAT32_IEEE SAB_STANDARD_S2_S3 1 100 0 1 ECU_ADDRESS 0xFFF8DC9C FORMAT "%4.3" DISPLAY_IDENTIFIER sv_v_IstSts.VehicleSpeedInFL.VehicleSpeedIn._.ZFFSAB /end MEASUREMENT
/begin MEASUREMENT ZFFSAB._.VehicleSpeedIn.VehicleSpeedInFL.tmr_DelayVIstMaxCalc.time "Description for this variable only in SW documentation possible not in asap2" ULONG SAB_T_TIMER_10MS_S2_S3 1 100 0 42949672950 ECU_ADDRESS 0xFFF8DC84 DISPLAY_IDENTIFIER time.tmr_DelayVIstMaxCalc.VehicleSpeedInFL.VehicleSpeedIn._.ZFFSAB /end MEASUREMENT
/begin MEASUREMENT ZFFSAB._.VehicleSpeedIn.VehicleSpeedInFL.tmr_DelayVIstMaxCalc.time_ "Description for this variable only in SW documentation possible not in asap2" ULONG SAB_T_TIMER_10MS_S2_S3 1 100 0 42949672950 ECU_ADDRESS 0xFFF8DC88 DISPLAY_IDENTIFIER time_.tmr_DelayVIstMaxCalc.VehicleSpeedInFL.VehicleSpeedIn._.ZFFSAB /end MEASUREMENT
/begin MEASUREMENT ZFFSAB._.VehicleSpeedIn.VehicleSpeedInFL.v_Fzg "Intermediate size signal vehicle speed" FLOAT32_IEEE SAB_V_KMH16_S2_S3 1 100 0 4095.9375 ECU_ADDRESS 0xFFF8DC90 DISPLAY_IDENTIFIER v_Fzg.VehicleSpeedInFL.VehicleSpeedIn._.ZFFSAB /end MEASUREMENT
/begin MEASUREMENT ZFFSAB._.VehicleSpeedIn.VehicleSpeedInFL.v_FzgSts "Intermediate size signal status of vehicle speed" FLOAT32_IEEE SAB_STANDARD_S2_S3 1 100 0 1 ECU_ADDRESS 0xFFF8DC94 FORMAT "%4.3" DISPLAY_IDENTIFIER v_FzgSts.VehicleSpeedInFL.VehicleSpeedIn._.ZFFSAB /end MEASUREMENT
/begin MEASUREMENT ZFFSAB._.VehicleSpeedIn.VehicleSpeedInFL.v_IstByNWheel "vehicle speed computed by wheel rpm" FLOAT32_IEEE SAB_V_1KMH_S2_S3 1 100 0 65535 ECU_ADDRESS 0xFFF8DCB8 FORMAT "%4.3" DISPLAY_IDENTIFIER v_IstByNWheel.VehicleSpeedInFL.VehicleSpeedIn._.ZFFSAB /end MEASUREMENT
/begin MEASUREMENT ZFFSAB._.VehicleSpeedIn.f_v_FzgErr "Error flag of v_Fzg-signal" UBYTE SAB_STANDARD_S2_S3 1 100 0 1 ECU_ADDRESS 0xFFF8DCF1 DISPLAY_IDENTIFIER f_v_FzgErr.VehicleSpeedIn._.ZFFSAB /end MEASUREMENT
/begin MEASUREMENT ZFFSAB._.VehicleSpeedIn.iv_u_SensESts "Input value electrical sensor status" UBYTE SAB_STANDARD_S2_S3 1 100 0 255 ECU_ADDRESS 0xFFF8DCCD DISPLAY_IDENTIFIER iv_u_SensESts.VehicleSpeedIn._.ZFFSAB /end MEASUREMENT
/begin MEASUREMENT ZFFSAB._.VehicleSpeedIn.iv_v_Fzg "Input value vehicle speed" UWORD SAB_V_KMH64_S2_S3 1 100 0 1023.984375 ECU_ADDRESS 0xFFF8DCC8 DISPLAY_IDENTIFIER iv_v_Fzg.VehicleSpeedIn._.ZFFSAB /end MEASUREMENT
/begin MEASUREMENT ZFFSAB._.VehicleSpeedIn.iv_v_FzgErr "Input value signal qualifier of vehicle speed" UBYTE SAB_STANDARD_S2_S3 1 100 0 255 ECU_ADDRESS 0xFFF8DCCB DISPLAY_IDENTIFIER iv_v_FzgErr.VehicleSpeedIn._.ZFFSAB /end MEASUREMENT
/begin MEASUREMENT ZFFSAB._.VehicleSpeedIn.iv_v_FzgErrSts "Input value signal status of qualifier of vehicle speed" UBYTE SAB_STANDARD_S2_S3 1 100 0 255 ECU_ADDRESS 0xFFF8DCCC DISPLAY_IDENTIFIER iv_v_FzgErrSts.VehicleSpeedIn._.ZFFSAB /end MEASUREMENT
/begin MEASUREMENT ZFFSAB._.VehicleSpeedIn.iv_v_FzgSts "Input value signal status of vehicle speed" UBYTE SAB_STANDARD_S2_S3 1 100 0 255 ECU_ADDRESS 0xFFF8DCCA DISPLAY_IDENTIFIER iv_v_FzgSts.VehicleSpeedIn._.ZFFSAB /end MEASUREMENT
/begin MEASUREMENT ZFFSAB._.VehicleSpeedIn.n_WheelAvg "Average Wheel rpm of all driven wheels" ULONG SAB_N_RPM100_S2_S3 1 100 0 655.35 ECU_ADDRESS 0xFFF8DCF4 DISPLAY_IDENTIFIER n_WheelAvg.VehicleSpeedIn._.ZFFSAB /end MEASUREMENT
/begin MEASUREMENT ZFFSAB._.VehicleSpeedIn.n_WheelAvgSts "Status of average Wheel rpm derived from driven wheels" UBYTE SAB_STANDARD_S2_S3 1 100 0 2 ECU_ADDRESS 0xFFF8DCF8 DISPLAY_IDENTIFIER n_WheelAvgSts.VehicleSpeedIn._.ZFFSAB /end MEASUREMENT
/begin MEASUREMENT ZFFSAB._.VehicleSpeedIn.sv_AGS_VVehCog "Intermediate value signal vehicle speed" UWORD SAB_V_KMH64_S2_S3 1 100 0 1023.984375 ECU_ADDRESS 0xFFF8DCEE DISPLAY_IDENTIFIER sv_AGS_VVehCog.VehicleSpeedIn._.ZFFSAB /end MEASUREMENT
/begin MEASUREMENT ZFFSAB._.VehicleSpeedIn.sv_AGS_VVehCogStat "Intermediate value signal status of vehicle speed" UBYTE SAB_STANDARD_S2_S3 1 100 0 1 ECU_ADDRESS 0xFFF8DCF0 DISPLAY_IDENTIFIER sv_AGS_VVehCogStat.VehicleSpeedIn._.ZFFSAB /end MEASUREMENT
/begin MEASUREMENT ZFFSAB._.VehicleSpeedIn.sv_v_FzgByNab "Output value vehicle speed derived from output rpm" UWORD SAB_V_KMH16_S2_S3 1 100 0 4095.9375 ECU_ADDRESS 0xFFF8DCDE DISPLAY_IDENTIFIER sv_v_FzgByNab.VehicleSpeedIn._.ZFFSAB /end MEASUREMENT
/begin MEASUREMENT ZFFSAB._.VehicleSpeedIn.sv_v_FzgByNabSts "Output value Status of vehicle speed derived from output rpm" UBYTE SAB_STANDARD_S2_S3 1 100 0 2 ECU_ADDRESS 0xFFF8DCE0 DISPLAY_IDENTIFIER sv_v_FzgByNabSts.VehicleSpeedIn._.ZFFSAB /end MEASUREMENT
/begin MEASUREMENT ZFFSAB._.VehicleSpeedIn.sv_v_FzgByNabSts_ "Complement output value Status of vehicle speed derived from output rpm" UBYTE SAB_STANDARD_S2_S3 1 100 0 2 ECU_ADDRESS 0xFFF8DCE4 DISPLAY_IDENTIFIER sv_v_FzgByNabSts_.VehicleSpeedIn._.ZFFSAB /end MEASUREMENT
/begin MEASUREMENT ZFFSAB._.VehicleSpeedIn.sv_v_FzgByNab_ "Complement output value vehicle speed derived from output rpm" UWORD SAB_STANDARD_S2_S3 1 100 0 65535 ECU_ADDRESS 0xFFF8DCE2 DISPLAY_IDENTIFIER sv_v_FzgByNab_.VehicleSpeedIn._.ZFFSAB /end MEASUREMENT
/begin MEASUREMENT ZFFSAB._.VehicleSpeedIn.sv_v_Ist "Output value vehicle speed" UWORD SAB_V_1KMH_S2_S3 1 100 0 65535 ECU_ADDRESS 0xFFF8DCCE DISPLAY_IDENTIFIER sv_v_Ist.VehicleSpeedIn._.ZFFSAB /end MEASUREMENT
/begin MEASUREMENT ZFFSAB._.VehicleSpeedIn.sv_v_IstMax "Output value vehicle speed maximum selection" UWORD SAB_V_1KMH_S2_S3 1 100 0 65535 ECU_ADDRESS 0xFFF8DCD6 DISPLAY_IDENTIFIER sv_v_IstMax.VehicleSpeedIn._.ZFFSAB /end MEASUREMENT
/begin MEASUREMENT ZFFSAB._.VehicleSpeedIn.sv_v_IstMaxSts "Output value signal status of vehicle speed maximum selection" UBYTE SAB_STANDARD_S2_S3 1 100 0 2 ECU_ADDRESS 0xFFF8DCD8 DISPLAY_IDENTIFIER sv_v_IstMaxSts.VehicleSpeedIn._.ZFFSAB /end MEASUREMENT
/begin MEASUREMENT ZFFSAB._.VehicleSpeedIn.sv_v_IstMaxSts_ "Complement output value signal status of vehicle speed maximum selection" UBYTE SAB_STANDARD_S2_S3 1 100 0 255 ECU_ADDRESS 0xFFF8DCDC DISPLAY_IDENTIFIER sv_v_IstMaxSts_.VehicleSpeedIn._.ZFFSAB /end MEASUREMENT
/begin MEASUREMENT ZFFSAB._.VehicleSpeedIn.sv_v_IstMax_ "Complement output value vehicle speed maximum selection" UWORD SAB_STANDARD_S2_S3 1 100 0 65535 ECU_ADDRESS 0xFFF8DCDA DISPLAY_IDENTIFIER sv_v_IstMax_.VehicleSpeedIn._.ZFFSAB /end MEASUREMENT
/begin MEASUREMENT ZFFSAB._.VehicleSpeedIn.sv_v_IstSts "Output value signal status of vehicle speed" UBYTE SAB_STANDARD_S2_S3 1 100 0 2 ECU_ADDRESS 0xFFF8DCD0 DISPLAY_IDENTIFIER sv_v_IstSts.VehicleSpeedIn._.ZFFSAB /end MEASUREMENT
/begin MEASUREMENT ZFFSAB._.VehicleSpeedIn.sv_v_IstSts_ "Complement output value signal status of vehicle speed" UBYTE SAB_STANDARD_S2_S3 1 100 0 2 ECU_ADDRESS 0xFFF8DCD4 DISPLAY_IDENTIFIER sv_v_IstSts_.VehicleSpeedIn._.ZFFSAB /end MEASUREMENT
/begin MEASUREMENT ZFFSAB._.VehicleSpeedIn.sv_v_Ist_ "Complement output value vehicle speed" UWORD SAB_STANDARD_S2_S3 1 100 0 65535 ECU_ADDRESS 0xFFF8DCD2 DISPLAY_IDENTIFIER sv_v_Ist_.VehicleSpeedIn._.ZFFSAB /end MEASUREMENT
/begin MEASUREMENT ZFFSAB._.VehicleSpeedIn.tmr_DelayVIstMaxCalc.time "Description for this variable only in SW documentation possible not in asap2" ULONG SAB_T_TIMER_10MS_S2_S3 1 100 0 42949672950 ECU_ADDRESS 0xFFF8DCC0 DISPLAY_IDENTIFIER time.tmr_DelayVIstMaxCalc.VehicleSpeedIn._.ZFFSAB /end MEASUREMENT
/begin MEASUREMENT ZFFSAB._.VehicleSpeedIn.tmr_DelayVIstMaxCalc.time_ "Description for this variable only in SW documentation possible not in asap2" ULONG SAB_T_TIMER_10MS_S2_S3 1 100 0 42949672950 ECU_ADDRESS 0xFFF8DCC4 DISPLAY_IDENTIFIER time_.tmr_DelayVIstMaxCalc.VehicleSpeedIn._.ZFFSAB /end MEASUREMENT
/begin MEASUREMENT ZFFSAB._.VehicleSpeedIn.v_Fzg "Intermediate value signal vehicle speed" UWORD SAB_V_KMH16_S2_S3 1 100 0 4095.9375 ECU_ADDRESS 0xFFF8DCE6 DISPLAY_IDENTIFIER v_Fzg.VehicleSpeedIn._.ZFFSAB /end MEASUREMENT
/begin MEASUREMENT ZFFSAB._.VehicleSpeedIn.v_FzgSts "Intermediate signal status of vehicle speed" UBYTE SAB_STANDARD_S2_S3 1 100 0 1 ECU_ADDRESS 0xFFF8DCE8 DISPLAY_IDENTIFIER v_FzgSts.VehicleSpeedIn._.ZFFSAB /end MEASUREMENT
/begin MEASUREMENT ZFFSAB._.VehicleSpeedIn.v_FzgSts_ "Complement of v_FzgSts" UBYTE SAB_STANDARD_S2_S3 1 100 0 1 ECU_ADDRESS 0xFFF8DCEC DISPLAY_IDENTIFIER v_FzgSts_.VehicleSpeedIn._.ZFFSAB /end MEASUREMENT
/begin MEASUREMENT ZFFSAB._.VehicleSpeedIn.v_Fzg_ "Complement of v_Fzg" UWORD SAB_STANDARD_S2_S3 1 100 0 65535 ECU_ADDRESS 0xFFF8DCEA DISPLAY_IDENTIFIER v_Fzg_.VehicleSpeedIn._.ZFFSAB /end MEASUREMENT
/begin MEASUREMENT ZFFSAB._.VehicleSpeedIn.v_IstByNWheel "vehicle speed computed by wheel rpm" UWORD SAB_V_1KMH_S2_S3 1 100 0 65535 ECU_ADDRESS 0xFFF8DCFA DISPLAY_IDENTIFIER v_IstByNWheel.VehicleSpeedIn._.ZFFSAB /end MEASUREMENT
/begin MEASUREMENT ZFFSAB._.VoltageMonitoringOut.f_DiagActive_UBATTL "Flag is set if diagnose of KFC_UBATTL is active" UBYTE SAB_STANDARD_S2_S3 1 100 0 1 ECU_ADDRESS 0xFFF95E83 DISPLAY_IDENTIFIER f_DiagActive_UBATTL.VoltageMonitoringOut._.ZFFSAB /end MEASUREMENT
/begin MEASUREMENT ZFFSAB._.VoltageMonitoringOut.f_DiagActive_UBATTU "Flag is set if diagnose of KFC_UBATTU is active" UBYTE SAB_STANDARD_S2_S3 1 100 0 1 ECU_ADDRESS 0xFFF95E82 DISPLAY_IDENTIFIER f_DiagActive_UBATTU.VoltageMonitoringOut._.ZFFSAB /end MEASUREMENT
/begin MEASUREMENT ZFFSAB._.VoltageMonitoringOut.iv_Pos "position of gear-lever" UBYTE SAB_STANDARD_S2_S3 1 100 0 12 ECU_ADDRESS 0xFFF95E78 DISPLAY_IDENTIFIER iv_Pos.VoltageMonitoringOut._.ZFFSAB /end MEASUREMENT
/begin MEASUREMENT ZFFSAB._.VoltageMonitoringOut.iv_fet0_active "Input value for state of FET0" UBYTE SAB_STANDARD_S2_S3 1 100 0 255 ECU_ADDRESS 0xFFF95E7C DISPLAY_IDENTIFIER iv_fet0_active.VoltageMonitoringOut._.ZFFSAB /end MEASUREMENT
/begin MEASUREMENT ZFFSAB._.VoltageMonitoringOut.iv_u_Batt_Diag "actual U_Batt" UWORD SAB_U_1VOLT1000_S2_S3 1 100 0 65.535 ECU_ADDRESS 0xFFF95E7A DISPLAY_IDENTIFIER iv_u_Batt_Diag.VoltageMonitoringOut._.ZFFSAB /end MEASUREMENT
/begin MEASUREMENT ZFFSAB._.VoltageMonitoringOut.sv_f_FET1 "signalizes if FET1 shall be active or not" UBYTE SAB_STANDARD_S2_S3 1 100 0 1 ECU_ADDRESS 0xFFF95E80 DISPLAY_IDENTIFIER sv_f_FET1.VoltageMonitoringOut._.ZFFSAB /end MEASUREMENT
/begin MEASUREMENT ZFFSAB._.VoltageMonitoringOut.sv_f_FET2 "signalizes if FET2 shall be active or not" UBYTE SAB_STANDARD_S2_S3 1 100 0 1 ECU_ADDRESS 0xFFF95E81 DISPLAY_IDENTIFIER sv_f_FET2.VoltageMonitoringOut._.ZFFSAB /end MEASUREMENT
/begin MEASUREMENT ZFFSAB._.VoltageMonitoringOut.sv_f_GetUndervoltageTC "signalizes if the Reset-Documentation is fullfilled" UBYTE SAB_STANDARD_S2_S3 1 100 0 1 ECU_ADDRESS 0xFFF95E7D DISPLAY_IDENTIFIER sv_f_GetUndervoltageTC.VoltageMonitoringOut._.ZFFSAB /end MEASUREMENT
/begin MEASUREMENT ZFFSAB._.VoltageMonitoringOut.sv_f_JumpstartAktiv "signalizes if Jumpstart is active or not" UBYTE SAB_STANDARD_S2_S3 1 100 0 1 ECU_ADDRESS 0xFFF95E7E DISPLAY_IDENTIFIER sv_f_JumpstartAktiv.VoltageMonitoringOut._.ZFFSAB /end MEASUREMENT
/begin MEASUREMENT ZFFSAB._.VoltageMonitoringOut.sv_sts_EDSMV "EDSMV-status to HPSYS" UBYTE SAB_STANDARD_S2_S3 1 100 0 7 ECU_ADDRESS 0xFFF95E7F DISPLAY_IDENTIFIER sv_sts_EDSMV.VoltageMonitoringOut._.ZFFSAB /end MEASUREMENT
/begin MEASUREMENT ZFFSAB._.VoltageMonitoringOut.tmr_DiagActive_UBATTL.time "Description for this variable only in SW documentation possible not in asap2" UBYTE SAB_T_TIMER_10MS_S2_S3 1 100 0 2550 ECU_ADDRESS 0xFFF95E77 DISPLAY_IDENTIFIER time.tmr_DiagActive_UBATTL.VoltageMonitoringOut._.ZFFSAB /end MEASUREMENT
/begin MEASUREMENT ZFFSAB._.VoltageMonitoringOut.tmr_DiagActive_UBATTU.time "Description for this variable only in SW documentation possible not in asap2" UBYTE SAB_T_TIMER_10MS_S2_S3 1 100 0 2550 ECU_ADDRESS 0xFFF95E76 DISPLAY_IDENTIFIER time.tmr_DiagActive_UBATTU.VoltageMonitoringOut._.ZFFSAB /end MEASUREMENT
/begin MEASUREMENT ZFFSAB._.VoltageMonitoringOut.tmr_GearSubstLSSOFF.time "Description for this variable only in SW documentation possible not in asap2" UWORD SAB_T_TIMER_10MS_S2_S3 1 100 0 655350 ECU_ADDRESS 0xFFF95E74 DISPLAY_IDENTIFIER time.tmr_GearSubstLSSOFF.VoltageMonitoringOut._.ZFFSAB /end MEASUREMENT
/begin MEASUREMENT ZFFSAB._.VoltageMonitoringOut.tmr_Jumpstart.time "Description for this variable only in SW documentation possible not in asap2" UWORD SAB_T_TIMER_10MS_S2_S3 1 100 0 655350 ECU_ADDRESS 0xFFF95E70 DISPLAY_IDENTIFIER time.tmr_Jumpstart.VoltageMonitoringOut._.ZFFSAB /end MEASUREMENT
/begin MEASUREMENT ZFFSAB._.VoltageMonitoringOut.tmr_u_BattU.time "Description for this variable only in SW documentation possible not in asap2" UWORD SAB_T_TIMER_10MS_S2_S3 1 100 0 655350 ECU_ADDRESS 0xFFF95E72 DISPLAY_IDENTIFIER time.tmr_u_BattU.VoltageMonitoringOut._.ZFFSAB /end MEASUREMENT
/begin MEASUREMENT ZFFSAB._.WarmUpIn.f_WarmUpSwitchErr "Error flag of WarmUpSwitch-signal" UBYTE SAB_STANDARD_S2_S3 1 100 0 1 ECU_ADDRESS 0xFFF96D08 DISPLAY_IDENTIFIER f_WarmUpSwitchErr.WarmUpIn._.ZFFSAB /end MEASUREMENT
/begin MEASUREMENT ZFFSAB._.WarmUpIn.iv_WarmUpSwitch "Input value engine warm up phase from CAN" UBYTE SAB_STANDARD_S2_S3 1 100 0 3 ECU_ADDRESS 0xFFF96D04 DISPLAY_IDENTIFIER iv_WarmUpSwitch.WarmUpIn._.ZFFSAB /end MEASUREMENT
/begin MEASUREMENT ZFFSAB._.WarmUpIn.iv_WarmUpSwitchSts "Input value message status of engine warm up phase" UBYTE SAB_STANDARD_S2_S3 1 100 0 255 ECU_ADDRESS 0xFFF96D05 DISPLAY_IDENTIFIER iv_WarmUpSwitchSts.WarmUpIn._.ZFFSAB /end MEASUREMENT
/begin MEASUREMENT ZFFSAB._.WarmUpIn.sv_WarmUpSwitch "Output value engine warm up phase" UBYTE SAB_STANDARD_S2_S3 1 100 0 2 ECU_ADDRESS 0xFFF96D06 DISPLAY_IDENTIFIER sv_WarmUpSwitch.WarmUpIn._.ZFFSAB /end MEASUREMENT
/begin MEASUREMENT ZFFSAB._.WarmUpIn.sv_WarmUpSwitchSts "Output value signal status of engine warm up phase" UBYTE SAB_STANDARD_S2_S3 1 100 0 2 ECU_ADDRESS 0xFFF96D07 DISPLAY_IDENTIFIER sv_WarmUpSwitchSts.WarmUpIn._.ZFFSAB /end MEASUREMENT
/begin MEASUREMENT ZFFSAB._.WheelIn.DriveDirWheel "Intermediate value of driving direction of active driven wheels" UBYTE SAB_STANDARD_S2_S3 1 100 0 255 ECU_ADDRESS 0xFFF95B99 DISPLAY_IDENTIFIER DriveDirWheel.WheelIn._.ZFFSAB /end MEASUREMENT
/begin MEASUREMENT ZFFSAB._.WheelIn.DriveDirWheelSts "Intermediate value signal status of driving direction of active driven wheels" UBYTE SAB_STANDARD_S2_S3 1 100 0 255 ECU_ADDRESS 0xFFF95B98 DISPLAY_IDENTIFIER DriveDirWheelSts.WheelIn._.ZFFSAB /end MEASUREMENT
/begin MEASUREMENT ZFFSAB._.WheelIn.FL.f_n_WheelErr "Error flag of Wheel rpm derived from driven wheels" UBYTE SAB_STANDARD_S2_S3 1 100 0 1 ECU_ADDRESS 0xFFF95BA5 DISPLAY_IDENTIFIER f_n_WheelErr.FL.WheelIn._.ZFFSAB /end MEASUREMENT
/begin MEASUREMENT ZFFSAB._.WheelIn.FL.f_v_WheelErr "Error flag of v_Wheel-signal" UBYTE SAB_STANDARD_S2_S3 1 100 0 1 ECU_ADDRESS 0xFFF95BAC DISPLAY_IDENTIFIER f_v_WheelErr.FL.WheelIn._.ZFFSAB /end MEASUREMENT
/begin MEASUREMENT ZFFSAB._.WheelIn.FL.iv_v_Wheel "Input raw signal of wheel speed from CAN" UWORD SAB_N_RADPS64_M32767_S2_S3 1 100 -511.984375 512 ECU_ADDRESS 0xFFF95B9C DISPLAY_IDENTIFIER iv_v_Wheel.FL.WheelIn._.ZFFSAB /end MEASUREMENT
/begin MEASUREMENT ZFFSAB._.WheelIn.FL.iv_v_WheelSts "Input signal message status of wheel speed from CAN" UBYTE SAB_STANDARD_S2_S3 1 100 0 255 ECU_ADDRESS 0xFFF95B9E DISPLAY_IDENTIFIER iv_v_WheelSts.FL.WheelIn._.ZFFSAB /end MEASUREMENT
/begin MEASUREMENT ZFFSAB._.WheelIn.FL.n_Wheel "Wheel rpm derived from driven wheels" SLONG SAB_N_RPM100_S2_S3 1 100 -21474836.48 21474836.47 ECU_ADDRESS 0xFFF95BA0 DISPLAY_IDENTIFIER n_Wheel.FL.WheelIn._.ZFFSAB /end MEASUREMENT
/begin MEASUREMENT ZFFSAB._.WheelIn.FL.n_WheelSts "Status of Wheel rpm derived from driven wheels" UBYTE SAB_STANDARD_S2_S3 1 100 0 2 ECU_ADDRESS 0xFFF95BA4 DISPLAY_IDENTIFIER n_WheelSts.FL.WheelIn._.ZFFSAB /end MEASUREMENT
/begin MEASUREMENT ZFFSAB._.WheelIn.FL.sv_v_Wheel "computed wheel speed with substitute value in error case" UWORD SAB_V_KMH16_S2_S3 1 100 0 4095.9375 ECU_ADDRESS 0xFFF95BA6 DISPLAY_IDENTIFIER sv_v_Wheel.FL.WheelIn._.ZFFSAB /end MEASUREMENT
/begin MEASUREMENT ZFFSAB._.WheelIn.FL.sv_v_WheelSts "status signal of computed wheel speed with substitute value in error case" UBYTE SAB_STANDARD_S2_S3 1 100 0 2 ECU_ADDRESS 0xFFF95BA8 DISPLAY_IDENTIFIER sv_v_WheelSts.FL.WheelIn._.ZFFSAB /end MEASUREMENT
/begin MEASUREMENT ZFFSAB._.WheelIn.FL.v_WheelBalanced "computed wheel speed" UWORD SAB_V_KMH16_S2_S3 1 100 0 4095.9375 ECU_ADDRESS 0xFFF95BAA DISPLAY_IDENTIFIER v_WheelBalanced.FL.WheelIn._.ZFFSAB /end MEASUREMENT
/begin MEASUREMENT ZFFSAB._.WheelIn.FR.f_n_WheelErr "Error flag of Wheel rpm derived from driven wheels" UBYTE SAB_STANDARD_S2_S3 1 100 0 1 ECU_ADDRESS 0xFFF95BB9 DISPLAY_IDENTIFIER f_n_WheelErr.FR.WheelIn._.ZFFSAB /end MEASUREMENT
/begin MEASUREMENT ZFFSAB._.WheelIn.FR.f_v_WheelErr "Error flag of v_Wheel-signal" UBYTE SAB_STANDARD_S2_S3 1 100 0 1 ECU_ADDRESS 0xFFF95BC0 DISPLAY_IDENTIFIER f_v_WheelErr.FR.WheelIn._.ZFFSAB /end MEASUREMENT
/begin MEASUREMENT ZFFSAB._.WheelIn.FR.iv_v_Wheel "Input raw signal of wheel speed from CAN" UWORD SAB_N_RADPS64_M32767_S2_S3 1 100 -511.984375 512 ECU_ADDRESS 0xFFF95BB0 DISPLAY_IDENTIFIER iv_v_Wheel.FR.WheelIn._.ZFFSAB /end MEASUREMENT
/begin MEASUREMENT ZFFSAB._.WheelIn.FR.iv_v_WheelSts "Input signal message status of wheel speed from CAN" UBYTE SAB_STANDARD_S2_S3 1 100 0 255 ECU_ADDRESS 0xFFF95BB2 DISPLAY_IDENTIFIER iv_v_WheelSts.FR.WheelIn._.ZFFSAB /end MEASUREMENT
/begin MEASUREMENT ZFFSAB._.WheelIn.FR.n_Wheel "Wheel rpm derived from driven wheels" SLONG SAB_N_RPM100_S2_S3 1 100 -21474836.48 21474836.47 ECU_ADDRESS 0xFFF95BB4 DISPLAY_IDENTIFIER n_Wheel.FR.WheelIn._.ZFFSAB /end MEASUREMENT
/begin MEASUREMENT ZFFSAB._.WheelIn.FR.n_WheelSts "Status of Wheel rpm derived from driven wheels" UBYTE SAB_STANDARD_S2_S3 1 100 0 2 ECU_ADDRESS 0xFFF95BB8 DISPLAY_IDENTIFIER n_WheelSts.FR.WheelIn._.ZFFSAB /end MEASUREMENT
/begin MEASUREMENT ZFFSAB._.WheelIn.FR.sv_v_Wheel "computed wheel speed with substitute value in error case" UWORD SAB_V_KMH16_S2_S3 1 100 0 4095.9375 ECU_ADDRESS 0xFFF95BBA DISPLAY_IDENTIFIER sv_v_Wheel.FR.WheelIn._.ZFFSAB /end MEASUREMENT
/begin MEASUREMENT ZFFSAB._.WheelIn.FR.sv_v_WheelSts "status signal of computed wheel speed with substitute value in error case" UBYTE SAB_STANDARD_S2_S3 1 100 0 2 ECU_ADDRESS 0xFFF95BBC DISPLAY_IDENTIFIER sv_v_WheelSts.FR.WheelIn._.ZFFSAB /end MEASUREMENT
/begin MEASUREMENT ZFFSAB._.WheelIn.FR.v_WheelBalanced "computed wheel speed" UWORD SAB_V_KMH16_S2_S3 1 100 0 4095.9375 ECU_ADDRESS 0xFFF95BBE DISPLAY_IDENTIFIER v_WheelBalanced.FR.WheelIn._.ZFFSAB /end MEASUREMENT
/begin MEASUREMENT ZFFSAB._.WheelIn.RL.f_n_WheelErr "Error flag of Wheel rpm derived from driven wheels" UBYTE SAB_STANDARD_S2_S3 1 100 0 1 ECU_ADDRESS 0xFFF95BCD DISPLAY_IDENTIFIER f_n_WheelErr.RL.WheelIn._.ZFFSAB /end MEASUREMENT
/begin MEASUREMENT ZFFSAB._.WheelIn.RL.f_v_WheelErr "Error flag of v_Wheel-signal" UBYTE SAB_STANDARD_S2_S3 1 100 0 1 ECU_ADDRESS 0xFFF95BD4 DISPLAY_IDENTIFIER f_v_WheelErr.RL.WheelIn._.ZFFSAB /end MEASUREMENT
/begin MEASUREMENT ZFFSAB._.WheelIn.RL.iv_v_Wheel "Input raw signal of wheel speed from CAN" UWORD SAB_N_RADPS64_M32767_S2_S3 1 100 -511.984375 512 ECU_ADDRESS 0xFFF95BC4 DISPLAY_IDENTIFIER iv_v_Wheel.RL.WheelIn._.ZFFSAB /end MEASUREMENT
/begin MEASUREMENT ZFFSAB._.WheelIn.RL.iv_v_WheelSts "Input signal message status of wheel speed from CAN" UBYTE SAB_STANDARD_S2_S3 1 100 0 255 ECU_ADDRESS 0xFFF95BC6 DISPLAY_IDENTIFIER iv_v_WheelSts.RL.WheelIn._.ZFFSAB /end MEASUREMENT
/begin MEASUREMENT ZFFSAB._.WheelIn.RL.n_Wheel "Wheel rpm derived from driven wheels" SLONG SAB_N_RPM100_S2_S3 1 100 -21474836.48 21474836.47 ECU_ADDRESS 0xFFF95BC8 DISPLAY_IDENTIFIER n_Wheel.RL.WheelIn._.ZFFSAB /end MEASUREMENT
/begin MEASUREMENT ZFFSAB._.WheelIn.RL.n_WheelSts "Status of Wheel rpm derived from driven wheels" UBYTE SAB_STANDARD_S2_S3 1 100 0 2 ECU_ADDRESS 0xFFF95BCC DISPLAY_IDENTIFIER n_WheelSts.RL.WheelIn._.ZFFSAB /end MEASUREMENT
/begin MEASUREMENT ZFFSAB._.WheelIn.RL.sv_v_Wheel "computed wheel speed with substitute value in error case" UWORD SAB_V_KMH16_S2_S3 1 100 0 4095.9375 ECU_ADDRESS 0xFFF95BCE DISPLAY_IDENTIFIER sv_v_Wheel.RL.WheelIn._.ZFFSAB /end MEASUREMENT
/begin MEASUREMENT ZFFSAB._.WheelIn.RL.sv_v_WheelSts "status signal of computed wheel speed with substitute value in error case" UBYTE SAB_STANDARD_S2_S3 1 100 0 2 ECU_ADDRESS 0xFFF95BD0 DISPLAY_IDENTIFIER sv_v_WheelSts.RL.WheelIn._.ZFFSAB /end MEASUREMENT
/begin MEASUREMENT ZFFSAB._.WheelIn.RL.v_WheelBalanced "computed wheel speed" UWORD SAB_V_KMH16_S2_S3 1 100 0 4095.9375 ECU_ADDRESS 0xFFF95BD2 DISPLAY_IDENTIFIER v_WheelBalanced.RL.WheelIn._.ZFFSAB /end MEASUREMENT
/begin MEASUREMENT ZFFSAB._.WheelIn.RR.f_n_WheelErr "Error flag of Wheel rpm derived from driven wheels" UBYTE SAB_STANDARD_S2_S3 1 100 0 1 ECU_ADDRESS 0xFFF95BE1 DISPLAY_IDENTIFIER f_n_WheelErr.RR.WheelIn._.ZFFSAB /end MEASUREMENT
/begin MEASUREMENT ZFFSAB._.WheelIn.RR.f_v_WheelErr "Error flag of v_Wheel-signal" UBYTE SAB_STANDARD_S2_S3 1 100 0 1 ECU_ADDRESS 0xFFF95BE8 DISPLAY_IDENTIFIER f_v_WheelErr.RR.WheelIn._.ZFFSAB /end MEASUREMENT
/begin MEASUREMENT ZFFSAB._.WheelIn.RR.iv_v_Wheel "Input raw signal of wheel speed from CAN" UWORD SAB_N_RADPS64_M32767_S2_S3 1 100 -511.984375 512 ECU_ADDRESS 0xFFF95BD8 DISPLAY_IDENTIFIER iv_v_Wheel.RR.WheelIn._.ZFFSAB /end MEASUREMENT
/begin MEASUREMENT ZFFSAB._.WheelIn.RR.iv_v_WheelSts "Input signal message status of wheel speed from CAN" UBYTE SAB_STANDARD_S2_S3 1 100 0 255 ECU_ADDRESS 0xFFF95BDA DISPLAY_IDENTIFIER iv_v_WheelSts.RR.WheelIn._.ZFFSAB /end MEASUREMENT
/begin MEASUREMENT ZFFSAB._.WheelIn.RR.n_Wheel "Wheel rpm derived from driven wheels" SLONG SAB_N_RPM100_S2_S3 1 100 -21474836.48 21474836.47 ECU_ADDRESS 0xFFF95BDC DISPLAY_IDENTIFIER n_Wheel.RR.WheelIn._.ZFFSAB /end MEASUREMENT
/begin MEASUREMENT ZFFSAB._.WheelIn.RR.n_WheelSts "Status of Wheel rpm derived from driven wheels" UBYTE SAB_STANDARD_S2_S3 1 100 0 2 ECU_ADDRESS 0xFFF95BE0 DISPLAY_IDENTIFIER n_WheelSts.RR.WheelIn._.ZFFSAB /end MEASUREMENT
/begin MEASUREMENT ZFFSAB._.WheelIn.RR.sv_v_Wheel "computed wheel speed with substitute value in error case" UWORD SAB_V_KMH16_S2_S3 1 100 0 4095.9375 ECU_ADDRESS 0xFFF95BE2 DISPLAY_IDENTIFIER sv_v_Wheel.RR.WheelIn._.ZFFSAB /end MEASUREMENT
/begin MEASUREMENT ZFFSAB._.WheelIn.RR.sv_v_WheelSts "status signal of computed wheel speed with substitute value in error case" UBYTE SAB_STANDARD_S2_S3 1 100 0 2 ECU_ADDRESS 0xFFF95BE4 DISPLAY_IDENTIFIER sv_v_WheelSts.RR.WheelIn._.ZFFSAB /end MEASUREMENT
/begin MEASUREMENT ZFFSAB._.WheelIn.RR.v_WheelBalanced "computed wheel speed" UWORD SAB_V_KMH16_S2_S3 1 100 0 4095.9375 ECU_ADDRESS 0xFFF95BE6 DISPLAY_IDENTIFIER v_WheelBalanced.RR.WheelIn._.ZFFSAB /end MEASUREMENT
/begin MEASUREMENT ZFFSAB._.WheelIn.cod_SWI_WheelActivePassive "Intermediate value switch for selection of driven axle" UBYTE SAB_STANDARD_S2_S3 1 100 0 3 ECU_ADDRESS 0xFFF95B75 DISPLAY_IDENTIFIER cod_SWI_WheelActivePassive.WheelIn._.ZFFSAB /end MEASUREMENT
/begin MEASUREMENT ZFFSAB._.WheelIn.f_n_WheelAvgErr "Error flag of average Wheel rpm derived from driven wheels" UBYTE SAB_STANDARD_S2_S3 1 100 0 1 ECU_ADDRESS 0xFFF95B95 DISPLAY_IDENTIFIER f_n_WheelAvgErr.WheelIn._.ZFFSAB /end MEASUREMENT
/begin MEASUREMENT ZFFSAB._.WheelIn.lfz_Wheel "REPRESENT_INTERMEDIATE value of calculated dynamic wheel circumference" UWORD SAB_L_1MM_S2_S3 1 100 0 4095 ECU_ADDRESS 0xFFF95B72 DISPLAY_IDENTIFIER lfz_Wheel.WheelIn._.ZFFSAB /end MEASUREMENT
/begin MEASUREMENT ZFFSAB._.WheelIn.lfz_WheelSts "REPRESENT_INTERMEDIATE value signal status of calculated lfz_Wheel" UBYTE SAB_STANDARD_S2_S3 1 100 0 2 ECU_ADDRESS 0xFFF95B74 DISPLAY_IDENTIFIER lfz_WheelSts.WheelIn._.ZFFSAB /end MEASUREMENT
/begin MEASUREMENT ZFFSAB._.WheelIn.n_AbFilt1 "Intermediate value output rpm (filtered with PT1)" UWORD SAB_N_1RPM_S2_S3 1 100 0 65535 ECU_ADDRESS 0xFFF95B96 DISPLAY_IDENTIFIER n_AbFilt1.WheelIn._.ZFFSAB /end MEASUREMENT
/begin MEASUREMENT ZFFSAB._.WheelIn.n_Ab_ByWheelActL "Output rpm value derived from left driven wheel" UWORD SAB_N_1RPM_S2_S3 1 100 0 65535 ECU_ADDRESS 0xFFF95B78 DISPLAY_IDENTIFIER n_Ab_ByWheelActL.WheelIn._.ZFFSAB /end MEASUREMENT
/begin MEASUREMENT ZFFSAB._.WheelIn.n_Ab_ByWheelActR "Output rpm value derived from right driven wheel" UWORD SAB_N_1RPM_S2_S3 1 100 0 65535 ECU_ADDRESS 0xFFF95B7A DISPLAY_IDENTIFIER n_Ab_ByWheelActR.WheelIn._.ZFFSAB /end MEASUREMENT
/begin MEASUREMENT ZFFSAB._.WheelIn.n_Ab_ByWheelActiveAvg "Intermediate value output rpm derived from driven wheels" UWORD SAB_N_1RPM_S2_S3 1 100 0 65535 ECU_ADDRESS 0xFFF95B84 DISPLAY_IDENTIFIER n_Ab_ByWheelActiveAvg.WheelIn._.ZFFSAB /end MEASUREMENT
/begin MEASUREMENT ZFFSAB._.WheelIn.n_Ab_ByWheelPassiveAvg "Intermediate value output rpm derived from not driven wheels" UWORD SAB_N_1RPM_S2_S3 1 100 0 65535 ECU_ADDRESS 0xFFF95B86 DISPLAY_IDENTIFIER n_Ab_ByWheelPassiveAvg.WheelIn._.ZFFSAB /end MEASUREMENT
/begin MEASUREMENT ZFFSAB._.WheelIn.n_WheelAvg "Average Wheel rpm of all driven wheels" ULONG SAB_N_RPM100_S2_S3 1 100 0 42949672.95 ECU_ADDRESS 0xFFF95B90 DISPLAY_IDENTIFIER n_WheelAvg.WheelIn._.ZFFSAB /end MEASUREMENT
/begin MEASUREMENT ZFFSAB._.WheelIn.n_WheelAvgSts "Status of average Wheel rpm derived from driven wheels" UBYTE SAB_STANDARD_S2_S3 1 100 0 2 ECU_ADDRESS 0xFFF95B94 DISPLAY_IDENTIFIER n_WheelAvgSts.WheelIn._.ZFFSAB /end MEASUREMENT
/begin MEASUREMENT ZFFSAB._.WheelIn.sv_AGS_FourWheelDrive "Intermediate value of driven axle" UBYTE SAB_STANDARD_S2_S3 1 100 0 2 ECU_ADDRESS 0xFFF95B70 DISPLAY_IDENTIFIER sv_AGS_FourWheelDrive.WheelIn._.ZFFSAB /end MEASUREMENT
/begin MEASUREMENT ZFFSAB._.WheelIn.sv_n_Ab_ByWheelActiveAvgFilt "REPRESENT_INTERMEDIATE value filtered average output rpm derived from driven wheels" UWORD SAB_N_1RPM_S2_S3 1 100 0 65535 ECU_ADDRESS 0xFFF95B6E DISPLAY_IDENTIFIER sv_n_Ab_ByWheelActiveAvgFilt.WheelIn._.ZFFSAB /end MEASUREMENT
/begin MEASUREMENT ZFFSAB._.WheelIn.sv_n_Ab_ByWheelActiveBalancedAvg "Intermediate value balanced output rpm derived from driven wheels" UWORD SAB_N_1RPM_S2_S3 1 100 0 65535 ECU_ADDRESS 0xFFF95B76 DISPLAY_IDENTIFIER sv_n_Ab_ByWheelActiveBalancedAvg.WheelIn._.ZFFSAB /end MEASUREMENT
/begin MEASUREMENT ZFFSAB._.WheelIn.sv_v_WheelActiveAvg "REPRESENT_INTERMEDIATE value of derived average speed of driven axle" UWORD SAB_V_KMH16_S2_S3 1 100 0 4095.9375 ECU_ADDRESS 0xFFF95B6C DISPLAY_IDENTIFIER sv_v_WheelActiveAvg.WheelIn._.ZFFSAB /end MEASUREMENT
/begin MEASUREMENT ZFFSAB._.WheelIn.sv_v_WheelActiveAvgSts "REPRESENT_INTERMEDIATE value signal status of derived average speed of driven axle" UBYTE SAB_STANDARD_S2_S3 1 100 0 255 ECU_ADDRESS 0xFFF95B6A DISPLAY_IDENTIFIER sv_v_WheelActiveAvgSts.WheelIn._.ZFFSAB /end MEASUREMENT
/begin MEASUREMENT ZFFSAB._.WheelIn.v_WheelActiveBalancedAvg "Intermediate value derived balanced wheel speed from driven wheels" UWORD SAB_V_KMH16_S2_S3 1 100 0 4095.9375 ECU_ADDRESS 0xFFF95B7E DISPLAY_IDENTIFIER v_WheelActiveBalancedAvg.WheelIn._.ZFFSAB /end MEASUREMENT
/begin MEASUREMENT ZFFSAB._.WheelIn.v_WheelAvg "Intermediate value of average wheel speed of all four wheels" UWORD SAB_V_KMH16_S2_S3 1 100 0 4095.9375 ECU_ADDRESS 0xFFF95B8C DISPLAY_IDENTIFIER v_WheelAvg.WheelIn._.ZFFSAB /end MEASUREMENT
/begin MEASUREMENT ZFFSAB._.WheelIn.v_WheelAvgSts "Intermediate value signal status of average wheel speed of all four wheels" UWORD SAB_STANDARD_S2_S3 1 100 0 65535 ECU_ADDRESS 0xFFF95B8A DISPLAY_IDENTIFIER v_WheelAvgSts.WheelIn._.ZFFSAB /end MEASUREMENT
/begin MEASUREMENT ZFFSAB._.WheelIn.v_WheelDiagSts "Input signal message status of wheel speed from CAN" UBYTE SAB_STANDARD_S2_S3 1 100 0 255 ECU_ADDRESS 0xFFF95B7C DISPLAY_IDENTIFIER v_WheelDiagSts.WheelIn._.ZFFSAB /end MEASUREMENT
/begin MEASUREMENT ZFFSAB._.WheelIn.v_WheelFSts "Intermediate value signal status of wheel speed front" UBYTE SAB_STANDARD_S2_S3 1 100 0 255 ECU_ADDRESS 0xFFF95B88 DISPLAY_IDENTIFIER v_WheelFSts.WheelIn._.ZFFSAB /end MEASUREMENT
/begin MEASUREMENT ZFFSAB._.WheelIn.v_WheelPassiveAvg "Intermediate value average wheel speed of not driven axle (front)" UWORD SAB_V_KMH16_S2_S3 1 100 0 4095.9375 ECU_ADDRESS 0xFFF95B82 DISPLAY_IDENTIFIER v_WheelPassiveAvg.WheelIn._.ZFFSAB /end MEASUREMENT
/begin MEASUREMENT ZFFSAB._.WheelIn.v_WheelPassiveAvgSts "Intermediate value signal status of average wheel speed of not driven axle (front)" UBYTE SAB_STANDARD_S2_S3 1 100 0 255 ECU_ADDRESS 0xFFF95B80 DISPLAY_IDENTIFIER v_WheelPassiveAvgSts.WheelIn._.ZFFSAB /end MEASUREMENT
/begin MEASUREMENT ZFFSAB._.WheelIn.v_WheelRSts "Intermediate value signal status of wheel speed rear" UBYTE SAB_STANDARD_S2_S3 1 100 0 255 ECU_ADDRESS 0xFFF95B89 DISPLAY_IDENTIFIER v_WheelRSts.WheelIn._.ZFFSAB /end MEASUREMENT
/begin MEASUREMENT ZFFSAB._.YawIn.f_YawRateErr "Error flag of yaw rate" UBYTE SAB_STANDARD_S2_S3 1 100 0 1 ECU_ADDRESS 0xFFF96E54 DISPLAY_IDENTIFIER f_YawRateErr.YawIn._.ZFFSAB /end MEASUREMENT
/begin MEASUREMENT ZFFSAB._.YawIn.iv_YawQURateSts "Qualifier signal for YawRate-signal" UBYTE SAB_STANDARD_S2_S3 1 100 0 255 ECU_ADDRESS 0xFFF96E4C DISPLAY_IDENTIFIER iv_YawQURateSts.YawIn._.ZFFSAB /end MEASUREMENT
/begin MEASUREMENT ZFFSAB._.YawIn.iv_YawRate "Input value yaw rate from CAN" UWORD SAB_OM_YAWRATE_GRADPS200_M32768_S2_S3 1 100 -163.84 163.835 ECU_ADDRESS 0xFFF96E4E DISPLAY_IDENTIFIER iv_YawRate.YawIn._.ZFFSAB /end MEASUREMENT
/begin MEASUREMENT ZFFSAB._.YawIn.iv_YawRateSts "Input value message status of yaw rate" UBYTE SAB_STANDARD_S2_S3 1 100 0 255 ECU_ADDRESS 0xFFF96E50 DISPLAY_IDENTIFIER iv_YawRateSts.YawIn._.ZFFSAB /end MEASUREMENT
/begin MEASUREMENT ZFFSAB._.YawIn.sv_YawRate "Output value yaw rate" SWORD SAB_OM_YAWRATE_GRADPS20_S2_S3 1 100 -1638.4 1638.35 ECU_ADDRESS 0xFFF96E52 DISPLAY_IDENTIFIER sv_YawRate.YawIn._.ZFFSAB /end MEASUREMENT
/begin MEASUREMENT ZFFSAB._.YawIn.sv_f_YawRateSts "Output value signal status of yaw rate" UBYTE SAB_STANDARD_S2_S3 1 100 0 2 ECU_ADDRESS 0xFFF96E51 DISPLAY_IDENTIFIER sv_f_YawRateSts.YawIn._.ZFFSAB /end MEASUREMENT
/begin MEASUREMENT ZFFSAB2._.ConfEGSACCOut.iv_EGSACCStsReceipt "Input value message status of EGSACC status" UBYTE SAB2_STANDARD_S3_S3 1 100 0 255 ECU_ADDRESS 0xFFF96EE0 DISPLAY_IDENTIFIER iv_EGSACCStsReceipt.ConfEGSACCOut._.ZFFSAB2 /end MEASUREMENT
/begin MEASUREMENT ZFFSAB2._.ConfEGSACCOut.sv_EGSACCStsReceipt "Output value confirmation of received message derived from message status" UBYTE SAB2_STANDARD_S3_S3 1 100 0 2 ECU_ADDRESS 0xFFF96EE1 DISPLAY_IDENTIFIER sv_EGSACCStsReceipt.ConfEGSACCOut._.ZFFSAB2 /end MEASUREMENT
/begin MEASUREMENT ZFFSAB2._.CoolingReqOut.iv_c_CoolMax "Input value cooling request from HPSYS" UBYTE SAB2_STANDARD_S3_S3 1 100 0 2 ECU_ADDRESS 0xFFF96EE2 DISPLAY_IDENTIFIER iv_c_CoolMax.CoolingReqOut._.ZFFSAB2 /end MEASUREMENT
/begin MEASUREMENT ZFFSAB2._.CoolingReqOut.sv_CoolerRequest "Output value cooling request" UBYTE SAB2_STANDARD_S3_S3 1 100 0 3 ECU_ADDRESS 0xFFF96EE3 DISPLAY_IDENTIFIER sv_CoolerRequest.CoolingReqOut._.ZFFSAB2 /end MEASUREMENT
/begin MEASUREMENT ZFFSAB2._.DashboardInfoOut.f_CtlDispPosErr "Error flag of sv_CtlDispPos" UBYTE SAB2_STANDARD_S3_S3 1 100 0 255 ECU_ADDRESS 0xFFF96D36 DISPLAY_IDENTIFIER f_CtlDispPosErr.DashboardInfoOut._.ZFFSAB2 /end MEASUREMENT
/begin MEASUREMENT ZFFSAB2._.DashboardInfoOut.f_CtlDispPosErr_ "Complement for the error flag of sv_CtlDispPos" UBYTE SAB2_STANDARD_S3_S3 1 100 0 255 ECU_ADDRESS 0xFFF96D37 DISPLAY_IDENTIFIER f_CtlDispPosErr_.DashboardInfoOut._.ZFFSAB2 /end MEASUREMENT
/begin MEASUREMENT ZFFSAB2._.DashboardInfoOut.iv_CtlDispPos "Indication of the gearbox position" UBYTE SAB2_STANDARD_S3_S3 1 100 0 7 ECU_ADDRESS 0xFFF96D32 DISPLAY_IDENTIFIER iv_CtlDispPos.DashboardInfoOut._.ZFFSAB2 /end MEASUREMENT
/begin MEASUREMENT ZFFSAB2._.DashboardInfoOut.iv_CtlDispPos_ "Complement for the indication of the gearbox position" UBYTE SAB2_STANDARD_S3_S3 1 100 0 255 ECU_ADDRESS 0xFFF96D33 DISPLAY_IDENTIFIER iv_CtlDispPos_.DashboardInfoOut._.ZFFSAB2 /end MEASUREMENT
/begin MEASUREMENT ZFFSAB2._.DashboardInfoOut.sv_CtlDispPos "Output signal of the complement for the indication of the gearbox position" UBYTE SAB2_STANDARD_S3_S3 1 100 0 7 ECU_ADDRESS 0xFFF96D34 DISPLAY_IDENTIFIER sv_CtlDispPos.DashboardInfoOut._.ZFFSAB2 /end MEASUREMENT
/begin MEASUREMENT ZFFSAB2._.DashboardInfoOut.sv_CtlDispPos_ "Output signal of the complement for the indication of the gearbox position" UBYTE SAB2_STANDARD_S3_S3 1 100 0 255 ECU_ADDRESS 0xFFF96D35 DISPLAY_IDENTIFIER sv_CtlDispPos_.DashboardInfoOut._.ZFFSAB2 /end MEASUREMENT
/begin MEASUREMENT ZFFSAB2._.EngIdleRaiseReqOut.f_n_EngIdleRaiseRequestErr "Error flag for the n_EngIdleRaiseRequest" UBYTE SAB2_STANDARD_S3_S3 1 100 0 1 ECU_ADDRESS 0xFFF96D3D DISPLAY_IDENTIFIER f_n_EngIdleRaiseRequestErr.EngIdleRaiseReqOut._.ZFFSAB2 /end MEASUREMENT
/begin MEASUREMENT ZFFSAB2._.EngIdleRaiseReqOut.f_n_EngIdleRaiseRequestErr_ "Complement error flag for the n_EngIdleRaiseRequest" UBYTE SAB2_STANDARD_S3_S3 1 100 0 255 ECU_ADDRESS 0xFFF96D3E DISPLAY_IDENTIFIER f_n_EngIdleRaiseRequestErr_.EngIdleRaiseReqOut._.ZFFSAB2 /end MEASUREMENT
/begin MEASUREMENT ZFFSAB2._.EngIdleRaiseReqOut.iv_n_EngIdleRaiseRequestHAS "Input value desired idle speed from HAS" UBYTE SAB2_N_10RPM_S3_S3 1 100 0 2550 ECU_ADDRESS 0xFFF96D39 DISPLAY_IDENTIFIER iv_n_EngIdleRaiseRequestHAS.EngIdleRaiseReqOut._.ZFFSAB2 /end MEASUREMENT
/begin MEASUREMENT ZFFSAB2._.EngIdleRaiseReqOut.iv_n_EngIdleRaiseRequestHAS_ "Complement input value desired idle speed from HAS" UBYTE SAB2_STANDARD_S3_S3 1 100 0 255 ECU_ADDRESS 0xFFF96D3A DISPLAY_IDENTIFIER iv_n_EngIdleRaiseRequestHAS_.EngIdleRaiseReqOut._.ZFFSAB2 /end MEASUREMENT
/begin MEASUREMENT ZFFSAB2._.EngIdleRaiseReqOut.sv_n_EngIdleRaiseRequest "Output value of desired idle speed" UBYTE SAB2_N_8RPM_S3_S3 1 100 0 2040 ECU_ADDRESS 0xFFF96D3B DISPLAY_IDENTIFIER sv_n_EngIdleRaiseRequest.EngIdleRaiseReqOut._.ZFFSAB2 /end MEASUREMENT
/begin MEASUREMENT ZFFSAB2._.EngIdleRaiseReqOut.sv_n_EngIdleRaiseRequest_ "Complement output value of desired idle speed" UBYTE SAB2_STANDARD_S3_S3 1 100 0 255 ECU_ADDRESS 0xFFF96D3C DISPLAY_IDENTIFIER sv_n_EngIdleRaiseRequest_.EngIdleRaiseReqOut._.ZFFSAB2 /end MEASUREMENT
/begin MEASUREMENT ZFFSAB2._.EngineInterventionMonitoringOut.arrayPointer_EngineInterventionType "Internal variable: Signalize which type of intervention is active; 0: Pos Me + Up Shifting; 1: Pos Me + Down Shifting; 2: Red Me + Up Shifting; 3: Red Me + Down Shifting; 255: Init value" UBYTE SAB2_STANDARD_S3_S3 1 100 0 255 ECU_ADDRESS 0xFFF961BB DISPLAY_IDENTIFIER arrayPointer_EngineInterventionType.EngineInterventionMonitoringOut._.ZFFSAB2 /end MEASUREMENT
/begin MEASUREMENT ZFFSAB2._.EngineInterventionMonitoringOut.f_EIMonActiv "Flag which reported if all conditions for activation of EI monitoring are fulfiled; 0: Not active; 1: Active" UBYTE SAB2_STANDARD_S3_S3 1 100 0 1 ECU_ADDRESS 0xFFF961BD DISPLAY_IDENTIFIER f_EIMonActiv.EngineInterventionMonitoringOut._.ZFFSAB2 /end MEASUREMENT
/begin MEASUREMENT ZFFSAB2._.EngineInterventionMonitoringOut.f_EI_IntegralMonActiv "Flag which reported if minimum size and type of intervention are fulfilled for settitng of the error memory; 0: Not fulfilled; 1: fulfilled" UBYTE SAB2_STANDARD_S3_S3 1 100 0 1 ECU_ADDRESS 0xFFF961BE DISPLAY_IDENTIFIER f_EI_IntegralMonActiv.EngineInterventionMonitoringOut._.ZFFSAB2 /end MEASUREMENT
/begin MEASUREMENT ZFFSAB2._.EngineInterventionMonitoringOut.f_EI_PosRealizedHighPErrMem "Flag which reported; that pos. EI was too strong. Record in Primary-Error memory. 0 = difference between requested and realized EI within limits; 1 = EI is too strong" UBYTE SAB2_STANDARD_S3_S3 1 100 0 1 ECU_ADDRESS 0xFFF961E0 DISPLAY_IDENTIFIER f_EI_PosRealizedHighPErrMem.EngineInterventionMonitoringOut._.ZFFSAB2 /end MEASUREMENT
/begin MEASUREMENT ZFFSAB2._.EngineInterventionMonitoringOut.f_EI_PosRealizedHighSErrMem "Flag which reported; that pos. EI was too strong. Record in Shadow-Error memory. 0 = difference between requested and realized EI within limits; 1 = EI is too strong" UBYTE SAB2_STANDARD_S3_S3 1 100 0 1 ECU_ADDRESS 0xFFF961DC DISPLAY_IDENTIFIER f_EI_PosRealizedHighSErrMem.EngineInterventionMonitoringOut._.ZFFSAB2 /end MEASUREMENT
/begin MEASUREMENT ZFFSAB2._.EngineInterventionMonitoringOut.f_EI_PosRealizedLowPErrMem "Flag which reported; that pos. EI was too weak. Record in Primary-Error memory. 0 = difference between requested and realized EI within limits; 1 = EI is too weak" UBYTE SAB2_STANDARD_S3_S3 1 100 0 1 ECU_ADDRESS 0xFFF961DF DISPLAY_IDENTIFIER f_EI_PosRealizedLowPErrMem.EngineInterventionMonitoringOut._.ZFFSAB2 /end MEASUREMENT
/begin MEASUREMENT ZFFSAB2._.EngineInterventionMonitoringOut.f_EI_PosRealizedLowSErrMem "Flag which reported; that pos. EI was too weak. Record in Shadow-Error memory. 0 = difference between requested and realized EI within limits; 1 = EI is too weak" UBYTE SAB2_STANDARD_S3_S3 1 100 0 1 ECU_ADDRESS 0xFFF961DB DISPLAY_IDENTIFIER f_EI_PosRealizedLowSErrMem.EngineInterventionMonitoringOut._.ZFFSAB2 /end MEASUREMENT
/begin MEASUREMENT ZFFSAB2._.EngineInterventionMonitoringOut.f_EI_RedRealizedHighPErrMem "Flag which reported; that red. EI was too strong. Record in Primary-Error memory. 0 = difference between requested and realized EI within limits; 1 = EI is too strong" UBYTE SAB2_STANDARD_S3_S3 1 100 0 1 ECU_ADDRESS 0xFFF961DE DISPLAY_IDENTIFIER f_EI_RedRealizedHighPErrMem.EngineInterventionMonitoringOut._.ZFFSAB2 /end MEASUREMENT
/begin MEASUREMENT ZFFSAB2._.EngineInterventionMonitoringOut.f_EI_RedRealizedHighSErrMem "Flag which reported; that red. EI was too strong. Record in Shadow-Error memory. 0 = difference between requested and realized EI within limits; 1 = EI is too strong" UBYTE SAB2_STANDARD_S3_S3 1 100 0 1 ECU_ADDRESS 0xFFF961DA DISPLAY_IDENTIFIER f_EI_RedRealizedHighSErrMem.EngineInterventionMonitoringOut._.ZFFSAB2 /end MEASUREMENT
/begin MEASUREMENT ZFFSAB2._.EngineInterventionMonitoringOut.f_EI_RedRealizedLowPErrMem "Flag which reported; that red. EI was too weak. Record in Primary-Error memory. 0 = difference between requested and realized EI within limits; 1 = EI is too weak" UBYTE SAB2_STANDARD_S3_S3 1 100 0 1 ECU_ADDRESS 0xFFF961DD DISPLAY_IDENTIFIER f_EI_RedRealizedLowPErrMem.EngineInterventionMonitoringOut._.ZFFSAB2 /end MEASUREMENT
/begin MEASUREMENT ZFFSAB2._.EngineInterventionMonitoringOut.f_EI_RedRealizedLowSErrMem "Flag which reported; that red. EI was too weak. Record in Shadow-Error memory. 0 = difference between requested and realized EI within limits; 1 = EI is too weak" UBYTE SAB2_STANDARD_S3_S3 1 100 0 1 ECU_ADDRESS 0xFFF961D9 DISPLAY_IDENTIFIER f_EI_RedRealizedLowSErrMem.EngineInterventionMonitoringOut._.ZFFSAB2 /end MEASUREMENT
/begin MEASUREMENT ZFFSAB2._.EngineInterventionMonitoringOut.iv_m_Crank "Input value of current torque of crankshaft corrected by the pump intake torque. Output variable from SABIN class CrankShaftCurTorqueIn." SWORD SAB2_M_1NM_S3_S3 1 100 -400 1640 ECU_ADDRESS 0xFFF961B8 DISPLAY_IDENTIFIER iv_m_Crank.EngineInterventionMonitoringOut._.ZFFSAB2 /end MEASUREMENT
/begin MEASUREMENT ZFFSAB2._.EngineInterventionMonitoringOut.iv_m_CrankSts "Input signal status of current torque of crankshaft. Output variable from SABIN class CrankShaftCurTorqueIn." UBYTE SAB2_STANDARD_S3_S3 1 100 0 2 ECU_ADDRESS 0xFFF961D3 DISPLAY_IDENTIFIER iv_m_CrankSts.EngineInterventionMonitoringOut._.ZFFSAB2 /end MEASUREMENT
/begin MEASUREMENT ZFFSAB2._.EngineInterventionMonitoringOut.iv_m_Eng "Input value of engine torque. Output variable from SABIN class EngineTorqueIn." SWORD SAB2_M_1NM_S3_S3 1 100 -2048 2047 ECU_ADDRESS 0xFFF961CE DISPLAY_IDENTIFIER iv_m_Eng.EngineInterventionMonitoringOut._.ZFFSAB2 /end MEASUREMENT
/begin MEASUREMENT ZFFSAB2._.EngineInterventionMonitoringOut.iv_m_EngIntervention "Input value for torque limitation from HPSYS." SWORD SAB2_M_1NM_S3_S3 1 100 -32768 32767 ECU_ADDRESS 0xFFF961D0 DISPLAY_IDENTIFIER iv_m_EngIntervention.EngineInterventionMonitoringOut._.ZFFSAB2 /end MEASUREMENT
/begin MEASUREMENT ZFFSAB2._.EngineInterventionMonitoringOut.iv_m_EngInterventionSts "Input value for engine intervention type from ATSYS." UBYTE SAB2_STANDARD_S3_S3 1 100 0 255 ECU_ADDRESS 0xFFF961D2 DISPLAY_IDENTIFIER iv_m_EngInterventionSts.EngineInterventionMonitoringOut._.ZFFSAB2 /end MEASUREMENT
/begin MEASUREMENT ZFFSAB2._.EngineInterventionMonitoringOut.iv_m_EngMaxCensored "Input value of the max. allowed engine torque limited from below by D_m_EngMaxLTh. Output variable from SABOUT class EngineInterventionOut." SWORD SAB2_M_1NM_S3_S3 1 100 -32768 32767 ECU_ADDRESS 0xFFF961D6 DISPLAY_IDENTIFIER iv_m_EngMaxCensored.EngineInterventionMonitoringOut._.ZFFSAB2 /end MEASUREMENT
/begin MEASUREMENT ZFFSAB2._.EngineInterventionMonitoringOut.iv_n_EngLev2Sts "Level 2 input signal status of engine rpm. Output variable from SABIN class EngineSpeedIn." UBYTE SAB2_STANDARD_S3_S3 1 100 0 2 ECU_ADDRESS 0xFFF961D4 DISPLAY_IDENTIFIER iv_n_EngLev2Sts.EngineInterventionMonitoringOut._.ZFFSAB2 /end MEASUREMENT
/begin MEASUREMENT ZFFSAB2._.EngineInterventionMonitoringOut.iv_n_TuLev2Sts "Level 2 input signal status of turbine speed. Output variable from SABIN class TurbineSpeedIn." UBYTE SAB2_STANDARD_S3_S3 1 100 0 2 ECU_ADDRESS 0xFFF961D5 DISPLAY_IDENTIFIER iv_n_TuLev2Sts.EngineInterventionMonitoringOut._.ZFFSAB2 /end MEASUREMENT
/begin MEASUREMENT ZFFSAB2._.EngineInterventionMonitoringOut.mIntegral_EI_realizedRelative "In every compute cycle relative realized EI(iv_m_Eng - iv_m_Crank) is integrated in this variable." SLONG SAB2_MINTEGRAL_NMS100_S3_S3 1 100 -2000 2000 ECU_ADDRESS 0xFFF961C8 DISPLAY_IDENTIFIER mIntegral_EI_realizedRelative.EngineInterventionMonitoringOut._.ZFFSAB2 /end MEASUREMENT
/begin MEASUREMENT ZFFSAB2._.EngineInterventionMonitoringOut.mIntegral_EI_requestedRelative "In every compute cycle relative requested EI(iv_m_Eng - iv_m_EngIntervention) is integrated in this variable." SLONG SAB2_MINTEGRAL_NMS100_S3_S3 1 100 -2000 2000 ECU_ADDRESS 0xFFF961C4 DISPLAY_IDENTIFIER mIntegral_EI_requestedRelative.EngineInterventionMonitoringOut._.ZFFSAB2 /end MEASUREMENT
/begin MEASUREMENT ZFFSAB2._.EngineInterventionMonitoringOut.m_EI_realizedRelative "In every compute cycle relative realized EI(iv_m_Eng - iv_m_Crank) is stored in this variable." SWORD SAB2_M_1NM_S3_S3 1 100 -1024 1023 ECU_ADDRESS 0xFFF961C2 DISPLAY_IDENTIFIER m_EI_realizedRelative.EngineInterventionMonitoringOut._.ZFFSAB2 /end MEASUREMENT
/begin MEASUREMENT ZFFSAB2._.EngineInterventionMonitoringOut.m_EI_requestedRelative "In every compute cycle relative requested EI(iv_m_Eng - iv_m_EngIntervention) is stored in this variable." SWORD SAB2_M_1NM_S3_S3 1 100 -1024 1023 ECU_ADDRESS 0xFFF961C0 DISPLAY_IDENTIFIER m_EI_requestedRelative.EngineInterventionMonitoringOut._.ZFFSAB2 /end MEASUREMENT
/begin MEASUREMENT ZFFSAB2._.EngineInterventionMonitoringOut.stateCounter_EIMonComputationPosition "Internal variable: Represents the position in the EI monitoring computation. 0: Computation stopped; 1:Timer t_EIMonDelay is running; 2:Timer t_EIMonDelay ran down and f_EIMonActiv is still active; 3:f_EIMonActiv fell to (nat8)0) and t_EIMonActivDelay is " UBYTE SAB2_STANDARD_S3_S3 1 100 0 3 ECU_ADDRESS 0xFFF961BA DISPLAY_IDENTIFIER stateCounter_EIMonComputationPosition.EngineInterventionMonitoringOut._.ZFFSAB2 /end MEASUREMENT
/begin MEASUREMENT ZFFSAB2._.EngineInterventionMonitoringOut.t_EIMonActivDelay.time "test_timer" UBYTE SAB2_T_TIMER_10MS_S3_S3 1 100 0 2550 ECU_ADDRESS 0xFFF961E2 DISPLAY_IDENTIFIER time.t_EIMonActivDelay.EngineInterventionMonitoringOut._.ZFFSAB2 /end MEASUREMENT
/begin MEASUREMENT ZFFSAB2._.EngineInterventionMonitoringOut.t_EIMonDelay.time "test_timer" UBYTE SAB2_T_TIMER_10MS_S3_S3 1 100 0 2550 ECU_ADDRESS 0xFFF961E1 DISPLAY_IDENTIFIER time.t_EIMonDelay.EngineInterventionMonitoringOut._.ZFFSAB2 /end MEASUREMENT
/begin MEASUREMENT ZFFSAB2._.EngineInterventionMonitoringOut.t_EIMonHoldFlagsTimer "Internal variable: Time delay during which output errorflags holds its values." UBYTE SAB2_T_10MS_S3_S3 1 100 0 40 ECU_ADDRESS 0xFFF961BC DISPLAY_IDENTIFIER t_EIMonHoldFlagsTimer.EngineInterventionMonitoringOut._.ZFFSAB2 /end MEASUREMENT
/begin MEASUREMENT ZFFSAB2._.EngineInterventionMonitoringOut.t_IntegrationTime "Variable in which the integration time is stored" UBYTE SAB2_T_10MS_S3_S3 1 100 0 2550 ECU_ADDRESS 0xFFF961D8 DISPLAY_IDENTIFIER t_IntegrationTime.EngineInterventionMonitoringOut._.ZFFSAB2 /end MEASUREMENT
/begin MEASUREMENT ZFFSAB2._.EngineInterventionMonitoringOut.x_m_EI_realizedPercental "Percentual difference between requested and realized EI is stored in this variable." SWORD SAB2_1PROZENT_S3_S3 1 100 -1000 1000 ECU_ADDRESS 0xFFF961CC DISPLAY_IDENTIFIER x_m_EI_realizedPercental.EngineInterventionMonitoringOut._.ZFFSAB2 /end MEASUREMENT
/begin MEASUREMENT ZFFSAB2._.EngineInterventionOut.EngInterventionCalcMethod "Intermediate value which stores the calculation method" UBYTE SAB2_STANDARD_S3_S3 1 100 0 1 ECU_ADDRESS 0xFFF96242 DISPLAY_IDENTIFIER EngInterventionCalcMethod.EngineInterventionOut._.ZFFSAB2 /end MEASUREMENT
/end MODULE
/end PROJECT
