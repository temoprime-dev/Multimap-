ASAP2_VERSION 1 51
/begin PROJECT ZHBC8600 "Gen2_BMW_System_Supplier_Lib"
/begin MODULE CPP ""
/begin MOD_COMMON "" BYTE_ORDER MSB_FIRST ALIGNMENT_BYTE 1 ALIGNMENT_WORD 2 ALIGNMENT_LONG 4 ALIGNMENT_FLOAT32_IEEE 4 ALIGNMENT_FLOAT64_IEEE 1 /end MOD_COMMON
/begin COMPU_METHOD EH_100PROZENT255_S4_S3 "int = ((phys * 255) / 100) - (0) %" RAT_FUNC "%5.4" "%" COEFFS 0 2.55 0 0 0 1 /end COMPU_METHOD
/begin COMPU_METHOD EH_C_1CEL_M40_S4_S3 "int = ((phys * 1) / 1) - (-40) Grad Celsius" RAT_FUNC "%1.0" "Grad Celsius" COEFFS 0 1 40 0 0 1 /end COMPU_METHOD
/begin COMPU_METHOD EH_C_1CEL_M48_S4_S3 "int = ((phys * 1) / 1) - (-48) Grad Celsius" RAT_FUNC "%1.0" "Grad Celsius" COEFFS 0 1 48 0 0 1 /end COMPU_METHOD
/begin COMPU_METHOD EH_L_1KM_S4_S3 "int = ((phys * 1) / 1) - (0) km" RAT_FUNC "%1.0" "km" COEFFS 0 1 0 0 0 1 /end COMPU_METHOD
/begin COMPU_METHOD EH_N_1RPM_S4_S3 "int = ((phys * 1) / 1) - (0) 1/min" RAT_FUNC "%1.0" "1/min" COEFFS 0 1 0 0 0 1 /end COMPU_METHOD
/begin COMPU_METHOD EH_N_RPM4_S4_S3 "int = ((phys * 4) / 1) - (0) 1/min" RAT_FUNC "%3.2" "1/min" COEFFS 0 4 0 0 0 1 /end COMPU_METHOD
/begin COMPU_METHOD EH_STANDARD_S4_S3 "int = ((phys * 1) / 1) - (0) -" RAT_FUNC "%1.0" "-" COEFFS 0 1 0 0 0 1 /end COMPU_METHOD
/begin COMPU_METHOD EH_T_1MIN_S4_S3 "int = ((phys * 1) / 1) - (0) min" RAT_FUNC "%1.0" "min" COEFFS 0 1 0 0 0 1 /end COMPU_METHOD
/begin COMPU_METHOD EH_T_1MS_S4_S3 "int = ((phys * 1) / 1) - (0) ms" RAT_FUNC "%1.0" "ms" COEFFS 0 1 0 0 0 1 /end COMPU_METHOD
/begin COMPU_METHOD EH_T_1S_S4_S3 "int = ((phys * 1) / 1) - (0) s" RAT_FUNC "%1.0" "s" COEFFS 0 1 0 0 0 1 /end COMPU_METHOD
/begin COMPU_METHOD EH_U_1VOLT1000_S4_S3 "int = ((phys * 1000) / 1) - (0) V" RAT_FUNC "%4.3" "V" COEFFS 0 1000 0 0 0 1 /end COMPU_METHOD
/begin COMPU_METHOD EH_V_KMH16_S4_S3 "int = ((phys * 16) / 1) - (0) km/h" RAT_FUNC "%5.4" "km/h" COEFFS 0 16 0 0 0 1 /end COMPU_METHOD
/begin COMPU_METHOD EH_V_KMH_S4_S3 "int = ((phys * 1) / 1) - (0) km/h" RAT_FUNC "%1.0" "km/h" COEFFS 0 1 0 0 0 1 /end COMPU_METHOD
/begin COMPU_METHOD SAB_100PROZENT254_S2_S3 "int = ((phys * 254) / 100) - (0) %" RAT_FUNC "%4.3" "%" COEFFS 0 2.54 0 0 0 1 /end COMPU_METHOD
/begin COMPU_METHOD SAB_A_2MPSS1000_M32500_S2_S3 "int = ((phys * 1000) / 2) - (-32500) m/s^2" RAT_FUNC "%4.3" "m/s^2" COEFFS 0 500 32500 0 0 1 /end COMPU_METHOD
/begin COMPU_METHOD SAB_A_MPSS32_S2_S3 "int = ((phys * 32) / 1) - (0) m/s^2" RAT_FUNC "%4.3" "m/s^2" COEFFS 0 32 0 0 0 1 /end COMPU_METHOD
/begin COMPU_METHOD SAB_C_1CEL_M40_S2_S3 "int = ((phys * 1) / 1) - (-40) Grad Celsius" RAT_FUNC "%1.0" "Grad Celsius" COEFFS 0 1 40 0 0 1 /end COMPU_METHOD
/begin COMPU_METHOD SAB_C_CGT_1CEL_M40_S2_S3 "int = ((phys * 1) / 1) - (-40) Grad Celsius" RAT_FUNC "%1.0" "Grad Celsius" COEFFS 0 1 40 0 0 1 /end COMPU_METHOD
/begin COMPU_METHOD SAB_I_MA10_S2_S3 "int = ((phys * 10) / 1) - (0) mA" RAT_FUNC "%4.3" "mA" COEFFS 0 10 0 0 0 1 /end COMPU_METHOD
/begin COMPU_METHOD SAB_L_1KM_S2_S3 "int = ((phys * 1) / 1) - (0) km" RAT_FUNC "%1.0" "km" COEFFS 0 1 0 0 0 1 /end COMPU_METHOD
/begin COMPU_METHOD SAB_M_1NM_M32000_S2_S3 "int = ((phys * 1) / 1) - (-32000) Nm" RAT_FUNC "%1.0" "Nm" COEFFS 0 1 32000 0 0 1 /end COMPU_METHOD
/begin COMPU_METHOD SAB_M_1NM_S2_S3 "int = ((phys * 1) / 1) - (0) Nm" RAT_FUNC "%1.0" "Nm" COEFFS 0 1 0 0 0 1 /end COMPU_METHOD
/begin COMPU_METHOD SAB_M_4NM_M100_S2_S3 "int = ((phys * 1) / 4) - (-25) Nm" RAT_FUNC "%4.3" "Nm" COEFFS 0 0.25 25 0 0 1 /end COMPU_METHOD
/begin COMPU_METHOD SAB_M_4NM_M500_S2_S3 "int = ((phys * 1) / 4) - (-125) Nm" RAT_FUNC "%4.3" "Nm" COEFFS 0 0.25 125 0 0 1 /end COMPU_METHOD
/begin COMPU_METHOD SAB_M_8NM_M400_S2_S3 "int = ((phys * 1) / 8) - (-50) Nm" RAT_FUNC "%4.3" "Nm" COEFFS 0 0.125 50 0 0 1 /end COMPU_METHOD
/begin COMPU_METHOD SAB_M_NM_S2_S3 "int = ((phys * 1) / 1) - (0) Nm" RAT_FUNC "%1.0" "Nm" COEFFS 0 1 0 0 0 1 /end COMPU_METHOD
/begin COMPU_METHOD SAB_N_1RADPS_M40_S2_S3 "int = ((phys * 1) / 1) - (-40) rad/s" RAT_FUNC "%1.0" "rad/s" COEFFS 0 1 40 0 0 1 /end COMPU_METHOD
/begin COMPU_METHOD SAB_N_1RPM_S2_S3 "int = ((phys * 1) / 1) - (0) 1/min" RAT_FUNC "%1.0" "1/min" COEFFS 0 1 0 0 0 1 /end COMPU_METHOD
/begin COMPU_METHOD SAB_N_32RPM_S2_S3 "int = ((phys * 1) / 32) - (0) 1/min" RAT_FUNC "%4.3" "1/min" COEFFS 0 0.03125 0 0 0 1 /end COMPU_METHOD
/begin COMPU_METHOD SAB_N_RADPS64_M32767_S2_S3 "int = ((phys * 64) / 1) - (-32767) rad/s" RAT_FUNC "%4.3" "rad/s" COEFFS 0 64 32767 0 0 1 /end COMPU_METHOD
/begin COMPU_METHOD SAB_N_RPM100_S2_S3 "int = ((phys * 100) / 1) - (0) 1/min" RAT_FUNC "%4.3" "1/min" COEFFS 0 100 0 0 0 1 /end COMPU_METHOD
/begin COMPU_METHOD SAB_P_1HPA_S2_S3 "int = ((phys * 1) / 1) - (0) hPa" RAT_FUNC "%1.0" "hPa" COEFFS 0 1 0 0 0 1 /end COMPU_METHOD
/begin COMPU_METHOD SAB_P_BAR2_S2_S3 "int = ((phys * 2) / 1) - (0) bar" RAT_FUNC "%4.3" "bar" COEFFS 0 2 0 0 0 1 /end COMPU_METHOD
/begin COMPU_METHOD SAB_P_BARO_2HPA_P598_S2_S3 "int = ((phys * 1) / 2) - (299) hPa" RAT_FUNC "%4.3" "hPa" COEFFS 0 0.5 -299 0 0 1 /end COMPU_METHOD
/begin COMPU_METHOD SAB_PHI_7GRAD160_S2_S3 "int = ((phys * 160) / 7) - (0) grad" RAT_FUNC "%4.3" "grad" COEFFS 0 22.8571428571 0 0 0 1 /end COMPU_METHOD
/begin COMPU_METHOD SAB_PHI_GRAD100_S2_S3 "int = ((phys * 100) / 1) - (0) grad" RAT_FUNC "%3.2" "grad" COEFFS 0 100 0 0 0 1 /end COMPU_METHOD
/begin COMPU_METHOD SAB_PHI_GRAD10_M720_S2_S3 "int = ((phys * 10) / 1) - (-7200) grad" RAT_FUNC "%4.3" "grad" COEFFS 0 10 7200 0 0 1 /end COMPU_METHOD
/begin COMPU_METHOD SAB_PHI_GRAD10_S2_S3 "int = ((phys * 10) / 1) - (0) grad" RAT_FUNC "%4.3" "grad" COEFFS 0 10 0 0 0 1 /end COMPU_METHOD
/begin COMPU_METHOD SAB_PHI_GRAD256_S2_S3 "int = ((phys * 256) / 1) - (0) grad" RAT_FUNC "%4.3" "grad" COEFFS 0 256 0 0 0 1 /end COMPU_METHOD
/begin COMPU_METHOD SAB_PHI_GRAD2_M2048_S2_S3 "int = ((phys * 2) / 1) - (-4096) GRAD" RAT_FUNC "%4.3" "GRAD" COEFFS 0 2 4096 0 0 1 /end COMPU_METHOD
/begin COMPU_METHOD SAB_PHI_GRAD4_M31_S2_S3 "int = ((phys * 4) / 1) - (-124) grad" RAT_FUNC "%4.3" "grad" COEFFS 0 4 124 0 0 1 /end COMPU_METHOD
/begin COMPU_METHOD SAB_PHI_GRAD_M125_S2_S3 "int = ((phys * 1) / 1) - (-125) grad" RAT_FUNC "%1.0" "grad" COEFFS 0 1 125 0 0 1 /end COMPU_METHOD
/begin COMPU_METHOD SAB_PHI_GRAD_S2_S3 "int = ((phys * 1) / 1) - (0) grad" RAT_FUNC "%1.0" "grad" COEFFS 0 1 0 0 0 1 /end COMPU_METHOD
/begin COMPU_METHOD SAB_PHI_SENS_1GRAD10_M640_S2_S3 "int = ((phys * 10) / 1) - (-640) grad" RAT_FUNC "%4.3" "grad" COEFFS 0 10 640 0 0 1 /end COMPU_METHOD
/begin COMPU_METHOD SAB_PHI_SENS_1GRAD3_S2_S3 "int = ((phys * 3) / 1) - (0) grad" RAT_FUNC "%4.3" "grad" COEFFS 0 3 0 0 0 1 /end COMPU_METHOD
/begin COMPU_METHOD SAB_PHI_STEERING_ANGLE_1GRAD2_M2048_S2_S3 "int = ((phys * 2) / 1) - (-4096) grad" RAT_FUNC "%4.3" "grad" COEFFS 0 2 4096 0 0 1 /end COMPU_METHOD
/begin COMPU_METHOD SAB_PHI_STEERING_ANGLE_1GRAD_S2_S3 "int = ((phys * 1) / 1) - (0) grad" RAT_FUNC "%1.0" "grad" COEFFS 0 1 0 0 0 1 /end COMPU_METHOD
/begin COMPU_METHOD SAB_PHI_STEERING_ANGLE_45GRAD1024_S2_S3 "int = ((phys * 1024) / 45) - (0) grad" RAT_FUNC "%4.3" "grad" COEFFS 0 22.7555555556 0 0 0 1 /end COMPU_METHOD
/begin COMPU_METHOD SAB_PHI_STEERING_ANGLE_5GRAD_S2_S3 "int = ((phys * 1) / 5) - (0) grad" RAT_FUNC "%4.3" "grad" COEFFS 0 0.2 0 0 0 1 /end COMPU_METHOD
/begin COMPU_METHOD SAB_PHI_STEERING_ANGLE_7GRAD160_S2_S3 "int = ((phys * 160) / 7) - (0) grad" RAT_FUNC "%4.3" "grad" COEFFS 0 22.8571428571 0 0 0 1 /end COMPU_METHOD
/begin COMPU_METHOD SAB_PHI_STEERING_ANGLE_GRAD10_M780_S2_S3 "int = ((phys * 10) / 1) - (-7800) grad" RAT_FUNC "%4.3" "grad" COEFFS 0 10 7800 0 0 1 /end COMPU_METHOD
/begin COMPU_METHOD SAB_PHI_STEERING_ANGLE_GRAD10_S2_S3 "int = ((phys * 10) / 1) - (0) grad" RAT_FUNC "%4.3" "grad" COEFFS 0 10 0 0 0 1 /end COMPU_METHOD
/begin COMPU_METHOD SAB_PROZENT100_S2_S3 "int = ((phys * 100) / 1) - (0) %" RAT_FUNC "%4.3" "%" COEFFS 0 100 0 0 0 1 /end COMPU_METHOD
/begin COMPU_METHOD SAB_PROZENT10_M1000_S2_S3 "int = ((phys * 10) / 1) - (-1000) %" RAT_FUNC "%4.3" "%" COEFFS 0 10 1000 0 0 1 /end COMPU_METHOD
/begin COMPU_METHOD SAB_PROZENT10_M100_S2_S3 "int = ((phys * 10) / 1) - (-1000) %" RAT_FUNC "%2.1" "%" COEFFS 0 10 1000 0 0 1 /end COMPU_METHOD
/begin COMPU_METHOD SAB_PROZENT10_M127_S2_S3 "int = ((phys * 10) / 1) - (-127) %" RAT_FUNC "%4.3" "%" COEFFS 0 10 127 0 0 1 /end COMPU_METHOD
/begin COMPU_METHOD SAB_PROZENT10_M3000_S2_S3 "int = ((phys * 10) / 1) - (-3000) %" RAT_FUNC "%4.3" "%" COEFFS 0 10 3000 0 0 1 /end COMPU_METHOD
/begin COMPU_METHOD SAB_PROZENT10_S2_S3 "int = ((phys * 10) / 1) - (0) %" RAT_FUNC "%4.3" "%" COEFFS 0 10 0 0 0 1 /end COMPU_METHOD
/begin COMPU_METHOD SAB_PROZENT128_S2_S3 "int = ((phys * 128) / 1) - (0) %" RAT_FUNC "%4.3" "%" COEFFS 0 128 0 0 0 1 /end COMPU_METHOD
/begin COMPU_METHOD SAB_PROZENT200_S2_S3 "int = ((phys * 200) / 1) - (0) %" RAT_FUNC "%4.3" "%" COEFFS 0 200 0 0 0 1 /end COMPU_METHOD
/begin COMPU_METHOD SAB_PROZENT2_S2_S3 "int = ((phys * 2) / 1) - (0) %" RAT_FUNC "%4.3" "%" COEFFS 0 2 0 0 0 1 /end COMPU_METHOD
/begin COMPU_METHOD SAB_PROZENT40_S2_S3 "int = ((phys * 40) / 1) - (0) %" RAT_FUNC "%4.3" "%" COEFFS 0 40 0 0 0 1 /end COMPU_METHOD
/begin COMPU_METHOD SAB_PROZENT4_S2_S3 "int = ((phys * 4) / 1) - (0) %" RAT_FUNC "%4.3" "%" COEFFS 0 4 0 0 0 1 /end COMPU_METHOD
/begin COMPU_METHOD SAB_STANDARD_S2_S3 "int = ((phys * 1) / 1) - (0) -" RAT_FUNC "%1.0" "-" COEFFS 0 1 0 0 0 1 /end COMPU_METHOD
/begin COMPU_METHOD SAB_T_TIMER_10MS_S2_S3 "int = ((phys * 1) / 10) - (0) ms" RAT_FUNC "%4.3" "ms" COEFFS 0 0.1 0 0 0 1 /end COMPU_METHOD
/begin COMPU_METHOD SAB_T_TIMER_1MS_S2_S3 "int = ((phys * 1) / 1) - (0) ms" RAT_FUNC "%1.0" "ms" COEFFS 0 1 0 0 0 1 /end COMPU_METHOD
/begin COMPU_METHOD SAB_T_TIMER_1S_S2_S3 "int = ((phys * 1) / 1) - (0) s" RAT_FUNC "%1.0" "s" COEFFS 0 1 0 0 0 1 /end COMPU_METHOD
/begin COMPU_METHOD SAB_T_TIMER_30MS_S2_S3 "int = ((phys * 1) / 30) - (0) ms" RAT_FUNC "%4.3" "ms" COEFFS 0 0.0333333333333 0 0 0 1 /end COMPU_METHOD
/begin COMPU_METHOD SAB_U_100VOLT8_S2_S3 "int = ((phys * 100) / 8) - (0) Volt" RAT_FUNC "%4.3" "Volt" COEFFS 0 12.5 0 0 0 1 /end COMPU_METHOD
/begin COMPU_METHOD SAB_U_1VOLT1000_S2_S3 "int = ((phys * 1000) / 1) - (0) Volt" RAT_FUNC "%4.3" "Volt" COEFFS 0 1000 0 0 0 1 /end COMPU_METHOD
/begin MEASUREMENT ZFEH_EepromData.ydiMemory_xau16[5].master_time "master time of error code stored in error memory slot" ULONG EH_STANDARD_S4_S3 1 100 0 4294967295 ECU_ADDRESS 0xFFF82438 DISPLAY_IDENTIFIER master_time.ydiMemory_xau16[5].ZFEH_EepromData /end MEASUREMENT
/begin MEASUREMENT ZFEH_EepromData.ydiMemory_xau16[5].obd_driving_cycle_counter "obd driving cycle counter of error code stored in error memory slot" UWORD EH_STANDARD_S4_S3 1 100 0 65535 ECU_ADDRESS 0xFFF8243E DISPLAY_IDENTIFIER obd_driving_cycle_counter.ydiMemory_xau16[5].ZFEH_EepromData /end MEASUREMENT
/begin MEASUREMENT ZFEH_EepromData.ydiMemory_xau16[5].permanent_counter "counter of permanent error codes stored in error memory slot" UBYTE EH_STANDARD_S4_S3 1 100 0 255 ECU_ADDRESS 0xFFF82434 DISPLAY_IDENTIFIER permanent_counter.ydiMemory_xau16[5].ZFEH_EepromData /end MEASUREMENT
/begin MEASUREMENT ZFEH_EepromData.ydiMemory_xau16[5].sequence_counter "sequence counter of error code stored in error memory slot" UBYTE EH_STANDARD_S4_S3 1 100 0 255 ECU_ADDRESS 0xFFF82435 DISPLAY_IDENTIFIER sequence_counter.ydiMemory_xau16[5].ZFEH_EepromData /end MEASUREMENT
/begin MEASUREMENT ZFEH_EepromData.ydiMemory_xau16[5].status_word "status word of error code stored in error memory slot" UWORD EH_STANDARD_S4_S3 1 100 0 65535 ECU_ADDRESS 0xFFF82430 DISPLAY_IDENTIFIER status_word.ydiMemory_xau16[5].ZFEH_EepromData /end MEASUREMENT
/begin MEASUREMENT ZFEH_EepromData.ydiMemory_xau16[6].amb_cond.ambient_condition[0][0] "ambient condition shot [0 .. 2-1] with 25 data bytes [0 .. 25-1] for the error code stored in this error memory slot" UBYTE EH_STANDARD_S4_S3 1 100 0 255 ECU_ADDRESS 0xFFF82488 DISPLAY_IDENTIFIER ambient_condition[0][0].amb_cond.ydiMemory_xau16[6].ZFEH_EepromData /end MEASUREMENT
/begin MEASUREMENT ZFEH_EepromData.ydiMemory_xau16[6].amb_cond.ambient_condition[0][10] "ambient condition shot [0 .. 2-1] with 25 data bytes [0 .. 25-1] for the error code stored in this error memory slot" UBYTE EH_STANDARD_S4_S3 1 100 0 255 ECU_ADDRESS 0xFFF82492 DISPLAY_IDENTIFIER ambient_condition[0][10].amb_cond.ydiMemory_xau16[6].ZFEH_EepromData /end MEASUREMENT
/begin MEASUREMENT ZFEH_EepromData.ydiMemory_xau16[6].amb_cond.ambient_condition[0][11] "ambient condition shot [0 .. 2-1] with 25 data bytes [0 .. 25-1] for the error code stored in this error memory slot" UBYTE EH_STANDARD_S4_S3 1 100 0 255 ECU_ADDRESS 0xFFF82493 DISPLAY_IDENTIFIER ambient_condition[0][11].amb_cond.ydiMemory_xau16[6].ZFEH_EepromData /end MEASUREMENT
/begin MEASUREMENT ZFEH_EepromData.ydiMemory_xau16[6].amb_cond.ambient_condition[0][12] "ambient condition shot [0 .. 2-1] with 25 data bytes [0 .. 25-1] for the error code stored in this error memory slot" UBYTE EH_STANDARD_S4_S3 1 100 0 255 ECU_ADDRESS 0xFFF82494 DISPLAY_IDENTIFIER ambient_condition[0][12].amb_cond.ydiMemory_xau16[6].ZFEH_EepromData /end MEASUREMENT
/begin MEASUREMENT ZFEH_EepromData.ydiMemory_xau16[6].amb_cond.ambient_condition[0][13] "ambient condition shot [0 .. 2-1] with 25 data bytes [0 .. 25-1] for the error code stored in this error memory slot" UBYTE EH_STANDARD_S4_S3 1 100 0 255 ECU_ADDRESS 0xFFF82495 DISPLAY_IDENTIFIER ambient_condition[0][13].amb_cond.ydiMemory_xau16[6].ZFEH_EepromData /end MEASUREMENT
/begin MEASUREMENT ZFEH_EepromData.ydiMemory_xau16[6].amb_cond.ambient_condition[0][14] "ambient condition shot [0 .. 2-1] with 25 data bytes [0 .. 25-1] for the error code stored in this error memory slot" UBYTE EH_STANDARD_S4_S3 1 100 0 255 ECU_ADDRESS 0xFFF82496 DISPLAY_IDENTIFIER ambient_condition[0][14].amb_cond.ydiMemory_xau16[6].ZFEH_EepromData /end MEASUREMENT
/begin MEASUREMENT ZFEH_EepromData.ydiMemory_xau16[6].amb_cond.ambient_condition[0][15] "ambient condition shot [0 .. 2-1] with 25 data bytes [0 .. 25-1] for the error code stored in this error memory slot" UBYTE EH_STANDARD_S4_S3 1 100 0 255 ECU_ADDRESS 0xFFF82497 DISPLAY_IDENTIFIER ambient_condition[0][15].amb_cond.ydiMemory_xau16[6].ZFEH_EepromData /end MEASUREMENT
/begin MEASUREMENT ZFEH_EepromData.ydiMemory_xau16[6].amb_cond.ambient_condition[0][16] "ambient condition shot [0 .. 2-1] with 25 data bytes [0 .. 25-1] for the error code stored in this error memory slot" UBYTE EH_STANDARD_S4_S3 1 100 0 255 ECU_ADDRESS 0xFFF82498 DISPLAY_IDENTIFIER ambient_condition[0][16].amb_cond.ydiMemory_xau16[6].ZFEH_EepromData /end MEASUREMENT
/begin MEASUREMENT ZFEH_EepromData.ydiMemory_xau16[6].amb_cond.ambient_condition[0][17] "ambient condition shot [0 .. 2-1] with 25 data bytes [0 .. 25-1] for the error code stored in this error memory slot" UBYTE EH_STANDARD_S4_S3 1 100 0 255 ECU_ADDRESS 0xFFF82499 DISPLAY_IDENTIFIER ambient_condition[0][17].amb_cond.ydiMemory_xau16[6].ZFEH_EepromData /end MEASUREMENT
/begin MEASUREMENT ZFEH_EepromData.ydiMemory_xau16[6].amb_cond.ambient_condition[0][18] "ambient condition shot [0 .. 2-1] with 25 data bytes [0 .. 25-1] for the error code stored in this error memory slot" UBYTE EH_STANDARD_S4_S3 1 100 0 255 ECU_ADDRESS 0xFFF8249A DISPLAY_IDENTIFIER ambient_condition[0][18].amb_cond.ydiMemory_xau16[6].ZFEH_EepromData /end MEASUREMENT
/begin MEASUREMENT ZFEH_EepromData.ydiMemory_xau16[6].amb_cond.ambient_condition[0][19] "ambient condition shot [0 .. 2-1] with 25 data bytes [0 .. 25-1] for the error code stored in this error memory slot" UBYTE EH_STANDARD_S4_S3 1 100 0 255 ECU_ADDRESS 0xFFF8249B DISPLAY_IDENTIFIER ambient_condition[0][19].amb_cond.ydiMemory_xau16[6].ZFEH_EepromData /end MEASUREMENT
/begin MEASUREMENT ZFEH_EepromData.ydiMemory_xau16[6].amb_cond.ambient_condition[0][1] "ambient condition shot [0 .. 2-1] with 25 data bytes [0 .. 25-1] for the error code stored in this error memory slot" UBYTE EH_STANDARD_S4_S3 1 100 0 255 ECU_ADDRESS 0xFFF82489 DISPLAY_IDENTIFIER ambient_condition[0][1].amb_cond.ydiMemory_xau16[6].ZFEH_EepromData /end MEASUREMENT
/begin MEASUREMENT ZFEH_EepromData.ydiMemory_xau16[6].amb_cond.ambient_condition[0][20] "ambient condition shot [0 .. 2-1] with 25 data bytes [0 .. 25-1] for the error code stored in this error memory slot" UBYTE EH_STANDARD_S4_S3 1 100 0 255 ECU_ADDRESS 0xFFF8249C DISPLAY_IDENTIFIER ambient_condition[0][20].amb_cond.ydiMemory_xau16[6].ZFEH_EepromData /end MEASUREMENT
/begin MEASUREMENT ZFEH_EepromData.ydiMemory_xau16[6].amb_cond.ambient_condition[0][21] "ambient condition shot [0 .. 2-1] with 25 data bytes [0 .. 25-1] for the error code stored in this error memory slot" UBYTE EH_STANDARD_S4_S3 1 100 0 255 ECU_ADDRESS 0xFFF8249D DISPLAY_IDENTIFIER ambient_condition[0][21].amb_cond.ydiMemory_xau16[6].ZFEH_EepromData /end MEASUREMENT
/begin MEASUREMENT ZFEH_EepromData.ydiMemory_xau16[6].amb_cond.ambient_condition[0][22] "ambient condition shot [0 .. 2-1] with 25 data bytes [0 .. 25-1] for the error code stored in this error memory slot" UBYTE EH_STANDARD_S4_S3 1 100 0 255 ECU_ADDRESS 0xFFF8249E DISPLAY_IDENTIFIER ambient_condition[0][22].amb_cond.ydiMemory_xau16[6].ZFEH_EepromData /end MEASUREMENT
/begin MEASUREMENT ZFEH_EepromData.ydiMemory_xau16[6].amb_cond.ambient_condition[0][23] "ambient condition shot [0 .. 2-1] with 25 data bytes [0 .. 25-1] for the error code stored in this error memory slot" UBYTE EH_STANDARD_S4_S3 1 100 0 255 ECU_ADDRESS 0xFFF8249F DISPLAY_IDENTIFIER ambient_condition[0][23].amb_cond.ydiMemory_xau16[6].ZFEH_EepromData /end MEASUREMENT
/begin MEASUREMENT ZFEH_EepromData.ydiMemory_xau16[6].amb_cond.ambient_condition[0][24] "ambient condition shot [0 .. 2-1] with 25 data bytes [0 .. 25-1] for the error code stored in this error memory slot" UBYTE EH_STANDARD_S4_S3 1 100 0 255 ECU_ADDRESS 0xFFF824A0 DISPLAY_IDENTIFIER ambient_condition[0][24].amb_cond.ydiMemory_xau16[6].ZFEH_EepromData /end MEASUREMENT
/begin MEASUREMENT ZFEH_EepromData.ydiMemory_xau16[6].amb_cond.ambient_condition[0][2] "ambient condition shot [0 .. 2-1] with 25 data bytes [0 .. 25-1] for the error code stored in this error memory slot" UBYTE EH_STANDARD_S4_S3 1 100 0 255 ECU_ADDRESS 0xFFF8248A DISPLAY_IDENTIFIER ambient_condition[0][2].amb_cond.ydiMemory_xau16[6].ZFEH_EepromData /end MEASUREMENT
/begin MEASUREMENT ZFEH_EepromData.ydiMemory_xau16[6].amb_cond.ambient_condition[0][3] "ambient condition shot [0 .. 2-1] with 25 data bytes [0 .. 25-1] for the error code stored in this error memory slot" UBYTE EH_STANDARD_S4_S3 1 100 0 255 ECU_ADDRESS 0xFFF8248B DISPLAY_IDENTIFIER ambient_condition[0][3].amb_cond.ydiMemory_xau16[6].ZFEH_EepromData /end MEASUREMENT
/begin MEASUREMENT ZFEH_EepromData.ydiMemory_xau16[6].amb_cond.ambient_condition[0][4] "ambient condition shot [0 .. 2-1] with 25 data bytes [0 .. 25-1] for the error code stored in this error memory slot" UBYTE EH_STANDARD_S4_S3 1 100 0 255 ECU_ADDRESS 0xFFF8248C DISPLAY_IDENTIFIER ambient_condition[0][4].amb_cond.ydiMemory_xau16[6].ZFEH_EepromData /end MEASUREMENT
/begin MEASUREMENT ZFEH_EepromData.ydiMemory_xau16[6].amb_cond.ambient_condition[0][5] "ambient condition shot [0 .. 2-1] with 25 data bytes [0 .. 25-1] for the error code stored in this error memory slot" UBYTE EH_STANDARD_S4_S3 1 100 0 255 ECU_ADDRESS 0xFFF8248D DISPLAY_IDENTIFIER ambient_condition[0][5].amb_cond.ydiMemory_xau16[6].ZFEH_EepromData /end MEASUREMENT
/begin MEASUREMENT ZFEH_EepromData.ydiMemory_xau16[6].amb_cond.ambient_condition[0][6] "ambient condition shot [0 .. 2-1] with 25 data bytes [0 .. 25-1] for the error code stored in this error memory slot" UBYTE EH_STANDARD_S4_S3 1 100 0 255 ECU_ADDRESS 0xFFF8248E DISPLAY_IDENTIFIER ambient_condition[0][6].amb_cond.ydiMemory_xau16[6].ZFEH_EepromData /end MEASUREMENT
/begin MEASUREMENT ZFEH_EepromData.ydiMemory_xau16[6].amb_cond.ambient_condition[0][7] "ambient condition shot [0 .. 2-1] with 25 data bytes [0 .. 25-1] for the error code stored in this error memory slot" UBYTE EH_STANDARD_S4_S3 1 100 0 255 ECU_ADDRESS 0xFFF8248F DISPLAY_IDENTIFIER ambient_condition[0][7].amb_cond.ydiMemory_xau16[6].ZFEH_EepromData /end MEASUREMENT
/begin MEASUREMENT ZFEH_EepromData.ydiMemory_xau16[6].amb_cond.ambient_condition[0][8] "ambient condition shot [0 .. 2-1] with 25 data bytes [0 .. 25-1] for the error code stored in this error memory slot" UBYTE EH_STANDARD_S4_S3 1 100 0 255 ECU_ADDRESS 0xFFF82490 DISPLAY_IDENTIFIER ambient_condition[0][8].amb_cond.ydiMemory_xau16[6].ZFEH_EepromData /end MEASUREMENT
/begin MEASUREMENT ZFEH_EepromData.ydiMemory_xau16[6].amb_cond.ambient_condition[0][9] "ambient condition shot [0 .. 2-1] with 25 data bytes [0 .. 25-1] for the error code stored in this error memory slot" UBYTE EH_STANDARD_S4_S3 1 100 0 255 ECU_ADDRESS 0xFFF82491 DISPLAY_IDENTIFIER ambient_condition[0][9].amb_cond.ydiMemory_xau16[6].ZFEH_EepromData /end MEASUREMENT
/begin MEASUREMENT ZFEH_EepromData.ydiMemory_xau16[6].amb_cond.ambient_condition[1][0] "ambient condition shot [0 .. 2-1] with 25 data bytes [0 .. 25-1] for the error code stored in this error memory slot" UBYTE EH_STANDARD_S4_S3 1 100 0 255 ECU_ADDRESS 0xFFF824A1 DISPLAY_IDENTIFIER ambient_condition[1][0].amb_cond.ydiMemory_xau16[6].ZFEH_EepromData /end MEASUREMENT
/begin MEASUREMENT ZFEH_EepromData.ydiMemory_xau16[6].amb_cond.ambient_condition[1][10] "ambient condition shot [0 .. 2-1] with 25 data bytes [0 .. 25-1] for the error code stored in this error memory slot" UBYTE EH_STANDARD_S4_S3 1 100 0 255 ECU_ADDRESS 0xFFF824AB DISPLAY_IDENTIFIER ambient_condition[1][10].amb_cond.ydiMemory_xau16[6].ZFEH_EepromData /end MEASUREMENT
/begin MEASUREMENT ZFEH_EepromData.ydiMemory_xau16[6].amb_cond.ambient_condition[1][11] "ambient condition shot [0 .. 2-1] with 25 data bytes [0 .. 25-1] for the error code stored in this error memory slot" UBYTE EH_STANDARD_S4_S3 1 100 0 255 ECU_ADDRESS 0xFFF824AC DISPLAY_IDENTIFIER ambient_condition[1][11].amb_cond.ydiMemory_xau16[6].ZFEH_EepromData /end MEASUREMENT
/begin MEASUREMENT ZFEH_EepromData.ydiMemory_xau16[6].amb_cond.ambient_condition[1][12] "ambient condition shot [0 .. 2-1] with 25 data bytes [0 .. 25-1] for the error code stored in this error memory slot" UBYTE EH_STANDARD_S4_S3 1 100 0 255 ECU_ADDRESS 0xFFF824AD DISPLAY_IDENTIFIER ambient_condition[1][12].amb_cond.ydiMemory_xau16[6].ZFEH_EepromData /end MEASUREMENT
/begin MEASUREMENT ZFEH_EepromData.ydiMemory_xau16[6].amb_cond.ambient_condition[1][13] "ambient condition shot [0 .. 2-1] with 25 data bytes [0 .. 25-1] for the error code stored in this error memory slot" UBYTE EH_STANDARD_S4_S3 1 100 0 255 ECU_ADDRESS 0xFFF824AE DISPLAY_IDENTIFIER ambient_condition[1][13].amb_cond.ydiMemory_xau16[6].ZFEH_EepromData /end MEASUREMENT
/begin MEASUREMENT ZFEH_EepromData.ydiMemory_xau16[6].amb_cond.ambient_condition[1][14] "ambient condition shot [0 .. 2-1] with 25 data bytes [0 .. 25-1] for the error code stored in this error memory slot" UBYTE EH_STANDARD_S4_S3 1 100 0 255 ECU_ADDRESS 0xFFF824AF DISPLAY_IDENTIFIER ambient_condition[1][14].amb_cond.ydiMemory_xau16[6].ZFEH_EepromData /end MEASUREMENT
/begin MEASUREMENT ZFEH_EepromData.ydiMemory_xau16[6].amb_cond.ambient_condition[1][15] "ambient condition shot [0 .. 2-1] with 25 data bytes [0 .. 25-1] for the error code stored in this error memory slot" UBYTE EH_STANDARD_S4_S3 1 100 0 255 ECU_ADDRESS 0xFFF824B0 DISPLAY_IDENTIFIER ambient_condition[1][15].amb_cond.ydiMemory_xau16[6].ZFEH_EepromData /end MEASUREMENT
/begin MEASUREMENT ZFEH_EepromData.ydiMemory_xau16[6].amb_cond.ambient_condition[1][16] "ambient condition shot [0 .. 2-1] with 25 data bytes [0 .. 25-1] for the error code stored in this error memory slot" UBYTE EH_STANDARD_S4_S3 1 100 0 255 ECU_ADDRESS 0xFFF824B1 DISPLAY_IDENTIFIER ambient_condition[1][16].amb_cond.ydiMemory_xau16[6].ZFEH_EepromData /end MEASUREMENT
/begin MEASUREMENT ZFEH_EepromData.ydiMemory_xau16[6].amb_cond.ambient_condition[1][17] "ambient condition shot [0 .. 2-1] with 25 data bytes [0 .. 25-1] for the error code stored in this error memory slot" UBYTE EH_STANDARD_S4_S3 1 100 0 255 ECU_ADDRESS 0xFFF824B2 DISPLAY_IDENTIFIER ambient_condition[1][17].amb_cond.ydiMemory_xau16[6].ZFEH_EepromData /end MEASUREMENT
/begin MEASUREMENT ZFEH_EepromData.ydiMemory_xau16[6].amb_cond.ambient_condition[1][18] "ambient condition shot [0 .. 2-1] with 25 data bytes [0 .. 25-1] for the error code stored in this error memory slot" UBYTE EH_STANDARD_S4_S3 1 100 0 255 ECU_ADDRESS 0xFFF824B3 DISPLAY_IDENTIFIER ambient_condition[1][18].amb_cond.ydiMemory_xau16[6].ZFEH_EepromData /end MEASUREMENT
/begin MEASUREMENT ZFEH_EepromData.ydiMemory_xau16[6].amb_cond.ambient_condition[1][19] "ambient condition shot [0 .. 2-1] with 25 data bytes [0 .. 25-1] for the error code stored in this error memory slot" UBYTE EH_STANDARD_S4_S3 1 100 0 255 ECU_ADDRESS 0xFFF824B4 DISPLAY_IDENTIFIER ambient_condition[1][19].amb_cond.ydiMemory_xau16[6].ZFEH_EepromData /end MEASUREMENT
/begin MEASUREMENT ZFEH_EepromData.ydiMemory_xau16[6].amb_cond.ambient_condition[1][1] "ambient condition shot [0 .. 2-1] with 25 data bytes [0 .. 25-1] for the error code stored in this error memory slot" UBYTE EH_STANDARD_S4_S3 1 100 0 255 ECU_ADDRESS 0xFFF824A2 DISPLAY_IDENTIFIER ambient_condition[1][1].amb_cond.ydiMemory_xau16[6].ZFEH_EepromData /end MEASUREMENT
/begin MEASUREMENT ZFEH_EepromData.ydiMemory_xau16[6].amb_cond.ambient_condition[1][20] "ambient condition shot [0 .. 2-1] with 25 data bytes [0 .. 25-1] for the error code stored in this error memory slot" UBYTE EH_STANDARD_S4_S3 1 100 0 255 ECU_ADDRESS 0xFFF824B5 DISPLAY_IDENTIFIER ambient_condition[1][20].amb_cond.ydiMemory_xau16[6].ZFEH_EepromData /end MEASUREMENT
/begin MEASUREMENT ZFEH_EepromData.ydiMemory_xau16[6].amb_cond.ambient_condition[1][21] "ambient condition shot [0 .. 2-1] with 25 data bytes [0 .. 25-1] for the error code stored in this error memory slot" UBYTE EH_STANDARD_S4_S3 1 100 0 255 ECU_ADDRESS 0xFFF824B6 DISPLAY_IDENTIFIER ambient_condition[1][21].amb_cond.ydiMemory_xau16[6].ZFEH_EepromData /end MEASUREMENT
/begin MEASUREMENT ZFEH_EepromData.ydiMemory_xau16[6].amb_cond.ambient_condition[1][22] "ambient condition shot [0 .. 2-1] with 25 data bytes [0 .. 25-1] for the error code stored in this error memory slot" UBYTE EH_STANDARD_S4_S3 1 100 0 255 ECU_ADDRESS 0xFFF824B7 DISPLAY_IDENTIFIER ambient_condition[1][22].amb_cond.ydiMemory_xau16[6].ZFEH_EepromData /end MEASUREMENT
/begin MEASUREMENT ZFEH_EepromData.ydiMemory_xau16[6].amb_cond.ambient_condition[1][23] "ambient condition shot [0 .. 2-1] with 25 data bytes [0 .. 25-1] for the error code stored in this error memory slot" UBYTE EH_STANDARD_S4_S3 1 100 0 255 ECU_ADDRESS 0xFFF824B8 DISPLAY_IDENTIFIER ambient_condition[1][23].amb_cond.ydiMemory_xau16[6].ZFEH_EepromData /end MEASUREMENT
/begin MEASUREMENT ZFEH_EepromData.ydiMemory_xau16[6].amb_cond.ambient_condition[1][24] "ambient condition shot [0 .. 2-1] with 25 data bytes [0 .. 25-1] for the error code stored in this error memory slot" UBYTE EH_STANDARD_S4_S3 1 100 0 255 ECU_ADDRESS 0xFFF824B9 DISPLAY_IDENTIFIER ambient_condition[1][24].amb_cond.ydiMemory_xau16[6].ZFEH_EepromData /end MEASUREMENT
/begin MEASUREMENT ZFEH_EepromData.ydiMemory_xau16[6].amb_cond.ambient_condition[1][2] "ambient condition shot [0 .. 2-1] with 25 data bytes [0 .. 25-1] for the error code stored in this error memory slot" UBYTE EH_STANDARD_S4_S3 1 100 0 255 ECU_ADDRESS 0xFFF824A3 DISPLAY_IDENTIFIER ambient_condition[1][2].amb_cond.ydiMemory_xau16[6].ZFEH_EepromData /end MEASUREMENT
/begin MEASUREMENT ZFEH_EepromData.ydiMemory_xau16[6].amb_cond.ambient_condition[1][3] "ambient condition shot [0 .. 2-1] with 25 data bytes [0 .. 25-1] for the error code stored in this error memory slot" UBYTE EH_STANDARD_S4_S3 1 100 0 255 ECU_ADDRESS 0xFFF824A4 DISPLAY_IDENTIFIER ambient_condition[1][3].amb_cond.ydiMemory_xau16[6].ZFEH_EepromData /end MEASUREMENT
/begin MEASUREMENT ZFEH_EepromData.ydiMemory_xau16[6].amb_cond.ambient_condition[1][4] "ambient condition shot [0 .. 2-1] with 25 data bytes [0 .. 25-1] for the error code stored in this error memory slot" UBYTE EH_STANDARD_S4_S3 1 100 0 255 ECU_ADDRESS 0xFFF824A5 DISPLAY_IDENTIFIER ambient_condition[1][4].amb_cond.ydiMemory_xau16[6].ZFEH_EepromData /end MEASUREMENT
/begin MEASUREMENT ZFEH_EepromData.ydiMemory_xau16[6].amb_cond.ambient_condition[1][5] "ambient condition shot [0 .. 2-1] with 25 data bytes [0 .. 25-1] for the error code stored in this error memory slot" UBYTE EH_STANDARD_S4_S3 1 100 0 255 ECU_ADDRESS 0xFFF824A6 DISPLAY_IDENTIFIER ambient_condition[1][5].amb_cond.ydiMemory_xau16[6].ZFEH_EepromData /end MEASUREMENT
/begin MEASUREMENT ZFEH_EepromData.ydiMemory_xau16[6].amb_cond.ambient_condition[1][6] "ambient condition shot [0 .. 2-1] with 25 data bytes [0 .. 25-1] for the error code stored in this error memory slot" UBYTE EH_STANDARD_S4_S3 1 100 0 255 ECU_ADDRESS 0xFFF824A7 DISPLAY_IDENTIFIER ambient_condition[1][6].amb_cond.ydiMemory_xau16[6].ZFEH_EepromData /end MEASUREMENT
/begin MEASUREMENT ZFEH_EepromData.ydiMemory_xau16[6].amb_cond.ambient_condition[1][7] "ambient condition shot [0 .. 2-1] with 25 data bytes [0 .. 25-1] for the error code stored in this error memory slot" UBYTE EH_STANDARD_S4_S3 1 100 0 255 ECU_ADDRESS 0xFFF824A8 DISPLAY_IDENTIFIER ambient_condition[1][7].amb_cond.ydiMemory_xau16[6].ZFEH_EepromData /end MEASUREMENT
/begin MEASUREMENT ZFEH_EepromData.ydiMemory_xau16[6].amb_cond.ambient_condition[1][8] "ambient condition shot [0 .. 2-1] with 25 data bytes [0 .. 25-1] for the error code stored in this error memory slot" UBYTE EH_STANDARD_S4_S3 1 100 0 255 ECU_ADDRESS 0xFFF824A9 DISPLAY_IDENTIFIER ambient_condition[1][8].amb_cond.ydiMemory_xau16[6].ZFEH_EepromData /end MEASUREMENT
/begin MEASUREMENT ZFEH_EepromData.ydiMemory_xau16[6].amb_cond.ambient_condition[1][9] "ambient condition shot [0 .. 2-1] with 25 data bytes [0 .. 25-1] for the error code stored in this error memory slot" UBYTE EH_STANDARD_S4_S3 1 100 0 255 ECU_ADDRESS 0xFFF824AA DISPLAY_IDENTIFIER ambient_condition[1][9].amb_cond.ydiMemory_xau16[6].ZFEH_EepromData /end MEASUREMENT
/begin MEASUREMENT ZFEH_EepromData.ydiMemory_xau16[6].amb_cond.status_of_ambient_conditions[0] "status of ambient condition shot x: 0=invalid 1=valid" UBYTE EH_STANDARD_S4_S3 1 100 0 1 ECU_ADDRESS 0xFFF824BA DISPLAY_IDENTIFIER status_of_ambient_conditions[0].amb_cond.ydiMemory_xau16[6].ZFEH_EepromData /end MEASUREMENT
/begin MEASUREMENT ZFEH_EepromData.ydiMemory_xau16[6].amb_cond.status_of_ambient_conditions[1] "status of ambient condition shot x: 0=invalid 1=valid" UBYTE EH_STANDARD_S4_S3 1 100 0 1 ECU_ADDRESS 0xFFF824BB DISPLAY_IDENTIFIER status_of_ambient_conditions[1].amb_cond.ydiMemory_xau16[6].ZFEH_EepromData /end MEASUREMENT
/begin MEASUREMENT ZFEH_EepromData.ydiMemory_xau16[6].backwards_counter "backwards counter of error code stored in error memory slot" UBYTE EH_STANDARD_S4_S3 1 100 0 255 ECU_ADDRESS 0xFFF8247B DISPLAY_IDENTIFIER backwards_counter.ydiMemory_xau16[6].ZFEH_EepromData /end MEASUREMENT
/begin MEASUREMENT ZFEH_EepromData.ydiMemory_xau16[6].condition_byte "condition byte of error code stored in error memory slot" UBYTE EH_STANDARD_S4_S3 1 100 0 255 ECU_ADDRESS 0xFFF82485 DISPLAY_IDENTIFIER condition_byte.ydiMemory_xau16[6].ZFEH_EepromData /end MEASUREMENT
/begin MEASUREMENT ZFEH_EepromData.ydiMemory_xau16[6].error_code "error code stored in error memory slot" UWORD EH_STANDARD_S4_S3 1 100 0 65535 ECU_ADDRESS 0xFFF82474 DISPLAY_IDENTIFIER error_code.ydiMemory_xau16[6].ZFEH_EepromData /end MEASUREMENT
/begin MEASUREMENT ZFEH_EepromData.ydiMemory_xau16[6].error_type "error type of error code stored in error memory slot" UWORD EH_STANDARD_S4_S3 1 100 0 65535 ECU_ADDRESS 0xFFF82476 DISPLAY_IDENTIFIER error_type.ydiMemory_xau16[6].ZFEH_EepromData /end MEASUREMENT
/begin MEASUREMENT ZFEH_EepromData.ydiMemory_xau16[6].frequency_counter "frequency counter of error code stored in error memory slot" UBYTE EH_STANDARD_S4_S3 1 100 0 255 ECU_ADDRESS 0xFFF8247A DISPLAY_IDENTIFIER frequency_counter.ydiMemory_xau16[6].ZFEH_EepromData /end MEASUREMENT
/begin MEASUREMENT ZFEH_EepromData.ydiMemory_xau16[6].master_time "master time of error code stored in error memory slot" ULONG EH_STANDARD_S4_S3 1 100 0 4294967295 ECU_ADDRESS 0xFFF82480 DISPLAY_IDENTIFIER master_time.ydiMemory_xau16[6].ZFEH_EepromData /end MEASUREMENT
/begin MEASUREMENT ZFEH_EepromData.ydiMemory_xau16[6].obd_driving_cycle_counter "obd driving cycle counter of error code stored in error memory slot" UWORD EH_STANDARD_S4_S3 1 100 0 65535 ECU_ADDRESS 0xFFF82486 DISPLAY_IDENTIFIER obd_driving_cycle_counter.ydiMemory_xau16[6].ZFEH_EepromData /end MEASUREMENT
/begin MEASUREMENT ZFEH_EepromData.ydiMemory_xau16[6].permanent_counter "counter of permanent error codes stored in error memory slot" UBYTE EH_STANDARD_S4_S3 1 100 0 255 ECU_ADDRESS 0xFFF8247C DISPLAY_IDENTIFIER permanent_counter.ydiMemory_xau16[6].ZFEH_EepromData /end MEASUREMENT
/begin MEASUREMENT ZFEH_EepromData.ydiMemory_xau16[6].sequence_counter "sequence counter of error code stored in error memory slot" UBYTE EH_STANDARD_S4_S3 1 100 0 255 ECU_ADDRESS 0xFFF8247D DISPLAY_IDENTIFIER sequence_counter.ydiMemory_xau16[6].ZFEH_EepromData /end MEASUREMENT
/begin MEASUREMENT ZFEH_EepromData.ydiMemory_xau16[6].status_word "status word of error code stored in error memory slot" UWORD EH_STANDARD_S4_S3 1 100 0 65535 ECU_ADDRESS 0xFFF82478 DISPLAY_IDENTIFIER status_word.ydiMemory_xau16[6].ZFEH_EepromData /end MEASUREMENT
/begin MEASUREMENT ZFEH_EepromData.ydiMemory_xau16[7].amb_cond.ambient_condition[0][0] "ambient condition shot [0 .. 2-1] with 25 data bytes [0 .. 25-1] for the error code stored in this error memory slot" UBYTE EH_STANDARD_S4_S3 1 100 0 255 ECU_ADDRESS 0xFFF824D0 DISPLAY_IDENTIFIER ambient_condition[0][0].amb_cond.ydiMemory_xau16[7].ZFEH_EepromData /end MEASUREMENT
/begin MEASUREMENT ZFEH_EepromData.ydiMemory_xau16[7].amb_cond.ambient_condition[0][10] "ambient condition shot [0 .. 2-1] with 25 data bytes [0 .. 25-1] for the error code stored in this error memory slot" UBYTE EH_STANDARD_S4_S3 1 100 0 255 ECU_ADDRESS 0xFFF824DA DISPLAY_IDENTIFIER ambient_condition[0][10].amb_cond.ydiMemory_xau16[7].ZFEH_EepromData /end MEASUREMENT
/begin MEASUREMENT ZFEH_EepromData.ydiMemory_xau16[7].amb_cond.ambient_condition[0][11] "ambient condition shot [0 .. 2-1] with 25 data bytes [0 .. 25-1] for the error code stored in this error memory slot" UBYTE EH_STANDARD_S4_S3 1 100 0 255 ECU_ADDRESS 0xFFF824DB DISPLAY_IDENTIFIER ambient_condition[0][11].amb_cond.ydiMemory_xau16[7].ZFEH_EepromData /end MEASUREMENT
/begin MEASUREMENT ZFEH_EepromData.ydiMemory_xau16[7].amb_cond.ambient_condition[0][12] "ambient condition shot [0 .. 2-1] with 25 data bytes [0 .. 25-1] for the error code stored in this error memory slot" UBYTE EH_STANDARD_S4_S3 1 100 0 255 ECU_ADDRESS 0xFFF824DC DISPLAY_IDENTIFIER ambient_condition[0][12].amb_cond.ydiMemory_xau16[7].ZFEH_EepromData /end MEASUREMENT
/begin MEASUREMENT ZFEH_EepromData.ydiMemory_xau16[7].amb_cond.ambient_condition[0][13] "ambient condition shot [0 .. 2-1] with 25 data bytes [0 .. 25-1] for the error code stored in this error memory slot" UBYTE EH_STANDARD_S4_S3 1 100 0 255 ECU_ADDRESS 0xFFF824DD DISPLAY_IDENTIFIER ambient_condition[0][13].amb_cond.ydiMemory_xau16[7].ZFEH_EepromData /end MEASUREMENT
/begin MEASUREMENT ZFEH_EepromData.ydiMemory_xau16[7].amb_cond.ambient_condition[0][14] "ambient condition shot [0 .. 2-1] with 25 data bytes [0 .. 25-1] for the error code stored in this error memory slot" UBYTE EH_STANDARD_S4_S3 1 100 0 255 ECU_ADDRESS 0xFFF824DE DISPLAY_IDENTIFIER ambient_condition[0][14].amb_cond.ydiMemory_xau16[7].ZFEH_EepromData /end MEASUREMENT
/begin MEASUREMENT ZFEH_EepromData.ydiMemory_xau16[7].amb_cond.ambient_condition[0][15] "ambient condition shot [0 .. 2-1] with 25 data bytes [0 .. 25-1] for the error code stored in this error memory slot" UBYTE EH_STANDARD_S4_S3 1 100 0 255 ECU_ADDRESS 0xFFF824DF DISPLAY_IDENTIFIER ambient_condition[0][15].amb_cond.ydiMemory_xau16[7].ZFEH_EepromData /end MEASUREMENT
/begin MEASUREMENT ZFEH_EepromData.ydiMemory_xau16[7].amb_cond.ambient_condition[0][16] "ambient condition shot [0 .. 2-1] with 25 data bytes [0 .. 25-1] for the error code stored in this error memory slot" UBYTE EH_STANDARD_S4_S3 1 100 0 255 ECU_ADDRESS 0xFFF824E0 DISPLAY_IDENTIFIER ambient_condition[0][16].amb_cond.ydiMemory_xau16[7].ZFEH_EepromData /end MEASUREMENT
/begin MEASUREMENT ZFEH_EepromData.ydiMemory_xau16[7].amb_cond.ambient_condition[0][17] "ambient condition shot [0 .. 2-1] with 25 data bytes [0 .. 25-1] for the error code stored in this error memory slot" UBYTE EH_STANDARD_S4_S3 1 100 0 255 ECU_ADDRESS 0xFFF824E1 DISPLAY_IDENTIFIER ambient_condition[0][17].amb_cond.ydiMemory_xau16[7].ZFEH_EepromData /end MEASUREMENT
/begin MEASUREMENT ZFEH_EepromData.ydiMemory_xau16[7].amb_cond.ambient_condition[0][18] "ambient condition shot [0 .. 2-1] with 25 data bytes [0 .. 25-1] for the error code stored in this error memory slot" UBYTE EH_STANDARD_S4_S3 1 100 0 255 ECU_ADDRESS 0xFFF824E2 DISPLAY_IDENTIFIER ambient_condition[0][18].amb_cond.ydiMemory_xau16[7].ZFEH_EepromData /end MEASUREMENT
/begin MEASUREMENT ZFEH_EepromData.ydiMemory_xau16[7].amb_cond.ambient_condition[0][19] "ambient condition shot [0 .. 2-1] with 25 data bytes [0 .. 25-1] for the error code stored in this error memory slot" UBYTE EH_STANDARD_S4_S3 1 100 0 255 ECU_ADDRESS 0xFFF824E3 DISPLAY_IDENTIFIER ambient_condition[0][19].amb_cond.ydiMemory_xau16[7].ZFEH_EepromData /end MEASUREMENT
/begin MEASUREMENT ZFEH_EepromData.ydiMemory_xau16[7].amb_cond.ambient_condition[0][1] "ambient condition shot [0 .. 2-1] with 25 data bytes [0 .. 25-1] for the error code stored in this error memory slot" UBYTE EH_STANDARD_S4_S3 1 100 0 255 ECU_ADDRESS 0xFFF824D1 DISPLAY_IDENTIFIER ambient_condition[0][1].amb_cond.ydiMemory_xau16[7].ZFEH_EepromData /end MEASUREMENT
/begin MEASUREMENT ZFEH_EepromData.ydiMemory_xau16[7].amb_cond.ambient_condition[0][20] "ambient condition shot [0 .. 2-1] with 25 data bytes [0 .. 25-1] for the error code stored in this error memory slot" UBYTE EH_STANDARD_S4_S3 1 100 0 255 ECU_ADDRESS 0xFFF824E4 DISPLAY_IDENTIFIER ambient_condition[0][20].amb_cond.ydiMemory_xau16[7].ZFEH_EepromData /end MEASUREMENT
/begin MEASUREMENT ZFEH_EepromData.ydiMemory_xau16[7].amb_cond.ambient_condition[0][21] "ambient condition shot [0 .. 2-1] with 25 data bytes [0 .. 25-1] for the error code stored in this error memory slot" UBYTE EH_STANDARD_S4_S3 1 100 0 255 ECU_ADDRESS 0xFFF824E5 DISPLAY_IDENTIFIER ambient_condition[0][21].amb_cond.ydiMemory_xau16[7].ZFEH_EepromData /end MEASUREMENT
/begin MEASUREMENT ZFEH_EepromData.ydiMemory_xau16[7].amb_cond.ambient_condition[0][22] "ambient condition shot [0 .. 2-1] with 25 data bytes [0 .. 25-1] for the error code stored in this error memory slot" UBYTE EH_STANDARD_S4_S3 1 100 0 255 ECU_ADDRESS 0xFFF824E6 DISPLAY_IDENTIFIER ambient_condition[0][22].amb_cond.ydiMemory_xau16[7].ZFEH_EepromData /end MEASUREMENT
/begin MEASUREMENT ZFEH_EepromData.ydiMemory_xau16[7].amb_cond.ambient_condition[0][23] "ambient condition shot [0 .. 2-1] with 25 data bytes [0 .. 25-1] for the error code stored in this error memory slot" UBYTE EH_STANDARD_S4_S3 1 100 0 255 ECU_ADDRESS 0xFFF824E7 DISPLAY_IDENTIFIER ambient_condition[0][23].amb_cond.ydiMemory_xau16[7].ZFEH_EepromData /end MEASUREMENT
/begin MEASUREMENT ZFEH_EepromData.ydiMemory_xau16[7].amb_cond.ambient_condition[0][24] "ambient condition shot [0 .. 2-1] with 25 data bytes [0 .. 25-1] for the error code stored in this error memory slot" UBYTE EH_STANDARD_S4_S3 1 100 0 255 ECU_ADDRESS 0xFFF824E8 DISPLAY_IDENTIFIER ambient_condition[0][24].amb_cond.ydiMemory_xau16[7].ZFEH_EepromData /end MEASUREMENT
/begin MEASUREMENT ZFEH_EepromData.ydiMemory_xau16[7].amb_cond.ambient_condition[0][2] "ambient condition shot [0 .. 2-1] with 25 data bytes [0 .. 25-1] for the error code stored in this error memory slot" UBYTE EH_STANDARD_S4_S3 1 100 0 255 ECU_ADDRESS 0xFFF824D2 DISPLAY_IDENTIFIER ambient_condition[0][2].amb_cond.ydiMemory_xau16[7].ZFEH_EepromData /end MEASUREMENT
/begin MEASUREMENT ZFEH_EepromData.ydiMemory_xau16[7].amb_cond.ambient_condition[0][3] "ambient condition shot [0 .. 2-1] with 25 data bytes [0 .. 25-1] for the error code stored in this error memory slot" UBYTE EH_STANDARD_S4_S3 1 100 0 255 ECU_ADDRESS 0xFFF824D3 DISPLAY_IDENTIFIER ambient_condition[0][3].amb_cond.ydiMemory_xau16[7].ZFEH_EepromData /end MEASUREMENT
/begin MEASUREMENT ZFEH_EepromData.ydiMemory_xau16[7].amb_cond.ambient_condition[0][4] "ambient condition shot [0 .. 2-1] with 25 data bytes [0 .. 25-1] for the error code stored in this error memory slot" UBYTE EH_STANDARD_S4_S3 1 100 0 255 ECU_ADDRESS 0xFFF824D4 DISPLAY_IDENTIFIER ambient_condition[0][4].amb_cond.ydiMemory_xau16[7].ZFEH_EepromData /end MEASUREMENT
/begin MEASUREMENT ZFEH_EepromData.ydiMemory_xau16[7].amb_cond.ambient_condition[0][5] "ambient condition shot [0 .. 2-1] with 25 data bytes [0 .. 25-1] for the error code stored in this error memory slot" UBYTE EH_STANDARD_S4_S3 1 100 0 255 ECU_ADDRESS 0xFFF824D5 DISPLAY_IDENTIFIER ambient_condition[0][5].amb_cond.ydiMemory_xau16[7].ZFEH_EepromData /end MEASUREMENT
/begin MEASUREMENT ZFEH_EepromData.ydiMemory_xau16[7].amb_cond.ambient_condition[0][6] "ambient condition shot [0 .. 2-1] with 25 data bytes [0 .. 25-1] for the error code stored in this error memory slot" UBYTE EH_STANDARD_S4_S3 1 100 0 255 ECU_ADDRESS 0xFFF824D6 DISPLAY_IDENTIFIER ambient_condition[0][6].amb_cond.ydiMemory_xau16[7].ZFEH_EepromData /end MEASUREMENT
/begin MEASUREMENT ZFEH_EepromData.ydiMemory_xau16[7].amb_cond.ambient_condition[0][7] "ambient condition shot [0 .. 2-1] with 25 data bytes [0 .. 25-1] for the error code stored in this error memory slot" UBYTE EH_STANDARD_S4_S3 1 100 0 255 ECU_ADDRESS 0xFFF824D7 DISPLAY_IDENTIFIER ambient_condition[0][7].amb_cond.ydiMemory_xau16[7].ZFEH_EepromData /end MEASUREMENT
/begin MEASUREMENT ZFEH_EepromData.ydiMemory_xau16[7].amb_cond.ambient_condition[0][8] "ambient condition shot [0 .. 2-1] with 25 data bytes [0 .. 25-1] for the error code stored in this error memory slot" UBYTE EH_STANDARD_S4_S3 1 100 0 255 ECU_ADDRESS 0xFFF824D8 DISPLAY_IDENTIFIER ambient_condition[0][8].amb_cond.ydiMemory_xau16[7].ZFEH_EepromData /end MEASUREMENT
/begin MEASUREMENT ZFEH_EepromData.ydiMemory_xau16[7].amb_cond.ambient_condition[0][9] "ambient condition shot [0 .. 2-1] with 25 data bytes [0 .. 25-1] for the error code stored in this error memory slot" UBYTE EH_STANDARD_S4_S3 1 100 0 255 ECU_ADDRESS 0xFFF824D9 DISPLAY_IDENTIFIER ambient_condition[0][9].amb_cond.ydiMemory_xau16[7].ZFEH_EepromData /end MEASUREMENT
/begin MEASUREMENT ZFEH_EepromData.ydiMemory_xau16[7].amb_cond.ambient_condition[1][0] "ambient condition shot [0 .. 2-1] with 25 data bytes [0 .. 25-1] for the error code stored in this error memory slot" UBYTE EH_STANDARD_S4_S3 1 100 0 255 ECU_ADDRESS 0xFFF824E9 DISPLAY_IDENTIFIER ambient_condition[1][0].amb_cond.ydiMemory_xau16[7].ZFEH_EepromData /end MEASUREMENT
/begin MEASUREMENT ZFEH_EepromData.ydiMemory_xau16[7].amb_cond.ambient_condition[1][10] "ambient condition shot [0 .. 2-1] with 25 data bytes [0 .. 25-1] for the error code stored in this error memory slot" UBYTE EH_STANDARD_S4_S3 1 100 0 255 ECU_ADDRESS 0xFFF824F3 DISPLAY_IDENTIFIER ambient_condition[1][10].amb_cond.ydiMemory_xau16[7].ZFEH_EepromData /end MEASUREMENT
/begin MEASUREMENT ZFEH_EepromData.ydiMemory_xau16[7].amb_cond.ambient_condition[1][11] "ambient condition shot [0 .. 2-1] with 25 data bytes [0 .. 25-1] for the error code stored in this error memory slot" UBYTE EH_STANDARD_S4_S3 1 100 0 255 ECU_ADDRESS 0xFFF824F4 DISPLAY_IDENTIFIER ambient_condition[1][11].amb_cond.ydiMemory_xau16[7].ZFEH_EepromData /end MEASUREMENT
/begin MEASUREMENT ZFEH_EepromData.ydiMemory_xau16[7].amb_cond.ambient_condition[1][12] "ambient condition shot [0 .. 2-1] with 25 data bytes [0 .. 25-1] for the error code stored in this error memory slot" UBYTE EH_STANDARD_S4_S3 1 100 0 255 ECU_ADDRESS 0xFFF824F5 DISPLAY_IDENTIFIER ambient_condition[1][12].amb_cond.ydiMemory_xau16[7].ZFEH_EepromData /end MEASUREMENT
/begin MEASUREMENT ZFEH_EepromData.ydiMemory_xau16[7].amb_cond.ambient_condition[1][13] "ambient condition shot [0 .. 2-1] with 25 data bytes [0 .. 25-1] for the error code stored in this error memory slot" UBYTE EH_STANDARD_S4_S3 1 100 0 255 ECU_ADDRESS 0xFFF824F6 DISPLAY_IDENTIFIER ambient_condition[1][13].amb_cond.ydiMemory_xau16[7].ZFEH_EepromData /end MEASUREMENT
/begin MEASUREMENT ZFEH_EepromData.ydiMemory_xau16[7].amb_cond.ambient_condition[1][14] "ambient condition shot [0 .. 2-1] with 25 data bytes [0 .. 25-1] for the error code stored in this error memory slot" UBYTE EH_STANDARD_S4_S3 1 100 0 255 ECU_ADDRESS 0xFFF824F7 DISPLAY_IDENTIFIER ambient_condition[1][14].amb_cond.ydiMemory_xau16[7].ZFEH_EepromData /end MEASUREMENT
/begin MEASUREMENT ZFEH_EepromData.ydiMemory_xau16[7].amb_cond.ambient_condition[1][15] "ambient condition shot [0 .. 2-1] with 25 data bytes [0 .. 25-1] for the error code stored in this error memory slot" UBYTE EH_STANDARD_S4_S3 1 100 0 255 ECU_ADDRESS 0xFFF824F8 DISPLAY_IDENTIFIER ambient_condition[1][15].amb_cond.ydiMemory_xau16[7].ZFEH_EepromData /end MEASUREMENT
/begin MEASUREMENT ZFEH_EepromData.ydiMemory_xau16[7].amb_cond.ambient_condition[1][16] "ambient condition shot [0 .. 2-1] with 25 data bytes [0 .. 25-1] for the error code stored in this error memory slot" UBYTE EH_STANDARD_S4_S3 1 100 0 255 ECU_ADDRESS 0xFFF824F9 DISPLAY_IDENTIFIER ambient_condition[1][16].amb_cond.ydiMemory_xau16[7].ZFEH_EepromData /end MEASUREMENT
/begin MEASUREMENT ZFEH_EepromData.ydiMemory_xau16[7].amb_cond.ambient_condition[1][17] "ambient condition shot [0 .. 2-1] with 25 data bytes [0 .. 25-1] for the error code stored in this error memory slot" UBYTE EH_STANDARD_S4_S3 1 100 0 255 ECU_ADDRESS 0xFFF824FA DISPLAY_IDENTIFIER ambient_condition[1][17].amb_cond.ydiMemory_xau16[7].ZFEH_EepromData /end MEASUREMENT
/begin MEASUREMENT ZFEH_EepromData.ydiMemory_xau16[7].amb_cond.ambient_condition[1][18] "ambient condition shot [0 .. 2-1] with 25 data bytes [0 .. 25-1] for the error code stored in this error memory slot" UBYTE EH_STANDARD_S4_S3 1 100 0 255 ECU_ADDRESS 0xFFF824FB DISPLAY_IDENTIFIER ambient_condition[1][18].amb_cond.ydiMemory_xau16[7].ZFEH_EepromData /end MEASUREMENT
/begin MEASUREMENT ZFEH_EepromData.ydiMemory_xau16[7].amb_cond.ambient_condition[1][19] "ambient condition shot [0 .. 2-1] with 25 data bytes [0 .. 25-1] for the error code stored in this error memory slot" UBYTE EH_STANDARD_S4_S3 1 100 0 255 ECU_ADDRESS 0xFFF824FC DISPLAY_IDENTIFIER ambient_condition[1][19].amb_cond.ydiMemory_xau16[7].ZFEH_EepromData /end MEASUREMENT
/begin MEASUREMENT ZFEH_EepromData.ydiMemory_xau16[7].amb_cond.ambient_condition[1][1] "ambient condition shot [0 .. 2-1] with 25 data bytes [0 .. 25-1] for the error code stored in this error memory slot" UBYTE EH_STANDARD_S4_S3 1 100 0 255 ECU_ADDRESS 0xFFF824EA DISPLAY_IDENTIFIER ambient_condition[1][1].amb_cond.ydiMemory_xau16[7].ZFEH_EepromData /end MEASUREMENT
/begin MEASUREMENT ZFEH_EepromData.ydiMemory_xau16[7].amb_cond.ambient_condition[1][20] "ambient condition shot [0 .. 2-1] with 25 data bytes [0 .. 25-1] for the error code stored in this error memory slot" UBYTE EH_STANDARD_S4_S3 1 100 0 255 ECU_ADDRESS 0xFFF824FD DISPLAY_IDENTIFIER ambient_condition[1][20].amb_cond.ydiMemory_xau16[7].ZFEH_EepromData /end MEASUREMENT
/begin MEASUREMENT ZFEH_EepromData.ydiMemory_xau16[7].amb_cond.ambient_condition[1][21] "ambient condition shot [0 .. 2-1] with 25 data bytes [0 .. 25-1] for the error code stored in this error memory slot" UBYTE EH_STANDARD_S4_S3 1 100 0 255 ECU_ADDRESS 0xFFF824FE DISPLAY_IDENTIFIER ambient_condition[1][21].amb_cond.ydiMemory_xau16[7].ZFEH_EepromData /end MEASUREMENT
/begin MEASUREMENT ZFEH_EepromData.ydiMemory_xau16[7].amb_cond.ambient_condition[1][22] "ambient condition shot [0 .. 2-1] with 25 data bytes [0 .. 25-1] for the error code stored in this error memory slot" UBYTE EH_STANDARD_S4_S3 1 100 0 255 ECU_ADDRESS 0xFFF824FF DISPLAY_IDENTIFIER ambient_condition[1][22].amb_cond.ydiMemory_xau16[7].ZFEH_EepromData /end MEASUREMENT
/begin MEASUREMENT ZFEH_EepromData.ydiMemory_xau16[7].amb_cond.ambient_condition[1][23] "ambient condition shot [0 .. 2-1] with 25 data bytes [0 .. 25-1] for the error code stored in this error memory slot" UBYTE EH_STANDARD_S4_S3 1 100 0 255 ECU_ADDRESS 0xFFF82500 DISPLAY_IDENTIFIER ambient_condition[1][23].amb_cond.ydiMemory_xau16[7].ZFEH_EepromData /end MEASUREMENT
/begin MEASUREMENT ZFEH_EepromData.ydiMemory_xau16[7].amb_cond.ambient_condition[1][24] "ambient condition shot [0 .. 2-1] with 25 data bytes [0 .. 25-1] for the error code stored in this error memory slot" UBYTE EH_STANDARD_S4_S3 1 100 0 255 ECU_ADDRESS 0xFFF82501 DISPLAY_IDENTIFIER ambient_condition[1][24].amb_cond.ydiMemory_xau16[7].ZFEH_EepromData /end MEASUREMENT
/begin MEASUREMENT ZFEH_EepromData.ydiMemory_xau16[7].amb_cond.ambient_condition[1][2] "ambient condition shot [0 .. 2-1] with 25 data bytes [0 .. 25-1] for the error code stored in this error memory slot" UBYTE EH_STANDARD_S4_S3 1 100 0 255 ECU_ADDRESS 0xFFF824EB DISPLAY_IDENTIFIER ambient_condition[1][2].amb_cond.ydiMemory_xau16[7].ZFEH_EepromData /end MEASUREMENT
/begin MEASUREMENT ZFEH_EepromData.ydiMemory_xau16[7].amb_cond.ambient_condition[1][3] "ambient condition shot [0 .. 2-1] with 25 data bytes [0 .. 25-1] for the error code stored in this error memory slot" UBYTE EH_STANDARD_S4_S3 1 100 0 255 ECU_ADDRESS 0xFFF824EC DISPLAY_IDENTIFIER ambient_condition[1][3].amb_cond.ydiMemory_xau16[7].ZFEH_EepromData /end MEASUREMENT
/begin MEASUREMENT ZFEH_EepromData.ydiMemory_xau16[7].amb_cond.ambient_condition[1][4] "ambient condition shot [0 .. 2-1] with 25 data bytes [0 .. 25-1] for the error code stored in this error memory slot" UBYTE EH_STANDARD_S4_S3 1 100 0 255 ECU_ADDRESS 0xFFF824ED DISPLAY_IDENTIFIER ambient_condition[1][4].amb_cond.ydiMemory_xau16[7].ZFEH_EepromData /end MEASUREMENT
/begin MEASUREMENT ZFEH_EepromData.ydiMemory_xau16[7].amb_cond.ambient_condition[1][5] "ambient condition shot [0 .. 2-1] with 25 data bytes [0 .. 25-1] for the error code stored in this error memory slot" UBYTE EH_STANDARD_S4_S3 1 100 0 255 ECU_ADDRESS 0xFFF824EE DISPLAY_IDENTIFIER ambient_condition[1][5].amb_cond.ydiMemory_xau16[7].ZFEH_EepromData /end MEASUREMENT
/begin MEASUREMENT ZFEH_EepromData.ydiMemory_xau16[7].amb_cond.ambient_condition[1][6] "ambient condition shot [0 .. 2-1] with 25 data bytes [0 .. 25-1] for the error code stored in this error memory slot" UBYTE EH_STANDARD_S4_S3 1 100 0 255 ECU_ADDRESS 0xFFF824EF DISPLAY_IDENTIFIER ambient_condition[1][6].amb_cond.ydiMemory_xau16[7].ZFEH_EepromData /end MEASUREMENT
/begin MEASUREMENT ZFEH_EepromData.ydiMemory_xau16[7].amb_cond.ambient_condition[1][7] "ambient condition shot [0 .. 2-1] with 25 data bytes [0 .. 25-1] for the error code stored in this error memory slot" UBYTE EH_STANDARD_S4_S3 1 100 0 255 ECU_ADDRESS 0xFFF824F0 DISPLAY_IDENTIFIER ambient_condition[1][7].amb_cond.ydiMemory_xau16[7].ZFEH_EepromData /end MEASUREMENT
/begin MEASUREMENT ZFEH_EepromData.ydiMemory_xau16[7].amb_cond.ambient_condition[1][8] "ambient condition shot [0 .. 2-1] with 25 data bytes [0 .. 25-1] for the error code stored in this error memory slot" UBYTE EH_STANDARD_S4_S3 1 100 0 255 ECU_ADDRESS 0xFFF824F1 DISPLAY_IDENTIFIER ambient_condition[1][8].amb_cond.ydiMemory_xau16[7].ZFEH_EepromData /end MEASUREMENT
/begin MEASUREMENT ZFEH_EepromData.ydiMemory_xau16[7].amb_cond.ambient_condition[1][9] "ambient condition shot [0 .. 2-1] with 25 data bytes [0 .. 25-1] for the error code stored in this error memory slot" UBYTE EH_STANDARD_S4_S3 1 100 0 255 ECU_ADDRESS 0xFFF824F2 DISPLAY_IDENTIFIER ambient_condition[1][9].amb_cond.ydiMemory_xau16[7].ZFEH_EepromData /end MEASUREMENT
/begin MEASUREMENT ZFEH_EepromData.ydiMemory_xau16[7].amb_cond.status_of_ambient_conditions[0] "status of ambient condition shot x: 0=invalid 1=valid" UBYTE EH_STANDARD_S4_S3 1 100 0 1 ECU_ADDRESS 0xFFF82502 DISPLAY_IDENTIFIER status_of_ambient_conditions[0].amb_cond.ydiMemory_xau16[7].ZFEH_EepromData /end MEASUREMENT
/begin MEASUREMENT ZFEH_EepromData.ydiMemory_xau16[7].amb_cond.status_of_ambient_conditions[1] "status of ambient condition shot x: 0=invalid 1=valid" UBYTE EH_STANDARD_S4_S3 1 100 0 1 ECU_ADDRESS 0xFFF82503 DISPLAY_IDENTIFIER status_of_ambient_conditions[1].amb_cond.ydiMemory_xau16[7].ZFEH_EepromData /end MEASUREMENT
/begin MEASUREMENT ZFEH_EepromData.ydiMemory_xau16[7].backwards_counter "backwards counter of error code stored in error memory slot" UBYTE EH_STANDARD_S4_S3 1 100 0 255 ECU_ADDRESS 0xFFF824C3 DISPLAY_IDENTIFIER backwards_counter.ydiMemory_xau16[7].ZFEH_EepromData /end MEASUREMENT
/begin MEASUREMENT ZFEH_EepromData.ydiMemory_xau16[7].condition_byte "condition byte of error code stored in error memory slot" UBYTE EH_STANDARD_S4_S3 1 100 0 255 ECU_ADDRESS 0xFFF824CD DISPLAY_IDENTIFIER condition_byte.ydiMemory_xau16[7].ZFEH_EepromData /end MEASUREMENT
/begin MEASUREMENT ZFEH_EepromData.ydiMemory_xau16[7].error_code "error code stored in error memory slot" UWORD EH_STANDARD_S4_S3 1 100 0 65535 ECU_ADDRESS 0xFFF824BC DISPLAY_IDENTIFIER error_code.ydiMemory_xau16[7].ZFEH_EepromData /end MEASUREMENT
/begin MEASUREMENT ZFEH_EepromData.ydiMemory_xau16[7].error_type "error type of error code stored in error memory slot" UWORD EH_STANDARD_S4_S3 1 100 0 65535 ECU_ADDRESS 0xFFF824BE DISPLAY_IDENTIFIER error_type.ydiMemory_xau16[7].ZFEH_EepromData /end MEASUREMENT
/begin MEASUREMENT ZFEH_EepromData.ydiMemory_xau16[7].frequency_counter "frequency counter of error code stored in error memory slot" UBYTE EH_STANDARD_S4_S3 1 100 0 255 ECU_ADDRESS 0xFFF824C2 DISPLAY_IDENTIFIER frequency_counter.ydiMemory_xau16[7].ZFEH_EepromData /end MEASUREMENT
/begin MEASUREMENT ZFEH_EepromData.ydiMemory_xau16[7].master_time "master time of error code stored in error memory slot" ULONG EH_STANDARD_S4_S3 1 100 0 4294967295 ECU_ADDRESS 0xFFF824C8 DISPLAY_IDENTIFIER master_time.ydiMemory_xau16[7].ZFEH_EepromData /end MEASUREMENT
/begin MEASUREMENT ZFEH_EepromData.ydiMemory_xau16[7].obd_driving_cycle_counter "obd driving cycle counter of error code stored in error memory slot" UWORD EH_STANDARD_S4_S3 1 100 0 65535 ECU_ADDRESS 0xFFF824CE DISPLAY_IDENTIFIER obd_driving_cycle_counter.ydiMemory_xau16[7].ZFEH_EepromData /end MEASUREMENT
/begin MEASUREMENT ZFEH_EepromData.ydiMemory_xau16[7].permanent_counter "counter of permanent error codes stored in error memory slot" UBYTE EH_STANDARD_S4_S3 1 100 0 255 ECU_ADDRESS 0xFFF824C4 DISPLAY_IDENTIFIER permanent_counter.ydiMemory_xau16[7].ZFEH_EepromData /end MEASUREMENT
/begin MEASUREMENT ZFEH_EepromData.ydiMemory_xau16[7].sequence_counter "sequence counter of error code stored in error memory slot" UBYTE EH_STANDARD_S4_S3 1 100 0 255 ECU_ADDRESS 0xFFF824C5 DISPLAY_IDENTIFIER sequence_counter.ydiMemory_xau16[7].ZFEH_EepromData /end MEASUREMENT
/begin MEASUREMENT ZFEH_EepromData.ydiMemory_xau16[7].status_word "status word of error code stored in error memory slot" UWORD EH_STANDARD_S4_S3 1 100 0 65535 ECU_ADDRESS 0xFFF824C0 DISPLAY_IDENTIFIER status_word.ydiMemory_xau16[7].ZFEH_EepromData /end MEASUREMENT
/begin MEASUREMENT ZFEH_EepromData.ydiMemory_xau16[8].amb_cond.ambient_condition[0][0] "ambient condition shot [0 .. 2-1] with 25 data bytes [0 .. 25-1] for the error code stored in this error memory slot" UBYTE EH_STANDARD_S4_S3 1 100 0 255 ECU_ADDRESS 0xFFF82518 DISPLAY_IDENTIFIER ambient_condition[0][0].amb_cond.ydiMemory_xau16[8].ZFEH_EepromData /end MEASUREMENT
/begin MEASUREMENT ZFEH_EepromData.ydiMemory_xau16[8].amb_cond.ambient_condition[0][10] "ambient condition shot [0 .. 2-1] with 25 data bytes [0 .. 25-1] for the error code stored in this error memory slot" UBYTE EH_STANDARD_S4_S3 1 100 0 255 ECU_ADDRESS 0xFFF82522 DISPLAY_IDENTIFIER ambient_condition[0][10].amb_cond.ydiMemory_xau16[8].ZFEH_EepromData /end MEASUREMENT
/begin MEASUREMENT ZFEH_EepromData.ydiMemory_xau16[8].amb_cond.ambient_condition[0][11] "ambient condition shot [0 .. 2-1] with 25 data bytes [0 .. 25-1] for the error code stored in this error memory slot" UBYTE EH_STANDARD_S4_S3 1 100 0 255 ECU_ADDRESS 0xFFF82523 DISPLAY_IDENTIFIER ambient_condition[0][11].amb_cond.ydiMemory_xau16[8].ZFEH_EepromData /end MEASUREMENT
/begin MEASUREMENT ZFEH_EepromData.ydiMemory_xau16[8].amb_cond.ambient_condition[0][12] "ambient condition shot [0 .. 2-1] with 25 data bytes [0 .. 25-1] for the error code stored in this error memory slot" UBYTE EH_STANDARD_S4_S3 1 100 0 255 ECU_ADDRESS 0xFFF82524 DISPLAY_IDENTIFIER ambient_condition[0][12].amb_cond.ydiMemory_xau16[8].ZFEH_EepromData /end MEASUREMENT
/begin MEASUREMENT ZFEH_EepromData.ydiMemory_xau16[8].amb_cond.ambient_condition[0][13] "ambient condition shot [0 .. 2-1] with 25 data bytes [0 .. 25-1] for the error code stored in this error memory slot" UBYTE EH_STANDARD_S4_S3 1 100 0 255 ECU_ADDRESS 0xFFF82525 DISPLAY_IDENTIFIER ambient_condition[0][13].amb_cond.ydiMemory_xau16[8].ZFEH_EepromData /end MEASUREMENT
/begin MEASUREMENT ZFEH_EepromData.ydiMemory_xau16[8].amb_cond.ambient_condition[0][14] "ambient condition shot [0 .. 2-1] with 25 data bytes [0 .. 25-1] for the error code stored in this error memory slot" UBYTE EH_STANDARD_S4_S3 1 100 0 255 ECU_ADDRESS 0xFFF82526 DISPLAY_IDENTIFIER ambient_condition[0][14].amb_cond.ydiMemory_xau16[8].ZFEH_EepromData /end MEASUREMENT
/begin MEASUREMENT ZFEH_EepromData.ydiMemory_xau16[8].amb_cond.ambient_condition[0][15] "ambient condition shot [0 .. 2-1] with 25 data bytes [0 .. 25-1] for the error code stored in this error memory slot" UBYTE EH_STANDARD_S4_S3 1 100 0 255 ECU_ADDRESS 0xFFF82527 DISPLAY_IDENTIFIER ambient_condition[0][15].amb_cond.ydiMemory_xau16[8].ZFEH_EepromData /end MEASUREMENT
/begin MEASUREMENT ZFEH_EepromData.ydiMemory_xau16[8].amb_cond.ambient_condition[0][16] "ambient condition shot [0 .. 2-1] with 25 data bytes [0 .. 25-1] for the error code stored in this error memory slot" UBYTE EH_STANDARD_S4_S3 1 100 0 255 ECU_ADDRESS 0xFFF82528 DISPLAY_IDENTIFIER ambient_condition[0][16].amb_cond.ydiMemory_xau16[8].ZFEH_EepromData /end MEASUREMENT
/begin MEASUREMENT ZFEH_EepromData.ydiMemory_xau16[8].amb_cond.ambient_condition[0][17] "ambient condition shot [0 .. 2-1] with 25 data bytes [0 .. 25-1] for the error code stored in this error memory slot" UBYTE EH_STANDARD_S4_S3 1 100 0 255 ECU_ADDRESS 0xFFF82529 DISPLAY_IDENTIFIER ambient_condition[0][17].amb_cond.ydiMemory_xau16[8].ZFEH_EepromData /end MEASUREMENT
/begin MEASUREMENT ZFEH_EepromData.ydiMemory_xau16[8].amb_cond.ambient_condition[0][18] "ambient condition shot [0 .. 2-1] with 25 data bytes [0 .. 25-1] for the error code stored in this error memory slot" UBYTE EH_STANDARD_S4_S3 1 100 0 255 ECU_ADDRESS 0xFFF8252A DISPLAY_IDENTIFIER ambient_condition[0][18].amb_cond.ydiMemory_xau16[8].ZFEH_EepromData /end MEASUREMENT
/begin MEASUREMENT ZFEH_EepromData.ydiMemory_xau16[8].amb_cond.ambient_condition[0][19] "ambient condition shot [0 .. 2-1] with 25 data bytes [0 .. 25-1] for the error code stored in this error memory slot" UBYTE EH_STANDARD_S4_S3 1 100 0 255 ECU_ADDRESS 0xFFF8252B DISPLAY_IDENTIFIER ambient_condition[0][19].amb_cond.ydiMemory_xau16[8].ZFEH_EepromData /end MEASUREMENT
/begin MEASUREMENT ZFEH_EepromData.ydiMemory_xau16[8].amb_cond.ambient_condition[0][1] "ambient condition shot [0 .. 2-1] with 25 data bytes [0 .. 25-1] for the error code stored in this error memory slot" UBYTE EH_STANDARD_S4_S3 1 100 0 255 ECU_ADDRESS 0xFFF82519 DISPLAY_IDENTIFIER ambient_condition[0][1].amb_cond.ydiMemory_xau16[8].ZFEH_EepromData /end MEASUREMENT
/begin MEASUREMENT ZFEH_EepromData.ydiMemory_xau16[8].amb_cond.ambient_condition[0][20] "ambient condition shot [0 .. 2-1] with 25 data bytes [0 .. 25-1] for the error code stored in this error memory slot" UBYTE EH_STANDARD_S4_S3 1 100 0 255 ECU_ADDRESS 0xFFF8252C DISPLAY_IDENTIFIER ambient_condition[0][20].amb_cond.ydiMemory_xau16[8].ZFEH_EepromData /end MEASUREMENT
/begin MEASUREMENT ZFEH_EepromData.ydiMemory_xau16[8].amb_cond.ambient_condition[0][21] "ambient condition shot [0 .. 2-1] with 25 data bytes [0 .. 25-1] for the error code stored in this error memory slot" UBYTE EH_STANDARD_S4_S3 1 100 0 255 ECU_ADDRESS 0xFFF8252D DISPLAY_IDENTIFIER ambient_condition[0][21].amb_cond.ydiMemory_xau16[8].ZFEH_EepromData /end MEASUREMENT
/begin MEASUREMENT ZFEH_EepromData.ydiMemory_xau16[8].amb_cond.ambient_condition[0][22] "ambient condition shot [0 .. 2-1] with 25 data bytes [0 .. 25-1] for the error code stored in this error memory slot" UBYTE EH_STANDARD_S4_S3 1 100 0 255 ECU_ADDRESS 0xFFF8252E DISPLAY_IDENTIFIER ambient_condition[0][22].amb_cond.ydiMemory_xau16[8].ZFEH_EepromData /end MEASUREMENT
/begin MEASUREMENT ZFEH_EepromData.ydiMemory_xau16[8].amb_cond.ambient_condition[0][23] "ambient condition shot [0 .. 2-1] with 25 data bytes [0 .. 25-1] for the error code stored in this error memory slot" UBYTE EH_STANDARD_S4_S3 1 100 0 255 ECU_ADDRESS 0xFFF8252F DISPLAY_IDENTIFIER ambient_condition[0][23].amb_cond.ydiMemory_xau16[8].ZFEH_EepromData /end MEASUREMENT
/begin MEASUREMENT ZFEH_EepromData.ydiMemory_xau16[8].amb_cond.ambient_condition[0][24] "ambient condition shot [0 .. 2-1] with 25 data bytes [0 .. 25-1] for the error code stored in this error memory slot" UBYTE EH_STANDARD_S4_S3 1 100 0 255 ECU_ADDRESS 0xFFF82530 DISPLAY_IDENTIFIER ambient_condition[0][24].amb_cond.ydiMemory_xau16[8].ZFEH_EepromData /end MEASUREMENT
/begin MEASUREMENT ZFEH_EepromData.ydiMemory_xau16[8].amb_cond.ambient_condition[0][2] "ambient condition shot [0 .. 2-1] with 25 data bytes [0 .. 25-1] for the error code stored in this error memory slot" UBYTE EH_STANDARD_S4_S3 1 100 0 255 ECU_ADDRESS 0xFFF8251A DISPLAY_IDENTIFIER ambient_condition[0][2].amb_cond.ydiMemory_xau16[8].ZFEH_EepromData /end MEASUREMENT
/begin MEASUREMENT ZFEH_EepromData.ydiMemory_xau16[8].amb_cond.ambient_condition[0][3] "ambient condition shot [0 .. 2-1] with 25 data bytes [0 .. 25-1] for the error code stored in this error memory slot" UBYTE EH_STANDARD_S4_S3 1 100 0 255 ECU_ADDRESS 0xFFF8251B DISPLAY_IDENTIFIER ambient_condition[0][3].amb_cond.ydiMemory_xau16[8].ZFEH_EepromData /end MEASUREMENT
/begin MEASUREMENT ZFEH_EepromData.ydiMemory_xau16[8].amb_cond.ambient_condition[0][4] "ambient condition shot [0 .. 2-1] with 25 data bytes [0 .. 25-1] for the error code stored in this error memory slot" UBYTE EH_STANDARD_S4_S3 1 100 0 255 ECU_ADDRESS 0xFFF8251C DISPLAY_IDENTIFIER ambient_condition[0][4].amb_cond.ydiMemory_xau16[8].ZFEH_EepromData /end MEASUREMENT
/begin MEASUREMENT ZFEH_EepromData.ydiMemory_xau16[8].amb_cond.ambient_condition[0][5] "ambient condition shot [0 .. 2-1] with 25 data bytes [0 .. 25-1] for the error code stored in this error memory slot" UBYTE EH_STANDARD_S4_S3 1 100 0 255 ECU_ADDRESS 0xFFF8251D DISPLAY_IDENTIFIER ambient_condition[0][5].amb_cond.ydiMemory_xau16[8].ZFEH_EepromData /end MEASUREMENT
/begin MEASUREMENT ZFEH_EepromData.ydiMemory_xau16[8].amb_cond.ambient_condition[0][6] "ambient condition shot [0 .. 2-1] with 25 data bytes [0 .. 25-1] for the error code stored in this error memory slot" UBYTE EH_STANDARD_S4_S3 1 100 0 255 ECU_ADDRESS 0xFFF8251E DISPLAY_IDENTIFIER ambient_condition[0][6].amb_cond.ydiMemory_xau16[8].ZFEH_EepromData /end MEASUREMENT
/begin MEASUREMENT ZFEH_EepromData.ydiMemory_xau16[8].amb_cond.ambient_condition[0][7] "ambient condition shot [0 .. 2-1] with 25 data bytes [0 .. 25-1] for the error code stored in this error memory slot" UBYTE EH_STANDARD_S4_S3 1 100 0 255 ECU_ADDRESS 0xFFF8251F DISPLAY_IDENTIFIER ambient_condition[0][7].amb_cond.ydiMemory_xau16[8].ZFEH_EepromData /end MEASUREMENT
/begin MEASUREMENT ZFEH_EepromData.ydiMemory_xau16[8].amb_cond.ambient_condition[0][8] "ambient condition shot [0 .. 2-1] with 25 data bytes [0 .. 25-1] for the error code stored in this error memory slot" UBYTE EH_STANDARD_S4_S3 1 100 0 255 ECU_ADDRESS 0xFFF82520 DISPLAY_IDENTIFIER ambient_condition[0][8].amb_cond.ydiMemory_xau16[8].ZFEH_EepromData /end MEASUREMENT
/begin MEASUREMENT ZFEH_EepromData.ydiMemory_xau16[8].amb_cond.ambient_condition[0][9] "ambient condition shot [0 .. 2-1] with 25 data bytes [0 .. 25-1] for the error code stored in this error memory slot" UBYTE EH_STANDARD_S4_S3 1 100 0 255 ECU_ADDRESS 0xFFF82521 DISPLAY_IDENTIFIER ambient_condition[0][9].amb_cond.ydiMemory_xau16[8].ZFEH_EepromData /end MEASUREMENT
/begin MEASUREMENT ZFEH_EepromData.ydiMemory_xau16[8].amb_cond.ambient_condition[1][0] "ambient condition shot [0 .. 2-1] with 25 data bytes [0 .. 25-1] for the error code stored in this error memory slot" UBYTE EH_STANDARD_S4_S3 1 100 0 255 ECU_ADDRESS 0xFFF82531 DISPLAY_IDENTIFIER ambient_condition[1][0].amb_cond.ydiMemory_xau16[8].ZFEH_EepromData /end MEASUREMENT
/begin MEASUREMENT ZFEH_EepromData.ydiMemory_xau16[8].amb_cond.ambient_condition[1][10] "ambient condition shot [0 .. 2-1] with 25 data bytes [0 .. 25-1] for the error code stored in this error memory slot" UBYTE EH_STANDARD_S4_S3 1 100 0 255 ECU_ADDRESS 0xFFF8253B DISPLAY_IDENTIFIER ambient_condition[1][10].amb_cond.ydiMemory_xau16[8].ZFEH_EepromData /end MEASUREMENT
/begin MEASUREMENT ZFEH_EepromData.ydiMemory_xau16[8].amb_cond.ambient_condition[1][11] "ambient condition shot [0 .. 2-1] with 25 data bytes [0 .. 25-1] for the error code stored in this error memory slot" UBYTE EH_STANDARD_S4_S3 1 100 0 255 ECU_ADDRESS 0xFFF8253C DISPLAY_IDENTIFIER ambient_condition[1][11].amb_cond.ydiMemory_xau16[8].ZFEH_EepromData /end MEASUREMENT
/begin MEASUREMENT ZFEH_EepromData.ydiMemory_xau16[8].amb_cond.ambient_condition[1][12] "ambient condition shot [0 .. 2-1] with 25 data bytes [0 .. 25-1] for the error code stored in this error memory slot" UBYTE EH_STANDARD_S4_S3 1 100 0 255 ECU_ADDRESS 0xFFF8253D DISPLAY_IDENTIFIER ambient_condition[1][12].amb_cond.ydiMemory_xau16[8].ZFEH_EepromData /end MEASUREMENT
/begin MEASUREMENT ZFEH_EepromData.ydiMemory_xau16[8].amb_cond.ambient_condition[1][13] "ambient condition shot [0 .. 2-1] with 25 data bytes [0 .. 25-1] for the error code stored in this error memory slot" UBYTE EH_STANDARD_S4_S3 1 100 0 255 ECU_ADDRESS 0xFFF8253E DISPLAY_IDENTIFIER ambient_condition[1][13].amb_cond.ydiMemory_xau16[8].ZFEH_EepromData /end MEASUREMENT
/begin MEASUREMENT ZFEH_EepromData.ydiMemory_xau16[8].amb_cond.ambient_condition[1][14] "ambient condition shot [0 .. 2-1] with 25 data bytes [0 .. 25-1] for the error code stored in this error memory slot" UBYTE EH_STANDARD_S4_S3 1 100 0 255 ECU_ADDRESS 0xFFF8253F DISPLAY_IDENTIFIER ambient_condition[1][14].amb_cond.ydiMemory_xau16[8].ZFEH_EepromData /end MEASUREMENT
/begin MEASUREMENT ZFEH_EepromData.ydiMemory_xau16[8].amb_cond.ambient_condition[1][15] "ambient condition shot [0 .. 2-1] with 25 data bytes [0 .. 25-1] for the error code stored in this error memory slot" UBYTE EH_STANDARD_S4_S3 1 100 0 255 ECU_ADDRESS 0xFFF82540 DISPLAY_IDENTIFIER ambient_condition[1][15].amb_cond.ydiMemory_xau16[8].ZFEH_EepromData /end MEASUREMENT
/begin MEASUREMENT ZFEH_EepromData.ydiMemory_xau16[8].amb_cond.ambient_condition[1][16] "ambient condition shot [0 .. 2-1] with 25 data bytes [0 .. 25-1] for the error code stored in this error memory slot" UBYTE EH_STANDARD_S4_S3 1 100 0 255 ECU_ADDRESS 0xFFF82541 DISPLAY_IDENTIFIER ambient_condition[1][16].amb_cond.ydiMemory_xau16[8].ZFEH_EepromData /end MEASUREMENT
/begin MEASUREMENT ZFEH_EepromData.ydiMemory_xau16[8].amb_cond.ambient_condition[1][17] "ambient condition shot [0 .. 2-1] with 25 data bytes [0 .. 25-1] for the error code stored in this error memory slot" UBYTE EH_STANDARD_S4_S3 1 100 0 255 ECU_ADDRESS 0xFFF82542 DISPLAY_IDENTIFIER ambient_condition[1][17].amb_cond.ydiMemory_xau16[8].ZFEH_EepromData /end MEASUREMENT
/begin MEASUREMENT ZFEH_EepromData.ydiMemory_xau16[8].amb_cond.ambient_condition[1][18] "ambient condition shot [0 .. 2-1] with 25 data bytes [0 .. 25-1] for the error code stored in this error memory slot" UBYTE EH_STANDARD_S4_S3 1 100 0 255 ECU_ADDRESS 0xFFF82543 DISPLAY_IDENTIFIER ambient_condition[1][18].amb_cond.ydiMemory_xau16[8].ZFEH_EepromData /end MEASUREMENT
/begin MEASUREMENT ZFEH_EepromData.ydiMemory_xau16[8].amb_cond.ambient_condition[1][19] "ambient condition shot [0 .. 2-1] with 25 data bytes [0 .. 25-1] for the error code stored in this error memory slot" UBYTE EH_STANDARD_S4_S3 1 100 0 255 ECU_ADDRESS 0xFFF82544 DISPLAY_IDENTIFIER ambient_condition[1][19].amb_cond.ydiMemory_xau16[8].ZFEH_EepromData /end MEASUREMENT
/begin MEASUREMENT ZFEH_EepromData.ydiMemory_xau16[8].amb_cond.ambient_condition[1][1] "ambient condition shot [0 .. 2-1] with 25 data bytes [0 .. 25-1] for the error code stored in this error memory slot" UBYTE EH_STANDARD_S4_S3 1 100 0 255 ECU_ADDRESS 0xFFF82532 DISPLAY_IDENTIFIER ambient_condition[1][1].amb_cond.ydiMemory_xau16[8].ZFEH_EepromData /end MEASUREMENT
/begin MEASUREMENT ZFEH_EepromData.ydiMemory_xau16[8].amb_cond.ambient_condition[1][20] "ambient condition shot [0 .. 2-1] with 25 data bytes [0 .. 25-1] for the error code stored in this error memory slot" UBYTE EH_STANDARD_S4_S3 1 100 0 255 ECU_ADDRESS 0xFFF82545 DISPLAY_IDENTIFIER ambient_condition[1][20].amb_cond.ydiMemory_xau16[8].ZFEH_EepromData /end MEASUREMENT
/begin MEASUREMENT ZFEH_EepromData.ydiMemory_xau16[8].amb_cond.ambient_condition[1][21] "ambient condition shot [0 .. 2-1] with 25 data bytes [0 .. 25-1] for the error code stored in this error memory slot" UBYTE EH_STANDARD_S4_S3 1 100 0 255 ECU_ADDRESS 0xFFF82546 DISPLAY_IDENTIFIER ambient_condition[1][21].amb_cond.ydiMemory_xau16[8].ZFEH_EepromData /end MEASUREMENT
/begin MEASUREMENT ZFEH_EepromData.ydiMemory_xau16[8].amb_cond.ambient_condition[1][22] "ambient condition shot [0 .. 2-1] with 25 data bytes [0 .. 25-1] for the error code stored in this error memory slot" UBYTE EH_STANDARD_S4_S3 1 100 0 255 ECU_ADDRESS 0xFFF82547 DISPLAY_IDENTIFIER ambient_condition[1][22].amb_cond.ydiMemory_xau16[8].ZFEH_EepromData /end MEASUREMENT
/begin MEASUREMENT ZFEH_EepromData.ydiMemory_xau16[8].amb_cond.ambient_condition[1][23] "ambient condition shot [0 .. 2-1] with 25 data bytes [0 .. 25-1] for the error code stored in this error memory slot" UBYTE EH_STANDARD_S4_S3 1 100 0 255 ECU_ADDRESS 0xFFF82548 DISPLAY_IDENTIFIER ambient_condition[1][23].amb_cond.ydiMemory_xau16[8].ZFEH_EepromData /end MEASUREMENT
/begin MEASUREMENT ZFEH_EepromData.ydiMemory_xau16[8].amb_cond.ambient_condition[1][24] "ambient condition shot [0 .. 2-1] with 25 data bytes [0 .. 25-1] for the error code stored in this error memory slot" UBYTE EH_STANDARD_S4_S3 1 100 0 255 ECU_ADDRESS 0xFFF82549 DISPLAY_IDENTIFIER ambient_condition[1][24].amb_cond.ydiMemory_xau16[8].ZFEH_EepromData /end MEASUREMENT
/begin MEASUREMENT ZFEH_EepromData.ydiMemory_xau16[8].amb_cond.ambient_condition[1][2] "ambient condition shot [0 .. 2-1] with 25 data bytes [0 .. 25-1] for the error code stored in this error memory slot" UBYTE EH_STANDARD_S4_S3 1 100 0 255 ECU_ADDRESS 0xFFF82533 DISPLAY_IDENTIFIER ambient_condition[1][2].amb_cond.ydiMemory_xau16[8].ZFEH_EepromData /end MEASUREMENT
/begin MEASUREMENT ZFEH_EepromData.ydiMemory_xau16[8].amb_cond.ambient_condition[1][3] "ambient condition shot [0 .. 2-1] with 25 data bytes [0 .. 25-1] for the error code stored in this error memory slot" UBYTE EH_STANDARD_S4_S3 1 100 0 255 ECU_ADDRESS 0xFFF82534 DISPLAY_IDENTIFIER ambient_condition[1][3].amb_cond.ydiMemory_xau16[8].ZFEH_EepromData /end MEASUREMENT
/begin MEASUREMENT ZFEH_EepromData.ydiMemory_xau16[8].amb_cond.ambient_condition[1][4] "ambient condition shot [0 .. 2-1] with 25 data bytes [0 .. 25-1] for the error code stored in this error memory slot" UBYTE EH_STANDARD_S4_S3 1 100 0 255 ECU_ADDRESS 0xFFF82535 DISPLAY_IDENTIFIER ambient_condition[1][4].amb_cond.ydiMemory_xau16[8].ZFEH_EepromData /end MEASUREMENT
/begin MEASUREMENT ZFEH_EepromData.ydiMemory_xau16[8].amb_cond.ambient_condition[1][5] "ambient condition shot [0 .. 2-1] with 25 data bytes [0 .. 25-1] for the error code stored in this error memory slot" UBYTE EH_STANDARD_S4_S3 1 100 0 255 ECU_ADDRESS 0xFFF82536 DISPLAY_IDENTIFIER ambient_condition[1][5].amb_cond.ydiMemory_xau16[8].ZFEH_EepromData /end MEASUREMENT
/begin MEASUREMENT ZFEH_EepromData.ydiMemory_xau16[8].amb_cond.ambient_condition[1][6] "ambient condition shot [0 .. 2-1] with 25 data bytes [0 .. 25-1] for the error code stored in this error memory slot" UBYTE EH_STANDARD_S4_S3 1 100 0 255 ECU_ADDRESS 0xFFF82537 DISPLAY_IDENTIFIER ambient_condition[1][6].amb_cond.ydiMemory_xau16[8].ZFEH_EepromData /end MEASUREMENT
/begin MEASUREMENT ZFEH_EepromData.ydiMemory_xau16[8].amb_cond.ambient_condition[1][7] "ambient condition shot [0 .. 2-1] with 25 data bytes [0 .. 25-1] for the error code stored in this error memory slot" UBYTE EH_STANDARD_S4_S3 1 100 0 255 ECU_ADDRESS 0xFFF82538 DISPLAY_IDENTIFIER ambient_condition[1][7].amb_cond.ydiMemory_xau16[8].ZFEH_EepromData /end MEASUREMENT
/begin MEASUREMENT ZFEH_EepromData.ydiMemory_xau16[8].amb_cond.ambient_condition[1][8] "ambient condition shot [0 .. 2-1] with 25 data bytes [0 .. 25-1] for the error code stored in this error memory slot" UBYTE EH_STANDARD_S4_S3 1 100 0 255 ECU_ADDRESS 0xFFF82539 DISPLAY_IDENTIFIER ambient_condition[1][8].amb_cond.ydiMemory_xau16[8].ZFEH_EepromData /end MEASUREMENT
/begin MEASUREMENT ZFEH_EepromData.ydiMemory_xau16[8].amb_cond.ambient_condition[1][9] "ambient condition shot [0 .. 2-1] with 25 data bytes [0 .. 25-1] for the error code stored in this error memory slot" UBYTE EH_STANDARD_S4_S3 1 100 0 255 ECU_ADDRESS 0xFFF8253A DISPLAY_IDENTIFIER ambient_condition[1][9].amb_cond.ydiMemory_xau16[8].ZFEH_EepromData /end MEASUREMENT
/begin MEASUREMENT ZFEH_EepromData.ydiMemory_xau16[8].amb_cond.status_of_ambient_conditions[0] "status of ambient condition shot x: 0=invalid 1=valid" UBYTE EH_STANDARD_S4_S3 1 100 0 1 ECU_ADDRESS 0xFFF8254A DISPLAY_IDENTIFIER status_of_ambient_conditions[0].amb_cond.ydiMemory_xau16[8].ZFEH_EepromData /end MEASUREMENT
/begin MEASUREMENT ZFEH_EepromData.ydiMemory_xau16[8].amb_cond.status_of_ambient_conditions[1] "status of ambient condition shot x: 0=invalid 1=valid" UBYTE EH_STANDARD_S4_S3 1 100 0 1 ECU_ADDRESS 0xFFF8254B DISPLAY_IDENTIFIER status_of_ambient_conditions[1].amb_cond.ydiMemory_xau16[8].ZFEH_EepromData /end MEASUREMENT
/begin MEASUREMENT ZFEH_EepromData.ydiMemory_xau16[8].backwards_counter "backwards counter of error code stored in error memory slot" UBYTE EH_STANDARD_S4_S3 1 100 0 255 ECU_ADDRESS 0xFFF8250B DISPLAY_IDENTIFIER backwards_counter.ydiMemory_xau16[8].ZFEH_EepromData /end MEASUREMENT
/begin MEASUREMENT ZFEH_EepromData.ydiMemory_xau16[8].condition_byte "condition byte of error code stored in error memory slot" UBYTE EH_STANDARD_S4_S3 1 100 0 255 ECU_ADDRESS 0xFFF82515 DISPLAY_IDENTIFIER condition_byte.ydiMemory_xau16[8].ZFEH_EepromData /end MEASUREMENT
/begin MEASUREMENT ZFEH_EepromData.ydiMemory_xau16[8].error_code "error code stored in error memory slot" UWORD EH_STANDARD_S4_S3 1 100 0 65535 ECU_ADDRESS 0xFFF82504 DISPLAY_IDENTIFIER error_code.ydiMemory_xau16[8].ZFEH_EepromData /end MEASUREMENT
/begin MEASUREMENT ZFEH_EepromData.ydiMemory_xau16[8].error_type "error type of error code stored in error memory slot" UWORD EH_STANDARD_S4_S3 1 100 0 65535 ECU_ADDRESS 0xFFF82506 DISPLAY_IDENTIFIER error_type.ydiMemory_xau16[8].ZFEH_EepromData /end MEASUREMENT
/begin MEASUREMENT ZFEH_EepromData.ydiMemory_xau16[8].frequency_counter "frequency counter of error code stored in error memory slot" UBYTE EH_STANDARD_S4_S3 1 100 0 255 ECU_ADDRESS 0xFFF8250A DISPLAY_IDENTIFIER frequency_counter.ydiMemory_xau16[8].ZFEH_EepromData /end MEASUREMENT
/begin MEASUREMENT ZFEH_EepromData.ydiMemory_xau16[8].master_time "master time of error code stored in error memory slot" ULONG EH_STANDARD_S4_S3 1 100 0 4294967295 ECU_ADDRESS 0xFFF82510 DISPLAY_IDENTIFIER master_time.ydiMemory_xau16[8].ZFEH_EepromData /end MEASUREMENT
/begin MEASUREMENT ZFEH_EepromData.ydiMemory_xau16[8].obd_driving_cycle_counter "obd driving cycle counter of error code stored in error memory slot" UWORD EH_STANDARD_S4_S3 1 100 0 65535 ECU_ADDRESS 0xFFF82516 DISPLAY_IDENTIFIER obd_driving_cycle_counter.ydiMemory_xau16[8].ZFEH_EepromData /end MEASUREMENT
/begin MEASUREMENT ZFEH_EepromData.ydiMemory_xau16[8].permanent_counter "counter of permanent error codes stored in error memory slot" UBYTE EH_STANDARD_S4_S3 1 100 0 255 ECU_ADDRESS 0xFFF8250C DISPLAY_IDENTIFIER permanent_counter.ydiMemory_xau16[8].ZFEH_EepromData /end MEASUREMENT
/begin MEASUREMENT ZFEH_EepromData.ydiMemory_xau16[8].sequence_counter "sequence counter of error code stored in error memory slot" UBYTE EH_STANDARD_S4_S3 1 100 0 255 ECU_ADDRESS 0xFFF8250D DISPLAY_IDENTIFIER sequence_counter.ydiMemory_xau16[8].ZFEH_EepromData /end MEASUREMENT
/begin MEASUREMENT ZFEH_EepromData.ydiMemory_xau16[8].status_word "status word of error code stored in error memory slot" UWORD EH_STANDARD_S4_S3 1 100 0 65535 ECU_ADDRESS 0xFFF82508 DISPLAY_IDENTIFIER status_word.ydiMemory_xau16[8].ZFEH_EepromData /end MEASUREMENT
/begin MEASUREMENT ZFEH_EepromData.ydiMemory_xau16[9].amb_cond.ambient_condition[0][0] "ambient condition shot [0 .. 2-1] with 25 data bytes [0 .. 25-1] for the error code stored in this error memory slot" UBYTE EH_STANDARD_S4_S3 1 100 0 255 ECU_ADDRESS 0xFFF82560 DISPLAY_IDENTIFIER ambient_condition[0][0].amb_cond.ydiMemory_xau16[9].ZFEH_EepromData /end MEASUREMENT
/begin MEASUREMENT ZFEH_EepromData.ydiMemory_xau16[9].amb_cond.ambient_condition[0][10] "ambient condition shot [0 .. 2-1] with 25 data bytes [0 .. 25-1] for the error code stored in this error memory slot" UBYTE EH_STANDARD_S4_S3 1 100 0 255 ECU_ADDRESS 0xFFF8256A DISPLAY_IDENTIFIER ambient_condition[0][10].amb_cond.ydiMemory_xau16[9].ZFEH_EepromData /end MEASUREMENT
/begin MEASUREMENT ZFEH_EepromData.ydiMemory_xau16[9].amb_cond.ambient_condition[0][11] "ambient condition shot [0 .. 2-1] with 25 data bytes [0 .. 25-1] for the error code stored in this error memory slot" UBYTE EH_STANDARD_S4_S3 1 100 0 255 ECU_ADDRESS 0xFFF8256B DISPLAY_IDENTIFIER ambient_condition[0][11].amb_cond.ydiMemory_xau16[9].ZFEH_EepromData /end MEASUREMENT
/begin MEASUREMENT ZFEH_EepromData.ydiMemory_xau16[9].amb_cond.ambient_condition[0][12] "ambient condition shot [0 .. 2-1] with 25 data bytes [0 .. 25-1] for the error code stored in this error memory slot" UBYTE EH_STANDARD_S4_S3 1 100 0 255 ECU_ADDRESS 0xFFF8256C DISPLAY_IDENTIFIER ambient_condition[0][12].amb_cond.ydiMemory_xau16[9].ZFEH_EepromData /end MEASUREMENT
/begin MEASUREMENT ZFEH_EepromData.ydiMemory_xau16[9].amb_cond.ambient_condition[0][13] "ambient condition shot [0 .. 2-1] with 25 data bytes [0 .. 25-1] for the error code stored in this error memory slot" UBYTE EH_STANDARD_S4_S3 1 100 0 255 ECU_ADDRESS 0xFFF8256D DISPLAY_IDENTIFIER ambient_condition[0][13].amb_cond.ydiMemory_xau16[9].ZFEH_EepromData /end MEASUREMENT
/begin MEASUREMENT ZFEH_EepromData.ydiMemory_xau16[9].amb_cond.ambient_condition[0][14] "ambient condition shot [0 .. 2-1] with 25 data bytes [0 .. 25-1] for the error code stored in this error memory slot" UBYTE EH_STANDARD_S4_S3 1 100 0 255 ECU_ADDRESS 0xFFF8256E DISPLAY_IDENTIFIER ambient_condition[0][14].amb_cond.ydiMemory_xau16[9].ZFEH_EepromData /end MEASUREMENT
/begin MEASUREMENT ZFEH_EepromData.ydiMemory_xau16[9].amb_cond.ambient_condition[0][15] "ambient condition shot [0 .. 2-1] with 25 data bytes [0 .. 25-1] for the error code stored in this error memory slot" UBYTE EH_STANDARD_S4_S3 1 100 0 255 ECU_ADDRESS 0xFFF8256F DISPLAY_IDENTIFIER ambient_condition[0][15].amb_cond.ydiMemory_xau16[9].ZFEH_EepromData /end MEASUREMENT
/begin MEASUREMENT ZFEH_EepromData.ydiMemory_xau16[9].amb_cond.ambient_condition[0][16] "ambient condition shot [0 .. 2-1] with 25 data bytes [0 .. 25-1] for the error code stored in this error memory slot" UBYTE EH_STANDARD_S4_S3 1 100 0 255 ECU_ADDRESS 0xFFF82570 DISPLAY_IDENTIFIER ambient_condition[0][16].amb_cond.ydiMemory_xau16[9].ZFEH_EepromData /end MEASUREMENT
/begin MEASUREMENT ZFEH_EepromData.ydiMemory_xau16[9].amb_cond.ambient_condition[0][17] "ambient condition shot [0 .. 2-1] with 25 data bytes [0 .. 25-1] for the error code stored in this error memory slot" UBYTE EH_STANDARD_S4_S3 1 100 0 255 ECU_ADDRESS 0xFFF82571 DISPLAY_IDENTIFIER ambient_condition[0][17].amb_cond.ydiMemory_xau16[9].ZFEH_EepromData /end MEASUREMENT
/begin MEASUREMENT ZFEH_EepromData.ydiMemory_xau16[9].amb_cond.ambient_condition[0][18] "ambient condition shot [0 .. 2-1] with 25 data bytes [0 .. 25-1] for the error code stored in this error memory slot" UBYTE EH_STANDARD_S4_S3 1 100 0 255 ECU_ADDRESS 0xFFF82572 DISPLAY_IDENTIFIER ambient_condition[0][18].amb_cond.ydiMemory_xau16[9].ZFEH_EepromData /end MEASUREMENT
/begin MEASUREMENT ZFEH_EepromData.ydiMemory_xau16[9].amb_cond.ambient_condition[0][19] "ambient condition shot [0 .. 2-1] with 25 data bytes [0 .. 25-1] for the error code stored in this error memory slot" UBYTE EH_STANDARD_S4_S3 1 100 0 255 ECU_ADDRESS 0xFFF82573 DISPLAY_IDENTIFIER ambient_condition[0][19].amb_cond.ydiMemory_xau16[9].ZFEH_EepromData /end MEASUREMENT
/begin MEASUREMENT ZFEH_EepromData.ydiMemory_xau16[9].amb_cond.ambient_condition[0][1] "ambient condition shot [0 .. 2-1] with 25 data bytes [0 .. 25-1] for the error code stored in this error memory slot" UBYTE EH_STANDARD_S4_S3 1 100 0 255 ECU_ADDRESS 0xFFF82561 DISPLAY_IDENTIFIER ambient_condition[0][1].amb_cond.ydiMemory_xau16[9].ZFEH_EepromData /end MEASUREMENT
/begin MEASUREMENT ZFEH_EepromData.ydiMemory_xau16[9].amb_cond.ambient_condition[0][20] "ambient condition shot [0 .. 2-1] with 25 data bytes [0 .. 25-1] for the error code stored in this error memory slot" UBYTE EH_STANDARD_S4_S3 1 100 0 255 ECU_ADDRESS 0xFFF82574 DISPLAY_IDENTIFIER ambient_condition[0][20].amb_cond.ydiMemory_xau16[9].ZFEH_EepromData /end MEASUREMENT
/begin MEASUREMENT ZFEH_EepromData.ydiMemory_xau16[9].amb_cond.ambient_condition[0][21] "ambient condition shot [0 .. 2-1] with 25 data bytes [0 .. 25-1] for the error code stored in this error memory slot" UBYTE EH_STANDARD_S4_S3 1 100 0 255 ECU_ADDRESS 0xFFF82575 DISPLAY_IDENTIFIER ambient_condition[0][21].amb_cond.ydiMemory_xau16[9].ZFEH_EepromData /end MEASUREMENT
/begin MEASUREMENT ZFEH_EepromData.ydiMemory_xau16[9].amb_cond.ambient_condition[0][22] "ambient condition shot [0 .. 2-1] with 25 data bytes [0 .. 25-1] for the error code stored in this error memory slot" UBYTE EH_STANDARD_S4_S3 1 100 0 255 ECU_ADDRESS 0xFFF82576 DISPLAY_IDENTIFIER ambient_condition[0][22].amb_cond.ydiMemory_xau16[9].ZFEH_EepromData /end MEASUREMENT
/begin MEASUREMENT ZFEH_EepromData.ydiMemory_xau16[9].amb_cond.ambient_condition[0][23] "ambient condition shot [0 .. 2-1] with 25 data bytes [0 .. 25-1] for the error code stored in this error memory slot" UBYTE EH_STANDARD_S4_S3 1 100 0 255 ECU_ADDRESS 0xFFF82577 DISPLAY_IDENTIFIER ambient_condition[0][23].amb_cond.ydiMemory_xau16[9].ZFEH_EepromData /end MEASUREMENT
/begin MEASUREMENT ZFEH_EepromData.ydiMemory_xau16[9].amb_cond.ambient_condition[0][24] "ambient condition shot [0 .. 2-1] with 25 data bytes [0 .. 25-1] for the error code stored in this error memory slot" UBYTE EH_STANDARD_S4_S3 1 100 0 255 ECU_ADDRESS 0xFFF82578 DISPLAY_IDENTIFIER ambient_condition[0][24].amb_cond.ydiMemory_xau16[9].ZFEH_EepromData /end MEASUREMENT
/begin MEASUREMENT ZFEH_EepromData.ydiMemory_xau16[9].amb_cond.ambient_condition[0][2] "ambient condition shot [0 .. 2-1] with 25 data bytes [0 .. 25-1] for the error code stored in this error memory slot" UBYTE EH_STANDARD_S4_S3 1 100 0 255 ECU_ADDRESS 0xFFF82562 DISPLAY_IDENTIFIER ambient_condition[0][2].amb_cond.ydiMemory_xau16[9].ZFEH_EepromData /end MEASUREMENT
/begin MEASUREMENT ZFEH_EepromData.ydiMemory_xau16[9].amb_cond.ambient_condition[0][3] "ambient condition shot [0 .. 2-1] with 25 data bytes [0 .. 25-1] for the error code stored in this error memory slot" UBYTE EH_STANDARD_S4_S3 1 100 0 255 ECU_ADDRESS 0xFFF82563 DISPLAY_IDENTIFIER ambient_condition[0][3].amb_cond.ydiMemory_xau16[9].ZFEH_EepromData /end MEASUREMENT
/begin MEASUREMENT ZFEH_EepromData.ydiMemory_xau16[9].amb_cond.ambient_condition[0][4] "ambient condition shot [0 .. 2-1] with 25 data bytes [0 .. 25-1] for the error code stored in this error memory slot" UBYTE EH_STANDARD_S4_S3 1 100 0 255 ECU_ADDRESS 0xFFF82564 DISPLAY_IDENTIFIER ambient_condition[0][4].amb_cond.ydiMemory_xau16[9].ZFEH_EepromData /end MEASUREMENT
/begin MEASUREMENT ZFEH_EepromData.ydiMemory_xau16[9].amb_cond.ambient_condition[0][5] "ambient condition shot [0 .. 2-1] with 25 data bytes [0 .. 25-1] for the error code stored in this error memory slot" UBYTE EH_STANDARD_S4_S3 1 100 0 255 ECU_ADDRESS 0xFFF82565 DISPLAY_IDENTIFIER ambient_condition[0][5].amb_cond.ydiMemory_xau16[9].ZFEH_EepromData /end MEASUREMENT
/begin MEASUREMENT ZFEH_EepromData.ydiMemory_xau16[9].amb_cond.ambient_condition[0][6] "ambient condition shot [0 .. 2-1] with 25 data bytes [0 .. 25-1] for the error code stored in this error memory slot" UBYTE EH_STANDARD_S4_S3 1 100 0 255 ECU_ADDRESS 0xFFF82566 DISPLAY_IDENTIFIER ambient_condition[0][6].amb_cond.ydiMemory_xau16[9].ZFEH_EepromData /end MEASUREMENT
/begin MEASUREMENT ZFEH_EepromData.ydiMemory_xau16[9].amb_cond.ambient_condition[0][7] "ambient condition shot [0 .. 2-1] with 25 data bytes [0 .. 25-1] for the error code stored in this error memory slot" UBYTE EH_STANDARD_S4_S3 1 100 0 255 ECU_ADDRESS 0xFFF82567 DISPLAY_IDENTIFIER ambient_condition[0][7].amb_cond.ydiMemory_xau16[9].ZFEH_EepromData /end MEASUREMENT
/begin MEASUREMENT ZFEH_EepromData.ydiMemory_xau16[9].amb_cond.ambient_condition[0][8] "ambient condition shot [0 .. 2-1] with 25 data bytes [0 .. 25-1] for the error code stored in this error memory slot" UBYTE EH_STANDARD_S4_S3 1 100 0 255 ECU_ADDRESS 0xFFF82568 DISPLAY_IDENTIFIER ambient_condition[0][8].amb_cond.ydiMemory_xau16[9].ZFEH_EepromData /end MEASUREMENT
/begin MEASUREMENT ZFEH_EepromData.ydiMemory_xau16[9].amb_cond.ambient_condition[0][9] "ambient condition shot [0 .. 2-1] with 25 data bytes [0 .. 25-1] for the error code stored in this error memory slot" UBYTE EH_STANDARD_S4_S3 1 100 0 255 ECU_ADDRESS 0xFFF82569 DISPLAY_IDENTIFIER ambient_condition[0][9].amb_cond.ydiMemory_xau16[9].ZFEH_EepromData /end MEASUREMENT
/begin MEASUREMENT ZFEH_EepromData.ydiMemory_xau16[9].amb_cond.ambient_condition[1][0] "ambient condition shot [0 .. 2-1] with 25 data bytes [0 .. 25-1] for the error code stored in this error memory slot" UBYTE EH_STANDARD_S4_S3 1 100 0 255 ECU_ADDRESS 0xFFF82579 DISPLAY_IDENTIFIER ambient_condition[1][0].amb_cond.ydiMemory_xau16[9].ZFEH_EepromData /end MEASUREMENT
/begin MEASUREMENT ZFEH_EepromData.ydiMemory_xau16[9].amb_cond.ambient_condition[1][10] "ambient condition shot [0 .. 2-1] with 25 data bytes [0 .. 25-1] for the error code stored in this error memory slot" UBYTE EH_STANDARD_S4_S3 1 100 0 255 ECU_ADDRESS 0xFFF82583 DISPLAY_IDENTIFIER ambient_condition[1][10].amb_cond.ydiMemory_xau16[9].ZFEH_EepromData /end MEASUREMENT
/begin MEASUREMENT ZFEH_EepromData.ydiMemory_xau16[9].amb_cond.ambient_condition[1][11] "ambient condition shot [0 .. 2-1] with 25 data bytes [0 .. 25-1] for the error code stored in this error memory slot" UBYTE EH_STANDARD_S4_S3 1 100 0 255 ECU_ADDRESS 0xFFF82584 DISPLAY_IDENTIFIER ambient_condition[1][11].amb_cond.ydiMemory_xau16[9].ZFEH_EepromData /end MEASUREMENT
/begin MEASUREMENT ZFEH_EepromData.ydiMemory_xau16[9].amb_cond.ambient_condition[1][12] "ambient condition shot [0 .. 2-1] with 25 data bytes [0 .. 25-1] for the error code stored in this error memory slot" UBYTE EH_STANDARD_S4_S3 1 100 0 255 ECU_ADDRESS 0xFFF82585 DISPLAY_IDENTIFIER ambient_condition[1][12].amb_cond.ydiMemory_xau16[9].ZFEH_EepromData /end MEASUREMENT
/begin MEASUREMENT ZFEH_EepromData.ydiMemory_xau16[9].amb_cond.ambient_condition[1][13] "ambient condition shot [0 .. 2-1] with 25 data bytes [0 .. 25-1] for the error code stored in this error memory slot" UBYTE EH_STANDARD_S4_S3 1 100 0 255 ECU_ADDRESS 0xFFF82586 DISPLAY_IDENTIFIER ambient_condition[1][13].amb_cond.ydiMemory_xau16[9].ZFEH_EepromData /end MEASUREMENT
/begin MEASUREMENT ZFEH_EepromData.ydiMemory_xau16[9].amb_cond.ambient_condition[1][14] "ambient condition shot [0 .. 2-1] with 25 data bytes [0 .. 25-1] for the error code stored in this error memory slot" UBYTE EH_STANDARD_S4_S3 1 100 0 255 ECU_ADDRESS 0xFFF82587 DISPLAY_IDENTIFIER ambient_condition[1][14].amb_cond.ydiMemory_xau16[9].ZFEH_EepromData /end MEASUREMENT
/begin MEASUREMENT ZFEH_EepromData.ydiMemory_xau16[9].amb_cond.ambient_condition[1][15] "ambient condition shot [0 .. 2-1] with 25 data bytes [0 .. 25-1] for the error code stored in this error memory slot" UBYTE EH_STANDARD_S4_S3 1 100 0 255 ECU_ADDRESS 0xFFF82588 DISPLAY_IDENTIFIER ambient_condition[1][15].amb_cond.ydiMemory_xau16[9].ZFEH_EepromData /end MEASUREMENT
/begin MEASUREMENT ZFEH_EepromData.ydiMemory_xau16[9].amb_cond.ambient_condition[1][16] "ambient condition shot [0 .. 2-1] with 25 data bytes [0 .. 25-1] for the error code stored in this error memory slot" UBYTE EH_STANDARD_S4_S3 1 100 0 255 ECU_ADDRESS 0xFFF82589 DISPLAY_IDENTIFIER ambient_condition[1][16].amb_cond.ydiMemory_xau16[9].ZFEH_EepromData /end MEASUREMENT
/begin MEASUREMENT ZFEH_EepromData.ydiMemory_xau16[9].amb_cond.ambient_condition[1][17] "ambient condition shot [0 .. 2-1] with 25 data bytes [0 .. 25-1] for the error code stored in this error memory slot" UBYTE EH_STANDARD_S4_S3 1 100 0 255 ECU_ADDRESS 0xFFF8258A DISPLAY_IDENTIFIER ambient_condition[1][17].amb_cond.ydiMemory_xau16[9].ZFEH_EepromData /end MEASUREMENT
/begin MEASUREMENT ZFEH_EepromData.ydiMemory_xau16[9].amb_cond.ambient_condition[1][18] "ambient condition shot [0 .. 2-1] with 25 data bytes [0 .. 25-1] for the error code stored in this error memory slot" UBYTE EH_STANDARD_S4_S3 1 100 0 255 ECU_ADDRESS 0xFFF8258B DISPLAY_IDENTIFIER ambient_condition[1][18].amb_cond.ydiMemory_xau16[9].ZFEH_EepromData /end MEASUREMENT
/begin MEASUREMENT ZFEH_EepromData.ydiMemory_xau16[9].amb_cond.ambient_condition[1][19] "ambient condition shot [0 .. 2-1] with 25 data bytes [0 .. 25-1] for the error code stored in this error memory slot" UBYTE EH_STANDARD_S4_S3 1 100 0 255 ECU_ADDRESS 0xFFF8258C DISPLAY_IDENTIFIER ambient_condition[1][19].amb_cond.ydiMemory_xau16[9].ZFEH_EepromData /end MEASUREMENT
/begin MEASUREMENT ZFEH_EepromData.ydiMemory_xau16[9].amb_cond.ambient_condition[1][1] "ambient condition shot [0 .. 2-1] with 25 data bytes [0 .. 25-1] for the error code stored in this error memory slot" UBYTE EH_STANDARD_S4_S3 1 100 0 255 ECU_ADDRESS 0xFFF8257A DISPLAY_IDENTIFIER ambient_condition[1][1].amb_cond.ydiMemory_xau16[9].ZFEH_EepromData /end MEASUREMENT
/begin MEASUREMENT ZFEH_EepromData.ydiMemory_xau16[9].amb_cond.ambient_condition[1][20] "ambient condition shot [0 .. 2-1] with 25 data bytes [0 .. 25-1] for the error code stored in this error memory slot" UBYTE EH_STANDARD_S4_S3 1 100 0 255 ECU_ADDRESS 0xFFF8258D DISPLAY_IDENTIFIER ambient_condition[1][20].amb_cond.ydiMemory_xau16[9].ZFEH_EepromData /end MEASUREMENT
/begin MEASUREMENT ZFEH_EepromData.ydiMemory_xau16[9].amb_cond.ambient_condition[1][21] "ambient condition shot [0 .. 2-1] with 25 data bytes [0 .. 25-1] for the error code stored in this error memory slot" UBYTE EH_STANDARD_S4_S3 1 100 0 255 ECU_ADDRESS 0xFFF8258E DISPLAY_IDENTIFIER ambient_condition[1][21].amb_cond.ydiMemory_xau16[9].ZFEH_EepromData /end MEASUREMENT
/begin MEASUREMENT ZFEH_EepromData.ydiMemory_xau16[9].amb_cond.ambient_condition[1][22] "ambient condition shot [0 .. 2-1] with 25 data bytes [0 .. 25-1] for the error code stored in this error memory slot" UBYTE EH_STANDARD_S4_S3 1 100 0 255 ECU_ADDRESS 0xFFF8258F DISPLAY_IDENTIFIER ambient_condition[1][22].amb_cond.ydiMemory_xau16[9].ZFEH_EepromData /end MEASUREMENT
/begin MEASUREMENT ZFEH_EepromData.ydiMemory_xau16[9].amb_cond.ambient_condition[1][23] "ambient condition shot [0 .. 2-1] with 25 data bytes [0 .. 25-1] for the error code stored in this error memory slot" UBYTE EH_STANDARD_S4_S3 1 100 0 255 ECU_ADDRESS 0xFFF82590 DISPLAY_IDENTIFIER ambient_condition[1][23].amb_cond.ydiMemory_xau16[9].ZFEH_EepromData /end MEASUREMENT
/begin MEASUREMENT ZFEH_EepromData.ydiMemory_xau16[9].amb_cond.ambient_condition[1][24] "ambient condition shot [0 .. 2-1] with 25 data bytes [0 .. 25-1] for the error code stored in this error memory slot" UBYTE EH_STANDARD_S4_S3 1 100 0 255 ECU_ADDRESS 0xFFF82591 DISPLAY_IDENTIFIER ambient_condition[1][24].amb_cond.ydiMemory_xau16[9].ZFEH_EepromData /end MEASUREMENT
/begin MEASUREMENT ZFEH_EepromData.ydiMemory_xau16[9].amb_cond.ambient_condition[1][2] "ambient condition shot [0 .. 2-1] with 25 data bytes [0 .. 25-1] for the error code stored in this error memory slot" UBYTE EH_STANDARD_S4_S3 1 100 0 255 ECU_ADDRESS 0xFFF8257B DISPLAY_IDENTIFIER ambient_condition[1][2].amb_cond.ydiMemory_xau16[9].ZFEH_EepromData /end MEASUREMENT
/begin MEASUREMENT ZFEH_EepromData.ydiMemory_xau16[9].amb_cond.ambient_condition[1][3] "ambient condition shot [0 .. 2-1] with 25 data bytes [0 .. 25-1] for the error code stored in this error memory slot" UBYTE EH_STANDARD_S4_S3 1 100 0 255 ECU_ADDRESS 0xFFF8257C DISPLAY_IDENTIFIER ambient_condition[1][3].amb_cond.ydiMemory_xau16[9].ZFEH_EepromData /end MEASUREMENT
/begin MEASUREMENT ZFEH_EepromData.ydiMemory_xau16[9].amb_cond.ambient_condition[1][4] "ambient condition shot [0 .. 2-1] with 25 data bytes [0 .. 25-1] for the error code stored in this error memory slot" UBYTE EH_STANDARD_S4_S3 1 100 0 255 ECU_ADDRESS 0xFFF8257D DISPLAY_IDENTIFIER ambient_condition[1][4].amb_cond.ydiMemory_xau16[9].ZFEH_EepromData /end MEASUREMENT
/begin MEASUREMENT ZFEH_EepromData.ydiMemory_xau16[9].amb_cond.ambient_condition[1][5] "ambient condition shot [0 .. 2-1] with 25 data bytes [0 .. 25-1] for the error code stored in this error memory slot" UBYTE EH_STANDARD_S4_S3 1 100 0 255 ECU_ADDRESS 0xFFF8257E DISPLAY_IDENTIFIER ambient_condition[1][5].amb_cond.ydiMemory_xau16[9].ZFEH_EepromData /end MEASUREMENT
/begin MEASUREMENT ZFEH_EepromData.ydiMemory_xau16[9].amb_cond.ambient_condition[1][6] "ambient condition shot [0 .. 2-1] with 25 data bytes [0 .. 25-1] for the error code stored in this error memory slot" UBYTE EH_STANDARD_S4_S3 1 100 0 255 ECU_ADDRESS 0xFFF8257F DISPLAY_IDENTIFIER ambient_condition[1][6].amb_cond.ydiMemory_xau16[9].ZFEH_EepromData /end MEASUREMENT
/begin MEASUREMENT ZFEH_EepromData.ydiMemory_xau16[9].amb_cond.ambient_condition[1][7] "ambient condition shot [0 .. 2-1] with 25 data bytes [0 .. 25-1] for the error code stored in this error memory slot" UBYTE EH_STANDARD_S4_S3 1 100 0 255 ECU_ADDRESS 0xFFF82580 DISPLAY_IDENTIFIER ambient_condition[1][7].amb_cond.ydiMemory_xau16[9].ZFEH_EepromData /end MEASUREMENT
/begin MEASUREMENT ZFEH_EepromData.ydiMemory_xau16[9].amb_cond.ambient_condition[1][8] "ambient condition shot [0 .. 2-1] with 25 data bytes [0 .. 25-1] for the error code stored in this error memory slot" UBYTE EH_STANDARD_S4_S3 1 100 0 255 ECU_ADDRESS 0xFFF82581 DISPLAY_IDENTIFIER ambient_condition[1][8].amb_cond.ydiMemory_xau16[9].ZFEH_EepromData /end MEASUREMENT
/begin MEASUREMENT ZFEH_EepromData.ydiMemory_xau16[9].amb_cond.ambient_condition[1][9] "ambient condition shot [0 .. 2-1] with 25 data bytes [0 .. 25-1] for the error code stored in this error memory slot" UBYTE EH_STANDARD_S4_S3 1 100 0 255 ECU_ADDRESS 0xFFF82582 DISPLAY_IDENTIFIER ambient_condition[1][9].amb_cond.ydiMemory_xau16[9].ZFEH_EepromData /end MEASUREMENT
/begin MEASUREMENT ZFEH_EepromData.ydiMemory_xau16[9].amb_cond.status_of_ambient_conditions[0] "status of ambient condition shot x: 0=invalid 1=valid" UBYTE EH_STANDARD_S4_S3 1 100 0 1 ECU_ADDRESS 0xFFF82592 DISPLAY_IDENTIFIER status_of_ambient_conditions[0].amb_cond.ydiMemory_xau16[9].ZFEH_EepromData /end MEASUREMENT
/begin MEASUREMENT ZFEH_EepromData.ydiMemory_xau16[9].amb_cond.status_of_ambient_conditions[1] "status of ambient condition shot x: 0=invalid 1=valid" UBYTE EH_STANDARD_S4_S3 1 100 0 1 ECU_ADDRESS 0xFFF82593 DISPLAY_IDENTIFIER status_of_ambient_conditions[1].amb_cond.ydiMemory_xau16[9].ZFEH_EepromData /end MEASUREMENT
/begin MEASUREMENT ZFEH_EepromData.ydiMemory_xau16[9].backwards_counter "backwards counter of error code stored in error memory slot" UBYTE EH_STANDARD_S4_S3 1 100 0 255 ECU_ADDRESS 0xFFF82553 DISPLAY_IDENTIFIER backwards_counter.ydiMemory_xau16[9].ZFEH_EepromData /end MEASUREMENT
/begin MEASUREMENT ZFEH_EepromData.ydiMemory_xau16[9].condition_byte "condition byte of error code stored in error memory slot" UBYTE EH_STANDARD_S4_S3 1 100 0 255 ECU_ADDRESS 0xFFF8255D DISPLAY_IDENTIFIER condition_byte.ydiMemory_xau16[9].ZFEH_EepromData /end MEASUREMENT
/begin MEASUREMENT ZFEH_EepromData.ydiMemory_xau16[9].error_code "error code stored in error memory slot" UWORD EH_STANDARD_S4_S3 1 100 0 65535 ECU_ADDRESS 0xFFF8254C DISPLAY_IDENTIFIER error_code.ydiMemory_xau16[9].ZFEH_EepromData /end MEASUREMENT
/begin MEASUREMENT ZFEH_EepromData.ydiMemory_xau16[9].error_type "error type of error code stored in error memory slot" UWORD EH_STANDARD_S4_S3 1 100 0 65535 ECU_ADDRESS 0xFFF8254E DISPLAY_IDENTIFIER error_type.ydiMemory_xau16[9].ZFEH_EepromData /end MEASUREMENT
/begin MEASUREMENT ZFEH_EepromData.ydiMemory_xau16[9].frequency_counter "frequency counter of error code stored in error memory slot" UBYTE EH_STANDARD_S4_S3 1 100 0 255 ECU_ADDRESS 0xFFF82552 DISPLAY_IDENTIFIER frequency_counter.ydiMemory_xau16[9].ZFEH_EepromData /end MEASUREMENT
/begin MEASUREMENT ZFEH_EepromData.ydiMemory_xau16[9].master_time "master time of error code stored in error memory slot" ULONG EH_STANDARD_S4_S3 1 100 0 4294967295 ECU_ADDRESS 0xFFF82558 DISPLAY_IDENTIFIER master_time.ydiMemory_xau16[9].ZFEH_EepromData /end MEASUREMENT
/begin MEASUREMENT ZFEH_EepromData.ydiMemory_xau16[9].obd_driving_cycle_counter "obd driving cycle counter of error code stored in error memory slot" UWORD EH_STANDARD_S4_S3 1 100 0 65535 ECU_ADDRESS 0xFFF8255E DISPLAY_IDENTIFIER obd_driving_cycle_counter.ydiMemory_xau16[9].ZFEH_EepromData /end MEASUREMENT
/begin MEASUREMENT ZFEH_EepromData.ydiMemory_xau16[9].permanent_counter "counter of permanent error codes stored in error memory slot" UBYTE EH_STANDARD_S4_S3 1 100 0 255 ECU_ADDRESS 0xFFF82554 DISPLAY_IDENTIFIER permanent_counter.ydiMemory_xau16[9].ZFEH_EepromData /end MEASUREMENT
/begin MEASUREMENT ZFEH_EepromData.ydiMemory_xau16[9].sequence_counter "sequence counter of error code stored in error memory slot" UBYTE EH_STANDARD_S4_S3 1 100 0 255 ECU_ADDRESS 0xFFF82555 DISPLAY_IDENTIFIER sequence_counter.ydiMemory_xau16[9].ZFEH_EepromData /end MEASUREMENT
/begin MEASUREMENT ZFEH_EepromData.ydiMemory_xau16[9].status_word "status word of error code stored in error memory slot" UWORD EH_STANDARD_S4_S3 1 100 0 65535 ECU_ADDRESS 0xFFF82550 DISPLAY_IDENTIFIER status_word.ydiMemory_xau16[9].ZFEH_EepromData /end MEASUREMENT
/begin MEASUREMENT ZFEH_EepromData.ydiObdMemory_xau16.obd_errorcode "OBD relevant error code number stored in OBD freeze frame data storage" UWORD EH_STANDARD_S4_S3 1 100 0 65535 ECU_ADDRESS 0xFFF82C36 DISPLAY_IDENTIFIER obd_errorcode.ydiObdMemory_xau16.ZFEH_EepromData /end MEASUREMENT
/begin MEASUREMENT ZFEH_EepromData.ydiObdMemory_xau16.obd_errortype "error type of error code stored in OBD freeze frame data storage" UWORD EH_STANDARD_S4_S3 1 100 0 65535 ECU_ADDRESS 0xFFF82C38 DISPLAY_IDENTIFIER obd_errortype.ydiObdMemory_xau16.ZFEH_EepromData /end MEASUREMENT
/begin MEASUREMENT ZFEH_EepromData.ydiObdMemory_xau16.obd_freezeframes[0] "freeze frame byte [0 .. 20-1] of error code stored in OBD freeze frame data storage" UBYTE EH_STANDARD_S4_S3 1 100 0 255 ECU_ADDRESS 0xFFF82C3A DISPLAY_IDENTIFIER obd_freezeframes[0].ydiObdMemory_xau16.ZFEH_EepromData /end MEASUREMENT
/begin MEASUREMENT ZFEH_EepromData.ydiObdMemory_xau16.obd_freezeframes[10] "freeze frame byte [0 .. 20-1] of error code stored in OBD freeze frame data storage" UBYTE EH_STANDARD_S4_S3 1 100 0 255 ECU_ADDRESS 0xFFF82C44 DISPLAY_IDENTIFIER obd_freezeframes[10].ydiObdMemory_xau16.ZFEH_EepromData /end MEASUREMENT
/begin MEASUREMENT ZFEH_EepromData.ydiObdMemory_xau16.obd_freezeframes[11] "freeze frame byte [0 .. 20-1] of error code stored in OBD freeze frame data storage" UBYTE EH_STANDARD_S4_S3 1 100 0 255 ECU_ADDRESS 0xFFF82C45 DISPLAY_IDENTIFIER obd_freezeframes[11].ydiObdMemory_xau16.ZFEH_EepromData /end MEASUREMENT
/begin MEASUREMENT ZFEH_EepromData.ydiObdMemory_xau16.obd_freezeframes[12] "freeze frame byte [0 .. 20-1] of error code stored in OBD freeze frame data storage" UBYTE EH_STANDARD_S4_S3 1 100 0 255 ECU_ADDRESS 0xFFF82C46 DISPLAY_IDENTIFIER obd_freezeframes[12].ydiObdMemory_xau16.ZFEH_EepromData /end MEASUREMENT
/begin MEASUREMENT ZFEH_EepromData.ydiObdMemory_xau16.obd_freezeframes[13] "freeze frame byte [0 .. 20-1] of error code stored in OBD freeze frame data storage" UBYTE EH_STANDARD_S4_S3 1 100 0 255 ECU_ADDRESS 0xFFF82C47 DISPLAY_IDENTIFIER obd_freezeframes[13].ydiObdMemory_xau16.ZFEH_EepromData /end MEASUREMENT
/begin MEASUREMENT ZFEH_EepromData.ydiObdMemory_xau16.obd_freezeframes[14] "freeze frame byte [0 .. 20-1] of error code stored in OBD freeze frame data storage" UBYTE EH_STANDARD_S4_S3 1 100 0 255 ECU_ADDRESS 0xFFF82C48 DISPLAY_IDENTIFIER obd_freezeframes[14].ydiObdMemory_xau16.ZFEH_EepromData /end MEASUREMENT
/begin MEASUREMENT ZFEH_EepromData.ydiObdMemory_xau16.obd_freezeframes[15] "freeze frame byte [0 .. 20-1] of error code stored in OBD freeze frame data storage" UBYTE EH_STANDARD_S4_S3 1 100 0 255 ECU_ADDRESS 0xFFF82C49 DISPLAY_IDENTIFIER obd_freezeframes[15].ydiObdMemory_xau16.ZFEH_EepromData /end MEASUREMENT
/begin MEASUREMENT ZFEH_EepromData.ydiObdMemory_xau16.obd_freezeframes[16] "freeze frame byte [0 .. 20-1] of error code stored in OBD freeze frame data storage" UBYTE EH_STANDARD_S4_S3 1 100 0 255 ECU_ADDRESS 0xFFF82C4A DISPLAY_IDENTIFIER obd_freezeframes[16].ydiObdMemory_xau16.ZFEH_EepromData /end MEASUREMENT
/begin MEASUREMENT ZFEH_EepromData.ydiObdMemory_xau16.obd_freezeframes[17] "freeze frame byte [0 .. 20-1] of error code stored in OBD freeze frame data storage" UBYTE EH_STANDARD_S4_S3 1 100 0 255 ECU_ADDRESS 0xFFF82C4B DISPLAY_IDENTIFIER obd_freezeframes[17].ydiObdMemory_xau16.ZFEH_EepromData /end MEASUREMENT
/begin MEASUREMENT ZFEH_EepromData.ydiObdMemory_xau16.obd_freezeframes[18] "freeze frame byte [0 .. 20-1] of error code stored in OBD freeze frame data storage" UBYTE EH_STANDARD_S4_S3 1 100 0 255 ECU_ADDRESS 0xFFF82C4C DISPLAY_IDENTIFIER obd_freezeframes[18].ydiObdMemory_xau16.ZFEH_EepromData /end MEASUREMENT
/begin MEASUREMENT ZFEH_EepromData.ydiObdMemory_xau16.obd_freezeframes[19] "freeze frame byte [0 .. 20-1] of error code stored in OBD freeze frame data storage" UBYTE EH_STANDARD_S4_S3 1 100 0 255 ECU_ADDRESS 0xFFF82C4D DISPLAY_IDENTIFIER obd_freezeframes[19].ydiObdMemory_xau16.ZFEH_EepromData /end MEASUREMENT
/begin MEASUREMENT ZFEH_EepromData.ydiObdMemory_xau16.obd_freezeframes[1] "freeze frame byte [0 .. 20-1] of error code stored in OBD freeze frame data storage" UBYTE EH_STANDARD_S4_S3 1 100 0 255 ECU_ADDRESS 0xFFF82C3B DISPLAY_IDENTIFIER obd_freezeframes[1].ydiObdMemory_xau16.ZFEH_EepromData /end MEASUREMENT
/begin MEASUREMENT ZFEH_EepromData.ydiObdMemory_xau16.obd_freezeframes[2] "freeze frame byte [0 .. 20-1] of error code stored in OBD freeze frame data storage" UBYTE EH_STANDARD_S4_S3 1 100 0 255 ECU_ADDRESS 0xFFF82C3C DISPLAY_IDENTIFIER obd_freezeframes[2].ydiObdMemory_xau16.ZFEH_EepromData /end MEASUREMENT
/begin MEASUREMENT ZFEH_EepromData.ydiObdMemory_xau16.obd_freezeframes[3] "freeze frame byte [0 .. 20-1] of error code stored in OBD freeze frame data storage" UBYTE EH_STANDARD_S4_S3 1 100 0 255 ECU_ADDRESS 0xFFF82C3D DISPLAY_IDENTIFIER obd_freezeframes[3].ydiObdMemory_xau16.ZFEH_EepromData /end MEASUREMENT
/begin MEASUREMENT ZFEH_EepromData.ydiObdMemory_xau16.obd_freezeframes[4] "freeze frame byte [0 .. 20-1] of error code stored in OBD freeze frame data storage" UBYTE EH_STANDARD_S4_S3 1 100 0 255 ECU_ADDRESS 0xFFF82C3E DISPLAY_IDENTIFIER obd_freezeframes[4].ydiObdMemory_xau16.ZFEH_EepromData /end MEASUREMENT
/begin MEASUREMENT ZFEH_EepromData.ydiObdMemory_xau16.obd_freezeframes[5] "freeze frame byte [0 .. 20-1] of error code stored in OBD freeze frame data storage" UBYTE EH_STANDARD_S4_S3 1 100 0 255 ECU_ADDRESS 0xFFF82C3F DISPLAY_IDENTIFIER obd_freezeframes[5].ydiObdMemory_xau16.ZFEH_EepromData /end MEASUREMENT
/begin MEASUREMENT ZFEH_EepromData.ydiObdMemory_xau16.obd_freezeframes[6] "freeze frame byte [0 .. 20-1] of error code stored in OBD freeze frame data storage" UBYTE EH_STANDARD_S4_S3 1 100 0 255 ECU_ADDRESS 0xFFF82C40 DISPLAY_IDENTIFIER obd_freezeframes[6].ydiObdMemory_xau16.ZFEH_EepromData /end MEASUREMENT
/begin MEASUREMENT ZFEH_EepromData.ydiObdMemory_xau16.obd_freezeframes[7] "freeze frame byte [0 .. 20-1] of error code stored in OBD freeze frame data storage" UBYTE EH_STANDARD_S4_S3 1 100 0 255 ECU_ADDRESS 0xFFF82C41 DISPLAY_IDENTIFIER obd_freezeframes[7].ydiObdMemory_xau16.ZFEH_EepromData /end MEASUREMENT
/begin MEASUREMENT ZFEH_EepromData.ydiObdMemory_xau16.obd_freezeframes[8] "freeze frame byte [0 .. 20-1] of error code stored in OBD freeze frame data storage" UBYTE EH_STANDARD_S4_S3 1 100 0 255 ECU_ADDRESS 0xFFF82C42 DISPLAY_IDENTIFIER obd_freezeframes[8].ydiObdMemory_xau16.ZFEH_EepromData /end MEASUREMENT
/begin MEASUREMENT ZFEH_EepromData.ydiObdMemory_xau16.obd_freezeframes[9] "freeze frame byte [0 .. 20-1] of error code stored in OBD freeze frame data storage" UBYTE EH_STANDARD_S4_S3 1 100 0 255 ECU_ADDRESS 0xFFF82C43 DISPLAY_IDENTIFIER obd_freezeframes[9].ydiObdMemory_xau16.ZFEH_EepromData /end MEASUREMENT
/begin MEASUREMENT ZFEH_Erm.alivecounter_old[0] "last stored value of alivecounter x if monitoring for this alivecounter is active" UBYTE EH_STANDARD_S4_S3 1 100 0 255 ECU_ADDRESS 0xFFF8AD00 DISPLAY_IDENTIFIER alivecounter_old[0].ZFEH_Erm /end MEASUREMENT
/begin MEASUREMENT ZFEH_Erm.alivecounter_old[1] "last stored value of alivecounter x if monitoring for this alivecounter is active" UBYTE EH_STANDARD_S4_S3 1 100 0 255 ECU_ADDRESS 0xFFF8AD01 DISPLAY_IDENTIFIER alivecounter_old[1].ZFEH_Erm /end MEASUREMENT
/begin MEASUREMENT ZFEH_Erm.alivecounter_old[2] "last stored value of alivecounter x if monitoring for this alivecounter is active" UBYTE EH_STANDARD_S4_S3 1 100 0 255 ECU_ADDRESS 0xFFF8AD02 DISPLAY_IDENTIFIER alivecounter_old[2].ZFEH_Erm /end MEASUREMENT
/begin MEASUREMENT ZFEH_Erm.alivecounter_old[3] "last stored value of alivecounter x if monitoring for this alivecounter is active" UBYTE EH_STANDARD_S4_S3 1 100 0 255 ECU_ADDRESS 0xFFF8AD03 DISPLAY_IDENTIFIER alivecounter_old[3].ZFEH_Erm /end MEASUREMENT
/begin MEASUREMENT ZFEH_Erm.alivecounter_old[4] "last stored value of alivecounter x if monitoring for this alivecounter is active" UBYTE EH_STANDARD_S4_S3 1 100 0 255 ECU_ADDRESS 0xFFF8AD04 DISPLAY_IDENTIFIER alivecounter_old[4].ZFEH_Erm /end MEASUREMENT
/begin MEASUREMENT ZFEH_Erm.alivecounter_old[5] "last stored value of alivecounter x if monitoring for this alivecounter is active" UBYTE EH_STANDARD_S4_S3 1 100 0 255 ECU_ADDRESS 0xFFF8AD05 DISPLAY_IDENTIFIER alivecounter_old[5].ZFEH_Erm /end MEASUREMENT
/begin MEASUREMENT ZFEH_Erm.alivecounter_old[6] "last stored value of alivecounter x if monitoring for this alivecounter is active" UBYTE EH_STANDARD_S4_S3 1 100 0 255 ECU_ADDRESS 0xFFF8AD06 DISPLAY_IDENTIFIER alivecounter_old[6].ZFEH_Erm /end MEASUREMENT
/begin MEASUREMENT ZFEH_Erm.alivecounter_old[7] "last stored value of alivecounter x if monitoring for this alivecounter is active" UBYTE EH_STANDARD_S4_S3 1 100 0 255 ECU_ADDRESS 0xFFF8AD07 DISPLAY_IDENTIFIER alivecounter_old[7].ZFEH_Erm /end MEASUREMENT
/begin MEASUREMENT ZFEH_Erm.st_alivecounter[0] "state of alivecounter monitoring for alivecounter x (0=inactive 1=active)" UBYTE EH_STANDARD_S4_S3 1 100 0 1 ECU_ADDRESS 0xFFF8ACF8 DISPLAY_IDENTIFIER st_alivecounter[0].ZFEH_Erm /end MEASUREMENT
/begin MEASUREMENT ZFEH_Erm.st_alivecounter[1] "state of alivecounter monitoring for alivecounter x (0=inactive 1=active)" UBYTE EH_STANDARD_S4_S3 1 100 0 1 ECU_ADDRESS 0xFFF8ACF9 DISPLAY_IDENTIFIER st_alivecounter[1].ZFEH_Erm /end MEASUREMENT
/begin MEASUREMENT ZFEH_Erm.st_alivecounter[2] "state of alivecounter monitoring for alivecounter x (0=inactive 1=active)" UBYTE EH_STANDARD_S4_S3 1 100 0 1 ECU_ADDRESS 0xFFF8ACFA DISPLAY_IDENTIFIER st_alivecounter[2].ZFEH_Erm /end MEASUREMENT
/begin MEASUREMENT ZFEH_Erm.st_alivecounter[3] "state of alivecounter monitoring for alivecounter x (0=inactive 1=active)" UBYTE EH_STANDARD_S4_S3 1 100 0 1 ECU_ADDRESS 0xFFF8ACFB DISPLAY_IDENTIFIER st_alivecounter[3].ZFEH_Erm /end MEASUREMENT
/begin MEASUREMENT ZFEH_Erm.st_alivecounter[4] "state of alivecounter monitoring for alivecounter x (0=inactive 1=active)" UBYTE EH_STANDARD_S4_S3 1 100 0 1 ECU_ADDRESS 0xFFF8ACFC DISPLAY_IDENTIFIER st_alivecounter[4].ZFEH_Erm /end MEASUREMENT
/begin MEASUREMENT ZFEH_Erm.st_alivecounter[5] "state of alivecounter monitoring for alivecounter x (0=inactive 1=active)" UBYTE EH_STANDARD_S4_S3 1 100 0 1 ECU_ADDRESS 0xFFF8ACFD DISPLAY_IDENTIFIER st_alivecounter[5].ZFEH_Erm /end MEASUREMENT
/begin MEASUREMENT ZFEH_Erm.st_alivecounter[6] "state of alivecounter monitoring for alivecounter x (0=inactive 1=active)" UBYTE EH_STANDARD_S4_S3 1 100 0 1 ECU_ADDRESS 0xFFF8ACFE DISPLAY_IDENTIFIER st_alivecounter[6].ZFEH_Erm /end MEASUREMENT
/begin MEASUREMENT ZFEH_Erm.st_alivecounter[7] "state of alivecounter monitoring for alivecounter x (0=inactive 1=active)" UBYTE EH_STANDARD_S4_S3 1 100 0 1 ECU_ADDRESS 0xFFF8ACFF DISPLAY_IDENTIFIER st_alivecounter[7].ZFEH_Erm /end MEASUREMENT
/begin MEASUREMENT ZFEH_Erm.st_alivecounter_check[0] "state of alivecounter monitoring check for alivecounter x (0=init 1=monitoring_entered ac_value stored 2=monitoring_active ac_value stopped or changed 3=ac_value changed again - reset)" UBYTE EH_STANDARD_S4_S3 1 100 0 2 ECU_ADDRESS 0xFFF8AD08 DISPLAY_IDENTIFIER st_alivecounter_check[0].ZFEH_Erm /end MEASUREMENT
/begin MEASUREMENT ZFEH_Erm.st_alivecounter_check[1] "state of alivecounter monitoring check for alivecounter x (0=init 1=monitoring_entered ac_value stored 2=monitoring_active ac_value stopped or changed 3=ac_value changed again - reset)" UBYTE EH_STANDARD_S4_S3 1 100 0 2 ECU_ADDRESS 0xFFF8AD09 DISPLAY_IDENTIFIER st_alivecounter_check[1].ZFEH_Erm /end MEASUREMENT
/begin MEASUREMENT ZFEH_Erm.st_alivecounter_check[2] "state of alivecounter monitoring check for alivecounter x (0=init 1=monitoring_entered ac_value stored 2=monitoring_active ac_value stopped or changed 3=ac_value changed again - reset)" UBYTE EH_STANDARD_S4_S3 1 100 0 2 ECU_ADDRESS 0xFFF8AD0A DISPLAY_IDENTIFIER st_alivecounter_check[2].ZFEH_Erm /end MEASUREMENT
/begin MEASUREMENT ZFEH_Erm.st_alivecounter_check[3] "state of alivecounter monitoring check for alivecounter x (0=init 1=monitoring_entered ac_value stored 2=monitoring_active ac_value stopped or changed 3=ac_value changed again - reset)" UBYTE EH_STANDARD_S4_S3 1 100 0 2 ECU_ADDRESS 0xFFF8AD0B DISPLAY_IDENTIFIER st_alivecounter_check[3].ZFEH_Erm /end MEASUREMENT
/begin MEASUREMENT ZFEH_Erm.st_alivecounter_check[4] "state of alivecounter monitoring check for alivecounter x (0=init 1=monitoring_entered ac_value stored 2=monitoring_active ac_value stopped or changed 3=ac_value changed again - reset)" UBYTE EH_STANDARD_S4_S3 1 100 0 2 ECU_ADDRESS 0xFFF8AD0C DISPLAY_IDENTIFIER st_alivecounter_check[4].ZFEH_Erm /end MEASUREMENT
/begin MEASUREMENT ZFEH_Erm.st_alivecounter_check[5] "state of alivecounter monitoring check for alivecounter x (0=init 1=monitoring_entered ac_value stored 2=monitoring_active ac_value stopped or changed 3=ac_value changed again - reset)" UBYTE EH_STANDARD_S4_S3 1 100 0 2 ECU_ADDRESS 0xFFF8AD0D DISPLAY_IDENTIFIER st_alivecounter_check[5].ZFEH_Erm /end MEASUREMENT
/begin MEASUREMENT ZFEH_Erm.st_alivecounter_check[6] "state of alivecounter monitoring check for alivecounter x (0=init 1=monitoring_entered ac_value stored 2=monitoring_active ac_value stopped or changed 3=ac_value changed again - reset)" UBYTE EH_STANDARD_S4_S3 1 100 0 2 ECU_ADDRESS 0xFFF8AD0E DISPLAY_IDENTIFIER st_alivecounter_check[6].ZFEH_Erm /end MEASUREMENT
/begin MEASUREMENT ZFEH_Erm.st_alivecounter_check[7] "state of alivecounter monitoring check for alivecounter x (0=init 1=monitoring_entered ac_value stored 2=monitoring_active ac_value stopped or changed 3=ac_value changed again - reset)" UBYTE EH_STANDARD_S4_S3 1 100 0 2 ECU_ADDRESS 0xFFF8AD0F DISPLAY_IDENTIFIER st_alivecounter_check[7].ZFEH_Erm /end MEASUREMENT
/begin MEASUREMENT ZFEH_Erm.st_lh_complementcheck "used for complement check only" UWORD EH_STANDARD_S4_S3 1 100 0 65535 ECU_ADDRESS 0xFFF8ACE6 DISPLAY_IDENTIFIER st_lh_complementcheck.ZFEH_Erm /end MEASUREMENT
/begin MEASUREMENT ZFEH_Erm.st_lh_complementcheck_ "complementary value of st_lh_complementcheck" UWORD EH_STANDARD_S4_S3 1 100 0 65535 ECU_ADDRESS 0xFFF8ACEE DISPLAY_IDENTIFIER st_lh_complementcheck_.ZFEH_Erm /end MEASUREMENT
/begin MEASUREMENT ZFEH_Erm.st_limphome_check "to avoid failure depending on task sequence the first two detections of wrong behaviour of limphome reaction will be ignored" UWORD EH_STANDARD_S4_S3 1 100 0 65535 ECU_ADDRESS 0xFFF8ACE4 DISPLAY_IDENTIFIER st_limphome_check.ZFEH_Erm /end MEASUREMENT
/begin MEASUREMENT ZFEH_Erm.st_limphome_check_ "complementary value of st_limphome_check" UWORD EH_STANDARD_S4_S3 1 100 0 65535 ECU_ADDRESS 0xFFF8ACEC DISPLAY_IDENTIFIER st_limphome_check_.ZFEH_Erm /end MEASUREMENT
/begin MEASUREMENT ZFEH_Erm.st_nonegtrqreq_check "to avoid failure depending on task sequence the first two detections of wrong behaviour of no_negative_torquerequest reaction will be ignored" UWORD EH_STANDARD_S4_S3 1 100 0 65535 ECU_ADDRESS 0xFFF8ACF2 DISPLAY_IDENTIFIER st_nonegtrqreq_check.ZFEH_Erm /end MEASUREMENT
/begin MEASUREMENT ZFEH_Erm.st_nonegtrqreq_check_ "complementary value of st_nonegtrqreq_check" UWORD EH_STANDARD_S4_S3 1 100 0 65535 ECU_ADDRESS 0xFFF8ACF4 DISPLAY_IDENTIFIER st_nonegtrqreq_check_.ZFEH_Erm /end MEASUREMENT
/begin MEASUREMENT ZFEH_Erm.st_nopostrqreq_check "to avoid failure depending on task sequence the first two detections of wrong behaviour of no_positive_torquerequest reaction will be ignored" UWORD EH_STANDARD_S4_S3 1 100 0 65535 ECU_ADDRESS 0xFFF8ACE8 DISPLAY_IDENTIFIER st_nopostrqreq_check.ZFEH_Erm /end MEASUREMENT
/begin MEASUREMENT ZFEH_Erm.st_nopostrqreq_check_ "complementary value of st_nopostrqreq_check" UWORD EH_STANDARD_S4_S3 1 100 0 65535 ECU_ADDRESS 0xFFF8ACF0 DISPLAY_IDENTIFIER st_nopostrqreq_check_.ZFEH_Erm /end MEASUREMENT
/begin MEASUREMENT ZFEH_Erm.st_position_check "to avoid failure depending on task sequence the first two detections of wrong behaviour of forced position neutral reaction will be ignored" UWORD EH_STANDARD_S4_S3 1 100 0 65535 ECU_ADDRESS 0xFFF8ACEA DISPLAY_IDENTIFIER st_position_check.ZFEH_Erm /end MEASUREMENT
/begin MEASUREMENT ZFEH_Erm.st_position_check_ "complementary value of st_position_check" UWORD EH_STANDARD_S4_S3 1 100 0 65535 ECU_ADDRESS 0xFFF8ACF6 DISPLAY_IDENTIFIER st_position_check_.ZFEH_Erm /end MEASUREMENT
/begin MEASUREMENT ZFEH_Interfi.arg_idx "0x00 means reference page and 0x01 means working page" UBYTE EH_STANDARD_S4_S3 1 100 0 1 ECU_ADDRESS 0xFFF8D6BB DISPLAY_IDENTIFIER arg_idx.ZFEH_Interfi /end MEASUREMENT
/begin MEASUREMENT ZFEH_Interfi.arg_idx_komp "0xFF means reference page and 0xFE means working page" UBYTE EH_STANDARD_S4_S3 1 100 254 255 ECU_ADDRESS 0xFFF8D6BC DISPLAY_IDENTIFIER arg_idx_komp.ZFEH_Interfi /end MEASUREMENT
/begin MEASUREMENT ZFEH_Interfi.iv_CodingMilCycles "input value for coded OBD variant 0=OBD-VAR0 1=OBD-VAR1" UBYTE EH_STANDARD_S4_S3 1 100 0 1 ECU_ADDRESS 0xFFF8D6B2 DISPLAY_IDENTIFIER iv_CodingMilCycles.ZFEH_Interfi /end MEASUREMENT
/begin MEASUREMENT ZFEH_Interfi.iv_ThrottlePosition "throttle position" UBYTE EH_100PROZENT255_S4_S3 1 100 0 100 ECU_ADDRESS 0xFFF8D6BA DISPLAY_IDENTIFIER iv_ThrottlePosition.ZFEH_Interfi /end MEASUREMENT
/begin MEASUREMENT ZFEH_Interfi.iv_f_Ignition "ignition state from SAB 0=ignition off 1=ignition on" UBYTE EH_STANDARD_S4_S3 1 100 0 1 ECU_ADDRESS 0xFFF8D6B3 DISPLAY_IDENTIFIER iv_f_Ignition.ZFEH_Interfi /end MEASUREMENT
/begin MEASUREMENT ZFEH_Interfi.iv_n_AbFilt "n_Ab filtered speed" UWORD EH_N_1RPM_S4_S3 1 100 0 65535 ECU_ADDRESS 0xFFF8D6B8 DISPLAY_IDENTIFIER iv_n_AbFilt.ZFEH_Interfi /end MEASUREMENT
/begin MEASUREMENT ZFEH_Interfi.iv_n_Eng "engine speed" UWORD EH_N_1RPM_S4_S3 1 100 0 65535 ECU_ADDRESS 0xFFF8D6B6 DISPLAY_IDENTIFIER iv_n_Eng.ZFEH_Interfi /end MEASUREMENT
/begin MEASUREMENT ZFEH_Interfi.iv_u_BattFilt "filtered control module voltage" UWORD EH_U_1VOLT1000_S4_S3 1 100 0 65.535 ECU_ADDRESS 0xFFF8D6B4 DISPLAY_IDENTIFIER iv_u_BattFilt.ZFEH_Interfi /end MEASUREMENT
/begin MEASUREMENT ZFEH_Obd.di_obd_abs_throttle_pos "obd signal absolute throttle position (converted to PID 11 scaling)" UBYTE EH_100PROZENT255_S4_S3 1 100 0 100 ECU_ADDRESS 0xFFF8AD78 DISPLAY_IDENTIFIER di_obd_abs_throttle_pos.ZFEH_Obd /end MEASUREMENT
/begin MEASUREMENT ZFEH_Obd.di_obd_calc_load "obd signal calculated load (converted to PID 04 scaling)" UBYTE EH_100PROZENT255_S4_S3 1 100 0 100 ECU_ADDRESS 0xFFF8AD65 DISPLAY_IDENTIFIER di_obd_calc_load.ZFEH_Obd /end MEASUREMENT
/begin MEASUREMENT ZFEH_Obd.di_obd_dist_travel_MIL_active "obd signal distance travelled with MIL active (converted to PID 21 scaling)" UWORD EH_L_1KM_S4_S3 1 100 0 65535 ECU_ADDRESS 0xFFF8AD7E DISPLAY_IDENTIFIER di_obd_dist_travel_MIL_active.ZFEH_Obd /end MEASUREMENT
/begin MEASUREMENT ZFEH_Obd.di_obd_dist_travel_since_DTC_clr "obd signal distance travelled since DTCs cleared (converted to PID 31 scaling)" UWORD EH_L_1KM_S4_S3 1 100 0 65535 ECU_ADDRESS 0xFFF8AD82 DISPLAY_IDENTIFIER di_obd_dist_travel_since_DTC_clr.ZFEH_Obd /end MEASUREMENT
/begin MEASUREMENT ZFEH_Obd.di_obd_distance "distance information used for the calculation of some obd signals (PID 21 and 31)" ULONG EH_L_1KM_S4_S3 1 100 0 4294967295 ECU_ADDRESS 0xFFF8AD9C DISPLAY_IDENTIFIER di_obd_distance.ZFEH_Obd /end MEASUREMENT
/begin MEASUREMENT ZFEH_Obd.di_obd_eng_cool_temp "obd signal engine coolant temperature (converted to PID 05 scaling)" UBYTE EH_C_1CEL_M40_S4_S3 1 100 -40 215 ECU_ADDRESS 0xFFF8AD6A DISPLAY_IDENTIFIER di_obd_eng_cool_temp.ZFEH_Obd /end MEASUREMENT
/begin MEASUREMENT ZFEH_Obd.di_obd_eng_speed "obd signal engine speed (converted to PID 0C scaling)" UWORD EH_N_RPM4_S4_S3 1 100 0 16383.5 ECU_ADDRESS 0xFFF8AD70 DISPLAY_IDENTIFIER di_obd_eng_speed.ZFEH_Obd /end MEASUREMENT
/begin MEASUREMENT ZFEH_Obd.di_obd_ext_dc "driving cycle triggered from extern" UBYTE EH_STANDARD_S4_S3 1 100 0 1 ECU_ADDRESS 0xFFF8AD5D DISPLAY_IDENTIFIER di_obd_ext_dc.ZFEH_Obd /end MEASUREMENT
/begin MEASUREMENT ZFEH_Obd.di_obd_ext_eng_run "engine running detection from extern" UBYTE EH_STANDARD_S4_S3 1 100 0 1 ECU_ADDRESS 0xFFF8AD5F DISPLAY_IDENTIFIER di_obd_ext_eng_run.ZFEH_Obd /end MEASUREMENT
/begin MEASUREMENT ZFEH_Obd.di_obd_ext_wuc "warmup cycle triggered from extern" UBYTE EH_STANDARD_S4_S3 1 100 0 1 ECU_ADDRESS 0xFFF8AD61 DISPLAY_IDENTIFIER di_obd_ext_wuc.ZFEH_Obd /end MEASUREMENT
/begin MEASUREMENT ZFEH_Obd.di_obd_ff_available "obd freeze frame datas actually available (0=no freeze frame datas available, 1=freeze frame datas available)" UBYTE EH_STANDARD_S4_S3 1 100 0 255 ECU_ADDRESS 0xFFF8AD91 DISPLAY_IDENTIFIER di_obd_ff_available.ZFEH_Obd /end MEASUREMENT
/begin MEASUREMENT ZFEH_Obd.di_obd_mil_req "MIL request (0=MIL not requested, 1= MIL requested)" UBYTE EH_STANDARD_S4_S3 1 100 0 1 ECU_ADDRESS 0xFFF8ADA0 DISPLAY_IDENTIFIER di_obd_mil_req.ZFEH_Obd /end MEASUREMENT
/begin MEASUREMENT ZFEH_Obd.di_obd_new_dc "in this ignition cycle a new driving cycle has begun" UBYTE EH_STANDARD_S4_S3 1 100 0 1 ECU_ADDRESS 0xFFF8AD5C DISPLAY_IDENTIFIER di_obd_new_dc.ZFEH_Obd /end MEASUREMENT
/begin MEASUREMENT ZFEH_Obd.di_obd_new_dc_next_ign_on "new driving cycle starting with ignition on" UBYTE EH_STANDARD_S4_S3 1 100 0 1 ECU_ADDRESS 0xFFF8AD5E DISPLAY_IDENTIFIER di_obd_new_dc_next_ign_on.ZFEH_Obd /end MEASUREMENT
/begin MEASUREMENT ZFEH_Obd.di_obd_new_wuc "in this ignition cycle a new warmup cycle has begun" UBYTE EH_STANDARD_S4_S3 1 100 0 1 ECU_ADDRESS 0xFFF8AD60 DISPLAY_IDENTIFIER di_obd_new_wuc.ZFEH_Obd /end MEASUREMENT
/begin MEASUREMENT ZFEH_Obd.di_obd_pedalpos "signal for pedal position for internal norm trip B detection" UBYTE EH_100PROZENT255_S4_S3 1 100 0 100 ECU_ADDRESS 0xFFF8AD90 DISPLAY_IDENTIFIER di_obd_pedalpos.ZFEH_Obd /end MEASUREMENT
/begin MEASUREMENT ZFEH_Obd.di_obd_ready_dc_specific_total "total driving cycle specific readiness" UBYTE EH_STANDARD_S4_S3 1 100 0 1 ECU_ADDRESS 0xFFF8AD8D DISPLAY_IDENTIFIER di_obd_ready_dc_specific_total.ZFEH_Obd /end MEASUREMENT
/begin MEASUREMENT ZFEH_Obd.di_obd_ready_total "total obd readiness" UBYTE EH_STANDARD_S4_S3 1 100 0 1 ECU_ADDRESS 0xFFF8AD8C DISPLAY_IDENTIFIER di_obd_ready_total.ZFEH_Obd /end MEASUREMENT
/begin MEASUREMENT ZFEH_Obd.di_obd_time_eng_run_MIL_active "obd signal time run by the engine while MIL is activated (converted to PID 4D scaling)" UWORD EH_T_1MIN_S4_S3 1 100 0 65535 ECU_ADDRESS 0xFFF8AD88 DISPLAY_IDENTIFIER di_obd_time_eng_run_MIL_active.ZFEH_Obd /end MEASUREMENT
/begin MEASUREMENT ZFEH_Obd.di_obd_time_since_DTC_clr "obd signal time since DTCs cleared (converted to PID 4E scaling)" UWORD EH_T_1MIN_S4_S3 1 100 0 65535 ECU_ADDRESS 0xFFF8AD8A DISPLAY_IDENTIFIER di_obd_time_since_DTC_clr.ZFEH_Obd /end MEASUREMENT
/begin MEASUREMENT ZFEH_Obd.di_obd_time_since_eng_start "obd signal time since engine start (converted to PID 1F scaling)" UWORD EH_T_1S_S4_S3 1 100 0 65535 ECU_ADDRESS 0xFFF8AD7C DISPLAY_IDENTIFIER di_obd_time_since_eng_start.ZFEH_Obd /end MEASUREMENT
/begin MEASUREMENT ZFEH_Obd.di_obd_vehicle_speed "obd signal vehicle speed (converted to PID 0D scaling)" UBYTE EH_V_KMH_S4_S3 1 100 0 255 ECU_ADDRESS 0xFFF8AD75 DISPLAY_IDENTIFIER di_obd_vehicle_speed.ZFEH_Obd /end MEASUREMENT
/begin MEASUREMENT ZFEH_Obd.di_obd_voltage "obd signal battery voltage (converted to PID 42 scaling)" UWORD EH_U_1VOLT1000_S4_S3 1 100 0 65.535 ECU_ADDRESS 0xFFF8AD86 DISPLAY_IDENTIFIER di_obd_voltage.ZFEH_Obd /end MEASUREMENT
/begin MEASUREMENT ZFEH_Obd.di_obd_wuc_since_DTC_clr "obd signal number of warmup cycles since DTCs cleared (converted to PID 30 scaling)" UBYTE EH_STANDARD_S4_S3 1 100 0 255 ECU_ADDRESS 0xFFF8AD80 DISPLAY_IDENTIFIER di_obd_wuc_since_DTC_clr.ZFEH_Obd /end MEASUREMENT
/begin MEASUREMENT ZFEH_Obd.di_obd_wuc_start_temp "engine coolant temperature at engine start (for WUC calculation)" UBYTE EH_C_1CEL_M40_S4_S3 1 100 -40 215 ECU_ADDRESS 0xFFF8AD62 DISPLAY_IDENTIFIER di_obd_wuc_start_temp.ZFEH_Obd /end MEASUREMENT
/begin MEASUREMENT ZFEH_Obd.di_obd_wuc_without_MIL "number of WarmUpCycles without MIL active" UBYTE EH_STANDARD_S4_S3 1 100 0 255 ECU_ADDRESS 0xFFF8ADA1 DISPLAY_IDENTIFIER di_obd_wuc_without_MIL.ZFEH_Obd /end MEASUREMENT
/begin MEASUREMENT ZFEH_Obd.iv_di_obd_abs_throttle_pos "input value for obd signal absolute throttle position (PID 11)" UBYTE EH_STANDARD_S4_S3 1 100 0 255 ECU_ADDRESS 0xFFF8AD76 DISPLAY_IDENTIFIER iv_di_obd_abs_throttle_pos.ZFEH_Obd /end MEASUREMENT
/begin MEASUREMENT ZFEH_Obd.iv_di_obd_abs_throttle_pos_status "status of input value for obd signal absolute throttle position" UBYTE EH_STANDARD_S4_S3 1 100 0 255 ECU_ADDRESS 0xFFF8AD77 DISPLAY_IDENTIFIER iv_di_obd_abs_throttle_pos_status.ZFEH_Obd /end MEASUREMENT
/begin MEASUREMENT ZFEH_Obd.iv_di_obd_backup_abs_throttle_pos "input value for obd backup signal absolute throttle position (PID 11)" UBYTE EH_STANDARD_S4_S3 1 100 0 255 ECU_ADDRESS 0xFFF8AD79 DISPLAY_IDENTIFIER iv_di_obd_backup_abs_throttle_pos.ZFEH_Obd /end MEASUREMENT
/begin MEASUREMENT ZFEH_Obd.iv_di_obd_backup_abs_throttle_pos_status "status of input value for obd backup signal absolute throttle position" UBYTE EH_STANDARD_S4_S3 1 100 0 255 ECU_ADDRESS 0xFFF8AD7A DISPLAY_IDENTIFIER iv_di_obd_backup_abs_throttle_pos_status.ZFEH_Obd /end MEASUREMENT
/begin MEASUREMENT ZFEH_Obd.iv_di_obd_backup_calc_load "input value for obd backup signal calculated load (PID 04)" UBYTE EH_100PROZENT255_S4_S3 1 100 0 100 ECU_ADDRESS 0xFFF8AD66 DISPLAY_IDENTIFIER iv_di_obd_backup_calc_load.ZFEH_Obd /end MEASUREMENT
/begin MEASUREMENT ZFEH_Obd.iv_di_obd_backup_calc_load_status "status of input value for obd backup signal calculated load" UBYTE EH_STANDARD_S4_S3 1 100 0 255 ECU_ADDRESS 0xFFF8AD67 DISPLAY_IDENTIFIER iv_di_obd_backup_calc_load_status.ZFEH_Obd /end MEASUREMENT
/begin MEASUREMENT ZFEH_Obd.iv_di_obd_calc_load "input value for obd signal calculated load (PID 04)" UBYTE EH_100PROZENT255_S4_S3 1 100 0 100 ECU_ADDRESS 0xFFF8AD63 DISPLAY_IDENTIFIER iv_di_obd_calc_load.ZFEH_Obd /end MEASUREMENT
/begin MEASUREMENT ZFEH_Obd.iv_di_obd_calc_load_status "status of input value for obd signal calculated load" UBYTE EH_STANDARD_S4_S3 1 100 0 255 ECU_ADDRESS 0xFFF8AD64 DISPLAY_IDENTIFIER iv_di_obd_calc_load_status.ZFEH_Obd /end MEASUREMENT
/begin MEASUREMENT ZFEH_Obd.iv_di_obd_distance "input value for distance information" ULONG EH_L_1KM_S4_S3 1 100 0 4294967295 ECU_ADDRESS 0xFFF8AD98 DISPLAY_IDENTIFIER iv_di_obd_distance.ZFEH_Obd /end MEASUREMENT
/begin MEASUREMENT ZFEH_Obd.iv_di_obd_eng_cool_temp "input value for obd signal engine coolant temperature (PID 05)" UBYTE EH_C_1CEL_M48_S4_S3 1 100 -48 207 ECU_ADDRESS 0xFFF8AD68 DISPLAY_IDENTIFIER iv_di_obd_eng_cool_temp.ZFEH_Obd /end MEASUREMENT
/begin MEASUREMENT ZFEH_Obd.iv_di_obd_eng_cool_temp_status "status of input value for obd signal engine coolant temperature" UBYTE EH_STANDARD_S4_S3 1 100 0 255 ECU_ADDRESS 0xFFF8AD69 DISPLAY_IDENTIFIER iv_di_obd_eng_cool_temp_status.ZFEH_Obd /end MEASUREMENT
/begin MEASUREMENT ZFEH_Obd.iv_di_obd_eng_speed "input value for obd signal engine speed (PID 0C)" UWORD EH_N_RPM4_S4_S3 1 100 0 16383.75 ECU_ADDRESS 0xFFF8AD6C DISPLAY_IDENTIFIER iv_di_obd_eng_speed.ZFEH_Obd /end MEASUREMENT
/begin MEASUREMENT ZFEH_Obd.iv_di_obd_eng_speed_status "status of input value for obd signal engine speed" UBYTE EH_STANDARD_S4_S3 1 100 0 255 ECU_ADDRESS 0xFFF8AD6E DISPLAY_IDENTIFIER iv_di_obd_eng_speed_status.ZFEH_Obd /end MEASUREMENT
/begin MEASUREMENT ZFEH_Obd.iv_di_obd_pedalpos "input value for pedal position signal for internal norm trip B detection" UBYTE EH_100PROZENT255_S4_S3 1 100 0 100 ECU_ADDRESS 0xFFF8AD8E DISPLAY_IDENTIFIER iv_di_obd_pedalpos.ZFEH_Obd /end MEASUREMENT
/begin MEASUREMENT ZFEH_Obd.iv_di_obd_pedalpos_status "status of input value for input signal pedal position" UBYTE EH_STANDARD_S4_S3 1 100 0 255 ECU_ADDRESS 0xFFF8AD8F DISPLAY_IDENTIFIER iv_di_obd_pedalpos_status.ZFEH_Obd /end MEASUREMENT
/begin MEASUREMENT ZFEH_Obd.iv_di_obd_time_ms "time information used for the calculation of some obd signals (PID 1F, 4D and 4E)" ULONG EH_T_1MS_S4_S3 1 100 0 4294967295 ECU_ADDRESS 0xFFF8AD94 DISPLAY_IDENTIFIER iv_di_obd_time_ms.ZFEH_Obd /end MEASUREMENT
/begin MEASUREMENT ZFEH_Obd.iv_di_obd_vehicle_speed "input value for obd signal vehicle speed (PID 0D)" UWORD EH_V_KMH16_S4_S3 1 100 0 4095.9375 ECU_ADDRESS 0xFFF8AD72 DISPLAY_IDENTIFIER iv_di_obd_vehicle_speed.ZFEH_Obd /end MEASUREMENT
/begin MEASUREMENT ZFEH_Obd.iv_di_obd_vehicle_speed_status "status of input value for obd signal vehicle speed" UBYTE EH_STANDARD_S4_S3 1 100 0 255 ECU_ADDRESS 0xFFF8AD74 DISPLAY_IDENTIFIER iv_di_obd_vehicle_speed_status.ZFEH_Obd /end MEASUREMENT
/begin MEASUREMENT ZFEH_Obd.iv_di_obd_voltage "input value for obd signal battery voltage (PID 42)" UWORD EH_U_1VOLT1000_S4_S3 1 100 0 65.535 ECU_ADDRESS 0xFFF8AD84 DISPLAY_IDENTIFIER iv_di_obd_voltage.ZFEH_Obd /end MEASUREMENT
/begin MEASUREMENT ZFEH_Statemachine.st_errorhandler "state of the errorhandler 0=initialization 1=running(without ignition on) 2=running(with ignition on) 3=running(ignition change)" UBYTE EH_STANDARD_S4_S3 1 100 0 3 ECU_ADDRESS 0xFFF8D6C0 DISPLAY_IDENTIFIER st_errorhandler.ZFEH_Statemachine /end MEASUREMENT
/begin MEASUREMENT ZFEH_Statemachine.typeOfStartUp "type of ECU startup 0=SW reset 1=power up" UBYTE EH_STANDARD_S4_S3 1 100 0 1 ECU_ADDRESS 0xFFF8D6C1 DISPLAY_IDENTIFIER typeOfStartUp.ZFEH_Statemachine /end MEASUREMENT
/begin MEASUREMENT ZFFSAB._.ABSIn.f_ABSOff "diagnosis flag for KFC_VUNPLAUSILEV2" UBYTE SAB_STANDARD_S2_S3 1 100 0 1 ECU_ADDRESS 0xFFF8E1D7 DISPLAY_IDENTIFIER f_ABSOff.ABSIn._.ZFFSAB /end MEASUREMENT
/begin MEASUREMENT ZFFSAB._.ABSIn.f_ABSOff_ "complement of diagnosis flag for KFC_VUNPLAUSILEV2" UBYTE SAB_STANDARD_S2_S3 1 100 0 255 ECU_ADDRESS 0xFFF8E1D8 DISPLAY_IDENTIFIER f_ABSOff_.ABSIn._.ZFFSAB /end MEASUREMENT
/begin MEASUREMENT ZFFSAB._.ABSIn.f_ABSRegErr "value for error flag of ABS" UBYTE SAB_STANDARD_S2_S3 1 100 0 255 ECU_ADDRESS 0xFFF8E1D6 DISPLAY_IDENTIFIER f_ABSRegErr.ABSIn._.ZFFSAB /end MEASUREMENT
/begin MEASUREMENT ZFFSAB._.ABSIn.iv_ABSReg "Input value for ABSReg" UWORD SAB_STANDARD_S2_S3 1 100 0 65535 ECU_ADDRESS 0xFFF8E1CC DISPLAY_IDENTIFIER iv_ABSReg.ABSIn._.ZFFSAB /end MEASUREMENT
/begin MEASUREMENT ZFFSAB._.ABSIn.iv_ABSRegSts "Input value message status of ABS regulation" UBYTE SAB_STANDARD_S2_S3 1 100 0 255 ECU_ADDRESS 0xFFF8E1D0 DISPLAY_IDENTIFIER iv_ABSRegSts.ABSIn._.ZFFSAB /end MEASUREMENT
/begin MEASUREMENT ZFFSAB._.ABSIn.iv_ABSRegSts_ "complement input value message status of ABS regulation" UBYTE SAB_STANDARD_S2_S3 1 100 0 255 ECU_ADDRESS 0xFFF8E1D1 DISPLAY_IDENTIFIER iv_ABSRegSts_.ABSIn._.ZFFSAB /end MEASUREMENT
/begin MEASUREMENT ZFFSAB._.ABSIn.iv_ABSReg_ "complement input value for ABSReg" UWORD SAB_STANDARD_S2_S3 1 100 0 65535 ECU_ADDRESS 0xFFF8E1CE DISPLAY_IDENTIFIER iv_ABSReg_.ABSIn._.ZFFSAB /end MEASUREMENT
/begin MEASUREMENT ZFFSAB._.ABSIn.sv_ABSReg "Output value for GET_ABS_REG" UBYTE SAB_STANDARD_S2_S3 1 100 0 2 ECU_ADDRESS 0xFFF8E1D4 DISPLAY_IDENTIFIER sv_ABSReg.ABSIn._.ZFFSAB /end MEASUREMENT
/begin MEASUREMENT ZFFSAB._.ABSIn.sv_ABSRegSts "Output value for GET_ABS_REG_STATUS" UBYTE SAB_STANDARD_S2_S3 1 100 0 2 ECU_ADDRESS 0xFFF8E1D2 DISPLAY_IDENTIFIER sv_ABSRegSts.ABSIn._.ZFFSAB /end MEASUREMENT
/begin MEASUREMENT ZFFSAB._.ABSIn.sv_ABSRegSts_ "complement output value for GET_ABS_REG_STATUS" UBYTE SAB_STANDARD_S2_S3 1 100 0 255 ECU_ADDRESS 0xFFF8E1D3 DISPLAY_IDENTIFIER sv_ABSRegSts_.ABSIn._.ZFFSAB /end MEASUREMENT
/begin MEASUREMENT ZFFSAB._.ABSIn.sv_ABSReg_ "complement output value for GET_ABS_REG" UBYTE SAB_STANDARD_S2_S3 1 100 0 255 ECU_ADDRESS 0xFFF8E1D5 DISPLAY_IDENTIFIER sv_ABSReg_.ABSIn._.ZFFSAB /end MEASUREMENT
/begin MEASUREMENT ZFFSAB._.ASCIn.f_ASCErr "Error flag of ESP" UBYTE SAB_STANDARD_S2_S3 1 100 0 1 ECU_ADDRESS 0xFFF96E2E DISPLAY_IDENTIFIER f_ASCErr.ASCIn._.ZFFSAB /end MEASUREMENT
/begin MEASUREMENT ZFFSAB._.ASCIn.f_ASCRegErr "Error flag for f_ASCReg" UBYTE SAB_STANDARD_S2_S3 1 100 0 1 ECU_ADDRESS 0xFFF96E31 DISPLAY_IDENTIFIER f_ASCRegErr.ASCIn._.ZFFSAB /end MEASUREMENT
/begin MEASUREMENT ZFFSAB._.ASCIn.f_ASCSbeErr "Error flag of f_ASCSbe" UBYTE SAB_STANDARD_S2_S3 1 100 0 1 ECU_ADDRESS 0xFFF96E2D DISPLAY_IDENTIFIER f_ASCSbeErr.ASCIn._.ZFFSAB /end MEASUREMENT
/begin MEASUREMENT ZFFSAB._.ASCIn.iv_ASCReg "Input value ASC control activ from CAN" UWORD SAB_STANDARD_S2_S3 1 100 0 4095 ECU_ADDRESS 0xFFF96E36 DISPLAY_IDENTIFIER iv_ASCReg.ASCIn._.ZFFSAB /end MEASUREMENT
/begin MEASUREMENT ZFFSAB._.ASCIn.iv_ASCRegSts "Input value message status of REG control state" UBYTE SAB_STANDARD_S2_S3 1 100 0 255 ECU_ADDRESS 0xFFF96E38 DISPLAY_IDENTIFIER iv_ASCRegSts.ASCIn._.ZFFSAB /end MEASUREMENT
/begin MEASUREMENT ZFFSAB._.ASCIn.iv_ASCSbe "Input value shifting influence from CAN" UBYTE SAB_STANDARD_S2_S3 1 100 0 7 ECU_ADDRESS 0xFFF96E34 DISPLAY_IDENTIFIER iv_ASCSbe.ASCIn._.ZFFSAB /end MEASUREMENT
/begin MEASUREMENT ZFFSAB._.ASCIn.iv_ASCSts "Input value message status of control state" UBYTE SAB_STANDARD_S2_S3 1 100 0 255 ECU_ADDRESS 0xFFF96E39 DISPLAY_IDENTIFIER iv_ASCSts.ASCIn._.ZFFSAB /end MEASUREMENT
/begin MEASUREMENT ZFFSAB._.ASCIn.sv_ASCRegSts "REPRESENT_INTERMEDIATE value for signal status of ASC control active" UBYTE SAB_STANDARD_S2_S3 1 100 0 2 ECU_ADDRESS 0xFFF96E32 DISPLAY_IDENTIFIER sv_ASCRegSts.ASCIn._.ZFFSAB /end MEASUREMENT
/begin MEASUREMENT ZFFSAB._.ASCIn.sv_ASCSbeSts "REPRESENT_INTERMEDIATE value signal status of shifting influence" UBYTE SAB_STANDARD_S2_S3 1 100 0 2 ECU_ADDRESS 0xFFF96E2F DISPLAY_IDENTIFIER sv_ASCSbeSts.ASCIn._.ZFFSAB /end MEASUREMENT
/begin MEASUREMENT ZFFSAB._.ASCIn.sv_f_ASCErr2 "REPRESENT_INTERMEDIATE value for error flag 2" UBYTE SAB_STANDARD_S2_S3 1 100 0 1 ECU_ADDRESS 0xFFF96E33 DISPLAY_IDENTIFIER sv_f_ASCErr2.ASCIn._.ZFFSAB /end MEASUREMENT
/begin MEASUREMENT ZFFSAB._.ASCIn.sv_f_ASCReg "REPRESENT_INTERMEDIATE value of ASC control active" UBYTE SAB_STANDARD_S2_S3 1 100 0 1 ECU_ADDRESS 0xFFF96E30 DISPLAY_IDENTIFIER sv_f_ASCReg.ASCIn._.ZFFSAB /end MEASUREMENT
/begin MEASUREMENT ZFFSAB._.ASCIn.sv_f_ASCSbe "REPRESENT_INTERMEDIATE value of shifting influence" UBYTE SAB_STANDARD_S2_S3 1 100 0 1 ECU_ADDRESS 0xFFF96E2C DISPLAY_IDENTIFIER sv_f_ASCSbe.ASCIn._.ZFFSAB /end MEASUREMENT
/begin MEASUREMENT ZFFSAB._.ASCPasIn.f_ASCPasErr "Error flag of ASCPas-signal" UBYTE SAB_STANDARD_S2_S3 1 100 0 1 ECU_ADDRESS 0xFFF8D9EA DISPLAY_IDENTIFIER f_ASCPasErr.ASCPasIn._.ZFFSAB /end MEASUREMENT
/begin MEASUREMENT ZFFSAB._.ASCPasIn.iv_ASCPas "Input value ASC passive indication from CAN" UWORD SAB_STANDARD_S2_S3 1 100 0 4095 ECU_ADDRESS 0xFFF8D9E0 DISPLAY_IDENTIFIER iv_ASCPas.ASCPasIn._.ZFFSAB /end MEASUREMENT
/begin MEASUREMENT ZFFSAB._.ASCPasIn.iv_ASCPasSts "Input value message status of PAS control state" UBYTE SAB_STANDARD_S2_S3 1 100 0 255 ECU_ADDRESS 0xFFF8D9E4 DISPLAY_IDENTIFIER iv_ASCPasSts.ASCPasIn._.ZFFSAB /end MEASUREMENT
/begin MEASUREMENT ZFFSAB._.ASCPasIn.iv_ASCPasSts_ "Input value message status of PAS control state" UBYTE SAB_STANDARD_S2_S3 1 100 0 255 ECU_ADDRESS 0xFFF8D9E5 DISPLAY_IDENTIFIER iv_ASCPasSts_.ASCPasIn._.ZFFSAB /end MEASUREMENT
/begin MEASUREMENT ZFFSAB._.ASCPasIn.iv_ASCPas_ "Input value of complementary ASC passive indication from CAN" UWORD SAB_STANDARD_S2_S3 1 100 0 65535 ECU_ADDRESS 0xFFF8D9E2 DISPLAY_IDENTIFIER iv_ASCPas_.ASCPasIn._.ZFFSAB /end MEASUREMENT
/begin MEASUREMENT ZFFSAB._.ASCPasIn.sv_ASCPas "Output value ASC passive indication" UBYTE SAB_STANDARD_S2_S3 1 100 0 1 ECU_ADDRESS 0xFFF8D9E7 DISPLAY_IDENTIFIER sv_ASCPas.ASCPasIn._.ZFFSAB /end MEASUREMENT
/begin MEASUREMENT ZFFSAB._.ASCPasIn.sv_ASCPasSts "Output value signal status of ASC passive indication" UBYTE SAB_STANDARD_S2_S3 1 100 0 2 ECU_ADDRESS 0xFFF8D9E6 DISPLAY_IDENTIFIER sv_ASCPasSts.ASCPasIn._.ZFFSAB /end MEASUREMENT
/begin MEASUREMENT ZFFSAB._.ASCPasIn.sv_f_DSCErr "Output value of DSCErr" UBYTE SAB_STANDARD_S2_S3 1 100 0 1 ECU_ADDRESS 0xFFF8D9E8 DISPLAY_IDENTIFIER sv_f_DSCErr.ASCPasIn._.ZFFSAB /end MEASUREMENT
/begin MEASUREMENT ZFFSAB._.ASCPasIn.sv_f_DSCErr_ "Output value of DSCErr" UBYTE SAB_STANDARD_S2_S3 1 100 0 255 ECU_ADDRESS 0xFFF8D9E9 DISPLAY_IDENTIFIER sv_f_DSCErr_.ASCPasIn._.ZFFSAB /end MEASUREMENT
/begin MEASUREMENT ZFFSAB._.AccelerationAcrossIn.f_AyRefErr "Error flag of cross acceleration" UBYTE SAB_STANDARD_S2_S3 1 100 0 1 ECU_ADDRESS 0xFFF8D9F3 DISPLAY_IDENTIFIER f_AyRefErr.AccelerationAcrossIn._.ZFFSAB /end MEASUREMENT
/begin MEASUREMENT ZFFSAB._.AccelerationAcrossIn.iv_AyRef "Input value cross acceleration from CAN" UWORD SAB_A_2MPSS1000_M32500_S2_S3 1 100 -65 66.07 ECU_ADDRESS 0xFFF8D9EC DISPLAY_IDENTIFIER iv_AyRef.AccelerationAcrossIn._.ZFFSAB /end MEASUREMENT
/begin MEASUREMENT ZFFSAB._.AccelerationAcrossIn.iv_AyRefErr "Input value qualifier of cross acceleration" UBYTE SAB_STANDARD_S2_S3 1 100 0 255 ECU_ADDRESS 0xFFF8D9EE DISPLAY_IDENTIFIER iv_AyRefErr.AccelerationAcrossIn._.ZFFSAB /end MEASUREMENT
/begin MEASUREMENT ZFFSAB._.AccelerationAcrossIn.iv_AyRefSts "Input value message status of cross acceleration" UBYTE SAB_STANDARD_S2_S3 1 100 0 255 ECU_ADDRESS 0xFFF8D9EF DISPLAY_IDENTIFIER iv_AyRefSts.AccelerationAcrossIn._.ZFFSAB /end MEASUREMENT
/begin MEASUREMENT ZFFSAB._.AccelerationAcrossIn.sv_AyRef "Output value cross acceleration" SWORD SAB_A_MPSS32_S2_S3 1 100 -65 66.0625 ECU_ADDRESS 0xFFF8D9F0 DISPLAY_IDENTIFIER sv_AyRef.AccelerationAcrossIn._.ZFFSAB /end MEASUREMENT
/begin MEASUREMENT ZFFSAB._.AccelerationAcrossIn.sv_AyRefSts "Output value signal status of cross acceleration" UBYTE SAB_STANDARD_S2_S3 1 100 0 2 ECU_ADDRESS 0xFFF8D9F2 DISPLAY_IDENTIFIER sv_AyRefSts.AccelerationAcrossIn._.ZFFSAB /end MEASUREMENT
/begin MEASUREMENT ZFFSAB._.AccelerationLongIn.f_AxRefErr "Error flag of cross acceleration" UBYTE SAB_STANDARD_S2_S3 1 100 0 1 ECU_ADDRESS 0xFFF9599F DISPLAY_IDENTIFIER f_AxRefErr.AccelerationLongIn._.ZFFSAB /end MEASUREMENT
/begin MEASUREMENT ZFFSAB._.AccelerationLongIn.iv_AxRef "Input value cross acceleration from CAN" UWORD SAB_A_2MPSS1000_M32500_S2_S3 1 100 -65 66.07 ECU_ADDRESS 0xFFF95998 DISPLAY_IDENTIFIER iv_AxRef.AccelerationLongIn._.ZFFSAB /end MEASUREMENT
/begin MEASUREMENT ZFFSAB._.AccelerationLongIn.iv_AxRefErr "Input value qualifier of cross acceleration" UBYTE SAB_STANDARD_S2_S3 1 100 0 255 ECU_ADDRESS 0xFFF9599A DISPLAY_IDENTIFIER iv_AxRefErr.AccelerationLongIn._.ZFFSAB /end MEASUREMENT
/begin MEASUREMENT ZFFSAB._.AccelerationLongIn.iv_AxRefSts "Input value message status of cross acceleration" UBYTE SAB_STANDARD_S2_S3 1 100 0 255 ECU_ADDRESS 0xFFF9599B DISPLAY_IDENTIFIER iv_AxRefSts.AccelerationLongIn._.ZFFSAB /end MEASUREMENT
/begin MEASUREMENT ZFFSAB._.AccelerationLongIn.sv_AxRef "Output value cross acceleration" SWORD SAB_A_MPSS32_S2_S3 1 100 -65 65 ECU_ADDRESS 0xFFF9599C DISPLAY_IDENTIFIER sv_AxRef.AccelerationLongIn._.ZFFSAB /end MEASUREMENT
/begin MEASUREMENT ZFFSAB._.AccelerationLongIn.sv_AxRefSts "Output value signal status of cross acceleration" UBYTE SAB_STANDARD_S2_S3 1 100 0 2 ECU_ADDRESS 0xFFF9599E DISPLAY_IDENTIFIER sv_AxRefSts.AccelerationLongIn._.ZFFSAB /end MEASUREMENT
/begin MEASUREMENT ZFFSAB._.ActuatorSignalsIn.f_EpumpConsiderAliveSignal "Coding flag for diagnosis" UBYTE SAB_STANDARD_S2_S3 1 100 0 1 ECU_ADDRESS 0xFFF9591A DISPLAY_IDENTIFIER f_EpumpConsiderAliveSignal.ActuatorSignalsIn._.ZFFSAB /end MEASUREMENT
/begin MEASUREMENT ZFFSAB._.ActuatorSignalsIn.f_SetDitherFunction "flag to indicate SET_OUTx_DITHER_ACTIVE have been called from cylic init" UBYTE SAB_STANDARD_S2_S3 1 100 0 1 ECU_ADDRESS 0xFFF9591B DISPLAY_IDENTIFIER f_SetDitherFunction.ActuatorSignalsIn._.ZFFSAB /end MEASUREMENT
/begin MEASUREMENT ZFFSAB._.ActuatorSignalsIn.iv_DcEPump "Input raw signal: PWM from E-Pump" UWORD SAB_PROZENT10_S2_S3 1 100 0 100 ECU_ADDRESS 0xFFF95910 DISPLAY_IDENTIFIER iv_DcEPump.ActuatorSignalsIn._.ZFFSAB /end MEASUREMENT
/begin MEASUREMENT ZFFSAB._.ActuatorSignalsIn.iv_GetIepCtrlByTester "Status of IEP_CTRL_BY_TESTER" UBYTE SAB_STANDARD_S2_S3 1 100 0 255 ECU_ADDRESS 0xFFF95917 DISPLAY_IDENTIFIER iv_GetIepCtrlByTester.ActuatorSignalsIn._.ZFFSAB /end MEASUREMENT
/begin MEASUREMENT ZFFSAB._.ActuatorSignalsIn.iv_GetIepSollHas "Status of IEP_SOLL_HAS" UBYTE SAB_STANDARD_S2_S3 1 100 0 255 ECU_ADDRESS 0xFFF95916 DISPLAY_IDENTIFIER iv_GetIepSollHas.ActuatorSignalsIn._.ZFFSAB /end MEASUREMENT
/begin MEASUREMENT ZFFSAB._.ActuatorSignalsIn.iv_GetIepSollSubst "Status of IEP_SOLL_SUBST" UBYTE SAB_STANDARD_S2_S3 1 100 0 255 ECU_ADDRESS 0xFFF95915 DISPLAY_IDENTIFIER iv_GetIepSollSubst.ActuatorSignalsIn._.ZFFSAB /end MEASUREMENT
/begin MEASUREMENT ZFFSAB._.ActuatorSignalsIn.iv_GetOut10ESts "E-Status of OUT10" UBYTE SAB_STANDARD_S2_S3 1 100 0 255 ECU_ADDRESS 0xFFF95912 DISPLAY_IDENTIFIER iv_GetOut10ESts.ActuatorSignalsIn._.ZFFSAB /end MEASUREMENT
/begin MEASUREMENT ZFFSAB._.ActuatorSignalsIn.iv_IEP_ist "Input value for status IEP" UBYTE SAB_STANDARD_S2_S3 1 100 0 4 ECU_ADDRESS 0xFFF95913 DISPLAY_IDENTIFIER iv_IEP_ist.ActuatorSignalsIn._.ZFFSAB /end MEASUREMENT
/begin MEASUREMENT ZFFSAB._.ActuatorSignalsIn.iv_fet0_active "Input value for state of FET0" UBYTE SAB_STANDARD_S2_S3 1 100 0 255 ECU_ADDRESS 0xFFF95914 DISPLAY_IDENTIFIER iv_fet0_active.ActuatorSignalsIn._.ZFFSAB /end MEASUREMENT
/begin MEASUREMENT ZFFSAB._.ActuatorSignalsIn.st_EpumpDiagErr "Error signal for diagnosis" UBYTE SAB_STANDARD_S2_S3 1 100 0 1 ECU_ADDRESS 0xFFF95919 DISPLAY_IDENTIFIER st_EpumpDiagErr.ActuatorSignalsIn._.ZFFSAB /end MEASUREMENT
/begin MEASUREMENT ZFFSAB._.ActuatorSignalsIn.sv_EPumpErr "Output signal: decoded of PWM from E-Pump" UBYTE SAB_STANDARD_S2_S3 1 100 0 3 ECU_ADDRESS 0xFFF95918 DISPLAY_IDENTIFIER sv_EPumpErr.ActuatorSignalsIn._.ZFFSAB /end MEASUREMENT
/begin MEASUREMENT ZFFSAB._.ActuatorSignalsIn.tmr_EPumpAliveSignal.time "Description for this variable only in SW documentation possible not in asap2" UWORD SAB_T_TIMER_10MS_S2_S3 1 100 0 655350 ECU_ADDRESS 0xFFF9590E DISPLAY_IDENTIFIER time.tmr_EPumpAliveSignal.ActuatorSignalsIn._.ZFFSAB /end MEASUREMENT
/begin MEASUREMENT ZFFSAB._.ActuatorSignalsIn.tmr_EPumpPermShutDown.time "Description for this variable only in SW documentation possible not in asap2" UBYTE SAB_T_TIMER_10MS_S2_S3 1 100 0 2550 ECU_ADDRESS 0xFFF9590C DISPLAY_IDENTIFIER time.tmr_EPumpPermShutDown.ActuatorSignalsIn._.ZFFSAB /end MEASUREMENT
/begin MEASUREMENT ZFFSAB._.ActuatorSignalsIn.tmr_EPumpTempShutDown.time "Description for this variable only in SW documentation possible not in asap2" UBYTE SAB_T_TIMER_10MS_S2_S3 1 100 0 2550 ECU_ADDRESS 0xFFF9590D DISPLAY_IDENTIFIER time.tmr_EPumpTempShutDown.ActuatorSignalsIn._.ZFFSAB /end MEASUREMENT
/begin MEASUREMENT ZFFSAB._.AfuReqIn.f_AfuReqErr "Error flag of start assistance" UBYTE SAB_STANDARD_S2_S3 1 100 0 255 ECU_ADDRESS 0xFFF96D03 DISPLAY_IDENTIFIER f_AfuReqErr.AfuReqIn._.ZFFSAB /end MEASUREMENT
/begin MEASUREMENT ZFFSAB._.AfuReqIn.iv_AfuReq "Input value start assistance from CAN" UBYTE SAB_STANDARD_S2_S3 1 100 0 255 ECU_ADDRESS 0xFFF96CFF DISPLAY_IDENTIFIER iv_AfuReq.AfuReqIn._.ZFFSAB /end MEASUREMENT
/begin MEASUREMENT ZFFSAB._.AfuReqIn.iv_AfuReqSts "Input value message status of start assistance" UBYTE SAB_STANDARD_S2_S3 1 100 0 255 ECU_ADDRESS 0xFFF96D00 DISPLAY_IDENTIFIER iv_AfuReqSts.AfuReqIn._.ZFFSAB /end MEASUREMENT
/begin MEASUREMENT ZFFSAB._.AfuReqIn.sv_AfuReq "Output value start assistance" UBYTE SAB_STANDARD_S2_S3 1 100 0 255 ECU_ADDRESS 0xFFF96D01 DISPLAY_IDENTIFIER sv_AfuReq.AfuReqIn._.ZFFSAB /end MEASUREMENT
/begin MEASUREMENT ZFFSAB._.AfuReqIn.sv_AfuReqSts "Output value signal status of start assistance" UBYTE SAB_STANDARD_S2_S3 1 100 0 255 ECU_ADDRESS 0xFFF96D02 DISPLAY_IDENTIFIER sv_AfuReqSts.AfuReqIn._.ZFFSAB /end MEASUREMENT
/begin MEASUREMENT ZFFSAB._.AmbConditionsIn.FaultCodeToAmbientCondition "Error Code supplied by the Errorhandler Component" UWORD SAB_STANDARD_S2_S3 1 100 0 65535 ECU_ADDRESS 0xFFF95AB2 DISPLAY_IDENTIFIER FaultCodeToAmbientCondition.AmbConditionsIn._.ZFFSAB /end MEASUREMENT
/begin MEASUREMENT ZFFSAB._.AmbConditionsIn.iv_ABSRegSts "Input value for ABSReg" UWORD SAB_STANDARD_S2_S3 1 100 0 4095 ECU_ADDRESS 0xFFF95A12 DISPLAY_IDENTIFIER iv_ABSRegSts.AmbConditionsIn._.ZFFSAB /end MEASUREMENT
/begin MEASUREMENT ZFFSAB._.AmbConditionsIn.iv_ASCPas "Input value ASC passive indication from CAN" UWORD SAB_STANDARD_S2_S3 1 100 0 4095 ECU_ADDRESS 0xFFF95A14 DISPLAY_IDENTIFIER iv_ASCPas.AmbConditionsIn._.ZFFSAB /end MEASUREMENT
/begin MEASUREMENT ZFFSAB._.AmbConditionsIn.iv_ASCReg "Input value ASC control activ from CAN" UWORD SAB_STANDARD_S2_S3 1 100 0 4095 ECU_ADDRESS 0xFFF95A16 DISPLAY_IDENTIFIER iv_ASCReg.AmbConditionsIn._.ZFFSAB /end MEASUREMENT
/begin MEASUREMENT ZFFSAB._.AmbConditionsIn.iv_AblaufvarianteHas "Input value: Specification of HAS stateflow variant (HAS: Hybrid-Ablauf-Steuerung)" UBYTE SAB_STANDARD_S2_S3 1 100 0 255 ECU_ADDRESS 0xFFF95A27 DISPLAY_IDENTIFIER iv_AblaufvarianteHas.AmbConditionsIn._.ZFFSAB /end MEASUREMENT
/begin MEASUREMENT ZFFSAB._.AmbConditionsIn.iv_ActiveActionByte1 "Detection for active action on Byte1 (index = 15)" ULONG SAB_STANDARD_S2_S3 1 100 0 4294967295 ECU_ADDRESS 0xFFF959C8 DISPLAY_IDENTIFIER iv_ActiveActionByte1.AmbConditionsIn._.ZFFSAB /end MEASUREMENT
/begin MEASUREMENT ZFFSAB._.AmbConditionsIn.iv_ActiveActionByte2 "Detection for active action on Byte2 (index = 16)" ULONG SAB_STANDARD_S2_S3 1 100 0 4294967295 ECU_ADDRESS 0xFFF959CC DISPLAY_IDENTIFIER iv_ActiveActionByte2.AmbConditionsIn._.ZFFSAB /end MEASUREMENT
/begin MEASUREMENT ZFFSAB._.AmbConditionsIn.iv_ActiveActionByte3 "Detection for active action on Byte3 (index = 17)" ULONG SAB_STANDARD_S2_S3 1 100 0 4294967295 ECU_ADDRESS 0xFFF959D0 DISPLAY_IDENTIFIER iv_ActiveActionByte3.AmbConditionsIn._.ZFFSAB /end MEASUREMENT
/begin MEASUREMENT ZFFSAB._.AmbConditionsIn.iv_ActiveActionByte4 "Detection for active action on Byte4 (index = 18)" ULONG SAB_STANDARD_S2_S3 1 100 0 4294967295 ECU_ADDRESS 0xFFF959D4 DISPLAY_IDENTIFIER iv_ActiveActionByte4.AmbConditionsIn._.ZFFSAB /end MEASUREMENT
/begin MEASUREMENT ZFFSAB._.AmbConditionsIn.iv_ActiveActionByte5 "Detection for active action on Byte5 (index = 19)" ULONG SAB_STANDARD_S2_S3 1 100 0 4294967295 ECU_ADDRESS 0xFFF959D8 DISPLAY_IDENTIFIER iv_ActiveActionByte5.AmbConditionsIn._.ZFFSAB /end MEASUREMENT
/begin MEASUREMENT ZFFSAB._.AmbConditionsIn.iv_ActiveActionByte6 "Detection for active action on Byte6 (index = 20)" ULONG SAB_STANDARD_S2_S3 1 100 0 4294967295 ECU_ADDRESS 0xFFF959DC DISPLAY_IDENTIFIER iv_ActiveActionByte6.AmbConditionsIn._.ZFFSAB /end MEASUREMENT
/begin MEASUREMENT ZFFSAB._.AmbConditionsIn.iv_ActiveActionByte7 "Detection for active action on Byte7 (index = 21)" ULONG SAB_STANDARD_S2_S3 1 100 0 4294967295 ECU_ADDRESS 0xFFF959E0 DISPLAY_IDENTIFIER iv_ActiveActionByte7.AmbConditionsIn._.ZFFSAB /end MEASUREMENT
/begin MEASUREMENT ZFFSAB._.AmbConditionsIn.iv_ActiveActionByte8 "Detection for active action on Byte8 (index = 21)" ULONG SAB_STANDARD_S2_S3 1 100 0 4294967295 ECU_ADDRESS 0xFFF959E4 DISPLAY_IDENTIFIER iv_ActiveActionByte8.AmbConditionsIn._.ZFFSAB /end MEASUREMENT
/begin MEASUREMENT ZFFSAB._.AmbConditionsIn.iv_ActualGear "Actual gear of the gear shifting control unit; -1 = R Gang; 0 = Kein Gang; 1 = 1. Gang; 2 = 2. Gang; 3 = 3. Gang; 4 = 4. Gang; 5 = 5. Gang; 6 = 6. Gang; 7 = 7. Gang; 8 = 8. Gang; 9 = 9. Gang (Getriebevarianten spezifisch)" SBYTE SAB_STANDARD_S2_S3 1 100 0 10 ECU_ADDRESS 0xFFF95A35 DISPLAY_IDENTIFIER iv_ActualGear.AmbConditionsIn._.ZFFSAB /end MEASUREMENT
/begin MEASUREMENT ZFFSAB._.AmbConditionsIn.iv_BrakeSts "Output status signal of brake information (index = 31)" UBYTE SAB_STANDARD_S2_S3 1 100 0 255 ECU_ADDRESS 0xFFF95A10 DISPLAY_IDENTIFIER iv_BrakeSts.AmbConditionsIn._.ZFFSAB /end MEASUREMENT
/begin MEASUREMENT ZFFSAB._.AmbConditionsIn.iv_CtrlSignalSourceSts "status of CtrlSignalSource" UBYTE SAB_STANDARD_S2_S3 1 100 0 2 ECU_ADDRESS 0xFFF95A11 DISPLAY_IDENTIFIER iv_CtrlSignalSourceSts.AmbConditionsIn._.ZFFSAB /end MEASUREMENT
/begin MEASUREMENT ZFFSAB._.AmbConditionsIn.iv_DoorDSts "Input value signal status of door detection (index = 68)" UBYTE SAB_STANDARD_S2_S3 1 100 0 255 ECU_ADDRESS 0xFFF95A8E DISPLAY_IDENTIFIER iv_DoorDSts.AmbConditionsIn._.ZFFSAB /end MEASUREMENT
/begin MEASUREMENT ZFFSAB._.AmbConditionsIn.iv_DrivingDirection "Input signal of driving direction wheel; 0 = Drehrichtung unbestimmt; 1 = Drehrichtung vorwaerts; 2 = Drehrichtung rueckwaerts" UBYTE SAB_STANDARD_S2_S3 1 100 0 2 ECU_ADDRESS 0xFFF95A37 DISPLAY_IDENTIFIER iv_DrivingDirection.AmbConditionsIn._.ZFFSAB /end MEASUREMENT
/begin MEASUREMENT ZFFSAB._.AmbConditionsIn.iv_FASPosSts "Input status signal of sv_FASPosSts 0: signal ok 1: dynamic substitute signal 2: signal faulty" UBYTE SAB_STANDARD_S2_S3 1 100 0 2 ECU_ADDRESS 0xFFF95A43 DISPLAY_IDENTIFIER iv_FASPosSts.AmbConditionsIn._.ZFFSAB /end MEASUREMENT
/begin MEASUREMENT ZFFSAB._.AmbConditionsIn.iv_IepIst "Input value: state of auxiliary electrical pump" UBYTE SAB_STANDARD_S2_S3 1 100 0 255 ECU_ADDRESS 0xFFF95A34 DISPLAY_IDENTIFIER iv_IepIst.AmbConditionsIn._.ZFFSAB /end MEASUREMENT
/begin MEASUREMENT ZFFSAB._.AmbConditionsIn.iv_KL15 "Ignition (index = 24)" UBYTE SAB_STANDARD_S2_S3 1 100 0 4 ECU_ADDRESS 0xFFF959E8 DISPLAY_IDENTIFIER iv_KL15.AmbConditionsIn._.ZFFSAB /end MEASUREMENT
/begin MEASUREMENT ZFFSAB._.AmbConditionsIn.iv_KL15Sts "Error state of output value 0=no error 1=substitute value 2=error" UBYTE SAB_STANDARD_S2_S3 1 100 0 2 ECU_ADDRESS 0xFFF95A9F DISPLAY_IDENTIFIER iv_KL15Sts.AmbConditionsIn._.ZFFSAB /end MEASUREMENT
/begin MEASUREMENT ZFFSAB._.AmbConditionsIn.iv_KL15_UWB81 "Input value of terminal 15 CAN signal" UBYTE SAB_STANDARD_S2_S3 1 100 0 15 ECU_ADDRESS 0xFFF95A26 DISPLAY_IDENTIFIER iv_KL15_UWB81.AmbConditionsIn._.ZFFSAB /end MEASUREMENT
/begin MEASUREMENT ZFFSAB._.AmbConditionsIn.iv_KeyValidSts "Input value signal status of key detection (index = 68)" UBYTE SAB_STANDARD_S2_S3 1 100 0 255 ECU_ADDRESS 0xFFF95A90 DISPLAY_IDENTIFIER iv_KeyValidSts.AmbConditionsIn._.ZFFSAB /end MEASUREMENT
/begin MEASUREMENT ZFFSAB._.AmbConditionsIn.iv_Kraftschluss "Power transmission (index = 26 or index = 94); 0 = kein Kraftschluss; 1 = Kraftschluss vorwaerts aufbauen / abbauen; 2 = Kraftschluss vorwaerts; 3 = Kraftschluss rueckwaerts aufbauen / abbauen; 4 = Kraftschluss rueckwaerts; 5 = schlupfendes Schaltelement " UBYTE SAB_STANDARD_S2_S3 1 100 0 6 ECU_ADDRESS 0xFFF959F0 DISPLAY_IDENTIFIER iv_Kraftschluss.AmbConditionsIn._.ZFFSAB /end MEASUREMENT
/begin MEASUREMENT ZFFSAB._.AmbConditionsIn.iv_KupStatusIae "Input value: physical state of integrated starting device" UBYTE SAB_STANDARD_S2_S3 1 100 0 255 ECU_ADDRESS 0xFFF95A33 DISPLAY_IDENTIFIER iv_KupStatusIae.AmbConditionsIn._.ZFFSAB /end MEASUREMENT
/begin MEASUREMENT ZFFSAB._.AmbConditionsIn.iv_LDMModeSts "Input value signal status of controlling state of LDM system 0: signal ok 1: dynamic substitute signal 2: signal faulty" UBYTE SAB_STANDARD_S2_S3 1 100 0 2 ECU_ADDRESS 0xFFF95A42 DISPLAY_IDENTIFIER iv_LDMModeSts.AmbConditionsIn._.ZFFSAB /end MEASUREMENT
/begin MEASUREMENT ZFFSAB._.AmbConditionsIn.iv_Mileage "Kilometer reading (index = 3)" ULONG SAB_L_1KM_S2_S3 1 100 0 4294967295 ECU_ADDRESS 0xFFF959B0 DISPLAY_IDENTIFIER iv_Mileage.AmbConditionsIn._.ZFFSAB /end MEASUREMENT
/begin MEASUREMENT ZFFSAB._.AmbConditionsIn.iv_PSensSts "Input of status of gearlevers signal (index = 29)" UBYTE SAB_STANDARD_S2_S3 1 100 0 255 ECU_ADDRESS 0xFFF95A0A DISPLAY_IDENTIFIER iv_PSensSts.AmbConditionsIn._.ZFFSAB /end MEASUREMENT
/begin MEASUREMENT ZFFSAB._.AmbConditionsIn.iv_STAT_Drv "Input raw signal Status MSA" UBYTE SAB_STANDARD_S2_S3 1 100 0 255 ECU_ADDRESS 0xFFF95A3E DISPLAY_IDENTIFIER iv_STAT_Drv.AmbConditionsIn._.ZFFSAB /end MEASUREMENT
/begin MEASUREMENT ZFFSAB._.AmbConditionsIn.iv_SeatBeltSts "Input value signal status of seatbelt detection" UBYTE SAB_STANDARD_S2_S3 1 100 0 2 ECU_ADDRESS 0xFFF95A1A DISPLAY_IDENTIFIER iv_SeatBeltSts.AmbConditionsIn._.ZFFSAB /end MEASUREMENT
/begin MEASUREMENT ZFFSAB._.AmbConditionsIn.iv_SeatFLSts "Input value signal status of seat detection (index = 68)" UBYTE SAB_STANDARD_S2_S3 1 100 0 255 ECU_ADDRESS 0xFFF95A8F DISPLAY_IDENTIFIER iv_SeatFLSts.AmbConditionsIn._.ZFFSAB /end MEASUREMENT
/begin MEASUREMENT ZFFSAB._.AmbConditionsIn.iv_StatusK0 "Input value: state of K0" UBYTE SAB_STANDARD_S2_S3 1 100 0 255 ECU_ADDRESS 0xFFF95A32 DISPLAY_IDENTIFIER iv_StatusK0.AmbConditionsIn._.ZFFSAB /end MEASUREMENT
/begin MEASUREMENT ZFFSAB._.AmbConditionsIn.iv_TargetGear "Target gear of the gear shifting control unit; -1 = R Gang; 0 = Kein Gang; 1 = 1. Gang; 2 = 2. Gang; 3 = 3. Gang; 4 = 4. Gang; 5 = 5. Gang; 6 = 6. Gang; 7 = 7. Gang; 8 = 8. Gang; 9 = 9. Gang (Getriebevarianten spezifisch)" SBYTE SAB_STANDARD_S2_S3 1 100 0 10 ECU_ADDRESS 0xFFF95A36 DISPLAY_IDENTIFIER iv_TargetGear.AmbConditionsIn._.ZFFSAB /end MEASUREMENT
/begin MEASUREMENT ZFFSAB._.AmbConditionsIn.iv_ThrottlePosition "Input value throttle position (index = 8)" UBYTE SAB_100PROZENT254_S2_S3 1 100 0 100.393700787 ECU_ADDRESS 0xFFF959BE DISPLAY_IDENTIFIER iv_ThrottlePosition.AmbConditionsIn._.ZFFSAB /end MEASUREMENT
/begin MEASUREMENT ZFFSAB._.AmbConditionsIn.iv_ThrottlePositionSts "Output value signal Status for angle for Acceleration Pedal (index = 30)" UBYTE SAB_STANDARD_S2_S3 1 100 0 255 ECU_ADDRESS 0xFFF95A0B DISPLAY_IDENTIFIER iv_ThrottlePositionSts.AmbConditionsIn._.ZFFSAB /end MEASUREMENT
/begin MEASUREMENT ZFFSAB._.AmbConditionsIn.iv_Tu_sts_Direction "Input signal of direction of rotation (turbine); 0 = Drehrichtung unbestimmt; 1 = Drehrichtung Motor und Turbine gleichsinnig; 2 = Drehrichtung Motor und Turbine ungleichsinnig" UBYTE SAB_STANDARD_S2_S3 1 100 0 2 ECU_ADDRESS 0xFFF95A38 DISPLAY_IDENTIFIER iv_Tu_sts_Direction.AmbConditionsIn._.ZFFSAB /end MEASUREMENT
/begin MEASUREMENT ZFFSAB._.AmbConditionsIn.iv_c_Chip1Trans "Input value substrate temperature from HW supplier (index = 6)" UBYTE SAB_C_CGT_1CEL_M40_S2_S3 1 100 -40 215 ECU_ADDRESS 0xFFF959BA DISPLAY_IDENTIFIER iv_c_Chip1Trans.AmbConditionsIn._.ZFFSAB /end MEASUREMENT
/begin MEASUREMENT ZFFSAB._.AmbConditionsIn.iv_c_Chip2Trans "Chip Temperatur2 (index = 32)" UBYTE SAB_C_CGT_1CEL_M40_S2_S3 1 100 -40 215 ECU_ADDRESS 0xFFF959BB DISPLAY_IDENTIFIER iv_c_Chip2Trans.AmbConditionsIn._.ZFFSAB /end MEASUREMENT
/begin MEASUREMENT ZFFSAB._.AmbConditionsIn.iv_c_ChipTempESts "Input value signal status of substrate temperature (index = 29)" UBYTE SAB_STANDARD_S2_S3 1 100 0 255 ECU_ADDRESS 0xFFF95A06 DISPLAY_IDENTIFIER iv_c_ChipTempESts.AmbConditionsIn._.ZFFSAB /end MEASUREMENT
/begin MEASUREMENT ZFFSAB._.AmbConditionsIn.iv_c_OilTrans "Input value Gearbox Oil Temperatur (index = 1)" UBYTE SAB_C_CGT_1CEL_M40_S2_S3 1 100 -40 215 ECU_ADDRESS 0xFFF959AC DISPLAY_IDENTIFIER iv_c_OilTrans.AmbConditionsIn._.ZFFSAB /end MEASUREMENT
/begin MEASUREMENT ZFFSAB._.AmbConditionsIn.iv_c_OilTransSts "Input value signal status of gear oil temperature (index = 29)" UBYTE SAB_STANDARD_S2_S3 1 100 0 255 ECU_ADDRESS 0xFFF95A07 DISPLAY_IDENTIFIER iv_c_OilTransSts.AmbConditionsIn._.ZFFSAB /end MEASUREMENT
/begin MEASUREMENT ZFFSAB._.AmbConditionsIn.iv_f_IgnOn "Output flag 1=Ignition on 0=Ignition off" UBYTE SAB_STANDARD_S2_S3 1 100 0 1 ECU_ADDRESS 0xFFF95A9E DISPLAY_IDENTIFIER iv_f_IgnOn.AmbConditionsIn._.ZFFSAB /end MEASUREMENT
/begin MEASUREMENT ZFFSAB._.AmbConditionsIn.iv_f_L1 "First port of electrical input signal indicating whether mechanical parklock sensor is active.It provides information about gear position" UBYTE SAB_STANDARD_S2_S3 1 100 0 1 ECU_ADDRESS 0xFFF959F2 DISPLAY_IDENTIFIER iv_f_L1.AmbConditionsIn._.ZFFSAB /end MEASUREMENT
/begin MEASUREMENT ZFFSAB._.AmbConditionsIn.iv_f_L2 "Second port of electrical input signal indicating whether mechanical parklock sensor is active.It provides information about gear position" UBYTE SAB_STANDARD_S2_S3 1 100 0 1 ECU_ADDRESS 0xFFF959F3 DISPLAY_IDENTIFIER iv_f_L2.AmbConditionsIn._.ZFFSAB /end MEASUREMENT
/begin MEASUREMENT ZFFSAB._.AmbConditionsIn.iv_f_L3 "Third port of electrical input signal indicating whether mechanical parklock sensor is active.It provides information about gear position" UBYTE SAB_STANDARD_S2_S3 1 100 0 1 ECU_ADDRESS 0xFFF959F4 DISPLAY_IDENTIFIER iv_f_L3.AmbConditionsIn._.ZFFSAB /end MEASUREMENT
/begin MEASUREMENT ZFFSAB._.AmbConditionsIn.iv_f_L4 "Fourth port of electrical input signal indicating whether mechanical parklock sensor is active.It provides information about gear position" UBYTE SAB_STANDARD_S2_S3 1 100 0 1 ECU_ADDRESS 0xFFF959F5 DISPLAY_IDENTIFIER iv_f_L4.AmbConditionsIn._.ZFFSAB /end MEASUREMENT
/begin MEASUREMENT ZFFSAB._.AmbConditionsIn.iv_f_P12TwoErr "defective park-buttons2 (index = 31)" UBYTE SAB_STANDARD_S2_S3 1 100 0 7 ECU_ADDRESS 0xFFF95A0F DISPLAY_IDENTIFIER iv_f_P12TwoErr.AmbConditionsIn._.ZFFSAB /end MEASUREMENT
/begin MEASUREMENT ZFFSAB._.AmbConditionsIn.iv_i_Out0 "Input value: Measured current at output OUT0" UWORD SAB_I_MA10_S2_S3 1 100 0 6553.5 ECU_ADDRESS 0xFFF95A44 DISPLAY_IDENTIFIER iv_i_Out0.AmbConditionsIn._.ZFFSAB /end MEASUREMENT
/begin MEASUREMENT ZFFSAB._.AmbConditionsIn.iv_i_Out1 "Input value: Measured current at output OUT1" UWORD SAB_I_MA10_S2_S3 1 100 0 6553.5 ECU_ADDRESS 0xFFF95A46 DISPLAY_IDENTIFIER iv_i_Out1.AmbConditionsIn._.ZFFSAB /end MEASUREMENT
/begin MEASUREMENT ZFFSAB._.AmbConditionsIn.iv_i_Out10 "State of current pressure regulator no.10 (index = 28)" UWORD SAB_I_MA10_S2_S3 1 100 0 6553.5 ECU_ADDRESS 0xFFF959FC DISPLAY_IDENTIFIER iv_i_Out10.AmbConditionsIn._.ZFFSAB /end MEASUREMENT
/begin MEASUREMENT ZFFSAB._.AmbConditionsIn.iv_i_Out11 "State of current pressure regulator no.11 (index = 28)" UWORD SAB_I_MA10_S2_S3 1 100 0 6553.5 ECU_ADDRESS 0xFFF959FE DISPLAY_IDENTIFIER iv_i_Out11.AmbConditionsIn._.ZFFSAB /end MEASUREMENT
/begin MEASUREMENT ZFFSAB._.AmbConditionsIn.iv_i_Out12 "State of current pressure regulator no.12 (index = 28)" UWORD SAB_I_MA10_S2_S3 1 100 0 6553.5 ECU_ADDRESS 0xFFF95A00 DISPLAY_IDENTIFIER iv_i_Out12.AmbConditionsIn._.ZFFSAB /end MEASUREMENT
/begin MEASUREMENT ZFFSAB._.AmbConditionsIn.iv_i_Out13 "State of current pressure regulator no.13 (index = 28)" UWORD SAB_I_MA10_S2_S3 1 100 0 6553.5 ECU_ADDRESS 0xFFF95A02 DISPLAY_IDENTIFIER iv_i_Out13.AmbConditionsIn._.ZFFSAB /end MEASUREMENT
/begin MEASUREMENT ZFFSAB._.AmbConditionsIn.iv_i_Out14 "State of current pressure regulator no.14 (index = 28)" UWORD SAB_I_MA10_S2_S3 1 100 0 6553.5 ECU_ADDRESS 0xFFF95A04 DISPLAY_IDENTIFIER iv_i_Out14.AmbConditionsIn._.ZFFSAB /end MEASUREMENT
/begin MEASUREMENT ZFFSAB._.AmbConditionsIn.iv_i_Out2 "Input value: Measured current at output OUT2" UWORD SAB_I_MA10_S2_S3 1 100 0 6553.5 ECU_ADDRESS 0xFFF95A48 DISPLAY_IDENTIFIER iv_i_Out2.AmbConditionsIn._.ZFFSAB /end MEASUREMENT
/begin MEASUREMENT ZFFSAB._.AmbConditionsIn.iv_i_Out3 "Input value: Measured current at output OUT3" UWORD SAB_I_MA10_S2_S3 1 100 0 6553.5 ECU_ADDRESS 0xFFF95A4A DISPLAY_IDENTIFIER iv_i_Out3.AmbConditionsIn._.ZFFSAB /end MEASUREMENT
/begin MEASUREMENT ZFFSAB._.AmbConditionsIn.iv_i_Out4 "Input value: Measured current at output OUT4" UWORD SAB_I_MA10_S2_S3 1 100 0 6553.5 ECU_ADDRESS 0xFFF95A4C DISPLAY_IDENTIFIER iv_i_Out4.AmbConditionsIn._.ZFFSAB /end MEASUREMENT
/begin MEASUREMENT ZFFSAB._.AmbConditionsIn.iv_i_Out5 "Input value: Measured current at output OUT5" UWORD SAB_I_MA10_S2_S3 1 100 0 6553.5 ECU_ADDRESS 0xFFF95A4E DISPLAY_IDENTIFIER iv_i_Out5.AmbConditionsIn._.ZFFSAB /end MEASUREMENT
/begin MEASUREMENT ZFFSAB._.AmbConditionsIn.iv_i_Out6 "Input value: Measured current at output OUT6" UWORD SAB_I_MA10_S2_S3 1 100 0 6553.5 ECU_ADDRESS 0xFFF95A50 DISPLAY_IDENTIFIER iv_i_Out6.AmbConditionsIn._.ZFFSAB /end MEASUREMENT
/begin MEASUREMENT ZFFSAB._.AmbConditionsIn.iv_i_Out7 "State of current pressure regulator no.7 (index = 28)" UWORD SAB_I_MA10_S2_S3 1 100 0 6553.5 ECU_ADDRESS 0xFFF959F6 DISPLAY_IDENTIFIER iv_i_Out7.AmbConditionsIn._.ZFFSAB /end MEASUREMENT
/begin MEASUREMENT ZFFSAB._.AmbConditionsIn.iv_i_Out8 "State of current pressure regulator no.8 (index = 28)" UWORD SAB_I_MA10_S2_S3 1 100 0 6553.5 ECU_ADDRESS 0xFFF959F8 DISPLAY_IDENTIFIER iv_i_Out8.AmbConditionsIn._.ZFFSAB /end MEASUREMENT
/begin MEASUREMENT ZFFSAB._.AmbConditionsIn.iv_i_Out9 "State of current pressure regulator no.9 (index = 28)" UWORD SAB_I_MA10_S2_S3 1 100 0 6553.5 ECU_ADDRESS 0xFFF959FA DISPLAY_IDENTIFIER iv_i_Out9.AmbConditionsIn._.ZFFSAB /end MEASUREMENT
/begin MEASUREMENT ZFFSAB._.AmbConditionsIn.iv_m_Crank "Input value of current torque of crankshaft corrected by the pump intake torque" SWORD SAB_M_NM_S2_S3 1 100 -400 1640 ECU_ADDRESS 0xFFF95A3A DISPLAY_IDENTIFIER iv_m_Crank.AmbConditionsIn._.ZFFSAB /end MEASUREMENT
/begin MEASUREMENT ZFFSAB._.AmbConditionsIn.iv_m_Eng "Input Motor moment (index = 13)" SWORD SAB_M_1NM_S2_S3 1 100 -32768 32767 ECU_ADDRESS 0xFFF959C6 DISPLAY_IDENTIFIER iv_m_Eng.AmbConditionsIn._.ZFFSAB /end MEASUREMENT
/begin MEASUREMENT ZFFSAB._.AmbConditionsIn.iv_m_EngIntervention "Input value for pos torque intervention from HPSYS" SWORD SAB_M_1NM_S2_S3 1 100 -32768 32767 ECU_ADDRESS 0xFFF95A18 DISPLAY_IDENTIFIER iv_m_EngIntervention.AmbConditionsIn._.ZFFSAB /end MEASUREMENT
/begin MEASUREMENT ZFFSAB._.AmbConditionsIn.iv_m_EngMax "Input value for max torque" SWORD SAB_M_1NM_S2_S3 1 100 -32768 32767 ECU_ADDRESS 0xFFF95A3C DISPLAY_IDENTIFIER iv_m_EngMax.AmbConditionsIn._.ZFFSAB /end MEASUREMENT
/begin MEASUREMENT ZFFSAB._.AmbConditionsIn.iv_m_EngSts "Output value signal status for GET_M_MOT (index = 30)" UBYTE SAB_STANDARD_S2_S3 1 100 0 255 ECU_ADDRESS 0xFFF95A0C DISPLAY_IDENTIFIER iv_m_EngSts.AmbConditionsIn._.ZFFSAB /end MEASUREMENT
/begin MEASUREMENT ZFFSAB._.AmbConditionsIn.iv_m_IstEm "Input value: actual electrical engine torque" SWORD SAB_M_1NM_S2_S3 1 100 -32768 32767 ECU_ADDRESS 0xFFF95A2C DISPLAY_IDENTIFIER iv_m_IstEm.AmbConditionsIn._.ZFFSAB /end MEASUREMENT
/begin MEASUREMENT ZFFSAB._.AmbConditionsIn.iv_m_IstK0 "Input value: actual K0 torque" SWORD SAB_M_1NM_S2_S3 1 100 -32768 32767 ECU_ADDRESS 0xFFF95A30 DISPLAY_IDENTIFIER iv_m_IstK0.AmbConditionsIn._.ZFFSAB /end MEASUREMENT
/begin MEASUREMENT ZFFSAB._.AmbConditionsIn.iv_m_MotMaxHas "Input value: maximum engine torque" SWORD SAB_M_1NM_S2_S3 1 100 -32768 32767 ECU_ADDRESS 0xFFF95A2E DISPLAY_IDENTIFIER iv_m_MotMaxHas.AmbConditionsIn._.ZFFSAB /end MEASUREMENT
/begin MEASUREMENT ZFFSAB._.AmbConditionsIn.iv_n_Ab "Output RPM (index = 9)" UWORD SAB_N_1RPM_S2_S3 1 100 0 65535 ECU_ADDRESS 0xFFF959C0 DISPLAY_IDENTIFIER iv_n_Ab.AmbConditionsIn._.ZFFSAB /end MEASUREMENT
/begin MEASUREMENT ZFFSAB._.AmbConditionsIn.iv_n_AbSts "Input signal of Transmission Output Speed (index = 29)" UBYTE SAB_STANDARD_S2_S3 1 100 0 255 ECU_ADDRESS 0xFFF95A08 DISPLAY_IDENTIFIER iv_n_AbSts.AmbConditionsIn._.ZFFSAB /end MEASUREMENT
/begin MEASUREMENT ZFFSAB._.AmbConditionsIn.iv_n_Eng "Input value engine rpm (index = 11)" UWORD SAB_N_1RPM_S2_S3 1 100 0 65535 ECU_ADDRESS 0xFFF959C4 DISPLAY_IDENTIFIER iv_n_Eng.AmbConditionsIn._.ZFFSAB /end MEASUREMENT
/begin MEASUREMENT ZFFSAB._.AmbConditionsIn.iv_n_EngSts "Output value signal status of engine RPM (index = 30)" UBYTE SAB_STANDARD_S2_S3 1 100 0 255 ECU_ADDRESS 0xFFF95A0D DISPLAY_IDENTIFIER iv_n_EngSts.AmbConditionsIn._.ZFFSAB /end MEASUREMENT
/begin MEASUREMENT ZFFSAB._.AmbConditionsIn.iv_n_EngVM "Input value engine rpm" UWORD SAB_N_1RPM_S2_S3 1 100 0 65535 ECU_ADDRESS 0xFFF95A40 DISPLAY_IDENTIFIER iv_n_EngVM.AmbConditionsIn._.ZFFSAB /end MEASUREMENT
/begin MEASUREMENT ZFFSAB._.AmbConditionsIn.iv_n_SollEmHas "Input value: nominal speed electrical engine" UWORD SAB_N_1RPM_S2_S3 1 100 0 65535 ECU_ADDRESS 0xFFF95A2A DISPLAY_IDENTIFIER iv_n_SollEmHas.AmbConditionsIn._.ZFFSAB /end MEASUREMENT
/begin MEASUREMENT ZFFSAB._.AmbConditionsIn.iv_n_Tu "Input value turbine speed (index = 10)" UWORD SAB_N_1RPM_S2_S3 1 100 0 65535 ECU_ADDRESS 0xFFF959C2 DISPLAY_IDENTIFIER iv_n_Tu.AmbConditionsIn._.ZFFSAB /end MEASUREMENT
/begin MEASUREMENT ZFFSAB._.AmbConditionsIn.iv_n_TuSts "State of the RPM (index = 29)" UBYTE SAB_STANDARD_S2_S3 1 100 0 255 ECU_ADDRESS 0xFFF95A09 DISPLAY_IDENTIFIER iv_n_TuSts.AmbConditionsIn._.ZFFSAB /end MEASUREMENT
/begin MEASUREMENT ZFFSAB._.AmbConditionsIn.iv_n_WheelAvg_UWB12 "Average Wheel rpm of all driven wheels (index = 12)" ULONG SAB_N_RPM100_S2_S3 1 100 0 42949672.95 ECU_ADDRESS 0xFFF95A64 DISPLAY_IDENTIFIER iv_n_WheelAvg_UWB12.AmbConditionsIn._.ZFFSAB /end MEASUREMENT
/begin MEASUREMENT ZFFSAB._.AmbConditionsIn.iv_n_WheelAvg_UWB74 "Average Wheel rpm of all driven wheels" ULONG SAB_N_RPM100_S2_S3 1 100 0 42949672.95 ECU_ADDRESS 0xFFF95A94 DISPLAY_IDENTIFIER iv_n_WheelAvg_UWB74.AmbConditionsIn._.ZFFSAB /end MEASUREMENT
/begin MEASUREMENT ZFFSAB._.AmbConditionsIn.iv_n_Wheel_FL "Input raw signal of front left (FL) wheel speed from CAN" UWORD SAB_N_RADPS64_M32767_S2_S3 1 100 -511.984375 512 ECU_ADDRESS 0xFFF95A1E DISPLAY_IDENTIFIER iv_n_Wheel_FL.AmbConditionsIn._.ZFFSAB /end MEASUREMENT
/begin MEASUREMENT ZFFSAB._.AmbConditionsIn.iv_n_Wheel_FR "Input raw signal of front right (FR) wheel speed from CAN" UWORD SAB_N_RADPS64_M32767_S2_S3 1 100 -511.984375 512 ECU_ADDRESS 0xFFF95A20 DISPLAY_IDENTIFIER iv_n_Wheel_FR.AmbConditionsIn._.ZFFSAB /end MEASUREMENT
/begin MEASUREMENT ZFFSAB._.AmbConditionsIn.iv_n_Wheel_RL "Input raw signal of rear left (RL) wheel speed from CAN" UWORD SAB_N_RADPS64_M32767_S2_S3 1 100 -511.984375 512 ECU_ADDRESS 0xFFF95A22 DISPLAY_IDENTIFIER iv_n_Wheel_RL.AmbConditionsIn._.ZFFSAB /end MEASUREMENT
/begin MEASUREMENT ZFFSAB._.AmbConditionsIn.iv_n_Wheel_RR "Input raw signal of rear right (RR) wheel speed from CAN" UWORD SAB_N_RADPS64_M32767_S2_S3 1 100 -511.984375 512 ECU_ADDRESS 0xFFF95A24 DISPLAY_IDENTIFIER iv_n_Wheel_RR.AmbConditionsIn._.ZFFSAB /end MEASUREMENT
/begin MEASUREMENT ZFFSAB._.AmbConditionsIn.iv_p_BrakeSts "Output value signal status of engine RPM (index = 31)" UBYTE SAB_STANDARD_S2_S3 1 100 0 255 ECU_ADDRESS 0xFFF95A0E DISPLAY_IDENTIFIER iv_p_BrakeSts.AmbConditionsIn._.ZFFSAB /end MEASUREMENT
/begin MEASUREMENT ZFFSAB._.AmbConditionsIn.iv_st_EepromValid "EEPROM valid channel 6 (index = 23)" UBYTE SAB_STANDARD_S2_S3 1 100 0 255 ECU_ADDRESS 0xFFF95A76 DISPLAY_IDENTIFIER iv_st_EepromValid.AmbConditionsIn._.ZFFSAB /end MEASUREMENT
/begin MEASUREMENT ZFFSAB._.AmbConditionsIn.iv_st_HasActualState "Input value: actual state of hybrid state machine" UBYTE SAB_STANDARD_S2_S3 1 100 0 255 ECU_ADDRESS 0xFFF95A29 DISPLAY_IDENTIFIER iv_st_HasActualState.AmbConditionsIn._.ZFFSAB /end MEASUREMENT
/begin MEASUREMENT ZFFSAB._.AmbConditionsIn.iv_st_HasNominalState "Input value: nominal state of hybrid state machine" UBYTE SAB_STANDARD_S2_S3 1 100 0 255 ECU_ADDRESS 0xFFF95A28 DISPLAY_IDENTIFIER iv_st_HasNominalState.AmbConditionsIn._.ZFFSAB /end MEASUREMENT
/begin MEASUREMENT ZFFSAB._.AmbConditionsIn.iv_st_IgnPlausiErr "state of the plausibility check result CAN signal against hardware signal KL15 (index = 81)" UBYTE SAB_STANDARD_S2_S3 1 100 0 2 ECU_ADDRESS 0xFFF95AA0 DISPLAY_IDENTIFIER iv_st_IgnPlausiErr.AmbConditionsIn._.ZFFSAB /end MEASUREMENT
/begin MEASUREMENT ZFFSAB._.AmbConditionsIn.iv_st_IstGang "Actual Gear Information (index = 14 or index = 26)" SBYTE SAB_STANDARD_S2_S3 1 100 -1 7 ECU_ADDRESS 0xFFF95A6B DISPLAY_IDENTIFIER iv_st_IstGang.AmbConditionsIn._.ZFFSAB /end MEASUREMENT
/begin MEASUREMENT ZFFSAB._.AmbConditionsIn.iv_st_WKZugSchub "Converter clutch drive overrun (index = 26 or index = 29)" UBYTE SAB_STANDARD_S2_S3 1 100 0 255 ECU_ADDRESS 0xFFF959F1 DISPLAY_IDENTIFIER iv_st_WKZugSchub.AmbConditionsIn._.ZFFSAB /end MEASUREMENT
/begin MEASUREMENT ZFFSAB._.AmbConditionsIn.iv_t_SystemTime "System time (index = 4)" ULONG SAB_T_TIMER_1S_S2_S3 1 100 0 4294967295 ECU_ADDRESS 0xFFF959B4 DISPLAY_IDENTIFIER iv_t_SystemTime.AmbConditionsIn._.ZFFSAB /end MEASUREMENT
/begin MEASUREMENT ZFFSAB._.AmbConditionsIn.iv_t_TimeSinceReset "System 1ms Counter (index = 25)" ULONG SAB_T_TIMER_1MS_S2_S3 1 100 0 4294967295 ECU_ADDRESS 0xFFF959EC DISPLAY_IDENTIFIER iv_t_TimeSinceReset.AmbConditionsIn._.ZFFSAB /end MEASUREMENT
/begin MEASUREMENT ZFFSAB._.AmbConditionsIn.iv_u_BattFilt "Input value Voltage on clamp 30 (index = 2)" UWORD SAB_U_1VOLT1000_S2_S3 1 100 0 65.535 ECU_ADDRESS 0xFFF959AE DISPLAY_IDENTIFIER iv_u_BattFilt.AmbConditionsIn._.ZFFSAB /end MEASUREMENT
/begin MEASUREMENT ZFFSAB._.AmbConditionsIn.iv_u_Kl15_Pin "Input of the voltage terminal 15 value" UWORD SAB_U_1VOLT1000_S2_S3 1 100 0 25 ECU_ADDRESS 0xFFF95A1C DISPLAY_IDENTIFIER iv_u_Kl15_Pin.AmbConditionsIn._.ZFFSAB /end MEASUREMENT
/begin MEASUREMENT ZFFSAB._.AmbConditionsIn.iv_u_Sensor1 "Supply voltage of the sensor supply 1: Speed sensors (index = 5)" UWORD SAB_U_1VOLT1000_S2_S3 1 100 0 65.535 ECU_ADDRESS 0xFFF959B8 DISPLAY_IDENTIFIER iv_u_Sensor1.AmbConditionsIn._.ZFFSAB /end MEASUREMENT
/begin MEASUREMENT ZFFSAB._.AmbConditionsIn.iv_udrmv1_act "Input signal measured highside voltage EDSx (index = 7)" UWORD SAB_U_1VOLT1000_S2_S3 1 100 0 65.535 ECU_ADDRESS 0xFFF959BC DISPLAY_IDENTIFIER iv_udrmv1_act.AmbConditionsIn._.ZFFSAB /end MEASUREMENT
/begin MEASUREMENT ZFFSAB._.AmbConditionsIn.sv_ABSRegSts "Output value ABS status (index = 33)" UWORD SAB_STANDARD_S2_S3 1 100 0 4095 ECU_ADDRESS 0xFFF95A86 DISPLAY_IDENTIFIER sv_ABSRegSts.AmbConditionsIn._.ZFFSAB /end MEASUREMENT
/begin MEASUREMENT ZFFSAB._.AmbConditionsIn.sv_ASCPas "Output value ASC passive indication from CAN (index = 34)" UWORD SAB_STANDARD_S2_S3 1 100 0 4095 ECU_ADDRESS 0xFFF95A88 DISPLAY_IDENTIFIER sv_ASCPas.AmbConditionsIn._.ZFFSAB /end MEASUREMENT
/begin MEASUREMENT ZFFSAB._.AmbConditionsIn.sv_ASCReg "Output value ASC control activ from CAN (index = 35)" UWORD SAB_STANDARD_S2_S3 1 100 0 4095 ECU_ADDRESS 0xFFF95A8A DISPLAY_IDENTIFIER sv_ASCReg.AmbConditionsIn._.ZFFSAB /end MEASUREMENT
/begin MEASUREMENT ZFFSAB._.AmbConditionsIn.sv_AblaufvarianteHas "Output value: nominal HAS sequence by HST (index = 82)" UBYTE SAB_STANDARD_S2_S3 1 100 0 255 ECU_ADDRESS 0xFFF95AA4 DISPLAY_IDENTIFIER sv_AblaufvarianteHas.AmbConditionsIn._.ZFFSAB /end MEASUREMENT
/begin MEASUREMENT ZFFSAB._.AmbConditionsIn.sv_ActiveActionByte1 "Detection for active action on Byte1 (index = 15)" UBYTE SAB_STANDARD_S2_S3 1 100 0 255 ECU_ADDRESS 0xFFF95A6E DISPLAY_IDENTIFIER sv_ActiveActionByte1.AmbConditionsIn._.ZFFSAB /end MEASUREMENT
/begin MEASUREMENT ZFFSAB._.AmbConditionsIn.sv_ActiveActionByte2 "Detection for active action on Byte2 (index = 16)" UBYTE SAB_STANDARD_S2_S3 1 100 0 255 ECU_ADDRESS 0xFFF95A6F DISPLAY_IDENTIFIER sv_ActiveActionByte2.AmbConditionsIn._.ZFFSAB /end MEASUREMENT
/begin MEASUREMENT ZFFSAB._.AmbConditionsIn.sv_ActiveActionByte3 "Detection for active action on Byte3 (index = 17)" UBYTE SAB_STANDARD_S2_S3 1 100 0 255 ECU_ADDRESS 0xFFF95A70 DISPLAY_IDENTIFIER sv_ActiveActionByte3.AmbConditionsIn._.ZFFSAB /end MEASUREMENT
/begin MEASUREMENT ZFFSAB._.AmbConditionsIn.sv_ActiveActionByte4 "Detection for active action on Byte4 (index = 18)" UBYTE SAB_STANDARD_S2_S3 1 100 0 255 ECU_ADDRESS 0xFFF95A71 DISPLAY_IDENTIFIER sv_ActiveActionByte4.AmbConditionsIn._.ZFFSAB /end MEASUREMENT
/begin MEASUREMENT ZFFSAB._.AmbConditionsIn.sv_ActiveActionByte5 "Detection for active action on Byte5 (index = 19)" UBYTE SAB_STANDARD_S2_S3 1 100 0 255 ECU_ADDRESS 0xFFF95A72 DISPLAY_IDENTIFIER sv_ActiveActionByte5.AmbConditionsIn._.ZFFSAB /end MEASUREMENT
/begin MEASUREMENT ZFFSAB._.AmbConditionsIn.sv_ActiveActionByte6 "Detection for active action on Byte6 (index = 20)" UBYTE SAB_STANDARD_S2_S3 1 100 0 255 ECU_ADDRESS 0xFFF95A73 DISPLAY_IDENTIFIER sv_ActiveActionByte6.AmbConditionsIn._.ZFFSAB /end MEASUREMENT
/begin MEASUREMENT ZFFSAB._.AmbConditionsIn.sv_ActiveActionByte7 "Detection for active action on Byte7 (index = 21)" UBYTE SAB_STANDARD_S2_S3 1 100 0 255 ECU_ADDRESS 0xFFF95A74 DISPLAY_IDENTIFIER sv_ActiveActionByte7.AmbConditionsIn._.ZFFSAB /end MEASUREMENT
/begin MEASUREMENT ZFFSAB._.AmbConditionsIn.sv_ActiveActionByte8 "Detection for active action on Byte8 (index = 22)" UBYTE SAB_STANDARD_S2_S3 1 100 0 255 ECU_ADDRESS 0xFFF95A75 DISPLAY_IDENTIFIER sv_ActiveActionByte8.AmbConditionsIn._.ZFFSAB /end MEASUREMENT
/begin MEASUREMENT ZFFSAB._.AmbConditionsIn.sv_IepIst "Output value: state of auxiliary electrical pump (index = 90)" UBYTE SAB_STANDARD_S2_S3 1 100 0 255 ECU_ADDRESS 0xFFF95AAC DISPLAY_IDENTIFIER sv_IepIst.AmbConditionsIn._.ZFFSAB /end MEASUREMENT
/begin MEASUREMENT ZFFSAB._.AmbConditionsIn.sv_KL15 "Ignition (index = 24)" UBYTE SAB_STANDARD_S2_S3 1 100 0 255 ECU_ADDRESS 0xFFF95A78 DISPLAY_IDENTIFIER sv_KL15.AmbConditionsIn._.ZFFSAB /end MEASUREMENT
/begin MEASUREMENT ZFFSAB._.AmbConditionsIn.sv_KupStatusIae "Output value: physical state of integrated starting device (index = 89)" UBYTE SAB_STANDARD_S2_S3 1 100 0 255 ECU_ADDRESS 0xFFF95AAB DISPLAY_IDENTIFIER sv_KupStatusIae.AmbConditionsIn._.ZFFSAB /end MEASUREMENT
/begin MEASUREMENT ZFFSAB._.AmbConditionsIn.sv_Mileage "Output value of mileage (index = 3)" ULONG SAB_L_1KM_S2_S3 1 100 0 16777215 ECU_ADDRESS 0xFFF95A54 DISPLAY_IDENTIFIER sv_Mileage.AmbConditionsIn._.ZFFSAB /end MEASUREMENT
/begin MEASUREMENT ZFFSAB._.AmbConditionsIn.sv_PowerTransRotation "Output value: Information about Power Transformation and direction of rotation (index = 94)" UBYTE SAB_STANDARD_S2_S3 1 100 0 255 ECU_ADDRESS 0xFFF95AAD DISPLAY_IDENTIFIER sv_PowerTransRotation.AmbConditionsIn._.ZFFSAB /end MEASUREMENT
/begin MEASUREMENT ZFFSAB._.AmbConditionsIn.sv_StatusK0 "Output value: state of K0 (index = 88)" UBYTE SAB_STANDARD_S2_S3 1 100 0 255 ECU_ADDRESS 0xFFF95AAA DISPLAY_IDENTIFIER sv_StatusK0.AmbConditionsIn._.ZFFSAB /end MEASUREMENT
/begin MEASUREMENT ZFFSAB._.AmbConditionsIn.sv_ThrottlePosition "Output value throttle position (index = 8)" UBYTE SAB_100PROZENT254_S2_S3 1 100 0 100.393700787 ECU_ADDRESS 0xFFF95A5F DISPLAY_IDENTIFIER sv_ThrottlePosition.AmbConditionsIn._.ZFFSAB /end MEASUREMENT
/begin MEASUREMENT ZFFSAB._.AmbConditionsIn.sv_c_Chip1Trans "Output value substrate temperature from HW supplier (index = 6)" UBYTE SAB_C_CGT_1CEL_M40_S2_S3 1 100 -40 215 ECU_ADDRESS 0xFFF95A5D DISPLAY_IDENTIFIER sv_c_Chip1Trans.AmbConditionsIn._.ZFFSAB /end MEASUREMENT
/begin MEASUREMENT ZFFSAB._.AmbConditionsIn.sv_c_Chip2Trans "Output value substrate temperature from HW supplier (index = 32)" UBYTE SAB_C_1CEL_M40_S2_S3 1 100 -40 215 ECU_ADDRESS 0xFFF95A85 DISPLAY_IDENTIFIER sv_c_Chip2Trans.AmbConditionsIn._.ZFFSAB /end MEASUREMENT
/begin MEASUREMENT ZFFSAB._.AmbConditionsIn.sv_c_OilTrans "Output value Gearbox Oil Temperatur (index = 1)" UBYTE SAB_C_CGT_1CEL_M40_S2_S3 1 100 -40 215 ECU_ADDRESS 0xFFF95A52 DISPLAY_IDENTIFIER sv_c_OilTrans.AmbConditionsIn._.ZFFSAB /end MEASUREMENT
/begin MEASUREMENT ZFFSAB._.AmbConditionsIn.sv_m_Crank "Output value of current torque of crankshaft corrected by the pump intake torque (index = 95)" UBYTE SAB_M_4NM_M100_S2_S3 1 100 -100 920 ECU_ADDRESS 0xFFF95AAE DISPLAY_IDENTIFIER sv_m_Crank.AmbConditionsIn._.ZFFSAB /end MEASUREMENT
/begin MEASUREMENT ZFFSAB._.AmbConditionsIn.sv_m_Eng "Motor moment (index = 13)" UBYTE SAB_M_4NM_M100_S2_S3 1 100 -100 920 ECU_ADDRESS 0xFFF95A6A DISPLAY_IDENTIFIER sv_m_Eng.AmbConditionsIn._.ZFFSAB /end MEASUREMENT
/begin MEASUREMENT ZFFSAB._.AmbConditionsIn.sv_m_EngIntervention "Output value for pos torque intervention from HPSYS (index = 66)" SWORD SAB_M_1NM_S2_S3 1 100 -32768 32767 ECU_ADDRESS 0xFFF95A8C DISPLAY_IDENTIFIER sv_m_EngIntervention.AmbConditionsIn._.ZFFSAB /end MEASUREMENT
/begin MEASUREMENT ZFFSAB._.AmbConditionsIn.sv_m_EngMax "Output value for max torque (index = 123)" UBYTE SAB_M_8NM_M400_S2_S3 1 100 -400 1640 ECU_ADDRESS 0xFFF95AAF DISPLAY_IDENTIFIER sv_m_EngMax.AmbConditionsIn._.ZFFSAB /end MEASUREMENT
/begin MEASUREMENT ZFFSAB._.AmbConditionsIn.sv_m_IstEm "Output value: actual torque electrical engine (index = 85)" UBYTE SAB_M_4NM_M500_S2_S3 1 100 -500 520 ECU_ADDRESS 0xFFF95AA7 DISPLAY_IDENTIFIER sv_m_IstEm.AmbConditionsIn._.ZFFSAB /end MEASUREMENT
/begin MEASUREMENT ZFFSAB._.AmbConditionsIn.sv_m_IstK0 "Output value: actual torque K0 (index = 87)" UBYTE SAB_M_4NM_M100_S2_S3 1 100 -100 920 ECU_ADDRESS 0xFFF95AA9 DISPLAY_IDENTIFIER sv_m_IstK0.AmbConditionsIn._.ZFFSAB /end MEASUREMENT
/begin MEASUREMENT ZFFSAB._.AmbConditionsIn.sv_m_MotMaxHas "Output value: maximum engine torque (index = 86)" UBYTE SAB_M_4NM_M100_S2_S3 1 100 -100 920 ECU_ADDRESS 0xFFF95AA8 DISPLAY_IDENTIFIER sv_m_MotMaxHas.AmbConditionsIn._.ZFFSAB /end MEASUREMENT
/begin MEASUREMENT ZFFSAB._.AmbConditionsIn.sv_n_Ab "Output RPM (index = 9)" UBYTE SAB_N_32RPM_S2_S3 1 100 0 8160 ECU_ADDRESS 0xFFF95A60 DISPLAY_IDENTIFIER sv_n_Ab.AmbConditionsIn._.ZFFSAB /end MEASUREMENT
/begin MEASUREMENT ZFFSAB._.AmbConditionsIn.sv_n_Eng "Output value engine rpm (index = 11)" UBYTE SAB_N_32RPM_S2_S3 1 100 0 8160 ECU_ADDRESS 0xFFF95A62 DISPLAY_IDENTIFIER sv_n_Eng.AmbConditionsIn._.ZFFSAB /end MEASUREMENT
/begin MEASUREMENT ZFFSAB._.AmbConditionsIn.sv_n_EngVM "Output value for engine rpm (index = 135)" UBYTE SAB_N_32RPM_S2_S3 1 100 0 8160 ECU_ADDRESS 0xFFF95AB0 DISPLAY_IDENTIFIER sv_n_EngVM.AmbConditionsIn._.ZFFSAB /end MEASUREMENT
/begin MEASUREMENT ZFFSAB._.AmbConditionsIn.sv_n_SollEmHas "Output value: nominal speed electrical engine (index = 84)" UBYTE SAB_N_32RPM_S2_S3 1 100 0 8160 ECU_ADDRESS 0xFFF95AA6 DISPLAY_IDENTIFIER sv_n_SollEmHas.AmbConditionsIn._.ZFFSAB /end MEASUREMENT
/begin MEASUREMENT ZFFSAB._.AmbConditionsIn.sv_n_Tu "Output value turbine speed (index = 10)" UBYTE SAB_N_32RPM_S2_S3 1 100 0 8160 ECU_ADDRESS 0xFFF95A61 DISPLAY_IDENTIFIER sv_n_Tu.AmbConditionsIn._.ZFFSAB /end MEASUREMENT
/begin MEASUREMENT ZFFSAB._.AmbConditionsIn.sv_n_WheelAvg_UWB12 "Intermediate value of wheel speed from driven wheels" UWORD SAB_N_1RPM_S2_S3 1 100 0 65535 ECU_ADDRESS 0xFFF95A68 DISPLAY_IDENTIFIER sv_n_WheelAvg_UWB12.AmbConditionsIn._.ZFFSAB /end MEASUREMENT
/begin MEASUREMENT ZFFSAB._.AmbConditionsIn.sv_n_WheelAvg_UWB74 "Intermediate value of wheel speed from driven wheels (index = 74)" UBYTE SAB_N_32RPM_S2_S3 1 100 0 8160 ECU_ADDRESS 0xFFF95A98 DISPLAY_IDENTIFIER sv_n_WheelAvg_UWB74.AmbConditionsIn._.ZFFSAB /end MEASUREMENT
/begin MEASUREMENT ZFFSAB._.AmbConditionsIn.sv_n_Wheel_FL "input speed of wheel (index = 77)" UBYTE SAB_N_1RADPS_M40_S2_S3 1 100 -40 215 ECU_ADDRESS 0xFFF95A9B DISPLAY_IDENTIFIER sv_n_Wheel_FL.AmbConditionsIn._.ZFFSAB /end MEASUREMENT
/begin MEASUREMENT ZFFSAB._.AmbConditionsIn.sv_n_Wheel_FR "input speed of wheel (index = 76)" UBYTE SAB_N_1RADPS_M40_S2_S3 1 100 -40 215 ECU_ADDRESS 0xFFF95A9A DISPLAY_IDENTIFIER sv_n_Wheel_FR.AmbConditionsIn._.ZFFSAB /end MEASUREMENT
/begin MEASUREMENT ZFFSAB._.AmbConditionsIn.sv_n_Wheel_RL "input speed of wheel (index = 79)" UBYTE SAB_N_1RADPS_M40_S2_S3 1 100 -40 215 ECU_ADDRESS 0xFFF95A9D DISPLAY_IDENTIFIER sv_n_Wheel_RL.AmbConditionsIn._.ZFFSAB /end MEASUREMENT
/begin MEASUREMENT ZFFSAB._.AmbConditionsIn.sv_n_Wheel_RR "input speed of wheel (index = 78)" UBYTE SAB_N_1RADPS_M40_S2_S3 1 100 -40 215 ECU_ADDRESS 0xFFF95A9C DISPLAY_IDENTIFIER sv_n_Wheel_RR.AmbConditionsIn._.ZFFSAB /end MEASUREMENT
/begin MEASUREMENT ZFFSAB._.AmbConditionsIn.sv_st_AscDscCanSig "State for signals from ASC/DSC/GWS (index = 31)" UBYTE SAB_STANDARD_S2_S3 1 100 0 255 ECU_ADDRESS 0xFFF95A84 DISPLAY_IDENTIFIER sv_st_AscDscCanSig.AmbConditionsIn._.ZFFSAB /end MEASUREMENT
/begin MEASUREMENT ZFFSAB._.AmbConditionsIn.sv_st_DiscreteEntries "State for discrete entries (index = 27)" UBYTE SAB_STANDARD_S2_S3 1 100 0 255 ECU_ADDRESS 0xFFF95A80 DISPLAY_IDENTIFIER sv_st_DiscreteEntries.AmbConditionsIn._.ZFFSAB /end MEASUREMENT
/begin MEASUREMENT ZFFSAB._.AmbConditionsIn.sv_st_EepromValid "EEPROM valid channel 6 (index = 23)" UBYTE SAB_STANDARD_S2_S3 1 100 0 255 ECU_ADDRESS 0xFFF95A77 DISPLAY_IDENTIFIER sv_st_EepromValid.AmbConditionsIn._.ZFFSAB /end MEASUREMENT
/begin MEASUREMENT ZFFSAB._.AmbConditionsIn.sv_st_FemCasCanSig "State for FEM/CAS (index = 68)" UBYTE SAB_STANDARD_S2_S3 1 100 0 255 ECU_ADDRESS 0xFFF95A91 DISPLAY_IDENTIFIER sv_st_FemCasCanSig.AmbConditionsIn._.ZFFSAB /end MEASUREMENT
/begin MEASUREMENT ZFFSAB._.AmbConditionsIn.sv_st_GearShiftingInfo "Gear state (index = 26 or index = 91)" UBYTE SAB_STANDARD_S2_S3 1 100 0 255 ECU_ADDRESS 0xFFF95A6D DISPLAY_IDENTIFIER sv_st_GearShiftingInfo.AmbConditionsIn._.ZFFSAB /end MEASUREMENT
/begin MEASUREMENT ZFFSAB._.AmbConditionsIn.sv_st_GearboxSig "State for EGS signals (index = 29)" UBYTE SAB_STANDARD_S2_S3 1 100 0 255 ECU_ADDRESS 0xFFF95A82 DISPLAY_IDENTIFIER sv_st_GearboxSig.AmbConditionsIn._.ZFFSAB /end MEASUREMENT
/begin MEASUREMENT ZFFSAB._.AmbConditionsIn.sv_st_HasActualNominalState "Output value: actual state and nominal state of hybrid state machine (index = 83)" UBYTE SAB_STANDARD_S2_S3 1 100 0 255 ECU_ADDRESS 0xFFF95AA5 DISPLAY_IDENTIFIER sv_st_HasActualNominalState.AmbConditionsIn._.ZFFSAB /end MEASUREMENT
/begin MEASUREMENT ZFFSAB._.AmbConditionsIn.sv_st_IgnitionSignal "compilation of ignition signals (index = 81)" UWORD SAB_STANDARD_S2_S3 1 100 0 65535 ECU_ADDRESS 0xFFF95AA2 DISPLAY_IDENTIFIER sv_st_IgnitionSignal.AmbConditionsIn._.ZFFSAB /end MEASUREMENT
/begin MEASUREMENT ZFFSAB._.AmbConditionsIn.sv_st_MVs "State for MVs signals (index = 28)" UBYTE SAB_STANDARD_S2_S3 1 100 0 255 ECU_ADDRESS 0xFFF95A81 DISPLAY_IDENTIFIER sv_st_MVs.AmbConditionsIn._.ZFFSAB /end MEASUREMENT
/begin MEASUREMENT ZFFSAB._.AmbConditionsIn.sv_st_MotorCanSig "State for Motor signals (index = 30)" UBYTE SAB_STANDARD_S2_S3 1 100 0 255 ECU_ADDRESS 0xFFF95A83 DISPLAY_IDENTIFIER sv_st_MotorCanSig.AmbConditionsIn._.ZFFSAB /end MEASUREMENT
/begin MEASUREMENT ZFFSAB._.AmbConditionsIn.sv_st_ZielGang "Destination Gear Information (index = 14 or index = 26)" SBYTE SAB_STANDARD_S2_S3 1 100 -1 7 ECU_ADDRESS 0xFFF95A6C DISPLAY_IDENTIFIER sv_st_ZielGang.AmbConditionsIn._.ZFFSAB /end MEASUREMENT
/begin MEASUREMENT ZFFSAB._.AmbConditionsIn.sv_sts_PMA "Output value of the states of signals which are relevant for the ParkManeuverAssistant Bit 0 = Modussignal Bit 1 = Positionssignal Bit 2 = Bremssignal (index = 136)" UBYTE SAB_STANDARD_S2_S3 1 100 0 255 ECU_ADDRESS 0xFFF95AB1 DISPLAY_IDENTIFIER sv_sts_PMA.AmbConditionsIn._.ZFFSAB /end MEASUREMENT
/begin MEASUREMENT ZFFSAB._.AmbConditionsIn.sv_t_SystemTime "Current system time (index = 4)" ULONG SAB_T_TIMER_1S_S2_S3 1 100 0 4294967295 ECU_ADDRESS 0xFFF95A58 DISPLAY_IDENTIFIER sv_t_SystemTime.AmbConditionsIn._.ZFFSAB /end MEASUREMENT
/begin MEASUREMENT ZFFSAB._.AmbConditionsIn.sv_t_TimeSinceReset "Time since reset (index = 25)" ULONG SAB_T_TIMER_30MS_S2_S3 1 100 0 128849018850 ECU_ADDRESS 0xFFF95A7C DISPLAY_IDENTIFIER sv_t_TimeSinceReset.AmbConditionsIn._.ZFFSAB /end MEASUREMENT
/begin MEASUREMENT ZFFSAB._.AmbConditionsIn.sv_u_BattFilt "Output value Voltage on clamp 30 (index = 2)" UBYTE SAB_U_100VOLT8_S2_S3 1 100 0 20.4 ECU_ADDRESS 0xFFF95A53 DISPLAY_IDENTIFIER sv_u_BattFilt.AmbConditionsIn._.ZFFSAB /end MEASUREMENT
/begin MEASUREMENT ZFFSAB._.AmbConditionsIn.sv_u_Kl15_Pin "input voltage of terminal 15 (index = 75)" UBYTE SAB_U_100VOLT8_S2_S3 1 100 0 20.4 ECU_ADDRESS 0xFFF95A99 DISPLAY_IDENTIFIER sv_u_Kl15_Pin.AmbConditionsIn._.ZFFSAB /end MEASUREMENT
/begin MEASUREMENT ZFFSAB._.AmbConditionsIn.sv_u_Sensor1 "Output value Supply voltage of the sensor supply 1 (index = 5)" UBYTE SAB_U_100VOLT8_S2_S3 1 100 0 20.4 ECU_ADDRESS 0xFFF95A5C DISPLAY_IDENTIFIER sv_u_Sensor1.AmbConditionsIn._.ZFFSAB /end MEASUREMENT
/begin MEASUREMENT ZFFSAB._.AmbConditionsIn.sv_udrmv1_act "Output signal measured highside voltage EDSx (index = 7)" UBYTE SAB_U_100VOLT8_S2_S3 1 100 0 20.4 ECU_ADDRESS 0xFFF95A5E DISPLAY_IDENTIFIER sv_udrmv1_act.AmbConditionsIn._.ZFFSAB /end MEASUREMENT
/begin MEASUREMENT ZFFSAB._.AzgDriver.addr_fsp "start address error memory. For further information about the error memory and the error handling see the dokumentation from the component 'error handler' (ZFEH.zip)" ULONG SAB_STANDARD_S2_S3 1 100 0 4294967295 ECU_ADDRESS 0xFFF95E4C DISPLAY_IDENTIFIER addr_fsp.AzgDriver._.ZFFSAB /end MEASUREMENT
/begin MEASUREMENT ZFFSAB._.BackToNormalFunctionViaReset.f_LimphomeD "Error flag used to inform ABK that a RzN-SW-Reset is about to come" UBYTE SAB_STANDARD_S2_S3 1 100 0 1 ECU_ADDRESS 0xFFF8DD36 DISPLAY_IDENTIFIER f_LimphomeD.BackToNormalFunctionViaReset._.ZFFSAB /end MEASUREMENT
/begin MEASUREMENT ZFFSAB._.BackToNormalFunctionViaReset.f_LimphomeD_ "Complement of the error flag used to inform ABK that a RzN-SW-Reset is about to come" UBYTE SAB_STANDARD_S2_S3 1 100 0 1 ECU_ADDRESS 0xFFF8DD37 DISPLAY_IDENTIFIER f_LimphomeD_.BackToNormalFunctionViaReset._.ZFFSAB /end MEASUREMENT
/begin MEASUREMENT ZFFSAB._.BackToNormalFunctionViaReset.f_Reset_DetectedTimer "Flag set to one after a RzN reset as long as the timer tmr_delay_LimphomeCnt has not elapsed" UBYTE SAB_STANDARD_S2_S3 1 100 0 1 ECU_ADDRESS 0xFFF8DD38 DISPLAY_IDENTIFIER f_Reset_DetectedTimer.BackToNormalFunctionViaReset._.ZFFSAB /end MEASUREMENT
/begin MEASUREMENT ZFFSAB._.BackToNormalFunctionViaReset.f_Reset_DetectedTimer_ "Complement of the flag set to one after a RzN reset as long as the timer tmr_delay_LimphomeCnt has not elapsed" UBYTE SAB_STANDARD_S2_S3 1 100 0 1 ECU_ADDRESS 0xFFF8DD39 DISPLAY_IDENTIFIER f_Reset_DetectedTimer_.BackToNormalFunctionViaReset._.ZFFSAB /end MEASUREMENT
/begin MEASUREMENT ZFFSAB._.BackToNormalFunctionViaReset.iv_EEPROMBusy "Input signal of _GET_EE_BUSY macro from HW" UBYTE SAB_STANDARD_S2_S3 1 100 0 1 ECU_ADDRESS 0xFFF8DD35 DISPLAY_IDENTIFIER iv_EEPROMBusy.BackToNormalFunctionViaReset._.ZFFSAB /end MEASUREMENT
/begin MEASUREMENT ZFFSAB._.BackToNormalFunctionViaReset.iv_f_EEPROMStoreInProgress "1=EEPROM Storage is activ 0=EEPROM Storage is not activ" UBYTE SAB_STANDARD_S2_S3 1 100 0 1 ECU_ADDRESS 0xFFF8DD34 DISPLAY_IDENTIFIER iv_f_EEPROMStoreInProgress.BackToNormalFunctionViaReset._.ZFFSAB /end MEASUREMENT
/begin MEASUREMENT ZFFSAB._.BackToNormalFunctionViaReset.tmr_delay_Limphome.time "Description for this variable only in SW documentation possible not in asap2" ULONG SAB_T_TIMER_10MS_S2_S3 1 100 0 42949672950 ECU_ADDRESS 0xFFF8DD24 DISPLAY_IDENTIFIER time.tmr_delay_Limphome.BackToNormalFunctionViaReset._.ZFFSAB /end MEASUREMENT
/begin MEASUREMENT ZFFSAB._.BackToNormalFunctionViaReset.tmr_delay_Limphome.time_ "Description for this variable only in SW documentation possible not in asap2" ULONG SAB_T_TIMER_10MS_S2_S3 1 100 0 42949672950 ECU_ADDRESS 0xFFF8DD28 DISPLAY_IDENTIFIER time_.tmr_delay_Limphome.BackToNormalFunctionViaReset._.ZFFSAB /end MEASUREMENT
/begin MEASUREMENT ZFFSAB._.BackToNormalFunctionViaReset.tmr_delay_LimphomeCnt.time "Description for this variable only in SW documentation possible not in asap2" ULONG SAB_T_TIMER_10MS_S2_S3 1 100 0 42949672950 ECU_ADDRESS 0xFFF8DD2C DISPLAY_IDENTIFIER time.tmr_delay_LimphomeCnt.BackToNormalFunctionViaReset._.ZFFSAB /end MEASUREMENT
/begin MEASUREMENT ZFFSAB._.BackToNormalFunctionViaReset.tmr_delay_LimphomeCnt.time_ "Description for this variable only in SW documentation possible not in asap2" ULONG SAB_T_TIMER_10MS_S2_S3 1 100 0 42949672950 ECU_ADDRESS 0xFFF8DD30 DISPLAY_IDENTIFIER time_.tmr_delay_LimphomeCnt.BackToNormalFunctionViaReset._.ZFFSAB /end MEASUREMENT
/begin MEASUREMENT ZFFSAB._.BackToNormalFunctionViaResetBPRAM.Reset_cnt "Variable which counts the number of resets done in this module" UBYTE SAB_STANDARD_S2_S3 1 100 0 1 ECU_ADDRESS 0xFFF835C0 DISPLAY_IDENTIFIER Reset_cnt.BackToNormalFunctionViaResetBPRAM._.ZFFSAB /end MEASUREMENT
/begin MEASUREMENT ZFFSAB._.BackToNormalFunctionViaResetBPRAM.Reset_cnt_ "Complement of variable which counts the number of resets done in this module" UBYTE SAB_STANDARD_S2_S3 1 100 0 1 ECU_ADDRESS 0xFFF835C1 DISPLAY_IDENTIFIER Reset_cnt_.BackToNormalFunctionViaResetBPRAM._.ZFFSAB /end MEASUREMENT
/begin MEASUREMENT ZFFSAB._.BackToNormalFunctionViaResetBPRAM.f_Relevant_KFC_Active "Flag set to one if no relevant KFC from D_TabRzNinCruiseCnt_KFC is active" UBYTE SAB_STANDARD_S2_S3 1 100 0 1 ECU_ADDRESS 0xFFF835C4 DISPLAY_IDENTIFIER f_Relevant_KFC_Active.BackToNormalFunctionViaResetBPRAM._.ZFFSAB /end MEASUREMENT
/begin MEASUREMENT ZFFSAB._.BackToNormalFunctionViaResetBPRAM.f_Relevant_KFC_Active_ "Complement of the flag set to one if no relevant KFC from D_TabRzNinCruiseCnt_KFC is active" UBYTE SAB_STANDARD_S2_S3 1 100 0 1 ECU_ADDRESS 0xFFF835C5 DISPLAY_IDENTIFIER f_Relevant_KFC_Active_.BackToNormalFunctionViaResetBPRAM._.ZFFSAB /end MEASUREMENT
/begin MEASUREMENT ZFFSAB._.BackToNormalFunctionViaResetBPRAM.f_Reset_Detected "Flag which stores in the BPRAM the information whether there has been a RzN-SW-Reset or not" UBYTE SAB_STANDARD_S2_S3 1 100 0 1 ECU_ADDRESS 0xFFF835C2 DISPLAY_IDENTIFIER f_Reset_Detected.BackToNormalFunctionViaResetBPRAM._.ZFFSAB /end MEASUREMENT
/begin MEASUREMENT ZFFSAB._.BackToNormalFunctionViaResetBPRAM.f_Reset_Detected_ "Complement of the flag which stores in the BPRAM the information whether there has been a RzN-SW-Reset or not" UBYTE SAB_STANDARD_S2_S3 1 100 0 1 ECU_ADDRESS 0xFFF835C3 DISPLAY_IDENTIFIER f_Reset_Detected_.BackToNormalFunctionViaResetBPRAM._.ZFFSAB /end MEASUREMENT
/begin MEASUREMENT ZFFSAB._.BaroPressureIn.f_p_AirErr "Error flag barometric pressure" UBYTE SAB_STANDARD_S2_S3 1 100 0 1 ECU_ADDRESS 0xFFF96E67 DISPLAY_IDENTIFIER f_p_AirErr.BaroPressureIn._.ZFFSAB /end MEASUREMENT
/begin MEASUREMENT ZFFSAB._.BaroPressureIn.iv_p_Air "Input value barometric pressure from CAN" UBYTE SAB_P_BARO_2HPA_P598_S2_S3 1 100 598 1108 ECU_ADDRESS 0xFFF96E62 DISPLAY_IDENTIFIER iv_p_Air.BaroPressureIn._.ZFFSAB /end MEASUREMENT
/begin MEASUREMENT ZFFSAB._.BaroPressureIn.iv_p_AirSts "Input value message status of barometric pressure" UBYTE SAB_STANDARD_S2_S3 1 100 0 255 ECU_ADDRESS 0xFFF96E63 DISPLAY_IDENTIFIER iv_p_AirSts.BaroPressureIn._.ZFFSAB /end MEASUREMENT
/begin MEASUREMENT ZFFSAB._.BaroPressureIn.sv_p_Air "Output value of barometric pressure" UWORD SAB_P_1HPA_S2_S3 1 100 0 65535 ECU_ADDRESS 0xFFF96E64 DISPLAY_IDENTIFIER sv_p_Air.BaroPressureIn._.ZFFSAB /end MEASUREMENT
/begin MEASUREMENT ZFFSAB._.BaroPressureIn.sv_p_AirSts "Output value signal status of barometric pressure" UBYTE SAB_STANDARD_S2_S3 1 100 0 2 ECU_ADDRESS 0xFFF96E66 DISPLAY_IDENTIFIER sv_p_AirSts.BaroPressureIn._.ZFFSAB /end MEASUREMENT
/begin MEASUREMENT ZFFSAB._.BootJump.reset_allowance "Output signal of CALL_JUMP2BOOT. 0: Jump not allowed 1: Jump allowed 2: Pending" UBYTE SAB_STANDARD_S2_S3 1 100 0 2 ECU_ADDRESS 0xFFF95F31 DISPLAY_IDENTIFIER reset_allowance.BootJump._.ZFFSAB /end MEASUREMENT
/begin MEASUREMENT ZFFSAB._.BootJump.tmr_IEP_ShutdownDelay.time "Description for this variable only in SW documentation possible not in asap2" UBYTE SAB_T_TIMER_10MS_S2_S3 1 100 0 2550 ECU_ADDRESS 0xFFF95F30 DISPLAY_IDENTIFIER time.tmr_IEP_ShutdownDelay.BootJump._.ZFFSAB /end MEASUREMENT
/begin MEASUREMENT ZFFSAB._.BrakePedalIn.f_BrakeErr "Error flag set by valid status and signal-error-value" UBYTE SAB_STANDARD_S2_S3 1 100 0 1 ECU_ADDRESS 0xFFF8DA01 DISPLAY_IDENTIFIER f_BrakeErr.BrakePedalIn._.ZFFSAB /end MEASUREMENT
/begin MEASUREMENT ZFFSAB._.BrakePedalIn.iv_Brake "Input value brake information signal from CAN" UBYTE SAB_STANDARD_S2_S3 1 100 0 63 ECU_ADDRESS 0xFFF8D9F8 DISPLAY_IDENTIFIER iv_Brake.BrakePedalIn._.ZFFSAB /end MEASUREMENT
/begin MEASUREMENT ZFFSAB._.BrakePedalIn.iv_BrakeSts "Input value message status of brake information from CAN" UBYTE SAB_STANDARD_S2_S3 1 100 0 255 ECU_ADDRESS 0xFFF8D9FA DISPLAY_IDENTIFIER iv_BrakeSts.BrakePedalIn._.ZFFSAB /end MEASUREMENT
/begin MEASUREMENT ZFFSAB._.BrakePedalIn.iv_BrakeSts_ "Input complement value message status of brake information from CAN" UBYTE SAB_STANDARD_S2_S3 1 100 0 255 ECU_ADDRESS 0xFFF8D9FB DISPLAY_IDENTIFIER iv_BrakeSts_.BrakePedalIn._.ZFFSAB /end MEASUREMENT
/begin MEASUREMENT ZFFSAB._.BrakePedalIn.iv_Brake_ "Input complement value brake information from CAN" UBYTE SAB_STANDARD_S2_S3 1 100 0 255 ECU_ADDRESS 0xFFF8D9F9 DISPLAY_IDENTIFIER iv_Brake_.BrakePedalIn._.ZFFSAB /end MEASUREMENT
/begin MEASUREMENT ZFFSAB._.BrakePedalIn.sv_BrakeLev2Sts "Lev2 diagnosis status signal of brake information for KFC_VUNPLAUSILEV2" UBYTE SAB_STANDARD_S2_S3 1 100 0 255 ECU_ADDRESS 0xFFF8DA03 DISPLAY_IDENTIFIER sv_BrakeLev2Sts.BrakePedalIn._.ZFFSAB /end MEASUREMENT
/begin MEASUREMENT ZFFSAB._.BrakePedalIn.sv_BrakeSts "Output status signal of brake information" UBYTE SAB_STANDARD_S2_S3 1 100 0 2 ECU_ADDRESS 0xFFF8D9FC DISPLAY_IDENTIFIER sv_BrakeSts.BrakePedalIn._.ZFFSAB /end MEASUREMENT
/begin MEASUREMENT ZFFSAB._.BrakePedalIn.sv_BrakeSts_ "Complement Output status signal of brake information" UBYTE SAB_STANDARD_S2_S3 1 100 0 255 ECU_ADDRESS 0xFFF8D9FF DISPLAY_IDENTIFIER sv_BrakeSts_.BrakePedalIn._.ZFFSAB /end MEASUREMENT
/begin MEASUREMENT ZFFSAB._.BrakePedalIn.sv_f_Brake "Output signal of brake information" UBYTE SAB_STANDARD_S2_S3 1 100 0 1 ECU_ADDRESS 0xFFF8D9FD DISPLAY_IDENTIFIER sv_f_Brake.BrakePedalIn._.ZFFSAB /end MEASUREMENT
/begin MEASUREMENT ZFFSAB._.BrakePedalIn.sv_f_BrakeLev2 "Lev2 diagnosis signal of brake information for KFC_VUNPLAUSILEV2" UBYTE SAB_STANDARD_S2_S3 1 100 0 1 ECU_ADDRESS 0xFFF8DA02 DISPLAY_IDENTIFIER sv_f_BrakeLev2.BrakePedalIn._.ZFFSAB /end MEASUREMENT
/begin MEASUREMENT ZFFSAB._.BrakePedalIn.sv_f_Brake_ "Complement Output signal of brake information" UBYTE SAB_STANDARD_S2_S3 1 100 0 255 ECU_ADDRESS 0xFFF8DA00 DISPLAY_IDENTIFIER sv_f_Brake_.BrakePedalIn._.ZFFSAB /end MEASUREMENT
/begin MEASUREMENT ZFFSAB._.BrakePedalIn.sv_f_Brake_AGS "Output signal of brake information for Layer AGS" UBYTE SAB_STANDARD_S2_S3 1 100 0 2 ECU_ADDRESS 0xFFF8D9FE DISPLAY_IDENTIFIER sv_f_Brake_AGS.BrakePedalIn._.ZFFSAB /end MEASUREMENT
/begin MEASUREMENT ZFFSAB._.BrakeTorqueIn.f_m_BrakeErr "Error flag of m_Brake-signal" UBYTE SAB_STANDARD_S2_S3 1 100 0 1 ECU_ADDRESS 0xFFF8DA1B DISPLAY_IDENTIFIER f_m_BrakeErr.BrakeTorqueIn._.ZFFSAB /end MEASUREMENT
/begin MEASUREMENT ZFFSAB._.BrakeTorqueIn.f_p_BrakeErr "Error flag set by valid status and signal-error-value of brake pressure" UBYTE SAB_STANDARD_S2_S3 1 100 0 1 ECU_ADDRESS 0xFFF8DA1A DISPLAY_IDENTIFIER f_p_BrakeErr.BrakeTorqueIn._.ZFFSAB /end MEASUREMENT
/begin MEASUREMENT ZFFSAB._.BrakeTorqueIn.iv_m_Brake "The signal contains the sum of braketorque regarding the actual wheel. The signal is sent by the DSC-Controller. A negative braketorque corresponds to a frictional power of the vehicle movement." UWORD SAB_M_1NM_M32000_S2_S3 1 100 -32000 33535 ECU_ADDRESS 0xFFF8DA0A DISPLAY_IDENTIFIER iv_m_Brake.BrakeTorqueIn._.ZFFSAB /end MEASUREMENT
/begin MEASUREMENT ZFFSAB._.BrakeTorqueIn.iv_m_BrakeQF "qualifier signal for m_Brake" UBYTE SAB_STANDARD_S2_S3 1 100 0 15 ECU_ADDRESS 0xFFF8DA08 DISPLAY_IDENTIFIER iv_m_BrakeQF.BrakeTorqueIn._.ZFFSAB /end MEASUREMENT
/begin MEASUREMENT ZFFSAB._.BrakeTorqueIn.iv_m_BrakeQF_ "complement qualifier signal for m_Brake" UBYTE SAB_STANDARD_S2_S3 1 100 0 255 ECU_ADDRESS 0xFFF8DA09 DISPLAY_IDENTIFIER iv_m_BrakeQF_.BrakeTorqueIn._.ZFFSAB /end MEASUREMENT
/begin MEASUREMENT ZFFSAB._.BrakeTorqueIn.iv_m_BrakeSts "Input CAN message status of braketorque" UBYTE SAB_STANDARD_S2_S3 1 100 0 255 ECU_ADDRESS 0xFFF8DA0E DISPLAY_IDENTIFIER iv_m_BrakeSts.BrakeTorqueIn._.ZFFSAB /end MEASUREMENT
/begin MEASUREMENT ZFFSAB._.BrakeTorqueIn.iv_m_BrakeSts_ "complement input CAN message status of braketorque" UBYTE SAB_STANDARD_S2_S3 1 100 0 255 ECU_ADDRESS 0xFFF8DA0F DISPLAY_IDENTIFIER iv_m_BrakeSts_.BrakeTorqueIn._.ZFFSAB /end MEASUREMENT
/begin MEASUREMENT ZFFSAB._.BrakeTorqueIn.iv_m_Brake_ "complement of brake torque signal" UWORD SAB_STANDARD_S2_S3 1 100 0 65535 ECU_ADDRESS 0xFFF8DA0C DISPLAY_IDENTIFIER iv_m_Brake_.BrakeTorqueIn._.ZFFSAB /end MEASUREMENT
/begin MEASUREMENT ZFFSAB._.BrakeTorqueIn.sv_m_Brake "Output signal of braketorque" UWORD SAB_M_1NM_M32000_S2_S3 1 100 -32000 33535 ECU_ADDRESS 0xFFF8DA10 DISPLAY_IDENTIFIER sv_m_Brake.BrakeTorqueIn._.ZFFSAB /end MEASUREMENT
/begin MEASUREMENT ZFFSAB._.BrakeTorqueIn.sv_m_BrakeSts "Output status signal of braketorque" UBYTE SAB_STANDARD_S2_S3 1 100 0 2 ECU_ADDRESS 0xFFF8DA12 DISPLAY_IDENTIFIER sv_m_BrakeSts.BrakeTorqueIn._.ZFFSAB /end MEASUREMENT
/begin MEASUREMENT ZFFSAB._.BrakeTorqueIn.sv_p_Brake "The calculated brakepressure output signal of braketorque" UWORD SAB_P_BAR2_S2_S3 1 100 0 255 ECU_ADDRESS 0xFFF8DA14 DISPLAY_IDENTIFIER sv_p_Brake.BrakeTorqueIn._.ZFFSAB /end MEASUREMENT
/begin MEASUREMENT ZFFSAB._.BrakeTorqueIn.sv_p_BrakeSts "The calculated brakepressure output status signal of brakepressure" UBYTE SAB_STANDARD_S2_S3 1 100 0 2 ECU_ADDRESS 0xFFF8DA18 DISPLAY_IDENTIFIER sv_p_BrakeSts.BrakeTorqueIn._.ZFFSAB /end MEASUREMENT
/begin MEASUREMENT ZFFSAB._.BrakeTorqueIn.sv_p_BrakeSts_ "The calculated complement brakepressure output status signal of brakepressure" UBYTE SAB_STANDARD_S2_S3 1 100 0 255 ECU_ADDRESS 0xFFF8DA19 DISPLAY_IDENTIFIER sv_p_BrakeSts_.BrakeTorqueIn._.ZFFSAB /end MEASUREMENT
/begin MEASUREMENT ZFFSAB._.BrakeTorqueIn.sv_p_Brake_ "The calculated complement brakepressure output signal of braketorque" UWORD SAB_STANDARD_S2_S3 1 100 0 65535 ECU_ADDRESS 0xFFF8DA16 DISPLAY_IDENTIFIER sv_p_Brake_.BrakeTorqueIn._.ZFFSAB /end MEASUREMENT
/begin MEASUREMENT ZFFSAB._.CAN_Handling.CANMsg[0].Status "CAN Message status" UBYTE SAB_STANDARD_S2_S3 1 100 0 255 ECU_ADDRESS 0xFFF95DC4 DISPLAY_IDENTIFIER Status.CANMsg[0].CAN_Handling._.ZFFSAB /end MEASUREMENT
/begin MEASUREMENT ZFFSAB._.CAN_Handling.CANMsg[10].Status "CAN Message status" UBYTE SAB_STANDARD_S2_S3 1 100 0 255 ECU_ADDRESS 0xFFF95DCE DISPLAY_IDENTIFIER Status.CANMsg[10].CAN_Handling._.ZFFSAB /end MEASUREMENT
/begin MEASUREMENT ZFFSAB._.CAN_Handling.CANMsg[11].Status "CAN Message status" UBYTE SAB_STANDARD_S2_S3 1 100 0 255 ECU_ADDRESS 0xFFF95DCF DISPLAY_IDENTIFIER Status.CANMsg[11].CAN_Handling._.ZFFSAB /end MEASUREMENT
/begin MEASUREMENT ZFFSAB._.CAN_Handling.CANMsg[12].Status "CAN Message status" UBYTE SAB_STANDARD_S2_S3 1 100 0 255 ECU_ADDRESS 0xFFF95DD0 DISPLAY_IDENTIFIER Status.CANMsg[12].CAN_Handling._.ZFFSAB /end MEASUREMENT
/begin MEASUREMENT ZFFSAB._.CAN_Handling.CANMsg[13].Status "CAN Message status" UBYTE SAB_STANDARD_S2_S3 1 100 0 255 ECU_ADDRESS 0xFFF95DD1 DISPLAY_IDENTIFIER Status.CANMsg[13].CAN_Handling._.ZFFSAB /end MEASUREMENT
/end MODULE
/end PROJECT
