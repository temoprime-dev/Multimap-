ASAP2_VERSION 1 51
/begin PROJECT ZHBC8600 "Gen2_BMW_System_Supplier_Lib"
/begin MODULE CPP ""
/begin MOD_COMMON "" BYTE_ORDER MSB_FIRST ALIGNMENT_BYTE 1 ALIGNMENT_WORD 2 ALIGNMENT_LONG 4 ALIGNMENT_FLOAT32_IEEE 4 ALIGNMENT_FLOAT64_IEEE 1 /end MOD_COMMON
/begin COMPU_METHOD defaultAscii_S1 "" RAT_FUNC "%6.2" "" COEFFS 0 1 0 0 0 1 /end COMPU_METHOD
/begin COMPU_METHOD EH_100PROZENT200_S4_S3 "int = ((phys * 200) / 100) - (0) %" RAT_FUNC "%4.3" "%" COEFFS 0 2 0 0 0 1 /end COMPU_METHOD
/begin COMPU_METHOD EH_31372PROZENT10000_S4_S3 "int = ((phys * 10000) / 31372) - (0) %" RAT_FUNC "%5.4" "%" COEFFS 0 0.318755578223 0 0 0 1 /end COMPU_METHOD
/begin COMPU_METHOD UMR___1_1000_0_S5_S3 "int = ((phys * 1000) / 1) - (0) [-]" RAT_FUNC "%4.3" "[-]" COEFFS 0 1000 0 0 0 1 /end COMPU_METHOD
/begin COMPU_METHOD UMR___1_100_0_S5_S3 "int = ((phys * 100) / 1) - (0) [-]" RAT_FUNC "%3.2" "[-]" COEFFS 0 100 0 0 0 1 /end COMPU_METHOD
/begin COMPU_METHOD UMR_GRADC__1_1_M48_S5_S3 "int = ((phys * 1) / 1) - (-48) [°C]" RAT_FUNC "%1.0" "[°C]" COEFFS 0 1 48 0 0 1 /end COMPU_METHOD
/begin COMPU_METHOD UMR_MSEC__10_1_0_S5_S3 "int = ((phys * 1) / 10) - (0) [ms]" RAT_FUNC "%1.0" "[ms]" COEFFS 0 0.1 0 0 0 1 /end COMPU_METHOD
/begin COMPU_METHOD UMR_MSEC__10_1_M128_S5_S3 "int = ((phys * 1) / 10) - (-128) [ms]" RAT_FUNC "%1.0" "[ms]" COEFFS 0 0.1 128 0 0 1 /end COMPU_METHOD
/begin COMPU_METHOD UMR_MSEC__1_1_0_S5_S3 "int = ((phys * 1) / 1) - (0) [ms]" RAT_FUNC "%1.0" "[ms]" COEFFS 0 1 0 0 0 1 /end COMPU_METHOD
/begin COMPU_METHOD UMR_NM__1_1_0_S5_S3 "int = ((phys * 1) / 1) - (0) [Nm]" RAT_FUNC "%1.0" "[Nm]" COEFFS 0 1 0 0 0 1 /end COMPU_METHOD
/begin COMPU_METHOD UMR_NM__6_1_0_S5_S3 "int = ((phys * 1) / 6) - (0) [Nm]" RAT_FUNC "%1.0" "[Nm]" COEFFS 0 0.166666666667 0 0 0 1 /end COMPU_METHOD
/begin COMPU_METHOD UMR_NM__6_1_M128_S5_S3 "int = ((phys * 1) / 6) - (-128) [Nm]" RAT_FUNC "%1.0" "[Nm]" COEFFS 0 0.166666666667 128 0 0 1 /end COMPU_METHOD
/begin COMPU_METHOD UMR_NM__6_1_M34_S5_S3 "int = ((phys * 1) / 6) - (-34) [Nm]" RAT_FUNC "%1.0" "[Nm]" COEFFS 0 0.166666666667 34 0 0 1 /end COMPU_METHOD
/begin COMPU_METHOD UMR_PROZENT__20_51_0_S5_S3 "int = ((phys * 51) / 20) - (0) [%]" RAT_FUNC "%5.4" "[%]" COEFFS 0 2.55 0 0 0 1 /end COMPU_METHOD
/begin COMPU_METHOD UMR_U_MIN_1_1_0_S5_S3 "int = ((phys * 1) / 1) - (0) [U/min]" RAT_FUNC "%1.0" "[U/min]" COEFFS 0 1 0 0 0 1 /end COMPU_METHOD
/begin COMPU_METHOD UMR_U_MIN_32_1_0_S5_S3 "int = ((phys * 1) / 32) - (0) [U/min]" RAT_FUNC "%1.0" "[U/min]" COEFFS 0 0.03125 0 0 0 1 /end COMPU_METHOD
/begin CHARACTERISTIC KF_FMEHAUPTGEDKINMOT_8 "Faktor auf Haupt-ME f(dki) Gangeinlegen D1 bis D6" MAP 0x1A9BC0 ZF_kf_ui8_S5_S3 100 UMR_PROZENT__20_51_0_S5_S3 0 100
 /begin AXIS_DESCR STD_AXIS zff_atsys._.iSignale._.obj.sig_dki UMR_PROZENT__20_51_0_S5_S3 4 0 100 DEPOSIT ABSOLUTE /end AXIS_DESCR
 /begin AXIS_DESCR STD_AXIS zff_atsys._.iSignale._.obj.sig_n_mot8 UMR_U_MIN_32_1_0_S5_S3 4 0 8160 DEPOSIT ABSOLUTE /end AXIS_DESCR
/end CHARACTERISTIC
/begin CHARACTERISTIC KF_FMEHAUPTGEDKINMOT_R "Faktor auf Haupt-ME f(dki) Gangeinlegen D1 bis D6" MAP 0x1A95A0 ZF_kf_ui8_S5_S3 100 UMR_PROZENT__20_51_0_S5_S3 0 100
 /begin AXIS_DESCR STD_AXIS zff_atsys._.iSignale._.obj.sig_dki UMR_PROZENT__20_51_0_S5_S3 4 0 100 DEPOSIT ABSOLUTE /end AXIS_DESCR
 /begin AXIS_DESCR STD_AXIS zff_atsys._.iSignale._.obj.sig_n_mot8 UMR_U_MIN_32_1_0_S5_S3 4 0 8160 DEPOSIT ABSOLUTE /end AXIS_DESCR
/end CHARACTERISTIC
/begin CHARACTERISTIC KF_FMESASMEHAUPTPOSE21 "Faktor fuer Reduzierung pos ME bei RS" MAP 0x1AAD70 ZF_kf_si16_S5_S3 1 UMR___1_100_0_S5_S3 0 1
 /begin AXIS_DESCR STD_AXIS iMoeMesaf.timer_rampe_pos UMR_MSEC__10_1_0_S5_S3 4 0 2550 DEPOSIT ABSOLUTE /end AXIS_DESCR
 /begin AXIS_DESCR STD_AXIS iMoeMesaf.me_sas_gesp UMR_NM__1_1_0_S5_S3 4 0 1500 DEPOSIT ABSOLUTE /end AXIS_DESCR
/end CHARACTERISTIC
/begin CHARACTERISTIC KF_FMESASMEHAUPTPOSE32 "Faktor fuer Reduzierung pos ME bei RS" MAP 0x1AAF7C ZF_kf_si16_S5_S3 1 UMR___1_100_0_S5_S3 0 1
 /begin AXIS_DESCR STD_AXIS iMoeMesaf.timer_rampe_pos UMR_MSEC__10_1_0_S5_S3 4 0 2550 DEPOSIT ABSOLUTE /end AXIS_DESCR
 /begin AXIS_DESCR STD_AXIS iMoeMesaf.me_sas_gesp UMR_NM__1_1_0_S5_S3 4 0 1500 DEPOSIT ABSOLUTE /end AXIS_DESCR
/end CHARACTERISTIC
/begin CHARACTERISTIC KF_FMESASMEHAUPTPOSE43 "Faktor fuer Reduzierung pos ME bei RS" MAP 0x1AB188 ZF_kf_si16_S5_S3 1 UMR___1_100_0_S5_S3 0 1
 /begin AXIS_DESCR STD_AXIS iMoeMesaf.timer_rampe_pos UMR_MSEC__10_1_0_S5_S3 4 0 2550 DEPOSIT ABSOLUTE /end AXIS_DESCR
 /begin AXIS_DESCR STD_AXIS iMoeMesaf.me_sas_gesp UMR_NM__1_1_0_S5_S3 4 0 1500 DEPOSIT ABSOLUTE /end AXIS_DESCR
/end CHARACTERISTIC
/begin CHARACTERISTIC KF_FMESASMEHAUPTPOSE54 "Faktor fuer Reduzierung pos ME bei RS" MAP 0x1AB394 ZF_kf_si16_S5_S3 1 UMR___1_100_0_S5_S3 0 1
 /begin AXIS_DESCR STD_AXIS iMoeMesaf.timer_rampe_pos UMR_MSEC__10_1_0_S5_S3 4 0 2550 DEPOSIT ABSOLUTE /end AXIS_DESCR
 /begin AXIS_DESCR STD_AXIS iMoeMesaf.me_sas_gesp UMR_NM__1_1_0_S5_S3 4 0 1500 DEPOSIT ABSOLUTE /end AXIS_DESCR
/end CHARACTERISTIC
/begin CHARACTERISTIC KF_FMESASMEHAUPTPOSE65 "Faktor fuer Reduzierung pos ME bei RS" MAP 0x1AB5A0 ZF_kf_si16_S5_S3 1 UMR___1_100_0_S5_S3 0 1
 /begin AXIS_DESCR STD_AXIS iMoeMesaf.timer_rampe_pos UMR_MSEC__10_1_0_S5_S3 4 0 2550 DEPOSIT ABSOLUTE /end AXIS_DESCR
 /begin AXIS_DESCR STD_AXIS iMoeMesaf.me_sas_gesp UMR_NM__1_1_0_S5_S3 4 0 1500 DEPOSIT ABSOLUTE /end AXIS_DESCR
/end CHARACTERISTIC
/begin CHARACTERISTIC KF_FMESASMEHAUPTPOSE76 "Faktor fuer Reduzierung pos ME bei RS" MAP 0x1AB7AC ZF_kf_si16_S5_S3 1 UMR___1_100_0_S5_S3 0 1
 /begin AXIS_DESCR STD_AXIS iMoeMesaf.timer_rampe_pos UMR_MSEC__10_1_0_S5_S3 4 0 2550 DEPOSIT ABSOLUTE /end AXIS_DESCR
 /begin AXIS_DESCR STD_AXIS iMoeMesaf.me_sas_gesp UMR_NM__1_1_0_S5_S3 4 0 1500 DEPOSIT ABSOLUTE /end AXIS_DESCR
/end CHARACTERISTIC
/begin CHARACTERISTIC KF_FMESASMEHAUPTPOSE87 "Faktor fuer Reduzierung pos ME bei RS" MAP 0x1AB9B8 ZF_kf_si16_S5_S3 1 UMR___1_100_0_S5_S3 0 1
 /begin AXIS_DESCR STD_AXIS iMoeMesaf.timer_rampe_pos UMR_MSEC__10_1_0_S5_S3 4 0 2550 DEPOSIT ABSOLUTE /end AXIS_DESCR
 /begin AXIS_DESCR STD_AXIS iMoeMesaf.me_sas_gesp UMR_NM__1_1_0_S5_S3 4 0 1500 DEPOSIT ABSOLUTE /end AXIS_DESCR
/end CHARACTERISTIC
/begin CHARACTERISTIC KF_FMESASMEHAUPTPOSESP21 "Faktor fuer Reduzierung pos ME bei RS" MAP 0x1ABAF0 ZF_kf_si16_S5_S3 1 UMR___1_100_0_S5_S3 0 1
 /begin AXIS_DESCR STD_AXIS iMoeMesaf.timer_rampe_pos UMR_MSEC__10_1_0_S5_S3 4 0 2550 DEPOSIT ABSOLUTE /end AXIS_DESCR
 /begin AXIS_DESCR STD_AXIS iMoeMesaf.me_sas_gesp UMR_NM__1_1_0_S5_S3 4 0 1500 DEPOSIT ABSOLUTE /end AXIS_DESCR
/end CHARACTERISTIC
/begin CHARACTERISTIC KF_FMESASMEHAUPTPOSESP31 "Faktor fuer Reduzierung pos ME bei RS" MAP 0x1AC378 ZF_kf_si16_S5_S3 1 UMR___1_100_0_S5_S3 0 1
 /begin AXIS_DESCR STD_AXIS iMoeMesaf.timer_rampe_pos UMR_MSEC__10_1_0_S5_S3 4 0 2550 DEPOSIT ABSOLUTE /end AXIS_DESCR
 /begin AXIS_DESCR STD_AXIS iMoeMesaf.me_sas_gesp UMR_NM__1_1_0_S5_S3 4 0 1500 DEPOSIT ABSOLUTE /end AXIS_DESCR
/end CHARACTERISTIC
/begin CHARACTERISTIC KF_FMESASMEHAUPTPOSESP32 "Faktor fuer Reduzierung pos ME bei RS" MAP 0x1ABC28 ZF_kf_si16_S5_S3 1 UMR___1_100_0_S5_S3 0 1
 /begin AXIS_DESCR STD_AXIS iMoeMesaf.timer_rampe_pos UMR_MSEC__10_1_0_S5_S3 4 0 2550 DEPOSIT ABSOLUTE /end AXIS_DESCR
 /begin AXIS_DESCR STD_AXIS iMoeMesaf.me_sas_gesp UMR_NM__1_1_0_S5_S3 4 0 1500 DEPOSIT ABSOLUTE /end AXIS_DESCR
/end CHARACTERISTIC
/begin CHARACTERISTIC KF_FMESASMEHAUPTPOSESP42 "Faktor fuer Reduzierung pos ME bei RS" MAP 0x1AC4B0 ZF_kf_si16_S5_S3 1 UMR___1_100_0_S5_S3 0 1
 /begin AXIS_DESCR STD_AXIS iMoeMesaf.timer_rampe_pos UMR_MSEC__10_1_0_S5_S3 4 0 2550 DEPOSIT ABSOLUTE /end AXIS_DESCR
 /begin AXIS_DESCR STD_AXIS iMoeMesaf.me_sas_gesp UMR_NM__1_1_0_S5_S3 4 0 1500 DEPOSIT ABSOLUTE /end AXIS_DESCR
/end CHARACTERISTIC
/begin CHARACTERISTIC KF_FMESASMEHAUPTPOSESP43 "Faktor fuer Reduzierung pos ME bei RS" MAP 0x1ABD60 ZF_kf_si16_S5_S3 1 UMR___1_100_0_S5_S3 0 1
 /begin AXIS_DESCR STD_AXIS iMoeMesaf.timer_rampe_pos UMR_MSEC__10_1_0_S5_S3 4 0 2550 DEPOSIT ABSOLUTE /end AXIS_DESCR
 /begin AXIS_DESCR STD_AXIS iMoeMesaf.me_sas_gesp UMR_NM__1_1_0_S5_S3 4 0 1500 DEPOSIT ABSOLUTE /end AXIS_DESCR
/end CHARACTERISTIC
/begin CHARACTERISTIC KF_FMESASMEHAUPTPOSESP51 "Faktor fuer Reduzierung pos ME bei RS" MAP 0x1AC5E8 ZF_kf_si16_S5_S3 1 UMR___1_100_0_S5_S3 0 1
 /begin AXIS_DESCR STD_AXIS iMoeMesaf.timer_rampe_pos UMR_MSEC__10_1_0_S5_S3 4 0 2550 DEPOSIT ABSOLUTE /end AXIS_DESCR
 /begin AXIS_DESCR STD_AXIS iMoeMesaf.me_sas_gesp UMR_NM__1_1_0_S5_S3 4 0 1500 DEPOSIT ABSOLUTE /end AXIS_DESCR
/end CHARACTERISTIC
/begin CHARACTERISTIC KF_FMESASMEHAUPTPOSESP53 "Faktor fuer Reduzierung pos ME bei RS" MAP 0x1AC720 ZF_kf_si16_S5_S3 1 UMR___1_100_0_S5_S3 0 1
 /begin AXIS_DESCR STD_AXIS iMoeMesaf.timer_rampe_pos UMR_MSEC__10_1_0_S5_S3 4 0 2550 DEPOSIT ABSOLUTE /end AXIS_DESCR
 /begin AXIS_DESCR STD_AXIS iMoeMesaf.me_sas_gesp UMR_NM__1_1_0_S5_S3 4 0 1500 DEPOSIT ABSOLUTE /end AXIS_DESCR
/end CHARACTERISTIC
/begin CHARACTERISTIC KF_FMESASMEHAUPTPOSESP54 "Faktor fuer Reduzierung pos ME bei RS" MAP 0x1ABE98 ZF_kf_si16_S5_S3 1 UMR___1_100_0_S5_S3 0 1
 /begin AXIS_DESCR STD_AXIS iMoeMesaf.timer_rampe_pos UMR_MSEC__10_1_0_S5_S3 4 0 2550 DEPOSIT ABSOLUTE /end AXIS_DESCR
 /begin AXIS_DESCR STD_AXIS iMoeMesaf.me_sas_gesp UMR_NM__1_1_0_S5_S3 4 0 1500 DEPOSIT ABSOLUTE /end AXIS_DESCR
/end CHARACTERISTIC
/begin CHARACTERISTIC KF_FMESASMEHAUPTPOSESP63 "Faktor fuer Reduzierung pos ME bei RS" MAP 0x1AC858 ZF_kf_si16_S5_S3 1 UMR___1_100_0_S5_S3 0 1
 /begin AXIS_DESCR STD_AXIS iMoeMesaf.timer_rampe_pos UMR_MSEC__10_1_0_S5_S3 4 0 2550 DEPOSIT ABSOLUTE /end AXIS_DESCR
 /begin AXIS_DESCR STD_AXIS iMoeMesaf.me_sas_gesp UMR_NM__1_1_0_S5_S3 4 0 1500 DEPOSIT ABSOLUTE /end AXIS_DESCR
/end CHARACTERISTIC
/begin CHARACTERISTIC KF_FMESASMEHAUPTPOSESP64 "Faktor fuer Reduzierung pos ME bei RS" MAP 0x1AC990 ZF_kf_si16_S5_S3 1 UMR___1_100_0_S5_S3 0 1
 /begin AXIS_DESCR STD_AXIS iMoeMesaf.timer_rampe_pos UMR_MSEC__10_1_0_S5_S3 4 0 2550 DEPOSIT ABSOLUTE /end AXIS_DESCR
 /begin AXIS_DESCR STD_AXIS iMoeMesaf.me_sas_gesp UMR_NM__1_1_0_S5_S3 4 0 1500 DEPOSIT ABSOLUTE /end AXIS_DESCR
/end CHARACTERISTIC
/begin CHARACTERISTIC KF_FMESASMEHAUPTPOSESP65 "Faktor fuer Reduzierung pos ME bei RS" MAP 0x1ABFD0 ZF_kf_si16_S5_S3 1 UMR___1_100_0_S5_S3 0 1
 /begin AXIS_DESCR STD_AXIS iMoeMesaf.timer_rampe_pos UMR_MSEC__10_1_0_S5_S3 4 0 2550 DEPOSIT ABSOLUTE /end AXIS_DESCR
 /begin AXIS_DESCR STD_AXIS iMoeMesaf.me_sas_gesp UMR_NM__1_1_0_S5_S3 4 0 1500 DEPOSIT ABSOLUTE /end AXIS_DESCR
/end CHARACTERISTIC
/begin CHARACTERISTIC KF_FMESASMEHAUPTPOSESP71 "Faktor fuer Reduzierung pos ME bei RS" MAP 0x1ACAC8 ZF_kf_si16_S5_S3 1 UMR___1_100_0_S5_S3 0 1
 /begin AXIS_DESCR STD_AXIS iMoeMesaf.timer_rampe_pos UMR_MSEC__10_1_0_S5_S3 4 0 2550 DEPOSIT ABSOLUTE /end AXIS_DESCR
 /begin AXIS_DESCR STD_AXIS iMoeMesaf.me_sas_gesp UMR_NM__1_1_0_S5_S3 4 0 1500 DEPOSIT ABSOLUTE /end AXIS_DESCR
/end CHARACTERISTIC
/begin CHARACTERISTIC KF_FMESASMEHAUPTPOSESP75 "Faktor fuer Reduzierung pos ME bei RS" MAP 0x1ACC00 ZF_kf_si16_S5_S3 1 UMR___1_100_0_S5_S3 0 1
 /begin AXIS_DESCR STD_AXIS iMoeMesaf.timer_rampe_pos UMR_MSEC__10_1_0_S5_S3 4 0 2550 DEPOSIT ABSOLUTE /end AXIS_DESCR
 /begin AXIS_DESCR STD_AXIS iMoeMesaf.me_sas_gesp UMR_NM__1_1_0_S5_S3 4 0 1500 DEPOSIT ABSOLUTE /end AXIS_DESCR
/end CHARACTERISTIC
/begin CHARACTERISTIC KF_FMESASMEHAUPTPOSESP76 "Faktor fuer Reduzierung pos ME bei RS" MAP 0x1AC108 ZF_kf_si16_S5_S3 1 UMR___1_100_0_S5_S3 0 1
 /begin AXIS_DESCR STD_AXIS iMoeMesaf.timer_rampe_pos UMR_MSEC__10_1_0_S5_S3 4 0 2550 DEPOSIT ABSOLUTE /end AXIS_DESCR
 /begin AXIS_DESCR STD_AXIS iMoeMesaf.me_sas_gesp UMR_NM__1_1_0_S5_S3 4 0 1500 DEPOSIT ABSOLUTE /end AXIS_DESCR
/end CHARACTERISTIC
/begin CHARACTERISTIC KF_FMESASMEHAUPTPOSESP82 "Faktor fuer Reduzierung pos ME bei RS" MAP 0x1ACD38 ZF_kf_si16_S5_S3 1 UMR___1_100_0_S5_S3 0 1
 /begin AXIS_DESCR STD_AXIS iMoeMesaf.timer_rampe_pos UMR_MSEC__10_1_0_S5_S3 4 0 2550 DEPOSIT ABSOLUTE /end AXIS_DESCR
 /begin AXIS_DESCR STD_AXIS iMoeMesaf.me_sas_gesp UMR_NM__1_1_0_S5_S3 4 0 1500 DEPOSIT ABSOLUTE /end AXIS_DESCR
/end CHARACTERISTIC
/begin CHARACTERISTIC KF_FMESASMEHAUPTPOSESP84 "Faktor fuer Reduzierung pos ME bei RS" MAP 0x1ACE70 ZF_kf_si16_S5_S3 1 UMR___1_100_0_S5_S3 0 1
 /begin AXIS_DESCR STD_AXIS iMoeMesaf.timer_rampe_pos UMR_MSEC__10_1_0_S5_S3 4 0 2550 DEPOSIT ABSOLUTE /end AXIS_DESCR
 /begin AXIS_DESCR STD_AXIS iMoeMesaf.me_sas_gesp UMR_NM__1_1_0_S5_S3 4 0 1500 DEPOSIT ABSOLUTE /end AXIS_DESCR
/end CHARACTERISTIC
/begin CHARACTERISTIC KF_FMESASMEHAUPTPOSESP86 "Faktor fuer Reduzierung pos ME bei RS" MAP 0x1ACFA8 ZF_kf_si16_S5_S3 1 UMR___1_100_0_S5_S3 0 1
 /begin AXIS_DESCR STD_AXIS iMoeMesaf.timer_rampe_pos UMR_MSEC__10_1_0_S5_S3 4 0 2550 DEPOSIT ABSOLUTE /end AXIS_DESCR
 /begin AXIS_DESCR STD_AXIS iMoeMesaf.me_sas_gesp UMR_NM__1_1_0_S5_S3 4 0 1500 DEPOSIT ABSOLUTE /end AXIS_DESCR
/end CHARACTERISTIC
/begin CHARACTERISTIC KF_FMESASMEHAUPTPOSESP87 "Faktor fuer Reduzierung pos ME bei RS" MAP 0x1AC240 ZF_kf_si16_S5_S3 1 UMR___1_100_0_S5_S3 0 1
 /begin AXIS_DESCR STD_AXIS iMoeMesaf.timer_rampe_pos UMR_MSEC__10_1_0_S5_S3 4 0 2550 DEPOSIT ABSOLUTE /end AXIS_DESCR
 /begin AXIS_DESCR STD_AXIS iMoeMesaf.me_sas_gesp UMR_NM__1_1_0_S5_S3 4 0 1500 DEPOSIT ABSOLUTE /end AXIS_DESCR
/end CHARACTERISTIC
/begin CHARACTERISTIC KF_FMESASMEHAUPTPOSESPORT21 "Faktor fuer Reduzierung pos ME bei RS" MAP 0x1AD0E0 ZF_kf_si16_S5_S3 1 UMR___1_100_0_S5_S3 0 1
 /begin AXIS_DESCR STD_AXIS iMoeMesaf.timer_rampe_pos UMR_MSEC__10_1_0_S5_S3 4 0 2550 DEPOSIT ABSOLUTE /end AXIS_DESCR
 /begin AXIS_DESCR STD_AXIS iMoeMesaf.me_sas_gesp UMR_NM__1_1_0_S5_S3 4 0 1500 DEPOSIT ABSOLUTE /end AXIS_DESCR
/end CHARACTERISTIC
/begin CHARACTERISTIC KF_FMESASMEHAUPTPOSESPORT31 "Faktor fuer Reduzierung pos ME bei RS" MAP 0x1AD968 ZF_kf_si16_S5_S3 1 UMR___1_100_0_S5_S3 0 1
 /begin AXIS_DESCR STD_AXIS iMoeMesaf.timer_rampe_pos UMR_MSEC__10_1_0_S5_S3 4 0 2550 DEPOSIT ABSOLUTE /end AXIS_DESCR
 /begin AXIS_DESCR STD_AXIS iMoeMesaf.me_sas_gesp UMR_NM__1_1_0_S5_S3 4 0 1500 DEPOSIT ABSOLUTE /end AXIS_DESCR
/end CHARACTERISTIC
/begin CHARACTERISTIC KF_FMESASMEHAUPTPOSESPORT32 "Faktor fuer Reduzierung pos ME bei RS" MAP 0x1AD218 ZF_kf_si16_S5_S3 1 UMR___1_100_0_S5_S3 0 1
 /begin AXIS_DESCR STD_AXIS iMoeMesaf.timer_rampe_pos UMR_MSEC__10_1_0_S5_S3 4 0 2550 DEPOSIT ABSOLUTE /end AXIS_DESCR
 /begin AXIS_DESCR STD_AXIS iMoeMesaf.me_sas_gesp UMR_NM__1_1_0_S5_S3 4 0 1500 DEPOSIT ABSOLUTE /end AXIS_DESCR
/end CHARACTERISTIC
/begin CHARACTERISTIC KF_FMESASMEHAUPTPOSESPORT42 "Faktor fuer Reduzierung pos ME bei RS" MAP 0x1ADAA0 ZF_kf_si16_S5_S3 1 UMR___1_100_0_S5_S3 0 1
 /begin AXIS_DESCR STD_AXIS iMoeMesaf.timer_rampe_pos UMR_MSEC__10_1_0_S5_S3 4 0 2550 DEPOSIT ABSOLUTE /end AXIS_DESCR
 /begin AXIS_DESCR STD_AXIS iMoeMesaf.me_sas_gesp UMR_NM__1_1_0_S5_S3 4 0 1500 DEPOSIT ABSOLUTE /end AXIS_DESCR
/end CHARACTERISTIC
/begin CHARACTERISTIC KF_FMESASMEHAUPTPOSESPORT43 "Faktor fuer Reduzierung pos ME bei RS" MAP 0x1AD350 ZF_kf_si16_S5_S3 1 UMR___1_100_0_S5_S3 0 1
 /begin AXIS_DESCR STD_AXIS iMoeMesaf.timer_rampe_pos UMR_MSEC__10_1_0_S5_S3 4 0 2550 DEPOSIT ABSOLUTE /end AXIS_DESCR
 /begin AXIS_DESCR STD_AXIS iMoeMesaf.me_sas_gesp UMR_NM__1_1_0_S5_S3 4 0 1500 DEPOSIT ABSOLUTE /end AXIS_DESCR
/end CHARACTERISTIC
/begin CHARACTERISTIC KF_FMESASMEHAUPTPOSESPORT51 "Faktor fuer Reduzierung pos ME bei RS" MAP 0x1ADBD8 ZF_kf_si16_S5_S3 1 UMR___1_100_0_S5_S3 0 1
 /begin AXIS_DESCR STD_AXIS iMoeMesaf.timer_rampe_pos UMR_MSEC__10_1_0_S5_S3 4 0 2550 DEPOSIT ABSOLUTE /end AXIS_DESCR
 /begin AXIS_DESCR STD_AXIS iMoeMesaf.me_sas_gesp UMR_NM__1_1_0_S5_S3 4 0 1500 DEPOSIT ABSOLUTE /end AXIS_DESCR
/end CHARACTERISTIC
/begin CHARACTERISTIC KF_FMESASMEHAUPTPOSESPORT53 "Faktor fuer Reduzierung pos ME bei RS" MAP 0x1ADD10 ZF_kf_si16_S5_S3 1 UMR___1_100_0_S5_S3 0 1
 /begin AXIS_DESCR STD_AXIS iMoeMesaf.timer_rampe_pos UMR_MSEC__10_1_0_S5_S3 4 0 2550 DEPOSIT ABSOLUTE /end AXIS_DESCR
 /begin AXIS_DESCR STD_AXIS iMoeMesaf.me_sas_gesp UMR_NM__1_1_0_S5_S3 4 0 1500 DEPOSIT ABSOLUTE /end AXIS_DESCR
/end CHARACTERISTIC
/begin CHARACTERISTIC KF_FMESASMEHAUPTPOSESPORT54 "Faktor fuer Reduzierung pos ME bei RS" MAP 0x1AD488 ZF_kf_si16_S5_S3 1 UMR___1_100_0_S5_S3 0 1
 /begin AXIS_DESCR STD_AXIS iMoeMesaf.timer_rampe_pos UMR_MSEC__10_1_0_S5_S3 4 0 2550 DEPOSIT ABSOLUTE /end AXIS_DESCR
 /begin AXIS_DESCR STD_AXIS iMoeMesaf.me_sas_gesp UMR_NM__1_1_0_S5_S3 4 0 1500 DEPOSIT ABSOLUTE /end AXIS_DESCR
/end CHARACTERISTIC
/begin CHARACTERISTIC KF_FMESASMEHAUPTPOSESPORT63 "Faktor fuer Reduzierung pos ME bei RS" MAP 0x1ADE48 ZF_kf_si16_S5_S3 1 UMR___1_100_0_S5_S3 0 1
 /begin AXIS_DESCR STD_AXIS iMoeMesaf.timer_rampe_pos UMR_MSEC__10_1_0_S5_S3 4 0 2550 DEPOSIT ABSOLUTE /end AXIS_DESCR
 /begin AXIS_DESCR STD_AXIS iMoeMesaf.me_sas_gesp UMR_NM__1_1_0_S5_S3 4 0 1500 DEPOSIT ABSOLUTE /end AXIS_DESCR
/end CHARACTERISTIC
/begin CHARACTERISTIC KF_FMESASMEHAUPTPOSESPORT64 "Faktor fuer Reduzierung pos ME bei RS" MAP 0x1ADF80 ZF_kf_si16_S5_S3 1 UMR___1_100_0_S5_S3 0 1
 /begin AXIS_DESCR STD_AXIS iMoeMesaf.timer_rampe_pos UMR_MSEC__10_1_0_S5_S3 4 0 2550 DEPOSIT ABSOLUTE /end AXIS_DESCR
 /begin AXIS_DESCR STD_AXIS iMoeMesaf.me_sas_gesp UMR_NM__1_1_0_S5_S3 4 0 1500 DEPOSIT ABSOLUTE /end AXIS_DESCR
/end CHARACTERISTIC
/begin CHARACTERISTIC KF_FMTMEHAUPTA21 "Faktor fuer Rampe auf HME bei RS" MAP 0x1AAC28 ZF_kf_ui8_S5_S3 1 UMR___1_100_0_S5_S3 0 1
 /begin AXIS_DESCR STD_AXIS iMoeMesaf.timer_zmes UMR_MSEC__10_1_0_S5_S3 4 0 2550 DEPOSIT ABSOLUTE /end AXIS_DESCR
 /begin AXIS_DESCR STD_AXIS zff_atsys._.iSignale._.obj.sig_m_t8 UMR_NM__6_1_M34_S5_S3 4 -204 1326 DEPOSIT ABSOLUTE /end AXIS_DESCR
/end CHARACTERISTIC
/begin CHARACTERISTIC KF_FMTMEHAUPTA32 "Faktor fuer Rampe auf HME bei RS" MAP 0x1AAE34 ZF_kf_ui8_S5_S3 1 UMR___1_100_0_S5_S3 0 1
 /begin AXIS_DESCR STD_AXIS iMoeMesaf.timer_zmes UMR_MSEC__10_1_0_S5_S3 4 0 2550 DEPOSIT ABSOLUTE /end AXIS_DESCR
 /begin AXIS_DESCR STD_AXIS zff_atsys._.iSignale._.obj.sig_m_t8 UMR_NM__6_1_M34_S5_S3 4 -204 1326 DEPOSIT ABSOLUTE /end AXIS_DESCR
/end CHARACTERISTIC
/begin CHARACTERISTIC KF_FMTMEHAUPTA43 "Faktor fuer Rampe auf HME bei RS" MAP 0x1AB040 ZF_kf_ui8_S5_S3 1 UMR___1_100_0_S5_S3 0 1
 /begin AXIS_DESCR STD_AXIS iMoeMesaf.timer_zmes UMR_MSEC__10_1_0_S5_S3 4 0 2550 DEPOSIT ABSOLUTE /end AXIS_DESCR
 /begin AXIS_DESCR STD_AXIS zff_atsys._.iSignale._.obj.sig_m_t8 UMR_NM__6_1_M34_S5_S3 4 -204 1326 DEPOSIT ABSOLUTE /end AXIS_DESCR
/end CHARACTERISTIC
/begin CHARACTERISTIC KF_FMTMEHAUPTA54 "Faktor fuer Rampe auf HME bei RS" MAP 0x1AB24C ZF_kf_ui8_S5_S3 1 UMR___1_100_0_S5_S3 0 1
 /begin AXIS_DESCR STD_AXIS iMoeMesaf.timer_zmes UMR_MSEC__10_1_0_S5_S3 4 0 2550 DEPOSIT ABSOLUTE /end AXIS_DESCR
 /begin AXIS_DESCR STD_AXIS zff_atsys._.iSignale._.obj.sig_m_t8 UMR_NM__6_1_M34_S5_S3 4 -204 1326 DEPOSIT ABSOLUTE /end AXIS_DESCR
/end CHARACTERISTIC
/begin CHARACTERISTIC KF_FMTMEHAUPTA65 "Faktor fuer Rampe auf HME bei RS" MAP 0x1AB458 ZF_kf_ui8_S5_S3 1 UMR___1_100_0_S5_S3 0 1
 /begin AXIS_DESCR STD_AXIS iMoeMesaf.timer_zmes UMR_MSEC__10_1_0_S5_S3 4 0 2550 DEPOSIT ABSOLUTE /end AXIS_DESCR
 /begin AXIS_DESCR STD_AXIS zff_atsys._.iSignale._.obj.sig_m_t8 UMR_NM__6_1_M34_S5_S3 4 -204 1326 DEPOSIT ABSOLUTE /end AXIS_DESCR
/end CHARACTERISTIC
/begin CHARACTERISTIC KF_FMTMEHAUPTA76 "Faktor fuer Rampe auf HME bei RS" MAP 0x1AB664 ZF_kf_ui8_S5_S3 1 UMR___1_100_0_S5_S3 0 1
 /begin AXIS_DESCR STD_AXIS iMoeMesaf.timer_zmes UMR_MSEC__10_1_0_S5_S3 4 0 2550 DEPOSIT ABSOLUTE /end AXIS_DESCR
 /begin AXIS_DESCR STD_AXIS zff_atsys._.iSignale._.obj.sig_m_t8 UMR_NM__6_1_M34_S5_S3 4 -204 1326 DEPOSIT ABSOLUTE /end AXIS_DESCR
/end CHARACTERISTIC
/begin CHARACTERISTIC KF_FMTMEHAUPTA87 "Faktor fuer Rampe auf HME bei RS" MAP 0x1AB870 ZF_kf_ui8_S5_S3 1 UMR___1_100_0_S5_S3 0 1
 /begin AXIS_DESCR STD_AXIS iMoeMesaf.timer_zmes UMR_MSEC__10_1_0_S5_S3 4 0 2550 DEPOSIT ABSOLUTE /end AXIS_DESCR
 /begin AXIS_DESCR STD_AXIS zff_atsys._.iSignale._.obj.sig_m_t8 UMR_NM__6_1_M34_S5_S3 4 -204 1326 DEPOSIT ABSOLUTE /end AXIS_DESCR
/end CHARACTERISTIC
/begin CHARACTERISTIC KF_FMTMEHAUPTASP21 "Faktor fuer Rampe auf HME bei RS" MAP 0x1ABA3C ZF_kf_ui8_S5_S3 1 UMR___1_100_0_S5_S3 0 1
 /begin AXIS_DESCR STD_AXIS iMoeMesaf.timer_zmes UMR_MSEC__10_1_0_S5_S3 4 0 2550 DEPOSIT ABSOLUTE /end AXIS_DESCR
 /begin AXIS_DESCR STD_AXIS zff_atsys._.iSignale._.obj.sig_m_t8 UMR_NM__6_1_M34_S5_S3 4 -204 1326 DEPOSIT ABSOLUTE /end AXIS_DESCR
/end CHARACTERISTIC
/begin CHARACTERISTIC KF_FMTMEHAUPTASP31 "Faktor fuer Rampe auf HME bei RS" MAP 0x1AC2C4 ZF_kf_ui8_S5_S3 1 UMR___1_100_0_S5_S3 0 1
 /begin AXIS_DESCR STD_AXIS iMoeMesaf.timer_zmes UMR_MSEC__10_1_0_S5_S3 4 0 2550 DEPOSIT ABSOLUTE /end AXIS_DESCR
 /begin AXIS_DESCR STD_AXIS zff_atsys._.iSignale._.obj.sig_m_t8 UMR_NM__6_1_M34_S5_S3 4 -204 1326 DEPOSIT ABSOLUTE /end AXIS_DESCR
/end CHARACTERISTIC
/begin CHARACTERISTIC KF_FMTMEHAUPTASP32 "Faktor fuer Rampe auf HME bei RS" MAP 0x1ABB74 ZF_kf_ui8_S5_S3 1 UMR___1_100_0_S5_S3 0 1
 /begin AXIS_DESCR STD_AXIS iMoeMesaf.timer_zmes UMR_MSEC__10_1_0_S5_S3 4 0 2550 DEPOSIT ABSOLUTE /end AXIS_DESCR
 /begin AXIS_DESCR STD_AXIS zff_atsys._.iSignale._.obj.sig_m_t8 UMR_NM__6_1_M34_S5_S3 4 -204 1326 DEPOSIT ABSOLUTE /end AXIS_DESCR
/end CHARACTERISTIC
/begin CHARACTERISTIC KF_FMTMEHAUPTASP42 "Faktor fuer Rampe auf HME bei RS" MAP 0x1AC3FC ZF_kf_ui8_S5_S3 1 UMR___1_100_0_S5_S3 0 1
 /begin AXIS_DESCR STD_AXIS iMoeMesaf.timer_zmes UMR_MSEC__10_1_0_S5_S3 4 0 2550 DEPOSIT ABSOLUTE /end AXIS_DESCR
 /begin AXIS_DESCR STD_AXIS zff_atsys._.iSignale._.obj.sig_m_t8 UMR_NM__6_1_M34_S5_S3 4 -204 1326 DEPOSIT ABSOLUTE /end AXIS_DESCR
/end CHARACTERISTIC
/begin CHARACTERISTIC KF_FMTMEHAUPTASP43 "Faktor fuer Rampe auf HME bei RS" MAP 0x1ABCAC ZF_kf_ui8_S5_S3 1 UMR___1_100_0_S5_S3 0 1
 /begin AXIS_DESCR STD_AXIS iMoeMesaf.timer_zmes UMR_MSEC__10_1_0_S5_S3 4 0 2550 DEPOSIT ABSOLUTE /end AXIS_DESCR
 /begin AXIS_DESCR STD_AXIS zff_atsys._.iSignale._.obj.sig_m_t8 UMR_NM__6_1_M34_S5_S3 4 -204 1326 DEPOSIT ABSOLUTE /end AXIS_DESCR
/end CHARACTERISTIC
/begin CHARACTERISTIC KF_FMTMEHAUPTASP51 "Faktor fuer Rampe auf HME bei RS" MAP 0x1AC534 ZF_kf_ui8_S5_S3 1 UMR___1_100_0_S5_S3 0 1
 /begin AXIS_DESCR STD_AXIS iMoeMesaf.timer_zmes UMR_MSEC__10_1_0_S5_S3 4 0 2550 DEPOSIT ABSOLUTE /end AXIS_DESCR
 /begin AXIS_DESCR STD_AXIS zff_atsys._.iSignale._.obj.sig_m_t8 UMR_NM__6_1_M34_S5_S3 4 -204 1326 DEPOSIT ABSOLUTE /end AXIS_DESCR
/end CHARACTERISTIC
/begin CHARACTERISTIC KF_FMTMEHAUPTASP53 "Faktor fuer Rampe auf HME bei RS" MAP 0x1AC66C ZF_kf_ui8_S5_S3 1 UMR___1_100_0_S5_S3 0 1
 /begin AXIS_DESCR STD_AXIS iMoeMesaf.timer_zmes UMR_MSEC__10_1_0_S5_S3 4 0 2550 DEPOSIT ABSOLUTE /end AXIS_DESCR
 /begin AXIS_DESCR STD_AXIS zff_atsys._.iSignale._.obj.sig_m_t8 UMR_NM__6_1_M34_S5_S3 4 -204 1326 DEPOSIT ABSOLUTE /end AXIS_DESCR
/end CHARACTERISTIC
/begin CHARACTERISTIC KF_FMTMEHAUPTASP54 "Faktor fuer Rampe auf HME bei RS" MAP 0x1ABDE4 ZF_kf_ui8_S5_S3 1 UMR___1_100_0_S5_S3 0 1
 /begin AXIS_DESCR STD_AXIS iMoeMesaf.timer_zmes UMR_MSEC__10_1_0_S5_S3 4 0 2550 DEPOSIT ABSOLUTE /end AXIS_DESCR
 /begin AXIS_DESCR STD_AXIS zff_atsys._.iSignale._.obj.sig_m_t8 UMR_NM__6_1_M34_S5_S3 4 -204 1326 DEPOSIT ABSOLUTE /end AXIS_DESCR
/end CHARACTERISTIC
/begin CHARACTERISTIC KF_FMTMEHAUPTASP63 "Faktor fuer Rampe auf HME bei RS" MAP 0x1AC7A4 ZF_kf_ui8_S5_S3 1 UMR___1_100_0_S5_S3 0 1
 /begin AXIS_DESCR STD_AXIS iMoeMesaf.timer_zmes UMR_MSEC__10_1_0_S5_S3 4 0 2550 DEPOSIT ABSOLUTE /end AXIS_DESCR
 /begin AXIS_DESCR STD_AXIS zff_atsys._.iSignale._.obj.sig_m_t8 UMR_NM__6_1_M34_S5_S3 4 -204 1326 DEPOSIT ABSOLUTE /end AXIS_DESCR
/end CHARACTERISTIC
/begin CHARACTERISTIC KF_FMTMEHAUPTASP64 "Faktor fuer Rampe auf HME bei RS" MAP 0x1AC8DC ZF_kf_ui8_S5_S3 1 UMR___1_100_0_S5_S3 0 1
 /begin AXIS_DESCR STD_AXIS iMoeMesaf.timer_zmes UMR_MSEC__10_1_0_S5_S3 4 0 2550 DEPOSIT ABSOLUTE /end AXIS_DESCR
 /begin AXIS_DESCR STD_AXIS zff_atsys._.iSignale._.obj.sig_m_t8 UMR_NM__6_1_M34_S5_S3 4 -204 1326 DEPOSIT ABSOLUTE /end AXIS_DESCR
/end CHARACTERISTIC
/begin CHARACTERISTIC KF_FMTMEHAUPTASP65 "Faktor fuer Rampe auf HME bei RS" MAP 0x1ABF1C ZF_kf_ui8_S5_S3 1 UMR___1_100_0_S5_S3 0 1
 /begin AXIS_DESCR STD_AXIS iMoeMesaf.timer_zmes UMR_MSEC__10_1_0_S5_S3 4 0 2550 DEPOSIT ABSOLUTE /end AXIS_DESCR
 /begin AXIS_DESCR STD_AXIS zff_atsys._.iSignale._.obj.sig_m_t8 UMR_NM__6_1_M34_S5_S3 4 -204 1326 DEPOSIT ABSOLUTE /end AXIS_DESCR
/end CHARACTERISTIC
/begin CHARACTERISTIC KF_FMTMEHAUPTASP71 "Faktor fuer Rampe auf HME bei RS" MAP 0x1ACA14 ZF_kf_ui8_S5_S3 1 UMR___1_100_0_S5_S3 0 1
 /begin AXIS_DESCR STD_AXIS iMoeMesaf.timer_zmes UMR_MSEC__10_1_0_S5_S3 4 0 2550 DEPOSIT ABSOLUTE /end AXIS_DESCR
 /begin AXIS_DESCR STD_AXIS zff_atsys._.iSignale._.obj.sig_m_t8 UMR_NM__6_1_M34_S5_S3 4 -204 1326 DEPOSIT ABSOLUTE /end AXIS_DESCR
/end CHARACTERISTIC
/begin CHARACTERISTIC KF_FMTMEHAUPTASP75 "Faktor fuer Rampe auf HME bei RS" MAP 0x1ACB4C ZF_kf_ui8_S5_S3 1 UMR___1_100_0_S5_S3 0 1
 /begin AXIS_DESCR STD_AXIS iMoeMesaf.timer_zmes UMR_MSEC__10_1_0_S5_S3 4 0 2550 DEPOSIT ABSOLUTE /end AXIS_DESCR
 /begin AXIS_DESCR STD_AXIS zff_atsys._.iSignale._.obj.sig_m_t8 UMR_NM__6_1_M34_S5_S3 4 -204 1326 DEPOSIT ABSOLUTE /end AXIS_DESCR
/end CHARACTERISTIC
/begin CHARACTERISTIC KF_FMTMEHAUPTASP76 "Faktor fuer Rampe auf HME bei RS" MAP 0x1AC054 ZF_kf_ui8_S5_S3 1 UMR___1_100_0_S5_S3 0 1
 /begin AXIS_DESCR STD_AXIS iMoeMesaf.timer_zmes UMR_MSEC__10_1_0_S5_S3 4 0 2550 DEPOSIT ABSOLUTE /end AXIS_DESCR
 /begin AXIS_DESCR STD_AXIS zff_atsys._.iSignale._.obj.sig_m_t8 UMR_NM__6_1_M34_S5_S3 4 -204 1326 DEPOSIT ABSOLUTE /end AXIS_DESCR
/end CHARACTERISTIC
/begin CHARACTERISTIC KF_FMTMEHAUPTASP82 "Faktor fuer Rampe auf HME bei RS" MAP 0x1ACC84 ZF_kf_ui8_S5_S3 1 UMR___1_100_0_S5_S3 0 1
 /begin AXIS_DESCR STD_AXIS iMoeMesaf.timer_zmes UMR_MSEC__10_1_0_S5_S3 4 0 2550 DEPOSIT ABSOLUTE /end AXIS_DESCR
 /begin AXIS_DESCR STD_AXIS zff_atsys._.iSignale._.obj.sig_m_t8 UMR_NM__6_1_M34_S5_S3 4 -204 1326 DEPOSIT ABSOLUTE /end AXIS_DESCR
/end CHARACTERISTIC
/begin CHARACTERISTIC KF_FMTMEHAUPTASP84 "Faktor fuer Rampe auf HME bei RS" MAP 0x1ACDBC ZF_kf_ui8_S5_S3 1 UMR___1_100_0_S5_S3 0 1
 /begin AXIS_DESCR STD_AXIS iMoeMesaf.timer_zmes UMR_MSEC__10_1_0_S5_S3 4 0 2550 DEPOSIT ABSOLUTE /end AXIS_DESCR
 /begin AXIS_DESCR STD_AXIS zff_atsys._.iSignale._.obj.sig_m_t8 UMR_NM__6_1_M34_S5_S3 4 -204 1326 DEPOSIT ABSOLUTE /end AXIS_DESCR
/end CHARACTERISTIC
/begin CHARACTERISTIC KF_FMTMEHAUPTASP86 "Faktor fuer Rampe auf HME bei RS" MAP 0x1ACEF4 ZF_kf_ui8_S5_S3 1 UMR___1_100_0_S5_S3 0 1
 /begin AXIS_DESCR STD_AXIS iMoeMesaf.timer_zmes UMR_MSEC__10_1_0_S5_S3 4 0 2550 DEPOSIT ABSOLUTE /end AXIS_DESCR
 /begin AXIS_DESCR STD_AXIS zff_atsys._.iSignale._.obj.sig_m_t8 UMR_NM__6_1_M34_S5_S3 4 -204 1326 DEPOSIT ABSOLUTE /end AXIS_DESCR
/end CHARACTERISTIC
/begin CHARACTERISTIC KF_FMTMEHAUPTASP87 "Faktor fuer Rampe auf HME bei RS" MAP 0x1AC18C ZF_kf_ui8_S5_S3 1 UMR___1_100_0_S5_S3 0 1
 /begin AXIS_DESCR STD_AXIS iMoeMesaf.timer_zmes UMR_MSEC__10_1_0_S5_S3 4 0 2550 DEPOSIT ABSOLUTE /end AXIS_DESCR
 /begin AXIS_DESCR STD_AXIS zff_atsys._.iSignale._.obj.sig_m_t8 UMR_NM__6_1_M34_S5_S3 4 -204 1326 DEPOSIT ABSOLUTE /end AXIS_DESCR
/end CHARACTERISTIC
/begin CHARACTERISTIC KF_FMTMEHAUPTASPORT21 "Faktor fuer Rampe auf HME bei RS" MAP 0x1AD02C ZF_kf_ui8_S5_S3 1 UMR___1_100_0_S5_S3 0 1
 /begin AXIS_DESCR STD_AXIS iMoeMesaf.timer_zmes UMR_MSEC__10_1_0_S5_S3 4 0 2550 DEPOSIT ABSOLUTE /end AXIS_DESCR
 /begin AXIS_DESCR STD_AXIS zff_atsys._.iSignale._.obj.sig_m_t8 UMR_NM__6_1_M34_S5_S3 4 -204 1326 DEPOSIT ABSOLUTE /end AXIS_DESCR
/end CHARACTERISTIC
/begin CHARACTERISTIC KF_FMTMEHAUPTASPORT31 "Faktor fuer Rampe auf HME bei RS" MAP 0x1AD8B4 ZF_kf_ui8_S5_S3 1 UMR___1_100_0_S5_S3 0 1
 /begin AXIS_DESCR STD_AXIS iMoeMesaf.timer_zmes UMR_MSEC__10_1_0_S5_S3 4 0 2550 DEPOSIT ABSOLUTE /end AXIS_DESCR
 /begin AXIS_DESCR STD_AXIS zff_atsys._.iSignale._.obj.sig_m_t8 UMR_NM__6_1_M34_S5_S3 4 -204 1326 DEPOSIT ABSOLUTE /end AXIS_DESCR
/end CHARACTERISTIC
/begin CHARACTERISTIC KF_FMTMEHAUPTASPORT32 "Faktor fuer Rampe auf HME bei RS" MAP 0x1AD164 ZF_kf_ui8_S5_S3 1 UMR___1_100_0_S5_S3 0 1
 /begin AXIS_DESCR STD_AXIS iMoeMesaf.timer_zmes UMR_MSEC__10_1_0_S5_S3 4 0 2550 DEPOSIT ABSOLUTE /end AXIS_DESCR
 /begin AXIS_DESCR STD_AXIS zff_atsys._.iSignale._.obj.sig_m_t8 UMR_NM__6_1_M34_S5_S3 4 -204 1326 DEPOSIT ABSOLUTE /end AXIS_DESCR
/end CHARACTERISTIC
/begin CHARACTERISTIC KF_FMTMEHAUPTASPORT42 "Faktor fuer Rampe auf HME bei RS" MAP 0x1AD9EC ZF_kf_ui8_S5_S3 1 UMR___1_100_0_S5_S3 0 1
 /begin AXIS_DESCR STD_AXIS iMoeMesaf.timer_zmes UMR_MSEC__10_1_0_S5_S3 4 0 2550 DEPOSIT ABSOLUTE /end AXIS_DESCR
 /begin AXIS_DESCR STD_AXIS zff_atsys._.iSignale._.obj.sig_m_t8 UMR_NM__6_1_M34_S5_S3 4 -204 1326 DEPOSIT ABSOLUTE /end AXIS_DESCR
/end CHARACTERISTIC
/begin CHARACTERISTIC KF_FMTMEHAUPTASPORT43 "Faktor fuer Rampe auf HME bei RS" MAP 0x1AD29C ZF_kf_ui8_S5_S3 1 UMR___1_100_0_S5_S3 0 1
 /begin AXIS_DESCR STD_AXIS iMoeMesaf.timer_zmes UMR_MSEC__10_1_0_S5_S3 4 0 2550 DEPOSIT ABSOLUTE /end AXIS_DESCR
 /begin AXIS_DESCR STD_AXIS zff_atsys._.iSignale._.obj.sig_m_t8 UMR_NM__6_1_M34_S5_S3 4 -204 1326 DEPOSIT ABSOLUTE /end AXIS_DESCR
/end CHARACTERISTIC
/begin CHARACTERISTIC KF_FMTMEHAUPTASPORT51 "Faktor fuer Rampe auf HME bei RS" MAP 0x1ADB24 ZF_kf_ui8_S5_S3 1 UMR___1_100_0_S5_S3 0 1
 /begin AXIS_DESCR STD_AXIS iMoeMesaf.timer_zmes UMR_MSEC__10_1_0_S5_S3 4 0 2550 DEPOSIT ABSOLUTE /end AXIS_DESCR
 /begin AXIS_DESCR STD_AXIS zff_atsys._.iSignale._.obj.sig_m_t8 UMR_NM__6_1_M34_S5_S3 4 -204 1326 DEPOSIT ABSOLUTE /end AXIS_DESCR
/end CHARACTERISTIC
/begin CHARACTERISTIC KF_FMTMEHAUPTASPORT53 "Faktor fuer Rampe auf HME bei RS" MAP 0x1ADC5C ZF_kf_ui8_S5_S3 1 UMR___1_100_0_S5_S3 0 1
 /begin AXIS_DESCR STD_AXIS iMoeMesaf.timer_zmes UMR_MSEC__10_1_0_S5_S3 4 0 2550 DEPOSIT ABSOLUTE /end AXIS_DESCR
 /begin AXIS_DESCR STD_AXIS zff_atsys._.iSignale._.obj.sig_m_t8 UMR_NM__6_1_M34_S5_S3 4 -204 1326 DEPOSIT ABSOLUTE /end AXIS_DESCR
/end CHARACTERISTIC
/begin CHARACTERISTIC KF_FMTMEHAUPTASPORT54 "Faktor fuer Rampe auf HME bei RS" MAP 0x1AD3D4 ZF_kf_ui8_S5_S3 1 UMR___1_100_0_S5_S3 0 1
 /begin AXIS_DESCR STD_AXIS iMoeMesaf.timer_zmes UMR_MSEC__10_1_0_S5_S3 4 0 2550 DEPOSIT ABSOLUTE /end AXIS_DESCR
 /begin AXIS_DESCR STD_AXIS zff_atsys._.iSignale._.obj.sig_m_t8 UMR_NM__6_1_M34_S5_S3 4 -204 1326 DEPOSIT ABSOLUTE /end AXIS_DESCR
/end CHARACTERISTIC
/begin CHARACTERISTIC KF_FMTMEHAUPTASPORT63 "Faktor fuer Rampe auf HME bei RS" MAP 0x1ADD94 ZF_kf_ui8_S5_S3 1 UMR___1_100_0_S5_S3 0 1
 /begin AXIS_DESCR STD_AXIS iMoeMesaf.timer_zmes UMR_MSEC__10_1_0_S5_S3 4 0 2550 DEPOSIT ABSOLUTE /end AXIS_DESCR
 /begin AXIS_DESCR STD_AXIS zff_atsys._.iSignale._.obj.sig_m_t8 UMR_NM__6_1_M34_S5_S3 4 -204 1326 DEPOSIT ABSOLUTE /end AXIS_DESCR
/end CHARACTERISTIC
/begin CHARACTERISTIC KF_FMTMEHAUPTASPORT64 "Faktor fuer Rampe auf HME bei RS" MAP 0x1ADECC ZF_kf_ui8_S5_S3 1 UMR___1_100_0_S5_S3 0 1
 /begin AXIS_DESCR STD_AXIS iMoeMesaf.timer_zmes UMR_MSEC__10_1_0_S5_S3 4 0 2550 DEPOSIT ABSOLUTE /end AXIS_DESCR
 /begin AXIS_DESCR STD_AXIS zff_atsys._.iSignale._.obj.sig_m_t8 UMR_NM__6_1_M34_S5_S3 4 -204 1326 DEPOSIT ABSOLUTE /end AXIS_DESCR
/end CHARACTERISTIC
/begin CHARACTERISTIC KF_FTSYNNTMEHAUPTE_8 "Faktor auf Haupt-ME fuer Nach-ME" MAP 0x1A9C18 ZF_kf_si16_S5_S3 1 UMR___1_100_0_S5_S3 0 1
 /begin AXIS_DESCR STD_AXIS iSasZentr.iSchaltend.t_syn UMR_MSEC__10_1_0_S5_S3 4 -5000 5000 DEPOSIT ABSOLUTE /end AXIS_DESCR
 /begin AXIS_DESCR STD_AXIS zff_atsys._.iSignale._.obj.sig_n_t UMR_U_MIN_1_1_0_S5_S3 4 0 8160 DEPOSIT ABSOLUTE /end AXIS_DESCR
/end CHARACTERISTIC
/begin CHARACTERISTIC KF_FTSYNNTMEHAUPTE_R "Faktor auf Haupt-ME fuer Nach-ME" MAP 0x1A95F8 ZF_kf_si16_S5_S3 1 UMR___1_100_0_S5_S3 0 1
 /begin AXIS_DESCR STD_AXIS iSasZentr.iSchaltend.t_syn UMR_MSEC__10_1_0_S5_S3 4 -5000 5000 DEPOSIT ABSOLUTE /end AXIS_DESCR
 /begin AXIS_DESCR STD_AXIS zff_atsys._.iSignale._.obj.sig_n_t UMR_U_MIN_1_1_0_S5_S3 4 0 8160 DEPOSIT ABSOLUTE /end AXIS_DESCR
/end CHARACTERISTIC
/begin CHARACTERISTIC KF_MEHAUPT12 "Hauptmotoreingriff Schaltablauf" MAP 0x1A9C84 ZF_kf_ui8_S5_S3 1530 UMR_NM__6_1_M128_S5_S3 -768 762
 /begin AXIS_DESCR STD_AXIS iSasZentr.iSchaltend.n_tkf UMR_U_MIN_32_1_0_S5_S3 6 0 8160 DEPOSIT ABSOLUTE /end AXIS_DESCR
 /begin AXIS_DESCR STD_AXIS zff_atsys._.iSignale._.obj.sig_m_t8 UMR_NM__6_1_M34_S5_S3 10 -204 1326 DEPOSIT ABSOLUTE /end AXIS_DESCR
/end CHARACTERISTIC
/begin CHARACTERISTIC KF_MEHAUPT12_EL "Hauptmotoreingriff Schaltablauf" MAP 0x1A9CD8 ZF_kf_ui8_S5_S3 1530 UMR_NM__6_1_M128_S5_S3 -768 762
 /begin AXIS_DESCR STD_AXIS iSasZentr.iSchaltend.n_tkf UMR_U_MIN_32_1_0_S5_S3 6 0 8160 DEPOSIT ABSOLUTE /end AXIS_DESCR
 /begin AXIS_DESCR STD_AXIS zff_atsys._.iSignale._.obj.sig_m_t8 UMR_NM__6_1_M34_S5_S3 10 -204 1326 DEPOSIT ABSOLUTE /end AXIS_DESCR
/end CHARACTERISTIC
/begin CHARACTERISTIC KF_MEHAUPT21 "Wert Hauptmotoreingriff" MAP 0x1AAC48 ZF_kf_ui8_S5_S3 1530 UMR_NM__6_1_M128_S5_S3 -768 762
 /begin AXIS_DESCR STD_AXIS NO_INPUT_QUANTITY UMR_U_MIN_32_1_0_S5_S3 6 0 8160 DEPOSIT ABSOLUTE /end AXIS_DESCR
 /begin AXIS_DESCR STD_AXIS zff_atsys._.iSignale._.obj.sig_m_t8 UMR_NM__6_1_M34_S5_S3 10 -204 1326 DEPOSIT ABSOLUTE /end AXIS_DESCR
/end CHARACTERISTIC
/begin CHARACTERISTIC KF_MEHAUPT21_EL "Wert Hauptmotoreingriff" MAP 0x1AAC9C ZF_kf_ui8_S5_S3 1530 UMR_NM__6_1_M128_S5_S3 -768 762
 /begin AXIS_DESCR STD_AXIS NO_INPUT_QUANTITY UMR_U_MIN_32_1_0_S5_S3 6 0 8160 DEPOSIT ABSOLUTE /end AXIS_DESCR
 /begin AXIS_DESCR STD_AXIS zff_atsys._.iSignale._.obj.sig_m_t8 UMR_NM__6_1_M34_S5_S3 10 -204 1326 DEPOSIT ABSOLUTE /end AXIS_DESCR
/end CHARACTERISTIC
/begin CHARACTERISTIC KF_MEHAUPT23 "Hauptmotoreingriff Schaltablauf" MAP 0x1A9D2C ZF_kf_ui8_S5_S3 1530 UMR_NM__6_1_M128_S5_S3 -768 762
 /begin AXIS_DESCR STD_AXIS iSasZentr.iSchaltend.n_tkf UMR_U_MIN_32_1_0_S5_S3 6 0 8160 DEPOSIT ABSOLUTE /end AXIS_DESCR
 /begin AXIS_DESCR STD_AXIS zff_atsys._.iSignale._.obj.sig_m_t8 UMR_NM__6_1_M34_S5_S3 10 -204 1326 DEPOSIT ABSOLUTE /end AXIS_DESCR
/end CHARACTERISTIC
/begin CHARACTERISTIC KF_MEHAUPT23_EL "Hauptmotoreingriff Schaltablauf" MAP 0x1A9D80 ZF_kf_ui8_S5_S3 1530 UMR_NM__6_1_M128_S5_S3 -768 762
 /begin AXIS_DESCR STD_AXIS iSasZentr.iSchaltend.n_tkf UMR_U_MIN_32_1_0_S5_S3 6 0 8160 DEPOSIT ABSOLUTE /end AXIS_DESCR
 /begin AXIS_DESCR STD_AXIS zff_atsys._.iSignale._.obj.sig_m_t8 UMR_NM__6_1_M34_S5_S3 10 -204 1326 DEPOSIT ABSOLUTE /end AXIS_DESCR
/end CHARACTERISTIC
/begin CHARACTERISTIC KF_MEHAUPT32 "Wert Hauptmotoreingriff" MAP 0x1AAE54 ZF_kf_ui8_S5_S3 1530 UMR_NM__6_1_M128_S5_S3 -768 762
 /begin AXIS_DESCR STD_AXIS NO_INPUT_QUANTITY UMR_U_MIN_32_1_0_S5_S3 6 0 8160 DEPOSIT ABSOLUTE /end AXIS_DESCR
 /begin AXIS_DESCR STD_AXIS zff_atsys._.iSignale._.obj.sig_m_t8 UMR_NM__6_1_M34_S5_S3 10 -204 1326 DEPOSIT ABSOLUTE /end AXIS_DESCR
/end CHARACTERISTIC
/begin CHARACTERISTIC KF_MEHAUPT32_EL "Wert Hauptmotoreingriff" MAP 0x1AAEA8 ZF_kf_ui8_S5_S3 1530 UMR_NM__6_1_M128_S5_S3 -768 762
 /begin AXIS_DESCR STD_AXIS NO_INPUT_QUANTITY UMR_U_MIN_32_1_0_S5_S3 6 0 8160 DEPOSIT ABSOLUTE /end AXIS_DESCR
 /begin AXIS_DESCR STD_AXIS zff_atsys._.iSignale._.obj.sig_m_t8 UMR_NM__6_1_M34_S5_S3 10 -204 1326 DEPOSIT ABSOLUTE /end AXIS_DESCR
/end CHARACTERISTIC
/begin CHARACTERISTIC KF_MEHAUPT34 "Hauptmotoreingriff Schaltablauf" MAP 0x1A9DD4 ZF_kf_ui8_S5_S3 1530 UMR_NM__6_1_M128_S5_S3 -768 762
 /begin AXIS_DESCR STD_AXIS iSasZentr.iSchaltend.n_tkf UMR_U_MIN_32_1_0_S5_S3 6 0 8160 DEPOSIT ABSOLUTE /end AXIS_DESCR
 /begin AXIS_DESCR STD_AXIS zff_atsys._.iSignale._.obj.sig_m_t8 UMR_NM__6_1_M34_S5_S3 10 -204 1326 DEPOSIT ABSOLUTE /end AXIS_DESCR
/end CHARACTERISTIC
/begin CHARACTERISTIC KF_MEHAUPT34_EL "Hauptmotoreingriff Schaltablauf" MAP 0x1A9E28 ZF_kf_ui8_S5_S3 1530 UMR_NM__6_1_M128_S5_S3 -768 762
 /begin AXIS_DESCR STD_AXIS iSasZentr.iSchaltend.n_tkf UMR_U_MIN_32_1_0_S5_S3 6 0 8160 DEPOSIT ABSOLUTE /end AXIS_DESCR
 /begin AXIS_DESCR STD_AXIS zff_atsys._.iSignale._.obj.sig_m_t8 UMR_NM__6_1_M34_S5_S3 10 -204 1326 DEPOSIT ABSOLUTE /end AXIS_DESCR
/end CHARACTERISTIC
/begin CHARACTERISTIC KF_MEHAUPT43 "Wert Hauptmotoreingriff" MAP 0x1AB060 ZF_kf_ui8_S5_S3 1530 UMR_NM__6_1_M128_S5_S3 -768 762
 /begin AXIS_DESCR STD_AXIS NO_INPUT_QUANTITY UMR_U_MIN_32_1_0_S5_S3 6 0 8160 DEPOSIT ABSOLUTE /end AXIS_DESCR
 /begin AXIS_DESCR STD_AXIS zff_atsys._.iSignale._.obj.sig_m_t8 UMR_NM__6_1_M34_S5_S3 10 -204 1326 DEPOSIT ABSOLUTE /end AXIS_DESCR
/end CHARACTERISTIC
/begin CHARACTERISTIC KF_MEHAUPT43_EL "Wert Hauptmotoreingriff" MAP 0x1AB0B4 ZF_kf_ui8_S5_S3 1530 UMR_NM__6_1_M128_S5_S3 -768 762
 /begin AXIS_DESCR STD_AXIS NO_INPUT_QUANTITY UMR_U_MIN_32_1_0_S5_S3 6 0 8160 DEPOSIT ABSOLUTE /end AXIS_DESCR
 /begin AXIS_DESCR STD_AXIS zff_atsys._.iSignale._.obj.sig_m_t8 UMR_NM__6_1_M34_S5_S3 10 -204 1326 DEPOSIT ABSOLUTE /end AXIS_DESCR
/end CHARACTERISTIC
/begin CHARACTERISTIC KF_MEHAUPT45 "Hauptmotoreingriff Schaltablauf" MAP 0x1A9E7C ZF_kf_ui8_S5_S3 1530 UMR_NM__6_1_M128_S5_S3 -768 762
 /begin AXIS_DESCR STD_AXIS iSasZentr.iSchaltend.n_tkf UMR_U_MIN_32_1_0_S5_S3 6 0 8160 DEPOSIT ABSOLUTE /end AXIS_DESCR
 /begin AXIS_DESCR STD_AXIS zff_atsys._.iSignale._.obj.sig_m_t8 UMR_NM__6_1_M34_S5_S3 10 -204 1326 DEPOSIT ABSOLUTE /end AXIS_DESCR
/end CHARACTERISTIC
/begin CHARACTERISTIC KF_MEHAUPT45_EL "Hauptmotoreingriff Schaltablauf" MAP 0x1A9ED0 ZF_kf_ui8_S5_S3 1530 UMR_NM__6_1_M128_S5_S3 -768 762
 /begin AXIS_DESCR STD_AXIS iSasZentr.iSchaltend.n_tkf UMR_U_MIN_32_1_0_S5_S3 6 0 8160 DEPOSIT ABSOLUTE /end AXIS_DESCR
 /begin AXIS_DESCR STD_AXIS zff_atsys._.iSignale._.obj.sig_m_t8 UMR_NM__6_1_M34_S5_S3 10 -204 1326 DEPOSIT ABSOLUTE /end AXIS_DESCR
/end CHARACTERISTIC
/begin CHARACTERISTIC KF_MEHAUPT54 "Wert Hauptmotoreingriff" MAP 0x1AB26C ZF_kf_ui8_S5_S3 1530 UMR_NM__6_1_M128_S5_S3 -768 762
 /begin AXIS_DESCR STD_AXIS NO_INPUT_QUANTITY UMR_U_MIN_32_1_0_S5_S3 6 0 8160 DEPOSIT ABSOLUTE /end AXIS_DESCR
 /begin AXIS_DESCR STD_AXIS zff_atsys._.iSignale._.obj.sig_m_t8 UMR_NM__6_1_M34_S5_S3 10 -204 1326 DEPOSIT ABSOLUTE /end AXIS_DESCR
/end CHARACTERISTIC
/begin CHARACTERISTIC KF_MEHAUPT54_EL "Wert Hauptmotoreingriff" MAP 0x1AB2C0 ZF_kf_ui8_S5_S3 1530 UMR_NM__6_1_M128_S5_S3 -768 762
 /begin AXIS_DESCR STD_AXIS NO_INPUT_QUANTITY UMR_U_MIN_32_1_0_S5_S3 6 0 8160 DEPOSIT ABSOLUTE /end AXIS_DESCR
 /begin AXIS_DESCR STD_AXIS zff_atsys._.iSignale._.obj.sig_m_t8 UMR_NM__6_1_M34_S5_S3 10 -204 1326 DEPOSIT ABSOLUTE /end AXIS_DESCR
/end CHARACTERISTIC
/begin CHARACTERISTIC KF_MEHAUPT56 "Hauptmotoreingriff Schaltablauf" MAP 0x1A9F24 ZF_kf_ui8_S5_S3 1530 UMR_NM__6_1_M128_S5_S3 -768 762
 /begin AXIS_DESCR STD_AXIS iSasZentr.iSchaltend.n_tkf UMR_U_MIN_32_1_0_S5_S3 6 0 8160 DEPOSIT ABSOLUTE /end AXIS_DESCR
 /begin AXIS_DESCR STD_AXIS zff_atsys._.iSignale._.obj.sig_m_t8 UMR_NM__6_1_M34_S5_S3 10 -204 1326 DEPOSIT ABSOLUTE /end AXIS_DESCR
/end CHARACTERISTIC
/begin CHARACTERISTIC KF_MEHAUPT56_EL "Hauptmotoreingriff Schaltablauf" MAP 0x1A9F78 ZF_kf_ui8_S5_S3 1530 UMR_NM__6_1_M128_S5_S3 -768 762
 /begin AXIS_DESCR STD_AXIS iSasZentr.iSchaltend.n_tkf UMR_U_MIN_32_1_0_S5_S3 6 0 8160 DEPOSIT ABSOLUTE /end AXIS_DESCR
 /begin AXIS_DESCR STD_AXIS zff_atsys._.iSignale._.obj.sig_m_t8 UMR_NM__6_1_M34_S5_S3 10 -204 1326 DEPOSIT ABSOLUTE /end AXIS_DESCR
/end CHARACTERISTIC
/begin CHARACTERISTIC KF_MEHAUPT65 "Wert Hauptmotoreingriff" MAP 0x1AB478 ZF_kf_ui8_S5_S3 1530 UMR_NM__6_1_M128_S5_S3 -768 762
 /begin AXIS_DESCR STD_AXIS NO_INPUT_QUANTITY UMR_U_MIN_32_1_0_S5_S3 6 0 8160 DEPOSIT ABSOLUTE /end AXIS_DESCR
 /begin AXIS_DESCR STD_AXIS zff_atsys._.iSignale._.obj.sig_m_t8 UMR_NM__6_1_M34_S5_S3 10 -204 1326 DEPOSIT ABSOLUTE /end AXIS_DESCR
/end CHARACTERISTIC
/begin CHARACTERISTIC KF_MEHAUPT65_EL "Wert Hauptmotoreingriff" MAP 0x1AB4CC ZF_kf_ui8_S5_S3 1530 UMR_NM__6_1_M128_S5_S3 -768 762
 /begin AXIS_DESCR STD_AXIS NO_INPUT_QUANTITY UMR_U_MIN_32_1_0_S5_S3 6 0 8160 DEPOSIT ABSOLUTE /end AXIS_DESCR
 /begin AXIS_DESCR STD_AXIS zff_atsys._.iSignale._.obj.sig_m_t8 UMR_NM__6_1_M34_S5_S3 10 -204 1326 DEPOSIT ABSOLUTE /end AXIS_DESCR
/end CHARACTERISTIC
/begin CHARACTERISTIC KF_MEHAUPT67 "Hauptmotoreingriff Schaltablauf" MAP 0x1A9FCC ZF_kf_ui8_S5_S3 1530 UMR_NM__6_1_M128_S5_S3 -768 762
 /begin AXIS_DESCR STD_AXIS iSasZentr.iSchaltend.n_tkf UMR_U_MIN_32_1_0_S5_S3 6 0 8160 DEPOSIT ABSOLUTE /end AXIS_DESCR
 /begin AXIS_DESCR STD_AXIS zff_atsys._.iSignale._.obj.sig_m_t8 UMR_NM__6_1_M34_S5_S3 10 -204 1326 DEPOSIT ABSOLUTE /end AXIS_DESCR
/end CHARACTERISTIC
/begin CHARACTERISTIC KF_MEHAUPT67_EL "Hauptmotoreingriff Schaltablauf" MAP 0x1AA020 ZF_kf_ui8_S5_S3 1530 UMR_NM__6_1_M128_S5_S3 -768 762
 /begin AXIS_DESCR STD_AXIS iSasZentr.iSchaltend.n_tkf UMR_U_MIN_32_1_0_S5_S3 6 0 8160 DEPOSIT ABSOLUTE /end AXIS_DESCR
 /begin AXIS_DESCR STD_AXIS zff_atsys._.iSignale._.obj.sig_m_t8 UMR_NM__6_1_M34_S5_S3 10 -204 1326 DEPOSIT ABSOLUTE /end AXIS_DESCR
/end CHARACTERISTIC
/begin CHARACTERISTIC KF_MEHAUPT76 "Wert Hauptmotoreingriff" MAP 0x1AB684 ZF_kf_ui8_S5_S3 1530 UMR_NM__6_1_M128_S5_S3 -768 762
 /begin AXIS_DESCR STD_AXIS NO_INPUT_QUANTITY UMR_U_MIN_32_1_0_S5_S3 6 0 8160 DEPOSIT ABSOLUTE /end AXIS_DESCR
 /begin AXIS_DESCR STD_AXIS zff_atsys._.iSignale._.obj.sig_m_t8 UMR_NM__6_1_M34_S5_S3 10 -204 1326 DEPOSIT ABSOLUTE /end AXIS_DESCR
/end CHARACTERISTIC
/begin CHARACTERISTIC KF_MEHAUPT76_EL "Wert Hauptmotoreingriff" MAP 0x1AB6D8 ZF_kf_ui8_S5_S3 1530 UMR_NM__6_1_M128_S5_S3 -768 762
 /begin AXIS_DESCR STD_AXIS NO_INPUT_QUANTITY UMR_U_MIN_32_1_0_S5_S3 6 0 8160 DEPOSIT ABSOLUTE /end AXIS_DESCR
 /begin AXIS_DESCR STD_AXIS zff_atsys._.iSignale._.obj.sig_m_t8 UMR_NM__6_1_M34_S5_S3 10 -204 1326 DEPOSIT ABSOLUTE /end AXIS_DESCR
/end CHARACTERISTIC
/begin CHARACTERISTIC KF_MEHAUPT78 "Hauptmotoreingriff Schaltablauf" MAP 0x1AA074 ZF_kf_ui8_S5_S3 1530 UMR_NM__6_1_M128_S5_S3 -768 762
 /begin AXIS_DESCR STD_AXIS iSasZentr.iSchaltend.n_tkf UMR_U_MIN_32_1_0_S5_S3 6 0 8160 DEPOSIT ABSOLUTE /end AXIS_DESCR
 /begin AXIS_DESCR STD_AXIS zff_atsys._.iSignale._.obj.sig_m_t8 UMR_NM__6_1_M34_S5_S3 10 -204 1326 DEPOSIT ABSOLUTE /end AXIS_DESCR
/end CHARACTERISTIC
/begin CHARACTERISTIC KF_MEHAUPT78_EL "Hauptmotoreingriff Schaltablauf" MAP 0x1AA0C8 ZF_kf_ui8_S5_S3 1530 UMR_NM__6_1_M128_S5_S3 -768 762
 /begin AXIS_DESCR STD_AXIS iSasZentr.iSchaltend.n_tkf UMR_U_MIN_32_1_0_S5_S3 6 0 8160 DEPOSIT ABSOLUTE /end AXIS_DESCR
 /begin AXIS_DESCR STD_AXIS zff_atsys._.iSignale._.obj.sig_m_t8 UMR_NM__6_1_M34_S5_S3 10 -204 1326 DEPOSIT ABSOLUTE /end AXIS_DESCR
/end CHARACTERISTIC
/begin CHARACTERISTIC KF_MEHAUPT87 "Wert Hauptmotoreingriff" MAP 0x1AB890 ZF_kf_ui8_S5_S3 1530 UMR_NM__6_1_M128_S5_S3 -768 762
 /begin AXIS_DESCR STD_AXIS NO_INPUT_QUANTITY UMR_U_MIN_32_1_0_S5_S3 6 0 8160 DEPOSIT ABSOLUTE /end AXIS_DESCR
 /begin AXIS_DESCR STD_AXIS zff_atsys._.iSignale._.obj.sig_m_t8 UMR_NM__6_1_M34_S5_S3 10 -204 1326 DEPOSIT ABSOLUTE /end AXIS_DESCR
/end CHARACTERISTIC
/begin CHARACTERISTIC KF_MEHAUPT87_EL "Wert Hauptmotoreingriff" MAP 0x1AB8E4 ZF_kf_ui8_S5_S3 1530 UMR_NM__6_1_M128_S5_S3 -768 762
 /begin AXIS_DESCR STD_AXIS NO_INPUT_QUANTITY UMR_U_MIN_32_1_0_S5_S3 6 0 8160 DEPOSIT ABSOLUTE /end AXIS_DESCR
 /begin AXIS_DESCR STD_AXIS zff_atsys._.iSignale._.obj.sig_m_t8 UMR_NM__6_1_M34_S5_S3 10 -204 1326 DEPOSIT ABSOLUTE /end AXIS_DESCR
/end CHARACTERISTIC
/begin CHARACTERISTIC KF_MEHAUPTSP12 "Hauptmotoreingriff Schaltablauf" MAP 0x1AA11C ZF_kf_ui8_S5_S3 1530 UMR_NM__6_1_M128_S5_S3 -768 762
 /begin AXIS_DESCR STD_AXIS iSasZentr.iSchaltend.n_tkf UMR_U_MIN_32_1_0_S5_S3 6 0 8160 DEPOSIT ABSOLUTE /end AXIS_DESCR
 /begin AXIS_DESCR STD_AXIS zff_atsys._.iSignale._.obj.sig_m_t8 UMR_NM__6_1_M34_S5_S3 10 -204 1326 DEPOSIT ABSOLUTE /end AXIS_DESCR
/end CHARACTERISTIC
/begin CHARACTERISTIC KF_MEHAUPTSP21 "Wert Hauptmotoreingriff" MAP 0x1ABA5C ZF_kf_ui8_S5_S3 1530 UMR_NM__6_1_M128_S5_S3 -768 762
 /begin AXIS_DESCR STD_AXIS NO_INPUT_QUANTITY UMR_U_MIN_32_1_0_S5_S3 6 0 8160 DEPOSIT ABSOLUTE /end AXIS_DESCR
 /begin AXIS_DESCR STD_AXIS zff_atsys._.iSignale._.obj.sig_m_t8 UMR_NM__6_1_M34_S5_S3 10 -204 1326 DEPOSIT ABSOLUTE /end AXIS_DESCR
/end CHARACTERISTIC
/begin CHARACTERISTIC KF_MEHAUPTSP23 "Hauptmotoreingriff Schaltablauf" MAP 0x1AA170 ZF_kf_ui8_S5_S3 1530 UMR_NM__6_1_M128_S5_S3 -768 762
 /begin AXIS_DESCR STD_AXIS iSasZentr.iSchaltend.n_tkf UMR_U_MIN_32_1_0_S5_S3 6 0 8160 DEPOSIT ABSOLUTE /end AXIS_DESCR
 /begin AXIS_DESCR STD_AXIS zff_atsys._.iSignale._.obj.sig_m_t8 UMR_NM__6_1_M34_S5_S3 10 -204 1326 DEPOSIT ABSOLUTE /end AXIS_DESCR
/end CHARACTERISTIC
/begin CHARACTERISTIC KF_MEHAUPTSP31 "Wert Hauptmotoreingriff" MAP 0x1AC2E4 ZF_kf_ui8_S5_S3 1530 UMR_NM__6_1_M128_S5_S3 -768 762
 /begin AXIS_DESCR STD_AXIS NO_INPUT_QUANTITY UMR_U_MIN_32_1_0_S5_S3 6 0 8160 DEPOSIT ABSOLUTE /end AXIS_DESCR
 /begin AXIS_DESCR STD_AXIS zff_atsys._.iSignale._.obj.sig_m_t8 UMR_NM__6_1_M34_S5_S3 10 -204 1326 DEPOSIT ABSOLUTE /end AXIS_DESCR
/end CHARACTERISTIC
/begin CHARACTERISTIC KF_MEHAUPTSP32 "Wert Hauptmotoreingriff" MAP 0x1ABB94 ZF_kf_ui8_S5_S3 1530 UMR_NM__6_1_M128_S5_S3 -768 762
 /begin AXIS_DESCR STD_AXIS NO_INPUT_QUANTITY UMR_U_MIN_32_1_0_S5_S3 6 0 8160 DEPOSIT ABSOLUTE /end AXIS_DESCR
 /begin AXIS_DESCR STD_AXIS zff_atsys._.iSignale._.obj.sig_m_t8 UMR_NM__6_1_M34_S5_S3 10 -204 1326 DEPOSIT ABSOLUTE /end AXIS_DESCR
/end CHARACTERISTIC
/begin CHARACTERISTIC KF_MEHAUPTSP34 "Hauptmotoreingriff Schaltablauf" MAP 0x1AA1C4 ZF_kf_ui8_S5_S3 1530 UMR_NM__6_1_M128_S5_S3 -768 762
 /begin AXIS_DESCR STD_AXIS iSasZentr.iSchaltend.n_tkf UMR_U_MIN_32_1_0_S5_S3 6 0 8160 DEPOSIT ABSOLUTE /end AXIS_DESCR
 /begin AXIS_DESCR STD_AXIS zff_atsys._.iSignale._.obj.sig_m_t8 UMR_NM__6_1_M34_S5_S3 10 -204 1326 DEPOSIT ABSOLUTE /end AXIS_DESCR
/end CHARACTERISTIC
/begin CHARACTERISTIC KF_MEHAUPTSP42 "Wert Hauptmotoreingriff" MAP 0x1AC41C ZF_kf_ui8_S5_S3 1530 UMR_NM__6_1_M128_S5_S3 -768 762
 /begin AXIS_DESCR STD_AXIS NO_INPUT_QUANTITY UMR_U_MIN_32_1_0_S5_S3 6 0 8160 DEPOSIT ABSOLUTE /end AXIS_DESCR
 /begin AXIS_DESCR STD_AXIS zff_atsys._.iSignale._.obj.sig_m_t8 UMR_NM__6_1_M34_S5_S3 10 -204 1326 DEPOSIT ABSOLUTE /end AXIS_DESCR
/end CHARACTERISTIC
/begin CHARACTERISTIC KF_MEHAUPTSP43 "Wert Hauptmotoreingriff" MAP 0x1ABCCC ZF_kf_ui8_S5_S3 1530 UMR_NM__6_1_M128_S5_S3 -768 762
 /begin AXIS_DESCR STD_AXIS NO_INPUT_QUANTITY UMR_U_MIN_32_1_0_S5_S3 6 0 8160 DEPOSIT ABSOLUTE /end AXIS_DESCR
 /begin AXIS_DESCR STD_AXIS zff_atsys._.iSignale._.obj.sig_m_t8 UMR_NM__6_1_M34_S5_S3 10 -204 1326 DEPOSIT ABSOLUTE /end AXIS_DESCR
/end CHARACTERISTIC
/begin CHARACTERISTIC KF_MEHAUPTSP45 "Hauptmotoreingriff Schaltablauf" MAP 0x1AA218 ZF_kf_ui8_S5_S3 1530 UMR_NM__6_1_M128_S5_S3 -768 762
 /begin AXIS_DESCR STD_AXIS iSasZentr.iSchaltend.n_tkf UMR_U_MIN_32_1_0_S5_S3 6 0 8160 DEPOSIT ABSOLUTE /end AXIS_DESCR
 /begin AXIS_DESCR STD_AXIS zff_atsys._.iSignale._.obj.sig_m_t8 UMR_NM__6_1_M34_S5_S3 10 -204 1326 DEPOSIT ABSOLUTE /end AXIS_DESCR
/end CHARACTERISTIC
/begin CHARACTERISTIC KF_MEHAUPTSP51 "Wert Hauptmotoreingriff" MAP 0x1AC554 ZF_kf_ui8_S5_S3 1530 UMR_NM__6_1_M128_S5_S3 -768 762
 /begin AXIS_DESCR STD_AXIS NO_INPUT_QUANTITY UMR_U_MIN_32_1_0_S5_S3 6 0 8160 DEPOSIT ABSOLUTE /end AXIS_DESCR
 /begin AXIS_DESCR STD_AXIS zff_atsys._.iSignale._.obj.sig_m_t8 UMR_NM__6_1_M34_S5_S3 10 -204 1326 DEPOSIT ABSOLUTE /end AXIS_DESCR
/end CHARACTERISTIC
/begin CHARACTERISTIC KF_MEHAUPTSP53 "Wert Hauptmotoreingriff" MAP 0x1AC68C ZF_kf_ui8_S5_S3 1530 UMR_NM__6_1_M128_S5_S3 -768 762
 /begin AXIS_DESCR STD_AXIS NO_INPUT_QUANTITY UMR_U_MIN_32_1_0_S5_S3 6 0 8160 DEPOSIT ABSOLUTE /end AXIS_DESCR
 /begin AXIS_DESCR STD_AXIS zff_atsys._.iSignale._.obj.sig_m_t8 UMR_NM__6_1_M34_S5_S3 10 -204 1326 DEPOSIT ABSOLUTE /end AXIS_DESCR
/end CHARACTERISTIC
/begin CHARACTERISTIC KF_MEHAUPTSP54 "Wert Hauptmotoreingriff" MAP 0x1ABE04 ZF_kf_ui8_S5_S3 1530 UMR_NM__6_1_M128_S5_S3 -768 762
 /begin AXIS_DESCR STD_AXIS NO_INPUT_QUANTITY UMR_U_MIN_32_1_0_S5_S3 6 0 8160 DEPOSIT ABSOLUTE /end AXIS_DESCR
 /begin AXIS_DESCR STD_AXIS zff_atsys._.iSignale._.obj.sig_m_t8 UMR_NM__6_1_M34_S5_S3 10 -204 1326 DEPOSIT ABSOLUTE /end AXIS_DESCR
/end CHARACTERISTIC
/begin CHARACTERISTIC KF_MEHAUPTSP56 "Hauptmotoreingriff Schaltablauf" MAP 0x1AA26C ZF_kf_ui8_S5_S3 1530 UMR_NM__6_1_M128_S5_S3 -768 762
 /begin AXIS_DESCR STD_AXIS iSasZentr.iSchaltend.n_tkf UMR_U_MIN_32_1_0_S5_S3 6 0 8160 DEPOSIT ABSOLUTE /end AXIS_DESCR
 /begin AXIS_DESCR STD_AXIS zff_atsys._.iSignale._.obj.sig_m_t8 UMR_NM__6_1_M34_S5_S3 10 -204 1326 DEPOSIT ABSOLUTE /end AXIS_DESCR
/end CHARACTERISTIC
/begin CHARACTERISTIC KF_MEHAUPTSP63 "Wert Hauptmotoreingriff" MAP 0x1AC7C4 ZF_kf_ui8_S5_S3 1530 UMR_NM__6_1_M128_S5_S3 -768 762
 /begin AXIS_DESCR STD_AXIS NO_INPUT_QUANTITY UMR_U_MIN_32_1_0_S5_S3 6 0 8160 DEPOSIT ABSOLUTE /end AXIS_DESCR
 /begin AXIS_DESCR STD_AXIS zff_atsys._.iSignale._.obj.sig_m_t8 UMR_NM__6_1_M34_S5_S3 10 -204 1326 DEPOSIT ABSOLUTE /end AXIS_DESCR
/end CHARACTERISTIC
/begin CHARACTERISTIC KF_MEHAUPTSP64 "Wert Hauptmotoreingriff" MAP 0x1AC8FC ZF_kf_ui8_S5_S3 1530 UMR_NM__6_1_M128_S5_S3 -768 762
 /begin AXIS_DESCR STD_AXIS NO_INPUT_QUANTITY UMR_U_MIN_32_1_0_S5_S3 6 0 8160 DEPOSIT ABSOLUTE /end AXIS_DESCR
 /begin AXIS_DESCR STD_AXIS zff_atsys._.iSignale._.obj.sig_m_t8 UMR_NM__6_1_M34_S5_S3 10 -204 1326 DEPOSIT ABSOLUTE /end AXIS_DESCR
/end CHARACTERISTIC
/begin CHARACTERISTIC KF_MEHAUPTSP65 "Wert Hauptmotoreingriff" MAP 0x1ABF3C ZF_kf_ui8_S5_S3 1530 UMR_NM__6_1_M128_S5_S3 -768 762
 /begin AXIS_DESCR STD_AXIS NO_INPUT_QUANTITY UMR_U_MIN_32_1_0_S5_S3 6 0 8160 DEPOSIT ABSOLUTE /end AXIS_DESCR
 /begin AXIS_DESCR STD_AXIS zff_atsys._.iSignale._.obj.sig_m_t8 UMR_NM__6_1_M34_S5_S3 10 -204 1326 DEPOSIT ABSOLUTE /end AXIS_DESCR
/end CHARACTERISTIC
/begin CHARACTERISTIC KF_MEHAUPTSP67 "Hauptmotoreingriff Schaltablauf" MAP 0x1AA2C0 ZF_kf_ui8_S5_S3 1530 UMR_NM__6_1_M128_S5_S3 -768 762
 /begin AXIS_DESCR STD_AXIS iSasZentr.iSchaltend.n_tkf UMR_U_MIN_32_1_0_S5_S3 6 0 8160 DEPOSIT ABSOLUTE /end AXIS_DESCR
 /begin AXIS_DESCR STD_AXIS zff_atsys._.iSignale._.obj.sig_m_t8 UMR_NM__6_1_M34_S5_S3 10 -204 1326 DEPOSIT ABSOLUTE /end AXIS_DESCR
/end CHARACTERISTIC
/begin CHARACTERISTIC KF_MEHAUPTSP71 "Wert Hauptmotoreingriff" MAP 0x1ACA34 ZF_kf_ui8_S5_S3 1530 UMR_NM__6_1_M128_S5_S3 -768 762
 /begin AXIS_DESCR STD_AXIS NO_INPUT_QUANTITY UMR_U_MIN_32_1_0_S5_S3 6 0 8160 DEPOSIT ABSOLUTE /end AXIS_DESCR
 /begin AXIS_DESCR STD_AXIS zff_atsys._.iSignale._.obj.sig_m_t8 UMR_NM__6_1_M34_S5_S3 10 -204 1326 DEPOSIT ABSOLUTE /end AXIS_DESCR
/end CHARACTERISTIC
/begin CHARACTERISTIC KF_MEHAUPTSP75 "Wert Hauptmotoreingriff" MAP 0x1ACB6C ZF_kf_ui8_S5_S3 1530 UMR_NM__6_1_M128_S5_S3 -768 762
 /begin AXIS_DESCR STD_AXIS NO_INPUT_QUANTITY UMR_U_MIN_32_1_0_S5_S3 6 0 8160 DEPOSIT ABSOLUTE /end AXIS_DESCR
 /begin AXIS_DESCR STD_AXIS zff_atsys._.iSignale._.obj.sig_m_t8 UMR_NM__6_1_M34_S5_S3 10 -204 1326 DEPOSIT ABSOLUTE /end AXIS_DESCR
/end CHARACTERISTIC
/begin CHARACTERISTIC KF_MEHAUPTSP76 "Wert Hauptmotoreingriff" MAP 0x1AC074 ZF_kf_ui8_S5_S3 1530 UMR_NM__6_1_M128_S5_S3 -768 762
 /begin AXIS_DESCR STD_AXIS NO_INPUT_QUANTITY UMR_U_MIN_32_1_0_S5_S3 6 0 8160 DEPOSIT ABSOLUTE /end AXIS_DESCR
 /begin AXIS_DESCR STD_AXIS zff_atsys._.iSignale._.obj.sig_m_t8 UMR_NM__6_1_M34_S5_S3 10 -204 1326 DEPOSIT ABSOLUTE /end AXIS_DESCR
/end CHARACTERISTIC
/begin CHARACTERISTIC KF_MEHAUPTSP78 "Hauptmotoreingriff Schaltablauf" MAP 0x1AA314 ZF_kf_ui8_S5_S3 1530 UMR_NM__6_1_M128_S5_S3 -768 762
 /begin AXIS_DESCR STD_AXIS iSasZentr.iSchaltend.n_tkf UMR_U_MIN_32_1_0_S5_S3 6 0 8160 DEPOSIT ABSOLUTE /end AXIS_DESCR
 /begin AXIS_DESCR STD_AXIS zff_atsys._.iSignale._.obj.sig_m_t8 UMR_NM__6_1_M34_S5_S3 10 -204 1326 DEPOSIT ABSOLUTE /end AXIS_DESCR
/end CHARACTERISTIC
/begin CHARACTERISTIC KF_MEHAUPTSP82 "Wert Hauptmotoreingriff" MAP 0x1ACCA4 ZF_kf_ui8_S5_S3 1530 UMR_NM__6_1_M128_S5_S3 -768 762
 /begin AXIS_DESCR STD_AXIS NO_INPUT_QUANTITY UMR_U_MIN_32_1_0_S5_S3 6 0 8160 DEPOSIT ABSOLUTE /end AXIS_DESCR
 /begin AXIS_DESCR STD_AXIS zff_atsys._.iSignale._.obj.sig_m_t8 UMR_NM__6_1_M34_S5_S3 10 -204 1326 DEPOSIT ABSOLUTE /end AXIS_DESCR
/end CHARACTERISTIC
/begin CHARACTERISTIC KF_MEHAUPTSP84 "Wert Hauptmotoreingriff" MAP 0x1ACDDC ZF_kf_ui8_S5_S3 1530 UMR_NM__6_1_M128_S5_S3 -768 762
 /begin AXIS_DESCR STD_AXIS NO_INPUT_QUANTITY UMR_U_MIN_32_1_0_S5_S3 6 0 8160 DEPOSIT ABSOLUTE /end AXIS_DESCR
 /begin AXIS_DESCR STD_AXIS zff_atsys._.iSignale._.obj.sig_m_t8 UMR_NM__6_1_M34_S5_S3 10 -204 1326 DEPOSIT ABSOLUTE /end AXIS_DESCR
/end CHARACTERISTIC
/begin CHARACTERISTIC KF_MEHAUPTSP86 "Wert Hauptmotoreingriff" MAP 0x1ACF14 ZF_kf_ui8_S5_S3 1530 UMR_NM__6_1_M128_S5_S3 -768 762
 /begin AXIS_DESCR STD_AXIS NO_INPUT_QUANTITY UMR_U_MIN_32_1_0_S5_S3 6 0 8160 DEPOSIT ABSOLUTE /end AXIS_DESCR
 /begin AXIS_DESCR STD_AXIS zff_atsys._.iSignale._.obj.sig_m_t8 UMR_NM__6_1_M34_S5_S3 10 -204 1326 DEPOSIT ABSOLUTE /end AXIS_DESCR
/end CHARACTERISTIC
/begin CHARACTERISTIC KF_MEHAUPTSP87 "Wert Hauptmotoreingriff" MAP 0x1AC1AC ZF_kf_ui8_S5_S3 1530 UMR_NM__6_1_M128_S5_S3 -768 762
 /begin AXIS_DESCR STD_AXIS NO_INPUT_QUANTITY UMR_U_MIN_32_1_0_S5_S3 6 0 8160 DEPOSIT ABSOLUTE /end AXIS_DESCR
 /begin AXIS_DESCR STD_AXIS zff_atsys._.iSignale._.obj.sig_m_t8 UMR_NM__6_1_M34_S5_S3 10 -204 1326 DEPOSIT ABSOLUTE /end AXIS_DESCR
/end CHARACTERISTIC
/begin CHARACTERISTIC KF_MEHAUPTSPORT12 "Hauptmotoreingriff Schaltablauf" MAP 0x1AA368 ZF_kf_ui8_S5_S3 1530 UMR_NM__6_1_M128_S5_S3 -768 762
 /begin AXIS_DESCR STD_AXIS iSasZentr.iSchaltend.n_tkf UMR_U_MIN_32_1_0_S5_S3 6 0 8160 DEPOSIT ABSOLUTE /end AXIS_DESCR
 /begin AXIS_DESCR STD_AXIS zff_atsys._.iSignale._.obj.sig_m_t8 UMR_NM__6_1_M34_S5_S3 10 -204 1326 DEPOSIT ABSOLUTE /end AXIS_DESCR
/end CHARACTERISTIC
/begin CHARACTERISTIC KF_MEHAUPTSPORT21 "Wert Hauptmotoreingriff" MAP 0x1AD04C ZF_kf_ui8_S5_S3 1530 UMR_NM__6_1_M128_S5_S3 -768 762
 /begin AXIS_DESCR STD_AXIS NO_INPUT_QUANTITY UMR_U_MIN_32_1_0_S5_S3 6 0 8160 DEPOSIT ABSOLUTE /end AXIS_DESCR
 /begin AXIS_DESCR STD_AXIS zff_atsys._.iSignale._.obj.sig_m_t8 UMR_NM__6_1_M34_S5_S3 10 -204 1326 DEPOSIT ABSOLUTE /end AXIS_DESCR
/end CHARACTERISTIC
/begin CHARACTERISTIC KF_MEHAUPTSPORT23 "Hauptmotoreingriff Schaltablauf" MAP 0x1AA3BC ZF_kf_ui8_S5_S3 1530 UMR_NM__6_1_M128_S5_S3 -768 762
 /begin AXIS_DESCR STD_AXIS iSasZentr.iSchaltend.n_tkf UMR_U_MIN_32_1_0_S5_S3 6 0 8160 DEPOSIT ABSOLUTE /end AXIS_DESCR
 /begin AXIS_DESCR STD_AXIS zff_atsys._.iSignale._.obj.sig_m_t8 UMR_NM__6_1_M34_S5_S3 10 -204 1326 DEPOSIT ABSOLUTE /end AXIS_DESCR
/end CHARACTERISTIC
/begin CHARACTERISTIC KF_MEHAUPTSPORT31 "Wert Hauptmotoreingriff" MAP 0x1AD8D4 ZF_kf_ui8_S5_S3 1530 UMR_NM__6_1_M128_S5_S3 -768 762
 /begin AXIS_DESCR STD_AXIS NO_INPUT_QUANTITY UMR_U_MIN_32_1_0_S5_S3 6 0 8160 DEPOSIT ABSOLUTE /end AXIS_DESCR
 /begin AXIS_DESCR STD_AXIS zff_atsys._.iSignale._.obj.sig_m_t8 UMR_NM__6_1_M34_S5_S3 10 -204 1326 DEPOSIT ABSOLUTE /end AXIS_DESCR
/end CHARACTERISTIC
/begin CHARACTERISTIC KF_MEHAUPTSPORT32 "Wert Hauptmotoreingriff" MAP 0x1AD184 ZF_kf_ui8_S5_S3 1530 UMR_NM__6_1_M128_S5_S3 -768 762
 /begin AXIS_DESCR STD_AXIS NO_INPUT_QUANTITY UMR_U_MIN_32_1_0_S5_S3 6 0 8160 DEPOSIT ABSOLUTE /end AXIS_DESCR
 /begin AXIS_DESCR STD_AXIS zff_atsys._.iSignale._.obj.sig_m_t8 UMR_NM__6_1_M34_S5_S3 10 -204 1326 DEPOSIT ABSOLUTE /end AXIS_DESCR
/end CHARACTERISTIC
/begin CHARACTERISTIC KF_MEHAUPTSPORT34 "Hauptmotoreingriff Schaltablauf" MAP 0x1AA410 ZF_kf_ui8_S5_S3 1530 UMR_NM__6_1_M128_S5_S3 -768 762
 /begin AXIS_DESCR STD_AXIS iSasZentr.iSchaltend.n_tkf UMR_U_MIN_32_1_0_S5_S3 6 0 8160 DEPOSIT ABSOLUTE /end AXIS_DESCR
 /begin AXIS_DESCR STD_AXIS zff_atsys._.iSignale._.obj.sig_m_t8 UMR_NM__6_1_M34_S5_S3 10 -204 1326 DEPOSIT ABSOLUTE /end AXIS_DESCR
/end CHARACTERISTIC
/begin CHARACTERISTIC KF_MEHAUPTSPORT42 "Wert Hauptmotoreingriff" MAP 0x1ADA0C ZF_kf_ui8_S5_S3 1530 UMR_NM__6_1_M128_S5_S3 -768 762
 /begin AXIS_DESCR STD_AXIS NO_INPUT_QUANTITY UMR_U_MIN_32_1_0_S5_S3 6 0 8160 DEPOSIT ABSOLUTE /end AXIS_DESCR
 /begin AXIS_DESCR STD_AXIS zff_atsys._.iSignale._.obj.sig_m_t8 UMR_NM__6_1_M34_S5_S3 10 -204 1326 DEPOSIT ABSOLUTE /end AXIS_DESCR
/end CHARACTERISTIC
/begin CHARACTERISTIC KF_MEHAUPTSPORT43 "Wert Hauptmotoreingriff" MAP 0x1AD2BC ZF_kf_ui8_S5_S3 1530 UMR_NM__6_1_M128_S5_S3 -768 762
 /begin AXIS_DESCR STD_AXIS NO_INPUT_QUANTITY UMR_U_MIN_32_1_0_S5_S3 6 0 8160 DEPOSIT ABSOLUTE /end AXIS_DESCR
 /begin AXIS_DESCR STD_AXIS zff_atsys._.iSignale._.obj.sig_m_t8 UMR_NM__6_1_M34_S5_S3 10 -204 1326 DEPOSIT ABSOLUTE /end AXIS_DESCR
/end CHARACTERISTIC
/begin CHARACTERISTIC KF_MEHAUPTSPORT45 "Hauptmotoreingriff Schaltablauf" MAP 0x1AA464 ZF_kf_ui8_S5_S3 1530 UMR_NM__6_1_M128_S5_S3 -768 762
 /begin AXIS_DESCR STD_AXIS iSasZentr.iSchaltend.n_tkf UMR_U_MIN_32_1_0_S5_S3 6 0 8160 DEPOSIT ABSOLUTE /end AXIS_DESCR
 /begin AXIS_DESCR STD_AXIS zff_atsys._.iSignale._.obj.sig_m_t8 UMR_NM__6_1_M34_S5_S3 10 -204 1326 DEPOSIT ABSOLUTE /end AXIS_DESCR
/end CHARACTERISTIC
/begin CHARACTERISTIC KF_MEHAUPTSPORT51 "Wert Hauptmotoreingriff" MAP 0x1ADB44 ZF_kf_ui8_S5_S3 1530 UMR_NM__6_1_M128_S5_S3 -768 762
 /begin AXIS_DESCR STD_AXIS NO_INPUT_QUANTITY UMR_U_MIN_32_1_0_S5_S3 6 0 8160 DEPOSIT ABSOLUTE /end AXIS_DESCR
 /begin AXIS_DESCR STD_AXIS zff_atsys._.iSignale._.obj.sig_m_t8 UMR_NM__6_1_M34_S5_S3 10 -204 1326 DEPOSIT ABSOLUTE /end AXIS_DESCR
/end CHARACTERISTIC
/begin CHARACTERISTIC KF_MEHAUPTSPORT53 "Wert Hauptmotoreingriff" MAP 0x1ADC7C ZF_kf_ui8_S5_S3 1530 UMR_NM__6_1_M128_S5_S3 -768 762
 /begin AXIS_DESCR STD_AXIS NO_INPUT_QUANTITY UMR_U_MIN_32_1_0_S5_S3 6 0 8160 DEPOSIT ABSOLUTE /end AXIS_DESCR
 /begin AXIS_DESCR STD_AXIS zff_atsys._.iSignale._.obj.sig_m_t8 UMR_NM__6_1_M34_S5_S3 10 -204 1326 DEPOSIT ABSOLUTE /end AXIS_DESCR
/end CHARACTERISTIC
/begin CHARACTERISTIC KF_MEHAUPTSPORT54 "Wert Hauptmotoreingriff" MAP 0x1AD3F4 ZF_kf_ui8_S5_S3 1530 UMR_NM__6_1_M128_S5_S3 -768 762
 /begin AXIS_DESCR STD_AXIS NO_INPUT_QUANTITY UMR_U_MIN_32_1_0_S5_S3 6 0 8160 DEPOSIT ABSOLUTE /end AXIS_DESCR
 /begin AXIS_DESCR STD_AXIS zff_atsys._.iSignale._.obj.sig_m_t8 UMR_NM__6_1_M34_S5_S3 10 -204 1326 DEPOSIT ABSOLUTE /end AXIS_DESCR
/end CHARACTERISTIC
/begin CHARACTERISTIC KF_MEHAUPTSPORT56 "Hauptmotoreingriff Schaltablauf" MAP 0x1AA4B8 ZF_kf_ui8_S5_S3 1530 UMR_NM__6_1_M128_S5_S3 -768 762
 /begin AXIS_DESCR STD_AXIS iSasZentr.iSchaltend.n_tkf UMR_U_MIN_32_1_0_S5_S3 6 0 8160 DEPOSIT ABSOLUTE /end AXIS_DESCR
 /begin AXIS_DESCR STD_AXIS zff_atsys._.iSignale._.obj.sig_m_t8 UMR_NM__6_1_M34_S5_S3 10 -204 1326 DEPOSIT ABSOLUTE /end AXIS_DESCR
/end CHARACTERISTIC
/begin CHARACTERISTIC KF_MEHAUPTSPORT63 "Wert Hauptmotoreingriff" MAP 0x1ADDB4 ZF_kf_ui8_S5_S3 1530 UMR_NM__6_1_M128_S5_S3 -768 762
 /begin AXIS_DESCR STD_AXIS NO_INPUT_QUANTITY UMR_U_MIN_32_1_0_S5_S3 6 0 8160 DEPOSIT ABSOLUTE /end AXIS_DESCR
 /begin AXIS_DESCR STD_AXIS zff_atsys._.iSignale._.obj.sig_m_t8 UMR_NM__6_1_M34_S5_S3 10 -204 1326 DEPOSIT ABSOLUTE /end AXIS_DESCR
/end CHARACTERISTIC
/begin CHARACTERISTIC KF_MEHAUPTSPORT64 "Wert Hauptmotoreingriff" MAP 0x1ADEEC ZF_kf_ui8_S5_S3 1530 UMR_NM__6_1_M128_S5_S3 -768 762
 /begin AXIS_DESCR STD_AXIS NO_INPUT_QUANTITY UMR_U_MIN_32_1_0_S5_S3 6 0 8160 DEPOSIT ABSOLUTE /end AXIS_DESCR
 /begin AXIS_DESCR STD_AXIS zff_atsys._.iSignale._.obj.sig_m_t8 UMR_NM__6_1_M34_S5_S3 10 -204 1326 DEPOSIT ABSOLUTE /end AXIS_DESCR
/end CHARACTERISTIC
/begin CHARACTERISTIC KF_MEHAUPTSPORT67 "Hauptmotoreingriff Schaltablauf" MAP 0x1AA50C ZF_kf_ui8_S5_S3 1530 UMR_NM__6_1_M128_S5_S3 -768 762
 /begin AXIS_DESCR STD_AXIS iSasZentr.iSchaltend.n_tkf UMR_U_MIN_32_1_0_S5_S3 6 0 8160 DEPOSIT ABSOLUTE /end AXIS_DESCR
 /begin AXIS_DESCR STD_AXIS zff_atsys._.iSignale._.obj.sig_m_t8 UMR_NM__6_1_M34_S5_S3 10 -204 1326 DEPOSIT ABSOLUTE /end AXIS_DESCR
/end CHARACTERISTIC
/begin CHARACTERISTIC KF_MEHAUPTSPORT78 "Hauptmotoreingriff Schaltablauf" MAP 0x1AA560 ZF_kf_ui8_S5_S3 1530 UMR_NM__6_1_M128_S5_S3 -768 762
 /begin AXIS_DESCR STD_AXIS iSasZentr.iSchaltend.n_tkf UMR_U_MIN_32_1_0_S5_S3 6 0 8160 DEPOSIT ABSOLUTE /end AXIS_DESCR
 /begin AXIS_DESCR STD_AXIS zff_atsys._.iSignale._.obj.sig_m_t8 UMR_NM__6_1_M34_S5_S3 10 -204 1326 DEPOSIT ABSOLUTE /end AXIS_DESCR
/end CHARACTERISTIC
/begin CHARACTERISTIC KF_MEHAUPT_8 "Hauptmotoreingriff Schaltablauf" MAP 0x1A9BE0 ZF_kf_ui8_S5_S3 768 UMR_NM__6_1_M128_S5_S3 -768 0
 /begin AXIS_DESCR STD_AXIS NO_INPUT_QUANTITY UMR_U_MIN_32_1_0_S5_S3 6 0 8160 DEPOSIT ABSOLUTE /end AXIS_DESCR
 /begin AXIS_DESCR STD_AXIS zff_atsys._.iSignale._.obj.sig_m_t8 UMR_NM__6_1_M34_S5_S3 6 -204 1326 DEPOSIT ABSOLUTE /end AXIS_DESCR
/end CHARACTERISTIC
/begin CHARACTERISTIC KF_MEHAUPT_R "Hauptmotoreingriff Schaltablauf" MAP 0x1A95C0 ZF_kf_ui8_S5_S3 768 UMR_NM__6_1_M128_S5_S3 -768 0
 /begin AXIS_DESCR STD_AXIS NO_INPUT_QUANTITY UMR_U_MIN_32_1_0_S5_S3 6 0 8160 DEPOSIT ABSOLUTE /end AXIS_DESCR
 /begin AXIS_DESCR STD_AXIS zff_atsys._.iSignale._.obj.sig_m_t8 UMR_NM__6_1_M34_S5_S3 6 -204 1326 DEPOSIT ABSOLUTE /end AXIS_DESCR
/end CHARACTERISTIC
/begin CHARACTERISTIC KF_MENACH21 "Nachmotoreingriff Schaltablauf" MAP 0x1AABB8 ZF_kf_ui8_S5_S3 768 UMR_NM__6_1_M128_S5_S3 -768 0
 /begin AXIS_DESCR STD_AXIS iSasZentr.iSchaltend.n_tkf UMR_U_MIN_32_1_0_S5_S3 6 0 8160 DEPOSIT ABSOLUTE /end AXIS_DESCR
 /begin AXIS_DESCR STD_AXIS zff_atsys._.iSignale._.obj.sig_m_t8 UMR_NM__6_1_M34_S5_S3 6 -204 1326 DEPOSIT ABSOLUTE /end AXIS_DESCR
/end CHARACTERISTIC
/begin CHARACTERISTIC KF_MENACH21_EL "Nachmotoreingriff Schaltablauf" MAP 0x1AABF0 ZF_kf_ui8_S5_S3 768 UMR_NM__6_1_M128_S5_S3 -768 0
 /begin AXIS_DESCR STD_AXIS iSasZentr.iSchaltend.n_tkf UMR_U_MIN_32_1_0_S5_S3 6 0 8160 DEPOSIT ABSOLUTE /end AXIS_DESCR
 /begin AXIS_DESCR STD_AXIS zff_atsys._.iSignale._.obj.sig_m_t8 UMR_NM__6_1_M34_S5_S3 6 -204 1326 DEPOSIT ABSOLUTE /end AXIS_DESCR
/end CHARACTERISTIC
/begin CHARACTERISTIC KF_MENACH32 "Nachmotoreingriff Schaltablauf" MAP 0x1AADC4 ZF_kf_ui8_S5_S3 768 UMR_NM__6_1_M128_S5_S3 -768 0
 /begin AXIS_DESCR STD_AXIS iSasZentr.iSchaltend.n_tkf UMR_U_MIN_32_1_0_S5_S3 6 0 8160 DEPOSIT ABSOLUTE /end AXIS_DESCR
 /begin AXIS_DESCR STD_AXIS zff_atsys._.iSignale._.obj.sig_m_t8 UMR_NM__6_1_M34_S5_S3 6 -204 1326 DEPOSIT ABSOLUTE /end AXIS_DESCR
/end CHARACTERISTIC
/begin CHARACTERISTIC KF_MENACH32_EL "Nachmotoreingriff Schaltablauf" MAP 0x1AADFC ZF_kf_ui8_S5_S3 768 UMR_NM__6_1_M128_S5_S3 -768 0
 /begin AXIS_DESCR STD_AXIS iSasZentr.iSchaltend.n_tkf UMR_U_MIN_32_1_0_S5_S3 6 0 8160 DEPOSIT ABSOLUTE /end AXIS_DESCR
 /begin AXIS_DESCR STD_AXIS zff_atsys._.iSignale._.obj.sig_m_t8 UMR_NM__6_1_M34_S5_S3 6 -204 1326 DEPOSIT ABSOLUTE /end AXIS_DESCR
/end CHARACTERISTIC
/begin CHARACTERISTIC KF_MENACH43 "Nachmotoreingriff Schaltablauf" MAP 0x1AAFD0 ZF_kf_ui8_S5_S3 768 UMR_NM__6_1_M128_S5_S3 -768 0
 /begin AXIS_DESCR STD_AXIS iSasZentr.iSchaltend.n_tkf UMR_U_MIN_32_1_0_S5_S3 6 0 8160 DEPOSIT ABSOLUTE /end AXIS_DESCR
 /begin AXIS_DESCR STD_AXIS zff_atsys._.iSignale._.obj.sig_m_t8 UMR_NM__6_1_M34_S5_S3 6 -204 1326 DEPOSIT ABSOLUTE /end AXIS_DESCR
/end CHARACTERISTIC
/begin CHARACTERISTIC KF_MENACH43_EL "Nachmotoreingriff Schaltablauf" MAP 0x1AB008 ZF_kf_ui8_S5_S3 768 UMR_NM__6_1_M128_S5_S3 -768 0
 /begin AXIS_DESCR STD_AXIS iSasZentr.iSchaltend.n_tkf UMR_U_MIN_32_1_0_S5_S3 6 0 8160 DEPOSIT ABSOLUTE /end AXIS_DESCR
 /begin AXIS_DESCR STD_AXIS zff_atsys._.iSignale._.obj.sig_m_t8 UMR_NM__6_1_M34_S5_S3 6 -204 1326 DEPOSIT ABSOLUTE /end AXIS_DESCR
/end CHARACTERISTIC
/begin CHARACTERISTIC KF_MENACH54 "Nachmotoreingriff Schaltablauf" MAP 0x1AB1DC ZF_kf_ui8_S5_S3 768 UMR_NM__6_1_M128_S5_S3 -768 0
 /begin AXIS_DESCR STD_AXIS iSasZentr.iSchaltend.n_tkf UMR_U_MIN_32_1_0_S5_S3 6 0 8160 DEPOSIT ABSOLUTE /end AXIS_DESCR
 /begin AXIS_DESCR STD_AXIS zff_atsys._.iSignale._.obj.sig_m_t8 UMR_NM__6_1_M34_S5_S3 6 -204 1326 DEPOSIT ABSOLUTE /end AXIS_DESCR
/end CHARACTERISTIC
/begin CHARACTERISTIC KF_MENACH54_EL "Nachmotoreingriff Schaltablauf" MAP 0x1AB214 ZF_kf_ui8_S5_S3 768 UMR_NM__6_1_M128_S5_S3 -768 0
 /begin AXIS_DESCR STD_AXIS iSasZentr.iSchaltend.n_tkf UMR_U_MIN_32_1_0_S5_S3 6 0 8160 DEPOSIT ABSOLUTE /end AXIS_DESCR
 /begin AXIS_DESCR STD_AXIS zff_atsys._.iSignale._.obj.sig_m_t8 UMR_NM__6_1_M34_S5_S3 6 -204 1326 DEPOSIT ABSOLUTE /end AXIS_DESCR
/end CHARACTERISTIC
/begin CHARACTERISTIC KF_MENACH65 "Nachmotoreingriff Schaltablauf" MAP 0x1AB3E8 ZF_kf_ui8_S5_S3 768 UMR_NM__6_1_M128_S5_S3 -768 0
 /begin AXIS_DESCR STD_AXIS iSasZentr.iSchaltend.n_tkf UMR_U_MIN_32_1_0_S5_S3 6 0 8160 DEPOSIT ABSOLUTE /end AXIS_DESCR
 /begin AXIS_DESCR STD_AXIS zff_atsys._.iSignale._.obj.sig_m_t8 UMR_NM__6_1_M34_S5_S3 6 -204 1326 DEPOSIT ABSOLUTE /end AXIS_DESCR
/end CHARACTERISTIC
/begin CHARACTERISTIC KF_MENACH65_EL "Nachmotoreingriff Schaltablauf" MAP 0x1AB420 ZF_kf_ui8_S5_S3 768 UMR_NM__6_1_M128_S5_S3 -768 0
 /begin AXIS_DESCR STD_AXIS iSasZentr.iSchaltend.n_tkf UMR_U_MIN_32_1_0_S5_S3 6 0 8160 DEPOSIT ABSOLUTE /end AXIS_DESCR
 /begin AXIS_DESCR STD_AXIS zff_atsys._.iSignale._.obj.sig_m_t8 UMR_NM__6_1_M34_S5_S3 6 -204 1326 DEPOSIT ABSOLUTE /end AXIS_DESCR
/end CHARACTERISTIC
/begin CHARACTERISTIC KF_MENACH76 "Nachmotoreingriff Schaltablauf" MAP 0x1AB5F4 ZF_kf_ui8_S5_S3 768 UMR_NM__6_1_M128_S5_S3 -768 0
 /begin AXIS_DESCR STD_AXIS iSasZentr.iSchaltend.n_tkf UMR_U_MIN_32_1_0_S5_S3 6 0 8160 DEPOSIT ABSOLUTE /end AXIS_DESCR
 /begin AXIS_DESCR STD_AXIS zff_atsys._.iSignale._.obj.sig_m_t8 UMR_NM__6_1_M34_S5_S3 6 -204 1326 DEPOSIT ABSOLUTE /end AXIS_DESCR
/end CHARACTERISTIC
/begin CHARACTERISTIC KF_MENACH76_EL "Nachmotoreingriff Schaltablauf" MAP 0x1AB62C ZF_kf_ui8_S5_S3 768 UMR_NM__6_1_M128_S5_S3 -768 0
 /begin AXIS_DESCR STD_AXIS iSasZentr.iSchaltend.n_tkf UMR_U_MIN_32_1_0_S5_S3 6 0 8160 DEPOSIT ABSOLUTE /end AXIS_DESCR
 /begin AXIS_DESCR STD_AXIS zff_atsys._.iSignale._.obj.sig_m_t8 UMR_NM__6_1_M34_S5_S3 6 -204 1326 DEPOSIT ABSOLUTE /end AXIS_DESCR
/end CHARACTERISTIC
/begin CHARACTERISTIC KF_MENACH87 "Nachmotoreingriff Schaltablauf" MAP 0x1AB800 ZF_kf_ui8_S5_S3 768 UMR_NM__6_1_M128_S5_S3 -768 0
 /begin AXIS_DESCR STD_AXIS iSasZentr.iSchaltend.n_tkf UMR_U_MIN_32_1_0_S5_S3 6 0 8160 DEPOSIT ABSOLUTE /end AXIS_DESCR
 /begin AXIS_DESCR STD_AXIS zff_atsys._.iSignale._.obj.sig_m_t8 UMR_NM__6_1_M34_S5_S3 6 -204 1326 DEPOSIT ABSOLUTE /end AXIS_DESCR
/end CHARACTERISTIC
/begin CHARACTERISTIC KF_MENACH87_EL "Nachmotoreingriff Schaltablauf" MAP 0x1AB838 ZF_kf_ui8_S5_S3 768 UMR_NM__6_1_M128_S5_S3 -768 0
 /begin AXIS_DESCR STD_AXIS iSasZentr.iSchaltend.n_tkf UMR_U_MIN_32_1_0_S5_S3 6 0 8160 DEPOSIT ABSOLUTE /end AXIS_DESCR
 /begin AXIS_DESCR STD_AXIS zff_atsys._.iSignale._.obj.sig_m_t8 UMR_NM__6_1_M34_S5_S3 6 -204 1326 DEPOSIT ABSOLUTE /end AXIS_DESCR
/end CHARACTERISTIC
/begin CHARACTERISTIC KF_MENACHSP21 "Nachmotoreingriff Schaltablauf" MAP 0x1ABA04 ZF_kf_ui8_S5_S3 768 UMR_NM__6_1_M128_S5_S3 -768 0
 /begin AXIS_DESCR STD_AXIS iSasZentr.iSchaltend.n_tkf UMR_U_MIN_32_1_0_S5_S3 6 0 8160 DEPOSIT ABSOLUTE /end AXIS_DESCR
 /begin AXIS_DESCR STD_AXIS zff_atsys._.iSignale._.obj.sig_m_t8 UMR_NM__6_1_M34_S5_S3 6 -204 1326 DEPOSIT ABSOLUTE /end AXIS_DESCR
/end CHARACTERISTIC
/begin CHARACTERISTIC KF_MENACHSP31 "Nachmotoreingriff Schaltablauf" MAP 0x1AC28C ZF_kf_ui8_S5_S3 768 UMR_NM__6_1_M128_S5_S3 -768 0
 /begin AXIS_DESCR STD_AXIS iSasZentr.iSchaltend.n_tkf UMR_U_MIN_32_1_0_S5_S3 6 0 8160 DEPOSIT ABSOLUTE /end AXIS_DESCR
 /begin AXIS_DESCR STD_AXIS zff_atsys._.iSignale._.obj.sig_m_t8 UMR_NM__6_1_M34_S5_S3 6 -204 1326 DEPOSIT ABSOLUTE /end AXIS_DESCR
/end CHARACTERISTIC
/begin CHARACTERISTIC KF_MENACHSP32 "Nachmotoreingriff Schaltablauf" MAP 0x1ABB3C ZF_kf_ui8_S5_S3 768 UMR_NM__6_1_M128_S5_S3 -768 0
 /begin AXIS_DESCR STD_AXIS iSasZentr.iSchaltend.n_tkf UMR_U_MIN_32_1_0_S5_S3 6 0 8160 DEPOSIT ABSOLUTE /end AXIS_DESCR
 /begin AXIS_DESCR STD_AXIS zff_atsys._.iSignale._.obj.sig_m_t8 UMR_NM__6_1_M34_S5_S3 6 -204 1326 DEPOSIT ABSOLUTE /end AXIS_DESCR
/end CHARACTERISTIC
/begin CHARACTERISTIC KF_MENACHSP42 "Nachmotoreingriff Schaltablauf" MAP 0x1AC3C4 ZF_kf_ui8_S5_S3 768 UMR_NM__6_1_M128_S5_S3 -768 0
 /begin AXIS_DESCR STD_AXIS iSasZentr.iSchaltend.n_tkf UMR_U_MIN_32_1_0_S5_S3 6 0 8160 DEPOSIT ABSOLUTE /end AXIS_DESCR
 /begin AXIS_DESCR STD_AXIS zff_atsys._.iSignale._.obj.sig_m_t8 UMR_NM__6_1_M34_S5_S3 6 -204 1326 DEPOSIT ABSOLUTE /end AXIS_DESCR
/end CHARACTERISTIC
/begin CHARACTERISTIC KF_MENACHSP43 "Nachmotoreingriff Schaltablauf" MAP 0x1ABC74 ZF_kf_ui8_S5_S3 768 UMR_NM__6_1_M128_S5_S3 -768 0
 /begin AXIS_DESCR STD_AXIS iSasZentr.iSchaltend.n_tkf UMR_U_MIN_32_1_0_S5_S3 6 0 8160 DEPOSIT ABSOLUTE /end AXIS_DESCR
 /begin AXIS_DESCR STD_AXIS zff_atsys._.iSignale._.obj.sig_m_t8 UMR_NM__6_1_M34_S5_S3 6 -204 1326 DEPOSIT ABSOLUTE /end AXIS_DESCR
/end CHARACTERISTIC
/begin CHARACTERISTIC KF_MENACHSP51 "Nachmotoreingriff Schaltablauf" MAP 0x1AC4FC ZF_kf_ui8_S5_S3 768 UMR_NM__6_1_M128_S5_S3 -768 0
 /begin AXIS_DESCR STD_AXIS iSasZentr.iSchaltend.n_tkf UMR_U_MIN_32_1_0_S5_S3 6 0 8160 DEPOSIT ABSOLUTE /end AXIS_DESCR
 /begin AXIS_DESCR STD_AXIS zff_atsys._.iSignale._.obj.sig_m_t8 UMR_NM__6_1_M34_S5_S3 6 -204 1326 DEPOSIT ABSOLUTE /end AXIS_DESCR
/end CHARACTERISTIC
/begin CHARACTERISTIC KF_MENACHSP53 "Nachmotoreingriff Schaltablauf" MAP 0x1AC634 ZF_kf_ui8_S5_S3 768 UMR_NM__6_1_M128_S5_S3 -768 0
 /begin AXIS_DESCR STD_AXIS iSasZentr.iSchaltend.n_tkf UMR_U_MIN_32_1_0_S5_S3 6 0 8160 DEPOSIT ABSOLUTE /end AXIS_DESCR
 /begin AXIS_DESCR STD_AXIS zff_atsys._.iSignale._.obj.sig_m_t8 UMR_NM__6_1_M34_S5_S3 6 -204 1326 DEPOSIT ABSOLUTE /end AXIS_DESCR
/end CHARACTERISTIC
/begin CHARACTERISTIC KF_MENACHSP54 "Nachmotoreingriff Schaltablauf" MAP 0x1ABDAC ZF_kf_ui8_S5_S3 768 UMR_NM__6_1_M128_S5_S3 -768 0
 /begin AXIS_DESCR STD_AXIS iSasZentr.iSchaltend.n_tkf UMR_U_MIN_32_1_0_S5_S3 6 0 8160 DEPOSIT ABSOLUTE /end AXIS_DESCR
 /begin AXIS_DESCR STD_AXIS zff_atsys._.iSignale._.obj.sig_m_t8 UMR_NM__6_1_M34_S5_S3 6 -204 1326 DEPOSIT ABSOLUTE /end AXIS_DESCR
/end CHARACTERISTIC
/begin CHARACTERISTIC KF_MENACHSP63 "Nachmotoreingriff Schaltablauf" MAP 0x1AC76C ZF_kf_ui8_S5_S3 768 UMR_NM__6_1_M128_S5_S3 -768 0
 /begin AXIS_DESCR STD_AXIS iSasZentr.iSchaltend.n_tkf UMR_U_MIN_32_1_0_S5_S3 6 0 8160 DEPOSIT ABSOLUTE /end AXIS_DESCR
 /begin AXIS_DESCR STD_AXIS zff_atsys._.iSignale._.obj.sig_m_t8 UMR_NM__6_1_M34_S5_S3 6 -204 1326 DEPOSIT ABSOLUTE /end AXIS_DESCR
/end CHARACTERISTIC
/begin CHARACTERISTIC KF_MENACHSP64 "Nachmotoreingriff Schaltablauf" MAP 0x1AC8A4 ZF_kf_ui8_S5_S3 768 UMR_NM__6_1_M128_S5_S3 -768 0
 /begin AXIS_DESCR STD_AXIS iSasZentr.iSchaltend.n_tkf UMR_U_MIN_32_1_0_S5_S3 6 0 8160 DEPOSIT ABSOLUTE /end AXIS_DESCR
 /begin AXIS_DESCR STD_AXIS zff_atsys._.iSignale._.obj.sig_m_t8 UMR_NM__6_1_M34_S5_S3 6 -204 1326 DEPOSIT ABSOLUTE /end AXIS_DESCR
/end CHARACTERISTIC
/begin CHARACTERISTIC KF_MENACHSP65 "Nachmotoreingriff Schaltablauf" MAP 0x1ABEE4 ZF_kf_ui8_S5_S3 768 UMR_NM__6_1_M128_S5_S3 -768 0
 /begin AXIS_DESCR STD_AXIS iSasZentr.iSchaltend.n_tkf UMR_U_MIN_32_1_0_S5_S3 6 0 8160 DEPOSIT ABSOLUTE /end AXIS_DESCR
 /begin AXIS_DESCR STD_AXIS zff_atsys._.iSignale._.obj.sig_m_t8 UMR_NM__6_1_M34_S5_S3 6 -204 1326 DEPOSIT ABSOLUTE /end AXIS_DESCR
/end CHARACTERISTIC
/begin CHARACTERISTIC KF_MENACHSP71 "Nachmotoreingriff Schaltablauf" MAP 0x1AC9DC ZF_kf_ui8_S5_S3 768 UMR_NM__6_1_M128_S5_S3 -768 0
 /begin AXIS_DESCR STD_AXIS iSasZentr.iSchaltend.n_tkf UMR_U_MIN_32_1_0_S5_S3 6 0 8160 DEPOSIT ABSOLUTE /end AXIS_DESCR
 /begin AXIS_DESCR STD_AXIS zff_atsys._.iSignale._.obj.sig_m_t8 UMR_NM__6_1_M34_S5_S3 6 -204 1326 DEPOSIT ABSOLUTE /end AXIS_DESCR
/end CHARACTERISTIC
/begin CHARACTERISTIC KF_MENACHSP75 "Nachmotoreingriff Schaltablauf" MAP 0x1ACB14 ZF_kf_ui8_S5_S3 768 UMR_NM__6_1_M128_S5_S3 -768 0
 /begin AXIS_DESCR STD_AXIS iSasZentr.iSchaltend.n_tkf UMR_U_MIN_32_1_0_S5_S3 6 0 8160 DEPOSIT ABSOLUTE /end AXIS_DESCR
 /begin AXIS_DESCR STD_AXIS zff_atsys._.iSignale._.obj.sig_m_t8 UMR_NM__6_1_M34_S5_S3 6 -204 1326 DEPOSIT ABSOLUTE /end AXIS_DESCR
/end CHARACTERISTIC
/begin CHARACTERISTIC KF_MENACHSP76 "Nachmotoreingriff Schaltablauf" MAP 0x1AC01C ZF_kf_ui8_S5_S3 768 UMR_NM__6_1_M128_S5_S3 -768 0
 /begin AXIS_DESCR STD_AXIS iSasZentr.iSchaltend.n_tkf UMR_U_MIN_32_1_0_S5_S3 6 0 8160 DEPOSIT ABSOLUTE /end AXIS_DESCR
 /begin AXIS_DESCR STD_AXIS zff_atsys._.iSignale._.obj.sig_m_t8 UMR_NM__6_1_M34_S5_S3 6 -204 1326 DEPOSIT ABSOLUTE /end AXIS_DESCR
/end CHARACTERISTIC
/begin CHARACTERISTIC KF_MENACHSP82 "Nachmotoreingriff Schaltablauf" MAP 0x1ACC4C ZF_kf_ui8_S5_S3 768 UMR_NM__6_1_M128_S5_S3 -768 0
 /begin AXIS_DESCR STD_AXIS iSasZentr.iSchaltend.n_tkf UMR_U_MIN_32_1_0_S5_S3 6 0 8160 DEPOSIT ABSOLUTE /end AXIS_DESCR
 /begin AXIS_DESCR STD_AXIS zff_atsys._.iSignale._.obj.sig_m_t8 UMR_NM__6_1_M34_S5_S3 6 -204 1326 DEPOSIT ABSOLUTE /end AXIS_DESCR
/end CHARACTERISTIC
/begin CHARACTERISTIC KF_MENACHSP84 "Nachmotoreingriff Schaltablauf" MAP 0x1ACD84 ZF_kf_ui8_S5_S3 768 UMR_NM__6_1_M128_S5_S3 -768 0
 /begin AXIS_DESCR STD_AXIS iSasZentr.iSchaltend.n_tkf UMR_U_MIN_32_1_0_S5_S3 6 0 8160 DEPOSIT ABSOLUTE /end AXIS_DESCR
 /begin AXIS_DESCR STD_AXIS zff_atsys._.iSignale._.obj.sig_m_t8 UMR_NM__6_1_M34_S5_S3 6 -204 1326 DEPOSIT ABSOLUTE /end AXIS_DESCR
/end CHARACTERISTIC
/begin CHARACTERISTIC KF_MENACHSP86 "Nachmotoreingriff Schaltablauf" MAP 0x1ACEBC ZF_kf_ui8_S5_S3 768 UMR_NM__6_1_M128_S5_S3 -768 0
 /begin AXIS_DESCR STD_AXIS iSasZentr.iSchaltend.n_tkf UMR_U_MIN_32_1_0_S5_S3 6 0 8160 DEPOSIT ABSOLUTE /end AXIS_DESCR
 /begin AXIS_DESCR STD_AXIS zff_atsys._.iSignale._.obj.sig_m_t8 UMR_NM__6_1_M34_S5_S3 6 -204 1326 DEPOSIT ABSOLUTE /end AXIS_DESCR
/end CHARACTERISTIC
/begin CHARACTERISTIC KF_MENACHSP87 "Nachmotoreingriff Schaltablauf" MAP 0x1AC154 ZF_kf_ui8_S5_S3 768 UMR_NM__6_1_M128_S5_S3 -768 0
 /begin AXIS_DESCR STD_AXIS iSasZentr.iSchaltend.n_tkf UMR_U_MIN_32_1_0_S5_S3 6 0 8160 DEPOSIT ABSOLUTE /end AXIS_DESCR
 /begin AXIS_DESCR STD_AXIS zff_atsys._.iSignale._.obj.sig_m_t8 UMR_NM__6_1_M34_S5_S3 6 -204 1326 DEPOSIT ABSOLUTE /end AXIS_DESCR
/end CHARACTERISTIC
/begin CHARACTERISTIC KF_MENACHSPORT21 "Nachmotoreingriff Schaltablauf" MAP 0x1ACFF4 ZF_kf_ui8_S5_S3 768 UMR_NM__6_1_M128_S5_S3 -768 0
 /begin AXIS_DESCR STD_AXIS iSasZentr.iSchaltend.n_tkf UMR_U_MIN_32_1_0_S5_S3 6 0 8160 DEPOSIT ABSOLUTE /end AXIS_DESCR
 /begin AXIS_DESCR STD_AXIS zff_atsys._.iSignale._.obj.sig_m_t8 UMR_NM__6_1_M34_S5_S3 6 -204 1326 DEPOSIT ABSOLUTE /end AXIS_DESCR
/end CHARACTERISTIC
/begin CHARACTERISTIC KF_MENACHSPORT31 "Nachmotoreingriff Schaltablauf" MAP 0x1AD87C ZF_kf_ui8_S5_S3 768 UMR_NM__6_1_M128_S5_S3 -768 0
 /begin AXIS_DESCR STD_AXIS iSasZentr.iSchaltend.n_tkf UMR_U_MIN_32_1_0_S5_S3 6 0 8160 DEPOSIT ABSOLUTE /end AXIS_DESCR
 /begin AXIS_DESCR STD_AXIS zff_atsys._.iSignale._.obj.sig_m_t8 UMR_NM__6_1_M34_S5_S3 6 -204 1326 DEPOSIT ABSOLUTE /end AXIS_DESCR
/end CHARACTERISTIC
/begin CHARACTERISTIC KF_MENACHSPORT32 "Nachmotoreingriff Schaltablauf" MAP 0x1AD12C ZF_kf_ui8_S5_S3 768 UMR_NM__6_1_M128_S5_S3 -768 0
 /begin AXIS_DESCR STD_AXIS iSasZentr.iSchaltend.n_tkf UMR_U_MIN_32_1_0_S5_S3 6 0 8160 DEPOSIT ABSOLUTE /end AXIS_DESCR
 /begin AXIS_DESCR STD_AXIS zff_atsys._.iSignale._.obj.sig_m_t8 UMR_NM__6_1_M34_S5_S3 6 -204 1326 DEPOSIT ABSOLUTE /end AXIS_DESCR
/end CHARACTERISTIC
/begin CHARACTERISTIC KF_MENACHSPORT42 "Nachmotoreingriff Schaltablauf" MAP 0x1AD9B4 ZF_kf_ui8_S5_S3 768 UMR_NM__6_1_M128_S5_S3 -768 0
 /begin AXIS_DESCR STD_AXIS iSasZentr.iSchaltend.n_tkf UMR_U_MIN_32_1_0_S5_S3 6 0 8160 DEPOSIT ABSOLUTE /end AXIS_DESCR
 /begin AXIS_DESCR STD_AXIS zff_atsys._.iSignale._.obj.sig_m_t8 UMR_NM__6_1_M34_S5_S3 6 -204 1326 DEPOSIT ABSOLUTE /end AXIS_DESCR
/end CHARACTERISTIC
/begin CHARACTERISTIC KF_MENACHSPORT43 "Nachmotoreingriff Schaltablauf" MAP 0x1AD264 ZF_kf_ui8_S5_S3 768 UMR_NM__6_1_M128_S5_S3 -768 0
 /begin AXIS_DESCR STD_AXIS iSasZentr.iSchaltend.n_tkf UMR_U_MIN_32_1_0_S5_S3 6 0 8160 DEPOSIT ABSOLUTE /end AXIS_DESCR
 /begin AXIS_DESCR STD_AXIS zff_atsys._.iSignale._.obj.sig_m_t8 UMR_NM__6_1_M34_S5_S3 6 -204 1326 DEPOSIT ABSOLUTE /end AXIS_DESCR
/end CHARACTERISTIC
/begin CHARACTERISTIC KF_MENACHSPORT51 "Nachmotoreingriff Schaltablauf" MAP 0x1ADAEC ZF_kf_ui8_S5_S3 768 UMR_NM__6_1_M128_S5_S3 -768 0
 /begin AXIS_DESCR STD_AXIS iSasZentr.iSchaltend.n_tkf UMR_U_MIN_32_1_0_S5_S3 6 0 8160 DEPOSIT ABSOLUTE /end AXIS_DESCR
 /begin AXIS_DESCR STD_AXIS zff_atsys._.iSignale._.obj.sig_m_t8 UMR_NM__6_1_M34_S5_S3 6 -204 1326 DEPOSIT ABSOLUTE /end AXIS_DESCR
/end CHARACTERISTIC
/begin CHARACTERISTIC KF_MENACHSPORT53 "Nachmotoreingriff Schaltablauf" MAP 0x1ADC24 ZF_kf_ui8_S5_S3 768 UMR_NM__6_1_M128_S5_S3 -768 0
 /begin AXIS_DESCR STD_AXIS iSasZentr.iSchaltend.n_tkf UMR_U_MIN_32_1_0_S5_S3 6 0 8160 DEPOSIT ABSOLUTE /end AXIS_DESCR
 /begin AXIS_DESCR STD_AXIS zff_atsys._.iSignale._.obj.sig_m_t8 UMR_NM__6_1_M34_S5_S3 6 -204 1326 DEPOSIT ABSOLUTE /end AXIS_DESCR
/end CHARACTERISTIC
/begin CHARACTERISTIC KF_MENACHSPORT54 "Nachmotoreingriff Schaltablauf" MAP 0x1AD39C ZF_kf_ui8_S5_S3 768 UMR_NM__6_1_M128_S5_S3 -768 0
 /begin AXIS_DESCR STD_AXIS iSasZentr.iSchaltend.n_tkf UMR_U_MIN_32_1_0_S5_S3 6 0 8160 DEPOSIT ABSOLUTE /end AXIS_DESCR
 /begin AXIS_DESCR STD_AXIS zff_atsys._.iSignale._.obj.sig_m_t8 UMR_NM__6_1_M34_S5_S3 6 -204 1326 DEPOSIT ABSOLUTE /end AXIS_DESCR
/end CHARACTERISTIC
/begin CHARACTERISTIC KF_MENACHSPORT63 "Nachmotoreingriff Schaltablauf" MAP 0x1ADD5C ZF_kf_ui8_S5_S3 768 UMR_NM__6_1_M128_S5_S3 -768 0
 /begin AXIS_DESCR STD_AXIS iSasZentr.iSchaltend.n_tkf UMR_U_MIN_32_1_0_S5_S3 6 0 8160 DEPOSIT ABSOLUTE /end AXIS_DESCR
 /begin AXIS_DESCR STD_AXIS zff_atsys._.iSignale._.obj.sig_m_t8 UMR_NM__6_1_M34_S5_S3 6 -204 1326 DEPOSIT ABSOLUTE /end AXIS_DESCR
/end CHARACTERISTIC
/begin CHARACTERISTIC KF_MENACHSPORT64 "Nachmotoreingriff Schaltablauf" MAP 0x1ADE94 ZF_kf_ui8_S5_S3 768 UMR_NM__6_1_M128_S5_S3 -768 0
 /begin AXIS_DESCR STD_AXIS iSasZentr.iSchaltend.n_tkf UMR_U_MIN_32_1_0_S5_S3 6 0 8160 DEPOSIT ABSOLUTE /end AXIS_DESCR
 /begin AXIS_DESCR STD_AXIS zff_atsys._.iSignale._.obj.sig_m_t8 UMR_NM__6_1_M34_S5_S3 6 -204 1326 DEPOSIT ABSOLUTE /end AXIS_DESCR
/end CHARACTERISTIC
/begin CHARACTERISTIC KF_TSYNMTNMOTMEHAUPTA12 "Zeitkriterium Start Haupt-ME bei Momentenerhoehung" MAP 0x1AA63C ZF_kf_si16_S5_S3 5000 UMR_MSEC__10_1_0_S5_S3 -5000 0
 /begin AXIS_DESCR STD_AXIS zff_atsys._.iSignale._.obj.sig_m_t UMR_NM__1_1_0_S5_S3 4 -200 1300 DEPOSIT ABSOLUTE /end AXIS_DESCR
 /begin AXIS_DESCR STD_AXIS zff_atsys._.iSignale._.obj.sig_n_mot UMR_U_MIN_1_1_0_S5_S3 4 0 8160 DEPOSIT ABSOLUTE /end AXIS_DESCR
/end CHARACTERISTIC
/begin CHARACTERISTIC KF_TSYNMTNMOTMEHAUPTA23 "Zeitkriterium Start Haupt-ME bei Momentenerhoehung" MAP 0x1AA714 ZF_kf_si16_S5_S3 5000 UMR_MSEC__10_1_0_S5_S3 -5000 0
 /begin AXIS_DESCR STD_AXIS zff_atsys._.iSignale._.obj.sig_m_t UMR_NM__1_1_0_S5_S3 4 -200 1300 DEPOSIT ABSOLUTE /end AXIS_DESCR
 /begin AXIS_DESCR STD_AXIS zff_atsys._.iSignale._.obj.sig_n_mot UMR_U_MIN_1_1_0_S5_S3 4 0 8160 DEPOSIT ABSOLUTE /end AXIS_DESCR
/end CHARACTERISTIC
/begin CHARACTERISTIC KF_TSYNMTNMOTMEHAUPTA34 "Zeitkriterium Start Haupt-ME bei Momentenerhoehung" MAP 0x1AA7EC ZF_kf_si16_S5_S3 5000 UMR_MSEC__10_1_0_S5_S3 -5000 0
 /begin AXIS_DESCR STD_AXIS zff_atsys._.iSignale._.obj.sig_m_t UMR_NM__1_1_0_S5_S3 4 -200 1300 DEPOSIT ABSOLUTE /end AXIS_DESCR
 /begin AXIS_DESCR STD_AXIS zff_atsys._.iSignale._.obj.sig_n_mot UMR_U_MIN_1_1_0_S5_S3 4 0 8160 DEPOSIT ABSOLUTE /end AXIS_DESCR
/end CHARACTERISTIC
/begin CHARACTERISTIC KF_TSYNMTNMOTMEHAUPTA45 "Zeitkriterium Start Haupt-ME bei Momentenerhoehung" MAP 0x1AA8C4 ZF_kf_si16_S5_S3 5000 UMR_MSEC__10_1_0_S5_S3 -5000 0
 /begin AXIS_DESCR STD_AXIS zff_atsys._.iSignale._.obj.sig_m_t UMR_NM__1_1_0_S5_S3 4 -200 1300 DEPOSIT ABSOLUTE /end AXIS_DESCR
 /begin AXIS_DESCR STD_AXIS zff_atsys._.iSignale._.obj.sig_n_mot UMR_U_MIN_1_1_0_S5_S3 4 0 8160 DEPOSIT ABSOLUTE /end AXIS_DESCR
/end CHARACTERISTIC
/begin CHARACTERISTIC KF_TSYNMTNMOTMEHAUPTA56 "Zeitkriterium Start Haupt-ME bei Momentenerhoehung" MAP 0x1AA99C ZF_kf_si16_S5_S3 5000 UMR_MSEC__10_1_0_S5_S3 -5000 0
 /begin AXIS_DESCR STD_AXIS zff_atsys._.iSignale._.obj.sig_m_t UMR_NM__1_1_0_S5_S3 4 -200 1300 DEPOSIT ABSOLUTE /end AXIS_DESCR
 /begin AXIS_DESCR STD_AXIS zff_atsys._.iSignale._.obj.sig_n_mot UMR_U_MIN_1_1_0_S5_S3 4 0 8160 DEPOSIT ABSOLUTE /end AXIS_DESCR
/end CHARACTERISTIC
/begin CHARACTERISTIC KF_TSYNMTNMOTMEHAUPTA67 "Zeitkriterium Start Haupt-ME bei Momentenerhoehung" MAP 0x1AAA74 ZF_kf_si16_S5_S3 5000 UMR_MSEC__10_1_0_S5_S3 -5000 0
 /begin AXIS_DESCR STD_AXIS zff_atsys._.iSignale._.obj.sig_m_t UMR_NM__1_1_0_S5_S3 4 -200 1300 DEPOSIT ABSOLUTE /end AXIS_DESCR
 /begin AXIS_DESCR STD_AXIS zff_atsys._.iSignale._.obj.sig_n_mot UMR_U_MIN_1_1_0_S5_S3 4 0 8160 DEPOSIT ABSOLUTE /end AXIS_DESCR
/end CHARACTERISTIC
/begin CHARACTERISTIC KF_TSYNMTNMOTMEHAUPTA78 "Zeitkriterium Start Haupt-ME bei Momentenerhoehung" MAP 0x1AAB4C ZF_kf_si16_S5_S3 5000 UMR_MSEC__10_1_0_S5_S3 -5000 0
 /begin AXIS_DESCR STD_AXIS zff_atsys._.iSignale._.obj.sig_m_t UMR_NM__1_1_0_S5_S3 4 -200 1300 DEPOSIT ABSOLUTE /end AXIS_DESCR
 /begin AXIS_DESCR STD_AXIS zff_atsys._.iSignale._.obj.sig_n_mot UMR_U_MIN_1_1_0_S5_S3 4 0 8160 DEPOSIT ABSOLUTE /end AXIS_DESCR
/end CHARACTERISTIC
/begin CHARACTERISTIC KF_TSYNNTKFMTMEHAUPTE21 "Zeitkriterium Ende Haupt-ME bei Momentenerhoehung" MAP 0x1AAD30 ZF_kf_ui8_S5_S3 1280 UMR_MSEC__10_1_M128_S5_S3 -1280 0
 /begin AXIS_DESCR STD_AXIS iSasZentr.iSchaltend.n_tkf UMR_U_MIN_32_1_0_S5_S3 4 0 8160 DEPOSIT ABSOLUTE /end AXIS_DESCR
 /begin AXIS_DESCR STD_AXIS zff_atsys._.iSignale._.obj.sig_m_t8 UMR_NM__6_1_M34_S5_S3 4 -204 1326 DEPOSIT ABSOLUTE /end AXIS_DESCR
/end CHARACTERISTIC
/begin CHARACTERISTIC KF_TSYNNTKFMTMEHAUPTE21_EL "Zeitkriterium Ende Haupt-ME bei Momentenerhoehung" MAP 0x1AAD50 ZF_kf_ui8_S5_S3 1280 UMR_MSEC__10_1_M128_S5_S3 -1280 0
 /begin AXIS_DESCR STD_AXIS iSasZentr.iSchaltend.n_tkf UMR_U_MIN_32_1_0_S5_S3 4 0 8160 DEPOSIT ABSOLUTE /end AXIS_DESCR
 /begin AXIS_DESCR STD_AXIS zff_atsys._.iSignale._.obj.sig_m_t8 UMR_NM__6_1_M34_S5_S3 4 -204 1326 DEPOSIT ABSOLUTE /end AXIS_DESCR
/end CHARACTERISTIC
/begin CHARACTERISTIC KF_TSYNNTKFMTMEHAUPTE32 "Zeitkriterium Ende Haupt-ME bei Momentenerhoehung" MAP 0x1AAF3C ZF_kf_ui8_S5_S3 1280 UMR_MSEC__10_1_M128_S5_S3 -1280 0
 /begin AXIS_DESCR STD_AXIS iSasZentr.iSchaltend.n_tkf UMR_U_MIN_32_1_0_S5_S3 4 0 8160 DEPOSIT ABSOLUTE /end AXIS_DESCR
 /begin AXIS_DESCR STD_AXIS zff_atsys._.iSignale._.obj.sig_m_t8 UMR_NM__6_1_M34_S5_S3 4 -204 1326 DEPOSIT ABSOLUTE /end AXIS_DESCR
/end CHARACTERISTIC
/begin CHARACTERISTIC KF_TSYNNTKFMTMEHAUPTE32_EL "Zeitkriterium Ende Haupt-ME bei Momentenerhoehung" MAP 0x1AAF5C ZF_kf_ui8_S5_S3 1280 UMR_MSEC__10_1_M128_S5_S3 -1280 0
 /begin AXIS_DESCR STD_AXIS iSasZentr.iSchaltend.n_tkf UMR_U_MIN_32_1_0_S5_S3 4 0 8160 DEPOSIT ABSOLUTE /end AXIS_DESCR
 /begin AXIS_DESCR STD_AXIS zff_atsys._.iSignale._.obj.sig_m_t8 UMR_NM__6_1_M34_S5_S3 4 -204 1326 DEPOSIT ABSOLUTE /end AXIS_DESCR
/end CHARACTERISTIC
/begin CHARACTERISTIC KF_TSYNNTKFMTMEHAUPTE43 "Zeitkriterium Ende Haupt-ME bei Momentenerhoehung" MAP 0x1AB148 ZF_kf_ui8_S5_S3 1280 UMR_MSEC__10_1_M128_S5_S3 -1280 0
 /begin AXIS_DESCR STD_AXIS iSasZentr.iSchaltend.n_tkf UMR_U_MIN_32_1_0_S5_S3 4 0 8160 DEPOSIT ABSOLUTE /end AXIS_DESCR
 /begin AXIS_DESCR STD_AXIS zff_atsys._.iSignale._.obj.sig_m_t8 UMR_NM__6_1_M34_S5_S3 4 -204 1326 DEPOSIT ABSOLUTE /end AXIS_DESCR
/end CHARACTERISTIC
/begin CHARACTERISTIC KF_TSYNNTKFMTMEHAUPTE43_EL "Zeitkriterium Ende Haupt-ME bei Momentenerhoehung" MAP 0x1AB168 ZF_kf_ui8_S5_S3 1280 UMR_MSEC__10_1_M128_S5_S3 -1280 0
 /begin AXIS_DESCR STD_AXIS iSasZentr.iSchaltend.n_tkf UMR_U_MIN_32_1_0_S5_S3 4 0 8160 DEPOSIT ABSOLUTE /end AXIS_DESCR
 /begin AXIS_DESCR STD_AXIS zff_atsys._.iSignale._.obj.sig_m_t8 UMR_NM__6_1_M34_S5_S3 4 -204 1326 DEPOSIT ABSOLUTE /end AXIS_DESCR
/end CHARACTERISTIC
/begin CHARACTERISTIC KF_TSYNNTKFMTMEHAUPTE54 "Zeitkriterium Ende Haupt-ME bei Momentenerhoehung" MAP 0x1AB354 ZF_kf_ui8_S5_S3 1280 UMR_MSEC__10_1_M128_S5_S3 -1280 0
 /begin AXIS_DESCR STD_AXIS iSasZentr.iSchaltend.n_tkf UMR_U_MIN_32_1_0_S5_S3 4 0 8160 DEPOSIT ABSOLUTE /end AXIS_DESCR
 /begin AXIS_DESCR STD_AXIS zff_atsys._.iSignale._.obj.sig_m_t8 UMR_NM__6_1_M34_S5_S3 4 -204 1326 DEPOSIT ABSOLUTE /end AXIS_DESCR
/end CHARACTERISTIC
/begin CHARACTERISTIC KF_TSYNNTKFMTMEHAUPTE54_EL "Zeitkriterium Ende Haupt-ME bei Momentenerhoehung" MAP 0x1AB374 ZF_kf_ui8_S5_S3 1280 UMR_MSEC__10_1_M128_S5_S3 -1280 0
 /begin AXIS_DESCR STD_AXIS iSasZentr.iSchaltend.n_tkf UMR_U_MIN_32_1_0_S5_S3 4 0 8160 DEPOSIT ABSOLUTE /end AXIS_DESCR
 /begin AXIS_DESCR STD_AXIS zff_atsys._.iSignale._.obj.sig_m_t8 UMR_NM__6_1_M34_S5_S3 4 -204 1326 DEPOSIT ABSOLUTE /end AXIS_DESCR
/end CHARACTERISTIC
/begin CHARACTERISTIC KF_TSYNNTKFMTMEHAUPTE65 "Zeitkriterium Ende Haupt-ME bei Momentenerhoehung" MAP 0x1AB560 ZF_kf_ui8_S5_S3 1280 UMR_MSEC__10_1_M128_S5_S3 -1280 0
 /begin AXIS_DESCR STD_AXIS iSasZentr.iSchaltend.n_tkf UMR_U_MIN_32_1_0_S5_S3 4 0 8160 DEPOSIT ABSOLUTE /end AXIS_DESCR
 /begin AXIS_DESCR STD_AXIS zff_atsys._.iSignale._.obj.sig_m_t8 UMR_NM__6_1_M34_S5_S3 4 -204 1326 DEPOSIT ABSOLUTE /end AXIS_DESCR
/end CHARACTERISTIC
/begin CHARACTERISTIC KF_TSYNNTKFMTMEHAUPTE65_EL "Zeitkriterium Ende Haupt-ME bei Momentenerhoehung" MAP 0x1AB580 ZF_kf_ui8_S5_S3 1280 UMR_MSEC__10_1_M128_S5_S3 -1280 0
 /begin AXIS_DESCR STD_AXIS iSasZentr.iSchaltend.n_tkf UMR_U_MIN_32_1_0_S5_S3 4 0 8160 DEPOSIT ABSOLUTE /end AXIS_DESCR
 /begin AXIS_DESCR STD_AXIS zff_atsys._.iSignale._.obj.sig_m_t8 UMR_NM__6_1_M34_S5_S3 4 -204 1326 DEPOSIT ABSOLUTE /end AXIS_DESCR
/end CHARACTERISTIC
/begin CHARACTERISTIC KF_TSYNNTKFMTMEHAUPTE76 "Zeitkriterium Ende Haupt-ME bei Momentenerhoehung" MAP 0x1AB76C ZF_kf_ui8_S5_S3 1280 UMR_MSEC__10_1_M128_S5_S3 -1280 0
 /begin AXIS_DESCR STD_AXIS iSasZentr.iSchaltend.n_tkf UMR_U_MIN_32_1_0_S5_S3 4 0 8160 DEPOSIT ABSOLUTE /end AXIS_DESCR
 /begin AXIS_DESCR STD_AXIS zff_atsys._.iSignale._.obj.sig_m_t8 UMR_NM__6_1_M34_S5_S3 4 -204 1326 DEPOSIT ABSOLUTE /end AXIS_DESCR
/end CHARACTERISTIC
/begin CHARACTERISTIC KF_TSYNNTKFMTMEHAUPTE76_EL "Zeitkriterium Ende Haupt-ME bei Momentenerhoehung" MAP 0x1AB78C ZF_kf_ui8_S5_S3 1280 UMR_MSEC__10_1_M128_S5_S3 -1280 0
 /begin AXIS_DESCR STD_AXIS iSasZentr.iSchaltend.n_tkf UMR_U_MIN_32_1_0_S5_S3 4 0 8160 DEPOSIT ABSOLUTE /end AXIS_DESCR
 /begin AXIS_DESCR STD_AXIS zff_atsys._.iSignale._.obj.sig_m_t8 UMR_NM__6_1_M34_S5_S3 4 -204 1326 DEPOSIT ABSOLUTE /end AXIS_DESCR
/end CHARACTERISTIC
/begin CHARACTERISTIC KF_TSYNNTKFMTMEHAUPTE87 "Zeitkriterium Ende Haupt-ME bei Momentenerhoehung" MAP 0x1AB978 ZF_kf_ui8_S5_S3 1280 UMR_MSEC__10_1_M128_S5_S3 -1280 0
 /begin AXIS_DESCR STD_AXIS iSasZentr.iSchaltend.n_tkf UMR_U_MIN_32_1_0_S5_S3 4 0 8160 DEPOSIT ABSOLUTE /end AXIS_DESCR
 /begin AXIS_DESCR STD_AXIS zff_atsys._.iSignale._.obj.sig_m_t8 UMR_NM__6_1_M34_S5_S3 4 -204 1326 DEPOSIT ABSOLUTE /end AXIS_DESCR
/end CHARACTERISTIC
/begin CHARACTERISTIC KF_TSYNNTKFMTMEHAUPTE87_EL "Zeitkriterium Ende Haupt-ME bei Momentenerhoehung" MAP 0x1AB998 ZF_kf_ui8_S5_S3 1280 UMR_MSEC__10_1_M128_S5_S3 -1280 0
 /begin AXIS_DESCR STD_AXIS iSasZentr.iSchaltend.n_tkf UMR_U_MIN_32_1_0_S5_S3 4 0 8160 DEPOSIT ABSOLUTE /end AXIS_DESCR
 /begin AXIS_DESCR STD_AXIS zff_atsys._.iSignale._.obj.sig_m_t8 UMR_NM__6_1_M34_S5_S3 4 -204 1326 DEPOSIT ABSOLUTE /end AXIS_DESCR
/end CHARACTERISTIC
/begin CHARACTERISTIC KF_TSYNNTKFMTMEHAUPTESP21 "Zeitkriterium Ende Haupt-ME bei Momentenerhoehung" MAP 0x1ABAD0 ZF_kf_ui8_S5_S3 1280 UMR_MSEC__10_1_M128_S5_S3 -1280 0
 /begin AXIS_DESCR STD_AXIS iSasZentr.iSchaltend.n_tkf UMR_U_MIN_32_1_0_S5_S3 4 0 8160 DEPOSIT ABSOLUTE /end AXIS_DESCR
 /begin AXIS_DESCR STD_AXIS zff_atsys._.iSignale._.obj.sig_m_t8 UMR_NM__6_1_M34_S5_S3 4 -204 1326 DEPOSIT ABSOLUTE /end AXIS_DESCR
/end CHARACTERISTIC
/begin CHARACTERISTIC KF_TSYNNTKFMTMEHAUPTESP31 "Zeitkriterium Ende Haupt-ME bei Momentenerhoehung" MAP 0x1AC358 ZF_kf_ui8_S5_S3 1280 UMR_MSEC__10_1_M128_S5_S3 -1280 0
 /begin AXIS_DESCR STD_AXIS iSasZentr.iSchaltend.n_tkf UMR_U_MIN_32_1_0_S5_S3 4 0 8160 DEPOSIT ABSOLUTE /end AXIS_DESCR
 /begin AXIS_DESCR STD_AXIS zff_atsys._.iSignale._.obj.sig_m_t8 UMR_NM__6_1_M34_S5_S3 4 -204 1326 DEPOSIT ABSOLUTE /end AXIS_DESCR
/end CHARACTERISTIC
/begin CHARACTERISTIC KF_TSYNNTKFMTMEHAUPTESP32 "Zeitkriterium Ende Haupt-ME bei Momentenerhoehung" MAP 0x1ABC08 ZF_kf_ui8_S5_S3 1280 UMR_MSEC__10_1_M128_S5_S3 -1280 0
 /begin AXIS_DESCR STD_AXIS iSasZentr.iSchaltend.n_tkf UMR_U_MIN_32_1_0_S5_S3 4 0 8160 DEPOSIT ABSOLUTE /end AXIS_DESCR
 /begin AXIS_DESCR STD_AXIS zff_atsys._.iSignale._.obj.sig_m_t8 UMR_NM__6_1_M34_S5_S3 4 -204 1326 DEPOSIT ABSOLUTE /end AXIS_DESCR
/end CHARACTERISTIC
/begin CHARACTERISTIC KF_TSYNNTKFMTMEHAUPTESP42 "Zeitkriterium Ende Haupt-ME bei Momentenerhoehung" MAP 0x1AC490 ZF_kf_ui8_S5_S3 1280 UMR_MSEC__10_1_M128_S5_S3 -1280 0
 /begin AXIS_DESCR STD_AXIS iSasZentr.iSchaltend.n_tkf UMR_U_MIN_32_1_0_S5_S3 4 0 8160 DEPOSIT ABSOLUTE /end AXIS_DESCR
 /begin AXIS_DESCR STD_AXIS zff_atsys._.iSignale._.obj.sig_m_t8 UMR_NM__6_1_M34_S5_S3 4 -204 1326 DEPOSIT ABSOLUTE /end AXIS_DESCR
/end CHARACTERISTIC
/begin CHARACTERISTIC KF_TSYNNTKFMTMEHAUPTESP43 "Zeitkriterium Ende Haupt-ME bei Momentenerhoehung" MAP 0x1ABD40 ZF_kf_ui8_S5_S3 1280 UMR_MSEC__10_1_M128_S5_S3 -1280 0
 /begin AXIS_DESCR STD_AXIS iSasZentr.iSchaltend.n_tkf UMR_U_MIN_32_1_0_S5_S3 4 0 8160 DEPOSIT ABSOLUTE /end AXIS_DESCR
 /begin AXIS_DESCR STD_AXIS zff_atsys._.iSignale._.obj.sig_m_t8 UMR_NM__6_1_M34_S5_S3 4 -204 1326 DEPOSIT ABSOLUTE /end AXIS_DESCR
/end CHARACTERISTIC
/begin CHARACTERISTIC KF_TSYNNTKFMTMEHAUPTESP51 "Zeitkriterium Ende Haupt-ME bei Momentenerhoehung" MAP 0x1AC5C8 ZF_kf_ui8_S5_S3 1280 UMR_MSEC__10_1_M128_S5_S3 -1280 0
 /begin AXIS_DESCR STD_AXIS iSasZentr.iSchaltend.n_tkf UMR_U_MIN_32_1_0_S5_S3 4 0 8160 DEPOSIT ABSOLUTE /end AXIS_DESCR
 /begin AXIS_DESCR STD_AXIS zff_atsys._.iSignale._.obj.sig_m_t8 UMR_NM__6_1_M34_S5_S3 4 -204 1326 DEPOSIT ABSOLUTE /end AXIS_DESCR
/end CHARACTERISTIC
/begin CHARACTERISTIC KF_TSYNNTKFMTMEHAUPTESP53 "Zeitkriterium Ende Haupt-ME bei Momentenerhoehung" MAP 0x1AC700 ZF_kf_ui8_S5_S3 1280 UMR_MSEC__10_1_M128_S5_S3 -1280 0
 /begin AXIS_DESCR STD_AXIS iSasZentr.iSchaltend.n_tkf UMR_U_MIN_32_1_0_S5_S3 4 0 8160 DEPOSIT ABSOLUTE /end AXIS_DESCR
 /begin AXIS_DESCR STD_AXIS zff_atsys._.iSignale._.obj.sig_m_t8 UMR_NM__6_1_M34_S5_S3 4 -204 1326 DEPOSIT ABSOLUTE /end AXIS_DESCR
/end CHARACTERISTIC
/begin CHARACTERISTIC KF_TSYNNTKFMTMEHAUPTESP54 "Zeitkriterium Ende Haupt-ME bei Momentenerhoehung" MAP 0x1ABE78 ZF_kf_ui8_S5_S3 1280 UMR_MSEC__10_1_M128_S5_S3 -1280 0
 /begin AXIS_DESCR STD_AXIS iSasZentr.iSchaltend.n_tkf UMR_U_MIN_32_1_0_S5_S3 4 0 8160 DEPOSIT ABSOLUTE /end AXIS_DESCR
 /begin AXIS_DESCR STD_AXIS zff_atsys._.iSignale._.obj.sig_m_t8 UMR_NM__6_1_M34_S5_S3 4 -204 1326 DEPOSIT ABSOLUTE /end AXIS_DESCR
/end CHARACTERISTIC
/begin CHARACTERISTIC KF_TSYNNTKFMTMEHAUPTESP63 "Zeitkriterium Ende Haupt-ME bei Momentenerhoehung" MAP 0x1AC838 ZF_kf_ui8_S5_S3 1280 UMR_MSEC__10_1_M128_S5_S3 -1280 0
 /begin AXIS_DESCR STD_AXIS iSasZentr.iSchaltend.n_tkf UMR_U_MIN_32_1_0_S5_S3 4 0 8160 DEPOSIT ABSOLUTE /end AXIS_DESCR
 /begin AXIS_DESCR STD_AXIS zff_atsys._.iSignale._.obj.sig_m_t8 UMR_NM__6_1_M34_S5_S3 4 -204 1326 DEPOSIT ABSOLUTE /end AXIS_DESCR
/end CHARACTERISTIC
/begin CHARACTERISTIC KF_TSYNNTKFMTMEHAUPTESP64 "Zeitkriterium Ende Haupt-ME bei Momentenerhoehung" MAP 0x1AC970 ZF_kf_ui8_S5_S3 1280 UMR_MSEC__10_1_M128_S5_S3 -1280 0
 /begin AXIS_DESCR STD_AXIS iSasZentr.iSchaltend.n_tkf UMR_U_MIN_32_1_0_S5_S3 4 0 8160 DEPOSIT ABSOLUTE /end AXIS_DESCR
 /begin AXIS_DESCR STD_AXIS zff_atsys._.iSignale._.obj.sig_m_t8 UMR_NM__6_1_M34_S5_S3 4 -204 1326 DEPOSIT ABSOLUTE /end AXIS_DESCR
/end CHARACTERISTIC
/begin CHARACTERISTIC KF_TSYNNTKFMTMEHAUPTESP65 "Zeitkriterium Ende Haupt-ME bei Momentenerhoehung" MAP 0x1ABFB0 ZF_kf_ui8_S5_S3 1280 UMR_MSEC__10_1_M128_S5_S3 -1280 0
 /begin AXIS_DESCR STD_AXIS iSasZentr.iSchaltend.n_tkf UMR_U_MIN_32_1_0_S5_S3 4 0 8160 DEPOSIT ABSOLUTE /end AXIS_DESCR
 /begin AXIS_DESCR STD_AXIS zff_atsys._.iSignale._.obj.sig_m_t8 UMR_NM__6_1_M34_S5_S3 4 -204 1326 DEPOSIT ABSOLUTE /end AXIS_DESCR
/end CHARACTERISTIC
/begin CHARACTERISTIC KF_TSYNNTKFMTMEHAUPTESP71 "Zeitkriterium Ende Haupt-ME bei Momentenerhoehung" MAP 0x1ACAA8 ZF_kf_ui8_S5_S3 1280 UMR_MSEC__10_1_M128_S5_S3 -1280 0
 /begin AXIS_DESCR STD_AXIS iSasZentr.iSchaltend.n_tkf UMR_U_MIN_32_1_0_S5_S3 4 0 8160 DEPOSIT ABSOLUTE /end AXIS_DESCR
 /begin AXIS_DESCR STD_AXIS zff_atsys._.iSignale._.obj.sig_m_t8 UMR_NM__6_1_M34_S5_S3 4 -204 1326 DEPOSIT ABSOLUTE /end AXIS_DESCR
/end CHARACTERISTIC
/begin CHARACTERISTIC KF_TSYNNTKFMTMEHAUPTESP75 "Zeitkriterium Ende Haupt-ME bei Momentenerhoehung" MAP 0x1ACBE0 ZF_kf_ui8_S5_S3 1280 UMR_MSEC__10_1_M128_S5_S3 -1280 0
 /begin AXIS_DESCR STD_AXIS iSasZentr.iSchaltend.n_tkf UMR_U_MIN_32_1_0_S5_S3 4 0 8160 DEPOSIT ABSOLUTE /end AXIS_DESCR
 /begin AXIS_DESCR STD_AXIS zff_atsys._.iSignale._.obj.sig_m_t8 UMR_NM__6_1_M34_S5_S3 4 -204 1326 DEPOSIT ABSOLUTE /end AXIS_DESCR
/end CHARACTERISTIC
/begin CHARACTERISTIC KF_TSYNNTKFMTMEHAUPTESP76 "Zeitkriterium Ende Haupt-ME bei Momentenerhoehung" MAP 0x1AC0E8 ZF_kf_ui8_S5_S3 1280 UMR_MSEC__10_1_M128_S5_S3 -1280 0
 /begin AXIS_DESCR STD_AXIS iSasZentr.iSchaltend.n_tkf UMR_U_MIN_32_1_0_S5_S3 4 0 8160 DEPOSIT ABSOLUTE /end AXIS_DESCR
 /begin AXIS_DESCR STD_AXIS zff_atsys._.iSignale._.obj.sig_m_t8 UMR_NM__6_1_M34_S5_S3 4 -204 1326 DEPOSIT ABSOLUTE /end AXIS_DESCR
/end CHARACTERISTIC
/begin CHARACTERISTIC KF_TSYNNTKFMTMEHAUPTESP82 "Zeitkriterium Ende Haupt-ME bei Momentenerhoehung" MAP 0x1ACD18 ZF_kf_ui8_S5_S3 1280 UMR_MSEC__10_1_M128_S5_S3 -1280 0
 /begin AXIS_DESCR STD_AXIS iSasZentr.iSchaltend.n_tkf UMR_U_MIN_32_1_0_S5_S3 4 0 8160 DEPOSIT ABSOLUTE /end AXIS_DESCR
 /begin AXIS_DESCR STD_AXIS zff_atsys._.iSignale._.obj.sig_m_t8 UMR_NM__6_1_M34_S5_S3 4 -204 1326 DEPOSIT ABSOLUTE /end AXIS_DESCR
/end CHARACTERISTIC
/begin CHARACTERISTIC KF_TSYNNTKFMTMEHAUPTESP84 "Zeitkriterium Ende Haupt-ME bei Momentenerhoehung" MAP 0x1ACE50 ZF_kf_ui8_S5_S3 1280 UMR_MSEC__10_1_M128_S5_S3 -1280 0
 /begin AXIS_DESCR STD_AXIS iSasZentr.iSchaltend.n_tkf UMR_U_MIN_32_1_0_S5_S3 4 0 8160 DEPOSIT ABSOLUTE /end AXIS_DESCR
 /begin AXIS_DESCR STD_AXIS zff_atsys._.iSignale._.obj.sig_m_t8 UMR_NM__6_1_M34_S5_S3 4 -204 1326 DEPOSIT ABSOLUTE /end AXIS_DESCR
/end CHARACTERISTIC
/begin CHARACTERISTIC KF_TSYNNTKFMTMEHAUPTESP86 "Zeitkriterium Ende Haupt-ME bei Momentenerhoehung" MAP 0x1ACF88 ZF_kf_ui8_S5_S3 1280 UMR_MSEC__10_1_M128_S5_S3 -1280 0
 /begin AXIS_DESCR STD_AXIS iSasZentr.iSchaltend.n_tkf UMR_U_MIN_32_1_0_S5_S3 4 0 8160 DEPOSIT ABSOLUTE /end AXIS_DESCR
 /begin AXIS_DESCR STD_AXIS zff_atsys._.iSignale._.obj.sig_m_t8 UMR_NM__6_1_M34_S5_S3 4 -204 1326 DEPOSIT ABSOLUTE /end AXIS_DESCR
/end CHARACTERISTIC
/begin CHARACTERISTIC KF_TSYNNTKFMTMEHAUPTESP87 "Zeitkriterium Ende Haupt-ME bei Momentenerhoehung" MAP 0x1AC220 ZF_kf_ui8_S5_S3 1280 UMR_MSEC__10_1_M128_S5_S3 -1280 0
 /begin AXIS_DESCR STD_AXIS iSasZentr.iSchaltend.n_tkf UMR_U_MIN_32_1_0_S5_S3 4 0 8160 DEPOSIT ABSOLUTE /end AXIS_DESCR
 /begin AXIS_DESCR STD_AXIS zff_atsys._.iSignale._.obj.sig_m_t8 UMR_NM__6_1_M34_S5_S3 4 -204 1326 DEPOSIT ABSOLUTE /end AXIS_DESCR
/end CHARACTERISTIC
/begin CHARACTERISTIC KF_TSYNNTKFMTMEHAUPTESPORT21 "Zeitkriterium Ende Haupt-ME bei Momentenerhoehung" MAP 0x1AD0C0 ZF_kf_ui8_S5_S3 1280 UMR_MSEC__10_1_M128_S5_S3 -1280 0
 /begin AXIS_DESCR STD_AXIS iSasZentr.iSchaltend.n_tkf UMR_U_MIN_32_1_0_S5_S3 4 0 8160 DEPOSIT ABSOLUTE /end AXIS_DESCR
 /begin AXIS_DESCR STD_AXIS zff_atsys._.iSignale._.obj.sig_m_t8 UMR_NM__6_1_M34_S5_S3 4 -204 1326 DEPOSIT ABSOLUTE /end AXIS_DESCR
/end CHARACTERISTIC
/begin CHARACTERISTIC KF_TSYNNTKFMTMEHAUPTESPORT31 "Zeitkriterium Ende Haupt-ME bei Momentenerhoehung" MAP 0x1AD948 ZF_kf_ui8_S5_S3 1280 UMR_MSEC__10_1_M128_S5_S3 -1280 0
 /begin AXIS_DESCR STD_AXIS iSasZentr.iSchaltend.n_tkf UMR_U_MIN_32_1_0_S5_S3 4 0 8160 DEPOSIT ABSOLUTE /end AXIS_DESCR
 /begin AXIS_DESCR STD_AXIS zff_atsys._.iSignale._.obj.sig_m_t8 UMR_NM__6_1_M34_S5_S3 4 -204 1326 DEPOSIT ABSOLUTE /end AXIS_DESCR
/end CHARACTERISTIC
/begin CHARACTERISTIC KF_TSYNNTKFMTMEHAUPTESPORT32 "Zeitkriterium Ende Haupt-ME bei Momentenerhoehung" MAP 0x1AD1F8 ZF_kf_ui8_S5_S3 1280 UMR_MSEC__10_1_M128_S5_S3 -1280 0
 /begin AXIS_DESCR STD_AXIS iSasZentr.iSchaltend.n_tkf UMR_U_MIN_32_1_0_S5_S3 4 0 8160 DEPOSIT ABSOLUTE /end AXIS_DESCR
 /begin AXIS_DESCR STD_AXIS zff_atsys._.iSignale._.obj.sig_m_t8 UMR_NM__6_1_M34_S5_S3 4 -204 1326 DEPOSIT ABSOLUTE /end AXIS_DESCR
/end CHARACTERISTIC
/begin CHARACTERISTIC KF_TSYNNTKFMTMEHAUPTESPORT42 "Zeitkriterium Ende Haupt-ME bei Momentenerhoehung" MAP 0x1ADA80 ZF_kf_ui8_S5_S3 1280 UMR_MSEC__10_1_M128_S5_S3 -1280 0
 /begin AXIS_DESCR STD_AXIS iSasZentr.iSchaltend.n_tkf UMR_U_MIN_32_1_0_S5_S3 4 0 8160 DEPOSIT ABSOLUTE /end AXIS_DESCR
 /begin AXIS_DESCR STD_AXIS zff_atsys._.iSignale._.obj.sig_m_t8 UMR_NM__6_1_M34_S5_S3 4 -204 1326 DEPOSIT ABSOLUTE /end AXIS_DESCR
/end CHARACTERISTIC
/begin CHARACTERISTIC KF_TSYNNTKFMTMEHAUPTESPORT43 "Zeitkriterium Ende Haupt-ME bei Momentenerhoehung" MAP 0x1AD330 ZF_kf_ui8_S5_S3 1280 UMR_MSEC__10_1_M128_S5_S3 -1280 0
 /begin AXIS_DESCR STD_AXIS iSasZentr.iSchaltend.n_tkf UMR_U_MIN_32_1_0_S5_S3 4 0 8160 DEPOSIT ABSOLUTE /end AXIS_DESCR
 /begin AXIS_DESCR STD_AXIS zff_atsys._.iSignale._.obj.sig_m_t8 UMR_NM__6_1_M34_S5_S3 4 -204 1326 DEPOSIT ABSOLUTE /end AXIS_DESCR
/end CHARACTERISTIC
/begin CHARACTERISTIC KF_TSYNNTKFMTMEHAUPTESPORT51 "Zeitkriterium Ende Haupt-ME bei Momentenerhoehung" MAP 0x1ADBB8 ZF_kf_ui8_S5_S3 1280 UMR_MSEC__10_1_M128_S5_S3 -1280 0
 /begin AXIS_DESCR STD_AXIS iSasZentr.iSchaltend.n_tkf UMR_U_MIN_32_1_0_S5_S3 4 0 8160 DEPOSIT ABSOLUTE /end AXIS_DESCR
 /begin AXIS_DESCR STD_AXIS zff_atsys._.iSignale._.obj.sig_m_t8 UMR_NM__6_1_M34_S5_S3 4 -204 1326 DEPOSIT ABSOLUTE /end AXIS_DESCR
/end CHARACTERISTIC
/begin CHARACTERISTIC KF_TSYNNTKFMTMEHAUPTESPORT53 "Zeitkriterium Ende Haupt-ME bei Momentenerhoehung" MAP 0x1ADCF0 ZF_kf_ui8_S5_S3 1280 UMR_MSEC__10_1_M128_S5_S3 -1280 0
 /begin AXIS_DESCR STD_AXIS iSasZentr.iSchaltend.n_tkf UMR_U_MIN_32_1_0_S5_S3 4 0 8160 DEPOSIT ABSOLUTE /end AXIS_DESCR
 /begin AXIS_DESCR STD_AXIS zff_atsys._.iSignale._.obj.sig_m_t8 UMR_NM__6_1_M34_S5_S3 4 -204 1326 DEPOSIT ABSOLUTE /end AXIS_DESCR
/end CHARACTERISTIC
/begin CHARACTERISTIC KF_TSYNNTKFMTMEHAUPTESPORT54 "Zeitkriterium Ende Haupt-ME bei Momentenerhoehung" MAP 0x1AD468 ZF_kf_ui8_S5_S3 1280 UMR_MSEC__10_1_M128_S5_S3 -1280 0
 /begin AXIS_DESCR STD_AXIS iSasZentr.iSchaltend.n_tkf UMR_U_MIN_32_1_0_S5_S3 4 0 8160 DEPOSIT ABSOLUTE /end AXIS_DESCR
 /begin AXIS_DESCR STD_AXIS zff_atsys._.iSignale._.obj.sig_m_t8 UMR_NM__6_1_M34_S5_S3 4 -204 1326 DEPOSIT ABSOLUTE /end AXIS_DESCR
/end CHARACTERISTIC
/begin CHARACTERISTIC KF_TSYNNTKFMTMEHAUPTESPORT63 "Zeitkriterium Ende Haupt-ME bei Momentenerhoehung" MAP 0x1ADE28 ZF_kf_ui8_S5_S3 1280 UMR_MSEC__10_1_M128_S5_S3 -1280 0
 /begin AXIS_DESCR STD_AXIS iSasZentr.iSchaltend.n_tkf UMR_U_MIN_32_1_0_S5_S3 4 0 8160 DEPOSIT ABSOLUTE /end AXIS_DESCR
 /begin AXIS_DESCR STD_AXIS zff_atsys._.iSignale._.obj.sig_m_t8 UMR_NM__6_1_M34_S5_S3 4 -204 1326 DEPOSIT ABSOLUTE /end AXIS_DESCR
/end CHARACTERISTIC
/begin CHARACTERISTIC KF_TSYNNTKFMTMEHAUPTESPORT64 "Zeitkriterium Ende Haupt-ME bei Momentenerhoehung" MAP 0x1ADF60 ZF_kf_ui8_S5_S3 1280 UMR_MSEC__10_1_M128_S5_S3 -1280 0
 /begin AXIS_DESCR STD_AXIS iSasZentr.iSchaltend.n_tkf UMR_U_MIN_32_1_0_S5_S3 4 0 8160 DEPOSIT ABSOLUTE /end AXIS_DESCR
 /begin AXIS_DESCR STD_AXIS zff_atsys._.iSignale._.obj.sig_m_t8 UMR_NM__6_1_M34_S5_S3 4 -204 1326 DEPOSIT ABSOLUTE /end AXIS_DESCR
/end CHARACTERISTIC
/begin CHARACTERISTIC KF_TVMTNMOTMEHAUPT21 "Verzoegerungszeit Start Haupt-ME bei Momentenerhoehung" MAP 0x1AACF0 ZF_kf_ui8_S5_S3 2540 UMR_MSEC__10_1_0_S5_S3 0 2540
 /begin AXIS_DESCR STD_AXIS zff_atsys._.iSignale._.obj.sig_m_t8 UMR_NM__6_1_M34_S5_S3 4 -204 1326 DEPOSIT ABSOLUTE /end AXIS_DESCR
 /begin AXIS_DESCR STD_AXIS zff_atsys._.iSignale._.obj.sig_n_mot8 UMR_U_MIN_32_1_0_S5_S3 4 0 8160 DEPOSIT ABSOLUTE /end AXIS_DESCR
/end CHARACTERISTIC
/begin CHARACTERISTIC KF_TVMTNMOTMEHAUPT21_EL "Verzoegerungszeit Start Haupt-ME bei Momentenerhoehung" MAP 0x1AAD10 ZF_kf_ui8_S5_S3 2540 UMR_MSEC__10_1_0_S5_S3 0 2540
 /begin AXIS_DESCR STD_AXIS zff_atsys._.iSignale._.obj.sig_m_t8 UMR_NM__6_1_M34_S5_S3 4 -204 1326 DEPOSIT ABSOLUTE /end AXIS_DESCR
 /begin AXIS_DESCR STD_AXIS zff_atsys._.iSignale._.obj.sig_n_mot8 UMR_U_MIN_32_1_0_S5_S3 4 0 8160 DEPOSIT ABSOLUTE /end AXIS_DESCR
/end CHARACTERISTIC
/begin CHARACTERISTIC KF_TVMTNMOTMEHAUPT32 "Verzoegerungszeit Start Haupt-ME bei Momentenerhoehung" MAP 0x1AAEFC ZF_kf_ui8_S5_S3 2540 UMR_MSEC__10_1_0_S5_S3 0 2540
 /begin AXIS_DESCR STD_AXIS zff_atsys._.iSignale._.obj.sig_m_t8 UMR_NM__6_1_M34_S5_S3 4 -204 1326 DEPOSIT ABSOLUTE /end AXIS_DESCR
 /begin AXIS_DESCR STD_AXIS zff_atsys._.iSignale._.obj.sig_n_mot8 UMR_U_MIN_32_1_0_S5_S3 4 0 8160 DEPOSIT ABSOLUTE /end AXIS_DESCR
/end CHARACTERISTIC
/begin CHARACTERISTIC KF_TVMTNMOTMEHAUPT32_EL "Verzoegerungszeit Start Haupt-ME bei Momentenerhoehung" MAP 0x1AAF1C ZF_kf_ui8_S5_S3 2540 UMR_MSEC__10_1_0_S5_S3 0 2540
 /begin AXIS_DESCR STD_AXIS zff_atsys._.iSignale._.obj.sig_m_t8 UMR_NM__6_1_M34_S5_S3 4 -204 1326 DEPOSIT ABSOLUTE /end AXIS_DESCR
 /begin AXIS_DESCR STD_AXIS zff_atsys._.iSignale._.obj.sig_n_mot8 UMR_U_MIN_32_1_0_S5_S3 4 0 8160 DEPOSIT ABSOLUTE /end AXIS_DESCR
/end CHARACTERISTIC
/begin CHARACTERISTIC KF_TVMTNMOTMEHAUPT43 "Verzoegerungszeit Start Haupt-ME bei Momentenerhoehung" MAP 0x1AB108 ZF_kf_ui8_S5_S3 2540 UMR_MSEC__10_1_0_S5_S3 0 2540
 /begin AXIS_DESCR STD_AXIS zff_atsys._.iSignale._.obj.sig_m_t8 UMR_NM__6_1_M34_S5_S3 4 -204 1326 DEPOSIT ABSOLUTE /end AXIS_DESCR
 /begin AXIS_DESCR STD_AXIS zff_atsys._.iSignale._.obj.sig_n_mot8 UMR_U_MIN_32_1_0_S5_S3 4 0 8160 DEPOSIT ABSOLUTE /end AXIS_DESCR
/end CHARACTERISTIC
/begin CHARACTERISTIC KF_TVMTNMOTMEHAUPT43_EL "Verzoegerungszeit Start Haupt-ME bei Momentenerhoehung" MAP 0x1AB128 ZF_kf_ui8_S5_S3 2540 UMR_MSEC__10_1_0_S5_S3 0 2540
 /begin AXIS_DESCR STD_AXIS zff_atsys._.iSignale._.obj.sig_m_t8 UMR_NM__6_1_M34_S5_S3 4 -204 1326 DEPOSIT ABSOLUTE /end AXIS_DESCR
 /begin AXIS_DESCR STD_AXIS zff_atsys._.iSignale._.obj.sig_n_mot8 UMR_U_MIN_32_1_0_S5_S3 4 0 8160 DEPOSIT ABSOLUTE /end AXIS_DESCR
/end CHARACTERISTIC
/begin CHARACTERISTIC KF_TVMTNMOTMEHAUPT54 "Verzoegerungszeit Start Haupt-ME bei Momentenerhoehung" MAP 0x1AB314 ZF_kf_ui8_S5_S3 2540 UMR_MSEC__10_1_0_S5_S3 0 2540
 /begin AXIS_DESCR STD_AXIS zff_atsys._.iSignale._.obj.sig_m_t8 UMR_NM__6_1_M34_S5_S3 4 -204 1326 DEPOSIT ABSOLUTE /end AXIS_DESCR
 /begin AXIS_DESCR STD_AXIS zff_atsys._.iSignale._.obj.sig_n_mot8 UMR_U_MIN_32_1_0_S5_S3 4 0 8160 DEPOSIT ABSOLUTE /end AXIS_DESCR
/end CHARACTERISTIC
/begin CHARACTERISTIC KF_TVMTNMOTMEHAUPT54_EL "Verzoegerungszeit Start Haupt-ME bei Momentenerhoehung" MAP 0x1AB334 ZF_kf_ui8_S5_S3 2540 UMR_MSEC__10_1_0_S5_S3 0 2540
 /begin AXIS_DESCR STD_AXIS zff_atsys._.iSignale._.obj.sig_m_t8 UMR_NM__6_1_M34_S5_S3 4 -204 1326 DEPOSIT ABSOLUTE /end AXIS_DESCR
 /begin AXIS_DESCR STD_AXIS zff_atsys._.iSignale._.obj.sig_n_mot8 UMR_U_MIN_32_1_0_S5_S3 4 0 8160 DEPOSIT ABSOLUTE /end AXIS_DESCR
/end CHARACTERISTIC
/begin CHARACTERISTIC KF_TVMTNMOTMEHAUPT65 "Verzoegerungszeit Start Haupt-ME bei Momentenerhoehung" MAP 0x1AB520 ZF_kf_ui8_S5_S3 2540 UMR_MSEC__10_1_0_S5_S3 0 2540
 /begin AXIS_DESCR STD_AXIS zff_atsys._.iSignale._.obj.sig_m_t8 UMR_NM__6_1_M34_S5_S3 4 -204 1326 DEPOSIT ABSOLUTE /end AXIS_DESCR
 /begin AXIS_DESCR STD_AXIS zff_atsys._.iSignale._.obj.sig_n_mot8 UMR_U_MIN_32_1_0_S5_S3 4 0 8160 DEPOSIT ABSOLUTE /end AXIS_DESCR
/end CHARACTERISTIC
/begin CHARACTERISTIC KF_TVMTNMOTMEHAUPT65_EL "Verzoegerungszeit Start Haupt-ME bei Momentenerhoehung" MAP 0x1AB540 ZF_kf_ui8_S5_S3 2540 UMR_MSEC__10_1_0_S5_S3 0 2540
 /begin AXIS_DESCR STD_AXIS zff_atsys._.iSignale._.obj.sig_m_t8 UMR_NM__6_1_M34_S5_S3 4 -204 1326 DEPOSIT ABSOLUTE /end AXIS_DESCR
 /begin AXIS_DESCR STD_AXIS zff_atsys._.iSignale._.obj.sig_n_mot8 UMR_U_MIN_32_1_0_S5_S3 4 0 8160 DEPOSIT ABSOLUTE /end AXIS_DESCR
/end CHARACTERISTIC
/begin CHARACTERISTIC KF_TVMTNMOTMEHAUPT76 "Verzoegerungszeit Start Haupt-ME bei Momentenerhoehung" MAP 0x1AB72C ZF_kf_ui8_S5_S3 2540 UMR_MSEC__10_1_0_S5_S3 0 2540
 /begin AXIS_DESCR STD_AXIS zff_atsys._.iSignale._.obj.sig_m_t8 UMR_NM__6_1_M34_S5_S3 4 -204 1326 DEPOSIT ABSOLUTE /end AXIS_DESCR
 /begin AXIS_DESCR STD_AXIS zff_atsys._.iSignale._.obj.sig_n_mot8 UMR_U_MIN_32_1_0_S5_S3 4 0 8160 DEPOSIT ABSOLUTE /end AXIS_DESCR
/end CHARACTERISTIC
/begin CHARACTERISTIC KF_TVMTNMOTMEHAUPT76_EL "Verzoegerungszeit Start Haupt-ME bei Momentenerhoehung" MAP 0x1AB74C ZF_kf_ui8_S5_S3 2540 UMR_MSEC__10_1_0_S5_S3 0 2540
 /begin AXIS_DESCR STD_AXIS zff_atsys._.iSignale._.obj.sig_m_t8 UMR_NM__6_1_M34_S5_S3 4 -204 1326 DEPOSIT ABSOLUTE /end AXIS_DESCR
 /begin AXIS_DESCR STD_AXIS zff_atsys._.iSignale._.obj.sig_n_mot8 UMR_U_MIN_32_1_0_S5_S3 4 0 8160 DEPOSIT ABSOLUTE /end AXIS_DESCR
/end CHARACTERISTIC
/begin CHARACTERISTIC KF_TVMTNMOTMEHAUPT87 "Verzoegerungszeit Start Haupt-ME bei Momentenerhoehung" MAP 0x1AB938 ZF_kf_ui8_S5_S3 2540 UMR_MSEC__10_1_0_S5_S3 0 2540
 /begin AXIS_DESCR STD_AXIS zff_atsys._.iSignale._.obj.sig_m_t8 UMR_NM__6_1_M34_S5_S3 4 -204 1326 DEPOSIT ABSOLUTE /end AXIS_DESCR
 /begin AXIS_DESCR STD_AXIS zff_atsys._.iSignale._.obj.sig_n_mot8 UMR_U_MIN_32_1_0_S5_S3 4 0 8160 DEPOSIT ABSOLUTE /end AXIS_DESCR
/end CHARACTERISTIC
/begin CHARACTERISTIC KF_TVMTNMOTMEHAUPT87_EL "Verzoegerungszeit Start Haupt-ME bei Momentenerhoehung" MAP 0x1AB958 ZF_kf_ui8_S5_S3 2540 UMR_MSEC__10_1_0_S5_S3 0 2540
 /begin AXIS_DESCR STD_AXIS zff_atsys._.iSignale._.obj.sig_m_t8 UMR_NM__6_1_M34_S5_S3 4 -204 1326 DEPOSIT ABSOLUTE /end AXIS_DESCR
 /begin AXIS_DESCR STD_AXIS zff_atsys._.iSignale._.obj.sig_n_mot8 UMR_U_MIN_32_1_0_S5_S3 4 0 8160 DEPOSIT ABSOLUTE /end AXIS_DESCR
/end CHARACTERISTIC
/begin CHARACTERISTIC KF_TVMTNMOTMEHAUPTSP21 "Verzoegerungszeit Start Haupt-ME bei Momentenerhoehung" MAP 0x1ABAB0 ZF_kf_ui8_S5_S3 2540 UMR_MSEC__10_1_0_S5_S3 0 2540
 /begin AXIS_DESCR STD_AXIS zff_atsys._.iSignale._.obj.sig_m_t8 UMR_NM__6_1_M34_S5_S3 4 -204 1326 DEPOSIT ABSOLUTE /end AXIS_DESCR
 /begin AXIS_DESCR STD_AXIS zff_atsys._.iSignale._.obj.sig_n_mot8 UMR_U_MIN_32_1_0_S5_S3 4 0 8160 DEPOSIT ABSOLUTE /end AXIS_DESCR
/end CHARACTERISTIC
/begin CHARACTERISTIC KF_TVMTNMOTMEHAUPTSP31 "Verzoegerungszeit Start Haupt-ME bei Momentenerhoehung" MAP 0x1AC338 ZF_kf_ui8_S5_S3 2540 UMR_MSEC__10_1_0_S5_S3 0 2540
 /begin AXIS_DESCR STD_AXIS zff_atsys._.iSignale._.obj.sig_m_t8 UMR_NM__6_1_M34_S5_S3 4 -204 1326 DEPOSIT ABSOLUTE /end AXIS_DESCR
 /begin AXIS_DESCR STD_AXIS zff_atsys._.iSignale._.obj.sig_n_mot8 UMR_U_MIN_32_1_0_S5_S3 4 0 8160 DEPOSIT ABSOLUTE /end AXIS_DESCR
/end CHARACTERISTIC
/begin CHARACTERISTIC KF_TVMTNMOTMEHAUPTSP32 "Verzoegerungszeit Start Haupt-ME bei Momentenerhoehung" MAP 0x1ABBE8 ZF_kf_ui8_S5_S3 2540 UMR_MSEC__10_1_0_S5_S3 0 2540
 /begin AXIS_DESCR STD_AXIS zff_atsys._.iSignale._.obj.sig_m_t8 UMR_NM__6_1_M34_S5_S3 4 -204 1326 DEPOSIT ABSOLUTE /end AXIS_DESCR
 /begin AXIS_DESCR STD_AXIS zff_atsys._.iSignale._.obj.sig_n_mot8 UMR_U_MIN_32_1_0_S5_S3 4 0 8160 DEPOSIT ABSOLUTE /end AXIS_DESCR
/end CHARACTERISTIC
/begin CHARACTERISTIC KF_TVMTNMOTMEHAUPTSP42 "Verzoegerungszeit Start Haupt-ME bei Momentenerhoehung" MAP 0x1AC470 ZF_kf_ui8_S5_S3 2540 UMR_MSEC__10_1_0_S5_S3 0 2540
 /begin AXIS_DESCR STD_AXIS zff_atsys._.iSignale._.obj.sig_m_t8 UMR_NM__6_1_M34_S5_S3 4 -204 1326 DEPOSIT ABSOLUTE /end AXIS_DESCR
 /begin AXIS_DESCR STD_AXIS zff_atsys._.iSignale._.obj.sig_n_mot8 UMR_U_MIN_32_1_0_S5_S3 4 0 8160 DEPOSIT ABSOLUTE /end AXIS_DESCR
/end CHARACTERISTIC
/begin CHARACTERISTIC KF_TVMTNMOTMEHAUPTSP43 "Verzoegerungszeit Start Haupt-ME bei Momentenerhoehung" MAP 0x1ABD20 ZF_kf_ui8_S5_S3 2540 UMR_MSEC__10_1_0_S5_S3 0 2540
 /begin AXIS_DESCR STD_AXIS zff_atsys._.iSignale._.obj.sig_m_t8 UMR_NM__6_1_M34_S5_S3 4 -204 1326 DEPOSIT ABSOLUTE /end AXIS_DESCR
 /begin AXIS_DESCR STD_AXIS zff_atsys._.iSignale._.obj.sig_n_mot8 UMR_U_MIN_32_1_0_S5_S3 4 0 8160 DEPOSIT ABSOLUTE /end AXIS_DESCR
/end CHARACTERISTIC
/begin CHARACTERISTIC KF_TVMTNMOTMEHAUPTSP51 "Verzoegerungszeit Start Haupt-ME bei Momentenerhoehung" MAP 0x1AC5A8 ZF_kf_ui8_S5_S3 2540 UMR_MSEC__10_1_0_S5_S3 0 2540
 /begin AXIS_DESCR STD_AXIS zff_atsys._.iSignale._.obj.sig_m_t8 UMR_NM__6_1_M34_S5_S3 4 -204 1326 DEPOSIT ABSOLUTE /end AXIS_DESCR
 /begin AXIS_DESCR STD_AXIS zff_atsys._.iSignale._.obj.sig_n_mot8 UMR_U_MIN_32_1_0_S5_S3 4 0 8160 DEPOSIT ABSOLUTE /end AXIS_DESCR
/end CHARACTERISTIC
/begin CHARACTERISTIC KF_TVMTNMOTMEHAUPTSP53 "Verzoegerungszeit Start Haupt-ME bei Momentenerhoehung" MAP 0x1AC6E0 ZF_kf_ui8_S5_S3 2540 UMR_MSEC__10_1_0_S5_S3 0 2540
 /begin AXIS_DESCR STD_AXIS zff_atsys._.iSignale._.obj.sig_m_t8 UMR_NM__6_1_M34_S5_S3 4 -204 1326 DEPOSIT ABSOLUTE /end AXIS_DESCR
 /begin AXIS_DESCR STD_AXIS zff_atsys._.iSignale._.obj.sig_n_mot8 UMR_U_MIN_32_1_0_S5_S3 4 0 8160 DEPOSIT ABSOLUTE /end AXIS_DESCR
/end CHARACTERISTIC
/begin CHARACTERISTIC KF_TVMTNMOTMEHAUPTSP54 "Verzoegerungszeit Start Haupt-ME bei Momentenerhoehung" MAP 0x1ABE58 ZF_kf_ui8_S5_S3 2540 UMR_MSEC__10_1_0_S5_S3 0 2540
 /begin AXIS_DESCR STD_AXIS zff_atsys._.iSignale._.obj.sig_m_t8 UMR_NM__6_1_M34_S5_S3 4 -204 1326 DEPOSIT ABSOLUTE /end AXIS_DESCR
 /begin AXIS_DESCR STD_AXIS zff_atsys._.iSignale._.obj.sig_n_mot8 UMR_U_MIN_32_1_0_S5_S3 4 0 8160 DEPOSIT ABSOLUTE /end AXIS_DESCR
/end CHARACTERISTIC
/begin CHARACTERISTIC KF_TVMTNMOTMEHAUPTSP63 "Verzoegerungszeit Start Haupt-ME bei Momentenerhoehung" MAP 0x1AC818 ZF_kf_ui8_S5_S3 2540 UMR_MSEC__10_1_0_S5_S3 0 2540
 /begin AXIS_DESCR STD_AXIS zff_atsys._.iSignale._.obj.sig_m_t8 UMR_NM__6_1_M34_S5_S3 4 -204 1326 DEPOSIT ABSOLUTE /end AXIS_DESCR
 /begin AXIS_DESCR STD_AXIS zff_atsys._.iSignale._.obj.sig_n_mot8 UMR_U_MIN_32_1_0_S5_S3 4 0 8160 DEPOSIT ABSOLUTE /end AXIS_DESCR
/end CHARACTERISTIC
/begin CHARACTERISTIC KF_TVMTNMOTMEHAUPTSP64 "Verzoegerungszeit Start Haupt-ME bei Momentenerhoehung" MAP 0x1AC950 ZF_kf_ui8_S5_S3 2540 UMR_MSEC__10_1_0_S5_S3 0 2540
 /begin AXIS_DESCR STD_AXIS zff_atsys._.iSignale._.obj.sig_m_t8 UMR_NM__6_1_M34_S5_S3 4 -204 1326 DEPOSIT ABSOLUTE /end AXIS_DESCR
 /begin AXIS_DESCR STD_AXIS zff_atsys._.iSignale._.obj.sig_n_mot8 UMR_U_MIN_32_1_0_S5_S3 4 0 8160 DEPOSIT ABSOLUTE /end AXIS_DESCR
/end CHARACTERISTIC
/begin CHARACTERISTIC KF_TVMTNMOTMEHAUPTSP65 "Verzoegerungszeit Start Haupt-ME bei Momentenerhoehung" MAP 0x1ABF90 ZF_kf_ui8_S5_S3 2540 UMR_MSEC__10_1_0_S5_S3 0 2540
 /begin AXIS_DESCR STD_AXIS zff_atsys._.iSignale._.obj.sig_m_t8 UMR_NM__6_1_M34_S5_S3 4 -204 1326 DEPOSIT ABSOLUTE /end AXIS_DESCR
 /begin AXIS_DESCR STD_AXIS zff_atsys._.iSignale._.obj.sig_n_mot8 UMR_U_MIN_32_1_0_S5_S3 4 0 8160 DEPOSIT ABSOLUTE /end AXIS_DESCR
/end CHARACTERISTIC
/begin CHARACTERISTIC KF_TVMTNMOTMEHAUPTSP71 "Verzoegerungszeit Start Haupt-ME bei Momentenerhoehung" MAP 0x1ACA88 ZF_kf_ui8_S5_S3 2540 UMR_MSEC__10_1_0_S5_S3 0 2540
 /begin AXIS_DESCR STD_AXIS zff_atsys._.iSignale._.obj.sig_m_t8 UMR_NM__6_1_M34_S5_S3 4 -204 1326 DEPOSIT ABSOLUTE /end AXIS_DESCR
 /begin AXIS_DESCR STD_AXIS zff_atsys._.iSignale._.obj.sig_n_mot8 UMR_U_MIN_32_1_0_S5_S3 4 0 8160 DEPOSIT ABSOLUTE /end AXIS_DESCR
/end CHARACTERISTIC
/begin CHARACTERISTIC KF_TVMTNMOTMEHAUPTSP75 "Verzoegerungszeit Start Haupt-ME bei Momentenerhoehung" MAP 0x1ACBC0 ZF_kf_ui8_S5_S3 2540 UMR_MSEC__10_1_0_S5_S3 0 2540
 /begin AXIS_DESCR STD_AXIS zff_atsys._.iSignale._.obj.sig_m_t8 UMR_NM__6_1_M34_S5_S3 4 -204 1326 DEPOSIT ABSOLUTE /end AXIS_DESCR
 /begin AXIS_DESCR STD_AXIS zff_atsys._.iSignale._.obj.sig_n_mot8 UMR_U_MIN_32_1_0_S5_S3 4 0 8160 DEPOSIT ABSOLUTE /end AXIS_DESCR
/end CHARACTERISTIC
/begin CHARACTERISTIC KF_TVMTNMOTMEHAUPTSP76 "Verzoegerungszeit Start Haupt-ME bei Momentenerhoehung" MAP 0x1AC0C8 ZF_kf_ui8_S5_S3 2540 UMR_MSEC__10_1_0_S5_S3 0 2540
 /begin AXIS_DESCR STD_AXIS zff_atsys._.iSignale._.obj.sig_m_t8 UMR_NM__6_1_M34_S5_S3 4 -204 1326 DEPOSIT ABSOLUTE /end AXIS_DESCR
 /begin AXIS_DESCR STD_AXIS zff_atsys._.iSignale._.obj.sig_n_mot8 UMR_U_MIN_32_1_0_S5_S3 4 0 8160 DEPOSIT ABSOLUTE /end AXIS_DESCR
/end CHARACTERISTIC
/begin CHARACTERISTIC KF_TVMTNMOTMEHAUPTSP82 "Verzoegerungszeit Start Haupt-ME bei Momentenerhoehung" MAP 0x1ACCF8 ZF_kf_ui8_S5_S3 2540 UMR_MSEC__10_1_0_S5_S3 0 2540
 /begin AXIS_DESCR STD_AXIS zff_atsys._.iSignale._.obj.sig_m_t8 UMR_NM__6_1_M34_S5_S3 4 -204 1326 DEPOSIT ABSOLUTE /end AXIS_DESCR
 /begin AXIS_DESCR STD_AXIS zff_atsys._.iSignale._.obj.sig_n_mot8 UMR_U_MIN_32_1_0_S5_S3 4 0 8160 DEPOSIT ABSOLUTE /end AXIS_DESCR
/end CHARACTERISTIC
/begin CHARACTERISTIC KF_TVMTNMOTMEHAUPTSP84 "Verzoegerungszeit Start Haupt-ME bei Momentenerhoehung" MAP 0x1ACE30 ZF_kf_ui8_S5_S3 2540 UMR_MSEC__10_1_0_S5_S3 0 2540
 /begin AXIS_DESCR STD_AXIS zff_atsys._.iSignale._.obj.sig_m_t8 UMR_NM__6_1_M34_S5_S3 4 -204 1326 DEPOSIT ABSOLUTE /end AXIS_DESCR
 /begin AXIS_DESCR STD_AXIS zff_atsys._.iSignale._.obj.sig_n_mot8 UMR_U_MIN_32_1_0_S5_S3 4 0 8160 DEPOSIT ABSOLUTE /end AXIS_DESCR
/end CHARACTERISTIC
/begin CHARACTERISTIC KF_TVMTNMOTMEHAUPTSP86 "Verzoegerungszeit Start Haupt-ME bei Momentenerhoehung" MAP 0x1ACF68 ZF_kf_ui8_S5_S3 2540 UMR_MSEC__10_1_0_S5_S3 0 2540
 /begin AXIS_DESCR STD_AXIS zff_atsys._.iSignale._.obj.sig_m_t8 UMR_NM__6_1_M34_S5_S3 4 -204 1326 DEPOSIT ABSOLUTE /end AXIS_DESCR
 /begin AXIS_DESCR STD_AXIS zff_atsys._.iSignale._.obj.sig_n_mot8 UMR_U_MIN_32_1_0_S5_S3 4 0 8160 DEPOSIT ABSOLUTE /end AXIS_DESCR
/end CHARACTERISTIC
/begin CHARACTERISTIC KF_TVMTNMOTMEHAUPTSP87 "Verzoegerungszeit Start Haupt-ME bei Momentenerhoehung" MAP 0x1AC200 ZF_kf_ui8_S5_S3 2540 UMR_MSEC__10_1_0_S5_S3 0 2540
 /begin AXIS_DESCR STD_AXIS zff_atsys._.iSignale._.obj.sig_m_t8 UMR_NM__6_1_M34_S5_S3 4 -204 1326 DEPOSIT ABSOLUTE /end AXIS_DESCR
 /begin AXIS_DESCR STD_AXIS zff_atsys._.iSignale._.obj.sig_n_mot8 UMR_U_MIN_32_1_0_S5_S3 4 0 8160 DEPOSIT ABSOLUTE /end AXIS_DESCR
/end CHARACTERISTIC
/begin CHARACTERISTIC KF_TVMTNMOTMEHAUPTSPORT21 "Verzoegerungszeit Start Haupt-ME bei Momentenerhoehung" MAP 0x1AD0A0 ZF_kf_ui8_S5_S3 2540 UMR_MSEC__10_1_0_S5_S3 0 2540
 /begin AXIS_DESCR STD_AXIS zff_atsys._.iSignale._.obj.sig_m_t8 UMR_NM__6_1_M34_S5_S3 4 -204 1326 DEPOSIT ABSOLUTE /end AXIS_DESCR
 /begin AXIS_DESCR STD_AXIS zff_atsys._.iSignale._.obj.sig_n_mot8 UMR_U_MIN_32_1_0_S5_S3 4 0 8160 DEPOSIT ABSOLUTE /end AXIS_DESCR
/end CHARACTERISTIC
/begin CHARACTERISTIC KF_TVMTNMOTMEHAUPTSPORT31 "Verzoegerungszeit Start Haupt-ME bei Momentenerhoehung" MAP 0x1AD928 ZF_kf_ui8_S5_S3 2540 UMR_MSEC__10_1_0_S5_S3 0 2540
 /begin AXIS_DESCR STD_AXIS zff_atsys._.iSignale._.obj.sig_m_t8 UMR_NM__6_1_M34_S5_S3 4 -204 1326 DEPOSIT ABSOLUTE /end AXIS_DESCR
 /begin AXIS_DESCR STD_AXIS zff_atsys._.iSignale._.obj.sig_n_mot8 UMR_U_MIN_32_1_0_S5_S3 4 0 8160 DEPOSIT ABSOLUTE /end AXIS_DESCR
/end CHARACTERISTIC
/begin CHARACTERISTIC KF_TVMTNMOTMEHAUPTSPORT32 "Verzoegerungszeit Start Haupt-ME bei Momentenerhoehung" MAP 0x1AD1D8 ZF_kf_ui8_S5_S3 2540 UMR_MSEC__10_1_0_S5_S3 0 2540
 /begin AXIS_DESCR STD_AXIS zff_atsys._.iSignale._.obj.sig_m_t8 UMR_NM__6_1_M34_S5_S3 4 -204 1326 DEPOSIT ABSOLUTE /end AXIS_DESCR
 /begin AXIS_DESCR STD_AXIS zff_atsys._.iSignale._.obj.sig_n_mot8 UMR_U_MIN_32_1_0_S5_S3 4 0 8160 DEPOSIT ABSOLUTE /end AXIS_DESCR
/end CHARACTERISTIC
/begin CHARACTERISTIC KF_TVMTNMOTMEHAUPTSPORT42 "Verzoegerungszeit Start Haupt-ME bei Momentenerhoehung" MAP 0x1ADA60 ZF_kf_ui8_S5_S3 2540 UMR_MSEC__10_1_0_S5_S3 0 2540
 /begin AXIS_DESCR STD_AXIS zff_atsys._.iSignale._.obj.sig_m_t8 UMR_NM__6_1_M34_S5_S3 4 -204 1326 DEPOSIT ABSOLUTE /end AXIS_DESCR
 /begin AXIS_DESCR STD_AXIS zff_atsys._.iSignale._.obj.sig_n_mot8 UMR_U_MIN_32_1_0_S5_S3 4 0 8160 DEPOSIT ABSOLUTE /end AXIS_DESCR
/end CHARACTERISTIC
/begin CHARACTERISTIC KF_TVMTNMOTMEHAUPTSPORT43 "Verzoegerungszeit Start Haupt-ME bei Momentenerhoehung" MAP 0x1AD310 ZF_kf_ui8_S5_S3 2540 UMR_MSEC__10_1_0_S5_S3 0 2540
 /begin AXIS_DESCR STD_AXIS zff_atsys._.iSignale._.obj.sig_m_t8 UMR_NM__6_1_M34_S5_S3 4 -204 1326 DEPOSIT ABSOLUTE /end AXIS_DESCR
 /begin AXIS_DESCR STD_AXIS zff_atsys._.iSignale._.obj.sig_n_mot8 UMR_U_MIN_32_1_0_S5_S3 4 0 8160 DEPOSIT ABSOLUTE /end AXIS_DESCR
/end CHARACTERISTIC
/begin CHARACTERISTIC KF_TVMTNMOTMEHAUPTSPORT51 "Verzoegerungszeit Start Haupt-ME bei Momentenerhoehung" MAP 0x1ADB98 ZF_kf_ui8_S5_S3 2540 UMR_MSEC__10_1_0_S5_S3 0 2540
 /begin AXIS_DESCR STD_AXIS zff_atsys._.iSignale._.obj.sig_m_t8 UMR_NM__6_1_M34_S5_S3 4 -204 1326 DEPOSIT ABSOLUTE /end AXIS_DESCR
 /begin AXIS_DESCR STD_AXIS zff_atsys._.iSignale._.obj.sig_n_mot8 UMR_U_MIN_32_1_0_S5_S3 4 0 8160 DEPOSIT ABSOLUTE /end AXIS_DESCR
/end CHARACTERISTIC
/begin CHARACTERISTIC KF_TVMTNMOTMEHAUPTSPORT53 "Verzoegerungszeit Start Haupt-ME bei Momentenerhoehung" MAP 0x1ADCD0 ZF_kf_ui8_S5_S3 2540 UMR_MSEC__10_1_0_S5_S3 0 2540
 /begin AXIS_DESCR STD_AXIS zff_atsys._.iSignale._.obj.sig_m_t8 UMR_NM__6_1_M34_S5_S3 4 -204 1326 DEPOSIT ABSOLUTE /end AXIS_DESCR
 /begin AXIS_DESCR STD_AXIS zff_atsys._.iSignale._.obj.sig_n_mot8 UMR_U_MIN_32_1_0_S5_S3 4 0 8160 DEPOSIT ABSOLUTE /end AXIS_DESCR
/end CHARACTERISTIC
/begin CHARACTERISTIC KF_TVMTNMOTMEHAUPTSPORT54 "Verzoegerungszeit Start Haupt-ME bei Momentenerhoehung" MAP 0x1AD448 ZF_kf_ui8_S5_S3 2540 UMR_MSEC__10_1_0_S5_S3 0 2540
 /begin AXIS_DESCR STD_AXIS zff_atsys._.iSignale._.obj.sig_m_t8 UMR_NM__6_1_M34_S5_S3 4 -204 1326 DEPOSIT ABSOLUTE /end AXIS_DESCR
 /begin AXIS_DESCR STD_AXIS zff_atsys._.iSignale._.obj.sig_n_mot8 UMR_U_MIN_32_1_0_S5_S3 4 0 8160 DEPOSIT ABSOLUTE /end AXIS_DESCR
/end CHARACTERISTIC
/begin CHARACTERISTIC KF_TVMTNMOTMEHAUPTSPORT63 "Verzoegerungszeit Start Haupt-ME bei Momentenerhoehung" MAP 0x1ADE08 ZF_kf_ui8_S5_S3 2540 UMR_MSEC__10_1_0_S5_S3 0 2540
 /begin AXIS_DESCR STD_AXIS zff_atsys._.iSignale._.obj.sig_m_t8 UMR_NM__6_1_M34_S5_S3 4 -204 1326 DEPOSIT ABSOLUTE /end AXIS_DESCR
 /begin AXIS_DESCR STD_AXIS zff_atsys._.iSignale._.obj.sig_n_mot8 UMR_U_MIN_32_1_0_S5_S3 4 0 8160 DEPOSIT ABSOLUTE /end AXIS_DESCR
/end CHARACTERISTIC
/begin CHARACTERISTIC KF_TVMTNMOTMEHAUPTSPORT64 "Verzoegerungszeit Start Haupt-ME bei Momentenerhoehung" MAP 0x1ADF40 ZF_kf_ui8_S5_S3 2540 UMR_MSEC__10_1_0_S5_S3 0 2540
 /begin AXIS_DESCR STD_AXIS zff_atsys._.iSignale._.obj.sig_m_t8 UMR_NM__6_1_M34_S5_S3 4 -204 1326 DEPOSIT ABSOLUTE /end AXIS_DESCR
 /begin AXIS_DESCR STD_AXIS zff_atsys._.iSignale._.obj.sig_n_mot8 UMR_U_MIN_32_1_0_S5_S3 4 0 8160 DEPOSIT ABSOLUTE /end AXIS_DESCR
/end CHARACTERISTIC
/begin CHARACTERISTIC KF_ZWME12 "Zwangsmotoreingriff Schaltablauf" MAP 0x1AA5B4 ZF_kf_si16_S5_S3 768 UMR_NM__6_1_0_S5_S3 -768 0
 /begin AXIS_DESCR STD_AXIS NO_INPUT_QUANTITY UMR_U_MIN_1_1_0_S5_S3 6 -8000 8000 DEPOSIT ABSOLUTE /end AXIS_DESCR
 /begin AXIS_DESCR STD_AXIS zff_atsys._.iSignale._.obj.sig_m_t UMR_NM__1_1_0_S5_S3 6 -200 1300 DEPOSIT ABSOLUTE /end AXIS_DESCR
/end CHARACTERISTIC
/begin CHARACTERISTIC KF_ZWME23 "Zwangsmotoreingriff Schaltablauf" MAP 0x1AA68C ZF_kf_si16_S5_S3 768 UMR_NM__6_1_0_S5_S3 -768 0
 /begin AXIS_DESCR STD_AXIS NO_INPUT_QUANTITY UMR_U_MIN_1_1_0_S5_S3 6 -8000 8000 DEPOSIT ABSOLUTE /end AXIS_DESCR
 /begin AXIS_DESCR STD_AXIS zff_atsys._.iSignale._.obj.sig_m_t UMR_NM__1_1_0_S5_S3 6 -200 1300 DEPOSIT ABSOLUTE /end AXIS_DESCR
/end CHARACTERISTIC
/begin CHARACTERISTIC KF_ZWME34 "Zwangsmotoreingriff Schaltablauf" MAP 0x1AA764 ZF_kf_si16_S5_S3 768 UMR_NM__6_1_0_S5_S3 -768 0
 /begin AXIS_DESCR STD_AXIS NO_INPUT_QUANTITY UMR_U_MIN_1_1_0_S5_S3 6 -8000 8000 DEPOSIT ABSOLUTE /end AXIS_DESCR
 /begin AXIS_DESCR STD_AXIS zff_atsys._.iSignale._.obj.sig_m_t UMR_NM__1_1_0_S5_S3 6 -200 1300 DEPOSIT ABSOLUTE /end AXIS_DESCR
/end CHARACTERISTIC
/begin CHARACTERISTIC KF_ZWME45 "Zwangsmotoreingriff Schaltablauf" MAP 0x1AA83C ZF_kf_si16_S5_S3 768 UMR_NM__6_1_0_S5_S3 -768 0
 /begin AXIS_DESCR STD_AXIS NO_INPUT_QUANTITY UMR_U_MIN_1_1_0_S5_S3 6 -8000 8000 DEPOSIT ABSOLUTE /end AXIS_DESCR
 /begin AXIS_DESCR STD_AXIS zff_atsys._.iSignale._.obj.sig_m_t UMR_NM__1_1_0_S5_S3 6 -200 1300 DEPOSIT ABSOLUTE /end AXIS_DESCR
/end CHARACTERISTIC
/begin CHARACTERISTIC KF_ZWME56 "Zwangsmotoreingriff Schaltablauf" MAP 0x1AA914 ZF_kf_si16_S5_S3 768 UMR_NM__6_1_0_S5_S3 -768 0
 /begin AXIS_DESCR STD_AXIS NO_INPUT_QUANTITY UMR_U_MIN_1_1_0_S5_S3 6 -8000 8000 DEPOSIT ABSOLUTE /end AXIS_DESCR
 /begin AXIS_DESCR STD_AXIS zff_atsys._.iSignale._.obj.sig_m_t UMR_NM__1_1_0_S5_S3 6 -200 1300 DEPOSIT ABSOLUTE /end AXIS_DESCR
/end CHARACTERISTIC
/begin CHARACTERISTIC KF_ZWME67 "Zwangsmotoreingriff Schaltablauf" MAP 0x1AA9EC ZF_kf_si16_S5_S3 768 UMR_NM__6_1_0_S5_S3 -768 0
 /begin AXIS_DESCR STD_AXIS NO_INPUT_QUANTITY UMR_U_MIN_1_1_0_S5_S3 6 -8000 8000 DEPOSIT ABSOLUTE /end AXIS_DESCR
 /begin AXIS_DESCR STD_AXIS zff_atsys._.iSignale._.obj.sig_m_t UMR_NM__1_1_0_S5_S3 6 -200 1300 DEPOSIT ABSOLUTE /end AXIS_DESCR
/end CHARACTERISTIC
/begin CHARACTERISTIC KF_ZWME78 "Zwangsmotoreingriff Schaltablauf" MAP 0x1AAAC4 ZF_kf_si16_S5_S3 768 UMR_NM__6_1_0_S5_S3 -768 0
 /begin AXIS_DESCR STD_AXIS NO_INPUT_QUANTITY UMR_U_MIN_1_1_0_S5_S3 6 -8000 8000 DEPOSIT ABSOLUTE /end AXIS_DESCR
 /begin AXIS_DESCR STD_AXIS zff_atsys._.iSignale._.obj.sig_m_t UMR_NM__1_1_0_S5_S3 6 -200 1300 DEPOSIT ABSOLUTE /end AXIS_DESCR
/end CHARACTERISTIC
/begin CHARACTERISTIC KL_FMEHAUPTPOSE12 "Faktor fuer Ruecknahmerampe bei Momentenerhoehung" CURVE 0x1AA61C ZF_kl_ui8_S5_S3 1 UMR___1_100_0_S5_S3 0 1
 /begin AXIS_DESCR STD_AXIS iMoeMesaf.timer_zmes UMR_MSEC__10_1_0_S5_S3 6 0 2550 DEPOSIT ABSOLUTE /end AXIS_DESCR
/end CHARACTERISTIC
/begin CHARACTERISTIC KL_FMEHAUPTPOSE23 "Faktor fuer Ruecknahmerampe bei Momentenerhoehung" CURVE 0x1AA6F4 ZF_kl_ui8_S5_S3 1 UMR___1_100_0_S5_S3 0 1
 /begin AXIS_DESCR STD_AXIS iMoeMesaf.timer_zmes UMR_MSEC__10_1_0_S5_S3 6 0 2550 DEPOSIT ABSOLUTE /end AXIS_DESCR
/end CHARACTERISTIC
/begin CHARACTERISTIC KL_FMEHAUPTPOSE34 "Faktor fuer Ruecknahmerampe bei Momentenerhoehung" CURVE 0x1AA7CC ZF_kl_ui8_S5_S3 1 UMR___1_100_0_S5_S3 0 1
 /begin AXIS_DESCR STD_AXIS iMoeMesaf.timer_zmes UMR_MSEC__10_1_0_S5_S3 6 0 2550 DEPOSIT ABSOLUTE /end AXIS_DESCR
/end CHARACTERISTIC
/begin CHARACTERISTIC KL_FMEHAUPTPOSE45 "Faktor fuer Ruecknahmerampe bei Momentenerhoehung" CURVE 0x1AA8A4 ZF_kl_ui8_S5_S3 1 UMR___1_100_0_S5_S3 0 1
 /begin AXIS_DESCR STD_AXIS iMoeMesaf.timer_zmes UMR_MSEC__10_1_0_S5_S3 6 0 2550 DEPOSIT ABSOLUTE /end AXIS_DESCR
/end CHARACTERISTIC
/begin CHARACTERISTIC KL_FMEHAUPTPOSE56 "Faktor fuer Ruecknahmerampe bei Momentenerhoehung" CURVE 0x1AA97C ZF_kl_ui8_S5_S3 1 UMR___1_100_0_S5_S3 0 1
 /begin AXIS_DESCR STD_AXIS iMoeMesaf.timer_zmes UMR_MSEC__10_1_0_S5_S3 6 0 2550 DEPOSIT ABSOLUTE /end AXIS_DESCR
/end CHARACTERISTIC
/begin CHARACTERISTIC KL_FMEHAUPTPOSE67 "Faktor fuer Ruecknahmerampe bei Momentenerhoehung" CURVE 0x1AAA54 ZF_kl_ui8_S5_S3 1 UMR___1_100_0_S5_S3 0 1
 /begin AXIS_DESCR STD_AXIS iMoeMesaf.timer_zmes UMR_MSEC__10_1_0_S5_S3 6 0 2550 DEPOSIT ABSOLUTE /end AXIS_DESCR
/end CHARACTERISTIC
/begin CHARACTERISTIC KL_FMEHAUPTPOSE78 "Faktor fuer Ruecknahmerampe bei Momentenerhoehung" CURVE 0x1AAB2C ZF_kl_ui8_S5_S3 1 UMR___1_100_0_S5_S3 0 1
 /begin AXIS_DESCR STD_AXIS iMoeMesaf.timer_zmes UMR_MSEC__10_1_0_S5_S3 6 0 2550 DEPOSIT ABSOLUTE /end AXIS_DESCR
/end CHARACTERISTIC
/begin CHARACTERISTIC KL_FMENACHE21 "Faktor fuer Rampe Ende Nach-ME bei RS" CURVE 0x1AAB9C ZF_kl_ui8_S5_S3 1 UMR___1_100_0_S5_S3 0 1
 /begin AXIS_DESCR STD_AXIS iMoeMesaf.timer_zmes UMR_MSEC__10_1_0_S5_S3 4 0 2550 DEPOSIT ABSOLUTE /end AXIS_DESCR
/end CHARACTERISTIC
/begin CHARACTERISTIC KL_FMENACHE32 "Faktor fuer Rampe Ende Nach-ME bei RS" CURVE 0x1AADA8 ZF_kl_ui8_S5_S3 1 UMR___1_100_0_S5_S3 0 1
 /begin AXIS_DESCR STD_AXIS iMoeMesaf.timer_zmes UMR_MSEC__10_1_0_S5_S3 4 0 2550 DEPOSIT ABSOLUTE /end AXIS_DESCR
/end CHARACTERISTIC
/begin CHARACTERISTIC KL_FMENACHE43 "Faktor fuer Rampe Ende Nach-ME bei RS" CURVE 0x1AAFB4 ZF_kl_ui8_S5_S3 1 UMR___1_100_0_S5_S3 0 1
 /begin AXIS_DESCR STD_AXIS iMoeMesaf.timer_zmes UMR_MSEC__10_1_0_S5_S3 4 0 2550 DEPOSIT ABSOLUTE /end AXIS_DESCR
/end CHARACTERISTIC
/begin CHARACTERISTIC KL_FMENACHE54 "Faktor fuer Rampe Ende Nach-ME bei RS" CURVE 0x1AB1C0 ZF_kl_ui8_S5_S3 1 UMR___1_100_0_S5_S3 0 1
 /begin AXIS_DESCR STD_AXIS iMoeMesaf.timer_zmes UMR_MSEC__10_1_0_S5_S3 4 0 2550 DEPOSIT ABSOLUTE /end AXIS_DESCR
/end CHARACTERISTIC
/begin CHARACTERISTIC KL_FMENACHE65 "Faktor fuer Rampe Ende Nach-ME bei RS" CURVE 0x1AB3CC ZF_kl_ui8_S5_S3 1 UMR___1_100_0_S5_S3 0 1
 /begin AXIS_DESCR STD_AXIS iMoeMesaf.timer_zmes UMR_MSEC__10_1_0_S5_S3 4 0 2550 DEPOSIT ABSOLUTE /end AXIS_DESCR
/end CHARACTERISTIC
/begin CHARACTERISTIC KL_FMENACHE76 "Faktor fuer Rampe Ende Nach-ME bei RS" CURVE 0x1AB5D8 ZF_kl_ui8_S5_S3 1 UMR___1_100_0_S5_S3 0 1
 /begin AXIS_DESCR STD_AXIS iMoeMesaf.timer_zmes UMR_MSEC__10_1_0_S5_S3 4 0 2550 DEPOSIT ABSOLUTE /end AXIS_DESCR
/end CHARACTERISTIC
/begin CHARACTERISTIC KL_FMENACHE87 "Faktor fuer Rampe Ende Nach-ME bei RS" CURVE 0x1AB7E4 ZF_kl_ui8_S5_S3 1 UMR___1_100_0_S5_S3 0 1
 /begin AXIS_DESCR STD_AXIS iMoeMesaf.timer_zmes UMR_MSEC__10_1_0_S5_S3 4 0 2550 DEPOSIT ABSOLUTE /end AXIS_DESCR
/end CHARACTERISTIC
/begin CHARACTERISTIC KL_FMENACHESP21 "Faktor fuer Rampe Ende Nach-ME bei RS" CURVE 0x1AB9F0 ZF_kl_ui8_S5_S3 1 UMR___1_100_0_S5_S3 0 1
 /begin AXIS_DESCR STD_AXIS iMoeMesaf.timer_zmes UMR_MSEC__10_1_0_S5_S3 4 0 2550 DEPOSIT ABSOLUTE /end AXIS_DESCR
/end CHARACTERISTIC
/begin CHARACTERISTIC KL_FMENACHESP31 "Faktor fuer Rampe Ende Nach-ME bei RS" CURVE 0x1AC278 ZF_kl_ui8_S5_S3 1 UMR___1_100_0_S5_S3 0 1
 /begin AXIS_DESCR STD_AXIS iMoeMesaf.timer_zmes UMR_MSEC__10_1_0_S5_S3 4 0 2550 DEPOSIT ABSOLUTE /end AXIS_DESCR
/end CHARACTERISTIC
/begin CHARACTERISTIC KL_FMENACHESP32 "Faktor fuer Rampe Ende Nach-ME bei RS" CURVE 0x1ABB28 ZF_kl_ui8_S5_S3 1 UMR___1_100_0_S5_S3 0 1
 /begin AXIS_DESCR STD_AXIS iMoeMesaf.timer_zmes UMR_MSEC__10_1_0_S5_S3 4 0 2550 DEPOSIT ABSOLUTE /end AXIS_DESCR
/end CHARACTERISTIC
/begin CHARACTERISTIC KL_FMENACHESP42 "Faktor fuer Rampe Ende Nach-ME bei RS" CURVE 0x1AC3B0 ZF_kl_ui8_S5_S3 1 UMR___1_100_0_S5_S3 0 1
 /begin AXIS_DESCR STD_AXIS iMoeMesaf.timer_zmes UMR_MSEC__10_1_0_S5_S3 4 0 2550 DEPOSIT ABSOLUTE /end AXIS_DESCR
/end CHARACTERISTIC
/begin CHARACTERISTIC KL_FMENACHESP43 "Faktor fuer Rampe Ende Nach-ME bei RS" CURVE 0x1ABC60 ZF_kl_ui8_S5_S3 1 UMR___1_100_0_S5_S3 0 1
 /begin AXIS_DESCR STD_AXIS iMoeMesaf.timer_zmes UMR_MSEC__10_1_0_S5_S3 4 0 2550 DEPOSIT ABSOLUTE /end AXIS_DESCR
/end CHARACTERISTIC
/begin CHARACTERISTIC KL_FMENACHESP51 "Faktor fuer Rampe Ende Nach-ME bei RS" CURVE 0x1AC4E8 ZF_kl_ui8_S5_S3 1 UMR___1_100_0_S5_S3 0 1
 /begin AXIS_DESCR STD_AXIS iMoeMesaf.timer_zmes UMR_MSEC__10_1_0_S5_S3 4 0 2550 DEPOSIT ABSOLUTE /end AXIS_DESCR
/end CHARACTERISTIC
/begin CHARACTERISTIC KL_FMENACHESP53 "Faktor fuer Rampe Ende Nach-ME bei RS" CURVE 0x1AC620 ZF_kl_ui8_S5_S3 1 UMR___1_100_0_S5_S3 0 1
 /begin AXIS_DESCR STD_AXIS iMoeMesaf.timer_zmes UMR_MSEC__10_1_0_S5_S3 4 0 2550 DEPOSIT ABSOLUTE /end AXIS_DESCR
/end CHARACTERISTIC
/begin CHARACTERISTIC KL_FMENACHESP54 "Faktor fuer Rampe Ende Nach-ME bei RS" CURVE 0x1ABD98 ZF_kl_ui8_S5_S3 1 UMR___1_100_0_S5_S3 0 1
 /begin AXIS_DESCR STD_AXIS iMoeMesaf.timer_zmes UMR_MSEC__10_1_0_S5_S3 4 0 2550 DEPOSIT ABSOLUTE /end AXIS_DESCR
/end CHARACTERISTIC
/begin CHARACTERISTIC KL_FMENACHESP63 "Faktor fuer Rampe Ende Nach-ME bei RS" CURVE 0x1AC758 ZF_kl_ui8_S5_S3 1 UMR___1_100_0_S5_S3 0 1
 /begin AXIS_DESCR STD_AXIS iMoeMesaf.timer_zmes UMR_MSEC__10_1_0_S5_S3 4 0 2550 DEPOSIT ABSOLUTE /end AXIS_DESCR
/end CHARACTERISTIC
/begin CHARACTERISTIC KL_FMENACHESP64 "Faktor fuer Rampe Ende Nach-ME bei RS" CURVE 0x1AC890 ZF_kl_ui8_S5_S3 1 UMR___1_100_0_S5_S3 0 1
 /begin AXIS_DESCR STD_AXIS iMoeMesaf.timer_zmes UMR_MSEC__10_1_0_S5_S3 4 0 2550 DEPOSIT ABSOLUTE /end AXIS_DESCR
/end CHARACTERISTIC
/begin CHARACTERISTIC KL_FMENACHESP65 "Faktor fuer Rampe Ende Nach-ME bei RS" CURVE 0x1ABED0 ZF_kl_ui8_S5_S3 1 UMR___1_100_0_S5_S3 0 1
 /begin AXIS_DESCR STD_AXIS iMoeMesaf.timer_zmes UMR_MSEC__10_1_0_S5_S3 4 0 2550 DEPOSIT ABSOLUTE /end AXIS_DESCR
/end CHARACTERISTIC
/begin CHARACTERISTIC KL_FMENACHESP71 "Faktor fuer Rampe Ende Nach-ME bei RS" CURVE 0x1AC9C8 ZF_kl_ui8_S5_S3 1 UMR___1_100_0_S5_S3 0 1
 /begin AXIS_DESCR STD_AXIS iMoeMesaf.timer_zmes UMR_MSEC__10_1_0_S5_S3 4 0 2550 DEPOSIT ABSOLUTE /end AXIS_DESCR
/end CHARACTERISTIC
/begin CHARACTERISTIC KL_FMENACHESP75 "Faktor fuer Rampe Ende Nach-ME bei RS" CURVE 0x1ACB00 ZF_kl_ui8_S5_S3 1 UMR___1_100_0_S5_S3 0 1
 /begin AXIS_DESCR STD_AXIS iMoeMesaf.timer_zmes UMR_MSEC__10_1_0_S5_S3 4 0 2550 DEPOSIT ABSOLUTE /end AXIS_DESCR
/end CHARACTERISTIC
/begin CHARACTERISTIC KL_FMENACHESP76 "Faktor fuer Rampe Ende Nach-ME bei RS" CURVE 0x1AC008 ZF_kl_ui8_S5_S3 1 UMR___1_100_0_S5_S3 0 1
 /begin AXIS_DESCR STD_AXIS iMoeMesaf.timer_zmes UMR_MSEC__10_1_0_S5_S3 4 0 2550 DEPOSIT ABSOLUTE /end AXIS_DESCR
/end CHARACTERISTIC
/begin CHARACTERISTIC KL_FMENACHESP82 "Faktor fuer Rampe Ende Nach-ME bei RS" CURVE 0x1ACC38 ZF_kl_ui8_S5_S3 1 UMR___1_100_0_S5_S3 0 1
 /begin AXIS_DESCR STD_AXIS iMoeMesaf.timer_zmes UMR_MSEC__10_1_0_S5_S3 4 0 2550 DEPOSIT ABSOLUTE /end AXIS_DESCR
/end CHARACTERISTIC
/begin CHARACTERISTIC KL_FMENACHESP84 "Faktor fuer Rampe Ende Nach-ME bei RS" CURVE 0x1ACD70 ZF_kl_ui8_S5_S3 1 UMR___1_100_0_S5_S3 0 1
 /begin AXIS_DESCR STD_AXIS iMoeMesaf.timer_zmes UMR_MSEC__10_1_0_S5_S3 4 0 2550 DEPOSIT ABSOLUTE /end AXIS_DESCR
/end CHARACTERISTIC
/begin CHARACTERISTIC KL_FMENACHESP86 "Faktor fuer Rampe Ende Nach-ME bei RS" CURVE 0x1ACEA8 ZF_kl_ui8_S5_S3 1 UMR___1_100_0_S5_S3 0 1
 /begin AXIS_DESCR STD_AXIS iMoeMesaf.timer_zmes UMR_MSEC__10_1_0_S5_S3 4 0 2550 DEPOSIT ABSOLUTE /end AXIS_DESCR
/end CHARACTERISTIC
/begin CHARACTERISTIC KL_FMENACHESP87 "Faktor fuer Rampe Ende Nach-ME bei RS" CURVE 0x1AC140 ZF_kl_ui8_S5_S3 1 UMR___1_100_0_S5_S3 0 1
 /begin AXIS_DESCR STD_AXIS iMoeMesaf.timer_zmes UMR_MSEC__10_1_0_S5_S3 4 0 2550 DEPOSIT ABSOLUTE /end AXIS_DESCR
/end CHARACTERISTIC
/begin CHARACTERISTIC KL_FMENACHESPORT21 "Faktor fuer Rampe Ende Nach-ME bei RS" CURVE 0x1ACFE0 ZF_kl_ui8_S5_S3 1 UMR___1_100_0_S5_S3 0 1
 /begin AXIS_DESCR STD_AXIS iMoeMesaf.timer_zmes UMR_MSEC__10_1_0_S5_S3 4 0 2550 DEPOSIT ABSOLUTE /end AXIS_DESCR
/end CHARACTERISTIC
/begin CHARACTERISTIC KL_FMENACHESPORT31 "Faktor fuer Rampe Ende Nach-ME bei RS" CURVE 0x1AD868 ZF_kl_ui8_S5_S3 1 UMR___1_100_0_S5_S3 0 1
 /begin AXIS_DESCR STD_AXIS iMoeMesaf.timer_zmes UMR_MSEC__10_1_0_S5_S3 4 0 2550 DEPOSIT ABSOLUTE /end AXIS_DESCR
/end CHARACTERISTIC
/begin CHARACTERISTIC KL_FMENACHESPORT32 "Faktor fuer Rampe Ende Nach-ME bei RS" CURVE 0x1AD118 ZF_kl_ui8_S5_S3 1 UMR___1_100_0_S5_S3 0 1
 /begin AXIS_DESCR STD_AXIS iMoeMesaf.timer_zmes UMR_MSEC__10_1_0_S5_S3 4 0 2550 DEPOSIT ABSOLUTE /end AXIS_DESCR
/end CHARACTERISTIC
/begin CHARACTERISTIC KL_FMENACHESPORT42 "Faktor fuer Rampe Ende Nach-ME bei RS" CURVE 0x1AD9A0 ZF_kl_ui8_S5_S3 1 UMR___1_100_0_S5_S3 0 1
 /begin AXIS_DESCR STD_AXIS iMoeMesaf.timer_zmes UMR_MSEC__10_1_0_S5_S3 4 0 2550 DEPOSIT ABSOLUTE /end AXIS_DESCR
/end CHARACTERISTIC
/begin CHARACTERISTIC KL_FMENACHESPORT43 "Faktor fuer Rampe Ende Nach-ME bei RS" CURVE 0x1AD250 ZF_kl_ui8_S5_S3 1 UMR___1_100_0_S5_S3 0 1
 /begin AXIS_DESCR STD_AXIS iMoeMesaf.timer_zmes UMR_MSEC__10_1_0_S5_S3 4 0 2550 DEPOSIT ABSOLUTE /end AXIS_DESCR
/end CHARACTERISTIC
/begin CHARACTERISTIC KL_FMENACHESPORT51 "Faktor fuer Rampe Ende Nach-ME bei RS" CURVE 0x1ADAD8 ZF_kl_ui8_S5_S3 1 UMR___1_100_0_S5_S3 0 1
 /begin AXIS_DESCR STD_AXIS iMoeMesaf.timer_zmes UMR_MSEC__10_1_0_S5_S3 4 0 2550 DEPOSIT ABSOLUTE /end AXIS_DESCR
/end CHARACTERISTIC
/begin CHARACTERISTIC KL_FMENACHESPORT53 "Faktor fuer Rampe Ende Nach-ME bei RS" CURVE 0x1ADC10 ZF_kl_ui8_S5_S3 1 UMR___1_100_0_S5_S3 0 1
 /begin AXIS_DESCR STD_AXIS iMoeMesaf.timer_zmes UMR_MSEC__10_1_0_S5_S3 4 0 2550 DEPOSIT ABSOLUTE /end AXIS_DESCR
/end CHARACTERISTIC
/begin CHARACTERISTIC KL_FMENACHESPORT54 "Faktor fuer Rampe Ende Nach-ME bei RS" CURVE 0x1AD388 ZF_kl_ui8_S5_S3 1 UMR___1_100_0_S5_S3 0 1
 /begin AXIS_DESCR STD_AXIS iMoeMesaf.timer_zmes UMR_MSEC__10_1_0_S5_S3 4 0 2550 DEPOSIT ABSOLUTE /end AXIS_DESCR
/end CHARACTERISTIC
/begin CHARACTERISTIC KL_FMENACHESPORT63 "Faktor fuer Rampe Ende Nach-ME bei RS" CURVE 0x1ADD48 ZF_kl_ui8_S5_S3 1 UMR___1_100_0_S5_S3 0 1
 /begin AXIS_DESCR STD_AXIS iMoeMesaf.timer_zmes UMR_MSEC__10_1_0_S5_S3 4 0 2550 DEPOSIT ABSOLUTE /end AXIS_DESCR
/end CHARACTERISTIC
/begin CHARACTERISTIC KL_FMENACHESPORT64 "Faktor fuer Rampe Ende Nach-ME bei RS" CURVE 0x1ADE80 ZF_kl_ui8_S5_S3 1 UMR___1_100_0_S5_S3 0 1
 /begin AXIS_DESCR STD_AXIS iMoeMesaf.timer_zmes UMR_MSEC__10_1_0_S5_S3 4 0 2550 DEPOSIT ABSOLUTE /end AXIS_DESCR
/end CHARACTERISTIC
/begin CHARACTERISTIC KL_MEKPOSCM12 "Erhoehungsfaktor ME f(Mot.temp)" CURVE 0x1AA674 ZF_kl_ui8_S5_S3 100 UMR_PROZENT__20_51_0_S5_S3 0 100
 /begin AXIS_DESCR STD_AXIS zff_atsys._.iSignale._.obj.sig_c_mot UMR_GRADC__1_1_M48_S5_S3 4 -48 144 DEPOSIT ABSOLUTE /end AXIS_DESCR
/end CHARACTERISTIC
/begin CHARACTERISTIC KL_MEKPOSCM23 "Erhoehungsfaktor ME f(Mot.temp)" CURVE 0x1AA74C ZF_kl_ui8_S5_S3 100 UMR_PROZENT__20_51_0_S5_S3 0 100
 /begin AXIS_DESCR STD_AXIS zff_atsys._.iSignale._.obj.sig_c_mot UMR_GRADC__1_1_M48_S5_S3 4 -48 144 DEPOSIT ABSOLUTE /end AXIS_DESCR
/end CHARACTERISTIC
/begin CHARACTERISTIC KL_MEKPOSCM34 "Erhoehungsfaktor ME f(Mot.temp)" CURVE 0x1AA824 ZF_kl_ui8_S5_S3 100 UMR_PROZENT__20_51_0_S5_S3 0 100
 /begin AXIS_DESCR STD_AXIS zff_atsys._.iSignale._.obj.sig_c_mot UMR_GRADC__1_1_M48_S5_S3 4 -48 144 DEPOSIT ABSOLUTE /end AXIS_DESCR
/end CHARACTERISTIC
/begin CHARACTERISTIC KL_MEKPOSCM45 "Erhoehungsfaktor ME f(Mot.temp)" CURVE 0x1AA8FC ZF_kl_ui8_S5_S3 100 UMR_PROZENT__20_51_0_S5_S3 0 100
 /begin AXIS_DESCR STD_AXIS zff_atsys._.iSignale._.obj.sig_c_mot UMR_GRADC__1_1_M48_S5_S3 4 -48 144 DEPOSIT ABSOLUTE /end AXIS_DESCR
/end CHARACTERISTIC
/begin CHARACTERISTIC KL_MEKPOSCM56 "Erhoehungsfaktor ME f(Mot.temp)" CURVE 0x1AA9D4 ZF_kl_ui8_S5_S3 100 UMR_PROZENT__20_51_0_S5_S3 0 100
 /begin AXIS_DESCR STD_AXIS zff_atsys._.iSignale._.obj.sig_c_mot UMR_GRADC__1_1_M48_S5_S3 4 -48 144 DEPOSIT ABSOLUTE /end AXIS_DESCR
/end CHARACTERISTIC
/begin CHARACTERISTIC KL_MEKPOSCM67 "Erhoehungsfaktor ME f(Mot.temp)" CURVE 0x1AAAAC ZF_kl_ui8_S5_S3 100 UMR_PROZENT__20_51_0_S5_S3 0 100
 /begin AXIS_DESCR STD_AXIS zff_atsys._.iSignale._.obj.sig_c_mot UMR_GRADC__1_1_M48_S5_S3 4 -48 144 DEPOSIT ABSOLUTE /end AXIS_DESCR
/end CHARACTERISTIC
/begin CHARACTERISTIC KL_MEKPOSCM78 "Erhoehungsfaktor ME f(Mot.temp)" CURVE 0x1AAB84 ZF_kl_ui8_S5_S3 100 UMR_PROZENT__20_51_0_S5_S3 0 100
 /begin AXIS_DESCR STD_AXIS zff_atsys._.iSignale._.obj.sig_c_mot UMR_GRADC__1_1_M48_S5_S3 4 -48 144 DEPOSIT ABSOLUTE /end AXIS_DESCR
/end CHARACTERISTIC
/begin CHARACTERISTIC KL_MEKREDCM12 "Reduzierfaktor ME f(Mot.temp)" CURVE 0x1AA680 ZF_kl_ui8_S5_S3 100 UMR_PROZENT__20_51_0_S5_S3 0 100
 /begin AXIS_DESCR STD_AXIS zff_atsys._.iSignale._.obj.sig_c_mot UMR_GRADC__1_1_M48_S5_S3 4 -48 144 DEPOSIT ABSOLUTE /end AXIS_DESCR
/end CHARACTERISTIC
/begin CHARACTERISTIC KL_MEKREDCM23 "Reduzierfaktor ME f(Mot.temp)" CURVE 0x1AA758 ZF_kl_ui8_S5_S3 100 UMR_PROZENT__20_51_0_S5_S3 0 100
 /begin AXIS_DESCR STD_AXIS zff_atsys._.iSignale._.obj.sig_c_mot UMR_GRADC__1_1_M48_S5_S3 4 -48 144 DEPOSIT ABSOLUTE /end AXIS_DESCR
/end CHARACTERISTIC
/begin CHARACTERISTIC KL_MEKREDCM34 "Reduzierfaktor ME f(Mot.temp)" CURVE 0x1AA830 ZF_kl_ui8_S5_S3 100 UMR_PROZENT__20_51_0_S5_S3 0 100
 /begin AXIS_DESCR STD_AXIS zff_atsys._.iSignale._.obj.sig_c_mot UMR_GRADC__1_1_M48_S5_S3 4 -48 144 DEPOSIT ABSOLUTE /end AXIS_DESCR
/end CHARACTERISTIC
/begin CHARACTERISTIC KL_MEKREDCM45 "Reduzierfaktor ME f(Mot.temp)" CURVE 0x1AA908 ZF_kl_ui8_S5_S3 100 UMR_PROZENT__20_51_0_S5_S3 0 100
 /begin AXIS_DESCR STD_AXIS zff_atsys._.iSignale._.obj.sig_c_mot UMR_GRADC__1_1_M48_S5_S3 4 -48 144 DEPOSIT ABSOLUTE /end AXIS_DESCR
/end CHARACTERISTIC
/begin CHARACTERISTIC KL_MEKREDCM56 "Reduzierfaktor ME f(Mot.temp)" CURVE 0x1AA9E0 ZF_kl_ui8_S5_S3 100 UMR_PROZENT__20_51_0_S5_S3 0 100
 /begin AXIS_DESCR STD_AXIS zff_atsys._.iSignale._.obj.sig_c_mot UMR_GRADC__1_1_M48_S5_S3 4 -48 144 DEPOSIT ABSOLUTE /end AXIS_DESCR
/end CHARACTERISTIC
/begin CHARACTERISTIC KL_MEKREDCM67 "Reduzierfaktor ME f(Mot.temp)" CURVE 0x1AAAB8 ZF_kl_ui8_S5_S3 100 UMR_PROZENT__20_51_0_S5_S3 0 100
 /begin AXIS_DESCR STD_AXIS zff_atsys._.iSignale._.obj.sig_c_mot UMR_GRADC__1_1_M48_S5_S3 4 -48 144 DEPOSIT ABSOLUTE /end AXIS_DESCR
/end CHARACTERISTIC
/begin CHARACTERISTIC KL_MEKREDCM78 "Reduzierfaktor ME f(Mot.temp)" CURVE 0x1AAB90 ZF_kl_ui8_S5_S3 100 UMR_PROZENT__20_51_0_S5_S3 0 100
 /begin AXIS_DESCR STD_AXIS zff_atsys._.iSignale._.obj.sig_c_mot UMR_GRADC__1_1_M48_S5_S3 4 -48 144 DEPOSIT ABSOLUTE /end AXIS_DESCR
/end CHARACTERISTIC
/begin CHARACTERISTIC KL_TSYNMEHAUPTPOSE12 "Zeitkriterium fuer Ende Haupt-ME bei Momentenerhoehung" CURVE 0x1AA62C ZF_kl_ui8_S5_S3 2550 UMR_MSEC__10_1_M128_S5_S3 -1280 1270
 /begin AXIS_DESCR STD_AXIS iSasZentr.iSchaltend.n_tkf UMR_U_MIN_32_1_0_S5_S3 6 0 8160 DEPOSIT ABSOLUTE /end AXIS_DESCR
/end CHARACTERISTIC
/begin CHARACTERISTIC KL_TSYNMEHAUPTPOSE23 "Zeitkriterium fuer Ende Haupt-ME bei Momentenerhoehung" CURVE 0x1AA704 ZF_kl_ui8_S5_S3 2550 UMR_MSEC__10_1_M128_S5_S3 -1280 1270
 /begin AXIS_DESCR STD_AXIS iSasZentr.iSchaltend.n_tkf UMR_U_MIN_32_1_0_S5_S3 6 0 8160 DEPOSIT ABSOLUTE /end AXIS_DESCR
/end CHARACTERISTIC
/begin CHARACTERISTIC KL_TSYNMEHAUPTPOSE34 "Zeitkriterium fuer Ende Haupt-ME bei Momentenerhoehung" CURVE 0x1AA7DC ZF_kl_ui8_S5_S3 2550 UMR_MSEC__10_1_M128_S5_S3 -1280 1270
 /begin AXIS_DESCR STD_AXIS iSasZentr.iSchaltend.n_tkf UMR_U_MIN_32_1_0_S5_S3 6 0 8160 DEPOSIT ABSOLUTE /end AXIS_DESCR
/end CHARACTERISTIC
/begin CHARACTERISTIC KL_TSYNMEHAUPTPOSE45 "Zeitkriterium fuer Ende Haupt-ME bei Momentenerhoehung" CURVE 0x1AA8B4 ZF_kl_ui8_S5_S3 2550 UMR_MSEC__10_1_M128_S5_S3 -1280 1270
 /begin AXIS_DESCR STD_AXIS iSasZentr.iSchaltend.n_tkf UMR_U_MIN_32_1_0_S5_S3 6 0 8160 DEPOSIT ABSOLUTE /end AXIS_DESCR
/end CHARACTERISTIC
/begin CHARACTERISTIC KL_TSYNMEHAUPTPOSE56 "Zeitkriterium fuer Ende Haupt-ME bei Momentenerhoehung" CURVE 0x1AA98C ZF_kl_ui8_S5_S3 2550 UMR_MSEC__10_1_M128_S5_S3 -1280 1270
 /begin AXIS_DESCR STD_AXIS iSasZentr.iSchaltend.n_tkf UMR_U_MIN_32_1_0_S5_S3 6 0 8160 DEPOSIT ABSOLUTE /end AXIS_DESCR
/end CHARACTERISTIC
/begin CHARACTERISTIC KL_TSYNMEHAUPTPOSE67 "Zeitkriterium fuer Ende Haupt-ME bei Momentenerhoehung" CURVE 0x1AAA64 ZF_kl_ui8_S5_S3 2550 UMR_MSEC__10_1_M128_S5_S3 -1280 1270
 /begin AXIS_DESCR STD_AXIS iSasZentr.iSchaltend.n_tkf UMR_U_MIN_32_1_0_S5_S3 6 0 8160 DEPOSIT ABSOLUTE /end AXIS_DESCR
/end CHARACTERISTIC
/begin CHARACTERISTIC KL_TSYNMEHAUPTPOSE78 "Zeitkriterium fuer Ende Haupt-ME bei Momentenerhoehung" CURVE 0x1AAB3C ZF_kl_ui8_S5_S3 2550 UMR_MSEC__10_1_M128_S5_S3 -1280 1270
 /begin AXIS_DESCR STD_AXIS iSasZentr.iSchaltend.n_tkf UMR_U_MIN_32_1_0_S5_S3 6 0 8160 DEPOSIT ABSOLUTE /end AXIS_DESCR
/end CHARACTERISTIC
/begin CHARACTERISTIC KL_TSYNMENACHA21 "Zeit vor Erkennen synchron fuer Ende Haupt-ME und Start Nach-ME" CURVE 0x1AABA8 ZF_kl_ui8_S5_S3 1280 UMR_MSEC__10_1_M128_S5_S3 -1280 0
 /begin AXIS_DESCR STD_AXIS zff_atsys._.iSignale._.obj.sig_n_mot8 UMR_U_MIN_32_1_0_S5_S3 2 0 8160 DEPOSIT ABSOLUTE /end AXIS_DESCR
/end CHARACTERISTIC
/begin CHARACTERISTIC KL_TSYNMENACHA21_EL "Zeit vor Erkennen synchron fuer Ende Haupt-ME und Start Nach-ME" CURVE 0x1AABB0 ZF_kl_ui8_S5_S3 1280 UMR_MSEC__10_1_M128_S5_S3 -1280 0
 /begin AXIS_DESCR STD_AXIS zff_atsys._.iSignale._.obj.sig_n_mot8 UMR_U_MIN_32_1_0_S5_S3 2 0 8160 DEPOSIT ABSOLUTE /end AXIS_DESCR
/end CHARACTERISTIC
/begin CHARACTERISTIC KL_TSYNMENACHA32 "Zeit vor Erkennen synchron fuer Ende Haupt-ME und Start Nach-ME" CURVE 0x1AADB4 ZF_kl_ui8_S5_S3 1280 UMR_MSEC__10_1_M128_S5_S3 -1280 0
 /begin AXIS_DESCR STD_AXIS zff_atsys._.iSignale._.obj.sig_n_mot8 UMR_U_MIN_32_1_0_S5_S3 2 0 8160 DEPOSIT ABSOLUTE /end AXIS_DESCR
/end CHARACTERISTIC
/begin CHARACTERISTIC KL_TSYNMENACHA32_EL "Zeit vor Erkennen synchron fuer Ende Haupt-ME und Start Nach-ME" CURVE 0x1AADBC ZF_kl_ui8_S5_S3 1280 UMR_MSEC__10_1_M128_S5_S3 -1280 0
 /begin AXIS_DESCR STD_AXIS zff_atsys._.iSignale._.obj.sig_n_mot8 UMR_U_MIN_32_1_0_S5_S3 2 0 8160 DEPOSIT ABSOLUTE /end AXIS_DESCR
/end CHARACTERISTIC
/begin CHARACTERISTIC KL_TSYNMENACHA43 "Zeit vor Erkennen synchron fuer Ende Haupt-ME und Start Nach-ME" CURVE 0x1AAFC0 ZF_kl_ui8_S5_S3 1280 UMR_MSEC__10_1_M128_S5_S3 -1280 0
 /begin AXIS_DESCR STD_AXIS zff_atsys._.iSignale._.obj.sig_n_mot8 UMR_U_MIN_32_1_0_S5_S3 2 0 8160 DEPOSIT ABSOLUTE /end AXIS_DESCR
/end CHARACTERISTIC
/begin CHARACTERISTIC KL_TSYNMENACHA43_EL "Zeit vor Erkennen synchron fuer Ende Haupt-ME und Start Nach-ME" CURVE 0x1AAFC8 ZF_kl_ui8_S5_S3 1280 UMR_MSEC__10_1_M128_S5_S3 -1280 0
 /begin AXIS_DESCR STD_AXIS zff_atsys._.iSignale._.obj.sig_n_mot8 UMR_U_MIN_32_1_0_S5_S3 2 0 8160 DEPOSIT ABSOLUTE /end AXIS_DESCR
/end CHARACTERISTIC
/begin CHARACTERISTIC KL_TSYNMENACHA54 "Zeit vor Erkennen synchron fuer Ende Haupt-ME und Start Nach-ME" CURVE 0x1AB1CC ZF_kl_ui8_S5_S3 1280 UMR_MSEC__10_1_M128_S5_S3 -1280 0
 /begin AXIS_DESCR STD_AXIS zff_atsys._.iSignale._.obj.sig_n_mot8 UMR_U_MIN_32_1_0_S5_S3 2 0 8160 DEPOSIT ABSOLUTE /end AXIS_DESCR
/end CHARACTERISTIC
/begin CHARACTERISTIC KL_TSYNMENACHA54_EL "Zeit vor Erkennen synchron fuer Ende Haupt-ME und Start Nach-ME" CURVE 0x1AB1D4 ZF_kl_ui8_S5_S3 1280 UMR_MSEC__10_1_M128_S5_S3 -1280 0
 /begin AXIS_DESCR STD_AXIS zff_atsys._.iSignale._.obj.sig_n_mot8 UMR_U_MIN_32_1_0_S5_S3 2 0 8160 DEPOSIT ABSOLUTE /end AXIS_DESCR
/end CHARACTERISTIC
/begin CHARACTERISTIC KL_TSYNMENACHA65 "Zeit vor Erkennen synchron fuer Ende Haupt-ME und Start Nach-ME" CURVE 0x1AB3D8 ZF_kl_ui8_S5_S3 1280 UMR_MSEC__10_1_M128_S5_S3 -1280 0
 /begin AXIS_DESCR STD_AXIS zff_atsys._.iSignale._.obj.sig_n_mot8 UMR_U_MIN_32_1_0_S5_S3 2 0 8160 DEPOSIT ABSOLUTE /end AXIS_DESCR
/end CHARACTERISTIC
/begin CHARACTERISTIC KL_TSYNMENACHA65_EL "Zeit vor Erkennen synchron fuer Ende Haupt-ME und Start Nach-ME" CURVE 0x1AB3E0 ZF_kl_ui8_S5_S3 1280 UMR_MSEC__10_1_M128_S5_S3 -1280 0
 /begin AXIS_DESCR STD_AXIS zff_atsys._.iSignale._.obj.sig_n_mot8 UMR_U_MIN_32_1_0_S5_S3 2 0 8160 DEPOSIT ABSOLUTE /end AXIS_DESCR
/end CHARACTERISTIC
/begin CHARACTERISTIC KL_TSYNMENACHA76 "Zeit vor Erkennen synchron fuer Ende Haupt-ME und Start Nach-ME" CURVE 0x1AB5E4 ZF_kl_ui8_S5_S3 1280 UMR_MSEC__10_1_M128_S5_S3 -1280 0
 /begin AXIS_DESCR STD_AXIS zff_atsys._.iSignale._.obj.sig_n_mot8 UMR_U_MIN_32_1_0_S5_S3 2 0 8160 DEPOSIT ABSOLUTE /end AXIS_DESCR
/end CHARACTERISTIC
/begin CHARACTERISTIC KL_TSYNMENACHA76_EL "Zeit vor Erkennen synchron fuer Ende Haupt-ME und Start Nach-ME" CURVE 0x1AB5EC ZF_kl_ui8_S5_S3 1280 UMR_MSEC__10_1_M128_S5_S3 -1280 0
 /begin AXIS_DESCR STD_AXIS zff_atsys._.iSignale._.obj.sig_n_mot8 UMR_U_MIN_32_1_0_S5_S3 2 0 8160 DEPOSIT ABSOLUTE /end AXIS_DESCR
/end CHARACTERISTIC
/begin CHARACTERISTIC KL_TSYNMENACHA87 "Zeit vor Erkennen synchron fuer Ende Haupt-ME und Start Nach-ME" CURVE 0x1AB7F0 ZF_kl_ui8_S5_S3 1280 UMR_MSEC__10_1_M128_S5_S3 -1280 0
 /begin AXIS_DESCR STD_AXIS zff_atsys._.iSignale._.obj.sig_n_mot8 UMR_U_MIN_32_1_0_S5_S3 2 0 8160 DEPOSIT ABSOLUTE /end AXIS_DESCR
/end CHARACTERISTIC
/begin CHARACTERISTIC KL_TSYNMENACHA87_EL "Zeit vor Erkennen synchron fuer Ende Haupt-ME und Start Nach-ME" CURVE 0x1AB7F8 ZF_kl_ui8_S5_S3 1280 UMR_MSEC__10_1_M128_S5_S3 -1280 0
 /begin AXIS_DESCR STD_AXIS zff_atsys._.iSignale._.obj.sig_n_mot8 UMR_U_MIN_32_1_0_S5_S3 2 0 8160 DEPOSIT ABSOLUTE /end AXIS_DESCR
/end CHARACTERISTIC
/begin CHARACTERISTIC KL_TSYNMENACHASP21 "Zeit vor Erkennen synchron fuer Ende Haupt-ME und Start Nach-ME" CURVE 0x1AB9FC ZF_kl_ui8_S5_S3 1280 UMR_MSEC__10_1_M128_S5_S3 -1280 0
 /begin AXIS_DESCR STD_AXIS zff_atsys._.iSignale._.obj.sig_n_mot8 UMR_U_MIN_32_1_0_S5_S3 2 0 8160 DEPOSIT ABSOLUTE /end AXIS_DESCR
/end CHARACTERISTIC
/begin CHARACTERISTIC KL_TSYNMENACHASP31 "Zeit vor Erkennen synchron fuer Ende Haupt-ME und Start Nach-ME" CURVE 0x1AC284 ZF_kl_ui8_S5_S3 1280 UMR_MSEC__10_1_M128_S5_S3 -1280 0
 /begin AXIS_DESCR STD_AXIS zff_atsys._.iSignale._.obj.sig_n_mot8 UMR_U_MIN_32_1_0_S5_S3 2 0 8160 DEPOSIT ABSOLUTE /end AXIS_DESCR
/end CHARACTERISTIC
/begin CHARACTERISTIC KL_TSYNMENACHASP32 "Zeit vor Erkennen synchron fuer Ende Haupt-ME und Start Nach-ME" CURVE 0x1ABB34 ZF_kl_ui8_S5_S3 1280 UMR_MSEC__10_1_M128_S5_S3 -1280 0
 /begin AXIS_DESCR STD_AXIS zff_atsys._.iSignale._.obj.sig_n_mot8 UMR_U_MIN_32_1_0_S5_S3 2 0 8160 DEPOSIT ABSOLUTE /end AXIS_DESCR
/end CHARACTERISTIC
/begin CHARACTERISTIC KL_TSYNMENACHASP42 "Zeit vor Erkennen synchron fuer Ende Haupt-ME und Start Nach-ME" CURVE 0x1AC3BC ZF_kl_ui8_S5_S3 1280 UMR_MSEC__10_1_M128_S5_S3 -1280 0
 /begin AXIS_DESCR STD_AXIS zff_atsys._.iSignale._.obj.sig_n_mot8 UMR_U_MIN_32_1_0_S5_S3 2 0 8160 DEPOSIT ABSOLUTE /end AXIS_DESCR
/end CHARACTERISTIC
/begin CHARACTERISTIC KL_TSYNMENACHASP43 "Zeit vor Erkennen synchron fuer Ende Haupt-ME und Start Nach-ME" CURVE 0x1ABC6C ZF_kl_ui8_S5_S3 1280 UMR_MSEC__10_1_M128_S5_S3 -1280 0
 /begin AXIS_DESCR STD_AXIS zff_atsys._.iSignale._.obj.sig_n_mot8 UMR_U_MIN_32_1_0_S5_S3 2 0 8160 DEPOSIT ABSOLUTE /end AXIS_DESCR
/end CHARACTERISTIC
/begin CHARACTERISTIC KL_TSYNMENACHASP51 "Zeit vor Erkennen synchron fuer Ende Haupt-ME und Start Nach-ME" CURVE 0x1AC4F4 ZF_kl_ui8_S5_S3 1280 UMR_MSEC__10_1_M128_S5_S3 -1280 0
 /begin AXIS_DESCR STD_AXIS zff_atsys._.iSignale._.obj.sig_n_mot8 UMR_U_MIN_32_1_0_S5_S3 2 0 8160 DEPOSIT ABSOLUTE /end AXIS_DESCR
/end CHARACTERISTIC
/begin CHARACTERISTIC KL_TSYNMENACHASP53 "Zeit vor Erkennen synchron fuer Ende Haupt-ME und Start Nach-ME" CURVE 0x1AC62C ZF_kl_ui8_S5_S3 1280 UMR_MSEC__10_1_M128_S5_S3 -1280 0
 /begin AXIS_DESCR STD_AXIS zff_atsys._.iSignale._.obj.sig_n_mot8 UMR_U_MIN_32_1_0_S5_S3 2 0 8160 DEPOSIT ABSOLUTE /end AXIS_DESCR
/end CHARACTERISTIC
/begin CHARACTERISTIC KL_TSYNMENACHASP54 "Zeit vor Erkennen synchron fuer Ende Haupt-ME und Start Nach-ME" CURVE 0x1ABDA4 ZF_kl_ui8_S5_S3 1280 UMR_MSEC__10_1_M128_S5_S3 -1280 0
 /begin AXIS_DESCR STD_AXIS zff_atsys._.iSignale._.obj.sig_n_mot8 UMR_U_MIN_32_1_0_S5_S3 2 0 8160 DEPOSIT ABSOLUTE /end AXIS_DESCR
/end CHARACTERISTIC
/begin CHARACTERISTIC KL_TSYNMENACHASP63 "Zeit vor Erkennen synchron fuer Ende Haupt-ME und Start Nach-ME" CURVE 0x1AC764 ZF_kl_ui8_S5_S3 1280 UMR_MSEC__10_1_M128_S5_S3 -1280 0
 /begin AXIS_DESCR STD_AXIS zff_atsys._.iSignale._.obj.sig_n_mot8 UMR_U_MIN_32_1_0_S5_S3 2 0 8160 DEPOSIT ABSOLUTE /end AXIS_DESCR
/end CHARACTERISTIC
/begin CHARACTERISTIC KL_TSYNMENACHASP64 "Zeit vor Erkennen synchron fuer Ende Haupt-ME und Start Nach-ME" CURVE 0x1AC89C ZF_kl_ui8_S5_S3 1280 UMR_MSEC__10_1_M128_S5_S3 -1280 0
 /begin AXIS_DESCR STD_AXIS zff_atsys._.iSignale._.obj.sig_n_mot8 UMR_U_MIN_32_1_0_S5_S3 2 0 8160 DEPOSIT ABSOLUTE /end AXIS_DESCR
/end CHARACTERISTIC
/begin CHARACTERISTIC KL_TSYNMENACHASP65 "Zeit vor Erkennen synchron fuer Ende Haupt-ME und Start Nach-ME" CURVE 0x1ABEDC ZF_kl_ui8_S5_S3 1280 UMR_MSEC__10_1_M128_S5_S3 -1280 0
 /begin AXIS_DESCR STD_AXIS zff_atsys._.iSignale._.obj.sig_n_mot8 UMR_U_MIN_32_1_0_S5_S3 2 0 8160 DEPOSIT ABSOLUTE /end AXIS_DESCR
/end CHARACTERISTIC
/begin CHARACTERISTIC KL_TSYNMENACHASP71 "Zeit vor Erkennen synchron fuer Ende Haupt-ME und Start Nach-ME" CURVE 0x1AC9D4 ZF_kl_ui8_S5_S3 1280 UMR_MSEC__10_1_M128_S5_S3 -1280 0
 /begin AXIS_DESCR STD_AXIS zff_atsys._.iSignale._.obj.sig_n_mot8 UMR_U_MIN_32_1_0_S5_S3 2 0 8160 DEPOSIT ABSOLUTE /end AXIS_DESCR
/end CHARACTERISTIC
/begin CHARACTERISTIC KL_TSYNMENACHASP75 "Zeit vor Erkennen synchron fuer Ende Haupt-ME und Start Nach-ME" CURVE 0x1ACB0C ZF_kl_ui8_S5_S3 1280 UMR_MSEC__10_1_M128_S5_S3 -1280 0
 /begin AXIS_DESCR STD_AXIS zff_atsys._.iSignale._.obj.sig_n_mot8 UMR_U_MIN_32_1_0_S5_S3 2 0 8160 DEPOSIT ABSOLUTE /end AXIS_DESCR
/end CHARACTERISTIC
/begin CHARACTERISTIC KL_TSYNMENACHASP76 "Zeit vor Erkennen synchron fuer Ende Haupt-ME und Start Nach-ME" CURVE 0x1AC014 ZF_kl_ui8_S5_S3 1280 UMR_MSEC__10_1_M128_S5_S3 -1280 0
 /begin AXIS_DESCR STD_AXIS zff_atsys._.iSignale._.obj.sig_n_mot8 UMR_U_MIN_32_1_0_S5_S3 2 0 8160 DEPOSIT ABSOLUTE /end AXIS_DESCR
/end CHARACTERISTIC
/begin CHARACTERISTIC KL_TSYNMENACHASP82 "Zeit vor Erkennen synchron fuer Ende Haupt-ME und Start Nach-ME" CURVE 0x1ACC44 ZF_kl_ui8_S5_S3 1280 UMR_MSEC__10_1_M128_S5_S3 -1280 0
 /begin AXIS_DESCR STD_AXIS zff_atsys._.iSignale._.obj.sig_n_mot8 UMR_U_MIN_32_1_0_S5_S3 2 0 8160 DEPOSIT ABSOLUTE /end AXIS_DESCR
/end CHARACTERISTIC
/begin CHARACTERISTIC KL_TSYNMENACHASP84 "Zeit vor Erkennen synchron fuer Ende Haupt-ME und Start Nach-ME" CURVE 0x1ACD7C ZF_kl_ui8_S5_S3 1280 UMR_MSEC__10_1_M128_S5_S3 -1280 0
 /begin AXIS_DESCR STD_AXIS zff_atsys._.iSignale._.obj.sig_n_mot8 UMR_U_MIN_32_1_0_S5_S3 2 0 8160 DEPOSIT ABSOLUTE /end AXIS_DESCR
/end CHARACTERISTIC
/begin CHARACTERISTIC KL_TSYNMENACHASP86 "Zeit vor Erkennen synchron fuer Ende Haupt-ME und Start Nach-ME" CURVE 0x1ACEB4 ZF_kl_ui8_S5_S3 1280 UMR_MSEC__10_1_M128_S5_S3 -1280 0
 /begin AXIS_DESCR STD_AXIS zff_atsys._.iSignale._.obj.sig_n_mot8 UMR_U_MIN_32_1_0_S5_S3 2 0 8160 DEPOSIT ABSOLUTE /end AXIS_DESCR
/end CHARACTERISTIC
/begin CHARACTERISTIC KL_TSYNMENACHASP87 "Zeit vor Erkennen synchron fuer Ende Haupt-ME und Start Nach-ME" CURVE 0x1AC14C ZF_kl_ui8_S5_S3 1280 UMR_MSEC__10_1_M128_S5_S3 -1280 0
 /begin AXIS_DESCR STD_AXIS zff_atsys._.iSignale._.obj.sig_n_mot8 UMR_U_MIN_32_1_0_S5_S3 2 0 8160 DEPOSIT ABSOLUTE /end AXIS_DESCR
/end CHARACTERISTIC
/begin CHARACTERISTIC KL_TSYNMENACHASPORT21 "Zeit vor Erkennen synchron fuer Ende Haupt-ME und Start Nach-ME" CURVE 0x1ACFEC ZF_kl_ui8_S5_S3 1280 UMR_MSEC__10_1_M128_S5_S3 -1280 0
 /begin AXIS_DESCR STD_AXIS zff_atsys._.iSignale._.obj.sig_n_mot8 UMR_U_MIN_32_1_0_S5_S3 2 0 8160 DEPOSIT ABSOLUTE /end AXIS_DESCR
/end CHARACTERISTIC
/begin CHARACTERISTIC KL_TSYNMENACHASPORT31 "Zeit vor Erkennen synchron fuer Ende Haupt-ME und Start Nach-ME" CURVE 0x1AD874 ZF_kl_ui8_S5_S3 1280 UMR_MSEC__10_1_M128_S5_S3 -1280 0
 /begin AXIS_DESCR STD_AXIS zff_atsys._.iSignale._.obj.sig_n_mot8 UMR_U_MIN_32_1_0_S5_S3 2 0 8160 DEPOSIT ABSOLUTE /end AXIS_DESCR
/end CHARACTERISTIC
/begin CHARACTERISTIC KL_TSYNMENACHASPORT32 "Zeit vor Erkennen synchron fuer Ende Haupt-ME und Start Nach-ME" CURVE 0x1AD124 ZF_kl_ui8_S5_S3 1280 UMR_MSEC__10_1_M128_S5_S3 -1280 0
 /begin AXIS_DESCR STD_AXIS zff_atsys._.iSignale._.obj.sig_n_mot8 UMR_U_MIN_32_1_0_S5_S3 2 0 8160 DEPOSIT ABSOLUTE /end AXIS_DESCR
/end CHARACTERISTIC
/begin CHARACTERISTIC KL_TSYNMENACHASPORT42 "Zeit vor Erkennen synchron fuer Ende Haupt-ME und Start Nach-ME" CURVE 0x1AD9AC ZF_kl_ui8_S5_S3 1280 UMR_MSEC__10_1_M128_S5_S3 -1280 0
 /begin AXIS_DESCR STD_AXIS zff_atsys._.iSignale._.obj.sig_n_mot8 UMR_U_MIN_32_1_0_S5_S3 2 0 8160 DEPOSIT ABSOLUTE /end AXIS_DESCR
/end CHARACTERISTIC
/begin CHARACTERISTIC KL_TSYNMENACHASPORT43 "Zeit vor Erkennen synchron fuer Ende Haupt-ME und Start Nach-ME" CURVE 0x1AD25C ZF_kl_ui8_S5_S3 1280 UMR_MSEC__10_1_M128_S5_S3 -1280 0
 /begin AXIS_DESCR STD_AXIS zff_atsys._.iSignale._.obj.sig_n_mot8 UMR_U_MIN_32_1_0_S5_S3 2 0 8160 DEPOSIT ABSOLUTE /end AXIS_DESCR
/end CHARACTERISTIC
/begin CHARACTERISTIC KL_TSYNMENACHASPORT51 "Zeit vor Erkennen synchron fuer Ende Haupt-ME und Start Nach-ME" CURVE 0x1ADAE4 ZF_kl_ui8_S5_S3 1280 UMR_MSEC__10_1_M128_S5_S3 -1280 0
 /begin AXIS_DESCR STD_AXIS zff_atsys._.iSignale._.obj.sig_n_mot8 UMR_U_MIN_32_1_0_S5_S3 2 0 8160 DEPOSIT ABSOLUTE /end AXIS_DESCR
/end CHARACTERISTIC
/begin CHARACTERISTIC KL_TSYNMENACHASPORT53 "Zeit vor Erkennen synchron fuer Ende Haupt-ME und Start Nach-ME" CURVE 0x1ADC1C ZF_kl_ui8_S5_S3 1280 UMR_MSEC__10_1_M128_S5_S3 -1280 0
 /begin AXIS_DESCR STD_AXIS zff_atsys._.iSignale._.obj.sig_n_mot8 UMR_U_MIN_32_1_0_S5_S3 2 0 8160 DEPOSIT ABSOLUTE /end AXIS_DESCR
/end CHARACTERISTIC
/begin CHARACTERISTIC KL_TSYNMENACHASPORT54 "Zeit vor Erkennen synchron fuer Ende Haupt-ME und Start Nach-ME" CURVE 0x1AD394 ZF_kl_ui8_S5_S3 1280 UMR_MSEC__10_1_M128_S5_S3 -1280 0
 /begin AXIS_DESCR STD_AXIS zff_atsys._.iSignale._.obj.sig_n_mot8 UMR_U_MIN_32_1_0_S5_S3 2 0 8160 DEPOSIT ABSOLUTE /end AXIS_DESCR
/end CHARACTERISTIC
/begin CHARACTERISTIC KL_TSYNMENACHASPORT63 "Zeit vor Erkennen synchron fuer Ende Haupt-ME und Start Nach-ME" CURVE 0x1ADD54 ZF_kl_ui8_S5_S3 1280 UMR_MSEC__10_1_M128_S5_S3 -1280 0
 /begin AXIS_DESCR STD_AXIS zff_atsys._.iSignale._.obj.sig_n_mot8 UMR_U_MIN_32_1_0_S5_S3 2 0 8160 DEPOSIT ABSOLUTE /end AXIS_DESCR
/end CHARACTERISTIC
/begin CHARACTERISTIC KL_TSYNMENACHASPORT64 "Zeit vor Erkennen synchron fuer Ende Haupt-ME und Start Nach-ME" CURVE 0x1ADE8C ZF_kl_ui8_S5_S3 1280 UMR_MSEC__10_1_M128_S5_S3 -1280 0
 /begin AXIS_DESCR STD_AXIS zff_atsys._.iSignale._.obj.sig_n_mot8 UMR_U_MIN_32_1_0_S5_S3 2 0 8160 DEPOSIT ABSOLUTE /end AXIS_DESCR
/end CHARACTERISTIC
/begin CHARACTERISTIC KL_TSYNMTMEHAUPTE_8 "Zeit vor Erkennen synchron fuer Ende Haupt-ME" CURVE 0x1A9C50 ZF_kl_ui8_S5_S3 1280 UMR_MSEC__10_1_M128_S5_S3 -1280 0
 /begin AXIS_DESCR STD_AXIS zff_atsys._.iSignale._.obj.sig_m_t8 UMR_NM__6_1_M34_S5_S3 6 -204 1326 DEPOSIT ABSOLUTE /end AXIS_DESCR
/end CHARACTERISTIC
/begin CHARACTERISTIC KL_TSYNMTMEHAUPTE_R "Zeit vor Erkennen synchron fuer Ende Haupt-ME" CURVE 0x1A9630 ZF_kl_ui8_S5_S3 1280 UMR_MSEC__10_1_M128_S5_S3 -1280 0
 /begin AXIS_DESCR STD_AXIS zff_atsys._.iSignale._.obj.sig_m_t8 UMR_NM__6_1_M34_S5_S3 6 -204 1326 DEPOSIT ABSOLUTE /end AXIS_DESCR
/end CHARACTERISTIC
/begin CHARACTERISTIC KL_TVMEA_8 "Verzoegerungszeit fuer Beginn Haupt-ME" CURVE 0x1A9C60 ZF_kl_si16_S5_S3 2000 UMR_MSEC__10_1_0_S5_S3 -1000 1000
 /begin AXIS_DESCR STD_AXIS zff_atsys._.iSignale._.obj.sig_n_t8 UMR_U_MIN_32_1_0_S5_S3 8 0 8160 DEPOSIT ABSOLUTE /end AXIS_DESCR
/end CHARACTERISTIC
/begin CHARACTERISTIC KL_TVMEA_R "Verzoegerungszeit fuer Beginn Haupt-ME" CURVE 0x1A9640 ZF_kl_si16_S5_S3 2000 UMR_MSEC__10_1_0_S5_S3 -1000 1000
 /begin AXIS_DESCR STD_AXIS zff_atsys._.iSignale._.obj.sig_n_t8 UMR_U_MIN_32_1_0_S5_S3 8 0 8160 DEPOSIT ABSOLUTE /end AXIS_DESCR
/end CHARACTERISTIC
/begin CHARACTERISTIC K_FMEHAUPTA_8 "Filterkonstante (aehnl INPT) Start Hauptmotoreingriff" VALUE 0x1D8540 ZF_kw_si16_S5_S3 65.535 UMR___1_1000_0_S5_S3 -32.768 32.767 /end CHARACTERISTIC
/begin CHARACTERISTIC K_FMEHAUPTA_R "Filterkonstante (aehnl INPT) Start Hauptmotoreingriff" VALUE 0x1D8510 ZF_kw_si16_S5_S3 65.535 UMR___1_1000_0_S5_S3 -32.768 32.767 /end CHARACTERISTIC
/begin CHARACTERISTIC K_FMEHAUPTPOSA12 "Filterkonstante (aehnl INPT) Start Hauptmotoreingriff" VALUE 0x1D8544 ZF_kw_si16_S5_S3 65.535 UMR___1_1000_0_S5_S3 -32.768 32.767 /end CHARACTERISTIC
/begin CHARACTERISTIC K_FMEHAUPTPOSA23 "Filterkonstante (aehnl INPT) Start Hauptmotoreingriff" VALUE 0x1D854A ZF_kw_si16_S5_S3 65.535 UMR___1_1000_0_S5_S3 -32.768 32.767 /end CHARACTERISTIC
/begin CHARACTERISTIC K_FMEHAUPTPOSA34 "Filterkonstante (aehnl INPT) Start Hauptmotoreingriff" VALUE 0x1D8550 ZF_kw_si16_S5_S3 65.535 UMR___1_1000_0_S5_S3 -32.768 32.767 /end CHARACTERISTIC
/begin CHARACTERISTIC K_FMEHAUPTPOSA45 "Filterkonstante (aehnl INPT) Start Hauptmotoreingriff" VALUE 0x1D8556 ZF_kw_si16_S5_S3 65.535 UMR___1_1000_0_S5_S3 -32.768 32.767 /end CHARACTERISTIC
/begin CHARACTERISTIC K_FMEHAUPTPOSA56 "Filterkonstante (aehnl INPT) Start Hauptmotoreingriff" VALUE 0x1D855C ZF_kw_si16_S5_S3 65.535 UMR___1_1000_0_S5_S3 -32.768 32.767 /end CHARACTERISTIC
/begin CHARACTERISTIC K_FMEHAUPTPOSA67 "Filterkonstante (aehnl INPT) Start Hauptmotoreingriff" VALUE 0x1D8562 ZF_kw_si16_S5_S3 65.535 UMR___1_1000_0_S5_S3 -32.768 32.767 /end CHARACTERISTIC
/begin CHARACTERISTIC K_FMEHAUPTPOSA78 "Filterkonstante (aehnl INPT) Start Hauptmotoreingriff" VALUE 0x1D8568 ZF_kw_si16_S5_S3 65.535 UMR___1_1000_0_S5_S3 -32.768 32.767 /end CHARACTERISTIC
/begin CHARACTERISTIC MS_TSSCHR12 "Turbinenmomentschwelle Schrittschaltungsmotoreingriff" VALUE 0x1D8546 ZF_kw_si16_S5_S3 1500 UMR_NM__1_1_0_S5_S3 -200 1300 /end CHARACTERISTIC
/begin CHARACTERISTIC MS_TSSCHR23 "Turbinenmomentschwelle Schrittschaltungsmotoreingriff" VALUE 0x1D854C ZF_kw_si16_S5_S3 1500 UMR_NM__1_1_0_S5_S3 -200 1300 /end CHARACTERISTIC
/begin CHARACTERISTIC MS_TSSCHR34 "Turbinenmomentschwelle Schrittschaltungsmotoreingriff" VALUE 0x1D8552 ZF_kw_si16_S5_S3 1500 UMR_NM__1_1_0_S5_S3 -200 1300 /end CHARACTERISTIC
/begin CHARACTERISTIC MS_TSSCHR45 "Turbinenmomentschwelle Schrittschaltungsmotoreingriff" VALUE 0x1D8558 ZF_kw_si16_S5_S3 1500 UMR_NM__1_1_0_S5_S3 -200 1300 /end CHARACTERISTIC
/begin CHARACTERISTIC MS_TSSCHR56 "Turbinenmomentschwelle Schrittschaltungsmotoreingriff" VALUE 0x1D855E ZF_kw_si16_S5_S3 1500 UMR_NM__1_1_0_S5_S3 -200 1300 /end CHARACTERISTIC
/begin CHARACTERISTIC MS_TSSCHR67 "Turbinenmomentschwelle Schrittschaltungsmotoreingriff" VALUE 0x1D8564 ZF_kw_si16_S5_S3 1500 UMR_NM__1_1_0_S5_S3 -200 1300 /end CHARACTERISTIC
/begin CHARACTERISTIC MS_TSSCHR78 "Turbinenmomentschwelle Schrittschaltungsmotoreingriff" VALUE 0x1D856A ZF_kw_si16_S5_S3 1500 UMR_NM__1_1_0_S5_S3 -200 1300 /end CHARACTERISTIC
/begin CHARACTERISTIC ND_MEHAUPTAGE_8 "Drehzahlkriterium Start Haupt-ME Gangeinlegen" VALUE 0x1D853C ZF_kw_si16_S5_S3 1000 UMR_U_MIN_1_1_0_S5_S3 0 1000 /end CHARACTERISTIC
/begin CHARACTERISTIC ND_MEHAUPTAGE_R "Drehzahlkriterium Start Haupt-ME Gangeinlegen" VALUE 0x1D850C ZF_kw_si16_S5_S3 1000 UMR_U_MIN_1_1_0_S5_S3 0 1000 /end CHARACTERISTIC
/begin CHARACTERISTIC T_FMEHAUPTA_8 "Filterzeit Start Hauptmotoreingriff" VALUE 0x1D853E ZF_kw_si16_S5_S3 508 UMR_MSEC__1_1_0_S5_S3 -254 254 /end CHARACTERISTIC
/begin CHARACTERISTIC T_FMEHAUPTA_R "Filterzeit Start Hauptmotoreingriff" VALUE 0x1D850E ZF_kw_si16_S5_S3 508 UMR_MSEC__1_1_0_S5_S3 -254 254 /end CHARACTERISTIC
/begin CHARACTERISTIC T_FMEHAUPTPOSA12 "Filterzeit Start Hauptmotoreingriff" VALUE 0x1D8542 ZF_kw_si16_S5_S3 508 UMR_MSEC__1_1_0_S5_S3 -254 254 /end CHARACTERISTIC
/begin CHARACTERISTIC T_FMEHAUPTPOSA23 "Filterzeit Start Hauptmotoreingriff" VALUE 0x1D8548 ZF_kw_si16_S5_S3 508 UMR_MSEC__1_1_0_S5_S3 -254 254 /end CHARACTERISTIC
/begin CHARACTERISTIC T_FMEHAUPTPOSA34 "Filterzeit Start Hauptmotoreingriff" VALUE 0x1D854E ZF_kw_si16_S5_S3 508 UMR_MSEC__1_1_0_S5_S3 -254 254 /end CHARACTERISTIC
/begin CHARACTERISTIC T_FMEHAUPTPOSA45 "Filterzeit Start Hauptmotoreingriff" VALUE 0x1D8554 ZF_kw_si16_S5_S3 508 UMR_MSEC__1_1_0_S5_S3 -254 254 /end CHARACTERISTIC
/begin CHARACTERISTIC T_FMEHAUPTPOSA56 "Filterzeit Start Hauptmotoreingriff" VALUE 0x1D855A ZF_kw_si16_S5_S3 508 UMR_MSEC__1_1_0_S5_S3 -254 254 /end CHARACTERISTIC
/begin CHARACTERISTIC T_FMEHAUPTPOSA67 "Filterzeit Start Hauptmotoreingriff" VALUE 0x1D8560 ZF_kw_si16_S5_S3 508 UMR_MSEC__1_1_0_S5_S3 -254 254 /end CHARACTERISTIC
/begin CHARACTERISTIC T_FMEHAUPTPOSA78 "Filterzeit Start Hauptmotoreingriff" VALUE 0x1D8566 ZF_kw_si16_S5_S3 508 UMR_MSEC__1_1_0_S5_S3 -254 254 /end CHARACTERISTIC
/begin CHARACTERISTIC T_RAMEE12 "Dauer Rampe ME bei Schaltungsende" VALUE 0x1D7862 ZF_kw_ui8_S5_S3 2540 UMR_MSEC__10_1_0_S5_S3 0 2540 /end CHARACTERISTIC
/begin CHARACTERISTIC T_RAMEE21 "Dauer Rampe ME bei Schaltungsende" VALUE 0x1D7869 ZF_kw_ui8_S5_S3 2540 UMR_MSEC__10_1_0_S5_S3 0 2540 /end CHARACTERISTIC
/begin CHARACTERISTIC T_RAMEE21_EL "Dauer Rampe ME bei Schaltungsende" VALUE 0x1D786A ZF_kw_ui8_S5_S3 2540 UMR_MSEC__10_1_0_S5_S3 0 2540 /end CHARACTERISTIC
/begin CHARACTERISTIC T_RAMEE23 "Dauer Rampe ME bei Schaltungsende" VALUE 0x1D7863 ZF_kw_ui8_S5_S3 2540 UMR_MSEC__10_1_0_S5_S3 0 2540 /end CHARACTERISTIC
/begin CHARACTERISTIC T_RAMEE32 "Dauer Rampe ME bei Schaltungsende" VALUE 0x1D786D ZF_kw_ui8_S5_S3 2540 UMR_MSEC__10_1_0_S5_S3 0 2540 /end CHARACTERISTIC
/begin CHARACTERISTIC T_RAMEE32_EL "Dauer Rampe ME bei Schaltungsende" VALUE 0x1D786E ZF_kw_ui8_S5_S3 2540 UMR_MSEC__10_1_0_S5_S3 0 2540 /end CHARACTERISTIC
/begin CHARACTERISTIC T_RAMEE34 "Dauer Rampe ME bei Schaltungsende" VALUE 0x1D7864 ZF_kw_ui8_S5_S3 2540 UMR_MSEC__10_1_0_S5_S3 0 2540 /end CHARACTERISTIC
/begin CHARACTERISTIC T_RAMEE43 "Dauer Rampe ME bei Schaltungsende" VALUE 0x1D7871 ZF_kw_ui8_S5_S3 2540 UMR_MSEC__10_1_0_S5_S3 0 2540 /end CHARACTERISTIC
/begin CHARACTERISTIC T_RAMEE43_EL "Dauer Rampe ME bei Schaltungsende" VALUE 0x1D7872 ZF_kw_ui8_S5_S3 2540 UMR_MSEC__10_1_0_S5_S3 0 2540 /end CHARACTERISTIC
/begin CHARACTERISTIC T_RAMEE45 "Dauer Rampe ME bei Schaltungsende" VALUE 0x1D7865 ZF_kw_ui8_S5_S3 2540 UMR_MSEC__10_1_0_S5_S3 0 2540 /end CHARACTERISTIC
/begin CHARACTERISTIC T_RAMEE54 "Dauer Rampe ME bei Schaltungsende" VALUE 0x1D7875 ZF_kw_ui8_S5_S3 2540 UMR_MSEC__10_1_0_S5_S3 0 2540 /end CHARACTERISTIC
/begin CHARACTERISTIC T_RAMEE54_EL "Dauer Rampe ME bei Schaltungsende" VALUE 0x1D7876 ZF_kw_ui8_S5_S3 2540 UMR_MSEC__10_1_0_S5_S3 0 2540 /end CHARACTERISTIC
/begin CHARACTERISTIC T_RAMEE56 "Dauer Rampe ME bei Schaltungsende" VALUE 0x1D7866 ZF_kw_ui8_S5_S3 2540 UMR_MSEC__10_1_0_S5_S3 0 2540 /end CHARACTERISTIC
/begin CHARACTERISTIC T_RAMEE65 "Dauer Rampe ME bei Schaltungsende" VALUE 0x1D7879 ZF_kw_ui8_S5_S3 2540 UMR_MSEC__10_1_0_S5_S3 0 2540 /end CHARACTERISTIC
/begin CHARACTERISTIC T_RAMEE65_EL "Dauer Rampe ME bei Schaltungsende" VALUE 0x1D787A ZF_kw_ui8_S5_S3 2540 UMR_MSEC__10_1_0_S5_S3 0 2540 /end CHARACTERISTIC
/begin CHARACTERISTIC T_RAMEE67 "Dauer Rampe ME bei Schaltungsende" VALUE 0x1D7867 ZF_kw_ui8_S5_S3 2540 UMR_MSEC__10_1_0_S5_S3 0 2540 /end CHARACTERISTIC
/begin CHARACTERISTIC T_RAMEE76 "Dauer Rampe ME bei Schaltungsende" VALUE 0x1D787D ZF_kw_ui8_S5_S3 2540 UMR_MSEC__10_1_0_S5_S3 0 2540 /end CHARACTERISTIC
/begin CHARACTERISTIC T_RAMEE76_EL "Dauer Rampe ME bei Schaltungsende" VALUE 0x1D787E ZF_kw_ui8_S5_S3 2540 UMR_MSEC__10_1_0_S5_S3 0 2540 /end CHARACTERISTIC
/begin CHARACTERISTIC T_RAMEE78 "Dauer Rampe ME bei Schaltungsende" VALUE 0x1D7868 ZF_kw_ui8_S5_S3 2540 UMR_MSEC__10_1_0_S5_S3 0 2540 /end CHARACTERISTIC
/begin CHARACTERISTIC T_RAMEE87 "Dauer Rampe ME bei Schaltungsende" VALUE 0x1D7881 ZF_kw_ui8_S5_S3 2540 UMR_MSEC__10_1_0_S5_S3 0 2540 /end CHARACTERISTIC
/begin CHARACTERISTIC T_RAMEE87_EL "Dauer Rampe ME bei Schaltungsende" VALUE 0x1D7882 ZF_kw_ui8_S5_S3 2540 UMR_MSEC__10_1_0_S5_S3 0 2540 /end CHARACTERISTIC
/begin CHARACTERISTIC T_RAMEESP21 "Dauer Rampe ME bei Schaltungsende" VALUE 0x1D7885 ZF_kw_ui8_S5_S3 2540 UMR_MSEC__10_1_0_S5_S3 0 2540 /end CHARACTERISTIC
/begin CHARACTERISTIC T_RAMEESP31 "Dauer Rampe ME bei Schaltungsende" VALUE 0x1D7893 ZF_kw_ui8_S5_S3 2540 UMR_MSEC__10_1_0_S5_S3 0 2540 /end CHARACTERISTIC
/begin CHARACTERISTIC T_RAMEESP32 "Dauer Rampe ME bei Schaltungsende" VALUE 0x1D7887 ZF_kw_ui8_S5_S3 2540 UMR_MSEC__10_1_0_S5_S3 0 2540 /end CHARACTERISTIC
/begin CHARACTERISTIC T_RAMEESP42 "Dauer Rampe ME bei Schaltungsende" VALUE 0x1D7895 ZF_kw_ui8_S5_S3 2540 UMR_MSEC__10_1_0_S5_S3 0 2540 /end CHARACTERISTIC
/begin CHARACTERISTIC T_RAMEESP43 "Dauer Rampe ME bei Schaltungsende" VALUE 0x1D7889 ZF_kw_ui8_S5_S3 2540 UMR_MSEC__10_1_0_S5_S3 0 2540 /end CHARACTERISTIC
/begin CHARACTERISTIC T_RAMEESP51 "Dauer Rampe ME bei Schaltungsende" VALUE 0x1D7897 ZF_kw_ui8_S5_S3 2540 UMR_MSEC__10_1_0_S5_S3 0 2540 /end CHARACTERISTIC
/begin CHARACTERISTIC T_RAMEESP53 "Dauer Rampe ME bei Schaltungsende" VALUE 0x1D7899 ZF_kw_ui8_S5_S3 2540 UMR_MSEC__10_1_0_S5_S3 0 2540 /end CHARACTERISTIC
/begin CHARACTERISTIC T_RAMEESP54 "Dauer Rampe ME bei Schaltungsende" VALUE 0x1D788B ZF_kw_ui8_S5_S3 2540 UMR_MSEC__10_1_0_S5_S3 0 2540 /end CHARACTERISTIC
/begin CHARACTERISTIC T_RAMEESP63 "Dauer Rampe ME bei Schaltungsende" VALUE 0x1D789B ZF_kw_ui8_S5_S3 2540 UMR_MSEC__10_1_0_S5_S3 0 2540 /end CHARACTERISTIC
/begin CHARACTERISTIC T_RAMEESP64 "Dauer Rampe ME bei Schaltungsende" VALUE 0x1D789D ZF_kw_ui8_S5_S3 2540 UMR_MSEC__10_1_0_S5_S3 0 2540 /end CHARACTERISTIC
/begin CHARACTERISTIC T_RAMEESP65 "Dauer Rampe ME bei Schaltungsende" VALUE 0x1D788D ZF_kw_ui8_S5_S3 2540 UMR_MSEC__10_1_0_S5_S3 0 2540 /end CHARACTERISTIC
/begin CHARACTERISTIC T_RAMEESP71 "Dauer Rampe ME bei Schaltungsende" VALUE 0x1D789F ZF_kw_ui8_S5_S3 2540 UMR_MSEC__10_1_0_S5_S3 0 2540 /end CHARACTERISTIC
/begin CHARACTERISTIC T_RAMEESP75 "Dauer Rampe ME bei Schaltungsende" VALUE 0x1D78A1 ZF_kw_ui8_S5_S3 2540 UMR_MSEC__10_1_0_S5_S3 0 2540 /end CHARACTERISTIC
/begin CHARACTERISTIC T_RAMEESP76 "Dauer Rampe ME bei Schaltungsende" VALUE 0x1D788F ZF_kw_ui8_S5_S3 2540 UMR_MSEC__10_1_0_S5_S3 0 2540 /end CHARACTERISTIC
/begin CHARACTERISTIC T_RAMEESP82 "Dauer Rampe ME bei Schaltungsende" VALUE 0x1D78A3 ZF_kw_ui8_S5_S3 2540 UMR_MSEC__10_1_0_S5_S3 0 2540 /end CHARACTERISTIC
/begin CHARACTERISTIC T_RAMEESP84 "Dauer Rampe ME bei Schaltungsende" VALUE 0x1D78A5 ZF_kw_ui8_S5_S3 2540 UMR_MSEC__10_1_0_S5_S3 0 2540 /end CHARACTERISTIC
/begin CHARACTERISTIC T_RAMEESP86 "Dauer Rampe ME bei Schaltungsende" VALUE 0x1D78A7 ZF_kw_ui8_S5_S3 2540 UMR_MSEC__10_1_0_S5_S3 0 2540 /end CHARACTERISTIC
/begin CHARACTERISTIC T_RAMEESP87 "Dauer Rampe ME bei Schaltungsende" VALUE 0x1D7891 ZF_kw_ui8_S5_S3 2540 UMR_MSEC__10_1_0_S5_S3 0 2540 /end CHARACTERISTIC
/begin CHARACTERISTIC T_RAMEESPORT21 "Dauer Rampe ME bei Schaltungsende" VALUE 0x1D78A9 ZF_kw_ui8_S5_S3 2540 UMR_MSEC__10_1_0_S5_S3 0 2540 /end CHARACTERISTIC
/begin CHARACTERISTIC T_RAMEESPORT31 "Dauer Rampe ME bei Schaltungsende" VALUE 0x1D78B7 ZF_kw_ui8_S5_S3 2540 UMR_MSEC__10_1_0_S5_S3 0 2540 /end CHARACTERISTIC
/begin CHARACTERISTIC T_RAMEESPORT32 "Dauer Rampe ME bei Schaltungsende" VALUE 0x1D78AB ZF_kw_ui8_S5_S3 2540 UMR_MSEC__10_1_0_S5_S3 0 2540 /end CHARACTERISTIC
/begin CHARACTERISTIC T_RAMEESPORT42 "Dauer Rampe ME bei Schaltungsende" VALUE 0x1D78B9 ZF_kw_ui8_S5_S3 2540 UMR_MSEC__10_1_0_S5_S3 0 2540 /end CHARACTERISTIC
/begin CHARACTERISTIC T_RAMEESPORT43 "Dauer Rampe ME bei Schaltungsende" VALUE 0x1D78AD ZF_kw_ui8_S5_S3 2540 UMR_MSEC__10_1_0_S5_S3 0 2540 /end CHARACTERISTIC
/begin CHARACTERISTIC T_RAMEESPORT51 "Dauer Rampe ME bei Schaltungsende" VALUE 0x1D78BB ZF_kw_ui8_S5_S3 2540 UMR_MSEC__10_1_0_S5_S3 0 2540 /end CHARACTERISTIC
/begin CHARACTERISTIC T_RAMEESPORT53 "Dauer Rampe ME bei Schaltungsende" VALUE 0x1D78BD ZF_kw_ui8_S5_S3 2540 UMR_MSEC__10_1_0_S5_S3 0 2540 /end CHARACTERISTIC
/begin CHARACTERISTIC T_RAMEESPORT54 "Dauer Rampe ME bei Schaltungsende" VALUE 0x1D78AF ZF_kw_ui8_S5_S3 2540 UMR_MSEC__10_1_0_S5_S3 0 2540 /end CHARACTERISTIC
/begin CHARACTERISTIC T_RAMEESPORT63 "Dauer Rampe ME bei Schaltungsende" VALUE 0x1D78BF ZF_kw_ui8_S5_S3 2540 UMR_MSEC__10_1_0_S5_S3 0 2540 /end CHARACTERISTIC
/begin CHARACTERISTIC T_RAMEESPORT64 "Dauer Rampe ME bei Schaltungsende" VALUE 0x1D78C1 ZF_kw_ui8_S5_S3 2540 UMR_MSEC__10_1_0_S5_S3 0 2540 /end CHARACTERISTIC
/begin CHARACTERISTIC T_RAMEE_8 "Dauer Rampe ME bei Ende Gangeinlegen" VALUE 0x1D7861 ZF_kw_ui8_S5_S3 2540 UMR_MSEC__10_1_0_S5_S3 0 2540 /end CHARACTERISTIC
/begin CHARACTERISTIC T_RAMEE_R "Dauer Rampe ME bei Ende Gangeinlegen" VALUE 0x1D7859 ZF_kw_ui8_S5_S3 2540 UMR_MSEC__10_1_0_S5_S3 0 2540 /end CHARACTERISTIC
/begin CHARACTERISTIC T_SYNMENACHE21 "Zeit vor/nach Erkennen synchron fuer Ende Nach-ME" VALUE 0x1D786B ZF_kw_ui8_S5_S3 2550 UMR_MSEC__10_1_M128_S5_S3 -1280 1270 /end CHARACTERISTIC
/begin CHARACTERISTIC T_SYNMENACHE21_EL "Zeit vor/nach Erkennen synchron fuer Ende Nach-ME" VALUE 0x1D786C ZF_kw_ui8_S5_S3 2550 UMR_MSEC__10_1_M128_S5_S3 -1280 1270 /end CHARACTERISTIC
/begin CHARACTERISTIC T_SYNMENACHE32 "Zeit vor/nach Erkennen synchron fuer Ende Nach-ME" VALUE 0x1D786F ZF_kw_ui8_S5_S3 2550 UMR_MSEC__10_1_M128_S5_S3 -1280 1270 /end CHARACTERISTIC
/begin CHARACTERISTIC T_SYNMENACHE32_EL "Zeit vor/nach Erkennen synchron fuer Ende Nach-ME" VALUE 0x1D7870 ZF_kw_ui8_S5_S3 2550 UMR_MSEC__10_1_M128_S5_S3 -1280 1270 /end CHARACTERISTIC
/begin CHARACTERISTIC T_SYNMENACHE43 "Zeit vor/nach Erkennen synchron fuer Ende Nach-ME" VALUE 0x1D7873 ZF_kw_ui8_S5_S3 2550 UMR_MSEC__10_1_M128_S5_S3 -1280 1270 /end CHARACTERISTIC
/begin CHARACTERISTIC T_SYNMENACHE43_EL "Zeit vor/nach Erkennen synchron fuer Ende Nach-ME" VALUE 0x1D7874 ZF_kw_ui8_S5_S3 2550 UMR_MSEC__10_1_M128_S5_S3 -1280 1270 /end CHARACTERISTIC
/begin CHARACTERISTIC T_SYNMENACHE54 "Zeit vor/nach Erkennen synchron fuer Ende Nach-ME" VALUE 0x1D7877 ZF_kw_ui8_S5_S3 2550 UMR_MSEC__10_1_M128_S5_S3 -1280 1270 /end CHARACTERISTIC
/begin CHARACTERISTIC T_SYNMENACHE54_EL "Zeit vor/nach Erkennen synchron fuer Ende Nach-ME" VALUE 0x1D7878 ZF_kw_ui8_S5_S3 2550 UMR_MSEC__10_1_M128_S5_S3 -1280 1270 /end CHARACTERISTIC
/begin CHARACTERISTIC T_SYNMENACHE65 "Zeit vor/nach Erkennen synchron fuer Ende Nach-ME" VALUE 0x1D787B ZF_kw_ui8_S5_S3 2550 UMR_MSEC__10_1_M128_S5_S3 -1280 1270 /end CHARACTERISTIC
/begin CHARACTERISTIC T_SYNMENACHE65_EL "Zeit vor/nach Erkennen synchron fuer Ende Nach-ME" VALUE 0x1D787C ZF_kw_ui8_S5_S3 2550 UMR_MSEC__10_1_M128_S5_S3 -1280 1270 /end CHARACTERISTIC
/begin CHARACTERISTIC T_SYNMENACHE76 "Zeit vor/nach Erkennen synchron fuer Ende Nach-ME" VALUE 0x1D787F ZF_kw_ui8_S5_S3 2550 UMR_MSEC__10_1_M128_S5_S3 -1280 1270 /end CHARACTERISTIC
/begin CHARACTERISTIC T_SYNMENACHE76_EL "Zeit vor/nach Erkennen synchron fuer Ende Nach-ME" VALUE 0x1D7880 ZF_kw_ui8_S5_S3 2550 UMR_MSEC__10_1_M128_S5_S3 -1280 1270 /end CHARACTERISTIC
/begin CHARACTERISTIC T_SYNMENACHE87 "Zeit vor/nach Erkennen synchron fuer Ende Nach-ME" VALUE 0x1D7883 ZF_kw_ui8_S5_S3 2550 UMR_MSEC__10_1_M128_S5_S3 -1280 1270 /end CHARACTERISTIC
/begin CHARACTERISTIC T_SYNMENACHE87_EL "Zeit vor/nach Erkennen synchron fuer Ende Nach-ME" VALUE 0x1D7884 ZF_kw_ui8_S5_S3 2550 UMR_MSEC__10_1_M128_S5_S3 -1280 1270 /end CHARACTERISTIC
/begin CHARACTERISTIC T_SYNMENACHESP21 "Zeit vor/nach Erkennen synchron fuer Ende Nach-ME" VALUE 0x1D7886 ZF_kw_ui8_S5_S3 2550 UMR_MSEC__10_1_M128_S5_S3 -1280 1270 /end CHARACTERISTIC
/begin CHARACTERISTIC T_SYNMENACHESP31 "Zeit vor/nach Erkennen synchron fuer Ende Nach-ME" VALUE 0x1D7894 ZF_kw_ui8_S5_S3 2550 UMR_MSEC__10_1_M128_S5_S3 -1280 1270 /end CHARACTERISTIC
/begin CHARACTERISTIC T_SYNMENACHESP32 "Zeit vor/nach Erkennen synchron fuer Ende Nach-ME" VALUE 0x1D7888 ZF_kw_ui8_S5_S3 2550 UMR_MSEC__10_1_M128_S5_S3 -1280 1270 /end CHARACTERISTIC
/begin CHARACTERISTIC T_SYNMENACHESP42 "Zeit vor/nach Erkennen synchron fuer Ende Nach-ME" VALUE 0x1D7896 ZF_kw_ui8_S5_S3 2550 UMR_MSEC__10_1_M128_S5_S3 -1280 1270 /end CHARACTERISTIC
/begin CHARACTERISTIC T_SYNMENACHESP43 "Zeit vor/nach Erkennen synchron fuer Ende Nach-ME" VALUE 0x1D788A ZF_kw_ui8_S5_S3 2550 UMR_MSEC__10_1_M128_S5_S3 -1280 1270 /end CHARACTERISTIC
/begin CHARACTERISTIC T_SYNMENACHESP51 "Zeit vor/nach Erkennen synchron fuer Ende Nach-ME" VALUE 0x1D7898 ZF_kw_ui8_S5_S3 2550 UMR_MSEC__10_1_M128_S5_S3 -1280 1270 /end CHARACTERISTIC
/begin CHARACTERISTIC T_SYNMENACHESP53 "Zeit vor/nach Erkennen synchron fuer Ende Nach-ME" VALUE 0x1D789A ZF_kw_ui8_S5_S3 2550 UMR_MSEC__10_1_M128_S5_S3 -1280 1270 /end CHARACTERISTIC
/begin CHARACTERISTIC T_SYNMENACHESP54 "Zeit vor/nach Erkennen synchron fuer Ende Nach-ME" VALUE 0x1D788C ZF_kw_ui8_S5_S3 2550 UMR_MSEC__10_1_M128_S5_S3 -1280 1270 /end CHARACTERISTIC
/begin CHARACTERISTIC T_SYNMENACHESP63 "Zeit vor/nach Erkennen synchron fuer Ende Nach-ME" VALUE 0x1D789C ZF_kw_ui8_S5_S3 2550 UMR_MSEC__10_1_M128_S5_S3 -1280 1270 /end CHARACTERISTIC
/begin CHARACTERISTIC T_SYNMENACHESP64 "Zeit vor/nach Erkennen synchron fuer Ende Nach-ME" VALUE 0x1D789E ZF_kw_ui8_S5_S3 2550 UMR_MSEC__10_1_M128_S5_S3 -1280 1270 /end CHARACTERISTIC
/begin CHARACTERISTIC T_SYNMENACHESP65 "Zeit vor/nach Erkennen synchron fuer Ende Nach-ME" VALUE 0x1D788E ZF_kw_ui8_S5_S3 2550 UMR_MSEC__10_1_M128_S5_S3 -1280 1270 /end CHARACTERISTIC
/begin CHARACTERISTIC T_SYNMENACHESP71 "Zeit vor/nach Erkennen synchron fuer Ende Nach-ME" VALUE 0x1D78A0 ZF_kw_ui8_S5_S3 2550 UMR_MSEC__10_1_M128_S5_S3 -1280 1270 /end CHARACTERISTIC
/begin CHARACTERISTIC T_SYNMENACHESP75 "Zeit vor/nach Erkennen synchron fuer Ende Nach-ME" VALUE 0x1D78A2 ZF_kw_ui8_S5_S3 2550 UMR_MSEC__10_1_M128_S5_S3 -1280 1270 /end CHARACTERISTIC
/begin CHARACTERISTIC T_SYNMENACHESP76 "Zeit vor/nach Erkennen synchron fuer Ende Nach-ME" VALUE 0x1D7890 ZF_kw_ui8_S5_S3 2550 UMR_MSEC__10_1_M128_S5_S3 -1280 1270 /end CHARACTERISTIC
/begin CHARACTERISTIC T_SYNMENACHESP82 "Zeit vor/nach Erkennen synchron fuer Ende Nach-ME" VALUE 0x1D78A4 ZF_kw_ui8_S5_S3 2550 UMR_MSEC__10_1_M128_S5_S3 -1280 1270 /end CHARACTERISTIC
/begin CHARACTERISTIC T_SYNMENACHESP84 "Zeit vor/nach Erkennen synchron fuer Ende Nach-ME" VALUE 0x1D78A6 ZF_kw_ui8_S5_S3 2550 UMR_MSEC__10_1_M128_S5_S3 -1280 1270 /end CHARACTERISTIC
/begin CHARACTERISTIC T_SYNMENACHESP86 "Zeit vor/nach Erkennen synchron fuer Ende Nach-ME" VALUE 0x1D78A8 ZF_kw_ui8_S5_S3 2550 UMR_MSEC__10_1_M128_S5_S3 -1280 1270 /end CHARACTERISTIC
/begin CHARACTERISTIC T_SYNMENACHESP87 "Zeit vor/nach Erkennen synchron fuer Ende Nach-ME" VALUE 0x1D7892 ZF_kw_ui8_S5_S3 2550 UMR_MSEC__10_1_M128_S5_S3 -1280 1270 /end CHARACTERISTIC
/begin CHARACTERISTIC T_SYNMENACHESPORT21 "Zeit vor/nach Erkennen synchron fuer Ende Nach-ME" VALUE 0x1D78AA ZF_kw_ui8_S5_S3 2550 UMR_MSEC__10_1_M128_S5_S3 -1280 1270 /end CHARACTERISTIC
/begin CHARACTERISTIC T_SYNMENACHESPORT31 "Zeit vor/nach Erkennen synchron fuer Ende Nach-ME" VALUE 0x1D78B8 ZF_kw_ui8_S5_S3 2550 UMR_MSEC__10_1_M128_S5_S3 -1280 1270 /end CHARACTERISTIC
/begin CHARACTERISTIC T_SYNMENACHESPORT32 "Zeit vor/nach Erkennen synchron fuer Ende Nach-ME" VALUE 0x1D78AC ZF_kw_ui8_S5_S3 2550 UMR_MSEC__10_1_M128_S5_S3 -1280 1270 /end CHARACTERISTIC
/begin CHARACTERISTIC T_SYNMENACHESPORT42 "Zeit vor/nach Erkennen synchron fuer Ende Nach-ME" VALUE 0x1D78BA ZF_kw_ui8_S5_S3 2550 UMR_MSEC__10_1_M128_S5_S3 -1280 1270 /end CHARACTERISTIC
/begin CHARACTERISTIC T_SYNMENACHESPORT43 "Zeit vor/nach Erkennen synchron fuer Ende Nach-ME" VALUE 0x1D78AE ZF_kw_ui8_S5_S3 2550 UMR_MSEC__10_1_M128_S5_S3 -1280 1270 /end CHARACTERISTIC
/begin CHARACTERISTIC T_SYNMENACHESPORT51 "Zeit vor/nach Erkennen synchron fuer Ende Nach-ME" VALUE 0x1D78BC ZF_kw_ui8_S5_S3 2550 UMR_MSEC__10_1_M128_S5_S3 -1280 1270 /end CHARACTERISTIC
/begin CHARACTERISTIC T_SYNMENACHESPORT53 "Zeit vor/nach Erkennen synchron fuer Ende Nach-ME" VALUE 0x1D78BE ZF_kw_ui8_S5_S3 2550 UMR_MSEC__10_1_M128_S5_S3 -1280 1270 /end CHARACTERISTIC
/begin CHARACTERISTIC T_SYNMENACHESPORT54 "Zeit vor/nach Erkennen synchron fuer Ende Nach-ME" VALUE 0x1D78B0 ZF_kw_ui8_S5_S3 2550 UMR_MSEC__10_1_M128_S5_S3 -1280 1270 /end CHARACTERISTIC
/begin CHARACTERISTIC T_SYNMENACHESPORT63 "Zeit vor/nach Erkennen synchron fuer Ende Nach-ME" VALUE 0x1D78C0 ZF_kw_ui8_S5_S3 2550 UMR_MSEC__10_1_M128_S5_S3 -1280 1270 /end CHARACTERISTIC
/begin CHARACTERISTIC T_SYNMENACHESPORT64 "Zeit vor/nach Erkennen synchron fuer Ende Nach-ME" VALUE 0x1D78C2 ZF_kw_ui8_S5_S3 2550 UMR_MSEC__10_1_M128_S5_S3 -1280 1270 /end CHARACTERISTIC
/begin FUNCTION jMoeSasGeG8_Fktn "Applikationesgroessen Instanz jMoeSasGeG8"
 /begin DEF_CHARACTERISTIC KF_FMEHAUPTGEDKINMOT_8 KF_FTSYNNTMEHAUPTE_8 KF_MEHAUPT_8 KL_TSYNMTMEHAUPTE_8 KL_TVMEA_8 K_FMEHAUPTA_8 ND_MEHAUPTAGE_8 T_FMEHAUPTA_8 T_RAMEE_8 /end DEF_CHARACTERISTIC
/end FUNCTION
/begin FUNCTION jMoeSasGeGR_Fktn "Applikationesgroessen Instanz jMoeSasGeGR"
 /begin DEF_CHARACTERISTIC KF_FMEHAUPTGEDKINMOT_R KF_FTSYNNTMEHAUPTE_R KF_MEHAUPT_R KL_TSYNMTMEHAUPTE_R KL_TVMEA_R K_FMEHAUPTA_R ND_MEHAUPTAGE_R T_FMEHAUPTA_R T_RAMEE_R /end DEF_CHARACTERISTIC
/end FUNCTION
/begin FUNCTION jMoeSasHSP112_Fktn "Applikationesgroessen Instanz jMoeSasHSP112" /begin DEF_CHARACTERISTIC KF_MEHAUPT12 KF_MEHAUPT12_EL /end DEF_CHARACTERISTIC /end FUNCTION
/begin FUNCTION jMoeSasHSP123_Fktn "Applikationesgroessen Instanz jMoeSasHSP123" /begin DEF_CHARACTERISTIC KF_MEHAUPT23 KF_MEHAUPT23_EL /end DEF_CHARACTERISTIC /end FUNCTION
/begin FUNCTION jMoeSasHSP134_Fktn "Applikationesgroessen Instanz jMoeSasHSP134" /begin DEF_CHARACTERISTIC KF_MEHAUPT34 KF_MEHAUPT34_EL /end DEF_CHARACTERISTIC /end FUNCTION
/begin FUNCTION jMoeSasHSP145_Fktn "Applikationesgroessen Instanz jMoeSasHSP145" /begin DEF_CHARACTERISTIC KF_MEHAUPT45 KF_MEHAUPT45_EL /end DEF_CHARACTERISTIC /end FUNCTION
/begin FUNCTION jMoeSasHSP156_Fktn "Applikationesgroessen Instanz jMoeSasHSP156" /begin DEF_CHARACTERISTIC KF_MEHAUPT56 KF_MEHAUPT56_EL /end DEF_CHARACTERISTIC /end FUNCTION
/begin FUNCTION jMoeSasHSP167_Fktn "Applikationesgroessen Instanz jMoeSasHSP167" /begin DEF_CHARACTERISTIC KF_MEHAUPT67 KF_MEHAUPT67_EL /end DEF_CHARACTERISTIC /end FUNCTION
/begin FUNCTION jMoeSasHSP178_Fktn "Applikationesgroessen Instanz jMoeSasHSP178" /begin DEF_CHARACTERISTIC KF_MEHAUPT78 KF_MEHAUPT78_EL /end DEF_CHARACTERISTIC /end FUNCTION
/begin FUNCTION jMoeSasHSP212_Fktn "Applikationesgroessen Instanz jMoeSasHSP212" /begin DEF_CHARACTERISTIC KF_MEHAUPTSP12 /end DEF_CHARACTERISTIC /end FUNCTION
/begin FUNCTION jMoeSasHSP223_Fktn "Applikationesgroessen Instanz jMoeSasHSP223" /begin DEF_CHARACTERISTIC KF_MEHAUPTSP23 /end DEF_CHARACTERISTIC /end FUNCTION
/begin FUNCTION jMoeSasHSP234_Fktn "Applikationesgroessen Instanz jMoeSasHSP234" /begin DEF_CHARACTERISTIC KF_MEHAUPTSP34 /end DEF_CHARACTERISTIC /end FUNCTION
/begin FUNCTION jMoeSasHSP245_Fktn "Applikationesgroessen Instanz jMoeSasHSP245" /begin DEF_CHARACTERISTIC KF_MEHAUPTSP45 /end DEF_CHARACTERISTIC /end FUNCTION
/begin FUNCTION jMoeSasHSP256_Fktn "Applikationesgroessen Instanz jMoeSasHSP256" /begin DEF_CHARACTERISTIC KF_MEHAUPTSP56 /end DEF_CHARACTERISTIC /end FUNCTION
/begin FUNCTION jMoeSasHSP267_Fktn "Applikationesgroessen Instanz jMoeSasHSP267" /begin DEF_CHARACTERISTIC KF_MEHAUPTSP67 /end DEF_CHARACTERISTIC /end FUNCTION
/begin FUNCTION jMoeSasHSP278_Fktn "Applikationesgroessen Instanz jMoeSasHSP278" /begin DEF_CHARACTERISTIC KF_MEHAUPTSP78 /end DEF_CHARACTERISTIC /end FUNCTION
/begin FUNCTION jMoeSasHSP312_Fktn "Applikationesgroessen Instanz jMoeSasHSP312" /begin DEF_CHARACTERISTIC KF_MEHAUPTSPORT12 /end DEF_CHARACTERISTIC /end FUNCTION
/begin FUNCTION jMoeSasHSP323_Fktn "Applikationesgroessen Instanz jMoeSasHSP323" /begin DEF_CHARACTERISTIC KF_MEHAUPTSPORT23 /end DEF_CHARACTERISTIC /end FUNCTION
/begin FUNCTION jMoeSasHSP334_Fktn "Applikationesgroessen Instanz jMoeSasHSP334" /begin DEF_CHARACTERISTIC KF_MEHAUPTSPORT34 /end DEF_CHARACTERISTIC /end FUNCTION
/begin FUNCTION jMoeSasHSP345_Fktn "Applikationesgroessen Instanz jMoeSasHSP345" /begin DEF_CHARACTERISTIC KF_MEHAUPTSPORT45 /end DEF_CHARACTERISTIC /end FUNCTION
/begin FUNCTION jMoeSasHSP356_Fktn "Applikationesgroessen Instanz jMoeSasHSP356" /begin DEF_CHARACTERISTIC KF_MEHAUPTSPORT56 /end DEF_CHARACTERISTIC /end FUNCTION
/begin FUNCTION jMoeSasHSP367_Fktn "Applikationesgroessen Instanz jMoeSasHSP367" /begin DEF_CHARACTERISTIC KF_MEHAUPTSPORT67 /end DEF_CHARACTERISTIC /end FUNCTION
/begin FUNCTION jMoeSasHSP378_Fktn "Applikationesgroessen Instanz jMoeSasHSP378" /begin DEF_CHARACTERISTIC KF_MEHAUPTSPORT78 /end DEF_CHARACTERISTIC /end FUNCTION
/begin FUNCTION jMoeSasHSS12_Fktn "Applikationesgroessen Instanz jMoeSasHSS12"
 /begin DEF_CHARACTERISTIC KF_TSYNMTNMOTMEHAUPTA12 KF_ZWME12 KL_FMEHAUPTPOSE12 KL_MEKPOSCM12 KL_MEKREDCM12 KL_TSYNMEHAUPTPOSE12 K_FMEHAUPTPOSA12 MS_TSSCHR12 T_FMEHAUPTPOSA12 T_RAMEE12 /end DEF_CHARACTERISTIC
/end FUNCTION
/begin FUNCTION jMoeSasHSS23_Fktn "Applikationesgroessen Instanz jMoeSasHSS23"
 /begin DEF_CHARACTERISTIC KF_TSYNMTNMOTMEHAUPTA23 KF_ZWME23 KL_FMEHAUPTPOSE23 KL_MEKPOSCM23 KL_MEKREDCM23 KL_TSYNMEHAUPTPOSE23 K_FMEHAUPTPOSA23 MS_TSSCHR23 T_FMEHAUPTPOSA23 T_RAMEE23 /end DEF_CHARACTERISTIC
/end FUNCTION
/begin FUNCTION jMoeSasHSS34_Fktn "Applikationesgroessen Instanz jMoeSasHSS34"
 /begin DEF_CHARACTERISTIC KF_TSYNMTNMOTMEHAUPTA34 KF_ZWME34 KL_FMEHAUPTPOSE34 KL_MEKPOSCM34 KL_MEKREDCM34 KL_TSYNMEHAUPTPOSE34 K_FMEHAUPTPOSA34 MS_TSSCHR34 T_FMEHAUPTPOSA34 T_RAMEE34 /end DEF_CHARACTERISTIC
/end FUNCTION
/begin FUNCTION jMoeSasHSS45_Fktn "Applikationesgroessen Instanz jMoeSasHSS45"
 /begin DEF_CHARACTERISTIC KF_TSYNMTNMOTMEHAUPTA45 KF_ZWME45 KL_FMEHAUPTPOSE45 KL_MEKPOSCM45 KL_MEKREDCM45 KL_TSYNMEHAUPTPOSE45 K_FMEHAUPTPOSA45 MS_TSSCHR45 T_FMEHAUPTPOSA45 T_RAMEE45 /end DEF_CHARACTERISTIC
/end FUNCTION
/begin FUNCTION jMoeSasHSS56_Fktn "Applikationesgroessen Instanz jMoeSasHSS56"
 /begin DEF_CHARACTERISTIC KF_TSYNMTNMOTMEHAUPTA56 KF_ZWME56 KL_FMEHAUPTPOSE56 KL_MEKPOSCM56 KL_MEKREDCM56 KL_TSYNMEHAUPTPOSE56 K_FMEHAUPTPOSA56 MS_TSSCHR56 T_FMEHAUPTPOSA56 T_RAMEE56 /end DEF_CHARACTERISTIC
/end FUNCTION
/begin FUNCTION jMoeSasHSS67_Fktn "Applikationesgroessen Instanz jMoeSasHSS67"
 /begin DEF_CHARACTERISTIC KF_TSYNMTNMOTMEHAUPTA67 KF_ZWME67 KL_FMEHAUPTPOSE67 KL_MEKPOSCM67 KL_MEKREDCM67 KL_TSYNMEHAUPTPOSE67 K_FMEHAUPTPOSA67 MS_TSSCHR67 T_FMEHAUPTPOSA67 T_RAMEE67 /end DEF_CHARACTERISTIC
/end FUNCTION
/begin FUNCTION jMoeSasHSS78_Fktn "Applikationesgroessen Instanz jMoeSasHSS78"
 /begin DEF_CHARACTERISTIC KF_TSYNMTNMOTMEHAUPTA78 KF_ZWME78 KL_FMEHAUPTPOSE78 KL_MEKPOSCM78 KL_MEKREDCM78 KL_TSYNMEHAUPTPOSE78 K_FMEHAUPTPOSA78 MS_TSSCHR78 T_FMEHAUPTPOSA78 T_RAMEE78 /end DEF_CHARACTERISTIC
/end FUNCTION
/begin FUNCTION jMoeSasRSP121_Fktn "Applikationesgroessen Instanz jMoeSasRSP121"
 /begin DEF_CHARACTERISTIC KF_FMESASMEHAUPTPOSE21 KF_FMTMEHAUPTA21 KF_MEHAUPT21 KF_MEHAUPT21_EL KF_MENACH21 KF_MENACH21_EL KF_TSYNNTKFMTMEHAUPTE21 KF_TSYNNTKFMTMEHAUPTE21_EL KF_TVMTNMOTMEHAUPT21 KF_TVMTNMOTMEHAUPT21_EL KL_FMENACHE21 KL_TSYNMENACHA21 KL_TSYNMENACHA21_EL T_RAMEE21 T_RAMEE21_EL T_SYNMENACHE21 T_SYNMENACHE21_EL /end DEF_CHARACTERISTIC
/end FUNCTION
/begin FUNCTION jMoeSasRSP132_Fktn "Applikationesgroessen Instanz jMoeSasRSP132"
 /begin DEF_CHARACTERISTIC KF_FMESASMEHAUPTPOSE32 KF_FMTMEHAUPTA32 KF_MEHAUPT32 KF_MEHAUPT32_EL KF_MENACH32 KF_MENACH32_EL KF_TSYNNTKFMTMEHAUPTE32 KF_TSYNNTKFMTMEHAUPTE32_EL KF_TVMTNMOTMEHAUPT32 KF_TVMTNMOTMEHAUPT32_EL KL_FMENACHE32 KL_TSYNMENACHA32 KL_TSYNMENACHA32_EL T_RAMEE32 T_RAMEE32_EL T_SYNMENACHE32 T_SYNMENACHE32_EL /end DEF_CHARACTERISTIC
/end FUNCTION
/begin FUNCTION jMoeSasRSP143_Fktn "Applikationesgroessen Instanz jMoeSasRSP143"
 /begin DEF_CHARACTERISTIC KF_FMESASMEHAUPTPOSE43 KF_FMTMEHAUPTA43 KF_MEHAUPT43 KF_MEHAUPT43_EL KF_MENACH43 KF_MENACH43_EL KF_TSYNNTKFMTMEHAUPTE43 KF_TSYNNTKFMTMEHAUPTE43_EL KF_TVMTNMOTMEHAUPT43 KF_TVMTNMOTMEHAUPT43_EL KL_FMENACHE43 KL_TSYNMENACHA43 KL_TSYNMENACHA43_EL T_RAMEE43 T_RAMEE43_EL T_SYNMENACHE43 T_SYNMENACHE43_EL /end DEF_CHARACTERISTIC
/end FUNCTION
/begin FUNCTION jMoeSasRSP154_Fktn "Applikationesgroessen Instanz jMoeSasRSP154"
 /begin DEF_CHARACTERISTIC KF_FMESASMEHAUPTPOSE54 KF_FMTMEHAUPTA54 KF_MEHAUPT54 KF_MEHAUPT54_EL KF_MENACH54 KF_MENACH54_EL KF_TSYNNTKFMTMEHAUPTE54 KF_TSYNNTKFMTMEHAUPTE54_EL KF_TVMTNMOTMEHAUPT54 KF_TVMTNMOTMEHAUPT54_EL KL_FMENACHE54 KL_TSYNMENACHA54 KL_TSYNMENACHA54_EL T_RAMEE54 T_RAMEE54_EL T_SYNMENACHE54 T_SYNMENACHE54_EL /end DEF_CHARACTERISTIC
/end FUNCTION
/begin FUNCTION jMoeSasRSP165_Fktn "Applikationesgroessen Instanz jMoeSasRSP165"
 /begin DEF_CHARACTERISTIC KF_FMESASMEHAUPTPOSE65 KF_FMTMEHAUPTA65 KF_MEHAUPT65 KF_MEHAUPT65_EL KF_MENACH65 KF_MENACH65_EL KF_TSYNNTKFMTMEHAUPTE65 KF_TSYNNTKFMTMEHAUPTE65_EL KF_TVMTNMOTMEHAUPT65 KF_TVMTNMOTMEHAUPT65_EL KL_FMENACHE65 KL_TSYNMENACHA65 KL_TSYNMENACHA65_EL T_RAMEE65 T_RAMEE65_EL T_SYNMENACHE65 T_SYNMENACHE65_EL /end DEF_CHARACTERISTIC
/end FUNCTION
/begin FUNCTION jMoeSasRSP176_Fktn "Applikationesgroessen Instanz jMoeSasRSP176"
 /begin DEF_CHARACTERISTIC KF_FMESASMEHAUPTPOSE76 KF_FMTMEHAUPTA76 KF_MEHAUPT76 KF_MEHAUPT76_EL KF_MENACH76 KF_MENACH76_EL KF_TSYNNTKFMTMEHAUPTE76 KF_TSYNNTKFMTMEHAUPTE76_EL KF_TVMTNMOTMEHAUPT76 KF_TVMTNMOTMEHAUPT76_EL KL_FMENACHE76 KL_TSYNMENACHA76 KL_TSYNMENACHA76_EL T_RAMEE76 T_RAMEE76_EL T_SYNMENACHE76 T_SYNMENACHE76_EL /end DEF_CHARACTERISTIC
/end FUNCTION
/begin FUNCTION jMoeSasRSP187_Fktn "Applikationesgroessen Instanz jMoeSasRSP187"
 /begin DEF_CHARACTERISTIC KF_FMESASMEHAUPTPOSE87 KF_FMTMEHAUPTA87 KF_MEHAUPT87 KF_MEHAUPT87_EL KF_MENACH87 KF_MENACH87_EL KF_TSYNNTKFMTMEHAUPTE87 KF_TSYNNTKFMTMEHAUPTE87_EL KF_TVMTNMOTMEHAUPT87 KF_TVMTNMOTMEHAUPT87_EL KL_FMENACHE87 KL_TSYNMENACHA87 KL_TSYNMENACHA87_EL T_RAMEE87 T_RAMEE87_EL T_SYNMENACHE87 T_SYNMENACHE87_EL /end DEF_CHARACTERISTIC
/end FUNCTION
/begin FUNCTION jMoeSasRSP221_Fktn "Applikationesgroessen Instanz jMoeSasRSP221"
 /begin DEF_CHARACTERISTIC KF_FMESASMEHAUPTPOSESP21 KF_FMTMEHAUPTASP21 KF_MEHAUPTSP21 KF_MENACHSP21 KF_TSYNNTKFMTMEHAUPTESP21 KF_TVMTNMOTMEHAUPTSP21 KL_FMENACHESP21 KL_TSYNMENACHASP21 T_RAMEESP21 T_SYNMENACHESP21 /end DEF_CHARACTERISTIC
/end FUNCTION
/begin FUNCTION jMoeSasRSP231_Fktn "Applikationesgroessen Instanz jMoeSasRSP231"
 /begin DEF_CHARACTERISTIC KF_FMESASMEHAUPTPOSESP31 KF_FMTMEHAUPTASP31 KF_MEHAUPTSP31 KF_MENACHSP31 KF_TSYNNTKFMTMEHAUPTESP31 KF_TVMTNMOTMEHAUPTSP31 KL_FMENACHESP31 KL_TSYNMENACHASP31 T_RAMEESP31 T_SYNMENACHESP31 /end DEF_CHARACTERISTIC
/end FUNCTION
/begin FUNCTION jMoeSasRSP232_Fktn "Applikationesgroessen Instanz jMoeSasRSP232"
 /begin DEF_CHARACTERISTIC KF_FMESASMEHAUPTPOSESP32 KF_FMTMEHAUPTASP32 KF_MEHAUPTSP32 KF_MENACHSP32 KF_TSYNNTKFMTMEHAUPTESP32 KF_TVMTNMOTMEHAUPTSP32 KL_FMENACHESP32 KL_TSYNMENACHASP32 T_RAMEESP32 T_SYNMENACHESP32 /end DEF_CHARACTERISTIC
/end FUNCTION
/begin FUNCTION jMoeSasRSP242_Fktn "Applikationesgroessen Instanz jMoeSasRSP242"
 /begin DEF_CHARACTERISTIC KF_FMESASMEHAUPTPOSESP42 KF_FMTMEHAUPTASP42 KF_MEHAUPTSP42 KF_MENACHSP42 KF_TSYNNTKFMTMEHAUPTESP42 KF_TVMTNMOTMEHAUPTSP42 KL_FMENACHESP42 KL_TSYNMENACHASP42 T_RAMEESP42 T_SYNMENACHESP42 /end DEF_CHARACTERISTIC
/end FUNCTION
/begin FUNCTION jMoeSasRSP243_Fktn "Applikationesgroessen Instanz jMoeSasRSP243"
 /begin DEF_CHARACTERISTIC KF_FMESASMEHAUPTPOSESP43 KF_FMTMEHAUPTASP43 KF_MEHAUPTSP43 KF_MENACHSP43 KF_TSYNNTKFMTMEHAUPTESP43 KF_TVMTNMOTMEHAUPTSP43 KL_FMENACHESP43 KL_TSYNMENACHASP43 T_RAMEESP43 T_SYNMENACHESP43 /end DEF_CHARACTERISTIC
/end FUNCTION
/begin FUNCTION jMoeSasRSP251_Fktn "Applikationesgroessen Instanz jMoeSasRSP251"
 /begin DEF_CHARACTERISTIC KF_FMESASMEHAUPTPOSESP51 KF_FMTMEHAUPTASP51 KF_MEHAUPTSP51 KF_MENACHSP51 KF_TSYNNTKFMTMEHAUPTESP51 KF_TVMTNMOTMEHAUPTSP51 KL_FMENACHESP51 KL_TSYNMENACHASP51 T_RAMEESP51 T_SYNMENACHESP51 /end DEF_CHARACTERISTIC
/end FUNCTION
/begin FUNCTION jMoeSasRSP253_Fktn "Applikationesgroessen Instanz jMoeSasRSP253"
 /begin DEF_CHARACTERISTIC KF_FMESASMEHAUPTPOSESP53 KF_FMTMEHAUPTASP53 KF_MEHAUPTSP53 KF_MENACHSP53 KF_TSYNNTKFMTMEHAUPTESP53 KF_TVMTNMOTMEHAUPTSP53 KL_FMENACHESP53 KL_TSYNMENACHASP53 T_RAMEESP53 T_SYNMENACHESP53 /end DEF_CHARACTERISTIC
/end FUNCTION
/begin FUNCTION jMoeSasRSP254_Fktn "Applikationesgroessen Instanz jMoeSasRSP254"
 /begin DEF_CHARACTERISTIC KF_FMESASMEHAUPTPOSESP54 KF_FMTMEHAUPTASP54 KF_MEHAUPTSP54 KF_MENACHSP54 KF_TSYNNTKFMTMEHAUPTESP54 KF_TVMTNMOTMEHAUPTSP54 KL_FMENACHESP54 KL_TSYNMENACHASP54 T_RAMEESP54 T_SYNMENACHESP54 /end DEF_CHARACTERISTIC
/end FUNCTION
/begin FUNCTION jMoeSasRSP263_Fktn "Applikationesgroessen Instanz jMoeSasRSP263"
 /begin DEF_CHARACTERISTIC KF_FMESASMEHAUPTPOSESP63 KF_FMTMEHAUPTASP63 KF_MEHAUPTSP63 KF_MENACHSP63 KF_TSYNNTKFMTMEHAUPTESP63 KF_TVMTNMOTMEHAUPTSP63 KL_FMENACHESP63 KL_TSYNMENACHASP63 T_RAMEESP63 T_SYNMENACHESP63 /end DEF_CHARACTERISTIC
/end FUNCTION
/begin FUNCTION jMoeSasRSP264_Fktn "Applikationesgroessen Instanz jMoeSasRSP264"
 /begin DEF_CHARACTERISTIC KF_FMESASMEHAUPTPOSESP64 KF_FMTMEHAUPTASP64 KF_MEHAUPTSP64 KF_MENACHSP64 KF_TSYNNTKFMTMEHAUPTESP64 KF_TVMTNMOTMEHAUPTSP64 KL_FMENACHESP64 KL_TSYNMENACHASP64 T_RAMEESP64 T_SYNMENACHESP64 /end DEF_CHARACTERISTIC
/end FUNCTION
/begin FUNCTION jMoeSasRSP265_Fktn "Applikationesgroessen Instanz jMoeSasRSP265"
 /begin DEF_CHARACTERISTIC KF_FMESASMEHAUPTPOSESP65 KF_FMTMEHAUPTASP65 KF_MEHAUPTSP65 KF_MENACHSP65 KF_TSYNNTKFMTMEHAUPTESP65 KF_TVMTNMOTMEHAUPTSP65 KL_FMENACHESP65 KL_TSYNMENACHASP65 T_RAMEESP65 T_SYNMENACHESP65 /end DEF_CHARACTERISTIC
/end FUNCTION
/begin FUNCTION jMoeSasRSP271_Fktn "Applikationesgroessen Instanz jMoeSasRSP271"
 /begin DEF_CHARACTERISTIC KF_FMESASMEHAUPTPOSESP71 KF_FMTMEHAUPTASP71 KF_MEHAUPTSP71 KF_MENACHSP71 KF_TSYNNTKFMTMEHAUPTESP71 KF_TVMTNMOTMEHAUPTSP71 KL_FMENACHESP71 KL_TSYNMENACHASP71 T_RAMEESP71 T_SYNMENACHESP71 /end DEF_CHARACTERISTIC
/end FUNCTION
/begin FUNCTION jMoeSasRSP275_Fktn "Applikationesgroessen Instanz jMoeSasRSP275"
 /begin DEF_CHARACTERISTIC KF_FMESASMEHAUPTPOSESP75 KF_FMTMEHAUPTASP75 KF_MEHAUPTSP75 KF_MENACHSP75 KF_TSYNNTKFMTMEHAUPTESP75 KF_TVMTNMOTMEHAUPTSP75 KL_FMENACHESP75 KL_TSYNMENACHASP75 T_RAMEESP75 T_SYNMENACHESP75 /end DEF_CHARACTERISTIC
/end FUNCTION
/begin FUNCTION jMoeSasRSP276_Fktn "Applikationesgroessen Instanz jMoeSasRSP276"
 /begin DEF_CHARACTERISTIC KF_FMESASMEHAUPTPOSESP76 KF_FMTMEHAUPTASP76 KF_MEHAUPTSP76 KF_MENACHSP76 KF_TSYNNTKFMTMEHAUPTESP76 KF_TVMTNMOTMEHAUPTSP76 KL_FMENACHESP76 KL_TSYNMENACHASP76 T_RAMEESP76 T_SYNMENACHESP76 /end DEF_CHARACTERISTIC
/end FUNCTION
/begin FUNCTION jMoeSasRSP282_Fktn "Applikationesgroessen Instanz jMoeSasRSP282"
 /begin DEF_CHARACTERISTIC KF_FMESASMEHAUPTPOSESP82 KF_FMTMEHAUPTASP82 KF_MEHAUPTSP82 KF_MENACHSP82 KF_TSYNNTKFMTMEHAUPTESP82 KF_TVMTNMOTMEHAUPTSP82 KL_FMENACHESP82 KL_TSYNMENACHASP82 T_RAMEESP82 T_SYNMENACHESP82 /end DEF_CHARACTERISTIC
/end FUNCTION
/begin FUNCTION jMoeSasRSP284_Fktn "Applikationesgroessen Instanz jMoeSasRSP284"
 /begin DEF_CHARACTERISTIC KF_FMESASMEHAUPTPOSESP84 KF_FMTMEHAUPTASP84 KF_MEHAUPTSP84 KF_MENACHSP84 KF_TSYNNTKFMTMEHAUPTESP84 KF_TVMTNMOTMEHAUPTSP84 KL_FMENACHESP84 KL_TSYNMENACHASP84 T_RAMEESP84 T_SYNMENACHESP84 /end DEF_CHARACTERISTIC
/end FUNCTION
/begin FUNCTION jMoeSasRSP286_Fktn "Applikationesgroessen Instanz jMoeSasRSP286"
 /begin DEF_CHARACTERISTIC KF_FMESASMEHAUPTPOSESP86 KF_FMTMEHAUPTASP86 KF_MEHAUPTSP86 KF_MENACHSP86 KF_TSYNNTKFMTMEHAUPTESP86 KF_TVMTNMOTMEHAUPTSP86 KL_FMENACHESP86 KL_TSYNMENACHASP86 T_RAMEESP86 T_SYNMENACHESP86 /end DEF_CHARACTERISTIC
/end FUNCTION
/begin FUNCTION jMoeSasRSP287_Fktn "Applikationesgroessen Instanz jMoeSasRSP287"
 /begin DEF_CHARACTERISTIC KF_FMESASMEHAUPTPOSESP87 KF_FMTMEHAUPTASP87 KF_MEHAUPTSP87 KF_MENACHSP87 KF_TSYNNTKFMTMEHAUPTESP87 KF_TVMTNMOTMEHAUPTSP87 KL_FMENACHESP87 KL_TSYNMENACHASP87 T_RAMEESP87 T_SYNMENACHESP87 /end DEF_CHARACTERISTIC
/end FUNCTION
/begin FUNCTION jMoeSasRSP321_Fktn "Applikationesgroessen Instanz jMoeSasRSP321"
 /begin DEF_CHARACTERISTIC KF_FMESASMEHAUPTPOSESPORT21 KF_FMTMEHAUPTASPORT21 KF_MEHAUPTSPORT21 KF_MENACHSPORT21 KF_TSYNNTKFMTMEHAUPTESPORT21 KF_TVMTNMOTMEHAUPTSPORT21 KL_FMENACHESPORT21 KL_TSYNMENACHASPORT21 T_RAMEESPORT21 T_SYNMENACHESPORT21 /end DEF_CHARACTERISTIC
/end FUNCTION
/begin FUNCTION jMoeSasRSP331_Fktn "Applikationesgroessen Instanz jMoeSasRSP331"
 /begin DEF_CHARACTERISTIC KF_FMESASMEHAUPTPOSESPORT31 KF_FMTMEHAUPTASPORT31 KF_MEHAUPTSPORT31 KF_MENACHSPORT31 KF_TSYNNTKFMTMEHAUPTESPORT31 KF_TVMTNMOTMEHAUPTSPORT31 KL_FMENACHESPORT31 KL_TSYNMENACHASPORT31 T_RAMEESPORT31 T_SYNMENACHESPORT31 /end DEF_CHARACTERISTIC
/end FUNCTION
/begin FUNCTION jMoeSasRSP332_Fktn "Applikationesgroessen Instanz jMoeSasRSP332"
 /begin DEF_CHARACTERISTIC KF_FMESASMEHAUPTPOSESPORT32 KF_FMTMEHAUPTASPORT32 KF_MEHAUPTSPORT32 KF_MENACHSPORT32 KF_TSYNNTKFMTMEHAUPTESPORT32 KF_TVMTNMOTMEHAUPTSPORT32 KL_FMENACHESPORT32 KL_TSYNMENACHASPORT32 T_RAMEESPORT32 T_SYNMENACHESPORT32 /end DEF_CHARACTERISTIC
/end FUNCTION
/begin FUNCTION jMoeSasRSP342_Fktn "Applikationesgroessen Instanz jMoeSasRSP342"
 /begin DEF_CHARACTERISTIC KF_FMESASMEHAUPTPOSESPORT42 KF_FMTMEHAUPTASPORT42 KF_MEHAUPTSPORT42 KF_MENACHSPORT42 KF_TSYNNTKFMTMEHAUPTESPORT42 KF_TVMTNMOTMEHAUPTSPORT42 KL_FMENACHESPORT42 KL_TSYNMENACHASPORT42 T_RAMEESPORT42 T_SYNMENACHESPORT42 /end DEF_CHARACTERISTIC
/end FUNCTION
/begin FUNCTION jMoeSasRSP343_Fktn "Applikationesgroessen Instanz jMoeSasRSP343"
 /begin DEF_CHARACTERISTIC KF_FMESASMEHAUPTPOSESPORT43 KF_FMTMEHAUPTASPORT43 KF_MEHAUPTSPORT43 KF_MENACHSPORT43 KF_TSYNNTKFMTMEHAUPTESPORT43 KF_TVMTNMOTMEHAUPTSPORT43 KL_FMENACHESPORT43 KL_TSYNMENACHASPORT43 T_RAMEESPORT43 T_SYNMENACHESPORT43 /end DEF_CHARACTERISTIC
/end FUNCTION
/begin FUNCTION jMoeSasRSP351_Fktn "Applikationesgroessen Instanz jMoeSasRSP351"
 /begin DEF_CHARACTERISTIC KF_FMESASMEHAUPTPOSESPORT51 KF_FMTMEHAUPTASPORT51 KF_MEHAUPTSPORT51 KF_MENACHSPORT51 KF_TSYNNTKFMTMEHAUPTESPORT51 KF_TVMTNMOTMEHAUPTSPORT51 KL_FMENACHESPORT51 KL_TSYNMENACHASPORT51 T_RAMEESPORT51 T_SYNMENACHESPORT51 /end DEF_CHARACTERISTIC
/end FUNCTION
/begin FUNCTION jMoeSasRSP353_Fktn "Applikationesgroessen Instanz jMoeSasRSP353"
 /begin DEF_CHARACTERISTIC KF_FMESASMEHAUPTPOSESPORT53 KF_FMTMEHAUPTASPORT53 KF_MEHAUPTSPORT53 KF_MENACHSPORT53 KF_TSYNNTKFMTMEHAUPTESPORT53 KF_TVMTNMOTMEHAUPTSPORT53 KL_FMENACHESPORT53 KL_TSYNMENACHASPORT53 T_RAMEESPORT53 T_SYNMENACHESPORT53 /end DEF_CHARACTERISTIC
/end FUNCTION
/begin FUNCTION jMoeSasRSP354_Fktn "Applikationesgroessen Instanz jMoeSasRSP354"
 /begin DEF_CHARACTERISTIC KF_FMESASMEHAUPTPOSESPORT54 KF_FMTMEHAUPTASPORT54 KF_MEHAUPTSPORT54 KF_MENACHSPORT54 KF_TSYNNTKFMTMEHAUPTESPORT54 KF_TVMTNMOTMEHAUPTSPORT54 KL_FMENACHESPORT54 KL_TSYNMENACHASPORT54 T_RAMEESPORT54 T_SYNMENACHESPORT54 /end DEF_CHARACTERISTIC
/end FUNCTION
/begin FUNCTION jMoeSasRSP363_Fktn "Applikationesgroessen Instanz jMoeSasRSP363"
 /begin DEF_CHARACTERISTIC KF_FMESASMEHAUPTPOSESPORT63 KF_FMTMEHAUPTASPORT63 KF_MEHAUPTSPORT63 KF_MENACHSPORT63 KF_TSYNNTKFMTMEHAUPTESPORT63 KF_TVMTNMOTMEHAUPTSPORT63 KL_FMENACHESPORT63 KL_TSYNMENACHASPORT63 T_RAMEESPORT63 T_SYNMENACHESPORT63 /end DEF_CHARACTERISTIC
/end FUNCTION
/begin FUNCTION jMoeSasRSP364_Fktn "Applikationesgroessen Instanz jMoeSasRSP364"
 /begin DEF_CHARACTERISTIC KF_FMESASMEHAUPTPOSESPORT64 KF_FMTMEHAUPTASPORT64 KF_MEHAUPTSPORT64 KF_MENACHSPORT64 KF_TSYNNTKFMTMEHAUPTESPORT64 KF_TVMTNMOTMEHAUPTSPORT64 KL_FMENACHESPORT64 KL_TSYNMENACHASPORT64 T_RAMEESPORT64 T_SYNMENACHESPORT64 /end DEF_CHARACTERISTIC
/end FUNCTION
/begin RECORD_LAYOUT ZF_kf_si16_S5_S3 FNC_VALUES 5 SWORD ROW_DIR DIRECT AXIS_PTS_X 3 SWORD INDEX_INCR DIRECT AXIS_PTS_Y 4 SWORD INDEX_INCR DIRECT NO_AXIS_PTS_X 1 ULONG NO_AXIS_PTS_Y 2 ULONG /end RECORD_LAYOUT
/begin RECORD_LAYOUT ZF_kf_ui8_S5_S3 FNC_VALUES 5 UBYTE ROW_DIR DIRECT AXIS_PTS_X 3 UBYTE INDEX_INCR DIRECT AXIS_PTS_Y 4 UBYTE INDEX_INCR DIRECT NO_AXIS_PTS_X 1 ULONG NO_AXIS_PTS_Y 2 ULONG /end RECORD_LAYOUT
/begin RECORD_LAYOUT ZF_kl_si16_S5_S3 FNC_VALUES 3 SWORD COLUMN_DIR DIRECT AXIS_PTS_X 2 SWORD INDEX_INCR DIRECT NO_AXIS_PTS_X 1 ULONG /end RECORD_LAYOUT
/begin RECORD_LAYOUT ZF_kl_ui8_S5_S3 FNC_VALUES 3 UBYTE COLUMN_DIR DIRECT AXIS_PTS_X 2 UBYTE INDEX_INCR DIRECT NO_AXIS_PTS_X 1 ULONG /end RECORD_LAYOUT
/begin RECORD_LAYOUT ZF_kw_si16_S5_S3 FNC_VALUES 1 SWORD COLUMN_DIR DIRECT /end RECORD_LAYOUT
/begin RECORD_LAYOUT ZF_kw_ui8_S5_S3 FNC_VALUES 1 UBYTE COLUMN_DIR DIRECT /end RECORD_LAYOUT
/end MODULE
/end PROJECT
