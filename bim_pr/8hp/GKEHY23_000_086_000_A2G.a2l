ASAP2_VERSION 1 51
/begin PROJECT ZHBC8600 "Gen2_BMW_System_Supplier_Lib"
/begin MODULE CPP ""
/begin MOD_COMMON "" BYTE_ORDER MSB_FIRST ALIGNMENT_BYTE 1 ALIGNMENT_WORD 2 ALIGNMENT_LONG 4 ALIGNMENT_FLOAT32_IEEE 4 ALIGNMENT_FLOAT64_IEEE 1 /end MOD_COMMON
/begin COMPU_METHOD SAB2_100PROZENT255_S3_S3 "int = ((phys * 255) / 100) - (0) %" RAT_FUNC "%4.3" "%" COEFFS 0 2.55 0 0 0 1 /end COMPU_METHOD
/begin COMPU_METHOD UMR___1_100_0_S5_S3 "int = ((phys * 100) / 1) - (0) [-]" RAT_FUNC "%3.2" "[-]" COEFFS 0 100 0 0 0 1 /end COMPU_METHOD
/begin COMPU_METHOD UMR___1_1_0_S5_S3 "int = ((phys * 1) / 1) - (0) [-]" RAT_FUNC "%1.0" "[-]" COEFFS 0 1 0 0 0 1 /end COMPU_METHOD
/begin COMPU_METHOD UMR_BAR__1_1000_0_S5_S3 "int = ((phys * 1000) / 1) - (0) [bar]" RAT_FUNC "%4.3" "[bar]" COEFFS 0 1000 0 0 0 1 /end COMPU_METHOD
/begin COMPU_METHOD UMR_BAR_SEC_1_10_0_S5_S3 "int = ((phys * 10) / 1) - (0) [bar/s]" RAT_FUNC "%2.1" "[bar/s]" COEFFS 0 10 0 0 0 1 /end COMPU_METHOD
/begin COMPU_METHOD UMR_GRADC__1_1_M40_S5_S3 "int = ((phys * 1) / 1) - (-40) [°C]" RAT_FUNC "%1.0" "[°C]" COEFFS 0 1 40 0 0 1 /end COMPU_METHOD
/begin COMPU_METHOD UMR_MSEC__10_1_0_S5_S3 "int = ((phys * 1) / 10) - (0) [ms]" RAT_FUNC "%1.0" "[ms]" COEFFS 0 0.1 0 0 0 1 /end COMPU_METHOD
/begin COMPU_METHOD UMR_MSEC__10_1_M128_S5_S3 "int = ((phys * 1) / 10) - (-128) [ms]" RAT_FUNC "%1.0" "[ms]" COEFFS 0 0.1 128 0 0 1 /end COMPU_METHOD
/begin COMPU_METHOD UMR_NM__1_1_0_S5_S3 "int = ((phys * 1) / 1) - (0) [Nm]" RAT_FUNC "%1.0" "[Nm]" COEFFS 0 1 0 0 0 1 /end COMPU_METHOD
/begin COMPU_METHOD UMR_NM__6_1_M34_S5_S3 "int = ((phys * 1) / 6) - (-34) [Nm]" RAT_FUNC "%1.0" "[Nm]" COEFFS 0 0.166666666667 34 0 0 1 /end COMPU_METHOD
/begin COMPU_METHOD UMR_PROZENT__1_100_0_S5_S3 "int = ((phys * 100) / 1) - (0) [%]" RAT_FUNC "%3.2" "[%]" COEFFS 0 100 0 0 0 1 /end COMPU_METHOD
/begin COMPU_METHOD UMR_PROZENT__20_51_0_S5_S3 "int = ((phys * 51) / 20) - (0) [%]" RAT_FUNC "%5.4" "[%]" COEFFS 0 2.55 0 0 0 1 /end COMPU_METHOD
/begin COMPU_METHOD UMR_U_MIN_1_1_0_S5_S3 "int = ((phys * 1) / 1) - (0) [U/min]" RAT_FUNC "%1.0" "[U/min]" COEFFS 0 1 0 0 0 1 /end COMPU_METHOD
/begin COMPU_METHOD UMR_U_MIN_32_1_0_S5_S3 "int = ((phys * 1) / 32) - (0) [U/min]" RAT_FUNC "%1.0" "[U/min]" COEFFS 0 0.03125 0 0 0 1 /end COMPU_METHOD
/begin COMPU_METHOD UMR_U_MINSEC_1_1_0_S5_S3 "int = ((phys * 1) / 1) - (0) [U/(min*s)]" RAT_FUNC "%1.0" "[U/(min*s)]" COEFFS 0 1 0 0 0 1 /end COMPU_METHOD
/begin CHARACTERISTIC F_PRA12 "Druckfaktor waehrend Rampe auf Schaltdruck" VALUE 0x1D7A98 ZF_kw_ui8_S5_S3 1 UMR___1_100_0_S5_S3 0 1 /end CHARACTERISTIC
/begin CHARACTERISTIC F_PRA12_EL "Druckfaktor waehrend Rampe auf Schaltdruck" VALUE 0x1D7A99 ZF_kw_ui8_S5_S3 1 UMR___1_100_0_S5_S3 0 1 /end CHARACTERISTIC
/begin CHARACTERISTIC F_PRA21 "Druckfaktor waehrend Rampe auf Schaltdruck" VALUE 0x1D7B0D ZF_kw_ui8_S5_S3 1 UMR___1_100_0_S5_S3 0 1 /end CHARACTERISTIC
/begin CHARACTERISTIC F_PRA21_EL "Druckfaktor waehrend Rampe auf Schaltdruck" VALUE 0x1D7B0E ZF_kw_ui8_S5_S3 1 UMR___1_100_0_S5_S3 0 1 /end CHARACTERISTIC
/begin CHARACTERISTIC F_PRA23 "Druckfaktor waehrend Rampe auf Schaltdruck" VALUE 0x1D7A9E ZF_kw_ui8_S5_S3 1 UMR___1_100_0_S5_S3 0 1 /end CHARACTERISTIC
/begin CHARACTERISTIC F_PRA23_EL "Druckfaktor waehrend Rampe auf Schaltdruck" VALUE 0x1D7A9F ZF_kw_ui8_S5_S3 1 UMR___1_100_0_S5_S3 0 1 /end CHARACTERISTIC
/begin CHARACTERISTIC F_PRA34 "Druckfaktor waehrend Rampe auf Schaltdruck" VALUE 0x1D7AA4 ZF_kw_ui8_S5_S3 1 UMR___1_100_0_S5_S3 0 1 /end CHARACTERISTIC
/begin CHARACTERISTIC F_PRA34_EL "Druckfaktor waehrend Rampe auf Schaltdruck" VALUE 0x1D7AA5 ZF_kw_ui8_S5_S3 1 UMR___1_100_0_S5_S3 0 1 /end CHARACTERISTIC
/begin CHARACTERISTIC F_PRA45 "Druckfaktor waehrend Rampe auf Schaltdruck" VALUE 0x1D7AAA ZF_kw_ui8_S5_S3 1 UMR___1_100_0_S5_S3 0 1 /end CHARACTERISTIC
/begin CHARACTERISTIC F_PRA45_EL "Druckfaktor waehrend Rampe auf Schaltdruck" VALUE 0x1D7AAB ZF_kw_ui8_S5_S3 1 UMR___1_100_0_S5_S3 0 1 /end CHARACTERISTIC
/begin CHARACTERISTIC F_PRA56 "Druckfaktor waehrend Rampe auf Schaltdruck" VALUE 0x1D7AB0 ZF_kw_ui8_S5_S3 1 UMR___1_100_0_S5_S3 0 1 /end CHARACTERISTIC
/begin CHARACTERISTIC F_PRA56_EL "Druckfaktor waehrend Rampe auf Schaltdruck" VALUE 0x1D7AB1 ZF_kw_ui8_S5_S3 1 UMR___1_100_0_S5_S3 0 1 /end CHARACTERISTIC
/begin CHARACTERISTIC F_PRA67 "Druckfaktor waehrend Rampe auf Schaltdruck" VALUE 0x1D7AB6 ZF_kw_ui8_S5_S3 1 UMR___1_100_0_S5_S3 0 1 /end CHARACTERISTIC
/begin CHARACTERISTIC F_PRA67_EL "Druckfaktor waehrend Rampe auf Schaltdruck" VALUE 0x1D7AB7 ZF_kw_ui8_S5_S3 1 UMR___1_100_0_S5_S3 0 1 /end CHARACTERISTIC
/begin CHARACTERISTIC F_PRA78 "Druckfaktor waehrend Rampe auf Schaltdruck" VALUE 0x1D7ABC ZF_kw_ui8_S5_S3 1 UMR___1_100_0_S5_S3 0 1 /end CHARACTERISTIC
/begin CHARACTERISTIC F_PRA78_EL "Druckfaktor waehrend Rampe auf Schaltdruck" VALUE 0x1D7ABD ZF_kw_ui8_S5_S3 1 UMR___1_100_0_S5_S3 0 1 /end CHARACTERISTIC
/begin CHARACTERISTIC F_PRAFUELLOPT12 "Druckfaktor waehrend Rampe auf Schaltdruck" VALUE 0x1D7AED ZF_kw_ui8_S5_S3 1 UMR___1_100_0_S5_S3 0 1 /end CHARACTERISTIC
/begin CHARACTERISTIC F_PRAFUELLOPT23 "Druckfaktor waehrend Rampe auf Schaltdruck" VALUE 0x1D7AF2 ZF_kw_ui8_S5_S3 1 UMR___1_100_0_S5_S3 0 1 /end CHARACTERISTIC
/begin CHARACTERISTIC F_PRAFUELLOPT34 "Druckfaktor waehrend Rampe auf Schaltdruck" VALUE 0x1D7AF7 ZF_kw_ui8_S5_S3 1 UMR___1_100_0_S5_S3 0 1 /end CHARACTERISTIC
/begin CHARACTERISTIC F_PRAFUELLOPT45 "Druckfaktor waehrend Rampe auf Schaltdruck" VALUE 0x1D7AFC ZF_kw_ui8_S5_S3 1 UMR___1_100_0_S5_S3 0 1 /end CHARACTERISTIC
/begin CHARACTERISTIC F_PRAFUELLOPT56 "Druckfaktor waehrend Rampe auf Schaltdruck" VALUE 0x1D7B01 ZF_kw_ui8_S5_S3 1 UMR___1_100_0_S5_S3 0 1 /end CHARACTERISTIC
/begin CHARACTERISTIC F_PRAFUELLOPT67 "Druckfaktor waehrend Rampe auf Schaltdruck" VALUE 0x1D7B06 ZF_kw_ui8_S5_S3 1 UMR___1_100_0_S5_S3 0 1 /end CHARACTERISTIC
/begin CHARACTERISTIC F_PRAFUELLOPT78 "Druckfaktor waehrend Rampe auf Schaltdruck" VALUE 0x1D7B0B ZF_kw_ui8_S5_S3 1 UMR___1_100_0_S5_S3 0 1 /end CHARACTERISTIC
/begin CHARACTERISTIC F_PRASP12 "Druckfaktor waehrend Rampe auf Schaltdruck" VALUE 0x1D7AC1 ZF_kw_ui8_S5_S3 1 UMR___1_100_0_S5_S3 0 1 /end CHARACTERISTIC
/begin CHARACTERISTIC F_PRASP23 "Druckfaktor waehrend Rampe auf Schaltdruck" VALUE 0x1D7AC4 ZF_kw_ui8_S5_S3 1 UMR___1_100_0_S5_S3 0 1 /end CHARACTERISTIC
/begin CHARACTERISTIC F_PRASP34 "Druckfaktor waehrend Rampe auf Schaltdruck" VALUE 0x1D7AC7 ZF_kw_ui8_S5_S3 1 UMR___1_100_0_S5_S3 0 1 /end CHARACTERISTIC
/begin CHARACTERISTIC F_PRASP45 "Druckfaktor waehrend Rampe auf Schaltdruck" VALUE 0x1D7ACA ZF_kw_ui8_S5_S3 1 UMR___1_100_0_S5_S3 0 1 /end CHARACTERISTIC
/begin CHARACTERISTIC F_PRASP56 "Druckfaktor waehrend Rampe auf Schaltdruck" VALUE 0x1D7ACD ZF_kw_ui8_S5_S3 1 UMR___1_100_0_S5_S3 0 1 /end CHARACTERISTIC
/begin CHARACTERISTIC F_PRASP67 "Druckfaktor waehrend Rampe auf Schaltdruck" VALUE 0x1D7AD0 ZF_kw_ui8_S5_S3 1 UMR___1_100_0_S5_S3 0 1 /end CHARACTERISTIC
/begin CHARACTERISTIC F_PRASP78 "Druckfaktor waehrend Rampe auf Schaltdruck" VALUE 0x1D7AD3 ZF_kw_ui8_S5_S3 1 UMR___1_100_0_S5_S3 0 1 /end CHARACTERISTIC
/begin CHARACTERISTIC F_PRASPORT12 "Druckfaktor waehrend Rampe auf Schaltdruck" VALUE 0x1D7AD6 ZF_kw_ui8_S5_S3 1 UMR___1_100_0_S5_S3 0 1 /end CHARACTERISTIC
/begin CHARACTERISTIC F_PRASPORT23 "Druckfaktor waehrend Rampe auf Schaltdruck" VALUE 0x1D7AD9 ZF_kw_ui8_S5_S3 1 UMR___1_100_0_S5_S3 0 1 /end CHARACTERISTIC
/begin CHARACTERISTIC F_PRASPORT34 "Druckfaktor waehrend Rampe auf Schaltdruck" VALUE 0x1D7ADC ZF_kw_ui8_S5_S3 1 UMR___1_100_0_S5_S3 0 1 /end CHARACTERISTIC
/begin CHARACTERISTIC F_PRASPORT45 "Druckfaktor waehrend Rampe auf Schaltdruck" VALUE 0x1D7ADF ZF_kw_ui8_S5_S3 1 UMR___1_100_0_S5_S3 0 1 /end CHARACTERISTIC
/begin CHARACTERISTIC F_PRASPORT56 "Druckfaktor waehrend Rampe auf Schaltdruck" VALUE 0x1D7AE2 ZF_kw_ui8_S5_S3 1 UMR___1_100_0_S5_S3 0 1 /end CHARACTERISTIC
/begin CHARACTERISTIC F_PRASPORT67 "Druckfaktor waehrend Rampe auf Schaltdruck" VALUE 0x1D7AE5 ZF_kw_ui8_S5_S3 1 UMR___1_100_0_S5_S3 0 1 /end CHARACTERISTIC
/begin CHARACTERISTIC F_PRASPORT78 "Druckfaktor waehrend Rampe auf Schaltdruck" VALUE 0x1D7AE8 ZF_kw_ui8_S5_S3 1 UMR___1_100_0_S5_S3 0 1 /end CHARACTERISTIC
/begin CHARACTERISTIC F_PRA_7 "Druckfaktor waehrend Rampe auf Schaltdruck" VALUE 0x1D7A8B ZF_kw_ui8_S5_S3 1 UMR___1_100_0_S5_S3 0 1 /end CHARACTERISTIC
/begin CHARACTERISTIC F_PRA_8 "Druckfaktor waehrend Rampe auf Schaltdruck" VALUE 0x1D7A93 ZF_kw_ui8_S5_S3 1 UMR___1_100_0_S5_S3 0 1 /end CHARACTERISTIC
/begin CHARACTERISTIC F_PRA_R "Druckfaktor waehrend Rampe auf Schaltdruck" VALUE 0x1D7A53 ZF_kw_ui8_S5_S3 1 UMR___1_100_0_S5_S3 0 1 /end CHARACTERISTIC
/begin CHARACTERISTIC F_TRA12 "Zeitfaktor waehrend Rampe auf Schaltdruck" VALUE 0x1D7A9A ZF_kw_ui8_S5_S3 1 UMR___1_100_0_S5_S3 0 1 /end CHARACTERISTIC
/begin CHARACTERISTIC F_TRA12_EL "Zeitfaktor waehrend Rampe auf Schaltdruck" VALUE 0x1D7A9B ZF_kw_ui8_S5_S3 1 UMR___1_100_0_S5_S3 0 1 /end CHARACTERISTIC
/begin CHARACTERISTIC F_TRA21 "Zeitfaktor waehrend Rampe auf Schaltdruck" VALUE 0x1D7B0F ZF_kw_ui8_S5_S3 1 UMR___1_100_0_S5_S3 0 1 /end CHARACTERISTIC
/begin CHARACTERISTIC F_TRA21_EL "Zeitfaktor waehrend Rampe auf Schaltdruck" VALUE 0x1D7B10 ZF_kw_ui8_S5_S3 1 UMR___1_100_0_S5_S3 0 1 /end CHARACTERISTIC
/begin CHARACTERISTIC F_TRA23 "Zeitfaktor waehrend Rampe auf Schaltdruck" VALUE 0x1D7AA0 ZF_kw_ui8_S5_S3 1 UMR___1_100_0_S5_S3 0 1 /end CHARACTERISTIC
/begin CHARACTERISTIC F_TRA23_EL "Zeitfaktor waehrend Rampe auf Schaltdruck" VALUE 0x1D7AA1 ZF_kw_ui8_S5_S3 1 UMR___1_100_0_S5_S3 0 1 /end CHARACTERISTIC
/begin CHARACTERISTIC F_TRA34 "Zeitfaktor waehrend Rampe auf Schaltdruck" VALUE 0x1D7AA6 ZF_kw_ui8_S5_S3 1 UMR___1_100_0_S5_S3 0 1 /end CHARACTERISTIC
/begin CHARACTERISTIC F_TRA34_EL "Zeitfaktor waehrend Rampe auf Schaltdruck" VALUE 0x1D7AA7 ZF_kw_ui8_S5_S3 1 UMR___1_100_0_S5_S3 0 1 /end CHARACTERISTIC
/begin CHARACTERISTIC F_TRA45 "Zeitfaktor waehrend Rampe auf Schaltdruck" VALUE 0x1D7AAC ZF_kw_ui8_S5_S3 1 UMR___1_100_0_S5_S3 0 1 /end CHARACTERISTIC
/begin CHARACTERISTIC F_TRA45_EL "Zeitfaktor waehrend Rampe auf Schaltdruck" VALUE 0x1D7AAD ZF_kw_ui8_S5_S3 1 UMR___1_100_0_S5_S3 0 1 /end CHARACTERISTIC
/begin CHARACTERISTIC F_TRA56 "Zeitfaktor waehrend Rampe auf Schaltdruck" VALUE 0x1D7AB2 ZF_kw_ui8_S5_S3 1 UMR___1_100_0_S5_S3 0 1 /end CHARACTERISTIC
/begin CHARACTERISTIC F_TRA56_EL "Zeitfaktor waehrend Rampe auf Schaltdruck" VALUE 0x1D7AB3 ZF_kw_ui8_S5_S3 1 UMR___1_100_0_S5_S3 0 1 /end CHARACTERISTIC
/begin CHARACTERISTIC F_TRA67 "Zeitfaktor waehrend Rampe auf Schaltdruck" VALUE 0x1D7AB8 ZF_kw_ui8_S5_S3 1 UMR___1_100_0_S5_S3 0 1 /end CHARACTERISTIC
/begin CHARACTERISTIC F_TRA67_EL "Zeitfaktor waehrend Rampe auf Schaltdruck" VALUE 0x1D7AB9 ZF_kw_ui8_S5_S3 1 UMR___1_100_0_S5_S3 0 1 /end CHARACTERISTIC
/begin CHARACTERISTIC F_TRA78 "Zeitfaktor waehrend Rampe auf Schaltdruck" VALUE 0x1D7ABE ZF_kw_ui8_S5_S3 1 UMR___1_100_0_S5_S3 0 1 /end CHARACTERISTIC
/begin CHARACTERISTIC F_TRA78_EL "Zeitfaktor waehrend Rampe auf Schaltdruck" VALUE 0x1D7ABF ZF_kw_ui8_S5_S3 1 UMR___1_100_0_S5_S3 0 1 /end CHARACTERISTIC
/begin CHARACTERISTIC F_TRAFUELLOPT12 "Zeitfaktor waehrend Rampe auf Schaltdruck" VALUE 0x1D7AEE ZF_kw_ui8_S5_S3 1 UMR___1_100_0_S5_S3 0 1 /end CHARACTERISTIC
/begin CHARACTERISTIC F_TRAFUELLOPT23 "Zeitfaktor waehrend Rampe auf Schaltdruck" VALUE 0x1D7AF3 ZF_kw_ui8_S5_S3 1 UMR___1_100_0_S5_S3 0 1 /end CHARACTERISTIC
/begin CHARACTERISTIC F_TRAFUELLOPT34 "Zeitfaktor waehrend Rampe auf Schaltdruck" VALUE 0x1D7AF8 ZF_kw_ui8_S5_S3 1 UMR___1_100_0_S5_S3 0 1 /end CHARACTERISTIC
/begin CHARACTERISTIC F_TRAFUELLOPT45 "Zeitfaktor waehrend Rampe auf Schaltdruck" VALUE 0x1D7AFD ZF_kw_ui8_S5_S3 1 UMR___1_100_0_S5_S3 0 1 /end CHARACTERISTIC
/begin CHARACTERISTIC F_TRAFUELLOPT56 "Zeitfaktor waehrend Rampe auf Schaltdruck" VALUE 0x1D7B02 ZF_kw_ui8_S5_S3 1 UMR___1_100_0_S5_S3 0 1 /end CHARACTERISTIC
/begin CHARACTERISTIC F_TRAFUELLOPT67 "Zeitfaktor waehrend Rampe auf Schaltdruck" VALUE 0x1D7B07 ZF_kw_ui8_S5_S3 1 UMR___1_100_0_S5_S3 0 1 /end CHARACTERISTIC
/begin CHARACTERISTIC F_TRAFUELLOPT78 "Zeitfaktor waehrend Rampe auf Schaltdruck" VALUE 0x1D7B0C ZF_kw_ui8_S5_S3 1 UMR___1_100_0_S5_S3 0 1 /end CHARACTERISTIC
/begin CHARACTERISTIC F_TRASP12 "Zeitfaktor waehrend Rampe auf Schaltdruck" VALUE 0x1D7AC2 ZF_kw_ui8_S5_S3 1 UMR___1_100_0_S5_S3 0 1 /end CHARACTERISTIC
/begin CHARACTERISTIC F_TRASP23 "Zeitfaktor waehrend Rampe auf Schaltdruck" VALUE 0x1D7AC5 ZF_kw_ui8_S5_S3 1 UMR___1_100_0_S5_S3 0 1 /end CHARACTERISTIC
/begin CHARACTERISTIC F_TRASP34 "Zeitfaktor waehrend Rampe auf Schaltdruck" VALUE 0x1D7AC8 ZF_kw_ui8_S5_S3 1 UMR___1_100_0_S5_S3 0 1 /end CHARACTERISTIC
/begin CHARACTERISTIC F_TRASP45 "Zeitfaktor waehrend Rampe auf Schaltdruck" VALUE 0x1D7ACB ZF_kw_ui8_S5_S3 1 UMR___1_100_0_S5_S3 0 1 /end CHARACTERISTIC
/begin CHARACTERISTIC F_TRASP56 "Zeitfaktor waehrend Rampe auf Schaltdruck" VALUE 0x1D7ACE ZF_kw_ui8_S5_S3 1 UMR___1_100_0_S5_S3 0 1 /end CHARACTERISTIC
/begin CHARACTERISTIC F_TRASP67 "Zeitfaktor waehrend Rampe auf Schaltdruck" VALUE 0x1D7AD1 ZF_kw_ui8_S5_S3 1 UMR___1_100_0_S5_S3 0 1 /end CHARACTERISTIC
/begin CHARACTERISTIC F_TRASP78 "Zeitfaktor waehrend Rampe auf Schaltdruck" VALUE 0x1D7AD4 ZF_kw_ui8_S5_S3 1 UMR___1_100_0_S5_S3 0 1 /end CHARACTERISTIC
/begin CHARACTERISTIC F_TRASPORT12 "Zeitfaktor waehrend Rampe auf Schaltdruck" VALUE 0x1D7AD7 ZF_kw_ui8_S5_S3 1 UMR___1_100_0_S5_S3 0 1 /end CHARACTERISTIC
/begin CHARACTERISTIC F_TRASPORT23 "Zeitfaktor waehrend Rampe auf Schaltdruck" VALUE 0x1D7ADA ZF_kw_ui8_S5_S3 1 UMR___1_100_0_S5_S3 0 1 /end CHARACTERISTIC
/begin CHARACTERISTIC F_TRASPORT34 "Zeitfaktor waehrend Rampe auf Schaltdruck" VALUE 0x1D7ADD ZF_kw_ui8_S5_S3 1 UMR___1_100_0_S5_S3 0 1 /end CHARACTERISTIC
/begin CHARACTERISTIC F_TRASPORT45 "Zeitfaktor waehrend Rampe auf Schaltdruck" VALUE 0x1D7AE0 ZF_kw_ui8_S5_S3 1 UMR___1_100_0_S5_S3 0 1 /end CHARACTERISTIC
/begin CHARACTERISTIC F_TRASPORT56 "Zeitfaktor waehrend Rampe auf Schaltdruck" VALUE 0x1D7AE3 ZF_kw_ui8_S5_S3 1 UMR___1_100_0_S5_S3 0 1 /end CHARACTERISTIC
/begin CHARACTERISTIC F_TRASPORT67 "Zeitfaktor waehrend Rampe auf Schaltdruck" VALUE 0x1D7AE6 ZF_kw_ui8_S5_S3 1 UMR___1_100_0_S5_S3 0 1 /end CHARACTERISTIC
/begin CHARACTERISTIC F_TRASPORT78 "Zeitfaktor waehrend Rampe auf Schaltdruck" VALUE 0x1D7AE9 ZF_kw_ui8_S5_S3 1 UMR___1_100_0_S5_S3 0 1 /end CHARACTERISTIC
/begin CHARACTERISTIC F_TRA_7 "Zeitfaktor waehrend Rampe auf Schaltdruck" VALUE 0x1D7A8C ZF_kw_ui8_S5_S3 1 UMR___1_100_0_S5_S3 0 1 /end CHARACTERISTIC
/begin CHARACTERISTIC F_TRA_8 "Zeitfaktor waehrend Rampe auf Schaltdruck" VALUE 0x1D7A94 ZF_kw_ui8_S5_S3 1 UMR___1_100_0_S5_S3 0 1 /end CHARACTERISTIC
/begin CHARACTERISTIC F_TRA_R "Zeitfaktor waehrend Rampe auf Schaltdruck" VALUE 0x1D7A54 ZF_kw_ui8_S5_S3 1 UMR___1_100_0_S5_S3 0 1 /end CHARACTERISTIC
/begin CHARACTERISTIC KF_PKZU12 "Schaltdruck zuschaltende Kupplung" MAP 0x1C2290 ZF_kf_si16_S5_S3 12.75 UMR_BAR__1_1000_0_S5_S3 0 12.75
 /begin AXIS_DESCR STD_AXIS iSasZentr.iSchaltend.n_tkf UMR_U_MIN_32_1_0_S5_S3 8 0 8160 DEPOSIT ABSOLUTE /end AXIS_DESCR
 /begin AXIS_DESCR STD_AXIS zff_atsys._.iSignale._.obj.sig_m_t UMR_NM__1_1_0_S5_S3 10 -200 1300 DEPOSIT ABSOLUTE /end AXIS_DESCR
/end CHARACTERISTIC
/begin CHARACTERISTIC KF_PKZU12_EL "Schaltdruck zuschaltende Kupplung" MAP 0x1C235C ZF_kf_si16_S5_S3 12.75 UMR_BAR__1_1000_0_S5_S3 0 12.75
 /begin AXIS_DESCR STD_AXIS iSasZentr.iSchaltend.n_tkf UMR_U_MIN_32_1_0_S5_S3 8 0 8160 DEPOSIT ABSOLUTE /end AXIS_DESCR
 /begin AXIS_DESCR STD_AXIS zff_atsys._.iSignale._.obj.sig_m_t UMR_NM__1_1_0_S5_S3 10 -200 1300 DEPOSIT ABSOLUTE /end AXIS_DESCR
/end CHARACTERISTIC
/begin CHARACTERISTIC KF_PKZU21 "Schaltdruck zuschaltende Kupplung" MAP 0x1C6A18 ZF_kf_si16_S5_S3 12.75 UMR_BAR__1_1000_0_S5_S3 0 12.75
 /begin AXIS_DESCR STD_AXIS iSasZentr.iSchaltend.n_tkf UMR_U_MIN_32_1_0_S5_S3 8 0 8160 DEPOSIT ABSOLUTE /end AXIS_DESCR
 /begin AXIS_DESCR STD_AXIS zff_atsys._.iSignale._.obj.sig_m_t UMR_NM__1_1_0_S5_S3 8 -200 1300 DEPOSIT ABSOLUTE /end AXIS_DESCR
/end CHARACTERISTIC
/begin CHARACTERISTIC KF_PKZU21_EL "Schaltdruck zuschaltende Kupplung" MAP 0x1C6AC0 ZF_kf_si16_S5_S3 12.75 UMR_BAR__1_1000_0_S5_S3 0 12.75
 /begin AXIS_DESCR STD_AXIS iSasZentr.iSchaltend.n_tkf UMR_U_MIN_32_1_0_S5_S3 8 0 8160 DEPOSIT ABSOLUTE /end AXIS_DESCR
 /begin AXIS_DESCR STD_AXIS zff_atsys._.iSignale._.obj.sig_m_t UMR_NM__1_1_0_S5_S3 8 -200 1300 DEPOSIT ABSOLUTE /end AXIS_DESCR
/end CHARACTERISTIC
/begin CHARACTERISTIC KF_PKZU23 "Schaltdruck zuschaltende Kupplung" MAP 0x1C2660 ZF_kf_si16_S5_S3 12.75 UMR_BAR__1_1000_0_S5_S3 0 12.75
 /begin AXIS_DESCR STD_AXIS iSasZentr.iSchaltend.n_tkf UMR_U_MIN_32_1_0_S5_S3 8 0 8160 DEPOSIT ABSOLUTE /end AXIS_DESCR
 /begin AXIS_DESCR STD_AXIS zff_atsys._.iSignale._.obj.sig_m_t UMR_NM__1_1_0_S5_S3 10 -200 1300 DEPOSIT ABSOLUTE /end AXIS_DESCR
/end CHARACTERISTIC
/begin CHARACTERISTIC KF_PKZU23_EL "Schaltdruck zuschaltende Kupplung" MAP 0x1C272C ZF_kf_si16_S5_S3 12.75 UMR_BAR__1_1000_0_S5_S3 0 12.75
 /begin AXIS_DESCR STD_AXIS iSasZentr.iSchaltend.n_tkf UMR_U_MIN_32_1_0_S5_S3 8 0 8160 DEPOSIT ABSOLUTE /end AXIS_DESCR
 /begin AXIS_DESCR STD_AXIS zff_atsys._.iSignale._.obj.sig_m_t UMR_NM__1_1_0_S5_S3 10 -200 1300 DEPOSIT ABSOLUTE /end AXIS_DESCR
/end CHARACTERISTIC
/begin CHARACTERISTIC KF_PKZU34 "Schaltdruck zuschaltende Kupplung" MAP 0x1C2A30 ZF_kf_si16_S5_S3 12.75 UMR_BAR__1_1000_0_S5_S3 0 12.75
 /begin AXIS_DESCR STD_AXIS iSasZentr.iSchaltend.n_tkf UMR_U_MIN_32_1_0_S5_S3 8 0 8160 DEPOSIT ABSOLUTE /end AXIS_DESCR
 /begin AXIS_DESCR STD_AXIS zff_atsys._.iSignale._.obj.sig_m_t UMR_NM__1_1_0_S5_S3 10 -200 1300 DEPOSIT ABSOLUTE /end AXIS_DESCR
/end CHARACTERISTIC
/begin CHARACTERISTIC KF_PKZU34_EL "Schaltdruck zuschaltende Kupplung" MAP 0x1C2AFC ZF_kf_si16_S5_S3 12.75 UMR_BAR__1_1000_0_S5_S3 0 12.75
 /begin AXIS_DESCR STD_AXIS iSasZentr.iSchaltend.n_tkf UMR_U_MIN_32_1_0_S5_S3 8 0 8160 DEPOSIT ABSOLUTE /end AXIS_DESCR
 /begin AXIS_DESCR STD_AXIS zff_atsys._.iSignale._.obj.sig_m_t UMR_NM__1_1_0_S5_S3 10 -200 1300 DEPOSIT ABSOLUTE /end AXIS_DESCR
/end CHARACTERISTIC
/begin CHARACTERISTIC KF_PKZU45 "Schaltdruck zuschaltende Kupplung" MAP 0x1C2E00 ZF_kf_si16_S5_S3 12.75 UMR_BAR__1_1000_0_S5_S3 0 12.75
 /begin AXIS_DESCR STD_AXIS iSasZentr.iSchaltend.n_tkf UMR_U_MIN_32_1_0_S5_S3 8 0 8160 DEPOSIT ABSOLUTE /end AXIS_DESCR
 /begin AXIS_DESCR STD_AXIS zff_atsys._.iSignale._.obj.sig_m_t UMR_NM__1_1_0_S5_S3 10 -200 1300 DEPOSIT ABSOLUTE /end AXIS_DESCR
/end CHARACTERISTIC
/begin CHARACTERISTIC KF_PKZU45_EL "Schaltdruck zuschaltende Kupplung" MAP 0x1C2ECC ZF_kf_si16_S5_S3 12.75 UMR_BAR__1_1000_0_S5_S3 0 12.75
 /begin AXIS_DESCR STD_AXIS iSasZentr.iSchaltend.n_tkf UMR_U_MIN_32_1_0_S5_S3 8 0 8160 DEPOSIT ABSOLUTE /end AXIS_DESCR
 /begin AXIS_DESCR STD_AXIS zff_atsys._.iSignale._.obj.sig_m_t UMR_NM__1_1_0_S5_S3 10 -200 1300 DEPOSIT ABSOLUTE /end AXIS_DESCR
/end CHARACTERISTIC
/begin CHARACTERISTIC KF_PKZU56 "Schaltdruck zuschaltende Kupplung" MAP 0x1C31D0 ZF_kf_si16_S5_S3 12.75 UMR_BAR__1_1000_0_S5_S3 0 12.75
 /begin AXIS_DESCR STD_AXIS iSasZentr.iSchaltend.n_tkf UMR_U_MIN_32_1_0_S5_S3 8 0 8160 DEPOSIT ABSOLUTE /end AXIS_DESCR
 /begin AXIS_DESCR STD_AXIS zff_atsys._.iSignale._.obj.sig_m_t UMR_NM__1_1_0_S5_S3 10 -200 1300 DEPOSIT ABSOLUTE /end AXIS_DESCR
/end CHARACTERISTIC
/begin CHARACTERISTIC KF_PKZU56_EL "Schaltdruck zuschaltende Kupplung" MAP 0x1C329C ZF_kf_si16_S5_S3 12.75 UMR_BAR__1_1000_0_S5_S3 0 12.75
 /begin AXIS_DESCR STD_AXIS iSasZentr.iSchaltend.n_tkf UMR_U_MIN_32_1_0_S5_S3 8 0 8160 DEPOSIT ABSOLUTE /end AXIS_DESCR
 /begin AXIS_DESCR STD_AXIS zff_atsys._.iSignale._.obj.sig_m_t UMR_NM__1_1_0_S5_S3 10 -200 1300 DEPOSIT ABSOLUTE /end AXIS_DESCR
/end CHARACTERISTIC
/begin CHARACTERISTIC KF_PKZU67 "Schaltdruck zuschaltende Kupplung" MAP 0x1C35A0 ZF_kf_si16_S5_S3 12.75 UMR_BAR__1_1000_0_S5_S3 0 12.75
 /begin AXIS_DESCR STD_AXIS iSasZentr.iSchaltend.n_tkf UMR_U_MIN_32_1_0_S5_S3 8 0 8160 DEPOSIT ABSOLUTE /end AXIS_DESCR
 /begin AXIS_DESCR STD_AXIS zff_atsys._.iSignale._.obj.sig_m_t UMR_NM__1_1_0_S5_S3 10 -200 1300 DEPOSIT ABSOLUTE /end AXIS_DESCR
/end CHARACTERISTIC
/begin CHARACTERISTIC KF_PKZU67_EL "Schaltdruck zuschaltende Kupplung" MAP 0x1C366C ZF_kf_si16_S5_S3 12.75 UMR_BAR__1_1000_0_S5_S3 0 12.75
 /begin AXIS_DESCR STD_AXIS iSasZentr.iSchaltend.n_tkf UMR_U_MIN_32_1_0_S5_S3 8 0 8160 DEPOSIT ABSOLUTE /end AXIS_DESCR
 /begin AXIS_DESCR STD_AXIS zff_atsys._.iSignale._.obj.sig_m_t UMR_NM__1_1_0_S5_S3 10 -200 1300 DEPOSIT ABSOLUTE /end AXIS_DESCR
/end CHARACTERISTIC
/begin CHARACTERISTIC KF_PKZU78 "Schaltdruck zuschaltende Kupplung" MAP 0x1C3970 ZF_kf_si16_S5_S3 12.75 UMR_BAR__1_1000_0_S5_S3 0 12.75
 /begin AXIS_DESCR STD_AXIS iSasZentr.iSchaltend.n_tkf UMR_U_MIN_32_1_0_S5_S3 8 0 8160 DEPOSIT ABSOLUTE /end AXIS_DESCR
 /begin AXIS_DESCR STD_AXIS zff_atsys._.iSignale._.obj.sig_m_t UMR_NM__1_1_0_S5_S3 10 -200 1300 DEPOSIT ABSOLUTE /end AXIS_DESCR
/end CHARACTERISTIC
/begin CHARACTERISTIC KF_PKZU78_EL "Schaltdruck zuschaltende Kupplung" MAP 0x1C3A3C ZF_kf_si16_S5_S3 12.75 UMR_BAR__1_1000_0_S5_S3 0 12.75
 /begin AXIS_DESCR STD_AXIS iSasZentr.iSchaltend.n_tkf UMR_U_MIN_32_1_0_S5_S3 8 0 8160 DEPOSIT ABSOLUTE /end AXIS_DESCR
 /begin AXIS_DESCR STD_AXIS zff_atsys._.iSignale._.obj.sig_m_t UMR_NM__1_1_0_S5_S3 10 -200 1300 DEPOSIT ABSOLUTE /end AXIS_DESCR
/end CHARACTERISTIC
/begin CHARACTERISTIC KF_PKZUSP12 "Schaltdruck zuschaltende Kupplung" MAP 0x1C3C94 ZF_kf_si16_S5_S3 12.75 UMR_BAR__1_1000_0_S5_S3 0 12.75
 /begin AXIS_DESCR STD_AXIS iSasZentr.iSchaltend.n_tkf UMR_U_MIN_32_1_0_S5_S3 8 0 8160 DEPOSIT ABSOLUTE /end AXIS_DESCR
 /begin AXIS_DESCR STD_AXIS zff_atsys._.iSignale._.obj.sig_m_t UMR_NM__1_1_0_S5_S3 10 -200 1300 DEPOSIT ABSOLUTE /end AXIS_DESCR
/end CHARACTERISTIC
/begin CHARACTERISTIC KF_PKZUSP23 "Schaltdruck zuschaltende Kupplung" MAP 0x1C3EEC ZF_kf_si16_S5_S3 12.75 UMR_BAR__1_1000_0_S5_S3 0 12.75
 /begin AXIS_DESCR STD_AXIS iSasZentr.iSchaltend.n_tkf UMR_U_MIN_32_1_0_S5_S3 8 0 8160 DEPOSIT ABSOLUTE /end AXIS_DESCR
 /begin AXIS_DESCR STD_AXIS zff_atsys._.iSignale._.obj.sig_m_t UMR_NM__1_1_0_S5_S3 10 -200 1300 DEPOSIT ABSOLUTE /end AXIS_DESCR
/end CHARACTERISTIC
/begin CHARACTERISTIC KF_PKZUSP34 "Schaltdruck zuschaltende Kupplung" MAP 0x1C4144 ZF_kf_si16_S5_S3 12.75 UMR_BAR__1_1000_0_S5_S3 0 12.75
 /begin AXIS_DESCR STD_AXIS iSasZentr.iSchaltend.n_tkf UMR_U_MIN_32_1_0_S5_S3 8 0 8160 DEPOSIT ABSOLUTE /end AXIS_DESCR
 /begin AXIS_DESCR STD_AXIS zff_atsys._.iSignale._.obj.sig_m_t UMR_NM__1_1_0_S5_S3 10 -200 1300 DEPOSIT ABSOLUTE /end AXIS_DESCR
/end CHARACTERISTIC
/begin CHARACTERISTIC KF_PKZUSP45 "Schaltdruck zuschaltende Kupplung" MAP 0x1C439C ZF_kf_si16_S5_S3 12.75 UMR_BAR__1_1000_0_S5_S3 0 12.75
 /begin AXIS_DESCR STD_AXIS iSasZentr.iSchaltend.n_tkf UMR_U_MIN_32_1_0_S5_S3 8 0 8160 DEPOSIT ABSOLUTE /end AXIS_DESCR
 /begin AXIS_DESCR STD_AXIS zff_atsys._.iSignale._.obj.sig_m_t UMR_NM__1_1_0_S5_S3 10 -200 1300 DEPOSIT ABSOLUTE /end AXIS_DESCR
/end CHARACTERISTIC
/begin CHARACTERISTIC KF_PKZUSP56 "Schaltdruck zuschaltende Kupplung" MAP 0x1C45F4 ZF_kf_si16_S5_S3 12.75 UMR_BAR__1_1000_0_S5_S3 0 12.75
 /begin AXIS_DESCR STD_AXIS iSasZentr.iSchaltend.n_tkf UMR_U_MIN_32_1_0_S5_S3 8 0 8160 DEPOSIT ABSOLUTE /end AXIS_DESCR
 /begin AXIS_DESCR STD_AXIS zff_atsys._.iSignale._.obj.sig_m_t UMR_NM__1_1_0_S5_S3 10 -200 1300 DEPOSIT ABSOLUTE /end AXIS_DESCR
/end CHARACTERISTIC
/begin CHARACTERISTIC KF_PKZUSP67 "Schaltdruck zuschaltende Kupplung" MAP 0x1C484C ZF_kf_si16_S5_S3 12.75 UMR_BAR__1_1000_0_S5_S3 0 12.75
 /begin AXIS_DESCR STD_AXIS iSasZentr.iSchaltend.n_tkf UMR_U_MIN_32_1_0_S5_S3 8 0 8160 DEPOSIT ABSOLUTE /end AXIS_DESCR
 /begin AXIS_DESCR STD_AXIS zff_atsys._.iSignale._.obj.sig_m_t UMR_NM__1_1_0_S5_S3 10 -200 1300 DEPOSIT ABSOLUTE /end AXIS_DESCR
/end CHARACTERISTIC
/begin CHARACTERISTIC KF_PKZUSP78 "Schaltdruck zuschaltende Kupplung" MAP 0x1C4AA4 ZF_kf_si16_S5_S3 12.75 UMR_BAR__1_1000_0_S5_S3 0 12.75
 /begin AXIS_DESCR STD_AXIS iSasZentr.iSchaltend.n_tkf UMR_U_MIN_32_1_0_S5_S3 8 0 8160 DEPOSIT ABSOLUTE /end AXIS_DESCR
 /begin AXIS_DESCR STD_AXIS zff_atsys._.iSignale._.obj.sig_m_t UMR_NM__1_1_0_S5_S3 10 -200 1300 DEPOSIT ABSOLUTE /end AXIS_DESCR
/end CHARACTERISTIC
/begin CHARACTERISTIC KF_PKZUSPORT12 "Schaltdruck zuschaltende Kupplung" MAP 0x1C4CFC ZF_kf_si16_S5_S3 12.75 UMR_BAR__1_1000_0_S5_S3 0 12.75
 /begin AXIS_DESCR STD_AXIS iSasZentr.iSchaltend.n_tkf UMR_U_MIN_32_1_0_S5_S3 8 0 8160 DEPOSIT ABSOLUTE /end AXIS_DESCR
 /begin AXIS_DESCR STD_AXIS zff_atsys._.iSignale._.obj.sig_m_t UMR_NM__1_1_0_S5_S3 10 -200 1300 DEPOSIT ABSOLUTE /end AXIS_DESCR
/end CHARACTERISTIC
/begin CHARACTERISTIC KF_PKZUSPORT23 "Schaltdruck zuschaltende Kupplung" MAP 0x1C4F54 ZF_kf_si16_S5_S3 12.75 UMR_BAR__1_1000_0_S5_S3 0 12.75
 /begin AXIS_DESCR STD_AXIS iSasZentr.iSchaltend.n_tkf UMR_U_MIN_32_1_0_S5_S3 8 0 8160 DEPOSIT ABSOLUTE /end AXIS_DESCR
 /begin AXIS_DESCR STD_AXIS zff_atsys._.iSignale._.obj.sig_m_t UMR_NM__1_1_0_S5_S3 10 -200 1300 DEPOSIT ABSOLUTE /end AXIS_DESCR
/end CHARACTERISTIC
/begin CHARACTERISTIC KF_PKZUSPORT34 "Schaltdruck zuschaltende Kupplung" MAP 0x1C51AC ZF_kf_si16_S5_S3 12.75 UMR_BAR__1_1000_0_S5_S3 0 12.75
 /begin AXIS_DESCR STD_AXIS iSasZentr.iSchaltend.n_tkf UMR_U_MIN_32_1_0_S5_S3 8 0 8160 DEPOSIT ABSOLUTE /end AXIS_DESCR
 /begin AXIS_DESCR STD_AXIS zff_atsys._.iSignale._.obj.sig_m_t UMR_NM__1_1_0_S5_S3 10 -200 1300 DEPOSIT ABSOLUTE /end AXIS_DESCR
/end CHARACTERISTIC
/begin CHARACTERISTIC KF_PKZUSPORT45 "Schaltdruck zuschaltende Kupplung" MAP 0x1C5404 ZF_kf_si16_S5_S3 12.75 UMR_BAR__1_1000_0_S5_S3 0 12.75
 /begin AXIS_DESCR STD_AXIS iSasZentr.iSchaltend.n_tkf UMR_U_MIN_32_1_0_S5_S3 8 0 8160 DEPOSIT ABSOLUTE /end AXIS_DESCR
 /begin AXIS_DESCR STD_AXIS zff_atsys._.iSignale._.obj.sig_m_t UMR_NM__1_1_0_S5_S3 10 -200 1300 DEPOSIT ABSOLUTE /end AXIS_DESCR
/end CHARACTERISTIC
/begin CHARACTERISTIC KF_PKZUSPORT56 "Schaltdruck zuschaltende Kupplung" MAP 0x1C565C ZF_kf_si16_S5_S3 12.75 UMR_BAR__1_1000_0_S5_S3 0 12.75
 /begin AXIS_DESCR STD_AXIS iSasZentr.iSchaltend.n_tkf UMR_U_MIN_32_1_0_S5_S3 8 0 8160 DEPOSIT ABSOLUTE /end AXIS_DESCR
 /begin AXIS_DESCR STD_AXIS zff_atsys._.iSignale._.obj.sig_m_t UMR_NM__1_1_0_S5_S3 10 -200 1300 DEPOSIT ABSOLUTE /end AXIS_DESCR
/end CHARACTERISTIC
/begin CHARACTERISTIC KF_PKZUSPORT67 "Schaltdruck zuschaltende Kupplung" MAP 0x1C58B4 ZF_kf_si16_S5_S3 12.75 UMR_BAR__1_1000_0_S5_S3 0 12.75
 /begin AXIS_DESCR STD_AXIS iSasZentr.iSchaltend.n_tkf UMR_U_MIN_32_1_0_S5_S3 8 0 8160 DEPOSIT ABSOLUTE /end AXIS_DESCR
 /begin AXIS_DESCR STD_AXIS zff_atsys._.iSignale._.obj.sig_m_t UMR_NM__1_1_0_S5_S3 10 -200 1300 DEPOSIT ABSOLUTE /end AXIS_DESCR
/end CHARACTERISTIC
/begin CHARACTERISTIC KF_PKZUSPORT78 "Schaltdruck zuschaltende Kupplung" MAP 0x1C5B0C ZF_kf_si16_S5_S3 12.75 UMR_BAR__1_1000_0_S5_S3 0 12.75
 /begin AXIS_DESCR STD_AXIS iSasZentr.iSchaltend.n_tkf UMR_U_MIN_32_1_0_S5_S3 8 0 8160 DEPOSIT ABSOLUTE /end AXIS_DESCR
 /begin AXIS_DESCR STD_AXIS zff_atsys._.iSignale._.obj.sig_m_t UMR_NM__1_1_0_S5_S3 10 -200 1300 DEPOSIT ABSOLUTE /end AXIS_DESCR
/end CHARACTERISTIC
/begin CHARACTERISTIC KF_PKZU_7 "Schaltdruck zuschaltende Kupplung" MAP 0x1C19E4 ZF_kf_si16_S5_S3 12.75 UMR_BAR__1_1000_0_S5_S3 0 12.75
 /begin AXIS_DESCR STD_AXIS iSasZentr.iSchaltend.n_tkf UMR_U_MIN_32_1_0_S5_S3 8 0 8160 DEPOSIT ABSOLUTE /end AXIS_DESCR
 /begin AXIS_DESCR STD_AXIS zff_atsys._.iSignale._.obj.sig_m_t UMR_NM__1_1_0_S5_S3 10 -200 1300 DEPOSIT ABSOLUTE /end AXIS_DESCR
/end CHARACTERISTIC
/begin CHARACTERISTIC KF_PKZU_8 "Schaltdruck zuschaltende Kupplung" MAP 0x1C1F14 ZF_kf_si16_S5_S3 12.75 UMR_BAR__1_1000_0_S5_S3 0 12.75
 /begin AXIS_DESCR STD_AXIS iSasZentr.iSchaltend.n_tkf UMR_U_MIN_32_1_0_S5_S3 8 0 8160 DEPOSIT ABSOLUTE /end AXIS_DESCR
 /begin AXIS_DESCR STD_AXIS zff_atsys._.iSignale._.obj.sig_m_t UMR_NM__1_1_0_S5_S3 10 -200 1300 DEPOSIT ABSOLUTE /end AXIS_DESCR
/end CHARACTERISTIC
/begin CHARACTERISTIC KF_PKZU_R "Schaltdruck zuschaltende Kupplung" MAP 0x1BF594 ZF_kf_si16_S5_S3 12.75 UMR_BAR__1_1000_0_S5_S3 0 12.75
 /begin AXIS_DESCR STD_AXIS iSasZentr.iSchaltend.n_tkf UMR_U_MIN_32_1_0_S5_S3 8 0 8160 DEPOSIT ABSOLUTE /end AXIS_DESCR
 /begin AXIS_DESCR STD_AXIS zff_atsys._.iSignale._.obj.sig_m_t UMR_NM__1_1_0_S5_S3 10 -200 1300 DEPOSIT ABSOLUTE /end AXIS_DESCR
/end CHARACTERISTIC
/begin CHARACTERISTIC KF_PODKIMOTSOLLNMOTGE_7 "Druckoffset Fuell- und Schaltdruck" MAP 0x1C16AC ZF_kf_si16_S5_S3 22 UMR_BAR__1_1000_0_S5_S3 0 22
 /begin AXIS_DESCR STD_AXIS zff_atsys._.iSignale._.obj.sig_dki_mmotsoll UMR___1_1_0_S5_S3 5 -400 1640 DEPOSIT ABSOLUTE /end AXIS_DESCR
 /begin AXIS_DESCR STD_AXIS zff_atsys._.iSignale._.obj.sig_n_mot UMR_U_MIN_1_1_0_S5_S3 5 0 8160 DEPOSIT ABSOLUTE /end AXIS_DESCR
/end CHARACTERISTIC
/begin CHARACTERISTIC KF_PODKIMOTSOLLNMOTGE_8 "Druckoffset Fuell- und Schaltdruck" MAP 0x1C1BDC ZF_kf_si16_S5_S3 22 UMR_BAR__1_1000_0_S5_S3 0 22
 /begin AXIS_DESCR STD_AXIS zff_atsys._.iSignale._.obj.sig_dki_mmotsoll UMR___1_1_0_S5_S3 5 -400 1640 DEPOSIT ABSOLUTE /end AXIS_DESCR
 /begin AXIS_DESCR STD_AXIS zff_atsys._.iSignale._.obj.sig_n_mot UMR_U_MIN_1_1_0_S5_S3 5 0 8160 DEPOSIT ABSOLUTE /end AXIS_DESCR
/end CHARACTERISTIC
/begin CHARACTERISTIC KF_PODKIMOTSOLLNMOTGE_ECO_7 "Druckoffset Fuell- und Schaltdruck bei ECO-Mode" MAP 0x1C16FC ZF_kf_si16_S5_S3 22 UMR_BAR__1_1000_0_S5_S3 0 22
 /begin AXIS_DESCR STD_AXIS zff_atsys._.iSignale._.obj.sig_dki_mmotsoll UMR___1_1_0_S5_S3 5 -400 1640 DEPOSIT ABSOLUTE /end AXIS_DESCR
 /begin AXIS_DESCR STD_AXIS zff_atsys._.iSignale._.obj.sig_n_mot UMR_U_MIN_1_1_0_S5_S3 5 0 8160 DEPOSIT ABSOLUTE /end AXIS_DESCR
/end CHARACTERISTIC
/begin CHARACTERISTIC KF_PODKIMOTSOLLNMOTGE_ECO_8 "Druckoffset Fuell- und Schaltdruck bei ECO-Mode" MAP 0x1C1C2C ZF_kf_si16_S5_S3 22 UMR_BAR__1_1000_0_S5_S3 0 22
 /begin AXIS_DESCR STD_AXIS zff_atsys._.iSignale._.obj.sig_dki_mmotsoll UMR___1_1_0_S5_S3 5 -400 1640 DEPOSIT ABSOLUTE /end AXIS_DESCR
 /begin AXIS_DESCR STD_AXIS zff_atsys._.iSignale._.obj.sig_n_mot UMR_U_MIN_1_1_0_S5_S3 5 0 8160 DEPOSIT ABSOLUTE /end AXIS_DESCR
/end CHARACTERISTIC
/begin CHARACTERISTIC KF_PODKIMOTSOLLNMOTGE_ECO_R "Druckoffset Fuell- und Schaltdruck bei ECO-Mode" MAP 0x1BF2AC ZF_kf_si16_S5_S3 22 UMR_BAR__1_1000_0_S5_S3 0 22
 /begin AXIS_DESCR STD_AXIS zff_atsys._.iSignale._.obj.sig_dki_mmotsoll UMR___1_1_0_S5_S3 5 -400 1640 DEPOSIT ABSOLUTE /end AXIS_DESCR
 /begin AXIS_DESCR STD_AXIS zff_atsys._.iSignale._.obj.sig_n_mot UMR_U_MIN_1_1_0_S5_S3 5 0 8160 DEPOSIT ABSOLUTE /end AXIS_DESCR
/end CHARACTERISTIC
/begin CHARACTERISTIC KF_PODKIMOTSOLLNMOTGE_R "Druckoffset Fuell- und Schaltdruck" MAP 0x1BF25C ZF_kf_si16_S5_S3 22 UMR_BAR__1_1000_0_S5_S3 0 22
 /begin AXIS_DESCR STD_AXIS zff_atsys._.iSignale._.obj.sig_dki_mmotsoll UMR___1_1_0_S5_S3 5 -400 1640 DEPOSIT ABSOLUTE /end AXIS_DESCR
 /begin AXIS_DESCR STD_AXIS zff_atsys._.iSignale._.obj.sig_n_mot UMR_U_MIN_1_1_0_S5_S3 5 0 8160 DEPOSIT ABSOLUTE /end AXIS_DESCR
/end CHARACTERISTIC
/begin CHARACTERISTIC KF_POFMTN12 "Kennfeld Fuelldruckoffset(n_t, m_t)" MAP 0x1C2180 ZF_kf_si16_S5_S3 12.75 UMR_BAR__1_1000_0_S5_S3 -6.4 6.35
 /begin AXIS_DESCR STD_AXIS zff_atsys._.iSignale._.obj.sig_n_t UMR_U_MIN_1_1_0_S5_S3 4 0 8160 DEPOSIT ABSOLUTE /end AXIS_DESCR
 /begin AXIS_DESCR STD_AXIS zff_atsys._.iSignale._.obj.sig_m_t UMR_NM__1_1_0_S5_S3 6 -200 1300 DEPOSIT ABSOLUTE /end AXIS_DESCR
/end CHARACTERISTIC
/begin CHARACTERISTIC KF_POFMTN12_EL "Kennfeld Fuelldruckoffset(n_t, m_t)" MAP 0x1C21CC ZF_kf_si16_S5_S3 12.75 UMR_BAR__1_1000_0_S5_S3 -6.4 6.35
 /begin AXIS_DESCR STD_AXIS zff_atsys._.iSignale._.obj.sig_n_t UMR_U_MIN_1_1_0_S5_S3 4 0 8160 DEPOSIT ABSOLUTE /end AXIS_DESCR
 /begin AXIS_DESCR STD_AXIS zff_atsys._.iSignale._.obj.sig_m_t UMR_NM__1_1_0_S5_S3 6 -200 1300 DEPOSIT ABSOLUTE /end AXIS_DESCR
/end CHARACTERISTIC
/begin CHARACTERISTIC KF_POFMTN21 "Kennfeld Fuelldruckoffset(n_t, m_t)" MAP 0x1C6980 ZF_kf_si16_S5_S3 12.75 UMR_BAR__1_1000_0_S5_S3 -6.4 6.35
 /begin AXIS_DESCR STD_AXIS zff_atsys._.iSignale._.obj.sig_n_t UMR_U_MIN_1_1_0_S5_S3 4 0 8160 DEPOSIT ABSOLUTE /end AXIS_DESCR
 /begin AXIS_DESCR STD_AXIS zff_atsys._.iSignale._.obj.sig_m_t UMR_NM__1_1_0_S5_S3 6 -200 1300 DEPOSIT ABSOLUTE /end AXIS_DESCR
/end CHARACTERISTIC
/begin CHARACTERISTIC KF_POFMTN21_EL "Kennfeld Fuelldruckoffset(n_t, m_t)" MAP 0x1C69CC ZF_kf_si16_S5_S3 12.75 UMR_BAR__1_1000_0_S5_S3 -6.4 6.35
 /begin AXIS_DESCR STD_AXIS zff_atsys._.iSignale._.obj.sig_n_t UMR_U_MIN_1_1_0_S5_S3 4 0 8160 DEPOSIT ABSOLUTE /end AXIS_DESCR
 /begin AXIS_DESCR STD_AXIS zff_atsys._.iSignale._.obj.sig_m_t UMR_NM__1_1_0_S5_S3 6 -200 1300 DEPOSIT ABSOLUTE /end AXIS_DESCR
/end CHARACTERISTIC
/begin CHARACTERISTIC KF_POFMTN23 "Kennfeld Fuelldruckoffset(n_t, m_t)" MAP 0x1C2550 ZF_kf_si16_S5_S3 12.75 UMR_BAR__1_1000_0_S5_S3 -6.4 6.35
 /begin AXIS_DESCR STD_AXIS zff_atsys._.iSignale._.obj.sig_n_t UMR_U_MIN_1_1_0_S5_S3 4 0 8160 DEPOSIT ABSOLUTE /end AXIS_DESCR
 /begin AXIS_DESCR STD_AXIS zff_atsys._.iSignale._.obj.sig_m_t UMR_NM__1_1_0_S5_S3 6 -200 1300 DEPOSIT ABSOLUTE /end AXIS_DESCR
/end CHARACTERISTIC
/begin CHARACTERISTIC KF_POFMTN23_EL "Kennfeld Fuelldruckoffset(n_t, m_t)" MAP 0x1C259C ZF_kf_si16_S5_S3 12.75 UMR_BAR__1_1000_0_S5_S3 -6.4 6.35
 /begin AXIS_DESCR STD_AXIS zff_atsys._.iSignale._.obj.sig_n_t UMR_U_MIN_1_1_0_S5_S3 4 0 8160 DEPOSIT ABSOLUTE /end AXIS_DESCR
 /begin AXIS_DESCR STD_AXIS zff_atsys._.iSignale._.obj.sig_m_t UMR_NM__1_1_0_S5_S3 6 -200 1300 DEPOSIT ABSOLUTE /end AXIS_DESCR
/end CHARACTERISTIC
/begin CHARACTERISTIC KF_POFMTN34 "Kennfeld Fuelldruckoffset(n_t, m_t)" MAP 0x1C2920 ZF_kf_si16_S5_S3 12.75 UMR_BAR__1_1000_0_S5_S3 -6.4 6.35
 /begin AXIS_DESCR STD_AXIS zff_atsys._.iSignale._.obj.sig_n_t UMR_U_MIN_1_1_0_S5_S3 4 0 8160 DEPOSIT ABSOLUTE /end AXIS_DESCR
 /begin AXIS_DESCR STD_AXIS zff_atsys._.iSignale._.obj.sig_m_t UMR_NM__1_1_0_S5_S3 6 -200 1300 DEPOSIT ABSOLUTE /end AXIS_DESCR
/end CHARACTERISTIC
/begin CHARACTERISTIC KF_POFMTN34_EL "Kennfeld Fuelldruckoffset(n_t, m_t)" MAP 0x1C296C ZF_kf_si16_S5_S3 12.75 UMR_BAR__1_1000_0_S5_S3 -6.4 6.35
 /begin AXIS_DESCR STD_AXIS zff_atsys._.iSignale._.obj.sig_n_t UMR_U_MIN_1_1_0_S5_S3 4 0 8160 DEPOSIT ABSOLUTE /end AXIS_DESCR
 /begin AXIS_DESCR STD_AXIS zff_atsys._.iSignale._.obj.sig_m_t UMR_NM__1_1_0_S5_S3 6 -200 1300 DEPOSIT ABSOLUTE /end AXIS_DESCR
/end CHARACTERISTIC
/begin CHARACTERISTIC KF_POFMTN45 "Kennfeld Fuelldruckoffset(n_t, m_t)" MAP 0x1C2CF0 ZF_kf_si16_S5_S3 12.75 UMR_BAR__1_1000_0_S5_S3 -6.4 6.35
 /begin AXIS_DESCR STD_AXIS zff_atsys._.iSignale._.obj.sig_n_t UMR_U_MIN_1_1_0_S5_S3 4 0 8160 DEPOSIT ABSOLUTE /end AXIS_DESCR
 /begin AXIS_DESCR STD_AXIS zff_atsys._.iSignale._.obj.sig_m_t UMR_NM__1_1_0_S5_S3 6 -200 1300 DEPOSIT ABSOLUTE /end AXIS_DESCR
/end CHARACTERISTIC
/begin CHARACTERISTIC KF_POFMTN45_EL "Kennfeld Fuelldruckoffset(n_t, m_t)" MAP 0x1C2D3C ZF_kf_si16_S5_S3 12.75 UMR_BAR__1_1000_0_S5_S3 -6.4 6.35
 /begin AXIS_DESCR STD_AXIS zff_atsys._.iSignale._.obj.sig_n_t UMR_U_MIN_1_1_0_S5_S3 4 0 8160 DEPOSIT ABSOLUTE /end AXIS_DESCR
 /begin AXIS_DESCR STD_AXIS zff_atsys._.iSignale._.obj.sig_m_t UMR_NM__1_1_0_S5_S3 6 -200 1300 DEPOSIT ABSOLUTE /end AXIS_DESCR
/end CHARACTERISTIC
/begin CHARACTERISTIC KF_POFMTN56 "Kennfeld Fuelldruckoffset(n_t, m_t)" MAP 0x1C30C0 ZF_kf_si16_S5_S3 12.75 UMR_BAR__1_1000_0_S5_S3 -6.4 6.35
 /begin AXIS_DESCR STD_AXIS zff_atsys._.iSignale._.obj.sig_n_t UMR_U_MIN_1_1_0_S5_S3 4 0 8160 DEPOSIT ABSOLUTE /end AXIS_DESCR
 /begin AXIS_DESCR STD_AXIS zff_atsys._.iSignale._.obj.sig_m_t UMR_NM__1_1_0_S5_S3 6 -200 1300 DEPOSIT ABSOLUTE /end AXIS_DESCR
/end CHARACTERISTIC
/begin CHARACTERISTIC KF_POFMTN56_EL "Kennfeld Fuelldruckoffset(n_t, m_t)" MAP 0x1C310C ZF_kf_si16_S5_S3 12.75 UMR_BAR__1_1000_0_S5_S3 -6.4 6.35
 /begin AXIS_DESCR STD_AXIS zff_atsys._.iSignale._.obj.sig_n_t UMR_U_MIN_1_1_0_S5_S3 4 0 8160 DEPOSIT ABSOLUTE /end AXIS_DESCR
 /begin AXIS_DESCR STD_AXIS zff_atsys._.iSignale._.obj.sig_m_t UMR_NM__1_1_0_S5_S3 6 -200 1300 DEPOSIT ABSOLUTE /end AXIS_DESCR
/end CHARACTERISTIC
/begin CHARACTERISTIC KF_POFMTN67 "Kennfeld Fuelldruckoffset(n_t, m_t)" MAP 0x1C3490 ZF_kf_si16_S5_S3 12.75 UMR_BAR__1_1000_0_S5_S3 -6.4 6.35
 /begin AXIS_DESCR STD_AXIS zff_atsys._.iSignale._.obj.sig_n_t UMR_U_MIN_1_1_0_S5_S3 4 0 8160 DEPOSIT ABSOLUTE /end AXIS_DESCR
 /begin AXIS_DESCR STD_AXIS zff_atsys._.iSignale._.obj.sig_m_t UMR_NM__1_1_0_S5_S3 6 -200 1300 DEPOSIT ABSOLUTE /end AXIS_DESCR
/end CHARACTERISTIC
/begin CHARACTERISTIC KF_POFMTN67_EL "Kennfeld Fuelldruckoffset(n_t, m_t)" MAP 0x1C34DC ZF_kf_si16_S5_S3 12.75 UMR_BAR__1_1000_0_S5_S3 -6.4 6.35
 /begin AXIS_DESCR STD_AXIS zff_atsys._.iSignale._.obj.sig_n_t UMR_U_MIN_1_1_0_S5_S3 4 0 8160 DEPOSIT ABSOLUTE /end AXIS_DESCR
 /begin AXIS_DESCR STD_AXIS zff_atsys._.iSignale._.obj.sig_m_t UMR_NM__1_1_0_S5_S3 6 -200 1300 DEPOSIT ABSOLUTE /end AXIS_DESCR
/end CHARACTERISTIC
/begin CHARACTERISTIC KF_POFMTN78 "Kennfeld Fuelldruckoffset(n_t, m_t)" MAP 0x1C3860 ZF_kf_si16_S5_S3 12.75 UMR_BAR__1_1000_0_S5_S3 -6.4 6.35
 /begin AXIS_DESCR STD_AXIS zff_atsys._.iSignale._.obj.sig_n_t UMR_U_MIN_1_1_0_S5_S3 4 0 8160 DEPOSIT ABSOLUTE /end AXIS_DESCR
 /begin AXIS_DESCR STD_AXIS zff_atsys._.iSignale._.obj.sig_m_t UMR_NM__1_1_0_S5_S3 6 -200 1300 DEPOSIT ABSOLUTE /end AXIS_DESCR
/end CHARACTERISTIC
/begin CHARACTERISTIC KF_POFMTN78_EL "Kennfeld Fuelldruckoffset(n_t, m_t)" MAP 0x1C38AC ZF_kf_si16_S5_S3 12.75 UMR_BAR__1_1000_0_S5_S3 -6.4 6.35
 /begin AXIS_DESCR STD_AXIS zff_atsys._.iSignale._.obj.sig_n_t UMR_U_MIN_1_1_0_S5_S3 4 0 8160 DEPOSIT ABSOLUTE /end AXIS_DESCR
 /begin AXIS_DESCR STD_AXIS zff_atsys._.iSignale._.obj.sig_m_t UMR_NM__1_1_0_S5_S3 6 -200 1300 DEPOSIT ABSOLUTE /end AXIS_DESCR
/end CHARACTERISTIC
/begin CHARACTERISTIC KF_POFMTNFUELLOPT12 "Kennfeld Fuelldruckoffset(n_t, m_t)" MAP 0x1C5D64 ZF_kf_si16_S5_S3 12.75 UMR_BAR__1_1000_0_S5_S3 -6.4 6.35
 /begin AXIS_DESCR STD_AXIS zff_atsys._.iSignale._.obj.sig_n_t UMR_U_MIN_1_1_0_S5_S3 4 0 8160 DEPOSIT ABSOLUTE /end AXIS_DESCR
 /begin AXIS_DESCR STD_AXIS zff_atsys._.iSignale._.obj.sig_m_t UMR_NM__1_1_0_S5_S3 6 -200 1300 DEPOSIT ABSOLUTE /end AXIS_DESCR
/end CHARACTERISTIC
/begin CHARACTERISTIC KF_POFMTNFUELLOPT23 "Kennfeld Fuelldruckoffset(n_t, m_t)" MAP 0x1C5F3C ZF_kf_si16_S5_S3 12.75 UMR_BAR__1_1000_0_S5_S3 -6.4 6.35
 /begin AXIS_DESCR STD_AXIS zff_atsys._.iSignale._.obj.sig_n_t UMR_U_MIN_1_1_0_S5_S3 4 0 8160 DEPOSIT ABSOLUTE /end AXIS_DESCR
 /begin AXIS_DESCR STD_AXIS zff_atsys._.iSignale._.obj.sig_m_t UMR_NM__1_1_0_S5_S3 6 -200 1300 DEPOSIT ABSOLUTE /end AXIS_DESCR
/end CHARACTERISTIC
/begin CHARACTERISTIC KF_POFMTNFUELLOPT34 "Kennfeld Fuelldruckoffset(n_t, m_t)" MAP 0x1C6114 ZF_kf_si16_S5_S3 12.75 UMR_BAR__1_1000_0_S5_S3 -6.4 6.35
 /begin AXIS_DESCR STD_AXIS zff_atsys._.iSignale._.obj.sig_n_t UMR_U_MIN_1_1_0_S5_S3 4 0 8160 DEPOSIT ABSOLUTE /end AXIS_DESCR
 /begin AXIS_DESCR STD_AXIS zff_atsys._.iSignale._.obj.sig_m_t UMR_NM__1_1_0_S5_S3 6 -200 1300 DEPOSIT ABSOLUTE /end AXIS_DESCR
/end CHARACTERISTIC
/begin CHARACTERISTIC KF_POFMTNFUELLOPT45 "Kennfeld Fuelldruckoffset(n_t, m_t)" MAP 0x1C62EC ZF_kf_si16_S5_S3 12.75 UMR_BAR__1_1000_0_S5_S3 -6.4 6.35
 /begin AXIS_DESCR STD_AXIS zff_atsys._.iSignale._.obj.sig_n_t UMR_U_MIN_1_1_0_S5_S3 4 0 8160 DEPOSIT ABSOLUTE /end AXIS_DESCR
 /begin AXIS_DESCR STD_AXIS zff_atsys._.iSignale._.obj.sig_m_t UMR_NM__1_1_0_S5_S3 6 -200 1300 DEPOSIT ABSOLUTE /end AXIS_DESCR
/end CHARACTERISTIC
/begin CHARACTERISTIC KF_POFMTNFUELLOPT56 "Kennfeld Fuelldruckoffset(n_t, m_t)" MAP 0x1C64C4 ZF_kf_si16_S5_S3 12.75 UMR_BAR__1_1000_0_S5_S3 -6.4 6.35
 /begin AXIS_DESCR STD_AXIS zff_atsys._.iSignale._.obj.sig_n_t UMR_U_MIN_1_1_0_S5_S3 4 0 8160 DEPOSIT ABSOLUTE /end AXIS_DESCR
 /begin AXIS_DESCR STD_AXIS zff_atsys._.iSignale._.obj.sig_m_t UMR_NM__1_1_0_S5_S3 6 -200 1300 DEPOSIT ABSOLUTE /end AXIS_DESCR
/end CHARACTERISTIC
/begin CHARACTERISTIC KF_POFMTNFUELLOPT67 "Kennfeld Fuelldruckoffset(n_t, m_t)" MAP 0x1C669C ZF_kf_si16_S5_S3 12.75 UMR_BAR__1_1000_0_S5_S3 -6.4 6.35
 /begin AXIS_DESCR STD_AXIS zff_atsys._.iSignale._.obj.sig_n_t UMR_U_MIN_1_1_0_S5_S3 4 0 8160 DEPOSIT ABSOLUTE /end AXIS_DESCR
 /begin AXIS_DESCR STD_AXIS zff_atsys._.iSignale._.obj.sig_m_t UMR_NM__1_1_0_S5_S3 6 -200 1300 DEPOSIT ABSOLUTE /end AXIS_DESCR
/end CHARACTERISTIC
/begin CHARACTERISTIC KF_POFMTNFUELLOPT78 "Kennfeld Fuelldruckoffset(n_t, m_t)" MAP 0x1C6874 ZF_kf_si16_S5_S3 12.75 UMR_BAR__1_1000_0_S5_S3 -6.4 6.35
 /begin AXIS_DESCR STD_AXIS zff_atsys._.iSignale._.obj.sig_n_t UMR_U_MIN_1_1_0_S5_S3 4 0 8160 DEPOSIT ABSOLUTE /end AXIS_DESCR
 /begin AXIS_DESCR STD_AXIS zff_atsys._.iSignale._.obj.sig_m_t UMR_NM__1_1_0_S5_S3 6 -200 1300 DEPOSIT ABSOLUTE /end AXIS_DESCR
/end CHARACTERISTIC
/begin CHARACTERISTIC KF_POFMTNFUELLRED12 "Kennfeld Fuelldruckoffset(n_t, m_t)" MAP 0x1C5D18 ZF_kf_si16_S5_S3 12.75 UMR_BAR__1_1000_0_S5_S3 -6.4 6.35
 /begin AXIS_DESCR STD_AXIS zff_atsys._.iSignale._.obj.sig_n_t UMR_U_MIN_1_1_0_S5_S3 4 0 8160 DEPOSIT ABSOLUTE /end AXIS_DESCR
 /begin AXIS_DESCR STD_AXIS zff_atsys._.iSignale._.obj.sig_m_t UMR_NM__1_1_0_S5_S3 6 -200 1300 DEPOSIT ABSOLUTE /end AXIS_DESCR
/end CHARACTERISTIC
/begin CHARACTERISTIC KF_POFMTNFUELLRED23 "Kennfeld Fuelldruckoffset(n_t, m_t)" MAP 0x1C5EF0 ZF_kf_si16_S5_S3 12.75 UMR_BAR__1_1000_0_S5_S3 -6.4 6.35
 /begin AXIS_DESCR STD_AXIS zff_atsys._.iSignale._.obj.sig_n_t UMR_U_MIN_1_1_0_S5_S3 4 0 8160 DEPOSIT ABSOLUTE /end AXIS_DESCR
 /begin AXIS_DESCR STD_AXIS zff_atsys._.iSignale._.obj.sig_m_t UMR_NM__1_1_0_S5_S3 6 -200 1300 DEPOSIT ABSOLUTE /end AXIS_DESCR
/end CHARACTERISTIC
/begin CHARACTERISTIC KF_POFMTNFUELLRED34 "Kennfeld Fuelldruckoffset(n_t, m_t)" MAP 0x1C60C8 ZF_kf_si16_S5_S3 12.75 UMR_BAR__1_1000_0_S5_S3 -6.4 6.35
 /begin AXIS_DESCR STD_AXIS zff_atsys._.iSignale._.obj.sig_n_t UMR_U_MIN_1_1_0_S5_S3 4 0 8160 DEPOSIT ABSOLUTE /end AXIS_DESCR
 /begin AXIS_DESCR STD_AXIS zff_atsys._.iSignale._.obj.sig_m_t UMR_NM__1_1_0_S5_S3 6 -200 1300 DEPOSIT ABSOLUTE /end AXIS_DESCR
/end CHARACTERISTIC
/begin CHARACTERISTIC KF_POFMTNFUELLRED45 "Kennfeld Fuelldruckoffset(n_t, m_t)" MAP 0x1C62A0 ZF_kf_si16_S5_S3 12.75 UMR_BAR__1_1000_0_S5_S3 -6.4 6.35
 /begin AXIS_DESCR STD_AXIS zff_atsys._.iSignale._.obj.sig_n_t UMR_U_MIN_1_1_0_S5_S3 4 0 8160 DEPOSIT ABSOLUTE /end AXIS_DESCR
 /begin AXIS_DESCR STD_AXIS zff_atsys._.iSignale._.obj.sig_m_t UMR_NM__1_1_0_S5_S3 6 -200 1300 DEPOSIT ABSOLUTE /end AXIS_DESCR
/end CHARACTERISTIC
/begin CHARACTERISTIC KF_POFMTNFUELLRED56 "Kennfeld Fuelldruckoffset(n_t, m_t)" MAP 0x1C6478 ZF_kf_si16_S5_S3 12.75 UMR_BAR__1_1000_0_S5_S3 -6.4 6.35
 /begin AXIS_DESCR STD_AXIS zff_atsys._.iSignale._.obj.sig_n_t UMR_U_MIN_1_1_0_S5_S3 4 0 8160 DEPOSIT ABSOLUTE /end AXIS_DESCR
 /begin AXIS_DESCR STD_AXIS zff_atsys._.iSignale._.obj.sig_m_t UMR_NM__1_1_0_S5_S3 6 -200 1300 DEPOSIT ABSOLUTE /end AXIS_DESCR
/end CHARACTERISTIC
/begin CHARACTERISTIC KF_POFMTNFUELLRED67 "Kennfeld Fuelldruckoffset(n_t, m_t)" MAP 0x1C6650 ZF_kf_si16_S5_S3 12.75 UMR_BAR__1_1000_0_S5_S3 -6.4 6.35
 /begin AXIS_DESCR STD_AXIS zff_atsys._.iSignale._.obj.sig_n_t UMR_U_MIN_1_1_0_S5_S3 4 0 8160 DEPOSIT ABSOLUTE /end AXIS_DESCR
 /begin AXIS_DESCR STD_AXIS zff_atsys._.iSignale._.obj.sig_m_t UMR_NM__1_1_0_S5_S3 6 -200 1300 DEPOSIT ABSOLUTE /end AXIS_DESCR
/end CHARACTERISTIC
/begin CHARACTERISTIC KF_POFMTNFUELLRED78 "Kennfeld Fuelldruckoffset(n_t, m_t)" MAP 0x1C6828 ZF_kf_si16_S5_S3 12.75 UMR_BAR__1_1000_0_S5_S3 -6.4 6.35
 /begin AXIS_DESCR STD_AXIS zff_atsys._.iSignale._.obj.sig_n_t UMR_U_MIN_1_1_0_S5_S3 4 0 8160 DEPOSIT ABSOLUTE /end AXIS_DESCR
 /begin AXIS_DESCR STD_AXIS zff_atsys._.iSignale._.obj.sig_m_t UMR_NM__1_1_0_S5_S3 6 -200 1300 DEPOSIT ABSOLUTE /end AXIS_DESCR
/end CHARACTERISTIC
/begin CHARACTERISTIC KF_POFMTNFUELLRED_7 "Kennfeld Fuelldruckoffset(n_t, m_t)" MAP 0x1C1770 ZF_kf_si16_S5_S3 12.75 UMR_BAR__1_1000_0_S5_S3 -6.4 6.35
 /begin AXIS_DESCR STD_AXIS iSasZentr.iSchaltend.nd_syn UMR_U_MIN_1_1_0_S5_S3 4 -8000 8000 DEPOSIT ABSOLUTE /end AXIS_DESCR
 /begin AXIS_DESCR STD_AXIS zff_atsys._.iSignale._.obj.sig_m_t UMR_NM__1_1_0_S5_S3 6 -200 1300 DEPOSIT ABSOLUTE /end AXIS_DESCR
/end CHARACTERISTIC
/begin CHARACTERISTIC KF_POFMTNFUELLRED_8 "Kennfeld Fuelldruckoffset(n_t, m_t)" MAP 0x1C1CA0 ZF_kf_si16_S5_S3 12.75 UMR_BAR__1_1000_0_S5_S3 -6.4 6.35
 /begin AXIS_DESCR STD_AXIS iSasZentr.iSchaltend.nd_syn UMR_U_MIN_1_1_0_S5_S3 4 -8000 8000 DEPOSIT ABSOLUTE /end AXIS_DESCR
 /begin AXIS_DESCR STD_AXIS zff_atsys._.iSignale._.obj.sig_m_t UMR_NM__1_1_0_S5_S3 6 -200 1300 DEPOSIT ABSOLUTE /end AXIS_DESCR
/end CHARACTERISTIC
/begin CHARACTERISTIC KF_POFMTNFUELLRED_R "Kennfeld Fuelldruckoffset(n_t, m_t)" MAP 0x1BF320 ZF_kf_si16_S5_S3 12.75 UMR_BAR__1_1000_0_S5_S3 -6.4 6.35
 /begin AXIS_DESCR STD_AXIS iSasZentr.iSchaltend.nd_syn UMR_U_MIN_1_1_0_S5_S3 4 -8000 8000 DEPOSIT ABSOLUTE /end AXIS_DESCR
 /begin AXIS_DESCR STD_AXIS zff_atsys._.iSignale._.obj.sig_m_t UMR_NM__1_1_0_S5_S3 6 -200 1300 DEPOSIT ABSOLUTE /end AXIS_DESCR
/end CHARACTERISTIC
/begin CHARACTERISTIC KF_POFMTNSP12 "Kennfeld Fuelldruckoffset(n_t, m_t)" MAP 0x1C3BF0 ZF_kf_si16_S5_S3 12.75 UMR_BAR__1_1000_0_S5_S3 -6.4 6.35
 /begin AXIS_DESCR STD_AXIS zff_atsys._.iSignale._.obj.sig_n_t UMR_U_MIN_1_1_0_S5_S3 4 0 8160 DEPOSIT ABSOLUTE /end AXIS_DESCR
 /begin AXIS_DESCR STD_AXIS zff_atsys._.iSignale._.obj.sig_m_t UMR_NM__1_1_0_S5_S3 6 -200 1300 DEPOSIT ABSOLUTE /end AXIS_DESCR
/end CHARACTERISTIC
/begin CHARACTERISTIC KF_POFMTNSP23 "Kennfeld Fuelldruckoffset(n_t, m_t)" MAP 0x1C3E48 ZF_kf_si16_S5_S3 12.75 UMR_BAR__1_1000_0_S5_S3 -6.4 6.35
 /begin AXIS_DESCR STD_AXIS zff_atsys._.iSignale._.obj.sig_n_t UMR_U_MIN_1_1_0_S5_S3 4 0 8160 DEPOSIT ABSOLUTE /end AXIS_DESCR
 /begin AXIS_DESCR STD_AXIS zff_atsys._.iSignale._.obj.sig_m_t UMR_NM__1_1_0_S5_S3 6 -200 1300 DEPOSIT ABSOLUTE /end AXIS_DESCR
/end CHARACTERISTIC
/begin CHARACTERISTIC KF_POFMTNSP34 "Kennfeld Fuelldruckoffset(n_t, m_t)" MAP 0x1C40A0 ZF_kf_si16_S5_S3 12.75 UMR_BAR__1_1000_0_S5_S3 -6.4 6.35
 /begin AXIS_DESCR STD_AXIS zff_atsys._.iSignale._.obj.sig_n_t UMR_U_MIN_1_1_0_S5_S3 4 0 8160 DEPOSIT ABSOLUTE /end AXIS_DESCR
 /begin AXIS_DESCR STD_AXIS zff_atsys._.iSignale._.obj.sig_m_t UMR_NM__1_1_0_S5_S3 6 -200 1300 DEPOSIT ABSOLUTE /end AXIS_DESCR
/end CHARACTERISTIC
/begin CHARACTERISTIC KF_POFMTNSP45 "Kennfeld Fuelldruckoffset(n_t, m_t)" MAP 0x1C42F8 ZF_kf_si16_S5_S3 12.75 UMR_BAR__1_1000_0_S5_S3 -6.4 6.35
 /begin AXIS_DESCR STD_AXIS zff_atsys._.iSignale._.obj.sig_n_t UMR_U_MIN_1_1_0_S5_S3 4 0 8160 DEPOSIT ABSOLUTE /end AXIS_DESCR
 /begin AXIS_DESCR STD_AXIS zff_atsys._.iSignale._.obj.sig_m_t UMR_NM__1_1_0_S5_S3 6 -200 1300 DEPOSIT ABSOLUTE /end AXIS_DESCR
/end CHARACTERISTIC
/begin CHARACTERISTIC KF_POFMTNSP56 "Kennfeld Fuelldruckoffset(n_t, m_t)" MAP 0x1C4550 ZF_kf_si16_S5_S3 12.75 UMR_BAR__1_1000_0_S5_S3 -6.4 6.35
 /begin AXIS_DESCR STD_AXIS zff_atsys._.iSignale._.obj.sig_n_t UMR_U_MIN_1_1_0_S5_S3 4 0 8160 DEPOSIT ABSOLUTE /end AXIS_DESCR
 /begin AXIS_DESCR STD_AXIS zff_atsys._.iSignale._.obj.sig_m_t UMR_NM__1_1_0_S5_S3 6 -200 1300 DEPOSIT ABSOLUTE /end AXIS_DESCR
/end CHARACTERISTIC
/begin CHARACTERISTIC KF_POFMTNSP67 "Kennfeld Fuelldruckoffset(n_t, m_t)" MAP 0x1C47A8 ZF_kf_si16_S5_S3 12.75 UMR_BAR__1_1000_0_S5_S3 -6.4 6.35
 /begin AXIS_DESCR STD_AXIS zff_atsys._.iSignale._.obj.sig_n_t UMR_U_MIN_1_1_0_S5_S3 4 0 8160 DEPOSIT ABSOLUTE /end AXIS_DESCR
 /begin AXIS_DESCR STD_AXIS zff_atsys._.iSignale._.obj.sig_m_t UMR_NM__1_1_0_S5_S3 6 -200 1300 DEPOSIT ABSOLUTE /end AXIS_DESCR
/end CHARACTERISTIC
/begin CHARACTERISTIC KF_POFMTNSP78 "Kennfeld Fuelldruckoffset(n_t, m_t)" MAP 0x1C4A00 ZF_kf_si16_S5_S3 12.75 UMR_BAR__1_1000_0_S5_S3 -6.4 6.35
 /begin AXIS_DESCR STD_AXIS zff_atsys._.iSignale._.obj.sig_n_t UMR_U_MIN_1_1_0_S5_S3 4 0 8160 DEPOSIT ABSOLUTE /end AXIS_DESCR
 /begin AXIS_DESCR STD_AXIS zff_atsys._.iSignale._.obj.sig_m_t UMR_NM__1_1_0_S5_S3 6 -200 1300 DEPOSIT ABSOLUTE /end AXIS_DESCR
/end CHARACTERISTIC
/begin CHARACTERISTIC KF_POFMTNSPORT12 "Kennfeld Fuelldruckoffset(n_t, m_t)" MAP 0x1C4C58 ZF_kf_si16_S5_S3 12.75 UMR_BAR__1_1000_0_S5_S3 -6.4 6.35
 /begin AXIS_DESCR STD_AXIS zff_atsys._.iSignale._.obj.sig_n_t UMR_U_MIN_1_1_0_S5_S3 4 0 8160 DEPOSIT ABSOLUTE /end AXIS_DESCR
 /begin AXIS_DESCR STD_AXIS zff_atsys._.iSignale._.obj.sig_m_t UMR_NM__1_1_0_S5_S3 6 -200 1300 DEPOSIT ABSOLUTE /end AXIS_DESCR
/end CHARACTERISTIC
/begin CHARACTERISTIC KF_POFMTNSPORT23 "Kennfeld Fuelldruckoffset(n_t, m_t)" MAP 0x1C4EB0 ZF_kf_si16_S5_S3 12.75 UMR_BAR__1_1000_0_S5_S3 -6.4 6.35
 /begin AXIS_DESCR STD_AXIS zff_atsys._.iSignale._.obj.sig_n_t UMR_U_MIN_1_1_0_S5_S3 4 0 8160 DEPOSIT ABSOLUTE /end AXIS_DESCR
 /begin AXIS_DESCR STD_AXIS zff_atsys._.iSignale._.obj.sig_m_t UMR_NM__1_1_0_S5_S3 6 -200 1300 DEPOSIT ABSOLUTE /end AXIS_DESCR
/end CHARACTERISTIC
/begin CHARACTERISTIC KF_POFMTNSPORT34 "Kennfeld Fuelldruckoffset(n_t, m_t)" MAP 0x1C5108 ZF_kf_si16_S5_S3 12.75 UMR_BAR__1_1000_0_S5_S3 -6.4 6.35
 /begin AXIS_DESCR STD_AXIS zff_atsys._.iSignale._.obj.sig_n_t UMR_U_MIN_1_1_0_S5_S3 4 0 8160 DEPOSIT ABSOLUTE /end AXIS_DESCR
 /begin AXIS_DESCR STD_AXIS zff_atsys._.iSignale._.obj.sig_m_t UMR_NM__1_1_0_S5_S3 6 -200 1300 DEPOSIT ABSOLUTE /end AXIS_DESCR
/end CHARACTERISTIC
/begin CHARACTERISTIC KF_POFMTNSPORT45 "Kennfeld Fuelldruckoffset(n_t, m_t)" MAP 0x1C5360 ZF_kf_si16_S5_S3 12.75 UMR_BAR__1_1000_0_S5_S3 -6.4 6.35
 /begin AXIS_DESCR STD_AXIS zff_atsys._.iSignale._.obj.sig_n_t UMR_U_MIN_1_1_0_S5_S3 4 0 8160 DEPOSIT ABSOLUTE /end AXIS_DESCR
 /begin AXIS_DESCR STD_AXIS zff_atsys._.iSignale._.obj.sig_m_t UMR_NM__1_1_0_S5_S3 6 -200 1300 DEPOSIT ABSOLUTE /end AXIS_DESCR
/end CHARACTERISTIC
/begin CHARACTERISTIC KF_POFMTNSPORT56 "Kennfeld Fuelldruckoffset(n_t, m_t)" MAP 0x1C55B8 ZF_kf_si16_S5_S3 12.75 UMR_BAR__1_1000_0_S5_S3 -6.4 6.35
 /begin AXIS_DESCR STD_AXIS zff_atsys._.iSignale._.obj.sig_n_t UMR_U_MIN_1_1_0_S5_S3 4 0 8160 DEPOSIT ABSOLUTE /end AXIS_DESCR
 /begin AXIS_DESCR STD_AXIS zff_atsys._.iSignale._.obj.sig_m_t UMR_NM__1_1_0_S5_S3 6 -200 1300 DEPOSIT ABSOLUTE /end AXIS_DESCR
/end CHARACTERISTIC
/begin CHARACTERISTIC KF_POFMTNSPORT67 "Kennfeld Fuelldruckoffset(n_t, m_t)" MAP 0x1C5810 ZF_kf_si16_S5_S3 12.75 UMR_BAR__1_1000_0_S5_S3 -6.4 6.35
 /begin AXIS_DESCR STD_AXIS zff_atsys._.iSignale._.obj.sig_n_t UMR_U_MIN_1_1_0_S5_S3 4 0 8160 DEPOSIT ABSOLUTE /end AXIS_DESCR
 /begin AXIS_DESCR STD_AXIS zff_atsys._.iSignale._.obj.sig_m_t UMR_NM__1_1_0_S5_S3 6 -200 1300 DEPOSIT ABSOLUTE /end AXIS_DESCR
/end CHARACTERISTIC
/begin CHARACTERISTIC KF_POFMTNSPORT78 "Kennfeld Fuelldruckoffset(n_t, m_t)" MAP 0x1C5A68 ZF_kf_si16_S5_S3 12.75 UMR_BAR__1_1000_0_S5_S3 -6.4 6.35
 /begin AXIS_DESCR STD_AXIS zff_atsys._.iSignale._.obj.sig_n_t UMR_U_MIN_1_1_0_S5_S3 4 0 8160 DEPOSIT ABSOLUTE /end AXIS_DESCR
 /begin AXIS_DESCR STD_AXIS zff_atsys._.iSignale._.obj.sig_m_t UMR_NM__1_1_0_S5_S3 6 -200 1300 DEPOSIT ABSOLUTE /end AXIS_DESCR
/end CHARACTERISTIC
/begin CHARACTERISTIC KF_POFMTN_7 "Kennfeld Fuelldruckoffset(nd_syn, m_t)" MAP 0x1C17BC ZF_kf_si16_S5_S3 12.75 UMR_BAR__1_1000_0_S5_S3 -6.4 6.35
 /begin AXIS_DESCR STD_AXIS iSasZentr.iSchaltend.nd_syn UMR_U_MIN_1_1_0_S5_S3 4 -8000 8000 DEPOSIT ABSOLUTE /end AXIS_DESCR
 /begin AXIS_DESCR STD_AXIS zff_atsys._.iSignale._.obj.sig_m_t UMR_NM__1_1_0_S5_S3 6 -200 1300 DEPOSIT ABSOLUTE /end AXIS_DESCR
/end CHARACTERISTIC
/begin CHARACTERISTIC KF_POFMTN_8 "Kennfeld Fuelldruckoffset(nd_syn, m_t)" MAP 0x1C1CEC ZF_kf_si16_S5_S3 12.75 UMR_BAR__1_1000_0_S5_S3 -6.4 6.35
 /begin AXIS_DESCR STD_AXIS iSasZentr.iSchaltend.nd_syn UMR_U_MIN_1_1_0_S5_S3 4 -8000 8000 DEPOSIT ABSOLUTE /end AXIS_DESCR
 /begin AXIS_DESCR STD_AXIS zff_atsys._.iSignale._.obj.sig_m_t UMR_NM__1_1_0_S5_S3 6 -200 1300 DEPOSIT ABSOLUTE /end AXIS_DESCR
/end CHARACTERISTIC
/begin CHARACTERISTIC KF_POFMTN_R "Kennfeld Fuelldruckoffset(nd_syn, m_t)" MAP 0x1BF36C ZF_kf_si16_S5_S3 12.75 UMR_BAR__1_1000_0_S5_S3 -6.4 6.35
 /begin AXIS_DESCR STD_AXIS iSasZentr.iSchaltend.nd_syn UMR_U_MIN_1_1_0_S5_S3 4 -8000 8000 DEPOSIT ABSOLUTE /end AXIS_DESCR
 /begin AXIS_DESCR STD_AXIS zff_atsys._.iSignale._.obj.sig_m_t UMR_NM__1_1_0_S5_S3 6 -200 1300 DEPOSIT ABSOLUTE /end AXIS_DESCR
/end CHARACTERISTIC
/begin CHARACTERISTIC KF_POHINSYNKZU21 "Kennfeld Haltedruckoffset(n_tkf, m_t) bei Haltephase in Synchron" MAP 0x1C6B68 ZF_kf_si16_S5_S3 12.75 UMR_BAR__1_1000_0_S5_S3 -6.4 6.35
 /begin AXIS_DESCR STD_AXIS iSasZentr.iSchaltend.n_tkf UMR_U_MIN_32_1_0_S5_S3 6 0 8160 DEPOSIT ABSOLUTE /end AXIS_DESCR
 /begin AXIS_DESCR STD_AXIS zff_atsys._.iSignale._.obj.sig_m_t UMR_NM__1_1_0_S5_S3 6 -200 1300 DEPOSIT ABSOLUTE /end AXIS_DESCR
/end CHARACTERISTIC
/begin CHARACTERISTIC KF_POKZUMTCG12 "Schaltdruckoffset" MAP 0x1C2444 ZF_kf_si16_S5_S3 12.75 UMR_BAR__1_1000_0_S5_S3 -6.4 6.35
 /begin AXIS_DESCR STD_AXIS zff_atsys._.iSignale._.obj.sig_m_t UMR_NM__1_1_0_S5_S3 5 -200 1300 DEPOSIT ABSOLUTE /end AXIS_DESCR
 /begin AXIS_DESCR STD_AXIS zff_atsys._.iSignale._.obj.sig_c_getr UMR_GRADC__1_1_M40_S5_S3 10 -40 150 DEPOSIT ABSOLUTE /end AXIS_DESCR
/end CHARACTERISTIC
/begin CHARACTERISTIC KF_POKZUMTCG23 "Schaltdruckoffset" MAP 0x1C2814 ZF_kf_si16_S5_S3 12.75 UMR_BAR__1_1000_0_S5_S3 -6.4 6.35
 /begin AXIS_DESCR STD_AXIS zff_atsys._.iSignale._.obj.sig_m_t UMR_NM__1_1_0_S5_S3 5 -200 1300 DEPOSIT ABSOLUTE /end AXIS_DESCR
 /begin AXIS_DESCR STD_AXIS zff_atsys._.iSignale._.obj.sig_c_getr UMR_GRADC__1_1_M40_S5_S3 10 -40 150 DEPOSIT ABSOLUTE /end AXIS_DESCR
/end CHARACTERISTIC
/begin CHARACTERISTIC KF_POKZUMTCG34 "Schaltdruckoffset" MAP 0x1C2BE4 ZF_kf_si16_S5_S3 12.75 UMR_BAR__1_1000_0_S5_S3 -6.4 6.35
 /begin AXIS_DESCR STD_AXIS zff_atsys._.iSignale._.obj.sig_m_t UMR_NM__1_1_0_S5_S3 5 -200 1300 DEPOSIT ABSOLUTE /end AXIS_DESCR
 /begin AXIS_DESCR STD_AXIS zff_atsys._.iSignale._.obj.sig_c_getr UMR_GRADC__1_1_M40_S5_S3 10 -40 150 DEPOSIT ABSOLUTE /end AXIS_DESCR
/end CHARACTERISTIC
/begin CHARACTERISTIC KF_POKZUMTCG45 "Schaltdruckoffset" MAP 0x1C2FB4 ZF_kf_si16_S5_S3 12.75 UMR_BAR__1_1000_0_S5_S3 -6.4 6.35
 /begin AXIS_DESCR STD_AXIS zff_atsys._.iSignale._.obj.sig_m_t UMR_NM__1_1_0_S5_S3 5 -200 1300 DEPOSIT ABSOLUTE /end AXIS_DESCR
 /begin AXIS_DESCR STD_AXIS zff_atsys._.iSignale._.obj.sig_c_getr UMR_GRADC__1_1_M40_S5_S3 10 -40 150 DEPOSIT ABSOLUTE /end AXIS_DESCR
/end CHARACTERISTIC
/begin CHARACTERISTIC KF_POKZUMTCG56 "Schaltdruckoffset" MAP 0x1C3384 ZF_kf_si16_S5_S3 12.75 UMR_BAR__1_1000_0_S5_S3 -6.4 6.35
 /begin AXIS_DESCR STD_AXIS zff_atsys._.iSignale._.obj.sig_m_t UMR_NM__1_1_0_S5_S3 5 -200 1300 DEPOSIT ABSOLUTE /end AXIS_DESCR
 /begin AXIS_DESCR STD_AXIS zff_atsys._.iSignale._.obj.sig_c_getr UMR_GRADC__1_1_M40_S5_S3 10 -40 150 DEPOSIT ABSOLUTE /end AXIS_DESCR
/end CHARACTERISTIC
/begin CHARACTERISTIC KF_POKZUMTCG67 "Schaltdruckoffset" MAP 0x1C3754 ZF_kf_si16_S5_S3 12.75 UMR_BAR__1_1000_0_S5_S3 -6.4 6.35
 /begin AXIS_DESCR STD_AXIS zff_atsys._.iSignale._.obj.sig_m_t UMR_NM__1_1_0_S5_S3 5 -200 1300 DEPOSIT ABSOLUTE /end AXIS_DESCR
 /begin AXIS_DESCR STD_AXIS zff_atsys._.iSignale._.obj.sig_c_getr UMR_GRADC__1_1_M40_S5_S3 10 -40 150 DEPOSIT ABSOLUTE /end AXIS_DESCR
/end CHARACTERISTIC
/begin CHARACTERISTIC KF_POKZUMTCG78 "Schaltdruckoffset" MAP 0x1C3B24 ZF_kf_si16_S5_S3 12.75 UMR_BAR__1_1000_0_S5_S3 -6.4 6.35
 /begin AXIS_DESCR STD_AXIS zff_atsys._.iSignale._.obj.sig_m_t UMR_NM__1_1_0_S5_S3 5 -200 1300 DEPOSIT ABSOLUTE /end AXIS_DESCR
 /begin AXIS_DESCR STD_AXIS zff_atsys._.iSignale._.obj.sig_c_getr UMR_GRADC__1_1_M40_S5_S3 10 -40 150 DEPOSIT ABSOLUTE /end AXIS_DESCR
/end CHARACTERISTIC
/begin CHARACTERISTIC KF_POKZUMTCGSP12 "Schaltdruckoffset" MAP 0x1C3D7C ZF_kf_si16_S5_S3 12.75 UMR_BAR__1_1000_0_S5_S3 -6.4 6.35
 /begin AXIS_DESCR STD_AXIS zff_atsys._.iSignale._.obj.sig_m_t UMR_NM__1_1_0_S5_S3 5 -200 1300 DEPOSIT ABSOLUTE /end AXIS_DESCR
 /begin AXIS_DESCR STD_AXIS zff_atsys._.iSignale._.obj.sig_c_getr UMR_GRADC__1_1_M40_S5_S3 10 -40 150 DEPOSIT ABSOLUTE /end AXIS_DESCR
/end CHARACTERISTIC
/begin CHARACTERISTIC KF_POKZUMTCGSP23 "Schaltdruckoffset" MAP 0x1C3FD4 ZF_kf_si16_S5_S3 12.75 UMR_BAR__1_1000_0_S5_S3 -6.4 6.35
 /begin AXIS_DESCR STD_AXIS zff_atsys._.iSignale._.obj.sig_m_t UMR_NM__1_1_0_S5_S3 5 -200 1300 DEPOSIT ABSOLUTE /end AXIS_DESCR
 /begin AXIS_DESCR STD_AXIS zff_atsys._.iSignale._.obj.sig_c_getr UMR_GRADC__1_1_M40_S5_S3 10 -40 150 DEPOSIT ABSOLUTE /end AXIS_DESCR
/end CHARACTERISTIC
/begin CHARACTERISTIC KF_POKZUMTCGSP34 "Schaltdruckoffset" MAP 0x1C422C ZF_kf_si16_S5_S3 12.75 UMR_BAR__1_1000_0_S5_S3 -6.4 6.35
 /begin AXIS_DESCR STD_AXIS zff_atsys._.iSignale._.obj.sig_m_t UMR_NM__1_1_0_S5_S3 5 -200 1300 DEPOSIT ABSOLUTE /end AXIS_DESCR
 /begin AXIS_DESCR STD_AXIS zff_atsys._.iSignale._.obj.sig_c_getr UMR_GRADC__1_1_M40_S5_S3 10 -40 150 DEPOSIT ABSOLUTE /end AXIS_DESCR
/end CHARACTERISTIC
/begin CHARACTERISTIC KF_POKZUMTCGSP45 "Schaltdruckoffset" MAP 0x1C4484 ZF_kf_si16_S5_S3 12.75 UMR_BAR__1_1000_0_S5_S3 -6.4 6.35
 /begin AXIS_DESCR STD_AXIS zff_atsys._.iSignale._.obj.sig_m_t UMR_NM__1_1_0_S5_S3 5 -200 1300 DEPOSIT ABSOLUTE /end AXIS_DESCR
 /begin AXIS_DESCR STD_AXIS zff_atsys._.iSignale._.obj.sig_c_getr UMR_GRADC__1_1_M40_S5_S3 10 -40 150 DEPOSIT ABSOLUTE /end AXIS_DESCR
/end CHARACTERISTIC
/begin CHARACTERISTIC KF_POKZUMTCGSP56 "Schaltdruckoffset" MAP 0x1C46DC ZF_kf_si16_S5_S3 12.75 UMR_BAR__1_1000_0_S5_S3 -6.4 6.35
 /begin AXIS_DESCR STD_AXIS zff_atsys._.iSignale._.obj.sig_m_t UMR_NM__1_1_0_S5_S3 5 -200 1300 DEPOSIT ABSOLUTE /end AXIS_DESCR
 /begin AXIS_DESCR STD_AXIS zff_atsys._.iSignale._.obj.sig_c_getr UMR_GRADC__1_1_M40_S5_S3 10 -40 150 DEPOSIT ABSOLUTE /end AXIS_DESCR
/end CHARACTERISTIC
/begin CHARACTERISTIC KF_POKZUMTCGSP67 "Schaltdruckoffset" MAP 0x1C4934 ZF_kf_si16_S5_S3 12.75 UMR_BAR__1_1000_0_S5_S3 -6.4 6.35
 /begin AXIS_DESCR STD_AXIS zff_atsys._.iSignale._.obj.sig_m_t UMR_NM__1_1_0_S5_S3 5 -200 1300 DEPOSIT ABSOLUTE /end AXIS_DESCR
 /begin AXIS_DESCR STD_AXIS zff_atsys._.iSignale._.obj.sig_c_getr UMR_GRADC__1_1_M40_S5_S3 10 -40 150 DEPOSIT ABSOLUTE /end AXIS_DESCR
/end CHARACTERISTIC
/begin CHARACTERISTIC KF_POKZUMTCGSP78 "Schaltdruckoffset" MAP 0x1C4B8C ZF_kf_si16_S5_S3 12.75 UMR_BAR__1_1000_0_S5_S3 -6.4 6.35
 /begin AXIS_DESCR STD_AXIS zff_atsys._.iSignale._.obj.sig_m_t UMR_NM__1_1_0_S5_S3 5 -200 1300 DEPOSIT ABSOLUTE /end AXIS_DESCR
 /begin AXIS_DESCR STD_AXIS zff_atsys._.iSignale._.obj.sig_c_getr UMR_GRADC__1_1_M40_S5_S3 10 -40 150 DEPOSIT ABSOLUTE /end AXIS_DESCR
/end CHARACTERISTIC
/begin CHARACTERISTIC KF_POKZUMTCGSPORT12 "Schaltdruckoffset" MAP 0x1C4DE4 ZF_kf_si16_S5_S3 12.75 UMR_BAR__1_1000_0_S5_S3 -6.4 6.35
 /begin AXIS_DESCR STD_AXIS zff_atsys._.iSignale._.obj.sig_m_t UMR_NM__1_1_0_S5_S3 5 -200 1300 DEPOSIT ABSOLUTE /end AXIS_DESCR
 /begin AXIS_DESCR STD_AXIS zff_atsys._.iSignale._.obj.sig_c_getr UMR_GRADC__1_1_M40_S5_S3 10 -40 150 DEPOSIT ABSOLUTE /end AXIS_DESCR
/end CHARACTERISTIC
/begin CHARACTERISTIC KF_POKZUMTCGSPORT23 "Schaltdruckoffset" MAP 0x1C503C ZF_kf_si16_S5_S3 12.75 UMR_BAR__1_1000_0_S5_S3 -6.4 6.35
 /begin AXIS_DESCR STD_AXIS zff_atsys._.iSignale._.obj.sig_m_t UMR_NM__1_1_0_S5_S3 5 -200 1300 DEPOSIT ABSOLUTE /end AXIS_DESCR
 /begin AXIS_DESCR STD_AXIS zff_atsys._.iSignale._.obj.sig_c_getr UMR_GRADC__1_1_M40_S5_S3 10 -40 150 DEPOSIT ABSOLUTE /end AXIS_DESCR
/end CHARACTERISTIC
/begin CHARACTERISTIC KF_POKZUMTCGSPORT34 "Schaltdruckoffset" MAP 0x1C5294 ZF_kf_si16_S5_S3 12.75 UMR_BAR__1_1000_0_S5_S3 -6.4 6.35
 /begin AXIS_DESCR STD_AXIS zff_atsys._.iSignale._.obj.sig_m_t UMR_NM__1_1_0_S5_S3 5 -200 1300 DEPOSIT ABSOLUTE /end AXIS_DESCR
 /begin AXIS_DESCR STD_AXIS zff_atsys._.iSignale._.obj.sig_c_getr UMR_GRADC__1_1_M40_S5_S3 10 -40 150 DEPOSIT ABSOLUTE /end AXIS_DESCR
/end CHARACTERISTIC
/begin CHARACTERISTIC KF_POKZUMTCGSPORT45 "Schaltdruckoffset" MAP 0x1C54EC ZF_kf_si16_S5_S3 12.75 UMR_BAR__1_1000_0_S5_S3 -6.4 6.35
 /begin AXIS_DESCR STD_AXIS zff_atsys._.iSignale._.obj.sig_m_t UMR_NM__1_1_0_S5_S3 5 -200 1300 DEPOSIT ABSOLUTE /end AXIS_DESCR
 /begin AXIS_DESCR STD_AXIS zff_atsys._.iSignale._.obj.sig_c_getr UMR_GRADC__1_1_M40_S5_S3 10 -40 150 DEPOSIT ABSOLUTE /end AXIS_DESCR
/end CHARACTERISTIC
/begin CHARACTERISTIC KF_POKZUMTCGSPORT56 "Schaltdruckoffset" MAP 0x1C5744 ZF_kf_si16_S5_S3 12.75 UMR_BAR__1_1000_0_S5_S3 -6.4 6.35
 /begin AXIS_DESCR STD_AXIS zff_atsys._.iSignale._.obj.sig_m_t UMR_NM__1_1_0_S5_S3 5 -200 1300 DEPOSIT ABSOLUTE /end AXIS_DESCR
 /begin AXIS_DESCR STD_AXIS zff_atsys._.iSignale._.obj.sig_c_getr UMR_GRADC__1_1_M40_S5_S3 10 -40 150 DEPOSIT ABSOLUTE /end AXIS_DESCR
/end CHARACTERISTIC
/begin CHARACTERISTIC KF_POKZUMTCGSPORT67 "Schaltdruckoffset" MAP 0x1C599C ZF_kf_si16_S5_S3 12.75 UMR_BAR__1_1000_0_S5_S3 -6.4 6.35
 /begin AXIS_DESCR STD_AXIS zff_atsys._.iSignale._.obj.sig_m_t UMR_NM__1_1_0_S5_S3 5 -200 1300 DEPOSIT ABSOLUTE /end AXIS_DESCR
 /begin AXIS_DESCR STD_AXIS zff_atsys._.iSignale._.obj.sig_c_getr UMR_GRADC__1_1_M40_S5_S3 10 -40 150 DEPOSIT ABSOLUTE /end AXIS_DESCR
/end CHARACTERISTIC
/begin CHARACTERISTIC KF_POKZUMTCGSPORT78 "Schaltdruckoffset" MAP 0x1C5BF4 ZF_kf_si16_S5_S3 12.75 UMR_BAR__1_1000_0_S5_S3 -6.4 6.35
 /begin AXIS_DESCR STD_AXIS zff_atsys._.iSignale._.obj.sig_m_t UMR_NM__1_1_0_S5_S3 5 -200 1300 DEPOSIT ABSOLUTE /end AXIS_DESCR
 /begin AXIS_DESCR STD_AXIS zff_atsys._.iSignale._.obj.sig_c_getr UMR_GRADC__1_1_M40_S5_S3 10 -40 150 DEPOSIT ABSOLUTE /end AXIS_DESCR
/end CHARACTERISTIC
/begin CHARACTERISTIC KF_POMLASTCGV2_7 "Momentenabhaengiger Druckoffset in FA der 2. nichtkraftschliessende KZU" MAP 0x1C1ADC ZF_kf_si16_S5_S3 3 UMR_BAR__1_1000_0_S5_S3 0 3
 /begin AXIS_DESCR STD_AXIS NO_INPUT_QUANTITY UMR_NM__1_1_0_S5_S3 5 -200 1300 DEPOSIT ABSOLUTE /end AXIS_DESCR
 /begin AXIS_DESCR STD_AXIS zff_atsys._.iSignale._.obj.sig_c_getr UMR_GRADC__1_1_M40_S5_S3 4 -40 150 DEPOSIT ABSOLUTE /end AXIS_DESCR
/end CHARACTERISTIC
/begin CHARACTERISTIC KF_POMLASTCGV2_8 "Momentenabhaengiger Druckoffset in FA der 2. nichtkraftschliessende KZU" MAP 0x1C200C ZF_kf_si16_S5_S3 3 UMR_BAR__1_1000_0_S5_S3 0 3
 /begin AXIS_DESCR STD_AXIS NO_INPUT_QUANTITY UMR_NM__1_1_0_S5_S3 5 -200 1300 DEPOSIT ABSOLUTE /end AXIS_DESCR
 /begin AXIS_DESCR STD_AXIS zff_atsys._.iSignale._.obj.sig_c_getr UMR_GRADC__1_1_M40_S5_S3 4 -40 150 DEPOSIT ABSOLUTE /end AXIS_DESCR
/end CHARACTERISTIC
/begin CHARACTERISTIC KF_POMLASTCGV2_R "Momentenabhaengiger Druckoffset in FA der 2. nichtkraftschliessende KZU" MAP 0x1BF68C ZF_kf_si16_S5_S3 3 UMR_BAR__1_1000_0_S5_S3 0 3
 /begin AXIS_DESCR STD_AXIS NO_INPUT_QUANTITY UMR_NM__1_1_0_S5_S3 5 -200 1300 DEPOSIT ABSOLUTE /end AXIS_DESCR
 /begin AXIS_DESCR STD_AXIS zff_atsys._.iSignale._.obj.sig_c_getr UMR_GRADC__1_1_M40_S5_S3 4 -40 150 DEPOSIT ABSOLUTE /end AXIS_DESCR
/end CHARACTERISTIC
/begin CHARACTERISTIC KF_POTNDSYNV2_7 "Differenzdrehzahlabhaengiger Druckoffset in FA der 2. nichtkraftschliessende KZU" MAP 0x1C1B20 ZF_kf_si16_S5_S3 3 UMR_BAR__1_1000_0_S5_S3 0 3
 /begin AXIS_DESCR STD_AXIS NO_INPUT_QUANTITY UMR_MSEC__10_1_0_S5_S3 6 0 2540 DEPOSIT ABSOLUTE /end AXIS_DESCR
 /begin AXIS_DESCR STD_AXIS NO_INPUT_QUANTITY UMR_U_MIN_1_1_0_S5_S3 8 -8160 8160 DEPOSIT ABSOLUTE /end AXIS_DESCR
/end CHARACTERISTIC
/begin CHARACTERISTIC KF_POTNDSYNV2_8 "Differenzdrehzahlabhaengiger Druckoffset in FA der 2. nichtkraftschliessende KZU" MAP 0x1C2050 ZF_kf_si16_S5_S3 3 UMR_BAR__1_1000_0_S5_S3 0 3
 /begin AXIS_DESCR STD_AXIS NO_INPUT_QUANTITY UMR_MSEC__10_1_0_S5_S3 6 0 2540 DEPOSIT ABSOLUTE /end AXIS_DESCR
 /begin AXIS_DESCR STD_AXIS NO_INPUT_QUANTITY UMR_U_MIN_1_1_0_S5_S3 8 -8160 8160 DEPOSIT ABSOLUTE /end AXIS_DESCR
/end CHARACTERISTIC
/begin CHARACTERISTIC KF_POTNDSYNV2_R "Differenzdrehzahlabhaengiger Druckoffset in FA der 2. nichtkraftschliessende KZU" MAP 0x1BF6D0 ZF_kf_si16_S5_S3 3 UMR_BAR__1_1000_0_S5_S3 0 3
 /begin AXIS_DESCR STD_AXIS NO_INPUT_QUANTITY UMR_MSEC__10_1_0_S5_S3 6 0 2540 DEPOSIT ABSOLUTE /end AXIS_DESCR
 /begin AXIS_DESCR STD_AXIS NO_INPUT_QUANTITY UMR_U_MIN_1_1_0_S5_S3 8 -8160 8160 DEPOSIT ABSOLUTE /end AXIS_DESCR
/end CHARACTERISTIC
/begin CHARACTERISTIC KF_TFCGNT12 "Fuellzeit" MAP 0x1C2118 ZF_kf_ui8_S5_S3 2540 UMR_MSEC__10_1_0_S5_S3 0 2540
 /begin AXIS_DESCR STD_AXIS zff_atsys._.iSignale._.obj.sig_c_getr UMR_GRADC__1_1_M40_S5_S3 10 -40 150 DEPOSIT ABSOLUTE /end AXIS_DESCR
 /begin AXIS_DESCR STD_AXIS zff_atsys._.iSignale._.obj.sig_n_t8 UMR_U_MIN_32_1_0_S5_S3 3 0 8160 DEPOSIT ABSOLUTE /end AXIS_DESCR
/end CHARACTERISTIC
/begin CHARACTERISTIC KF_TFCGNT12_EL "Fuellzeit" MAP 0x1C214C ZF_kf_ui8_S5_S3 2540 UMR_MSEC__10_1_0_S5_S3 0 2540
 /begin AXIS_DESCR STD_AXIS zff_atsys._.iSignale._.obj.sig_c_getr UMR_GRADC__1_1_M40_S5_S3 10 -40 150 DEPOSIT ABSOLUTE /end AXIS_DESCR
 /begin AXIS_DESCR STD_AXIS zff_atsys._.iSignale._.obj.sig_n_t8 UMR_U_MIN_32_1_0_S5_S3 3 0 8160 DEPOSIT ABSOLUTE /end AXIS_DESCR
/end CHARACTERISTIC
/begin CHARACTERISTIC KF_TFCGNT23 "Fuellzeit" MAP 0x1C24E8 ZF_kf_ui8_S5_S3 2540 UMR_MSEC__10_1_0_S5_S3 0 2540
 /begin AXIS_DESCR STD_AXIS zff_atsys._.iSignale._.obj.sig_c_getr UMR_GRADC__1_1_M40_S5_S3 10 -40 150 DEPOSIT ABSOLUTE /end AXIS_DESCR
 /begin AXIS_DESCR STD_AXIS zff_atsys._.iSignale._.obj.sig_n_t8 UMR_U_MIN_32_1_0_S5_S3 3 0 8160 DEPOSIT ABSOLUTE /end AXIS_DESCR
/end CHARACTERISTIC
/begin CHARACTERISTIC KF_TFCGNT23_EL "Fuellzeit" MAP 0x1C251C ZF_kf_ui8_S5_S3 2540 UMR_MSEC__10_1_0_S5_S3 0 2540
 /begin AXIS_DESCR STD_AXIS zff_atsys._.iSignale._.obj.sig_c_getr UMR_GRADC__1_1_M40_S5_S3 10 -40 150 DEPOSIT ABSOLUTE /end AXIS_DESCR
 /begin AXIS_DESCR STD_AXIS zff_atsys._.iSignale._.obj.sig_n_t8 UMR_U_MIN_32_1_0_S5_S3 3 0 8160 DEPOSIT ABSOLUTE /end AXIS_DESCR
/end CHARACTERISTIC
/begin CHARACTERISTIC KF_TFCGNT34 "Fuellzeit" MAP 0x1C28B8 ZF_kf_ui8_S5_S3 2540 UMR_MSEC__10_1_0_S5_S3 0 2540
 /begin AXIS_DESCR STD_AXIS zff_atsys._.iSignale._.obj.sig_c_getr UMR_GRADC__1_1_M40_S5_S3 10 -40 150 DEPOSIT ABSOLUTE /end AXIS_DESCR
 /begin AXIS_DESCR STD_AXIS zff_atsys._.iSignale._.obj.sig_n_t8 UMR_U_MIN_32_1_0_S5_S3 3 0 8160 DEPOSIT ABSOLUTE /end AXIS_DESCR
/end CHARACTERISTIC
/begin CHARACTERISTIC KF_TFCGNT34_EL "Fuellzeit" MAP 0x1C28EC ZF_kf_ui8_S5_S3 2540 UMR_MSEC__10_1_0_S5_S3 0 2540
 /begin AXIS_DESCR STD_AXIS zff_atsys._.iSignale._.obj.sig_c_getr UMR_GRADC__1_1_M40_S5_S3 10 -40 150 DEPOSIT ABSOLUTE /end AXIS_DESCR
 /begin AXIS_DESCR STD_AXIS zff_atsys._.iSignale._.obj.sig_n_t8 UMR_U_MIN_32_1_0_S5_S3 3 0 8160 DEPOSIT ABSOLUTE /end AXIS_DESCR
/end CHARACTERISTIC
/begin CHARACTERISTIC KF_TFCGNT45 "Fuellzeit" MAP 0x1C2C88 ZF_kf_ui8_S5_S3 2540 UMR_MSEC__10_1_0_S5_S3 0 2540
 /begin AXIS_DESCR STD_AXIS zff_atsys._.iSignale._.obj.sig_c_getr UMR_GRADC__1_1_M40_S5_S3 10 -40 150 DEPOSIT ABSOLUTE /end AXIS_DESCR
 /begin AXIS_DESCR STD_AXIS zff_atsys._.iSignale._.obj.sig_n_t8 UMR_U_MIN_32_1_0_S5_S3 3 0 8160 DEPOSIT ABSOLUTE /end AXIS_DESCR
/end CHARACTERISTIC
/begin CHARACTERISTIC KF_TFCGNT45_EL "Fuellzeit" MAP 0x1C2CBC ZF_kf_ui8_S5_S3 2540 UMR_MSEC__10_1_0_S5_S3 0 2540
 /begin AXIS_DESCR STD_AXIS zff_atsys._.iSignale._.obj.sig_c_getr UMR_GRADC__1_1_M40_S5_S3 10 -40 150 DEPOSIT ABSOLUTE /end AXIS_DESCR
 /begin AXIS_DESCR STD_AXIS zff_atsys._.iSignale._.obj.sig_n_t8 UMR_U_MIN_32_1_0_S5_S3 3 0 8160 DEPOSIT ABSOLUTE /end AXIS_DESCR
/end CHARACTERISTIC
/begin CHARACTERISTIC KF_TFCGNT56 "Fuellzeit" MAP 0x1C3058 ZF_kf_ui8_S5_S3 2540 UMR_MSEC__10_1_0_S5_S3 0 2540
 /begin AXIS_DESCR STD_AXIS zff_atsys._.iSignale._.obj.sig_c_getr UMR_GRADC__1_1_M40_S5_S3 10 -40 150 DEPOSIT ABSOLUTE /end AXIS_DESCR
 /begin AXIS_DESCR STD_AXIS zff_atsys._.iSignale._.obj.sig_n_t8 UMR_U_MIN_32_1_0_S5_S3 3 0 8160 DEPOSIT ABSOLUTE /end AXIS_DESCR
/end CHARACTERISTIC
/begin CHARACTERISTIC KF_TFCGNT56_EL "Fuellzeit" MAP 0x1C308C ZF_kf_ui8_S5_S3 2540 UMR_MSEC__10_1_0_S5_S3 0 2540
 /begin AXIS_DESCR STD_AXIS zff_atsys._.iSignale._.obj.sig_c_getr UMR_GRADC__1_1_M40_S5_S3 10 -40 150 DEPOSIT ABSOLUTE /end AXIS_DESCR
 /begin AXIS_DESCR STD_AXIS zff_atsys._.iSignale._.obj.sig_n_t8 UMR_U_MIN_32_1_0_S5_S3 3 0 8160 DEPOSIT ABSOLUTE /end AXIS_DESCR
/end CHARACTERISTIC
/begin CHARACTERISTIC KF_TFCGNT67 "Fuellzeit" MAP 0x1C3428 ZF_kf_ui8_S5_S3 2540 UMR_MSEC__10_1_0_S5_S3 0 2540
 /begin AXIS_DESCR STD_AXIS zff_atsys._.iSignale._.obj.sig_c_getr UMR_GRADC__1_1_M40_S5_S3 10 -40 150 DEPOSIT ABSOLUTE /end AXIS_DESCR
 /begin AXIS_DESCR STD_AXIS zff_atsys._.iSignale._.obj.sig_n_t8 UMR_U_MIN_32_1_0_S5_S3 3 0 8160 DEPOSIT ABSOLUTE /end AXIS_DESCR
/end CHARACTERISTIC
/begin CHARACTERISTIC KF_TFCGNT67_EL "Fuellzeit" MAP 0x1C345C ZF_kf_ui8_S5_S3 2540 UMR_MSEC__10_1_0_S5_S3 0 2540
 /begin AXIS_DESCR STD_AXIS zff_atsys._.iSignale._.obj.sig_c_getr UMR_GRADC__1_1_M40_S5_S3 10 -40 150 DEPOSIT ABSOLUTE /end AXIS_DESCR
 /begin AXIS_DESCR STD_AXIS zff_atsys._.iSignale._.obj.sig_n_t8 UMR_U_MIN_32_1_0_S5_S3 3 0 8160 DEPOSIT ABSOLUTE /end AXIS_DESCR
/end CHARACTERISTIC
/begin CHARACTERISTIC KF_TFCGNT78 "Fuellzeit" MAP 0x1C37F8 ZF_kf_ui8_S5_S3 2540 UMR_MSEC__10_1_0_S5_S3 0 2540
 /begin AXIS_DESCR STD_AXIS zff_atsys._.iSignale._.obj.sig_c_getr UMR_GRADC__1_1_M40_S5_S3 10 -40 150 DEPOSIT ABSOLUTE /end AXIS_DESCR
 /begin AXIS_DESCR STD_AXIS zff_atsys._.iSignale._.obj.sig_n_t8 UMR_U_MIN_32_1_0_S5_S3 3 0 8160 DEPOSIT ABSOLUTE /end AXIS_DESCR
/end CHARACTERISTIC
/begin CHARACTERISTIC KF_TFCGNT78_EL "Fuellzeit" MAP 0x1C382C ZF_kf_ui8_S5_S3 2540 UMR_MSEC__10_1_0_S5_S3 0 2540
 /begin AXIS_DESCR STD_AXIS zff_atsys._.iSignale._.obj.sig_c_getr UMR_GRADC__1_1_M40_S5_S3 10 -40 150 DEPOSIT ABSOLUTE /end AXIS_DESCR
 /begin AXIS_DESCR STD_AXIS zff_atsys._.iSignale._.obj.sig_n_t8 UMR_U_MIN_32_1_0_S5_S3 3 0 8160 DEPOSIT ABSOLUTE /end AXIS_DESCR
/end CHARACTERISTIC
/begin CHARACTERISTIC KF_TFCGNTSP12 "Fuellzeit" MAP 0x1C3BBC ZF_kf_ui8_S5_S3 2540 UMR_MSEC__10_1_0_S5_S3 0 2540
 /begin AXIS_DESCR STD_AXIS zff_atsys._.iSignale._.obj.sig_c_getr UMR_GRADC__1_1_M40_S5_S3 10 -40 150 DEPOSIT ABSOLUTE /end AXIS_DESCR
 /begin AXIS_DESCR STD_AXIS zff_atsys._.iSignale._.obj.sig_n_t8 UMR_U_MIN_32_1_0_S5_S3 3 0 8160 DEPOSIT ABSOLUTE /end AXIS_DESCR
/end CHARACTERISTIC
/begin CHARACTERISTIC KF_TFCGNTSP23 "Fuellzeit" MAP 0x1C3E14 ZF_kf_ui8_S5_S3 2540 UMR_MSEC__10_1_0_S5_S3 0 2540
 /begin AXIS_DESCR STD_AXIS zff_atsys._.iSignale._.obj.sig_c_getr UMR_GRADC__1_1_M40_S5_S3 10 -40 150 DEPOSIT ABSOLUTE /end AXIS_DESCR
 /begin AXIS_DESCR STD_AXIS zff_atsys._.iSignale._.obj.sig_n_t8 UMR_U_MIN_32_1_0_S5_S3 3 0 8160 DEPOSIT ABSOLUTE /end AXIS_DESCR
/end CHARACTERISTIC
/begin CHARACTERISTIC KF_TFCGNTSP34 "Fuellzeit" MAP 0x1C406C ZF_kf_ui8_S5_S3 2540 UMR_MSEC__10_1_0_S5_S3 0 2540
 /begin AXIS_DESCR STD_AXIS zff_atsys._.iSignale._.obj.sig_c_getr UMR_GRADC__1_1_M40_S5_S3 10 -40 150 DEPOSIT ABSOLUTE /end AXIS_DESCR
 /begin AXIS_DESCR STD_AXIS zff_atsys._.iSignale._.obj.sig_n_t8 UMR_U_MIN_32_1_0_S5_S3 3 0 8160 DEPOSIT ABSOLUTE /end AXIS_DESCR
/end CHARACTERISTIC
/begin CHARACTERISTIC KF_TFCGNTSP45 "Fuellzeit" MAP 0x1C42C4 ZF_kf_ui8_S5_S3 2540 UMR_MSEC__10_1_0_S5_S3 0 2540
 /begin AXIS_DESCR STD_AXIS zff_atsys._.iSignale._.obj.sig_c_getr UMR_GRADC__1_1_M40_S5_S3 10 -40 150 DEPOSIT ABSOLUTE /end AXIS_DESCR
 /begin AXIS_DESCR STD_AXIS zff_atsys._.iSignale._.obj.sig_n_t8 UMR_U_MIN_32_1_0_S5_S3 3 0 8160 DEPOSIT ABSOLUTE /end AXIS_DESCR
/end CHARACTERISTIC
/begin CHARACTERISTIC KF_TFCGNTSP56 "Fuellzeit" MAP 0x1C451C ZF_kf_ui8_S5_S3 2540 UMR_MSEC__10_1_0_S5_S3 0 2540
 /begin AXIS_DESCR STD_AXIS zff_atsys._.iSignale._.obj.sig_c_getr UMR_GRADC__1_1_M40_S5_S3 10 -40 150 DEPOSIT ABSOLUTE /end AXIS_DESCR
 /begin AXIS_DESCR STD_AXIS zff_atsys._.iSignale._.obj.sig_n_t8 UMR_U_MIN_32_1_0_S5_S3 3 0 8160 DEPOSIT ABSOLUTE /end AXIS_DESCR
/end CHARACTERISTIC
/begin CHARACTERISTIC KF_TFCGNTSP67 "Fuellzeit" MAP 0x1C4774 ZF_kf_ui8_S5_S3 2540 UMR_MSEC__10_1_0_S5_S3 0 2540
 /begin AXIS_DESCR STD_AXIS zff_atsys._.iSignale._.obj.sig_c_getr UMR_GRADC__1_1_M40_S5_S3 10 -40 150 DEPOSIT ABSOLUTE /end AXIS_DESCR
 /begin AXIS_DESCR STD_AXIS zff_atsys._.iSignale._.obj.sig_n_t8 UMR_U_MIN_32_1_0_S5_S3 3 0 8160 DEPOSIT ABSOLUTE /end AXIS_DESCR
/end CHARACTERISTIC
/begin CHARACTERISTIC KF_TFCGNTSP78 "Fuellzeit" MAP 0x1C49CC ZF_kf_ui8_S5_S3 2540 UMR_MSEC__10_1_0_S5_S3 0 2540
 /begin AXIS_DESCR STD_AXIS zff_atsys._.iSignale._.obj.sig_c_getr UMR_GRADC__1_1_M40_S5_S3 10 -40 150 DEPOSIT ABSOLUTE /end AXIS_DESCR
 /begin AXIS_DESCR STD_AXIS zff_atsys._.iSignale._.obj.sig_n_t8 UMR_U_MIN_32_1_0_S5_S3 3 0 8160 DEPOSIT ABSOLUTE /end AXIS_DESCR
/end CHARACTERISTIC
/begin CHARACTERISTIC KF_TFCGNTSPORT12 "Fuellzeit" MAP 0x1C4C24 ZF_kf_ui8_S5_S3 2540 UMR_MSEC__10_1_0_S5_S3 0 2540
 /begin AXIS_DESCR STD_AXIS zff_atsys._.iSignale._.obj.sig_c_getr UMR_GRADC__1_1_M40_S5_S3 10 -40 150 DEPOSIT ABSOLUTE /end AXIS_DESCR
 /begin AXIS_DESCR STD_AXIS zff_atsys._.iSignale._.obj.sig_n_t8 UMR_U_MIN_32_1_0_S5_S3 3 0 8160 DEPOSIT ABSOLUTE /end AXIS_DESCR
/end CHARACTERISTIC
/begin CHARACTERISTIC KF_TFCGNTSPORT23 "Fuellzeit" MAP 0x1C4E7C ZF_kf_ui8_S5_S3 2540 UMR_MSEC__10_1_0_S5_S3 0 2540
 /begin AXIS_DESCR STD_AXIS zff_atsys._.iSignale._.obj.sig_c_getr UMR_GRADC__1_1_M40_S5_S3 10 -40 150 DEPOSIT ABSOLUTE /end AXIS_DESCR
 /begin AXIS_DESCR STD_AXIS zff_atsys._.iSignale._.obj.sig_n_t8 UMR_U_MIN_32_1_0_S5_S3 3 0 8160 DEPOSIT ABSOLUTE /end AXIS_DESCR
/end CHARACTERISTIC
/begin CHARACTERISTIC KF_TFCGNTSPORT34 "Fuellzeit" MAP 0x1C50D4 ZF_kf_ui8_S5_S3 2540 UMR_MSEC__10_1_0_S5_S3 0 2540
 /begin AXIS_DESCR STD_AXIS zff_atsys._.iSignale._.obj.sig_c_getr UMR_GRADC__1_1_M40_S5_S3 10 -40 150 DEPOSIT ABSOLUTE /end AXIS_DESCR
 /begin AXIS_DESCR STD_AXIS zff_atsys._.iSignale._.obj.sig_n_t8 UMR_U_MIN_32_1_0_S5_S3 3 0 8160 DEPOSIT ABSOLUTE /end AXIS_DESCR
/end CHARACTERISTIC
/begin CHARACTERISTIC KF_TFCGNTSPORT45 "Fuellzeit" MAP 0x1C532C ZF_kf_ui8_S5_S3 2540 UMR_MSEC__10_1_0_S5_S3 0 2540
 /begin AXIS_DESCR STD_AXIS zff_atsys._.iSignale._.obj.sig_c_getr UMR_GRADC__1_1_M40_S5_S3 10 -40 150 DEPOSIT ABSOLUTE /end AXIS_DESCR
 /begin AXIS_DESCR STD_AXIS zff_atsys._.iSignale._.obj.sig_n_t8 UMR_U_MIN_32_1_0_S5_S3 3 0 8160 DEPOSIT ABSOLUTE /end AXIS_DESCR
/end CHARACTERISTIC
/begin CHARACTERISTIC KF_TFCGNTSPORT56 "Fuellzeit" MAP 0x1C5584 ZF_kf_ui8_S5_S3 2540 UMR_MSEC__10_1_0_S5_S3 0 2540
 /begin AXIS_DESCR STD_AXIS zff_atsys._.iSignale._.obj.sig_c_getr UMR_GRADC__1_1_M40_S5_S3 10 -40 150 DEPOSIT ABSOLUTE /end AXIS_DESCR
 /begin AXIS_DESCR STD_AXIS zff_atsys._.iSignale._.obj.sig_n_t8 UMR_U_MIN_32_1_0_S5_S3 3 0 8160 DEPOSIT ABSOLUTE /end AXIS_DESCR
/end CHARACTERISTIC
/begin CHARACTERISTIC KF_TFCGNTSPORT67 "Fuellzeit" MAP 0x1C57DC ZF_kf_ui8_S5_S3 2540 UMR_MSEC__10_1_0_S5_S3 0 2540
 /begin AXIS_DESCR STD_AXIS zff_atsys._.iSignale._.obj.sig_c_getr UMR_GRADC__1_1_M40_S5_S3 10 -40 150 DEPOSIT ABSOLUTE /end AXIS_DESCR
 /begin AXIS_DESCR STD_AXIS zff_atsys._.iSignale._.obj.sig_n_t8 UMR_U_MIN_32_1_0_S5_S3 3 0 8160 DEPOSIT ABSOLUTE /end AXIS_DESCR
/end CHARACTERISTIC
/begin CHARACTERISTIC KF_TFCGNTSPORT78 "Fuellzeit" MAP 0x1C5A34 ZF_kf_ui8_S5_S3 2540 UMR_MSEC__10_1_0_S5_S3 0 2540
 /begin AXIS_DESCR STD_AXIS zff_atsys._.iSignale._.obj.sig_c_getr UMR_GRADC__1_1_M40_S5_S3 10 -40 150 DEPOSIT ABSOLUTE /end AXIS_DESCR
 /begin AXIS_DESCR STD_AXIS zff_atsys._.iSignale._.obj.sig_n_t8 UMR_U_MIN_32_1_0_S5_S3 3 0 8160 DEPOSIT ABSOLUTE /end AXIS_DESCR
/end CHARACTERISTIC
/begin CHARACTERISTIC KF_TRAMTCG_7 "Kennlinie Zeit 1. Rampe der zuschaltenden Kupplung" MAP 0x1C1AB0 ZF_kf_ui8_S5_S3 2540 UMR_MSEC__10_1_0_S5_S3 0 2540
 /begin AXIS_DESCR STD_AXIS zff_atsys._.iSignale._.obj.sig_m_t8 UMR_NM__6_1_M34_S5_S3 4 -204 1326 DEPOSIT ABSOLUTE /end AXIS_DESCR
 /begin AXIS_DESCR STD_AXIS zff_atsys._.iSignale._.obj.sig_c_getr UMR_GRADC__1_1_M40_S5_S3 4 -40 150 DEPOSIT ABSOLUTE /end AXIS_DESCR
/end CHARACTERISTIC
/begin CHARACTERISTIC KF_TRAMTCG_8 "Kennlinie Zeit 1. Rampe der zuschaltenden Kupplung" MAP 0x1C1FE0 ZF_kf_ui8_S5_S3 2540 UMR_MSEC__10_1_0_S5_S3 0 2540
 /begin AXIS_DESCR STD_AXIS zff_atsys._.iSignale._.obj.sig_m_t8 UMR_NM__6_1_M34_S5_S3 4 -204 1326 DEPOSIT ABSOLUTE /end AXIS_DESCR
 /begin AXIS_DESCR STD_AXIS zff_atsys._.iSignale._.obj.sig_c_getr UMR_GRADC__1_1_M40_S5_S3 4 -40 150 DEPOSIT ABSOLUTE /end AXIS_DESCR
/end CHARACTERISTIC
/begin CHARACTERISTIC KF_TRAMTCG_R "Kennlinie Zeit 1. Rampe der zuschaltenden Kupplung" MAP 0x1BF660 ZF_kf_ui8_S5_S3 2540 UMR_MSEC__10_1_0_S5_S3 0 2540
 /begin AXIS_DESCR STD_AXIS zff_atsys._.iSignale._.obj.sig_m_t8 UMR_NM__6_1_M34_S5_S3 4 -204 1326 DEPOSIT ABSOLUTE /end AXIS_DESCR
 /begin AXIS_DESCR STD_AXIS zff_atsys._.iSignale._.obj.sig_c_getr UMR_GRADC__1_1_M40_S5_S3 4 -40 150 DEPOSIT ABSOLUTE /end AXIS_DESCR
/end CHARACTERISTIC
/begin CHARACTERISTIC KF_TRAMTNT12 "Zeit 1. Rampe der zuschaltenden Kupplung" MAP 0x1C2250 ZF_kf_ui8_S5_S3 2540 UMR_MSEC__10_1_0_S5_S3 0 2540
 /begin AXIS_DESCR STD_AXIS zff_atsys._.iSignale._.obj.sig_m_t8 UMR_NM__6_1_M34_S5_S3 4 -204 1326 DEPOSIT ABSOLUTE /end AXIS_DESCR
 /begin AXIS_DESCR STD_AXIS zff_atsys._.iSignale._.obj.sig_n_t8 UMR_U_MIN_32_1_0_S5_S3 4 0 8160 DEPOSIT ABSOLUTE /end AXIS_DESCR
/end CHARACTERISTIC
/begin CHARACTERISTIC KF_TRAMTNT12_EL "Zeit 1. Rampe der zuschaltenden Kupplung" MAP 0x1C2270 ZF_kf_ui8_S5_S3 2540 UMR_MSEC__10_1_0_S5_S3 0 2540
 /begin AXIS_DESCR STD_AXIS zff_atsys._.iSignale._.obj.sig_m_t8 UMR_NM__6_1_M34_S5_S3 4 -204 1326 DEPOSIT ABSOLUTE /end AXIS_DESCR
 /begin AXIS_DESCR STD_AXIS zff_atsys._.iSignale._.obj.sig_n_t8 UMR_U_MIN_32_1_0_S5_S3 4 0 8160 DEPOSIT ABSOLUTE /end AXIS_DESCR
/end CHARACTERISTIC
/begin CHARACTERISTIC KF_TRAMTNT23 "Zeit 1. Rampe der zuschaltenden Kupplung" MAP 0x1C2620 ZF_kf_ui8_S5_S3 2540 UMR_MSEC__10_1_0_S5_S3 0 2540
 /begin AXIS_DESCR STD_AXIS zff_atsys._.iSignale._.obj.sig_m_t8 UMR_NM__6_1_M34_S5_S3 4 -204 1326 DEPOSIT ABSOLUTE /end AXIS_DESCR
 /begin AXIS_DESCR STD_AXIS zff_atsys._.iSignale._.obj.sig_n_t8 UMR_U_MIN_32_1_0_S5_S3 4 0 8160 DEPOSIT ABSOLUTE /end AXIS_DESCR
/end CHARACTERISTIC
/begin CHARACTERISTIC KF_TRAMTNT23_EL "Zeit 1. Rampe der zuschaltenden Kupplung" MAP 0x1C2640 ZF_kf_ui8_S5_S3 2540 UMR_MSEC__10_1_0_S5_S3 0 2540
 /begin AXIS_DESCR STD_AXIS zff_atsys._.iSignale._.obj.sig_m_t8 UMR_NM__6_1_M34_S5_S3 4 -204 1326 DEPOSIT ABSOLUTE /end AXIS_DESCR
 /begin AXIS_DESCR STD_AXIS zff_atsys._.iSignale._.obj.sig_n_t8 UMR_U_MIN_32_1_0_S5_S3 4 0 8160 DEPOSIT ABSOLUTE /end AXIS_DESCR
/end CHARACTERISTIC
/begin CHARACTERISTIC KF_TRAMTNT34 "Zeit 1. Rampe der zuschaltenden Kupplung" MAP 0x1C29F0 ZF_kf_ui8_S5_S3 2540 UMR_MSEC__10_1_0_S5_S3 0 2540
 /begin AXIS_DESCR STD_AXIS zff_atsys._.iSignale._.obj.sig_m_t8 UMR_NM__6_1_M34_S5_S3 4 -204 1326 DEPOSIT ABSOLUTE /end AXIS_DESCR
 /begin AXIS_DESCR STD_AXIS zff_atsys._.iSignale._.obj.sig_n_t8 UMR_U_MIN_32_1_0_S5_S3 4 0 8160 DEPOSIT ABSOLUTE /end AXIS_DESCR
/end CHARACTERISTIC
/begin CHARACTERISTIC KF_TRAMTNT34_EL "Zeit 1. Rampe der zuschaltenden Kupplung" MAP 0x1C2A10 ZF_kf_ui8_S5_S3 2540 UMR_MSEC__10_1_0_S5_S3 0 2540
 /begin AXIS_DESCR STD_AXIS zff_atsys._.iSignale._.obj.sig_m_t8 UMR_NM__6_1_M34_S5_S3 4 -204 1326 DEPOSIT ABSOLUTE /end AXIS_DESCR
 /begin AXIS_DESCR STD_AXIS zff_atsys._.iSignale._.obj.sig_n_t8 UMR_U_MIN_32_1_0_S5_S3 4 0 8160 DEPOSIT ABSOLUTE /end AXIS_DESCR
/end CHARACTERISTIC
/begin CHARACTERISTIC KF_TRAMTNT45 "Zeit 1. Rampe der zuschaltenden Kupplung" MAP 0x1C2DC0 ZF_kf_ui8_S5_S3 2540 UMR_MSEC__10_1_0_S5_S3 0 2540
 /begin AXIS_DESCR STD_AXIS zff_atsys._.iSignale._.obj.sig_m_t8 UMR_NM__6_1_M34_S5_S3 4 -204 1326 DEPOSIT ABSOLUTE /end AXIS_DESCR
 /begin AXIS_DESCR STD_AXIS zff_atsys._.iSignale._.obj.sig_n_t8 UMR_U_MIN_32_1_0_S5_S3 4 0 8160 DEPOSIT ABSOLUTE /end AXIS_DESCR
/end CHARACTERISTIC
/begin CHARACTERISTIC KF_TRAMTNT45_EL "Zeit 1. Rampe der zuschaltenden Kupplung" MAP 0x1C2DE0 ZF_kf_ui8_S5_S3 2540 UMR_MSEC__10_1_0_S5_S3 0 2540
 /begin AXIS_DESCR STD_AXIS zff_atsys._.iSignale._.obj.sig_m_t8 UMR_NM__6_1_M34_S5_S3 4 -204 1326 DEPOSIT ABSOLUTE /end AXIS_DESCR
 /begin AXIS_DESCR STD_AXIS zff_atsys._.iSignale._.obj.sig_n_t8 UMR_U_MIN_32_1_0_S5_S3 4 0 8160 DEPOSIT ABSOLUTE /end AXIS_DESCR
/end CHARACTERISTIC
/begin CHARACTERISTIC KF_TRAMTNT56 "Zeit 1. Rampe der zuschaltenden Kupplung" MAP 0x1C3190 ZF_kf_ui8_S5_S3 2540 UMR_MSEC__10_1_0_S5_S3 0 2540
 /begin AXIS_DESCR STD_AXIS zff_atsys._.iSignale._.obj.sig_m_t8 UMR_NM__6_1_M34_S5_S3 4 -204 1326 DEPOSIT ABSOLUTE /end AXIS_DESCR
 /begin AXIS_DESCR STD_AXIS zff_atsys._.iSignale._.obj.sig_n_t8 UMR_U_MIN_32_1_0_S5_S3 4 0 8160 DEPOSIT ABSOLUTE /end AXIS_DESCR
/end CHARACTERISTIC
/begin CHARACTERISTIC KF_TRAMTNT56_EL "Zeit 1. Rampe der zuschaltenden Kupplung" MAP 0x1C31B0 ZF_kf_ui8_S5_S3 2540 UMR_MSEC__10_1_0_S5_S3 0 2540
 /begin AXIS_DESCR STD_AXIS zff_atsys._.iSignale._.obj.sig_m_t8 UMR_NM__6_1_M34_S5_S3 4 -204 1326 DEPOSIT ABSOLUTE /end AXIS_DESCR
 /begin AXIS_DESCR STD_AXIS zff_atsys._.iSignale._.obj.sig_n_t8 UMR_U_MIN_32_1_0_S5_S3 4 0 8160 DEPOSIT ABSOLUTE /end AXIS_DESCR
/end CHARACTERISTIC
/begin CHARACTERISTIC KF_TRAMTNT67 "Zeit 1. Rampe der zuschaltenden Kupplung" MAP 0x1C3560 ZF_kf_ui8_S5_S3 2540 UMR_MSEC__10_1_0_S5_S3 0 2540
 /begin AXIS_DESCR STD_AXIS zff_atsys._.iSignale._.obj.sig_m_t8 UMR_NM__6_1_M34_S5_S3 4 -204 1326 DEPOSIT ABSOLUTE /end AXIS_DESCR
 /begin AXIS_DESCR STD_AXIS zff_atsys._.iSignale._.obj.sig_n_t8 UMR_U_MIN_32_1_0_S5_S3 4 0 8160 DEPOSIT ABSOLUTE /end AXIS_DESCR
/end CHARACTERISTIC
/begin CHARACTERISTIC KF_TRAMTNT67_EL "Zeit 1. Rampe der zuschaltenden Kupplung" MAP 0x1C3580 ZF_kf_ui8_S5_S3 2540 UMR_MSEC__10_1_0_S5_S3 0 2540
 /begin AXIS_DESCR STD_AXIS zff_atsys._.iSignale._.obj.sig_m_t8 UMR_NM__6_1_M34_S5_S3 4 -204 1326 DEPOSIT ABSOLUTE /end AXIS_DESCR
 /begin AXIS_DESCR STD_AXIS zff_atsys._.iSignale._.obj.sig_n_t8 UMR_U_MIN_32_1_0_S5_S3 4 0 8160 DEPOSIT ABSOLUTE /end AXIS_DESCR
/end CHARACTERISTIC
/begin CHARACTERISTIC KF_TRAMTNT78 "Zeit 1. Rampe der zuschaltenden Kupplung" MAP 0x1C3930 ZF_kf_ui8_S5_S3 2540 UMR_MSEC__10_1_0_S5_S3 0 2540
 /begin AXIS_DESCR STD_AXIS zff_atsys._.iSignale._.obj.sig_m_t8 UMR_NM__6_1_M34_S5_S3 4 -204 1326 DEPOSIT ABSOLUTE /end AXIS_DESCR
 /begin AXIS_DESCR STD_AXIS zff_atsys._.iSignale._.obj.sig_n_t8 UMR_U_MIN_32_1_0_S5_S3 4 0 8160 DEPOSIT ABSOLUTE /end AXIS_DESCR
/end CHARACTERISTIC
/begin CHARACTERISTIC KF_TRAMTNT78_EL "Zeit 1. Rampe der zuschaltenden Kupplung" MAP 0x1C3950 ZF_kf_ui8_S5_S3 2540 UMR_MSEC__10_1_0_S5_S3 0 2540
 /begin AXIS_DESCR STD_AXIS zff_atsys._.iSignale._.obj.sig_m_t8 UMR_NM__6_1_M34_S5_S3 4 -204 1326 DEPOSIT ABSOLUTE /end AXIS_DESCR
 /begin AXIS_DESCR STD_AXIS zff_atsys._.iSignale._.obj.sig_n_t8 UMR_U_MIN_32_1_0_S5_S3 4 0 8160 DEPOSIT ABSOLUTE /end AXIS_DESCR
/end CHARACTERISTIC
/begin CHARACTERISTIC KF_TRAMTNTFUELLOPT12 "Zeit 1. Rampe der zuschaltenden Kupplung" MAP 0x1C5DE8 ZF_kf_ui8_S5_S3 2540 UMR_MSEC__10_1_0_S5_S3 0 2540
 /begin AXIS_DESCR STD_AXIS zff_atsys._.iSignale._.obj.sig_m_t8 UMR_NM__6_1_M34_S5_S3 4 -204 1326 DEPOSIT ABSOLUTE /end AXIS_DESCR
 /begin AXIS_DESCR STD_AXIS zff_atsys._.iSignale._.obj.sig_n_t8 UMR_U_MIN_32_1_0_S5_S3 4 0 8160 DEPOSIT ABSOLUTE /end AXIS_DESCR
/end CHARACTERISTIC
/begin CHARACTERISTIC KF_TRAMTNTFUELLOPT23 "Zeit 1. Rampe der zuschaltenden Kupplung" MAP 0x1C5FC0 ZF_kf_ui8_S5_S3 2540 UMR_MSEC__10_1_0_S5_S3 0 2540
 /begin AXIS_DESCR STD_AXIS zff_atsys._.iSignale._.obj.sig_m_t8 UMR_NM__6_1_M34_S5_S3 4 -204 1326 DEPOSIT ABSOLUTE /end AXIS_DESCR
 /begin AXIS_DESCR STD_AXIS zff_atsys._.iSignale._.obj.sig_n_t8 UMR_U_MIN_32_1_0_S5_S3 4 0 8160 DEPOSIT ABSOLUTE /end AXIS_DESCR
/end CHARACTERISTIC
/begin CHARACTERISTIC KF_TRAMTNTFUELLOPT34 "Zeit 1. Rampe der zuschaltenden Kupplung" MAP 0x1C6198 ZF_kf_ui8_S5_S3 2540 UMR_MSEC__10_1_0_S5_S3 0 2540
 /begin AXIS_DESCR STD_AXIS zff_atsys._.iSignale._.obj.sig_m_t8 UMR_NM__6_1_M34_S5_S3 4 -204 1326 DEPOSIT ABSOLUTE /end AXIS_DESCR
 /begin AXIS_DESCR STD_AXIS zff_atsys._.iSignale._.obj.sig_n_t8 UMR_U_MIN_32_1_0_S5_S3 4 0 8160 DEPOSIT ABSOLUTE /end AXIS_DESCR
/end CHARACTERISTIC
/begin CHARACTERISTIC KF_TRAMTNTFUELLOPT45 "Zeit 1. Rampe der zuschaltenden Kupplung" MAP 0x1C6370 ZF_kf_ui8_S5_S3 2540 UMR_MSEC__10_1_0_S5_S3 0 2540
 /begin AXIS_DESCR STD_AXIS zff_atsys._.iSignale._.obj.sig_m_t8 UMR_NM__6_1_M34_S5_S3 4 -204 1326 DEPOSIT ABSOLUTE /end AXIS_DESCR
 /begin AXIS_DESCR STD_AXIS zff_atsys._.iSignale._.obj.sig_n_t8 UMR_U_MIN_32_1_0_S5_S3 4 0 8160 DEPOSIT ABSOLUTE /end AXIS_DESCR
/end CHARACTERISTIC
/begin CHARACTERISTIC KF_TRAMTNTFUELLOPT56 "Zeit 1. Rampe der zuschaltenden Kupplung" MAP 0x1C6548 ZF_kf_ui8_S5_S3 2540 UMR_MSEC__10_1_0_S5_S3 0 2540
 /begin AXIS_DESCR STD_AXIS zff_atsys._.iSignale._.obj.sig_m_t8 UMR_NM__6_1_M34_S5_S3 4 -204 1326 DEPOSIT ABSOLUTE /end AXIS_DESCR
 /begin AXIS_DESCR STD_AXIS zff_atsys._.iSignale._.obj.sig_n_t8 UMR_U_MIN_32_1_0_S5_S3 4 0 8160 DEPOSIT ABSOLUTE /end AXIS_DESCR
/end CHARACTERISTIC
/begin CHARACTERISTIC KF_TRAMTNTFUELLOPT67 "Zeit 1. Rampe der zuschaltenden Kupplung" MAP 0x1C6720 ZF_kf_ui8_S5_S3 2540 UMR_MSEC__10_1_0_S5_S3 0 2540
 /begin AXIS_DESCR STD_AXIS zff_atsys._.iSignale._.obj.sig_m_t8 UMR_NM__6_1_M34_S5_S3 4 -204 1326 DEPOSIT ABSOLUTE /end AXIS_DESCR
 /begin AXIS_DESCR STD_AXIS zff_atsys._.iSignale._.obj.sig_n_t8 UMR_U_MIN_32_1_0_S5_S3 4 0 8160 DEPOSIT ABSOLUTE /end AXIS_DESCR
/end CHARACTERISTIC
/begin CHARACTERISTIC KF_TRAMTNTFUELLOPT78 "Zeit 1. Rampe der zuschaltenden Kupplung" MAP 0x1C68F8 ZF_kf_ui8_S5_S3 2540 UMR_MSEC__10_1_0_S5_S3 0 2540
 /begin AXIS_DESCR STD_AXIS zff_atsys._.iSignale._.obj.sig_m_t8 UMR_NM__6_1_M34_S5_S3 4 -204 1326 DEPOSIT ABSOLUTE /end AXIS_DESCR
 /begin AXIS_DESCR STD_AXIS zff_atsys._.iSignale._.obj.sig_n_t8 UMR_U_MIN_32_1_0_S5_S3 4 0 8160 DEPOSIT ABSOLUTE /end AXIS_DESCR
/end CHARACTERISTIC
/begin CHARACTERISTIC KF_TRAMTNTSP12 "Zeit 1. Rampe der zuschaltenden Kupplung" MAP 0x1C3C74 ZF_kf_ui8_S5_S3 2540 UMR_MSEC__10_1_0_S5_S3 0 2540
 /begin AXIS_DESCR STD_AXIS zff_atsys._.iSignale._.obj.sig_m_t8 UMR_NM__6_1_M34_S5_S3 4 -204 1326 DEPOSIT ABSOLUTE /end AXIS_DESCR
 /begin AXIS_DESCR STD_AXIS zff_atsys._.iSignale._.obj.sig_n_t8 UMR_U_MIN_32_1_0_S5_S3 4 0 8160 DEPOSIT ABSOLUTE /end AXIS_DESCR
/end CHARACTERISTIC
/begin CHARACTERISTIC KF_TRAMTNTSP23 "Zeit 1. Rampe der zuschaltenden Kupplung" MAP 0x1C3ECC ZF_kf_ui8_S5_S3 2540 UMR_MSEC__10_1_0_S5_S3 0 2540
 /begin AXIS_DESCR STD_AXIS zff_atsys._.iSignale._.obj.sig_m_t8 UMR_NM__6_1_M34_S5_S3 4 -204 1326 DEPOSIT ABSOLUTE /end AXIS_DESCR
 /begin AXIS_DESCR STD_AXIS zff_atsys._.iSignale._.obj.sig_n_t8 UMR_U_MIN_32_1_0_S5_S3 4 0 8160 DEPOSIT ABSOLUTE /end AXIS_DESCR
/end CHARACTERISTIC
/begin CHARACTERISTIC KF_TRAMTNTSP34 "Zeit 1. Rampe der zuschaltenden Kupplung" MAP 0x1C4124 ZF_kf_ui8_S5_S3 2540 UMR_MSEC__10_1_0_S5_S3 0 2540
 /begin AXIS_DESCR STD_AXIS zff_atsys._.iSignale._.obj.sig_m_t8 UMR_NM__6_1_M34_S5_S3 4 -204 1326 DEPOSIT ABSOLUTE /end AXIS_DESCR
 /begin AXIS_DESCR STD_AXIS zff_atsys._.iSignale._.obj.sig_n_t8 UMR_U_MIN_32_1_0_S5_S3 4 0 8160 DEPOSIT ABSOLUTE /end AXIS_DESCR
/end CHARACTERISTIC
/begin CHARACTERISTIC KF_TRAMTNTSP45 "Zeit 1. Rampe der zuschaltenden Kupplung" MAP 0x1C437C ZF_kf_ui8_S5_S3 2540 UMR_MSEC__10_1_0_S5_S3 0 2540
 /begin AXIS_DESCR STD_AXIS zff_atsys._.iSignale._.obj.sig_m_t8 UMR_NM__6_1_M34_S5_S3 4 -204 1326 DEPOSIT ABSOLUTE /end AXIS_DESCR
 /begin AXIS_DESCR STD_AXIS zff_atsys._.iSignale._.obj.sig_n_t8 UMR_U_MIN_32_1_0_S5_S3 4 0 8160 DEPOSIT ABSOLUTE /end AXIS_DESCR
/end CHARACTERISTIC
/begin CHARACTERISTIC KF_TRAMTNTSP56 "Zeit 1. Rampe der zuschaltenden Kupplung" MAP 0x1C45D4 ZF_kf_ui8_S5_S3 2540 UMR_MSEC__10_1_0_S5_S3 0 2540
 /begin AXIS_DESCR STD_AXIS zff_atsys._.iSignale._.obj.sig_m_t8 UMR_NM__6_1_M34_S5_S3 4 -204 1326 DEPOSIT ABSOLUTE /end AXIS_DESCR
 /begin AXIS_DESCR STD_AXIS zff_atsys._.iSignale._.obj.sig_n_t8 UMR_U_MIN_32_1_0_S5_S3 4 0 8160 DEPOSIT ABSOLUTE /end AXIS_DESCR
/end CHARACTERISTIC
/begin CHARACTERISTIC KF_TRAMTNTSP67 "Zeit 1. Rampe der zuschaltenden Kupplung" MAP 0x1C482C ZF_kf_ui8_S5_S3 2540 UMR_MSEC__10_1_0_S5_S3 0 2540
 /begin AXIS_DESCR STD_AXIS zff_atsys._.iSignale._.obj.sig_m_t8 UMR_NM__6_1_M34_S5_S3 4 -204 1326 DEPOSIT ABSOLUTE /end AXIS_DESCR
 /begin AXIS_DESCR STD_AXIS zff_atsys._.iSignale._.obj.sig_n_t8 UMR_U_MIN_32_1_0_S5_S3 4 0 8160 DEPOSIT ABSOLUTE /end AXIS_DESCR
/end CHARACTERISTIC
/begin CHARACTERISTIC KF_TRAMTNTSP78 "Zeit 1. Rampe der zuschaltenden Kupplung" MAP 0x1C4A84 ZF_kf_ui8_S5_S3 2540 UMR_MSEC__10_1_0_S5_S3 0 2540
 /begin AXIS_DESCR STD_AXIS zff_atsys._.iSignale._.obj.sig_m_t8 UMR_NM__6_1_M34_S5_S3 4 -204 1326 DEPOSIT ABSOLUTE /end AXIS_DESCR
 /begin AXIS_DESCR STD_AXIS zff_atsys._.iSignale._.obj.sig_n_t8 UMR_U_MIN_32_1_0_S5_S3 4 0 8160 DEPOSIT ABSOLUTE /end AXIS_DESCR
/end CHARACTERISTIC
/begin CHARACTERISTIC KF_TRAMTNTSPORT12 "Zeit 1. Rampe der zuschaltenden Kupplung" MAP 0x1C4CDC ZF_kf_ui8_S5_S3 2540 UMR_MSEC__10_1_0_S5_S3 0 2540
 /begin AXIS_DESCR STD_AXIS zff_atsys._.iSignale._.obj.sig_m_t8 UMR_NM__6_1_M34_S5_S3 4 -204 1326 DEPOSIT ABSOLUTE /end AXIS_DESCR
 /begin AXIS_DESCR STD_AXIS zff_atsys._.iSignale._.obj.sig_n_t8 UMR_U_MIN_32_1_0_S5_S3 4 0 8160 DEPOSIT ABSOLUTE /end AXIS_DESCR
/end CHARACTERISTIC
/begin CHARACTERISTIC KF_TRAMTNTSPORT23 "Zeit 1. Rampe der zuschaltenden Kupplung" MAP 0x1C4F34 ZF_kf_ui8_S5_S3 2540 UMR_MSEC__10_1_0_S5_S3 0 2540
 /begin AXIS_DESCR STD_AXIS zff_atsys._.iSignale._.obj.sig_m_t8 UMR_NM__6_1_M34_S5_S3 4 -204 1326 DEPOSIT ABSOLUTE /end AXIS_DESCR
 /begin AXIS_DESCR STD_AXIS zff_atsys._.iSignale._.obj.sig_n_t8 UMR_U_MIN_32_1_0_S5_S3 4 0 8160 DEPOSIT ABSOLUTE /end AXIS_DESCR
/end CHARACTERISTIC
/begin CHARACTERISTIC KF_TRAMTNTSPORT34 "Zeit 1. Rampe der zuschaltenden Kupplung" MAP 0x1C518C ZF_kf_ui8_S5_S3 2540 UMR_MSEC__10_1_0_S5_S3 0 2540
 /begin AXIS_DESCR STD_AXIS zff_atsys._.iSignale._.obj.sig_m_t8 UMR_NM__6_1_M34_S5_S3 4 -204 1326 DEPOSIT ABSOLUTE /end AXIS_DESCR
 /begin AXIS_DESCR STD_AXIS zff_atsys._.iSignale._.obj.sig_n_t8 UMR_U_MIN_32_1_0_S5_S3 4 0 8160 DEPOSIT ABSOLUTE /end AXIS_DESCR
/end CHARACTERISTIC
/begin CHARACTERISTIC KF_TRAMTNTSPORT45 "Zeit 1. Rampe der zuschaltenden Kupplung" MAP 0x1C53E4 ZF_kf_ui8_S5_S3 2540 UMR_MSEC__10_1_0_S5_S3 0 2540
 /begin AXIS_DESCR STD_AXIS zff_atsys._.iSignale._.obj.sig_m_t8 UMR_NM__6_1_M34_S5_S3 4 -204 1326 DEPOSIT ABSOLUTE /end AXIS_DESCR
 /begin AXIS_DESCR STD_AXIS zff_atsys._.iSignale._.obj.sig_n_t8 UMR_U_MIN_32_1_0_S5_S3 4 0 8160 DEPOSIT ABSOLUTE /end AXIS_DESCR
/end CHARACTERISTIC
/begin CHARACTERISTIC KF_TRAMTNTSPORT56 "Zeit 1. Rampe der zuschaltenden Kupplung" MAP 0x1C563C ZF_kf_ui8_S5_S3 2540 UMR_MSEC__10_1_0_S5_S3 0 2540
 /begin AXIS_DESCR STD_AXIS zff_atsys._.iSignale._.obj.sig_m_t8 UMR_NM__6_1_M34_S5_S3 4 -204 1326 DEPOSIT ABSOLUTE /end AXIS_DESCR
 /begin AXIS_DESCR STD_AXIS zff_atsys._.iSignale._.obj.sig_n_t8 UMR_U_MIN_32_1_0_S5_S3 4 0 8160 DEPOSIT ABSOLUTE /end AXIS_DESCR
/end CHARACTERISTIC
/begin CHARACTERISTIC KF_TRAMTNTSPORT67 "Zeit 1. Rampe der zuschaltenden Kupplung" MAP 0x1C5894 ZF_kf_ui8_S5_S3 2540 UMR_MSEC__10_1_0_S5_S3 0 2540
 /begin AXIS_DESCR STD_AXIS zff_atsys._.iSignale._.obj.sig_m_t8 UMR_NM__6_1_M34_S5_S3 4 -204 1326 DEPOSIT ABSOLUTE /end AXIS_DESCR
 /begin AXIS_DESCR STD_AXIS zff_atsys._.iSignale._.obj.sig_n_t8 UMR_U_MIN_32_1_0_S5_S3 4 0 8160 DEPOSIT ABSOLUTE /end AXIS_DESCR
/end CHARACTERISTIC
/begin CHARACTERISTIC KF_TRAMTNTSPORT78 "Zeit 1. Rampe der zuschaltenden Kupplung" MAP 0x1C5AEC ZF_kf_ui8_S5_S3 2540 UMR_MSEC__10_1_0_S5_S3 0 2540
 /begin AXIS_DESCR STD_AXIS zff_atsys._.iSignale._.obj.sig_m_t8 UMR_NM__6_1_M34_S5_S3 4 -204 1326 DEPOSIT ABSOLUTE /end AXIS_DESCR
 /begin AXIS_DESCR STD_AXIS zff_atsys._.iSignale._.obj.sig_n_t8 UMR_U_MIN_32_1_0_S5_S3 4 0 8160 DEPOSIT ABSOLUTE /end AXIS_DESCR
/end CHARACTERISTIC
/begin CHARACTERISTIC KF_TSYN_DT_IG_CHANGE21 "Kennfeld für T_SYN-Vorhalt für Übergabe Synchronrampenzeit" MAP 0x1C6BDC ZF_kf_si16_S5_S3 2540 UMR_MSEC__10_1_0_S5_S3 0 2540
 /begin AXIS_DESCR STD_AXIS zff_atsys._.iSignale._.obj.sig_n_t UMR_U_MIN_1_1_0_S5_S3 4 0 8160 DEPOSIT ABSOLUTE /end AXIS_DESCR
 /begin AXIS_DESCR STD_AXIS zff_atsys._.iSignale._.obj.sig_m_t UMR_NM__1_1_0_S5_S3 4 -200 1300 DEPOSIT ABSOLUTE /end AXIS_DESCR
/end CHARACTERISTIC
/begin CHARACTERISTIC KF_T_DT_IG_CHANGE12 "Kennfeld Zeitvorhalt für Übergabe Rampenzeit auf Schaltdruck" MAP 0x1C2218 ZF_kf_si16_S5_S3 2540 UMR_MSEC__10_1_0_S5_S3 0 2540
 /begin AXIS_DESCR STD_AXIS zff_atsys._.iSignale._.obj.sig_n_t UMR_U_MIN_1_1_0_S5_S3 4 0 8160 DEPOSIT ABSOLUTE /end AXIS_DESCR
 /begin AXIS_DESCR STD_AXIS zff_atsys._.iSignale._.obj.sig_m_t UMR_NM__1_1_0_S5_S3 4 -200 1300 DEPOSIT ABSOLUTE /end AXIS_DESCR
/end CHARACTERISTIC
/begin CHARACTERISTIC KF_T_DT_IG_CHANGE23 "Kennfeld Zeitvorhalt für Übergabe Rampenzeit auf Schaltdruck" MAP 0x1C25E8 ZF_kf_si16_S5_S3 2540 UMR_MSEC__10_1_0_S5_S3 0 2540
 /begin AXIS_DESCR STD_AXIS zff_atsys._.iSignale._.obj.sig_n_t UMR_U_MIN_1_1_0_S5_S3 4 0 8160 DEPOSIT ABSOLUTE /end AXIS_DESCR
 /begin AXIS_DESCR STD_AXIS zff_atsys._.iSignale._.obj.sig_m_t UMR_NM__1_1_0_S5_S3 4 -200 1300 DEPOSIT ABSOLUTE /end AXIS_DESCR
/end CHARACTERISTIC
/begin CHARACTERISTIC KF_T_DT_IG_CHANGE34 "Kennfeld Zeitvorhalt für Übergabe Rampenzeit auf Schaltdruck" MAP 0x1C29B8 ZF_kf_si16_S5_S3 2540 UMR_MSEC__10_1_0_S5_S3 0 2540
 /begin AXIS_DESCR STD_AXIS zff_atsys._.iSignale._.obj.sig_n_t UMR_U_MIN_1_1_0_S5_S3 4 0 8160 DEPOSIT ABSOLUTE /end AXIS_DESCR
 /begin AXIS_DESCR STD_AXIS zff_atsys._.iSignale._.obj.sig_m_t UMR_NM__1_1_0_S5_S3 4 -200 1300 DEPOSIT ABSOLUTE /end AXIS_DESCR
/end CHARACTERISTIC
/begin CHARACTERISTIC KF_T_DT_IG_CHANGE45 "Kennfeld Zeitvorhalt für Übergabe Rampenzeit auf Schaltdruck" MAP 0x1C2D88 ZF_kf_si16_S5_S3 2540 UMR_MSEC__10_1_0_S5_S3 0 2540
 /begin AXIS_DESCR STD_AXIS zff_atsys._.iSignale._.obj.sig_n_t UMR_U_MIN_1_1_0_S5_S3 4 0 8160 DEPOSIT ABSOLUTE /end AXIS_DESCR
 /begin AXIS_DESCR STD_AXIS zff_atsys._.iSignale._.obj.sig_m_t UMR_NM__1_1_0_S5_S3 4 -200 1300 DEPOSIT ABSOLUTE /end AXIS_DESCR
/end CHARACTERISTIC
/begin CHARACTERISTIC KF_T_DT_IG_CHANGE56 "Kennfeld Zeitvorhalt für Übergabe Rampenzeit auf Schaltdruck" MAP 0x1C3158 ZF_kf_si16_S5_S3 2540 UMR_MSEC__10_1_0_S5_S3 0 2540
 /begin AXIS_DESCR STD_AXIS zff_atsys._.iSignale._.obj.sig_n_t UMR_U_MIN_1_1_0_S5_S3 4 0 8160 DEPOSIT ABSOLUTE /end AXIS_DESCR
 /begin AXIS_DESCR STD_AXIS zff_atsys._.iSignale._.obj.sig_m_t UMR_NM__1_1_0_S5_S3 4 -200 1300 DEPOSIT ABSOLUTE /end AXIS_DESCR
/end CHARACTERISTIC
/begin CHARACTERISTIC KF_T_DT_IG_CHANGE67 "Kennfeld Zeitvorhalt für Übergabe Rampenzeit auf Schaltdruck" MAP 0x1C3528 ZF_kf_si16_S5_S3 2540 UMR_MSEC__10_1_0_S5_S3 0 2540
 /begin AXIS_DESCR STD_AXIS zff_atsys._.iSignale._.obj.sig_n_t UMR_U_MIN_1_1_0_S5_S3 4 0 8160 DEPOSIT ABSOLUTE /end AXIS_DESCR
 /begin AXIS_DESCR STD_AXIS zff_atsys._.iSignale._.obj.sig_m_t UMR_NM__1_1_0_S5_S3 4 -200 1300 DEPOSIT ABSOLUTE /end AXIS_DESCR
/end CHARACTERISTIC
/begin CHARACTERISTIC KF_T_DT_IG_CHANGE78 "Kennfeld Zeitvorhalt für Übergabe Rampenzeit auf Schaltdruck" MAP 0x1C38F8 ZF_kf_si16_S5_S3 2540 UMR_MSEC__10_1_0_S5_S3 0 2540
 /begin AXIS_DESCR STD_AXIS zff_atsys._.iSignale._.obj.sig_n_t UMR_U_MIN_1_1_0_S5_S3 4 0 8160 DEPOSIT ABSOLUTE /end AXIS_DESCR
 /begin AXIS_DESCR STD_AXIS zff_atsys._.iSignale._.obj.sig_m_t UMR_NM__1_1_0_S5_S3 4 -200 1300 DEPOSIT ABSOLUTE /end AXIS_DESCR
/end CHARACTERISTIC
/begin CHARACTERISTIC KF_T_DT_IG_CHANGESP12 "Kennfeld Zeitvorhalt für Übergabe Rampenzeit auf Schaltdruck" MAP 0x1C3C3C ZF_kf_si16_S5_S3 2540 UMR_MSEC__10_1_0_S5_S3 0 2540
 /begin AXIS_DESCR STD_AXIS zff_atsys._.iSignale._.obj.sig_n_t UMR_U_MIN_1_1_0_S5_S3 4 0 8160 DEPOSIT ABSOLUTE /end AXIS_DESCR
 /begin AXIS_DESCR STD_AXIS zff_atsys._.iSignale._.obj.sig_m_t UMR_NM__1_1_0_S5_S3 4 -200 1300 DEPOSIT ABSOLUTE /end AXIS_DESCR
/end CHARACTERISTIC
/begin CHARACTERISTIC KF_T_DT_IG_CHANGESP23 "Kennfeld Zeitvorhalt für Übergabe Rampenzeit auf Schaltdruck" MAP 0x1C3E94 ZF_kf_si16_S5_S3 2540 UMR_MSEC__10_1_0_S5_S3 0 2540
 /begin AXIS_DESCR STD_AXIS zff_atsys._.iSignale._.obj.sig_n_t UMR_U_MIN_1_1_0_S5_S3 4 0 8160 DEPOSIT ABSOLUTE /end AXIS_DESCR
 /begin AXIS_DESCR STD_AXIS zff_atsys._.iSignale._.obj.sig_m_t UMR_NM__1_1_0_S5_S3 4 -200 1300 DEPOSIT ABSOLUTE /end AXIS_DESCR
/end CHARACTERISTIC
/begin CHARACTERISTIC KF_T_DT_IG_CHANGESP34 "Kennfeld Zeitvorhalt für Übergabe Rampenzeit auf Schaltdruck" MAP 0x1C40EC ZF_kf_si16_S5_S3 2540 UMR_MSEC__10_1_0_S5_S3 0 2540
 /begin AXIS_DESCR STD_AXIS zff_atsys._.iSignale._.obj.sig_n_t UMR_U_MIN_1_1_0_S5_S3 4 0 8160 DEPOSIT ABSOLUTE /end AXIS_DESCR
 /begin AXIS_DESCR STD_AXIS zff_atsys._.iSignale._.obj.sig_m_t UMR_NM__1_1_0_S5_S3 4 -200 1300 DEPOSIT ABSOLUTE /end AXIS_DESCR
/end CHARACTERISTIC
/begin CHARACTERISTIC KF_T_DT_IG_CHANGESP45 "Kennfeld Zeitvorhalt für Übergabe Rampenzeit auf Schaltdruck" MAP 0x1C4344 ZF_kf_si16_S5_S3 2540 UMR_MSEC__10_1_0_S5_S3 0 2540
 /begin AXIS_DESCR STD_AXIS zff_atsys._.iSignale._.obj.sig_n_t UMR_U_MIN_1_1_0_S5_S3 4 0 8160 DEPOSIT ABSOLUTE /end AXIS_DESCR
 /begin AXIS_DESCR STD_AXIS zff_atsys._.iSignale._.obj.sig_m_t UMR_NM__1_1_0_S5_S3 4 -200 1300 DEPOSIT ABSOLUTE /end AXIS_DESCR
/end CHARACTERISTIC
/begin CHARACTERISTIC KF_T_DT_IG_CHANGESP56 "Kennfeld Zeitvorhalt für Übergabe Rampenzeit auf Schaltdruck" MAP 0x1C459C ZF_kf_si16_S5_S3 2540 UMR_MSEC__10_1_0_S5_S3 0 2540
 /begin AXIS_DESCR STD_AXIS zff_atsys._.iSignale._.obj.sig_n_t UMR_U_MIN_1_1_0_S5_S3 4 0 8160 DEPOSIT ABSOLUTE /end AXIS_DESCR
 /begin AXIS_DESCR STD_AXIS zff_atsys._.iSignale._.obj.sig_m_t UMR_NM__1_1_0_S5_S3 4 -200 1300 DEPOSIT ABSOLUTE /end AXIS_DESCR
/end CHARACTERISTIC
/begin CHARACTERISTIC KF_T_DT_IG_CHANGESP67 "Kennfeld Zeitvorhalt für Übergabe Rampenzeit auf Schaltdruck" MAP 0x1C47F4 ZF_kf_si16_S5_S3 2540 UMR_MSEC__10_1_0_S5_S3 0 2540
 /begin AXIS_DESCR STD_AXIS zff_atsys._.iSignale._.obj.sig_n_t UMR_U_MIN_1_1_0_S5_S3 4 0 8160 DEPOSIT ABSOLUTE /end AXIS_DESCR
 /begin AXIS_DESCR STD_AXIS zff_atsys._.iSignale._.obj.sig_m_t UMR_NM__1_1_0_S5_S3 4 -200 1300 DEPOSIT ABSOLUTE /end AXIS_DESCR
/end CHARACTERISTIC
/begin CHARACTERISTIC KF_T_DT_IG_CHANGESP78 "Kennfeld Zeitvorhalt für Übergabe Rampenzeit auf Schaltdruck" MAP 0x1C4A4C ZF_kf_si16_S5_S3 2540 UMR_MSEC__10_1_0_S5_S3 0 2540
 /begin AXIS_DESCR STD_AXIS zff_atsys._.iSignale._.obj.sig_n_t UMR_U_MIN_1_1_0_S5_S3 4 0 8160 DEPOSIT ABSOLUTE /end AXIS_DESCR
 /begin AXIS_DESCR STD_AXIS zff_atsys._.iSignale._.obj.sig_m_t UMR_NM__1_1_0_S5_S3 4 -200 1300 DEPOSIT ABSOLUTE /end AXIS_DESCR
/end CHARACTERISTIC
/begin CHARACTERISTIC KF_T_DT_IG_CHANGESPORT12 "Kennfeld Zeitvorhalt für Übergabe Rampenzeit auf Schaltdruck" MAP 0x1C4CA4 ZF_kf_si16_S5_S3 2540 UMR_MSEC__10_1_0_S5_S3 0 2540
 /begin AXIS_DESCR STD_AXIS zff_atsys._.iSignale._.obj.sig_n_t UMR_U_MIN_1_1_0_S5_S3 4 0 8160 DEPOSIT ABSOLUTE /end AXIS_DESCR
 /begin AXIS_DESCR STD_AXIS zff_atsys._.iSignale._.obj.sig_m_t UMR_NM__1_1_0_S5_S3 4 -200 1300 DEPOSIT ABSOLUTE /end AXIS_DESCR
/end CHARACTERISTIC
/begin CHARACTERISTIC KF_T_DT_IG_CHANGESPORT23 "Kennfeld Zeitvorhalt für Übergabe Rampenzeit auf Schaltdruck" MAP 0x1C4EFC ZF_kf_si16_S5_S3 2540 UMR_MSEC__10_1_0_S5_S3 0 2540
 /begin AXIS_DESCR STD_AXIS zff_atsys._.iSignale._.obj.sig_n_t UMR_U_MIN_1_1_0_S5_S3 4 0 8160 DEPOSIT ABSOLUTE /end AXIS_DESCR
 /begin AXIS_DESCR STD_AXIS zff_atsys._.iSignale._.obj.sig_m_t UMR_NM__1_1_0_S5_S3 4 -200 1300 DEPOSIT ABSOLUTE /end AXIS_DESCR
/end CHARACTERISTIC
/begin CHARACTERISTIC KF_T_DT_IG_CHANGESPORT34 "Kennfeld Zeitvorhalt für Übergabe Rampenzeit auf Schaltdruck" MAP 0x1C5154 ZF_kf_si16_S5_S3 2540 UMR_MSEC__10_1_0_S5_S3 0 2540
 /begin AXIS_DESCR STD_AXIS zff_atsys._.iSignale._.obj.sig_n_t UMR_U_MIN_1_1_0_S5_S3 4 0 8160 DEPOSIT ABSOLUTE /end AXIS_DESCR
 /begin AXIS_DESCR STD_AXIS zff_atsys._.iSignale._.obj.sig_m_t UMR_NM__1_1_0_S5_S3 4 -200 1300 DEPOSIT ABSOLUTE /end AXIS_DESCR
/end CHARACTERISTIC
/begin CHARACTERISTIC KF_T_DT_IG_CHANGESPORT45 "Kennfeld Zeitvorhalt für Übergabe Rampenzeit auf Schaltdruck" MAP 0x1C53AC ZF_kf_si16_S5_S3 2540 UMR_MSEC__10_1_0_S5_S3 0 2540
 /begin AXIS_DESCR STD_AXIS zff_atsys._.iSignale._.obj.sig_n_t UMR_U_MIN_1_1_0_S5_S3 4 0 8160 DEPOSIT ABSOLUTE /end AXIS_DESCR
 /begin AXIS_DESCR STD_AXIS zff_atsys._.iSignale._.obj.sig_m_t UMR_NM__1_1_0_S5_S3 4 -200 1300 DEPOSIT ABSOLUTE /end AXIS_DESCR
/end CHARACTERISTIC
/begin CHARACTERISTIC KF_T_DT_IG_CHANGESPORT56 "Kennfeld Zeitvorhalt für Übergabe Rampenzeit auf Schaltdruck" MAP 0x1C5604 ZF_kf_si16_S5_S3 2540 UMR_MSEC__10_1_0_S5_S3 0 2540
 /begin AXIS_DESCR STD_AXIS zff_atsys._.iSignale._.obj.sig_n_t UMR_U_MIN_1_1_0_S5_S3 4 0 8160 DEPOSIT ABSOLUTE /end AXIS_DESCR
 /begin AXIS_DESCR STD_AXIS zff_atsys._.iSignale._.obj.sig_m_t UMR_NM__1_1_0_S5_S3 4 -200 1300 DEPOSIT ABSOLUTE /end AXIS_DESCR
/end CHARACTERISTIC
/begin CHARACTERISTIC KF_T_DT_IG_CHANGESPORT67 "Kennfeld Zeitvorhalt für Übergabe Rampenzeit auf Schaltdruck" MAP 0x1C585C ZF_kf_si16_S5_S3 2540 UMR_MSEC__10_1_0_S5_S3 0 2540
 /begin AXIS_DESCR STD_AXIS zff_atsys._.iSignale._.obj.sig_n_t UMR_U_MIN_1_1_0_S5_S3 4 0 8160 DEPOSIT ABSOLUTE /end AXIS_DESCR
 /begin AXIS_DESCR STD_AXIS zff_atsys._.iSignale._.obj.sig_m_t UMR_NM__1_1_0_S5_S3 4 -200 1300 DEPOSIT ABSOLUTE /end AXIS_DESCR
/end CHARACTERISTIC
/begin CHARACTERISTIC KF_T_DT_IG_CHANGESPORT78 "Kennfeld Zeitvorhalt für Übergabe Rampenzeit auf Schaltdruck" MAP 0x1C5AB4 ZF_kf_si16_S5_S3 2540 UMR_MSEC__10_1_0_S5_S3 0 2540
 /begin AXIS_DESCR STD_AXIS zff_atsys._.iSignale._.obj.sig_n_t UMR_U_MIN_1_1_0_S5_S3 4 0 8160 DEPOSIT ABSOLUTE /end AXIS_DESCR
 /begin AXIS_DESCR STD_AXIS zff_atsys._.iSignale._.obj.sig_m_t UMR_NM__1_1_0_S5_S3 4 -200 1300 DEPOSIT ABSOLUTE /end AXIS_DESCR
/end CHARACTERISTIC
/begin CHARACTERISTIC KL_FPOTNDSYNV2_7 "Temp. abhaengiger Faktor fuer Druckoffset waehrend FA 2. nichtkraftschliessende KZU" CURVE 0x1C1BA4 ZF_kl_ui8_S5_S3 1 UMR___1_100_0_S5_S3 0 1
 /begin AXIS_DESCR STD_AXIS zff_atsys._.iSignale._.obj.sig_c_getr UMR_GRADC__1_1_M40_S5_S3 5 -40 150 DEPOSIT ABSOLUTE /end AXIS_DESCR
/end CHARACTERISTIC
/begin CHARACTERISTIC KL_FPOTNDSYNV2_8 "Temp. abhaengiger Faktor fuer Druckoffset waehrend FA 2. nichtkraftschliessende KZU" CURVE 0x1C20D4 ZF_kl_ui8_S5_S3 1 UMR___1_100_0_S5_S3 0 1
 /begin AXIS_DESCR STD_AXIS zff_atsys._.iSignale._.obj.sig_c_getr UMR_GRADC__1_1_M40_S5_S3 5 -40 150 DEPOSIT ABSOLUTE /end AXIS_DESCR
/end CHARACTERISTIC
/begin CHARACTERISTIC KL_FPOTNDSYNV2_R "Temp. abhaengiger Faktor fuer Druckoffset waehrend FA 2. nichtkraftschliessende KZU" CURVE 0x1BF754 ZF_kl_ui8_S5_S3 1 UMR___1_100_0_S5_S3 0 1
 /begin AXIS_DESCR STD_AXIS zff_atsys._.iSignale._.obj.sig_c_getr UMR_GRADC__1_1_M40_S5_S3 5 -40 150 DEPOSIT ABSOLUTE /end AXIS_DESCR
/end CHARACTERISTIC
/begin CHARACTERISTIC KL_FTRACG12 "Faktor auf Zeit für Rampe auf Schaltdruck" CURVE 0x1C5CB0 ZF_kl_ui8_S5_S3 1 UMR_PROZENT__1_100_0_S5_S3 1 2
 /begin AXIS_DESCR STD_AXIS zff_atsys._.iSignale._.obj.sig_c_getr UMR_GRADC__1_1_M40_S5_S3 4 -40 150 DEPOSIT ABSOLUTE /end AXIS_DESCR
/end CHARACTERISTIC
/begin CHARACTERISTIC KL_FTRACG23 "Faktor auf Zeit für Rampe auf Schaltdruck" CURVE 0x1C5E88 ZF_kl_ui8_S5_S3 1 UMR_PROZENT__1_100_0_S5_S3 1 2
 /begin AXIS_DESCR STD_AXIS zff_atsys._.iSignale._.obj.sig_c_getr UMR_GRADC__1_1_M40_S5_S3 4 -40 150 DEPOSIT ABSOLUTE /end AXIS_DESCR
/end CHARACTERISTIC
/begin CHARACTERISTIC KL_FTRACG34 "Faktor auf Zeit für Rampe auf Schaltdruck" CURVE 0x1C6060 ZF_kl_ui8_S5_S3 1 UMR_PROZENT__1_100_0_S5_S3 1 2
 /begin AXIS_DESCR STD_AXIS zff_atsys._.iSignale._.obj.sig_c_getr UMR_GRADC__1_1_M40_S5_S3 4 -40 150 DEPOSIT ABSOLUTE /end AXIS_DESCR
/end CHARACTERISTIC
/begin CHARACTERISTIC KL_FTRACG45 "Faktor auf Zeit für Rampe auf Schaltdruck" CURVE 0x1C6238 ZF_kl_ui8_S5_S3 1 UMR_PROZENT__1_100_0_S5_S3 1 2
 /begin AXIS_DESCR STD_AXIS zff_atsys._.iSignale._.obj.sig_c_getr UMR_GRADC__1_1_M40_S5_S3 4 -40 150 DEPOSIT ABSOLUTE /end AXIS_DESCR
/end CHARACTERISTIC
/begin CHARACTERISTIC KL_FTRACG56 "Faktor auf Zeit für Rampe auf Schaltdruck" CURVE 0x1C6410 ZF_kl_ui8_S5_S3 1 UMR_PROZENT__1_100_0_S5_S3 1 2
 /begin AXIS_DESCR STD_AXIS zff_atsys._.iSignale._.obj.sig_c_getr UMR_GRADC__1_1_M40_S5_S3 4 -40 150 DEPOSIT ABSOLUTE /end AXIS_DESCR
/end CHARACTERISTIC
/begin CHARACTERISTIC KL_FTRACG67 "Faktor auf Zeit für Rampe auf Schaltdruck" CURVE 0x1C65E8 ZF_kl_ui8_S5_S3 1 UMR_PROZENT__1_100_0_S5_S3 1 2
 /begin AXIS_DESCR STD_AXIS zff_atsys._.iSignale._.obj.sig_c_getr UMR_GRADC__1_1_M40_S5_S3 4 -40 150 DEPOSIT ABSOLUTE /end AXIS_DESCR
/end CHARACTERISTIC
/begin CHARACTERISTIC KL_FTRACG78 "Faktor auf Zeit für Rampe auf Schaltdruck" CURVE 0x1C67C0 ZF_kl_ui8_S5_S3 1 UMR_PROZENT__1_100_0_S5_S3 1 2
 /begin AXIS_DESCR STD_AXIS zff_atsys._.iSignale._.obj.sig_c_getr UMR_GRADC__1_1_M40_S5_S3 4 -40 150 DEPOSIT ABSOLUTE /end AXIS_DESCR
/end CHARACTERISTIC
/begin CHARACTERISTIC KL_PGOFCGV2_7 "Gradient Offset Fuelldruck 2. nicht kraftschl. Kup." CURVE 0x1C16A0 ZF_kl_ui8_S5_S3 5 UMR_BAR_SEC_1_10_0_S5_S3 0 5
 /begin AXIS_DESCR STD_AXIS zff_atsys._.iSignale._.obj.sig_c_getr UMR_GRADC__1_1_M40_S5_S3 4 -40 150 DEPOSIT ABSOLUTE /end AXIS_DESCR
/end CHARACTERISTIC
/begin CHARACTERISTIC KL_PGOFCGV2_8 "Gradient Offset Fuelldruck 2. nicht kraftschl. Kup." CURVE 0x1C1BD0 ZF_kl_ui8_S5_S3 5 UMR_BAR_SEC_1_10_0_S5_S3 0 5
 /begin AXIS_DESCR STD_AXIS zff_atsys._.iSignale._.obj.sig_c_getr UMR_GRADC__1_1_M40_S5_S3 4 -40 150 DEPOSIT ABSOLUTE /end AXIS_DESCR
/end CHARACTERISTIC
/begin CHARACTERISTIC KL_PGOFCGV2_R "Gradient Offset Fuelldruck 2. nicht kraftschl. Kup." CURVE 0x1BF250 ZF_kl_ui8_S5_S3 5 UMR_BAR_SEC_1_10_0_S5_S3 0 5
 /begin AXIS_DESCR STD_AXIS zff_atsys._.iSignale._.obj.sig_c_getr UMR_GRADC__1_1_M40_S5_S3 4 -40 150 DEPOSIT ABSOLUTE /end AXIS_DESCR
/end CHARACTERISTIC
/begin CHARACTERISTIC KL_PGOFMT12 "Gradient Druckoffset Fuellphase" CURVE 0x1C5C80 ZF_kl_si16_S5_S3 200 UMR_BAR_SEC_1_10_0_S5_S3 -100 100
 /begin AXIS_DESCR STD_AXIS zff_atsys._.iSignale._.obj.sig_m_t UMR_NM__1_1_0_S5_S3 4 -200 1300 DEPOSIT ABSOLUTE /end AXIS_DESCR
/end CHARACTERISTIC
/begin CHARACTERISTIC KL_PGOFMT23 "Gradient Druckoffset Fuellphase" CURVE 0x1C5E58 ZF_kl_si16_S5_S3 200 UMR_BAR_SEC_1_10_0_S5_S3 -100 100
 /begin AXIS_DESCR STD_AXIS zff_atsys._.iSignale._.obj.sig_m_t UMR_NM__1_1_0_S5_S3 4 -200 1300 DEPOSIT ABSOLUTE /end AXIS_DESCR
/end CHARACTERISTIC
/begin CHARACTERISTIC KL_PGOFMT34 "Gradient Druckoffset Fuellphase" CURVE 0x1C6030 ZF_kl_si16_S5_S3 200 UMR_BAR_SEC_1_10_0_S5_S3 -100 100
 /begin AXIS_DESCR STD_AXIS zff_atsys._.iSignale._.obj.sig_m_t UMR_NM__1_1_0_S5_S3 4 -200 1300 DEPOSIT ABSOLUTE /end AXIS_DESCR
/end CHARACTERISTIC
/begin CHARACTERISTIC KL_PGOFMT45 "Gradient Druckoffset Fuellphase" CURVE 0x1C6208 ZF_kl_si16_S5_S3 200 UMR_BAR_SEC_1_10_0_S5_S3 -100 100
 /begin AXIS_DESCR STD_AXIS zff_atsys._.iSignale._.obj.sig_m_t UMR_NM__1_1_0_S5_S3 4 -200 1300 DEPOSIT ABSOLUTE /end AXIS_DESCR
/end CHARACTERISTIC
/begin CHARACTERISTIC KL_PGOFMT56 "Gradient Druckoffset Fuellphase" CURVE 0x1C63E0 ZF_kl_si16_S5_S3 200 UMR_BAR_SEC_1_10_0_S5_S3 -100 100
 /begin AXIS_DESCR STD_AXIS zff_atsys._.iSignale._.obj.sig_m_t UMR_NM__1_1_0_S5_S3 4 -200 1300 DEPOSIT ABSOLUTE /end AXIS_DESCR
/end CHARACTERISTIC
/begin CHARACTERISTIC KL_PGOFMT67 "Gradient Druckoffset Fuellphase" CURVE 0x1C65B8 ZF_kl_si16_S5_S3 200 UMR_BAR_SEC_1_10_0_S5_S3 -100 100
 /begin AXIS_DESCR STD_AXIS zff_atsys._.iSignale._.obj.sig_m_t UMR_NM__1_1_0_S5_S3 4 -200 1300 DEPOSIT ABSOLUTE /end AXIS_DESCR
/end CHARACTERISTIC
/begin CHARACTERISTIC KL_PGOFMT78 "Gradient Druckoffset Fuellphase" CURVE 0x1C6790 ZF_kl_si16_S5_S3 200 UMR_BAR_SEC_1_10_0_S5_S3 -100 100
 /begin AXIS_DESCR STD_AXIS zff_atsys._.iSignale._.obj.sig_m_t UMR_NM__1_1_0_S5_S3 4 -200 1300 DEPOSIT ABSOLUTE /end AXIS_DESCR
/end CHARACTERISTIC
/begin CHARACTERISTIC KL_PGOFMT_7 "Gradient Druckoffset Fuellphase" CURVE 0x1C174C ZF_kl_si16_S5_S3 200 UMR_BAR_SEC_1_10_0_S5_S3 -100 100
 /begin AXIS_DESCR STD_AXIS zff_atsys._.iSignale._.obj.sig_m_t UMR_NM__1_1_0_S5_S3 4 -200 1300 DEPOSIT ABSOLUTE /end AXIS_DESCR
/end CHARACTERISTIC
/begin CHARACTERISTIC KL_PGOFMT_8 "Gradient Druckoffset Fuellphase" CURVE 0x1C1C7C ZF_kl_si16_S5_S3 200 UMR_BAR_SEC_1_10_0_S5_S3 -100 100
 /begin AXIS_DESCR STD_AXIS zff_atsys._.iSignale._.obj.sig_m_t UMR_NM__1_1_0_S5_S3 4 -200 1300 DEPOSIT ABSOLUTE /end AXIS_DESCR
/end CHARACTERISTIC
/begin CHARACTERISTIC KL_PGOFMT_R "Gradient Druckoffset Fuellphase" CURVE 0x1BF2FC ZF_kl_si16_S5_S3 200 UMR_BAR_SEC_1_10_0_S5_S3 -100 100
 /begin AXIS_DESCR STD_AXIS zff_atsys._.iSignale._.obj.sig_m_t UMR_NM__1_1_0_S5_S3 4 -200 1300 DEPOSIT ABSOLUTE /end AXIS_DESCR
/end CHARACTERISTIC
/begin CHARACTERISTIC KL_PGOKZU12 "Druckgradient in Abhaengigkeit von m_t" CURVE 0x1C2428 ZF_kl_si16_S5_S3 200 UMR_BAR_SEC_1_10_0_S5_S3 -100 100
 /begin AXIS_DESCR STD_AXIS zff_atsys._.iSignale._.obj.sig_m_t UMR_NM__1_1_0_S5_S3 6 -200 1300 DEPOSIT ABSOLUTE /end AXIS_DESCR
/end CHARACTERISTIC
/begin CHARACTERISTIC KL_PGOKZU23 "Druckgradient in Abhaengigkeit von m_t" CURVE 0x1C27F8 ZF_kl_si16_S5_S3 200 UMR_BAR_SEC_1_10_0_S5_S3 -100 100
 /begin AXIS_DESCR STD_AXIS zff_atsys._.iSignale._.obj.sig_m_t UMR_NM__1_1_0_S5_S3 6 -200 1300 DEPOSIT ABSOLUTE /end AXIS_DESCR
/end CHARACTERISTIC
/begin CHARACTERISTIC KL_PGOKZU34 "Druckgradient in Abhaengigkeit von m_t" CURVE 0x1C2BC8 ZF_kl_si16_S5_S3 200 UMR_BAR_SEC_1_10_0_S5_S3 -100 100
 /begin AXIS_DESCR STD_AXIS zff_atsys._.iSignale._.obj.sig_m_t UMR_NM__1_1_0_S5_S3 6 -200 1300 DEPOSIT ABSOLUTE /end AXIS_DESCR
/end CHARACTERISTIC
/begin CHARACTERISTIC KL_PGOKZU45 "Druckgradient in Abhaengigkeit von m_t" CURVE 0x1C2F98 ZF_kl_si16_S5_S3 200 UMR_BAR_SEC_1_10_0_S5_S3 -100 100
 /begin AXIS_DESCR STD_AXIS zff_atsys._.iSignale._.obj.sig_m_t UMR_NM__1_1_0_S5_S3 6 -200 1300 DEPOSIT ABSOLUTE /end AXIS_DESCR
/end CHARACTERISTIC
/begin CHARACTERISTIC KL_PGOKZU56 "Druckgradient in Abhaengigkeit von m_t" CURVE 0x1C3368 ZF_kl_si16_S5_S3 200 UMR_BAR_SEC_1_10_0_S5_S3 -100 100
 /begin AXIS_DESCR STD_AXIS zff_atsys._.iSignale._.obj.sig_m_t UMR_NM__1_1_0_S5_S3 6 -200 1300 DEPOSIT ABSOLUTE /end AXIS_DESCR
/end CHARACTERISTIC
/begin CHARACTERISTIC KL_PGOKZU67 "Druckgradient in Abhaengigkeit von m_t" CURVE 0x1C3738 ZF_kl_si16_S5_S3 200 UMR_BAR_SEC_1_10_0_S5_S3 -100 100
 /begin AXIS_DESCR STD_AXIS zff_atsys._.iSignale._.obj.sig_m_t UMR_NM__1_1_0_S5_S3 6 -200 1300 DEPOSIT ABSOLUTE /end AXIS_DESCR
/end CHARACTERISTIC
/begin CHARACTERISTIC KL_PGOKZU78 "Druckgradient in Abhaengigkeit von m_t" CURVE 0x1C3B08 ZF_kl_si16_S5_S3 200 UMR_BAR_SEC_1_10_0_S5_S3 -100 100
 /begin AXIS_DESCR STD_AXIS zff_atsys._.iSignale._.obj.sig_m_t UMR_NM__1_1_0_S5_S3 6 -200 1300 DEPOSIT ABSOLUTE /end AXIS_DESCR
/end CHARACTERISTIC
/begin CHARACTERISTIC KL_PGOKZUNAB_7 "Schaltdruckgradienten Offset f(n_ab)" CURVE 0x1C1AD0 ZF_kl_si16_S5_S3 200 UMR_BAR_SEC_1_10_0_S5_S3 -100 100
 /begin AXIS_DESCR STD_AXIS zff_atsys._.iSignale._.obj.sig_n_ab UMR_U_MIN_1_1_0_S5_S3 2 0 8160 DEPOSIT ABSOLUTE /end AXIS_DESCR
/end CHARACTERISTIC
/begin CHARACTERISTIC KL_PGOKZUNAB_8 "Schaltdruckgradienten Offset f(n_ab)" CURVE 0x1C2000 ZF_kl_si16_S5_S3 200 UMR_BAR_SEC_1_10_0_S5_S3 -100 100
 /begin AXIS_DESCR STD_AXIS zff_atsys._.iSignale._.obj.sig_n_ab UMR_U_MIN_1_1_0_S5_S3 2 0 8160 DEPOSIT ABSOLUTE /end AXIS_DESCR
/end CHARACTERISTIC
/begin CHARACTERISTIC KL_PGOKZUNAB_R "Schaltdruckgradienten Offset f(n_ab)" CURVE 0x1BF680 ZF_kl_si16_S5_S3 200 UMR_BAR_SEC_1_10_0_S5_S3 -100 100
 /begin AXIS_DESCR STD_AXIS zff_atsys._.iSignale._.obj.sig_n_ab UMR_U_MIN_1_1_0_S5_S3 2 0 8160 DEPOSIT ABSOLUTE /end AXIS_DESCR
/end CHARACTERISTIC
/begin CHARACTERISTIC KL_PGOKZUSP12 "Druckgradient in Abhaengigkeit von m_t" CURVE 0x1C3D60 ZF_kl_si16_S5_S3 200 UMR_BAR_SEC_1_10_0_S5_S3 -100 100
 /begin AXIS_DESCR STD_AXIS zff_atsys._.iSignale._.obj.sig_m_t UMR_NM__1_1_0_S5_S3 6 -200 1300 DEPOSIT ABSOLUTE /end AXIS_DESCR
/end CHARACTERISTIC
/begin CHARACTERISTIC KL_PGOKZUSP23 "Druckgradient in Abhaengigkeit von m_t" CURVE 0x1C3FB8 ZF_kl_si16_S5_S3 200 UMR_BAR_SEC_1_10_0_S5_S3 -100 100
 /begin AXIS_DESCR STD_AXIS zff_atsys._.iSignale._.obj.sig_m_t UMR_NM__1_1_0_S5_S3 6 -200 1300 DEPOSIT ABSOLUTE /end AXIS_DESCR
/end CHARACTERISTIC
/begin CHARACTERISTIC KL_PGOKZUSP34 "Druckgradient in Abhaengigkeit von m_t" CURVE 0x1C4210 ZF_kl_si16_S5_S3 200 UMR_BAR_SEC_1_10_0_S5_S3 -100 100
 /begin AXIS_DESCR STD_AXIS zff_atsys._.iSignale._.obj.sig_m_t UMR_NM__1_1_0_S5_S3 6 -200 1300 DEPOSIT ABSOLUTE /end AXIS_DESCR
/end CHARACTERISTIC
/begin CHARACTERISTIC KL_PGOKZUSP45 "Druckgradient in Abhaengigkeit von m_t" CURVE 0x1C4468 ZF_kl_si16_S5_S3 200 UMR_BAR_SEC_1_10_0_S5_S3 -100 100
 /begin AXIS_DESCR STD_AXIS zff_atsys._.iSignale._.obj.sig_m_t UMR_NM__1_1_0_S5_S3 6 -200 1300 DEPOSIT ABSOLUTE /end AXIS_DESCR
/end CHARACTERISTIC
/begin CHARACTERISTIC KL_PGOKZUSP56 "Druckgradient in Abhaengigkeit von m_t" CURVE 0x1C46C0 ZF_kl_si16_S5_S3 200 UMR_BAR_SEC_1_10_0_S5_S3 -100 100
 /begin AXIS_DESCR STD_AXIS zff_atsys._.iSignale._.obj.sig_m_t UMR_NM__1_1_0_S5_S3 6 -200 1300 DEPOSIT ABSOLUTE /end AXIS_DESCR
/end CHARACTERISTIC
/begin CHARACTERISTIC KL_PGOKZUSP67 "Druckgradient in Abhaengigkeit von m_t" CURVE 0x1C4918 ZF_kl_si16_S5_S3 200 UMR_BAR_SEC_1_10_0_S5_S3 -100 100
 /begin AXIS_DESCR STD_AXIS zff_atsys._.iSignale._.obj.sig_m_t UMR_NM__1_1_0_S5_S3 6 -200 1300 DEPOSIT ABSOLUTE /end AXIS_DESCR
/end CHARACTERISTIC
/begin CHARACTERISTIC KL_PGOKZUSP78 "Druckgradient in Abhaengigkeit von m_t" CURVE 0x1C4B70 ZF_kl_si16_S5_S3 200 UMR_BAR_SEC_1_10_0_S5_S3 -100 100
 /begin AXIS_DESCR STD_AXIS zff_atsys._.iSignale._.obj.sig_m_t UMR_NM__1_1_0_S5_S3 6 -200 1300 DEPOSIT ABSOLUTE /end AXIS_DESCR
/end CHARACTERISTIC
/begin CHARACTERISTIC KL_PGOKZUSPORT12 "Druckgradient in Abhaengigkeit von m_t" CURVE 0x1C4DC8 ZF_kl_si16_S5_S3 200 UMR_BAR_SEC_1_10_0_S5_S3 -100 100
 /begin AXIS_DESCR STD_AXIS zff_atsys._.iSignale._.obj.sig_m_t UMR_NM__1_1_0_S5_S3 6 -200 1300 DEPOSIT ABSOLUTE /end AXIS_DESCR
/end CHARACTERISTIC
/begin CHARACTERISTIC KL_PGOKZUSPORT23 "Druckgradient in Abhaengigkeit von m_t" CURVE 0x1C5020 ZF_kl_si16_S5_S3 200 UMR_BAR_SEC_1_10_0_S5_S3 -100 100
 /begin AXIS_DESCR STD_AXIS zff_atsys._.iSignale._.obj.sig_m_t UMR_NM__1_1_0_S5_S3 6 -200 1300 DEPOSIT ABSOLUTE /end AXIS_DESCR
/end CHARACTERISTIC
/begin CHARACTERISTIC KL_PGOKZUSPORT34 "Druckgradient in Abhaengigkeit von m_t" CURVE 0x1C5278 ZF_kl_si16_S5_S3 200 UMR_BAR_SEC_1_10_0_S5_S3 -100 100
 /begin AXIS_DESCR STD_AXIS zff_atsys._.iSignale._.obj.sig_m_t UMR_NM__1_1_0_S5_S3 6 -200 1300 DEPOSIT ABSOLUTE /end AXIS_DESCR
/end CHARACTERISTIC
/begin CHARACTERISTIC KL_PGOKZUSPORT45 "Druckgradient in Abhaengigkeit von m_t" CURVE 0x1C54D0 ZF_kl_si16_S5_S3 200 UMR_BAR_SEC_1_10_0_S5_S3 -100 100
 /begin AXIS_DESCR STD_AXIS zff_atsys._.iSignale._.obj.sig_m_t UMR_NM__1_1_0_S5_S3 6 -200 1300 DEPOSIT ABSOLUTE /end AXIS_DESCR
/end CHARACTERISTIC
/begin CHARACTERISTIC KL_PGOKZUSPORT56 "Druckgradient in Abhaengigkeit von m_t" CURVE 0x1C5728 ZF_kl_si16_S5_S3 200 UMR_BAR_SEC_1_10_0_S5_S3 -100 100
 /begin AXIS_DESCR STD_AXIS zff_atsys._.iSignale._.obj.sig_m_t UMR_NM__1_1_0_S5_S3 6 -200 1300 DEPOSIT ABSOLUTE /end AXIS_DESCR
/end CHARACTERISTIC
/begin CHARACTERISTIC KL_PGOKZUSPORT67 "Druckgradient in Abhaengigkeit von m_t" CURVE 0x1C5980 ZF_kl_si16_S5_S3 200 UMR_BAR_SEC_1_10_0_S5_S3 -100 100
 /begin AXIS_DESCR STD_AXIS zff_atsys._.iSignale._.obj.sig_m_t UMR_NM__1_1_0_S5_S3 6 -200 1300 DEPOSIT ABSOLUTE /end AXIS_DESCR
/end CHARACTERISTIC
/begin CHARACTERISTIC KL_PGOKZUSPORT78 "Druckgradient in Abhaengigkeit von m_t" CURVE 0x1C5BD8 ZF_kl_si16_S5_S3 200 UMR_BAR_SEC_1_10_0_S5_S3 -100 100
 /begin AXIS_DESCR STD_AXIS zff_atsys._.iSignale._.obj.sig_m_t UMR_NM__1_1_0_S5_S3 6 -200 1300 DEPOSIT ABSOLUTE /end AXIS_DESCR
/end CHARACTERISTIC
/begin CHARACTERISTIC KL_PGOKZU_7 "Druckgradient in Abhaengigkeit von m_t" CURVE 0x1C1808 ZF_kl_si16_S5_S3 200 UMR_BAR_SEC_1_10_0_S5_S3 -100 100
 /begin AXIS_DESCR STD_AXIS zff_atsys._.iSignale._.obj.sig_m_t UMR_NM__1_1_0_S5_S3 6 -200 1300 DEPOSIT ABSOLUTE /end AXIS_DESCR
/end CHARACTERISTIC
/begin CHARACTERISTIC KL_PGOKZU_8 "Druckgradient in Abhaengigkeit von m_t" CURVE 0x1C1D38 ZF_kl_si16_S5_S3 200 UMR_BAR_SEC_1_10_0_S5_S3 -100 100
 /begin AXIS_DESCR STD_AXIS zff_atsys._.iSignale._.obj.sig_m_t UMR_NM__1_1_0_S5_S3 6 -200 1300 DEPOSIT ABSOLUTE /end AXIS_DESCR
/end CHARACTERISTIC
/begin CHARACTERISTIC KL_PGOKZU_R "Druckgradient in Abhaengigkeit von m_t" CURVE 0x1BF3B8 ZF_kl_si16_S5_S3 200 UMR_BAR_SEC_1_10_0_S5_S3 -100 100
 /begin AXIS_DESCR STD_AXIS zff_atsys._.iSignale._.obj.sig_m_t UMR_NM__1_1_0_S5_S3 6 -200 1300 DEPOSIT ABSOLUTE /end AXIS_DESCR
/end CHARACTERISTIC
/begin CHARACTERISTIC KL_PGRASYN12 "Schliessrampenradient" CURVE 0x1C5E24 ZF_kl_si16_S5_S3 6553.4 UMR_BAR_SEC_1_10_0_S5_S3 -3276.7 3276.7
 /begin AXIS_DESCR STD_AXIS zff_atsys._.iSignale._.obj.sig_m_t UMR_NM__1_1_0_S5_S3 6 -200 1300 DEPOSIT ABSOLUTE /end AXIS_DESCR
/end CHARACTERISTIC
/begin CHARACTERISTIC KL_PGRASYN23 "Schliessrampenradient" CURVE 0x1C5FFC ZF_kl_si16_S5_S3 6553.4 UMR_BAR_SEC_1_10_0_S5_S3 -3276.7 3276.7
 /begin AXIS_DESCR STD_AXIS zff_atsys._.iSignale._.obj.sig_m_t UMR_NM__1_1_0_S5_S3 6 -200 1300 DEPOSIT ABSOLUTE /end AXIS_DESCR
/end CHARACTERISTIC
/begin CHARACTERISTIC KL_PGRASYN34 "Schliessrampenradient" CURVE 0x1C61D4 ZF_kl_si16_S5_S3 6553.4 UMR_BAR_SEC_1_10_0_S5_S3 -3276.7 3276.7
 /begin AXIS_DESCR STD_AXIS zff_atsys._.iSignale._.obj.sig_m_t UMR_NM__1_1_0_S5_S3 6 -200 1300 DEPOSIT ABSOLUTE /end AXIS_DESCR
/end CHARACTERISTIC
/begin CHARACTERISTIC KL_PGRASYN45 "Schliessrampenradient" CURVE 0x1C63AC ZF_kl_si16_S5_S3 6553.4 UMR_BAR_SEC_1_10_0_S5_S3 -3276.7 3276.7
 /begin AXIS_DESCR STD_AXIS zff_atsys._.iSignale._.obj.sig_m_t UMR_NM__1_1_0_S5_S3 6 -200 1300 DEPOSIT ABSOLUTE /end AXIS_DESCR
/end CHARACTERISTIC
/begin CHARACTERISTIC KL_PGRASYN56 "Schliessrampenradient" CURVE 0x1C6584 ZF_kl_si16_S5_S3 6553.4 UMR_BAR_SEC_1_10_0_S5_S3 -3276.7 3276.7
 /begin AXIS_DESCR STD_AXIS zff_atsys._.iSignale._.obj.sig_m_t UMR_NM__1_1_0_S5_S3 6 -200 1300 DEPOSIT ABSOLUTE /end AXIS_DESCR
/end CHARACTERISTIC
/begin CHARACTERISTIC KL_PGRASYN67 "Schliessrampenradient" CURVE 0x1C675C ZF_kl_si16_S5_S3 6553.4 UMR_BAR_SEC_1_10_0_S5_S3 -3276.7 3276.7
 /begin AXIS_DESCR STD_AXIS zff_atsys._.iSignale._.obj.sig_m_t UMR_NM__1_1_0_S5_S3 6 -200 1300 DEPOSIT ABSOLUTE /end AXIS_DESCR
/end CHARACTERISTIC
/begin CHARACTERISTIC KL_PGRASYN78 "Schliessrampenradient" CURVE 0x1C6934 ZF_kl_si16_S5_S3 6553.4 UMR_BAR_SEC_1_10_0_S5_S3 -3276.7 3276.7
 /begin AXIS_DESCR STD_AXIS zff_atsys._.iSignale._.obj.sig_m_t UMR_NM__1_1_0_S5_S3 6 -200 1300 DEPOSIT ABSOLUTE /end AXIS_DESCR
/end CHARACTERISTIC
/begin CHARACTERISTIC KL_PGRASYNNAB_7 "Schliessrampenradient f(n_ab)" CURVE 0x1C1840 ZF_kl_si16_S5_S3 200 UMR_BAR_SEC_1_10_0_S5_S3 -100 100
 /begin AXIS_DESCR STD_AXIS zff_atsys._.iSignale._.obj.sig_n_ab UMR_U_MIN_1_1_0_S5_S3 2 0 8160 DEPOSIT ABSOLUTE /end AXIS_DESCR
/end CHARACTERISTIC
/begin CHARACTERISTIC KL_PGRASYNNAB_8 "Schliessrampenradient f(n_ab)" CURVE 0x1C1D70 ZF_kl_si16_S5_S3 200 UMR_BAR_SEC_1_10_0_S5_S3 -100 100
 /begin AXIS_DESCR STD_AXIS zff_atsys._.iSignale._.obj.sig_n_ab UMR_U_MIN_1_1_0_S5_S3 2 0 8160 DEPOSIT ABSOLUTE /end AXIS_DESCR
/end CHARACTERISTIC
/begin CHARACTERISTIC KL_PGRASYNNAB_R "Schliessrampenradient f(n_ab)" CURVE 0x1BF3F0 ZF_kl_si16_S5_S3 200 UMR_BAR_SEC_1_10_0_S5_S3 -100 100
 /begin AXIS_DESCR STD_AXIS zff_atsys._.iSignale._.obj.sig_n_ab UMR_U_MIN_1_1_0_S5_S3 2 0 8160 DEPOSIT ABSOLUTE /end AXIS_DESCR
/end CHARACTERISTIC
/begin CHARACTERISTIC KL_PGRASYNV1_7 "Schliessrampenradient 1. nichtkraftschl. Kupplung" CURVE 0x1C184C ZF_kl_si16_S5_S3 1000 UMR_BAR_SEC_1_10_0_S5_S3 0 1000
 /begin AXIS_DESCR STD_AXIS zff_atsys._.iSignale._.obj.sig_m_t UMR_NM__1_1_0_S5_S3 6 -200 1300 DEPOSIT ABSOLUTE /end AXIS_DESCR
/end CHARACTERISTIC
/begin CHARACTERISTIC KL_PGRASYNV1_8 "Schliessrampenradient 1. nichtkraftschl. Kupplung" CURVE 0x1C1D7C ZF_kl_si16_S5_S3 1000 UMR_BAR_SEC_1_10_0_S5_S3 0 1000
 /begin AXIS_DESCR STD_AXIS zff_atsys._.iSignale._.obj.sig_m_t UMR_NM__1_1_0_S5_S3 6 -200 1300 DEPOSIT ABSOLUTE /end AXIS_DESCR
/end CHARACTERISTIC
/begin CHARACTERISTIC KL_PGRASYNV1_R "Schliessrampenradient 1. nichtkraftschl. Kupplung" CURVE 0x1BF3FC ZF_kl_si16_S5_S3 1000 UMR_BAR_SEC_1_10_0_S5_S3 0 1000
 /begin AXIS_DESCR STD_AXIS zff_atsys._.iSignale._.obj.sig_m_t UMR_NM__1_1_0_S5_S3 6 -200 1300 DEPOSIT ABSOLUTE /end AXIS_DESCR
/end CHARACTERISTIC
/begin CHARACTERISTIC KL_PGRASYNV2_7 "Schliessrampenradient 2. nichtkraftschl. Kupplung" CURVE 0x1C1878 ZF_kl_si16_S5_S3 1000 UMR_BAR_SEC_1_10_0_S5_S3 0 1000
 /begin AXIS_DESCR STD_AXIS zff_atsys._.iSignale._.obj.sig_m_t UMR_NM__1_1_0_S5_S3 6 -200 1300 DEPOSIT ABSOLUTE /end AXIS_DESCR
/end CHARACTERISTIC
/begin CHARACTERISTIC KL_PGRASYNV2_8 "Schliessrampenradient 2. nichtkraftschl. Kupplung" CURVE 0x1C1DA8 ZF_kl_si16_S5_S3 1000 UMR_BAR_SEC_1_10_0_S5_S3 0 1000
 /begin AXIS_DESCR STD_AXIS zff_atsys._.iSignale._.obj.sig_m_t UMR_NM__1_1_0_S5_S3 6 -200 1300 DEPOSIT ABSOLUTE /end AXIS_DESCR
/end CHARACTERISTIC
/begin CHARACTERISTIC KL_PGRASYNV2_R "Schliessrampenradient 2. nichtkraftschl. Kupplung" CURVE 0x1BF428 ZF_kl_si16_S5_S3 1000 UMR_BAR_SEC_1_10_0_S5_S3 0 1000
 /begin AXIS_DESCR STD_AXIS zff_atsys._.iSignale._.obj.sig_m_t UMR_NM__1_1_0_S5_S3 6 -200 1300 DEPOSIT ABSOLUTE /end AXIS_DESCR
/end CHARACTERISTIC
/begin CHARACTERISTIC KL_PGRASYN_7 "Schliessrampenradient f(m_t)" CURVE 0x1C1824 ZF_kl_si16_S5_S3 6553.4 UMR_BAR_SEC_1_10_0_S5_S3 -3276.7 3276.7
 /begin AXIS_DESCR STD_AXIS zff_atsys._.iSignale._.obj.sig_m_t UMR_NM__1_1_0_S5_S3 6 -200 1300 DEPOSIT ABSOLUTE /end AXIS_DESCR
/end CHARACTERISTIC
/begin CHARACTERISTIC KL_PGRASYN_8 "Schliessrampenradient f(m_t)" CURVE 0x1C1D54 ZF_kl_si16_S5_S3 6553.4 UMR_BAR_SEC_1_10_0_S5_S3 -3276.7 3276.7
 /begin AXIS_DESCR STD_AXIS zff_atsys._.iSignale._.obj.sig_m_t UMR_NM__1_1_0_S5_S3 6 -200 1300 DEPOSIT ABSOLUTE /end AXIS_DESCR
/end CHARACTERISTIC
/begin CHARACTERISTIC KL_PGRASYN_R "Schliessrampenradient f(m_t)" CURVE 0x1BF3D4 ZF_kl_si16_S5_S3 6553.4 UMR_BAR_SEC_1_10_0_S5_S3 -3276.7 3276.7
 /begin AXIS_DESCR STD_AXIS zff_atsys._.iSignale._.obj.sig_m_t UMR_NM__1_1_0_S5_S3 6 -200 1300 DEPOSIT ABSOLUTE /end AXIS_DESCR
/end CHARACTERISTIC
/begin CHARACTERISTIC KL_POFCG12 "Kennlinie Fuelldruckoffset" CURVE 0x1C5CEC ZF_kl_si16_S5_S3 12.75 UMR_BAR__1_1000_0_S5_S3 -6.4 6.35
 /begin AXIS_DESCR STD_AXIS zff_atsys._.iSignale._.obj.sig_c_getr UMR_GRADC__1_1_M40_S5_S3 10 -40 150 DEPOSIT ABSOLUTE /end AXIS_DESCR
/end CHARACTERISTIC
/begin CHARACTERISTIC KL_POFCG23 "Kennlinie Fuelldruckoffset" CURVE 0x1C5EC4 ZF_kl_si16_S5_S3 12.75 UMR_BAR__1_1000_0_S5_S3 -6.4 6.35
 /begin AXIS_DESCR STD_AXIS zff_atsys._.iSignale._.obj.sig_c_getr UMR_GRADC__1_1_M40_S5_S3 10 -40 150 DEPOSIT ABSOLUTE /end AXIS_DESCR
/end CHARACTERISTIC
/begin CHARACTERISTIC KL_POFCG34 "Kennlinie Fuelldruckoffset" CURVE 0x1C609C ZF_kl_si16_S5_S3 12.75 UMR_BAR__1_1000_0_S5_S3 -6.4 6.35
 /begin AXIS_DESCR STD_AXIS zff_atsys._.iSignale._.obj.sig_c_getr UMR_GRADC__1_1_M40_S5_S3 10 -40 150 DEPOSIT ABSOLUTE /end AXIS_DESCR
/end CHARACTERISTIC
/begin CHARACTERISTIC KL_POFCG45 "Kennlinie Fuelldruckoffset" CURVE 0x1C6274 ZF_kl_si16_S5_S3 12.75 UMR_BAR__1_1000_0_S5_S3 -6.4 6.35
 /begin AXIS_DESCR STD_AXIS zff_atsys._.iSignale._.obj.sig_c_getr UMR_GRADC__1_1_M40_S5_S3 10 -40 150 DEPOSIT ABSOLUTE /end AXIS_DESCR
/end CHARACTERISTIC
/begin CHARACTERISTIC KL_POFCG56 "Kennlinie Fuelldruckoffset" CURVE 0x1C644C ZF_kl_si16_S5_S3 12.75 UMR_BAR__1_1000_0_S5_S3 -6.4 6.35
 /begin AXIS_DESCR STD_AXIS zff_atsys._.iSignale._.obj.sig_c_getr UMR_GRADC__1_1_M40_S5_S3 10 -40 150 DEPOSIT ABSOLUTE /end AXIS_DESCR
/end CHARACTERISTIC
/begin CHARACTERISTIC KL_POFCG67 "Kennlinie Fuelldruckoffset" CURVE 0x1C6624 ZF_kl_si16_S5_S3 12.75 UMR_BAR__1_1000_0_S5_S3 -6.4 6.35
 /begin AXIS_DESCR STD_AXIS zff_atsys._.iSignale._.obj.sig_c_getr UMR_GRADC__1_1_M40_S5_S3 10 -40 150 DEPOSIT ABSOLUTE /end AXIS_DESCR
/end CHARACTERISTIC
/begin CHARACTERISTIC KL_POFCG78 "Kennlinie Fuelldruckoffset" CURVE 0x1C67FC ZF_kl_si16_S5_S3 12.75 UMR_BAR__1_1000_0_S5_S3 -6.4 6.35
 /begin AXIS_DESCR STD_AXIS zff_atsys._.iSignale._.obj.sig_c_getr UMR_GRADC__1_1_M40_S5_S3 10 -40 150 DEPOSIT ABSOLUTE /end AXIS_DESCR
/end CHARACTERISTIC
/begin CHARACTERISTIC KL_POFCGV1_7 "Kennlinie Fuelldruckoffset" CURVE 0x1C1950 ZF_kl_si16_S5_S3 12.75 UMR_BAR__1_1000_0_S5_S3 -6.4 6.35
 /begin AXIS_DESCR STD_AXIS zff_atsys._.iSignale._.obj.sig_c_getr UMR_GRADC__1_1_M40_S5_S3 10 -40 150 DEPOSIT ABSOLUTE /end AXIS_DESCR
/end CHARACTERISTIC
/begin CHARACTERISTIC KL_POFCGV1_8 "Kennlinie Fuelldruckoffset" CURVE 0x1C1E80 ZF_kl_si16_S5_S3 12.75 UMR_BAR__1_1000_0_S5_S3 -6.4 6.35
 /begin AXIS_DESCR STD_AXIS zff_atsys._.iSignale._.obj.sig_c_getr UMR_GRADC__1_1_M40_S5_S3 10 -40 150 DEPOSIT ABSOLUTE /end AXIS_DESCR
/end CHARACTERISTIC
/begin CHARACTERISTIC KL_POFCGV1_R "Kennlinie Fuelldruckoffset" CURVE 0x1BF500 ZF_kl_si16_S5_S3 12.75 UMR_BAR__1_1000_0_S5_S3 -6.4 6.35
 /begin AXIS_DESCR STD_AXIS zff_atsys._.iSignale._.obj.sig_c_getr UMR_GRADC__1_1_M40_S5_S3 10 -40 150 DEPOSIT ABSOLUTE /end AXIS_DESCR
/end CHARACTERISTIC
/begin CHARACTERISTIC KL_POFCGV2_7 "Kennlinie Fuelldruckoffset" CURVE 0x1C197C ZF_kl_si16_S5_S3 12.75 UMR_BAR__1_1000_0_S5_S3 -6.4 6.35
 /begin AXIS_DESCR STD_AXIS zff_atsys._.iSignale._.obj.sig_c_getr UMR_GRADC__1_1_M40_S5_S3 10 -40 150 DEPOSIT ABSOLUTE /end AXIS_DESCR
/end CHARACTERISTIC
/begin CHARACTERISTIC KL_POFCGV2_8 "Kennlinie Fuelldruckoffset" CURVE 0x1C1EAC ZF_kl_si16_S5_S3 12.75 UMR_BAR__1_1000_0_S5_S3 -6.4 6.35
 /begin AXIS_DESCR STD_AXIS zff_atsys._.iSignale._.obj.sig_c_getr UMR_GRADC__1_1_M40_S5_S3 10 -40 150 DEPOSIT ABSOLUTE /end AXIS_DESCR
/end CHARACTERISTIC
/begin CHARACTERISTIC KL_POFCGV2_R "Kennlinie Fuelldruckoffset" CURVE 0x1BF52C ZF_kl_si16_S5_S3 12.75 UMR_BAR__1_1000_0_S5_S3 -6.4 6.35
 /begin AXIS_DESCR STD_AXIS zff_atsys._.iSignale._.obj.sig_c_getr UMR_GRADC__1_1_M40_S5_S3 10 -40 150 DEPOSIT ABSOLUTE /end AXIS_DESCR
/end CHARACTERISTIC
/begin CHARACTERISTIC KL_POFCG_7 "Kennlinie Fuelldruckoffset" CURVE 0x1C1924 ZF_kl_si16_S5_S3 12.75 UMR_BAR__1_1000_0_S5_S3 -6.4 6.35
 /begin AXIS_DESCR STD_AXIS zff_atsys._.iSignale._.obj.sig_c_getr UMR_GRADC__1_1_M40_S5_S3 10 -40 150 DEPOSIT ABSOLUTE /end AXIS_DESCR
/end CHARACTERISTIC
/begin CHARACTERISTIC KL_POFCG_8 "Kennlinie Fuelldruckoffset" CURVE 0x1C1E54 ZF_kl_si16_S5_S3 12.75 UMR_BAR__1_1000_0_S5_S3 -6.4 6.35
 /begin AXIS_DESCR STD_AXIS zff_atsys._.iSignale._.obj.sig_c_getr UMR_GRADC__1_1_M40_S5_S3 10 -40 150 DEPOSIT ABSOLUTE /end AXIS_DESCR
/end CHARACTERISTIC
/begin CHARACTERISTIC KL_POFCG_R "Kennlinie Fuelldruckoffset" CURVE 0x1BF4D4 ZF_kl_si16_S5_S3 12.75 UMR_BAR__1_1000_0_S5_S3 -6.4 6.35
 /begin AXIS_DESCR STD_AXIS zff_atsys._.iSignale._.obj.sig_c_getr UMR_GRADC__1_1_M40_S5_S3 10 -40 150 DEPOSIT ABSOLUTE /end AXIS_DESCR
/end CHARACTERISTIC
/begin CHARACTERISTIC KL_POFMDMOTSOLL12 "Fuelldruckoffset f(Erhoehung Motorsollmoment)" CURVE 0x1C5C94 ZF_kl_si16_S5_S3 12.75 UMR_BAR__1_1000_0_S5_S3 -6.4 6.35
 /begin AXIS_DESCR STD_AXIS NO_INPUT_QUANTITY UMR_NM__1_1_0_S5_S3 6 -1500 1500 DEPOSIT ABSOLUTE /end AXIS_DESCR
/end CHARACTERISTIC
/begin CHARACTERISTIC KL_POFMDMOTSOLL23 "Fuelldruckoffset f(Erhoehung Motorsollmoment)" CURVE 0x1C5E6C ZF_kl_si16_S5_S3 12.75 UMR_BAR__1_1000_0_S5_S3 -6.4 6.35
 /begin AXIS_DESCR STD_AXIS NO_INPUT_QUANTITY UMR_NM__1_1_0_S5_S3 6 -1500 1500 DEPOSIT ABSOLUTE /end AXIS_DESCR
/end CHARACTERISTIC
/begin CHARACTERISTIC KL_POFMDMOTSOLL34 "Fuelldruckoffset f(Erhoehung Motorsollmoment)" CURVE 0x1C6044 ZF_kl_si16_S5_S3 12.75 UMR_BAR__1_1000_0_S5_S3 -6.4 6.35
 /begin AXIS_DESCR STD_AXIS NO_INPUT_QUANTITY UMR_NM__1_1_0_S5_S3 6 -1500 1500 DEPOSIT ABSOLUTE /end AXIS_DESCR
/end CHARACTERISTIC
/begin CHARACTERISTIC KL_POFMDMOTSOLL45 "Fuelldruckoffset f(Erhoehung Motorsollmoment)" CURVE 0x1C621C ZF_kl_si16_S5_S3 12.75 UMR_BAR__1_1000_0_S5_S3 -6.4 6.35
 /begin AXIS_DESCR STD_AXIS NO_INPUT_QUANTITY UMR_NM__1_1_0_S5_S3 6 -1500 1500 DEPOSIT ABSOLUTE /end AXIS_DESCR
/end CHARACTERISTIC
/begin CHARACTERISTIC KL_POFMDMOTSOLL56 "Fuelldruckoffset f(Erhoehung Motorsollmoment)" CURVE 0x1C63F4 ZF_kl_si16_S5_S3 12.75 UMR_BAR__1_1000_0_S5_S3 -6.4 6.35
 /begin AXIS_DESCR STD_AXIS NO_INPUT_QUANTITY UMR_NM__1_1_0_S5_S3 6 -1500 1500 DEPOSIT ABSOLUTE /end AXIS_DESCR
/end CHARACTERISTIC
/begin CHARACTERISTIC KL_POFMDMOTSOLL67 "Fuelldruckoffset f(Erhoehung Motorsollmoment)" CURVE 0x1C65CC ZF_kl_si16_S5_S3 12.75 UMR_BAR__1_1000_0_S5_S3 -6.4 6.35
 /begin AXIS_DESCR STD_AXIS NO_INPUT_QUANTITY UMR_NM__1_1_0_S5_S3 6 -1500 1500 DEPOSIT ABSOLUTE /end AXIS_DESCR
/end CHARACTERISTIC
/begin CHARACTERISTIC KL_POFMDMOTSOLL78 "Fuelldruckoffset f(Erhoehung Motorsollmoment)" CURVE 0x1C67A4 ZF_kl_si16_S5_S3 12.75 UMR_BAR__1_1000_0_S5_S3 -6.4 6.35
 /begin AXIS_DESCR STD_AXIS NO_INPUT_QUANTITY UMR_NM__1_1_0_S5_S3 6 -1500 1500 DEPOSIT ABSOLUTE /end AXIS_DESCR
/end CHARACTERISTIC
/begin CHARACTERISTIC KL_POKZUCG_7 "Schaltdruckoffset" CURVE 0x1C19A8 ZF_kl_si16_S5_S3 12.75 UMR_BAR__1_1000_0_S5_S3 -6.4 6.35
 /begin AXIS_DESCR STD_AXIS zff_atsys._.iSignale._.obj.sig_c_getr UMR_GRADC__1_1_M40_S5_S3 10 -40 150 DEPOSIT ABSOLUTE /end AXIS_DESCR
/end CHARACTERISTIC
/begin CHARACTERISTIC KL_POKZUCG_8 "Schaltdruckoffset" CURVE 0x1C1ED8 ZF_kl_si16_S5_S3 12.75 UMR_BAR__1_1000_0_S5_S3 -6.4 6.35
 /begin AXIS_DESCR STD_AXIS zff_atsys._.iSignale._.obj.sig_c_getr UMR_GRADC__1_1_M40_S5_S3 10 -40 150 DEPOSIT ABSOLUTE /end AXIS_DESCR
/end CHARACTERISTIC
/begin CHARACTERISTIC KL_POKZUCG_R "Schaltdruckoffset" CURVE 0x1BF558 ZF_kl_si16_S5_S3 12.75 UMR_BAR__1_1000_0_S5_S3 -6.4 6.35
 /begin AXIS_DESCR STD_AXIS zff_atsys._.iSignale._.obj.sig_c_getr UMR_GRADC__1_1_M40_S5_S3 10 -40 150 DEPOSIT ABSOLUTE /end AXIS_DESCR
/end CHARACTERISTIC
/begin CHARACTERISTIC KL_POKZUFLARE12 "Sollschlupf abhaengiger Druckoffset zur Vermeidung von Flare" CURVE 0x1C5E40 ZF_kl_si16_S5_S3 3 UMR_BAR__1_1000_0_S5_S3 0 3
 /begin AXIS_DESCR STD_AXIS iSasZentr.iSchaltend.nd_synistgang UMR_U_MIN_1_1_0_S5_S3 5 -8000 8000 DEPOSIT ABSOLUTE /end AXIS_DESCR
/end CHARACTERISTIC
/begin CHARACTERISTIC KL_POKZUFLARE23 "Sollschlupf abhaengiger Druckoffset zur Vermeidung von Flare" CURVE 0x1C6018 ZF_kl_si16_S5_S3 3 UMR_BAR__1_1000_0_S5_S3 0 3
 /begin AXIS_DESCR STD_AXIS iSasZentr.iSchaltend.nd_synistgang UMR_U_MIN_1_1_0_S5_S3 5 -8000 8000 DEPOSIT ABSOLUTE /end AXIS_DESCR
/end CHARACTERISTIC
/begin CHARACTERISTIC KL_POKZUFLARE34 "Sollschlupf abhaengiger Druckoffset zur Vermeidung von Flare" CURVE 0x1C61F0 ZF_kl_si16_S5_S3 3 UMR_BAR__1_1000_0_S5_S3 0 3
 /begin AXIS_DESCR STD_AXIS iSasZentr.iSchaltend.nd_synistgang UMR_U_MIN_1_1_0_S5_S3 5 -8000 8000 DEPOSIT ABSOLUTE /end AXIS_DESCR
/end CHARACTERISTIC
/begin CHARACTERISTIC KL_POKZUFLARE45 "Sollschlupf abhaengiger Druckoffset zur Vermeidung von Flare" CURVE 0x1C63C8 ZF_kl_si16_S5_S3 3 UMR_BAR__1_1000_0_S5_S3 0 3
 /begin AXIS_DESCR STD_AXIS iSasZentr.iSchaltend.nd_synistgang UMR_U_MIN_1_1_0_S5_S3 5 -8000 8000 DEPOSIT ABSOLUTE /end AXIS_DESCR
/end CHARACTERISTIC
/begin CHARACTERISTIC KL_POKZUFLARE56 "Sollschlupf abhaengiger Druckoffset zur Vermeidung von Flare" CURVE 0x1C65A0 ZF_kl_si16_S5_S3 3 UMR_BAR__1_1000_0_S5_S3 0 3
 /begin AXIS_DESCR STD_AXIS iSasZentr.iSchaltend.nd_synistgang UMR_U_MIN_1_1_0_S5_S3 5 -8000 8000 DEPOSIT ABSOLUTE /end AXIS_DESCR
/end CHARACTERISTIC
/begin CHARACTERISTIC KL_POKZUFLARE67 "Sollschlupf abhaengiger Druckoffset zur Vermeidung von Flare" CURVE 0x1C6778 ZF_kl_si16_S5_S3 3 UMR_BAR__1_1000_0_S5_S3 0 3
 /begin AXIS_DESCR STD_AXIS iSasZentr.iSchaltend.nd_synistgang UMR_U_MIN_1_1_0_S5_S3 5 -8000 8000 DEPOSIT ABSOLUTE /end AXIS_DESCR
/end CHARACTERISTIC
/begin CHARACTERISTIC KL_POKZUFLARE78 "Sollschlupf abhaengiger Druckoffset zur Vermeidung von Flare" CURVE 0x1C6950 ZF_kl_si16_S5_S3 3 UMR_BAR__1_1000_0_S5_S3 0 3
 /begin AXIS_DESCR STD_AXIS iSasZentr.iSchaltend.nd_synistgang UMR_U_MIN_1_1_0_S5_S3 5 -8000 8000 DEPOSIT ABSOLUTE /end AXIS_DESCR
/end CHARACTERISTIC
/begin CHARACTERISTIC KL_POKZUMDMOTSOLL12 "Schaltdruckoffset in Abhaengigkeit von md_motsoll_sas" CURVE 0x1C5E08 ZF_kl_si16_S5_S3 12.75 UMR_BAR__1_1000_0_S5_S3 -6.4 6.35
 /begin AXIS_DESCR STD_AXIS NO_INPUT_QUANTITY UMR_NM__1_1_0_S5_S3 6 -1500 1500 DEPOSIT ABSOLUTE /end AXIS_DESCR
/end CHARACTERISTIC
/begin CHARACTERISTIC KL_POKZUMDMOTSOLL23 "Schaltdruckoffset in Abhaengigkeit von md_motsoll_sas" CURVE 0x1C5FE0 ZF_kl_si16_S5_S3 12.75 UMR_BAR__1_1000_0_S5_S3 -6.4 6.35
 /begin AXIS_DESCR STD_AXIS NO_INPUT_QUANTITY UMR_NM__1_1_0_S5_S3 6 -1500 1500 DEPOSIT ABSOLUTE /end AXIS_DESCR
/end CHARACTERISTIC
/begin CHARACTERISTIC KL_POKZUMDMOTSOLL34 "Schaltdruckoffset in Abhaengigkeit von md_motsoll_sas" CURVE 0x1C61B8 ZF_kl_si16_S5_S3 12.75 UMR_BAR__1_1000_0_S5_S3 -6.4 6.35
 /begin AXIS_DESCR STD_AXIS NO_INPUT_QUANTITY UMR_NM__1_1_0_S5_S3 6 -1500 1500 DEPOSIT ABSOLUTE /end AXIS_DESCR
/end CHARACTERISTIC
/begin CHARACTERISTIC KL_POKZUMDMOTSOLL45 "Schaltdruckoffset in Abhaengigkeit von md_motsoll_sas" CURVE 0x1C6390 ZF_kl_si16_S5_S3 12.75 UMR_BAR__1_1000_0_S5_S3 -6.4 6.35
 /begin AXIS_DESCR STD_AXIS NO_INPUT_QUANTITY UMR_NM__1_1_0_S5_S3 6 -1500 1500 DEPOSIT ABSOLUTE /end AXIS_DESCR
/end CHARACTERISTIC
/begin CHARACTERISTIC KL_POKZUMDMOTSOLL56 "Schaltdruckoffset in Abhaengigkeit von md_motsoll_sas" CURVE 0x1C6568 ZF_kl_si16_S5_S3 12.75 UMR_BAR__1_1000_0_S5_S3 -6.4 6.35
 /begin AXIS_DESCR STD_AXIS NO_INPUT_QUANTITY UMR_NM__1_1_0_S5_S3 6 -1500 1500 DEPOSIT ABSOLUTE /end AXIS_DESCR
/end CHARACTERISTIC
/begin CHARACTERISTIC KL_POKZUMDMOTSOLL67 "Schaltdruckoffset in Abhaengigkeit von md_motsoll_sas" CURVE 0x1C6740 ZF_kl_si16_S5_S3 12.75 UMR_BAR__1_1000_0_S5_S3 -6.4 6.35
 /begin AXIS_DESCR STD_AXIS NO_INPUT_QUANTITY UMR_NM__1_1_0_S5_S3 6 -1500 1500 DEPOSIT ABSOLUTE /end AXIS_DESCR
/end CHARACTERISTIC
/begin CHARACTERISTIC KL_POKZUMDMOTSOLL78 "Schaltdruckoffset in Abhaengigkeit von md_motsoll_sas" CURVE 0x1C6918 ZF_kl_si16_S5_S3 12.75 UMR_BAR__1_1000_0_S5_S3 -6.4 6.35
 /begin AXIS_DESCR STD_AXIS NO_INPUT_QUANTITY UMR_NM__1_1_0_S5_S3 6 -1500 1500 DEPOSIT ABSOLUTE /end AXIS_DESCR
/end CHARACTERISTIC
/begin CHARACTERISTIC KL_POKZUMEPOS12 "Schaltdruckoffset f(Momentenerhoehung)" CURVE 0x1C5DB0 ZF_kl_si16_S5_S3 12.75 UMR_BAR__1_1000_0_S5_S3 0 12.75
 /begin AXIS_DESCR STD_AXIS iMoeMesaf.me_sas UMR_NM__1_1_0_S5_S3 5 -1500 1500 DEPOSIT ABSOLUTE /end AXIS_DESCR
/end CHARACTERISTIC
/begin CHARACTERISTIC KL_POKZUMEPOS23 "Schaltdruckoffset f(Momentenerhoehung)" CURVE 0x1C5F88 ZF_kl_si16_S5_S3 12.75 UMR_BAR__1_1000_0_S5_S3 0 12.75
 /begin AXIS_DESCR STD_AXIS iMoeMesaf.me_sas UMR_NM__1_1_0_S5_S3 5 -1500 1500 DEPOSIT ABSOLUTE /end AXIS_DESCR
/end CHARACTERISTIC
/begin CHARACTERISTIC KL_POKZUMEPOS34 "Schaltdruckoffset f(Momentenerhoehung)" CURVE 0x1C6160 ZF_kl_si16_S5_S3 12.75 UMR_BAR__1_1000_0_S5_S3 0 12.75
 /begin AXIS_DESCR STD_AXIS iMoeMesaf.me_sas UMR_NM__1_1_0_S5_S3 5 -1500 1500 DEPOSIT ABSOLUTE /end AXIS_DESCR
/end CHARACTERISTIC
/begin CHARACTERISTIC KL_POKZUMEPOS45 "Schaltdruckoffset f(Momentenerhoehung)" CURVE 0x1C6338 ZF_kl_si16_S5_S3 12.75 UMR_BAR__1_1000_0_S5_S3 0 12.75
 /begin AXIS_DESCR STD_AXIS iMoeMesaf.me_sas UMR_NM__1_1_0_S5_S3 5 -1500 1500 DEPOSIT ABSOLUTE /end AXIS_DESCR
/end CHARACTERISTIC
/begin CHARACTERISTIC KL_POKZUMEPOS56 "Schaltdruckoffset f(Momentenerhoehung)" CURVE 0x1C6510 ZF_kl_si16_S5_S3 12.75 UMR_BAR__1_1000_0_S5_S3 0 12.75
 /begin AXIS_DESCR STD_AXIS iMoeMesaf.me_sas UMR_NM__1_1_0_S5_S3 5 -1500 1500 DEPOSIT ABSOLUTE /end AXIS_DESCR
/end CHARACTERISTIC
/begin CHARACTERISTIC KL_POKZUMEPOS67 "Schaltdruckoffset f(Momentenerhoehung)" CURVE 0x1C66E8 ZF_kl_si16_S5_S3 12.75 UMR_BAR__1_1000_0_S5_S3 0 12.75
 /begin AXIS_DESCR STD_AXIS iMoeMesaf.me_sas UMR_NM__1_1_0_S5_S3 5 -1500 1500 DEPOSIT ABSOLUTE /end AXIS_DESCR
/end CHARACTERISTIC
/begin CHARACTERISTIC KL_POKZUMEPOS78 "Schaltdruckoffset f(Momentenerhoehung)" CURVE 0x1C68C0 ZF_kl_si16_S5_S3 12.75 UMR_BAR__1_1000_0_S5_S3 0 12.75
 /begin AXIS_DESCR STD_AXIS iMoeMesaf.me_sas UMR_NM__1_1_0_S5_S3 5 -1500 1500 DEPOSIT ABSOLUTE /end AXIS_DESCR
/end CHARACTERISTIC
/begin CHARACTERISTIC KL_POLASTDKIV2_7 "Druckoffset auf Fülldruck zweites nichtkraftschließendes Schaltelement" CURVE 0x1C1BB4 ZF_kl_si16_S5_S3 6 UMR_BAR__1_1000_0_S5_S3 0 6
 /begin AXIS_DESCR STD_AXIS zff_atsys._.iSignale._.obj.sig_dki UMR_PROZENT__20_51_0_S5_S3 6 0 100 DEPOSIT ABSOLUTE /end AXIS_DESCR
/end CHARACTERISTIC
/begin CHARACTERISTIC KL_POLASTDKIV2_8 "Druckoffset auf Fülldruck zweites nichtkraftschließendes Schaltelement" CURVE 0x1C20E4 ZF_kl_si16_S5_S3 6 UMR_BAR__1_1000_0_S5_S3 0 6
 /begin AXIS_DESCR STD_AXIS zff_atsys._.iSignale._.obj.sig_dki UMR_PROZENT__20_51_0_S5_S3 6 0 100 DEPOSIT ABSOLUTE /end AXIS_DESCR
/end CHARACTERISTIC
/begin CHARACTERISTIC KL_POLASTDKIV2_R "Druckoffset auf Fülldruck zweites nichtkraftschließendes Schaltelement" CURVE 0x1BF764 ZF_kl_si16_S5_S3 6 UMR_BAR__1_1000_0_S5_S3 0 6
 /begin AXIS_DESCR STD_AXIS zff_atsys._.iSignale._.obj.sig_dki UMR_PROZENT__20_51_0_S5_S3 6 0 100 DEPOSIT ABSOLUTE /end AXIS_DESCR
/end CHARACTERISTIC
/begin CHARACTERISTIC KL_PORAKZU12 "Schaltdruckoffset" CURVE 0x1C5DC8 ZF_kl_si16_S5_S3 12.75 UMR_BAR__1_1000_0_S5_S3 -6.4 6.35
 /begin AXIS_DESCR STD_AXIS iSasZentr.iSchaltend.iKzu.timer_zkzu UMR_MSEC__10_1_0_S5_S3 3 0 2540 DEPOSIT ABSOLUTE /end AXIS_DESCR
/end CHARACTERISTIC
/begin CHARACTERISTIC KL_PORAKZU23 "Schaltdruckoffset" CURVE 0x1C5FA0 ZF_kl_si16_S5_S3 12.75 UMR_BAR__1_1000_0_S5_S3 -6.4 6.35
 /begin AXIS_DESCR STD_AXIS iSasZentr.iSchaltend.iKzu.timer_zkzu UMR_MSEC__10_1_0_S5_S3 3 0 2540 DEPOSIT ABSOLUTE /end AXIS_DESCR
/end CHARACTERISTIC
/begin CHARACTERISTIC KL_PORAKZU34 "Schaltdruckoffset" CURVE 0x1C6178 ZF_kl_si16_S5_S3 12.75 UMR_BAR__1_1000_0_S5_S3 -6.4 6.35
 /begin AXIS_DESCR STD_AXIS iSasZentr.iSchaltend.iKzu.timer_zkzu UMR_MSEC__10_1_0_S5_S3 3 0 2540 DEPOSIT ABSOLUTE /end AXIS_DESCR
/end CHARACTERISTIC
/begin CHARACTERISTIC KL_PORAKZU45 "Schaltdruckoffset" CURVE 0x1C6350 ZF_kl_si16_S5_S3 12.75 UMR_BAR__1_1000_0_S5_S3 -6.4 6.35
 /begin AXIS_DESCR STD_AXIS iSasZentr.iSchaltend.iKzu.timer_zkzu UMR_MSEC__10_1_0_S5_S3 3 0 2540 DEPOSIT ABSOLUTE /end AXIS_DESCR
/end CHARACTERISTIC
/begin CHARACTERISTIC KL_PORAKZU56 "Schaltdruckoffset" CURVE 0x1C6528 ZF_kl_si16_S5_S3 12.75 UMR_BAR__1_1000_0_S5_S3 -6.4 6.35
 /begin AXIS_DESCR STD_AXIS iSasZentr.iSchaltend.iKzu.timer_zkzu UMR_MSEC__10_1_0_S5_S3 3 0 2540 DEPOSIT ABSOLUTE /end AXIS_DESCR
/end CHARACTERISTIC
/begin CHARACTERISTIC KL_PORAKZU67 "Schaltdruckoffset" CURVE 0x1C6700 ZF_kl_si16_S5_S3 12.75 UMR_BAR__1_1000_0_S5_S3 -6.4 6.35
 /begin AXIS_DESCR STD_AXIS iSasZentr.iSchaltend.iKzu.timer_zkzu UMR_MSEC__10_1_0_S5_S3 3 0 2540 DEPOSIT ABSOLUTE /end AXIS_DESCR
/end CHARACTERISTIC
/begin CHARACTERISTIC KL_PORAKZU78 "Schaltdruckoffset" CURVE 0x1C68D8 ZF_kl_si16_S5_S3 12.75 UMR_BAR__1_1000_0_S5_S3 -6.4 6.35
 /begin AXIS_DESCR STD_AXIS iSasZentr.iSchaltend.iKzu.timer_zkzu UMR_MSEC__10_1_0_S5_S3 3 0 2540 DEPOSIT ABSOLUTE /end AXIS_DESCR
/end CHARACTERISTIC
/begin CHARACTERISTIC KL_PORAKZU_7 "Schaltdruckoffset" CURVE 0x1C1760 ZF_kl_si16_S5_S3 12.75 UMR_BAR__1_1000_0_S5_S3 -6.4 6.35
 /begin AXIS_DESCR STD_AXIS NO_INPUT_QUANTITY UMR_MSEC__10_1_0_S5_S3 3 0 2540 DEPOSIT ABSOLUTE /end AXIS_DESCR
/end CHARACTERISTIC
/begin CHARACTERISTIC KL_PORAKZU_8 "Schaltdruckoffset" CURVE 0x1C1C90 ZF_kl_si16_S5_S3 12.75 UMR_BAR__1_1000_0_S5_S3 -6.4 6.35
 /begin AXIS_DESCR STD_AXIS NO_INPUT_QUANTITY UMR_MSEC__10_1_0_S5_S3 3 0 2540 DEPOSIT ABSOLUTE /end AXIS_DESCR
/end CHARACTERISTIC
/begin CHARACTERISTIC KL_PORAKZU_R "Schaltdruckoffset" CURVE 0x1BF310 ZF_kl_si16_S5_S3 12.75 UMR_BAR__1_1000_0_S5_S3 -6.4 6.35
 /begin AXIS_DESCR STD_AXIS NO_INPUT_QUANTITY UMR_MSEC__10_1_0_S5_S3 3 0 2540 DEPOSIT ABSOLUTE /end AXIS_DESCR
/end CHARACTERISTIC
/begin CHARACTERISTIC KL_PORASYN12 "Rampe n.Syn.->letz.Stuetz.y PMAX" CURVE 0x1C5DD8 ZF_kl_si16_S5_S3 12.75 UMR_BAR__1_1000_0_S5_S3 0 12.75
 /begin AXIS_DESCR STD_AXIS iSasZentr.iSchaltend.iKzu.timer_zkzu UMR_MSEC__10_1_0_S5_S3 3 0 2540 DEPOSIT ABSOLUTE /end AXIS_DESCR
/end CHARACTERISTIC
/begin CHARACTERISTIC KL_PORASYN23 "Rampe n.Syn.->letz.Stuetz.y PMAX" CURVE 0x1C5FB0 ZF_kl_si16_S5_S3 12.75 UMR_BAR__1_1000_0_S5_S3 0 12.75
 /begin AXIS_DESCR STD_AXIS iSasZentr.iSchaltend.iKzu.timer_zkzu UMR_MSEC__10_1_0_S5_S3 3 0 2540 DEPOSIT ABSOLUTE /end AXIS_DESCR
/end CHARACTERISTIC
/begin CHARACTERISTIC KL_PORASYN34 "Rampe n.Syn.->letz.Stuetz.y PMAX" CURVE 0x1C6188 ZF_kl_si16_S5_S3 12.75 UMR_BAR__1_1000_0_S5_S3 0 12.75
 /begin AXIS_DESCR STD_AXIS iSasZentr.iSchaltend.iKzu.timer_zkzu UMR_MSEC__10_1_0_S5_S3 3 0 2540 DEPOSIT ABSOLUTE /end AXIS_DESCR
/end CHARACTERISTIC
/begin CHARACTERISTIC KL_PORASYN45 "Rampe n.Syn.->letz.Stuetz.y PMAX" CURVE 0x1C6360 ZF_kl_si16_S5_S3 12.75 UMR_BAR__1_1000_0_S5_S3 0 12.75
 /begin AXIS_DESCR STD_AXIS iSasZentr.iSchaltend.iKzu.timer_zkzu UMR_MSEC__10_1_0_S5_S3 3 0 2540 DEPOSIT ABSOLUTE /end AXIS_DESCR
/end CHARACTERISTIC
/begin CHARACTERISTIC KL_PORASYN56 "Rampe n.Syn.->letz.Stuetz.y PMAX" CURVE 0x1C6538 ZF_kl_si16_S5_S3 12.75 UMR_BAR__1_1000_0_S5_S3 0 12.75
 /begin AXIS_DESCR STD_AXIS iSasZentr.iSchaltend.iKzu.timer_zkzu UMR_MSEC__10_1_0_S5_S3 3 0 2540 DEPOSIT ABSOLUTE /end AXIS_DESCR
/end CHARACTERISTIC
/begin CHARACTERISTIC KL_PORASYN67 "Rampe n.Syn.->letz.Stuetz.y PMAX" CURVE 0x1C6710 ZF_kl_si16_S5_S3 12.75 UMR_BAR__1_1000_0_S5_S3 0 12.75
 /begin AXIS_DESCR STD_AXIS iSasZentr.iSchaltend.iKzu.timer_zkzu UMR_MSEC__10_1_0_S5_S3 3 0 2540 DEPOSIT ABSOLUTE /end AXIS_DESCR
/end CHARACTERISTIC
/begin CHARACTERISTIC KL_PORASYN78 "Rampe n.Syn.->letz.Stuetz.y PMAX" CURVE 0x1C68E8 ZF_kl_si16_S5_S3 12.75 UMR_BAR__1_1000_0_S5_S3 0 12.75
 /begin AXIS_DESCR STD_AXIS iSasZentr.iSchaltend.iKzu.timer_zkzu UMR_MSEC__10_1_0_S5_S3 3 0 2540 DEPOSIT ABSOLUTE /end AXIS_DESCR
/end CHARACTERISTIC
/begin CHARACTERISTIC KL_PORASYNV1_7 "Schliessrampendruckoffset 1. nichtkraftschl. Kupplung" CURVE 0x1C1868 ZF_kl_si16_S5_S3 12.75 UMR_BAR__1_1000_0_S5_S3 0 12.75
 /begin AXIS_DESCR STD_AXIS NO_INPUT_QUANTITY UMR_MSEC__10_1_0_S5_S3 3 0 2540 DEPOSIT ABSOLUTE /end AXIS_DESCR
/end CHARACTERISTIC
/begin CHARACTERISTIC KL_PORASYNV1_8 "Schliessrampendruckoffset 1. nichtkraftschl. Kupplung" CURVE 0x1C1D98 ZF_kl_si16_S5_S3 12.75 UMR_BAR__1_1000_0_S5_S3 0 12.75
 /begin AXIS_DESCR STD_AXIS NO_INPUT_QUANTITY UMR_MSEC__10_1_0_S5_S3 3 0 2540 DEPOSIT ABSOLUTE /end AXIS_DESCR
/end CHARACTERISTIC
/begin CHARACTERISTIC KL_PORASYNV1_R "Schliessrampendruckoffset 1. nichtkraftschl. Kupplung" CURVE 0x1BF418 ZF_kl_si16_S5_S3 12.75 UMR_BAR__1_1000_0_S5_S3 0 12.75
 /begin AXIS_DESCR STD_AXIS NO_INPUT_QUANTITY UMR_MSEC__10_1_0_S5_S3 3 0 2540 DEPOSIT ABSOLUTE /end AXIS_DESCR
/end CHARACTERISTIC
/begin CHARACTERISTIC KL_PORASYNV2_7 "Schliessrampendruckoffset 2. nichtkraftschl. Kupplung" CURVE 0x1C1894 ZF_kl_si16_S5_S3 12.75 UMR_BAR__1_1000_0_S5_S3 0 12.75
 /begin AXIS_DESCR STD_AXIS NO_INPUT_QUANTITY UMR_MSEC__10_1_0_S5_S3 3 0 2540 DEPOSIT ABSOLUTE /end AXIS_DESCR
/end CHARACTERISTIC
/begin CHARACTERISTIC KL_PORASYNV2_8 "Schliessrampendruckoffset 2. nichtkraftschl. Kupplung" CURVE 0x1C1DC4 ZF_kl_si16_S5_S3 12.75 UMR_BAR__1_1000_0_S5_S3 0 12.75
 /begin AXIS_DESCR STD_AXIS NO_INPUT_QUANTITY UMR_MSEC__10_1_0_S5_S3 3 0 2540 DEPOSIT ABSOLUTE /end AXIS_DESCR
/end CHARACTERISTIC
/begin CHARACTERISTIC KL_PORASYNV2_R "Schliessrampendruckoffset 2. nichtkraftschl. Kupplung" CURVE 0x1BF444 ZF_kl_si16_S5_S3 12.75 UMR_BAR__1_1000_0_S5_S3 0 12.75
 /begin AXIS_DESCR STD_AXIS NO_INPUT_QUANTITY UMR_MSEC__10_1_0_S5_S3 3 0 2540 DEPOSIT ABSOLUTE /end AXIS_DESCR
/end CHARACTERISTIC
/begin CHARACTERISTIC KL_PORASYN_7 "Rampe n.Syn.->letz.Stuetz.y PMAX" CURVE 0x1C19D4 ZF_kl_si16_S5_S3 12.75 UMR_BAR__1_1000_0_S5_S3 0 12.75
 /begin AXIS_DESCR STD_AXIS NO_INPUT_QUANTITY UMR_MSEC__10_1_0_S5_S3 3 0 2540 DEPOSIT ABSOLUTE /end AXIS_DESCR
/end CHARACTERISTIC
/begin CHARACTERISTIC KL_PORASYN_8 "Rampe n.Syn.->letz.Stuetz.y PMAX" CURVE 0x1C1F04 ZF_kl_si16_S5_S3 12.75 UMR_BAR__1_1000_0_S5_S3 0 12.75
 /begin AXIS_DESCR STD_AXIS NO_INPUT_QUANTITY UMR_MSEC__10_1_0_S5_S3 3 0 2540 DEPOSIT ABSOLUTE /end AXIS_DESCR
/end CHARACTERISTIC
/begin CHARACTERISTIC KL_PORASYN_R "Rampe n.Syn.->letz.Stuetz.y PMAX" CURVE 0x1BF584 ZF_kl_si16_S5_S3 12.75 UMR_BAR__1_1000_0_S5_S3 0 12.75
 /begin AXIS_DESCR STD_AXIS NO_INPUT_QUANTITY UMR_MSEC__10_1_0_S5_S3 3 0 2540 DEPOSIT ABSOLUTE /end AXIS_DESCR
/end CHARACTERISTIC
/begin CHARACTERISTIC KL_TFCGFUELLOPT12 "Fuellzeit in Abhaengigkeit von der Getriebetemp." CURVE 0x1C5CD4 ZF_kl_ui8_S5_S3 2540 UMR_MSEC__10_1_0_S5_S3 0 2540
 /begin AXIS_DESCR STD_AXIS zff_atsys._.iSignale._.obj.sig_c_getr UMR_GRADC__1_1_M40_S5_S3 10 -40 150 DEPOSIT ABSOLUTE /end AXIS_DESCR
/end CHARACTERISTIC
/begin CHARACTERISTIC KL_TFCGFUELLOPT23 "Fuellzeit in Abhaengigkeit von der Getriebetemp." CURVE 0x1C5EAC ZF_kl_ui8_S5_S3 2540 UMR_MSEC__10_1_0_S5_S3 0 2540
 /begin AXIS_DESCR STD_AXIS zff_atsys._.iSignale._.obj.sig_c_getr UMR_GRADC__1_1_M40_S5_S3 10 -40 150 DEPOSIT ABSOLUTE /end AXIS_DESCR
/end CHARACTERISTIC
/begin CHARACTERISTIC KL_TFCGFUELLOPT34 "Fuellzeit in Abhaengigkeit von der Getriebetemp." CURVE 0x1C6084 ZF_kl_ui8_S5_S3 2540 UMR_MSEC__10_1_0_S5_S3 0 2540
 /begin AXIS_DESCR STD_AXIS zff_atsys._.iSignale._.obj.sig_c_getr UMR_GRADC__1_1_M40_S5_S3 10 -40 150 DEPOSIT ABSOLUTE /end AXIS_DESCR
/end CHARACTERISTIC
/begin CHARACTERISTIC KL_TFCGFUELLOPT45 "Fuellzeit in Abhaengigkeit von der Getriebetemp." CURVE 0x1C625C ZF_kl_ui8_S5_S3 2540 UMR_MSEC__10_1_0_S5_S3 0 2540
 /begin AXIS_DESCR STD_AXIS zff_atsys._.iSignale._.obj.sig_c_getr UMR_GRADC__1_1_M40_S5_S3 10 -40 150 DEPOSIT ABSOLUTE /end AXIS_DESCR
/end CHARACTERISTIC
/begin CHARACTERISTIC KL_TFCGFUELLOPT56 "Fuellzeit in Abhaengigkeit von der Getriebetemp." CURVE 0x1C6434 ZF_kl_ui8_S5_S3 2540 UMR_MSEC__10_1_0_S5_S3 0 2540
 /begin AXIS_DESCR STD_AXIS zff_atsys._.iSignale._.obj.sig_c_getr UMR_GRADC__1_1_M40_S5_S3 10 -40 150 DEPOSIT ABSOLUTE /end AXIS_DESCR
/end CHARACTERISTIC
/begin CHARACTERISTIC KL_TFCGFUELLOPT67 "Fuellzeit in Abhaengigkeit von der Getriebetemp." CURVE 0x1C660C ZF_kl_ui8_S5_S3 2540 UMR_MSEC__10_1_0_S5_S3 0 2540
 /begin AXIS_DESCR STD_AXIS zff_atsys._.iSignale._.obj.sig_c_getr UMR_GRADC__1_1_M40_S5_S3 10 -40 150 DEPOSIT ABSOLUTE /end AXIS_DESCR
/end CHARACTERISTIC
/begin CHARACTERISTIC KL_TFCGFUELLOPT78 "Fuellzeit in Abhaengigkeit von der Getriebetemp." CURVE 0x1C67E4 ZF_kl_ui8_S5_S3 2540 UMR_MSEC__10_1_0_S5_S3 0 2540
 /begin AXIS_DESCR STD_AXIS zff_atsys._.iSignale._.obj.sig_c_getr UMR_GRADC__1_1_M40_S5_S3 10 -40 150 DEPOSIT ABSOLUTE /end AXIS_DESCR
/end CHARACTERISTIC
/begin CHARACTERISTIC KL_TFCGFUELLRED12 "Fuellzeit in Abhaengigkeit von der Getriebetemp." CURVE 0x1C5CBC ZF_kl_ui8_S5_S3 2540 UMR_MSEC__10_1_0_S5_S3 0 2540
 /begin AXIS_DESCR STD_AXIS zff_atsys._.iSignale._.obj.sig_c_getr UMR_GRADC__1_1_M40_S5_S3 10 -40 150 DEPOSIT ABSOLUTE /end AXIS_DESCR
/end CHARACTERISTIC
/begin CHARACTERISTIC KL_TFCGFUELLRED23 "Fuellzeit in Abhaengigkeit von der Getriebetemp." CURVE 0x1C5E94 ZF_kl_ui8_S5_S3 2540 UMR_MSEC__10_1_0_S5_S3 0 2540
 /begin AXIS_DESCR STD_AXIS zff_atsys._.iSignale._.obj.sig_c_getr UMR_GRADC__1_1_M40_S5_S3 10 -40 150 DEPOSIT ABSOLUTE /end AXIS_DESCR
/end CHARACTERISTIC
/begin CHARACTERISTIC KL_TFCGFUELLRED34 "Fuellzeit in Abhaengigkeit von der Getriebetemp." CURVE 0x1C606C ZF_kl_ui8_S5_S3 2540 UMR_MSEC__10_1_0_S5_S3 0 2540
 /begin AXIS_DESCR STD_AXIS zff_atsys._.iSignale._.obj.sig_c_getr UMR_GRADC__1_1_M40_S5_S3 10 -40 150 DEPOSIT ABSOLUTE /end AXIS_DESCR
/end CHARACTERISTIC
/begin CHARACTERISTIC KL_TFCGFUELLRED45 "Fuellzeit in Abhaengigkeit von der Getriebetemp." CURVE 0x1C6244 ZF_kl_ui8_S5_S3 2540 UMR_MSEC__10_1_0_S5_S3 0 2540
 /begin AXIS_DESCR STD_AXIS zff_atsys._.iSignale._.obj.sig_c_getr UMR_GRADC__1_1_M40_S5_S3 10 -40 150 DEPOSIT ABSOLUTE /end AXIS_DESCR
/end CHARACTERISTIC
/begin CHARACTERISTIC KL_TFCGFUELLRED56 "Fuellzeit in Abhaengigkeit von der Getriebetemp." CURVE 0x1C641C ZF_kl_ui8_S5_S3 2540 UMR_MSEC__10_1_0_S5_S3 0 2540
 /begin AXIS_DESCR STD_AXIS zff_atsys._.iSignale._.obj.sig_c_getr UMR_GRADC__1_1_M40_S5_S3 10 -40 150 DEPOSIT ABSOLUTE /end AXIS_DESCR
/end CHARACTERISTIC
/begin CHARACTERISTIC KL_TFCGFUELLRED67 "Fuellzeit in Abhaengigkeit von der Getriebetemp." CURVE 0x1C65F4 ZF_kl_ui8_S5_S3 2540 UMR_MSEC__10_1_0_S5_S3 0 2540
 /begin AXIS_DESCR STD_AXIS zff_atsys._.iSignale._.obj.sig_c_getr UMR_GRADC__1_1_M40_S5_S3 10 -40 150 DEPOSIT ABSOLUTE /end AXIS_DESCR
/end CHARACTERISTIC
/begin CHARACTERISTIC KL_TFCGFUELLRED78 "Fuellzeit in Abhaengigkeit von der Getriebetemp." CURVE 0x1C67CC ZF_kl_ui8_S5_S3 2540 UMR_MSEC__10_1_0_S5_S3 0 2540
 /begin AXIS_DESCR STD_AXIS zff_atsys._.iSignale._.obj.sig_c_getr UMR_GRADC__1_1_M40_S5_S3 10 -40 150 DEPOSIT ABSOLUTE /end AXIS_DESCR
/end CHARACTERISTIC
/begin CHARACTERISTIC KL_TFCGGE_7 "Fuellzeit" CURVE 0x1C18D0 ZF_kl_ui16_S5_S3 2540 UMR_MSEC__10_1_0_S5_S3 0 2540
 /begin AXIS_DESCR STD_AXIS zff_atsys._.iSignale._.obj.sig_c_getr UMR_GRADC__1_1_M40_S5_S3 10 -40 210 DEPOSIT ABSOLUTE /end AXIS_DESCR
/end CHARACTERISTIC
/begin CHARACTERISTIC KL_TFCGGE_8 "Fuellzeit" CURVE 0x1C1E00 ZF_kl_ui16_S5_S3 2540 UMR_MSEC__10_1_0_S5_S3 0 2540
 /begin AXIS_DESCR STD_AXIS zff_atsys._.iSignale._.obj.sig_c_getr UMR_GRADC__1_1_M40_S5_S3 10 -40 210 DEPOSIT ABSOLUTE /end AXIS_DESCR
/end CHARACTERISTIC
/begin CHARACTERISTIC KL_TFCGGE_R "Fuellzeit" CURVE 0x1BF480 ZF_kl_ui16_S5_S3 2540 UMR_MSEC__10_1_0_S5_S3 0 2540
 /begin AXIS_DESCR STD_AXIS zff_atsys._.iSignale._.obj.sig_c_getr UMR_GRADC__1_1_M40_S5_S3 10 -40 210 DEPOSIT ABSOLUTE /end AXIS_DESCR
/end CHARACTERISTIC
/begin CHARACTERISTIC KL_TFCGV2_7 "Fuellzeit GE 2. nicht kraftschl. Kupplung" CURVE 0x1C1910 ZF_kl_ui16_S5_S3 2540 UMR_MSEC__10_1_0_S5_S3 0 2540
 /begin AXIS_DESCR STD_AXIS zff_atsys._.iSignale._.obj.sig_c_getr UMR_GRADC__1_1_M40_S5_S3 4 -40 210 DEPOSIT ABSOLUTE /end AXIS_DESCR
/end CHARACTERISTIC
/begin CHARACTERISTIC KL_TFCGV2_8 "Fuellzeit GE 2. nicht kraftschl. Kupplung" CURVE 0x1C1E40 ZF_kl_ui16_S5_S3 2540 UMR_MSEC__10_1_0_S5_S3 0 2540
 /begin AXIS_DESCR STD_AXIS zff_atsys._.iSignale._.obj.sig_c_getr UMR_GRADC__1_1_M40_S5_S3 4 -40 210 DEPOSIT ABSOLUTE /end AXIS_DESCR
/end CHARACTERISTIC
/begin CHARACTERISTIC KL_TFCGV2_R "Fuellzeit GE 2. nicht kraftschl. Kupplung" CURVE 0x1BF4C0 ZF_kl_ui16_S5_S3 2540 UMR_MSEC__10_1_0_S5_S3 0 2540
 /begin AXIS_DESCR STD_AXIS zff_atsys._.iSignale._.obj.sig_c_getr UMR_GRADC__1_1_M40_S5_S3 4 -40 210 DEPOSIT ABSOLUTE /end AXIS_DESCR
/end CHARACTERISTIC
/begin CHARACTERISTIC KL_TFV1_7 "Fuellzeit GE 1. nicht kraftschl. Kupplung" CURVE 0x1C18FC ZF_kl_ui16_S5_S3 2540 UMR_MSEC__10_1_0_S5_S3 0 2540
 /begin AXIS_DESCR STD_AXIS zff_atsys._.iSignale._.obj.sig_n_ab UMR_U_MIN_1_1_0_S5_S3 4 0 8160 DEPOSIT ABSOLUTE /end AXIS_DESCR
/end CHARACTERISTIC
/begin CHARACTERISTIC KL_TFV1_8 "Fuellzeit GE 1. nicht kraftschl. Kupplung" CURVE 0x1C1E2C ZF_kl_ui16_S5_S3 2540 UMR_MSEC__10_1_0_S5_S3 0 2540
 /begin AXIS_DESCR STD_AXIS zff_atsys._.iSignale._.obj.sig_n_ab UMR_U_MIN_1_1_0_S5_S3 4 0 8160 DEPOSIT ABSOLUTE /end AXIS_DESCR
/end CHARACTERISTIC
/begin CHARACTERISTIC KL_TFV1_R "Fuellzeit GE 1. nicht kraftschl. Kupplung" CURVE 0x1BF4AC ZF_kl_ui16_S5_S3 2540 UMR_MSEC__10_1_0_S5_S3 0 2540
 /begin AXIS_DESCR STD_AXIS zff_atsys._.iSignale._.obj.sig_n_ab UMR_U_MIN_1_1_0_S5_S3 4 0 8160 DEPOSIT ABSOLUTE /end AXIS_DESCR
/end CHARACTERISTIC
/begin CHARACTERISTIC KL_TOVKZUCG_7 "Offset auf Verzoegerungszeit kraftschliessende KZU" CURVE 0x1C18A4 ZF_kl_ui8_S5_S3 2540 UMR_MSEC__10_1_0_S5_S3 0 2540
 /begin AXIS_DESCR STD_AXIS zff_atsys._.iSignale._.obj.sig_c_getr UMR_GRADC__1_1_M40_S5_S3 4 -40 150 DEPOSIT ABSOLUTE /end AXIS_DESCR
/end CHARACTERISTIC
/begin CHARACTERISTIC KL_TOVKZUCG_8 "Offset auf Verzoegerungszeit kraftschliessende KZU" CURVE 0x1C1DD4 ZF_kl_ui8_S5_S3 2540 UMR_MSEC__10_1_0_S5_S3 0 2540
 /begin AXIS_DESCR STD_AXIS zff_atsys._.iSignale._.obj.sig_c_getr UMR_GRADC__1_1_M40_S5_S3 4 -40 150 DEPOSIT ABSOLUTE /end AXIS_DESCR
/end CHARACTERISTIC
/begin CHARACTERISTIC KL_TOVKZUCG_R "Offset auf Verzoegerungszeit kraftschliessende KZU" CURVE 0x1BF454 ZF_kl_ui8_S5_S3 2540 UMR_MSEC__10_1_0_S5_S3 0 2540
 /begin AXIS_DESCR STD_AXIS zff_atsys._.iSignale._.obj.sig_c_getr UMR_GRADC__1_1_M40_S5_S3 4 -40 150 DEPOSIT ABSOLUTE /end AXIS_DESCR
/end CHARACTERISTIC
/begin CHARACTERISTIC KL_TRA21 "Kennlinie Zeit Erste Rampe" CURVE 0x1C6968 ZF_kl_ui8_S5_S3 2540 UMR_MSEC__10_1_0_S5_S3 0 2540
 /begin AXIS_DESCR STD_AXIS zff_atsys._.iSignale._.obj.sig_m_t8 UMR_NM__6_1_M34_S5_S3 4 -204 1326 DEPOSIT ABSOLUTE /end AXIS_DESCR
/end CHARACTERISTIC
/begin CHARACTERISTIC KL_TRA21_EL "Kennlinie Zeit Erste Rampe" CURVE 0x1C6974 ZF_kl_ui8_S5_S3 2540 UMR_MSEC__10_1_0_S5_S3 0 2540
 /begin AXIS_DESCR STD_AXIS zff_atsys._.iSignale._.obj.sig_m_t8 UMR_NM__6_1_M34_S5_S3 4 -204 1326 DEPOSIT ABSOLUTE /end AXIS_DESCR
/end CHARACTERISTIC
/begin CHARACTERISTIC KL_TSYNCGHINSYNEKZU21 "Zeit fuer Ende Haltephase in Synchron KZU" CURVE 0x1C6BD0 ZF_kl_ui8_S5_S3 2550 UMR_MSEC__10_1_M128_S5_S3 -1280 1270
 /begin AXIS_DESCR STD_AXIS zff_atsys._.iSignale._.obj.sig_c_getr UMR_GRADC__1_1_M40_S5_S3 4 -40 150 DEPOSIT ABSOLUTE /end AXIS_DESCR
/end CHARACTERISTIC
/begin CHARACTERISTIC KL_TSYNMTRAKZU12 "Zeit vor sync. Ende Schaltdruck/Start 3. Rampe KZU" CURVE 0x1C2100 ZF_kl_ui8_S5_S3 1280 UMR_MSEC__10_1_M128_S5_S3 -1280 0
 /begin AXIS_DESCR STD_AXIS zff_atsys._.iSignale._.obj.sig_m_t8 UMR_NM__6_1_M34_S5_S3 4 -204 1326 DEPOSIT ABSOLUTE /end AXIS_DESCR
/end CHARACTERISTIC
/begin CHARACTERISTIC KL_TSYNMTRAKZU12_EL "Zeit vor sync. Ende Schaltdruck/Start 3. Rampe KZU" CURVE 0x1C210C ZF_kl_ui8_S5_S3 1280 UMR_MSEC__10_1_M128_S5_S3 -1280 0
 /begin AXIS_DESCR STD_AXIS zff_atsys._.iSignale._.obj.sig_m_t8 UMR_NM__6_1_M34_S5_S3 4 -204 1326 DEPOSIT ABSOLUTE /end AXIS_DESCR
/end CHARACTERISTIC
/begin CHARACTERISTIC KL_TSYNMTRAKZU23 "Zeit vor sync. Ende Schaltdruck/Start 3. Rampe KZU" CURVE 0x1C24D0 ZF_kl_ui8_S5_S3 1280 UMR_MSEC__10_1_M128_S5_S3 -1280 0
 /begin AXIS_DESCR STD_AXIS zff_atsys._.iSignale._.obj.sig_m_t8 UMR_NM__6_1_M34_S5_S3 4 -204 1326 DEPOSIT ABSOLUTE /end AXIS_DESCR
/end CHARACTERISTIC
/begin CHARACTERISTIC KL_TSYNMTRAKZU23_EL "Zeit vor sync. Ende Schaltdruck/Start 3. Rampe KZU" CURVE 0x1C24DC ZF_kl_ui8_S5_S3 1280 UMR_MSEC__10_1_M128_S5_S3 -1280 0
 /begin AXIS_DESCR STD_AXIS zff_atsys._.iSignale._.obj.sig_m_t8 UMR_NM__6_1_M34_S5_S3 4 -204 1326 DEPOSIT ABSOLUTE /end AXIS_DESCR
/end CHARACTERISTIC
/begin CHARACTERISTIC KL_TSYNMTRAKZU34 "Zeit vor sync. Ende Schaltdruck/Start 3. Rampe KZU" CURVE 0x1C28A0 ZF_kl_ui8_S5_S3 1280 UMR_MSEC__10_1_M128_S5_S3 -1280 0
 /begin AXIS_DESCR STD_AXIS zff_atsys._.iSignale._.obj.sig_m_t8 UMR_NM__6_1_M34_S5_S3 4 -204 1326 DEPOSIT ABSOLUTE /end AXIS_DESCR
/end CHARACTERISTIC
/begin CHARACTERISTIC KL_TSYNMTRAKZU34_EL "Zeit vor sync. Ende Schaltdruck/Start 3. Rampe KZU" CURVE 0x1C28AC ZF_kl_ui8_S5_S3 1280 UMR_MSEC__10_1_M128_S5_S3 -1280 0
 /begin AXIS_DESCR STD_AXIS zff_atsys._.iSignale._.obj.sig_m_t8 UMR_NM__6_1_M34_S5_S3 4 -204 1326 DEPOSIT ABSOLUTE /end AXIS_DESCR
/end CHARACTERISTIC
/begin CHARACTERISTIC KL_TSYNMTRAKZU45 "Zeit vor sync. Ende Schaltdruck/Start 3. Rampe KZU" CURVE 0x1C2C70 ZF_kl_ui8_S5_S3 1280 UMR_MSEC__10_1_M128_S5_S3 -1280 0
 /begin AXIS_DESCR STD_AXIS zff_atsys._.iSignale._.obj.sig_m_t8 UMR_NM__6_1_M34_S5_S3 4 -204 1326 DEPOSIT ABSOLUTE /end AXIS_DESCR
/end CHARACTERISTIC
/begin CHARACTERISTIC KL_TSYNMTRAKZU45_EL "Zeit vor sync. Ende Schaltdruck/Start 3. Rampe KZU" CURVE 0x1C2C7C ZF_kl_ui8_S5_S3 1280 UMR_MSEC__10_1_M128_S5_S3 -1280 0
 /begin AXIS_DESCR STD_AXIS zff_atsys._.iSignale._.obj.sig_m_t8 UMR_NM__6_1_M34_S5_S3 4 -204 1326 DEPOSIT ABSOLUTE /end AXIS_DESCR
/end CHARACTERISTIC
/begin CHARACTERISTIC KL_TSYNMTRAKZU56 "Zeit vor sync. Ende Schaltdruck/Start 3. Rampe KZU" CURVE 0x1C3040 ZF_kl_ui8_S5_S3 1280 UMR_MSEC__10_1_M128_S5_S3 -1280 0
 /begin AXIS_DESCR STD_AXIS zff_atsys._.iSignale._.obj.sig_m_t8 UMR_NM__6_1_M34_S5_S3 4 -204 1326 DEPOSIT ABSOLUTE /end AXIS_DESCR
/end CHARACTERISTIC
/begin CHARACTERISTIC KL_TSYNMTRAKZU56_EL "Zeit vor sync. Ende Schaltdruck/Start 3. Rampe KZU" CURVE 0x1C304C ZF_kl_ui8_S5_S3 1280 UMR_MSEC__10_1_M128_S5_S3 -1280 0
 /begin AXIS_DESCR STD_AXIS zff_atsys._.iSignale._.obj.sig_m_t8 UMR_NM__6_1_M34_S5_S3 4 -204 1326 DEPOSIT ABSOLUTE /end AXIS_DESCR
/end CHARACTERISTIC
/begin CHARACTERISTIC KL_TSYNMTRAKZU67 "Zeit vor sync. Ende Schaltdruck/Start 3. Rampe KZU" CURVE 0x1C3410 ZF_kl_ui8_S5_S3 1280 UMR_MSEC__10_1_M128_S5_S3 -1280 0
 /begin AXIS_DESCR STD_AXIS zff_atsys._.iSignale._.obj.sig_m_t8 UMR_NM__6_1_M34_S5_S3 4 -204 1326 DEPOSIT ABSOLUTE /end AXIS_DESCR
/end CHARACTERISTIC
/begin CHARACTERISTIC KL_TSYNMTRAKZU67_EL "Zeit vor sync. Ende Schaltdruck/Start 3. Rampe KZU" CURVE 0x1C341C ZF_kl_ui8_S5_S3 1280 UMR_MSEC__10_1_M128_S5_S3 -1280 0
 /begin AXIS_DESCR STD_AXIS zff_atsys._.iSignale._.obj.sig_m_t8 UMR_NM__6_1_M34_S5_S3 4 -204 1326 DEPOSIT ABSOLUTE /end AXIS_DESCR
/end CHARACTERISTIC
/begin CHARACTERISTIC KL_TSYNMTRAKZU78 "Zeit vor sync. Ende Schaltdruck/Start 3. Rampe KZU" CURVE 0x1C37E0 ZF_kl_ui8_S5_S3 1280 UMR_MSEC__10_1_M128_S5_S3 -1280 0
 /begin AXIS_DESCR STD_AXIS zff_atsys._.iSignale._.obj.sig_m_t8 UMR_NM__6_1_M34_S5_S3 4 -204 1326 DEPOSIT ABSOLUTE /end AXIS_DESCR
/end CHARACTERISTIC
/begin CHARACTERISTIC KL_TSYNMTRAKZU78_EL "Zeit vor sync. Ende Schaltdruck/Start 3. Rampe KZU" CURVE 0x1C37EC ZF_kl_ui8_S5_S3 1280 UMR_MSEC__10_1_M128_S5_S3 -1280 0
 /begin AXIS_DESCR STD_AXIS zff_atsys._.iSignale._.obj.sig_m_t8 UMR_NM__6_1_M34_S5_S3 4 -204 1326 DEPOSIT ABSOLUTE /end AXIS_DESCR
/end CHARACTERISTIC
/begin CHARACTERISTIC KL_TSYNMTRAKZUSP12 "Zeit vor sync. Ende Schaltdruck/Start 3. Rampe KZU" CURVE 0x1C3BB0 ZF_kl_ui8_S5_S3 1280 UMR_MSEC__10_1_M128_S5_S3 -1280 0
 /begin AXIS_DESCR STD_AXIS zff_atsys._.iSignale._.obj.sig_m_t8 UMR_NM__6_1_M34_S5_S3 4 -204 1326 DEPOSIT ABSOLUTE /end AXIS_DESCR
/end CHARACTERISTIC
/begin CHARACTERISTIC KL_TSYNMTRAKZUSP23 "Zeit vor sync. Ende Schaltdruck/Start 3. Rampe KZU" CURVE 0x1C3E08 ZF_kl_ui8_S5_S3 1280 UMR_MSEC__10_1_M128_S5_S3 -1280 0
 /begin AXIS_DESCR STD_AXIS zff_atsys._.iSignale._.obj.sig_m_t8 UMR_NM__6_1_M34_S5_S3 4 -204 1326 DEPOSIT ABSOLUTE /end AXIS_DESCR
/end CHARACTERISTIC
/begin CHARACTERISTIC KL_TSYNMTRAKZUSP34 "Zeit vor sync. Ende Schaltdruck/Start 3. Rampe KZU" CURVE 0x1C4060 ZF_kl_ui8_S5_S3 1280 UMR_MSEC__10_1_M128_S5_S3 -1280 0
 /begin AXIS_DESCR STD_AXIS zff_atsys._.iSignale._.obj.sig_m_t8 UMR_NM__6_1_M34_S5_S3 4 -204 1326 DEPOSIT ABSOLUTE /end AXIS_DESCR
/end CHARACTERISTIC
/begin CHARACTERISTIC KL_TSYNMTRAKZUSP45 "Zeit vor sync. Ende Schaltdruck/Start 3. Rampe KZU" CURVE 0x1C42B8 ZF_kl_ui8_S5_S3 1280 UMR_MSEC__10_1_M128_S5_S3 -1280 0
 /begin AXIS_DESCR STD_AXIS zff_atsys._.iSignale._.obj.sig_m_t8 UMR_NM__6_1_M34_S5_S3 4 -204 1326 DEPOSIT ABSOLUTE /end AXIS_DESCR
/end CHARACTERISTIC
/begin CHARACTERISTIC KL_TSYNMTRAKZUSP56 "Zeit vor sync. Ende Schaltdruck/Start 3. Rampe KZU" CURVE 0x1C4510 ZF_kl_ui8_S5_S3 1280 UMR_MSEC__10_1_M128_S5_S3 -1280 0
 /begin AXIS_DESCR STD_AXIS zff_atsys._.iSignale._.obj.sig_m_t8 UMR_NM__6_1_M34_S5_S3 4 -204 1326 DEPOSIT ABSOLUTE /end AXIS_DESCR
/end CHARACTERISTIC
/begin CHARACTERISTIC KL_TSYNMTRAKZUSP67 "Zeit vor sync. Ende Schaltdruck/Start 3. Rampe KZU" CURVE 0x1C4768 ZF_kl_ui8_S5_S3 1280 UMR_MSEC__10_1_M128_S5_S3 -1280 0
 /begin AXIS_DESCR STD_AXIS zff_atsys._.iSignale._.obj.sig_m_t8 UMR_NM__6_1_M34_S5_S3 4 -204 1326 DEPOSIT ABSOLUTE /end AXIS_DESCR
/end CHARACTERISTIC
/begin CHARACTERISTIC KL_TSYNMTRAKZUSP78 "Zeit vor sync. Ende Schaltdruck/Start 3. Rampe KZU" CURVE 0x1C49C0 ZF_kl_ui8_S5_S3 1280 UMR_MSEC__10_1_M128_S5_S3 -1280 0
 /begin AXIS_DESCR STD_AXIS zff_atsys._.iSignale._.obj.sig_m_t8 UMR_NM__6_1_M34_S5_S3 4 -204 1326 DEPOSIT ABSOLUTE /end AXIS_DESCR
/end CHARACTERISTIC
/begin CHARACTERISTIC KL_TSYNMTRAKZUSPORT12 "Zeit vor sync. Ende Schaltdruck/Start 3. Rampe KZU" CURVE 0x1C4C18 ZF_kl_ui8_S5_S3 1280 UMR_MSEC__10_1_M128_S5_S3 -1280 0
 /begin AXIS_DESCR STD_AXIS zff_atsys._.iSignale._.obj.sig_m_t8 UMR_NM__6_1_M34_S5_S3 4 -204 1326 DEPOSIT ABSOLUTE /end AXIS_DESCR
/end CHARACTERISTIC
/begin CHARACTERISTIC KL_TSYNMTRAKZUSPORT23 "Zeit vor sync. Ende Schaltdruck/Start 3. Rampe KZU" CURVE 0x1C4E70 ZF_kl_ui8_S5_S3 1280 UMR_MSEC__10_1_M128_S5_S3 -1280 0
 /begin AXIS_DESCR STD_AXIS zff_atsys._.iSignale._.obj.sig_m_t8 UMR_NM__6_1_M34_S5_S3 4 -204 1326 DEPOSIT ABSOLUTE /end AXIS_DESCR
/end CHARACTERISTIC
/begin CHARACTERISTIC KL_TSYNMTRAKZUSPORT34 "Zeit vor sync. Ende Schaltdruck/Start 3. Rampe KZU" CURVE 0x1C50C8 ZF_kl_ui8_S5_S3 1280 UMR_MSEC__10_1_M128_S5_S3 -1280 0
 /begin AXIS_DESCR STD_AXIS zff_atsys._.iSignale._.obj.sig_m_t8 UMR_NM__6_1_M34_S5_S3 4 -204 1326 DEPOSIT ABSOLUTE /end AXIS_DESCR
/end CHARACTERISTIC
/begin CHARACTERISTIC KL_TSYNMTRAKZUSPORT45 "Zeit vor sync. Ende Schaltdruck/Start 3. Rampe KZU" CURVE 0x1C5320 ZF_kl_ui8_S5_S3 1280 UMR_MSEC__10_1_M128_S5_S3 -1280 0
 /begin AXIS_DESCR STD_AXIS zff_atsys._.iSignale._.obj.sig_m_t8 UMR_NM__6_1_M34_S5_S3 4 -204 1326 DEPOSIT ABSOLUTE /end AXIS_DESCR
/end CHARACTERISTIC
/begin CHARACTERISTIC KL_TSYNMTRAKZUSPORT56 "Zeit vor sync. Ende Schaltdruck/Start 3. Rampe KZU" CURVE 0x1C5578 ZF_kl_ui8_S5_S3 1280 UMR_MSEC__10_1_M128_S5_S3 -1280 0
 /begin AXIS_DESCR STD_AXIS zff_atsys._.iSignale._.obj.sig_m_t8 UMR_NM__6_1_M34_S5_S3 4 -204 1326 DEPOSIT ABSOLUTE /end AXIS_DESCR
/end CHARACTERISTIC
/begin CHARACTERISTIC KL_TSYNMTRAKZUSPORT67 "Zeit vor sync. Ende Schaltdruck/Start 3. Rampe KZU" CURVE 0x1C57D0 ZF_kl_ui8_S5_S3 1280 UMR_MSEC__10_1_M128_S5_S3 -1280 0
 /begin AXIS_DESCR STD_AXIS zff_atsys._.iSignale._.obj.sig_m_t8 UMR_NM__6_1_M34_S5_S3 4 -204 1326 DEPOSIT ABSOLUTE /end AXIS_DESCR
/end CHARACTERISTIC
/begin CHARACTERISTIC KL_TSYNMTRAKZUSPORT78 "Zeit vor sync. Ende Schaltdruck/Start 3. Rampe KZU" CURVE 0x1C5A28 ZF_kl_ui8_S5_S3 1280 UMR_MSEC__10_1_M128_S5_S3 -1280 0
 /begin AXIS_DESCR STD_AXIS zff_atsys._.iSignale._.obj.sig_m_t8 UMR_NM__6_1_M34_S5_S3 4 -204 1326 DEPOSIT ABSOLUTE /end AXIS_DESCR
/end CHARACTERISTIC
/begin CHARACTERISTIC KL_TVKZUCGV2_7 "Verzoegerungszeit 2. nichtkraftschliessende KZU" CURVE 0x1C18C4 ZF_kl_ui8_S5_S3 2540 UMR_MSEC__10_1_0_S5_S3 0 2540
 /begin AXIS_DESCR STD_AXIS zff_atsys._.iSignale._.obj.sig_c_getr UMR_GRADC__1_1_M40_S5_S3 4 -40 150 DEPOSIT ABSOLUTE /end AXIS_DESCR
/end CHARACTERISTIC
/begin CHARACTERISTIC KL_TVKZUCGV2_8 "Verzoegerungszeit 2. nichtkraftschliessende KZU" CURVE 0x1C1DF4 ZF_kl_ui8_S5_S3 2540 UMR_MSEC__10_1_0_S5_S3 0 2540
 /begin AXIS_DESCR STD_AXIS zff_atsys._.iSignale._.obj.sig_c_getr UMR_GRADC__1_1_M40_S5_S3 4 -40 150 DEPOSIT ABSOLUTE /end AXIS_DESCR
/end CHARACTERISTIC
/begin CHARACTERISTIC KL_TVKZUCGV2_R "Verzoegerungszeit 2. nichtkraftschliessende KZU" CURVE 0x1BF474 ZF_kl_ui8_S5_S3 2540 UMR_MSEC__10_1_0_S5_S3 0 2540
 /begin AXIS_DESCR STD_AXIS zff_atsys._.iSignale._.obj.sig_c_getr UMR_GRADC__1_1_M40_S5_S3 4 -40 150 DEPOSIT ABSOLUTE /end AXIS_DESCR
/end CHARACTERISTIC
/begin CHARACTERISTIC KL_TVKZU_7 "Verzoegerungszeit kraftschliessende KZU" CURVE 0x1C18B0 ZF_kl_ui16_S5_S3 2540 UMR_MSEC__10_1_0_S5_S3 0 2540
 /begin AXIS_DESCR STD_AXIS zff_atsys._.iSignale._.obj.sig_n_ab UMR_U_MIN_1_1_0_S5_S3 4 0 8160 DEPOSIT ABSOLUTE /end AXIS_DESCR
/end CHARACTERISTIC
/begin CHARACTERISTIC KL_TVKZU_8 "Verzoegerungszeit kraftschliessende KZU" CURVE 0x1C1DE0 ZF_kl_ui16_S5_S3 2540 UMR_MSEC__10_1_0_S5_S3 0 2540
 /begin AXIS_DESCR STD_AXIS zff_atsys._.iSignale._.obj.sig_n_ab UMR_U_MIN_1_1_0_S5_S3 4 0 8160 DEPOSIT ABSOLUTE /end AXIS_DESCR
/end CHARACTERISTIC
/begin CHARACTERISTIC KL_TVKZU_R "Verzoegerungszeit kraftschliessende KZU" CURVE 0x1BF460 ZF_kl_ui16_S5_S3 2540 UMR_MSEC__10_1_0_S5_S3 0 2540
 /begin AXIS_DESCR STD_AXIS zff_atsys._.iSignale._.obj.sig_n_ab UMR_U_MIN_1_1_0_S5_S3 4 0 8160 DEPOSIT ABSOLUTE /end AXIS_DESCR
/end CHARACTERISTIC
/begin CHARACTERISTIC NGS_ABFLARE12 "Abtriebsdrehzahlgradientenschwelle" VALUE 0x1D8A9E ZF_kw_si16_S5_S3 13200 UMR_U_MINSEC_1_1_0_S5_S3 -5000 8200 /end CHARACTERISTIC
/begin CHARACTERISTIC NGS_ABFLARE23 "Abtriebsdrehzahlgradientenschwelle" VALUE 0x1D8AA2 ZF_kw_si16_S5_S3 13200 UMR_U_MINSEC_1_1_0_S5_S3 -5000 8200 /end CHARACTERISTIC
/begin CHARACTERISTIC NGS_ABFLARE34 "Abtriebsdrehzahlgradientenschwelle" VALUE 0x1D8AA6 ZF_kw_si16_S5_S3 13200 UMR_U_MINSEC_1_1_0_S5_S3 -5000 8200 /end CHARACTERISTIC
/begin CHARACTERISTIC NGS_ABFLARE45 "Abtriebsdrehzahlgradientenschwelle" VALUE 0x1D8AAA ZF_kw_si16_S5_S3 13200 UMR_U_MINSEC_1_1_0_S5_S3 -5000 8200 /end CHARACTERISTIC
/begin CHARACTERISTIC NGS_ABFLARE56 "Abtriebsdrehzahlgradientenschwelle" VALUE 0x1D8AAE ZF_kw_si16_S5_S3 13200 UMR_U_MINSEC_1_1_0_S5_S3 -5000 8200 /end CHARACTERISTIC
/begin CHARACTERISTIC NGS_ABFLARE67 "Abtriebsdrehzahlgradientenschwelle" VALUE 0x1D8AB2 ZF_kw_si16_S5_S3 13200 UMR_U_MINSEC_1_1_0_S5_S3 -5000 8200 /end CHARACTERISTIC
/begin CHARACTERISTIC NGS_ABFLARE78 "Abtriebsdrehzahlgradientenschwelle" VALUE 0x1D8AB6 ZF_kw_si16_S5_S3 13200 UMR_U_MINSEC_1_1_0_S5_S3 -5000 8200 /end CHARACTERISTIC
/begin CHARACTERISTIC NS_GENDSYNIAE_7 "Drehzahlschwelle Endebedingung Fuellausgleich 2. nichtkraftschliessende KZU" VALUE 0x1D8A98 ZF_kw_si16_S5_S3 16000 UMR_U_MIN_1_1_0_S5_S3 -8000 8000 /end CHARACTERISTIC
/begin CHARACTERISTIC NS_GENDSYNIAE_8 "Drehzahlschwelle Endebedingung Fuellausgleich 2. nichtkraftschliessende KZU" VALUE 0x1D8A9A ZF_kw_si16_S5_S3 16000 UMR_U_MIN_1_1_0_S5_S3 -8000 8000 /end CHARACTERISTIC
/begin CHARACTERISTIC NS_GENDSYNIAE_R "Drehzahlschwelle Endebedingung Fuellausgleich 2. nichtkraftschliessende KZU" VALUE 0x1D8A8A ZF_kw_si16_S5_S3 16000 UMR_U_MIN_1_1_0_S5_S3 -8000 8000 /end CHARACTERISTIC
/begin CHARACTERISTIC PG_OFV1_7 "Gradient Offset Fuelldruck 1.nicht kraftschl. Kup." VALUE 0x1D7A86 ZF_kw_ui8_S5_S3 5 UMR_BAR_SEC_1_10_0_S5_S3 0 5 /end CHARACTERISTIC
/begin CHARACTERISTIC PG_OFV1_8 "Gradient Offset Fuelldruck 1.nicht kraftschl. Kup." VALUE 0x1D7A8E ZF_kw_ui8_S5_S3 5 UMR_BAR_SEC_1_10_0_S5_S3 0 5 /end CHARACTERISTIC
/begin CHARACTERISTIC PG_OFV1_R "Gradient Offset Fuelldruck 1.nicht kraftschl. Kup." VALUE 0x1D7A4E ZF_kw_ui8_S5_S3 5 UMR_BAR_SEC_1_10_0_S5_S3 0 5 /end CHARACTERISTIC
/begin CHARACTERISTIC T_F21 "Fuellzeit" VALUE 0x1D7B11 ZF_kw_ui8_S5_S3 2540 UMR_MSEC__10_1_0_S5_S3 0 2540 /end CHARACTERISTIC
/begin CHARACTERISTIC T_F21_EL "Fuellzeit" VALUE 0x1D7B12 ZF_kw_ui8_S5_S3 2540 UMR_MSEC__10_1_0_S5_S3 0 2540 /end CHARACTERISTIC
/begin CHARACTERISTIC T_FFUELLRED_7 "Fuellzeit reduzierte Befüllung" VALUE 0x1D7A88 ZF_kw_ui8_S5_S3 2540 UMR_MSEC__10_1_0_S5_S3 0 2540 /end CHARACTERISTIC
/begin CHARACTERISTIC T_FFUELLRED_8 "Fuellzeit reduzierte Befüllung" VALUE 0x1D7A90 ZF_kw_ui8_S5_S3 2540 UMR_MSEC__10_1_0_S5_S3 0 2540 /end CHARACTERISTIC
/begin CHARACTERISTIC T_FFUELLRED_R "Fuellzeit reduzierte Befüllung" VALUE 0x1D7A50 ZF_kw_ui8_S5_S3 2540 UMR_MSEC__10_1_0_S5_S3 0 2540 /end CHARACTERISTIC
/begin CHARACTERISTIC T_KORHSZEIT12 "Korrekturwert fur Schaltverzugberechnung" VALUE 0x1D7AEC ZF_kw_ui8_S5_S3 2000 UMR_MSEC__10_1_M128_S5_S3 -1000 1000 /end CHARACTERISTIC
/begin CHARACTERISTIC T_KORHSZEIT23 "Korrekturwert fur Schaltverzugberechnung" VALUE 0x1D7AF1 ZF_kw_ui8_S5_S3 2000 UMR_MSEC__10_1_M128_S5_S3 -1000 1000 /end CHARACTERISTIC
/begin CHARACTERISTIC T_KORHSZEIT34 "Korrekturwert fur Schaltverzugberechnung" VALUE 0x1D7AF6 ZF_kw_ui8_S5_S3 2000 UMR_MSEC__10_1_M128_S5_S3 -1000 1000 /end CHARACTERISTIC
/begin CHARACTERISTIC T_KORHSZEIT45 "Korrekturwert fur Schaltverzugberechnung" VALUE 0x1D7AFB ZF_kw_ui8_S5_S3 2000 UMR_MSEC__10_1_M128_S5_S3 -1000 1000 /end CHARACTERISTIC
/begin CHARACTERISTIC T_KORHSZEIT56 "Korrekturwert fur Schaltverzugberechnung" VALUE 0x1D7B00 ZF_kw_ui8_S5_S3 2000 UMR_MSEC__10_1_M128_S5_S3 -1000 1000 /end CHARACTERISTIC
/begin CHARACTERISTIC T_KORHSZEIT67 "Korrekturwert fur Schaltverzugberechnung" VALUE 0x1D7B05 ZF_kw_ui8_S5_S3 2000 UMR_MSEC__10_1_M128_S5_S3 -1000 1000 /end CHARACTERISTIC
/begin CHARACTERISTIC T_KORHSZEIT78 "Korrekturwert fur Schaltverzugberechnung" VALUE 0x1D7B0A ZF_kw_ui8_S5_S3 2000 UMR_MSEC__10_1_M128_S5_S3 -1000 1000 /end CHARACTERISTIC
/begin CHARACTERISTIC T_RA2SSCHR12 "Zeit 2.Rampe bei Schrittschaltung" VALUE 0x1D7AEA ZF_kw_ui8_S5_S3 2540 UMR_MSEC__10_1_0_S5_S3 0 2540 /end CHARACTERISTIC
/begin CHARACTERISTIC T_RA2SSCHR23 "Zeit 2.Rampe bei Schrittschaltung" VALUE 0x1D7AEF ZF_kw_ui8_S5_S3 2540 UMR_MSEC__10_1_0_S5_S3 0 2540 /end CHARACTERISTIC
/begin CHARACTERISTIC T_RA2SSCHR34 "Zeit 2.Rampe bei Schrittschaltung" VALUE 0x1D7AF4 ZF_kw_ui8_S5_S3 2540 UMR_MSEC__10_1_0_S5_S3 0 2540 /end CHARACTERISTIC
/begin CHARACTERISTIC T_RA2SSCHR45 "Zeit 2.Rampe bei Schrittschaltung" VALUE 0x1D7AF9 ZF_kw_ui8_S5_S3 2540 UMR_MSEC__10_1_0_S5_S3 0 2540 /end CHARACTERISTIC
/begin CHARACTERISTIC T_RA2SSCHR56 "Zeit 2.Rampe bei Schrittschaltung" VALUE 0x1D7AFE ZF_kw_ui8_S5_S3 2540 UMR_MSEC__10_1_0_S5_S3 0 2540 /end CHARACTERISTIC
/begin CHARACTERISTIC T_RA2SSCHR67 "Zeit 2.Rampe bei Schrittschaltung" VALUE 0x1D7B03 ZF_kw_ui8_S5_S3 2540 UMR_MSEC__10_1_0_S5_S3 0 2540 /end CHARACTERISTIC
/begin CHARACTERISTIC T_RA2SSCHR78 "Zeit 2.Rampe bei Schrittschaltung" VALUE 0x1D7B08 ZF_kw_ui8_S5_S3 2540 UMR_MSEC__10_1_0_S5_S3 0 2540 /end CHARACTERISTIC
/begin CHARACTERISTIC T_SYN12 "Verweilzeit in Synchron zum Start Max.Rampe" VALUE 0x1D7AEB ZF_kw_ui8_S5_S3 2540 UMR_MSEC__10_1_0_S5_S3 0 2540 /end CHARACTERISTIC
/begin CHARACTERISTIC T_SYN23 "Verweilzeit in Synchron zum Start Max.Rampe" VALUE 0x1D7AF0 ZF_kw_ui8_S5_S3 2540 UMR_MSEC__10_1_0_S5_S3 0 2540 /end CHARACTERISTIC
/begin CHARACTERISTIC T_SYN34 "Verweilzeit in Synchron zum Start Max.Rampe" VALUE 0x1D7AF5 ZF_kw_ui8_S5_S3 2540 UMR_MSEC__10_1_0_S5_S3 0 2540 /end CHARACTERISTIC
/begin CHARACTERISTIC T_SYN45 "Verweilzeit in Synchron zum Start Max.Rampe" VALUE 0x1D7AFA ZF_kw_ui8_S5_S3 2540 UMR_MSEC__10_1_0_S5_S3 0 2540 /end CHARACTERISTIC
/begin CHARACTERISTIC T_SYN56 "Verweilzeit in Synchron zum Start Max.Rampe" VALUE 0x1D7AFF ZF_kw_ui8_S5_S3 2540 UMR_MSEC__10_1_0_S5_S3 0 2540 /end CHARACTERISTIC
/begin CHARACTERISTIC T_SYN67 "Verweilzeit in Synchron zum Start Max.Rampe" VALUE 0x1D7B04 ZF_kw_ui8_S5_S3 2540 UMR_MSEC__10_1_0_S5_S3 0 2540 /end CHARACTERISTIC
/begin CHARACTERISTIC T_SYN78 "Verweilzeit in Synchron zum Start Max.Rampe" VALUE 0x1D7B09 ZF_kw_ui8_S5_S3 2540 UMR_MSEC__10_1_0_S5_S3 0 2540 /end CHARACTERISTIC
/begin CHARACTERISTIC T_SYNPOMEPOS12 "Zeitkriterium fuer Schaltdruckoffset" VALUE 0x1D8A9C ZF_kw_si16_S5_S3 5000 UMR_MSEC__10_1_0_S5_S3 -5000 0 /end CHARACTERISTIC
/begin CHARACTERISTIC T_SYNPOMEPOS23 "Zeitkriterium fuer Schaltdruckoffset" VALUE 0x1D8AA0 ZF_kw_si16_S5_S3 5000 UMR_MSEC__10_1_0_S5_S3 -5000 0 /end CHARACTERISTIC
/begin CHARACTERISTIC T_SYNPOMEPOS34 "Zeitkriterium fuer Schaltdruckoffset" VALUE 0x1D8AA4 ZF_kw_si16_S5_S3 5000 UMR_MSEC__10_1_0_S5_S3 -5000 0 /end CHARACTERISTIC
/begin CHARACTERISTIC T_SYNPOMEPOS45 "Zeitkriterium fuer Schaltdruckoffset" VALUE 0x1D8AA8 ZF_kw_si16_S5_S3 5000 UMR_MSEC__10_1_0_S5_S3 -5000 0 /end CHARACTERISTIC
/begin CHARACTERISTIC T_SYNPOMEPOS56 "Zeitkriterium fuer Schaltdruckoffset" VALUE 0x1D8AAC ZF_kw_si16_S5_S3 5000 UMR_MSEC__10_1_0_S5_S3 -5000 0 /end CHARACTERISTIC
/begin CHARACTERISTIC T_SYNPOMEPOS67 "Zeitkriterium fuer Schaltdruckoffset" VALUE 0x1D8AB0 ZF_kw_si16_S5_S3 5000 UMR_MSEC__10_1_0_S5_S3 -5000 0 /end CHARACTERISTIC
/begin CHARACTERISTIC T_SYNPOMEPOS78 "Zeitkriterium fuer Schaltdruckoffset" VALUE 0x1D8AB4 ZF_kw_si16_S5_S3 5000 UMR_MSEC__10_1_0_S5_S3 -5000 0 /end CHARACTERISTIC
/begin CHARACTERISTIC T_SYNRAKZU_7 "Zeit vor sync. Ende Schaltdruck/Start 3. Rampe KZU" VALUE 0x1D7A8A ZF_kw_ui8_S5_S3 1280 UMR_MSEC__10_1_M128_S5_S3 -1280 0 /end CHARACTERISTIC
/begin CHARACTERISTIC T_SYNRAKZU_8 "Zeit vor sync. Ende Schaltdruck/Start 3. Rampe KZU" VALUE 0x1D7A92 ZF_kw_ui8_S5_S3 1280 UMR_MSEC__10_1_M128_S5_S3 -1280 0 /end CHARACTERISTIC
/begin CHARACTERISTIC T_SYNRAKZU_R "Zeit vor sync. Ende Schaltdruck/Start 3. Rampe KZU" VALUE 0x1D7A52 ZF_kw_ui8_S5_S3 1280 UMR_MSEC__10_1_M128_S5_S3 -1280 0 /end CHARACTERISTIC
/begin CHARACTERISTIC T_SYN_7 "Verweilzeit in Synchron zum Start Max.Rampe" VALUE 0x1D7A89 ZF_kw_ui8_S5_S3 2540 UMR_MSEC__10_1_0_S5_S3 0 2540 /end CHARACTERISTIC
/begin CHARACTERISTIC T_SYN_8 "Verweilzeit in Synchron zum Start Max.Rampe" VALUE 0x1D7A91 ZF_kw_ui8_S5_S3 2540 UMR_MSEC__10_1_0_S5_S3 0 2540 /end CHARACTERISTIC
/begin CHARACTERISTIC T_SYN_R "Verweilzeit in Synchron zum Start Max.Rampe" VALUE 0x1D7A51 ZF_kw_ui8_S5_S3 2540 UMR_MSEC__10_1_0_S5_S3 0 2540 /end CHARACTERISTIC
/begin CHARACTERISTIC T_VGEIAE_7 "Verzoegerung Drehzahlschwelle GE Hybrid" VALUE 0x1D7A8D ZF_kw_ui8_S5_S3 2540 UMR_MSEC__10_1_0_S5_S3 0 2540 /end CHARACTERISTIC
/begin CHARACTERISTIC T_VGEIAE_8 "Verzoegerung Drehzahlschwelle GE Hybrid" VALUE 0x1D7A95 ZF_kw_ui8_S5_S3 2540 UMR_MSEC__10_1_0_S5_S3 0 2540 /end CHARACTERISTIC
/begin CHARACTERISTIC T_VGEIAE_R "Verzoegerung Drehzahlschwelle GE Hybrid" VALUE 0x1D7A55 ZF_kw_ui8_S5_S3 2540 UMR_MSEC__10_1_0_S5_S3 0 2540 /end CHARACTERISTIC
/begin CHARACTERISTIC T_VKZU12 "Verzoegerungszeit zuschaltende Kupplung nach Schaltbeginn" VALUE 0x1D7A96 ZF_kw_ui8_S5_S3 2540 UMR_MSEC__10_1_0_S5_S3 0 2540 /end CHARACTERISTIC
/begin CHARACTERISTIC T_VKZU12_EL "Verzoegerungszeit zuschaltende Kupplung nach Schaltbeginn" VALUE 0x1D7A97 ZF_kw_ui8_S5_S3 2540 UMR_MSEC__10_1_0_S5_S3 0 2540 /end CHARACTERISTIC
/begin CHARACTERISTIC T_VKZU23 "Verzoegerungszeit zuschaltende Kupplung nach Schaltbeginn" VALUE 0x1D7A9C ZF_kw_ui8_S5_S3 2540 UMR_MSEC__10_1_0_S5_S3 0 2540 /end CHARACTERISTIC
/begin CHARACTERISTIC T_VKZU23_EL "Verzoegerungszeit zuschaltende Kupplung nach Schaltbeginn" VALUE 0x1D7A9D ZF_kw_ui8_S5_S3 2540 UMR_MSEC__10_1_0_S5_S3 0 2540 /end CHARACTERISTIC
/begin CHARACTERISTIC T_VKZU34 "Verzoegerungszeit zuschaltende Kupplung nach Schaltbeginn" VALUE 0x1D7AA2 ZF_kw_ui8_S5_S3 2540 UMR_MSEC__10_1_0_S5_S3 0 2540 /end CHARACTERISTIC
/begin CHARACTERISTIC T_VKZU34_EL "Verzoegerungszeit zuschaltende Kupplung nach Schaltbeginn" VALUE 0x1D7AA3 ZF_kw_ui8_S5_S3 2540 UMR_MSEC__10_1_0_S5_S3 0 2540 /end CHARACTERISTIC
/begin CHARACTERISTIC T_VKZU45 "Verzoegerungszeit zuschaltende Kupplung nach Schaltbeginn" VALUE 0x1D7AA8 ZF_kw_ui8_S5_S3 2540 UMR_MSEC__10_1_0_S5_S3 0 2540 /end CHARACTERISTIC
/begin CHARACTERISTIC T_VKZU45_EL "Verzoegerungszeit zuschaltende Kupplung nach Schaltbeginn" VALUE 0x1D7AA9 ZF_kw_ui8_S5_S3 2540 UMR_MSEC__10_1_0_S5_S3 0 2540 /end CHARACTERISTIC
/begin CHARACTERISTIC T_VKZU56 "Verzoegerungszeit zuschaltende Kupplung nach Schaltbeginn" VALUE 0x1D7AAE ZF_kw_ui8_S5_S3 2540 UMR_MSEC__10_1_0_S5_S3 0 2540 /end CHARACTERISTIC
/begin CHARACTERISTIC T_VKZU56_EL "Verzoegerungszeit zuschaltende Kupplung nach Schaltbeginn" VALUE 0x1D7AAF ZF_kw_ui8_S5_S3 2540 UMR_MSEC__10_1_0_S5_S3 0 2540 /end CHARACTERISTIC
/begin CHARACTERISTIC T_VKZU67 "Verzoegerungszeit zuschaltende Kupplung nach Schaltbeginn" VALUE 0x1D7AB4 ZF_kw_ui8_S5_S3 2540 UMR_MSEC__10_1_0_S5_S3 0 2540 /end CHARACTERISTIC
/begin CHARACTERISTIC T_VKZU67_EL "Verzoegerungszeit zuschaltende Kupplung nach Schaltbeginn" VALUE 0x1D7AB5 ZF_kw_ui8_S5_S3 2540 UMR_MSEC__10_1_0_S5_S3 0 2540 /end CHARACTERISTIC
/begin CHARACTERISTIC T_VKZU78 "Verzoegerungszeit zuschaltende Kupplung nach Schaltbeginn" VALUE 0x1D7ABA ZF_kw_ui8_S5_S3 2540 UMR_MSEC__10_1_0_S5_S3 0 2540 /end CHARACTERISTIC
/begin CHARACTERISTIC T_VKZU78_EL "Verzoegerungszeit zuschaltende Kupplung nach Schaltbeginn" VALUE 0x1D7ABB ZF_kw_ui8_S5_S3 2540 UMR_MSEC__10_1_0_S5_S3 0 2540 /end CHARACTERISTIC
/begin CHARACTERISTIC T_VKZUSP12 "Verzoegerungszeit zuschaltende Kupplung nach Schaltbeginn" VALUE 0x1D7AC0 ZF_kw_ui8_S5_S3 2540 UMR_MSEC__10_1_0_S5_S3 0 2540 /end CHARACTERISTIC
/begin CHARACTERISTIC T_VKZUSP23 "Verzoegerungszeit zuschaltende Kupplung nach Schaltbeginn" VALUE 0x1D7AC3 ZF_kw_ui8_S5_S3 2540 UMR_MSEC__10_1_0_S5_S3 0 2540 /end CHARACTERISTIC
/begin CHARACTERISTIC T_VKZUSP34 "Verzoegerungszeit zuschaltende Kupplung nach Schaltbeginn" VALUE 0x1D7AC6 ZF_kw_ui8_S5_S3 2540 UMR_MSEC__10_1_0_S5_S3 0 2540 /end CHARACTERISTIC
/begin CHARACTERISTIC T_VKZUSP45 "Verzoegerungszeit zuschaltende Kupplung nach Schaltbeginn" VALUE 0x1D7AC9 ZF_kw_ui8_S5_S3 2540 UMR_MSEC__10_1_0_S5_S3 0 2540 /end CHARACTERISTIC
/begin CHARACTERISTIC T_VKZUSP56 "Verzoegerungszeit zuschaltende Kupplung nach Schaltbeginn" VALUE 0x1D7ACC ZF_kw_ui8_S5_S3 2540 UMR_MSEC__10_1_0_S5_S3 0 2540 /end CHARACTERISTIC
/begin CHARACTERISTIC T_VKZUSP67 "Verzoegerungszeit zuschaltende Kupplung nach Schaltbeginn" VALUE 0x1D7ACF ZF_kw_ui8_S5_S3 2540 UMR_MSEC__10_1_0_S5_S3 0 2540 /end CHARACTERISTIC
/begin CHARACTERISTIC T_VKZUSP78 "Verzoegerungszeit zuschaltende Kupplung nach Schaltbeginn" VALUE 0x1D7AD2 ZF_kw_ui8_S5_S3 2540 UMR_MSEC__10_1_0_S5_S3 0 2540 /end CHARACTERISTIC
/begin CHARACTERISTIC T_VKZUSPORT12 "Verzoegerungszeit zuschaltende Kupplung nach Schaltbeginn" VALUE 0x1D7AD5 ZF_kw_ui8_S5_S3 2540 UMR_MSEC__10_1_0_S5_S3 0 2540 /end CHARACTERISTIC
/begin CHARACTERISTIC T_VKZUSPORT23 "Verzoegerungszeit zuschaltende Kupplung nach Schaltbeginn" VALUE 0x1D7AD8 ZF_kw_ui8_S5_S3 2540 UMR_MSEC__10_1_0_S5_S3 0 2540 /end CHARACTERISTIC
/begin CHARACTERISTIC T_VKZUSPORT34 "Verzoegerungszeit zuschaltende Kupplung nach Schaltbeginn" VALUE 0x1D7ADB ZF_kw_ui8_S5_S3 2540 UMR_MSEC__10_1_0_S5_S3 0 2540 /end CHARACTERISTIC
/begin CHARACTERISTIC T_VKZUSPORT45 "Verzoegerungszeit zuschaltende Kupplung nach Schaltbeginn" VALUE 0x1D7ADE ZF_kw_ui8_S5_S3 2540 UMR_MSEC__10_1_0_S5_S3 0 2540 /end CHARACTERISTIC
/begin CHARACTERISTIC T_VKZUSPORT56 "Verzoegerungszeit zuschaltende Kupplung nach Schaltbeginn" VALUE 0x1D7AE1 ZF_kw_ui8_S5_S3 2540 UMR_MSEC__10_1_0_S5_S3 0 2540 /end CHARACTERISTIC
/begin CHARACTERISTIC T_VKZUSPORT67 "Verzoegerungszeit zuschaltende Kupplung nach Schaltbeginn" VALUE 0x1D7AE4 ZF_kw_ui8_S5_S3 2540 UMR_MSEC__10_1_0_S5_S3 0 2540 /end CHARACTERISTIC
/begin CHARACTERISTIC T_VKZUSPORT78 "Verzoegerungszeit zuschaltende Kupplung nach Schaltbeginn" VALUE 0x1D7AE7 ZF_kw_ui8_S5_S3 2540 UMR_MSEC__10_1_0_S5_S3 0 2540 /end CHARACTERISTIC
/begin CHARACTERISTIC T_VKZUV2_7 "Verzoegerungszeit 2. nicht kraftschliessende KZU" VALUE 0x1D7A87 ZF_kw_ui8_S5_S3 2540 UMR_MSEC__10_1_0_S5_S3 0 2540 /end CHARACTERISTIC
/begin CHARACTERISTIC T_VKZUV2_8 "Verzoegerungszeit 2. nicht kraftschliessende KZU" VALUE 0x1D7A8F ZF_kw_ui8_S5_S3 2540 UMR_MSEC__10_1_0_S5_S3 0 2540 /end CHARACTERISTIC
/begin CHARACTERISTIC T_VKZUV2_R "Verzoegerungszeit 2. nicht kraftschliessende KZU" VALUE 0x1D7A4F ZF_kw_ui8_S5_S3 2540 UMR_MSEC__10_1_0_S5_S3 0 2540 /end CHARACTERISTIC
/begin FUNCTION jSasKzuGeG7_Fktn "Applikationesgroessen Instanz jSasKzuGeG7"
 /begin DEF_CHARACTERISTIC F_PRA_7 F_TRA_7 KF_PKZU_7 KF_PODKIMOTSOLLNMOTGE_7 KF_PODKIMOTSOLLNMOTGE_ECO_7 KF_POFMTNFUELLRED_7 KF_POFMTN_7 KF_POMLASTCGV2_7 KF_POTNDSYNV2_7 KF_TRAMTCG_7 KL_FPOTNDSYNV2_7 KL_PGOFCGV2_7 KL_PGOFMT_7 KL_PGOKZUNAB_7 KL_PGOKZU_7 KL_PGRASYNNAB_7 KL_PGRASYNV1_7 KL_PGRASYNV2_7 KL_PGRASYN_7 KL_POFCGV1_7 KL_POFCGV2_7 KL_POFCG_7 KL_POKZUCG_7 KL_POLASTDKIV2_7 KL_PORAKZU_7 KL_PORASYNV1_7 KL_PORASYNV2_7 KL_PORASYN_7 KL_TFCGGE_7 KL_TFCGV2_7 KL_TFV1_7 KL_TOVKZUCG_7 KL_TVKZUCGV2_7 KL_TVKZU_7 NS_GENDSYNIAE_7 PG_OFV1_7 T_FFUELLRED_7 T_SYNRAKZU_7 T_SYN_7 T_VGEIAE_7 T_VKZUV2_7 /end DEF_CHARACTERISTIC
/end FUNCTION
/begin FUNCTION jSasKzuGeG8_Fktn "Applikationesgroessen Instanz jSasKzuGeG8"
 /begin DEF_CHARACTERISTIC F_PRA_8 F_TRA_8 KF_PKZU_8 KF_PODKIMOTSOLLNMOTGE_8 KF_PODKIMOTSOLLNMOTGE_ECO_8 KF_POFMTNFUELLRED_8 KF_POFMTN_8 KF_POMLASTCGV2_8 KF_POTNDSYNV2_8 KF_TRAMTCG_8 KL_FPOTNDSYNV2_8 KL_PGOFCGV2_8 KL_PGOFMT_8 KL_PGOKZUNAB_8 KL_PGOKZU_8 KL_PGRASYNNAB_8 KL_PGRASYNV1_8 KL_PGRASYNV2_8 KL_PGRASYN_8 KL_POFCGV1_8 KL_POFCGV2_8 KL_POFCG_8 KL_POKZUCG_8 KL_POLASTDKIV2_8 KL_PORAKZU_8 KL_PORASYNV1_8 KL_PORASYNV2_8 KL_PORASYN_8 KL_TFCGGE_8 KL_TFCGV2_8 KL_TFV1_8 KL_TOVKZUCG_8 KL_TVKZUCGV2_8 KL_TVKZU_8 NS_GENDSYNIAE_8 PG_OFV1_8 T_FFUELLRED_8 T_SYNRAKZU_8 T_SYN_8 T_VGEIAE_8 T_VKZUV2_8 /end DEF_CHARACTERISTIC
/end FUNCTION
/begin FUNCTION jSasKzuGeGR_Fktn "Applikationesgroessen Instanz jSasKzuGeGR"
 /begin DEF_CHARACTERISTIC F_PRA_R F_TRA_R KF_PKZU_R KF_PODKIMOTSOLLNMOTGE_ECO_R KF_PODKIMOTSOLLNMOTGE_R KF_POFMTNFUELLRED_R KF_POFMTN_R KF_POMLASTCGV2_R KF_POTNDSYNV2_R KF_TRAMTCG_R KL_FPOTNDSYNV2_R KL_PGOFCGV2_R KL_PGOFMT_R KL_PGOKZUNAB_R KL_PGOKZU_R KL_PGRASYNNAB_R KL_PGRASYNV1_R KL_PGRASYNV2_R KL_PGRASYN_R KL_POFCGV1_R KL_POFCGV2_R KL_POFCG_R KL_POKZUCG_R KL_POLASTDKIV2_R KL_PORAKZU_R KL_PORASYNV1_R KL_PORASYNV2_R KL_PORASYN_R KL_TFCGGE_R KL_TFCGV2_R KL_TFV1_R KL_TOVKZUCG_R KL_TVKZUCGV2_R KL_TVKZU_R NS_GENDSYNIAE_R PG_OFV1_R T_FFUELLRED_R T_SYNRAKZU_R T_SYN_R T_VGEIAE_R T_VKZUV2_R /end DEF_CHARACTERISTIC
/end FUNCTION
/begin FUNCTION jSasKzuHSP112_Fktn "Applikationesgroessen Instanz jSasKzuHSP112"
 /begin DEF_CHARACTERISTIC F_PRA12 F_PRA12_EL F_TRA12 F_TRA12_EL KF_PKZU12 KF_PKZU12_EL KF_POFMTN12 KF_POFMTN12_EL KF_POKZUMTCG12 KF_TFCGNT12 KF_TFCGNT12_EL KF_TRAMTNT12 KF_TRAMTNT12_EL KF_T_DT_IG_CHANGE12 KL_PGOKZU12 KL_TSYNMTRAKZU12 KL_TSYNMTRAKZU12_EL T_VKZU12 T_VKZU12_EL /end DEF_CHARACTERISTIC
/end FUNCTION
/begin FUNCTION jSasKzuHSP123_Fktn "Applikationesgroessen Instanz jSasKzuHSP123"
 /begin DEF_CHARACTERISTIC F_PRA23 F_PRA23_EL F_TRA23 F_TRA23_EL KF_PKZU23 KF_PKZU23_EL KF_POFMTN23 KF_POFMTN23_EL KF_POKZUMTCG23 KF_TFCGNT23 KF_TFCGNT23_EL KF_TRAMTNT23 KF_TRAMTNT23_EL KF_T_DT_IG_CHANGE23 KL_PGOKZU23 KL_TSYNMTRAKZU23 KL_TSYNMTRAKZU23_EL T_VKZU23 T_VKZU23_EL /end DEF_CHARACTERISTIC
/end FUNCTION
/begin FUNCTION jSasKzuHSP134_Fktn "Applikationesgroessen Instanz jSasKzuHSP134"
 /begin DEF_CHARACTERISTIC F_PRA34 F_PRA34_EL F_TRA34 F_TRA34_EL KF_PKZU34 KF_PKZU34_EL KF_POFMTN34 KF_POFMTN34_EL KF_POKZUMTCG34 KF_TFCGNT34 KF_TFCGNT34_EL KF_TRAMTNT34 KF_TRAMTNT34_EL KF_T_DT_IG_CHANGE34 KL_PGOKZU34 KL_TSYNMTRAKZU34 KL_TSYNMTRAKZU34_EL T_VKZU34 T_VKZU34_EL /end DEF_CHARACTERISTIC
/end FUNCTION
/begin FUNCTION jSasKzuHSP145_Fktn "Applikationesgroessen Instanz jSasKzuHSP145"
 /begin DEF_CHARACTERISTIC F_PRA45 F_PRA45_EL F_TRA45 F_TRA45_EL KF_PKZU45 KF_PKZU45_EL KF_POFMTN45 KF_POFMTN45_EL KF_POKZUMTCG45 KF_TFCGNT45 KF_TFCGNT45_EL KF_TRAMTNT45 KF_TRAMTNT45_EL KF_T_DT_IG_CHANGE45 KL_PGOKZU45 KL_TSYNMTRAKZU45 KL_TSYNMTRAKZU45_EL T_VKZU45 T_VKZU45_EL /end DEF_CHARACTERISTIC
/end FUNCTION
/begin FUNCTION jSasKzuHSP156_Fktn "Applikationesgroessen Instanz jSasKzuHSP156"
 /begin DEF_CHARACTERISTIC F_PRA56 F_PRA56_EL F_TRA56 F_TRA56_EL KF_PKZU56 KF_PKZU56_EL KF_POFMTN56 KF_POFMTN56_EL KF_POKZUMTCG56 KF_TFCGNT56 KF_TFCGNT56_EL KF_TRAMTNT56 KF_TRAMTNT56_EL KF_T_DT_IG_CHANGE56 KL_PGOKZU56 KL_TSYNMTRAKZU56 KL_TSYNMTRAKZU56_EL T_VKZU56 T_VKZU56_EL /end DEF_CHARACTERISTIC
/end FUNCTION
/begin FUNCTION jSasKzuHSP167_Fktn "Applikationesgroessen Instanz jSasKzuHSP167"
 /begin DEF_CHARACTERISTIC F_PRA67 F_PRA67_EL F_TRA67 F_TRA67_EL KF_PKZU67 KF_PKZU67_EL KF_POFMTN67 KF_POFMTN67_EL KF_POKZUMTCG67 KF_TFCGNT67 KF_TFCGNT67_EL KF_TRAMTNT67 KF_TRAMTNT67_EL KF_T_DT_IG_CHANGE67 KL_PGOKZU67 KL_TSYNMTRAKZU67 KL_TSYNMTRAKZU67_EL T_VKZU67 T_VKZU67_EL /end DEF_CHARACTERISTIC
/end FUNCTION
/begin FUNCTION jSasKzuHSP178_Fktn "Applikationesgroessen Instanz jSasKzuHSP178"
 /begin DEF_CHARACTERISTIC F_PRA78 F_PRA78_EL F_TRA78 F_TRA78_EL KF_PKZU78 KF_PKZU78_EL KF_POFMTN78 KF_POFMTN78_EL KF_POKZUMTCG78 KF_TFCGNT78 KF_TFCGNT78_EL KF_TRAMTNT78 KF_TRAMTNT78_EL KF_T_DT_IG_CHANGE78 KL_PGOKZU78 KL_TSYNMTRAKZU78 KL_TSYNMTRAKZU78_EL T_VKZU78 T_VKZU78_EL /end DEF_CHARACTERISTIC
/end FUNCTION
/begin FUNCTION jSasKzuHSP212_Fktn "Applikationesgroessen Instanz jSasKzuHSP212"
 /begin DEF_CHARACTERISTIC F_PRASP12 F_TRASP12 KF_PKZUSP12 KF_POFMTNSP12 KF_POKZUMTCGSP12 KF_TFCGNTSP12 KF_TRAMTNTSP12 KF_T_DT_IG_CHANGESP12 KL_PGOKZUSP12 KL_TSYNMTRAKZUSP12 T_VKZUSP12 /end DEF_CHARACTERISTIC
/end FUNCTION
/begin FUNCTION jSasKzuHSP223_Fktn "Applikationesgroessen Instanz jSasKzuHSP223"
 /begin DEF_CHARACTERISTIC F_PRASP23 F_TRASP23 KF_PKZUSP23 KF_POFMTNSP23 KF_POKZUMTCGSP23 KF_TFCGNTSP23 KF_TRAMTNTSP23 KF_T_DT_IG_CHANGESP23 KL_PGOKZUSP23 KL_TSYNMTRAKZUSP23 T_VKZUSP23 /end DEF_CHARACTERISTIC
/end FUNCTION
/begin FUNCTION jSasKzuHSP234_Fktn "Applikationesgroessen Instanz jSasKzuHSP234"
 /begin DEF_CHARACTERISTIC F_PRASP34 F_TRASP34 KF_PKZUSP34 KF_POFMTNSP34 KF_POKZUMTCGSP34 KF_TFCGNTSP34 KF_TRAMTNTSP34 KF_T_DT_IG_CHANGESP34 KL_PGOKZUSP34 KL_TSYNMTRAKZUSP34 T_VKZUSP34 /end DEF_CHARACTERISTIC
/end FUNCTION
/begin FUNCTION jSasKzuHSP245_Fktn "Applikationesgroessen Instanz jSasKzuHSP245"
 /begin DEF_CHARACTERISTIC F_PRASP45 F_TRASP45 KF_PKZUSP45 KF_POFMTNSP45 KF_POKZUMTCGSP45 KF_TFCGNTSP45 KF_TRAMTNTSP45 KF_T_DT_IG_CHANGESP45 KL_PGOKZUSP45 KL_TSYNMTRAKZUSP45 T_VKZUSP45 /end DEF_CHARACTERISTIC
/end FUNCTION
/begin FUNCTION jSasKzuHSP256_Fktn "Applikationesgroessen Instanz jSasKzuHSP256"
 /begin DEF_CHARACTERISTIC F_PRASP56 F_TRASP56 KF_PKZUSP56 KF_POFMTNSP56 KF_POKZUMTCGSP56 KF_TFCGNTSP56 KF_TRAMTNTSP56 KF_T_DT_IG_CHANGESP56 KL_PGOKZUSP56 KL_TSYNMTRAKZUSP56 T_VKZUSP56 /end DEF_CHARACTERISTIC
/end FUNCTION
/begin FUNCTION jSasKzuHSP267_Fktn "Applikationesgroessen Instanz jSasKzuHSP267"
 /begin DEF_CHARACTERISTIC F_PRASP67 F_TRASP67 KF_PKZUSP67 KF_POFMTNSP67 KF_POKZUMTCGSP67 KF_TFCGNTSP67 KF_TRAMTNTSP67 KF_T_DT_IG_CHANGESP67 KL_PGOKZUSP67 KL_TSYNMTRAKZUSP67 T_VKZUSP67 /end DEF_CHARACTERISTIC
/end FUNCTION
/begin FUNCTION jSasKzuHSP278_Fktn "Applikationesgroessen Instanz jSasKzuHSP278"
 /begin DEF_CHARACTERISTIC F_PRASP78 F_TRASP78 KF_PKZUSP78 KF_POFMTNSP78 KF_POKZUMTCGSP78 KF_TFCGNTSP78 KF_TRAMTNTSP78 KF_T_DT_IG_CHANGESP78 KL_PGOKZUSP78 KL_TSYNMTRAKZUSP78 T_VKZUSP78 /end DEF_CHARACTERISTIC
/end FUNCTION
/begin FUNCTION jSasKzuHSP312_Fktn "Applikationesgroessen Instanz jSasKzuHSP312"
 /begin DEF_CHARACTERISTIC F_PRASPORT12 F_TRASPORT12 KF_PKZUSPORT12 KF_POFMTNSPORT12 KF_POKZUMTCGSPORT12 KF_TFCGNTSPORT12 KF_TRAMTNTSPORT12 KF_T_DT_IG_CHANGESPORT12 KL_PGOKZUSPORT12 KL_TSYNMTRAKZUSPORT12 T_VKZUSPORT12 /end DEF_CHARACTERISTIC
/end FUNCTION
/begin FUNCTION jSasKzuHSP323_Fktn "Applikationesgroessen Instanz jSasKzuHSP323"
 /begin DEF_CHARACTERISTIC F_PRASPORT23 F_TRASPORT23 KF_PKZUSPORT23 KF_POFMTNSPORT23 KF_POKZUMTCGSPORT23 KF_TFCGNTSPORT23 KF_TRAMTNTSPORT23 KF_T_DT_IG_CHANGESPORT23 KL_PGOKZUSPORT23 KL_TSYNMTRAKZUSPORT23 T_VKZUSPORT23 /end DEF_CHARACTERISTIC
/end FUNCTION
/begin FUNCTION jSasKzuHSP334_Fktn "Applikationesgroessen Instanz jSasKzuHSP334"
 /begin DEF_CHARACTERISTIC F_PRASPORT34 F_TRASPORT34 KF_PKZUSPORT34 KF_POFMTNSPORT34 KF_POKZUMTCGSPORT34 KF_TFCGNTSPORT34 KF_TRAMTNTSPORT34 KF_T_DT_IG_CHANGESPORT34 KL_PGOKZUSPORT34 KL_TSYNMTRAKZUSPORT34 T_VKZUSPORT34 /end DEF_CHARACTERISTIC
/end FUNCTION
/begin FUNCTION jSasKzuHSP345_Fktn "Applikationesgroessen Instanz jSasKzuHSP345"
 /begin DEF_CHARACTERISTIC F_PRASPORT45 F_TRASPORT45 KF_PKZUSPORT45 KF_POFMTNSPORT45 KF_POKZUMTCGSPORT45 KF_TFCGNTSPORT45 KF_TRAMTNTSPORT45 KF_T_DT_IG_CHANGESPORT45 KL_PGOKZUSPORT45 KL_TSYNMTRAKZUSPORT45 T_VKZUSPORT45 /end DEF_CHARACTERISTIC
/end FUNCTION
/begin FUNCTION jSasKzuHSP356_Fktn "Applikationesgroessen Instanz jSasKzuHSP356"
 /begin DEF_CHARACTERISTIC F_PRASPORT56 F_TRASPORT56 KF_PKZUSPORT56 KF_POFMTNSPORT56 KF_POKZUMTCGSPORT56 KF_TFCGNTSPORT56 KF_TRAMTNTSPORT56 KF_T_DT_IG_CHANGESPORT56 KL_PGOKZUSPORT56 KL_TSYNMTRAKZUSPORT56 T_VKZUSPORT56 /end DEF_CHARACTERISTIC
/end FUNCTION
/begin FUNCTION jSasKzuHSP367_Fktn "Applikationesgroessen Instanz jSasKzuHSP367"
 /begin DEF_CHARACTERISTIC F_PRASPORT67 F_TRASPORT67 KF_PKZUSPORT67 KF_POFMTNSPORT67 KF_POKZUMTCGSPORT67 KF_TFCGNTSPORT67 KF_TRAMTNTSPORT67 KF_T_DT_IG_CHANGESPORT67 KL_PGOKZUSPORT67 KL_TSYNMTRAKZUSPORT67 T_VKZUSPORT67 /end DEF_CHARACTERISTIC
/end FUNCTION
/begin FUNCTION jSasKzuHSP378_Fktn "Applikationesgroessen Instanz jSasKzuHSP378"
 /begin DEF_CHARACTERISTIC F_PRASPORT78 F_TRASPORT78 KF_PKZUSPORT78 KF_POFMTNSPORT78 KF_POKZUMTCGSPORT78 KF_TFCGNTSPORT78 KF_TRAMTNTSPORT78 KF_T_DT_IG_CHANGESPORT78 KL_PGOKZUSPORT78 KL_TSYNMTRAKZUSPORT78 T_VKZUSPORT78 /end DEF_CHARACTERISTIC
/end FUNCTION
/begin FUNCTION jSasKzuHSS12_Fktn "Applikationesgroessen Instanz jSasKzuHSS12"
 /begin DEF_CHARACTERISTIC F_PRAFUELLOPT12 F_TRAFUELLOPT12 KF_POFMTNFUELLOPT12 KF_POFMTNFUELLRED12 KF_TRAMTNTFUELLOPT12 KL_FTRACG12 KL_PGOFMT12 KL_PGRASYN12 KL_POFCG12 KL_POFMDMOTSOLL12 KL_POKZUFLARE12 KL_POKZUMDMOTSOLL12 KL_POKZUMEPOS12 KL_PORAKZU12 KL_PORASYN12 KL_TFCGFUELLOPT12 KL_TFCGFUELLRED12 NGS_ABFLARE12 T_KORHSZEIT12 T_RA2SSCHR12 T_SYN12 T_SYNPOMEPOS12 /end DEF_CHARACTERISTIC
/end FUNCTION
/begin FUNCTION jSasKzuHSS23_Fktn "Applikationesgroessen Instanz jSasKzuHSS23"
 /begin DEF_CHARACTERISTIC F_PRAFUELLOPT23 F_TRAFUELLOPT23 KF_POFMTNFUELLOPT23 KF_POFMTNFUELLRED23 KF_TRAMTNTFUELLOPT23 KL_FTRACG23 KL_PGOFMT23 KL_PGRASYN23 KL_POFCG23 KL_POFMDMOTSOLL23 KL_POKZUFLARE23 KL_POKZUMDMOTSOLL23 KL_POKZUMEPOS23 KL_PORAKZU23 KL_PORASYN23 KL_TFCGFUELLOPT23 KL_TFCGFUELLRED23 NGS_ABFLARE23 T_KORHSZEIT23 T_RA2SSCHR23 T_SYN23 T_SYNPOMEPOS23 /end DEF_CHARACTERISTIC
/end FUNCTION
/begin FUNCTION jSasKzuHSS34_Fktn "Applikationesgroessen Instanz jSasKzuHSS34"
 /begin DEF_CHARACTERISTIC F_PRAFUELLOPT34 F_TRAFUELLOPT34 KF_POFMTNFUELLOPT34 KF_POFMTNFUELLRED34 KF_TRAMTNTFUELLOPT34 KL_FTRACG34 KL_PGOFMT34 KL_PGRASYN34 KL_POFCG34 KL_POFMDMOTSOLL34 KL_POKZUFLARE34 KL_POKZUMDMOTSOLL34 KL_POKZUMEPOS34 KL_PORAKZU34 KL_PORASYN34 KL_TFCGFUELLOPT34 KL_TFCGFUELLRED34 NGS_ABFLARE34 T_KORHSZEIT34 T_RA2SSCHR34 T_SYN34 T_SYNPOMEPOS34 /end DEF_CHARACTERISTIC
/end FUNCTION
/begin FUNCTION jSasKzuHSS45_Fktn "Applikationesgroessen Instanz jSasKzuHSS45"
 /begin DEF_CHARACTERISTIC F_PRAFUELLOPT45 F_TRAFUELLOPT45 KF_POFMTNFUELLOPT45 KF_POFMTNFUELLRED45 KF_TRAMTNTFUELLOPT45 KL_FTRACG45 KL_PGOFMT45 KL_PGRASYN45 KL_POFCG45 KL_POFMDMOTSOLL45 KL_POKZUFLARE45 KL_POKZUMDMOTSOLL45 KL_POKZUMEPOS45 KL_PORAKZU45 KL_PORASYN45 KL_TFCGFUELLOPT45 KL_TFCGFUELLRED45 NGS_ABFLARE45 T_KORHSZEIT45 T_RA2SSCHR45 T_SYN45 T_SYNPOMEPOS45 /end DEF_CHARACTERISTIC
/end FUNCTION
/begin FUNCTION jSasKzuHSS56_Fktn "Applikationesgroessen Instanz jSasKzuHSS56"
 /begin DEF_CHARACTERISTIC F_PRAFUELLOPT56 F_TRAFUELLOPT56 KF_POFMTNFUELLOPT56 KF_POFMTNFUELLRED56 KF_TRAMTNTFUELLOPT56 KL_FTRACG56 KL_PGOFMT56 KL_PGRASYN56 KL_POFCG56 KL_POFMDMOTSOLL56 KL_POKZUFLARE56 KL_POKZUMDMOTSOLL56 KL_POKZUMEPOS56 KL_PORAKZU56 KL_PORASYN56 KL_TFCGFUELLOPT56 KL_TFCGFUELLRED56 NGS_ABFLARE56 T_KORHSZEIT56 T_RA2SSCHR56 T_SYN56 T_SYNPOMEPOS56 /end DEF_CHARACTERISTIC
/end FUNCTION
/begin FUNCTION jSasKzuHSS67_Fktn "Applikationesgroessen Instanz jSasKzuHSS67"
 /begin DEF_CHARACTERISTIC F_PRAFUELLOPT67 F_TRAFUELLOPT67 KF_POFMTNFUELLOPT67 KF_POFMTNFUELLRED67 KF_TRAMTNTFUELLOPT67 KL_FTRACG67 KL_PGOFMT67 KL_PGRASYN67 KL_POFCG67 KL_POFMDMOTSOLL67 KL_POKZUFLARE67 KL_POKZUMDMOTSOLL67 KL_POKZUMEPOS67 KL_PORAKZU67 KL_PORASYN67 KL_TFCGFUELLOPT67 KL_TFCGFUELLRED67 NGS_ABFLARE67 T_KORHSZEIT67 T_RA2SSCHR67 T_SYN67 T_SYNPOMEPOS67 /end DEF_CHARACTERISTIC
/end FUNCTION
/begin FUNCTION jSasKzuHSS78_Fktn "Applikationesgroessen Instanz jSasKzuHSS78"
 /begin DEF_CHARACTERISTIC F_PRAFUELLOPT78 F_TRAFUELLOPT78 KF_POFMTNFUELLOPT78 KF_POFMTNFUELLRED78 KF_TRAMTNTFUELLOPT78 KL_FTRACG78 KL_PGOFMT78 KL_PGRASYN78 KL_POFCG78 KL_POFMDMOTSOLL78 KL_POKZUFLARE78 KL_POKZUMDMOTSOLL78 KL_POKZUMEPOS78 KL_PORAKZU78 KL_PORASYN78 KL_TFCGFUELLOPT78 KL_TFCGFUELLRED78 NGS_ABFLARE78 T_KORHSZEIT78 T_RA2SSCHR78 T_SYN78 T_SYNPOMEPOS78 /end DEF_CHARACTERISTIC
/end FUNCTION
/begin FUNCTION jSasKzuRSP121_Fktn "Applikationesgroessen Instanz jSasKzuRSP121"
 /begin DEF_CHARACTERISTIC F_PRA21 F_PRA21_EL F_TRA21 F_TRA21_EL KF_PKZU21 KF_PKZU21_EL KF_POFMTN21 KF_POFMTN21_EL KF_POHINSYNKZU21 KF_TSYN_DT_IG_CHANGE21 KL_TRA21 KL_TRA21_EL KL_TSYNCGHINSYNEKZU21 T_F21 T_F21_EL /end DEF_CHARACTERISTIC
/end FUNCTION
/begin RECORD_LAYOUT ZF_kf_si16_S5_S3 FNC_VALUES 5 SWORD ROW_DIR DIRECT AXIS_PTS_X 3 SWORD INDEX_INCR DIRECT AXIS_PTS_Y 4 SWORD INDEX_INCR DIRECT NO_AXIS_PTS_X 1 ULONG NO_AXIS_PTS_Y 2 ULONG /end RECORD_LAYOUT
/begin RECORD_LAYOUT ZF_kf_ui8_S5_S3 FNC_VALUES 5 UBYTE ROW_DIR DIRECT AXIS_PTS_X 3 UBYTE INDEX_INCR DIRECT AXIS_PTS_Y 4 UBYTE INDEX_INCR DIRECT NO_AXIS_PTS_X 1 ULONG NO_AXIS_PTS_Y 2 ULONG /end RECORD_LAYOUT
/begin RECORD_LAYOUT ZF_kl_si16_S5_S3 FNC_VALUES 3 SWORD COLUMN_DIR DIRECT AXIS_PTS_X 2 SWORD INDEX_INCR DIRECT NO_AXIS_PTS_X 1 ULONG /end RECORD_LAYOUT
/begin RECORD_LAYOUT ZF_kl_ui16_S5_S3 FNC_VALUES 3 UWORD COLUMN_DIR DIRECT AXIS_PTS_X 2 UWORD INDEX_INCR DIRECT NO_AXIS_PTS_X 1 ULONG /end RECORD_LAYOUT
/begin RECORD_LAYOUT ZF_kl_ui8_S5_S3 FNC_VALUES 3 UBYTE COLUMN_DIR DIRECT AXIS_PTS_X 2 UBYTE INDEX_INCR DIRECT NO_AXIS_PTS_X 1 ULONG /end RECORD_LAYOUT
/begin RECORD_LAYOUT ZF_kw_si16_S5_S3 FNC_VALUES 1 SWORD COLUMN_DIR DIRECT /end RECORD_LAYOUT
/begin RECORD_LAYOUT ZF_kw_ui8_S5_S3 FNC_VALUES 1 UBYTE COLUMN_DIR DIRECT /end RECORD_LAYOUT
/end MODULE
/end PROJECT
