ASAP2_VERSION 1 51
/begin PROJECT ZHBC8600 "Gen2_BMW_System_Supplier_Lib"
/begin MODULE CPP ""
/begin MOD_COMMON "" BYTE_ORDER MSB_FIRST ALIGNMENT_BYTE 1 ALIGNMENT_WORD 2 ALIGNMENT_LONG 4 ALIGNMENT_FLOAT32_IEEE 4 ALIGNMENT_FLOAT64_IEEE 1 /end MOD_COMMON
/begin COMPU_METHOD EH_STANDARD_S4_S3 "int = ((phys * 1) / 1) - (0) -" RAT_FUNC "%1.0" "-" COEFFS 0 1 0 0 0 1 /end COMPU_METHOD
/begin COMPU_METHOD SAB_M_NM_M1023_S2_S3 "int = ((phys * 1) / 1) - (-1023) Nm" RAT_FUNC "%1.0" "Nm" COEFFS 0 1 1023 0 0 1 /end COMPU_METHOD
/begin COMPU_METHOD SAB_M_NM_M2048_S2_S3 "int = ((phys * 1) / 1) - (-2048) Nm" RAT_FUNC "%1.0" "Nm" COEFFS 0 1 2048 0 0 1 /end COMPU_METHOD
/begin COMPU_METHOD SAB_M_NM_M500_S2_S3 "int = ((phys * 1) / 1) - (-500) Nm" RAT_FUNC "%1.0" "Nm" COEFFS 0 1 500 0 0 1 /end COMPU_METHOD
/begin COMPU_METHOD SAB_M_NM_M510_S2_S3 "int = ((phys * 1) / 1) - (-510) Nm" RAT_FUNC "%1.0" "Nm" COEFFS 0 1 510 0 0 1 /end COMPU_METHOD
/begin COMPU_METHOD SAB_M_Quanten_M509_S2_S3 "int = ((phys * 1) / 1) - (-509) Quanten" RAT_FUNC "%1.0" "Quanten" COEFFS 0 1 509 0 0 1 /end COMPU_METHOD
/begin COMPU_METHOD SAB_M_Quanten_S2_S3 "int = ((phys * 1) / 1) - (0) Quanten" RAT_FUNC "%1.0" "Quanten" COEFFS 0 1 0 0 0 1 /end COMPU_METHOD
/begin COMPU_METHOD SAB_MG_10NMS_S2_S3 "int = ((phys * 1) / 1) - (0) Nm/s" RAT_FUNC "%1.0" "Nm/s" COEFFS 0 1 0 0 0 1 /end COMPU_METHOD
/begin COMPU_METHOD SAB_MG_25NMS_S2_S3 "int = ((phys * 1) / 25) - (0) Nm/s" RAT_FUNC "%4.3" "Nm/s" COEFFS 0 0.04 0 0 0 1 /end COMPU_METHOD
/begin COMPU_METHOD SAB_MG_50NMS_M6325_S2_S3 "int = ((phys * 1) / 50) - (-126.5) Nm/s" RAT_FUNC "%4.3" "Nm/s" COEFFS 0 0.02 126.5 0 0 1 /end COMPU_METHOD
/begin COMPU_METHOD SAB_MG_50NMS_M6350_S2_S3 "int = ((phys * 1) / 50) - (-127) Nm/s" RAT_FUNC "%4.3" "Nm/s" COEFFS 0 0.02 127 0 0 1 /end COMPU_METHOD
/begin COMPU_METHOD SAB_MG_M25NMS_S2_S3 "int = ((phys * 1) / -25) - (0) Nm/s" RAT_FUNC "%4.3" "Nm/s" COEFFS 0 -0.04 0 0 0 1 /end COMPU_METHOD
/begin COMPU_METHOD SAB_MG_NMS_S2_S3 "int = ((phys * 1) / 1) - (0) Nm/s" RAT_FUNC "%1.0" "Nm/s" COEFFS 0 1 0 0 0 1 /end COMPU_METHOD
/begin COMPU_METHOD SAB_MINUTE_S2_S3 "int = ((phys * 1) / 1) - (0) minute" RAT_FUNC "%1.0" "minute" COEFFS 0 1 0 0 0 1 /end COMPU_METHOD
/begin COMPU_METHOD SAB_MONTH_S2_S3 "int = ((phys * 1) / 1) - (0) month" RAT_FUNC "%1.0" "month" COEFFS 0 1 0 0 0 1 /end COMPU_METHOD
/begin COMPU_METHOD SAB_N_100RPM_S2_S3 "int = ((phys * 1) / 100) - (0) 1/min" RAT_FUNC "%4.3" "1/min" COEFFS 0 0.01 0 0 0 1 /end COMPU_METHOD
/begin COMPU_METHOD SAB_N_125RPM1000_S2_S3 "int = ((phys * 1000) / 125) - (0) U/min" RAT_FUNC "%4.3" "U/min" COEFFS 0 8 0 0 0 1 /end COMPU_METHOD
/begin COMPU_METHOD SAB_N_16RPM_S2_S3 "int = ((phys * 1) / 16) - (0) U/min" RAT_FUNC "%4.3" "U/min" COEFFS 0 0.0625 0 0 0 1 /end COMPU_METHOD
/begin COMPU_METHOD SAB_N_20RPM_S2_S3 "int = ((phys * 1) / 20) - (0) 1/min" RAT_FUNC "%1.0" "1/min" COEFFS 0 0.05 0 0 0 1 /end COMPU_METHOD
/begin COMPU_METHOD SAB_N_25GRADPS_S2_S3 "int = ((phys * 1) / 25) - (0) Grad/s" RAT_FUNC "%4.3" "Grad/s" COEFFS 0 0.04 0 0 0 1 /end COMPU_METHOD
/begin COMPU_METHOD SAB_N_25RPM_P2000_S2_S3 "int = ((phys * 1) / 25) - (80) 1/min" RAT_FUNC "%4.3" "1/min" COEFFS 0 0.04 -80 0 0 1 /end COMPU_METHOD
/begin COMPU_METHOD SAB_N_25RPM_P750_S2_S3 "int = ((phys * 1) / 25) - (30) 1/min" RAT_FUNC "%4.3" "1/min" COEFFS 0 0.04 -30 0 0 1 /end COMPU_METHOD
/begin COMPU_METHOD SAB_N_25RPM_S2_S3 "int = ((phys * 1) / 25) - (0) 1/min" RAT_FUNC "%4.3" "1/min" COEFFS 0 0.04 0 0 0 1 /end COMPU_METHOD
/begin COMPU_METHOD SAB_N_294118RPM10000_S2_S3 "int = ((phys * 10000) / 294118) - (0) 1/min" RAT_FUNC "%4.3" "1/min" COEFFS 0 0.0339999592 0 0 0 1 /end COMPU_METHOD
/begin MEASUREMENT ZFEH_EepromData.di_statusOfDTC[87] "status of DTC of error code [0 .. 254-1]" UBYTE EH_STANDARD_S4_S3 1 100 0 255 ECU_ADDRESS 0xFFF82B8F DISPLAY_IDENTIFIER di_statusOfDTC[87].ZFEH_EepromData /end MEASUREMENT
/begin MEASUREMENT ZFEH_EepromData.di_statusOfDTC[88] "status of DTC of error code [0 .. 254-1]" UBYTE EH_STANDARD_S4_S3 1 100 0 255 ECU_ADDRESS 0xFFF82B90 DISPLAY_IDENTIFIER di_statusOfDTC[88].ZFEH_EepromData /end MEASUREMENT
/begin MEASUREMENT ZFEH_EepromData.di_statusOfDTC[89] "status of DTC of error code [0 .. 254-1]" UBYTE EH_STANDARD_S4_S3 1 100 0 255 ECU_ADDRESS 0xFFF82B91 DISPLAY_IDENTIFIER di_statusOfDTC[89].ZFEH_EepromData /end MEASUREMENT
/begin MEASUREMENT ZFEH_EepromData.di_statusOfDTC[8] "status of DTC of error code [0 .. 254-1]" UBYTE EH_STANDARD_S4_S3 1 100 0 255 ECU_ADDRESS 0xFFF82B40 DISPLAY_IDENTIFIER di_statusOfDTC[8].ZFEH_EepromData /end MEASUREMENT
/begin MEASUREMENT ZFEH_EepromData.di_statusOfDTC[90] "status of DTC of error code [0 .. 254-1]" UBYTE EH_STANDARD_S4_S3 1 100 0 255 ECU_ADDRESS 0xFFF82B92 DISPLAY_IDENTIFIER di_statusOfDTC[90].ZFEH_EepromData /end MEASUREMENT
/begin MEASUREMENT ZFEH_EepromData.di_statusOfDTC[91] "status of DTC of error code [0 .. 254-1]" UBYTE EH_STANDARD_S4_S3 1 100 0 255 ECU_ADDRESS 0xFFF82B93 DISPLAY_IDENTIFIER di_statusOfDTC[91].ZFEH_EepromData /end MEASUREMENT
/begin MEASUREMENT ZFEH_EepromData.di_statusOfDTC[92] "status of DTC of error code [0 .. 254-1]" UBYTE EH_STANDARD_S4_S3 1 100 0 255 ECU_ADDRESS 0xFFF82B94 DISPLAY_IDENTIFIER di_statusOfDTC[92].ZFEH_EepromData /end MEASUREMENT
/begin MEASUREMENT ZFEH_EepromData.di_statusOfDTC[93] "status of DTC of error code [0 .. 254-1]" UBYTE EH_STANDARD_S4_S3 1 100 0 255 ECU_ADDRESS 0xFFF82B95 DISPLAY_IDENTIFIER di_statusOfDTC[93].ZFEH_EepromData /end MEASUREMENT
/begin MEASUREMENT ZFEH_EepromData.di_statusOfDTC[94] "status of DTC of error code [0 .. 254-1]" UBYTE EH_STANDARD_S4_S3 1 100 0 255 ECU_ADDRESS 0xFFF82B96 DISPLAY_IDENTIFIER di_statusOfDTC[94].ZFEH_EepromData /end MEASUREMENT
/begin MEASUREMENT ZFEH_EepromData.di_statusOfDTC[95] "status of DTC of error code [0 .. 254-1]" UBYTE EH_STANDARD_S4_S3 1 100 0 255 ECU_ADDRESS 0xFFF82B97 DISPLAY_IDENTIFIER di_statusOfDTC[95].ZFEH_EepromData /end MEASUREMENT
/begin MEASUREMENT ZFEH_EepromData.di_statusOfDTC[96] "status of DTC of error code [0 .. 254-1]" UBYTE EH_STANDARD_S4_S3 1 100 0 255 ECU_ADDRESS 0xFFF82B98 DISPLAY_IDENTIFIER di_statusOfDTC[96].ZFEH_EepromData /end MEASUREMENT
/begin MEASUREMENT ZFEH_EepromData.di_statusOfDTC[97] "status of DTC of error code [0 .. 254-1]" UBYTE EH_STANDARD_S4_S3 1 100 0 255 ECU_ADDRESS 0xFFF82B99 DISPLAY_IDENTIFIER di_statusOfDTC[97].ZFEH_EepromData /end MEASUREMENT
/begin MEASUREMENT ZFEH_EepromData.di_statusOfDTC[98] "status of DTC of error code [0 .. 254-1]" UBYTE EH_STANDARD_S4_S3 1 100 0 255 ECU_ADDRESS 0xFFF82B9A DISPLAY_IDENTIFIER di_statusOfDTC[98].ZFEH_EepromData /end MEASUREMENT
/begin MEASUREMENT ZFEH_EepromData.di_statusOfDTC[99] "status of DTC of error code [0 .. 254-1]" UBYTE EH_STANDARD_S4_S3 1 100 0 255 ECU_ADDRESS 0xFFF82B9B DISPLAY_IDENTIFIER di_statusOfDTC[99].ZFEH_EepromData /end MEASUREMENT
/begin MEASUREMENT ZFEH_EepromData.di_statusOfDTC[9] "status of DTC of error code [0 .. 254-1]" UBYTE EH_STANDARD_S4_S3 1 100 0 255 ECU_ADDRESS 0xFFF82B41 DISPLAY_IDENTIFIER di_statusOfDTC[9].ZFEH_EepromData /end MEASUREMENT
/begin MEASUREMENT ZFEH_EepromData.ydiBackupMemory_xau16[0].amb_cond.ambient_condition[0][0] "ambient condition shot [0 .. 2-1] with 25 data bytes [0 .. 25-1] for the error code stored in this error memory slot" UBYTE EH_STANDARD_S4_S3 1 100 0 255 ECU_ADDRESS 0xFFF82878 DISPLAY_IDENTIFIER ambient_condition[0][0].amb_cond.ydiBackupMemory_xau16[0].ZFEH_EepromData /end MEASUREMENT
/begin MEASUREMENT ZFEH_EepromData.ydiBackupMemory_xau16[0].amb_cond.ambient_condition[0][10] "ambient condition shot [0 .. 2-1] with 25 data bytes [0 .. 25-1] for the error code stored in this error memory slot" UBYTE EH_STANDARD_S4_S3 1 100 0 255 ECU_ADDRESS 0xFFF82882 DISPLAY_IDENTIFIER ambient_condition[0][10].amb_cond.ydiBackupMemory_xau16[0].ZFEH_EepromData /end MEASUREMENT
/begin MEASUREMENT ZFEH_EepromData.ydiBackupMemory_xau16[0].amb_cond.ambient_condition[0][11] "ambient condition shot [0 .. 2-1] with 25 data bytes [0 .. 25-1] for the error code stored in this error memory slot" UBYTE EH_STANDARD_S4_S3 1 100 0 255 ECU_ADDRESS 0xFFF82883 DISPLAY_IDENTIFIER ambient_condition[0][11].amb_cond.ydiBackupMemory_xau16[0].ZFEH_EepromData /end MEASUREMENT
/begin MEASUREMENT ZFEH_EepromData.ydiBackupMemory_xau16[0].amb_cond.ambient_condition[0][12] "ambient condition shot [0 .. 2-1] with 25 data bytes [0 .. 25-1] for the error code stored in this error memory slot" UBYTE EH_STANDARD_S4_S3 1 100 0 255 ECU_ADDRESS 0xFFF82884 DISPLAY_IDENTIFIER ambient_condition[0][12].amb_cond.ydiBackupMemory_xau16[0].ZFEH_EepromData /end MEASUREMENT
/begin MEASUREMENT ZFEH_EepromData.ydiBackupMemory_xau16[0].amb_cond.ambient_condition[0][13] "ambient condition shot [0 .. 2-1] with 25 data bytes [0 .. 25-1] for the error code stored in this error memory slot" UBYTE EH_STANDARD_S4_S3 1 100 0 255 ECU_ADDRESS 0xFFF82885 DISPLAY_IDENTIFIER ambient_condition[0][13].amb_cond.ydiBackupMemory_xau16[0].ZFEH_EepromData /end MEASUREMENT
/begin MEASUREMENT ZFEH_EepromData.ydiBackupMemory_xau16[0].amb_cond.ambient_condition[0][14] "ambient condition shot [0 .. 2-1] with 25 data bytes [0 .. 25-1] for the error code stored in this error memory slot" UBYTE EH_STANDARD_S4_S3 1 100 0 255 ECU_ADDRESS 0xFFF82886 DISPLAY_IDENTIFIER ambient_condition[0][14].amb_cond.ydiBackupMemory_xau16[0].ZFEH_EepromData /end MEASUREMENT
/begin MEASUREMENT ZFEH_EepromData.ydiBackupMemory_xau16[0].amb_cond.ambient_condition[0][15] "ambient condition shot [0 .. 2-1] with 25 data bytes [0 .. 25-1] for the error code stored in this error memory slot" UBYTE EH_STANDARD_S4_S3 1 100 0 255 ECU_ADDRESS 0xFFF82887 DISPLAY_IDENTIFIER ambient_condition[0][15].amb_cond.ydiBackupMemory_xau16[0].ZFEH_EepromData /end MEASUREMENT
/begin MEASUREMENT ZFEH_EepromData.ydiBackupMemory_xau16[0].amb_cond.ambient_condition[0][16] "ambient condition shot [0 .. 2-1] with 25 data bytes [0 .. 25-1] for the error code stored in this error memory slot" UBYTE EH_STANDARD_S4_S3 1 100 0 255 ECU_ADDRESS 0xFFF82888 DISPLAY_IDENTIFIER ambient_condition[0][16].amb_cond.ydiBackupMemory_xau16[0].ZFEH_EepromData /end MEASUREMENT
/begin MEASUREMENT ZFEH_EepromData.ydiBackupMemory_xau16[0].amb_cond.ambient_condition[0][17] "ambient condition shot [0 .. 2-1] with 25 data bytes [0 .. 25-1] for the error code stored in this error memory slot" UBYTE EH_STANDARD_S4_S3 1 100 0 255 ECU_ADDRESS 0xFFF82889 DISPLAY_IDENTIFIER ambient_condition[0][17].amb_cond.ydiBackupMemory_xau16[0].ZFEH_EepromData /end MEASUREMENT
/begin MEASUREMENT ZFEH_EepromData.ydiBackupMemory_xau16[0].amb_cond.ambient_condition[0][18] "ambient condition shot [0 .. 2-1] with 25 data bytes [0 .. 25-1] for the error code stored in this error memory slot" UBYTE EH_STANDARD_S4_S3 1 100 0 255 ECU_ADDRESS 0xFFF8288A DISPLAY_IDENTIFIER ambient_condition[0][18].amb_cond.ydiBackupMemory_xau16[0].ZFEH_EepromData /end MEASUREMENT
/begin MEASUREMENT ZFEH_EepromData.ydiBackupMemory_xau16[0].amb_cond.ambient_condition[0][19] "ambient condition shot [0 .. 2-1] with 25 data bytes [0 .. 25-1] for the error code stored in this error memory slot" UBYTE EH_STANDARD_S4_S3 1 100 0 255 ECU_ADDRESS 0xFFF8288B DISPLAY_IDENTIFIER ambient_condition[0][19].amb_cond.ydiBackupMemory_xau16[0].ZFEH_EepromData /end MEASUREMENT
/begin MEASUREMENT ZFEH_EepromData.ydiBackupMemory_xau16[0].amb_cond.ambient_condition[0][1] "ambient condition shot [0 .. 2-1] with 25 data bytes [0 .. 25-1] for the error code stored in this error memory slot" UBYTE EH_STANDARD_S4_S3 1 100 0 255 ECU_ADDRESS 0xFFF82879 DISPLAY_IDENTIFIER ambient_condition[0][1].amb_cond.ydiBackupMemory_xau16[0].ZFEH_EepromData /end MEASUREMENT
/begin MEASUREMENT ZFEH_EepromData.ydiBackupMemory_xau16[0].amb_cond.ambient_condition[0][20] "ambient condition shot [0 .. 2-1] with 25 data bytes [0 .. 25-1] for the error code stored in this error memory slot" UBYTE EH_STANDARD_S4_S3 1 100 0 255 ECU_ADDRESS 0xFFF8288C DISPLAY_IDENTIFIER ambient_condition[0][20].amb_cond.ydiBackupMemory_xau16[0].ZFEH_EepromData /end MEASUREMENT
/begin MEASUREMENT ZFEH_EepromData.ydiBackupMemory_xau16[0].amb_cond.ambient_condition[0][21] "ambient condition shot [0 .. 2-1] with 25 data bytes [0 .. 25-1] for the error code stored in this error memory slot" UBYTE EH_STANDARD_S4_S3 1 100 0 255 ECU_ADDRESS 0xFFF8288D DISPLAY_IDENTIFIER ambient_condition[0][21].amb_cond.ydiBackupMemory_xau16[0].ZFEH_EepromData /end MEASUREMENT
/begin MEASUREMENT ZFEH_EepromData.ydiBackupMemory_xau16[0].amb_cond.ambient_condition[0][22] "ambient condition shot [0 .. 2-1] with 25 data bytes [0 .. 25-1] for the error code stored in this error memory slot" UBYTE EH_STANDARD_S4_S3 1 100 0 255 ECU_ADDRESS 0xFFF8288E DISPLAY_IDENTIFIER ambient_condition[0][22].amb_cond.ydiBackupMemory_xau16[0].ZFEH_EepromData /end MEASUREMENT
/begin MEASUREMENT ZFEH_EepromData.ydiBackupMemory_xau16[0].amb_cond.ambient_condition[0][23] "ambient condition shot [0 .. 2-1] with 25 data bytes [0 .. 25-1] for the error code stored in this error memory slot" UBYTE EH_STANDARD_S4_S3 1 100 0 255 ECU_ADDRESS 0xFFF8288F DISPLAY_IDENTIFIER ambient_condition[0][23].amb_cond.ydiBackupMemory_xau16[0].ZFEH_EepromData /end MEASUREMENT
/begin MEASUREMENT ZFEH_EepromData.ydiBackupMemory_xau16[0].amb_cond.ambient_condition[0][24] "ambient condition shot [0 .. 2-1] with 25 data bytes [0 .. 25-1] for the error code stored in this error memory slot" UBYTE EH_STANDARD_S4_S3 1 100 0 255 ECU_ADDRESS 0xFFF82890 DISPLAY_IDENTIFIER ambient_condition[0][24].amb_cond.ydiBackupMemory_xau16[0].ZFEH_EepromData /end MEASUREMENT
/begin MEASUREMENT ZFEH_EepromData.ydiBackupMemory_xau16[0].amb_cond.ambient_condition[0][2] "ambient condition shot [0 .. 2-1] with 25 data bytes [0 .. 25-1] for the error code stored in this error memory slot" UBYTE EH_STANDARD_S4_S3 1 100 0 255 ECU_ADDRESS 0xFFF8287A DISPLAY_IDENTIFIER ambient_condition[0][2].amb_cond.ydiBackupMemory_xau16[0].ZFEH_EepromData /end MEASUREMENT
/begin MEASUREMENT ZFEH_EepromData.ydiBackupMemory_xau16[0].amb_cond.ambient_condition[0][3] "ambient condition shot [0 .. 2-1] with 25 data bytes [0 .. 25-1] for the error code stored in this error memory slot" UBYTE EH_STANDARD_S4_S3 1 100 0 255 ECU_ADDRESS 0xFFF8287B DISPLAY_IDENTIFIER ambient_condition[0][3].amb_cond.ydiBackupMemory_xau16[0].ZFEH_EepromData /end MEASUREMENT
/begin MEASUREMENT ZFEH_EepromData.ydiBackupMemory_xau16[0].amb_cond.ambient_condition[0][4] "ambient condition shot [0 .. 2-1] with 25 data bytes [0 .. 25-1] for the error code stored in this error memory slot" UBYTE EH_STANDARD_S4_S3 1 100 0 255 ECU_ADDRESS 0xFFF8287C DISPLAY_IDENTIFIER ambient_condition[0][4].amb_cond.ydiBackupMemory_xau16[0].ZFEH_EepromData /end MEASUREMENT
/begin MEASUREMENT ZFEH_EepromData.ydiBackupMemory_xau16[0].amb_cond.ambient_condition[0][5] "ambient condition shot [0 .. 2-1] with 25 data bytes [0 .. 25-1] for the error code stored in this error memory slot" UBYTE EH_STANDARD_S4_S3 1 100 0 255 ECU_ADDRESS 0xFFF8287D DISPLAY_IDENTIFIER ambient_condition[0][5].amb_cond.ydiBackupMemory_xau16[0].ZFEH_EepromData /end MEASUREMENT
/begin MEASUREMENT ZFEH_EepromData.ydiBackupMemory_xau16[0].amb_cond.ambient_condition[0][6] "ambient condition shot [0 .. 2-1] with 25 data bytes [0 .. 25-1] for the error code stored in this error memory slot" UBYTE EH_STANDARD_S4_S3 1 100 0 255 ECU_ADDRESS 0xFFF8287E DISPLAY_IDENTIFIER ambient_condition[0][6].amb_cond.ydiBackupMemory_xau16[0].ZFEH_EepromData /end MEASUREMENT
/begin MEASUREMENT ZFEH_EepromData.ydiBackupMemory_xau16[0].amb_cond.ambient_condition[0][7] "ambient condition shot [0 .. 2-1] with 25 data bytes [0 .. 25-1] for the error code stored in this error memory slot" UBYTE EH_STANDARD_S4_S3 1 100 0 255 ECU_ADDRESS 0xFFF8287F DISPLAY_IDENTIFIER ambient_condition[0][7].amb_cond.ydiBackupMemory_xau16[0].ZFEH_EepromData /end MEASUREMENT
/begin MEASUREMENT ZFEH_EepromData.ydiBackupMemory_xau16[0].amb_cond.ambient_condition[0][8] "ambient condition shot [0 .. 2-1] with 25 data bytes [0 .. 25-1] for the error code stored in this error memory slot" UBYTE EH_STANDARD_S4_S3 1 100 0 255 ECU_ADDRESS 0xFFF82880 DISPLAY_IDENTIFIER ambient_condition[0][8].amb_cond.ydiBackupMemory_xau16[0].ZFEH_EepromData /end MEASUREMENT
/begin MEASUREMENT ZFEH_EepromData.ydiBackupMemory_xau16[0].amb_cond.ambient_condition[0][9] "ambient condition shot [0 .. 2-1] with 25 data bytes [0 .. 25-1] for the error code stored in this error memory slot" UBYTE EH_STANDARD_S4_S3 1 100 0 255 ECU_ADDRESS 0xFFF82881 DISPLAY_IDENTIFIER ambient_condition[0][9].amb_cond.ydiBackupMemory_xau16[0].ZFEH_EepromData /end MEASUREMENT
/begin MEASUREMENT ZFEH_EepromData.ydiBackupMemory_xau16[0].amb_cond.ambient_condition[1][0] "ambient condition shot [0 .. 2-1] with 25 data bytes [0 .. 25-1] for the error code stored in this error memory slot" UBYTE EH_STANDARD_S4_S3 1 100 0 255 ECU_ADDRESS 0xFFF82891 DISPLAY_IDENTIFIER ambient_condition[1][0].amb_cond.ydiBackupMemory_xau16[0].ZFEH_EepromData /end MEASUREMENT
/begin MEASUREMENT ZFEH_EepromData.ydiBackupMemory_xau16[0].amb_cond.ambient_condition[1][10] "ambient condition shot [0 .. 2-1] with 25 data bytes [0 .. 25-1] for the error code stored in this error memory slot" UBYTE EH_STANDARD_S4_S3 1 100 0 255 ECU_ADDRESS 0xFFF8289B DISPLAY_IDENTIFIER ambient_condition[1][10].amb_cond.ydiBackupMemory_xau16[0].ZFEH_EepromData /end MEASUREMENT
/begin MEASUREMENT ZFEH_EepromData.ydiBackupMemory_xau16[0].amb_cond.ambient_condition[1][11] "ambient condition shot [0 .. 2-1] with 25 data bytes [0 .. 25-1] for the error code stored in this error memory slot" UBYTE EH_STANDARD_S4_S3 1 100 0 255 ECU_ADDRESS 0xFFF8289C DISPLAY_IDENTIFIER ambient_condition[1][11].amb_cond.ydiBackupMemory_xau16[0].ZFEH_EepromData /end MEASUREMENT
/begin MEASUREMENT ZFEH_EepromData.ydiBackupMemory_xau16[0].amb_cond.ambient_condition[1][12] "ambient condition shot [0 .. 2-1] with 25 data bytes [0 .. 25-1] for the error code stored in this error memory slot" UBYTE EH_STANDARD_S4_S3 1 100 0 255 ECU_ADDRESS 0xFFF8289D DISPLAY_IDENTIFIER ambient_condition[1][12].amb_cond.ydiBackupMemory_xau16[0].ZFEH_EepromData /end MEASUREMENT
/begin MEASUREMENT ZFEH_EepromData.ydiBackupMemory_xau16[0].amb_cond.ambient_condition[1][13] "ambient condition shot [0 .. 2-1] with 25 data bytes [0 .. 25-1] for the error code stored in this error memory slot" UBYTE EH_STANDARD_S4_S3 1 100 0 255 ECU_ADDRESS 0xFFF8289E DISPLAY_IDENTIFIER ambient_condition[1][13].amb_cond.ydiBackupMemory_xau16[0].ZFEH_EepromData /end MEASUREMENT
/begin MEASUREMENT ZFEH_EepromData.ydiBackupMemory_xau16[0].amb_cond.ambient_condition[1][14] "ambient condition shot [0 .. 2-1] with 25 data bytes [0 .. 25-1] for the error code stored in this error memory slot" UBYTE EH_STANDARD_S4_S3 1 100 0 255 ECU_ADDRESS 0xFFF8289F DISPLAY_IDENTIFIER ambient_condition[1][14].amb_cond.ydiBackupMemory_xau16[0].ZFEH_EepromData /end MEASUREMENT
/begin MEASUREMENT ZFEH_EepromData.ydiBackupMemory_xau16[0].amb_cond.ambient_condition[1][15] "ambient condition shot [0 .. 2-1] with 25 data bytes [0 .. 25-1] for the error code stored in this error memory slot" UBYTE EH_STANDARD_S4_S3 1 100 0 255 ECU_ADDRESS 0xFFF828A0 DISPLAY_IDENTIFIER ambient_condition[1][15].amb_cond.ydiBackupMemory_xau16[0].ZFEH_EepromData /end MEASUREMENT
/begin MEASUREMENT ZFEH_EepromData.ydiBackupMemory_xau16[0].amb_cond.ambient_condition[1][16] "ambient condition shot [0 .. 2-1] with 25 data bytes [0 .. 25-1] for the error code stored in this error memory slot" UBYTE EH_STANDARD_S4_S3 1 100 0 255 ECU_ADDRESS 0xFFF828A1 DISPLAY_IDENTIFIER ambient_condition[1][16].amb_cond.ydiBackupMemory_xau16[0].ZFEH_EepromData /end MEASUREMENT
/begin MEASUREMENT ZFEH_EepromData.ydiBackupMemory_xau16[0].amb_cond.ambient_condition[1][17] "ambient condition shot [0 .. 2-1] with 25 data bytes [0 .. 25-1] for the error code stored in this error memory slot" UBYTE EH_STANDARD_S4_S3 1 100 0 255 ECU_ADDRESS 0xFFF828A2 DISPLAY_IDENTIFIER ambient_condition[1][17].amb_cond.ydiBackupMemory_xau16[0].ZFEH_EepromData /end MEASUREMENT
/begin MEASUREMENT ZFEH_EepromData.ydiBackupMemory_xau16[0].amb_cond.ambient_condition[1][18] "ambient condition shot [0 .. 2-1] with 25 data bytes [0 .. 25-1] for the error code stored in this error memory slot" UBYTE EH_STANDARD_S4_S3 1 100 0 255 ECU_ADDRESS 0xFFF828A3 DISPLAY_IDENTIFIER ambient_condition[1][18].amb_cond.ydiBackupMemory_xau16[0].ZFEH_EepromData /end MEASUREMENT
/begin MEASUREMENT ZFEH_EepromData.ydiBackupMemory_xau16[0].amb_cond.ambient_condition[1][19] "ambient condition shot [0 .. 2-1] with 25 data bytes [0 .. 25-1] for the error code stored in this error memory slot" UBYTE EH_STANDARD_S4_S3 1 100 0 255 ECU_ADDRESS 0xFFF828A4 DISPLAY_IDENTIFIER ambient_condition[1][19].amb_cond.ydiBackupMemory_xau16[0].ZFEH_EepromData /end MEASUREMENT
/begin MEASUREMENT ZFEH_EepromData.ydiBackupMemory_xau16[0].amb_cond.ambient_condition[1][1] "ambient condition shot [0 .. 2-1] with 25 data bytes [0 .. 25-1] for the error code stored in this error memory slot" UBYTE EH_STANDARD_S4_S3 1 100 0 255 ECU_ADDRESS 0xFFF82892 DISPLAY_IDENTIFIER ambient_condition[1][1].amb_cond.ydiBackupMemory_xau16[0].ZFEH_EepromData /end MEASUREMENT
/begin MEASUREMENT ZFEH_EepromData.ydiBackupMemory_xau16[0].amb_cond.ambient_condition[1][20] "ambient condition shot [0 .. 2-1] with 25 data bytes [0 .. 25-1] for the error code stored in this error memory slot" UBYTE EH_STANDARD_S4_S3 1 100 0 255 ECU_ADDRESS 0xFFF828A5 DISPLAY_IDENTIFIER ambient_condition[1][20].amb_cond.ydiBackupMemory_xau16[0].ZFEH_EepromData /end MEASUREMENT
/begin MEASUREMENT ZFEH_EepromData.ydiBackupMemory_xau16[0].amb_cond.ambient_condition[1][21] "ambient condition shot [0 .. 2-1] with 25 data bytes [0 .. 25-1] for the error code stored in this error memory slot" UBYTE EH_STANDARD_S4_S3 1 100 0 255 ECU_ADDRESS 0xFFF828A6 DISPLAY_IDENTIFIER ambient_condition[1][21].amb_cond.ydiBackupMemory_xau16[0].ZFEH_EepromData /end MEASUREMENT
/begin MEASUREMENT ZFEH_EepromData.ydiBackupMemory_xau16[0].amb_cond.ambient_condition[1][22] "ambient condition shot [0 .. 2-1] with 25 data bytes [0 .. 25-1] for the error code stored in this error memory slot" UBYTE EH_STANDARD_S4_S3 1 100 0 255 ECU_ADDRESS 0xFFF828A7 DISPLAY_IDENTIFIER ambient_condition[1][22].amb_cond.ydiBackupMemory_xau16[0].ZFEH_EepromData /end MEASUREMENT
/begin MEASUREMENT ZFEH_EepromData.ydiBackupMemory_xau16[0].amb_cond.ambient_condition[1][23] "ambient condition shot [0 .. 2-1] with 25 data bytes [0 .. 25-1] for the error code stored in this error memory slot" UBYTE EH_STANDARD_S4_S3 1 100 0 255 ECU_ADDRESS 0xFFF828A8 DISPLAY_IDENTIFIER ambient_condition[1][23].amb_cond.ydiBackupMemory_xau16[0].ZFEH_EepromData /end MEASUREMENT
/begin MEASUREMENT ZFEH_EepromData.ydiBackupMemory_xau16[0].amb_cond.ambient_condition[1][24] "ambient condition shot [0 .. 2-1] with 25 data bytes [0 .. 25-1] for the error code stored in this error memory slot" UBYTE EH_STANDARD_S4_S3 1 100 0 255 ECU_ADDRESS 0xFFF828A9 DISPLAY_IDENTIFIER ambient_condition[1][24].amb_cond.ydiBackupMemory_xau16[0].ZFEH_EepromData /end MEASUREMENT
/begin MEASUREMENT ZFEH_EepromData.ydiBackupMemory_xau16[0].amb_cond.ambient_condition[1][2] "ambient condition shot [0 .. 2-1] with 25 data bytes [0 .. 25-1] for the error code stored in this error memory slot" UBYTE EH_STANDARD_S4_S3 1 100 0 255 ECU_ADDRESS 0xFFF82893 DISPLAY_IDENTIFIER ambient_condition[1][2].amb_cond.ydiBackupMemory_xau16[0].ZFEH_EepromData /end MEASUREMENT
/begin MEASUREMENT ZFEH_EepromData.ydiBackupMemory_xau16[0].amb_cond.ambient_condition[1][3] "ambient condition shot [0 .. 2-1] with 25 data bytes [0 .. 25-1] for the error code stored in this error memory slot" UBYTE EH_STANDARD_S4_S3 1 100 0 255 ECU_ADDRESS 0xFFF82894 DISPLAY_IDENTIFIER ambient_condition[1][3].amb_cond.ydiBackupMemory_xau16[0].ZFEH_EepromData /end MEASUREMENT
/begin MEASUREMENT ZFEH_EepromData.ydiBackupMemory_xau16[0].amb_cond.ambient_condition[1][4] "ambient condition shot [0 .. 2-1] with 25 data bytes [0 .. 25-1] for the error code stored in this error memory slot" UBYTE EH_STANDARD_S4_S3 1 100 0 255 ECU_ADDRESS 0xFFF82895 DISPLAY_IDENTIFIER ambient_condition[1][4].amb_cond.ydiBackupMemory_xau16[0].ZFEH_EepromData /end MEASUREMENT
/begin MEASUREMENT ZFEH_EepromData.ydiBackupMemory_xau16[0].amb_cond.ambient_condition[1][5] "ambient condition shot [0 .. 2-1] with 25 data bytes [0 .. 25-1] for the error code stored in this error memory slot" UBYTE EH_STANDARD_S4_S3 1 100 0 255 ECU_ADDRESS 0xFFF82896 DISPLAY_IDENTIFIER ambient_condition[1][5].amb_cond.ydiBackupMemory_xau16[0].ZFEH_EepromData /end MEASUREMENT
/begin MEASUREMENT ZFEH_EepromData.ydiBackupMemory_xau16[0].amb_cond.ambient_condition[1][6] "ambient condition shot [0 .. 2-1] with 25 data bytes [0 .. 25-1] for the error code stored in this error memory slot" UBYTE EH_STANDARD_S4_S3 1 100 0 255 ECU_ADDRESS 0xFFF82897 DISPLAY_IDENTIFIER ambient_condition[1][6].amb_cond.ydiBackupMemory_xau16[0].ZFEH_EepromData /end MEASUREMENT
/begin MEASUREMENT ZFEH_EepromData.ydiBackupMemory_xau16[0].amb_cond.ambient_condition[1][7] "ambient condition shot [0 .. 2-1] with 25 data bytes [0 .. 25-1] for the error code stored in this error memory slot" UBYTE EH_STANDARD_S4_S3 1 100 0 255 ECU_ADDRESS 0xFFF82898 DISPLAY_IDENTIFIER ambient_condition[1][7].amb_cond.ydiBackupMemory_xau16[0].ZFEH_EepromData /end MEASUREMENT
/begin MEASUREMENT ZFEH_EepromData.ydiBackupMemory_xau16[0].amb_cond.ambient_condition[1][8] "ambient condition shot [0 .. 2-1] with 25 data bytes [0 .. 25-1] for the error code stored in this error memory slot" UBYTE EH_STANDARD_S4_S3 1 100 0 255 ECU_ADDRESS 0xFFF82899 DISPLAY_IDENTIFIER ambient_condition[1][8].amb_cond.ydiBackupMemory_xau16[0].ZFEH_EepromData /end MEASUREMENT
/begin MEASUREMENT ZFEH_EepromData.ydiBackupMemory_xau16[0].amb_cond.ambient_condition[1][9] "ambient condition shot [0 .. 2-1] with 25 data bytes [0 .. 25-1] for the error code stored in this error memory slot" UBYTE EH_STANDARD_S4_S3 1 100 0 255 ECU_ADDRESS 0xFFF8289A DISPLAY_IDENTIFIER ambient_condition[1][9].amb_cond.ydiBackupMemory_xau16[0].ZFEH_EepromData /end MEASUREMENT
/begin MEASUREMENT ZFEH_EepromData.ydiBackupMemory_xau16[0].amb_cond.status_of_ambient_conditions[0] "status of ambient condition shot x: 0=invalid 1=valid" UBYTE EH_STANDARD_S4_S3 1 100 0 1 ECU_ADDRESS 0xFFF828AA DISPLAY_IDENTIFIER status_of_ambient_conditions[0].amb_cond.ydiBackupMemory_xau16[0].ZFEH_EepromData /end MEASUREMENT
/begin MEASUREMENT ZFEH_EepromData.ydiBackupMemory_xau16[0].amb_cond.status_of_ambient_conditions[1] "status of ambient condition shot x: 0=invalid 1=valid" UBYTE EH_STANDARD_S4_S3 1 100 0 1 ECU_ADDRESS 0xFFF828AB DISPLAY_IDENTIFIER status_of_ambient_conditions[1].amb_cond.ydiBackupMemory_xau16[0].ZFEH_EepromData /end MEASUREMENT
/begin MEASUREMENT ZFEH_EepromData.ydiBackupMemory_xau16[0].backwards_counter "backwards counter of error code stored in error memory slot" UBYTE EH_STANDARD_S4_S3 1 100 0 255 ECU_ADDRESS 0xFFF8286B DISPLAY_IDENTIFIER backwards_counter.ydiBackupMemory_xau16[0].ZFEH_EepromData /end MEASUREMENT
/begin MEASUREMENT ZFEH_EepromData.ydiBackupMemory_xau16[0].condition_byte "condition byte of error code stored in error memory slot" UBYTE EH_STANDARD_S4_S3 1 100 0 255 ECU_ADDRESS 0xFFF82875 DISPLAY_IDENTIFIER condition_byte.ydiBackupMemory_xau16[0].ZFEH_EepromData /end MEASUREMENT
/begin MEASUREMENT ZFEH_EepromData.ydiBackupMemory_xau16[0].error_code "error code stored in error memory slot" UWORD EH_STANDARD_S4_S3 1 100 0 65535 ECU_ADDRESS 0xFFF82864 DISPLAY_IDENTIFIER error_code.ydiBackupMemory_xau16[0].ZFEH_EepromData /end MEASUREMENT
/begin MEASUREMENT ZFEH_EepromData.ydiBackupMemory_xau16[0].error_type "error type of error code stored in error memory slot" UWORD EH_STANDARD_S4_S3 1 100 0 65535 ECU_ADDRESS 0xFFF82866 DISPLAY_IDENTIFIER error_type.ydiBackupMemory_xau16[0].ZFEH_EepromData /end MEASUREMENT
/begin MEASUREMENT ZFEH_EepromData.ydiBackupMemory_xau16[0].frequency_counter "frequency counter of error code stored in error memory slot" UBYTE EH_STANDARD_S4_S3 1 100 0 255 ECU_ADDRESS 0xFFF8286A DISPLAY_IDENTIFIER frequency_counter.ydiBackupMemory_xau16[0].ZFEH_EepromData /end MEASUREMENT
/begin MEASUREMENT ZFEH_EepromData.ydiBackupMemory_xau16[0].master_time "master time of error code stored in error memory slot" ULONG EH_STANDARD_S4_S3 1 100 0 4294967295 ECU_ADDRESS 0xFFF82870 DISPLAY_IDENTIFIER master_time.ydiBackupMemory_xau16[0].ZFEH_EepromData /end MEASUREMENT
/begin MEASUREMENT ZFEH_EepromData.ydiBackupMemory_xau16[0].obd_driving_cycle_counter "obd driving cycle counter of error code stored in error memory slot" UWORD EH_STANDARD_S4_S3 1 100 0 65535 ECU_ADDRESS 0xFFF82876 DISPLAY_IDENTIFIER obd_driving_cycle_counter.ydiBackupMemory_xau16[0].ZFEH_EepromData /end MEASUREMENT
/begin MEASUREMENT ZFEH_EepromData.ydiBackupMemory_xau16[0].permanent_counter "counter of permanent error codes stored in error memory slot" UBYTE EH_STANDARD_S4_S3 1 100 0 255 ECU_ADDRESS 0xFFF8286C DISPLAY_IDENTIFIER permanent_counter.ydiBackupMemory_xau16[0].ZFEH_EepromData /end MEASUREMENT
/begin MEASUREMENT ZFEH_EepromData.ydiBackupMemory_xau16[0].sequence_counter "sequence counter of error code stored in error memory slot" UBYTE EH_STANDARD_S4_S3 1 100 0 255 ECU_ADDRESS 0xFFF8286D DISPLAY_IDENTIFIER sequence_counter.ydiBackupMemory_xau16[0].ZFEH_EepromData /end MEASUREMENT
/begin MEASUREMENT ZFEH_EepromData.ydiBackupMemory_xau16[0].status_word "status word of error code stored in error memory slot" UWORD EH_STANDARD_S4_S3 1 100 0 65535 ECU_ADDRESS 0xFFF82868 DISPLAY_IDENTIFIER status_word.ydiBackupMemory_xau16[0].ZFEH_EepromData /end MEASUREMENT
/begin MEASUREMENT ZFEH_EepromData.ydiBackupMemory_xau16[1].amb_cond.ambient_condition[0][0] "ambient condition shot [0 .. 2-1] with 25 data bytes [0 .. 25-1] for the error code stored in this error memory slot" UBYTE EH_STANDARD_S4_S3 1 100 0 255 ECU_ADDRESS 0xFFF828C0 DISPLAY_IDENTIFIER ambient_condition[0][0].amb_cond.ydiBackupMemory_xau16[1].ZFEH_EepromData /end MEASUREMENT
/begin MEASUREMENT ZFEH_EepromData.ydiBackupMemory_xau16[1].amb_cond.ambient_condition[0][10] "ambient condition shot [0 .. 2-1] with 25 data bytes [0 .. 25-1] for the error code stored in this error memory slot" UBYTE EH_STANDARD_S4_S3 1 100 0 255 ECU_ADDRESS 0xFFF828CA DISPLAY_IDENTIFIER ambient_condition[0][10].amb_cond.ydiBackupMemory_xau16[1].ZFEH_EepromData /end MEASUREMENT
/begin MEASUREMENT ZFEH_EepromData.ydiBackupMemory_xau16[1].amb_cond.ambient_condition[0][11] "ambient condition shot [0 .. 2-1] with 25 data bytes [0 .. 25-1] for the error code stored in this error memory slot" UBYTE EH_STANDARD_S4_S3 1 100 0 255 ECU_ADDRESS 0xFFF828CB DISPLAY_IDENTIFIER ambient_condition[0][11].amb_cond.ydiBackupMemory_xau16[1].ZFEH_EepromData /end MEASUREMENT
/begin MEASUREMENT ZFEH_EepromData.ydiBackupMemory_xau16[1].amb_cond.ambient_condition[0][12] "ambient condition shot [0 .. 2-1] with 25 data bytes [0 .. 25-1] for the error code stored in this error memory slot" UBYTE EH_STANDARD_S4_S3 1 100 0 255 ECU_ADDRESS 0xFFF828CC DISPLAY_IDENTIFIER ambient_condition[0][12].amb_cond.ydiBackupMemory_xau16[1].ZFEH_EepromData /end MEASUREMENT
/begin MEASUREMENT ZFEH_EepromData.ydiBackupMemory_xau16[1].amb_cond.ambient_condition[0][13] "ambient condition shot [0 .. 2-1] with 25 data bytes [0 .. 25-1] for the error code stored in this error memory slot" UBYTE EH_STANDARD_S4_S3 1 100 0 255 ECU_ADDRESS 0xFFF828CD DISPLAY_IDENTIFIER ambient_condition[0][13].amb_cond.ydiBackupMemory_xau16[1].ZFEH_EepromData /end MEASUREMENT
/begin MEASUREMENT ZFEH_EepromData.ydiBackupMemory_xau16[1].amb_cond.ambient_condition[0][14] "ambient condition shot [0 .. 2-1] with 25 data bytes [0 .. 25-1] for the error code stored in this error memory slot" UBYTE EH_STANDARD_S4_S3 1 100 0 255 ECU_ADDRESS 0xFFF828CE DISPLAY_IDENTIFIER ambient_condition[0][14].amb_cond.ydiBackupMemory_xau16[1].ZFEH_EepromData /end MEASUREMENT
/begin MEASUREMENT ZFEH_EepromData.ydiBackupMemory_xau16[1].amb_cond.ambient_condition[0][15] "ambient condition shot [0 .. 2-1] with 25 data bytes [0 .. 25-1] for the error code stored in this error memory slot" UBYTE EH_STANDARD_S4_S3 1 100 0 255 ECU_ADDRESS 0xFFF828CF DISPLAY_IDENTIFIER ambient_condition[0][15].amb_cond.ydiBackupMemory_xau16[1].ZFEH_EepromData /end MEASUREMENT
/begin MEASUREMENT ZFEH_EepromData.ydiBackupMemory_xau16[1].amb_cond.ambient_condition[0][16] "ambient condition shot [0 .. 2-1] with 25 data bytes [0 .. 25-1] for the error code stored in this error memory slot" UBYTE EH_STANDARD_S4_S3 1 100 0 255 ECU_ADDRESS 0xFFF828D0 DISPLAY_IDENTIFIER ambient_condition[0][16].amb_cond.ydiBackupMemory_xau16[1].ZFEH_EepromData /end MEASUREMENT
/begin MEASUREMENT ZFEH_EepromData.ydiBackupMemory_xau16[1].amb_cond.ambient_condition[0][17] "ambient condition shot [0 .. 2-1] with 25 data bytes [0 .. 25-1] for the error code stored in this error memory slot" UBYTE EH_STANDARD_S4_S3 1 100 0 255 ECU_ADDRESS 0xFFF828D1 DISPLAY_IDENTIFIER ambient_condition[0][17].amb_cond.ydiBackupMemory_xau16[1].ZFEH_EepromData /end MEASUREMENT
/begin MEASUREMENT ZFEH_EepromData.ydiBackupMemory_xau16[1].amb_cond.ambient_condition[0][18] "ambient condition shot [0 .. 2-1] with 25 data bytes [0 .. 25-1] for the error code stored in this error memory slot" UBYTE EH_STANDARD_S4_S3 1 100 0 255 ECU_ADDRESS 0xFFF828D2 DISPLAY_IDENTIFIER ambient_condition[0][18].amb_cond.ydiBackupMemory_xau16[1].ZFEH_EepromData /end MEASUREMENT
/begin MEASUREMENT ZFEH_EepromData.ydiBackupMemory_xau16[1].amb_cond.ambient_condition[0][19] "ambient condition shot [0 .. 2-1] with 25 data bytes [0 .. 25-1] for the error code stored in this error memory slot" UBYTE EH_STANDARD_S4_S3 1 100 0 255 ECU_ADDRESS 0xFFF828D3 DISPLAY_IDENTIFIER ambient_condition[0][19].amb_cond.ydiBackupMemory_xau16[1].ZFEH_EepromData /end MEASUREMENT
/begin MEASUREMENT ZFEH_EepromData.ydiBackupMemory_xau16[1].amb_cond.ambient_condition[0][1] "ambient condition shot [0 .. 2-1] with 25 data bytes [0 .. 25-1] for the error code stored in this error memory slot" UBYTE EH_STANDARD_S4_S3 1 100 0 255 ECU_ADDRESS 0xFFF828C1 DISPLAY_IDENTIFIER ambient_condition[0][1].amb_cond.ydiBackupMemory_xau16[1].ZFEH_EepromData /end MEASUREMENT
/begin MEASUREMENT ZFEH_EepromData.ydiBackupMemory_xau16[1].amb_cond.ambient_condition[0][20] "ambient condition shot [0 .. 2-1] with 25 data bytes [0 .. 25-1] for the error code stored in this error memory slot" UBYTE EH_STANDARD_S4_S3 1 100 0 255 ECU_ADDRESS 0xFFF828D4 DISPLAY_IDENTIFIER ambient_condition[0][20].amb_cond.ydiBackupMemory_xau16[1].ZFEH_EepromData /end MEASUREMENT
/begin MEASUREMENT ZFEH_EepromData.ydiBackupMemory_xau16[1].amb_cond.ambient_condition[0][21] "ambient condition shot [0 .. 2-1] with 25 data bytes [0 .. 25-1] for the error code stored in this error memory slot" UBYTE EH_STANDARD_S4_S3 1 100 0 255 ECU_ADDRESS 0xFFF828D5 DISPLAY_IDENTIFIER ambient_condition[0][21].amb_cond.ydiBackupMemory_xau16[1].ZFEH_EepromData /end MEASUREMENT
/begin MEASUREMENT ZFEH_EepromData.ydiBackupMemory_xau16[1].amb_cond.ambient_condition[0][22] "ambient condition shot [0 .. 2-1] with 25 data bytes [0 .. 25-1] for the error code stored in this error memory slot" UBYTE EH_STANDARD_S4_S3 1 100 0 255 ECU_ADDRESS 0xFFF828D6 DISPLAY_IDENTIFIER ambient_condition[0][22].amb_cond.ydiBackupMemory_xau16[1].ZFEH_EepromData /end MEASUREMENT
/begin MEASUREMENT ZFEH_EepromData.ydiBackupMemory_xau16[1].amb_cond.ambient_condition[0][23] "ambient condition shot [0 .. 2-1] with 25 data bytes [0 .. 25-1] for the error code stored in this error memory slot" UBYTE EH_STANDARD_S4_S3 1 100 0 255 ECU_ADDRESS 0xFFF828D7 DISPLAY_IDENTIFIER ambient_condition[0][23].amb_cond.ydiBackupMemory_xau16[1].ZFEH_EepromData /end MEASUREMENT
/begin MEASUREMENT ZFEH_EepromData.ydiBackupMemory_xau16[1].amb_cond.ambient_condition[0][24] "ambient condition shot [0 .. 2-1] with 25 data bytes [0 .. 25-1] for the error code stored in this error memory slot" UBYTE EH_STANDARD_S4_S3 1 100 0 255 ECU_ADDRESS 0xFFF828D8 DISPLAY_IDENTIFIER ambient_condition[0][24].amb_cond.ydiBackupMemory_xau16[1].ZFEH_EepromData /end MEASUREMENT
/begin MEASUREMENT ZFEH_EepromData.ydiBackupMemory_xau16[1].amb_cond.ambient_condition[0][2] "ambient condition shot [0 .. 2-1] with 25 data bytes [0 .. 25-1] for the error code stored in this error memory slot" UBYTE EH_STANDARD_S4_S3 1 100 0 255 ECU_ADDRESS 0xFFF828C2 DISPLAY_IDENTIFIER ambient_condition[0][2].amb_cond.ydiBackupMemory_xau16[1].ZFEH_EepromData /end MEASUREMENT
/begin MEASUREMENT ZFEH_EepromData.ydiBackupMemory_xau16[1].amb_cond.ambient_condition[0][3] "ambient condition shot [0 .. 2-1] with 25 data bytes [0 .. 25-1] for the error code stored in this error memory slot" UBYTE EH_STANDARD_S4_S3 1 100 0 255 ECU_ADDRESS 0xFFF828C3 DISPLAY_IDENTIFIER ambient_condition[0][3].amb_cond.ydiBackupMemory_xau16[1].ZFEH_EepromData /end MEASUREMENT
/begin MEASUREMENT ZFEH_EepromData.ydiBackupMemory_xau16[1].amb_cond.ambient_condition[0][4] "ambient condition shot [0 .. 2-1] with 25 data bytes [0 .. 25-1] for the error code stored in this error memory slot" UBYTE EH_STANDARD_S4_S3 1 100 0 255 ECU_ADDRESS 0xFFF828C4 DISPLAY_IDENTIFIER ambient_condition[0][4].amb_cond.ydiBackupMemory_xau16[1].ZFEH_EepromData /end MEASUREMENT
/begin MEASUREMENT ZFEH_EepromData.ydiBackupMemory_xau16[1].amb_cond.ambient_condition[0][5] "ambient condition shot [0 .. 2-1] with 25 data bytes [0 .. 25-1] for the error code stored in this error memory slot" UBYTE EH_STANDARD_S4_S3 1 100 0 255 ECU_ADDRESS 0xFFF828C5 DISPLAY_IDENTIFIER ambient_condition[0][5].amb_cond.ydiBackupMemory_xau16[1].ZFEH_EepromData /end MEASUREMENT
/begin MEASUREMENT ZFEH_EepromData.ydiBackupMemory_xau16[1].amb_cond.ambient_condition[0][6] "ambient condition shot [0 .. 2-1] with 25 data bytes [0 .. 25-1] for the error code stored in this error memory slot" UBYTE EH_STANDARD_S4_S3 1 100 0 255 ECU_ADDRESS 0xFFF828C6 DISPLAY_IDENTIFIER ambient_condition[0][6].amb_cond.ydiBackupMemory_xau16[1].ZFEH_EepromData /end MEASUREMENT
/begin MEASUREMENT ZFEH_EepromData.ydiBackupMemory_xau16[1].amb_cond.ambient_condition[0][7] "ambient condition shot [0 .. 2-1] with 25 data bytes [0 .. 25-1] for the error code stored in this error memory slot" UBYTE EH_STANDARD_S4_S3 1 100 0 255 ECU_ADDRESS 0xFFF828C7 DISPLAY_IDENTIFIER ambient_condition[0][7].amb_cond.ydiBackupMemory_xau16[1].ZFEH_EepromData /end MEASUREMENT
/begin MEASUREMENT ZFEH_EepromData.ydiBackupMemory_xau16[1].amb_cond.ambient_condition[0][8] "ambient condition shot [0 .. 2-1] with 25 data bytes [0 .. 25-1] for the error code stored in this error memory slot" UBYTE EH_STANDARD_S4_S3 1 100 0 255 ECU_ADDRESS 0xFFF828C8 DISPLAY_IDENTIFIER ambient_condition[0][8].amb_cond.ydiBackupMemory_xau16[1].ZFEH_EepromData /end MEASUREMENT
/begin MEASUREMENT ZFEH_EepromData.ydiBackupMemory_xau16[1].amb_cond.ambient_condition[0][9] "ambient condition shot [0 .. 2-1] with 25 data bytes [0 .. 25-1] for the error code stored in this error memory slot" UBYTE EH_STANDARD_S4_S3 1 100 0 255 ECU_ADDRESS 0xFFF828C9 DISPLAY_IDENTIFIER ambient_condition[0][9].amb_cond.ydiBackupMemory_xau16[1].ZFEH_EepromData /end MEASUREMENT
/begin MEASUREMENT ZFEH_EepromData.ydiBackupMemory_xau16[1].amb_cond.ambient_condition[1][0] "ambient condition shot [0 .. 2-1] with 25 data bytes [0 .. 25-1] for the error code stored in this error memory slot" UBYTE EH_STANDARD_S4_S3 1 100 0 255 ECU_ADDRESS 0xFFF828D9 DISPLAY_IDENTIFIER ambient_condition[1][0].amb_cond.ydiBackupMemory_xau16[1].ZFEH_EepromData /end MEASUREMENT
/begin MEASUREMENT ZFEH_EepromData.ydiBackupMemory_xau16[1].amb_cond.ambient_condition[1][10] "ambient condition shot [0 .. 2-1] with 25 data bytes [0 .. 25-1] for the error code stored in this error memory slot" UBYTE EH_STANDARD_S4_S3 1 100 0 255 ECU_ADDRESS 0xFFF828E3 DISPLAY_IDENTIFIER ambient_condition[1][10].amb_cond.ydiBackupMemory_xau16[1].ZFEH_EepromData /end MEASUREMENT
/begin MEASUREMENT ZFEH_EepromData.ydiBackupMemory_xau16[1].amb_cond.ambient_condition[1][11] "ambient condition shot [0 .. 2-1] with 25 data bytes [0 .. 25-1] for the error code stored in this error memory slot" UBYTE EH_STANDARD_S4_S3 1 100 0 255 ECU_ADDRESS 0xFFF828E4 DISPLAY_IDENTIFIER ambient_condition[1][11].amb_cond.ydiBackupMemory_xau16[1].ZFEH_EepromData /end MEASUREMENT
/begin MEASUREMENT ZFEH_EepromData.ydiBackupMemory_xau16[1].amb_cond.ambient_condition[1][12] "ambient condition shot [0 .. 2-1] with 25 data bytes [0 .. 25-1] for the error code stored in this error memory slot" UBYTE EH_STANDARD_S4_S3 1 100 0 255 ECU_ADDRESS 0xFFF828E5 DISPLAY_IDENTIFIER ambient_condition[1][12].amb_cond.ydiBackupMemory_xau16[1].ZFEH_EepromData /end MEASUREMENT
/begin MEASUREMENT ZFEH_EepromData.ydiBackupMemory_xau16[1].amb_cond.ambient_condition[1][13] "ambient condition shot [0 .. 2-1] with 25 data bytes [0 .. 25-1] for the error code stored in this error memory slot" UBYTE EH_STANDARD_S4_S3 1 100 0 255 ECU_ADDRESS 0xFFF828E6 DISPLAY_IDENTIFIER ambient_condition[1][13].amb_cond.ydiBackupMemory_xau16[1].ZFEH_EepromData /end MEASUREMENT
/begin MEASUREMENT ZFEH_EepromData.ydiBackupMemory_xau16[1].amb_cond.ambient_condition[1][14] "ambient condition shot [0 .. 2-1] with 25 data bytes [0 .. 25-1] for the error code stored in this error memory slot" UBYTE EH_STANDARD_S4_S3 1 100 0 255 ECU_ADDRESS 0xFFF828E7 DISPLAY_IDENTIFIER ambient_condition[1][14].amb_cond.ydiBackupMemory_xau16[1].ZFEH_EepromData /end MEASUREMENT
/begin MEASUREMENT ZFEH_EepromData.ydiBackupMemory_xau16[1].amb_cond.ambient_condition[1][15] "ambient condition shot [0 .. 2-1] with 25 data bytes [0 .. 25-1] for the error code stored in this error memory slot" UBYTE EH_STANDARD_S4_S3 1 100 0 255 ECU_ADDRESS 0xFFF828E8 DISPLAY_IDENTIFIER ambient_condition[1][15].amb_cond.ydiBackupMemory_xau16[1].ZFEH_EepromData /end MEASUREMENT
/begin MEASUREMENT ZFEH_EepromData.ydiBackupMemory_xau16[1].amb_cond.ambient_condition[1][16] "ambient condition shot [0 .. 2-1] with 25 data bytes [0 .. 25-1] for the error code stored in this error memory slot" UBYTE EH_STANDARD_S4_S3 1 100 0 255 ECU_ADDRESS 0xFFF828E9 DISPLAY_IDENTIFIER ambient_condition[1][16].amb_cond.ydiBackupMemory_xau16[1].ZFEH_EepromData /end MEASUREMENT
/begin MEASUREMENT ZFEH_EepromData.ydiBackupMemory_xau16[1].amb_cond.ambient_condition[1][17] "ambient condition shot [0 .. 2-1] with 25 data bytes [0 .. 25-1] for the error code stored in this error memory slot" UBYTE EH_STANDARD_S4_S3 1 100 0 255 ECU_ADDRESS 0xFFF828EA DISPLAY_IDENTIFIER ambient_condition[1][17].amb_cond.ydiBackupMemory_xau16[1].ZFEH_EepromData /end MEASUREMENT
/begin MEASUREMENT ZFEH_EepromData.ydiBackupMemory_xau16[1].amb_cond.ambient_condition[1][18] "ambient condition shot [0 .. 2-1] with 25 data bytes [0 .. 25-1] for the error code stored in this error memory slot" UBYTE EH_STANDARD_S4_S3 1 100 0 255 ECU_ADDRESS 0xFFF828EB DISPLAY_IDENTIFIER ambient_condition[1][18].amb_cond.ydiBackupMemory_xau16[1].ZFEH_EepromData /end MEASUREMENT
/begin MEASUREMENT ZFEH_EepromData.ydiBackupMemory_xau16[1].amb_cond.ambient_condition[1][19] "ambient condition shot [0 .. 2-1] with 25 data bytes [0 .. 25-1] for the error code stored in this error memory slot" UBYTE EH_STANDARD_S4_S3 1 100 0 255 ECU_ADDRESS 0xFFF828EC DISPLAY_IDENTIFIER ambient_condition[1][19].amb_cond.ydiBackupMemory_xau16[1].ZFEH_EepromData /end MEASUREMENT
/begin MEASUREMENT ZFEH_EepromData.ydiBackupMemory_xau16[1].amb_cond.ambient_condition[1][1] "ambient condition shot [0 .. 2-1] with 25 data bytes [0 .. 25-1] for the error code stored in this error memory slot" UBYTE EH_STANDARD_S4_S3 1 100 0 255 ECU_ADDRESS 0xFFF828DA DISPLAY_IDENTIFIER ambient_condition[1][1].amb_cond.ydiBackupMemory_xau16[1].ZFEH_EepromData /end MEASUREMENT
/begin MEASUREMENT ZFEH_EepromData.ydiBackupMemory_xau16[1].amb_cond.ambient_condition[1][20] "ambient condition shot [0 .. 2-1] with 25 data bytes [0 .. 25-1] for the error code stored in this error memory slot" UBYTE EH_STANDARD_S4_S3 1 100 0 255 ECU_ADDRESS 0xFFF828ED DISPLAY_IDENTIFIER ambient_condition[1][20].amb_cond.ydiBackupMemory_xau16[1].ZFEH_EepromData /end MEASUREMENT
/begin MEASUREMENT ZFEH_EepromData.ydiBackupMemory_xau16[1].amb_cond.ambient_condition[1][21] "ambient condition shot [0 .. 2-1] with 25 data bytes [0 .. 25-1] for the error code stored in this error memory slot" UBYTE EH_STANDARD_S4_S3 1 100 0 255 ECU_ADDRESS 0xFFF828EE DISPLAY_IDENTIFIER ambient_condition[1][21].amb_cond.ydiBackupMemory_xau16[1].ZFEH_EepromData /end MEASUREMENT
/begin MEASUREMENT ZFEH_EepromData.ydiBackupMemory_xau16[1].amb_cond.ambient_condition[1][22] "ambient condition shot [0 .. 2-1] with 25 data bytes [0 .. 25-1] for the error code stored in this error memory slot" UBYTE EH_STANDARD_S4_S3 1 100 0 255 ECU_ADDRESS 0xFFF828EF DISPLAY_IDENTIFIER ambient_condition[1][22].amb_cond.ydiBackupMemory_xau16[1].ZFEH_EepromData /end MEASUREMENT
/begin MEASUREMENT ZFEH_EepromData.ydiBackupMemory_xau16[1].amb_cond.ambient_condition[1][23] "ambient condition shot [0 .. 2-1] with 25 data bytes [0 .. 25-1] for the error code stored in this error memory slot" UBYTE EH_STANDARD_S4_S3 1 100 0 255 ECU_ADDRESS 0xFFF828F0 DISPLAY_IDENTIFIER ambient_condition[1][23].amb_cond.ydiBackupMemory_xau16[1].ZFEH_EepromData /end MEASUREMENT
/begin MEASUREMENT ZFEH_EepromData.ydiBackupMemory_xau16[1].amb_cond.ambient_condition[1][24] "ambient condition shot [0 .. 2-1] with 25 data bytes [0 .. 25-1] for the error code stored in this error memory slot" UBYTE EH_STANDARD_S4_S3 1 100 0 255 ECU_ADDRESS 0xFFF828F1 DISPLAY_IDENTIFIER ambient_condition[1][24].amb_cond.ydiBackupMemory_xau16[1].ZFEH_EepromData /end MEASUREMENT
/begin MEASUREMENT ZFEH_EepromData.ydiBackupMemory_xau16[1].amb_cond.ambient_condition[1][2] "ambient condition shot [0 .. 2-1] with 25 data bytes [0 .. 25-1] for the error code stored in this error memory slot" UBYTE EH_STANDARD_S4_S3 1 100 0 255 ECU_ADDRESS 0xFFF828DB DISPLAY_IDENTIFIER ambient_condition[1][2].amb_cond.ydiBackupMemory_xau16[1].ZFEH_EepromData /end MEASUREMENT
/begin MEASUREMENT ZFEH_EepromData.ydiBackupMemory_xau16[1].amb_cond.ambient_condition[1][3] "ambient condition shot [0 .. 2-1] with 25 data bytes [0 .. 25-1] for the error code stored in this error memory slot" UBYTE EH_STANDARD_S4_S3 1 100 0 255 ECU_ADDRESS 0xFFF828DC DISPLAY_IDENTIFIER ambient_condition[1][3].amb_cond.ydiBackupMemory_xau16[1].ZFEH_EepromData /end MEASUREMENT
/begin MEASUREMENT ZFEH_EepromData.ydiBackupMemory_xau16[1].amb_cond.ambient_condition[1][4] "ambient condition shot [0 .. 2-1] with 25 data bytes [0 .. 25-1] for the error code stored in this error memory slot" UBYTE EH_STANDARD_S4_S3 1 100 0 255 ECU_ADDRESS 0xFFF828DD DISPLAY_IDENTIFIER ambient_condition[1][4].amb_cond.ydiBackupMemory_xau16[1].ZFEH_EepromData /end MEASUREMENT
/begin MEASUREMENT ZFEH_EepromData.ydiBackupMemory_xau16[1].amb_cond.ambient_condition[1][5] "ambient condition shot [0 .. 2-1] with 25 data bytes [0 .. 25-1] for the error code stored in this error memory slot" UBYTE EH_STANDARD_S4_S3 1 100 0 255 ECU_ADDRESS 0xFFF828DE DISPLAY_IDENTIFIER ambient_condition[1][5].amb_cond.ydiBackupMemory_xau16[1].ZFEH_EepromData /end MEASUREMENT
/begin MEASUREMENT ZFEH_EepromData.ydiBackupMemory_xau16[1].amb_cond.ambient_condition[1][6] "ambient condition shot [0 .. 2-1] with 25 data bytes [0 .. 25-1] for the error code stored in this error memory slot" UBYTE EH_STANDARD_S4_S3 1 100 0 255 ECU_ADDRESS 0xFFF828DF DISPLAY_IDENTIFIER ambient_condition[1][6].amb_cond.ydiBackupMemory_xau16[1].ZFEH_EepromData /end MEASUREMENT
/begin MEASUREMENT ZFEH_EepromData.ydiBackupMemory_xau16[1].amb_cond.ambient_condition[1][7] "ambient condition shot [0 .. 2-1] with 25 data bytes [0 .. 25-1] for the error code stored in this error memory slot" UBYTE EH_STANDARD_S4_S3 1 100 0 255 ECU_ADDRESS 0xFFF828E0 DISPLAY_IDENTIFIER ambient_condition[1][7].amb_cond.ydiBackupMemory_xau16[1].ZFEH_EepromData /end MEASUREMENT
/begin MEASUREMENT ZFEH_EepromData.ydiBackupMemory_xau16[1].amb_cond.ambient_condition[1][8] "ambient condition shot [0 .. 2-1] with 25 data bytes [0 .. 25-1] for the error code stored in this error memory slot" UBYTE EH_STANDARD_S4_S3 1 100 0 255 ECU_ADDRESS 0xFFF828E1 DISPLAY_IDENTIFIER ambient_condition[1][8].amb_cond.ydiBackupMemory_xau16[1].ZFEH_EepromData /end MEASUREMENT
/begin MEASUREMENT ZFEH_EepromData.ydiBackupMemory_xau16[1].amb_cond.ambient_condition[1][9] "ambient condition shot [0 .. 2-1] with 25 data bytes [0 .. 25-1] for the error code stored in this error memory slot" UBYTE EH_STANDARD_S4_S3 1 100 0 255 ECU_ADDRESS 0xFFF828E2 DISPLAY_IDENTIFIER ambient_condition[1][9].amb_cond.ydiBackupMemory_xau16[1].ZFEH_EepromData /end MEASUREMENT
/begin MEASUREMENT ZFEH_EepromData.ydiBackupMemory_xau16[1].amb_cond.status_of_ambient_conditions[0] "status of ambient condition shot x: 0=invalid 1=valid" UBYTE EH_STANDARD_S4_S3 1 100 0 1 ECU_ADDRESS 0xFFF828F2 DISPLAY_IDENTIFIER status_of_ambient_conditions[0].amb_cond.ydiBackupMemory_xau16[1].ZFEH_EepromData /end MEASUREMENT
/begin MEASUREMENT ZFEH_EepromData.ydiBackupMemory_xau16[1].amb_cond.status_of_ambient_conditions[1] "status of ambient condition shot x: 0=invalid 1=valid" UBYTE EH_STANDARD_S4_S3 1 100 0 1 ECU_ADDRESS 0xFFF828F3 DISPLAY_IDENTIFIER status_of_ambient_conditions[1].amb_cond.ydiBackupMemory_xau16[1].ZFEH_EepromData /end MEASUREMENT
/begin MEASUREMENT ZFEH_EepromData.ydiBackupMemory_xau16[1].backwards_counter "backwards counter of error code stored in error memory slot" UBYTE EH_STANDARD_S4_S3 1 100 0 255 ECU_ADDRESS 0xFFF828B3 DISPLAY_IDENTIFIER backwards_counter.ydiBackupMemory_xau16[1].ZFEH_EepromData /end MEASUREMENT
/begin MEASUREMENT ZFEH_EepromData.ydiBackupMemory_xau16[1].condition_byte "condition byte of error code stored in error memory slot" UBYTE EH_STANDARD_S4_S3 1 100 0 255 ECU_ADDRESS 0xFFF828BD DISPLAY_IDENTIFIER condition_byte.ydiBackupMemory_xau16[1].ZFEH_EepromData /end MEASUREMENT
/begin MEASUREMENT ZFEH_EepromData.ydiBackupMemory_xau16[1].error_code "error code stored in error memory slot" UWORD EH_STANDARD_S4_S3 1 100 0 65535 ECU_ADDRESS 0xFFF828AC DISPLAY_IDENTIFIER error_code.ydiBackupMemory_xau16[1].ZFEH_EepromData /end MEASUREMENT
/begin MEASUREMENT ZFEH_EepromData.ydiBackupMemory_xau16[1].error_type "error type of error code stored in error memory slot" UWORD EH_STANDARD_S4_S3 1 100 0 65535 ECU_ADDRESS 0xFFF828AE DISPLAY_IDENTIFIER error_type.ydiBackupMemory_xau16[1].ZFEH_EepromData /end MEASUREMENT
/begin MEASUREMENT ZFEH_EepromData.ydiBackupMemory_xau16[1].frequency_counter "frequency counter of error code stored in error memory slot" UBYTE EH_STANDARD_S4_S3 1 100 0 255 ECU_ADDRESS 0xFFF828B2 DISPLAY_IDENTIFIER frequency_counter.ydiBackupMemory_xau16[1].ZFEH_EepromData /end MEASUREMENT
/begin MEASUREMENT ZFEH_EepromData.ydiBackupMemory_xau16[1].master_time "master time of error code stored in error memory slot" ULONG EH_STANDARD_S4_S3 1 100 0 4294967295 ECU_ADDRESS 0xFFF828B8 DISPLAY_IDENTIFIER master_time.ydiBackupMemory_xau16[1].ZFEH_EepromData /end MEASUREMENT
/begin MEASUREMENT ZFEH_EepromData.ydiBackupMemory_xau16[1].obd_driving_cycle_counter "obd driving cycle counter of error code stored in error memory slot" UWORD EH_STANDARD_S4_S3 1 100 0 65535 ECU_ADDRESS 0xFFF828BE DISPLAY_IDENTIFIER obd_driving_cycle_counter.ydiBackupMemory_xau16[1].ZFEH_EepromData /end MEASUREMENT
/begin MEASUREMENT ZFEH_EepromData.ydiBackupMemory_xau16[1].permanent_counter "counter of permanent error codes stored in error memory slot" UBYTE EH_STANDARD_S4_S3 1 100 0 255 ECU_ADDRESS 0xFFF828B4 DISPLAY_IDENTIFIER permanent_counter.ydiBackupMemory_xau16[1].ZFEH_EepromData /end MEASUREMENT
/begin MEASUREMENT ZFEH_EepromData.ydiBackupMemory_xau16[1].sequence_counter "sequence counter of error code stored in error memory slot" UBYTE EH_STANDARD_S4_S3 1 100 0 255 ECU_ADDRESS 0xFFF828B5 DISPLAY_IDENTIFIER sequence_counter.ydiBackupMemory_xau16[1].ZFEH_EepromData /end MEASUREMENT
/begin MEASUREMENT ZFEH_EepromData.ydiBackupMemory_xau16[1].status_word "status word of error code stored in error memory slot" UWORD EH_STANDARD_S4_S3 1 100 0 65535 ECU_ADDRESS 0xFFF828B0 DISPLAY_IDENTIFIER status_word.ydiBackupMemory_xau16[1].ZFEH_EepromData /end MEASUREMENT
/begin MEASUREMENT ZFEH_EepromData.ydiBackupMemory_xau16[2].amb_cond.ambient_condition[0][0] "ambient condition shot [0 .. 2-1] with 25 data bytes [0 .. 25-1] for the error code stored in this error memory slot" UBYTE EH_STANDARD_S4_S3 1 100 0 255 ECU_ADDRESS 0xFFF82908 DISPLAY_IDENTIFIER ambient_condition[0][0].amb_cond.ydiBackupMemory_xau16[2].ZFEH_EepromData /end MEASUREMENT
/begin MEASUREMENT ZFEH_EepromData.ydiBackupMemory_xau16[2].amb_cond.ambient_condition[0][10] "ambient condition shot [0 .. 2-1] with 25 data bytes [0 .. 25-1] for the error code stored in this error memory slot" UBYTE EH_STANDARD_S4_S3 1 100 0 255 ECU_ADDRESS 0xFFF82912 DISPLAY_IDENTIFIER ambient_condition[0][10].amb_cond.ydiBackupMemory_xau16[2].ZFEH_EepromData /end MEASUREMENT
/begin MEASUREMENT ZFEH_EepromData.ydiBackupMemory_xau16[2].amb_cond.ambient_condition[0][11] "ambient condition shot [0 .. 2-1] with 25 data bytes [0 .. 25-1] for the error code stored in this error memory slot" UBYTE EH_STANDARD_S4_S3 1 100 0 255 ECU_ADDRESS 0xFFF82913 DISPLAY_IDENTIFIER ambient_condition[0][11].amb_cond.ydiBackupMemory_xau16[2].ZFEH_EepromData /end MEASUREMENT
/begin MEASUREMENT ZFEH_EepromData.ydiBackupMemory_xau16[2].amb_cond.ambient_condition[0][12] "ambient condition shot [0 .. 2-1] with 25 data bytes [0 .. 25-1] for the error code stored in this error memory slot" UBYTE EH_STANDARD_S4_S3 1 100 0 255 ECU_ADDRESS 0xFFF82914 DISPLAY_IDENTIFIER ambient_condition[0][12].amb_cond.ydiBackupMemory_xau16[2].ZFEH_EepromData /end MEASUREMENT
/begin MEASUREMENT ZFEH_EepromData.ydiBackupMemory_xau16[2].amb_cond.ambient_condition[0][13] "ambient condition shot [0 .. 2-1] with 25 data bytes [0 .. 25-1] for the error code stored in this error memory slot" UBYTE EH_STANDARD_S4_S3 1 100 0 255 ECU_ADDRESS 0xFFF82915 DISPLAY_IDENTIFIER ambient_condition[0][13].amb_cond.ydiBackupMemory_xau16[2].ZFEH_EepromData /end MEASUREMENT
/begin MEASUREMENT ZFEH_EepromData.ydiBackupMemory_xau16[2].amb_cond.ambient_condition[0][14] "ambient condition shot [0 .. 2-1] with 25 data bytes [0 .. 25-1] for the error code stored in this error memory slot" UBYTE EH_STANDARD_S4_S3 1 100 0 255 ECU_ADDRESS 0xFFF82916 DISPLAY_IDENTIFIER ambient_condition[0][14].amb_cond.ydiBackupMemory_xau16[2].ZFEH_EepromData /end MEASUREMENT
/begin MEASUREMENT ZFEH_EepromData.ydiBackupMemory_xau16[2].amb_cond.ambient_condition[0][15] "ambient condition shot [0 .. 2-1] with 25 data bytes [0 .. 25-1] for the error code stored in this error memory slot" UBYTE EH_STANDARD_S4_S3 1 100 0 255 ECU_ADDRESS 0xFFF82917 DISPLAY_IDENTIFIER ambient_condition[0][15].amb_cond.ydiBackupMemory_xau16[2].ZFEH_EepromData /end MEASUREMENT
/begin MEASUREMENT ZFEH_EepromData.ydiBackupMemory_xau16[2].amb_cond.ambient_condition[0][16] "ambient condition shot [0 .. 2-1] with 25 data bytes [0 .. 25-1] for the error code stored in this error memory slot" UBYTE EH_STANDARD_S4_S3 1 100 0 255 ECU_ADDRESS 0xFFF82918 DISPLAY_IDENTIFIER ambient_condition[0][16].amb_cond.ydiBackupMemory_xau16[2].ZFEH_EepromData /end MEASUREMENT
/begin MEASUREMENT ZFEH_EepromData.ydiBackupMemory_xau16[2].amb_cond.ambient_condition[0][17] "ambient condition shot [0 .. 2-1] with 25 data bytes [0 .. 25-1] for the error code stored in this error memory slot" UBYTE EH_STANDARD_S4_S3 1 100 0 255 ECU_ADDRESS 0xFFF82919 DISPLAY_IDENTIFIER ambient_condition[0][17].amb_cond.ydiBackupMemory_xau16[2].ZFEH_EepromData /end MEASUREMENT
/begin MEASUREMENT ZFEH_EepromData.ydiBackupMemory_xau16[2].amb_cond.ambient_condition[0][18] "ambient condition shot [0 .. 2-1] with 25 data bytes [0 .. 25-1] for the error code stored in this error memory slot" UBYTE EH_STANDARD_S4_S3 1 100 0 255 ECU_ADDRESS 0xFFF8291A DISPLAY_IDENTIFIER ambient_condition[0][18].amb_cond.ydiBackupMemory_xau16[2].ZFEH_EepromData /end MEASUREMENT
/begin MEASUREMENT ZFEH_EepromData.ydiBackupMemory_xau16[2].amb_cond.ambient_condition[0][19] "ambient condition shot [0 .. 2-1] with 25 data bytes [0 .. 25-1] for the error code stored in this error memory slot" UBYTE EH_STANDARD_S4_S3 1 100 0 255 ECU_ADDRESS 0xFFF8291B DISPLAY_IDENTIFIER ambient_condition[0][19].amb_cond.ydiBackupMemory_xau16[2].ZFEH_EepromData /end MEASUREMENT
/begin MEASUREMENT ZFEH_EepromData.ydiBackupMemory_xau16[2].amb_cond.ambient_condition[0][1] "ambient condition shot [0 .. 2-1] with 25 data bytes [0 .. 25-1] for the error code stored in this error memory slot" UBYTE EH_STANDARD_S4_S3 1 100 0 255 ECU_ADDRESS 0xFFF82909 DISPLAY_IDENTIFIER ambient_condition[0][1].amb_cond.ydiBackupMemory_xau16[2].ZFEH_EepromData /end MEASUREMENT
/begin MEASUREMENT ZFEH_EepromData.ydiBackupMemory_xau16[2].amb_cond.ambient_condition[0][20] "ambient condition shot [0 .. 2-1] with 25 data bytes [0 .. 25-1] for the error code stored in this error memory slot" UBYTE EH_STANDARD_S4_S3 1 100 0 255 ECU_ADDRESS 0xFFF8291C DISPLAY_IDENTIFIER ambient_condition[0][20].amb_cond.ydiBackupMemory_xau16[2].ZFEH_EepromData /end MEASUREMENT
/begin MEASUREMENT ZFEH_EepromData.ydiBackupMemory_xau16[2].amb_cond.ambient_condition[0][21] "ambient condition shot [0 .. 2-1] with 25 data bytes [0 .. 25-1] for the error code stored in this error memory slot" UBYTE EH_STANDARD_S4_S3 1 100 0 255 ECU_ADDRESS 0xFFF8291D DISPLAY_IDENTIFIER ambient_condition[0][21].amb_cond.ydiBackupMemory_xau16[2].ZFEH_EepromData /end MEASUREMENT
/begin MEASUREMENT ZFEH_EepromData.ydiBackupMemory_xau16[2].amb_cond.ambient_condition[0][22] "ambient condition shot [0 .. 2-1] with 25 data bytes [0 .. 25-1] for the error code stored in this error memory slot" UBYTE EH_STANDARD_S4_S3 1 100 0 255 ECU_ADDRESS 0xFFF8291E DISPLAY_IDENTIFIER ambient_condition[0][22].amb_cond.ydiBackupMemory_xau16[2].ZFEH_EepromData /end MEASUREMENT
/begin MEASUREMENT ZFEH_EepromData.ydiBackupMemory_xau16[2].amb_cond.ambient_condition[0][23] "ambient condition shot [0 .. 2-1] with 25 data bytes [0 .. 25-1] for the error code stored in this error memory slot" UBYTE EH_STANDARD_S4_S3 1 100 0 255 ECU_ADDRESS 0xFFF8291F DISPLAY_IDENTIFIER ambient_condition[0][23].amb_cond.ydiBackupMemory_xau16[2].ZFEH_EepromData /end MEASUREMENT
/begin MEASUREMENT ZFEH_EepromData.ydiBackupMemory_xau16[2].amb_cond.ambient_condition[0][24] "ambient condition shot [0 .. 2-1] with 25 data bytes [0 .. 25-1] for the error code stored in this error memory slot" UBYTE EH_STANDARD_S4_S3 1 100 0 255 ECU_ADDRESS 0xFFF82920 DISPLAY_IDENTIFIER ambient_condition[0][24].amb_cond.ydiBackupMemory_xau16[2].ZFEH_EepromData /end MEASUREMENT
/begin MEASUREMENT ZFEH_EepromData.ydiBackupMemory_xau16[2].amb_cond.ambient_condition[0][2] "ambient condition shot [0 .. 2-1] with 25 data bytes [0 .. 25-1] for the error code stored in this error memory slot" UBYTE EH_STANDARD_S4_S3 1 100 0 255 ECU_ADDRESS 0xFFF8290A DISPLAY_IDENTIFIER ambient_condition[0][2].amb_cond.ydiBackupMemory_xau16[2].ZFEH_EepromData /end MEASUREMENT
/begin MEASUREMENT ZFEH_EepromData.ydiBackupMemory_xau16[2].amb_cond.ambient_condition[0][3] "ambient condition shot [0 .. 2-1] with 25 data bytes [0 .. 25-1] for the error code stored in this error memory slot" UBYTE EH_STANDARD_S4_S3 1 100 0 255 ECU_ADDRESS 0xFFF8290B DISPLAY_IDENTIFIER ambient_condition[0][3].amb_cond.ydiBackupMemory_xau16[2].ZFEH_EepromData /end MEASUREMENT
/begin MEASUREMENT ZFEH_EepromData.ydiBackupMemory_xau16[2].amb_cond.ambient_condition[0][4] "ambient condition shot [0 .. 2-1] with 25 data bytes [0 .. 25-1] for the error code stored in this error memory slot" UBYTE EH_STANDARD_S4_S3 1 100 0 255 ECU_ADDRESS 0xFFF8290C DISPLAY_IDENTIFIER ambient_condition[0][4].amb_cond.ydiBackupMemory_xau16[2].ZFEH_EepromData /end MEASUREMENT
/begin MEASUREMENT ZFEH_EepromData.ydiBackupMemory_xau16[2].amb_cond.ambient_condition[0][5] "ambient condition shot [0 .. 2-1] with 25 data bytes [0 .. 25-1] for the error code stored in this error memory slot" UBYTE EH_STANDARD_S4_S3 1 100 0 255 ECU_ADDRESS 0xFFF8290D DISPLAY_IDENTIFIER ambient_condition[0][5].amb_cond.ydiBackupMemory_xau16[2].ZFEH_EepromData /end MEASUREMENT
/begin MEASUREMENT ZFEH_EepromData.ydiBackupMemory_xau16[2].amb_cond.ambient_condition[0][6] "ambient condition shot [0 .. 2-1] with 25 data bytes [0 .. 25-1] for the error code stored in this error memory slot" UBYTE EH_STANDARD_S4_S3 1 100 0 255 ECU_ADDRESS 0xFFF8290E DISPLAY_IDENTIFIER ambient_condition[0][6].amb_cond.ydiBackupMemory_xau16[2].ZFEH_EepromData /end MEASUREMENT
/begin MEASUREMENT ZFEH_EepromData.ydiBackupMemory_xau16[2].amb_cond.ambient_condition[0][7] "ambient condition shot [0 .. 2-1] with 25 data bytes [0 .. 25-1] for the error code stored in this error memory slot" UBYTE EH_STANDARD_S4_S3 1 100 0 255 ECU_ADDRESS 0xFFF8290F DISPLAY_IDENTIFIER ambient_condition[0][7].amb_cond.ydiBackupMemory_xau16[2].ZFEH_EepromData /end MEASUREMENT
/begin MEASUREMENT ZFEH_EepromData.ydiBackupMemory_xau16[2].amb_cond.ambient_condition[0][8] "ambient condition shot [0 .. 2-1] with 25 data bytes [0 .. 25-1] for the error code stored in this error memory slot" UBYTE EH_STANDARD_S4_S3 1 100 0 255 ECU_ADDRESS 0xFFF82910 DISPLAY_IDENTIFIER ambient_condition[0][8].amb_cond.ydiBackupMemory_xau16[2].ZFEH_EepromData /end MEASUREMENT
/begin MEASUREMENT ZFEH_EepromData.ydiBackupMemory_xau16[2].amb_cond.ambient_condition[0][9] "ambient condition shot [0 .. 2-1] with 25 data bytes [0 .. 25-1] for the error code stored in this error memory slot" UBYTE EH_STANDARD_S4_S3 1 100 0 255 ECU_ADDRESS 0xFFF82911 DISPLAY_IDENTIFIER ambient_condition[0][9].amb_cond.ydiBackupMemory_xau16[2].ZFEH_EepromData /end MEASUREMENT
/begin MEASUREMENT ZFEH_EepromData.ydiBackupMemory_xau16[2].amb_cond.ambient_condition[1][0] "ambient condition shot [0 .. 2-1] with 25 data bytes [0 .. 25-1] for the error code stored in this error memory slot" UBYTE EH_STANDARD_S4_S3 1 100 0 255 ECU_ADDRESS 0xFFF82921 DISPLAY_IDENTIFIER ambient_condition[1][0].amb_cond.ydiBackupMemory_xau16[2].ZFEH_EepromData /end MEASUREMENT
/begin MEASUREMENT ZFEH_EepromData.ydiBackupMemory_xau16[2].amb_cond.ambient_condition[1][10] "ambient condition shot [0 .. 2-1] with 25 data bytes [0 .. 25-1] for the error code stored in this error memory slot" UBYTE EH_STANDARD_S4_S3 1 100 0 255 ECU_ADDRESS 0xFFF8292B DISPLAY_IDENTIFIER ambient_condition[1][10].amb_cond.ydiBackupMemory_xau16[2].ZFEH_EepromData /end MEASUREMENT
/begin MEASUREMENT ZFEH_EepromData.ydiBackupMemory_xau16[2].amb_cond.ambient_condition[1][11] "ambient condition shot [0 .. 2-1] with 25 data bytes [0 .. 25-1] for the error code stored in this error memory slot" UBYTE EH_STANDARD_S4_S3 1 100 0 255 ECU_ADDRESS 0xFFF8292C DISPLAY_IDENTIFIER ambient_condition[1][11].amb_cond.ydiBackupMemory_xau16[2].ZFEH_EepromData /end MEASUREMENT
/begin MEASUREMENT ZFEH_EepromData.ydiBackupMemory_xau16[2].amb_cond.ambient_condition[1][12] "ambient condition shot [0 .. 2-1] with 25 data bytes [0 .. 25-1] for the error code stored in this error memory slot" UBYTE EH_STANDARD_S4_S3 1 100 0 255 ECU_ADDRESS 0xFFF8292D DISPLAY_IDENTIFIER ambient_condition[1][12].amb_cond.ydiBackupMemory_xau16[2].ZFEH_EepromData /end MEASUREMENT
/begin MEASUREMENT ZFEH_EepromData.ydiBackupMemory_xau16[2].amb_cond.ambient_condition[1][13] "ambient condition shot [0 .. 2-1] with 25 data bytes [0 .. 25-1] for the error code stored in this error memory slot" UBYTE EH_STANDARD_S4_S3 1 100 0 255 ECU_ADDRESS 0xFFF8292E DISPLAY_IDENTIFIER ambient_condition[1][13].amb_cond.ydiBackupMemory_xau16[2].ZFEH_EepromData /end MEASUREMENT
/begin MEASUREMENT ZFEH_EepromData.ydiBackupMemory_xau16[2].amb_cond.ambient_condition[1][14] "ambient condition shot [0 .. 2-1] with 25 data bytes [0 .. 25-1] for the error code stored in this error memory slot" UBYTE EH_STANDARD_S4_S3 1 100 0 255 ECU_ADDRESS 0xFFF8292F DISPLAY_IDENTIFIER ambient_condition[1][14].amb_cond.ydiBackupMemory_xau16[2].ZFEH_EepromData /end MEASUREMENT
/begin MEASUREMENT ZFEH_EepromData.ydiBackupMemory_xau16[2].amb_cond.ambient_condition[1][15] "ambient condition shot [0 .. 2-1] with 25 data bytes [0 .. 25-1] for the error code stored in this error memory slot" UBYTE EH_STANDARD_S4_S3 1 100 0 255 ECU_ADDRESS 0xFFF82930 DISPLAY_IDENTIFIER ambient_condition[1][15].amb_cond.ydiBackupMemory_xau16[2].ZFEH_EepromData /end MEASUREMENT
/begin MEASUREMENT ZFEH_EepromData.ydiBackupMemory_xau16[2].amb_cond.ambient_condition[1][16] "ambient condition shot [0 .. 2-1] with 25 data bytes [0 .. 25-1] for the error code stored in this error memory slot" UBYTE EH_STANDARD_S4_S3 1 100 0 255 ECU_ADDRESS 0xFFF82931 DISPLAY_IDENTIFIER ambient_condition[1][16].amb_cond.ydiBackupMemory_xau16[2].ZFEH_EepromData /end MEASUREMENT
/begin MEASUREMENT ZFEH_EepromData.ydiBackupMemory_xau16[2].amb_cond.ambient_condition[1][17] "ambient condition shot [0 .. 2-1] with 25 data bytes [0 .. 25-1] for the error code stored in this error memory slot" UBYTE EH_STANDARD_S4_S3 1 100 0 255 ECU_ADDRESS 0xFFF82932 DISPLAY_IDENTIFIER ambient_condition[1][17].amb_cond.ydiBackupMemory_xau16[2].ZFEH_EepromData /end MEASUREMENT
/begin MEASUREMENT ZFEH_EepromData.ydiBackupMemory_xau16[2].amb_cond.ambient_condition[1][18] "ambient condition shot [0 .. 2-1] with 25 data bytes [0 .. 25-1] for the error code stored in this error memory slot" UBYTE EH_STANDARD_S4_S3 1 100 0 255 ECU_ADDRESS 0xFFF82933 DISPLAY_IDENTIFIER ambient_condition[1][18].amb_cond.ydiBackupMemory_xau16[2].ZFEH_EepromData /end MEASUREMENT
/begin MEASUREMENT ZFEH_EepromData.ydiBackupMemory_xau16[2].amb_cond.ambient_condition[1][19] "ambient condition shot [0 .. 2-1] with 25 data bytes [0 .. 25-1] for the error code stored in this error memory slot" UBYTE EH_STANDARD_S4_S3 1 100 0 255 ECU_ADDRESS 0xFFF82934 DISPLAY_IDENTIFIER ambient_condition[1][19].amb_cond.ydiBackupMemory_xau16[2].ZFEH_EepromData /end MEASUREMENT
/begin MEASUREMENT ZFEH_EepromData.ydiBackupMemory_xau16[2].amb_cond.ambient_condition[1][1] "ambient condition shot [0 .. 2-1] with 25 data bytes [0 .. 25-1] for the error code stored in this error memory slot" UBYTE EH_STANDARD_S4_S3 1 100 0 255 ECU_ADDRESS 0xFFF82922 DISPLAY_IDENTIFIER ambient_condition[1][1].amb_cond.ydiBackupMemory_xau16[2].ZFEH_EepromData /end MEASUREMENT
/begin MEASUREMENT ZFEH_EepromData.ydiBackupMemory_xau16[2].amb_cond.ambient_condition[1][20] "ambient condition shot [0 .. 2-1] with 25 data bytes [0 .. 25-1] for the error code stored in this error memory slot" UBYTE EH_STANDARD_S4_S3 1 100 0 255 ECU_ADDRESS 0xFFF82935 DISPLAY_IDENTIFIER ambient_condition[1][20].amb_cond.ydiBackupMemory_xau16[2].ZFEH_EepromData /end MEASUREMENT
/begin MEASUREMENT ZFEH_EepromData.ydiBackupMemory_xau16[2].amb_cond.ambient_condition[1][21] "ambient condition shot [0 .. 2-1] with 25 data bytes [0 .. 25-1] for the error code stored in this error memory slot" UBYTE EH_STANDARD_S4_S3 1 100 0 255 ECU_ADDRESS 0xFFF82936 DISPLAY_IDENTIFIER ambient_condition[1][21].amb_cond.ydiBackupMemory_xau16[2].ZFEH_EepromData /end MEASUREMENT
/begin MEASUREMENT ZFEH_EepromData.ydiBackupMemory_xau16[2].amb_cond.ambient_condition[1][22] "ambient condition shot [0 .. 2-1] with 25 data bytes [0 .. 25-1] for the error code stored in this error memory slot" UBYTE EH_STANDARD_S4_S3 1 100 0 255 ECU_ADDRESS 0xFFF82937 DISPLAY_IDENTIFIER ambient_condition[1][22].amb_cond.ydiBackupMemory_xau16[2].ZFEH_EepromData /end MEASUREMENT
/begin MEASUREMENT ZFEH_EepromData.ydiBackupMemory_xau16[2].amb_cond.ambient_condition[1][23] "ambient condition shot [0 .. 2-1] with 25 data bytes [0 .. 25-1] for the error code stored in this error memory slot" UBYTE EH_STANDARD_S4_S3 1 100 0 255 ECU_ADDRESS 0xFFF82938 DISPLAY_IDENTIFIER ambient_condition[1][23].amb_cond.ydiBackupMemory_xau16[2].ZFEH_EepromData /end MEASUREMENT
/begin MEASUREMENT ZFEH_EepromData.ydiBackupMemory_xau16[2].amb_cond.ambient_condition[1][24] "ambient condition shot [0 .. 2-1] with 25 data bytes [0 .. 25-1] for the error code stored in this error memory slot" UBYTE EH_STANDARD_S4_S3 1 100 0 255 ECU_ADDRESS 0xFFF82939 DISPLAY_IDENTIFIER ambient_condition[1][24].amb_cond.ydiBackupMemory_xau16[2].ZFEH_EepromData /end MEASUREMENT
/begin MEASUREMENT ZFEH_EepromData.ydiBackupMemory_xau16[2].amb_cond.ambient_condition[1][2] "ambient condition shot [0 .. 2-1] with 25 data bytes [0 .. 25-1] for the error code stored in this error memory slot" UBYTE EH_STANDARD_S4_S3 1 100 0 255 ECU_ADDRESS 0xFFF82923 DISPLAY_IDENTIFIER ambient_condition[1][2].amb_cond.ydiBackupMemory_xau16[2].ZFEH_EepromData /end MEASUREMENT
/begin MEASUREMENT ZFEH_EepromData.ydiBackupMemory_xau16[2].amb_cond.ambient_condition[1][3] "ambient condition shot [0 .. 2-1] with 25 data bytes [0 .. 25-1] for the error code stored in this error memory slot" UBYTE EH_STANDARD_S4_S3 1 100 0 255 ECU_ADDRESS 0xFFF82924 DISPLAY_IDENTIFIER ambient_condition[1][3].amb_cond.ydiBackupMemory_xau16[2].ZFEH_EepromData /end MEASUREMENT
/begin MEASUREMENT ZFEH_EepromData.ydiBackupMemory_xau16[2].amb_cond.ambient_condition[1][4] "ambient condition shot [0 .. 2-1] with 25 data bytes [0 .. 25-1] for the error code stored in this error memory slot" UBYTE EH_STANDARD_S4_S3 1 100 0 255 ECU_ADDRESS 0xFFF82925 DISPLAY_IDENTIFIER ambient_condition[1][4].amb_cond.ydiBackupMemory_xau16[2].ZFEH_EepromData /end MEASUREMENT
/begin MEASUREMENT ZFEH_EepromData.ydiBackupMemory_xau16[2].amb_cond.ambient_condition[1][5] "ambient condition shot [0 .. 2-1] with 25 data bytes [0 .. 25-1] for the error code stored in this error memory slot" UBYTE EH_STANDARD_S4_S3 1 100 0 255 ECU_ADDRESS 0xFFF82926 DISPLAY_IDENTIFIER ambient_condition[1][5].amb_cond.ydiBackupMemory_xau16[2].ZFEH_EepromData /end MEASUREMENT
/begin MEASUREMENT ZFEH_EepromData.ydiBackupMemory_xau16[2].amb_cond.ambient_condition[1][6] "ambient condition shot [0 .. 2-1] with 25 data bytes [0 .. 25-1] for the error code stored in this error memory slot" UBYTE EH_STANDARD_S4_S3 1 100 0 255 ECU_ADDRESS 0xFFF82927 DISPLAY_IDENTIFIER ambient_condition[1][6].amb_cond.ydiBackupMemory_xau16[2].ZFEH_EepromData /end MEASUREMENT
/begin MEASUREMENT ZFEH_EepromData.ydiBackupMemory_xau16[2].amb_cond.ambient_condition[1][7] "ambient condition shot [0 .. 2-1] with 25 data bytes [0 .. 25-1] for the error code stored in this error memory slot" UBYTE EH_STANDARD_S4_S3 1 100 0 255 ECU_ADDRESS 0xFFF82928 DISPLAY_IDENTIFIER ambient_condition[1][7].amb_cond.ydiBackupMemory_xau16[2].ZFEH_EepromData /end MEASUREMENT
/begin MEASUREMENT ZFEH_EepromData.ydiBackupMemory_xau16[2].amb_cond.ambient_condition[1][8] "ambient condition shot [0 .. 2-1] with 25 data bytes [0 .. 25-1] for the error code stored in this error memory slot" UBYTE EH_STANDARD_S4_S3 1 100 0 255 ECU_ADDRESS 0xFFF82929 DISPLAY_IDENTIFIER ambient_condition[1][8].amb_cond.ydiBackupMemory_xau16[2].ZFEH_EepromData /end MEASUREMENT
/begin MEASUREMENT ZFEH_EepromData.ydiBackupMemory_xau16[2].amb_cond.ambient_condition[1][9] "ambient condition shot [0 .. 2-1] with 25 data bytes [0 .. 25-1] for the error code stored in this error memory slot" UBYTE EH_STANDARD_S4_S3 1 100 0 255 ECU_ADDRESS 0xFFF8292A DISPLAY_IDENTIFIER ambient_condition[1][9].amb_cond.ydiBackupMemory_xau16[2].ZFEH_EepromData /end MEASUREMENT
/begin MEASUREMENT ZFEH_EepromData.ydiBackupMemory_xau16[2].amb_cond.status_of_ambient_conditions[0] "status of ambient condition shot x: 0=invalid 1=valid" UBYTE EH_STANDARD_S4_S3 1 100 0 1 ECU_ADDRESS 0xFFF8293A DISPLAY_IDENTIFIER status_of_ambient_conditions[0].amb_cond.ydiBackupMemory_xau16[2].ZFEH_EepromData /end MEASUREMENT
/begin MEASUREMENT ZFEH_EepromData.ydiBackupMemory_xau16[2].amb_cond.status_of_ambient_conditions[1] "status of ambient condition shot x: 0=invalid 1=valid" UBYTE EH_STANDARD_S4_S3 1 100 0 1 ECU_ADDRESS 0xFFF8293B DISPLAY_IDENTIFIER status_of_ambient_conditions[1].amb_cond.ydiBackupMemory_xau16[2].ZFEH_EepromData /end MEASUREMENT
/begin MEASUREMENT ZFEH_EepromData.ydiBackupMemory_xau16[2].backwards_counter "backwards counter of error code stored in error memory slot" UBYTE EH_STANDARD_S4_S3 1 100 0 255 ECU_ADDRESS 0xFFF828FB DISPLAY_IDENTIFIER backwards_counter.ydiBackupMemory_xau16[2].ZFEH_EepromData /end MEASUREMENT
/begin MEASUREMENT ZFEH_EepromData.ydiBackupMemory_xau16[2].condition_byte "condition byte of error code stored in error memory slot" UBYTE EH_STANDARD_S4_S3 1 100 0 255 ECU_ADDRESS 0xFFF82905 DISPLAY_IDENTIFIER condition_byte.ydiBackupMemory_xau16[2].ZFEH_EepromData /end MEASUREMENT
/begin MEASUREMENT ZFEH_EepromData.ydiBackupMemory_xau16[2].error_code "error code stored in error memory slot" UWORD EH_STANDARD_S4_S3 1 100 0 65535 ECU_ADDRESS 0xFFF828F4 DISPLAY_IDENTIFIER error_code.ydiBackupMemory_xau16[2].ZFEH_EepromData /end MEASUREMENT
/begin MEASUREMENT ZFEH_EepromData.ydiBackupMemory_xau16[2].error_type "error type of error code stored in error memory slot" UWORD EH_STANDARD_S4_S3 1 100 0 65535 ECU_ADDRESS 0xFFF828F6 DISPLAY_IDENTIFIER error_type.ydiBackupMemory_xau16[2].ZFEH_EepromData /end MEASUREMENT
/begin MEASUREMENT ZFEH_EepromData.ydiBackupMemory_xau16[2].frequency_counter "frequency counter of error code stored in error memory slot" UBYTE EH_STANDARD_S4_S3 1 100 0 255 ECU_ADDRESS 0xFFF828FA DISPLAY_IDENTIFIER frequency_counter.ydiBackupMemory_xau16[2].ZFEH_EepromData /end MEASUREMENT
/begin MEASUREMENT ZFEH_EepromData.ydiBackupMemory_xau16[2].master_time "master time of error code stored in error memory slot" ULONG EH_STANDARD_S4_S3 1 100 0 4294967295 ECU_ADDRESS 0xFFF82900 DISPLAY_IDENTIFIER master_time.ydiBackupMemory_xau16[2].ZFEH_EepromData /end MEASUREMENT
/begin MEASUREMENT ZFEH_EepromData.ydiBackupMemory_xau16[2].obd_driving_cycle_counter "obd driving cycle counter of error code stored in error memory slot" UWORD EH_STANDARD_S4_S3 1 100 0 65535 ECU_ADDRESS 0xFFF82906 DISPLAY_IDENTIFIER obd_driving_cycle_counter.ydiBackupMemory_xau16[2].ZFEH_EepromData /end MEASUREMENT
/begin MEASUREMENT ZFEH_EepromData.ydiBackupMemory_xau16[2].permanent_counter "counter of permanent error codes stored in error memory slot" UBYTE EH_STANDARD_S4_S3 1 100 0 255 ECU_ADDRESS 0xFFF828FC DISPLAY_IDENTIFIER permanent_counter.ydiBackupMemory_xau16[2].ZFEH_EepromData /end MEASUREMENT
/begin MEASUREMENT ZFEH_EepromData.ydiBackupMemory_xau16[2].sequence_counter "sequence counter of error code stored in error memory slot" UBYTE EH_STANDARD_S4_S3 1 100 0 255 ECU_ADDRESS 0xFFF828FD DISPLAY_IDENTIFIER sequence_counter.ydiBackupMemory_xau16[2].ZFEH_EepromData /end MEASUREMENT
/begin MEASUREMENT ZFEH_EepromData.ydiBackupMemory_xau16[2].status_word "status word of error code stored in error memory slot" UWORD EH_STANDARD_S4_S3 1 100 0 65535 ECU_ADDRESS 0xFFF828F8 DISPLAY_IDENTIFIER status_word.ydiBackupMemory_xau16[2].ZFEH_EepromData /end MEASUREMENT
/begin MEASUREMENT ZFEH_EepromData.ydiBackupMemory_xau16[3].amb_cond.ambient_condition[0][0] "ambient condition shot [0 .. 2-1] with 25 data bytes [0 .. 25-1] for the error code stored in this error memory slot" UBYTE EH_STANDARD_S4_S3 1 100 0 255 ECU_ADDRESS 0xFFF82950 DISPLAY_IDENTIFIER ambient_condition[0][0].amb_cond.ydiBackupMemory_xau16[3].ZFEH_EepromData /end MEASUREMENT
/begin MEASUREMENT ZFEH_EepromData.ydiBackupMemory_xau16[3].amb_cond.ambient_condition[0][10] "ambient condition shot [0 .. 2-1] with 25 data bytes [0 .. 25-1] for the error code stored in this error memory slot" UBYTE EH_STANDARD_S4_S3 1 100 0 255 ECU_ADDRESS 0xFFF8295A DISPLAY_IDENTIFIER ambient_condition[0][10].amb_cond.ydiBackupMemory_xau16[3].ZFEH_EepromData /end MEASUREMENT
/begin MEASUREMENT ZFEH_EepromData.ydiBackupMemory_xau16[3].amb_cond.ambient_condition[0][11] "ambient condition shot [0 .. 2-1] with 25 data bytes [0 .. 25-1] for the error code stored in this error memory slot" UBYTE EH_STANDARD_S4_S3 1 100 0 255 ECU_ADDRESS 0xFFF8295B DISPLAY_IDENTIFIER ambient_condition[0][11].amb_cond.ydiBackupMemory_xau16[3].ZFEH_EepromData /end MEASUREMENT
/begin MEASUREMENT ZFEH_EepromData.ydiBackupMemory_xau16[3].amb_cond.ambient_condition[0][12] "ambient condition shot [0 .. 2-1] with 25 data bytes [0 .. 25-1] for the error code stored in this error memory slot" UBYTE EH_STANDARD_S4_S3 1 100 0 255 ECU_ADDRESS 0xFFF8295C DISPLAY_IDENTIFIER ambient_condition[0][12].amb_cond.ydiBackupMemory_xau16[3].ZFEH_EepromData /end MEASUREMENT
/begin MEASUREMENT ZFEH_EepromData.ydiBackupMemory_xau16[3].amb_cond.ambient_condition[0][13] "ambient condition shot [0 .. 2-1] with 25 data bytes [0 .. 25-1] for the error code stored in this error memory slot" UBYTE EH_STANDARD_S4_S3 1 100 0 255 ECU_ADDRESS 0xFFF8295D DISPLAY_IDENTIFIER ambient_condition[0][13].amb_cond.ydiBackupMemory_xau16[3].ZFEH_EepromData /end MEASUREMENT
/begin MEASUREMENT ZFEH_EepromData.ydiBackupMemory_xau16[3].amb_cond.ambient_condition[0][14] "ambient condition shot [0 .. 2-1] with 25 data bytes [0 .. 25-1] for the error code stored in this error memory slot" UBYTE EH_STANDARD_S4_S3 1 100 0 255 ECU_ADDRESS 0xFFF8295E DISPLAY_IDENTIFIER ambient_condition[0][14].amb_cond.ydiBackupMemory_xau16[3].ZFEH_EepromData /end MEASUREMENT
/begin MEASUREMENT ZFEH_EepromData.ydiBackupMemory_xau16[3].amb_cond.ambient_condition[0][15] "ambient condition shot [0 .. 2-1] with 25 data bytes [0 .. 25-1] for the error code stored in this error memory slot" UBYTE EH_STANDARD_S4_S3 1 100 0 255 ECU_ADDRESS 0xFFF8295F DISPLAY_IDENTIFIER ambient_condition[0][15].amb_cond.ydiBackupMemory_xau16[3].ZFEH_EepromData /end MEASUREMENT
/begin MEASUREMENT ZFEH_EepromData.ydiBackupMemory_xau16[3].amb_cond.ambient_condition[0][16] "ambient condition shot [0 .. 2-1] with 25 data bytes [0 .. 25-1] for the error code stored in this error memory slot" UBYTE EH_STANDARD_S4_S3 1 100 0 255 ECU_ADDRESS 0xFFF82960 DISPLAY_IDENTIFIER ambient_condition[0][16].amb_cond.ydiBackupMemory_xau16[3].ZFEH_EepromData /end MEASUREMENT
/begin MEASUREMENT ZFEH_EepromData.ydiBackupMemory_xau16[3].amb_cond.ambient_condition[0][17] "ambient condition shot [0 .. 2-1] with 25 data bytes [0 .. 25-1] for the error code stored in this error memory slot" UBYTE EH_STANDARD_S4_S3 1 100 0 255 ECU_ADDRESS 0xFFF82961 DISPLAY_IDENTIFIER ambient_condition[0][17].amb_cond.ydiBackupMemory_xau16[3].ZFEH_EepromData /end MEASUREMENT
/begin MEASUREMENT ZFEH_EepromData.ydiBackupMemory_xau16[3].amb_cond.ambient_condition[0][18] "ambient condition shot [0 .. 2-1] with 25 data bytes [0 .. 25-1] for the error code stored in this error memory slot" UBYTE EH_STANDARD_S4_S3 1 100 0 255 ECU_ADDRESS 0xFFF82962 DISPLAY_IDENTIFIER ambient_condition[0][18].amb_cond.ydiBackupMemory_xau16[3].ZFEH_EepromData /end MEASUREMENT
/begin MEASUREMENT ZFEH_EepromData.ydiBackupMemory_xau16[3].amb_cond.ambient_condition[0][19] "ambient condition shot [0 .. 2-1] with 25 data bytes [0 .. 25-1] for the error code stored in this error memory slot" UBYTE EH_STANDARD_S4_S3 1 100 0 255 ECU_ADDRESS 0xFFF82963 DISPLAY_IDENTIFIER ambient_condition[0][19].amb_cond.ydiBackupMemory_xau16[3].ZFEH_EepromData /end MEASUREMENT
/begin MEASUREMENT ZFEH_EepromData.ydiBackupMemory_xau16[3].amb_cond.ambient_condition[0][1] "ambient condition shot [0 .. 2-1] with 25 data bytes [0 .. 25-1] for the error code stored in this error memory slot" UBYTE EH_STANDARD_S4_S3 1 100 0 255 ECU_ADDRESS 0xFFF82951 DISPLAY_IDENTIFIER ambient_condition[0][1].amb_cond.ydiBackupMemory_xau16[3].ZFEH_EepromData /end MEASUREMENT
/begin MEASUREMENT ZFEH_EepromData.ydiBackupMemory_xau16[3].amb_cond.ambient_condition[0][20] "ambient condition shot [0 .. 2-1] with 25 data bytes [0 .. 25-1] for the error code stored in this error memory slot" UBYTE EH_STANDARD_S4_S3 1 100 0 255 ECU_ADDRESS 0xFFF82964 DISPLAY_IDENTIFIER ambient_condition[0][20].amb_cond.ydiBackupMemory_xau16[3].ZFEH_EepromData /end MEASUREMENT
/begin MEASUREMENT ZFEH_EepromData.ydiBackupMemory_xau16[3].amb_cond.ambient_condition[0][21] "ambient condition shot [0 .. 2-1] with 25 data bytes [0 .. 25-1] for the error code stored in this error memory slot" UBYTE EH_STANDARD_S4_S3 1 100 0 255 ECU_ADDRESS 0xFFF82965 DISPLAY_IDENTIFIER ambient_condition[0][21].amb_cond.ydiBackupMemory_xau16[3].ZFEH_EepromData /end MEASUREMENT
/begin MEASUREMENT ZFEH_EepromData.ydiBackupMemory_xau16[3].amb_cond.ambient_condition[0][22] "ambient condition shot [0 .. 2-1] with 25 data bytes [0 .. 25-1] for the error code stored in this error memory slot" UBYTE EH_STANDARD_S4_S3 1 100 0 255 ECU_ADDRESS 0xFFF82966 DISPLAY_IDENTIFIER ambient_condition[0][22].amb_cond.ydiBackupMemory_xau16[3].ZFEH_EepromData /end MEASUREMENT
/begin MEASUREMENT ZFEH_EepromData.ydiBackupMemory_xau16[3].amb_cond.ambient_condition[0][23] "ambient condition shot [0 .. 2-1] with 25 data bytes [0 .. 25-1] for the error code stored in this error memory slot" UBYTE EH_STANDARD_S4_S3 1 100 0 255 ECU_ADDRESS 0xFFF82967 DISPLAY_IDENTIFIER ambient_condition[0][23].amb_cond.ydiBackupMemory_xau16[3].ZFEH_EepromData /end MEASUREMENT
/begin MEASUREMENT ZFEH_EepromData.ydiBackupMemory_xau16[3].amb_cond.ambient_condition[0][24] "ambient condition shot [0 .. 2-1] with 25 data bytes [0 .. 25-1] for the error code stored in this error memory slot" UBYTE EH_STANDARD_S4_S3 1 100 0 255 ECU_ADDRESS 0xFFF82968 DISPLAY_IDENTIFIER ambient_condition[0][24].amb_cond.ydiBackupMemory_xau16[3].ZFEH_EepromData /end MEASUREMENT
/begin MEASUREMENT ZFEH_EepromData.ydiBackupMemory_xau16[3].amb_cond.ambient_condition[0][2] "ambient condition shot [0 .. 2-1] with 25 data bytes [0 .. 25-1] for the error code stored in this error memory slot" UBYTE EH_STANDARD_S4_S3 1 100 0 255 ECU_ADDRESS 0xFFF82952 DISPLAY_IDENTIFIER ambient_condition[0][2].amb_cond.ydiBackupMemory_xau16[3].ZFEH_EepromData /end MEASUREMENT
/begin MEASUREMENT ZFEH_EepromData.ydiBackupMemory_xau16[3].amb_cond.ambient_condition[0][3] "ambient condition shot [0 .. 2-1] with 25 data bytes [0 .. 25-1] for the error code stored in this error memory slot" UBYTE EH_STANDARD_S4_S3 1 100 0 255 ECU_ADDRESS 0xFFF82953 DISPLAY_IDENTIFIER ambient_condition[0][3].amb_cond.ydiBackupMemory_xau16[3].ZFEH_EepromData /end MEASUREMENT
/begin MEASUREMENT ZFEH_EepromData.ydiBackupMemory_xau16[3].amb_cond.ambient_condition[0][4] "ambient condition shot [0 .. 2-1] with 25 data bytes [0 .. 25-1] for the error code stored in this error memory slot" UBYTE EH_STANDARD_S4_S3 1 100 0 255 ECU_ADDRESS 0xFFF82954 DISPLAY_IDENTIFIER ambient_condition[0][4].amb_cond.ydiBackupMemory_xau16[3].ZFEH_EepromData /end MEASUREMENT
/begin MEASUREMENT ZFEH_EepromData.ydiBackupMemory_xau16[3].amb_cond.ambient_condition[0][5] "ambient condition shot [0 .. 2-1] with 25 data bytes [0 .. 25-1] for the error code stored in this error memory slot" UBYTE EH_STANDARD_S4_S3 1 100 0 255 ECU_ADDRESS 0xFFF82955 DISPLAY_IDENTIFIER ambient_condition[0][5].amb_cond.ydiBackupMemory_xau16[3].ZFEH_EepromData /end MEASUREMENT
/begin MEASUREMENT ZFEH_EepromData.ydiBackupMemory_xau16[3].amb_cond.ambient_condition[0][6] "ambient condition shot [0 .. 2-1] with 25 data bytes [0 .. 25-1] for the error code stored in this error memory slot" UBYTE EH_STANDARD_S4_S3 1 100 0 255 ECU_ADDRESS 0xFFF82956 DISPLAY_IDENTIFIER ambient_condition[0][6].amb_cond.ydiBackupMemory_xau16[3].ZFEH_EepromData /end MEASUREMENT
/begin MEASUREMENT ZFEH_EepromData.ydiBackupMemory_xau16[3].amb_cond.ambient_condition[0][7] "ambient condition shot [0 .. 2-1] with 25 data bytes [0 .. 25-1] for the error code stored in this error memory slot" UBYTE EH_STANDARD_S4_S3 1 100 0 255 ECU_ADDRESS 0xFFF82957 DISPLAY_IDENTIFIER ambient_condition[0][7].amb_cond.ydiBackupMemory_xau16[3].ZFEH_EepromData /end MEASUREMENT
/begin MEASUREMENT ZFEH_EepromData.ydiBackupMemory_xau16[3].amb_cond.ambient_condition[0][8] "ambient condition shot [0 .. 2-1] with 25 data bytes [0 .. 25-1] for the error code stored in this error memory slot" UBYTE EH_STANDARD_S4_S3 1 100 0 255 ECU_ADDRESS 0xFFF82958 DISPLAY_IDENTIFIER ambient_condition[0][8].amb_cond.ydiBackupMemory_xau16[3].ZFEH_EepromData /end MEASUREMENT
/begin MEASUREMENT ZFEH_EepromData.ydiBackupMemory_xau16[3].amb_cond.ambient_condition[0][9] "ambient condition shot [0 .. 2-1] with 25 data bytes [0 .. 25-1] for the error code stored in this error memory slot" UBYTE EH_STANDARD_S4_S3 1 100 0 255 ECU_ADDRESS 0xFFF82959 DISPLAY_IDENTIFIER ambient_condition[0][9].amb_cond.ydiBackupMemory_xau16[3].ZFEH_EepromData /end MEASUREMENT
/begin MEASUREMENT ZFEH_EepromData.ydiBackupMemory_xau16[3].amb_cond.ambient_condition[1][0] "ambient condition shot [0 .. 2-1] with 25 data bytes [0 .. 25-1] for the error code stored in this error memory slot" UBYTE EH_STANDARD_S4_S3 1 100 0 255 ECU_ADDRESS 0xFFF82969 DISPLAY_IDENTIFIER ambient_condition[1][0].amb_cond.ydiBackupMemory_xau16[3].ZFEH_EepromData /end MEASUREMENT
/begin MEASUREMENT ZFEH_EepromData.ydiBackupMemory_xau16[3].amb_cond.ambient_condition[1][10] "ambient condition shot [0 .. 2-1] with 25 data bytes [0 .. 25-1] for the error code stored in this error memory slot" UBYTE EH_STANDARD_S4_S3 1 100 0 255 ECU_ADDRESS 0xFFF82973 DISPLAY_IDENTIFIER ambient_condition[1][10].amb_cond.ydiBackupMemory_xau16[3].ZFEH_EepromData /end MEASUREMENT
/begin MEASUREMENT ZFEH_EepromData.ydiBackupMemory_xau16[3].amb_cond.ambient_condition[1][11] "ambient condition shot [0 .. 2-1] with 25 data bytes [0 .. 25-1] for the error code stored in this error memory slot" UBYTE EH_STANDARD_S4_S3 1 100 0 255 ECU_ADDRESS 0xFFF82974 DISPLAY_IDENTIFIER ambient_condition[1][11].amb_cond.ydiBackupMemory_xau16[3].ZFEH_EepromData /end MEASUREMENT
/begin MEASUREMENT ZFEH_EepromData.ydiBackupMemory_xau16[3].amb_cond.ambient_condition[1][12] "ambient condition shot [0 .. 2-1] with 25 data bytes [0 .. 25-1] for the error code stored in this error memory slot" UBYTE EH_STANDARD_S4_S3 1 100 0 255 ECU_ADDRESS 0xFFF82975 DISPLAY_IDENTIFIER ambient_condition[1][12].amb_cond.ydiBackupMemory_xau16[3].ZFEH_EepromData /end MEASUREMENT
/begin MEASUREMENT ZFEH_EepromData.ydiBackupMemory_xau16[3].amb_cond.ambient_condition[1][13] "ambient condition shot [0 .. 2-1] with 25 data bytes [0 .. 25-1] for the error code stored in this error memory slot" UBYTE EH_STANDARD_S4_S3 1 100 0 255 ECU_ADDRESS 0xFFF82976 DISPLAY_IDENTIFIER ambient_condition[1][13].amb_cond.ydiBackupMemory_xau16[3].ZFEH_EepromData /end MEASUREMENT
/begin MEASUREMENT ZFEH_EepromData.ydiBackupMemory_xau16[3].amb_cond.ambient_condition[1][14] "ambient condition shot [0 .. 2-1] with 25 data bytes [0 .. 25-1] for the error code stored in this error memory slot" UBYTE EH_STANDARD_S4_S3 1 100 0 255 ECU_ADDRESS 0xFFF82977 DISPLAY_IDENTIFIER ambient_condition[1][14].amb_cond.ydiBackupMemory_xau16[3].ZFEH_EepromData /end MEASUREMENT
/begin MEASUREMENT ZFEH_EepromData.ydiBackupMemory_xau16[3].amb_cond.ambient_condition[1][15] "ambient condition shot [0 .. 2-1] with 25 data bytes [0 .. 25-1] for the error code stored in this error memory slot" UBYTE EH_STANDARD_S4_S3 1 100 0 255 ECU_ADDRESS 0xFFF82978 DISPLAY_IDENTIFIER ambient_condition[1][15].amb_cond.ydiBackupMemory_xau16[3].ZFEH_EepromData /end MEASUREMENT
/begin MEASUREMENT ZFEH_EepromData.ydiBackupMemory_xau16[3].amb_cond.ambient_condition[1][16] "ambient condition shot [0 .. 2-1] with 25 data bytes [0 .. 25-1] for the error code stored in this error memory slot" UBYTE EH_STANDARD_S4_S3 1 100 0 255 ECU_ADDRESS 0xFFF82979 DISPLAY_IDENTIFIER ambient_condition[1][16].amb_cond.ydiBackupMemory_xau16[3].ZFEH_EepromData /end MEASUREMENT
/begin MEASUREMENT ZFEH_EepromData.ydiBackupMemory_xau16[3].amb_cond.ambient_condition[1][17] "ambient condition shot [0 .. 2-1] with 25 data bytes [0 .. 25-1] for the error code stored in this error memory slot" UBYTE EH_STANDARD_S4_S3 1 100 0 255 ECU_ADDRESS 0xFFF8297A DISPLAY_IDENTIFIER ambient_condition[1][17].amb_cond.ydiBackupMemory_xau16[3].ZFEH_EepromData /end MEASUREMENT
/begin MEASUREMENT ZFEH_EepromData.ydiBackupMemory_xau16[3].amb_cond.ambient_condition[1][18] "ambient condition shot [0 .. 2-1] with 25 data bytes [0 .. 25-1] for the error code stored in this error memory slot" UBYTE EH_STANDARD_S4_S3 1 100 0 255 ECU_ADDRESS 0xFFF8297B DISPLAY_IDENTIFIER ambient_condition[1][18].amb_cond.ydiBackupMemory_xau16[3].ZFEH_EepromData /end MEASUREMENT
/begin MEASUREMENT ZFEH_EepromData.ydiBackupMemory_xau16[3].amb_cond.ambient_condition[1][19] "ambient condition shot [0 .. 2-1] with 25 data bytes [0 .. 25-1] for the error code stored in this error memory slot" UBYTE EH_STANDARD_S4_S3 1 100 0 255 ECU_ADDRESS 0xFFF8297C DISPLAY_IDENTIFIER ambient_condition[1][19].amb_cond.ydiBackupMemory_xau16[3].ZFEH_EepromData /end MEASUREMENT
/begin MEASUREMENT ZFEH_EepromData.ydiBackupMemory_xau16[3].amb_cond.ambient_condition[1][1] "ambient condition shot [0 .. 2-1] with 25 data bytes [0 .. 25-1] for the error code stored in this error memory slot" UBYTE EH_STANDARD_S4_S3 1 100 0 255 ECU_ADDRESS 0xFFF8296A DISPLAY_IDENTIFIER ambient_condition[1][1].amb_cond.ydiBackupMemory_xau16[3].ZFEH_EepromData /end MEASUREMENT
/begin MEASUREMENT ZFEH_EepromData.ydiBackupMemory_xau16[3].amb_cond.ambient_condition[1][20] "ambient condition shot [0 .. 2-1] with 25 data bytes [0 .. 25-1] for the error code stored in this error memory slot" UBYTE EH_STANDARD_S4_S3 1 100 0 255 ECU_ADDRESS 0xFFF8297D DISPLAY_IDENTIFIER ambient_condition[1][20].amb_cond.ydiBackupMemory_xau16[3].ZFEH_EepromData /end MEASUREMENT
/begin MEASUREMENT ZFEH_EepromData.ydiBackupMemory_xau16[3].amb_cond.ambient_condition[1][21] "ambient condition shot [0 .. 2-1] with 25 data bytes [0 .. 25-1] for the error code stored in this error memory slot" UBYTE EH_STANDARD_S4_S3 1 100 0 255 ECU_ADDRESS 0xFFF8297E DISPLAY_IDENTIFIER ambient_condition[1][21].amb_cond.ydiBackupMemory_xau16[3].ZFEH_EepromData /end MEASUREMENT
/begin MEASUREMENT ZFEH_EepromData.ydiBackupMemory_xau16[3].amb_cond.ambient_condition[1][22] "ambient condition shot [0 .. 2-1] with 25 data bytes [0 .. 25-1] for the error code stored in this error memory slot" UBYTE EH_STANDARD_S4_S3 1 100 0 255 ECU_ADDRESS 0xFFF8297F DISPLAY_IDENTIFIER ambient_condition[1][22].amb_cond.ydiBackupMemory_xau16[3].ZFEH_EepromData /end MEASUREMENT
/begin MEASUREMENT ZFEH_EepromData.ydiBackupMemory_xau16[3].amb_cond.ambient_condition[1][23] "ambient condition shot [0 .. 2-1] with 25 data bytes [0 .. 25-1] for the error code stored in this error memory slot" UBYTE EH_STANDARD_S4_S3 1 100 0 255 ECU_ADDRESS 0xFFF82980 DISPLAY_IDENTIFIER ambient_condition[1][23].amb_cond.ydiBackupMemory_xau16[3].ZFEH_EepromData /end MEASUREMENT
/begin MEASUREMENT ZFEH_EepromData.ydiBackupMemory_xau16[3].amb_cond.ambient_condition[1][24] "ambient condition shot [0 .. 2-1] with 25 data bytes [0 .. 25-1] for the error code stored in this error memory slot" UBYTE EH_STANDARD_S4_S3 1 100 0 255 ECU_ADDRESS 0xFFF82981 DISPLAY_IDENTIFIER ambient_condition[1][24].amb_cond.ydiBackupMemory_xau16[3].ZFEH_EepromData /end MEASUREMENT
/begin MEASUREMENT ZFEH_EepromData.ydiBackupMemory_xau16[3].amb_cond.ambient_condition[1][2] "ambient condition shot [0 .. 2-1] with 25 data bytes [0 .. 25-1] for the error code stored in this error memory slot" UBYTE EH_STANDARD_S4_S3 1 100 0 255 ECU_ADDRESS 0xFFF8296B DISPLAY_IDENTIFIER ambient_condition[1][2].amb_cond.ydiBackupMemory_xau16[3].ZFEH_EepromData /end MEASUREMENT
/begin MEASUREMENT ZFEH_EepromData.ydiBackupMemory_xau16[3].amb_cond.ambient_condition[1][3] "ambient condition shot [0 .. 2-1] with 25 data bytes [0 .. 25-1] for the error code stored in this error memory slot" UBYTE EH_STANDARD_S4_S3 1 100 0 255 ECU_ADDRESS 0xFFF8296C DISPLAY_IDENTIFIER ambient_condition[1][3].amb_cond.ydiBackupMemory_xau16[3].ZFEH_EepromData /end MEASUREMENT
/begin MEASUREMENT ZFEH_EepromData.ydiBackupMemory_xau16[3].amb_cond.ambient_condition[1][4] "ambient condition shot [0 .. 2-1] with 25 data bytes [0 .. 25-1] for the error code stored in this error memory slot" UBYTE EH_STANDARD_S4_S3 1 100 0 255 ECU_ADDRESS 0xFFF8296D DISPLAY_IDENTIFIER ambient_condition[1][4].amb_cond.ydiBackupMemory_xau16[3].ZFEH_EepromData /end MEASUREMENT
/begin MEASUREMENT ZFEH_EepromData.ydiBackupMemory_xau16[3].amb_cond.ambient_condition[1][5] "ambient condition shot [0 .. 2-1] with 25 data bytes [0 .. 25-1] for the error code stored in this error memory slot" UBYTE EH_STANDARD_S4_S3 1 100 0 255 ECU_ADDRESS 0xFFF8296E DISPLAY_IDENTIFIER ambient_condition[1][5].amb_cond.ydiBackupMemory_xau16[3].ZFEH_EepromData /end MEASUREMENT
/begin MEASUREMENT ZFEH_EepromData.ydiBackupMemory_xau16[3].amb_cond.ambient_condition[1][6] "ambient condition shot [0 .. 2-1] with 25 data bytes [0 .. 25-1] for the error code stored in this error memory slot" UBYTE EH_STANDARD_S4_S3 1 100 0 255 ECU_ADDRESS 0xFFF8296F DISPLAY_IDENTIFIER ambient_condition[1][6].amb_cond.ydiBackupMemory_xau16[3].ZFEH_EepromData /end MEASUREMENT
/begin MEASUREMENT ZFEH_EepromData.ydiBackupMemory_xau16[3].amb_cond.ambient_condition[1][7] "ambient condition shot [0 .. 2-1] with 25 data bytes [0 .. 25-1] for the error code stored in this error memory slot" UBYTE EH_STANDARD_S4_S3 1 100 0 255 ECU_ADDRESS 0xFFF82970 DISPLAY_IDENTIFIER ambient_condition[1][7].amb_cond.ydiBackupMemory_xau16[3].ZFEH_EepromData /end MEASUREMENT
/begin MEASUREMENT ZFEH_EepromData.ydiBackupMemory_xau16[3].amb_cond.ambient_condition[1][8] "ambient condition shot [0 .. 2-1] with 25 data bytes [0 .. 25-1] for the error code stored in this error memory slot" UBYTE EH_STANDARD_S4_S3 1 100 0 255 ECU_ADDRESS 0xFFF82971 DISPLAY_IDENTIFIER ambient_condition[1][8].amb_cond.ydiBackupMemory_xau16[3].ZFEH_EepromData /end MEASUREMENT
/begin MEASUREMENT ZFEH_EepromData.ydiBackupMemory_xau16[3].amb_cond.ambient_condition[1][9] "ambient condition shot [0 .. 2-1] with 25 data bytes [0 .. 25-1] for the error code stored in this error memory slot" UBYTE EH_STANDARD_S4_S3 1 100 0 255 ECU_ADDRESS 0xFFF82972 DISPLAY_IDENTIFIER ambient_condition[1][9].amb_cond.ydiBackupMemory_xau16[3].ZFEH_EepromData /end MEASUREMENT
/begin MEASUREMENT ZFEH_EepromData.ydiBackupMemory_xau16[3].amb_cond.status_of_ambient_conditions[0] "status of ambient condition shot x: 0=invalid 1=valid" UBYTE EH_STANDARD_S4_S3 1 100 0 1 ECU_ADDRESS 0xFFF82982 DISPLAY_IDENTIFIER status_of_ambient_conditions[0].amb_cond.ydiBackupMemory_xau16[3].ZFEH_EepromData /end MEASUREMENT
/begin MEASUREMENT ZFEH_EepromData.ydiBackupMemory_xau16[3].amb_cond.status_of_ambient_conditions[1] "status of ambient condition shot x: 0=invalid 1=valid" UBYTE EH_STANDARD_S4_S3 1 100 0 1 ECU_ADDRESS 0xFFF82983 DISPLAY_IDENTIFIER status_of_ambient_conditions[1].amb_cond.ydiBackupMemory_xau16[3].ZFEH_EepromData /end MEASUREMENT
/begin MEASUREMENT ZFEH_EepromData.ydiBackupMemory_xau16[3].backwards_counter "backwards counter of error code stored in error memory slot" UBYTE EH_STANDARD_S4_S3 1 100 0 255 ECU_ADDRESS 0xFFF82943 DISPLAY_IDENTIFIER backwards_counter.ydiBackupMemory_xau16[3].ZFEH_EepromData /end MEASUREMENT
/begin MEASUREMENT ZFEH_EepromData.ydiBackupMemory_xau16[3].condition_byte "condition byte of error code stored in error memory slot" UBYTE EH_STANDARD_S4_S3 1 100 0 255 ECU_ADDRESS 0xFFF8294D DISPLAY_IDENTIFIER condition_byte.ydiBackupMemory_xau16[3].ZFEH_EepromData /end MEASUREMENT
/begin MEASUREMENT ZFEH_EepromData.ydiBackupMemory_xau16[3].error_code "error code stored in error memory slot" UWORD EH_STANDARD_S4_S3 1 100 0 65535 ECU_ADDRESS 0xFFF8293C DISPLAY_IDENTIFIER error_code.ydiBackupMemory_xau16[3].ZFEH_EepromData /end MEASUREMENT
/begin MEASUREMENT ZFEH_EepromData.ydiBackupMemory_xau16[3].error_type "error type of error code stored in error memory slot" UWORD EH_STANDARD_S4_S3 1 100 0 65535 ECU_ADDRESS 0xFFF8293E DISPLAY_IDENTIFIER error_type.ydiBackupMemory_xau16[3].ZFEH_EepromData /end MEASUREMENT
/begin MEASUREMENT ZFEH_EepromData.ydiBackupMemory_xau16[3].frequency_counter "frequency counter of error code stored in error memory slot" UBYTE EH_STANDARD_S4_S3 1 100 0 255 ECU_ADDRESS 0xFFF82942 DISPLAY_IDENTIFIER frequency_counter.ydiBackupMemory_xau16[3].ZFEH_EepromData /end MEASUREMENT
/begin MEASUREMENT ZFEH_EepromData.ydiBackupMemory_xau16[3].master_time "master time of error code stored in error memory slot" ULONG EH_STANDARD_S4_S3 1 100 0 4294967295 ECU_ADDRESS 0xFFF82948 DISPLAY_IDENTIFIER master_time.ydiBackupMemory_xau16[3].ZFEH_EepromData /end MEASUREMENT
/begin MEASUREMENT ZFEH_EepromData.ydiBackupMemory_xau16[3].obd_driving_cycle_counter "obd driving cycle counter of error code stored in error memory slot" UWORD EH_STANDARD_S4_S3 1 100 0 65535 ECU_ADDRESS 0xFFF8294E DISPLAY_IDENTIFIER obd_driving_cycle_counter.ydiBackupMemory_xau16[3].ZFEH_EepromData /end MEASUREMENT
/begin MEASUREMENT ZFEH_EepromData.ydiBackupMemory_xau16[3].permanent_counter "counter of permanent error codes stored in error memory slot" UBYTE EH_STANDARD_S4_S3 1 100 0 255 ECU_ADDRESS 0xFFF82944 DISPLAY_IDENTIFIER permanent_counter.ydiBackupMemory_xau16[3].ZFEH_EepromData /end MEASUREMENT
/begin MEASUREMENT ZFEH_EepromData.ydiBackupMemory_xau16[3].sequence_counter "sequence counter of error code stored in error memory slot" UBYTE EH_STANDARD_S4_S3 1 100 0 255 ECU_ADDRESS 0xFFF82945 DISPLAY_IDENTIFIER sequence_counter.ydiBackupMemory_xau16[3].ZFEH_EepromData /end MEASUREMENT
/begin MEASUREMENT ZFEH_EepromData.ydiBackupMemory_xau16[3].status_word "status word of error code stored in error memory slot" UWORD EH_STANDARD_S4_S3 1 100 0 65535 ECU_ADDRESS 0xFFF82940 DISPLAY_IDENTIFIER status_word.ydiBackupMemory_xau16[3].ZFEH_EepromData /end MEASUREMENT
/begin MEASUREMENT ZFEH_EepromData.ydiBackupMemory_xau16[4].amb_cond.ambient_condition[0][0] "ambient condition shot [0 .. 2-1] with 25 data bytes [0 .. 25-1] for the error code stored in this error memory slot" UBYTE EH_STANDARD_S4_S3 1 100 0 255 ECU_ADDRESS 0xFFF82998 DISPLAY_IDENTIFIER ambient_condition[0][0].amb_cond.ydiBackupMemory_xau16[4].ZFEH_EepromData /end MEASUREMENT
/begin MEASUREMENT ZFEH_EepromData.ydiBackupMemory_xau16[4].amb_cond.ambient_condition[0][10] "ambient condition shot [0 .. 2-1] with 25 data bytes [0 .. 25-1] for the error code stored in this error memory slot" UBYTE EH_STANDARD_S4_S3 1 100 0 255 ECU_ADDRESS 0xFFF829A2 DISPLAY_IDENTIFIER ambient_condition[0][10].amb_cond.ydiBackupMemory_xau16[4].ZFEH_EepromData /end MEASUREMENT
/begin MEASUREMENT ZFEH_EepromData.ydiBackupMemory_xau16[4].amb_cond.ambient_condition[0][11] "ambient condition shot [0 .. 2-1] with 25 data bytes [0 .. 25-1] for the error code stored in this error memory slot" UBYTE EH_STANDARD_S4_S3 1 100 0 255 ECU_ADDRESS 0xFFF829A3 DISPLAY_IDENTIFIER ambient_condition[0][11].amb_cond.ydiBackupMemory_xau16[4].ZFEH_EepromData /end MEASUREMENT
/begin MEASUREMENT ZFEH_EepromData.ydiBackupMemory_xau16[4].amb_cond.ambient_condition[0][12] "ambient condition shot [0 .. 2-1] with 25 data bytes [0 .. 25-1] for the error code stored in this error memory slot" UBYTE EH_STANDARD_S4_S3 1 100 0 255 ECU_ADDRESS 0xFFF829A4 DISPLAY_IDENTIFIER ambient_condition[0][12].amb_cond.ydiBackupMemory_xau16[4].ZFEH_EepromData /end MEASUREMENT
/begin MEASUREMENT ZFEH_EepromData.ydiBackupMemory_xau16[4].amb_cond.ambient_condition[0][13] "ambient condition shot [0 .. 2-1] with 25 data bytes [0 .. 25-1] for the error code stored in this error memory slot" UBYTE EH_STANDARD_S4_S3 1 100 0 255 ECU_ADDRESS 0xFFF829A5 DISPLAY_IDENTIFIER ambient_condition[0][13].amb_cond.ydiBackupMemory_xau16[4].ZFEH_EepromData /end MEASUREMENT
/begin MEASUREMENT ZFEH_EepromData.ydiBackupMemory_xau16[4].amb_cond.ambient_condition[0][14] "ambient condition shot [0 .. 2-1] with 25 data bytes [0 .. 25-1] for the error code stored in this error memory slot" UBYTE EH_STANDARD_S4_S3 1 100 0 255 ECU_ADDRESS 0xFFF829A6 DISPLAY_IDENTIFIER ambient_condition[0][14].amb_cond.ydiBackupMemory_xau16[4].ZFEH_EepromData /end MEASUREMENT
/begin MEASUREMENT ZFEH_EepromData.ydiBackupMemory_xau16[4].amb_cond.ambient_condition[0][15] "ambient condition shot [0 .. 2-1] with 25 data bytes [0 .. 25-1] for the error code stored in this error memory slot" UBYTE EH_STANDARD_S4_S3 1 100 0 255 ECU_ADDRESS 0xFFF829A7 DISPLAY_IDENTIFIER ambient_condition[0][15].amb_cond.ydiBackupMemory_xau16[4].ZFEH_EepromData /end MEASUREMENT
/begin MEASUREMENT ZFEH_EepromData.ydiBackupMemory_xau16[4].amb_cond.ambient_condition[0][16] "ambient condition shot [0 .. 2-1] with 25 data bytes [0 .. 25-1] for the error code stored in this error memory slot" UBYTE EH_STANDARD_S4_S3 1 100 0 255 ECU_ADDRESS 0xFFF829A8 DISPLAY_IDENTIFIER ambient_condition[0][16].amb_cond.ydiBackupMemory_xau16[4].ZFEH_EepromData /end MEASUREMENT
/begin MEASUREMENT ZFEH_EepromData.ydiBackupMemory_xau16[4].amb_cond.ambient_condition[0][17] "ambient condition shot [0 .. 2-1] with 25 data bytes [0 .. 25-1] for the error code stored in this error memory slot" UBYTE EH_STANDARD_S4_S3 1 100 0 255 ECU_ADDRESS 0xFFF829A9 DISPLAY_IDENTIFIER ambient_condition[0][17].amb_cond.ydiBackupMemory_xau16[4].ZFEH_EepromData /end MEASUREMENT
/begin MEASUREMENT ZFEH_EepromData.ydiBackupMemory_xau16[4].amb_cond.ambient_condition[0][18] "ambient condition shot [0 .. 2-1] with 25 data bytes [0 .. 25-1] for the error code stored in this error memory slot" UBYTE EH_STANDARD_S4_S3 1 100 0 255 ECU_ADDRESS 0xFFF829AA DISPLAY_IDENTIFIER ambient_condition[0][18].amb_cond.ydiBackupMemory_xau16[4].ZFEH_EepromData /end MEASUREMENT
/begin MEASUREMENT ZFEH_EepromData.ydiBackupMemory_xau16[4].amb_cond.ambient_condition[0][19] "ambient condition shot [0 .. 2-1] with 25 data bytes [0 .. 25-1] for the error code stored in this error memory slot" UBYTE EH_STANDARD_S4_S3 1 100 0 255 ECU_ADDRESS 0xFFF829AB DISPLAY_IDENTIFIER ambient_condition[0][19].amb_cond.ydiBackupMemory_xau16[4].ZFEH_EepromData /end MEASUREMENT
/begin MEASUREMENT ZFEH_EepromData.ydiBackupMemory_xau16[4].amb_cond.ambient_condition[0][1] "ambient condition shot [0 .. 2-1] with 25 data bytes [0 .. 25-1] for the error code stored in this error memory slot" UBYTE EH_STANDARD_S4_S3 1 100 0 255 ECU_ADDRESS 0xFFF82999 DISPLAY_IDENTIFIER ambient_condition[0][1].amb_cond.ydiBackupMemory_xau16[4].ZFEH_EepromData /end MEASUREMENT
/begin MEASUREMENT ZFEH_EepromData.ydiBackupMemory_xau16[4].amb_cond.ambient_condition[0][20] "ambient condition shot [0 .. 2-1] with 25 data bytes [0 .. 25-1] for the error code stored in this error memory slot" UBYTE EH_STANDARD_S4_S3 1 100 0 255 ECU_ADDRESS 0xFFF829AC DISPLAY_IDENTIFIER ambient_condition[0][20].amb_cond.ydiBackupMemory_xau16[4].ZFEH_EepromData /end MEASUREMENT
/begin MEASUREMENT ZFEH_EepromData.ydiBackupMemory_xau16[4].amb_cond.ambient_condition[0][21] "ambient condition shot [0 .. 2-1] with 25 data bytes [0 .. 25-1] for the error code stored in this error memory slot" UBYTE EH_STANDARD_S4_S3 1 100 0 255 ECU_ADDRESS 0xFFF829AD DISPLAY_IDENTIFIER ambient_condition[0][21].amb_cond.ydiBackupMemory_xau16[4].ZFEH_EepromData /end MEASUREMENT
/begin MEASUREMENT ZFEH_EepromData.ydiBackupMemory_xau16[4].amb_cond.ambient_condition[0][22] "ambient condition shot [0 .. 2-1] with 25 data bytes [0 .. 25-1] for the error code stored in this error memory slot" UBYTE EH_STANDARD_S4_S3 1 100 0 255 ECU_ADDRESS 0xFFF829AE DISPLAY_IDENTIFIER ambient_condition[0][22].amb_cond.ydiBackupMemory_xau16[4].ZFEH_EepromData /end MEASUREMENT
/begin MEASUREMENT ZFEH_EepromData.ydiBackupMemory_xau16[4].amb_cond.ambient_condition[0][23] "ambient condition shot [0 .. 2-1] with 25 data bytes [0 .. 25-1] for the error code stored in this error memory slot" UBYTE EH_STANDARD_S4_S3 1 100 0 255 ECU_ADDRESS 0xFFF829AF DISPLAY_IDENTIFIER ambient_condition[0][23].amb_cond.ydiBackupMemory_xau16[4].ZFEH_EepromData /end MEASUREMENT
/begin MEASUREMENT ZFEH_EepromData.ydiBackupMemory_xau16[4].amb_cond.ambient_condition[0][24] "ambient condition shot [0 .. 2-1] with 25 data bytes [0 .. 25-1] for the error code stored in this error memory slot" UBYTE EH_STANDARD_S4_S3 1 100 0 255 ECU_ADDRESS 0xFFF829B0 DISPLAY_IDENTIFIER ambient_condition[0][24].amb_cond.ydiBackupMemory_xau16[4].ZFEH_EepromData /end MEASUREMENT
/begin MEASUREMENT ZFEH_EepromData.ydiBackupMemory_xau16[4].amb_cond.ambient_condition[0][2] "ambient condition shot [0 .. 2-1] with 25 data bytes [0 .. 25-1] for the error code stored in this error memory slot" UBYTE EH_STANDARD_S4_S3 1 100 0 255 ECU_ADDRESS 0xFFF8299A DISPLAY_IDENTIFIER ambient_condition[0][2].amb_cond.ydiBackupMemory_xau16[4].ZFEH_EepromData /end MEASUREMENT
/begin MEASUREMENT ZFEH_EepromData.ydiBackupMemory_xau16[4].amb_cond.ambient_condition[0][3] "ambient condition shot [0 .. 2-1] with 25 data bytes [0 .. 25-1] for the error code stored in this error memory slot" UBYTE EH_STANDARD_S4_S3 1 100 0 255 ECU_ADDRESS 0xFFF8299B DISPLAY_IDENTIFIER ambient_condition[0][3].amb_cond.ydiBackupMemory_xau16[4].ZFEH_EepromData /end MEASUREMENT
/begin MEASUREMENT ZFEH_EepromData.ydiBackupMemory_xau16[4].amb_cond.ambient_condition[0][4] "ambient condition shot [0 .. 2-1] with 25 data bytes [0 .. 25-1] for the error code stored in this error memory slot" UBYTE EH_STANDARD_S4_S3 1 100 0 255 ECU_ADDRESS 0xFFF8299C DISPLAY_IDENTIFIER ambient_condition[0][4].amb_cond.ydiBackupMemory_xau16[4].ZFEH_EepromData /end MEASUREMENT
/begin MEASUREMENT ZFEH_EepromData.ydiBackupMemory_xau16[4].amb_cond.ambient_condition[0][5] "ambient condition shot [0 .. 2-1] with 25 data bytes [0 .. 25-1] for the error code stored in this error memory slot" UBYTE EH_STANDARD_S4_S3 1 100 0 255 ECU_ADDRESS 0xFFF8299D DISPLAY_IDENTIFIER ambient_condition[0][5].amb_cond.ydiBackupMemory_xau16[4].ZFEH_EepromData /end MEASUREMENT
/begin MEASUREMENT ZFEH_EepromData.ydiBackupMemory_xau16[4].amb_cond.ambient_condition[0][6] "ambient condition shot [0 .. 2-1] with 25 data bytes [0 .. 25-1] for the error code stored in this error memory slot" UBYTE EH_STANDARD_S4_S3 1 100 0 255 ECU_ADDRESS 0xFFF8299E DISPLAY_IDENTIFIER ambient_condition[0][6].amb_cond.ydiBackupMemory_xau16[4].ZFEH_EepromData /end MEASUREMENT
/begin MEASUREMENT ZFEH_EepromData.ydiBackupMemory_xau16[4].amb_cond.ambient_condition[0][7] "ambient condition shot [0 .. 2-1] with 25 data bytes [0 .. 25-1] for the error code stored in this error memory slot" UBYTE EH_STANDARD_S4_S3 1 100 0 255 ECU_ADDRESS 0xFFF8299F DISPLAY_IDENTIFIER ambient_condition[0][7].amb_cond.ydiBackupMemory_xau16[4].ZFEH_EepromData /end MEASUREMENT
/begin MEASUREMENT ZFEH_EepromData.ydiBackupMemory_xau16[4].amb_cond.ambient_condition[0][8] "ambient condition shot [0 .. 2-1] with 25 data bytes [0 .. 25-1] for the error code stored in this error memory slot" UBYTE EH_STANDARD_S4_S3 1 100 0 255 ECU_ADDRESS 0xFFF829A0 DISPLAY_IDENTIFIER ambient_condition[0][8].amb_cond.ydiBackupMemory_xau16[4].ZFEH_EepromData /end MEASUREMENT
/begin MEASUREMENT ZFEH_EepromData.ydiBackupMemory_xau16[4].amb_cond.ambient_condition[0][9] "ambient condition shot [0 .. 2-1] with 25 data bytes [0 .. 25-1] for the error code stored in this error memory slot" UBYTE EH_STANDARD_S4_S3 1 100 0 255 ECU_ADDRESS 0xFFF829A1 DISPLAY_IDENTIFIER ambient_condition[0][9].amb_cond.ydiBackupMemory_xau16[4].ZFEH_EepromData /end MEASUREMENT
/begin MEASUREMENT ZFEH_EepromData.ydiBackupMemory_xau16[4].amb_cond.ambient_condition[1][0] "ambient condition shot [0 .. 2-1] with 25 data bytes [0 .. 25-1] for the error code stored in this error memory slot" UBYTE EH_STANDARD_S4_S3 1 100 0 255 ECU_ADDRESS 0xFFF829B1 DISPLAY_IDENTIFIER ambient_condition[1][0].amb_cond.ydiBackupMemory_xau16[4].ZFEH_EepromData /end MEASUREMENT
/begin MEASUREMENT ZFEH_EepromData.ydiBackupMemory_xau16[4].amb_cond.ambient_condition[1][10] "ambient condition shot [0 .. 2-1] with 25 data bytes [0 .. 25-1] for the error code stored in this error memory slot" UBYTE EH_STANDARD_S4_S3 1 100 0 255 ECU_ADDRESS 0xFFF829BB DISPLAY_IDENTIFIER ambient_condition[1][10].amb_cond.ydiBackupMemory_xau16[4].ZFEH_EepromData /end MEASUREMENT
/begin MEASUREMENT ZFEH_EepromData.ydiBackupMemory_xau16[4].amb_cond.ambient_condition[1][11] "ambient condition shot [0 .. 2-1] with 25 data bytes [0 .. 25-1] for the error code stored in this error memory slot" UBYTE EH_STANDARD_S4_S3 1 100 0 255 ECU_ADDRESS 0xFFF829BC DISPLAY_IDENTIFIER ambient_condition[1][11].amb_cond.ydiBackupMemory_xau16[4].ZFEH_EepromData /end MEASUREMENT
/begin MEASUREMENT ZFEH_EepromData.ydiBackupMemory_xau16[4].amb_cond.ambient_condition[1][12] "ambient condition shot [0 .. 2-1] with 25 data bytes [0 .. 25-1] for the error code stored in this error memory slot" UBYTE EH_STANDARD_S4_S3 1 100 0 255 ECU_ADDRESS 0xFFF829BD DISPLAY_IDENTIFIER ambient_condition[1][12].amb_cond.ydiBackupMemory_xau16[4].ZFEH_EepromData /end MEASUREMENT
/begin MEASUREMENT ZFEH_EepromData.ydiBackupMemory_xau16[4].amb_cond.ambient_condition[1][13] "ambient condition shot [0 .. 2-1] with 25 data bytes [0 .. 25-1] for the error code stored in this error memory slot" UBYTE EH_STANDARD_S4_S3 1 100 0 255 ECU_ADDRESS 0xFFF829BE DISPLAY_IDENTIFIER ambient_condition[1][13].amb_cond.ydiBackupMemory_xau16[4].ZFEH_EepromData /end MEASUREMENT
/begin MEASUREMENT ZFEH_EepromData.ydiBackupMemory_xau16[4].amb_cond.ambient_condition[1][14] "ambient condition shot [0 .. 2-1] with 25 data bytes [0 .. 25-1] for the error code stored in this error memory slot" UBYTE EH_STANDARD_S4_S3 1 100 0 255 ECU_ADDRESS 0xFFF829BF DISPLAY_IDENTIFIER ambient_condition[1][14].amb_cond.ydiBackupMemory_xau16[4].ZFEH_EepromData /end MEASUREMENT
/begin MEASUREMENT ZFEH_EepromData.ydiBackupMemory_xau16[4].amb_cond.ambient_condition[1][15] "ambient condition shot [0 .. 2-1] with 25 data bytes [0 .. 25-1] for the error code stored in this error memory slot" UBYTE EH_STANDARD_S4_S3 1 100 0 255 ECU_ADDRESS 0xFFF829C0 DISPLAY_IDENTIFIER ambient_condition[1][15].amb_cond.ydiBackupMemory_xau16[4].ZFEH_EepromData /end MEASUREMENT
/begin MEASUREMENT ZFEH_EepromData.ydiBackupMemory_xau16[4].amb_cond.ambient_condition[1][16] "ambient condition shot [0 .. 2-1] with 25 data bytes [0 .. 25-1] for the error code stored in this error memory slot" UBYTE EH_STANDARD_S4_S3 1 100 0 255 ECU_ADDRESS 0xFFF829C1 DISPLAY_IDENTIFIER ambient_condition[1][16].amb_cond.ydiBackupMemory_xau16[4].ZFEH_EepromData /end MEASUREMENT
/begin MEASUREMENT ZFEH_EepromData.ydiBackupMemory_xau16[4].amb_cond.ambient_condition[1][17] "ambient condition shot [0 .. 2-1] with 25 data bytes [0 .. 25-1] for the error code stored in this error memory slot" UBYTE EH_STANDARD_S4_S3 1 100 0 255 ECU_ADDRESS 0xFFF829C2 DISPLAY_IDENTIFIER ambient_condition[1][17].amb_cond.ydiBackupMemory_xau16[4].ZFEH_EepromData /end MEASUREMENT
/begin MEASUREMENT ZFEH_EepromData.ydiBackupMemory_xau16[4].amb_cond.ambient_condition[1][18] "ambient condition shot [0 .. 2-1] with 25 data bytes [0 .. 25-1] for the error code stored in this error memory slot" UBYTE EH_STANDARD_S4_S3 1 100 0 255 ECU_ADDRESS 0xFFF829C3 DISPLAY_IDENTIFIER ambient_condition[1][18].amb_cond.ydiBackupMemory_xau16[4].ZFEH_EepromData /end MEASUREMENT
/begin MEASUREMENT ZFEH_EepromData.ydiBackupMemory_xau16[4].amb_cond.ambient_condition[1][19] "ambient condition shot [0 .. 2-1] with 25 data bytes [0 .. 25-1] for the error code stored in this error memory slot" UBYTE EH_STANDARD_S4_S3 1 100 0 255 ECU_ADDRESS 0xFFF829C4 DISPLAY_IDENTIFIER ambient_condition[1][19].amb_cond.ydiBackupMemory_xau16[4].ZFEH_EepromData /end MEASUREMENT
/begin MEASUREMENT ZFEH_EepromData.ydiBackupMemory_xau16[4].amb_cond.ambient_condition[1][1] "ambient condition shot [0 .. 2-1] with 25 data bytes [0 .. 25-1] for the error code stored in this error memory slot" UBYTE EH_STANDARD_S4_S3 1 100 0 255 ECU_ADDRESS 0xFFF829B2 DISPLAY_IDENTIFIER ambient_condition[1][1].amb_cond.ydiBackupMemory_xau16[4].ZFEH_EepromData /end MEASUREMENT
/begin MEASUREMENT ZFEH_EepromData.ydiBackupMemory_xau16[4].amb_cond.ambient_condition[1][20] "ambient condition shot [0 .. 2-1] with 25 data bytes [0 .. 25-1] for the error code stored in this error memory slot" UBYTE EH_STANDARD_S4_S3 1 100 0 255 ECU_ADDRESS 0xFFF829C5 DISPLAY_IDENTIFIER ambient_condition[1][20].amb_cond.ydiBackupMemory_xau16[4].ZFEH_EepromData /end MEASUREMENT
/begin MEASUREMENT ZFEH_EepromData.ydiBackupMemory_xau16[4].amb_cond.ambient_condition[1][21] "ambient condition shot [0 .. 2-1] with 25 data bytes [0 .. 25-1] for the error code stored in this error memory slot" UBYTE EH_STANDARD_S4_S3 1 100 0 255 ECU_ADDRESS 0xFFF829C6 DISPLAY_IDENTIFIER ambient_condition[1][21].amb_cond.ydiBackupMemory_xau16[4].ZFEH_EepromData /end MEASUREMENT
/begin MEASUREMENT ZFEH_EepromData.ydiBackupMemory_xau16[4].amb_cond.ambient_condition[1][22] "ambient condition shot [0 .. 2-1] with 25 data bytes [0 .. 25-1] for the error code stored in this error memory slot" UBYTE EH_STANDARD_S4_S3 1 100 0 255 ECU_ADDRESS 0xFFF829C7 DISPLAY_IDENTIFIER ambient_condition[1][22].amb_cond.ydiBackupMemory_xau16[4].ZFEH_EepromData /end MEASUREMENT
/begin MEASUREMENT ZFEH_EepromData.ydiBackupMemory_xau16[4].amb_cond.ambient_condition[1][23] "ambient condition shot [0 .. 2-1] with 25 data bytes [0 .. 25-1] for the error code stored in this error memory slot" UBYTE EH_STANDARD_S4_S3 1 100 0 255 ECU_ADDRESS 0xFFF829C8 DISPLAY_IDENTIFIER ambient_condition[1][23].amb_cond.ydiBackupMemory_xau16[4].ZFEH_EepromData /end MEASUREMENT
/begin MEASUREMENT ZFEH_EepromData.ydiBackupMemory_xau16[4].amb_cond.ambient_condition[1][24] "ambient condition shot [0 .. 2-1] with 25 data bytes [0 .. 25-1] for the error code stored in this error memory slot" UBYTE EH_STANDARD_S4_S3 1 100 0 255 ECU_ADDRESS 0xFFF829C9 DISPLAY_IDENTIFIER ambient_condition[1][24].amb_cond.ydiBackupMemory_xau16[4].ZFEH_EepromData /end MEASUREMENT
/begin MEASUREMENT ZFEH_EepromData.ydiBackupMemory_xau16[4].amb_cond.ambient_condition[1][2] "ambient condition shot [0 .. 2-1] with 25 data bytes [0 .. 25-1] for the error code stored in this error memory slot" UBYTE EH_STANDARD_S4_S3 1 100 0 255 ECU_ADDRESS 0xFFF829B3 DISPLAY_IDENTIFIER ambient_condition[1][2].amb_cond.ydiBackupMemory_xau16[4].ZFEH_EepromData /end MEASUREMENT
/begin MEASUREMENT ZFEH_EepromData.ydiBackupMemory_xau16[4].amb_cond.ambient_condition[1][3] "ambient condition shot [0 .. 2-1] with 25 data bytes [0 .. 25-1] for the error code stored in this error memory slot" UBYTE EH_STANDARD_S4_S3 1 100 0 255 ECU_ADDRESS 0xFFF829B4 DISPLAY_IDENTIFIER ambient_condition[1][3].amb_cond.ydiBackupMemory_xau16[4].ZFEH_EepromData /end MEASUREMENT
/begin MEASUREMENT ZFEH_EepromData.ydiBackupMemory_xau16[4].amb_cond.ambient_condition[1][4] "ambient condition shot [0 .. 2-1] with 25 data bytes [0 .. 25-1] for the error code stored in this error memory slot" UBYTE EH_STANDARD_S4_S3 1 100 0 255 ECU_ADDRESS 0xFFF829B5 DISPLAY_IDENTIFIER ambient_condition[1][4].amb_cond.ydiBackupMemory_xau16[4].ZFEH_EepromData /end MEASUREMENT
/begin MEASUREMENT ZFEH_EepromData.ydiBackupMemory_xau16[4].amb_cond.ambient_condition[1][5] "ambient condition shot [0 .. 2-1] with 25 data bytes [0 .. 25-1] for the error code stored in this error memory slot" UBYTE EH_STANDARD_S4_S3 1 100 0 255 ECU_ADDRESS 0xFFF829B6 DISPLAY_IDENTIFIER ambient_condition[1][5].amb_cond.ydiBackupMemory_xau16[4].ZFEH_EepromData /end MEASUREMENT
/begin MEASUREMENT ZFEH_EepromData.ydiBackupMemory_xau16[4].amb_cond.ambient_condition[1][6] "ambient condition shot [0 .. 2-1] with 25 data bytes [0 .. 25-1] for the error code stored in this error memory slot" UBYTE EH_STANDARD_S4_S3 1 100 0 255 ECU_ADDRESS 0xFFF829B7 DISPLAY_IDENTIFIER ambient_condition[1][6].amb_cond.ydiBackupMemory_xau16[4].ZFEH_EepromData /end MEASUREMENT
/begin MEASUREMENT ZFEH_EepromData.ydiBackupMemory_xau16[4].amb_cond.ambient_condition[1][7] "ambient condition shot [0 .. 2-1] with 25 data bytes [0 .. 25-1] for the error code stored in this error memory slot" UBYTE EH_STANDARD_S4_S3 1 100 0 255 ECU_ADDRESS 0xFFF829B8 DISPLAY_IDENTIFIER ambient_condition[1][7].amb_cond.ydiBackupMemory_xau16[4].ZFEH_EepromData /end MEASUREMENT
/begin MEASUREMENT ZFEH_EepromData.ydiBackupMemory_xau16[4].amb_cond.ambient_condition[1][8] "ambient condition shot [0 .. 2-1] with 25 data bytes [0 .. 25-1] for the error code stored in this error memory slot" UBYTE EH_STANDARD_S4_S3 1 100 0 255 ECU_ADDRESS 0xFFF829B9 DISPLAY_IDENTIFIER ambient_condition[1][8].amb_cond.ydiBackupMemory_xau16[4].ZFEH_EepromData /end MEASUREMENT
/begin MEASUREMENT ZFEH_EepromData.ydiBackupMemory_xau16[4].amb_cond.ambient_condition[1][9] "ambient condition shot [0 .. 2-1] with 25 data bytes [0 .. 25-1] for the error code stored in this error memory slot" UBYTE EH_STANDARD_S4_S3 1 100 0 255 ECU_ADDRESS 0xFFF829BA DISPLAY_IDENTIFIER ambient_condition[1][9].amb_cond.ydiBackupMemory_xau16[4].ZFEH_EepromData /end MEASUREMENT
/begin MEASUREMENT ZFEH_EepromData.ydiBackupMemory_xau16[4].amb_cond.status_of_ambient_conditions[0] "status of ambient condition shot x: 0=invalid 1=valid" UBYTE EH_STANDARD_S4_S3 1 100 0 1 ECU_ADDRESS 0xFFF829CA DISPLAY_IDENTIFIER status_of_ambient_conditions[0].amb_cond.ydiBackupMemory_xau16[4].ZFEH_EepromData /end MEASUREMENT
/begin MEASUREMENT ZFEH_EepromData.ydiBackupMemory_xau16[4].amb_cond.status_of_ambient_conditions[1] "status of ambient condition shot x: 0=invalid 1=valid" UBYTE EH_STANDARD_S4_S3 1 100 0 1 ECU_ADDRESS 0xFFF829CB DISPLAY_IDENTIFIER status_of_ambient_conditions[1].amb_cond.ydiBackupMemory_xau16[4].ZFEH_EepromData /end MEASUREMENT
/begin MEASUREMENT ZFEH_EepromData.ydiBackupMemory_xau16[4].backwards_counter "backwards counter of error code stored in error memory slot" UBYTE EH_STANDARD_S4_S3 1 100 0 255 ECU_ADDRESS 0xFFF8298B DISPLAY_IDENTIFIER backwards_counter.ydiBackupMemory_xau16[4].ZFEH_EepromData /end MEASUREMENT
/begin MEASUREMENT ZFEH_EepromData.ydiBackupMemory_xau16[4].condition_byte "condition byte of error code stored in error memory slot" UBYTE EH_STANDARD_S4_S3 1 100 0 255 ECU_ADDRESS 0xFFF82995 DISPLAY_IDENTIFIER condition_byte.ydiBackupMemory_xau16[4].ZFEH_EepromData /end MEASUREMENT
/begin MEASUREMENT ZFEH_EepromData.ydiBackupMemory_xau16[4].error_code "error code stored in error memory slot" UWORD EH_STANDARD_S4_S3 1 100 0 65535 ECU_ADDRESS 0xFFF82984 DISPLAY_IDENTIFIER error_code.ydiBackupMemory_xau16[4].ZFEH_EepromData /end MEASUREMENT
/begin MEASUREMENT ZFEH_EepromData.ydiBackupMemory_xau16[4].error_type "error type of error code stored in error memory slot" UWORD EH_STANDARD_S4_S3 1 100 0 65535 ECU_ADDRESS 0xFFF82986 DISPLAY_IDENTIFIER error_type.ydiBackupMemory_xau16[4].ZFEH_EepromData /end MEASUREMENT
/begin MEASUREMENT ZFEH_EepromData.ydiBackupMemory_xau16[4].frequency_counter "frequency counter of error code stored in error memory slot" UBYTE EH_STANDARD_S4_S3 1 100 0 255 ECU_ADDRESS 0xFFF8298A DISPLAY_IDENTIFIER frequency_counter.ydiBackupMemory_xau16[4].ZFEH_EepromData /end MEASUREMENT
/begin MEASUREMENT ZFEH_EepromData.ydiBackupMemory_xau16[4].master_time "master time of error code stored in error memory slot" ULONG EH_STANDARD_S4_S3 1 100 0 4294967295 ECU_ADDRESS 0xFFF82990 DISPLAY_IDENTIFIER master_time.ydiBackupMemory_xau16[4].ZFEH_EepromData /end MEASUREMENT
/begin MEASUREMENT ZFEH_EepromData.ydiBackupMemory_xau16[4].obd_driving_cycle_counter "obd driving cycle counter of error code stored in error memory slot" UWORD EH_STANDARD_S4_S3 1 100 0 65535 ECU_ADDRESS 0xFFF82996 DISPLAY_IDENTIFIER obd_driving_cycle_counter.ydiBackupMemory_xau16[4].ZFEH_EepromData /end MEASUREMENT
/begin MEASUREMENT ZFEH_EepromData.ydiBackupMemory_xau16[4].permanent_counter "counter of permanent error codes stored in error memory slot" UBYTE EH_STANDARD_S4_S3 1 100 0 255 ECU_ADDRESS 0xFFF8298C DISPLAY_IDENTIFIER permanent_counter.ydiBackupMemory_xau16[4].ZFEH_EepromData /end MEASUREMENT
/begin MEASUREMENT ZFEH_EepromData.ydiBackupMemory_xau16[4].sequence_counter "sequence counter of error code stored in error memory slot" UBYTE EH_STANDARD_S4_S3 1 100 0 255 ECU_ADDRESS 0xFFF8298D DISPLAY_IDENTIFIER sequence_counter.ydiBackupMemory_xau16[4].ZFEH_EepromData /end MEASUREMENT
/begin MEASUREMENT ZFEH_EepromData.ydiBackupMemory_xau16[4].status_word "status word of error code stored in error memory slot" UWORD EH_STANDARD_S4_S3 1 100 0 65535 ECU_ADDRESS 0xFFF82988 DISPLAY_IDENTIFIER status_word.ydiBackupMemory_xau16[4].ZFEH_EepromData /end MEASUREMENT
/begin MEASUREMENT ZFEH_EepromData.ydiBackupMemory_xau16[5].amb_cond.ambient_condition[0][0] "ambient condition shot [0 .. 2-1] with 25 data bytes [0 .. 25-1] for the error code stored in this error memory slot" UBYTE EH_STANDARD_S4_S3 1 100 0 255 ECU_ADDRESS 0xFFF829E0 DISPLAY_IDENTIFIER ambient_condition[0][0].amb_cond.ydiBackupMemory_xau16[5].ZFEH_EepromData /end MEASUREMENT
/begin MEASUREMENT ZFEH_EepromData.ydiBackupMemory_xau16[5].amb_cond.ambient_condition[0][10] "ambient condition shot [0 .. 2-1] with 25 data bytes [0 .. 25-1] for the error code stored in this error memory slot" UBYTE EH_STANDARD_S4_S3 1 100 0 255 ECU_ADDRESS 0xFFF829EA DISPLAY_IDENTIFIER ambient_condition[0][10].amb_cond.ydiBackupMemory_xau16[5].ZFEH_EepromData /end MEASUREMENT
/begin MEASUREMENT ZFEH_EepromData.ydiBackupMemory_xau16[5].amb_cond.ambient_condition[0][11] "ambient condition shot [0 .. 2-1] with 25 data bytes [0 .. 25-1] for the error code stored in this error memory slot" UBYTE EH_STANDARD_S4_S3 1 100 0 255 ECU_ADDRESS 0xFFF829EB DISPLAY_IDENTIFIER ambient_condition[0][11].amb_cond.ydiBackupMemory_xau16[5].ZFEH_EepromData /end MEASUREMENT
/begin MEASUREMENT ZFEH_EepromData.ydiBackupMemory_xau16[5].amb_cond.ambient_condition[0][12] "ambient condition shot [0 .. 2-1] with 25 data bytes [0 .. 25-1] for the error code stored in this error memory slot" UBYTE EH_STANDARD_S4_S3 1 100 0 255 ECU_ADDRESS 0xFFF829EC DISPLAY_IDENTIFIER ambient_condition[0][12].amb_cond.ydiBackupMemory_xau16[5].ZFEH_EepromData /end MEASUREMENT
/begin MEASUREMENT ZFEH_EepromData.ydiBackupMemory_xau16[5].amb_cond.ambient_condition[0][13] "ambient condition shot [0 .. 2-1] with 25 data bytes [0 .. 25-1] for the error code stored in this error memory slot" UBYTE EH_STANDARD_S4_S3 1 100 0 255 ECU_ADDRESS 0xFFF829ED DISPLAY_IDENTIFIER ambient_condition[0][13].amb_cond.ydiBackupMemory_xau16[5].ZFEH_EepromData /end MEASUREMENT
/begin MEASUREMENT ZFEH_EepromData.ydiBackupMemory_xau16[5].amb_cond.ambient_condition[0][14] "ambient condition shot [0 .. 2-1] with 25 data bytes [0 .. 25-1] for the error code stored in this error memory slot" UBYTE EH_STANDARD_S4_S3 1 100 0 255 ECU_ADDRESS 0xFFF829EE DISPLAY_IDENTIFIER ambient_condition[0][14].amb_cond.ydiBackupMemory_xau16[5].ZFEH_EepromData /end MEASUREMENT
/begin MEASUREMENT ZFEH_EepromData.ydiBackupMemory_xau16[5].amb_cond.ambient_condition[0][15] "ambient condition shot [0 .. 2-1] with 25 data bytes [0 .. 25-1] for the error code stored in this error memory slot" UBYTE EH_STANDARD_S4_S3 1 100 0 255 ECU_ADDRESS 0xFFF829EF DISPLAY_IDENTIFIER ambient_condition[0][15].amb_cond.ydiBackupMemory_xau16[5].ZFEH_EepromData /end MEASUREMENT
/begin MEASUREMENT ZFEH_EepromData.ydiBackupMemory_xau16[5].amb_cond.ambient_condition[0][16] "ambient condition shot [0 .. 2-1] with 25 data bytes [0 .. 25-1] for the error code stored in this error memory slot" UBYTE EH_STANDARD_S4_S3 1 100 0 255 ECU_ADDRESS 0xFFF829F0 DISPLAY_IDENTIFIER ambient_condition[0][16].amb_cond.ydiBackupMemory_xau16[5].ZFEH_EepromData /end MEASUREMENT
/begin MEASUREMENT ZFEH_EepromData.ydiBackupMemory_xau16[5].amb_cond.ambient_condition[0][17] "ambient condition shot [0 .. 2-1] with 25 data bytes [0 .. 25-1] for the error code stored in this error memory slot" UBYTE EH_STANDARD_S4_S3 1 100 0 255 ECU_ADDRESS 0xFFF829F1 DISPLAY_IDENTIFIER ambient_condition[0][17].amb_cond.ydiBackupMemory_xau16[5].ZFEH_EepromData /end MEASUREMENT
/begin MEASUREMENT ZFEH_EepromData.ydiBackupMemory_xau16[5].amb_cond.ambient_condition[0][18] "ambient condition shot [0 .. 2-1] with 25 data bytes [0 .. 25-1] for the error code stored in this error memory slot" UBYTE EH_STANDARD_S4_S3 1 100 0 255 ECU_ADDRESS 0xFFF829F2 DISPLAY_IDENTIFIER ambient_condition[0][18].amb_cond.ydiBackupMemory_xau16[5].ZFEH_EepromData /end MEASUREMENT
/begin MEASUREMENT ZFEH_EepromData.ydiBackupMemory_xau16[5].amb_cond.ambient_condition[0][19] "ambient condition shot [0 .. 2-1] with 25 data bytes [0 .. 25-1] for the error code stored in this error memory slot" UBYTE EH_STANDARD_S4_S3 1 100 0 255 ECU_ADDRESS 0xFFF829F3 DISPLAY_IDENTIFIER ambient_condition[0][19].amb_cond.ydiBackupMemory_xau16[5].ZFEH_EepromData /end MEASUREMENT
/begin MEASUREMENT ZFEH_EepromData.ydiBackupMemory_xau16[5].amb_cond.ambient_condition[0][1] "ambient condition shot [0 .. 2-1] with 25 data bytes [0 .. 25-1] for the error code stored in this error memory slot" UBYTE EH_STANDARD_S4_S3 1 100 0 255 ECU_ADDRESS 0xFFF829E1 DISPLAY_IDENTIFIER ambient_condition[0][1].amb_cond.ydiBackupMemory_xau16[5].ZFEH_EepromData /end MEASUREMENT
/begin MEASUREMENT ZFEH_EepromData.ydiBackupMemory_xau16[5].amb_cond.ambient_condition[0][20] "ambient condition shot [0 .. 2-1] with 25 data bytes [0 .. 25-1] for the error code stored in this error memory slot" UBYTE EH_STANDARD_S4_S3 1 100 0 255 ECU_ADDRESS 0xFFF829F4 DISPLAY_IDENTIFIER ambient_condition[0][20].amb_cond.ydiBackupMemory_xau16[5].ZFEH_EepromData /end MEASUREMENT
/begin MEASUREMENT ZFEH_EepromData.ydiBackupMemory_xau16[5].amb_cond.ambient_condition[0][21] "ambient condition shot [0 .. 2-1] with 25 data bytes [0 .. 25-1] for the error code stored in this error memory slot" UBYTE EH_STANDARD_S4_S3 1 100 0 255 ECU_ADDRESS 0xFFF829F5 DISPLAY_IDENTIFIER ambient_condition[0][21].amb_cond.ydiBackupMemory_xau16[5].ZFEH_EepromData /end MEASUREMENT
/begin MEASUREMENT ZFEH_EepromData.ydiBackupMemory_xau16[5].amb_cond.ambient_condition[0][22] "ambient condition shot [0 .. 2-1] with 25 data bytes [0 .. 25-1] for the error code stored in this error memory slot" UBYTE EH_STANDARD_S4_S3 1 100 0 255 ECU_ADDRESS 0xFFF829F6 DISPLAY_IDENTIFIER ambient_condition[0][22].amb_cond.ydiBackupMemory_xau16[5].ZFEH_EepromData /end MEASUREMENT
/begin MEASUREMENT ZFEH_EepromData.ydiBackupMemory_xau16[5].amb_cond.ambient_condition[0][23] "ambient condition shot [0 .. 2-1] with 25 data bytes [0 .. 25-1] for the error code stored in this error memory slot" UBYTE EH_STANDARD_S4_S3 1 100 0 255 ECU_ADDRESS 0xFFF829F7 DISPLAY_IDENTIFIER ambient_condition[0][23].amb_cond.ydiBackupMemory_xau16[5].ZFEH_EepromData /end MEASUREMENT
/begin MEASUREMENT ZFEH_EepromData.ydiBackupMemory_xau16[5].amb_cond.ambient_condition[0][24] "ambient condition shot [0 .. 2-1] with 25 data bytes [0 .. 25-1] for the error code stored in this error memory slot" UBYTE EH_STANDARD_S4_S3 1 100 0 255 ECU_ADDRESS 0xFFF829F8 DISPLAY_IDENTIFIER ambient_condition[0][24].amb_cond.ydiBackupMemory_xau16[5].ZFEH_EepromData /end MEASUREMENT
/begin MEASUREMENT ZFEH_EepromData.ydiBackupMemory_xau16[5].amb_cond.ambient_condition[0][2] "ambient condition shot [0 .. 2-1] with 25 data bytes [0 .. 25-1] for the error code stored in this error memory slot" UBYTE EH_STANDARD_S4_S3 1 100 0 255 ECU_ADDRESS 0xFFF829E2 DISPLAY_IDENTIFIER ambient_condition[0][2].amb_cond.ydiBackupMemory_xau16[5].ZFEH_EepromData /end MEASUREMENT
/begin MEASUREMENT ZFEH_EepromData.ydiBackupMemory_xau16[5].amb_cond.ambient_condition[0][3] "ambient condition shot [0 .. 2-1] with 25 data bytes [0 .. 25-1] for the error code stored in this error memory slot" UBYTE EH_STANDARD_S4_S3 1 100 0 255 ECU_ADDRESS 0xFFF829E3 DISPLAY_IDENTIFIER ambient_condition[0][3].amb_cond.ydiBackupMemory_xau16[5].ZFEH_EepromData /end MEASUREMENT
/begin MEASUREMENT ZFEH_EepromData.ydiBackupMemory_xau16[5].amb_cond.ambient_condition[0][4] "ambient condition shot [0 .. 2-1] with 25 data bytes [0 .. 25-1] for the error code stored in this error memory slot" UBYTE EH_STANDARD_S4_S3 1 100 0 255 ECU_ADDRESS 0xFFF829E4 DISPLAY_IDENTIFIER ambient_condition[0][4].amb_cond.ydiBackupMemory_xau16[5].ZFEH_EepromData /end MEASUREMENT
/begin MEASUREMENT ZFEH_EepromData.ydiBackupMemory_xau16[5].amb_cond.ambient_condition[0][5] "ambient condition shot [0 .. 2-1] with 25 data bytes [0 .. 25-1] for the error code stored in this error memory slot" UBYTE EH_STANDARD_S4_S3 1 100 0 255 ECU_ADDRESS 0xFFF829E5 DISPLAY_IDENTIFIER ambient_condition[0][5].amb_cond.ydiBackupMemory_xau16[5].ZFEH_EepromData /end MEASUREMENT
/begin MEASUREMENT ZFEH_EepromData.ydiBackupMemory_xau16[5].amb_cond.ambient_condition[0][6] "ambient condition shot [0 .. 2-1] with 25 data bytes [0 .. 25-1] for the error code stored in this error memory slot" UBYTE EH_STANDARD_S4_S3 1 100 0 255 ECU_ADDRESS 0xFFF829E6 DISPLAY_IDENTIFIER ambient_condition[0][6].amb_cond.ydiBackupMemory_xau16[5].ZFEH_EepromData /end MEASUREMENT
/begin MEASUREMENT ZFEH_EepromData.ydiBackupMemory_xau16[5].amb_cond.ambient_condition[0][7] "ambient condition shot [0 .. 2-1] with 25 data bytes [0 .. 25-1] for the error code stored in this error memory slot" UBYTE EH_STANDARD_S4_S3 1 100 0 255 ECU_ADDRESS 0xFFF829E7 DISPLAY_IDENTIFIER ambient_condition[0][7].amb_cond.ydiBackupMemory_xau16[5].ZFEH_EepromData /end MEASUREMENT
/begin MEASUREMENT ZFEH_EepromData.ydiBackupMemory_xau16[5].amb_cond.ambient_condition[0][8] "ambient condition shot [0 .. 2-1] with 25 data bytes [0 .. 25-1] for the error code stored in this error memory slot" UBYTE EH_STANDARD_S4_S3 1 100 0 255 ECU_ADDRESS 0xFFF829E8 DISPLAY_IDENTIFIER ambient_condition[0][8].amb_cond.ydiBackupMemory_xau16[5].ZFEH_EepromData /end MEASUREMENT
/begin MEASUREMENT ZFEH_EepromData.ydiBackupMemory_xau16[5].amb_cond.ambient_condition[0][9] "ambient condition shot [0 .. 2-1] with 25 data bytes [0 .. 25-1] for the error code stored in this error memory slot" UBYTE EH_STANDARD_S4_S3 1 100 0 255 ECU_ADDRESS 0xFFF829E9 DISPLAY_IDENTIFIER ambient_condition[0][9].amb_cond.ydiBackupMemory_xau16[5].ZFEH_EepromData /end MEASUREMENT
/begin MEASUREMENT ZFEH_EepromData.ydiBackupMemory_xau16[5].amb_cond.ambient_condition[1][0] "ambient condition shot [0 .. 2-1] with 25 data bytes [0 .. 25-1] for the error code stored in this error memory slot" UBYTE EH_STANDARD_S4_S3 1 100 0 255 ECU_ADDRESS 0xFFF829F9 DISPLAY_IDENTIFIER ambient_condition[1][0].amb_cond.ydiBackupMemory_xau16[5].ZFEH_EepromData /end MEASUREMENT
/begin MEASUREMENT ZFEH_EepromData.ydiBackupMemory_xau16[5].amb_cond.ambient_condition[1][10] "ambient condition shot [0 .. 2-1] with 25 data bytes [0 .. 25-1] for the error code stored in this error memory slot" UBYTE EH_STANDARD_S4_S3 1 100 0 255 ECU_ADDRESS 0xFFF82A03 DISPLAY_IDENTIFIER ambient_condition[1][10].amb_cond.ydiBackupMemory_xau16[5].ZFEH_EepromData /end MEASUREMENT
/begin MEASUREMENT ZFEH_EepromData.ydiBackupMemory_xau16[5].amb_cond.ambient_condition[1][11] "ambient condition shot [0 .. 2-1] with 25 data bytes [0 .. 25-1] for the error code stored in this error memory slot" UBYTE EH_STANDARD_S4_S3 1 100 0 255 ECU_ADDRESS 0xFFF82A04 DISPLAY_IDENTIFIER ambient_condition[1][11].amb_cond.ydiBackupMemory_xau16[5].ZFEH_EepromData /end MEASUREMENT
/begin MEASUREMENT ZFEH_EepromData.ydiBackupMemory_xau16[5].amb_cond.ambient_condition[1][12] "ambient condition shot [0 .. 2-1] with 25 data bytes [0 .. 25-1] for the error code stored in this error memory slot" UBYTE EH_STANDARD_S4_S3 1 100 0 255 ECU_ADDRESS 0xFFF82A05 DISPLAY_IDENTIFIER ambient_condition[1][12].amb_cond.ydiBackupMemory_xau16[5].ZFEH_EepromData /end MEASUREMENT
/begin MEASUREMENT ZFEH_EepromData.ydiBackupMemory_xau16[5].amb_cond.ambient_condition[1][13] "ambient condition shot [0 .. 2-1] with 25 data bytes [0 .. 25-1] for the error code stored in this error memory slot" UBYTE EH_STANDARD_S4_S3 1 100 0 255 ECU_ADDRESS 0xFFF82A06 DISPLAY_IDENTIFIER ambient_condition[1][13].amb_cond.ydiBackupMemory_xau16[5].ZFEH_EepromData /end MEASUREMENT
/begin MEASUREMENT ZFEH_EepromData.ydiBackupMemory_xau16[5].amb_cond.ambient_condition[1][14] "ambient condition shot [0 .. 2-1] with 25 data bytes [0 .. 25-1] for the error code stored in this error memory slot" UBYTE EH_STANDARD_S4_S3 1 100 0 255 ECU_ADDRESS 0xFFF82A07 DISPLAY_IDENTIFIER ambient_condition[1][14].amb_cond.ydiBackupMemory_xau16[5].ZFEH_EepromData /end MEASUREMENT
/begin MEASUREMENT ZFEH_EepromData.ydiBackupMemory_xau16[5].amb_cond.ambient_condition[1][15] "ambient condition shot [0 .. 2-1] with 25 data bytes [0 .. 25-1] for the error code stored in this error memory slot" UBYTE EH_STANDARD_S4_S3 1 100 0 255 ECU_ADDRESS 0xFFF82A08 DISPLAY_IDENTIFIER ambient_condition[1][15].amb_cond.ydiBackupMemory_xau16[5].ZFEH_EepromData /end MEASUREMENT
/begin MEASUREMENT ZFEH_EepromData.ydiBackupMemory_xau16[5].amb_cond.ambient_condition[1][16] "ambient condition shot [0 .. 2-1] with 25 data bytes [0 .. 25-1] for the error code stored in this error memory slot" UBYTE EH_STANDARD_S4_S3 1 100 0 255 ECU_ADDRESS 0xFFF82A09 DISPLAY_IDENTIFIER ambient_condition[1][16].amb_cond.ydiBackupMemory_xau16[5].ZFEH_EepromData /end MEASUREMENT
/begin MEASUREMENT ZFEH_EepromData.ydiBackupMemory_xau16[5].amb_cond.ambient_condition[1][17] "ambient condition shot [0 .. 2-1] with 25 data bytes [0 .. 25-1] for the error code stored in this error memory slot" UBYTE EH_STANDARD_S4_S3 1 100 0 255 ECU_ADDRESS 0xFFF82A0A DISPLAY_IDENTIFIER ambient_condition[1][17].amb_cond.ydiBackupMemory_xau16[5].ZFEH_EepromData /end MEASUREMENT
/begin MEASUREMENT ZFEH_EepromData.ydiBackupMemory_xau16[5].amb_cond.ambient_condition[1][18] "ambient condition shot [0 .. 2-1] with 25 data bytes [0 .. 25-1] for the error code stored in this error memory slot" UBYTE EH_STANDARD_S4_S3 1 100 0 255 ECU_ADDRESS 0xFFF82A0B DISPLAY_IDENTIFIER ambient_condition[1][18].amb_cond.ydiBackupMemory_xau16[5].ZFEH_EepromData /end MEASUREMENT
/begin MEASUREMENT ZFEH_EepromData.ydiBackupMemory_xau16[5].amb_cond.ambient_condition[1][19] "ambient condition shot [0 .. 2-1] with 25 data bytes [0 .. 25-1] for the error code stored in this error memory slot" UBYTE EH_STANDARD_S4_S3 1 100 0 255 ECU_ADDRESS 0xFFF82A0C DISPLAY_IDENTIFIER ambient_condition[1][19].amb_cond.ydiBackupMemory_xau16[5].ZFEH_EepromData /end MEASUREMENT
/begin MEASUREMENT ZFEH_EepromData.ydiBackupMemory_xau16[5].amb_cond.ambient_condition[1][1] "ambient condition shot [0 .. 2-1] with 25 data bytes [0 .. 25-1] for the error code stored in this error memory slot" UBYTE EH_STANDARD_S4_S3 1 100 0 255 ECU_ADDRESS 0xFFF829FA DISPLAY_IDENTIFIER ambient_condition[1][1].amb_cond.ydiBackupMemory_xau16[5].ZFEH_EepromData /end MEASUREMENT
/begin MEASUREMENT ZFEH_EepromData.ydiBackupMemory_xau16[5].amb_cond.ambient_condition[1][20] "ambient condition shot [0 .. 2-1] with 25 data bytes [0 .. 25-1] for the error code stored in this error memory slot" UBYTE EH_STANDARD_S4_S3 1 100 0 255 ECU_ADDRESS 0xFFF82A0D DISPLAY_IDENTIFIER ambient_condition[1][20].amb_cond.ydiBackupMemory_xau16[5].ZFEH_EepromData /end MEASUREMENT
/begin MEASUREMENT ZFEH_EepromData.ydiBackupMemory_xau16[5].amb_cond.ambient_condition[1][21] "ambient condition shot [0 .. 2-1] with 25 data bytes [0 .. 25-1] for the error code stored in this error memory slot" UBYTE EH_STANDARD_S4_S3 1 100 0 255 ECU_ADDRESS 0xFFF82A0E DISPLAY_IDENTIFIER ambient_condition[1][21].amb_cond.ydiBackupMemory_xau16[5].ZFEH_EepromData /end MEASUREMENT
/begin MEASUREMENT ZFEH_EepromData.ydiBackupMemory_xau16[5].amb_cond.ambient_condition[1][22] "ambient condition shot [0 .. 2-1] with 25 data bytes [0 .. 25-1] for the error code stored in this error memory slot" UBYTE EH_STANDARD_S4_S3 1 100 0 255 ECU_ADDRESS 0xFFF82A0F DISPLAY_IDENTIFIER ambient_condition[1][22].amb_cond.ydiBackupMemory_xau16[5].ZFEH_EepromData /end MEASUREMENT
/begin MEASUREMENT ZFEH_EepromData.ydiBackupMemory_xau16[5].amb_cond.ambient_condition[1][23] "ambient condition shot [0 .. 2-1] with 25 data bytes [0 .. 25-1] for the error code stored in this error memory slot" UBYTE EH_STANDARD_S4_S3 1 100 0 255 ECU_ADDRESS 0xFFF82A10 DISPLAY_IDENTIFIER ambient_condition[1][23].amb_cond.ydiBackupMemory_xau16[5].ZFEH_EepromData /end MEASUREMENT
/begin MEASUREMENT ZFEH_EepromData.ydiBackupMemory_xau16[5].amb_cond.ambient_condition[1][24] "ambient condition shot [0 .. 2-1] with 25 data bytes [0 .. 25-1] for the error code stored in this error memory slot" UBYTE EH_STANDARD_S4_S3 1 100 0 255 ECU_ADDRESS 0xFFF82A11 DISPLAY_IDENTIFIER ambient_condition[1][24].amb_cond.ydiBackupMemory_xau16[5].ZFEH_EepromData /end MEASUREMENT
/begin MEASUREMENT ZFEH_EepromData.ydiBackupMemory_xau16[5].amb_cond.ambient_condition[1][2] "ambient condition shot [0 .. 2-1] with 25 data bytes [0 .. 25-1] for the error code stored in this error memory slot" UBYTE EH_STANDARD_S4_S3 1 100 0 255 ECU_ADDRESS 0xFFF829FB DISPLAY_IDENTIFIER ambient_condition[1][2].amb_cond.ydiBackupMemory_xau16[5].ZFEH_EepromData /end MEASUREMENT
/begin MEASUREMENT ZFEH_EepromData.ydiBackupMemory_xau16[5].amb_cond.ambient_condition[1][3] "ambient condition shot [0 .. 2-1] with 25 data bytes [0 .. 25-1] for the error code stored in this error memory slot" UBYTE EH_STANDARD_S4_S3 1 100 0 255 ECU_ADDRESS 0xFFF829FC DISPLAY_IDENTIFIER ambient_condition[1][3].amb_cond.ydiBackupMemory_xau16[5].ZFEH_EepromData /end MEASUREMENT
/begin MEASUREMENT ZFEH_EepromData.ydiBackupMemory_xau16[5].amb_cond.ambient_condition[1][4] "ambient condition shot [0 .. 2-1] with 25 data bytes [0 .. 25-1] for the error code stored in this error memory slot" UBYTE EH_STANDARD_S4_S3 1 100 0 255 ECU_ADDRESS 0xFFF829FD DISPLAY_IDENTIFIER ambient_condition[1][4].amb_cond.ydiBackupMemory_xau16[5].ZFEH_EepromData /end MEASUREMENT
/begin MEASUREMENT ZFEH_EepromData.ydiBackupMemory_xau16[5].amb_cond.ambient_condition[1][5] "ambient condition shot [0 .. 2-1] with 25 data bytes [0 .. 25-1] for the error code stored in this error memory slot" UBYTE EH_STANDARD_S4_S3 1 100 0 255 ECU_ADDRESS 0xFFF829FE DISPLAY_IDENTIFIER ambient_condition[1][5].amb_cond.ydiBackupMemory_xau16[5].ZFEH_EepromData /end MEASUREMENT
/begin MEASUREMENT ZFEH_EepromData.ydiBackupMemory_xau16[5].amb_cond.ambient_condition[1][6] "ambient condition shot [0 .. 2-1] with 25 data bytes [0 .. 25-1] for the error code stored in this error memory slot" UBYTE EH_STANDARD_S4_S3 1 100 0 255 ECU_ADDRESS 0xFFF829FF DISPLAY_IDENTIFIER ambient_condition[1][6].amb_cond.ydiBackupMemory_xau16[5].ZFEH_EepromData /end MEASUREMENT
/begin MEASUREMENT ZFEH_EepromData.ydiBackupMemory_xau16[5].amb_cond.ambient_condition[1][7] "ambient condition shot [0 .. 2-1] with 25 data bytes [0 .. 25-1] for the error code stored in this error memory slot" UBYTE EH_STANDARD_S4_S3 1 100 0 255 ECU_ADDRESS 0xFFF82A00 DISPLAY_IDENTIFIER ambient_condition[1][7].amb_cond.ydiBackupMemory_xau16[5].ZFEH_EepromData /end MEASUREMENT
/begin MEASUREMENT ZFEH_EepromData.ydiBackupMemory_xau16[5].amb_cond.ambient_condition[1][8] "ambient condition shot [0 .. 2-1] with 25 data bytes [0 .. 25-1] for the error code stored in this error memory slot" UBYTE EH_STANDARD_S4_S3 1 100 0 255 ECU_ADDRESS 0xFFF82A01 DISPLAY_IDENTIFIER ambient_condition[1][8].amb_cond.ydiBackupMemory_xau16[5].ZFEH_EepromData /end MEASUREMENT
/begin MEASUREMENT ZFEH_EepromData.ydiBackupMemory_xau16[5].amb_cond.ambient_condition[1][9] "ambient condition shot [0 .. 2-1] with 25 data bytes [0 .. 25-1] for the error code stored in this error memory slot" UBYTE EH_STANDARD_S4_S3 1 100 0 255 ECU_ADDRESS 0xFFF82A02 DISPLAY_IDENTIFIER ambient_condition[1][9].amb_cond.ydiBackupMemory_xau16[5].ZFEH_EepromData /end MEASUREMENT
/begin MEASUREMENT ZFEH_EepromData.ydiBackupMemory_xau16[5].amb_cond.status_of_ambient_conditions[0] "status of ambient condition shot x: 0=invalid 1=valid" UBYTE EH_STANDARD_S4_S3 1 100 0 1 ECU_ADDRESS 0xFFF82A12 DISPLAY_IDENTIFIER status_of_ambient_conditions[0].amb_cond.ydiBackupMemory_xau16[5].ZFEH_EepromData /end MEASUREMENT
/begin MEASUREMENT ZFEH_EepromData.ydiBackupMemory_xau16[5].amb_cond.status_of_ambient_conditions[1] "status of ambient condition shot x: 0=invalid 1=valid" UBYTE EH_STANDARD_S4_S3 1 100 0 1 ECU_ADDRESS 0xFFF82A13 DISPLAY_IDENTIFIER status_of_ambient_conditions[1].amb_cond.ydiBackupMemory_xau16[5].ZFEH_EepromData /end MEASUREMENT
/begin MEASUREMENT ZFEH_EepromData.ydiBackupMemory_xau16[5].backwards_counter "backwards counter of error code stored in error memory slot" UBYTE EH_STANDARD_S4_S3 1 100 0 255 ECU_ADDRESS 0xFFF829D3 DISPLAY_IDENTIFIER backwards_counter.ydiBackupMemory_xau16[5].ZFEH_EepromData /end MEASUREMENT
/begin MEASUREMENT ZFEH_EepromData.ydiBackupMemory_xau16[5].condition_byte "condition byte of error code stored in error memory slot" UBYTE EH_STANDARD_S4_S3 1 100 0 255 ECU_ADDRESS 0xFFF829DD DISPLAY_IDENTIFIER condition_byte.ydiBackupMemory_xau16[5].ZFEH_EepromData /end MEASUREMENT
/begin MEASUREMENT ZFEH_EepromData.ydiBackupMemory_xau16[5].error_code "error code stored in error memory slot" UWORD EH_STANDARD_S4_S3 1 100 0 65535 ECU_ADDRESS 0xFFF829CC DISPLAY_IDENTIFIER error_code.ydiBackupMemory_xau16[5].ZFEH_EepromData /end MEASUREMENT
/begin MEASUREMENT ZFEH_EepromData.ydiBackupMemory_xau16[5].error_type "error type of error code stored in error memory slot" UWORD EH_STANDARD_S4_S3 1 100 0 65535 ECU_ADDRESS 0xFFF829CE DISPLAY_IDENTIFIER error_type.ydiBackupMemory_xau16[5].ZFEH_EepromData /end MEASUREMENT
/begin MEASUREMENT ZFEH_EepromData.ydiBackupMemory_xau16[5].frequency_counter "frequency counter of error code stored in error memory slot" UBYTE EH_STANDARD_S4_S3 1 100 0 255 ECU_ADDRESS 0xFFF829D2 DISPLAY_IDENTIFIER frequency_counter.ydiBackupMemory_xau16[5].ZFEH_EepromData /end MEASUREMENT
/begin MEASUREMENT ZFEH_EepromData.ydiBackupMemory_xau16[5].master_time "master time of error code stored in error memory slot" ULONG EH_STANDARD_S4_S3 1 100 0 4294967295 ECU_ADDRESS 0xFFF829D8 DISPLAY_IDENTIFIER master_time.ydiBackupMemory_xau16[5].ZFEH_EepromData /end MEASUREMENT
/begin MEASUREMENT ZFEH_EepromData.ydiBackupMemory_xau16[5].obd_driving_cycle_counter "obd driving cycle counter of error code stored in error memory slot" UWORD EH_STANDARD_S4_S3 1 100 0 65535 ECU_ADDRESS 0xFFF829DE DISPLAY_IDENTIFIER obd_driving_cycle_counter.ydiBackupMemory_xau16[5].ZFEH_EepromData /end MEASUREMENT
/begin MEASUREMENT ZFEH_EepromData.ydiBackupMemory_xau16[5].permanent_counter "counter of permanent error codes stored in error memory slot" UBYTE EH_STANDARD_S4_S3 1 100 0 255 ECU_ADDRESS 0xFFF829D4 DISPLAY_IDENTIFIER permanent_counter.ydiBackupMemory_xau16[5].ZFEH_EepromData /end MEASUREMENT
/begin MEASUREMENT ZFEH_EepromData.ydiBackupMemory_xau16[5].sequence_counter "sequence counter of error code stored in error memory slot" UBYTE EH_STANDARD_S4_S3 1 100 0 255 ECU_ADDRESS 0xFFF829D5 DISPLAY_IDENTIFIER sequence_counter.ydiBackupMemory_xau16[5].ZFEH_EepromData /end MEASUREMENT
/begin MEASUREMENT ZFEH_EepromData.ydiBackupMemory_xau16[5].status_word "status word of error code stored in error memory slot" UWORD EH_STANDARD_S4_S3 1 100 0 65535 ECU_ADDRESS 0xFFF829D0 DISPLAY_IDENTIFIER status_word.ydiBackupMemory_xau16[5].ZFEH_EepromData /end MEASUREMENT
/begin MEASUREMENT ZFEH_EepromData.ydiBackupMemory_xau16[6].amb_cond.ambient_condition[0][0] "ambient condition shot [0 .. 2-1] with 25 data bytes [0 .. 25-1] for the error code stored in this error memory slot" UBYTE EH_STANDARD_S4_S3 1 100 0 255 ECU_ADDRESS 0xFFF82A28 DISPLAY_IDENTIFIER ambient_condition[0][0].amb_cond.ydiBackupMemory_xau16[6].ZFEH_EepromData /end MEASUREMENT
/begin MEASUREMENT ZFEH_EepromData.ydiBackupMemory_xau16[6].amb_cond.ambient_condition[0][10] "ambient condition shot [0 .. 2-1] with 25 data bytes [0 .. 25-1] for the error code stored in this error memory slot" UBYTE EH_STANDARD_S4_S3 1 100 0 255 ECU_ADDRESS 0xFFF82A32 DISPLAY_IDENTIFIER ambient_condition[0][10].amb_cond.ydiBackupMemory_xau16[6].ZFEH_EepromData /end MEASUREMENT
/begin MEASUREMENT ZFEH_EepromData.ydiBackupMemory_xau16[6].amb_cond.ambient_condition[0][11] "ambient condition shot [0 .. 2-1] with 25 data bytes [0 .. 25-1] for the error code stored in this error memory slot" UBYTE EH_STANDARD_S4_S3 1 100 0 255 ECU_ADDRESS 0xFFF82A33 DISPLAY_IDENTIFIER ambient_condition[0][11].amb_cond.ydiBackupMemory_xau16[6].ZFEH_EepromData /end MEASUREMENT
/begin MEASUREMENT ZFEH_EepromData.ydiBackupMemory_xau16[6].amb_cond.ambient_condition[0][12] "ambient condition shot [0 .. 2-1] with 25 data bytes [0 .. 25-1] for the error code stored in this error memory slot" UBYTE EH_STANDARD_S4_S3 1 100 0 255 ECU_ADDRESS 0xFFF82A34 DISPLAY_IDENTIFIER ambient_condition[0][12].amb_cond.ydiBackupMemory_xau16[6].ZFEH_EepromData /end MEASUREMENT
/begin MEASUREMENT ZFEH_EepromData.ydiBackupMemory_xau16[6].amb_cond.ambient_condition[0][13] "ambient condition shot [0 .. 2-1] with 25 data bytes [0 .. 25-1] for the error code stored in this error memory slot" UBYTE EH_STANDARD_S4_S3 1 100 0 255 ECU_ADDRESS 0xFFF82A35 DISPLAY_IDENTIFIER ambient_condition[0][13].amb_cond.ydiBackupMemory_xau16[6].ZFEH_EepromData /end MEASUREMENT
/begin MEASUREMENT ZFEH_EepromData.ydiBackupMemory_xau16[6].amb_cond.ambient_condition[0][14] "ambient condition shot [0 .. 2-1] with 25 data bytes [0 .. 25-1] for the error code stored in this error memory slot" UBYTE EH_STANDARD_S4_S3 1 100 0 255 ECU_ADDRESS 0xFFF82A36 DISPLAY_IDENTIFIER ambient_condition[0][14].amb_cond.ydiBackupMemory_xau16[6].ZFEH_EepromData /end MEASUREMENT
/begin MEASUREMENT ZFEH_EepromData.ydiBackupMemory_xau16[6].amb_cond.ambient_condition[0][15] "ambient condition shot [0 .. 2-1] with 25 data bytes [0 .. 25-1] for the error code stored in this error memory slot" UBYTE EH_STANDARD_S4_S3 1 100 0 255 ECU_ADDRESS 0xFFF82A37 DISPLAY_IDENTIFIER ambient_condition[0][15].amb_cond.ydiBackupMemory_xau16[6].ZFEH_EepromData /end MEASUREMENT
/begin MEASUREMENT ZFEH_EepromData.ydiBackupMemory_xau16[6].amb_cond.ambient_condition[0][16] "ambient condition shot [0 .. 2-1] with 25 data bytes [0 .. 25-1] for the error code stored in this error memory slot" UBYTE EH_STANDARD_S4_S3 1 100 0 255 ECU_ADDRESS 0xFFF82A38 DISPLAY_IDENTIFIER ambient_condition[0][16].amb_cond.ydiBackupMemory_xau16[6].ZFEH_EepromData /end MEASUREMENT
/begin MEASUREMENT ZFEH_EepromData.ydiBackupMemory_xau16[6].amb_cond.ambient_condition[0][17] "ambient condition shot [0 .. 2-1] with 25 data bytes [0 .. 25-1] for the error code stored in this error memory slot" UBYTE EH_STANDARD_S4_S3 1 100 0 255 ECU_ADDRESS 0xFFF82A39 DISPLAY_IDENTIFIER ambient_condition[0][17].amb_cond.ydiBackupMemory_xau16[6].ZFEH_EepromData /end MEASUREMENT
/begin MEASUREMENT ZFEH_EepromData.ydiBackupMemory_xau16[6].amb_cond.ambient_condition[0][18] "ambient condition shot [0 .. 2-1] with 25 data bytes [0 .. 25-1] for the error code stored in this error memory slot" UBYTE EH_STANDARD_S4_S3 1 100 0 255 ECU_ADDRESS 0xFFF82A3A DISPLAY_IDENTIFIER ambient_condition[0][18].amb_cond.ydiBackupMemory_xau16[6].ZFEH_EepromData /end MEASUREMENT
/begin MEASUREMENT ZFEH_EepromData.ydiBackupMemory_xau16[6].amb_cond.ambient_condition[0][19] "ambient condition shot [0 .. 2-1] with 25 data bytes [0 .. 25-1] for the error code stored in this error memory slot" UBYTE EH_STANDARD_S4_S3 1 100 0 255 ECU_ADDRESS 0xFFF82A3B DISPLAY_IDENTIFIER ambient_condition[0][19].amb_cond.ydiBackupMemory_xau16[6].ZFEH_EepromData /end MEASUREMENT
/begin MEASUREMENT ZFEH_EepromData.ydiBackupMemory_xau16[6].amb_cond.ambient_condition[0][1] "ambient condition shot [0 .. 2-1] with 25 data bytes [0 .. 25-1] for the error code stored in this error memory slot" UBYTE EH_STANDARD_S4_S3 1 100 0 255 ECU_ADDRESS 0xFFF82A29 DISPLAY_IDENTIFIER ambient_condition[0][1].amb_cond.ydiBackupMemory_xau16[6].ZFEH_EepromData /end MEASUREMENT
/begin MEASUREMENT ZFEH_EepromData.ydiBackupMemory_xau16[6].amb_cond.ambient_condition[0][20] "ambient condition shot [0 .. 2-1] with 25 data bytes [0 .. 25-1] for the error code stored in this error memory slot" UBYTE EH_STANDARD_S4_S3 1 100 0 255 ECU_ADDRESS 0xFFF82A3C DISPLAY_IDENTIFIER ambient_condition[0][20].amb_cond.ydiBackupMemory_xau16[6].ZFEH_EepromData /end MEASUREMENT
/begin MEASUREMENT ZFEH_EepromData.ydiBackupMemory_xau16[6].amb_cond.ambient_condition[0][21] "ambient condition shot [0 .. 2-1] with 25 data bytes [0 .. 25-1] for the error code stored in this error memory slot" UBYTE EH_STANDARD_S4_S3 1 100 0 255 ECU_ADDRESS 0xFFF82A3D DISPLAY_IDENTIFIER ambient_condition[0][21].amb_cond.ydiBackupMemory_xau16[6].ZFEH_EepromData /end MEASUREMENT
/begin MEASUREMENT ZFEH_EepromData.ydiBackupMemory_xau16[6].amb_cond.ambient_condition[0][22] "ambient condition shot [0 .. 2-1] with 25 data bytes [0 .. 25-1] for the error code stored in this error memory slot" UBYTE EH_STANDARD_S4_S3 1 100 0 255 ECU_ADDRESS 0xFFF82A3E DISPLAY_IDENTIFIER ambient_condition[0][22].amb_cond.ydiBackupMemory_xau16[6].ZFEH_EepromData /end MEASUREMENT
/begin MEASUREMENT ZFEH_EepromData.ydiBackupMemory_xau16[6].amb_cond.ambient_condition[0][23] "ambient condition shot [0 .. 2-1] with 25 data bytes [0 .. 25-1] for the error code stored in this error memory slot" UBYTE EH_STANDARD_S4_S3 1 100 0 255 ECU_ADDRESS 0xFFF82A3F DISPLAY_IDENTIFIER ambient_condition[0][23].amb_cond.ydiBackupMemory_xau16[6].ZFEH_EepromData /end MEASUREMENT
/begin MEASUREMENT ZFEH_EepromData.ydiBackupMemory_xau16[6].amb_cond.ambient_condition[0][24] "ambient condition shot [0 .. 2-1] with 25 data bytes [0 .. 25-1] for the error code stored in this error memory slot" UBYTE EH_STANDARD_S4_S3 1 100 0 255 ECU_ADDRESS 0xFFF82A40 DISPLAY_IDENTIFIER ambient_condition[0][24].amb_cond.ydiBackupMemory_xau16[6].ZFEH_EepromData /end MEASUREMENT
/begin MEASUREMENT ZFEH_EepromData.ydiBackupMemory_xau16[6].amb_cond.ambient_condition[0][2] "ambient condition shot [0 .. 2-1] with 25 data bytes [0 .. 25-1] for the error code stored in this error memory slot" UBYTE EH_STANDARD_S4_S3 1 100 0 255 ECU_ADDRESS 0xFFF82A2A DISPLAY_IDENTIFIER ambient_condition[0][2].amb_cond.ydiBackupMemory_xau16[6].ZFEH_EepromData /end MEASUREMENT
/begin MEASUREMENT ZFEH_EepromData.ydiBackupMemory_xau16[6].amb_cond.ambient_condition[0][3] "ambient condition shot [0 .. 2-1] with 25 data bytes [0 .. 25-1] for the error code stored in this error memory slot" UBYTE EH_STANDARD_S4_S3 1 100 0 255 ECU_ADDRESS 0xFFF82A2B DISPLAY_IDENTIFIER ambient_condition[0][3].amb_cond.ydiBackupMemory_xau16[6].ZFEH_EepromData /end MEASUREMENT
/begin MEASUREMENT ZFEH_EepromData.ydiBackupMemory_xau16[6].amb_cond.ambient_condition[0][4] "ambient condition shot [0 .. 2-1] with 25 data bytes [0 .. 25-1] for the error code stored in this error memory slot" UBYTE EH_STANDARD_S4_S3 1 100 0 255 ECU_ADDRESS 0xFFF82A2C DISPLAY_IDENTIFIER ambient_condition[0][4].amb_cond.ydiBackupMemory_xau16[6].ZFEH_EepromData /end MEASUREMENT
/begin MEASUREMENT ZFEH_EepromData.ydiBackupMemory_xau16[6].amb_cond.ambient_condition[0][5] "ambient condition shot [0 .. 2-1] with 25 data bytes [0 .. 25-1] for the error code stored in this error memory slot" UBYTE EH_STANDARD_S4_S3 1 100 0 255 ECU_ADDRESS 0xFFF82A2D DISPLAY_IDENTIFIER ambient_condition[0][5].amb_cond.ydiBackupMemory_xau16[6].ZFEH_EepromData /end MEASUREMENT
/begin MEASUREMENT ZFEH_EepromData.ydiBackupMemory_xau16[6].amb_cond.ambient_condition[0][6] "ambient condition shot [0 .. 2-1] with 25 data bytes [0 .. 25-1] for the error code stored in this error memory slot" UBYTE EH_STANDARD_S4_S3 1 100 0 255 ECU_ADDRESS 0xFFF82A2E DISPLAY_IDENTIFIER ambient_condition[0][6].amb_cond.ydiBackupMemory_xau16[6].ZFEH_EepromData /end MEASUREMENT
/begin MEASUREMENT ZFEH_EepromData.ydiBackupMemory_xau16[6].amb_cond.ambient_condition[0][7] "ambient condition shot [0 .. 2-1] with 25 data bytes [0 .. 25-1] for the error code stored in this error memory slot" UBYTE EH_STANDARD_S4_S3 1 100 0 255 ECU_ADDRESS 0xFFF82A2F DISPLAY_IDENTIFIER ambient_condition[0][7].amb_cond.ydiBackupMemory_xau16[6].ZFEH_EepromData /end MEASUREMENT
/begin MEASUREMENT ZFEH_EepromData.ydiBackupMemory_xau16[6].amb_cond.ambient_condition[0][8] "ambient condition shot [0 .. 2-1] with 25 data bytes [0 .. 25-1] for the error code stored in this error memory slot" UBYTE EH_STANDARD_S4_S3 1 100 0 255 ECU_ADDRESS 0xFFF82A30 DISPLAY_IDENTIFIER ambient_condition[0][8].amb_cond.ydiBackupMemory_xau16[6].ZFEH_EepromData /end MEASUREMENT
/begin MEASUREMENT ZFEH_EepromData.ydiBackupMemory_xau16[6].amb_cond.ambient_condition[0][9] "ambient condition shot [0 .. 2-1] with 25 data bytes [0 .. 25-1] for the error code stored in this error memory slot" UBYTE EH_STANDARD_S4_S3 1 100 0 255 ECU_ADDRESS 0xFFF82A31 DISPLAY_IDENTIFIER ambient_condition[0][9].amb_cond.ydiBackupMemory_xau16[6].ZFEH_EepromData /end MEASUREMENT
/begin MEASUREMENT ZFEH_EepromData.ydiBackupMemory_xau16[6].amb_cond.ambient_condition[1][0] "ambient condition shot [0 .. 2-1] with 25 data bytes [0 .. 25-1] for the error code stored in this error memory slot" UBYTE EH_STANDARD_S4_S3 1 100 0 255 ECU_ADDRESS 0xFFF82A41 DISPLAY_IDENTIFIER ambient_condition[1][0].amb_cond.ydiBackupMemory_xau16[6].ZFEH_EepromData /end MEASUREMENT
/begin MEASUREMENT ZFEH_EepromData.ydiBackupMemory_xau16[6].amb_cond.ambient_condition[1][10] "ambient condition shot [0 .. 2-1] with 25 data bytes [0 .. 25-1] for the error code stored in this error memory slot" UBYTE EH_STANDARD_S4_S3 1 100 0 255 ECU_ADDRESS 0xFFF82A4B DISPLAY_IDENTIFIER ambient_condition[1][10].amb_cond.ydiBackupMemory_xau16[6].ZFEH_EepromData /end MEASUREMENT
/begin MEASUREMENT ZFEH_EepromData.ydiBackupMemory_xau16[6].amb_cond.ambient_condition[1][11] "ambient condition shot [0 .. 2-1] with 25 data bytes [0 .. 25-1] for the error code stored in this error memory slot" UBYTE EH_STANDARD_S4_S3 1 100 0 255 ECU_ADDRESS 0xFFF82A4C DISPLAY_IDENTIFIER ambient_condition[1][11].amb_cond.ydiBackupMemory_xau16[6].ZFEH_EepromData /end MEASUREMENT
/begin MEASUREMENT ZFEH_EepromData.ydiBackupMemory_xau16[6].amb_cond.ambient_condition[1][12] "ambient condition shot [0 .. 2-1] with 25 data bytes [0 .. 25-1] for the error code stored in this error memory slot" UBYTE EH_STANDARD_S4_S3 1 100 0 255 ECU_ADDRESS 0xFFF82A4D DISPLAY_IDENTIFIER ambient_condition[1][12].amb_cond.ydiBackupMemory_xau16[6].ZFEH_EepromData /end MEASUREMENT
/begin MEASUREMENT ZFEH_EepromData.ydiBackupMemory_xau16[6].amb_cond.ambient_condition[1][13] "ambient condition shot [0 .. 2-1] with 25 data bytes [0 .. 25-1] for the error code stored in this error memory slot" UBYTE EH_STANDARD_S4_S3 1 100 0 255 ECU_ADDRESS 0xFFF82A4E DISPLAY_IDENTIFIER ambient_condition[1][13].amb_cond.ydiBackupMemory_xau16[6].ZFEH_EepromData /end MEASUREMENT
/begin MEASUREMENT ZFEH_EepromData.ydiBackupMemory_xau16[6].amb_cond.ambient_condition[1][14] "ambient condition shot [0 .. 2-1] with 25 data bytes [0 .. 25-1] for the error code stored in this error memory slot" UBYTE EH_STANDARD_S4_S3 1 100 0 255 ECU_ADDRESS 0xFFF82A4F DISPLAY_IDENTIFIER ambient_condition[1][14].amb_cond.ydiBackupMemory_xau16[6].ZFEH_EepromData /end MEASUREMENT
/begin MEASUREMENT ZFEH_EepromData.ydiBackupMemory_xau16[6].amb_cond.ambient_condition[1][15] "ambient condition shot [0 .. 2-1] with 25 data bytes [0 .. 25-1] for the error code stored in this error memory slot" UBYTE EH_STANDARD_S4_S3 1 100 0 255 ECU_ADDRESS 0xFFF82A50 DISPLAY_IDENTIFIER ambient_condition[1][15].amb_cond.ydiBackupMemory_xau16[6].ZFEH_EepromData /end MEASUREMENT
/begin MEASUREMENT ZFEH_EepromData.ydiBackupMemory_xau16[6].amb_cond.ambient_condition[1][16] "ambient condition shot [0 .. 2-1] with 25 data bytes [0 .. 25-1] for the error code stored in this error memory slot" UBYTE EH_STANDARD_S4_S3 1 100 0 255 ECU_ADDRESS 0xFFF82A51 DISPLAY_IDENTIFIER ambient_condition[1][16].amb_cond.ydiBackupMemory_xau16[6].ZFEH_EepromData /end MEASUREMENT
/begin MEASUREMENT ZFEH_EepromData.ydiBackupMemory_xau16[6].amb_cond.ambient_condition[1][17] "ambient condition shot [0 .. 2-1] with 25 data bytes [0 .. 25-1] for the error code stored in this error memory slot" UBYTE EH_STANDARD_S4_S3 1 100 0 255 ECU_ADDRESS 0xFFF82A52 DISPLAY_IDENTIFIER ambient_condition[1][17].amb_cond.ydiBackupMemory_xau16[6].ZFEH_EepromData /end MEASUREMENT
/begin MEASUREMENT ZFEH_EepromData.ydiBackupMemory_xau16[6].amb_cond.ambient_condition[1][18] "ambient condition shot [0 .. 2-1] with 25 data bytes [0 .. 25-1] for the error code stored in this error memory slot" UBYTE EH_STANDARD_S4_S3 1 100 0 255 ECU_ADDRESS 0xFFF82A53 DISPLAY_IDENTIFIER ambient_condition[1][18].amb_cond.ydiBackupMemory_xau16[6].ZFEH_EepromData /end MEASUREMENT
/begin MEASUREMENT ZFEH_EepromData.ydiBackupMemory_xau16[6].amb_cond.ambient_condition[1][19] "ambient condition shot [0 .. 2-1] with 25 data bytes [0 .. 25-1] for the error code stored in this error memory slot" UBYTE EH_STANDARD_S4_S3 1 100 0 255 ECU_ADDRESS 0xFFF82A54 DISPLAY_IDENTIFIER ambient_condition[1][19].amb_cond.ydiBackupMemory_xau16[6].ZFEH_EepromData /end MEASUREMENT
/begin MEASUREMENT ZFEH_EepromData.ydiBackupMemory_xau16[6].amb_cond.ambient_condition[1][1] "ambient condition shot [0 .. 2-1] with 25 data bytes [0 .. 25-1] for the error code stored in this error memory slot" UBYTE EH_STANDARD_S4_S3 1 100 0 255 ECU_ADDRESS 0xFFF82A42 DISPLAY_IDENTIFIER ambient_condition[1][1].amb_cond.ydiBackupMemory_xau16[6].ZFEH_EepromData /end MEASUREMENT
/begin MEASUREMENT ZFEH_EepromData.ydiBackupMemory_xau16[6].amb_cond.ambient_condition[1][20] "ambient condition shot [0 .. 2-1] with 25 data bytes [0 .. 25-1] for the error code stored in this error memory slot" UBYTE EH_STANDARD_S4_S3 1 100 0 255 ECU_ADDRESS 0xFFF82A55 DISPLAY_IDENTIFIER ambient_condition[1][20].amb_cond.ydiBackupMemory_xau16[6].ZFEH_EepromData /end MEASUREMENT
/begin MEASUREMENT ZFEH_EepromData.ydiBackupMemory_xau16[6].amb_cond.ambient_condition[1][21] "ambient condition shot [0 .. 2-1] with 25 data bytes [0 .. 25-1] for the error code stored in this error memory slot" UBYTE EH_STANDARD_S4_S3 1 100 0 255 ECU_ADDRESS 0xFFF82A56 DISPLAY_IDENTIFIER ambient_condition[1][21].amb_cond.ydiBackupMemory_xau16[6].ZFEH_EepromData /end MEASUREMENT
/begin MEASUREMENT ZFEH_EepromData.ydiBackupMemory_xau16[6].amb_cond.ambient_condition[1][22] "ambient condition shot [0 .. 2-1] with 25 data bytes [0 .. 25-1] for the error code stored in this error memory slot" UBYTE EH_STANDARD_S4_S3 1 100 0 255 ECU_ADDRESS 0xFFF82A57 DISPLAY_IDENTIFIER ambient_condition[1][22].amb_cond.ydiBackupMemory_xau16[6].ZFEH_EepromData /end MEASUREMENT
/begin MEASUREMENT ZFEH_EepromData.ydiBackupMemory_xau16[6].amb_cond.ambient_condition[1][23] "ambient condition shot [0 .. 2-1] with 25 data bytes [0 .. 25-1] for the error code stored in this error memory slot" UBYTE EH_STANDARD_S4_S3 1 100 0 255 ECU_ADDRESS 0xFFF82A58 DISPLAY_IDENTIFIER ambient_condition[1][23].amb_cond.ydiBackupMemory_xau16[6].ZFEH_EepromData /end MEASUREMENT
/begin MEASUREMENT ZFEH_EepromData.ydiBackupMemory_xau16[6].amb_cond.ambient_condition[1][24] "ambient condition shot [0 .. 2-1] with 25 data bytes [0 .. 25-1] for the error code stored in this error memory slot" UBYTE EH_STANDARD_S4_S3 1 100 0 255 ECU_ADDRESS 0xFFF82A59 DISPLAY_IDENTIFIER ambient_condition[1][24].amb_cond.ydiBackupMemory_xau16[6].ZFEH_EepromData /end MEASUREMENT
/begin MEASUREMENT ZFEH_EepromData.ydiBackupMemory_xau16[6].amb_cond.ambient_condition[1][2] "ambient condition shot [0 .. 2-1] with 25 data bytes [0 .. 25-1] for the error code stored in this error memory slot" UBYTE EH_STANDARD_S4_S3 1 100 0 255 ECU_ADDRESS 0xFFF82A43 DISPLAY_IDENTIFIER ambient_condition[1][2].amb_cond.ydiBackupMemory_xau16[6].ZFEH_EepromData /end MEASUREMENT
/begin MEASUREMENT ZFEH_EepromData.ydiBackupMemory_xau16[6].amb_cond.ambient_condition[1][3] "ambient condition shot [0 .. 2-1] with 25 data bytes [0 .. 25-1] for the error code stored in this error memory slot" UBYTE EH_STANDARD_S4_S3 1 100 0 255 ECU_ADDRESS 0xFFF82A44 DISPLAY_IDENTIFIER ambient_condition[1][3].amb_cond.ydiBackupMemory_xau16[6].ZFEH_EepromData /end MEASUREMENT
/begin MEASUREMENT ZFEH_EepromData.ydiBackupMemory_xau16[6].amb_cond.ambient_condition[1][4] "ambient condition shot [0 .. 2-1] with 25 data bytes [0 .. 25-1] for the error code stored in this error memory slot" UBYTE EH_STANDARD_S4_S3 1 100 0 255 ECU_ADDRESS 0xFFF82A45 DISPLAY_IDENTIFIER ambient_condition[1][4].amb_cond.ydiBackupMemory_xau16[6].ZFEH_EepromData /end MEASUREMENT
/begin MEASUREMENT ZFEH_EepromData.ydiBackupMemory_xau16[6].amb_cond.ambient_condition[1][5] "ambient condition shot [0 .. 2-1] with 25 data bytes [0 .. 25-1] for the error code stored in this error memory slot" UBYTE EH_STANDARD_S4_S3 1 100 0 255 ECU_ADDRESS 0xFFF82A46 DISPLAY_IDENTIFIER ambient_condition[1][5].amb_cond.ydiBackupMemory_xau16[6].ZFEH_EepromData /end MEASUREMENT
/begin MEASUREMENT ZFEH_EepromData.ydiBackupMemory_xau16[6].amb_cond.ambient_condition[1][6] "ambient condition shot [0 .. 2-1] with 25 data bytes [0 .. 25-1] for the error code stored in this error memory slot" UBYTE EH_STANDARD_S4_S3 1 100 0 255 ECU_ADDRESS 0xFFF82A47 DISPLAY_IDENTIFIER ambient_condition[1][6].amb_cond.ydiBackupMemory_xau16[6].ZFEH_EepromData /end MEASUREMENT
/begin MEASUREMENT ZFEH_EepromData.ydiBackupMemory_xau16[6].amb_cond.ambient_condition[1][7] "ambient condition shot [0 .. 2-1] with 25 data bytes [0 .. 25-1] for the error code stored in this error memory slot" UBYTE EH_STANDARD_S4_S3 1 100 0 255 ECU_ADDRESS 0xFFF82A48 DISPLAY_IDENTIFIER ambient_condition[1][7].amb_cond.ydiBackupMemory_xau16[6].ZFEH_EepromData /end MEASUREMENT
/begin MEASUREMENT ZFEH_EepromData.ydiBackupMemory_xau16[6].amb_cond.ambient_condition[1][8] "ambient condition shot [0 .. 2-1] with 25 data bytes [0 .. 25-1] for the error code stored in this error memory slot" UBYTE EH_STANDARD_S4_S3 1 100 0 255 ECU_ADDRESS 0xFFF82A49 DISPLAY_IDENTIFIER ambient_condition[1][8].amb_cond.ydiBackupMemory_xau16[6].ZFEH_EepromData /end MEASUREMENT
/begin MEASUREMENT ZFEH_EepromData.ydiBackupMemory_xau16[6].amb_cond.ambient_condition[1][9] "ambient condition shot [0 .. 2-1] with 25 data bytes [0 .. 25-1] for the error code stored in this error memory slot" UBYTE EH_STANDARD_S4_S3 1 100 0 255 ECU_ADDRESS 0xFFF82A4A DISPLAY_IDENTIFIER ambient_condition[1][9].amb_cond.ydiBackupMemory_xau16[6].ZFEH_EepromData /end MEASUREMENT
/begin MEASUREMENT ZFEH_EepromData.ydiBackupMemory_xau16[6].amb_cond.status_of_ambient_conditions[0] "status of ambient condition shot x: 0=invalid 1=valid" UBYTE EH_STANDARD_S4_S3 1 100 0 1 ECU_ADDRESS 0xFFF82A5A DISPLAY_IDENTIFIER status_of_ambient_conditions[0].amb_cond.ydiBackupMemory_xau16[6].ZFEH_EepromData /end MEASUREMENT
/begin MEASUREMENT ZFEH_EepromData.ydiBackupMemory_xau16[6].amb_cond.status_of_ambient_conditions[1] "status of ambient condition shot x: 0=invalid 1=valid" UBYTE EH_STANDARD_S4_S3 1 100 0 1 ECU_ADDRESS 0xFFF82A5B DISPLAY_IDENTIFIER status_of_ambient_conditions[1].amb_cond.ydiBackupMemory_xau16[6].ZFEH_EepromData /end MEASUREMENT
/begin MEASUREMENT ZFEH_EepromData.ydiBackupMemory_xau16[6].backwards_counter "backwards counter of error code stored in error memory slot" UBYTE EH_STANDARD_S4_S3 1 100 0 255 ECU_ADDRESS 0xFFF82A1B DISPLAY_IDENTIFIER backwards_counter.ydiBackupMemory_xau16[6].ZFEH_EepromData /end MEASUREMENT
/begin MEASUREMENT ZFEH_EepromData.ydiBackupMemory_xau16[6].condition_byte "condition byte of error code stored in error memory slot" UBYTE EH_STANDARD_S4_S3 1 100 0 255 ECU_ADDRESS 0xFFF82A25 DISPLAY_IDENTIFIER condition_byte.ydiBackupMemory_xau16[6].ZFEH_EepromData /end MEASUREMENT
/begin MEASUREMENT ZFEH_EepromData.ydiBackupMemory_xau16[6].error_code "error code stored in error memory slot" UWORD EH_STANDARD_S4_S3 1 100 0 65535 ECU_ADDRESS 0xFFF82A14 DISPLAY_IDENTIFIER error_code.ydiBackupMemory_xau16[6].ZFEH_EepromData /end MEASUREMENT
/begin MEASUREMENT ZFEH_EepromData.ydiBackupMemory_xau16[6].error_type "error type of error code stored in error memory slot" UWORD EH_STANDARD_S4_S3 1 100 0 65535 ECU_ADDRESS 0xFFF82A16 DISPLAY_IDENTIFIER error_type.ydiBackupMemory_xau16[6].ZFEH_EepromData /end MEASUREMENT
/begin MEASUREMENT ZFEH_EepromData.ydiBackupMemory_xau16[6].frequency_counter "frequency counter of error code stored in error memory slot" UBYTE EH_STANDARD_S4_S3 1 100 0 255 ECU_ADDRESS 0xFFF82A1A DISPLAY_IDENTIFIER frequency_counter.ydiBackupMemory_xau16[6].ZFEH_EepromData /end MEASUREMENT
/begin MEASUREMENT ZFEH_EepromData.ydiBackupMemory_xau16[6].master_time "master time of error code stored in error memory slot" ULONG EH_STANDARD_S4_S3 1 100 0 4294967295 ECU_ADDRESS 0xFFF82A20 DISPLAY_IDENTIFIER master_time.ydiBackupMemory_xau16[6].ZFEH_EepromData /end MEASUREMENT
/begin MEASUREMENT ZFEH_EepromData.ydiBackupMemory_xau16[6].obd_driving_cycle_counter "obd driving cycle counter of error code stored in error memory slot" UWORD EH_STANDARD_S4_S3 1 100 0 65535 ECU_ADDRESS 0xFFF82A26 DISPLAY_IDENTIFIER obd_driving_cycle_counter.ydiBackupMemory_xau16[6].ZFEH_EepromData /end MEASUREMENT
/begin MEASUREMENT ZFEH_EepromData.ydiBackupMemory_xau16[6].permanent_counter "counter of permanent error codes stored in error memory slot" UBYTE EH_STANDARD_S4_S3 1 100 0 255 ECU_ADDRESS 0xFFF82A1C DISPLAY_IDENTIFIER permanent_counter.ydiBackupMemory_xau16[6].ZFEH_EepromData /end MEASUREMENT
/begin MEASUREMENT ZFEH_EepromData.ydiBackupMemory_xau16[6].sequence_counter "sequence counter of error code stored in error memory slot" UBYTE EH_STANDARD_S4_S3 1 100 0 255 ECU_ADDRESS 0xFFF82A1D DISPLAY_IDENTIFIER sequence_counter.ydiBackupMemory_xau16[6].ZFEH_EepromData /end MEASUREMENT
/begin MEASUREMENT ZFEH_EepromData.ydiBackupMemory_xau16[6].status_word "status word of error code stored in error memory slot" UWORD EH_STANDARD_S4_S3 1 100 0 65535 ECU_ADDRESS 0xFFF82A18 DISPLAY_IDENTIFIER status_word.ydiBackupMemory_xau16[6].ZFEH_EepromData /end MEASUREMENT
/begin MEASUREMENT ZFEH_EepromData.ydiBackupMemory_xau16[7].amb_cond.ambient_condition[0][0] "ambient condition shot [0 .. 2-1] with 25 data bytes [0 .. 25-1] for the error code stored in this error memory slot" UBYTE EH_STANDARD_S4_S3 1 100 0 255 ECU_ADDRESS 0xFFF82A70 DISPLAY_IDENTIFIER ambient_condition[0][0].amb_cond.ydiBackupMemory_xau16[7].ZFEH_EepromData /end MEASUREMENT
/begin MEASUREMENT ZFEH_EepromData.ydiBackupMemory_xau16[7].amb_cond.ambient_condition[0][10] "ambient condition shot [0 .. 2-1] with 25 data bytes [0 .. 25-1] for the error code stored in this error memory slot" UBYTE EH_STANDARD_S4_S3 1 100 0 255 ECU_ADDRESS 0xFFF82A7A DISPLAY_IDENTIFIER ambient_condition[0][10].amb_cond.ydiBackupMemory_xau16[7].ZFEH_EepromData /end MEASUREMENT
/begin MEASUREMENT ZFEH_EepromData.ydiBackupMemory_xau16[7].amb_cond.ambient_condition[0][11] "ambient condition shot [0 .. 2-1] with 25 data bytes [0 .. 25-1] for the error code stored in this error memory slot" UBYTE EH_STANDARD_S4_S3 1 100 0 255 ECU_ADDRESS 0xFFF82A7B DISPLAY_IDENTIFIER ambient_condition[0][11].amb_cond.ydiBackupMemory_xau16[7].ZFEH_EepromData /end MEASUREMENT
/begin MEASUREMENT ZFEH_EepromData.ydiBackupMemory_xau16[7].amb_cond.ambient_condition[0][12] "ambient condition shot [0 .. 2-1] with 25 data bytes [0 .. 25-1] for the error code stored in this error memory slot" UBYTE EH_STANDARD_S4_S3 1 100 0 255 ECU_ADDRESS 0xFFF82A7C DISPLAY_IDENTIFIER ambient_condition[0][12].amb_cond.ydiBackupMemory_xau16[7].ZFEH_EepromData /end MEASUREMENT
/begin MEASUREMENT ZFEH_EepromData.ydiBackupMemory_xau16[7].amb_cond.ambient_condition[0][13] "ambient condition shot [0 .. 2-1] with 25 data bytes [0 .. 25-1] for the error code stored in this error memory slot" UBYTE EH_STANDARD_S4_S3 1 100 0 255 ECU_ADDRESS 0xFFF82A7D DISPLAY_IDENTIFIER ambient_condition[0][13].amb_cond.ydiBackupMemory_xau16[7].ZFEH_EepromData /end MEASUREMENT
/begin MEASUREMENT ZFEH_EepromData.ydiBackupMemory_xau16[7].amb_cond.ambient_condition[0][14] "ambient condition shot [0 .. 2-1] with 25 data bytes [0 .. 25-1] for the error code stored in this error memory slot" UBYTE EH_STANDARD_S4_S3 1 100 0 255 ECU_ADDRESS 0xFFF82A7E DISPLAY_IDENTIFIER ambient_condition[0][14].amb_cond.ydiBackupMemory_xau16[7].ZFEH_EepromData /end MEASUREMENT
/begin MEASUREMENT ZFEH_EepromData.ydiBackupMemory_xau16[7].amb_cond.ambient_condition[0][15] "ambient condition shot [0 .. 2-1] with 25 data bytes [0 .. 25-1] for the error code stored in this error memory slot" UBYTE EH_STANDARD_S4_S3 1 100 0 255 ECU_ADDRESS 0xFFF82A7F DISPLAY_IDENTIFIER ambient_condition[0][15].amb_cond.ydiBackupMemory_xau16[7].ZFEH_EepromData /end MEASUREMENT
/begin MEASUREMENT ZFEH_EepromData.ydiBackupMemory_xau16[7].amb_cond.ambient_condition[0][16] "ambient condition shot [0 .. 2-1] with 25 data bytes [0 .. 25-1] for the error code stored in this error memory slot" UBYTE EH_STANDARD_S4_S3 1 100 0 255 ECU_ADDRESS 0xFFF82A80 DISPLAY_IDENTIFIER ambient_condition[0][16].amb_cond.ydiBackupMemory_xau16[7].ZFEH_EepromData /end MEASUREMENT
/begin MEASUREMENT ZFEH_EepromData.ydiBackupMemory_xau16[7].amb_cond.ambient_condition[0][17] "ambient condition shot [0 .. 2-1] with 25 data bytes [0 .. 25-1] for the error code stored in this error memory slot" UBYTE EH_STANDARD_S4_S3 1 100 0 255 ECU_ADDRESS 0xFFF82A81 DISPLAY_IDENTIFIER ambient_condition[0][17].amb_cond.ydiBackupMemory_xau16[7].ZFEH_EepromData /end MEASUREMENT
/begin MEASUREMENT ZFEH_EepromData.ydiBackupMemory_xau16[7].amb_cond.ambient_condition[0][18] "ambient condition shot [0 .. 2-1] with 25 data bytes [0 .. 25-1] for the error code stored in this error memory slot" UBYTE EH_STANDARD_S4_S3 1 100 0 255 ECU_ADDRESS 0xFFF82A82 DISPLAY_IDENTIFIER ambient_condition[0][18].amb_cond.ydiBackupMemory_xau16[7].ZFEH_EepromData /end MEASUREMENT
/begin MEASUREMENT ZFEH_EepromData.ydiBackupMemory_xau16[7].amb_cond.ambient_condition[0][19] "ambient condition shot [0 .. 2-1] with 25 data bytes [0 .. 25-1] for the error code stored in this error memory slot" UBYTE EH_STANDARD_S4_S3 1 100 0 255 ECU_ADDRESS 0xFFF82A83 DISPLAY_IDENTIFIER ambient_condition[0][19].amb_cond.ydiBackupMemory_xau16[7].ZFEH_EepromData /end MEASUREMENT
/begin MEASUREMENT ZFEH_EepromData.ydiBackupMemory_xau16[7].amb_cond.ambient_condition[0][1] "ambient condition shot [0 .. 2-1] with 25 data bytes [0 .. 25-1] for the error code stored in this error memory slot" UBYTE EH_STANDARD_S4_S3 1 100 0 255 ECU_ADDRESS 0xFFF82A71 DISPLAY_IDENTIFIER ambient_condition[0][1].amb_cond.ydiBackupMemory_xau16[7].ZFEH_EepromData /end MEASUREMENT
/begin MEASUREMENT ZFEH_EepromData.ydiBackupMemory_xau16[7].amb_cond.ambient_condition[0][20] "ambient condition shot [0 .. 2-1] with 25 data bytes [0 .. 25-1] for the error code stored in this error memory slot" UBYTE EH_STANDARD_S4_S3 1 100 0 255 ECU_ADDRESS 0xFFF82A84 DISPLAY_IDENTIFIER ambient_condition[0][20].amb_cond.ydiBackupMemory_xau16[7].ZFEH_EepromData /end MEASUREMENT
/begin MEASUREMENT ZFEH_EepromData.ydiBackupMemory_xau16[7].amb_cond.ambient_condition[0][21] "ambient condition shot [0 .. 2-1] with 25 data bytes [0 .. 25-1] for the error code stored in this error memory slot" UBYTE EH_STANDARD_S4_S3 1 100 0 255 ECU_ADDRESS 0xFFF82A85 DISPLAY_IDENTIFIER ambient_condition[0][21].amb_cond.ydiBackupMemory_xau16[7].ZFEH_EepromData /end MEASUREMENT
/begin MEASUREMENT ZFEH_EepromData.ydiBackupMemory_xau16[7].amb_cond.ambient_condition[0][22] "ambient condition shot [0 .. 2-1] with 25 data bytes [0 .. 25-1] for the error code stored in this error memory slot" UBYTE EH_STANDARD_S4_S3 1 100 0 255 ECU_ADDRESS 0xFFF82A86 DISPLAY_IDENTIFIER ambient_condition[0][22].amb_cond.ydiBackupMemory_xau16[7].ZFEH_EepromData /end MEASUREMENT
/begin MEASUREMENT ZFEH_EepromData.ydiBackupMemory_xau16[7].amb_cond.ambient_condition[0][23] "ambient condition shot [0 .. 2-1] with 25 data bytes [0 .. 25-1] for the error code stored in this error memory slot" UBYTE EH_STANDARD_S4_S3 1 100 0 255 ECU_ADDRESS 0xFFF82A87 DISPLAY_IDENTIFIER ambient_condition[0][23].amb_cond.ydiBackupMemory_xau16[7].ZFEH_EepromData /end MEASUREMENT
/begin MEASUREMENT ZFEH_EepromData.ydiBackupMemory_xau16[7].amb_cond.ambient_condition[0][24] "ambient condition shot [0 .. 2-1] with 25 data bytes [0 .. 25-1] for the error code stored in this error memory slot" UBYTE EH_STANDARD_S4_S3 1 100 0 255 ECU_ADDRESS 0xFFF82A88 DISPLAY_IDENTIFIER ambient_condition[0][24].amb_cond.ydiBackupMemory_xau16[7].ZFEH_EepromData /end MEASUREMENT
/begin MEASUREMENT ZFEH_EepromData.ydiBackupMemory_xau16[7].amb_cond.ambient_condition[0][2] "ambient condition shot [0 .. 2-1] with 25 data bytes [0 .. 25-1] for the error code stored in this error memory slot" UBYTE EH_STANDARD_S4_S3 1 100 0 255 ECU_ADDRESS 0xFFF82A72 DISPLAY_IDENTIFIER ambient_condition[0][2].amb_cond.ydiBackupMemory_xau16[7].ZFEH_EepromData /end MEASUREMENT
/begin MEASUREMENT ZFEH_EepromData.ydiBackupMemory_xau16[7].amb_cond.ambient_condition[0][3] "ambient condition shot [0 .. 2-1] with 25 data bytes [0 .. 25-1] for the error code stored in this error memory slot" UBYTE EH_STANDARD_S4_S3 1 100 0 255 ECU_ADDRESS 0xFFF82A73 DISPLAY_IDENTIFIER ambient_condition[0][3].amb_cond.ydiBackupMemory_xau16[7].ZFEH_EepromData /end MEASUREMENT
/begin MEASUREMENT ZFEH_EepromData.ydiBackupMemory_xau16[7].amb_cond.ambient_condition[0][4] "ambient condition shot [0 .. 2-1] with 25 data bytes [0 .. 25-1] for the error code stored in this error memory slot" UBYTE EH_STANDARD_S4_S3 1 100 0 255 ECU_ADDRESS 0xFFF82A74 DISPLAY_IDENTIFIER ambient_condition[0][4].amb_cond.ydiBackupMemory_xau16[7].ZFEH_EepromData /end MEASUREMENT
/begin MEASUREMENT ZFEH_EepromData.ydiBackupMemory_xau16[7].amb_cond.ambient_condition[0][5] "ambient condition shot [0 .. 2-1] with 25 data bytes [0 .. 25-1] for the error code stored in this error memory slot" UBYTE EH_STANDARD_S4_S3 1 100 0 255 ECU_ADDRESS 0xFFF82A75 DISPLAY_IDENTIFIER ambient_condition[0][5].amb_cond.ydiBackupMemory_xau16[7].ZFEH_EepromData /end MEASUREMENT
/begin MEASUREMENT ZFEH_EepromData.ydiBackupMemory_xau16[7].amb_cond.ambient_condition[0][6] "ambient condition shot [0 .. 2-1] with 25 data bytes [0 .. 25-1] for the error code stored in this error memory slot" UBYTE EH_STANDARD_S4_S3 1 100 0 255 ECU_ADDRESS 0xFFF82A76 DISPLAY_IDENTIFIER ambient_condition[0][6].amb_cond.ydiBackupMemory_xau16[7].ZFEH_EepromData /end MEASUREMENT
/begin MEASUREMENT ZFEH_EepromData.ydiBackupMemory_xau16[7].amb_cond.ambient_condition[0][7] "ambient condition shot [0 .. 2-1] with 25 data bytes [0 .. 25-1] for the error code stored in this error memory slot" UBYTE EH_STANDARD_S4_S3 1 100 0 255 ECU_ADDRESS 0xFFF82A77 DISPLAY_IDENTIFIER ambient_condition[0][7].amb_cond.ydiBackupMemory_xau16[7].ZFEH_EepromData /end MEASUREMENT
/begin MEASUREMENT ZFEH_EepromData.ydiBackupMemory_xau16[7].amb_cond.ambient_condition[0][8] "ambient condition shot [0 .. 2-1] with 25 data bytes [0 .. 25-1] for the error code stored in this error memory slot" UBYTE EH_STANDARD_S4_S3 1 100 0 255 ECU_ADDRESS 0xFFF82A78 DISPLAY_IDENTIFIER ambient_condition[0][8].amb_cond.ydiBackupMemory_xau16[7].ZFEH_EepromData /end MEASUREMENT
/begin MEASUREMENT ZFEH_EepromData.ydiBackupMemory_xau16[7].amb_cond.ambient_condition[0][9] "ambient condition shot [0 .. 2-1] with 25 data bytes [0 .. 25-1] for the error code stored in this error memory slot" UBYTE EH_STANDARD_S4_S3 1 100 0 255 ECU_ADDRESS 0xFFF82A79 DISPLAY_IDENTIFIER ambient_condition[0][9].amb_cond.ydiBackupMemory_xau16[7].ZFEH_EepromData /end MEASUREMENT
/begin MEASUREMENT ZFEH_EepromData.ydiBackupMemory_xau16[7].amb_cond.ambient_condition[1][0] "ambient condition shot [0 .. 2-1] with 25 data bytes [0 .. 25-1] for the error code stored in this error memory slot" UBYTE EH_STANDARD_S4_S3 1 100 0 255 ECU_ADDRESS 0xFFF82A89 DISPLAY_IDENTIFIER ambient_condition[1][0].amb_cond.ydiBackupMemory_xau16[7].ZFEH_EepromData /end MEASUREMENT
/begin MEASUREMENT ZFEH_EepromData.ydiBackupMemory_xau16[7].amb_cond.ambient_condition[1][10] "ambient condition shot [0 .. 2-1] with 25 data bytes [0 .. 25-1] for the error code stored in this error memory slot" UBYTE EH_STANDARD_S4_S3 1 100 0 255 ECU_ADDRESS 0xFFF82A93 DISPLAY_IDENTIFIER ambient_condition[1][10].amb_cond.ydiBackupMemory_xau16[7].ZFEH_EepromData /end MEASUREMENT
/begin MEASUREMENT ZFEH_EepromData.ydiBackupMemory_xau16[7].amb_cond.ambient_condition[1][11] "ambient condition shot [0 .. 2-1] with 25 data bytes [0 .. 25-1] for the error code stored in this error memory slot" UBYTE EH_STANDARD_S4_S3 1 100 0 255 ECU_ADDRESS 0xFFF82A94 DISPLAY_IDENTIFIER ambient_condition[1][11].amb_cond.ydiBackupMemory_xau16[7].ZFEH_EepromData /end MEASUREMENT
/begin MEASUREMENT ZFEH_EepromData.ydiBackupMemory_xau16[7].amb_cond.ambient_condition[1][12] "ambient condition shot [0 .. 2-1] with 25 data bytes [0 .. 25-1] for the error code stored in this error memory slot" UBYTE EH_STANDARD_S4_S3 1 100 0 255 ECU_ADDRESS 0xFFF82A95 DISPLAY_IDENTIFIER ambient_condition[1][12].amb_cond.ydiBackupMemory_xau16[7].ZFEH_EepromData /end MEASUREMENT
/begin MEASUREMENT ZFEH_EepromData.ydiBackupMemory_xau16[7].amb_cond.ambient_condition[1][13] "ambient condition shot [0 .. 2-1] with 25 data bytes [0 .. 25-1] for the error code stored in this error memory slot" UBYTE EH_STANDARD_S4_S3 1 100 0 255 ECU_ADDRESS 0xFFF82A96 DISPLAY_IDENTIFIER ambient_condition[1][13].amb_cond.ydiBackupMemory_xau16[7].ZFEH_EepromData /end MEASUREMENT
/begin MEASUREMENT ZFEH_EepromData.ydiBackupMemory_xau16[7].amb_cond.ambient_condition[1][14] "ambient condition shot [0 .. 2-1] with 25 data bytes [0 .. 25-1] for the error code stored in this error memory slot" UBYTE EH_STANDARD_S4_S3 1 100 0 255 ECU_ADDRESS 0xFFF82A97 DISPLAY_IDENTIFIER ambient_condition[1][14].amb_cond.ydiBackupMemory_xau16[7].ZFEH_EepromData /end MEASUREMENT
/begin MEASUREMENT ZFEH_EepromData.ydiBackupMemory_xau16[7].amb_cond.ambient_condition[1][15] "ambient condition shot [0 .. 2-1] with 25 data bytes [0 .. 25-1] for the error code stored in this error memory slot" UBYTE EH_STANDARD_S4_S3 1 100 0 255 ECU_ADDRESS 0xFFF82A98 DISPLAY_IDENTIFIER ambient_condition[1][15].amb_cond.ydiBackupMemory_xau16[7].ZFEH_EepromData /end MEASUREMENT
/begin MEASUREMENT ZFEH_EepromData.ydiBackupMemory_xau16[7].amb_cond.ambient_condition[1][16] "ambient condition shot [0 .. 2-1] with 25 data bytes [0 .. 25-1] for the error code stored in this error memory slot" UBYTE EH_STANDARD_S4_S3 1 100 0 255 ECU_ADDRESS 0xFFF82A99 DISPLAY_IDENTIFIER ambient_condition[1][16].amb_cond.ydiBackupMemory_xau16[7].ZFEH_EepromData /end MEASUREMENT
/begin MEASUREMENT ZFEH_EepromData.ydiBackupMemory_xau16[7].amb_cond.ambient_condition[1][17] "ambient condition shot [0 .. 2-1] with 25 data bytes [0 .. 25-1] for the error code stored in this error memory slot" UBYTE EH_STANDARD_S4_S3 1 100 0 255 ECU_ADDRESS 0xFFF82A9A DISPLAY_IDENTIFIER ambient_condition[1][17].amb_cond.ydiBackupMemory_xau16[7].ZFEH_EepromData /end MEASUREMENT
/begin MEASUREMENT ZFEH_EepromData.ydiBackupMemory_xau16[7].amb_cond.ambient_condition[1][18] "ambient condition shot [0 .. 2-1] with 25 data bytes [0 .. 25-1] for the error code stored in this error memory slot" UBYTE EH_STANDARD_S4_S3 1 100 0 255 ECU_ADDRESS 0xFFF82A9B DISPLAY_IDENTIFIER ambient_condition[1][18].amb_cond.ydiBackupMemory_xau16[7].ZFEH_EepromData /end MEASUREMENT
/begin MEASUREMENT ZFEH_EepromData.ydiBackupMemory_xau16[7].amb_cond.ambient_condition[1][19] "ambient condition shot [0 .. 2-1] with 25 data bytes [0 .. 25-1] for the error code stored in this error memory slot" UBYTE EH_STANDARD_S4_S3 1 100 0 255 ECU_ADDRESS 0xFFF82A9C DISPLAY_IDENTIFIER ambient_condition[1][19].amb_cond.ydiBackupMemory_xau16[7].ZFEH_EepromData /end MEASUREMENT
/begin MEASUREMENT ZFEH_EepromData.ydiBackupMemory_xau16[7].amb_cond.ambient_condition[1][1] "ambient condition shot [0 .. 2-1] with 25 data bytes [0 .. 25-1] for the error code stored in this error memory slot" UBYTE EH_STANDARD_S4_S3 1 100 0 255 ECU_ADDRESS 0xFFF82A8A DISPLAY_IDENTIFIER ambient_condition[1][1].amb_cond.ydiBackupMemory_xau16[7].ZFEH_EepromData /end MEASUREMENT
/begin MEASUREMENT ZFEH_EepromData.ydiBackupMemory_xau16[7].amb_cond.ambient_condition[1][20] "ambient condition shot [0 .. 2-1] with 25 data bytes [0 .. 25-1] for the error code stored in this error memory slot" UBYTE EH_STANDARD_S4_S3 1 100 0 255 ECU_ADDRESS 0xFFF82A9D DISPLAY_IDENTIFIER ambient_condition[1][20].amb_cond.ydiBackupMemory_xau16[7].ZFEH_EepromData /end MEASUREMENT
/begin MEASUREMENT ZFEH_EepromData.ydiBackupMemory_xau16[7].amb_cond.ambient_condition[1][21] "ambient condition shot [0 .. 2-1] with 25 data bytes [0 .. 25-1] for the error code stored in this error memory slot" UBYTE EH_STANDARD_S4_S3 1 100 0 255 ECU_ADDRESS 0xFFF82A9E DISPLAY_IDENTIFIER ambient_condition[1][21].amb_cond.ydiBackupMemory_xau16[7].ZFEH_EepromData /end MEASUREMENT
/begin MEASUREMENT ZFEH_EepromData.ydiBackupMemory_xau16[7].amb_cond.ambient_condition[1][22] "ambient condition shot [0 .. 2-1] with 25 data bytes [0 .. 25-1] for the error code stored in this error memory slot" UBYTE EH_STANDARD_S4_S3 1 100 0 255 ECU_ADDRESS 0xFFF82A9F DISPLAY_IDENTIFIER ambient_condition[1][22].amb_cond.ydiBackupMemory_xau16[7].ZFEH_EepromData /end MEASUREMENT
/begin MEASUREMENT ZFEH_EepromData.ydiBackupMemory_xau16[7].amb_cond.ambient_condition[1][23] "ambient condition shot [0 .. 2-1] with 25 data bytes [0 .. 25-1] for the error code stored in this error memory slot" UBYTE EH_STANDARD_S4_S3 1 100 0 255 ECU_ADDRESS 0xFFF82AA0 DISPLAY_IDENTIFIER ambient_condition[1][23].amb_cond.ydiBackupMemory_xau16[7].ZFEH_EepromData /end MEASUREMENT
/begin MEASUREMENT ZFEH_EepromData.ydiBackupMemory_xau16[7].amb_cond.ambient_condition[1][24] "ambient condition shot [0 .. 2-1] with 25 data bytes [0 .. 25-1] for the error code stored in this error memory slot" UBYTE EH_STANDARD_S4_S3 1 100 0 255 ECU_ADDRESS 0xFFF82AA1 DISPLAY_IDENTIFIER ambient_condition[1][24].amb_cond.ydiBackupMemory_xau16[7].ZFEH_EepromData /end MEASUREMENT
/begin MEASUREMENT ZFEH_EepromData.ydiBackupMemory_xau16[7].amb_cond.ambient_condition[1][2] "ambient condition shot [0 .. 2-1] with 25 data bytes [0 .. 25-1] for the error code stored in this error memory slot" UBYTE EH_STANDARD_S4_S3 1 100 0 255 ECU_ADDRESS 0xFFF82A8B DISPLAY_IDENTIFIER ambient_condition[1][2].amb_cond.ydiBackupMemory_xau16[7].ZFEH_EepromData /end MEASUREMENT
/begin MEASUREMENT ZFEH_EepromData.ydiBackupMemory_xau16[7].amb_cond.ambient_condition[1][3] "ambient condition shot [0 .. 2-1] with 25 data bytes [0 .. 25-1] for the error code stored in this error memory slot" UBYTE EH_STANDARD_S4_S3 1 100 0 255 ECU_ADDRESS 0xFFF82A8C DISPLAY_IDENTIFIER ambient_condition[1][3].amb_cond.ydiBackupMemory_xau16[7].ZFEH_EepromData /end MEASUREMENT
/begin MEASUREMENT ZFEH_EepromData.ydiBackupMemory_xau16[7].amb_cond.ambient_condition[1][4] "ambient condition shot [0 .. 2-1] with 25 data bytes [0 .. 25-1] for the error code stored in this error memory slot" UBYTE EH_STANDARD_S4_S3 1 100 0 255 ECU_ADDRESS 0xFFF82A8D DISPLAY_IDENTIFIER ambient_condition[1][4].amb_cond.ydiBackupMemory_xau16[7].ZFEH_EepromData /end MEASUREMENT
/begin MEASUREMENT ZFEH_EepromData.ydiBackupMemory_xau16[7].amb_cond.ambient_condition[1][5] "ambient condition shot [0 .. 2-1] with 25 data bytes [0 .. 25-1] for the error code stored in this error memory slot" UBYTE EH_STANDARD_S4_S3 1 100 0 255 ECU_ADDRESS 0xFFF82A8E DISPLAY_IDENTIFIER ambient_condition[1][5].amb_cond.ydiBackupMemory_xau16[7].ZFEH_EepromData /end MEASUREMENT
/begin MEASUREMENT ZFEH_EepromData.ydiBackupMemory_xau16[7].amb_cond.ambient_condition[1][6] "ambient condition shot [0 .. 2-1] with 25 data bytes [0 .. 25-1] for the error code stored in this error memory slot" UBYTE EH_STANDARD_S4_S3 1 100 0 255 ECU_ADDRESS 0xFFF82A8F DISPLAY_IDENTIFIER ambient_condition[1][6].amb_cond.ydiBackupMemory_xau16[7].ZFEH_EepromData /end MEASUREMENT
/begin MEASUREMENT ZFEH_EepromData.ydiBackupMemory_xau16[7].amb_cond.ambient_condition[1][7] "ambient condition shot [0 .. 2-1] with 25 data bytes [0 .. 25-1] for the error code stored in this error memory slot" UBYTE EH_STANDARD_S4_S3 1 100 0 255 ECU_ADDRESS 0xFFF82A90 DISPLAY_IDENTIFIER ambient_condition[1][7].amb_cond.ydiBackupMemory_xau16[7].ZFEH_EepromData /end MEASUREMENT
/begin MEASUREMENT ZFEH_EepromData.ydiBackupMemory_xau16[7].amb_cond.ambient_condition[1][8] "ambient condition shot [0 .. 2-1] with 25 data bytes [0 .. 25-1] for the error code stored in this error memory slot" UBYTE EH_STANDARD_S4_S3 1 100 0 255 ECU_ADDRESS 0xFFF82A91 DISPLAY_IDENTIFIER ambient_condition[1][8].amb_cond.ydiBackupMemory_xau16[7].ZFEH_EepromData /end MEASUREMENT
/begin MEASUREMENT ZFEH_EepromData.ydiBackupMemory_xau16[7].amb_cond.ambient_condition[1][9] "ambient condition shot [0 .. 2-1] with 25 data bytes [0 .. 25-1] for the error code stored in this error memory slot" UBYTE EH_STANDARD_S4_S3 1 100 0 255 ECU_ADDRESS 0xFFF82A92 DISPLAY_IDENTIFIER ambient_condition[1][9].amb_cond.ydiBackupMemory_xau16[7].ZFEH_EepromData /end MEASUREMENT
/begin MEASUREMENT ZFEH_EepromData.ydiBackupMemory_xau16[7].amb_cond.status_of_ambient_conditions[0] "status of ambient condition shot x: 0=invalid 1=valid" UBYTE EH_STANDARD_S4_S3 1 100 0 1 ECU_ADDRESS 0xFFF82AA2 DISPLAY_IDENTIFIER status_of_ambient_conditions[0].amb_cond.ydiBackupMemory_xau16[7].ZFEH_EepromData /end MEASUREMENT
/begin MEASUREMENT ZFEH_EepromData.ydiBackupMemory_xau16[7].amb_cond.status_of_ambient_conditions[1] "status of ambient condition shot x: 0=invalid 1=valid" UBYTE EH_STANDARD_S4_S3 1 100 0 1 ECU_ADDRESS 0xFFF82AA3 DISPLAY_IDENTIFIER status_of_ambient_conditions[1].amb_cond.ydiBackupMemory_xau16[7].ZFEH_EepromData /end MEASUREMENT
/begin MEASUREMENT ZFEH_EepromData.ydiBackupMemory_xau16[7].backwards_counter "backwards counter of error code stored in error memory slot" UBYTE EH_STANDARD_S4_S3 1 100 0 255 ECU_ADDRESS 0xFFF82A63 DISPLAY_IDENTIFIER backwards_counter.ydiBackupMemory_xau16[7].ZFEH_EepromData /end MEASUREMENT
/begin MEASUREMENT ZFEH_EepromData.ydiBackupMemory_xau16[7].condition_byte "condition byte of error code stored in error memory slot" UBYTE EH_STANDARD_S4_S3 1 100 0 255 ECU_ADDRESS 0xFFF82A6D DISPLAY_IDENTIFIER condition_byte.ydiBackupMemory_xau16[7].ZFEH_EepromData /end MEASUREMENT
/begin MEASUREMENT ZFEH_EepromData.ydiBackupMemory_xau16[7].error_code "error code stored in error memory slot" UWORD EH_STANDARD_S4_S3 1 100 0 65535 ECU_ADDRESS 0xFFF82A5C DISPLAY_IDENTIFIER error_code.ydiBackupMemory_xau16[7].ZFEH_EepromData /end MEASUREMENT
/begin MEASUREMENT ZFEH_EepromData.ydiBackupMemory_xau16[7].error_type "error type of error code stored in error memory slot" UWORD EH_STANDARD_S4_S3 1 100 0 65535 ECU_ADDRESS 0xFFF82A5E DISPLAY_IDENTIFIER error_type.ydiBackupMemory_xau16[7].ZFEH_EepromData /end MEASUREMENT
/begin MEASUREMENT ZFEH_EepromData.ydiBackupMemory_xau16[7].frequency_counter "frequency counter of error code stored in error memory slot" UBYTE EH_STANDARD_S4_S3 1 100 0 255 ECU_ADDRESS 0xFFF82A62 DISPLAY_IDENTIFIER frequency_counter.ydiBackupMemory_xau16[7].ZFEH_EepromData /end MEASUREMENT
/begin MEASUREMENT ZFEH_EepromData.ydiBackupMemory_xau16[7].master_time "master time of error code stored in error memory slot" ULONG EH_STANDARD_S4_S3 1 100 0 4294967295 ECU_ADDRESS 0xFFF82A68 DISPLAY_IDENTIFIER master_time.ydiBackupMemory_xau16[7].ZFEH_EepromData /end MEASUREMENT
/begin MEASUREMENT ZFEH_EepromData.ydiBackupMemory_xau16[7].obd_driving_cycle_counter "obd driving cycle counter of error code stored in error memory slot" UWORD EH_STANDARD_S4_S3 1 100 0 65535 ECU_ADDRESS 0xFFF82A6E DISPLAY_IDENTIFIER obd_driving_cycle_counter.ydiBackupMemory_xau16[7].ZFEH_EepromData /end MEASUREMENT
/begin MEASUREMENT ZFEH_EepromData.ydiBackupMemory_xau16[7].permanent_counter "counter of permanent error codes stored in error memory slot" UBYTE EH_STANDARD_S4_S3 1 100 0 255 ECU_ADDRESS 0xFFF82A64 DISPLAY_IDENTIFIER permanent_counter.ydiBackupMemory_xau16[7].ZFEH_EepromData /end MEASUREMENT
/begin MEASUREMENT ZFEH_EepromData.ydiBackupMemory_xau16[7].sequence_counter "sequence counter of error code stored in error memory slot" UBYTE EH_STANDARD_S4_S3 1 100 0 255 ECU_ADDRESS 0xFFF82A65 DISPLAY_IDENTIFIER sequence_counter.ydiBackupMemory_xau16[7].ZFEH_EepromData /end MEASUREMENT
/begin MEASUREMENT ZFEH_EepromData.ydiBackupMemory_xau16[7].status_word "status word of error code stored in error memory slot" UWORD EH_STANDARD_S4_S3 1 100 0 65535 ECU_ADDRESS 0xFFF82A60 DISPLAY_IDENTIFIER status_word.ydiBackupMemory_xau16[7].ZFEH_EepromData /end MEASUREMENT
/begin MEASUREMENT ZFEH_EepromData.ydiBackupMemory_xau16[8].amb_cond.ambient_condition[0][0] "ambient condition shot [0 .. 2-1] with 25 data bytes [0 .. 25-1] for the error code stored in this error memory slot" UBYTE EH_STANDARD_S4_S3 1 100 0 255 ECU_ADDRESS 0xFFF82AB8 DISPLAY_IDENTIFIER ambient_condition[0][0].amb_cond.ydiBackupMemory_xau16[8].ZFEH_EepromData /end MEASUREMENT
/begin MEASUREMENT ZFEH_EepromData.ydiBackupMemory_xau16[8].amb_cond.ambient_condition[0][10] "ambient condition shot [0 .. 2-1] with 25 data bytes [0 .. 25-1] for the error code stored in this error memory slot" UBYTE EH_STANDARD_S4_S3 1 100 0 255 ECU_ADDRESS 0xFFF82AC2 DISPLAY_IDENTIFIER ambient_condition[0][10].amb_cond.ydiBackupMemory_xau16[8].ZFEH_EepromData /end MEASUREMENT
/begin MEASUREMENT ZFEH_EepromData.ydiBackupMemory_xau16[8].amb_cond.ambient_condition[0][11] "ambient condition shot [0 .. 2-1] with 25 data bytes [0 .. 25-1] for the error code stored in this error memory slot" UBYTE EH_STANDARD_S4_S3 1 100 0 255 ECU_ADDRESS 0xFFF82AC3 DISPLAY_IDENTIFIER ambient_condition[0][11].amb_cond.ydiBackupMemory_xau16[8].ZFEH_EepromData /end MEASUREMENT
/begin MEASUREMENT ZFEH_EepromData.ydiBackupMemory_xau16[8].amb_cond.ambient_condition[0][12] "ambient condition shot [0 .. 2-1] with 25 data bytes [0 .. 25-1] for the error code stored in this error memory slot" UBYTE EH_STANDARD_S4_S3 1 100 0 255 ECU_ADDRESS 0xFFF82AC4 DISPLAY_IDENTIFIER ambient_condition[0][12].amb_cond.ydiBackupMemory_xau16[8].ZFEH_EepromData /end MEASUREMENT
/begin MEASUREMENT ZFEH_EepromData.ydiBackupMemory_xau16[8].amb_cond.ambient_condition[0][13] "ambient condition shot [0 .. 2-1] with 25 data bytes [0 .. 25-1] for the error code stored in this error memory slot" UBYTE EH_STANDARD_S4_S3 1 100 0 255 ECU_ADDRESS 0xFFF82AC5 DISPLAY_IDENTIFIER ambient_condition[0][13].amb_cond.ydiBackupMemory_xau16[8].ZFEH_EepromData /end MEASUREMENT
/begin MEASUREMENT ZFEH_EepromData.ydiBackupMemory_xau16[8].amb_cond.ambient_condition[0][14] "ambient condition shot [0 .. 2-1] with 25 data bytes [0 .. 25-1] for the error code stored in this error memory slot" UBYTE EH_STANDARD_S4_S3 1 100 0 255 ECU_ADDRESS 0xFFF82AC6 DISPLAY_IDENTIFIER ambient_condition[0][14].amb_cond.ydiBackupMemory_xau16[8].ZFEH_EepromData /end MEASUREMENT
/begin MEASUREMENT ZFEH_EepromData.ydiBackupMemory_xau16[8].amb_cond.ambient_condition[0][15] "ambient condition shot [0 .. 2-1] with 25 data bytes [0 .. 25-1] for the error code stored in this error memory slot" UBYTE EH_STANDARD_S4_S3 1 100 0 255 ECU_ADDRESS 0xFFF82AC7 DISPLAY_IDENTIFIER ambient_condition[0][15].amb_cond.ydiBackupMemory_xau16[8].ZFEH_EepromData /end MEASUREMENT
/begin MEASUREMENT ZFEH_EepromData.ydiBackupMemory_xau16[8].amb_cond.ambient_condition[0][16] "ambient condition shot [0 .. 2-1] with 25 data bytes [0 .. 25-1] for the error code stored in this error memory slot" UBYTE EH_STANDARD_S4_S3 1 100 0 255 ECU_ADDRESS 0xFFF82AC8 DISPLAY_IDENTIFIER ambient_condition[0][16].amb_cond.ydiBackupMemory_xau16[8].ZFEH_EepromData /end MEASUREMENT
/begin MEASUREMENT ZFEH_EepromData.ydiBackupMemory_xau16[8].amb_cond.ambient_condition[0][17] "ambient condition shot [0 .. 2-1] with 25 data bytes [0 .. 25-1] for the error code stored in this error memory slot" UBYTE EH_STANDARD_S4_S3 1 100 0 255 ECU_ADDRESS 0xFFF82AC9 DISPLAY_IDENTIFIER ambient_condition[0][17].amb_cond.ydiBackupMemory_xau16[8].ZFEH_EepromData /end MEASUREMENT
/begin MEASUREMENT ZFEH_EepromData.ydiBackupMemory_xau16[8].amb_cond.ambient_condition[0][18] "ambient condition shot [0 .. 2-1] with 25 data bytes [0 .. 25-1] for the error code stored in this error memory slot" UBYTE EH_STANDARD_S4_S3 1 100 0 255 ECU_ADDRESS 0xFFF82ACA DISPLAY_IDENTIFIER ambient_condition[0][18].amb_cond.ydiBackupMemory_xau16[8].ZFEH_EepromData /end MEASUREMENT
/begin MEASUREMENT ZFEH_EepromData.ydiBackupMemory_xau16[8].amb_cond.ambient_condition[0][19] "ambient condition shot [0 .. 2-1] with 25 data bytes [0 .. 25-1] for the error code stored in this error memory slot" UBYTE EH_STANDARD_S4_S3 1 100 0 255 ECU_ADDRESS 0xFFF82ACB DISPLAY_IDENTIFIER ambient_condition[0][19].amb_cond.ydiBackupMemory_xau16[8].ZFEH_EepromData /end MEASUREMENT
/begin MEASUREMENT ZFEH_EepromData.ydiBackupMemory_xau16[8].amb_cond.ambient_condition[0][1] "ambient condition shot [0 .. 2-1] with 25 data bytes [0 .. 25-1] for the error code stored in this error memory slot" UBYTE EH_STANDARD_S4_S3 1 100 0 255 ECU_ADDRESS 0xFFF82AB9 DISPLAY_IDENTIFIER ambient_condition[0][1].amb_cond.ydiBackupMemory_xau16[8].ZFEH_EepromData /end MEASUREMENT
/begin MEASUREMENT ZFEH_EepromData.ydiBackupMemory_xau16[8].amb_cond.ambient_condition[0][20] "ambient condition shot [0 .. 2-1] with 25 data bytes [0 .. 25-1] for the error code stored in this error memory slot" UBYTE EH_STANDARD_S4_S3 1 100 0 255 ECU_ADDRESS 0xFFF82ACC DISPLAY_IDENTIFIER ambient_condition[0][20].amb_cond.ydiBackupMemory_xau16[8].ZFEH_EepromData /end MEASUREMENT
/begin MEASUREMENT ZFEH_EepromData.ydiBackupMemory_xau16[8].amb_cond.ambient_condition[0][21] "ambient condition shot [0 .. 2-1] with 25 data bytes [0 .. 25-1] for the error code stored in this error memory slot" UBYTE EH_STANDARD_S4_S3 1 100 0 255 ECU_ADDRESS 0xFFF82ACD DISPLAY_IDENTIFIER ambient_condition[0][21].amb_cond.ydiBackupMemory_xau16[8].ZFEH_EepromData /end MEASUREMENT
/begin MEASUREMENT ZFEH_EepromData.ydiBackupMemory_xau16[8].amb_cond.ambient_condition[0][22] "ambient condition shot [0 .. 2-1] with 25 data bytes [0 .. 25-1] for the error code stored in this error memory slot" UBYTE EH_STANDARD_S4_S3 1 100 0 255 ECU_ADDRESS 0xFFF82ACE DISPLAY_IDENTIFIER ambient_condition[0][22].amb_cond.ydiBackupMemory_xau16[8].ZFEH_EepromData /end MEASUREMENT
/begin MEASUREMENT ZFEH_EepromData.ydiBackupMemory_xau16[8].amb_cond.ambient_condition[0][23] "ambient condition shot [0 .. 2-1] with 25 data bytes [0 .. 25-1] for the error code stored in this error memory slot" UBYTE EH_STANDARD_S4_S3 1 100 0 255 ECU_ADDRESS 0xFFF82ACF DISPLAY_IDENTIFIER ambient_condition[0][23].amb_cond.ydiBackupMemory_xau16[8].ZFEH_EepromData /end MEASUREMENT
/begin MEASUREMENT ZFEH_EepromData.ydiBackupMemory_xau16[8].amb_cond.ambient_condition[0][24] "ambient condition shot [0 .. 2-1] with 25 data bytes [0 .. 25-1] for the error code stored in this error memory slot" UBYTE EH_STANDARD_S4_S3 1 100 0 255 ECU_ADDRESS 0xFFF82AD0 DISPLAY_IDENTIFIER ambient_condition[0][24].amb_cond.ydiBackupMemory_xau16[8].ZFEH_EepromData /end MEASUREMENT
/begin MEASUREMENT ZFEH_EepromData.ydiBackupMemory_xau16[8].amb_cond.ambient_condition[0][2] "ambient condition shot [0 .. 2-1] with 25 data bytes [0 .. 25-1] for the error code stored in this error memory slot" UBYTE EH_STANDARD_S4_S3 1 100 0 255 ECU_ADDRESS 0xFFF82ABA DISPLAY_IDENTIFIER ambient_condition[0][2].amb_cond.ydiBackupMemory_xau16[8].ZFEH_EepromData /end MEASUREMENT
/begin MEASUREMENT ZFEH_EepromData.ydiBackupMemory_xau16[8].amb_cond.ambient_condition[0][3] "ambient condition shot [0 .. 2-1] with 25 data bytes [0 .. 25-1] for the error code stored in this error memory slot" UBYTE EH_STANDARD_S4_S3 1 100 0 255 ECU_ADDRESS 0xFFF82ABB DISPLAY_IDENTIFIER ambient_condition[0][3].amb_cond.ydiBackupMemory_xau16[8].ZFEH_EepromData /end MEASUREMENT
/begin MEASUREMENT ZFEH_EepromData.ydiBackupMemory_xau16[8].amb_cond.ambient_condition[0][4] "ambient condition shot [0 .. 2-1] with 25 data bytes [0 .. 25-1] for the error code stored in this error memory slot" UBYTE EH_STANDARD_S4_S3 1 100 0 255 ECU_ADDRESS 0xFFF82ABC DISPLAY_IDENTIFIER ambient_condition[0][4].amb_cond.ydiBackupMemory_xau16[8].ZFEH_EepromData /end MEASUREMENT
/begin MEASUREMENT ZFEH_EepromData.ydiBackupMemory_xau16[8].amb_cond.ambient_condition[0][5] "ambient condition shot [0 .. 2-1] with 25 data bytes [0 .. 25-1] for the error code stored in this error memory slot" UBYTE EH_STANDARD_S4_S3 1 100 0 255 ECU_ADDRESS 0xFFF82ABD DISPLAY_IDENTIFIER ambient_condition[0][5].amb_cond.ydiBackupMemory_xau16[8].ZFEH_EepromData /end MEASUREMENT
/begin MEASUREMENT ZFEH_EepromData.ydiBackupMemory_xau16[8].amb_cond.ambient_condition[0][6] "ambient condition shot [0 .. 2-1] with 25 data bytes [0 .. 25-1] for the error code stored in this error memory slot" UBYTE EH_STANDARD_S4_S3 1 100 0 255 ECU_ADDRESS 0xFFF82ABE DISPLAY_IDENTIFIER ambient_condition[0][6].amb_cond.ydiBackupMemory_xau16[8].ZFEH_EepromData /end MEASUREMENT
/begin MEASUREMENT ZFEH_EepromData.ydiBackupMemory_xau16[8].amb_cond.ambient_condition[0][7] "ambient condition shot [0 .. 2-1] with 25 data bytes [0 .. 25-1] for the error code stored in this error memory slot" UBYTE EH_STANDARD_S4_S3 1 100 0 255 ECU_ADDRESS 0xFFF82ABF DISPLAY_IDENTIFIER ambient_condition[0][7].amb_cond.ydiBackupMemory_xau16[8].ZFEH_EepromData /end MEASUREMENT
/end MODULE
/end PROJECT
