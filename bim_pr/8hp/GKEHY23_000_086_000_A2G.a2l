ASAP2_VERSION 1 51
/begin PROJECT ZHBC8600 "Gen2_BMW_System_Supplier_Lib"
/begin MODULE CPP ""
/begin MOD_COMMON "" BYTE_ORDER MSB_FIRST ALIGNMENT_BYTE 1 ALIGNMENT_WORD 2 ALIGNMENT_LONG 4 ALIGNMENT_FLOAT32_IEEE 4 ALIGNMENT_FLOAT64_IEEE 1 /end MOD_COMMON
/begin COMPU_METHOD EH_N_RPM8_S4_S3 "int = ((phys * 8) / 1) - (0) 1/min" RAT_FUNC "%3.2" "1/min" COEFFS 0 8 0 0 0 1 /end COMPU_METHOD
/begin COMPU_METHOD EH_P_1HPA_S4_S3 "int = ((phys * 1) / 1) - (0) hPa" RAT_FUNC "%1.0" "hPa" COEFFS 0 1 0 0 0 1 /end COMPU_METHOD
/begin COMPU_METHOD EH_P_1KPA_S4_S3 "int = ((phys * 1) / 1) - (0) kPa" RAT_FUNC "%1.0" "kPa" COEFFS 0 1 0 0 0 1 /end COMPU_METHOD
/begin COMPU_METHOD EH_P_1MBAR_S4_S3 "int = ((phys * 1) / 1) - (0) mbar" RAT_FUNC "%1.0" "mbar" COEFFS 0 1 0 0 0 1 /end COMPU_METHOD
/begin COMPU_METHOD UMR___10_1_0_S5_S3 "int = ((phys * 1) / 10) - (0) [-]" RAT_FUNC "%1.0" "[-]" COEFFS 0 0.1 0 0 0 1 /end COMPU_METHOD
/begin COMPU_METHOD UMR___1_1000_0_S5_S3 "int = ((phys * 1000) / 1) - (0) [-]" RAT_FUNC "%4.3" "[-]" COEFFS 0 1000 0 0 0 1 /end COMPU_METHOD
/begin COMPU_METHOD UMR___1_100_0_S5_S3 "int = ((phys * 100) / 1) - (0) [-]" RAT_FUNC "%3.2" "[-]" COEFFS 0 100 0 0 0 1 /end COMPU_METHOD
/begin COMPU_METHOD UMR___1_1_0_S5_S3 "int = ((phys * 1) / 1) - (0) [-]" RAT_FUNC "%1.0" "[-]" COEFFS 0 1 0 0 0 1 /end COMPU_METHOD
/begin COMPU_METHOD UMR_BAR__1_1000_0_S5_S3 "int = ((phys * 1000) / 1) - (0) [bar]" RAT_FUNC "%4.3" "[bar]" COEFFS 0 1000 0 0 0 1 /end COMPU_METHOD
/begin COMPU_METHOD UMR_BAR__1_1_0_S5_S3 "int = ((phys * 1) / 1) - (0) [bar]" RAT_FUNC "%1.0" "[bar]" COEFFS 0 1 0 0 0 1 /end COMPU_METHOD
/begin COMPU_METHOD UMR_G__1_10_0_S5_S3 "int = ((phys * 10) / 1) - (0) [g]" RAT_FUNC "%2.1" "[g]" COEFFS 0 10 0 0 0 1 /end COMPU_METHOD
/begin COMPU_METHOD UMR_G__1_1_0_S5_S3 "int = ((phys * 1) / 1) - (0) [g]" RAT_FUNC "%1.0" "[g]" COEFFS 0 1 0 0 0 1 /end COMPU_METHOD
/begin COMPU_METHOD UMR_GRADC__1_1_0_S5_S3 "int = ((phys * 1) / 1) - (0) [°C]" RAT_FUNC "%1.0" "[°C]" COEFFS 0 1 0 0 0 1 /end COMPU_METHOD
/begin COMPU_METHOD UMR_GRADC__1_1_M40_S5_S3 "int = ((phys * 1) / 1) - (-40) [°C]" RAT_FUNC "%1.0" "[°C]" COEFFS 0 1 40 0 0 1 /end COMPU_METHOD
/begin COMPU_METHOD UMR_GRADC__1_1_M48_S5_S3 "int = ((phys * 1) / 1) - (-48) [°C]" RAT_FUNC "%1.0" "[°C]" COEFFS 0 1 48 0 0 1 /end COMPU_METHOD
/begin COMPU_METHOD UMR_J_G_1_1_0_S5_S3 "int = ((phys * 1) / 1) - (0) [J/(g)]" RAT_FUNC "%1.0" "[J/(g)]" COEFFS 0 1 0 0 0 1 /end COMPU_METHOD
/begin COMPU_METHOD UMR_J_GK_1_1000_0_S5_S3 "int = ((phys * 1000) / 1) - (0) [J/(g*K)]" RAT_FUNC "%4.3" "[J/(g*K)]" COEFFS 0 1000 0 0 0 1 /end COMPU_METHOD
/begin COMPU_METHOD UMR_K_SECK_1_1000_0_S5_S3 "int = ((phys * 1000) / 1) - (0) [K/(s*K)]" RAT_FUNC "%4.3" "[K/(s*K)]" COEFFS 0 1000 0 0 0 1 /end COMPU_METHOD
/begin COMPU_METHOD UMR_MM2__10_1_0_S5_S3 "int = ((phys * 1) / 10) - (0) [mm^2]" RAT_FUNC "%1.0" "[mm^2]" COEFFS 0 0.1 0 0 0 1 /end COMPU_METHOD
/begin COMPU_METHOD UMR_MSEC__10_1_0_S5_S3 "int = ((phys * 1) / 10) - (0) [ms]" RAT_FUNC "%1.0" "[ms]" COEFFS 0 0.1 0 0 0 1 /end COMPU_METHOD
/begin COMPU_METHOD UMR_MSEC__10_1_M128_S5_S3 "int = ((phys * 1) / 10) - (-128) [ms]" RAT_FUNC "%1.0" "[ms]" COEFFS 0 0.1 128 0 0 1 /end COMPU_METHOD
/begin COMPU_METHOD UMR_MSEC__10_1_M255_S5_S3 "int = ((phys * 1) / 10) - (-255) [ms]" RAT_FUNC "%1.0" "[ms]" COEFFS 0 0.1 255 0 0 1 /end COMPU_METHOD
/begin COMPU_METHOD UMR_MSEC__1_1_0_S5_S3 "int = ((phys * 1) / 1) - (0) [ms]" RAT_FUNC "%1.0" "[ms]" COEFFS 0 1 0 0 0 1 /end COMPU_METHOD
/begin COMPU_METHOD UMR_NM__1_1_0_S5_S3 "int = ((phys * 1) / 1) - (0) [Nm]" RAT_FUNC "%1.0" "[Nm]" COEFFS 0 1 0 0 0 1 /end COMPU_METHOD
/begin COMPU_METHOD UMR_NM__6_1_M128_S5_S3 "int = ((phys * 1) / 6) - (-128) [Nm]" RAT_FUNC "%1.0" "[Nm]" COEFFS 0 0.166666666667 128 0 0 1 /end COMPU_METHOD
/begin COMPU_METHOD UMR_NM__6_1_M34_S5_S3 "int = ((phys * 1) / 6) - (-34) [Nm]" RAT_FUNC "%1.0" "[Nm]" COEFFS 0 0.166666666667 34 0 0 1 /end COMPU_METHOD
/begin COMPU_METHOD UMR_NM_BAR2_1_100_0_S5_S3 "int = ((phys * 100) / 1) - (0) [Nm/bar^2]" RAT_FUNC "%3.2" "[Nm/bar^2]" COEFFS 0 100 0 0 0 1 /end COMPU_METHOD
/begin COMPU_METHOD UMR_NM_BAR_1_100_0_S5_S3 "int = ((phys * 100) / 1) - (0) [Nm/bar]" RAT_FUNC "%3.2" "[Nm/bar]" COEFFS 0 100 0 0 0 1 /end COMPU_METHOD
/begin COMPU_METHOD UMR_NM_SEC_10_1_0_S5_S3 "int = ((phys * 1) / 10) - (0) [Nm/s]" RAT_FUNC "%2.1" "[Nm/s]" COEFFS 0 0.1 0 0 0 1 /end COMPU_METHOD
/begin COMPU_METHOD UMR_PROZENT__20_51_0_S5_S3 "int = ((phys * 51) / 20) - (0) [%]" RAT_FUNC "%5.4" "[%]" COEFFS 0 2.55 0 0 0 1 /end COMPU_METHOD
/begin COMPU_METHOD UMR_SEC__1_1_0_S5_S3 "int = ((phys * 1) / 1) - (0) [s]" RAT_FUNC "%1.0" "[s]" COEFFS 0 1 0 0 0 1 /end COMPU_METHOD
/begin COMPU_METHOD UMR_U_MIN_1_1_0_S5_S3 "int = ((phys * 1) / 1) - (0) [U/min]" RAT_FUNC "%1.0" "[U/min]" COEFFS 0 1 0 0 0 1 /end COMPU_METHOD
/begin COMPU_METHOD UMR_U_MIN_32_1_0_S5_S3 "int = ((phys * 1) / 32) - (0) [U/min]" RAT_FUNC "%1.0" "[U/min]" COEFFS 0 0.03125 0 0 0 1 /end COMPU_METHOD
/begin COMPU_METHOD UMR_U_MINSEC_1_1_0_S5_S3 "int = ((phys * 1) / 1) - (0) [U/(min*s)]" RAT_FUNC "%1.0" "[U/(min*s)]" COEFFS 0 1 0 0 0 1 /end COMPU_METHOD
/begin COMPU_METHOD UMR_W_MM2_1_100_0_S5_S3 "int = ((phys * 100) / 1) - (0) [W/(mm^2)]" RAT_FUNC "%3.2" "[W/(mm^2)]" COEFFS 0 100 0 0 0 1 /end COMPU_METHOD
/begin CHARACTERISTIC CS_GABBHS "Getriebetemp.schwelle fuer Abbruch von Hochschaltungen" VALUE 0x1D7905 ZF_kw_ui8_S5_S3 220 UMR_GRADC__1_1_M40_S5_S3 -40 180 /end CHARACTERISTIC
/begin CHARACTERISTIC CS_GVERSHS "Untere Getriebetemp.schwelle fuer Verschacht. schaltungen HS" VALUE 0x1D7900 ZF_kw_ui8_S5_S3 190 UMR_GRADC__1_1_M40_S5_S3 -40 150 /end CHARACTERISTIC
/begin CHARACTERISTIC CS_GVERSRS "Untere Getriebetemp.schwelle fuer Verschacht. schaltungen RS" VALUE 0x1D7901 ZF_kw_ui8_S5_S3 190 UMR_GRADC__1_1_M40_S5_S3 -40 150 /end CHARACTERISTIC
/begin CHARACTERISTIC CS_OBSP "Obere Getriebetemperaturschwelle fuer verkuerzte RS" VALUE 0x1D7908 ZF_kw_ui8_S5_S3 190 UMR_GRADC__1_1_M40_S5_S3 -40 150 /end CHARACTERISTIC
/begin CHARACTERISTIC CS_OBSPORT "Obere Getriebetemperaturschwelle fuer sportl. RS" VALUE 0x1D790B ZF_kw_ui8_S5_S3 190 UMR_GRADC__1_1_M40_S5_S3 -40 150 /end CHARACTERISTIC
/begin CHARACTERISTIC CS_UNSPHS "Untere Getriebetemperaturschwelle fuer verkuerzte HS" VALUE 0x1D7909 ZF_kw_ui8_S5_S3 190 UMR_GRADC__1_1_M40_S5_S3 -40 150 /end CHARACTERISTIC
/begin CHARACTERISTIC CS_UNSPORTHS "Untere Getriebetemperaturschwelle fuer sportl. HS" VALUE 0x1D790C ZF_kw_ui8_S5_S3 190 UMR_GRADC__1_1_M40_S5_S3 -40 150 /end CHARACTERISTIC
/begin CHARACTERISTIC CS_UNSPORTRS "Untere Getriebetemperaturschwelle fuer sportl. RS" VALUE 0x1D790D ZF_kw_ui8_S5_S3 190 UMR_GRADC__1_1_M40_S5_S3 -40 150 /end CHARACTERISTIC
/begin CHARACTERISTIC CS_UNSPRS "Untere Getriebetemperaturschwelle fuer verkuerzte RS" VALUE 0x1D790A ZF_kw_ui8_S5_S3 190 UMR_GRADC__1_1_M40_S5_S3 -40 150 /end CHARACTERISTIC
/begin CHARACTERISTIC DKIS_VERS "DKI Schwelle Ausführung einer verschachtelten Schaltung" VALUE 0x1D7902 ZF_kw_ui8_S5_S3 100 UMR_PROZENT__20_51_0_S5_S3 0 100 /end CHARACTERISTIC
/begin CHARACTERISTIC F_VSYNABBHS "Faktor Drehzahlfenster GLS-Abbruch" VALUE 0x1D7906 ZF_kw_ui8_S5_S3 100 UMR_PROZENT__20_51_0_S5_S3 0 100 /end CHARACTERISTIC
/begin CHARACTERISTIC HYS_NGS_VERIAE12 "Hysterese für Gradientenschwelle bei IAE" VALUE 0x1D86B8 ZF_kw_si16_S5_S3 20000 UMR_U_MINSEC_1_1_0_S5_S3 -10000 10000 /end CHARACTERISTIC
/begin CHARACTERISTIC HYS_NGS_VERIAE23 "Hysterese für Gradientenschwelle bei IAE" VALUE 0x1D86C6 ZF_kw_si16_S5_S3 20000 UMR_U_MINSEC_1_1_0_S5_S3 -10000 10000 /end CHARACTERISTIC
/begin CHARACTERISTIC HYS_NGS_VERIAE34 "Hysterese für Gradientenschwelle bei IAE" VALUE 0x1D86D4 ZF_kw_si16_S5_S3 20000 UMR_U_MINSEC_1_1_0_S5_S3 -10000 10000 /end CHARACTERISTIC
/begin CHARACTERISTIC HYS_NGS_VERIAE45 "Hysterese für Gradientenschwelle bei IAE" VALUE 0x1D86E2 ZF_kw_si16_S5_S3 20000 UMR_U_MINSEC_1_1_0_S5_S3 -10000 10000 /end CHARACTERISTIC
/begin CHARACTERISTIC HYS_NGS_VERIAE56 "Hysterese für Gradientenschwelle bei IAE" VALUE 0x1D86F0 ZF_kw_si16_S5_S3 20000 UMR_U_MINSEC_1_1_0_S5_S3 -10000 10000 /end CHARACTERISTIC
/begin CHARACTERISTIC HYS_NGS_VERIAE67 "Hysterese für Gradientenschwelle bei IAE" VALUE 0x1D86FE ZF_kw_si16_S5_S3 20000 UMR_U_MINSEC_1_1_0_S5_S3 -10000 10000 /end CHARACTERISTIC
/begin CHARACTERISTIC HYS_NGS_VERIAE78 "Hysterese für Gradientenschwelle bei IAE" VALUE 0x1D870C ZF_kw_si16_S5_S3 20000 UMR_U_MINSEC_1_1_0_S5_S3 -10000 10000 /end CHARACTERISTIC
/begin CHARACTERISTIC KF_FMESASMEHAUPTPOSESPORT65 "Faktor fuer Reduzierung pos ME bei RS" MAP 0x1AD5C0 ZF_kf_si16_S5_S3 1 UMR___1_100_0_S5_S3 0 1
 /begin AXIS_DESCR STD_AXIS iMoeMesaf.timer_rampe_pos UMR_MSEC__10_1_0_S5_S3 4 0 2550 DEPOSIT ABSOLUTE /end AXIS_DESCR
 /begin AXIS_DESCR STD_AXIS iMoeMesaf.me_sas_gesp UMR_NM__1_1_0_S5_S3 4 0 1500 DEPOSIT ABSOLUTE /end AXIS_DESCR
/end CHARACTERISTIC
/begin CHARACTERISTIC KF_FMESASMEHAUPTPOSESPORT71 "Faktor fuer Reduzierung pos ME bei RS" MAP 0x1AE0B8 ZF_kf_si16_S5_S3 1 UMR___1_100_0_S5_S3 0 1
 /begin AXIS_DESCR STD_AXIS iMoeMesaf.timer_rampe_pos UMR_MSEC__10_1_0_S5_S3 4 0 2550 DEPOSIT ABSOLUTE /end AXIS_DESCR
 /begin AXIS_DESCR STD_AXIS iMoeMesaf.me_sas_gesp UMR_NM__1_1_0_S5_S3 4 0 1500 DEPOSIT ABSOLUTE /end AXIS_DESCR
/end CHARACTERISTIC
/begin CHARACTERISTIC KF_FMESASMEHAUPTPOSESPORT75 "Faktor fuer Reduzierung pos ME bei RS" MAP 0x1AE1F0 ZF_kf_si16_S5_S3 1 UMR___1_100_0_S5_S3 0 1
 /begin AXIS_DESCR STD_AXIS iMoeMesaf.timer_rampe_pos UMR_MSEC__10_1_0_S5_S3 4 0 2550 DEPOSIT ABSOLUTE /end AXIS_DESCR
 /begin AXIS_DESCR STD_AXIS iMoeMesaf.me_sas_gesp UMR_NM__1_1_0_S5_S3 4 0 1500 DEPOSIT ABSOLUTE /end AXIS_DESCR
/end CHARACTERISTIC
/begin CHARACTERISTIC KF_FMESASMEHAUPTPOSESPORT76 "Faktor fuer Reduzierung pos ME bei RS" MAP 0x1AD6F8 ZF_kf_si16_S5_S3 1 UMR___1_100_0_S5_S3 0 1
 /begin AXIS_DESCR STD_AXIS iMoeMesaf.timer_rampe_pos UMR_MSEC__10_1_0_S5_S3 4 0 2550 DEPOSIT ABSOLUTE /end AXIS_DESCR
 /begin AXIS_DESCR STD_AXIS iMoeMesaf.me_sas_gesp UMR_NM__1_1_0_S5_S3 4 0 1500 DEPOSIT ABSOLUTE /end AXIS_DESCR
/end CHARACTERISTIC
/begin CHARACTERISTIC KF_FMESASMEHAUPTPOSESPORT82 "Faktor fuer Reduzierung pos ME bei RS" MAP 0x1AE328 ZF_kf_si16_S5_S3 1 UMR___1_100_0_S5_S3 0 1
 /begin AXIS_DESCR STD_AXIS iMoeMesaf.timer_rampe_pos UMR_MSEC__10_1_0_S5_S3 4 0 2550 DEPOSIT ABSOLUTE /end AXIS_DESCR
 /begin AXIS_DESCR STD_AXIS iMoeMesaf.me_sas_gesp UMR_NM__1_1_0_S5_S3 4 0 1500 DEPOSIT ABSOLUTE /end AXIS_DESCR
/end CHARACTERISTIC
/begin CHARACTERISTIC KF_FMESASMEHAUPTPOSESPORT84 "Faktor fuer Reduzierung pos ME bei RS" MAP 0x1AE460 ZF_kf_si16_S5_S3 1 UMR___1_100_0_S5_S3 0 1
 /begin AXIS_DESCR STD_AXIS iMoeMesaf.timer_rampe_pos UMR_MSEC__10_1_0_S5_S3 4 0 2550 DEPOSIT ABSOLUTE /end AXIS_DESCR
 /begin AXIS_DESCR STD_AXIS iMoeMesaf.me_sas_gesp UMR_NM__1_1_0_S5_S3 4 0 1500 DEPOSIT ABSOLUTE /end AXIS_DESCR
/end CHARACTERISTIC
/begin CHARACTERISTIC KF_FMESASMEHAUPTPOSESPORT86 "Faktor fuer Reduzierung pos ME bei RS" MAP 0x1AE598 ZF_kf_si16_S5_S3 1 UMR___1_100_0_S5_S3 0 1
 /begin AXIS_DESCR STD_AXIS iMoeMesaf.timer_rampe_pos UMR_MSEC__10_1_0_S5_S3 4 0 2550 DEPOSIT ABSOLUTE /end AXIS_DESCR
 /begin AXIS_DESCR STD_AXIS iMoeMesaf.me_sas_gesp UMR_NM__1_1_0_S5_S3 4 0 1500 DEPOSIT ABSOLUTE /end AXIS_DESCR
/end CHARACTERISTIC
/begin CHARACTERISTIC KF_FMESASMEHAUPTPOSESPORT87 "Faktor fuer Reduzierung pos ME bei RS" MAP 0x1AD830 ZF_kf_si16_S5_S3 1 UMR___1_100_0_S5_S3 0 1
 /begin AXIS_DESCR STD_AXIS iMoeMesaf.timer_rampe_pos UMR_MSEC__10_1_0_S5_S3 4 0 2550 DEPOSIT ABSOLUTE /end AXIS_DESCR
 /begin AXIS_DESCR STD_AXIS iMoeMesaf.me_sas_gesp UMR_NM__1_1_0_S5_S3 4 0 1500 DEPOSIT ABSOLUTE /end AXIS_DESCR
/end CHARACTERISTIC
/begin CHARACTERISTIC KF_FMEVORLUFT21 "Faktor auf Momentenvorhalt bei RS" MAP 0x1AE604 ZF_kf_si16_S5_S3 1 UMR___1_100_0_S5_S3 0 1
 /begin AXIS_DESCR STD_AXIS zff_atsys._.iSignale._.obj.sig_n_mot UMR_U_MIN_1_1_0_S5_S3 4 0 8160 DEPOSIT ABSOLUTE /end AXIS_DESCR
 /begin AXIS_DESCR STD_AXIS iMoeMesaf.me_sas UMR_NM__1_1_0_S5_S3 4 -1500 1500 DEPOSIT ABSOLUTE /end AXIS_DESCR
/end CHARACTERISTIC
/begin CHARACTERISTIC KF_FMEVORLUFT32 "Faktor auf Momentenvorhalt bei RS" MAP 0x1AE670 ZF_kf_si16_S5_S3 1 UMR___1_100_0_S5_S3 0 1
 /begin AXIS_DESCR STD_AXIS zff_atsys._.iSignale._.obj.sig_n_mot UMR_U_MIN_1_1_0_S5_S3 4 0 8160 DEPOSIT ABSOLUTE /end AXIS_DESCR
 /begin AXIS_DESCR STD_AXIS iMoeMesaf.me_sas UMR_NM__1_1_0_S5_S3 4 -1500 1500 DEPOSIT ABSOLUTE /end AXIS_DESCR
/end CHARACTERISTIC
/begin CHARACTERISTIC KF_FMEVORLUFT43 "Faktor auf Momentenvorhalt bei RS" MAP 0x1AE6DC ZF_kf_si16_S5_S3 1 UMR___1_100_0_S5_S3 0 1
 /begin AXIS_DESCR STD_AXIS zff_atsys._.iSignale._.obj.sig_n_mot UMR_U_MIN_1_1_0_S5_S3 4 0 8160 DEPOSIT ABSOLUTE /end AXIS_DESCR
 /begin AXIS_DESCR STD_AXIS iMoeMesaf.me_sas UMR_NM__1_1_0_S5_S3 4 -1500 1500 DEPOSIT ABSOLUTE /end AXIS_DESCR
/end CHARACTERISTIC
/begin CHARACTERISTIC KF_FMEVORLUFT54 "Faktor auf Momentenvorhalt bei RS" MAP 0x1AE748 ZF_kf_si16_S5_S3 1 UMR___1_100_0_S5_S3 0 1
 /begin AXIS_DESCR STD_AXIS zff_atsys._.iSignale._.obj.sig_n_mot UMR_U_MIN_1_1_0_S5_S3 4 0 8160 DEPOSIT ABSOLUTE /end AXIS_DESCR
 /begin AXIS_DESCR STD_AXIS iMoeMesaf.me_sas UMR_NM__1_1_0_S5_S3 4 -1500 1500 DEPOSIT ABSOLUTE /end AXIS_DESCR
/end CHARACTERISTIC
/begin CHARACTERISTIC KF_FMEVORLUFT65 "Faktor auf Momentenvorhalt bei RS" MAP 0x1AE7B4 ZF_kf_si16_S5_S3 1 UMR___1_100_0_S5_S3 0 1
 /begin AXIS_DESCR STD_AXIS zff_atsys._.iSignale._.obj.sig_n_mot UMR_U_MIN_1_1_0_S5_S3 4 0 8160 DEPOSIT ABSOLUTE /end AXIS_DESCR
 /begin AXIS_DESCR STD_AXIS iMoeMesaf.me_sas UMR_NM__1_1_0_S5_S3 4 -1500 1500 DEPOSIT ABSOLUTE /end AXIS_DESCR
/end CHARACTERISTIC
/begin CHARACTERISTIC KF_FMEVORLUFT76 "Faktor auf Momentenvorhalt bei RS" MAP 0x1AE820 ZF_kf_si16_S5_S3 1 UMR___1_100_0_S5_S3 0 1
 /begin AXIS_DESCR STD_AXIS zff_atsys._.iSignale._.obj.sig_n_mot UMR_U_MIN_1_1_0_S5_S3 4 0 8160 DEPOSIT ABSOLUTE /end AXIS_DESCR
 /begin AXIS_DESCR STD_AXIS iMoeMesaf.me_sas UMR_NM__1_1_0_S5_S3 4 -1500 1500 DEPOSIT ABSOLUTE /end AXIS_DESCR
/end CHARACTERISTIC
/begin CHARACTERISTIC KF_FMEVORLUFT87 "Faktor auf Momentenvorhalt bei RS" MAP 0x1AE88C ZF_kf_si16_S5_S3 1 UMR___1_100_0_S5_S3 0 1
 /begin AXIS_DESCR STD_AXIS zff_atsys._.iSignale._.obj.sig_n_mot UMR_U_MIN_1_1_0_S5_S3 4 0 8160 DEPOSIT ABSOLUTE /end AXIS_DESCR
 /begin AXIS_DESCR STD_AXIS iMoeMesaf.me_sas UMR_NM__1_1_0_S5_S3 4 -1500 1500 DEPOSIT ABSOLUTE /end AXIS_DESCR
/end CHARACTERISTIC
/begin CHARACTERISTIC KF_FMEVORLUFTSP31 "Faktor auf Momentenvorhalt bei RS" MAP 0x1AE8F8 ZF_kf_si16_S5_S3 1 UMR___1_100_0_S5_S3 0 1
 /begin AXIS_DESCR STD_AXIS zff_atsys._.iSignale._.obj.sig_n_mot UMR_U_MIN_1_1_0_S5_S3 4 0 8160 DEPOSIT ABSOLUTE /end AXIS_DESCR
 /begin AXIS_DESCR STD_AXIS iMoeMesaf.me_sas UMR_NM__1_1_0_S5_S3 4 -1500 1500 DEPOSIT ABSOLUTE /end AXIS_DESCR
/end CHARACTERISTIC
/begin CHARACTERISTIC KF_FMEVORLUFTSP42 "Faktor auf Momentenvorhalt bei RS" MAP 0x1AE964 ZF_kf_si16_S5_S3 1 UMR___1_100_0_S5_S3 0 1
 /begin AXIS_DESCR STD_AXIS zff_atsys._.iSignale._.obj.sig_n_mot UMR_U_MIN_1_1_0_S5_S3 4 0 8160 DEPOSIT ABSOLUTE /end AXIS_DESCR
 /begin AXIS_DESCR STD_AXIS iMoeMesaf.me_sas UMR_NM__1_1_0_S5_S3 4 -1500 1500 DEPOSIT ABSOLUTE /end AXIS_DESCR
/end CHARACTERISTIC
/begin CHARACTERISTIC KF_FMEVORLUFTSP51 "Faktor auf Momentenvorhalt bei RS" MAP 0x1AE9D0 ZF_kf_si16_S5_S3 1 UMR___1_100_0_S5_S3 0 1
 /begin AXIS_DESCR STD_AXIS zff_atsys._.iSignale._.obj.sig_n_mot UMR_U_MIN_1_1_0_S5_S3 4 0 8160 DEPOSIT ABSOLUTE /end AXIS_DESCR
 /begin AXIS_DESCR STD_AXIS iMoeMesaf.me_sas UMR_NM__1_1_0_S5_S3 4 -1500 1500 DEPOSIT ABSOLUTE /end AXIS_DESCR
/end CHARACTERISTIC
/begin CHARACTERISTIC KF_FMEVORLUFTSP53 "Faktor auf Momentenvorhalt bei RS" MAP 0x1AEA3C ZF_kf_si16_S5_S3 1 UMR___1_100_0_S5_S3 0 1
 /begin AXIS_DESCR STD_AXIS zff_atsys._.iSignale._.obj.sig_n_mot UMR_U_MIN_1_1_0_S5_S3 4 0 8160 DEPOSIT ABSOLUTE /end AXIS_DESCR
 /begin AXIS_DESCR STD_AXIS iMoeMesaf.me_sas UMR_NM__1_1_0_S5_S3 4 -1500 1500 DEPOSIT ABSOLUTE /end AXIS_DESCR
/end CHARACTERISTIC
/begin CHARACTERISTIC KF_FMEVORLUFTSP63 "Faktor auf Momentenvorhalt bei RS" MAP 0x1AEAA8 ZF_kf_si16_S5_S3 1 UMR___1_100_0_S5_S3 0 1
 /begin AXIS_DESCR STD_AXIS zff_atsys._.iSignale._.obj.sig_n_mot UMR_U_MIN_1_1_0_S5_S3 4 0 8160 DEPOSIT ABSOLUTE /end AXIS_DESCR
 /begin AXIS_DESCR STD_AXIS iMoeMesaf.me_sas UMR_NM__1_1_0_S5_S3 4 -1500 1500 DEPOSIT ABSOLUTE /end AXIS_DESCR
/end CHARACTERISTIC
/begin CHARACTERISTIC KF_FMEVORLUFTSP64 "Faktor auf Momentenvorhalt bei RS" MAP 0x1AEB14 ZF_kf_si16_S5_S3 1 UMR___1_100_0_S5_S3 0 1
 /begin AXIS_DESCR STD_AXIS zff_atsys._.iSignale._.obj.sig_n_mot UMR_U_MIN_1_1_0_S5_S3 4 0 8160 DEPOSIT ABSOLUTE /end AXIS_DESCR
 /begin AXIS_DESCR STD_AXIS iMoeMesaf.me_sas UMR_NM__1_1_0_S5_S3 4 -1500 1500 DEPOSIT ABSOLUTE /end AXIS_DESCR
/end CHARACTERISTIC
/begin CHARACTERISTIC KF_FMEVORLUFTSP71 "Faktor auf Momentenvorhalt bei RS" MAP 0x1AEB80 ZF_kf_si16_S5_S3 1 UMR___1_100_0_S5_S3 0 1
 /begin AXIS_DESCR STD_AXIS zff_atsys._.iSignale._.obj.sig_n_mot UMR_U_MIN_1_1_0_S5_S3 4 0 8160 DEPOSIT ABSOLUTE /end AXIS_DESCR
 /begin AXIS_DESCR STD_AXIS iMoeMesaf.me_sas UMR_NM__1_1_0_S5_S3 4 -1500 1500 DEPOSIT ABSOLUTE /end AXIS_DESCR
/end CHARACTERISTIC
/begin CHARACTERISTIC KF_FMEVORLUFTSP75 "Faktor auf Momentenvorhalt bei RS" MAP 0x1AEBEC ZF_kf_si16_S5_S3 1 UMR___1_100_0_S5_S3 0 1
 /begin AXIS_DESCR STD_AXIS zff_atsys._.iSignale._.obj.sig_n_mot UMR_U_MIN_1_1_0_S5_S3 4 0 8160 DEPOSIT ABSOLUTE /end AXIS_DESCR
 /begin AXIS_DESCR STD_AXIS iMoeMesaf.me_sas UMR_NM__1_1_0_S5_S3 4 -1500 1500 DEPOSIT ABSOLUTE /end AXIS_DESCR
/end CHARACTERISTIC
/begin CHARACTERISTIC KF_FMEVORLUFTSP82 "Faktor auf Momentenvorhalt bei RS" MAP 0x1AEC58 ZF_kf_si16_S5_S3 1 UMR___1_100_0_S5_S3 0 1
 /begin AXIS_DESCR STD_AXIS zff_atsys._.iSignale._.obj.sig_n_mot UMR_U_MIN_1_1_0_S5_S3 4 0 8160 DEPOSIT ABSOLUTE /end AXIS_DESCR
 /begin AXIS_DESCR STD_AXIS iMoeMesaf.me_sas UMR_NM__1_1_0_S5_S3 4 -1500 1500 DEPOSIT ABSOLUTE /end AXIS_DESCR
/end CHARACTERISTIC
/begin CHARACTERISTIC KF_FMEVORLUFTSP84 "Faktor auf Momentenvorhalt bei RS" MAP 0x1AECC4 ZF_kf_si16_S5_S3 1 UMR___1_100_0_S5_S3 0 1
 /begin AXIS_DESCR STD_AXIS zff_atsys._.iSignale._.obj.sig_n_mot UMR_U_MIN_1_1_0_S5_S3 4 0 8160 DEPOSIT ABSOLUTE /end AXIS_DESCR
 /begin AXIS_DESCR STD_AXIS iMoeMesaf.me_sas UMR_NM__1_1_0_S5_S3 4 -1500 1500 DEPOSIT ABSOLUTE /end AXIS_DESCR
/end CHARACTERISTIC
/begin CHARACTERISTIC KF_FMEVORLUFTSP86 "Faktor auf Momentenvorhalt bei RS" MAP 0x1AED30 ZF_kf_si16_S5_S3 1 UMR___1_100_0_S5_S3 0 1
 /begin AXIS_DESCR STD_AXIS zff_atsys._.iSignale._.obj.sig_n_mot UMR_U_MIN_1_1_0_S5_S3 4 0 8160 DEPOSIT ABSOLUTE /end AXIS_DESCR
 /begin AXIS_DESCR STD_AXIS iMoeMesaf.me_sas UMR_NM__1_1_0_S5_S3 4 -1500 1500 DEPOSIT ABSOLUTE /end AXIS_DESCR
/end CHARACTERISTIC
/begin CHARACTERISTIC KF_FMTMEHAUPTASPORT65 "Faktor fuer Rampe auf HME bei RS" MAP 0x1AD50C ZF_kf_ui8_S5_S3 1 UMR___1_100_0_S5_S3 0 1
 /begin AXIS_DESCR STD_AXIS iMoeMesaf.timer_zmes UMR_MSEC__10_1_0_S5_S3 4 0 2550 DEPOSIT ABSOLUTE /end AXIS_DESCR
 /begin AXIS_DESCR STD_AXIS zff_atsys._.iSignale._.obj.sig_m_t8 UMR_NM__6_1_M34_S5_S3 4 -204 1326 DEPOSIT ABSOLUTE /end AXIS_DESCR
/end CHARACTERISTIC
/begin CHARACTERISTIC KF_FMTMEHAUPTASPORT71 "Faktor fuer Rampe auf HME bei RS" MAP 0x1AE004 ZF_kf_ui8_S5_S3 1 UMR___1_100_0_S5_S3 0 1
 /begin AXIS_DESCR STD_AXIS iMoeMesaf.timer_zmes UMR_MSEC__10_1_0_S5_S3 4 0 2550 DEPOSIT ABSOLUTE /end AXIS_DESCR
 /begin AXIS_DESCR STD_AXIS zff_atsys._.iSignale._.obj.sig_m_t8 UMR_NM__6_1_M34_S5_S3 4 -204 1326 DEPOSIT ABSOLUTE /end AXIS_DESCR
/end CHARACTERISTIC
/begin CHARACTERISTIC KF_FMTMEHAUPTASPORT75 "Faktor fuer Rampe auf HME bei RS" MAP 0x1AE13C ZF_kf_ui8_S5_S3 1 UMR___1_100_0_S5_S3 0 1
 /begin AXIS_DESCR STD_AXIS iMoeMesaf.timer_zmes UMR_MSEC__10_1_0_S5_S3 4 0 2550 DEPOSIT ABSOLUTE /end AXIS_DESCR
 /begin AXIS_DESCR STD_AXIS zff_atsys._.iSignale._.obj.sig_m_t8 UMR_NM__6_1_M34_S5_S3 4 -204 1326 DEPOSIT ABSOLUTE /end AXIS_DESCR
/end CHARACTERISTIC
/begin CHARACTERISTIC KF_FMTMEHAUPTASPORT76 "Faktor fuer Rampe auf HME bei RS" MAP 0x1AD644 ZF_kf_ui8_S5_S3 1 UMR___1_100_0_S5_S3 0 1
 /begin AXIS_DESCR STD_AXIS iMoeMesaf.timer_zmes UMR_MSEC__10_1_0_S5_S3 4 0 2550 DEPOSIT ABSOLUTE /end AXIS_DESCR
 /begin AXIS_DESCR STD_AXIS zff_atsys._.iSignale._.obj.sig_m_t8 UMR_NM__6_1_M34_S5_S3 4 -204 1326 DEPOSIT ABSOLUTE /end AXIS_DESCR
/end CHARACTERISTIC
/begin CHARACTERISTIC KF_FMTMEHAUPTASPORT82 "Faktor fuer Rampe auf HME bei RS" MAP 0x1AE274 ZF_kf_ui8_S5_S3 1 UMR___1_100_0_S5_S3 0 1
 /begin AXIS_DESCR STD_AXIS iMoeMesaf.timer_zmes UMR_MSEC__10_1_0_S5_S3 4 0 2550 DEPOSIT ABSOLUTE /end AXIS_DESCR
 /begin AXIS_DESCR STD_AXIS zff_atsys._.iSignale._.obj.sig_m_t8 UMR_NM__6_1_M34_S5_S3 4 -204 1326 DEPOSIT ABSOLUTE /end AXIS_DESCR
/end CHARACTERISTIC
/begin CHARACTERISTIC KF_FMTMEHAUPTASPORT84 "Faktor fuer Rampe auf HME bei RS" MAP 0x1AE3AC ZF_kf_ui8_S5_S3 1 UMR___1_100_0_S5_S3 0 1
 /begin AXIS_DESCR STD_AXIS iMoeMesaf.timer_zmes UMR_MSEC__10_1_0_S5_S3 4 0 2550 DEPOSIT ABSOLUTE /end AXIS_DESCR
 /begin AXIS_DESCR STD_AXIS zff_atsys._.iSignale._.obj.sig_m_t8 UMR_NM__6_1_M34_S5_S3 4 -204 1326 DEPOSIT ABSOLUTE /end AXIS_DESCR
/end CHARACTERISTIC
/begin CHARACTERISTIC KF_FMTMEHAUPTASPORT86 "Faktor fuer Rampe auf HME bei RS" MAP 0x1AE4E4 ZF_kf_ui8_S5_S3 1 UMR___1_100_0_S5_S3 0 1
 /begin AXIS_DESCR STD_AXIS iMoeMesaf.timer_zmes UMR_MSEC__10_1_0_S5_S3 4 0 2550 DEPOSIT ABSOLUTE /end AXIS_DESCR
 /begin AXIS_DESCR STD_AXIS zff_atsys._.iSignale._.obj.sig_m_t8 UMR_NM__6_1_M34_S5_S3 4 -204 1326 DEPOSIT ABSOLUTE /end AXIS_DESCR
/end CHARACTERISTIC
/begin CHARACTERISTIC KF_FMTMEHAUPTASPORT87 "Faktor fuer Rampe auf HME bei RS" MAP 0x1AD77C ZF_kf_ui8_S5_S3 1 UMR___1_100_0_S5_S3 0 1
 /begin AXIS_DESCR STD_AXIS iMoeMesaf.timer_zmes UMR_MSEC__10_1_0_S5_S3 4 0 2550 DEPOSIT ABSOLUTE /end AXIS_DESCR
 /begin AXIS_DESCR STD_AXIS zff_atsys._.iSignale._.obj.sig_m_t8 UMR_NM__6_1_M34_S5_S3 4 -204 1326 DEPOSIT ABSOLUTE /end AXIS_DESCR
/end CHARACTERISTIC
/begin CHARACTERISTIC KF_FTSYNNTMEHAUPTE12 "Faktor auf Haupt-ME fuer Nach-ME" MAP 0x1A7524 ZF_kf_si16_S5_S3 1 UMR___1_100_0_S5_S3 0 1
 /begin AXIS_DESCR STD_AXIS iSasZentr.iSchaltend.t_syn UMR_MSEC__10_1_0_S5_S3 6 -5000 5000 DEPOSIT ABSOLUTE /end AXIS_DESCR
 /begin AXIS_DESCR STD_AXIS zff_atsys._.iSignale._.obj.sig_n_t UMR_U_MIN_1_1_0_S5_S3 4 0 8160 DEPOSIT ABSOLUTE /end AXIS_DESCR
/end CHARACTERISTIC
/begin CHARACTERISTIC KF_FTSYNNTMEHAUPTE23 "Faktor auf Haupt-ME fuer Nach-ME" MAP 0x1A7650 ZF_kf_si16_S5_S3 1 UMR___1_100_0_S5_S3 0 1
 /begin AXIS_DESCR STD_AXIS iSasZentr.iSchaltend.t_syn UMR_MSEC__10_1_0_S5_S3 6 -5000 5000 DEPOSIT ABSOLUTE /end AXIS_DESCR
 /begin AXIS_DESCR STD_AXIS zff_atsys._.iSignale._.obj.sig_n_t UMR_U_MIN_1_1_0_S5_S3 4 0 8160 DEPOSIT ABSOLUTE /end AXIS_DESCR
/end CHARACTERISTIC
/begin CHARACTERISTIC KF_FTSYNNTMEHAUPTE34 "Faktor auf Haupt-ME fuer Nach-ME" MAP 0x1A777C ZF_kf_si16_S5_S3 1 UMR___1_100_0_S5_S3 0 1
 /begin AXIS_DESCR STD_AXIS iSasZentr.iSchaltend.t_syn UMR_MSEC__10_1_0_S5_S3 6 -5000 5000 DEPOSIT ABSOLUTE /end AXIS_DESCR
 /begin AXIS_DESCR STD_AXIS zff_atsys._.iSignale._.obj.sig_n_t UMR_U_MIN_1_1_0_S5_S3 4 0 8160 DEPOSIT ABSOLUTE /end AXIS_DESCR
/end CHARACTERISTIC
/begin CHARACTERISTIC KF_FTSYNNTMEHAUPTE45 "Faktor auf Haupt-ME fuer Nach-ME" MAP 0x1A78A8 ZF_kf_si16_S5_S3 1 UMR___1_100_0_S5_S3 0 1
 /begin AXIS_DESCR STD_AXIS iSasZentr.iSchaltend.t_syn UMR_MSEC__10_1_0_S5_S3 6 -5000 5000 DEPOSIT ABSOLUTE /end AXIS_DESCR
 /begin AXIS_DESCR STD_AXIS zff_atsys._.iSignale._.obj.sig_n_t UMR_U_MIN_1_1_0_S5_S3 4 0 8160 DEPOSIT ABSOLUTE /end AXIS_DESCR
/end CHARACTERISTIC
/begin CHARACTERISTIC KF_FTSYNNTMEHAUPTE56 "Faktor auf Haupt-ME fuer Nach-ME" MAP 0x1A79D4 ZF_kf_si16_S5_S3 1 UMR___1_100_0_S5_S3 0 1
 /begin AXIS_DESCR STD_AXIS iSasZentr.iSchaltend.t_syn UMR_MSEC__10_1_0_S5_S3 6 -5000 5000 DEPOSIT ABSOLUTE /end AXIS_DESCR
 /begin AXIS_DESCR STD_AXIS zff_atsys._.iSignale._.obj.sig_n_t UMR_U_MIN_1_1_0_S5_S3 4 0 8160 DEPOSIT ABSOLUTE /end AXIS_DESCR
/end CHARACTERISTIC
/begin CHARACTERISTIC KF_FTSYNNTMEHAUPTE67 "Faktor auf Haupt-ME fuer Nach-ME" MAP 0x1A7B00 ZF_kf_si16_S5_S3 1 UMR___1_100_0_S5_S3 0 1
 /begin AXIS_DESCR STD_AXIS iSasZentr.iSchaltend.t_syn UMR_MSEC__10_1_0_S5_S3 6 -5000 5000 DEPOSIT ABSOLUTE /end AXIS_DESCR
 /begin AXIS_DESCR STD_AXIS zff_atsys._.iSignale._.obj.sig_n_t UMR_U_MIN_1_1_0_S5_S3 4 0 8160 DEPOSIT ABSOLUTE /end AXIS_DESCR
/end CHARACTERISTIC
/begin CHARACTERISTIC KF_FTSYNNTMEHAUPTE78 "Faktor auf Haupt-ME fuer Nach-ME" MAP 0x1A7C2C ZF_kf_si16_S5_S3 1 UMR___1_100_0_S5_S3 0 1
 /begin AXIS_DESCR STD_AXIS iSasZentr.iSchaltend.t_syn UMR_MSEC__10_1_0_S5_S3 6 -5000 5000 DEPOSIT ABSOLUTE /end AXIS_DESCR
 /begin AXIS_DESCR STD_AXIS zff_atsys._.iSignale._.obj.sig_n_t UMR_U_MIN_1_1_0_S5_S3 4 0 8160 DEPOSIT ABSOLUTE /end AXIS_DESCR
/end CHARACTERISTIC
/begin CHARACTERISTIC KF_FTSYNNTMEHAUPTESP12 "Faktor auf Haupt-ME fuer Nach-ME" MAP 0x1A7D48 ZF_kf_si16_S5_S3 1 UMR___1_100_0_S5_S3 0 1
 /begin AXIS_DESCR STD_AXIS iSasZentr.iSchaltend.t_syn UMR_MSEC__10_1_0_S5_S3 6 -5000 5000 DEPOSIT ABSOLUTE /end AXIS_DESCR
 /begin AXIS_DESCR STD_AXIS zff_atsys._.iSignale._.obj.sig_n_t UMR_U_MIN_1_1_0_S5_S3 4 0 8160 DEPOSIT ABSOLUTE /end AXIS_DESCR
/end CHARACTERISTIC
/begin CHARACTERISTIC KF_FTSYNNTMEHAUPTESP23 "Faktor auf Haupt-ME fuer Nach-ME" MAP 0x1A7E04 ZF_kf_si16_S5_S3 1 UMR___1_100_0_S5_S3 0 1
 /begin AXIS_DESCR STD_AXIS iSasZentr.iSchaltend.t_syn UMR_MSEC__10_1_0_S5_S3 6 -5000 5000 DEPOSIT ABSOLUTE /end AXIS_DESCR
 /begin AXIS_DESCR STD_AXIS zff_atsys._.iSignale._.obj.sig_n_t UMR_U_MIN_1_1_0_S5_S3 4 0 8160 DEPOSIT ABSOLUTE /end AXIS_DESCR
/end CHARACTERISTIC
/begin CHARACTERISTIC KF_FTSYNNTMEHAUPTESP34 "Faktor auf Haupt-ME fuer Nach-ME" MAP 0x1A7EC0 ZF_kf_si16_S5_S3 1 UMR___1_100_0_S5_S3 0 1
 /begin AXIS_DESCR STD_AXIS iSasZentr.iSchaltend.t_syn UMR_MSEC__10_1_0_S5_S3 6 -5000 5000 DEPOSIT ABSOLUTE /end AXIS_DESCR
 /begin AXIS_DESCR STD_AXIS zff_atsys._.iSignale._.obj.sig_n_t UMR_U_MIN_1_1_0_S5_S3 4 0 8160 DEPOSIT ABSOLUTE /end AXIS_DESCR
/end CHARACTERISTIC
/begin CHARACTERISTIC KF_FTSYNNTMEHAUPTESP45 "Faktor auf Haupt-ME fuer Nach-ME" MAP 0x1A7F7C ZF_kf_si16_S5_S3 1 UMR___1_100_0_S5_S3 0 1
 /begin AXIS_DESCR STD_AXIS iSasZentr.iSchaltend.t_syn UMR_MSEC__10_1_0_S5_S3 6 -5000 5000 DEPOSIT ABSOLUTE /end AXIS_DESCR
 /begin AXIS_DESCR STD_AXIS zff_atsys._.iSignale._.obj.sig_n_t UMR_U_MIN_1_1_0_S5_S3 4 0 8160 DEPOSIT ABSOLUTE /end AXIS_DESCR
/end CHARACTERISTIC
/begin CHARACTERISTIC KF_FTSYNNTMEHAUPTESP56 "Faktor auf Haupt-ME fuer Nach-ME" MAP 0x1A8038 ZF_kf_si16_S5_S3 1 UMR___1_100_0_S5_S3 0 1
 /begin AXIS_DESCR STD_AXIS iSasZentr.iSchaltend.t_syn UMR_MSEC__10_1_0_S5_S3 6 -5000 5000 DEPOSIT ABSOLUTE /end AXIS_DESCR
 /begin AXIS_DESCR STD_AXIS zff_atsys._.iSignale._.obj.sig_n_t UMR_U_MIN_1_1_0_S5_S3 4 0 8160 DEPOSIT ABSOLUTE /end AXIS_DESCR
/end CHARACTERISTIC
/begin CHARACTERISTIC KF_FTSYNNTMEHAUPTESP67 "Faktor auf Haupt-ME fuer Nach-ME" MAP 0x1A80F4 ZF_kf_si16_S5_S3 1 UMR___1_100_0_S5_S3 0 1
 /begin AXIS_DESCR STD_AXIS iSasZentr.iSchaltend.t_syn UMR_MSEC__10_1_0_S5_S3 6 -5000 5000 DEPOSIT ABSOLUTE /end AXIS_DESCR
 /begin AXIS_DESCR STD_AXIS zff_atsys._.iSignale._.obj.sig_n_t UMR_U_MIN_1_1_0_S5_S3 4 0 8160 DEPOSIT ABSOLUTE /end AXIS_DESCR
/end CHARACTERISTIC
/begin CHARACTERISTIC KF_FTSYNNTMEHAUPTESP78 "Faktor auf Haupt-ME fuer Nach-ME" MAP 0x1A81B0 ZF_kf_si16_S5_S3 1 UMR___1_100_0_S5_S3 0 1
 /begin AXIS_DESCR STD_AXIS iSasZentr.iSchaltend.t_syn UMR_MSEC__10_1_0_S5_S3 6 -5000 5000 DEPOSIT ABSOLUTE /end AXIS_DESCR
 /begin AXIS_DESCR STD_AXIS zff_atsys._.iSignale._.obj.sig_n_t UMR_U_MIN_1_1_0_S5_S3 4 0 8160 DEPOSIT ABSOLUTE /end AXIS_DESCR
/end CHARACTERISTIC
/begin CHARACTERISTIC KF_FTSYNNTMEHAUPTESPORT12 "Faktor auf Haupt-ME fuer Nach-ME" MAP 0x1A826C ZF_kf_si16_S5_S3 1 UMR___1_100_0_S5_S3 0 1
 /begin AXIS_DESCR STD_AXIS iSasZentr.iSchaltend.t_syn UMR_MSEC__10_1_0_S5_S3 6 -5000 5000 DEPOSIT ABSOLUTE /end AXIS_DESCR
 /begin AXIS_DESCR STD_AXIS zff_atsys._.iSignale._.obj.sig_n_t UMR_U_MIN_1_1_0_S5_S3 4 0 8160 DEPOSIT ABSOLUTE /end AXIS_DESCR
/end CHARACTERISTIC
/begin CHARACTERISTIC KF_FTSYNNTMEHAUPTESPORT23 "Faktor auf Haupt-ME fuer Nach-ME" MAP 0x1A8328 ZF_kf_si16_S5_S3 1 UMR___1_100_0_S5_S3 0 1
 /begin AXIS_DESCR STD_AXIS iSasZentr.iSchaltend.t_syn UMR_MSEC__10_1_0_S5_S3 6 -5000 5000 DEPOSIT ABSOLUTE /end AXIS_DESCR
 /begin AXIS_DESCR STD_AXIS zff_atsys._.iSignale._.obj.sig_n_t UMR_U_MIN_1_1_0_S5_S3 4 0 8160 DEPOSIT ABSOLUTE /end AXIS_DESCR
/end CHARACTERISTIC
/begin CHARACTERISTIC KF_FTSYNNTMEHAUPTESPORT34 "Faktor auf Haupt-ME fuer Nach-ME" MAP 0x1A83E4 ZF_kf_si16_S5_S3 1 UMR___1_100_0_S5_S3 0 1
 /begin AXIS_DESCR STD_AXIS iSasZentr.iSchaltend.t_syn UMR_MSEC__10_1_0_S5_S3 6 -5000 5000 DEPOSIT ABSOLUTE /end AXIS_DESCR
 /begin AXIS_DESCR STD_AXIS zff_atsys._.iSignale._.obj.sig_n_t UMR_U_MIN_1_1_0_S5_S3 4 0 8160 DEPOSIT ABSOLUTE /end AXIS_DESCR
/end CHARACTERISTIC
/begin CHARACTERISTIC KF_FTSYNNTMEHAUPTESPORT45 "Faktor auf Haupt-ME fuer Nach-ME" MAP 0x1A84A0 ZF_kf_si16_S5_S3 1 UMR___1_100_0_S5_S3 0 1
 /begin AXIS_DESCR STD_AXIS iSasZentr.iSchaltend.t_syn UMR_MSEC__10_1_0_S5_S3 6 -5000 5000 DEPOSIT ABSOLUTE /end AXIS_DESCR
 /begin AXIS_DESCR STD_AXIS zff_atsys._.iSignale._.obj.sig_n_t UMR_U_MIN_1_1_0_S5_S3 4 0 8160 DEPOSIT ABSOLUTE /end AXIS_DESCR
/end CHARACTERISTIC
/begin CHARACTERISTIC KF_FTSYNNTMEHAUPTESPORT56 "Faktor auf Haupt-ME fuer Nach-ME" MAP 0x1A855C ZF_kf_si16_S5_S3 1 UMR___1_100_0_S5_S3 0 1
 /begin AXIS_DESCR STD_AXIS iSasZentr.iSchaltend.t_syn UMR_MSEC__10_1_0_S5_S3 6 -5000 5000 DEPOSIT ABSOLUTE /end AXIS_DESCR
 /begin AXIS_DESCR STD_AXIS zff_atsys._.iSignale._.obj.sig_n_t UMR_U_MIN_1_1_0_S5_S3 4 0 8160 DEPOSIT ABSOLUTE /end AXIS_DESCR
/end CHARACTERISTIC
/begin CHARACTERISTIC KF_FTSYNNTMEHAUPTESPORT67 "Faktor auf Haupt-ME fuer Nach-ME" MAP 0x1A8618 ZF_kf_si16_S5_S3 1 UMR___1_100_0_S5_S3 0 1
 /begin AXIS_DESCR STD_AXIS iSasZentr.iSchaltend.t_syn UMR_MSEC__10_1_0_S5_S3 6 -5000 5000 DEPOSIT ABSOLUTE /end AXIS_DESCR
 /begin AXIS_DESCR STD_AXIS zff_atsys._.iSignale._.obj.sig_n_t UMR_U_MIN_1_1_0_S5_S3 4 0 8160 DEPOSIT ABSOLUTE /end AXIS_DESCR
/end CHARACTERISTIC
/begin CHARACTERISTIC KF_FTSYNNTMEHAUPTESPORT78 "Faktor auf Haupt-ME fuer Nach-ME" MAP 0x1A86D4 ZF_kf_si16_S5_S3 1 UMR___1_100_0_S5_S3 0 1
 /begin AXIS_DESCR STD_AXIS iSasZentr.iSchaltend.t_syn UMR_MSEC__10_1_0_S5_S3 6 -5000 5000 DEPOSIT ABSOLUTE /end AXIS_DESCR
 /begin AXIS_DESCR STD_AXIS zff_atsys._.iSignale._.obj.sig_n_t UMR_U_MIN_1_1_0_S5_S3 4 0 8160 DEPOSIT ABSOLUTE /end AXIS_DESCR
/end CHARACTERISTIC
/begin CHARACTERISTIC KF_MEHAUPTSPORT65 "Wert Hauptmotoreingriff" MAP 0x1AD52C ZF_kf_ui8_S5_S3 1530 UMR_NM__6_1_M128_S5_S3 -768 762
 /begin AXIS_DESCR STD_AXIS NO_INPUT_QUANTITY UMR_U_MIN_32_1_0_S5_S3 6 0 8160 DEPOSIT ABSOLUTE /end AXIS_DESCR
 /begin AXIS_DESCR STD_AXIS zff_atsys._.iSignale._.obj.sig_m_t8 UMR_NM__6_1_M34_S5_S3 10 -204 1326 DEPOSIT ABSOLUTE /end AXIS_DESCR
/end CHARACTERISTIC
/begin CHARACTERISTIC KF_MEHAUPTSPORT71 "Wert Hauptmotoreingriff" MAP 0x1AE024 ZF_kf_ui8_S5_S3 1530 UMR_NM__6_1_M128_S5_S3 -768 762
 /begin AXIS_DESCR STD_AXIS NO_INPUT_QUANTITY UMR_U_MIN_32_1_0_S5_S3 6 0 8160 DEPOSIT ABSOLUTE /end AXIS_DESCR
 /begin AXIS_DESCR STD_AXIS zff_atsys._.iSignale._.obj.sig_m_t8 UMR_NM__6_1_M34_S5_S3 10 -204 1326 DEPOSIT ABSOLUTE /end AXIS_DESCR
/end CHARACTERISTIC
/begin CHARACTERISTIC KF_MEHAUPTSPORT75 "Wert Hauptmotoreingriff" MAP 0x1AE15C ZF_kf_ui8_S5_S3 1530 UMR_NM__6_1_M128_S5_S3 -768 762
 /begin AXIS_DESCR STD_AXIS NO_INPUT_QUANTITY UMR_U_MIN_32_1_0_S5_S3 6 0 8160 DEPOSIT ABSOLUTE /end AXIS_DESCR
 /begin AXIS_DESCR STD_AXIS zff_atsys._.iSignale._.obj.sig_m_t8 UMR_NM__6_1_M34_S5_S3 10 -204 1326 DEPOSIT ABSOLUTE /end AXIS_DESCR
/end CHARACTERISTIC
/begin CHARACTERISTIC KF_MEHAUPTSPORT76 "Wert Hauptmotoreingriff" MAP 0x1AD664 ZF_kf_ui8_S5_S3 1530 UMR_NM__6_1_M128_S5_S3 -768 762
 /begin AXIS_DESCR STD_AXIS NO_INPUT_QUANTITY UMR_U_MIN_32_1_0_S5_S3 6 0 8160 DEPOSIT ABSOLUTE /end AXIS_DESCR
 /begin AXIS_DESCR STD_AXIS zff_atsys._.iSignale._.obj.sig_m_t8 UMR_NM__6_1_M34_S5_S3 10 -204 1326 DEPOSIT ABSOLUTE /end AXIS_DESCR
/end CHARACTERISTIC
/begin CHARACTERISTIC KF_MEHAUPTSPORT82 "Wert Hauptmotoreingriff" MAP 0x1AE294 ZF_kf_ui8_S5_S3 1530 UMR_NM__6_1_M128_S5_S3 -768 762
 /begin AXIS_DESCR STD_AXIS NO_INPUT_QUANTITY UMR_U_MIN_32_1_0_S5_S3 6 0 8160 DEPOSIT ABSOLUTE /end AXIS_DESCR
 /begin AXIS_DESCR STD_AXIS zff_atsys._.iSignale._.obj.sig_m_t8 UMR_NM__6_1_M34_S5_S3 10 -204 1326 DEPOSIT ABSOLUTE /end AXIS_DESCR
/end CHARACTERISTIC
/begin CHARACTERISTIC KF_MEHAUPTSPORT84 "Wert Hauptmotoreingriff" MAP 0x1AE3CC ZF_kf_ui8_S5_S3 1530 UMR_NM__6_1_M128_S5_S3 -768 762
 /begin AXIS_DESCR STD_AXIS NO_INPUT_QUANTITY UMR_U_MIN_32_1_0_S5_S3 6 0 8160 DEPOSIT ABSOLUTE /end AXIS_DESCR
 /begin AXIS_DESCR STD_AXIS zff_atsys._.iSignale._.obj.sig_m_t8 UMR_NM__6_1_M34_S5_S3 10 -204 1326 DEPOSIT ABSOLUTE /end AXIS_DESCR
/end CHARACTERISTIC
/begin CHARACTERISTIC KF_MEHAUPTSPORT86 "Wert Hauptmotoreingriff" MAP 0x1AE504 ZF_kf_ui8_S5_S3 1530 UMR_NM__6_1_M128_S5_S3 -768 762
 /begin AXIS_DESCR STD_AXIS NO_INPUT_QUANTITY UMR_U_MIN_32_1_0_S5_S3 6 0 8160 DEPOSIT ABSOLUTE /end AXIS_DESCR
 /begin AXIS_DESCR STD_AXIS zff_atsys._.iSignale._.obj.sig_m_t8 UMR_NM__6_1_M34_S5_S3 10 -204 1326 DEPOSIT ABSOLUTE /end AXIS_DESCR
/end CHARACTERISTIC
/begin CHARACTERISTIC KF_MEHAUPTSPORT87 "Wert Hauptmotoreingriff" MAP 0x1AD79C ZF_kf_ui8_S5_S3 1530 UMR_NM__6_1_M128_S5_S3 -768 762
 /begin AXIS_DESCR STD_AXIS NO_INPUT_QUANTITY UMR_U_MIN_32_1_0_S5_S3 6 0 8160 DEPOSIT ABSOLUTE /end AXIS_DESCR
 /begin AXIS_DESCR STD_AXIS zff_atsys._.iSignale._.obj.sig_m_t8 UMR_NM__6_1_M34_S5_S3 10 -204 1326 DEPOSIT ABSOLUTE /end AXIS_DESCR
/end CHARACTERISTIC
/begin CHARACTERISTIC KF_MENACHSPORT65 "Nachmotoreingriff Schaltablauf" MAP 0x1AD4D4 ZF_kf_ui8_S5_S3 768 UMR_NM__6_1_M128_S5_S3 -768 0
 /begin AXIS_DESCR STD_AXIS iSasZentr.iSchaltend.n_tkf UMR_U_MIN_32_1_0_S5_S3 6 0 8160 DEPOSIT ABSOLUTE /end AXIS_DESCR
 /begin AXIS_DESCR STD_AXIS zff_atsys._.iSignale._.obj.sig_m_t8 UMR_NM__6_1_M34_S5_S3 6 -204 1326 DEPOSIT ABSOLUTE /end AXIS_DESCR
/end CHARACTERISTIC
/begin CHARACTERISTIC KF_MENACHSPORT71 "Nachmotoreingriff Schaltablauf" MAP 0x1ADFCC ZF_kf_ui8_S5_S3 768 UMR_NM__6_1_M128_S5_S3 -768 0
 /begin AXIS_DESCR STD_AXIS iSasZentr.iSchaltend.n_tkf UMR_U_MIN_32_1_0_S5_S3 6 0 8160 DEPOSIT ABSOLUTE /end AXIS_DESCR
 /begin AXIS_DESCR STD_AXIS zff_atsys._.iSignale._.obj.sig_m_t8 UMR_NM__6_1_M34_S5_S3 6 -204 1326 DEPOSIT ABSOLUTE /end AXIS_DESCR
/end CHARACTERISTIC
/begin CHARACTERISTIC KF_MENACHSPORT75 "Nachmotoreingriff Schaltablauf" MAP 0x1AE104 ZF_kf_ui8_S5_S3 768 UMR_NM__6_1_M128_S5_S3 -768 0
 /begin AXIS_DESCR STD_AXIS iSasZentr.iSchaltend.n_tkf UMR_U_MIN_32_1_0_S5_S3 6 0 8160 DEPOSIT ABSOLUTE /end AXIS_DESCR
 /begin AXIS_DESCR STD_AXIS zff_atsys._.iSignale._.obj.sig_m_t8 UMR_NM__6_1_M34_S5_S3 6 -204 1326 DEPOSIT ABSOLUTE /end AXIS_DESCR
/end CHARACTERISTIC
/begin CHARACTERISTIC KF_MENACHSPORT76 "Nachmotoreingriff Schaltablauf" MAP 0x1AD60C ZF_kf_ui8_S5_S3 768 UMR_NM__6_1_M128_S5_S3 -768 0
 /begin AXIS_DESCR STD_AXIS iSasZentr.iSchaltend.n_tkf UMR_U_MIN_32_1_0_S5_S3 6 0 8160 DEPOSIT ABSOLUTE /end AXIS_DESCR
 /begin AXIS_DESCR STD_AXIS zff_atsys._.iSignale._.obj.sig_m_t8 UMR_NM__6_1_M34_S5_S3 6 -204 1326 DEPOSIT ABSOLUTE /end AXIS_DESCR
/end CHARACTERISTIC
/begin CHARACTERISTIC KF_MENACHSPORT82 "Nachmotoreingriff Schaltablauf" MAP 0x1AE23C ZF_kf_ui8_S5_S3 768 UMR_NM__6_1_M128_S5_S3 -768 0
 /begin AXIS_DESCR STD_AXIS iSasZentr.iSchaltend.n_tkf UMR_U_MIN_32_1_0_S5_S3 6 0 8160 DEPOSIT ABSOLUTE /end AXIS_DESCR
 /begin AXIS_DESCR STD_AXIS zff_atsys._.iSignale._.obj.sig_m_t8 UMR_NM__6_1_M34_S5_S3 6 -204 1326 DEPOSIT ABSOLUTE /end AXIS_DESCR
/end CHARACTERISTIC
/begin CHARACTERISTIC KF_MENACHSPORT84 "Nachmotoreingriff Schaltablauf" MAP 0x1AE374 ZF_kf_ui8_S5_S3 768 UMR_NM__6_1_M128_S5_S3 -768 0
 /begin AXIS_DESCR STD_AXIS iSasZentr.iSchaltend.n_tkf UMR_U_MIN_32_1_0_S5_S3 6 0 8160 DEPOSIT ABSOLUTE /end AXIS_DESCR
 /begin AXIS_DESCR STD_AXIS zff_atsys._.iSignale._.obj.sig_m_t8 UMR_NM__6_1_M34_S5_S3 6 -204 1326 DEPOSIT ABSOLUTE /end AXIS_DESCR
/end CHARACTERISTIC
/begin CHARACTERISTIC KF_MENACHSPORT86 "Nachmotoreingriff Schaltablauf" MAP 0x1AE4AC ZF_kf_ui8_S5_S3 768 UMR_NM__6_1_M128_S5_S3 -768 0
 /begin AXIS_DESCR STD_AXIS iSasZentr.iSchaltend.n_tkf UMR_U_MIN_32_1_0_S5_S3 6 0 8160 DEPOSIT ABSOLUTE /end AXIS_DESCR
 /begin AXIS_DESCR STD_AXIS zff_atsys._.iSignale._.obj.sig_m_t8 UMR_NM__6_1_M34_S5_S3 6 -204 1326 DEPOSIT ABSOLUTE /end AXIS_DESCR
/end CHARACTERISTIC
/begin CHARACTERISTIC KF_MENACHSPORT87 "Nachmotoreingriff Schaltablauf" MAP 0x1AD744 ZF_kf_ui8_S5_S3 768 UMR_NM__6_1_M128_S5_S3 -768 0
 /begin AXIS_DESCR STD_AXIS iSasZentr.iSchaltend.n_tkf UMR_U_MIN_32_1_0_S5_S3 6 0 8160 DEPOSIT ABSOLUTE /end AXIS_DESCR
 /begin AXIS_DESCR STD_AXIS zff_atsys._.iSignale._.obj.sig_m_t8 UMR_NM__6_1_M34_S5_S3 6 -204 1326 DEPOSIT ABSOLUTE /end AXIS_DESCR
/end CHARACTERISTIC
/begin CHARACTERISTIC KF_POKZUFOLSPORT_A "Kupplungsabhängiger Offset vorbereitende KZU" MAP 0x1B00B0 ZF_kf_si16_S5_S3 12.8 UMR_BAR__1_1000_0_S5_S3 -6.4 6.4
 /begin AXIS_DESCR STD_AXIS zff_atsys._.iSignale._.obj.sig_m_t UMR_NM__1_1_0_S5_S3 4 -200 1300 DEPOSIT ABSOLUTE /end AXIS_DESCR
 /begin AXIS_DESCR STD_AXIS zff_atsys._.iSignale._.obj.sig_c_getr UMR_GRADC__1_1_M40_S5_S3 4 -40 215 DEPOSIT ABSOLUTE /end AXIS_DESCR
/end CHARACTERISTIC
/begin CHARACTERISTIC KF_POKZUFOLSPORT_B "Kupplungsabhängiger Offset vorbereitende KZU" MAP 0x1B017C ZF_kf_si16_S5_S3 12.8 UMR_BAR__1_1000_0_S5_S3 -6.4 6.4
 /begin AXIS_DESCR STD_AXIS zff_atsys._.iSignale._.obj.sig_m_t UMR_NM__1_1_0_S5_S3 4 -200 1300 DEPOSIT ABSOLUTE /end AXIS_DESCR
 /begin AXIS_DESCR STD_AXIS zff_atsys._.iSignale._.obj.sig_c_getr UMR_GRADC__1_1_M40_S5_S3 4 -40 215 DEPOSIT ABSOLUTE /end AXIS_DESCR
/end CHARACTERISTIC
/begin CHARACTERISTIC KF_POKZUFOLSPORT_C "Kupplungsabhängiger Offset vorbereitende KZU" MAP 0x1B0248 ZF_kf_si16_S5_S3 12.8 UMR_BAR__1_1000_0_S5_S3 -6.4 6.4
 /begin AXIS_DESCR STD_AXIS zff_atsys._.iSignale._.obj.sig_m_t UMR_NM__1_1_0_S5_S3 4 -200 1300 DEPOSIT ABSOLUTE /end AXIS_DESCR
 /begin AXIS_DESCR STD_AXIS zff_atsys._.iSignale._.obj.sig_c_getr UMR_GRADC__1_1_M40_S5_S3 4 -40 215 DEPOSIT ABSOLUTE /end AXIS_DESCR
/end CHARACTERISTIC
/begin CHARACTERISTIC KF_POKZUFOLSPORT_D "Kupplungsabhängiger Offset vorbereitende KZU" MAP 0x1B0314 ZF_kf_si16_S5_S3 12.8 UMR_BAR__1_1000_0_S5_S3 -6.4 6.4
 /begin AXIS_DESCR STD_AXIS zff_atsys._.iSignale._.obj.sig_m_t UMR_NM__1_1_0_S5_S3 4 -200 1300 DEPOSIT ABSOLUTE /end AXIS_DESCR
 /begin AXIS_DESCR STD_AXIS zff_atsys._.iSignale._.obj.sig_c_getr UMR_GRADC__1_1_M40_S5_S3 4 -40 215 DEPOSIT ABSOLUTE /end AXIS_DESCR
/end CHARACTERISTIC
/begin CHARACTERISTIC KF_POKZUFOLSPORT_E "Kupplungsabhängiger Offset vorbereitende KZU" MAP 0x1B03E0 ZF_kf_si16_S5_S3 12.8 UMR_BAR__1_1000_0_S5_S3 -6.4 6.4
 /begin AXIS_DESCR STD_AXIS zff_atsys._.iSignale._.obj.sig_m_t UMR_NM__1_1_0_S5_S3 4 -200 1300 DEPOSIT ABSOLUTE /end AXIS_DESCR
 /begin AXIS_DESCR STD_AXIS zff_atsys._.iSignale._.obj.sig_c_getr UMR_GRADC__1_1_M40_S5_S3 4 -40 215 DEPOSIT ABSOLUTE /end AXIS_DESCR
/end CHARACTERISTIC
/begin CHARACTERISTIC KF_POKZUFOLSP_A "Kupplungsabhängiger Offset vorbereitende KZU" MAP 0x1B0078 ZF_kf_si16_S5_S3 12.8 UMR_BAR__1_1000_0_S5_S3 -6.4 6.4
 /begin AXIS_DESCR STD_AXIS zff_atsys._.iSignale._.obj.sig_m_t UMR_NM__1_1_0_S5_S3 4 -200 1300 DEPOSIT ABSOLUTE /end AXIS_DESCR
 /begin AXIS_DESCR STD_AXIS zff_atsys._.iSignale._.obj.sig_c_getr UMR_GRADC__1_1_M40_S5_S3 4 -40 215 DEPOSIT ABSOLUTE /end AXIS_DESCR
/end CHARACTERISTIC
/begin CHARACTERISTIC KF_POKZUFOLSP_B "Kupplungsabhängiger Offset vorbereitende KZU" MAP 0x1B0144 ZF_kf_si16_S5_S3 12.8 UMR_BAR__1_1000_0_S5_S3 -6.4 6.4
 /begin AXIS_DESCR STD_AXIS zff_atsys._.iSignale._.obj.sig_m_t UMR_NM__1_1_0_S5_S3 4 -200 1300 DEPOSIT ABSOLUTE /end AXIS_DESCR
 /begin AXIS_DESCR STD_AXIS zff_atsys._.iSignale._.obj.sig_c_getr UMR_GRADC__1_1_M40_S5_S3 4 -40 215 DEPOSIT ABSOLUTE /end AXIS_DESCR
/end CHARACTERISTIC
/begin CHARACTERISTIC KF_POKZUFOLSP_C "Kupplungsabhängiger Offset vorbereitende KZU" MAP 0x1B0210 ZF_kf_si16_S5_S3 12.8 UMR_BAR__1_1000_0_S5_S3 -6.4 6.4
 /begin AXIS_DESCR STD_AXIS zff_atsys._.iSignale._.obj.sig_m_t UMR_NM__1_1_0_S5_S3 4 -200 1300 DEPOSIT ABSOLUTE /end AXIS_DESCR
 /begin AXIS_DESCR STD_AXIS zff_atsys._.iSignale._.obj.sig_c_getr UMR_GRADC__1_1_M40_S5_S3 4 -40 215 DEPOSIT ABSOLUTE /end AXIS_DESCR
/end CHARACTERISTIC
/begin CHARACTERISTIC KF_POKZUFOLSP_D "Kupplungsabhängiger Offset vorbereitende KZU" MAP 0x1B02DC ZF_kf_si16_S5_S3 12.8 UMR_BAR__1_1000_0_S5_S3 -6.4 6.4
 /begin AXIS_DESCR STD_AXIS zff_atsys._.iSignale._.obj.sig_m_t UMR_NM__1_1_0_S5_S3 4 -200 1300 DEPOSIT ABSOLUTE /end AXIS_DESCR
 /begin AXIS_DESCR STD_AXIS zff_atsys._.iSignale._.obj.sig_c_getr UMR_GRADC__1_1_M40_S5_S3 4 -40 215 DEPOSIT ABSOLUTE /end AXIS_DESCR
/end CHARACTERISTIC
/begin CHARACTERISTIC KF_POKZUFOLSP_E "Kupplungsabhängiger Offset vorbereitende KZU" MAP 0x1B03A8 ZF_kf_si16_S5_S3 12.8 UMR_BAR__1_1000_0_S5_S3 -6.4 6.4
 /begin AXIS_DESCR STD_AXIS zff_atsys._.iSignale._.obj.sig_m_t UMR_NM__1_1_0_S5_S3 4 -200 1300 DEPOSIT ABSOLUTE /end AXIS_DESCR
 /begin AXIS_DESCR STD_AXIS zff_atsys._.iSignale._.obj.sig_c_getr UMR_GRADC__1_1_M40_S5_S3 4 -40 215 DEPOSIT ABSOLUTE /end AXIS_DESCR
/end CHARACTERISTIC
/begin CHARACTERISTIC KF_POKZUFOL_A "Kupplungsabhängiger Offset vorbereitende KZU" MAP 0x1B0040 ZF_kf_si16_S5_S3 12.8 UMR_BAR__1_1000_0_S5_S3 -6.4 6.4
 /begin AXIS_DESCR STD_AXIS zff_atsys._.iSignale._.obj.sig_m_t UMR_NM__1_1_0_S5_S3 4 -200 1300 DEPOSIT ABSOLUTE /end AXIS_DESCR
 /begin AXIS_DESCR STD_AXIS zff_atsys._.iSignale._.obj.sig_c_getr UMR_GRADC__1_1_M40_S5_S3 4 -40 215 DEPOSIT ABSOLUTE /end AXIS_DESCR
/end CHARACTERISTIC
/begin CHARACTERISTIC KF_POKZUFOL_B "Kupplungsabhängiger Offset vorbereitende KZU" MAP 0x1B010C ZF_kf_si16_S5_S3 12.8 UMR_BAR__1_1000_0_S5_S3 -6.4 6.4
 /begin AXIS_DESCR STD_AXIS zff_atsys._.iSignale._.obj.sig_m_t UMR_NM__1_1_0_S5_S3 4 -200 1300 DEPOSIT ABSOLUTE /end AXIS_DESCR
 /begin AXIS_DESCR STD_AXIS zff_atsys._.iSignale._.obj.sig_c_getr UMR_GRADC__1_1_M40_S5_S3 4 -40 215 DEPOSIT ABSOLUTE /end AXIS_DESCR
/end CHARACTERISTIC
/begin CHARACTERISTIC KF_POKZUFOL_C "Kupplungsabhängiger Offset vorbereitende KZU" MAP 0x1B01D8 ZF_kf_si16_S5_S3 12.8 UMR_BAR__1_1000_0_S5_S3 -6.4 6.4
 /begin AXIS_DESCR STD_AXIS zff_atsys._.iSignale._.obj.sig_m_t UMR_NM__1_1_0_S5_S3 4 -200 1300 DEPOSIT ABSOLUTE /end AXIS_DESCR
 /begin AXIS_DESCR STD_AXIS zff_atsys._.iSignale._.obj.sig_c_getr UMR_GRADC__1_1_M40_S5_S3 4 -40 215 DEPOSIT ABSOLUTE /end AXIS_DESCR
/end CHARACTERISTIC
/begin CHARACTERISTIC KF_POKZUFOL_D "Kupplungsabhängiger Offset vorbereitende KZU" MAP 0x1B02A4 ZF_kf_si16_S5_S3 12.8 UMR_BAR__1_1000_0_S5_S3 -6.4 6.4
 /begin AXIS_DESCR STD_AXIS zff_atsys._.iSignale._.obj.sig_m_t UMR_NM__1_1_0_S5_S3 4 -200 1300 DEPOSIT ABSOLUTE /end AXIS_DESCR
 /begin AXIS_DESCR STD_AXIS zff_atsys._.iSignale._.obj.sig_c_getr UMR_GRADC__1_1_M40_S5_S3 4 -40 215 DEPOSIT ABSOLUTE /end AXIS_DESCR
/end CHARACTERISTIC
/begin CHARACTERISTIC KF_POKZUFOL_E "Kupplungsabhängiger Offset vorbereitende KZU" MAP 0x1B0370 ZF_kf_si16_S5_S3 12.8 UMR_BAR__1_1000_0_S5_S3 -6.4 6.4
 /begin AXIS_DESCR STD_AXIS zff_atsys._.iSignale._.obj.sig_m_t UMR_NM__1_1_0_S5_S3 4 -200 1300 DEPOSIT ABSOLUTE /end AXIS_DESCR
 /begin AXIS_DESCR STD_AXIS zff_atsys._.iSignale._.obj.sig_c_getr UMR_GRADC__1_1_M40_S5_S3 4 -40 215 DEPOSIT ABSOLUTE /end AXIS_DESCR
/end CHARACTERISTIC
/begin CHARACTERISTIC KF_TSYNCGMTHINSYN21 "Zeit vor sync. fur Rampenstart Haltephase in Synchron" MAP 0x1B043C ZF_kf_ui8_S5_S3 2550 UMR_MSEC__10_1_M255_S5_S3 -2550 0
 /begin AXIS_DESCR STD_AXIS zff_atsys._.iSignale._.obj.sig_c_getr UMR_GRADC__1_1_M40_S5_S3 4 -40 215 DEPOSIT ABSOLUTE /end AXIS_DESCR
 /begin AXIS_DESCR STD_AXIS zff_atsys._.iSignale._.obj.sig_m_t8 UMR_NM__6_1_M34_S5_S3 4 -204 1326 DEPOSIT ABSOLUTE /end AXIS_DESCR
/end CHARACTERISTIC
/begin CHARACTERISTIC KF_TSYNCGMTHINSYN32 "Zeit vor sync. fur Rampenstart Haltephase in Synchron" MAP 0x1B047C ZF_kf_ui8_S5_S3 2550 UMR_MSEC__10_1_M255_S5_S3 -2550 0
 /begin AXIS_DESCR STD_AXIS zff_atsys._.iSignale._.obj.sig_c_getr UMR_GRADC__1_1_M40_S5_S3 4 -40 215 DEPOSIT ABSOLUTE /end AXIS_DESCR
 /begin AXIS_DESCR STD_AXIS zff_atsys._.iSignale._.obj.sig_m_t8 UMR_NM__6_1_M34_S5_S3 4 -204 1326 DEPOSIT ABSOLUTE /end AXIS_DESCR
/end CHARACTERISTIC
/begin CHARACTERISTIC KF_TSYNCGMTHINSYN43 "Zeit vor sync. fur Rampenstart Haltephase in Synchron" MAP 0x1B04BC ZF_kf_ui8_S5_S3 2550 UMR_MSEC__10_1_M255_S5_S3 -2550 0
 /begin AXIS_DESCR STD_AXIS zff_atsys._.iSignale._.obj.sig_c_getr UMR_GRADC__1_1_M40_S5_S3 4 -40 215 DEPOSIT ABSOLUTE /end AXIS_DESCR
 /begin AXIS_DESCR STD_AXIS zff_atsys._.iSignale._.obj.sig_m_t8 UMR_NM__6_1_M34_S5_S3 4 -204 1326 DEPOSIT ABSOLUTE /end AXIS_DESCR
/end CHARACTERISTIC
/begin CHARACTERISTIC KF_TSYNCGMTHINSYN54 "Zeit vor sync. fur Rampenstart Haltephase in Synchron" MAP 0x1B04FC ZF_kf_ui8_S5_S3 2550 UMR_MSEC__10_1_M255_S5_S3 -2550 0
 /begin AXIS_DESCR STD_AXIS zff_atsys._.iSignale._.obj.sig_c_getr UMR_GRADC__1_1_M40_S5_S3 4 -40 215 DEPOSIT ABSOLUTE /end AXIS_DESCR
 /begin AXIS_DESCR STD_AXIS zff_atsys._.iSignale._.obj.sig_m_t8 UMR_NM__6_1_M34_S5_S3 4 -204 1326 DEPOSIT ABSOLUTE /end AXIS_DESCR
/end CHARACTERISTIC
/begin CHARACTERISTIC KF_TSYNCGMTHINSYN65 "Zeit vor sync. fur Rampenstart Haltephase in Synchron" MAP 0x1B053C ZF_kf_ui8_S5_S3 2550 UMR_MSEC__10_1_M255_S5_S3 -2550 0
 /begin AXIS_DESCR STD_AXIS zff_atsys._.iSignale._.obj.sig_c_getr UMR_GRADC__1_1_M40_S5_S3 4 -40 215 DEPOSIT ABSOLUTE /end AXIS_DESCR
 /begin AXIS_DESCR STD_AXIS zff_atsys._.iSignale._.obj.sig_m_t8 UMR_NM__6_1_M34_S5_S3 4 -204 1326 DEPOSIT ABSOLUTE /end AXIS_DESCR
/end CHARACTERISTIC
/begin CHARACTERISTIC KF_TSYNCGMTHINSYN76 "Zeit vor sync. fur Rampenstart Haltephase in Synchron" MAP 0x1B057C ZF_kf_ui8_S5_S3 2550 UMR_MSEC__10_1_M255_S5_S3 -2550 0
 /begin AXIS_DESCR STD_AXIS zff_atsys._.iSignale._.obj.sig_c_getr UMR_GRADC__1_1_M40_S5_S3 4 -40 215 DEPOSIT ABSOLUTE /end AXIS_DESCR
 /begin AXIS_DESCR STD_AXIS zff_atsys._.iSignale._.obj.sig_m_t8 UMR_NM__6_1_M34_S5_S3 4 -204 1326 DEPOSIT ABSOLUTE /end AXIS_DESCR
/end CHARACTERISTIC
/begin CHARACTERISTIC KF_TSYNCGMTHINSYN87 "Zeit vor sync. fur Rampenstart Haltephase in Synchron" MAP 0x1B05BC ZF_kf_ui8_S5_S3 2550 UMR_MSEC__10_1_M255_S5_S3 -2550 0
 /begin AXIS_DESCR STD_AXIS zff_atsys._.iSignale._.obj.sig_c_getr UMR_GRADC__1_1_M40_S5_S3 4 -40 215 DEPOSIT ABSOLUTE /end AXIS_DESCR
 /begin AXIS_DESCR STD_AXIS zff_atsys._.iSignale._.obj.sig_m_t8 UMR_NM__6_1_M34_S5_S3 4 -204 1326 DEPOSIT ABSOLUTE /end AXIS_DESCR
/end CHARACTERISTIC
/begin CHARACTERISTIC KF_TSYNCGMTHINSYNRA21 "Zeit vor sync. fur Rampenende Haltephase in Synchron" MAP 0x1B045C ZF_kf_ui8_S5_S3 2550 UMR_MSEC__10_1_M255_S5_S3 -2550 0
 /begin AXIS_DESCR STD_AXIS zff_atsys._.iSignale._.obj.sig_c_getr UMR_GRADC__1_1_M40_S5_S3 4 -40 215 DEPOSIT ABSOLUTE /end AXIS_DESCR
 /begin AXIS_DESCR STD_AXIS zff_atsys._.iSignale._.obj.sig_m_t8 UMR_NM__6_1_M34_S5_S3 4 -204 1326 DEPOSIT ABSOLUTE /end AXIS_DESCR
/end CHARACTERISTIC
/begin CHARACTERISTIC KF_TSYNCGMTHINSYNRA32 "Zeit vor sync. fur Rampenende Haltephase in Synchron" MAP 0x1B049C ZF_kf_ui8_S5_S3 2550 UMR_MSEC__10_1_M255_S5_S3 -2550 0
 /begin AXIS_DESCR STD_AXIS zff_atsys._.iSignale._.obj.sig_c_getr UMR_GRADC__1_1_M40_S5_S3 4 -40 215 DEPOSIT ABSOLUTE /end AXIS_DESCR
 /begin AXIS_DESCR STD_AXIS zff_atsys._.iSignale._.obj.sig_m_t8 UMR_NM__6_1_M34_S5_S3 4 -204 1326 DEPOSIT ABSOLUTE /end AXIS_DESCR
/end CHARACTERISTIC
/begin CHARACTERISTIC KF_TSYNCGMTHINSYNRA43 "Zeit vor sync. fur Rampenende Haltephase in Synchron" MAP 0x1B04DC ZF_kf_ui8_S5_S3 2550 UMR_MSEC__10_1_M255_S5_S3 -2550 0
 /begin AXIS_DESCR STD_AXIS zff_atsys._.iSignale._.obj.sig_c_getr UMR_GRADC__1_1_M40_S5_S3 4 -40 215 DEPOSIT ABSOLUTE /end AXIS_DESCR
 /begin AXIS_DESCR STD_AXIS zff_atsys._.iSignale._.obj.sig_m_t8 UMR_NM__6_1_M34_S5_S3 4 -204 1326 DEPOSIT ABSOLUTE /end AXIS_DESCR
/end CHARACTERISTIC
/begin CHARACTERISTIC KF_TSYNCGMTHINSYNRA54 "Zeit vor sync. fur Rampenende Haltephase in Synchron" MAP 0x1B051C ZF_kf_ui8_S5_S3 2550 UMR_MSEC__10_1_M255_S5_S3 -2550 0
 /begin AXIS_DESCR STD_AXIS zff_atsys._.iSignale._.obj.sig_c_getr UMR_GRADC__1_1_M40_S5_S3 4 -40 215 DEPOSIT ABSOLUTE /end AXIS_DESCR
 /begin AXIS_DESCR STD_AXIS zff_atsys._.iSignale._.obj.sig_m_t8 UMR_NM__6_1_M34_S5_S3 4 -204 1326 DEPOSIT ABSOLUTE /end AXIS_DESCR
/end CHARACTERISTIC
/begin CHARACTERISTIC KF_TSYNCGMTHINSYNRA65 "Zeit vor sync. fur Rampenende Haltephase in Synchron" MAP 0x1B055C ZF_kf_ui8_S5_S3 2550 UMR_MSEC__10_1_M255_S5_S3 -2550 0
 /begin AXIS_DESCR STD_AXIS zff_atsys._.iSignale._.obj.sig_c_getr UMR_GRADC__1_1_M40_S5_S3 4 -40 215 DEPOSIT ABSOLUTE /end AXIS_DESCR
 /begin AXIS_DESCR STD_AXIS zff_atsys._.iSignale._.obj.sig_m_t8 UMR_NM__6_1_M34_S5_S3 4 -204 1326 DEPOSIT ABSOLUTE /end AXIS_DESCR
/end CHARACTERISTIC
/begin CHARACTERISTIC KF_TSYNCGMTHINSYNRA76 "Zeit vor sync. fur Rampenende Haltephase in Synchron" MAP 0x1B059C ZF_kf_ui8_S5_S3 2550 UMR_MSEC__10_1_M255_S5_S3 -2550 0
 /begin AXIS_DESCR STD_AXIS zff_atsys._.iSignale._.obj.sig_c_getr UMR_GRADC__1_1_M40_S5_S3 4 -40 215 DEPOSIT ABSOLUTE /end AXIS_DESCR
 /begin AXIS_DESCR STD_AXIS zff_atsys._.iSignale._.obj.sig_m_t8 UMR_NM__6_1_M34_S5_S3 4 -204 1326 DEPOSIT ABSOLUTE /end AXIS_DESCR
/end CHARACTERISTIC
/begin CHARACTERISTIC KF_TSYNCGMTHINSYNRA87 "Zeit vor sync. fur Rampenende Haltephase in Synchron" MAP 0x1B05DC ZF_kf_ui8_S5_S3 2550 UMR_MSEC__10_1_M255_S5_S3 -2550 0
 /begin AXIS_DESCR STD_AXIS zff_atsys._.iSignale._.obj.sig_c_getr UMR_GRADC__1_1_M40_S5_S3 4 -40 215 DEPOSIT ABSOLUTE /end AXIS_DESCR
 /begin AXIS_DESCR STD_AXIS zff_atsys._.iSignale._.obj.sig_m_t8 UMR_NM__6_1_M34_S5_S3 4 -204 1326 DEPOSIT ABSOLUTE /end AXIS_DESCR
/end CHARACTERISTIC
/begin CHARACTERISTIC KF_TSYNCGMTHINSYNRASP21 "Zeit vor sync. fur Rampenende Haltephase in Synchron" MAP 0x1B061C ZF_kf_ui8_S5_S3 2550 UMR_MSEC__10_1_M255_S5_S3 -2550 0
 /begin AXIS_DESCR STD_AXIS zff_atsys._.iSignale._.obj.sig_c_getr UMR_GRADC__1_1_M40_S5_S3 4 -40 215 DEPOSIT ABSOLUTE /end AXIS_DESCR
 /begin AXIS_DESCR STD_AXIS zff_atsys._.iSignale._.obj.sig_m_t8 UMR_NM__6_1_M34_S5_S3 4 -204 1326 DEPOSIT ABSOLUTE /end AXIS_DESCR
/end CHARACTERISTIC
/begin CHARACTERISTIC KF_TSYNCGMTHINSYNRASP31 "Zeit vor sync. fur Rampenende Haltephase in Synchron" MAP 0x1B07DC ZF_kf_ui8_S5_S3 2550 UMR_MSEC__10_1_M255_S5_S3 -2550 0
 /begin AXIS_DESCR STD_AXIS zff_atsys._.iSignale._.obj.sig_c_getr UMR_GRADC__1_1_M40_S5_S3 4 -40 215 DEPOSIT ABSOLUTE /end AXIS_DESCR
 /begin AXIS_DESCR STD_AXIS zff_atsys._.iSignale._.obj.sig_m_t8 UMR_NM__6_1_M34_S5_S3 4 -204 1326 DEPOSIT ABSOLUTE /end AXIS_DESCR
/end CHARACTERISTIC
/begin CHARACTERISTIC KF_TSYNCGMTHINSYNRASP32 "Zeit vor sync. fur Rampenende Haltephase in Synchron" MAP 0x1B065C ZF_kf_ui8_S5_S3 2550 UMR_MSEC__10_1_M255_S5_S3 -2550 0
 /begin AXIS_DESCR STD_AXIS zff_atsys._.iSignale._.obj.sig_c_getr UMR_GRADC__1_1_M40_S5_S3 4 -40 215 DEPOSIT ABSOLUTE /end AXIS_DESCR
 /begin AXIS_DESCR STD_AXIS zff_atsys._.iSignale._.obj.sig_m_t8 UMR_NM__6_1_M34_S5_S3 4 -204 1326 DEPOSIT ABSOLUTE /end AXIS_DESCR
/end CHARACTERISTIC
/begin CHARACTERISTIC KF_TSYNCGMTHINSYNRASP42 "Zeit vor sync. fur Rampenende Haltephase in Synchron" MAP 0x1B081C ZF_kf_ui8_S5_S3 2550 UMR_MSEC__10_1_M255_S5_S3 -2550 0
 /begin AXIS_DESCR STD_AXIS zff_atsys._.iSignale._.obj.sig_c_getr UMR_GRADC__1_1_M40_S5_S3 4 -40 215 DEPOSIT ABSOLUTE /end AXIS_DESCR
 /begin AXIS_DESCR STD_AXIS zff_atsys._.iSignale._.obj.sig_m_t8 UMR_NM__6_1_M34_S5_S3 4 -204 1326 DEPOSIT ABSOLUTE /end AXIS_DESCR
/end CHARACTERISTIC
/begin CHARACTERISTIC KF_TSYNCGMTHINSYNRASP43 "Zeit vor sync. fur Rampenende Haltephase in Synchron" MAP 0x1B069C ZF_kf_ui8_S5_S3 2550 UMR_MSEC__10_1_M255_S5_S3 -2550 0
 /begin AXIS_DESCR STD_AXIS zff_atsys._.iSignale._.obj.sig_c_getr UMR_GRADC__1_1_M40_S5_S3 4 -40 215 DEPOSIT ABSOLUTE /end AXIS_DESCR
 /begin AXIS_DESCR STD_AXIS zff_atsys._.iSignale._.obj.sig_m_t8 UMR_NM__6_1_M34_S5_S3 4 -204 1326 DEPOSIT ABSOLUTE /end AXIS_DESCR
/end CHARACTERISTIC
/begin CHARACTERISTIC KF_TSYNCGMTHINSYNRASP51 "Zeit vor sync. fur Rampenende Haltephase in Synchron" MAP 0x1B085C ZF_kf_ui8_S5_S3 2550 UMR_MSEC__10_1_M255_S5_S3 -2550 0
 /begin AXIS_DESCR STD_AXIS zff_atsys._.iSignale._.obj.sig_c_getr UMR_GRADC__1_1_M40_S5_S3 4 -40 215 DEPOSIT ABSOLUTE /end AXIS_DESCR
 /begin AXIS_DESCR STD_AXIS zff_atsys._.iSignale._.obj.sig_m_t8 UMR_NM__6_1_M34_S5_S3 4 -204 1326 DEPOSIT ABSOLUTE /end AXIS_DESCR
/end CHARACTERISTIC
/begin CHARACTERISTIC KF_TSYNCGMTHINSYNRASP53 "Zeit vor sync. fur Rampenende Haltephase in Synchron" MAP 0x1B089C ZF_kf_ui8_S5_S3 2550 UMR_MSEC__10_1_M255_S5_S3 -2550 0
 /begin AXIS_DESCR STD_AXIS zff_atsys._.iSignale._.obj.sig_c_getr UMR_GRADC__1_1_M40_S5_S3 4 -40 215 DEPOSIT ABSOLUTE /end AXIS_DESCR
 /begin AXIS_DESCR STD_AXIS zff_atsys._.iSignale._.obj.sig_m_t8 UMR_NM__6_1_M34_S5_S3 4 -204 1326 DEPOSIT ABSOLUTE /end AXIS_DESCR
/end CHARACTERISTIC
/begin CHARACTERISTIC KF_TSYNCGMTHINSYNRASP54 "Zeit vor sync. fur Rampenende Haltephase in Synchron" MAP 0x1B06DC ZF_kf_ui8_S5_S3 2550 UMR_MSEC__10_1_M255_S5_S3 -2550 0
 /begin AXIS_DESCR STD_AXIS zff_atsys._.iSignale._.obj.sig_c_getr UMR_GRADC__1_1_M40_S5_S3 4 -40 215 DEPOSIT ABSOLUTE /end AXIS_DESCR
 /begin AXIS_DESCR STD_AXIS zff_atsys._.iSignale._.obj.sig_m_t8 UMR_NM__6_1_M34_S5_S3 4 -204 1326 DEPOSIT ABSOLUTE /end AXIS_DESCR
/end CHARACTERISTIC
/begin CHARACTERISTIC KF_TSYNCGMTHINSYNRASP63 "Zeit vor sync. fur Rampenende Haltephase in Synchron" MAP 0x1B08DC ZF_kf_ui8_S5_S3 2550 UMR_MSEC__10_1_M255_S5_S3 -2550 0
 /begin AXIS_DESCR STD_AXIS zff_atsys._.iSignale._.obj.sig_c_getr UMR_GRADC__1_1_M40_S5_S3 4 -40 215 DEPOSIT ABSOLUTE /end AXIS_DESCR
 /begin AXIS_DESCR STD_AXIS zff_atsys._.iSignale._.obj.sig_m_t8 UMR_NM__6_1_M34_S5_S3 4 -204 1326 DEPOSIT ABSOLUTE /end AXIS_DESCR
/end CHARACTERISTIC
/begin CHARACTERISTIC KF_TSYNCGMTHINSYNRASP64 "Zeit vor sync. fur Rampenende Haltephase in Synchron" MAP 0x1B091C ZF_kf_ui8_S5_S3 2550 UMR_MSEC__10_1_M255_S5_S3 -2550 0
 /begin AXIS_DESCR STD_AXIS zff_atsys._.iSignale._.obj.sig_c_getr UMR_GRADC__1_1_M40_S5_S3 4 -40 215 DEPOSIT ABSOLUTE /end AXIS_DESCR
 /begin AXIS_DESCR STD_AXIS zff_atsys._.iSignale._.obj.sig_m_t8 UMR_NM__6_1_M34_S5_S3 4 -204 1326 DEPOSIT ABSOLUTE /end AXIS_DESCR
/end CHARACTERISTIC
/begin CHARACTERISTIC KF_TSYNCGMTHINSYNRASP65 "Zeit vor sync. fur Rampenende Haltephase in Synchron" MAP 0x1B071C ZF_kf_ui8_S5_S3 2550 UMR_MSEC__10_1_M255_S5_S3 -2550 0
 /begin AXIS_DESCR STD_AXIS zff_atsys._.iSignale._.obj.sig_c_getr UMR_GRADC__1_1_M40_S5_S3 4 -40 215 DEPOSIT ABSOLUTE /end AXIS_DESCR
 /begin AXIS_DESCR STD_AXIS zff_atsys._.iSignale._.obj.sig_m_t8 UMR_NM__6_1_M34_S5_S3 4 -204 1326 DEPOSIT ABSOLUTE /end AXIS_DESCR
/end CHARACTERISTIC
/begin CHARACTERISTIC KF_TSYNCGMTHINSYNRASP71 "Zeit vor sync. fur Rampenende Haltephase in Synchron" MAP 0x1B095C ZF_kf_ui8_S5_S3 2550 UMR_MSEC__10_1_M255_S5_S3 -2550 0
 /begin AXIS_DESCR STD_AXIS zff_atsys._.iSignale._.obj.sig_c_getr UMR_GRADC__1_1_M40_S5_S3 4 -40 215 DEPOSIT ABSOLUTE /end AXIS_DESCR
 /begin AXIS_DESCR STD_AXIS zff_atsys._.iSignale._.obj.sig_m_t8 UMR_NM__6_1_M34_S5_S3 4 -204 1326 DEPOSIT ABSOLUTE /end AXIS_DESCR
/end CHARACTERISTIC
/begin CHARACTERISTIC KF_TSYNCGMTHINSYNSP21 "Zeit vor sync. fur Rampenstart Haltephase in Synchron" MAP 0x1B05FC ZF_kf_ui8_S5_S3 2550 UMR_MSEC__10_1_M255_S5_S3 -2550 0
 /begin AXIS_DESCR STD_AXIS zff_atsys._.iSignale._.obj.sig_c_getr UMR_GRADC__1_1_M40_S5_S3 4 -40 215 DEPOSIT ABSOLUTE /end AXIS_DESCR
 /begin AXIS_DESCR STD_AXIS zff_atsys._.iSignale._.obj.sig_m_t8 UMR_NM__6_1_M34_S5_S3 4 -204 1326 DEPOSIT ABSOLUTE /end AXIS_DESCR
/end CHARACTERISTIC
/begin CHARACTERISTIC KF_TSYNCGMTHINSYNSP31 "Zeit vor sync. fur Rampenstart Haltephase in Synchron" MAP 0x1B07BC ZF_kf_ui8_S5_S3 2550 UMR_MSEC__10_1_M255_S5_S3 -2550 0
 /begin AXIS_DESCR STD_AXIS zff_atsys._.iSignale._.obj.sig_c_getr UMR_GRADC__1_1_M40_S5_S3 4 -40 215 DEPOSIT ABSOLUTE /end AXIS_DESCR
 /begin AXIS_DESCR STD_AXIS zff_atsys._.iSignale._.obj.sig_m_t8 UMR_NM__6_1_M34_S5_S3 4 -204 1326 DEPOSIT ABSOLUTE /end AXIS_DESCR
/end CHARACTERISTIC
/begin CHARACTERISTIC KF_TSYNCGMTHINSYNSP32 "Zeit vor sync. fur Rampenstart Haltephase in Synchron" MAP 0x1B063C ZF_kf_ui8_S5_S3 2550 UMR_MSEC__10_1_M255_S5_S3 -2550 0
 /begin AXIS_DESCR STD_AXIS zff_atsys._.iSignale._.obj.sig_c_getr UMR_GRADC__1_1_M40_S5_S3 4 -40 215 DEPOSIT ABSOLUTE /end AXIS_DESCR
 /begin AXIS_DESCR STD_AXIS zff_atsys._.iSignale._.obj.sig_m_t8 UMR_NM__6_1_M34_S5_S3 4 -204 1326 DEPOSIT ABSOLUTE /end AXIS_DESCR
/end CHARACTERISTIC
/begin CHARACTERISTIC KF_TSYNCGMTHINSYNSP42 "Zeit vor sync. fur Rampenstart Haltephase in Synchron" MAP 0x1B07FC ZF_kf_ui8_S5_S3 2550 UMR_MSEC__10_1_M255_S5_S3 -2550 0
 /begin AXIS_DESCR STD_AXIS zff_atsys._.iSignale._.obj.sig_c_getr UMR_GRADC__1_1_M40_S5_S3 4 -40 215 DEPOSIT ABSOLUTE /end AXIS_DESCR
 /begin AXIS_DESCR STD_AXIS zff_atsys._.iSignale._.obj.sig_m_t8 UMR_NM__6_1_M34_S5_S3 4 -204 1326 DEPOSIT ABSOLUTE /end AXIS_DESCR
/end CHARACTERISTIC
/begin CHARACTERISTIC KF_TSYNCGMTHINSYNSP43 "Zeit vor sync. fur Rampenstart Haltephase in Synchron" MAP 0x1B067C ZF_kf_ui8_S5_S3 2550 UMR_MSEC__10_1_M255_S5_S3 -2550 0
 /begin AXIS_DESCR STD_AXIS zff_atsys._.iSignale._.obj.sig_c_getr UMR_GRADC__1_1_M40_S5_S3 4 -40 215 DEPOSIT ABSOLUTE /end AXIS_DESCR
 /begin AXIS_DESCR STD_AXIS zff_atsys._.iSignale._.obj.sig_m_t8 UMR_NM__6_1_M34_S5_S3 4 -204 1326 DEPOSIT ABSOLUTE /end AXIS_DESCR
/end CHARACTERISTIC
/begin CHARACTERISTIC KF_TSYNCGMTHINSYNSP51 "Zeit vor sync. fur Rampenstart Haltephase in Synchron" MAP 0x1B083C ZF_kf_ui8_S5_S3 2550 UMR_MSEC__10_1_M255_S5_S3 -2550 0
 /begin AXIS_DESCR STD_AXIS zff_atsys._.iSignale._.obj.sig_c_getr UMR_GRADC__1_1_M40_S5_S3 4 -40 215 DEPOSIT ABSOLUTE /end AXIS_DESCR
 /begin AXIS_DESCR STD_AXIS zff_atsys._.iSignale._.obj.sig_m_t8 UMR_NM__6_1_M34_S5_S3 4 -204 1326 DEPOSIT ABSOLUTE /end AXIS_DESCR
/end CHARACTERISTIC
/begin CHARACTERISTIC KF_TSYNCGMTHINSYNSP53 "Zeit vor sync. fur Rampenstart Haltephase in Synchron" MAP 0x1B087C ZF_kf_ui8_S5_S3 2550 UMR_MSEC__10_1_M255_S5_S3 -2550 0
 /begin AXIS_DESCR STD_AXIS zff_atsys._.iSignale._.obj.sig_c_getr UMR_GRADC__1_1_M40_S5_S3 4 -40 215 DEPOSIT ABSOLUTE /end AXIS_DESCR
 /begin AXIS_DESCR STD_AXIS zff_atsys._.iSignale._.obj.sig_m_t8 UMR_NM__6_1_M34_S5_S3 4 -204 1326 DEPOSIT ABSOLUTE /end AXIS_DESCR
/end CHARACTERISTIC
/begin CHARACTERISTIC KF_TSYNCGMTHINSYNSP54 "Zeit vor sync. fur Rampenstart Haltephase in Synchron" MAP 0x1B06BC ZF_kf_ui8_S5_S3 2550 UMR_MSEC__10_1_M255_S5_S3 -2550 0
 /begin AXIS_DESCR STD_AXIS zff_atsys._.iSignale._.obj.sig_c_getr UMR_GRADC__1_1_M40_S5_S3 4 -40 215 DEPOSIT ABSOLUTE /end AXIS_DESCR
 /begin AXIS_DESCR STD_AXIS zff_atsys._.iSignale._.obj.sig_m_t8 UMR_NM__6_1_M34_S5_S3 4 -204 1326 DEPOSIT ABSOLUTE /end AXIS_DESCR
/end CHARACTERISTIC
/begin CHARACTERISTIC KF_TSYNCGMTHINSYNSP63 "Zeit vor sync. fur Rampenstart Haltephase in Synchron" MAP 0x1B08BC ZF_kf_ui8_S5_S3 2550 UMR_MSEC__10_1_M255_S5_S3 -2550 0
 /begin AXIS_DESCR STD_AXIS zff_atsys._.iSignale._.obj.sig_c_getr UMR_GRADC__1_1_M40_S5_S3 4 -40 215 DEPOSIT ABSOLUTE /end AXIS_DESCR
 /begin AXIS_DESCR STD_AXIS zff_atsys._.iSignale._.obj.sig_m_t8 UMR_NM__6_1_M34_S5_S3 4 -204 1326 DEPOSIT ABSOLUTE /end AXIS_DESCR
/end CHARACTERISTIC
/begin CHARACTERISTIC KF_TSYNCGMTHINSYNSP64 "Zeit vor sync. fur Rampenstart Haltephase in Synchron" MAP 0x1B08FC ZF_kf_ui8_S5_S3 2550 UMR_MSEC__10_1_M255_S5_S3 -2550 0
 /begin AXIS_DESCR STD_AXIS zff_atsys._.iSignale._.obj.sig_c_getr UMR_GRADC__1_1_M40_S5_S3 4 -40 215 DEPOSIT ABSOLUTE /end AXIS_DESCR
 /begin AXIS_DESCR STD_AXIS zff_atsys._.iSignale._.obj.sig_m_t8 UMR_NM__6_1_M34_S5_S3 4 -204 1326 DEPOSIT ABSOLUTE /end AXIS_DESCR
/end CHARACTERISTIC
/begin CHARACTERISTIC KF_TSYNCGMTHINSYNSP65 "Zeit vor sync. fur Rampenstart Haltephase in Synchron" MAP 0x1B06FC ZF_kf_ui8_S5_S3 2550 UMR_MSEC__10_1_M255_S5_S3 -2550 0
 /begin AXIS_DESCR STD_AXIS zff_atsys._.iSignale._.obj.sig_c_getr UMR_GRADC__1_1_M40_S5_S3 4 -40 215 DEPOSIT ABSOLUTE /end AXIS_DESCR
 /begin AXIS_DESCR STD_AXIS zff_atsys._.iSignale._.obj.sig_m_t8 UMR_NM__6_1_M34_S5_S3 4 -204 1326 DEPOSIT ABSOLUTE /end AXIS_DESCR
/end CHARACTERISTIC
/begin CHARACTERISTIC KF_TSYNCGMTHINSYNSP71 "Zeit vor sync. fur Rampenstart Haltephase in Synchron" MAP 0x1B093C ZF_kf_ui8_S5_S3 2550 UMR_MSEC__10_1_M255_S5_S3 -2550 0
 /begin AXIS_DESCR STD_AXIS zff_atsys._.iSignale._.obj.sig_c_getr UMR_GRADC__1_1_M40_S5_S3 4 -40 215 DEPOSIT ABSOLUTE /end AXIS_DESCR
 /begin AXIS_DESCR STD_AXIS zff_atsys._.iSignale._.obj.sig_m_t8 UMR_NM__6_1_M34_S5_S3 4 -204 1326 DEPOSIT ABSOLUTE /end AXIS_DESCR
/end CHARACTERISTIC
/begin CHARACTERISTIC KF_TSYNNTKFMTMEHAUPTESPORT65 "Zeitkriterium Ende Haupt-ME bei Momentenerhoehung" MAP 0x1AD5A0 ZF_kf_ui8_S5_S3 1280 UMR_MSEC__10_1_M128_S5_S3 -1280 0
 /begin AXIS_DESCR STD_AXIS iSasZentr.iSchaltend.n_tkf UMR_U_MIN_32_1_0_S5_S3 4 0 8160 DEPOSIT ABSOLUTE /end AXIS_DESCR
 /begin AXIS_DESCR STD_AXIS zff_atsys._.iSignale._.obj.sig_m_t8 UMR_NM__6_1_M34_S5_S3 4 -204 1326 DEPOSIT ABSOLUTE /end AXIS_DESCR
/end CHARACTERISTIC
/begin CHARACTERISTIC KF_TSYNNTKFMTMEHAUPTESPORT71 "Zeitkriterium Ende Haupt-ME bei Momentenerhoehung" MAP 0x1AE098 ZF_kf_ui8_S5_S3 1280 UMR_MSEC__10_1_M128_S5_S3 -1280 0
 /begin AXIS_DESCR STD_AXIS iSasZentr.iSchaltend.n_tkf UMR_U_MIN_32_1_0_S5_S3 4 0 8160 DEPOSIT ABSOLUTE /end AXIS_DESCR
 /begin AXIS_DESCR STD_AXIS zff_atsys._.iSignale._.obj.sig_m_t8 UMR_NM__6_1_M34_S5_S3 4 -204 1326 DEPOSIT ABSOLUTE /end AXIS_DESCR
/end CHARACTERISTIC
/begin CHARACTERISTIC KF_TSYNNTKFMTMEHAUPTESPORT75 "Zeitkriterium Ende Haupt-ME bei Momentenerhoehung" MAP 0x1AE1D0 ZF_kf_ui8_S5_S3 1280 UMR_MSEC__10_1_M128_S5_S3 -1280 0
 /begin AXIS_DESCR STD_AXIS iSasZentr.iSchaltend.n_tkf UMR_U_MIN_32_1_0_S5_S3 4 0 8160 DEPOSIT ABSOLUTE /end AXIS_DESCR
 /begin AXIS_DESCR STD_AXIS zff_atsys._.iSignale._.obj.sig_m_t8 UMR_NM__6_1_M34_S5_S3 4 -204 1326 DEPOSIT ABSOLUTE /end AXIS_DESCR
/end CHARACTERISTIC
/begin CHARACTERISTIC KF_TSYNNTKFMTMEHAUPTESPORT76 "Zeitkriterium Ende Haupt-ME bei Momentenerhoehung" MAP 0x1AD6D8 ZF_kf_ui8_S5_S3 1280 UMR_MSEC__10_1_M128_S5_S3 -1280 0
 /begin AXIS_DESCR STD_AXIS iSasZentr.iSchaltend.n_tkf UMR_U_MIN_32_1_0_S5_S3 4 0 8160 DEPOSIT ABSOLUTE /end AXIS_DESCR
 /begin AXIS_DESCR STD_AXIS zff_atsys._.iSignale._.obj.sig_m_t8 UMR_NM__6_1_M34_S5_S3 4 -204 1326 DEPOSIT ABSOLUTE /end AXIS_DESCR
/end CHARACTERISTIC
/begin CHARACTERISTIC KF_TSYNNTKFMTMEHAUPTESPORT82 "Zeitkriterium Ende Haupt-ME bei Momentenerhoehung" MAP 0x1AE308 ZF_kf_ui8_S5_S3 1280 UMR_MSEC__10_1_M128_S5_S3 -1280 0
 /begin AXIS_DESCR STD_AXIS iSasZentr.iSchaltend.n_tkf UMR_U_MIN_32_1_0_S5_S3 4 0 8160 DEPOSIT ABSOLUTE /end AXIS_DESCR
 /begin AXIS_DESCR STD_AXIS zff_atsys._.iSignale._.obj.sig_m_t8 UMR_NM__6_1_M34_S5_S3 4 -204 1326 DEPOSIT ABSOLUTE /end AXIS_DESCR
/end CHARACTERISTIC
/begin CHARACTERISTIC KF_TSYNNTKFMTMEHAUPTESPORT84 "Zeitkriterium Ende Haupt-ME bei Momentenerhoehung" MAP 0x1AE440 ZF_kf_ui8_S5_S3 1280 UMR_MSEC__10_1_M128_S5_S3 -1280 0
 /begin AXIS_DESCR STD_AXIS iSasZentr.iSchaltend.n_tkf UMR_U_MIN_32_1_0_S5_S3 4 0 8160 DEPOSIT ABSOLUTE /end AXIS_DESCR
 /begin AXIS_DESCR STD_AXIS zff_atsys._.iSignale._.obj.sig_m_t8 UMR_NM__6_1_M34_S5_S3 4 -204 1326 DEPOSIT ABSOLUTE /end AXIS_DESCR
/end CHARACTERISTIC
/begin CHARACTERISTIC KF_TSYNNTKFMTMEHAUPTESPORT86 "Zeitkriterium Ende Haupt-ME bei Momentenerhoehung" MAP 0x1AE578 ZF_kf_ui8_S5_S3 1280 UMR_MSEC__10_1_M128_S5_S3 -1280 0
 /begin AXIS_DESCR STD_AXIS iSasZentr.iSchaltend.n_tkf UMR_U_MIN_32_1_0_S5_S3 4 0 8160 DEPOSIT ABSOLUTE /end AXIS_DESCR
 /begin AXIS_DESCR STD_AXIS zff_atsys._.iSignale._.obj.sig_m_t8 UMR_NM__6_1_M34_S5_S3 4 -204 1326 DEPOSIT ABSOLUTE /end AXIS_DESCR
/end CHARACTERISTIC
/begin CHARACTERISTIC KF_TSYNNTKFMTMEHAUPTESPORT87 "Zeitkriterium Ende Haupt-ME bei Momentenerhoehung" MAP 0x1AD810 ZF_kf_ui8_S5_S3 1280 UMR_MSEC__10_1_M128_S5_S3 -1280 0
 /begin AXIS_DESCR STD_AXIS iSasZentr.iSchaltend.n_tkf UMR_U_MIN_32_1_0_S5_S3 4 0 8160 DEPOSIT ABSOLUTE /end AXIS_DESCR
 /begin AXIS_DESCR STD_AXIS zff_atsys._.iSignale._.obj.sig_m_t8 UMR_NM__6_1_M34_S5_S3 4 -204 1326 DEPOSIT ABSOLUTE /end AXIS_DESCR
/end CHARACTERISTIC
/begin CHARACTERISTIC KF_TVMEA12 "Verzoegerungszeit fuer Beginn Haupt-ME" MAP 0x1A7570 ZF_kf_si16_S5_S3 2000 UMR_MSEC__10_1_0_S5_S3 -1000 1000
 /begin AXIS_DESCR STD_AXIS zff_atsys._.iSignale._.obj.sig_n_t8 UMR_U_MIN_32_1_0_S5_S3 8 0 8160 DEPOSIT ABSOLUTE /end AXIS_DESCR
 /begin AXIS_DESCR STD_AXIS zff_atsys._.iSignale._.obj.sig_m_t8 UMR_NM__6_1_M34_S5_S3 4 -204 1326 DEPOSIT ABSOLUTE /end AXIS_DESCR
/end CHARACTERISTIC
/begin CHARACTERISTIC KF_TVMEA12_EL "Verzoegerungszeit fuer Beginn Haupt-ME" MAP 0x1A75D0 ZF_kf_si16_S5_S3 2000 UMR_MSEC__10_1_0_S5_S3 -1000 1000
 /begin AXIS_DESCR STD_AXIS zff_atsys._.iSignale._.obj.sig_n_t8 UMR_U_MIN_32_1_0_S5_S3 8 0 8160 DEPOSIT ABSOLUTE /end AXIS_DESCR
 /begin AXIS_DESCR STD_AXIS zff_atsys._.iSignale._.obj.sig_m_t8 UMR_NM__6_1_M34_S5_S3 4 -204 1326 DEPOSIT ABSOLUTE /end AXIS_DESCR
/end CHARACTERISTIC
/begin CHARACTERISTIC KF_TVMEA23 "Verzoegerungszeit fuer Beginn Haupt-ME" MAP 0x1A769C ZF_kf_si16_S5_S3 2000 UMR_MSEC__10_1_0_S5_S3 -1000 1000
 /begin AXIS_DESCR STD_AXIS zff_atsys._.iSignale._.obj.sig_n_t8 UMR_U_MIN_32_1_0_S5_S3 8 0 8160 DEPOSIT ABSOLUTE /end AXIS_DESCR
 /begin AXIS_DESCR STD_AXIS zff_atsys._.iSignale._.obj.sig_m_t8 UMR_NM__6_1_M34_S5_S3 4 -204 1326 DEPOSIT ABSOLUTE /end AXIS_DESCR
/end CHARACTERISTIC
/begin CHARACTERISTIC KF_TVMEA23_EL "Verzoegerungszeit fuer Beginn Haupt-ME" MAP 0x1A76FC ZF_kf_si16_S5_S3 2000 UMR_MSEC__10_1_0_S5_S3 -1000 1000
 /begin AXIS_DESCR STD_AXIS zff_atsys._.iSignale._.obj.sig_n_t8 UMR_U_MIN_32_1_0_S5_S3 8 0 8160 DEPOSIT ABSOLUTE /end AXIS_DESCR
 /begin AXIS_DESCR STD_AXIS zff_atsys._.iSignale._.obj.sig_m_t8 UMR_NM__6_1_M34_S5_S3 4 -204 1326 DEPOSIT ABSOLUTE /end AXIS_DESCR
/end CHARACTERISTIC
/begin CHARACTERISTIC KF_TVMEA34 "Verzoegerungszeit fuer Beginn Haupt-ME" MAP 0x1A77C8 ZF_kf_si16_S5_S3 2000 UMR_MSEC__10_1_0_S5_S3 -1000 1000
 /begin AXIS_DESCR STD_AXIS zff_atsys._.iSignale._.obj.sig_n_t8 UMR_U_MIN_32_1_0_S5_S3 8 0 8160 DEPOSIT ABSOLUTE /end AXIS_DESCR
 /begin AXIS_DESCR STD_AXIS zff_atsys._.iSignale._.obj.sig_m_t8 UMR_NM__6_1_M34_S5_S3 4 -204 1326 DEPOSIT ABSOLUTE /end AXIS_DESCR
/end CHARACTERISTIC
/begin CHARACTERISTIC KF_TVMEA34_EL "Verzoegerungszeit fuer Beginn Haupt-ME" MAP 0x1A7828 ZF_kf_si16_S5_S3 2000 UMR_MSEC__10_1_0_S5_S3 -1000 1000
 /begin AXIS_DESCR STD_AXIS zff_atsys._.iSignale._.obj.sig_n_t8 UMR_U_MIN_32_1_0_S5_S3 8 0 8160 DEPOSIT ABSOLUTE /end AXIS_DESCR
 /begin AXIS_DESCR STD_AXIS zff_atsys._.iSignale._.obj.sig_m_t8 UMR_NM__6_1_M34_S5_S3 4 -204 1326 DEPOSIT ABSOLUTE /end AXIS_DESCR
/end CHARACTERISTIC
/begin CHARACTERISTIC KF_TVMEA45 "Verzoegerungszeit fuer Beginn Haupt-ME" MAP 0x1A78F4 ZF_kf_si16_S5_S3 2000 UMR_MSEC__10_1_0_S5_S3 -1000 1000
 /begin AXIS_DESCR STD_AXIS zff_atsys._.iSignale._.obj.sig_n_t8 UMR_U_MIN_32_1_0_S5_S3 8 0 8160 DEPOSIT ABSOLUTE /end AXIS_DESCR
 /begin AXIS_DESCR STD_AXIS zff_atsys._.iSignale._.obj.sig_m_t8 UMR_NM__6_1_M34_S5_S3 4 -204 1326 DEPOSIT ABSOLUTE /end AXIS_DESCR
/end CHARACTERISTIC
/begin CHARACTERISTIC KF_TVMEA45_EL "Verzoegerungszeit fuer Beginn Haupt-ME" MAP 0x1A7954 ZF_kf_si16_S5_S3 2000 UMR_MSEC__10_1_0_S5_S3 -1000 1000
 /begin AXIS_DESCR STD_AXIS zff_atsys._.iSignale._.obj.sig_n_t8 UMR_U_MIN_32_1_0_S5_S3 8 0 8160 DEPOSIT ABSOLUTE /end AXIS_DESCR
 /begin AXIS_DESCR STD_AXIS zff_atsys._.iSignale._.obj.sig_m_t8 UMR_NM__6_1_M34_S5_S3 4 -204 1326 DEPOSIT ABSOLUTE /end AXIS_DESCR
/end CHARACTERISTIC
/begin CHARACTERISTIC KF_TVMEA56 "Verzoegerungszeit fuer Beginn Haupt-ME" MAP 0x1A7A20 ZF_kf_si16_S5_S3 2000 UMR_MSEC__10_1_0_S5_S3 -1000 1000
 /begin AXIS_DESCR STD_AXIS zff_atsys._.iSignale._.obj.sig_n_t8 UMR_U_MIN_32_1_0_S5_S3 8 0 8160 DEPOSIT ABSOLUTE /end AXIS_DESCR
 /begin AXIS_DESCR STD_AXIS zff_atsys._.iSignale._.obj.sig_m_t8 UMR_NM__6_1_M34_S5_S3 4 -204 1326 DEPOSIT ABSOLUTE /end AXIS_DESCR
/end CHARACTERISTIC
/begin CHARACTERISTIC KF_TVMEA56_EL "Verzoegerungszeit fuer Beginn Haupt-ME" MAP 0x1A7A80 ZF_kf_si16_S5_S3 2000 UMR_MSEC__10_1_0_S5_S3 -1000 1000
 /begin AXIS_DESCR STD_AXIS zff_atsys._.iSignale._.obj.sig_n_t8 UMR_U_MIN_32_1_0_S5_S3 8 0 8160 DEPOSIT ABSOLUTE /end AXIS_DESCR
 /begin AXIS_DESCR STD_AXIS zff_atsys._.iSignale._.obj.sig_m_t8 UMR_NM__6_1_M34_S5_S3 4 -204 1326 DEPOSIT ABSOLUTE /end AXIS_DESCR
/end CHARACTERISTIC
/begin CHARACTERISTIC KF_TVMEA67 "Verzoegerungszeit fuer Beginn Haupt-ME" MAP 0x1A7B4C ZF_kf_si16_S5_S3 2000 UMR_MSEC__10_1_0_S5_S3 -1000 1000
 /begin AXIS_DESCR STD_AXIS zff_atsys._.iSignale._.obj.sig_n_t8 UMR_U_MIN_32_1_0_S5_S3 8 0 8160 DEPOSIT ABSOLUTE /end AXIS_DESCR
 /begin AXIS_DESCR STD_AXIS zff_atsys._.iSignale._.obj.sig_m_t8 UMR_NM__6_1_M34_S5_S3 4 -204 1326 DEPOSIT ABSOLUTE /end AXIS_DESCR
/end CHARACTERISTIC
/begin CHARACTERISTIC KF_TVMEA67_EL "Verzoegerungszeit fuer Beginn Haupt-ME" MAP 0x1A7BAC ZF_kf_si16_S5_S3 2000 UMR_MSEC__10_1_0_S5_S3 -1000 1000
 /begin AXIS_DESCR STD_AXIS zff_atsys._.iSignale._.obj.sig_n_t8 UMR_U_MIN_32_1_0_S5_S3 8 0 8160 DEPOSIT ABSOLUTE /end AXIS_DESCR
 /begin AXIS_DESCR STD_AXIS zff_atsys._.iSignale._.obj.sig_m_t8 UMR_NM__6_1_M34_S5_S3 4 -204 1326 DEPOSIT ABSOLUTE /end AXIS_DESCR
/end CHARACTERISTIC
/begin CHARACTERISTIC KF_TVMEA78 "Verzoegerungszeit fuer Beginn Haupt-ME" MAP 0x1A7C78 ZF_kf_si16_S5_S3 2000 UMR_MSEC__10_1_0_S5_S3 -1000 1000
 /begin AXIS_DESCR STD_AXIS zff_atsys._.iSignale._.obj.sig_n_t8 UMR_U_MIN_32_1_0_S5_S3 8 0 8160 DEPOSIT ABSOLUTE /end AXIS_DESCR
 /begin AXIS_DESCR STD_AXIS zff_atsys._.iSignale._.obj.sig_m_t8 UMR_NM__6_1_M34_S5_S3 4 -204 1326 DEPOSIT ABSOLUTE /end AXIS_DESCR
/end CHARACTERISTIC
/begin CHARACTERISTIC KF_TVMEA78_EL "Verzoegerungszeit fuer Beginn Haupt-ME" MAP 0x1A7CD8 ZF_kf_si16_S5_S3 2000 UMR_MSEC__10_1_0_S5_S3 -1000 1000
 /begin AXIS_DESCR STD_AXIS zff_atsys._.iSignale._.obj.sig_n_t8 UMR_U_MIN_32_1_0_S5_S3 8 0 8160 DEPOSIT ABSOLUTE /end AXIS_DESCR
 /begin AXIS_DESCR STD_AXIS zff_atsys._.iSignale._.obj.sig_m_t8 UMR_NM__6_1_M34_S5_S3 4 -204 1326 DEPOSIT ABSOLUTE /end AXIS_DESCR
/end CHARACTERISTIC
/begin CHARACTERISTIC KF_TVMEASP12 "Verzoegerungszeit fuer Beginn Haupt-ME" MAP 0x1A7D94 ZF_kf_si16_S5_S3 2000 UMR_MSEC__10_1_0_S5_S3 -1000 1000
 /begin AXIS_DESCR STD_AXIS zff_atsys._.iSignale._.obj.sig_n_t8 UMR_U_MIN_32_1_0_S5_S3 8 0 8160 DEPOSIT ABSOLUTE /end AXIS_DESCR
 /begin AXIS_DESCR STD_AXIS zff_atsys._.iSignale._.obj.sig_m_t8 UMR_NM__6_1_M34_S5_S3 4 -204 1326 DEPOSIT ABSOLUTE /end AXIS_DESCR
/end CHARACTERISTIC
/begin CHARACTERISTIC KF_TVMEASP23 "Verzoegerungszeit fuer Beginn Haupt-ME" MAP 0x1A7E50 ZF_kf_si16_S5_S3 2000 UMR_MSEC__10_1_0_S5_S3 -1000 1000
 /begin AXIS_DESCR STD_AXIS zff_atsys._.iSignale._.obj.sig_n_t8 UMR_U_MIN_32_1_0_S5_S3 8 0 8160 DEPOSIT ABSOLUTE /end AXIS_DESCR
 /begin AXIS_DESCR STD_AXIS zff_atsys._.iSignale._.obj.sig_m_t8 UMR_NM__6_1_M34_S5_S3 4 -204 1326 DEPOSIT ABSOLUTE /end AXIS_DESCR
/end CHARACTERISTIC
/begin CHARACTERISTIC KF_TVMEASP34 "Verzoegerungszeit fuer Beginn Haupt-ME" MAP 0x1A7F0C ZF_kf_si16_S5_S3 2000 UMR_MSEC__10_1_0_S5_S3 -1000 1000
 /begin AXIS_DESCR STD_AXIS zff_atsys._.iSignale._.obj.sig_n_t8 UMR_U_MIN_32_1_0_S5_S3 8 0 8160 DEPOSIT ABSOLUTE /end AXIS_DESCR
 /begin AXIS_DESCR STD_AXIS zff_atsys._.iSignale._.obj.sig_m_t8 UMR_NM__6_1_M34_S5_S3 4 -204 1326 DEPOSIT ABSOLUTE /end AXIS_DESCR
/end CHARACTERISTIC
/begin CHARACTERISTIC KF_TVMEASP45 "Verzoegerungszeit fuer Beginn Haupt-ME" MAP 0x1A7FC8 ZF_kf_si16_S5_S3 2000 UMR_MSEC__10_1_0_S5_S3 -1000 1000
 /begin AXIS_DESCR STD_AXIS zff_atsys._.iSignale._.obj.sig_n_t8 UMR_U_MIN_32_1_0_S5_S3 8 0 8160 DEPOSIT ABSOLUTE /end AXIS_DESCR
 /begin AXIS_DESCR STD_AXIS zff_atsys._.iSignale._.obj.sig_m_t8 UMR_NM__6_1_M34_S5_S3 4 -204 1326 DEPOSIT ABSOLUTE /end AXIS_DESCR
/end CHARACTERISTIC
/begin CHARACTERISTIC KF_TVMEASP56 "Verzoegerungszeit fuer Beginn Haupt-ME" MAP 0x1A8084 ZF_kf_si16_S5_S3 2000 UMR_MSEC__10_1_0_S5_S3 -1000 1000
 /begin AXIS_DESCR STD_AXIS zff_atsys._.iSignale._.obj.sig_n_t8 UMR_U_MIN_32_1_0_S5_S3 8 0 8160 DEPOSIT ABSOLUTE /end AXIS_DESCR
 /begin AXIS_DESCR STD_AXIS zff_atsys._.iSignale._.obj.sig_m_t8 UMR_NM__6_1_M34_S5_S3 4 -204 1326 DEPOSIT ABSOLUTE /end AXIS_DESCR
/end CHARACTERISTIC
/begin CHARACTERISTIC KF_TVMEASP67 "Verzoegerungszeit fuer Beginn Haupt-ME" MAP 0x1A8140 ZF_kf_si16_S5_S3 2000 UMR_MSEC__10_1_0_S5_S3 -1000 1000
 /begin AXIS_DESCR STD_AXIS zff_atsys._.iSignale._.obj.sig_n_t8 UMR_U_MIN_32_1_0_S5_S3 8 0 8160 DEPOSIT ABSOLUTE /end AXIS_DESCR
 /begin AXIS_DESCR STD_AXIS zff_atsys._.iSignale._.obj.sig_m_t8 UMR_NM__6_1_M34_S5_S3 4 -204 1326 DEPOSIT ABSOLUTE /end AXIS_DESCR
/end CHARACTERISTIC
/begin CHARACTERISTIC KF_TVMEASP78 "Verzoegerungszeit fuer Beginn Haupt-ME" MAP 0x1A81FC ZF_kf_si16_S5_S3 2000 UMR_MSEC__10_1_0_S5_S3 -1000 1000
 /begin AXIS_DESCR STD_AXIS zff_atsys._.iSignale._.obj.sig_n_t8 UMR_U_MIN_32_1_0_S5_S3 8 0 8160 DEPOSIT ABSOLUTE /end AXIS_DESCR
 /begin AXIS_DESCR STD_AXIS zff_atsys._.iSignale._.obj.sig_m_t8 UMR_NM__6_1_M34_S5_S3 4 -204 1326 DEPOSIT ABSOLUTE /end AXIS_DESCR
/end CHARACTERISTIC
/begin CHARACTERISTIC KF_TVMEASPORT12 "Verzoegerungszeit fuer Beginn Haupt-ME" MAP 0x1A82B8 ZF_kf_si16_S5_S3 2000 UMR_MSEC__10_1_0_S5_S3 -1000 1000
 /begin AXIS_DESCR STD_AXIS zff_atsys._.iSignale._.obj.sig_n_t8 UMR_U_MIN_32_1_0_S5_S3 8 0 8160 DEPOSIT ABSOLUTE /end AXIS_DESCR
 /begin AXIS_DESCR STD_AXIS zff_atsys._.iSignale._.obj.sig_m_t8 UMR_NM__6_1_M34_S5_S3 4 -204 1326 DEPOSIT ABSOLUTE /end AXIS_DESCR
/end CHARACTERISTIC
/begin CHARACTERISTIC KF_TVMEASPORT23 "Verzoegerungszeit fuer Beginn Haupt-ME" MAP 0x1A8374 ZF_kf_si16_S5_S3 2000 UMR_MSEC__10_1_0_S5_S3 -1000 1000
 /begin AXIS_DESCR STD_AXIS zff_atsys._.iSignale._.obj.sig_n_t8 UMR_U_MIN_32_1_0_S5_S3 8 0 8160 DEPOSIT ABSOLUTE /end AXIS_DESCR
 /begin AXIS_DESCR STD_AXIS zff_atsys._.iSignale._.obj.sig_m_t8 UMR_NM__6_1_M34_S5_S3 4 -204 1326 DEPOSIT ABSOLUTE /end AXIS_DESCR
/end CHARACTERISTIC
/begin CHARACTERISTIC KF_TVMEASPORT34 "Verzoegerungszeit fuer Beginn Haupt-ME" MAP 0x1A8430 ZF_kf_si16_S5_S3 2000 UMR_MSEC__10_1_0_S5_S3 -1000 1000
 /begin AXIS_DESCR STD_AXIS zff_atsys._.iSignale._.obj.sig_n_t8 UMR_U_MIN_32_1_0_S5_S3 8 0 8160 DEPOSIT ABSOLUTE /end AXIS_DESCR
 /begin AXIS_DESCR STD_AXIS zff_atsys._.iSignale._.obj.sig_m_t8 UMR_NM__6_1_M34_S5_S3 4 -204 1326 DEPOSIT ABSOLUTE /end AXIS_DESCR
/end CHARACTERISTIC
/begin CHARACTERISTIC KF_TVMEASPORT45 "Verzoegerungszeit fuer Beginn Haupt-ME" MAP 0x1A84EC ZF_kf_si16_S5_S3 2000 UMR_MSEC__10_1_0_S5_S3 -1000 1000
 /begin AXIS_DESCR STD_AXIS zff_atsys._.iSignale._.obj.sig_n_t8 UMR_U_MIN_32_1_0_S5_S3 8 0 8160 DEPOSIT ABSOLUTE /end AXIS_DESCR
 /begin AXIS_DESCR STD_AXIS zff_atsys._.iSignale._.obj.sig_m_t8 UMR_NM__6_1_M34_S5_S3 4 -204 1326 DEPOSIT ABSOLUTE /end AXIS_DESCR
/end CHARACTERISTIC
/begin CHARACTERISTIC KF_TVMEASPORT56 "Verzoegerungszeit fuer Beginn Haupt-ME" MAP 0x1A85A8 ZF_kf_si16_S5_S3 2000 UMR_MSEC__10_1_0_S5_S3 -1000 1000
 /begin AXIS_DESCR STD_AXIS zff_atsys._.iSignale._.obj.sig_n_t8 UMR_U_MIN_32_1_0_S5_S3 8 0 8160 DEPOSIT ABSOLUTE /end AXIS_DESCR
 /begin AXIS_DESCR STD_AXIS zff_atsys._.iSignale._.obj.sig_m_t8 UMR_NM__6_1_M34_S5_S3 4 -204 1326 DEPOSIT ABSOLUTE /end AXIS_DESCR
/end CHARACTERISTIC
/begin CHARACTERISTIC KF_TVMEASPORT67 "Verzoegerungszeit fuer Beginn Haupt-ME" MAP 0x1A8664 ZF_kf_si16_S5_S3 2000 UMR_MSEC__10_1_0_S5_S3 -1000 1000
 /begin AXIS_DESCR STD_AXIS zff_atsys._.iSignale._.obj.sig_n_t8 UMR_U_MIN_32_1_0_S5_S3 8 0 8160 DEPOSIT ABSOLUTE /end AXIS_DESCR
 /begin AXIS_DESCR STD_AXIS zff_atsys._.iSignale._.obj.sig_m_t8 UMR_NM__6_1_M34_S5_S3 4 -204 1326 DEPOSIT ABSOLUTE /end AXIS_DESCR
/end CHARACTERISTIC
/begin CHARACTERISTIC KF_TVMEASPORT78 "Verzoegerungszeit fuer Beginn Haupt-ME" MAP 0x1A8720 ZF_kf_si16_S5_S3 2000 UMR_MSEC__10_1_0_S5_S3 -1000 1000
 /begin AXIS_DESCR STD_AXIS zff_atsys._.iSignale._.obj.sig_n_t8 UMR_U_MIN_32_1_0_S5_S3 8 0 8160 DEPOSIT ABSOLUTE /end AXIS_DESCR
 /begin AXIS_DESCR STD_AXIS zff_atsys._.iSignale._.obj.sig_m_t8 UMR_NM__6_1_M34_S5_S3 4 -204 1326 DEPOSIT ABSOLUTE /end AXIS_DESCR
/end CHARACTERISTIC
/begin CHARACTERISTIC KF_TVMTNMOTMEHAUPTSPORT65 "Verzoegerungszeit Start Haupt-ME bei Momentenerhoehung" MAP 0x1AD580 ZF_kf_ui8_S5_S3 2540 UMR_MSEC__10_1_0_S5_S3 0 2540
 /begin AXIS_DESCR STD_AXIS zff_atsys._.iSignale._.obj.sig_m_t8 UMR_NM__6_1_M34_S5_S3 4 -204 1326 DEPOSIT ABSOLUTE /end AXIS_DESCR
 /begin AXIS_DESCR STD_AXIS zff_atsys._.iSignale._.obj.sig_n_mot8 UMR_U_MIN_32_1_0_S5_S3 4 0 8160 DEPOSIT ABSOLUTE /end AXIS_DESCR
/end CHARACTERISTIC
/begin CHARACTERISTIC KF_TVMTNMOTMEHAUPTSPORT71 "Verzoegerungszeit Start Haupt-ME bei Momentenerhoehung" MAP 0x1AE078 ZF_kf_ui8_S5_S3 2540 UMR_MSEC__10_1_0_S5_S3 0 2540
 /begin AXIS_DESCR STD_AXIS zff_atsys._.iSignale._.obj.sig_m_t8 UMR_NM__6_1_M34_S5_S3 4 -204 1326 DEPOSIT ABSOLUTE /end AXIS_DESCR
 /begin AXIS_DESCR STD_AXIS zff_atsys._.iSignale._.obj.sig_n_mot8 UMR_U_MIN_32_1_0_S5_S3 4 0 8160 DEPOSIT ABSOLUTE /end AXIS_DESCR
/end CHARACTERISTIC
/begin CHARACTERISTIC KF_TVMTNMOTMEHAUPTSPORT75 "Verzoegerungszeit Start Haupt-ME bei Momentenerhoehung" MAP 0x1AE1B0 ZF_kf_ui8_S5_S3 2540 UMR_MSEC__10_1_0_S5_S3 0 2540
 /begin AXIS_DESCR STD_AXIS zff_atsys._.iSignale._.obj.sig_m_t8 UMR_NM__6_1_M34_S5_S3 4 -204 1326 DEPOSIT ABSOLUTE /end AXIS_DESCR
 /begin AXIS_DESCR STD_AXIS zff_atsys._.iSignale._.obj.sig_n_mot8 UMR_U_MIN_32_1_0_S5_S3 4 0 8160 DEPOSIT ABSOLUTE /end AXIS_DESCR
/end CHARACTERISTIC
/begin CHARACTERISTIC KF_TVMTNMOTMEHAUPTSPORT76 "Verzoegerungszeit Start Haupt-ME bei Momentenerhoehung" MAP 0x1AD6B8 ZF_kf_ui8_S5_S3 2540 UMR_MSEC__10_1_0_S5_S3 0 2540
 /begin AXIS_DESCR STD_AXIS zff_atsys._.iSignale._.obj.sig_m_t8 UMR_NM__6_1_M34_S5_S3 4 -204 1326 DEPOSIT ABSOLUTE /end AXIS_DESCR
 /begin AXIS_DESCR STD_AXIS zff_atsys._.iSignale._.obj.sig_n_mot8 UMR_U_MIN_32_1_0_S5_S3 4 0 8160 DEPOSIT ABSOLUTE /end AXIS_DESCR
/end CHARACTERISTIC
/begin CHARACTERISTIC KF_TVMTNMOTMEHAUPTSPORT82 "Verzoegerungszeit Start Haupt-ME bei Momentenerhoehung" MAP 0x1AE2E8 ZF_kf_ui8_S5_S3 2540 UMR_MSEC__10_1_0_S5_S3 0 2540
 /begin AXIS_DESCR STD_AXIS zff_atsys._.iSignale._.obj.sig_m_t8 UMR_NM__6_1_M34_S5_S3 4 -204 1326 DEPOSIT ABSOLUTE /end AXIS_DESCR
 /begin AXIS_DESCR STD_AXIS zff_atsys._.iSignale._.obj.sig_n_mot8 UMR_U_MIN_32_1_0_S5_S3 4 0 8160 DEPOSIT ABSOLUTE /end AXIS_DESCR
/end CHARACTERISTIC
/begin CHARACTERISTIC KF_TVMTNMOTMEHAUPTSPORT84 "Verzoegerungszeit Start Haupt-ME bei Momentenerhoehung" MAP 0x1AE420 ZF_kf_ui8_S5_S3 2540 UMR_MSEC__10_1_0_S5_S3 0 2540
 /begin AXIS_DESCR STD_AXIS zff_atsys._.iSignale._.obj.sig_m_t8 UMR_NM__6_1_M34_S5_S3 4 -204 1326 DEPOSIT ABSOLUTE /end AXIS_DESCR
 /begin AXIS_DESCR STD_AXIS zff_atsys._.iSignale._.obj.sig_n_mot8 UMR_U_MIN_32_1_0_S5_S3 4 0 8160 DEPOSIT ABSOLUTE /end AXIS_DESCR
/end CHARACTERISTIC
/begin CHARACTERISTIC KF_TVMTNMOTMEHAUPTSPORT86 "Verzoegerungszeit Start Haupt-ME bei Momentenerhoehung" MAP 0x1AE558 ZF_kf_ui8_S5_S3 2540 UMR_MSEC__10_1_0_S5_S3 0 2540
 /begin AXIS_DESCR STD_AXIS zff_atsys._.iSignale._.obj.sig_m_t8 UMR_NM__6_1_M34_S5_S3 4 -204 1326 DEPOSIT ABSOLUTE /end AXIS_DESCR
 /begin AXIS_DESCR STD_AXIS zff_atsys._.iSignale._.obj.sig_n_mot8 UMR_U_MIN_32_1_0_S5_S3 4 0 8160 DEPOSIT ABSOLUTE /end AXIS_DESCR
/end CHARACTERISTIC
/begin CHARACTERISTIC KF_TVMTNMOTMEHAUPTSPORT87 "Verzoegerungszeit Start Haupt-ME bei Momentenerhoehung" MAP 0x1AD7F0 ZF_kf_ui8_S5_S3 2540 UMR_MSEC__10_1_0_S5_S3 0 2540
 /begin AXIS_DESCR STD_AXIS zff_atsys._.iSignale._.obj.sig_m_t8 UMR_NM__6_1_M34_S5_S3 4 -204 1326 DEPOSIT ABSOLUTE /end AXIS_DESCR
 /begin AXIS_DESCR STD_AXIS zff_atsys._.iSignale._.obj.sig_n_mot8 UMR_U_MIN_32_1_0_S5_S3 4 0 8160 DEPOSIT ABSOLUTE /end AXIS_DESCR
/end CHARACTERISTIC
/begin CHARACTERISTIC KL_CK_MMOTMAX "Kupplungstemperaturabhängige Motormomentenbegrenzung." CURVE 0x1AFF00 ZF_kl_si16_S5_S3 1500 UMR_NM__1_1_0_S5_S3 -200 1300
 /begin AXIS_DESCR STD_AXIS NO_INPUT_QUANTITY UMR_GRADC__1_1_0_S5_S3 4 -40 500 DEPOSIT ABSOLUTE /end AXIS_DESCR
/end CHARACTERISTIC
/begin CHARACTERISTIC KL_FMENACHESPORT65 "Faktor fuer Rampe Ende Nach-ME bei RS" CURVE 0x1AD4C0 ZF_kl_ui8_S5_S3 1 UMR___1_100_0_S5_S3 0 1
 /begin AXIS_DESCR STD_AXIS iMoeMesaf.timer_zmes UMR_MSEC__10_1_0_S5_S3 4 0 2550 DEPOSIT ABSOLUTE /end AXIS_DESCR
/end CHARACTERISTIC
/begin CHARACTERISTIC KL_FMENACHESPORT71 "Faktor fuer Rampe Ende Nach-ME bei RS" CURVE 0x1ADFB8 ZF_kl_ui8_S5_S3 1 UMR___1_100_0_S5_S3 0 1
 /begin AXIS_DESCR STD_AXIS iMoeMesaf.timer_zmes UMR_MSEC__10_1_0_S5_S3 4 0 2550 DEPOSIT ABSOLUTE /end AXIS_DESCR
/end CHARACTERISTIC
/begin CHARACTERISTIC KL_FMENACHESPORT75 "Faktor fuer Rampe Ende Nach-ME bei RS" CURVE 0x1AE0F0 ZF_kl_ui8_S5_S3 1 UMR___1_100_0_S5_S3 0 1
 /begin AXIS_DESCR STD_AXIS iMoeMesaf.timer_zmes UMR_MSEC__10_1_0_S5_S3 4 0 2550 DEPOSIT ABSOLUTE /end AXIS_DESCR
/end CHARACTERISTIC
/begin CHARACTERISTIC KL_FMENACHESPORT76 "Faktor fuer Rampe Ende Nach-ME bei RS" CURVE 0x1AD5F8 ZF_kl_ui8_S5_S3 1 UMR___1_100_0_S5_S3 0 1
 /begin AXIS_DESCR STD_AXIS iMoeMesaf.timer_zmes UMR_MSEC__10_1_0_S5_S3 4 0 2550 DEPOSIT ABSOLUTE /end AXIS_DESCR
/end CHARACTERISTIC
/begin CHARACTERISTIC KL_FMENACHESPORT82 "Faktor fuer Rampe Ende Nach-ME bei RS" CURVE 0x1AE228 ZF_kl_ui8_S5_S3 1 UMR___1_100_0_S5_S3 0 1
 /begin AXIS_DESCR STD_AXIS iMoeMesaf.timer_zmes UMR_MSEC__10_1_0_S5_S3 4 0 2550 DEPOSIT ABSOLUTE /end AXIS_DESCR
/end CHARACTERISTIC
/begin CHARACTERISTIC KL_FMENACHESPORT84 "Faktor fuer Rampe Ende Nach-ME bei RS" CURVE 0x1AE360 ZF_kl_ui8_S5_S3 1 UMR___1_100_0_S5_S3 0 1
 /begin AXIS_DESCR STD_AXIS iMoeMesaf.timer_zmes UMR_MSEC__10_1_0_S5_S3 4 0 2550 DEPOSIT ABSOLUTE /end AXIS_DESCR
/end CHARACTERISTIC
/begin CHARACTERISTIC KL_FMENACHESPORT86 "Faktor fuer Rampe Ende Nach-ME bei RS" CURVE 0x1AE498 ZF_kl_ui8_S5_S3 1 UMR___1_100_0_S5_S3 0 1
 /begin AXIS_DESCR STD_AXIS iMoeMesaf.timer_zmes UMR_MSEC__10_1_0_S5_S3 4 0 2550 DEPOSIT ABSOLUTE /end AXIS_DESCR
/end CHARACTERISTIC
/begin CHARACTERISTIC KL_FMENACHESPORT87 "Faktor fuer Rampe Ende Nach-ME bei RS" CURVE 0x1AD730 ZF_kl_ui8_S5_S3 1 UMR___1_100_0_S5_S3 0 1
 /begin AXIS_DESCR STD_AXIS iMoeMesaf.timer_zmes UMR_MSEC__10_1_0_S5_S3 4 0 2550 DEPOSIT ABSOLUTE /end AXIS_DESCR
/end CHARACTERISTIC
/begin CHARACTERISTIC KL_FMEPOSNGAB21 "Faktor zur Gewichtung pos. ME" CURVE 0x1AE5E8 ZF_kl_si16_S5_S3 1 UMR___1_100_0_S5_S3 0 1
 /begin AXIS_DESCR STD_AXIS iMoeMesaf.ng_abmesas UMR_U_MINSEC_1_1_0_S5_S3 6 -1000 1000 DEPOSIT ABSOLUTE /end AXIS_DESCR
/end CHARACTERISTIC
/begin CHARACTERISTIC KL_FMEPOSNGAB32 "Faktor zur Gewichtung pos. ME" CURVE 0x1AE654 ZF_kl_si16_S5_S3 1 UMR___1_100_0_S5_S3 0 1
 /begin AXIS_DESCR STD_AXIS iMoeMesaf.ng_abmesas UMR_U_MINSEC_1_1_0_S5_S3 6 -1000 1000 DEPOSIT ABSOLUTE /end AXIS_DESCR
/end CHARACTERISTIC
/begin CHARACTERISTIC KL_FMEPOSNGAB43 "Faktor zur Gewichtung pos. ME" CURVE 0x1AE6C0 ZF_kl_si16_S5_S3 1 UMR___1_100_0_S5_S3 0 1
 /begin AXIS_DESCR STD_AXIS iMoeMesaf.ng_abmesas UMR_U_MINSEC_1_1_0_S5_S3 6 -1000 1000 DEPOSIT ABSOLUTE /end AXIS_DESCR
/end CHARACTERISTIC
/begin CHARACTERISTIC KL_FMEPOSNGAB54 "Faktor zur Gewichtung pos. ME" CURVE 0x1AE72C ZF_kl_si16_S5_S3 1 UMR___1_100_0_S5_S3 0 1
 /begin AXIS_DESCR STD_AXIS iMoeMesaf.ng_abmesas UMR_U_MINSEC_1_1_0_S5_S3 6 -1000 1000 DEPOSIT ABSOLUTE /end AXIS_DESCR
/end CHARACTERISTIC
/begin CHARACTERISTIC KL_FMEPOSNGAB65 "Faktor zur Gewichtung pos. ME" CURVE 0x1AE798 ZF_kl_si16_S5_S3 1 UMR___1_100_0_S5_S3 0 1
 /begin AXIS_DESCR STD_AXIS iMoeMesaf.ng_abmesas UMR_U_MINSEC_1_1_0_S5_S3 6 -1000 1000 DEPOSIT ABSOLUTE /end AXIS_DESCR
/end CHARACTERISTIC
/begin CHARACTERISTIC KL_FMEPOSNGAB76 "Faktor zur Gewichtung pos. ME" CURVE 0x1AE804 ZF_kl_si16_S5_S3 1 UMR___1_100_0_S5_S3 0 1
 /begin AXIS_DESCR STD_AXIS iMoeMesaf.ng_abmesas UMR_U_MINSEC_1_1_0_S5_S3 6 -1000 1000 DEPOSIT ABSOLUTE /end AXIS_DESCR
/end CHARACTERISTIC
/begin CHARACTERISTIC KL_FMEPOSNGAB87 "Faktor zur Gewichtung pos. ME" CURVE 0x1AE870 ZF_kl_si16_S5_S3 1 UMR___1_100_0_S5_S3 0 1
 /begin AXIS_DESCR STD_AXIS iMoeMesaf.ng_abmesas UMR_U_MINSEC_1_1_0_S5_S3 6 -1000 1000 DEPOSIT ABSOLUTE /end AXIS_DESCR
/end CHARACTERISTIC
/begin CHARACTERISTIC KL_FMEPOSNGABSP31 "Faktor zur Gewichtung pos. ME" CURVE 0x1AE8DC ZF_kl_si16_S5_S3 1 UMR___1_100_0_S5_S3 0 1
 /begin AXIS_DESCR STD_AXIS iMoeMesaf.ng_abmesas UMR_U_MINSEC_1_1_0_S5_S3 6 -1000 1000 DEPOSIT ABSOLUTE /end AXIS_DESCR
/end CHARACTERISTIC
/begin CHARACTERISTIC KL_FMEPOSNGABSP42 "Faktor zur Gewichtung pos. ME" CURVE 0x1AE948 ZF_kl_si16_S5_S3 1 UMR___1_100_0_S5_S3 0 1
 /begin AXIS_DESCR STD_AXIS iMoeMesaf.ng_abmesas UMR_U_MINSEC_1_1_0_S5_S3 6 -1000 1000 DEPOSIT ABSOLUTE /end AXIS_DESCR
/end CHARACTERISTIC
/begin CHARACTERISTIC KL_FMEPOSNGABSP51 "Faktor zur Gewichtung pos. ME" CURVE 0x1AE9B4 ZF_kl_si16_S5_S3 1 UMR___1_100_0_S5_S3 0 1
 /begin AXIS_DESCR STD_AXIS iMoeMesaf.ng_abmesas UMR_U_MINSEC_1_1_0_S5_S3 6 -1000 1000 DEPOSIT ABSOLUTE /end AXIS_DESCR
/end CHARACTERISTIC
/begin CHARACTERISTIC KL_FMEPOSNGABSP53 "Faktor zur Gewichtung pos. ME" CURVE 0x1AEA20 ZF_kl_si16_S5_S3 1 UMR___1_100_0_S5_S3 0 1
 /begin AXIS_DESCR STD_AXIS iMoeMesaf.ng_abmesas UMR_U_MINSEC_1_1_0_S5_S3 6 -1000 1000 DEPOSIT ABSOLUTE /end AXIS_DESCR
/end CHARACTERISTIC
/begin CHARACTERISTIC KL_FMEPOSNGABSP63 "Faktor zur Gewichtung pos. ME" CURVE 0x1AEA8C ZF_kl_si16_S5_S3 1 UMR___1_100_0_S5_S3 0 1
 /begin AXIS_DESCR STD_AXIS iMoeMesaf.ng_abmesas UMR_U_MINSEC_1_1_0_S5_S3 6 -1000 1000 DEPOSIT ABSOLUTE /end AXIS_DESCR
/end CHARACTERISTIC
/begin CHARACTERISTIC KL_FMEPOSNGABSP64 "Faktor zur Gewichtung pos. ME" CURVE 0x1AEAF8 ZF_kl_si16_S5_S3 1 UMR___1_100_0_S5_S3 0 1
 /begin AXIS_DESCR STD_AXIS iMoeMesaf.ng_abmesas UMR_U_MINSEC_1_1_0_S5_S3 6 -1000 1000 DEPOSIT ABSOLUTE /end AXIS_DESCR
/end CHARACTERISTIC
/begin CHARACTERISTIC KL_FMEPOSNGABSP71 "Faktor zur Gewichtung pos. ME" CURVE 0x1AEB64 ZF_kl_si16_S5_S3 1 UMR___1_100_0_S5_S3 0 1
 /begin AXIS_DESCR STD_AXIS iMoeMesaf.ng_abmesas UMR_U_MINSEC_1_1_0_S5_S3 6 -1000 1000 DEPOSIT ABSOLUTE /end AXIS_DESCR
/end CHARACTERISTIC
/begin CHARACTERISTIC KL_FMEPOSNGABSP75 "Faktor zur Gewichtung pos. ME" CURVE 0x1AEBD0 ZF_kl_si16_S5_S3 1 UMR___1_100_0_S5_S3 0 1
 /begin AXIS_DESCR STD_AXIS iMoeMesaf.ng_abmesas UMR_U_MINSEC_1_1_0_S5_S3 6 -1000 1000 DEPOSIT ABSOLUTE /end AXIS_DESCR
/end CHARACTERISTIC
/begin CHARACTERISTIC KL_FMEPOSNGABSP82 "Faktor zur Gewichtung pos. ME" CURVE 0x1AEC3C ZF_kl_si16_S5_S3 1 UMR___1_100_0_S5_S3 0 1
 /begin AXIS_DESCR STD_AXIS iMoeMesaf.ng_abmesas UMR_U_MINSEC_1_1_0_S5_S3 6 -1000 1000 DEPOSIT ABSOLUTE /end AXIS_DESCR
/end CHARACTERISTIC
/begin CHARACTERISTIC KL_FMEPOSNGABSP84 "Faktor zur Gewichtung pos. ME" CURVE 0x1AECA8 ZF_kl_si16_S5_S3 1 UMR___1_100_0_S5_S3 0 1
 /begin AXIS_DESCR STD_AXIS iMoeMesaf.ng_abmesas UMR_U_MINSEC_1_1_0_S5_S3 6 -1000 1000 DEPOSIT ABSOLUTE /end AXIS_DESCR
/end CHARACTERISTIC
/begin CHARACTERISTIC KL_FMEPOSNGABSP86 "Faktor zur Gewichtung pos. ME" CURVE 0x1AED14 ZF_kl_si16_S5_S3 1 UMR___1_100_0_S5_S3 0 1
 /begin AXIS_DESCR STD_AXIS iMoeMesaf.ng_abmesas UMR_U_MINSEC_1_1_0_S5_S3 6 -1000 1000 DEPOSIT ABSOLUTE /end AXIS_DESCR
/end CHARACTERISTIC
/begin CHARACTERISTIC KL_MEKPOSCM21 "Erhoehungsfaktor ME f(Mot.temp)" CURVE 0x1AE5DC ZF_kl_ui8_S5_S3 100 UMR_PROZENT__20_51_0_S5_S3 0 100
 /begin AXIS_DESCR STD_AXIS zff_atsys._.iSignale._.obj.sig_c_mot UMR_GRADC__1_1_M48_S5_S3 4 -48 144 DEPOSIT ABSOLUTE /end AXIS_DESCR
/end CHARACTERISTIC
/begin CHARACTERISTIC KL_MEKPOSCM32 "Erhoehungsfaktor ME f(Mot.temp)" CURVE 0x1AE648 ZF_kl_ui8_S5_S3 100 UMR_PROZENT__20_51_0_S5_S3 0 100
 /begin AXIS_DESCR STD_AXIS zff_atsys._.iSignale._.obj.sig_c_mot UMR_GRADC__1_1_M48_S5_S3 4 -48 144 DEPOSIT ABSOLUTE /end AXIS_DESCR
/end CHARACTERISTIC
/begin CHARACTERISTIC KL_MEKPOSCM43 "Erhoehungsfaktor ME f(Mot.temp)" CURVE 0x1AE6B4 ZF_kl_ui8_S5_S3 100 UMR_PROZENT__20_51_0_S5_S3 0 100
 /begin AXIS_DESCR STD_AXIS zff_atsys._.iSignale._.obj.sig_c_mot UMR_GRADC__1_1_M48_S5_S3 4 -48 144 DEPOSIT ABSOLUTE /end AXIS_DESCR
/end CHARACTERISTIC
/begin CHARACTERISTIC KL_MEKPOSCM54 "Erhoehungsfaktor ME f(Mot.temp)" CURVE 0x1AE720 ZF_kl_ui8_S5_S3 100 UMR_PROZENT__20_51_0_S5_S3 0 100
 /begin AXIS_DESCR STD_AXIS zff_atsys._.iSignale._.obj.sig_c_mot UMR_GRADC__1_1_M48_S5_S3 4 -48 144 DEPOSIT ABSOLUTE /end AXIS_DESCR
/end CHARACTERISTIC
/begin CHARACTERISTIC KL_MEKPOSCM65 "Erhoehungsfaktor ME f(Mot.temp)" CURVE 0x1AE78C ZF_kl_ui8_S5_S3 100 UMR_PROZENT__20_51_0_S5_S3 0 100
 /begin AXIS_DESCR STD_AXIS zff_atsys._.iSignale._.obj.sig_c_mot UMR_GRADC__1_1_M48_S5_S3 4 -48 144 DEPOSIT ABSOLUTE /end AXIS_DESCR
/end CHARACTERISTIC
/begin CHARACTERISTIC KL_MEKPOSCM76 "Erhoehungsfaktor ME f(Mot.temp)" CURVE 0x1AE7F8 ZF_kl_ui8_S5_S3 100 UMR_PROZENT__20_51_0_S5_S3 0 100
 /begin AXIS_DESCR STD_AXIS zff_atsys._.iSignale._.obj.sig_c_mot UMR_GRADC__1_1_M48_S5_S3 4 -48 144 DEPOSIT ABSOLUTE /end AXIS_DESCR
/end CHARACTERISTIC
/begin CHARACTERISTIC KL_MEKPOSCM87 "Erhoehungsfaktor ME f(Mot.temp)" CURVE 0x1AE864 ZF_kl_ui8_S5_S3 100 UMR_PROZENT__20_51_0_S5_S3 0 100
 /begin AXIS_DESCR STD_AXIS zff_atsys._.iSignale._.obj.sig_c_mot UMR_GRADC__1_1_M48_S5_S3 4 -48 144 DEPOSIT ABSOLUTE /end AXIS_DESCR
/end CHARACTERISTIC
/begin CHARACTERISTIC KL_MEKPOSCMSP31 "Erhoehungsfaktor ME f(Mot.temp)" CURVE 0x1AE8D0 ZF_kl_ui8_S5_S3 100 UMR_PROZENT__20_51_0_S5_S3 0 100
 /begin AXIS_DESCR STD_AXIS zff_atsys._.iSignale._.obj.sig_c_mot UMR_GRADC__1_1_M48_S5_S3 4 -48 144 DEPOSIT ABSOLUTE /end AXIS_DESCR
/end CHARACTERISTIC
/begin CHARACTERISTIC KL_MEKPOSCMSP42 "Erhoehungsfaktor ME f(Mot.temp)" CURVE 0x1AE93C ZF_kl_ui8_S5_S3 100 UMR_PROZENT__20_51_0_S5_S3 0 100
 /begin AXIS_DESCR STD_AXIS zff_atsys._.iSignale._.obj.sig_c_mot UMR_GRADC__1_1_M48_S5_S3 4 -48 144 DEPOSIT ABSOLUTE /end AXIS_DESCR
/end CHARACTERISTIC
/begin CHARACTERISTIC KL_MEKPOSCMSP51 "Erhoehungsfaktor ME f(Mot.temp)" CURVE 0x1AE9A8 ZF_kl_ui8_S5_S3 100 UMR_PROZENT__20_51_0_S5_S3 0 100
 /begin AXIS_DESCR STD_AXIS zff_atsys._.iSignale._.obj.sig_c_mot UMR_GRADC__1_1_M48_S5_S3 4 -48 144 DEPOSIT ABSOLUTE /end AXIS_DESCR
/end CHARACTERISTIC
/begin CHARACTERISTIC KL_MEKPOSCMSP53 "Erhoehungsfaktor ME f(Mot.temp)" CURVE 0x1AEA14 ZF_kl_ui8_S5_S3 100 UMR_PROZENT__20_51_0_S5_S3 0 100
 /begin AXIS_DESCR STD_AXIS zff_atsys._.iSignale._.obj.sig_c_mot UMR_GRADC__1_1_M48_S5_S3 4 -48 144 DEPOSIT ABSOLUTE /end AXIS_DESCR
/end CHARACTERISTIC
/begin CHARACTERISTIC KL_MEKPOSCMSP63 "Erhoehungsfaktor ME f(Mot.temp)" CURVE 0x1AEA80 ZF_kl_ui8_S5_S3 100 UMR_PROZENT__20_51_0_S5_S3 0 100
 /begin AXIS_DESCR STD_AXIS zff_atsys._.iSignale._.obj.sig_c_mot UMR_GRADC__1_1_M48_S5_S3 4 -48 144 DEPOSIT ABSOLUTE /end AXIS_DESCR
/end CHARACTERISTIC
/begin CHARACTERISTIC KL_MEKPOSCMSP64 "Erhoehungsfaktor ME f(Mot.temp)" CURVE 0x1AEAEC ZF_kl_ui8_S5_S3 100 UMR_PROZENT__20_51_0_S5_S3 0 100
 /begin AXIS_DESCR STD_AXIS zff_atsys._.iSignale._.obj.sig_c_mot UMR_GRADC__1_1_M48_S5_S3 4 -48 144 DEPOSIT ABSOLUTE /end AXIS_DESCR
/end CHARACTERISTIC
/begin CHARACTERISTIC KL_MEKPOSCMSP71 "Erhoehungsfaktor ME f(Mot.temp)" CURVE 0x1AEB58 ZF_kl_ui8_S5_S3 100 UMR_PROZENT__20_51_0_S5_S3 0 100
 /begin AXIS_DESCR STD_AXIS zff_atsys._.iSignale._.obj.sig_c_mot UMR_GRADC__1_1_M48_S5_S3 4 -48 144 DEPOSIT ABSOLUTE /end AXIS_DESCR
/end CHARACTERISTIC
/begin CHARACTERISTIC KL_MEKPOSCMSP75 "Erhoehungsfaktor ME f(Mot.temp)" CURVE 0x1AEBC4 ZF_kl_ui8_S5_S3 100 UMR_PROZENT__20_51_0_S5_S3 0 100
 /begin AXIS_DESCR STD_AXIS zff_atsys._.iSignale._.obj.sig_c_mot UMR_GRADC__1_1_M48_S5_S3 4 -48 144 DEPOSIT ABSOLUTE /end AXIS_DESCR
/end CHARACTERISTIC
/begin CHARACTERISTIC KL_MEKPOSCMSP82 "Erhoehungsfaktor ME f(Mot.temp)" CURVE 0x1AEC30 ZF_kl_ui8_S5_S3 100 UMR_PROZENT__20_51_0_S5_S3 0 100
 /begin AXIS_DESCR STD_AXIS zff_atsys._.iSignale._.obj.sig_c_mot UMR_GRADC__1_1_M48_S5_S3 4 -48 144 DEPOSIT ABSOLUTE /end AXIS_DESCR
/end CHARACTERISTIC
/begin CHARACTERISTIC KL_MEKPOSCMSP84 "Erhoehungsfaktor ME f(Mot.temp)" CURVE 0x1AEC9C ZF_kl_ui8_S5_S3 100 UMR_PROZENT__20_51_0_S5_S3 0 100
 /begin AXIS_DESCR STD_AXIS zff_atsys._.iSignale._.obj.sig_c_mot UMR_GRADC__1_1_M48_S5_S3 4 -48 144 DEPOSIT ABSOLUTE /end AXIS_DESCR
/end CHARACTERISTIC
/begin CHARACTERISTIC KL_MEKPOSCMSP86 "Erhoehungsfaktor ME f(Mot.temp)" CURVE 0x1AED08 ZF_kl_ui8_S5_S3 100 UMR_PROZENT__20_51_0_S5_S3 0 100
 /begin AXIS_DESCR STD_AXIS zff_atsys._.iSignale._.obj.sig_c_mot UMR_GRADC__1_1_M48_S5_S3 4 -48 144 DEPOSIT ABSOLUTE /end AXIS_DESCR
/end CHARACTERISTIC
/begin CHARACTERISTIC KL_MEKREDCM21 "Reduzierfaktor ME f(Mot.temp)" CURVE 0x1AE5D0 ZF_kl_ui8_S5_S3 100 UMR_PROZENT__20_51_0_S5_S3 0 100
 /begin AXIS_DESCR STD_AXIS zff_atsys._.iSignale._.obj.sig_c_mot UMR_GRADC__1_1_M48_S5_S3 4 -48 144 DEPOSIT ABSOLUTE /end AXIS_DESCR
/end CHARACTERISTIC
/begin CHARACTERISTIC KL_MEKREDCM32 "Reduzierfaktor ME f(Mot.temp)" CURVE 0x1AE63C ZF_kl_ui8_S5_S3 100 UMR_PROZENT__20_51_0_S5_S3 0 100
 /begin AXIS_DESCR STD_AXIS zff_atsys._.iSignale._.obj.sig_c_mot UMR_GRADC__1_1_M48_S5_S3 4 -48 144 DEPOSIT ABSOLUTE /end AXIS_DESCR
/end CHARACTERISTIC
/begin CHARACTERISTIC KL_MEKREDCM43 "Reduzierfaktor ME f(Mot.temp)" CURVE 0x1AE6A8 ZF_kl_ui8_S5_S3 100 UMR_PROZENT__20_51_0_S5_S3 0 100
 /begin AXIS_DESCR STD_AXIS zff_atsys._.iSignale._.obj.sig_c_mot UMR_GRADC__1_1_M48_S5_S3 4 -48 144 DEPOSIT ABSOLUTE /end AXIS_DESCR
/end CHARACTERISTIC
/begin CHARACTERISTIC KL_MEKREDCM54 "Reduzierfaktor ME f(Mot.temp)" CURVE 0x1AE714 ZF_kl_ui8_S5_S3 100 UMR_PROZENT__20_51_0_S5_S3 0 100
 /begin AXIS_DESCR STD_AXIS zff_atsys._.iSignale._.obj.sig_c_mot UMR_GRADC__1_1_M48_S5_S3 4 -48 144 DEPOSIT ABSOLUTE /end AXIS_DESCR
/end CHARACTERISTIC
/begin CHARACTERISTIC KL_MEKREDCM65 "Reduzierfaktor ME f(Mot.temp)" CURVE 0x1AE780 ZF_kl_ui8_S5_S3 100 UMR_PROZENT__20_51_0_S5_S3 0 100
 /begin AXIS_DESCR STD_AXIS zff_atsys._.iSignale._.obj.sig_c_mot UMR_GRADC__1_1_M48_S5_S3 4 -48 144 DEPOSIT ABSOLUTE /end AXIS_DESCR
/end CHARACTERISTIC
/begin CHARACTERISTIC KL_MEKREDCM76 "Reduzierfaktor ME f(Mot.temp)" CURVE 0x1AE7EC ZF_kl_ui8_S5_S3 100 UMR_PROZENT__20_51_0_S5_S3 0 100
 /begin AXIS_DESCR STD_AXIS zff_atsys._.iSignale._.obj.sig_c_mot UMR_GRADC__1_1_M48_S5_S3 4 -48 144 DEPOSIT ABSOLUTE /end AXIS_DESCR
/end CHARACTERISTIC
/begin CHARACTERISTIC KL_MEKREDCM87 "Reduzierfaktor ME f(Mot.temp)" CURVE 0x1AE858 ZF_kl_ui8_S5_S3 100 UMR_PROZENT__20_51_0_S5_S3 0 100
 /begin AXIS_DESCR STD_AXIS zff_atsys._.iSignale._.obj.sig_c_mot UMR_GRADC__1_1_M48_S5_S3 4 -48 144 DEPOSIT ABSOLUTE /end AXIS_DESCR
/end CHARACTERISTIC
/begin CHARACTERISTIC KL_MEKREDCMSP31 "Reduzierfaktor ME f(Mot.temp)" CURVE 0x1AE8C4 ZF_kl_ui8_S5_S3 100 UMR_PROZENT__20_51_0_S5_S3 0 100
 /begin AXIS_DESCR STD_AXIS zff_atsys._.iSignale._.obj.sig_c_mot UMR_GRADC__1_1_M48_S5_S3 4 -48 144 DEPOSIT ABSOLUTE /end AXIS_DESCR
/end CHARACTERISTIC
/begin CHARACTERISTIC KL_MEKREDCMSP42 "Reduzierfaktor ME f(Mot.temp)" CURVE 0x1AE930 ZF_kl_ui8_S5_S3 100 UMR_PROZENT__20_51_0_S5_S3 0 100
 /begin AXIS_DESCR STD_AXIS zff_atsys._.iSignale._.obj.sig_c_mot UMR_GRADC__1_1_M48_S5_S3 4 -48 144 DEPOSIT ABSOLUTE /end AXIS_DESCR
/end CHARACTERISTIC
/begin CHARACTERISTIC KL_MEKREDCMSP51 "Reduzierfaktor ME f(Mot.temp)" CURVE 0x1AE99C ZF_kl_ui8_S5_S3 100 UMR_PROZENT__20_51_0_S5_S3 0 100
 /begin AXIS_DESCR STD_AXIS zff_atsys._.iSignale._.obj.sig_c_mot UMR_GRADC__1_1_M48_S5_S3 4 -48 144 DEPOSIT ABSOLUTE /end AXIS_DESCR
/end CHARACTERISTIC
/begin CHARACTERISTIC KL_MEKREDCMSP53 "Reduzierfaktor ME f(Mot.temp)" CURVE 0x1AEA08 ZF_kl_ui8_S5_S3 100 UMR_PROZENT__20_51_0_S5_S3 0 100
 /begin AXIS_DESCR STD_AXIS zff_atsys._.iSignale._.obj.sig_c_mot UMR_GRADC__1_1_M48_S5_S3 4 -48 144 DEPOSIT ABSOLUTE /end AXIS_DESCR
/end CHARACTERISTIC
/begin CHARACTERISTIC KL_MEKREDCMSP63 "Reduzierfaktor ME f(Mot.temp)" CURVE 0x1AEA74 ZF_kl_ui8_S5_S3 100 UMR_PROZENT__20_51_0_S5_S3 0 100
 /begin AXIS_DESCR STD_AXIS zff_atsys._.iSignale._.obj.sig_c_mot UMR_GRADC__1_1_M48_S5_S3 4 -48 144 DEPOSIT ABSOLUTE /end AXIS_DESCR
/end CHARACTERISTIC
/begin CHARACTERISTIC KL_MEKREDCMSP64 "Reduzierfaktor ME f(Mot.temp)" CURVE 0x1AEAE0 ZF_kl_ui8_S5_S3 100 UMR_PROZENT__20_51_0_S5_S3 0 100
 /begin AXIS_DESCR STD_AXIS zff_atsys._.iSignale._.obj.sig_c_mot UMR_GRADC__1_1_M48_S5_S3 4 -48 144 DEPOSIT ABSOLUTE /end AXIS_DESCR
/end CHARACTERISTIC
/begin CHARACTERISTIC KL_MEKREDCMSP71 "Reduzierfaktor ME f(Mot.temp)" CURVE 0x1AEB4C ZF_kl_ui8_S5_S3 100 UMR_PROZENT__20_51_0_S5_S3 0 100
 /begin AXIS_DESCR STD_AXIS zff_atsys._.iSignale._.obj.sig_c_mot UMR_GRADC__1_1_M48_S5_S3 4 -48 144 DEPOSIT ABSOLUTE /end AXIS_DESCR
/end CHARACTERISTIC
/begin CHARACTERISTIC KL_MEKREDCMSP75 "Reduzierfaktor ME f(Mot.temp)" CURVE 0x1AEBB8 ZF_kl_ui8_S5_S3 100 UMR_PROZENT__20_51_0_S5_S3 0 100
 /begin AXIS_DESCR STD_AXIS zff_atsys._.iSignale._.obj.sig_c_mot UMR_GRADC__1_1_M48_S5_S3 4 -48 144 DEPOSIT ABSOLUTE /end AXIS_DESCR
/end CHARACTERISTIC
/begin CHARACTERISTIC KL_MEKREDCMSP82 "Reduzierfaktor ME f(Mot.temp)" CURVE 0x1AEC24 ZF_kl_ui8_S5_S3 100 UMR_PROZENT__20_51_0_S5_S3 0 100
 /begin AXIS_DESCR STD_AXIS zff_atsys._.iSignale._.obj.sig_c_mot UMR_GRADC__1_1_M48_S5_S3 4 -48 144 DEPOSIT ABSOLUTE /end AXIS_DESCR
/end CHARACTERISTIC
/begin CHARACTERISTIC KL_MEKREDCMSP84 "Reduzierfaktor ME f(Mot.temp)" CURVE 0x1AEC90 ZF_kl_ui8_S5_S3 100 UMR_PROZENT__20_51_0_S5_S3 0 100
 /begin AXIS_DESCR STD_AXIS zff_atsys._.iSignale._.obj.sig_c_mot UMR_GRADC__1_1_M48_S5_S3 4 -48 144 DEPOSIT ABSOLUTE /end AXIS_DESCR
/end CHARACTERISTIC
/begin CHARACTERISTIC KL_MEKREDCMSP86 "Reduzierfaktor ME f(Mot.temp)" CURVE 0x1AECFC ZF_kl_ui8_S5_S3 100 UMR_PROZENT__20_51_0_S5_S3 0 100
 /begin AXIS_DESCR STD_AXIS zff_atsys._.iSignale._.obj.sig_c_mot UMR_GRADC__1_1_M48_S5_S3 4 -48 144 DEPOSIT ABSOLUTE /end AXIS_DESCR
/end CHARACTERISTIC
/begin CHARACTERISTIC KL_NDSGANGWECHSEL "Drehzahlschwelle zur Ausgabe Gangwechsel Flag" CURVE 0x1AEE34 ZF_kl_si16_S5_S3 8000 UMR_U_MIN_1_1_0_S5_S3 0 8000
 /begin AXIS_DESCR STD_AXIS zff_atsys._.iSignale._.obj.sig_c_getr UMR_GRADC__1_1_M40_S5_S3 4 -40 150 DEPOSIT ABSOLUTE /end AXIS_DESCR
/end CHARACTERISTIC
/begin CHARACTERISTIC KL_PO1FCG_A "Kennlinie Fuelldruckoffset 1. Befuellung" CURVE 0x1B00E8 ZF_kl_si16_S5_S3 12.75 UMR_BAR__1_1000_0_S5_S3 -6.4 6.35
 /begin AXIS_DESCR STD_AXIS zff_atsys._.iSignale._.obj.sig_c_getr UMR_GRADC__1_1_M40_S5_S3 3 -40 150 DEPOSIT ABSOLUTE /end AXIS_DESCR
/end CHARACTERISTIC
/begin CHARACTERISTIC KL_PO1FCG_B "Kennlinie Fuelldruckoffset 1. Befuellung" CURVE 0x1B01B4 ZF_kl_si16_S5_S3 12.75 UMR_BAR__1_1000_0_S5_S3 -6.4 6.35
 /begin AXIS_DESCR STD_AXIS zff_atsys._.iSignale._.obj.sig_c_getr UMR_GRADC__1_1_M40_S5_S3 3 -40 150 DEPOSIT ABSOLUTE /end AXIS_DESCR
/end CHARACTERISTIC
/begin CHARACTERISTIC KL_PO1FCG_C "Kennlinie Fuelldruckoffset 1. Befuellung" CURVE 0x1B0280 ZF_kl_si16_S5_S3 12.75 UMR_BAR__1_1000_0_S5_S3 -6.4 6.35
 /begin AXIS_DESCR STD_AXIS zff_atsys._.iSignale._.obj.sig_c_getr UMR_GRADC__1_1_M40_S5_S3 3 -40 150 DEPOSIT ABSOLUTE /end AXIS_DESCR
/end CHARACTERISTIC
/begin CHARACTERISTIC KL_PO1FCG_D "Kennlinie Fuelldruckoffset 1. Befuellung" CURVE 0x1B034C ZF_kl_si16_S5_S3 12.75 UMR_BAR__1_1000_0_S5_S3 -6.4 6.35
 /begin AXIS_DESCR STD_AXIS zff_atsys._.iSignale._.obj.sig_c_getr UMR_GRADC__1_1_M40_S5_S3 3 -40 150 DEPOSIT ABSOLUTE /end AXIS_DESCR
/end CHARACTERISTIC
/begin CHARACTERISTIC KL_PO1FCG_E "Kennlinie Fuelldruckoffset 1. Befuellung" CURVE 0x1B0418 ZF_kl_si16_S5_S3 12.75 UMR_BAR__1_1000_0_S5_S3 -6.4 6.35
 /begin AXIS_DESCR STD_AXIS zff_atsys._.iSignale._.obj.sig_c_getr UMR_GRADC__1_1_M40_S5_S3 3 -40 150 DEPOSIT ABSOLUTE /end AXIS_DESCR
/end CHARACTERISTIC
/begin CHARACTERISTIC KL_PORASASABBRUCHGA "Gesteuerte Druckrampe bei Schaltungsabbruch" CURVE 0x1AEE14 ZF_kl_ui16_S5_S3 12.5 UMR_BAR__1_1000_0_S5_S3 0 12.5
 /begin AXIS_DESCR STD_AXIS iSasAnGeaNichtKraftschl1.timer_zgea UMR_MSEC__10_1_0_S5_S3 3 0 1000 DEPOSIT ABSOLUTE /end AXIS_DESCR
/end CHARACTERISTIC
/begin CHARACTERISTIC KL_TFNGDSYNZIELGANG "Filterzeit fuer Berechnung Differenzdrehzahlgradient ng_dsynzielgang" CURVE 0x1AEE48 ZF_kl_ui16_S5_S3 999 UMR_MSEC__1_1_0_S5_S3 1 1000
 /begin AXIS_DESCR STD_AXIS zff_atsys._.iSignale._.obj.sig_n_ab UMR_U_MIN_1_1_0_S5_S3 3 0 8160 DEPOSIT ABSOLUTE /end AXIS_DESCR
/end CHARACTERISTIC
/begin CHARACTERISTIC KL_TMAXCG12 "Maximaldauer Schaltung" CURVE 0x1AFFEC ZF_kl_ui16_S5_S3 10000 UMR_MSEC__10_1_0_S5_S3 0 10000
 /begin AXIS_DESCR STD_AXIS NO_INPUT_QUANTITY UMR_GRADC__1_1_M40_S5_S3 2 -40 150 DEPOSIT ABSOLUTE /end AXIS_DESCR
/end CHARACTERISTIC
/begin CHARACTERISTIC KL_TMAXCG23 "Maximaldauer Schaltung" CURVE 0x1AFFF8 ZF_kl_ui16_S5_S3 10000 UMR_MSEC__10_1_0_S5_S3 0 10000
 /begin AXIS_DESCR STD_AXIS NO_INPUT_QUANTITY UMR_GRADC__1_1_M40_S5_S3 2 -40 150 DEPOSIT ABSOLUTE /end AXIS_DESCR
/end CHARACTERISTIC
/begin CHARACTERISTIC KL_TMAXCG34 "Maximaldauer Schaltung" CURVE 0x1B0004 ZF_kl_ui16_S5_S3 10000 UMR_MSEC__10_1_0_S5_S3 0 10000
 /begin AXIS_DESCR STD_AXIS NO_INPUT_QUANTITY UMR_GRADC__1_1_M40_S5_S3 2 -40 150 DEPOSIT ABSOLUTE /end AXIS_DESCR
/end CHARACTERISTIC
/begin CHARACTERISTIC KL_TMAXCG45 "Maximaldauer Schaltung" CURVE 0x1B0010 ZF_kl_ui16_S5_S3 10000 UMR_MSEC__10_1_0_S5_S3 0 10000
 /begin AXIS_DESCR STD_AXIS NO_INPUT_QUANTITY UMR_GRADC__1_1_M40_S5_S3 2 -40 150 DEPOSIT ABSOLUTE /end AXIS_DESCR
/end CHARACTERISTIC
/begin CHARACTERISTIC KL_TMAXCG56 "Maximaldauer Schaltung" CURVE 0x1B001C ZF_kl_ui16_S5_S3 10000 UMR_MSEC__10_1_0_S5_S3 0 10000
 /begin AXIS_DESCR STD_AXIS NO_INPUT_QUANTITY UMR_GRADC__1_1_M40_S5_S3 2 -40 150 DEPOSIT ABSOLUTE /end AXIS_DESCR
/end CHARACTERISTIC
/begin CHARACTERISTIC KL_TMAXCG67 "Maximaldauer Schaltung" CURVE 0x1B0028 ZF_kl_ui16_S5_S3 10000 UMR_MSEC__10_1_0_S5_S3 0 10000
 /begin AXIS_DESCR STD_AXIS NO_INPUT_QUANTITY UMR_GRADC__1_1_M40_S5_S3 2 -40 150 DEPOSIT ABSOLUTE /end AXIS_DESCR
/end CHARACTERISTIC
/begin CHARACTERISTIC KL_TMAXCG78 "Maximaldauer Schaltung" CURVE 0x1B0034 ZF_kl_ui16_S5_S3 10000 UMR_MSEC__10_1_0_S5_S3 0 10000
 /begin AXIS_DESCR STD_AXIS NO_INPUT_QUANTITY UMR_GRADC__1_1_M40_S5_S3 2 -40 150 DEPOSIT ABSOLUTE /end AXIS_DESCR
/end CHARACTERISTIC
/begin CHARACTERISTIC KL_TMAXCGGA_1 "Maximaldauer Gangauslegen" CURVE 0x1AFF38 ZF_kl_ui16_S5_S3 10000 UMR_MSEC__10_1_0_S5_S3 0 10000
 /begin AXIS_DESCR STD_AXIS zff_atsys._.iSignale._.obj.sig_c_getr UMR_GRADC__1_1_M40_S5_S3 2 -40 150 DEPOSIT ABSOLUTE /end AXIS_DESCR
/end CHARACTERISTIC
/begin CHARACTERISTIC KL_TMAXCGGA_2 "Maximaldauer Gangauslegen" CURVE 0x1AFF50 ZF_kl_ui16_S5_S3 10000 UMR_MSEC__10_1_0_S5_S3 0 10000
 /begin AXIS_DESCR STD_AXIS zff_atsys._.iSignale._.obj.sig_c_getr UMR_GRADC__1_1_M40_S5_S3 2 -40 150 DEPOSIT ABSOLUTE /end AXIS_DESCR
/end CHARACTERISTIC
/begin CHARACTERISTIC KL_TMAXCGGA_3 "Maximaldauer Gangauslegen" CURVE 0x1AFF68 ZF_kl_ui16_S5_S3 10000 UMR_MSEC__10_1_0_S5_S3 0 10000
 /begin AXIS_DESCR STD_AXIS zff_atsys._.iSignale._.obj.sig_c_getr UMR_GRADC__1_1_M40_S5_S3 2 -40 150 DEPOSIT ABSOLUTE /end AXIS_DESCR
/end CHARACTERISTIC
/begin CHARACTERISTIC KL_TMAXCGGA_4 "Maximaldauer Gangauslegen" CURVE 0x1AFF80 ZF_kl_ui16_S5_S3 10000 UMR_MSEC__10_1_0_S5_S3 0 10000
 /begin AXIS_DESCR STD_AXIS zff_atsys._.iSignale._.obj.sig_c_getr UMR_GRADC__1_1_M40_S5_S3 2 -40 150 DEPOSIT ABSOLUTE /end AXIS_DESCR
/end CHARACTERISTIC
/begin CHARACTERISTIC KL_TMAXCGGA_5 "Maximaldauer Gangauslegen" CURVE 0x1AFF98 ZF_kl_ui16_S5_S3 10000 UMR_MSEC__10_1_0_S5_S3 0 10000
 /begin AXIS_DESCR STD_AXIS zff_atsys._.iSignale._.obj.sig_c_getr UMR_GRADC__1_1_M40_S5_S3 2 -40 150 DEPOSIT ABSOLUTE /end AXIS_DESCR
/end CHARACTERISTIC
/begin CHARACTERISTIC KL_TMAXCGGA_6 "Maximaldauer Gangauslegen" CURVE 0x1AFFB0 ZF_kl_ui16_S5_S3 10000 UMR_MSEC__10_1_0_S5_S3 0 10000
 /begin AXIS_DESCR STD_AXIS zff_atsys._.iSignale._.obj.sig_c_getr UMR_GRADC__1_1_M40_S5_S3 2 -40 150 DEPOSIT ABSOLUTE /end AXIS_DESCR
/end CHARACTERISTIC
/begin CHARACTERISTIC KL_TMAXCGGA_7 "Maximaldauer Gangauslegen" CURVE 0x1AFFC8 ZF_kl_ui16_S5_S3 10000 UMR_MSEC__10_1_0_S5_S3 0 10000
 /begin AXIS_DESCR STD_AXIS zff_atsys._.iSignale._.obj.sig_c_getr UMR_GRADC__1_1_M40_S5_S3 2 -40 150 DEPOSIT ABSOLUTE /end AXIS_DESCR
/end CHARACTERISTIC
/begin CHARACTERISTIC KL_TMAXCGGA_8 "Maximaldauer Gangauslegen" CURVE 0x1AFFE0 ZF_kl_ui16_S5_S3 10000 UMR_MSEC__10_1_0_S5_S3 0 10000
 /begin AXIS_DESCR STD_AXIS zff_atsys._.iSignale._.obj.sig_c_getr UMR_GRADC__1_1_M40_S5_S3 2 -40 150 DEPOSIT ABSOLUTE /end AXIS_DESCR
/end CHARACTERISTIC
/begin CHARACTERISTIC KL_TMAXCGGA_R "Maximaldauer Gangauslegen" CURVE 0x1AFF20 ZF_kl_ui16_S5_S3 10000 UMR_MSEC__10_1_0_S5_S3 0 10000
 /begin AXIS_DESCR STD_AXIS zff_atsys._.iSignale._.obj.sig_c_getr UMR_GRADC__1_1_M40_S5_S3 2 -40 150 DEPOSIT ABSOLUTE /end AXIS_DESCR
/end CHARACTERISTIC
/begin CHARACTERISTIC KL_TMAXCG_1 "Maximaldauer Gangeinlegen" CURVE 0x1AFF2C ZF_kl_ui16_S5_S3 10000 UMR_MSEC__10_1_0_S5_S3 0 10000
 /begin AXIS_DESCR STD_AXIS zff_atsys._.iSignale._.obj.sig_c_getr UMR_GRADC__1_1_M40_S5_S3 2 -40 150 DEPOSIT ABSOLUTE /end AXIS_DESCR
/end CHARACTERISTIC
/begin CHARACTERISTIC KL_TMAXCG_2 "Maximaldauer Gangeinlegen" CURVE 0x1AFF44 ZF_kl_ui16_S5_S3 10000 UMR_MSEC__10_1_0_S5_S3 0 10000
 /begin AXIS_DESCR STD_AXIS zff_atsys._.iSignale._.obj.sig_c_getr UMR_GRADC__1_1_M40_S5_S3 2 -40 150 DEPOSIT ABSOLUTE /end AXIS_DESCR
/end CHARACTERISTIC
/begin CHARACTERISTIC KL_TMAXCG_3 "Maximaldauer Gangeinlegen" CURVE 0x1AFF5C ZF_kl_ui16_S5_S3 10000 UMR_MSEC__10_1_0_S5_S3 0 10000
 /begin AXIS_DESCR STD_AXIS zff_atsys._.iSignale._.obj.sig_c_getr UMR_GRADC__1_1_M40_S5_S3 2 -40 150 DEPOSIT ABSOLUTE /end AXIS_DESCR
/end CHARACTERISTIC
/begin CHARACTERISTIC KL_TMAXCG_4 "Maximaldauer Gangeinlegen" CURVE 0x1AFF74 ZF_kl_ui16_S5_S3 10000 UMR_MSEC__10_1_0_S5_S3 0 10000
 /begin AXIS_DESCR STD_AXIS zff_atsys._.iSignale._.obj.sig_c_getr UMR_GRADC__1_1_M40_S5_S3 2 -40 150 DEPOSIT ABSOLUTE /end AXIS_DESCR
/end CHARACTERISTIC
/begin CHARACTERISTIC KL_TMAXCG_5 "Maximaldauer Gangeinlegen" CURVE 0x1AFF8C ZF_kl_ui16_S5_S3 10000 UMR_MSEC__10_1_0_S5_S3 0 10000
 /begin AXIS_DESCR STD_AXIS zff_atsys._.iSignale._.obj.sig_c_getr UMR_GRADC__1_1_M40_S5_S3 2 -40 150 DEPOSIT ABSOLUTE /end AXIS_DESCR
/end CHARACTERISTIC
/begin CHARACTERISTIC KL_TMAXCG_6 "Maximaldauer Gangeinlegen" CURVE 0x1AFFA4 ZF_kl_ui16_S5_S3 10000 UMR_MSEC__10_1_0_S5_S3 0 10000
 /begin AXIS_DESCR STD_AXIS zff_atsys._.iSignale._.obj.sig_c_getr UMR_GRADC__1_1_M40_S5_S3 2 -40 150 DEPOSIT ABSOLUTE /end AXIS_DESCR
/end CHARACTERISTIC
/begin CHARACTERISTIC KL_TMAXCG_7 "Maximaldauer Gangeinlegen" CURVE 0x1AFFBC ZF_kl_ui16_S5_S3 10000 UMR_MSEC__10_1_0_S5_S3 0 10000
 /begin AXIS_DESCR STD_AXIS zff_atsys._.iSignale._.obj.sig_c_getr UMR_GRADC__1_1_M40_S5_S3 2 -40 150 DEPOSIT ABSOLUTE /end AXIS_DESCR
/end CHARACTERISTIC
/begin CHARACTERISTIC KL_TMAXCG_8 "Maximaldauer Gangeinlegen" CURVE 0x1AFFD4 ZF_kl_ui16_S5_S3 10000 UMR_MSEC__10_1_0_S5_S3 0 10000
 /begin AXIS_DESCR STD_AXIS zff_atsys._.iSignale._.obj.sig_c_getr UMR_GRADC__1_1_M40_S5_S3 2 -40 150 DEPOSIT ABSOLUTE /end AXIS_DESCR
/end CHARACTERISTIC
/begin CHARACTERISTIC KL_TMAXCG_R "Maximaldauer Gangeinlegen" CURVE 0x1AFF14 ZF_kl_ui16_S5_S3 10000 UMR_MSEC__10_1_0_S5_S3 0 10000
 /begin AXIS_DESCR STD_AXIS zff_atsys._.iSignale._.obj.sig_c_getr UMR_GRADC__1_1_M40_S5_S3 2 -40 150 DEPOSIT ABSOLUTE /end AXIS_DESCR
/end CHARACTERISTIC
/begin CHARACTERISTIC KL_TSYNMENACHASPORT65 "Zeit vor Erkennen synchron fuer Ende Haupt-ME und Start Nach-ME" CURVE 0x1AD4CC ZF_kl_ui8_S5_S3 1280 UMR_MSEC__10_1_M128_S5_S3 -1280 0
 /begin AXIS_DESCR STD_AXIS zff_atsys._.iSignale._.obj.sig_n_mot8 UMR_U_MIN_32_1_0_S5_S3 2 0 8160 DEPOSIT ABSOLUTE /end AXIS_DESCR
/end CHARACTERISTIC
/begin CHARACTERISTIC KL_TSYNMENACHASPORT71 "Zeit vor Erkennen synchron fuer Ende Haupt-ME und Start Nach-ME" CURVE 0x1ADFC4 ZF_kl_ui8_S5_S3 1280 UMR_MSEC__10_1_M128_S5_S3 -1280 0
 /begin AXIS_DESCR STD_AXIS zff_atsys._.iSignale._.obj.sig_n_mot8 UMR_U_MIN_32_1_0_S5_S3 2 0 8160 DEPOSIT ABSOLUTE /end AXIS_DESCR
/end CHARACTERISTIC
/begin CHARACTERISTIC KL_TSYNMENACHASPORT75 "Zeit vor Erkennen synchron fuer Ende Haupt-ME und Start Nach-ME" CURVE 0x1AE0FC ZF_kl_ui8_S5_S3 1280 UMR_MSEC__10_1_M128_S5_S3 -1280 0
 /begin AXIS_DESCR STD_AXIS zff_atsys._.iSignale._.obj.sig_n_mot8 UMR_U_MIN_32_1_0_S5_S3 2 0 8160 DEPOSIT ABSOLUTE /end AXIS_DESCR
/end CHARACTERISTIC
/begin CHARACTERISTIC KL_TSYNMENACHASPORT76 "Zeit vor Erkennen synchron fuer Ende Haupt-ME und Start Nach-ME" CURVE 0x1AD604 ZF_kl_ui8_S5_S3 1280 UMR_MSEC__10_1_M128_S5_S3 -1280 0
 /begin AXIS_DESCR STD_AXIS zff_atsys._.iSignale._.obj.sig_n_mot8 UMR_U_MIN_32_1_0_S5_S3 2 0 8160 DEPOSIT ABSOLUTE /end AXIS_DESCR
/end CHARACTERISTIC
/begin CHARACTERISTIC KL_TSYNMENACHASPORT82 "Zeit vor Erkennen synchron fuer Ende Haupt-ME und Start Nach-ME" CURVE 0x1AE234 ZF_kl_ui8_S5_S3 1280 UMR_MSEC__10_1_M128_S5_S3 -1280 0
 /begin AXIS_DESCR STD_AXIS zff_atsys._.iSignale._.obj.sig_n_mot8 UMR_U_MIN_32_1_0_S5_S3 2 0 8160 DEPOSIT ABSOLUTE /end AXIS_DESCR
/end CHARACTERISTIC
/begin CHARACTERISTIC KL_TSYNMENACHASPORT84 "Zeit vor Erkennen synchron fuer Ende Haupt-ME und Start Nach-ME" CURVE 0x1AE36C ZF_kl_ui8_S5_S3 1280 UMR_MSEC__10_1_M128_S5_S3 -1280 0
 /begin AXIS_DESCR STD_AXIS zff_atsys._.iSignale._.obj.sig_n_mot8 UMR_U_MIN_32_1_0_S5_S3 2 0 8160 DEPOSIT ABSOLUTE /end AXIS_DESCR
/end CHARACTERISTIC
/begin CHARACTERISTIC KL_TSYNMENACHASPORT86 "Zeit vor Erkennen synchron fuer Ende Haupt-ME und Start Nach-ME" CURVE 0x1AE4A4 ZF_kl_ui8_S5_S3 1280 UMR_MSEC__10_1_M128_S5_S3 -1280 0
 /begin AXIS_DESCR STD_AXIS zff_atsys._.iSignale._.obj.sig_n_mot8 UMR_U_MIN_32_1_0_S5_S3 2 0 8160 DEPOSIT ABSOLUTE /end AXIS_DESCR
/end CHARACTERISTIC
/begin CHARACTERISTIC KL_TSYNMENACHASPORT87 "Zeit vor Erkennen synchron fuer Ende Haupt-ME und Start Nach-ME" CURVE 0x1AD73C ZF_kl_ui8_S5_S3 1280 UMR_MSEC__10_1_M128_S5_S3 -1280 0
 /begin AXIS_DESCR STD_AXIS zff_atsys._.iSignale._.obj.sig_n_mot8 UMR_U_MIN_32_1_0_S5_S3 2 0 8160 DEPOSIT ABSOLUTE /end AXIS_DESCR
/end CHARACTERISTIC
/begin CHARACTERISTIC KL_TSYNMTMEHAUPTE12 "Zeit vor Erkennen synchron fuer Ende Haupt-ME" CURVE 0x1A7504 ZF_kl_ui8_S5_S3 1280 UMR_MSEC__10_1_M128_S5_S3 -1280 0
 /begin AXIS_DESCR STD_AXIS zff_atsys._.iSignale._.obj.sig_m_t8 UMR_NM__6_1_M34_S5_S3 6 -204 1326 DEPOSIT ABSOLUTE /end AXIS_DESCR
/end CHARACTERISTIC
/begin CHARACTERISTIC KL_TSYNMTMEHAUPTE12_EL "Zeit vor Erkennen synchron fuer Ende Haupt-ME" CURVE 0x1A7514 ZF_kl_ui8_S5_S3 1280 UMR_MSEC__10_1_M128_S5_S3 -1280 0
 /begin AXIS_DESCR STD_AXIS zff_atsys._.iSignale._.obj.sig_m_t8 UMR_NM__6_1_M34_S5_S3 6 -204 1326 DEPOSIT ABSOLUTE /end AXIS_DESCR
/end CHARACTERISTIC
/begin CHARACTERISTIC KL_TSYNMTMEHAUPTE23 "Zeit vor Erkennen synchron fuer Ende Haupt-ME" CURVE 0x1A7630 ZF_kl_ui8_S5_S3 1280 UMR_MSEC__10_1_M128_S5_S3 -1280 0
 /begin AXIS_DESCR STD_AXIS zff_atsys._.iSignale._.obj.sig_m_t8 UMR_NM__6_1_M34_S5_S3 6 -204 1326 DEPOSIT ABSOLUTE /end AXIS_DESCR
/end CHARACTERISTIC
/begin CHARACTERISTIC KL_TSYNMTMEHAUPTE23_EL "Zeit vor Erkennen synchron fuer Ende Haupt-ME" CURVE 0x1A7640 ZF_kl_ui8_S5_S3 1280 UMR_MSEC__10_1_M128_S5_S3 -1280 0
 /begin AXIS_DESCR STD_AXIS zff_atsys._.iSignale._.obj.sig_m_t8 UMR_NM__6_1_M34_S5_S3 6 -204 1326 DEPOSIT ABSOLUTE /end AXIS_DESCR
/end CHARACTERISTIC
/begin CHARACTERISTIC KL_TSYNMTMEHAUPTE34 "Zeit vor Erkennen synchron fuer Ende Haupt-ME" CURVE 0x1A775C ZF_kl_ui8_S5_S3 1280 UMR_MSEC__10_1_M128_S5_S3 -1280 0
 /begin AXIS_DESCR STD_AXIS zff_atsys._.iSignale._.obj.sig_m_t8 UMR_NM__6_1_M34_S5_S3 6 -204 1326 DEPOSIT ABSOLUTE /end AXIS_DESCR
/end CHARACTERISTIC
/begin CHARACTERISTIC KL_TSYNMTMEHAUPTE34_EL "Zeit vor Erkennen synchron fuer Ende Haupt-ME" CURVE 0x1A776C ZF_kl_ui8_S5_S3 1280 UMR_MSEC__10_1_M128_S5_S3 -1280 0
 /begin AXIS_DESCR STD_AXIS zff_atsys._.iSignale._.obj.sig_m_t8 UMR_NM__6_1_M34_S5_S3 6 -204 1326 DEPOSIT ABSOLUTE /end AXIS_DESCR
/end CHARACTERISTIC
/begin CHARACTERISTIC KL_TSYNMTMEHAUPTE45 "Zeit vor Erkennen synchron fuer Ende Haupt-ME" CURVE 0x1A7888 ZF_kl_ui8_S5_S3 1280 UMR_MSEC__10_1_M128_S5_S3 -1280 0
 /begin AXIS_DESCR STD_AXIS zff_atsys._.iSignale._.obj.sig_m_t8 UMR_NM__6_1_M34_S5_S3 6 -204 1326 DEPOSIT ABSOLUTE /end AXIS_DESCR
/end CHARACTERISTIC
/begin CHARACTERISTIC KL_TSYNMTMEHAUPTE45_EL "Zeit vor Erkennen synchron fuer Ende Haupt-ME" CURVE 0x1A7898 ZF_kl_ui8_S5_S3 1280 UMR_MSEC__10_1_M128_S5_S3 -1280 0
 /begin AXIS_DESCR STD_AXIS zff_atsys._.iSignale._.obj.sig_m_t8 UMR_NM__6_1_M34_S5_S3 6 -204 1326 DEPOSIT ABSOLUTE /end AXIS_DESCR
/end CHARACTERISTIC
/begin CHARACTERISTIC KL_TSYNMTMEHAUPTE56 "Zeit vor Erkennen synchron fuer Ende Haupt-ME" CURVE 0x1A79B4 ZF_kl_ui8_S5_S3 1280 UMR_MSEC__10_1_M128_S5_S3 -1280 0
 /begin AXIS_DESCR STD_AXIS zff_atsys._.iSignale._.obj.sig_m_t8 UMR_NM__6_1_M34_S5_S3 6 -204 1326 DEPOSIT ABSOLUTE /end AXIS_DESCR
/end CHARACTERISTIC
/begin CHARACTERISTIC KL_TSYNMTMEHAUPTE56_EL "Zeit vor Erkennen synchron fuer Ende Haupt-ME" CURVE 0x1A79C4 ZF_kl_ui8_S5_S3 1280 UMR_MSEC__10_1_M128_S5_S3 -1280 0
 /begin AXIS_DESCR STD_AXIS zff_atsys._.iSignale._.obj.sig_m_t8 UMR_NM__6_1_M34_S5_S3 6 -204 1326 DEPOSIT ABSOLUTE /end AXIS_DESCR
/end CHARACTERISTIC
/begin CHARACTERISTIC KL_TSYNMTMEHAUPTE67 "Zeit vor Erkennen synchron fuer Ende Haupt-ME" CURVE 0x1A7AE0 ZF_kl_ui8_S5_S3 1280 UMR_MSEC__10_1_M128_S5_S3 -1280 0
 /begin AXIS_DESCR STD_AXIS zff_atsys._.iSignale._.obj.sig_m_t8 UMR_NM__6_1_M34_S5_S3 6 -204 1326 DEPOSIT ABSOLUTE /end AXIS_DESCR
/end CHARACTERISTIC
/begin CHARACTERISTIC KL_TSYNMTMEHAUPTE67_EL "Zeit vor Erkennen synchron fuer Ende Haupt-ME" CURVE 0x1A7AF0 ZF_kl_ui8_S5_S3 1280 UMR_MSEC__10_1_M128_S5_S3 -1280 0
 /begin AXIS_DESCR STD_AXIS zff_atsys._.iSignale._.obj.sig_m_t8 UMR_NM__6_1_M34_S5_S3 6 -204 1326 DEPOSIT ABSOLUTE /end AXIS_DESCR
/end CHARACTERISTIC
/begin CHARACTERISTIC KL_TSYNMTMEHAUPTE78 "Zeit vor Erkennen synchron fuer Ende Haupt-ME" CURVE 0x1A7C0C ZF_kl_ui8_S5_S3 1280 UMR_MSEC__10_1_M128_S5_S3 -1280 0
 /begin AXIS_DESCR STD_AXIS zff_atsys._.iSignale._.obj.sig_m_t8 UMR_NM__6_1_M34_S5_S3 6 -204 1326 DEPOSIT ABSOLUTE /end AXIS_DESCR
/end CHARACTERISTIC
/begin CHARACTERISTIC KL_TSYNMTMEHAUPTE78_EL "Zeit vor Erkennen synchron fuer Ende Haupt-ME" CURVE 0x1A7C1C ZF_kl_ui8_S5_S3 1280 UMR_MSEC__10_1_M128_S5_S3 -1280 0
 /begin AXIS_DESCR STD_AXIS zff_atsys._.iSignale._.obj.sig_m_t8 UMR_NM__6_1_M34_S5_S3 6 -204 1326 DEPOSIT ABSOLUTE /end AXIS_DESCR
/end CHARACTERISTIC
/begin CHARACTERISTIC KL_TSYNMTMEHAUPTESP12 "Zeit vor Erkennen synchron fuer Ende Haupt-ME" CURVE 0x1A7D38 ZF_kl_ui8_S5_S3 1280 UMR_MSEC__10_1_M128_S5_S3 -1280 0
 /begin AXIS_DESCR STD_AXIS zff_atsys._.iSignale._.obj.sig_m_t8 UMR_NM__6_1_M34_S5_S3 6 -204 1326 DEPOSIT ABSOLUTE /end AXIS_DESCR
/end CHARACTERISTIC
/begin CHARACTERISTIC KL_TSYNMTMEHAUPTESP23 "Zeit vor Erkennen synchron fuer Ende Haupt-ME" CURVE 0x1A7DF4 ZF_kl_ui8_S5_S3 1280 UMR_MSEC__10_1_M128_S5_S3 -1280 0
 /begin AXIS_DESCR STD_AXIS zff_atsys._.iSignale._.obj.sig_m_t8 UMR_NM__6_1_M34_S5_S3 6 -204 1326 DEPOSIT ABSOLUTE /end AXIS_DESCR
/end CHARACTERISTIC
/begin CHARACTERISTIC KL_TSYNMTMEHAUPTESP34 "Zeit vor Erkennen synchron fuer Ende Haupt-ME" CURVE 0x1A7EB0 ZF_kl_ui8_S5_S3 1280 UMR_MSEC__10_1_M128_S5_S3 -1280 0
 /begin AXIS_DESCR STD_AXIS zff_atsys._.iSignale._.obj.sig_m_t8 UMR_NM__6_1_M34_S5_S3 6 -204 1326 DEPOSIT ABSOLUTE /end AXIS_DESCR
/end CHARACTERISTIC
/begin CHARACTERISTIC KL_TSYNMTMEHAUPTESP45 "Zeit vor Erkennen synchron fuer Ende Haupt-ME" CURVE 0x1A7F6C ZF_kl_ui8_S5_S3 1280 UMR_MSEC__10_1_M128_S5_S3 -1280 0
 /begin AXIS_DESCR STD_AXIS zff_atsys._.iSignale._.obj.sig_m_t8 UMR_NM__6_1_M34_S5_S3 6 -204 1326 DEPOSIT ABSOLUTE /end AXIS_DESCR
/end CHARACTERISTIC
/begin CHARACTERISTIC KL_TSYNMTMEHAUPTESP56 "Zeit vor Erkennen synchron fuer Ende Haupt-ME" CURVE 0x1A8028 ZF_kl_ui8_S5_S3 1280 UMR_MSEC__10_1_M128_S5_S3 -1280 0
 /begin AXIS_DESCR STD_AXIS zff_atsys._.iSignale._.obj.sig_m_t8 UMR_NM__6_1_M34_S5_S3 6 -204 1326 DEPOSIT ABSOLUTE /end AXIS_DESCR
/end CHARACTERISTIC
/begin CHARACTERISTIC KL_TSYNMTMEHAUPTESP67 "Zeit vor Erkennen synchron fuer Ende Haupt-ME" CURVE 0x1A80E4 ZF_kl_ui8_S5_S3 1280 UMR_MSEC__10_1_M128_S5_S3 -1280 0
 /begin AXIS_DESCR STD_AXIS zff_atsys._.iSignale._.obj.sig_m_t8 UMR_NM__6_1_M34_S5_S3 6 -204 1326 DEPOSIT ABSOLUTE /end AXIS_DESCR
/end CHARACTERISTIC
/begin CHARACTERISTIC KL_TSYNMTMEHAUPTESP78 "Zeit vor Erkennen synchron fuer Ende Haupt-ME" CURVE 0x1A81A0 ZF_kl_ui8_S5_S3 1280 UMR_MSEC__10_1_M128_S5_S3 -1280 0
 /begin AXIS_DESCR STD_AXIS zff_atsys._.iSignale._.obj.sig_m_t8 UMR_NM__6_1_M34_S5_S3 6 -204 1326 DEPOSIT ABSOLUTE /end AXIS_DESCR
/end CHARACTERISTIC
/begin CHARACTERISTIC KL_TSYNMTMEHAUPTESPORT12 "Zeit vor Erkennen synchron fuer Ende Haupt-ME" CURVE 0x1A825C ZF_kl_ui8_S5_S3 1280 UMR_MSEC__10_1_M128_S5_S3 -1280 0
 /begin AXIS_DESCR STD_AXIS zff_atsys._.iSignale._.obj.sig_m_t8 UMR_NM__6_1_M34_S5_S3 6 -204 1326 DEPOSIT ABSOLUTE /end AXIS_DESCR
/end CHARACTERISTIC
/begin CHARACTERISTIC KL_TSYNMTMEHAUPTESPORT23 "Zeit vor Erkennen synchron fuer Ende Haupt-ME" CURVE 0x1A8318 ZF_kl_ui8_S5_S3 1280 UMR_MSEC__10_1_M128_S5_S3 -1280 0
 /begin AXIS_DESCR STD_AXIS zff_atsys._.iSignale._.obj.sig_m_t8 UMR_NM__6_1_M34_S5_S3 6 -204 1326 DEPOSIT ABSOLUTE /end AXIS_DESCR
/end CHARACTERISTIC
/begin CHARACTERISTIC KL_TSYNMTMEHAUPTESPORT34 "Zeit vor Erkennen synchron fuer Ende Haupt-ME" CURVE 0x1A83D4 ZF_kl_ui8_S5_S3 1280 UMR_MSEC__10_1_M128_S5_S3 -1280 0
 /begin AXIS_DESCR STD_AXIS zff_atsys._.iSignale._.obj.sig_m_t8 UMR_NM__6_1_M34_S5_S3 6 -204 1326 DEPOSIT ABSOLUTE /end AXIS_DESCR
/end CHARACTERISTIC
/begin CHARACTERISTIC KL_TSYNMTMEHAUPTESPORT45 "Zeit vor Erkennen synchron fuer Ende Haupt-ME" CURVE 0x1A8490 ZF_kl_ui8_S5_S3 1280 UMR_MSEC__10_1_M128_S5_S3 -1280 0
 /begin AXIS_DESCR STD_AXIS zff_atsys._.iSignale._.obj.sig_m_t8 UMR_NM__6_1_M34_S5_S3 6 -204 1326 DEPOSIT ABSOLUTE /end AXIS_DESCR
/end CHARACTERISTIC
/begin CHARACTERISTIC KL_TSYNMTMEHAUPTESPORT56 "Zeit vor Erkennen synchron fuer Ende Haupt-ME" CURVE 0x1A854C ZF_kl_ui8_S5_S3 1280 UMR_MSEC__10_1_M128_S5_S3 -1280 0
 /begin AXIS_DESCR STD_AXIS zff_atsys._.iSignale._.obj.sig_m_t8 UMR_NM__6_1_M34_S5_S3 6 -204 1326 DEPOSIT ABSOLUTE /end AXIS_DESCR
/end CHARACTERISTIC
/begin CHARACTERISTIC KL_TSYNMTMEHAUPTESPORT67 "Zeit vor Erkennen synchron fuer Ende Haupt-ME" CURVE 0x1A8608 ZF_kl_ui8_S5_S3 1280 UMR_MSEC__10_1_M128_S5_S3 -1280 0
 /begin AXIS_DESCR STD_AXIS zff_atsys._.iSignale._.obj.sig_m_t8 UMR_NM__6_1_M34_S5_S3 6 -204 1326 DEPOSIT ABSOLUTE /end AXIS_DESCR
/end CHARACTERISTIC
/begin CHARACTERISTIC KL_TSYNMTMEHAUPTESPORT78 "Zeit vor Erkennen synchron fuer Ende Haupt-ME" CURVE 0x1A86C4 ZF_kl_ui8_S5_S3 1280 UMR_MSEC__10_1_M128_S5_S3 -1280 0
 /begin AXIS_DESCR STD_AXIS zff_atsys._.iSignale._.obj.sig_m_t8 UMR_NM__6_1_M34_S5_S3 6 -204 1326 DEPOSIT ABSOLUTE /end AXIS_DESCR
/end CHARACTERISTIC
/begin CHARACTERISTIC KL_TVPARKSPCGNP "Verzoegerung Zustand Parksperre eingelegt fuer N nach P" CURVE 0x1AEDA4 ZF_kl_ui8_S5_S3 2500 UMR_MSEC__10_1_0_S5_S3 0 2500
 /begin AXIS_DESCR STD_AXIS zff_atsys._.iSignale._.obj.sig_c_getr UMR_GRADC__1_1_M40_S5_S3 4 -40 215 DEPOSIT ABSOLUTE /end AXIS_DESCR
/end CHARACTERISTIC
/begin CHARACTERISTIC KL_TVPSEIN "Verzoegerungszeit für das Einlegen der Parksperre aus einer Kraftflußrichtung" CURVE 0x1AEDB0 ZF_kl_ui8_S5_S3 2540 UMR_MSEC__10_1_0_S5_S3 0 2540
 /begin AXIS_DESCR STD_AXIS zff_atsys._.iSignale._.obj.sig_c_getr UMR_GRADC__1_1_M40_S5_S3 5 -40 150 DEPOSIT ABSOLUTE /end AXIS_DESCR
/end CHARACTERISTIC
/begin CHARACTERISTIC K_FMEHAUPTA12 "Filterkonstante (aehnl INPT) Start Hauptmotoreingriff" VALUE 0x1D84A6 ZF_kw_si16_S5_S3 65.535 UMR___1_1000_0_S5_S3 -32.768 32.767 /end CHARACTERISTIC
/begin CHARACTERISTIC K_FMEHAUPTA12_EL "Filterkonstante (aehnl INPT) Start Hauptmotoreingriff" VALUE 0x1D84A8 ZF_kw_si16_S5_S3 65.535 UMR___1_1000_0_S5_S3 -32.768 32.767 /end CHARACTERISTIC
/begin CHARACTERISTIC K_FMEHAUPTA23 "Filterkonstante (aehnl INPT) Start Hauptmotoreingriff" VALUE 0x1D84AC ZF_kw_si16_S5_S3 65.535 UMR___1_1000_0_S5_S3 -32.768 32.767 /end CHARACTERISTIC
/begin CHARACTERISTIC K_FMEHAUPTA23_EL "Filterkonstante (aehnl INPT) Start Hauptmotoreingriff" VALUE 0x1D84AE ZF_kw_si16_S5_S3 65.535 UMR___1_1000_0_S5_S3 -32.768 32.767 /end CHARACTERISTIC
/begin CHARACTERISTIC K_FMEHAUPTA34 "Filterkonstante (aehnl INPT) Start Hauptmotoreingriff" VALUE 0x1D84B2 ZF_kw_si16_S5_S3 65.535 UMR___1_1000_0_S5_S3 -32.768 32.767 /end CHARACTERISTIC
/begin CHARACTERISTIC K_FMEHAUPTA34_EL "Filterkonstante (aehnl INPT) Start Hauptmotoreingriff" VALUE 0x1D84B4 ZF_kw_si16_S5_S3 65.535 UMR___1_1000_0_S5_S3 -32.768 32.767 /end CHARACTERISTIC
/begin CHARACTERISTIC K_FMEHAUPTA45 "Filterkonstante (aehnl INPT) Start Hauptmotoreingriff" VALUE 0x1D84B8 ZF_kw_si16_S5_S3 65.535 UMR___1_1000_0_S5_S3 -32.768 32.767 /end CHARACTERISTIC
/begin CHARACTERISTIC K_FMEHAUPTA45_EL "Filterkonstante (aehnl INPT) Start Hauptmotoreingriff" VALUE 0x1D84BA ZF_kw_si16_S5_S3 65.535 UMR___1_1000_0_S5_S3 -32.768 32.767 /end CHARACTERISTIC
/begin CHARACTERISTIC K_FMEHAUPTA56 "Filterkonstante (aehnl INPT) Start Hauptmotoreingriff" VALUE 0x1D84BE ZF_kw_si16_S5_S3 65.535 UMR___1_1000_0_S5_S3 -32.768 32.767 /end CHARACTERISTIC
/begin CHARACTERISTIC K_FMEHAUPTA56_EL "Filterkonstante (aehnl INPT) Start Hauptmotoreingriff" VALUE 0x1D84C0 ZF_kw_si16_S5_S3 65.535 UMR___1_1000_0_S5_S3 -32.768 32.767 /end CHARACTERISTIC
/begin CHARACTERISTIC K_FMEHAUPTA67 "Filterkonstante (aehnl INPT) Start Hauptmotoreingriff" VALUE 0x1D84C4 ZF_kw_si16_S5_S3 65.535 UMR___1_1000_0_S5_S3 -32.768 32.767 /end CHARACTERISTIC
/begin CHARACTERISTIC K_FMEHAUPTA67_EL "Filterkonstante (aehnl INPT) Start Hauptmotoreingriff" VALUE 0x1D84C6 ZF_kw_si16_S5_S3 65.535 UMR___1_1000_0_S5_S3 -32.768 32.767 /end CHARACTERISTIC
/begin CHARACTERISTIC K_FMEHAUPTA78 "Filterkonstante (aehnl INPT) Start Hauptmotoreingriff" VALUE 0x1D84CA ZF_kw_si16_S5_S3 65.535 UMR___1_1000_0_S5_S3 -32.768 32.767 /end CHARACTERISTIC
/begin CHARACTERISTIC K_FMEHAUPTA78_EL "Filterkonstante (aehnl INPT) Start Hauptmotoreingriff" VALUE 0x1D84CC ZF_kw_si16_S5_S3 65.535 UMR___1_1000_0_S5_S3 -32.768 32.767 /end CHARACTERISTIC
/begin CHARACTERISTIC K_FMEHAUPTASP12 "Filterkonstante (aehnl INPT) Start Hauptmotoreingriff" VALUE 0x1D84D0 ZF_kw_si16_S5_S3 65.535 UMR___1_1000_0_S5_S3 -32.768 32.767 /end CHARACTERISTIC
/begin CHARACTERISTIC K_FMEHAUPTASP23 "Filterkonstante (aehnl INPT) Start Hauptmotoreingriff" VALUE 0x1D84D4 ZF_kw_si16_S5_S3 65.535 UMR___1_1000_0_S5_S3 -32.768 32.767 /end CHARACTERISTIC
/begin CHARACTERISTIC K_FMEHAUPTASP34 "Filterkonstante (aehnl INPT) Start Hauptmotoreingriff" VALUE 0x1D84D8 ZF_kw_si16_S5_S3 65.535 UMR___1_1000_0_S5_S3 -32.768 32.767 /end CHARACTERISTIC
/begin CHARACTERISTIC K_FMEHAUPTASP45 "Filterkonstante (aehnl INPT) Start Hauptmotoreingriff" VALUE 0x1D84DC ZF_kw_si16_S5_S3 65.535 UMR___1_1000_0_S5_S3 -32.768 32.767 /end CHARACTERISTIC
/begin CHARACTERISTIC K_FMEHAUPTASP56 "Filterkonstante (aehnl INPT) Start Hauptmotoreingriff" VALUE 0x1D84E0 ZF_kw_si16_S5_S3 65.535 UMR___1_1000_0_S5_S3 -32.768 32.767 /end CHARACTERISTIC
/begin CHARACTERISTIC K_FMEHAUPTASP67 "Filterkonstante (aehnl INPT) Start Hauptmotoreingriff" VALUE 0x1D84E4 ZF_kw_si16_S5_S3 65.535 UMR___1_1000_0_S5_S3 -32.768 32.767 /end CHARACTERISTIC
/begin CHARACTERISTIC K_FMEHAUPTASP78 "Filterkonstante (aehnl INPT) Start Hauptmotoreingriff" VALUE 0x1D84E8 ZF_kw_si16_S5_S3 65.535 UMR___1_1000_0_S5_S3 -32.768 32.767 /end CHARACTERISTIC
/begin CHARACTERISTIC K_FMEHAUPTASPORT12 "Filterkonstante (aehnl INPT) Start Hauptmotoreingriff" VALUE 0x1D84EC ZF_kw_si16_S5_S3 65.535 UMR___1_1000_0_S5_S3 -32.768 32.767 /end CHARACTERISTIC
/begin CHARACTERISTIC K_FMEHAUPTASPORT23 "Filterkonstante (aehnl INPT) Start Hauptmotoreingriff" VALUE 0x1D84F0 ZF_kw_si16_S5_S3 65.535 UMR___1_1000_0_S5_S3 -32.768 32.767 /end CHARACTERISTIC
/begin CHARACTERISTIC K_FMEHAUPTASPORT34 "Filterkonstante (aehnl INPT) Start Hauptmotoreingriff" VALUE 0x1D84F4 ZF_kw_si16_S5_S3 65.535 UMR___1_1000_0_S5_S3 -32.768 32.767 /end CHARACTERISTIC
/begin CHARACTERISTIC K_FMEHAUPTASPORT45 "Filterkonstante (aehnl INPT) Start Hauptmotoreingriff" VALUE 0x1D84F8 ZF_kw_si16_S5_S3 65.535 UMR___1_1000_0_S5_S3 -32.768 32.767 /end CHARACTERISTIC
/begin CHARACTERISTIC K_FMEHAUPTASPORT56 "Filterkonstante (aehnl INPT) Start Hauptmotoreingriff" VALUE 0x1D84FC ZF_kw_si16_S5_S3 65.535 UMR___1_1000_0_S5_S3 -32.768 32.767 /end CHARACTERISTIC
/begin CHARACTERISTIC K_FMEHAUPTASPORT67 "Filterkonstante (aehnl INPT) Start Hauptmotoreingriff" VALUE 0x1D8500 ZF_kw_si16_S5_S3 65.535 UMR___1_1000_0_S5_S3 -32.768 32.767 /end CHARACTERISTIC
/begin CHARACTERISTIC K_FMEHAUPTASPORT78 "Filterkonstante (aehnl INPT) Start Hauptmotoreingriff" VALUE 0x1D8504 ZF_kw_si16_S5_S3 65.535 UMR___1_1000_0_S5_S3 -32.768 32.767 /end CHARACTERISTIC
/begin CHARACTERISTIC MG_MMOTMAXVERHSSAUF12 "Gradient über den die Momentenbegrenzung aufgehoben wird" VALUE 0x1D86B2 ZF_kw_si16_S5_S3 2750 UMR_NM_SEC_10_1_0_S5_S3 -200 2550 /end CHARACTERISTIC
/begin CHARACTERISTIC MG_MMOTMAXVERHSSAUF23 "Gradient über den die Momentenbegrenzung aufgehoben wird" VALUE 0x1D86C0 ZF_kw_si16_S5_S3 2750 UMR_NM_SEC_10_1_0_S5_S3 -200 2550 /end CHARACTERISTIC
/begin CHARACTERISTIC MG_MMOTMAXVERHSSAUF34 "Gradient über den die Momentenbegrenzung aufgehoben wird" VALUE 0x1D86CE ZF_kw_si16_S5_S3 2750 UMR_NM_SEC_10_1_0_S5_S3 -200 2550 /end CHARACTERISTIC
/begin CHARACTERISTIC MG_MMOTMAXVERHSSAUF45 "Gradient über den die Momentenbegrenzung aufgehoben wird" VALUE 0x1D86DC ZF_kw_si16_S5_S3 2750 UMR_NM_SEC_10_1_0_S5_S3 -200 2550 /end CHARACTERISTIC
/begin CHARACTERISTIC MG_MMOTMAXVERHSSAUF56 "Gradient über den die Momentenbegrenzung aufgehoben wird" VALUE 0x1D86EA ZF_kw_si16_S5_S3 2750 UMR_NM_SEC_10_1_0_S5_S3 -200 2550 /end CHARACTERISTIC
/begin CHARACTERISTIC MG_MMOTMAXVERHSSAUF67 "Gradient über den die Momentenbegrenzung aufgehoben wird" VALUE 0x1D86F8 ZF_kw_si16_S5_S3 2750 UMR_NM_SEC_10_1_0_S5_S3 -200 2550 /end CHARACTERISTIC
/begin CHARACTERISTIC MG_MMOTMAXVERHSSAUF78 "Gradient über den die Momentenbegrenzung aufgehoben wird" VALUE 0x1D8706 ZF_kw_si16_S5_S3 2750 UMR_NM_SEC_10_1_0_S5_S3 -200 2550 /end CHARACTERISTIC
/begin CHARACTERISTIC MG_MOTMAXCKAUF "Momentengradient bei Rücknahme Kupplungstemperaturabhängige Motormomentenbegrenzung" VALUE 0x1D7913 ZF_kw_ui8_S5_S3 2550 UMR_NM_SEC_10_1_0_S5_S3 0 2550 /end CHARACTERISTIC
/begin CHARACTERISTIC M_MOTMAXVERHSS12 "Max. Motormoment während aktiver Fkt." VALUE 0x1D86B0 ZF_kw_si16_S5_S3 1500 UMR_NM__1_1_0_S5_S3 -200 1300 /end CHARACTERISTIC
/begin CHARACTERISTIC M_MOTMAXVERHSS23 "Max. Motormoment während aktiver Fkt." VALUE 0x1D86BE ZF_kw_si16_S5_S3 1500 UMR_NM__1_1_0_S5_S3 -200 1300 /end CHARACTERISTIC
/begin CHARACTERISTIC M_MOTMAXVERHSS34 "Max. Motormoment während aktiver Fkt." VALUE 0x1D86CC ZF_kw_si16_S5_S3 1500 UMR_NM__1_1_0_S5_S3 -200 1300 /end CHARACTERISTIC
/begin CHARACTERISTIC M_MOTMAXVERHSS45 "Max. Motormoment während aktiver Fkt." VALUE 0x1D86DA ZF_kw_si16_S5_S3 1500 UMR_NM__1_1_0_S5_S3 -200 1300 /end CHARACTERISTIC
/begin CHARACTERISTIC M_MOTMAXVERHSS56 "Max. Motormoment während aktiver Fkt." VALUE 0x1D86E8 ZF_kw_si16_S5_S3 1500 UMR_NM__1_1_0_S5_S3 -200 1300 /end CHARACTERISTIC
/begin CHARACTERISTIC M_MOTMAXVERHSS67 "Max. Motormoment während aktiver Fkt." VALUE 0x1D86F6 ZF_kw_si16_S5_S3 1500 UMR_NM__1_1_0_S5_S3 -200 1300 /end CHARACTERISTIC
/begin CHARACTERISTIC M_MOTMAXVERHSS78 "Max. Motormoment während aktiver Fkt." VALUE 0x1D8704 ZF_kw_si16_S5_S3 1500 UMR_NM__1_1_0_S5_S3 -200 1300 /end CHARACTERISTIC
/begin CHARACTERISTIC ND_SYNABBRGA_D "Differenzdrehzahl zu Synchron fuer Abbruch GA" VALUE 0x1D868E ZF_kw_ui16_S5_S3 1999 UMR_U_MIN_1_1_0_S5_S3 1 2000 /end CHARACTERISTIC
/begin CHARACTERISTIC ND_SYNABBRGA_R "Differenzdrehzahl zu Synchron fuer Abbruch GA" VALUE 0x1D8690 ZF_kw_ui16_S5_S3 1999 UMR_U_MIN_1_1_0_S5_S3 1 2000 /end CHARACTERISTIC
/begin CHARACTERISTIC NGS_ABVERSOB "obere Schwelle Abtriebsdrehzahlgradient Verschachtelung" VALUE 0x1D8698 ZF_kw_si16_S5_S3 13200 UMR_U_MINSEC_1_1_0_S5_S3 -5000 8200 /end CHARACTERISTIC
/begin CHARACTERISTIC NGS_ABVERSUN "untere Schwelle Abtriebsdrehzahlgradient Verschachtelung" VALUE 0x1D8696 ZF_kw_si16_S5_S3 13200 UMR_U_MINSEC_1_1_0_S5_S3 -5000 8200 /end CHARACTERISTIC
/begin CHARACTERISTIC NGS_VERIAE12 "Abtriebsdrehzahlgradientenschwelle für ausführen der verschachtelten Schaltung mit IAE" VALUE 0x1D86B6 ZF_kw_si16_S5_S3 20000 UMR_U_MINSEC_1_1_0_S5_S3 -10000 10000 /end CHARACTERISTIC
/begin CHARACTERISTIC NGS_VERIAE23 "Abtriebsdrehzahlgradientenschwelle für ausführen der verschachtelten Schaltung mit IAE" VALUE 0x1D86C4 ZF_kw_si16_S5_S3 20000 UMR_U_MINSEC_1_1_0_S5_S3 -10000 10000 /end CHARACTERISTIC
/begin CHARACTERISTIC NGS_VERIAE34 "Abtriebsdrehzahlgradientenschwelle für ausführen der verschachtelten Schaltung mit IAE" VALUE 0x1D86D2 ZF_kw_si16_S5_S3 20000 UMR_U_MINSEC_1_1_0_S5_S3 -10000 10000 /end CHARACTERISTIC
/begin CHARACTERISTIC NGS_VERIAE45 "Abtriebsdrehzahlgradientenschwelle für ausführen der verschachtelten Schaltung mit IAE" VALUE 0x1D86E0 ZF_kw_si16_S5_S3 20000 UMR_U_MINSEC_1_1_0_S5_S3 -10000 10000 /end CHARACTERISTIC
/begin CHARACTERISTIC NGS_VERIAE56 "Abtriebsdrehzahlgradientenschwelle für ausführen der verschachtelten Schaltung mit IAE" VALUE 0x1D86EE ZF_kw_si16_S5_S3 20000 UMR_U_MINSEC_1_1_0_S5_S3 -10000 10000 /end CHARACTERISTIC
/begin CHARACTERISTIC NGS_VERIAE67 "Abtriebsdrehzahlgradientenschwelle für ausführen der verschachtelten Schaltung mit IAE" VALUE 0x1D86FC ZF_kw_si16_S5_S3 20000 UMR_U_MINSEC_1_1_0_S5_S3 -10000 10000 /end CHARACTERISTIC
/begin CHARACTERISTIC NGS_VERIAE78 "Abtriebsdrehzahlgradientenschwelle für ausführen der verschachtelten Schaltung mit IAE" VALUE 0x1D870A ZF_kw_si16_S5_S3 20000 UMR_U_MINSEC_1_1_0_S5_S3 -10000 10000 /end CHARACTERISTIC
/begin CHARACTERISTIC NS_ABSSCHRHS "Abtriebsdrehzahlschwelle Schrittschaltung HS" VALUE 0x1D86A0 ZF_kw_ui16_S5_S3 8160 UMR_U_MIN_1_1_0_S5_S3 0 8160 /end CHARACTERISTIC
/begin CHARACTERISTIC NS_ABSSCHRHS1 "Schwelle Schrittschaltung bei HS mit 1.Gang" VALUE 0x1D86A4 ZF_kw_ui16_S5_S3 8160 UMR_U_MIN_1_1_0_S5_S3 0 8160 /end CHARACTERISTIC
/begin CHARACTERISTIC NS_ABSSCHRRS "Abtriebsdrehzahlschwelle Schrittschaltung RS" VALUE 0x1D86A2 ZF_kw_ui16_S5_S3 8160 UMR_U_MIN_1_1_0_S5_S3 0 8160 /end CHARACTERISTIC
/begin CHARACTERISTIC NS_ABSSCHRRS1 "Schwelle Schrittschaltung bei RS mit 1.Gang" VALUE 0x1D86A6 ZF_kw_ui16_S5_S3 8160 UMR_U_MIN_1_1_0_S5_S3 0 8160 /end CHARACTERISTIC
/begin CHARACTERISTIC NS_MOTVERS "Motordrehzahlschwelle Verschachtelung" VALUE 0x1D8694 ZF_kw_ui16_S5_S3 8160 UMR_U_MIN_1_1_0_S5_S3 0 8160 /end CHARACTERISTIC
/begin CHARACTERISTIC NS_NTVERSHS "Drehzahlschwelle für Ausführung verschachtelter Schaltung HS" VALUE 0x1D869A ZF_kw_ui16_S5_S3 8200 UMR_U_MIN_1_1_0_S5_S3 0 8200 /end CHARACTERISTIC
/begin CHARACTERISTIC NS_NTVERSRS "Drehzahlschwelle für Ausführung verschachtelter Schaltung RS" VALUE 0x1D869C ZF_kw_ui16_S5_S3 8200 UMR_U_MIN_1_1_0_S5_S3 0 8200 /end CHARACTERISTIC
/begin CHARACTERISTIC NS_SYNISTE12 "Turbinendifferenzdrehzahlschwelle zur Erkennung Synchron istgang verlassen" VALUE 0x1D86AE ZF_kw_si16_S5_S3 1000 UMR_U_MIN_1_1_0_S5_S3 0 1000 /end CHARACTERISTIC
/begin CHARACTERISTIC NS_SYNISTE23 "Turbinendifferenzdrehzahlschwelle zur Erkennung Synchron istgang verlassen" VALUE 0x1D86BC ZF_kw_si16_S5_S3 1000 UMR_U_MIN_1_1_0_S5_S3 0 1000 /end CHARACTERISTIC
/begin CHARACTERISTIC NS_SYNISTE34 "Turbinendifferenzdrehzahlschwelle zur Erkennung Synchron istgang verlassen" VALUE 0x1D86CA ZF_kw_si16_S5_S3 1000 UMR_U_MIN_1_1_0_S5_S3 0 1000 /end CHARACTERISTIC
/begin CHARACTERISTIC NS_SYNISTE45 "Turbinendifferenzdrehzahlschwelle zur Erkennung Synchron istgang verlassen" VALUE 0x1D86D8 ZF_kw_si16_S5_S3 1000 UMR_U_MIN_1_1_0_S5_S3 0 1000 /end CHARACTERISTIC
/begin CHARACTERISTIC NS_SYNISTE56 "Turbinendifferenzdrehzahlschwelle zur Erkennung Synchron istgang verlassen" VALUE 0x1D86E6 ZF_kw_si16_S5_S3 1000 UMR_U_MIN_1_1_0_S5_S3 0 1000 /end CHARACTERISTIC
/begin CHARACTERISTIC NS_SYNISTE67 "Turbinendifferenzdrehzahlschwelle zur Erkennung Synchron istgang verlassen" VALUE 0x1D86F4 ZF_kw_si16_S5_S3 1000 UMR_U_MIN_1_1_0_S5_S3 0 1000 /end CHARACTERISTIC
/begin CHARACTERISTIC NS_SYNISTE78 "Turbinendifferenzdrehzahlschwelle zur Erkennung Synchron istgang verlassen" VALUE 0x1D8702 ZF_kw_si16_S5_S3 1000 UMR_U_MIN_1_1_0_S5_S3 0 1000 /end CHARACTERISTIC
/begin CHARACTERISTIC NS_TABB12 "Turbinendrehzahlschwelle fuer Schaltungsabbruch in GLS" VALUE 0x1D86AC ZF_kw_ui16_S5_S3 8200 UMR_U_MIN_1_1_0_S5_S3 0 8200 /end CHARACTERISTIC
/begin CHARACTERISTIC NS_TABB23 "Turbinendrehzahlschwelle fuer Schaltungsabbruch in GLS" VALUE 0x1D86BA ZF_kw_ui16_S5_S3 8200 UMR_U_MIN_1_1_0_S5_S3 0 8200 /end CHARACTERISTIC
/begin CHARACTERISTIC NS_TABB34 "Turbinendrehzahlschwelle fuer Schaltungsabbruch in GLS" VALUE 0x1D86C8 ZF_kw_ui16_S5_S3 8200 UMR_U_MIN_1_1_0_S5_S3 0 8200 /end CHARACTERISTIC
/begin CHARACTERISTIC NS_TABB45 "Turbinendrehzahlschwelle fuer Schaltungsabbruch in GLS" VALUE 0x1D86D6 ZF_kw_ui16_S5_S3 8200 UMR_U_MIN_1_1_0_S5_S3 0 8200 /end CHARACTERISTIC
/begin CHARACTERISTIC NS_TABB56 "Turbinendrehzahlschwelle fuer Schaltungsabbruch in GLS" VALUE 0x1D86E4 ZF_kw_ui16_S5_S3 8200 UMR_U_MIN_1_1_0_S5_S3 0 8200 /end CHARACTERISTIC
/begin CHARACTERISTIC NS_TABB67 "Turbinendrehzahlschwelle fuer Schaltungsabbruch in GLS" VALUE 0x1D86F2 ZF_kw_ui16_S5_S3 8200 UMR_U_MIN_1_1_0_S5_S3 0 8200 /end CHARACTERISTIC
/begin CHARACTERISTIC NS_TABB78 "Turbinendrehzahlschwelle fuer Schaltungsabbruch in GLS" VALUE 0x1D8700 ZF_kw_ui16_S5_S3 8200 UMR_U_MIN_1_1_0_S5_S3 0 8200 /end CHARACTERISTIC
/begin CHARACTERISTIC NS_TSSCHR "Turbinendrehzahlschwelle Schrittschaltung" VALUE 0x1D86A8 ZF_kw_ui16_S5_S3 8160 UMR_U_MIN_1_1_0_S5_S3 0 8160 /end CHARACTERISTIC
/begin CHARACTERISTIC NS_VERSIAE12 "Drehzahlschwelle auf Leerlaufdrehzahl zur Verhinderung der Verschachtelung bei IAE" VALUE 0x1D86B4 ZF_kw_si16_S5_S3 8200 UMR_U_MIN_1_1_0_S5_S3 0 8200 /end CHARACTERISTIC
/begin CHARACTERISTIC NS_VERSIAE23 "Drehzahlschwelle auf Leerlaufdrehzahl zur Verhinderung der Verschachtelung bei IAE" VALUE 0x1D86C2 ZF_kw_si16_S5_S3 8200 UMR_U_MIN_1_1_0_S5_S3 0 8200 /end CHARACTERISTIC
/begin CHARACTERISTIC NS_VERSIAE34 "Drehzahlschwelle auf Leerlaufdrehzahl zur Verhinderung der Verschachtelung bei IAE" VALUE 0x1D86D0 ZF_kw_si16_S5_S3 8200 UMR_U_MIN_1_1_0_S5_S3 0 8200 /end CHARACTERISTIC
/begin CHARACTERISTIC NS_VERSIAE45 "Drehzahlschwelle auf Leerlaufdrehzahl zur Verhinderung der Verschachtelung bei IAE" VALUE 0x1D86DE ZF_kw_si16_S5_S3 8200 UMR_U_MIN_1_1_0_S5_S3 0 8200 /end CHARACTERISTIC
/begin CHARACTERISTIC NS_VERSIAE56 "Drehzahlschwelle auf Leerlaufdrehzahl zur Verhinderung der Verschachtelung bei IAE" VALUE 0x1D86EC ZF_kw_si16_S5_S3 8200 UMR_U_MIN_1_1_0_S5_S3 0 8200 /end CHARACTERISTIC
/begin CHARACTERISTIC NS_VERSIAE67 "Drehzahlschwelle auf Leerlaufdrehzahl zur Verhinderung der Verschachtelung bei IAE" VALUE 0x1D86FA ZF_kw_si16_S5_S3 8200 UMR_U_MIN_1_1_0_S5_S3 0 8200 /end CHARACTERISTIC
/begin CHARACTERISTIC NS_VERSIAE78 "Drehzahlschwelle auf Leerlaufdrehzahl zur Verhinderung der Verschachtelung bei IAE" VALUE 0x1D8708 ZF_kw_si16_S5_S3 8200 UMR_U_MIN_1_1_0_S5_S3 0 8200 /end CHARACTERISTIC
/begin CHARACTERISTIC N_ABBRTVPSEIN "Abtriebsdrehzahlschwelle fuer die Fkt. Verzoegertes einlegen P" VALUE 0x1D8574 ZF_kw_ui16_S5_S3 2000 UMR_U_MIN_1_1_0_S5_S3 0 2000 /end CHARACTERISTIC
/begin CHARACTERISTIC PO_FDNR "Fuelldruckoffset GE nicht kraftschl.Kup bei Dx-N-R" VALUE 0x1D8684 ZF_kw_si16_S5_S3 19.15 UMR_BAR__1_1000_0_S5_S3 -6.4 12.75 /end CHARACTERISTIC
/begin CHARACTERISTIC PO_FGEDR "Druckoffset Fuelldruck GE nach R und vorher Kraftfluss in D" VALUE 0x1D8680 ZF_kw_si16_S5_S3 6.4 UMR_BAR__1_1000_0_S5_S3 -6.4 0 /end CHARACTERISTIC
/begin CHARACTERISTIC PO_FGERD "Druckoffset Fuelldruck GE nach D und vorher Kraftfluss in R" VALUE 0x1D8682 ZF_kw_si16_S5_S3 6.4 UMR_BAR__1_1000_0_S5_S3 -6.4 0 /end CHARACTERISTIC
/begin CHARACTERISTIC PO_FRND "Fuelldruckoffset GE nicht kraftschl.Kup bei R-N-Dx oder Dx-N-Dx" VALUE 0x1D8686 ZF_kw_si16_S5_S3 19.15 UMR_BAR__1_1000_0_S5_S3 -6.4 12.75 /end CHARACTERISTIC
/begin CHARACTERISTIC PO_SDGEDR "Druckoffset Schaltdruck GE nach R und vorher Kraftfluss in D" VALUE 0x1D8688 ZF_kw_si16_S5_S3 6.4 UMR_BAR__1_1000_0_S5_S3 -6.4 0 /end CHARACTERISTIC
/begin CHARACTERISTIC PO_SDGERD "Druckoffset Schaltdruck GE nach D und vorher Kraftfluss in R" VALUE 0x1D868A ZF_kw_si16_S5_S3 6.4 UMR_BAR__1_1000_0_S5_S3 -6.4 0 /end CHARACTERISTIC
/begin CHARACTERISTIC PS_BRTVPSEIN "Druckschwelle fuer Anwendung der Verzoegerungszeit KL_TVPSEIN" VALUE 0x1D8572 ZF_kw_si16_S5_S3 200 UMR_BAR__1_1_0_S5_S3 0 200 /end CHARACTERISTIC
/begin CHARACTERISTIC P_GAKUPPC "Druck Kup. C bei GA als nicht kraftloesende Kupplung" VALUE 0x1D868C ZF_kw_si16_S5_S3 12.75 UMR_BAR__1_1000_0_S5_S3 0 12.75 /end CHARACTERISTIC
/begin CHARACTERISTIC SCHWELLE_NDSYN "Drehzahlschwelle fuer Verlassen/Erreichen synchron" VALUE 0x1D869E ZF_kw_ui16_S5_S3 8160 UMR_U_MIN_1_1_0_S5_S3 0 8160 /end CHARACTERISTIC
/begin CHARACTERISTIC SWI_ABBRS "Schalter Abbruch einer RS" VALUE 0x1D7903 ZF_kw_bool8_S5_S3 1 UMR___1_1_0_S5_S3 0 1 /end CHARACTERISTIC
/begin CHARACTERISTIC SWI_ABBSYNISTHS "Schalter Abbruch einer HS bevor sync istgang verlassen" VALUE 0x1D7904 ZF_kw_bool8_S5_S3 1 UMR___1_1_0_S5_S3 0 1 /end CHARACTERISTIC
/begin CHARACTERISTIC SWI_ADADATEN "Loeschen der Adaptionsdaten bei Urstart verhindern 0=OFF, 1=ON, 2=Nur Kup Zaehler loeschen" VALUE 0x1D73EC ZF_kw_ui8_S5_S3 2 UMR___1_1_0_S5_S3 0 2 /end CHARACTERISTIC
/begin CHARACTERISTIC SWI_EEPROM_CHECKSUMME "0 keine Checksummen/Pruefpattern-Ueberpruefung 1 zyklische Checksummen/Pattern- Ueberpruefung aktiv (Standard) 2 einmalige Neuberechnung der Checksumme/Pruefpattern" VALUE 0x1D73EB ZF_kw_ui8_S5_S3 2 UMR___1_1_0_S5_S3 0 2 /end CHARACTERISTIC
/begin CHARACTERISTIC SWI_EEPROM_INIT "0: ATSYS EEPROM Daten nicht lesen nach Neustart 1: ATSYS EEPROM Daten verwenden nach Neustart (Standard) 2: ATSYS EEPROM Daten immer initialisieren" VALUE 0x1D73EA ZF_kw_ui8_S5_S3 2 UMR___1_1_0_S5_S3 0 2 /end CHARACTERISTIC
/begin CHARACTERISTIC SWI_ERRSP "Schalter schnelle Rueckschaltungen auch bei Fehlereintrag" VALUE 0x1D7907 ZF_kw_bool8_S5_S3 1 UMR___1_1_0_S5_S3 0 1 /end CHARACTERISTIC
/begin CHARACTERISTIC SWI_HINSYN "Schalter Funktion Hinsyn aktivieren" VALUE 0x1D78FD ZF_kw_bool8_S5_S3 1 UMR___1_1_0_S5_S3 0 1 /end CHARACTERISTIC
/begin CHARACTERISTIC SWI_MVGIEPLOESCH "Loeschen der IEP MvG-Daten beim Wechsel von 0->1" VALUE 0x1D78E2 ZF_kw_ui8_S5_S3 1 UMR___1_1_0_S5_S3 0 1 /end CHARACTERISTIC
/begin CHARACTERISTIC SWI_MVGIEPRES "Loeschen der IEP-Werte erlauben" VALUE 0x1D78E3 ZF_kw_ui8_S5_S3 1 UMR___1_1_0_S5_S3 0 1 /end CHARACTERISTIC
/begin CHARACTERISTIC SWI_MVG_AKT "Aktivieren von MvG" VALUE 0x1D78DF ZF_kw_ui8_S5_S3 1 UMR___1_1_0_S5_S3 0 1 /end CHARACTERISTIC
/begin CHARACTERISTIC SWI_MVG_LOESCH "Loeschen von allen MvG-Daten beim Wechsel von 0->1" VALUE 0x1D78E0 ZF_kw_ui8_S5_S3 1 UMR___1_1_0_S5_S3 0 1 /end CHARACTERISTIC
/begin CHARACTERISTIC SWI_SCHLEPPVERS "Schalter zur aktivierung der Bedingung für Verschachtelung bei Schleppstart" VALUE 0x1D78FC ZF_kw_bool8_S5_S3 1 UMR___1_1_0_S5_S3 0 1 /end CHARACTERISTIC
/begin CHARACTERISTIC SWI_START_GANGWECHSEL "Schalter fuer Art der Berechnung fuer die Ausgabe vom Gangwechsel" VALUE 0x1D78FF ZF_kw_bool8_S5_S3 1 UMR___1_1_0_S5_S3 0 1 /end CHARACTERISTIC
/begin CHARACTERISTIC SWI_UMSPLABRS "Switch Umschaltung aller Label fuer spontane RS auch nach Start Schaltung" VALUE 0x1D790E ZF_kw_bool8_S5_S3 1 UMR___1_1_0_S5_S3 0 1 /end CHARACTERISTIC
/begin CHARACTERISTIC SWI_VERHVERSMMOTMAX "Schalter zur Verhinderung der Verschachtelung wenn Kupplungstemperaturabhängige Motormomentenbegrenzung aktiv" VALUE 0x1D7914 ZF_kw_bool8_S5_S3 1 UMR___1_1_0_S5_S3 0 1 /end CHARACTERISTIC
/begin CHARACTERISTIC TAB_ABKOEF_KUPPLUNG_AUF "Abkühlkoeffizient bei offenem Schaltelement" CURVE 0x1AFEE0 ZF_tab_ui16_S5_S3 1 UMR_K_SECK_1_1000_0_S5_S3 0 1
 /begin AXIS_DESCR FIX_AXIS iTciCompu.k_ab UMR___1_1_0_S5_S3 5 1 5 READ_ONLY FIX_AXIS_PAR_DIST 1 1 5 /end AXIS_DESCR
/end CHARACTERISTIC
/begin CHARACTERISTIC TAB_ABKOEF_KUPPLUNG_ZU "Abkühlkoeffizient bei geschlossenem Schaltelement" CURVE 0x1AFEF0 ZF_tab_ui16_S5_S3 1 UMR_K_SECK_1_1000_0_S5_S3 0 1
 /begin AXIS_DESCR FIX_AXIS iTciCompu.k_zu UMR___1_1_0_S5_S3 5 1 5 READ_ONLY FIX_AXIS_PAR_DIST 1 1 5 /end AXIS_DESCR
/end CHARACTERISTIC
/begin CHARACTERISTIC TAB_F_KORCKUPPL "Korrekturfaktor für Schaltelementerwärmung" MAP 0x1AFEC8 ZF_tab2d_ui8_S5_S3 2.55 UMR___1_100_0_S5_S3 0 2.55
 /begin AXIS_DESCR FIX_AXIS iTciCompu.k_zu UMR___1_1_0_S5_S3 5 1 5 READ_ONLY FIX_AXIS_PAR_DIST 1 1 5 /end AXIS_DESCR
 /begin AXIS_DESCR FIX_AXIS iTciCompu.schaltart_sas_red_tci UMR___1_1_0_S5_S3 3 1 3 READ_ONLY FIX_AXIS_PAR_DIST 1 1 3 /end AXIS_DESCR
/end CHARACTERISTIC
/begin CHARACTERISTIC TAB_GESAMTMASSE "Gesamtmasse der Stahllamellen der Kupplung" CURVE 0x1AF9CC ZF_tab_si16_S5_S3 9999 UMR_G__1_1_0_S5_S3 1 10000
 /begin AXIS_DESCR FIX_AXIS iTciCompu.k_zu UMR___1_1_0_S5_S3 5 1 5 READ_ONLY FIX_AXIS_PAR_DIST 1 1 5 /end AXIS_DESCR
/end CHARACTERISTIC
/begin CHARACTERISTIC TAB_GESAMTREIBFLAECHE "Reibfläche der Kupplung" CURVE 0x1AF9BC ZF_tab_si16_S5_S3 299990 UMR_MM2__10_1_0_S5_S3 10 300000
 /begin AXIS_DESCR FIX_AXIS iTciCompu.k_zu UMR___1_1_0_S5_S3 5 1 5 READ_ONLY FIX_AXIS_PAR_DIST 1 1 5 /end AXIS_DESCR
/end CHARACTERISTIC
/begin CHARACTERISTIC TAB_LMAXZULKAB "Max. zulässige Reibleistung der abschaltenden Kupplung" MAP 0x1AF9DC ZF_tab2d_si16_S5_S3 4.99 UMR_W_MM2_1_100_0_S5_S3 0.01 5
 /begin AXIS_DESCR FIX_AXIS zff_atsys._.iSignale._.obj.sig_istgang UMR___1_1_0_S5_S3 10 -1 8 READ_ONLY FIX_AXIS_PAR_DIST -1 1 10 /end AXIS_DESCR
 /begin AXIS_DESCR FIX_AXIS zff_atsys._.iSignale._.obj.sig_zielgang_sas UMR___1_1_0_S5_S3 10 -1 8 READ_ONLY FIX_AXIS_PAR_DIST -1 1 10 /end AXIS_DESCR
/end CHARACTERISTIC
/begin CHARACTERISTIC TAB_LMAXZULKZU "Max. zulässige Reibleistung der zuschaltenden Kupplung" MAP 0x1AFAAC ZF_tab2d_si16_S5_S3 4.99 UMR_W_MM2_1_100_0_S5_S3 0.01 5
 /begin AXIS_DESCR FIX_AXIS zff_atsys._.iSignale._.obj.sig_istgang UMR___1_1_0_S5_S3 10 -1 8 READ_ONLY FIX_AXIS_PAR_DIST -1 1 10 /end AXIS_DESCR
 /begin AXIS_DESCR FIX_AXIS zff_atsys._.iSignale._.obj.sig_zielgang_sas UMR___1_1_0_S5_S3 10 -1 8 READ_ONLY FIX_AXIS_PAR_DIST -1 1 10 /end AXIS_DESCR
/end CHARACTERISTIC
/begin CHARACTERISTIC TAB_MASSE_LAM "Masse einer Stahllamelle der Kupplung" CURVE 0x1AFEAC ZF_tab_ui16_S5_S3 999.9 UMR_G__1_10_0_S5_S3 0.1 1000
 /begin AXIS_DESCR FIX_AXIS iTciCompu.k_zu UMR___1_1_0_S5_S3 5 1 5 READ_ONLY FIX_AXIS_PAR_DIST 1 1 5 /end AXIS_DESCR
/end CHARACTERISTIC
/begin CHARACTERISTIC TAB_MSTOBSP "untere Momentenschwelle fuer verkuerzte Schaltungen" MAP 0x1AF0CC ZF_tab2d_si16_S5_S3 1500 UMR_NM__1_1_0_S5_S3 -200 1300
 /begin AXIS_DESCR FIX_AXIS zff_atsys._.iSignale._.obj.sig_istgang UMR___1_1_0_S5_S3 10 -1 8 READ_ONLY FIX_AXIS_PAR_DIST -1 1 10 /end AXIS_DESCR
 /begin AXIS_DESCR FIX_AXIS zff_atsys._.iSignale._.obj.sig_zielgang UMR___1_1_0_S5_S3 10 -1 8 READ_ONLY FIX_AXIS_PAR_DIST -1 1 10 /end AXIS_DESCR
/end CHARACTERISTIC
/begin CHARACTERISTIC TAB_MSTUNSP "untere Momentenschwelle fuer verkuerzte Schaltungen" MAP 0x1AF19C ZF_tab2d_si16_S5_S3 1500 UMR_NM__1_1_0_S5_S3 -200 1300
 /begin AXIS_DESCR FIX_AXIS zff_atsys._.iSignale._.obj.sig_istgang UMR___1_1_0_S5_S3 10 -1 8 READ_ONLY FIX_AXIS_PAR_DIST -1 1 10 /end AXIS_DESCR
 /begin AXIS_DESCR FIX_AXIS zff_atsys._.iSignale._.obj.sig_zielgang UMR___1_1_0_S5_S3 10 -1 8 READ_ONLY FIX_AXIS_PAR_DIST -1 1 10 /end AXIS_DESCR
/end CHARACTERISTIC
/begin CHARACTERISTIC TAB_MSTVERS "Momentenschwelle fuer verschachtelte Schaltungen" MAP 0x1AEFFC ZF_tab2d_si16_S5_S3 1500 UMR_NM__1_1_0_S5_S3 -200 1300
 /begin AXIS_DESCR FIX_AXIS zff_atsys._.iSignale._.obj.sig_istgang UMR___1_1_0_S5_S3 10 -1 8 READ_ONLY FIX_AXIS_PAR_DIST -1 1 10 /end AXIS_DESCR
 /begin AXIS_DESCR FIX_AXIS zff_atsys._.iSignale._.obj.sig_zielgang UMR___1_1_0_S5_S3 10 -1 8 READ_ONLY FIX_AXIS_PAR_DIST -1 1 10 /end AXIS_DESCR
/end CHARACTERISTIC
/begin CHARACTERISTIC TAB_MVG_CGETR "Klassengrenzen fuer Getriebetemperatur MvG" CURVE 0x1AED68 ZF_tab_ui8_S5_S3 255 UMR_GRADC__1_1_M40_S5_S3 -40 215
 /begin AXIS_DESCR FIX_AXIS NO_INPUT_QUANTITY UMR___1_1_0_S5_S3 7 0 6 READ_ONLY FIX_AXIS_PAR_DIST 0 1 7 /end AXIS_DESCR
/end CHARACTERISTIC
/begin CHARACTERISTIC TAB_MVG_CKUP_A "Grenzen der Teilintervalle für die Kupplungstemperatur beim Getriebemonitoring" CURVE 0x1B00F8 ZF_tab_si16_S5_S3 540 UMR_GRADC__1_1_0_S5_S3 -40 500
 /begin AXIS_DESCR FIX_AXIS NO_INPUT_QUANTITY UMR___1_1_0_S5_S3 7 1 7 READ_ONLY FIX_AXIS_PAR_DIST 1 1 7 /end AXIS_DESCR
/end CHARACTERISTIC
/begin CHARACTERISTIC TAB_MVG_CKUP_B "Grenzen der Teilintervalle für die Kupplungstemperatur beim Getriebemonitoring" CURVE 0x1B01C4 ZF_tab_si16_S5_S3 540 UMR_GRADC__1_1_0_S5_S3 -40 500
 /begin AXIS_DESCR FIX_AXIS NO_INPUT_QUANTITY UMR___1_1_0_S5_S3 7 1 7 READ_ONLY FIX_AXIS_PAR_DIST 1 1 7 /end AXIS_DESCR
/end CHARACTERISTIC
/begin CHARACTERISTIC TAB_MVG_CKUP_C "Grenzen der Teilintervalle für die Kupplungstemperatur beim Getriebemonitoring" CURVE 0x1B0290 ZF_tab_si16_S5_S3 540 UMR_GRADC__1_1_0_S5_S3 -40 500
 /begin AXIS_DESCR FIX_AXIS NO_INPUT_QUANTITY UMR___1_1_0_S5_S3 7 1 7 READ_ONLY FIX_AXIS_PAR_DIST 1 1 7 /end AXIS_DESCR
/end CHARACTERISTIC
/begin CHARACTERISTIC TAB_MVG_CKUP_D "Grenzen der Teilintervalle für die Kupplungstemperatur beim Getriebemonitoring" CURVE 0x1B035C ZF_tab_si16_S5_S3 540 UMR_GRADC__1_1_0_S5_S3 -40 500
 /begin AXIS_DESCR FIX_AXIS NO_INPUT_QUANTITY UMR___1_1_0_S5_S3 7 1 7 READ_ONLY FIX_AXIS_PAR_DIST 1 1 7 /end AXIS_DESCR
/end CHARACTERISTIC
/begin CHARACTERISTIC TAB_MVG_CKUP_E "Grenzen der Teilintervalle für die Kupplungstemperatur beim Getriebemonitoring" CURVE 0x1B0428 ZF_tab_si16_S5_S3 540 UMR_GRADC__1_1_0_S5_S3 -40 500
 /begin AXIS_DESCR FIX_AXIS NO_INPUT_QUANTITY UMR___1_1_0_S5_S3 7 1 7 READ_ONLY FIX_AXIS_PAR_DIST 1 1 7 /end AXIS_DESCR
/end CHARACTERISTIC
/begin CHARACTERISTIC TAB_MVG_MOTSTART "Klassengrenzen fuer Motorstart Temp MvG" CURVE 0x1AED98 ZF_tab_ui8_S5_S3 255 UMR_GRADC__1_1_M40_S5_S3 -40 215
 /begin AXIS_DESCR FIX_AXIS NO_INPUT_QUANTITY UMR___1_1_0_S5_S3 7 0 6 READ_ONLY FIX_AXIS_PAR_DIST 0 1 7 /end AXIS_DESCR
/end CHARACTERISTIC
/begin CHARACTERISTIC TAB_MVG_MT "Klassengrenzen fuer MT-Betriebspunkt MvG" CURVE 0x1AED84 ZF_tab_si16_S5_S3 1700 UMR_NM__1_1_0_S5_S3 -200 1500
 /begin AXIS_DESCR FIX_AXIS NO_INPUT_QUANTITY UMR___1_1_0_S5_S3 7 0 6 READ_ONLY FIX_AXIS_PAR_DIST 0 1 7 /end AXIS_DESCR
/end CHARACTERISTIC
/begin CHARACTERISTIC TAB_MVG_NT "Klassengrenzen fuer NT-Betriebspunkt MvG" CURVE 0x1AED74 ZF_tab_ui16_S5_S3 8200 UMR_U_MIN_1_1_0_S5_S3 0 8200
 /begin AXIS_DESCR FIX_AXIS NO_INPUT_QUANTITY UMR___1_1_0_S5_S3 5 0 4 READ_ONLY FIX_AXIS_PAR_DIST 0 1 5 /end AXIS_DESCR
/end CHARACTERISTIC
/begin CHARACTERISTIC TAB_NABFAKTORKAB "Abtriebsdrehzahlfaktor für Berechnung Kupplungsdrehzahl bei Schaltungen für abschaltende Kupplung" MAP 0x1AF4DC ZF_tab2d_si16_S5_S3 20 UMR___1_1000_0_S5_S3 -10 10
 /begin AXIS_DESCR FIX_AXIS zff_atsys._.iSignale._.obj.sig_istgang UMR___1_1_0_S5_S3 10 -1 8 READ_ONLY FIX_AXIS_PAR_DIST -1 1 10 /end AXIS_DESCR
 /begin AXIS_DESCR FIX_AXIS zff_atsys._.iSignale._.obj.sig_zielgang_sas UMR___1_1_0_S5_S3 10 -1 8 READ_ONLY FIX_AXIS_PAR_DIST -1 1 10 /end AXIS_DESCR
/end CHARACTERISTIC
/begin CHARACTERISTIC TAB_NABFAKTORKZU "Abtriebsdrehzahlfaktor für Berechnung Kupplungsdrehzahl bei Schaltungen für zuschaltende Kupplung" MAP 0x1AF5AC ZF_tab2d_si16_S5_S3 20 UMR___1_1000_0_S5_S3 -10 10
 /begin AXIS_DESCR FIX_AXIS zff_atsys._.iSignale._.obj.sig_istgang UMR___1_1_0_S5_S3 10 -1 8 READ_ONLY FIX_AXIS_PAR_DIST -1 1 10 /end AXIS_DESCR
 /begin AXIS_DESCR FIX_AXIS zff_atsys._.iSignale._.obj.sig_zielgang_sas UMR___1_1_0_S5_S3 10 -1 8 READ_ONLY FIX_AXIS_PAR_DIST -1 1 10 /end AXIS_DESCR
/end CHARACTERISTIC
/begin CHARACTERISTIC TAB_NSABSP "Abtriebsdrehzahlschwelle fuer verkuerzte Schaltungen" MAP 0x1AF26C ZF_tab2d_ui16_S5_S3 8160 UMR_U_MIN_1_1_0_S5_S3 0 8160
 /begin AXIS_DESCR FIX_AXIS zff_atsys._.iSignale._.obj.sig_istgang UMR___1_1_0_S5_S3 10 -1 8 READ_ONLY FIX_AXIS_PAR_DIST -1 1 10 /end AXIS_DESCR
 /begin AXIS_DESCR FIX_AXIS zff_atsys._.iSignale._.obj.sig_zielgang UMR___1_1_0_S5_S3 10 -1 8 READ_ONLY FIX_AXIS_PAR_DIST -1 1 10 /end AXIS_DESCR
/end CHARACTERISTIC
/begin CHARACTERISTIC TAB_NTFAKTORKAB "Turbinendrehzahlfaktor für Berechnung Kupplungsdrehzahl bei Schaltungen für abschaltende Kupplung" MAP 0x1AF33C ZF_tab2d_si16_S5_S3 20 UMR___1_1000_0_S5_S3 -10 10
 /begin AXIS_DESCR FIX_AXIS zff_atsys._.iSignale._.obj.sig_istgang UMR___1_1_0_S5_S3 10 -1 8 READ_ONLY FIX_AXIS_PAR_DIST -1 1 10 /end AXIS_DESCR
 /begin AXIS_DESCR FIX_AXIS zff_atsys._.iSignale._.obj.sig_zielgang_sas UMR___1_1_0_S5_S3 10 -1 8 READ_ONLY FIX_AXIS_PAR_DIST -1 1 10 /end AXIS_DESCR
/end CHARACTERISTIC
/begin CHARACTERISTIC TAB_NTFAKTORKZU "Turbinendrehzahlfaktor für Berechnung Kupplungsdrehzahl bei Schaltungen für zuschaltende Kupplung" MAP 0x1AF40C ZF_tab2d_si16_S5_S3 20 UMR___1_1000_0_S5_S3 -10 10
 /begin AXIS_DESCR FIX_AXIS zff_atsys._.iSignale._.obj.sig_istgang UMR___1_1_0_S5_S3 10 -1 8 READ_ONLY FIX_AXIS_PAR_DIST -1 1 10 /end AXIS_DESCR
 /begin AXIS_DESCR FIX_AXIS zff_atsys._.iSignale._.obj.sig_zielgang_sas UMR___1_1_0_S5_S3 10 -1 8 READ_ONLY FIX_AXIS_PAR_DIST -1 1 10 /end AXIS_DESCR
/end CHARACTERISTIC
/begin CHARACTERISTIC TAB_N_LAM "Anzahl der Stahllamellen der Kupplung" CURVE 0x1AFEBC ZF_tab_ui8_S5_S3 9 UMR___1_1_0_S5_S3 1 10
 /begin AXIS_DESCR FIX_AXIS iTciCompu.k_zu UMR___1_1_0_S5_S3 5 1 5 READ_ONLY FIX_AXIS_PAR_DIST 1 1 5 /end AXIS_DESCR
/end CHARACTERISTIC
/begin CHARACTERISTIC TAB_REIBFAKTORKAB_1 "Reibfaktor der abschaltenden Kupplung schaltungsabhängig" MAP 0x1AF67C ZF_tab2d_si16_S5_S3 300 UMR_NM_BAR_1_100_0_S5_S3 0 300
 /begin AXIS_DESCR FIX_AXIS zff_atsys._.iSignale._.obj.sig_istgang UMR___1_1_0_S5_S3 10 -1 8 READ_ONLY FIX_AXIS_PAR_DIST -1 1 10 /end AXIS_DESCR
 /begin AXIS_DESCR FIX_AXIS zff_atsys._.iSignale._.obj.sig_zielgang_sas UMR___1_1_0_S5_S3 10 -1 8 READ_ONLY FIX_AXIS_PAR_DIST -1 1 10 /end AXIS_DESCR
/end CHARACTERISTIC
/begin CHARACTERISTIC TAB_REIBFAKTORKAB_2 "Reibfaktor der abschaltenden Kupplung schaltungsabhängig" MAP 0x1AF74C ZF_tab2d_si16_S5_S3 10 UMR_NM_BAR2_1_100_0_S5_S3 -10 0
 /begin AXIS_DESCR FIX_AXIS zff_atsys._.iSignale._.obj.sig_istgang UMR___1_1_0_S5_S3 10 -1 8 READ_ONLY FIX_AXIS_PAR_DIST -1 1 10 /end AXIS_DESCR
 /begin AXIS_DESCR FIX_AXIS zff_atsys._.iSignale._.obj.sig_zielgang_sas UMR___1_1_0_S5_S3 10 -1 8 READ_ONLY FIX_AXIS_PAR_DIST -1 1 10 /end AXIS_DESCR
/end CHARACTERISTIC
/begin CHARACTERISTIC TAB_REIBFAKTORKZU_1 "Reibfaktor der zuschaltenden Kupplung schaltungsabhängig" MAP 0x1AF81C ZF_tab2d_si16_S5_S3 300 UMR_NM_BAR_1_100_0_S5_S3 0 300
 /begin AXIS_DESCR FIX_AXIS zff_atsys._.iSignale._.obj.sig_istgang UMR___1_1_0_S5_S3 10 -1 8 READ_ONLY FIX_AXIS_PAR_DIST -1 1 10 /end AXIS_DESCR
 /begin AXIS_DESCR FIX_AXIS zff_atsys._.iSignale._.obj.sig_zielgang_sas UMR___1_1_0_S5_S3 10 -1 8 READ_ONLY FIX_AXIS_PAR_DIST -1 1 10 /end AXIS_DESCR
/end CHARACTERISTIC
/begin CHARACTERISTIC TAB_REIBFAKTORKZU_2 "Reibfaktor der zuschaltenden Kupplung schaltungsabhängig" MAP 0x1AF8EC ZF_tab2d_si16_S5_S3 10 UMR_NM_BAR2_1_100_0_S5_S3 -10 0
 /begin AXIS_DESCR FIX_AXIS zff_atsys._.iSignale._.obj.sig_istgang UMR___1_1_0_S5_S3 10 -1 8 READ_ONLY FIX_AXIS_PAR_DIST -1 1 10 /end AXIS_DESCR
 /begin AXIS_DESCR FIX_AXIS zff_atsys._.iSignale._.obj.sig_zielgang_sas UMR___1_1_0_S5_S3 10 -1 8 READ_ONLY FIX_AXIS_PAR_DIST -1 1 10 /end AXIS_DESCR
/end CHARACTERISTIC
/begin CHARACTERISTIC TAB_SWIECOMODE "Tabelle zu Aktivierung ECO Mode aus Index" CURVE 0x1AEF28 ZF_tab_ui8_S5_S3 1 UMR___1_1_0_S5_S3 0 1
 /begin AXIS_DESCR FIX_AXIS zff_atsys._.iSignale._.obj.sig_index_sp_sps UMR___1_1_0_S5_S3 100 0 99 READ_ONLY FIX_AXIS_PAR_DIST 0 1 100 /end AXIS_DESCR
/end CHARACTERISTIC
/begin CHARACTERISTIC TAB_SWISPONTHS "Aktivierung spontane HS aus Index" CURVE 0x1AEEC0 ZF_tab_ui8_S5_S3 2 UMR___1_1_0_S5_S3 0 2
 /begin AXIS_DESCR FIX_AXIS zff_atsys._.iSignale._.obj.sig_index_sp_sps UMR___1_1_0_S5_S3 100 0 99 READ_ONLY FIX_AXIS_PAR_DIST 0 1 100 /end AXIS_DESCR
/end CHARACTERISTIC
/begin CHARACTERISTIC TAB_SWISPONTRS "Aktivierung spontane RS (SP und SPORT) aus Index" CURVE 0x1AEE58 ZF_tab_ui8_S5_S3 2 UMR___1_1_0_S5_S3 0 2
 /begin AXIS_DESCR FIX_AXIS zff_atsys._.iSignale._.obj.sig_index_sp_sps UMR___1_1_0_S5_S3 100 0 99 READ_ONLY FIX_AXIS_PAR_DIST 0 1 100 /end AXIS_DESCR
/end CHARACTERISTIC
/begin CHARACTERISTIC TAB_SWIVERSFOLGE "Schaltungen bei denen eine Folgeschaltung verschachtelt wird" MAP 0x1AEF90 ZF_tab2d_ui8_S5_S3 5 UMR___1_1_0_S5_S3 0 5
 /begin AXIS_DESCR FIX_AXIS zff_atsys._.iSignale._.obj.sig_istgang UMR___1_1_0_S5_S3 10 -1 8 READ_ONLY FIX_AXIS_PAR_DIST -1 1 10 /end AXIS_DESCR
 /begin AXIS_DESCR FIX_AXIS zff_atsys._.iSignale._.obj.sig_zielgang UMR___1_1_0_S5_S3 10 -1 8 READ_ONLY FIX_AXIS_PAR_DIST -1 1 10 /end AXIS_DESCR
/end CHARACTERISTIC
/begin CHARACTERISTIC TAB_TV_GANGWECHSEL "Verzoegerung Ausgabe Gangwechsel" CURVE 0x1AEE24 ZF_tab_si16_S5_S3 5080 UMR_MSEC__10_1_0_S5_S3 -2540 2540
 /begin AXIS_DESCR FIX_AXIS iSasZentr.schalttyp UMR___1_1_0_S5_S3 5 0 4 READ_ONLY FIX_AXIS_PAR_DIST 0 1 5 /end AXIS_DESCR
/end CHARACTERISTIC
/begin CHARACTERISTIC TAB_WMAXZULKAB "Max. zulässige Reibarbeit der abschaltenden Kupplung" MAP 0x1AFB7C ZF_tab2d_fl32_S5_S3 199.9 UMR_J_G_1_1_0_S5_S3 0.1 200
 /begin AXIS_DESCR FIX_AXIS zff_atsys._.iSignale._.obj.sig_istgang UMR___1_1_0_S5_S3 10 -1 8 READ_ONLY FIX_AXIS_PAR_DIST -1 1 10 /end AXIS_DESCR
 /begin AXIS_DESCR FIX_AXIS zff_atsys._.iSignale._.obj.sig_zielgang_sas UMR___1_1_0_S5_S3 10 -1 8 READ_ONLY FIX_AXIS_PAR_DIST -1 1 10 /end AXIS_DESCR
 FORMAT "%4.3" /end CHARACTERISTIC
/begin CHARACTERISTIC TAB_WMAXZULKZU "Max. zulässige Reibarbeit der zuschaltenden Kupplung" MAP 0x1AFD14 ZF_tab2d_fl32_S5_S3 199.9 UMR_J_G_1_1_0_S5_S3 0.1 200
 /begin AXIS_DESCR FIX_AXIS zff_atsys._.iSignale._.obj.sig_istgang UMR___1_1_0_S5_S3 10 -1 8 READ_ONLY FIX_AXIS_PAR_DIST -1 1 10 /end AXIS_DESCR
 /begin AXIS_DESCR FIX_AXIS zff_atsys._.iSignale._.obj.sig_zielgang_sas UMR___1_1_0_S5_S3 10 -1 8 READ_ONLY FIX_AXIS_PAR_DIST -1 1 10 /end AXIS_DESCR
 FORMAT "%4.3" /end CHARACTERISTIC
/begin CHARACTERISTIC TS_MVG_CGETR "Temperatur-Quantisierung fuer MvG" VALUE 0x1D856E ZF_kw_ui16_S5_S3 7620 UMR___10_1_0_S5_S3 30 7650 /end CHARACTERISTIC
/begin CHARACTERISTIC TS_MVG_DATENREF "Standard-Quantisierung fuer MvG" VALUE 0x1D856C ZF_kw_ui16_S5_S3 7620 UMR___10_1_0_S5_S3 30 7650 /end CHARACTERISTIC
/begin CHARACTERISTIC T_ABBHSZ "Minimalzeit seit Wechsel Schub-Zug fuer Abbruch HSZ" VALUE 0x1D790F ZF_kw_ui8_S5_S3 2540 UMR_MSEC__10_1_0_S5_S3 0 2540 /end CHARACTERISTIC
/begin CHARACTERISTIC T_FMEHAUPTA12 "Filterzeit Start Hauptmotoreingriff" VALUE 0x1D84A4 ZF_kw_si16_S5_S3 508 UMR_MSEC__1_1_0_S5_S3 -254 254 /end CHARACTERISTIC
/begin CHARACTERISTIC T_FMEHAUPTA23 "Filterzeit Start Hauptmotoreingriff" VALUE 0x1D84AA ZF_kw_si16_S5_S3 508 UMR_MSEC__1_1_0_S5_S3 -254 254 /end CHARACTERISTIC
/begin CHARACTERISTIC T_FMEHAUPTA34 "Filterzeit Start Hauptmotoreingriff" VALUE 0x1D84B0 ZF_kw_si16_S5_S3 508 UMR_MSEC__1_1_0_S5_S3 -254 254 /end CHARACTERISTIC
/begin CHARACTERISTIC T_FMEHAUPTA45 "Filterzeit Start Hauptmotoreingriff" VALUE 0x1D84B6 ZF_kw_si16_S5_S3 508 UMR_MSEC__1_1_0_S5_S3 -254 254 /end CHARACTERISTIC
/begin CHARACTERISTIC T_FMEHAUPTA56 "Filterzeit Start Hauptmotoreingriff" VALUE 0x1D84BC ZF_kw_si16_S5_S3 508 UMR_MSEC__1_1_0_S5_S3 -254 254 /end CHARACTERISTIC
/begin CHARACTERISTIC T_FMEHAUPTA67 "Filterzeit Start Hauptmotoreingriff" VALUE 0x1D84C2 ZF_kw_si16_S5_S3 508 UMR_MSEC__1_1_0_S5_S3 -254 254 /end CHARACTERISTIC
/begin CHARACTERISTIC T_FMEHAUPTA78 "Filterzeit Start Hauptmotoreingriff" VALUE 0x1D84C8 ZF_kw_si16_S5_S3 508 UMR_MSEC__1_1_0_S5_S3 -254 254 /end CHARACTERISTIC
/begin CHARACTERISTIC T_FMEHAUPTASP12 "Filterzeit Start Hauptmotoreingriff" VALUE 0x1D84CE ZF_kw_si16_S5_S3 508 UMR_MSEC__1_1_0_S5_S3 -254 254 /end CHARACTERISTIC
/begin CHARACTERISTIC T_FMEHAUPTASP23 "Filterzeit Start Hauptmotoreingriff" VALUE 0x1D84D2 ZF_kw_si16_S5_S3 508 UMR_MSEC__1_1_0_S5_S3 -254 254 /end CHARACTERISTIC
/begin CHARACTERISTIC T_FMEHAUPTASP34 "Filterzeit Start Hauptmotoreingriff" VALUE 0x1D84D6 ZF_kw_si16_S5_S3 508 UMR_MSEC__1_1_0_S5_S3 -254 254 /end CHARACTERISTIC
/begin CHARACTERISTIC T_FMEHAUPTASP45 "Filterzeit Start Hauptmotoreingriff" VALUE 0x1D84DA ZF_kw_si16_S5_S3 508 UMR_MSEC__1_1_0_S5_S3 -254 254 /end CHARACTERISTIC
/begin CHARACTERISTIC T_FMEHAUPTASP56 "Filterzeit Start Hauptmotoreingriff" VALUE 0x1D84DE ZF_kw_si16_S5_S3 508 UMR_MSEC__1_1_0_S5_S3 -254 254 /end CHARACTERISTIC
/begin CHARACTERISTIC T_FMEHAUPTASP67 "Filterzeit Start Hauptmotoreingriff" VALUE 0x1D84E2 ZF_kw_si16_S5_S3 508 UMR_MSEC__1_1_0_S5_S3 -254 254 /end CHARACTERISTIC
/begin CHARACTERISTIC T_FMEHAUPTASP78 "Filterzeit Start Hauptmotoreingriff" VALUE 0x1D84E6 ZF_kw_si16_S5_S3 508 UMR_MSEC__1_1_0_S5_S3 -254 254 /end CHARACTERISTIC
/begin CHARACTERISTIC T_FMEHAUPTASPORT12 "Filterzeit Start Hauptmotoreingriff" VALUE 0x1D84EA ZF_kw_si16_S5_S3 508 UMR_MSEC__1_1_0_S5_S3 -254 254 /end CHARACTERISTIC
/begin CHARACTERISTIC T_FMEHAUPTASPORT23 "Filterzeit Start Hauptmotoreingriff" VALUE 0x1D84EE ZF_kw_si16_S5_S3 508 UMR_MSEC__1_1_0_S5_S3 -254 254 /end CHARACTERISTIC
/begin CHARACTERISTIC T_FMEHAUPTASPORT34 "Filterzeit Start Hauptmotoreingriff" VALUE 0x1D84F2 ZF_kw_si16_S5_S3 508 UMR_MSEC__1_1_0_S5_S3 -254 254 /end CHARACTERISTIC
/begin CHARACTERISTIC T_FMEHAUPTASPORT45 "Filterzeit Start Hauptmotoreingriff" VALUE 0x1D84F6 ZF_kw_si16_S5_S3 508 UMR_MSEC__1_1_0_S5_S3 -254 254 /end CHARACTERISTIC
/begin CHARACTERISTIC T_FMEHAUPTASPORT56 "Filterzeit Start Hauptmotoreingriff" VALUE 0x1D84FA ZF_kw_si16_S5_S3 508 UMR_MSEC__1_1_0_S5_S3 -254 254 /end CHARACTERISTIC
/begin CHARACTERISTIC T_FMEHAUPTASPORT67 "Filterzeit Start Hauptmotoreingriff" VALUE 0x1D84FE ZF_kw_si16_S5_S3 508 UMR_MSEC__1_1_0_S5_S3 -254 254 /end CHARACTERISTIC
/begin CHARACTERISTIC T_FMEHAUPTASPORT78 "Filterzeit Start Hauptmotoreingriff" VALUE 0x1D8502 ZF_kw_si16_S5_S3 508 UMR_MSEC__1_1_0_S5_S3 -254 254 /end CHARACTERISTIC
/begin CHARACTERISTIC T_FNGABSAS "Filterzeit fuer Abtriebsdrehzahlgradient Motoreingriff" VALUE 0x1D8692 ZF_kw_ui16_S5_S3 999 UMR_MSEC__1_1_0_S5_S3 1 1000 /end CHARACTERISTIC
/begin CHARACTERISTIC T_FPKABKUPBEL "Filterzeit für Kupplungswirkdruck kab" VALUE 0x1D7911 ZF_kw_ui8_S5_S3 253 UMR_MSEC__1_1_0_S5_S3 1 254 /end CHARACTERISTIC
/begin CHARACTERISTIC T_FPKZUKUPBEL "Filterzeit für Kupplungswirkdruck kzu" VALUE 0x1D7910 ZF_kw_ui8_S5_S3 253 UMR_MSEC__1_1_0_S5_S3 1 254 /end CHARACTERISTIC
/begin CHARACTERISTIC T_MAXOUT11 "Maximalzeit Ansteuerung Parksperrenmagnet" VALUE 0x1D8570 ZF_kw_ui16_S5_S3 299 UMR_SEC__1_1_0_S5_S3 1 300 /end CHARACTERISTIC
/begin CHARACTERISTIC T_MINGANGFLAG "Mindestzeit Flag sync_ziel_erreicht" VALUE 0x1D78FE ZF_kw_ui8_S5_S3 50 UMR_MSEC__10_1_0_S5_S3 0 50 /end CHARACTERISTIC
/begin CHARACTERISTIC T_MINOUT11 "Mindestzeit Ansteuerung Parksperrenmagnet" VALUE 0x1D78E5 ZF_kw_ui8_S5_S3 1000 UMR_MSEC__10_1_0_S5_S3 0 1000 /end CHARACTERISTIC
/begin CHARACTERISTIC T_MMOTMAXCKAB "Rampenzeit auf Kupplungstemperaturabhängige Motormomentenbegrenzung" VALUE 0x1D7912 ZF_kw_ui8_S5_S3 2540 UMR_MSEC__10_1_0_S5_S3 0 2540 /end CHARACTERISTIC
/begin CHARACTERISTIC T_POGERDDR "Zeit seit letztem GA fuer Verwendung Druckoffsets" VALUE 0x1D78FB ZF_kw_ui8_S5_S3 2550 UMR_MSEC__10_1_0_S5_S3 0 2550 /end CHARACTERISTIC
/begin CHARACTERISTIC T_RAMAX12 "Rampe bei Timeout" VALUE 0x1D791E ZF_kw_ui8_S5_S3 2540 UMR_MSEC__10_1_0_S5_S3 0 2540 /end CHARACTERISTIC
/begin CHARACTERISTIC T_RAMAX23 "Rampe bei Timeout" VALUE 0x1D791F ZF_kw_ui8_S5_S3 2540 UMR_MSEC__10_1_0_S5_S3 0 2540 /end CHARACTERISTIC
/begin CHARACTERISTIC T_RAMAX34 "Rampe bei Timeout" VALUE 0x1D7920 ZF_kw_ui8_S5_S3 2540 UMR_MSEC__10_1_0_S5_S3 0 2540 /end CHARACTERISTIC
/begin CHARACTERISTIC T_RAMAX45 "Rampe bei Timeout" VALUE 0x1D7921 ZF_kw_ui8_S5_S3 2540 UMR_MSEC__10_1_0_S5_S3 0 2540 /end CHARACTERISTIC
/begin CHARACTERISTIC T_RAMAX56 "Rampe bei Timeout" VALUE 0x1D7922 ZF_kw_ui8_S5_S3 2540 UMR_MSEC__10_1_0_S5_S3 0 2540 /end CHARACTERISTIC
/begin CHARACTERISTIC T_RAMAX67 "Rampe bei Timeout" VALUE 0x1D7923 ZF_kw_ui8_S5_S3 2540 UMR_MSEC__10_1_0_S5_S3 0 2540 /end CHARACTERISTIC
/begin CHARACTERISTIC T_RAMAX78 "Rampe bei Timeout" VALUE 0x1D7924 ZF_kw_ui8_S5_S3 2540 UMR_MSEC__10_1_0_S5_S3 0 2540 /end CHARACTERISTIC
/begin CHARACTERISTIC T_RAMAX_1 "Rampe bei Timeout" VALUE 0x1D7916 ZF_kw_ui8_S5_S3 2540 UMR_MSEC__10_1_0_S5_S3 0 2540 /end CHARACTERISTIC
/begin CHARACTERISTIC T_RAMAX_2 "Rampe bei Timeout" VALUE 0x1D7917 ZF_kw_ui8_S5_S3 2540 UMR_MSEC__10_1_0_S5_S3 0 2540 /end CHARACTERISTIC
/begin CHARACTERISTIC T_RAMAX_3 "Rampe bei Timeout" VALUE 0x1D7918 ZF_kw_ui8_S5_S3 2540 UMR_MSEC__10_1_0_S5_S3 0 2540 /end CHARACTERISTIC
/begin CHARACTERISTIC T_RAMAX_4 "Rampe bei Timeout" VALUE 0x1D7919 ZF_kw_ui8_S5_S3 2540 UMR_MSEC__10_1_0_S5_S3 0 2540 /end CHARACTERISTIC
/begin CHARACTERISTIC T_RAMAX_5 "Rampe bei Timeout" VALUE 0x1D791A ZF_kw_ui8_S5_S3 2540 UMR_MSEC__10_1_0_S5_S3 0 2540 /end CHARACTERISTIC
/begin CHARACTERISTIC T_RAMAX_6 "Rampe bei Timeout" VALUE 0x1D791B ZF_kw_ui8_S5_S3 2540 UMR_MSEC__10_1_0_S5_S3 0 2540 /end CHARACTERISTIC
/begin CHARACTERISTIC T_RAMAX_7 "Rampe bei Timeout" VALUE 0x1D791C ZF_kw_ui8_S5_S3 2540 UMR_MSEC__10_1_0_S5_S3 0 2540 /end CHARACTERISTIC
/begin CHARACTERISTIC T_RAMAX_8 "Rampe bei Timeout" VALUE 0x1D791D ZF_kw_ui8_S5_S3 2540 UMR_MSEC__10_1_0_S5_S3 0 2540 /end CHARACTERISTIC
/begin CHARACTERISTIC T_RAMAX_R "Rampe bei Timeout" VALUE 0x1D7915 ZF_kw_ui8_S5_S3 2540 UMR_MSEC__10_1_0_S5_S3 0 2540 /end CHARACTERISTIC
/begin CHARACTERISTIC T_RAMEESPORT65 "Dauer Rampe ME bei Schaltungsende" VALUE 0x1D78B1 ZF_kw_ui8_S5_S3 2540 UMR_MSEC__10_1_0_S5_S3 0 2540 /end CHARACTERISTIC
/begin CHARACTERISTIC T_RAMEESPORT71 "Dauer Rampe ME bei Schaltungsende" VALUE 0x1D78C3 ZF_kw_ui8_S5_S3 2540 UMR_MSEC__10_1_0_S5_S3 0 2540 /end CHARACTERISTIC
/begin CHARACTERISTIC T_RAMEESPORT75 "Dauer Rampe ME bei Schaltungsende" VALUE 0x1D78C5 ZF_kw_ui8_S5_S3 2540 UMR_MSEC__10_1_0_S5_S3 0 2540 /end CHARACTERISTIC
/begin CHARACTERISTIC T_RAMEESPORT76 "Dauer Rampe ME bei Schaltungsende" VALUE 0x1D78B3 ZF_kw_ui8_S5_S3 2540 UMR_MSEC__10_1_0_S5_S3 0 2540 /end CHARACTERISTIC
/begin CHARACTERISTIC T_RAMEESPORT82 "Dauer Rampe ME bei Schaltungsende" VALUE 0x1D78C7 ZF_kw_ui8_S5_S3 2540 UMR_MSEC__10_1_0_S5_S3 0 2540 /end CHARACTERISTIC
/begin CHARACTERISTIC T_RAMEESPORT84 "Dauer Rampe ME bei Schaltungsende" VALUE 0x1D78C9 ZF_kw_ui8_S5_S3 2540 UMR_MSEC__10_1_0_S5_S3 0 2540 /end CHARACTERISTIC
/begin CHARACTERISTIC T_RAMEESPORT86 "Dauer Rampe ME bei Schaltungsende" VALUE 0x1D78CB ZF_kw_ui8_S5_S3 2540 UMR_MSEC__10_1_0_S5_S3 0 2540 /end CHARACTERISTIC
/begin CHARACTERISTIC T_RAMEESPORT87 "Dauer Rampe ME bei Schaltungsende" VALUE 0x1D78B5 ZF_kw_ui8_S5_S3 2540 UMR_MSEC__10_1_0_S5_S3 0 2540 /end CHARACTERISTIC
/begin CHARACTERISTIC T_SYNMENACHESPORT65 "Zeit vor/nach Erkennen synchron fuer Ende Nach-ME" VALUE 0x1D78B2 ZF_kw_ui8_S5_S3 2550 UMR_MSEC__10_1_M128_S5_S3 -1280 1270 /end CHARACTERISTIC
/begin CHARACTERISTIC T_SYNMENACHESPORT71 "Zeit vor/nach Erkennen synchron fuer Ende Nach-ME" VALUE 0x1D78C4 ZF_kw_ui8_S5_S3 2550 UMR_MSEC__10_1_M128_S5_S3 -1280 1270 /end CHARACTERISTIC
/begin CHARACTERISTIC T_SYNMENACHESPORT75 "Zeit vor/nach Erkennen synchron fuer Ende Nach-ME" VALUE 0x1D78C6 ZF_kw_ui8_S5_S3 2550 UMR_MSEC__10_1_M128_S5_S3 -1280 1270 /end CHARACTERISTIC
/begin CHARACTERISTIC T_SYNMENACHESPORT76 "Zeit vor/nach Erkennen synchron fuer Ende Nach-ME" VALUE 0x1D78B4 ZF_kw_ui8_S5_S3 2550 UMR_MSEC__10_1_M128_S5_S3 -1280 1270 /end CHARACTERISTIC
/begin CHARACTERISTIC T_SYNMENACHESPORT82 "Zeit vor/nach Erkennen synchron fuer Ende Nach-ME" VALUE 0x1D78C8 ZF_kw_ui8_S5_S3 2550 UMR_MSEC__10_1_M128_S5_S3 -1280 1270 /end CHARACTERISTIC
/begin CHARACTERISTIC T_SYNMENACHESPORT84 "Zeit vor/nach Erkennen synchron fuer Ende Nach-ME" VALUE 0x1D78CA ZF_kw_ui8_S5_S3 2550 UMR_MSEC__10_1_M128_S5_S3 -1280 1270 /end CHARACTERISTIC
/begin CHARACTERISTIC T_SYNMENACHESPORT86 "Zeit vor/nach Erkennen synchron fuer Ende Nach-ME" VALUE 0x1D78CC ZF_kw_ui8_S5_S3 2550 UMR_MSEC__10_1_M128_S5_S3 -1280 1270 /end CHARACTERISTIC
/begin CHARACTERISTIC T_SYNMENACHESPORT87 "Zeit vor/nach Erkennen synchron fuer Ende Nach-ME" VALUE 0x1D78B6 ZF_kw_ui8_S5_S3 2550 UMR_MSEC__10_1_M128_S5_S3 -1280 1270 /end CHARACTERISTIC
/begin CHARACTERISTIC T_SYNMERUECKFILTERE21 "Zeit fuer Ende Rueckfilterung pos. ME" VALUE 0x1D78CD ZF_kw_ui8_S5_S3 2550 UMR_MSEC__10_1_M128_S5_S3 -1280 1270 /end CHARACTERISTIC
/begin CHARACTERISTIC T_SYNMERUECKFILTERE32 "Zeit fuer Ende Rueckfilterung pos. ME" VALUE 0x1D78CE ZF_kw_ui8_S5_S3 2550 UMR_MSEC__10_1_M128_S5_S3 -1280 1270 /end CHARACTERISTIC
/begin CHARACTERISTIC T_SYNMERUECKFILTERE43 "Zeit fuer Ende Rueckfilterung pos. ME" VALUE 0x1D78CF ZF_kw_ui8_S5_S3 2550 UMR_MSEC__10_1_M128_S5_S3 -1280 1270 /end CHARACTERISTIC
/begin CHARACTERISTIC T_SYNMERUECKFILTERE54 "Zeit fuer Ende Rueckfilterung pos. ME" VALUE 0x1D78D0 ZF_kw_ui8_S5_S3 2550 UMR_MSEC__10_1_M128_S5_S3 -1280 1270 /end CHARACTERISTIC
/begin CHARACTERISTIC T_SYNMERUECKFILTERE65 "Zeit fuer Ende Rueckfilterung pos. ME" VALUE 0x1D78D1 ZF_kw_ui8_S5_S3 2550 UMR_MSEC__10_1_M128_S5_S3 -1280 1270 /end CHARACTERISTIC
/begin CHARACTERISTIC T_SYNMERUECKFILTERE76 "Zeit fuer Ende Rueckfilterung pos. ME" VALUE 0x1D78D2 ZF_kw_ui8_S5_S3 2550 UMR_MSEC__10_1_M128_S5_S3 -1280 1270 /end CHARACTERISTIC
/begin CHARACTERISTIC T_SYNMERUECKFILTERE87 "Zeit fuer Ende Rueckfilterung pos. ME" VALUE 0x1D78D3 ZF_kw_ui8_S5_S3 2550 UMR_MSEC__10_1_M128_S5_S3 -1280 1270 /end CHARACTERISTIC
/begin CHARACTERISTIC T_SYNMERUECKFILTERESP31 "Zeit fuer Ende Rueckfilterung pos. ME" VALUE 0x1D78D4 ZF_kw_ui8_S5_S3 2550 UMR_MSEC__10_1_M128_S5_S3 -1280 1270 /end CHARACTERISTIC
/begin CHARACTERISTIC T_SYNMERUECKFILTERESP42 "Zeit fuer Ende Rueckfilterung pos. ME" VALUE 0x1D78D5 ZF_kw_ui8_S5_S3 2550 UMR_MSEC__10_1_M128_S5_S3 -1280 1270 /end CHARACTERISTIC
/begin CHARACTERISTIC T_SYNMERUECKFILTERESP51 "Zeit fuer Ende Rueckfilterung pos. ME" VALUE 0x1D78D6 ZF_kw_ui8_S5_S3 2550 UMR_MSEC__10_1_M128_S5_S3 -1280 1270 /end CHARACTERISTIC
/begin CHARACTERISTIC T_SYNMERUECKFILTERESP53 "Zeit fuer Ende Rueckfilterung pos. ME" VALUE 0x1D78D7 ZF_kw_ui8_S5_S3 2550 UMR_MSEC__10_1_M128_S5_S3 -1280 1270 /end CHARACTERISTIC
/begin CHARACTERISTIC T_SYNMERUECKFILTERESP63 "Zeit fuer Ende Rueckfilterung pos. ME" VALUE 0x1D78D8 ZF_kw_ui8_S5_S3 2550 UMR_MSEC__10_1_M128_S5_S3 -1280 1270 /end CHARACTERISTIC
/begin CHARACTERISTIC T_SYNMERUECKFILTERESP64 "Zeit fuer Ende Rueckfilterung pos. ME" VALUE 0x1D78D9 ZF_kw_ui8_S5_S3 2550 UMR_MSEC__10_1_M128_S5_S3 -1280 1270 /end CHARACTERISTIC
/begin CHARACTERISTIC T_SYNMERUECKFILTERESP71 "Zeit fuer Ende Rueckfilterung pos. ME" VALUE 0x1D78DA ZF_kw_ui8_S5_S3 2550 UMR_MSEC__10_1_M128_S5_S3 -1280 1270 /end CHARACTERISTIC
/begin CHARACTERISTIC T_SYNMERUECKFILTERESP75 "Zeit fuer Ende Rueckfilterung pos. ME" VALUE 0x1D78DB ZF_kw_ui8_S5_S3 2550 UMR_MSEC__10_1_M128_S5_S3 -1280 1270 /end CHARACTERISTIC
/begin CHARACTERISTIC T_SYNMERUECKFILTERESP82 "Zeit fuer Ende Rueckfilterung pos. ME" VALUE 0x1D78DC ZF_kw_ui8_S5_S3 2550 UMR_MSEC__10_1_M128_S5_S3 -1280 1270 /end CHARACTERISTIC
/begin CHARACTERISTIC T_SYNMERUECKFILTERESP84 "Zeit fuer Ende Rueckfilterung pos. ME" VALUE 0x1D78DD ZF_kw_ui8_S5_S3 2550 UMR_MSEC__10_1_M128_S5_S3 -1280 1270 /end CHARACTERISTIC
/begin CHARACTERISTIC T_SYNMERUECKFILTERESP86 "Zeit fuer Ende Rueckfilterung pos. ME" VALUE 0x1D78DE ZF_kw_ui8_S5_S3 2550 UMR_MSEC__10_1_M128_S5_S3 -1280 1270 /end CHARACTERISTIC
/begin CHARACTERISTIC T_VPARKSPPN "Verzoegerung Zustand Parksperre geloest fuer P nach N" VALUE 0x1D78E4 ZF_kw_ui8_S5_S3 2540 UMR_MSEC__10_1_0_S5_S3 0 2540 /end CHARACTERISTIC
/begin CHARACTERISTIC VERSION_MVG "Versions-Nr des MvG - wird mit abgespeichertem EEPROM-Wert verglichen und loescht falls ungleich den MvG Speicher" VALUE 0x1D78E1 ZF_kw_ui8_S5_S3 255 UMR___1_1_0_S5_S3 0 255 /end CHARACTERISTIC
/begin CHARACTERISTIC WAERMEKAP_LAM "Wärmekapazität einer Stahllamelle der Kupplung" VALUE 0x1D86AA ZF_kw_ui16_S5_S3 0.999 UMR_J_GK_1_1000_0_S5_S3 0.001 1 /end CHARACTERISTIC
/begin FUNCTION jMoeSasRSP365_Fktn "Applikationesgroessen Instanz jMoeSasRSP365"
 /begin DEF_CHARACTERISTIC KF_FMESASMEHAUPTPOSESPORT65 KF_FMTMEHAUPTASPORT65 KF_MEHAUPTSPORT65 KF_MENACHSPORT65 KF_TSYNNTKFMTMEHAUPTESPORT65 KF_TVMTNMOTMEHAUPTSPORT65 KL_FMENACHESPORT65 KL_TSYNMENACHASPORT65 T_RAMEESPORT65 T_SYNMENACHESPORT65 /end DEF_CHARACTERISTIC
/end FUNCTION
/begin FUNCTION jMoeSasRSP371_Fktn "Applikationesgroessen Instanz jMoeSasRSP371"
 /begin DEF_CHARACTERISTIC KF_FMESASMEHAUPTPOSESPORT71 KF_FMTMEHAUPTASPORT71 KF_MEHAUPTSPORT71 KF_MENACHSPORT71 KF_TSYNNTKFMTMEHAUPTESPORT71 KF_TVMTNMOTMEHAUPTSPORT71 KL_FMENACHESPORT71 KL_TSYNMENACHASPORT71 T_RAMEESPORT71 T_SYNMENACHESPORT71 /end DEF_CHARACTERISTIC
/end FUNCTION
/begin FUNCTION jMoeSasRSP375_Fktn "Applikationesgroessen Instanz jMoeSasRSP375"
 /begin DEF_CHARACTERISTIC KF_FMESASMEHAUPTPOSESPORT75 KF_FMTMEHAUPTASPORT75 KF_MEHAUPTSPORT75 KF_MENACHSPORT75 KF_TSYNNTKFMTMEHAUPTESPORT75 KF_TVMTNMOTMEHAUPTSPORT75 KL_FMENACHESPORT75 KL_TSYNMENACHASPORT75 T_RAMEESPORT75 T_SYNMENACHESPORT75 /end DEF_CHARACTERISTIC
/end FUNCTION
/begin FUNCTION jMoeSasRSP376_Fktn "Applikationesgroessen Instanz jMoeSasRSP376"
 /begin DEF_CHARACTERISTIC KF_FMESASMEHAUPTPOSESPORT76 KF_FMTMEHAUPTASPORT76 KF_MEHAUPTSPORT76 KF_MENACHSPORT76 KF_TSYNNTKFMTMEHAUPTESPORT76 KF_TVMTNMOTMEHAUPTSPORT76 KL_FMENACHESPORT76 KL_TSYNMENACHASPORT76 T_RAMEESPORT76 T_SYNMENACHESPORT76 /end DEF_CHARACTERISTIC
/end FUNCTION
/begin FUNCTION jMoeSasRSP382_Fktn "Applikationesgroessen Instanz jMoeSasRSP382"
 /begin DEF_CHARACTERISTIC KF_FMESASMEHAUPTPOSESPORT82 KF_FMTMEHAUPTASPORT82 KF_MEHAUPTSPORT82 KF_MENACHSPORT82 KF_TSYNNTKFMTMEHAUPTESPORT82 KF_TVMTNMOTMEHAUPTSPORT82 KL_FMENACHESPORT82 KL_TSYNMENACHASPORT82 T_RAMEESPORT82 T_SYNMENACHESPORT82 /end DEF_CHARACTERISTIC
/end FUNCTION
/begin FUNCTION jMoeSasRSP384_Fktn "Applikationesgroessen Instanz jMoeSasRSP384"
 /begin DEF_CHARACTERISTIC KF_FMESASMEHAUPTPOSESPORT84 KF_FMTMEHAUPTASPORT84 KF_MEHAUPTSPORT84 KF_MENACHSPORT84 KF_TSYNNTKFMTMEHAUPTESPORT84 KF_TVMTNMOTMEHAUPTSPORT84 KL_FMENACHESPORT84 KL_TSYNMENACHASPORT84 T_RAMEESPORT84 T_SYNMENACHESPORT84 /end DEF_CHARACTERISTIC
/end FUNCTION
/begin FUNCTION jMoeSasRSP386_Fktn "Applikationesgroessen Instanz jMoeSasRSP386"
 /begin DEF_CHARACTERISTIC KF_FMESASMEHAUPTPOSESPORT86 KF_FMTMEHAUPTASPORT86 KF_MEHAUPTSPORT86 KF_MENACHSPORT86 KF_TSYNNTKFMTMEHAUPTESPORT86 KF_TVMTNMOTMEHAUPTSPORT86 KL_FMENACHESPORT86 KL_TSYNMENACHASPORT86 T_RAMEESPORT86 T_SYNMENACHESPORT86 /end DEF_CHARACTERISTIC
/end FUNCTION
/begin FUNCTION jMoeSasRSP387_Fktn "Applikationesgroessen Instanz jMoeSasRSP387"
 /begin DEF_CHARACTERISTIC KF_FMESASMEHAUPTPOSESPORT87 KF_FMTMEHAUPTASPORT87 KF_MEHAUPTSPORT87 KF_MENACHSPORT87 KF_TSYNNTKFMTMEHAUPTESPORT87 KF_TVMTNMOTMEHAUPTSPORT87 KL_FMENACHESPORT87 KL_TSYNMENACHASPORT87 T_RAMEESPORT87 T_SYNMENACHESPORT87 /end DEF_CHARACTERISTIC
/end FUNCTION
/begin FUNCTION jMoeSasRSS21_Fktn "Applikationesgroessen Instanz jMoeSasRSS21"
 /begin DEF_CHARACTERISTIC KF_FMEVORLUFT21 KL_FMEPOSNGAB21 KL_MEKPOSCM21 KL_MEKREDCM21 T_SYNMERUECKFILTERE21 /end DEF_CHARACTERISTIC
/end FUNCTION
/begin FUNCTION jMoeSasRSS31_Fktn "Applikationesgroessen Instanz jMoeSasRSS31"
 /begin DEF_CHARACTERISTIC KF_FMEVORLUFTSP31 KL_FMEPOSNGABSP31 KL_MEKPOSCMSP31 KL_MEKREDCMSP31 T_SYNMERUECKFILTERESP31 /end DEF_CHARACTERISTIC
/end FUNCTION
/begin FUNCTION jMoeSasRSS32_Fktn "Applikationesgroessen Instanz jMoeSasRSS32"
 /begin DEF_CHARACTERISTIC KF_FMEVORLUFT32 KL_FMEPOSNGAB32 KL_MEKPOSCM32 KL_MEKREDCM32 T_SYNMERUECKFILTERE32 /end DEF_CHARACTERISTIC
/end FUNCTION
/begin FUNCTION jMoeSasRSS42_Fktn "Applikationesgroessen Instanz jMoeSasRSS42"
 /begin DEF_CHARACTERISTIC KF_FMEVORLUFTSP42 KL_FMEPOSNGABSP42 KL_MEKPOSCMSP42 KL_MEKREDCMSP42 T_SYNMERUECKFILTERESP42 /end DEF_CHARACTERISTIC
/end FUNCTION
/begin FUNCTION jMoeSasRSS43_Fktn "Applikationesgroessen Instanz jMoeSasRSS43"
 /begin DEF_CHARACTERISTIC KF_FMEVORLUFT43 KL_FMEPOSNGAB43 KL_MEKPOSCM43 KL_MEKREDCM43 T_SYNMERUECKFILTERE43 /end DEF_CHARACTERISTIC
/end FUNCTION
/begin FUNCTION jMoeSasRSS51_Fktn "Applikationesgroessen Instanz jMoeSasRSS51"
 /begin DEF_CHARACTERISTIC KF_FMEVORLUFTSP51 KL_FMEPOSNGABSP51 KL_MEKPOSCMSP51 KL_MEKREDCMSP51 T_SYNMERUECKFILTERESP51 /end DEF_CHARACTERISTIC
/end FUNCTION
/begin FUNCTION jMoeSasRSS53_Fktn "Applikationesgroessen Instanz jMoeSasRSS53"
 /begin DEF_CHARACTERISTIC KF_FMEVORLUFTSP53 KL_FMEPOSNGABSP53 KL_MEKPOSCMSP53 KL_MEKREDCMSP53 T_SYNMERUECKFILTERESP53 /end DEF_CHARACTERISTIC
/end FUNCTION
/begin FUNCTION jMoeSasRSS54_Fktn "Applikationesgroessen Instanz jMoeSasRSS54"
 /begin DEF_CHARACTERISTIC KF_FMEVORLUFT54 KL_FMEPOSNGAB54 KL_MEKPOSCM54 KL_MEKREDCM54 T_SYNMERUECKFILTERE54 /end DEF_CHARACTERISTIC
/end FUNCTION
/begin FUNCTION jMoeSasRSS63_Fktn "Applikationesgroessen Instanz jMoeSasRSS63"
 /begin DEF_CHARACTERISTIC KF_FMEVORLUFTSP63 KL_FMEPOSNGABSP63 KL_MEKPOSCMSP63 KL_MEKREDCMSP63 T_SYNMERUECKFILTERESP63 /end DEF_CHARACTERISTIC
/end FUNCTION
/begin FUNCTION jMoeSasRSS64_Fktn "Applikationesgroessen Instanz jMoeSasRSS64"
 /begin DEF_CHARACTERISTIC KF_FMEVORLUFTSP64 KL_FMEPOSNGABSP64 KL_MEKPOSCMSP64 KL_MEKREDCMSP64 T_SYNMERUECKFILTERESP64 /end DEF_CHARACTERISTIC
/end FUNCTION
/begin FUNCTION jMoeSasRSS65_Fktn "Applikationesgroessen Instanz jMoeSasRSS65"
 /begin DEF_CHARACTERISTIC KF_FMEVORLUFT65 KL_FMEPOSNGAB65 KL_MEKPOSCM65 KL_MEKREDCM65 T_SYNMERUECKFILTERE65 /end DEF_CHARACTERISTIC
/end FUNCTION
/begin FUNCTION jMoeSasRSS71_Fktn "Applikationesgroessen Instanz jMoeSasRSS71"
 /begin DEF_CHARACTERISTIC KF_FMEVORLUFTSP71 KL_FMEPOSNGABSP71 KL_MEKPOSCMSP71 KL_MEKREDCMSP71 T_SYNMERUECKFILTERESP71 /end DEF_CHARACTERISTIC
/end FUNCTION
/begin FUNCTION jMoeSasRSS75_Fktn "Applikationesgroessen Instanz jMoeSasRSS75"
 /begin DEF_CHARACTERISTIC KF_FMEVORLUFTSP75 KL_FMEPOSNGABSP75 KL_MEKPOSCMSP75 KL_MEKREDCMSP75 T_SYNMERUECKFILTERESP75 /end DEF_CHARACTERISTIC
/end FUNCTION
/begin FUNCTION jMoeSasRSS76_Fktn "Applikationesgroessen Instanz jMoeSasRSS76"
 /begin DEF_CHARACTERISTIC KF_FMEVORLUFT76 KL_FMEPOSNGAB76 KL_MEKPOSCM76 KL_MEKREDCM76 T_SYNMERUECKFILTERE76 /end DEF_CHARACTERISTIC
/end FUNCTION
/begin FUNCTION jMoeSasRSS82_Fktn "Applikationesgroessen Instanz jMoeSasRSS82"
 /begin DEF_CHARACTERISTIC KF_FMEVORLUFTSP82 KL_FMEPOSNGABSP82 KL_MEKPOSCMSP82 KL_MEKREDCMSP82 T_SYNMERUECKFILTERESP82 /end DEF_CHARACTERISTIC
/end FUNCTION
/begin FUNCTION jMoeSasRSS84_Fktn "Applikationesgroessen Instanz jMoeSasRSS84"
 /begin DEF_CHARACTERISTIC KF_FMEVORLUFTSP84 KL_FMEPOSNGABSP84 KL_MEKPOSCMSP84 KL_MEKREDCMSP84 T_SYNMERUECKFILTERESP84 /end DEF_CHARACTERISTIC
/end FUNCTION
/begin FUNCTION jMoeSasRSS86_Fktn "Applikationesgroessen Instanz jMoeSasRSS86"
 /begin DEF_CHARACTERISTIC KF_FMEVORLUFTSP86 KL_FMEPOSNGABSP86 KL_MEKPOSCMSP86 KL_MEKREDCMSP86 T_SYNMERUECKFILTERESP86 /end DEF_CHARACTERISTIC
/end FUNCTION
/begin FUNCTION jMoeSasRSS87_Fktn "Applikationesgroessen Instanz jMoeSasRSS87"
 /begin DEF_CHARACTERISTIC KF_FMEVORLUFT87 KL_FMEPOSNGAB87 KL_MEKPOSCM87 KL_MEKREDCM87 T_SYNMERUECKFILTERE87 /end DEF_CHARACTERISTIC
/end FUNCTION
/begin FUNCTION jMoeZwrHSP112_Fktn "Applikationesgroessen Instanz jMoeZwrHSP112"
 /begin DEF_CHARACTERISTIC KF_FTSYNNTMEHAUPTE12 KF_TVMEA12 KF_TVMEA12_EL KL_TSYNMTMEHAUPTE12 KL_TSYNMTMEHAUPTE12_EL K_FMEHAUPTA12 K_FMEHAUPTA12_EL T_FMEHAUPTA12 /end DEF_CHARACTERISTIC
/end FUNCTION
/begin FUNCTION jMoeZwrHSP123_Fktn "Applikationesgroessen Instanz jMoeZwrHSP123"
 /begin DEF_CHARACTERISTIC KF_FTSYNNTMEHAUPTE23 KF_TVMEA23 KF_TVMEA23_EL KL_TSYNMTMEHAUPTE23 KL_TSYNMTMEHAUPTE23_EL K_FMEHAUPTA23 K_FMEHAUPTA23_EL T_FMEHAUPTA23 /end DEF_CHARACTERISTIC
/end FUNCTION
/begin FUNCTION jMoeZwrHSP134_Fktn "Applikationesgroessen Instanz jMoeZwrHSP134"
 /begin DEF_CHARACTERISTIC KF_FTSYNNTMEHAUPTE34 KF_TVMEA34 KF_TVMEA34_EL KL_TSYNMTMEHAUPTE34 KL_TSYNMTMEHAUPTE34_EL K_FMEHAUPTA34 K_FMEHAUPTA34_EL T_FMEHAUPTA34 /end DEF_CHARACTERISTIC
/end FUNCTION
/begin FUNCTION jMoeZwrHSP145_Fktn "Applikationesgroessen Instanz jMoeZwrHSP145"
 /begin DEF_CHARACTERISTIC KF_FTSYNNTMEHAUPTE45 KF_TVMEA45 KF_TVMEA45_EL KL_TSYNMTMEHAUPTE45 KL_TSYNMTMEHAUPTE45_EL K_FMEHAUPTA45 K_FMEHAUPTA45_EL T_FMEHAUPTA45 /end DEF_CHARACTERISTIC
/end FUNCTION
/begin FUNCTION jMoeZwrHSP156_Fktn "Applikationesgroessen Instanz jMoeZwrHSP156"
 /begin DEF_CHARACTERISTIC KF_FTSYNNTMEHAUPTE56 KF_TVMEA56 KF_TVMEA56_EL KL_TSYNMTMEHAUPTE56 KL_TSYNMTMEHAUPTE56_EL K_FMEHAUPTA56 K_FMEHAUPTA56_EL T_FMEHAUPTA56 /end DEF_CHARACTERISTIC
/end FUNCTION
/begin FUNCTION jMoeZwrHSP167_Fktn "Applikationesgroessen Instanz jMoeZwrHSP167"
 /begin DEF_CHARACTERISTIC KF_FTSYNNTMEHAUPTE67 KF_TVMEA67 KF_TVMEA67_EL KL_TSYNMTMEHAUPTE67 KL_TSYNMTMEHAUPTE67_EL K_FMEHAUPTA67 K_FMEHAUPTA67_EL T_FMEHAUPTA67 /end DEF_CHARACTERISTIC
/end FUNCTION
/begin FUNCTION jMoeZwrHSP178_Fktn "Applikationesgroessen Instanz jMoeZwrHSP178"
 /begin DEF_CHARACTERISTIC KF_FTSYNNTMEHAUPTE78 KF_TVMEA78 KF_TVMEA78_EL KL_TSYNMTMEHAUPTE78 KL_TSYNMTMEHAUPTE78_EL K_FMEHAUPTA78 K_FMEHAUPTA78_EL T_FMEHAUPTA78 /end DEF_CHARACTERISTIC
/end FUNCTION
/begin FUNCTION jMoeZwrHSP212_Fktn "Applikationesgroessen Instanz jMoeZwrHSP212"
 /begin DEF_CHARACTERISTIC KF_FTSYNNTMEHAUPTESP12 KF_TVMEASP12 KL_TSYNMTMEHAUPTESP12 K_FMEHAUPTASP12 T_FMEHAUPTASP12 /end DEF_CHARACTERISTIC
/end FUNCTION
/begin FUNCTION jMoeZwrHSP223_Fktn "Applikationesgroessen Instanz jMoeZwrHSP223"
 /begin DEF_CHARACTERISTIC KF_FTSYNNTMEHAUPTESP23 KF_TVMEASP23 KL_TSYNMTMEHAUPTESP23 K_FMEHAUPTASP23 T_FMEHAUPTASP23 /end DEF_CHARACTERISTIC
/end FUNCTION
/begin FUNCTION jMoeZwrHSP234_Fktn "Applikationesgroessen Instanz jMoeZwrHSP234"
 /begin DEF_CHARACTERISTIC KF_FTSYNNTMEHAUPTESP34 KF_TVMEASP34 KL_TSYNMTMEHAUPTESP34 K_FMEHAUPTASP34 T_FMEHAUPTASP34 /end DEF_CHARACTERISTIC
/end FUNCTION
/begin FUNCTION jMoeZwrHSP245_Fktn "Applikationesgroessen Instanz jMoeZwrHSP245"
 /begin DEF_CHARACTERISTIC KF_FTSYNNTMEHAUPTESP45 KF_TVMEASP45 KL_TSYNMTMEHAUPTESP45 K_FMEHAUPTASP45 T_FMEHAUPTASP45 /end DEF_CHARACTERISTIC
/end FUNCTION
/begin FUNCTION jMoeZwrHSP256_Fktn "Applikationesgroessen Instanz jMoeZwrHSP256"
 /begin DEF_CHARACTERISTIC KF_FTSYNNTMEHAUPTESP56 KF_TVMEASP56 KL_TSYNMTMEHAUPTESP56 K_FMEHAUPTASP56 T_FMEHAUPTASP56 /end DEF_CHARACTERISTIC
/end FUNCTION
/begin FUNCTION jMoeZwrHSP267_Fktn "Applikationesgroessen Instanz jMoeZwrHSP267"
 /begin DEF_CHARACTERISTIC KF_FTSYNNTMEHAUPTESP67 KF_TVMEASP67 KL_TSYNMTMEHAUPTESP67 K_FMEHAUPTASP67 T_FMEHAUPTASP67 /end DEF_CHARACTERISTIC
/end FUNCTION
/begin FUNCTION jMoeZwrHSP278_Fktn "Applikationesgroessen Instanz jMoeZwrHSP278"
 /begin DEF_CHARACTERISTIC KF_FTSYNNTMEHAUPTESP78 KF_TVMEASP78 KL_TSYNMTMEHAUPTESP78 K_FMEHAUPTASP78 T_FMEHAUPTASP78 /end DEF_CHARACTERISTIC
/end FUNCTION
/begin FUNCTION jMoeZwrHSP312_Fktn "Applikationesgroessen Instanz jMoeZwrHSP312"
 /begin DEF_CHARACTERISTIC KF_FTSYNNTMEHAUPTESPORT12 KF_TVMEASPORT12 KL_TSYNMTMEHAUPTESPORT12 K_FMEHAUPTASPORT12 T_FMEHAUPTASPORT12 /end DEF_CHARACTERISTIC
/end FUNCTION
/begin FUNCTION jMoeZwrHSP323_Fktn "Applikationesgroessen Instanz jMoeZwrHSP323"
 /begin DEF_CHARACTERISTIC KF_FTSYNNTMEHAUPTESPORT23 KF_TVMEASPORT23 KL_TSYNMTMEHAUPTESPORT23 K_FMEHAUPTASPORT23 T_FMEHAUPTASPORT23 /end DEF_CHARACTERISTIC
/end FUNCTION
/begin FUNCTION jMoeZwrHSP334_Fktn "Applikationesgroessen Instanz jMoeZwrHSP334"
 /begin DEF_CHARACTERISTIC KF_FTSYNNTMEHAUPTESPORT34 KF_TVMEASPORT34 KL_TSYNMTMEHAUPTESPORT34 K_FMEHAUPTASPORT34 T_FMEHAUPTASPORT34 /end DEF_CHARACTERISTIC
/end FUNCTION
/begin FUNCTION jMoeZwrHSP345_Fktn "Applikationesgroessen Instanz jMoeZwrHSP345"
 /begin DEF_CHARACTERISTIC KF_FTSYNNTMEHAUPTESPORT45 KF_TVMEASPORT45 KL_TSYNMTMEHAUPTESPORT45 K_FMEHAUPTASPORT45 T_FMEHAUPTASPORT45 /end DEF_CHARACTERISTIC
/end FUNCTION
/begin FUNCTION jMoeZwrHSP356_Fktn "Applikationesgroessen Instanz jMoeZwrHSP356"
 /begin DEF_CHARACTERISTIC KF_FTSYNNTMEHAUPTESPORT56 KF_TVMEASPORT56 KL_TSYNMTMEHAUPTESPORT56 K_FMEHAUPTASPORT56 T_FMEHAUPTASPORT56 /end DEF_CHARACTERISTIC
/end FUNCTION
/begin FUNCTION jMoeZwrHSP367_Fktn "Applikationesgroessen Instanz jMoeZwrHSP367"
 /begin DEF_CHARACTERISTIC KF_FTSYNNTMEHAUPTESPORT67 KF_TVMEASPORT67 KL_TSYNMTMEHAUPTESPORT67 K_FMEHAUPTASPORT67 T_FMEHAUPTASPORT67 /end DEF_CHARACTERISTIC
/end FUNCTION
/begin FUNCTION jMoeZwrHSP378_Fktn "Applikationesgroessen Instanz jMoeZwrHSP378"
 /begin DEF_CHARACTERISTIC KF_FTSYNNTMEHAUPTESPORT78 KF_TVMEASPORT78 KL_TSYNMTMEHAUPTESPORT78 K_FMEHAUPTASPORT78 T_FMEHAUPTASPORT78 /end DEF_CHARACTERISTIC
/end FUNCTION
/begin FUNCTION jMonMvGet_Fktn "Applikationesgroessen Instanz jMonMvGet"
 /begin DEF_CHARACTERISTIC SWI_MVGIEPLOESCH SWI_MVGIEPRES SWI_MVG_AKT SWI_MVG_LOESCH TAB_MVG_CGETR TAB_MVG_MOTSTART TAB_MVG_MT TAB_MVG_NT TS_MVG_CGETR TS_MVG_DATENREF VERSION_MVG /end DEF_CHARACTERISTIC
/end FUNCTION
/begin FUNCTION jMvsZentr_Fktn "Applikationesgroessen Instanz jMvsZentr"
 /begin DEF_CHARACTERISTIC KL_TVPARKSPCGNP KL_TVPSEIN N_ABBRTVPSEIN PS_BRTVPSEIN T_MAXOUT11 T_MINOUT11 T_VPARKSPPN /end DEF_CHARACTERISTIC
/end FUNCTION
/begin FUNCTION jNvrContr_Fktn "Applikationesgroessen Instanz jNvrContr" /begin DEF_CHARACTERISTIC SWI_ADADATEN SWI_EEPROM_CHECKSUMME SWI_EEPROM_INIT /end DEF_CHARACTERISTIC /end FUNCTION
/begin FUNCTION jSasGeaAl_Fktn "Applikationesgroessen Instanz jSasGeaAl"
 /begin DEF_CHARACTERISTIC KL_PORASASABBRUCHGA ND_SYNABBRGA_D ND_SYNABBRGA_R PO_FDNR PO_FGEDR PO_FGERD PO_FRND PO_SDGEDR PO_SDGERD P_GAKUPPC T_POGERDDR /end DEF_CHARACTERISTIC
/end FUNCTION
/begin FUNCTION jSasGloAl_Fktn "Applikationesgroessen Instanz jSasGloAl"
 /begin DEF_CHARACTERISTIC CS_GABBHS CS_GVERSHS CS_GVERSRS CS_OBSP CS_OBSPORT CS_UNSPHS CS_UNSPORTHS CS_UNSPORTRS CS_UNSPRS DKIS_VERS F_VSYNABBHS KL_CK_MMOTMAX KL_NDSGANGWECHSEL KL_TFNGDSYNZIELGANG MG_MOTMAXCKAUF NGS_ABVERSOB NGS_ABVERSUN NS_ABSSCHRHS NS_ABSSCHRHS1 NS_ABSSCHRRS NS_ABSSCHRRS1 NS_MOTVERS NS_NTVERSHS NS_NTVERSRS NS_TSSCHR SCHWELLE_NDSYN SWI_ABBRS SWI_ABBSYNISTHS SWI_ERRSP SWI_HINSYN SWI_SCHLEPPVERS SWI_START_GANGWECHSEL SWI_UMSPLABRS SWI_VERHVERSMMOTMAX TAB_ABKOEF_KUPPLUNG_AUF TAB_ABKOEF_KUPPLUNG_ZU TAB_F_KORCKUPPL TAB_GESAMTMASSE TAB_GESAMTREIBFLAECHE TAB_LMAXZULKAB TAB_LMAXZULKZU TAB_MASSE_LAM TAB_MSTOBSP TAB_MSTUNSP TAB_MSTVERS TAB_NABFAKTORKAB TAB_NABFAKTORKZU TAB_NSABSP TAB_NTFAKTORKAB TAB_NTFAKTORKZU TAB_N_LAM TAB_REIBFAKTORKAB_1 TAB_REIBFAKTORKAB_2 TAB_REIBFAKTORKZU_1 TAB_REIBFAKTORKZU_2 TAB_SWIECOMODE TAB_SWISPONTHS TAB_SWISPONTRS TAB_SWIVERSFOLGE TAB_TV_GANGWECHSEL TAB_WMAXZULKAB TAB_WMAXZULKZU T_ABBHSZ T_FNGABSAS T_FPKABKUPBEL T_FPKZUKUPBEL T_MINGANGFLAG T_MMOTMAXCKAB WAERMEKAP_LAM /end DEF_CHARACTERISTIC
/end FUNCTION
/begin FUNCTION jSasGloGeG1_Fktn "Applikationesgroessen Instanz jSasGloGeG1" /begin DEF_CHARACTERISTIC KL_TMAXCGGA_1 KL_TMAXCG_1 T_RAMAX_1 /end DEF_CHARACTERISTIC /end FUNCTION
/begin FUNCTION jSasGloGeG2_Fktn "Applikationesgroessen Instanz jSasGloGeG2" /begin DEF_CHARACTERISTIC KL_TMAXCGGA_2 KL_TMAXCG_2 T_RAMAX_2 /end DEF_CHARACTERISTIC /end FUNCTION
/begin FUNCTION jSasGloGeG3_Fktn "Applikationesgroessen Instanz jSasGloGeG3" /begin DEF_CHARACTERISTIC KL_TMAXCGGA_3 KL_TMAXCG_3 T_RAMAX_3 /end DEF_CHARACTERISTIC /end FUNCTION
/begin FUNCTION jSasGloGeG4_Fktn "Applikationesgroessen Instanz jSasGloGeG4" /begin DEF_CHARACTERISTIC KL_TMAXCGGA_4 KL_TMAXCG_4 T_RAMAX_4 /end DEF_CHARACTERISTIC /end FUNCTION
/begin FUNCTION jSasGloGeG5_Fktn "Applikationesgroessen Instanz jSasGloGeG5" /begin DEF_CHARACTERISTIC KL_TMAXCGGA_5 KL_TMAXCG_5 T_RAMAX_5 /end DEF_CHARACTERISTIC /end FUNCTION
/begin FUNCTION jSasGloGeG6_Fktn "Applikationesgroessen Instanz jSasGloGeG6" /begin DEF_CHARACTERISTIC KL_TMAXCGGA_6 KL_TMAXCG_6 T_RAMAX_6 /end DEF_CHARACTERISTIC /end FUNCTION
/begin FUNCTION jSasGloGeG7_Fktn "Applikationesgroessen Instanz jSasGloGeG7" /begin DEF_CHARACTERISTIC KL_TMAXCGGA_7 KL_TMAXCG_7 T_RAMAX_7 /end DEF_CHARACTERISTIC /end FUNCTION
/begin FUNCTION jSasGloGeG8_Fktn "Applikationesgroessen Instanz jSasGloGeG8" /begin DEF_CHARACTERISTIC KL_TMAXCGGA_8 KL_TMAXCG_8 T_RAMAX_8 /end DEF_CHARACTERISTIC /end FUNCTION
/begin FUNCTION jSasGloGeGR_Fktn "Applikationesgroessen Instanz jSasGloGeGR" /begin DEF_CHARACTERISTIC KL_TMAXCGGA_R KL_TMAXCG_R T_RAMAX_R /end DEF_CHARACTERISTIC /end FUNCTION
/begin FUNCTION jSasGloHSS12_Fktn "Applikationesgroessen Instanz jSasGloHSS12"
 /begin DEF_CHARACTERISTIC HYS_NGS_VERIAE12 KL_TMAXCG12 MG_MMOTMAXVERHSSAUF12 M_MOTMAXVERHSS12 NGS_VERIAE12 NS_SYNISTE12 NS_TABB12 NS_VERSIAE12 T_RAMAX12 /end DEF_CHARACTERISTIC
/end FUNCTION
/begin FUNCTION jSasGloHSS23_Fktn "Applikationesgroessen Instanz jSasGloHSS23"
 /begin DEF_CHARACTERISTIC HYS_NGS_VERIAE23 KL_TMAXCG23 MG_MMOTMAXVERHSSAUF23 M_MOTMAXVERHSS23 NGS_VERIAE23 NS_SYNISTE23 NS_TABB23 NS_VERSIAE23 T_RAMAX23 /end DEF_CHARACTERISTIC
/end FUNCTION
/begin FUNCTION jSasGloHSS34_Fktn "Applikationesgroessen Instanz jSasGloHSS34"
 /begin DEF_CHARACTERISTIC HYS_NGS_VERIAE34 KL_TMAXCG34 MG_MMOTMAXVERHSSAUF34 M_MOTMAXVERHSS34 NGS_VERIAE34 NS_SYNISTE34 NS_TABB34 NS_VERSIAE34 T_RAMAX34 /end DEF_CHARACTERISTIC
/end FUNCTION
/begin FUNCTION jSasGloHSS45_Fktn "Applikationesgroessen Instanz jSasGloHSS45"
 /begin DEF_CHARACTERISTIC HYS_NGS_VERIAE45 KL_TMAXCG45 MG_MMOTMAXVERHSSAUF45 M_MOTMAXVERHSS45 NGS_VERIAE45 NS_SYNISTE45 NS_TABB45 NS_VERSIAE45 T_RAMAX45 /end DEF_CHARACTERISTIC
/end FUNCTION
/begin FUNCTION jSasGloHSS56_Fktn "Applikationesgroessen Instanz jSasGloHSS56"
 /begin DEF_CHARACTERISTIC HYS_NGS_VERIAE56 KL_TMAXCG56 MG_MMOTMAXVERHSSAUF56 M_MOTMAXVERHSS56 NGS_VERIAE56 NS_SYNISTE56 NS_TABB56 NS_VERSIAE56 T_RAMAX56 /end DEF_CHARACTERISTIC
/end FUNCTION
/begin FUNCTION jSasGloHSS67_Fktn "Applikationesgroessen Instanz jSasGloHSS67"
 /begin DEF_CHARACTERISTIC HYS_NGS_VERIAE67 KL_TMAXCG67 MG_MMOTMAXVERHSSAUF67 M_MOTMAXVERHSS67 NGS_VERIAE67 NS_SYNISTE67 NS_TABB67 NS_VERSIAE67 T_RAMAX67 /end DEF_CHARACTERISTIC
/end FUNCTION
/begin FUNCTION jSasGloHSS78_Fktn "Applikationesgroessen Instanz jSasGloHSS78"
 /begin DEF_CHARACTERISTIC HYS_NGS_VERIAE78 KL_TMAXCG78 MG_MMOTMAXVERHSSAUF78 M_MOTMAXVERHSS78 NGS_VERIAE78 NS_SYNISTE78 NS_TABB78 NS_VERSIAE78 T_RAMAX78 /end DEF_CHARACTERISTIC
/end FUNCTION
/begin FUNCTION jSasGloKuKA_Fktn "Applikationesgroessen Instanz jSasGloKuKA"
 /begin DEF_CHARACTERISTIC KF_POKZUFOLSPORT_A KF_POKZUFOLSP_A KF_POKZUFOL_A KL_PO1FCG_A TAB_MVG_CKUP_A /end DEF_CHARACTERISTIC
/end FUNCTION
/begin FUNCTION jSasGloKuKB_Fktn "Applikationesgroessen Instanz jSasGloKuKB"
 /begin DEF_CHARACTERISTIC KF_POKZUFOLSPORT_B KF_POKZUFOLSP_B KF_POKZUFOL_B KL_PO1FCG_B TAB_MVG_CKUP_B /end DEF_CHARACTERISTIC
/end FUNCTION
/begin FUNCTION jSasGloKuKC_Fktn "Applikationesgroessen Instanz jSasGloKuKC"
 /begin DEF_CHARACTERISTIC KF_POKZUFOLSPORT_C KF_POKZUFOLSP_C KF_POKZUFOL_C KL_PO1FCG_C TAB_MVG_CKUP_C /end DEF_CHARACTERISTIC
/end FUNCTION
/begin FUNCTION jSasGloKuKD_Fktn "Applikationesgroessen Instanz jSasGloKuKD"
 /begin DEF_CHARACTERISTIC KF_POKZUFOLSPORT_D KF_POKZUFOLSP_D KF_POKZUFOL_D KL_PO1FCG_D TAB_MVG_CKUP_D /end DEF_CHARACTERISTIC
/end FUNCTION
/begin FUNCTION jSasGloKuKE_Fktn "Applikationesgroessen Instanz jSasGloKuKE"
 /begin DEF_CHARACTERISTIC KF_POKZUFOLSPORT_E KF_POKZUFOLSP_E KF_POKZUFOL_E KL_PO1FCG_E TAB_MVG_CKUP_E /end DEF_CHARACTERISTIC
/end FUNCTION
/begin FUNCTION jSasGloRSP121_Fktn "Applikationesgroessen Instanz jSasGloRSP121" /begin DEF_CHARACTERISTIC KF_TSYNCGMTHINSYN21 KF_TSYNCGMTHINSYNRA21 /end DEF_CHARACTERISTIC /end FUNCTION
/begin FUNCTION jSasGloRSP132_Fktn "Applikationesgroessen Instanz jSasGloRSP132" /begin DEF_CHARACTERISTIC KF_TSYNCGMTHINSYN32 KF_TSYNCGMTHINSYNRA32 /end DEF_CHARACTERISTIC /end FUNCTION
/begin FUNCTION jSasGloRSP143_Fktn "Applikationesgroessen Instanz jSasGloRSP143" /begin DEF_CHARACTERISTIC KF_TSYNCGMTHINSYN43 KF_TSYNCGMTHINSYNRA43 /end DEF_CHARACTERISTIC /end FUNCTION
/begin FUNCTION jSasGloRSP154_Fktn "Applikationesgroessen Instanz jSasGloRSP154" /begin DEF_CHARACTERISTIC KF_TSYNCGMTHINSYN54 KF_TSYNCGMTHINSYNRA54 /end DEF_CHARACTERISTIC /end FUNCTION
/begin FUNCTION jSasGloRSP165_Fktn "Applikationesgroessen Instanz jSasGloRSP165" /begin DEF_CHARACTERISTIC KF_TSYNCGMTHINSYN65 KF_TSYNCGMTHINSYNRA65 /end DEF_CHARACTERISTIC /end FUNCTION
/begin FUNCTION jSasGloRSP176_Fktn "Applikationesgroessen Instanz jSasGloRSP176" /begin DEF_CHARACTERISTIC KF_TSYNCGMTHINSYN76 KF_TSYNCGMTHINSYNRA76 /end DEF_CHARACTERISTIC /end FUNCTION
/begin FUNCTION jSasGloRSP187_Fktn "Applikationesgroessen Instanz jSasGloRSP187" /begin DEF_CHARACTERISTIC KF_TSYNCGMTHINSYN87 KF_TSYNCGMTHINSYNRA87 /end DEF_CHARACTERISTIC /end FUNCTION
/begin FUNCTION jSasGloRSP221_Fktn "Applikationesgroessen Instanz jSasGloRSP221" /begin DEF_CHARACTERISTIC KF_TSYNCGMTHINSYNRASP21 KF_TSYNCGMTHINSYNSP21 /end DEF_CHARACTERISTIC /end FUNCTION
/begin FUNCTION jSasGloRSP231_Fktn "Applikationesgroessen Instanz jSasGloRSP231" /begin DEF_CHARACTERISTIC KF_TSYNCGMTHINSYNRASP31 KF_TSYNCGMTHINSYNSP31 /end DEF_CHARACTERISTIC /end FUNCTION
/begin FUNCTION jSasGloRSP232_Fktn "Applikationesgroessen Instanz jSasGloRSP232" /begin DEF_CHARACTERISTIC KF_TSYNCGMTHINSYNRASP32 KF_TSYNCGMTHINSYNSP32 /end DEF_CHARACTERISTIC /end FUNCTION
/begin FUNCTION jSasGloRSP242_Fktn "Applikationesgroessen Instanz jSasGloRSP242" /begin DEF_CHARACTERISTIC KF_TSYNCGMTHINSYNRASP42 KF_TSYNCGMTHINSYNSP42 /end DEF_CHARACTERISTIC /end FUNCTION
/begin FUNCTION jSasGloRSP243_Fktn "Applikationesgroessen Instanz jSasGloRSP243" /begin DEF_CHARACTERISTIC KF_TSYNCGMTHINSYNRASP43 KF_TSYNCGMTHINSYNSP43 /end DEF_CHARACTERISTIC /end FUNCTION
/begin FUNCTION jSasGloRSP251_Fktn "Applikationesgroessen Instanz jSasGloRSP251" /begin DEF_CHARACTERISTIC KF_TSYNCGMTHINSYNRASP51 KF_TSYNCGMTHINSYNSP51 /end DEF_CHARACTERISTIC /end FUNCTION
/begin FUNCTION jSasGloRSP253_Fktn "Applikationesgroessen Instanz jSasGloRSP253" /begin DEF_CHARACTERISTIC KF_TSYNCGMTHINSYNRASP53 KF_TSYNCGMTHINSYNSP53 /end DEF_CHARACTERISTIC /end FUNCTION
/begin FUNCTION jSasGloRSP254_Fktn "Applikationesgroessen Instanz jSasGloRSP254" /begin DEF_CHARACTERISTIC KF_TSYNCGMTHINSYNRASP54 KF_TSYNCGMTHINSYNSP54 /end DEF_CHARACTERISTIC /end FUNCTION
/begin FUNCTION jSasGloRSP263_Fktn "Applikationesgroessen Instanz jSasGloRSP263" /begin DEF_CHARACTERISTIC KF_TSYNCGMTHINSYNRASP63 KF_TSYNCGMTHINSYNSP63 /end DEF_CHARACTERISTIC /end FUNCTION
/begin FUNCTION jSasGloRSP264_Fktn "Applikationesgroessen Instanz jSasGloRSP264" /begin DEF_CHARACTERISTIC KF_TSYNCGMTHINSYNRASP64 KF_TSYNCGMTHINSYNSP64 /end DEF_CHARACTERISTIC /end FUNCTION
/begin FUNCTION jSasGloRSP265_Fktn "Applikationesgroessen Instanz jSasGloRSP265" /begin DEF_CHARACTERISTIC KF_TSYNCGMTHINSYNRASP65 KF_TSYNCGMTHINSYNSP65 /end DEF_CHARACTERISTIC /end FUNCTION
/begin FUNCTION jSasGloRSP271_Fktn "Applikationesgroessen Instanz jSasGloRSP271" /begin DEF_CHARACTERISTIC KF_TSYNCGMTHINSYNRASP71 KF_TSYNCGMTHINSYNSP71 /end DEF_CHARACTERISTIC /end FUNCTION
/begin RECORD_LAYOUT ZF_kf_si16_S5_S3 FNC_VALUES 5 SWORD ROW_DIR DIRECT AXIS_PTS_X 3 SWORD INDEX_INCR DIRECT AXIS_PTS_Y 4 SWORD INDEX_INCR DIRECT NO_AXIS_PTS_X 1 ULONG NO_AXIS_PTS_Y 2 ULONG /end RECORD_LAYOUT
/begin RECORD_LAYOUT ZF_kf_ui8_S5_S3 FNC_VALUES 5 UBYTE ROW_DIR DIRECT AXIS_PTS_X 3 UBYTE INDEX_INCR DIRECT AXIS_PTS_Y 4 UBYTE INDEX_INCR DIRECT NO_AXIS_PTS_X 1 ULONG NO_AXIS_PTS_Y 2 ULONG /end RECORD_LAYOUT
/begin RECORD_LAYOUT ZF_kl_si16_S5_S3 FNC_VALUES 3 SWORD COLUMN_DIR DIRECT AXIS_PTS_X 2 SWORD INDEX_INCR DIRECT NO_AXIS_PTS_X 1 ULONG /end RECORD_LAYOUT
/begin RECORD_LAYOUT ZF_kl_ui16_S5_S3 FNC_VALUES 3 UWORD COLUMN_DIR DIRECT AXIS_PTS_X 2 UWORD INDEX_INCR DIRECT NO_AXIS_PTS_X 1 ULONG /end RECORD_LAYOUT
/begin RECORD_LAYOUT ZF_kl_ui8_S5_S3 FNC_VALUES 3 UBYTE COLUMN_DIR DIRECT AXIS_PTS_X 2 UBYTE INDEX_INCR DIRECT NO_AXIS_PTS_X 1 ULONG /end RECORD_LAYOUT
/begin RECORD_LAYOUT ZF_kw_bool8_S5_S3 FNC_VALUES 1 UBYTE COLUMN_DIR DIRECT /end RECORD_LAYOUT
/begin RECORD_LAYOUT ZF_kw_si16_S5_S3 FNC_VALUES 1 SWORD COLUMN_DIR DIRECT /end RECORD_LAYOUT
/begin RECORD_LAYOUT ZF_kw_ui16_S5_S3 FNC_VALUES 1 UWORD COLUMN_DIR DIRECT /end RECORD_LAYOUT
/begin RECORD_LAYOUT ZF_kw_ui8_S5_S3 FNC_VALUES 1 UBYTE COLUMN_DIR DIRECT /end RECORD_LAYOUT
/begin RECORD_LAYOUT ZF_tab2d_fl32_S5_S3 FNC_VALUES 3 FLOAT32_IEEE ROW_DIR DIRECT NO_AXIS_PTS_X 1 ULONG NO_AXIS_PTS_Y 2 ULONG /end RECORD_LAYOUT
/begin RECORD_LAYOUT ZF_tab2d_si16_S5_S3 FNC_VALUES 3 SWORD ROW_DIR DIRECT NO_AXIS_PTS_X 1 ULONG NO_AXIS_PTS_Y 2 ULONG /end RECORD_LAYOUT
/begin RECORD_LAYOUT ZF_tab2d_ui16_S5_S3 FNC_VALUES 3 UWORD ROW_DIR DIRECT NO_AXIS_PTS_X 1 ULONG NO_AXIS_PTS_Y 2 ULONG /end RECORD_LAYOUT
/begin RECORD_LAYOUT ZF_tab2d_ui8_S5_S3 FNC_VALUES 3 UBYTE ROW_DIR DIRECT NO_AXIS_PTS_X 1 ULONG NO_AXIS_PTS_Y 2 ULONG /end RECORD_LAYOUT
/begin RECORD_LAYOUT ZF_tab_si16_S5_S3 FNC_VALUES 2 SWORD COLUMN_DIR DIRECT NO_AXIS_PTS_X 1 ULONG /end RECORD_LAYOUT
/begin RECORD_LAYOUT ZF_tab_ui16_S5_S3 FNC_VALUES 2 UWORD COLUMN_DIR DIRECT NO_AXIS_PTS_X 1 ULONG /end RECORD_LAYOUT
/begin RECORD_LAYOUT ZF_tab_ui8_S5_S3 FNC_VALUES 2 UBYTE COLUMN_DIR DIRECT NO_AXIS_PTS_X 1 ULONG /end RECORD_LAYOUT
/end MODULE
/end PROJECT
