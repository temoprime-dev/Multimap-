ASAP2_VERSION 1 51
/begin PROJECT ZHBC8600 "Gen2_BMW_System_Supplier_Lib"
/begin MODULE CPP ""
/begin MOD_COMMON "" BYTE_ORDER MSB_FIRST ALIGNMENT_BYTE 1 ALIGNMENT_WORD 2 ALIGNMENT_LONG 4 ALIGNMENT_FLOAT32_IEEE 4 ALIGNMENT_FLOAT64_IEEE 1 /end MOD_COMMON
/begin COMPU_VTAB Conv.cModHydlg._.vnr_abgldat_im_boot_S5_S3 "Umrechnung fuer Messgroesse cModHydlg::vnr_abgldat_im_boot" TAB_VERB 15 0 "unbelegt" 4 "Hydraulik E26/1 oder E26/2" 5 "Hydraulik E26/5 (Hybrid)" 6 "Hydraulik E26/6 (E-Schaltung mit WFS)" 7 "Hydraulik E26/4 (M-Schaltung mit WFS)" 8 "Hydraulik E26/9 (Hybrid mit WFS)" 9 "Hydraulik E28/1 (FQ12)" 10 "Hydraulik E28/2 E28/3 E28/4 (9HP EP2)" 11 "Hydraulik E26/11 (Hybrid E-Schaltung mit WFS)" 12 "Belegt wegen E20/1 und E20/2" 13 "Hydraulik E26/14 (8HPTU E-Schaltung)" 14 "Hydraulik E26/16 (8HPTU E-Schaltung mit WFS)" 15 "E26/13 (Hybrid Gen3 E-Schaltung)" 16 "E26/18 (Hybrid Gen3 K11 E-Schaltung)" 17 "E26/23 (Hybrid Gen3 K11 E-Schaltung mit WFS)" DEFAULT_VALUE "" /end COMPU_VTAB
/begin COMPU_VTAB Conv.cModHydlg._.zugriff_abgleichdaten_S5_S3 "Umrechnung fuer Messgroesse cModHydlg::zugriff_abgleichdaten" TAB_VERB 5 0 "Abgleichdaten aus Boot" 1 "Abgleichdaten aus Appl. ROM wegen SWI_ABGLDAT" 2 "Abgleichdaten aus Appl. ROM wegen n. i.O. Pruefung" 3 "Abgleichdaten aus Appl. ROM wegen SWI und n.i.O. Pruefung" 4 "Abgleichdaten aus Appl. wegen Teachin" DEFAULT_VALUE "" /end COMPU_VTAB
/begin COMPU_VTAB Conv.cModPVorg._.f_anst_statisch_S5_S3 "Umrechnung fuer Messgroesse cModPVorg::f_anst_statisch" TAB_VERB 2 0 "FALSE" 1 "TRUE" DEFAULT_VALUE "" /end COMPU_VTAB
/begin COMPU_VTAB Conv.cModPVorg._.f_druck_vorgegeben_S5_S3 "Umrechnung fuer Messgroesse cModPVorg::f_druck_vorgegeben" TAB_VERB 2 0 "FALSE" 1 "TRUE" DEFAULT_VALUE "" /end COMPU_VTAB
/begin COMPU_VTAB Conv.cModPVorg._.fktn_druckvorgabe_S5_S3 "Umrechnung fuer Messgroesse cModPVorg::fktn_druckvorgabe" TAB_VERB 29 0 "DRUCKVORGABE_STATISCH" 1 "DRUCKVORGABE_KZU" 2 "DRUCKVORGABE_KAB" 3 "DRUCKVORGABE_VKZU" 4 "DRUCKVORGABE_VKAB" 5 "DRUCKVORGABE_GE1GA" 6 "DRUCKVORGABE_GE1GE" 7 "DRUCKVORGABE_GE2GA" 8 "DRUCKVORGABE_GE2GE" 9 "DRUCKVORGABE_GE3GA" 10 "DRUCKVORGABE_GE3GE" 11 "DRUCKVORGABE_KUPZU_IN_N" 12 "DRUCKVORGABE_KUP_PF_IN_N" 13 "DRUCKVORGABE_GSK" 15 "DRUCKVORGABE_PRUEFPULS" 16 "DRUCKVORGABE_KAB_KFL_WECHSEL" 17 "DRUCKVORGABE_ABSENK_AUSERHALB_SAS" 18 "DRUCKVORGABE_K0S" 19 "DRUCKVORGABE_EL_VORBEF" 20 "DRUCKVORGABE_SYSTEM" 21 "DRUCKVORGABE_WK" 22 "DRUCKVORGABE_GESYNC1GA" 23 "DRUCKVORGABE_GESYNC1GE" 24 "DRUCKVORGABE_GESYNC2GA" 25 "DRUCKVORGABE_GESYNC2GE" 26 "DRUCKVORGABE_TSTEDS" 27 "DRUCKVORGABE_PULS_LEER" 28 "DRUCKVORGABE_KUP_SEGELN" 29 "DRUCKVORGABE_KUP_PARKSPERRE" DEFAULT_VALUE "" /end COMPU_VTAB
/begin COMPU_VTAB Conv.cModPVorg._.typ_druckvorgabe_S5_S3 "Umrechnung fuer Messgroesse cModPVorg::typ_druckvorgabe" TAB_VERB 5 0 "STD_KUP_WIRKDRUCK_MIT_HYS" 1 "STD_KUP_WIRKDRUCK_OHNE_HYS" 2 "MANUELL_SF" 3 "MANUELL_ABSOLUTDRUCKVORGABE_MIT_HYS" 4 "ABSOLUTDRUCKVORGABE" DEFAULT_VALUE "" /end COMPU_VTAB
/begin COMPU_VTAB Conv.cMoeMesaf._.f_neuber_startz_hme_hs_angef_S5_S3 "Umrechnung fuer Messgroesse cMoeMesaf::f_neuber_startz_hme_hs_angef" TAB_VERB 2 0 "FALSE" 1 "TRUE" DEFAULT_VALUE "" /end COMPU_VTAB
/begin COMPU_VTAB Conv.cMoeMesaf._.f_neuber_startz_hme_hs_erfolgt_S5_S3 "Umrechnung fuer Messgroesse cMoeMesaf::f_neuber_startz_hme_hs_erfolgt" TAB_VERB 2 0 "FALSE" 1 "TRUE" DEFAULT_VALUE "" /end COMPU_VTAB
/begin COMPU_VTAB Conv.cMoeMesaf._.f_unterdr_me_S5_S3 "Umrechnung fuer Messgroesse cMoeMesaf::f_unterdr_me" TAB_VERB 2 0 "FALSE" 1 "TRUE" DEFAULT_VALUE "" /end COMPU_VTAB
/begin COMPU_VTAB Conv.cMoeMesaf._.flag_me_haupt_aktiv_S5_S3 "Umrechnung fuer Messgroesse cMoeMesaf::flag_me_haupt_aktiv" TAB_VERB 2 0 "kein Hauptmotoreingriff" 1 "Haupt- oder Zwangsmotoreingriff wird ausgegeben" DEFAULT_VALUE "" /end COMPU_VTAB
/begin COMPU_VTAB Conv.cMoeMesaf._.flag_schaltung_mes_aktiv_S5_S3 "Umrechnung fuer Messgroesse cMoeMesaf::flag_schaltung_mes_aktiv" TAB_VERB 2 0 "FALSE" 1 "TRUE" DEFAULT_VALUE "" /end COMPU_VTAB
/begin COMPU_VTAB Conv.cMoeMesaf._.me_sas_pos_vor_stat_S5_S3 "Umrechnung fuer Messgroesse cMoeMesaf::me_sas_pos_vor_stat" TAB_VERB 2 0 "Voreilender Motoreingriff inaktiv" 1 "Voreilender Motoreingriff aktiv" DEFAULT_VALUE "" /end COMPU_VTAB
/begin COMPU_VTAB Conv.cMoeMesaf._.momentenerhoehung_erlaubt_alt_S5_S3 "Umrechnung fuer Messgroesse cMoeMesaf::momentenerhoehung_erlaubt_alt" TAB_VERB 2 0 "Momentenerhoehung im letzten Durchlauf NICHT aktiv" 1 "Momentenerhoehung im letzten Durchlauf aktiv" DEFAULT_VALUE "" /end COMPU_VTAB
/begin COMPU_VTAB Conv.cMoeMesaf._.momentenerhoehung_erlaubt_S5_S3 "Umrechnung fuer Messgroesse cMoeMesaf::momentenerhoehung_erlaubt" TAB_VERB 2 0 "Momentenerhoehung NICHT aktiv" 1 "Momentenerhoehung aktiv" DEFAULT_VALUE "" /end COMPU_VTAB
/begin COMPU_VTAB Conv.cMoeMesaf._.nachme_rs_losgelaufen_S5_S3 "Umrechnung fuer Messgroesse cMoeMesaf::nachme_rs_losgelaufen" TAB_VERB 2 0 "Nach-Me bei RS wurde NICHT gestartet" 1 "Nach-Me bei RS wurde gestartet" DEFAULT_VALUE "" /end COMPU_VTAB
/begin COMPU_VTAB Conv.cMoeMesaf._.schalttyp_mes_S5_S3 "Umrechnung fuer Messgroesse cMoeMesaf::schalttyp_mes" TAB_VERB 3 0 "SCHALTTYP_MES_RS" 1 "SCHALTTYP_MES_HS" 2 "SCHALTTYP_MES_GE" DEFAULT_VALUE "" /end COMPU_VTAB
/begin COMPU_VTAB Conv.cMoeMesaf._.verbot_sas_fkt_alt_S5_S3 "Umrechnung fuer Messgroesse cMoeMesaf::verbot_sas_fkt_alt" TAB_VERB 2 0 "Kein Verbot der SAS Funktionen" 1 "Verbot der SAS Funktionen" DEFAULT_VALUE "" /end COMPU_VTAB
/begin COMPU_VTAB Conv.cMoeMesaf._.z_mes_S5_S3 "Umrechnung fuer Messgroesse cMoeMesaf::z_mes" TAB_VERB 10 2 "Vormotoreingriff Ruecksch." 3 "Hauptmotoreingriff Ruecksch." 4 "Rueckfilterung Hauptmotoreingriff Ruecksch." 5 "Nachmotoreingriff Ruecksch." 6 "Beenden des Nachmotoreingriff Ruecksch" 8 "Vormotoreingriff Hochsch GE" 9 "Zwangsmotoreingriff Hochsch." 10 "Hauptmotoreingriff Hochsch GE" 11 "Nachmotoreingriff Hochsch GE" 12 "kein Motoreingriff" DEFAULT_VALUE "" /end COMPU_VTAB
/begin COMPU_VTAB Conv.cMoeMesaf._.zust_haupt_me_gestartet_S5_S3 "Umrechnung fuer Messgroesse cMoeMesaf::zust_haupt_me_gestartet" TAB_VERB 2 0 "Hauptmotoreingriff noch nicht gestartet" 1 "Hauptmotoreingriff ist gestartet" DEFAULT_VALUE "" /end COMPU_VTAB
/begin COMPU_VTAB Conv.cMonMoSig._.mon_mst_status_S5_S3 "Umrechnung fuer Messgroesse cMonMoSig::mon_mst_status" TAB_VERB 4 0 "Motor AUS" 1 "Motor wechselt nach AN" 2 "Motor AN" 3 "Motor wechselt nach AUS" DEFAULT_VALUE "" /end COMPU_VTAB
/begin COMPU_VTAB Conv.cMvsZentr._.ps_aktiv_permanent_S5_S3 "Umrechnung fuer Messgroesse cMvsZentr::ps_aktiv_permanent" TAB_VERB 2 0 "Parksperren-Ansteuerung ist NICHT aktiv" 1 "Parksperren-Ansteuerung ist aktiv" DEFAULT_VALUE "" /end COMPU_VTAB
/begin COMPU_VTAB Conv.cMvsZentr._.ps_aktiv_S5_S3 "Umrechnung fuer Messgroesse cMvsZentr::ps_aktiv" TAB_VERB 2 0 "Parksperren-Ansteuerung ist NICHT aktiv" 1 "Parksperren-Ansteuerung ist aktiv" DEFAULT_VALUE "" /end COMPU_VTAB
/begin COMPU_VTAB Conv.cMvsZentr._.ps_magnet_timeout_S5_S3 "Umrechnung fuer Messgroesse cMvsZentr::ps_magnet_timeout" TAB_VERB 2 0 "NICHT aktiv" 1 "Timeout erreicht -> Spule abschalten" DEFAULT_VALUE "" /end COMPU_VTAB
/begin COMPU_VTAB Conv.cMvsZentr._.ps_zustand_S5_S3 "Umrechnung fuer Messgroesse cMvsZentr::ps_zustand" TAB_VERB 5 0 "Parksperre unbekannt" 1 "Parksperre geloest" 2 "Parksperre loesen" 3 "Parksperre einlegen" 4 "Parksperre eingelegt" DEFAULT_VALUE "" /end COMPU_VTAB
/begin COMPU_VTAB Conv.cNvrKoordinator._.ee_anzeige_block_history_S5_S3 "Umrechnung fuer Messgroesse cNvrKoordinator::ee_anzeige_block_history" TAB_VERB 11 0 "undefiniert" 1 "Block Valid i.O. - es wurden keine Daten angefordert" 2 "Block Valid i.O. trotzdem Fehler entdeckt - sollte nie vorkommen" 3 "Block Valid nicht i.O. - es wurden ungeultige Daten vom EEPROM kopiert" 4 "Block Valid nicht i.O. - es wurden gueltige Daten vom EEPROM kopiert" 5 "keine Pruefung und Init - nach Reset moeglich" 6 "keine Pruefung aber i.O. - nach Reset moeglich" 7 "Urstart erkannt und Block neu initialisiert" 8 "Block bereits freigegeben - nach Reset moeglich" 9 "Block Zustandsfehler - sollte nie auftreten" 10 "SWI_EEPROM_INIt = 2 - Block initialisieren" DEFAULT_VALUE "" /end COMPU_VTAB
/begin COMPU_VTAB Conv.cNvrKoordinator._.ee_management_status_S5_S3 "Umrechnung fuer Messgroesse cNvrKoordinator::ee_management_status" TAB_VERB 8 1 "Auswertung Zustand des Spiegek-Speichers" 2 "Spiegel Speicher abhaengig vom Zustand einrichten" 3 "Spiegel Speicher abhaengig vom Zustand einrichten" 4 "Spiegel Speicher abhaengig vom Zustand einrichten" 5 "Normal Betrieb = zyklische Checksummenpruefung" 6 "mit SWI_EEPROM_CHECKSUMMe = 2 wird einmalig Checksumme/Pruefpattern neu berechnet" 7 "keine Schreibzugriff erlaubt" 8 "Warten auf das Abschalten der EGS" DEFAULT_VALUE "" /end COMPU_VTAB
/begin COMPU_VTAB Conv.cNvrKoordinator._.ee_systemstart_ueber_reset_S5_S3 "Umrechnung fuer Messgroesse cNvrKoordinator::ee_systemstart_ueber_reset" TAB_VERB 3 0 "undefiniert" 1 "Systemstart ueber Reset sicher erkannt" 2 "Systemstart war sicher kein Reset" DEFAULT_VALUE "" /end COMPU_VTAB
/begin COMPU_VTAB Conv.cPAnzeige._.befuellung_schaltelement_aktiv_S5_S3 "Umrechnung fuer Messgroesse cPAnzeige::befuellung_schaltelement_aktiv" TAB_VERB 2 0 "FALSE" 1 "TRUE" DEFAULT_VALUE "" /end COMPU_VTAB
/begin COMPU_VTAB Conv.cPAnzeige._.kzu_beob_kup_ada_S5_S3 "Umrechnung fuer Messgroesse cPAnzeige::kzu_beob_kup_ada" TAB_VERB 7 0 "KEINE_KUPPLUNG" 1 "K_A" 2 "K_B" 3 "K_C" 4 "K_D" 5 "K_E" 6 "K_K0" DEFAULT_VALUE "" /end COMPU_VTAB
/begin COMPU_VTAB Conv.cSasAnGea._.ende_kab_gestartet_S5_S3 "Umrechnung fuer Messgroesse cSasAnGea::ende_kab_gestartet" TAB_VERB 2 0 "Zustand Ende KAB inaktiv" 1 "Zustand Ende KAB gestartet" DEFAULT_VALUE "" /end COMPU_VTAB
/begin COMPU_VTAB Conv.cSasAnGea._.erste_schaltung_S5_S3 "Umrechnung fuer Messgroesse cSasAnGea::erste_schaltung" TAB_VERB 2 0 "Kupplung wurde schon mal befuellt" 1 "Kupplung wurde noch nie befuellt" DEFAULT_VALUE "" /end COMPU_VTAB
/begin COMPU_VTAB Conv.cSasAnGea._.f_pfmin_erreicht_S5_S3 "Umrechnung fuer Messgroesse cSasAnGea::f_pfmin_erreicht" TAB_VERB 2 0 "Kupplung hat p_fmin erreicht" 1 "Kupplung hat p_fmin noch nicht erreicht" DEFAULT_VALUE "" /end COMPU_VTAB
/begin COMPU_VTAB Conv.cSasAnGea._.f_pokzu_kfl_zuletzt_wechsel_S5_S3 "Umrechnung fuer Messgroesse cSasAnGea::f_pokzu_kfl_zuletzt_wechsel" TAB_VERB 2 0 "Druckoffset nicht verwenden" 1 "Druckoffset verwenden" DEFAULT_VALUE "" /end COMPU_VTAB
/begin COMPU_VTAB Conv.cSasAnGea._.f_schnellfuellung_gestartet_S5_S3 "Umrechnung fuer Messgroesse cSasAnGea::f_schnellfuellung_gestartet" TAB_VERB 2 0 "Schnellfuellung noch nicht gestartet" 1 "Schnellfuellung gestartet" DEFAULT_VALUE "" /end COMPU_VTAB
/begin COMPU_VTAB Conv.cSasAnGea._.f_timeout_S5_S3 "Umrechnung fuer Messgroesse cSasAnGea::f_timeout" TAB_VERB 2 0 "Timeout-Zeit noch nicht abgelaufen" 1 "Timeout-Zeit abgelaufen" DEFAULT_VALUE "" /end COMPU_VTAB
/begin COMPU_VTAB Conv.cSasAnGea._.f_verb_ada_erste_bef_S5_S3 "Umrechnung fuer Messgroesse cSasAnGea::f_verb_ada_erste_bef" TAB_VERB 2 0 "Ada nicht verboten" 1 "Adapiton verboten" DEFAULT_VALUE "" /end COMPU_VTAB
/begin COMPU_VTAB Conv.cSasAnGea._.fa_kzu_gestartet_S5_S3 "Umrechnung fuer Messgroesse cSasAnGea::fa_kzu_gestartet" TAB_VERB 2 0 "Fuellausgleich KZU inaktiv" 1 "Fuellausgleich KZU aktiv" DEFAULT_VALUE "" /end COMPU_VTAB
/begin COMPU_VTAB Conv.cSasAnGea._.gea_ablauf_aktiv_S5_S3 "Umrechnung fuer Messgroesse cSasAnGea::gea_ablauf_aktiv" TAB_VERB 2 0 "Gangein/-auslegen inaktiv" 1 "Gangein/-auslegen aktiv" DEFAULT_VALUE "" /end COMPU_VTAB
/begin COMPU_VTAB Conv.cSasAnGea._.instanz_nr_S5_S3 "Umrechnung fuer Messgroesse cSasAnGea::instanz_nr" TAB_VERB 3 2 "Instanz Kraftschliessende Kup." 3 "Instanz 1. Nichtkraftschliessende Kup." 4 "Instanz 2. Nichtkraftschliessende Kup." DEFAULT_VALUE "" /end COMPU_VTAB
/begin COMPU_VTAB Conv.cSasAnGea._.kup_ga_S5_S3 "Umrechnung fuer Messgroesse cSasAnGea::kup_ga" TAB_VERB 6 0 "KEINE" 1 "K_A" 2 "K_B" 3 "K_C" 4 "K_D" 5 "K_E" DEFAULT_VALUE "" /end COMPU_VTAB
/begin COMPU_VTAB Conv.cSasAnGea._.kup_ge_S5_S3 "Umrechnung fuer Messgroesse cSasAnGea::kup_ge" TAB_VERB 6 0 "KEINE" 1 "K_A" 2 "K_B" 3 "K_C" 4 "K_D" 5 "K_E" DEFAULT_VALUE "" /end COMPU_VTAB
/begin COMPU_VTAB Conv.cSasAnGea._.kzu_voll_bei_start_S5_S3 "Umrechnung fuer Messgroesse cSasAnGea::kzu_voll_bei_start" TAB_VERB 2 0 "KZU war noch nicht befuellt" 1 "KZU war schon befuellt" DEFAULT_VALUE "" /end COMPU_VTAB
/begin COMPU_VTAB Conv.cSasAnGea._.po_fkzu_aktiv_S5_S3 "Umrechnung fuer Messgroesse cSasAnGea::po_fkzu_aktiv" TAB_VERB 2 0 "FALSE" 1 "TRUE" DEFAULT_VALUE "" /end COMPU_VTAB
/begin COMPU_VTAB Conv.cSasAnGea._.ra1_ge_gestartet_S5_S3 "Umrechnung fuer Messgroesse cSasAnGea::ra1_ge_gestartet" TAB_VERB 2 0 "Rampe 1 KZU inaktiv" 1 "Rampe 1 KZU gestartet" DEFAULT_VALUE "" /end COMPU_VTAB
/begin COMPU_VTAB Conv.cSasAnGea._.ra2_ge_gestartet_S5_S3 "Umrechnung fuer Messgroesse cSasAnGea::ra2_ge_gestartet" TAB_VERB 2 0 "Rampe 2 KZU inaktiv" 1 "Rampe 2 KZU gestartet" DEFAULT_VALUE "" /end COMPU_VTAB
/begin COMPU_VTAB Conv.cSasAnGea._.ra3_ge_gestartet_S5_S3 "Umrechnung fuer Messgroesse cSasAnGea::ra3_ge_gestartet" TAB_VERB 2 0 "Rampe 3 KZU inaktiv" 1 "Rampe 3 KZU gestartet" DEFAULT_VALUE "" /end COMPU_VTAB
/begin COMPU_VTAB Conv.cSasAnGea._.schalttyp_gea_S5_S3 "Umrechnung fuer Messgroesse cSasAnGea::schalttyp_gea" TAB_VERB 5 0 "Ablauf Kraftschliessende Kup." 1 "Ablauf 1. Nichtkraftschliessende Kup." 2 "Ablauf 2. Nichtkraftschliessende Kup." 3 "Ablauf Gangauslegen" 4 "Schalttyp unbestimmt" DEFAULT_VALUE "" /end COMPU_VTAB
/begin COMPU_VTAB Conv.cSasAnGea._.schliessen_kup_in_n_gestartet_S5_S3 "Umrechnung fuer Messgroesse cSasAnGea::schliessen_kup_in_n_gestartet" TAB_VERB 2 0 "Kupplungsansteuerung in Neutral nicht gestartet" 1 "Kupplungsansteuerung in Neutral gestartet" DEFAULT_VALUE "" /end COMPU_VTAB
/begin COMPU_VTAB Conv.cSasAnGea._.schnellfuellung_beendet_S5_S3 "Umrechnung fuer Messgroesse cSasAnGea::schnellfuellung_beendet" TAB_VERB 2 0 "Schnellfuellung nicht beendet" 1 "Schnellfuellung beendet" DEFAULT_VALUE "" /end COMPU_VTAB
/begin COMPU_VTAB Conv.cSasAnGea._.statisch_gea_S5_S3 "Umrechnung fuer Messgroesse cSasAnGea::statisch_gea" TAB_VERB 2 0 "GE/GA-Kupplung arbeitet" 1 "GE/GA-Kupplung statisch" DEFAULT_VALUE "" /end COMPU_VTAB
/begin COMPU_VTAB Conv.cSasAnGea._.synchron_verboten_S5_S3 "Umrechnung fuer Messgroesse cSasAnGea::synchron_verboten" TAB_VERB 2 0 "Synchron erreichen erlaubt" 1 "Synchron erreichen verboten" DEFAULT_VALUE "" /end COMPU_VTAB
/begin COMPU_VTAB Conv.cSasAnGea._.z_gea_S5_S3 "Umrechnung fuer Messgroesse cSasAnGea::z_gea" TAB_VERB 21 0 "Initialisierungszustand" 1 "zuschaltende Kup : Verzoegern Start SF bei GE" 2 "zuschaltende Kup : Schnellfuellung bei GE" 3 "kraftschl. Kup : Verzoegern der Fuellausgleichsphase" 4 "zuschaltende Kup : Fuellausgleich bei GE" 5 "nicht genutzt" 6 "nicht genutzt" 7 "nicht genutzt" 8 "nicht genutzt" 9 "kraftschl. Kup : Rampe auf Schaltdruck" 10 "kraftschl. Kup : Schaltdruckphase" 11 "kraftschl. Kup : Schliessrampe" 12 "kraftschl. Kup : (Not-)Schliessrampe nach Zeit in synchron" 13 "nicht genutzt" 14 "Maximalzeit des GE erreicht" 15 "kraftschl. Kup: Warten auf SF der nichtkraftschl. Kupplungen" 16 "nichtkraftschl. Kup : Schliessrampe" 17 "2. nichtkraftschl. Kup. : Warten auf 1. nichtkraftschl. Kup." 18 "Warten abschaltende Kupplung bei Gangauslegen" 19 "Rampe Gangauslegen abschaltende Kupplung" 20 "Ende Gangauslegen abschaltende Kupplung" DEFAULT_VALUE "" /end COMPU_VTAB
/begin COMPU_VTAB Conv.cSasAnGea._.z_modus_gea_S5_S3 "Umrechnung fuer Messgroesse cSasAnGea::z_modus_gea" TAB_VERB 3 0 "Normal Modus aktiv" 1 "ECO Mode aktiv" 2 "nicht genutzt" DEFAULT_VALUE "" /end COMPU_VTAB
/begin COMPU_VTAB Conv.cSasAnGls._.filter_wngtgls_gestartet_S5_S3 "Umrechnung fuer Messgroesse cSasAnGls::filter_wngtgls_gestartet" TAB_VERB 2 0 "FALSE" 1 "TRUE" DEFAULT_VALUE "" /end COMPU_VTAB
/begin COMPU_VTAB Conv.cSasAnGls._.gls_aktiv_S5_S3 "Umrechnung fuer Messgroesse cSasAnGls::gls_aktiv" TAB_VERB 2 0 "FALSE" 1 "TRUE" DEFAULT_VALUE "" /end COMPU_VTAB
/begin COMPU_VTAB Conv.cSasAnGls._.gls_mindruck_S5_S3 "Umrechnung fuer Messgroesse cSasAnGls::gls_mindruck" TAB_VERB 2 0 "GLS-Minimaldruck nicht erreicht" 1 "GLS-Minimaldruck erreicht" DEFAULT_VALUE "" /end COMPU_VTAB
/begin COMPU_VTAB Conv.cSasAnGls._.reg_gls_gestartet_S5_S3 "Umrechnung fuer Messgroesse cSasAnGls::reg_gls_gestartet" TAB_VERB 2 0 "FALSE" 1 "TRUE" DEFAULT_VALUE "" /end COMPU_VTAB
/begin COMPU_VTAB Conv.cSasAnGls._.schalttyp_gls_S5_S3 "Umrechnung fuer Messgroesse cSasAnGls::schalttyp_gls" TAB_VERB 6 0 "SCHUBHOCH" 1 "ZUGHOCH" 2 "SCHUBRUECK" 3 "ZUGRUECK" 4 "SCHALTTYP_GE_GA" 5 "ZR_ABB_IN_GLS" DEFAULT_VALUE "" /end COMPU_VTAB
/begin COMPU_VTAB Conv.cSasAnGls._.schaltung_gls_S5_S3 "Umrechnung fuer Messgroesse cSasAnGls::schaltung_gls" TAB_VERB 2 0 "FALSE" 1 "TRUE" DEFAULT_VALUE "" /end COMPU_VTAB
/begin COMPU_VTAB Conv.cSasAnGls._.verz_gls_gestartet_S5_S3 "Umrechnung fuer Messgroesse cSasAnGls::verz_gls_gestartet" TAB_VERB 2 0 "FALSE" 1 "TRUE" DEFAULT_VALUE "" /end COMPU_VTAB
/begin COMPU_VTAB Conv.cSasAnGls._.wechsel_normal_kurz_S5_S3 "Umrechnung fuer Messgroesse cSasAnGls::wechsel_normal_kurz" TAB_VERB 2 0 "FALSE" 1 "TRUE" DEFAULT_VALUE "" /end COMPU_VTAB
/begin COMPU_VTAB Conv.cSasAnGls._.z_gls_regler_S5_S3 "Umrechnung fuer Messgroesse cSasAnGls::z_gls_regler" TAB_VERB 3 2 "Initialisierung GLS-Regler" 4 "GLS-Regler Regelung" 5 "GLS-Regler Beendet" DEFAULT_VALUE "" /end COMPU_VTAB
/begin COMPU_VTAB Conv.cSasAnGls._.z_gls_S5_S3 "Umrechnung fuer Messgroesse cSasAnGls::z_gls" TAB_VERB 12 0 "GLS inaktiv" 1 "Warten GLS Schubhoch" 2 "Warten GLS Zughoch" 3 "Warten GLS Schubrueck" 4 "Warten GLS Zugrueck" 5 "Warten GLS Gangeinlegen" 6 "Verzoegerung GLS" 7 "Verzoegerung GLS Gangeinlegen" 8 "Regelung GLS" 9 "Ende GLS zuschaltende Kupplung" 10 "Ende GLS abschaltende Kupplung" 11 "GLS Passiv (abgeschaltet)" DEFAULT_VALUE "" /end COMPU_VTAB
/begin COMPU_VTAB Conv.cSasAnGls._.zug_schub_gls_S5_S3 "Umrechnung fuer Messgroesse cSasAnGls::zug_schub_gls" TAB_VERB 2 0 "SCHUB-Betrieb" 1 "ZUG-Betrieb" DEFAULT_VALUE "" /end COMPU_VTAB
/begin COMPU_VTAB Conv.cSasAnKab._.ende_kab_gestartet_S5_S3 "Umrechnung fuer Messgroesse cSasAnKab::ende_kab_gestartet" TAB_VERB 2 0 "FALSE" 1 "TRUE" DEFAULT_VALUE "" /end COMPU_VTAB
/begin COMPU_VTAB Conv.cSasAnKab._.f_best_poffkab_in_syn_erfolgt_S5_S3 "Umrechnung fuer Messgroesse cSasAnKab::f_best_poffkab_in_syn_erfolgt" TAB_VERB 2 0 "FALSE" 1 "TRUE" DEFAULT_VALUE "" /end COMPU_VTAB
/begin COMPU_VTAB Conv.cSasAnKab._.f_ende_verz_kab_erlaubt_S5_S3 "Umrechnung fuer Messgroesse cSasAnKab::f_ende_verz_kab_erlaubt" TAB_VERB 2 0 "FALSE" 1 "TRUE" DEFAULT_VALUE "" /end COMPU_VTAB
/begin COMPU_VTAB Conv.cSasAnKab._.f_rueckf_pozustartk0_aktiv_S5_S3 "Umrechnung fuer Messgroesse cSasAnKab::f_rueckf_pozustartk0_aktiv" TAB_VERB 2 0 "FALSE" 1 "TRUE" DEFAULT_VALUE "" /end COMPU_VTAB
/begin COMPU_VTAB Conv.cSasAnKab._.f_warten_auf_sf_k0_aktiv_S5_S3 "Umrechnung fuer Messgroesse cSasAnKab::f_warten_auf_sf_k0_aktiv" TAB_VERB 2 0 "FALSE" 1 "TRUE" DEFAULT_VALUE "" /end COMPU_VTAB
/begin COMPU_VTAB Conv.cSasAnKab._.gls_hs_kab_gestartet_S5_S3 "Umrechnung fuer Messgroesse cSasAnKab::gls_hs_kab_gestartet" TAB_VERB 2 0 "GLS der KAB darf noch nicht gestartet werden" 1 "GLS der KAB kann starten" DEFAULT_VALUE "" /end COMPU_VTAB
/begin COMPU_VTAB Conv.cSasAnKab._.halten_in_syn_kab_gestartet_S5_S3 "Umrechnung fuer Messgroesse cSasAnKab::halten_in_syn_kab_gestartet" TAB_VERB 2 0 "FALSE" 1 "TRUE" DEFAULT_VALUE "" /end COMPU_VTAB
/begin COMPU_VTAB Conv.cSasAnKab._.kab_nicht_befuellt_S5_S3 "Umrechnung fuer Messgroesse cSasAnKab::kab_nicht_befuellt" TAB_VERB 2 0 "KAB ist schon befuellt" 1 "KAB nicht befuellt" DEFAULT_VALUE "" /end COMPU_VTAB
/begin COMPU_VTAB Conv.cSasAnKab._.kup_kab_S5_S3 "Umrechnung fuer Messgroesse cSasAnKab::kup_kab" TAB_VERB 6 0 "KEINE" 1 "K_A" 2 "K_B" 3 "K_C" 4 "K_D" 5 "K_E" DEFAULT_VALUE "" /end COMPU_VTAB
/begin COMPU_VTAB Conv.cSasAnKab._.pkf_rs_kab_ausgegeben_S5_S3 "Umrechnung fuer Messgroesse cSasAnKab::pkf_rs_kab_ausgegeben" TAB_VERB 2 0 "FALSE" 1 "TRUE" DEFAULT_VALUE "" /end COMPU_VTAB
/begin COMPU_VTAB Conv.cSasAnKab._.pkf_rs_kab_gestartet_S5_S3 "Umrechnung fuer Messgroesse cSasAnKab::pkf_rs_kab_gestartet" TAB_VERB 2 0 "FALSE" 1 "TRUE" DEFAULT_VALUE "" /end COMPU_VTAB
/begin COMPU_VTAB Conv.cSasAnKab._.ps_hs_kab_gestartet_S5_S3 "Umrechnung fuer Messgroesse cSasAnKab::ps_hs_kab_gestartet" TAB_VERB 2 0 "Schaltdruckphase KAB nicht gestartet" 1 "Schaltdruckphase KAB gestartet" DEFAULT_VALUE "" /end COMPU_VTAB
/begin COMPU_VTAB Conv.cSasAnKab._.ra1_kab_gestartet_S5_S3 "Umrechnung fuer Messgroesse cSasAnKab::ra1_kab_gestartet" TAB_VERB 2 0 "Rampe 1 KAB nicht gestartet" 1 "Rampe 1 KAB gestartet" DEFAULT_VALUE "" /end COMPU_VTAB
/begin COMPU_VTAB Conv.cSasAnKab._.ra_sd_hs_kab_gestartet_S5_S3 "Umrechnung fuer Messgroesse cSasAnKab::ra_sd_hs_kab_gestartet" TAB_VERB 2 0 "FALSE" 1 "TRUE" DEFAULT_VALUE "" /end COMPU_VTAB
/begin COMPU_VTAB Conv.cSasAnKab._.ra_sd_rs_kab_gestartet_S5_S3 "Umrechnung fuer Messgroesse cSasAnKab::ra_sd_rs_kab_gestartet" TAB_VERB 2 0 "FALSE" 1 "TRUE" DEFAULT_VALUE "" /end COMPU_VTAB
/begin COMPU_VTAB Conv.cSasAnKab._.schalttyp_kab_S5_S3 "Umrechnung fuer Messgroesse cSasAnKab::schalttyp_kab" TAB_VERB 5 0 "RS_ABBR_IN_GLS_KAB" 1 "ZUGHOCH" 2 "SCHUBRUECK" 3 "wird nicht verwendet" 4 "wird nicht verwendet" DEFAULT_VALUE "" /end COMPU_VTAB
/begin COMPU_VTAB Conv.cSasAnKab._.statisch_kab_S5_S3 "Umrechnung fuer Messgroesse cSasAnKab::statisch_kab" TAB_VERB 2 0 "KAB arbeitet" 1 "KAB statisch" DEFAULT_VALUE "" /end COMPU_VTAB
/begin COMPU_VTAB Conv.cSasAnKab._.ueb_rs_kab_gestartet_S5_S3 "Umrechnung fuer Messgroesse cSasAnKab::ueb_rs_kab_gestartet" TAB_VERB 2 0 "Ueberschneidung nicht gestartet" 1 "Ueberschneidung KAB gestartet" DEFAULT_VALUE "" /end COMPU_VTAB
/begin COMPU_VTAB Conv.cSasAnKab._.z_kab_S5_S3 "Umrechnung fuer Messgroesse cSasAnKab::z_kab" TAB_VERB 17 0 "Initialisierungszustand" 1 "Verzoegern der Abschaltenden Kupplung" 2 "Haltephase bei Hochschaltung" 3 "Rampe auf Schaltdruck bei Hochschaltungen" 4 "Schaltdruckphase bei Hochschaltungen" 5 "nicht genutzt" 6 "nicht genutzt" 7 "nicht genutzt" 8 "nicht genutzt" 9 "Lastuebernahme GLS bei Hochschaltung" 10 "Haltedruck bei Rueckschaltung" 11 "Rampe auf Schaltdruck bei Rueckschaltung" 12 "Schaltdruckphase bei Rueckschaltung" 13 "Rampe auf Haltephase in Synchron bei Rueckschaltung" 14 "Haltephase in Synchron bei Rueckschaltung" 15 "Ueberschneidungsphase bei Rueckschaltung" 16 "Ende abschaltende Kupplung" DEFAULT_VALUE "" /end COMPU_VTAB
/begin COMPU_VTAB Conv.cSasAnKzu._.f_hinsyn_kzu_gestartet_S5_S3 "Umrechnung fuer Messgroesse cSasAnKzu::f_hinsyn_kzu_gestartet" TAB_VERB 2 0 "FALSE" 1 "TRUE" DEFAULT_VALUE "" /end COMPU_VTAB
/begin COMPU_VTAB Conv.cSasAnKzu._.f_ngs_abflare_unterschritten_S5_S3 "Umrechnung fuer Messgroesse cSasAnKzu::f_ngs_abflare_unterschritten" TAB_VERB 2 0 "Druckoffset bei Flare nicht gesetzt" 1 "Druckoffset bei Flare gesetzt" DEFAULT_VALUE "" /end COMPU_VTAB
/begin COMPU_VTAB Conv.cSasAnKzu._.f_pokzufol_erlaubt_S5_S3 "Umrechnung fuer Messgroesse cSasAnKzu::f_pokzufol_erlaubt" TAB_VERB 2 0 "FALSE" 1 "TRUE" DEFAULT_VALUE "" /end COMPU_VTAB
/begin COMPU_VTAB Conv.cSasAnKzu._.f_rampenzeitberechnung_fertig_S5_S3 "Umrechnung fuer Messgroesse cSasAnKzu::f_rampenzeitberechnung_fertig" TAB_VERB 2 0 "Schliessrampenzeit nicht berechnet" 1 "Schliessrampenzeit berechnet" DEFAULT_VALUE "" /end COMPU_VTAB
/begin COMPU_VTAB Conv.cSasAnKzu._.f_schnellfuellung_war_aktiv_S5_S3 "Umrechnung fuer Messgroesse cSasAnKzu::f_schnellfuellung_war_aktiv" TAB_VERB 2 0 "FALSE" 1 "TRUE" DEFAULT_VALUE "" /end COMPU_VTAB
/begin COMPU_VTAB Conv.cSasAnKzu._.fa_kzu_gestartet_S5_S3 "Umrechnung fuer Messgroesse cSasAnKzu::fa_kzu_gestartet" TAB_VERB 2 0 "FALSE" 1 "TRUE" DEFAULT_VALUE "" /end COMPU_VTAB
/begin COMPU_VTAB Conv.cSasAnKzu._.flag_pomekzu_erlaubt_S5_S3 "Umrechnung fuer Messgroesse cSasAnKzu::flag_pomekzu_erlaubt" TAB_VERB 2 0 "ME-abhaengiger Druckoffset nicht erlaubt" 1 "ME-abhaengiger Druckoffset erlaubt" DEFAULT_VALUE "" /end COMPU_VTAB
/begin COMPU_VTAB Conv.cSasAnKzu._.kup_kzu_S5_S3 "Umrechnung fuer Messgroesse cSasAnKzu::kup_kzu" TAB_VERB 6 0 "KEINE" 1 "K_A" 2 "K_B" 3 "K_C" 4 "K_D" 5 "K_E" DEFAULT_VALUE "" /end COMPU_VTAB
/begin COMPU_VTAB Conv.cSasAnKzu._.p_fkzu_gueltig_S5_S3 "Umrechnung fuer Messgroesse cSasAnKzu::p_fkzu_gueltig" TAB_VERB 2 0 "Fuelldruckwert nicht gueltig" 1 "Fuelldruckwert gueltig" DEFAULT_VALUE "" /end COMPU_VTAB
/begin COMPU_VTAB Conv.cSasAnKzu._.ra1_hsrs_kzu_gestartet_S5_S3 "Umrechnung fuer Messgroesse cSasAnKzu::ra1_hsrs_kzu_gestartet" TAB_VERB 2 0 "FALSE" 1 "TRUE" DEFAULT_VALUE "" /end COMPU_VTAB
/begin COMPU_VTAB Conv.cSasAnKzu._.ra2_hsrs_kzu_gestartet_S5_S3 "Umrechnung fuer Messgroesse cSasAnKzu::ra2_hsrs_kzu_gestartet" TAB_VERB 2 0 "FALSE" 1 "TRUE" DEFAULT_VALUE "" /end COMPU_VTAB
/begin COMPU_VTAB Conv.cSasAnKzu._.ra3_hsrs_kzu_gestartet_S5_S3 "Umrechnung fuer Messgroesse cSasAnKzu::ra3_hsrs_kzu_gestartet" TAB_VERB 2 0 "FALSE" 1 "TRUE" DEFAULT_VALUE "" /end COMPU_VTAB
/begin COMPU_VTAB Conv.cSasAnKzu._.schalttyp_kzu_S5_S3 "Umrechnung fuer Messgroesse cSasAnKzu::schalttyp_kzu" TAB_VERB 5 0 "nicht genutzt" 1 "Hochschaltung:    ZUGHOCH" 2 "Rueckschaltung:   SCHUBRUECK" 3 "wird nicht verwendet" 4 "Gangein/-auslegen: SCHALTTYP_GE_GA" DEFAULT_VALUE "" /end COMPU_VTAB
/begin COMPU_VTAB Conv.cSasAnKzu._.schliessen_kzu_S5_S3 "Umrechnung fuer Messgroesse cSasAnKzu::schliessen_kzu" TAB_VERB 2 0 "FALSE" 1 "TRUE" DEFAULT_VALUE "" /end COMPU_VTAB
/begin COMPU_VTAB Conv.cSasAnKzu._.statisch_kzu_S5_S3 "Umrechnung fuer Messgroesse cSasAnKzu::statisch_kzu" TAB_VERB 2 0 "KZU arbeitet" 1 "KZU statisch" DEFAULT_VALUE "" /end COMPU_VTAB
/begin COMPU_VTAB Conv.cSasAnKzu._.t_vkabr_abgelaufen_S5_S3 "Umrechnung fuer Messgroesse cSasAnKzu::t_vkabr_abgelaufen" TAB_VERB 2 0 "Verzoegerungszeit nicht abgelaufen" 1 "Verzoegerungszeit abgelaufen" DEFAULT_VALUE "" /end COMPU_VTAB
/begin COMPU_VTAB Conv.cSasAnKzu._.z_kzu_S5_S3 "Umrechnung fuer Messgroesse cSasAnKzu::z_kzu" TAB_VERB 20 0 "Initialisierungszustand" 1 "Warten" 2 "Schnellfuellung" 3 "nicht genutzt" 4 "Fuellausgleich Hochschaltung" 5 "Fuellausgleich Rueckschaltung" 6 "nicht genutzt" 7 "nicht genutzt" 8 "nicht genutzt" 9 "Rampe 1 Hoch- und Rueckschaltung" 10 "Rampe 2 Hoch- und Rueckschaltung" 11 "Rampe auf Haltephase in Synchron" 12 "Haltephase in Synchron" 13 "Rampe 3 Hoch- und Rueckschaltung" 14 "Timeout" 15 "nicht genutzt" 16 "nicht genutzt" 17 "Warten bis Schnellfüllung K0 beendet ist" 18 "Schliessrampe nach Zeit in synchron bei Rueckschaltung" 19 "Fuellausgleich waehrend Vorbereitung" DEFAULT_VALUE "" /end COMPU_VTAB
/begin COMPU_VTAB Conv.cSasPsyst._.f_auframpen_mg_psysminpuls_gest_S5_S3 "Umrechnung fuer Messgroesse cSasPsyst::f_auframpen_mg_psysminpuls_gest" TAB_VERB 2 0 "FALSE" 1 "TRUE" DEFAULT_VALUE "" /end COMPU_VTAB
/begin COMPU_VTAB Conv.cSasPsyst._.f_einstiegsbed_p_sysiae_erf_S5_S3 "Umrechnung fuer Messgroesse cSasPsyst::f_einstiegsbed_p_sysiae_erf" TAB_VERB 2 0 "Bedingungen für Systemdruckvorgabe IAE Fkt. nicht erfüllt" 1 "Bedingungen für Systemdruckvorgabe IAE Fkt. erfüllt" DEFAULT_VALUE "" /end COMPU_VTAB
/begin COMPU_VTAB Conv.cSasPsyst._.f_psys_kupschutz_anst_laeuft_S5_S3 "Umrechnung fuer Messgroesse cSasPsyst::f_psys_kupschutz_anst_laeuft" TAB_VERB 2 0 "keine Systemdruckanhebung" 1 "Systemdruckanhebung durch erhoehte Kupplungstemperatur" DEFAULT_VALUE "" /end COMPU_VTAB
/begin COMPU_VTAB Conv.cSasPsyst._.f_zeit_max_psys_abgelaufen_S5_S3 "Umrechnung fuer Messgroesse cSasPsyst::f_zeit_max_psys_abgelaufen" TAB_VERB 2 0 "Zeit für MAX-Ansteuerung Systemdruck ist noch nicht abgelaufen" 1 "Zeit für MAX-Ansteuerung Systemdruck ist abgelaufen" DEFAULT_VALUE "" /end COMPU_VTAB
/begin COMPU_VTAB Conv.cSasPsyst._.f_zeit_max_psys_anst_laeuft_S5_S3 "Umrechnung fuer Messgroesse cSasPsyst::f_zeit_max_psys_anst_laeuft" TAB_VERB 2 0 "keine MAX-Ansteuerung Systemdruck" 1 "MAX-Ansteuerung Systemdruck aktiv" DEFAULT_VALUE "" /end COMPU_VTAB
/begin COMPU_VTAB Conv.cSasPsyst._.fkt_druckvorgabe_psys_S5_S3 "Umrechnung fuer Messgroesse cSasPsyst::fkt_druckvorgabe_psys" TAB_VERB 30 0 "Keine Systemdruck vorhanden" 1 "Maximaler Systemdruck anfgefordert" 2 "Druckvorgabe Pulsadaption" 3 "Druckvorgabe Schlupfadaption" 4 "Druckvorgabe CSC" 5 "Druckvorgabe LCC" 6 "Druckvorgabe HIS" 7 "Druckvorgabe HOK" 8 "Druckvorgabe K0" 9 "Druckvorgabe opt/red Bef. K0" 10 "Druckvorgabe Kupplungsschutzfkt" 11 "Druckvorgabe IEP" 12 "Druckvorgabe Übertemp. Kühlerzul." 13 "Druckvorgabe IAE" 14 "Druckvorgabe Segelfunktion" 15 "Druckvorgabe POSV Ueberwachung" 16 "Druckvorgabe Gangeinlegen" 17 "Druckvorgabe HS/RS" 18 "Druckvorgabe Ansteuerung Parksperre" 19 "Druckvorgabe Parksperre auslegen" 20 "Druckvorgabe nach Motorstart" 21 "Druckvorgabe durch GEA Modell" 22 "Druckvorgabe bei aktiver Klauenschaltung" 23 "Druckvorgabe Gangnachf. mit Klaue" 24 "Druckvorgabe Gangabhängig" 25 "Druckvorgabe bei KFL Neutral" 26 "Druckvorgabe durch Notlauf UWIG" 27 "Druckvorgabe durch K0 Gangabhängig" 28 "Druckvorgabe Wandlertemperatur" 255 "Noch keine Funktion definiert" DEFAULT_VALUE "" /end COMPU_VTAB
/begin COMPU_VTAB Conv.cSasSaKor._.aktuelle_schaltung_S5_S3 "Umrechnung fuer Messgroesse cSasSaKor::aktuelle_schaltung" TAB_VERB 2 0 "Instanz entspricht Vorbereitende Schaltung" 1 "Instanz entspricht Aktive Schaltung" DEFAULT_VALUE "" /end COMPU_VTAB
/begin COMPU_VTAB Conv.cSasSaKor._.erste_schaltung_S5_S3 "Umrechnung fuer Messgroesse cSasSaKor::erste_schaltung" TAB_VERB 2 0 "Kupplung wurde schon mal befuellt" 1 "Kupplung wurde noch nie befuellt" DEFAULT_VALUE "" /end COMPU_VTAB
/begin COMPU_VTAB Conv.cSasSaKor._.f_verb_ada_erste_bef_S5_S3 "Umrechnung fuer Messgroesse cSasSaKor::f_verb_ada_erste_bef" TAB_VERB 2 0 "Adaption erlaubt" 1 "Adaption verboten" DEFAULT_VALUE "" /end COMPU_VTAB
/begin COMPU_VTAB Conv.cSasSaKor._.fkt_halten_in_sync_verboten_S5_S3 "Umrechnung fuer Messgroesse cSasSaKor::fkt_halten_in_sync_verboten" TAB_VERB 2 0 "Halten in Synchron nicht verboten" 1 "Halten in Synchron verboten" DEFAULT_VALUE "" /end COMPU_VTAB
/begin COMPU_VTAB Conv.cSasSaKor._.index_spsas_S5_S3 "Umrechnung fuer Messgroesse cSasSaKor::index_spsas" TAB_VERB 3 0 "IND_KURZSAS_NORMAL" 1 "IND_KURZSAS_SP" 2 "IND_KURZSAS_SPORT" DEFAULT_VALUE "" /end COMPU_VTAB
/begin COMPU_VTAB Conv.cSasSaKor._.istgang_sas_S5_S3 "Umrechnung fuer Messgroesse cSasSaKor::istgang_sas" TAB_VERB 10 -1 "GR1" 0 "KEIN_GANG" 1 "G1" 2 "G2" 3 "G3" 4 "G4" 5 "G5" 6 "G6" 7 "G7" 8 "G8" DEFAULT_VALUE "" /end COMPU_VTAB
/begin COMPU_VTAB Conv.cSasSaKor._.kup_schutz_massnahme_aktiv_S5_S3 "Umrechnung fuer Messgroesse cSasSaKor::kup_schutz_massnahme_aktiv" TAB_VERB 2 0 "Schutzfunktion inaktiv" 1 "Schutzfunktion aktiv" DEFAULT_VALUE "" /end COMPU_VTAB
/begin COMPU_VTAB Conv.cSasSaKor._.schaltinfo_sas_S5_S3 "Umrechnung fuer Messgroesse cSasSaKor::schaltinfo_sas" TAB_VERB 5 0 "Keine Schaltinfo" 1 "Einzelhochschaltung" 2 "Mehrfachhochschaltung" 3 "Einzelrueckschaltung" 4 "Mehrfachrueckschaltung" DEFAULT_VALUE "" /end COMPU_VTAB
/begin COMPU_VTAB Conv.cSasSaKor._.schaltinfo_sas_vor_folge_S5_S3 "Umrechnung fuer Messgroesse cSasSaKor::schaltinfo_sas_vor_folge" TAB_VERB 9 0 "KEINE_SCHALTINFO" 1 "EHS" 2 "MHS" 3 "ERS" 4 "MRS" 5 "MRS84" 6 "MRS64" 7 "nicht verwendet" 8 "nicht verwendet" DEFAULT_VALUE "" /end COMPU_VTAB
/begin COMPU_VTAB Conv.cSasSaKor._.schaltinfo_syn_S5_S3 "Umrechnung fuer Messgroesse cSasSaKor::schaltinfo_syn" TAB_VERB 5 0 "KEINE_SCHALTINFO" 1 "EHS" 2 "MHS" 3 "ERS" 4 "MRS" DEFAULT_VALUE "" /end COMPU_VTAB
/begin COMPU_VTAB Conv.cSasSaKor._.schnellfuellung_beendet_S5_S3 "Umrechnung fuer Messgroesse cSasSaKor::schnellfuellung_beendet" TAB_VERB 2 0 "Schnellfuellung nicht beendet" 1 "Schnellfuellung beendet" DEFAULT_VALUE "" /end COMPU_VTAB
/begin COMPU_VTAB Conv.cSasSaKor._.schnellfuellung_gestartet_S5_S3 "Umrechnung fuer Messgroesse cSasSaKor::schnellfuellung_gestartet" TAB_VERB 2 0 "Schnellfuellung nicht gestartet" 1 "Schnellfuellung gestartet" DEFAULT_VALUE "" /end COMPU_VTAB
/begin COMPU_VTAB Conv.cSasSaKor._.synchron_S5_S3 "Umrechnung fuer Messgroesse cSasSaKor::synchron" TAB_VERB 2 0 "Synchronpunkt noch nicht erreicht" 1 "Synchronpunkt erreicht" DEFAULT_VALUE "" /end COMPU_VTAB
/begin COMPU_VTAB Conv.cSasSaKor._.synchron_verboten_S5_S3 "Umrechnung fuer Messgroesse cSasSaKor::synchron_verboten" TAB_VERB 2 0 "Synchron nicht verboten" 1 "Synchron verboten" DEFAULT_VALUE "" /end COMPU_VTAB
/begin COMPU_VTAB Conv.cSasSaKor._.timeout_S5_S3 "Umrechnung fuer Messgroesse cSasSaKor::timeout" TAB_VERB 2 0 "kein Timeout" 1 "Timeout erreicht" DEFAULT_VALUE "" /end COMPU_VTAB
/begin COMPU_VTAB Conv.cSasSaKor._.z_kurze_schaltung_S5_S3 "Umrechnung fuer Messgroesse cSasSaKor::z_kurze_schaltung" TAB_VERB 8 0 "Initialisierungszustand" 1 "Passiv keine kurzen Parameter vorhanden" 2 "normale Parameter" 3 "nur teilweise SP-Label verwendet" 4 "alle SP-Label verwendet" 5 "nur teilweise SPORT-Label verwendet" 6 "alle SPORT-Label verwendet" 7 "alle SP-Label und teilweise SPORT-Label" DEFAULT_VALUE "" /end COMPU_VTAB
/begin COMPU_VTAB Conv.cSasSaKor._.zielgang_sas_S5_S3 "Umrechnung fuer Messgroesse cSasSaKor::zielgang_sas" TAB_VERB 10 -1 "GR1" 0 "KEIN_GANG" 1 "G1" 2 "G2" 3 "G3" 4 "G4" 5 "G5" 6 "G6" 7 "G7" 8 "G8" DEFAULT_VALUE "" /end COMPU_VTAB
/begin COMPU_VTAB Conv.cSasSaKor._.zwangssynchron_S5_S3 "Umrechnung fuer Messgroesse cSasSaKor::zwangssynchron" TAB_VERB 2 0 "Kein Zwangssynchron" 1 "Zwangssynchron" DEFAULT_VALUE "" /end COMPU_VTAB
/begin COMPU_VTAB Conv.cSasStrat._.ber_red_durch_sf_notwendig_S5_S3 "Umrechnung fuer Messgroesse cSasStrat::ber_red_durch_sf_notwendig" TAB_VERB 2 0 "FALSE" 1 "TRUE" DEFAULT_VALUE "" /end COMPU_VTAB
/begin COMPU_VTAB Conv.cSasStrat._.f_nmot_ts_estart_S5_S3 "Umrechnung fuer Messgroesse cSasStrat::f_nmot_ts_estart" TAB_VERB 2 0 "FALSE" 1 "TRUE" DEFAULT_VALUE "" /end COMPU_VTAB
/begin COMPU_VTAB Conv.cSasStrat._.f_sltsf_estart_S5_S3 "Umrechnung fuer Messgroesse cSasStrat::f_sltsf_estart" TAB_VERB 2 0 "FALSE" 1 "TRUE" DEFAULT_VALUE "" /end COMPU_VTAB
/begin COMPU_VTAB Conv.cSasStrat._.flag_opt_bef_aush_sch_angef_S5_S3 "Umrechnung fuer Messgroesse cSasStrat::flag_opt_bef_aush_sch_angef" TAB_VERB 2 0 "FALSE" 1 "TRUE" DEFAULT_VALUE "" /end COMPU_VTAB
/begin COMPU_VTAB Conv.cSasStrat._.flag_opt_bef_inh_sch_angef_S5_S3 "Umrechnung fuer Messgroesse cSasStrat::flag_opt_bef_inh_sch_angef" TAB_VERB 2 0 "FALSE" 1 "TRUE" DEFAULT_VALUE "" /end COMPU_VTAB
/begin COMPU_VTAB Conv.cSasStrat._.flag_red_bef_aush_sch_angef_S5_S3 "Umrechnung fuer Messgroesse cSasStrat::flag_red_bef_aush_sch_angef" TAB_VERB 2 0 "FALSE" 1 "TRUE" DEFAULT_VALUE "" /end COMPU_VTAB
/begin COMPU_VTAB Conv.cSasStrat._.flag_red_bef_inh_sch_angef_S5_S3 "Umrechnung fuer Messgroesse cSasStrat::flag_red_bef_inh_sch_angef" TAB_VERB 2 0 "FALSE" 1 "TRUE" DEFAULT_VALUE "" /end COMPU_VTAB
/begin COMPU_VTAB Conv.cSasZentr._.abbruchsart_hs_gls_erlaubt_S5_S3 "Umrechnung fuer Messgroesse cSasZentr::abbruchsart_hs_gls_erlaubt" TAB_VERB 2 0 "FALSE" 1 "TRUE" DEFAULT_VALUE "" /end COMPU_VTAB
/begin COMPU_VTAB Conv.cSasZentr._.abbruchsart_ist_S5_S3 "Umrechnung fuer Messgroesse cSasZentr::abbruchsart_ist" TAB_VERB 5 0 "Kein Abbruch" 10 "Abbruch HS in synchron Istgang" 20 "Abbruch HS in GLS" 30 "Abbruch RS" 40 "Abbruch HYD" DEFAULT_VALUE "" /end COMPU_VTAB
/begin COMPU_VTAB Conv.cSasZentr._.abbruchsart_soll_S5_S3 "Umrechnung fuer Messgroesse cSasZentr::abbruchsart_soll" TAB_VERB 5 0 "Kein Abbruch" 10 "Abbruch HS in synchron Istgang" 20 "Abbruch HS in GLS" 30 "Abbruch RS" 40 "Abbruch HYD" DEFAULT_VALUE "" /end COMPU_VTAB
/begin COMPU_VTAB Conv.cSasZentr._.event_sf_erkannt_S5_S3 "Umrechnung fuer Messgroesse cSasZentr::event_sf_erkannt" TAB_VERB 2 0 "FALSE" 1 "TRUE" DEFAULT_VALUE "" /end COMPU_VTAB
/begin COMPU_VTAB Conv.cSasZentr._.f_eco_mode_S5_S3 "Umrechnung fuer Messgroesse cSasZentr::f_eco_mode" TAB_VERB 2 0 "ECO Mode inaktiv" 1 "ECO Mode aktiv" DEFAULT_VALUE "" /end COMPU_VTAB
/begin COMPU_VTAB Conv.cSasZentr._.f_einstiegsbed_erfuellt_S5_S3 "Umrechnung fuer Messgroesse cSasZentr::f_einstiegsbed_erfuellt" TAB_VERB 2 0 "Einstiegsbed. noch nicht erfüllt" 1 "Einstiegsbed. erfüllt" DEFAULT_VALUE "" /end COMPU_VTAB
/begin COMPU_VTAB Conv.cSasZentr._.f_red_mmotmax_angefordert_S5_S3 "Umrechnung fuer Messgroesse cSasZentr::f_red_mmotmax_angefordert" TAB_VERB 2 0 "Einstiegsbed. noch nicht erfüllt" 1 "Einstiegsbed. erfüllt" DEFAULT_VALUE "" /end COMPU_VTAB
/begin COMPU_VTAB Conv.cSasZentr._.f_schaltung_normal_beendet_S5_S3 "Umrechnung fuer Messgroesse cSasZentr::f_schaltung_normal_beendet" TAB_VERB 2 0 "Schaltung wurde noch nicht oder über einen Abbruch beendet" 1 "Schaltungsende erfolgte über die normale Schaltungsende-Bedingungen" DEFAULT_VALUE "" /end COMPU_VTAB
/begin COMPU_VTAB Conv.cSasZentr._.flag_ge_dnr_aktiv_S5_S3 "Umrechnung fuer Messgroesse cSasZentr::flag_ge_dnr_aktiv" TAB_VERB 2 0 "Positionswechsel D-N-R nicht aktiv" 1 "Positionswechsel D-N-R aktiv" DEFAULT_VALUE "" /end COMPU_VTAB
/begin COMPU_VTAB Conv.cSasZentr._.flag_ge_rnd_aktiv_S5_S3 "Umrechnung fuer Messgroesse cSasZentr::flag_ge_rnd_aktiv" TAB_VERB 2 0 "Positionswechsel R-N-D nicht aktiv" 1 "Positionswechsel R-N-D aktiv" DEFAULT_VALUE "" /end COMPU_VTAB
/begin COMPU_VTAB Conv.cSasZentr._.flag_sync_verlassen_me_S5_S3 "Umrechnung fuer Messgroesse cSasZentr::flag_sync_verlassen_me" TAB_VERB 2 0 "sync istgang oder sync zielgang" 1 "kein synchron" DEFAULT_VALUE "" /end COMPU_VTAB
/begin COMPU_VTAB Conv.cSasZentr._.folgeschaltung_S5_S3 "Umrechnung fuer Messgroesse cSasZentr::folgeschaltung" TAB_VERB 2 0 "keine Folgeschaltung" 1 "Folgeschaltung" DEFAULT_VALUE "" /end COMPU_VTAB
/begin COMPU_VTAB Conv.cSasZentr._.gangwechsel_S5_S3 "Umrechnung fuer Messgroesse cSasZentr::gangwechsel" TAB_VERB 2 0 "kein Gangwechsel" 1 "Gangwechsel aktiv" DEFAULT_VALUE "" /end COMPU_VTAB
/begin COMPU_METHOD Conv.cModHydlg._.vnr_abgldat_im_boot_S5_S3 "Umrechnung fuer Messgroesse cModHydlg::vnr_abgldat_im_boot" TAB_VERB "%4.0" "" COMPU_TAB_REF Conv.cModHydlg._.vnr_abgldat_im_boot_S5_S3 /end COMPU_METHOD
/begin COMPU_METHOD Conv.cModHydlg._.zugriff_abgleichdaten_S5_S3 "Umrechnung fuer Messgroesse cModHydlg::zugriff_abgleichdaten" TAB_VERB "%4.0" "" COMPU_TAB_REF Conv.cModHydlg._.zugriff_abgleichdaten_S5_S3 /end COMPU_METHOD
/begin COMPU_METHOD Conv.cModPVorg._.f_anst_statisch_S5_S3 "Umrechnung fuer Messgroesse cModPVorg::f_anst_statisch" TAB_VERB "%4.0" "" COMPU_TAB_REF Conv.cModPVorg._.f_anst_statisch_S5_S3 /end COMPU_METHOD
/begin COMPU_METHOD Conv.cModPVorg._.f_druck_vorgegeben_S5_S3 "Umrechnung fuer Messgroesse cModPVorg::f_druck_vorgegeben" TAB_VERB "%4.0" "" COMPU_TAB_REF Conv.cModPVorg._.f_druck_vorgegeben_S5_S3 /end COMPU_METHOD
/begin COMPU_METHOD Conv.cModPVorg._.fktn_druckvorgabe_S5_S3 "Umrechnung fuer Messgroesse cModPVorg::fktn_druckvorgabe" TAB_VERB "%4.0" "" COMPU_TAB_REF Conv.cModPVorg._.fktn_druckvorgabe_S5_S3 /end COMPU_METHOD
/begin COMPU_METHOD Conv.cModPVorg._.typ_druckvorgabe_S5_S3 "Umrechnung fuer Messgroesse cModPVorg::typ_druckvorgabe" TAB_VERB "%4.0" "" COMPU_TAB_REF Conv.cModPVorg._.typ_druckvorgabe_S5_S3 /end COMPU_METHOD
/begin COMPU_METHOD Conv.cMoeMesaf._.f_neuber_startz_hme_hs_angef_S5_S3 "Umrechnung fuer Messgroesse cMoeMesaf::f_neuber_startz_hme_hs_angef" TAB_VERB "%4.0" "" COMPU_TAB_REF Conv.cMoeMesaf._.f_neuber_startz_hme_hs_angef_S5_S3 /end COMPU_METHOD
/begin COMPU_METHOD Conv.cMoeMesaf._.f_neuber_startz_hme_hs_erfolgt_S5_S3 "Umrechnung fuer Messgroesse cMoeMesaf::f_neuber_startz_hme_hs_erfolgt" TAB_VERB "%4.0" "" COMPU_TAB_REF Conv.cMoeMesaf._.f_neuber_startz_hme_hs_erfolgt_S5_S3 /end COMPU_METHOD
/begin COMPU_METHOD Conv.cMoeMesaf._.f_unterdr_me_S5_S3 "Umrechnung fuer Messgroesse cMoeMesaf::f_unterdr_me" TAB_VERB "%4.0" "" COMPU_TAB_REF Conv.cMoeMesaf._.f_unterdr_me_S5_S3 /end COMPU_METHOD
/begin COMPU_METHOD Conv.cMoeMesaf._.flag_me_haupt_aktiv_S5_S3 "Umrechnung fuer Messgroesse cMoeMesaf::flag_me_haupt_aktiv" TAB_VERB "%4.0" "" COMPU_TAB_REF Conv.cMoeMesaf._.flag_me_haupt_aktiv_S5_S3 /end COMPU_METHOD
/begin COMPU_METHOD Conv.cMoeMesaf._.flag_schaltung_mes_aktiv_S5_S3 "Umrechnung fuer Messgroesse cMoeMesaf::flag_schaltung_mes_aktiv" TAB_VERB "%4.0" "" COMPU_TAB_REF Conv.cMoeMesaf._.flag_schaltung_mes_aktiv_S5_S3 /end COMPU_METHOD
/begin COMPU_METHOD Conv.cMoeMesaf._.me_sas_pos_vor_stat_S5_S3 "Umrechnung fuer Messgroesse cMoeMesaf::me_sas_pos_vor_stat" TAB_VERB "%4.0" "" COMPU_TAB_REF Conv.cMoeMesaf._.me_sas_pos_vor_stat_S5_S3 /end COMPU_METHOD
/begin COMPU_METHOD Conv.cMoeMesaf._.momentenerhoehung_erlaubt_alt_S5_S3 "Umrechnung fuer Messgroesse cMoeMesaf::momentenerhoehung_erlaubt_alt" TAB_VERB "%4.0" "" COMPU_TAB_REF Conv.cMoeMesaf._.momentenerhoehung_erlaubt_alt_S5_S3 /end COMPU_METHOD
/begin COMPU_METHOD Conv.cMoeMesaf._.momentenerhoehung_erlaubt_S5_S3 "Umrechnung fuer Messgroesse cMoeMesaf::momentenerhoehung_erlaubt" TAB_VERB "%4.0" "" COMPU_TAB_REF Conv.cMoeMesaf._.momentenerhoehung_erlaubt_S5_S3 /end COMPU_METHOD
/begin COMPU_METHOD Conv.cMoeMesaf._.nachme_rs_losgelaufen_S5_S3 "Umrechnung fuer Messgroesse cMoeMesaf::nachme_rs_losgelaufen" TAB_VERB "%4.0" "" COMPU_TAB_REF Conv.cMoeMesaf._.nachme_rs_losgelaufen_S5_S3 /end COMPU_METHOD
/begin COMPU_METHOD Conv.cMoeMesaf._.schalttyp_mes_S5_S3 "Umrechnung fuer Messgroesse cMoeMesaf::schalttyp_mes" TAB_VERB "%4.0" "" COMPU_TAB_REF Conv.cMoeMesaf._.schalttyp_mes_S5_S3 /end COMPU_METHOD
/begin COMPU_METHOD Conv.cMoeMesaf._.verbot_sas_fkt_alt_S5_S3 "Umrechnung fuer Messgroesse cMoeMesaf::verbot_sas_fkt_alt" TAB_VERB "%4.0" "" COMPU_TAB_REF Conv.cMoeMesaf._.verbot_sas_fkt_alt_S5_S3 /end COMPU_METHOD
/begin COMPU_METHOD Conv.cMoeMesaf._.z_mes_S5_S3 "Umrechnung fuer Messgroesse cMoeMesaf::z_mes" TAB_VERB "%4.0" "" COMPU_TAB_REF Conv.cMoeMesaf._.z_mes_S5_S3 /end COMPU_METHOD
/begin COMPU_METHOD Conv.cMoeMesaf._.zust_haupt_me_gestartet_S5_S3 "Umrechnung fuer Messgroesse cMoeMesaf::zust_haupt_me_gestartet" TAB_VERB "%4.0" "" COMPU_TAB_REF Conv.cMoeMesaf._.zust_haupt_me_gestartet_S5_S3 /end COMPU_METHOD
/begin COMPU_METHOD Conv.cMonMoSig._.mon_mst_status_S5_S3 "Umrechnung fuer Messgroesse cMonMoSig::mon_mst_status" TAB_VERB "%4.0" "" COMPU_TAB_REF Conv.cMonMoSig._.mon_mst_status_S5_S3 /end COMPU_METHOD
/begin COMPU_METHOD Conv.cMvsZentr._.ps_aktiv_permanent_S5_S3 "Umrechnung fuer Messgroesse cMvsZentr::ps_aktiv_permanent" TAB_VERB "%4.0" "" COMPU_TAB_REF Conv.cMvsZentr._.ps_aktiv_permanent_S5_S3 /end COMPU_METHOD
/begin COMPU_METHOD Conv.cMvsZentr._.ps_aktiv_S5_S3 "Umrechnung fuer Messgroesse cMvsZentr::ps_aktiv" TAB_VERB "%4.0" "" COMPU_TAB_REF Conv.cMvsZentr._.ps_aktiv_S5_S3 /end COMPU_METHOD
/begin COMPU_METHOD Conv.cMvsZentr._.ps_magnet_timeout_S5_S3 "Umrechnung fuer Messgroesse cMvsZentr::ps_magnet_timeout" TAB_VERB "%4.0" "" COMPU_TAB_REF Conv.cMvsZentr._.ps_magnet_timeout_S5_S3 /end COMPU_METHOD
/begin COMPU_METHOD Conv.cMvsZentr._.ps_zustand_S5_S3 "Umrechnung fuer Messgroesse cMvsZentr::ps_zustand" TAB_VERB "%4.0" "" COMPU_TAB_REF Conv.cMvsZentr._.ps_zustand_S5_S3 /end COMPU_METHOD
/begin COMPU_METHOD Conv.cNvrKoordinator._.ee_anzeige_block_history_S5_S3 "Umrechnung fuer Messgroesse cNvrKoordinator::ee_anzeige_block_history" TAB_VERB "%4.0" "" COMPU_TAB_REF Conv.cNvrKoordinator._.ee_anzeige_block_history_S5_S3 /end COMPU_METHOD
/begin COMPU_METHOD Conv.cNvrKoordinator._.ee_management_status_S5_S3 "Umrechnung fuer Messgroesse cNvrKoordinator::ee_management_status" TAB_VERB "%4.0" "" COMPU_TAB_REF Conv.cNvrKoordinator._.ee_management_status_S5_S3 /end COMPU_METHOD
/begin COMPU_METHOD Conv.cNvrKoordinator._.ee_systemstart_ueber_reset_S5_S3 "Umrechnung fuer Messgroesse cNvrKoordinator::ee_systemstart_ueber_reset" TAB_VERB "%4.0" "" COMPU_TAB_REF Conv.cNvrKoordinator._.ee_systemstart_ueber_reset_S5_S3 /end COMPU_METHOD
/begin COMPU_METHOD Conv.cPAnzeige._.befuellung_schaltelement_aktiv_S5_S3 "Umrechnung fuer Messgroesse cPAnzeige::befuellung_schaltelement_aktiv" TAB_VERB "%4.0" "" COMPU_TAB_REF Conv.cPAnzeige._.befuellung_schaltelement_aktiv_S5_S3 /end COMPU_METHOD
/begin COMPU_METHOD Conv.cPAnzeige._.kzu_beob_kup_ada_S5_S3 "Umrechnung fuer Messgroesse cPAnzeige::kzu_beob_kup_ada" TAB_VERB "%4.0" "" COMPU_TAB_REF Conv.cPAnzeige._.kzu_beob_kup_ada_S5_S3 /end COMPU_METHOD
/begin COMPU_METHOD Conv.cSasAnGea._.ende_kab_gestartet_S5_S3 "Umrechnung fuer Messgroesse cSasAnGea::ende_kab_gestartet" TAB_VERB "%4.0" "" COMPU_TAB_REF Conv.cSasAnGea._.ende_kab_gestartet_S5_S3 /end COMPU_METHOD
/begin COMPU_METHOD Conv.cSasAnGea._.erste_schaltung_S5_S3 "Umrechnung fuer Messgroesse cSasAnGea::erste_schaltung" TAB_VERB "%4.0" "" COMPU_TAB_REF Conv.cSasAnGea._.erste_schaltung_S5_S3 /end COMPU_METHOD
/begin COMPU_METHOD Conv.cSasAnGea._.f_pfmin_erreicht_S5_S3 "Umrechnung fuer Messgroesse cSasAnGea::f_pfmin_erreicht" TAB_VERB "%4.0" "" COMPU_TAB_REF Conv.cSasAnGea._.f_pfmin_erreicht_S5_S3 /end COMPU_METHOD
/begin COMPU_METHOD Conv.cSasAnGea._.f_pokzu_kfl_zuletzt_wechsel_S5_S3 "Umrechnung fuer Messgroesse cSasAnGea::f_pokzu_kfl_zuletzt_wechsel" TAB_VERB "%4.0" "" COMPU_TAB_REF Conv.cSasAnGea._.f_pokzu_kfl_zuletzt_wechsel_S5_S3 /end COMPU_METHOD
/begin COMPU_METHOD Conv.cSasAnGea._.f_schnellfuellung_gestartet_S5_S3 "Umrechnung fuer Messgroesse cSasAnGea::f_schnellfuellung_gestartet" TAB_VERB "%4.0" "" COMPU_TAB_REF Conv.cSasAnGea._.f_schnellfuellung_gestartet_S5_S3 /end COMPU_METHOD
/begin COMPU_METHOD Conv.cSasAnGea._.f_timeout_S5_S3 "Umrechnung fuer Messgroesse cSasAnGea::f_timeout" TAB_VERB "%4.0" "" COMPU_TAB_REF Conv.cSasAnGea._.f_timeout_S5_S3 /end COMPU_METHOD
/begin COMPU_METHOD Conv.cSasAnGea._.f_verb_ada_erste_bef_S5_S3 "Umrechnung fuer Messgroesse cSasAnGea::f_verb_ada_erste_bef" TAB_VERB "%4.0" "" COMPU_TAB_REF Conv.cSasAnGea._.f_verb_ada_erste_bef_S5_S3 /end COMPU_METHOD
/begin COMPU_METHOD Conv.cSasAnGea._.fa_kzu_gestartet_S5_S3 "Umrechnung fuer Messgroesse cSasAnGea::fa_kzu_gestartet" TAB_VERB "%4.0" "" COMPU_TAB_REF Conv.cSasAnGea._.fa_kzu_gestartet_S5_S3 /end COMPU_METHOD
/begin COMPU_METHOD Conv.cSasAnGea._.gea_ablauf_aktiv_S5_S3 "Umrechnung fuer Messgroesse cSasAnGea::gea_ablauf_aktiv" TAB_VERB "%4.0" "" COMPU_TAB_REF Conv.cSasAnGea._.gea_ablauf_aktiv_S5_S3 /end COMPU_METHOD
/begin COMPU_METHOD Conv.cSasAnGea._.instanz_nr_S5_S3 "Umrechnung fuer Messgroesse cSasAnGea::instanz_nr" TAB_VERB "%4.0" "" COMPU_TAB_REF Conv.cSasAnGea._.instanz_nr_S5_S3 /end COMPU_METHOD
/begin COMPU_METHOD Conv.cSasAnGea._.kup_ga_S5_S3 "Umrechnung fuer Messgroesse cSasAnGea::kup_ga" TAB_VERB "%4.0" "" COMPU_TAB_REF Conv.cSasAnGea._.kup_ga_S5_S3 /end COMPU_METHOD
/begin COMPU_METHOD Conv.cSasAnGea._.kup_ge_S5_S3 "Umrechnung fuer Messgroesse cSasAnGea::kup_ge" TAB_VERB "%4.0" "" COMPU_TAB_REF Conv.cSasAnGea._.kup_ge_S5_S3 /end COMPU_METHOD
/begin COMPU_METHOD Conv.cSasAnGea._.kzu_voll_bei_start_S5_S3 "Umrechnung fuer Messgroesse cSasAnGea::kzu_voll_bei_start" TAB_VERB "%4.0" "" COMPU_TAB_REF Conv.cSasAnGea._.kzu_voll_bei_start_S5_S3 /end COMPU_METHOD
/begin COMPU_METHOD Conv.cSasAnGea._.po_fkzu_aktiv_S5_S3 "Umrechnung fuer Messgroesse cSasAnGea::po_fkzu_aktiv" TAB_VERB "%4.0" "" COMPU_TAB_REF Conv.cSasAnGea._.po_fkzu_aktiv_S5_S3 /end COMPU_METHOD
/begin COMPU_METHOD Conv.cSasAnGea._.ra1_ge_gestartet_S5_S3 "Umrechnung fuer Messgroesse cSasAnGea::ra1_ge_gestartet" TAB_VERB "%4.0" "" COMPU_TAB_REF Conv.cSasAnGea._.ra1_ge_gestartet_S5_S3 /end COMPU_METHOD
/begin COMPU_METHOD Conv.cSasAnGea._.ra2_ge_gestartet_S5_S3 "Umrechnung fuer Messgroesse cSasAnGea::ra2_ge_gestartet" TAB_VERB "%4.0" "" COMPU_TAB_REF Conv.cSasAnGea._.ra2_ge_gestartet_S5_S3 /end COMPU_METHOD
/begin COMPU_METHOD Conv.cSasAnGea._.ra3_ge_gestartet_S5_S3 "Umrechnung fuer Messgroesse cSasAnGea::ra3_ge_gestartet" TAB_VERB "%4.0" "" COMPU_TAB_REF Conv.cSasAnGea._.ra3_ge_gestartet_S5_S3 /end COMPU_METHOD
/begin COMPU_METHOD Conv.cSasAnGea._.schalttyp_gea_S5_S3 "Umrechnung fuer Messgroesse cSasAnGea::schalttyp_gea" TAB_VERB "%4.0" "" COMPU_TAB_REF Conv.cSasAnGea._.schalttyp_gea_S5_S3 /end COMPU_METHOD
/begin COMPU_METHOD Conv.cSasAnGea._.schliessen_kup_in_n_gestartet_S5_S3 "Umrechnung fuer Messgroesse cSasAnGea::schliessen_kup_in_n_gestartet" TAB_VERB "%4.0" "" COMPU_TAB_REF Conv.cSasAnGea._.schliessen_kup_in_n_gestartet_S5_S3 /end COMPU_METHOD
/begin COMPU_METHOD Conv.cSasAnGea._.schnellfuellung_beendet_S5_S3 "Umrechnung fuer Messgroesse cSasAnGea::schnellfuellung_beendet" TAB_VERB "%4.0" "" COMPU_TAB_REF Conv.cSasAnGea._.schnellfuellung_beendet_S5_S3 /end COMPU_METHOD
/begin COMPU_METHOD Conv.cSasAnGea._.statisch_gea_S5_S3 "Umrechnung fuer Messgroesse cSasAnGea::statisch_gea" TAB_VERB "%4.0" "" COMPU_TAB_REF Conv.cSasAnGea._.statisch_gea_S5_S3 /end COMPU_METHOD
/begin COMPU_METHOD Conv.cSasAnGea._.synchron_verboten_S5_S3 "Umrechnung fuer Messgroesse cSasAnGea::synchron_verboten" TAB_VERB "%4.0" "" COMPU_TAB_REF Conv.cSasAnGea._.synchron_verboten_S5_S3 /end COMPU_METHOD
/begin COMPU_METHOD Conv.cSasAnGea._.z_gea_S5_S3 "Umrechnung fuer Messgroesse cSasAnGea::z_gea" TAB_VERB "%4.0" "" COMPU_TAB_REF Conv.cSasAnGea._.z_gea_S5_S3 /end COMPU_METHOD
/begin COMPU_METHOD Conv.cSasAnGea._.z_modus_gea_S5_S3 "Umrechnung fuer Messgroesse cSasAnGea::z_modus_gea" TAB_VERB "%4.0" "" COMPU_TAB_REF Conv.cSasAnGea._.z_modus_gea_S5_S3 /end COMPU_METHOD
/begin COMPU_METHOD Conv.cSasAnGls._.filter_wngtgls_gestartet_S5_S3 "Umrechnung fuer Messgroesse cSasAnGls::filter_wngtgls_gestartet" TAB_VERB "%4.0" "" COMPU_TAB_REF Conv.cSasAnGls._.filter_wngtgls_gestartet_S5_S3 /end COMPU_METHOD
/begin COMPU_METHOD Conv.cSasAnGls._.gls_aktiv_S5_S3 "Umrechnung fuer Messgroesse cSasAnGls::gls_aktiv" TAB_VERB "%4.0" "" COMPU_TAB_REF Conv.cSasAnGls._.gls_aktiv_S5_S3 /end COMPU_METHOD
/begin COMPU_METHOD Conv.cSasAnGls._.gls_mindruck_S5_S3 "Umrechnung fuer Messgroesse cSasAnGls::gls_mindruck" TAB_VERB "%4.0" "" COMPU_TAB_REF Conv.cSasAnGls._.gls_mindruck_S5_S3 /end COMPU_METHOD
/begin COMPU_METHOD Conv.cSasAnGls._.reg_gls_gestartet_S5_S3 "Umrechnung fuer Messgroesse cSasAnGls::reg_gls_gestartet" TAB_VERB "%4.0" "" COMPU_TAB_REF Conv.cSasAnGls._.reg_gls_gestartet_S5_S3 /end COMPU_METHOD
/begin COMPU_METHOD Conv.cSasAnGls._.schalttyp_gls_S5_S3 "Umrechnung fuer Messgroesse cSasAnGls::schalttyp_gls" TAB_VERB "%4.0" "" COMPU_TAB_REF Conv.cSasAnGls._.schalttyp_gls_S5_S3 /end COMPU_METHOD
/begin COMPU_METHOD Conv.cSasAnGls._.schaltung_gls_S5_S3 "Umrechnung fuer Messgroesse cSasAnGls::schaltung_gls" TAB_VERB "%4.0" "" COMPU_TAB_REF Conv.cSasAnGls._.schaltung_gls_S5_S3 /end COMPU_METHOD
/begin COMPU_METHOD Conv.cSasAnGls._.verz_gls_gestartet_S5_S3 "Umrechnung fuer Messgroesse cSasAnGls::verz_gls_gestartet" TAB_VERB "%4.0" "" COMPU_TAB_REF Conv.cSasAnGls._.verz_gls_gestartet_S5_S3 /end COMPU_METHOD
/begin COMPU_METHOD Conv.cSasAnGls._.wechsel_normal_kurz_S5_S3 "Umrechnung fuer Messgroesse cSasAnGls::wechsel_normal_kurz" TAB_VERB "%4.0" "" COMPU_TAB_REF Conv.cSasAnGls._.wechsel_normal_kurz_S5_S3 /end COMPU_METHOD
/begin COMPU_METHOD Conv.cSasAnGls._.z_gls_regler_S5_S3 "Umrechnung fuer Messgroesse cSasAnGls::z_gls_regler" TAB_VERB "%4.0" "" COMPU_TAB_REF Conv.cSasAnGls._.z_gls_regler_S5_S3 /end COMPU_METHOD
/begin COMPU_METHOD Conv.cSasAnGls._.z_gls_S5_S3 "Umrechnung fuer Messgroesse cSasAnGls::z_gls" TAB_VERB "%4.0" "" COMPU_TAB_REF Conv.cSasAnGls._.z_gls_S5_S3 /end COMPU_METHOD
/begin COMPU_METHOD Conv.cSasAnGls._.zug_schub_gls_S5_S3 "Umrechnung fuer Messgroesse cSasAnGls::zug_schub_gls" TAB_VERB "%4.0" "" COMPU_TAB_REF Conv.cSasAnGls._.zug_schub_gls_S5_S3 /end COMPU_METHOD
/begin COMPU_METHOD Conv.cSasAnKab._.ende_kab_gestartet_S5_S3 "Umrechnung fuer Messgroesse cSasAnKab::ende_kab_gestartet" TAB_VERB "%4.0" "" COMPU_TAB_REF Conv.cSasAnKab._.ende_kab_gestartet_S5_S3 /end COMPU_METHOD
/begin COMPU_METHOD Conv.cSasAnKab._.f_best_poffkab_in_syn_erfolgt_S5_S3 "Umrechnung fuer Messgroesse cSasAnKab::f_best_poffkab_in_syn_erfolgt" TAB_VERB "%4.0" "" COMPU_TAB_REF Conv.cSasAnKab._.f_best_poffkab_in_syn_erfolgt_S5_S3 /end COMPU_METHOD
/begin COMPU_METHOD Conv.cSasAnKab._.f_ende_verz_kab_erlaubt_S5_S3 "Umrechnung fuer Messgroesse cSasAnKab::f_ende_verz_kab_erlaubt" TAB_VERB "%4.0" "" COMPU_TAB_REF Conv.cSasAnKab._.f_ende_verz_kab_erlaubt_S5_S3 /end COMPU_METHOD
/begin COMPU_METHOD Conv.cSasAnKab._.f_rueckf_pozustartk0_aktiv_S5_S3 "Umrechnung fuer Messgroesse cSasAnKab::f_rueckf_pozustartk0_aktiv" TAB_VERB "%4.0" "" COMPU_TAB_REF Conv.cSasAnKab._.f_rueckf_pozustartk0_aktiv_S5_S3 /end COMPU_METHOD
/begin COMPU_METHOD Conv.cSasAnKab._.f_warten_auf_sf_k0_aktiv_S5_S3 "Umrechnung fuer Messgroesse cSasAnKab::f_warten_auf_sf_k0_aktiv" TAB_VERB "%4.0" "" COMPU_TAB_REF Conv.cSasAnKab._.f_warten_auf_sf_k0_aktiv_S5_S3 /end COMPU_METHOD
/begin COMPU_METHOD Conv.cSasAnKab._.gls_hs_kab_gestartet_S5_S3 "Umrechnung fuer Messgroesse cSasAnKab::gls_hs_kab_gestartet" TAB_VERB "%4.0" "" COMPU_TAB_REF Conv.cSasAnKab._.gls_hs_kab_gestartet_S5_S3 /end COMPU_METHOD
/begin COMPU_METHOD Conv.cSasAnKab._.halten_in_syn_kab_gestartet_S5_S3 "Umrechnung fuer Messgroesse cSasAnKab::halten_in_syn_kab_gestartet" TAB_VERB "%4.0" "" COMPU_TAB_REF Conv.cSasAnKab._.halten_in_syn_kab_gestartet_S5_S3 /end COMPU_METHOD
/begin COMPU_METHOD Conv.cSasAnKab._.kab_nicht_befuellt_S5_S3 "Umrechnung fuer Messgroesse cSasAnKab::kab_nicht_befuellt" TAB_VERB "%4.0" "" COMPU_TAB_REF Conv.cSasAnKab._.kab_nicht_befuellt_S5_S3 /end COMPU_METHOD
/begin COMPU_METHOD Conv.cSasAnKab._.kup_kab_S5_S3 "Umrechnung fuer Messgroesse cSasAnKab::kup_kab" TAB_VERB "%4.0" "" COMPU_TAB_REF Conv.cSasAnKab._.kup_kab_S5_S3 /end COMPU_METHOD
/begin COMPU_METHOD Conv.cSasAnKab._.pkf_rs_kab_ausgegeben_S5_S3 "Umrechnung fuer Messgroesse cSasAnKab::pkf_rs_kab_ausgegeben" TAB_VERB "%4.0" "" COMPU_TAB_REF Conv.cSasAnKab._.pkf_rs_kab_ausgegeben_S5_S3 /end COMPU_METHOD
/begin COMPU_METHOD Conv.cSasAnKab._.pkf_rs_kab_gestartet_S5_S3 "Umrechnung fuer Messgroesse cSasAnKab::pkf_rs_kab_gestartet" TAB_VERB "%4.0" "" COMPU_TAB_REF Conv.cSasAnKab._.pkf_rs_kab_gestartet_S5_S3 /end COMPU_METHOD
/begin COMPU_METHOD Conv.cSasAnKab._.ps_hs_kab_gestartet_S5_S3 "Umrechnung fuer Messgroesse cSasAnKab::ps_hs_kab_gestartet" TAB_VERB "%4.0" "" COMPU_TAB_REF Conv.cSasAnKab._.ps_hs_kab_gestartet_S5_S3 /end COMPU_METHOD
/begin COMPU_METHOD Conv.cSasAnKab._.ra1_kab_gestartet_S5_S3 "Umrechnung fuer Messgroesse cSasAnKab::ra1_kab_gestartet" TAB_VERB "%4.0" "" COMPU_TAB_REF Conv.cSasAnKab._.ra1_kab_gestartet_S5_S3 /end COMPU_METHOD
/begin COMPU_METHOD Conv.cSasAnKab._.ra_sd_hs_kab_gestartet_S5_S3 "Umrechnung fuer Messgroesse cSasAnKab::ra_sd_hs_kab_gestartet" TAB_VERB "%4.0" "" COMPU_TAB_REF Conv.cSasAnKab._.ra_sd_hs_kab_gestartet_S5_S3 /end COMPU_METHOD
/begin COMPU_METHOD Conv.cSasAnKab._.ra_sd_rs_kab_gestartet_S5_S3 "Umrechnung fuer Messgroesse cSasAnKab::ra_sd_rs_kab_gestartet" TAB_VERB "%4.0" "" COMPU_TAB_REF Conv.cSasAnKab._.ra_sd_rs_kab_gestartet_S5_S3 /end COMPU_METHOD
/begin COMPU_METHOD Conv.cSasAnKab._.schalttyp_kab_S5_S3 "Umrechnung fuer Messgroesse cSasAnKab::schalttyp_kab" TAB_VERB "%4.0" "" COMPU_TAB_REF Conv.cSasAnKab._.schalttyp_kab_S5_S3 /end COMPU_METHOD
/begin COMPU_METHOD Conv.cSasAnKab._.statisch_kab_S5_S3 "Umrechnung fuer Messgroesse cSasAnKab::statisch_kab" TAB_VERB "%4.0" "" COMPU_TAB_REF Conv.cSasAnKab._.statisch_kab_S5_S3 /end COMPU_METHOD
/begin COMPU_METHOD Conv.cSasAnKab._.ueb_rs_kab_gestartet_S5_S3 "Umrechnung fuer Messgroesse cSasAnKab::ueb_rs_kab_gestartet" TAB_VERB "%4.0" "" COMPU_TAB_REF Conv.cSasAnKab._.ueb_rs_kab_gestartet_S5_S3 /end COMPU_METHOD
/begin COMPU_METHOD Conv.cSasAnKab._.z_kab_S5_S3 "Umrechnung fuer Messgroesse cSasAnKab::z_kab" TAB_VERB "%4.0" "" COMPU_TAB_REF Conv.cSasAnKab._.z_kab_S5_S3 /end COMPU_METHOD
/begin COMPU_METHOD Conv.cSasAnKzu._.f_hinsyn_kzu_gestartet_S5_S3 "Umrechnung fuer Messgroesse cSasAnKzu::f_hinsyn_kzu_gestartet" TAB_VERB "%4.0" "" COMPU_TAB_REF Conv.cSasAnKzu._.f_hinsyn_kzu_gestartet_S5_S3 /end COMPU_METHOD
/begin COMPU_METHOD Conv.cSasAnKzu._.f_ngs_abflare_unterschritten_S5_S3 "Umrechnung fuer Messgroesse cSasAnKzu::f_ngs_abflare_unterschritten" TAB_VERB "%4.0" "" COMPU_TAB_REF Conv.cSasAnKzu._.f_ngs_abflare_unterschritten_S5_S3 /end COMPU_METHOD
/begin COMPU_METHOD Conv.cSasAnKzu._.f_pokzufol_erlaubt_S5_S3 "Umrechnung fuer Messgroesse cSasAnKzu::f_pokzufol_erlaubt" TAB_VERB "%4.0" "" COMPU_TAB_REF Conv.cSasAnKzu._.f_pokzufol_erlaubt_S5_S3 /end COMPU_METHOD
/begin COMPU_METHOD Conv.cSasAnKzu._.f_rampenzeitberechnung_fertig_S5_S3 "Umrechnung fuer Messgroesse cSasAnKzu::f_rampenzeitberechnung_fertig" TAB_VERB "%4.0" "" COMPU_TAB_REF Conv.cSasAnKzu._.f_rampenzeitberechnung_fertig_S5_S3 /end COMPU_METHOD
/begin COMPU_METHOD Conv.cSasAnKzu._.f_schnellfuellung_war_aktiv_S5_S3 "Umrechnung fuer Messgroesse cSasAnKzu::f_schnellfuellung_war_aktiv" TAB_VERB "%4.0" "" COMPU_TAB_REF Conv.cSasAnKzu._.f_schnellfuellung_war_aktiv_S5_S3 /end COMPU_METHOD
/begin COMPU_METHOD Conv.cSasAnKzu._.fa_kzu_gestartet_S5_S3 "Umrechnung fuer Messgroesse cSasAnKzu::fa_kzu_gestartet" TAB_VERB "%4.0" "" COMPU_TAB_REF Conv.cSasAnKzu._.fa_kzu_gestartet_S5_S3 /end COMPU_METHOD
/begin COMPU_METHOD Conv.cSasAnKzu._.flag_pomekzu_erlaubt_S5_S3 "Umrechnung fuer Messgroesse cSasAnKzu::flag_pomekzu_erlaubt" TAB_VERB "%4.0" "" COMPU_TAB_REF Conv.cSasAnKzu._.flag_pomekzu_erlaubt_S5_S3 /end COMPU_METHOD
/begin COMPU_METHOD Conv.cSasAnKzu._.kup_kzu_S5_S3 "Umrechnung fuer Messgroesse cSasAnKzu::kup_kzu" TAB_VERB "%4.0" "" COMPU_TAB_REF Conv.cSasAnKzu._.kup_kzu_S5_S3 /end COMPU_METHOD
/begin COMPU_METHOD Conv.cSasAnKzu._.p_fkzu_gueltig_S5_S3 "Umrechnung fuer Messgroesse cSasAnKzu::p_fkzu_gueltig" TAB_VERB "%4.0" "" COMPU_TAB_REF Conv.cSasAnKzu._.p_fkzu_gueltig_S5_S3 /end COMPU_METHOD
/begin COMPU_METHOD Conv.cSasAnKzu._.ra1_hsrs_kzu_gestartet_S5_S3 "Umrechnung fuer Messgroesse cSasAnKzu::ra1_hsrs_kzu_gestartet" TAB_VERB "%4.0" "" COMPU_TAB_REF Conv.cSasAnKzu._.ra1_hsrs_kzu_gestartet_S5_S3 /end COMPU_METHOD
/begin COMPU_METHOD Conv.cSasAnKzu._.ra2_hsrs_kzu_gestartet_S5_S3 "Umrechnung fuer Messgroesse cSasAnKzu::ra2_hsrs_kzu_gestartet" TAB_VERB "%4.0" "" COMPU_TAB_REF Conv.cSasAnKzu._.ra2_hsrs_kzu_gestartet_S5_S3 /end COMPU_METHOD
/begin COMPU_METHOD Conv.cSasAnKzu._.ra3_hsrs_kzu_gestartet_S5_S3 "Umrechnung fuer Messgroesse cSasAnKzu::ra3_hsrs_kzu_gestartet" TAB_VERB "%4.0" "" COMPU_TAB_REF Conv.cSasAnKzu._.ra3_hsrs_kzu_gestartet_S5_S3 /end COMPU_METHOD
/begin COMPU_METHOD Conv.cSasAnKzu._.schalttyp_kzu_S5_S3 "Umrechnung fuer Messgroesse cSasAnKzu::schalttyp_kzu" TAB_VERB "%4.0" "" COMPU_TAB_REF Conv.cSasAnKzu._.schalttyp_kzu_S5_S3 /end COMPU_METHOD
/begin COMPU_METHOD Conv.cSasAnKzu._.schliessen_kzu_S5_S3 "Umrechnung fuer Messgroesse cSasAnKzu::schliessen_kzu" TAB_VERB "%4.0" "" COMPU_TAB_REF Conv.cSasAnKzu._.schliessen_kzu_S5_S3 /end COMPU_METHOD
/begin COMPU_METHOD Conv.cSasAnKzu._.statisch_kzu_S5_S3 "Umrechnung fuer Messgroesse cSasAnKzu::statisch_kzu" TAB_VERB "%4.0" "" COMPU_TAB_REF Conv.cSasAnKzu._.statisch_kzu_S5_S3 /end COMPU_METHOD
/begin COMPU_METHOD Conv.cSasAnKzu._.t_vkabr_abgelaufen_S5_S3 "Umrechnung fuer Messgroesse cSasAnKzu::t_vkabr_abgelaufen" TAB_VERB "%4.0" "" COMPU_TAB_REF Conv.cSasAnKzu._.t_vkabr_abgelaufen_S5_S3 /end COMPU_METHOD
/begin COMPU_METHOD Conv.cSasAnKzu._.z_kzu_S5_S3 "Umrechnung fuer Messgroesse cSasAnKzu::z_kzu" TAB_VERB "%4.0" "" COMPU_TAB_REF Conv.cSasAnKzu._.z_kzu_S5_S3 /end COMPU_METHOD
/begin COMPU_METHOD Conv.cSasPsyst._.f_auframpen_mg_psysminpuls_gest_S5_S3 "Umrechnung fuer Messgroesse cSasPsyst::f_auframpen_mg_psysminpuls_gest" TAB_VERB "%4.0" "" COMPU_TAB_REF Conv.cSasPsyst._.f_auframpen_mg_psysminpuls_gest_S5_S3 /end COMPU_METHOD
/begin COMPU_METHOD Conv.cSasPsyst._.f_einstiegsbed_p_sysiae_erf_S5_S3 "Umrechnung fuer Messgroesse cSasPsyst::f_einstiegsbed_p_sysiae_erf" TAB_VERB "%4.0" "" COMPU_TAB_REF Conv.cSasPsyst._.f_einstiegsbed_p_sysiae_erf_S5_S3 /end COMPU_METHOD
/begin COMPU_METHOD Conv.cSasPsyst._.f_psys_kupschutz_anst_laeuft_S5_S3 "Umrechnung fuer Messgroesse cSasPsyst::f_psys_kupschutz_anst_laeuft" TAB_VERB "%4.0" "" COMPU_TAB_REF Conv.cSasPsyst._.f_psys_kupschutz_anst_laeuft_S5_S3 /end COMPU_METHOD
/begin COMPU_METHOD Conv.cSasPsyst._.f_zeit_max_psys_abgelaufen_S5_S3 "Umrechnung fuer Messgroesse cSasPsyst::f_zeit_max_psys_abgelaufen" TAB_VERB "%4.0" "" COMPU_TAB_REF Conv.cSasPsyst._.f_zeit_max_psys_abgelaufen_S5_S3 /end COMPU_METHOD
/begin COMPU_METHOD Conv.cSasPsyst._.f_zeit_max_psys_anst_laeuft_S5_S3 "Umrechnung fuer Messgroesse cSasPsyst::f_zeit_max_psys_anst_laeuft" TAB_VERB "%4.0" "" COMPU_TAB_REF Conv.cSasPsyst._.f_zeit_max_psys_anst_laeuft_S5_S3 /end COMPU_METHOD
/begin COMPU_METHOD Conv.cSasPsyst._.fkt_druckvorgabe_psys_S5_S3 "Umrechnung fuer Messgroesse cSasPsyst::fkt_druckvorgabe_psys" TAB_VERB "%4.0" "" COMPU_TAB_REF Conv.cSasPsyst._.fkt_druckvorgabe_psys_S5_S3 /end COMPU_METHOD
/begin COMPU_METHOD Conv.cSasSaKor._.aktuelle_schaltung_S5_S3 "Umrechnung fuer Messgroesse cSasSaKor::aktuelle_schaltung" TAB_VERB "%4.0" "" COMPU_TAB_REF Conv.cSasSaKor._.aktuelle_schaltung_S5_S3 /end COMPU_METHOD
/begin COMPU_METHOD Conv.cSasSaKor._.erste_schaltung_S5_S3 "Umrechnung fuer Messgroesse cSasSaKor::erste_schaltung" TAB_VERB "%4.0" "" COMPU_TAB_REF Conv.cSasSaKor._.erste_schaltung_S5_S3 /end COMPU_METHOD
/begin COMPU_METHOD Conv.cSasSaKor._.f_verb_ada_erste_bef_S5_S3 "Umrechnung fuer Messgroesse cSasSaKor::f_verb_ada_erste_bef" TAB_VERB "%4.0" "" COMPU_TAB_REF Conv.cSasSaKor._.f_verb_ada_erste_bef_S5_S3 /end COMPU_METHOD
/begin COMPU_METHOD Conv.cSasSaKor._.fkt_halten_in_sync_verboten_S5_S3 "Umrechnung fuer Messgroesse cSasSaKor::fkt_halten_in_sync_verboten" TAB_VERB "%4.0" "" COMPU_TAB_REF Conv.cSasSaKor._.fkt_halten_in_sync_verboten_S5_S3 /end COMPU_METHOD
/begin COMPU_METHOD Conv.cSasSaKor._.index_spsas_S5_S3 "Umrechnung fuer Messgroesse cSasSaKor::index_spsas" TAB_VERB "%4.0" "" COMPU_TAB_REF Conv.cSasSaKor._.index_spsas_S5_S3 /end COMPU_METHOD
/begin COMPU_METHOD Conv.cSasSaKor._.istgang_sas_S5_S3 "Umrechnung fuer Messgroesse cSasSaKor::istgang_sas" TAB_VERB "%4.0" "" COMPU_TAB_REF Conv.cSasSaKor._.istgang_sas_S5_S3 /end COMPU_METHOD
/begin COMPU_METHOD Conv.cSasSaKor._.kup_schutz_massnahme_aktiv_S5_S3 "Umrechnung fuer Messgroesse cSasSaKor::kup_schutz_massnahme_aktiv" TAB_VERB "%4.0" "" COMPU_TAB_REF Conv.cSasSaKor._.kup_schutz_massnahme_aktiv_S5_S3 /end COMPU_METHOD
/begin COMPU_METHOD Conv.cSasSaKor._.schaltinfo_sas_S5_S3 "Umrechnung fuer Messgroesse cSasSaKor::schaltinfo_sas" TAB_VERB "%4.0" "" COMPU_TAB_REF Conv.cSasSaKor._.schaltinfo_sas_S5_S3 /end COMPU_METHOD
/begin COMPU_METHOD Conv.cSasSaKor._.schaltinfo_sas_vor_folge_S5_S3 "Umrechnung fuer Messgroesse cSasSaKor::schaltinfo_sas_vor_folge" TAB_VERB "%4.0" "" COMPU_TAB_REF Conv.cSasSaKor._.schaltinfo_sas_vor_folge_S5_S3 /end COMPU_METHOD
/begin COMPU_METHOD Conv.cSasSaKor._.schaltinfo_syn_S5_S3 "Umrechnung fuer Messgroesse cSasSaKor::schaltinfo_syn" TAB_VERB "%4.0" "" COMPU_TAB_REF Conv.cSasSaKor._.schaltinfo_syn_S5_S3 /end COMPU_METHOD
/begin COMPU_METHOD Conv.cSasSaKor._.schnellfuellung_beendet_S5_S3 "Umrechnung fuer Messgroesse cSasSaKor::schnellfuellung_beendet" TAB_VERB "%4.0" "" COMPU_TAB_REF Conv.cSasSaKor._.schnellfuellung_beendet_S5_S3 /end COMPU_METHOD
/begin COMPU_METHOD Conv.cSasSaKor._.schnellfuellung_gestartet_S5_S3 "Umrechnung fuer Messgroesse cSasSaKor::schnellfuellung_gestartet" TAB_VERB "%4.0" "" COMPU_TAB_REF Conv.cSasSaKor._.schnellfuellung_gestartet_S5_S3 /end COMPU_METHOD
/begin COMPU_METHOD Conv.cSasSaKor._.synchron_S5_S3 "Umrechnung fuer Messgroesse cSasSaKor::synchron" TAB_VERB "%4.0" "" COMPU_TAB_REF Conv.cSasSaKor._.synchron_S5_S3 /end COMPU_METHOD
/begin COMPU_METHOD Conv.cSasSaKor._.synchron_verboten_S5_S3 "Umrechnung fuer Messgroesse cSasSaKor::synchron_verboten" TAB_VERB "%4.0" "" COMPU_TAB_REF Conv.cSasSaKor._.synchron_verboten_S5_S3 /end COMPU_METHOD
/begin COMPU_METHOD Conv.cSasSaKor._.timeout_S5_S3 "Umrechnung fuer Messgroesse cSasSaKor::timeout" TAB_VERB "%4.0" "" COMPU_TAB_REF Conv.cSasSaKor._.timeout_S5_S3 /end COMPU_METHOD
/begin COMPU_METHOD Conv.cSasSaKor._.z_kurze_schaltung_S5_S3 "Umrechnung fuer Messgroesse cSasSaKor::z_kurze_schaltung" TAB_VERB "%4.0" "" COMPU_TAB_REF Conv.cSasSaKor._.z_kurze_schaltung_S5_S3 /end COMPU_METHOD
/begin COMPU_METHOD Conv.cSasSaKor._.zielgang_sas_S5_S3 "Umrechnung fuer Messgroesse cSasSaKor::zielgang_sas" TAB_VERB "%4.0" "" COMPU_TAB_REF Conv.cSasSaKor._.zielgang_sas_S5_S3 /end COMPU_METHOD
/begin COMPU_METHOD Conv.cSasSaKor._.zwangssynchron_S5_S3 "Umrechnung fuer Messgroesse cSasSaKor::zwangssynchron" TAB_VERB "%4.0" "" COMPU_TAB_REF Conv.cSasSaKor._.zwangssynchron_S5_S3 /end COMPU_METHOD
/begin COMPU_METHOD Conv.cSasStrat._.ber_red_durch_sf_notwendig_S5_S3 "Umrechnung fuer Messgroesse cSasStrat::ber_red_durch_sf_notwendig" TAB_VERB "%4.0" "" COMPU_TAB_REF Conv.cSasStrat._.ber_red_durch_sf_notwendig_S5_S3 /end COMPU_METHOD
/begin COMPU_METHOD Conv.cSasStrat._.f_nmot_ts_estart_S5_S3 "Umrechnung fuer Messgroesse cSasStrat::f_nmot_ts_estart" TAB_VERB "%4.0" "" COMPU_TAB_REF Conv.cSasStrat._.f_nmot_ts_estart_S5_S3 /end COMPU_METHOD
/begin COMPU_METHOD Conv.cSasStrat._.f_sltsf_estart_S5_S3 "Umrechnung fuer Messgroesse cSasStrat::f_sltsf_estart" TAB_VERB "%4.0" "" COMPU_TAB_REF Conv.cSasStrat._.f_sltsf_estart_S5_S3 /end COMPU_METHOD
/begin COMPU_METHOD Conv.cSasStrat._.flag_opt_bef_aush_sch_angef_S5_S3 "Umrechnung fuer Messgroesse cSasStrat::flag_opt_bef_aush_sch_angef" TAB_VERB "%4.0" "" COMPU_TAB_REF Conv.cSasStrat._.flag_opt_bef_aush_sch_angef_S5_S3 /end COMPU_METHOD
/begin COMPU_METHOD Conv.cSasStrat._.flag_opt_bef_inh_sch_angef_S5_S3 "Umrechnung fuer Messgroesse cSasStrat::flag_opt_bef_inh_sch_angef" TAB_VERB "%4.0" "" COMPU_TAB_REF Conv.cSasStrat._.flag_opt_bef_inh_sch_angef_S5_S3 /end COMPU_METHOD
/begin COMPU_METHOD Conv.cSasStrat._.flag_red_bef_aush_sch_angef_S5_S3 "Umrechnung fuer Messgroesse cSasStrat::flag_red_bef_aush_sch_angef" TAB_VERB "%4.0" "" COMPU_TAB_REF Conv.cSasStrat._.flag_red_bef_aush_sch_angef_S5_S3 /end COMPU_METHOD
/begin COMPU_METHOD Conv.cSasStrat._.flag_red_bef_inh_sch_angef_S5_S3 "Umrechnung fuer Messgroesse cSasStrat::flag_red_bef_inh_sch_angef" TAB_VERB "%4.0" "" COMPU_TAB_REF Conv.cSasStrat._.flag_red_bef_inh_sch_angef_S5_S3 /end COMPU_METHOD
/begin COMPU_METHOD Conv.cSasZentr._.abbruchsart_hs_gls_erlaubt_S5_S3 "Umrechnung fuer Messgroesse cSasZentr::abbruchsart_hs_gls_erlaubt" TAB_VERB "%4.0" "" COMPU_TAB_REF Conv.cSasZentr._.abbruchsart_hs_gls_erlaubt_S5_S3 /end COMPU_METHOD
/begin COMPU_METHOD Conv.cSasZentr._.abbruchsart_ist_S5_S3 "Umrechnung fuer Messgroesse cSasZentr::abbruchsart_ist" TAB_VERB "%4.0" "" COMPU_TAB_REF Conv.cSasZentr._.abbruchsart_ist_S5_S3 /end COMPU_METHOD
/begin COMPU_METHOD Conv.cSasZentr._.abbruchsart_soll_S5_S3 "Umrechnung fuer Messgroesse cSasZentr::abbruchsart_soll" TAB_VERB "%4.0" "" COMPU_TAB_REF Conv.cSasZentr._.abbruchsart_soll_S5_S3 /end COMPU_METHOD
/begin COMPU_METHOD Conv.cSasZentr._.event_sf_erkannt_S5_S3 "Umrechnung fuer Messgroesse cSasZentr::event_sf_erkannt" TAB_VERB "%4.0" "" COMPU_TAB_REF Conv.cSasZentr._.event_sf_erkannt_S5_S3 /end COMPU_METHOD
/begin COMPU_METHOD Conv.cSasZentr._.f_eco_mode_S5_S3 "Umrechnung fuer Messgroesse cSasZentr::f_eco_mode" TAB_VERB "%4.0" "" COMPU_TAB_REF Conv.cSasZentr._.f_eco_mode_S5_S3 /end COMPU_METHOD
/begin COMPU_METHOD Conv.cSasZentr._.f_einstiegsbed_erfuellt_S5_S3 "Umrechnung fuer Messgroesse cSasZentr::f_einstiegsbed_erfuellt" TAB_VERB "%4.0" "" COMPU_TAB_REF Conv.cSasZentr._.f_einstiegsbed_erfuellt_S5_S3 /end COMPU_METHOD
/begin COMPU_METHOD Conv.cSasZentr._.f_red_mmotmax_angefordert_S5_S3 "Umrechnung fuer Messgroesse cSasZentr::f_red_mmotmax_angefordert" TAB_VERB "%4.0" "" COMPU_TAB_REF Conv.cSasZentr._.f_red_mmotmax_angefordert_S5_S3 /end COMPU_METHOD
/begin COMPU_METHOD Conv.cSasZentr._.f_schaltung_normal_beendet_S5_S3 "Umrechnung fuer Messgroesse cSasZentr::f_schaltung_normal_beendet" TAB_VERB "%4.0" "" COMPU_TAB_REF Conv.cSasZentr._.f_schaltung_normal_beendet_S5_S3 /end COMPU_METHOD
/begin COMPU_METHOD Conv.cSasZentr._.flag_ge_dnr_aktiv_S5_S3 "Umrechnung fuer Messgroesse cSasZentr::flag_ge_dnr_aktiv" TAB_VERB "%4.0" "" COMPU_TAB_REF Conv.cSasZentr._.flag_ge_dnr_aktiv_S5_S3 /end COMPU_METHOD
/begin COMPU_METHOD Conv.cSasZentr._.flag_ge_rnd_aktiv_S5_S3 "Umrechnung fuer Messgroesse cSasZentr::flag_ge_rnd_aktiv" TAB_VERB "%4.0" "" COMPU_TAB_REF Conv.cSasZentr._.flag_ge_rnd_aktiv_S5_S3 /end COMPU_METHOD
/begin COMPU_METHOD Conv.cSasZentr._.flag_sync_verlassen_me_S5_S3 "Umrechnung fuer Messgroesse cSasZentr::flag_sync_verlassen_me" TAB_VERB "%4.0" "" COMPU_TAB_REF Conv.cSasZentr._.flag_sync_verlassen_me_S5_S3 /end COMPU_METHOD
/begin COMPU_METHOD Conv.cSasZentr._.folgeschaltung_S5_S3 "Umrechnung fuer Messgroesse cSasZentr::folgeschaltung" TAB_VERB "%4.0" "" COMPU_TAB_REF Conv.cSasZentr._.folgeschaltung_S5_S3 /end COMPU_METHOD
/begin COMPU_METHOD Conv.cSasZentr._.gangwechsel_S5_S3 "Umrechnung fuer Messgroesse cSasZentr::gangwechsel" TAB_VERB "%4.0" "" COMPU_TAB_REF Conv.cSasZentr._.gangwechsel_S5_S3 /end COMPU_METHOD
/begin COMPU_METHOD UMR___1_1_0_S5_S3 "int = ((phys * 1) / 1) - (0) [-]" RAT_FUNC "%1.0" "[-]" COEFFS 0 1 0 0 0 1 /end COMPU_METHOD
/begin COMPU_METHOD UMR_BAR__1_1000_0_S5_S3 "int = ((phys * 1000) / 1) - (0) [bar]" RAT_FUNC "%4.3" "[bar]" COEFFS 0 1000 0 0 0 1 /end COMPU_METHOD
/begin COMPU_METHOD UMR_BAR__1_20_0_S5_S3 "int = ((phys * 20) / 1) - (0) [bar]" RAT_FUNC "%3.2" "[bar]" COEFFS 0 20 0 0 0 1 /end COMPU_METHOD
/begin COMPU_METHOD UMR_BAR_SEC_1_10_0_S5_S3 "int = ((phys * 10) / 1) - (0) [bar/s]" RAT_FUNC "%2.1" "[bar/s]" COEFFS 0 10 0 0 0 1 /end COMPU_METHOD
/begin COMPU_METHOD UMR_GRADC__1_1_M40_S5_S3 "int = ((phys * 1) / 1) - (-40) [°C]" RAT_FUNC "%1.0" "[°C]" COEFFS 0 1 40 0 0 1 /end COMPU_METHOD
/begin COMPU_METHOD UMR_LITER_MIN_1_10_0_S5_S3 "int = ((phys * 10) / 1) - (0) [Liter/min]" RAT_FUNC "%2.1" "[Liter/min]" COEFFS 0 10 0 0 0 1 /end COMPU_METHOD
/begin COMPU_METHOD UMR_MSEC__10_1_0_S5_S3 "int = ((phys * 1) / 10) - (0) [ms]" RAT_FUNC "%1.0" "[ms]" COEFFS 0 0.1 0 0 0 1 /end COMPU_METHOD
/begin COMPU_METHOD UMR_MSEC__1_1_0_S5_S3 "int = ((phys * 1) / 1) - (0) [ms]" RAT_FUNC "%1.0" "[ms]" COEFFS 0 1 0 0 0 1 /end COMPU_METHOD
/begin COMPU_METHOD UMR_NM__1_1_0_S5_S3 "int = ((phys * 1) / 1) - (0) [Nm]" RAT_FUNC "%1.0" "[Nm]" COEFFS 0 1 0 0 0 1 /end COMPU_METHOD
/begin COMPU_METHOD UMR_SEC__1_1_0_S5_S3 "int = ((phys * 1) / 1) - (0) [s]" RAT_FUNC "%1.0" "[s]" COEFFS 0 1 0 0 0 1 /end COMPU_METHOD
/begin COMPU_METHOD UMR_U_MIN_1_1_0_S5_S3 "int = ((phys * 1) / 1) - (0) [U/min]" RAT_FUNC "%1.0" "[U/min]" COEFFS 0 1 0 0 0 1 /end COMPU_METHOD
/begin COMPU_METHOD UMR_U_MIN_32_1_0_S5_S3 "int = ((phys * 1) / 32) - (0) [U/min]" RAT_FUNC "%1.0" "[U/min]" COEFFS 0 0.03125 0 0 0 1 /end COMPU_METHOD
/begin COMPU_METHOD UMR_U_MINSEC_1_1_0_S5_S3 "int = ((phys * 1) / 1) - (0) [U/(min*s)]" RAT_FUNC "%1.0" "[U/(min*s)]" COEFFS 0 1 0 0 0 1 /end COMPU_METHOD
/begin MEASUREMENT iModHydlg.vnr_abgldat_im_boot "Im Boot enthaltene Versionsnummer der Abgleichdaten" ULONG Conv.cModHydlg._.vnr_abgldat_im_boot_S5_S3 1 100 0 255 ECU_ADDRESS 0xFFF8BBF8 DISPLAY_IDENTIFIER vnr_abgldat_im_boot.iModHydlg /end MEASUREMENT
/begin MEASUREMENT iModHydlg.zugriff_abgleichdaten "Zugriff Abgleichdaten" UBYTE Conv.cModHydlg._.zugriff_abgleichdaten_S5_S3 1 100 0 255 ECU_ADDRESS 0xFFF8BBF1 DISPLAY_IDENTIFIER zugriff_abgleichdaten.iModHydlg /end MEASUREMENT
/begin MEASUREMENT iMoeMesaf.f_neuber_startz_hme_hs_angef "FLAG: Neuberechnung der Startzeit des HME ist wird angefordert" UBYTE Conv.cMoeMesaf._.f_neuber_startz_hme_hs_angef_S5_S3 1 100 0 1 BIT_MASK 0x1 ECU_ADDRESS 0xFFF8BE74 DISPLAY_IDENTIFIER f_neuber_startz_hme_hs_angef.iMoeMesaf /end MEASUREMENT
/begin MEASUREMENT iMoeMesaf.f_neuber_startz_hme_hs_erfolgt "FLAG: Neuberechnung der Startzeit des HME wurde ausgeführt" UBYTE Conv.cMoeMesaf._.f_neuber_startz_hme_hs_erfolgt_S5_S3 1 100 0 1 BIT_MASK 0x1 ECU_ADDRESS 0xFFF8BE75 DISPLAY_IDENTIFIER f_neuber_startz_hme_hs_erfolgt.iMoeMesaf /end MEASUREMENT
/begin MEASUREMENT iMoeMesaf.f_unterdr_me "FLAG: Unterdrückung red. ME durch Leerlaufdrehzahlunterschr. aktiv" UBYTE Conv.cMoeMesaf._.f_unterdr_me_S5_S3 1 100 0 1 BIT_MASK 0x1 ECU_ADDRESS 0xFFF8BE6D DISPLAY_IDENTIFIER f_unterdr_me.iMoeMesaf /end MEASUREMENT
/begin MEASUREMENT iMoeMesaf.filter_spez_me.letzter_ms_timer "letzter Timerwert" UWORD UMR___1_1_0_S5_S3 1 100 0 65535 ECU_ADDRESS 0xFFF8BE98 DISPLAY_IDENTIFIER letzter_ms_timer.filter_spez_me.iMoeMesaf /end MEASUREMENT
/begin MEASUREMENT iMoeMesaf.filter_spez_me.start_wert "Startwert" SWORD UMR___1_1_0_S5_S3 1 100 -32768 32767 ECU_ADDRESS 0xFFF8BE90 DISPLAY_IDENTIFIER start_wert.filter_spez_me.iMoeMesaf /end MEASUREMENT
/begin MEASUREMENT iMoeMesaf.filter_spez_me.x "normierter letzter Wert (0 bis 1)" SLONG UMR___1_1_0_S5_S3 1 100 -2147483648 2147483647 ECU_ADDRESS 0xFFF8BE94 DISPLAY_IDENTIFIER x.filter_spez_me.iMoeMesaf /end MEASUREMENT
/begin MEASUREMENT iMoeMesaf.flag_me_haupt_aktiv "FLAG: Wert Hauptmotoreingriff wird ausgegeben" UBYTE Conv.cMoeMesaf._.flag_me_haupt_aktiv_S5_S3 1 100 0 1 BIT_MASK 0x1 ECU_ADDRESS 0xFFF8BE65 DISPLAY_IDENTIFIER flag_me_haupt_aktiv.iMoeMesaf /end MEASUREMENT
/begin MEASUREMENT iMoeMesaf.flag_schaltung_mes_aktiv "FLAG: Es ist eine Schaltung/Gangeinlegen aktiv" UBYTE Conv.cMoeMesaf._.flag_schaltung_mes_aktiv_S5_S3 1 100 0 1 BIT_MASK 0x1 ECU_ADDRESS 0xFFF8BE77 DISPLAY_IDENTIFIER flag_schaltung_mes_aktiv.iMoeMesaf /end MEASUREMENT
/begin MEASUREMENT iMoeMesaf.me_sas "Motoreingriff der Schaltablaufsteuerung" SWORD UMR_NM__1_1_0_S5_S3 1 100 -1500 1500 ECU_ADDRESS 0xFFF8BE60 DISPLAY_IDENTIFIER me_sas.iMoeMesaf /end MEASUREMENT
/begin MEASUREMENT iMoeMesaf.me_sas0_mee "gemerkter Wert ME bei Schaltungsende" SWORD UMR___1_1_0_S5_S3 1 100 -32768 32767 ECU_ADDRESS 0xFFF8BE7E DISPLAY_IDENTIFIER me_sas0_mee.iMoeMesaf /end MEASUREMENT
/begin MEASUREMENT iMoeMesaf.me_sas_gesp "Gespeicherter Motoreingriff" SWORD UMR_NM__1_1_0_S5_S3 1 100 -1500 1500 ECU_ADDRESS 0xFFF8BE68 DISPLAY_IDENTIFIER me_sas_gesp.iMoeMesaf /end MEASUREMENT
/begin MEASUREMENT iMoeMesaf.me_sas_gesp_kf "Gespeicherter ME letzter Zustand" SWORD UMR_NM__1_1_0_S5_S3 1 100 -1500 1500 ECU_ADDRESS 0xFFF8BE6A DISPLAY_IDENTIFIER me_sas_gesp_kf.iMoeMesaf /end MEASUREMENT
/begin MEASUREMENT iMoeMesaf.me_sas_int "interner ME-Wert, wird benoetigt, fuer Filterinitalisierungen" SWORD UMR___1_1_0_S5_S3 1 100 -32768 32767 ECU_ADDRESS 0xFFF8BE80 DISPLAY_IDENTIFIER me_sas_int.iMoeMesaf /end MEASUREMENT
/begin MEASUREMENT iMoeMesaf.me_sas_pos_vor "Voreilender Motoreingriff der Schaltablaufsteuerung" SWORD UMR_NM__1_1_0_S5_S3 1 100 -1500 1500 ECU_ADDRESS 0xFFF8BE62 DISPLAY_IDENTIFIER me_sas_pos_vor.iMoeMesaf /end MEASUREMENT
/begin MEASUREMENT iMoeMesaf.me_sas_pos_vor_stat "Statussignal zu voreilendem Motoreingriff" UBYTE Conv.cMoeMesaf._.me_sas_pos_vor_stat_S5_S3 1 100 0 1 BIT_MASK 0x1 ECU_ADDRESS 0xFFF8BE64 DISPLAY_IDENTIFIER me_sas_pos_vor_stat.iMoeMesaf /end MEASUREMENT
/begin MEASUREMENT iMoeMesaf.me_sas_start_nach_me "gemerkter Wert ME waehrend Nachmotoreingriff" SWORD UMR___1_1_0_S5_S3 1 100 -32768 32767 ECU_ADDRESS 0xFFF8BE88 DISPLAY_IDENTIFIER me_sas_start_nach_me.iMoeMesaf /end MEASUREMENT
/begin MEASUREMENT iMoeMesaf.me_sas_zwme_max "gemerkter staerkster Eingriffswert aus Zwangs-ME" SWORD UMR___1_1_0_S5_S3 1 100 -32768 32767 ECU_ADDRESS 0xFFF8BE72 DISPLAY_IDENTIFIER me_sas_zwme_max.iMoeMesaf /end MEASUREMENT
/begin MEASUREMENT iMoeMesaf.momentenerhoehung_erlaubt "Flag das Momentenerhoehung aktiv" UBYTE Conv.cMoeMesaf._.momentenerhoehung_erlaubt_S5_S3 1 100 0 1 BIT_MASK 0x1 ECU_ADDRESS 0xFFF8BE86 DISPLAY_IDENTIFIER momentenerhoehung_erlaubt.iMoeMesaf /end MEASUREMENT
/begin MEASUREMENT iMoeMesaf.momentenerhoehung_erlaubt_alt "Merker wie Flag momentenerhoehung_erlaubt im letzten Duchlauf gesetzt war (relevant zur Erkennung von LW)" UBYTE Conv.cMoeMesaf._.momentenerhoehung_erlaubt_alt_S5_S3 1 100 0 1 BIT_MASK 0x1 ECU_ADDRESS 0xFFF8BE87 DISPLAY_IDENTIFIER momentenerhoehung_erlaubt_alt.iMoeMesaf /end MEASUREMENT
/begin MEASUREMENT iMoeMesaf.nachme_rs_losgelaufen "Merker-Variable, das Nach-Me bei RS gestartet wurde" UBYTE Conv.cMoeMesaf._.nachme_rs_losgelaufen_S5_S3 1 100 0 1 BIT_MASK 0x1 ECU_ADDRESS 0xFFF8BE76 DISPLAY_IDENTIFIER nachme_rs_losgelaufen.iMoeMesaf /end MEASUREMENT
/begin MEASUREMENT iMoeMesaf.ng_abmesas "Abtriebsdrehzahlgradient fuer Motoreingriff" SWORD UMR_U_MINSEC_1_1_0_S5_S3 1 100 -1000 1000 ECU_ADDRESS 0xFFF8BE8A DISPLAY_IDENTIFIER ng_abmesas.iMoeMesaf /end MEASUREMENT
/begin MEASUREMENT iMoeMesaf.offset_n_motsolleer "Verbrennungsmotorgradienten abhängiger Offset auf die Motorleerlaufdrehzahl" SWORD UMR_U_MIN_1_1_0_S5_S3 1 100 0 1000 ECU_ADDRESS 0xFFF8BE6E DISPLAY_IDENTIFIER offset_n_motsolleer.iMoeMesaf /end MEASUREMENT
/begin MEASUREMENT iMoeMesaf.schalttyp_mes "Schalttyp fuer SAS-Motoreingriff" UBYTE Conv.cMoeMesaf._.schalttyp_mes_S5_S3 1 100 0 2 ECU_ADDRESS 0xFFF8BE67 DISPLAY_IDENTIFIER schalttyp_mes.iMoeMesaf /end MEASUREMENT
/begin MEASUREMENT iMoeMesaf.t_ramee "Dauer Rampe ME bei Schaltungsende" UBYTE UMR___1_1_0_S5_S3 1 100 0 255 ECU_ADDRESS 0xFFF8BE7C DISPLAY_IDENTIFIER t_ramee.iMoeMesaf /end MEASUREMENT
/begin MEASUREMENT iMoeMesaf.t_zmes "Zustandszeitdauer" SWORD UMR___1_1_0_S5_S3 1 100 -32768 32767 ECU_ADDRESS 0xFFF8BE84 DISPLAY_IDENTIFIER t_zmes.iMoeMesaf /end MEASUREMENT
/begin MEASUREMENT iMoeMesaf.timer_maxzeit_mes "Timer Maximalzeit ME" UBYTE UMR___1_1_0_S5_S3 1 100 0 255 ECU_ADDRESS 0xFFF8BE7A DISPLAY_IDENTIFIER timer_maxzeit_mes.iMoeMesaf /end MEASUREMENT
/begin MEASUREMENT iMoeMesaf.timer_ramee "Timer Rampe ME bei Schaltungsende" UBYTE UMR___1_1_0_S5_S3 1 100 0 255 ECU_ADDRESS 0xFFF8BE7B DISPLAY_IDENTIFIER timer_ramee.iMoeMesaf /end MEASUREMENT
/begin MEASUREMENT iMoeMesaf.timer_rampe_pos "Zustandstimer Motoreingriff Schaltablauf" UBYTE UMR_MSEC__10_1_0_S5_S3 1 100 0 2550 ECU_ADDRESS 0xFFF8BE6C DISPLAY_IDENTIFIER timer_rampe_pos.iMoeMesaf /end MEASUREMENT
/begin MEASUREMENT iMoeMesaf.timer_schaltung_mes "Timer seit Start Schaltung" UWORD UMR___1_1_0_S5_S3 1 100 0 65535 ECU_ADDRESS 0xFFF8BE78 DISPLAY_IDENTIFIER timer_schaltung_mes.iMoeMesaf /end MEASUREMENT
/begin MEASUREMENT iMoeMesaf.timer_zmes "Zustandstimer Motoreingriff Schaltablauf" UBYTE UMR_MSEC__10_1_0_S5_S3 1 100 0 2550 ECU_ADDRESS 0xFFF8BE71 DISPLAY_IDENTIFIER timer_zmes.iMoeMesaf /end MEASUREMENT
/begin MEASUREMENT iMoeMesaf.verbot_sas_fkt_alt "Merker Verbot SAS Funktionen" UBYTE Conv.cMoeMesaf._.verbot_sas_fkt_alt_S5_S3 1 100 0 1 BIT_MASK 0x1 ECU_ADDRESS 0xFFF8BE8C DISPLAY_IDENTIFIER verbot_sas_fkt_alt.iMoeMesaf /end MEASUREMENT
/begin MEASUREMENT iMoeMesaf.z_mes "Zustand Motoreingriff Schaltablauf" UBYTE Conv.cMoeMesaf._.z_mes_S5_S3 1 100 0 12 ECU_ADDRESS 0xFFF8BE70 DISPLAY_IDENTIFIER z_mes.iMoeMesaf /end MEASUREMENT
/begin MEASUREMENT iMoeMesaf.zaehler_zmes "Zustandszaehler" UBYTE UMR___1_1_0_S5_S3 1 100 0 255 ECU_ADDRESS 0xFFF8BE82 DISPLAY_IDENTIFIER zaehler_zmes.iMoeMesaf /end MEASUREMENT
/begin MEASUREMENT iMoeMesaf.zust_haupt_me_gestartet "FLAG: Zustand Hauptmotoreingriff ist gestartet" UBYTE Conv.cMoeMesaf._.zust_haupt_me_gestartet_S5_S3 1 100 0 1 BIT_MASK 0x1 ECU_ADDRESS 0xFFF8BE66 DISPLAY_IDENTIFIER zust_haupt_me_gestartet.iMoeMesaf /end MEASUREMENT
/begin MEASUREMENT iMonMoSig.mon_mst_klasse "Beobachtungs-Klasse Monitoring Motor Start" UBYTE UMR___1_1_0_S5_S3 1 100 0 8 ECU_ADDRESS 0xFFF8BEA9 DISPLAY_IDENTIFIER mon_mst_klasse.iMonMoSig /end MEASUREMENT
/begin MEASUREMENT iMonMoSig.mon_mst_status "Zustands- Groesse Monitoring Motor Start" UBYTE Conv.cMonMoSig._.mon_mst_status_S5_S3 1 100 0 3 ECU_ADDRESS 0xFFF8BEA8 DISPLAY_IDENTIFIER mon_mst_status.iMonMoSig /end MEASUREMENT
/begin MEASUREMENT iMonMoSig.mon_mst_timer "Timer (bzw. Zaehler) - erst nach 10s wechselt Motor AN <=> AUS" UWORD UMR___1_1_0_S5_S3 1 100 0 65535 ECU_ADDRESS 0xFFF8BEAA DISPLAY_IDENTIFIER mon_mst_timer.iMonMoSig /end MEASUREMENT
/begin MEASUREMENT iMvsZentr.iTimerKeinKfl.timer "Der aktuelle Timerwert" UBYTE UMR_MSEC__10_1_0_S5_S3 1 100 0 2550 ECU_ADDRESS 0xFFF8BEB1 DISPLAY_IDENTIFIER iTimerKeinKfl.iMvsZentr /end MEASUREMENT
/begin MEASUREMENT iMvsZentr.iTimerMagnet.timer "Der aktuelle Timerwert" UWORD UMR_MSEC__10_1_0_S5_S3 1 100 0 655350 ECU_ADDRESS 0xFFF8BEB2 DISPLAY_IDENTIFIER iTimerMagnet.iMvsZentr /end MEASUREMENT
/begin MEASUREMENT iMvsZentr.iTimerParksp.timer "Der aktuelle Timerwert" UBYTE UMR_MSEC__10_1_0_S5_S3 1 100 0 2550 ECU_ADDRESS 0xFFF8BEB0 DISPLAY_IDENTIFIER iTimerParksp.iMvsZentr /end MEASUREMENT
/begin MEASUREMENT iMvsZentr.ps_aktiv "repraesentiert den Zustand der Parksperren-Ansteuerung (Wichtig: Initialisierung muss false sein!)" UBYTE Conv.cMvsZentr._.ps_aktiv_S5_S3 1 100 0 1 BIT_MASK 0x1 ECU_ADDRESS 0xFFF8BEAD DISPLAY_IDENTIFIER ps_aktiv.iMvsZentr /end MEASUREMENT
/begin MEASUREMENT iMvsZentr.ps_aktiv_permanent "repraesentiert den Zustand der Parksperren-Ansteuerung Permanentmagnet (Wichtig: Initialisierung muss false sein!)" UBYTE Conv.cMvsZentr._.ps_aktiv_permanent_S5_S3 1 100 0 1 BIT_MASK 0x1 ECU_ADDRESS 0xFFF8BEAE DISPLAY_IDENTIFIER ps_aktiv_permanent.iMvsZentr /end MEASUREMENT
/begin MEASUREMENT iMvsZentr.ps_magnet_timeout "Parksperren-Ansteuerung Permanentmagnet Timeout" UBYTE Conv.cMvsZentr._.ps_magnet_timeout_S5_S3 1 100 0 1 BIT_MASK 0x1 ECU_ADDRESS 0xFFF8BEAF DISPLAY_IDENTIFIER ps_magnet_timeout.iMvsZentr /end MEASUREMENT
/begin MEASUREMENT iMvsZentr.ps_zustand "berechneter Zustandgröße Parsperre" UBYTE Conv.cMvsZentr._.ps_zustand_S5_S3 1 100 0 4 ECU_ADDRESS 0xFFF8BEAC DISPLAY_IDENTIFIER ps_zustand.iMvsZentr /end MEASUREMENT
/begin MEASUREMENT iNvrInSWP.ee_urstart_info_eeprom "Kopie des Uebergabe-Parameters des SW-Partners bei Urstart/Prog-Wechsel erkannt" UBYTE UMR___1_1_0_S5_S3 1 100 0 255 ECU_ADDRESS 0xFFF89441 DISPLAY_IDENTIFIER ee_urstart_info_eeprom.iNvrInSWP /end MEASUREMENT
/begin MEASUREMENT iNvrInSWP.f_externer_loesch_auftrag "Flag, TRUE, wenn CALL_ADA_LOESCHEN vom SWP aufgerufen wurde" UBYTE UMR___1_1_0_S5_S3 1 100 0 1 BIT_MASK 0x1 ECU_ADDRESS 0xFFF89447 DISPLAY_IDENTIFIER f_externer_loesch_auftrag.iNvrInSWP /end MEASUREMENT
/begin MEASUREMENT iNvrInSWP.n_aufruf_eeprom_default "Zaehler, der anzeigt, wie haeufig die Urstart-Funktion von SWP aufgerufen wurde" UBYTE UMR___1_1_0_S5_S3 1 100 0 255 ECU_ADDRESS 0xFFF89443 DISPLAY_IDENTIFIER n_aufruf_eeprom_default.iNvrInSWP /end MEASUREMENT
/begin MEASUREMENT iNvrInSWP.n_aufruf_eeprom_update "Zaehler, der anzeigt, wie haeufig die Update-Funktion von SWP aufgerufen wurde" UBYTE UMR___1_1_0_S5_S3 1 100 0 255 ECU_ADDRESS 0xFFF89444 DISPLAY_IDENTIFIER n_aufruf_eeprom_update.iNvrInSWP /end MEASUREMENT
/begin MEASUREMENT iNvrInSWP.n_aufruf_eeprom_valid "Zaehler, der anzeigt, wie haeufig die Check-Ram-Spiegel-Funktion von SWP aufgerufen wurde" UBYTE UMR___1_1_0_S5_S3 1 100 0 255 ECU_ADDRESS 0xFFF89442 DISPLAY_IDENTIFIER n_aufruf_eeprom_valid.iNvrInSWP /end MEASUREMENT
/begin MEASUREMENT iNvrInSWP.n_aufruf_statistics_update "Zaehler, der anzeigt, wie haeufig die Update-Funktion von SWP aufgerufen wurde" UBYTE UMR___1_1_0_S5_S3 1 100 0 255 ECU_ADDRESS 0xFFF89446 DISPLAY_IDENTIFIER n_aufruf_statistics_update.iNvrInSWP /end MEASUREMENT
/begin MEASUREMENT iNvrInSWP.n_aufruf_statistics_valid "Zaehler, der anzeigt, wie haeufig die Check-Ram-Spiegel-Funktion von SWP aufgerufen wurde" UBYTE UMR___1_1_0_S5_S3 1 100 0 255 ECU_ADDRESS 0xFFF89445 DISPLAY_IDENTIFIER n_aufruf_statistics_valid.iNvrInSWP /end MEASUREMENT
/begin MEASUREMENT iNvrKoordinator.ee_anzeige_block_history "Status EE-Management" UBYTE Conv.cNvrKoordinator._.ee_anzeige_block_history_S5_S3 1 100 0 10 ECU_ADDRESS 0xFFF89706 DISPLAY_IDENTIFIER ee_anzeige_block_history.iNvrKoordinator /end MEASUREMENT
/begin MEASUREMENT iNvrKoordinator.ee_management_status "Status EE-Management" UBYTE Conv.cNvrKoordinator._.ee_management_status_S5_S3 1 100 1 8 ECU_ADDRESS 0xFFF89705 DISPLAY_IDENTIFIER ee_management_status.iNvrKoordinator /end MEASUREMENT
/begin MEASUREMENT iNvrKoordinator.ee_systemstart_ueber_reset "Wurde System ueber Reset gestartet" UBYTE Conv.cNvrKoordinator._.ee_systemstart_ueber_reset_S5_S3 1 100 0 2 ECU_ADDRESS 0xFFF89707 DISPLAY_IDENTIFIER ee_systemstart_ueber_reset.iNvrKoordinator /end MEASUREMENT
/begin MEASUREMENT iPAnzeige.befuellung_schaltelement_aktiv "Flag für aktive Befüllung (SF bzw. Füllausgleich)" UBYTE Conv.cPAnzeige._.befuellung_schaltelement_aktiv_S5_S3 1 100 0 1 BIT_MASK 0x1 ECU_ADDRESS 0xFFF8D770 DISPLAY_IDENTIFIER befuellung_schaltelement_aktiv /end MEASUREMENT
/begin MEASUREMENT iPAnzeige.kzu_beob_kup_ada "Kupplung zu to_sfkup_ada und po_fkup_ada" UBYTE Conv.cPAnzeige._.kzu_beob_kup_ada_S5_S3 1 100 0 6 ECU_ADDRESS 0xFFF8D780 DISPLAY_IDENTIFIER kzu_beob_kup_ada /end MEASUREMENT
/begin MEASUREMENT iPAnzeige.p_abs_gsk "Absoluter Solldruck GSK" UWORD UMR_BAR__1_1000_0_S5_S3 1 100 0 20 ECU_ADDRESS 0xFFF8D77E DISPLAY_IDENTIFIER p_abs_gsk /end MEASUREMENT
/begin MEASUREMENT iPAnzeige.p_abs_kab "Absoluter Solldruck Kupplung KAB" UWORD UMR_BAR__1_1000_0_S5_S3 1 100 0 20 ECU_ADDRESS 0xFFF8D774 DISPLAY_IDENTIFIER p_abs_kab /end MEASUREMENT
/begin MEASUREMENT iPAnzeige.p_abs_kzu_puls "Absoluter Solldruck Kupplung KZU bzw. Kupplung Pulsada" UWORD UMR_BAR__1_1000_0_S5_S3 1 100 0 20 ECU_ADDRESS 0xFFF8D772 DISPLAY_IDENTIFIER p_abs_kzu_puls /end MEASUREMENT
/begin MEASUREMENT iPAnzeige.p_abs_v2kab "Absoluter Solldruck Kupplung 2. vorbereitenden KAB" UWORD UMR_BAR__1_1000_0_S5_S3 1 100 0 20 ECU_ADDRESS 0xFFF8D77C DISPLAY_IDENTIFIER p_abs_v2kab /end MEASUREMENT
/begin MEASUREMENT iPAnzeige.p_abs_v2kzu "Absoluter Solldruck Kupplung 2. vorbereitende KZU" UWORD UMR_BAR__1_1000_0_S5_S3 1 100 0 20 ECU_ADDRESS 0xFFF8D77A DISPLAY_IDENTIFIER p_abs_v2kzu /end MEASUREMENT
/begin MEASUREMENT iPAnzeige.p_abs_vkab "Absoluter Solldruck Kupplung vorbereitenden KAB" UWORD UMR_BAR__1_1000_0_S5_S3 1 100 0 20 ECU_ADDRESS 0xFFF8D778 DISPLAY_IDENTIFIER p_abs_vkab /end MEASUREMENT
/begin MEASUREMENT iPAnzeige.p_abs_vkzu "Absoluter Solldruck Kupplung vorbereitende KZU" UWORD UMR_BAR__1_1000_0_S5_S3 1 100 0 20 ECU_ADDRESS 0xFFF8D776 DISPLAY_IDENTIFIER p_abs_vkzu /end MEASUREMENT
/begin MEASUREMENT iPAnzeige.po_fkup_ada "Adaptionswert kupplungsbez. PF-Adaption zu kzu_beob_kup_ada" SWORD UMR_BAR__1_1000_0_S5_S3 1 100 -6 6 ECU_ADDRESS 0xFFF8D782 DISPLAY_IDENTIFIER po_fkup_ada /end MEASUREMENT
/begin MEASUREMENT iPAnzeige.to_sfkup_ada "Adaptionswert kupplungsbez. SF-Adaption zu kzu_beob_kup_ada" SWORD UMR_MSEC__1_1_0_S5_S3 1 100 -1000 1000 ECU_ADDRESS 0xFFF8D784 DISPLAY_IDENTIFIER to_sfkup_ada /end MEASUREMENT
/begin MEASUREMENT iPSystem.f_anst_statisch "Flag für die statische Ansteuerung" UBYTE Conv.cModPVorg._.f_anst_statisch_S5_S3 1 100 0 1 BIT_MASK 0x1 ECU_ADDRESS 0xFFF8BE2F DISPLAY_IDENTIFIER f_anst_statisch_System /end MEASUREMENT
/begin MEASUREMENT iPSystem.f_druck_vorgegeben "Flag, ob Druck an dieses Element in diesem Zyklus schon vorgegeben wurde" UBYTE Conv.cModPVorg._.f_druck_vorgegeben_S5_S3 1 100 0 1 BIT_MASK 0x1 ECU_ADDRESS 0xFFF8BE2E DISPLAY_IDENTIFIER f_druck_vorgegeben_System /end MEASUREMENT
/begin MEASUREMENT iPSystem.fktn_druckvorgabe "Die ansteuernde Funktion" UBYTE Conv.cModPVorg._.fktn_druckvorgabe_S5_S3 1 100 0 29 ECU_ADDRESS 0xFFF8BE30 DISPLAY_IDENTIFIER fktn_druckvorgabe_System /end MEASUREMENT
/begin MEASUREMENT iPSystem.p_abssoll "Solldruck der Kupplung" UWORD UMR_BAR__1_1000_0_S5_S3 1 100 0 20 ECU_ADDRESS 0xFFF8BE2A DISPLAY_IDENTIFIER p_abssoll_System /end MEASUREMENT
/begin MEASUREMENT iPSystem.p_abssoll_sys "Solldruck der Kupplung, begrentzt auf Systemdruck" UWORD UMR_BAR__1_1000_0_S5_S3 1 100 0 20 ECU_ADDRESS 0xFFF8BE2C DISPLAY_IDENTIFIER p_abssoll_sys_System /end MEASUREMENT
/begin MEASUREMENT iPSystem.p_vorgabe "Solldruck der Kupplung" UWORD UMR_BAR__1_1000_0_S5_S3 1 100 0 20 ECU_ADDRESS 0xFFF8BE28 DISPLAY_IDENTIFIER p_vorgabe_System /end MEASUREMENT
/begin MEASUREMENT iPSystem.typ_druckvorgabe "Der Typ des angesteuerten Druckes" UBYTE Conv.cModPVorg._.typ_druckvorgabe_S5_S3 1 100 0 4 ECU_ADDRESS 0xFFF8BE31 DISPLAY_IDENTIFIER typ_druckvorgabe_System /end MEASUREMENT
/begin MEASUREMENT iPWk.f_anst_statisch "Flag für die statische Ansteuerung" UBYTE Conv.cModPVorg._.f_anst_statisch_S5_S3 1 100 0 1 BIT_MASK 0x1 ECU_ADDRESS 0xFFF8BE43 DISPLAY_IDENTIFIER f_anst_statisch_Wk /end MEASUREMENT
/begin MEASUREMENT iPWk.f_druck_vorgegeben "Flag, ob Druck an dieses Element in diesem Zyklus schon vorgegeben wurde" UBYTE Conv.cModPVorg._.f_druck_vorgegeben_S5_S3 1 100 0 1 BIT_MASK 0x1 ECU_ADDRESS 0xFFF8BE42 DISPLAY_IDENTIFIER f_druck_vorgegeben_Wk /end MEASUREMENT
/begin MEASUREMENT iPWk.fktn_druckvorgabe "Die ansteuernde Funktion" UBYTE Conv.cModPVorg._.fktn_druckvorgabe_S5_S3 1 100 0 29 ECU_ADDRESS 0xFFF8BE44 DISPLAY_IDENTIFIER fktn_druckvorgabe_Wk /end MEASUREMENT
/begin MEASUREMENT iPWk.p_abssoll "Solldruck der Kupplung" UWORD UMR_BAR__1_1000_0_S5_S3 1 100 0 20 ECU_ADDRESS 0xFFF8BE3E DISPLAY_IDENTIFIER p_abssoll_Wk /end MEASUREMENT
/begin MEASUREMENT iPWk.p_abssoll_sys "Solldruck der Kupplung, begrentzt auf Systemdruck" UWORD UMR_BAR__1_1000_0_S5_S3 1 100 0 20 ECU_ADDRESS 0xFFF8BE40 DISPLAY_IDENTIFIER p_abssoll_sys_Wk /end MEASUREMENT
/begin MEASUREMENT iPWk.p_vorgabe "Solldruck der Kupplung" UWORD UMR_BAR__1_1000_0_S5_S3 1 100 0 20 ECU_ADDRESS 0xFFF8BE3C DISPLAY_IDENTIFIER p_vorgabe_Wk /end MEASUREMENT
/begin MEASUREMENT iPWk.typ_druckvorgabe "Der Typ des angesteuerten Druckes" UBYTE Conv.cModPVorg._.typ_druckvorgabe_S5_S3 1 100 0 4 ECU_ADDRESS 0xFFF8BE45 DISPLAY_IDENTIFIER typ_druckvorgabe_Wk /end MEASUREMENT
/begin MEASUREMENT iSasAnGeaKraftschl.dauer_ra1_ge_kzu "Zeitdauer der Rampe 1 der KZU (bei Gea)" SWORD UMR_MSEC__10_1_0_S5_S3 1 100 -327680 327670 ECU_ADDRESS 0xFFF8D298 DISPLAY_IDENTIFIER dauer_ra1_ge_kzu.iSasAnGeaKraftschl /end MEASUREMENT
/begin MEASUREMENT iSasAnGeaKraftschl.ende_kab_gestartet "Flag: Zustand Ende der abschaltenden Kupplung gestartet" UBYTE Conv.cSasAnGea._.ende_kab_gestartet_S5_S3 1 100 0 1 BIT_MASK 0x1 ECU_ADDRESS 0xFFF8D26B DISPLAY_IDENTIFIER ende_kab_gestartet.iSasAnGeaKraftschl /end MEASUREMENT
/begin MEASUREMENT iSasAnGeaKraftschl.erste_schaltung "Flag: 1. Befuellung einer Kupplung" UBYTE Conv.cSasAnGea._.erste_schaltung_S5_S3 1 100 0 1 BIT_MASK 0x1 ECU_ADDRESS 0xFFF8D269 DISPLAY_IDENTIFIER erste_schaltung.iSasAnGeaKraftschl /end MEASUREMENT
/begin MEASUREMENT iSasAnGeaKraftschl.f_pfmin_erreicht "FLAG: Kupplung hat p_fmin erreicht" UBYTE Conv.cSasAnGea._.f_pfmin_erreicht_S5_S3 1 100 0 1 BIT_MASK 0x1 ECU_ADDRESS 0xFFF8D283 DISPLAY_IDENTIFIER f_pfmin_erreicht.iSasAnGeaKraftschl /end MEASUREMENT
/begin MEASUREMENT iSasAnGeaKraftschl.f_pokzu_kfl_zuletzt_wechsel "FLAG: Druckoffset bei KFL-Wechsel verwenden" UBYTE Conv.cSasAnGea._.f_pokzu_kfl_zuletzt_wechsel_S5_S3 1 100 0 1 BIT_MASK 0x1 ECU_ADDRESS 0xFFF8D282 DISPLAY_IDENTIFIER f_pokzu_kfl_zuletzt_wechsel.iSasAnGeaKraftschl /end MEASUREMENT
/begin MEASUREMENT iSasAnGeaKraftschl.f_schnellfuellung_gestartet "FLAG: Schnellfuellung wurde gestartet" UBYTE Conv.cSasAnGea._.f_schnellfuellung_gestartet_S5_S3 1 100 0 1 BIT_MASK 0x1 ECU_ADDRESS 0xFFF8D27B DISPLAY_IDENTIFIER f_schnellfuellung_gestartet.iSasAnGeaKraftschl /end MEASUREMENT
/begin MEASUREMENT iSasAnGeaKraftschl.f_timeout "FLAG: Timeout" UBYTE Conv.cSasAnGea._.f_timeout_S5_S3 1 100 0 1 BIT_MASK 0x1 ECU_ADDRESS 0xFFF8D278 DISPLAY_IDENTIFIER f_timeout.iSasAnGeaKraftschl /end MEASUREMENT
/begin MEASUREMENT iSasAnGeaKraftschl.f_verb_ada_erste_bef "Flag: 1. Befuellung einer Kupplung verbietet Ada" UBYTE Conv.cSasAnGea._.f_verb_ada_erste_bef_S5_S3 1 100 0 1 BIT_MASK 0x1 ECU_ADDRESS 0xFFF8D26A DISPLAY_IDENTIFIER f_verb_ada_erste_bef.iSasAnGeaKraftschl /end MEASUREMENT
/begin MEASUREMENT iSasAnGeaKraftschl.fa_kzu_gestartet "Flag: Fuellausgleich KZU gestartet" UBYTE Conv.cSasAnGea._.fa_kzu_gestartet_S5_S3 1 100 0 1 BIT_MASK 0x1 ECU_ADDRESS 0xFFF8D26C DISPLAY_IDENTIFIER fa_kzu_gestartet.iSasAnGeaKraftschl /end MEASUREMENT
/begin MEASUREMENT iSasAnGeaKraftschl.gea_ablauf_aktiv "Flag: Gangein-/auslegen aktiv" UBYTE Conv.cSasAnGea._.gea_ablauf_aktiv_S5_S3 1 100 0 1 BIT_MASK 0x1 ECU_ADDRESS 0xFFF8D264 DISPLAY_IDENTIFIER gea_ablauf_aktiv.iSasAnGeaKraftschl /end MEASUREMENT
/begin MEASUREMENT iSasAnGeaKraftschl.instanz_nr "Instanzennummer des Gea-Ablaufs" UBYTE Conv.cSasAnGea._.instanz_nr_S5_S3 1 100 2 4 ECU_ADDRESS 0xFFF8D280 DISPLAY_IDENTIFIER instanz_nr.iSasAnGeaKraftschl /end MEASUREMENT
/begin MEASUREMENT iSasAnGeaKraftschl.kup_ga "Kupplung Gangauslegen" UBYTE Conv.cSasAnGea._.kup_ga_S5_S3 1 100 0 5 ECU_ADDRESS 0xFFF8D285 DISPLAY_IDENTIFIER kup_ga.iSasAnGeaKraftschl /end MEASUREMENT
/begin MEASUREMENT iSasAnGeaKraftschl.kup_ge "Kupplung Gangeinlegen" UBYTE Conv.cSasAnGea._.kup_ge_S5_S3 1 100 0 5 ECU_ADDRESS 0xFFF8D284 DISPLAY_IDENTIFIER kup_ge.iSasAnGeaKraftschl /end MEASUREMENT
/begin MEASUREMENT iSasAnGeaKraftschl.kzu_voll_bei_start "KZU war schon befuellt bei Start Schaltung" UBYTE Conv.cSasAnGea._.kzu_voll_bei_start_S5_S3 1 100 0 1 BIT_MASK 0x1 ECU_ADDRESS 0xFFF8D281 DISPLAY_IDENTIFIER kzu_voll_bei_start.iSasAnGeaKraftschl /end MEASUREMENT
/begin MEASUREMENT iSasAnGeaKraftschl.nd_nmotnt_init_ga "Gemerkter Wert von nd_nmot_nt bei Initialisierung GA" SWORD UMR_U_MIN_1_1_0_S5_S3 1 100 -10000 10000 ECU_ADDRESS 0xFFF8D29A DISPLAY_IDENTIFIER nd_nmotnt_init_ga.iSasAnGeaKraftschl /end MEASUREMENT
/begin MEASUREMENT iSasAnGeaKraftschl.p_0stgea "Zustandsanfangsdruck gesteuerter Anteil Ge/Ga" SWORD UMR_BAR__1_1000_0_S5_S3 1 100 -32.768 32.767 ECU_ADDRESS 0xFFF8D28C DISPLAY_IDENTIFIER p_0stgea.iSasAnGeaKraftschl /end MEASUREMENT
/begin MEASUREMENT iSasAnGeaKraftschl.p_adaptgea "Adaptionsdruck Ge/Ga" SWORD UMR_BAR__1_1000_0_S5_S3 1 100 -32.768 32.767 ECU_ADDRESS 0xFFF8D288 DISPLAY_IDENTIFIER p_adaptgea.iSasAnGeaKraftschl /end MEASUREMENT
/begin MEASUREMENT iSasAnGeaKraftschl.p_gea "Druckwert aus Druckberechnung Ge/Ga" SWORD UMR_BAR__1_1000_0_S5_S3 1 100 0 20 ECU_ADDRESS 0xFFF8D26E DISPLAY_IDENTIFIER p_gea.iSasAnGeaKraftschl /end MEASUREMENT
/begin MEASUREMENT iSasAnGeaKraftschl.p_offgea "Offsetdruck Ge/Ga" SWORD UMR_BAR__1_1000_0_S5_S3 1 100 -32.768 32.767 ECU_ADDRESS 0xFFF8D28A DISPLAY_IDENTIFIER p_offgea.iSasAnGeaKraftschl /end MEASUREMENT
/begin MEASUREMENT iSasAnGeaKraftschl.p_stgea "Gesteuerter Druckanteil aus Druckberechnung Ge/Ga" SWORD UMR_BAR__1_1000_0_S5_S3 1 100 0 20 ECU_ADDRESS 0xFFF8D270 DISPLAY_IDENTIFIER p_stgea.iSasAnGeaKraftschl /end MEASUREMENT
/begin MEASUREMENT iSasAnGeaKraftschl.pgo_gea_rampe.cBibRampeGradSi16._.letzter_ms_timer "Speichert den letzten BS-Timer" UWORD UMR_MSEC__1_1_0_S5_S3 1 100 0 65535 ECU_ADDRESS 0xFFF8D2A4 DISPLAY_IDENTIFIER letzter_ms_timer._.cBibRampeGradSi16.pgo_gea_rampe.iSasAnGeaKraftschl /end MEASUREMENT
/begin MEASUREMENT iSasAnGeaKraftschl.pgo_gea_rampe.cBibRampeGradSi16._.letzter_wert "Speichert den letzten Eingangswert" FLOAT32_IEEE UMR___1_1_0_S5_S3 1 100 -1e+037 1e+037 ECU_ADDRESS 0xFFF8D2A0 FORMAT "%3.2" DISPLAY_IDENTIFIER letzter_wert._.cBibRampeGradSi16.pgo_gea_rampe.iSasAnGeaKraftschl /end MEASUREMENT
/begin MEASUREMENT iSasAnGeaKraftschl.pgo_gea_rampe.cBibRampeGradSi16._.maximum "Maximum Begrenzung" FLOAT32_IEEE UMR___1_1_0_S5_S3 1 100 -1e+037 1e+037 ECU_ADDRESS 0xFFF8D2AC FORMAT "%3.2" DISPLAY_IDENTIFIER maximum._.cBibRampeGradSi16.pgo_gea_rampe.iSasAnGeaKraftschl /end MEASUREMENT
/begin MEASUREMENT iSasAnGeaKraftschl.pgo_gea_rampe.cBibRampeGradSi16._.minimum "Minimum Begrenzung" FLOAT32_IEEE UMR___1_1_0_S5_S3 1 100 -1e+037 1e+037 ECU_ADDRESS 0xFFF8D2A8 FORMAT "%3.2" DISPLAY_IDENTIFIER minimum._.cBibRampeGradSi16.pgo_gea_rampe.iSasAnGeaKraftschl /end MEASUREMENT
/begin MEASUREMENT iSasAnGeaKraftschl.pgo_nabgea "Schaltdruckgradienten Offset" SWORD UMR_BAR_SEC_1_10_0_S5_S3 1 100 -3276.8 3276.7 ECU_ADDRESS 0xFFF8D290 DISPLAY_IDENTIFIER pgo_nabgea.iSasAnGeaKraftschl /end MEASUREMENT
/begin MEASUREMENT iSasAnGeaKraftschl.po_fkzu_aktiv "Verzoegerung der Druckoffsetzausgabe wegen evtl. Druckuebernahme durch IAE" UBYTE Conv.cSasAnGea._.po_fkzu_aktiv_S5_S3 1 100 0 1 BIT_MASK 0x1 ECU_ADDRESS 0xFFF8D29C DISPLAY_IDENTIFIER po_fkzu_aktiv.iSasAnGeaKraftschl /end MEASUREMENT
/begin MEASUREMENT iSasAnGeaKraftschl.po_mtgea "Momentenabhaengiger Druckoffset Ge/Ga" SWORD UMR_BAR__1_1000_0_S5_S3 1 100 -32.768 32.767 ECU_ADDRESS 0xFFF8D28E DISPLAY_IDENTIFIER po_mtgea.iSasAnGeaKraftschl /end MEASUREMENT
/begin MEASUREMENT iSasAnGeaKraftschl.ra1_ge_gestartet "FLAG: Rampe 1 KZU gestartet" UBYTE Conv.cSasAnGea._.ra1_ge_gestartet_S5_S3 1 100 0 1 BIT_MASK 0x1 ECU_ADDRESS 0xFFF8D265 DISPLAY_IDENTIFIER ra1_ge_gestartet.iSasAnGeaKraftschl /end MEASUREMENT
/begin MEASUREMENT iSasAnGeaKraftschl.ra2_ge_gestartet "FLAG: Rampe 2 KZU gestartet" UBYTE Conv.cSasAnGea._.ra2_ge_gestartet_S5_S3 1 100 0 1 BIT_MASK 0x1 ECU_ADDRESS 0xFFF8D266 DISPLAY_IDENTIFIER ra2_ge_gestartet.iSasAnGeaKraftschl /end MEASUREMENT
/begin MEASUREMENT iSasAnGeaKraftschl.ra3_ge_gestartet "FLAG: Rampe 3 KZU gestartet" UBYTE Conv.cSasAnGea._.ra3_ge_gestartet_S5_S3 1 100 0 1 BIT_MASK 0x1 ECU_ADDRESS 0xFFF8D267 DISPLAY_IDENTIFIER ra3_ge_gestartet.iSasAnGeaKraftschl /end MEASUREMENT
/begin MEASUREMENT iSasAnGeaKraftschl.schalttyp_gea "Schalttyp des Gea-Ablaufs" UBYTE Conv.cSasAnGea._.schalttyp_gea_S5_S3 1 100 0 4 ECU_ADDRESS 0xFFF8D279 DISPLAY_IDENTIFIER schalttyp_gea.iSasAnGeaKraftschl /end MEASUREMENT
/begin MEASUREMENT iSasAnGeaKraftschl.schliessen_kup_in_n_gestartet "Flag: Kupplungsansteuerung in Neutral wurde gestartet" UBYTE Conv.cSasAnGea._.schliessen_kup_in_n_gestartet_S5_S3 1 100 0 1 BIT_MASK 0x1 ECU_ADDRESS 0xFFF8D26D DISPLAY_IDENTIFIER schliessen_kup_in_n_gestartet.iSasAnGeaKraftschl /end MEASUREMENT
/begin MEASUREMENT iSasAnGeaKraftschl.schnellfuellung_beendet "FLAG: Schnellfuellung beendet" UBYTE Conv.cSasAnGea._.schnellfuellung_beendet_S5_S3 1 100 0 1 BIT_MASK 0x1 ECU_ADDRESS 0xFFF8D27A DISPLAY_IDENTIFIER schnellfuellung_beendet.iSasAnGeaKraftschl /end MEASUREMENT
/begin MEASUREMENT iSasAnGeaKraftschl.statisch_gea "Flag: Statischansteuerung der GE/GA-Kupplung" UBYTE Conv.cSasAnGea._.statisch_gea_S5_S3 1 100 0 1 BIT_MASK 0x1 ECU_ADDRESS 0xFFF8D274 DISPLAY_IDENTIFIER statisch_gea.iSasAnGeaKraftschl /end MEASUREMENT
/begin MEASUREMENT iSasAnGeaKraftschl.synchron_verboten "FLAG: Synchron erreichen ist verboten" UBYTE Conv.cSasAnGea._.synchron_verboten_S5_S3 1 100 0 1 BIT_MASK 0x1 ECU_ADDRESS 0xFFF8D268 DISPLAY_IDENTIFIER synchron_verboten.iSasAnGeaKraftschl /end MEASUREMENT
/begin MEASUREMENT iSasAnGeaKraftschl.t_0kzu_gea "Zeitdauer des zuletzt durchlaufenen Zustands bei KZU" SWORD UMR_MSEC__10_1_0_S5_S3 1 100 -327680 327670 ECU_ADDRESS 0xFFF8D292 DISPLAY_IDENTIFIER t_0kzu_gea.iSasAnGeaKraftschl /end MEASUREMENT
/begin MEASUREMENT iSasAnGeaKraftschl.t_maxgea "Maximalzeit des GE/GA" UWORD UMR_MSEC__10_1_0_S5_S3 1 100 0 50000 ECU_ADDRESS 0xFFF8D276 DISPLAY_IDENTIFIER t_maxgea.iSasAnGeaKraftschl /end MEASUREMENT
/begin MEASUREMENT iSasAnGeaKraftschl.t_timeout "Zeit von Start Gangeinlegen bis Start Timeoutfunktion" UWORD UMR_MSEC__10_1_0_S5_S3 1 100 0 50000 ECU_ADDRESS 0xFFF8D27E DISPLAY_IDENTIFIER t_timeout.iSasAnGeaKraftschl /end MEASUREMENT
/begin MEASUREMENT iSasAnGeaKraftschl.t_zgea "Zustandszeitdauer des aktuellen Gea-Zustands" SWORD UMR_MSEC__10_1_0_S5_S3 1 100 -327680 327670 ECU_ADDRESS 0xFFF8D294 DISPLAY_IDENTIFIER t_zgea.iSasAnGeaKraftschl /end MEASUREMENT
/begin MEASUREMENT iSasAnGeaKraftschl.timer16_ra1_ge "Timer der mit Beginn der Rampe 1 startet" UWORD UMR_MSEC__10_1_0_S5_S3 1 100 0 655350 ECU_ADDRESS 0xFFF8D272 DISPLAY_IDENTIFIER timer16_ra1_ge.iSasAnGeaKraftschl /end MEASUREMENT
/begin MEASUREMENT iSasAnGeaKraftschl.timer_start_fa_kzu "Timer Zeit seit Start Fuellausgleich KZU (bei Gea)" UBYTE UMR_MSEC__10_1_0_S5_S3 1 100 0 2550 ECU_ADDRESS 0xFFF8D297 DISPLAY_IDENTIFIER timer_start_fa_kzu.iSasAnGeaKraftschl /end MEASUREMENT
/begin MEASUREMENT iSasAnGeaKraftschl.timer_zgea "Zustandstimer Gea-Ablauf" UBYTE UMR_MSEC__10_1_0_S5_S3 1 100 0 2550 ECU_ADDRESS 0xFFF8D296 DISPLAY_IDENTIFIER timer_zgea.iSasAnGeaKraftschl /end MEASUREMENT
/begin MEASUREMENT iSasAnGeaKraftschl.z_gea "Zustand Gangein-/auslegen" UBYTE Conv.cSasAnGea._.z_gea_S5_S3 1 100 0 20 ECU_ADDRESS 0xFFF8D275 DISPLAY_IDENTIFIER z_gea.iSasAnGeaKraftschl /end MEASUREMENT
/begin MEASUREMENT iSasAnGeaKraftschl.z_modus_gea "Betriebsmodus fuer GEA" UBYTE Conv.cSasAnGea._.z_modus_gea_S5_S3 1 100 0 2 ECU_ADDRESS 0xFFF8D27C DISPLAY_IDENTIFIER z_modus_gea.iSasAnGeaKraftschl /end MEASUREMENT
/begin MEASUREMENT iSasAnGeaKraftschl.zaehler_zgea "Zustandszaehler Gea-Ablauf" UBYTE UMR___1_1_0_S5_S3 1 100 0 255 ECU_ADDRESS 0xFFF8D286 DISPLAY_IDENTIFIER zaehler_zgea.iSasAnGeaKraftschl /end MEASUREMENT
/begin MEASUREMENT iSasAnGeaNichtKraftschl1.dauer_ra1_ge_kzu "Zeitdauer der Rampe 1 der KZU (bei Gea)" SWORD UMR_MSEC__10_1_0_S5_S3 1 100 -327680 327670 ECU_ADDRESS 0xFFF8D2FC DISPLAY_IDENTIFIER dauer_ra1_ge_kzu.iSasAnGeaNichtKraftschl1 /end MEASUREMENT
/begin MEASUREMENT iSasAnGeaNichtKraftschl1.ende_kab_gestartet "Flag: Zustand Ende der abschaltenden Kupplung gestartet" UBYTE Conv.cSasAnGea._.ende_kab_gestartet_S5_S3 1 100 0 1 BIT_MASK 0x1 ECU_ADDRESS 0xFFF8D2CF DISPLAY_IDENTIFIER ende_kab_gestartet.iSasAnGeaNichtKraftschl1 /end MEASUREMENT
/begin MEASUREMENT iSasAnGeaNichtKraftschl1.erste_schaltung "Flag: 1. Befuellung einer Kupplung" UBYTE Conv.cSasAnGea._.erste_schaltung_S5_S3 1 100 0 1 BIT_MASK 0x1 ECU_ADDRESS 0xFFF8D2CD DISPLAY_IDENTIFIER erste_schaltung.iSasAnGeaNichtKraftschl1 /end MEASUREMENT
/begin MEASUREMENT iSasAnGeaNichtKraftschl1.f_pfmin_erreicht "FLAG: Kupplung hat p_fmin erreicht" UBYTE Conv.cSasAnGea._.f_pfmin_erreicht_S5_S3 1 100 0 1 BIT_MASK 0x1 ECU_ADDRESS 0xFFF8D2E7 DISPLAY_IDENTIFIER f_pfmin_erreicht.iSasAnGeaNichtKraftschl1 /end MEASUREMENT
/begin MEASUREMENT iSasAnGeaNichtKraftschl1.f_pokzu_kfl_zuletzt_wechsel "FLAG: Druckoffset bei KFL-Wechsel verwenden" UBYTE Conv.cSasAnGea._.f_pokzu_kfl_zuletzt_wechsel_S5_S3 1 100 0 1 BIT_MASK 0x1 ECU_ADDRESS 0xFFF8D2E6 DISPLAY_IDENTIFIER f_pokzu_kfl_zuletzt_wechsel.iSasAnGeaNichtKraftschl1 /end MEASUREMENT
/begin MEASUREMENT iSasAnGeaNichtKraftschl1.f_schnellfuellung_gestartet "FLAG: Schnellfuellung wurde gestartet" UBYTE Conv.cSasAnGea._.f_schnellfuellung_gestartet_S5_S3 1 100 0 1 BIT_MASK 0x1 ECU_ADDRESS 0xFFF8D2DF DISPLAY_IDENTIFIER f_schnellfuellung_gestartet.iSasAnGeaNichtKraftschl1 /end MEASUREMENT
/begin MEASUREMENT iSasAnGeaNichtKraftschl1.f_timeout "FLAG: Timeout" UBYTE Conv.cSasAnGea._.f_timeout_S5_S3 1 100 0 1 BIT_MASK 0x1 ECU_ADDRESS 0xFFF8D2DC DISPLAY_IDENTIFIER f_timeout.iSasAnGeaNichtKraftschl1 /end MEASUREMENT
/begin MEASUREMENT iSasAnGeaNichtKraftschl1.f_verb_ada_erste_bef "Flag: 1. Befuellung einer Kupplung verbietet Ada" UBYTE Conv.cSasAnGea._.f_verb_ada_erste_bef_S5_S3 1 100 0 1 BIT_MASK 0x1 ECU_ADDRESS 0xFFF8D2CE DISPLAY_IDENTIFIER f_verb_ada_erste_bef.iSasAnGeaNichtKraftschl1 /end MEASUREMENT
/begin MEASUREMENT iSasAnGeaNichtKraftschl1.fa_kzu_gestartet "Flag: Fuellausgleich KZU gestartet" UBYTE Conv.cSasAnGea._.fa_kzu_gestartet_S5_S3 1 100 0 1 BIT_MASK 0x1 ECU_ADDRESS 0xFFF8D2D0 DISPLAY_IDENTIFIER fa_kzu_gestartet.iSasAnGeaNichtKraftschl1 /end MEASUREMENT
/begin MEASUREMENT iSasAnGeaNichtKraftschl1.gea_ablauf_aktiv "Flag: Gangein-/auslegen aktiv" UBYTE Conv.cSasAnGea._.gea_ablauf_aktiv_S5_S3 1 100 0 1 BIT_MASK 0x1 ECU_ADDRESS 0xFFF8D2C8 DISPLAY_IDENTIFIER gea_ablauf_aktiv.iSasAnGeaNichtKraftschl1 /end MEASUREMENT
/begin MEASUREMENT iSasAnGeaNichtKraftschl1.instanz_nr "Instanzennummer des Gea-Ablaufs" UBYTE Conv.cSasAnGea._.instanz_nr_S5_S3 1 100 2 4 ECU_ADDRESS 0xFFF8D2E4 DISPLAY_IDENTIFIER instanz_nr.iSasAnGeaNichtKraftschl1 /end MEASUREMENT
/begin MEASUREMENT iSasAnGeaNichtKraftschl1.kup_ga "Kupplung Gangauslegen" UBYTE Conv.cSasAnGea._.kup_ga_S5_S3 1 100 0 5 ECU_ADDRESS 0xFFF8D2E9 DISPLAY_IDENTIFIER kup_ga.iSasAnGeaNichtKraftschl1 /end MEASUREMENT
/begin MEASUREMENT iSasAnGeaNichtKraftschl1.kup_ge "Kupplung Gangeinlegen" UBYTE Conv.cSasAnGea._.kup_ge_S5_S3 1 100 0 5 ECU_ADDRESS 0xFFF8D2E8 DISPLAY_IDENTIFIER kup_ge.iSasAnGeaNichtKraftschl1 /end MEASUREMENT
/begin MEASUREMENT iSasAnGeaNichtKraftschl1.kzu_voll_bei_start "KZU war schon befuellt bei Start Schaltung" UBYTE Conv.cSasAnGea._.kzu_voll_bei_start_S5_S3 1 100 0 1 BIT_MASK 0x1 ECU_ADDRESS 0xFFF8D2E5 DISPLAY_IDENTIFIER kzu_voll_bei_start.iSasAnGeaNichtKraftschl1 /end MEASUREMENT
/begin MEASUREMENT iSasAnGeaNichtKraftschl1.nd_nmotnt_init_ga "Gemerkter Wert von nd_nmot_nt bei Initialisierung GA" SWORD UMR_U_MIN_1_1_0_S5_S3 1 100 -10000 10000 ECU_ADDRESS 0xFFF8D2FE DISPLAY_IDENTIFIER nd_nmotnt_init_ga.iSasAnGeaNichtKraftschl1 /end MEASUREMENT
/begin MEASUREMENT iSasAnGeaNichtKraftschl1.p_0stgea "Zustandsanfangsdruck gesteuerter Anteil Ge/Ga" SWORD UMR_BAR__1_1000_0_S5_S3 1 100 -32.768 32.767 ECU_ADDRESS 0xFFF8D2F0 DISPLAY_IDENTIFIER p_0stgea.iSasAnGeaNichtKraftschl1 /end MEASUREMENT
/begin MEASUREMENT iSasAnGeaNichtKraftschl1.p_adaptgea "Adaptionsdruck Ge/Ga" SWORD UMR_BAR__1_1000_0_S5_S3 1 100 -32.768 32.767 ECU_ADDRESS 0xFFF8D2EC DISPLAY_IDENTIFIER p_adaptgea.iSasAnGeaNichtKraftschl1 /end MEASUREMENT
/begin MEASUREMENT iSasAnGeaNichtKraftschl1.p_gea "Druckwert aus Druckberechnung Ge/Ga" SWORD UMR_BAR__1_1000_0_S5_S3 1 100 0 20 ECU_ADDRESS 0xFFF8D2D2 DISPLAY_IDENTIFIER p_gea.iSasAnGeaNichtKraftschl1 /end MEASUREMENT
/begin MEASUREMENT iSasAnGeaNichtKraftschl1.p_offgea "Offsetdruck Ge/Ga" SWORD UMR_BAR__1_1000_0_S5_S3 1 100 -32.768 32.767 ECU_ADDRESS 0xFFF8D2EE DISPLAY_IDENTIFIER p_offgea.iSasAnGeaNichtKraftschl1 /end MEASUREMENT
/begin MEASUREMENT iSasAnGeaNichtKraftschl1.p_stgea "Gesteuerter Druckanteil aus Druckberechnung Ge/Ga" SWORD UMR_BAR__1_1000_0_S5_S3 1 100 0 20 ECU_ADDRESS 0xFFF8D2D4 DISPLAY_IDENTIFIER p_stgea.iSasAnGeaNichtKraftschl1 /end MEASUREMENT
/begin MEASUREMENT iSasAnGeaNichtKraftschl1.pgo_gea_rampe.cBibRampeGradSi16._.letzter_ms_timer "Speichert den letzten BS-Timer" UWORD UMR_MSEC__1_1_0_S5_S3 1 100 0 65535 ECU_ADDRESS 0xFFF8D308 DISPLAY_IDENTIFIER letzter_ms_timer._.cBibRampeGradSi16.pgo_gea_rampe.iSasAnGeaNichtKraftschl1 /end MEASUREMENT
/begin MEASUREMENT iSasAnGeaNichtKraftschl1.pgo_gea_rampe.cBibRampeGradSi16._.letzter_wert "Speichert den letzten Eingangswert" FLOAT32_IEEE UMR___1_1_0_S5_S3 1 100 -1e+037 1e+037 ECU_ADDRESS 0xFFF8D304 FORMAT "%3.2" DISPLAY_IDENTIFIER letzter_wert._.cBibRampeGradSi16.pgo_gea_rampe.iSasAnGeaNichtKraftschl1 /end MEASUREMENT
/begin MEASUREMENT iSasAnGeaNichtKraftschl1.pgo_gea_rampe.cBibRampeGradSi16._.maximum "Maximum Begrenzung" FLOAT32_IEEE UMR___1_1_0_S5_S3 1 100 -1e+037 1e+037 ECU_ADDRESS 0xFFF8D310 FORMAT "%3.2" DISPLAY_IDENTIFIER maximum._.cBibRampeGradSi16.pgo_gea_rampe.iSasAnGeaNichtKraftschl1 /end MEASUREMENT
/begin MEASUREMENT iSasAnGeaNichtKraftschl1.pgo_gea_rampe.cBibRampeGradSi16._.minimum "Minimum Begrenzung" FLOAT32_IEEE UMR___1_1_0_S5_S3 1 100 -1e+037 1e+037 ECU_ADDRESS 0xFFF8D30C FORMAT "%3.2" DISPLAY_IDENTIFIER minimum._.cBibRampeGradSi16.pgo_gea_rampe.iSasAnGeaNichtKraftschl1 /end MEASUREMENT
/begin MEASUREMENT iSasAnGeaNichtKraftschl1.pgo_nabgea "Schaltdruckgradienten Offset" SWORD UMR_BAR_SEC_1_10_0_S5_S3 1 100 -3276.8 3276.7 ECU_ADDRESS 0xFFF8D2F4 DISPLAY_IDENTIFIER pgo_nabgea.iSasAnGeaNichtKraftschl1 /end MEASUREMENT
/begin MEASUREMENT iSasAnGeaNichtKraftschl1.po_fkzu_aktiv "Verzoegerung der Druckoffsetzausgabe wegen evtl. Druckuebernahme durch IAE" UBYTE Conv.cSasAnGea._.po_fkzu_aktiv_S5_S3 1 100 0 1 BIT_MASK 0x1 ECU_ADDRESS 0xFFF8D300 DISPLAY_IDENTIFIER po_fkzu_aktiv.iSasAnGeaNichtKraftschl1 /end MEASUREMENT
/begin MEASUREMENT iSasAnGeaNichtKraftschl1.po_mtgea "Momentenabhaengiger Druckoffset Ge/Ga" SWORD UMR_BAR__1_1000_0_S5_S3 1 100 -32.768 32.767 ECU_ADDRESS 0xFFF8D2F2 DISPLAY_IDENTIFIER po_mtgea.iSasAnGeaNichtKraftschl1 /end MEASUREMENT
/begin MEASUREMENT iSasAnGeaNichtKraftschl1.ra1_ge_gestartet "FLAG: Rampe 1 KZU gestartet" UBYTE Conv.cSasAnGea._.ra1_ge_gestartet_S5_S3 1 100 0 1 BIT_MASK 0x1 ECU_ADDRESS 0xFFF8D2C9 DISPLAY_IDENTIFIER ra1_ge_gestartet.iSasAnGeaNichtKraftschl1 /end MEASUREMENT
/begin MEASUREMENT iSasAnGeaNichtKraftschl1.ra2_ge_gestartet "FLAG: Rampe 2 KZU gestartet" UBYTE Conv.cSasAnGea._.ra2_ge_gestartet_S5_S3 1 100 0 1 BIT_MASK 0x1 ECU_ADDRESS 0xFFF8D2CA DISPLAY_IDENTIFIER ra2_ge_gestartet.iSasAnGeaNichtKraftschl1 /end MEASUREMENT
/begin MEASUREMENT iSasAnGeaNichtKraftschl1.ra3_ge_gestartet "FLAG: Rampe 3 KZU gestartet" UBYTE Conv.cSasAnGea._.ra3_ge_gestartet_S5_S3 1 100 0 1 BIT_MASK 0x1 ECU_ADDRESS 0xFFF8D2CB DISPLAY_IDENTIFIER ra3_ge_gestartet.iSasAnGeaNichtKraftschl1 /end MEASUREMENT
/begin MEASUREMENT iSasAnGeaNichtKraftschl1.schalttyp_gea "Schalttyp des Gea-Ablaufs" UBYTE Conv.cSasAnGea._.schalttyp_gea_S5_S3 1 100 0 4 ECU_ADDRESS 0xFFF8D2DD DISPLAY_IDENTIFIER schalttyp_gea.iSasAnGeaNichtKraftschl1 /end MEASUREMENT
/begin MEASUREMENT iSasAnGeaNichtKraftschl1.schliessen_kup_in_n_gestartet "Flag: Kupplungsansteuerung in Neutral wurde gestartet" UBYTE Conv.cSasAnGea._.schliessen_kup_in_n_gestartet_S5_S3 1 100 0 1 BIT_MASK 0x1 ECU_ADDRESS 0xFFF8D2D1 DISPLAY_IDENTIFIER schliessen_kup_in_n_gestartet.iSasAnGeaNichtKraftschl1 /end MEASUREMENT
/begin MEASUREMENT iSasAnGeaNichtKraftschl1.schnellfuellung_beendet "FLAG: Schnellfuellung beendet" UBYTE Conv.cSasAnGea._.schnellfuellung_beendet_S5_S3 1 100 0 1 BIT_MASK 0x1 ECU_ADDRESS 0xFFF8D2DE DISPLAY_IDENTIFIER schnellfuellung_beendet.iSasAnGeaNichtKraftschl1 /end MEASUREMENT
/begin MEASUREMENT iSasAnGeaNichtKraftschl1.statisch_gea "Flag: Statischansteuerung der GE/GA-Kupplung" UBYTE Conv.cSasAnGea._.statisch_gea_S5_S3 1 100 0 1 BIT_MASK 0x1 ECU_ADDRESS 0xFFF8D2D8 DISPLAY_IDENTIFIER statisch_gea.iSasAnGeaNichtKraftschl1 /end MEASUREMENT
/begin MEASUREMENT iSasAnGeaNichtKraftschl1.synchron_verboten "FLAG: Synchron erreichen ist verboten" UBYTE Conv.cSasAnGea._.synchron_verboten_S5_S3 1 100 0 1 BIT_MASK 0x1 ECU_ADDRESS 0xFFF8D2CC DISPLAY_IDENTIFIER synchron_verboten.iSasAnGeaNichtKraftschl1 /end MEASUREMENT
/begin MEASUREMENT iSasAnGeaNichtKraftschl1.t_0kzu_gea "Zeitdauer des zuletzt durchlaufenen Zustands bei KZU" SWORD UMR_MSEC__10_1_0_S5_S3 1 100 -327680 327670 ECU_ADDRESS 0xFFF8D2F6 DISPLAY_IDENTIFIER t_0kzu_gea.iSasAnGeaNichtKraftschl1 /end MEASUREMENT
/begin MEASUREMENT iSasAnGeaNichtKraftschl1.t_maxgea "Maximalzeit des GE/GA" UWORD UMR_MSEC__10_1_0_S5_S3 1 100 0 50000 ECU_ADDRESS 0xFFF8D2DA DISPLAY_IDENTIFIER t_maxgea.iSasAnGeaNichtKraftschl1 /end MEASUREMENT
/begin MEASUREMENT iSasAnGeaNichtKraftschl1.t_timeout "Zeit von Start Gangeinlegen bis Start Timeoutfunktion" UWORD UMR_MSEC__10_1_0_S5_S3 1 100 0 50000 ECU_ADDRESS 0xFFF8D2E2 DISPLAY_IDENTIFIER t_timeout.iSasAnGeaNichtKraftschl1 /end MEASUREMENT
/begin MEASUREMENT iSasAnGeaNichtKraftschl1.t_zgea "Zustandszeitdauer des aktuellen Gea-Zustands" SWORD UMR_MSEC__10_1_0_S5_S3 1 100 -327680 327670 ECU_ADDRESS 0xFFF8D2F8 DISPLAY_IDENTIFIER t_zgea.iSasAnGeaNichtKraftschl1 /end MEASUREMENT
/begin MEASUREMENT iSasAnGeaNichtKraftschl1.timer16_ra1_ge "Timer der mit Beginn der Rampe 1 startet" UWORD UMR_MSEC__10_1_0_S5_S3 1 100 0 655350 ECU_ADDRESS 0xFFF8D2D6 DISPLAY_IDENTIFIER timer16_ra1_ge.iSasAnGeaNichtKraftschl1 /end MEASUREMENT
/begin MEASUREMENT iSasAnGeaNichtKraftschl1.timer_start_fa_kzu "Timer Zeit seit Start Fuellausgleich KZU (bei Gea)" UBYTE UMR_MSEC__10_1_0_S5_S3 1 100 0 2550 ECU_ADDRESS 0xFFF8D2FB DISPLAY_IDENTIFIER timer_start_fa_kzu.iSasAnGeaNichtKraftschl1 /end MEASUREMENT
/begin MEASUREMENT iSasAnGeaNichtKraftschl1.timer_zgea "Zustandstimer Gea-Ablauf" UBYTE UMR_MSEC__10_1_0_S5_S3 1 100 0 2550 ECU_ADDRESS 0xFFF8D2FA DISPLAY_IDENTIFIER timer_zgea.iSasAnGeaNichtKraftschl1 /end MEASUREMENT
/begin MEASUREMENT iSasAnGeaNichtKraftschl1.z_gea "Zustand Gangein-/auslegen" UBYTE Conv.cSasAnGea._.z_gea_S5_S3 1 100 0 20 ECU_ADDRESS 0xFFF8D2D9 DISPLAY_IDENTIFIER z_gea.iSasAnGeaNichtKraftschl1 /end MEASUREMENT
/begin MEASUREMENT iSasAnGeaNichtKraftschl1.z_modus_gea "Betriebsmodus fuer GEA" UBYTE Conv.cSasAnGea._.z_modus_gea_S5_S3 1 100 0 2 ECU_ADDRESS 0xFFF8D2E0 DISPLAY_IDENTIFIER z_modus_gea.iSasAnGeaNichtKraftschl1 /end MEASUREMENT
/begin MEASUREMENT iSasAnGeaNichtKraftschl1.zaehler_zgea "Zustandszaehler Gea-Ablauf" UBYTE UMR___1_1_0_S5_S3 1 100 0 255 ECU_ADDRESS 0xFFF8D2EA DISPLAY_IDENTIFIER zaehler_zgea.iSasAnGeaNichtKraftschl1 /end MEASUREMENT
/begin MEASUREMENT iSasAnGeaNichtKraftschl2.dauer_ra1_ge_kzu "Zeitdauer der Rampe 1 der KZU (bei Gea)" SWORD UMR_MSEC__10_1_0_S5_S3 1 100 -327680 327670 ECU_ADDRESS 0xFFF8D360 DISPLAY_IDENTIFIER dauer_ra1_ge_kzu.iSasAnGeaNichtKraftschl2 /end MEASUREMENT
/begin MEASUREMENT iSasAnGeaNichtKraftschl2.ende_kab_gestartet "Flag: Zustand Ende der abschaltenden Kupplung gestartet" UBYTE Conv.cSasAnGea._.ende_kab_gestartet_S5_S3 1 100 0 1 BIT_MASK 0x1 ECU_ADDRESS 0xFFF8D333 DISPLAY_IDENTIFIER ende_kab_gestartet.iSasAnGeaNichtKraftschl2 /end MEASUREMENT
/begin MEASUREMENT iSasAnGeaNichtKraftschl2.erste_schaltung "Flag: 1. Befuellung einer Kupplung" UBYTE Conv.cSasAnGea._.erste_schaltung_S5_S3 1 100 0 1 BIT_MASK 0x1 ECU_ADDRESS 0xFFF8D331 DISPLAY_IDENTIFIER erste_schaltung.iSasAnGeaNichtKraftschl2 /end MEASUREMENT
/begin MEASUREMENT iSasAnGeaNichtKraftschl2.f_pfmin_erreicht "FLAG: Kupplung hat p_fmin erreicht" UBYTE Conv.cSasAnGea._.f_pfmin_erreicht_S5_S3 1 100 0 1 BIT_MASK 0x1 ECU_ADDRESS 0xFFF8D34B DISPLAY_IDENTIFIER f_pfmin_erreicht.iSasAnGeaNichtKraftschl2 /end MEASUREMENT
/begin MEASUREMENT iSasAnGeaNichtKraftschl2.f_pokzu_kfl_zuletzt_wechsel "FLAG: Druckoffset bei KFL-Wechsel verwenden" UBYTE Conv.cSasAnGea._.f_pokzu_kfl_zuletzt_wechsel_S5_S3 1 100 0 1 BIT_MASK 0x1 ECU_ADDRESS 0xFFF8D34A DISPLAY_IDENTIFIER f_pokzu_kfl_zuletzt_wechsel.iSasAnGeaNichtKraftschl2 /end MEASUREMENT
/begin MEASUREMENT iSasAnGeaNichtKraftschl2.f_schnellfuellung_gestartet "FLAG: Schnellfuellung wurde gestartet" UBYTE Conv.cSasAnGea._.f_schnellfuellung_gestartet_S5_S3 1 100 0 1 BIT_MASK 0x1 ECU_ADDRESS 0xFFF8D343 DISPLAY_IDENTIFIER f_schnellfuellung_gestartet.iSasAnGeaNichtKraftschl2 /end MEASUREMENT
/begin MEASUREMENT iSasAnGeaNichtKraftschl2.f_timeout "FLAG: Timeout" UBYTE Conv.cSasAnGea._.f_timeout_S5_S3 1 100 0 1 BIT_MASK 0x1 ECU_ADDRESS 0xFFF8D340 DISPLAY_IDENTIFIER f_timeout.iSasAnGeaNichtKraftschl2 /end MEASUREMENT
/begin MEASUREMENT iSasAnGeaNichtKraftschl2.f_verb_ada_erste_bef "Flag: 1. Befuellung einer Kupplung verbietet Ada" UBYTE Conv.cSasAnGea._.f_verb_ada_erste_bef_S5_S3 1 100 0 1 BIT_MASK 0x1 ECU_ADDRESS 0xFFF8D332 DISPLAY_IDENTIFIER f_verb_ada_erste_bef.iSasAnGeaNichtKraftschl2 /end MEASUREMENT
/begin MEASUREMENT iSasAnGeaNichtKraftschl2.fa_kzu_gestartet "Flag: Fuellausgleich KZU gestartet" UBYTE Conv.cSasAnGea._.fa_kzu_gestartet_S5_S3 1 100 0 1 BIT_MASK 0x1 ECU_ADDRESS 0xFFF8D334 DISPLAY_IDENTIFIER fa_kzu_gestartet.iSasAnGeaNichtKraftschl2 /end MEASUREMENT
/begin MEASUREMENT iSasAnGeaNichtKraftschl2.gea_ablauf_aktiv "Flag: Gangein-/auslegen aktiv" UBYTE Conv.cSasAnGea._.gea_ablauf_aktiv_S5_S3 1 100 0 1 BIT_MASK 0x1 ECU_ADDRESS 0xFFF8D32C DISPLAY_IDENTIFIER gea_ablauf_aktiv.iSasAnGeaNichtKraftschl2 /end MEASUREMENT
/begin MEASUREMENT iSasAnGeaNichtKraftschl2.instanz_nr "Instanzennummer des Gea-Ablaufs" UBYTE Conv.cSasAnGea._.instanz_nr_S5_S3 1 100 2 4 ECU_ADDRESS 0xFFF8D348 DISPLAY_IDENTIFIER instanz_nr.iSasAnGeaNichtKraftschl2 /end MEASUREMENT
/begin MEASUREMENT iSasAnGeaNichtKraftschl2.kup_ga "Kupplung Gangauslegen" UBYTE Conv.cSasAnGea._.kup_ga_S5_S3 1 100 0 5 ECU_ADDRESS 0xFFF8D34D DISPLAY_IDENTIFIER kup_ga.iSasAnGeaNichtKraftschl2 /end MEASUREMENT
/begin MEASUREMENT iSasAnGeaNichtKraftschl2.kup_ge "Kupplung Gangeinlegen" UBYTE Conv.cSasAnGea._.kup_ge_S5_S3 1 100 0 5 ECU_ADDRESS 0xFFF8D34C DISPLAY_IDENTIFIER kup_ge.iSasAnGeaNichtKraftschl2 /end MEASUREMENT
/begin MEASUREMENT iSasAnGeaNichtKraftschl2.kzu_voll_bei_start "KZU war schon befuellt bei Start Schaltung" UBYTE Conv.cSasAnGea._.kzu_voll_bei_start_S5_S3 1 100 0 1 BIT_MASK 0x1 ECU_ADDRESS 0xFFF8D349 DISPLAY_IDENTIFIER kzu_voll_bei_start.iSasAnGeaNichtKraftschl2 /end MEASUREMENT
/begin MEASUREMENT iSasAnGeaNichtKraftschl2.nd_nmotnt_init_ga "Gemerkter Wert von nd_nmot_nt bei Initialisierung GA" SWORD UMR_U_MIN_1_1_0_S5_S3 1 100 -10000 10000 ECU_ADDRESS 0xFFF8D362 DISPLAY_IDENTIFIER nd_nmotnt_init_ga.iSasAnGeaNichtKraftschl2 /end MEASUREMENT
/begin MEASUREMENT iSasAnGeaNichtKraftschl2.p_0stgea "Zustandsanfangsdruck gesteuerter Anteil Ge/Ga" SWORD UMR_BAR__1_1000_0_S5_S3 1 100 -32.768 32.767 ECU_ADDRESS 0xFFF8D354 DISPLAY_IDENTIFIER p_0stgea.iSasAnGeaNichtKraftschl2 /end MEASUREMENT
/begin MEASUREMENT iSasAnGeaNichtKraftschl2.p_adaptgea "Adaptionsdruck Ge/Ga" SWORD UMR_BAR__1_1000_0_S5_S3 1 100 -32.768 32.767 ECU_ADDRESS 0xFFF8D350 DISPLAY_IDENTIFIER p_adaptgea.iSasAnGeaNichtKraftschl2 /end MEASUREMENT
/begin MEASUREMENT iSasAnGeaNichtKraftschl2.p_gea "Druckwert aus Druckberechnung Ge/Ga" SWORD UMR_BAR__1_1000_0_S5_S3 1 100 0 20 ECU_ADDRESS 0xFFF8D336 DISPLAY_IDENTIFIER p_gea.iSasAnGeaNichtKraftschl2 /end MEASUREMENT
/begin MEASUREMENT iSasAnGeaNichtKraftschl2.p_offgea "Offsetdruck Ge/Ga" SWORD UMR_BAR__1_1000_0_S5_S3 1 100 -32.768 32.767 ECU_ADDRESS 0xFFF8D352 DISPLAY_IDENTIFIER p_offgea.iSasAnGeaNichtKraftschl2 /end MEASUREMENT
/begin MEASUREMENT iSasAnGeaNichtKraftschl2.p_stgea "Gesteuerter Druckanteil aus Druckberechnung Ge/Ga" SWORD UMR_BAR__1_1000_0_S5_S3 1 100 0 20 ECU_ADDRESS 0xFFF8D338 DISPLAY_IDENTIFIER p_stgea.iSasAnGeaNichtKraftschl2 /end MEASUREMENT
/begin MEASUREMENT iSasAnGeaNichtKraftschl2.pgo_gea_rampe.cBibRampeGradSi16._.letzter_ms_timer "Speichert den letzten BS-Timer" UWORD UMR_MSEC__1_1_0_S5_S3 1 100 0 65535 ECU_ADDRESS 0xFFF8D36C DISPLAY_IDENTIFIER letzter_ms_timer._.cBibRampeGradSi16.pgo_gea_rampe.iSasAnGeaNichtKraftschl2 /end MEASUREMENT
/begin MEASUREMENT iSasAnGeaNichtKraftschl2.pgo_gea_rampe.cBibRampeGradSi16._.letzter_wert "Speichert den letzten Eingangswert" FLOAT32_IEEE UMR___1_1_0_S5_S3 1 100 -1e+037 1e+037 ECU_ADDRESS 0xFFF8D368 FORMAT "%3.2" DISPLAY_IDENTIFIER letzter_wert._.cBibRampeGradSi16.pgo_gea_rampe.iSasAnGeaNichtKraftschl2 /end MEASUREMENT
/begin MEASUREMENT iSasAnGeaNichtKraftschl2.pgo_gea_rampe.cBibRampeGradSi16._.maximum "Maximum Begrenzung" FLOAT32_IEEE UMR___1_1_0_S5_S3 1 100 -1e+037 1e+037 ECU_ADDRESS 0xFFF8D374 FORMAT "%3.2" DISPLAY_IDENTIFIER maximum._.cBibRampeGradSi16.pgo_gea_rampe.iSasAnGeaNichtKraftschl2 /end MEASUREMENT
/begin MEASUREMENT iSasAnGeaNichtKraftschl2.pgo_gea_rampe.cBibRampeGradSi16._.minimum "Minimum Begrenzung" FLOAT32_IEEE UMR___1_1_0_S5_S3 1 100 -1e+037 1e+037 ECU_ADDRESS 0xFFF8D370 FORMAT "%3.2" DISPLAY_IDENTIFIER minimum._.cBibRampeGradSi16.pgo_gea_rampe.iSasAnGeaNichtKraftschl2 /end MEASUREMENT
/begin MEASUREMENT iSasAnGeaNichtKraftschl2.pgo_nabgea "Schaltdruckgradienten Offset" SWORD UMR_BAR_SEC_1_10_0_S5_S3 1 100 -3276.8 3276.7 ECU_ADDRESS 0xFFF8D358 DISPLAY_IDENTIFIER pgo_nabgea.iSasAnGeaNichtKraftschl2 /end MEASUREMENT
/begin MEASUREMENT iSasAnGeaNichtKraftschl2.po_fkzu_aktiv "Verzoegerung der Druckoffsetzausgabe wegen evtl. Druckuebernahme durch IAE" UBYTE Conv.cSasAnGea._.po_fkzu_aktiv_S5_S3 1 100 0 1 BIT_MASK 0x1 ECU_ADDRESS 0xFFF8D364 DISPLAY_IDENTIFIER po_fkzu_aktiv.iSasAnGeaNichtKraftschl2 /end MEASUREMENT
/begin MEASUREMENT iSasAnGeaNichtKraftschl2.po_mtgea "Momentenabhaengiger Druckoffset Ge/Ga" SWORD UMR_BAR__1_1000_0_S5_S3 1 100 -32.768 32.767 ECU_ADDRESS 0xFFF8D356 DISPLAY_IDENTIFIER po_mtgea.iSasAnGeaNichtKraftschl2 /end MEASUREMENT
/begin MEASUREMENT iSasAnGeaNichtKraftschl2.ra1_ge_gestartet "FLAG: Rampe 1 KZU gestartet" UBYTE Conv.cSasAnGea._.ra1_ge_gestartet_S5_S3 1 100 0 1 BIT_MASK 0x1 ECU_ADDRESS 0xFFF8D32D DISPLAY_IDENTIFIER ra1_ge_gestartet.iSasAnGeaNichtKraftschl2 /end MEASUREMENT
/begin MEASUREMENT iSasAnGeaNichtKraftschl2.ra2_ge_gestartet "FLAG: Rampe 2 KZU gestartet" UBYTE Conv.cSasAnGea._.ra2_ge_gestartet_S5_S3 1 100 0 1 BIT_MASK 0x1 ECU_ADDRESS 0xFFF8D32E DISPLAY_IDENTIFIER ra2_ge_gestartet.iSasAnGeaNichtKraftschl2 /end MEASUREMENT
/begin MEASUREMENT iSasAnGeaNichtKraftschl2.ra3_ge_gestartet "FLAG: Rampe 3 KZU gestartet" UBYTE Conv.cSasAnGea._.ra3_ge_gestartet_S5_S3 1 100 0 1 BIT_MASK 0x1 ECU_ADDRESS 0xFFF8D32F DISPLAY_IDENTIFIER ra3_ge_gestartet.iSasAnGeaNichtKraftschl2 /end MEASUREMENT
/begin MEASUREMENT iSasAnGeaNichtKraftschl2.schalttyp_gea "Schalttyp des Gea-Ablaufs" UBYTE Conv.cSasAnGea._.schalttyp_gea_S5_S3 1 100 0 4 ECU_ADDRESS 0xFFF8D341 DISPLAY_IDENTIFIER schalttyp_gea.iSasAnGeaNichtKraftschl2 /end MEASUREMENT
/begin MEASUREMENT iSasAnGeaNichtKraftschl2.schliessen_kup_in_n_gestartet "Flag: Kupplungsansteuerung in Neutral wurde gestartet" UBYTE Conv.cSasAnGea._.schliessen_kup_in_n_gestartet_S5_S3 1 100 0 1 BIT_MASK 0x1 ECU_ADDRESS 0xFFF8D335 DISPLAY_IDENTIFIER schliessen_kup_in_n_gestartet.iSasAnGeaNichtKraftschl2 /end MEASUREMENT
/begin MEASUREMENT iSasAnGeaNichtKraftschl2.schnellfuellung_beendet "FLAG: Schnellfuellung beendet" UBYTE Conv.cSasAnGea._.schnellfuellung_beendet_S5_S3 1 100 0 1 BIT_MASK 0x1 ECU_ADDRESS 0xFFF8D342 DISPLAY_IDENTIFIER schnellfuellung_beendet.iSasAnGeaNichtKraftschl2 /end MEASUREMENT
/begin MEASUREMENT iSasAnGeaNichtKraftschl2.statisch_gea "Flag: Statischansteuerung der GE/GA-Kupplung" UBYTE Conv.cSasAnGea._.statisch_gea_S5_S3 1 100 0 1 BIT_MASK 0x1 ECU_ADDRESS 0xFFF8D33C DISPLAY_IDENTIFIER statisch_gea.iSasAnGeaNichtKraftschl2 /end MEASUREMENT
/begin MEASUREMENT iSasAnGeaNichtKraftschl2.synchron_verboten "FLAG: Synchron erreichen ist verboten" UBYTE Conv.cSasAnGea._.synchron_verboten_S5_S3 1 100 0 1 BIT_MASK 0x1 ECU_ADDRESS 0xFFF8D330 DISPLAY_IDENTIFIER synchron_verboten.iSasAnGeaNichtKraftschl2 /end MEASUREMENT
/begin MEASUREMENT iSasAnGeaNichtKraftschl2.t_0kzu_gea "Zeitdauer des zuletzt durchlaufenen Zustands bei KZU" SWORD UMR_MSEC__10_1_0_S5_S3 1 100 -327680 327670 ECU_ADDRESS 0xFFF8D35A DISPLAY_IDENTIFIER t_0kzu_gea.iSasAnGeaNichtKraftschl2 /end MEASUREMENT
/begin MEASUREMENT iSasAnGeaNichtKraftschl2.t_maxgea "Maximalzeit des GE/GA" UWORD UMR_MSEC__10_1_0_S5_S3 1 100 0 50000 ECU_ADDRESS 0xFFF8D33E DISPLAY_IDENTIFIER t_maxgea.iSasAnGeaNichtKraftschl2 /end MEASUREMENT
/begin MEASUREMENT iSasAnGeaNichtKraftschl2.t_timeout "Zeit von Start Gangeinlegen bis Start Timeoutfunktion" UWORD UMR_MSEC__10_1_0_S5_S3 1 100 0 50000 ECU_ADDRESS 0xFFF8D346 DISPLAY_IDENTIFIER t_timeout.iSasAnGeaNichtKraftschl2 /end MEASUREMENT
/begin MEASUREMENT iSasAnGeaNichtKraftschl2.t_zgea "Zustandszeitdauer des aktuellen Gea-Zustands" SWORD UMR_MSEC__10_1_0_S5_S3 1 100 -327680 327670 ECU_ADDRESS 0xFFF8D35C DISPLAY_IDENTIFIER t_zgea.iSasAnGeaNichtKraftschl2 /end MEASUREMENT
/begin MEASUREMENT iSasAnGeaNichtKraftschl2.timer16_ra1_ge "Timer der mit Beginn der Rampe 1 startet" UWORD UMR_MSEC__10_1_0_S5_S3 1 100 0 655350 ECU_ADDRESS 0xFFF8D33A DISPLAY_IDENTIFIER timer16_ra1_ge.iSasAnGeaNichtKraftschl2 /end MEASUREMENT
/begin MEASUREMENT iSasAnGeaNichtKraftschl2.timer_start_fa_kzu "Timer Zeit seit Start Fuellausgleich KZU (bei Gea)" UBYTE UMR_MSEC__10_1_0_S5_S3 1 100 0 2550 ECU_ADDRESS 0xFFF8D35F DISPLAY_IDENTIFIER timer_start_fa_kzu.iSasAnGeaNichtKraftschl2 /end MEASUREMENT
/begin MEASUREMENT iSasAnGeaNichtKraftschl2.timer_zgea "Zustandstimer Gea-Ablauf" UBYTE UMR_MSEC__10_1_0_S5_S3 1 100 0 2550 ECU_ADDRESS 0xFFF8D35E DISPLAY_IDENTIFIER timer_zgea.iSasAnGeaNichtKraftschl2 /end MEASUREMENT
/begin MEASUREMENT iSasAnGeaNichtKraftschl2.z_gea "Zustand Gangein-/auslegen" UBYTE Conv.cSasAnGea._.z_gea_S5_S3 1 100 0 20 ECU_ADDRESS 0xFFF8D33D DISPLAY_IDENTIFIER z_gea.iSasAnGeaNichtKraftschl2 /end MEASUREMENT
/begin MEASUREMENT iSasAnGeaNichtKraftschl2.z_modus_gea "Betriebsmodus fuer GEA" UBYTE Conv.cSasAnGea._.z_modus_gea_S5_S3 1 100 0 2 ECU_ADDRESS 0xFFF8D344 DISPLAY_IDENTIFIER z_modus_gea.iSasAnGeaNichtKraftschl2 /end MEASUREMENT
/begin MEASUREMENT iSasAnGeaNichtKraftschl2.zaehler_zgea "Zustandszaehler Gea-Ablauf" UBYTE UMR___1_1_0_S5_S3 1 100 0 255 ECU_ADDRESS 0xFFF8D34E DISPLAY_IDENTIFIER zaehler_zgea.iSasAnGeaNichtKraftschl2 /end MEASUREMENT
/begin MEASUREMENT iSasAnGls.filter_wngtgls.letzter_ms_timer "letzter BS-Timer" UWORD UMR_MSEC__1_1_0_S5_S3 1 100 0 65535 ECU_ADDRESS 0xFFF8BEFC DISPLAY_IDENTIFIER letzter_ms_timer.filter_wngtgls.iSasAnGls /end MEASUREMENT
/begin MEASUREMENT iSasAnGls.filter_wngtgls.x "letzter Wert" SLONG UMR___1_1_0_S5_S3 1 100 -2147483648 2147483647 ECU_ADDRESS 0xFFF8BEF8 DISPLAY_IDENTIFIER x.filter_wngtgls.iSasAnGls /end MEASUREMENT
/begin MEASUREMENT iSasAnGls.filter_wngtgls_gestartet "Flag, ob Filterfkt w_ngtgls gestartet ist" UBYTE Conv.cSasAnGls._.filter_wngtgls_gestartet_S5_S3 1 100 0 1 BIT_MASK 0x1 ECU_ADDRESS 0xFFF8BEDE DISPLAY_IDENTIFIER filter_wngtgls_gestartet.iSasAnGls /end MEASUREMENT
/begin MEASUREMENT iSasAnGls.gls_aktiv "FLAG: GLS ist Aktiv" UBYTE Conv.cSasAnGls._.gls_aktiv_S5_S3 1 100 0 1 BIT_MASK 0x1 ECU_ADDRESS 0xFFF8BEBA DISPLAY_IDENTIFIER gls_aktiv.iSasAnGls /end MEASUREMENT
/begin MEASUREMENT iSasAnGls.gls_mindruck "FLAG: GLS-Minimaldruck erreicht" UBYTE Conv.cSasAnGls._.gls_mindruck_S5_S3 1 100 0 1 BIT_MASK 0x1 ECU_ADDRESS 0xFFF8BEC7 DISPLAY_IDENTIFIER gls_mindruck.iSasAnGls /end MEASUREMENT
/begin MEASUREMENT iSasAnGls.gls_para.cBibRegle._.faktor_d "Param. D-Anteil" UWORD UMR___1_1_0_S5_S3 1 100 0 65535 ECU_ADDRESS 0xFFF8BEE8 DISPLAY_IDENTIFIER faktor_d._.cBibRegle.gls_para.iSasAnGls /end MEASUREMENT
/begin MEASUREMENT iSasAnGls.gls_para.cBibRegle._.faktor_i "Param. I-Anteil" UWORD UMR___1_1_0_S5_S3 1 100 0 65535 ECU_ADDRESS 0xFFF8BEE6 DISPLAY_IDENTIFIER faktor_i._.cBibRegle.gls_para.iSasAnGls /end MEASUREMENT
/begin MEASUREMENT iSasAnGls.gls_para.cBibRegle._.faktor_p "Param. P-Anteil" UWORD UMR___1_1_0_S5_S3 1 100 0 65535 ECU_ADDRESS 0xFFF8BEE4 DISPLAY_IDENTIFIER faktor_p._.cBibRegle.gls_para.iSasAnGls /end MEASUREMENT
/begin MEASUREMENT iSasAnGls.gls_para.cBibRegle._.faktor_t1 "Param. T1-Anteil" UWORD UMR___1_1_0_S5_S3 1 100 0 65535 ECU_ADDRESS 0xFFF8BEEA DISPLAY_IDENTIFIER faktor_t1._.cBibRegle.gls_para.iSasAnGls /end MEASUREMENT
/begin MEASUREMENT iSasAnGls.gls_para.cBibRegle._.regel_diff_alt "verzoeg. Regeldifferenz" SWORD UMR___1_1_0_S5_S3 1 100 -32768 32767 ECU_ADDRESS 0xFFF8BEF0 DISPLAY_IDENTIFIER regel_diff_alt._.cBibRegle.gls_para.iSasAnGls /end MEASUREMENT
/begin MEASUREMENT iSasAnGls.gls_para.cBibRegle._.stell_max "maximale Stellgroesse" SWORD UMR___1_1_0_S5_S3 1 100 -32768 32767 ECU_ADDRESS 0xFFF8BEEC DISPLAY_IDENTIFIER stell_max._.cBibRegle.gls_para.iSasAnGls /end MEASUREMENT
/begin MEASUREMENT iSasAnGls.gls_para.cBibRegle._.stell_min "minimale Stellgroesse" SWORD UMR___1_1_0_S5_S3 1 100 -32768 32767 ECU_ADDRESS 0xFFF8BEEE DISPLAY_IDENTIFIER stell_min._.cBibRegle.gls_para.iSasAnGls /end MEASUREMENT
/begin MEASUREMENT iSasAnGls.gls_para.cBibRegle._.stellgr_alt "verzoegerte Stellgroesse" SWORD UMR___1_1_0_S5_S3 1 100 -32768 32767 ECU_ADDRESS 0xFFF8BEF2 DISPLAY_IDENTIFIER stellgr_alt._.cBibRegle.gls_para.iSasAnGls /end MEASUREMENT
/begin MEASUREMENT iSasAnGls.gls_para.cBibRegle._.stellgr_d_alt "verzoegerte D-Stellgroesse" SWORD UMR___1_1_0_S5_S3 1 100 -32768 32767 ECU_ADDRESS 0xFFF8BEE2 DISPLAY_IDENTIFIER stellgr_d_alt._.cBibRegle.gls_para.iSasAnGls /end MEASUREMENT
/begin MEASUREMENT iSasAnGls.gls_para.cBibRegle._.stellgr_i_alt "verzoegerte I-Stellgroesse" SWORD UMR___1_1_0_S5_S3 1 100 -32768 32767 ECU_ADDRESS 0xFFF8BEE0 DISPLAY_IDENTIFIER stellgr_i_alt._.cBibRegle.gls_para.iSasAnGls /end MEASUREMENT
/begin MEASUREMENT iSasAnGls.gls_para.cBibRegle._.stellgr_i_modulo "Ganzzahl. Rest d. I-Quotient" SWORD UMR___1_1_0_S5_S3 1 100 -32768 32767 ECU_ADDRESS 0xFFF8BEF4 DISPLAY_IDENTIFIER stellgr_i_modulo._.cBibRegle.gls_para.iSasAnGls /end MEASUREMENT
/begin MEASUREMENT iSasAnGls.n_tmaxge "maximale Turbinendrehzahl zum Zeitpunkt Start Ra 1 kraftschl. Kup" UWORD UMR_U_MIN_1_1_0_S5_S3 1 100 0 8160 ECU_ADDRESS 0xFFF8BECA DISPLAY_IDENTIFIER n_tmaxge.iSasAnGls /end MEASUREMENT
/begin MEASUREMENT iSasAnGls.ng_tgls "Istwert Turbinen-Drehzahlgradient GLS" SWORD UMR_U_MINSEC_1_1_0_S5_S3 1 100 -32000 32000 ECU_ADDRESS 0xFFF8BEC0 DISPLAY_IDENTIFIER ng_tgls.iSasAnGls /end MEASUREMENT
/begin MEASUREMENT iSasAnGls.p_gls "Druck GLS" SWORD UMR_BAR__1_1000_0_S5_S3 1 100 -32 32 ECU_ADDRESS 0xFFF8BEC2 DISPLAY_IDENTIFIER p_gls.iSasAnGls /end MEASUREMENT
/begin MEASUREMENT iSasAnGls.p_gls_kab "Druck GLS bei Regelung der KAB" SWORD UMR_BAR__1_1000_0_S5_S3 1 100 -32 32 ECU_ADDRESS 0xFFF8BEBE DISPLAY_IDENTIFIER p_gls_kab.iSasAnGls /end MEASUREMENT
/begin MEASUREMENT iSasAnGls.p_gls_kzu "Druck GLS bei Regelung der KZU" SWORD UMR_BAR__1_1000_0_S5_S3 1 100 -32 32 ECU_ADDRESS 0xFFF8BEBC DISPLAY_IDENTIFIER p_gls_kzu.iSasAnGls /end MEASUREMENT
/begin MEASUREMENT iSasAnGls.p_i_gls "I-Anteil Druck GLS" SWORD UMR_BAR__1_20_0_S5_S3 1 100 -1600 1600 ECU_ADDRESS 0xFFF8BEC8 DISPLAY_IDENTIFIER p_i_gls.iSasAnGls /end MEASUREMENT
/begin MEASUREMENT iSasAnGls.p_maxgls "Maximale Druckgrenze der Regeldruckdifferenz GLS" SWORD UMR_BAR__1_1000_0_S5_S3 1 100 -32 32 ECU_ADDRESS 0xFFF8BED0 DISPLAY_IDENTIFIER p_maxgls.iSasAnGls /end MEASUREMENT
/begin MEASUREMENT iSasAnGls.p_mingls "Minimale Druckgrenze der Regeldruckdifferenz GLS" SWORD UMR_BAR__1_1000_0_S5_S3 1 100 -32 32 ECU_ADDRESS 0xFFF8BED2 DISPLAY_IDENTIFIER p_mingls.iSasAnGls /end MEASUREMENT
/begin MEASUREMENT iSasAnGls.reg_gls_gestartet "FLAG: GLS-Regler wurde gestartet" UBYTE Conv.cSasAnGls._.reg_gls_gestartet_S5_S3 1 100 0 1 BIT_MASK 0x1 ECU_ADDRESS 0xFFF8BEB9 DISPLAY_IDENTIFIER reg_gls_gestartet.iSasAnGls /end MEASUREMENT
/begin MEASUREMENT iSasAnGls.schalttyp_gls "Schalttyp der GLS" UBYTE Conv.cSasAnGls._.schalttyp_gls_S5_S3 1 100 0 5 ECU_ADDRESS 0xFFF8BED6 DISPLAY_IDENTIFIER schalttyp_gls.iSasAnGls /end MEASUREMENT
/begin MEASUREMENT iSasAnGls.schaltung_gls "Flag, das GLS Initialisiert wurde und aktiv werden kann" UBYTE Conv.cSasAnGls._.schaltung_gls_S5_S3 1 100 0 1 BIT_MASK 0x1 ECU_ADDRESS 0xFFF8BED4 DISPLAY_IDENTIFIER schaltung_gls.iSasAnGls /end MEASUREMENT
/begin MEASUREMENT iSasAnGls.t_sgls "Schleifzeit geregelte Lastschaltung" UBYTE UMR_MSEC__10_1_0_S5_S3 1 100 0 2550 ECU_ADDRESS 0xFFF8BEB8 DISPLAY_IDENTIFIER t_sgls.iSasAnGls /end MEASUREMENT
/begin MEASUREMENT iSasAnGls.t_zgls "Zustandszeitdauer geregelte Lastschaltung" SWORD UMR_MSEC__10_1_0_S5_S3 1 100 -327680 327670 ECU_ADDRESS 0xFFF8BEDC DISPLAY_IDENTIFIER t_zgls.iSasAnGls /end MEASUREMENT
/begin MEASUREMENT iSasAnGls.timer_sgls "Schleifzeittimer der GLS" UBYTE UMR_MSEC__10_1_0_S5_S3 1 100 0 2550 ECU_ADDRESS 0xFFF8BED9 DISPLAY_IDENTIFIER timer_sgls.iSasAnGls /end MEASUREMENT
/begin MEASUREMENT iSasAnGls.timer_vglskab "Timer Verzoegerungszeit bei Regelung der KAB" UBYTE UMR_MSEC__10_1_0_S5_S3 1 100 0 2550 ECU_ADDRESS 0xFFF8BEDB DISPLAY_IDENTIFIER timer_vglskab.iSasAnGls /end MEASUREMENT
/begin MEASUREMENT iSasAnGls.timer_vglskzu "Timer Verzoegerungszeit bei Regelung der KZU" UBYTE UMR_MSEC__10_1_0_S5_S3 1 100 0 2550 ECU_ADDRESS 0xFFF8BEDA DISPLAY_IDENTIFIER timer_vglskzu.iSasAnGls /end MEASUREMENT
/begin MEASUREMENT iSasAnGls.timer_zgls "Zustandstimer der GLS" UBYTE UMR_MSEC__10_1_0_S5_S3 1 100 0 2550 ECU_ADDRESS 0xFFF8BED8 DISPLAY_IDENTIFIER timer_zgls.iSasAnGls /end MEASUREMENT
/begin MEASUREMENT iSasAnGls.verz_gls_gestartet "FLAG: Verzögerung des GLS-Reglers wurde gestartet" UBYTE Conv.cSasAnGls._.verz_gls_gestartet_S5_S3 1 100 0 1 BIT_MASK 0x1 ECU_ADDRESS 0xFFF8BEC6 DISPLAY_IDENTIFIER verz_gls_gestartet.iSasAnGls /end MEASUREMENT
/begin MEASUREMENT iSasAnGls.w_ngtgls "Sollwert Turbinen-Drehzahlgradient GLS" SWORD UMR_U_MINSEC_1_1_0_S5_S3 1 100 -32000 32000 ECU_ADDRESS 0xFFF8BEB6 DISPLAY_IDENTIFIER w_ngtgls.iSasAnGls /end MEASUREMENT
/begin MEASUREMENT iSasAnGls.w_ngtnomgls "nominaler Wert des Turbinendrehzahlgradienten bei der GLS" SWORD UMR_U_MINSEC_1_1_0_S5_S3 1 100 -32000 32000 ECU_ADDRESS 0xFFF8BECE DISPLAY_IDENTIFIER w_ngtnomgls.iSasAnGls /end MEASUREMENT
/begin MEASUREMENT iSasAnGls.w_tsgls "Sollwert Schleifzeit GLS" UBYTE UMR_MSEC__10_1_0_S5_S3 1 100 0 2550 ECU_ADDRESS 0xFFF8BEB4 DISPLAY_IDENTIFIER w_tsgls.iSasAnGls /end MEASUREMENT
/begin MEASUREMENT iSasAnGls.wechsel_normal_kurz "Flag, ob Schaltung von normal nach kurz gewechselt hat" UBYTE Conv.cSasAnGls._.wechsel_normal_kurz_S5_S3 1 100 0 1 BIT_MASK 0x1 ECU_ADDRESS 0xFFF8BED5 DISPLAY_IDENTIFIER wechsel_normal_kurz.iSasAnGls /end MEASUREMENT
/begin MEASUREMENT iSasAnGls.z_gls "Zustand geregelte Lastschaltung" UBYTE Conv.cSasAnGls._.z_gls_S5_S3 1 100 0 11 ECU_ADDRESS 0xFFF8BEC5 DISPLAY_IDENTIFIER z_gls.iSasAnGls /end MEASUREMENT
/begin MEASUREMENT iSasAnGls.z_gls_regler "Zustand Gls-Regler" UBYTE Conv.cSasAnGls._.z_gls_regler_S5_S3 1 100 0 5 ECU_ADDRESS 0xFFF8BECC DISPLAY_IDENTIFIER z_gls_regler.iSasAnGls /end MEASUREMENT
/begin MEASUREMENT iSasAnGls.zaehler_zgls "Zustandszaehler der GLS" UBYTE UMR___1_1_0_S5_S3 1 100 0 255 ECU_ADDRESS 0xFFF8BED7 DISPLAY_IDENTIFIER zaehler_zgls.iSasAnGls /end MEASUREMENT
/begin MEASUREMENT iSasAnGls.zug_schub_gls "Flag: Zug Schub der GLS" UBYTE Conv.cSasAnGls._.zug_schub_gls_S5_S3 1 100 0 1 ECU_ADDRESS 0xFFF8BEC4 DISPLAY_IDENTIFIER zug_schub_gls.iSasAnGls /end MEASUREMENT
/begin MEASUREMENT iSasKflwe.kup1_kflw "1. abschaltende Kupplung bei schnellem DNR/RND" UBYTE UMR___1_1_0_S5_S3 1 100 0 5 ECU_ADDRESS 0xFFF8BF0C DISPLAY_IDENTIFIER kup1_kflw.iSasKflwe /end MEASUREMENT
/begin MEASUREMENT iSasKflwe.kup2_kflw "2. abschaltende Kupplung bei schnellem DNR/RND" UBYTE UMR___1_1_0_S5_S3 1 100 0 5 ECU_ADDRESS 0xFFF8BF0D DISPLAY_IDENTIFIER kup2_kflw.iSasKflwe /end MEASUREMENT
/begin MEASUREMENT iSasKflwe.nd_nmot_nt_skw "Differenzdrehzahl (n_mot - n_t)" SWORD UMR_U_MIN_1_1_0_S5_S3 1 100 -16320 16320 ECU_ADDRESS 0xFFF8BF0E DISPLAY_IDENTIFIER nd_nmot_nt_skw.iSasKflwe /end MEASUREMENT
/begin MEASUREMENT iSasKflwe.p_kab1_kflw "Druck 1. abschaltende Kupplung bei schnellem DNR/RND" SWORD UMR_BAR__1_1000_0_S5_S3 1 100 0 20 ECU_ADDRESS 0xFFF8BF08 DISPLAY_IDENTIFIER p_kab1_kflw.iSasKflwe /end MEASUREMENT
/begin MEASUREMENT iSasKflwe.p_kab2_kflw "Druck 2. abschaltende Kupplung bei schnellem DNR/RND" SWORD UMR_BAR__1_1000_0_S5_S3 1 100 0 20 ECU_ADDRESS 0xFFF8BF0A DISPLAY_IDENTIFIER p_kab2_kflw.iSasKflwe /end MEASUREMENT
/begin MEASUREMENT iSasKflwe.p_kab_kflw2_speicher.letzter_ms_timer "Speichert den letzten BS-Timer" UWORD UMR_MSEC__1_1_0_S5_S3 1 100 0 65535 ECU_ADDRESS 0xFFF8BF30 DISPLAY_IDENTIFIER letzter_ms_timer.p_kab_kflw2_speicher.iSasKflwe /end MEASUREMENT
/begin MEASUREMENT iSasKflwe.p_kab_kflw2_speicher.letzter_wert "Speichert den letzten Eingangswert" FLOAT32_IEEE UMR___1_1_0_S5_S3 1 100 -1e+037 1e+037 ECU_ADDRESS 0xFFF8BF2C FORMAT "%3.2" DISPLAY_IDENTIFIER letzter_wert.p_kab_kflw2_speicher.iSasKflwe /end MEASUREMENT
/begin MEASUREMENT iSasKflwe.p_kab_kflw2_speicher.maximum "Maximum Begrenzung" FLOAT32_IEEE UMR___1_1_0_S5_S3 1 100 -1e+037 1e+037 ECU_ADDRESS 0xFFF8BF38 FORMAT "%3.2" DISPLAY_IDENTIFIER maximum.p_kab_kflw2_speicher.iSasKflwe /end MEASUREMENT
/begin MEASUREMENT iSasKflwe.p_kab_kflw2_speicher.minimum "Minimum Begrenzung" FLOAT32_IEEE UMR___1_1_0_S5_S3 1 100 -1e+037 1e+037 ECU_ADDRESS 0xFFF8BF34 FORMAT "%3.2" DISPLAY_IDENTIFIER minimum.p_kab_kflw2_speicher.iSasKflwe /end MEASUREMENT
/begin MEASUREMENT iSasKflwe.p_kab_kflw_speicher.letzter_ms_timer "Speichert den letzten BS-Timer" UWORD UMR_MSEC__1_1_0_S5_S3 1 100 0 65535 ECU_ADDRESS 0xFFF8BF18 DISPLAY_IDENTIFIER letzter_ms_timer.p_kab_kflw_speicher.iSasKflwe /end MEASUREMENT
/begin MEASUREMENT iSasKflwe.p_kab_kflw_speicher.letzter_wert "Speichert den letzten Eingangswert" FLOAT32_IEEE UMR___1_1_0_S5_S3 1 100 -1e+037 1e+037 ECU_ADDRESS 0xFFF8BF14 FORMAT "%3.2" DISPLAY_IDENTIFIER letzter_wert.p_kab_kflw_speicher.iSasKflwe /end MEASUREMENT
/begin MEASUREMENT iSasKflwe.p_kab_kflw_speicher.maximum "Maximum Begrenzung" FLOAT32_IEEE UMR___1_1_0_S5_S3 1 100 -1e+037 1e+037 ECU_ADDRESS 0xFFF8BF20 FORMAT "%3.2" DISPLAY_IDENTIFIER maximum.p_kab_kflw_speicher.iSasKflwe /end MEASUREMENT
/begin MEASUREMENT iSasKflwe.p_kab_kflw_speicher.minimum "Minimum Begrenzung" FLOAT32_IEEE UMR___1_1_0_S5_S3 1 100 -1e+037 1e+037 ECU_ADDRESS 0xFFF8BF1C FORMAT "%3.2" DISPLAY_IDENTIFIER minimum.p_kab_kflw_speicher.iSasKflwe /end MEASUREMENT
/begin MEASUREMENT iSasPsyst.f_auframpen_mg_psysminpuls_gest "FLAG: Auframpen über Gradient wurde gestartet" UBYTE Conv.cSasPsyst._.f_auframpen_mg_psysminpuls_gest_S5_S3 1 100 0 1 BIT_MASK 0x1 ECU_ADDRESS 0xFFF8BF4D DISPLAY_IDENTIFIER f_auframpen_mg_psysminpuls_gest.iSasPsyst /end MEASUREMENT
/begin MEASUREMENT iSasPsyst.f_einstiegsbed_p_sysiae_erf "FLAG: Bedingungen für Systemdruckvorgabe IAE Fkt. erfüllt" UBYTE Conv.cSasPsyst._.f_einstiegsbed_p_sysiae_erf_S5_S3 1 100 0 1 BIT_MASK 0x1 ECU_ADDRESS 0xFFF8BF50 DISPLAY_IDENTIFIER f_einstiegsbed_p_sysiae_erf.iSasPsyst /end MEASUREMENT
/begin MEASUREMENT iSasPsyst.f_psys_kupschutz_anst_laeuft "FLAG: Systemdruckanhebung Kupplungstemperaturschutz aktiv" UBYTE Conv.cSasPsyst._.f_psys_kupschutz_anst_laeuft_S5_S3 1 100 0 1 BIT_MASK 0x1 ECU_ADDRESS 0xFFF8BF4B DISPLAY_IDENTIFIER f_psys_kupschutz_anst_laeuft.iSasPsyst /end MEASUREMENT
/begin MEASUREMENT iSasPsyst.f_zeit_max_psys_abgelaufen "FLAG: Zeit für MAX-Ansteuerung Systemdruck ist abgelaufen" UBYTE Conv.cSasPsyst._.f_zeit_max_psys_abgelaufen_S5_S3 1 100 0 1 BIT_MASK 0x1 ECU_ADDRESS 0xFFF8BF4E DISPLAY_IDENTIFIER f_zeit_max_psys_abgelaufen.iSasPsyst /end MEASUREMENT
/begin MEASUREMENT iSasPsyst.f_zeit_max_psys_anst_laeuft "FLAG: Zeit für MAX-Ansteuerung Systemdruck läuft" UBYTE Conv.cSasPsyst._.f_zeit_max_psys_anst_laeuft_S5_S3 1 100 0 1 BIT_MASK 0x1 ECU_ADDRESS 0xFFF8BF4A DISPLAY_IDENTIFIER f_zeit_max_psys_anst_laeuft.iSasPsyst /end MEASUREMENT
/begin MEASUREMENT iSasPsyst.filter_p_sysist.letzter_ms_timer "letzter BS-Timer" UWORD UMR_MSEC__1_1_0_S5_S3 1 100 0 65535 ECU_ADDRESS 0xFFF8BF58 DISPLAY_IDENTIFIER letzter_ms_timer.filter_p_sysist.iSasPsyst /end MEASUREMENT
/begin MEASUREMENT iSasPsyst.filter_p_sysist.x "letzter Wert" SLONG UMR___1_1_0_S5_S3 1 100 -2147483648 2147483647 ECU_ADDRESS 0xFFF8BF54 DISPLAY_IDENTIFIER x.filter_p_sysist.iSasPsyst /end MEASUREMENT
/begin MEASUREMENT iSasPsyst.fkt_druckvorgabe_psys "Info welche Funktion aktiv die Systemdruckansteuerung beeinflusst" UBYTE Conv.cSasPsyst._.fkt_druckvorgabe_psys_S5_S3 1 100 0 255 ECU_ADDRESS 0xFFF8BF4C DISPLAY_IDENTIFIER fkt_druckvorgabe_psys.iSasPsyst /end MEASUREMENT
/begin MEASUREMENT iSasPsyst.p_iep_sys "Systemdruck-Begrenzung für IEP" UWORD UMR_BAR__1_1000_0_S5_S3 1 100 0 20 ECU_ADDRESS 0xFFF8BF46 DISPLAY_IDENTIFIER p_iep_sys.iSasPsyst /end MEASUREMENT
/begin MEASUREMENT iSasPsyst.p_mod "Modulationsdruck" UWORD UMR_BAR__1_1000_0_S5_S3 1 100 0 20 ECU_ADDRESS 0xFFF8BF42 DISPLAY_IDENTIFIER p_mod.iSasPsyst /end MEASUREMENT
/begin MEASUREMENT iSasPsyst.p_pumpe_sys "Systemdruck-Begrenzung aus Pumpe" UWORD UMR_BAR__1_1000_0_S5_S3 1 100 0 20 ECU_ADDRESS 0xFFF8BF48 DISPLAY_IDENTIFIER p_pumpe_sys.iSasPsyst /end MEASUREMENT
/begin MEASUREMENT iSasPsyst.p_sys "Systemdruck" UWORD UMR_BAR__1_1000_0_S5_S3 1 100 0 20 ECU_ADDRESS 0xFFF8BF40 DISPLAY_IDENTIFIER p_sys.iSasPsyst /end MEASUREMENT
/begin MEASUREMENT iSasPsyst.p_sysist "Ist-Systemdruck" UWORD UMR_BAR__1_1000_0_S5_S3 1 100 0 20 ECU_ADDRESS 0xFFF8BF44 DISPLAY_IDENTIFIER p_sysist.iSasPsyst /end MEASUREMENT
/begin MEASUREMENT iSasPsyst.rampe_p_sysiae.letzter_ms_timer "Speichert den letzten BS-Timer" UWORD UMR_MSEC__1_1_0_S5_S3 1 100 0 65535 ECU_ADDRESS 0xFFF8BF60 DISPLAY_IDENTIFIER letzter_ms_timer.rampe_p_sysiae.iSasPsyst /end MEASUREMENT
/begin MEASUREMENT iSasPsyst.rampe_p_sysiae.letzter_wert "Speichert den letzten Eingangswert" FLOAT32_IEEE UMR___1_1_0_S5_S3 1 100 -1e+037 1e+037 ECU_ADDRESS 0xFFF8BF5C FORMAT "%3.2" DISPLAY_IDENTIFIER letzter_wert.rampe_p_sysiae.iSasPsyst /end MEASUREMENT
/begin MEASUREMENT iSasPsyst.rampe_p_sysiae.maximum "Maximum Begrenzung" FLOAT32_IEEE UMR___1_1_0_S5_S3 1 100 -1e+037 1e+037 ECU_ADDRESS 0xFFF8BF68 FORMAT "%3.2" DISPLAY_IDENTIFIER maximum.rampe_p_sysiae.iSasPsyst /end MEASUREMENT
/begin MEASUREMENT iSasPsyst.rampe_p_sysiae.minimum "Minimum Begrenzung" FLOAT32_IEEE UMR___1_1_0_S5_S3 1 100 -1e+037 1e+037 ECU_ADDRESS 0xFFF8BF64 FORMAT "%3.2" DISPLAY_IDENTIFIER minimum.rampe_p_sysiae.iSasPsyst /end MEASUREMENT
/begin MEASUREMENT iSasPsyst.rampe_p_syspulsada.letzter_ms_timer "Speichert den letzten BS-Timer" UWORD UMR_MSEC__1_1_0_S5_S3 1 100 0 65535 ECU_ADDRESS 0xFFF8BF74 DISPLAY_IDENTIFIER letzter_ms_timer.rampe_p_syspulsada.iSasPsyst /end MEASUREMENT
/begin MEASUREMENT iSasPsyst.rampe_p_syspulsada.letzter_wert "Speichert den letzten Eingangswert" FLOAT32_IEEE UMR___1_1_0_S5_S3 1 100 -1e+037 1e+037 ECU_ADDRESS 0xFFF8BF70 FORMAT "%3.2" DISPLAY_IDENTIFIER letzter_wert.rampe_p_syspulsada.iSasPsyst /end MEASUREMENT
/begin MEASUREMENT iSasPsyst.rampe_p_syspulsada.maximum "Maximum Begrenzung" FLOAT32_IEEE UMR___1_1_0_S5_S3 1 100 -1e+037 1e+037 ECU_ADDRESS 0xFFF8BF7C FORMAT "%3.2" DISPLAY_IDENTIFIER maximum.rampe_p_syspulsada.iSasPsyst /end MEASUREMENT
/begin MEASUREMENT iSasPsyst.rampe_p_syspulsada.minimum "Minimum Begrenzung" FLOAT32_IEEE UMR___1_1_0_S5_S3 1 100 -1e+037 1e+037 ECU_ADDRESS 0xFFF8BF78 FORMAT "%3.2" DISPLAY_IDENTIFIER minimum.rampe_p_syspulsada.iSasPsyst /end MEASUREMENT
/begin MEASUREMENT iSasPsyst.timer_max_psys_anst "Timer fur MAX-Ansteuerung Systemdruck" UBYTE UMR_MSEC__10_1_0_S5_S3 1 100 0 2550 ECU_ADDRESS 0xFFF8BF4F DISPLAY_IDENTIFIER timer_max_psys_anst.iSasPsyst /end MEASUREMENT
/begin MEASUREMENT iSasStrat.ber_red_durch_sf_notwendig "Berechnung Red Befuellung durch SF notwendig" UBYTE Conv.cSasStrat._.ber_red_durch_sf_notwendig_S5_S3 1 100 0 1 BIT_MASK 0x1 ECU_ADDRESS 0xFFF8D7D2 DISPLAY_IDENTIFIER ber_red_durch_sf_notwendig.iSasStrat /end MEASUREMENT
/begin MEASUREMENT iSasStrat.f_nmot_ts_estart "Flag n_mot < NS_ESTART fuer TS_ESTART" UBYTE Conv.cSasStrat._.f_nmot_ts_estart_S5_S3 1 100 0 1 BIT_MASK 0x1 ECU_ADDRESS 0xFFF8D7CC DISPLAY_IDENTIFIER f_nmot_ts_estart.iSasStrat /end MEASUREMENT
/begin MEASUREMENT iSasStrat.f_sltsf_estart "FLAG: Sfkt Leerlaufen Kolbenraum nach EStart ist aktiv" UBYTE Conv.cSasStrat._.f_sltsf_estart_S5_S3 1 100 0 1 BIT_MASK 0x1 ECU_ADDRESS 0xFFF8D7C6 DISPLAY_IDENTIFIER f_sltsf_estart.iSasStrat /end MEASUREMENT
/begin MEASUREMENT iSasStrat.flag_opt_bef_aush_sch_angef "FLAG: Fkt. optimierte Befuellung ausserh Schaltung angef." UBYTE Conv.cSasStrat._.flag_opt_bef_aush_sch_angef_S5_S3 1 100 0 1 BIT_MASK 0x1 ECU_ADDRESS 0xFFF8D7C4 DISPLAY_IDENTIFIER flag_opt_bef_aush_sch_angef.iSasStrat /end MEASUREMENT
/begin MEASUREMENT iSasStrat.flag_opt_bef_inh_sch_angef "FLAG: Fkt. optimierte Befuellung innerh Schaltung angef." UBYTE Conv.cSasStrat._.flag_opt_bef_inh_sch_angef_S5_S3 1 100 0 1 BIT_MASK 0x1 ECU_ADDRESS 0xFFF8D7C5 DISPLAY_IDENTIFIER flag_opt_bef_inh_sch_angef.iSasStrat /end MEASUREMENT
/begin MEASUREMENT iSasStrat.flag_red_bef_aush_sch_angef "FLAG: Fkt. reduzierte Befuellung ausserh Schaltung angef." UBYTE Conv.cSasStrat._.flag_red_bef_aush_sch_angef_S5_S3 1 100 0 1 BIT_MASK 0x1 ECU_ADDRESS 0xFFF8D7C2 DISPLAY_IDENTIFIER flag_red_bef_aush_sch_angef.iSasStrat /end MEASUREMENT
/begin MEASUREMENT iSasStrat.flag_red_bef_inh_sch_angef "FLAG: Fkt. reduzierte Befuellung innerh Schaltung angef." UBYTE Conv.cSasStrat._.flag_red_bef_inh_sch_angef_S5_S3 1 100 0 1 BIT_MASK 0x1 ECU_ADDRESS 0xFFF8D7C3 DISPLAY_IDENTIFIER flag_red_bef_inh_sch_angef.iSasStrat /end MEASUREMENT
/begin MEASUREMENT iSasStrat.q_fuellred "Grenze des verfügbaren Restölvolumen" SWORD UMR_LITER_MIN_1_10_0_S5_S3 1 100 -80 20 ECU_ADDRESS 0xFFF8D7D0 DISPLAY_IDENTIFIER q_fuellred.iSasStrat /end MEASUREMENT
/begin MEASUREMENT iSasStrat.q_verfuegbar_rest "verfügbares Restölvolumen" SWORD UMR_LITER_MIN_1_10_0_S5_S3 1 100 -80 20 ECU_ADDRESS 0xFFF8D7CE DISPLAY_IDENTIFIER q_verfuegbar_rest.iSasStrat /end MEASUREMENT
/begin MEASUREMENT iSasStrat.timer_sltsf_estart "timer der mit Ende eines GE mit Estart loslaeuft" UWORD UMR_MSEC__10_1_0_S5_S3 1 100 0 655350 ECU_ADDRESS 0xFFF8D7C8 DISPLAY_IDENTIFIER timer_sltsf_estart.iSasStrat /end MEASUREMENT
/begin MEASUREMENT iSasStrat.timer_sltsf_ts_estart "timer der mit n_mot < NS_ESTART loslaueft" UWORD UMR_MSEC__10_1_0_S5_S3 1 100 0 655350 ECU_ADDRESS 0xFFF8D7CA DISPLAY_IDENTIFIER timer_sltsf_ts_estart.iSasStrat /end MEASUREMENT
/begin MEASUREMENT iSasZentr.abbruchsart_hs_gls_erlaubt "Flag: Abbruch einer HS waehrend GLS erlaubt" UBYTE Conv.cSasZentr._.abbruchsart_hs_gls_erlaubt_S5_S3 1 100 0 1 BIT_MASK 0x1 ECU_ADDRESS 0xFFF8BFB5 DISPLAY_IDENTIFIER abbruchsart_hs_gls_erlaubt.iSasZentr /end MEASUREMENT
/begin MEASUREMENT iSasZentr.abbruchsart_ist "Zustand Abbruch Schaltablaufsteuerung" UBYTE Conv.cSasZentr._.abbruchsart_ist_S5_S3 1 100 0 40 ECU_ADDRESS 0xFFF8BF91 DISPLAY_IDENTIFIER abbruchsart_ist.iSasZentr /end MEASUREMENT
/begin MEASUREMENT iSasZentr.abbruchsart_soll "Vorgegebener Zustand Abbruch, wird in Init-Fkt. initialisiert" UBYTE Conv.cSasZentr._.abbruchsart_soll_S5_S3 1 100 0 40 ECU_ADDRESS 0xFFF8BF92 DISPLAY_IDENTIFIER abbruchsart_soll.iSasZentr /end MEASUREMENT
/begin MEASUREMENT iSasZentr.c_getr_sas "Getriebetemperatur zu Schaltbeginn" UBYTE UMR_GRADC__1_1_M40_S5_S3 1 100 -40 215 ECU_ADDRESS 0xFFF8BF9B DISPLAY_IDENTIFIER c_getr_sas.iSasZentr /end MEASUREMENT
/begin MEASUREMENT iSasZentr.event_sf_erkannt "Flag: Merker, für Event eine SF gestartet genau 1x durchlaufen wurde" UBYTE Conv.cSasZentr._.event_sf_erkannt_S5_S3 1 100 0 1 BIT_MASK 0x1 ECU_ADDRESS 0xFFF8BFB8 DISPLAY_IDENTIFIER event_sf_erkannt.iSasZentr /end MEASUREMENT
/begin MEASUREMENT iSasZentr.f_eco_mode "Flag ECO Mode aktiv" UBYTE Conv.cSasZentr._.f_eco_mode_S5_S3 1 100 0 1 BIT_MASK 0x1 ECU_ADDRESS 0xFFF8BFAA DISPLAY_IDENTIFIER f_eco_mode.iSasZentr /end MEASUREMENT
/begin MEASUREMENT iSasZentr.f_einstiegsbed_erfuellt "Flag das Einstiegsbed. für Zustandsgraph zur Bestimmung von m_motmax_sas erfüllt sind" UBYTE Conv.cSasZentr._.f_einstiegsbed_erfuellt_S5_S3 1 100 0 1 BIT_MASK 0x1 ECU_ADDRESS 0xFFF8BFBC DISPLAY_IDENTIFIER f_einstiegsbed_erfuellt.iSasZentr /end MEASUREMENT
/begin MEASUREMENT iSasZentr.f_red_mmotmax_angefordert "Flag das Einstiegsbed. für Zustandsgraph zur Bestimmung von m_motmax_kupschtz erfüllt sind" UBYTE Conv.cSasZentr._.f_red_mmotmax_angefordert_S5_S3 1 100 0 1 BIT_MASK 0x1 ECU_ADDRESS 0xFFF8BFC3 DISPLAY_IDENTIFIER f_red_mmotmax_angefordert.iSasZentr /end MEASUREMENT
/begin MEASUREMENT iSasZentr.f_schaltung_normal_beendet "Flag: Merker, das die laufende Schaltung ohne Abbrueche od. Maximalzeit beendet wurde" UBYTE Conv.cSasZentr._.f_schaltung_normal_beendet_S5_S3 1 100 0 1 BIT_MASK 0x1 ECU_ADDRESS 0xFFF8BFB1 DISPLAY_IDENTIFIER f_schaltung_normal_beendet.iSasZentr /end MEASUREMENT
/begin MEASUREMENT iSasZentr.flag_ge_dnr_aktiv "FLAG: Ein GE N-R findet statt" UBYTE Conv.cSasZentr._.flag_ge_dnr_aktiv_S5_S3 1 100 0 1 BIT_MASK 0x1 ECU_ADDRESS 0xFFF8BF96 DISPLAY_IDENTIFIER flag_ge_dnr_aktiv.iSasZentr /end MEASUREMENT
/begin MEASUREMENT iSasZentr.flag_ge_rnd_aktiv "FLAG: Ein GE N-D findet statt" UBYTE Conv.cSasZentr._.flag_ge_rnd_aktiv_S5_S3 1 100 0 1 BIT_MASK 0x1 ECU_ADDRESS 0xFFF8BF95 DISPLAY_IDENTIFIER flag_ge_rnd_aktiv.iSasZentr /end MEASUREMENT
/begin MEASUREMENT iSasZentr.flag_sync_verlassen_me "Flag sync istgang verlassen (schaltungsabhaengig) und kein sync zielgang fuer ME und GWK" UBYTE Conv.cSasZentr._.flag_sync_verlassen_me_S5_S3 1 100 0 1 BIT_MASK 0x1 ECU_ADDRESS 0xFFF8BF9A DISPLAY_IDENTIFIER flag_sync_verlassen_me.iSasZentr /end MEASUREMENT
/begin MEASUREMENT iSasZentr.folgeschaltung "Flag: Folgeschaltung" UBYTE Conv.cSasZentr._.folgeschaltung_S5_S3 1 100 0 1 BIT_MASK 0x1 ECU_ADDRESS 0xFFF8BF8F DISPLAY_IDENTIFIER folgeschaltung.iSasZentr /end MEASUREMENT
/begin MEASUREMENT iSasZentr.gangwechsel "FLAG: n_t zwischen sync istgang und zielgang" UBYTE Conv.cSasZentr._.gangwechsel_S5_S3 1 100 0 1 BIT_MASK 0x1 ECU_ADDRESS 0xFFF8BFAC DISPLAY_IDENTIFIER gangwechsel.iSasZentr /end MEASUREMENT
/begin MEASUREMENT iSasZentr.iSchaltend.aktuelle_schaltung "FLAG: Aktive Schaltung" UBYTE Conv.cSasSaKor._.aktuelle_schaltung_S5_S3 1 100 0 1 ECU_ADDRESS 0xFFF8BFD3 DISPLAY_IDENTIFIER aktuelle_schaltung.iSchaltend.iSasZentr /end MEASUREMENT
/begin MEASUREMENT iSasZentr.iSchaltend.erste_schaltung "Flag: 1. Befuellung einer Kupplung" UBYTE Conv.cSasSaKor._.erste_schaltung_S5_S3 1 100 0 1 BIT_MASK 0x1 ECU_ADDRESS 0xFFF8BFF0 DISPLAY_IDENTIFIER erste_schaltung.iSchaltend.iSasZentr /end MEASUREMENT
/begin MEASUREMENT iSasZentr.iSchaltend.f_verb_ada_erste_bef "Flag: 1. Befuellung einer Kupplung verbietet Adaption" UBYTE Conv.cSasSaKor._.f_verb_ada_erste_bef_S5_S3 1 100 0 1 BIT_MASK 0x1 ECU_ADDRESS 0xFFF8BFF1 DISPLAY_IDENTIFIER f_verb_ada_erste_bef.iSchaltend.iSasZentr /end MEASUREMENT
/begin MEASUREMENT iSasZentr.iSchaltend.fkt_halten_in_sync_verboten "FLAG: Ausfuehren der Fkt. Halten in Synchron verboten" UBYTE Conv.cSasSaKor._.fkt_halten_in_sync_verboten_S5_S3 1 100 0 1 BIT_MASK 0x1 ECU_ADDRESS 0xFFF8BFF4 DISPLAY_IDENTIFIER fkt_halten_in_sync_verboten.iSchaltend.iSasZentr /end MEASUREMENT
/begin MEASUREMENT iSasZentr.iSchaltend.iKab.ende_kab_gestartet "Flag: Zustand Ende der abschaltenden Kupplung gestartet" UBYTE Conv.cSasAnKab._.ende_kab_gestartet_S5_S3 1 100 0 1 BIT_MASK 0x1 ECU_ADDRESS 0xFFF8C000 DISPLAY_IDENTIFIER ende_kab_gestartet.iKab.iSchaltend.iSasZentr /end MEASUREMENT
/begin MEASUREMENT iSasZentr.iSchaltend.iKab.f_best_poffkab_in_syn_erfolgt "Flag: Neubestimmung p_offkab in Synchron erfolgt" UBYTE Conv.cSasAnKab._.f_best_poffkab_in_syn_erfolgt_S5_S3 1 100 0 1 BIT_MASK 0x1 ECU_ADDRESS 0xFFF8C018 DISPLAY_IDENTIFIER f_best_poffkab_in_syn_erfolgt.iKab.iSchaltend.iSasZentr /end MEASUREMENT
/begin MEASUREMENT iSasZentr.iSchaltend.iKab.f_ende_verz_kab_erlaubt "Flag: Bedingung fuer Ende Verzoegerung KAB erfuellt" UBYTE Conv.cSasAnKab._.f_ende_verz_kab_erlaubt_S5_S3 1 100 0 1 BIT_MASK 0x1 ECU_ADDRESS 0xFFF8C017 DISPLAY_IDENTIFIER f_ende_verz_kab_erlaubt.iKab.iSchaltend.iSasZentr /end MEASUREMENT
/begin MEASUREMENT iSasZentr.iSchaltend.iKab.f_rueckf_pozustartk0_aktiv "Hilfsflag für die Auswertung der Rueckfilterung des Offsets KL_POZUSTARTK0" UBYTE Conv.cSasAnKab._.f_rueckf_pozustartk0_aktiv_S5_S3 1 100 0 1 BIT_MASK 0x1 ECU_ADDRESS 0xFFF8C039 DISPLAY_IDENTIFIER f_rueckf_pozustartk0_aktiv.iKab.iSchaltend.iSasZentr /end MEASUREMENT
/begin MEASUREMENT iSasZentr.iSchaltend.iKab.f_warten_auf_sf_k0_aktiv "FLAG: Warten auf Ende der Schnellfuellung K0 aktiv" UBYTE Conv.cSasAnKab._.f_warten_auf_sf_k0_aktiv_S5_S3 1 100 0 1 BIT_MASK 0x1 ECU_ADDRESS 0xFFF8C038 DISPLAY_IDENTIFIER f_warten_auf_sf_k0_aktiv.iKab.iSchaltend.iSasZentr /end MEASUREMENT
/begin MEASUREMENT iSasZentr.iSchaltend.iKab.gls_hs_kab_gestartet "Flag: GLS der KAB kann starten" UBYTE Conv.cSasAnKab._.gls_hs_kab_gestartet_S5_S3 1 100 0 1 BIT_MASK 0x1 ECU_ADDRESS 0xFFF8C002 DISPLAY_IDENTIFIER gls_hs_kab_gestartet.iKab.iSchaltend.iSasZentr /end MEASUREMENT
/begin MEASUREMENT iSasZentr.iSchaltend.iKab.halten_in_syn_kab_gestartet "Flag: Ablauf Halten in Synchron fuer die KAB gestartet" UBYTE Conv.cSasAnKab._.halten_in_syn_kab_gestartet_S5_S3 1 100 0 1 BIT_MASK 0x1 ECU_ADDRESS 0xFFF8C010 DISPLAY_IDENTIFIER halten_in_syn_kab_gestartet.iKab.iSchaltend.iSasZentr /end MEASUREMENT
/begin MEASUREMENT iSasZentr.iSchaltend.iKab.kab_nicht_befuellt "Flag: Kupplung KAB nicht befuellt" UBYTE Conv.cSasAnKab._.kab_nicht_befuellt_S5_S3 1 100 0 1 BIT_MASK 0x1 ECU_ADDRESS 0xFFF8C016 DISPLAY_IDENTIFIER kab_nicht_befuellt.iKab.iSchaltend.iSasZentr /end MEASUREMENT
/begin MEASUREMENT iSasZentr.iSchaltend.iKab.kup_kab "Kupplungsnummer Abschaltende Kupplung" UBYTE Conv.cSasAnKab._.kup_kab_S5_S3 1 100 0 5 ECU_ADDRESS 0xFFF8C00C DISPLAY_IDENTIFIER kup_kab.iKab.iSchaltend.iSasZentr /end MEASUREMENT
/begin MEASUREMENT iSasZentr.iSchaltend.iKab.m_motsoll0_sas "Motorsollmoment bei Start Rampe auf Schaltdruck" SWORD UMR_NM__1_1_0_S5_S3 1 100 -1500 1500 ECU_ADDRESS 0xFFF8C036 DISPLAY_IDENTIFIER m_motsoll0_sas.iKab.iSchaltend.iSasZentr /end MEASUREMENT
/begin MEASUREMENT iSasZentr.iSchaltend.iKab.md_motsoll_sas "Motorsollmomentanstieg fuer KF-Zugriff abschalt. Kupplung" SWORD UMR_NM__1_1_0_S5_S3 1 100 -1500 1500 ECU_ADDRESS 0xFFF8C034 DISPLAY_IDENTIFIER md_motsoll_sas.iKab.iSchaltend.iSasZentr /end MEASUREMENT
/begin MEASUREMENT iSasZentr.iSchaltend.iKab.p_0stkab "Zustandsanfangsdruck gesteuerter Anteil der absch. Kupplung" SWORD UMR_BAR__1_1000_0_S5_S3 1 100 -32 32 ECU_ADDRESS 0xFFF8C01C DISPLAY_IDENTIFIER p_0stkab.iKab.iSchaltend.iSasZentr /end MEASUREMENT
/begin MEASUREMENT iSasZentr.iSchaltend.iKab.p_adaptkab "Adaptionsdruck abschaltende Kupplung" SWORD UMR_BAR__1_1000_0_S5_S3 1 100 0 20 ECU_ADDRESS 0xFFF8C004 DISPLAY_IDENTIFIER p_adaptkab.iKab.iSchaltend.iSasZentr /end MEASUREMENT
/begin MEASUREMENT iSasZentr.iSchaltend.iKab.p_kab "Druck KAB (inklusive GLS-Druck)" SWORD UMR_BAR__1_1000_0_S5_S3 1 100 0 20 ECU_ADDRESS 0xFFF8C012 DISPLAY_IDENTIFIER p_kab.iKab.iSchaltend.iSasZentr /end MEASUREMENT
/begin MEASUREMENT iSasZentr.iSchaltend.iKab.p_kfkab "Kennfelddruck gesteuerter Anteil der absch. Kupplung" SWORD UMR_BAR__1_1000_0_S5_S3 1 100 0 32 ECU_ADDRESS 0xFFF8C032 DISPLAY_IDENTIFIER p_kfkab.iKab.iSchaltend.iSasZentr /end MEASUREMENT
/begin MEASUREMENT iSasZentr.iSchaltend.iKab.p_offkab "Offsetdruck der abschaltenden Kupplung" SWORD UMR_BAR__1_1000_0_S5_S3 1 100 -32 32 ECU_ADDRESS 0xFFF8C01E DISPLAY_IDENTIFIER p_offkab.iKab.iSchaltend.iSasZentr /end MEASUREMENT
/begin MEASUREMENT iSasZentr.iSchaltend.iKab.p_stkab "Gesteuerter Druckanteil KAB" SWORD UMR_BAR__1_1000_0_S5_S3 1 100 0 20 ECU_ADDRESS 0xFFF8C006 DISPLAY_IDENTIFIER p_stkab.iKab.iSchaltend.iSasZentr /end MEASUREMENT
/begin MEASUREMENT iSasZentr.iSchaltend.iKab.pgo_kab_speicher.cBibRampeGradSi16._.letzter_ms_timer "Speichert den letzten BS-Timer" UWORD UMR_MSEC__1_1_0_S5_S3 1 100 0 65535 ECU_ADDRESS 0xFFF8C060 DISPLAY_IDENTIFIER letzter_ms_timer._.cBibRampeGradSi16.pgo_kab_speicher.iKab.iSchaltend.iSasZentr /end MEASUREMENT
/begin MEASUREMENT iSasZentr.iSchaltend.iKab.pgo_kab_speicher.cBibRampeGradSi16._.letzter_wert "Speichert den letzten Eingangswert" FLOAT32_IEEE UMR___1_1_0_S5_S3 1 100 -1e+037 1e+037 ECU_ADDRESS 0xFFF8C05C FORMAT "%3.2" DISPLAY_IDENTIFIER letzter_wert._.cBibRampeGradSi16.pgo_kab_speicher.iKab.iSchaltend.iSasZentr /end MEASUREMENT
/begin MEASUREMENT iSasZentr.iSchaltend.iKab.pgo_kab_speicher.cBibRampeGradSi16._.maximum "Maximum Begrenzung" FLOAT32_IEEE UMR___1_1_0_S5_S3 1 100 -1e+037 1e+037 ECU_ADDRESS 0xFFF8C068 FORMAT "%3.2" DISPLAY_IDENTIFIER maximum._.cBibRampeGradSi16.pgo_kab_speicher.iKab.iSchaltend.iSasZentr /end MEASUREMENT
/begin MEASUREMENT iSasZentr.iSchaltend.iKab.pgo_kab_speicher.cBibRampeGradSi16._.minimum "Minimum Begrenzung" FLOAT32_IEEE UMR___1_1_0_S5_S3 1 100 -1e+037 1e+037 ECU_ADDRESS 0xFFF8C064 FORMAT "%3.2" DISPLAY_IDENTIFIER minimum._.cBibRampeGradSi16.pgo_kab_speicher.iKab.iSchaltend.iSasZentr /end MEASUREMENT
/begin MEASUREMENT iSasZentr.iSchaltend.iKab.pkf_rs_kab_ausgegeben "Flag: Druck aus Kennfeld wird ausgegeben" UBYTE Conv.cSasAnKab._.pkf_rs_kab_ausgegeben_S5_S3 1 100 0 1 BIT_MASK 0x1 ECU_ADDRESS 0xFFF8C015 DISPLAY_IDENTIFIER pkf_rs_kab_ausgegeben.iKab.iSchaltend.iSasZentr /end MEASUREMENT
/begin MEASUREMENT iSasZentr.iSchaltend.iKab.pkf_rs_kab_gestartet "Flag: Kennfeldzugriff KAB (bei ZR) gestartet bzw. Rampe hat Kennfelddruck erreicht" UBYTE Conv.cSasAnKab._.pkf_rs_kab_gestartet_S5_S3 1 100 0 1 BIT_MASK 0x1 ECU_ADDRESS 0xFFF8C001 DISPLAY_IDENTIFIER pkf_rs_kab_gestartet.iKab.iSchaltend.iSasZentr /end MEASUREMENT
/begin MEASUREMENT iSasZentr.iSchaltend.iKab.po_0zustartk0 "Anfangsdruck fuer Rueckfilterung des Offsetdrucks nach Zustart K0" SWORD UMR_BAR__1_1000_0_S5_S3 1 100 0 6.4 ECU_ADDRESS 0xFFF8C03C DISPLAY_IDENTIFIER po_0zustartk0.iKab.iSchaltend.iSasZentr /end MEASUREMENT
/begin MEASUREMENT iSasZentr.iSchaltend.iKab.po_mtkab "Momentenabhaengiger Druckoffset der KAB" SWORD UMR_BAR__1_1000_0_S5_S3 1 100 -32 32 ECU_ADDRESS 0xFFF8C020 DISPLAY_IDENTIFIER po_mtkab.iKab.iSchaltend.iSasZentr /end MEASUREMENT
/begin MEASUREMENT iSasZentr.iSchaltend.iKab.po_zustartk0 "Offsetdruck der abschaltenden Kupplung waehrend Zustart K0" SWORD UMR_BAR__1_1000_0_S5_S3 1 100 0 6.4 ECU_ADDRESS 0xFFF8C03E DISPLAY_IDENTIFIER po_zustartk0.iKab.iSchaltend.iSasZentr /end MEASUREMENT
/begin MEASUREMENT iSasZentr.iSchaltend.iKab.ps_hs_kab_gestartet "Flag: Schaltdruckphase KAB gestartet" UBYTE Conv.cSasAnKab._.ps_hs_kab_gestartet_S5_S3 1 100 0 1 BIT_MASK 0x1 ECU_ADDRESS 0xFFF8C008 DISPLAY_IDENTIFIER ps_hs_kab_gestartet.iKab.iSchaltend.iSasZentr /end MEASUREMENT
/begin MEASUREMENT iSasZentr.iSchaltend.iKab.ra1_kab_gestartet "Flag: Rampe 1 KAB gestartet" UBYTE Conv.cSasAnKab._.ra1_kab_gestartet_S5_S3 1 100 0 1 BIT_MASK 0x1 ECU_ADDRESS 0xFFF8C009 DISPLAY_IDENTIFIER ra1_kab_gestartet.iKab.iSchaltend.iSasZentr /end MEASUREMENT
/begin MEASUREMENT iSasZentr.iSchaltend.iKab.ra_sd_hs_kab_gestartet "Flag: Rampe auf Schaltdruck KAB bei HS ist gestartet" UBYTE Conv.cSasAnKab._.ra_sd_hs_kab_gestartet_S5_S3 1 100 0 1 BIT_MASK 0x1 ECU_ADDRESS 0xFFF8C00E DISPLAY_IDENTIFIER ra_sd_hs_kab_gestartet.iKab.iSchaltend.iSasZentr /end MEASUREMENT
/begin MEASUREMENT iSasZentr.iSchaltend.iKab.ra_sd_rs_kab_gestartet "Flag: Rampe auf Schaltdruck KAB bei RS ist gestartet" UBYTE Conv.cSasAnKab._.ra_sd_rs_kab_gestartet_S5_S3 1 100 0 1 BIT_MASK 0x1 ECU_ADDRESS 0xFFF8C00F DISPLAY_IDENTIFIER ra_sd_rs_kab_gestartet.iKab.iSchaltend.iSasZentr /end MEASUREMENT
/begin MEASUREMENT iSasZentr.iSchaltend.iKab.raph_kab_speicher.letzter_timer "Speichert den letzten BS-Timer" UBYTE UMR_SEC__1_1_0_S5_S3 1 100 0 255 ECU_ADDRESS 0xFFF8C074 DISPLAY_IDENTIFIER letzter_timer.raph_kab_speicher.iKab.iSchaltend.iSasZentr /end MEASUREMENT
/begin MEASUREMENT iSasZentr.iSchaltend.iKab.raph_kab_speicher.letzter_wert "Speichert den letzten Eingangswert" SLONG UMR___1_1_0_S5_S3 1 100 -2147483648 2147483647 ECU_ADDRESS 0xFFF8C070 DISPLAY_IDENTIFIER letzter_wert.raph_kab_speicher.iKab.iSchaltend.iSasZentr /end MEASUREMENT
/begin MEASUREMENT iSasZentr.iSchaltend.iKab.raps_kab_speicher.letzter_timer "Speichert den letzten BS-Timer" UBYTE UMR_SEC__1_1_0_S5_S3 1 100 0 255 ECU_ADDRESS 0xFFF8C07C DISPLAY_IDENTIFIER letzter_timer.raps_kab_speicher.iKab.iSchaltend.iSasZentr /end MEASUREMENT
/begin MEASUREMENT iSasZentr.iSchaltend.iKab.raps_kab_speicher.letzter_wert "Speichert den letzten Eingangswert" SLONG UMR___1_1_0_S5_S3 1 100 -2147483648 2147483647 ECU_ADDRESS 0xFFF8C078 DISPLAY_IDENTIFIER letzter_wert.raps_kab_speicher.iKab.iSchaltend.iSasZentr /end MEASUREMENT
/begin MEASUREMENT iSasZentr.iSchaltend.iKab.schalttyp_kab "Schalttyp der absch. Kupplung" UBYTE Conv.cSasAnKab._.schalttyp_kab_S5_S3 1 100 0 4 ECU_ADDRESS 0xFFF8C01A DISPLAY_IDENTIFIER schalttyp_kab.iKab.iSchaltend.iSasZentr /end MEASUREMENT
/begin MEASUREMENT iSasZentr.iSchaltend.iKab.statisch_kab "Flag: Anzeige ob KAB eine Druckvorgabe ausgibt oder Minimal/Maximaldruck angesteuert wird" UBYTE Conv.cSasAnKab._.statisch_kab_S5_S3 1 100 0 1 BIT_MASK 0x1 ECU_ADDRESS 0xFFF8C00A DISPLAY_IDENTIFIER statisch_kab.iKab.iSchaltend.iSasZentr /end MEASUREMENT
/begin MEASUREMENT iSasZentr.iSchaltend.iKab.t_0kab "Zeitdauer des zuletzt durchlaufenen Zustands der absch. Kupplung" SWORD UMR_MSEC__10_1_0_S5_S3 1 100 -327680 327670 ECU_ADDRESS 0xFFF8C024 DISPLAY_IDENTIFIER t_0kab.iKab.iSchaltend.iSasZentr /end MEASUREMENT
/begin MEASUREMENT iSasZentr.iSchaltend.iKab.t_ph_rs "Berechnete Zeitdauer Haltedruckphase der absch. Kupplung während RS" SLONG UMR_MSEC__10_1_0_S5_S3 1 100 -327680 327670 ECU_ADDRESS 0xFFF8C028 DISPLAY_IDENTIFIER t_ph_rs.iKab.iSchaltend.iSasZentr /end MEASUREMENT
/begin MEASUREMENT iSasZentr.iSchaltend.iKab.t_ra_kab_vor_ra1_kzu "Anteil Dauer der KAB-Rampe auf Schaltdruck vor Start der KZU-Rampe auf Schaltdruck" SWORD UMR_MSEC__10_1_0_S5_S3 1 100 -327680 327670 ECU_ADDRESS 0xFFF8C02E DISPLAY_IDENTIFIER t_ra_kab_vor_ra1_kzu.iKab.iSchaltend.iSasZentr /end MEASUREMENT
/begin MEASUREMENT iSasZentr.iSchaltend.iKab.t_verz_ph_rs "Berechnete Zeitdauer Verzögerung der Haltedruckphase der absch. Kupplung während RS" SWORD UMR_MSEC__10_1_0_S5_S3 1 100 -327680 327670 ECU_ADDRESS 0xFFF8C02C DISPLAY_IDENTIFIER t_verz_ph_rs.iKab.iSchaltend.iSasZentr /end MEASUREMENT
/begin MEASUREMENT iSasZentr.iSchaltend.iKab.t_zkab "Zustandszeitdauer der absch. Kupplung" SWORD UMR_MSEC__10_1_0_S5_S3 1 100 -327680 327670 ECU_ADDRESS 0xFFF8C022 DISPLAY_IDENTIFIER t_zkab.iKab.iSchaltend.iSasZentr /end MEASUREMENT
/begin MEASUREMENT iSasZentr.iSchaltend.iKab.timer_hinsyn "Zeit seit Start Rampe auf Halten in Synchron" UBYTE UMR_MSEC__10_1_0_S5_S3 1 100 0 2550 ECU_ADDRESS 0xFFF8C030 DISPLAY_IDENTIFIER timer_hinsyn.iKab.iSchaltend.iSasZentr /end MEASUREMENT
/begin MEASUREMENT iSasZentr.iSchaltend.iKab.timer_pozustartk0 "Timer fuer Rueckfilterung des Offset nach Befuellung der K0" UBYTE UMR_MSEC__10_1_0_S5_S3 1 100 0 2550 ECU_ADDRESS 0xFFF8C03A DISPLAY_IDENTIFIER timer_pozustartk0.iKab.iSchaltend.iSasZentr /end MEASUREMENT
/begin MEASUREMENT iSasZentr.iSchaltend.iKab.timer_zkab "Zustandstimer abschaltende Kupplung" UBYTE UMR_MSEC__10_1_0_S5_S3 1 100 0 2550 ECU_ADDRESS 0xFFF8C014 DISPLAY_IDENTIFIER timer_zkab.iKab.iSchaltend.iSasZentr /end MEASUREMENT
/begin MEASUREMENT iSasZentr.iSchaltend.iKab.ueb_rs_kab_gestartet "Flag: Ueberschneidungsphase abschaltende Kupplung (bei ZR-Schaltung) gestartet" UBYTE Conv.cSasAnKab._.ueb_rs_kab_gestartet_S5_S3 1 100 0 1 BIT_MASK 0x1 ECU_ADDRESS 0xFFF8C00B DISPLAY_IDENTIFIER ueb_rs_kab_gestartet.iKab.iSchaltend.iSasZentr /end MEASUREMENT
/begin MEASUREMENT iSasZentr.iSchaltend.iKab.z_kab "Zustand abschaltende Kupplung" UBYTE Conv.cSasAnKab._.z_kab_S5_S3 1 100 0 16 ECU_ADDRESS 0xFFF8C00D DISPLAY_IDENTIFIER z_kab.iKab.iSchaltend.iSasZentr /end MEASUREMENT
/begin MEASUREMENT iSasZentr.iSchaltend.iKab.zaehler_zkab "Zustandszaehler der abschaltenden Kupplung" UBYTE UMR___1_1_0_S5_S3 1 100 0 255 ECU_ADDRESS 0xFFF8C019 DISPLAY_IDENTIFIER zaehler_zkab.iKab.iSchaltend.iSasZentr /end MEASUREMENT
/begin MEASUREMENT iSasZentr.iSchaltend.iKzu.dauer_fa_hsrs_kzu "Merker Dauer Fuellausgleichsphase der KZU" SWORD UMR_MSEC__10_1_0_S5_S3 1 100 -327680 327670 ECU_ADDRESS 0xFFF8C0A4 DISPLAY_IDENTIFIER dauer_fa_hsrs_kzu.iKzu.iSchaltend.iSasZentr /end MEASUREMENT
/begin MEASUREMENT iSasZentr.iSchaltend.iKzu.dauer_ra1_hsrs_kzu "Merker Dauer Rampe 1 der KZU" SWORD UMR_MSEC__10_1_0_S5_S3 1 100 -327680 327670 ECU_ADDRESS 0xFFF8C0A0 DISPLAY_IDENTIFIER dauer_ra1_hsrs_kzu.iKzu.iSchaltend.iSasZentr /end MEASUREMENT
/begin MEASUREMENT iSasZentr.iSchaltend.iKzu.f_hinsyn_kzu_gestartet "FLAG: HINSYN-Fkt. im KZU-Ablauf gestartet" UBYTE Conv.cSasAnKzu._.f_hinsyn_kzu_gestartet_S5_S3 1 100 0 1 BIT_MASK 0x1 ECU_ADDRESS 0xFFF8C09E DISPLAY_IDENTIFIER f_hinsyn_kzu_gestartet.iKzu.iSchaltend.iSasZentr /end MEASUREMENT
/begin MEASUREMENT iSasZentr.iSchaltend.iKzu.f_ngs_abflare_unterschritten "Merker ob Druckoffset auf Schaltdruck bei Flare gesetzt werden soll" UBYTE Conv.cSasAnKzu._.f_ngs_abflare_unterschritten_S5_S3 1 100 0 1 BIT_MASK 0x1 ECU_ADDRESS 0xFFF8C0BE DISPLAY_IDENTIFIER f_ngs_abflare_unterschritten.iKzu.iSchaltend.iSasZentr /end MEASUREMENT
/begin MEASUREMENT iSasZentr.iSchaltend.iKzu.f_pokzufol_erlaubt "FLAG: Verwendung von KF_POKZUFOL ist erlaubt" UBYTE Conv.cSasAnKzu._.f_pokzufol_erlaubt_S5_S3 1 100 0 1 BIT_MASK 0x1 ECU_ADDRESS 0xFFF8C0BF DISPLAY_IDENTIFIER f_pokzufol_erlaubt.iKzu.iSchaltend.iSasZentr /end MEASUREMENT
/begin MEASUREMENT iSasZentr.iSchaltend.iKzu.f_rampenzeitberechnung_fertig "Flag: Die Berechnung der Schliessrampenzeit erfolgt einmalig" UBYTE Conv.cSasAnKzu._.f_rampenzeitberechnung_fertig_S5_S3 1 100 0 1 BIT_MASK 0x1 ECU_ADDRESS 0xFFF8C096 DISPLAY_IDENTIFIER f_rampenzeitberechnung_fertig.iKzu.iSchaltend.iSasZentr /end MEASUREMENT
/begin MEASUREMENT iSasZentr.iSchaltend.iKzu.f_schnellfuellung_war_aktiv "FLAG: Schnellfüllung wurde ausgeführt" UBYTE Conv.cSasAnKzu._.f_schnellfuellung_war_aktiv_S5_S3 1 100 0 1 BIT_MASK 0x1 ECU_ADDRESS 0xFFF8C0A2 DISPLAY_IDENTIFIER f_schnellfuellung_war_aktiv.iKzu.iSchaltend.iSasZentr /end MEASUREMENT
/begin MEASUREMENT iSasZentr.iSchaltend.iKzu.fa_kzu_gestartet "Flag: Fuellausgleich KZU gestartet" UBYTE Conv.cSasAnKzu._.fa_kzu_gestartet_S5_S3 1 100 0 1 BIT_MASK 0x1 ECU_ADDRESS 0xFFF8C080 DISPLAY_IDENTIFIER fa_kzu_gestartet.iKzu.iSchaltend.iSasZentr /end MEASUREMENT
/begin MEASUREMENT iSasZentr.iSchaltend.iKzu.flag_pomekzu_erlaubt "Flag: Aufrechnung ME-abhaengiger Druckoffset erlaubt" UBYTE Conv.cSasAnKzu._.flag_pomekzu_erlaubt_S5_S3 1 100 0 1 BIT_MASK 0x1 ECU_ADDRESS 0xFFF8C0AD DISPLAY_IDENTIFIER flag_pomekzu_erlaubt.iKzu.iSchaltend.iSasZentr /end MEASUREMENT
/begin MEASUREMENT iSasZentr.iSchaltend.iKzu.kup_kzu "Kupplungsnummer Zuschaltende Kupplung" UBYTE Conv.cSasAnKzu._.kup_kzu_S5_S3 1 100 0 5 ECU_ADDRESS 0xFFF8C098 DISPLAY_IDENTIFIER kup_kzu.iKzu.iSchaltend.iSasZentr /end MEASUREMENT
/begin MEASUREMENT iSasZentr.iSchaltend.iKzu.md_motsoll_sas "Motorsollmomentanstieg" SWORD UMR_NM__1_1_0_S5_S3 1 100 -1500 1500 ECU_ADDRESS 0xFFF8C0B8 DISPLAY_IDENTIFIER md_motsoll_sas.iKzu.iSchaltend.iSasZentr /end MEASUREMENT
/begin MEASUREMENT iSasZentr.iSchaltend.iKzu.p_0stkzu "Zustandsanfangsdruck gesteuerter Anteil KZU" SWORD UMR_BAR__1_1000_0_S5_S3 1 100 0 20 ECU_ADDRESS 0xFFF8C0A8 DISPLAY_IDENTIFIER p_0stkzu.iKzu.iSchaltend.iSasZentr /end MEASUREMENT
/begin MEASUREMENT iSasZentr.iSchaltend.iKzu.p_adaptkzu "Adaptionsdruck zuschaltende Kupplung" SWORD UMR_BAR__1_1000_0_S5_S3 1 100 0 20 ECU_ADDRESS 0xFFF8C082 DISPLAY_IDENTIFIER p_adaptkzu.iKzu.iSchaltend.iSasZentr /end MEASUREMENT
/begin MEASUREMENT iSasZentr.iSchaltend.iKzu.p_fkzu "Fuelldruck" SWORD UMR_BAR__1_1000_0_S5_S3 1 100 0 20 ECU_ADDRESS 0xFFF8C0AA DISPLAY_IDENTIFIER p_fkzu.iKzu.iSchaltend.iSasZentr /end MEASUREMENT
/begin MEASUREMENT iSasZentr.iSchaltend.iKzu.p_fkzu_gueltig "Flag: Fuelldruck wurde berechnet und ausgegeben" UBYTE Conv.cSasAnKzu._.p_fkzu_gueltig_S5_S3 1 100 0 1 BIT_MASK 0x1 ECU_ADDRESS 0xFFF8C0AC DISPLAY_IDENTIFIER p_fkzu_gueltig.iKzu.iSchaltend.iSasZentr /end MEASUREMENT
/begin MEASUREMENT iSasZentr.iSchaltend.iKzu.p_kzu "Druck KZU (inklusive GLS-Druck)" SWORD UMR_BAR__1_1000_0_S5_S3 1 100 0 20 ECU_ADDRESS 0xFFF8C09C DISPLAY_IDENTIFIER p_kzu.iKzu.iSchaltend.iSasZentr /end MEASUREMENT
/begin MEASUREMENT iSasZentr.iSchaltend.iKzu.p_offkzu "Offsetdruck der zuschaltenden Kupplung" SWORD UMR_BAR__1_1000_0_S5_S3 1 100 0 20 ECU_ADDRESS 0xFFF8C0B4 DISPLAY_IDENTIFIER p_offkzu.iKzu.iSchaltend.iSasZentr /end MEASUREMENT
/begin MEASUREMENT iSasZentr.iSchaltend.iKzu.p_stkzu "Gesteuerter Druckanteil KZU" SWORD UMR_BAR__1_1000_0_S5_S3 1 100 0 20 ECU_ADDRESS 0xFFF8C084 DISPLAY_IDENTIFIER p_stkzu.iKzu.iSchaltend.iSasZentr /end MEASUREMENT
/begin MEASUREMENT iSasZentr.iSchaltend.iKzu.pgo_kzu_speicher.cBibRampeGradSi16._.letzter_ms_timer "Speichert den letzten BS-Timer" UWORD UMR_MSEC__1_1_0_S5_S3 1 100 0 65535 ECU_ADDRESS 0xFFF8C0E4 DISPLAY_IDENTIFIER letzter_ms_timer._.cBibRampeGradSi16.pgo_kzu_speicher.iKzu.iSchaltend.iSasZentr /end MEASUREMENT
/begin MEASUREMENT iSasZentr.iSchaltend.iKzu.pgo_kzu_speicher.cBibRampeGradSi16._.letzter_wert "Speichert den letzten Eingangswert" FLOAT32_IEEE UMR___1_1_0_S5_S3 1 100 -1e+037 1e+037 ECU_ADDRESS 0xFFF8C0E0 FORMAT "%3.2" DISPLAY_IDENTIFIER letzter_wert._.cBibRampeGradSi16.pgo_kzu_speicher.iKzu.iSchaltend.iSasZentr /end MEASUREMENT
/begin MEASUREMENT iSasZentr.iSchaltend.iKzu.pgo_kzu_speicher.cBibRampeGradSi16._.maximum "Maximum Begrenzung" FLOAT32_IEEE UMR___1_1_0_S5_S3 1 100 -1e+037 1e+037 ECU_ADDRESS 0xFFF8C0EC FORMAT "%3.2" DISPLAY_IDENTIFIER maximum._.cBibRampeGradSi16.pgo_kzu_speicher.iKzu.iSchaltend.iSasZentr /end MEASUREMENT
/begin MEASUREMENT iSasZentr.iSchaltend.iKzu.pgo_kzu_speicher.cBibRampeGradSi16._.minimum "Minimum Begrenzung" FLOAT32_IEEE UMR___1_1_0_S5_S3 1 100 -1e+037 1e+037 ECU_ADDRESS 0xFFF8C0E8 FORMAT "%3.2" DISPLAY_IDENTIFIER minimum._.cBibRampeGradSi16.pgo_kzu_speicher.iKzu.iSchaltend.iSasZentr /end MEASUREMENT
/begin MEASUREMENT iSasZentr.iSchaltend.iKzu.po_kzuflare "Druckoffset auf Schaltdruck bei Flare" SWORD UMR_BAR__1_1000_0_S5_S3 1 100 0 20 ECU_ADDRESS 0xFFF8C0BC DISPLAY_IDENTIFIER po_kzuflare.iKzu.iSchaltend.iSasZentr /end MEASUREMENT
/begin MEASUREMENT iSasZentr.iSchaltend.iKzu.po_mekzu "Schaltdruckoffset, der abhaengig von einem ME ist" SWORD UMR_BAR__1_1000_0_S5_S3 1 100 0 12.75 ECU_ADDRESS 0xFFF8C0AE DISPLAY_IDENTIFIER po_mekzu.iKzu.iSchaltend.iSasZentr /end MEASUREMENT
/begin MEASUREMENT iSasZentr.iSchaltend.iKzu.po_mtkzu "momentenabhaengiger Druckoffset" SWORD UMR_BAR__1_1000_0_S5_S3 1 100 0 20 ECU_ADDRESS 0xFFF8C0B6 DISPLAY_IDENTIFIER po_mtkzu.iKzu.iSchaltend.iSasZentr /end MEASUREMENT
/begin MEASUREMENT iSasZentr.iSchaltend.iKzu.ra1_hsrs_kzu_gestartet "Flag: Rampe 1 KZU gestartet" UBYTE Conv.cSasAnKzu._.ra1_hsrs_kzu_gestartet_S5_S3 1 100 0 1 BIT_MASK 0x1 ECU_ADDRESS 0xFFF8C086 DISPLAY_IDENTIFIER ra1_hsrs_kzu_gestartet.iKzu.iSchaltend.iSasZentr /end MEASUREMENT
/begin MEASUREMENT iSasZentr.iSchaltend.iKzu.ra2_hsrs_kzu_gestartet "Flag: Rampe 2 KZU gestartet" UBYTE Conv.cSasAnKzu._.ra2_hsrs_kzu_gestartet_S5_S3 1 100 0 1 BIT_MASK 0x1 ECU_ADDRESS 0xFFF8C087 DISPLAY_IDENTIFIER ra2_hsrs_kzu_gestartet.iKzu.iSchaltend.iSasZentr /end MEASUREMENT
/begin MEASUREMENT iSasZentr.iSchaltend.iKzu.ra3_hsrs_kzu_gestartet "Flag: Rampe 3 KZU gestartet" UBYTE Conv.cSasAnKzu._.ra3_hsrs_kzu_gestartet_S5_S3 1 100 0 1 BIT_MASK 0x1 ECU_ADDRESS 0xFFF8C088 DISPLAY_IDENTIFIER ra3_hsrs_kzu_gestartet.iKzu.iSchaltend.iSasZentr /end MEASUREMENT
/begin MEASUREMENT iSasZentr.iSchaltend.iKzu.raph_kzu_speicher.letzter_timer "Speichert den letzten BS-Timer" UBYTE UMR_SEC__1_1_0_S5_S3 1 100 0 255 ECU_ADDRESS 0xFFF8C0F8 DISPLAY_IDENTIFIER letzter_timer.raph_kzu_speicher.iKzu.iSchaltend.iSasZentr /end MEASUREMENT
/begin MEASUREMENT iSasZentr.iSchaltend.iKzu.raph_kzu_speicher.letzter_wert "Speichert den letzten Eingangswert" SLONG UMR___1_1_0_S5_S3 1 100 -2147483648 2147483647 ECU_ADDRESS 0xFFF8C0F4 DISPLAY_IDENTIFIER letzter_wert.raph_kzu_speicher.iKzu.iSchaltend.iSasZentr /end MEASUREMENT
/begin MEASUREMENT iSasZentr.iSchaltend.iKzu.schalttyp_kzu "Schalttyp der zusch. Kupplung" UBYTE Conv.cSasAnKzu._.schalttyp_kzu_S5_S3 1 100 0 4 ECU_ADDRESS 0xFFF8C0A7 DISPLAY_IDENTIFIER schalttyp_kzu.iKzu.iSchaltend.iSasZentr /end MEASUREMENT
/begin MEASUREMENT iSasZentr.iSchaltend.iKzu.schliessen_kzu "Flag: KZU soll schliessen" UBYTE Conv.cSasAnKzu._.schliessen_kzu_S5_S3 1 100 0 1 BIT_MASK 0x1 ECU_ADDRESS 0xFFF8C089 DISPLAY_IDENTIFIER schliessen_kzu.iKzu.iSchaltend.iSasZentr /end MEASUREMENT
/begin MEASUREMENT iSasZentr.iSchaltend.iKzu.statisch_kzu "Flag: Anzeige ob KAB eine Druckvorgabe ausgibt oder Minimal/Maximaldruck angesteuert wird" UBYTE Conv.cSasAnKzu._.statisch_kzu_S5_S3 1 100 0 1 BIT_MASK 0x1 ECU_ADDRESS 0xFFF8C08A DISPLAY_IDENTIFIER statisch_kzu.iKzu.iSchaltend.iSasZentr /end MEASUREMENT
/begin MEASUREMENT iSasZentr.iSchaltend.iKzu.t_0kzu "Zeitdauer des zuletzt durchlaufenen Zustands KZU" SWORD UMR_MSEC__10_1_0_S5_S3 1 100 -327680 327670 ECU_ADDRESS 0xFFF8C0B2 DISPLAY_IDENTIFIER t_0kzu.iKzu.iSchaltend.iSasZentr /end MEASUREMENT
/begin MEASUREMENT iSasZentr.iSchaltend.iKzu.t_berechnungszeitpunkt "Zeitpunkt für Berechnungsstart" SWORD UMR_MSEC__10_1_0_S5_S3 1 100 -327680 327670 ECU_ADDRESS 0xFFF8C094 DISPLAY_IDENTIFIER t_berechnungszeitpunkt.iKzu.iSchaltend.iSasZentr /end MEASUREMENT
/begin MEASUREMENT iSasZentr.iSchaltend.iKzu.t_besfhsrskzu "Zeit bis Ende Schnellfuellung" SWORD UMR_MSEC__1_1_0_S5_S3 1 100 -32768 32767 ECU_ADDRESS 0xFFF8C09A DISPLAY_IDENTIFIER t_besfhsrskzu.iKzu.iSchaltend.iSasZentr /end MEASUREMENT
/begin MEASUREMENT iSasZentr.iSchaltend.iKzu.t_eff_ra1_hsrs_kzu "Effektive Zeit Rampe 1 KZU" UWORD UMR_MSEC__10_1_0_S5_S3 1 100 0 655350 ECU_ADDRESS 0xFFF8C08E DISPLAY_IDENTIFIER t_eff_ra1_hsrs_kzu.iKzu.iSchaltend.iSasZentr /end MEASUREMENT
/begin MEASUREMENT iSasZentr.iSchaltend.iKzu.t_ig_change "Zeit für Momentenübergang" UBYTE UMR_MSEC__10_1_0_S5_S3 1 100 0 2540 ECU_ADDRESS 0xFFF8C092 DISPLAY_IDENTIFIER t_ig_change.iKzu.iSchaltend.iSasZentr /end MEASUREMENT
/begin MEASUREMENT iSasZentr.iSchaltend.iKzu.t_vkabr_abgelaufen "Flag: Verzoegerungszeit nach Start Rampe2 abgelaufen" UBYTE Conv.cSasAnKzu._.t_vkabr_abgelaufen_S5_S3 1 100 0 1 BIT_MASK 0x1 ECU_ADDRESS 0xFFF8C08B DISPLAY_IDENTIFIER t_vkabr_abgelaufen.iKzu.iSchaltend.iSasZentr /end MEASUREMENT
/begin MEASUREMENT iSasZentr.iSchaltend.iKzu.t_zkzu "Zustandszeitdauer der KZU" SWORD UMR_MSEC__10_1_0_S5_S3 1 100 -327680 327670 ECU_ADDRESS 0xFFF8C0B0 DISPLAY_IDENTIFIER t_zkzu.iKzu.iSchaltend.iSasZentr /end MEASUREMENT
/begin MEASUREMENT iSasZentr.iSchaltend.iKzu.timer16_ra1_hsrs_kzu "Zeit seit Start Rampe 1 KZU" UWORD UMR_MSEC__10_1_0_S5_S3 1 100 0 655350 ECU_ADDRESS 0xFFF8C08C DISPLAY_IDENTIFIER timer16_ra1_hsrs_kzu.iKzu.iSchaltend.iSasZentr /end MEASUREMENT
/begin MEASUREMENT iSasZentr.iSchaltend.iKzu.timer_ab_ende_sf_kzu "Timer seit SF Ende Kzu" UWORD UMR_MSEC__10_1_0_S5_S3 1 100 0 655350 ECU_ADDRESS 0xFFF8C0BA DISPLAY_IDENTIFIER timer_ab_ende_sf_kzu.iKzu.iSchaltend.iSasZentr /end MEASUREMENT
/begin MEASUREMENT iSasZentr.iSchaltend.iKzu.timer_seit_start_schaltung "Zeit seit Start Schaltung" UBYTE UMR_MSEC__10_1_0_S5_S3 1 100 0 2550 ECU_ADDRESS 0xFFF8C093 DISPLAY_IDENTIFIER timer_seit_start_schaltung.iKzu.iSchaltend.iSasZentr /end MEASUREMENT
/begin MEASUREMENT iSasZentr.iSchaltend.iKzu.timer_start_fa_kzu "Zeit seit Start Fuellausgleichsphase" UBYTE UMR_MSEC__10_1_0_S5_S3 1 100 0 2550 ECU_ADDRESS 0xFFF8C090 DISPLAY_IDENTIFIER timer_start_fa_kzu.iKzu.iSchaltend.iSasZentr /end MEASUREMENT
/begin MEASUREMENT iSasZentr.iSchaltend.iKzu.timer_zkzu "Zustandstimer zuschaltende Kupplung" UBYTE UMR_MSEC__10_1_0_S5_S3 1 100 0 2550 ECU_ADDRESS 0xFFF8C091 DISPLAY_IDENTIFIER timer_zkzu.iKzu.iSchaltend.iSasZentr /end MEASUREMENT
/begin MEASUREMENT iSasZentr.iSchaltend.iKzu.z_kzu "Zustand zuschaltende Kupplung in einer Schaltung" UBYTE Conv.cSasAnKzu._.z_kzu_S5_S3 1 100 0 19 ECU_ADDRESS 0xFFF8C097 DISPLAY_IDENTIFIER z_kzu.iKzu.iSchaltend.iSasZentr /end MEASUREMENT
/begin MEASUREMENT iSasZentr.iSchaltend.iKzu.zaehler_zkzu "Zustandszaehler der zusch. Kupplung" UBYTE UMR___1_1_0_S5_S3 1 100 0 255 ECU_ADDRESS 0xFFF8C0A6 DISPLAY_IDENTIFIER zaehler_zkzu.iKzu.iSchaltend.iSasZentr /end MEASUREMENT
/begin MEASUREMENT iSasZentr.iSchaltend.index_spsas "Vorgabe Schaltung mit SP/SPORT-Parametern" UBYTE Conv.cSasSaKor._.index_spsas_S5_S3 1 100 0 2 ECU_ADDRESS 0xFFF8BFDA DISPLAY_IDENTIFIER index_spsas.iSchaltend.iSasZentr /end MEASUREMENT
/begin MEASUREMENT iSasZentr.iSchaltend.istgang_sas "Istgang SAS" SBYTE Conv.cSasSaKor._.istgang_sas_S5_S3 1 100 -1 8 ECU_ADDRESS 0xFFF8BFD2 DISPLAY_IDENTIFIER istgang_sas.iSchaltend.iSasZentr /end MEASUREMENT
/begin MEASUREMENT iSasZentr.iSchaltend.kup_schutz_massnahme_aktiv "FLAG: Schutzfunktion auf Grund eines überhitzten Schaltelements aktiv." UBYTE Conv.cSasSaKor._.kup_schutz_massnahme_aktiv_S5_S3 1 100 0 1 BIT_MASK 0x1 ECU_ADDRESS 0xFFF8BFFE DISPLAY_IDENTIFIER kup_schutz_massnahme_aktiv.iSchaltend.iSasZentr /end MEASUREMENT
/begin MEASUREMENT iSasZentr.iSchaltend.m_motsoll0_sas "Motorsollmoment bei Start Schaltung" SWORD UMR_NM__1_1_0_S5_S3 1 100 -1500 1500 ECU_ADDRESS 0xFFF8BFEA DISPLAY_IDENTIFIER m_motsoll0_sas.iSchaltend.iSasZentr /end MEASUREMENT
/begin MEASUREMENT iSasZentr.iSchaltend.n_tkf "Turbinendrehzahl f. KF-Zugriff" UBYTE UMR_U_MIN_32_1_0_S5_S3 1 100 0 8160 ECU_ADDRESS 0xFFF8BFE0 DISPLAY_IDENTIFIER n_tkf.iSchaltend.iSasZentr /end MEASUREMENT
/begin MEASUREMENT iSasZentr.iSchaltend.n_tsyn "Turbinensynchrondrehzahl fuer zielgang_sas" UWORD UMR_U_MIN_1_1_0_S5_S3 1 100 0 8160 ECU_ADDRESS 0xFFF8BFDE DISPLAY_IDENTIFIER n_tsyn.iSchaltend.iSasZentr /end MEASUREMENT
/begin MEASUREMENT iSasZentr.iSchaltend.nd_syn "Differenzdrehzahl zur Synchrondrehzahl neuer Gang (zielgang_sas)" SWORD UMR_U_MIN_1_1_0_S5_S3 1 100 -8000 8000 ECU_ADDRESS 0xFFF8BFE2 DISPLAY_IDENTIFIER nd_syn.iSchaltend.iSasZentr /end MEASUREMENT
/begin MEASUREMENT iSasZentr.iSchaltend.nd_synistgang "Differenzdrehzahl zu synchron Istgang" SWORD UMR_U_MIN_1_1_0_S5_S3 1 100 -8000 8000 ECU_ADDRESS 0xFFF8BFE8 DISPLAY_IDENTIFIER nd_synistgang.iSchaltend.iSasZentr /end MEASUREMENT
/begin MEASUREMENT iSasZentr.iSchaltend.nd_vsyn_betr "Betrag Differenzdrehzahl bis synchron Zielgang" SWORD UMR_U_MIN_1_1_0_S5_S3 1 100 0 8160 ECU_ADDRESS 0xFFF8BFE4 DISPLAY_IDENTIFIER nd_vsyn_betr.iSchaltend.iSasZentr /end MEASUREMENT
/begin MEASUREMENT iSasZentr.iSchaltend.ng_dsynzielgang "Gradient Differenzdrehzahl n_t zu n_t(synchron zielgang)" SWORD UMR_U_MINSEC_1_1_0_S5_S3 1 100 -32000 32000 ECU_ADDRESS 0xFFF8BFE6 DISPLAY_IDENTIFIER ng_dsynzielgang.iSchaltend.iSasZentr /end MEASUREMENT
/begin MEASUREMENT iSasZentr.iSchaltend.p_kab_letzte_schaltung "Druck KAB bei letzter Schaltung" SWORD UMR_BAR__1_1000_0_S5_S3 1 100 0 12.75 ECU_ADDRESS 0xFFF8BFEE DISPLAY_IDENTIFIER p_kab_letzte_schaltung.iSchaltend.iSasZentr /end MEASUREMENT
/begin MEASUREMENT iSasZentr.iSchaltend.p_kzu_letzte_schaltung "Druck KZU bei letzter Schaltung" SWORD UMR_BAR__1_1000_0_S5_S3 1 100 0 12.75 ECU_ADDRESS 0xFFF8BFEC DISPLAY_IDENTIFIER p_kzu_letzte_schaltung.iSchaltend.iSasZentr /end MEASUREMENT
/begin MEASUREMENT iSasZentr.iSchaltend.schaltinfo_sas "Aktuelle Schaltinfo des Schaltablaufs" UBYTE Conv.cSasSaKor._.schaltinfo_sas_S5_S3 1 100 0 4 ECU_ADDRESS 0xFFF8BFD5 DISPLAY_IDENTIFIER schaltinfo_sas.iSchaltend.iSasZentr /end MEASUREMENT
/begin MEASUREMENT iSasZentr.iSchaltend.schaltinfo_sas_vor_folge "Schaltinfo der vorhergehenden Schaltung waehrend verschachtelten Sch." UBYTE Conv.cSasSaKor._.schaltinfo_sas_vor_folge_S5_S3 1 100 0 8 ECU_ADDRESS 0xFFF8BFF2 DISPLAY_IDENTIFIER schaltinfo_sas_vor_folge.iSchaltend.iSasZentr /end MEASUREMENT
/begin MEASUREMENT iSasZentr.iSchaltend.schaltinfo_syn "Schaltinfo fuer Synchronerkennung" UBYTE Conv.cSasSaKor._.schaltinfo_syn_S5_S3 1 100 0 4 ECU_ADDRESS 0xFFF8BFFA DISPLAY_IDENTIFIER schaltinfo_syn.iSchaltend.iSasZentr /end MEASUREMENT
/begin MEASUREMENT iSasZentr.iSchaltend.schnellfuellung_beendet "Flag: Schnellfuellung beendet" UBYTE Conv.cSasSaKor._.schnellfuellung_beendet_S5_S3 1 100 0 1 BIT_MASK 0x1 ECU_ADDRESS 0xFFF8BFD6 DISPLAY_IDENTIFIER schnellfuellung_beendet.iSchaltend.iSasZentr /end MEASUREMENT
/begin MEASUREMENT iSasZentr.iSchaltend.schnellfuellung_gestartet "Flag: Schnellfuellung gestartet" UBYTE Conv.cSasSaKor._.schnellfuellung_gestartet_S5_S3 1 100 0 1 BIT_MASK 0x1 ECU_ADDRESS 0xFFF8BFF3 DISPLAY_IDENTIFIER schnellfuellung_gestartet.iSchaltend.iSasZentr /end MEASUREMENT
/begin MEASUREMENT iSasZentr.iSchaltend.sp_ngdsynzielgang.letzter_ms_timer "letzter Timerwert" UWORD UMR___1_1_0_S5_S3 1 100 0 65535 ECU_ADDRESS 0xFFF8C10C DISPLAY_IDENTIFIER letzter_ms_timer.sp_ngdsynzielgang.iSchaltend.iSasZentr /end MEASUREMENT
/begin MEASUREMENT iSasZentr.iSchaltend.sp_ngdsynzielgang.n_f "letzter Wert" SLONG UMR___1_1_0_S5_S3 1 100 -2147483648 2147483647 ECU_ADDRESS 0xFFF8C108 DISPLAY_IDENTIFIER n_f.sp_ngdsynzielgang.iSchaltend.iSasZentr /end MEASUREMENT
/begin MEASUREMENT iSasZentr.iSchaltend.synchron "FLAG: Synchronpunkt erreicht" UBYTE Conv.cSasSaKor._.synchron_S5_S3 1 100 0 1 BIT_MASK 0x1 ECU_ADDRESS 0xFFF8BFD0 DISPLAY_IDENTIFIER synchron.iSchaltend.iSasZentr /end MEASUREMENT
/begin MEASUREMENT iSasZentr.iSchaltend.synchron_verboten "FLAG: Synchron verboten" UBYTE Conv.cSasSaKor._.synchron_verboten_S5_S3 1 100 0 1 BIT_MASK 0x1 ECU_ADDRESS 0xFFF8BFD8 DISPLAY_IDENTIFIER synchron_verboten.iSchaltend.iSasZentr /end MEASUREMENT
/begin MEASUREMENT iSasZentr.iSchaltend.t_maxsas "maximale Schaltzeit" UWORD UMR_MSEC__10_1_0_S5_S3 1 100 0 50000 ECU_ADDRESS 0xFFF8BFF8 DISPLAY_IDENTIFIER t_maxsas.iSchaltend.iSasZentr /end MEASUREMENT
/begin MEASUREMENT iSasZentr.iSchaltend.t_syn "vorausberechnete Zeit bis Erreichen Synchron zielgang" SWORD UMR_MSEC__10_1_0_S5_S3 1 100 -327680 327670 ECU_ADDRESS 0xFFF8BFDC DISPLAY_IDENTIFIER t_syn.iSchaltend.iSasZentr /end MEASUREMENT
/begin MEASUREMENT iSasZentr.iSchaltend.t_timeout "Zeit von Schaltbeginn bis Start Timeoutfunktion" UWORD UMR_MSEC__10_1_0_S5_S3 1 100 0 50000 ECU_ADDRESS 0xFFF8BFFC DISPLAY_IDENTIFIER t_timeout.iSchaltend.iSasZentr /end MEASUREMENT
/begin MEASUREMENT iSasZentr.iSchaltend.timeout "Flag: Schaltung timeout" UBYTE Conv.cSasSaKor._.timeout_S5_S3 1 100 0 1 BIT_MASK 0x1 ECU_ADDRESS 0xFFF8BFD4 DISPLAY_IDENTIFIER timeout.iSchaltend.iSasZentr /end MEASUREMENT
/begin MEASUREMENT iSasZentr.iSchaltend.timer16_sas "Timer Schaltungsdauer, wird bei Vorhalt schon gestartet" UWORD UMR_MSEC__10_1_0_S5_S3 1 100 0 320000 ECU_ADDRESS 0xFFF8BFF6 DISPLAY_IDENTIFIER timer16_sas.iSchaltend.iSasZentr /end MEASUREMENT
/begin MEASUREMENT iSasZentr.iSchaltend.z_kurze_schaltung "Zustandsgroesse kurze Schaltung" UBYTE Conv.cSasSaKor._.z_kurze_schaltung_S5_S3 1 100 0 7 ECU_ADDRESS 0xFFF8BFD9 DISPLAY_IDENTIFIER z_kurze_schaltung.iSchaltend.iSasZentr /end MEASUREMENT
/begin MEASUREMENT iSasZentr.iSchaltend.zielgang_sas "Zielgang SAS" SBYTE Conv.cSasSaKor._.zielgang_sas_S5_S3 1 100 -1 8 ECU_ADDRESS 0xFFF8BFD1 DISPLAY_IDENTIFIER zielgang_sas.iSchaltend.iSasZentr /end MEASUREMENT
/begin MEASUREMENT iSasZentr.iSchaltend.zwangssynchron "FLAG: Zwangssynchron wird angefordert" UBYTE Conv.cSasSaKor._.zwangssynchron_S5_S3 1 100 0 1 BIT_MASK 0x1 ECU_ADDRESS 0xFFF8BFD7 DISPLAY_IDENTIFIER zwangssynchron.iSchaltend.iSasZentr /end MEASUREMENT
/begin MEASUREMENT iSasZentr.iVorbereitend.aktuelle_schaltung "FLAG: Aktive Schaltung" UBYTE Conv.cSasSaKor._.aktuelle_schaltung_S5_S3 1 100 0 1 ECU_ADDRESS 0xFFF8C113 DISPLAY_IDENTIFIER aktuelle_schaltung.iVorbereitend.iSasZentr /end MEASUREMENT
/begin MEASUREMENT iSasZentr.iVorbereitend.erste_schaltung "Flag: 1. Befuellung einer Kupplung" UBYTE Conv.cSasSaKor._.erste_schaltung_S5_S3 1 100 0 1 BIT_MASK 0x1 ECU_ADDRESS 0xFFF8C130 DISPLAY_IDENTIFIER erste_schaltung.iVorbereitend.iSasZentr /end MEASUREMENT
/begin MEASUREMENT iSasZentr.iVorbereitend.f_verb_ada_erste_bef "Flag: 1. Befuellung einer Kupplung verbietet Adaption" UBYTE Conv.cSasSaKor._.f_verb_ada_erste_bef_S5_S3 1 100 0 1 BIT_MASK 0x1 ECU_ADDRESS 0xFFF8C131 DISPLAY_IDENTIFIER f_verb_ada_erste_bef.iVorbereitend.iSasZentr /end MEASUREMENT
/begin MEASUREMENT iSasZentr.iVorbereitend.fkt_halten_in_sync_verboten "FLAG: Ausfuehren der Fkt. Halten in Synchron verboten" UBYTE Conv.cSasSaKor._.fkt_halten_in_sync_verboten_S5_S3 1 100 0 1 BIT_MASK 0x1 ECU_ADDRESS 0xFFF8C134 DISPLAY_IDENTIFIER fkt_halten_in_sync_verboten.iVorbereitend.iSasZentr /end MEASUREMENT
/begin MEASUREMENT iSasZentr.iVorbereitend.iKab.ende_kab_gestartet "Flag: Zustand Ende der abschaltenden Kupplung gestartet" UBYTE Conv.cSasAnKab._.ende_kab_gestartet_S5_S3 1 100 0 1 BIT_MASK 0x1 ECU_ADDRESS 0xFFF8C140 DISPLAY_IDENTIFIER ende_kab_gestartet.iKab.iVorbereitend.iSasZentr /end MEASUREMENT
/begin MEASUREMENT iSasZentr.iVorbereitend.iKab.f_best_poffkab_in_syn_erfolgt "Flag: Neubestimmung p_offkab in Synchron erfolgt" UBYTE Conv.cSasAnKab._.f_best_poffkab_in_syn_erfolgt_S5_S3 1 100 0 1 BIT_MASK 0x1 ECU_ADDRESS 0xFFF8C158 DISPLAY_IDENTIFIER f_best_poffkab_in_syn_erfolgt.iKab.iVorbereitend.iSasZentr /end MEASUREMENT
/begin MEASUREMENT iSasZentr.iVorbereitend.iKab.f_ende_verz_kab_erlaubt "Flag: Bedingung fuer Ende Verzoegerung KAB erfuellt" UBYTE Conv.cSasAnKab._.f_ende_verz_kab_erlaubt_S5_S3 1 100 0 1 BIT_MASK 0x1 ECU_ADDRESS 0xFFF8C157 DISPLAY_IDENTIFIER f_ende_verz_kab_erlaubt.iKab.iVorbereitend.iSasZentr /end MEASUREMENT
/begin MEASUREMENT iSasZentr.iVorbereitend.iKab.f_rueckf_pozustartk0_aktiv "Hilfsflag für die Auswertung der Rueckfilterung des Offsets KL_POZUSTARTK0" UBYTE Conv.cSasAnKab._.f_rueckf_pozustartk0_aktiv_S5_S3 1 100 0 1 BIT_MASK 0x1 ECU_ADDRESS 0xFFF8C179 DISPLAY_IDENTIFIER f_rueckf_pozustartk0_aktiv.iKab.iVorbereitend.iSasZentr /end MEASUREMENT
/begin MEASUREMENT iSasZentr.iVorbereitend.iKab.f_warten_auf_sf_k0_aktiv "FLAG: Warten auf Ende der Schnellfuellung K0 aktiv" UBYTE Conv.cSasAnKab._.f_warten_auf_sf_k0_aktiv_S5_S3 1 100 0 1 BIT_MASK 0x1 ECU_ADDRESS 0xFFF8C178 DISPLAY_IDENTIFIER f_warten_auf_sf_k0_aktiv.iKab.iVorbereitend.iSasZentr /end MEASUREMENT
/begin MEASUREMENT iSasZentr.iVorbereitend.iKab.gls_hs_kab_gestartet "Flag: GLS der KAB kann starten" UBYTE Conv.cSasAnKab._.gls_hs_kab_gestartet_S5_S3 1 100 0 1 BIT_MASK 0x1 ECU_ADDRESS 0xFFF8C142 DISPLAY_IDENTIFIER gls_hs_kab_gestartet.iKab.iVorbereitend.iSasZentr /end MEASUREMENT
/begin MEASUREMENT iSasZentr.iVorbereitend.iKab.halten_in_syn_kab_gestartet "Flag: Ablauf Halten in Synchron fuer die KAB gestartet" UBYTE Conv.cSasAnKab._.halten_in_syn_kab_gestartet_S5_S3 1 100 0 1 BIT_MASK 0x1 ECU_ADDRESS 0xFFF8C150 DISPLAY_IDENTIFIER halten_in_syn_kab_gestartet.iKab.iVorbereitend.iSasZentr /end MEASUREMENT
/begin MEASUREMENT iSasZentr.iVorbereitend.iKab.kab_nicht_befuellt "Flag: Kupplung KAB nicht befuellt" UBYTE Conv.cSasAnKab._.kab_nicht_befuellt_S5_S3 1 100 0 1 BIT_MASK 0x1 ECU_ADDRESS 0xFFF8C156 DISPLAY_IDENTIFIER kab_nicht_befuellt.iKab.iVorbereitend.iSasZentr /end MEASUREMENT
/begin MEASUREMENT iSasZentr.iVorbereitend.iKab.kup_kab "Kupplungsnummer Abschaltende Kupplung" UBYTE Conv.cSasAnKab._.kup_kab_S5_S3 1 100 0 5 ECU_ADDRESS 0xFFF8C14C DISPLAY_IDENTIFIER kup_kab.iKab.iVorbereitend.iSasZentr /end MEASUREMENT
/begin MEASUREMENT iSasZentr.iVorbereitend.iKab.m_motsoll0_sas "Motorsollmoment bei Start Rampe auf Schaltdruck" SWORD UMR_NM__1_1_0_S5_S3 1 100 -1500 1500 ECU_ADDRESS 0xFFF8C176 DISPLAY_IDENTIFIER m_motsoll0_sas.iKab.iVorbereitend.iSasZentr /end MEASUREMENT
/begin MEASUREMENT iSasZentr.iVorbereitend.iKab.md_motsoll_sas "Motorsollmomentanstieg fuer KF-Zugriff abschalt. Kupplung" SWORD UMR_NM__1_1_0_S5_S3 1 100 -1500 1500 ECU_ADDRESS 0xFFF8C174 DISPLAY_IDENTIFIER md_motsoll_sas.iKab.iVorbereitend.iSasZentr /end MEASUREMENT
/begin MEASUREMENT iSasZentr.iVorbereitend.iKab.p_0stkab "Zustandsanfangsdruck gesteuerter Anteil der absch. Kupplung" SWORD UMR_BAR__1_1000_0_S5_S3 1 100 -32 32 ECU_ADDRESS 0xFFF8C15C DISPLAY_IDENTIFIER p_0stkab.iKab.iVorbereitend.iSasZentr /end MEASUREMENT
/begin MEASUREMENT iSasZentr.iVorbereitend.iKab.p_adaptkab "Adaptionsdruck abschaltende Kupplung" SWORD UMR_BAR__1_1000_0_S5_S3 1 100 0 20 ECU_ADDRESS 0xFFF8C144 DISPLAY_IDENTIFIER p_adaptkab.iKab.iVorbereitend.iSasZentr /end MEASUREMENT
/begin MEASUREMENT iSasZentr.iVorbereitend.iKab.p_kab "Druck KAB (inklusive GLS-Druck)" SWORD UMR_BAR__1_1000_0_S5_S3 1 100 0 20 ECU_ADDRESS 0xFFF8C152 DISPLAY_IDENTIFIER p_kab.iKab.iVorbereitend.iSasZentr /end MEASUREMENT
/begin MEASUREMENT iSasZentr.iVorbereitend.iKab.p_kfkab "Kennfelddruck gesteuerter Anteil der absch. Kupplung" SWORD UMR_BAR__1_1000_0_S5_S3 1 100 0 32 ECU_ADDRESS 0xFFF8C172 DISPLAY_IDENTIFIER p_kfkab.iKab.iVorbereitend.iSasZentr /end MEASUREMENT
/begin MEASUREMENT iSasZentr.iVorbereitend.iKab.p_offkab "Offsetdruck der abschaltenden Kupplung" SWORD UMR_BAR__1_1000_0_S5_S3 1 100 -32 32 ECU_ADDRESS 0xFFF8C15E DISPLAY_IDENTIFIER p_offkab.iKab.iVorbereitend.iSasZentr /end MEASUREMENT
/begin MEASUREMENT iSasZentr.iVorbereitend.iKab.p_stkab "Gesteuerter Druckanteil KAB" SWORD UMR_BAR__1_1000_0_S5_S3 1 100 0 20 ECU_ADDRESS 0xFFF8C146 DISPLAY_IDENTIFIER p_stkab.iKab.iVorbereitend.iSasZentr /end MEASUREMENT
/begin MEASUREMENT iSasZentr.iVorbereitend.iKab.pgo_kab_speicher.cBibRampeGradSi16._.letzter_ms_timer "Speichert den letzten BS-Timer" UWORD UMR_MSEC__1_1_0_S5_S3 1 100 0 65535 ECU_ADDRESS 0xFFF8C1A0 DISPLAY_IDENTIFIER letzter_ms_timer._.cBibRampeGradSi16.pgo_kab_speicher.iKab.iVorbereitend.iSasZentr /end MEASUREMENT
/begin MEASUREMENT iSasZentr.iVorbereitend.iKab.pgo_kab_speicher.cBibRampeGradSi16._.letzter_wert "Speichert den letzten Eingangswert" FLOAT32_IEEE UMR___1_1_0_S5_S3 1 100 -1e+037 1e+037 ECU_ADDRESS 0xFFF8C19C FORMAT "%3.2" DISPLAY_IDENTIFIER letzter_wert._.cBibRampeGradSi16.pgo_kab_speicher.iKab.iVorbereitend.iSasZentr /end MEASUREMENT
/begin MEASUREMENT iSasZentr.iVorbereitend.iKab.pgo_kab_speicher.cBibRampeGradSi16._.maximum "Maximum Begrenzung" FLOAT32_IEEE UMR___1_1_0_S5_S3 1 100 -1e+037 1e+037 ECU_ADDRESS 0xFFF8C1A8 FORMAT "%3.2" DISPLAY_IDENTIFIER maximum._.cBibRampeGradSi16.pgo_kab_speicher.iKab.iVorbereitend.iSasZentr /end MEASUREMENT
/begin MEASUREMENT iSasZentr.iVorbereitend.iKab.pgo_kab_speicher.cBibRampeGradSi16._.minimum "Minimum Begrenzung" FLOAT32_IEEE UMR___1_1_0_S5_S3 1 100 -1e+037 1e+037 ECU_ADDRESS 0xFFF8C1A4 FORMAT "%3.2" DISPLAY_IDENTIFIER minimum._.cBibRampeGradSi16.pgo_kab_speicher.iKab.iVorbereitend.iSasZentr /end MEASUREMENT
/begin MEASUREMENT iSasZentr.iVorbereitend.iKab.pkf_rs_kab_ausgegeben "Flag: Druck aus Kennfeld wird ausgegeben" UBYTE Conv.cSasAnKab._.pkf_rs_kab_ausgegeben_S5_S3 1 100 0 1 BIT_MASK 0x1 ECU_ADDRESS 0xFFF8C155 DISPLAY_IDENTIFIER pkf_rs_kab_ausgegeben.iKab.iVorbereitend.iSasZentr /end MEASUREMENT
/begin MEASUREMENT iSasZentr.iVorbereitend.iKab.pkf_rs_kab_gestartet "Flag: Kennfeldzugriff KAB (bei ZR) gestartet bzw. Rampe hat Kennfelddruck erreicht" UBYTE Conv.cSasAnKab._.pkf_rs_kab_gestartet_S5_S3 1 100 0 1 BIT_MASK 0x1 ECU_ADDRESS 0xFFF8C141 DISPLAY_IDENTIFIER pkf_rs_kab_gestartet.iKab.iVorbereitend.iSasZentr /end MEASUREMENT
/begin MEASUREMENT iSasZentr.iVorbereitend.iKab.po_0zustartk0 "Anfangsdruck fuer Rueckfilterung des Offsetdrucks nach Zustart K0" SWORD UMR_BAR__1_1000_0_S5_S3 1 100 0 6.4 ECU_ADDRESS 0xFFF8C17C DISPLAY_IDENTIFIER po_0zustartk0.iKab.iVorbereitend.iSasZentr /end MEASUREMENT
/begin MEASUREMENT iSasZentr.iVorbereitend.iKab.po_mtkab "Momentenabhaengiger Druckoffset der KAB" SWORD UMR_BAR__1_1000_0_S5_S3 1 100 -32 32 ECU_ADDRESS 0xFFF8C160 DISPLAY_IDENTIFIER po_mtkab.iKab.iVorbereitend.iSasZentr /end MEASUREMENT
/begin MEASUREMENT iSasZentr.iVorbereitend.iKab.po_zustartk0 "Offsetdruck der abschaltenden Kupplung waehrend Zustart K0" SWORD UMR_BAR__1_1000_0_S5_S3 1 100 0 6.4 ECU_ADDRESS 0xFFF8C17E DISPLAY_IDENTIFIER po_zustartk0.iKab.iVorbereitend.iSasZentr /end MEASUREMENT
/begin MEASUREMENT iSasZentr.iVorbereitend.iKab.ps_hs_kab_gestartet "Flag: Schaltdruckphase KAB gestartet" UBYTE Conv.cSasAnKab._.ps_hs_kab_gestartet_S5_S3 1 100 0 1 BIT_MASK 0x1 ECU_ADDRESS 0xFFF8C148 DISPLAY_IDENTIFIER ps_hs_kab_gestartet.iKab.iVorbereitend.iSasZentr /end MEASUREMENT
/begin MEASUREMENT iSasZentr.iVorbereitend.iKab.ra1_kab_gestartet "Flag: Rampe 1 KAB gestartet" UBYTE Conv.cSasAnKab._.ra1_kab_gestartet_S5_S3 1 100 0 1 BIT_MASK 0x1 ECU_ADDRESS 0xFFF8C149 DISPLAY_IDENTIFIER ra1_kab_gestartet.iKab.iVorbereitend.iSasZentr /end MEASUREMENT
/begin MEASUREMENT iSasZentr.iVorbereitend.iKab.ra_sd_hs_kab_gestartet "Flag: Rampe auf Schaltdruck KAB bei HS ist gestartet" UBYTE Conv.cSasAnKab._.ra_sd_hs_kab_gestartet_S5_S3 1 100 0 1 BIT_MASK 0x1 ECU_ADDRESS 0xFFF8C14E DISPLAY_IDENTIFIER ra_sd_hs_kab_gestartet.iKab.iVorbereitend.iSasZentr /end MEASUREMENT
/begin MEASUREMENT iSasZentr.iVorbereitend.iKab.ra_sd_rs_kab_gestartet "Flag: Rampe auf Schaltdruck KAB bei RS ist gestartet" UBYTE Conv.cSasAnKab._.ra_sd_rs_kab_gestartet_S5_S3 1 100 0 1 BIT_MASK 0x1 ECU_ADDRESS 0xFFF8C14F DISPLAY_IDENTIFIER ra_sd_rs_kab_gestartet.iKab.iVorbereitend.iSasZentr /end MEASUREMENT
/begin MEASUREMENT iSasZentr.iVorbereitend.iKab.raph_kab_speicher.letzter_timer "Speichert den letzten BS-Timer" UBYTE UMR_SEC__1_1_0_S5_S3 1 100 0 255 ECU_ADDRESS 0xFFF8C1B4 DISPLAY_IDENTIFIER letzter_timer.raph_kab_speicher.iKab.iVorbereitend.iSasZentr /end MEASUREMENT
/begin MEASUREMENT iSasZentr.iVorbereitend.iKab.raph_kab_speicher.letzter_wert "Speichert den letzten Eingangswert" SLONG UMR___1_1_0_S5_S3 1 100 -2147483648 2147483647 ECU_ADDRESS 0xFFF8C1B0 DISPLAY_IDENTIFIER letzter_wert.raph_kab_speicher.iKab.iVorbereitend.iSasZentr /end MEASUREMENT
/begin MEASUREMENT iSasZentr.iVorbereitend.iKab.raps_kab_speicher.letzter_timer "Speichert den letzten BS-Timer" UBYTE UMR_SEC__1_1_0_S5_S3 1 100 0 255 ECU_ADDRESS 0xFFF8C1BC DISPLAY_IDENTIFIER letzter_timer.raps_kab_speicher.iKab.iVorbereitend.iSasZentr /end MEASUREMENT
/begin MEASUREMENT iSasZentr.iVorbereitend.iKab.raps_kab_speicher.letzter_wert "Speichert den letzten Eingangswert" SLONG UMR___1_1_0_S5_S3 1 100 -2147483648 2147483647 ECU_ADDRESS 0xFFF8C1B8 DISPLAY_IDENTIFIER letzter_wert.raps_kab_speicher.iKab.iVorbereitend.iSasZentr /end MEASUREMENT
/begin MEASUREMENT iSasZentr.iVorbereitend.iKab.schalttyp_kab "Schalttyp der absch. Kupplung" UBYTE Conv.cSasAnKab._.schalttyp_kab_S5_S3 1 100 0 4 ECU_ADDRESS 0xFFF8C15A DISPLAY_IDENTIFIER schalttyp_kab.iKab.iVorbereitend.iSasZentr /end MEASUREMENT
/begin MEASUREMENT iSasZentr.iVorbereitend.iKab.statisch_kab "Flag: Anzeige ob KAB eine Druckvorgabe ausgibt oder Minimal/Maximaldruck angesteuert wird" UBYTE Conv.cSasAnKab._.statisch_kab_S5_S3 1 100 0 1 BIT_MASK 0x1 ECU_ADDRESS 0xFFF8C14A DISPLAY_IDENTIFIER statisch_kab.iKab.iVorbereitend.iSasZentr /end MEASUREMENT
/begin MEASUREMENT iSasZentr.iVorbereitend.iKab.t_0kab "Zeitdauer des zuletzt durchlaufenen Zustands der absch. Kupplung" SWORD UMR_MSEC__10_1_0_S5_S3 1 100 -327680 327670 ECU_ADDRESS 0xFFF8C164 DISPLAY_IDENTIFIER t_0kab.iKab.iVorbereitend.iSasZentr /end MEASUREMENT
/begin MEASUREMENT iSasZentr.iVorbereitend.iKab.t_ph_rs "Berechnete Zeitdauer Haltedruckphase der absch. Kupplung während RS" SLONG UMR_MSEC__10_1_0_S5_S3 1 100 -327680 327670 ECU_ADDRESS 0xFFF8C168 DISPLAY_IDENTIFIER t_ph_rs.iKab.iVorbereitend.iSasZentr /end MEASUREMENT
/begin MEASUREMENT iSasZentr.iVorbereitend.iKab.t_ra_kab_vor_ra1_kzu "Anteil Dauer der KAB-Rampe auf Schaltdruck vor Start der KZU-Rampe auf Schaltdruck" SWORD UMR_MSEC__10_1_0_S5_S3 1 100 -327680 327670 ECU_ADDRESS 0xFFF8C16E DISPLAY_IDENTIFIER t_ra_kab_vor_ra1_kzu.iKab.iVorbereitend.iSasZentr /end MEASUREMENT
/begin MEASUREMENT iSasZentr.iVorbereitend.iKab.t_verz_ph_rs "Berechnete Zeitdauer Verzögerung der Haltedruckphase der absch. Kupplung während RS" SWORD UMR_MSEC__10_1_0_S5_S3 1 100 -327680 327670 ECU_ADDRESS 0xFFF8C16C DISPLAY_IDENTIFIER t_verz_ph_rs.iKab.iVorbereitend.iSasZentr /end MEASUREMENT
/begin MEASUREMENT iSasZentr.iVorbereitend.iKab.t_zkab "Zustandszeitdauer der absch. Kupplung" SWORD UMR_MSEC__10_1_0_S5_S3 1 100 -327680 327670 ECU_ADDRESS 0xFFF8C162 DISPLAY_IDENTIFIER t_zkab.iKab.iVorbereitend.iSasZentr /end MEASUREMENT
/begin MEASUREMENT iSasZentr.iVorbereitend.iKab.timer_hinsyn "Zeit seit Start Rampe auf Halten in Synchron" UBYTE UMR_MSEC__10_1_0_S5_S3 1 100 0 2550 ECU_ADDRESS 0xFFF8C170 DISPLAY_IDENTIFIER timer_hinsyn.iKab.iVorbereitend.iSasZentr /end MEASUREMENT
/begin MEASUREMENT iSasZentr.iVorbereitend.iKab.timer_pozustartk0 "Timer fuer Rueckfilterung des Offset nach Befuellung der K0" UBYTE UMR_MSEC__10_1_0_S5_S3 1 100 0 2550 ECU_ADDRESS 0xFFF8C17A DISPLAY_IDENTIFIER timer_pozustartk0.iKab.iVorbereitend.iSasZentr /end MEASUREMENT
/begin MEASUREMENT iSasZentr.iVorbereitend.iKab.timer_zkab "Zustandstimer abschaltende Kupplung" UBYTE UMR_MSEC__10_1_0_S5_S3 1 100 0 2550 ECU_ADDRESS 0xFFF8C154 DISPLAY_IDENTIFIER timer_zkab.iKab.iVorbereitend.iSasZentr /end MEASUREMENT
/begin MEASUREMENT iSasZentr.iVorbereitend.iKab.ueb_rs_kab_gestartet "Flag: Ueberschneidungsphase abschaltende Kupplung (bei ZR-Schaltung) gestartet" UBYTE Conv.cSasAnKab._.ueb_rs_kab_gestartet_S5_S3 1 100 0 1 BIT_MASK 0x1 ECU_ADDRESS 0xFFF8C14B DISPLAY_IDENTIFIER ueb_rs_kab_gestartet.iKab.iVorbereitend.iSasZentr /end MEASUREMENT
/begin MEASUREMENT iSasZentr.iVorbereitend.iKab.z_kab "Zustand abschaltende Kupplung" UBYTE Conv.cSasAnKab._.z_kab_S5_S3 1 100 0 16 ECU_ADDRESS 0xFFF8C14D DISPLAY_IDENTIFIER z_kab.iKab.iVorbereitend.iSasZentr /end MEASUREMENT
/begin RECORD_LAYOUT ZF_TAB2D_OI_INT32_S3_S3 FNC_VALUES 1 SLONG ROW_DIR DIRECT /end RECORD_LAYOUT
/begin RECORD_LAYOUT ZF_TAB2D_OI_INT32_S4_S3 FNC_VALUES 1 SLONG ROW_DIR DIRECT /end RECORD_LAYOUT
/begin RECORD_LAYOUT ZF_TAB2D_OI_INT8_S2_S3 FNC_VALUES 1 SBYTE ROW_DIR DIRECT /end RECORD_LAYOUT
/begin RECORD_LAYOUT ZF_TAB2D_OI_INT8_S3_S3 FNC_VALUES 1 SBYTE ROW_DIR DIRECT /end RECORD_LAYOUT
/begin RECORD_LAYOUT ZF_TAB2D_OI_INT8_S4_S3 FNC_VALUES 1 SBYTE ROW_DIR DIRECT /end RECORD_LAYOUT
/begin RECORD_LAYOUT ZF_TAB2D_OI_NAT16_S2_S3 FNC_VALUES 1 UWORD ROW_DIR DIRECT /end RECORD_LAYOUT
/begin RECORD_LAYOUT ZF_TAB2D_OI_NAT16_S3_S3 FNC_VALUES 1 UWORD ROW_DIR DIRECT /end RECORD_LAYOUT
/begin RECORD_LAYOUT ZF_TAB2D_OI_NAT32_S2_S3 FNC_VALUES 1 ULONG ROW_DIR DIRECT /end RECORD_LAYOUT
/begin RECORD_LAYOUT ZF_TAB2D_OI_NAT32_S3_S3 FNC_VALUES 1 ULONG ROW_DIR DIRECT /end RECORD_LAYOUT
/begin RECORD_LAYOUT ZF_TAB2D_OI_NAT32_S4_S3 FNC_VALUES 1 ULONG ROW_DIR DIRECT /end RECORD_LAYOUT
/begin RECORD_LAYOUT ZF_TAB2D_OI_NAT8_S2_S3 FNC_VALUES 1 UBYTE ROW_DIR DIRECT /end RECORD_LAYOUT
/begin RECORD_LAYOUT ZF_TAB2D_OI_NAT8_S3_S3 FNC_VALUES 1 UBYTE ROW_DIR DIRECT /end RECORD_LAYOUT
/begin RECORD_LAYOUT ZF_tab2d_si8_S5_S3 FNC_VALUES 3 SBYTE ROW_DIR DIRECT NO_AXIS_PTS_X 1 ULONG NO_AXIS_PTS_Y 2 ULONG /end RECORD_LAYOUT
/begin RECORD_LAYOUT ZF_tab2d_tGang_S5_S3 FNC_VALUES 3 SBYTE ROW_DIR DIRECT NO_AXIS_PTS_X 1 ULONG NO_AXIS_PTS_Y 2 ULONG /end RECORD_LAYOUT
/begin RECORD_LAYOUT ZF_TAB_INT16_S1_S3 FNC_VALUES 2 SWORD COLUMN_DIR DIRECT NO_AXIS_PTS_X 1 ULONG /end RECORD_LAYOUT
/begin RECORD_LAYOUT ZF_TAB_INT16_S2_S3 FNC_VALUES 2 SWORD COLUMN_DIR DIRECT NO_AXIS_PTS_X 1 ULONG /end RECORD_LAYOUT
/begin RECORD_LAYOUT ZF_TAB_INT16_S3_S3 FNC_VALUES 2 SWORD COLUMN_DIR DIRECT NO_AXIS_PTS_X 1 ULONG /end RECORD_LAYOUT
/begin RECORD_LAYOUT ZF_TAB_INT16_S4_S3 FNC_VALUES 2 SWORD COLUMN_DIR DIRECT NO_AXIS_PTS_X 1 ULONG /end RECORD_LAYOUT
/begin RECORD_LAYOUT ZF_TAB_INT32_S1_S3 FNC_VALUES 2 SLONG COLUMN_DIR DIRECT NO_AXIS_PTS_X 1 ULONG /end RECORD_LAYOUT
/begin RECORD_LAYOUT ZF_TAB_INT32_S2_S3 FNC_VALUES 2 SLONG COLUMN_DIR DIRECT NO_AXIS_PTS_X 1 ULONG /end RECORD_LAYOUT
/begin RECORD_LAYOUT ZF_TAB_INT32_S3_S3 FNC_VALUES 2 SLONG COLUMN_DIR DIRECT NO_AXIS_PTS_X 1 ULONG /end RECORD_LAYOUT
/begin RECORD_LAYOUT ZF_TAB_INT32_S4_S3 FNC_VALUES 2 SLONG COLUMN_DIR DIRECT NO_AXIS_PTS_X 1 ULONG /end RECORD_LAYOUT
/end MODULE
/end PROJECT
