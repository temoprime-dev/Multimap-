ASAP2_VERSION 1 51
/begin PROJECT ZHBC8600 "Gen2_BMW_System_Supplier_Lib"
/begin MODULE CPP ""
/begin MOD_COMMON "" BYTE_ORDER MSB_FIRST ALIGNMENT_BYTE 1 ALIGNMENT_WORD 2 ALIGNMENT_LONG 4 ALIGNMENT_FLOAT32_IEEE 4 ALIGNMENT_FLOAT64_IEEE 1 /end MOD_COMMON
/begin COMPU_VTAB Conv.cAzsKorgl._.f_notgang_gesetzt_S5_S3 "Umrechnung fuer Messgroesse cAzsKorgl::f_notgang_gesetzt" TAB_VERB 2 0 "FALSE" 1 "TRUE" DEFAULT_VALUE "" /end COMPU_VTAB
/begin COMPU_VTAB Conv.cAzsKorgl._.f_schaltung_direkt_S5_S3 "Umrechnung fuer Messgroesse cAzsKorgl::f_schaltung_direkt" TAB_VERB 2 0 "FALSE" 1 "TRUE" DEFAULT_VALUE "" /end COMPU_VTAB
/begin COMPU_VTAB Conv.cAzsKorgl._.f_stromlos_zzs_S5_S3 "Umrechnung fuer Messgroesse cAzsKorgl::f_stromlos_zzs" TAB_VERB 2 0 "FALSE" 1 "TRUE" DEFAULT_VALUE "" /end COMPU_VTAB
/begin COMPU_VTAB Conv.cAzsKorgl._.parksperre_ziel_S5_S3 "Umrechnung fuer Messgroesse cAzsKorgl::parksperre_ziel" TAB_VERB 2 0 "FALSE" 1 "Parksperre einlegen" DEFAULT_VALUE "" /end COMPU_VTAB
/begin COMPU_VTAB Conv.cAzsKorgl._.pos_red_S5_S3 "Umrechnung fuer Messgroesse cAzsKorgl::pos_red" TAB_VERB 4 0 "Position Neutral" 1 "Position Drive" 2 "Position Rueckwaerts" 255 "Undefiniert" DEFAULT_VALUE "" /end COMPU_VTAB
/begin COMPU_VTAB Conv.cAzsKupMassnahmenKoord._.beeinfl_spont_index_S5_S3 "Umrechnung fuer Messgroesse cAzsKupMassnahmenKoord::beeinfl_spont_index" TAB_VERB 4 0 "undefinierte Beeinflussung des Spontanitätsindex" 1 "keine Beeinflussung des Spontanitätsindex" 2 "keine Beeinflussung des Spontanitätsindex und Fehlercode zurück nehmen." 3 "Beeinflussung des Spontanitätsindex" DEFAULT_VALUE "" /end COMPU_VTAB
/begin COMPU_VTAB Conv.cAzsKupMassnahmenKoord._.reduzierung_m_mot_max_S5_S3 "Umrechnung fuer Messgroesse cAzsKupMassnahmenKoord::reduzierung_m_mot_max" TAB_VERB 4 0 "undefiniert Reduzierung des max. Motormoment" 1 "keine Reduzierung des max. Motormoment" 2 "keine Reduzierung des max. Motormoment und Fehlercode zurück nehmen." 3 "Reduzierung des max. Motormoment" DEFAULT_VALUE "" /end COMPU_VTAB
/begin COMPU_VTAB Conv.cAzsKupMassnahmenKoord._.versch_schalt_verh_S5_S3 "Umrechnung fuer Messgroesse cAzsKupMassnahmenKoord::versch_schalt_verh" TAB_VERB 2 0 "die Schaltung wurde nicht verhindert" 1 "die Schaltung wurde verhindert" DEFAULT_VALUE "" /end COMPU_VTAB
/begin COMPU_VTAB Conv.cAzsKupMassnahmenKoord._.zustand_schaltungsverh_S5_S3 "Umrechnung fuer Messgroesse cAzsKupMassnahmenKoord::zustand_schaltungsverh" TAB_VERB 3 0 "undefinierte" 1 "keine Schaltungsverhinderung" 2 "Schaltungsverhinderung" DEFAULT_VALUE "" /end COMPU_VTAB
/begin COMPU_VTAB Conv.cAzsNeutralEbene._.fkt_neutral_ebene_S5_S3 "Umrechnung fuer Messgroesse cAzsNeutralEbene::fkt_neutral_ebene" TAB_VERB 12 0 "FKT_NE_PASSIV" 1 "FKT_NE_STROMLOS" 2 "FKT_NE_RESET" 4 "FKT_NE_NEUSTART" 8 "FKT_NE_KLAUEN_SENSORIK" 16 "FKT_NE_STATISCH_UEBERWACHUNG" 32 "FKT_NE_MSA" 64 "FKT_NE_STILLSTANDSADA" 128 "FKT_NE_SCHALT_ABBRUCH_GA" 256 "FKT_NE_STADA" 512 "FKT_NE_UEBERDREHZAHL_GA" 1024 "FKT_NE_MINIMALDRUCK" DEFAULT_VALUE "" /end COMPU_VTAB
/begin COMPU_VTAB Conv.cAzsNeutralEbene._.pos_neutral_n_stern_S5_S3 "Umrechnung fuer Messgroesse cAzsNeutralEbene::pos_neutral_n_stern" TAB_VERB 5 0 "POS_NE_KEINE_ANSTEUERUNG" 1 "POS_NE_KLAUE_GESCHLOSSEN" 2 "POS_NE_ALLE_ELEMENTE_GEOEFFNET" 3 "POS_NE_KLAUE_F_GESCHLOSSEN" 4 "POS_NE_KUP_B_PF" DEFAULT_VALUE "" /end COMPU_VTAB
/begin COMPU_VTAB Conv.cAzsNeutralEbene._.z_neutral_ebene_S5_S3 "Umrechnung fuer Messgroesse cAzsNeutralEbene::z_neutral_ebene" TAB_VERB 7 0 "NE_PASSIV" 1 "NE_ELEMENTE_OFFEN_EINSTIEG" 2 "NE_ELEMENTE_OFFEN_AKTIV" 3 "NE_ELEMENTE_OFFEN_AUSSTIEG" 4 "NE_MINDRUCK_EINSTIEG" 5 "NE_MINDRUCK_AKTIV" 6 "NE_MINDRUCK_AUSSTIEG" DEFAULT_VALUE "" /end COMPU_VTAB
/begin COMPU_VTAB Conv.cAzsSchluesselStart._.s_start_status_S5_S3 "Umrechnung fuer Messgroesse cAzsSchluesselStart::s_start_status" TAB_VERB 5 0 "Motor AUS" 1 "Schluessel-Start erkannt" 2 "GE und Schaltung verzoegern" 3 "nur GE verzoegern" 4 "Normalbetrieb" DEFAULT_VALUE "" /end COMPU_VTAB
/begin COMPU_VTAB Conv.cAzsSollgangMoeglich._.sollgang_moeglich_S5_S3 "Umrechnung fuer Messgroesse cAzsSollgangMoeglich::sollgang_moeglich" TAB_VERB 10 -1 "GR1" 0 "KEIN_GANG" 1 "G1" 2 "G2" 3 "G3" 4 "G4" 5 "G5" 6 "G6" 7 "G7" 8 "G8" DEFAULT_VALUE "" /end COMPU_VTAB
/begin COMPU_VTAB Conv.cAzsSZPulsAda._.f_abbruch_pre_ada_azs_S5_S3 "Umrechnung fuer Messgroesse cAzsSZPulsAda::f_abbruch_pre_ada_azs" TAB_VERB 2 0 "NEIN" 1 "JA" DEFAULT_VALUE "" /end COMPU_VTAB
/begin COMPU_VTAB Conv.cAzsSZPulsAda._.f_gang_vorgabe_S5_S3 "Umrechnung fuer Messgroesse cAzsSZPulsAda::f_gang_vorgabe" TAB_VERB 2 0 "NEIN" 1 "JA" DEFAULT_VALUE "" /end COMPU_VTAB
/begin COMPU_VTAB Conv.cAzsSZPulsAda._.f_neutral_vorgabe_S5_S3 "Umrechnung fuer Messgroesse cAzsSZPulsAda::f_neutral_vorgabe" TAB_VERB 2 0 "NEIN" 1 "JA" DEFAULT_VALUE "" /end COMPU_VTAB
/begin COMPU_VTAB Conv.cAzsSZPulsAda._.f_sz_puls_ada_aktiv_S5_S3 "Umrechnung fuer Messgroesse cAzsSZPulsAda::f_sz_puls_ada_aktiv" TAB_VERB 2 0 "NEIN" 1 "JA" DEFAULT_VALUE "" /end COMPU_VTAB
/begin COMPU_VTAB Conv.cAzsSZPulsAda._.sz_puls_ada_gang_S5_S3 "Umrechnung fuer Messgroesse cAzsSZPulsAda::sz_puls_ada_gang" TAB_VERB 10 -1 "GR1" 0 "KEIN_GANG" 1 "G1" 2 "G2" 3 "G3" 4 "G4" 5 "G5" 6 "G6" 7 "G7" 8 "G8" DEFAULT_VALUE "" /end COMPU_VTAB
/begin COMPU_VTAB Conv.cAzsSZPulsAda._.z_sonder_zustand_puls_ada_S5_S3 "Umrechnung fuer Messgroesse cAzsSZPulsAda::z_sonder_zustand_puls_ada" TAB_VERB 13 0 "SZ_PA_PASSIV" 1 "SZ_PA_WARTEN_EINSTIEG" 2 "SZ_PA_EINSTIEG_GA" 3 "SZ_PA_EINSTIEG_WARTEN_VORGABE" 4 "SZ_PA_AKTIV_GA" 5 "SZ_PA_AKTIV_WARTEN" 6 "SZ_PA_AKTIV_SCHALTEN" 7 "SZ_PA_AKTIV_GE" 8 "SZ_PA_AKTIV_IN_D" 9 "SZ_PA_EXIT_GA" 10 "SZ_PA_EXIT_N1" 11 "SZ_PA_EXIT_WARTEN_POS_ERLAUBT" 12 "SZ_PA_EXIT_POS_UEBERNEHMEN" DEFAULT_VALUE "" /end COMPU_VTAB
/begin COMPU_VTAB Conv.cAzsVorgabeGang._.f_abbruch_vorb_angefordert_S5_S3 "Umrechnung fuer Messgroesse cAzsVorgabeGang::f_abbruch_vorb_angefordert" TAB_VERB 2 0 "kein Abbruch" 1 "Abbruch" DEFAULT_VALUE "" /end COMPU_VTAB
/begin COMPU_VTAB Conv.cAzsVorgabeGang._.f_schleppstart_erkannt_S5_S3 "Umrechnung fuer Messgroesse cAzsVorgabeGang::f_schleppstart_erkannt" TAB_VERB 2 0 "keine Anforderung durch Schleppstartfkt." 1 "Anforderung durch Schleppstartfkt." DEFAULT_VALUE "" /end COMPU_VTAB
/begin COMPU_VTAB Conv.cAzsVorgabeGang._.gang_schleppstart_S5_S3 "Umrechnung fuer Messgroesse cAzsVorgabeGang::gang_schleppstart" TAB_VERB 10 -1 "GR1" 0 "KEIN_GANG" 1 "G1" 2 "G2" 3 "G3" 4 "G4" 5 "G5" 6 "G6" 7 "G7" 8 "G8" DEFAULT_VALUE "" /end COMPU_VTAB
/begin COMPU_VTAB Conv.cAzsVorgabeGang._.vorgabegang_S5_S3 "Umrechnung fuer Messgroesse cAzsVorgabeGang::vorgabegang" TAB_VERB 10 -1 "GR1" 0 "KEIN_GANG" 1 "G1" 2 "G2" 3 "G3" 4 "G4" 5 "G5" 6 "G6" 7 "G7" 8 "G8" DEFAULT_VALUE "" /end COMPU_VTAB
/begin COMPU_VTAB Conv.cAzsZielgang._.f_schalt_abbruch_invers_S5_S3 "Umrechnung fuer Messgroesse cAzsZielgang::f_schalt_abbruch_invers" TAB_VERB 2 0 "kein Abbruch" 1 "Abbruch" DEFAULT_VALUE "" /end COMPU_VTAB
/begin COMPU_VTAB Conv.cAzsZielgang._.zielgang_S5_S3 "Umrechnung fuer Messgroesse cAzsZielgang::zielgang" TAB_VERB 10 -1 "GR1" 0 "KEIN_GANG" 1 "G1" 2 "G2" 3 "G3" 4 "G4" 5 "G5" 6 "G6" 7 "G7" 8 "G8" DEFAULT_VALUE "" /end COMPU_VTAB
/begin COMPU_VTAB Conv.cAzsZielgangSas._.schaltart_S5_S3 "Umrechnung fuer Messgroesse cAzsZielgangSas::schaltart" TAB_VERB 3 0 "n.def" 1 "Hochschaltung" 2 "Rueckschaltung" DEFAULT_VALUE "" /end COMPU_VTAB
/begin COMPU_VTAB Conv.cAzsZielgangSas._.schaltinfo_S5_S3 "Umrechnung fuer Messgroesse cAzsZielgangSas::schaltinfo" TAB_VERB 5 0 "keine Schaltung" 1 "Einfach-Hochschaltung" 2 "Mehrfachhochschaltung" 3 "Einfach-Rueckschaltung" 4 "Mehrfachrueckschaltung" DEFAULT_VALUE "" /end COMPU_VTAB
/begin COMPU_VTAB Conv.cAzsZielgangSas._.schaltung_S5_S3 "Umrechnung fuer Messgroesse cAzsZielgangSas::schaltung" TAB_VERB 2 0 "keine laufende Schaltung" 1 "laufende Schaltung" DEFAULT_VALUE "" /end COMPU_VTAB
/begin COMPU_VTAB Conv.cAzsZielgangSas._.zielgang_sas_komp_S5_S3 "Umrechnung fuer Messgroesse cAzsZielgangSas::zielgang_sas_komp" TAB_VERB 10 -9 "8. Gang" -8 "7. Gang" -7 "6. Gang" -6 "5. Gang" -5 "4. Gang" -4 "3. Gang" -3 "2. Gang" -2 "1. Gang" -1 "R-Gang" 0 "R-Gang" DEFAULT_VALUE "" /end COMPU_VTAB
/begin COMPU_VTAB Conv.cAzsZielgangSas._.zielgang_sas_S5_S3 "Umrechnung fuer Messgroesse cAzsZielgangSas::zielgang_sas" TAB_VERB 10 -1 "GR1" 0 "KEIN_GANG" 1 "G1" 2 "G2" 3 "G3" 4 "G4" 5 "G5" 6 "G6" 7 "G7" 8 "G8" DEFAULT_VALUE "" /end COMPU_VTAB
/begin COMPU_VTAB Conv.cAzsZielgangSoll._.zielgang_soll_S5_S3 "Umrechnung fuer Messgroesse cAzsZielgangSoll::zielgang_soll" TAB_VERB 10 -1 "GR1" 0 "KEIN_GANG" 1 "G1" 2 "G2" 3 "G3" 4 "G4" 5 "G5" 6 "G6" 7 "G7" 8 "G8" DEFAULT_VALUE "" /end COMPU_VTAB
/begin COMPU_VTAB Conv.cBibAglex._.f_nicht_berechnen_S5_S3 "Umrechnung fuer Messgroesse cBibAglex::f_nicht_berechnen" TAB_VERB 2 0 "FALSE" 1 "TRUE" DEFAULT_VALUE "" /end COMPU_VTAB
/begin COMPU_VTAB Conv.cBibAglex._.func_agl_S5_S3 "Umrechnung fuer Messgroesse cBibAglex::func_agl" TAB_VERB 5 0 "ADA_FUNC_AGL_KEINE" 1 "ADA_KUP" 2 "ADA_SF_WK" 3 "ADA_PRE_SCHALTKUP" 4 "ADA_PRE_K0" DEFAULT_VALUE "" /end COMPU_VTAB
/begin COMPU_VTAB Conv.cBibAglex._.signal_agl_S5_S3 "Umrechnung fuer Messgroesse cBibAglex::signal_agl" TAB_VERB 5 0 "AGL_MIT_NAB" 1 "AGL_MIT_NT" 2 "AGL_MIT_MITTELWERT" 3 "AGL_MIT_NMOT" 4 "AGL_MIT_N6" DEFAULT_VALUE "" /end COMPU_VTAB
/begin COMPU_VTAB Conv.cBibAglex._.z_agl_S5_S3 "Umrechnung fuer Messgroesse cBibAglex::z_agl" TAB_VERB 5 0 "Z_AGL_PASSIV" 1 "Z_AGL_INIT" 2 "Z_AGL_AKTIV" 3 "Z_AGL_NICHT_BERECHNEN" 4 "Z_AGL_FEHLER_UEBERLAUF" DEFAULT_VALUE "" /end COMPU_VTAB
/begin COMPU_VTAB Conv.cBibAglex._.z_ringspeicher_S5_S3 "Umrechnung fuer Messgroesse cBibAglex::z_ringspeicher" TAB_VERB 3 0 "RINGSPEICHER_PASSIV" 1 "RINGSPEICHER_INIT" 2 "RINGSPEICHER_AKTIV" DEFAULT_VALUE "" /end COMPU_VTAB
/begin COMPU_VTAB Conv.cBihMobef._.f_rganglimitaktiv_S5_S3 "Umrechnung fuer Messgroesse cBihMobef::f_rganglimitaktiv" TAB_VERB 2 0 "nicht aktiv" 1 "aktiv" DEFAULT_VALUE "" /end COMPU_VTAB
/begin COMPU_VTAB Conv.cBihMobef._.fl_meschlupfaktiv_S5_S3 "Umrechnung fuer Messgroesse cBihMobef::fl_meschlupfaktiv" TAB_VERB 2 0 "noch nicht aktiv" 1 "bereits aktiv" DEFAULT_VALUE "" /end COMPU_VTAB
/begin COMPU_VTAB Conv.cBihMobef._.flag_meschlupf_S5_S3 "Umrechnung fuer Messgroesse cBihMobef::flag_meschlupf" TAB_VERB 2 0 "nicht aktiv" 1 "aktiv" DEFAULT_VALUE "" /end COMPU_VTAB
/begin COMPU_VTAB Conv.cBihMobef._.z_m_motmax_kor_strang_S5_S3 "Umrechnung fuer Messgroesse cBihMobef::z_m_motmax_kor_strang" TAB_VERB 3 0 "Passiv" 1 "Abregelrampe" 2 "Aufregelrampe" DEFAULT_VALUE "" /end COMPU_VTAB
/begin COMPU_VTAB Conv.cBihMobef._.z_m_motmax_schlupf_S5_S3 "Umrechnung fuer Messgroesse cBihMobef::z_m_motmax_schlupf" TAB_VERB 3 0 "nicht aktiv" 1 "aktiv" 2 "Aufregelrampe" DEFAULT_VALUE "" /end COMPU_VTAB
/begin COMPU_VTAB Conv.cBihMomen._.z_t_mverl_k0_S5_S3 "Umrechnung fuer Messgroesse cBihMomen::z_t_mverl_k0" TAB_VERB 3 0 "Timer passiv Schleppmoment K0" 1 "Timer aktiv  Schleppmoment K0" 2 "Timer passiv kein Schleppmoment von K0" DEFAULT_VALUE "" /end COMPU_VTAB
/begin COMPU_VTAB Conv.cBihPumpendruck._.f_evt_pumpendruck_motor_S5_S3 "Umrechnung fuer Messgroesse cBihPumpendruck::f_evt_pumpendruck_motor" TAB_VERB 2 0 "FALSE" 1 "TRUE" DEFAULT_VALUE "" /end COMPU_VTAB
/begin COMPU_VTAB Conv.cBihPumpendruck._.f_evt_pumpendruck_turbine_S5_S3 "Umrechnung fuer Messgroesse cBihPumpendruck::f_evt_pumpendruck_turbine" TAB_VERB 2 0 "FALSE" 1 "TRUE" DEFAULT_VALUE "" /end COMPU_VTAB
/begin COMPU_VTAB Conv.cBihPumpendruck._.f_pumpendruck_motor_S5_S3 "Umrechnung fuer Messgroesse cBihPumpendruck::f_pumpendruck_motor" TAB_VERB 2 0 "FALSE" 1 "TRUE" DEFAULT_VALUE "" /end COMPU_VTAB
/begin COMPU_VTAB Conv.cBihPumpendruck._.f_sfkt_pumpendruck_aktiv_S5_S3 "Umrechnung fuer Messgroesse cBihPumpendruck::f_sfkt_pumpendruck_aktiv" TAB_VERB 2 0 "FALSE" 1 "TRUE" DEFAULT_VALUE "" /end COMPU_VTAB
/begin COMPU_VTAB Conv.cBihPumpendruck._.z_pumpendruck_S5_S3 "Umrechnung fuer Messgroesse cBihPumpendruck::z_pumpendruck" TAB_VERB 4 0 "Z_PD_INIT" 1 "Z_PD_KEIN_DRUCK" 2 "Z_PD_EVT_DRUCK" 3 "Z_PD_SICHER_DRUCK" DEFAULT_VALUE "" /end COMPU_VTAB
/begin COMPU_VTAB Conv.cBihSigna._.bremsbed_ofstb_S5_S3 "Umrechnung fuer Messgroesse cBihSigna::bremsbed_ofstb" TAB_VERB 2 0 "nicht betaetigt" 1 "betaetigt" DEFAULT_VALUE "" /end COMPU_VTAB
/begin COMPU_VTAB Conv.cBihSigna._.bremsbed_S5_S3 "Umrechnung fuer Messgroesse cBihSigna::bremsbed" TAB_VERB 2 0 "nicht betaetigt" 1 "betaetigt" DEFAULT_VALUE "" /end COMPU_VTAB
/begin COMPU_VTAB Conv.cDiaRbmif._.flag_rbm_zust_hanfahr_iae_S5_S3 "Umrechnung fuer Messgroesse cDiaRbmif::flag_rbm_zust_hanfahr_iae" TAB_VERB 2 0 "Betriebszustand nicht erfuellt" 1 "Betriebszustand erfuellt" DEFAULT_VALUE "" /end COMPU_VTAB
/begin COMPU_VTAB Conv.cDiaRbmif._.flag_rbm_zust_inaktiv_iae_S5_S3 "Umrechnung fuer Messgroesse cDiaRbmif::flag_rbm_zust_inaktiv_iae" TAB_VERB 2 0 "Betriebszustand nicht erfuellt" 1 "Betriebszustand erfuellt" DEFAULT_VALUE "" /end COMPU_VTAB
/begin COMPU_VTAB Conv.cDiaRbmif._.flag_rbm_zustand_posn_S5_S3 "Umrechnung fuer Messgroesse cDiaRbmif::flag_rbm_zustand_posn" TAB_VERB 2 0 "Betriebszustand nicht erfuellt" 1 "Betriebszustand erfuellt" DEFAULT_VALUE "" /end COMPU_VTAB
/begin COMPU_VTAB Conv.cDiaRbmif._.flag_rbm_zustand_uwigkup_S5_S3 "Umrechnung fuer Messgroesse cDiaRbmif::flag_rbm_zustand_uwigkup" TAB_VERB 2 0 "Betriebszustand nicht erfuellt" 1 "Betriebszustand erfuellt" DEFAULT_VALUE "" /end COMPU_VTAB
/begin COMPU_VTAB Conv.cDiaRbmif._.flag_rbm_zustand_uwigschalt_S5_S3 "Umrechnung fuer Messgroesse cDiaRbmif::flag_rbm_zustand_uwigschalt" TAB_VERB 2 0 "Betriebszustand nicht erfuellt" 1 "Betriebszustand erfuellt" DEFAULT_VALUE "" /end COMPU_VTAB
/begin COMPU_VTAB Conv.cDiaRbmif._.rbm_istgang_vorw_alt_S5_S3 "Umrechnung fuer Messgroesse cDiaRbmif::rbm_istgang_vorw_alt" TAB_VERB 9 0 "KEIN_GANG" 1 "G1" 2 "G2" 3 "G3" 4 "G4" 5 "G5" 6 "G6" 7 "G7" 8 "G8" DEFAULT_VALUE "" /end COMPU_VTAB
/begin COMPU_VTAB Conv.cDiaRbmif._.rbm_zielgang_sas_vorw_alt_S5_S3 "Umrechnung fuer Messgroesse cDiaRbmif::rbm_zielgang_sas_vorw_alt" TAB_VERB 9 0 "KEIN_GANG" 1 "G1" 2 "G2" 3 "G3" 4 "G4" 5 "G5" 6 "G6" 7 "G7" 8 "G8" DEFAULT_VALUE "" /end COMPU_VTAB
/begin COMPU_VTAB Conv.cIaeAdauf._.kfl_ziel_start_uefiea_S5_S3 "Umrechnung fuer Messgroesse cIaeAdauf::kfl_ziel_start_uefiea" TAB_VERB 3 0 "KEIN_KFL" 1 "KFL_VORWAERTS" 2 "KFL_RUECKWAERTS" DEFAULT_VALUE "" /end COMPU_VTAB
/begin COMPU_VTAB Conv.cIaeAdauf._.z_ada_uefiae_S5_S3 "Umrechnung fuer Messgroesse cIaeAdauf::z_ada_uefiae" TAB_VERB 2 0 "Z_ADA_UEFIAE_PASSIV" 1 "Z_ADA_UEFIAE_BEOBACHTEN" DEFAULT_VALUE "" /end COMPU_VTAB
/begin COMPU_VTAB Conv.cIaeAdauf._.zielgang_start_uefiae_S5_S3 "Umrechnung fuer Messgroesse cIaeAdauf::zielgang_start_uefiae" TAB_VERB 10 -1 "GR1" 0 "KEIN_GANG" 1 "G1" 2 "G2" 3 "G3" 4 "G4" 5 "G5" 6 "G6" 7 "G7" 8 "G8" DEFAULT_VALUE "" /end COMPU_VTAB
/begin COMPU_VTAB Conv.cIaeDiagn._.flag_close_bew_aktiv_diagiae_S5_S3 "Umrechnung fuer Messgroesse cIaeDiagn::flag_close_bew_aktiv_diagiae" TAB_VERB 2 0 "FALSE" 1 "TRUE" DEFAULT_VALUE "" /end COMPU_VTAB
/begin COMPU_VTAB Conv.cIaeDiagn._.flag_close_diagiae_S5_S3 "Umrechnung fuer Messgroesse cIaeDiagn::flag_close_diagiae" TAB_VERB 2 0 "FALSE" 1 "TRUE" DEFAULT_VALUE "" /end COMPU_VTAB
/begin COMPU_VTAB Conv.cIaeDiagn._.flag_hot_diagiae_S5_S3 "Umrechnung fuer Messgroesse cIaeDiagn::flag_hot_diagiae" TAB_VERB 2 0 "FALSE" 1 "TRUE" DEFAULT_VALUE "" /end COMPU_VTAB
/begin COMPU_VTAB Conv.cIaeDiagn._.flag_max_p_haupt_diagiae_S5_S3 "Umrechnung fuer Messgroesse cIaeDiagn::flag_max_p_haupt_diagiae" TAB_VERB 2 0 "FALSE" 1 "TRUE" DEFAULT_VALUE "" /end COMPU_VTAB
/begin COMPU_VTAB Conv.cIaeDiagn._.flag_mmot_gespeichert_diagiae_S5_S3 "Umrechnung fuer Messgroesse cIaeDiagn::flag_mmot_gespeichert_diagiae" TAB_VERB 2 0 "FALSE" 1 "TRUE" DEFAULT_VALUE "" /end COMPU_VTAB
/begin COMPU_VTAB Conv.cIaeDiagn._.flag_noclose_bew_aktiv_diagiae_S5_S3 "Umrechnung fuer Messgroesse cIaeDiagn::flag_noclose_bew_aktiv_diagiae" TAB_VERB 2 0 "FALSE" 1 "TRUE" DEFAULT_VALUE "" /end COMPU_VTAB
/begin COMPU_VTAB Conv.cIaeDiagn._.flag_noclose_diagiae_S5_S3 "Umrechnung fuer Messgroesse cIaeDiagn::flag_noclose_diagiae" TAB_VERB 2 0 "FALSE" 1 "TRUE" DEFAULT_VALUE "" /end COMPU_VTAB
/begin COMPU_VTAB Conv.cIaeDiagn._.flag_noclose_hogez_diagiae_S5_S3 "Umrechnung fuer Messgroesse cIaeDiagn::flag_noclose_hogez_diagiae" TAB_VERB 2 0 "FALSE" 1 "TRUE" DEFAULT_VALUE "" /end COMPU_VTAB
/begin COMPU_VTAB Conv.cIaeDiagn._.flag_noopen_bew_aktiv_diagiae_S5_S3 "Umrechnung fuer Messgroesse cIaeDiagn::flag_noopen_bew_aktiv_diagiae" TAB_VERB 2 0 "FALSE" 1 "TRUE" DEFAULT_VALUE "" /end COMPU_VTAB
/begin COMPU_VTAB Conv.cIaeDiagn._.flag_noopen_diagiae_S5_S3 "Umrechnung fuer Messgroesse cIaeDiagn::flag_noopen_diagiae" TAB_VERB 2 0 "FALSE" 1 "TRUE" DEFAULT_VALUE "" /end COMPU_VTAB
/begin COMPU_VTAB Conv.cIaeDiagn._.flag_rueckf_mmot_diagiae_S5_S3 "Umrechnung fuer Messgroesse cIaeDiagn::flag_rueckf_mmot_diagiae" TAB_VERB 2 0 "FALSE" 1 "TRUE" DEFAULT_VALUE "" /end COMPU_VTAB
/begin COMPU_VTAB Conv.cIaeDiagn._.flag_rueckf_msollnmot_diagiae_S5_S3 "Umrechnung fuer Messgroesse cIaeDiagn::flag_rueckf_msollnmot_diagiae" TAB_VERB 2 0 "FALSE" 1 "TRUE" DEFAULT_VALUE "" /end COMPU_VTAB
/begin COMPU_VTAB Conv.cIaeDiagn._.flag_sammelbed_diagiae_S5_S3 "Umrechnung fuer Messgroesse cIaeDiagn::flag_sammelbed_diagiae" TAB_VERB 2 0 "FALSE" 1 "TRUE" DEFAULT_VALUE "" /end COMPU_VTAB
/begin COMPU_VTAB Conv.cIaeDiagn._.flag_spassfahrt_diagiae_S5_S3 "Umrechnung fuer Messgroesse cIaeDiagn::flag_spassfahrt_diagiae" TAB_VERB 2 0 "FALSE" 1 "TRUE" DEFAULT_VALUE "" /end COMPU_VTAB
/begin COMPU_VTAB Conv.cIaeDiagn._.flag_timer_hot_diagiae_S5_S3 "Umrechnung fuer Messgroesse cIaeDiagn::flag_timer_hot_diagiae" TAB_VERB 2 0 "FALSE" 1 "TRUE" DEFAULT_VALUE "" /end COMPU_VTAB
/begin COMPU_VTAB Conv.cIaeDiagn._.status_iae_hotinfo_S5_S3 "Umrechnung fuer Messgroesse cIaeDiagn::status_iae_hotinfo" TAB_VERB 3 0 "keine Meldung" 1 "Stufe I (IAE Pulsen)" 2 "Stufe II (IAE Öffnen)" DEFAULT_VALUE "" /end COMPU_VTAB
/begin COMPU_VTAB Conv.cIaeDiagn._.z_close_diagiae_S5_S3 "Umrechnung fuer Messgroesse cIaeDiagn::z_close_diagiae" TAB_VERB 3 0 "Diagnose IAE_CLOSE nicht aktiv" 1 "Diagnose IAE_CLOSE aktiv" 2 "Diagnose IAE_CLOSE ng-Bedingung einmalig erfuellt  Timer-TSAX_CLOSE_DIAGIAE laeuft" DEFAULT_VALUE "" /end COMPU_VTAB
/begin COMPU_VTAB Conv.cIaeDraus._.f_hysschleife_aktiv_iae_S5_S3 "Umrechnung fuer Messgroesse cIaeDraus::f_hysschleife_aktiv_iae" TAB_VERB 2 0 "FALSE" 1 "TRUE" DEFAULT_VALUE "" /end COMPU_VTAB
/begin COMPU_VTAB Conv.cIaeDraus._.f_hysschleife_moeglich_iae_S5_S3 "Umrechnung fuer Messgroesse cIaeDraus::f_hysschleife_moeglich_iae" TAB_VERB 2 0 "FALSE" 1 "TRUE" DEFAULT_VALUE "" /end COMPU_VTAB
/begin COMPU_VTAB Conv.cIaeDraus._.flag_init_ausinaktiv_iae_S5_S3 "Umrechnung fuer Messgroesse cIaeDraus::flag_init_ausinaktiv_iae" TAB_VERB 2 0 "FALSE" 1 "TRUE" DEFAULT_VALUE "" /end COMPU_VTAB
/begin COMPU_VTAB Conv.cIaeDraus._.flag_m_max_alt_S5_S3 "Umrechnung fuer Messgroesse cIaeDraus::flag_m_max_alt" TAB_VERB 2 0 "FALSE" 1 "TRUE" DEFAULT_VALUE "" /end COMPU_VTAB
/begin COMPU_VTAB Conv.cIaeDraus._.flag_po_dyn_aktiv_iae_S5_S3 "Umrechnung fuer Messgroesse cIaeDraus::flag_po_dyn_aktiv_iae" TAB_VERB 2 0 "FALSE" 1 "TRUE" DEFAULT_VALUE "" /end COMPU_VTAB
/begin COMPU_VTAB Conv.cIaeDraus._.z_hyskompstillunten_iae_S5_S3 "Umrechnung fuer Messgroesse cIaeDraus::z_hyskompstillunten_iae" TAB_VERB 4 0 "warten" 1 "abrampen" 2 "halten" 3 "rausfiltern" DEFAULT_VALUE "" /end COMPU_VTAB
/begin COMPU_VTAB Conv.cIaeKordi._.f_torqfuse_iae_S5_S3 "Umrechnung fuer Messgroesse cIaeKordi::f_torqfuse_iae" TAB_VERB 2 0 "FALSE" 1 "TRUE" DEFAULT_VALUE "" /end COMPU_VTAB
/begin COMPU_VTAB Conv.cIaeKordi._.flag_zu_gewesen_iae_S5_S3 "Umrechnung fuer Messgroesse cIaeKordi::flag_zu_gewesen_iae" TAB_VERB 2 0 "FALSE" 1 "TRUE" DEFAULT_VALUE "" /end COMPU_VTAB
/begin COMPU_VTAB Conv.cIaeKordi._.kup_status_iae_S5_S3 "Umrechnung fuer Messgroesse cIaeKordi::kup_status_iae" TAB_VERB 9 0 "Funktion hat kein zugriff auf IAE" 1 "IAE offen" 2 "IAE angelegt" 3 "IAE Schlupfend" 4 "IAE Schlupf während Schleppstart" 5 "IAE Schlupf während Schleppstart im Anfahren" 6 "IAE baut Restschlupf ab" 7 "IAE vollständig zu" 8 "IAE oeffnet" DEFAULT_VALUE "" /end COMPU_VTAB
/begin COMPU_VTAB Conv.cIaeKordi._.z_iae_S5_S3 "Umrechnung fuer Messgroesse cIaeKordi::z_iae" TAB_VERB 10 0 "IAE nicht definiert" 1 "IAE PASSIV" 2 "IAE Angelegt" 3 "IAE Kriechen" 4 "IAE H-Anfahren" 5 "IAE E-Anfahren" 6 "IAE E-Anfahren entkoppelt" 7 "IAE Synchronisieren" 8 "IAE Zu" 9 "IAE Entkoppelt" DEFAULT_VALUE "" /end COMPU_VTAB
/begin COMPU_VTAB Conv.cIaeKordi._.z_iae_temp_S5_S3 "Umrechnung fuer Messgroesse cIaeKordi::z_iae_temp" TAB_VERB 10 0 "IAE nicht definiert" 1 "IAE PASSIV" 2 "IAE Angelegt" 3 "IAE Kriechen" 4 "IAE H-Anfahren" 5 "IAE E-Anfahren" 6 "IAE E-Anfahren entkoppelt" 7 "IAE Synchronisieren" 8 "IAE Zu" 9 "IAE Entkoppelt" DEFAULT_VALUE "" /end COMPU_VTAB
/begin COMPU_VTAB Conv.cIaeMomen._.flag_first_reglerinit_iae_S5_S3 "Umrechnung fuer Messgroesse cIaeMomen::flag_first_reglerinit_iae" TAB_VERB 2 0 "FALSE" 1 "TRUE" DEFAULT_VALUE "" /end COMPU_VTAB
/begin COMPU_VTAB Conv.cIaeMomen._.flag_initmistvorst_iae_S5_S3 "Umrechnung fuer Messgroesse cIaeMomen::flag_initmistvorst_iae" TAB_VERB 2 0 "FALSE" 1 "TRUE" DEFAULT_VALUE "" /end COMPU_VTAB
/begin COMPU_VTAB Conv.cIaeMomen._.flag_initsollanfahr_iae_S5_S3 "Umrechnung fuer Messgroesse cIaeMomen::flag_initsollanfahr_iae" TAB_VERB 2 0 "FALSE" 1 "TRUE" DEFAULT_VALUE "" /end COMPU_VTAB
/begin COMPU_VTAB Conv.cIaeMomen._.flag_kaltanfahren_aktiv_iae_S5_S3 "Umrechnung fuer Messgroesse cIaeMomen::flag_kaltanfahren_aktiv_iae" TAB_VERB 2 0 "FALSE" 1 "TRUE" DEFAULT_VALUE "" /end COMPU_VTAB
/begin COMPU_VTAB Conv.cIaeMomen._.flag_mvorberechnug_aktiv_iae_S5_S3 "Umrechnung fuer Messgroesse cIaeMomen::flag_mvorberechnug_aktiv_iae" TAB_VERB 2 0 "FALSE" 1 "TRUE" DEFAULT_VALUE "" /end COMPU_VTAB
/begin COMPU_VTAB Conv.cIaeMomen._.flag_nsmotmaxc_iae_S5_S3 "Umrechnung fuer Messgroesse cIaeMomen::flag_nsmotmaxc_iae" TAB_VERB 2 0 "FALSE" 1 "TRUE" DEFAULT_VALUE "" /end COMPU_VTAB
/begin COMPU_VTAB Conv.cIaeMomen._.flag_pulscue_aktiv_iae_S5_S3 "Umrechnung fuer Messgroesse cIaeMomen::flag_pulscue_aktiv_iae" TAB_VERB 2 0 "FALSE" 1 "TRUE" DEFAULT_VALUE "" /end COMPU_VTAB
/begin COMPU_VTAB Conv.cIaeMomen._.flag_regler_aktiv_S5_S3 "Umrechnung fuer Messgroesse cIaeMomen::flag_regler_aktiv" TAB_VERB 2 0 "FALSE" 1 "TRUE" DEFAULT_VALUE "" /end COMPU_VTAB
/begin COMPU_VTAB Conv.cIaeMomen._.flag_schaltung_aktiv_iae_S5_S3 "Umrechnung fuer Messgroesse cIaeMomen::flag_schaltung_aktiv_iae" TAB_VERB 2 0 "FALSE" 1 "TRUE" DEFAULT_VALUE "" /end COMPU_VTAB
/begin COMPU_VTAB Conv.cIaeMomen._.flag_schrittschaltung_iae_S5_S3 "Umrechnung fuer Messgroesse cIaeMomen::flag_schrittschaltung_iae" TAB_VERB 2 0 "FALSE" 1 "TRUE" DEFAULT_VALUE "" /end COMPU_VTAB
/begin COMPU_VTAB Conv.cIaeMomen._.flag_t_ueffix_iae_S5_S3 "Umrechnung fuer Messgroesse cIaeMomen::flag_t_ueffix_iae" TAB_VERB 2 0 "FALSE" 1 "TRUE" DEFAULT_VALUE "" /end COMPU_VTAB
/begin COMPU_VTAB Conv.cIaeMomen._.flag_ueflaeuft_iae_S5_S3 "Umrechnung fuer Messgroesse cIaeMomen::flag_ueflaeuft_iae" TAB_VERB 2 0 "FALSE" 1 "TRUE" DEFAULT_VALUE "" /end COMPU_VTAB
/begin COMPU_VTAB Conv.cIaeMomen._.flag_zu_erreicht_iae_S5_S3 "Umrechnung fuer Messgroesse cIaeMomen::flag_zu_erreicht_iae" TAB_VERB 2 0 "FALSE" 1 "TRUE" DEFAULT_VALUE "" /end COMPU_VTAB
/begin COMPU_VTAB Conv.cIaeMomen._.kfl_ziel_tmp_iae_S5_S3 "Umrechnung fuer Messgroesse cIaeMomen::kfl_ziel_tmp_iae" TAB_VERB 3 0 "KEIN_KFL" 1 "KFL_VORWAERTS" 2 "KFL_RUECKWAERTS" DEFAULT_VALUE "" /end COMPU_VTAB
/begin COMPU_VTAB Conv.cIaeMomen._.st_anfagradbegrenz_iae_S5_S3 "Umrechnung fuer Messgroesse cIaeMomen::st_anfagradbegrenz_iae" TAB_VERB 3 0 "keine Stallspeed und keine Begrenzung" 1 "Stallspeed" 2 "Begrenzung nach Stallspeed" DEFAULT_VALUE "" /end COMPU_VTAB
/begin COMPU_VTAB Conv.cIaeMomen._.status_uef_zu_kriech_init_iae_S5_S3 "Umrechnung fuer Messgroesse cIaeMomen::status_uef_zu_kriech_init_iae" TAB_VERB 3 0 "Init noch nicht erfolgt" 1 "Init jetzt" 2 "Init erfolgt" DEFAULT_VALUE "" /end COMPU_VTAB
/begin COMPU_VTAB Conv.cIaeMomen._.typ_uef_m_S5_S3 "Umrechnung fuer Messgroesse cIaeMomen::typ_uef_m" TAB_VERB 5 0 "undefinier" 1 "Sprung" 2 "Gerade" 3 "symmetrischer S-Schlag" 4 "asymmetrischer S-Schlag" DEFAULT_VALUE "" /end COMPU_VTAB
/begin COMPU_VTAB Conv.cIaeMomen._.typ_uef_miaeaufanf_iae_S5_S3 "Umrechnung fuer Messgroesse cIaeMomen::typ_uef_miaeaufanf_iae" TAB_VERB 5 0 "undefinier" 1 "Sprung" 2 "Gerade" 3 "symmetrischer S-Schlag" 4 "asymmetrischer S-Schlag" DEFAULT_VALUE "" /end COMPU_VTAB
/begin COMPU_VTAB Conv.cIaeMomen._.z_mo_kriech_aktiv_iae_S5_S3 "Umrechnung fuer Messgroesse cIaeMomen::z_mo_kriech_aktiv_iae" TAB_VERB 4 0 "Fahrzeug steht" 1 "mo_vorst wird aufgerampt" 2 "Fahrzeug fährt" 3 "mo_vorst wird abgerampt" DEFAULT_VALUE "" /end COMPU_VTAB
/begin COMPU_VTAB Conv.cIaeMomen._.z_modusiae_temp_S5_S3 "Umrechnung fuer Messgroesse cIaeMomen::z_modusiae_temp" TAB_VERB 3 0 "E-Anfahren mit Schlupf" 1 "E-Anfahren geschlossen" 2 "Hybrid-Anfahren" DEFAULT_VALUE "" /end COMPU_VTAB
/begin COMPU_VTAB Conv.cIaeMomen._.z_rampe_miaeauf_S5_S3 "Umrechnung fuer Messgroesse cIaeMomen::z_rampe_miaeauf" TAB_VERB 3 0 "Rampe fertig" 1 "Rampe wird gestartet" 2 "Rampe rampt" DEFAULT_VALUE "" /end COMPU_VTAB
/begin COMPU_VTAB Conv.cIaeMotmx._.flag_motmaxndiff_iae_S5_S3 "Umrechnung fuer Messgroesse cIaeMotmx::flag_motmaxndiff_iae" TAB_VERB 2 0 "FALSE" 1 "TRUE" DEFAULT_VALUE "" /end COMPU_VTAB
/begin COMPU_VTAB Conv.cIaeMotmx._.flag_motmaxregdiff_iae_S5_S3 "Umrechnung fuer Messgroesse cIaeMotmx::flag_motmaxregdiff_iae" TAB_VERB 2 0 "FALSE" 1 "TRUE" DEFAULT_VALUE "" /end COMPU_VTAB
/begin COMPU_VTAB Conv.cIaeMotmx._.flag_motmaxstall_iae_S5_S3 "Umrechnung fuer Messgroesse cIaeMotmx::flag_motmaxstall_iae" TAB_VERB 2 0 "FALSE" 1 "TRUE" DEFAULT_VALUE "" /end COMPU_VTAB
/begin COMPU_VTAB Conv.cIaeMotmx._.flag_motmaxtemp_iae_S5_S3 "Umrechnung fuer Messgroesse cIaeMotmx::flag_motmaxtemp_iae" TAB_VERB 2 0 "FALSE" 1 "TRUE" DEFAULT_VALUE "" /end COMPU_VTAB
/begin COMPU_VTAB Conv.cIaeMotmx._.flag_stallspeed_iae_S5_S3 "Umrechnung fuer Messgroesse cIaeMotmx::flag_stallspeed_iae" TAB_VERB 2 0 "FALSE" 1 "TRUE" DEFAULT_VALUE "" /end COMPU_VTAB
/begin COMPU_VTAB Conv.cIaeSigna._.asr_regelt_iae_S5_S3 "Umrechnung fuer Messgroesse cIaeSigna::asr_regelt_iae" TAB_VERB 2 0 "FALSE" 1 "TRUE" DEFAULT_VALUE "" /end COMPU_VTAB
/begin COMPU_VTAB Conv.cIaeSigna._.flag_init_signa_iae_S5_S3 "Umrechnung fuer Messgroesse cIaeSigna::flag_init_signa_iae" TAB_VERB 2 0 "FALSE" 1 "TRUE" DEFAULT_VALUE "" /end COMPU_VTAB
/begin COMPU_VTAB Conv.cIaeSigna._.flag_mreibzumstell_iae_S5_S3 "Umrechnung fuer Messgroesse cIaeSigna::flag_mreibzumstell_iae" TAB_VERB 2 0 "FALSE" 1 "TRUE" DEFAULT_VALUE "" /end COMPU_VTAB
/begin COMPU_VTAB Conv.cIaeSigna._.kfl_sollneutral_iae_S5_S3 "Umrechnung fuer Messgroesse cIaeSigna::kfl_sollneutral_iae" TAB_VERB 2 0 "FALSE" 1 "TRUE" DEFAULT_VALUE "" /end COMPU_VTAB
/begin COMPU_VTAB Conv.cIaeSigna._.n_ab_dir_iae_S5_S3 "Umrechnung fuer Messgroesse cIaeSigna::n_ab_dir_iae" TAB_VERB 2 -1 "Drehrichtung entgegen dem Fahrbetrieb" 1 "Drehrichtung in Fahrbetriebsrichtung" DEFAULT_VALUE "" /end COMPU_VTAB
/begin COMPU_VTAB Conv.cIaeSigna._.z_nmotll_aktiv_iae_S5_S3 "Umrechnung fuer Messgroesse cIaeSigna::z_nmotll_aktiv_iae" TAB_VERB 2 0 "nicht aktiv" 1 "aktiv" DEFAULT_VALUE "" /end COMPU_VTAB
/begin COMPU_VTAB Conv.cIaeTempm._.flag_tempsperr_timerini_iae_S5_S3 "Umrechnung fuer Messgroesse cIaeTempm::flag_tempsperr_timerini_iae" TAB_VERB 2 0 "FALSE" 1 "TRUE" DEFAULT_VALUE "" /end COMPU_VTAB
/begin COMPU_VTAB Conv.cIaeTempm._.z_temp_init_iae_S5_S3 "Umrechnung fuer Messgroesse cIaeTempm::z_temp_init_iae" TAB_VERB 3 0 "Initialisierung noch nicht erfolgt" 1 "Vorab-Init mit c_iae aus EEPROM erfolgt" 2 "Initialisierung endgültig erfolgt" DEFAULT_VALUE "" /end COMPU_VTAB
/begin COMPU_VTAB Conv.cIepBerLp._.f_has_aktiv_iep_S5_S3 "Umrechnung fuer Messgroesse cIepBerLp::f_has_aktiv_iep" TAB_VERB 2 0 "FALSE" 1 "TRUE" DEFAULT_VALUE "" /end COMPU_VTAB
/begin COMPU_VTAB Conv.cIepBerLp._.f_iep_ext_S5_S3 "Umrechnung fuer Messgroesse cIepBerLp::f_iep_ext" TAB_VERB 2 0 "FALSE" 1 "TRUE" DEFAULT_VALUE "" /end COMPU_VTAB
/begin COMPU_VTAB Conv.cIepBerLp._.f_iep_has_S5_S3 "Umrechnung fuer Messgroesse cIepBerLp::f_iep_has" TAB_VERB 2 0 "FALSE" 1 "TRUE" DEFAULT_VALUE "" /end COMPU_VTAB
/begin COMPU_VTAB Conv.cIepBerLp._.f_iep_sab_S5_S3 "Umrechnung fuer Messgroesse cIepBerLp::f_iep_sab" TAB_VERB 2 0 "FALSE" 1 "TRUE" DEFAULT_VALUE "" /end COMPU_VTAB
/begin COMPU_VTAB Conv.cIepBerLp._.f_iep_tes_S5_S3 "Umrechnung fuer Messgroesse cIepBerLp::f_iep_tes" TAB_VERB 2 0 "FALSE" 1 "TRUE" DEFAULT_VALUE "" /end COMPU_VTAB
/begin COMPU_VTAB Conv.cIepBerLp._.f_kmn_enpg_S5_S3 "Umrechnung fuer Messgroesse cIepBerLp::f_kmn_enpg" TAB_VERB 2 0 "FALSE" 1 "TRUE" DEFAULT_VALUE "" /end COMPU_VTAB
/begin COMPU_VTAB Conv.cIepBerLp._.f_nmin_iep_S5_S3 "Umrechnung fuer Messgroesse cIepBerLp::f_nmin_iep" TAB_VERB 2 0 "FALSE" 1 "TRUE" DEFAULT_VALUE "" /end COMPU_VTAB
/begin COMPU_VTAB Conv.cIepBerLp._.f_senken_LP3_iep_S5_S3 "Umrechnung fuer Messgroesse cIepBerLp::f_senken_LP3_iep" TAB_VERB 2 0 "iep_soll_intern aktiv" 1 "LP1 vorgeben" DEFAULT_VALUE "" /end COMPU_VTAB
/begin COMPU_VTAB Conv.cIepBerLp._.iep_soll_ext_intern_S5_S3 "Umrechnung fuer Messgroesse cIepBerLp::iep_soll_ext_intern" TAB_VERB 5 0 "Keine ext. Vorgaben" 1 "Pumpe ausgeschaltet" 2 "Leistungspunkt 1" 3 "Leistungspunkt 2" 4 "Leistungspunkt 3" DEFAULT_VALUE "" /end COMPU_VTAB
/begin COMPU_VTAB Conv.cIepBerLp._.iep_soll_ext_S5_S3 "Umrechnung fuer Messgroesse cIepBerLp::iep_soll_ext" TAB_VERB 5 0 "Keine ext. Vorgaben" 1 "Pumpe ausgeschaltet" 2 "Leistungspunkt 1" 3 "Leistungspunkt 2" 4 "Leistungspunkt 3" DEFAULT_VALUE "" /end COMPU_VTAB
/begin COMPU_VTAB Conv.cIepBerLp._.iep_soll_intern_S5_S3 "Umrechnung fuer Messgroesse cIepBerLp::iep_soll_intern" TAB_VERB 4 0 "Pumpe muss abgeschaltet" 1 "Vorgabe LP1" 2 "Vorgabe LP2" 3 "Vorgabe LP3" DEFAULT_VALUE "" /end COMPU_VTAB
/begin COMPU_VTAB Conv.cIepBerLp._.iep_soll_S5_S3 "Umrechnung fuer Messgroesse cIepBerLp::iep_soll" TAB_VERB 4 0 "Pumpe muss abgeschaltet" 1 "Vorgabe LP1" 2 "Vorgabe LP2" 3 "Vorgabe LP3" DEFAULT_VALUE "" /end COMPU_VTAB
/begin COMPU_VTAB Conv.cIepBerLp._.schaltung_iep_S5_S3 "Umrechnung fuer Messgroesse cIepBerLp::schaltung_iep" TAB_VERB 2 0 "FALSE" 1 "TRUE" DEFAULT_VALUE "" /end COMPU_VTAB
/begin COMPU_VTAB Conv.cIepBerLp._.z_nmin_iep_S5_S3 "Umrechnung fuer Messgroesse cIepBerLp::z_nmin_iep" TAB_VERB 2 0 "timer aktiv" 1 "timer nicht aktiv" DEFAULT_VALUE "" /end COMPU_VTAB
/begin COMPU_VTAB Conv.cIepBerLp._.z_senken_lp3_S5_S3 "Umrechnung fuer Messgroesse cIepBerLp::z_senken_lp3" TAB_VERB 3 0 "interne Sollvorgaben der Iep" 1 "interne Vorgaben Timer aktiv" 2 "hart iep_soll_lp1 vorgeben" DEFAULT_VALUE "" /end COMPU_VTAB
/begin COMPU_VTAB Conv.cIepKordi._.bed_in_fehler_S5_S3 "Umrechnung fuer Messgroesse cIepKordi::bed_in_fehler" TAB_VERB 2 0 "FALSE" 1 "TRUE" DEFAULT_VALUE "" /end COMPU_VTAB
/begin COMPU_VTAB Conv.cIepKordi._.elektrisch_pumpe_laeuft_S5_S3 "Umrechnung fuer Messgroesse cIepKordi::elektrisch_pumpe_laeuft" TAB_VERB 2 0 "FALSE" 1 "TRUE" DEFAULT_VALUE "" /end COMPU_VTAB
/begin COMPU_VTAB Conv.cIepKordi._.fehler_iep_S5_S3 "Umrechnung fuer Messgroesse cIepKordi::fehler_iep" TAB_VERB 2 0 "kein Fehler -> normale Betrieb der Pumpe" 1 "Fehler in Iep" DEFAULT_VALUE "" /end COMPU_VTAB
/begin COMPU_VTAB Conv.cIepKordi._.iep_ist_manuell_S5_S3 "Umrechnung fuer Messgroesse cIepKordi::iep_ist_manuell" TAB_VERB 5 0 "IEP_IST_AUS" 1 "IEP_IST_SLEEP" 2 "IEP_IST_LP1" 3 "IEP_IST_LP2" 4 "IEP_IST_LP3" DEFAULT_VALUE "" /end COMPU_VTAB
/begin COMPU_VTAB Conv.cIepKordi._.iep_ist_S5_S3 "Umrechnung fuer Messgroesse cIepKordi::iep_ist" TAB_VERB 5 0 "IEP_IST_AUS" 1 "IEP_IST_SLEEP" 2 "IEP_IST_LP1" 3 "IEP_IST_LP2" 4 "IEP_IST_LP3" DEFAULT_VALUE "" /end COMPU_VTAB
/begin COMPU_VTAB Conv.cIepKordi._.zustand_iep_S5_S3 "Umrechnung fuer Messgroesse cIepKordi::zustand_iep" TAB_VERB 7 0 "Pumpe ausgeschaltet" 1 "SLEEP - Modus" 2 "Leistungspunkt 1" 3 "Leistungspunkt 2" 4 "Leistungspunkt 3" 5 "Manuell" 6 "Fehler in IEP" DEFAULT_VALUE "" /end COMPU_VTAB
/begin COMPU_VTAB Conv.cSchaltung._.kup_mass_S5_S3 "Umrechnung fuer Messgroesse cSchaltung::kup_mass" TAB_VERB 6 0 "KEINE" 1 "K_A" 2 "K_B" 3 "K_C" 4 "K_D" 5 "K_E" DEFAULT_VALUE "" /end COMPU_VTAB
/begin COMPU_VTAB Conv.cSchaltung._.manuell_S5_S3 "Umrechnung fuer Messgroesse cSchaltung::manuell" TAB_VERB 3 1 "keine manuelle Schaltung" 2 "manuelle Schaltung" 255 "Initialwert o. nach Reset" DEFAULT_VALUE "" /end COMPU_VTAB
/begin COMPU_VTAB Conv.cSchaltungMitVerzoegerung._.k_a_schalt_verh_S5_S3 "Umrechnung fuer Messgroesse cSchaltungMitVerzoegerung::k_a_schalt_verh" TAB_VERB 2 0 "FALSE" 1 "TRUE" DEFAULT_VALUE "" /end COMPU_VTAB
/begin COMPU_VTAB Conv.cSchaltungMitVerzoegerung._.k_b_schalt_verh_S5_S3 "Umrechnung fuer Messgroesse cSchaltungMitVerzoegerung::k_b_schalt_verh" TAB_VERB 2 0 "FALSE" 1 "TRUE" DEFAULT_VALUE "" /end COMPU_VTAB
/begin COMPU_VTAB Conv.cSchaltungMitVerzoegerung._.k_c_schalt_verh_S5_S3 "Umrechnung fuer Messgroesse cSchaltungMitVerzoegerung::k_c_schalt_verh" TAB_VERB 2 0 "FALSE" 1 "TRUE" DEFAULT_VALUE "" /end COMPU_VTAB
/begin COMPU_VTAB Conv.cSchaltungMitVerzoegerung._.k_d_schalt_verh_S5_S3 "Umrechnung fuer Messgroesse cSchaltungMitVerzoegerung::k_d_schalt_verh" TAB_VERB 2 0 "FALSE" 1 "TRUE" DEFAULT_VALUE "" /end COMPU_VTAB
/begin COMPU_VTAB Conv.cSchaltungMitVerzoegerung._.k_e_schalt_verh_S5_S3 "Umrechnung fuer Messgroesse cSchaltungMitVerzoegerung::k_e_schalt_verh" TAB_VERB 2 0 "FALSE" 1 "TRUE" DEFAULT_VALUE "" /end COMPU_VTAB
/begin COMPU_VTAB Conv.cSchaltungMitVerzoegerung._.sollgang_S5_S3 "Umrechnung fuer Messgroesse cSchaltungMitVerzoegerung::sollgang" TAB_VERB 10 -1 "GR1" 0 "KEIN_GANG" 1 "G1" 2 "G2" 3 "G3" 4 "G4" 5 "G5" 6 "G6" 7 "G7" 8 "G8" DEFAULT_VALUE "" /end COMPU_VTAB
/begin COMPU_METHOD Conv.cAzsKorgl._.f_notgang_gesetzt_S5_S3 "Umrechnung fuer Messgroesse cAzsKorgl::f_notgang_gesetzt" TAB_VERB "%4.0" "" COMPU_TAB_REF Conv.cAzsKorgl._.f_notgang_gesetzt_S5_S3 /end COMPU_METHOD
/begin COMPU_METHOD Conv.cAzsKorgl._.f_schaltung_direkt_S5_S3 "Umrechnung fuer Messgroesse cAzsKorgl::f_schaltung_direkt" TAB_VERB "%4.0" "" COMPU_TAB_REF Conv.cAzsKorgl._.f_schaltung_direkt_S5_S3 /end COMPU_METHOD
/begin COMPU_METHOD Conv.cAzsKorgl._.f_stromlos_zzs_S5_S3 "Umrechnung fuer Messgroesse cAzsKorgl::f_stromlos_zzs" TAB_VERB "%4.0" "" COMPU_TAB_REF Conv.cAzsKorgl._.f_stromlos_zzs_S5_S3 /end COMPU_METHOD
/begin COMPU_METHOD Conv.cAzsKorgl._.parksperre_ziel_S5_S3 "Umrechnung fuer Messgroesse cAzsKorgl::parksperre_ziel" TAB_VERB "%4.0" "" COMPU_TAB_REF Conv.cAzsKorgl._.parksperre_ziel_S5_S3 /end COMPU_METHOD
/begin COMPU_METHOD Conv.cAzsKorgl._.pos_red_S5_S3 "Umrechnung fuer Messgroesse cAzsKorgl::pos_red" TAB_VERB "%4.0" "" COMPU_TAB_REF Conv.cAzsKorgl._.pos_red_S5_S3 /end COMPU_METHOD
/begin COMPU_METHOD Conv.cAzsKupMassnahmenKoord._.beeinfl_spont_index_S5_S3 "Umrechnung fuer Messgroesse cAzsKupMassnahmenKoord::beeinfl_spont_index" TAB_VERB "%4.0" "" COMPU_TAB_REF Conv.cAzsKupMassnahmenKoord._.beeinfl_spont_index_S5_S3 /end COMPU_METHOD
/begin COMPU_METHOD Conv.cAzsKupMassnahmenKoord._.reduzierung_m_mot_max_S5_S3 "Umrechnung fuer Messgroesse cAzsKupMassnahmenKoord::reduzierung_m_mot_max" TAB_VERB "%4.0" "" COMPU_TAB_REF Conv.cAzsKupMassnahmenKoord._.reduzierung_m_mot_max_S5_S3 /end COMPU_METHOD
/begin COMPU_METHOD Conv.cAzsKupMassnahmenKoord._.versch_schalt_verh_S5_S3 "Umrechnung fuer Messgroesse cAzsKupMassnahmenKoord::versch_schalt_verh" TAB_VERB "%4.0" "" COMPU_TAB_REF Conv.cAzsKupMassnahmenKoord._.versch_schalt_verh_S5_S3 /end COMPU_METHOD
/begin COMPU_METHOD Conv.cAzsKupMassnahmenKoord._.zustand_schaltungsverh_S5_S3 "Umrechnung fuer Messgroesse cAzsKupMassnahmenKoord::zustand_schaltungsverh" TAB_VERB "%4.0" "" COMPU_TAB_REF Conv.cAzsKupMassnahmenKoord._.zustand_schaltungsverh_S5_S3 /end COMPU_METHOD
/begin COMPU_METHOD Conv.cAzsNeutralEbene._.fkt_neutral_ebene_S5_S3 "Umrechnung fuer Messgroesse cAzsNeutralEbene::fkt_neutral_ebene" TAB_VERB "%4.0" "" COMPU_TAB_REF Conv.cAzsNeutralEbene._.fkt_neutral_ebene_S5_S3 /end COMPU_METHOD
/begin COMPU_METHOD Conv.cAzsNeutralEbene._.pos_neutral_n_stern_S5_S3 "Umrechnung fuer Messgroesse cAzsNeutralEbene::pos_neutral_n_stern" TAB_VERB "%4.0" "" COMPU_TAB_REF Conv.cAzsNeutralEbene._.pos_neutral_n_stern_S5_S3 /end COMPU_METHOD
/begin COMPU_METHOD Conv.cAzsNeutralEbene._.z_neutral_ebene_S5_S3 "Umrechnung fuer Messgroesse cAzsNeutralEbene::z_neutral_ebene" TAB_VERB "%4.0" "" COMPU_TAB_REF Conv.cAzsNeutralEbene._.z_neutral_ebene_S5_S3 /end COMPU_METHOD
/begin COMPU_METHOD Conv.cAzsSchluesselStart._.s_start_status_S5_S3 "Umrechnung fuer Messgroesse cAzsSchluesselStart::s_start_status" TAB_VERB "%4.0" "" COMPU_TAB_REF Conv.cAzsSchluesselStart._.s_start_status_S5_S3 /end COMPU_METHOD
/begin COMPU_METHOD Conv.cAzsSollgangMoeglich._.sollgang_moeglich_S5_S3 "Umrechnung fuer Messgroesse cAzsSollgangMoeglich::sollgang_moeglich" TAB_VERB "%4.0" "" COMPU_TAB_REF Conv.cAzsSollgangMoeglich._.sollgang_moeglich_S5_S3 /end COMPU_METHOD
/begin COMPU_METHOD Conv.cAzsSZPulsAda._.f_abbruch_pre_ada_azs_S5_S3 "Umrechnung fuer Messgroesse cAzsSZPulsAda::f_abbruch_pre_ada_azs" TAB_VERB "%4.0" "" COMPU_TAB_REF Conv.cAzsSZPulsAda._.f_abbruch_pre_ada_azs_S5_S3 /end COMPU_METHOD
/begin COMPU_METHOD Conv.cAzsSZPulsAda._.f_gang_vorgabe_S5_S3 "Umrechnung fuer Messgroesse cAzsSZPulsAda::f_gang_vorgabe" TAB_VERB "%4.0" "" COMPU_TAB_REF Conv.cAzsSZPulsAda._.f_gang_vorgabe_S5_S3 /end COMPU_METHOD
/begin COMPU_METHOD Conv.cAzsSZPulsAda._.f_neutral_vorgabe_S5_S3 "Umrechnung fuer Messgroesse cAzsSZPulsAda::f_neutral_vorgabe" TAB_VERB "%4.0" "" COMPU_TAB_REF Conv.cAzsSZPulsAda._.f_neutral_vorgabe_S5_S3 /end COMPU_METHOD
/begin COMPU_METHOD Conv.cAzsSZPulsAda._.f_sz_puls_ada_aktiv_S5_S3 "Umrechnung fuer Messgroesse cAzsSZPulsAda::f_sz_puls_ada_aktiv" TAB_VERB "%4.0" "" COMPU_TAB_REF Conv.cAzsSZPulsAda._.f_sz_puls_ada_aktiv_S5_S3 /end COMPU_METHOD
/begin COMPU_METHOD Conv.cAzsSZPulsAda._.sz_puls_ada_gang_S5_S3 "Umrechnung fuer Messgroesse cAzsSZPulsAda::sz_puls_ada_gang" TAB_VERB "%4.0" "" COMPU_TAB_REF Conv.cAzsSZPulsAda._.sz_puls_ada_gang_S5_S3 /end COMPU_METHOD
/begin COMPU_METHOD Conv.cAzsSZPulsAda._.z_sonder_zustand_puls_ada_S5_S3 "Umrechnung fuer Messgroesse cAzsSZPulsAda::z_sonder_zustand_puls_ada" TAB_VERB "%4.0" "" COMPU_TAB_REF Conv.cAzsSZPulsAda._.z_sonder_zustand_puls_ada_S5_S3 /end COMPU_METHOD
/begin COMPU_METHOD Conv.cAzsVorgabeGang._.f_abbruch_vorb_angefordert_S5_S3 "Umrechnung fuer Messgroesse cAzsVorgabeGang::f_abbruch_vorb_angefordert" TAB_VERB "%4.0" "" COMPU_TAB_REF Conv.cAzsVorgabeGang._.f_abbruch_vorb_angefordert_S5_S3 /end COMPU_METHOD
/begin COMPU_METHOD Conv.cAzsVorgabeGang._.f_schleppstart_erkannt_S5_S3 "Umrechnung fuer Messgroesse cAzsVorgabeGang::f_schleppstart_erkannt" TAB_VERB "%4.0" "" COMPU_TAB_REF Conv.cAzsVorgabeGang._.f_schleppstart_erkannt_S5_S3 /end COMPU_METHOD
/begin COMPU_METHOD Conv.cAzsVorgabeGang._.gang_schleppstart_S5_S3 "Umrechnung fuer Messgroesse cAzsVorgabeGang::gang_schleppstart" TAB_VERB "%4.0" "" COMPU_TAB_REF Conv.cAzsVorgabeGang._.gang_schleppstart_S5_S3 /end COMPU_METHOD
/begin COMPU_METHOD Conv.cAzsVorgabeGang._.vorgabegang_S5_S3 "Umrechnung fuer Messgroesse cAzsVorgabeGang::vorgabegang" TAB_VERB "%4.0" "" COMPU_TAB_REF Conv.cAzsVorgabeGang._.vorgabegang_S5_S3 /end COMPU_METHOD
/begin COMPU_METHOD Conv.cAzsZielgang._.f_schalt_abbruch_invers_S5_S3 "Umrechnung fuer Messgroesse cAzsZielgang::f_schalt_abbruch_invers" TAB_VERB "%4.0" "" COMPU_TAB_REF Conv.cAzsZielgang._.f_schalt_abbruch_invers_S5_S3 /end COMPU_METHOD
/begin COMPU_METHOD Conv.cAzsZielgang._.zielgang_S5_S3 "Umrechnung fuer Messgroesse cAzsZielgang::zielgang" TAB_VERB "%4.0" "" COMPU_TAB_REF Conv.cAzsZielgang._.zielgang_S5_S3 /end COMPU_METHOD
/begin COMPU_METHOD Conv.cAzsZielgangSas._.schaltart_S5_S3 "Umrechnung fuer Messgroesse cAzsZielgangSas::schaltart" TAB_VERB "%4.0" "" COMPU_TAB_REF Conv.cAzsZielgangSas._.schaltart_S5_S3 /end COMPU_METHOD
/begin COMPU_METHOD Conv.cAzsZielgangSas._.schaltinfo_S5_S3 "Umrechnung fuer Messgroesse cAzsZielgangSas::schaltinfo" TAB_VERB "%4.0" "" COMPU_TAB_REF Conv.cAzsZielgangSas._.schaltinfo_S5_S3 /end COMPU_METHOD
/begin COMPU_METHOD Conv.cAzsZielgangSas._.schaltung_S5_S3 "Umrechnung fuer Messgroesse cAzsZielgangSas::schaltung" TAB_VERB "%4.0" "" COMPU_TAB_REF Conv.cAzsZielgangSas._.schaltung_S5_S3 /end COMPU_METHOD
/begin COMPU_METHOD Conv.cAzsZielgangSas._.zielgang_sas_komp_S5_S3 "Umrechnung fuer Messgroesse cAzsZielgangSas::zielgang_sas_komp" TAB_VERB "%4.0" "" COMPU_TAB_REF Conv.cAzsZielgangSas._.zielgang_sas_komp_S5_S3 /end COMPU_METHOD
/begin COMPU_METHOD Conv.cAzsZielgangSas._.zielgang_sas_S5_S3 "Umrechnung fuer Messgroesse cAzsZielgangSas::zielgang_sas" TAB_VERB "%4.0" "" COMPU_TAB_REF Conv.cAzsZielgangSas._.zielgang_sas_S5_S3 /end COMPU_METHOD
/begin COMPU_METHOD Conv.cAzsZielgangSoll._.zielgang_soll_S5_S3 "Umrechnung fuer Messgroesse cAzsZielgangSoll::zielgang_soll" TAB_VERB "%4.0" "" COMPU_TAB_REF Conv.cAzsZielgangSoll._.zielgang_soll_S5_S3 /end COMPU_METHOD
/begin COMPU_METHOD Conv.cBibAglex._.f_nicht_berechnen_S5_S3 "Umrechnung fuer Messgroesse cBibAglex::f_nicht_berechnen" TAB_VERB "%4.0" "" COMPU_TAB_REF Conv.cBibAglex._.f_nicht_berechnen_S5_S3 /end COMPU_METHOD
/begin COMPU_METHOD Conv.cBibAglex._.func_agl_S5_S3 "Umrechnung fuer Messgroesse cBibAglex::func_agl" TAB_VERB "%4.0" "" COMPU_TAB_REF Conv.cBibAglex._.func_agl_S5_S3 /end COMPU_METHOD
/begin COMPU_METHOD Conv.cBibAglex._.signal_agl_S5_S3 "Umrechnung fuer Messgroesse cBibAglex::signal_agl" TAB_VERB "%4.0" "" COMPU_TAB_REF Conv.cBibAglex._.signal_agl_S5_S3 /end COMPU_METHOD
/begin COMPU_METHOD Conv.cBibAglex._.z_agl_S5_S3 "Umrechnung fuer Messgroesse cBibAglex::z_agl" TAB_VERB "%4.0" "" COMPU_TAB_REF Conv.cBibAglex._.z_agl_S5_S3 /end COMPU_METHOD
/begin COMPU_METHOD Conv.cBibAglex._.z_ringspeicher_S5_S3 "Umrechnung fuer Messgroesse cBibAglex::z_ringspeicher" TAB_VERB "%4.0" "" COMPU_TAB_REF Conv.cBibAglex._.z_ringspeicher_S5_S3 /end COMPU_METHOD
/begin COMPU_METHOD Conv.cBihMobef._.f_rganglimitaktiv_S5_S3 "Umrechnung fuer Messgroesse cBihMobef::f_rganglimitaktiv" TAB_VERB "%4.0" "" COMPU_TAB_REF Conv.cBihMobef._.f_rganglimitaktiv_S5_S3 /end COMPU_METHOD
/begin COMPU_METHOD Conv.cBihMobef._.fl_meschlupfaktiv_S5_S3 "Umrechnung fuer Messgroesse cBihMobef::fl_meschlupfaktiv" TAB_VERB "%4.0" "" COMPU_TAB_REF Conv.cBihMobef._.fl_meschlupfaktiv_S5_S3 /end COMPU_METHOD
/begin COMPU_METHOD Conv.cBihMobef._.flag_meschlupf_S5_S3 "Umrechnung fuer Messgroesse cBihMobef::flag_meschlupf" TAB_VERB "%4.0" "" COMPU_TAB_REF Conv.cBihMobef._.flag_meschlupf_S5_S3 /end COMPU_METHOD
/begin COMPU_METHOD Conv.cBihMobef._.z_m_motmax_kor_strang_S5_S3 "Umrechnung fuer Messgroesse cBihMobef::z_m_motmax_kor_strang" TAB_VERB "%4.0" "" COMPU_TAB_REF Conv.cBihMobef._.z_m_motmax_kor_strang_S5_S3 /end COMPU_METHOD
/begin COMPU_METHOD Conv.cBihMobef._.z_m_motmax_schlupf_S5_S3 "Umrechnung fuer Messgroesse cBihMobef::z_m_motmax_schlupf" TAB_VERB "%4.0" "" COMPU_TAB_REF Conv.cBihMobef._.z_m_motmax_schlupf_S5_S3 /end COMPU_METHOD
/begin COMPU_METHOD Conv.cBihMomen._.z_t_mverl_k0_S5_S3 "Umrechnung fuer Messgroesse cBihMomen::z_t_mverl_k0" TAB_VERB "%4.0" "" COMPU_TAB_REF Conv.cBihMomen._.z_t_mverl_k0_S5_S3 /end COMPU_METHOD
/begin COMPU_METHOD Conv.cBihPumpendruck._.f_evt_pumpendruck_motor_S5_S3 "Umrechnung fuer Messgroesse cBihPumpendruck::f_evt_pumpendruck_motor" TAB_VERB "%4.0" "" COMPU_TAB_REF Conv.cBihPumpendruck._.f_evt_pumpendruck_motor_S5_S3 /end COMPU_METHOD
/begin COMPU_METHOD Conv.cBihPumpendruck._.f_evt_pumpendruck_turbine_S5_S3 "Umrechnung fuer Messgroesse cBihPumpendruck::f_evt_pumpendruck_turbine" TAB_VERB "%4.0" "" COMPU_TAB_REF Conv.cBihPumpendruck._.f_evt_pumpendruck_turbine_S5_S3 /end COMPU_METHOD
/begin COMPU_METHOD Conv.cBihPumpendruck._.f_pumpendruck_motor_S5_S3 "Umrechnung fuer Messgroesse cBihPumpendruck::f_pumpendruck_motor" TAB_VERB "%4.0" "" COMPU_TAB_REF Conv.cBihPumpendruck._.f_pumpendruck_motor_S5_S3 /end COMPU_METHOD
/begin COMPU_METHOD Conv.cBihPumpendruck._.f_sfkt_pumpendruck_aktiv_S5_S3 "Umrechnung fuer Messgroesse cBihPumpendruck::f_sfkt_pumpendruck_aktiv" TAB_VERB "%4.0" "" COMPU_TAB_REF Conv.cBihPumpendruck._.f_sfkt_pumpendruck_aktiv_S5_S3 /end COMPU_METHOD
/begin COMPU_METHOD Conv.cBihPumpendruck._.z_pumpendruck_S5_S3 "Umrechnung fuer Messgroesse cBihPumpendruck::z_pumpendruck" TAB_VERB "%4.0" "" COMPU_TAB_REF Conv.cBihPumpendruck._.z_pumpendruck_S5_S3 /end COMPU_METHOD
/begin COMPU_METHOD Conv.cBihSigna._.bremsbed_ofstb_S5_S3 "Umrechnung fuer Messgroesse cBihSigna::bremsbed_ofstb" TAB_VERB "%4.0" "" COMPU_TAB_REF Conv.cBihSigna._.bremsbed_ofstb_S5_S3 /end COMPU_METHOD
/begin COMPU_METHOD Conv.cBihSigna._.bremsbed_S5_S3 "Umrechnung fuer Messgroesse cBihSigna::bremsbed" TAB_VERB "%4.0" "" COMPU_TAB_REF Conv.cBihSigna._.bremsbed_S5_S3 /end COMPU_METHOD
/begin COMPU_METHOD Conv.cDiaRbmif._.flag_rbm_zust_hanfahr_iae_S5_S3 "Umrechnung fuer Messgroesse cDiaRbmif::flag_rbm_zust_hanfahr_iae" TAB_VERB "%4.0" "" COMPU_TAB_REF Conv.cDiaRbmif._.flag_rbm_zust_hanfahr_iae_S5_S3 /end COMPU_METHOD
/begin COMPU_METHOD Conv.cDiaRbmif._.flag_rbm_zust_inaktiv_iae_S5_S3 "Umrechnung fuer Messgroesse cDiaRbmif::flag_rbm_zust_inaktiv_iae" TAB_VERB "%4.0" "" COMPU_TAB_REF Conv.cDiaRbmif._.flag_rbm_zust_inaktiv_iae_S5_S3 /end COMPU_METHOD
/begin COMPU_METHOD Conv.cDiaRbmif._.flag_rbm_zustand_posn_S5_S3 "Umrechnung fuer Messgroesse cDiaRbmif::flag_rbm_zustand_posn" TAB_VERB "%4.0" "" COMPU_TAB_REF Conv.cDiaRbmif._.flag_rbm_zustand_posn_S5_S3 /end COMPU_METHOD
/begin COMPU_METHOD Conv.cDiaRbmif._.flag_rbm_zustand_uwigkup_S5_S3 "Umrechnung fuer Messgroesse cDiaRbmif::flag_rbm_zustand_uwigkup" TAB_VERB "%4.0" "" COMPU_TAB_REF Conv.cDiaRbmif._.flag_rbm_zustand_uwigkup_S5_S3 /end COMPU_METHOD
/begin COMPU_METHOD Conv.cDiaRbmif._.flag_rbm_zustand_uwigschalt_S5_S3 "Umrechnung fuer Messgroesse cDiaRbmif::flag_rbm_zustand_uwigschalt" TAB_VERB "%4.0" "" COMPU_TAB_REF Conv.cDiaRbmif._.flag_rbm_zustand_uwigschalt_S5_S3 /end COMPU_METHOD
/begin COMPU_METHOD Conv.cDiaRbmif._.rbm_istgang_vorw_alt_S5_S3 "Umrechnung fuer Messgroesse cDiaRbmif::rbm_istgang_vorw_alt" TAB_VERB "%4.0" "" COMPU_TAB_REF Conv.cDiaRbmif._.rbm_istgang_vorw_alt_S5_S3 /end COMPU_METHOD
/begin COMPU_METHOD Conv.cDiaRbmif._.rbm_zielgang_sas_vorw_alt_S5_S3 "Umrechnung fuer Messgroesse cDiaRbmif::rbm_zielgang_sas_vorw_alt" TAB_VERB "%4.0" "" COMPU_TAB_REF Conv.cDiaRbmif._.rbm_zielgang_sas_vorw_alt_S5_S3 /end COMPU_METHOD
/begin COMPU_METHOD Conv.cIaeAdauf._.kfl_ziel_start_uefiea_S5_S3 "Umrechnung fuer Messgroesse cIaeAdauf::kfl_ziel_start_uefiea" TAB_VERB "%4.0" "" COMPU_TAB_REF Conv.cIaeAdauf._.kfl_ziel_start_uefiea_S5_S3 /end COMPU_METHOD
/begin COMPU_METHOD Conv.cIaeAdauf._.z_ada_uefiae_S5_S3 "Umrechnung fuer Messgroesse cIaeAdauf::z_ada_uefiae" TAB_VERB "%4.0" "" COMPU_TAB_REF Conv.cIaeAdauf._.z_ada_uefiae_S5_S3 /end COMPU_METHOD
/begin COMPU_METHOD Conv.cIaeAdauf._.zielgang_start_uefiae_S5_S3 "Umrechnung fuer Messgroesse cIaeAdauf::zielgang_start_uefiae" TAB_VERB "%4.0" "" COMPU_TAB_REF Conv.cIaeAdauf._.zielgang_start_uefiae_S5_S3 /end COMPU_METHOD
/begin COMPU_METHOD Conv.cIaeDiagn._.flag_close_bew_aktiv_diagiae_S5_S3 "Umrechnung fuer Messgroesse cIaeDiagn::flag_close_bew_aktiv_diagiae" TAB_VERB "%4.0" "" COMPU_TAB_REF Conv.cIaeDiagn._.flag_close_bew_aktiv_diagiae_S5_S3 /end COMPU_METHOD
/begin COMPU_METHOD Conv.cIaeDiagn._.flag_close_diagiae_S5_S3 "Umrechnung fuer Messgroesse cIaeDiagn::flag_close_diagiae" TAB_VERB "%4.0" "" COMPU_TAB_REF Conv.cIaeDiagn._.flag_close_diagiae_S5_S3 /end COMPU_METHOD
/begin COMPU_METHOD Conv.cIaeDiagn._.flag_hot_diagiae_S5_S3 "Umrechnung fuer Messgroesse cIaeDiagn::flag_hot_diagiae" TAB_VERB "%4.0" "" COMPU_TAB_REF Conv.cIaeDiagn._.flag_hot_diagiae_S5_S3 /end COMPU_METHOD
/begin COMPU_METHOD Conv.cIaeDiagn._.flag_max_p_haupt_diagiae_S5_S3 "Umrechnung fuer Messgroesse cIaeDiagn::flag_max_p_haupt_diagiae" TAB_VERB "%4.0" "" COMPU_TAB_REF Conv.cIaeDiagn._.flag_max_p_haupt_diagiae_S5_S3 /end COMPU_METHOD
/begin COMPU_METHOD Conv.cIaeDiagn._.flag_mmot_gespeichert_diagiae_S5_S3 "Umrechnung fuer Messgroesse cIaeDiagn::flag_mmot_gespeichert_diagiae" TAB_VERB "%4.0" "" COMPU_TAB_REF Conv.cIaeDiagn._.flag_mmot_gespeichert_diagiae_S5_S3 /end COMPU_METHOD
/begin COMPU_METHOD Conv.cIaeDiagn._.flag_noclose_bew_aktiv_diagiae_S5_S3 "Umrechnung fuer Messgroesse cIaeDiagn::flag_noclose_bew_aktiv_diagiae" TAB_VERB "%4.0" "" COMPU_TAB_REF Conv.cIaeDiagn._.flag_noclose_bew_aktiv_diagiae_S5_S3 /end COMPU_METHOD
/begin COMPU_METHOD Conv.cIaeDiagn._.flag_noclose_diagiae_S5_S3 "Umrechnung fuer Messgroesse cIaeDiagn::flag_noclose_diagiae" TAB_VERB "%4.0" "" COMPU_TAB_REF Conv.cIaeDiagn._.flag_noclose_diagiae_S5_S3 /end COMPU_METHOD
/begin COMPU_METHOD Conv.cIaeDiagn._.flag_noclose_hogez_diagiae_S5_S3 "Umrechnung fuer Messgroesse cIaeDiagn::flag_noclose_hogez_diagiae" TAB_VERB "%4.0" "" COMPU_TAB_REF Conv.cIaeDiagn._.flag_noclose_hogez_diagiae_S5_S3 /end COMPU_METHOD
/begin COMPU_METHOD Conv.cIaeDiagn._.flag_noopen_bew_aktiv_diagiae_S5_S3 "Umrechnung fuer Messgroesse cIaeDiagn::flag_noopen_bew_aktiv_diagiae" TAB_VERB "%4.0" "" COMPU_TAB_REF Conv.cIaeDiagn._.flag_noopen_bew_aktiv_diagiae_S5_S3 /end COMPU_METHOD
/begin COMPU_METHOD Conv.cIaeDiagn._.flag_noopen_diagiae_S5_S3 "Umrechnung fuer Messgroesse cIaeDiagn::flag_noopen_diagiae" TAB_VERB "%4.0" "" COMPU_TAB_REF Conv.cIaeDiagn._.flag_noopen_diagiae_S5_S3 /end COMPU_METHOD
/begin COMPU_METHOD Conv.cIaeDiagn._.flag_rueckf_mmot_diagiae_S5_S3 "Umrechnung fuer Messgroesse cIaeDiagn::flag_rueckf_mmot_diagiae" TAB_VERB "%4.0" "" COMPU_TAB_REF Conv.cIaeDiagn._.flag_rueckf_mmot_diagiae_S5_S3 /end COMPU_METHOD
/begin COMPU_METHOD Conv.cIaeDiagn._.flag_rueckf_msollnmot_diagiae_S5_S3 "Umrechnung fuer Messgroesse cIaeDiagn::flag_rueckf_msollnmot_diagiae" TAB_VERB "%4.0" "" COMPU_TAB_REF Conv.cIaeDiagn._.flag_rueckf_msollnmot_diagiae_S5_S3 /end COMPU_METHOD
/begin COMPU_METHOD Conv.cIaeDiagn._.flag_sammelbed_diagiae_S5_S3 "Umrechnung fuer Messgroesse cIaeDiagn::flag_sammelbed_diagiae" TAB_VERB "%4.0" "" COMPU_TAB_REF Conv.cIaeDiagn._.flag_sammelbed_diagiae_S5_S3 /end COMPU_METHOD
/begin COMPU_METHOD Conv.cIaeDiagn._.flag_spassfahrt_diagiae_S5_S3 "Umrechnung fuer Messgroesse cIaeDiagn::flag_spassfahrt_diagiae" TAB_VERB "%4.0" "" COMPU_TAB_REF Conv.cIaeDiagn._.flag_spassfahrt_diagiae_S5_S3 /end COMPU_METHOD
/begin COMPU_METHOD Conv.cIaeDiagn._.flag_timer_hot_diagiae_S5_S3 "Umrechnung fuer Messgroesse cIaeDiagn::flag_timer_hot_diagiae" TAB_VERB "%4.0" "" COMPU_TAB_REF Conv.cIaeDiagn._.flag_timer_hot_diagiae_S5_S3 /end COMPU_METHOD
/begin COMPU_METHOD Conv.cIaeDiagn._.status_iae_hotinfo_S5_S3 "Umrechnung fuer Messgroesse cIaeDiagn::status_iae_hotinfo" TAB_VERB "%4.0" "" COMPU_TAB_REF Conv.cIaeDiagn._.status_iae_hotinfo_S5_S3 /end COMPU_METHOD
/begin COMPU_METHOD Conv.cIaeDiagn._.z_close_diagiae_S5_S3 "Umrechnung fuer Messgroesse cIaeDiagn::z_close_diagiae" TAB_VERB "%4.0" "" COMPU_TAB_REF Conv.cIaeDiagn._.z_close_diagiae_S5_S3 /end COMPU_METHOD
/begin COMPU_METHOD Conv.cIaeDraus._.f_hysschleife_aktiv_iae_S5_S3 "Umrechnung fuer Messgroesse cIaeDraus::f_hysschleife_aktiv_iae" TAB_VERB "%4.0" "" COMPU_TAB_REF Conv.cIaeDraus._.f_hysschleife_aktiv_iae_S5_S3 /end COMPU_METHOD
/begin COMPU_METHOD Conv.cIaeDraus._.f_hysschleife_moeglich_iae_S5_S3 "Umrechnung fuer Messgroesse cIaeDraus::f_hysschleife_moeglich_iae" TAB_VERB "%4.0" "" COMPU_TAB_REF Conv.cIaeDraus._.f_hysschleife_moeglich_iae_S5_S3 /end COMPU_METHOD
/begin COMPU_METHOD Conv.cIaeDraus._.flag_init_ausinaktiv_iae_S5_S3 "Umrechnung fuer Messgroesse cIaeDraus::flag_init_ausinaktiv_iae" TAB_VERB "%4.0" "" COMPU_TAB_REF Conv.cIaeDraus._.flag_init_ausinaktiv_iae_S5_S3 /end COMPU_METHOD
/begin COMPU_METHOD Conv.cIaeDraus._.flag_m_max_alt_S5_S3 "Umrechnung fuer Messgroesse cIaeDraus::flag_m_max_alt" TAB_VERB "%4.0" "" COMPU_TAB_REF Conv.cIaeDraus._.flag_m_max_alt_S5_S3 /end COMPU_METHOD
/begin COMPU_METHOD Conv.cIaeDraus._.flag_po_dyn_aktiv_iae_S5_S3 "Umrechnung fuer Messgroesse cIaeDraus::flag_po_dyn_aktiv_iae" TAB_VERB "%4.0" "" COMPU_TAB_REF Conv.cIaeDraus._.flag_po_dyn_aktiv_iae_S5_S3 /end COMPU_METHOD
/begin COMPU_METHOD Conv.cIaeDraus._.z_hyskompstillunten_iae_S5_S3 "Umrechnung fuer Messgroesse cIaeDraus::z_hyskompstillunten_iae" TAB_VERB "%4.0" "" COMPU_TAB_REF Conv.cIaeDraus._.z_hyskompstillunten_iae_S5_S3 /end COMPU_METHOD
/begin COMPU_METHOD Conv.cIaeKordi._.f_torqfuse_iae_S5_S3 "Umrechnung fuer Messgroesse cIaeKordi::f_torqfuse_iae" TAB_VERB "%4.0" "" COMPU_TAB_REF Conv.cIaeKordi._.f_torqfuse_iae_S5_S3 /end COMPU_METHOD
/begin COMPU_METHOD Conv.cIaeKordi._.flag_zu_gewesen_iae_S5_S3 "Umrechnung fuer Messgroesse cIaeKordi::flag_zu_gewesen_iae" TAB_VERB "%4.0" "" COMPU_TAB_REF Conv.cIaeKordi._.flag_zu_gewesen_iae_S5_S3 /end COMPU_METHOD
/begin COMPU_METHOD Conv.cIaeKordi._.kup_status_iae_S5_S3 "Umrechnung fuer Messgroesse cIaeKordi::kup_status_iae" TAB_VERB "%4.0" "" COMPU_TAB_REF Conv.cIaeKordi._.kup_status_iae_S5_S3 /end COMPU_METHOD
/begin COMPU_METHOD Conv.cIaeKordi._.z_iae_S5_S3 "Umrechnung fuer Messgroesse cIaeKordi::z_iae" TAB_VERB "%4.0" "" COMPU_TAB_REF Conv.cIaeKordi._.z_iae_S5_S3 /end COMPU_METHOD
/begin COMPU_METHOD Conv.cIaeKordi._.z_iae_temp_S5_S3 "Umrechnung fuer Messgroesse cIaeKordi::z_iae_temp" TAB_VERB "%4.0" "" COMPU_TAB_REF Conv.cIaeKordi._.z_iae_temp_S5_S3 /end COMPU_METHOD
/begin COMPU_METHOD Conv.cIaeMomen._.flag_first_reglerinit_iae_S5_S3 "Umrechnung fuer Messgroesse cIaeMomen::flag_first_reglerinit_iae" TAB_VERB "%4.0" "" COMPU_TAB_REF Conv.cIaeMomen._.flag_first_reglerinit_iae_S5_S3 /end COMPU_METHOD
/begin COMPU_METHOD Conv.cIaeMomen._.flag_initmistvorst_iae_S5_S3 "Umrechnung fuer Messgroesse cIaeMomen::flag_initmistvorst_iae" TAB_VERB "%4.0" "" COMPU_TAB_REF Conv.cIaeMomen._.flag_initmistvorst_iae_S5_S3 /end COMPU_METHOD
/begin COMPU_METHOD Conv.cIaeMomen._.flag_initsollanfahr_iae_S5_S3 "Umrechnung fuer Messgroesse cIaeMomen::flag_initsollanfahr_iae" TAB_VERB "%4.0" "" COMPU_TAB_REF Conv.cIaeMomen._.flag_initsollanfahr_iae_S5_S3 /end COMPU_METHOD
/begin COMPU_METHOD Conv.cIaeMomen._.flag_kaltanfahren_aktiv_iae_S5_S3 "Umrechnung fuer Messgroesse cIaeMomen::flag_kaltanfahren_aktiv_iae" TAB_VERB "%4.0" "" COMPU_TAB_REF Conv.cIaeMomen._.flag_kaltanfahren_aktiv_iae_S5_S3 /end COMPU_METHOD
/begin COMPU_METHOD Conv.cIaeMomen._.flag_mvorberechnug_aktiv_iae_S5_S3 "Umrechnung fuer Messgroesse cIaeMomen::flag_mvorberechnug_aktiv_iae" TAB_VERB "%4.0" "" COMPU_TAB_REF Conv.cIaeMomen._.flag_mvorberechnug_aktiv_iae_S5_S3 /end COMPU_METHOD
/begin COMPU_METHOD Conv.cIaeMomen._.flag_nsmotmaxc_iae_S5_S3 "Umrechnung fuer Messgroesse cIaeMomen::flag_nsmotmaxc_iae" TAB_VERB "%4.0" "" COMPU_TAB_REF Conv.cIaeMomen._.flag_nsmotmaxc_iae_S5_S3 /end COMPU_METHOD
/begin COMPU_METHOD Conv.cIaeMomen._.flag_pulscue_aktiv_iae_S5_S3 "Umrechnung fuer Messgroesse cIaeMomen::flag_pulscue_aktiv_iae" TAB_VERB "%4.0" "" COMPU_TAB_REF Conv.cIaeMomen._.flag_pulscue_aktiv_iae_S5_S3 /end COMPU_METHOD
/begin COMPU_METHOD Conv.cIaeMomen._.flag_regler_aktiv_S5_S3 "Umrechnung fuer Messgroesse cIaeMomen::flag_regler_aktiv" TAB_VERB "%4.0" "" COMPU_TAB_REF Conv.cIaeMomen._.flag_regler_aktiv_S5_S3 /end COMPU_METHOD
/begin COMPU_METHOD Conv.cIaeMomen._.flag_schaltung_aktiv_iae_S5_S3 "Umrechnung fuer Messgroesse cIaeMomen::flag_schaltung_aktiv_iae" TAB_VERB "%4.0" "" COMPU_TAB_REF Conv.cIaeMomen._.flag_schaltung_aktiv_iae_S5_S3 /end COMPU_METHOD
/begin COMPU_METHOD Conv.cIaeMomen._.flag_schrittschaltung_iae_S5_S3 "Umrechnung fuer Messgroesse cIaeMomen::flag_schrittschaltung_iae" TAB_VERB "%4.0" "" COMPU_TAB_REF Conv.cIaeMomen._.flag_schrittschaltung_iae_S5_S3 /end COMPU_METHOD
/begin COMPU_METHOD Conv.cIaeMomen._.flag_t_ueffix_iae_S5_S3 "Umrechnung fuer Messgroesse cIaeMomen::flag_t_ueffix_iae" TAB_VERB "%4.0" "" COMPU_TAB_REF Conv.cIaeMomen._.flag_t_ueffix_iae_S5_S3 /end COMPU_METHOD
/begin COMPU_METHOD Conv.cIaeMomen._.flag_ueflaeuft_iae_S5_S3 "Umrechnung fuer Messgroesse cIaeMomen::flag_ueflaeuft_iae" TAB_VERB "%4.0" "" COMPU_TAB_REF Conv.cIaeMomen._.flag_ueflaeuft_iae_S5_S3 /end COMPU_METHOD
/begin COMPU_METHOD Conv.cIaeMomen._.flag_zu_erreicht_iae_S5_S3 "Umrechnung fuer Messgroesse cIaeMomen::flag_zu_erreicht_iae" TAB_VERB "%4.0" "" COMPU_TAB_REF Conv.cIaeMomen._.flag_zu_erreicht_iae_S5_S3 /end COMPU_METHOD
/begin COMPU_METHOD Conv.cIaeMomen._.kfl_ziel_tmp_iae_S5_S3 "Umrechnung fuer Messgroesse cIaeMomen::kfl_ziel_tmp_iae" TAB_VERB "%4.0" "" COMPU_TAB_REF Conv.cIaeMomen._.kfl_ziel_tmp_iae_S5_S3 /end COMPU_METHOD
/begin COMPU_METHOD Conv.cIaeMomen._.st_anfagradbegrenz_iae_S5_S3 "Umrechnung fuer Messgroesse cIaeMomen::st_anfagradbegrenz_iae" TAB_VERB "%4.0" "" COMPU_TAB_REF Conv.cIaeMomen._.st_anfagradbegrenz_iae_S5_S3 /end COMPU_METHOD
/begin COMPU_METHOD Conv.cIaeMomen._.status_uef_zu_kriech_init_iae_S5_S3 "Umrechnung fuer Messgroesse cIaeMomen::status_uef_zu_kriech_init_iae" TAB_VERB "%4.0" "" COMPU_TAB_REF Conv.cIaeMomen._.status_uef_zu_kriech_init_iae_S5_S3 /end COMPU_METHOD
/begin COMPU_METHOD Conv.cIaeMomen._.typ_uef_m_S5_S3 "Umrechnung fuer Messgroesse cIaeMomen::typ_uef_m" TAB_VERB "%4.0" "" COMPU_TAB_REF Conv.cIaeMomen._.typ_uef_m_S5_S3 /end COMPU_METHOD
/begin COMPU_METHOD Conv.cIaeMomen._.typ_uef_miaeaufanf_iae_S5_S3 "Umrechnung fuer Messgroesse cIaeMomen::typ_uef_miaeaufanf_iae" TAB_VERB "%4.0" "" COMPU_TAB_REF Conv.cIaeMomen._.typ_uef_miaeaufanf_iae_S5_S3 /end COMPU_METHOD
/begin COMPU_METHOD Conv.cIaeMomen._.z_mo_kriech_aktiv_iae_S5_S3 "Umrechnung fuer Messgroesse cIaeMomen::z_mo_kriech_aktiv_iae" TAB_VERB "%4.0" "" COMPU_TAB_REF Conv.cIaeMomen._.z_mo_kriech_aktiv_iae_S5_S3 /end COMPU_METHOD
/begin COMPU_METHOD Conv.cIaeMomen._.z_modusiae_temp_S5_S3 "Umrechnung fuer Messgroesse cIaeMomen::z_modusiae_temp" TAB_VERB "%4.0" "" COMPU_TAB_REF Conv.cIaeMomen._.z_modusiae_temp_S5_S3 /end COMPU_METHOD
/begin COMPU_METHOD Conv.cIaeMomen._.z_rampe_miaeauf_S5_S3 "Umrechnung fuer Messgroesse cIaeMomen::z_rampe_miaeauf" TAB_VERB "%4.0" "" COMPU_TAB_REF Conv.cIaeMomen._.z_rampe_miaeauf_S5_S3 /end COMPU_METHOD
/begin COMPU_METHOD Conv.cIaeMotmx._.flag_motmaxndiff_iae_S5_S3 "Umrechnung fuer Messgroesse cIaeMotmx::flag_motmaxndiff_iae" TAB_VERB "%4.0" "" COMPU_TAB_REF Conv.cIaeMotmx._.flag_motmaxndiff_iae_S5_S3 /end COMPU_METHOD
/begin COMPU_METHOD Conv.cIaeMotmx._.flag_motmaxregdiff_iae_S5_S3 "Umrechnung fuer Messgroesse cIaeMotmx::flag_motmaxregdiff_iae" TAB_VERB "%4.0" "" COMPU_TAB_REF Conv.cIaeMotmx._.flag_motmaxregdiff_iae_S5_S3 /end COMPU_METHOD
/begin COMPU_METHOD Conv.cIaeMotmx._.flag_motmaxstall_iae_S5_S3 "Umrechnung fuer Messgroesse cIaeMotmx::flag_motmaxstall_iae" TAB_VERB "%4.0" "" COMPU_TAB_REF Conv.cIaeMotmx._.flag_motmaxstall_iae_S5_S3 /end COMPU_METHOD
/begin COMPU_METHOD Conv.cIaeMotmx._.flag_motmaxtemp_iae_S5_S3 "Umrechnung fuer Messgroesse cIaeMotmx::flag_motmaxtemp_iae" TAB_VERB "%4.0" "" COMPU_TAB_REF Conv.cIaeMotmx._.flag_motmaxtemp_iae_S5_S3 /end COMPU_METHOD
/begin COMPU_METHOD Conv.cIaeMotmx._.flag_stallspeed_iae_S5_S3 "Umrechnung fuer Messgroesse cIaeMotmx::flag_stallspeed_iae" TAB_VERB "%4.0" "" COMPU_TAB_REF Conv.cIaeMotmx._.flag_stallspeed_iae_S5_S3 /end COMPU_METHOD
/begin COMPU_METHOD Conv.cIaeSigna._.asr_regelt_iae_S5_S3 "Umrechnung fuer Messgroesse cIaeSigna::asr_regelt_iae" TAB_VERB "%4.0" "" COMPU_TAB_REF Conv.cIaeSigna._.asr_regelt_iae_S5_S3 /end COMPU_METHOD
/begin COMPU_METHOD Conv.cIaeSigna._.flag_init_signa_iae_S5_S3 "Umrechnung fuer Messgroesse cIaeSigna::flag_init_signa_iae" TAB_VERB "%4.0" "" COMPU_TAB_REF Conv.cIaeSigna._.flag_init_signa_iae_S5_S3 /end COMPU_METHOD
/begin COMPU_METHOD Conv.cIaeSigna._.flag_mreibzumstell_iae_S5_S3 "Umrechnung fuer Messgroesse cIaeSigna::flag_mreibzumstell_iae" TAB_VERB "%4.0" "" COMPU_TAB_REF Conv.cIaeSigna._.flag_mreibzumstell_iae_S5_S3 /end COMPU_METHOD
/begin COMPU_METHOD Conv.cIaeSigna._.kfl_sollneutral_iae_S5_S3 "Umrechnung fuer Messgroesse cIaeSigna::kfl_sollneutral_iae" TAB_VERB "%4.0" "" COMPU_TAB_REF Conv.cIaeSigna._.kfl_sollneutral_iae_S5_S3 /end COMPU_METHOD
/begin COMPU_METHOD Conv.cIaeSigna._.n_ab_dir_iae_S5_S3 "Umrechnung fuer Messgroesse cIaeSigna::n_ab_dir_iae" TAB_VERB "%4.0" "" COMPU_TAB_REF Conv.cIaeSigna._.n_ab_dir_iae_S5_S3 /end COMPU_METHOD
/begin COMPU_METHOD Conv.cIaeSigna._.z_nmotll_aktiv_iae_S5_S3 "Umrechnung fuer Messgroesse cIaeSigna::z_nmotll_aktiv_iae" TAB_VERB "%4.0" "" COMPU_TAB_REF Conv.cIaeSigna._.z_nmotll_aktiv_iae_S5_S3 /end COMPU_METHOD
/begin COMPU_METHOD Conv.cIaeTempm._.flag_tempsperr_timerini_iae_S5_S3 "Umrechnung fuer Messgroesse cIaeTempm::flag_tempsperr_timerini_iae" TAB_VERB "%4.0" "" COMPU_TAB_REF Conv.cIaeTempm._.flag_tempsperr_timerini_iae_S5_S3 /end COMPU_METHOD
/begin COMPU_METHOD Conv.cIaeTempm._.z_temp_init_iae_S5_S3 "Umrechnung fuer Messgroesse cIaeTempm::z_temp_init_iae" TAB_VERB "%4.0" "" COMPU_TAB_REF Conv.cIaeTempm._.z_temp_init_iae_S5_S3 /end COMPU_METHOD
/begin COMPU_METHOD Conv.cIepBerLp._.f_has_aktiv_iep_S5_S3 "Umrechnung fuer Messgroesse cIepBerLp::f_has_aktiv_iep" TAB_VERB "%4.0" "" COMPU_TAB_REF Conv.cIepBerLp._.f_has_aktiv_iep_S5_S3 /end COMPU_METHOD
/begin COMPU_METHOD Conv.cIepBerLp._.f_iep_ext_S5_S3 "Umrechnung fuer Messgroesse cIepBerLp::f_iep_ext" TAB_VERB "%4.0" "" COMPU_TAB_REF Conv.cIepBerLp._.f_iep_ext_S5_S3 /end COMPU_METHOD
/begin COMPU_METHOD Conv.cIepBerLp._.f_iep_has_S5_S3 "Umrechnung fuer Messgroesse cIepBerLp::f_iep_has" TAB_VERB "%4.0" "" COMPU_TAB_REF Conv.cIepBerLp._.f_iep_has_S5_S3 /end COMPU_METHOD
/begin COMPU_METHOD Conv.cIepBerLp._.f_iep_sab_S5_S3 "Umrechnung fuer Messgroesse cIepBerLp::f_iep_sab" TAB_VERB "%4.0" "" COMPU_TAB_REF Conv.cIepBerLp._.f_iep_sab_S5_S3 /end COMPU_METHOD
/begin COMPU_METHOD Conv.cIepBerLp._.f_iep_tes_S5_S3 "Umrechnung fuer Messgroesse cIepBerLp::f_iep_tes" TAB_VERB "%4.0" "" COMPU_TAB_REF Conv.cIepBerLp._.f_iep_tes_S5_S3 /end COMPU_METHOD
/begin COMPU_METHOD Conv.cIepBerLp._.f_kmn_enpg_S5_S3 "Umrechnung fuer Messgroesse cIepBerLp::f_kmn_enpg" TAB_VERB "%4.0" "" COMPU_TAB_REF Conv.cIepBerLp._.f_kmn_enpg_S5_S3 /end COMPU_METHOD
/begin COMPU_METHOD Conv.cIepBerLp._.f_nmin_iep_S5_S3 "Umrechnung fuer Messgroesse cIepBerLp::f_nmin_iep" TAB_VERB "%4.0" "" COMPU_TAB_REF Conv.cIepBerLp._.f_nmin_iep_S5_S3 /end COMPU_METHOD
/begin COMPU_METHOD Conv.cIepBerLp._.f_senken_LP3_iep_S5_S3 "Umrechnung fuer Messgroesse cIepBerLp::f_senken_LP3_iep" TAB_VERB "%4.0" "" COMPU_TAB_REF Conv.cIepBerLp._.f_senken_LP3_iep_S5_S3 /end COMPU_METHOD
/begin COMPU_METHOD Conv.cIepBerLp._.iep_soll_ext_intern_S5_S3 "Umrechnung fuer Messgroesse cIepBerLp::iep_soll_ext_intern" TAB_VERB "%4.0" "" COMPU_TAB_REF Conv.cIepBerLp._.iep_soll_ext_intern_S5_S3 /end COMPU_METHOD
/begin COMPU_METHOD Conv.cIepBerLp._.iep_soll_ext_S5_S3 "Umrechnung fuer Messgroesse cIepBerLp::iep_soll_ext" TAB_VERB "%4.0" "" COMPU_TAB_REF Conv.cIepBerLp._.iep_soll_ext_S5_S3 /end COMPU_METHOD
/begin COMPU_METHOD Conv.cIepBerLp._.iep_soll_intern_S5_S3 "Umrechnung fuer Messgroesse cIepBerLp::iep_soll_intern" TAB_VERB "%4.0" "" COMPU_TAB_REF Conv.cIepBerLp._.iep_soll_intern_S5_S3 /end COMPU_METHOD
/begin COMPU_METHOD Conv.cIepBerLp._.iep_soll_S5_S3 "Umrechnung fuer Messgroesse cIepBerLp::iep_soll" TAB_VERB "%4.0" "" COMPU_TAB_REF Conv.cIepBerLp._.iep_soll_S5_S3 /end COMPU_METHOD
/begin COMPU_METHOD Conv.cIepBerLp._.schaltung_iep_S5_S3 "Umrechnung fuer Messgroesse cIepBerLp::schaltung_iep" TAB_VERB "%4.0" "" COMPU_TAB_REF Conv.cIepBerLp._.schaltung_iep_S5_S3 /end COMPU_METHOD
/begin COMPU_METHOD Conv.cIepBerLp._.z_nmin_iep_S5_S3 "Umrechnung fuer Messgroesse cIepBerLp::z_nmin_iep" TAB_VERB "%4.0" "" COMPU_TAB_REF Conv.cIepBerLp._.z_nmin_iep_S5_S3 /end COMPU_METHOD
/begin COMPU_METHOD Conv.cIepBerLp._.z_senken_lp3_S5_S3 "Umrechnung fuer Messgroesse cIepBerLp::z_senken_lp3" TAB_VERB "%4.0" "" COMPU_TAB_REF Conv.cIepBerLp._.z_senken_lp3_S5_S3 /end COMPU_METHOD
/begin COMPU_METHOD Conv.cIepKordi._.bed_in_fehler_S5_S3 "Umrechnung fuer Messgroesse cIepKordi::bed_in_fehler" TAB_VERB "%4.0" "" COMPU_TAB_REF Conv.cIepKordi._.bed_in_fehler_S5_S3 /end COMPU_METHOD
/begin COMPU_METHOD Conv.cIepKordi._.elektrisch_pumpe_laeuft_S5_S3 "Umrechnung fuer Messgroesse cIepKordi::elektrisch_pumpe_laeuft" TAB_VERB "%4.0" "" COMPU_TAB_REF Conv.cIepKordi._.elektrisch_pumpe_laeuft_S5_S3 /end COMPU_METHOD
/begin COMPU_METHOD Conv.cIepKordi._.fehler_iep_S5_S3 "Umrechnung fuer Messgroesse cIepKordi::fehler_iep" TAB_VERB "%4.0" "" COMPU_TAB_REF Conv.cIepKordi._.fehler_iep_S5_S3 /end COMPU_METHOD
/begin COMPU_METHOD Conv.cIepKordi._.iep_ist_manuell_S5_S3 "Umrechnung fuer Messgroesse cIepKordi::iep_ist_manuell" TAB_VERB "%4.0" "" COMPU_TAB_REF Conv.cIepKordi._.iep_ist_manuell_S5_S3 /end COMPU_METHOD
/begin COMPU_METHOD Conv.cIepKordi._.iep_ist_S5_S3 "Umrechnung fuer Messgroesse cIepKordi::iep_ist" TAB_VERB "%4.0" "" COMPU_TAB_REF Conv.cIepKordi._.iep_ist_S5_S3 /end COMPU_METHOD
/begin COMPU_METHOD Conv.cIepKordi._.zustand_iep_S5_S3 "Umrechnung fuer Messgroesse cIepKordi::zustand_iep" TAB_VERB "%4.0" "" COMPU_TAB_REF Conv.cIepKordi._.zustand_iep_S5_S3 /end COMPU_METHOD
/begin COMPU_METHOD Conv.cSchaltung._.kup_mass_S5_S3 "Umrechnung fuer Messgroesse cSchaltung::kup_mass" TAB_VERB "%4.0" "" COMPU_TAB_REF Conv.cSchaltung._.kup_mass_S5_S3 /end COMPU_METHOD
/begin COMPU_METHOD Conv.cSchaltung._.manuell_S5_S3 "Umrechnung fuer Messgroesse cSchaltung::manuell" TAB_VERB "%4.0" "" COMPU_TAB_REF Conv.cSchaltung._.manuell_S5_S3 /end COMPU_METHOD
/begin COMPU_METHOD Conv.cSchaltungMitVerzoegerung._.k_a_schalt_verh_S5_S3 "Umrechnung fuer Messgroesse cSchaltungMitVerzoegerung::k_a_schalt_verh" TAB_VERB "%4.0" "" COMPU_TAB_REF Conv.cSchaltungMitVerzoegerung._.k_a_schalt_verh_S5_S3 /end COMPU_METHOD
/begin COMPU_METHOD Conv.cSchaltungMitVerzoegerung._.k_b_schalt_verh_S5_S3 "Umrechnung fuer Messgroesse cSchaltungMitVerzoegerung::k_b_schalt_verh" TAB_VERB "%4.0" "" COMPU_TAB_REF Conv.cSchaltungMitVerzoegerung._.k_b_schalt_verh_S5_S3 /end COMPU_METHOD
/begin COMPU_METHOD Conv.cSchaltungMitVerzoegerung._.k_c_schalt_verh_S5_S3 "Umrechnung fuer Messgroesse cSchaltungMitVerzoegerung::k_c_schalt_verh" TAB_VERB "%4.0" "" COMPU_TAB_REF Conv.cSchaltungMitVerzoegerung._.k_c_schalt_verh_S5_S3 /end COMPU_METHOD
/begin COMPU_METHOD Conv.cSchaltungMitVerzoegerung._.k_d_schalt_verh_S5_S3 "Umrechnung fuer Messgroesse cSchaltungMitVerzoegerung::k_d_schalt_verh" TAB_VERB "%4.0" "" COMPU_TAB_REF Conv.cSchaltungMitVerzoegerung._.k_d_schalt_verh_S5_S3 /end COMPU_METHOD
/begin COMPU_METHOD Conv.cSchaltungMitVerzoegerung._.k_e_schalt_verh_S5_S3 "Umrechnung fuer Messgroesse cSchaltungMitVerzoegerung::k_e_schalt_verh" TAB_VERB "%4.0" "" COMPU_TAB_REF Conv.cSchaltungMitVerzoegerung._.k_e_schalt_verh_S5_S3 /end COMPU_METHOD
/begin COMPU_METHOD Conv.cSchaltungMitVerzoegerung._.sollgang_S5_S3 "Umrechnung fuer Messgroesse cSchaltungMitVerzoegerung::sollgang" TAB_VERB "%4.0" "" COMPU_TAB_REF Conv.cSchaltungMitVerzoegerung._.sollgang_S5_S3 /end COMPU_METHOD
/begin COMPU_METHOD UMR___1_1000_0_S5_S3 "int = ((phys * 1000) / 1) - (0) [-]" RAT_FUNC "%4.3" "[-]" COEFFS 0 1000 0 0 0 1 /end COMPU_METHOD
/begin COMPU_METHOD UMR___1_100_0_S5_S3 "int = ((phys * 100) / 1) - (0) [-]" RAT_FUNC "%3.2" "[-]" COEFFS 0 100 0 0 0 1 /end COMPU_METHOD
/begin COMPU_METHOD UMR___1_1_0_S5_S3 "int = ((phys * 1) / 1) - (0) [-]" RAT_FUNC "%1.0" "[-]" COEFFS 0 1 0 0 0 1 /end COMPU_METHOD
/begin COMPU_METHOD UMR___1_300_0_S5_S3 "int = ((phys * 300) / 1) - (0) [-]" RAT_FUNC "%6.5" "[-]" COEFFS 0 300 0 0 0 1 /end COMPU_METHOD
/begin COMPU_METHOD UMR__SEC_1_1_0_S5_S3 "int = ((phys * 1) / 1) - (0) [1/s]" RAT_FUNC "%1.0" "[1/s]" COEFFS 0 1 0 0 0 1 /end COMPU_METHOD
/begin COMPU_METHOD UMR_BAR__1_1000_0_S5_S3 "int = ((phys * 1000) / 1) - (0) [bar]" RAT_FUNC "%4.3" "[bar]" COEFFS 0 1000 0 0 0 1 /end COMPU_METHOD
/begin COMPU_METHOD UMR_BAR__1_100_0_S5_S3 "int = ((phys * 100) / 1) - (0) [bar]" RAT_FUNC "%3.2" "[bar]" COEFFS 0 100 0 0 0 1 /end COMPU_METHOD
/begin COMPU_METHOD UMR_BAR_SEC_1_1_0_S5_S3 "int = ((phys * 1) / 1) - (0) [bar/s]" RAT_FUNC "%1.0" "[bar/s]" COEFFS 0 1 0 0 0 1 /end COMPU_METHOD
/begin COMPU_METHOD UMR_GRAD__1_3_M128_S5_S3 "int = ((phys * 3) / 1) - (-128) [Grad]" RAT_FUNC "%4.3" "[Grad]" COEFFS 0 3 128 0 0 1 /end COMPU_METHOD
/begin COMPU_METHOD UMR_GRADC__1_1_0_S5_S3 "int = ((phys * 1) / 1) - (0) [°C]" RAT_FUNC "%1.0" "[°C]" COEFFS 0 1 0 0 0 1 /end COMPU_METHOD
/begin COMPU_METHOD UMR_GRADC__1_1_M40_S5_S3 "int = ((phys * 1) / 1) - (-40) [°C]" RAT_FUNC "%1.0" "[°C]" COEFFS 0 1 40 0 0 1 /end COMPU_METHOD
/begin COMPU_METHOD UMR_KW__1_1000_0_S5_S3 "int = ((phys * 1000) / 1) - (0) [KW]" RAT_FUNC "%4.3" "[KW]" COEFFS 0 1000 0 0 0 1 /end COMPU_METHOD
/begin COMPU_METHOD UMR_LITER_MIN_1_10_0_S5_S3 "int = ((phys * 10) / 1) - (0) [Liter/min]" RAT_FUNC "%2.1" "[Liter/min]" COEFFS 0 10 0 0 0 1 /end COMPU_METHOD
/begin COMPU_METHOD UMR_LITER_MIN_1_1_0_S5_S3 "int = ((phys * 1) / 1) - (0) [Liter/min]" RAT_FUNC "%1.0" "[Liter/min]" COEFFS 0 1 0 0 0 1 /end COMPU_METHOD
/begin COMPU_METHOD UMR_M_SEC2_1_32_0_S5_S3 "int = ((phys * 32) / 1) - (0) [m/s^2]" RAT_FUNC "%3.2" "[m/s^2]" COEFFS 0 32 0 0 0 1 /end COMPU_METHOD
/begin COMPU_METHOD UMR_M_SEC_1_3200_0_S5_S3 "int = ((phys * 3200) / 1) - (0) [m/s]" RAT_FUNC "%5.4" "[m/s]" COEFFS 0 3200 0 0 0 1 /end COMPU_METHOD
/begin COMPU_METHOD UMR_MSEC__10_1_0_S5_S3 "int = ((phys * 1) / 10) - (0) [ms]" RAT_FUNC "%1.0" "[ms]" COEFFS 0 0.1 0 0 0 1 /end COMPU_METHOD
/begin COMPU_METHOD UMR_MSEC__1_1_0_S5_S3 "int = ((phys * 1) / 1) - (0) [ms]" RAT_FUNC "%1.0" "[ms]" COEFFS 0 1 0 0 0 1 /end COMPU_METHOD
/begin COMPU_METHOD UMR_NM__1_100_0_S5_S3 "int = ((phys * 100) / 1) - (0) [Nm]" RAT_FUNC "%3.2" "[Nm]" COEFFS 0 100 0 0 0 1 /end COMPU_METHOD
/begin COMPU_METHOD UMR_NM__1_1_0_S5_S3 "int = ((phys * 1) / 1) - (0) [Nm]" RAT_FUNC "%1.0" "[Nm]" COEFFS 0 1 0 0 0 1 /end COMPU_METHOD
/begin COMPU_METHOD UMR_NM_BAR_1_1_0_S5_S3 "int = ((phys * 1) / 1) - (0) [Nm/bar]" RAT_FUNC "%1.0" "[Nm/bar]" COEFFS 0 1 0 0 0 1 /end COMPU_METHOD
/begin COMPU_METHOD UMR_NM_SEC_1_1_0_S5_S3 "int = ((phys * 1) / 1) - (0) [Nm/s]" RAT_FUNC "%1.0" "[Nm/s]" COEFFS 0 1 0 0 0 1 /end COMPU_METHOD
/begin COMPU_METHOD UMR_PROZENT__16_10_0_S5_S3 "int = ((phys * 10) / 16) - (0) [%]" RAT_FUNC "%2.1" "[%]" COEFFS 0 0.625 0 0 0 1 /end COMPU_METHOD
/begin COMPU_METHOD UMR_PROZENT__20_51_0_S5_S3 "int = ((phys * 51) / 20) - (0) [%]" RAT_FUNC "%5.4" "[%]" COEFFS 0 2.55 0 0 0 1 /end COMPU_METHOD
/begin COMPU_METHOD UMR_PROZENT_SEC_20_51_0_S5_S3 "int = ((phys * 51) / 20) - (0) [%/s]" RAT_FUNC "%5.4" "[%/s]" COEFFS 0 2.55 0 0 0 1 /end COMPU_METHOD
/begin COMPU_METHOD UMR_SEC__1_100_0_S5_S3 "int = ((phys * 100) / 1) - (0) [s]" RAT_FUNC "%3.2" "[s]" COEFFS 0 100 0 0 0 1 /end COMPU_METHOD
/begin COMPU_METHOD UMR_U_MIN_1_100_0_S5_S3 "int = ((phys * 100) / 1) - (0) [U/min]" RAT_FUNC "%3.2" "[U/min]" COEFFS 0 100 0 0 0 1 /end COMPU_METHOD
/begin COMPU_METHOD UMR_U_MIN_1_1_0_S5_S3 "int = ((phys * 1) / 1) - (0) [U/min]" RAT_FUNC "%1.0" "[U/min]" COEFFS 0 1 0 0 0 1 /end COMPU_METHOD
/begin COMPU_METHOD UMR_U_MINSEC_1_1_0_S5_S3 "int = ((phys * 1) / 1) - (0) [U/(min*s)]" RAT_FUNC "%1.0" "[U/(min*s)]" COEFFS 0 1 0 0 0 1 /end COMPU_METHOD
/begin COMPU_METHOD UMR_W__1_1_0_S5_S3 "int = ((phys * 1) / 1) - (0) [W]" RAT_FUNC "%1.0" "[W]" COEFFS 0 1 0 0 0 1 /end COMPU_METHOD
/begin MEASUREMENT iAzsKorgl.f_notgang_gesetzt "Ist derzeit ein Notgang gesetzt" UBYTE Conv.cAzsKorgl._.f_notgang_gesetzt_S5_S3 1 100 0 1 BIT_MASK 0x1 ECU_ADDRESS 0xFFF8945F DISPLAY_IDENTIFIER f_notgang_gesetzt.iAzsKorgl /end MEASUREMENT
/begin MEASUREMENT iAzsKorgl.f_schaltung_direkt "Soll ein Gang-Wechsel direkt durchgefuert werden" UBYTE Conv.cAzsKorgl._.f_schaltung_direkt_S5_S3 1 100 0 1 BIT_MASK 0x1 ECU_ADDRESS 0xFFF8945D DISPLAY_IDENTIFIER f_schaltung_direkt.iAzsKorgl /end MEASUREMENT
/begin MEASUREMENT iAzsKorgl.f_stromlos_zzs "Befindet sich die ZZS im Stromlos-Zustand (Hydraulischer Notlauf/elektr. simulierter Notlauf)" UBYTE Conv.cAzsKorgl._.f_stromlos_zzs_S5_S3 1 100 0 1 BIT_MASK 0x1 ECU_ADDRESS 0xFFF8945E DISPLAY_IDENTIFIER f_stromlos_zzs.iAzsKorgl /end MEASUREMENT
/begin MEASUREMENT iAzsKorgl.parksperre_ziel "Parksperre Zielvorgabe" UBYTE Conv.cAzsKorgl._.parksperre_ziel_S5_S3 1 100 0 1 BIT_MASK 0x1 ECU_ADDRESS 0xFFF8945B DISPLAY_IDENTIFIER parksperre_ziel.iAzsKorgl /end MEASUREMENT
/begin MEASUREMENT iAzsKorgl.pos_red "Reduzierte Positioninformation" UBYTE Conv.cAzsKorgl._.pos_red_S5_S3 1 100 0 255 ECU_ADDRESS 0xFFF8945A DISPLAY_IDENTIFIER pos_red.iAzsKorgl /end MEASUREMENT
/begin MEASUREMENT iAzsKupMassnahmenKoord.beeinfl_spont_index "Beeinflussung des Spontanitätsindex auf Grund eines überhitzten Schaltelements." UBYTE Conv.cAzsKupMassnahmenKoord._.beeinfl_spont_index_S5_S3 1 100 0 3 ECU_ADDRESS 0xFFF8B2FD DISPLAY_IDENTIFIER beeinfl_spont_index.iAzsKupMassnahmenKoord /end MEASUREMENT
/begin MEASUREMENT iAzsKupMassnahmenKoord.iSchaltungTrans.k_ab_temp "Temperatur der abschaltenden Kupplung" SWORD UMR_GRADC__1_1_0_S5_S3 1 100 -40 500 ECU_ADDRESS 0xFFF8B322 DISPLAY_IDENTIFIER k_ab_temp.iSchaltungTrans.iAzsKupMassnahmenKoord /end MEASUREMENT
/begin MEASUREMENT iAzsKupMassnahmenKoord.iSchaltungTrans.k_zu_temp "Temperatur der zuschaltenden Kupplung" SWORD UMR_GRADC__1_1_0_S5_S3 1 100 -40 500 ECU_ADDRESS 0xFFF8B324 DISPLAY_IDENTIFIER k_zu_temp.iSchaltungTrans.iAzsKupMassnahmenKoord /end MEASUREMENT
/begin MEASUREMENT iAzsKupMassnahmenKoord.iSchaltungTrans.kup_mass "Kupplung deren Temp. zu der Massnahme geführt hat. Falls bei einer Rückschaltung beide Kup.-Temp. über der Grenze liegen, dann wird die größte zurückgeliefert." UBYTE Conv.cSchaltung._.kup_mass_S5_S3 1 100 0 5 ECU_ADDRESS 0xFFF8B326 DISPLAY_IDENTIFIER kup_mass.iSchaltungTrans.iAzsKupMassnahmenKoord /end MEASUREMENT
/begin MEASUREMENT iAzsKupMassnahmenKoord.iSchaltungTrans.manuell "Speichert ob es sich bei der aktuellen Schaltung um eine Manuelle o. nicht handelt" UBYTE Conv.cSchaltung._.manuell_S5_S3 1 100 1 255 ECU_ADDRESS 0xFFF8B31C DISPLAY_IDENTIFIER manuell.iSchaltungTrans.iAzsKupMassnahmenKoord /end MEASUREMENT
/begin MEASUREMENT iAzsKupMassnahmenKoord.iSchaltungTrans.temp_schwelle "Temperaturschwelle auf die aktuell geschaut wird" UWORD UMR_GRADC__1_1_0_S5_S3 1 100 0 65535 ECU_ADDRESS 0xFFF8B31E DISPLAY_IDENTIFIER temp_schwelle.iSchaltungTrans.iAzsKupMassnahmenKoord /end MEASUREMENT
/begin MEASUREMENT iAzsKupMassnahmenKoord.iSchaltungTrans.temp_schwelle_hys "Temparaturschwelle - Hysterese" UWORD UMR_GRADC__1_1_0_S5_S3 1 100 0 65535 ECU_ADDRESS 0xFFF8B320 DISPLAY_IDENTIFIER temp_schwelle_hys.iSchaltungTrans.iAzsKupMassnahmenKoord /end MEASUREMENT
/begin MEASUREMENT iAzsKupMassnahmenKoord.iSchaltungVerz.cSchaltung._.k_ab_temp "Temperatur der abschaltenden Kupplung" SWORD UMR_GRADC__1_1_0_S5_S3 1 100 -40 500 ECU_ADDRESS 0xFFF8B306 DISPLAY_IDENTIFIER k_ab_temp._.cSchaltung.iSchaltungVerz.iAzsKupMassnahmenKoord /end MEASUREMENT
/begin MEASUREMENT iAzsKupMassnahmenKoord.iSchaltungVerz.cSchaltung._.k_zu_temp "Temperatur der zuschaltenden Kupplung" SWORD UMR_GRADC__1_1_0_S5_S3 1 100 -40 500 ECU_ADDRESS 0xFFF8B308 DISPLAY_IDENTIFIER k_zu_temp._.cSchaltung.iSchaltungVerz.iAzsKupMassnahmenKoord /end MEASUREMENT
/begin MEASUREMENT iAzsKupMassnahmenKoord.iSchaltungVerz.cSchaltung._.kup_mass "Kupplung deren Temp. zu der Massnahme geführt hat. Falls bei einer Rückschaltung beide Kup.-Temp. über der Grenze liegen, dann wird die größte zurückgeliefert." UBYTE Conv.cSchaltung._.kup_mass_S5_S3 1 100 0 5 ECU_ADDRESS 0xFFF8B30A DISPLAY_IDENTIFIER kup_mass._.cSchaltung.iSchaltungVerz.iAzsKupMassnahmenKoord /end MEASUREMENT
/begin MEASUREMENT iAzsKupMassnahmenKoord.iSchaltungVerz.cSchaltung._.manuell "Speichert ob es sich bei der aktuellen Schaltung um eine Manuelle o. nicht handelt" UBYTE Conv.cSchaltung._.manuell_S5_S3 1 100 1 255 ECU_ADDRESS 0xFFF8B300 DISPLAY_IDENTIFIER manuell._.cSchaltung.iSchaltungVerz.iAzsKupMassnahmenKoord /end MEASUREMENT
/begin MEASUREMENT iAzsKupMassnahmenKoord.iSchaltungVerz.cSchaltung._.temp_schwelle "Temperaturschwelle auf die aktuell geschaut wird" UWORD UMR_GRADC__1_1_0_S5_S3 1 100 0 65535 ECU_ADDRESS 0xFFF8B302 DISPLAY_IDENTIFIER temp_schwelle._.cSchaltung.iSchaltungVerz.iAzsKupMassnahmenKoord /end MEASUREMENT
/begin MEASUREMENT iAzsKupMassnahmenKoord.iSchaltungVerz.cSchaltung._.temp_schwelle_hys "Temparaturschwelle - Hysterese" UWORD UMR_GRADC__1_1_0_S5_S3 1 100 0 65535 ECU_ADDRESS 0xFFF8B304 DISPLAY_IDENTIFIER temp_schwelle_hys._.cSchaltung.iSchaltungVerz.iAzsKupMassnahmenKoord /end MEASUREMENT
/begin MEASUREMENT iAzsKupMassnahmenKoord.iSchaltungVerz.iVerzZeit.time "Zeit des Timers" UBYTE UMR_SEC__1_100_0_S5_S3 1 100 0 2.55 ECU_ADDRESS 0xFFF8B31A DISPLAY_IDENTIFIER iVerzZeit.iSchaltungVerz.iAzsKupMassnahmenKoord /end MEASUREMENT
/begin MEASUREMENT iAzsKupMassnahmenKoord.iSchaltungVerz.k_a_schalt_verh "Die K_A hat eine Schaltungsverhinderung ausgelöst." UBYTE Conv.cSchaltungMitVerzoegerung._.k_a_schalt_verh_S5_S3 1 100 0 1 BIT_MASK 0x1 ECU_ADDRESS 0xFFF8B315 DISPLAY_IDENTIFIER k_a_schalt_verh.iSchaltungVerz.iAzsKupMassnahmenKoord /end MEASUREMENT
/begin MEASUREMENT iAzsKupMassnahmenKoord.iSchaltungVerz.k_b_schalt_verh "Die K_B hat eine Schaltungsverhinderung ausgelöst." UBYTE Conv.cSchaltungMitVerzoegerung._.k_b_schalt_verh_S5_S3 1 100 0 1 BIT_MASK 0x1 ECU_ADDRESS 0xFFF8B316 DISPLAY_IDENTIFIER k_b_schalt_verh.iSchaltungVerz.iAzsKupMassnahmenKoord /end MEASUREMENT
/begin MEASUREMENT iAzsKupMassnahmenKoord.iSchaltungVerz.k_c_schalt_verh "Die K_C hat eine Schaltungsverhinderung ausgelöst." UBYTE Conv.cSchaltungMitVerzoegerung._.k_c_schalt_verh_S5_S3 1 100 0 1 BIT_MASK 0x1 ECU_ADDRESS 0xFFF8B317 DISPLAY_IDENTIFIER k_c_schalt_verh.iSchaltungVerz.iAzsKupMassnahmenKoord /end MEASUREMENT
/begin MEASUREMENT iAzsKupMassnahmenKoord.iSchaltungVerz.k_d_schalt_verh "Die K_D hat eine Schaltungsverhinderung ausgelöst." UBYTE Conv.cSchaltungMitVerzoegerung._.k_d_schalt_verh_S5_S3 1 100 0 1 BIT_MASK 0x1 ECU_ADDRESS 0xFFF8B318 DISPLAY_IDENTIFIER k_d_schalt_verh.iSchaltungVerz.iAzsKupMassnahmenKoord /end MEASUREMENT
/begin MEASUREMENT iAzsKupMassnahmenKoord.iSchaltungVerz.k_e_schalt_verh "Die K_E hat eine Schaltungsverhinderung ausgelöst." UBYTE Conv.cSchaltungMitVerzoegerung._.k_e_schalt_verh_S5_S3 1 100 0 1 BIT_MASK 0x1 ECU_ADDRESS 0xFFF8B319 DISPLAY_IDENTIFIER k_e_schalt_verh.iSchaltungVerz.iAzsKupMassnahmenKoord /end MEASUREMENT
/begin MEASUREMENT iAzsKupMassnahmenKoord.iSchaltungVerz.sollgang "Sollgang-Gang" SBYTE Conv.cSchaltungMitVerzoegerung._.sollgang_S5_S3 1 100 -1 8 ECU_ADDRESS 0xFFF8B314 DISPLAY_IDENTIFIER sollgang.iSchaltungVerz.iAzsKupMassnahmenKoord /end MEASUREMENT
/begin MEASUREMENT iAzsKupMassnahmenKoord.reduzierung_m_mot_max "Reduzierung des max. Motormoments auf Grund eines überhitzten Schaltelements." UBYTE Conv.cAzsKupMassnahmenKoord._.reduzierung_m_mot_max_S5_S3 1 100 0 3 ECU_ADDRESS 0xFFF8B2FC DISPLAY_IDENTIFIER reduzierung_m_mot_max.iAzsKupMassnahmenKoord /end MEASUREMENT
/begin MEASUREMENT iAzsKupMassnahmenKoord.versch_schalt_verh "In der Messgröße wird gespeichert ob eine verschachtelte Schaltung verhindert wird." UBYTE Conv.cAzsKupMassnahmenKoord._.versch_schalt_verh_S5_S3 1 100 0 1 BIT_MASK 0x1 ECU_ADDRESS 0xFFF8B2FF DISPLAY_IDENTIFIER versch_schalt_verh.iAzsKupMassnahmenKoord /end MEASUREMENT
/begin MEASUREMENT iAzsKupMassnahmenKoord.zustand_schaltungsverh "Gibt an ob die aktuelle Schaltung verhindert werden soll." UBYTE Conv.cAzsKupMassnahmenKoord._.zustand_schaltungsverh_S5_S3 1 100 0 2 ECU_ADDRESS 0xFFF8B2FE DISPLAY_IDENTIFIER zustand_schaltungsverh.iAzsKupMassnahmenKoord /end MEASUREMENT
/begin MEASUREMENT iAzsNeutralEbene.TimerNE.time "Zeit des Timers" UWORD UMR_SEC__1_100_0_S5_S3 1 100 0 655.35 ECU_ADDRESS 0xFFF8B336 DISPLAY_IDENTIFIER TimerNE.iAzsNeutralEbene /end MEASUREMENT
/begin MEASUREMENT iAzsNeutralEbene.fkt_neutral_ebene "welche Funktion fordert eine Neutral-Ebenen Ansteuerung an" UWORD Conv.cAzsNeutralEbene._.fkt_neutral_ebene_S5_S3 1 100 0 1024 ECU_ADDRESS 0xFFF8B332 DISPLAY_IDENTIFIER fkt_neutral_ebene.iAzsNeutralEbene /end MEASUREMENT
/begin MEASUREMENT iAzsNeutralEbene.pos_neutral_n_stern "reine Anzeigegroesse fuer ES" UBYTE Conv.cAzsNeutralEbene._.pos_neutral_n_stern_S5_S3 1 100 0 4 ECU_ADDRESS 0xFFF8B334 DISPLAY_IDENTIFIER pos_neutral_n_stern.iAzsNeutralEbene /end MEASUREMENT
/begin MEASUREMENT iAzsNeutralEbene.z_neutral_ebene "Zustand der Neutral Ebenen Ansteuerung" UBYTE Conv.cAzsNeutralEbene._.z_neutral_ebene_S5_S3 1 100 0 6 ECU_ADDRESS 0xFFF8B330 DISPLAY_IDENTIFIER z_neutral_ebene.iAzsNeutralEbene /end MEASUREMENT
/begin MEASUREMENT iAzsSZPulsAda.TimerMaxTime.time "Zeit des Timers" UWORD UMR_SEC__1_100_0_S5_S3 1 100 0 655.35 ECU_ADDRESS 0xFFF8D6EA DISPLAY_IDENTIFIER TimerMaxTime.iAzsSZPulsAda /end MEASUREMENT
/begin MEASUREMENT iAzsSZPulsAda.TimerSZPulsAda.time "Zeit des Timers" UWORD UMR_SEC__1_100_0_S5_S3 1 100 0 655.35 ECU_ADDRESS 0xFFF8D6E8 DISPLAY_IDENTIFIER TimerSZPulsAda.iAzsSZPulsAda /end MEASUREMENT
/begin MEASUREMENT iAzsSZPulsAda.f_abbruch_pre_ada_azs "Abbruch der uebergeordneten Pre-Adaption aus Sicht der ZZS" UBYTE Conv.cAzsSZPulsAda._.f_abbruch_pre_ada_azs_S5_S3 1 100 0 1 BIT_MASK 0x1 ECU_ADDRESS 0xFFF8D6E5 DISPLAY_IDENTIFIER f_abbruch_pre_ada_azs.iAzsSZPulsAda /end MEASUREMENT
/begin MEASUREMENT iAzsSZPulsAda.f_gang_vorgabe "Gang-Vorgabe fuer SZPuls" UBYTE Conv.cAzsSZPulsAda._.f_gang_vorgabe_S5_S3 1 100 0 1 BIT_MASK 0x1 ECU_ADDRESS 0xFFF8D6E4 DISPLAY_IDENTIFIER f_gang_vorgabe.iAzsSZPulsAda /end MEASUREMENT
/begin MEASUREMENT iAzsSZPulsAda.f_neutral_vorgabe "Kraftfluss-Vorgabe Neutral fuer SZPuls" UBYTE Conv.cAzsSZPulsAda._.f_neutral_vorgabe_S5_S3 1 100 0 1 BIT_MASK 0x1 ECU_ADDRESS 0xFFF8D6E3 DISPLAY_IDENTIFIER f_neutral_vorgabe.iAzsSZPulsAda /end MEASUREMENT
/begin MEASUREMENT iAzsSZPulsAda.f_sz_puls_ada_aktiv "Sonderzustand: Beeinflussung der kraftschliessenden Kupplung" UBYTE Conv.cAzsSZPulsAda._.f_sz_puls_ada_aktiv_S5_S3 1 100 0 1 BIT_MASK 0x1 ECU_ADDRESS 0xFFF8D6E6 DISPLAY_IDENTIFIER f_sz_puls_ada_aktiv.iAzsSZPulsAda /end MEASUREMENT
/begin MEASUREMENT iAzsSZPulsAda.sz_puls_ada_gang "Gang-Vorgabe von SZPuls" SBYTE Conv.cAzsSZPulsAda._.sz_puls_ada_gang_S5_S3 1 100 -1 8 ECU_ADDRESS 0xFFF8D6E7 DISPLAY_IDENTIFIER sz_puls_ada_gang.iAzsSZPulsAda /end MEASUREMENT
/begin MEASUREMENT iAzsSZPulsAda.z_sonder_zustand_puls_ada "Zustandsgraph der ZZS, um den Sonderzustand fuer die Puls-Pre-Ada anzufahren" UBYTE Conv.cAzsSZPulsAda._.z_sonder_zustand_puls_ada_S5_S3 1 100 0 12 ECU_ADDRESS 0xFFF8D6E2 DISPLAY_IDENTIFIER z_sonder_zustand_puls_ada.iAzsSZPulsAda /end MEASUREMENT
/begin MEASUREMENT iAzsSchluesselStart.s_start_status "Zustand des Schluessel-Starts" UBYTE Conv.cAzsSchluesselStart._.s_start_status_S5_S3 1 100 0 4 ECU_ADDRESS 0xFFF89746 DISPLAY_IDENTIFIER s_start_status.iAzsSchluesselStart /end MEASUREMENT
/begin MEASUREMENT iAzsSollgangMoeglich.sollgang_moeglich "Gibt einen Gang moeglichst nahe am Sollgang an, in den das Getriebe ueber mehrere Schaltungen hinweg derzeit geschalten werden koennte" SBYTE Conv.cAzsSollgangMoeglich._.sollgang_moeglich_S5_S3 1 100 -1 8 ECU_ADDRESS 0xFFF89461 DISPLAY_IDENTIFIER sollgang_moeglich.iAzsSollgangMoeglich /end MEASUREMENT
/begin MEASUREMENT iAzsUeFunktionen.ue_fkt_abschalten "Ueberwachungsfunktionen sollen abgeschalten werden" UBYTE UMR___1_1_0_S5_S3 1 100 0 255 ECU_ADDRESS 0xFFF8D6EC DISPLAY_IDENTIFIER ue_fkt_abschalten.iAzsUeFunktionen /end MEASUREMENT
/begin MEASUREMENT iAzsUeFunktionen.ue_fkt_aufgerufen "-Ueberwachungsfunktionen abschalten/freigeben- wurde in diesem Zyklus aufgerufen" UBYTE UMR___1_1_0_S5_S3 1 100 0 255 ECU_ADDRESS 0xFFF8D6ED DISPLAY_IDENTIFIER ue_fkt_aufgerufen.iAzsUeFunktionen /end MEASUREMENT
/begin MEASUREMENT iAzsVorgabeGang.f_abbruch_vorb_angefordert "Abbruch einer Vorbereitung wegen Schleppstart" UBYTE Conv.cAzsVorgabeGang._.f_abbruch_vorb_angefordert_S5_S3 1 100 0 1 BIT_MASK 0x1 ECU_ADDRESS 0xFFF8B33A DISPLAY_IDENTIFIER f_abbruch_vorb_angefordert.iAzsVorgabeGang /end MEASUREMENT
/begin MEASUREMENT iAzsVorgabeGang.f_schleppstart_erkannt "Aktive Anforderung einer Schaltungsverhinderung/-abbruch durch Schleppstartfkt." UBYTE Conv.cAzsVorgabeGang._.f_schleppstart_erkannt_S5_S3 1 100 0 1 BIT_MASK 0x1 ECU_ADDRESS 0xFFF8B33B DISPLAY_IDENTIFIER f_schleppstart_erkannt.iAzsVorgabeGang /end MEASUREMENT
/begin MEASUREMENT iAzsVorgabeGang.gang_schleppstart "der vorgabegang der Schleppstart-Fkt." SBYTE Conv.cAzsVorgabeGang._.gang_schleppstart_S5_S3 1 100 -1 8 ECU_ADDRESS 0xFFF8B338 DISPLAY_IDENTIFIER gang_schleppstart.iAzsVorgabeGang /end MEASUREMENT
/begin MEASUREMENT iAzsVorgabeGang.vorgabegang "Vorgabegang - sammelt alle Ganganforderungen (ohne Gang R)" SBYTE Conv.cAzsVorgabeGang._.vorgabegang_S5_S3 1 100 -1 8 ECU_ADDRESS 0xFFF8B339 DISPLAY_IDENTIFIER vorgabegang.iAzsVorgabeGang /end MEASUREMENT
/begin MEASUREMENT iAzsZielgang.f_schalt_abbruch_invers "Abbruch der laufenden Schaltung wegen inverser Anforderung wurde von SAS erlaubt" UBYTE Conv.cAzsZielgang._.f_schalt_abbruch_invers_S5_S3 1 100 0 1 BIT_MASK 0x1 ECU_ADDRESS 0xFFF8D824 DISPLAY_IDENTIFIER f_schalt_abbruch_invers.iAzsZielgang /end MEASUREMENT
/begin MEASUREMENT iAzsZielgang.zielgang "zielgang ist ein zum istgang schaltbarer Gang" SBYTE Conv.cAzsZielgang._.zielgang_S5_S3 1 100 -1 8 ECU_ADDRESS 0xFFF8D825 DISPLAY_IDENTIFIER zielgang.iAzsZielgang /end MEASUREMENT
/begin MEASUREMENT iAzsZielgangSas.schaltart "Laufende Schaltung ist HS, RS oder keine Schaltung" UBYTE Conv.cAzsZielgangSas._.schaltart_S5_S3 1 100 0 2 ECU_ADDRESS 0xFFF89463 DISPLAY_IDENTIFIER schaltart.iAzsZielgangSas /end MEASUREMENT
/begin MEASUREMENT iAzsZielgangSas.schaltinfo "Laufende Schaltung ist EHS, MHS, MRS, MRS oder keine Schaltung" UBYTE Conv.cAzsZielgangSas._.schaltinfo_S5_S3 1 100 0 4 ECU_ADDRESS 0xFFF89464 DISPLAY_IDENTIFIER schaltinfo.iAzsZielgangSas /end MEASUREMENT
/begin MEASUREMENT iAzsZielgangSas.schaltung "TRUE waehrend laufender Schaltung" UBYTE Conv.cAzsZielgangSas._.schaltung_S5_S3 1 100 0 1 BIT_MASK 0x1 ECU_ADDRESS 0xFFF89462 DISPLAY_IDENTIFIER schaltung.iAzsZielgangSas /end MEASUREMENT
/begin MEASUREMENT iAzsZielgangSas.zielgang_sas "Zielgang-Sas: wenn ungleich Istgang laeuft gerade eine Schaltung" SBYTE Conv.cAzsZielgangSas._.zielgang_sas_S5_S3 1 100 -1 8 ECU_ADDRESS 0xFFF89465 DISPLAY_IDENTIFIER zielgang_sas.iAzsZielgangSas /end MEASUREMENT
/begin MEASUREMENT iAzsZielgangSas.zielgang_sas_komp "Zielgang-Sas-Komplement: Bitinvertiertes Signal zu zielgang_sas" SBYTE Conv.cAzsZielgangSas._.zielgang_sas_komp_S5_S3 1 100 -9 0 ECU_ADDRESS 0xFFF89466 DISPLAY_IDENTIFIER zielgang_sas_komp.iAzsZielgangSas /end MEASUREMENT
/begin MEASUREMENT iAzsZielgangSoll.zielgang_soll "Zielgang-Soll" SBYTE Conv.cAzsZielgangSoll._.zielgang_soll_S5_S3 1 100 -1 8 ECU_ADDRESS 0xFFF89467 DISPLAY_IDENTIFIER zielgang_soll.iAzsZielgangSoll /end MEASUREMENT
/begin MEASUREMENT iBibAglex.anzahl_werte "Anzahl der Werte der Ausgleichsgeraden (laenge + extrapolationsschritte)" UBYTE UMR___1_1_0_S5_S3 1 100 0 255 ECU_ADDRESS 0xFFF8ADAF DISPLAY_IDENTIFIER anzahl_werte.iBibAglex /end MEASUREMENT
/begin MEASUREMENT iBibAglex.extrapolationsschritte "Anzahl der Extrapolationsschritte" UBYTE UMR___1_1_0_S5_S3 1 100 0 255 ECU_ADDRESS 0xFFF8ADB1 DISPLAY_IDENTIFIER extrapolationsschritte.iBibAglex /end MEASUREMENT
/begin MEASUREMENT iBibAglex.extrapolierter_wert "mit Ausgleichsgerade extrapolierter y-Wert" SWORD UMR___1_1_0_S5_S3 1 100 -32768 32767 ECU_ADDRESS 0xFFF8ADA8 DISPLAY_IDENTIFIER extrapolierter_wert.iBibAglex /end MEASUREMENT
/begin MEASUREMENT iBibAglex.f_nicht_berechnen "Aktives Eingangssignal" UBYTE Conv.cBibAglex._.f_nicht_berechnen_S5_S3 1 100 0 1 BIT_MASK 0x1 ECU_ADDRESS 0xFFF8ADAE DISPLAY_IDENTIFIER f_nicht_berechnen.iBibAglex /end MEASUREMENT
/begin MEASUREMENT iBibAglex.func_agl "Funktion die AGL besitzt" UBYTE Conv.cBibAglex._.func_agl_S5_S3 1 100 0 4 ECU_ADDRESS 0xFFF8ADAC DISPLAY_IDENTIFIER func_agl.iBibAglex /end MEASUREMENT
/begin MEASUREMENT iBibAglex.index_aeltester_wert "Index des aeltesten Wertes" UBYTE UMR___1_1_0_S5_S3 1 100 0 255 ECU_ADDRESS 0xFFF8ADB4 DISPLAY_IDENTIFIER index_aeltester_wert.iBibAglex /end MEASUREMENT
/begin MEASUREMENT iBibAglex.index_erster_wert "Index des aeltesten Wertes" UBYTE UMR___1_1_0_S5_S3 1 100 0 255 ECU_ADDRESS 0xFFF8ADB3 DISPLAY_IDENTIFIER index_erster_wert.iBibAglex /end MEASUREMENT
/begin MEASUREMENT iBibAglex.laenge "Laenge der Ausgleichsgeraden" UBYTE UMR___1_1_0_S5_S3 1 100 0 255 ECU_ADDRESS 0xFFF8ADB0 DISPLAY_IDENTIFIER laenge.iBibAglex /end MEASUREMENT
/begin MEASUREMENT iBibAglex.n_aktuell "Eingangsdrehzahl fuer AGL der Pulsadaption (n_t bzw. n_ab)" SWORD UMR_U_MIN_1_1_0_S5_S3 1 100 0 8200 ECU_ADDRESS 0xFFF8ADA6 DISPLAY_IDENTIFIER n_aktuell.iBibAglex /end MEASUREMENT
/begin MEASUREMENT iBibAglex.n_guete "Drehzahlsignalguete (n_aktuell - extrapolierter_wert)" SWORD UMR_U_MIN_1_1_0_S5_S3 1 100 -200 200 ECU_ADDRESS 0xFFF8ADAA DISPLAY_IDENTIFIER n_guete.iBibAglex /end MEASUREMENT
/begin MEASUREMENT iBibAglex.noch_benoetigte_werte "Laenge der Ausgleichsgeraden" UBYTE UMR___1_1_0_S5_S3 1 100 0 255 ECU_ADDRESS 0xFFF8ADB2 DISPLAY_IDENTIFIER noch_benoetigte_werte.iBibAglex /end MEASUREMENT
/begin MEASUREMENT iBibAglex.signal_agl "Aktives Eingangssignal" UBYTE Conv.cBibAglex._.signal_agl_S5_S3 1 100 0 4 ECU_ADDRESS 0xFFF8ADAD DISPLAY_IDENTIFIER signal_agl.iBibAglex /end MEASUREMENT
/begin MEASUREMENT iBibAglex.steigung "Steigung der Ausgleichsgeraden" SLONG UMR___1_1_0_S5_S3 1 100 -2147483648 2147483647 ECU_ADDRESS 0xFFF8ADCC DISPLAY_IDENTIFIER steigung.iBibAglex /end MEASUREMENT
/begin MEASUREMENT iBibAglex.sum_xi_q "Summe aller (xi*xi) entspricht Nenner der Steigung a'" SLONG UMR___1_1_0_S5_S3 1 100 -2147483648 2147483647 ECU_ADDRESS 0xFFF8ADC4 DISPLAY_IDENTIFIER sum_xi_q.iBibAglex /end MEASUREMENT
/begin MEASUREMENT iBibAglex.sum_yi "Summe aller y-Werte" SLONG UMR___1_1_0_S5_S3 1 100 -2147483648 2147483647 ECU_ADDRESS 0xFFF8ADC8 DISPLAY_IDENTIFIER sum_yi.iBibAglex /end MEASUREMENT
/begin MEASUREMENT iBibAglex.x_0 "neuer Koordinatenursprung in x-Richtung" SLONG UMR___1_1_0_S5_S3 1 100 -2147483648 2147483647 ECU_ADDRESS 0xFFF8ADB8 DISPLAY_IDENTIFIER x_0.iBibAglex /end MEASUREMENT
/begin MEASUREMENT iBibAglex.x_expol "Abstand v.Schwerpkt zum extrapol.Wert in x-Richtg." SWORD UMR___1_1_0_S5_S3 1 100 -32768 32767 ECU_ADDRESS 0xFFF8ADC0 DISPLAY_IDENTIFIER x_expol.iBibAglex /end MEASUREMENT
/begin MEASUREMENT iBibAglex.y_0 "neuer Koordinatenursprung in y-Richtung" SLONG UMR___1_1_0_S5_S3 1 100 -2147483648 2147483647 ECU_ADDRESS 0xFFF8ADBC DISPLAY_IDENTIFIER y_0.iBibAglex /end MEASUREMENT
/begin MEASUREMENT iBibAglex.z_agl "Zustand der AGL-Berechnung" UBYTE Conv.cBibAglex._.z_agl_S5_S3 1 100 0 4 ECU_ADDRESS 0xFFF8ADA4 DISPLAY_IDENTIFIER z_agl.iBibAglex /end MEASUREMENT
/begin MEASUREMENT iBibAglex.z_ringspeicher "Zustand der AGL-Berechnung" UBYTE Conv.cBibAglex._.z_ringspeicher_S5_S3 1 100 0 2 ECU_ADDRESS 0xFFF8ADA5 DISPLAY_IDENTIFIER z_ringspeicher.iBibAglex /end MEASUREMENT
/begin MEASUREMENT iBihMobef.counter_meschlupf "Zähler zur Erfassung der Anzahl an Momenteneingriffen aufgrund schlupfender Kupplungen" UWORD UMR___1_1_0_S5_S3 1 100 0 65535 ECU_ADDRESS 0xFFF8D708 DISPLAY_IDENTIFIER counter_meschlupf.iBihMobef /end MEASUREMENT
/begin MEASUREMENT iBihMobef.f_rganglimitaktiv "Einstiegsbedingung R-Ganglimit erfüllt" UBYTE Conv.cBihMobef._.f_rganglimitaktiv_S5_S3 1 100 0 1 BIT_MASK 0x1 ECU_ADDRESS 0xFFF8D704 DISPLAY_IDENTIFIER f_rganglimitaktiv.iBihMobef /end MEASUREMENT
/begin MEASUREMENT iBihMobef.fl_meschlupfaktiv "FLAG: Zur Kennzeichnung, ob Schlupferkennung in aktuellen Gang aktiv war" UBYTE Conv.cBihMobef._.fl_meschlupfaktiv_S5_S3 1 100 0 1 BIT_MASK 0x1 ECU_ADDRESS 0xFFF8D705 DISPLAY_IDENTIFIER fl_meschlupfaktiv.iBihMobef /end MEASUREMENT
/begin MEASUREMENT iBihMobef.flag_meschlupf "Getriebeschutz wegen Schlupferkennung ausserhalb Schaltung aktiv/nicht aktiv" UBYTE Conv.cBihMobef._.flag_meschlupf_S5_S3 1 100 0 1 BIT_MASK 0x1 ECU_ADDRESS 0xFFF8D706 DISPLAY_IDENTIFIER flag_meschlupf.iBihMobef /end MEASUREMENT
/begin MEASUREMENT iBihMobef.m_getrmax_schlupf "maximal zulaessiges Getr.moment bei Schlupf (noch ohne Sicherheit)" SWORD UMR_NM__1_1_0_S5_S3 1 100 0 1300 ECU_ADDRESS 0xFFF8D714 DISPLAY_IDENTIFIER m_getrmax_schlupf.iBihMobef /end MEASUREMENT
/begin MEASUREMENT iBihMobef.m_motmax_getr "maximal zulaessiges Getr.moment ohne Sicherheit aktueller Wert" SWORD UMR_NM__1_1_0_S5_S3 1 100 -2000 26000 ECU_ADDRESS 0xFFF8D6FC DISPLAY_IDENTIFIER m_motmax_getr.iBihMobef /end MEASUREMENT
/begin MEASUREMENT iBihMobef.m_motmax_getr_alt "maximal zulaessiges Getr.moment ohne Sicherheit alter Wert" SWORD UMR_NM__1_1_0_S5_S3 1 100 -2000 26000 ECU_ADDRESS 0xFFF8D6FA DISPLAY_IDENTIFIER m_motmax_getr_alt.iBihMobef /end MEASUREMENT
/begin MEASUREMENT iBihMobef.m_motmax_getr_neu "maximal zulaessiges Getr.moment ohne Sicherheit neuer Wert" SWORD UMR_NM__1_1_0_S5_S3 1 100 0 1300 ECU_ADDRESS 0xFFF8D6F8 DISPLAY_IDENTIFIER m_motmax_getr_neu.iBihMobef /end MEASUREMENT
/begin MEASUREMENT iBihMobef.m_motmax_stall "min. Auswahl zwischen m_motmax_strang und m_motmax_wd" SWORD UMR_NM__1_1_0_S5_S3 1 100 0 1300 ECU_ADDRESS 0xFFF8D700 DISPLAY_IDENTIFIER m_motmax_stall.iBihMobef /end MEASUREMENT
/begin MEASUREMENT iBihMobef.m_motmax_strang "maximal zulaessiges Getr.moment bei Stallspeed zum Strangschutz" SWORD UMR_NM__1_1_0_S5_S3 1 100 0 1300 ECU_ADDRESS 0xFFF8D702 DISPLAY_IDENTIFIER m_motmax_strang.iBihMobef /end MEASUREMENT
/begin MEASUREMENT iBihMobef.m_t_meschlupfaktiv "Wert des Turbinenmoments zum Zeitpunkt der Berechnung von m_getrmax_schlupf" SWORD UMR_NM__1_1_0_S5_S3 1 100 0 1300 ECU_ADDRESS 0xFFF8D716 DISPLAY_IDENTIFIER m_t_meschlupfaktiv.iBihMobef /end MEASUREMENT
/begin MEASUREMENT iBihMobef.me_abs "Angefordertes Motormoment als Absolutmoment gesamt" SWORD UMR_NM__1_1_0_S5_S3 1 100 -1500 1500 ECU_ADDRESS 0xFFF8D6EE DISPLAY_IDENTIFIER me_abs.iBihMobef /end MEASUREMENT
/begin MEASUREMENT iBihMobef.me_diff "ausgegebenes Momentenveränderung als Differenz zu m_mot in Nm" SWORD UMR_NM__1_1_0_S5_S3 1 100 -1500 1500 ECU_ADDRESS 0xFFF8D6F0 DISPLAY_IDENTIFIER me_diff.iBihMobef /end MEASUREMENT
/begin MEASUREMENT iBihMobef.nd_synmmotmax "nd_syn fuer gefuehrter Getriebeschutz" SWORD UMR_U_MIN_1_1_0_S5_S3 1 100 -8160 8160 ECU_ADDRESS 0xFFF8D6F4 DISPLAY_IDENTIFIER nd_synmmotmax.iBihMobef /end MEASUREMENT
/begin MEASUREMENT iBihMobef.nd_synschutz "nd_syn fuer gefuehrter Getriebeschutz bei Schlupf" SWORD UMR_U_MIN_1_1_0_S5_S3 1 100 -8160 8160 ECU_ADDRESS 0xFFF8D70A DISPLAY_IDENTIFIER nd_synschutz.iBihMobef /end MEASUREMENT
/begin MEASUREMENT iBihMobef.timer16_meuw "Timer Motoreingriffszeitueberwachung" UWORD UMR_MSEC__10_1_0_S5_S3 1 100 0 655350 ECU_ADDRESS 0xFFF8D70C DISPLAY_IDENTIFIER timer16_meuw.iBihMobef /end MEASUREMENT
/begin MEASUREMENT iBihMobef.timer_m_motmax_schlupf_aktiv "Timer fuer gef. Getriebeschutz bei Schlupf" UWORD UMR_MSEC__10_1_0_S5_S3 1 100 0 655350 ECU_ADDRESS 0xFFF8D710 DISPLAY_IDENTIFIER timer_m_motmax_schlupf_aktiv.iBihMobef /end MEASUREMENT
/begin MEASUREMENT iBihMobef.timer_metot "Timer ME-Unterbrechung" UBYTE UMR_MSEC__10_1_0_S5_S3 1 100 0 2550 ECU_ADDRESS 0xFFF8D70E DISPLAY_IDENTIFIER timer_metot.iBihMobef /end MEASUREMENT
/begin MEASUREMENT iBihMobef.timer_ndsynme "Zustandstimer für Geführten Getriebeschutz bei Schlupferkennung" UWORD UMR_MSEC__10_1_0_S5_S3 1 100 0 655350 ECU_ADDRESS 0xFFF8D718 DISPLAY_IDENTIFIER timer_ndsynme.iBihMobef /end MEASUREMENT
/begin MEASUREMENT iBihMobef.timer_notlaufsprung "Timer Getriebeschutz Notlaufsprung" UBYTE UMR_MSEC__10_1_0_S5_S3 1 100 0 2550 ECU_ADDRESS 0xFFF8D6F2 DISPLAY_IDENTIFIER timer_notlaufsprung.iBihMobef /end MEASUREMENT
/begin MEASUREMENT iBihMobef.timer_ra_m_motmax "Timer Rampe Berechnung m_motmax" UBYTE UMR_MSEC__10_1_0_S5_S3 1 100 0 2550 ECU_ADDRESS 0xFFF8D6F6 DISPLAY_IDENTIFIER timer_ra_m_motmax.iBihMobef /end MEASUREMENT
/begin MEASUREMENT iBihMobef.timer_ra_m_motmax_schlupf "Timer fuer Aufregelrampe gef. Getriebeschutz bei Schlupf" UBYTE UMR_MSEC__10_1_0_S5_S3 1 100 0 2550 ECU_ADDRESS 0xFFF8D712 DISPLAY_IDENTIFIER timer_ra_m_motmax_schlupf.iBihMobef /end MEASUREMENT
/begin MEASUREMENT iBihMobef.timer_vstall "Timer Rampe verzoegerung Schutzfunktion Antiebsstrang" UBYTE UMR_MSEC__10_1_0_S5_S3 1 100 0 2550 ECU_ADDRESS 0xFFF8D6FE DISPLAY_IDENTIFIER timer_vstall.iBihMobef /end MEASUREMENT
/begin MEASUREMENT iBihMobef.z_m_motmax_kor_strang "Zustand gef. Getriebeschutz bei Stallspeed Antriebsstranschutz" UBYTE Conv.cBihMobef._.z_m_motmax_kor_strang_S5_S3 1 100 0 2 ECU_ADDRESS 0xFFF8D6FF DISPLAY_IDENTIFIER z_m_motmax_kor_strang.iBihMobef /end MEASUREMENT
/begin MEASUREMENT iBihMobef.z_m_motmax_schlupf "Zustand m_motmax bei Schlupf" UBYTE Conv.cBihMobef._.z_m_motmax_schlupf_S5_S3 1 100 0 2 ECU_ADDRESS 0xFFF8D713 DISPLAY_IDENTIFIER z_m_motmax_schlupf.iBihMobef /end MEASUREMENT
/begin MEASUREMENT iBihMomen.Pt1MPuAuf.x "Filterwert" SLONG UMR___1_300_0_S5_S3 1 100 -7158278.82667 7158278.82333 ECU_ADDRESS 0xFFF8B380 DISPLAY_IDENTIFIER Pt1MPuAuf.iBihMomen /end MEASUREMENT
/begin MEASUREMENT iBihMomen.TimerK0Verlust.time "Zeit des Timers" UWORD UMR_SEC__1_100_0_S5_S3 1 100 0 655.35 ECU_ADDRESS 0xFFF8B37E DISPLAY_IDENTIFIER TimerK0Verlust.iBihMomen /end MEASUREMENT
/begin MEASUREMENT iBihMomen.m_ab_dyn "Dynamisches Abtriebsmoment" SWORD UMR_NM__1_1_0_S5_S3 1 100 -32768 32767 ECU_ADDRESS 0xFFF8B374 DISPLAY_IDENTIFIER m_ab_dyn.iBihMomen /end MEASUREMENT
/begin MEASUREMENT iBihMomen.m_getrauf "Getriebeaufnahmemoment" SWORD UMR_NM__1_1_0_S5_S3 1 100 -1200 1200 ECU_ADDRESS 0xFFF8B36C DISPLAY_IDENTIFIER m_getrauf.iBihMomen /end MEASUREMENT
/begin MEASUREMENT iBihMomen.m_getrverl "Getriebeverlustmoment" SWORD UMR_NM__1_1_0_S5_S3 1 100 0 200 ECU_ADDRESS 0xFFF8B376 DISPLAY_IDENTIFIER m_getrverl.iBihMomen /end MEASUREMENT
/begin MEASUREMENT iBihMomen.m_puauf "Pumpenaufnahmemoment" SWORD UMR_NM__1_1_0_S5_S3 1 100 0 1300 ECU_ADDRESS 0xFFF8B36E DISPLAY_IDENTIFIER m_puauf.iBihMomen /end MEASUREMENT
/begin MEASUREMENT iBihMomen.md_motsollist "m_motsoll-m_motkor_in, Eingangsgroesse fuer KL_FGMMOTMDMOT" SWORD UMR_NM__1_1_0_S5_S3 1 100 -200 1300 ECU_ADDRESS 0xFFF8B372 DISPLAY_IDENTIFIER md_motsollist.iBihMomen /end MEASUREMENT
/begin MEASUREMENT iBihMomen.n_mot_pu "Eingangsgroesse fuer KF_MPUAUF" UWORD UMR_U_MIN_1_1_0_S5_S3 1 100 0 10000 ECU_ADDRESS 0xFFF8B370 DISPLAY_IDENTIFIER n_mot_pu.iBihMomen /end MEASUREMENT
/begin MEASUREMENT iBihMomen.n_tsynist "Synchrondrehzahl der Turbine bei aktueller Abtriebsdrehzahl n_ab und eingelegtem Istgang" SWORD UMR_U_MIN_1_1_0_S5_S3 1 100 0 32767 ECU_ADDRESS 0xFFF8B37A DISPLAY_IDENTIFIER n_tsynist.iBihMomen /end MEASUREMENT
/begin MEASUREMENT iBihMomen.n_tsynziel "Synchrondrehzahl der Turbine bei aktueller Abtriebsdrehzahl n_ab und eingelegtem Zielgang_sas" SWORD UMR_U_MIN_1_1_0_S5_S3 1 100 0 32767 ECU_ADDRESS 0xFFF8B37C DISPLAY_IDENTIFIER n_tsynziel.iBihMomen /end MEASUREMENT
/begin MEASUREMENT iBihMomen.z_t_mverl_k0 "Zustandsgröße" UBYTE Conv.cBihMomen._.z_t_mverl_k0_S5_S3 1 100 0 2 ECU_ADDRESS 0xFFF8B378 DISPLAY_IDENTIFIER z_t_mverl_k0.iBihMomen /end MEASUREMENT
/begin MEASUREMENT iBihPumpendruck.f_evt_pumpendruck_motor "eventuell Pumpendruck ueber Motor vorhanden" UBYTE Conv.cBihPumpendruck._.f_evt_pumpendruck_motor_S5_S3 1 100 0 1 BIT_MASK 0x1 ECU_ADDRESS 0xFFF89469 DISPLAY_IDENTIFIER f_evt_pumpendruck_motor.iBihPumpendruck /end MEASUREMENT
/begin MEASUREMENT iBihPumpendruck.f_evt_pumpendruck_turbine "eventuell Pumpendruck ueber Turbine vorhanden" UBYTE Conv.cBihPumpendruck._.f_evt_pumpendruck_turbine_S5_S3 1 100 0 1 BIT_MASK 0x1 ECU_ADDRESS 0xFFF8946B DISPLAY_IDENTIFIER f_evt_pumpendruck_turbine.iBihPumpendruck /end MEASUREMENT
/begin MEASUREMENT iBihPumpendruck.f_pumpendruck_motor "Pumpendruck ueber Motor vorhanden" UBYTE Conv.cBihPumpendruck._.f_pumpendruck_motor_S5_S3 1 100 0 1 BIT_MASK 0x1 ECU_ADDRESS 0xFFF8946A DISPLAY_IDENTIFIER f_pumpendruck_motor.iBihPumpendruck /end MEASUREMENT
/begin MEASUREMENT iBihPumpendruck.f_sfkt_pumpendruck_aktiv "Pumpendruck ueber Sonderfunktion vorhanden" UBYTE Conv.cBihPumpendruck._.f_sfkt_pumpendruck_aktiv_S5_S3 1 100 0 1 BIT_MASK 0x1 ECU_ADDRESS 0xFFF8946C DISPLAY_IDENTIFIER f_sfkt_pumpendruck_aktiv.iBihPumpendruck /end MEASUREMENT
/begin MEASUREMENT iBihPumpendruck.z_pumpendruck "Zustandsgroesse zur Bestimmung Pumpendruck vorhanden" UBYTE Conv.cBihPumpendruck._.z_pumpendruck_S5_S3 1 100 0 3 ECU_ADDRESS 0xFFF8946D DISPLAY_IDENTIFIER z_pumpendruck.iBihPumpendruck /end MEASUREMENT
/begin MEASUREMENT iBihSigna.bremsbed "Bremsbedingung mit Feststellbremse" UBYTE Conv.cBihSigna._.bremsbed_S5_S3 1 100 0 1 BIT_MASK 0x1 ECU_ADDRESS 0xFFF8B38C DISPLAY_IDENTIFIER bremsbed.iBihSigna /end MEASUREMENT
/begin MEASUREMENT iBihSigna.bremsbed_ofstb "Bremsbedingung ohne Feststellbremse" UBYTE Conv.cBihSigna._.bremsbed_ofstb_S5_S3 1 100 0 1 BIT_MASK 0x1 ECU_ADDRESS 0xFFF8B38D DISPLAY_IDENTIFIER bremsbed_ofstb.iBihSigna /end MEASUREMENT
/begin MEASUREMENT iBihSigna.c_maxhotmode "Max(Getriebetemperatur,Chiptemperatur)" UBYTE UMR_GRADC__1_1_M40_S5_S3 1 100 -40 215 ECU_ADDRESS 0xFFF8B392 DISPLAY_IDENTIFIER c_maxhotmode.iBihSigna /end MEASUREMENT
/begin MEASUREMENT iBihSigna.steigung_hang_filter "-" SWORD UMR___1_1_0_S5_S3 1 100 -32768 32767 ECU_ADDRESS 0xFFF8B38E DISPLAY_IDENTIFIER steigung_hang_filter.iBihSigna /end MEASUREMENT
/begin MEASUREMENT iBihSigna.timer_neigung "Timer Neigung" UBYTE UMR_MSEC__10_1_0_S5_S3 1 100 0 2550 ECU_ADDRESS 0xFFF8B391 DISPLAY_IDENTIFIER timer_neigung.iBihSigna /end MEASUREMENT
/begin MEASUREMENT iBihSigna.timer_sollgang_pruefung "-" UBYTE UMR___1_1_0_S5_S3 1 100 0 255 ECU_ADDRESS 0xFFF8B390 DISPLAY_IDENTIFIER timer_sollgang_pruefung.iBihSigna /end MEASUREMENT
/begin MEASUREMENT iBihTimer.timer_difference "tatsächliche Timer Wert: (BS Timer - timer_old_value)" UWORD UMR_MSEC__1_1_0_S5_S3 1 100 0 65535 ECU_ADDRESS 0xFFF8D6C2 DISPLAY_IDENTIFIER timer_difference.iBihTimer /end MEASUREMENT
/begin MEASUREMENT iBihTimer.timer_difference_10ms_skal "Timerschritt für 10ms Quantisierung" UWORD UMR_MSEC__10_1_0_S5_S3 1 100 0 655350 ECU_ADDRESS 0xFFF8D6C4 DISPLAY_IDENTIFIER timer_difference_10ms_skal.iBihTimer /end MEASUREMENT
/begin MEASUREMENT iBihTimer.timer_difference_1ms_skal "Timerschritt für 10ms Quantisierung" UWORD UMR_MSEC__1_1_0_S5_S3 1 100 0 65535 ECU_ADDRESS 0xFFF8D6C6 DISPLAY_IDENTIFIER timer_difference_1ms_skal.iBihTimer /end MEASUREMENT
/begin MEASUREMENT iBihTimer.timer_old_value "letzte Timer Wert" UWORD UMR_MSEC__1_1_0_S5_S3 1 100 0 65535 ECU_ADDRESS 0xFFF8D6C8 DISPLAY_IDENTIFIER timer_old_value.iBihTimer /end MEASUREMENT
/begin MEASUREMENT iBihTimer.timer_reset.timer "Der aktuelle Timerwert" UBYTE UMR_MSEC__10_1_0_S5_S3 1 100 0 2550 ECU_ADDRESS 0xFFF8D6CA DISPLAY_IDENTIFIER timer_reset.iBihTimer /end MEASUREMENT
/begin MEASUREMENT iBihZfinf.timer32_betrieb "-" ULONG UMR___1_1_0_S5_S3 1 100 0 4294967295 ECU_ADDRESS 0xFFF8AE80 DISPLAY_IDENTIFIER timer32_betrieb.iBihZfinf /end MEASUREMENT
/begin MEASUREMENT iDiaRbmif.flag_rbm_zust_hanfahr_iae "RBM-Betriebszustand IAE für IAENOCLOSE" UBYTE Conv.cDiaRbmif._.flag_rbm_zust_hanfahr_iae_S5_S3 1 100 0 1 BIT_MASK 0x1 ECU_ADDRESS 0xFFF89475 DISPLAY_IDENTIFIER flag_rbm_zust_hanfahr_iae.iDiaRbmif /end MEASUREMENT
/begin MEASUREMENT iDiaRbmif.flag_rbm_zust_inaktiv_iae "RBM-Betriebszustand IAE für IAECLOSE und IAENOOPEN" UBYTE Conv.cDiaRbmif._.flag_rbm_zust_inaktiv_iae_S5_S3 1 100 0 1 BIT_MASK 0x1 ECU_ADDRESS 0xFFF89474 DISPLAY_IDENTIFIER flag_rbm_zust_inaktiv_iae.iDiaRbmif /end MEASUREMENT
/begin MEASUREMENT iDiaRbmif.flag_rbm_zustand_posn "RBM-Betriebszustand POSN-Plausibilisierung" UBYTE Conv.cDiaRbmif._.flag_rbm_zustand_posn_S5_S3 1 100 0 1 BIT_MASK 0x1 ECU_ADDRESS 0xFFF89473 DISPLAY_IDENTIFIER flag_rbm_zustand_posn.iDiaRbmif /end MEASUREMENT
/begin MEASUREMENT iDiaRbmif.flag_rbm_zustand_uwigkup "RBM-Betriebszustand Uebersetzungsueberwachung Kupplung" UBYTE Conv.cDiaRbmif._.flag_rbm_zustand_uwigkup_S5_S3 1 100 0 1 BIT_MASK 0x1 ECU_ADDRESS 0xFFF89470 DISPLAY_IDENTIFIER flag_rbm_zustand_uwigkup.iDiaRbmif /end MEASUREMENT
/begin MEASUREMENT iDiaRbmif.flag_rbm_zustand_uwigschalt "RBM-Betriebszustand Uebersetzungsueberwachung Schaltung" UBYTE Conv.cDiaRbmif._.flag_rbm_zustand_uwigschalt_S5_S3 1 100 0 1 BIT_MASK 0x1 ECU_ADDRESS 0xFFF8946F DISPLAY_IDENTIFIER flag_rbm_zustand_uwigschalt.iDiaRbmif /end MEASUREMENT
/begin MEASUREMENT iDiaRbmif.rbm_istgang_vorw_alt "istgang (nur positive Werte ansonsten 0) beim letzten Aufruf der RBM-Funktion" UBYTE Conv.cDiaRbmif._.rbm_istgang_vorw_alt_S5_S3 1 100 0 8 ECU_ADDRESS 0xFFF89472 DISPLAY_IDENTIFIER rbm_istgang_vorw_alt.iDiaRbmif /end MEASUREMENT
/begin MEASUREMENT iDiaRbmif.rbm_zielgang_sas_vorw_alt "zielgang_sas (nur positive Werte ansonsten 0) beim letzten Aufruf der RBM-Funktion" UBYTE Conv.cDiaRbmif._.rbm_zielgang_sas_vorw_alt_S5_S3 1 100 0 8 ECU_ADDRESS 0xFFF89471 DISPLAY_IDENTIFIER rbm_zielgang_sas_vorw_alt.iDiaRbmif /end MEASUREMENT
/begin MEASUREMENT iGeaKordi.timer_gega_laeuft "Zeitdauer seit Start GE/GA" UBYTE UMR_MSEC__10_1_0_S5_S3 1 100 0 2550 ECU_ADDRESS 0xFFF89748 DISPLAY_IDENTIFIER timer_gega_laeuft.iGeaKordi /end MEASUREMENT
/begin MEASUREMENT iIaeAdauf.iTLaufUefiae.timer "Der aktuelle Timerwert" UBYTE UMR_MSEC__10_1_0_S5_S3 1 100 0 2550 ECU_ADDRESS 0xFFF8D741 DISPLAY_IDENTIFIER iTLaufUefiae.iIaeAdauf /end MEASUREMENT
/begin MEASUREMENT iIaeAdauf.kfl_ziel_start_uefiea "kfl_ziel zum Startzeipunkt Beobachung" UBYTE Conv.cIaeAdauf._.kfl_ziel_start_uefiea_S5_S3 1 100 0 2 ECU_ADDRESS 0xFFF8D73F DISPLAY_IDENTIFIER kfl_ziel_start_uefiea.iIaeAdauf /end MEASUREMENT
/begin MEASUREMENT iIaeAdauf.m_motist_mw_uefiae "Mittelwert des gefiltertes und verzögertes Motormoment mit Eingriffen" SWORD UMR_NM__1_1_0_S5_S3 1 100 -200 1300 ECU_ADDRESS 0xFFF8D728 DISPLAY_IDENTIFIER m_motist_mw_uefiae.iIaeAdauf /end MEASUREMENT
/begin MEASUREMENT iIaeAdauf.m_motist_start_uefiae "gefiltertes und verzögertes Motormoment mit Eingriffen" SWORD UMR_NM__1_1_0_S5_S3 1 100 -200 1300 ECU_ADDRESS 0xFFF8D726 DISPLAY_IDENTIFIER m_motist_start_uefiae.iIaeAdauf /end MEASUREMENT
/begin MEASUREMENT iIaeAdauf.m_soll_mw_uefiae "Mittelwert des IAE Sollmoment Getriebeeingangsseitig" SWORD UMR_NM__1_1_0_S5_S3 1 100 -200 1300 ECU_ADDRESS 0xFFF8D72C DISPLAY_IDENTIFIER m_soll_mw_uefiae.iIaeAdauf /end MEASUREMENT
/begin MEASUREMENT iIaeAdauf.m_soll_start_uefiae "IAE Sollmoment Getriebeeingangsseitig" SWORD UMR_NM__1_1_0_S5_S3 1 100 -200 1300 ECU_ADDRESS 0xFFF8D72A DISPLAY_IDENTIFIER m_soll_start_uefiae.iIaeAdauf /end MEASUREMENT
/begin MEASUREMENT iIaeAdauf.m_stell_mw_uefiae "Mittelwert des IAE Stellmoment Anfahrkupplung" SWORD UMR_NM__1_1_0_S5_S3 1 100 -200 1300 ECU_ADDRESS 0xFFF8D730 DISPLAY_IDENTIFIER m_stell_mw_uefiae.iIaeAdauf /end MEASUREMENT
/begin MEASUREMENT iIaeAdauf.m_stell_start_uefiae "IAE Stellmoment Anfahrkupplung" SWORD UMR_NM__1_1_0_S5_S3 1 100 -200 1300 ECU_ADDRESS 0xFFF8D72E DISPLAY_IDENTIFIER m_stell_start_uefiae.iIaeAdauf /end MEASUREMENT
/begin MEASUREMENT iIaeAdauf.mue_adawert_lesen "Mue- Offset aus aktiven Adaptionswerten ausgelesen" SBYTE UMR_NM_BAR_1_1_0_S5_S3 1 100 -100 100 ECU_ADDRESS 0xFFF8D73C DISPLAY_IDENTIFIER mue_adawert_lesen.iIaeAdauf /end MEASUREMENT
/begin MEASUREMENT iIaeAdauf.mue_adawert_schreiben "Mue- Offset der in das ADA KF geschieben wird" SBYTE UMR_NM_BAR_1_1_0_S5_S3 1 100 -100 100 ECU_ADDRESS 0xFFF8D73D DISPLAY_IDENTIFIER mue_adawert_schreiben.iIaeAdauf /end MEASUREMENT
/begin MEASUREMENT iIaeAdauf.mue_diff "Gemessene Differenz MUE-Soll MUE-Ist" SWORD UMR_NM_BAR_1_1_0_S5_S3 1 100 -1000 1000 ECU_ADDRESS 0xFFF8D722 DISPLAY_IDENTIFIER mue_diff.iIaeAdauf /end MEASUREMENT
/begin MEASUREMENT iIaeAdauf.mue_ist_uefiae "Durch Adaption ermittelter Reibwert" SWORD UMR_NM_BAR_1_1_0_S5_S3 1 100 0 1000 ECU_ADDRESS 0xFFF8D71C DISPLAY_IDENTIFIER mue_ist_uefiae.iIaeAdauf /end MEASUREMENT
/begin MEASUREMENT iIaeAdauf.mue_kor_j_uefiae "Korrekturwert aus dem Traegheitskorrekturkenfeld zur zur Verbesserung von TAB_MTM_MOT_UEFIAE" SBYTE UMR_NM_BAR_1_1_0_S5_S3 1 100 -100 100 ECU_ADDRESS 0xFFF8D724 DISPLAY_IDENTIFIER mue_kor_j_uefiae.iIaeAdauf /end MEASUREMENT
/begin MEASUREMENT iIaeAdauf.mue_mw_uefiae "Mittelwert des verwendeten Mue Werts in der beobachteten Zeit" SWORD UMR_NM_BAR_1_1_0_S5_S3 1 100 0 1000 ECU_ADDRESS 0xFFF8D720 DISPLAY_IDENTIFIER mue_mw_uefiae.iIaeAdauf /end MEASUREMENT
/begin MEASUREMENT iIaeAdauf.mue_start_uefiae "Startwert des verwendeten Mue Werts" SWORD UMR_NM_BAR_1_1_0_S5_S3 1 100 0 1000 ECU_ADDRESS 0xFFF8D71E DISPLAY_IDENTIFIER mue_start_uefiae.iIaeAdauf /end MEASUREMENT
/begin MEASUREMENT iIaeAdauf.nd_mw_uefiae "Mittelwert der Differenzdrehzahl am Anfahrelement" SWORD UMR_U_MIN_1_1_0_S5_S3 1 100 -8160 8160 ECU_ADDRESS 0xFFF8D734 DISPLAY_IDENTIFIER nd_mw_uefiae.iIaeAdauf /end MEASUREMENT
/begin MEASUREMENT iIaeAdauf.nd_start_uefiae "Differenzdrehzahl am Anfahrelement" SWORD UMR_U_MIN_1_1_0_S5_S3 1 100 -8160 8160 ECU_ADDRESS 0xFFF8D732 DISPLAY_IDENTIFIER nd_start_uefiae.iIaeAdauf /end MEASUREMENT
/begin MEASUREMENT iIaeAdauf.ng_mot_mw_uefiae "Mittelwert des Gradient der Motordrehzahll" SWORD UMR_U_MINSEC_1_1_0_S5_S3 1 100 -10000 10000 ECU_ADDRESS 0xFFF8D738 DISPLAY_IDENTIFIER ng_mot_mw_uefiae.iIaeAdauf /end MEASUREMENT
/begin MEASUREMENT iIaeAdauf.ng_mot_start_uefiae "Gradient der Motordrehzahll" SWORD UMR_U_MINSEC_1_1_0_S5_S3 1 100 -10000 10000 ECU_ADDRESS 0xFFF8D736 DISPLAY_IDENTIFIER ng_mot_start_uefiae.iIaeAdauf /end MEASUREMENT
/begin MEASUREMENT iIaeAdauf.p_stell_start_uefiae "StellDruck fuer integrierte Anfahrkupplung" SWORD UMR_BAR__1_1000_0_S5_S3 1 100 -1 12.75 ECU_ADDRESS 0xFFF8D73A DISPLAY_IDENTIFIER p_stell_start_uefiae.iIaeAdauf /end MEASUREMENT
/begin MEASUREMENT iIaeAdauf.z_ada_uefiae "Zustand der IAE Uebertragunsfaehigkeits-Adaption" UBYTE Conv.cIaeAdauf._.z_ada_uefiae_S5_S3 1 100 0 1 ECU_ADDRESS 0xFFF8D740 DISPLAY_IDENTIFIER z_ada_uefiae.iIaeAdauf /end MEASUREMENT
/begin MEASUREMENT iIaeAdauf.zielgang_start_uefiae "Ziel-Gang zum Startzeipunkt Beobachung" SBYTE Conv.cIaeAdauf._.zielgang_start_uefiae_S5_S3 1 100 -1 8 ECU_ADDRESS 0xFFF8D73E DISPLAY_IDENTIFIER zielgang_start_uefiae.iIaeAdauf /end MEASUREMENT
/begin MEASUREMENT iIaeDiagn.Pt1Axrefiae.x "Filterwert" SLONG UMR___1_300_0_S5_S3 1 100 -7158278.82667 7158278.82333 ECU_ADDRESS 0xFFF8B3C0 DISPLAY_IDENTIFIER Pt1Axrefiae.iIaeDiagn /end MEASUREMENT
/begin MEASUREMENT iIaeDiagn.Pt1Mdidiagiae.x "Filterwert" SLONG UMR___1_300_0_S5_S3 1 100 -7158278.82667 7158278.82333 ECU_ADDRESS 0xFFF8B3BC DISPLAY_IDENTIFIER Pt1Mdidiagiae.iIaeDiagn /end MEASUREMENT
/begin MEASUREMENT iIaeDiagn.TimerCloseBewAktiv.maxtime "Endzeit" UWORD UMR_SEC__1_100_0_S5_S3 1 100 0 655.35 ECU_ADDRESS 0xFFF8B3DA DISPLAY_IDENTIFIER maxtime.TimerCloseBewAktiv.iIaeDiagn /end MEASUREMENT
/begin MEASUREMENT iIaeDiagn.TimerCloseBewAktiv.time "Zeit des Timers" UWORD UMR_SEC__1_100_0_S5_S3 1 100 0 655.35 ECU_ADDRESS 0xFFF8B3D8 DISPLAY_IDENTIFIER time.TimerCloseBewAktiv.iIaeDiagn /end MEASUREMENT
/begin MEASUREMENT iIaeDiagn.TimerCloseNgab.maxtime "Endzeit" UWORD UMR_SEC__1_100_0_S5_S3 1 100 0 655.35 ECU_ADDRESS 0xFFF8B3CE DISPLAY_IDENTIFIER maxtime.TimerCloseNgab.iIaeDiagn /end MEASUREMENT
/begin MEASUREMENT iIaeDiagn.TimerCloseNgab.time "Zeit des Timers" UWORD UMR_SEC__1_100_0_S5_S3 1 100 0 655.35 ECU_ADDRESS 0xFFF8B3CC DISPLAY_IDENTIFIER time.TimerCloseNgab.iIaeDiagn /end MEASUREMENT
/begin MEASUREMENT iIaeDiagn.TimerCloseRueckF.maxtime "Endzeit" UWORD UMR_SEC__1_100_0_S5_S3 1 100 0 655.35 ECU_ADDRESS 0xFFF8B3D2 DISPLAY_IDENTIFIER maxtime.TimerCloseRueckF.iIaeDiagn /end MEASUREMENT
/begin MEASUREMENT iIaeDiagn.TimerCloseRueckF.time "Zeit des Timers" UWORD UMR_SEC__1_100_0_S5_S3 1 100 0 655.35 ECU_ADDRESS 0xFFF8B3D0 DISPLAY_IDENTIFIER time.TimerCloseRueckF.iIaeDiagn /end MEASUREMENT
/begin MEASUREMENT iIaeDiagn.TimerHotDiagiae.time "Zeit des Timers" UWORD UMR_SEC__1_100_0_S5_S3 1 100 0 655.35 ECU_ADDRESS 0xFFF8B3E4 DISPLAY_IDENTIFIER TimerHotDiagiae.iIaeDiagn /end MEASUREMENT
/begin MEASUREMENT iIaeDiagn.TimerNoCloseDiagiae.maxtime "Endzeit" UWORD UMR_SEC__1_100_0_S5_S3 1 100 0 655.35 ECU_ADDRESS 0xFFF8B3CA DISPLAY_IDENTIFIER maxtime.TimerNoCloseDiagiae.iIaeDiagn /end MEASUREMENT
/begin MEASUREMENT iIaeDiagn.TimerNoCloseDiagiae.time "Zeit des Timers" UWORD UMR_SEC__1_100_0_S5_S3 1 100 0 655.35 ECU_ADDRESS 0xFFF8B3C8 DISPLAY_IDENTIFIER time.TimerNoCloseDiagiae.iIaeDiagn /end MEASUREMENT
/begin MEASUREMENT iIaeDiagn.TimerNoOpenDiagiae.maxtime "Endzeit" UWORD UMR_SEC__1_100_0_S5_S3 1 100 0 655.35 ECU_ADDRESS 0xFFF8B3C6 DISPLAY_IDENTIFIER maxtime.TimerNoOpenDiagiae.iIaeDiagn /end MEASUREMENT
/begin MEASUREMENT iIaeDiagn.TimerNoOpenDiagiae.time "Zeit des Timers" UWORD UMR_SEC__1_100_0_S5_S3 1 100 0 655.35 ECU_ADDRESS 0xFFF8B3C4 DISPLAY_IDENTIFIER time.TimerNoOpenDiagiae.iIaeDiagn /end MEASUREMENT
/begin MEASUREMENT iIaeDiagn.TimerNocloseBewAktiv.maxtime "Endzeit" UWORD UMR_SEC__1_100_0_S5_S3 1 100 0 655.35 ECU_ADDRESS 0xFFF8B3DE DISPLAY_IDENTIFIER maxtime.TimerNocloseBewAktiv.iIaeDiagn /end MEASUREMENT
/begin MEASUREMENT iIaeDiagn.TimerNocloseBewAktiv.time "Zeit des Timers" UWORD UMR_SEC__1_100_0_S5_S3 1 100 0 655.35 ECU_ADDRESS 0xFFF8B3DC DISPLAY_IDENTIFIER time.TimerNocloseBewAktiv.iIaeDiagn /end MEASUREMENT
/begin MEASUREMENT iIaeDiagn.TimerNoopenBewAktiv.maxtime "Endzeit" UWORD UMR_SEC__1_100_0_S5_S3 1 100 0 655.35 ECU_ADDRESS 0xFFF8B3E2 DISPLAY_IDENTIFIER maxtime.TimerNoopenBewAktiv.iIaeDiagn /end MEASUREMENT
/begin MEASUREMENT iIaeDiagn.TimerNoopenBewAktiv.time "Zeit des Timers" UWORD UMR_SEC__1_100_0_S5_S3 1 100 0 655.35 ECU_ADDRESS 0xFFF8B3E0 DISPLAY_IDENTIFIER time.TimerNoopenBewAktiv.iIaeDiagn /end MEASUREMENT
/begin MEASUREMENT iIaeDiagn.TimerNoopenRueckF.maxtime "Endzeit" UWORD UMR_SEC__1_100_0_S5_S3 1 100 0 655.35 ECU_ADDRESS 0xFFF8B3D6 DISPLAY_IDENTIFIER maxtime.TimerNoopenRueckF.iIaeDiagn /end MEASUREMENT
/begin MEASUREMENT iIaeDiagn.TimerNoopenRueckF.time "Zeit des Timers" UWORD UMR_SEC__1_100_0_S5_S3 1 100 0 655.35 ECU_ADDRESS 0xFFF8B3D4 DISPLAY_IDENTIFIER time.TimerNoopenRueckF.iIaeDiagn /end MEASUREMENT
/begin MEASUREMENT iIaeDiagn.ax_integral_diagiae "Laengsbeschleunigung-Summe, wird noch mit dt in Sek. multipliziert für Vergleich mit AXS_CLOSE_DIAGIAE" SLONG UMR_M_SEC_1_3200_0_S5_S3 1 100 -671088.64 671088.639687 ECU_ADDRESS 0xFFF8B3AC DISPLAY_IDENTIFIER ax_integral_diagiae.iIaeDiagn /end MEASUREMENT
/begin MEASUREMENT iIaeDiagn.flag_close_bew_aktiv_diagiae "Diagnose für Erkennung KFC_IAECLOSE aktiv" UBYTE Conv.cIaeDiagn._.flag_close_bew_aktiv_diagiae_S5_S3 1 100 0 1 BIT_MASK 0x1 ECU_ADDRESS 0xFFF8B3B7 DISPLAY_IDENTIFIER flag_close_bew_aktiv_diagiae.iIaeDiagn /end MEASUREMENT
/begin MEASUREMENT iIaeDiagn.flag_close_diagiae "Flag für Erkennung KFC_IAECLOSE" UBYTE Conv.cIaeDiagn._.flag_close_diagiae_S5_S3 1 100 0 1 BIT_MASK 0x1 ECU_ADDRESS 0xFFF8B3A3 DISPLAY_IDENTIFIER flag_close_diagiae.iIaeDiagn /end MEASUREMENT
/begin MEASUREMENT iIaeDiagn.flag_hot_diagiae "Flag für Erkennung KFC_IAEHOT" UBYTE Conv.cIaeDiagn._.flag_hot_diagiae_S5_S3 1 100 0 1 BIT_MASK 0x1 ECU_ADDRESS 0xFFF8B3A6 DISPLAY_IDENTIFIER flag_hot_diagiae.iIaeDiagn /end MEASUREMENT
/begin MEASUREMENT iIaeDiagn.flag_max_p_haupt_diagiae "maximaler Systemdruck gefordert" UBYTE Conv.cIaeDiagn._.flag_max_p_haupt_diagiae_S5_S3 1 100 0 1 BIT_MASK 0x1 ECU_ADDRESS 0xFFF8B3B2 DISPLAY_IDENTIFIER flag_max_p_haupt_diagiae.iIaeDiagn /end MEASUREMENT
/begin MEASUREMENT iIaeDiagn.flag_mmot_gespeichert_diagiae "Motormoment in diesem Anfahrzyklus gespeichert" UBYTE Conv.cIaeDiagn._.flag_mmot_gespeichert_diagiae_S5_S3 1 100 0 1 BIT_MASK 0x1 ECU_ADDRESS 0xFFF8B3B3 DISPLAY_IDENTIFIER flag_mmot_gespeichert_diagiae.iIaeDiagn /end MEASUREMENT
/begin MEASUREMENT iIaeDiagn.flag_noclose_bew_aktiv_diagiae "Diagnose für Erkennung KFC_IAENOCLOSE aktiv" UBYTE Conv.cIaeDiagn._.flag_noclose_bew_aktiv_diagiae_S5_S3 1 100 0 1 BIT_MASK 0x1 ECU_ADDRESS 0xFFF8B3B9 DISPLAY_IDENTIFIER flag_noclose_bew_aktiv_diagiae.iIaeDiagn /end MEASUREMENT
/begin MEASUREMENT iIaeDiagn.flag_noclose_diagiae "Flag für Erkennung KFC_IAENOCLOSE" UBYTE Conv.cIaeDiagn._.flag_noclose_diagiae_S5_S3 1 100 0 1 BIT_MASK 0x1 ECU_ADDRESS 0xFFF8B3A5 DISPLAY_IDENTIFIER flag_noclose_diagiae.iIaeDiagn /end MEASUREMENT
/begin MEASUREMENT iIaeDiagn.flag_noclose_hogez_diagiae "Hilfflag das anzeigt ob n_stoer_noclose_diagiae im aktuellen Anfahrvorgang bereits hochgezählt wurde" UBYTE Conv.cIaeDiagn._.flag_noclose_hogez_diagiae_S5_S3 1 100 0 1 BIT_MASK 0x1 ECU_ADDRESS 0xFFF8B3B6 DISPLAY_IDENTIFIER flag_noclose_hogez_diagiae.iIaeDiagn /end MEASUREMENT
/begin MEASUREMENT iIaeDiagn.flag_noopen_bew_aktiv_diagiae "Diagnose für Erkennung KFC_IAENOOPEN aktiv" UBYTE Conv.cIaeDiagn._.flag_noopen_bew_aktiv_diagiae_S5_S3 1 100 0 1 BIT_MASK 0x1 ECU_ADDRESS 0xFFF8B3B8 DISPLAY_IDENTIFIER flag_noopen_bew_aktiv_diagiae.iIaeDiagn /end MEASUREMENT
/begin MEASUREMENT iIaeDiagn.flag_noopen_diagiae "Flag für Erkennung KFC_IAENOOPEN" UBYTE Conv.cIaeDiagn._.flag_noopen_diagiae_S5_S3 1 100 0 1 BIT_MASK 0x1 ECU_ADDRESS 0xFFF8B3A4 DISPLAY_IDENTIFIER flag_noopen_diagiae.iIaeDiagn /end MEASUREMENT
/begin MEASUREMENT iIaeDiagn.flag_rueckf_mmot_diagiae "Hilfflag für die Auswertung der Rückfilterung IAENOCLOSE" UBYTE Conv.cIaeDiagn._.flag_rueckf_mmot_diagiae_S5_S3 1 100 0 1 BIT_MASK 0x1 ECU_ADDRESS 0xFFF8B3B4 DISPLAY_IDENTIFIER flag_rueckf_mmot_diagiae.iIaeDiagn /end MEASUREMENT
/begin MEASUREMENT iIaeDiagn.flag_rueckf_msollnmot_diagiae "Hilfflag für die Auswertung der Rückfilterung IAENOCLOSE" UBYTE Conv.cIaeDiagn._.flag_rueckf_msollnmot_diagiae_S5_S3 1 100 0 1 BIT_MASK 0x1 ECU_ADDRESS 0xFFF8B3B5 DISPLAY_IDENTIFIER flag_rueckf_msollnmot_diagiae.iIaeDiagn /end MEASUREMENT
/begin MEASUREMENT iIaeDiagn.flag_sammelbed_diagiae "Gesammelte Gleichteil-Bedingungen zur Aktivierung der Diagnosen" UBYTE Conv.cIaeDiagn._.flag_sammelbed_diagiae_S5_S3 1 100 0 1 BIT_MASK 0x1 ECU_ADDRESS 0xFFF8B3B1 DISPLAY_IDENTIFIER flag_sammelbed_diagiae.iIaeDiagn /end MEASUREMENT
/begin MEASUREMENT iIaeDiagn.flag_spassfahrt_diagiae "Spassfahrt aktiv" UBYTE Conv.cIaeDiagn._.flag_spassfahrt_diagiae_S5_S3 1 100 0 1 BIT_MASK 0x1 ECU_ADDRESS 0xFFF8B3B0 DISPLAY_IDENTIFIER flag_spassfahrt_diagiae.iIaeDiagn /end MEASUREMENT
/begin MEASUREMENT iIaeDiagn.flag_timer_hot_diagiae "Timer für Erkennung KFC_IAEHOT berechnen" UBYTE Conv.cIaeDiagn._.flag_timer_hot_diagiae_S5_S3 1 100 0 1 BIT_MASK 0x1 ECU_ADDRESS 0xFFF8B3A7 DISPLAY_IDENTIFIER flag_timer_hot_diagiae.iIaeDiagn /end MEASUREMENT
/begin MEASUREMENT iIaeDiagn.index_mot_diagiae "Hilfgröße für KF_MDI_DIAGIA: End_mot_iae oder (n_mot_iae/n_motsoll_ll_iae)*100" SWORD UMR___1_1_0_S5_S3 1 100 -10000 10000 ECU_ADDRESS 0xFFF8B3A0 DISPLAY_IDENTIFIER index_mot_diagiae.iIaeDiagn /end MEASUREMENT
/begin MEASUREMENT iIaeDiagn.m_motistoe_temp_diagiae "gespeichertes Motormoment" SWORD UMR_NM__1_1_0_S5_S3 1 100 -200 1300 ECU_ADDRESS 0xFFF8B3AA DISPLAY_IDENTIFIER m_motistoe_temp_diagiae.iIaeDiagn /end MEASUREMENT
/begin MEASUREMENT iIaeDiagn.mdi_diagiae "Motordrückindex" UBYTE UMR_U_MIN_1_1_0_S5_S3 1 100 0 100 ECU_ADDRESS 0xFFF8B3A2 DISPLAY_IDENTIFIER mdi_diagiae.iIaeDiagn /end MEASUREMENT
/begin MEASUREMENT iIaeDiagn.n_stoer_noclose_diagiae "Stoerzaehler fuer Ungenuegendes Schliessen" UBYTE UMR___1_1_0_S5_S3 1 100 0 100 ECU_ADDRESS 0xFFF8B3A8 DISPLAY_IDENTIFIER n_stoer_noclose_diagiae.iIaeDiagn /end MEASUREMENT
/begin MEASUREMENT iIaeDiagn.status_iae_hotinfo "Info über IAE-Hot-Status" UBYTE Conv.cIaeDiagn._.status_iae_hotinfo_S5_S3 1 100 0 2 ECU_ADDRESS 0xFFF8B3BA DISPLAY_IDENTIFIER status_iae_hotinfo.iIaeDiagn /end MEASUREMENT
/begin MEASUREMENT iIaeDiagn.z_close_diagiae "Zustand der Fehlererkennung IAE_CLOSE" UBYTE Conv.cIaeDiagn._.z_close_diagiae_S5_S3 1 100 0 2 ECU_ADDRESS 0xFFF8B3BB DISPLAY_IDENTIFIER z_close_diagiae.iIaeDiagn /end MEASUREMENT
/begin MEASUREMENT iIaeDraus.Dt1PGStell.Pt1Si16.x "Filterwert" SLONG UMR___1_300_0_S5_S3 1 100 -7158278.82667 7158278.82333 ECU_ADDRESS 0xFFF8B41C DISPLAY_IDENTIFIER Pt1Si16.Dt1PGStell.iIaeDraus /end MEASUREMENT
/begin MEASUREMENT iIaeDraus.Dt1PGStell.xp "Ableitung vom Eingangswert" SWORD UMR___1_1_0_S5_S3 1 100 -32768 32767 ECU_ADDRESS 0xFFF8B418 DISPLAY_IDENTIFIER Dt1PGStell.iIaeDraus /end MEASUREMENT
/begin MEASUREMENT iIaeDraus.Pt1Mue.x "Filterwert" SLONG UMR___1_300_0_S5_S3 1 100 -7158278.82667 7158278.82333 ECU_ADDRESS 0xFFF8B42C DISPLAY_IDENTIFIER Pt1Mue.iIaeDraus /end MEASUREMENT
/begin MEASUREMENT iIaeDraus.Pt1PDStellHysS.x "Filterwert" SLONG UMR___1_300_0_S5_S3 1 100 -7158278.82667 7158278.82333 ECU_ADDRESS 0xFFF8B420 DISPLAY_IDENTIFIER Pt1PDStellHysS.iIaeDraus /end MEASUREMENT
/begin MEASUREMENT iIaeDraus.Pt1PStellbasis.x "Filterwert" SLONG UMR___1_300_0_S5_S3 1 100 -7158278.82667 7158278.82333 ECU_ADDRESS 0xFFF8B430 DISPLAY_IDENTIFIER Pt1PStellbasis.iIaeDraus /end MEASUREMENT
/begin MEASUREMENT iIaeDraus.Pt1PoDyn.x "Filterwert" SLONG UMR___1_300_0_S5_S3 1 100 -7158278.82667 7158278.82333 ECU_ADDRESS 0xFFF8B428 DISPLAY_IDENTIFIER Pt1PoDyn.iIaeDraus /end MEASUREMENT
/begin MEASUREMENT iIaeDraus.Pt1PoHysKoStill.x "Filterwert" SLONG UMR___1_300_0_S5_S3 1 100 -7158278.82667 7158278.82333 ECU_ADDRESS 0xFFF8B424 DISPLAY_IDENTIFIER Pt1PoHysKoStill.iIaeDraus /end MEASUREMENT
/begin MEASUREMENT iIaeDraus.Pt2PIst.x "Filterwert" FLOAT32_IEEE UMR___1_1_0_S5_S3 1 100 -2147483648 2147483647 ECU_ADDRESS 0xFFF8B434 FORMAT "%3.2" DISPLAY_IDENTIFIER x.Pt2PIst.iIaeDraus /end MEASUREMENT
/begin MEASUREMENT iIaeDraus.Pt2PIst.xp "Ableitung vom Eingangswert" FLOAT32_IEEE UMR__SEC_1_1_0_S5_S3 1 100 -2147483648 2147483647 ECU_ADDRESS 0xFFF8B438 FORMAT "%3.2" DISPLAY_IDENTIFIER xp.Pt2PIst.iIaeDraus /end MEASUREMENT
/begin MEASUREMENT iIaeDraus.TimerHysSchl.maxtime "Endzeit" UWORD UMR_SEC__1_100_0_S5_S3 1 100 0 655.35 ECU_ADDRESS 0xFFF8B40E DISPLAY_IDENTIFIER maxtime.TimerHysSchl.iIaeDraus /end MEASUREMENT
/begin MEASUREMENT iIaeDraus.TimerHysSchl.time "Zeit des Timers" UWORD UMR_SEC__1_100_0_S5_S3 1 100 0 655.35 ECU_ADDRESS 0xFFF8B40C DISPLAY_IDENTIFIER time.TimerHysSchl.iIaeDraus /end MEASUREMENT
/begin MEASUREMENT iIaeDraus.TimerHyskompan.maxtime "Endzeit" UWORD UMR_SEC__1_100_0_S5_S3 1 100 0 655.35 ECU_ADDRESS 0xFFF8B412 DISPLAY_IDENTIFIER maxtime.TimerHyskompan.iIaeDraus /end MEASUREMENT
/begin MEASUREMENT iIaeDraus.TimerHyskompan.time "Zeit des Timers" UWORD UMR_SEC__1_100_0_S5_S3 1 100 0 655.35 ECU_ADDRESS 0xFFF8B410 DISPLAY_IDENTIFIER time.TimerHyskompan.iIaeDraus /end MEASUREMENT
/begin MEASUREMENT iIaeDraus.TimerPoDyn.maxtime "Endzeit" UWORD UMR_SEC__1_100_0_S5_S3 1 100 0 655.35 ECU_ADDRESS 0xFFF8B416 DISPLAY_IDENTIFIER maxtime.TimerPoDyn.iIaeDraus /end MEASUREMENT
/begin MEASUREMENT iIaeDraus.TimerPoDyn.time "Zeit des Timers" UWORD UMR_SEC__1_100_0_S5_S3 1 100 0 655.35 ECU_ADDRESS 0xFFF8B414 DISPLAY_IDENTIFIER time.TimerPoDyn.iIaeDraus /end MEASUREMENT
/begin MEASUREMENT iIaeDraus.f_hysschleife_aktiv_iae "Hysterese-Schleife aktiv" UBYTE Conv.cIaeDraus._.f_hysschleife_aktiv_iae_S5_S3 1 100 0 1 BIT_MASK 0x1 ECU_ADDRESS 0xFFF8B3FF DISPLAY_IDENTIFIER f_hysschleife_aktiv_iae.iIaeDraus /end MEASUREMENT
/begin MEASUREMENT iIaeDraus.f_hysschleife_moeglich_iae "Hysterese-Schleife moeglich" UBYTE Conv.cIaeDraus._.f_hysschleife_moeglich_iae_S5_S3 1 100 0 1 BIT_MASK 0x1 ECU_ADDRESS 0xFFF8B400 DISPLAY_IDENTIFIER f_hysschleife_moeglich_iae.iIaeDraus /end MEASUREMENT
/begin MEASUREMENT iIaeDraus.flag_init_ausinaktiv_iae "Initialisierung nach Inaktiv" UBYTE Conv.cIaeDraus._.flag_init_ausinaktiv_iae_S5_S3 1 100 0 1 BIT_MASK 0x1 ECU_ADDRESS 0xFFF8B403 DISPLAY_IDENTIFIER flag_init_ausinaktiv_iae.iIaeDraus /end MEASUREMENT
/begin MEASUREMENT iIaeDraus.flag_m_max_alt "Hysterese-Schleife moeglich" UBYTE Conv.cIaeDraus._.flag_m_max_alt_S5_S3 1 100 0 1 BIT_MASK 0x1 ECU_ADDRESS 0xFFF8B402 DISPLAY_IDENTIFIER flag_m_max_alt.iIaeDraus /end MEASUREMENT
/begin MEASUREMENT iIaeDraus.flag_po_dyn_aktiv_iae "Druckpeakaufschaltung aktiv" UBYTE Conv.cIaeDraus._.flag_po_dyn_aktiv_iae_S5_S3 1 100 0 1 BIT_MASK 0x1 ECU_ADDRESS 0xFFF8B401 DISPLAY_IDENTIFIER flag_po_dyn_aktiv_iae.iIaeDraus /end MEASUREMENT
/begin MEASUREMENT iIaeDraus.mpt_po_dyn_iae "Filterparameter für po_dyn_iae" UBYTE UMR___1_100_0_S5_S3 1 100 0 1 ECU_ADDRESS 0xFFF8B3F6 DISPLAY_IDENTIFIER mpt_po_dyn_iae.iIaeDraus /end MEASUREMENT
/begin MEASUREMENT iIaeDraus.mue_iae "Wandlerübertragung" SWORD UMR_NM_BAR_1_1_0_S5_S3 1 100 0 30000 ECU_ADDRESS 0xFFF8B404 DISPLAY_IDENTIFIER mue_iae.iIaeDraus /end MEASUREMENT
/begin MEASUREMENT iIaeDraus.nd_iae_kf_mue "Differenzdrehzahl am Anfahrelement, Absolutwert minimalbegrenzt für MUE-Berechnung" SWORD UMR_U_MIN_1_1_0_S5_S3 1 100 -8160 8160 ECU_ADDRESS 0xFFF8B3E8 DISPLAY_IDENTIFIER nd_iae_kf_mue.iIaeDraus /end MEASUREMENT
/begin MEASUREMENT iIaeDraus.p_ist_basis_iae "PT2-gefiltertes p_stell_basis" SWORD UMR_BAR__1_1000_0_S5_S3 1 100 -1 12.75 ECU_ADDRESS 0xFFF8B3EC DISPLAY_IDENTIFIER p_ist_basis_iae.iIaeDraus /end MEASUREMENT
/begin MEASUREMENT iIaeDraus.p_ofmin_iae "Druckoffset auf Minimaldruck p_fmin" SWORD UMR_BAR__1_1000_0_S5_S3 1 100 0 2 ECU_ADDRESS 0xFFF8B40A DISPLAY_IDENTIFIER p_ofmin_iae.iIaeDraus /end MEASUREMENT
/begin MEASUREMENT iIaeDraus.p_stell_basis_iae "Basis-Stelldruck an der IAE direkt aus m_stell_iae berechnet" SWORD UMR_BAR__1_1000_0_S5_S3 1 100 -1 12.75 ECU_ADDRESS 0xFFF8B3EA DISPLAY_IDENTIFIER p_stell_basis_iae.iIaeDraus /end MEASUREMENT
/begin MEASUREMENT iIaeDraus.p_stell_iae "StellDruck fuer integrierte Anfahrkupplung" SWORD UMR_BAR__1_1000_0_S5_S3 1 100 -1 12.75 ECU_ADDRESS 0xFFF8B408 DISPLAY_IDENTIFIER p_stell_iae.iIaeDraus /end MEASUREMENT
/begin MEASUREMENT iIaeDraus.p_stellalt_iae "StellDruck fuer integrierte Anfahrkupplung" SWORD UMR_BAR__1_1000_0_S5_S3 1 100 -1 12.75 ECU_ADDRESS 0xFFF8B406 DISPLAY_IDENTIFIER p_stellalt_iae.iIaeDraus /end MEASUREMENT
/begin MEASUREMENT iIaeDraus.pd_hysschleife_iae "Abzufilterder Differenzdruck nach der Hysterese-Schleife" SWORD UMR_BAR__1_1000_0_S5_S3 1 100 -1 12.75 ECU_ADDRESS 0xFFF8B3EE DISPLAY_IDENTIFIER pd_hysschleife_iae.iIaeDraus /end MEASUREMENT
/begin MEASUREMENT iIaeDraus.po_dyn_iae "Druckoffset für Druckpeak" SWORD UMR_BAR__1_1000_0_S5_S3 1 100 -3 12.75 ECU_ADDRESS 0xFFF8B3F2 DISPLAY_IDENTIFIER po_dyn_iae.iIaeDraus /end MEASUREMENT
/begin MEASUREMENT iIaeDraus.po_hys_iae "Druckoffset resultierend aus Hysteresekompensation gesamt" SWORD UMR_BAR__1_1000_0_S5_S3 1 100 -3 12.75 ECU_ADDRESS 0xFFF8B3F0 DISPLAY_IDENTIFIER po_hys_iae.iIaeDraus /end MEASUREMENT
/begin MEASUREMENT iIaeDraus.po_hyskomp_angelegt_iae "Druckoffset resultierend aus Hysteresekompensation im Angelegt" SWORD UMR_BAR__1_1000_0_S5_S3 1 100 -2 12.75 ECU_ADDRESS 0xFFF8B3F8 DISPLAY_IDENTIFIER po_hyskomp_angelegt_iae.iIaeDraus /end MEASUREMENT
/begin MEASUREMENT iIaeDraus.po_hyskomp_max_iae "max. Druck aus Hysteresekompensation im Stillstand" SWORD UMR_BAR__1_1000_0_S5_S3 1 100 -20 20 ECU_ADDRESS 0xFFF8B3FC DISPLAY_IDENTIFIER po_hyskomp_max_iae.iIaeDraus /end MEASUREMENT
/begin MEASUREMENT iIaeDraus.po_hyskomp_min_iae "min. Druck aus Hysteresekompensation im Stillstand" SWORD UMR_BAR__1_1000_0_S5_S3 1 100 -20 20 ECU_ADDRESS 0xFFF8B3FA DISPLAY_IDENTIFIER po_hyskomp_min_iae.iIaeDraus /end MEASUREMENT
/begin MEASUREMENT iIaeDraus.t_po_dyn_iae "Dauer des Druckpeaks" UWORD UMR_MSEC__10_1_0_S5_S3 1 100 0 600000 ECU_ADDRESS 0xFFF8B3F4 DISPLAY_IDENTIFIER t_po_dyn_iae.iIaeDraus /end MEASUREMENT
/begin MEASUREMENT iIaeDraus.z_hyskompstillunten_iae "Zustand der Hysteresekompensation im Stillstand" UBYTE Conv.cIaeDraus._.z_hyskompstillunten_iae_S5_S3 1 100 0 3 ECU_ADDRESS 0xFFF8B3FE DISPLAY_IDENTIFIER z_hyskompstillunten_iae.iIaeDraus /end MEASUREMENT
/begin MEASUREMENT iIaeKordi.TimerZIae.maxtime "Endzeit" UWORD UMR_SEC__1_100_0_S5_S3 1 100 0 655.35 ECU_ADDRESS 0xFFF8B44A DISPLAY_IDENTIFIER maxtime.TimerZIae.iIaeKordi /end MEASUREMENT
/begin MEASUREMENT iIaeKordi.TimerZIae.time "Zeit des Timers" UWORD UMR_SEC__1_100_0_S5_S3 1 100 0 655.35 ECU_ADDRESS 0xFFF8B448 DISPLAY_IDENTIFIER time.TimerZIae.iIaeKordi /end MEASUREMENT
/begin MEASUREMENT iIaeKordi.f_torqfuse_iae "Torqfuse!" UBYTE Conv.cIaeKordi._.f_torqfuse_iae_S5_S3 1 100 0 1 BIT_MASK 0x1 ECU_ADDRESS 0xFFF8B43F DISPLAY_IDENTIFIER f_torqfuse_iae.iIaeKordi /end MEASUREMENT
/begin MEASUREMENT iIaeKordi.flag_zu_gewesen_iae "IAE war schon einmal zu" UBYTE Conv.cIaeKordi._.flag_zu_gewesen_iae_S5_S3 1 100 0 1 BIT_MASK 0x1 ECU_ADDRESS 0xFFF8B440 DISPLAY_IDENTIFIER flag_zu_gewesen_iae.iIaeKordi /end MEASUREMENT
/begin MEASUREMENT iIaeKordi.kup_status_iae "Kupplungsstatus der Anfahrkupplung" UBYTE Conv.cIaeKordi._.kup_status_iae_S5_S3 1 100 0 8 ECU_ADDRESS 0xFFF8B446 DISPLAY_IDENTIFIER kup_status_iae.iIaeKordi /end MEASUREMENT
/begin MEASUREMENT iIaeKordi.t_angelegt_iae "Zeit im Zustand Stillstand" UWORD UMR_MSEC__10_1_0_S5_S3 1 100 0 600000 ECU_ADDRESS 0xFFF8B444 DISPLAY_IDENTIFIER t_angelegt_iae.iIaeKordi /end MEASUREMENT
/begin MEASUREMENT iIaeKordi.t_nds_zu_iae "Zeit seit wann die Schwelle NDS_ZU unterschritten ist" UBYTE UMR_MSEC__10_1_0_S5_S3 1 100 0 2550 ECU_ADDRESS 0xFFF8B43E DISPLAY_IDENTIFIER t_nds_zu_iae.iIaeKordi /end MEASUREMENT
/begin MEASUREMENT iIaeKordi.timer_z_iae "Zeit im aktuellen IAE Zustand" UWORD UMR_MSEC__10_1_0_S5_S3 1 100 0 600000 ECU_ADDRESS 0xFFF8B442 DISPLAY_IDENTIFIER timer_z_iae.iIaeKordi /end MEASUREMENT
/begin MEASUREMENT iIaeKordi.z_iae "Zustand der Anfahrkupplung" UBYTE Conv.cIaeKordi._.z_iae_S5_S3 1 100 0 9 ECU_ADDRESS 0xFFF8B43C DISPLAY_IDENTIFIER z_iae.iIaeKordi /end MEASUREMENT
/begin MEASUREMENT iIaeKordi.z_iae_temp "letzter Zustand der Anfahrkupplung" UBYTE Conv.cIaeKordi._.z_iae_temp_S5_S3 1 100 0 10 ECU_ADDRESS 0xFFF8B43D DISPLAY_IDENTIFIER z_iae_temp.iIaeKordi /end MEASUREMENT
/begin MEASUREMENT iIaeKuehl.Pt1Vpsoll.x "Filterwert" SLONG UMR___1_300_0_S5_S3 1 100 -7158278.82667 7158278.82333 ECU_ADDRESS 0xFFF8B45C DISPLAY_IDENTIFIER Pt1Vpsoll.iIaeKuehl /end MEASUREMENT
/begin MEASUREMENT iIaeKuehl.TimerZModusIae.maxtime "Endzeit" UWORD UMR_SEC__1_100_0_S5_S3 1 100 0 655.35 ECU_ADDRESS 0xFFF8B462 DISPLAY_IDENTIFIER maxtime.TimerZModusIae.iIaeKuehl /end MEASUREMENT
/begin MEASUREMENT iIaeKuehl.TimerZModusIae.time "Zeit des Timers" UWORD UMR_SEC__1_100_0_S5_S3 1 100 0 655.35 ECU_ADDRESS 0xFFF8B460 DISPLAY_IDENTIFIER time.TimerZModusIae.iIaeKuehl /end MEASUREMENT
/begin MEASUREMENT iIaeKuehl.f_min_em_kuehl_iae "Anforderung einer min EM-Drehzahl wegen Kuehlung IAE" UBYTE UMR___1_1_0_S5_S3 1 100 0 1 BIT_MASK 0x1 ECU_ADDRESS 0xFFF8B458 DISPLAY_IDENTIFIER f_min_em_kuehl_iae.iIaeKuehl /end MEASUREMENT
/begin MEASUREMENT iIaeKuehl.flag_kuehlung_im_inaktiv "Kuehlung im Zustand INAKTIV aktiv" UBYTE UMR___1_1_0_S5_S3 1 100 0 1 BIT_MASK 0x1 ECU_ADDRESS 0xFFF8B452 DISPLAY_IDENTIFIER flag_kuehlung_im_inaktiv.iIaeKuehl /end MEASUREMENT
/begin MEASUREMENT iIaeKuehl.p_kuehl_soll_iae "Soll-Kühlöldruck" SWORD UMR_BAR__1_1000_0_S5_S3 1 100 -1 12.75 ECU_ADDRESS 0xFFF8B456 DISPLAY_IDENTIFIER p_kuehl_soll_iae.iIaeKuehl /end MEASUREMENT
/begin MEASUREMENT iIaeKuehl.vp_kuehl_korr_iae "Kuehloelvolumenstrom korrigiert" SWORD UMR_LITER_MIN_1_10_0_S5_S3 1 100 0 50 ECU_ADDRESS 0xFFF8B44E DISPLAY_IDENTIFIER vp_kuehl_korr_iae.iIaeKuehl /end MEASUREMENT
/begin MEASUREMENT iIaeKuehl.vp_kuehl_max_iae "maximaler Kuehloelvolumenstrom Iae" SWORD UMR_LITER_MIN_1_10_0_S5_S3 1 100 0 50 ECU_ADDRESS 0xFFF8B450 DISPLAY_IDENTIFIER vp_kuehl_max_iae.iIaeKuehl /end MEASUREMENT
/begin MEASUREMENT iIaeKuehl.vp_kuehl_soll_iae "Kuehloelvolumenstrom soll" SWORD UMR_LITER_MIN_1_10_0_S5_S3 1 100 0 50 ECU_ADDRESS 0xFFF8B44C DISPLAY_IDENTIFIER vp_kuehl_soll_iae.iIaeKuehl /end MEASUREMENT
/begin MEASUREMENT iIaeKuehl.vp_sek_k0_iae "Kuehloelvolumenstrom für K0" SWORD UMR_LITER_MIN_1_10_0_S5_S3 1 100 0 50 ECU_ADDRESS 0xFFF8B454 DISPLAY_IDENTIFIER vp_sek_k0_iae.iIaeKuehl /end MEASUREMENT
/begin MEASUREMENT iIaeMomen.BibPIDIae.faktor_d "Param. D-Anteil" FLOAT32_IEEE UMR___1_1_0_S5_S3 1 100 -1e+037 1e+037 ECU_ADDRESS 0xFFF8B53C FORMAT "%3.2" DISPLAY_IDENTIFIER faktor_d.BibPIDIae.iIaeMomen /end MEASUREMENT
/begin MEASUREMENT iIaeMomen.BibPIDIae.faktor_i "Param. I-Anteil" FLOAT32_IEEE UMR___1_1_0_S5_S3 1 100 -1e+037 1e+037 ECU_ADDRESS 0xFFF8B538 FORMAT "%3.2" DISPLAY_IDENTIFIER faktor_i.BibPIDIae.iIaeMomen /end MEASUREMENT
/begin MEASUREMENT iIaeMomen.BibPIDIae.faktor_p "Param. P-Anteil" FLOAT32_IEEE UMR___1_1_0_S5_S3 1 100 -1e+037 1e+037 ECU_ADDRESS 0xFFF8B534 FORMAT "%3.2" DISPLAY_IDENTIFIER faktor_p.BibPIDIae.iIaeMomen /end MEASUREMENT
/begin MEASUREMENT iIaeMomen.BibPIDIae.faktor_t1 "Param. T1-Anteil" FLOAT32_IEEE UMR___1_1_0_S5_S3 1 100 -1e+037 1e+037 ECU_ADDRESS 0xFFF8B540 FORMAT "%3.2" DISPLAY_IDENTIFIER faktor_t1.BibPIDIae.iIaeMomen /end MEASUREMENT
/begin MEASUREMENT iIaeMomen.BibPIDIae.regel_diff_alt "verzoeg. Regeldifferenz" FLOAT32_IEEE UMR___1_1_0_S5_S3 1 100 -1e+037 1e+037 ECU_ADDRESS 0xFFF8B54C FORMAT "%3.2" DISPLAY_IDENTIFIER regel_diff_alt.BibPIDIae.iIaeMomen /end MEASUREMENT
/begin MEASUREMENT iIaeMomen.BibPIDIae.stell_max "maximale Stellgroesse" FLOAT32_IEEE UMR___1_1_0_S5_S3 1 100 -1e+037 1e+037 ECU_ADDRESS 0xFFF8B544 FORMAT "%3.2" DISPLAY_IDENTIFIER stell_max.BibPIDIae.iIaeMomen /end MEASUREMENT
/begin MEASUREMENT iIaeMomen.BibPIDIae.stell_min "minimale Stellgroesse" FLOAT32_IEEE UMR___1_1_0_S5_S3 1 100 -1e+037 1e+037 ECU_ADDRESS 0xFFF8B548 FORMAT "%3.2" DISPLAY_IDENTIFIER stell_min.BibPIDIae.iIaeMomen /end MEASUREMENT
/begin MEASUREMENT iIaeMomen.BibPIDIae.stellgr_alt "verzoegerte Stellgroesse" FLOAT32_IEEE UMR___1_1_0_S5_S3 1 100 -1e+037 1e+037 ECU_ADDRESS 0xFFF8B550 FORMAT "%3.2" DISPLAY_IDENTIFIER stellgr_alt.BibPIDIae.iIaeMomen /end MEASUREMENT
/begin MEASUREMENT iIaeMomen.BibPIDIae.stellgr_d_alt "verzoegerte D-Stellgroesse" FLOAT32_IEEE UMR___1_1_0_S5_S3 1 100 -1e+037 1e+037 ECU_ADDRESS 0xFFF8B530 FORMAT "%3.2" DISPLAY_IDENTIFIER stellgr_d_alt.BibPIDIae.iIaeMomen /end MEASUREMENT
/begin MEASUREMENT iIaeMomen.BibPIDIae.stellgr_i_alt "verzoegerte I-Stellgroesse" FLOAT32_IEEE UMR___1_1_0_S5_S3 1 100 -1e+037 1e+037 ECU_ADDRESS 0xFFF8B52C FORMAT "%3.2" DISPLAY_IDENTIFIER stellgr_i_alt.BibPIDIae.iIaeMomen /end MEASUREMENT
/begin MEASUREMENT iIaeMomen.BibPIDIae.stellgr_i_modulo "Ganzzahl. Rest d. I-Quotient" FLOAT32_IEEE UMR___1_1_0_S5_S3 1 100 -1e+037 1e+037 ECU_ADDRESS 0xFFF8B554 FORMAT "%3.2" DISPLAY_IDENTIFIER stellgr_i_modulo.BibPIDIae.iIaeMomen /end MEASUREMENT
/begin MEASUREMENT iIaeMomen.Pt1IStuetz.x "Filterwert" SLONG UMR___1_300_0_S5_S3 1 100 -7158278.82667 7158278.82333 ECU_ADDRESS 0xFFF8B568 DISPLAY_IDENTIFIER Pt1IStuetz.iIaeMomen /end MEASUREMENT
/begin MEASUREMENT iIaeMomen.Pt1NMotAnfah.x "Filterwert" SLONG UMR___1_300_0_S5_S3 1 100 -7158278.82667 7158278.82333 ECU_ADDRESS 0xFFF8B564 DISPLAY_IDENTIFIER Pt1NMotAnfah.iIaeMomen /end MEASUREMENT
/begin MEASUREMENT iIaeMomen.Pt2MIstVorstIae.x "Filterwert" FLOAT32_IEEE UMR___1_1_0_S5_S3 1 100 -2147483648 2147483647 ECU_ADDRESS 0xFFF8B56C FORMAT "%3.2" DISPLAY_IDENTIFIER x.Pt2MIstVorstIae.iIaeMomen /end MEASUREMENT
/begin MEASUREMENT iIaeMomen.Pt2MIstVorstIae.xp "Ableitung vom Eingangswert" FLOAT32_IEEE UMR__SEC_1_1_0_S5_S3 1 100 -2147483648 2147483647 ECU_ADDRESS 0xFFF8B570 FORMAT "%3.2" DISPLAY_IDENTIFIER xp.Pt2MIstVorstIae.iIaeMomen /end MEASUREMENT
/begin MEASUREMENT iIaeMomen.Pt2NMotAnfahrt.x "Filterwert" FLOAT32_IEEE UMR___1_1_0_S5_S3 1 100 -2147483648 2147483647 ECU_ADDRESS 0xFFF8B55C FORMAT "%3.2" DISPLAY_IDENTIFIER x.Pt2NMotAnfahrt.iIaeMomen /end MEASUREMENT
/begin MEASUREMENT iIaeMomen.Pt2NMotAnfahrt.xp "Ableitung vom Eingangswert" FLOAT32_IEEE UMR__SEC_1_1_0_S5_S3 1 100 -2147483648 2147483647 ECU_ADDRESS 0xFFF8B560 FORMAT "%3.2" DISPLAY_IDENTIFIER xp.Pt2NMotAnfahrt.iIaeMomen /end MEASUREMENT
/begin MEASUREMENT iIaeMomen.TimerKflMiaeauf.maxtime "Endzeit" UWORD UMR_SEC__1_100_0_S5_S3 1 100 0 655.35 ECU_ADDRESS 0xFFF8B576 DISPLAY_IDENTIFIER maxtime.TimerKflMiaeauf.iIaeMomen /end MEASUREMENT
/begin MEASUREMENT iIaeMomen.TimerKflMiaeauf.time "Zeit des Timers" UWORD UMR_SEC__1_100_0_S5_S3 1 100 0 655.35 ECU_ADDRESS 0xFFF8B574 DISPLAY_IDENTIFIER time.TimerKflMiaeauf.iIaeMomen /end MEASUREMENT
/begin MEASUREMENT iIaeMomen.TimerMiaeaufAnfahr.maxtime "Endzeit" UWORD UMR_SEC__1_100_0_S5_S3 1 100 0 655.35 ECU_ADDRESS 0xFFF8B57A DISPLAY_IDENTIFIER maxtime.TimerMiaeaufAnfahr.iIaeMomen /end MEASUREMENT
/begin MEASUREMENT iIaeMomen.TimerMiaeaufAnfahr.time "Zeit des Timers" UWORD UMR_SEC__1_100_0_S5_S3 1 100 0 655.35 ECU_ADDRESS 0xFFF8B578 DISPLAY_IDENTIFIER time.TimerMiaeaufAnfahr.iIaeMomen /end MEASUREMENT
/begin MEASUREMENT iIaeMomen.TimerNachMmaxHas.maxtime "Endzeit" UWORD UMR_SEC__1_100_0_S5_S3 1 100 0 655.35 ECU_ADDRESS 0xFFF8B57E DISPLAY_IDENTIFIER maxtime.TimerNachMmaxHas.iIaeMomen /end MEASUREMENT
/begin MEASUREMENT iIaeMomen.TimerNachMmaxHas.time "Zeit des Timers" UWORD UMR_SEC__1_100_0_S5_S3 1 100 0 655.35 ECU_ADDRESS 0xFFF8B57C DISPLAY_IDENTIFIER time.TimerNachMmaxHas.iIaeMomen /end MEASUREMENT
/begin MEASUREMENT iIaeMomen.TimerPulsCue.maxtime "Endzeit" UWORD UMR_SEC__1_100_0_S5_S3 1 100 0 655.35 ECU_ADDRESS 0xFFF8B58E DISPLAY_IDENTIFIER maxtime.TimerPulsCue.iIaeMomen /end MEASUREMENT
/begin MEASUREMENT iIaeMomen.TimerPulsCue.time "Zeit des Timers" UWORD UMR_SEC__1_100_0_S5_S3 1 100 0 655.35 ECU_ADDRESS 0xFFF8B58C DISPLAY_IDENTIFIER time.TimerPulsCue.iIaeMomen /end MEASUREMENT
/begin MEASUREMENT iIaeMomen.TimerPulsCueAktiv.maxtime "Endzeit" UWORD UMR_SEC__1_100_0_S5_S3 1 100 0 655.35 ECU_ADDRESS 0xFFF8B592 DISPLAY_IDENTIFIER maxtime.TimerPulsCueAktiv.iIaeMomen /end MEASUREMENT
/begin MEASUREMENT iIaeMomen.TimerPulsCueAktiv.time "Zeit des Timers" UWORD UMR_SEC__1_100_0_S5_S3 1 100 0 655.35 ECU_ADDRESS 0xFFF8B590 DISPLAY_IDENTIFIER time.TimerPulsCueAktiv.iIaeMomen /end MEASUREMENT
/begin MEASUREMENT iIaeMomen.TimerUefIstuetz.maxtime "Endzeit" UWORD UMR_SEC__1_100_0_S5_S3 1 100 0 655.35 ECU_ADDRESS 0xFFF8B582 DISPLAY_IDENTIFIER maxtime.TimerUefIstuetz.iIaeMomen /end MEASUREMENT
/begin MEASUREMENT iIaeMomen.TimerUefIstuetz.time "Zeit des Timers" UWORD UMR_SEC__1_100_0_S5_S3 1 100 0 655.35 ECU_ADDRESS 0xFFF8B580 DISPLAY_IDENTIFIER time.TimerUefIstuetz.iIaeMomen /end MEASUREMENT
/begin MEASUREMENT iIaeMomen.TimerUefKriechen.maxtime "Endzeit" UWORD UMR_SEC__1_100_0_S5_S3 1 100 0 655.35 ECU_ADDRESS 0xFFF8B586 DISPLAY_IDENTIFIER maxtime.TimerUefKriechen.iIaeMomen /end MEASUREMENT
/begin MEASUREMENT iIaeMomen.TimerUefKriechen.time "Zeit des Timers" UWORD UMR_SEC__1_100_0_S5_S3 1 100 0 655.35 ECU_ADDRESS 0xFFF8B584 DISPLAY_IDENTIFIER time.TimerUefKriechen.iIaeMomen /end MEASUREMENT
/begin MEASUREMENT iIaeMomen.TimerUefMVorKriechen.maxtime "Endzeit" UWORD UMR_SEC__1_100_0_S5_S3 1 100 0 655.35 ECU_ADDRESS 0xFFF8B58A DISPLAY_IDENTIFIER maxtime.TimerUefMVorKriechen.iIaeMomen /end MEASUREMENT
/begin MEASUREMENT iIaeMomen.TimerUefMVorKriechen.time "Zeit des Timers" UWORD UMR_SEC__1_100_0_S5_S3 1 100 0 655.35 ECU_ADDRESS 0xFFF8B588 DISPLAY_IDENTIFIER time.TimerUefMVorKriechen.iIaeMomen /end MEASUREMENT
/begin MEASUREMENT iIaeMomen.cd_iae "Reglerkoeffizienten" FLOAT32_IEEE UMR___1_1_0_S5_S3 1 100 -10000 10000 ECU_ADDRESS 0xFFF8B4D0 FORMAT "%3.2" DISPLAY_IDENTIFIER cd_iae.iIaeMomen /end MEASUREMENT
/begin MEASUREMENT iIaeMomen.ci_iae "Reglerkoeffizienten" FLOAT32_IEEE UMR___1_1_0_S5_S3 1 100 -10000 10000 ECU_ADDRESS 0xFFF8B4D4 FORMAT "%3.2" DISPLAY_IDENTIFIER ci_iae.iIaeMomen /end MEASUREMENT
/begin MEASUREMENT iIaeMomen.cp_iae "Reglerkoeffizienten" FLOAT32_IEEE UMR___1_1_0_S5_S3 1 100 -10000 10000 ECU_ADDRESS 0xFFF8B4D8 FORMAT "%3.2" DISPLAY_IDENTIFIER cp_iae.iIaeMomen /end MEASUREMENT
/begin MEASUREMENT iIaeMomen.ct1_iae "Reglerkoeffizienten" FLOAT32_IEEE UMR___1_1_0_S5_S3 1 100 -10000 10000 ECU_ADDRESS 0xFFF8B4DC FORMAT "%3.2" DISPLAY_IDENTIFIER ct1_iae.iIaeMomen /end MEASUREMENT
/begin MEASUREMENT iIaeMomen.dki_maxiae "max. Wert gefiltertes Fahrpedal" UBYTE UMR_PROZENT__20_51_0_S5_S3 1 100 0 100 ECU_ADDRESS 0xFFF8B49C DISPLAY_IDENTIFIER dki_maxiae.iIaeMomen /end MEASUREMENT
/begin MEASUREMENT iIaeMomen.f_m_basis_anfahrt_iae "Faktor auf Anfahmoment im H/E-Anfahren IAE" SWORD UMR___1_100_0_S5_S3 1 100 0 30 ECU_ADDRESS 0xFFF8B468 DISPLAY_IDENTIFIER f_m_basis_anfahrt_iae.iIaeMomen /end MEASUREMENT
/begin MEASUREMENT iIaeMomen.f_miaeaufdki_iae "Faktor m_iaeauf für Lastrückmahme im Anfahren" FLOAT32_IEEE UMR___1_1_0_S5_S3 1 100 0 2 ECU_ADDRESS 0xFFF8B504 FORMAT "%3.2" DISPLAY_IDENTIFIER f_miaeaufdki_iae.iIaeMomen /end MEASUREMENT
/begin MEASUREMENT iIaeMomen.f_mschlepp_iae "Faktor m_schlepp_iae für Rückfilterung im Anfahren Synchronisieren und Zu" FLOAT32_IEEE UMR___1_1_0_S5_S3 1 100 0 2 ECU_ADDRESS 0xFFF8B508 FORMAT "%3.2" DISPLAY_IDENTIFIER f_mschlepp_iae.iIaeMomen /end MEASUREMENT
/begin MEASUREMENT iIaeMomen.f_nganfahrt_iae "Faktor auf Anfahrdrehzahlgradient während GE" SWORD UMR___1_100_0_S5_S3 1 100 0 2 ECU_ADDRESS 0xFFF8B46A DISPLAY_IDENTIFIER f_nganfahrt_iae.iIaeMomen /end MEASUREMENT
/begin MEASUREMENT iIaeMomen.f_sign_puls_iae "Vorzeichen vom Puls für Ubertemperaturrippeln" SBYTE UMR___1_1_0_S5_S3 1 100 -1 1 ECU_ADDRESS 0xFFF8B520 DISPLAY_IDENTIFIER f_sign_puls_iae.iIaeMomen /end MEASUREMENT
/begin MEASUREMENT iIaeMomen.flag_first_reglerinit_iae "Regler im Kriechen wurde schon mal initialisiert Nur einmalig setzen" UBYTE Conv.cIaeMomen._.flag_first_reglerinit_iae_S5_S3 1 100 0 1 BIT_MASK 0x1 ECU_ADDRESS 0xFFF8B4F7 DISPLAY_IDENTIFIER flag_first_reglerinit_iae.iIaeMomen /end MEASUREMENT
/begin MEASUREMENT iIaeMomen.flag_initmistvorst_iae "Initialisierung von m_ist_vorst_iae" UBYTE Conv.cIaeMomen._.flag_initmistvorst_iae_S5_S3 1 100 0 1 BIT_MASK 0x1 ECU_ADDRESS 0xFFF8B51B DISPLAY_IDENTIFIER flag_initmistvorst_iae.iIaeMomen /end MEASUREMENT
/begin MEASUREMENT iIaeMomen.flag_initsollanfahr_iae "Initialisierungfase des Sollwerts im Anfahren aktiv" UBYTE Conv.cIaeMomen._.flag_initsollanfahr_iae_S5_S3 1 100 0 1 BIT_MASK 0x1 ECU_ADDRESS 0xFFF8B465 DISPLAY_IDENTIFIER flag_initsollanfahr_iae.iIaeMomen /end MEASUREMENT
/begin MEASUREMENT iIaeMomen.flag_kaltanfahren_aktiv_iae "IAE fährt im Kaltanfahr-Modus an" UBYTE Conv.cIaeMomen._.flag_kaltanfahren_aktiv_iae_S5_S3 1 100 0 1 BIT_MASK 0x1 ECU_ADDRESS 0xFFF8B467 DISPLAY_IDENTIFIER flag_kaltanfahren_aktiv_iae.iIaeMomen /end MEASUREMENT
/begin MEASUREMENT iIaeMomen.flag_mvorberechnug_aktiv_iae "Berechnung von m_vorsteuer im Kriechen aktiv" UBYTE Conv.cIaeMomen._.flag_mvorberechnug_aktiv_iae_S5_S3 1 100 0 1 BIT_MASK 0x1 ECU_ADDRESS 0xFFF8B526 DISPLAY_IDENTIFIER flag_mvorberechnug_aktiv_iae.iIaeMomen /end MEASUREMENT
/begin MEASUREMENT iIaeMomen.flag_nsmotmaxc_iae "Motordrehzahl im Anfahrvorgang einmalig über NS_MOTANFAHRMAXC_IAE" UBYTE Conv.cIaeMomen._.flag_nsmotmaxc_iae_S5_S3 1 100 0 1 BIT_MASK 0x1 ECU_ADDRESS 0xFFF8B4FB DISPLAY_IDENTIFIER flag_nsmotmaxc_iae.iIaeMomen /end MEASUREMENT
/begin MEASUREMENT iIaeMomen.flag_pulscue_aktiv_iae "Momentenpuls bei Übertemperatur aktiv" UBYTE Conv.cIaeMomen._.flag_pulscue_aktiv_iae_S5_S3 1 100 0 1 BIT_MASK 0x1 ECU_ADDRESS 0xFFF8B524 DISPLAY_IDENTIFIER flag_pulscue_aktiv_iae.iIaeMomen /end MEASUREMENT
/begin MEASUREMENT iIaeMomen.flag_regler_aktiv "Regler ist aktiv" UBYTE Conv.cIaeMomen._.flag_regler_aktiv_S5_S3 1 100 0 1 BIT_MASK 0x1 ECU_ADDRESS 0xFFF8B4F6 DISPLAY_IDENTIFIER flag_regler_aktiv.iIaeMomen /end MEASUREMENT
/begin MEASUREMENT iIaeMomen.flag_schaltung_aktiv_iae "schaltung aktiv" UBYTE Conv.cIaeMomen._.flag_schaltung_aktiv_iae_S5_S3 1 100 0 1 BIT_MASK 0x1 ECU_ADDRESS 0xFFF8B525 DISPLAY_IDENTIFIER flag_schaltung_aktiv_iae.iIaeMomen /end MEASUREMENT
/begin MEASUREMENT iIaeMomen.flag_schrittschaltung_iae "Kopie von schrittschaltung zur Flankenerkennung" UBYTE Conv.cIaeMomen._.flag_schrittschaltung_iae_S5_S3 1 100 0 1 BIT_MASK 0x1 ECU_ADDRESS 0xFFF8B48C DISPLAY_IDENTIFIER flag_schrittschaltung_iae.iIaeMomen /end MEASUREMENT
/begin MEASUREMENT iIaeMomen.flag_t_ueffix_iae "Flag wird gesetzt, wenn t_uef_iae fix ist, und nur zum Zustandswechsel gesetzt wird" UBYTE Conv.cIaeMomen._.flag_t_ueffix_iae_S5_S3 1 100 0 1 BIT_MASK 0x1 ECU_ADDRESS 0xFFF8B466 DISPLAY_IDENTIFIER flag_t_ueffix_iae.iIaeMomen /end MEASUREMENT
/begin MEASUREMENT iIaeMomen.flag_ueflaeuft_iae "Überführungsfunktion im Zustand läuft" UBYTE Conv.cIaeMomen._.flag_ueflaeuft_iae_S5_S3 1 100 0 1 BIT_MASK 0x1 ECU_ADDRESS 0xFFF8B464 DISPLAY_IDENTIFIER flag_ueflaeuft_iae.iIaeMomen /end MEASUREMENT
/begin MEASUREMENT iIaeMomen.flag_zu_erreicht_iae "Zu-Rampe beendet" UBYTE Conv.cIaeMomen._.flag_zu_erreicht_iae_S5_S3 1 100 0 1 BIT_MASK 0x1 ECU_ADDRESS 0xFFF8B4FA DISPLAY_IDENTIFIER flag_zu_erreicht_iae.iIaeMomen /end MEASUREMENT
/begin MEASUREMENT iIaeMomen.i_stuetz_iae "Stützfaktor der IAE-Kupplung" SWORD UMR___1_1000_0_S5_S3 1 100 0 6 ECU_ADDRESS 0xFFF8B484 DISPLAY_IDENTIFIER i_stuetz_iae.iIaeMomen /end MEASUREMENT
/begin MEASUREMENT iIaeMomen.i_stuetzalt_iae "Stützfaktor der IAE-Kupplung alt" SWORD UMR___1_1000_0_S5_S3 1 100 0 6 ECU_ADDRESS 0xFFF8B486 DISPLAY_IDENTIFIER i_stuetzalt_iae.iIaeMomen /end MEASUREMENT
/begin MEASUREMENT iIaeMomen.i_stuetzziel_iae "Stützfaktor der IAE-Kupplung ziel" SWORD UMR___1_1000_0_S5_S3 1 100 0 6 ECU_ADDRESS 0xFFF8B488 DISPLAY_IDENTIFIER i_stuetzziel_iae.iIaeMomen /end MEASUREMENT
/begin MEASUREMENT iIaeMomen.kd_iae "Reglerparameter D-Anteil" FLOAT32_IEEE UMR___1_1_0_S5_S3 1 100 -10000 10000 ECU_ADDRESS 0xFFF8B4C4 FORMAT "%3.2" DISPLAY_IDENTIFIER kd_iae.iIaeMomen /end MEASUREMENT
/begin MEASUREMENT iIaeMomen.kfl_ziel_tmp_iae "kfl_ziel" UBYTE Conv.cIaeMomen._.kfl_ziel_tmp_iae_S5_S3 1 100 0 2 ECU_ADDRESS 0xFFF8B51C DISPLAY_IDENTIFIER kfl_ziel_tmp_iae.iIaeMomen /end MEASUREMENT
/begin MEASUREMENT iIaeMomen.ki_iae "Reglerparameter I-Anteil" FLOAT32_IEEE UMR___1_1_0_S5_S3 1 100 -10000 10000 ECU_ADDRESS 0xFFF8B4C8 FORMAT "%3.2" DISPLAY_IDENTIFIER ki_iae.iIaeMomen /end MEASUREMENT
/begin MEASUREMENT iIaeMomen.kp_iae "Reglerparameter P-Anteil" FLOAT32_IEEE UMR___1_1_0_S5_S3 1 100 -10000 10000 ECU_ADDRESS 0xFFF8B4CC FORMAT "%3.2" DISPLAY_IDENTIFIER kp_iae.iIaeMomen /end MEASUREMENT
/begin MEASUREMENT iIaeMomen.m_alt_iae "Moment aus letztem Zustand" SWORD UMR_NM__1_1_0_S5_S3 1 100 -200 1300 ECU_ADDRESS 0xFFF8B4B8 DISPLAY_IDENTIFIER m_alt_iae.iIaeMomen /end MEASUREMENT
/begin MEASUREMENT iIaeMomen.m_basis_anfahrt_iae "Basis für Anfahrmoment im H/E-Anfahren IAE" SWORD UMR_NM__1_1_0_S5_S3 1 100 -200 1300 ECU_ADDRESS 0xFFF8B4B4 DISPLAY_IDENTIFIER m_basis_anfahrt_iae.iIaeMomen /end MEASUREMENT
/begin MEASUREMENT iIaeMomen.m_iaeauf "IAE-AufnahmemomentMoment" SWORD UMR_NM__1_1_0_S5_S3 1 100 -200 1300 ECU_ADDRESS 0xFFF8B490 DISPLAY_IDENTIFIER m_iaeauf.iIaeMomen /end MEASUREMENT
/begin MEASUREMENT iIaeMomen.m_iaeauf_alt "altes IAE-AufnahmemomentMoment aus letztem Zustand" SWORD UMR_NM__1_1_0_S5_S3 1 100 -200 1300 ECU_ADDRESS 0xFFF8B4FE DISPLAY_IDENTIFIER m_iaeauf_alt.iIaeMomen /end MEASUREMENT
/begin MEASUREMENT iIaeMomen.m_iaeauf_frozen "eingefrorenes IAE-AufnahmemomentMoment" SWORD UMR_NM__1_1_0_S5_S3 1 100 -200 1300 ECU_ADDRESS 0xFFF8B500 DISPLAY_IDENTIFIER m_iaeauf_frozen.iIaeMomen /end MEASUREMENT
/begin MEASUREMENT iIaeMomen.m_iaeauf_ramp "Rampe IAE-AufnahmemomentMoment" SLONG UMR_NM__1_100_0_S5_S3 1 100 -1000 1000 ECU_ADDRESS 0xFFF8B494 DISPLAY_IDENTIFIER m_iaeauf_ramp.iIaeMomen /end MEASUREMENT
/begin MEASUREMENT iIaeMomen.m_ist_iae "IAE-Ist-Moment" SWORD UMR_NM__1_1_0_S5_S3 1 100 -200 1300 ECU_ADDRESS 0xFFF8B50E DISPLAY_IDENTIFIER m_ist_iae.iIaeMomen /end MEASUREMENT
/begin MEASUREMENT iIaeMomen.m_ist_vorst_alt_iae "Altwert von IAE-Ist-Vorst-Moment" SWORD UMR_NM__1_1_0_S5_S3 1 100 -200 1300 ECU_ADDRESS 0xFFF8B516 DISPLAY_IDENTIFIER m_ist_vorst_alt_iae.iIaeMomen /end MEASUREMENT
/begin MEASUREMENT iIaeMomen.m_ist_vorst_iae "IAE-Ist-Vorst-Moment" SWORD UMR_NM__1_1_0_S5_S3 1 100 -200 1300 ECU_ADDRESS 0xFFF8B512 DISPLAY_IDENTIFIER m_ist_vorst_iae.iIaeMomen /end MEASUREMENT
/begin MEASUREMENT iIaeMomen.m_ist_vorst_iae_froz "eingefrorenes IAE-Ist-Vorst-Moment" SWORD UMR_NM__1_1_0_S5_S3 1 100 -200 1300 ECU_ADDRESS 0xFFF8B510 DISPLAY_IDENTIFIER m_ist_vorst_iae_froz.iIaeMomen /end MEASUREMENT
/begin MEASUREMENT iIaeMomen.m_ist_vorst_max_anfahr_iae "IAE-Ist-Vorst-Moment im Anfahren" SWORD UMR_NM__1_1_0_S5_S3 1 100 -200 1300 ECU_ADDRESS 0xFFF8B514 DISPLAY_IDENTIFIER m_ist_vorst_max_anfahr_iae.iIaeMomen /end MEASUREMENT
/begin MEASUREMENT iIaeMomen.m_kriech_max_iae "Obergrenze Kriechmoment" SWORD UMR_NM__1_1_0_S5_S3 1 100 -200 1300 ECU_ADDRESS 0xFFF8B4AE DISPLAY_IDENTIFIER m_kriech_max_iae.iIaeMomen /end MEASUREMENT
/begin MEASUREMENT iIaeMomen.m_kriech_min_iae "Untergrenze Kriechmoment" SWORD UMR_NM__1_1_0_S5_S3 1 100 -200 1300 ECU_ADDRESS 0xFFF8B4AC DISPLAY_IDENTIFIER m_kriech_min_iae.iIaeMomen /end MEASUREMENT
/begin MEASUREMENT iIaeMomen.m_motistoe_iae_init "Motormoment Initialisierungswert bei Zustandsstart" SWORD UMR_NM__1_1_0_S5_S3 1 100 -200 1300 ECU_ADDRESS 0xFFF8B4FC DISPLAY_IDENTIFIER m_motistoe_iae_init.iIaeMomen /end MEASUREMENT
/begin MEASUREMENT iIaeMomen.m_puls_cueber_iae "Momentenpuls bei Übertemperatur" SWORD UMR_NM__1_1_0_S5_S3 1 100 -200 1300 ECU_ADDRESS 0xFFF8B522 DISPLAY_IDENTIFIER m_puls_cueber_iae.iIaeMomen /end MEASUREMENT
/begin MEASUREMENT iIaeMomen.m_regler_d_iae "D-Anteil Regler" FLOAT32_IEEE UMR_NM__1_1_0_S5_S3 1 100 -1000 1000 ECU_ADDRESS 0xFFF8B4E4 DISPLAY_IDENTIFIER m_regler_d_iae.iIaeMomen /end MEASUREMENT
/begin MEASUREMENT iIaeMomen.m_regler_i_iae "I-Anteil Regler" FLOAT32_IEEE UMR_NM__1_1_0_S5_S3 1 100 -1000 1000 ECU_ADDRESS 0xFFF8B4E8 DISPLAY_IDENTIFIER m_regler_i_iae.iIaeMomen /end MEASUREMENT
/begin MEASUREMENT iIaeMomen.m_regler_iae "Reglermoment für integrierte Anfahrkupplung" SWORD UMR_NM__1_1_0_S5_S3 1 100 -1000 1000 ECU_ADDRESS 0xFFF8B4B6 DISPLAY_IDENTIFIER m_regler_iae.iIaeMomen /end MEASUREMENT
/begin MEASUREMENT iIaeMomen.m_regler_p_iae "P-Anteil Regler" FLOAT32_IEEE UMR_NM__1_1_0_S5_S3 1 100 -1000 1000 ECU_ADDRESS 0xFFF8B4E0 DISPLAY_IDENTIFIER m_regler_p_iae.iIaeMomen /end MEASUREMENT
/begin MEASUREMENT iIaeMomen.m_schlepp_iae "IAE-Schleppmoment" SWORD UMR_NM__1_1_0_S5_S3 1 100 -200 1300 ECU_ADDRESS 0xFFF8B50C DISPLAY_IDENTIFIER m_schlepp_iae.iIaeMomen /end MEASUREMENT
/begin MEASUREMENT iIaeMomen.m_soll_iae "IAE Sollmoment Getriebeeingangsseitig" SWORD UMR_NM__1_1_0_S5_S3 1 100 -200 1300 ECU_ADDRESS 0xFFF8B48E DISPLAY_IDENTIFIER m_soll_iae.iIaeMomen /end MEASUREMENT
/begin MEASUREMENT iIaeMomen.m_soll_iae_init "Sollmoment bei Start Synchronisieren" SWORD UMR_NM__1_1_0_S5_S3 1 100 -200 1300 ECU_ADDRESS 0xFFF8B49A DISPLAY_IDENTIFIER m_soll_iae_init.iIaeMomen /end MEASUREMENT
/begin MEASUREMENT iIaeMomen.m_soll_still_iae "IAE Sollmoment im STILLSTAND" SWORD UMR_NM__1_1_0_S5_S3 1 100 -200 1300 ECU_ADDRESS 0xFFF8B4A4 DISPLAY_IDENTIFIER m_soll_still_iae.iIaeMomen /end MEASUREMENT
/begin MEASUREMENT iIaeMomen.m_stell_iae "IAE Stellmoment Anfahrkupplung" SWORD UMR_NM__1_1_0_S5_S3 1 100 -200 1300 ECU_ADDRESS 0xFFF8B4A6 DISPLAY_IDENTIFIER m_stell_iae.iIaeMomen /end MEASUREMENT
/begin MEASUREMENT iIaeMomen.m_vorkriechziel_iae "Zielwert fuer Vorsteuermoment im Kriechen" SWORD UMR_NM__1_1_0_S5_S3 1 100 -200 1300 ECU_ADDRESS 0xFFF8B4AA DISPLAY_IDENTIFIER m_vorkriechziel_iae.iIaeMomen /end MEASUREMENT
/begin MEASUREMENT iIaeMomen.m_vorsteuer_iae "Vorsteuermoment für integrierte Anfahrkupplung" SWORD UMR_NM__1_1_0_S5_S3 1 100 -200 1300 ECU_ADDRESS 0xFFF8B4A8 DISPLAY_IDENTIFIER m_vorsteuer_iae.iIaeMomen /end MEASUREMENT
/begin MEASUREMENT iIaeMomen.mo_soll_iae "Momentenoffset für Solldruck" SLONG UMR_NM__1_100_0_S5_S3 1 100 0 1500 ECU_ADDRESS 0xFFF8B4A0 DISPLAY_IDENTIFIER mo_soll_iae.iIaeMomen /end MEASUREMENT
/begin MEASUREMENT iIaeMomen.mo_vorstkreichen_iae "Offset auf Vorsteuermoment im Kriechen" SLONG UMR_NM__1_100_0_S5_S3 1 100 -1500 1500 ECU_ADDRESS 0xFFF8B4B0 DISPLAY_IDENTIFIER mo_vorstkreichen_iae.iIaeMomen /end MEASUREMENT
/begin MEASUREMENT iIaeMomen.ms_motanfahrinit_iae "Motormoment beim Eintritt in Zustand Anfahren" SWORD UMR_NM__1_1_0_S5_S3 1 100 -200 1300 ECU_ADDRESS 0xFFF8B46C DISPLAY_IDENTIFIER ms_motanfahrinit_iae.iIaeMomen /end MEASUREMENT
/begin MEASUREMENT iIaeMomen.n_emknick_iae "Knickdrehzahl" SWORD UMR_U_MIN_1_1_0_S5_S3 1 100 0 8160 ECU_ADDRESS 0xFFF8B47A DISPLAY_IDENTIFIER n_emknick_iae.iIaeMomen /end MEASUREMENT
/begin MEASUREMENT iIaeMomen.n_grenzentk_iae "Drehzahlgrenze zum Umschalten von kup_status nach STATUS_IAE_ENTKOPP_ANF" SWORD UMR_U_MIN_1_1_0_S5_S3 1 100 0 8160 ECU_ADDRESS 0xFFF8B478 DISPLAY_IDENTIFIER n_grenzentk_iae.iIaeMomen /end MEASUREMENT
/begin MEASUREMENT iIaeMomen.n_motanfahr_gef_iae "Motorsolldrehzahl im Zustand Anfahren (PT2-gefiltert)" SWORD UMR_U_MIN_1_1_0_S5_S3 1 100 0 8160 ECU_ADDRESS 0xFFF8B470 DISPLAY_IDENTIFIER n_motanfahr_gef_iae.iIaeMomen /end MEASUREMENT
/begin MEASUREMENT iIaeMomen.n_motanfahr_grad_iae "Drehzahloffset aus Gradient auf Anfahrdrehzahl" SLONG UMR_U_MIN_1_100_0_S5_S3 1 100 -8160 8160 ECU_ADDRESS 0xFFF8B480 DISPLAY_IDENTIFIER n_motanfahr_grad_iae.iIaeMomen /end MEASUREMENT
/begin MEASUREMENT iIaeMomen.n_motsollanfahr_iae "Motorsolldrehzahl im Zustand Anfahren ungefiltert" SWORD UMR_U_MIN_1_1_0_S5_S3 1 100 0 8160 ECU_ADDRESS 0xFFF8B474 DISPLAY_IDENTIFIER n_motsollanfahr_iae.iIaeMomen /end MEASUREMENT
/begin MEASUREMENT iIaeMomen.n_motsollanfahr_roh_iae "Rohwert vor Filter von Motorsolldrehzahl im Zustand Anfahren ungefiltert" SWORD UMR_U_MIN_1_1_0_S5_S3 1 100 0 8160 ECU_ADDRESS 0xFFF8B476 DISPLAY_IDENTIFIER n_motsollanfahr_roh_iae.iIaeMomen /end MEASUREMENT
/begin MEASUREMENT iIaeMomen.nd_kriechsoll_iae "Sollkriechdrehzahl" SWORD UMR_U_MIN_1_1_0_S5_S3 1 100 -10000 10000 ECU_ADDRESS 0xFFF8B4F4 DISPLAY_IDENTIFIER nd_kriechsoll_iae.iIaeMomen /end MEASUREMENT
/begin MEASUREMENT iIaeMomen.nd_kriechstart_iae "Differenzdrehzahl beim ReglerStart" SWORD UMR_U_MIN_1_1_0_S5_S3 1 100 -10000 10000 ECU_ADDRESS 0xFFF8B4F2 DISPLAY_IDENTIFIER nd_kriechstart_iae.iIaeMomen /end MEASUREMENT
/begin MEASUREMENT iIaeMomen.nd_kriechziel_iae "Sollkriechdrehzahl Zielwert" SWORD UMR_U_MIN_1_1_0_S5_S3 1 100 -10000 10000 ECU_ADDRESS 0xFFF8B4F0 DISPLAY_IDENTIFIER nd_kriechziel_iae.iIaeMomen /end MEASUREMENT
/begin MEASUREMENT iIaeMomen.nd_motentkoppeln_init_iae "nd_motsollanfahr_iae-Wert bei Setzen von kup_status_iae Entkoppeln_anfahren" SWORD UMR_U_MIN_1_1_0_S5_S3 1 100 -10000 10000 ECU_ADDRESS 0xFFF8B47E DISPLAY_IDENTIFIER nd_motentkoppeln_init_iae.iIaeMomen /end MEASUREMENT
/begin MEASUREMENT iIaeMomen.nd_motsollanfahr_iae "(n_motsollanfahr_iae - n_mot_iae)" SWORD UMR_U_MIN_1_1_0_S5_S3 1 100 -10000 10000 ECU_ADDRESS 0xFFF8B47C DISPLAY_IDENTIFIER nd_motsollanfahr_iae.iIaeMomen /end MEASUREMENT
/begin MEASUREMENT iIaeMomen.ng_motanfahr_gef_iae "Motorsolldrehzahlgradient im Zustand Anfahren (PT2-gefiltert)" SWORD UMR_U_MINSEC_1_1_0_S5_S3 1 100 -10000 10000 ECU_ADDRESS 0xFFF8B472 DISPLAY_IDENTIFIER ng_motanfahr_gef_iae.iIaeMomen /end MEASUREMENT
/begin MEASUREMENT iIaeMomen.ns_motanfahrinit_iae "Motordrehzahl beim Eintritt in Zustand Anfahren" SWORD UMR_U_MIN_1_1_0_S5_S3 1 100 0 8160 ECU_ADDRESS 0xFFF8B46E DISPLAY_IDENTIFIER ns_motanfahrinit_iae.iIaeMomen /end MEASUREMENT
/begin MEASUREMENT iIaeMomen.sig_rampe_miaeauf "Vorzeichen der Rampe IAE-AufnahmemomentMoment" SBYTE UMR___1_1_0_S5_S3 1 100 -1 1 ECU_ADDRESS 0xFFF8B498 DISPLAY_IDENTIFIER sig_rampe_miaeauf.iIaeMomen /end MEASUREMENT
/begin MEASUREMENT iIaeMomen.st_anfagradbegrenz_iae "Status der Begrenzung für n_motanfahr_grad_iae" UBYTE Conv.cIaeMomen._.st_anfagradbegrenz_iae_S5_S3 1 100 0 2 ECU_ADDRESS 0xFFF8B528 DISPLAY_IDENTIFIER st_anfagradbegrenz_iae.iIaeMomen /end MEASUREMENT
/begin MEASUREMENT iIaeMomen.status_uef_zu_kriech_init_iae "Berechnung von m_vorsteuer im Kriechen aktiv" UBYTE Conv.cIaeMomen._.status_uef_zu_kriech_init_iae_S5_S3 1 100 0 2 ECU_ADDRESS 0xFFF8B527 DISPLAY_IDENTIFIER status_uef_zu_kriech_init_iae.iIaeMomen /end MEASUREMENT
/begin MEASUREMENT iIaeMomen.t_dauer_iuef_hs_iae "Dauer der Überführungfunktion für den Stützfaktor bei HS" SWORD UMR_MSEC__10_1_0_S5_S3 1 100 -327680 327670 ECU_ADDRESS 0xFFF8B51E DISPLAY_IDENTIFIER t_dauer_iuef_hs_iae.iIaeMomen /end MEASUREMENT
/begin MEASUREMENT iIaeMomen.t_syn_temp_iae "vorausberechnete Zeit bis Erreichen Synchron zielgang" SWORD UMR_MSEC__10_1_0_S5_S3 1 100 -327680 327670 ECU_ADDRESS 0xFFF8B48A DISPLAY_IDENTIFIER t_syn_temp_iae.iIaeMomen /end MEASUREMENT
/begin MEASUREMENT iIaeMomen.t_uef_m_iae "Dauer der Überführungsfunktion für Momentenüberführung" SWORD UMR_MSEC__10_1_0_S5_S3 1 100 0 320000 ECU_ADDRESS 0xFFF8B4BC DISPLAY_IDENTIFIER t_uef_m_iae.iIaeMomen /end MEASUREMENT
/begin MEASUREMENT iIaeMomen.t_uef_m_zu_kriech_iae "Dauer der Überführungsfunktion für Momentenüberführung speziell von Zu nach Kriechen" SWORD UMR_MSEC__10_1_0_S5_S3 1 100 0 320000 ECU_ADDRESS 0xFFF8B4C0 DISPLAY_IDENTIFIER t_uef_m_zu_kriech_iae.iIaeMomen /end MEASUREMENT
/begin MEASUREMENT iIaeMomen.t_uef_miaeaufanf_iae "Dauer der Überführungfunktion für m_ist_vorst_iae im und aus Anfahren" SWORD UMR_MSEC__10_1_0_S5_S3 1 100 -327680 327670 ECU_ADDRESS 0xFFF8B518 DISPLAY_IDENTIFIER t_uef_miaeaufanf_iae.iIaeMomen /end MEASUREMENT
/begin MEASUREMENT iIaeMomen.t_uef_nd_iae "Dauer der Überführungsfunktion für Drehzahlsüberführung" SWORD UMR_MSEC__10_1_0_S5_S3 1 100 0 320000 ECU_ADDRESS 0xFFF8B4BE DISPLAY_IDENTIFIER t_uef_nd_iae.iIaeMomen /end MEASUREMENT
/begin MEASUREMENT iIaeMomen.typ_uef_m "Typ der Überführungsfunktion für Momente" UBYTE Conv.cIaeMomen._.typ_uef_m_S5_S3 1 100 0 4 ECU_ADDRESS 0xFFF8B4BA DISPLAY_IDENTIFIER typ_uef_m.iIaeMomen /end MEASUREMENT
/begin MEASUREMENT iIaeMomen.typ_uef_miaeaufanf_iae "Typ der Überführungfunktion für m_ist_vorst_iae im und aus Anfahren" UBYTE Conv.cIaeMomen._.typ_uef_miaeaufanf_iae_S5_S3 1 100 0 4 ECU_ADDRESS 0xFFF8B51A DISPLAY_IDENTIFIER typ_uef_miaeaufanf_iae.iIaeMomen /end MEASUREMENT
/begin MEASUREMENT iIaeMomen.xd_iae "Reglerdifferenz" FLOAT32_IEEE UMR___1_1_0_S5_S3 1 100 -10000 10000 ECU_ADDRESS 0xFFF8B4EC FORMAT "%3.2" DISPLAY_IDENTIFIER xd_iae.iIaeMomen /end MEASUREMENT
/begin MEASUREMENT iIaeMomen.z_mo_kriech_aktiv_iae "Vorsteueroffset im Kriechen aktiv" UBYTE Conv.cIaeMomen._.z_mo_kriech_aktiv_iae_S5_S3 1 100 0 3 ECU_ADDRESS 0xFFF8B4F8 DISPLAY_IDENTIFIER z_mo_kriech_aktiv_iae.iIaeMomen /end MEASUREMENT
/begin MEASUREMENT iIaeMomen.z_modusiae_temp "Altwert von z_modus_iae" UBYTE Conv.cIaeMomen._.z_modusiae_temp_S5_S3 1 100 0 2 ECU_ADDRESS 0xFFF8B4F9 DISPLAY_IDENTIFIER z_modusiae_temp.iIaeMomen /end MEASUREMENT
/begin MEASUREMENT iIaeMomen.z_rampe_miaeauf "Status der Rampe auf neues m_iaeauf" UBYTE Conv.cIaeMomen._.z_rampe_miaeauf_S5_S3 1 100 0 2 ECU_ADDRESS 0xFFF8B499 DISPLAY_IDENTIFIER z_rampe_miaeauf.iIaeMomen /end MEASUREMENT
/begin MEASUREMENT iIaeMotmx.Pt1MMotmax.x "Filterwert" SLONG UMR___1_300_0_S5_S3 1 100 -7158278.82667 7158278.82333 ECU_ADDRESS 0xFFF8CEF0 DISPLAY_IDENTIFIER Pt1MMotmax.iIaeMotmx /end MEASUREMENT
/begin MEASUREMENT iIaeMotmx.TimerStallIae.maxtime "Endzeit" UWORD UMR_SEC__1_100_0_S5_S3 1 100 0 655.35 ECU_ADDRESS 0xFFF8CEEE DISPLAY_IDENTIFIER maxtime.TimerStallIae.iIaeMotmx /end MEASUREMENT
/begin MEASUREMENT iIaeMotmx.TimerStallIae.time "Zeit des Timers" UWORD UMR_SEC__1_100_0_S5_S3 1 100 0 655.35 ECU_ADDRESS 0xFFF8CEEC DISPLAY_IDENTIFIER time.TimerStallIae.iIaeMotmx /end MEASUREMENT
/begin MEASUREMENT iIaeMotmx.flag_motmaxndiff_iae "Momentenbegrenzung-Drehzahldifferenz-IAE aktiv" UBYTE Conv.cIaeMotmx._.flag_motmaxndiff_iae_S5_S3 1 100 0 1 BIT_MASK 0x1 ECU_ADDRESS 0xFFF8CEE5 DISPLAY_IDENTIFIER flag_motmaxndiff_iae.iIaeMotmx /end MEASUREMENT
/begin MEASUREMENT iIaeMotmx.flag_motmaxregdiff_iae "Momentenbegrenzung-Anfahrdrehzahl-IAE aktiv" UBYTE Conv.cIaeMotmx._.flag_motmaxregdiff_iae_S5_S3 1 100 0 1 BIT_MASK 0x1 ECU_ADDRESS 0xFFF8CEE6 DISPLAY_IDENTIFIER flag_motmaxregdiff_iae.iIaeMotmx /end MEASUREMENT
/begin MEASUREMENT iIaeMotmx.flag_motmaxstall_iae "Momentenbegrenzung-Stallspeed-IAE aktiv" UBYTE Conv.cIaeMotmx._.flag_motmaxstall_iae_S5_S3 1 100 0 1 BIT_MASK 0x1 ECU_ADDRESS 0xFFF8CEE7 DISPLAY_IDENTIFIER flag_motmaxstall_iae.iIaeMotmx /end MEASUREMENT
/begin MEASUREMENT iIaeMotmx.flag_motmaxtemp_iae "Momentenbegrenzung-Temperaturschutz-IAE aktiv" UBYTE Conv.cIaeMotmx._.flag_motmaxtemp_iae_S5_S3 1 100 0 1 BIT_MASK 0x1 ECU_ADDRESS 0xFFF8CEE8 DISPLAY_IDENTIFIER flag_motmaxtemp_iae.iIaeMotmx /end MEASUREMENT
/begin MEASUREMENT iIaeMotmx.flag_stallspeed_iae "Stallspeed aktiv" UBYTE Conv.cIaeMotmx._.flag_stallspeed_iae_S5_S3 1 100 0 1 BIT_MASK 0x1 ECU_ADDRESS 0xFFF8CEE4 DISPLAY_IDENTIFIER flag_stallspeed_iae.iIaeMotmx /end MEASUREMENT
/begin MEASUREMENT iIaeMotmx.i_stuetz_mmax_iae "Stützfaktor der IAE-Kupplung alter Wert von der Begrenzung" SWORD UMR___1_1000_0_S5_S3 1 100 0 6 ECU_ADDRESS 0xFFF8CEB0 DISPLAY_IDENTIFIER i_stuetz_mmax_iae.iIaeMotmx /end MEASUREMENT
/begin MEASUREMENT iIaeMotmx.m_motmax100_iae "Motormomentenbegrenzung der IAE" SLONG UMR_NM__1_100_0_S5_S3 1 100 -200 1200 ECU_ADDRESS 0xFFF8CEC0 DISPLAY_IDENTIFIER m_motmax100_iae.iIaeMotmx /end MEASUREMENT
/begin MEASUREMENT iIaeMotmx.m_motmax_iae "Motormomentenbegrenzung der IAE" SWORD UMR_NM__1_1_0_S5_S3 1 100 -200 1300 ECU_ADDRESS 0xFFF8CEB2 DISPLAY_IDENTIFIER m_motmax_iae.iIaeMotmx /end MEASUREMENT
/begin MEASUREMENT iIaeMotmx.m_motmax_max_iae "Obergrenze Motormomentenbegrenzung der IAE" SWORD UMR_NM__1_1_0_S5_S3 1 100 -200 1300 ECU_ADDRESS 0xFFF8CEB4 DISPLAY_IDENTIFIER m_motmax_max_iae.iIaeMotmx /end MEASUREMENT
/begin MEASUREMENT iIaeMotmx.m_motmax_roh_iae "Motormomentenbegrenzung der IAE ungefiltert" SWORD UMR_NM__1_1_0_S5_S3 1 100 -200 1300 ECU_ADDRESS 0xFFF8CEBC DISPLAY_IDENTIFIER m_motmax_roh_iae.iIaeMotmx /end MEASUREMENT
/begin MEASUREMENT iIaeMotmx.m_motmaxmax100_iae "maximales Motormomentenbegrenzung der IAE" SLONG UMR_NM__1_100_0_S5_S3 1 100 -200 1200 ECU_ADDRESS 0xFFF8CEB8 DISPLAY_IDENTIFIER m_motmaxmax100_iae.iIaeMotmx /end MEASUREMENT
/begin MEASUREMENT iIaeMotmx.m_motmaxndiff100_iae "Motormomentenbegrenzung der IAE Differenzdrehzahlschutzfunktion" SLONG UMR_NM__1_100_0_S5_S3 1 100 -200 1200 ECU_ADDRESS 0xFFF8CED0 DISPLAY_IDENTIFIER m_motmaxndiff100_iae.iIaeMotmx /end MEASUREMENT
/begin MEASUREMENT iIaeMotmx.m_motmaxndiff_iae "Motormomentenbegrenzung der IAE Differenzdrehzahlschutzfunktion" SWORD UMR_NM__1_1_0_S5_S3 1 100 -200 1300 ECU_ADDRESS 0xFFF8CECC DISPLAY_IDENTIFIER m_motmaxndiff_iae.iIaeMotmx /end MEASUREMENT
/begin MEASUREMENT iIaeMotmx.m_motmaxregdiff100_iae "Motormomentenbegrenzung der IAE Anfahrdrehzahlschutzfunktion" SLONG UMR_NM__1_100_0_S5_S3 1 100 -200 1200 ECU_ADDRESS 0xFFF8CED8 DISPLAY_IDENTIFIER m_motmaxregdiff100_iae.iIaeMotmx /end MEASUREMENT
/begin MEASUREMENT iIaeMotmx.m_motmaxregdiff_iae "Motormomentenbegrenzung der IAE Anfahrdrehzahlschutzfunktion" SWORD UMR_NM__1_1_0_S5_S3 1 100 -200 1300 ECU_ADDRESS 0xFFF8CED4 DISPLAY_IDENTIFIER m_motmaxregdiff_iae.iIaeMotmx /end MEASUREMENT
/begin MEASUREMENT iIaeMotmx.m_motmaxstall100_iae "Motormomentenbegrenzung der IAE Stallspeed" SLONG UMR_NM__1_100_0_S5_S3 1 100 -200 1200 ECU_ADDRESS 0xFFF8CEE0 DISPLAY_IDENTIFIER m_motmaxstall100_iae.iIaeMotmx /end MEASUREMENT
/begin MEASUREMENT iIaeMotmx.m_motmaxstall_iae "Motormomentenbegrenzung der IAE Stallspeed" SWORD UMR_NM__1_1_0_S5_S3 1 100 -200 1300 ECU_ADDRESS 0xFFF8CEDC DISPLAY_IDENTIFIER m_motmaxstall_iae.iIaeMotmx /end MEASUREMENT
/begin MEASUREMENT iIaeMotmx.m_motmaxtemp100_iae "Motormomentenbegrenzung der IAE Belagtemperaturschutz" SLONG UMR_NM__1_100_0_S5_S3 1 100 -200 1200 ECU_ADDRESS 0xFFF8CEC8 DISPLAY_IDENTIFIER m_motmaxtemp100_iae.iIaeMotmx /end MEASUREMENT
/begin MEASUREMENT iIaeMotmx.m_motmaxtemp_iae "Motormomentenbegrenzung der IAE Belagtemperaturschutz" SWORD UMR_NM__1_1_0_S5_S3 1 100 -200 1300 ECU_ADDRESS 0xFFF8CEC4 DISPLAY_IDENTIFIER m_motmaxtemp_iae.iIaeMotmx /end MEASUREMENT
/begin MEASUREMENT iIaeMotmx.timer_stallspeed_iae "Zeit im Stallspeed" SWORD UMR_MSEC__10_1_0_S5_S3 1 100 0 300000 ECU_ADDRESS 0xFFF8CEEA DISPLAY_IDENTIFIER timer_stallspeed_iae.iIaeMotmx /end MEASUREMENT
/begin MEASUREMENT iIaeSigna.DelayMMotgem.write_index "Index der aktuellen Bufferposition" SBYTE UMR___1_1_0_S5_S3 1 100 0 10 ECU_ADDRESS 0xFFF8B660 DISPLAY_IDENTIFIER DelayMMotgem.iIaeSigna /end MEASUREMENT
/begin MEASUREMENT iIaeSigna.DelayMMotist.write_index "Index der aktuellen Bufferposition" SBYTE UMR___1_1_0_S5_S3 1 100 0 10 ECU_ADDRESS 0xFFF8B676 DISPLAY_IDENTIFIER DelayMMotist.iIaeSigna /end MEASUREMENT
/begin MEASUREMENT iIaeSigna.DelayMMotistoe.write_index "Index der aktuellen Bufferposition" SBYTE UMR___1_1_0_S5_S3 1 100 0 10 ECU_ADDRESS 0xFFF8B68C DISPLAY_IDENTIFIER DelayMMotistoe.iIaeSigna /end MEASUREMENT
/begin MEASUREMENT iIaeSigna.DelayMMotsolloe.write_index "Index der aktuellen Bufferposition" SBYTE UMR___1_1_0_S5_S3 1 100 0 10 ECU_ADDRESS 0xFFF8B6A2 DISPLAY_IDENTIFIER DelayMMotsolloe.iIaeSigna /end MEASUREMENT
/begin MEASUREMENT iIaeSigna.DelayNab.write_index "Index der aktuellen Bufferposition" SBYTE UMR___1_1_0_S5_S3 1 100 0 10 ECU_ADDRESS 0xFFF8B6B8 DISPLAY_IDENTIFIER DelayNab.iIaeSigna /end MEASUREMENT
/begin MEASUREMENT iIaeSigna.DelayNt.write_index "Index der aktuellen Bufferposition" SBYTE UMR___1_1_0_S5_S3 1 100 0 10 ECU_ADDRESS 0xFFF8B6CE DISPLAY_IDENTIFIER DelayNt.iIaeSigna /end MEASUREMENT
/begin MEASUREMENT iIaeSigna.Dt1Dkig.Pt1Si16.x "Filterwert" SLONG UMR___1_300_0_S5_S3 1 100 -7158278.82667 7158278.82333 ECU_ADDRESS 0xFFF8B5F4 DISPLAY_IDENTIFIER Pt1Si16.Dt1Dkig.iIaeSigna /end MEASUREMENT
/begin MEASUREMENT iIaeSigna.Dt1Dkig.xp "Ableitung vom Eingangswert" SWORD UMR___1_1_0_S5_S3 1 100 -32768 32767 ECU_ADDRESS 0xFFF8B5F0 DISPLAY_IDENTIFIER Dt1Dkig.iIaeSigna /end MEASUREMENT
/begin MEASUREMENT iIaeSigna.Dt1MgMotist.Pt1Si16.x "Filterwert" SLONG UMR___1_300_0_S5_S3 1 100 -7158278.82667 7158278.82333 ECU_ADDRESS 0xFFF8B614 DISPLAY_IDENTIFIER Pt1Si16.Dt1MgMotist.iIaeSigna /end MEASUREMENT
/begin MEASUREMENT iIaeSigna.Dt1MgMotist.xp "Ableitung vom Eingangswert" SWORD UMR___1_1_0_S5_S3 1 100 -32768 32767 ECU_ADDRESS 0xFFF8B610 DISPLAY_IDENTIFIER Dt1MgMotist.iIaeSigna /end MEASUREMENT
/begin MEASUREMENT iIaeSigna.Dt1NdgIae.Pt1Si16.x "Filterwert" SLONG UMR___1_300_0_S5_S3 1 100 -7158278.82667 7158278.82333 ECU_ADDRESS 0xFFF8B65C DISPLAY_IDENTIFIER Pt1Si16.Dt1NdgIae.iIaeSigna /end MEASUREMENT
/begin MEASUREMENT iIaeSigna.Dt1NdgIae.xp "Ableitung vom Eingangswert" SWORD UMR___1_1_0_S5_S3 1 100 -32768 32767 ECU_ADDRESS 0xFFF8B658 DISPLAY_IDENTIFIER Dt1NdgIae.iIaeSigna /end MEASUREMENT
/begin MEASUREMENT iIaeSigna.Dt1NgAb.Pt1Si16.x "Filterwert" SLONG UMR___1_300_0_S5_S3 1 100 -7158278.82667 7158278.82333 ECU_ADDRESS 0xFFF8B5FC DISPLAY_IDENTIFIER Pt1Si16.Dt1NgAb.iIaeSigna /end MEASUREMENT
/begin MEASUREMENT iIaeSigna.Dt1NgAb.xp "Ableitung vom Eingangswert" SWORD UMR___1_1_0_S5_S3 1 100 -32768 32767 ECU_ADDRESS 0xFFF8B5F8 DISPLAY_IDENTIFIER Dt1NgAb.iIaeSigna /end MEASUREMENT
/begin MEASUREMENT iIaeSigna.Dt1NgGetrein.Pt1Si16.x "Filterwert" SLONG UMR___1_300_0_S5_S3 1 100 -7158278.82667 7158278.82333 ECU_ADDRESS 0xFFF8B60C DISPLAY_IDENTIFIER Pt1Si16.Dt1NgGetrein.iIaeSigna /end MEASUREMENT
/begin MEASUREMENT iIaeSigna.Dt1NgGetrein.xp "Ableitung vom Eingangswert" SWORD UMR___1_1_0_S5_S3 1 100 -32768 32767 ECU_ADDRESS 0xFFF8B608 DISPLAY_IDENTIFIER Dt1NgGetrein.iIaeSigna /end MEASUREMENT
/begin MEASUREMENT iIaeSigna.Dt1NgMot.Pt1Si16.x "Filterwert" SLONG UMR___1_300_0_S5_S3 1 100 -7158278.82667 7158278.82333 ECU_ADDRESS 0xFFF8B604 DISPLAY_IDENTIFIER Pt1Si16.Dt1NgMot.iIaeSigna /end MEASUREMENT
/begin MEASUREMENT iIaeSigna.Dt1NgMot.xp "Ableitung vom Eingangswert" SWORD UMR___1_1_0_S5_S3 1 100 -32768 32767 ECU_ADDRESS 0xFFF8B600 DISPLAY_IDENTIFIER Dt1NgMot.iIaeSigna /end MEASUREMENT
/begin MEASUREMENT iIaeSigna.Dt1Pbremsg.Pt1Si16.x "Filterwert" SLONG UMR___1_300_0_S5_S3 1 100 -7158278.82667 7158278.82333 ECU_ADDRESS 0xFFF8B5EC DISPLAY_IDENTIFIER Pt1Si16.Dt1Pbremsg.iIaeSigna /end MEASUREMENT
/begin MEASUREMENT iIaeSigna.Dt1Pbremsg.xp "Ableitung vom Eingangswert" SWORD UMR___1_1_0_S5_S3 1 100 -32768 32767 ECU_ADDRESS 0xFFF8B5E8 DISPLAY_IDENTIFIER Dt1Pbremsg.iIaeSigna /end MEASUREMENT
/begin MEASUREMENT iIaeSigna.Pt1AxrefIae.x "Filterwert" SLONG UMR___1_300_0_S5_S3 1 100 -7158278.82667 7158278.82333 ECU_ADDRESS 0xFFF8B64C DISPLAY_IDENTIFIER Pt1AxrefIae.iIaeSigna /end MEASUREMENT
/begin MEASUREMENT iIaeSigna.Pt1Dki.x "Filterwert" SLONG UMR___1_300_0_S5_S3 1 100 -7158278.82667 7158278.82333 ECU_ADDRESS 0xFFF8B624 DISPLAY_IDENTIFIER Pt1Dki.iIaeSigna /end MEASUREMENT
/begin MEASUREMENT iIaeSigna.Pt1MMotgem.x "Filterwert" SLONG UMR___1_300_0_S5_S3 1 100 -7158278.82667 7158278.82333 ECU_ADDRESS 0xFFF8B638 DISPLAY_IDENTIFIER Pt1MMotgem.iIaeSigna /end MEASUREMENT
/begin MEASUREMENT iIaeSigna.Pt1MMotist.x "Filterwert" SLONG UMR___1_300_0_S5_S3 1 100 -7158278.82667 7158278.82333 ECU_ADDRESS 0xFFF8B62C DISPLAY_IDENTIFIER Pt1MMotist.iIaeSigna /end MEASUREMENT
/begin MEASUREMENT iIaeSigna.Pt1MMotistoe.x "Filterwert" SLONG UMR___1_300_0_S5_S3 1 100 -7158278.82667 7158278.82333 ECU_ADDRESS 0xFFF8B630 DISPLAY_IDENTIFIER Pt1MMotistoe.iIaeSigna /end MEASUREMENT
/begin MEASUREMENT iIaeSigna.Pt1MMotsolloe.x "Filterwert" SLONG UMR___1_300_0_S5_S3 1 100 -7158278.82667 7158278.82333 ECU_ADDRESS 0xFFF8B634 DISPLAY_IDENTIFIER Pt1MMotsolloe.iIaeSigna /end MEASUREMENT
/begin MEASUREMENT iIaeSigna.Pt1NAb.x "Filterwert" SLONG UMR___1_300_0_S5_S3 1 100 -7158278.82667 7158278.82333 ECU_ADDRESS 0xFFF8B63C DISPLAY_IDENTIFIER Pt1NAb.iIaeSigna /end MEASUREMENT
/begin MEASUREMENT iIaeSigna.Pt1NMot.x "Filterwert" SLONG UMR___1_300_0_S5_S3 1 100 -7158278.82667 7158278.82333 ECU_ADDRESS 0xFFF8B644 DISPLAY_IDENTIFIER Pt1NMot.iIaeSigna /end MEASUREMENT
/begin MEASUREMENT iIaeSigna.Pt1NT.x "Filterwert" SLONG UMR___1_300_0_S5_S3 1 100 -7158278.82667 7158278.82333 ECU_ADDRESS 0xFFF8B640 DISPLAY_IDENTIFIER Pt1NT.iIaeSigna /end MEASUREMENT
/begin MEASUREMENT iIaeSigna.Pt1NdGetrein.x "Filterwert" SLONG UMR___1_300_0_S5_S3 1 100 -7158278.82667 7158278.82333 ECU_ADDRESS 0xFFF8B620 DISPLAY_IDENTIFIER Pt1NdGetrein.iIaeSigna /end MEASUREMENT
/begin MEASUREMENT iIaeSigna.Pt1NdIae.x "Filterwert" SLONG UMR___1_300_0_S5_S3 1 100 -7158278.82667 7158278.82333 ECU_ADDRESS 0xFFF8B648 DISPLAY_IDENTIFIER Pt1NdIae.iIaeSigna /end MEASUREMENT
/begin MEASUREMENT iIaeSigna.Pt1NdMot.x "Filterwert" SLONG UMR___1_300_0_S5_S3 1 100 -7158278.82667 7158278.82333 ECU_ADDRESS 0xFFF8B61C DISPLAY_IDENTIFIER Pt1NdMot.iIaeSigna /end MEASUREMENT
/begin MEASUREMENT iIaeSigna.Pt1Nue.x "Filterwert" SLONG UMR___1_300_0_S5_S3 1 100 -7158278.82667 7158278.82333 ECU_ADDRESS 0xFFF8B618 DISPLAY_IDENTIFIER Pt1Nue.iIaeSigna /end MEASUREMENT
/begin MEASUREMENT iIaeSigna.Pt1PBrems.x "Filterwert" SLONG UMR___1_300_0_S5_S3 1 100 -7158278.82667 7158278.82333 ECU_ADDRESS 0xFFF8B628 DISPLAY_IDENTIFIER Pt1PBrems.iIaeSigna /end MEASUREMENT
/begin MEASUREMENT iIaeSigna.Pt2NeigungIae.x "Filterwert" FLOAT32_IEEE UMR___1_1_0_S5_S3 1 100 -2147483648 2147483647 ECU_ADDRESS 0xFFF8B650 FORMAT "%3.2" DISPLAY_IDENTIFIER x.Pt2NeigungIae.iIaeSigna /end MEASUREMENT
/begin MEASUREMENT iIaeSigna.Pt2NeigungIae.xp "Ableitung vom Eingangswert" FLOAT32_IEEE UMR__SEC_1_1_0_S5_S3 1 100 -2147483648 2147483647 ECU_ADDRESS 0xFFF8B654 FORMAT "%3.2" DISPLAY_IDENTIFIER xp.Pt2NeigungIae.iIaeSigna /end MEASUREMENT
/begin MEASUREMENT iIaeSigna.asr_regelt_iae "asr regelt" UBYTE Conv.cIaeSigna._.asr_regelt_iae_S5_S3 1 100 0 1 BIT_MASK 0x1 ECU_ADDRESS 0xFFF8B594 DISPLAY_IDENTIFIER asr_regelt_iae.iIaeSigna /end MEASUREMENT
/begin MEASUREMENT iIaeSigna.ax_ref_filt_diagiae "Laengsbeschleunigung" SWORD UMR_M_SEC2_1_32_0_S5_S3 1 100 -1024 1023.96875 ECU_ADDRESS 0xFFF8B5E4 DISPLAY_IDENTIFIER ax_ref_filt_diagiae.iIaeSigna /end MEASUREMENT
/begin MEASUREMENT iIaeSigna.dki_iae "gefiltertes Fahrpedal" UBYTE UMR_PROZENT__20_51_0_S5_S3 1 100 0 100 ECU_ADDRESS 0xFFF8B5D6 DISPLAY_IDENTIFIER dki_iae.iIaeSigna /end MEASUREMENT
/begin MEASUREMENT iIaeSigna.dkig_iae "Gradient vom Fahrpedal" SWORD UMR_PROZENT_SEC_20_51_0_S5_S3 1 100 -3921.56862745 3921.56862745 ECU_ADDRESS 0xFFF8B5D8 DISPLAY_IDENTIFIER dkig_iae.iIaeSigna /end MEASUREMENT
/begin MEASUREMENT iIaeSigna.flag_init_signa_iae "Signalaufbereitung und Tempmodell initialisiert" UBYTE Conv.cIaeSigna._.flag_init_signa_iae_S5_S3 1 100 0 1 BIT_MASK 0x1 ECU_ADDRESS 0xFFF8B595 DISPLAY_IDENTIFIER flag_init_signa_iae.iIaeSigna /end MEASUREMENT
/begin MEASUREMENT iIaeSigna.flag_mreibzumstell_iae "nd im ZU größer Schwelle - m_reib wird mit m_stell beschrieben" UBYTE Conv.cIaeSigna._.flag_mreibzumstell_iae_S5_S3 1 100 0 1 BIT_MASK 0x1 ECU_ADDRESS 0xFFF8B5A2 DISPLAY_IDENTIFIER flag_mreibzumstell_iae.iIaeSigna /end MEASUREMENT
/begin MEASUREMENT iIaeSigna.kfl_sollneutral_iae "Anforderung von Zwangsneutral" UBYTE Conv.cIaeSigna._.kfl_sollneutral_iae_S5_S3 1 100 0 1 BIT_MASK 0x1 ECU_ADDRESS 0xFFF8B5DA DISPLAY_IDENTIFIER kfl_sollneutral_iae.iIaeSigna /end MEASUREMENT
/begin MEASUREMENT iIaeSigna.m_motgemoe_iae "gemitteltes Motormoment mit Eingriffen" SWORD UMR_NM__1_1_0_S5_S3 1 100 -200 1300 ECU_ADDRESS 0xFFF8B5AA DISPLAY_IDENTIFIER m_motgemoe_iae.iIaeSigna /end MEASUREMENT
/begin MEASUREMENT iIaeSigna.m_motist_iae "gefiltertes und verzögertes Motormoment mit Eingriffen" SWORD UMR_NM__1_1_0_S5_S3 1 100 -200 1300 ECU_ADDRESS 0xFFF8B5A4 DISPLAY_IDENTIFIER m_motist_iae.iIaeSigna /end MEASUREMENT
/begin MEASUREMENT iIaeSigna.m_motistoe_iae "gefiltertes Motormoment ohne Eingriffen" SWORD UMR_NM__1_1_0_S5_S3 1 100 -200 1300 ECU_ADDRESS 0xFFF8B5A6 DISPLAY_IDENTIFIER m_motistoe_iae.iIaeSigna /end MEASUREMENT
/begin MEASUREMENT iIaeSigna.m_motsolloe_iae "gefiltertes Motorsollmoment ohne Eingriffen" SWORD UMR_NM__1_1_0_S5_S3 1 100 -200 1300 ECU_ADDRESS 0xFFF8B5A8 DISPLAY_IDENTIFIER m_motsolloe_iae.iIaeSigna /end MEASUREMENT
/begin MEASUREMENT iIaeSigna.m_reib_iae "Reibmoment an der Kupplung zur berechnung der Verlustleistung" SWORD UMR_NM__1_1_0_S5_S3 1 100 0 1300 ECU_ADDRESS 0xFFF8B5A0 DISPLAY_IDENTIFIER m_reib_iae.iIaeSigna /end MEASUREMENT
/begin MEASUREMENT iIaeSigna.mg_motist_iae "Gradient vom Motoristmoment mit Eingriffe" SWORD UMR_NM_SEC_1_1_0_S5_S3 1 100 -32768 32767 ECU_ADDRESS 0xFFF8B5AC DISPLAY_IDENTIFIER mg_motist_iae.iIaeSigna /end MEASUREMENT
/begin MEASUREMENT iIaeSigna.mot_stress_iae "Motorstress" SWORD UMR_PROZENT__16_10_0_S5_S3 1 100 0 204.8 ECU_ADDRESS 0xFFF8B598 DISPLAY_IDENTIFIER mot_stress_iae.iIaeSigna /end MEASUREMENT
/begin MEASUREMENT iIaeSigna.n_ab_dir_iae "Drehrichtung Abtrieb intern IAE" SBYTE Conv.cIaeSigna._.n_ab_dir_iae_S5_S3 1 100 -1 1 ECU_ADDRESS 0xFFF8B5DB DISPLAY_IDENTIFIER n_ab_dir_iae.iIaeSigna /end MEASUREMENT
/begin MEASUREMENT iIaeSigna.n_ab_iae "gefilterte und verzögerte Abtriebsdrehzahl" SWORD UMR_U_MIN_1_1_0_S5_S3 1 100 0 8160 ECU_ADDRESS 0xFFF8B5C2 DISPLAY_IDENTIFIER n_ab_iae.iIaeSigna /end MEASUREMENT
/begin MEASUREMENT iIaeSigna.n_getrein_iae "Getriebeeingangsdrehzahl aus Abtriebsdrehzahl berechnet" SWORD UMR_U_MIN_1_1_0_S5_S3 1 100 0 8160 ECU_ADDRESS 0xFFF8B5B6 DISPLAY_IDENTIFIER n_getrein_iae.iIaeSigna /end MEASUREMENT
/begin MEASUREMENT iIaeSigna.n_mot_iae "gefilterte Motordrehzahl" SWORD UMR_U_MIN_1_1_0_S5_S3 1 100 0 8160 ECU_ADDRESS 0xFFF8B5AE DISPLAY_IDENTIFIER n_mot_iae.iIaeSigna /end MEASUREMENT
/begin MEASUREMENT iIaeSigna.n_motanfahr_basis_iae "Basisdrehzahl für die Berechnung der Anfahrdrehzahl im Zustand Anfahren" SWORD UMR_U_MIN_1_1_0_S5_S3 1 100 0 8160 ECU_ADDRESS 0xFFF8B5DE DISPLAY_IDENTIFIER n_motanfahr_basis_iae.iIaeSigna /end MEASUREMENT
/begin MEASUREMENT iIaeSigna.n_motsoll_ll_iae "gefilterte Motordrehzahl" SWORD UMR_U_MIN_1_1_0_S5_S3 1 100 0 8160 ECU_ADDRESS 0xFFF8B5B4 DISPLAY_IDENTIFIER n_motsoll_ll_iae.iIaeSigna /end MEASUREMENT
/begin MEASUREMENT iIaeSigna.n_motsollmax_iae "Maximalwert aus n_motsoll_ll_iae, n_mot_solleer und n_mot_llsoll_has" SWORD UMR_U_MIN_1_1_0_S5_S3 1 100 0 8160 ECU_ADDRESS 0xFFF8B5DC DISPLAY_IDENTIFIER n_motsollmax_iae.iIaeSigna /end MEASUREMENT
/begin MEASUREMENT iIaeSigna.n_t_iae "gefilterte und verzögerte Turbinendrehzahl" SWORD UMR_U_MIN_1_1_0_S5_S3 1 100 0 8160 ECU_ADDRESS 0xFFF8B5C4 DISPLAY_IDENTIFIER n_t_iae.iIaeSigna /end MEASUREMENT
/begin MEASUREMENT iIaeSigna.nd_getrein_basis_ll_iae "Basis für Differenz zwischen Getriebeeingangsdrehzahl und Motorleerlaufdrehzahl" SWORD UMR_U_MIN_1_1_0_S5_S3 1 100 -8160 8160 ECU_ADDRESS 0xFFF8B5BA DISPLAY_IDENTIFIER nd_getrein_basis_ll_iae.iIaeSigna /end MEASUREMENT
/begin MEASUREMENT iIaeSigna.nd_getrein_iae "Differenz zwischen Getriebeeingangsdrehzahl und Motorleerlaufdrehzahl" SWORD UMR_U_MIN_1_1_0_S5_S3 1 100 -8160 8160 ECU_ADDRESS 0xFFF8B5B8 DISPLAY_IDENTIFIER nd_getrein_iae.iIaeSigna /end MEASUREMENT
/begin MEASUREMENT iIaeSigna.nd_iae "Differenzdrehzahl am Anfahrelement" SWORD UMR_U_MIN_1_1_0_S5_S3 1 100 -8160 8160 ECU_ADDRESS 0xFFF8B5CC DISPLAY_IDENTIFIER nd_iae.iIaeSigna /end MEASUREMENT
/begin MEASUREMENT iIaeSigna.nd_iae_betrag "Differenzdrehzahl am Anfahrelement, Absolutwert" SWORD UMR_U_MIN_1_1_0_S5_S3 1 100 -8160 8160 ECU_ADDRESS 0xFFF8B5CA DISPLAY_IDENTIFIER nd_iae_betrag.iIaeSigna /end MEASUREMENT
/begin MEASUREMENT iIaeSigna.nd_iae_kf "Differenzdrehzahl am Anfahrelement, Absolutwert, zustandsabhängig" SWORD UMR_U_MIN_1_1_0_S5_S3 1 100 -8160 8160 ECU_ADDRESS 0xFFF8B5C8 DISPLAY_IDENTIFIER nd_iae_kf.iIaeSigna /end MEASUREMENT
/begin MEASUREMENT iIaeSigna.nd_mot_iae "Differenzdrehzahl zwischen Motor" SWORD UMR_U_MIN_1_1_0_S5_S3 1 100 -8160 8160 ECU_ADDRESS 0xFFF8B5D0 DISPLAY_IDENTIFIER nd_mot_iae.iIaeSigna /end MEASUREMENT
/begin MEASUREMENT iIaeSigna.ndg_iae "Gradinet der Differenzdrehzahl am Anfahrelement" SWORD UMR_U_MINSEC_1_1_0_S5_S3 1 100 -32768 32767 ECU_ADDRESS 0xFFF8B5CE DISPLAY_IDENTIFIER ndg_iae.iIaeSigna /end MEASUREMENT
/begin MEASUREMENT iIaeSigna.neigung_iae "Neigung in Grad Steigung" SWORD UMR_GRAD__1_3_M128_S5_S3 1 100 -42.6666666667 42 ECU_ADDRESS 0xFFF8B5E0 DISPLAY_IDENTIFIER neigung_iae.iIaeSigna /end MEASUREMENT
/begin MEASUREMENT iIaeSigna.neigung_nmin_iae "Neigung in Grad Steigung" SWORD UMR_GRAD__1_3_M128_S5_S3 1 100 -42.6666666667 42 ECU_ADDRESS 0xFFF8B5E2 DISPLAY_IDENTIFIER neigung_nmin_iae.iIaeSigna /end MEASUREMENT
/begin MEASUREMENT iIaeSigna.ng_ab_iae "Gradient der Abtriebsdrehzahll" SWORD UMR_U_MINSEC_1_1_0_S5_S3 1 100 -10000 10000 ECU_ADDRESS 0xFFF8B5C6 DISPLAY_IDENTIFIER ng_ab_iae.iIaeSigna /end MEASUREMENT
/begin MEASUREMENT iIaeSigna.ng_getrein_iae "Gradient der Motordrehzahll" SWORD UMR_U_MINSEC_1_1_0_S5_S3 1 100 -10000 10000 ECU_ADDRESS 0xFFF8B5B2 DISPLAY_IDENTIFIER ng_getrein_iae.iIaeSigna /end MEASUREMENT
/begin MEASUREMENT iIaeSigna.ng_mot_iae "Gradient der Motordrehzahll" SWORD UMR_U_MINSEC_1_1_0_S5_S3 1 100 -10000 10000 ECU_ADDRESS 0xFFF8B5B0 DISPLAY_IDENTIFIER ng_mot_iae.iIaeSigna /end MEASUREMENT
/begin MEASUREMENT iIaeSigna.ns_getrein_oeffnen_iae "Schwelle für Getriebeeingangsdrehzahl zum Öffnen" SWORD UMR_U_MIN_1_1_0_S5_S3 1 100 0 8160 ECU_ADDRESS 0xFFF8B5BE DISPLAY_IDENTIFIER ns_getrein_oeffnen_iae.iIaeSigna /end MEASUREMENT
/begin MEASUREMENT iIaeSigna.ns_getrein_schliess_iae "Schwelle für Getriebeeingangsdrehzahl zum Schliessen" SWORD UMR_U_MIN_1_1_0_S5_S3 1 100 0 8160 ECU_ADDRESS 0xFFF8B5C0 DISPLAY_IDENTIFIER ns_getrein_schliess_iae.iIaeSigna /end MEASUREMENT
/begin MEASUREMENT iIaeSigna.nue_iae "Drehzahlverhältnis n_getrein_ausab/n_mot" SWORD UMR___1_1000_0_S5_S3 1 100 0 30 ECU_ADDRESS 0xFFF8B596 DISPLAY_IDENTIFIER nue_iae.iIaeSigna /end MEASUREMENT
/begin MEASUREMENT iIaeSigna.p_brems_iae "gefilterter Bremsdruck" SWORD UMR_BAR__1_100_0_S5_S3 1 100 -100 300 ECU_ADDRESS 0xFFF8B5D2 DISPLAY_IDENTIFIER p_brems_iae.iIaeSigna /end MEASUREMENT
/begin MEASUREMENT iIaeSigna.pg_brems_iae "Bremsdruckgradient" SWORD UMR_BAR_SEC_1_1_0_S5_S3 1 100 -10000 10000 ECU_ADDRESS 0xFFF8B5D4 DISPLAY_IDENTIFIER pg_brems_iae.iIaeSigna /end MEASUREMENT
/begin MEASUREMENT iIaeSigna.pw_reib_iae "Verlustleistung" SLONG UMR_KW__1_1000_0_S5_S3 1 100 0 2147483.647 ECU_ADDRESS 0xFFF8B59C DISPLAY_IDENTIFIER pw_reib_iae.iIaeSigna /end MEASUREMENT
/begin MEASUREMENT iIaeSigna.x_kf_ns_sync_iae "Eingangsgroesse für KF_NS_SYNC_IAE" SWORD UMR___1_1000_0_S5_S3 1 100 -30 30 ECU_ADDRESS 0xFFF8B5BC DISPLAY_IDENTIFIER x_kf_ns_sync_iae.iIaeSigna /end MEASUREMENT
/begin MEASUREMENT iIaeSigna.z_nmotll_aktiv_iae "Motorleerlaufregler" UBYTE Conv.cIaeSigna._.z_nmotll_aktiv_iae_S5_S3 1 100 0 1 BIT_MASK 0x1 ECU_ADDRESS 0xFFF8B5E6 DISPLAY_IDENTIFIER z_nmotll_aktiv_iae.iIaeSigna /end MEASUREMENT
/begin MEASUREMENT iIaeTempm.TimerVzInit.maxtime "Endzeit" UWORD UMR_SEC__1_100_0_S5_S3 1 100 0 655.35 ECU_ADDRESS 0xFFF8B6F4 DISPLAY_IDENTIFIER maxtime.TimerVzInit.iIaeTempm /end MEASUREMENT
/begin MEASUREMENT iIaeTempm.TimerVzInit.time "Zeit des Timers" UWORD UMR_SEC__1_100_0_S5_S3 1 100 0 655.35 ECU_ADDRESS 0xFFF8B6F2 DISPLAY_IDENTIFIER time.TimerVzInit.iIaeTempm /end MEASUREMENT
/begin MEASUREMENT iIaeTempm.c_iae "Temperatur fuer integrierte Anfahrkupplung" UWORD UMR_GRADC__1_1_M40_S5_S3 1 100 -40 500 ECU_ADDRESS 0xFFF8B6E4 DISPLAY_IDENTIFIER c_iae.iIaeTempm /end MEASUREMENT
/begin MEASUREMENT iIaeTempm.c_iae_fl "Temperatur in Float fuer integrierte Anfahrkupplung" FLOAT32_IEEE UMR_GRADC__1_1_0_S5_S3 1 100 -40 500 ECU_ADDRESS 0xFFF8B6E8 DISPLAY_IDENTIFIER c_iae_fl.iIaeTempm /end MEASUREMENT
/begin MEASUREMENT iIaeTempm.flag_tempsperr_timerini_iae "Timer für init-Verzögerung der c_iae-Abstelltemperatur" UBYTE Conv.cIaeTempm._.flag_tempsperr_timerini_iae_S5_S3 1 100 0 1 BIT_MASK 0x1 ECU_ADDRESS 0xFFF8B6F1 DISPLAY_IDENTIFIER flag_tempsperr_timerini_iae.iIaeTempm /end MEASUREMENT
/begin MEASUREMENT iIaeTempm.q_ab_iae "[W] Abfliessende Verlustleistung der Kupplung" FLOAT32_IEEE UMR_W__1_1_0_S5_S3 1 100 -1000000 1000000 ECU_ADDRESS 0xFFF8B6EC DISPLAY_IDENTIFIER q_ab_iae.iIaeTempm /end MEASUREMENT
/begin MEASUREMENT iIaeTempm.z_temp_init_iae "Status der Initialisierung des Temperaturmodell der IAE" UBYTE Conv.cIaeTempm._.z_temp_init_iae_S5_S3 1 100 0 2 ECU_ADDRESS 0xFFF8B6F0 DISPLAY_IDENTIFIER z_temp_init_iae.iIaeTempm /end MEASUREMENT
/begin MEASUREMENT iIepBerLp.f_has_aktiv_iep "Anzeige das ein Has Ablauf aktiv ist und die K0 befüllt werden soll" UBYTE Conv.cIepBerLp._.f_has_aktiv_iep_S5_S3 1 100 0 1 BIT_MASK 0x1 ECU_ADDRESS 0xFFF8B6FD DISPLAY_IDENTIFIER f_has_aktiv_iep.iIepBerLp /end MEASUREMENT
/begin MEASUREMENT iIepBerLp.f_iep_ext "FLAG: wird gesetzt wenn das Flag von SAB oder HAS gesetzt ist" UBYTE Conv.cIepBerLp._.f_iep_ext_S5_S3 1 100 0 1 BIT_MASK 0x1 ECU_ADDRESS 0xFFF8B704 DISPLAY_IDENTIFIER f_iep_ext.iIepBerLp /end MEASUREMENT
/begin MEASUREMENT iIepBerLp.f_iep_has "FLAG: wird gesetzt, wenn iep_soll Wert von Has kommt" UBYTE Conv.cIepBerLp._.f_iep_has_S5_S3 1 100 0 1 BIT_MASK 0x1 ECU_ADDRESS 0xFFF8B702 DISPLAY_IDENTIFIER f_iep_has.iIepBerLp /end MEASUREMENT
/begin MEASUREMENT iIepBerLp.f_iep_sab "FLAG: wird gesetzt, wenn iep_soll Wert von Sab kommt" UBYTE Conv.cIepBerLp._.f_iep_sab_S5_S3 1 100 0 1 BIT_MASK 0x1 ECU_ADDRESS 0xFFF8B701 DISPLAY_IDENTIFIER f_iep_sab.iIepBerLp /end MEASUREMENT
/begin MEASUREMENT iIepBerLp.f_iep_tes "FLAG: Sollzustandvorgabe der Iep durch Tester" UBYTE Conv.cIepBerLp._.f_iep_tes_S5_S3 1 100 0 1 BIT_MASK 0x1 ECU_ADDRESS 0xFFF8B703 DISPLAY_IDENTIFIER f_iep_tes.iIepBerLp /end MEASUREMENT
/begin MEASUREMENT iIepBerLp.f_kmn_enpg "FLAG: wird gesetzt, wenn eine KMN zwischen KMN_ENPG3 und KMN_ENPG8 aktiv ist" UBYTE Conv.cIepBerLp._.f_kmn_enpg_S5_S3 1 100 0 1 BIT_MASK 0x1 ECU_ADDRESS 0xFFF8B709 DISPLAY_IDENTIFIER f_kmn_enpg.iIepBerLp /end MEASUREMENT
/begin MEASUREMENT iIepBerLp.f_nmin_iep "Flag zur Anzeige, das die EM alle anderen Leistungspunkte außer LP1 abdeckt" UBYTE Conv.cIepBerLp._.f_nmin_iep_S5_S3 1 100 0 1 BIT_MASK 0x1 ECU_ADDRESS 0xFFF8B6FC DISPLAY_IDENTIFIER f_nmin_iep.iIepBerLp /end MEASUREMENT
/begin MEASUREMENT iIepBerLp.f_senken_LP3_iep "Senken des Lp3 bei P und aktiven brembsbed_ofst" UBYTE Conv.cIepBerLp._.f_senken_LP3_iep_S5_S3 1 100 0 1 BIT_MASK 0x1 ECU_ADDRESS 0xFFF8B700 DISPLAY_IDENTIFIER f_senken_LP3_iep.iIepBerLp /end MEASUREMENT
/begin MEASUREMENT iIepBerLp.iTimerNminIep.timer "Der aktuelle Timerwert" UWORD UMR_MSEC__10_1_0_S5_S3 1 100 0 655350 ECU_ADDRESS 0xFFF8B710 DISPLAY_IDENTIFIER iTimerNminIep.iIepBerLp /end MEASUREMENT
/begin MEASUREMENT iIepBerLp.iTimerSenkenLP3.timer "Der aktuelle Timerwert" ULONG UMR_MSEC__10_1_0_S5_S3 1 100 0 42949672950 ECU_ADDRESS 0xFFF8B70C DISPLAY_IDENTIFIER iTimerSenkenLP3.iIepBerLp /end MEASUREMENT
/begin MEASUREMENT iIepBerLp.iep_soll "Engültiger Soll-Zustand der el. Zusatzpumpe" UBYTE Conv.cIepBerLp._.iep_soll_S5_S3 1 100 0 3 ECU_ADDRESS 0xFFF8B6F8 DISPLAY_IDENTIFIER iep_soll.iIepBerLp /end MEASUREMENT
/begin MEASUREMENT iIepBerLp.iep_soll_ext "Soll-Zustand der el. Zusatzpumpe durch SAB oder HAS" UBYTE Conv.cIepBerLp._.iep_soll_ext_S5_S3 1 100 0 4 ECU_ADDRESS 0xFFF8B6F9 DISPLAY_IDENTIFIER iep_soll_ext.iIepBerLp /end MEASUREMENT
/begin MEASUREMENT iIepBerLp.iep_soll_ext_intern "Sollzustand der Iep" UBYTE Conv.cIepBerLp._.iep_soll_ext_intern_S5_S3 1 100 0 4 ECU_ADDRESS 0xFFF8B6FB DISPLAY_IDENTIFIER iep_soll_ext_intern.iIepBerLp /end MEASUREMENT
/begin MEASUREMENT iIepBerLp.iep_soll_intern "Engültiger Soll-Zustand der el. Zusatzpumpe" UBYTE Conv.cIepBerLp._.iep_soll_intern_S5_S3 1 100 0 3 ECU_ADDRESS 0xFFF8B6FA DISPLAY_IDENTIFIER iep_soll_intern.iIepBerLp /end MEASUREMENT
/begin MEASUREMENT iIepBerLp.m_getr_iep "Eingangsmoment für IEP" SWORD UMR_NM__1_1_0_S5_S3 1 100 -1024 1024 ECU_ADDRESS 0xFFF8B706 DISPLAY_IDENTIFIER m_getr_iep.iIepBerLp /end MEASUREMENT
/begin MEASUREMENT iIepBerLp.schaltung_iep "Schaltung aktiv/nicht aktiv" UBYTE Conv.cIepBerLp._.schaltung_iep_S5_S3 1 100 0 1 BIT_MASK 0x1 ECU_ADDRESS 0xFFF8B6FE DISPLAY_IDENTIFIER schaltung_iep.iIepBerLp /end MEASUREMENT
/begin MEASUREMENT iIepBerLp.z_nmin_iep "Zustandstimer LL Simulation" UBYTE Conv.cIepBerLp._.z_nmin_iep_S5_S3 1 100 0 1 ECU_ADDRESS 0xFFF8B708 DISPLAY_IDENTIFIER z_nmin_iep.iIepBerLp /end MEASUREMENT
/begin MEASUREMENT iIepBerLp.z_senken_lp3 "Senken der LP3 bei P und aktiven bremsbed_ofsb, Wechsel nach LP1" UBYTE Conv.cIepBerLp._.z_senken_lp3_S5_S3 1 100 0 2 ECU_ADDRESS 0xFFF8B6FF DISPLAY_IDENTIFIER z_senken_lp3.iIepBerLp /end MEASUREMENT
/begin MEASUREMENT iIepKordi.bed_in_fehler "Erkennt Bedingungen für den Einstieg in den Fehler-Zustand(f_cgetr_aus_iep,f_tmax_aus_iep,kmn_iep_off)" UBYTE Conv.cIepKordi._.bed_in_fehler_S5_S3 1 100 0 1 BIT_MASK 0x1 ECU_ADDRESS 0xFFF8B720 DISPLAY_IDENTIFIER bed_in_fehler.iIepKordi /end MEASUREMENT
/begin MEASUREMENT iIepKordi.cnt_LP1_iep "Häufigkeit der LP1" ULONG UMR___1_1_0_S5_S3 1 100 0 4294967295 ECU_ADDRESS 0xFFF8B724 DISPLAY_IDENTIFIER cnt_LP1_iep.iIepKordi /end MEASUREMENT
/begin MEASUREMENT iIepKordi.cnt_LP2_iep "Häufigkeit der LP2" ULONG UMR___1_1_0_S5_S3 1 100 0 4294967295 ECU_ADDRESS 0xFFF8B728 DISPLAY_IDENTIFIER cnt_LP2_iep.iIepKordi /end MEASUREMENT
/begin MEASUREMENT iIepKordi.cnt_LP3_iep "Häufigkeit der LP3" ULONG UMR___1_1_0_S5_S3 1 100 0 4294967295 ECU_ADDRESS 0xFFF8B72C DISPLAY_IDENTIFIER cnt_LP3_iep.iIepKordi /end MEASUREMENT
/begin MEASUREMENT iIepKordi.elektrisch_pumpe_laeuft "Signal ob Pumpe Läuft" UBYTE Conv.cIepKordi._.elektrisch_pumpe_laeuft_S5_S3 1 100 0 1 BIT_MASK 0x1 ECU_ADDRESS 0xFFF8B71F DISPLAY_IDENTIFIER elektrisch_pumpe_laeuft.iIepKordi /end MEASUREMENT
/begin MEASUREMENT iIepKordi.fehler_iep "Fehler der el. Zusatzpumpe" UBYTE Conv.cIepKordi._.fehler_iep_S5_S3 1 100 0 1 ECU_ADDRESS 0xFFF8B71E DISPLAY_IDENTIFIER fehler_iep.iIepKordi /end MEASUREMENT
/begin MEASUREMENT iIepKordi.iTimerGesamtLP1.maxtime "Endzeit" ULONG UMR_SEC__1_100_0_S5_S3 1 100 0 36000 ECU_ADDRESS 0xFFF8B740 DISPLAY_IDENTIFIER maxtime.iTimerGesamtLP1.iIepKordi /end MEASUREMENT
/begin MEASUREMENT iIepKordi.iTimerGesamtLP1.time "Zeit des Timers" ULONG UMR_SEC__1_100_0_S5_S3 1 100 0 36000 ECU_ADDRESS 0xFFF8B73C DISPLAY_IDENTIFIER time.iTimerGesamtLP1.iIepKordi /end MEASUREMENT
/begin MEASUREMENT iIepKordi.iTimerGesamtLP2.maxtime "Endzeit" ULONG UMR_SEC__1_100_0_S5_S3 1 100 0 36000 ECU_ADDRESS 0xFFF8B748 DISPLAY_IDENTIFIER maxtime.iTimerGesamtLP2.iIepKordi /end MEASUREMENT
/begin MEASUREMENT iIepKordi.iTimerGesamtLP2.time "Zeit des Timers" ULONG UMR_SEC__1_100_0_S5_S3 1 100 0 36000 ECU_ADDRESS 0xFFF8B744 DISPLAY_IDENTIFIER time.iTimerGesamtLP2.iIepKordi /end MEASUREMENT
/begin MEASUREMENT iIepKordi.iTimerGesamtLP3.maxtime "Endzeit" ULONG UMR_SEC__1_100_0_S5_S3 1 100 0 36000 ECU_ADDRESS 0xFFF8B750 DISPLAY_IDENTIFIER maxtime.iTimerGesamtLP3.iIepKordi /end MEASUREMENT
/begin MEASUREMENT iIepKordi.iTimerGesamtLP3.time "Zeit des Timers" ULONG UMR_SEC__1_100_0_S5_S3 1 100 0 36000 ECU_ADDRESS 0xFFF8B74C DISPLAY_IDENTIFIER time.iTimerGesamtLP3.iIepKordi /end MEASUREMENT
/begin MEASUREMENT iIepKordi.iep_ist "Ist-Zustand der el. Zusatzpumpe" UBYTE Conv.cIepKordi._.iep_ist_S5_S3 1 100 0 4 ECU_ADDRESS 0xFFF8B719 DISPLAY_IDENTIFIER iep_ist.iIepKordi /end MEASUREMENT
/begin MEASUREMENT iIepKordi.iep_ist_manuell "Altes Ist-Zustand der el. Zusatzpumpe für Statistik" UBYTE Conv.cIepKordi._.iep_ist_manuell_S5_S3 1 100 0 4 ECU_ADDRESS 0xFFF8B71A DISPLAY_IDENTIFIER iep_ist_manuell.iIepKordi /end MEASUREMENT
/begin MEASUREMENT iIepKordi.iep_ist_pwm "Istzustand der Pumpe in PWM in Promill" UWORD UMR___1_1_0_S5_S3 1 100 0 10000 ECU_ADDRESS 0xFFF8B71C DISPLAY_IDENTIFIER iep_ist_pwm.iIepKordi /end MEASUREMENT
/begin MEASUREMENT iIepKordi.t_an_LP1_iep "Gesamtlaufzeit in LP1" ULONG UMR_SEC__1_100_0_S5_S3 1 100 0 36000 ECU_ADDRESS 0xFFF8B730 DISPLAY_IDENTIFIER t_an_LP1_iep.iIepKordi /end MEASUREMENT
/begin MEASUREMENT iIepKordi.t_an_LP2_iep "Gesamtlaufzeit in LP2" ULONG UMR_SEC__1_100_0_S5_S3 1 100 0 36000 ECU_ADDRESS 0xFFF8B734 DISPLAY_IDENTIFIER t_an_LP2_iep.iIepKordi /end MEASUREMENT
/begin MEASUREMENT iIepKordi.t_an_LP3_iep "Gesamtlaufzeit in LP3" ULONG UMR_SEC__1_100_0_S5_S3 1 100 0 36000 ECU_ADDRESS 0xFFF8B738 DISPLAY_IDENTIFIER t_an_LP3_iep.iIepKordi /end MEASUREMENT
/begin MEASUREMENT iIepKordi.zustand_iep "Zustand der Zusatzpumpe" UBYTE Conv.cIepKordi._.zustand_iep_S5_S3 1 100 0 10 ECU_ADDRESS 0xFFF8B718 DISPLAY_IDENTIFIER zustand_iep.iIepKordi /end MEASUREMENT
/begin MEASUREMENT iIepLeckagemodell.Pt1NgMotIep.x "Filterwert" SLONG UMR___1_300_0_S5_S3 1 100 -7158278.82667 7158278.82333 ECU_ADDRESS 0xFFF8CF10 DISPLAY_IDENTIFIER Pt1NgMotIep.iIepLeckagemodell /end MEASUREMENT
/begin MEASUREMENT iIepLeckagemodell.Pt1NsMotAnKorrIep.x "Filterwert" SLONG UMR___1_300_0_S5_S3 1 100 -7158278.82667 7158278.82333 ECU_ADDRESS 0xFFF8CF14 DISPLAY_IDENTIFIER Pt1NsMotAnKorrIep.iIepLeckagemodell /end MEASUREMENT
/begin MEASUREMENT iIepLeckagemodell.ng_mot_iep "Gradient der Motordrehzahl" SWORD UMR_U_MINSEC_1_1_0_S5_S3 1 100 -10000 10000 ECU_ADDRESS 0xFFF8CF0C DISPLAY_IDENTIFIER ng_mot_iep.iIepLeckagemodell /end MEASUREMENT
/begin MEASUREMENT iIepLeckagemodell.ns_mot_an_iep "Motordrehzahlschwelle" UWORD UMR_U_MIN_1_1_0_S5_S3 1 100 0 8160 ECU_ADDRESS 0xFFF8CF04 DISPLAY_IDENTIFIER ns_mot_an_iep.iIepLeckagemodell /end MEASUREMENT
/begin MEASUREMENT iIepLeckagemodell.ns_mot_an_korr_iep "Korrigierte, gefilterte berechnete Motordrehzahlschwelle" SWORD UMR_U_MIN_1_1_0_S5_S3 1 100 -8160 8160 ECU_ADDRESS 0xFFF8CF0A DISPLAY_IDENTIFIER ns_mot_an_korr_iep.iIepLeckagemodell /end MEASUREMENT
/begin MEASUREMENT iIepLeckagemodell.ns_mot_an_korr_iep_gef "Gefilterte korrigierte berechnete Motordrehzahlschwelle" SWORD UMR_U_MIN_1_1_0_S5_S3 1 100 -8160 8160 ECU_ADDRESS 0xFFF8CF08 DISPLAY_IDENTIFIER ns_mot_an_korr_iep_gef.iIepLeckagemodell /end MEASUREMENT
/begin MEASUREMENT iIepLeckagemodell.ns_mot_an_korr_iep_roh "Korrigierte berechnete Motordrehzahlschwelle" SWORD UMR_U_MIN_1_1_0_S5_S3 1 100 -8160 8160 ECU_ADDRESS 0xFFF8CF06 DISPLAY_IDENTIFIER ns_mot_an_korr_iep_roh.iIepLeckagemodell /end MEASUREMENT
/begin MEASUREMENT iIepLeckagemodell.ns_mot_hys_iep "Ausschalthysterese" SWORD UMR_U_MIN_1_1_0_S5_S3 1 100 -8160 8160 ECU_ADDRESS 0xFFF8CF0E DISPLAY_IDENTIFIER ns_mot_hys_iep.iIepLeckagemodell /end MEASUREMENT
/begin MEASUREMENT iIepLeckagemodell.q_bedarf_iep "Bedarf an Ölvolumen" FLOAT32_IEEE UMR_LITER_MIN_1_1_0_S5_S3 1 100 0 30 ECU_ADDRESS 0xFFF8CF00 FORMAT "%2.1" DISPLAY_IDENTIFIER q_bedarf_iep.iIepLeckagemodell /end MEASUREMENT
/begin MEASUREMENT iIepLeckagemodell.q_leckage_fzp_iep "Leckage der mech. Flügelzellenpumpe" FLOAT32_IEEE UMR_LITER_MIN_1_1_0_S5_S3 1 100 0 20 ECU_ADDRESS 0xFFF8CEF4 FORMAT "%2.1" DISPLAY_IDENTIFIER q_leckage_fzp_iep.iIepLeckagemodell /end MEASUREMENT
/begin MEASUREMENT iIepLeckagemodell.q_leckage_ges_iep "Gesamte Leckage HSG und FZP" FLOAT32_IEEE UMR_LITER_MIN_1_1_0_S5_S3 1 100 0 20 ECU_ADDRESS 0xFFF8CEFC FORMAT "%2.1" DISPLAY_IDENTIFIER q_leckage_ges_iep.iIepLeckagemodell /end MEASUREMENT
/begin MEASUREMENT iIepLeckagemodell.q_leckage_hsg_iep "Leckage des hydr. Schaltgerätes" FLOAT32_IEEE UMR_LITER_MIN_1_1_0_S5_S3 1 100 0 20 ECU_ADDRESS 0xFFF8CEF8 FORMAT "%2.1" DISPLAY_IDENTIFIER q_leckage_hsg_iep.iIepLeckagemodell /end MEASUREMENT
/begin RECORD_LAYOUT ZF_KF_INT32_S4_S3 FNC_VALUES 5 SLONG ROW_DIR DIRECT AXIS_PTS_X 3 SLONG INDEX_INCR DIRECT AXIS_PTS_Y 4 SLONG INDEX_INCR DIRECT NO_AXIS_PTS_X 1 ULONG NO_AXIS_PTS_Y 2 ULONG /end RECORD_LAYOUT
/begin RECORD_LAYOUT ZF_KF_INT8_S1_S3 FNC_VALUES 5 SBYTE ROW_DIR DIRECT AXIS_PTS_X 3 SBYTE INDEX_INCR DIRECT AXIS_PTS_Y 4 SBYTE INDEX_INCR DIRECT NO_AXIS_PTS_X 1 ULONG NO_AXIS_PTS_Y 2 ULONG /end RECORD_LAYOUT
/begin RECORD_LAYOUT ZF_KF_INT8_S2_S3 FNC_VALUES 5 SBYTE ROW_DIR DIRECT AXIS_PTS_X 3 SBYTE INDEX_INCR DIRECT AXIS_PTS_Y 4 SBYTE INDEX_INCR DIRECT NO_AXIS_PTS_X 1 ULONG NO_AXIS_PTS_Y 2 ULONG /end RECORD_LAYOUT
/begin RECORD_LAYOUT ZF_KF_INT8_S3_S3 FNC_VALUES 5 SBYTE ROW_DIR DIRECT AXIS_PTS_X 3 SBYTE INDEX_INCR DIRECT AXIS_PTS_Y 4 SBYTE INDEX_INCR DIRECT NO_AXIS_PTS_X 1 ULONG NO_AXIS_PTS_Y 2 ULONG /end RECORD_LAYOUT
/begin RECORD_LAYOUT ZF_KF_INT8_S4_S3 FNC_VALUES 5 SBYTE ROW_DIR DIRECT AXIS_PTS_X 3 SBYTE INDEX_INCR DIRECT AXIS_PTS_Y 4 SBYTE INDEX_INCR DIRECT NO_AXIS_PTS_X 1 ULONG NO_AXIS_PTS_Y 2 ULONG /end RECORD_LAYOUT
/begin RECORD_LAYOUT ZF_KF_NAT16_S1_S3 FNC_VALUES 5 UWORD ROW_DIR DIRECT AXIS_PTS_X 3 UWORD INDEX_INCR DIRECT AXIS_PTS_Y 4 UWORD INDEX_INCR DIRECT NO_AXIS_PTS_X 1 ULONG NO_AXIS_PTS_Y 2 ULONG /end RECORD_LAYOUT
/begin RECORD_LAYOUT ZF_KF_NAT16_S2_S3 FNC_VALUES 5 UWORD ROW_DIR DIRECT AXIS_PTS_X 3 UWORD INDEX_INCR DIRECT AXIS_PTS_Y 4 UWORD INDEX_INCR DIRECT NO_AXIS_PTS_X 1 ULONG NO_AXIS_PTS_Y 2 ULONG /end RECORD_LAYOUT
/begin RECORD_LAYOUT ZF_KF_NAT16_S3_S3 FNC_VALUES 5 UWORD ROW_DIR DIRECT AXIS_PTS_X 3 UWORD INDEX_INCR DIRECT AXIS_PTS_Y 4 UWORD INDEX_INCR DIRECT NO_AXIS_PTS_X 1 ULONG NO_AXIS_PTS_Y 2 ULONG /end RECORD_LAYOUT
/begin RECORD_LAYOUT ZF_KF_NAT16_S4_S3 FNC_VALUES 5 UWORD ROW_DIR DIRECT AXIS_PTS_X 3 UWORD INDEX_INCR DIRECT AXIS_PTS_Y 4 UWORD INDEX_INCR DIRECT NO_AXIS_PTS_X 1 ULONG NO_AXIS_PTS_Y 2 ULONG /end RECORD_LAYOUT
/begin RECORD_LAYOUT ZF_KF_NAT32_S1_S3 FNC_VALUES 5 ULONG ROW_DIR DIRECT AXIS_PTS_X 3 ULONG INDEX_INCR DIRECT AXIS_PTS_Y 4 ULONG INDEX_INCR DIRECT NO_AXIS_PTS_X 1 ULONG NO_AXIS_PTS_Y 2 ULONG /end RECORD_LAYOUT
/begin RECORD_LAYOUT ZF_KF_NAT32_S2_S3 FNC_VALUES 5 ULONG ROW_DIR DIRECT AXIS_PTS_X 3 ULONG INDEX_INCR DIRECT AXIS_PTS_Y 4 ULONG INDEX_INCR DIRECT NO_AXIS_PTS_X 1 ULONG NO_AXIS_PTS_Y 2 ULONG /end RECORD_LAYOUT
/begin RECORD_LAYOUT ZF_KF_NAT32_S3_S3 FNC_VALUES 5 ULONG ROW_DIR DIRECT AXIS_PTS_X 3 ULONG INDEX_INCR DIRECT AXIS_PTS_Y 4 ULONG INDEX_INCR DIRECT NO_AXIS_PTS_X 1 ULONG NO_AXIS_PTS_Y 2 ULONG /end RECORD_LAYOUT
/begin RECORD_LAYOUT ZF_KF_NAT32_S4_S3 FNC_VALUES 5 ULONG ROW_DIR DIRECT AXIS_PTS_X 3 ULONG INDEX_INCR DIRECT AXIS_PTS_Y 4 ULONG INDEX_INCR DIRECT NO_AXIS_PTS_X 1 ULONG NO_AXIS_PTS_Y 2 ULONG /end RECORD_LAYOUT
/begin RECORD_LAYOUT ZF_KF_NAT8_S1_S3 FNC_VALUES 5 UBYTE ROW_DIR DIRECT AXIS_PTS_X 3 UBYTE INDEX_INCR DIRECT AXIS_PTS_Y 4 UBYTE INDEX_INCR DIRECT NO_AXIS_PTS_X 1 ULONG NO_AXIS_PTS_Y 2 ULONG /end RECORD_LAYOUT
/begin RECORD_LAYOUT ZF_KF_NAT8_S2_S3 FNC_VALUES 5 UBYTE ROW_DIR DIRECT AXIS_PTS_X 3 UBYTE INDEX_INCR DIRECT AXIS_PTS_Y 4 UBYTE INDEX_INCR DIRECT NO_AXIS_PTS_X 1 ULONG NO_AXIS_PTS_Y 2 ULONG /end RECORD_LAYOUT
/begin RECORD_LAYOUT ZF_KF_NAT8_S3_S3 FNC_VALUES 5 UBYTE ROW_DIR DIRECT AXIS_PTS_X 3 UBYTE INDEX_INCR DIRECT AXIS_PTS_Y 4 UBYTE INDEX_INCR DIRECT NO_AXIS_PTS_X 1 ULONG NO_AXIS_PTS_Y 2 ULONG /end RECORD_LAYOUT
/begin RECORD_LAYOUT ZF_KF_NAT8_S4_S3 FNC_VALUES 5 UBYTE ROW_DIR DIRECT AXIS_PTS_X 3 UBYTE INDEX_INCR DIRECT AXIS_PTS_Y 4 UBYTE INDEX_INCR DIRECT NO_AXIS_PTS_X 1 ULONG NO_AXIS_PTS_Y 2 ULONG /end RECORD_LAYOUT
/begin RECORD_LAYOUT ZF_KL_INT16_S1_S3 FNC_VALUES 3 SWORD COLUMN_DIR DIRECT AXIS_PTS_X 2 SWORD INDEX_INCR DIRECT NO_AXIS_PTS_X 1 ULONG /end RECORD_LAYOUT
/begin RECORD_LAYOUT ZF_KL_INT16_S2_S3 FNC_VALUES 3 SWORD COLUMN_DIR DIRECT AXIS_PTS_X 2 SWORD INDEX_INCR DIRECT NO_AXIS_PTS_X 1 ULONG /end RECORD_LAYOUT
/begin RECORD_LAYOUT ZF_KL_INT16_S3_S3 FNC_VALUES 3 SWORD COLUMN_DIR DIRECT AXIS_PTS_X 2 SWORD INDEX_INCR DIRECT NO_AXIS_PTS_X 1 ULONG /end RECORD_LAYOUT
/begin RECORD_LAYOUT ZF_KL_INT16_S4_S3 FNC_VALUES 3 SWORD COLUMN_DIR DIRECT AXIS_PTS_X 2 SWORD INDEX_INCR DIRECT NO_AXIS_PTS_X 1 ULONG /end RECORD_LAYOUT
/begin RECORD_LAYOUT ZF_KL_INT32_S1_S3 FNC_VALUES 3 SLONG COLUMN_DIR DIRECT AXIS_PTS_X 2 SLONG INDEX_INCR DIRECT NO_AXIS_PTS_X 1 ULONG /end RECORD_LAYOUT
/begin RECORD_LAYOUT ZF_KL_INT32_S2_S3 FNC_VALUES 3 SLONG COLUMN_DIR DIRECT AXIS_PTS_X 2 SLONG INDEX_INCR DIRECT NO_AXIS_PTS_X 1 ULONG /end RECORD_LAYOUT
/end MODULE
/end PROJECT
