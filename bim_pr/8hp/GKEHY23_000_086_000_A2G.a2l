ASAP2_VERSION 1 51
/begin PROJECT ZHBC8600 "Gen2_BMW_System_Supplier_Lib"
/begin MODULE CPP ""
/begin MOD_COMMON "" BYTE_ORDER MSB_FIRST ALIGNMENT_BYTE 1 ALIGNMENT_WORD 2 ALIGNMENT_LONG 4 ALIGNMENT_FLOAT32_IEEE 4 ALIGNMENT_FLOAT64_IEEE 1 /end MOD_COMMON
/begin COMPU_VTAB CONV_TAB_E_FEHLERIEP_S6_S3 "Conversion table" TAB_VERB 2 0 "NORMALBETRIEB" 1 "FEHLER" DEFAULT_VALUE "" /end COMPU_VTAB
/begin COMPU_VTAB CONV_TAB_E_HYBFKT_S6_S3 "Conversion table" TAB_VERB 16 0 "PASSIV" 1 "ANKOPPELN_VM" 2 "ABKOPPELN_VM" 3 "GANGEINLEGEN" 4 "GANGAUSLEGEN" 5 "OHNABLAUFFKT" 6 "DIREKTSTART" 7 "VM_ZUSTART" 8 "ABSTELLEN_VM" 9 "NICHTDEFINIERT_4" 10 "VM_SCHLEPPSTART" 11 "VM_NOTSTART" 12 "VM_EIN" 13 "VM_AUS" 14 "NICHTDEFINIERT_3" 15 "FEHLER" DEFAULT_VALUE "" /end COMPU_VTAB
/begin COMPU_VTAB CONV_TAB_E_POS_S6_S3 "Conversion table" TAB_VERB 9 0 "D1" 1 "D2" 2 "D3" 3 "D4" 4 "D5" 5 "D" 6 "N" 7 "R" 8 "P" DEFAULT_VALUE "" /end COMPU_VTAB
/begin COMPU_VTAB CONV_TAB_E_SIGSTATUS_S6_S3 "Conversion table" TAB_VERB 3 0 "SIGNAL_OK" 1 "ERSATZWERT" 2 "SIGNAL_FEHLER" DEFAULT_VALUE "" /end COMPU_VTAB
/begin COMPU_VTAB CONV_TAB_E_STATUSADA_S6_S3 "Conversion table" TAB_VERB 3 0 "KEINADAPTION" 1 "TOUCHPOINT_ADAPTION" 2 "REIBWERT_ADAPTION" DEFAULT_VALUE "" /end COMPU_VTAB
/begin COMPU_VTAB CONV_TAB_E_STATUSIAE_S6_S3 "Conversion table" TAB_VERB 9 0 "NICHTDEFINIERT" 1 "OFFEN" 2 "ANGELEGT" 3 "ANFAHREN" 4 "ENTKOPPELT" 5 "ENTKOPPELT_ANFAHREN" 6 "SYNCHRONISIEREN" 7 "GESCHLOSSEN" 8 "OEFFNEN" DEFAULT_VALUE "" /end COMPU_VTAB
/begin COMPU_VTAB CONV_TAB_E_STATUSIEP_S6_S3 "Conversion table" TAB_VERB 5 0 "AUS" 1 "SLEEP" 2 "LP1" 3 "LP2" 4 "LP3" DEFAULT_VALUE "" /end COMPU_VTAB
/begin COMPU_VTAB CONV_TAB_E_STATUSK0_S6_S3 "Conversion table" TAB_VERB 6 0 "OFFEN" 1 "ANGELEGT" 2 "DRUCKSTELLUNG" 3 "SCHLUPFGEREGELT" 4 "GEREGELTGESCHL" 5 "GESCHLOSSEN" DEFAULT_VALUE "" /end COMPU_VTAB
/begin COMPU_VTAB CONV_TAB_E_STATUSKSL_S6_S3 "Conversion table" TAB_VERB 7 0 "KEIN_KRAFTSCHLUSS" 1 "VORW_AUF_ABBAUEND" 2 "VORWAERTS" 3 "RUECKW_AUF_ABBAUEND" 4 "RUECKWAERTS" 5 "VORWAERTS_SCHLUPF" 6 "RUECKWAERTS_SCHLUPF" DEFAULT_VALUE "" /end COMPU_VTAB
/begin COMPU_VTAB CONV_TAB_E_STATUSPSY_S6_S3 "Conversion table" TAB_VERB 5 0 "AUS" 1 "NICHTDEFINIERT" 2 "LP1" 3 "LP2" 4 "LP3" DEFAULT_VALUE "" /end COMPU_VTAB
/begin COMPU_VTAB CONV_TAB_E_STBZHAS_S6_S3 "Conversion table" TAB_VERB 16 0 "INIT_INAKTIV" 1 "ANGEKOPPELT" 2 "ENTKOPPELT" 3 "EFAHREN" 4 "STOP" 5 "LADEN" 6 "ENTK_VMEIN" 7 "EFAHREN_VMEIN" 8 "HYBRID" 9 "NICHTDEFINIERT_1" 10 "NICHTDEFINIERT_2" 11 "NICHTDEFINIERT_3" 12 "NICHTDEFINIERT_4" 13 "NICHTDEFINIERT_5" 14 "INIT_KL15" 15 "FEHLER" DEFAULT_VALUE "" /end COMPU_VTAB
/begin COMPU_VTAB CONV_TAB_E_ZIEP_S6_S3 "Conversion table" TAB_VERB 5 0 "AUS" 1 "SLEEP" 2 "LP1" 3 "LP2" 4 "LP3" DEFAULT_VALUE "" /end COMPU_VTAB
/begin COMPU_VTAB CONV_TAB_E_ZK0_S6_S3 "Conversion table" TAB_VERB 6 0 "OEFFNENSW" 1 "BEFUELLEN" 2 "DRUCKSTELLUNG" 3 "SCHLUPFREGELUNG" 4 "GEREGELTGESCHL" 5 "GESCHLOSSEN" DEFAULT_VALUE "" /end COMPU_VTAB
/begin COMPU_VTAB CONV_TAB_E_ZK0FSTIN_S6_S3 "Conversion table" TAB_VERB 4 0 "OFFEN" 1 "SCHLUPFGEREGELT" 2 "GEREGELTGESCHL" 3 "GESCHLOSSEN" DEFAULT_VALUE "" /end COMPU_VTAB
/begin COMPU_VTAB CONV_TAB_E_ZMODUSIAE_S6_S3 "Conversion table" TAB_VERB 3 0 "EFAHREN_SCHLUPF" 1 "EFAHREN_KRAFTSCHL" 2 "HYBRIDFAHREN" DEFAULT_VALUE "" /end COMPU_VTAB
/begin COMPU_VTAB CONV_TAB_E_ZMODUSIEP_S6_S3 "Conversion table" TAB_VERB 5 0 "KEINVORGABE" 1 "AUS" 2 "LP1" 3 "LP2" 4 "LP3" DEFAULT_VALUE "" /end COMPU_VTAB
/begin COMPU_VTAB CONV_TAB_E_ZNLLSOLL_S6_S3 "Conversion table" TAB_VERB 3 0 "KEINANF" 1 "ANF_ADAP" 2 "ANF_ALLG" DEFAULT_VALUE "" /end COMPU_VTAB
/begin COMPU_METHOD b_int_S6_S3 "Bit Feld" RAT_FUNC "%10.0" "-" COEFFS 0 1 0 0 0 1 /end COMPU_METHOD
/begin COMPU_METHOD c_int_S6_S3 "Temperatur" RAT_FUNC "%12.6" "°C" COEFFS 0 1 0 0 0 1 /end COMPU_METHOD
/begin COMPU_METHOD E_FEHLERIEP_S6_S3 "" TAB_VERB "%12.6" "" COMPU_TAB_REF CONV_TAB_E_FEHLERIEP_S6_S3 /end COMPU_METHOD
/begin COMPU_METHOD E_HYBFKT_S6_S3 "" TAB_VERB "%12.6" "" COMPU_TAB_REF CONV_TAB_E_HYBFKT_S6_S3 /end COMPU_METHOD
/begin COMPU_METHOD E_POS_S6_S3 "" TAB_VERB "%12.6" "" COMPU_TAB_REF CONV_TAB_E_POS_S6_S3 /end COMPU_METHOD
/begin COMPU_METHOD E_SIGSTATUS_S6_S3 "" TAB_VERB "%12.6" "" COMPU_TAB_REF CONV_TAB_E_SIGSTATUS_S6_S3 /end COMPU_METHOD
/begin COMPU_METHOD E_STATUSADA_S6_S3 "" TAB_VERB "%12.6" "" COMPU_TAB_REF CONV_TAB_E_STATUSADA_S6_S3 /end COMPU_METHOD
/begin COMPU_METHOD E_STATUSIAE_S6_S3 "" TAB_VERB "%12.6" "" COMPU_TAB_REF CONV_TAB_E_STATUSIAE_S6_S3 /end COMPU_METHOD
/begin COMPU_METHOD E_STATUSIEP_S6_S3 "" TAB_VERB "%12.6" "" COMPU_TAB_REF CONV_TAB_E_STATUSIEP_S6_S3 /end COMPU_METHOD
/begin COMPU_METHOD E_STATUSK0_S6_S3 "" TAB_VERB "%12.6" "" COMPU_TAB_REF CONV_TAB_E_STATUSK0_S6_S3 /end COMPU_METHOD
/begin COMPU_METHOD E_STATUSKSL_S6_S3 "" TAB_VERB "%12.6" "" COMPU_TAB_REF CONV_TAB_E_STATUSKSL_S6_S3 /end COMPU_METHOD
/begin COMPU_METHOD E_STATUSPSY_S6_S3 "" TAB_VERB "%12.6" "" COMPU_TAB_REF CONV_TAB_E_STATUSPSY_S6_S3 /end COMPU_METHOD
/begin COMPU_METHOD E_STBZHAS_S6_S3 "" TAB_VERB "%12.6" "" COMPU_TAB_REF CONV_TAB_E_STBZHAS_S6_S3 /end COMPU_METHOD
/begin COMPU_METHOD E_ZIEP_S6_S3 "" TAB_VERB "%12.6" "" COMPU_TAB_REF CONV_TAB_E_ZIEP_S6_S3 /end COMPU_METHOD
/begin COMPU_METHOD E_ZK0_S6_S3 "" TAB_VERB "%12.6" "" COMPU_TAB_REF CONV_TAB_E_ZK0_S6_S3 /end COMPU_METHOD
/begin COMPU_METHOD E_ZK0FSTIN_S6_S3 "" TAB_VERB "%12.6" "" COMPU_TAB_REF CONV_TAB_E_ZK0FSTIN_S6_S3 /end COMPU_METHOD
/begin COMPU_METHOD E_ZMODUSIAE_S6_S3 "" TAB_VERB "%12.6" "" COMPU_TAB_REF CONV_TAB_E_ZMODUSIAE_S6_S3 /end COMPU_METHOD
/begin COMPU_METHOD E_ZMODUSIEP_S6_S3 "" TAB_VERB "%12.6" "" COMPU_TAB_REF CONV_TAB_E_ZMODUSIEP_S6_S3 /end COMPU_METHOD
/begin COMPU_METHOD E_ZNLLSOLL_S6_S3 "" TAB_VERB "%12.6" "" COMPU_TAB_REF CONV_TAB_E_ZNLLSOLL_S6_S3 /end COMPU_METHOD
/begin COMPU_METHOD n_fl_S6_S3 "Drehzahl" RAT_FUNC "%12.6" "1/min" COEFFS 0 1 0 0 0 1 /end COMPU_METHOD
/begin COMPU_METHOD ng_fl_S6_S3 "Drehzahlgradient" RAT_FUNC "%12.6" "1/min/s" COEFFS 0 1 0 0 0 1 /end COMPU_METHOD
/begin COMPU_METHOD p_fl_S6_S3 "Druck" RAT_FUNC "%12.6" "bar" COEFFS 0 1 0 0 0 1 /end COMPU_METHOD
/begin COMPU_METHOD SAB2_A_2MPSS1000_M32500_S3_S3 "int = ((phys * 1000) / 2) - (-32500) m/s^2" RAT_FUNC "%4.3" "m/s^2" COEFFS 0 500 32500 0 0 1 /end COMPU_METHOD
/begin COMPU_METHOD SAB2_A_981G10000_M127_S3_S3 "int = ((phys * 1.0E6) / 981) - (-1295) g" RAT_FUNC "%7.6" "g" COEFFS 0 1019.36799185 1295 0 0 1 /end COMPU_METHOD
/begin COMPU_METHOD SAB2_A_MPSS32_S3_S3 "int = ((phys * 32) / 1) - (0) m/s^2" RAT_FUNC "%4.3" "m/s^2" COEFFS 0 32 0 0 0 1 /end COMPU_METHOD
/begin COMPU_METHOD SAB2_A_MPSS40_S3_S3 "int = ((phys * 40) / 1) - (0) m/s^2" RAT_FUNC "%4.3" "m/s^2" COEFFS 0 40 0 0 0 1 /end COMPU_METHOD
/begin COMPU_METHOD SAB2_C_1CEL_M50_S3_S3 "int = ((phys * 1) / 1) - (-50) Grad Celsius" RAT_FUNC "%1.0" "Grad Celsius" COEFFS 0 1 50 0 0 1 /end COMPU_METHOD
/begin COMPU_METHOD SAB2_C_1CEL_M60_S3_S3 "int = ((phys * 1) / 1) - (-60) Grad Celsius" RAT_FUNC "%1.0" "Grad Celsius" COEFFS 0 1 60 0 0 1 /end COMPU_METHOD
/begin COMPU_METHOD t_fl_S6_S3 "Zeit" RAT_FUNC "%12.6" "s" COEFFS 0 1 0 0 0 1 /end COMPU_METHOD
/begin COMPU_METHOD t_int_d_S6_S3 "Zeit" RAT_FUNC "%4.2" "s" COEFFS 0 100 0 0 0 1 /end COMPU_METHOD
/begin COMPU_METHOD t_int_S6_S3 "Zeit" RAT_FUNC "%11.2" "s" COEFFS 0 100 0 0 0 1 /end COMPU_METHOD
/begin COMPU_METHOD trq_fl_a_S6_S3 "Moment" RAT_FUNC "%12.6" "Nm" COEFFS 0 1 0 0 0 1 /end COMPU_METHOD
/begin COMPU_METHOD trqg_fl_c_S6_S3 "Momentengradient" RAT_FUNC "%12.6" "Nm/s" COEFFS 0 1 0 0 0 1 /end COMPU_METHOD
/begin COMPU_METHOD v_fl_S6_S3 "Geschwindigkeit" RAT_FUNC "%12.6" "km/h" COEFFS 0 1 0 0 0 1 /end COMPU_METHOD
/begin COMPU_METHOD vg_fl_S6_S3 "Geschwindigkeitsgradient" RAT_FUNC "%12.6" "km/h/s" COEFFS 0 1 0 0 0 1 /end COMPU_METHOD
/begin COMPU_METHOD void_fl_S6_S3 "ohne Umrechnung" RAT_FUNC "%12.6" "-" COEFFS 0 1 0 0 0 1 /end COMPU_METHOD
/begin COMPU_METHOD void_int_b_S6_S3 "ohne Umrechnung" RAT_FUNC "%5.0" "-" COEFFS 0 1 0 0 0 1 /end COMPU_METHOD
/begin COMPU_METHOD void_int_e_S6_S3 "ohne Umrechnung" RAT_FUNC "%1.0" "-" COEFFS 0 1 0 0 0 1 /end COMPU_METHOD
/begin COMPU_METHOD void_int_S6_S3 "ohne Umrechnung" RAT_FUNC "%3.0" "-" COEFFS 0 1 0 0 0 1 /end COMPU_METHOD
/begin COMPU_METHOD VOID_SCALING_f_S6_S3 "Void scaling for unscaled variables" RAT_FUNC "%12.6" "" COEFFS 0 1 0 0 0 1 /end COMPU_METHOD
/begin COMPU_METHOD VOID_SCALING_g_S6_S3 "Void scaling for unscaled variables" RAT_FUNC "%3.0" "" COEFFS 0 1 0 0 0 1 /end COMPU_METHOD
/begin COMPU_METHOD VOID_SCALING_S6_S3 "Void scaling for unscaled variables" RAT_FUNC "%1.0" "" COEFFS 0 1 0 0 0 1 /end COMPU_METHOD
/begin CHARACTERISTIC FK_14NSOLLVM_ANS "Filterzeit zur Filterung von n_soll_vm_has" VALUE 0x1D1960 FLOAT32_IEEE_COL_DIRECT_S6_S3 0 t_fl_S6_S3 -3.40282e+038 3.40282e+038 /end CHARACTERISTIC
/begin CHARACTERISTIC FK_MGWUNSCHFPW "Filterkoeffizient zur Berechnung Gradient Fahrsollmoment" VALUE 0x1975E8 FLOAT32_IEEE_COL_DIRECT_S6_S3 0 void_fl_S6_S3 -3.40282e+038 3.40282e+038 /end CHARACTERISTIC
/begin CHARACTERISTIC FK_MK0MBERZUS_HAS "Filterkoeffizient zur PT1-Filterung des K0-Moments der HAS zur Motormomentbe-grenzung in der SAB beim Zustart" VALUE 0x1979A8 FLOAT32_IEEE_COL_DIRECT_S6_S3 0 void_fl_S6_S3 0 1 /end CHARACTERISTIC
/begin CHARACTERISTIC FK_NDGK0 "Filterkoeffizient zu Berechnung Gradient Differenzdrehzahl K0" VALUE 0x1975EC FLOAT32_IEEE_COL_DIRECT_S6_S3 0 void_fl_S6_S3 -3.40282e+038 3.40282e+038 /end CHARACTERISTIC
/begin CHARACTERISTIC FK_NDGSOLLVMNVM_SYN_ZUS "Filterkonstante zur Bestimmung des Gradienten der Differenz zwischen VM-Soll- und Ist-Drehzahl im Zustand K0 Synchronisieren beim Zustart" VALUE 0x1D5D78 FLOAT32_IEEE_COL_DIRECT_S6_S3 0 void_fl_S6_S3 0 1 /end CHARACTERISTIC
/begin CHARACTERISTIC FK_NGEM_ANK "Filterkonstante zur Bestimmung des EM-Drehzahlgradienten beim Ankoppeln" VALUE 0x1D0EBC FLOAT32_IEEE_COL_DIRECT_S6_S3 0 void_fl_S6_S3 0 1 /end CHARACTERISTIC
/begin CHARACTERISTIC FK_NGEM_ZUS "Filterkonstante zur Berechnung des EM-Drehzahlgradienten beim Zustart" VALUE 0x1D5D7C FLOAT32_IEEE_COL_DIRECT_S6_S3 0 void_fl_S6_S3 0 1 /end CHARACTERISTIC
/begin CHARACTERISTIC FK_NGVM_AST_ABST "Zusätzliche PT1-Filterung von ng_vm_in zum Vergleich mit der VM-Drehzahlgradientenschwelle zur Vorgabe K0 OEFFNENSW im Zustand VM-Abstellen beim VM Abstellen" VALUE 0x1D0D28 FLOAT32_IEEE_COL_DIRECT_S6_S3 0 ng_fl_S6_S3 0 5 /end CHARACTERISTIC
/begin CHARACTERISTIC FK_NGVM_HAS "Filterkoeffizient zu Berechnung Gradient Differenzdrehzahl VM" VALUE 0x1975F0 FLOAT32_IEEE_COL_DIRECT_S6_S3 0 void_fl_S6_S3 -3.40282e+038 3.40282e+038 /end CHARACTERISTIC
/begin CHARACTERISTIC FK_NMOTSOLLIAE1_ANS "Filterkonstante 1 zur Filterung von n_mot_soll_iae_fil" VALUE 0x1D1968 FLOAT32_IEEE_COL_DIRECT_S6_S3 0 t_fl_S6_S3 -3.40282e+038 3.40282e+038 /end CHARACTERISTIC
/begin CHARACTERISTIC FK_NMOTSOLLIAE2_ANS "Filterkonstante 2 zur Filterung von n_mot_soll_iae_fil" VALUE 0x1D196C FLOAT32_IEEE_COL_DIRECT_S6_S3 0 t_fl_S6_S3 -3.40282e+038 3.40282e+038 /end CHARACTERISTIC
/begin CHARACTERISTIC FK_NSOLLVM_ANH_ZUS "Filterung der VM Solldrehzahl beim VM Start Variante Zustarten" VALUE 0x1D5D80 FLOAT32_IEEE_COL_DIRECT_S6_S3 0 void_fl_S6_S3 0 1 /end CHARACTERISTIC
/begin CHARACTERISTIC FK_NSOLLVM_KON_ANK "Filterung der VM-Solldrehzahl ab dem Zustand Konditionieren beim Ankoppeln" VALUE 0x1D0EC0 FLOAT32_IEEE_COL_DIRECT_S6_S3 0 void_fl_S6_S3 0 1 /end CHARACTERISTIC
/begin CHARACTERISTIC FK_NSOLLVM_SAK_ZUS "Filterung der VM-Solldrehzahl im Zustand Schaltung aktiv beim Zustart" VALUE 0x1D5D84 FLOAT32_IEEE_COL_DIRECT_S6_S3 0 void_fl_S6_S3 0 1 /end CHARACTERISTIC
/begin CHARACTERISTIC FK_NSOLLVM_ZST_ZUS "Filterung der VM Solldrehzahl beim VM Start Variante Zustarten" VALUE 0x1D5D88 FLOAT32_IEEE_COL_DIRECT_S6_S3 0 void_fl_S6_S3 0 1 /end CHARACTERISTIC
/begin CHARACTERISTIC FK_VGF_HAS "Filterkoeffizient zur Berechnung des Fahrzeuggeschwindigkeitsgradienten in der Hybridablaufsteuerung" VALUE 0x1975FC FLOAT32_IEEE_COL_DIRECT_S6_S3 0 void_fl_S6_S3 0 1 /end CHARACTERISTIC
/begin CHARACTERISTIC KF_MMOTMAX_HAS_W "Maximales Getriebeeingangsmoment" MAP 0x197C5C FLOAT32_IEEE_COL_DIRECT_S6_S3 0 trq_fl_a_S6_S3 -3.40282e+038 3.40282e+038
 /begin AXIS_DESCR COM_AXIS istgang_egs_in void_fl_S6_S3 10 -3.40282e+038 3.40282e+038 DEPOSIT ABSOLUTE AXIS_PTS_REF KF_MMOTMAX_HAS_X /end AXIS_DESCR
 /begin AXIS_DESCR COM_AXIS NO_INPUT_QUANTITY void_fl_S6_S3 6 -3.40282e+038 3.40282e+038 DEPOSIT ABSOLUTE AXIS_PTS_REF KF_MMOTMAX_HAS_Y /end AXIS_DESCR
/end CHARACTERISTIC
/begin AXIS_PTS KF_MMOTMAX_HAS_X "Maximales Getriebeeingangsmoment: Gangindex" 0x197D4C istgang_egs_in FLOAT32_IEEE_X_INCR_DIRECT_S6_S3 0 void_fl_S6_S3 10 -3.40282e+038 3.40282e+038 DEPOSIT ABSOLUTE /end AXIS_PTS
/begin AXIS_PTS KF_MMOTMAX_HAS_Y "Maximales Getriebeeingangsmoment: Druck" 0x197D74 NO_INPUT_QUANTITY FLOAT32_IEEE_X_INCR_DIRECT_S6_S3 0 void_fl_S6_S3 6 -3.40282e+038 3.40282e+038 DEPOSIT ABSOLUTE /end AXIS_PTS
/begin CHARACTERISTIC KF_PMAX_FZP_HAS_W "Maximaler Systemdruck über FZP in Abhängigkeit von E-Maschinen-Drehzahl und Getriebetemperatur" MAP 0x197ECC FLOAT32_IEEE_COL_DIRECT_S6_S3 0 void_fl_S6_S3 -3.40282e+038 3.40282e+038
 /begin AXIS_DESCR COM_AXIS c_getriebe_egs_in c_int_S6_S3 5 -3.40282e+038 3.40282e+038 DEPOSIT ABSOLUTE AXIS_PTS_REF KF_PMAX_FZP_HAS_X /end AXIS_DESCR
 /begin AXIS_DESCR COM_AXIS n_em_in trq_fl_a_S6_S3 6 -3.40282e+038 3.40282e+038 DEPOSIT ABSOLUTE AXIS_PTS_REF KF_PMAX_FZP_HAS_Y /end AXIS_DESCR
/end CHARACTERISTIC
/begin AXIS_PTS KF_PMAX_FZP_HAS_X "Maximaler Systemdruck über FZP in Abhängigkeit von E-Maschinen-Drehzahl und Getriebetemperatur: Temperatur" 0x197F44 c_getriebe_egs_in FLOAT32_IEEE_X_INCR_DIRECT_S6_S3 0 c_int_S6_S3 5 -3.40282e+038 3.40282e+038 DEPOSIT ABSOLUTE /end AXIS_PTS
/begin AXIS_PTS KF_PMAX_FZP_HAS_Y "Maximaler Systemdruck über FZP in Abhängigkeit von E-Maschinen-Drehzahl und Getriebetemperatur: Drehzahl" 0x197F58 n_em_in FLOAT32_IEEE_X_INCR_DIRECT_S6_S3 0 trq_fl_a_S6_S3 6 -3.40282e+038 3.40282e+038 DEPOSIT ABSOLUTE /end AXIS_PTS
/begin CHARACTERISTIC KF_SCHALTART_ZUL_SVH_HAS_W "Festlegung der zulässigen Schaltart der Schaltverhinderung der HAS in Abhängigkeit des aktiven Ablaufs (255 = alle Schaltarten zulässig, 0 = keine Schaltart zulässig) - Bit-Codierung -> siehe Handbuch bzw. Kommentar zu status_schaltart_zul_svh_has  " MAP 0x1D761A UBYTE_COL_DIRECT_S6_S3 0 void_int_S6_S3 0 255
 /begin AXIS_DESCR COM_AXIS st_ist_bz_has_stg void_int_S6_S3 9 0 8 DEPOSIT ABSOLUTE AXIS_PTS_REF KF_SCHALTART_ZUL_SVH_HAS_X /end AXIS_DESCR
 /begin AXIS_DESCR COM_AXIS st_ziel_bz_has_stg void_int_S6_S3 9 0 8 DEPOSIT ABSOLUTE AXIS_PTS_REF KF_SCHALTART_ZUL_SVH_HAS_Y /end AXIS_DESCR
/end CHARACTERISTIC
/begin AXIS_PTS KF_SCHALTART_ZUL_SVH_HAS_X "Festlegung der zulässigen Schaltart der Schaltverhinderung der HAS in Abhängigkeit des aktiven Ablaufs (255 = alle Schaltarten zulässig, 0 = keine Schaltart zulässig) - Bit-Codierung -> siehe Handbuch bzw. Kommentar zu status_schaltart_zul_svh_has  " 0x1D766B st_ist_bz_has_stg UBYTE_X_INCR_DIRECT_S6_S3 0 void_int_S6_S3 9 0 8 DEPOSIT ABSOLUTE /end AXIS_PTS
/begin AXIS_PTS KF_SCHALTART_ZUL_SVH_HAS_Y "Festlegung der zulässigen Schaltart der Schaltverhinderung der HAS in Abhängigkeit des aktiven Ablaufs (255 = alle Schaltarten zulässig, 0 = keine Schaltart zulässig) - Bit-Codierung -> siehe Handbuch bzw. Kommentar zu status_schaltart_zul_svh_has  " 0x1D7674 st_ziel_bz_has_stg UBYTE_X_INCR_DIRECT_S6_S3 0 void_int_S6_S3 9 0 8 DEPOSIT ABSOLUTE /end AXIS_PTS
/begin AXIS_PTS KL_ABLVARMPS_HAS_X "" 0x197898 z_ablaufvariante_has_stg UBYTE_X_INCR_DIRECT_S6_S3 0 void_int_S6_S3 8 0 255 DEPOSIT ABSOLUTE /end AXIS_PTS
/begin CHARACTERISTIC KL_ABLVARMPS_HAS_Y "erlaubte Ablaufvarianten zur Modifikation des Pum-pendruckstatus bei Erststarts (14-5) " CURVE 0x1978A0 UBYTE_COL_DIRECT_S6_S3 0 void_int_S6_S3 0 255
 /begin AXIS_DESCR COM_AXIS z_ablaufvariante_has_stg void_int_S6_S3 8 0 255 DEPOSIT ABSOLUTE AXIS_PTS_REF KL_ABLVARMPS_HAS_X /end AXIS_DESCR
/end CHARACTERISTIC
/begin AXIS_PTS KL_MPTNT_SBE_X "Filterkonstante für die Turbinendrehzahl abhängig von Fahrsollmoment" 0x197730 m_wunsch_fpw_in FLOAT32_IEEE_X_INCR_DIRECT_S6_S3 0 trq_fl_a_S6_S3 8 -3.40282e+038 3.40282e+038 DEPOSIT ABSOLUTE /end AXIS_PTS
/begin CHARACTERISTIC KL_MPTNT_SBE_Y "Filterkonstante für die Turbinendrehzahl abhängig von Fahrsollmoment" CURVE 0x197750 FLOAT32_IEEE_COL_DIRECT_S6_S3 0 n_fl_S6_S3 -3.40282e+038 3.40282e+038
 /begin AXIS_DESCR COM_AXIS m_wunsch_fpw_in trq_fl_a_S6_S3 8 -3.40282e+038 3.40282e+038 DEPOSIT ABSOLUTE AXIS_PTS_REF KL_MPTNT_SBE_X /end AXIS_DESCR
/end CHARACTERISTIC
/begin AXIS_PTS KL_MSMOT_KPS_HAS_X "Momentschwelle, Tab = f(istgang_egs_in) zur Best. z_k0schlupf_mmotiae_kps" 0x1D8112 istgang_egs_in SBYTE_X_INCR_DIRECT_S6_S3 0 void_int_S6_S3 10 -1 8 DEPOSIT ABSOLUTE /end AXIS_PTS
/begin CHARACTERISTIC KL_MSMOT_KPS_HAS_Y "Momentschwelle, Tab = f(istgang_egs_in) zur Best. z_k0schlupf_mmotiae_kps" CURVE 0x197FB0 FLOAT32_IEEE_COL_DIRECT_S6_S3 0 trq_fl_a_S6_S3 -50 1000
 /begin AXIS_DESCR COM_AXIS istgang_egs_in void_int_S6_S3 10 -1 8 DEPOSIT ABSOLUTE AXIS_PTS_REF KL_MSMOT_KPS_HAS_X /end AXIS_DESCR
/end CHARACTERISTIC
/begin AXIS_PTS KL_NSEMAUS_MPS_HAS_X "EM-Istdrehzahlschwelle, oberhalb welcher die Modifikation des Pumpendruckstatus aktiv werden kann" 0x1977D8 c_getriebe_egs_in FLOAT32_IEEE_X_INCR_DIRECT_S6_S3 0 c_int_S6_S3 8 -3.40282e+038 3.40282e+038 DEPOSIT ABSOLUTE /end AXIS_PTS
/begin CHARACTERISTIC KL_NSEMAUS_MPS_HAS_Y "Ausschaltschwelle, unterhalb welcher EM-Istdrehzahl die Modifikation des Pumpendruckstatus deaktiviert werden muss" CURVE 0x1977F8 FLOAT32_IEEE_COL_DIRECT_S6_S3 0 n_fl_S6_S3 -3.40282e+038 3.40282e+038
 /begin AXIS_DESCR COM_AXIS c_getriebe_egs_in c_int_S6_S3 8 -3.40282e+038 3.40282e+038 DEPOSIT ABSOLUTE AXIS_PTS_REF KL_NSEMAUS_MPS_HAS_X /end AXIS_DESCR
/end CHARACTERISTIC
/begin AXIS_PTS KL_NSEMEIN_MPS_HAS_X "EM-Istdrehzahlschwelle, oberhalb welcher die Modifikation des Pumpendruckstatus aktiv werden kann" 0x197818 c_getriebe_egs_in FLOAT32_IEEE_X_INCR_DIRECT_S6_S3 0 c_int_S6_S3 8 -3.40282e+038 3.40282e+038 DEPOSIT ABSOLUTE /end AXIS_PTS
/begin CHARACTERISTIC KL_NSEMEIN_MPS_HAS_Y "Einschaltschwelle, ab welcher EM-Istdrehzahl die Modifikation des Pumpendruckstatus aktiviert werden kann" CURVE 0x197838 FLOAT32_IEEE_COL_DIRECT_S6_S3 0 n_fl_S6_S3 -3.40282e+038 3.40282e+038
 /begin AXIS_DESCR COM_AXIS c_getriebe_egs_in c_int_S6_S3 8 -3.40282e+038 3.40282e+038 DEPOSIT ABSOLUTE AXIS_PTS_REF KL_NSEMEIN_MPS_HAS_X /end AXIS_DESCR
/end CHARACTERISTIC
/begin CHARACTERISTIC K_VF_HAS "Faktor zur Berechnung der Fahrzeuggeschwindigkeit aus der Getriebeabtriebsdrehzahl in der Hybridablaufsteuerung ( 3,6 * Pi * r_dyn / (30 * i_achse) ) " VALUE 0x197600 FLOAT32_IEEE_COL_DIRECT_S6_S3 0 void_fl_S6_S3 0 0.5 /end CHARACTERISTIC
/begin CHARACTERISTIC MG_10SOLLK0_ANS "Gradient für m_soll_k0_has im Zustand SLST_Abbruch" VALUE 0x1D1990 FLOAT32_IEEE_COL_DIRECT_S6_S3 0 trqg_fl_c_S6_S3 0 10000 /end CHARACTERISTIC
/begin CHARACTERISTIC MG_5MOMAXIAE_ANS "Gradient für maximales IAE Offsetmoment" VALUE 0x1D19B8 FLOAT32_IEEE_COL_DIRECT_S6_S3 0 trqg_fl_c_S6_S3 -3.40282e+038 3.40282e+038 /end CHARACTERISTIC
/begin CHARACTERISTIC MG_K0MBERZUSNEG_HAS "Negativer Grenzgradient des K0-Moments der HAS zur Motormomentbegrenzung in der SAB beim Zustart" VALUE 0x1979C8 FLOAT32_IEEE_COL_DIRECT_S6_S3 0 trqg_fl_c_S6_S3 -50000 0 /end CHARACTERISTIC
/begin CHARACTERISTIC MG_K0MBERZUSPOS_HAS "Positiver Grenzgradient des K0-Moments der HAS zur Motormomentbegrenzung in der SAB beim Zustart" VALUE 0x1979CC FLOAT32_IEEE_COL_DIRECT_S6_S3 0 trqg_fl_c_S6_S3 0 50000 /end CHARACTERISTIC
/begin CHARACTERISTIC MG_K0MODMAXMAX_SYN_ANK "Maximaler Gradienten des Maximalwerts des modifizierten K0-Moments der HAS im Zustand K0-Synchronisieren beim Ankoppeln" VALUE 0x1D0EDC FLOAT32_IEEE_COL_DIRECT_S6_S3 0 trqg_fl_c_S6_S3 0 50000 /end CHARACTERISTIC
/begin CHARACTERISTIC MG_SOLLK0MIN_SYN_ANK "Minimaler Gradient des K0-Sollmoments im Zustand K0 Synchronisieren beim Ankoppeln" VALUE 0x1D0EEC FLOAT32_IEEE_COL_DIRECT_S6_S3 0 trqg_fl_c_S6_S3 -10000 0 /end CHARACTERISTIC
/begin CHARACTERISTIC MG_SOLLK0MIN_SYN_ZUS "Minimaler Gradient des K0-Sollmoments im Zustand K0 Synchronisieren beim Zustart" VALUE 0x1D5DC8 FLOAT32_IEEE_COL_DIRECT_S6_S3 0 trqg_fl_c_S6_S3 -10000 0 /end CHARACTERISTIC
/begin CHARACTERISTIC MG_SOLLK0NEG_ABF_ZUS "Negativer Gradient des K0 Sollmoments zum Abfangen des VM bei einem Abbruch VM Abstellen im Zustand VM Abfangen beim Zustart" VALUE 0x1D5DD4 FLOAT32_IEEE_COL_DIRECT_S6_S3 0 trqg_fl_c_S6_S3 -10000 0 /end CHARACTERISTIC
/begin CHARACTERISTIC MG_SOLLK0NEG_GAB_ABST "Gradient zum Abbau des K0 Sollmoments im Zustand 'VM geführt Abstellen' beim VM Abstellen" VALUE 0x1D0D3C FLOAT32_IEEE_COL_DIRECT_S6_S3 0 trqg_fl_c_S6_S3 -10000 0 /end CHARACTERISTIC
/begin CHARACTERISTIC MG_SOLLK0POS_ABF_ZUS "Positiver Gradient des K0 Sollmoments zum Abfangen des VM bei einem Abbruch VM Abstellen im Zustand VM Abfangen beim Zustart" VALUE 0x1D5DF0 FLOAT32_IEEE_COL_DIRECT_S6_S3 0 trqg_fl_c_S6_S3 0 10000 /end CHARACTERISTIC
/begin CHARACTERISTIC MG_SOLLK0POS_GAB_ABST "Gradient zum Anheben des K0 Sollmo-ments im Zustand 'VM geführt Abstellen' beim VM Abstellen" VALUE 0x1D0D40 FLOAT32_IEEE_COL_DIRECT_S6_S3 0 trqg_fl_c_S6_S3 0 10000 /end CHARACTERISTIC
/begin CHARACTERISTIC MG_SOLLK0UVSNEG_ZST_ZUS "Negativer Gradient des K0 Sollmoments bei Anforderung einer K0-Unterstützung des VM Startsystems durch die HAS Zustandssteuerung (OML) im Zustand Zustarten beim VM Zustart" VALUE 0x1D5E00 FLOAT32_IEEE_COL_DIRECT_S6_S3 0 trqg_fl_c_S6_S3 -10000 0 /end CHARACTERISTIC
/begin CHARACTERISTIC MG_SOLLK0UVSPOS_ZST_ZUS "Positiver Gradient des K0 Sollmoments bei Anforderung einer K0-Unterstützung des VM Startsystems durch die HAS Zustandssteuerung (OML) im Zustand Zustarten beim VM Zustart" VALUE 0x1D5E04 FLOAT32_IEEE_COL_DIRECT_S6_S3 0 trqg_fl_c_S6_S3 0 10000 /end CHARACTERISTIC
/begin CHARACTERISTIC MG_SOLLK0_ABB_ANK "Gradienten für das K0-Sollmoments der HAS im Zustand 'Abbruch Ankoppeln' beim Ankoppeln" VALUE 0x1D0EF0 FLOAT32_IEEE_COL_DIRECT_S6_S3 0 trqg_fl_c_S6_S3 0 50000 /end CHARACTERISTIC
/begin CHARACTERISTIC MG_SOLLK0_ABB_NOS "Gradienten für das K0-Sollmoments der HAS im Zustand Abbruch Nostart beim Notstart" VALUE 0x1D18FC FLOAT32_IEEE_COL_DIRECT_S6_S3 0 trqg_fl_c_S6_S3 0 50000 /end CHARACTERISTIC
/begin CHARACTERISTIC MG_SOLLK0_ABB_ZUS "Gradienten für das K0-Sollmoments der HAS im Zustand Abbruch Zustart beim Zustart" VALUE 0x1D5E08 FLOAT32_IEEE_COL_DIRECT_S6_S3 0 trqg_fl_c_S6_S3 0 50000 /end CHARACTERISTIC
/begin CHARACTERISTIC MO_MOT_KPS_HAS "Momentoffset zur Realisierung einer Hystereseschwelle für z_k0schlupfbed_mmotiae" VALUE 0x1979D0 FLOAT32_IEEE_COL_DIRECT_S6_S3 0 trq_fl_a_S6_S3 0 100 /end CHARACTERISTIC
/begin CHARACTERISTIC MPT_MWUNSCHFPWHST "Filterkoeffizient Fahrerwunschmoment" VALUE 0x197604 FLOAT32_IEEE_COL_DIRECT_S6_S3 0 trq_fl_a_S6_S3 -3.40282e+038 3.40282e+038 /end CHARACTERISTIC
/begin CHARACTERISTIC MS_WUNSCHK0SBEDNGEM1_KPS_HAS "Schwellwert des Fahrerwunschmoment aus Fahrpedalinterpretation zur Rücknahme der EM Drehzahlgradientenbedingung der Priorisierung der K0-Ansteuerung der HAS" VALUE 0x1979E4 FLOAT32_IEEE_COL_DIRECT_S6_S3 0 trq_fl_a_S6_S3 -1000 1000 /end CHARACTERISTIC
/begin CHARACTERISTIC MS_WUNSCHK0SBEDNGEM2_KPS_HAS "Schwellwert des Fahrerwunschmoment aus Fahrpedalinterpretation zum Setzen der EM Drehzahlgradientenbedingung der Priorisierung der K0-Ansteuerung der HAS" VALUE 0x1979E8 FLOAT32_IEEE_COL_DIRECT_S6_S3 0 trq_fl_a_S6_S3 -1000 1000 /end CHARACTERISTIC
/begin CHARACTERISTIC NDS_SYNCHRON_HAS "Differenzdrehzahlschwelle zur Plausibilisierung der Erkennung ob synchron erreicht ist" VALUE 0x197608 FLOAT32_IEEE_COL_DIRECT_S6_S3 0 n_fl_S6_S3 0 10000 /end CHARACTERISTIC
/begin CHARACTERISTIC NG_1SOLLEM_DRS "Maximaler Gradient Solldrehzahl EM" VALUE 0x1D18BC FLOAT32_IEEE_COL_DIRECT_S6_S3 0 ng_fl_S6_S3 -3.40282e+038 3.40282e+038 /end CHARACTERISTIC
/begin CHARACTERISTIC NG_EMMODRSMIN_SYN_ANK "Minimaler Gradient der modifizierten EM-Drehzahl als Basisdrehzahl zur Bestimmung der VM Solldrehzahl bei RS beim K0 Synchronisieren beim Ankoppeln" VALUE 0x1D0F48 FLOAT32_IEEE_COL_DIRECT_S6_S3 0 ng_fl_S6_S3 -50000 0 /end CHARACTERISTIC
/begin CHARACTERISTIC NG_EMMODRSMIN_SYN_ZUS "Minimaler Gradient der modifizierten EM-Drehzahl als Basisdrehzahl zur Bestimmung der VM Solldrehzahl bei RS beim K0 Synchronisieren beim Zustart" VALUE 0x1D5E90 FLOAT32_IEEE_COL_DIRECT_S6_S3 0 ng_fl_S6_S3 -50000 0 /end CHARACTERISTIC
/begin CHARACTERISTIC NG_SOLLVMMAXVE_ANS "Drehzahlgradient für no_sollvmve_ans" VALUE 0x1D1A40 FLOAT32_IEEE_COL_DIRECT_S6_S3 0 ng_fl_S6_S3 -10000 10000 /end CHARACTERISTIC
/begin CHARACTERISTIC NOS_EMK0SBEDNGEM1_KPS_HAS "Drehzahloffset zur VM-Leerlauf-Solldrehzahl als EM-Drehzahlschwelle zur Rücknahme der EM Drehzahlgradientenbedingung der Priorisierung der K0-Ansteuerung der HAS" VALUE 0x197A08 FLOAT32_IEEE_COL_DIRECT_S6_S3 0 n_fl_S6_S3 0 10000 /end CHARACTERISTIC
/begin CHARACTERISTIC NOS_EMK0SBEDNGEM2_KPS_HAS "Drehzahloffset zur VM-Leerlauf-Solldrehzahl als EM-Drehzahlschwelle zum Setzen der EM Drehzahlgradientenbedingung der Priorisierung der K0-Ansteuerung der HAS" VALUE 0x197A0C FLOAT32_IEEE_COL_DIRECT_S6_S3 0 n_fl_S6_S3 0 10000 /end CHARACTERISTIC
/begin CHARACTERISTIC NS_NT_SBE "Drehzahlschwelle definiert ein Bereich für die Umschaltung zwischen n_t_egs_in und n_ab_egs*I_istgang_egs wenn status_kraftfluss_egs_roh_in /= 2 oder 4 ist." VALUE 0x19762C FLOAT32_IEEE_COL_DIRECT_S6_S3 0 n_fl_S6_S3 -3.40282e+038 3.40282e+038 /end CHARACTERISTIC
/begin MEASUREMENT SFHC25_xp_ "" FLOAT32_IEEE VOID_SCALING_f_S6_S3 1 100 -3.40282e+038 3.40282e+038 ECU_ADDRESS 0xFFF963FC /end MEASUREMENT
/begin MEASUREMENT SFHC26_xp_ "" FLOAT32_IEEE VOID_SCALING_f_S6_S3 1 100 -3.40282e+038 3.40282e+038 ECU_ADDRESS 0xFFF96404 /end MEASUREMENT
/begin MEASUREMENT SFHC27_xp_ "" FLOAT32_IEEE VOID_SCALING_f_S6_S3 1 100 -3.40282e+038 3.40282e+038 ECU_ADDRESS 0xFFF9640C /end MEASUREMENT
/begin MEASUREMENT SFHC47_x_ "" FLOAT32_IEEE VOID_SCALING_f_S6_S3 1 100 -3.40282e+038 3.40282e+038 ECU_ADDRESS 0xFFF96428 /end MEASUREMENT
/begin MEASUREMENT SFHC59_xp_ "" FLOAT32_IEEE VOID_SCALING_f_S6_S3 1 100 -3.40282e+038 3.40282e+038 ECU_ADDRESS 0xFFF96438 /end MEASUREMENT
/begin MEASUREMENT SFHC60_xp_ "" FLOAT32_IEEE VOID_SCALING_f_S6_S3 1 100 -3.40282e+038 3.40282e+038 ECU_ADDRESS 0xFFF96440 /end MEASUREMENT
/begin MEASUREMENT SFHC61_x_ "" FLOAT32_IEEE VOID_SCALING_f_S6_S3 1 100 -3.40282e+038 3.40282e+038 ECU_ADDRESS 0xFFF96448 /end MEASUREMENT
/begin MEASUREMENT SFOp_ABST108_Unit_Delay "" FLOAT32_IEEE VOID_SCALING_f_S6_S3 1 100 -3.40282e+038 3.40282e+038 ECU_ADDRESS 0xFFF96644 /end MEASUREMENT
/begin MEASUREMENT SFOp_ABST108_out_ "" FLOAT32_IEEE VOID_SCALING_f_S6_S3 1 100 -3.40282e+038 3.40282e+038 ECU_ADDRESS 0xFFF96648 /end MEASUREMENT
/begin MEASUREMENT SFOp_ABST94_Unit_Delay2 "" FLOAT32_IEEE VOID_SCALING_f_S6_S3 1 100 -3.40282e+038 3.40282e+038 ECU_ADDRESS 0xFFF96674 /end MEASUREMENT
/begin MEASUREMENT SFOp_ABST94_x_ "" FLOAT32_IEEE VOID_SCALING_f_S6_S3 1 100 -3.40282e+038 3.40282e+038 ECU_ADDRESS 0xFFF96678 /end MEASUREMENT
/begin MEASUREMENT SFOp_ABST95_Unit_Delay "" FLOAT32_IEEE VOID_SCALING_f_S6_S3 1 100 -3.40282e+038 3.40282e+038 ECU_ADDRESS 0xFFF9667C /end MEASUREMENT
/begin MEASUREMENT SFOp_ABST95_isActive_ "" UBYTE VOID_SCALING_S6_S3 1 100 0 1 ECU_ADDRESS 0xFFF8632C /end MEASUREMENT
/begin MEASUREMENT SFOp_ABST95_t_left_ "" FLOAT32_IEEE VOID_SCALING_f_S6_S3 1 100 -3.40282e+038 3.40282e+038 ECU_ADDRESS 0xFFF854D4 /end MEASUREMENT
/begin MEASUREMENT SFOp_ABST96_Unit_Delay "" FLOAT32_IEEE VOID_SCALING_f_S6_S3 1 100 -3.40282e+038 3.40282e+038 ECU_ADDRESS 0xFFF96680 /end MEASUREMENT
/begin MEASUREMENT SFOp_ABST96_isActive_ "" UBYTE VOID_SCALING_S6_S3 1 100 0 1 ECU_ADDRESS 0xFFF96DA4 /end MEASUREMENT
/begin MEASUREMENT SFOp_ABST96_t_left_ "" FLOAT32_IEEE VOID_SCALING_f_S6_S3 1 100 -3.40282e+038 3.40282e+038 ECU_ADDRESS 0xFFF96684 /end MEASUREMENT
/begin MEASUREMENT SFOp_ANK102_Unit_Delay "" FLOAT32_IEEE VOID_SCALING_f_S6_S3 1 100 -3.40282e+038 3.40282e+038 ECU_ADDRESS 0xFFF966D4 /end MEASUREMENT
/begin MEASUREMENT SFOp_ANK102_isActive_ "" UBYTE VOID_SCALING_S6_S3 1 100 0 1 ECU_ADDRESS 0xFFF863A0 /end MEASUREMENT
/begin MEASUREMENT SFOp_ANK102_t_left_ "" FLOAT32_IEEE VOID_SCALING_f_S6_S3 1 100 -3.40282e+038 3.40282e+038 ECU_ADDRESS 0xFFF85634 /end MEASUREMENT
/begin MEASUREMENT SFOp_ANK104_Unit_Delay "" FLOAT32_IEEE VOID_SCALING_f_S6_S3 1 100 -3.40282e+038 3.40282e+038 ECU_ADDRESS 0xFFF966D8 /end MEASUREMENT
/begin MEASUREMENT SFOp_ANK104_out_ "" FLOAT32_IEEE VOID_SCALING_f_S6_S3 1 100 -3.40282e+038 3.40282e+038 ECU_ADDRESS 0xFFF966DC /end MEASUREMENT
/begin MEASUREMENT SFOp_ANK105_Unit_Delay "" FLOAT32_IEEE VOID_SCALING_f_S6_S3 1 100 -3.40282e+038 3.40282e+038 ECU_ADDRESS 0xFFF966E0 /end MEASUREMENT
/begin MEASUREMENT SFOp_ANK105_out_ "" FLOAT32_IEEE VOID_SCALING_f_S6_S3 1 100 -3.40282e+038 3.40282e+038 ECU_ADDRESS 0xFFF966E4 /end MEASUREMENT
/begin MEASUREMENT SFOp_ANK106_Unit_Delay "" FLOAT32_IEEE VOID_SCALING_f_S6_S3 1 100 -3.40282e+038 3.40282e+038 ECU_ADDRESS 0xFFF966E8 /end MEASUREMENT
/begin MEASUREMENT SFOp_ANK106_isActive_ "" UBYTE VOID_SCALING_S6_S3 1 100 0 1 ECU_ADDRESS 0xFFF863A1 /end MEASUREMENT
/begin MEASUREMENT SFOp_ANK106_t_left_ "" FLOAT32_IEEE VOID_SCALING_f_S6_S3 1 100 -3.40282e+038 3.40282e+038 ECU_ADDRESS 0xFFF85638 /end MEASUREMENT
/begin MEASUREMENT SFOp_ANK116_Unit_Delay "" FLOAT32_IEEE VOID_SCALING_f_S6_S3 1 100 -3.40282e+038 3.40282e+038 ECU_ADDRESS 0xFFF966EC /end MEASUREMENT
/begin MEASUREMENT SFOp_ANK116_isActive_ "" UBYTE VOID_SCALING_S6_S3 1 100 0 1 ECU_ADDRESS 0xFFF863A2 /end MEASUREMENT
/begin MEASUREMENT SFOp_ANK116_t_left_ "" FLOAT32_IEEE VOID_SCALING_f_S6_S3 1 100 -3.40282e+038 3.40282e+038 ECU_ADDRESS 0xFFF8563C /end MEASUREMENT
/begin MEASUREMENT SFOp_ANK132_Unit_Delay "" FLOAT32_IEEE VOID_SCALING_f_S6_S3 1 100 -3.40282e+038 3.40282e+038 ECU_ADDRESS 0xFFF966F0 /end MEASUREMENT
/begin MEASUREMENT SFOp_ANK132_isActive_ "" UBYTE VOID_SCALING_S6_S3 1 100 0 1 ECU_ADDRESS 0xFFF863A3 /end MEASUREMENT
/begin MEASUREMENT SFOp_ANK132_t_left_ "" FLOAT32_IEEE VOID_SCALING_f_S6_S3 1 100 -3.40282e+038 3.40282e+038 ECU_ADDRESS 0xFFF85640 /end MEASUREMENT
/begin MEASUREMENT SFOp_ANK137_Unit_Delay "" FLOAT32_IEEE VOID_SCALING_f_S6_S3 1 100 -3.40282e+038 3.40282e+038 ECU_ADDRESS 0xFFF966F4 /end MEASUREMENT
/begin MEASUREMENT SFOp_ANK137_isActive_ "" UBYTE VOID_SCALING_S6_S3 1 100 0 1 ECU_ADDRESS 0xFFF863A4 /end MEASUREMENT
/begin MEASUREMENT SFOp_ANK137_t_left_ "" FLOAT32_IEEE VOID_SCALING_f_S6_S3 1 100 -3.40282e+038 3.40282e+038 ECU_ADDRESS 0xFFF85644 /end MEASUREMENT
/begin MEASUREMENT SFOp_ANK143_Unit_Delay "" FLOAT32_IEEE VOID_SCALING_f_S6_S3 1 100 -3.40282e+038 3.40282e+038 ECU_ADDRESS 0xFFF966F8 /end MEASUREMENT
/begin MEASUREMENT SFOp_ANK143_isActive_ "" UBYTE VOID_SCALING_S6_S3 1 100 0 1 ECU_ADDRESS 0xFFF863A5 /end MEASUREMENT
/begin MEASUREMENT SFOp_ANK143_t_left_ "" FLOAT32_IEEE VOID_SCALING_f_S6_S3 1 100 -3.40282e+038 3.40282e+038 ECU_ADDRESS 0xFFF85648 /end MEASUREMENT
/begin MEASUREMENT SFOp_ANK149_Unit_Delay2 "" FLOAT32_IEEE VOID_SCALING_f_S6_S3 1 100 -3.40282e+038 3.40282e+038 ECU_ADDRESS 0xFFF966FC /end MEASUREMENT
/begin MEASUREMENT SFOp_ANK149_x_ "" FLOAT32_IEEE VOID_SCALING_f_S6_S3 1 100 -3.40282e+038 3.40282e+038 ECU_ADDRESS 0xFFF96700 /end MEASUREMENT
/begin MEASUREMENT SFOp_ANK153_Unit_Delay "" FLOAT32_IEEE VOID_SCALING_f_S6_S3 1 100 -3.40282e+038 3.40282e+038 ECU_ADDRESS 0xFFF96704 /end MEASUREMENT
/begin MEASUREMENT SFOp_ANK153_isActive_ "" UBYTE VOID_SCALING_S6_S3 1 100 0 1 ECU_ADDRESS 0xFFF863A6 /end MEASUREMENT
/begin MEASUREMENT SFOp_ANK153_t_left_ "" FLOAT32_IEEE VOID_SCALING_f_S6_S3 1 100 -3.40282e+038 3.40282e+038 ECU_ADDRESS 0xFFF8564C /end MEASUREMENT
/begin MEASUREMENT SFOp_ANK159_Unit_Delay "" FLOAT32_IEEE VOID_SCALING_f_S6_S3 1 100 -3.40282e+038 3.40282e+038 ECU_ADDRESS 0xFFF96708 /end MEASUREMENT
/begin MEASUREMENT SFOp_ANK159_out_ "" FLOAT32_IEEE VOID_SCALING_f_S6_S3 1 100 -3.40282e+038 3.40282e+038 ECU_ADDRESS 0xFFF9670C /end MEASUREMENT
/begin MEASUREMENT SFOp_ANK164_Unit_Delay "" FLOAT32_IEEE VOID_SCALING_f_S6_S3 1 100 -3.40282e+038 3.40282e+038 ECU_ADDRESS 0xFFF96710 /end MEASUREMENT
/begin MEASUREMENT SFOp_ANK164_out_ "" FLOAT32_IEEE VOID_SCALING_f_S6_S3 1 100 -3.40282e+038 3.40282e+038 ECU_ADDRESS 0xFFF96714 /end MEASUREMENT
/begin MEASUREMENT SFOp_ANK165_Unit_Delay "" FLOAT32_IEEE VOID_SCALING_f_S6_S3 1 100 -3.40282e+038 3.40282e+038 ECU_ADDRESS 0xFFF96718 /end MEASUREMENT
/begin MEASUREMENT SFOp_ANK165_out_ "" FLOAT32_IEEE VOID_SCALING_f_S6_S3 1 100 -3.40282e+038 3.40282e+038 ECU_ADDRESS 0xFFF9671C /end MEASUREMENT
/begin MEASUREMENT SFOp_ANK172_Unit_Delay "" FLOAT32_IEEE VOID_SCALING_f_S6_S3 1 100 -3.40282e+038 3.40282e+038 ECU_ADDRESS 0xFFF96720 /end MEASUREMENT
/begin MEASUREMENT SFOp_ANK172_isActive_ "" UBYTE VOID_SCALING_S6_S3 1 100 0 1 ECU_ADDRESS 0xFFF863A7 /end MEASUREMENT
/begin MEASUREMENT SFOp_ANK172_t_left_ "" FLOAT32_IEEE VOID_SCALING_f_S6_S3 1 100 -3.40282e+038 3.40282e+038 ECU_ADDRESS 0xFFF85650 /end MEASUREMENT
/begin MEASUREMENT SFOp_ANK173_KL__CERKUMS_SYN_ANK "" FLOAT32_IEEE VOID_SCALING_f_S6_S3 1 100 -3.40282e+038 3.40282e+038 ECU_ADDRESS 0xFFF966C0 /end MEASUREMENT
/begin MEASUREMENT SFOp_ANK176_Unit_Delay "" FLOAT32_IEEE VOID_SCALING_f_S6_S3 1 100 -3.40282e+038 3.40282e+038 ECU_ADDRESS 0xFFF96724 /end MEASUREMENT
/begin MEASUREMENT SFOp_ANK176_isActive_ "" UBYTE VOID_SCALING_S6_S3 1 100 0 1 ECU_ADDRESS 0xFFF863A8 /end MEASUREMENT
/begin MEASUREMENT SFOp_ANK176_t_left_ "" FLOAT32_IEEE VOID_SCALING_f_S6_S3 1 100 -3.40282e+038 3.40282e+038 ECU_ADDRESS 0xFFF85654 /end MEASUREMENT
/begin MEASUREMENT SFOp_ANK187_Unit_Delay2 "" FLOAT32_IEEE VOID_SCALING_f_S6_S3 1 100 -3.40282e+038 3.40282e+038 ECU_ADDRESS 0xFFF96728 /end MEASUREMENT
/begin MEASUREMENT SFOp_ANK187_x_ "" FLOAT32_IEEE VOID_SCALING_f_S6_S3 1 100 -3.40282e+038 3.40282e+038 ECU_ADDRESS 0xFFF9672C /end MEASUREMENT
/begin MEASUREMENT SFOp_ANK197_Unit_Delay "" FLOAT32_IEEE VOID_SCALING_f_S6_S3 1 100 -3.40282e+038 3.40282e+038 ECU_ADDRESS 0xFFF96730 /end MEASUREMENT
/begin MEASUREMENT SFOp_ANK197_isActive_ "" UBYTE VOID_SCALING_S6_S3 1 100 0 1 ECU_ADDRESS 0xFFF863A9 /end MEASUREMENT
/begin MEASUREMENT SFOp_ANK197_t_left_ "" FLOAT32_IEEE VOID_SCALING_f_S6_S3 1 100 -3.40282e+038 3.40282e+038 ECU_ADDRESS 0xFFF85658 /end MEASUREMENT
/begin MEASUREMENT SFOp_ANK54_x_filter_ "" FLOAT32_IEEE VOID_SCALING_f_S6_S3 1 100 -3.40282e+038 3.40282e+038 ECU_ADDRESS 0xFFF96734 /end MEASUREMENT
/begin MEASUREMENT SFOp_ANK54_xp_ "" FLOAT32_IEEE VOID_SCALING_f_S6_S3 1 100 -3.40282e+038 3.40282e+038 ECU_ADDRESS 0xFFF96738 /end MEASUREMENT
/begin MEASUREMENT SFOp_ANK55_Unit_Delay2 "" FLOAT32_IEEE VOID_SCALING_f_S6_S3 1 100 -3.40282e+038 3.40282e+038 ECU_ADDRESS 0xFFF9673C /end MEASUREMENT
/begin MEASUREMENT SFOp_ANK89_Unit_Delay "" FLOAT32_IEEE VOID_SCALING_f_S6_S3 1 100 -3.40282e+038 3.40282e+038 ECU_ADDRESS 0xFFF96740 /end MEASUREMENT
/begin MEASUREMENT SFOp_ANK89_isActive_ "" UBYTE VOID_SCALING_S6_S3 1 100 0 1 ECU_ADDRESS 0xFFF863AA /end MEASUREMENT
/begin MEASUREMENT SFOp_ANK89_t_left_ "" FLOAT32_IEEE VOID_SCALING_f_S6_S3 1 100 -3.40282e+038 3.40282e+038 ECU_ADDRESS 0xFFF8565C /end MEASUREMENT
/begin MEASUREMENT SFOp_ANK90_Unit_Delay "" FLOAT32_IEEE VOID_SCALING_f_S6_S3 1 100 -3.40282e+038 3.40282e+038 ECU_ADDRESS 0xFFF96744 /end MEASUREMENT
/begin MEASUREMENT SFOp_ANK90_out_ "" FLOAT32_IEEE VOID_SCALING_f_S6_S3 1 100 -3.40282e+038 3.40282e+038 ECU_ADDRESS 0xFFF96748 /end MEASUREMENT
/begin MEASUREMENT SFOp_DRS62_Unit_Delay "" FLOAT32_IEEE VOID_SCALING_f_S6_S3 1 100 -3.40282e+038 3.40282e+038 ECU_ADDRESS 0xFFF967CC /end MEASUREMENT
/begin MEASUREMENT SFOp_DRS62_out_ "" FLOAT32_IEEE VOID_SCALING_f_S6_S3 1 100 -3.40282e+038 3.40282e+038 ECU_ADDRESS 0xFFF967D0 /end MEASUREMENT
/begin MEASUREMENT SFOp_DRS63_Unit_Delay "" FLOAT32_IEEE VOID_SCALING_f_S6_S3 1 100 -3.40282e+038 3.40282e+038 ECU_ADDRESS 0xFFF967D4 /end MEASUREMENT
/begin MEASUREMENT SFOp_DRS63_isActive_ "" UBYTE VOID_SCALING_S6_S3 1 100 0 1 ECU_ADDRESS 0xFFF96DA8 /end MEASUREMENT
/begin MEASUREMENT SFOp_DRS63_t_left_ "" FLOAT32_IEEE VOID_SCALING_f_S6_S3 1 100 -3.40282e+038 3.40282e+038 ECU_ADDRESS 0xFFF967D8 /end MEASUREMENT
/begin MEASUREMENT SFOp_DRS79_Unit_Delay2 "" FLOAT32_IEEE VOID_SCALING_f_S6_S3 1 100 -3.40282e+038 3.40282e+038 ECU_ADDRESS 0xFFF967DC /end MEASUREMENT
/begin MEASUREMENT SFOp_DRS79_x2_ "" FLOAT32_IEEE VOID_SCALING_f_S6_S3 1 100 -3.40282e+038 3.40282e+038 ECU_ADDRESS 0xFFF967E0 /end MEASUREMENT
/begin MEASUREMENT SFOp_DRS80_Unit_Delay "" FLOAT32_IEEE VOID_SCALING_f_S6_S3 1 100 -3.40282e+038 3.40282e+038 ECU_ADDRESS 0xFFF967E4 /end MEASUREMENT
/begin MEASUREMENT SFOp_DRS80_isActive_ "" UBYTE VOID_SCALING_S6_S3 1 100 0 1 ECU_ADDRESS 0xFFF96DA9 /end MEASUREMENT
/begin MEASUREMENT SFOp_DRS80_t_left_ "" FLOAT32_IEEE VOID_SCALING_f_S6_S3 1 100 -3.40282e+038 3.40282e+038 ECU_ADDRESS 0xFFF967E8 /end MEASUREMENT
/begin MEASUREMENT SFOp_NOS46_Unit_Delay "" FLOAT32_IEEE VOID_SCALING_f_S6_S3 1 100 -3.40282e+038 3.40282e+038 ECU_ADDRESS 0xFFF96804 /end MEASUREMENT
/begin MEASUREMENT SFOp_NOS46_isActive_ "" UBYTE VOID_SCALING_S6_S3 1 100 0 1 ECU_ADDRESS 0xFFF96DAD /end MEASUREMENT
/begin MEASUREMENT SFOp_NOS46_t_left_ "" FLOAT32_IEEE VOID_SCALING_f_S6_S3 1 100 -3.40282e+038 3.40282e+038 ECU_ADDRESS 0xFFF96808 /end MEASUREMENT
/begin MEASUREMENT SFOp_NOS61_Unit_Delay "" FLOAT32_IEEE VOID_SCALING_f_S6_S3 1 100 -3.40282e+038 3.40282e+038 ECU_ADDRESS 0xFFF9680C /end MEASUREMENT
/begin MEASUREMENT SFOp_NOS61_isActive_ "" UBYTE VOID_SCALING_S6_S3 1 100 0 1 ECU_ADDRESS 0xFFF86452 /end MEASUREMENT
/begin MEASUREMENT SFOp_NOS61_t_left_ "" FLOAT32_IEEE VOID_SCALING_f_S6_S3 1 100 -3.40282e+038 3.40282e+038 ECU_ADDRESS 0xFFF857C4 /end MEASUREMENT
/begin MEASUREMENT SFOp_NOS62_Unit_Delay "" FLOAT32_IEEE VOID_SCALING_f_S6_S3 1 100 -3.40282e+038 3.40282e+038 ECU_ADDRESS 0xFFF96810 /end MEASUREMENT
/begin MEASUREMENT SFOp_NOS62_out_ "" FLOAT32_IEEE VOID_SCALING_f_S6_S3 1 100 -3.40282e+038 3.40282e+038 ECU_ADDRESS 0xFFF96814 /end MEASUREMENT
/begin MEASUREMENT SFOp_NOS75_Unit_Delay "" FLOAT32_IEEE VOID_SCALING_f_S6_S3 1 100 -3.40282e+038 3.40282e+038 ECU_ADDRESS 0xFFF96818 /end MEASUREMENT
/begin MEASUREMENT SFOp_NOS75_isActive_ "" UBYTE VOID_SCALING_S6_S3 1 100 0 1 ECU_ADDRESS 0xFFF96DAE /end MEASUREMENT
/begin MEASUREMENT SFOp_NOS75_t_left_ "" FLOAT32_IEEE VOID_SCALING_f_S6_S3 1 100 -3.40282e+038 3.40282e+038 ECU_ADDRESS 0xFFF9681C /end MEASUREMENT
/begin MEASUREMENT SFOp_NOS77_Unit_Delay "" FLOAT32_IEEE VOID_SCALING_f_S6_S3 1 100 -3.40282e+038 3.40282e+038 ECU_ADDRESS 0xFFF96820 /end MEASUREMENT
/begin MEASUREMENT SFOp_NOS77_out_ "" FLOAT32_IEEE VOID_SCALING_f_S6_S3 1 100 -3.40282e+038 3.40282e+038 ECU_ADDRESS 0xFFF96824 /end MEASUREMENT
/begin MEASUREMENT SFOp_NOS78_Unit_Delay "" FLOAT32_IEEE VOID_SCALING_f_S6_S3 1 100 -3.40282e+038 3.40282e+038 ECU_ADDRESS 0xFFF96828 /end MEASUREMENT
/begin MEASUREMENT SFOp_NOS78_isActive_ "" UBYTE VOID_SCALING_S6_S3 1 100 0 1 ECU_ADDRESS 0xFFF86453 /end MEASUREMENT
/begin MEASUREMENT SFOp_NOS78_t_left_ "" FLOAT32_IEEE VOID_SCALING_f_S6_S3 1 100 -3.40282e+038 3.40282e+038 ECU_ADDRESS 0xFFF857C8 /end MEASUREMENT
/begin MEASUREMENT SFOp_NOS80_Unit_Delay "" FLOAT32_IEEE VOID_SCALING_f_S6_S3 1 100 -3.40282e+038 3.40282e+038 ECU_ADDRESS 0xFFF9682C /end MEASUREMENT
/begin MEASUREMENT SFOp_NOS80_isActive_ "" UBYTE VOID_SCALING_S6_S3 1 100 0 1 ECU_ADDRESS 0xFFF96DAF /end MEASUREMENT
/begin MEASUREMENT SFOp_NOS80_t_left_ "" FLOAT32_IEEE VOID_SCALING_f_S6_S3 1 100 -3.40282e+038 3.40282e+038 ECU_ADDRESS 0xFFF96830 /end MEASUREMENT
/begin MEASUREMENT SFOp_SLST102_Unit_Delay "" FLOAT32_IEEE VOID_SCALING_f_S6_S3 1 100 -3.40282e+038 3.40282e+038 ECU_ADDRESS 0xFFF9686C /end MEASUREMENT
/begin MEASUREMENT SFOp_SLST102_isActive_ "" UBYTE VOID_SCALING_S6_S3 1 100 0 1 ECU_ADDRESS 0xFFF86490 /end MEASUREMENT
/begin MEASUREMENT SFOp_SLST102_t_left_ "" FLOAT32_IEEE VOID_SCALING_f_S6_S3 1 100 -3.40282e+038 3.40282e+038 ECU_ADDRESS 0xFFF85810 /end MEASUREMENT
/begin MEASUREMENT SFOp_SLST111_Unit_Delay "" FLOAT32_IEEE VOID_SCALING_f_S6_S3 1 100 -3.40282e+038 3.40282e+038 ECU_ADDRESS 0xFFF96870 /end MEASUREMENT
/begin MEASUREMENT SFOp_SLST111_isActive_ "" UBYTE VOID_SCALING_S6_S3 1 100 0 1 ECU_ADDRESS 0xFFF86491 /end MEASUREMENT
/begin MEASUREMENT SFOp_SLST111_t_left_ "" FLOAT32_IEEE VOID_SCALING_f_S6_S3 1 100 -3.40282e+038 3.40282e+038 ECU_ADDRESS 0xFFF85814 /end MEASUREMENT
/begin MEASUREMENT SFOp_SLST112_Unit_Delay "" FLOAT32_IEEE VOID_SCALING_f_S6_S3 1 100 -3.40282e+038 3.40282e+038 ECU_ADDRESS 0xFFF96874 /end MEASUREMENT
/begin MEASUREMENT SFOp_SLST112_isActive_ "" UBYTE VOID_SCALING_S6_S3 1 100 0 1 ECU_ADDRESS 0xFFF86492 /end MEASUREMENT
/begin MEASUREMENT SFOp_SLST112_t_left_ "" FLOAT32_IEEE VOID_SCALING_f_S6_S3 1 100 -3.40282e+038 3.40282e+038 ECU_ADDRESS 0xFFF85818 /end MEASUREMENT
/begin MEASUREMENT SFOp_SLST143_Unit_Delay "" FLOAT32_IEEE VOID_SCALING_f_S6_S3 1 100 -3.40282e+038 3.40282e+038 ECU_ADDRESS 0xFFF96878 /end MEASUREMENT
/begin MEASUREMENT SFOp_SLST143_isActive_ "" UBYTE VOID_SCALING_S6_S3 1 100 0 1 ECU_ADDRESS 0xFFF86493 /end MEASUREMENT
/begin MEASUREMENT SFOp_SLST143_t_left_ "" FLOAT32_IEEE VOID_SCALING_f_S6_S3 1 100 -3.40282e+038 3.40282e+038 ECU_ADDRESS 0xFFF8581C /end MEASUREMENT
/begin MEASUREMENT SFOp_SLST146_x_filter_ "" FLOAT32_IEEE VOID_SCALING_f_S6_S3 1 100 -3.40282e+038 3.40282e+038 ECU_ADDRESS 0xFFF9687C /end MEASUREMENT
/begin MEASUREMENT SFOp_SLST146_xp_ "" FLOAT32_IEEE VOID_SCALING_f_S6_S3 1 100 -3.40282e+038 3.40282e+038 ECU_ADDRESS 0xFFF96880 /end MEASUREMENT
/begin MEASUREMENT SFOp_SLST147_Unit_Delay "" FLOAT32_IEEE VOID_SCALING_f_S6_S3 1 100 -3.40282e+038 3.40282e+038 ECU_ADDRESS 0xFFF96884 /end MEASUREMENT
/begin MEASUREMENT SFOp_SLST147_out_ "" FLOAT32_IEEE VOID_SCALING_f_S6_S3 1 100 -3.40282e+038 3.40282e+038 ECU_ADDRESS 0xFFF96888 /end MEASUREMENT
/begin MEASUREMENT SFOp_SLST149_Unit_Delay2 "" FLOAT32_IEEE VOID_SCALING_f_S6_S3 1 100 -3.40282e+038 3.40282e+038 ECU_ADDRESS 0xFFF9688C /end MEASUREMENT
/begin MEASUREMENT SFOp_SLST156_out_ "" FLOAT32_IEEE VOID_SCALING_f_S6_S3 1 100 -3.40282e+038 3.40282e+038 ECU_ADDRESS 0xFFF96890 /end MEASUREMENT
/begin MEASUREMENT SFOp_SLST158_Unit_Delay1 "" UBYTE void_int_S6_S3 1 100 0 255 ECU_ADDRESS 0xFFF96DB2 /end MEASUREMENT
/begin MEASUREMENT SFOp_SLST193_Unit_Delay "" FLOAT32_IEEE VOID_SCALING_f_S6_S3 1 100 -3.40282e+038 3.40282e+038 ECU_ADDRESS 0xFFF96894 /end MEASUREMENT
/begin MEASUREMENT SFOp_SLST193_out_ "" FLOAT32_IEEE VOID_SCALING_f_S6_S3 1 100 -3.40282e+038 3.40282e+038 ECU_ADDRESS 0xFFF96898 /end MEASUREMENT
/begin MEASUREMENT SFOp_SLST201_Unit_Delay "" FLOAT32_IEEE VOID_SCALING_f_S6_S3 1 100 -3.40282e+038 3.40282e+038 ECU_ADDRESS 0xFFF9689C /end MEASUREMENT
/begin MEASUREMENT SFOp_SLST201_out_ "" FLOAT32_IEEE VOID_SCALING_f_S6_S3 1 100 -3.40282e+038 3.40282e+038 ECU_ADDRESS 0xFFF968A0 /end MEASUREMENT
/begin MEASUREMENT SFOp_SLST206_Unit_Delay2 "" FLOAT32_IEEE VOID_SCALING_f_S6_S3 1 100 -3.40282e+038 3.40282e+038 ECU_ADDRESS 0xFFF968A4 /end MEASUREMENT
/begin MEASUREMENT SFOp_SLST206_x2_ "" FLOAT32_IEEE VOID_SCALING_f_S6_S3 1 100 -3.40282e+038 3.40282e+038 ECU_ADDRESS 0xFFF968A8 /end MEASUREMENT
/begin MEASUREMENT SFOp_SLST207_Unit_Delay2 "" FLOAT32_IEEE VOID_SCALING_f_S6_S3 1 100 -3.40282e+038 3.40282e+038 ECU_ADDRESS 0xFFF968AC /end MEASUREMENT
/begin MEASUREMENT SFOp_SLST207_x2_ "" FLOAT32_IEEE VOID_SCALING_f_S6_S3 1 100 -3.40282e+038 3.40282e+038 ECU_ADDRESS 0xFFF968B0 /end MEASUREMENT
/begin MEASUREMENT SFOp_SLST246_Unit_Delay "" FLOAT32_IEEE VOID_SCALING_f_S6_S3 1 100 -3.40282e+038 3.40282e+038 ECU_ADDRESS 0xFFF968B4 /end MEASUREMENT
/begin MEASUREMENT SFOp_SLST246_isActive_ "" UBYTE VOID_SCALING_S6_S3 1 100 0 1 ECU_ADDRESS 0xFFF96DB3 /end MEASUREMENT
/begin MEASUREMENT SFOp_SLST246_t_left_ "" FLOAT32_IEEE VOID_SCALING_f_S6_S3 1 100 -3.40282e+038 3.40282e+038 ECU_ADDRESS 0xFFF968B8 /end MEASUREMENT
/begin MEASUREMENT SFOp_SLST247_Unit_Delay "" FLOAT32_IEEE VOID_SCALING_f_S6_S3 1 100 -3.40282e+038 3.40282e+038 ECU_ADDRESS 0xFFF968BC /end MEASUREMENT
/begin MEASUREMENT SFOp_SLST247_isActive_ "" UBYTE VOID_SCALING_S6_S3 1 100 0 1 ECU_ADDRESS 0xFFF96DB4 /end MEASUREMENT
/begin MEASUREMENT SFOp_SLST247_t_left_ "" FLOAT32_IEEE VOID_SCALING_f_S6_S3 1 100 -3.40282e+038 3.40282e+038 ECU_ADDRESS 0xFFF968C0 /end MEASUREMENT
/begin MEASUREMENT SFOp_SLST252_Unit_Delay "" FLOAT32_IEEE VOID_SCALING_f_S6_S3 1 100 -3.40282e+038 3.40282e+038 ECU_ADDRESS 0xFFF968C4 /end MEASUREMENT
/begin MEASUREMENT SFOp_SLST252_out_ "" FLOAT32_IEEE VOID_SCALING_f_S6_S3 1 100 -3.40282e+038 3.40282e+038 ECU_ADDRESS 0xFFF968C8 /end MEASUREMENT
/begin MEASUREMENT SFOp_SLST260_Unit_Delay "" FLOAT32_IEEE VOID_SCALING_f_S6_S3 1 100 -3.40282e+038 3.40282e+038 ECU_ADDRESS 0xFFF968CC /end MEASUREMENT
/begin MEASUREMENT SFOp_SLST260_out_ "" FLOAT32_IEEE VOID_SCALING_f_S6_S3 1 100 -3.40282e+038 3.40282e+038 ECU_ADDRESS 0xFFF968D0 /end MEASUREMENT
/begin MEASUREMENT SFOp_SLST261_Unit_Delay "" FLOAT32_IEEE VOID_SCALING_f_S6_S3 1 100 -3.40282e+038 3.40282e+038 ECU_ADDRESS 0xFFF968D4 /end MEASUREMENT
/begin MEASUREMENT SFOp_SLST261_isActive_ "" UBYTE VOID_SCALING_S6_S3 1 100 0 1 ECU_ADDRESS 0xFFF96DB5 /end MEASUREMENT
/begin MEASUREMENT SFOp_SLST261_t_left_ "" FLOAT32_IEEE VOID_SCALING_f_S6_S3 1 100 -3.40282e+038 3.40282e+038 ECU_ADDRESS 0xFFF968D8 /end MEASUREMENT
/begin MEASUREMENT SFOp_SLST266_Unit_Delay "" FLOAT32_IEEE VOID_SCALING_f_S6_S3 1 100 -3.40282e+038 3.40282e+038 ECU_ADDRESS 0xFFF968DC /end MEASUREMENT
/begin MEASUREMENT SFOp_SLST266_isActive_ "" UBYTE VOID_SCALING_S6_S3 1 100 0 1 ECU_ADDRESS 0xFFF96DB6 /end MEASUREMENT
/begin MEASUREMENT SFOp_SLST266_t_left_ "" FLOAT32_IEEE VOID_SCALING_f_S6_S3 1 100 -3.40282e+038 3.40282e+038 ECU_ADDRESS 0xFFF968E0 /end MEASUREMENT
/begin MEASUREMENT SFOp_SLST276_Unit_Delay2 "" FLOAT32_IEEE VOID_SCALING_f_S6_S3 1 100 -3.40282e+038 3.40282e+038 ECU_ADDRESS 0xFFF968E4 /end MEASUREMENT
/begin MEASUREMENT SFOp_SLST276_x_filt_ "" FLOAT32_IEEE VOID_SCALING_f_S6_S3 1 100 -3.40282e+038 3.40282e+038 ECU_ADDRESS 0xFFF968E8 /end MEASUREMENT
/begin MEASUREMENT SFOp_SLST276_xg_filt_ "" FLOAT32_IEEE VOID_SCALING_f_S6_S3 1 100 -3.40282e+038 3.40282e+038 ECU_ADDRESS 0xFFF968EC /end MEASUREMENT
/begin MEASUREMENT SFOp_SLST295_Unit_Delay "" FLOAT32_IEEE VOID_SCALING_f_S6_S3 1 100 -3.40282e+038 3.40282e+038 ECU_ADDRESS 0xFFF968F0 /end MEASUREMENT
/begin MEASUREMENT SFOp_SLST295_out_ "" FLOAT32_IEEE VOID_SCALING_f_S6_S3 1 100 -3.40282e+038 3.40282e+038 ECU_ADDRESS 0xFFF968F4 /end MEASUREMENT
/begin MEASUREMENT SFOp_SLST296_Unit_Delay "" FLOAT32_IEEE VOID_SCALING_f_S6_S3 1 100 -3.40282e+038 3.40282e+038 ECU_ADDRESS 0xFFF968F8 /end MEASUREMENT
/begin MEASUREMENT SFOp_SLST296_isActive_ "" UBYTE VOID_SCALING_S6_S3 1 100 0 1 ECU_ADDRESS 0xFFF96DB7 /end MEASUREMENT
/begin MEASUREMENT SFOp_SLST296_t_left_ "" FLOAT32_IEEE VOID_SCALING_f_S6_S3 1 100 -3.40282e+038 3.40282e+038 ECU_ADDRESS 0xFFF968FC /end MEASUREMENT
/begin MEASUREMENT SFOp_SLST299_Unit_Delay "" FLOAT32_IEEE VOID_SCALING_f_S6_S3 1 100 -3.40282e+038 3.40282e+038 ECU_ADDRESS 0xFFF96900 /end MEASUREMENT
/begin MEASUREMENT SFOp_SLST299_out_ "" FLOAT32_IEEE VOID_SCALING_f_S6_S3 1 100 -3.40282e+038 3.40282e+038 ECU_ADDRESS 0xFFF96904 /end MEASUREMENT
/begin MEASUREMENT SFOp_SLST322_Unit_Delay "" FLOAT32_IEEE VOID_SCALING_f_S6_S3 1 100 -3.40282e+038 3.40282e+038 ECU_ADDRESS 0xFFF96908 /end MEASUREMENT
/begin MEASUREMENT SFOp_SLST322_isActive_ "" UBYTE VOID_SCALING_S6_S3 1 100 0 1 ECU_ADDRESS 0xFFF96DB8 /end MEASUREMENT
/begin MEASUREMENT SFOp_SLST322_t_left_ "" FLOAT32_IEEE VOID_SCALING_f_S6_S3 1 100 -3.40282e+038 3.40282e+038 ECU_ADDRESS 0xFFF9690C /end MEASUREMENT
/begin MEASUREMENT SFOp_SLST327_Unit_Delay "" FLOAT32_IEEE VOID_SCALING_f_S6_S3 1 100 -3.40282e+038 3.40282e+038 ECU_ADDRESS 0xFFF96910 /end MEASUREMENT
/begin MEASUREMENT SFOp_SLST327_out_ "" FLOAT32_IEEE VOID_SCALING_f_S6_S3 1 100 -3.40282e+038 3.40282e+038 ECU_ADDRESS 0xFFF96914 /end MEASUREMENT
/begin MEASUREMENT SFOp_SLST333_haften_b_ "" UBYTE VOID_SCALING_S6_S3 1 100 0 1 ECU_ADDRESS 0xFFF96DB9 /end MEASUREMENT
/begin MEASUREMENT SFOp_SLST333_synchron_b_loc_ "" UBYTE VOID_SCALING_S6_S3 1 100 0 1 ECU_ADDRESS 0xFFF96DBA /end MEASUREMENT
/begin MEASUREMENT SFOp_SLST333_vorsynchron_b_loc_ "" UBYTE VOID_SCALING_S6_S3 1 100 0 1 ECU_ADDRESS 0xFFF96DBB /end MEASUREMENT
/begin MEASUREMENT SFOp_SLST334_Unit_Delay "" FLOAT32_IEEE VOID_SCALING_f_S6_S3 1 100 -3.40282e+038 3.40282e+038 ECU_ADDRESS 0xFFF96918 /end MEASUREMENT
/begin MEASUREMENT SFOp_SLST334_out_ "" FLOAT32_IEEE VOID_SCALING_f_S6_S3 1 100 -3.40282e+038 3.40282e+038 ECU_ADDRESS 0xFFF9691C /end MEASUREMENT
/begin MEASUREMENT SFOp_SLST335_Unit_Delay "" FLOAT32_IEEE VOID_SCALING_f_S6_S3 1 100 -3.40282e+038 3.40282e+038 ECU_ADDRESS 0xFFF96920 /end MEASUREMENT
/begin MEASUREMENT SFOp_SLST335_out_ "" FLOAT32_IEEE VOID_SCALING_f_S6_S3 1 100 -3.40282e+038 3.40282e+038 ECU_ADDRESS 0xFFF96924 /end MEASUREMENT
/begin MEASUREMENT SFOp_SLST342_Unit_Delay2 "" SBYTE VOID_SCALING_g_S6_S3 1 100 -128 127 ECU_ADDRESS 0xFFF96DBC /end MEASUREMENT
/begin MEASUREMENT SFOp_SLST344_Unit_Delay2 "" FLOAT32_IEEE VOID_SCALING_f_S6_S3 1 100 -3.40282e+038 3.40282e+038 ECU_ADDRESS 0xFFF96928 /end MEASUREMENT
/begin MEASUREMENT SFOp_SLST352_Unit_Delay2 "" FLOAT32_IEEE VOID_SCALING_f_S6_S3 1 100 -3.40282e+038 3.40282e+038 ECU_ADDRESS 0xFFF9692C /end MEASUREMENT
/begin MEASUREMENT SFOp_SLST352_x_filt_ "" FLOAT32_IEEE VOID_SCALING_f_S6_S3 1 100 -3.40282e+038 3.40282e+038 ECU_ADDRESS 0xFFF96930 /end MEASUREMENT
/begin MEASUREMENT SFOp_SLST352_xg_filt_ "" FLOAT32_IEEE VOID_SCALING_f_S6_S3 1 100 -3.40282e+038 3.40282e+038 ECU_ADDRESS 0xFFF96934 /end MEASUREMENT
/begin MEASUREMENT SFOp_SLST389_Unit_Delay "" FLOAT32_IEEE VOID_SCALING_f_S6_S3 1 100 -3.40282e+038 3.40282e+038 ECU_ADDRESS 0xFFF96948 /end MEASUREMENT
/begin MEASUREMENT SFOp_SLST389_isActive_ "" UBYTE VOID_SCALING_S6_S3 1 100 0 1 ECU_ADDRESS 0xFFF96DBE /end MEASUREMENT
/begin MEASUREMENT SFOp_SLST389_t_left_ "" FLOAT32_IEEE VOID_SCALING_f_S6_S3 1 100 -3.40282e+038 3.40282e+038 ECU_ADDRESS 0xFFF9694C /end MEASUREMENT
/begin MEASUREMENT SFOp_SLST394_Unit_Delay "" FLOAT32_IEEE VOID_SCALING_f_S6_S3 1 100 -3.40282e+038 3.40282e+038 ECU_ADDRESS 0xFFF96950 /end MEASUREMENT
/begin MEASUREMENT SFOp_SLST394_out_ "" FLOAT32_IEEE VOID_SCALING_f_S6_S3 1 100 -3.40282e+038 3.40282e+038 ECU_ADDRESS 0xFFF96954 /end MEASUREMENT
/begin MEASUREMENT SFOp_SLST395_Unit_Delay "" FLOAT32_IEEE VOID_SCALING_f_S6_S3 1 100 -3.40282e+038 3.40282e+038 ECU_ADDRESS 0xFFF96958 /end MEASUREMENT
/begin MEASUREMENT SFOp_SLST395_isActive_ "" UBYTE VOID_SCALING_S6_S3 1 100 0 1 ECU_ADDRESS 0xFFF86494 /end MEASUREMENT
/begin MEASUREMENT SFOp_SLST395_t_left_ "" FLOAT32_IEEE VOID_SCALING_f_S6_S3 1 100 -3.40282e+038 3.40282e+038 ECU_ADDRESS 0xFFF85820 /end MEASUREMENT
/begin MEASUREMENT SFOp_SLST413_Unit_Delay "" FLOAT32_IEEE VOID_SCALING_f_S6_S3 1 100 -3.40282e+038 3.40282e+038 ECU_ADDRESS 0xFFF9695C /end MEASUREMENT
/begin MEASUREMENT SFOp_SLST413_out_ "" FLOAT32_IEEE VOID_SCALING_f_S6_S3 1 100 -3.40282e+038 3.40282e+038 ECU_ADDRESS 0xFFF96960 /end MEASUREMENT
/begin MEASUREMENT SFOp_SLST420_Unit_Delay2 "" FLOAT32_IEEE VOID_SCALING_f_S6_S3 1 100 -3.40282e+038 3.40282e+038 ECU_ADDRESS 0xFFF96964 /end MEASUREMENT
/begin MEASUREMENT SFOp_SLST420_x_filt_ "" FLOAT32_IEEE VOID_SCALING_f_S6_S3 1 100 -3.40282e+038 3.40282e+038 ECU_ADDRESS 0xFFF96968 /end MEASUREMENT
/begin MEASUREMENT SFOp_SLST420_xg_filt_ "" FLOAT32_IEEE VOID_SCALING_f_S6_S3 1 100 -3.40282e+038 3.40282e+038 ECU_ADDRESS 0xFFF9696C /end MEASUREMENT
/begin MEASUREMENT SFOp_SLST431_Unit_Delay "" FLOAT32_IEEE VOID_SCALING_f_S6_S3 1 100 -3.40282e+038 3.40282e+038 ECU_ADDRESS 0xFFF96970 /end MEASUREMENT
/begin MEASUREMENT SFOp_SLST431_isActive_ "" UBYTE VOID_SCALING_S6_S3 1 100 0 1 ECU_ADDRESS 0xFFF96DBF /end MEASUREMENT
/begin MEASUREMENT SFOp_SLST431_t_left_ "" FLOAT32_IEEE VOID_SCALING_f_S6_S3 1 100 -3.40282e+038 3.40282e+038 ECU_ADDRESS 0xFFF96974 /end MEASUREMENT
/begin MEASUREMENT SFOp_SLST435_Unit_Delay "" FLOAT32_IEEE VOID_SCALING_f_S6_S3 1 100 -3.40282e+038 3.40282e+038 ECU_ADDRESS 0xFFF96978 /end MEASUREMENT
/begin MEASUREMENT SFOp_SLST435_out_ "" FLOAT32_IEEE VOID_SCALING_f_S6_S3 1 100 -3.40282e+038 3.40282e+038 ECU_ADDRESS 0xFFF9697C /end MEASUREMENT
/begin MEASUREMENT SFOp_SLST460_Unit_Delay "" FLOAT32_IEEE VOID_SCALING_f_S6_S3 1 100 -3.40282e+038 3.40282e+038 ECU_ADDRESS 0xFFF96980 /end MEASUREMENT
/begin MEASUREMENT SFOp_SLST460_isActive_ "" UBYTE VOID_SCALING_S6_S3 1 100 0 1 ECU_ADDRESS 0xFFF96DC0 /end MEASUREMENT
/begin MEASUREMENT SFOp_SLST460_t_left_ "" FLOAT32_IEEE VOID_SCALING_f_S6_S3 1 100 -3.40282e+038 3.40282e+038 ECU_ADDRESS 0xFFF96984 /end MEASUREMENT
/begin MEASUREMENT SFOp_SLST461_Unit_Delay "" FLOAT32_IEEE VOID_SCALING_f_S6_S3 1 100 -3.40282e+038 3.40282e+038 ECU_ADDRESS 0xFFF96988 /end MEASUREMENT
/begin MEASUREMENT SFOp_SLST461_isActive_ "" UBYTE VOID_SCALING_S6_S3 1 100 0 1 ECU_ADDRESS 0xFFF86495 /end MEASUREMENT
/begin MEASUREMENT SFOp_SLST461_t_left_ "" FLOAT32_IEEE VOID_SCALING_f_S6_S3 1 100 -3.40282e+038 3.40282e+038 ECU_ADDRESS 0xFFF85824 /end MEASUREMENT
/begin MEASUREMENT SFOp_SLST469_Unit_Delay "" FLOAT32_IEEE VOID_SCALING_f_S6_S3 1 100 -3.40282e+038 3.40282e+038 ECU_ADDRESS 0xFFF9698C /end MEASUREMENT
/begin MEASUREMENT SFOp_SLST469_out_ "" FLOAT32_IEEE VOID_SCALING_f_S6_S3 1 100 -3.40282e+038 3.40282e+038 ECU_ADDRESS 0xFFF96990 /end MEASUREMENT
/begin MEASUREMENT SFOp_SLST477_Unit_Delay "" FLOAT32_IEEE VOID_SCALING_f_S6_S3 1 100 -3.40282e+038 3.40282e+038 ECU_ADDRESS 0xFFF96994 /end MEASUREMENT
/begin MEASUREMENT SFOp_SLST477_out_ "" FLOAT32_IEEE VOID_SCALING_f_S6_S3 1 100 -3.40282e+038 3.40282e+038 ECU_ADDRESS 0xFFF96998 /end MEASUREMENT
/begin MEASUREMENT SFOp_SLST478_Unit_Delay "" FLOAT32_IEEE VOID_SCALING_f_S6_S3 1 100 -3.40282e+038 3.40282e+038 ECU_ADDRESS 0xFFF9699C /end MEASUREMENT
/begin MEASUREMENT SFOp_SLST478_out_ "" FLOAT32_IEEE VOID_SCALING_f_S6_S3 1 100 -3.40282e+038 3.40282e+038 ECU_ADDRESS 0xFFF969A0 /end MEASUREMENT
/begin MEASUREMENT SFOp_SLST489_Unit_Delay2 "" FLOAT32_IEEE VOID_SCALING_f_S6_S3 1 100 -3.40282e+038 3.40282e+038 ECU_ADDRESS 0xFFF969A4 /end MEASUREMENT
/begin MEASUREMENT SFOp_SLST489_x_filt_ "" FLOAT32_IEEE VOID_SCALING_f_S6_S3 1 100 -3.40282e+038 3.40282e+038 ECU_ADDRESS 0xFFF969A8 /end MEASUREMENT
/begin MEASUREMENT SFOp_SLST489_xg_filt_ "" FLOAT32_IEEE VOID_SCALING_f_S6_S3 1 100 -3.40282e+038 3.40282e+038 ECU_ADDRESS 0xFFF969AC /end MEASUREMENT
/begin MEASUREMENT SFOp_SLST509_Unit_Delay "" FLOAT32_IEEE VOID_SCALING_f_S6_S3 1 100 -3.40282e+038 3.40282e+038 ECU_ADDRESS 0xFFF969B0 /end MEASUREMENT
/begin MEASUREMENT SFOp_SLST509_isActive_ "" UBYTE VOID_SCALING_S6_S3 1 100 0 1 ECU_ADDRESS 0xFFF96DC1 /end MEASUREMENT
/begin MEASUREMENT SFOp_SLST509_t_left_ "" FLOAT32_IEEE VOID_SCALING_f_S6_S3 1 100 -3.40282e+038 3.40282e+038 ECU_ADDRESS 0xFFF969B4 /end MEASUREMENT
/begin MEASUREMENT SFOp_SLST510_Unit_Delay2 "" FLOAT32_IEEE VOID_SCALING_f_S6_S3 1 100 -3.40282e+038 3.40282e+038 ECU_ADDRESS 0xFFF969B8 /end MEASUREMENT
/begin MEASUREMENT SFOp_SLST510_x_filt_ "" FLOAT32_IEEE VOID_SCALING_f_S6_S3 1 100 -3.40282e+038 3.40282e+038 ECU_ADDRESS 0xFFF969BC /end MEASUREMENT
/begin MEASUREMENT SFOp_SLST510_xg_filt_ "" FLOAT32_IEEE VOID_SCALING_f_S6_S3 1 100 -3.40282e+038 3.40282e+038 ECU_ADDRESS 0xFFF969C0 /end MEASUREMENT
/begin MEASUREMENT SFOp_SLST82_Unit_Delay2 "" FLOAT32_IEEE VOID_SCALING_f_S6_S3 1 100 -3.40282e+038 3.40282e+038 ECU_ADDRESS 0xFFF969C4 /end MEASUREMENT
/begin MEASUREMENT SFOp_SLST82_x2_ "" FLOAT32_IEEE VOID_SCALING_f_S6_S3 1 100 -3.40282e+038 3.40282e+038 ECU_ADDRESS 0xFFF969C8 /end MEASUREMENT
/begin MEASUREMENT SFOp_SLST83_Unit_Delay2 "" FLOAT32_IEEE VOID_SCALING_f_S6_S3 1 100 -3.40282e+038 3.40282e+038 ECU_ADDRESS 0xFFF969CC /end MEASUREMENT
/begin MEASUREMENT SFOp_SLST83_x2_ "" FLOAT32_IEEE VOID_SCALING_f_S6_S3 1 100 -3.40282e+038 3.40282e+038 ECU_ADDRESS 0xFFF969D0 /end MEASUREMENT
/begin MEASUREMENT SFOp_SLST84_Unit_Delay "" FLOAT32_IEEE VOID_SCALING_f_S6_S3 1 100 -3.40282e+038 3.40282e+038 ECU_ADDRESS 0xFFF969D4 /end MEASUREMENT
/begin MEASUREMENT SFOp_SLST84_isActive_ "" UBYTE VOID_SCALING_S6_S3 1 100 0 1 ECU_ADDRESS 0xFFF86496 /end MEASUREMENT
/begin MEASUREMENT SFOp_SLST84_t_left_ "" FLOAT32_IEEE VOID_SCALING_f_S6_S3 1 100 -3.40282e+038 3.40282e+038 ECU_ADDRESS 0xFFF85828 /end MEASUREMENT
/begin MEASUREMENT SFOp_SLST98_Unit_Delay "" FLOAT32_IEEE VOID_SCALING_f_S6_S3 1 100 -3.40282e+038 3.40282e+038 ECU_ADDRESS 0xFFF969D8 /end MEASUREMENT
/begin MEASUREMENT SFOp_SLST98_isActive_ "" UBYTE VOID_SCALING_S6_S3 1 100 0 1 ECU_ADDRESS 0xFFF86497 /end MEASUREMENT
/begin MEASUREMENT SFOp_SLST98_t_left_ "" FLOAT32_IEEE VOID_SCALING_f_S6_S3 1 100 -3.40282e+038 3.40282e+038 ECU_ADDRESS 0xFFF8582C /end MEASUREMENT
/begin MEASUREMENT SFOp_VMA30_Unit_Delay "" FLOAT32_IEEE VOID_SCALING_f_S6_S3 1 100 -3.40282e+038 3.40282e+038 ECU_ADDRESS 0xFFF96AB0 /end MEASUREMENT
/begin MEASUREMENT SFOp_VMA30_isActive_ "" UBYTE VOID_SCALING_S6_S3 1 100 0 1 ECU_ADDRESS 0xFFF8653A /end MEASUREMENT
/begin MEASUREMENT SFOp_VMA30_t_left_ "" FLOAT32_IEEE VOID_SCALING_f_S6_S3 1 100 -3.40282e+038 3.40282e+038 ECU_ADDRESS 0xFFF85AFC /end MEASUREMENT
/begin MEASUREMENT SFOp_VME33_Unit_Delay "" FLOAT32_IEEE VOID_SCALING_f_S6_S3 1 100 -3.40282e+038 3.40282e+038 ECU_ADDRESS 0xFFF96ABC /end MEASUREMENT
/begin MEASUREMENT SFOp_VME33_isActive_ "" UBYTE VOID_SCALING_S6_S3 1 100 0 1 ECU_ADDRESS 0xFFF86556 /end MEASUREMENT
/begin MEASUREMENT SFOp_VME33_t_left_ "" FLOAT32_IEEE VOID_SCALING_f_S6_S3 1 100 -3.40282e+038 3.40282e+038 ECU_ADDRESS 0xFFF85B08 /end MEASUREMENT
/begin MEASUREMENT SFOp_Zus144_Unit_Delay "" FLOAT32_IEEE VOID_SCALING_f_S6_S3 1 100 -3.40282e+038 3.40282e+038 ECU_ADDRESS 0xFFF96B5C /end MEASUREMENT
/begin MEASUREMENT SFOp_Zus144_isActive_ "" UBYTE VOID_SCALING_S6_S3 1 100 0 1 ECU_ADDRESS 0xFFF96DE3 /end MEASUREMENT
/begin MEASUREMENT SFOp_Zus144_t_left_ "" FLOAT32_IEEE VOID_SCALING_f_S6_S3 1 100 -3.40282e+038 3.40282e+038 ECU_ADDRESS 0xFFF96B60 /end MEASUREMENT
/begin MEASUREMENT SFOp_Zus145_Unit_Delay2 "" FLOAT32_IEEE VOID_SCALING_f_S6_S3 1 100 -3.40282e+038 3.40282e+038 ECU_ADDRESS 0xFFF96B64 /end MEASUREMENT
/begin MEASUREMENT SFOp_Zus145_x_ "" FLOAT32_IEEE VOID_SCALING_f_S6_S3 1 100 -3.40282e+038 3.40282e+038 ECU_ADDRESS 0xFFF96B68 /end MEASUREMENT
/begin MEASUREMENT SFOp_Zus151_Unit_Delay "" FLOAT32_IEEE VOID_SCALING_f_S6_S3 1 100 -3.40282e+038 3.40282e+038 ECU_ADDRESS 0xFFF96B6C /end MEASUREMENT
/begin MEASUREMENT SFOp_Zus151_out_ "" FLOAT32_IEEE VOID_SCALING_f_S6_S3 1 100 -3.40282e+038 3.40282e+038 ECU_ADDRESS 0xFFF96B70 /end MEASUREMENT
/begin MEASUREMENT SFOp_Zus171_Unit_Delay "" FLOAT32_IEEE VOID_SCALING_f_S6_S3 1 100 -3.40282e+038 3.40282e+038 ECU_ADDRESS 0xFFF96B74 /end MEASUREMENT
/begin MEASUREMENT SFOp_Zus171_isActive_ "" UBYTE VOID_SCALING_S6_S3 1 100 0 1 ECU_ADDRESS 0xFFF86574 /end MEASUREMENT
/begin MEASUREMENT SFOp_Zus171_t_left_ "" FLOAT32_IEEE VOID_SCALING_f_S6_S3 1 100 -3.40282e+038 3.40282e+038 ECU_ADDRESS 0xFFF85B14 /end MEASUREMENT
/begin MEASUREMENT SFOp_Zus173_Unit_Delay "" FLOAT32_IEEE VOID_SCALING_f_S6_S3 1 100 -3.40282e+038 3.40282e+038 ECU_ADDRESS 0xFFF96B78 /end MEASUREMENT
/begin MEASUREMENT SFOp_Zus173_out_ "" FLOAT32_IEEE VOID_SCALING_f_S6_S3 1 100 -3.40282e+038 3.40282e+038 ECU_ADDRESS 0xFFF96B7C /end MEASUREMENT
/begin MEASUREMENT SFOp_Zus174_Unit_Delay "" FLOAT32_IEEE VOID_SCALING_f_S6_S3 1 100 -3.40282e+038 3.40282e+038 ECU_ADDRESS 0xFFF96B80 /end MEASUREMENT
/begin MEASUREMENT SFOp_Zus174_out_ "" FLOAT32_IEEE VOID_SCALING_f_S6_S3 1 100 -3.40282e+038 3.40282e+038 ECU_ADDRESS 0xFFF96B84 /end MEASUREMENT
/begin MEASUREMENT SFOp_Zus183_Unit_Delay "" FLOAT32_IEEE VOID_SCALING_f_S6_S3 1 100 -3.40282e+038 3.40282e+038 ECU_ADDRESS 0xFFF96B88 /end MEASUREMENT
/begin MEASUREMENT SFOp_Zus183_isActive_ "" UBYTE VOID_SCALING_S6_S3 1 100 0 1 ECU_ADDRESS 0xFFF96DE4 /end MEASUREMENT
/begin MEASUREMENT SFOp_Zus183_t_left_ "" FLOAT32_IEEE VOID_SCALING_f_S6_S3 1 100 -3.40282e+038 3.40282e+038 ECU_ADDRESS 0xFFF96B8C /end MEASUREMENT
/begin MEASUREMENT SFOp_Zus186_Unit_Delay "" FLOAT32_IEEE VOID_SCALING_f_S6_S3 1 100 -3.40282e+038 3.40282e+038 ECU_ADDRESS 0xFFF96B90 /end MEASUREMENT
/begin MEASUREMENT SFOp_Zus186_isActive_ "" UBYTE VOID_SCALING_S6_S3 1 100 0 1 ECU_ADDRESS 0xFFF86575 /end MEASUREMENT
/begin MEASUREMENT SFOp_Zus186_t_left_ "" FLOAT32_IEEE VOID_SCALING_f_S6_S3 1 100 -3.40282e+038 3.40282e+038 ECU_ADDRESS 0xFFF85B18 /end MEASUREMENT
/begin MEASUREMENT SFOp_Zus198_KL__DMAXMAX_SYN_ZUS "" FLOAT32_IEEE VOID_SCALING_f_S6_S3 1 100 -3.40282e+038 3.40282e+038 ECU_ADDRESS 0xFFF96ADC /end MEASUREMENT
/begin MEASUREMENT SFOp_Zus205_Unit_Delay "" FLOAT32_IEEE VOID_SCALING_f_S6_S3 1 100 -3.40282e+038 3.40282e+038 ECU_ADDRESS 0xFFF96B94 /end MEASUREMENT
/begin MEASUREMENT SFOp_Zus205_isActive_ "" UBYTE VOID_SCALING_S6_S3 1 100 0 1 ECU_ADDRESS 0xFFF86576 /end MEASUREMENT
/begin MEASUREMENT SFOp_Zus205_t_left_ "" FLOAT32_IEEE VOID_SCALING_f_S6_S3 1 100 -3.40282e+038 3.40282e+038 ECU_ADDRESS 0xFFF85B1C /end MEASUREMENT
/begin MEASUREMENT SFOp_Zus210_Unit_Delay "" FLOAT32_IEEE VOID_SCALING_f_S6_S3 1 100 -3.40282e+038 3.40282e+038 ECU_ADDRESS 0xFFF96B98 /end MEASUREMENT
/begin MEASUREMENT SFOp_Zus210_isActive_ "" UBYTE VOID_SCALING_S6_S3 1 100 0 1 ECU_ADDRESS 0xFFF86577 /end MEASUREMENT
/begin MEASUREMENT SFOp_Zus210_t_left_ "" FLOAT32_IEEE VOID_SCALING_f_S6_S3 1 100 -3.40282e+038 3.40282e+038 ECU_ADDRESS 0xFFF85B20 /end MEASUREMENT
/begin MEASUREMENT SFOp_Zus216_Unit_Delay "" FLOAT32_IEEE VOID_SCALING_f_S6_S3 1 100 -3.40282e+038 3.40282e+038 ECU_ADDRESS 0xFFF96B9C /end MEASUREMENT
/begin MEASUREMENT SFOp_Zus216_isActive_ "" UBYTE VOID_SCALING_S6_S3 1 100 0 1 ECU_ADDRESS 0xFFF86578 /end MEASUREMENT
/begin MEASUREMENT SFOp_Zus216_t_left_ "" FLOAT32_IEEE VOID_SCALING_f_S6_S3 1 100 -3.40282e+038 3.40282e+038 ECU_ADDRESS 0xFFF85B24 /end MEASUREMENT
/begin MEASUREMENT SFOp_Zus219_x_filter_ "" FLOAT32_IEEE VOID_SCALING_f_S6_S3 1 100 -3.40282e+038 3.40282e+038 ECU_ADDRESS 0xFFF96BA0 /end MEASUREMENT
/begin MEASUREMENT SFOp_Zus219_xp_ "" FLOAT32_IEEE VOID_SCALING_f_S6_S3 1 100 -3.40282e+038 3.40282e+038 ECU_ADDRESS 0xFFF96BA4 /end MEASUREMENT
/begin MEASUREMENT SFOp_Zus220_Unit_Delay2 "" FLOAT32_IEEE VOID_SCALING_f_S6_S3 1 100 -3.40282e+038 3.40282e+038 ECU_ADDRESS 0xFFF96BA8 /end MEASUREMENT
/begin MEASUREMENT SFOp_Zus231_Unit_Delay "" FLOAT32_IEEE VOID_SCALING_f_S6_S3 1 100 -3.40282e+038 3.40282e+038 ECU_ADDRESS 0xFFF96BAC /end MEASUREMENT
/begin MEASUREMENT SFOp_Zus231_out_ "" FLOAT32_IEEE VOID_SCALING_f_S6_S3 1 100 -3.40282e+038 3.40282e+038 ECU_ADDRESS 0xFFF96BB0 /end MEASUREMENT
/begin MEASUREMENT SFOp_Zus232_Unit_Delay "" FLOAT32_IEEE VOID_SCALING_f_S6_S3 1 100 -3.40282e+038 3.40282e+038 ECU_ADDRESS 0xFFF96BB4 /end MEASUREMENT
/begin MEASUREMENT SFOp_Zus232_out_ "" FLOAT32_IEEE VOID_SCALING_f_S6_S3 1 100 -3.40282e+038 3.40282e+038 ECU_ADDRESS 0xFFF96BB8 /end MEASUREMENT
/begin MEASUREMENT SFOp_Zus239_Unit_Delay "" FLOAT32_IEEE VOID_SCALING_f_S6_S3 1 100 -3.40282e+038 3.40282e+038 ECU_ADDRESS 0xFFF96BBC /end MEASUREMENT
/begin MEASUREMENT SFOp_Zus239_isActive_ "" UBYTE VOID_SCALING_S6_S3 1 100 0 1 ECU_ADDRESS 0xFFF86579 /end MEASUREMENT
/begin MEASUREMENT SFOp_Zus239_t_left_ "" FLOAT32_IEEE VOID_SCALING_f_S6_S3 1 100 -3.40282e+038 3.40282e+038 ECU_ADDRESS 0xFFF85B28 /end MEASUREMENT
/begin MEASUREMENT SFOp_Zus240_KL__CERKUMS_SYN_ZUS "" FLOAT32_IEEE VOID_SCALING_f_S6_S3 1 100 -3.40282e+038 3.40282e+038 ECU_ADDRESS 0xFFF96B18 /end MEASUREMENT
/begin MEASUREMENT SFOp_Zus243_Unit_Delay "" FLOAT32_IEEE VOID_SCALING_f_S6_S3 1 100 -3.40282e+038 3.40282e+038 ECU_ADDRESS 0xFFF96BC0 /end MEASUREMENT
/begin MEASUREMENT SFOp_Zus243_isActive_ "" UBYTE VOID_SCALING_S6_S3 1 100 0 1 ECU_ADDRESS 0xFFF8657A /end MEASUREMENT
/begin MEASUREMENT SFOp_Zus243_t_left_ "" FLOAT32_IEEE VOID_SCALING_f_S6_S3 1 100 -3.40282e+038 3.40282e+038 ECU_ADDRESS 0xFFF85B2C /end MEASUREMENT
/begin MEASUREMENT SFOp_Zus247_Unit_Delay2 "" FLOAT32_IEEE VOID_SCALING_f_S6_S3 1 100 -3.40282e+038 3.40282e+038 ECU_ADDRESS 0xFFF96BC4 /end MEASUREMENT
/begin MEASUREMENT SFOp_Zus247_x_ "" FLOAT32_IEEE VOID_SCALING_f_S6_S3 1 100 -3.40282e+038 3.40282e+038 ECU_ADDRESS 0xFFF96BC8 /end MEASUREMENT
/begin MEASUREMENT SFOp_Zus253_Unit_Delay "" FLOAT32_IEEE VOID_SCALING_f_S6_S3 1 100 -3.40282e+038 3.40282e+038 ECU_ADDRESS 0xFFF96BCC /end MEASUREMENT
/begin MEASUREMENT SFOp_Zus253_isActive_ "" UBYTE VOID_SCALING_S6_S3 1 100 0 1 ECU_ADDRESS 0xFFF8657B /end MEASUREMENT
/begin MEASUREMENT SFOp_Zus253_t_left_ "" FLOAT32_IEEE VOID_SCALING_f_S6_S3 1 100 -3.40282e+038 3.40282e+038 ECU_ADDRESS 0xFFF85B30 /end MEASUREMENT
/begin MEASUREMENT SFOp_Zus259_Unit_Delay "" FLOAT32_IEEE VOID_SCALING_f_S6_S3 1 100 -3.40282e+038 3.40282e+038 ECU_ADDRESS 0xFFF96BD0 /end MEASUREMENT
/begin MEASUREMENT SFOp_Zus259_out_ "" FLOAT32_IEEE VOID_SCALING_f_S6_S3 1 100 -3.40282e+038 3.40282e+038 ECU_ADDRESS 0xFFF96BD4 /end MEASUREMENT
/begin MEASUREMENT SFOp_Zus278_Unit_Delay "" FLOAT32_IEEE VOID_SCALING_f_S6_S3 1 100 -3.40282e+038 3.40282e+038 ECU_ADDRESS 0xFFF96BD8 /end MEASUREMENT
/begin MEASUREMENT SFOp_Zus278_isActive_ "" UBYTE VOID_SCALING_S6_S3 1 100 0 1 ECU_ADDRESS 0xFFF8657C /end MEASUREMENT
/begin MEASUREMENT SFOp_Zus278_t_left_ "" FLOAT32_IEEE VOID_SCALING_f_S6_S3 1 100 -3.40282e+038 3.40282e+038 ECU_ADDRESS 0xFFF85B34 /end MEASUREMENT
/begin MEASUREMENT SFOp_Zus279_Unit_Delay "" FLOAT32_IEEE VOID_SCALING_f_S6_S3 1 100 -3.40282e+038 3.40282e+038 ECU_ADDRESS 0xFFF96BDC /end MEASUREMENT
/begin MEASUREMENT SFOp_Zus279_out_ "" FLOAT32_IEEE VOID_SCALING_f_S6_S3 1 100 -3.40282e+038 3.40282e+038 ECU_ADDRESS 0xFFF96BE0 /end MEASUREMENT
/begin MEASUREMENT SFOp_Zus284_Unit_Delay2 "" FLOAT32_IEEE VOID_SCALING_f_S6_S3 1 100 -3.40282e+038 3.40282e+038 ECU_ADDRESS 0xFFF96BE4 /end MEASUREMENT
/begin MEASUREMENT SFOp_Zus284_x_ "" FLOAT32_IEEE VOID_SCALING_f_S6_S3 1 100 -3.40282e+038 3.40282e+038 ECU_ADDRESS 0xFFF96BE8 /end MEASUREMENT
/begin MEASUREMENT SFOp_Zus300_Unit_Delay "" FLOAT32_IEEE VOID_SCALING_f_S6_S3 1 100 -3.40282e+038 3.40282e+038 ECU_ADDRESS 0xFFF96BEC /end MEASUREMENT
/begin MEASUREMENT SFOp_Zus300_isActive_ "" UBYTE VOID_SCALING_S6_S3 1 100 0 1 ECU_ADDRESS 0xFFF8657D /end MEASUREMENT
/begin MEASUREMENT SFOp_Zus300_t_left_ "" FLOAT32_IEEE VOID_SCALING_f_S6_S3 1 100 -3.40282e+038 3.40282e+038 ECU_ADDRESS 0xFFF85B38 /end MEASUREMENT
/begin MEASUREMENT SFOp_Zus302_Unit_Delay2 "" FLOAT32_IEEE VOID_SCALING_f_S6_S3 1 100 -3.40282e+038 3.40282e+038 ECU_ADDRESS 0xFFF96BF0 /end MEASUREMENT
/begin MEASUREMENT SFOp_Zus302_x_ "" FLOAT32_IEEE VOID_SCALING_f_S6_S3 1 100 -3.40282e+038 3.40282e+038 ECU_ADDRESS 0xFFF96BF4 /end MEASUREMENT
/begin MEASUREMENT SFOp_Zus310_Unit_Delay "" FLOAT32_IEEE VOID_SCALING_f_S6_S3 1 100 -3.40282e+038 3.40282e+038 ECU_ADDRESS 0xFFF96BF8 /end MEASUREMENT
/begin MEASUREMENT SFOp_Zus310_isActive_ "" UBYTE VOID_SCALING_S6_S3 1 100 0 1 ECU_ADDRESS 0xFFF8657E /end MEASUREMENT
/begin MEASUREMENT SFOp_Zus310_t_left_ "" FLOAT32_IEEE VOID_SCALING_f_S6_S3 1 100 -3.40282e+038 3.40282e+038 ECU_ADDRESS 0xFFF85B3C /end MEASUREMENT
/begin MEASUREMENT SFOp_Zus313_Unit_Delay "" FLOAT32_IEEE VOID_SCALING_f_S6_S3 1 100 -3.40282e+038 3.40282e+038 ECU_ADDRESS 0xFFF96BFC /end MEASUREMENT
/begin MEASUREMENT SFOp_Zus313_out_ "" FLOAT32_IEEE VOID_SCALING_f_S6_S3 1 100 -3.40282e+038 3.40282e+038 ECU_ADDRESS 0xFFF96C00 /end MEASUREMENT
/begin MEASUREMENT SFOp_Zus327_Unit_Delay "" FLOAT32_IEEE VOID_SCALING_f_S6_S3 1 100 -3.40282e+038 3.40282e+038 ECU_ADDRESS 0xFFF96C04 /end MEASUREMENT
/begin MEASUREMENT SFOp_Zus327_isActive_ "" UBYTE VOID_SCALING_S6_S3 1 100 0 1 ECU_ADDRESS 0xFFF8657F /end MEASUREMENT
/begin MEASUREMENT SFOp_Zus327_t_left_ "" FLOAT32_IEEE VOID_SCALING_f_S6_S3 1 100 -3.40282e+038 3.40282e+038 ECU_ADDRESS 0xFFF85B40 /end MEASUREMENT
/begin MEASUREMENT SFOp_Zus329_Unit_Delay "" FLOAT32_IEEE VOID_SCALING_f_S6_S3 1 100 -3.40282e+038 3.40282e+038 ECU_ADDRESS 0xFFF96C08 /end MEASUREMENT
/begin MEASUREMENT SFOp_Zus329_out_ "" FLOAT32_IEEE VOID_SCALING_f_S6_S3 1 100 -3.40282e+038 3.40282e+038 ECU_ADDRESS 0xFFF96C0C /end MEASUREMENT
/begin MEASUREMENT SFOp_Zus345_Unit_Delay "" FLOAT32_IEEE VOID_SCALING_f_S6_S3 1 100 -3.40282e+038 3.40282e+038 ECU_ADDRESS 0xFFF96C10 /end MEASUREMENT
/begin MEASUREMENT SFOp_Zus345_out_ "" FLOAT32_IEEE VOID_SCALING_f_S6_S3 1 100 -3.40282e+038 3.40282e+038 ECU_ADDRESS 0xFFF96C14 /end MEASUREMENT
/begin MEASUREMENT SFOp_Zus346_Unit_Delay "" FLOAT32_IEEE VOID_SCALING_f_S6_S3 1 100 -3.40282e+038 3.40282e+038 ECU_ADDRESS 0xFFF96C18 /end MEASUREMENT
/begin MEASUREMENT SFOp_Zus346_out_ "" FLOAT32_IEEE VOID_SCALING_f_S6_S3 1 100 -3.40282e+038 3.40282e+038 ECU_ADDRESS 0xFFF96C1C /end MEASUREMENT
/begin MEASUREMENT SFOp_Zus347_Unit_Delay "" FLOAT32_IEEE VOID_SCALING_f_S6_S3 1 100 -3.40282e+038 3.40282e+038 ECU_ADDRESS 0xFFF96C20 /end MEASUREMENT
/begin MEASUREMENT SFOp_Zus347_isActive_ "" UBYTE VOID_SCALING_S6_S3 1 100 0 1 ECU_ADDRESS 0xFFF86580 /end MEASUREMENT
/begin MEASUREMENT SFOp_Zus347_t_left_ "" FLOAT32_IEEE VOID_SCALING_f_S6_S3 1 100 -3.40282e+038 3.40282e+038 ECU_ADDRESS 0xFFF85B44 /end MEASUREMENT
/begin MEASUREMENT SFOp_Zus357_Unit_Delay2 "" FLOAT32_IEEE VOID_SCALING_f_S6_S3 1 100 -3.40282e+038 3.40282e+038 ECU_ADDRESS 0xFFF96C24 /end MEASUREMENT
/begin MEASUREMENT SFOp_Zus357_x_ "" FLOAT32_IEEE VOID_SCALING_f_S6_S3 1 100 -3.40282e+038 3.40282e+038 ECU_ADDRESS 0xFFF96C28 /end MEASUREMENT
/begin MEASUREMENT SFOp_Zus77_Unit_Delay "" FLOAT32_IEEE VOID_SCALING_f_S6_S3 1 100 -3.40282e+038 3.40282e+038 ECU_ADDRESS 0xFFF96C2C /end MEASUREMENT
/begin MEASUREMENT SFOp_Zus77_isActive_ "" UBYTE VOID_SCALING_S6_S3 1 100 0 1 ECU_ADDRESS 0xFFF96DE5 /end MEASUREMENT
/begin MEASUREMENT SFOp_Zus77_t_left_ "" FLOAT32_IEEE VOID_SCALING_f_S6_S3 1 100 -3.40282e+038 3.40282e+038 ECU_ADDRESS 0xFFF96C30 /end MEASUREMENT
/begin MEASUREMENT SFOp_Zus78_x_filter_ "" FLOAT32_IEEE VOID_SCALING_f_S6_S3 1 100 -3.40282e+038 3.40282e+038 ECU_ADDRESS 0xFFF96C34 /end MEASUREMENT
/begin MEASUREMENT SFOp_Zus78_xp_ "" FLOAT32_IEEE VOID_SCALING_f_S6_S3 1 100 -3.40282e+038 3.40282e+038 ECU_ADDRESS 0xFFF96C38 /end MEASUREMENT
/begin MEASUREMENT SFOp_Zus79_Unit_Delay2 "" FLOAT32_IEEE VOID_SCALING_f_S6_S3 1 100 -3.40282e+038 3.40282e+038 ECU_ADDRESS 0xFFF96C3C /end MEASUREMENT
/begin MEASUREMENT SFOp_Zus85_Unit_Delay "" FLOAT32_IEEE VOID_SCALING_f_S6_S3 1 100 -3.40282e+038 3.40282e+038 ECU_ADDRESS 0xFFF96C40 /end MEASUREMENT
/begin MEASUREMENT SFOp_Zus85_isActive_ "" UBYTE VOID_SCALING_S6_S3 1 100 0 1 ECU_ADDRESS 0xFFF86581 /end MEASUREMENT
/begin MEASUREMENT SFOp_Zus85_t_left_ "" FLOAT32_IEEE VOID_SCALING_f_S6_S3 1 100 -3.40282e+038 3.40282e+038 ECU_ADDRESS 0xFFF85B48 /end MEASUREMENT
/begin MEASUREMENT SFOp_Zus88_Unit_Delay2 "" FLOAT32_IEEE VOID_SCALING_f_S6_S3 1 100 -3.40282e+038 3.40282e+038 ECU_ADDRESS 0xFFF96C44 /end MEASUREMENT
/begin MEASUREMENT SFOp_Zus88_x2_ "" FLOAT32_IEEE VOID_SCALING_f_S6_S3 1 100 -3.40282e+038 3.40282e+038 ECU_ADDRESS 0xFFF96C48 /end MEASUREMENT
/begin MEASUREMENT SFOp_Zus89_Unit_Delay2 "" FLOAT32_IEEE VOID_SCALING_f_S6_S3 1 100 -3.40282e+038 3.40282e+038 ECU_ADDRESS 0xFFF96C4C /end MEASUREMENT
/begin MEASUREMENT SFOp_Zus89_x2_ "" FLOAT32_IEEE VOID_SCALING_f_S6_S3 1 100 -3.40282e+038 3.40282e+038 ECU_ADDRESS 0xFFF96C50 /end MEASUREMENT
/begin MEASUREMENT SFOp_Zus90_Unit_Delay "" FLOAT32_IEEE VOID_SCALING_f_S6_S3 1 100 -3.40282e+038 3.40282e+038 ECU_ADDRESS 0xFFF96C54 /end MEASUREMENT
/begin MEASUREMENT SFOp_Zus90_isActive_ "" UBYTE VOID_SCALING_S6_S3 1 100 0 1 ECU_ADDRESS 0xFFF86582 /end MEASUREMENT
/begin MEASUREMENT SFOp_Zus90_t_left_ "" FLOAT32_IEEE VOID_SCALING_f_S6_S3 1 100 -3.40282e+038 3.40282e+038 ECU_ADDRESS 0xFFF85B4C /end MEASUREMENT
/begin MEASUREMENT SFSBo141_Unit_Delay "" FLOAT32_IEEE VOID_SCALING_f_S6_S3 1 100 -3.40282e+038 3.40282e+038 ECU_ADDRESS 0xFFF964C8 /end MEASUREMENT
/begin MEASUREMENT SFSBo141_isActive_ "" UBYTE VOID_SCALING_S6_S3 1 100 0 1 ECU_ADDRESS 0xFFF96D75 /end MEASUREMENT
/begin MEASUREMENT SFSBo141_t_left_ "" FLOAT32_IEEE VOID_SCALING_f_S6_S3 1 100 -3.40282e+038 3.40282e+038 ECU_ADDRESS 0xFFF964CC /end MEASUREMENT
/begin MEASUREMENT SFSBo154_Unit_Delay "" FLOAT32_IEEE VOID_SCALING_f_S6_S3 1 100 -3.40282e+038 3.40282e+038 ECU_ADDRESS 0xFFF964D0 /end MEASUREMENT
/begin MEASUREMENT SFSBo154_isActive_ "" UBYTE VOID_SCALING_S6_S3 1 100 0 1 ECU_ADDRESS 0xFFF86263 /end MEASUREMENT
/begin MEASUREMENT SFSBo154_t_left_ "" FLOAT32_IEEE VOID_SCALING_f_S6_S3 1 100 -3.40282e+038 3.40282e+038 ECU_ADDRESS 0xFFF8530C /end MEASUREMENT
/begin MEASUREMENT SFSBo155_Unit_Delay "" FLOAT32_IEEE VOID_SCALING_f_S6_S3 1 100 -3.40282e+038 3.40282e+038 ECU_ADDRESS 0xFFF964D4 /end MEASUREMENT
/begin MEASUREMENT SFSBo155_isActive_ "" UBYTE VOID_SCALING_S6_S3 1 100 0 1 ECU_ADDRESS 0xFFF86264 /end MEASUREMENT
/begin MEASUREMENT SFSBo155_t_left_ "" FLOAT32_IEEE VOID_SCALING_f_S6_S3 1 100 -3.40282e+038 3.40282e+038 ECU_ADDRESS 0xFFF85310 /end MEASUREMENT
/begin MEASUREMENT SFSBo156_Unit_Delay "" FLOAT32_IEEE VOID_SCALING_f_S6_S3 1 100 -3.40282e+038 3.40282e+038 ECU_ADDRESS 0xFFF964D8 /end MEASUREMENT
/begin MEASUREMENT SFSBo156_isActive_ "" UBYTE VOID_SCALING_S6_S3 1 100 0 1 ECU_ADDRESS 0xFFF86265 /end MEASUREMENT
/begin MEASUREMENT SFSBo156_t_left_ "" FLOAT32_IEEE VOID_SCALING_f_S6_S3 1 100 -3.40282e+038 3.40282e+038 ECU_ADDRESS 0xFFF85314 /end MEASUREMENT
/begin MEASUREMENT SFSBo163_Unit_Delay "" FLOAT32_IEEE VOID_SCALING_f_S6_S3 1 100 -3.40282e+038 3.40282e+038 ECU_ADDRESS 0xFFF964DC /end MEASUREMENT
/begin MEASUREMENT SFSBo163_isActive_ "" UBYTE VOID_SCALING_S6_S3 1 100 0 1 ECU_ADDRESS 0xFFF86266 /end MEASUREMENT
/begin MEASUREMENT SFSBo163_t_left_ "" FLOAT32_IEEE VOID_SCALING_f_S6_S3 1 100 -3.40282e+038 3.40282e+038 ECU_ADDRESS 0xFFF85318 /end MEASUREMENT
/begin MEASUREMENT SFSBo182_Unit_Delay "" FLOAT32_IEEE VOID_SCALING_f_S6_S3 1 100 -3.40282e+038 3.40282e+038 ECU_ADDRESS 0xFFF964E0 /end MEASUREMENT
/begin MEASUREMENT SFSBo182_isActive_ "" UBYTE VOID_SCALING_S6_S3 1 100 0 1 ECU_ADDRESS 0xFFF86267 /end MEASUREMENT
/begin MEASUREMENT SFSBo182_t_left_ "" FLOAT32_IEEE VOID_SCALING_f_S6_S3 1 100 -3.40282e+038 3.40282e+038 ECU_ADDRESS 0xFFF8531C /end MEASUREMENT
/begin MEASUREMENT SFSBo200_Unit_Delay "" FLOAT32_IEEE VOID_SCALING_f_S6_S3 1 100 -3.40282e+038 3.40282e+038 ECU_ADDRESS 0xFFF964EC /end MEASUREMENT
/begin MEASUREMENT SFSBo200_out_ "" FLOAT32_IEEE VOID_SCALING_f_S6_S3 1 100 -3.40282e+038 3.40282e+038 ECU_ADDRESS 0xFFF964F0 /end MEASUREMENT
/begin MEASUREMENT SFSBo210_Unit_Delay2 "" FLOAT32_IEEE VOID_SCALING_f_S6_S3 1 100 -3.40282e+038 3.40282e+038 ECU_ADDRESS 0xFFF964F4 /end MEASUREMENT
/begin MEASUREMENT SFSBo210_x_ "" FLOAT32_IEEE VOID_SCALING_f_S6_S3 1 100 -3.40282e+038 3.40282e+038 ECU_ADDRESS 0xFFF964F8 /end MEASUREMENT
/begin MEASUREMENT SFSBo211_Unit_Delay2 "" FLOAT32_IEEE VOID_SCALING_f_S6_S3 1 100 -3.40282e+038 3.40282e+038 ECU_ADDRESS 0xFFF964FC /end MEASUREMENT
/begin MEASUREMENT SFSBo211_x_ "" FLOAT32_IEEE VOID_SCALING_f_S6_S3 1 100 -3.40282e+038 3.40282e+038 ECU_ADDRESS 0xFFF96500 /end MEASUREMENT
/begin MEASUREMENT SFSBo220_Unit_Delay "" FLOAT32_IEEE VOID_SCALING_f_S6_S3 1 100 -3.40282e+038 3.40282e+038 ECU_ADDRESS 0xFFF96504 /end MEASUREMENT
/begin MEASUREMENT SFSBo220_isActive_ "" UBYTE VOID_SCALING_S6_S3 1 100 0 1 ECU_ADDRESS 0xFFF86268 /end MEASUREMENT
/begin MEASUREMENT SFSBo220_t_left_ "" FLOAT32_IEEE VOID_SCALING_f_S6_S3 1 100 -3.40282e+038 3.40282e+038 ECU_ADDRESS 0xFFF85320 /end MEASUREMENT
/begin MEASUREMENT SFSBo223_Unit_Delay "" FLOAT32_IEEE VOID_SCALING_f_S6_S3 1 100 -3.40282e+038 3.40282e+038 ECU_ADDRESS 0xFFF96508 /end MEASUREMENT
/begin MEASUREMENT SFSBo223_out_ "" FLOAT32_IEEE VOID_SCALING_f_S6_S3 1 100 -3.40282e+038 3.40282e+038 ECU_ADDRESS 0xFFF9650C /end MEASUREMENT
/begin MEASUREMENT SFSBo24_Unit_Delay "" FLOAT32_IEEE VOID_SCALING_f_S6_S3 1 100 -3.40282e+038 3.40282e+038 ECU_ADDRESS 0xFFF96510 /end MEASUREMENT
/begin MEASUREMENT SFSBo24_isActive_ "" UBYTE VOID_SCALING_S6_S3 1 100 0 1 ECU_ADDRESS 0xFFF86269 /end MEASUREMENT
/begin MEASUREMENT SFSBo24_t_left_ "" FLOAT32_IEEE VOID_SCALING_f_S6_S3 1 100 -3.40282e+038 3.40282e+038 ECU_ADDRESS 0xFFF85324 /end MEASUREMENT
/begin MEASUREMENT SFSBo25_Unit_Delay "" FLOAT32_IEEE VOID_SCALING_f_S6_S3 1 100 -3.40282e+038 3.40282e+038 ECU_ADDRESS 0xFFF96514 /end MEASUREMENT
/begin MEASUREMENT SFSBo25_isActive_ "" UBYTE VOID_SCALING_S6_S3 1 100 0 1 ECU_ADDRESS 0xFFF8626A /end MEASUREMENT
/begin MEASUREMENT SFSBo25_t_left_ "" FLOAT32_IEEE VOID_SCALING_f_S6_S3 1 100 -3.40282e+038 3.40282e+038 ECU_ADDRESS 0xFFF85328 /end MEASUREMENT
/begin MEASUREMENT SFSBo33_Unit_Delay "" FLOAT32_IEEE VOID_SCALING_f_S6_S3 1 100 -3.40282e+038 3.40282e+038 ECU_ADDRESS 0xFFF96518 /end MEASUREMENT
/begin MEASUREMENT SFSBo33_isActive_ "" UBYTE VOID_SCALING_S6_S3 1 100 0 1 ECU_ADDRESS 0xFFF96D76 /end MEASUREMENT
/begin MEASUREMENT SFSBo33_t_left_ "" FLOAT32_IEEE VOID_SCALING_f_S6_S3 1 100 -3.40282e+038 3.40282e+038 ECU_ADDRESS 0xFFF9651C /end MEASUREMENT
/begin MEASUREMENT SFSBo34_Unit_Delay "" FLOAT32_IEEE VOID_SCALING_f_S6_S3 1 100 -3.40282e+038 3.40282e+038 ECU_ADDRESS 0xFFF96520 /end MEASUREMENT
/begin MEASUREMENT SFSBo34_isActive_ "" UBYTE VOID_SCALING_S6_S3 1 100 0 1 ECU_ADDRESS 0xFFF96D77 /end MEASUREMENT
/begin MEASUREMENT SFSBo34_t_left_ "" FLOAT32_IEEE VOID_SCALING_f_S6_S3 1 100 -3.40282e+038 3.40282e+038 ECU_ADDRESS 0xFFF96524 /end MEASUREMENT
/begin MEASUREMENT SFSBo39_Unit_Delay2 "" FLOAT32_IEEE VOID_SCALING_f_S6_S3 1 100 -3.40282e+038 3.40282e+038 ECU_ADDRESS 0xFFF96528 /end MEASUREMENT
/begin MEASUREMENT SFSBo39_x2_ "" FLOAT32_IEEE VOID_SCALING_f_S6_S3 1 100 -3.40282e+038 3.40282e+038 ECU_ADDRESS 0xFFF9652C /end MEASUREMENT
/begin MEASUREMENT SFSBo40_Unit_Delay "" FLOAT32_IEEE VOID_SCALING_f_S6_S3 1 100 -3.40282e+038 3.40282e+038 ECU_ADDRESS 0xFFF96530 /end MEASUREMENT
/begin MEASUREMENT SFSBo40_out_ "" FLOAT32_IEEE VOID_SCALING_f_S6_S3 1 100 -3.40282e+038 3.40282e+038 ECU_ADDRESS 0xFFF96534 /end MEASUREMENT
/begin MEASUREMENT SFSTA12_Unit_Delay "" FLOAT32_IEEE VOID_SCALING_f_S6_S3 1 100 -3.40282e+038 3.40282e+038 ECU_ADDRESS 0xFFF963A4 /end MEASUREMENT
/begin MEASUREMENT SFSTA12_isActive_ "" UBYTE VOID_SCALING_S6_S3 1 100 0 1 ECU_ADDRESS 0xFFF861E7 /end MEASUREMENT
/begin MEASUREMENT SFSTA12_t_left_ "" FLOAT32_IEEE VOID_SCALING_f_S6_S3 1 100 -3.40282e+038 3.40282e+038 ECU_ADDRESS 0xFFF8516C /end MEASUREMENT
/begin MEASUREMENT SSAi81_out_ "" FLOAT32_IEEE VOID_SCALING_f_S6_S3 1 100 -3.40282e+038 3.40282e+038 ECU_ADDRESS 0xFFF963B0 /end MEASUREMENT
/begin MEASUREMENT SSAi82_out_ "" FLOAT32_IEEE VOID_SCALING_f_S6_S3 1 100 -3.40282e+038 3.40282e+038 ECU_ADDRESS 0xFFF963B4 /end MEASUREMENT
/begin MEASUREMENT SSAi84_Unit_Delay1 "" UBYTE void_int_S6_S3 1 100 0 255 ECU_ADDRESS 0xFFF96D6A /end MEASUREMENT
/begin MEASUREMENT SSAi87_Unit_Delay1 "" UBYTE void_int_S6_S3 1 100 0 255 ECU_ADDRESS 0xFFF96D6B /end MEASUREMENT
/begin MEASUREMENT SSAo55_Unit_Delay "" FLOAT32_IEEE VOID_SCALING_f_S6_S3 1 100 -3.40282e+038 3.40282e+038 ECU_ADDRESS 0xFFF963C8 /end MEASUREMENT
/begin MEASUREMENT SSAo55_out_ "" FLOAT32_IEEE VOID_SCALING_f_S6_S3 1 100 -3.40282e+038 3.40282e+038 ECU_ADDRESS 0xFFF963CC /end MEASUREMENT
/begin CHARACTERISTIC SWI_K0SCHLUPFBED_PN_HAS "Schalter um die Schlupfentkopplung der K0 in PN zu erlauben in de HAS" VALUE 0x1D7612 UBYTE_COL_DIRECT_S6_S3 0 void_int_e_S6_S3 0 1 /end CHARACTERISTIC
/begin CHARACTERISTIC SWI_NTVIRTNSECIAE_AKTIV_HAS "Berechnung n_sec_iae ohne Einfluss von Sta-tus_kraftfluss_egs_in" VALUE 0x1D759B UBYTE_COL_DIRECT_S6_S3 0 void_int_e_S6_S3 0 1 /end CHARACTERISTIC
/begin CHARACTERISTIC SWI_SCHALTARTAKT_SVH_HAS "Schalter zur Aktivierung der stetigen Aktualisierung der Schaltart bei vorliegender Schaltanforderung im Modul Schaltverhinderung der HAS" VALUE 0x1D7616 UBYTE_COL_DIRECT_S6_S3 0 void_int_e_S6_S3 0 1 /end CHARACTERISTIC
/begin CHARACTERISTIC TAB_K0SCHLUPFBED_IAE_HAS "Tabelle um die Schlupfentkopplung der K0 in Abhängigkeit des IAE-Status zu erlauben in der HAS" VAL_BLK 0x1D75EA UBYTE_COL_DIRECT_S6_S3 0 void_int_S6_S3 0 1 MATRIX_DIM 9 1 1 /end CHARACTERISTIC
/begin CHARACTERISTIC TAB_PMAX_IEP_HAS "Maximaler Systemdruck abhängig vom Zustand der IEP" VAL_BLK 0x1978A8 FLOAT32_IEEE_COL_DIRECT_S6_S3 0 p_fl_S6_S3 0 30 MATRIX_DIM 5 1 1 /end CHARACTERISTIC
/begin CHARACTERISTIC TAB_TVSVHRESET_SVH_HAS "Verzögerungszeit zum Rücksetzen der Schaltverhinderung der HAS nach einem Ablauf in Abhängigkeit des Ziel-Betriebszustands der HAS (st_ziel_bz_has_stg)" VAL_BLK 0x197904 FLOAT32_IEEE_COL_DIRECT_S6_S3 0 t_fl_S6_S3 0 2.5 MATRIX_DIM 9 1 1 /end CHARACTERISTIC
/begin CHARACTERISTIC TAB_UEBERSETZUNGEN_EGS "Übersetungen des 8P Zentralteils" VAL_BLK 0x1975C0 FLOAT32_IEEE_COL_DIRECT_S6_S3 0 void_fl_S6_S3 -3.40282e+038 3.40282e+038 MATRIX_DIM 10 1 1 /end CHARACTERISTIC
/begin CHARACTERISTIC TAB_ZK0FSTSBE_HAS "Tabelle zur Umcodierung der Werte, die von der Fahrstrategie kommen" VAL_BLK 0x197968 UBYTE_COL_DIRECT_S6_S3 0 void_int_S6_S3 3 5 MATRIX_DIM 4 1 1 /end CHARACTERISTIC
/begin CHARACTERISTIC T_0MAX_ANS "Max-Timer in Phase Schaltung Aktiv (100)" VALUE 0x1D1A8C FLOAT32_IEEE_COL_DIRECT_S6_S3 0 t_fl_S6_S3 -3.40282e+038 3.40282e+038 /end CHARACTERISTIC
/begin CHARACTERISTIC T_10MAX_ANS "Maximalzeit im Zustand SLST Abbr." VALUE 0x1D1A90 FLOAT32_IEEE_COL_DIRECT_S6_S3 0 t_fl_S6_S3 0 10 /end CHARACTERISTIC
/begin CHARACTERISTIC T_1MAX_ANS "Zeit für Füllausgleichsphase K0" VALUE 0x1D1A94 FLOAT32_IEEE_COL_DIRECT_S6_S3 0 t_fl_S6_S3 -3.40282e+038 3.40282e+038 /end CHARACTERISTIC
/begin CHARACTERISTIC T_1MAX_DRS "" VALUE 0x1D18C0 FLOAT32_IEEE_COL_DIRECT_S6_S3 0 t_fl_S6_S3 -3.40282e+038 3.40282e+038 /end CHARACTERISTIC
/begin CHARACTERISTIC T_2MAX_ANS "Maximalzeit im Zustand St_Anschleppen_Ans" VALUE 0x1D1AA0 FLOAT32_IEEE_COL_DIRECT_S6_S3 0 t_fl_S6_S3 -3.40282e+038 3.40282e+038 /end CHARACTERISTIC
/begin CHARACTERISTIC T_2MAX_DRS "" VALUE 0x1D18C4 FLOAT32_IEEE_COL_DIRECT_S6_S3 0 t_fl_S6_S3 -3.40282e+038 3.40282e+038 /end CHARACTERISTIC
/begin CHARACTERISTIC T_2MIN_ANS "Mindestzeit zum Verbleib in VM_zuenden" VALUE 0x1D1AA4 FLOAT32_IEEE_COL_DIRECT_S6_S3 0 t_fl_S6_S3 -3.40282e+038 3.40282e+038 /end CHARACTERISTIC
/begin CHARACTERISTIC T_2MK0OFFSET_ANS "Timer Ausloesen einer Notanschlepprampe K0" VALUE 0x1D1AA8 FLOAT32_IEEE_COL_DIRECT_S6_S3 0 t_fl_S6_S3 0 1 /end CHARACTERISTIC
/begin CHARACTERISTIC T_3MAX_ANS "Maximalzeit im Zustand St_VM_zuenden_En_St" VALUE 0x1D1AAC FLOAT32_IEEE_COL_DIRECT_S6_S3 0 t_fl_S6_S3 -3.40282e+038 3.40282e+038 /end CHARACTERISTIC
/begin CHARACTERISTIC T_4MAX_ANS "Maximalzeit im Zustand St_K0_Synchronisieren_En_St" VALUE 0x1D1AB0 FLOAT32_IEEE_COL_DIRECT_S6_S3 0 t_fl_S6_S3 -3.40282e+038 3.40282e+038 /end CHARACTERISTIC
/begin CHARACTERISTIC T_5MAX_ANS "Maximalzeit im Zustand St_K0_Schliessen_En_St" VALUE 0x1D1AB4 FLOAT32_IEEE_COL_DIRECT_S6_S3 0 t_fl_S6_S3 -3.40282e+038 3.40282e+038 /end CHARACTERISTIC
/begin CHARACTERISTIC T_K0SREGBASISMAX_SYN_ANK "Maximalzeit zum Setzen der Basisbedin-gung zur Aktivierung der K0-Schlupfregelung im Zustand K0 Synchronisieren beim Ankoppeln" VALUE 0x1D0F64 FLOAT32_IEEE_COL_DIRECT_S6_S3 0 t_fl_S6_S3 0 10 /end CHARACTERISTIC
/begin CHARACTERISTIC T_K0SREGBASISMAX_SYN_ZUS "Maximalzeit zum Setzen der Basisbedingung zur Aktivierung der K0-Schlupfregelung im Zustand K0 Synchronisieren beim Zustart" VALUE 0x1D5EDC FLOAT32_IEEE_COL_DIRECT_S6_S3 0 t_fl_S6_S3 0 10 /end CHARACTERISTIC
/begin CHARACTERISTIC T_MAX_ABB_ANK "Maximale Verweildauer im Zustand 'Ankoppeln Abbruch' beim Ankoppeln" VALUE 0x1D0F68 FLOAT32_IEEE_COL_DIRECT_S6_S3 0 t_fl_S6_S3 0 10 /end CHARACTERISTIC
/begin CHARACTERISTIC T_MAX_ABB_NOS "Maximale Verweildauer im Zustand Abbruch beim Notstart" VALUE 0x1D1928 FLOAT32_IEEE_COL_DIRECT_S6_S3 0 t_fl_S6_S3 0 10 /end CHARACTERISTIC
/begin CHARACTERISTIC T_MAX_ABB_ZUS "Maximale Verweildauer im Zustand Abbruch beim Zustart" VALUE 0x1D5EE0 FLOAT32_IEEE_COL_DIRECT_S6_S3 0 t_fl_S6_S3 0 10 /end CHARACTERISTIC
/begin CHARACTERISTIC T_MAX_EMAKTIV_FUW_ZUS "Maximale Dauer der Überwachung der EM Reaktion der Funktionsüberwachung der EM Funktion beim Zustartt" VALUE 0x1D5EE4 FLOAT32_IEEE_COL_DIRECT_S6_S3 0 t_fl_S6_S3 0 5000 /end CHARACTERISTIC
/begin CHARACTERISTIC T_MAX_NST_NOS "maximale Verweildauer im Zustand Notstarten (151)" VALUE 0x1D192C FLOAT32_IEEE_COL_DIRECT_S6_S3 0 t_fl_S6_S3 0 10 /end CHARACTERISTIC
/begin CHARACTERISTIC T_MAX_SAK_ANK "Max. Verweildauer im Zustand Schaltung_aktiv beim Ankoppeln" VALUE 0x1D0F6C FLOAT32_IEEE_COL_DIRECT_S6_S3 0 t_fl_S6_S3 0 10 /end CHARACTERISTIC
/begin CHARACTERISTIC T_MAX_SAK_ZUS "Max-Timer in Phase Schaltung Aktiv (100)" VALUE 0x1D5EE8 FLOAT32_IEEE_COL_DIRECT_S6_S3 0 t_fl_S6_S3 0 10 /end CHARACTERISTIC
/begin CHARACTERISTIC T_MAX_SCL_ANK "Max. Verweildauer im Zustand K0-Schliessen beim Ankoppeln" VALUE 0x1D0F70 FLOAT32_IEEE_COL_DIRECT_S6_S3 0 t_fl_S6_S3 0 10 /end CHARACTERISTIC
/begin CHARACTERISTIC T_MAX_SCL_NOS "maximale Verweildauer im Zustand K0-Schliessen (152)" VALUE 0x1D1930 FLOAT32_IEEE_COL_DIRECT_S6_S3 0 t_fl_S6_S3 0 10 /end CHARACTERISTIC
/begin CHARACTERISTIC T_MAX_SCL_ZUS "Maximale Verweildauer im Zustand K0 Schliessen im Zustand Zustart" VALUE 0x1D5EEC FLOAT32_IEEE_COL_DIRECT_S6_S3 0 t_fl_S6_S3 0 10 /end CHARACTERISTIC
/begin CHARACTERISTIC T_MK0MODZIEL_SCL_ANK "Dauer der Berücksichtigung des K0 Istmoments als Zielmoment für das modi-fizierte K0 Ist-Moment beim K0-Schliessen beim Ankoppeln" VALUE 0x1D0F74 FLOAT32_IEEE_COL_DIRECT_S6_S3 0 t_fl_S6_S3 0 10 /end CHARACTERISTIC
/begin CHARACTERISTIC T_MK0MODZIEL_SCL_ZUS "Dauer der Berücksichtigung des K0-Istmoments als Zielmoment für das modifizierte K0-Sollmoment beim K0-Schliessen beim Zustart" VALUE 0x1D5EF0 FLOAT32_IEEE_COL_DIRECT_S6_S3 0 t_fl_S6_S3 0 10 /end CHARACTERISTIC
/begin CHARACTERISTIC T_MSOLLEMAKTIVMAX_ZUS "Maximalzeit der Ausgabe des K0-Störmoments der EM-Ansteuerung beim Zustart" VALUE 0x1D5EF4 FLOAT32_IEEE_COL_DIRECT_S6_S3 0 t_fl_S6_S3 0 10 /end CHARACTERISTIC
/begin CHARACTERISTIC T_MSOLLEMAKTIV_ANS "Überwachung Ausgabe m_soll_em_has (Max.-Zeit)" VALUE 0x1D1AB8 FLOAT32_IEEE_COL_DIRECT_S6_S3 0 t_fl_S6_S3 -3.40282e+038 3.40282e+038 /end CHARACTERISTIC
/begin CHARACTERISTIC T_MSOLLEMHST_HAS "Verzögerungszeit des EM Sollmoment der HST für die Berechnung des Fahrerwunschmoments der HST" VALUE 0x1975AC FLOAT32_IEEE_COL_DIRECT_S6_S3 0 t_fl_S6_S3 -3.40282e+038 3.40282e+038 /end CHARACTERISTIC
/begin CHARACTERISTIC T_MSOLLK0ANSTMAX_SCL_ANK "Timer zur Überwachung der max. Dauer der K0-Ansteuerung HAS beim K0-Schliessen" VALUE 0x1D0F78 FLOAT32_IEEE_COL_DIRECT_S6_S3 0 t_fl_S6_S3 -3.40282e+038 3.40282e+038 /end CHARACTERISTIC
/begin CHARACTERISTIC T_MSOLLK0ANSTMAX_SCL_ZUS "Maximale Dauer der K0-Ansteuerung HAS beim K0-Schliessen im Zustand K0 Schliessen beim Zustart" VALUE 0x1D5EF8 FLOAT32_IEEE_COL_DIRECT_S6_S3 0 t_fl_S6_S3 0 10 /end CHARACTERISTIC
/begin CHARACTERISTIC T_MSOLLVMHST_HAS "Verzögerungszeit des VM Sollmoment der HST für die Berechnung des Fahrerwunschmoments der HST" VALUE 0x1975B0 FLOAT32_IEEE_COL_DIRECT_S6_S3 0 t_fl_S6_S3 -3.40282e+038 3.40282e+038 /end CHARACTERISTIC
/begin CHARACTERISTIC T_NDG "Filterzeit Differenzdrehzahlgradient" VALUE 0x1D1ABC FLOAT32_IEEE_COL_DIRECT_S6_S3 0 t_fl_S6_S3 -3.40282e+038 3.40282e+038 /end CHARACTERISTIC
/begin CHARACTERISTIC T_NDGK0K0SREGMIN_SYN_ANK "Mindestdauer bei der Abfrage des K0-Differenzdrehzahlgradienten zur Bestimmung des Zeitpunkt der Anforderung der Aktivierung der K0-Schlupfregelung im Zustand K0 Synchronisieren beim Ankoppeln" VALUE 0x1D0F7C FLOAT32_IEEE_COL_DIRECT_S6_S3 0 t_fl_S6_S3 0 5 /end CHARACTERISTIC
/begin CHARACTERISTIC T_NDGK0K0SREGMIN_SYN_ZUS "Mindestdauer bei der Abfrage des K0-Differenzdrehzahlgradienten zur Bestimmung des Zeitpunkt der Anforderung der Aktivierung der K0-Schlupfregelung im Zustand K0 Synchronisieren beim Zustart" VALUE 0x1D5EFC FLOAT32_IEEE_COL_DIRECT_S6_S3 0 t_fl_S6_S3 0 5 /end CHARACTERISTIC
/begin CHARACTERISTIC T_NDSK0_NST_NOS "minimale Verweildauer, in der die K0-Differenzdrehzahl unterhalb einer applizierbaren Schwelle ist; im Zustand Notstarten (151)" VALUE 0x1D1934 FLOAT32_IEEE_COL_DIRECT_S6_S3 0 t_fl_S6_S3 0 10 /end CHARACTERISTIC
/begin CHARACTERISTIC T_NGSVMK0OEFFNEN_AST_ABST "Verzögerungszeit zur Abfrage der VM Drehzahlgradientenschwelle zur Vorgabe K0 OEFFNENSW im Zustand VM-Abstellen beim VM Abstellen" VALUE 0x1D0DB8 FLOAT32_IEEE_COL_DIRECT_S6_S3 0 t_fl_S6_S3 0 10 /end CHARACTERISTIC
/begin CHARACTERISTIC T_NMINEMBEFUELLFZP_LLS_HAS "Zeit für die Ausgabe einer EM Mindrehzahl zur Befuellung des Ansaugkanals der FZP" VALUE 0x197A70 FLOAT32_IEEE_COL_DIRECT_S6_S3 0 t_fl_S6_S3 0 5 /end CHARACTERISTIC
/begin CHARACTERISTIC T_NVMAUSERK_AST_VMA "Dauer zur Abfrage der VM-Drehzahlschwelle zur Erkennung VM aus im Zustand VM-Abstellen der Hybridfunktion VM aus" VALUE 0x1D5D48 FLOAT32_IEEE_COL_DIRECT_S6_S3 0 t_fl_S6_S3 0 10 /end CHARACTERISTIC
/begin CHARACTERISTIC T_NVMEINERK_ZST_VME "Dauer zur Abfrage der VM-Drehzahlschwelle zur Erkennung VM läuft im Zustand Zustarten der Hybridfunktion VM ein" VALUE 0x1D5D50 FLOAT32_IEEE_COL_DIRECT_S6_S3 0 t_fl_S6_S3 0 10 /end CHARACTERISTIC
/begin CHARACTERISTIC T_PT1NSOLLEM_DRS "Filterzeitkonstante für Solldrehzahl EM" VALUE 0x1D18C8 FLOAT32_IEEE_COL_DIRECT_S6_S3 0 t_fl_S6_S3 -3.40282e+038 3.40282e+038 /end CHARACTERISTIC
/begin CHARACTERISTIC T_STATUSIAE_PLAUS_ANS "Zeit zur Anfilterung für nicht erreichten 
IAE-Schlupf nd_iae bei 
status_iae_in = 4 (IAE entkoppelt)" VALUE 0x1D1AC0 FLOAT32_IEEE_COL_DIRECT_S6_S3 0 t_fl_S6_S3 0 2 /end CHARACTERISTIC
/begin CHARACTERISTIC T_STATUSWECHSELIAE_ANS "Verzögerungszeit bis Entkopplungsanfrage zurueckgenommen wird" VALUE 0x1D1AC4 FLOAT32_IEEE_COL_DIRECT_S6_S3 0 t_fl_S6_S3 -3.40282e+038 3.40282e+038 /end CHARACTERISTIC
/begin CHARACTERISTIC T_TESTABLVAR_ANS "TEST: Zeit des Timers" VALUE 0x1D1AC8 FLOAT32_IEEE_COL_DIRECT_S6_S3 0 t_fl_S6_S3 -3.40282e+038 3.40282e+038 /end CHARACTERISTIC
/begin CHARACTERISTIC T_UMS_NST_NOS "maximale Umschaltdauer im Zustand Notstarten (151)" VALUE 0x1D1938 FLOAT32_IEEE_COL_DIRECT_S6_S3 0 t_fl_S6_S3 0 10 /end CHARACTERISTIC
/begin CHARACTERISTIC T_VBRE_ABS_MSA_HAS "Verzögerungszeit zur Deaktivierung der Beeinflussung der MSA-Funktionalität bei aktiven ABS-/ESP-Regelzuständen beim Bremsen" VALUE 0x197A7C FLOAT32_IEEE_COL_DIRECT_S6_S3 0 t_fl_S6_S3 0 5 /end CHARACTERISTIC
/begin CHARACTERISTIC T_VK0BEFKALTNEM_ZST_ZUS "Verzögerungszeit zur Sicherstellung der Ölversorgung zur Befüllung der K0 bei einem Kaltstart-Ablauf mit abgesenkter EM-Drehzahl im Zustand Zustarten beim Zustart" VALUE 0x1D5F00 FLOAT32_IEEE_COL_DIRECT_S6_S3 0 t_fl_S6_S3 0 5 /end CHARACTERISTIC
/begin CHARACTERISTIC T_VK0SREGAKTIV_SYN_ANK "Verzögerungszeit zur Aktivierung der K0-Schlupfregelung nach Eintritt in den Zustand K0 Synchronisieren beim Ankoppeln" VALUE 0x1D0F80 FLOAT32_IEEE_COL_DIRECT_S6_S3 0 t_fl_S6_S3 0 5 /end CHARACTERISTIC
/begin CHARACTERISTIC T_VK0SREGAKTIV_SYN_ZUS "Verzögerungszeit zur Aktivierung der K0-Schlupfregelung nach Eintritt in den Zustand K0 Synchronisieren beim Zustart" VALUE 0x1D5F04 FLOAT32_IEEE_COL_DIRECT_S6_S3 0 t_fl_S6_S3 0 5 /end CHARACTERISTIC
/begin CHARACTERISTIC T_VK0SYNCERK_SYN_ANK "Verzögerungszeit der K0-Synchron-Erkennung im Zustand K0 Synchronisieren beim Ankoppeln" VALUE 0x1D0F84 FLOAT32_IEEE_COL_DIRECT_S6_S3 0 t_fl_S6_S3 0 10 /end CHARACTERISTIC
/begin CHARACTERISTIC T_VK0SYNCERK_SYN_ZUS "Timer zur K0 Synchronerkennung im Zustand K0 Synchronisieren beim Zustart" VALUE 0x1D5F08 FLOAT32_IEEE_COL_DIRECT_S6_S3 0 t_fl_S6_S3 0 10 /end CHARACTERISTIC
/begin CHARACTERISTIC T_VMDZIELSOLLK0_SYN_ANK "Verzögerungszeit zur Init. der VM-Solldrehzahl bei geringer Momentdif. zwischen K0" VALUE 0x1D0F88 FLOAT32_IEEE_COL_DIRECT_S6_S3 0 t_fl_S6_S3 0 5 /end CHARACTERISTIC
/begin CHARACTERISTIC T_VMDZIELSOLLK0_SYN_ZUS "Verzögerungszeit zur Initialisierung der VM Solldrehzahl beim K0 Synchronisieren beim Zustart" VALUE 0x1D5F10 FLOAT32_IEEE_COL_DIRECT_S6_S3 0 t_fl_S6_S3 0 5 /end CHARACTERISTIC
/begin CHARACTERISTIC T_VMSTATUSMAX_ABF_ZUS "Maximalzeit der Beruecksichtigung der Anzeige VM selbstlauffaehig als Uebergangsbedingung nach K0- Synchronisieren im Zustand VM-Abfangen beim Zustart" VALUE 0x1D5F14 FLOAT32_IEEE_COL_DIRECT_S6_S3 0 t_fl_S6_S3 0 5 /end CHARACTERISTIC
/begin CHARACTERISTIC T_VMSTATUSMAX_ANH_ZUS "Maximalzeit der Beruecksichtigung der Anzeige VM selbstlauffaehig als Uebergangsbedingung nach K0- Synchronisieren im Zustand VM-Drehzahlanhebung beim Zustart" VALUE 0x1D5F18 FLOAT32_IEEE_COL_DIRECT_S6_S3 0 t_fl_S6_S3 0 5 /end CHARACTERISTIC
/begin CHARACTERISTIC T_VNEMNDK0_HAS "Verzögerungszeit der EM-Drehzahl für die Berechnung der K0-Differenzdrehzahl" VALUE 0x197648 FLOAT32_IEEE_COL_DIRECT_S6_S3 0 t_fl_S6_S3 0 0.15 /end CHARACTERISTIC
/begin CHARACTERISTIC T_VNVMNDK0_HAS "Verzögerungszeit der VM-Drehzahl für die Berechnung der K0-Differenzdrehzahl" VALUE 0x197650 FLOAT32_IEEE_COL_DIRECT_S6_S3 0 t_fl_S6_S3 0 0.15 /end CHARACTERISTIC
/begin CHARACTERISTIC T_VORSYNC "Zeitschwelle Differenzdrehzahl vor Synchron" VALUE 0x1D1ACC FLOAT32_IEEE_COL_DIRECT_S6_S3 0 t_fl_S6_S3 -3.40282e+038 3.40282e+038 /end CHARACTERISTIC
/begin CHARACTERISTIC T_VRUECKGELSAS_MSA_HAS "Verzögerungszeit zur Ruecknahme der Beeinflussung der MSA-Funktionalität bei aktivem Schaltablauf beim Gangeinlegen" VALUE 0x197A84 FLOAT32_IEEE_COL_DIRECT_S6_S3 0 t_fl_S6_S3 0 10 /end CHARACTERISTIC
/begin CHARACTERISTIC T_VZABLAUFREINIT_HAS "Verzögerungszeit zur Bestimmung des Soll-Betriebszustands der Hybrid-Zustandssteuerung bei Anforderung eines Neustarts durch die HAS Diagnose" VALUE 0x197594 FLOAT32_IEEE_COL_DIRECT_S6_S3 0 t_fl_S6_S3 0 1 /end CHARACTERISTIC
/begin CHARACTERISTIC T_VZMGK0_ANS "Verzögerungsteit für den Kupplungsgradient zum Anschleppen" VALUE 0x1D1AD0 FLOAT32_IEEE_COL_DIRECT_S6_S3 0 t_fl_S6_S3 -3.40282e+038 3.40282e+038 /end CHARACTERISTIC
/begin CHARACTERISTIC T_ZIEPHASAKTIV_BFI_HAS "Zeitraum nach Erkennung der Betriebsbereitschaft des Hybridsystems in dem die Beeinflussung der IEP durch die HAS aktiv ist" VALUE 0x197A88 FLOAT32_IEEE_COL_DIRECT_S6_S3 0 t_fl_S6_S3 0 5 /end CHARACTERISTIC
/begin CHARACTERISTIC T_ZIEPHASMAX_BFI_HAS "Maximaler Zeitraum nach Erkennung der Betriebsbereitschaft des Hybridsystems in dem die Beeinflussung der IEP durch die HAS aktiv ist" VALUE 0x197A8C FLOAT32_IEEE_COL_DIRECT_S6_S3 0 t_fl_S6_S3 0 500 /end CHARACTERISTIC
/begin CHARACTERISTIC T_ZSASHASAKTIV_BBR_HAS "Zeitraum nach Erkennung der Betriebsbereitschaft des Hybridsystems, in dem die Beeinflussung der SAS Befüllreihenfolge durch die HAS bestätigt werden muss" VALUE 0x197A90 FLOAT32_IEEE_COL_DIRECT_S6_S3 0 t_fl_S6_S3 0 5 /end CHARACTERISTIC
/begin CHARACTERISTIC XP_MAX "" VALUE 0x197664 FLOAT32_IEEE_COL_DIRECT_S6_S3 0 void_fl_S6_S3 -3.40282e+038 3.40282e+038 /end CHARACTERISTIC
/begin MEASUREMENT abstellpos_vm_in "Abstellposition VM vor nächstem ZOT" UBYTE void_int_S6_S3 1 100 0 180 ECU_ADDRESS 0xFFF86698 /end MEASUREMENT
/begin MEASUREMENT abstellpos_vm_status_in "Status Abstellposition VM" UBYTE void_int_S6_S3 1 100 0 2 ECU_ADDRESS 0xFFF86699 /end MEASUREMENT
/begin MEASUREMENT c_getriebe_egs_in "" FLOAT32_IEEE c_int_S6_S3 1 100 -40 215 ECU_ADDRESS 0xFFF85DDC /end MEASUREMENT
/begin MEASUREMENT c_vm_in "" FLOAT32_IEEE c_int_S6_S3 1 100 -3.40282e+038 3.40282e+038 ECU_ADDRESS 0xFFF85E38 /end MEASUREMENT
/begin MEASUREMENT gangwechsel_egs_in "Flag während laufender Schaltung, bei synchron verlassen bis synchron erreicht" UBYTE void_int_S6_S3 1 100 0 1 ECU_ADDRESS 0xFFF86677 /end MEASUREMENT
/begin MEASUREMENT i_istgang_egs "" FLOAT32_IEEE void_fl_S6_S3 1 100 0 8 ECU_ADDRESS 0xFFF85D8C /end MEASUREMENT
/begin MEASUREMENT i_zielgang_egs "" FLOAT32_IEEE void_fl_S6_S3 1 100 0 8 ECU_ADDRESS 0xFFF85D90 /end MEASUREMENT
/begin MEASUREMENT init_anfiae_aktiv_ans "Trigger zur Aktivierung des Gradientenbegrenzer" UBYTE void_int_S6_S3 1 100 0 1 ECU_ADDRESS 0xFFF96DC2 /end MEASUREMENT
/begin MEASUREMENT init_nsollem_grad_ans "Initflag zur Initi. des Gradientenbegrenzer für die Ber. n_soll_em" UBYTE void_int_S6_S3 1 100 0 255 ECU_ADDRESS 0xFFF96DC3 /end MEASUREMENT
/begin MEASUREMENT istgang_egs_in "" SBYTE void_int_S6_S3 1 100 -128 127 ECU_ADDRESS 0xFFF86678 /end MEASUREMENT
/begin MEASUREMENT m_em_in "" FLOAT32_IEEE trq_fl_a_S6_S3 1 100 -1024 1024 ECU_ADDRESS 0xFFF85DE0 /end MEASUREMENT
/begin MEASUREMENT m_iae_in "" FLOAT32_IEEE trq_fl_a_S6_S3 1 100 -32768 32767 ECU_ADDRESS 0xFFF85DE4 /end MEASUREMENT
/begin MEASUREMENT m_k0_fkt "" FLOAT32_IEEE trq_fl_a_S6_S3 1 100 -1200 1200 ECU_ADDRESS 0xFFF85D48 /end MEASUREMENT
/begin MEASUREMENT m_k0_in "" FLOAT32_IEEE trq_fl_a_S6_S3 1 100 -32768 32767 ECU_ADDRESS 0xFFF85DE8 /end MEASUREMENT
/begin MEASUREMENT m_k0_mber_has_sbe "K0-Moment der HAS zur Motormomentbegrenzung in der SAB" FLOAT32_IEEE trq_fl_a_S6_S3 1 100 -3.40282e+038 3.40282e+038 ECU_ADDRESS 0xFFF85DC4 /end MEASUREMENT
/begin MEASUREMENT m_k0_mber_zus_gbegr "Gradientenbegrenzter Basiswert des K0 Moments beim Zustart zur Bestimmung des K0-Moments der HAS zur Motormomentbegrenzung in der SAB" FLOAT32_IEEE trq_fl_a_S6_S3 1 100 -3.40282e+038 3.40282e+038 ECU_ADDRESS 0xFFF9653C /end MEASUREMENT
/begin MEASUREMENT m_k0_mod_has_fkt "" FLOAT32_IEEE trq_fl_a_S6_S3 1 100 -1200 1200 ECU_ADDRESS 0xFFF85D4C /end MEASUREMENT
/begin MEASUREMENT m_max_dyn_em_in "" FLOAT32_IEEE trq_fl_a_S6_S3 1 100 -32768 32767 ECU_ADDRESS 0xFFF85DEC /end MEASUREMENT
/begin MEASUREMENT m_max_em_has_fkt "" FLOAT32_IEEE trq_fl_a_S6_S3 1 100 -1200 1200 ECU_ADDRESS 0xFFF85D50 /end MEASUREMENT
/begin MEASUREMENT m_max_iae_has_fkt "" FLOAT32_IEEE trq_fl_a_S6_S3 1 100 -1200 1200 ECU_ADDRESS 0xFFF85D54 /end MEASUREMENT
/begin MEASUREMENT m_min_dyn_em_in "" FLOAT32_IEEE trq_fl_a_S6_S3 1 100 -3.40282e+038 3.40282e+038 ECU_ADDRESS 0xFFF85DF0 /end MEASUREMENT
/begin MEASUREMENT m_min_em_has_fkt "" FLOAT32_IEEE trq_fl_a_S6_S3 1 100 -1200 1200 ECU_ADDRESS 0xFFF85D58 /end MEASUREMENT
/begin MEASUREMENT m_min_vm_in "" FLOAT32_IEEE trq_fl_a_S6_S3 1 100 -3.40282e+038 3.40282e+038 ECU_ADDRESS 0xFFF85E3C /end MEASUREMENT
/begin MEASUREMENT m_mot_in "" FLOAT32_IEEE trq_fl_a_S6_S3 1 100 -1024 1024 ECU_ADDRESS 0xFFF85DF4 /end MEASUREMENT
/begin MEASUREMENT m_motmax_has "" FLOAT32_IEEE trq_fl_a_S6_S3 1 100 -1200 1200 ECU_ADDRESS 0xFFF85DC8 /end MEASUREMENT
/begin MEASUREMENT m_soll_em_has_fkt "" FLOAT32_IEEE trq_fl_a_S6_S3 1 100 -1200 1200 ECU_ADDRESS 0xFFF85D5C /end MEASUREMENT
/begin MEASUREMENT m_soll_em_hst_in "" FLOAT32_IEEE trq_fl_a_S6_S3 1 100 -32768 32767 ECU_ADDRESS 0xFFF85DF8 /end MEASUREMENT
/begin MEASUREMENT m_soll_k0_has_fkt "" FLOAT32_IEEE trq_fl_a_S6_S3 1 100 -1200 1200 ECU_ADDRESS 0xFFF85D60 /end MEASUREMENT
/begin MEASUREMENT m_soll_k0_ziel_nos_mess "Zielwert des K0-Sollmoments m_soll_k0_has" FLOAT32_IEEE trq_fl_a_S6_S3 1 100 -3.40282e+038 3.40282e+038 ECU_ADDRESS 0xFFF96834 /end MEASUREMENT
/begin MEASUREMENT m_soll_res_em_bas_sbe "" FLOAT32_IEEE trq_fl_a_S6_S3 1 100 -3.40282e+038 3.40282e+038 ECU_ADDRESS 0xFFF85DCC /end MEASUREMENT
/begin MEASUREMENT m_soll_res_em_has_fkt "" FLOAT32_IEEE trq_fl_a_S6_S3 1 100 -1200 1200 ECU_ADDRESS 0xFFF85D64 /end MEASUREMENT
/begin MEASUREMENT m_soll_res_em_has_sbe "" FLOAT32_IEEE trq_fl_a_S6_S3 1 100 -3.40282e+038 3.40282e+038 ECU_ADDRESS 0xFFF85DD0 /end MEASUREMENT
/begin MEASUREMENT m_soll_vm_has_fkt "" FLOAT32_IEEE trq_fl_a_S6_S3 1 100 -1200 1200 ECU_ADDRESS 0xFFF85D68 /end MEASUREMENT
/begin MEASUREMENT m_soll_vm_hst_in "" FLOAT32_IEEE trq_fl_a_S6_S3 1 100 -32768 32767 ECU_ADDRESS 0xFFF85DFC /end MEASUREMENT
/begin MEASUREMENT m_soll_vm_l_has_fkt "" FLOAT32_IEEE trq_fl_a_S6_S3 1 100 -1200 1200 ECU_ADDRESS 0xFFF85D6C /end MEASUREMENT
/begin MEASUREMENT m_soll_vm_l_hst_in "" FLOAT32_IEEE trq_fl_a_S6_S3 1 100 -3.40282e+038 3.40282e+038 ECU_ADDRESS 0xFFF85E40 /end MEASUREMENT
/begin MEASUREMENT m_sollk0has_nverz_mes "Gem. in Output vor CDelay" FLOAT32_IEEE trq_fl_a_S6_S3 1 100 -3.40282e+038 3.40282e+038 ECU_ADDRESS 0xFFF969DC /end MEASUREMENT
/begin MEASUREMENT m_vm_in "" FLOAT32_IEEE trq_fl_a_S6_S3 1 100 -1024 1023.5 ECU_ADDRESS 0xFFF85E00 /end MEASUREMENT
/begin MEASUREMENT m_vm_start_in "" FLOAT32_IEEE trq_fl_a_S6_S3 1 100 -1024 1023.5 ECU_ADDRESS 0xFFF85E04 /end MEASUREMENT
/begin MEASUREMENT m_wunsch_fpw_hst_fil "" FLOAT32_IEEE trqg_fl_c_S6_S3 1 100 -2000 2000 ECU_ADDRESS 0xFFF85D94 /end MEASUREMENT
/begin MEASUREMENT m_wunsch_fpw_hst_fil_azg "AZG-Grösse für m_wunsch_fpw_hst_fil" FLOAT32_IEEE trq_fl_a_S6_S3 1 100 -32767 32767 ECU_ADDRESS 0xFFF96474 /end MEASUREMENT
/begin MEASUREMENT m_wunsch_fpw_hst_in "" FLOAT32_IEEE trq_fl_a_S6_S3 1 100 -3.40282e+038 3.40282e+038 ECU_ADDRESS 0xFFF85E44 /end MEASUREMENT
/begin MEASUREMENT m_wunsch_fpw_in "" FLOAT32_IEEE trq_fl_a_S6_S3 1 100 -32768 32767 ECU_ADDRESS 0xFFF85E08 /end MEASUREMENT
/begin MEASUREMENT mg_k0_mod_max_ank "Max. Gradienten des mod. K0-Moments der HAS beim K0-Schliessen beim Ankoppeln" FLOAT32_IEEE trqg_fl_c_S6_S3 1 100 0 50000 ECU_ADDRESS 0xFFF96754 /end MEASUREMENT
/begin MEASUREMENT mg_k0_mod_max_zus "Maximaler Gradient des modifizierten K0-Moments der HAS im K0 Schliessen beim Zustart" FLOAT32_IEEE trqg_fl_c_S6_S3 1 100 0 50000 ECU_ADDRESS 0xFFF85B6C /end MEASUREMENT
/begin MEASUREMENT mg_max_em_has_fkt "" FLOAT32_IEEE trqg_fl_c_S6_S3 1 100 -3000 3000 ECU_ADDRESS 0xFFF85D70 /end MEASUREMENT
/begin MEASUREMENT mg_min_em_has_fkt "" FLOAT32_IEEE trqg_fl_c_S6_S3 1 100 -3000 3000 ECU_ADDRESS 0xFFF85D74 /end MEASUREMENT
/begin MEASUREMENT mg_soll_K0_fkt "" FLOAT32_IEEE trqg_fl_c_S6_S3 1 100 -3000 3000 ECU_ADDRESS 0xFFF85D78 /end MEASUREMENT
/begin MEASUREMENT mg_soll_k0_has_fkt "" FLOAT32_IEEE trqg_fl_c_S6_S3 1 100 -3000 3000 ECU_ADDRESS 0xFFF85D7C /end MEASUREMENT
/begin MEASUREMENT mg_soll_k0_max_ank "Max. Gradienten des K0-Sollmoments der HAS beim K0-Schliessen beim Ankoppeln" FLOAT32_IEEE trqg_fl_c_S6_S3 1 100 0 50000 ECU_ADDRESS 0xFFF96758 /end MEASUREMENT
/begin MEASUREMENT mg_soll_k0_max_zus "Maximaler Gradient des K0-Soll-Moments der HAS im K0 Schliessen beim Zustart" FLOAT32_IEEE trqg_fl_c_S6_S3 1 100 -3.40282e+038 3.40282e+038 ECU_ADDRESS 0xFFF96C5C /end MEASUREMENT
/begin MEASUREMENT mg_soll_k0_syn_ank "Gradient des K0-Sollmoments beim K0 Synchronisieren beim Ankoppeln" FLOAT32_IEEE trqg_fl_c_S6_S3 1 100 -3.40282e+038 3.40282e+038 ECU_ADDRESS 0xFFF9675C /end MEASUREMENT
/begin MEASUREMENT mg_soll_k0_syn_zus "Gradient des K0-Soll-Moments im K0 Synchronisieren beim Zustart" FLOAT32_IEEE trqg_fl_c_S6_S3 1 100 -3.40282e+038 3.40282e+038 ECU_ADDRESS 0xFFF96C60 /end MEASUREMENT
/begin MEASUREMENT mg_wunsch_fpw "" FLOAT32_IEEE trqg_fl_c_S6_S3 1 100 -2000 2000 ECU_ADDRESS 0xFFF85D98 /end MEASUREMENT
/begin MEASUREMENT mg_wunsch_fpw_hst "" FLOAT32_IEEE trqg_fl_c_S6_S3 1 100 -2000 2000 ECU_ADDRESS 0xFFF85D9C /end MEASUREMENT
/begin MEASUREMENT mod_K0_fkt "" UBYTE void_int_S6_S3 1 100 0 50 ECU_ADDRESS 0xFFF8663A /end MEASUREMENT
/begin MEASUREMENT n_ab_egs_in "" FLOAT32_IEEE n_fl_S6_S3 1 100 0 65535 ECU_ADDRESS 0xFFF85E0C /end MEASUREMENT
/begin MEASUREMENT n_em_in "" FLOAT32_IEEE n_fl_S6_S3 1 100 -3.40282e+038 3.40282e+038 ECU_ADDRESS 0xFFF85E10 /end MEASUREMENT
/begin MEASUREMENT n_em_verz "Verzögerte EM-Drehzahl zur Bestimmung der K0_Differenzdrehlzahl" FLOAT32_IEEE n_fl_S6_S3 1 100 0 10000 ECU_ADDRESS 0xFFF96478 /end MEASUREMENT
/begin MEASUREMENT n_min_em_has_sbe "Minimale EM Drehzahl der Leerlaufsimulation der HAS (LLS)" FLOAT32_IEEE n_fl_S6_S3 1 100 -32767 32767 ECU_ADDRESS 0xFFF85DD4 /end MEASUREMENT
/begin MEASUREMENT n_min_em_lls_has_ngef "Nicht gefilterte und nicht abgesicherte minimale EM Drehzahl der Leerlaufsimulation der HAS (LLS)" FLOAT32_IEEE n_fl_S6_S3 1 100 -3.40282e+038 3.40282e+038 ECU_ADDRESS 0xFFF96560 /end MEASUREMENT
/begin MEASUREMENT n_min_psys_em_has_sbe "Minimale EM Drehzahl zur Sicherstellung Ölversorgung" FLOAT32_IEEE n_fl_S6_S3 1 100 -32767 32767 ECU_ADDRESS 0xFFF85DA0 /end MEASUREMENT
/begin MEASUREMENT n_mineminit_lls_has "Initialisierungsdrehzahl des Gradientenbegrenzers und PT2-Filters" FLOAT32_IEEE n_fl_S6_S3 1 100 -3.40282e+038 3.40282e+038 ECU_ADDRESS 0xFFF9656C /end MEASUREMENT
/begin MEASUREMENT n_mot_soll_iae_in "" FLOAT32_IEEE n_fl_S6_S3 1 100 -3.40282e+038 3.40282e+038 ECU_ADDRESS 0xFFF85E14 /end MEASUREMENT
/begin MEASUREMENT n_sec_iae "" FLOAT32_IEEE n_fl_S6_S3 1 100 -10000 10000 ECU_ADDRESS 0xFFF85DA4 /end MEASUREMENT
/begin MEASUREMENT n_sec_iae_mod "Sekundärdrehzahl IAE" FLOAT32_IEEE n_fl_S6_S3 1 100 -3.40282e+038 3.40282e+038 ECU_ADDRESS 0xFFF9648C /end MEASUREMENT
/begin MEASUREMENT n_soll_em_has_fkt "" FLOAT32_IEEE n_fl_S6_S3 1 100 0 8000 ECU_ADDRESS 0xFFF85D80 /end MEASUREMENT
/begin MEASUREMENT n_soll_em_hst_in "" FLOAT32_IEEE n_fl_S6_S3 1 100 -3.40282e+038 3.40282e+038 ECU_ADDRESS 0xFFF85E48 /end MEASUREMENT
/begin MEASUREMENT n_soll_ll_vm_in "" FLOAT32_IEEE n_fl_S6_S3 1 100 0 2540 ECU_ADDRESS 0xFFF85E18 /end MEASUREMENT
/begin MEASUREMENT n_soll_vm_bas_ve_ans "Gemessen in Output. Regulaere Solldrehzahl" FLOAT32_IEEE n_fl_S6_S3 1 100 -3.40282e+038 3.40282e+038 ECU_ADDRESS 0xFFF96A08 /end MEASUREMENT
/begin MEASUREMENT n_soll_vm_has_fkt "" FLOAT32_IEEE n_fl_S6_S3 1 100 0 8000 ECU_ADDRESS 0xFFF85D84 /end MEASUREMENT
/begin MEASUREMENT n_t_egs_in "" FLOAT32_IEEE n_fl_S6_S3 1 100 0 65535 ECU_ADDRESS 0xFFF85E1C /end MEASUREMENT
/begin MEASUREMENT n_vm_in "" FLOAT32_IEEE n_fl_S6_S3 1 100 0 65535 ECU_ADDRESS 0xFFF85E20 /end MEASUREMENT
/begin MEASUREMENT n_vm_verz "Verzögerte VM-Drehzahl zur Bestimmung der K0_Differenzdrehlzahl" FLOAT32_IEEE n_fl_S6_S3 1 100 -3.40282e+038 3.40282e+038 ECU_ADDRESS 0xFFF96490 /end MEASUREMENT
/begin MEASUREMENT nd_iae "" FLOAT32_IEEE n_fl_S6_S3 1 100 -10000 10000 ECU_ADDRESS 0xFFF85DA8 /end MEASUREMENT
/begin MEASUREMENT nd_k0_in "" FLOAT32_IEEE n_fl_S6_S3 1 100 -10000 10000 ECU_ADDRESS 0xFFF85DAC /end MEASUREMENT
/begin MEASUREMENT nd_soll_iae_fkt "Differenzdrehzahl der Anfahrkupplung" FLOAT32_IEEE ng_fl_S6_S3 1 100 -8000 8000 ECU_ADDRESS 0xFFF85D88 /end MEASUREMENT
/begin MEASUREMENT nd_sollvmnvm_syn_zus "Differenz zwischen VM-Soll- und Ist-Drehzahl zur Bestimmung des Zeitpunkts der Anforderung der Aktivierung der K0-Schlupfregelung im Zustand K0 Synchronisieren beim Zustart" FLOAT32_IEEE n_fl_S6_S3 1 100 -10000 10000 ECU_ADDRESS 0xFFF85B78 /end MEASUREMENT
/begin MEASUREMENT ndg_k0_in "" FLOAT32_IEEE ng_fl_S6_S3 1 100 -10000 10000 ECU_ADDRESS 0xFFF85DB0 /end MEASUREMENT
/begin MEASUREMENT ng_emmodrsmax_syn_ank "Maximaler Gradient der modifizierten EM-Drehzahl als Basisdrehzahl zur Bestimmung der VM Solldrehzahl bei RS beim K0 Synchronisieren beim Ankoppeln" FLOAT32_IEEE ng_fl_S6_S3 1 100 -3.40282e+038 3.40282e+038 ECU_ADDRESS 0xFFF9677C /end MEASUREMENT
/begin MEASUREMENT ng_emmodrsmax_syn_zus "Maximaler Gradient der modifizierten EM-Drehzahl als Basisdrehzahl zur Bestimmung der VM Solldrehzahl bei RS beim K0 Synchronisieren beim Zustart" FLOAT32_IEEE ng_fl_S6_S3 1 100 -50000 50000 ECU_ADDRESS 0xFFF85B80 /end MEASUREMENT
/begin MEASUREMENT ng_nsoll_em_ans "Gemessen in solldrehzahl_em/konditionieren" FLOAT32_IEEE ng_fl_S6_S3 1 100 -3.40282e+038 3.40282e+038 ECU_ADDRESS 0xFFF96A1C /end MEASUREMENT
/begin MEASUREMENT ng_vm "" FLOAT32_IEEE ng_fl_S6_S3 1 100 -10000 10000 ECU_ADDRESS 0xFFF85DB4 /end MEASUREMENT
/begin MEASUREMENT no_sollvmbegrve_ans "Gemessen in Output. Nach Saturation von ng_sollvmdt1ve_ans" FLOAT32_IEEE n_fl_S6_S3 1 100 -3.40282e+038 3.40282e+038 ECU_ADDRESS 0xFFF96A28 /end MEASUREMENT
/begin MEASUREMENT osmode_next_in "" UBYTE void_int_S6_S3 1 100 1 3 ECU_ADDRESS 0xFFF86679 /end MEASUREMENT
/begin MEASUREMENT p_bremse_fzg_in "" FLOAT32_IEEE p_fl_S6_S3 1 100 -32000 0 ECU_ADDRESS 0xFFF85E24 /end MEASUREMENT
/begin MEASUREMENT phi_neigung_in "Fahrzeug-Neigungswinkel" FLOAT32_IEEE void_fl_S6_S3 1 100 -3.40282e+038 3.40282e+038 ECU_ADDRESS 0xFFF85E28 /end MEASUREMENT
/begin MEASUREMENT pos_egs_in "Waehlhebelposition" UBYTE E_POS_S6_S3 1 100 0 8 ECU_ADDRESS 0xFFF8667A /end MEASUREMENT
/begin MEASUREMENT sollgang_egs_in "" SBYTE void_int_S6_S3 1 100 -128 127 ECU_ADDRESS 0xFFF8667B /end MEASUREMENT
/begin MEASUREMENT st_OMLID_act_stg "Innere Zustände der OML" UWORD void_int_b_S6_S3 1 100 0 4999 ECU_ADDRESS 0xFFF860CA /end MEASUREMENT
/begin MEASUREMENT st_ablauf_fkt "Phase des Ablauf" UWORD void_int_b_S6_S3 1 100 0 65535 ECU_ADDRESS 0xFFF860CC /end MEASUREMENT
/begin MEASUREMENT st_ist_bz_has_stg "Istzustand OML" UBYTE E_STBZHAS_S6_S3 1 100 0 15 ECU_ADDRESS 0xFFF86635 /end MEASUREMENT
/begin MEASUREMENT st_soll_bz_has_hst "interner HST Soll-Betriebszustand der Strategieanpassung (variantenunabhaengig)" UBYTE void_int_S6_S3 1 100 0 1 ECU_ADDRESS 0xFFF8669A /end MEASUREMENT
/begin MEASUREMENT st_ziel_bz_has_stg "Zielzustand OML" UBYTE E_STBZHAS_S6_S3 1 100 0 15 ECU_ADDRESS 0xFFF86636 /end MEASUREMENT
/begin MEASUREMENT status_ablauf_has_fkt "" UBYTE void_int_S6_S3 1 100 0 50 ECU_ADDRESS 0xFFF8663B /end MEASUREMENT
/begin MEASUREMENT status_alaengs_adaoff_in "Information, ob die Adaptionen aufgrund erkannter Laengsbeschleunigung deaktiviert wird. 0 = Adaption aktiv aufgrund erkannter Laengsbeschleunigung
1 = Adaption inaktiv aufgrund nicht erkannter Laengsbeschleunigung" UBYTE void_int_S6_S3 1 100 0 1 ECU_ADDRESS 0xFFF8667C /end MEASUREMENT
/begin MEASUREMENT status_betriebsbereit_hst_in "" UBYTE void_int_S6_S3 1 100 0 1 ECU_ADDRESS 0xFFF8669B /end MEASUREMENT
/begin MEASUREMENT status_efahren_has_sbe "Status E-Fahren der HAS zur Festlegung der entsprechenden Portout-Größe in der HAS Signalaufbereitung_Out" UBYTE void_int_S6_S3 1 100 0 1 ECU_ADDRESS 0xFFF8665A /end MEASUREMENT
/begin MEASUREMENT status_fehler15_eh_diagin "Info vom Errorhandler ob Ersatzfkt. aktiv" UBYTE void_int_S6_S3 1 100 0 1 ECU_ADDRESS 0xFFF8662E /end MEASUREMENT
/begin MEASUREMENT status_fehler_iep_in "" UBYTE E_FEHLERIEP_S6_S3 1 100 0 1 ECU_ADDRESS 0xFFF8667D /end MEASUREMENT
/begin MEASUREMENT status_iae_adap_in "Status der Adaption des Integrierten Anfahrelements IAE" UBYTE E_STATUSADA_S6_S3 1 100 0 2 ECU_ADDRESS 0xFFF8667E /end MEASUREMENT
/begin MEASUREMENT status_iae_in "" UBYTE E_STATUSIAE_S6_S3 1 100 0 8 ECU_ADDRESS 0xFFF8667F /end MEASUREMENT
/begin MEASUREMENT status_iep_in "" UBYTE E_STATUSIEP_S6_S3 1 100 0 4 ECU_ADDRESS 0xFFF86680 /end MEASUREMENT
/begin MEASUREMENT status_k0_adap_in "" UBYTE E_STATUSADA_S6_S3 1 100 0 2 ECU_ADDRESS 0xFFF86681 /end MEASUREMENT
/begin MEASUREMENT status_k0_in "" UBYTE E_STATUSK0_S6_S3 1 100 0 5 ECU_ADDRESS 0xFFF86682 /end MEASUREMENT
/begin MEASUREMENT status_kl15_in "" UBYTE void_int_S6_S3 1 100 0 1 ECU_ADDRESS 0xFFF8669C /end MEASUREMENT
/begin MEASUREMENT status_kolbenpos_k0_in "" UBYTE void_int_S6_S3 1 100 0 255 ECU_ADDRESS 0xFFF86683 /end MEASUREMENT
/begin MEASUREMENT status_kraftfluss_egs_in "" UBYTE E_STATUSKSL_S6_S3 1 100 0 6 ECU_ADDRESS 0xFFF86684 /end MEASUREMENT
/begin MEASUREMENT status_kraftfluss_egs_roh_in "" UBYTE void_int_S6_S3 1 100 0 255 ECU_ADDRESS 0xFFF86685 /end MEASUREMENT
/begin MEASUREMENT status_ll_vm_in "" UBYTE void_int_S6_S3 1 100 0 255 ECU_ADDRESS 0xFFF86686 /end MEASUREMENT
/begin MEASUREMENT status_nem_in "Status zur Drehzahl E-Motor" UBYTE E_SIGSTATUS_S6_S3 1 100 0 2 ECU_ADDRESS 0xFFF86687 /end MEASUREMENT
/begin MEASUREMENT status_nreg_em_hst_in "Status E-Motor Drehzahlregelung der HST" UBYTE void_int_S6_S3 1 100 0 255 ECU_ADDRESS 0xFFF8669D /end MEASUREMENT
/begin MEASUREMENT status_nvm_in "Status zur Drehzahl VM-Motor" UBYTE E_SIGSTATUS_S6_S3 1 100 0 2 ECU_ADDRESS 0xFFF86688 /end MEASUREMENT
/begin MEASUREMENT status_posvueb_in "Erkennung PosV Diagnose" UBYTE void_int_S6_S3 1 100 0 255 ECU_ADDRESS 0xFFF86689 /end MEASUREMENT
/begin MEASUREMENT status_psys_has_sbe "" UBYTE E_STATUSPSY_S6_S3 1 100 0 4 ECU_ADDRESS 0xFFF86654 /end MEASUREMENT
/begin MEASUREMENT status_sa_vm_in "00 Keine Beeinflussung; 01 Schubabschaltung aktiv; 10 Nicht stellbarer Bereich; 11 Signal ungültig" UBYTE void_int_S6_S3 1 100 0 3 ECU_ADDRESS 0xFFF8669E /end MEASUREMENT
/begin MEASUREMENT status_schaltart_svh_has_sbe "Schaltart der angeforderten Schaltung der Schaltverhinderung der HAS (0 = keine Schaltung angefordert) - Bit-Codierung (m/oL=mit/ohne Lanstanh.)=: bit0=ZRSmL,1=ZHSmL,2=SRSmL,3=SHSmL,4=ZRSoL,5=ZHSoL,6=SRSoL,7=SHSoL" UBYTE void_int_S6_S3 1 100 0 255 ECU_ADDRESS 0xFFF8665B /end MEASUREMENT
/begin MEASUREMENT status_schaltart_zul_svh_has "Status der zulässigen Schaltart der Schaltverhinderung der HAS (255 = alle Schaltarten zulässig, 0 = keine Schaltart zulässig) - Bit-Codierung (m/oL=mit/ohne Lanstanh.)=: bit0=ZRSmL,1=ZHSmL,2=SRSmL,3=SHSmL,4=ZRSoL,5=ZHSoL,6=SRSoL,7=SHSoL" UBYTE void_int_S6_S3 1 100 0 255 ECU_ADDRESS 0xFFF96D81 /end MEASUREMENT
/begin MEASUREMENT status_schaltung_egs_in "" SBYTE void_int_S6_S3 1 100 -9 9 ECU_ADDRESS 0xFFF86655 /end MEASUREMENT
/begin MEASUREMENT status_sync_schaltung_sbe "Anzeige der Synchronerkennung der aktuellen Schaltung innerhalb der HAS" UBYTE void_int_S6_S3 1 100 0 1 ECU_ADDRESS 0xFFF86656 /end MEASUREMENT
/begin MEASUREMENT status_waschstr_in "" UBYTE void_int_S6_S3 1 100 0 255 ECU_ADDRESS 0xFFF8668A /end MEASUREMENT
/begin MEASUREMENT status_zug_svh "Richtung der angeforderten Schaltung der Schaltverhinderung der HAS - TRUE = RS angefordert, FALSE = keine RS angefordert" UBYTE void_int_S6_S3 1 100 0 1 ECU_ADDRESS 0xFFF96D82 /end MEASUREMENT
/begin MEASUREMENT status_zug_svh_sbe "Status für Anzeige Zug/Schub" UBYTE void_int_S6_S3 1 100 0 1 ECU_ADDRESS 0xFFF8665C /end MEASUREMENT
/begin MEASUREMENT t_23msollk0_ans_mes "Gemessen in im Output" FLOAT32_IEEE t_fl_S6_S3 1 100 -3.40282e+038 3.40282e+038 ECU_ADDRESS 0xFFF96A38 /end MEASUREMENT
/begin MEASUREMENT t_3minablvar_ans_mes "Gemessener Applikationswert für T_3MIN_ANS" FLOAT32_IEEE t_fl_S6_S3 1 100 -3.40282e+038 3.40282e+038 ECU_ADDRESS 0xFFF96A48 /end MEASUREMENT
/begin MEASUREMENT t_betrieb_pvu_has_ee_in "" ULONG t_int_S6_S3 1 100 0 10000 ECU_ADDRESS 0xFFF85E2C /end MEASUREMENT
/begin MEASUREMENT t_betrieb_pvu_has_sbe "Betriebsdauer seit dem letzten Ablauf der Diagnosefunktion \"Positionsventil-Überwachung\" der Funktion zur Unterstüt-zung der Positionsventil-Überwachung der HAS" FLOAT32_IEEE t_fl_S6_S3 1 100 0 1000000 ECU_ADDRESS 0xFFF85DB8 /end MEASUREMENT
/begin MEASUREMENT t_vsvhreset_svh "Verzögerungszeit zur Rücknahme der Schaltverhinderung der HAS nach einem Ablaufs der HAS" FLOAT32_IEEE t_fl_S6_S3 1 100 0 255 ECU_ADDRESS 0xFFF96584 /end MEASUREMENT
/begin MEASUREMENT timer_pumpready_aktiv_fkt "" UBYTE t_int_d_S6_S3 1 100 0 1 ECU_ADDRESS 0xFFF8663C /end MEASUREMENT
/begin MEASUREMENT v_f_sbe "Fahrzeuggeschwindigkeit auf Basis der Getriebeabtriebsdrehzahl in der  Hybridablaufsteuerung" FLOAT32_IEEE v_fl_S6_S3 1 100 -3.40282e+038 3.40282e+038 ECU_ADDRESS 0xFFF85DBC /end MEASUREMENT
/begin MEASUREMENT vg_f_sbe "Fahrzeuggeschwindigkeitsgradient auf Basis der Getriebeabtriebsdrehzahl in der  Hybridablaufsteuerung" FLOAT32_IEEE vg_fl_S6_S3 1 100 -3.40282e+038 3.40282e+038 ECU_ADDRESS 0xFFF85DC0 /end MEASUREMENT
/begin MEASUREMENT z_ablauf_has_hst_in "" UBYTE void_int_S6_S3 1 100 0 15 ECU_ADDRESS 0xFFF8668B /end MEASUREMENT
/begin MEASUREMENT z_ablauf_has_stg "Zusaetzliche Steuergroesse zur Ablaufsteuerung" UBYTE void_int_S6_S3 1 100 0 15 ECU_ADDRESS 0xFFF86637 /end MEASUREMENT
/begin MEASUREMENT z_ablauf_svh_reset_has_fkt "" UBYTE void_int_S6_S3 1 100 0 255 ECU_ADDRESS 0xFFF8663D /end MEASUREMENT
/begin MEASUREMENT z_ablaufreinit_frk_dihi "Zeigt an, dass der aktuelle HAS-Ablauf erneut begonnen werden soll" UBYTE void_int_S6_S3 1 100 0 1 ECU_ADDRESS 0xFFF8662F /end MEASUREMENT
/begin MEASUREMENT z_ablaufvariante_has_hst_in "" UBYTE void_int_S6_S3 1 100 0 15 ECU_ADDRESS 0xFFF8668C /end MEASUREMENT
/begin MEASUREMENT z_ablaufvariante_has_stg "Ablaufvariante, die  die OML ausgibt" UBYTE void_int_S6_S3 1 100 0 99 ECU_ADDRESS 0xFFF86638 /end MEASUREMENT
/begin MEASUREMENT z_ablaufvariante_kalt_zus "Anzeige der aktiven Ablaufvariante Kaltstart beim Zustart - 0 = kein Kaltstart, 1 = Kaltstart mit abgesenkter EM-Drehzahl" UBYTE void_int_S6_S3 1 100 0 255 ECU_ADDRESS 0xFFF8663E /end MEASUREMENT
/begin MEASUREMENT z_ba_has_k0_hst_in "" UBYTE void_int_S6_S3 1 100 0 1 ECU_ADDRESS 0xFFF8669F /end MEASUREMENT
/begin MEASUREMENT z_ba_has_vm_hst_in "" UBYTE void_int_S6_S3 1 100 0 1 ECU_ADDRESS 0xFFF866A0 /end MEASUREMENT
/begin MEASUREMENT z_diag_ersfkt_has_in "Funktionsschnittstelle zur Ermittlung ob irgendeine Ersatzmaßnahme in der Diagnoseverwaltung aktiv ist" ULONG b_int_S6_S3 1 100 0 4294967295 ECU_ADDRESS 0xFFF85E30 /end MEASUREMENT
/begin MEASUREMENT z_diag_ersfkt_hi_has_in "Funktionsschnittstelle zur Ermittlung ob irgendeine Ersatzmaßnahme in der Diagnoseverwaltung aktiv ist" ULONG b_int_S6_S3 1 100 0 4294967295 ECU_ADDRESS 0xFFF85E34 /end MEASUREMENT
/begin MEASUREMENT z_diag_notgang_has_in "Notganginformation" UBYTE void_int_S6_S3 1 100 0 255 ECU_ADDRESS 0xFFF8668D /end MEASUREMENT
/begin MEASUREMENT z_emaktiv_fuw_zus_fkt "Anzeige der EM Fehlfuntion der Funktionsüberwachung der EM beim Zustart" UBYTE void_int_S6_S3 1 100 0 1 ECU_ADDRESS 0xFFF8663F /end MEASUREMENT
/begin MEASUREMENT z_emfehler_frk_dihi "Zeigt an, dass eine EM Fehlfunktion erkannt wurde, die in der HAS ausgewertet werden soll" UBYTE void_int_S6_S3 1 100 0 1 ECU_ADDRESS 0xFFF86630 /end MEASUREMENT
/begin MEASUREMENT z_fehler15_eh_fkt "" UBYTE void_int_S6_S3 1 100 0 1 ECU_ADDRESS 0xFFF86640 /end MEASUREMENT
/begin MEASUREMENT z_freigabe_pvu_has_sbe "Freigabe zur Aktivierung der Diagnosefunktion \"Positionsventil-Überwachung\" der Funktion zur Unterstützung der Positi-onsventil-Überwachung der HAS" UBYTE void_int_S6_S3 1 100 0 1 ECU_ADDRESS 0xFFF86657 /end MEASUREMENT
/begin MEASUREMENT z_fuwdeakt_frk_dihi "Zeigt an, dass die FUW-Funktion nicht aktiviert werden darf" UBYTE void_int_S6_S3 1 100 0 1 ECU_ADDRESS 0xFFF86631 /end MEASUREMENT
/begin MEASUREMENT z_hybfkt_stg "Anforderung der Aktivierung einer Hybridfunktion durch die Hyrid-Zustandssteuerung" UBYTE E_HYBFKT_S6_S3 1 100 0 15 ECU_ADDRESS 0xFFF86639 /end MEASUREMENT
/begin MEASUREMENT z_iep_in "" UBYTE E_ZIEP_S6_S3 1 100 0 4 ECU_ADDRESS 0xFFF8668E /end MEASUREMENT
/begin MEASUREMENT z_init_fkt "" UBYTE void_int_S6_S3 1 100 0 1 ECU_ADDRESS 0xFFF86641 /end MEASUREMENT
/begin MEASUREMENT z_k0_befuellopt_has_fkt "" UBYTE void_int_S6_S3 1 100 0 1 ECU_ADDRESS 0xFFF86642 /end MEASUREMENT
/begin MEASUREMENT z_k0_fst_in "" UBYTE E_ZK0FSTIN_S6_S3 1 100 0 3 ECU_ADDRESS 0xFFF8668F /end MEASUREMENT
/begin MEASUREMENT z_k0_has_fkt "" UBYTE E_ZK0_S6_S3 1 100 0 5 ECU_ADDRESS 0xFFF86643 /end MEASUREMENT
/begin MEASUREMENT z_k0_has_sbe "" UBYTE E_ZK0_S6_S3 1 100 0 5 ECU_ADDRESS 0xFFF8665D /end MEASUREMENT
/begin MEASUREMENT z_k0schlupfbed_iae_has "Anzeige, ob Schlupfentkopplung der K0 in Abhängigkeit des IAE-Status erlaubt ist in der HAS" UBYTE void_int_S6_S3 1 100 0 255 ECU_ADDRESS 0xFFF96D8E /end MEASUREMENT
/begin MEASUREMENT z_k0schlupfbed_mmotiae_kps "Schlupfbedingung zur Bestimmung z_k0_has_sbe" UBYTE void_int_S6_S3 1 100 0 1 ECU_ADDRESS 0xFFF96D8F /end MEASUREMENT
/begin MEASUREMENT z_k0schlupfbed_ngem_kps "Anzeige ob Schlupfentkopplung der K0 in Abhängigkeit der EM-Drehzahlgradientenbedingung erlaubt ist bei der Priorisierung der K0-Ansteuerung der HAS" UBYTE void_int_S6_S3 1 100 0 1 ECU_ADDRESS 0xFFF8626B /end MEASUREMENT
/begin MEASUREMENT z_k0syncmk0erh_frk_dihi "Zeigt an, dass eine K0-Zwangsynchronisation mittels Erhöhung des K0-Moments erfolgen soll" UBYTE void_int_S6_S3 1 100 0 1 ECU_ADDRESS 0xFFF86632 /end MEASUREMENT
/begin MEASUREMENT z_kps_stada_in "Sollvorgabe für die Trennkupplung K0 durch die Stillstandsadaption" UBYTE void_int_S6_S3 1 100 0 255 ECU_ADDRESS 0xFFF86690 /end MEASUREMENT
/begin MEASUREMENT z_m_begr_em_has_fkt "" UBYTE void_int_S6_S3 1 100 0 50 ECU_ADDRESS 0xFFF86644 /end MEASUREMENT
/begin MEASUREMENT z_m_max_iae_has_fkt "" UBYTE void_int_S6_S3 1 100 0 50 ECU_ADDRESS 0xFFF86645 /end MEASUREMENT
/begin MEASUREMENT z_m_soll_em_has_fkt "" UBYTE void_int_S6_S3 1 100 0 50 ECU_ADDRESS 0xFFF86646 /end MEASUREMENT
/begin MEASUREMENT z_m_soll_vm_has_fkt "" UBYTE void_int_S6_S3 1 100 0 50 ECU_ADDRESS 0xFFF86647 /end MEASUREMENT
/begin MEASUREMENT z_modus_em_hst_in "" UBYTE void_int_S6_S3 1 100 0 255 ECU_ADDRESS 0xFFF86691 /end MEASUREMENT
/begin MEASUREMENT z_modus_iae_has_fkt "" UBYTE E_ZMODUSIAE_S6_S3 1 100 0 2 ECU_ADDRESS 0xFFF86648 /end MEASUREMENT
/begin MEASUREMENT z_modus_iae_has_sbe "" UBYTE E_ZMODUSIAE_S6_S3 1 100 0 2 ECU_ADDRESS 0xFFF8665E /end MEASUREMENT
/begin MEASUREMENT z_modus_iep_has_sbe "Vorgabe des Betriebsmodus der IEP durch die HAS" UBYTE E_ZMODUSIEP_S6_S3 1 100 0 4 ECU_ADDRESS 0xFFF8665F /end MEASUREMENT
/begin MEASUREMENT z_msa_avh_moni_has_sbe "Anforderung einer Schaltverhinderung der HAS" UBYTE void_int_S6_S3 1 100 0 255 ECU_ADDRESS 0xFFF86660 /end MEASUREMENT
/begin MEASUREMENT z_msa_eaf_moni_has_sbe "Anforderung einer Schaltverhinderung der HAS" UBYTE void_int_S6_S3 1 100 0 255 ECU_ADDRESS 0xFFF86661 /end MEASUREMENT
/begin MEASUREMENT z_msa_fst_in "Anforderung einer Abschaltverhinderung durch die Fahrstrategie ASIS" UBYTE void_int_S6_S3 1 100 0 255 ECU_ADDRESS 0xFFF86692 /end MEASUREMENT
/begin MEASUREMENT z_msa_has_sbe "Anforderung der Beeinflussung der MSA-Funktionalität durch die Hybridablaufsteuerung - Codierung: bit0 = AVZ, bit1 = AVH, bit2 = EAF, bit3 = EVH, bit4 = Deaktivierung, bit7 = Störungsbedingt" UBYTE void_int_S6_S3 1 100 0 255 ECU_ADDRESS 0xFFF86662 /end MEASUREMENT
/begin MEASUREMENT z_msa_stada_in "" UBYTE void_int_S6_S3 1 100 0 6 ECU_ADDRESS 0xFFF866A1 /end MEASUREMENT
/begin MEASUREMENT z_n_min_em_parksp_has_in "Anforderung einer EM-Drehzahlanhebung beim Auslegen der Parksperre infolge unzureichender Ölversorgung" UBYTE void_int_S6_S3 1 100 0 1 ECU_ADDRESS 0xFFF86693 /end MEASUREMENT
/begin MEASUREMENT z_n_min_iep_in "Anforderung Ausgabe EM-Mindestdrehzahl zur Sicherstellung der Ölversorgung durch die IEP" UBYTE void_int_S6_S3 1 100 0 1 ECU_ADDRESS 0xFFF86694 /end MEASUREMENT
/begin MEASUREMENT z_n_soll_em_has_fkt "" UBYTE void_int_S6_S3 1 100 0 50 ECU_ADDRESS 0xFFF86649 /end MEASUREMENT
/begin MEASUREMENT z_n_soll_vm_has_fkt "" UBYTE void_int_S6_S3 1 100 0 50 ECU_ADDRESS 0xFFF8664A /end MEASUREMENT
/begin MEASUREMENT z_nllsoll_iae_in "Anforderung der IAE, dass eine definierte LL-Drehzahl durch den Motor eingestellt werden soll" UBYTE E_ZNLLSOLL_S6_S3 1 100 0 2 ECU_ADDRESS 0xFFF86695 /end MEASUREMENT
/begin MEASUREMENT z_nmineminit_lls_has "Flag zur Initialisierung des Gradientenbegrenzers und PT2-Filters" UBYTE void_int_S6_S3 1 100 0 1 ECU_ADDRESS 0xFFF96D97 /end MEASUREMENT
/begin MEASUREMENT z_nminemnull_frk_dihi "Zeigt an, dass die Ausgabe der minimalen EM Drehzahl der HAS unterdrückt werden soll." UBYTE void_int_S6_S3 1 100 0 1 ECU_ADDRESS 0xFFF86633 /end MEASUREMENT
/begin MEASUREMENT z_nvmsollbegr_frk_dihi "Zeigt an, dass die VM-Solldrehzahl auf die EM-Istdrehzahl be-grenzt werden soll" UBYTE void_int_S6_S3 1 100 0 1 ECU_ADDRESS 0xFFF86634 /end MEASUREMENT
/begin MEASUREMENT z_p_hys_k0_has_fkt "Hysteresekompensation" UBYTE void_int_S6_S3 1 100 0 1 ECU_ADDRESS 0xFFF8664B /end MEASUREMENT
/begin MEASUREMENT z_ponr_fkt "point of no return" UBYTE void_int_S6_S3 1 100 0 1 ECU_ADDRESS 0xFFF8664C /end MEASUREMENT
/begin MEASUREMENT z_pvu_has_sbe "Beeinflussung des Hybridsystems zur Unterstützung der Positionsventil- Überwachung der HAS-Codierung: 0 = keine Beeinflussung, 1 = Beeinflussung Stufe 1, 2 = Beeinflussung Stufe 2" UBYTE void_int_S6_S3 1 100 0 2 ECU_ADDRESS 0xFFF86658 /end MEASUREMENT
/begin MEASUREMENT z_saf_has_fkt "Schaltanforderung 1...aktiv" UBYTE void_int_S6_S3 1 100 0 1 ECU_ADDRESS 0xFFF8664D /end MEASUREMENT
/begin MEASUREMENT z_sas_has_sbe "Ändert im Wahrheitsfall die KupplungsBefüllreihenfolge" UBYTE void_int_S6_S3 1 100 0 1 ECU_ADDRESS 0xFFF86663 /end MEASUREMENT
/begin MEASUREMENT z_sbe_has_fkt "Schaltbeeinflussung  1...aktiv" UBYTE void_int_S6_S3 1 100 0 1 ECU_ADDRESS 0xFFF8664E /end MEASUREMENT
/begin MEASUREMENT z_standby_em_has_fkt "" UBYTE void_int_S6_S3 1 100 0 1 ECU_ADDRESS 0xFFF8664F /end MEASUREMENT
/begin MEASUREMENT z_start_modus_has_sbe "Anforderung eines Anlasserstarts" UBYTE void_int_S6_S3 1 100 0 255 ECU_ADDRESS 0xFFF86664 /end MEASUREMENT
/begin MEASUREMENT z_status_psys_mps_sbe "Flag, das eine Modifikation des Pumpendruckstatus anzeigt" UBYTE void_int_S6_S3 1 100 0 1 ECU_ADDRESS 0xFFF86659 /end MEASUREMENT
/begin MEASUREMENT z_svh_has_sbe "Anforderung einer Schaltverhinderung der HAS" UBYTE void_int_S6_S3 1 100 0 1 ECU_ADDRESS 0xFFF86665 /end MEASUREMENT
/begin MEASUREMENT z_timer_pumpready_fkt "" UBYTE void_int_S6_S3 1 100 0 1 ECU_ADDRESS 0xFFF86650 /end MEASUREMENT
/begin MEASUREMENT z_tmin_fehler15_fkt "Status Timer für Verweilzeit in Fehler15" UBYTE void_int_S6_S3 1 100 0 255 ECU_ADDRESS 0xFFF86651 /end MEASUREMENT
/begin MEASUREMENT z_ziel_kraftfluss_egs_in "" UBYTE void_int_S6_S3 1 100 0 255 ECU_ADDRESS 0xFFF86696 /end MEASUREMENT
/begin MEASUREMENT z_zuendfreigabe_vm_fkt "" UBYTE void_int_S6_S3 1 100 0 1 ECU_ADDRESS 0xFFF86652 /end MEASUREMENT
/begin MEASUREMENT z_zuendfreigabe_vm_has_fkt "" UBYTE void_int_S6_S3 1 100 0 1 ECU_ADDRESS 0xFFF86653 /end MEASUREMENT
/begin MEASUREMENT zielgang_egs_in "" SBYTE void_int_S6_S3 1 100 -128 127 ECU_ADDRESS 0xFFF86697 /end MEASUREMENT
/begin FUNCTION Run_SFOp_ABST1__radient_MSollK0 "" /begin DEF_CHARACTERISTIC MG_SOLLK0NEG_GAB_ABST MG_SOLLK0POS_GAB_ABST /end DEF_CHARACTERISTIC /begin OUT_MEASUREMENT SFOp_ABST108_out_ /end OUT_MEASUREMENT /begin LOC_MEASUREMENT SFOp_ABST108_Unit_Delay /end LOC_MEASUREMENT /end FUNCTION
/begin FUNCTION Run_SFOp_ABST94_CL_PT1_ "" /begin DEF_CHARACTERISTIC FK_NGVM_AST_ABST /end DEF_CHARACTERISTIC /begin OUT_MEASUREMENT SFOp_ABST94_x_ /end OUT_MEASUREMENT /begin LOC_MEASUREMENT SFOp_ABST94_Unit_Delay2 /end LOC_MEASUREMENT /end FUNCTION
/begin FUNCTION Run_SFOp_ABST95_cTimer_VM_aus_ "" /begin OUT_MEASUREMENT SFOp_ABST95_isActive_ SFOp_ABST95_t_left_ /end OUT_MEASUREMENT /begin LOC_MEASUREMENT SFOp_ABST95_Unit_Delay /end LOC_MEASUREMENT /end FUNCTION
/begin FUNCTION Run_SFOp_ABST9__svmvmabst_abst_ "" /begin DEF_CHARACTERISTIC T_NGSVMK0OEFFNEN_AST_ABST /end DEF_CHARACTERISTIC /begin OUT_MEASUREMENT SFOp_ABST96_isActive_ SFOp_ABST96_t_left_ /end OUT_MEASUREMENT /begin LOC_MEASUREMENT SFOp_ABST96_Unit_Delay /end LOC_MEASUREMENT /end FUNCTION
/begin FUNCTION Run_SFOp_ANK102_cTimer_trigger_ "" /begin DEF_CHARACTERISTIC T_MAX_SCL_ANK /end DEF_CHARACTERISTIC /begin OUT_MEASUREMENT SFOp_ANK102_isActive_ SFOp_ANK102_t_left_ /end OUT_MEASUREMENT /begin LOC_MEASUREMENT SFOp_ANK102_Unit_Delay /end LOC_MEASUREMENT /end FUNCTION
/begin FUNCTION Run_SFOp_ANK10__nt_m_k0_mod_has "" /begin OUT_MEASUREMENT SFOp_ANK104_out_ /end OUT_MEASUREMENT /begin LOC_MEASUREMENT SFOp_ANK104_Unit_Delay mg_k0_mod_max_ank /end LOC_MEASUREMENT /end FUNCTION
/begin FUNCTION Run_SFOp_ANK10__t_m_soll_k0_has "" /begin OUT_MEASUREMENT SFOp_ANK105_out_ /end OUT_MEASUREMENT /begin LOC_MEASUREMENT SFOp_ANK105_Unit_Delay mg_soll_k0_max_ank /end LOC_MEASUREMENT /end FUNCTION
/begin FUNCTION Run_SFOp_ANK10__Timer_trigger_1 "" /begin DEF_CHARACTERISTIC T_MSOLLK0ANSTMAX_SCL_ANK /end DEF_CHARACTERISTIC /begin OUT_MEASUREMENT SFOp_ANK106_isActive_ SFOp_ANK106_t_left_ /end OUT_MEASUREMENT /begin LOC_MEASUREMENT SFOp_ANK106_Unit_Delay /end LOC_MEASUREMENT /end FUNCTION
/begin FUNCTION Run_SFOp_ANK11__Timer_trigger_1 "" /begin DEF_CHARACTERISTIC T_MK0MODZIEL_SCL_ANK /end DEF_CHARACTERISTIC /begin OUT_MEASUREMENT SFOp_ANK116_isActive_ SFOp_ANK116_t_left_ /end OUT_MEASUREMENT /begin LOC_MEASUREMENT SFOp_ANK116_Unit_Delay /end LOC_MEASUREMENT /end FUNCTION
/begin FUNCTION Run_SFOp_ANK13__egaktiv_syn_ank "" /begin DEF_CHARACTERISTIC T_VK0SREGAKTIV_SYN_ANK /end DEF_CHARACTERISTIC /begin OUT_MEASUREMENT SFOp_ANK132_isActive_ SFOp_ANK132_t_left_ /end OUT_MEASUREMENT /begin LOC_MEASUREMENT SFOp_ANK132_Unit_Delay /end LOC_MEASUREMENT /end FUNCTION
/begin FUNCTION Run_SFOp_ANK13__egbasis_syn_ank "" /begin DEF_CHARACTERISTIC T_K0SREGBASISMAX_SYN_ANK /end DEF_CHARACTERISTIC /begin OUT_MEASUREMENT SFOp_ANK137_isActive_ SFOp_ANK137_t_left_ /end OUT_MEASUREMENT /begin LOC_MEASUREMENT SFOp_ANK137_Unit_Delay /end LOC_MEASUREMENT /end FUNCTION
/begin FUNCTION Run_SFOp_ANK149_cPT1_NVMSoll "" /begin DEF_CHARACTERISTIC FK_NSOLLVM_KON_ANK /end DEF_CHARACTERISTIC /begin OUT_MEASUREMENT SFOp_ANK149_x_ /end OUT_MEASUREMENT /begin LOC_MEASUREMENT SFOp_ANK149_Unit_Delay2 /end LOC_MEASUREMENT /end FUNCTION
/begin FUNCTION Run_SFOp_ANK14__0k0sreg_syn_ank "" /begin DEF_CHARACTERISTIC T_NDGK0K0SREGMIN_SYN_ANK /end DEF_CHARACTERISTIC /begin OUT_MEASUREMENT SFOp_ANK143_isActive_ SFOp_ANK143_t_left_ /end OUT_MEASUREMENT /begin LOC_MEASUREMENT SFOp_ANK143_Unit_Delay /end LOC_MEASUREMENT /end FUNCTION
/begin FUNCTION Run_SFOp_ANK15__mer_NSollVMInit "" /begin DEF_CHARACTERISTIC T_VMDZIELSOLLK0_SYN_ANK /end DEF_CHARACTERISTIC /begin OUT_MEASUREMENT SFOp_ANK153_isActive_ SFOp_ANK153_t_left_ /end OUT_MEASUREMENT /begin LOC_MEASUREMENT SFOp_ANK153_Unit_Delay /end LOC_MEASUREMENT /end FUNCTION
/begin FUNCTION Run_SFOp_ANK15__radient_MSollK0 "" /begin DEF_CHARACTERISTIC NG_EMMODRSMIN_SYN_ANK /end DEF_CHARACTERISTIC /begin OUT_MEASUREMENT SFOp_ANK159_out_ /end OUT_MEASUREMENT /begin LOC_MEASUREMENT SFOp_ANK159_Unit_Delay ng_emmodrsmax_syn_ank /end LOC_MEASUREMENT /end FUNCTION
/begin FUNCTION Run_SFOp_ANK16___MSollK0_Synmin "" /begin DEF_CHARACTERISTIC MG_SOLLK0MIN_SYN_ANK /end DEF_CHARACTERISTIC /begin OUT_MEASUREMENT SFOp_ANK164_out_ /end OUT_MEASUREMENT /begin LOC_MEASUREMENT SFOp_ANK164_Unit_Delay mg_soll_k0_syn_ank /end LOC_MEASUREMENT /end FUNCTION
/begin FUNCTION Run_SFOp_ANK16__nt_m_k0_mod_has "" /begin DEF_CHARACTERISTIC MG_K0MODMAXMAX_SYN_ANK /end DEF_CHARACTERISTIC /begin OUT_MEASUREMENT SFOp_ANK165_out_ /end OUT_MEASUREMENT /begin LOC_MEASUREMENT SFOp_ANK165_Unit_Delay /end LOC_MEASUREMENT /end FUNCTION
/begin FUNCTION Run_SFOp_ANK17__erkums_syn_ank_ "" /begin OUT_MEASUREMENT SFOp_ANK176_isActive_ SFOp_ANK176_t_left_ /end OUT_MEASUREMENT /begin LOC_MEASUREMENT SFOp_ANK173_KL__CERKUMS_SYN_ANK SFOp_ANK176_Unit_Delay /end LOC_MEASUREMENT /end FUNCTION
/begin FUNCTION Run_SFOp_ANK17__yncerk_syn_ank_ "" /begin DEF_CHARACTERISTIC T_VK0SYNCERK_SYN_ANK /end DEF_CHARACTERISTIC /begin OUT_MEASUREMENT SFOp_ANK172_isActive_ SFOp_ANK172_t_left_ /end OUT_MEASUREMENT /begin LOC_MEASUREMENT SFOp_ANK172_Unit_Delay /end LOC_MEASUREMENT /end FUNCTION
/begin FUNCTION Run_SFOp_ANK187_cPT1_NVMSoll "" /begin DEF_CHARACTERISTIC FK_NSOLLVM_KON_ANK /end DEF_CHARACTERISTIC /begin OUT_MEASUREMENT SFOp_ANK187_x_ /end OUT_MEASUREMENT /begin LOC_MEASUREMENT SFOp_ANK187_Unit_Delay2 /end LOC_MEASUREMENT /end FUNCTION
/begin FUNCTION Run_SFOp_ANK197_cTimer_trigger_ "" /begin DEF_CHARACTERISTIC T_MAX_SAK_ANK /end DEF_CHARACTERISTIC /begin OUT_MEASUREMENT SFOp_ANK197_isActive_ SFOp_ANK197_t_left_ /end OUT_MEASUREMENT /begin LOC_MEASUREMENT SFOp_ANK197_Unit_Delay /end LOC_MEASUREMENT /end FUNCTION
/begin FUNCTION Run_SFOp_ANK54_cDT1_ngem "" /begin DEF_CHARACTERISTIC FK_NGEM_ANK /end DEF_CHARACTERISTIC /begin OUT_MEASUREMENT SFOp_ANK54_x_filter_ SFOp_ANK54_xp_ /end OUT_MEASUREMENT /begin LOC_MEASUREMENT SFOp_ANK55_Unit_Delay2 n_em_in /end LOC_MEASUREMENT /end FUNCTION
/begin FUNCTION Run_SFOp_ANK89_cTimer_trigger_ "" /begin DEF_CHARACTERISTIC T_MAX_ABB_ANK /end DEF_CHARACTERISTIC /begin OUT_MEASUREMENT SFOp_ANK89_isActive_ SFOp_ANK89_t_left_ /end OUT_MEASUREMENT /begin LOC_MEASUREMENT SFOp_ANK89_Unit_Delay /end LOC_MEASUREMENT /end FUNCTION
/begin FUNCTION Run_SFOp_ANK90__radient_MSollK0 "" /begin DEF_CHARACTERISTIC MG_SOLLK0_ABB_ANK /end DEF_CHARACTERISTIC /begin OUT_MEASUREMENT SFOp_ANK90_out_ /end OUT_MEASUREMENT /begin LOC_MEASUREMENT SFOp_ANK90_Unit_Delay /end LOC_MEASUREMENT /end FUNCTION
/begin FUNCTION Run_SFOp_DRS62__miter_Gradient_ "" /begin DEF_CHARACTERISTIC NG_1SOLLEM_DRS /end DEF_CHARACTERISTIC /begin OUT_MEASUREMENT SFOp_DRS62_out_ /end OUT_MEASUREMENT /begin LOC_MEASUREMENT SFOp_DRS62_Unit_Delay /end LOC_MEASUREMENT /end FUNCTION
/begin FUNCTION Run_SFOp_DRS63_cTimerStep_ "" /begin DEF_CHARACTERISTIC T_1MAX_DRS /end DEF_CHARACTERISTIC /begin OUT_MEASUREMENT SFOp_DRS63_isActive_ SFOp_DRS63_t_left_ /end OUT_MEASUREMENT /begin LOC_MEASUREMENT SFOp_DRS63_Unit_Delay /end LOC_MEASUREMENT /end FUNCTION
/begin FUNCTION Run_SFOp_DRS79_CL_PT1_TA_ "" /begin DEF_CHARACTERISTIC T_PT1NSOLLEM_DRS /end DEF_CHARACTERISTIC /begin OUT_MEASUREMENT SFOp_DRS79_x2_ /end OUT_MEASUREMENT /begin LOC_MEASUREMENT SFOp_DRS79_Unit_Delay2 /end LOC_MEASUREMENT /end FUNCTION
/begin FUNCTION Run_SFOp_DRS80_cTimerStep_ "" /begin DEF_CHARACTERISTIC T_2MAX_DRS /end DEF_CHARACTERISTIC /begin OUT_MEASUREMENT SFOp_DRS80_isActive_ SFOp_DRS80_t_left_ /end OUT_MEASUREMENT /begin LOC_MEASUREMENT SFOp_DRS80_Unit_Delay /end LOC_MEASUREMENT /end FUNCTION
/begin FUNCTION Run_SFOp_NOS46__mer_max_scl_nos "" /begin DEF_CHARACTERISTIC T_MAX_SCL_NOS /end DEF_CHARACTERISTIC /begin OUT_MEASUREMENT SFOp_NOS46_isActive_ SFOp_NOS46_t_left_ /end OUT_MEASUREMENT /begin LOC_MEASUREMENT SFOp_NOS46_Unit_Delay /end LOC_MEASUREMENT /end FUNCTION
/begin FUNCTION Run_SFOp_NOS61__r_t_max_abb_zus "" /begin DEF_CHARACTERISTIC T_MAX_ABB_NOS /end DEF_CHARACTERISTIC /begin OUT_MEASUREMENT SFOp_NOS61_isActive_ SFOp_NOS61_t_left_ /end OUT_MEASUREMENT /begin LOC_MEASUREMENT SFOp_NOS61_Unit_Delay /end LOC_MEASUREMENT /end FUNCTION
/begin FUNCTION Run_SFOp_NOS62__radient_MSollK0 "" /begin DEF_CHARACTERISTIC MG_SOLLK0_ABB_NOS /end DEF_CHARACTERISTIC /begin OUT_MEASUREMENT SFOp_NOS62_out_ /end OUT_MEASUREMENT /begin LOC_MEASUREMENT SFOp_NOS62_Unit_Delay /end LOC_MEASUREMENT /end FUNCTION
/begin FUNCTION Run_SFOp_NOS75__mer_max_nst_nos "" /begin DEF_CHARACTERISTIC T_MAX_NST_NOS /end DEF_CHARACTERISTIC /begin OUT_MEASUREMENT SFOp_NOS75_isActive_ SFOp_NOS75_t_left_ /end OUT_MEASUREMENT /begin LOC_MEASUREMENT SFOp_NOS75_Unit_Delay /end LOC_MEASUREMENT /end FUNCTION
/begin FUNCTION Run_SFOp_NOS77__r_m_soll_k0_has "" /begin OUT_MEASUREMENT SFOp_NOS77_out_ /end OUT_MEASUREMENT /begin LOC_MEASUREMENT SFOp_NOS77_Unit_Delay m_soll_k0_ziel_nos_mess /end LOC_MEASUREMENT /end FUNCTION
/begin FUNCTION Run_SFOp_NOS78__t_ndsk0_nst_nos "" /begin DEF_CHARACTERISTIC T_NDSK0_NST_NOS /end DEF_CHARACTERISTIC /begin OUT_MEASUREMENT SFOp_NOS78_isActive_ SFOp_NOS78_t_left_ /end OUT_MEASUREMENT /begin LOC_MEASUREMENT SFOp_NOS78_Unit_Delay /end LOC_MEASUREMENT /end FUNCTION
/begin FUNCTION Run_SFOp_NOS80__mer_ums_nst_nos "" /begin DEF_CHARACTERISTIC T_UMS_NST_NOS /end DEF_CHARACTERISTIC /begin OUT_MEASUREMENT SFOp_NOS80_isActive_ SFOp_NOS80_t_left_ /end OUT_MEASUREMENT /begin LOC_MEASUREMENT SFOp_NOS80_Unit_Delay /end LOC_MEASUREMENT /end FUNCTION
/begin FUNCTION Run_SFOp_SLST146_CL_DT1_ngvm "" /begin OUT_MEASUREMENT SFOp_SLST146_x_filter_ SFOp_SLST146_xp_ /end OUT_MEASUREMENT /begin LOC_MEASUREMENT SFOp_SLST149_Unit_Delay2 n_soll_vm_bas_ve_ans /end LOC_MEASUREMENT /end FUNCTION
/begin FUNCTION Run_SFOp_SLST156_cDelay_vm "" /begin OUT_MEASUREMENT SFOp_SLST156_out_ /end OUT_MEASUREMENT
 /begin LOC_MEASUREMENT SFOp_SLST158_Unit_Delay1 m_sollk0has_nverz_mes t_23msollk0_ans_mes /end LOC_MEASUREMENT
/end FUNCTION
/begin FUNCTION Run_SFOp_SLST1__ger_TMAXIAEOEFF "" /begin OUT_MEASUREMENT SFOp_SLST112_isActive_ SFOp_SLST112_t_left_ /end OUT_MEASUREMENT /begin LOC_MEASUREMENT SFOp_SLST112_Unit_Delay /end LOC_MEASUREMENT /end FUNCTION
/begin FUNCTION Run_SFOp_SLST1__Gradient_ndiae1 "" /begin OUT_MEASUREMENT SFOp_SLST193_out_ /end OUT_MEASUREMENT
 /begin LOC_MEASUREMENT SFOp_SLST193_Unit_Delay init_nsollem_grad_ans ng_nsoll_em_ans /end LOC_MEASUREMENT
/end FUNCTION
/begin FUNCTION Run_SFOp_SLST1__imer_testablvar "" /begin DEF_CHARACTERISTIC T_TESTABLVAR_ANS /end DEF_CHARACTERISTIC /begin OUT_MEASUREMENT SFOp_SLST102_isActive_ SFOp_SLST102_t_left_ /end OUT_MEASUREMENT /begin LOC_MEASUREMENT SFOp_SLST102_Unit_Delay /end LOC_MEASUREMENT /end FUNCTION
/begin FUNCTION Run_SFOp_SLST1__PPELT_STATUS_8_ "" /begin DEF_CHARACTERISTIC T_STATUSWECHSELIAE_ANS /end DEF_CHARACTERISTIC /begin OUT_MEASUREMENT SFOp_SLST111_isActive_ SFOp_SLST111_t_left_ /end OUT_MEASUREMENT /begin LOC_MEASUREMENT SFOp_SLST111_Unit_Delay /end LOC_MEASUREMENT /end FUNCTION
/begin FUNCTION Run_SFOp_SLST1__r_ve_nsollvmhas "" /begin DEF_CHARACTERISTIC NG_SOLLVMMAXVE_ANS /end DEF_CHARACTERISTIC /begin OUT_MEASUREMENT SFOp_SLST147_out_ /end OUT_MEASUREMENT /begin LOC_MEASUREMENT SFOp_SLST147_Unit_Delay no_sollvmbegrve_ans /end LOC_MEASUREMENT /end FUNCTION
/begin FUNCTION Run_SFOp_SLST1__sollemaktiv_ans "" /begin DEF_CHARACTERISTIC T_MSOLLEMAKTIV_ANS /end DEF_CHARACTERISTIC /begin OUT_MEASUREMENT SFOp_SLST143_isActive_ SFOp_SLST143_t_left_ /end OUT_MEASUREMENT /begin LOC_MEASUREMENT SFOp_SLST143_Unit_Delay /end LOC_MEASUREMENT /end FUNCTION
/begin FUNCTION Run_SFOp_SLST246_cTimerState "" /begin DEF_CHARACTERISTIC T_2MIN_ANS /end DEF_CHARACTERISTIC /begin OUT_MEASUREMENT SFOp_SLST246_isActive_ SFOp_SLST246_t_left_ /end OUT_MEASUREMENT /begin LOC_MEASUREMENT SFOp_SLST246_Unit_Delay /end LOC_MEASUREMENT /end FUNCTION
/begin FUNCTION Run_SFOp_SLST276_CL_PT1_sec_ "" /begin DEF_CHARACTERISTIC FK_14NSOLLVM_ANS /end DEF_CHARACTERISTIC /begin OUT_MEASUREMENT SFOp_SLST276_x_filt_ SFOp_SLST276_xg_filt_ /end OUT_MEASUREMENT /begin LOC_MEASUREMENT SFOp_SLST276_Unit_Delay2 /end LOC_MEASUREMENT /end FUNCTION
/begin FUNCTION Run_SFOp_SLST2__adient_MMaxIae1 "" /begin DEF_CHARACTERISTIC MG_5MOMAXIAE_ANS /end DEF_CHARACTERISTIC /begin OUT_MEASUREMENT SFOp_SLST299_out_ /end OUT_MEASUREMENT /begin LOC_MEASUREMENT SFOp_SLST299_Unit_Delay /end LOC_MEASUREMENT /end FUNCTION
/begin FUNCTION Run_SFOp_SLST2__cTimer_2Max_Ans "" /begin DEF_CHARACTERISTIC T_2MAX_ANS /end DEF_CHARACTERISTIC /begin OUT_MEASUREMENT SFOp_SLST247_isActive_ SFOp_SLST247_t_left_ /end OUT_MEASUREMENT /begin LOC_MEASUREMENT SFOp_SLST247_Unit_Delay /end LOC_MEASUREMENT /end FUNCTION
/begin FUNCTION Run_SFOp_SLST2__cTimer_5Max_Ans "" /begin DEF_CHARACTERISTIC T_5MAX_ANS /end DEF_CHARACTERISTIC /begin OUT_MEASUREMENT SFOp_SLST296_isActive_ SFOp_SLST296_t_left_ /end OUT_MEASUREMENT /begin LOC_MEASUREMENT SFOp_SLST296_Unit_Delay /end LOC_MEASUREMENT /end FUNCTION
/begin FUNCTION Run_SFOp_SLST2__erDownOFFSETMK0 "" /begin DEF_CHARACTERISTIC T_2MK0OFFSET_ANS /end DEF_CHARACTERISTIC /begin OUT_MEASUREMENT SFOp_SLST266_isActive_ SFOp_SLST266_t_left_ /end OUT_MEASUREMENT /begin LOC_MEASUREMENT SFOp_SLST266_Unit_Delay /end LOC_MEASUREMENT /end FUNCTION
/begin FUNCTION Run_SFOp_SLST2__iter_nsollemiae "" /begin OUT_MEASUREMENT SFOp_SLST201_out_ /end OUT_MEASUREMENT /begin LOC_MEASUREMENT SFOp_SLST201_Unit_Delay init_anfiae_aktiv_ans /end LOC_MEASUREMENT /end FUNCTION
/begin FUNCTION Run_SFOp_SLST2__miter_Gradient_ "" /begin OUT_MEASUREMENT SFOp_SLST295_out_ /end OUT_MEASUREMENT /begin LOC_MEASUREMENT SFOp_SLST295_Unit_Delay /end LOC_MEASUREMENT /end FUNCTION
/begin FUNCTION Run_SFOp_SLST2__oll_iae_fil_in1 "" /begin DEF_CHARACTERISTIC FK_NMOTSOLLIAE2_ANS /end DEF_CHARACTERISTIC /begin OUT_MEASUREMENT SFOp_SLST207_x2_ /end OUT_MEASUREMENT /begin LOC_MEASUREMENT SFOp_SLST206_x2_ SFOp_SLST207_Unit_Delay2 /end LOC_MEASUREMENT /end FUNCTION
/begin FUNCTION Run_SFOp_SLST2__radient_MMaxIae "" /begin OUT_MEASUREMENT SFOp_SLST252_out_ /end OUT_MEASUREMENT /begin LOC_MEASUREMENT SFOp_SLST252_Unit_Delay /end LOC_MEASUREMENT /end FUNCTION
/begin FUNCTION Run_SFOp_SLST2__radient_MSollK0 "" /begin OUT_MEASUREMENT SFOp_SLST260_out_ /end OUT_MEASUREMENT /begin LOC_MEASUREMENT SFOp_SLST260_Unit_Delay /end LOC_MEASUREMENT /end FUNCTION
/begin FUNCTION Run_SFOp_SLST2__soll_iae_fil_in "" /begin DEF_CHARACTERISTIC FK_NMOTSOLLIAE1_ANS /end DEF_CHARACTERISTIC /begin OUT_MEASUREMENT SFOp_SLST206_x2_ /end OUT_MEASUREMENT /begin LOC_MEASUREMENT SFOp_SLST206_Unit_Delay2 /end LOC_MEASUREMENT /end FUNCTION
/begin FUNCTION Run_SFOp_SLST2__TimerDownMgK0Vz "" /begin DEF_CHARACTERISTIC T_VZMGK0_ANS /end DEF_CHARACTERISTIC /begin OUT_MEASUREMENT SFOp_SLST261_isActive_ SFOp_SLST261_t_left_ /end OUT_MEASUREMENT /begin LOC_MEASUREMENT SFOp_SLST261_Unit_Delay /end LOC_MEASUREMENT /end FUNCTION
/begin FUNCTION Run_SFOp_SLST352_CL_PT1_sec_ "" /begin DEF_CHARACTERISTIC FK_14NSOLLVM_ANS /end DEF_CHARACTERISTIC /begin OUT_MEASUREMENT SFOp_SLST352_x_filt_ SFOp_SLST352_xg_filt_ /end OUT_MEASUREMENT /begin LOC_MEASUREMENT SFOp_SLST352_Unit_Delay2 /end LOC_MEASUREMENT /end FUNCTION
/begin FUNCTION Run_SFOp_SLST389_cTimer_T1MAX "" /begin DEF_CHARACTERISTIC T_1MAX_ANS /end DEF_CHARACTERISTIC /begin OUT_MEASUREMENT SFOp_SLST389_isActive_ SFOp_SLST389_t_left_ /end OUT_MEASUREMENT /begin LOC_MEASUREMENT SFOp_SLST389_Unit_Delay /end LOC_MEASUREMENT /end FUNCTION
/begin FUNCTION Run_SFOp_SLST3__adient_MMaxIae1 "" /begin OUT_MEASUREMENT SFOp_SLST327_out_ /end OUT_MEASUREMENT /begin LOC_MEASUREMENT SFOp_SLST327_Unit_Delay /end LOC_MEASUREMENT /end FUNCTION
/begin FUNCTION Run_SFOp_SLST3__cTimer_4Max_Ans "" /begin DEF_CHARACTERISTIC T_4MAX_ANS /end DEF_CHARACTERISTIC /begin OUT_MEASUREMENT SFOp_SLST322_isActive_ SFOp_SLST322_t_left_ /end OUT_MEASUREMENT /begin LOC_MEASUREMENT SFOp_SLST322_Unit_Delay /end LOC_MEASUREMENT /end FUNCTION
/begin FUNCTION Run_SFOp_SLST3__er_WAITSCHLUPF_ "" /begin OUT_MEASUREMENT SFOp_SLST395_isActive_ SFOp_SLST395_t_left_ /end OUT_MEASUREMENT /begin LOC_MEASUREMENT SFOp_SLST395_Unit_Delay /end LOC_MEASUREMENT /end FUNCTION
/begin FUNCTION Run_SFOp_SLST3__miter_Gradient_ "" /begin OUT_MEASUREMENT SFOp_SLST334_out_ /end OUT_MEASUREMENT /begin LOC_MEASUREMENT SFOp_SLST334_Unit_Delay /end LOC_MEASUREMENT /end FUNCTION
/begin FUNCTION Run_SFOp_SLST3__NCHRON_DEFAULT_ "" /begin DEF_CHARACTERISTIC T_NDG T_VORSYNC /end DEF_CHARACTERISTIC
 /begin OUT_MEASUREMENT SFOp_SLST333_haften_b_ SFOp_SLST333_synchron_b_loc_ SFOp_SLST333_vorsynchron_b_loc_ /end OUT_MEASUREMENT
 /begin LOC_MEASUREMENT SFOp_SLST342_Unit_Delay2 SFOp_SLST344_Unit_Delay2 /end LOC_MEASUREMENT
/end FUNCTION
/begin FUNCTION Run_SFOp_SLST3__radient_MMaxIae "" /begin OUT_MEASUREMENT SFOp_SLST394_out_ /end OUT_MEASUREMENT /begin LOC_MEASUREMENT SFOp_SLST394_Unit_Delay /end LOC_MEASUREMENT /end FUNCTION
/begin FUNCTION Run_SFOp_SLST3__radient_MSollK0 "" /begin OUT_MEASUREMENT SFOp_SLST335_out_ /end OUT_MEASUREMENT /begin LOC_MEASUREMENT SFOp_SLST335_Unit_Delay /end LOC_MEASUREMENT /end FUNCTION
/begin FUNCTION Run_SFOp_SLST420_CL_PT1_sec_ "" /begin DEF_CHARACTERISTIC FK_14NSOLLVM_ANS /end DEF_CHARACTERISTIC /begin OUT_MEASUREMENT SFOp_SLST420_x_filt_ SFOp_SLST420_xg_filt_ /end OUT_MEASUREMENT /begin LOC_MEASUREMENT SFOp_SLST420_Unit_Delay2 /end LOC_MEASUREMENT /end FUNCTION
/begin FUNCTION Run_SFOp_SLST489_CL_PT1_sec_ "" /begin DEF_CHARACTERISTIC FK_14NSOLLVM_ANS /end DEF_CHARACTERISTIC /begin OUT_MEASUREMENT SFOp_SLST489_x_filt_ SFOp_SLST489_xg_filt_ /end OUT_MEASUREMENT /begin LOC_MEASUREMENT SFOp_SLST489_Unit_Delay2 /end LOC_MEASUREMENT /end FUNCTION
/begin FUNCTION Run_SFOp_SLST4___3vzmsollk0_ans "" /begin OUT_MEASUREMENT SFOp_SLST477_out_ /end OUT_MEASUREMENT /begin LOC_MEASUREMENT SFOp_SLST477_Unit_Delay /end LOC_MEASUREMENT /end FUNCTION
/begin FUNCTION Run_SFOp_SLST4__adient_MMaxIae1 "" /begin OUT_MEASUREMENT SFOp_SLST469_out_ /end OUT_MEASUREMENT /begin LOC_MEASUREMENT SFOp_SLST469_Unit_Delay /end LOC_MEASUREMENT /end FUNCTION
/begin FUNCTION Run_SFOp_SLST4__cTimer_3Max_Ans "" /begin DEF_CHARACTERISTIC T_3MAX_ANS /end DEF_CHARACTERISTIC /begin OUT_MEASUREMENT SFOp_SLST460_isActive_ SFOp_SLST460_t_left_ /end OUT_MEASUREMENT /begin LOC_MEASUREMENT SFOp_SLST460_Unit_Delay /end LOC_MEASUREMENT /end FUNCTION
/begin FUNCTION Run_SFOp_SLST4__cTimer_trigger_ "" /begin OUT_MEASUREMENT SFOp_SLST461_isActive_ SFOp_SLST461_t_left_ /end OUT_MEASUREMENT /begin LOC_MEASUREMENT SFOp_SLST461_Unit_Delay t_3minablvar_ans_mes /end LOC_MEASUREMENT /end FUNCTION
/begin FUNCTION Run_SFOp_SLST4__ent_msollk0_kon "" /begin OUT_MEASUREMENT SFOp_SLST413_out_ /end OUT_MEASUREMENT /begin LOC_MEASUREMENT SFOp_SLST413_Unit_Delay /end LOC_MEASUREMENT /end FUNCTION
/begin FUNCTION Run_SFOp_SLST4__Max_slstabb_Ans "" /begin DEF_CHARACTERISTIC T_10MAX_ANS /end DEF_CHARACTERISTIC /begin OUT_MEASUREMENT SFOp_SLST431_isActive_ SFOp_SLST431_t_left_ /end OUT_MEASUREMENT /begin LOC_MEASUREMENT SFOp_SLST431_Unit_Delay /end LOC_MEASUREMENT /end FUNCTION
/begin FUNCTION Run_SFOp_SLST4__radient_MSoll_a "" /begin OUT_MEASUREMENT SFOp_SLST478_out_ /end OUT_MEASUREMENT /begin LOC_MEASUREMENT SFOp_SLST478_Unit_Delay /end LOC_MEASUREMENT /end FUNCTION
/begin FUNCTION Run_SFOp_SLST4__radient_MSollK0 "" /begin DEF_CHARACTERISTIC MG_10SOLLK0_ANS /end DEF_CHARACTERISTIC /begin OUT_MEASUREMENT SFOp_SLST435_out_ /end OUT_MEASUREMENT /begin LOC_MEASUREMENT SFOp_SLST435_Unit_Delay /end LOC_MEASUREMENT /end FUNCTION
/begin FUNCTION Run_SFOp_SLST5__ate_t_0_max_ans "" /begin DEF_CHARACTERISTIC T_0MAX_ANS /end DEF_CHARACTERISTIC /begin OUT_MEASUREMENT SFOp_SLST509_isActive_ SFOp_SLST509_t_left_ /end OUT_MEASUREMENT /begin LOC_MEASUREMENT SFOp_SLST509_Unit_Delay /end LOC_MEASUREMENT /end FUNCTION
/begin FUNCTION Run_SFOp_SLST5__L_PT1_14nsollvm "" /begin DEF_CHARACTERISTIC FK_14NSOLLVM_ANS /end DEF_CHARACTERISTIC /begin OUT_MEASUREMENT SFOp_SLST510_x_filt_ SFOp_SLST510_xg_filt_ /end OUT_MEASUREMENT /begin LOC_MEASUREMENT SFOp_SLST510_Unit_Delay2 /end LOC_MEASUREMENT /end FUNCTION
/begin FUNCTION Run_SFOp_SLST8__T1_m_stoer_em_1 "" /begin OUT_MEASUREMENT SFOp_SLST82_x2_ /end OUT_MEASUREMENT /begin LOC_MEASUREMENT SFOp_SLST82_Unit_Delay2 /end LOC_MEASUREMENT /end FUNCTION
/begin FUNCTION Run_SFOp_SLST8__T1_m_stoer_em_2 "" /begin OUT_MEASUREMENT SFOp_SLST83_x2_ /end OUT_MEASUREMENT /begin LOC_MEASUREMENT SFOp_SLST82_x2_ SFOp_SLST83_Unit_Delay2 /end LOC_MEASUREMENT /end FUNCTION
/begin FUNCTION Run_SFOp_SLST8__t_mstoerk0emfil "" /begin OUT_MEASUREMENT SFOp_SLST84_isActive_ SFOp_SLST84_t_left_ /end OUT_MEASUREMENT /begin LOC_MEASUREMENT SFOp_SLST84_Unit_Delay /end LOC_MEASUREMENT /end FUNCTION
/begin FUNCTION Run_SFOp_SLST9___statusiaeplaus "" /begin DEF_CHARACTERISTIC T_STATUSIAE_PLAUS_ANS /end DEF_CHARACTERISTIC /begin OUT_MEASUREMENT SFOp_SLST98_isActive_ SFOp_SLST98_t_left_ /end OUT_MEASUREMENT /begin LOC_MEASUREMENT SFOp_SLST98_Unit_Delay /end LOC_MEASUREMENT /end FUNCTION
/begin FUNCTION Run_SFOp_VMA30_cTimer_trigger_ "" /begin DEF_CHARACTERISTIC T_NVMAUSERK_AST_VMA /end DEF_CHARACTERISTIC /begin OUT_MEASUREMENT SFOp_VMA30_isActive_ SFOp_VMA30_t_left_ /end OUT_MEASUREMENT /begin LOC_MEASUREMENT SFOp_VMA30_Unit_Delay /end LOC_MEASUREMENT /end FUNCTION
/begin FUNCTION Run_SFOp_VME33_cTimer_trigger_ "" /begin DEF_CHARACTERISTIC T_NVMEINERK_ZST_VME /end DEF_CHARACTERISTIC /begin OUT_MEASUREMENT SFOp_VME33_isActive_ SFOp_VME33_t_left_ /end OUT_MEASUREMENT /begin LOC_MEASUREMENT SFOp_VME33_Unit_Delay /end LOC_MEASUREMENT /end FUNCTION
/begin FUNCTION Run_SFOp_Zus145_cPT1_NVMSoll "" /begin DEF_CHARACTERISTIC FK_NSOLLVM_SAK_ZUS /end DEF_CHARACTERISTIC /begin OUT_MEASUREMENT SFOp_Zus145_x_ /end OUT_MEASUREMENT /begin LOC_MEASUREMENT SFOp_Zus145_Unit_Delay2 /end LOC_MEASUREMENT /end FUNCTION
/begin FUNCTION Run_SFOp_Zus14__e_t_max_sak_zus "" /begin DEF_CHARACTERISTIC T_MAX_SAK_ZUS /end DEF_CHARACTERISTIC /begin OUT_MEASUREMENT SFOp_Zus144_isActive_ SFOp_Zus144_t_left_ /end OUT_MEASUREMENT /begin LOC_MEASUREMENT SFOp_Zus144_Unit_Delay /end LOC_MEASUREMENT /end FUNCTION
/begin FUNCTION Run_SFOp_Zus15__t_m_soll_k0_has "" /begin OUT_MEASUREMENT SFOp_Zus151_out_ /end OUT_MEASUREMENT /begin LOC_MEASUREMENT SFOp_Zus151_Unit_Delay /end LOC_MEASUREMENT /end FUNCTION
/begin FUNCTION Run_SFOp_Zus171_cTimer_trigger_ "" /begin DEF_CHARACTERISTIC T_MAX_SCL_ZUS /end DEF_CHARACTERISTIC /begin OUT_MEASUREMENT SFOp_Zus171_isActive_ SFOp_Zus171_t_left_ /end OUT_MEASUREMENT /begin LOC_MEASUREMENT SFOp_Zus171_Unit_Delay /end LOC_MEASUREMENT /end FUNCTION
/begin FUNCTION Run_SFOp_Zus17__dient_m_mod_has "" /begin OUT_MEASUREMENT SFOp_Zus173_out_ /end OUT_MEASUREMENT /begin LOC_MEASUREMENT SFOp_Zus173_Unit_Delay mg_k0_mod_max_zus /end LOC_MEASUREMENT /end FUNCTION
/begin FUNCTION Run_SFOp_Zus17__t_m_soll_k0_has "" /begin OUT_MEASUREMENT SFOp_Zus174_out_ /end OUT_MEASUREMENT /begin LOC_MEASUREMENT SFOp_Zus174_Unit_Delay mg_soll_k0_max_zus /end LOC_MEASUREMENT /end FUNCTION
/begin FUNCTION Run_SFOp_Zus186_cTimer_trigger_ "" /begin DEF_CHARACTERISTIC T_MK0MODZIEL_SCL_ZUS /end DEF_CHARACTERISTIC /begin OUT_MEASUREMENT SFOp_Zus186_isActive_ SFOp_Zus186_t_left_ /end OUT_MEASUREMENT /begin LOC_MEASUREMENT SFOp_Zus186_Unit_Delay /end LOC_MEASUREMENT /end FUNCTION
/begin FUNCTION Run_SFOp_Zus18__oll_k0_anst_zus "" /begin DEF_CHARACTERISTIC T_MSOLLK0ANSTMAX_SCL_ZUS /end DEF_CHARACTERISTIC /begin OUT_MEASUREMENT SFOp_Zus183_isActive_ SFOp_Zus183_t_left_ /end OUT_MEASUREMENT /begin LOC_MEASUREMENT SFOp_Zus183_Unit_Delay /end LOC_MEASUREMENT /end FUNCTION
/begin FUNCTION Run_SFOp_Zus20__egaktiv_syn_zus "" /begin DEF_CHARACTERISTIC T_VK0SREGAKTIV_SYN_ZUS /end DEF_CHARACTERISTIC /begin OUT_MEASUREMENT SFOp_Zus205_isActive_ SFOp_Zus205_t_left_ /end OUT_MEASUREMENT /begin LOC_MEASUREMENT SFOp_Zus205_Unit_Delay /end LOC_MEASUREMENT /end FUNCTION
/begin FUNCTION Run_SFOp_Zus219_CL_DT1 "" /begin DEF_CHARACTERISTIC FK_NDGSOLLVMNVM_SYN_ZUS /end DEF_CHARACTERISTIC /begin OUT_MEASUREMENT SFOp_Zus219_x_filter_ SFOp_Zus219_xp_ /end OUT_MEASUREMENT /begin LOC_MEASUREMENT SFOp_Zus220_Unit_Delay2 nd_sollvmnvm_syn_zus /end LOC_MEASUREMENT /end FUNCTION
/begin FUNCTION Run_SFOp_Zus21__0k0sreg_syn_zus "" /begin DEF_CHARACTERISTIC T_NDGK0K0SREGMIN_SYN_ZUS /end DEF_CHARACTERISTIC /begin OUT_MEASUREMENT SFOp_Zus216_isActive_ SFOp_Zus216_t_left_ /end OUT_MEASUREMENT /begin LOC_MEASUREMENT SFOp_Zus216_Unit_Delay /end LOC_MEASUREMENT /end FUNCTION
/begin FUNCTION Run_SFOp_Zus21__egbasis_syn_zus "" /begin DEF_CHARACTERISTIC T_K0SREGBASISMAX_SYN_ZUS /end DEF_CHARACTERISTIC /begin OUT_MEASUREMENT SFOp_Zus210_isActive_ SFOp_Zus210_t_left_ /end OUT_MEASUREMENT /begin LOC_MEASUREMENT SFOp_Zus210_Unit_Delay /end LOC_MEASUREMENT /end FUNCTION
/begin FUNCTION Run_SFOp_Zus23__nt_m_k0_mod_has "" /begin OUT_MEASUREMENT SFOp_Zus232_out_ /end OUT_MEASUREMENT /begin LOC_MEASUREMENT SFOp_Zus198_KL__DMAXMAX_SYN_ZUS SFOp_Zus232_Unit_Delay /end LOC_MEASUREMENT /end FUNCTION
/begin FUNCTION Run_SFOp_Zus23__radient_MSollK0 "" /begin DEF_CHARACTERISTIC MG_SOLLK0MIN_SYN_ZUS /end DEF_CHARACTERISTIC /begin OUT_MEASUREMENT SFOp_Zus231_out_ /end OUT_MEASUREMENT /begin LOC_MEASUREMENT SFOp_Zus231_Unit_Delay mg_soll_k0_syn_zus /end LOC_MEASUREMENT /end FUNCTION
/begin FUNCTION Run_SFOp_Zus23__yncerk_syn_zus_ "" /begin DEF_CHARACTERISTIC T_VK0SYNCERK_SYN_ZUS /end DEF_CHARACTERISTIC /begin OUT_MEASUREMENT SFOp_Zus239_isActive_ SFOp_Zus239_t_left_ /end OUT_MEASUREMENT /begin LOC_MEASUREMENT SFOp_Zus239_Unit_Delay /end LOC_MEASUREMENT /end FUNCTION
/begin FUNCTION Run_SFOp_Zus247_cPT1_NVMSoll "" /begin DEF_CHARACTERISTIC FK_NSOLLVM_ANH_ZUS /end DEF_CHARACTERISTIC /begin OUT_MEASUREMENT SFOp_Zus247_x_ /end OUT_MEASUREMENT /begin LOC_MEASUREMENT SFOp_Zus247_Unit_Delay2 /end LOC_MEASUREMENT /end FUNCTION
/begin FUNCTION Run_SFOp_Zus24__erkums_syn_zus_ "" /begin OUT_MEASUREMENT SFOp_Zus243_isActive_ SFOp_Zus243_t_left_ /end OUT_MEASUREMENT /begin LOC_MEASUREMENT SFOp_Zus240_KL__CERKUMS_SYN_ZUS SFOp_Zus243_Unit_Delay /end LOC_MEASUREMENT /end FUNCTION
/begin FUNCTION Run_SFOp_Zus25__mer_NSollVMInit "" /begin DEF_CHARACTERISTIC T_VMDZIELSOLLK0_SYN_ZUS /end DEF_CHARACTERISTIC /begin OUT_MEASUREMENT SFOp_Zus253_isActive_ SFOp_Zus253_t_left_ /end OUT_MEASUREMENT /begin LOC_MEASUREMENT SFOp_Zus253_Unit_Delay /end LOC_MEASUREMENT /end FUNCTION
/begin FUNCTION Run_SFOp_Zus25__radient_MSollK0 "" /begin DEF_CHARACTERISTIC NG_EMMODRSMIN_SYN_ZUS /end DEF_CHARACTERISTIC /begin OUT_MEASUREMENT SFOp_Zus259_out_ /end OUT_MEASUREMENT /begin LOC_MEASUREMENT SFOp_Zus259_Unit_Delay ng_emmodrsmax_syn_zus /end LOC_MEASUREMENT /end FUNCTION
/begin FUNCTION Run_SFOp_Zus278_cTimer_trigger_ "" /begin DEF_CHARACTERISTIC T_VMSTATUSMAX_ABF_ZUS /end DEF_CHARACTERISTIC /begin OUT_MEASUREMENT SFOp_Zus278_isActive_ SFOp_Zus278_t_left_ /end OUT_MEASUREMENT /begin LOC_MEASUREMENT SFOp_Zus278_Unit_Delay /end LOC_MEASUREMENT /end FUNCTION
/begin FUNCTION Run_SFOp_Zus27__adient_m_k0_has "" /begin DEF_CHARACTERISTIC MG_SOLLK0NEG_ABF_ZUS MG_SOLLK0POS_ABF_ZUS /end DEF_CHARACTERISTIC /begin OUT_MEASUREMENT SFOp_Zus279_out_ /end OUT_MEASUREMENT /begin LOC_MEASUREMENT SFOp_Zus279_Unit_Delay /end LOC_MEASUREMENT /end FUNCTION
/begin FUNCTION Run_SFOp_Zus284_cPT1_NVMSoll "" /begin DEF_CHARACTERISTIC FK_NSOLLVM_ANH_ZUS /end DEF_CHARACTERISTIC /begin OUT_MEASUREMENT SFOp_Zus284_x_ /end OUT_MEASUREMENT /begin LOC_MEASUREMENT SFOp_Zus284_Unit_Delay2 /end LOC_MEASUREMENT /end FUNCTION
/begin FUNCTION Run_SFOp_Zus300_cTimer_trigger_ "" /begin DEF_CHARACTERISTIC T_VMSTATUSMAX_ANH_ZUS /end DEF_CHARACTERISTIC /begin OUT_MEASUREMENT SFOp_Zus300_isActive_ SFOp_Zus300_t_left_ /end OUT_MEASUREMENT /begin LOC_MEASUREMENT SFOp_Zus300_Unit_Delay /end LOC_MEASUREMENT /end FUNCTION
/begin FUNCTION Run_SFOp_Zus302_cPT1_NVMSoll "" /begin DEF_CHARACTERISTIC FK_NSOLLVM_ANH_ZUS /end DEF_CHARACTERISTIC /begin OUT_MEASUREMENT SFOp_Zus302_x_ /end OUT_MEASUREMENT /begin LOC_MEASUREMENT SFOp_Zus302_Unit_Delay2 /end LOC_MEASUREMENT /end FUNCTION
/begin FUNCTION Run_SFOp_Zus31__hlerbed_fuw_zus "" /begin OUT_MEASUREMENT SFOp_Zus310_isActive_ SFOp_Zus310_t_left_ /end OUT_MEASUREMENT /begin LOC_MEASUREMENT SFOp_Zus310_Unit_Delay /end LOC_MEASUREMENT /end FUNCTION
/begin FUNCTION Run_SFOp_Zus31__iter_Gradient_1 "" /begin OUT_MEASUREMENT SFOp_Zus313_out_ /end OUT_MEASUREMENT /begin LOC_MEASUREMENT SFOp_Zus313_Unit_Delay /end LOC_MEASUREMENT /end FUNCTION
/begin FUNCTION Run_SFOp_Zus32__r_t_max_abb_zus "" /begin DEF_CHARACTERISTIC T_MAX_ABB_ZUS /end DEF_CHARACTERISTIC /begin OUT_MEASUREMENT SFOp_Zus327_isActive_ SFOp_Zus327_t_left_ /end OUT_MEASUREMENT /begin LOC_MEASUREMENT SFOp_Zus327_Unit_Delay /end LOC_MEASUREMENT /end FUNCTION
/begin FUNCTION Run_SFOp_Zus32__radient_MSollK0 "" /begin DEF_CHARACTERISTIC MG_SOLLK0_ABB_ZUS /end DEF_CHARACTERISTIC /begin OUT_MEASUREMENT SFOp_Zus329_out_ /end OUT_MEASUREMENT /begin LOC_MEASUREMENT SFOp_Zus329_Unit_Delay /end LOC_MEASUREMENT /end FUNCTION
/begin FUNCTION Run_SFOp_Zus347_cTimer_trigger_ "" /begin DEF_CHARACTERISTIC T_VK0BEFKALTNEM_ZST_ZUS /end DEF_CHARACTERISTIC /begin OUT_MEASUREMENT SFOp_Zus347_isActive_ SFOp_Zus347_t_left_ /end OUT_MEASUREMENT /begin LOC_MEASUREMENT SFOp_Zus347_Unit_Delay /end LOC_MEASUREMENT /end FUNCTION
/begin FUNCTION Run_SFOp_Zus34___k0_min_uvs_zus "" /begin DEF_CHARACTERISTIC MG_SOLLK0UVSNEG_ZST_ZUS MG_SOLLK0UVSPOS_ZST_ZUS /end DEF_CHARACTERISTIC /begin OUT_MEASUREMENT SFOp_Zus346_out_ /end OUT_MEASUREMENT /begin LOC_MEASUREMENT SFOp_Zus346_Unit_Delay /end LOC_MEASUREMENT /end FUNCTION
/begin FUNCTION Run_SFOp_Zus34__t_m_soll_k0_has "" /begin OUT_MEASUREMENT SFOp_Zus345_out_ /end OUT_MEASUREMENT /begin LOC_MEASUREMENT SFOp_Zus345_Unit_Delay /end LOC_MEASUREMENT /end FUNCTION
/begin FUNCTION Run_SFOp_Zus357_cPT1_NVMSoll "" /begin DEF_CHARACTERISTIC FK_NSOLLVM_ZST_ZUS /end DEF_CHARACTERISTIC /begin OUT_MEASUREMENT SFOp_Zus357_x_ /end OUT_MEASUREMENT /begin LOC_MEASUREMENT SFOp_Zus357_Unit_Delay2 /end LOC_MEASUREMENT /end FUNCTION
/begin FUNCTION Run_SFOp_Zus77__emaktiv_fuw_zus "" /begin DEF_CHARACTERISTIC T_MAX_EMAKTIV_FUW_ZUS /end DEF_CHARACTERISTIC /begin OUT_MEASUREMENT SFOp_Zus77_isActive_ SFOp_Zus77_t_left_ /end OUT_MEASUREMENT /begin LOC_MEASUREMENT SFOp_Zus77_Unit_Delay /end LOC_MEASUREMENT /end FUNCTION
/begin FUNCTION Run_SFOp_Zus78_cDT1_ngem "" /begin DEF_CHARACTERISTIC FK_NGEM_ZUS /end DEF_CHARACTERISTIC /begin OUT_MEASUREMENT SFOp_Zus78_x_filter_ SFOp_Zus78_xp_ /end OUT_MEASUREMENT /begin LOC_MEASUREMENT SFOp_Zus79_Unit_Delay2 n_em_in /end LOC_MEASUREMENT /end FUNCTION
/begin FUNCTION Run_SFOp_Zus85__sollemaktiv_zus "" /begin DEF_CHARACTERISTIC T_MSOLLEMAKTIVMAX_ZUS /end DEF_CHARACTERISTIC /begin OUT_MEASUREMENT SFOp_Zus85_isActive_ SFOp_Zus85_t_left_ /end OUT_MEASUREMENT /begin LOC_MEASUREMENT SFOp_Zus85_Unit_Delay /end LOC_MEASUREMENT /end FUNCTION
/begin FUNCTION Run_SFOp_Zus88__0em_fil_basis_1 "" /begin OUT_MEASUREMENT SFOp_Zus88_x2_ /end OUT_MEASUREMENT /begin LOC_MEASUREMENT SFOp_Zus88_Unit_Delay2 /end LOC_MEASUREMENT /end FUNCTION
/begin FUNCTION Run_SFOp_Zus89__0em_fil_basis_2 "" /begin OUT_MEASUREMENT SFOp_Zus89_x2_ /end OUT_MEASUREMENT /begin LOC_MEASUREMENT SFOp_Zus88_x2_ SFOp_Zus89_Unit_Delay2 /end LOC_MEASUREMENT /end FUNCTION
/begin FUNCTION Run_SFOp_Zus90__toerk0emfil_zus "" /begin OUT_MEASUREMENT SFOp_Zus90_isActive_ SFOp_Zus90_t_left_ /end OUT_MEASUREMENT /begin LOC_MEASUREMENT SFOp_Zus90_Unit_Delay /end LOC_MEASUREMENT /end FUNCTION
/begin FUNCTION Run_SFSBo141_cTimer_ "" /begin DEF_CHARACTERISTIC T_VBRE_ABS_MSA_HAS /end DEF_CHARACTERISTIC /begin OUT_MEASUREMENT SFSBo141_isActive_ SFSBo141_t_left_ /end OUT_MEASUREMENT /begin LOC_MEASUREMENT SFSBo141_Unit_Delay /end LOC_MEASUREMENT /end FUNCTION
/begin FUNCTION Run_SFSBo154_c___maxsas_msa_has "" /begin OUT_MEASUREMENT SFSBo154_isActive_ SFSBo154_t_left_ /end OUT_MEASUREMENT /begin LOC_MEASUREMENT SFSBo154_Unit_Delay /end LOC_MEASUREMENT /end FUNCTION
/begin FUNCTION Run_SFSBo155_c__ckgesas_msa_has "" /begin DEF_CHARACTERISTIC T_VRUECKGELSAS_MSA_HAS /end DEF_CHARACTERISTIC /begin OUT_MEASUREMENT SFSBo155_isActive_ SFSBo155_t_left_ /end OUT_MEASUREMENT /begin LOC_MEASUREMENT SFSBo155_Unit_Delay /end LOC_MEASUREMENT /end FUNCTION
/begin FUNCTION Run_SFSBo156_c__uecksas_msa_has "" /begin OUT_MEASUREMENT SFSBo156_isActive_ SFSBo156_t_left_ /end OUT_MEASUREMENT /begin LOC_MEASUREMENT SFSBo156_Unit_Delay /end LOC_MEASUREMENT /end FUNCTION
/begin FUNCTION Run_SFSBo163_c___t_berg_msa_has "" /begin OUT_MEASUREMENT SFSBo163_isActive_ SFSBo163_t_left_ /end OUT_MEASUREMENT /begin LOC_MEASUREMENT SFSBo163_Unit_Delay /end LOC_MEASUREMENT /end FUNCTION
/begin FUNCTION Run_SFSBo182_cTimer_trigger_ "" /begin OUT_MEASUREMENT SFSBo182_isActive_ SFSBo182_t_left_ /end OUT_MEASUREMENT /begin LOC_MEASUREMENT SFSBo182_Unit_Delay /end LOC_MEASUREMENT /end FUNCTION
/begin FUNCTION Run_SFSBo200_cLimiter_Gradient_ "" /begin OUT_MEASUREMENT SFSBo200_out_ /end OUT_MEASUREMENT /begin LOC_MEASUREMENT SFSBo200_Unit_Delay /end LOC_MEASUREMENT /end FUNCTION
/begin FUNCTION Run_SFSBo210_CL_PT1_ "" /begin OUT_MEASUREMENT SFSBo210_x_ /end OUT_MEASUREMENT
 /begin LOC_MEASUREMENT SFSBo210_Unit_Delay2 n_min_em_lls_has_ngef n_mineminit_lls_has z_nmineminit_lls_has /end LOC_MEASUREMENT
/end FUNCTION
/begin FUNCTION Run_SFSBo211_CL_PT1_1 "" /begin OUT_MEASUREMENT SFSBo211_x_ /end OUT_MEASUREMENT
 /begin LOC_MEASUREMENT SFSBo210_x_ SFSBo211_Unit_Delay2 n_mineminit_lls_has z_nmineminit_lls_has /end LOC_MEASUREMENT
/end FUNCTION
/begin FUNCTION Run_SFSBo220_cTimer_testablvar "" /begin DEF_CHARACTERISTIC T_NMINEMBEFUELLFZP_LLS_HAS /end DEF_CHARACTERISTIC /begin OUT_MEASUREMENT SFSBo220_isActive_ SFSBo220_t_left_ /end OUT_MEASUREMENT /begin LOC_MEASUREMENT SFSBo220_Unit_Delay /end LOC_MEASUREMENT /end FUNCTION
/begin FUNCTION Run_SFSBo223_cLimiter_Gradient_ "" /begin OUT_MEASUREMENT SFSBo223_out_ /end OUT_MEASUREMENT /begin LOC_MEASUREMENT SFSBo223_Unit_Delay z_nmineminit_lls_has /end LOC_MEASUREMENT /end FUNCTION
/begin FUNCTION Run_SFSBo24_cT__sashasaktiv_bbr "" /begin DEF_CHARACTERISTIC T_ZIEPHASAKTIV_BFI_HAS /end DEF_CHARACTERISTIC /begin OUT_MEASUREMENT SFSBo24_isActive_ SFSBo24_t_left_ /end OUT_MEASUREMENT /begin LOC_MEASUREMENT SFSBo24_Unit_Delay /end LOC_MEASUREMENT /end FUNCTION
/begin FUNCTION Run_SFSBo25_cT___zsashasmax_bbr "" /begin DEF_CHARACTERISTIC T_ZIEPHASMAX_BFI_HAS /end DEF_CHARACTERISTIC /begin OUT_MEASUREMENT SFSBo25_isActive_ SFSBo25_t_left_ /end OUT_MEASUREMENT /begin LOC_MEASUREMENT SFSBo25_Unit_Delay /end LOC_MEASUREMENT /end FUNCTION
/begin FUNCTION Run_SFSBo33_cT__sashasaktiv_bbr "" /begin DEF_CHARACTERISTIC T_ZSASHASAKTIV_BBR_HAS /end DEF_CHARACTERISTIC /begin OUT_MEASUREMENT SFSBo33_isActive_ SFSBo33_t_left_ /end OUT_MEASUREMENT /begin LOC_MEASUREMENT SFSBo33_Unit_Delay /end LOC_MEASUREMENT /end FUNCTION
/begin FUNCTION Run_SFSBo34_cT___zsashasmax_bbr "" /begin OUT_MEASUREMENT SFSBo34_isActive_ SFSBo34_t_left_ /end OUT_MEASUREMENT /begin LOC_MEASUREMENT SFSBo34_Unit_Delay /end LOC_MEASUREMENT /end FUNCTION
/begin FUNCTION Run_SFSBo39_CL__k0_mber_has_sbe "" /begin DEF_CHARACTERISTIC FK_MK0MBERZUS_HAS /end DEF_CHARACTERISTIC /begin OUT_MEASUREMENT SFSBo39_x2_ /end OUT_MEASUREMENT /begin LOC_MEASUREMENT SFSBo39_Unit_Delay2 m_k0_mber_zus_gbegr m_k0_mod_has_fkt /end LOC_MEASUREMENT /end FUNCTION
/begin FUNCTION Run_SFSBo40_cL___mber_zus_gbegr "" /begin DEF_CHARACTERISTIC MG_K0MBERZUSNEG_HAS MG_K0MBERZUSPOS_HAS /end DEF_CHARACTERISTIC /begin OUT_MEASUREMENT SFSBo40_out_ /end OUT_MEASUREMENT /begin LOC_MEASUREMENT SFSBo40_Unit_Delay /end LOC_MEASUREMENT /end FUNCTION
/begin FUNCTION Run_SFSTA12_cTimer_trigger_ "" /begin DEF_CHARACTERISTIC T_VZABLAUFREINIT_HAS /end DEF_CHARACTERISTIC /begin OUT_MEASUREMENT SFSTA12_isActive_ SFSTA12_t_left_ /end OUT_MEASUREMENT /begin LOC_MEASUREMENT SFSTA12_Unit_Delay /end LOC_MEASUREMENT /end FUNCTION
/begin FUNCTION Run_SSAi81_cDelay_m_soll_em "" /begin DEF_CHARACTERISTIC T_MSOLLEMHST_HAS /end DEF_CHARACTERISTIC /begin OUT_MEASUREMENT SSAi81_out_ /end OUT_MEASUREMENT /begin LOC_MEASUREMENT SSAi84_Unit_Delay1 /end LOC_MEASUREMENT /end FUNCTION
/begin FUNCTION Run_SSAi82_cDelay_m_soll_vm "" /begin DEF_CHARACTERISTIC T_MSOLLVMHST_HAS /end DEF_CHARACTERISTIC /begin OUT_MEASUREMENT SSAi82_out_ /end OUT_MEASUREMENT /begin LOC_MEASUREMENT SSAi87_Unit_Delay1 /end LOC_MEASUREMENT /end FUNCTION
/begin FUNCTION Run_SSAo55_cLi__r_Gradient_m_k0 "" /begin OUT_MEASUREMENT SSAo55_out_ /end OUT_MEASUREMENT /begin LOC_MEASUREMENT SSAo55_Unit_Delay /end LOC_MEASUREMENT /end FUNCTION
/begin FUNCTION Run_TL_FSBi_SignalBerechnung_in ""
 /begin SUB_FUNCTION SFHC10_cN_Min_Psys_EM Run_SFHC61_cPT1MWunsch Run_SFHC60_cDT1MgWunschHST Run_SFHC59_cDT1MgWunsch SFHC54_IfActionSubsystem2 SFHC53_IfActionSubsystem Run_SFHC47_cPt1nseciae Run_SFHC29_cDelayNVM_ Run_SFHC28_cDelayEM_ Run_SFHC27_cDT1_vg_f Run_SFHC26_cDT1_ndgvm Run_SFHC25_cDT1_ndgk0 SFHC6_Unterstu__tilueberwachung /end SUB_FUNCTION
 /begin DEF_CHARACTERISTIC FK_MGWUNSCHFPW FK_NDGK0 FK_NGVM_HAS FK_VGF_HAS KL_ABLVARMPS_HAS_X KL_ABLVARMPS_HAS_Y KL_MPTNT_SBE_X KL_MPTNT_SBE_Y KL_NSEMAUS_MPS_HAS_X KL_NSEMAUS_MPS_HAS_Y KL_NSEMEIN_MPS_HAS_X KL_NSEMEIN_MPS_HAS_Y K_VF_HAS MPT_MWUNSCHFPWHST NDS_SYNCHRON_HAS NS_NT_SBE SWI_NTVIRTNSECIAE_AKTIV_HAS TAB_UEBERSETZUNGEN_EGS T_VNEMNDK0_HAS T_VNVMNDK0_HAS XP_MAX /end DEF_CHARACTERISTIC
 /begin LOC_MEASUREMENT SFHC25_xp_ SFHC26_xp_ SFHC27_xp_ SFHC47_x_ SFHC59_xp_ SFHC60_xp_ SFHC61_x_ abstellpos_vm_in abstellpos_vm_status_in c_getriebe_egs_in c_vm_in gangwechsel_egs_in i_istgang_egs i_zielgang_egs istgang_egs_in m_em_in m_iae_in m_k0_fkt m_k0_in m_k0_mod_has_fkt m_max_dyn_em_in m_max_em_has_fkt m_max_iae_has_fkt m_min_dyn_em_in m_min_em_has_fkt m_min_vm_in m_mot_in m_soll_em_has_fkt m_soll_em_hst_in m_soll_k0_has_fkt m_soll_res_em_has_fkt m_soll_vm_has_fkt m_soll_vm_hst_in m_soll_vm_l_has_fkt m_soll_vm_l_hst_in m_vm_in m_vm_start_in m_wunsch_fpw_hst_fil m_wunsch_fpw_hst_fil_azg m_wunsch_fpw_hst_in m_wunsch_fpw_in mg_max_em_has_fkt mg_min_em_has_fkt mg_soll_K0_fkt mg_soll_k0_has_fkt mg_wunsch_fpw mg_wunsch_fpw_hst mod_K0_fkt n_ab_egs_in n_em_in n_em_verz n_min_psys_em_has_sbe n_mot_soll_iae_in n_sec_iae n_sec_iae_mod n_soll_em_has_fkt n_soll_em_hst_in n_soll_ll_vm_in n_soll_vm_has_fkt n_t_egs_in n_vm_in n_vm_verz nd_iae nd_k0_in nd_soll_iae_fkt ndg_k0_in ng_vm osmode_next_in p_bremse_fzg_in phi_neigung_in pos_egs_in sollgang_egs_in st_OMLID_act_stg st_ablauf_fkt st_ist_bz_has_stg st_soll_bz_has_hst st_ziel_bz_has_stg status_ablauf_has_fkt status_alaengs_adaoff_in status_betriebsbereit_hst_in status_fehler_iep_in status_iae_adap_in status_iae_in status_iep_in status_k0_adap_in status_k0_in status_kl15_in status_kolbenpos_k0_in status_kraftfluss_egs_in status_kraftfluss_egs_roh_in status_ll_vm_in status_nem_in status_nreg_em_hst_in status_nvm_in status_posvueb_in status_psys_has_sbe status_sa_vm_in status_schaltung_egs_in status_sync_schaltung_sbe status_waschstr_in t_betrieb_pvu_has_ee_in t_betrieb_pvu_has_sbe timer_pumpready_aktiv_fkt v_f_sbe vg_f_sbe z_ablauf_has_hst_in z_ablauf_has_stg z_ablauf_svh_reset_has_fkt z_ablaufvariante_has_hst_in z_ablaufvariante_has_stg z_ablaufvariante_kalt_zus z_ba_has_k0_hst_in z_ba_has_vm_hst_in z_diag_ersfkt_has_in z_diag_ersfkt_hi_has_in z_diag_notgang_has_in z_emaktiv_fuw_zus_fkt z_fehler15_eh_fkt z_freigabe_pvu_has_sbe z_hybfkt_stg z_iep_in z_init_fkt z_k0_befuellopt_has_fkt z_k0_fst_in z_k0_has_fkt z_kps_stada_in z_m_begr_em_has_fkt z_m_max_iae_has_fkt z_m_soll_em_has_fkt z_m_soll_vm_has_fkt z_modus_em_hst_in z_modus_iae_has_fkt z_msa_fst_in z_msa_stada_in z_n_min_em_parksp_has_in z_n_min_iep_in z_n_soll_em_has_fkt z_n_soll_vm_has_fkt z_nllsoll_iae_in z_p_hys_k0_has_fkt z_ponr_fkt z_pvu_has_sbe z_saf_has_fkt z_sbe_has_fkt z_standby_em_has_fkt z_status_psys_mps_sbe z_timer_pumpready_fkt z_tmin_fehler15_fkt z_ziel_kraftfluss_egs_in z_zuendfreigabe_vm_fkt z_zuendfreigabe_vm_has_fkt zielgang_egs_in /end LOC_MEASUREMENT
/end FUNCTION
/begin FUNCTION Run_TL_FSBo_SignalBerechnung_out ""
 /begin SUB_FUNCTION SFSBo17_n_min_EM_LL SFSBo189_Variante_BMW SFSBo188_Variante_Audi SFSBo14_Status_EFahren_out SFSBo13_Status_EFahren_BMI SFSBo185_Bitwise_AND_ui8_ Run_SFSBo182_cTimer_trigger_ SFSBo174_Schaltungsrichtung SFSBo173_Lastzustand SFSBo172_Lastaenderungszustand SFSBo10_MSA SFSBo8_Betriebsmodus_IAE_BMI SFSBo7_Bestimm__omentbegrenzung SFSBo6_Beeinfl__uellreihenfolge SFSBo5_BeeinflussungIEP SFSBo4_Anlasse__art_Anforderung /end SUB_FUNCTION
 /begin DEF_CHARACTERISTIC KF_MMOTMAX_HAS_W KF_MMOTMAX_HAS_X KF_MMOTMAX_HAS_Y KF_PMAX_FZP_HAS_W KF_PMAX_FZP_HAS_X KF_PMAX_FZP_HAS_Y KF_SCHALTART_ZUL_SVH_HAS_W KF_SCHALTART_ZUL_SVH_HAS_X KF_SCHALTART_ZUL_SVH_HAS_Y KL_MSMOT_KPS_HAS_X KL_MSMOT_KPS_HAS_Y MO_MOT_KPS_HAS MS_WUNSCHK0SBEDNGEM1_KPS_HAS MS_WUNSCHK0SBEDNGEM2_KPS_HAS NOS_EMK0SBEDNGEM1_KPS_HAS NOS_EMK0SBEDNGEM2_KPS_HAS SWI_K0SCHLUPFBED_PN_HAS SWI_SCHALTARTAKT_SVH_HAS TAB_K0SCHLUPFBED_IAE_HAS TAB_PMAX_IEP_HAS TAB_TVSVHRESET_SVH_HAS TAB_ZK0FSTSBE_HAS /end DEF_CHARACTERISTIC
 /begin LOC_MEASUREMENT abstellpos_vm_in abstellpos_vm_status_in c_getriebe_egs_in c_vm_in gangwechsel_egs_in i_istgang_egs i_zielgang_egs istgang_egs_in m_em_in m_iae_in m_k0_fkt m_k0_in m_k0_mber_has_sbe m_k0_mod_has_fkt m_max_dyn_em_in m_max_em_has_fkt m_max_iae_has_fkt m_min_dyn_em_in m_min_em_has_fkt m_min_vm_in m_mot_in m_motmax_has m_soll_em_has_fkt m_soll_em_hst_in m_soll_k0_has_fkt m_soll_res_em_bas_sbe m_soll_res_em_has_fkt m_soll_res_em_has_sbe m_soll_vm_has_fkt m_soll_vm_hst_in m_soll_vm_l_has_fkt m_soll_vm_l_hst_in m_vm_in m_vm_start_in m_wunsch_fpw_hst_fil m_wunsch_fpw_hst_in m_wunsch_fpw_in mg_max_em_has_fkt mg_min_em_has_fkt mg_soll_K0_fkt mg_soll_k0_has_fkt mg_wunsch_fpw mg_wunsch_fpw_hst mod_K0_fkt n_ab_egs_in n_em_in n_min_em_has_sbe n_min_psys_em_has_sbe n_mot_soll_iae_in n_sec_iae n_soll_em_has_fkt n_soll_em_hst_in n_soll_ll_vm_in n_soll_vm_has_fkt n_t_egs_in n_vm_in nd_iae nd_k0_in nd_soll_iae_fkt ndg_k0_in ng_vm osmode_next_in p_bremse_fzg_in phi_neigung_in pos_egs_in sollgang_egs_in st_OMLID_act_stg st_ablauf_fkt st_ist_bz_has_stg st_soll_bz_has_hst st_ziel_bz_has_stg status_ablauf_has_fkt status_alaengs_adaoff_in status_betriebsbereit_hst_in status_efahren_has_sbe status_fehler15_eh_diagin status_fehler_iep_in status_iae_adap_in status_iae_in status_iep_in status_k0_adap_in status_k0_in status_kl15_in status_kolbenpos_k0_in status_kraftfluss_egs_in status_kraftfluss_egs_roh_in status_ll_vm_in status_nem_in status_nreg_em_hst_in status_nvm_in status_posvueb_in status_psys_has_sbe status_sa_vm_in status_schaltart_svh_has_sbe status_schaltart_zul_svh_has status_schaltung_egs_in status_sync_schaltung_sbe status_waschstr_in status_zug_svh status_zug_svh_sbe t_betrieb_pvu_has_ee_in t_betrieb_pvu_has_sbe t_vsvhreset_svh timer_pumpready_aktiv_fkt v_f_sbe vg_f_sbe z_ablauf_has_hst_in z_ablauf_has_stg z_ablauf_svh_reset_has_fkt z_ablaufreinit_frk_dihi z_ablaufvariante_has_hst_in z_ablaufvariante_has_stg z_ablaufvariante_kalt_zus z_ba_has_k0_hst_in z_ba_has_vm_hst_in z_diag_ersfkt_has_in z_diag_ersfkt_hi_has_in z_diag_notgang_has_in z_emaktiv_fuw_zus_fkt z_emfehler_frk_dihi z_fehler15_eh_fkt z_freigabe_pvu_has_sbe z_fuwdeakt_frk_dihi z_hybfkt_stg z_iep_in z_init_fkt z_k0_befuellopt_has_fkt z_k0_fst_in z_k0_has_fkt z_k0_has_sbe z_k0schlupfbed_iae_has z_k0schlupfbed_mmotiae_kps z_k0schlupfbed_ngem_kps z_k0syncmk0erh_frk_dihi z_kps_stada_in z_m_begr_em_has_fkt z_m_max_iae_has_fkt z_m_soll_em_has_fkt z_m_soll_vm_has_fkt z_modus_em_hst_in z_modus_iae_has_fkt z_modus_iae_has_sbe z_modus_iep_has_sbe z_msa_avh_moni_has_sbe z_msa_eaf_moni_has_sbe z_msa_fst_in z_msa_has_sbe z_msa_stada_in z_n_min_em_parksp_has_in z_n_min_iep_in z_n_soll_em_has_fkt z_n_soll_vm_has_fkt z_nllsoll_iae_in z_nminemnull_frk_dihi z_nvmsollbegr_frk_dihi z_p_hys_k0_has_fkt z_ponr_fkt z_pvu_has_sbe z_saf_has_fkt z_sas_has_sbe z_sbe_has_fkt z_standby_em_has_fkt z_start_modus_has_sbe z_status_psys_mps_sbe z_svh_has_sbe z_timer_pumpready_fkt z_tmin_fehler15_fkt z_ziel_kraftfluss_egs_in z_zuendfreigabe_vm_fkt z_zuendfreigabe_vm_has_fkt zielgang_egs_in /end LOC_MEASUREMENT
/end FUNCTION
/begin RECORD_LAYOUT FLOAT32_IEEE_COL_DIRECT_S6_S3 FNC_VALUES 1 FLOAT32_IEEE COLUMN_DIR DIRECT /end RECORD_LAYOUT
/begin RECORD_LAYOUT FLOAT32_IEEE_X_INCR_DIRECT_S6_S3 AXIS_PTS_X 1 FLOAT32_IEEE INDEX_INCR DIRECT /end RECORD_LAYOUT
/begin RECORD_LAYOUT SBYTE_X_INCR_DIRECT_S6_S3 AXIS_PTS_X 1 SBYTE INDEX_INCR DIRECT /end RECORD_LAYOUT
/begin RECORD_LAYOUT UBYTE_COL_DIRECT_S6_S3 FNC_VALUES 1 UBYTE COLUMN_DIR DIRECT /end RECORD_LAYOUT
/begin RECORD_LAYOUT UBYTE_X_INCR_DIRECT_S6_S3 AXIS_PTS_X 1 UBYTE INDEX_INCR DIRECT /end RECORD_LAYOUT
/end MODULE
/end PROJECT
