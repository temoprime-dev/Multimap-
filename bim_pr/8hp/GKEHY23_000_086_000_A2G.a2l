ASAP2_VERSION 1 51
/begin PROJECT ZHBC8600 "Gen2_BMW_System_Supplier_Lib"
/begin MODULE CPP ""
/begin MOD_COMMON "" BYTE_ORDER MSB_FIRST ALIGNMENT_BYTE 1 ALIGNMENT_WORD 2 ALIGNMENT_LONG 4 ALIGNMENT_FLOAT32_IEEE 4 ALIGNMENT_FLOAT64_IEEE 1 /end MOD_COMMON
/begin COMPU_METHOD SAB2_04PROZENT_S3_S3 "int = ((phys * 10) / 4) - (0) %" RAT_FUNC "%4.3" "%" COEFFS 0 2.5 0 0 0 1 /end COMPU_METHOD
/begin COMPU_METHOD SAB2_05PROZENT_S3_S3 "int = ((phys * 10) / 5) - (0) %" RAT_FUNC "%4.3" "%" COEFFS 0 2 0 0 0 1 /end COMPU_METHOD
/begin COMPU_METHOD UMR___1_100_0_S5_S3 "int = ((phys * 100) / 1) - (0) [-]" RAT_FUNC "%3.2" "[-]" COEFFS 0 100 0 0 0 1 /end COMPU_METHOD
/begin COMPU_METHOD UMR_BAR__1_1000_0_S5_S3 "int = ((phys * 1000) / 1) - (0) [bar]" RAT_FUNC "%4.3" "[bar]" COEFFS 0 1000 0 0 0 1 /end COMPU_METHOD
/begin COMPU_METHOD UMR_GRADC__1_1_M40_S5_S3 "int = ((phys * 1) / 1) - (-40) [°C]" RAT_FUNC "%1.0" "[°C]" COEFFS 0 1 40 0 0 1 /end COMPU_METHOD
/begin COMPU_METHOD UMR_MSEC__10_1_0_S5_S3 "int = ((phys * 1) / 10) - (0) [ms]" RAT_FUNC "%1.0" "[ms]" COEFFS 0 0.1 0 0 0 1 /end COMPU_METHOD
/begin COMPU_METHOD UMR_MSEC__10_1_M128_S5_S3 "int = ((phys * 1) / 10) - (-128) [ms]" RAT_FUNC "%1.0" "[ms]" COEFFS 0 0.1 128 0 0 1 /end COMPU_METHOD
/begin COMPU_METHOD UMR_NM__1_1_0_S5_S3 "int = ((phys * 1) / 1) - (0) [Nm]" RAT_FUNC "%1.0" "[Nm]" COEFFS 0 1 0 0 0 1 /end COMPU_METHOD
/begin COMPU_METHOD UMR_NM__6_1_M34_S5_S3 "int = ((phys * 1) / 6) - (-34) [Nm]" RAT_FUNC "%1.0" "[Nm]" COEFFS 0 0.166666666667 34 0 0 1 /end COMPU_METHOD
/begin COMPU_METHOD UMR_U_MIN_1_1_0_S5_S3 "int = ((phys * 1) / 1) - (0) [U/min]" RAT_FUNC "%1.0" "[U/min]" COEFFS 0 1 0 0 0 1 /end COMPU_METHOD
/begin COMPU_METHOD UMR_U_MIN_32_1_0_S5_S3 "int = ((phys * 1) / 32) - (0) [U/min]" RAT_FUNC "%1.0" "[U/min]" COEFFS 0 0.03125 0 0 0 1 /end COMPU_METHOD
/begin CHARACTERISTIC F_PRAHKAB21 "Druckfaktor waehrend Rampe auf Schaltdruck" VALUE 0x1D799A ZF_kw_ui8_S5_S3 1 UMR___1_100_0_S5_S3 0 1 /end CHARACTERISTIC
/begin CHARACTERISTIC F_PRAHKAB21_EL "Druckfaktor waehrend Rampe auf Schaltdruck" VALUE 0x1D799B ZF_kw_ui8_S5_S3 1 UMR___1_100_0_S5_S3 0 1 /end CHARACTERISTIC
/begin CHARACTERISTIC F_PRAHKAB32 "Druckfaktor waehrend Rampe auf Schaltdruck" VALUE 0x1D799F ZF_kw_ui8_S5_S3 1 UMR___1_100_0_S5_S3 0 1 /end CHARACTERISTIC
/begin CHARACTERISTIC F_PRAHKAB32_EL "Druckfaktor waehrend Rampe auf Schaltdruck" VALUE 0x1D79A0 ZF_kw_ui8_S5_S3 1 UMR___1_100_0_S5_S3 0 1 /end CHARACTERISTIC
/begin CHARACTERISTIC F_PRAHKAB43 "Druckfaktor waehrend Rampe auf Schaltdruck" VALUE 0x1D79A4 ZF_kw_ui8_S5_S3 1 UMR___1_100_0_S5_S3 0 1 /end CHARACTERISTIC
/begin CHARACTERISTIC F_PRAHKAB43_EL "Druckfaktor waehrend Rampe auf Schaltdruck" VALUE 0x1D79A5 ZF_kw_ui8_S5_S3 1 UMR___1_100_0_S5_S3 0 1 /end CHARACTERISTIC
/begin CHARACTERISTIC F_PRAHKAB54 "Druckfaktor waehrend Rampe auf Schaltdruck" VALUE 0x1D79A9 ZF_kw_ui8_S5_S3 1 UMR___1_100_0_S5_S3 0 1 /end CHARACTERISTIC
/begin CHARACTERISTIC F_PRAHKAB54_EL "Druckfaktor waehrend Rampe auf Schaltdruck" VALUE 0x1D79AA ZF_kw_ui8_S5_S3 1 UMR___1_100_0_S5_S3 0 1 /end CHARACTERISTIC
/begin CHARACTERISTIC F_PRAHKAB65 "Druckfaktor waehrend Rampe auf Schaltdruck" VALUE 0x1D79AE ZF_kw_ui8_S5_S3 1 UMR___1_100_0_S5_S3 0 1 /end CHARACTERISTIC
/begin CHARACTERISTIC F_PRAHKAB65_EL "Druckfaktor waehrend Rampe auf Schaltdruck" VALUE 0x1D79AF ZF_kw_ui8_S5_S3 1 UMR___1_100_0_S5_S3 0 1 /end CHARACTERISTIC
/begin CHARACTERISTIC F_PRAHKAB76 "Druckfaktor waehrend Rampe auf Schaltdruck" VALUE 0x1D79B3 ZF_kw_ui8_S5_S3 1 UMR___1_100_0_S5_S3 0 1 /end CHARACTERISTIC
/begin CHARACTERISTIC F_PRAHKAB76_EL "Druckfaktor waehrend Rampe auf Schaltdruck" VALUE 0x1D79B4 ZF_kw_ui8_S5_S3 1 UMR___1_100_0_S5_S3 0 1 /end CHARACTERISTIC
/begin CHARACTERISTIC F_PRAHKAB87 "Druckfaktor waehrend Rampe auf Schaltdruck" VALUE 0x1D79B8 ZF_kw_ui8_S5_S3 1 UMR___1_100_0_S5_S3 0 1 /end CHARACTERISTIC
/begin CHARACTERISTIC F_PRAHKAB87_EL "Druckfaktor waehrend Rampe auf Schaltdruck" VALUE 0x1D79B9 ZF_kw_ui8_S5_S3 1 UMR___1_100_0_S5_S3 0 1 /end CHARACTERISTIC
/begin CHARACTERISTIC F_PRAHKABSP21 "Druckfaktor waehrend Rampe auf Schaltdruck" VALUE 0x1D79BD ZF_kw_ui8_S5_S3 1 UMR___1_100_0_S5_S3 0 1 /end CHARACTERISTIC
/begin CHARACTERISTIC F_PRAHKABSP31 "Druckfaktor waehrend Rampe auf Schaltdruck" VALUE 0x1D79D2 ZF_kw_ui8_S5_S3 1 UMR___1_100_0_S5_S3 0 1 /end CHARACTERISTIC
/begin CHARACTERISTIC F_PRAHKABSP32 "Druckfaktor waehrend Rampe auf Schaltdruck" VALUE 0x1D79C0 ZF_kw_ui8_S5_S3 1 UMR___1_100_0_S5_S3 0 1 /end CHARACTERISTIC
/begin CHARACTERISTIC F_PRAHKABSP42 "Druckfaktor waehrend Rampe auf Schaltdruck" VALUE 0x1D79D5 ZF_kw_ui8_S5_S3 1 UMR___1_100_0_S5_S3 0 1 /end CHARACTERISTIC
/begin CHARACTERISTIC F_PRAHKABSP43 "Druckfaktor waehrend Rampe auf Schaltdruck" VALUE 0x1D79C3 ZF_kw_ui8_S5_S3 1 UMR___1_100_0_S5_S3 0 1 /end CHARACTERISTIC
/begin CHARACTERISTIC F_PRAHKABSP51 "Druckfaktor waehrend Rampe auf Schaltdruck" VALUE 0x1D79D8 ZF_kw_ui8_S5_S3 1 UMR___1_100_0_S5_S3 0 1 /end CHARACTERISTIC
/begin CHARACTERISTIC F_PRAHKABSP53 "Druckfaktor waehrend Rampe auf Schaltdruck" VALUE 0x1D79DB ZF_kw_ui8_S5_S3 1 UMR___1_100_0_S5_S3 0 1 /end CHARACTERISTIC
/begin CHARACTERISTIC F_PRAHKABSP54 "Druckfaktor waehrend Rampe auf Schaltdruck" VALUE 0x1D79C6 ZF_kw_ui8_S5_S3 1 UMR___1_100_0_S5_S3 0 1 /end CHARACTERISTIC
/begin CHARACTERISTIC F_PRAHKABSP63 "Druckfaktor waehrend Rampe auf Schaltdruck" VALUE 0x1D79DE ZF_kw_ui8_S5_S3 1 UMR___1_100_0_S5_S3 0 1 /end CHARACTERISTIC
/begin CHARACTERISTIC F_PRAHKABSP64 "Druckfaktor waehrend Rampe auf Schaltdruck" VALUE 0x1D79E1 ZF_kw_ui8_S5_S3 1 UMR___1_100_0_S5_S3 0 1 /end CHARACTERISTIC
/begin CHARACTERISTIC F_PRAHKABSP65 "Druckfaktor waehrend Rampe auf Schaltdruck" VALUE 0x1D79C9 ZF_kw_ui8_S5_S3 1 UMR___1_100_0_S5_S3 0 1 /end CHARACTERISTIC
/begin CHARACTERISTIC F_PRAHKABSP71 "Druckfaktor waehrend Rampe auf Schaltdruck" VALUE 0x1D79E4 ZF_kw_ui8_S5_S3 1 UMR___1_100_0_S5_S3 0 1 /end CHARACTERISTIC
/begin CHARACTERISTIC F_PRAHKABSP75 "Druckfaktor waehrend Rampe auf Schaltdruck" VALUE 0x1D79E7 ZF_kw_ui8_S5_S3 1 UMR___1_100_0_S5_S3 0 1 /end CHARACTERISTIC
/begin CHARACTERISTIC F_PRAHKABSP76 "Druckfaktor waehrend Rampe auf Schaltdruck" VALUE 0x1D79CC ZF_kw_ui8_S5_S3 1 UMR___1_100_0_S5_S3 0 1 /end CHARACTERISTIC
/begin CHARACTERISTIC F_PRAHKABSP82 "Druckfaktor waehrend Rampe auf Schaltdruck" VALUE 0x1D79EA ZF_kw_ui8_S5_S3 1 UMR___1_100_0_S5_S3 0 1 /end CHARACTERISTIC
/begin CHARACTERISTIC F_PRAHKABSP84 "Druckfaktor waehrend Rampe auf Schaltdruck" VALUE 0x1D79ED ZF_kw_ui8_S5_S3 1 UMR___1_100_0_S5_S3 0 1 /end CHARACTERISTIC
/begin CHARACTERISTIC F_PRAHKABSP86 "Druckfaktor waehrend Rampe auf Schaltdruck" VALUE 0x1D79F0 ZF_kw_ui8_S5_S3 1 UMR___1_100_0_S5_S3 0 1 /end CHARACTERISTIC
/begin CHARACTERISTIC F_PRAHKABSP87 "Druckfaktor waehrend Rampe auf Schaltdruck" VALUE 0x1D79CF ZF_kw_ui8_S5_S3 1 UMR___1_100_0_S5_S3 0 1 /end CHARACTERISTIC
/begin CHARACTERISTIC F_PRAHKABSPORT21 "Druckfaktor waehrend Rampe auf Schaltdruck" VALUE 0x1D79F3 ZF_kw_ui8_S5_S3 1 UMR___1_100_0_S5_S3 0 1 /end CHARACTERISTIC
/begin CHARACTERISTIC F_PRAHKABSPORT31 "Druckfaktor waehrend Rampe auf Schaltdruck" VALUE 0x1D7A08 ZF_kw_ui8_S5_S3 1 UMR___1_100_0_S5_S3 0 1 /end CHARACTERISTIC
/begin CHARACTERISTIC F_PRAHKABSPORT32 "Druckfaktor waehrend Rampe auf Schaltdruck" VALUE 0x1D79F6 ZF_kw_ui8_S5_S3 1 UMR___1_100_0_S5_S3 0 1 /end CHARACTERISTIC
/begin CHARACTERISTIC F_PRAHKABSPORT42 "Druckfaktor waehrend Rampe auf Schaltdruck" VALUE 0x1D7A0B ZF_kw_ui8_S5_S3 1 UMR___1_100_0_S5_S3 0 1 /end CHARACTERISTIC
/begin CHARACTERISTIC F_PRAHKABSPORT43 "Druckfaktor waehrend Rampe auf Schaltdruck" VALUE 0x1D79F9 ZF_kw_ui8_S5_S3 1 UMR___1_100_0_S5_S3 0 1 /end CHARACTERISTIC
/begin CHARACTERISTIC F_PRAHKABSPORT51 "Druckfaktor waehrend Rampe auf Schaltdruck" VALUE 0x1D7A0E ZF_kw_ui8_S5_S3 1 UMR___1_100_0_S5_S3 0 1 /end CHARACTERISTIC
/begin CHARACTERISTIC F_PRAHKABSPORT53 "Druckfaktor waehrend Rampe auf Schaltdruck" VALUE 0x1D7A11 ZF_kw_ui8_S5_S3 1 UMR___1_100_0_S5_S3 0 1 /end CHARACTERISTIC
/begin CHARACTERISTIC F_PRAHKABSPORT54 "Druckfaktor waehrend Rampe auf Schaltdruck" VALUE 0x1D79FC ZF_kw_ui8_S5_S3 1 UMR___1_100_0_S5_S3 0 1 /end CHARACTERISTIC
/begin CHARACTERISTIC F_PRAHKABSPORT63 "Druckfaktor waehrend Rampe auf Schaltdruck" VALUE 0x1D7A14 ZF_kw_ui8_S5_S3 1 UMR___1_100_0_S5_S3 0 1 /end CHARACTERISTIC
/begin CHARACTERISTIC F_PRAHKABSPORT64 "Druckfaktor waehrend Rampe auf Schaltdruck" VALUE 0x1D7A17 ZF_kw_ui8_S5_S3 1 UMR___1_100_0_S5_S3 0 1 /end CHARACTERISTIC
/begin CHARACTERISTIC F_PRAHKABSPORT65 "Druckfaktor waehrend Rampe auf Schaltdruck" VALUE 0x1D79FF ZF_kw_ui8_S5_S3 1 UMR___1_100_0_S5_S3 0 1 /end CHARACTERISTIC
/begin CHARACTERISTIC F_PRAHKABSPORT71 "Druckfaktor waehrend Rampe auf Schaltdruck" VALUE 0x1D7A1A ZF_kw_ui8_S5_S3 1 UMR___1_100_0_S5_S3 0 1 /end CHARACTERISTIC
/begin CHARACTERISTIC F_PRAHKABSPORT75 "Druckfaktor waehrend Rampe auf Schaltdruck" VALUE 0x1D7A1D ZF_kw_ui8_S5_S3 1 UMR___1_100_0_S5_S3 0 1 /end CHARACTERISTIC
/begin CHARACTERISTIC F_PRAHKABSPORT76 "Druckfaktor waehrend Rampe auf Schaltdruck" VALUE 0x1D7A02 ZF_kw_ui8_S5_S3 1 UMR___1_100_0_S5_S3 0 1 /end CHARACTERISTIC
/begin CHARACTERISTIC F_PRAHKABSPORT82 "Druckfaktor waehrend Rampe auf Schaltdruck" VALUE 0x1D7A20 ZF_kw_ui8_S5_S3 1 UMR___1_100_0_S5_S3 0 1 /end CHARACTERISTIC
/begin CHARACTERISTIC F_TRAHKAB21 "Zeitfaktor waehrend Rampe auf Schaltdruck" VALUE 0x1D799C ZF_kw_ui8_S5_S3 1 UMR___1_100_0_S5_S3 0 1 /end CHARACTERISTIC
/begin CHARACTERISTIC F_TRAHKAB21_EL "Zeitfaktor waehrend Rampe auf Schaltdruck" VALUE 0x1D799D ZF_kw_ui8_S5_S3 1 UMR___1_100_0_S5_S3 0 1 /end CHARACTERISTIC
/begin CHARACTERISTIC F_TRAHKAB32 "Zeitfaktor waehrend Rampe auf Schaltdruck" VALUE 0x1D79A1 ZF_kw_ui8_S5_S3 1 UMR___1_100_0_S5_S3 0 1 /end CHARACTERISTIC
/begin CHARACTERISTIC F_TRAHKAB32_EL "Zeitfaktor waehrend Rampe auf Schaltdruck" VALUE 0x1D79A2 ZF_kw_ui8_S5_S3 1 UMR___1_100_0_S5_S3 0 1 /end CHARACTERISTIC
/begin CHARACTERISTIC F_TRAHKAB43 "Zeitfaktor waehrend Rampe auf Schaltdruck" VALUE 0x1D79A6 ZF_kw_ui8_S5_S3 1 UMR___1_100_0_S5_S3 0 1 /end CHARACTERISTIC
/begin CHARACTERISTIC F_TRAHKAB43_EL "Zeitfaktor waehrend Rampe auf Schaltdruck" VALUE 0x1D79A7 ZF_kw_ui8_S5_S3 1 UMR___1_100_0_S5_S3 0 1 /end CHARACTERISTIC
/begin CHARACTERISTIC F_TRAHKAB54 "Zeitfaktor waehrend Rampe auf Schaltdruck" VALUE 0x1D79AB ZF_kw_ui8_S5_S3 1 UMR___1_100_0_S5_S3 0 1 /end CHARACTERISTIC
/begin CHARACTERISTIC F_TRAHKAB54_EL "Zeitfaktor waehrend Rampe auf Schaltdruck" VALUE 0x1D79AC ZF_kw_ui8_S5_S3 1 UMR___1_100_0_S5_S3 0 1 /end CHARACTERISTIC
/begin CHARACTERISTIC F_TRAHKAB65 "Zeitfaktor waehrend Rampe auf Schaltdruck" VALUE 0x1D79B0 ZF_kw_ui8_S5_S3 1 UMR___1_100_0_S5_S3 0 1 /end CHARACTERISTIC
/begin CHARACTERISTIC F_TRAHKAB65_EL "Zeitfaktor waehrend Rampe auf Schaltdruck" VALUE 0x1D79B1 ZF_kw_ui8_S5_S3 1 UMR___1_100_0_S5_S3 0 1 /end CHARACTERISTIC
/begin CHARACTERISTIC F_TRAHKAB76 "Zeitfaktor waehrend Rampe auf Schaltdruck" VALUE 0x1D79B5 ZF_kw_ui8_S5_S3 1 UMR___1_100_0_S5_S3 0 1 /end CHARACTERISTIC
/begin CHARACTERISTIC F_TRAHKAB76_EL "Zeitfaktor waehrend Rampe auf Schaltdruck" VALUE 0x1D79B6 ZF_kw_ui8_S5_S3 1 UMR___1_100_0_S5_S3 0 1 /end CHARACTERISTIC
/begin CHARACTERISTIC F_TRAHKAB87 "Zeitfaktor waehrend Rampe auf Schaltdruck" VALUE 0x1D79BA ZF_kw_ui8_S5_S3 1 UMR___1_100_0_S5_S3 0 1 /end CHARACTERISTIC
/begin CHARACTERISTIC F_TRAHKAB87_EL "Zeitfaktor waehrend Rampe auf Schaltdruck" VALUE 0x1D79BB ZF_kw_ui8_S5_S3 1 UMR___1_100_0_S5_S3 0 1 /end CHARACTERISTIC
/begin CHARACTERISTIC F_TRAHKABSP21 "Zeitfaktor waehrend Rampe auf Schaltdruck" VALUE 0x1D79BE ZF_kw_ui8_S5_S3 1 UMR___1_100_0_S5_S3 0 1 /end CHARACTERISTIC
/begin CHARACTERISTIC F_TRAHKABSP31 "Zeitfaktor waehrend Rampe auf Schaltdruck" VALUE 0x1D79D3 ZF_kw_ui8_S5_S3 1 UMR___1_100_0_S5_S3 0 1 /end CHARACTERISTIC
/begin CHARACTERISTIC F_TRAHKABSP32 "Zeitfaktor waehrend Rampe auf Schaltdruck" VALUE 0x1D79C1 ZF_kw_ui8_S5_S3 1 UMR___1_100_0_S5_S3 0 1 /end CHARACTERISTIC
/begin CHARACTERISTIC F_TRAHKABSP42 "Zeitfaktor waehrend Rampe auf Schaltdruck" VALUE 0x1D79D6 ZF_kw_ui8_S5_S3 1 UMR___1_100_0_S5_S3 0 1 /end CHARACTERISTIC
/begin CHARACTERISTIC F_TRAHKABSP43 "Zeitfaktor waehrend Rampe auf Schaltdruck" VALUE 0x1D79C4 ZF_kw_ui8_S5_S3 1 UMR___1_100_0_S5_S3 0 1 /end CHARACTERISTIC
/begin CHARACTERISTIC F_TRAHKABSP51 "Zeitfaktor waehrend Rampe auf Schaltdruck" VALUE 0x1D79D9 ZF_kw_ui8_S5_S3 1 UMR___1_100_0_S5_S3 0 1 /end CHARACTERISTIC
/begin CHARACTERISTIC F_TRAHKABSP53 "Zeitfaktor waehrend Rampe auf Schaltdruck" VALUE 0x1D79DC ZF_kw_ui8_S5_S3 1 UMR___1_100_0_S5_S3 0 1 /end CHARACTERISTIC
/begin CHARACTERISTIC F_TRAHKABSP54 "Zeitfaktor waehrend Rampe auf Schaltdruck" VALUE 0x1D79C7 ZF_kw_ui8_S5_S3 1 UMR___1_100_0_S5_S3 0 1 /end CHARACTERISTIC
/begin CHARACTERISTIC F_TRAHKABSP63 "Zeitfaktor waehrend Rampe auf Schaltdruck" VALUE 0x1D79DF ZF_kw_ui8_S5_S3 1 UMR___1_100_0_S5_S3 0 1 /end CHARACTERISTIC
/begin CHARACTERISTIC F_TRAHKABSP64 "Zeitfaktor waehrend Rampe auf Schaltdruck" VALUE 0x1D79E2 ZF_kw_ui8_S5_S3 1 UMR___1_100_0_S5_S3 0 1 /end CHARACTERISTIC
/begin CHARACTERISTIC F_TRAHKABSP65 "Zeitfaktor waehrend Rampe auf Schaltdruck" VALUE 0x1D79CA ZF_kw_ui8_S5_S3 1 UMR___1_100_0_S5_S3 0 1 /end CHARACTERISTIC
/begin CHARACTERISTIC F_TRAHKABSP71 "Zeitfaktor waehrend Rampe auf Schaltdruck" VALUE 0x1D79E5 ZF_kw_ui8_S5_S3 1 UMR___1_100_0_S5_S3 0 1 /end CHARACTERISTIC
/begin CHARACTERISTIC F_TRAHKABSP75 "Zeitfaktor waehrend Rampe auf Schaltdruck" VALUE 0x1D79E8 ZF_kw_ui8_S5_S3 1 UMR___1_100_0_S5_S3 0 1 /end CHARACTERISTIC
/begin CHARACTERISTIC F_TRAHKABSP76 "Zeitfaktor waehrend Rampe auf Schaltdruck" VALUE 0x1D79CD ZF_kw_ui8_S5_S3 1 UMR___1_100_0_S5_S3 0 1 /end CHARACTERISTIC
/begin CHARACTERISTIC F_TRAHKABSP82 "Zeitfaktor waehrend Rampe auf Schaltdruck" VALUE 0x1D79EB ZF_kw_ui8_S5_S3 1 UMR___1_100_0_S5_S3 0 1 /end CHARACTERISTIC
/begin CHARACTERISTIC F_TRAHKABSP84 "Zeitfaktor waehrend Rampe auf Schaltdruck" VALUE 0x1D79EE ZF_kw_ui8_S5_S3 1 UMR___1_100_0_S5_S3 0 1 /end CHARACTERISTIC
/begin CHARACTERISTIC F_TRAHKABSP86 "Zeitfaktor waehrend Rampe auf Schaltdruck" VALUE 0x1D79F1 ZF_kw_ui8_S5_S3 1 UMR___1_100_0_S5_S3 0 1 /end CHARACTERISTIC
/begin CHARACTERISTIC F_TRAHKABSP87 "Zeitfaktor waehrend Rampe auf Schaltdruck" VALUE 0x1D79D0 ZF_kw_ui8_S5_S3 1 UMR___1_100_0_S5_S3 0 1 /end CHARACTERISTIC
/begin CHARACTERISTIC F_TRAHKABSPORT21 "Zeitfaktor waehrend Rampe auf Schaltdruck" VALUE 0x1D79F4 ZF_kw_ui8_S5_S3 1 UMR___1_100_0_S5_S3 0 1 /end CHARACTERISTIC
/begin CHARACTERISTIC F_TRAHKABSPORT31 "Zeitfaktor waehrend Rampe auf Schaltdruck" VALUE 0x1D7A09 ZF_kw_ui8_S5_S3 1 UMR___1_100_0_S5_S3 0 1 /end CHARACTERISTIC
/begin CHARACTERISTIC F_TRAHKABSPORT32 "Zeitfaktor waehrend Rampe auf Schaltdruck" VALUE 0x1D79F7 ZF_kw_ui8_S5_S3 1 UMR___1_100_0_S5_S3 0 1 /end CHARACTERISTIC
/begin CHARACTERISTIC F_TRAHKABSPORT42 "Zeitfaktor waehrend Rampe auf Schaltdruck" VALUE 0x1D7A0C ZF_kw_ui8_S5_S3 1 UMR___1_100_0_S5_S3 0 1 /end CHARACTERISTIC
/begin CHARACTERISTIC F_TRAHKABSPORT43 "Zeitfaktor waehrend Rampe auf Schaltdruck" VALUE 0x1D79FA ZF_kw_ui8_S5_S3 1 UMR___1_100_0_S5_S3 0 1 /end CHARACTERISTIC
/begin CHARACTERISTIC F_TRAHKABSPORT51 "Zeitfaktor waehrend Rampe auf Schaltdruck" VALUE 0x1D7A0F ZF_kw_ui8_S5_S3 1 UMR___1_100_0_S5_S3 0 1 /end CHARACTERISTIC
/begin CHARACTERISTIC F_TRAHKABSPORT53 "Zeitfaktor waehrend Rampe auf Schaltdruck" VALUE 0x1D7A12 ZF_kw_ui8_S5_S3 1 UMR___1_100_0_S5_S3 0 1 /end CHARACTERISTIC
/begin CHARACTERISTIC F_TRAHKABSPORT54 "Zeitfaktor waehrend Rampe auf Schaltdruck" VALUE 0x1D79FD ZF_kw_ui8_S5_S3 1 UMR___1_100_0_S5_S3 0 1 /end CHARACTERISTIC
/begin CHARACTERISTIC F_TRAHKABSPORT63 "Zeitfaktor waehrend Rampe auf Schaltdruck" VALUE 0x1D7A15 ZF_kw_ui8_S5_S3 1 UMR___1_100_0_S5_S3 0 1 /end CHARACTERISTIC
/begin CHARACTERISTIC F_TRAHKABSPORT64 "Zeitfaktor waehrend Rampe auf Schaltdruck" VALUE 0x1D7A18 ZF_kw_ui8_S5_S3 1 UMR___1_100_0_S5_S3 0 1 /end CHARACTERISTIC
/begin CHARACTERISTIC F_TRAHKABSPORT65 "Zeitfaktor waehrend Rampe auf Schaltdruck" VALUE 0x1D7A00 ZF_kw_ui8_S5_S3 1 UMR___1_100_0_S5_S3 0 1 /end CHARACTERISTIC
/begin CHARACTERISTIC F_TRAHKABSPORT71 "Zeitfaktor waehrend Rampe auf Schaltdruck" VALUE 0x1D7A1B ZF_kw_ui8_S5_S3 1 UMR___1_100_0_S5_S3 0 1 /end CHARACTERISTIC
/begin CHARACTERISTIC F_TRAHKABSPORT75 "Zeitfaktor waehrend Rampe auf Schaltdruck" VALUE 0x1D7A1E ZF_kw_ui8_S5_S3 1 UMR___1_100_0_S5_S3 0 1 /end CHARACTERISTIC
/begin CHARACTERISTIC F_TRAHKABSPORT76 "Zeitfaktor waehrend Rampe auf Schaltdruck" VALUE 0x1D7A03 ZF_kw_ui8_S5_S3 1 UMR___1_100_0_S5_S3 0 1 /end CHARACTERISTIC
/begin CHARACTERISTIC F_TRAHKABSPORT82 "Zeitfaktor waehrend Rampe auf Schaltdruck" VALUE 0x1D7A21 ZF_kw_ui8_S5_S3 1 UMR___1_100_0_S5_S3 0 1 /end CHARACTERISTIC
/begin CHARACTERISTIC KF_PKAB12 "Schaltdruck abschaltende Kupplung" MAP 0x1B81FC ZF_kf_si16_S5_S3 12.75 UMR_BAR__1_1000_0_S5_S3 0 12.75
 /begin AXIS_DESCR STD_AXIS iSasZentr.iSchaltend.n_tkf UMR_U_MIN_32_1_0_S5_S3 8 0 8160 DEPOSIT ABSOLUTE /end AXIS_DESCR
 /begin AXIS_DESCR STD_AXIS zff_atsys._.iSignale._.obj.sig_m_t UMR_NM__1_1_0_S5_S3 10 -200 1300 DEPOSIT ABSOLUTE /end AXIS_DESCR
/end CHARACTERISTIC
/begin CHARACTERISTIC KF_PKAB21 "Schaltdruck abschaltende Kupplung" MAP 0x1B8860 ZF_kf_si16_S5_S3 12.75 UMR_BAR__1_1000_0_S5_S3 0 12.75
 /begin AXIS_DESCR STD_AXIS iSasZentr.iSchaltend.n_tkf UMR_U_MIN_32_1_0_S5_S3 8 0 8160 DEPOSIT ABSOLUTE /end AXIS_DESCR
 /begin AXIS_DESCR STD_AXIS zff_atsys._.iSignale._.obj.sig_m_t UMR_NM__1_1_0_S5_S3 10 -200 1300 DEPOSIT ABSOLUTE /end AXIS_DESCR
/end CHARACTERISTIC
/begin CHARACTERISTIC KF_PKAB21_EL "Schaltdruck abschaltende Kupplung" MAP 0x1B892C ZF_kf_si16_S5_S3 12.75 UMR_BAR__1_1000_0_S5_S3 0 12.75
 /begin AXIS_DESCR STD_AXIS iSasZentr.iSchaltend.n_tkf UMR_U_MIN_32_1_0_S5_S3 8 0 8160 DEPOSIT ABSOLUTE /end AXIS_DESCR
 /begin AXIS_DESCR STD_AXIS zff_atsys._.iSignale._.obj.sig_m_t UMR_NM__1_1_0_S5_S3 10 -200 1300 DEPOSIT ABSOLUTE /end AXIS_DESCR
/end CHARACTERISTIC
/begin CHARACTERISTIC KF_PKAB23 "Schaltdruck abschaltende Kupplung" MAP 0x1B82C8 ZF_kf_si16_S5_S3 12.75 UMR_BAR__1_1000_0_S5_S3 0 12.75
 /begin AXIS_DESCR STD_AXIS iSasZentr.iSchaltend.n_tkf UMR_U_MIN_32_1_0_S5_S3 8 0 8160 DEPOSIT ABSOLUTE /end AXIS_DESCR
 /begin AXIS_DESCR STD_AXIS zff_atsys._.iSignale._.obj.sig_m_t UMR_NM__1_1_0_S5_S3 10 -200 1300 DEPOSIT ABSOLUTE /end AXIS_DESCR
/end CHARACTERISTIC
/begin CHARACTERISTIC KF_PKAB32 "Schaltdruck abschaltende Kupplung" MAP 0x1B8B3C ZF_kf_si16_S5_S3 12.75 UMR_BAR__1_1000_0_S5_S3 0 12.75
 /begin AXIS_DESCR STD_AXIS iSasZentr.iSchaltend.n_tkf UMR_U_MIN_32_1_0_S5_S3 8 0 8160 DEPOSIT ABSOLUTE /end AXIS_DESCR
 /begin AXIS_DESCR STD_AXIS zff_atsys._.iSignale._.obj.sig_m_t UMR_NM__1_1_0_S5_S3 10 -200 1300 DEPOSIT ABSOLUTE /end AXIS_DESCR
/end CHARACTERISTIC
/begin CHARACTERISTIC KF_PKAB32_EL "Schaltdruck abschaltende Kupplung" MAP 0x1B8C08 ZF_kf_si16_S5_S3 12.75 UMR_BAR__1_1000_0_S5_S3 0 12.75
 /begin AXIS_DESCR STD_AXIS iSasZentr.iSchaltend.n_tkf UMR_U_MIN_32_1_0_S5_S3 8 0 8160 DEPOSIT ABSOLUTE /end AXIS_DESCR
 /begin AXIS_DESCR STD_AXIS zff_atsys._.iSignale._.obj.sig_m_t UMR_NM__1_1_0_S5_S3 10 -200 1300 DEPOSIT ABSOLUTE /end AXIS_DESCR
/end CHARACTERISTIC
/begin CHARACTERISTIC KF_PKAB34 "Schaltdruck abschaltende Kupplung" MAP 0x1B8394 ZF_kf_si16_S5_S3 12.75 UMR_BAR__1_1000_0_S5_S3 0 12.75
 /begin AXIS_DESCR STD_AXIS iSasZentr.iSchaltend.n_tkf UMR_U_MIN_32_1_0_S5_S3 8 0 8160 DEPOSIT ABSOLUTE /end AXIS_DESCR
 /begin AXIS_DESCR STD_AXIS zff_atsys._.iSignale._.obj.sig_m_t UMR_NM__1_1_0_S5_S3 10 -200 1300 DEPOSIT ABSOLUTE /end AXIS_DESCR
/end CHARACTERISTIC
/begin CHARACTERISTIC KF_PKAB43 "Schaltdruck abschaltende Kupplung" MAP 0x1B8E18 ZF_kf_si16_S5_S3 12.75 UMR_BAR__1_1000_0_S5_S3 0 12.75
 /begin AXIS_DESCR STD_AXIS iSasZentr.iSchaltend.n_tkf UMR_U_MIN_32_1_0_S5_S3 8 0 8160 DEPOSIT ABSOLUTE /end AXIS_DESCR
 /begin AXIS_DESCR STD_AXIS zff_atsys._.iSignale._.obj.sig_m_t UMR_NM__1_1_0_S5_S3 10 -200 1300 DEPOSIT ABSOLUTE /end AXIS_DESCR
/end CHARACTERISTIC
/begin CHARACTERISTIC KF_PKAB43_EL "Schaltdruck abschaltende Kupplung" MAP 0x1B8EE4 ZF_kf_si16_S5_S3 12.75 UMR_BAR__1_1000_0_S5_S3 0 12.75
 /begin AXIS_DESCR STD_AXIS iSasZentr.iSchaltend.n_tkf UMR_U_MIN_32_1_0_S5_S3 8 0 8160 DEPOSIT ABSOLUTE /end AXIS_DESCR
 /begin AXIS_DESCR STD_AXIS zff_atsys._.iSignale._.obj.sig_m_t UMR_NM__1_1_0_S5_S3 10 -200 1300 DEPOSIT ABSOLUTE /end AXIS_DESCR
/end CHARACTERISTIC
/begin CHARACTERISTIC KF_PKAB45 "Schaltdruck abschaltende Kupplung" MAP 0x1B8460 ZF_kf_si16_S5_S3 12.75 UMR_BAR__1_1000_0_S5_S3 0 12.75
 /begin AXIS_DESCR STD_AXIS iSasZentr.iSchaltend.n_tkf UMR_U_MIN_32_1_0_S5_S3 8 0 8160 DEPOSIT ABSOLUTE /end AXIS_DESCR
 /begin AXIS_DESCR STD_AXIS zff_atsys._.iSignale._.obj.sig_m_t UMR_NM__1_1_0_S5_S3 10 -200 1300 DEPOSIT ABSOLUTE /end AXIS_DESCR
/end CHARACTERISTIC
/begin CHARACTERISTIC KF_PKAB54 "Schaltdruck abschaltende Kupplung" MAP 0x1B90F4 ZF_kf_si16_S5_S3 12.75 UMR_BAR__1_1000_0_S5_S3 0 12.75
 /begin AXIS_DESCR STD_AXIS iSasZentr.iSchaltend.n_tkf UMR_U_MIN_32_1_0_S5_S3 8 0 8160 DEPOSIT ABSOLUTE /end AXIS_DESCR
 /begin AXIS_DESCR STD_AXIS zff_atsys._.iSignale._.obj.sig_m_t UMR_NM__1_1_0_S5_S3 10 -200 1300 DEPOSIT ABSOLUTE /end AXIS_DESCR
/end CHARACTERISTIC
/begin CHARACTERISTIC KF_PKAB54_EL "Schaltdruck abschaltende Kupplung" MAP 0x1B91C0 ZF_kf_si16_S5_S3 12.75 UMR_BAR__1_1000_0_S5_S3 0 12.75
 /begin AXIS_DESCR STD_AXIS iSasZentr.iSchaltend.n_tkf UMR_U_MIN_32_1_0_S5_S3 8 0 8160 DEPOSIT ABSOLUTE /end AXIS_DESCR
 /begin AXIS_DESCR STD_AXIS zff_atsys._.iSignale._.obj.sig_m_t UMR_NM__1_1_0_S5_S3 10 -200 1300 DEPOSIT ABSOLUTE /end AXIS_DESCR
/end CHARACTERISTIC
/begin CHARACTERISTIC KF_PKAB56 "Schaltdruck abschaltende Kupplung" MAP 0x1B852C ZF_kf_si16_S5_S3 12.75 UMR_BAR__1_1000_0_S5_S3 0 12.75
 /begin AXIS_DESCR STD_AXIS iSasZentr.iSchaltend.n_tkf UMR_U_MIN_32_1_0_S5_S3 8 0 8160 DEPOSIT ABSOLUTE /end AXIS_DESCR
 /begin AXIS_DESCR STD_AXIS zff_atsys._.iSignale._.obj.sig_m_t UMR_NM__1_1_0_S5_S3 10 -200 1300 DEPOSIT ABSOLUTE /end AXIS_DESCR
/end CHARACTERISTIC
/begin CHARACTERISTIC KF_PKAB65 "Schaltdruck abschaltende Kupplung" MAP 0x1B93D0 ZF_kf_si16_S5_S3 12.75 UMR_BAR__1_1000_0_S5_S3 0 12.75
 /begin AXIS_DESCR STD_AXIS iSasZentr.iSchaltend.n_tkf UMR_U_MIN_32_1_0_S5_S3 8 0 8160 DEPOSIT ABSOLUTE /end AXIS_DESCR
 /begin AXIS_DESCR STD_AXIS zff_atsys._.iSignale._.obj.sig_m_t UMR_NM__1_1_0_S5_S3 10 -200 1300 DEPOSIT ABSOLUTE /end AXIS_DESCR
/end CHARACTERISTIC
/begin CHARACTERISTIC KF_PKAB65_EL "Schaltdruck abschaltende Kupplung" MAP 0x1B949C ZF_kf_si16_S5_S3 12.75 UMR_BAR__1_1000_0_S5_S3 0 12.75
 /begin AXIS_DESCR STD_AXIS iSasZentr.iSchaltend.n_tkf UMR_U_MIN_32_1_0_S5_S3 8 0 8160 DEPOSIT ABSOLUTE /end AXIS_DESCR
 /begin AXIS_DESCR STD_AXIS zff_atsys._.iSignale._.obj.sig_m_t UMR_NM__1_1_0_S5_S3 10 -200 1300 DEPOSIT ABSOLUTE /end AXIS_DESCR
/end CHARACTERISTIC
/begin CHARACTERISTIC KF_PKAB67 "Schaltdruck abschaltende Kupplung" MAP 0x1B85F8 ZF_kf_si16_S5_S3 12.75 UMR_BAR__1_1000_0_S5_S3 0 12.75
 /begin AXIS_DESCR STD_AXIS iSasZentr.iSchaltend.n_tkf UMR_U_MIN_32_1_0_S5_S3 8 0 8160 DEPOSIT ABSOLUTE /end AXIS_DESCR
 /begin AXIS_DESCR STD_AXIS zff_atsys._.iSignale._.obj.sig_m_t UMR_NM__1_1_0_S5_S3 10 -200 1300 DEPOSIT ABSOLUTE /end AXIS_DESCR
/end CHARACTERISTIC
/begin CHARACTERISTIC KF_PKAB76 "Schaltdruck abschaltende Kupplung" MAP 0x1B96AC ZF_kf_si16_S5_S3 12.75 UMR_BAR__1_1000_0_S5_S3 0 12.75
 /begin AXIS_DESCR STD_AXIS iSasZentr.iSchaltend.n_tkf UMR_U_MIN_32_1_0_S5_S3 8 0 8160 DEPOSIT ABSOLUTE /end AXIS_DESCR
 /begin AXIS_DESCR STD_AXIS zff_atsys._.iSignale._.obj.sig_m_t UMR_NM__1_1_0_S5_S3 10 -200 1300 DEPOSIT ABSOLUTE /end AXIS_DESCR
/end CHARACTERISTIC
/begin CHARACTERISTIC KF_PKAB76_EL "Schaltdruck abschaltende Kupplung" MAP 0x1B9778 ZF_kf_si16_S5_S3 12.75 UMR_BAR__1_1000_0_S5_S3 0 12.75
 /begin AXIS_DESCR STD_AXIS iSasZentr.iSchaltend.n_tkf UMR_U_MIN_32_1_0_S5_S3 8 0 8160 DEPOSIT ABSOLUTE /end AXIS_DESCR
 /begin AXIS_DESCR STD_AXIS zff_atsys._.iSignale._.obj.sig_m_t UMR_NM__1_1_0_S5_S3 10 -200 1300 DEPOSIT ABSOLUTE /end AXIS_DESCR
/end CHARACTERISTIC
/begin CHARACTERISTIC KF_PKAB78 "Schaltdruck abschaltende Kupplung" MAP 0x1B86C4 ZF_kf_si16_S5_S3 12.75 UMR_BAR__1_1000_0_S5_S3 0 12.75
 /begin AXIS_DESCR STD_AXIS iSasZentr.iSchaltend.n_tkf UMR_U_MIN_32_1_0_S5_S3 8 0 8160 DEPOSIT ABSOLUTE /end AXIS_DESCR
 /begin AXIS_DESCR STD_AXIS zff_atsys._.iSignale._.obj.sig_m_t UMR_NM__1_1_0_S5_S3 10 -200 1300 DEPOSIT ABSOLUTE /end AXIS_DESCR
/end CHARACTERISTIC
/begin CHARACTERISTIC KF_PKAB87 "Schaltdruck abschaltende Kupplung" MAP 0x1B9988 ZF_kf_si16_S5_S3 12.75 UMR_BAR__1_1000_0_S5_S3 0 12.75
 /begin AXIS_DESCR STD_AXIS iSasZentr.iSchaltend.n_tkf UMR_U_MIN_32_1_0_S5_S3 8 0 8160 DEPOSIT ABSOLUTE /end AXIS_DESCR
 /begin AXIS_DESCR STD_AXIS zff_atsys._.iSignale._.obj.sig_m_t UMR_NM__1_1_0_S5_S3 10 -200 1300 DEPOSIT ABSOLUTE /end AXIS_DESCR
/end CHARACTERISTIC
/begin CHARACTERISTIC KF_PKAB87_EL "Schaltdruck abschaltende Kupplung" MAP 0x1B9A54 ZF_kf_si16_S5_S3 12.75 UMR_BAR__1_1000_0_S5_S3 0 12.75
 /begin AXIS_DESCR STD_AXIS iSasZentr.iSchaltend.n_tkf UMR_U_MIN_32_1_0_S5_S3 8 0 8160 DEPOSIT ABSOLUTE /end AXIS_DESCR
 /begin AXIS_DESCR STD_AXIS zff_atsys._.iSignale._.obj.sig_m_t UMR_NM__1_1_0_S5_S3 10 -200 1300 DEPOSIT ABSOLUTE /end AXIS_DESCR
/end CHARACTERISTIC
/begin CHARACTERISTIC KF_PKABSP21 "Schaltdruck abschaltende Kupplung" MAP 0x1B9C0C ZF_kf_si16_S5_S3 12.75 UMR_BAR__1_1000_0_S5_S3 0 12.75
 /begin AXIS_DESCR STD_AXIS iSasZentr.iSchaltend.n_tkf UMR_U_MIN_32_1_0_S5_S3 8 0 8160 DEPOSIT ABSOLUTE /end AXIS_DESCR
 /begin AXIS_DESCR STD_AXIS zff_atsys._.iSignale._.obj.sig_m_t UMR_NM__1_1_0_S5_S3 10 -200 1300 DEPOSIT ABSOLUTE /end AXIS_DESCR
/end CHARACTERISTIC
/begin CHARACTERISTIC KF_PKABSP31 "Schaltdruck abschaltende Kupplung" MAP 0x1BA814 ZF_kf_si16_S5_S3 12.75 UMR_BAR__1_1000_0_S5_S3 0 12.75
 /begin AXIS_DESCR STD_AXIS iSasZentr.iSchaltend.n_tkf UMR_U_MIN_32_1_0_S5_S3 8 0 8160 DEPOSIT ABSOLUTE /end AXIS_DESCR
 /begin AXIS_DESCR STD_AXIS zff_atsys._.iSignale._.obj.sig_m_t UMR_NM__1_1_0_S5_S3 10 -200 1300 DEPOSIT ABSOLUTE /end AXIS_DESCR
/end CHARACTERISTIC
/begin CHARACTERISTIC KF_PKABSP32 "Schaltdruck abschaltende Kupplung" MAP 0x1B9DC4 ZF_kf_si16_S5_S3 12.75 UMR_BAR__1_1000_0_S5_S3 0 12.75
 /begin AXIS_DESCR STD_AXIS iSasZentr.iSchaltend.n_tkf UMR_U_MIN_32_1_0_S5_S3 8 0 8160 DEPOSIT ABSOLUTE /end AXIS_DESCR
 /begin AXIS_DESCR STD_AXIS zff_atsys._.iSignale._.obj.sig_m_t UMR_NM__1_1_0_S5_S3 10 -200 1300 DEPOSIT ABSOLUTE /end AXIS_DESCR
/end CHARACTERISTIC
/begin CHARACTERISTIC KF_PKABSP42 "Schaltdruck abschaltende Kupplung" MAP 0x1BA9CC ZF_kf_si16_S5_S3 12.75 UMR_BAR__1_1000_0_S5_S3 0 12.75
 /begin AXIS_DESCR STD_AXIS iSasZentr.iSchaltend.n_tkf UMR_U_MIN_32_1_0_S5_S3 8 0 8160 DEPOSIT ABSOLUTE /end AXIS_DESCR
 /begin AXIS_DESCR STD_AXIS zff_atsys._.iSignale._.obj.sig_m_t UMR_NM__1_1_0_S5_S3 10 -200 1300 DEPOSIT ABSOLUTE /end AXIS_DESCR
/end CHARACTERISTIC
/begin CHARACTERISTIC KF_PKABSP43 "Schaltdruck abschaltende Kupplung" MAP 0x1B9F7C ZF_kf_si16_S5_S3 12.75 UMR_BAR__1_1000_0_S5_S3 0 12.75
 /begin AXIS_DESCR STD_AXIS iSasZentr.iSchaltend.n_tkf UMR_U_MIN_32_1_0_S5_S3 8 0 8160 DEPOSIT ABSOLUTE /end AXIS_DESCR
 /begin AXIS_DESCR STD_AXIS zff_atsys._.iSignale._.obj.sig_m_t UMR_NM__1_1_0_S5_S3 10 -200 1300 DEPOSIT ABSOLUTE /end AXIS_DESCR
/end CHARACTERISTIC
/begin CHARACTERISTIC KF_PKABSP51 "Schaltdruck abschaltende Kupplung" MAP 0x1BAB84 ZF_kf_si16_S5_S3 12.75 UMR_BAR__1_1000_0_S5_S3 0 12.75
 /begin AXIS_DESCR STD_AXIS iSasZentr.iSchaltend.n_tkf UMR_U_MIN_32_1_0_S5_S3 8 0 8160 DEPOSIT ABSOLUTE /end AXIS_DESCR
 /begin AXIS_DESCR STD_AXIS zff_atsys._.iSignale._.obj.sig_m_t UMR_NM__1_1_0_S5_S3 10 -200 1300 DEPOSIT ABSOLUTE /end AXIS_DESCR
/end CHARACTERISTIC
/begin CHARACTERISTIC KF_PKABSP53 "Schaltdruck abschaltende Kupplung" MAP 0x1BAD3C ZF_kf_si16_S5_S3 12.75 UMR_BAR__1_1000_0_S5_S3 0 12.75
 /begin AXIS_DESCR STD_AXIS iSasZentr.iSchaltend.n_tkf UMR_U_MIN_32_1_0_S5_S3 8 0 8160 DEPOSIT ABSOLUTE /end AXIS_DESCR
 /begin AXIS_DESCR STD_AXIS zff_atsys._.iSignale._.obj.sig_m_t UMR_NM__1_1_0_S5_S3 10 -200 1300 DEPOSIT ABSOLUTE /end AXIS_DESCR
/end CHARACTERISTIC
/begin CHARACTERISTIC KF_PKABSP54 "Schaltdruck abschaltende Kupplung" MAP 0x1BA134 ZF_kf_si16_S5_S3 12.75 UMR_BAR__1_1000_0_S5_S3 0 12.75
 /begin AXIS_DESCR STD_AXIS iSasZentr.iSchaltend.n_tkf UMR_U_MIN_32_1_0_S5_S3 8 0 8160 DEPOSIT ABSOLUTE /end AXIS_DESCR
 /begin AXIS_DESCR STD_AXIS zff_atsys._.iSignale._.obj.sig_m_t UMR_NM__1_1_0_S5_S3 10 -200 1300 DEPOSIT ABSOLUTE /end AXIS_DESCR
/end CHARACTERISTIC
/begin CHARACTERISTIC KF_PKABSP63 "Schaltdruck abschaltende Kupplung" MAP 0x1BAEF4 ZF_kf_si16_S5_S3 12.75 UMR_BAR__1_1000_0_S5_S3 0 12.75
 /begin AXIS_DESCR STD_AXIS iSasZentr.iSchaltend.n_tkf UMR_U_MIN_32_1_0_S5_S3 8 0 8160 DEPOSIT ABSOLUTE /end AXIS_DESCR
 /begin AXIS_DESCR STD_AXIS zff_atsys._.iSignale._.obj.sig_m_t UMR_NM__1_1_0_S5_S3 10 -200 1300 DEPOSIT ABSOLUTE /end AXIS_DESCR
/end CHARACTERISTIC
/begin CHARACTERISTIC KF_PKABSP64 "Schaltdruck abschaltende Kupplung" MAP 0x1BB0AC ZF_kf_si16_S5_S3 12.75 UMR_BAR__1_1000_0_S5_S3 0 12.75
 /begin AXIS_DESCR STD_AXIS iSasZentr.iSchaltend.n_tkf UMR_U_MIN_32_1_0_S5_S3 8 0 8160 DEPOSIT ABSOLUTE /end AXIS_DESCR
 /begin AXIS_DESCR STD_AXIS zff_atsys._.iSignale._.obj.sig_m_t UMR_NM__1_1_0_S5_S3 10 -200 1300 DEPOSIT ABSOLUTE /end AXIS_DESCR
/end CHARACTERISTIC
/begin CHARACTERISTIC KF_PKABSP65 "Schaltdruck abschaltende Kupplung" MAP 0x1BA2EC ZF_kf_si16_S5_S3 12.75 UMR_BAR__1_1000_0_S5_S3 0 12.75
 /begin AXIS_DESCR STD_AXIS iSasZentr.iSchaltend.n_tkf UMR_U_MIN_32_1_0_S5_S3 8 0 8160 DEPOSIT ABSOLUTE /end AXIS_DESCR
 /begin AXIS_DESCR STD_AXIS zff_atsys._.iSignale._.obj.sig_m_t UMR_NM__1_1_0_S5_S3 10 -200 1300 DEPOSIT ABSOLUTE /end AXIS_DESCR
/end CHARACTERISTIC
/begin CHARACTERISTIC KF_PKABSP71 "Schaltdruck abschaltende Kupplung" MAP 0x1BB264 ZF_kf_si16_S5_S3 12.75 UMR_BAR__1_1000_0_S5_S3 0 12.75
 /begin AXIS_DESCR STD_AXIS iSasZentr.iSchaltend.n_tkf UMR_U_MIN_32_1_0_S5_S3 8 0 8160 DEPOSIT ABSOLUTE /end AXIS_DESCR
 /begin AXIS_DESCR STD_AXIS zff_atsys._.iSignale._.obj.sig_m_t UMR_NM__1_1_0_S5_S3 10 -200 1300 DEPOSIT ABSOLUTE /end AXIS_DESCR
/end CHARACTERISTIC
/begin CHARACTERISTIC KF_PKABSP75 "Schaltdruck abschaltende Kupplung" MAP 0x1BB41C ZF_kf_si16_S5_S3 12.75 UMR_BAR__1_1000_0_S5_S3 0 12.75
 /begin AXIS_DESCR STD_AXIS iSasZentr.iSchaltend.n_tkf UMR_U_MIN_32_1_0_S5_S3 8 0 8160 DEPOSIT ABSOLUTE /end AXIS_DESCR
 /begin AXIS_DESCR STD_AXIS zff_atsys._.iSignale._.obj.sig_m_t UMR_NM__1_1_0_S5_S3 10 -200 1300 DEPOSIT ABSOLUTE /end AXIS_DESCR
/end CHARACTERISTIC
/begin CHARACTERISTIC KF_PKABSP76 "Schaltdruck abschaltende Kupplung" MAP 0x1BA4A4 ZF_kf_si16_S5_S3 12.75 UMR_BAR__1_1000_0_S5_S3 0 12.75
 /begin AXIS_DESCR STD_AXIS iSasZentr.iSchaltend.n_tkf UMR_U_MIN_32_1_0_S5_S3 8 0 8160 DEPOSIT ABSOLUTE /end AXIS_DESCR
 /begin AXIS_DESCR STD_AXIS zff_atsys._.iSignale._.obj.sig_m_t UMR_NM__1_1_0_S5_S3 10 -200 1300 DEPOSIT ABSOLUTE /end AXIS_DESCR
/end CHARACTERISTIC
/begin CHARACTERISTIC KF_PKABSP82 "Schaltdruck abschaltende Kupplung" MAP 0x1BB5D4 ZF_kf_si16_S5_S3 12.75 UMR_BAR__1_1000_0_S5_S3 0 12.75
 /begin AXIS_DESCR STD_AXIS iSasZentr.iSchaltend.n_tkf UMR_U_MIN_32_1_0_S5_S3 8 0 8160 DEPOSIT ABSOLUTE /end AXIS_DESCR
 /begin AXIS_DESCR STD_AXIS zff_atsys._.iSignale._.obj.sig_m_t UMR_NM__1_1_0_S5_S3 10 -200 1300 DEPOSIT ABSOLUTE /end AXIS_DESCR
/end CHARACTERISTIC
/begin CHARACTERISTIC KF_PKABSP84 "Schaltdruck abschaltende Kupplung" MAP 0x1BB78C ZF_kf_si16_S5_S3 12.75 UMR_BAR__1_1000_0_S5_S3 0 12.75
 /begin AXIS_DESCR STD_AXIS iSasZentr.iSchaltend.n_tkf UMR_U_MIN_32_1_0_S5_S3 8 0 8160 DEPOSIT ABSOLUTE /end AXIS_DESCR
 /begin AXIS_DESCR STD_AXIS zff_atsys._.iSignale._.obj.sig_m_t UMR_NM__1_1_0_S5_S3 10 -200 1300 DEPOSIT ABSOLUTE /end AXIS_DESCR
/end CHARACTERISTIC
/begin CHARACTERISTIC KF_PKABSP86 "Schaltdruck abschaltende Kupplung" MAP 0x1BB944 ZF_kf_si16_S5_S3 12.75 UMR_BAR__1_1000_0_S5_S3 0 12.75
 /begin AXIS_DESCR STD_AXIS iSasZentr.iSchaltend.n_tkf UMR_U_MIN_32_1_0_S5_S3 8 0 8160 DEPOSIT ABSOLUTE /end AXIS_DESCR
 /begin AXIS_DESCR STD_AXIS zff_atsys._.iSignale._.obj.sig_m_t UMR_NM__1_1_0_S5_S3 10 -200 1300 DEPOSIT ABSOLUTE /end AXIS_DESCR
/end CHARACTERISTIC
/begin CHARACTERISTIC KF_PKABSP87 "Schaltdruck abschaltende Kupplung" MAP 0x1BA65C ZF_kf_si16_S5_S3 12.75 UMR_BAR__1_1000_0_S5_S3 0 12.75
 /begin AXIS_DESCR STD_AXIS iSasZentr.iSchaltend.n_tkf UMR_U_MIN_32_1_0_S5_S3 8 0 8160 DEPOSIT ABSOLUTE /end AXIS_DESCR
 /begin AXIS_DESCR STD_AXIS zff_atsys._.iSignale._.obj.sig_m_t UMR_NM__1_1_0_S5_S3 10 -200 1300 DEPOSIT ABSOLUTE /end AXIS_DESCR
/end CHARACTERISTIC
/begin CHARACTERISTIC KF_PKABSPORT21 "Schaltdruck abschaltende Kupplung" MAP 0x1BBAFC ZF_kf_si16_S5_S3 12.75 UMR_BAR__1_1000_0_S5_S3 0 12.75
 /begin AXIS_DESCR STD_AXIS iSasZentr.iSchaltend.n_tkf UMR_U_MIN_32_1_0_S5_S3 8 0 8160 DEPOSIT ABSOLUTE /end AXIS_DESCR
 /begin AXIS_DESCR STD_AXIS zff_atsys._.iSignale._.obj.sig_m_t UMR_NM__1_1_0_S5_S3 10 -200 1300 DEPOSIT ABSOLUTE /end AXIS_DESCR
/end CHARACTERISTIC
/begin CHARACTERISTIC KF_PKABSPORT31 "Schaltdruck abschaltende Kupplung" MAP 0x1BC704 ZF_kf_si16_S5_S3 12.75 UMR_BAR__1_1000_0_S5_S3 0 12.75
 /begin AXIS_DESCR STD_AXIS iSasZentr.iSchaltend.n_tkf UMR_U_MIN_32_1_0_S5_S3 8 0 8160 DEPOSIT ABSOLUTE /end AXIS_DESCR
 /begin AXIS_DESCR STD_AXIS zff_atsys._.iSignale._.obj.sig_m_t UMR_NM__1_1_0_S5_S3 10 -200 1300 DEPOSIT ABSOLUTE /end AXIS_DESCR
/end CHARACTERISTIC
/begin CHARACTERISTIC KF_PKABSPORT32 "Schaltdruck abschaltende Kupplung" MAP 0x1BBCB4 ZF_kf_si16_S5_S3 12.75 UMR_BAR__1_1000_0_S5_S3 0 12.75
 /begin AXIS_DESCR STD_AXIS iSasZentr.iSchaltend.n_tkf UMR_U_MIN_32_1_0_S5_S3 8 0 8160 DEPOSIT ABSOLUTE /end AXIS_DESCR
 /begin AXIS_DESCR STD_AXIS zff_atsys._.iSignale._.obj.sig_m_t UMR_NM__1_1_0_S5_S3 10 -200 1300 DEPOSIT ABSOLUTE /end AXIS_DESCR
/end CHARACTERISTIC
/begin CHARACTERISTIC KF_PKABSPORT42 "Schaltdruck abschaltende Kupplung" MAP 0x1BC8BC ZF_kf_si16_S5_S3 12.75 UMR_BAR__1_1000_0_S5_S3 0 12.75
 /begin AXIS_DESCR STD_AXIS iSasZentr.iSchaltend.n_tkf UMR_U_MIN_32_1_0_S5_S3 8 0 8160 DEPOSIT ABSOLUTE /end AXIS_DESCR
 /begin AXIS_DESCR STD_AXIS zff_atsys._.iSignale._.obj.sig_m_t UMR_NM__1_1_0_S5_S3 10 -200 1300 DEPOSIT ABSOLUTE /end AXIS_DESCR
/end CHARACTERISTIC
/begin CHARACTERISTIC KF_PKABSPORT43 "Schaltdruck abschaltende Kupplung" MAP 0x1BBE6C ZF_kf_si16_S5_S3 12.75 UMR_BAR__1_1000_0_S5_S3 0 12.75
 /begin AXIS_DESCR STD_AXIS iSasZentr.iSchaltend.n_tkf UMR_U_MIN_32_1_0_S5_S3 8 0 8160 DEPOSIT ABSOLUTE /end AXIS_DESCR
 /begin AXIS_DESCR STD_AXIS zff_atsys._.iSignale._.obj.sig_m_t UMR_NM__1_1_0_S5_S3 10 -200 1300 DEPOSIT ABSOLUTE /end AXIS_DESCR
/end CHARACTERISTIC
/begin CHARACTERISTIC KF_PKABSPORT51 "Schaltdruck abschaltende Kupplung" MAP 0x1BCA74 ZF_kf_si16_S5_S3 12.75 UMR_BAR__1_1000_0_S5_S3 0 12.75
 /begin AXIS_DESCR STD_AXIS iSasZentr.iSchaltend.n_tkf UMR_U_MIN_32_1_0_S5_S3 8 0 8160 DEPOSIT ABSOLUTE /end AXIS_DESCR
 /begin AXIS_DESCR STD_AXIS zff_atsys._.iSignale._.obj.sig_m_t UMR_NM__1_1_0_S5_S3 10 -200 1300 DEPOSIT ABSOLUTE /end AXIS_DESCR
/end CHARACTERISTIC
/begin CHARACTERISTIC KF_PKABSPORT53 "Schaltdruck abschaltende Kupplung" MAP 0x1BCC2C ZF_kf_si16_S5_S3 12.75 UMR_BAR__1_1000_0_S5_S3 0 12.75
 /begin AXIS_DESCR STD_AXIS iSasZentr.iSchaltend.n_tkf UMR_U_MIN_32_1_0_S5_S3 8 0 8160 DEPOSIT ABSOLUTE /end AXIS_DESCR
 /begin AXIS_DESCR STD_AXIS zff_atsys._.iSignale._.obj.sig_m_t UMR_NM__1_1_0_S5_S3 10 -200 1300 DEPOSIT ABSOLUTE /end AXIS_DESCR
/end CHARACTERISTIC
/begin CHARACTERISTIC KF_PKABSPORT54 "Schaltdruck abschaltende Kupplung" MAP 0x1BC024 ZF_kf_si16_S5_S3 12.75 UMR_BAR__1_1000_0_S5_S3 0 12.75
 /begin AXIS_DESCR STD_AXIS iSasZentr.iSchaltend.n_tkf UMR_U_MIN_32_1_0_S5_S3 8 0 8160 DEPOSIT ABSOLUTE /end AXIS_DESCR
 /begin AXIS_DESCR STD_AXIS zff_atsys._.iSignale._.obj.sig_m_t UMR_NM__1_1_0_S5_S3 10 -200 1300 DEPOSIT ABSOLUTE /end AXIS_DESCR
/end CHARACTERISTIC
/begin CHARACTERISTIC KF_PKABSPORT63 "Schaltdruck abschaltende Kupplung" MAP 0x1BCDE4 ZF_kf_si16_S5_S3 12.75 UMR_BAR__1_1000_0_S5_S3 0 12.75
 /begin AXIS_DESCR STD_AXIS iSasZentr.iSchaltend.n_tkf UMR_U_MIN_32_1_0_S5_S3 8 0 8160 DEPOSIT ABSOLUTE /end AXIS_DESCR
 /begin AXIS_DESCR STD_AXIS zff_atsys._.iSignale._.obj.sig_m_t UMR_NM__1_1_0_S5_S3 10 -200 1300 DEPOSIT ABSOLUTE /end AXIS_DESCR
/end CHARACTERISTIC
/begin CHARACTERISTIC KF_PKABSPORT64 "Schaltdruck abschaltende Kupplung" MAP 0x1BCF9C ZF_kf_si16_S5_S3 12.75 UMR_BAR__1_1000_0_S5_S3 0 12.75
 /begin AXIS_DESCR STD_AXIS iSasZentr.iSchaltend.n_tkf UMR_U_MIN_32_1_0_S5_S3 8 0 8160 DEPOSIT ABSOLUTE /end AXIS_DESCR
 /begin AXIS_DESCR STD_AXIS zff_atsys._.iSignale._.obj.sig_m_t UMR_NM__1_1_0_S5_S3 10 -200 1300 DEPOSIT ABSOLUTE /end AXIS_DESCR
/end CHARACTERISTIC
/begin CHARACTERISTIC KF_PKABSPORT65 "Schaltdruck abschaltende Kupplung" MAP 0x1BC1DC ZF_kf_si16_S5_S3 12.75 UMR_BAR__1_1000_0_S5_S3 0 12.75
 /begin AXIS_DESCR STD_AXIS iSasZentr.iSchaltend.n_tkf UMR_U_MIN_32_1_0_S5_S3 8 0 8160 DEPOSIT ABSOLUTE /end AXIS_DESCR
 /begin AXIS_DESCR STD_AXIS zff_atsys._.iSignale._.obj.sig_m_t UMR_NM__1_1_0_S5_S3 10 -200 1300 DEPOSIT ABSOLUTE /end AXIS_DESCR
/end CHARACTERISTIC
/begin CHARACTERISTIC KF_PKABSPORT71 "Schaltdruck abschaltende Kupplung" MAP 0x1BD154 ZF_kf_si16_S5_S3 12.75 UMR_BAR__1_1000_0_S5_S3 0 12.75
 /begin AXIS_DESCR STD_AXIS iSasZentr.iSchaltend.n_tkf UMR_U_MIN_32_1_0_S5_S3 8 0 8160 DEPOSIT ABSOLUTE /end AXIS_DESCR
 /begin AXIS_DESCR STD_AXIS zff_atsys._.iSignale._.obj.sig_m_t UMR_NM__1_1_0_S5_S3 10 -200 1300 DEPOSIT ABSOLUTE /end AXIS_DESCR
/end CHARACTERISTIC
/begin CHARACTERISTIC KF_PKABSPORT75 "Schaltdruck abschaltende Kupplung" MAP 0x1BD30C ZF_kf_si16_S5_S3 12.75 UMR_BAR__1_1000_0_S5_S3 0 12.75
 /begin AXIS_DESCR STD_AXIS iSasZentr.iSchaltend.n_tkf UMR_U_MIN_32_1_0_S5_S3 8 0 8160 DEPOSIT ABSOLUTE /end AXIS_DESCR
 /begin AXIS_DESCR STD_AXIS zff_atsys._.iSignale._.obj.sig_m_t UMR_NM__1_1_0_S5_S3 10 -200 1300 DEPOSIT ABSOLUTE /end AXIS_DESCR
/end CHARACTERISTIC
/begin CHARACTERISTIC KF_PKABSPORT76 "Schaltdruck abschaltende Kupplung" MAP 0x1BC394 ZF_kf_si16_S5_S3 12.75 UMR_BAR__1_1000_0_S5_S3 0 12.75
 /begin AXIS_DESCR STD_AXIS iSasZentr.iSchaltend.n_tkf UMR_U_MIN_32_1_0_S5_S3 8 0 8160 DEPOSIT ABSOLUTE /end AXIS_DESCR
 /begin AXIS_DESCR STD_AXIS zff_atsys._.iSignale._.obj.sig_m_t UMR_NM__1_1_0_S5_S3 10 -200 1300 DEPOSIT ABSOLUTE /end AXIS_DESCR
/end CHARACTERISTIC
/begin CHARACTERISTIC KF_PKABSPORT82 "Schaltdruck abschaltende Kupplung" MAP 0x1BD4C4 ZF_kf_si16_S5_S3 12.75 UMR_BAR__1_1000_0_S5_S3 0 12.75
 /begin AXIS_DESCR STD_AXIS iSasZentr.iSchaltend.n_tkf UMR_U_MIN_32_1_0_S5_S3 8 0 8160 DEPOSIT ABSOLUTE /end AXIS_DESCR
 /begin AXIS_DESCR STD_AXIS zff_atsys._.iSignale._.obj.sig_m_t UMR_NM__1_1_0_S5_S3 10 -200 1300 DEPOSIT ABSOLUTE /end AXIS_DESCR
/end CHARACTERISTIC
/begin CHARACTERISTIC KF_POHINSYNKAB21 "Kennfeld Haltedruckoffset(n_tkf, m_t) bei Haltephase in Synchron" MAP 0x1B8A04 ZF_kf_si16_S5_S3 12.75 UMR_BAR__1_1000_0_S5_S3 -6.4 6.35
 /begin AXIS_DESCR STD_AXIS iSasZentr.iSchaltend.n_tkf UMR_U_MIN_32_1_0_S5_S3 6 0 8160 DEPOSIT ABSOLUTE /end AXIS_DESCR
 /begin AXIS_DESCR STD_AXIS zff_atsys._.iSignale._.obj.sig_m_t UMR_NM__1_1_0_S5_S3 6 -200 1300 DEPOSIT ABSOLUTE /end AXIS_DESCR
/end CHARACTERISTIC
/begin CHARACTERISTIC KF_POHINSYNKAB32 "Kennfeld Haltedruckoffset(n_tkf, m_t) bei Haltephase in Synchron" MAP 0x1B8CE0 ZF_kf_si16_S5_S3 12.75 UMR_BAR__1_1000_0_S5_S3 -6.4 6.35
 /begin AXIS_DESCR STD_AXIS iSasZentr.iSchaltend.n_tkf UMR_U_MIN_32_1_0_S5_S3 6 0 8160 DEPOSIT ABSOLUTE /end AXIS_DESCR
 /begin AXIS_DESCR STD_AXIS zff_atsys._.iSignale._.obj.sig_m_t UMR_NM__1_1_0_S5_S3 6 -200 1300 DEPOSIT ABSOLUTE /end AXIS_DESCR
/end CHARACTERISTIC
/begin CHARACTERISTIC KF_POHINSYNKAB43 "Kennfeld Haltedruckoffset(n_tkf, m_t) bei Haltephase in Synchron" MAP 0x1B8FBC ZF_kf_si16_S5_S3 12.75 UMR_BAR__1_1000_0_S5_S3 -6.4 6.35
 /begin AXIS_DESCR STD_AXIS iSasZentr.iSchaltend.n_tkf UMR_U_MIN_32_1_0_S5_S3 6 0 8160 DEPOSIT ABSOLUTE /end AXIS_DESCR
 /begin AXIS_DESCR STD_AXIS zff_atsys._.iSignale._.obj.sig_m_t UMR_NM__1_1_0_S5_S3 6 -200 1300 DEPOSIT ABSOLUTE /end AXIS_DESCR
/end CHARACTERISTIC
/begin CHARACTERISTIC KF_POHINSYNKAB54 "Kennfeld Haltedruckoffset(n_tkf, m_t) bei Haltephase in Synchron" MAP 0x1B9298 ZF_kf_si16_S5_S3 12.75 UMR_BAR__1_1000_0_S5_S3 -6.4 6.35
 /begin AXIS_DESCR STD_AXIS iSasZentr.iSchaltend.n_tkf UMR_U_MIN_32_1_0_S5_S3 6 0 8160 DEPOSIT ABSOLUTE /end AXIS_DESCR
 /begin AXIS_DESCR STD_AXIS zff_atsys._.iSignale._.obj.sig_m_t UMR_NM__1_1_0_S5_S3 6 -200 1300 DEPOSIT ABSOLUTE /end AXIS_DESCR
/end CHARACTERISTIC
/begin CHARACTERISTIC KF_POHINSYNKAB65 "Kennfeld Haltedruckoffset(n_tkf, m_t) bei Haltephase in Synchron" MAP 0x1B9574 ZF_kf_si16_S5_S3 12.75 UMR_BAR__1_1000_0_S5_S3 -6.4 6.35
 /begin AXIS_DESCR STD_AXIS iSasZentr.iSchaltend.n_tkf UMR_U_MIN_32_1_0_S5_S3 6 0 8160 DEPOSIT ABSOLUTE /end AXIS_DESCR
 /begin AXIS_DESCR STD_AXIS zff_atsys._.iSignale._.obj.sig_m_t UMR_NM__1_1_0_S5_S3 6 -200 1300 DEPOSIT ABSOLUTE /end AXIS_DESCR
/end CHARACTERISTIC
/begin CHARACTERISTIC KF_POHINSYNKAB76 "Kennfeld Haltedruckoffset(n_tkf, m_t) bei Haltephase in Synchron" MAP 0x1B9850 ZF_kf_si16_S5_S3 12.75 UMR_BAR__1_1000_0_S5_S3 -6.4 6.35
 /begin AXIS_DESCR STD_AXIS iSasZentr.iSchaltend.n_tkf UMR_U_MIN_32_1_0_S5_S3 6 0 8160 DEPOSIT ABSOLUTE /end AXIS_DESCR
 /begin AXIS_DESCR STD_AXIS zff_atsys._.iSignale._.obj.sig_m_t UMR_NM__1_1_0_S5_S3 6 -200 1300 DEPOSIT ABSOLUTE /end AXIS_DESCR
/end CHARACTERISTIC
/begin CHARACTERISTIC KF_POHINSYNKAB87 "Kennfeld Haltedruckoffset(n_tkf, m_t) bei Haltephase in Synchron" MAP 0x1B9B2C ZF_kf_si16_S5_S3 12.75 UMR_BAR__1_1000_0_S5_S3 -6.4 6.35
 /begin AXIS_DESCR STD_AXIS iSasZentr.iSchaltend.n_tkf UMR_U_MIN_32_1_0_S5_S3 6 0 8160 DEPOSIT ABSOLUTE /end AXIS_DESCR
 /begin AXIS_DESCR STD_AXIS zff_atsys._.iSignale._.obj.sig_m_t UMR_NM__1_1_0_S5_S3 6 -200 1300 DEPOSIT ABSOLUTE /end AXIS_DESCR
/end CHARACTERISTIC
/begin CHARACTERISTIC KF_POHINSYNKABSP21 "Kennfeld Haltedruckoffset(n_tkf, m_t) bei Haltephase in Synchron" MAP 0x1B9CE4 ZF_kf_si16_S5_S3 12.75 UMR_BAR__1_1000_0_S5_S3 -6.4 6.35
 /begin AXIS_DESCR STD_AXIS iSasZentr.iSchaltend.n_tkf UMR_U_MIN_32_1_0_S5_S3 6 0 8160 DEPOSIT ABSOLUTE /end AXIS_DESCR
 /begin AXIS_DESCR STD_AXIS zff_atsys._.iSignale._.obj.sig_m_t UMR_NM__1_1_0_S5_S3 6 -200 1300 DEPOSIT ABSOLUTE /end AXIS_DESCR
/end CHARACTERISTIC
/begin CHARACTERISTIC KF_POHINSYNKABSP31 "Kennfeld Haltedruckoffset(n_tkf, m_t) bei Haltephase in Synchron" MAP 0x1BA8EC ZF_kf_si16_S5_S3 12.75 UMR_BAR__1_1000_0_S5_S3 -6.4 6.35
 /begin AXIS_DESCR STD_AXIS iSasZentr.iSchaltend.n_tkf UMR_U_MIN_32_1_0_S5_S3 6 0 8160 DEPOSIT ABSOLUTE /end AXIS_DESCR
 /begin AXIS_DESCR STD_AXIS zff_atsys._.iSignale._.obj.sig_m_t UMR_NM__1_1_0_S5_S3 6 -200 1300 DEPOSIT ABSOLUTE /end AXIS_DESCR
/end CHARACTERISTIC
/begin CHARACTERISTIC KF_POHINSYNKABSP32 "Kennfeld Haltedruckoffset(n_tkf, m_t) bei Haltephase in Synchron" MAP 0x1B9E9C ZF_kf_si16_S5_S3 12.75 UMR_BAR__1_1000_0_S5_S3 -6.4 6.35
 /begin AXIS_DESCR STD_AXIS iSasZentr.iSchaltend.n_tkf UMR_U_MIN_32_1_0_S5_S3 6 0 8160 DEPOSIT ABSOLUTE /end AXIS_DESCR
 /begin AXIS_DESCR STD_AXIS zff_atsys._.iSignale._.obj.sig_m_t UMR_NM__1_1_0_S5_S3 6 -200 1300 DEPOSIT ABSOLUTE /end AXIS_DESCR
/end CHARACTERISTIC
/begin CHARACTERISTIC KF_POHINSYNKABSP42 "Kennfeld Haltedruckoffset(n_tkf, m_t) bei Haltephase in Synchron" MAP 0x1BAAA4 ZF_kf_si16_S5_S3 12.75 UMR_BAR__1_1000_0_S5_S3 -6.4 6.35
 /begin AXIS_DESCR STD_AXIS iSasZentr.iSchaltend.n_tkf UMR_U_MIN_32_1_0_S5_S3 6 0 8160 DEPOSIT ABSOLUTE /end AXIS_DESCR
 /begin AXIS_DESCR STD_AXIS zff_atsys._.iSignale._.obj.sig_m_t UMR_NM__1_1_0_S5_S3 6 -200 1300 DEPOSIT ABSOLUTE /end AXIS_DESCR
/end CHARACTERISTIC
/begin CHARACTERISTIC KF_POHINSYNKABSP43 "Kennfeld Haltedruckoffset(n_tkf, m_t) bei Haltephase in Synchron" MAP 0x1BA054 ZF_kf_si16_S5_S3 12.75 UMR_BAR__1_1000_0_S5_S3 -6.4 6.35
 /begin AXIS_DESCR STD_AXIS iSasZentr.iSchaltend.n_tkf UMR_U_MIN_32_1_0_S5_S3 6 0 8160 DEPOSIT ABSOLUTE /end AXIS_DESCR
 /begin AXIS_DESCR STD_AXIS zff_atsys._.iSignale._.obj.sig_m_t UMR_NM__1_1_0_S5_S3 6 -200 1300 DEPOSIT ABSOLUTE /end AXIS_DESCR
/end CHARACTERISTIC
/begin CHARACTERISTIC KF_POHINSYNKABSP51 "Kennfeld Haltedruckoffset(n_tkf, m_t) bei Haltephase in Synchron" MAP 0x1BAC5C ZF_kf_si16_S5_S3 12.75 UMR_BAR__1_1000_0_S5_S3 -6.4 6.35
 /begin AXIS_DESCR STD_AXIS iSasZentr.iSchaltend.n_tkf UMR_U_MIN_32_1_0_S5_S3 6 0 8160 DEPOSIT ABSOLUTE /end AXIS_DESCR
 /begin AXIS_DESCR STD_AXIS zff_atsys._.iSignale._.obj.sig_m_t UMR_NM__1_1_0_S5_S3 6 -200 1300 DEPOSIT ABSOLUTE /end AXIS_DESCR
/end CHARACTERISTIC
/begin CHARACTERISTIC KF_POHINSYNKABSP53 "Kennfeld Haltedruckoffset(n_tkf, m_t) bei Haltephase in Synchron" MAP 0x1BAE14 ZF_kf_si16_S5_S3 12.75 UMR_BAR__1_1000_0_S5_S3 -6.4 6.35
 /begin AXIS_DESCR STD_AXIS iSasZentr.iSchaltend.n_tkf UMR_U_MIN_32_1_0_S5_S3 6 0 8160 DEPOSIT ABSOLUTE /end AXIS_DESCR
 /begin AXIS_DESCR STD_AXIS zff_atsys._.iSignale._.obj.sig_m_t UMR_NM__1_1_0_S5_S3 6 -200 1300 DEPOSIT ABSOLUTE /end AXIS_DESCR
/end CHARACTERISTIC
/begin CHARACTERISTIC KF_POHINSYNKABSP54 "Kennfeld Haltedruckoffset(n_tkf, m_t) bei Haltephase in Synchron" MAP 0x1BA20C ZF_kf_si16_S5_S3 12.75 UMR_BAR__1_1000_0_S5_S3 -6.4 6.35
 /begin AXIS_DESCR STD_AXIS iSasZentr.iSchaltend.n_tkf UMR_U_MIN_32_1_0_S5_S3 6 0 8160 DEPOSIT ABSOLUTE /end AXIS_DESCR
 /begin AXIS_DESCR STD_AXIS zff_atsys._.iSignale._.obj.sig_m_t UMR_NM__1_1_0_S5_S3 6 -200 1300 DEPOSIT ABSOLUTE /end AXIS_DESCR
/end CHARACTERISTIC
/begin CHARACTERISTIC KF_POHINSYNKABSP63 "Kennfeld Haltedruckoffset(n_tkf, m_t) bei Haltephase in Synchron" MAP 0x1BAFCC ZF_kf_si16_S5_S3 12.75 UMR_BAR__1_1000_0_S5_S3 -6.4 6.35
 /begin AXIS_DESCR STD_AXIS iSasZentr.iSchaltend.n_tkf UMR_U_MIN_32_1_0_S5_S3 6 0 8160 DEPOSIT ABSOLUTE /end AXIS_DESCR
 /begin AXIS_DESCR STD_AXIS zff_atsys._.iSignale._.obj.sig_m_t UMR_NM__1_1_0_S5_S3 6 -200 1300 DEPOSIT ABSOLUTE /end AXIS_DESCR
/end CHARACTERISTIC
/begin CHARACTERISTIC KF_POHINSYNKABSP64 "Kennfeld Haltedruckoffset(n_tkf, m_t) bei Haltephase in Synchron" MAP 0x1BB184 ZF_kf_si16_S5_S3 12.75 UMR_BAR__1_1000_0_S5_S3 -6.4 6.35
 /begin AXIS_DESCR STD_AXIS iSasZentr.iSchaltend.n_tkf UMR_U_MIN_32_1_0_S5_S3 6 0 8160 DEPOSIT ABSOLUTE /end AXIS_DESCR
 /begin AXIS_DESCR STD_AXIS zff_atsys._.iSignale._.obj.sig_m_t UMR_NM__1_1_0_S5_S3 6 -200 1300 DEPOSIT ABSOLUTE /end AXIS_DESCR
/end CHARACTERISTIC
/begin CHARACTERISTIC KF_POHINSYNKABSP65 "Kennfeld Haltedruckoffset(n_tkf, m_t) bei Haltephase in Synchron" MAP 0x1BA3C4 ZF_kf_si16_S5_S3 12.75 UMR_BAR__1_1000_0_S5_S3 -6.4 6.35
 /begin AXIS_DESCR STD_AXIS iSasZentr.iSchaltend.n_tkf UMR_U_MIN_32_1_0_S5_S3 6 0 8160 DEPOSIT ABSOLUTE /end AXIS_DESCR
 /begin AXIS_DESCR STD_AXIS zff_atsys._.iSignale._.obj.sig_m_t UMR_NM__1_1_0_S5_S3 6 -200 1300 DEPOSIT ABSOLUTE /end AXIS_DESCR
/end CHARACTERISTIC
/begin CHARACTERISTIC KF_POHINSYNKABSP71 "Kennfeld Haltedruckoffset(n_tkf, m_t) bei Haltephase in Synchron" MAP 0x1BB33C ZF_kf_si16_S5_S3 12.75 UMR_BAR__1_1000_0_S5_S3 -6.4 6.35
 /begin AXIS_DESCR STD_AXIS iSasZentr.iSchaltend.n_tkf UMR_U_MIN_32_1_0_S5_S3 6 0 8160 DEPOSIT ABSOLUTE /end AXIS_DESCR
 /begin AXIS_DESCR STD_AXIS zff_atsys._.iSignale._.obj.sig_m_t UMR_NM__1_1_0_S5_S3 6 -200 1300 DEPOSIT ABSOLUTE /end AXIS_DESCR
/end CHARACTERISTIC
/begin CHARACTERISTIC KF_POHINSYNKABSP75 "Kennfeld Haltedruckoffset(n_tkf, m_t) bei Haltephase in Synchron" MAP 0x1BB4F4 ZF_kf_si16_S5_S3 12.75 UMR_BAR__1_1000_0_S5_S3 -6.4 6.35
 /begin AXIS_DESCR STD_AXIS iSasZentr.iSchaltend.n_tkf UMR_U_MIN_32_1_0_S5_S3 6 0 8160 DEPOSIT ABSOLUTE /end AXIS_DESCR
 /begin AXIS_DESCR STD_AXIS zff_atsys._.iSignale._.obj.sig_m_t UMR_NM__1_1_0_S5_S3 6 -200 1300 DEPOSIT ABSOLUTE /end AXIS_DESCR
/end CHARACTERISTIC
/begin CHARACTERISTIC KF_POHINSYNKABSP76 "Kennfeld Haltedruckoffset(n_tkf, m_t) bei Haltephase in Synchron" MAP 0x1BA57C ZF_kf_si16_S5_S3 12.75 UMR_BAR__1_1000_0_S5_S3 -6.4 6.35
 /begin AXIS_DESCR STD_AXIS iSasZentr.iSchaltend.n_tkf UMR_U_MIN_32_1_0_S5_S3 6 0 8160 DEPOSIT ABSOLUTE /end AXIS_DESCR
 /begin AXIS_DESCR STD_AXIS zff_atsys._.iSignale._.obj.sig_m_t UMR_NM__1_1_0_S5_S3 6 -200 1300 DEPOSIT ABSOLUTE /end AXIS_DESCR
/end CHARACTERISTIC
/begin CHARACTERISTIC KF_POHINSYNKABSP82 "Kennfeld Haltedruckoffset(n_tkf, m_t) bei Haltephase in Synchron" MAP 0x1BB6AC ZF_kf_si16_S5_S3 12.75 UMR_BAR__1_1000_0_S5_S3 -6.4 6.35
 /begin AXIS_DESCR STD_AXIS iSasZentr.iSchaltend.n_tkf UMR_U_MIN_32_1_0_S5_S3 6 0 8160 DEPOSIT ABSOLUTE /end AXIS_DESCR
 /begin AXIS_DESCR STD_AXIS zff_atsys._.iSignale._.obj.sig_m_t UMR_NM__1_1_0_S5_S3 6 -200 1300 DEPOSIT ABSOLUTE /end AXIS_DESCR
/end CHARACTERISTIC
/begin CHARACTERISTIC KF_POHINSYNKABSP84 "Kennfeld Haltedruckoffset(n_tkf, m_t) bei Haltephase in Synchron" MAP 0x1BB864 ZF_kf_si16_S5_S3 12.75 UMR_BAR__1_1000_0_S5_S3 -6.4 6.35
 /begin AXIS_DESCR STD_AXIS iSasZentr.iSchaltend.n_tkf UMR_U_MIN_32_1_0_S5_S3 6 0 8160 DEPOSIT ABSOLUTE /end AXIS_DESCR
 /begin AXIS_DESCR STD_AXIS zff_atsys._.iSignale._.obj.sig_m_t UMR_NM__1_1_0_S5_S3 6 -200 1300 DEPOSIT ABSOLUTE /end AXIS_DESCR
/end CHARACTERISTIC
/begin CHARACTERISTIC KF_POHINSYNKABSP86 "Kennfeld Haltedruckoffset(n_tkf, m_t) bei Haltephase in Synchron" MAP 0x1BBA1C ZF_kf_si16_S5_S3 12.75 UMR_BAR__1_1000_0_S5_S3 -6.4 6.35
 /begin AXIS_DESCR STD_AXIS iSasZentr.iSchaltend.n_tkf UMR_U_MIN_32_1_0_S5_S3 6 0 8160 DEPOSIT ABSOLUTE /end AXIS_DESCR
 /begin AXIS_DESCR STD_AXIS zff_atsys._.iSignale._.obj.sig_m_t UMR_NM__1_1_0_S5_S3 6 -200 1300 DEPOSIT ABSOLUTE /end AXIS_DESCR
/end CHARACTERISTIC
/begin CHARACTERISTIC KF_POHINSYNKABSP87 "Kennfeld Haltedruckoffset(n_tkf, m_t) bei Haltephase in Synchron" MAP 0x1BA734 ZF_kf_si16_S5_S3 12.75 UMR_BAR__1_1000_0_S5_S3 -6.4 6.35
 /begin AXIS_DESCR STD_AXIS iSasZentr.iSchaltend.n_tkf UMR_U_MIN_32_1_0_S5_S3 6 0 8160 DEPOSIT ABSOLUTE /end AXIS_DESCR
 /begin AXIS_DESCR STD_AXIS zff_atsys._.iSignale._.obj.sig_m_t UMR_NM__1_1_0_S5_S3 6 -200 1300 DEPOSIT ABSOLUTE /end AXIS_DESCR
/end CHARACTERISTIC
/begin CHARACTERISTIC KF_POHINSYNKABSPORT21 "Kennfeld Haltedruckoffset(n_tkf, m_t) bei Haltephase in Synchron" MAP 0x1BBBD4 ZF_kf_si16_S5_S3 12.75 UMR_BAR__1_1000_0_S5_S3 -6.4 6.35
 /begin AXIS_DESCR STD_AXIS iSasZentr.iSchaltend.n_tkf UMR_U_MIN_32_1_0_S5_S3 6 0 8160 DEPOSIT ABSOLUTE /end AXIS_DESCR
 /begin AXIS_DESCR STD_AXIS zff_atsys._.iSignale._.obj.sig_m_t UMR_NM__1_1_0_S5_S3 6 -200 1300 DEPOSIT ABSOLUTE /end AXIS_DESCR
/end CHARACTERISTIC
/begin CHARACTERISTIC KF_POHINSYNKABSPORT31 "Kennfeld Haltedruckoffset(n_tkf, m_t) bei Haltephase in Synchron" MAP 0x1BC7DC ZF_kf_si16_S5_S3 12.75 UMR_BAR__1_1000_0_S5_S3 -6.4 6.35
 /begin AXIS_DESCR STD_AXIS iSasZentr.iSchaltend.n_tkf UMR_U_MIN_32_1_0_S5_S3 6 0 8160 DEPOSIT ABSOLUTE /end AXIS_DESCR
 /begin AXIS_DESCR STD_AXIS zff_atsys._.iSignale._.obj.sig_m_t UMR_NM__1_1_0_S5_S3 6 -200 1300 DEPOSIT ABSOLUTE /end AXIS_DESCR
/end CHARACTERISTIC
/begin CHARACTERISTIC KF_POHINSYNKABSPORT32 "Kennfeld Haltedruckoffset(n_tkf, m_t) bei Haltephase in Synchron" MAP 0x1BBD8C ZF_kf_si16_S5_S3 12.75 UMR_BAR__1_1000_0_S5_S3 -6.4 6.35
 /begin AXIS_DESCR STD_AXIS iSasZentr.iSchaltend.n_tkf UMR_U_MIN_32_1_0_S5_S3 6 0 8160 DEPOSIT ABSOLUTE /end AXIS_DESCR
 /begin AXIS_DESCR STD_AXIS zff_atsys._.iSignale._.obj.sig_m_t UMR_NM__1_1_0_S5_S3 6 -200 1300 DEPOSIT ABSOLUTE /end AXIS_DESCR
/end CHARACTERISTIC
/begin CHARACTERISTIC KF_POHINSYNKABSPORT42 "Kennfeld Haltedruckoffset(n_tkf, m_t) bei Haltephase in Synchron" MAP 0x1BC994 ZF_kf_si16_S5_S3 12.75 UMR_BAR__1_1000_0_S5_S3 -6.4 6.35
 /begin AXIS_DESCR STD_AXIS iSasZentr.iSchaltend.n_tkf UMR_U_MIN_32_1_0_S5_S3 6 0 8160 DEPOSIT ABSOLUTE /end AXIS_DESCR
 /begin AXIS_DESCR STD_AXIS zff_atsys._.iSignale._.obj.sig_m_t UMR_NM__1_1_0_S5_S3 6 -200 1300 DEPOSIT ABSOLUTE /end AXIS_DESCR
/end CHARACTERISTIC
/begin CHARACTERISTIC KF_POHINSYNKABSPORT43 "Kennfeld Haltedruckoffset(n_tkf, m_t) bei Haltephase in Synchron" MAP 0x1BBF44 ZF_kf_si16_S5_S3 12.75 UMR_BAR__1_1000_0_S5_S3 -6.4 6.35
 /begin AXIS_DESCR STD_AXIS iSasZentr.iSchaltend.n_tkf UMR_U_MIN_32_1_0_S5_S3 6 0 8160 DEPOSIT ABSOLUTE /end AXIS_DESCR
 /begin AXIS_DESCR STD_AXIS zff_atsys._.iSignale._.obj.sig_m_t UMR_NM__1_1_0_S5_S3 6 -200 1300 DEPOSIT ABSOLUTE /end AXIS_DESCR
/end CHARACTERISTIC
/begin CHARACTERISTIC KF_POHINSYNKABSPORT51 "Kennfeld Haltedruckoffset(n_tkf, m_t) bei Haltephase in Synchron" MAP 0x1BCB4C ZF_kf_si16_S5_S3 12.75 UMR_BAR__1_1000_0_S5_S3 -6.4 6.35
 /begin AXIS_DESCR STD_AXIS iSasZentr.iSchaltend.n_tkf UMR_U_MIN_32_1_0_S5_S3 6 0 8160 DEPOSIT ABSOLUTE /end AXIS_DESCR
 /begin AXIS_DESCR STD_AXIS zff_atsys._.iSignale._.obj.sig_m_t UMR_NM__1_1_0_S5_S3 6 -200 1300 DEPOSIT ABSOLUTE /end AXIS_DESCR
/end CHARACTERISTIC
/begin CHARACTERISTIC KF_POHINSYNKABSPORT53 "Kennfeld Haltedruckoffset(n_tkf, m_t) bei Haltephase in Synchron" MAP 0x1BCD04 ZF_kf_si16_S5_S3 12.75 UMR_BAR__1_1000_0_S5_S3 -6.4 6.35
 /begin AXIS_DESCR STD_AXIS iSasZentr.iSchaltend.n_tkf UMR_U_MIN_32_1_0_S5_S3 6 0 8160 DEPOSIT ABSOLUTE /end AXIS_DESCR
 /begin AXIS_DESCR STD_AXIS zff_atsys._.iSignale._.obj.sig_m_t UMR_NM__1_1_0_S5_S3 6 -200 1300 DEPOSIT ABSOLUTE /end AXIS_DESCR
/end CHARACTERISTIC
/begin CHARACTERISTIC KF_POHINSYNKABSPORT54 "Kennfeld Haltedruckoffset(n_tkf, m_t) bei Haltephase in Synchron" MAP 0x1BC0FC ZF_kf_si16_S5_S3 12.75 UMR_BAR__1_1000_0_S5_S3 -6.4 6.35
 /begin AXIS_DESCR STD_AXIS iSasZentr.iSchaltend.n_tkf UMR_U_MIN_32_1_0_S5_S3 6 0 8160 DEPOSIT ABSOLUTE /end AXIS_DESCR
 /begin AXIS_DESCR STD_AXIS zff_atsys._.iSignale._.obj.sig_m_t UMR_NM__1_1_0_S5_S3 6 -200 1300 DEPOSIT ABSOLUTE /end AXIS_DESCR
/end CHARACTERISTIC
/begin CHARACTERISTIC KF_POHINSYNKABSPORT63 "Kennfeld Haltedruckoffset(n_tkf, m_t) bei Haltephase in Synchron" MAP 0x1BCEBC ZF_kf_si16_S5_S3 12.75 UMR_BAR__1_1000_0_S5_S3 -6.4 6.35
 /begin AXIS_DESCR STD_AXIS iSasZentr.iSchaltend.n_tkf UMR_U_MIN_32_1_0_S5_S3 6 0 8160 DEPOSIT ABSOLUTE /end AXIS_DESCR
 /begin AXIS_DESCR STD_AXIS zff_atsys._.iSignale._.obj.sig_m_t UMR_NM__1_1_0_S5_S3 6 -200 1300 DEPOSIT ABSOLUTE /end AXIS_DESCR
/end CHARACTERISTIC
/begin CHARACTERISTIC KF_POHINSYNKABSPORT64 "Kennfeld Haltedruckoffset(n_tkf, m_t) bei Haltephase in Synchron" MAP 0x1BD074 ZF_kf_si16_S5_S3 12.75 UMR_BAR__1_1000_0_S5_S3 -6.4 6.35
 /begin AXIS_DESCR STD_AXIS iSasZentr.iSchaltend.n_tkf UMR_U_MIN_32_1_0_S5_S3 6 0 8160 DEPOSIT ABSOLUTE /end AXIS_DESCR
 /begin AXIS_DESCR STD_AXIS zff_atsys._.iSignale._.obj.sig_m_t UMR_NM__1_1_0_S5_S3 6 -200 1300 DEPOSIT ABSOLUTE /end AXIS_DESCR
/end CHARACTERISTIC
/begin CHARACTERISTIC KF_POHINSYNKABSPORT65 "Kennfeld Haltedruckoffset(n_tkf, m_t) bei Haltephase in Synchron" MAP 0x1BC2B4 ZF_kf_si16_S5_S3 12.75 UMR_BAR__1_1000_0_S5_S3 -6.4 6.35
 /begin AXIS_DESCR STD_AXIS iSasZentr.iSchaltend.n_tkf UMR_U_MIN_32_1_0_S5_S3 6 0 8160 DEPOSIT ABSOLUTE /end AXIS_DESCR
 /begin AXIS_DESCR STD_AXIS zff_atsys._.iSignale._.obj.sig_m_t UMR_NM__1_1_0_S5_S3 6 -200 1300 DEPOSIT ABSOLUTE /end AXIS_DESCR
/end CHARACTERISTIC
/begin CHARACTERISTIC KF_POHINSYNKABSPORT71 "Kennfeld Haltedruckoffset(n_tkf, m_t) bei Haltephase in Synchron" MAP 0x1BD22C ZF_kf_si16_S5_S3 12.75 UMR_BAR__1_1000_0_S5_S3 -6.4 6.35
 /begin AXIS_DESCR STD_AXIS iSasZentr.iSchaltend.n_tkf UMR_U_MIN_32_1_0_S5_S3 6 0 8160 DEPOSIT ABSOLUTE /end AXIS_DESCR
 /begin AXIS_DESCR STD_AXIS zff_atsys._.iSignale._.obj.sig_m_t UMR_NM__1_1_0_S5_S3 6 -200 1300 DEPOSIT ABSOLUTE /end AXIS_DESCR
/end CHARACTERISTIC
/begin CHARACTERISTIC KF_POHINSYNKABSPORT75 "Kennfeld Haltedruckoffset(n_tkf, m_t) bei Haltephase in Synchron" MAP 0x1BD3E4 ZF_kf_si16_S5_S3 12.75 UMR_BAR__1_1000_0_S5_S3 -6.4 6.35
 /begin AXIS_DESCR STD_AXIS iSasZentr.iSchaltend.n_tkf UMR_U_MIN_32_1_0_S5_S3 6 0 8160 DEPOSIT ABSOLUTE /end AXIS_DESCR
 /begin AXIS_DESCR STD_AXIS zff_atsys._.iSignale._.obj.sig_m_t UMR_NM__1_1_0_S5_S3 6 -200 1300 DEPOSIT ABSOLUTE /end AXIS_DESCR
/end CHARACTERISTIC
/begin CHARACTERISTIC KF_POHINSYNKABSPORT76 "Kennfeld Haltedruckoffset(n_tkf, m_t) bei Haltephase in Synchron" MAP 0x1BC46C ZF_kf_si16_S5_S3 12.75 UMR_BAR__1_1000_0_S5_S3 -6.4 6.35
 /begin AXIS_DESCR STD_AXIS iSasZentr.iSchaltend.n_tkf UMR_U_MIN_32_1_0_S5_S3 6 0 8160 DEPOSIT ABSOLUTE /end AXIS_DESCR
 /begin AXIS_DESCR STD_AXIS zff_atsys._.iSignale._.obj.sig_m_t UMR_NM__1_1_0_S5_S3 6 -200 1300 DEPOSIT ABSOLUTE /end AXIS_DESCR
/end CHARACTERISTIC
/begin CHARACTERISTIC KF_POHINSYNKABSPORT82 "Kennfeld Haltedruckoffset(n_tkf, m_t) bei Haltephase in Synchron" MAP 0x1BD59C ZF_kf_si16_S5_S3 12.75 UMR_BAR__1_1000_0_S5_S3 -6.4 6.35
 /begin AXIS_DESCR STD_AXIS iSasZentr.iSchaltend.n_tkf UMR_U_MIN_32_1_0_S5_S3 6 0 8160 DEPOSIT ABSOLUTE /end AXIS_DESCR
 /begin AXIS_DESCR STD_AXIS zff_atsys._.iSignale._.obj.sig_m_t UMR_NM__1_1_0_S5_S3 6 -200 1300 DEPOSIT ABSOLUTE /end AXIS_DESCR
/end CHARACTERISTIC
/begin CHARACTERISTIC KF_THKABMTCGSPORT12 "Zeitoffset Ende Haltephase KAB fuer HS" MAP 0x1B7BC4 ZF_kf_ui8_S5_S3 2000 UMR_MSEC__10_1_M128_S5_S3 -1000 1000
 /begin AXIS_DESCR STD_AXIS zff_atsys._.iSignale._.obj.sig_m_t8 UMR_NM__6_1_M34_S5_S3 8 -204 1326 DEPOSIT ABSOLUTE /end AXIS_DESCR
 /begin AXIS_DESCR STD_AXIS zff_atsys._.iSignale._.obj.sig_c_getr UMR_GRADC__1_1_M40_S5_S3 8 -40 150 DEPOSIT ABSOLUTE /end AXIS_DESCR
/end CHARACTERISTIC
/begin CHARACTERISTIC KF_THKABMTCGSPORT23 "Zeitoffset Ende Haltephase KAB fuer HS" MAP 0x1B7CBC ZF_kf_ui8_S5_S3 2000 UMR_MSEC__10_1_M128_S5_S3 -1000 1000
 /begin AXIS_DESCR STD_AXIS zff_atsys._.iSignale._.obj.sig_m_t8 UMR_NM__6_1_M34_S5_S3 8 -204 1326 DEPOSIT ABSOLUTE /end AXIS_DESCR
 /begin AXIS_DESCR STD_AXIS zff_atsys._.iSignale._.obj.sig_c_getr UMR_GRADC__1_1_M40_S5_S3 8 -40 150 DEPOSIT ABSOLUTE /end AXIS_DESCR
/end CHARACTERISTIC
/begin CHARACTERISTIC KF_THKABMTCGSPORT34 "Zeitoffset Ende Haltephase KAB fuer HS" MAP 0x1B7DB4 ZF_kf_ui8_S5_S3 2000 UMR_MSEC__10_1_M128_S5_S3 -1000 1000
 /begin AXIS_DESCR STD_AXIS zff_atsys._.iSignale._.obj.sig_m_t8 UMR_NM__6_1_M34_S5_S3 8 -204 1326 DEPOSIT ABSOLUTE /end AXIS_DESCR
 /begin AXIS_DESCR STD_AXIS zff_atsys._.iSignale._.obj.sig_c_getr UMR_GRADC__1_1_M40_S5_S3 8 -40 150 DEPOSIT ABSOLUTE /end AXIS_DESCR
/end CHARACTERISTIC
/begin CHARACTERISTIC KF_THKABMTCGSPORT45 "Zeitoffset Ende Haltephase KAB fuer HS" MAP 0x1B7EAC ZF_kf_ui8_S5_S3 2000 UMR_MSEC__10_1_M128_S5_S3 -1000 1000
 /begin AXIS_DESCR STD_AXIS zff_atsys._.iSignale._.obj.sig_m_t8 UMR_NM__6_1_M34_S5_S3 8 -204 1326 DEPOSIT ABSOLUTE /end AXIS_DESCR
 /begin AXIS_DESCR STD_AXIS zff_atsys._.iSignale._.obj.sig_c_getr UMR_GRADC__1_1_M40_S5_S3 8 -40 150 DEPOSIT ABSOLUTE /end AXIS_DESCR
/end CHARACTERISTIC
/begin CHARACTERISTIC KF_THKABMTCGSPORT56 "Zeitoffset Ende Haltephase KAB fuer HS" MAP 0x1B7FA4 ZF_kf_ui8_S5_S3 2000 UMR_MSEC__10_1_M128_S5_S3 -1000 1000
 /begin AXIS_DESCR STD_AXIS zff_atsys._.iSignale._.obj.sig_m_t8 UMR_NM__6_1_M34_S5_S3 8 -204 1326 DEPOSIT ABSOLUTE /end AXIS_DESCR
 /begin AXIS_DESCR STD_AXIS zff_atsys._.iSignale._.obj.sig_c_getr UMR_GRADC__1_1_M40_S5_S3 8 -40 150 DEPOSIT ABSOLUTE /end AXIS_DESCR
/end CHARACTERISTIC
/begin CHARACTERISTIC KF_THKABMTCGSPORT67 "Zeitoffset Ende Haltephase KAB fuer HS" MAP 0x1B809C ZF_kf_ui8_S5_S3 2000 UMR_MSEC__10_1_M128_S5_S3 -1000 1000
 /begin AXIS_DESCR STD_AXIS zff_atsys._.iSignale._.obj.sig_m_t8 UMR_NM__6_1_M34_S5_S3 8 -204 1326 DEPOSIT ABSOLUTE /end AXIS_DESCR
 /begin AXIS_DESCR STD_AXIS zff_atsys._.iSignale._.obj.sig_c_getr UMR_GRADC__1_1_M40_S5_S3 8 -40 150 DEPOSIT ABSOLUTE /end AXIS_DESCR
/end CHARACTERISTIC
/begin CHARACTERISTIC KF_THKABMTCGSPORT78 "Zeitoffset Ende Haltephase KAB fuer HS" MAP 0x1B8194 ZF_kf_ui8_S5_S3 2000 UMR_MSEC__10_1_M128_S5_S3 -1000 1000
 /begin AXIS_DESCR STD_AXIS zff_atsys._.iSignale._.obj.sig_m_t8 UMR_NM__6_1_M34_S5_S3 8 -204 1326 DEPOSIT ABSOLUTE /end AXIS_DESCR
 /begin AXIS_DESCR STD_AXIS zff_atsys._.iSignale._.obj.sig_c_getr UMR_GRADC__1_1_M40_S5_S3 8 -40 150 DEPOSIT ABSOLUTE /end AXIS_DESCR
/end CHARACTERISTIC
/begin CHARACTERISTIC KF_TOHKABMTNT21 "Zeitoffset auf Ende SF fuer Haltephase" MAP 0x1B87D0 ZF_kf_ui8_S5_S3 2000 UMR_MSEC__10_1_M128_S5_S3 -1000 1000
 /begin AXIS_DESCR STD_AXIS zff_atsys._.iSignale._.obj.sig_n_t8 UMR_U_MIN_32_1_0_S5_S3 4 0 8160 DEPOSIT ABSOLUTE /end AXIS_DESCR
 /begin AXIS_DESCR STD_AXIS zff_atsys._.iSignale._.obj.sig_m_t8 UMR_NM__6_1_M34_S5_S3 6 -204 1326 DEPOSIT ABSOLUTE /end AXIS_DESCR
/end CHARACTERISTIC
/begin CHARACTERISTIC KF_TOHKABMTNT21_EL "Zeitoffset auf Ende SF fuer Haltephase" MAP 0x1B87FC ZF_kf_ui8_S5_S3 2000 UMR_MSEC__10_1_M128_S5_S3 -1000 1000
 /begin AXIS_DESCR STD_AXIS zff_atsys._.iSignale._.obj.sig_n_t8 UMR_U_MIN_32_1_0_S5_S3 4 0 8160 DEPOSIT ABSOLUTE /end AXIS_DESCR
 /begin AXIS_DESCR STD_AXIS zff_atsys._.iSignale._.obj.sig_m_t8 UMR_NM__6_1_M34_S5_S3 6 -204 1326 DEPOSIT ABSOLUTE /end AXIS_DESCR
/end CHARACTERISTIC
/begin CHARACTERISTIC KF_TOHKABMTNT32 "Zeitoffset auf Ende SF fuer Haltephase" MAP 0x1B8AAC ZF_kf_ui8_S5_S3 2000 UMR_MSEC__10_1_M128_S5_S3 -1000 1000
 /begin AXIS_DESCR STD_AXIS zff_atsys._.iSignale._.obj.sig_n_t8 UMR_U_MIN_32_1_0_S5_S3 4 0 8160 DEPOSIT ABSOLUTE /end AXIS_DESCR
 /begin AXIS_DESCR STD_AXIS zff_atsys._.iSignale._.obj.sig_m_t8 UMR_NM__6_1_M34_S5_S3 6 -204 1326 DEPOSIT ABSOLUTE /end AXIS_DESCR
/end CHARACTERISTIC
/begin CHARACTERISTIC KF_TOHKABMTNT32_EL "Zeitoffset auf Ende SF fuer Haltephase" MAP 0x1B8AD8 ZF_kf_ui8_S5_S3 2000 UMR_MSEC__10_1_M128_S5_S3 -1000 1000
 /begin AXIS_DESCR STD_AXIS zff_atsys._.iSignale._.obj.sig_n_t8 UMR_U_MIN_32_1_0_S5_S3 4 0 8160 DEPOSIT ABSOLUTE /end AXIS_DESCR
 /begin AXIS_DESCR STD_AXIS zff_atsys._.iSignale._.obj.sig_m_t8 UMR_NM__6_1_M34_S5_S3 6 -204 1326 DEPOSIT ABSOLUTE /end AXIS_DESCR
/end CHARACTERISTIC
/begin CHARACTERISTIC KF_TOHKABMTNT43 "Zeitoffset auf Ende SF fuer Haltephase" MAP 0x1B8D88 ZF_kf_ui8_S5_S3 2000 UMR_MSEC__10_1_M128_S5_S3 -1000 1000
 /begin AXIS_DESCR STD_AXIS zff_atsys._.iSignale._.obj.sig_n_t8 UMR_U_MIN_32_1_0_S5_S3 4 0 8160 DEPOSIT ABSOLUTE /end AXIS_DESCR
 /begin AXIS_DESCR STD_AXIS zff_atsys._.iSignale._.obj.sig_m_t8 UMR_NM__6_1_M34_S5_S3 6 -204 1326 DEPOSIT ABSOLUTE /end AXIS_DESCR
/end CHARACTERISTIC
/begin CHARACTERISTIC KF_TOHKABMTNT43_EL "Zeitoffset auf Ende SF fuer Haltephase" MAP 0x1B8DB4 ZF_kf_ui8_S5_S3 2000 UMR_MSEC__10_1_M128_S5_S3 -1000 1000
 /begin AXIS_DESCR STD_AXIS zff_atsys._.iSignale._.obj.sig_n_t8 UMR_U_MIN_32_1_0_S5_S3 4 0 8160 DEPOSIT ABSOLUTE /end AXIS_DESCR
 /begin AXIS_DESCR STD_AXIS zff_atsys._.iSignale._.obj.sig_m_t8 UMR_NM__6_1_M34_S5_S3 6 -204 1326 DEPOSIT ABSOLUTE /end AXIS_DESCR
/end CHARACTERISTIC
/begin CHARACTERISTIC KF_TOHKABMTNT54 "Zeitoffset auf Ende SF fuer Haltephase" MAP 0x1B9064 ZF_kf_ui8_S5_S3 2000 UMR_MSEC__10_1_M128_S5_S3 -1000 1000
 /begin AXIS_DESCR STD_AXIS zff_atsys._.iSignale._.obj.sig_n_t8 UMR_U_MIN_32_1_0_S5_S3 4 0 8160 DEPOSIT ABSOLUTE /end AXIS_DESCR
 /begin AXIS_DESCR STD_AXIS zff_atsys._.iSignale._.obj.sig_m_t8 UMR_NM__6_1_M34_S5_S3 6 -204 1326 DEPOSIT ABSOLUTE /end AXIS_DESCR
/end CHARACTERISTIC
/begin CHARACTERISTIC KF_TOHKABMTNT54_EL "Zeitoffset auf Ende SF fuer Haltephase" MAP 0x1B9090 ZF_kf_ui8_S5_S3 2000 UMR_MSEC__10_1_M128_S5_S3 -1000 1000
 /begin AXIS_DESCR STD_AXIS zff_atsys._.iSignale._.obj.sig_n_t8 UMR_U_MIN_32_1_0_S5_S3 4 0 8160 DEPOSIT ABSOLUTE /end AXIS_DESCR
 /begin AXIS_DESCR STD_AXIS zff_atsys._.iSignale._.obj.sig_m_t8 UMR_NM__6_1_M34_S5_S3 6 -204 1326 DEPOSIT ABSOLUTE /end AXIS_DESCR
/end CHARACTERISTIC
/begin CHARACTERISTIC KF_TOHKABMTNT65 "Zeitoffset auf Ende SF fuer Haltephase" MAP 0x1B9340 ZF_kf_ui8_S5_S3 2000 UMR_MSEC__10_1_M128_S5_S3 -1000 1000
 /begin AXIS_DESCR STD_AXIS zff_atsys._.iSignale._.obj.sig_n_t8 UMR_U_MIN_32_1_0_S5_S3 4 0 8160 DEPOSIT ABSOLUTE /end AXIS_DESCR
 /begin AXIS_DESCR STD_AXIS zff_atsys._.iSignale._.obj.sig_m_t8 UMR_NM__6_1_M34_S5_S3 6 -204 1326 DEPOSIT ABSOLUTE /end AXIS_DESCR
/end CHARACTERISTIC
/begin CHARACTERISTIC KF_TOHKABMTNT65_EL "Zeitoffset auf Ende SF fuer Haltephase" MAP 0x1B936C ZF_kf_ui8_S5_S3 2000 UMR_MSEC__10_1_M128_S5_S3 -1000 1000
 /begin AXIS_DESCR STD_AXIS zff_atsys._.iSignale._.obj.sig_n_t8 UMR_U_MIN_32_1_0_S5_S3 4 0 8160 DEPOSIT ABSOLUTE /end AXIS_DESCR
 /begin AXIS_DESCR STD_AXIS zff_atsys._.iSignale._.obj.sig_m_t8 UMR_NM__6_1_M34_S5_S3 6 -204 1326 DEPOSIT ABSOLUTE /end AXIS_DESCR
/end CHARACTERISTIC
/begin CHARACTERISTIC KF_TOHKABMTNT76 "Zeitoffset auf Ende SF fuer Haltephase" MAP 0x1B961C ZF_kf_ui8_S5_S3 2000 UMR_MSEC__10_1_M128_S5_S3 -1000 1000
 /begin AXIS_DESCR STD_AXIS zff_atsys._.iSignale._.obj.sig_n_t8 UMR_U_MIN_32_1_0_S5_S3 4 0 8160 DEPOSIT ABSOLUTE /end AXIS_DESCR
 /begin AXIS_DESCR STD_AXIS zff_atsys._.iSignale._.obj.sig_m_t8 UMR_NM__6_1_M34_S5_S3 6 -204 1326 DEPOSIT ABSOLUTE /end AXIS_DESCR
/end CHARACTERISTIC
/begin CHARACTERISTIC KF_TOHKABMTNT76_EL "Zeitoffset auf Ende SF fuer Haltephase" MAP 0x1B9648 ZF_kf_ui8_S5_S3 2000 UMR_MSEC__10_1_M128_S5_S3 -1000 1000
 /begin AXIS_DESCR STD_AXIS zff_atsys._.iSignale._.obj.sig_n_t8 UMR_U_MIN_32_1_0_S5_S3 4 0 8160 DEPOSIT ABSOLUTE /end AXIS_DESCR
 /begin AXIS_DESCR STD_AXIS zff_atsys._.iSignale._.obj.sig_m_t8 UMR_NM__6_1_M34_S5_S3 6 -204 1326 DEPOSIT ABSOLUTE /end AXIS_DESCR
/end CHARACTERISTIC
/begin CHARACTERISTIC KF_TOHKABMTNT87 "Zeitoffset auf Ende SF fuer Haltephase" MAP 0x1B98F8 ZF_kf_ui8_S5_S3 2000 UMR_MSEC__10_1_M128_S5_S3 -1000 1000
 /begin AXIS_DESCR STD_AXIS zff_atsys._.iSignale._.obj.sig_n_t8 UMR_U_MIN_32_1_0_S5_S3 4 0 8160 DEPOSIT ABSOLUTE /end AXIS_DESCR
 /begin AXIS_DESCR STD_AXIS zff_atsys._.iSignale._.obj.sig_m_t8 UMR_NM__6_1_M34_S5_S3 6 -204 1326 DEPOSIT ABSOLUTE /end AXIS_DESCR
/end CHARACTERISTIC
/begin CHARACTERISTIC KF_TOHKABMTNT87_EL "Zeitoffset auf Ende SF fuer Haltephase" MAP 0x1B9924 ZF_kf_ui8_S5_S3 2000 UMR_MSEC__10_1_M128_S5_S3 -1000 1000
 /begin AXIS_DESCR STD_AXIS zff_atsys._.iSignale._.obj.sig_n_t8 UMR_U_MIN_32_1_0_S5_S3 4 0 8160 DEPOSIT ABSOLUTE /end AXIS_DESCR
 /begin AXIS_DESCR STD_AXIS zff_atsys._.iSignale._.obj.sig_m_t8 UMR_NM__6_1_M34_S5_S3 6 -204 1326 DEPOSIT ABSOLUTE /end AXIS_DESCR
/end CHARACTERISTIC
/begin CHARACTERISTIC KF_TOHKABMTNTSP21 "Zeitoffset auf Ende SF fuer Haltephase" MAP 0x1B9BB4 ZF_kf_ui8_S5_S3 2000 UMR_MSEC__10_1_M128_S5_S3 -1000 1000
 /begin AXIS_DESCR STD_AXIS zff_atsys._.iSignale._.obj.sig_n_t8 UMR_U_MIN_32_1_0_S5_S3 4 0 8160 DEPOSIT ABSOLUTE /end AXIS_DESCR
 /begin AXIS_DESCR STD_AXIS zff_atsys._.iSignale._.obj.sig_m_t8 UMR_NM__6_1_M34_S5_S3 6 -204 1326 DEPOSIT ABSOLUTE /end AXIS_DESCR
/end CHARACTERISTIC
/begin CHARACTERISTIC KF_TOHKABMTNTSP31 "Zeitoffset auf Ende SF fuer Haltephase" MAP 0x1BA7BC ZF_kf_ui8_S5_S3 2000 UMR_MSEC__10_1_M128_S5_S3 -1000 1000
 /begin AXIS_DESCR STD_AXIS zff_atsys._.iSignale._.obj.sig_n_t8 UMR_U_MIN_32_1_0_S5_S3 4 0 8160 DEPOSIT ABSOLUTE /end AXIS_DESCR
 /begin AXIS_DESCR STD_AXIS zff_atsys._.iSignale._.obj.sig_m_t8 UMR_NM__6_1_M34_S5_S3 6 -204 1326 DEPOSIT ABSOLUTE /end AXIS_DESCR
/end CHARACTERISTIC
/begin CHARACTERISTIC KF_TOHKABMTNTSP32 "Zeitoffset auf Ende SF fuer Haltephase" MAP 0x1B9D6C ZF_kf_ui8_S5_S3 2000 UMR_MSEC__10_1_M128_S5_S3 -1000 1000
 /begin AXIS_DESCR STD_AXIS zff_atsys._.iSignale._.obj.sig_n_t8 UMR_U_MIN_32_1_0_S5_S3 4 0 8160 DEPOSIT ABSOLUTE /end AXIS_DESCR
 /begin AXIS_DESCR STD_AXIS zff_atsys._.iSignale._.obj.sig_m_t8 UMR_NM__6_1_M34_S5_S3 6 -204 1326 DEPOSIT ABSOLUTE /end AXIS_DESCR
/end CHARACTERISTIC
/begin CHARACTERISTIC KF_TOHKABMTNTSP42 "Zeitoffset auf Ende SF fuer Haltephase" MAP 0x1BA974 ZF_kf_ui8_S5_S3 2000 UMR_MSEC__10_1_M128_S5_S3 -1000 1000
 /begin AXIS_DESCR STD_AXIS zff_atsys._.iSignale._.obj.sig_n_t8 UMR_U_MIN_32_1_0_S5_S3 4 0 8160 DEPOSIT ABSOLUTE /end AXIS_DESCR
 /begin AXIS_DESCR STD_AXIS zff_atsys._.iSignale._.obj.sig_m_t8 UMR_NM__6_1_M34_S5_S3 6 -204 1326 DEPOSIT ABSOLUTE /end AXIS_DESCR
/end CHARACTERISTIC
/begin CHARACTERISTIC KF_TOHKABMTNTSP43 "Zeitoffset auf Ende SF fuer Haltephase" MAP 0x1B9F24 ZF_kf_ui8_S5_S3 2000 UMR_MSEC__10_1_M128_S5_S3 -1000 1000
 /begin AXIS_DESCR STD_AXIS zff_atsys._.iSignale._.obj.sig_n_t8 UMR_U_MIN_32_1_0_S5_S3 4 0 8160 DEPOSIT ABSOLUTE /end AXIS_DESCR
 /begin AXIS_DESCR STD_AXIS zff_atsys._.iSignale._.obj.sig_m_t8 UMR_NM__6_1_M34_S5_S3 6 -204 1326 DEPOSIT ABSOLUTE /end AXIS_DESCR
/end CHARACTERISTIC
/begin CHARACTERISTIC KF_TOHKABMTNTSP51 "Zeitoffset auf Ende SF fuer Haltephase" MAP 0x1BAB2C ZF_kf_ui8_S5_S3 2000 UMR_MSEC__10_1_M128_S5_S3 -1000 1000
 /begin AXIS_DESCR STD_AXIS zff_atsys._.iSignale._.obj.sig_n_t8 UMR_U_MIN_32_1_0_S5_S3 4 0 8160 DEPOSIT ABSOLUTE /end AXIS_DESCR
 /begin AXIS_DESCR STD_AXIS zff_atsys._.iSignale._.obj.sig_m_t8 UMR_NM__6_1_M34_S5_S3 6 -204 1326 DEPOSIT ABSOLUTE /end AXIS_DESCR
/end CHARACTERISTIC
/begin CHARACTERISTIC KF_TOHKABMTNTSP53 "Zeitoffset auf Ende SF fuer Haltephase" MAP 0x1BACE4 ZF_kf_ui8_S5_S3 2000 UMR_MSEC__10_1_M128_S5_S3 -1000 1000
 /begin AXIS_DESCR STD_AXIS zff_atsys._.iSignale._.obj.sig_n_t8 UMR_U_MIN_32_1_0_S5_S3 4 0 8160 DEPOSIT ABSOLUTE /end AXIS_DESCR
 /begin AXIS_DESCR STD_AXIS zff_atsys._.iSignale._.obj.sig_m_t8 UMR_NM__6_1_M34_S5_S3 6 -204 1326 DEPOSIT ABSOLUTE /end AXIS_DESCR
/end CHARACTERISTIC
/begin CHARACTERISTIC KF_TOHKABMTNTSP54 "Zeitoffset auf Ende SF fuer Haltephase" MAP 0x1BA0DC ZF_kf_ui8_S5_S3 2000 UMR_MSEC__10_1_M128_S5_S3 -1000 1000
 /begin AXIS_DESCR STD_AXIS zff_atsys._.iSignale._.obj.sig_n_t8 UMR_U_MIN_32_1_0_S5_S3 4 0 8160 DEPOSIT ABSOLUTE /end AXIS_DESCR
 /begin AXIS_DESCR STD_AXIS zff_atsys._.iSignale._.obj.sig_m_t8 UMR_NM__6_1_M34_S5_S3 6 -204 1326 DEPOSIT ABSOLUTE /end AXIS_DESCR
/end CHARACTERISTIC
/begin CHARACTERISTIC KF_TOHKABMTNTSP63 "Zeitoffset auf Ende SF fuer Haltephase" MAP 0x1BAE9C ZF_kf_ui8_S5_S3 2000 UMR_MSEC__10_1_M128_S5_S3 -1000 1000
 /begin AXIS_DESCR STD_AXIS zff_atsys._.iSignale._.obj.sig_n_t8 UMR_U_MIN_32_1_0_S5_S3 4 0 8160 DEPOSIT ABSOLUTE /end AXIS_DESCR
 /begin AXIS_DESCR STD_AXIS zff_atsys._.iSignale._.obj.sig_m_t8 UMR_NM__6_1_M34_S5_S3 6 -204 1326 DEPOSIT ABSOLUTE /end AXIS_DESCR
/end CHARACTERISTIC
/begin CHARACTERISTIC KF_TOHKABMTNTSP64 "Zeitoffset auf Ende SF fuer Haltephase" MAP 0x1BB054 ZF_kf_ui8_S5_S3 2000 UMR_MSEC__10_1_M128_S5_S3 -1000 1000
 /begin AXIS_DESCR STD_AXIS zff_atsys._.iSignale._.obj.sig_n_t8 UMR_U_MIN_32_1_0_S5_S3 4 0 8160 DEPOSIT ABSOLUTE /end AXIS_DESCR
 /begin AXIS_DESCR STD_AXIS zff_atsys._.iSignale._.obj.sig_m_t8 UMR_NM__6_1_M34_S5_S3 6 -204 1326 DEPOSIT ABSOLUTE /end AXIS_DESCR
/end CHARACTERISTIC
/begin CHARACTERISTIC KF_TOHKABMTNTSP65 "Zeitoffset auf Ende SF fuer Haltephase" MAP 0x1BA294 ZF_kf_ui8_S5_S3 2000 UMR_MSEC__10_1_M128_S5_S3 -1000 1000
 /begin AXIS_DESCR STD_AXIS zff_atsys._.iSignale._.obj.sig_n_t8 UMR_U_MIN_32_1_0_S5_S3 4 0 8160 DEPOSIT ABSOLUTE /end AXIS_DESCR
 /begin AXIS_DESCR STD_AXIS zff_atsys._.iSignale._.obj.sig_m_t8 UMR_NM__6_1_M34_S5_S3 6 -204 1326 DEPOSIT ABSOLUTE /end AXIS_DESCR
/end CHARACTERISTIC
/begin CHARACTERISTIC KF_TOHKABMTNTSP71 "Zeitoffset auf Ende SF fuer Haltephase" MAP 0x1BB20C ZF_kf_ui8_S5_S3 2000 UMR_MSEC__10_1_M128_S5_S3 -1000 1000
 /begin AXIS_DESCR STD_AXIS zff_atsys._.iSignale._.obj.sig_n_t8 UMR_U_MIN_32_1_0_S5_S3 4 0 8160 DEPOSIT ABSOLUTE /end AXIS_DESCR
 /begin AXIS_DESCR STD_AXIS zff_atsys._.iSignale._.obj.sig_m_t8 UMR_NM__6_1_M34_S5_S3 6 -204 1326 DEPOSIT ABSOLUTE /end AXIS_DESCR
/end CHARACTERISTIC
/begin CHARACTERISTIC KF_TOHKABMTNTSP75 "Zeitoffset auf Ende SF fuer Haltephase" MAP 0x1BB3C4 ZF_kf_ui8_S5_S3 2000 UMR_MSEC__10_1_M128_S5_S3 -1000 1000
 /begin AXIS_DESCR STD_AXIS zff_atsys._.iSignale._.obj.sig_n_t8 UMR_U_MIN_32_1_0_S5_S3 4 0 8160 DEPOSIT ABSOLUTE /end AXIS_DESCR
 /begin AXIS_DESCR STD_AXIS zff_atsys._.iSignale._.obj.sig_m_t8 UMR_NM__6_1_M34_S5_S3 6 -204 1326 DEPOSIT ABSOLUTE /end AXIS_DESCR
/end CHARACTERISTIC
/begin CHARACTERISTIC KF_TOHKABMTNTSP76 "Zeitoffset auf Ende SF fuer Haltephase" MAP 0x1BA44C ZF_kf_ui8_S5_S3 2000 UMR_MSEC__10_1_M128_S5_S3 -1000 1000
 /begin AXIS_DESCR STD_AXIS zff_atsys._.iSignale._.obj.sig_n_t8 UMR_U_MIN_32_1_0_S5_S3 4 0 8160 DEPOSIT ABSOLUTE /end AXIS_DESCR
 /begin AXIS_DESCR STD_AXIS zff_atsys._.iSignale._.obj.sig_m_t8 UMR_NM__6_1_M34_S5_S3 6 -204 1326 DEPOSIT ABSOLUTE /end AXIS_DESCR
/end CHARACTERISTIC
/begin CHARACTERISTIC KF_TOHKABMTNTSP82 "Zeitoffset auf Ende SF fuer Haltephase" MAP 0x1BB57C ZF_kf_ui8_S5_S3 2000 UMR_MSEC__10_1_M128_S5_S3 -1000 1000
 /begin AXIS_DESCR STD_AXIS zff_atsys._.iSignale._.obj.sig_n_t8 UMR_U_MIN_32_1_0_S5_S3 4 0 8160 DEPOSIT ABSOLUTE /end AXIS_DESCR
 /begin AXIS_DESCR STD_AXIS zff_atsys._.iSignale._.obj.sig_m_t8 UMR_NM__6_1_M34_S5_S3 6 -204 1326 DEPOSIT ABSOLUTE /end AXIS_DESCR
/end CHARACTERISTIC
/begin CHARACTERISTIC KF_TOHKABMTNTSP84 "Zeitoffset auf Ende SF fuer Haltephase" MAP 0x1BB734 ZF_kf_ui8_S5_S3 2000 UMR_MSEC__10_1_M128_S5_S3 -1000 1000
 /begin AXIS_DESCR STD_AXIS zff_atsys._.iSignale._.obj.sig_n_t8 UMR_U_MIN_32_1_0_S5_S3 4 0 8160 DEPOSIT ABSOLUTE /end AXIS_DESCR
 /begin AXIS_DESCR STD_AXIS zff_atsys._.iSignale._.obj.sig_m_t8 UMR_NM__6_1_M34_S5_S3 6 -204 1326 DEPOSIT ABSOLUTE /end AXIS_DESCR
/end CHARACTERISTIC
/begin CHARACTERISTIC KF_TOHKABMTNTSP86 "Zeitoffset auf Ende SF fuer Haltephase" MAP 0x1BB8EC ZF_kf_ui8_S5_S3 2000 UMR_MSEC__10_1_M128_S5_S3 -1000 1000
 /begin AXIS_DESCR STD_AXIS zff_atsys._.iSignale._.obj.sig_n_t8 UMR_U_MIN_32_1_0_S5_S3 4 0 8160 DEPOSIT ABSOLUTE /end AXIS_DESCR
 /begin AXIS_DESCR STD_AXIS zff_atsys._.iSignale._.obj.sig_m_t8 UMR_NM__6_1_M34_S5_S3 6 -204 1326 DEPOSIT ABSOLUTE /end AXIS_DESCR
/end CHARACTERISTIC
/begin CHARACTERISTIC KF_TOHKABMTNTSP87 "Zeitoffset auf Ende SF fuer Haltephase" MAP 0x1BA604 ZF_kf_ui8_S5_S3 2000 UMR_MSEC__10_1_M128_S5_S3 -1000 1000
 /begin AXIS_DESCR STD_AXIS zff_atsys._.iSignale._.obj.sig_n_t8 UMR_U_MIN_32_1_0_S5_S3 4 0 8160 DEPOSIT ABSOLUTE /end AXIS_DESCR
 /begin AXIS_DESCR STD_AXIS zff_atsys._.iSignale._.obj.sig_m_t8 UMR_NM__6_1_M34_S5_S3 6 -204 1326 DEPOSIT ABSOLUTE /end AXIS_DESCR
/end CHARACTERISTIC
/begin CHARACTERISTIC KF_TOHKABMTNTSPORT21 "Zeitoffset auf Ende SF fuer Haltephase" MAP 0x1BBAA4 ZF_kf_ui8_S5_S3 2000 UMR_MSEC__10_1_M128_S5_S3 -1000 1000
 /begin AXIS_DESCR STD_AXIS zff_atsys._.iSignale._.obj.sig_n_t8 UMR_U_MIN_32_1_0_S5_S3 4 0 8160 DEPOSIT ABSOLUTE /end AXIS_DESCR
 /begin AXIS_DESCR STD_AXIS zff_atsys._.iSignale._.obj.sig_m_t8 UMR_NM__6_1_M34_S5_S3 6 -204 1326 DEPOSIT ABSOLUTE /end AXIS_DESCR
/end CHARACTERISTIC
/begin CHARACTERISTIC KF_TOHKABMTNTSPORT31 "Zeitoffset auf Ende SF fuer Haltephase" MAP 0x1BC6AC ZF_kf_ui8_S5_S3 2000 UMR_MSEC__10_1_M128_S5_S3 -1000 1000
 /begin AXIS_DESCR STD_AXIS zff_atsys._.iSignale._.obj.sig_n_t8 UMR_U_MIN_32_1_0_S5_S3 4 0 8160 DEPOSIT ABSOLUTE /end AXIS_DESCR
 /begin AXIS_DESCR STD_AXIS zff_atsys._.iSignale._.obj.sig_m_t8 UMR_NM__6_1_M34_S5_S3 6 -204 1326 DEPOSIT ABSOLUTE /end AXIS_DESCR
/end CHARACTERISTIC
/begin CHARACTERISTIC KF_TOHKABMTNTSPORT32 "Zeitoffset auf Ende SF fuer Haltephase" MAP 0x1BBC5C ZF_kf_ui8_S5_S3 2000 UMR_MSEC__10_1_M128_S5_S3 -1000 1000
 /begin AXIS_DESCR STD_AXIS zff_atsys._.iSignale._.obj.sig_n_t8 UMR_U_MIN_32_1_0_S5_S3 4 0 8160 DEPOSIT ABSOLUTE /end AXIS_DESCR
 /begin AXIS_DESCR STD_AXIS zff_atsys._.iSignale._.obj.sig_m_t8 UMR_NM__6_1_M34_S5_S3 6 -204 1326 DEPOSIT ABSOLUTE /end AXIS_DESCR
/end CHARACTERISTIC
/begin CHARACTERISTIC KF_TOHKABMTNTSPORT42 "Zeitoffset auf Ende SF fuer Haltephase" MAP 0x1BC864 ZF_kf_ui8_S5_S3 2000 UMR_MSEC__10_1_M128_S5_S3 -1000 1000
 /begin AXIS_DESCR STD_AXIS zff_atsys._.iSignale._.obj.sig_n_t8 UMR_U_MIN_32_1_0_S5_S3 4 0 8160 DEPOSIT ABSOLUTE /end AXIS_DESCR
 /begin AXIS_DESCR STD_AXIS zff_atsys._.iSignale._.obj.sig_m_t8 UMR_NM__6_1_M34_S5_S3 6 -204 1326 DEPOSIT ABSOLUTE /end AXIS_DESCR
/end CHARACTERISTIC
/begin CHARACTERISTIC KF_TOHKABMTNTSPORT43 "Zeitoffset auf Ende SF fuer Haltephase" MAP 0x1BBE14 ZF_kf_ui8_S5_S3 2000 UMR_MSEC__10_1_M128_S5_S3 -1000 1000
 /begin AXIS_DESCR STD_AXIS zff_atsys._.iSignale._.obj.sig_n_t8 UMR_U_MIN_32_1_0_S5_S3 4 0 8160 DEPOSIT ABSOLUTE /end AXIS_DESCR
 /begin AXIS_DESCR STD_AXIS zff_atsys._.iSignale._.obj.sig_m_t8 UMR_NM__6_1_M34_S5_S3 6 -204 1326 DEPOSIT ABSOLUTE /end AXIS_DESCR
/end CHARACTERISTIC
/begin CHARACTERISTIC KF_TOHKABMTNTSPORT51 "Zeitoffset auf Ende SF fuer Haltephase" MAP 0x1BCA1C ZF_kf_ui8_S5_S3 2000 UMR_MSEC__10_1_M128_S5_S3 -1000 1000
 /begin AXIS_DESCR STD_AXIS zff_atsys._.iSignale._.obj.sig_n_t8 UMR_U_MIN_32_1_0_S5_S3 4 0 8160 DEPOSIT ABSOLUTE /end AXIS_DESCR
 /begin AXIS_DESCR STD_AXIS zff_atsys._.iSignale._.obj.sig_m_t8 UMR_NM__6_1_M34_S5_S3 6 -204 1326 DEPOSIT ABSOLUTE /end AXIS_DESCR
/end CHARACTERISTIC
/begin CHARACTERISTIC KF_TOHKABMTNTSPORT53 "Zeitoffset auf Ende SF fuer Haltephase" MAP 0x1BCBD4 ZF_kf_ui8_S5_S3 2000 UMR_MSEC__10_1_M128_S5_S3 -1000 1000
 /begin AXIS_DESCR STD_AXIS zff_atsys._.iSignale._.obj.sig_n_t8 UMR_U_MIN_32_1_0_S5_S3 4 0 8160 DEPOSIT ABSOLUTE /end AXIS_DESCR
 /begin AXIS_DESCR STD_AXIS zff_atsys._.iSignale._.obj.sig_m_t8 UMR_NM__6_1_M34_S5_S3 6 -204 1326 DEPOSIT ABSOLUTE /end AXIS_DESCR
/end CHARACTERISTIC
/begin CHARACTERISTIC KF_TOHKABMTNTSPORT54 "Zeitoffset auf Ende SF fuer Haltephase" MAP 0x1BBFCC ZF_kf_ui8_S5_S3 2000 UMR_MSEC__10_1_M128_S5_S3 -1000 1000
 /begin AXIS_DESCR STD_AXIS zff_atsys._.iSignale._.obj.sig_n_t8 UMR_U_MIN_32_1_0_S5_S3 4 0 8160 DEPOSIT ABSOLUTE /end AXIS_DESCR
 /begin AXIS_DESCR STD_AXIS zff_atsys._.iSignale._.obj.sig_m_t8 UMR_NM__6_1_M34_S5_S3 6 -204 1326 DEPOSIT ABSOLUTE /end AXIS_DESCR
/end CHARACTERISTIC
/begin CHARACTERISTIC KF_TOHKABMTNTSPORT63 "Zeitoffset auf Ende SF fuer Haltephase" MAP 0x1BCD8C ZF_kf_ui8_S5_S3 2000 UMR_MSEC__10_1_M128_S5_S3 -1000 1000
 /begin AXIS_DESCR STD_AXIS zff_atsys._.iSignale._.obj.sig_n_t8 UMR_U_MIN_32_1_0_S5_S3 4 0 8160 DEPOSIT ABSOLUTE /end AXIS_DESCR
 /begin AXIS_DESCR STD_AXIS zff_atsys._.iSignale._.obj.sig_m_t8 UMR_NM__6_1_M34_S5_S3 6 -204 1326 DEPOSIT ABSOLUTE /end AXIS_DESCR
/end CHARACTERISTIC
/begin CHARACTERISTIC KF_TOHKABMTNTSPORT64 "Zeitoffset auf Ende SF fuer Haltephase" MAP 0x1BCF44 ZF_kf_ui8_S5_S3 2000 UMR_MSEC__10_1_M128_S5_S3 -1000 1000
 /begin AXIS_DESCR STD_AXIS zff_atsys._.iSignale._.obj.sig_n_t8 UMR_U_MIN_32_1_0_S5_S3 4 0 8160 DEPOSIT ABSOLUTE /end AXIS_DESCR
 /begin AXIS_DESCR STD_AXIS zff_atsys._.iSignale._.obj.sig_m_t8 UMR_NM__6_1_M34_S5_S3 6 -204 1326 DEPOSIT ABSOLUTE /end AXIS_DESCR
/end CHARACTERISTIC
/begin CHARACTERISTIC KF_TOHKABMTNTSPORT65 "Zeitoffset auf Ende SF fuer Haltephase" MAP 0x1BC184 ZF_kf_ui8_S5_S3 2000 UMR_MSEC__10_1_M128_S5_S3 -1000 1000
 /begin AXIS_DESCR STD_AXIS zff_atsys._.iSignale._.obj.sig_n_t8 UMR_U_MIN_32_1_0_S5_S3 4 0 8160 DEPOSIT ABSOLUTE /end AXIS_DESCR
 /begin AXIS_DESCR STD_AXIS zff_atsys._.iSignale._.obj.sig_m_t8 UMR_NM__6_1_M34_S5_S3 6 -204 1326 DEPOSIT ABSOLUTE /end AXIS_DESCR
/end CHARACTERISTIC
/begin CHARACTERISTIC KF_TOHKABMTNTSPORT71 "Zeitoffset auf Ende SF fuer Haltephase" MAP 0x1BD0FC ZF_kf_ui8_S5_S3 2000 UMR_MSEC__10_1_M128_S5_S3 -1000 1000
 /begin AXIS_DESCR STD_AXIS zff_atsys._.iSignale._.obj.sig_n_t8 UMR_U_MIN_32_1_0_S5_S3 4 0 8160 DEPOSIT ABSOLUTE /end AXIS_DESCR
 /begin AXIS_DESCR STD_AXIS zff_atsys._.iSignale._.obj.sig_m_t8 UMR_NM__6_1_M34_S5_S3 6 -204 1326 DEPOSIT ABSOLUTE /end AXIS_DESCR
/end CHARACTERISTIC
/begin CHARACTERISTIC KF_TOHKABMTNTSPORT75 "Zeitoffset auf Ende SF fuer Haltephase" MAP 0x1BD2B4 ZF_kf_ui8_S5_S3 2000 UMR_MSEC__10_1_M128_S5_S3 -1000 1000
 /begin AXIS_DESCR STD_AXIS zff_atsys._.iSignale._.obj.sig_n_t8 UMR_U_MIN_32_1_0_S5_S3 4 0 8160 DEPOSIT ABSOLUTE /end AXIS_DESCR
 /begin AXIS_DESCR STD_AXIS zff_atsys._.iSignale._.obj.sig_m_t8 UMR_NM__6_1_M34_S5_S3 6 -204 1326 DEPOSIT ABSOLUTE /end AXIS_DESCR
/end CHARACTERISTIC
/begin CHARACTERISTIC KF_TOHKABMTNTSPORT76 "Zeitoffset auf Ende SF fuer Haltephase" MAP 0x1BC33C ZF_kf_ui8_S5_S3 2000 UMR_MSEC__10_1_M128_S5_S3 -1000 1000
 /begin AXIS_DESCR STD_AXIS zff_atsys._.iSignale._.obj.sig_n_t8 UMR_U_MIN_32_1_0_S5_S3 4 0 8160 DEPOSIT ABSOLUTE /end AXIS_DESCR
 /begin AXIS_DESCR STD_AXIS zff_atsys._.iSignale._.obj.sig_m_t8 UMR_NM__6_1_M34_S5_S3 6 -204 1326 DEPOSIT ABSOLUTE /end AXIS_DESCR
/end CHARACTERISTIC
/begin CHARACTERISTIC KF_TOHKABMTNTSPORT82 "Zeitoffset auf Ende SF fuer Haltephase" MAP 0x1BD46C ZF_kf_ui8_S5_S3 2000 UMR_MSEC__10_1_M128_S5_S3 -1000 1000
 /begin AXIS_DESCR STD_AXIS zff_atsys._.iSignale._.obj.sig_n_t8 UMR_U_MIN_32_1_0_S5_S3 4 0 8160 DEPOSIT ABSOLUTE /end AXIS_DESCR
 /begin AXIS_DESCR STD_AXIS zff_atsys._.iSignale._.obj.sig_m_t8 UMR_NM__6_1_M34_S5_S3 6 -204 1326 DEPOSIT ABSOLUTE /end AXIS_DESCR
/end CHARACTERISTIC
/begin CHARACTERISTIC KF_TPKABMTCGSPORT12 "Zeitoffset Ende Rampe auf Schaltdruck KAB fuer HS" MAP 0x1B7B34 ZF_kf_ui8_S5_S3 2000 UMR_MSEC__10_1_M128_S5_S3 -1000 1000
 /begin AXIS_DESCR STD_AXIS zff_atsys._.iSignale._.obj.sig_m_t8 UMR_NM__6_1_M34_S5_S3 8 -204 1326 DEPOSIT ABSOLUTE /end AXIS_DESCR
 /begin AXIS_DESCR STD_AXIS zff_atsys._.iSignale._.obj.sig_c_getr UMR_GRADC__1_1_M40_S5_S3 8 -40 150 DEPOSIT ABSOLUTE /end AXIS_DESCR
/end CHARACTERISTIC
/begin CHARACTERISTIC KF_TPKABMTCGSPORT23 "Zeitoffset Ende Rampe auf Schaltdruck KAB fuer HS" MAP 0x1B7C2C ZF_kf_ui8_S5_S3 2000 UMR_MSEC__10_1_M128_S5_S3 -1000 1000
 /begin AXIS_DESCR STD_AXIS zff_atsys._.iSignale._.obj.sig_m_t8 UMR_NM__6_1_M34_S5_S3 8 -204 1326 DEPOSIT ABSOLUTE /end AXIS_DESCR
 /begin AXIS_DESCR STD_AXIS zff_atsys._.iSignale._.obj.sig_c_getr UMR_GRADC__1_1_M40_S5_S3 8 -40 150 DEPOSIT ABSOLUTE /end AXIS_DESCR
/end CHARACTERISTIC
/begin CHARACTERISTIC KF_TPKABMTCGSPORT34 "Zeitoffset Ende Rampe auf Schaltdruck KAB fuer HS" MAP 0x1B7D24 ZF_kf_ui8_S5_S3 2000 UMR_MSEC__10_1_M128_S5_S3 -1000 1000
 /begin AXIS_DESCR STD_AXIS zff_atsys._.iSignale._.obj.sig_m_t8 UMR_NM__6_1_M34_S5_S3 8 -204 1326 DEPOSIT ABSOLUTE /end AXIS_DESCR
 /begin AXIS_DESCR STD_AXIS zff_atsys._.iSignale._.obj.sig_c_getr UMR_GRADC__1_1_M40_S5_S3 8 -40 150 DEPOSIT ABSOLUTE /end AXIS_DESCR
/end CHARACTERISTIC
/begin CHARACTERISTIC KF_TPKABMTCGSPORT45 "Zeitoffset Ende Rampe auf Schaltdruck KAB fuer HS" MAP 0x1B7E1C ZF_kf_ui8_S5_S3 2000 UMR_MSEC__10_1_M128_S5_S3 -1000 1000
 /begin AXIS_DESCR STD_AXIS zff_atsys._.iSignale._.obj.sig_m_t8 UMR_NM__6_1_M34_S5_S3 8 -204 1326 DEPOSIT ABSOLUTE /end AXIS_DESCR
 /begin AXIS_DESCR STD_AXIS zff_atsys._.iSignale._.obj.sig_c_getr UMR_GRADC__1_1_M40_S5_S3 8 -40 150 DEPOSIT ABSOLUTE /end AXIS_DESCR
/end CHARACTERISTIC
/begin CHARACTERISTIC KF_TPKABMTCGSPORT56 "Zeitoffset Ende Rampe auf Schaltdruck KAB fuer HS" MAP 0x1B7F14 ZF_kf_ui8_S5_S3 2000 UMR_MSEC__10_1_M128_S5_S3 -1000 1000
 /begin AXIS_DESCR STD_AXIS zff_atsys._.iSignale._.obj.sig_m_t8 UMR_NM__6_1_M34_S5_S3 8 -204 1326 DEPOSIT ABSOLUTE /end AXIS_DESCR
 /begin AXIS_DESCR STD_AXIS zff_atsys._.iSignale._.obj.sig_c_getr UMR_GRADC__1_1_M40_S5_S3 8 -40 150 DEPOSIT ABSOLUTE /end AXIS_DESCR
/end CHARACTERISTIC
/begin CHARACTERISTIC KF_TPKABMTCGSPORT67 "Zeitoffset Ende Rampe auf Schaltdruck KAB fuer HS" MAP 0x1B800C ZF_kf_ui8_S5_S3 2000 UMR_MSEC__10_1_M128_S5_S3 -1000 1000
 /begin AXIS_DESCR STD_AXIS zff_atsys._.iSignale._.obj.sig_m_t8 UMR_NM__6_1_M34_S5_S3 8 -204 1326 DEPOSIT ABSOLUTE /end AXIS_DESCR
 /begin AXIS_DESCR STD_AXIS zff_atsys._.iSignale._.obj.sig_c_getr UMR_GRADC__1_1_M40_S5_S3 8 -40 150 DEPOSIT ABSOLUTE /end AXIS_DESCR
/end CHARACTERISTIC
/begin CHARACTERISTIC KF_TPKABMTCGSPORT78 "Zeitoffset Ende Rampe auf Schaltdruck KAB fuer HS" MAP 0x1B8104 ZF_kf_ui8_S5_S3 2000 UMR_MSEC__10_1_M128_S5_S3 -1000 1000
 /begin AXIS_DESCR STD_AXIS zff_atsys._.iSignale._.obj.sig_m_t8 UMR_NM__6_1_M34_S5_S3 8 -204 1326 DEPOSIT ABSOLUTE /end AXIS_DESCR
 /begin AXIS_DESCR STD_AXIS zff_atsys._.iSignale._.obj.sig_c_getr UMR_GRADC__1_1_M40_S5_S3 8 -40 150 DEPOSIT ABSOLUTE /end AXIS_DESCR
/end CHARACTERISTIC
/begin CHARACTERISTIC KF_TVKABMTNMOTRS21 "Verzögerungszeit abschaltende Kupplung bei RS" MAP 0x1B8840 ZF_kf_ui8_S5_S3 2000 UMR_MSEC__10_1_0_S5_S3 0 2000
 /begin AXIS_DESCR STD_AXIS zff_atsys._.iSignale._.obj.sig_m_t8 UMR_NM__6_1_M34_S5_S3 4 -204 1326 DEPOSIT ABSOLUTE /end AXIS_DESCR
 /begin AXIS_DESCR STD_AXIS zff_atsys._.iSignale._.obj.sig_n_mot8 UMR_U_MIN_32_1_0_S5_S3 4 0 8160 DEPOSIT ABSOLUTE /end AXIS_DESCR
/end CHARACTERISTIC
/begin CHARACTERISTIC KF_TVKABMTNMOTRS32 "Verzögerungszeit abschaltende Kupplung bei RS" MAP 0x1B8B1C ZF_kf_ui8_S5_S3 2000 UMR_MSEC__10_1_0_S5_S3 0 2000
 /begin AXIS_DESCR STD_AXIS zff_atsys._.iSignale._.obj.sig_m_t8 UMR_NM__6_1_M34_S5_S3 4 -204 1326 DEPOSIT ABSOLUTE /end AXIS_DESCR
 /begin AXIS_DESCR STD_AXIS zff_atsys._.iSignale._.obj.sig_n_mot8 UMR_U_MIN_32_1_0_S5_S3 4 0 8160 DEPOSIT ABSOLUTE /end AXIS_DESCR
/end CHARACTERISTIC
/begin CHARACTERISTIC KF_TVKABMTNMOTRS43 "Verzögerungszeit abschaltende Kupplung bei RS" MAP 0x1B8DF8 ZF_kf_ui8_S5_S3 2000 UMR_MSEC__10_1_0_S5_S3 0 2000
 /begin AXIS_DESCR STD_AXIS zff_atsys._.iSignale._.obj.sig_m_t8 UMR_NM__6_1_M34_S5_S3 4 -204 1326 DEPOSIT ABSOLUTE /end AXIS_DESCR
 /begin AXIS_DESCR STD_AXIS zff_atsys._.iSignale._.obj.sig_n_mot8 UMR_U_MIN_32_1_0_S5_S3 4 0 8160 DEPOSIT ABSOLUTE /end AXIS_DESCR
/end CHARACTERISTIC
/begin CHARACTERISTIC KF_TVKABMTNMOTRS54 "Verzögerungszeit abschaltende Kupplung bei RS" MAP 0x1B90D4 ZF_kf_ui8_S5_S3 2000 UMR_MSEC__10_1_0_S5_S3 0 2000
 /begin AXIS_DESCR STD_AXIS zff_atsys._.iSignale._.obj.sig_m_t8 UMR_NM__6_1_M34_S5_S3 4 -204 1326 DEPOSIT ABSOLUTE /end AXIS_DESCR
 /begin AXIS_DESCR STD_AXIS zff_atsys._.iSignale._.obj.sig_n_mot8 UMR_U_MIN_32_1_0_S5_S3 4 0 8160 DEPOSIT ABSOLUTE /end AXIS_DESCR
/end CHARACTERISTIC
/begin CHARACTERISTIC KF_TVKABMTNMOTRS65 "Verzögerungszeit abschaltende Kupplung bei RS" MAP 0x1B93B0 ZF_kf_ui8_S5_S3 2000 UMR_MSEC__10_1_0_S5_S3 0 2000
 /begin AXIS_DESCR STD_AXIS zff_atsys._.iSignale._.obj.sig_m_t8 UMR_NM__6_1_M34_S5_S3 4 -204 1326 DEPOSIT ABSOLUTE /end AXIS_DESCR
 /begin AXIS_DESCR STD_AXIS zff_atsys._.iSignale._.obj.sig_n_mot8 UMR_U_MIN_32_1_0_S5_S3 4 0 8160 DEPOSIT ABSOLUTE /end AXIS_DESCR
/end CHARACTERISTIC
/begin CHARACTERISTIC KF_TVKABMTNMOTRS76 "Verzögerungszeit abschaltende Kupplung bei RS" MAP 0x1B968C ZF_kf_ui8_S5_S3 2000 UMR_MSEC__10_1_0_S5_S3 0 2000
 /begin AXIS_DESCR STD_AXIS zff_atsys._.iSignale._.obj.sig_m_t8 UMR_NM__6_1_M34_S5_S3 4 -204 1326 DEPOSIT ABSOLUTE /end AXIS_DESCR
 /begin AXIS_DESCR STD_AXIS zff_atsys._.iSignale._.obj.sig_n_mot8 UMR_U_MIN_32_1_0_S5_S3 4 0 8160 DEPOSIT ABSOLUTE /end AXIS_DESCR
/end CHARACTERISTIC
/begin CHARACTERISTIC KF_TVKABMTNMOTRS87 "Verzögerungszeit abschaltende Kupplung bei RS" MAP 0x1B9968 ZF_kf_ui8_S5_S3 2000 UMR_MSEC__10_1_0_S5_S3 0 2000
 /begin AXIS_DESCR STD_AXIS zff_atsys._.iSignale._.obj.sig_m_t8 UMR_NM__6_1_M34_S5_S3 4 -204 1326 DEPOSIT ABSOLUTE /end AXIS_DESCR
 /begin AXIS_DESCR STD_AXIS zff_atsys._.iSignale._.obj.sig_n_mot8 UMR_U_MIN_32_1_0_S5_S3 4 0 8160 DEPOSIT ABSOLUTE /end AXIS_DESCR
/end CHARACTERISTIC
/begin CHARACTERISTIC KF_TVKABMTNMOTRSSP21 "Verzögerungszeit abschaltende Kupplung bei RS" MAP 0x1B9BEC ZF_kf_ui8_S5_S3 2000 UMR_MSEC__10_1_0_S5_S3 0 2000
 /begin AXIS_DESCR STD_AXIS zff_atsys._.iSignale._.obj.sig_m_t8 UMR_NM__6_1_M34_S5_S3 4 -204 1326 DEPOSIT ABSOLUTE /end AXIS_DESCR
 /begin AXIS_DESCR STD_AXIS zff_atsys._.iSignale._.obj.sig_n_mot8 UMR_U_MIN_32_1_0_S5_S3 4 0 8160 DEPOSIT ABSOLUTE /end AXIS_DESCR
/end CHARACTERISTIC
/begin CHARACTERISTIC KF_TVKABMTNMOTRSSP31 "Verzögerungszeit abschaltende Kupplung bei RS" MAP 0x1BA7F4 ZF_kf_ui8_S5_S3 2000 UMR_MSEC__10_1_0_S5_S3 0 2000
 /begin AXIS_DESCR STD_AXIS zff_atsys._.iSignale._.obj.sig_m_t8 UMR_NM__6_1_M34_S5_S3 4 -204 1326 DEPOSIT ABSOLUTE /end AXIS_DESCR
 /begin AXIS_DESCR STD_AXIS zff_atsys._.iSignale._.obj.sig_n_mot8 UMR_U_MIN_32_1_0_S5_S3 4 0 8160 DEPOSIT ABSOLUTE /end AXIS_DESCR
/end CHARACTERISTIC
/begin CHARACTERISTIC KF_TVKABMTNMOTRSSP32 "Verzögerungszeit abschaltende Kupplung bei RS" MAP 0x1B9DA4 ZF_kf_ui8_S5_S3 2000 UMR_MSEC__10_1_0_S5_S3 0 2000
 /begin AXIS_DESCR STD_AXIS zff_atsys._.iSignale._.obj.sig_m_t8 UMR_NM__6_1_M34_S5_S3 4 -204 1326 DEPOSIT ABSOLUTE /end AXIS_DESCR
 /begin AXIS_DESCR STD_AXIS zff_atsys._.iSignale._.obj.sig_n_mot8 UMR_U_MIN_32_1_0_S5_S3 4 0 8160 DEPOSIT ABSOLUTE /end AXIS_DESCR
/end CHARACTERISTIC
/begin CHARACTERISTIC KF_TVKABMTNMOTRSSP42 "Verzögerungszeit abschaltende Kupplung bei RS" MAP 0x1BA9AC ZF_kf_ui8_S5_S3 2000 UMR_MSEC__10_1_0_S5_S3 0 2000
 /begin AXIS_DESCR STD_AXIS zff_atsys._.iSignale._.obj.sig_m_t8 UMR_NM__6_1_M34_S5_S3 4 -204 1326 DEPOSIT ABSOLUTE /end AXIS_DESCR
 /begin AXIS_DESCR STD_AXIS zff_atsys._.iSignale._.obj.sig_n_mot8 UMR_U_MIN_32_1_0_S5_S3 4 0 8160 DEPOSIT ABSOLUTE /end AXIS_DESCR
/end CHARACTERISTIC
/begin CHARACTERISTIC KF_TVKABMTNMOTRSSP43 "Verzögerungszeit abschaltende Kupplung bei RS" MAP 0x1B9F5C ZF_kf_ui8_S5_S3 2000 UMR_MSEC__10_1_0_S5_S3 0 2000
 /begin AXIS_DESCR STD_AXIS zff_atsys._.iSignale._.obj.sig_m_t8 UMR_NM__6_1_M34_S5_S3 4 -204 1326 DEPOSIT ABSOLUTE /end AXIS_DESCR
 /begin AXIS_DESCR STD_AXIS zff_atsys._.iSignale._.obj.sig_n_mot8 UMR_U_MIN_32_1_0_S5_S3 4 0 8160 DEPOSIT ABSOLUTE /end AXIS_DESCR
/end CHARACTERISTIC
/begin CHARACTERISTIC KF_TVKABMTNMOTRSSP51 "Verzögerungszeit abschaltende Kupplung bei RS" MAP 0x1BAB64 ZF_kf_ui8_S5_S3 2000 UMR_MSEC__10_1_0_S5_S3 0 2000
 /begin AXIS_DESCR STD_AXIS zff_atsys._.iSignale._.obj.sig_m_t8 UMR_NM__6_1_M34_S5_S3 4 -204 1326 DEPOSIT ABSOLUTE /end AXIS_DESCR
 /begin AXIS_DESCR STD_AXIS zff_atsys._.iSignale._.obj.sig_n_mot8 UMR_U_MIN_32_1_0_S5_S3 4 0 8160 DEPOSIT ABSOLUTE /end AXIS_DESCR
/end CHARACTERISTIC
/begin CHARACTERISTIC KF_TVKABMTNMOTRSSP53 "Verzögerungszeit abschaltende Kupplung bei RS" MAP 0x1BAD1C ZF_kf_ui8_S5_S3 2000 UMR_MSEC__10_1_0_S5_S3 0 2000
 /begin AXIS_DESCR STD_AXIS zff_atsys._.iSignale._.obj.sig_m_t8 UMR_NM__6_1_M34_S5_S3 4 -204 1326 DEPOSIT ABSOLUTE /end AXIS_DESCR
 /begin AXIS_DESCR STD_AXIS zff_atsys._.iSignale._.obj.sig_n_mot8 UMR_U_MIN_32_1_0_S5_S3 4 0 8160 DEPOSIT ABSOLUTE /end AXIS_DESCR
/end CHARACTERISTIC
/begin CHARACTERISTIC KF_TVKABMTNMOTRSSP54 "Verzögerungszeit abschaltende Kupplung bei RS" MAP 0x1BA114 ZF_kf_ui8_S5_S3 2000 UMR_MSEC__10_1_0_S5_S3 0 2000
 /begin AXIS_DESCR STD_AXIS zff_atsys._.iSignale._.obj.sig_m_t8 UMR_NM__6_1_M34_S5_S3 4 -204 1326 DEPOSIT ABSOLUTE /end AXIS_DESCR
 /begin AXIS_DESCR STD_AXIS zff_atsys._.iSignale._.obj.sig_n_mot8 UMR_U_MIN_32_1_0_S5_S3 4 0 8160 DEPOSIT ABSOLUTE /end AXIS_DESCR
/end CHARACTERISTIC
/begin CHARACTERISTIC KF_TVKABMTNMOTRSSP63 "Verzögerungszeit abschaltende Kupplung bei RS" MAP 0x1BAED4 ZF_kf_ui8_S5_S3 2000 UMR_MSEC__10_1_0_S5_S3 0 2000
 /begin AXIS_DESCR STD_AXIS zff_atsys._.iSignale._.obj.sig_m_t8 UMR_NM__6_1_M34_S5_S3 4 -204 1326 DEPOSIT ABSOLUTE /end AXIS_DESCR
 /begin AXIS_DESCR STD_AXIS zff_atsys._.iSignale._.obj.sig_n_mot8 UMR_U_MIN_32_1_0_S5_S3 4 0 8160 DEPOSIT ABSOLUTE /end AXIS_DESCR
/end CHARACTERISTIC
/begin CHARACTERISTIC KF_TVKABMTNMOTRSSP64 "Verzögerungszeit abschaltende Kupplung bei RS" MAP 0x1BB08C ZF_kf_ui8_S5_S3 2000 UMR_MSEC__10_1_0_S5_S3 0 2000
 /begin AXIS_DESCR STD_AXIS zff_atsys._.iSignale._.obj.sig_m_t8 UMR_NM__6_1_M34_S5_S3 4 -204 1326 DEPOSIT ABSOLUTE /end AXIS_DESCR
 /begin AXIS_DESCR STD_AXIS zff_atsys._.iSignale._.obj.sig_n_mot8 UMR_U_MIN_32_1_0_S5_S3 4 0 8160 DEPOSIT ABSOLUTE /end AXIS_DESCR
/end CHARACTERISTIC
/begin CHARACTERISTIC KF_TVKABMTNMOTRSSP65 "Verzögerungszeit abschaltende Kupplung bei RS" MAP 0x1BA2CC ZF_kf_ui8_S5_S3 2000 UMR_MSEC__10_1_0_S5_S3 0 2000
 /begin AXIS_DESCR STD_AXIS zff_atsys._.iSignale._.obj.sig_m_t8 UMR_NM__6_1_M34_S5_S3 4 -204 1326 DEPOSIT ABSOLUTE /end AXIS_DESCR
 /begin AXIS_DESCR STD_AXIS zff_atsys._.iSignale._.obj.sig_n_mot8 UMR_U_MIN_32_1_0_S5_S3 4 0 8160 DEPOSIT ABSOLUTE /end AXIS_DESCR
/end CHARACTERISTIC
/begin CHARACTERISTIC KF_TVKABMTNMOTRSSP71 "Verzögerungszeit abschaltende Kupplung bei RS" MAP 0x1BB244 ZF_kf_ui8_S5_S3 2000 UMR_MSEC__10_1_0_S5_S3 0 2000
 /begin AXIS_DESCR STD_AXIS zff_atsys._.iSignale._.obj.sig_m_t8 UMR_NM__6_1_M34_S5_S3 4 -204 1326 DEPOSIT ABSOLUTE /end AXIS_DESCR
 /begin AXIS_DESCR STD_AXIS zff_atsys._.iSignale._.obj.sig_n_mot8 UMR_U_MIN_32_1_0_S5_S3 4 0 8160 DEPOSIT ABSOLUTE /end AXIS_DESCR
/end CHARACTERISTIC
/begin CHARACTERISTIC KF_TVKABMTNMOTRSSP75 "Verzögerungszeit abschaltende Kupplung bei RS" MAP 0x1BB3FC ZF_kf_ui8_S5_S3 2000 UMR_MSEC__10_1_0_S5_S3 0 2000
 /begin AXIS_DESCR STD_AXIS zff_atsys._.iSignale._.obj.sig_m_t8 UMR_NM__6_1_M34_S5_S3 4 -204 1326 DEPOSIT ABSOLUTE /end AXIS_DESCR
 /begin AXIS_DESCR STD_AXIS zff_atsys._.iSignale._.obj.sig_n_mot8 UMR_U_MIN_32_1_0_S5_S3 4 0 8160 DEPOSIT ABSOLUTE /end AXIS_DESCR
/end CHARACTERISTIC
/begin CHARACTERISTIC KF_TVKABMTNMOTRSSP76 "Verzögerungszeit abschaltende Kupplung bei RS" MAP 0x1BA484 ZF_kf_ui8_S5_S3 2000 UMR_MSEC__10_1_0_S5_S3 0 2000
 /begin AXIS_DESCR STD_AXIS zff_atsys._.iSignale._.obj.sig_m_t8 UMR_NM__6_1_M34_S5_S3 4 -204 1326 DEPOSIT ABSOLUTE /end AXIS_DESCR
 /begin AXIS_DESCR STD_AXIS zff_atsys._.iSignale._.obj.sig_n_mot8 UMR_U_MIN_32_1_0_S5_S3 4 0 8160 DEPOSIT ABSOLUTE /end AXIS_DESCR
/end CHARACTERISTIC
/begin CHARACTERISTIC KF_TVKABMTNMOTRSSP82 "Verzögerungszeit abschaltende Kupplung bei RS" MAP 0x1BB5B4 ZF_kf_ui8_S5_S3 2000 UMR_MSEC__10_1_0_S5_S3 0 2000
 /begin AXIS_DESCR STD_AXIS zff_atsys._.iSignale._.obj.sig_m_t8 UMR_NM__6_1_M34_S5_S3 4 -204 1326 DEPOSIT ABSOLUTE /end AXIS_DESCR
 /begin AXIS_DESCR STD_AXIS zff_atsys._.iSignale._.obj.sig_n_mot8 UMR_U_MIN_32_1_0_S5_S3 4 0 8160 DEPOSIT ABSOLUTE /end AXIS_DESCR
/end CHARACTERISTIC
/begin CHARACTERISTIC KF_TVKABMTNMOTRSSP84 "Verzögerungszeit abschaltende Kupplung bei RS" MAP 0x1BB76C ZF_kf_ui8_S5_S3 2000 UMR_MSEC__10_1_0_S5_S3 0 2000
 /begin AXIS_DESCR STD_AXIS zff_atsys._.iSignale._.obj.sig_m_t8 UMR_NM__6_1_M34_S5_S3 4 -204 1326 DEPOSIT ABSOLUTE /end AXIS_DESCR
 /begin AXIS_DESCR STD_AXIS zff_atsys._.iSignale._.obj.sig_n_mot8 UMR_U_MIN_32_1_0_S5_S3 4 0 8160 DEPOSIT ABSOLUTE /end AXIS_DESCR
/end CHARACTERISTIC
/begin CHARACTERISTIC KF_TVKABMTNMOTRSSP86 "Verzögerungszeit abschaltende Kupplung bei RS" MAP 0x1BB924 ZF_kf_ui8_S5_S3 2000 UMR_MSEC__10_1_0_S5_S3 0 2000
 /begin AXIS_DESCR STD_AXIS zff_atsys._.iSignale._.obj.sig_m_t8 UMR_NM__6_1_M34_S5_S3 4 -204 1326 DEPOSIT ABSOLUTE /end AXIS_DESCR
 /begin AXIS_DESCR STD_AXIS zff_atsys._.iSignale._.obj.sig_n_mot8 UMR_U_MIN_32_1_0_S5_S3 4 0 8160 DEPOSIT ABSOLUTE /end AXIS_DESCR
/end CHARACTERISTIC
/begin CHARACTERISTIC KF_TVKABMTNMOTRSSP87 "Verzögerungszeit abschaltende Kupplung bei RS" MAP 0x1BA63C ZF_kf_ui8_S5_S3 2000 UMR_MSEC__10_1_0_S5_S3 0 2000
 /begin AXIS_DESCR STD_AXIS zff_atsys._.iSignale._.obj.sig_m_t8 UMR_NM__6_1_M34_S5_S3 4 -204 1326 DEPOSIT ABSOLUTE /end AXIS_DESCR
 /begin AXIS_DESCR STD_AXIS zff_atsys._.iSignale._.obj.sig_n_mot8 UMR_U_MIN_32_1_0_S5_S3 4 0 8160 DEPOSIT ABSOLUTE /end AXIS_DESCR
/end CHARACTERISTIC
/begin CHARACTERISTIC KF_TVKABMTNMOTRSSPORT21 "Verzögerungszeit abschaltende Kupplung bei RS" MAP 0x1BBADC ZF_kf_ui8_S5_S3 2000 UMR_MSEC__10_1_0_S5_S3 0 2000
 /begin AXIS_DESCR STD_AXIS zff_atsys._.iSignale._.obj.sig_m_t8 UMR_NM__6_1_M34_S5_S3 4 -204 1326 DEPOSIT ABSOLUTE /end AXIS_DESCR
 /begin AXIS_DESCR STD_AXIS zff_atsys._.iSignale._.obj.sig_n_mot8 UMR_U_MIN_32_1_0_S5_S3 4 0 8160 DEPOSIT ABSOLUTE /end AXIS_DESCR
/end CHARACTERISTIC
/begin CHARACTERISTIC KF_TVKABMTNMOTRSSPORT31 "Verzögerungszeit abschaltende Kupplung bei RS" MAP 0x1BC6E4 ZF_kf_ui8_S5_S3 2000 UMR_MSEC__10_1_0_S5_S3 0 2000
 /begin AXIS_DESCR STD_AXIS zff_atsys._.iSignale._.obj.sig_m_t8 UMR_NM__6_1_M34_S5_S3 4 -204 1326 DEPOSIT ABSOLUTE /end AXIS_DESCR
 /begin AXIS_DESCR STD_AXIS zff_atsys._.iSignale._.obj.sig_n_mot8 UMR_U_MIN_32_1_0_S5_S3 4 0 8160 DEPOSIT ABSOLUTE /end AXIS_DESCR
/end CHARACTERISTIC
/begin CHARACTERISTIC KF_TVKABMTNMOTRSSPORT32 "Verzögerungszeit abschaltende Kupplung bei RS" MAP 0x1BBC94 ZF_kf_ui8_S5_S3 2000 UMR_MSEC__10_1_0_S5_S3 0 2000
 /begin AXIS_DESCR STD_AXIS zff_atsys._.iSignale._.obj.sig_m_t8 UMR_NM__6_1_M34_S5_S3 4 -204 1326 DEPOSIT ABSOLUTE /end AXIS_DESCR
 /begin AXIS_DESCR STD_AXIS zff_atsys._.iSignale._.obj.sig_n_mot8 UMR_U_MIN_32_1_0_S5_S3 4 0 8160 DEPOSIT ABSOLUTE /end AXIS_DESCR
/end CHARACTERISTIC
/begin CHARACTERISTIC KF_TVKABMTNMOTRSSPORT42 "Verzögerungszeit abschaltende Kupplung bei RS" MAP 0x1BC89C ZF_kf_ui8_S5_S3 2000 UMR_MSEC__10_1_0_S5_S3 0 2000
 /begin AXIS_DESCR STD_AXIS zff_atsys._.iSignale._.obj.sig_m_t8 UMR_NM__6_1_M34_S5_S3 4 -204 1326 DEPOSIT ABSOLUTE /end AXIS_DESCR
 /begin AXIS_DESCR STD_AXIS zff_atsys._.iSignale._.obj.sig_n_mot8 UMR_U_MIN_32_1_0_S5_S3 4 0 8160 DEPOSIT ABSOLUTE /end AXIS_DESCR
/end CHARACTERISTIC
/begin CHARACTERISTIC KF_TVKABMTNMOTRSSPORT43 "Verzögerungszeit abschaltende Kupplung bei RS" MAP 0x1BBE4C ZF_kf_ui8_S5_S3 2000 UMR_MSEC__10_1_0_S5_S3 0 2000
 /begin AXIS_DESCR STD_AXIS zff_atsys._.iSignale._.obj.sig_m_t8 UMR_NM__6_1_M34_S5_S3 4 -204 1326 DEPOSIT ABSOLUTE /end AXIS_DESCR
 /begin AXIS_DESCR STD_AXIS zff_atsys._.iSignale._.obj.sig_n_mot8 UMR_U_MIN_32_1_0_S5_S3 4 0 8160 DEPOSIT ABSOLUTE /end AXIS_DESCR
/end CHARACTERISTIC
/begin CHARACTERISTIC KF_TVKABMTNMOTRSSPORT51 "Verzögerungszeit abschaltende Kupplung bei RS" MAP 0x1BCA54 ZF_kf_ui8_S5_S3 2000 UMR_MSEC__10_1_0_S5_S3 0 2000
 /begin AXIS_DESCR STD_AXIS zff_atsys._.iSignale._.obj.sig_m_t8 UMR_NM__6_1_M34_S5_S3 4 -204 1326 DEPOSIT ABSOLUTE /end AXIS_DESCR
 /begin AXIS_DESCR STD_AXIS zff_atsys._.iSignale._.obj.sig_n_mot8 UMR_U_MIN_32_1_0_S5_S3 4 0 8160 DEPOSIT ABSOLUTE /end AXIS_DESCR
/end CHARACTERISTIC
/begin CHARACTERISTIC KF_TVKABMTNMOTRSSPORT53 "Verzögerungszeit abschaltende Kupplung bei RS" MAP 0x1BCC0C ZF_kf_ui8_S5_S3 2000 UMR_MSEC__10_1_0_S5_S3 0 2000
 /begin AXIS_DESCR STD_AXIS zff_atsys._.iSignale._.obj.sig_m_t8 UMR_NM__6_1_M34_S5_S3 4 -204 1326 DEPOSIT ABSOLUTE /end AXIS_DESCR
 /begin AXIS_DESCR STD_AXIS zff_atsys._.iSignale._.obj.sig_n_mot8 UMR_U_MIN_32_1_0_S5_S3 4 0 8160 DEPOSIT ABSOLUTE /end AXIS_DESCR
/end CHARACTERISTIC
/begin CHARACTERISTIC KF_TVKABMTNMOTRSSPORT54 "Verzögerungszeit abschaltende Kupplung bei RS" MAP 0x1BC004 ZF_kf_ui8_S5_S3 2000 UMR_MSEC__10_1_0_S5_S3 0 2000
 /begin AXIS_DESCR STD_AXIS zff_atsys._.iSignale._.obj.sig_m_t8 UMR_NM__6_1_M34_S5_S3 4 -204 1326 DEPOSIT ABSOLUTE /end AXIS_DESCR
 /begin AXIS_DESCR STD_AXIS zff_atsys._.iSignale._.obj.sig_n_mot8 UMR_U_MIN_32_1_0_S5_S3 4 0 8160 DEPOSIT ABSOLUTE /end AXIS_DESCR
/end CHARACTERISTIC
/begin CHARACTERISTIC KF_TVKABMTNMOTRSSPORT63 "Verzögerungszeit abschaltende Kupplung bei RS" MAP 0x1BCDC4 ZF_kf_ui8_S5_S3 2000 UMR_MSEC__10_1_0_S5_S3 0 2000
 /begin AXIS_DESCR STD_AXIS zff_atsys._.iSignale._.obj.sig_m_t8 UMR_NM__6_1_M34_S5_S3 4 -204 1326 DEPOSIT ABSOLUTE /end AXIS_DESCR
 /begin AXIS_DESCR STD_AXIS zff_atsys._.iSignale._.obj.sig_n_mot8 UMR_U_MIN_32_1_0_S5_S3 4 0 8160 DEPOSIT ABSOLUTE /end AXIS_DESCR
/end CHARACTERISTIC
/begin CHARACTERISTIC KF_TVKABMTNMOTRSSPORT64 "Verzögerungszeit abschaltende Kupplung bei RS" MAP 0x1BCF7C ZF_kf_ui8_S5_S3 2000 UMR_MSEC__10_1_0_S5_S3 0 2000
 /begin AXIS_DESCR STD_AXIS zff_atsys._.iSignale._.obj.sig_m_t8 UMR_NM__6_1_M34_S5_S3 4 -204 1326 DEPOSIT ABSOLUTE /end AXIS_DESCR
 /begin AXIS_DESCR STD_AXIS zff_atsys._.iSignale._.obj.sig_n_mot8 UMR_U_MIN_32_1_0_S5_S3 4 0 8160 DEPOSIT ABSOLUTE /end AXIS_DESCR
/end CHARACTERISTIC
/begin CHARACTERISTIC KF_TVKABMTNMOTRSSPORT65 "Verzögerungszeit abschaltende Kupplung bei RS" MAP 0x1BC1BC ZF_kf_ui8_S5_S3 2000 UMR_MSEC__10_1_0_S5_S3 0 2000
 /begin AXIS_DESCR STD_AXIS zff_atsys._.iSignale._.obj.sig_m_t8 UMR_NM__6_1_M34_S5_S3 4 -204 1326 DEPOSIT ABSOLUTE /end AXIS_DESCR
 /begin AXIS_DESCR STD_AXIS zff_atsys._.iSignale._.obj.sig_n_mot8 UMR_U_MIN_32_1_0_S5_S3 4 0 8160 DEPOSIT ABSOLUTE /end AXIS_DESCR
/end CHARACTERISTIC
/begin CHARACTERISTIC KF_TVKABMTNMOTRSSPORT71 "Verzögerungszeit abschaltende Kupplung bei RS" MAP 0x1BD134 ZF_kf_ui8_S5_S3 2000 UMR_MSEC__10_1_0_S5_S3 0 2000
 /begin AXIS_DESCR STD_AXIS zff_atsys._.iSignale._.obj.sig_m_t8 UMR_NM__6_1_M34_S5_S3 4 -204 1326 DEPOSIT ABSOLUTE /end AXIS_DESCR
 /begin AXIS_DESCR STD_AXIS zff_atsys._.iSignale._.obj.sig_n_mot8 UMR_U_MIN_32_1_0_S5_S3 4 0 8160 DEPOSIT ABSOLUTE /end AXIS_DESCR
/end CHARACTERISTIC
/begin CHARACTERISTIC KF_TVKABMTNMOTRSSPORT75 "Verzögerungszeit abschaltende Kupplung bei RS" MAP 0x1BD2EC ZF_kf_ui8_S5_S3 2000 UMR_MSEC__10_1_0_S5_S3 0 2000
 /begin AXIS_DESCR STD_AXIS zff_atsys._.iSignale._.obj.sig_m_t8 UMR_NM__6_1_M34_S5_S3 4 -204 1326 DEPOSIT ABSOLUTE /end AXIS_DESCR
 /begin AXIS_DESCR STD_AXIS zff_atsys._.iSignale._.obj.sig_n_mot8 UMR_U_MIN_32_1_0_S5_S3 4 0 8160 DEPOSIT ABSOLUTE /end AXIS_DESCR
/end CHARACTERISTIC
/begin CHARACTERISTIC KF_TVKABMTNMOTRSSPORT76 "Verzögerungszeit abschaltende Kupplung bei RS" MAP 0x1BC374 ZF_kf_ui8_S5_S3 2000 UMR_MSEC__10_1_0_S5_S3 0 2000
 /begin AXIS_DESCR STD_AXIS zff_atsys._.iSignale._.obj.sig_m_t8 UMR_NM__6_1_M34_S5_S3 4 -204 1326 DEPOSIT ABSOLUTE /end AXIS_DESCR
 /begin AXIS_DESCR STD_AXIS zff_atsys._.iSignale._.obj.sig_n_mot8 UMR_U_MIN_32_1_0_S5_S3 4 0 8160 DEPOSIT ABSOLUTE /end AXIS_DESCR
/end CHARACTERISTIC
/begin CHARACTERISTIC KF_TVKABMTNMOTRSSPORT82 "Verzögerungszeit abschaltende Kupplung bei RS" MAP 0x1BD4A4 ZF_kf_ui8_S5_S3 2000 UMR_MSEC__10_1_0_S5_S3 0 2000
 /begin AXIS_DESCR STD_AXIS zff_atsys._.iSignale._.obj.sig_m_t8 UMR_NM__6_1_M34_S5_S3 4 -204 1326 DEPOSIT ABSOLUTE /end AXIS_DESCR
 /begin AXIS_DESCR STD_AXIS zff_atsys._.iSignale._.obj.sig_n_mot8 UMR_U_MIN_32_1_0_S5_S3 4 0 8160 DEPOSIT ABSOLUTE /end AXIS_DESCR
/end CHARACTERISTIC
/begin CHARACTERISTIC KL_PHKABMTSPORT12 "Haltedruck abschaltende Kupplung bei HS" CURVE 0x1B7BA0 ZF_kl_si16_S5_S3 22 UMR_BAR__1_1000_0_S5_S3 0 22
 /begin AXIS_DESCR STD_AXIS zff_atsys._.iSignale._.obj.sig_m_t UMR_NM__1_1_0_S5_S3 8 -200 1300 DEPOSIT ABSOLUTE /end AXIS_DESCR
/end CHARACTERISTIC
/begin CHARACTERISTIC KL_PHKABMTSPORT23 "Haltedruck abschaltende Kupplung bei HS" CURVE 0x1B7C98 ZF_kl_si16_S5_S3 22 UMR_BAR__1_1000_0_S5_S3 0 22
 /begin AXIS_DESCR STD_AXIS zff_atsys._.iSignale._.obj.sig_m_t UMR_NM__1_1_0_S5_S3 8 -200 1300 DEPOSIT ABSOLUTE /end AXIS_DESCR
/end CHARACTERISTIC
/begin CHARACTERISTIC KL_PHKABMTSPORT34 "Haltedruck abschaltende Kupplung bei HS" CURVE 0x1B7D90 ZF_kl_si16_S5_S3 22 UMR_BAR__1_1000_0_S5_S3 0 22
 /begin AXIS_DESCR STD_AXIS zff_atsys._.iSignale._.obj.sig_m_t UMR_NM__1_1_0_S5_S3 8 -200 1300 DEPOSIT ABSOLUTE /end AXIS_DESCR
/end CHARACTERISTIC
/begin CHARACTERISTIC KL_PHKABMTSPORT45 "Haltedruck abschaltende Kupplung bei HS" CURVE 0x1B7E88 ZF_kl_si16_S5_S3 22 UMR_BAR__1_1000_0_S5_S3 0 22
 /begin AXIS_DESCR STD_AXIS zff_atsys._.iSignale._.obj.sig_m_t UMR_NM__1_1_0_S5_S3 8 -200 1300 DEPOSIT ABSOLUTE /end AXIS_DESCR
/end CHARACTERISTIC
/begin CHARACTERISTIC KL_PHKABMTSPORT56 "Haltedruck abschaltende Kupplung bei HS" CURVE 0x1B7F80 ZF_kl_si16_S5_S3 22 UMR_BAR__1_1000_0_S5_S3 0 22
 /begin AXIS_DESCR STD_AXIS zff_atsys._.iSignale._.obj.sig_m_t UMR_NM__1_1_0_S5_S3 8 -200 1300 DEPOSIT ABSOLUTE /end AXIS_DESCR
/end CHARACTERISTIC
/begin CHARACTERISTIC KL_PHKABMTSPORT67 "Haltedruck abschaltende Kupplung bei HS" CURVE 0x1B8078 ZF_kl_si16_S5_S3 22 UMR_BAR__1_1000_0_S5_S3 0 22
 /begin AXIS_DESCR STD_AXIS zff_atsys._.iSignale._.obj.sig_m_t UMR_NM__1_1_0_S5_S3 8 -200 1300 DEPOSIT ABSOLUTE /end AXIS_DESCR
/end CHARACTERISTIC
/begin CHARACTERISTIC KL_PHKABMTSPORT78 "Haltedruck abschaltende Kupplung bei HS" CURVE 0x1B8170 ZF_kl_si16_S5_S3 22 UMR_BAR__1_1000_0_S5_S3 0 22
 /begin AXIS_DESCR STD_AXIS zff_atsys._.iSignale._.obj.sig_m_t UMR_NM__1_1_0_S5_S3 8 -200 1300 DEPOSIT ABSOLUTE /end AXIS_DESCR
/end CHARACTERISTIC
/begin CHARACTERISTIC KL_POHKAB21 "Druckoffset waehrend Haltedruckphase" CURVE 0x1B8790 ZF_kl_si16_S5_S3 12.75 UMR_BAR__1_1000_0_S5_S3 -6.4 6.35
 /begin AXIS_DESCR STD_AXIS zff_atsys._.iSignale._.obj.sig_m_t8 UMR_NM__6_1_M34_S5_S3 4 -204 1326 DEPOSIT ABSOLUTE /end AXIS_DESCR
/end CHARACTERISTIC
/begin CHARACTERISTIC KL_POHKAB21_EL "Druckoffset waehrend Haltedruckphase" CURVE 0x1B87A4 ZF_kl_si16_S5_S3 12.75 UMR_BAR__1_1000_0_S5_S3 -6.4 6.35
 /begin AXIS_DESCR STD_AXIS zff_atsys._.iSignale._.obj.sig_m_t8 UMR_NM__6_1_M34_S5_S3 4 -204 1326 DEPOSIT ABSOLUTE /end AXIS_DESCR
/end CHARACTERISTIC
/begin CHARACTERISTIC KL_POHKAB32 "Druckoffset waehrend Haltedruckphase" CURVE 0x1B8A6C ZF_kl_si16_S5_S3 12.75 UMR_BAR__1_1000_0_S5_S3 -6.4 6.35
 /begin AXIS_DESCR STD_AXIS zff_atsys._.iSignale._.obj.sig_m_t8 UMR_NM__6_1_M34_S5_S3 4 -204 1326 DEPOSIT ABSOLUTE /end AXIS_DESCR
/end CHARACTERISTIC
/begin CHARACTERISTIC KL_POHKAB32_EL "Druckoffset waehrend Haltedruckphase" CURVE 0x1B8A80 ZF_kl_si16_S5_S3 12.75 UMR_BAR__1_1000_0_S5_S3 -6.4 6.35
 /begin AXIS_DESCR STD_AXIS zff_atsys._.iSignale._.obj.sig_m_t8 UMR_NM__6_1_M34_S5_S3 4 -204 1326 DEPOSIT ABSOLUTE /end AXIS_DESCR
/end CHARACTERISTIC
/begin CHARACTERISTIC KL_POHKAB43 "Druckoffset waehrend Haltedruckphase" CURVE 0x1B8D48 ZF_kl_si16_S5_S3 12.75 UMR_BAR__1_1000_0_S5_S3 -6.4 6.35
 /begin AXIS_DESCR STD_AXIS zff_atsys._.iSignale._.obj.sig_m_t8 UMR_NM__6_1_M34_S5_S3 4 -204 1326 DEPOSIT ABSOLUTE /end AXIS_DESCR
/end CHARACTERISTIC
/begin CHARACTERISTIC KL_POHKAB43_EL "Druckoffset waehrend Haltedruckphase" CURVE 0x1B8D5C ZF_kl_si16_S5_S3 12.75 UMR_BAR__1_1000_0_S5_S3 -6.4 6.35
 /begin AXIS_DESCR STD_AXIS zff_atsys._.iSignale._.obj.sig_m_t8 UMR_NM__6_1_M34_S5_S3 4 -204 1326 DEPOSIT ABSOLUTE /end AXIS_DESCR
/end CHARACTERISTIC
/begin CHARACTERISTIC KL_POHKAB54 "Druckoffset waehrend Haltedruckphase" CURVE 0x1B9024 ZF_kl_si16_S5_S3 12.75 UMR_BAR__1_1000_0_S5_S3 -6.4 6.35
 /begin AXIS_DESCR STD_AXIS zff_atsys._.iSignale._.obj.sig_m_t8 UMR_NM__6_1_M34_S5_S3 4 -204 1326 DEPOSIT ABSOLUTE /end AXIS_DESCR
/end CHARACTERISTIC
/begin CHARACTERISTIC KL_POHKAB54_EL "Druckoffset waehrend Haltedruckphase" CURVE 0x1B9038 ZF_kl_si16_S5_S3 12.75 UMR_BAR__1_1000_0_S5_S3 -6.4 6.35
 /begin AXIS_DESCR STD_AXIS zff_atsys._.iSignale._.obj.sig_m_t8 UMR_NM__6_1_M34_S5_S3 4 -204 1326 DEPOSIT ABSOLUTE /end AXIS_DESCR
/end CHARACTERISTIC
/begin CHARACTERISTIC KL_POHKAB65 "Druckoffset waehrend Haltedruckphase" CURVE 0x1B9300 ZF_kl_si16_S5_S3 12.75 UMR_BAR__1_1000_0_S5_S3 -6.4 6.35
 /begin AXIS_DESCR STD_AXIS zff_atsys._.iSignale._.obj.sig_m_t8 UMR_NM__6_1_M34_S5_S3 4 -204 1326 DEPOSIT ABSOLUTE /end AXIS_DESCR
/end CHARACTERISTIC
/begin CHARACTERISTIC KL_POHKAB65_EL "Druckoffset waehrend Haltedruckphase" CURVE 0x1B9314 ZF_kl_si16_S5_S3 12.75 UMR_BAR__1_1000_0_S5_S3 -6.4 6.35
 /begin AXIS_DESCR STD_AXIS zff_atsys._.iSignale._.obj.sig_m_t8 UMR_NM__6_1_M34_S5_S3 4 -204 1326 DEPOSIT ABSOLUTE /end AXIS_DESCR
/end CHARACTERISTIC
/begin CHARACTERISTIC KL_POHKAB76 "Druckoffset waehrend Haltedruckphase" CURVE 0x1B95DC ZF_kl_si16_S5_S3 12.75 UMR_BAR__1_1000_0_S5_S3 -6.4 6.35
 /begin AXIS_DESCR STD_AXIS zff_atsys._.iSignale._.obj.sig_m_t8 UMR_NM__6_1_M34_S5_S3 4 -204 1326 DEPOSIT ABSOLUTE /end AXIS_DESCR
/end CHARACTERISTIC
/begin CHARACTERISTIC KL_POHKAB76_EL "Druckoffset waehrend Haltedruckphase" CURVE 0x1B95F0 ZF_kl_si16_S5_S3 12.75 UMR_BAR__1_1000_0_S5_S3 -6.4 6.35
 /begin AXIS_DESCR STD_AXIS zff_atsys._.iSignale._.obj.sig_m_t8 UMR_NM__6_1_M34_S5_S3 4 -204 1326 DEPOSIT ABSOLUTE /end AXIS_DESCR
/end CHARACTERISTIC
/begin CHARACTERISTIC KL_POHKAB87 "Druckoffset waehrend Haltedruckphase" CURVE 0x1B98B8 ZF_kl_si16_S5_S3 12.75 UMR_BAR__1_1000_0_S5_S3 -6.4 6.35
 /begin AXIS_DESCR STD_AXIS zff_atsys._.iSignale._.obj.sig_m_t8 UMR_NM__6_1_M34_S5_S3 4 -204 1326 DEPOSIT ABSOLUTE /end AXIS_DESCR
/end CHARACTERISTIC
/begin CHARACTERISTIC KL_POHKAB87_EL "Druckoffset waehrend Haltedruckphase" CURVE 0x1B98CC ZF_kl_si16_S5_S3 12.75 UMR_BAR__1_1000_0_S5_S3 -6.4 6.35
 /begin AXIS_DESCR STD_AXIS zff_atsys._.iSignale._.obj.sig_m_t8 UMR_NM__6_1_M34_S5_S3 4 -204 1326 DEPOSIT ABSOLUTE /end AXIS_DESCR
/end CHARACTERISTIC
/begin CHARACTERISTIC KL_POHKABSP21 "Druckoffset waehrend Haltedruckphase" CURVE 0x1B9B94 ZF_kl_si16_S5_S3 12.75 UMR_BAR__1_1000_0_S5_S3 -6.4 6.35
 /begin AXIS_DESCR STD_AXIS zff_atsys._.iSignale._.obj.sig_m_t8 UMR_NM__6_1_M34_S5_S3 4 -204 1326 DEPOSIT ABSOLUTE /end AXIS_DESCR
/end CHARACTERISTIC
/begin CHARACTERISTIC KL_POHKABSP31 "Druckoffset waehrend Haltedruckphase" CURVE 0x1BA79C ZF_kl_si16_S5_S3 12.75 UMR_BAR__1_1000_0_S5_S3 -6.4 6.35
 /begin AXIS_DESCR STD_AXIS zff_atsys._.iSignale._.obj.sig_m_t8 UMR_NM__6_1_M34_S5_S3 4 -204 1326 DEPOSIT ABSOLUTE /end AXIS_DESCR
/end CHARACTERISTIC
/begin CHARACTERISTIC KL_POHKABSP32 "Druckoffset waehrend Haltedruckphase" CURVE 0x1B9D4C ZF_kl_si16_S5_S3 12.75 UMR_BAR__1_1000_0_S5_S3 -6.4 6.35
 /begin AXIS_DESCR STD_AXIS zff_atsys._.iSignale._.obj.sig_m_t8 UMR_NM__6_1_M34_S5_S3 4 -204 1326 DEPOSIT ABSOLUTE /end AXIS_DESCR
/end CHARACTERISTIC
/begin CHARACTERISTIC KL_POHKABSP42 "Druckoffset waehrend Haltedruckphase" CURVE 0x1BA954 ZF_kl_si16_S5_S3 12.75 UMR_BAR__1_1000_0_S5_S3 -6.4 6.35
 /begin AXIS_DESCR STD_AXIS zff_atsys._.iSignale._.obj.sig_m_t8 UMR_NM__6_1_M34_S5_S3 4 -204 1326 DEPOSIT ABSOLUTE /end AXIS_DESCR
/end CHARACTERISTIC
/begin CHARACTERISTIC KL_POHKABSP43 "Druckoffset waehrend Haltedruckphase" CURVE 0x1B9F04 ZF_kl_si16_S5_S3 12.75 UMR_BAR__1_1000_0_S5_S3 -6.4 6.35
 /begin AXIS_DESCR STD_AXIS zff_atsys._.iSignale._.obj.sig_m_t8 UMR_NM__6_1_M34_S5_S3 4 -204 1326 DEPOSIT ABSOLUTE /end AXIS_DESCR
/end CHARACTERISTIC
/begin CHARACTERISTIC KL_POHKABSP51 "Druckoffset waehrend Haltedruckphase" CURVE 0x1BAB0C ZF_kl_si16_S5_S3 12.75 UMR_BAR__1_1000_0_S5_S3 -6.4 6.35
 /begin AXIS_DESCR STD_AXIS zff_atsys._.iSignale._.obj.sig_m_t8 UMR_NM__6_1_M34_S5_S3 4 -204 1326 DEPOSIT ABSOLUTE /end AXIS_DESCR
/end CHARACTERISTIC
/begin CHARACTERISTIC KL_POHKABSP53 "Druckoffset waehrend Haltedruckphase" CURVE 0x1BACC4 ZF_kl_si16_S5_S3 12.75 UMR_BAR__1_1000_0_S5_S3 -6.4 6.35
 /begin AXIS_DESCR STD_AXIS zff_atsys._.iSignale._.obj.sig_m_t8 UMR_NM__6_1_M34_S5_S3 4 -204 1326 DEPOSIT ABSOLUTE /end AXIS_DESCR
/end CHARACTERISTIC
/begin CHARACTERISTIC KL_POHKABSP54 "Druckoffset waehrend Haltedruckphase" CURVE 0x1BA0BC ZF_kl_si16_S5_S3 12.75 UMR_BAR__1_1000_0_S5_S3 -6.4 6.35
 /begin AXIS_DESCR STD_AXIS zff_atsys._.iSignale._.obj.sig_m_t8 UMR_NM__6_1_M34_S5_S3 4 -204 1326 DEPOSIT ABSOLUTE /end AXIS_DESCR
/end CHARACTERISTIC
/begin CHARACTERISTIC KL_POHKABSP63 "Druckoffset waehrend Haltedruckphase" CURVE 0x1BAE7C ZF_kl_si16_S5_S3 12.75 UMR_BAR__1_1000_0_S5_S3 -6.4 6.35
 /begin AXIS_DESCR STD_AXIS zff_atsys._.iSignale._.obj.sig_m_t8 UMR_NM__6_1_M34_S5_S3 4 -204 1326 DEPOSIT ABSOLUTE /end AXIS_DESCR
/end CHARACTERISTIC
/begin CHARACTERISTIC KL_POHKABSP64 "Druckoffset waehrend Haltedruckphase" CURVE 0x1BB034 ZF_kl_si16_S5_S3 12.75 UMR_BAR__1_1000_0_S5_S3 -6.4 6.35
 /begin AXIS_DESCR STD_AXIS zff_atsys._.iSignale._.obj.sig_m_t8 UMR_NM__6_1_M34_S5_S3 4 -204 1326 DEPOSIT ABSOLUTE /end AXIS_DESCR
/end CHARACTERISTIC
/begin CHARACTERISTIC KL_POHKABSP65 "Druckoffset waehrend Haltedruckphase" CURVE 0x1BA274 ZF_kl_si16_S5_S3 12.75 UMR_BAR__1_1000_0_S5_S3 -6.4 6.35
 /begin AXIS_DESCR STD_AXIS zff_atsys._.iSignale._.obj.sig_m_t8 UMR_NM__6_1_M34_S5_S3 4 -204 1326 DEPOSIT ABSOLUTE /end AXIS_DESCR
/end CHARACTERISTIC
/begin CHARACTERISTIC KL_POHKABSP71 "Druckoffset waehrend Haltedruckphase" CURVE 0x1BB1EC ZF_kl_si16_S5_S3 12.75 UMR_BAR__1_1000_0_S5_S3 -6.4 6.35
 /begin AXIS_DESCR STD_AXIS zff_atsys._.iSignale._.obj.sig_m_t8 UMR_NM__6_1_M34_S5_S3 4 -204 1326 DEPOSIT ABSOLUTE /end AXIS_DESCR
/end CHARACTERISTIC
/begin CHARACTERISTIC KL_POHKABSP75 "Druckoffset waehrend Haltedruckphase" CURVE 0x1BB3A4 ZF_kl_si16_S5_S3 12.75 UMR_BAR__1_1000_0_S5_S3 -6.4 6.35
 /begin AXIS_DESCR STD_AXIS zff_atsys._.iSignale._.obj.sig_m_t8 UMR_NM__6_1_M34_S5_S3 4 -204 1326 DEPOSIT ABSOLUTE /end AXIS_DESCR
/end CHARACTERISTIC
/begin CHARACTERISTIC KL_POHKABSP76 "Druckoffset waehrend Haltedruckphase" CURVE 0x1BA42C ZF_kl_si16_S5_S3 12.75 UMR_BAR__1_1000_0_S5_S3 -6.4 6.35
 /begin AXIS_DESCR STD_AXIS zff_atsys._.iSignale._.obj.sig_m_t8 UMR_NM__6_1_M34_S5_S3 4 -204 1326 DEPOSIT ABSOLUTE /end AXIS_DESCR
/end CHARACTERISTIC
/begin CHARACTERISTIC KL_POHKABSP82 "Druckoffset waehrend Haltedruckphase" CURVE 0x1BB55C ZF_kl_si16_S5_S3 12.75 UMR_BAR__1_1000_0_S5_S3 -6.4 6.35
 /begin AXIS_DESCR STD_AXIS zff_atsys._.iSignale._.obj.sig_m_t8 UMR_NM__6_1_M34_S5_S3 4 -204 1326 DEPOSIT ABSOLUTE /end AXIS_DESCR
/end CHARACTERISTIC
/begin CHARACTERISTIC KL_POHKABSP84 "Druckoffset waehrend Haltedruckphase" CURVE 0x1BB714 ZF_kl_si16_S5_S3 12.75 UMR_BAR__1_1000_0_S5_S3 -6.4 6.35
 /begin AXIS_DESCR STD_AXIS zff_atsys._.iSignale._.obj.sig_m_t8 UMR_NM__6_1_M34_S5_S3 4 -204 1326 DEPOSIT ABSOLUTE /end AXIS_DESCR
/end CHARACTERISTIC
/begin CHARACTERISTIC KL_POHKABSP86 "Druckoffset waehrend Haltedruckphase" CURVE 0x1BB8CC ZF_kl_si16_S5_S3 12.75 UMR_BAR__1_1000_0_S5_S3 -6.4 6.35
 /begin AXIS_DESCR STD_AXIS zff_atsys._.iSignale._.obj.sig_m_t8 UMR_NM__6_1_M34_S5_S3 4 -204 1326 DEPOSIT ABSOLUTE /end AXIS_DESCR
/end CHARACTERISTIC
/begin CHARACTERISTIC KL_POHKABSP87 "Druckoffset waehrend Haltedruckphase" CURVE 0x1BA5E4 ZF_kl_si16_S5_S3 12.75 UMR_BAR__1_1000_0_S5_S3 -6.4 6.35
 /begin AXIS_DESCR STD_AXIS zff_atsys._.iSignale._.obj.sig_m_t8 UMR_NM__6_1_M34_S5_S3 4 -204 1326 DEPOSIT ABSOLUTE /end AXIS_DESCR
/end CHARACTERISTIC
/begin CHARACTERISTIC KL_POHKABSPORT21 "Druckoffset waehrend Haltedruckphase" CURVE 0x1BBA84 ZF_kl_si16_S5_S3 12.75 UMR_BAR__1_1000_0_S5_S3 -6.4 6.35
 /begin AXIS_DESCR STD_AXIS zff_atsys._.iSignale._.obj.sig_m_t8 UMR_NM__6_1_M34_S5_S3 4 -204 1326 DEPOSIT ABSOLUTE /end AXIS_DESCR
/end CHARACTERISTIC
/begin CHARACTERISTIC KL_POHKABSPORT31 "Druckoffset waehrend Haltedruckphase" CURVE 0x1BC68C ZF_kl_si16_S5_S3 12.75 UMR_BAR__1_1000_0_S5_S3 -6.4 6.35
 /begin AXIS_DESCR STD_AXIS zff_atsys._.iSignale._.obj.sig_m_t8 UMR_NM__6_1_M34_S5_S3 4 -204 1326 DEPOSIT ABSOLUTE /end AXIS_DESCR
/end CHARACTERISTIC
/begin CHARACTERISTIC KL_POHKABSPORT32 "Druckoffset waehrend Haltedruckphase" CURVE 0x1BBC3C ZF_kl_si16_S5_S3 12.75 UMR_BAR__1_1000_0_S5_S3 -6.4 6.35
 /begin AXIS_DESCR STD_AXIS zff_atsys._.iSignale._.obj.sig_m_t8 UMR_NM__6_1_M34_S5_S3 4 -204 1326 DEPOSIT ABSOLUTE /end AXIS_DESCR
/end CHARACTERISTIC
/begin CHARACTERISTIC KL_POHKABSPORT42 "Druckoffset waehrend Haltedruckphase" CURVE 0x1BC844 ZF_kl_si16_S5_S3 12.75 UMR_BAR__1_1000_0_S5_S3 -6.4 6.35
 /begin AXIS_DESCR STD_AXIS zff_atsys._.iSignale._.obj.sig_m_t8 UMR_NM__6_1_M34_S5_S3 4 -204 1326 DEPOSIT ABSOLUTE /end AXIS_DESCR
/end CHARACTERISTIC
/begin CHARACTERISTIC KL_POHKABSPORT43 "Druckoffset waehrend Haltedruckphase" CURVE 0x1BBDF4 ZF_kl_si16_S5_S3 12.75 UMR_BAR__1_1000_0_S5_S3 -6.4 6.35
 /begin AXIS_DESCR STD_AXIS zff_atsys._.iSignale._.obj.sig_m_t8 UMR_NM__6_1_M34_S5_S3 4 -204 1326 DEPOSIT ABSOLUTE /end AXIS_DESCR
/end CHARACTERISTIC
/begin CHARACTERISTIC KL_POHKABSPORT51 "Druckoffset waehrend Haltedruckphase" CURVE 0x1BC9FC ZF_kl_si16_S5_S3 12.75 UMR_BAR__1_1000_0_S5_S3 -6.4 6.35
 /begin AXIS_DESCR STD_AXIS zff_atsys._.iSignale._.obj.sig_m_t8 UMR_NM__6_1_M34_S5_S3 4 -204 1326 DEPOSIT ABSOLUTE /end AXIS_DESCR
/end CHARACTERISTIC
/begin CHARACTERISTIC KL_POHKABSPORT53 "Druckoffset waehrend Haltedruckphase" CURVE 0x1BCBB4 ZF_kl_si16_S5_S3 12.75 UMR_BAR__1_1000_0_S5_S3 -6.4 6.35
 /begin AXIS_DESCR STD_AXIS zff_atsys._.iSignale._.obj.sig_m_t8 UMR_NM__6_1_M34_S5_S3 4 -204 1326 DEPOSIT ABSOLUTE /end AXIS_DESCR
/end CHARACTERISTIC
/begin CHARACTERISTIC KL_POHKABSPORT54 "Druckoffset waehrend Haltedruckphase" CURVE 0x1BBFAC ZF_kl_si16_S5_S3 12.75 UMR_BAR__1_1000_0_S5_S3 -6.4 6.35
 /begin AXIS_DESCR STD_AXIS zff_atsys._.iSignale._.obj.sig_m_t8 UMR_NM__6_1_M34_S5_S3 4 -204 1326 DEPOSIT ABSOLUTE /end AXIS_DESCR
/end CHARACTERISTIC
/begin CHARACTERISTIC KL_POHKABSPORT63 "Druckoffset waehrend Haltedruckphase" CURVE 0x1BCD6C ZF_kl_si16_S5_S3 12.75 UMR_BAR__1_1000_0_S5_S3 -6.4 6.35
 /begin AXIS_DESCR STD_AXIS zff_atsys._.iSignale._.obj.sig_m_t8 UMR_NM__6_1_M34_S5_S3 4 -204 1326 DEPOSIT ABSOLUTE /end AXIS_DESCR
/end CHARACTERISTIC
/begin CHARACTERISTIC KL_POHKABSPORT64 "Druckoffset waehrend Haltedruckphase" CURVE 0x1BCF24 ZF_kl_si16_S5_S3 12.75 UMR_BAR__1_1000_0_S5_S3 -6.4 6.35
 /begin AXIS_DESCR STD_AXIS zff_atsys._.iSignale._.obj.sig_m_t8 UMR_NM__6_1_M34_S5_S3 4 -204 1326 DEPOSIT ABSOLUTE /end AXIS_DESCR
/end CHARACTERISTIC
/begin CHARACTERISTIC KL_POHKABSPORT65 "Druckoffset waehrend Haltedruckphase" CURVE 0x1BC164 ZF_kl_si16_S5_S3 12.75 UMR_BAR__1_1000_0_S5_S3 -6.4 6.35
 /begin AXIS_DESCR STD_AXIS zff_atsys._.iSignale._.obj.sig_m_t8 UMR_NM__6_1_M34_S5_S3 4 -204 1326 DEPOSIT ABSOLUTE /end AXIS_DESCR
/end CHARACTERISTIC
/begin CHARACTERISTIC KL_POHKABSPORT71 "Druckoffset waehrend Haltedruckphase" CURVE 0x1BD0DC ZF_kl_si16_S5_S3 12.75 UMR_BAR__1_1000_0_S5_S3 -6.4 6.35
 /begin AXIS_DESCR STD_AXIS zff_atsys._.iSignale._.obj.sig_m_t8 UMR_NM__6_1_M34_S5_S3 4 -204 1326 DEPOSIT ABSOLUTE /end AXIS_DESCR
/end CHARACTERISTIC
/begin CHARACTERISTIC KL_POHKABSPORT75 "Druckoffset waehrend Haltedruckphase" CURVE 0x1BD294 ZF_kl_si16_S5_S3 12.75 UMR_BAR__1_1000_0_S5_S3 -6.4 6.35
 /begin AXIS_DESCR STD_AXIS zff_atsys._.iSignale._.obj.sig_m_t8 UMR_NM__6_1_M34_S5_S3 4 -204 1326 DEPOSIT ABSOLUTE /end AXIS_DESCR
/end CHARACTERISTIC
/begin CHARACTERISTIC KL_POHKABSPORT76 "Druckoffset waehrend Haltedruckphase" CURVE 0x1BC31C ZF_kl_si16_S5_S3 12.75 UMR_BAR__1_1000_0_S5_S3 -6.4 6.35
 /begin AXIS_DESCR STD_AXIS zff_atsys._.iSignale._.obj.sig_m_t8 UMR_NM__6_1_M34_S5_S3 4 -204 1326 DEPOSIT ABSOLUTE /end AXIS_DESCR
/end CHARACTERISTIC
/begin CHARACTERISTIC KL_POHKABSPORT82 "Druckoffset waehrend Haltedruckphase" CURVE 0x1BD44C ZF_kl_si16_S5_S3 12.75 UMR_BAR__1_1000_0_S5_S3 -6.4 6.35
 /begin AXIS_DESCR STD_AXIS zff_atsys._.iSignale._.obj.sig_m_t8 UMR_NM__6_1_M34_S5_S3 4 -204 1326 DEPOSIT ABSOLUTE /end AXIS_DESCR
/end CHARACTERISTIC
/begin CHARACTERISTIC KL_POKABCGSPORT12 "Temp. abhängiger Druckoffset auf Schaltdruck KAB fuer HS" CURVE 0x1B7C1C ZF_kl_si16_S5_S3 2.5 UMR_BAR__1_1000_0_S5_S3 -1.25 1.25
 /begin AXIS_DESCR STD_AXIS zff_atsys._.iSignale._.obj.sig_c_getr UMR_GRADC__1_1_M40_S5_S3 3 -40 150 DEPOSIT ABSOLUTE /end AXIS_DESCR
/end CHARACTERISTIC
/begin CHARACTERISTIC KL_POKABCGSPORT23 "Temp. abhängiger Druckoffset auf Schaltdruck KAB fuer HS" CURVE 0x1B7D14 ZF_kl_si16_S5_S3 2.5 UMR_BAR__1_1000_0_S5_S3 -1.25 1.25
 /begin AXIS_DESCR STD_AXIS zff_atsys._.iSignale._.obj.sig_c_getr UMR_GRADC__1_1_M40_S5_S3 3 -40 150 DEPOSIT ABSOLUTE /end AXIS_DESCR
/end CHARACTERISTIC
/begin CHARACTERISTIC KL_POKABCGSPORT34 "Temp. abhängiger Druckoffset auf Schaltdruck KAB fuer HS" CURVE 0x1B7E0C ZF_kl_si16_S5_S3 2.5 UMR_BAR__1_1000_0_S5_S3 -1.25 1.25
 /begin AXIS_DESCR STD_AXIS zff_atsys._.iSignale._.obj.sig_c_getr UMR_GRADC__1_1_M40_S5_S3 3 -40 150 DEPOSIT ABSOLUTE /end AXIS_DESCR
/end CHARACTERISTIC
/begin CHARACTERISTIC KL_POKABCGSPORT45 "Temp. abhängiger Druckoffset auf Schaltdruck KAB fuer HS" CURVE 0x1B7F04 ZF_kl_si16_S5_S3 2.5 UMR_BAR__1_1000_0_S5_S3 -1.25 1.25
 /begin AXIS_DESCR STD_AXIS zff_atsys._.iSignale._.obj.sig_c_getr UMR_GRADC__1_1_M40_S5_S3 3 -40 150 DEPOSIT ABSOLUTE /end AXIS_DESCR
/end CHARACTERISTIC
/begin CHARACTERISTIC KL_POKABCGSPORT56 "Temp. abhängiger Druckoffset auf Schaltdruck KAB fuer HS" CURVE 0x1B7FFC ZF_kl_si16_S5_S3 2.5 UMR_BAR__1_1000_0_S5_S3 -1.25 1.25
 /begin AXIS_DESCR STD_AXIS zff_atsys._.iSignale._.obj.sig_c_getr UMR_GRADC__1_1_M40_S5_S3 3 -40 150 DEPOSIT ABSOLUTE /end AXIS_DESCR
/end CHARACTERISTIC
/begin CHARACTERISTIC KL_POKABCGSPORT67 "Temp. abhängiger Druckoffset auf Schaltdruck KAB fuer HS" CURVE 0x1B80F4 ZF_kl_si16_S5_S3 2.5 UMR_BAR__1_1000_0_S5_S3 -1.25 1.25
 /begin AXIS_DESCR STD_AXIS zff_atsys._.iSignale._.obj.sig_c_getr UMR_GRADC__1_1_M40_S5_S3 3 -40 150 DEPOSIT ABSOLUTE /end AXIS_DESCR
/end CHARACTERISTIC
/begin CHARACTERISTIC KL_POKABCGSPORT78 "Temp. abhängiger Druckoffset auf Schaltdruck KAB fuer HS" CURVE 0x1B81EC ZF_kl_si16_S5_S3 2.5 UMR_BAR__1_1000_0_S5_S3 -1.25 1.25
 /begin AXIS_DESCR STD_AXIS zff_atsys._.iSignale._.obj.sig_c_getr UMR_GRADC__1_1_M40_S5_S3 3 -40 150 DEPOSIT ABSOLUTE /end AXIS_DESCR
/end CHARACTERISTIC
/begin CHARACTERISTIC KL_TOPKABNDSPORT12 "Zeitoffset f(nd_synistgang) Ende Rampe auf Schaltdruck KAB fuer HS" CURVE 0x1B7B8C ZF_kl_si16_S5_S3 1000 UMR_MSEC__10_1_0_S5_S3 0 1000
 /begin AXIS_DESCR STD_AXIS iSasZentr.iSchaltend.nd_synistgang UMR_U_MIN_1_1_0_S5_S3 4 -8000 8000 DEPOSIT ABSOLUTE /end AXIS_DESCR
/end CHARACTERISTIC
/begin CHARACTERISTIC KL_TOPKABNDSPORT23 "Zeitoffset f(nd_synistgang) Ende Rampe auf Schaltdruck KAB fuer HS" CURVE 0x1B7C84 ZF_kl_si16_S5_S3 1000 UMR_MSEC__10_1_0_S5_S3 0 1000
 /begin AXIS_DESCR STD_AXIS iSasZentr.iSchaltend.nd_synistgang UMR_U_MIN_1_1_0_S5_S3 4 -8000 8000 DEPOSIT ABSOLUTE /end AXIS_DESCR
/end CHARACTERISTIC
/begin CHARACTERISTIC KL_TOPKABNDSPORT34 "Zeitoffset f(nd_synistgang) Ende Rampe auf Schaltdruck KAB fuer HS" CURVE 0x1B7D7C ZF_kl_si16_S5_S3 1000 UMR_MSEC__10_1_0_S5_S3 0 1000
 /begin AXIS_DESCR STD_AXIS iSasZentr.iSchaltend.nd_synistgang UMR_U_MIN_1_1_0_S5_S3 4 -8000 8000 DEPOSIT ABSOLUTE /end AXIS_DESCR
/end CHARACTERISTIC
/begin CHARACTERISTIC KL_TOPKABNDSPORT45 "Zeitoffset f(nd_synistgang) Ende Rampe auf Schaltdruck KAB fuer HS" CURVE 0x1B7E74 ZF_kl_si16_S5_S3 1000 UMR_MSEC__10_1_0_S5_S3 0 1000
 /begin AXIS_DESCR STD_AXIS iSasZentr.iSchaltend.nd_synistgang UMR_U_MIN_1_1_0_S5_S3 4 -8000 8000 DEPOSIT ABSOLUTE /end AXIS_DESCR
/end CHARACTERISTIC
/begin CHARACTERISTIC KL_TOPKABNDSPORT56 "Zeitoffset f(nd_synistgang) Ende Rampe auf Schaltdruck KAB fuer HS" CURVE 0x1B7F6C ZF_kl_si16_S5_S3 1000 UMR_MSEC__10_1_0_S5_S3 0 1000
 /begin AXIS_DESCR STD_AXIS iSasZentr.iSchaltend.nd_synistgang UMR_U_MIN_1_1_0_S5_S3 4 -8000 8000 DEPOSIT ABSOLUTE /end AXIS_DESCR
/end CHARACTERISTIC
/begin CHARACTERISTIC KL_TOPKABNDSPORT67 "Zeitoffset f(nd_synistgang) Ende Rampe auf Schaltdruck KAB fuer HS" CURVE 0x1B8064 ZF_kl_si16_S5_S3 1000 UMR_MSEC__10_1_0_S5_S3 0 1000
 /begin AXIS_DESCR STD_AXIS iSasZentr.iSchaltend.nd_synistgang UMR_U_MIN_1_1_0_S5_S3 4 -8000 8000 DEPOSIT ABSOLUTE /end AXIS_DESCR
/end CHARACTERISTIC
/begin CHARACTERISTIC KL_TOPKABNDSPORT78 "Zeitoffset f(nd_synistgang) Ende Rampe auf Schaltdruck KAB fuer HS" CURVE 0x1B815C ZF_kl_si16_S5_S3 1000 UMR_MSEC__10_1_0_S5_S3 0 1000
 /begin AXIS_DESCR STD_AXIS iSasZentr.iSchaltend.nd_synistgang UMR_U_MIN_1_1_0_S5_S3 4 -8000 8000 DEPOSIT ABSOLUTE /end AXIS_DESCR
/end CHARACTERISTIC
/begin CHARACTERISTIC KL_TRAHKAB21 "Zeit fuer Rampe auf Schaltdruck" CURVE 0x1B87B8 ZF_kl_ui8_S5_S3 2540 UMR_MSEC__10_1_0_S5_S3 0 2540
 /begin AXIS_DESCR STD_AXIS zff_atsys._.iSignale._.obj.sig_m_t8 UMR_NM__6_1_M34_S5_S3 4 -204 1326 DEPOSIT ABSOLUTE /end AXIS_DESCR
/end CHARACTERISTIC
/begin CHARACTERISTIC KL_TRAHKAB21_EL "Zeit fuer Rampe auf Schaltdruck" CURVE 0x1B87C4 ZF_kl_ui8_S5_S3 2540 UMR_MSEC__10_1_0_S5_S3 0 2540
 /begin AXIS_DESCR STD_AXIS zff_atsys._.iSignale._.obj.sig_m_t8 UMR_NM__6_1_M34_S5_S3 4 -204 1326 DEPOSIT ABSOLUTE /end AXIS_DESCR
/end CHARACTERISTIC
/begin CHARACTERISTIC KL_TRAHKAB32 "Zeit fuer Rampe auf Schaltdruck" CURVE 0x1B8A94 ZF_kl_ui8_S5_S3 2540 UMR_MSEC__10_1_0_S5_S3 0 2540
 /begin AXIS_DESCR STD_AXIS zff_atsys._.iSignale._.obj.sig_m_t8 UMR_NM__6_1_M34_S5_S3 4 -204 1326 DEPOSIT ABSOLUTE /end AXIS_DESCR
/end CHARACTERISTIC
/begin CHARACTERISTIC KL_TRAHKAB32_EL "Zeit fuer Rampe auf Schaltdruck" CURVE 0x1B8AA0 ZF_kl_ui8_S5_S3 2540 UMR_MSEC__10_1_0_S5_S3 0 2540
 /begin AXIS_DESCR STD_AXIS zff_atsys._.iSignale._.obj.sig_m_t8 UMR_NM__6_1_M34_S5_S3 4 -204 1326 DEPOSIT ABSOLUTE /end AXIS_DESCR
/end CHARACTERISTIC
/begin CHARACTERISTIC KL_TRAHKAB43 "Zeit fuer Rampe auf Schaltdruck" CURVE 0x1B8D70 ZF_kl_ui8_S5_S3 2540 UMR_MSEC__10_1_0_S5_S3 0 2540
 /begin AXIS_DESCR STD_AXIS zff_atsys._.iSignale._.obj.sig_m_t8 UMR_NM__6_1_M34_S5_S3 4 -204 1326 DEPOSIT ABSOLUTE /end AXIS_DESCR
/end CHARACTERISTIC
/begin CHARACTERISTIC KL_TRAHKAB43_EL "Zeit fuer Rampe auf Schaltdruck" CURVE 0x1B8D7C ZF_kl_ui8_S5_S3 2540 UMR_MSEC__10_1_0_S5_S3 0 2540
 /begin AXIS_DESCR STD_AXIS zff_atsys._.iSignale._.obj.sig_m_t8 UMR_NM__6_1_M34_S5_S3 4 -204 1326 DEPOSIT ABSOLUTE /end AXIS_DESCR
/end CHARACTERISTIC
/begin CHARACTERISTIC KL_TRAHKAB54 "Zeit fuer Rampe auf Schaltdruck" CURVE 0x1B904C ZF_kl_ui8_S5_S3 2540 UMR_MSEC__10_1_0_S5_S3 0 2540
 /begin AXIS_DESCR STD_AXIS zff_atsys._.iSignale._.obj.sig_m_t8 UMR_NM__6_1_M34_S5_S3 4 -204 1326 DEPOSIT ABSOLUTE /end AXIS_DESCR
/end CHARACTERISTIC
/begin CHARACTERISTIC KL_TRAHKAB54_EL "Zeit fuer Rampe auf Schaltdruck" CURVE 0x1B9058 ZF_kl_ui8_S5_S3 2540 UMR_MSEC__10_1_0_S5_S3 0 2540
 /begin AXIS_DESCR STD_AXIS zff_atsys._.iSignale._.obj.sig_m_t8 UMR_NM__6_1_M34_S5_S3 4 -204 1326 DEPOSIT ABSOLUTE /end AXIS_DESCR
/end CHARACTERISTIC
/begin CHARACTERISTIC KL_TRAHKAB65 "Zeit fuer Rampe auf Schaltdruck" CURVE 0x1B9328 ZF_kl_ui8_S5_S3 2540 UMR_MSEC__10_1_0_S5_S3 0 2540
 /begin AXIS_DESCR STD_AXIS zff_atsys._.iSignale._.obj.sig_m_t8 UMR_NM__6_1_M34_S5_S3 4 -204 1326 DEPOSIT ABSOLUTE /end AXIS_DESCR
/end CHARACTERISTIC
/begin CHARACTERISTIC KL_TRAHKAB65_EL "Zeit fuer Rampe auf Schaltdruck" CURVE 0x1B9334 ZF_kl_ui8_S5_S3 2540 UMR_MSEC__10_1_0_S5_S3 0 2540
 /begin AXIS_DESCR STD_AXIS zff_atsys._.iSignale._.obj.sig_m_t8 UMR_NM__6_1_M34_S5_S3 4 -204 1326 DEPOSIT ABSOLUTE /end AXIS_DESCR
/end CHARACTERISTIC
/begin CHARACTERISTIC KL_TRAHKAB76 "Zeit fuer Rampe auf Schaltdruck" CURVE 0x1B9604 ZF_kl_ui8_S5_S3 2540 UMR_MSEC__10_1_0_S5_S3 0 2540
 /begin AXIS_DESCR STD_AXIS zff_atsys._.iSignale._.obj.sig_m_t8 UMR_NM__6_1_M34_S5_S3 4 -204 1326 DEPOSIT ABSOLUTE /end AXIS_DESCR
/end CHARACTERISTIC
/begin CHARACTERISTIC KL_TRAHKAB76_EL "Zeit fuer Rampe auf Schaltdruck" CURVE 0x1B9610 ZF_kl_ui8_S5_S3 2540 UMR_MSEC__10_1_0_S5_S3 0 2540
 /begin AXIS_DESCR STD_AXIS zff_atsys._.iSignale._.obj.sig_m_t8 UMR_NM__6_1_M34_S5_S3 4 -204 1326 DEPOSIT ABSOLUTE /end AXIS_DESCR
/end CHARACTERISTIC
/begin CHARACTERISTIC KL_TRAHKAB87 "Zeit fuer Rampe auf Schaltdruck" CURVE 0x1B98E0 ZF_kl_ui8_S5_S3 2540 UMR_MSEC__10_1_0_S5_S3 0 2540
 /begin AXIS_DESCR STD_AXIS zff_atsys._.iSignale._.obj.sig_m_t8 UMR_NM__6_1_M34_S5_S3 4 -204 1326 DEPOSIT ABSOLUTE /end AXIS_DESCR
/end CHARACTERISTIC
/begin CHARACTERISTIC KL_TRAHKAB87_EL "Zeit fuer Rampe auf Schaltdruck" CURVE 0x1B98EC ZF_kl_ui8_S5_S3 2540 UMR_MSEC__10_1_0_S5_S3 0 2540
 /begin AXIS_DESCR STD_AXIS zff_atsys._.iSignale._.obj.sig_m_t8 UMR_NM__6_1_M34_S5_S3 4 -204 1326 DEPOSIT ABSOLUTE /end AXIS_DESCR
/end CHARACTERISTIC
/begin CHARACTERISTIC KL_TRAHKABSP21 "Zeit fuer Rampe auf Schaltdruck" CURVE 0x1B9BA8 ZF_kl_ui8_S5_S3 2540 UMR_MSEC__10_1_0_S5_S3 0 2540
 /begin AXIS_DESCR STD_AXIS zff_atsys._.iSignale._.obj.sig_m_t8 UMR_NM__6_1_M34_S5_S3 4 -204 1326 DEPOSIT ABSOLUTE /end AXIS_DESCR
/end CHARACTERISTIC
/begin CHARACTERISTIC KL_TRAHKABSP31 "Zeit fuer Rampe auf Schaltdruck" CURVE 0x1BA7B0 ZF_kl_ui8_S5_S3 2540 UMR_MSEC__10_1_0_S5_S3 0 2540
 /begin AXIS_DESCR STD_AXIS zff_atsys._.iSignale._.obj.sig_m_t8 UMR_NM__6_1_M34_S5_S3 4 -204 1326 DEPOSIT ABSOLUTE /end AXIS_DESCR
/end CHARACTERISTIC
/begin CHARACTERISTIC KL_TRAHKABSP32 "Zeit fuer Rampe auf Schaltdruck" CURVE 0x1B9D60 ZF_kl_ui8_S5_S3 2540 UMR_MSEC__10_1_0_S5_S3 0 2540
 /begin AXIS_DESCR STD_AXIS zff_atsys._.iSignale._.obj.sig_m_t8 UMR_NM__6_1_M34_S5_S3 4 -204 1326 DEPOSIT ABSOLUTE /end AXIS_DESCR
/end CHARACTERISTIC
/begin CHARACTERISTIC KL_TRAHKABSP42 "Zeit fuer Rampe auf Schaltdruck" CURVE 0x1BA968 ZF_kl_ui8_S5_S3 2540 UMR_MSEC__10_1_0_S5_S3 0 2540
 /begin AXIS_DESCR STD_AXIS zff_atsys._.iSignale._.obj.sig_m_t8 UMR_NM__6_1_M34_S5_S3 4 -204 1326 DEPOSIT ABSOLUTE /end AXIS_DESCR
/end CHARACTERISTIC
/begin CHARACTERISTIC KL_TRAHKABSP43 "Zeit fuer Rampe auf Schaltdruck" CURVE 0x1B9F18 ZF_kl_ui8_S5_S3 2540 UMR_MSEC__10_1_0_S5_S3 0 2540
 /begin AXIS_DESCR STD_AXIS zff_atsys._.iSignale._.obj.sig_m_t8 UMR_NM__6_1_M34_S5_S3 4 -204 1326 DEPOSIT ABSOLUTE /end AXIS_DESCR
/end CHARACTERISTIC
/begin CHARACTERISTIC KL_TRAHKABSP51 "Zeit fuer Rampe auf Schaltdruck" CURVE 0x1BAB20 ZF_kl_ui8_S5_S3 2540 UMR_MSEC__10_1_0_S5_S3 0 2540
 /begin AXIS_DESCR STD_AXIS zff_atsys._.iSignale._.obj.sig_m_t8 UMR_NM__6_1_M34_S5_S3 4 -204 1326 DEPOSIT ABSOLUTE /end AXIS_DESCR
/end CHARACTERISTIC
/begin CHARACTERISTIC KL_TRAHKABSP53 "Zeit fuer Rampe auf Schaltdruck" CURVE 0x1BACD8 ZF_kl_ui8_S5_S3 2540 UMR_MSEC__10_1_0_S5_S3 0 2540
 /begin AXIS_DESCR STD_AXIS zff_atsys._.iSignale._.obj.sig_m_t8 UMR_NM__6_1_M34_S5_S3 4 -204 1326 DEPOSIT ABSOLUTE /end AXIS_DESCR
/end CHARACTERISTIC
/begin CHARACTERISTIC KL_TRAHKABSP54 "Zeit fuer Rampe auf Schaltdruck" CURVE 0x1BA0D0 ZF_kl_ui8_S5_S3 2540 UMR_MSEC__10_1_0_S5_S3 0 2540
 /begin AXIS_DESCR STD_AXIS zff_atsys._.iSignale._.obj.sig_m_t8 UMR_NM__6_1_M34_S5_S3 4 -204 1326 DEPOSIT ABSOLUTE /end AXIS_DESCR
/end CHARACTERISTIC
/begin CHARACTERISTIC KL_TRAHKABSP63 "Zeit fuer Rampe auf Schaltdruck" CURVE 0x1BAE90 ZF_kl_ui8_S5_S3 2540 UMR_MSEC__10_1_0_S5_S3 0 2540
 /begin AXIS_DESCR STD_AXIS zff_atsys._.iSignale._.obj.sig_m_t8 UMR_NM__6_1_M34_S5_S3 4 -204 1326 DEPOSIT ABSOLUTE /end AXIS_DESCR
/end CHARACTERISTIC
/begin CHARACTERISTIC KL_TRAHKABSP64 "Zeit fuer Rampe auf Schaltdruck" CURVE 0x1BB048 ZF_kl_ui8_S5_S3 2540 UMR_MSEC__10_1_0_S5_S3 0 2540
 /begin AXIS_DESCR STD_AXIS zff_atsys._.iSignale._.obj.sig_m_t8 UMR_NM__6_1_M34_S5_S3 4 -204 1326 DEPOSIT ABSOLUTE /end AXIS_DESCR
/end CHARACTERISTIC
/begin CHARACTERISTIC KL_TRAHKABSP65 "Zeit fuer Rampe auf Schaltdruck" CURVE 0x1BA288 ZF_kl_ui8_S5_S3 2540 UMR_MSEC__10_1_0_S5_S3 0 2540
 /begin AXIS_DESCR STD_AXIS zff_atsys._.iSignale._.obj.sig_m_t8 UMR_NM__6_1_M34_S5_S3 4 -204 1326 DEPOSIT ABSOLUTE /end AXIS_DESCR
/end CHARACTERISTIC
/begin CHARACTERISTIC KL_TRAHKABSP71 "Zeit fuer Rampe auf Schaltdruck" CURVE 0x1BB200 ZF_kl_ui8_S5_S3 2540 UMR_MSEC__10_1_0_S5_S3 0 2540
 /begin AXIS_DESCR STD_AXIS zff_atsys._.iSignale._.obj.sig_m_t8 UMR_NM__6_1_M34_S5_S3 4 -204 1326 DEPOSIT ABSOLUTE /end AXIS_DESCR
/end CHARACTERISTIC
/begin CHARACTERISTIC KL_TRAHKABSP75 "Zeit fuer Rampe auf Schaltdruck" CURVE 0x1BB3B8 ZF_kl_ui8_S5_S3 2540 UMR_MSEC__10_1_0_S5_S3 0 2540
 /begin AXIS_DESCR STD_AXIS zff_atsys._.iSignale._.obj.sig_m_t8 UMR_NM__6_1_M34_S5_S3 4 -204 1326 DEPOSIT ABSOLUTE /end AXIS_DESCR
/end CHARACTERISTIC
/begin CHARACTERISTIC KL_TRAHKABSP76 "Zeit fuer Rampe auf Schaltdruck" CURVE 0x1BA440 ZF_kl_ui8_S5_S3 2540 UMR_MSEC__10_1_0_S5_S3 0 2540
 /begin AXIS_DESCR STD_AXIS zff_atsys._.iSignale._.obj.sig_m_t8 UMR_NM__6_1_M34_S5_S3 4 -204 1326 DEPOSIT ABSOLUTE /end AXIS_DESCR
/end CHARACTERISTIC
/begin CHARACTERISTIC KL_TRAHKABSP82 "Zeit fuer Rampe auf Schaltdruck" CURVE 0x1BB570 ZF_kl_ui8_S5_S3 2540 UMR_MSEC__10_1_0_S5_S3 0 2540
 /begin AXIS_DESCR STD_AXIS zff_atsys._.iSignale._.obj.sig_m_t8 UMR_NM__6_1_M34_S5_S3 4 -204 1326 DEPOSIT ABSOLUTE /end AXIS_DESCR
/end CHARACTERISTIC
/begin CHARACTERISTIC KL_TRAHKABSP84 "Zeit fuer Rampe auf Schaltdruck" CURVE 0x1BB728 ZF_kl_ui8_S5_S3 2540 UMR_MSEC__10_1_0_S5_S3 0 2540
 /begin AXIS_DESCR STD_AXIS zff_atsys._.iSignale._.obj.sig_m_t8 UMR_NM__6_1_M34_S5_S3 4 -204 1326 DEPOSIT ABSOLUTE /end AXIS_DESCR
/end CHARACTERISTIC
/begin CHARACTERISTIC KL_TRAHKABSP86 "Zeit fuer Rampe auf Schaltdruck" CURVE 0x1BB8E0 ZF_kl_ui8_S5_S3 2540 UMR_MSEC__10_1_0_S5_S3 0 2540
 /begin AXIS_DESCR STD_AXIS zff_atsys._.iSignale._.obj.sig_m_t8 UMR_NM__6_1_M34_S5_S3 4 -204 1326 DEPOSIT ABSOLUTE /end AXIS_DESCR
/end CHARACTERISTIC
/begin CHARACTERISTIC KL_TRAHKABSP87 "Zeit fuer Rampe auf Schaltdruck" CURVE 0x1BA5F8 ZF_kl_ui8_S5_S3 2540 UMR_MSEC__10_1_0_S5_S3 0 2540
 /begin AXIS_DESCR STD_AXIS zff_atsys._.iSignale._.obj.sig_m_t8 UMR_NM__6_1_M34_S5_S3 4 -204 1326 DEPOSIT ABSOLUTE /end AXIS_DESCR
/end CHARACTERISTIC
/begin CHARACTERISTIC KL_TRAHKABSPORT21 "Zeit fuer Rampe auf Schaltdruck" CURVE 0x1BBA98 ZF_kl_ui8_S5_S3 2540 UMR_MSEC__10_1_0_S5_S3 0 2540
 /begin AXIS_DESCR STD_AXIS zff_atsys._.iSignale._.obj.sig_m_t8 UMR_NM__6_1_M34_S5_S3 4 -204 1326 DEPOSIT ABSOLUTE /end AXIS_DESCR
/end CHARACTERISTIC
/begin CHARACTERISTIC KL_TRAHKABSPORT31 "Zeit fuer Rampe auf Schaltdruck" CURVE 0x1BC6A0 ZF_kl_ui8_S5_S3 2540 UMR_MSEC__10_1_0_S5_S3 0 2540
 /begin AXIS_DESCR STD_AXIS zff_atsys._.iSignale._.obj.sig_m_t8 UMR_NM__6_1_M34_S5_S3 4 -204 1326 DEPOSIT ABSOLUTE /end AXIS_DESCR
/end CHARACTERISTIC
/begin CHARACTERISTIC KL_TRAHKABSPORT32 "Zeit fuer Rampe auf Schaltdruck" CURVE 0x1BBC50 ZF_kl_ui8_S5_S3 2540 UMR_MSEC__10_1_0_S5_S3 0 2540
 /begin AXIS_DESCR STD_AXIS zff_atsys._.iSignale._.obj.sig_m_t8 UMR_NM__6_1_M34_S5_S3 4 -204 1326 DEPOSIT ABSOLUTE /end AXIS_DESCR
/end CHARACTERISTIC
/begin CHARACTERISTIC KL_TRAHKABSPORT42 "Zeit fuer Rampe auf Schaltdruck" CURVE 0x1BC858 ZF_kl_ui8_S5_S3 2540 UMR_MSEC__10_1_0_S5_S3 0 2540
 /begin AXIS_DESCR STD_AXIS zff_atsys._.iSignale._.obj.sig_m_t8 UMR_NM__6_1_M34_S5_S3 4 -204 1326 DEPOSIT ABSOLUTE /end AXIS_DESCR
/end CHARACTERISTIC
/begin CHARACTERISTIC KL_TRAHKABSPORT43 "Zeit fuer Rampe auf Schaltdruck" CURVE 0x1BBE08 ZF_kl_ui8_S5_S3 2540 UMR_MSEC__10_1_0_S5_S3 0 2540
 /begin AXIS_DESCR STD_AXIS zff_atsys._.iSignale._.obj.sig_m_t8 UMR_NM__6_1_M34_S5_S3 4 -204 1326 DEPOSIT ABSOLUTE /end AXIS_DESCR
/end CHARACTERISTIC
/begin CHARACTERISTIC KL_TRAHKABSPORT51 "Zeit fuer Rampe auf Schaltdruck" CURVE 0x1BCA10 ZF_kl_ui8_S5_S3 2540 UMR_MSEC__10_1_0_S5_S3 0 2540
 /begin AXIS_DESCR STD_AXIS zff_atsys._.iSignale._.obj.sig_m_t8 UMR_NM__6_1_M34_S5_S3 4 -204 1326 DEPOSIT ABSOLUTE /end AXIS_DESCR
/end CHARACTERISTIC
/begin CHARACTERISTIC KL_TRAHKABSPORT53 "Zeit fuer Rampe auf Schaltdruck" CURVE 0x1BCBC8 ZF_kl_ui8_S5_S3 2540 UMR_MSEC__10_1_0_S5_S3 0 2540
 /begin AXIS_DESCR STD_AXIS zff_atsys._.iSignale._.obj.sig_m_t8 UMR_NM__6_1_M34_S5_S3 4 -204 1326 DEPOSIT ABSOLUTE /end AXIS_DESCR
/end CHARACTERISTIC
/begin CHARACTERISTIC KL_TRAHKABSPORT54 "Zeit fuer Rampe auf Schaltdruck" CURVE 0x1BBFC0 ZF_kl_ui8_S5_S3 2540 UMR_MSEC__10_1_0_S5_S3 0 2540
 /begin AXIS_DESCR STD_AXIS zff_atsys._.iSignale._.obj.sig_m_t8 UMR_NM__6_1_M34_S5_S3 4 -204 1326 DEPOSIT ABSOLUTE /end AXIS_DESCR
/end CHARACTERISTIC
/begin CHARACTERISTIC KL_TRAHKABSPORT63 "Zeit fuer Rampe auf Schaltdruck" CURVE 0x1BCD80 ZF_kl_ui8_S5_S3 2540 UMR_MSEC__10_1_0_S5_S3 0 2540
 /begin AXIS_DESCR STD_AXIS zff_atsys._.iSignale._.obj.sig_m_t8 UMR_NM__6_1_M34_S5_S3 4 -204 1326 DEPOSIT ABSOLUTE /end AXIS_DESCR
/end CHARACTERISTIC
/begin CHARACTERISTIC KL_TRAHKABSPORT64 "Zeit fuer Rampe auf Schaltdruck" CURVE 0x1BCF38 ZF_kl_ui8_S5_S3 2540 UMR_MSEC__10_1_0_S5_S3 0 2540
 /begin AXIS_DESCR STD_AXIS zff_atsys._.iSignale._.obj.sig_m_t8 UMR_NM__6_1_M34_S5_S3 4 -204 1326 DEPOSIT ABSOLUTE /end AXIS_DESCR
/end CHARACTERISTIC
/begin CHARACTERISTIC KL_TRAHKABSPORT65 "Zeit fuer Rampe auf Schaltdruck" CURVE 0x1BC178 ZF_kl_ui8_S5_S3 2540 UMR_MSEC__10_1_0_S5_S3 0 2540
 /begin AXIS_DESCR STD_AXIS zff_atsys._.iSignale._.obj.sig_m_t8 UMR_NM__6_1_M34_S5_S3 4 -204 1326 DEPOSIT ABSOLUTE /end AXIS_DESCR
/end CHARACTERISTIC
/begin CHARACTERISTIC KL_TRAHKABSPORT71 "Zeit fuer Rampe auf Schaltdruck" CURVE 0x1BD0F0 ZF_kl_ui8_S5_S3 2540 UMR_MSEC__10_1_0_S5_S3 0 2540
 /begin AXIS_DESCR STD_AXIS zff_atsys._.iSignale._.obj.sig_m_t8 UMR_NM__6_1_M34_S5_S3 4 -204 1326 DEPOSIT ABSOLUTE /end AXIS_DESCR
/end CHARACTERISTIC
/begin CHARACTERISTIC KL_TRAHKABSPORT75 "Zeit fuer Rampe auf Schaltdruck" CURVE 0x1BD2A8 ZF_kl_ui8_S5_S3 2540 UMR_MSEC__10_1_0_S5_S3 0 2540
 /begin AXIS_DESCR STD_AXIS zff_atsys._.iSignale._.obj.sig_m_t8 UMR_NM__6_1_M34_S5_S3 4 -204 1326 DEPOSIT ABSOLUTE /end AXIS_DESCR
/end CHARACTERISTIC
/begin CHARACTERISTIC KL_TRAHKABSPORT76 "Zeit fuer Rampe auf Schaltdruck" CURVE 0x1BC330 ZF_kl_ui8_S5_S3 2540 UMR_MSEC__10_1_0_S5_S3 0 2540
 /begin AXIS_DESCR STD_AXIS zff_atsys._.iSignale._.obj.sig_m_t8 UMR_NM__6_1_M34_S5_S3 4 -204 1326 DEPOSIT ABSOLUTE /end AXIS_DESCR
/end CHARACTERISTIC
/begin CHARACTERISTIC KL_TRAHKABSPORT82 "Zeit fuer Rampe auf Schaltdruck" CURVE 0x1BD460 ZF_kl_ui8_S5_S3 2540 UMR_MSEC__10_1_0_S5_S3 0 2540
 /begin AXIS_DESCR STD_AXIS zff_atsys._.iSignale._.obj.sig_m_t8 UMR_NM__6_1_M34_S5_S3 4 -204 1326 DEPOSIT ABSOLUTE /end AXIS_DESCR
/end CHARACTERISTIC
/begin CHARACTERISTIC KL_TRAMTHINSYNKAB21 "Zeit fuer Abschalten KAB nach Haltephase in Synchron" CURVE 0x1B89F8 ZF_kl_ui8_S5_S3 2550 UMR_MSEC__10_1_0_S5_S3 0 2550
 /begin AXIS_DESCR STD_AXIS zff_atsys._.iSignale._.obj.sig_m_t8 UMR_NM__6_1_M34_S5_S3 4 -204 1326 DEPOSIT ABSOLUTE /end AXIS_DESCR
/end CHARACTERISTIC
/begin CHARACTERISTIC KL_TRAMTHINSYNKAB32 "Zeit fuer Abschalten KAB nach Haltephase in Synchron" CURVE 0x1B8CD4 ZF_kl_ui8_S5_S3 2550 UMR_MSEC__10_1_0_S5_S3 0 2550
 /begin AXIS_DESCR STD_AXIS zff_atsys._.iSignale._.obj.sig_m_t8 UMR_NM__6_1_M34_S5_S3 4 -204 1326 DEPOSIT ABSOLUTE /end AXIS_DESCR
/end CHARACTERISTIC
/begin CHARACTERISTIC KL_TRAMTHINSYNKAB43 "Zeit fuer Abschalten KAB nach Haltephase in Synchron" CURVE 0x1B8FB0 ZF_kl_ui8_S5_S3 2550 UMR_MSEC__10_1_0_S5_S3 0 2550
 /begin AXIS_DESCR STD_AXIS zff_atsys._.iSignale._.obj.sig_m_t8 UMR_NM__6_1_M34_S5_S3 4 -204 1326 DEPOSIT ABSOLUTE /end AXIS_DESCR
/end CHARACTERISTIC
/begin CHARACTERISTIC KL_TRAMTHINSYNKAB54 "Zeit fuer Abschalten KAB nach Haltephase in Synchron" CURVE 0x1B928C ZF_kl_ui8_S5_S3 2550 UMR_MSEC__10_1_0_S5_S3 0 2550
 /begin AXIS_DESCR STD_AXIS zff_atsys._.iSignale._.obj.sig_m_t8 UMR_NM__6_1_M34_S5_S3 4 -204 1326 DEPOSIT ABSOLUTE /end AXIS_DESCR
/end CHARACTERISTIC
/begin CHARACTERISTIC KL_TRAMTHINSYNKAB65 "Zeit fuer Abschalten KAB nach Haltephase in Synchron" CURVE 0x1B9568 ZF_kl_ui8_S5_S3 2550 UMR_MSEC__10_1_0_S5_S3 0 2550
 /begin AXIS_DESCR STD_AXIS zff_atsys._.iSignale._.obj.sig_m_t8 UMR_NM__6_1_M34_S5_S3 4 -204 1326 DEPOSIT ABSOLUTE /end AXIS_DESCR
/end CHARACTERISTIC
/begin CHARACTERISTIC KL_TRAMTHINSYNKAB76 "Zeit fuer Abschalten KAB nach Haltephase in Synchron" CURVE 0x1B9844 ZF_kl_ui8_S5_S3 2550 UMR_MSEC__10_1_0_S5_S3 0 2550
 /begin AXIS_DESCR STD_AXIS zff_atsys._.iSignale._.obj.sig_m_t8 UMR_NM__6_1_M34_S5_S3 4 -204 1326 DEPOSIT ABSOLUTE /end AXIS_DESCR
/end CHARACTERISTIC
/begin CHARACTERISTIC KL_TRAMTHINSYNKAB87 "Zeit fuer Abschalten KAB nach Haltephase in Synchron" CURVE 0x1B9B20 ZF_kl_ui8_S5_S3 2550 UMR_MSEC__10_1_0_S5_S3 0 2550
 /begin AXIS_DESCR STD_AXIS zff_atsys._.iSignale._.obj.sig_m_t8 UMR_NM__6_1_M34_S5_S3 4 -204 1326 DEPOSIT ABSOLUTE /end AXIS_DESCR
/end CHARACTERISTIC
/begin CHARACTERISTIC KL_TRAMTHINSYNKABSP21 "Zeit fuer Abschalten KAB nach Haltephase in Synchron" CURVE 0x1B9CD8 ZF_kl_ui8_S5_S3 2550 UMR_MSEC__10_1_0_S5_S3 0 2550
 /begin AXIS_DESCR STD_AXIS zff_atsys._.iSignale._.obj.sig_m_t8 UMR_NM__6_1_M34_S5_S3 4 -204 1326 DEPOSIT ABSOLUTE /end AXIS_DESCR
/end CHARACTERISTIC
/begin CHARACTERISTIC KL_TRAMTHINSYNKABSP31 "Zeit fuer Abschalten KAB nach Haltephase in Synchron" CURVE 0x1BA8E0 ZF_kl_ui8_S5_S3 2550 UMR_MSEC__10_1_0_S5_S3 0 2550
 /begin AXIS_DESCR STD_AXIS zff_atsys._.iSignale._.obj.sig_m_t8 UMR_NM__6_1_M34_S5_S3 4 -204 1326 DEPOSIT ABSOLUTE /end AXIS_DESCR
/end CHARACTERISTIC
/begin CHARACTERISTIC KL_TRAMTHINSYNKABSP32 "Zeit fuer Abschalten KAB nach Haltephase in Synchron" CURVE 0x1B9E90 ZF_kl_ui8_S5_S3 2550 UMR_MSEC__10_1_0_S5_S3 0 2550
 /begin AXIS_DESCR STD_AXIS zff_atsys._.iSignale._.obj.sig_m_t8 UMR_NM__6_1_M34_S5_S3 4 -204 1326 DEPOSIT ABSOLUTE /end AXIS_DESCR
/end CHARACTERISTIC
/begin CHARACTERISTIC KL_TRAMTHINSYNKABSP42 "Zeit fuer Abschalten KAB nach Haltephase in Synchron" CURVE 0x1BAA98 ZF_kl_ui8_S5_S3 2550 UMR_MSEC__10_1_0_S5_S3 0 2550
 /begin AXIS_DESCR STD_AXIS zff_atsys._.iSignale._.obj.sig_m_t8 UMR_NM__6_1_M34_S5_S3 4 -204 1326 DEPOSIT ABSOLUTE /end AXIS_DESCR
/end CHARACTERISTIC
/begin CHARACTERISTIC KL_TRAMTHINSYNKABSP43 "Zeit fuer Abschalten KAB nach Haltephase in Synchron" CURVE 0x1BA048 ZF_kl_ui8_S5_S3 2550 UMR_MSEC__10_1_0_S5_S3 0 2550
 /begin AXIS_DESCR STD_AXIS zff_atsys._.iSignale._.obj.sig_m_t8 UMR_NM__6_1_M34_S5_S3 4 -204 1326 DEPOSIT ABSOLUTE /end AXIS_DESCR
/end CHARACTERISTIC
/begin CHARACTERISTIC KL_TRAMTHINSYNKABSP51 "Zeit fuer Abschalten KAB nach Haltephase in Synchron" CURVE 0x1BAC50 ZF_kl_ui8_S5_S3 2550 UMR_MSEC__10_1_0_S5_S3 0 2550
 /begin AXIS_DESCR STD_AXIS zff_atsys._.iSignale._.obj.sig_m_t8 UMR_NM__6_1_M34_S5_S3 4 -204 1326 DEPOSIT ABSOLUTE /end AXIS_DESCR
/end CHARACTERISTIC
/begin CHARACTERISTIC KL_TRAMTHINSYNKABSP53 "Zeit fuer Abschalten KAB nach Haltephase in Synchron" CURVE 0x1BAE08 ZF_kl_ui8_S5_S3 2550 UMR_MSEC__10_1_0_S5_S3 0 2550
 /begin AXIS_DESCR STD_AXIS zff_atsys._.iSignale._.obj.sig_m_t8 UMR_NM__6_1_M34_S5_S3 4 -204 1326 DEPOSIT ABSOLUTE /end AXIS_DESCR
/end CHARACTERISTIC
/begin CHARACTERISTIC KL_TRAMTHINSYNKABSP54 "Zeit fuer Abschalten KAB nach Haltephase in Synchron" CURVE 0x1BA200 ZF_kl_ui8_S5_S3 2550 UMR_MSEC__10_1_0_S5_S3 0 2550
 /begin AXIS_DESCR STD_AXIS zff_atsys._.iSignale._.obj.sig_m_t8 UMR_NM__6_1_M34_S5_S3 4 -204 1326 DEPOSIT ABSOLUTE /end AXIS_DESCR
/end CHARACTERISTIC
/begin CHARACTERISTIC KL_TRAMTHINSYNKABSP63 "Zeit fuer Abschalten KAB nach Haltephase in Synchron" CURVE 0x1BAFC0 ZF_kl_ui8_S5_S3 2550 UMR_MSEC__10_1_0_S5_S3 0 2550
 /begin AXIS_DESCR STD_AXIS zff_atsys._.iSignale._.obj.sig_m_t8 UMR_NM__6_1_M34_S5_S3 4 -204 1326 DEPOSIT ABSOLUTE /end AXIS_DESCR
/end CHARACTERISTIC
/begin CHARACTERISTIC KL_TRAMTHINSYNKABSP64 "Zeit fuer Abschalten KAB nach Haltephase in Synchron" CURVE 0x1BB178 ZF_kl_ui8_S5_S3 2550 UMR_MSEC__10_1_0_S5_S3 0 2550
 /begin AXIS_DESCR STD_AXIS zff_atsys._.iSignale._.obj.sig_m_t8 UMR_NM__6_1_M34_S5_S3 4 -204 1326 DEPOSIT ABSOLUTE /end AXIS_DESCR
/end CHARACTERISTIC
/begin CHARACTERISTIC KL_TRAMTHINSYNKABSP65 "Zeit fuer Abschalten KAB nach Haltephase in Synchron" CURVE 0x1BA3B8 ZF_kl_ui8_S5_S3 2550 UMR_MSEC__10_1_0_S5_S3 0 2550
 /begin AXIS_DESCR STD_AXIS zff_atsys._.iSignale._.obj.sig_m_t8 UMR_NM__6_1_M34_S5_S3 4 -204 1326 DEPOSIT ABSOLUTE /end AXIS_DESCR
/end CHARACTERISTIC
/begin CHARACTERISTIC KL_TRAMTHINSYNKABSP71 "Zeit fuer Abschalten KAB nach Haltephase in Synchron" CURVE 0x1BB330 ZF_kl_ui8_S5_S3 2550 UMR_MSEC__10_1_0_S5_S3 0 2550
 /begin AXIS_DESCR STD_AXIS zff_atsys._.iSignale._.obj.sig_m_t8 UMR_NM__6_1_M34_S5_S3 4 -204 1326 DEPOSIT ABSOLUTE /end AXIS_DESCR
/end CHARACTERISTIC
/begin CHARACTERISTIC KL_TRAMTHINSYNKABSP75 "Zeit fuer Abschalten KAB nach Haltephase in Synchron" CURVE 0x1BB4E8 ZF_kl_ui8_S5_S3 2550 UMR_MSEC__10_1_0_S5_S3 0 2550
 /begin AXIS_DESCR STD_AXIS zff_atsys._.iSignale._.obj.sig_m_t8 UMR_NM__6_1_M34_S5_S3 4 -204 1326 DEPOSIT ABSOLUTE /end AXIS_DESCR
/end CHARACTERISTIC
/begin CHARACTERISTIC KL_TRAMTHINSYNKABSP76 "Zeit fuer Abschalten KAB nach Haltephase in Synchron" CURVE 0x1BA570 ZF_kl_ui8_S5_S3 2550 UMR_MSEC__10_1_0_S5_S3 0 2550
 /begin AXIS_DESCR STD_AXIS zff_atsys._.iSignale._.obj.sig_m_t8 UMR_NM__6_1_M34_S5_S3 4 -204 1326 DEPOSIT ABSOLUTE /end AXIS_DESCR
/end CHARACTERISTIC
/begin CHARACTERISTIC KL_TRAMTHINSYNKABSP82 "Zeit fuer Abschalten KAB nach Haltephase in Synchron" CURVE 0x1BB6A0 ZF_kl_ui8_S5_S3 2550 UMR_MSEC__10_1_0_S5_S3 0 2550
 /begin AXIS_DESCR STD_AXIS zff_atsys._.iSignale._.obj.sig_m_t8 UMR_NM__6_1_M34_S5_S3 4 -204 1326 DEPOSIT ABSOLUTE /end AXIS_DESCR
/end CHARACTERISTIC
/begin CHARACTERISTIC KL_TRAMTHINSYNKABSP84 "Zeit fuer Abschalten KAB nach Haltephase in Synchron" CURVE 0x1BB858 ZF_kl_ui8_S5_S3 2550 UMR_MSEC__10_1_0_S5_S3 0 2550
 /begin AXIS_DESCR STD_AXIS zff_atsys._.iSignale._.obj.sig_m_t8 UMR_NM__6_1_M34_S5_S3 4 -204 1326 DEPOSIT ABSOLUTE /end AXIS_DESCR
/end CHARACTERISTIC
/begin CHARACTERISTIC KL_TRAMTHINSYNKABSP86 "Zeit fuer Abschalten KAB nach Haltephase in Synchron" CURVE 0x1BBA10 ZF_kl_ui8_S5_S3 2550 UMR_MSEC__10_1_0_S5_S3 0 2550
 /begin AXIS_DESCR STD_AXIS zff_atsys._.iSignale._.obj.sig_m_t8 UMR_NM__6_1_M34_S5_S3 4 -204 1326 DEPOSIT ABSOLUTE /end AXIS_DESCR
/end CHARACTERISTIC
/begin CHARACTERISTIC KL_TRAMTHINSYNKABSP87 "Zeit fuer Abschalten KAB nach Haltephase in Synchron" CURVE 0x1BA728 ZF_kl_ui8_S5_S3 2550 UMR_MSEC__10_1_0_S5_S3 0 2550
 /begin AXIS_DESCR STD_AXIS zff_atsys._.iSignale._.obj.sig_m_t8 UMR_NM__6_1_M34_S5_S3 4 -204 1326 DEPOSIT ABSOLUTE /end AXIS_DESCR
/end CHARACTERISTIC
/begin CHARACTERISTIC KL_TRAMTHINSYNKABSPORT21 "Zeit fuer Abschalten KAB nach Haltephase in Synchron" CURVE 0x1BBBC8 ZF_kl_ui8_S5_S3 2550 UMR_MSEC__10_1_0_S5_S3 0 2550
 /begin AXIS_DESCR STD_AXIS zff_atsys._.iSignale._.obj.sig_m_t8 UMR_NM__6_1_M34_S5_S3 4 -204 1326 DEPOSIT ABSOLUTE /end AXIS_DESCR
/end CHARACTERISTIC
/begin CHARACTERISTIC KL_TRAMTHINSYNKABSPORT31 "Zeit fuer Abschalten KAB nach Haltephase in Synchron" CURVE 0x1BC7D0 ZF_kl_ui8_S5_S3 2550 UMR_MSEC__10_1_0_S5_S3 0 2550
 /begin AXIS_DESCR STD_AXIS zff_atsys._.iSignale._.obj.sig_m_t8 UMR_NM__6_1_M34_S5_S3 4 -204 1326 DEPOSIT ABSOLUTE /end AXIS_DESCR
/end CHARACTERISTIC
/begin CHARACTERISTIC KL_TRAMTHINSYNKABSPORT32 "Zeit fuer Abschalten KAB nach Haltephase in Synchron" CURVE 0x1BBD80 ZF_kl_ui8_S5_S3 2550 UMR_MSEC__10_1_0_S5_S3 0 2550
 /begin AXIS_DESCR STD_AXIS zff_atsys._.iSignale._.obj.sig_m_t8 UMR_NM__6_1_M34_S5_S3 4 -204 1326 DEPOSIT ABSOLUTE /end AXIS_DESCR
/end CHARACTERISTIC
/begin CHARACTERISTIC KL_TRAMTHINSYNKABSPORT42 "Zeit fuer Abschalten KAB nach Haltephase in Synchron" CURVE 0x1BC988 ZF_kl_ui8_S5_S3 2550 UMR_MSEC__10_1_0_S5_S3 0 2550
 /begin AXIS_DESCR STD_AXIS zff_atsys._.iSignale._.obj.sig_m_t8 UMR_NM__6_1_M34_S5_S3 4 -204 1326 DEPOSIT ABSOLUTE /end AXIS_DESCR
/end CHARACTERISTIC
/begin CHARACTERISTIC KL_TRAMTHINSYNKABSPORT43 "Zeit fuer Abschalten KAB nach Haltephase in Synchron" CURVE 0x1BBF38 ZF_kl_ui8_S5_S3 2550 UMR_MSEC__10_1_0_S5_S3 0 2550
 /begin AXIS_DESCR STD_AXIS zff_atsys._.iSignale._.obj.sig_m_t8 UMR_NM__6_1_M34_S5_S3 4 -204 1326 DEPOSIT ABSOLUTE /end AXIS_DESCR
/end CHARACTERISTIC
/begin CHARACTERISTIC KL_TRAMTHINSYNKABSPORT51 "Zeit fuer Abschalten KAB nach Haltephase in Synchron" CURVE 0x1BCB40 ZF_kl_ui8_S5_S3 2550 UMR_MSEC__10_1_0_S5_S3 0 2550
 /begin AXIS_DESCR STD_AXIS zff_atsys._.iSignale._.obj.sig_m_t8 UMR_NM__6_1_M34_S5_S3 4 -204 1326 DEPOSIT ABSOLUTE /end AXIS_DESCR
/end CHARACTERISTIC
/begin CHARACTERISTIC KL_TRAMTHINSYNKABSPORT53 "Zeit fuer Abschalten KAB nach Haltephase in Synchron" CURVE 0x1BCCF8 ZF_kl_ui8_S5_S3 2550 UMR_MSEC__10_1_0_S5_S3 0 2550
 /begin AXIS_DESCR STD_AXIS zff_atsys._.iSignale._.obj.sig_m_t8 UMR_NM__6_1_M34_S5_S3 4 -204 1326 DEPOSIT ABSOLUTE /end AXIS_DESCR
/end CHARACTERISTIC
/begin CHARACTERISTIC KL_TRAMTHINSYNKABSPORT54 "Zeit fuer Abschalten KAB nach Haltephase in Synchron" CURVE 0x1BC0F0 ZF_kl_ui8_S5_S3 2550 UMR_MSEC__10_1_0_S5_S3 0 2550
 /begin AXIS_DESCR STD_AXIS zff_atsys._.iSignale._.obj.sig_m_t8 UMR_NM__6_1_M34_S5_S3 4 -204 1326 DEPOSIT ABSOLUTE /end AXIS_DESCR
/end CHARACTERISTIC
/begin CHARACTERISTIC KL_TRAMTHINSYNKABSPORT63 "Zeit fuer Abschalten KAB nach Haltephase in Synchron" CURVE 0x1BCEB0 ZF_kl_ui8_S5_S3 2550 UMR_MSEC__10_1_0_S5_S3 0 2550
 /begin AXIS_DESCR STD_AXIS zff_atsys._.iSignale._.obj.sig_m_t8 UMR_NM__6_1_M34_S5_S3 4 -204 1326 DEPOSIT ABSOLUTE /end AXIS_DESCR
/end CHARACTERISTIC
/begin CHARACTERISTIC KL_TRAMTHINSYNKABSPORT64 "Zeit fuer Abschalten KAB nach Haltephase in Synchron" CURVE 0x1BD068 ZF_kl_ui8_S5_S3 2550 UMR_MSEC__10_1_0_S5_S3 0 2550
 /begin AXIS_DESCR STD_AXIS zff_atsys._.iSignale._.obj.sig_m_t8 UMR_NM__6_1_M34_S5_S3 4 -204 1326 DEPOSIT ABSOLUTE /end AXIS_DESCR
/end CHARACTERISTIC
/begin CHARACTERISTIC KL_TRAMTHINSYNKABSPORT65 "Zeit fuer Abschalten KAB nach Haltephase in Synchron" CURVE 0x1BC2A8 ZF_kl_ui8_S5_S3 2550 UMR_MSEC__10_1_0_S5_S3 0 2550
 /begin AXIS_DESCR STD_AXIS zff_atsys._.iSignale._.obj.sig_m_t8 UMR_NM__6_1_M34_S5_S3 4 -204 1326 DEPOSIT ABSOLUTE /end AXIS_DESCR
/end CHARACTERISTIC
/begin CHARACTERISTIC KL_TRAMTHINSYNKABSPORT71 "Zeit fuer Abschalten KAB nach Haltephase in Synchron" CURVE 0x1BD220 ZF_kl_ui8_S5_S3 2550 UMR_MSEC__10_1_0_S5_S3 0 2550
 /begin AXIS_DESCR STD_AXIS zff_atsys._.iSignale._.obj.sig_m_t8 UMR_NM__6_1_M34_S5_S3 4 -204 1326 DEPOSIT ABSOLUTE /end AXIS_DESCR
/end CHARACTERISTIC
/begin CHARACTERISTIC KL_TRAMTHINSYNKABSPORT75 "Zeit fuer Abschalten KAB nach Haltephase in Synchron" CURVE 0x1BD3D8 ZF_kl_ui8_S5_S3 2550 UMR_MSEC__10_1_0_S5_S3 0 2550
 /begin AXIS_DESCR STD_AXIS zff_atsys._.iSignale._.obj.sig_m_t8 UMR_NM__6_1_M34_S5_S3 4 -204 1326 DEPOSIT ABSOLUTE /end AXIS_DESCR
/end CHARACTERISTIC
/begin CHARACTERISTIC KL_TRAMTHINSYNKABSPORT76 "Zeit fuer Abschalten KAB nach Haltephase in Synchron" CURVE 0x1BC460 ZF_kl_ui8_S5_S3 2550 UMR_MSEC__10_1_0_S5_S3 0 2550
 /begin AXIS_DESCR STD_AXIS zff_atsys._.iSignale._.obj.sig_m_t8 UMR_NM__6_1_M34_S5_S3 4 -204 1326 DEPOSIT ABSOLUTE /end AXIS_DESCR
/end CHARACTERISTIC
/begin CHARACTERISTIC KL_TRAMTHINSYNKABSPORT82 "Zeit fuer Abschalten KAB nach Haltephase in Synchron" CURVE 0x1BD590 ZF_kl_ui8_S5_S3 2550 UMR_MSEC__10_1_0_S5_S3 0 2550
 /begin AXIS_DESCR STD_AXIS zff_atsys._.iSignale._.obj.sig_m_t8 UMR_NM__6_1_M34_S5_S3 4 -204 1326 DEPOSIT ABSOLUTE /end AXIS_DESCR
/end CHARACTERISTIC
/begin CHARACTERISTIC KL_TSYNMTKAB21 "Zeit vor sync. Ende Schaltdruck KAB" CURVE 0x1B8828 ZF_kl_ui8_S5_S3 1280 UMR_MSEC__10_1_M128_S5_S3 -1280 0
 /begin AXIS_DESCR STD_AXIS zff_atsys._.iSignale._.obj.sig_m_t8 UMR_NM__6_1_M34_S5_S3 4 -204 1326 DEPOSIT ABSOLUTE /end AXIS_DESCR
/end CHARACTERISTIC
/begin CHARACTERISTIC KL_TSYNMTKAB21_EL "Zeit vor sync. Ende Schaltdruck KAB" CURVE 0x1B8834 ZF_kl_ui8_S5_S3 1280 UMR_MSEC__10_1_M128_S5_S3 -1280 0
 /begin AXIS_DESCR STD_AXIS zff_atsys._.iSignale._.obj.sig_m_t8 UMR_NM__6_1_M34_S5_S3 4 -204 1326 DEPOSIT ABSOLUTE /end AXIS_DESCR
/end CHARACTERISTIC
/begin CHARACTERISTIC KL_TSYNMTKAB32 "Zeit vor sync. Ende Schaltdruck KAB" CURVE 0x1B8B04 ZF_kl_ui8_S5_S3 1280 UMR_MSEC__10_1_M128_S5_S3 -1280 0
 /begin AXIS_DESCR STD_AXIS zff_atsys._.iSignale._.obj.sig_m_t8 UMR_NM__6_1_M34_S5_S3 4 -204 1326 DEPOSIT ABSOLUTE /end AXIS_DESCR
/end CHARACTERISTIC
/begin CHARACTERISTIC KL_TSYNMTKAB32_EL "Zeit vor sync. Ende Schaltdruck KAB" CURVE 0x1B8B10 ZF_kl_ui8_S5_S3 1280 UMR_MSEC__10_1_M128_S5_S3 -1280 0
 /begin AXIS_DESCR STD_AXIS zff_atsys._.iSignale._.obj.sig_m_t8 UMR_NM__6_1_M34_S5_S3 4 -204 1326 DEPOSIT ABSOLUTE /end AXIS_DESCR
/end CHARACTERISTIC
/begin CHARACTERISTIC KL_TSYNMTKAB43 "Zeit vor sync. Ende Schaltdruck KAB" CURVE 0x1B8DE0 ZF_kl_ui8_S5_S3 1280 UMR_MSEC__10_1_M128_S5_S3 -1280 0
 /begin AXIS_DESCR STD_AXIS zff_atsys._.iSignale._.obj.sig_m_t8 UMR_NM__6_1_M34_S5_S3 4 -204 1326 DEPOSIT ABSOLUTE /end AXIS_DESCR
/end CHARACTERISTIC
/begin CHARACTERISTIC KL_TSYNMTKAB43_EL "Zeit vor sync. Ende Schaltdruck KAB" CURVE 0x1B8DEC ZF_kl_ui8_S5_S3 1280 UMR_MSEC__10_1_M128_S5_S3 -1280 0
 /begin AXIS_DESCR STD_AXIS zff_atsys._.iSignale._.obj.sig_m_t8 UMR_NM__6_1_M34_S5_S3 4 -204 1326 DEPOSIT ABSOLUTE /end AXIS_DESCR
/end CHARACTERISTIC
/begin CHARACTERISTIC KL_TSYNMTKAB54 "Zeit vor sync. Ende Schaltdruck KAB" CURVE 0x1B90BC ZF_kl_ui8_S5_S3 1280 UMR_MSEC__10_1_M128_S5_S3 -1280 0
 /begin AXIS_DESCR STD_AXIS zff_atsys._.iSignale._.obj.sig_m_t8 UMR_NM__6_1_M34_S5_S3 4 -204 1326 DEPOSIT ABSOLUTE /end AXIS_DESCR
/end CHARACTERISTIC
/begin CHARACTERISTIC KL_TSYNMTKAB54_EL "Zeit vor sync. Ende Schaltdruck KAB" CURVE 0x1B90C8 ZF_kl_ui8_S5_S3 1280 UMR_MSEC__10_1_M128_S5_S3 -1280 0
 /begin AXIS_DESCR STD_AXIS zff_atsys._.iSignale._.obj.sig_m_t8 UMR_NM__6_1_M34_S5_S3 4 -204 1326 DEPOSIT ABSOLUTE /end AXIS_DESCR
/end CHARACTERISTIC
/begin CHARACTERISTIC KL_TSYNMTKAB65 "Zeit vor sync. Ende Schaltdruck KAB" CURVE 0x1B9398 ZF_kl_ui8_S5_S3 1280 UMR_MSEC__10_1_M128_S5_S3 -1280 0
 /begin AXIS_DESCR STD_AXIS zff_atsys._.iSignale._.obj.sig_m_t8 UMR_NM__6_1_M34_S5_S3 4 -204 1326 DEPOSIT ABSOLUTE /end AXIS_DESCR
/end CHARACTERISTIC
/begin CHARACTERISTIC KL_TSYNMTKAB65_EL "Zeit vor sync. Ende Schaltdruck KAB" CURVE 0x1B93A4 ZF_kl_ui8_S5_S3 1280 UMR_MSEC__10_1_M128_S5_S3 -1280 0
 /begin AXIS_DESCR STD_AXIS zff_atsys._.iSignale._.obj.sig_m_t8 UMR_NM__6_1_M34_S5_S3 4 -204 1326 DEPOSIT ABSOLUTE /end AXIS_DESCR
/end CHARACTERISTIC
/begin CHARACTERISTIC KL_TSYNMTKAB76 "Zeit vor sync. Ende Schaltdruck KAB" CURVE 0x1B9674 ZF_kl_ui8_S5_S3 1280 UMR_MSEC__10_1_M128_S5_S3 -1280 0
 /begin AXIS_DESCR STD_AXIS zff_atsys._.iSignale._.obj.sig_m_t8 UMR_NM__6_1_M34_S5_S3 4 -204 1326 DEPOSIT ABSOLUTE /end AXIS_DESCR
/end CHARACTERISTIC
/begin CHARACTERISTIC KL_TSYNMTKAB76_EL "Zeit vor sync. Ende Schaltdruck KAB" CURVE 0x1B9680 ZF_kl_ui8_S5_S3 1280 UMR_MSEC__10_1_M128_S5_S3 -1280 0
 /begin AXIS_DESCR STD_AXIS zff_atsys._.iSignale._.obj.sig_m_t8 UMR_NM__6_1_M34_S5_S3 4 -204 1326 DEPOSIT ABSOLUTE /end AXIS_DESCR
/end CHARACTERISTIC
/begin CHARACTERISTIC KL_TSYNMTKAB87 "Zeit vor sync. Ende Schaltdruck KAB" CURVE 0x1B9950 ZF_kl_ui8_S5_S3 1280 UMR_MSEC__10_1_M128_S5_S3 -1280 0
 /begin AXIS_DESCR STD_AXIS zff_atsys._.iSignale._.obj.sig_m_t8 UMR_NM__6_1_M34_S5_S3 4 -204 1326 DEPOSIT ABSOLUTE /end AXIS_DESCR
/end CHARACTERISTIC
/begin CHARACTERISTIC KL_TSYNMTKAB87_EL "Zeit vor sync. Ende Schaltdruck KAB" CURVE 0x1B995C ZF_kl_ui8_S5_S3 1280 UMR_MSEC__10_1_M128_S5_S3 -1280 0
 /begin AXIS_DESCR STD_AXIS zff_atsys._.iSignale._.obj.sig_m_t8 UMR_NM__6_1_M34_S5_S3 4 -204 1326 DEPOSIT ABSOLUTE /end AXIS_DESCR
/end CHARACTERISTIC
/begin CHARACTERISTIC KL_TSYNMTKABSP21 "Zeit vor sync. Ende Schaltdruck KAB" CURVE 0x1B9BE0 ZF_kl_ui8_S5_S3 1280 UMR_MSEC__10_1_M128_S5_S3 -1280 0
 /begin AXIS_DESCR STD_AXIS zff_atsys._.iSignale._.obj.sig_m_t8 UMR_NM__6_1_M34_S5_S3 4 -204 1326 DEPOSIT ABSOLUTE /end AXIS_DESCR
/end CHARACTERISTIC
/begin CHARACTERISTIC KL_TSYNMTKABSP31 "Zeit vor sync. Ende Schaltdruck KAB" CURVE 0x1BA7E8 ZF_kl_ui8_S5_S3 1280 UMR_MSEC__10_1_M128_S5_S3 -1280 0
 /begin AXIS_DESCR STD_AXIS zff_atsys._.iSignale._.obj.sig_m_t8 UMR_NM__6_1_M34_S5_S3 4 -204 1326 DEPOSIT ABSOLUTE /end AXIS_DESCR
/end CHARACTERISTIC
/begin CHARACTERISTIC KL_TSYNMTKABSP32 "Zeit vor sync. Ende Schaltdruck KAB" CURVE 0x1B9D98 ZF_kl_ui8_S5_S3 1280 UMR_MSEC__10_1_M128_S5_S3 -1280 0
 /begin AXIS_DESCR STD_AXIS zff_atsys._.iSignale._.obj.sig_m_t8 UMR_NM__6_1_M34_S5_S3 4 -204 1326 DEPOSIT ABSOLUTE /end AXIS_DESCR
/end CHARACTERISTIC
/begin CHARACTERISTIC KL_TSYNMTKABSP42 "Zeit vor sync. Ende Schaltdruck KAB" CURVE 0x1BA9A0 ZF_kl_ui8_S5_S3 1280 UMR_MSEC__10_1_M128_S5_S3 -1280 0
 /begin AXIS_DESCR STD_AXIS zff_atsys._.iSignale._.obj.sig_m_t8 UMR_NM__6_1_M34_S5_S3 4 -204 1326 DEPOSIT ABSOLUTE /end AXIS_DESCR
/end CHARACTERISTIC
/begin CHARACTERISTIC KL_TSYNMTKABSP43 "Zeit vor sync. Ende Schaltdruck KAB" CURVE 0x1B9F50 ZF_kl_ui8_S5_S3 1280 UMR_MSEC__10_1_M128_S5_S3 -1280 0
 /begin AXIS_DESCR STD_AXIS zff_atsys._.iSignale._.obj.sig_m_t8 UMR_NM__6_1_M34_S5_S3 4 -204 1326 DEPOSIT ABSOLUTE /end AXIS_DESCR
/end CHARACTERISTIC
/begin CHARACTERISTIC KL_TSYNMTKABSP51 "Zeit vor sync. Ende Schaltdruck KAB" CURVE 0x1BAB58 ZF_kl_ui8_S5_S3 1280 UMR_MSEC__10_1_M128_S5_S3 -1280 0
 /begin AXIS_DESCR STD_AXIS zff_atsys._.iSignale._.obj.sig_m_t8 UMR_NM__6_1_M34_S5_S3 4 -204 1326 DEPOSIT ABSOLUTE /end AXIS_DESCR
/end CHARACTERISTIC
/begin CHARACTERISTIC KL_TSYNMTKABSP53 "Zeit vor sync. Ende Schaltdruck KAB" CURVE 0x1BAD10 ZF_kl_ui8_S5_S3 1280 UMR_MSEC__10_1_M128_S5_S3 -1280 0
 /begin AXIS_DESCR STD_AXIS zff_atsys._.iSignale._.obj.sig_m_t8 UMR_NM__6_1_M34_S5_S3 4 -204 1326 DEPOSIT ABSOLUTE /end AXIS_DESCR
/end CHARACTERISTIC
/begin CHARACTERISTIC KL_TSYNMTKABSP54 "Zeit vor sync. Ende Schaltdruck KAB" CURVE 0x1BA108 ZF_kl_ui8_S5_S3 1280 UMR_MSEC__10_1_M128_S5_S3 -1280 0
 /begin AXIS_DESCR STD_AXIS zff_atsys._.iSignale._.obj.sig_m_t8 UMR_NM__6_1_M34_S5_S3 4 -204 1326 DEPOSIT ABSOLUTE /end AXIS_DESCR
/end CHARACTERISTIC
/begin CHARACTERISTIC KL_TSYNMTKABSP63 "Zeit vor sync. Ende Schaltdruck KAB" CURVE 0x1BAEC8 ZF_kl_ui8_S5_S3 1280 UMR_MSEC__10_1_M128_S5_S3 -1280 0
 /begin AXIS_DESCR STD_AXIS zff_atsys._.iSignale._.obj.sig_m_t8 UMR_NM__6_1_M34_S5_S3 4 -204 1326 DEPOSIT ABSOLUTE /end AXIS_DESCR
/end CHARACTERISTIC
/begin CHARACTERISTIC KL_TSYNMTKABSP64 "Zeit vor sync. Ende Schaltdruck KAB" CURVE 0x1BB080 ZF_kl_ui8_S5_S3 1280 UMR_MSEC__10_1_M128_S5_S3 -1280 0
 /begin AXIS_DESCR STD_AXIS zff_atsys._.iSignale._.obj.sig_m_t8 UMR_NM__6_1_M34_S5_S3 4 -204 1326 DEPOSIT ABSOLUTE /end AXIS_DESCR
/end CHARACTERISTIC
/begin CHARACTERISTIC KL_TSYNMTKABSP65 "Zeit vor sync. Ende Schaltdruck KAB" CURVE 0x1BA2C0 ZF_kl_ui8_S5_S3 1280 UMR_MSEC__10_1_M128_S5_S3 -1280 0
 /begin AXIS_DESCR STD_AXIS zff_atsys._.iSignale._.obj.sig_m_t8 UMR_NM__6_1_M34_S5_S3 4 -204 1326 DEPOSIT ABSOLUTE /end AXIS_DESCR
/end CHARACTERISTIC
/begin CHARACTERISTIC KL_TSYNMTKABSP71 "Zeit vor sync. Ende Schaltdruck KAB" CURVE 0x1BB238 ZF_kl_ui8_S5_S3 1280 UMR_MSEC__10_1_M128_S5_S3 -1280 0
 /begin AXIS_DESCR STD_AXIS zff_atsys._.iSignale._.obj.sig_m_t8 UMR_NM__6_1_M34_S5_S3 4 -204 1326 DEPOSIT ABSOLUTE /end AXIS_DESCR
/end CHARACTERISTIC
/begin CHARACTERISTIC KL_TSYNMTKABSP75 "Zeit vor sync. Ende Schaltdruck KAB" CURVE 0x1BB3F0 ZF_kl_ui8_S5_S3 1280 UMR_MSEC__10_1_M128_S5_S3 -1280 0
 /begin AXIS_DESCR STD_AXIS zff_atsys._.iSignale._.obj.sig_m_t8 UMR_NM__6_1_M34_S5_S3 4 -204 1326 DEPOSIT ABSOLUTE /end AXIS_DESCR
/end CHARACTERISTIC
/begin CHARACTERISTIC KL_TSYNMTKABSP76 "Zeit vor sync. Ende Schaltdruck KAB" CURVE 0x1BA478 ZF_kl_ui8_S5_S3 1280 UMR_MSEC__10_1_M128_S5_S3 -1280 0
 /begin AXIS_DESCR STD_AXIS zff_atsys._.iSignale._.obj.sig_m_t8 UMR_NM__6_1_M34_S5_S3 4 -204 1326 DEPOSIT ABSOLUTE /end AXIS_DESCR
/end CHARACTERISTIC
/begin CHARACTERISTIC KL_TSYNMTKABSP82 "Zeit vor sync. Ende Schaltdruck KAB" CURVE 0x1BB5A8 ZF_kl_ui8_S5_S3 1280 UMR_MSEC__10_1_M128_S5_S3 -1280 0
 /begin AXIS_DESCR STD_AXIS zff_atsys._.iSignale._.obj.sig_m_t8 UMR_NM__6_1_M34_S5_S3 4 -204 1326 DEPOSIT ABSOLUTE /end AXIS_DESCR
/end CHARACTERISTIC
/begin CHARACTERISTIC KL_TSYNMTKABSP84 "Zeit vor sync. Ende Schaltdruck KAB" CURVE 0x1BB760 ZF_kl_ui8_S5_S3 1280 UMR_MSEC__10_1_M128_S5_S3 -1280 0
 /begin AXIS_DESCR STD_AXIS zff_atsys._.iSignale._.obj.sig_m_t8 UMR_NM__6_1_M34_S5_S3 4 -204 1326 DEPOSIT ABSOLUTE /end AXIS_DESCR
/end CHARACTERISTIC
/begin CHARACTERISTIC KL_TSYNMTKABSP86 "Zeit vor sync. Ende Schaltdruck KAB" CURVE 0x1BB918 ZF_kl_ui8_S5_S3 1280 UMR_MSEC__10_1_M128_S5_S3 -1280 0
 /begin AXIS_DESCR STD_AXIS zff_atsys._.iSignale._.obj.sig_m_t8 UMR_NM__6_1_M34_S5_S3 4 -204 1326 DEPOSIT ABSOLUTE /end AXIS_DESCR
/end CHARACTERISTIC
/begin CHARACTERISTIC KL_TSYNMTKABSP87 "Zeit vor sync. Ende Schaltdruck KAB" CURVE 0x1BA630 ZF_kl_ui8_S5_S3 1280 UMR_MSEC__10_1_M128_S5_S3 -1280 0
 /begin AXIS_DESCR STD_AXIS zff_atsys._.iSignale._.obj.sig_m_t8 UMR_NM__6_1_M34_S5_S3 4 -204 1326 DEPOSIT ABSOLUTE /end AXIS_DESCR
/end CHARACTERISTIC
/begin CHARACTERISTIC KL_TSYNMTKABSPORT21 "Zeit vor sync. Ende Schaltdruck KAB" CURVE 0x1BBAD0 ZF_kl_ui8_S5_S3 1280 UMR_MSEC__10_1_M128_S5_S3 -1280 0
 /begin AXIS_DESCR STD_AXIS zff_atsys._.iSignale._.obj.sig_m_t8 UMR_NM__6_1_M34_S5_S3 4 -204 1326 DEPOSIT ABSOLUTE /end AXIS_DESCR
/end CHARACTERISTIC
/begin CHARACTERISTIC KL_TSYNMTKABSPORT31 "Zeit vor sync. Ende Schaltdruck KAB" CURVE 0x1BC6D8 ZF_kl_ui8_S5_S3 1280 UMR_MSEC__10_1_M128_S5_S3 -1280 0
 /begin AXIS_DESCR STD_AXIS zff_atsys._.iSignale._.obj.sig_m_t8 UMR_NM__6_1_M34_S5_S3 4 -204 1326 DEPOSIT ABSOLUTE /end AXIS_DESCR
/end CHARACTERISTIC
/begin CHARACTERISTIC KL_TSYNMTKABSPORT32 "Zeit vor sync. Ende Schaltdruck KAB" CURVE 0x1BBC88 ZF_kl_ui8_S5_S3 1280 UMR_MSEC__10_1_M128_S5_S3 -1280 0
 /begin AXIS_DESCR STD_AXIS zff_atsys._.iSignale._.obj.sig_m_t8 UMR_NM__6_1_M34_S5_S3 4 -204 1326 DEPOSIT ABSOLUTE /end AXIS_DESCR
/end CHARACTERISTIC
/begin CHARACTERISTIC KL_TSYNMTKABSPORT42 "Zeit vor sync. Ende Schaltdruck KAB" CURVE 0x1BC890 ZF_kl_ui8_S5_S3 1280 UMR_MSEC__10_1_M128_S5_S3 -1280 0
 /begin AXIS_DESCR STD_AXIS zff_atsys._.iSignale._.obj.sig_m_t8 UMR_NM__6_1_M34_S5_S3 4 -204 1326 DEPOSIT ABSOLUTE /end AXIS_DESCR
/end CHARACTERISTIC
/begin CHARACTERISTIC KL_TSYNMTKABSPORT43 "Zeit vor sync. Ende Schaltdruck KAB" CURVE 0x1BBE40 ZF_kl_ui8_S5_S3 1280 UMR_MSEC__10_1_M128_S5_S3 -1280 0
 /begin AXIS_DESCR STD_AXIS zff_atsys._.iSignale._.obj.sig_m_t8 UMR_NM__6_1_M34_S5_S3 4 -204 1326 DEPOSIT ABSOLUTE /end AXIS_DESCR
/end CHARACTERISTIC
/begin CHARACTERISTIC KL_TSYNMTKABSPORT51 "Zeit vor sync. Ende Schaltdruck KAB" CURVE 0x1BCA48 ZF_kl_ui8_S5_S3 1280 UMR_MSEC__10_1_M128_S5_S3 -1280 0
 /begin AXIS_DESCR STD_AXIS zff_atsys._.iSignale._.obj.sig_m_t8 UMR_NM__6_1_M34_S5_S3 4 -204 1326 DEPOSIT ABSOLUTE /end AXIS_DESCR
/end CHARACTERISTIC
/begin CHARACTERISTIC KL_TSYNMTKABSPORT53 "Zeit vor sync. Ende Schaltdruck KAB" CURVE 0x1BCC00 ZF_kl_ui8_S5_S3 1280 UMR_MSEC__10_1_M128_S5_S3 -1280 0
 /begin AXIS_DESCR STD_AXIS zff_atsys._.iSignale._.obj.sig_m_t8 UMR_NM__6_1_M34_S5_S3 4 -204 1326 DEPOSIT ABSOLUTE /end AXIS_DESCR
/end CHARACTERISTIC
/begin CHARACTERISTIC KL_TSYNMTKABSPORT54 "Zeit vor sync. Ende Schaltdruck KAB" CURVE 0x1BBFF8 ZF_kl_ui8_S5_S3 1280 UMR_MSEC__10_1_M128_S5_S3 -1280 0
 /begin AXIS_DESCR STD_AXIS zff_atsys._.iSignale._.obj.sig_m_t8 UMR_NM__6_1_M34_S5_S3 4 -204 1326 DEPOSIT ABSOLUTE /end AXIS_DESCR
/end CHARACTERISTIC
/begin CHARACTERISTIC KL_TSYNMTKABSPORT63 "Zeit vor sync. Ende Schaltdruck KAB" CURVE 0x1BCDB8 ZF_kl_ui8_S5_S3 1280 UMR_MSEC__10_1_M128_S5_S3 -1280 0
 /begin AXIS_DESCR STD_AXIS zff_atsys._.iSignale._.obj.sig_m_t8 UMR_NM__6_1_M34_S5_S3 4 -204 1326 DEPOSIT ABSOLUTE /end AXIS_DESCR
/end CHARACTERISTIC
/begin CHARACTERISTIC KL_TSYNMTKABSPORT64 "Zeit vor sync. Ende Schaltdruck KAB" CURVE 0x1BCF70 ZF_kl_ui8_S5_S3 1280 UMR_MSEC__10_1_M128_S5_S3 -1280 0
 /begin AXIS_DESCR STD_AXIS zff_atsys._.iSignale._.obj.sig_m_t8 UMR_NM__6_1_M34_S5_S3 4 -204 1326 DEPOSIT ABSOLUTE /end AXIS_DESCR
/end CHARACTERISTIC
/begin CHARACTERISTIC KL_TSYNMTKABSPORT65 "Zeit vor sync. Ende Schaltdruck KAB" CURVE 0x1BC1B0 ZF_kl_ui8_S5_S3 1280 UMR_MSEC__10_1_M128_S5_S3 -1280 0
 /begin AXIS_DESCR STD_AXIS zff_atsys._.iSignale._.obj.sig_m_t8 UMR_NM__6_1_M34_S5_S3 4 -204 1326 DEPOSIT ABSOLUTE /end AXIS_DESCR
/end CHARACTERISTIC
/begin CHARACTERISTIC KL_TSYNMTKABSPORT71 "Zeit vor sync. Ende Schaltdruck KAB" CURVE 0x1BD128 ZF_kl_ui8_S5_S3 1280 UMR_MSEC__10_1_M128_S5_S3 -1280 0
 /begin AXIS_DESCR STD_AXIS zff_atsys._.iSignale._.obj.sig_m_t8 UMR_NM__6_1_M34_S5_S3 4 -204 1326 DEPOSIT ABSOLUTE /end AXIS_DESCR
/end CHARACTERISTIC
/begin CHARACTERISTIC KL_TSYNMTKABSPORT75 "Zeit vor sync. Ende Schaltdruck KAB" CURVE 0x1BD2E0 ZF_kl_ui8_S5_S3 1280 UMR_MSEC__10_1_M128_S5_S3 -1280 0
 /begin AXIS_DESCR STD_AXIS zff_atsys._.iSignale._.obj.sig_m_t8 UMR_NM__6_1_M34_S5_S3 4 -204 1326 DEPOSIT ABSOLUTE /end AXIS_DESCR
/end CHARACTERISTIC
/begin CHARACTERISTIC KL_TSYNMTKABSPORT76 "Zeit vor sync. Ende Schaltdruck KAB" CURVE 0x1BC368 ZF_kl_ui8_S5_S3 1280 UMR_MSEC__10_1_M128_S5_S3 -1280 0
 /begin AXIS_DESCR STD_AXIS zff_atsys._.iSignale._.obj.sig_m_t8 UMR_NM__6_1_M34_S5_S3 4 -204 1326 DEPOSIT ABSOLUTE /end AXIS_DESCR
/end CHARACTERISTIC
/begin CHARACTERISTIC KL_TSYNMTKABSPORT82 "Zeit vor sync. Ende Schaltdruck KAB" CURVE 0x1BD498 ZF_kl_ui8_S5_S3 1280 UMR_MSEC__10_1_M128_S5_S3 -1280 0
 /begin AXIS_DESCR STD_AXIS zff_atsys._.iSignale._.obj.sig_m_t8 UMR_NM__6_1_M34_S5_S3 4 -204 1326 DEPOSIT ABSOLUTE /end AXIS_DESCR
/end CHARACTERISTIC
/begin CHARACTERISTIC PO_HKAB12 "Druckoffset waehrend Haltephase k_ab" VALUE 0x1D8A44 ZF_kw_si16_S5_S3 12.75 UMR_BAR__1_1000_0_S5_S3 0 12.75 /end CHARACTERISTIC
/begin CHARACTERISTIC PO_HKAB23 "Druckoffset waehrend Haltephase k_ab" VALUE 0x1D8A4A ZF_kw_si16_S5_S3 12.75 UMR_BAR__1_1000_0_S5_S3 0 12.75 /end CHARACTERISTIC
/begin CHARACTERISTIC PO_HKAB34 "Druckoffset waehrend Haltephase k_ab" VALUE 0x1D8A50 ZF_kw_si16_S5_S3 12.75 UMR_BAR__1_1000_0_S5_S3 0 12.75 /end CHARACTERISTIC
/begin CHARACTERISTIC PO_HKAB45 "Druckoffset waehrend Haltephase k_ab" VALUE 0x1D8A56 ZF_kw_si16_S5_S3 12.75 UMR_BAR__1_1000_0_S5_S3 0 12.75 /end CHARACTERISTIC
/begin CHARACTERISTIC PO_HKAB56 "Druckoffset waehrend Haltephase k_ab" VALUE 0x1D8A5C ZF_kw_si16_S5_S3 12.75 UMR_BAR__1_1000_0_S5_S3 0 12.75 /end CHARACTERISTIC
/begin CHARACTERISTIC PO_HKAB67 "Druckoffset waehrend Haltephase k_ab" VALUE 0x1D8A62 ZF_kw_si16_S5_S3 12.75 UMR_BAR__1_1000_0_S5_S3 0 12.75 /end CHARACTERISTIC
/begin CHARACTERISTIC PO_HKAB78 "Druckoffset waehrend Haltephase k_ab" VALUE 0x1D8A68 ZF_kw_si16_S5_S3 12.75 UMR_BAR__1_1000_0_S5_S3 0 12.75 /end CHARACTERISTIC
/begin CHARACTERISTIC PS_ABBSYNISTHS12 "Schwellwert Abbruch einer HS bevor sync istgang verlassen" VALUE 0x1D8A46 ZF_kw_si16_S5_S3 22 UMR_BAR__1_1000_0_S5_S3 0 22 /end CHARACTERISTIC
/begin CHARACTERISTIC PS_ABBSYNISTHS23 "Schwellwert Abbruch einer HS bevor sync istgang verlassen" VALUE 0x1D8A4C ZF_kw_si16_S5_S3 22 UMR_BAR__1_1000_0_S5_S3 0 22 /end CHARACTERISTIC
/begin CHARACTERISTIC PS_ABBSYNISTHS34 "Schwellwert Abbruch einer HS bevor sync istgang verlassen" VALUE 0x1D8A52 ZF_kw_si16_S5_S3 22 UMR_BAR__1_1000_0_S5_S3 0 22 /end CHARACTERISTIC
/begin CHARACTERISTIC PS_ABBSYNISTHS45 "Schwellwert Abbruch einer HS bevor sync istgang verlassen" VALUE 0x1D8A58 ZF_kw_si16_S5_S3 22 UMR_BAR__1_1000_0_S5_S3 0 22 /end CHARACTERISTIC
/begin CHARACTERISTIC PS_ABBSYNISTHS56 "Schwellwert Abbruch einer HS bevor sync istgang verlassen" VALUE 0x1D8A5E ZF_kw_si16_S5_S3 22 UMR_BAR__1_1000_0_S5_S3 0 22 /end CHARACTERISTIC
/begin CHARACTERISTIC PS_ABBSYNISTHS67 "Schwellwert Abbruch einer HS bevor sync istgang verlassen" VALUE 0x1D8A64 ZF_kw_si16_S5_S3 22 UMR_BAR__1_1000_0_S5_S3 0 22 /end CHARACTERISTIC
/begin CHARACTERISTIC PS_ABBSYNISTHS78 "Schwellwert Abbruch einer HS bevor sync istgang verlassen" VALUE 0x1D8A6A ZF_kw_si16_S5_S3 22 UMR_BAR__1_1000_0_S5_S3 0 22 /end CHARACTERISTIC
/begin CHARACTERISTIC TO_HKAB12 "Zeit fuer Druckoffset waehrend Haltephase k_ab" VALUE 0x1D7993 ZF_kw_ui8_S5_S3 1000 UMR_MSEC__10_1_0_S5_S3 0 1000 /end CHARACTERISTIC
/begin CHARACTERISTIC TO_HKAB23 "Zeit fuer Druckoffset waehrend Haltephase k_ab" VALUE 0x1D7994 ZF_kw_ui8_S5_S3 1000 UMR_MSEC__10_1_0_S5_S3 0 1000 /end CHARACTERISTIC
/begin CHARACTERISTIC TO_HKAB34 "Zeit fuer Druckoffset waehrend Haltephase k_ab" VALUE 0x1D7995 ZF_kw_ui8_S5_S3 1000 UMR_MSEC__10_1_0_S5_S3 0 1000 /end CHARACTERISTIC
/begin CHARACTERISTIC TO_HKAB45 "Zeit fuer Druckoffset waehrend Haltephase k_ab" VALUE 0x1D7996 ZF_kw_ui8_S5_S3 1000 UMR_MSEC__10_1_0_S5_S3 0 1000 /end CHARACTERISTIC
/begin CHARACTERISTIC TO_HKAB56 "Zeit fuer Druckoffset waehrend Haltephase k_ab" VALUE 0x1D7997 ZF_kw_ui8_S5_S3 1000 UMR_MSEC__10_1_0_S5_S3 0 1000 /end CHARACTERISTIC
/begin CHARACTERISTIC TO_HKAB67 "Zeit fuer Druckoffset waehrend Haltephase k_ab" VALUE 0x1D7998 ZF_kw_ui8_S5_S3 1000 UMR_MSEC__10_1_0_S5_S3 0 1000 /end CHARACTERISTIC
/begin CHARACTERISTIC TO_HKAB78 "Zeit fuer Druckoffset waehrend Haltephase k_ab" VALUE 0x1D7999 ZF_kw_ui8_S5_S3 1000 UMR_MSEC__10_1_0_S5_S3 0 1000 /end CHARACTERISTIC
/begin CHARACTERISTIC T_HINSYN21 "Zeit fuer Ende Haltephase in Synchron KZU/KAB" VALUE 0x1D799E ZF_kw_ui8_S5_S3 2540 UMR_MSEC__10_1_0_S5_S3 0 2540 /end CHARACTERISTIC
/begin CHARACTERISTIC T_HINSYN32 "Zeit fuer Ende Haltephase in Synchron KZU/KAB" VALUE 0x1D79A3 ZF_kw_ui8_S5_S3 2540 UMR_MSEC__10_1_0_S5_S3 0 2540 /end CHARACTERISTIC
/begin CHARACTERISTIC T_HINSYN43 "Zeit fuer Ende Haltephase in Synchron KZU/KAB" VALUE 0x1D79A8 ZF_kw_ui8_S5_S3 2540 UMR_MSEC__10_1_0_S5_S3 0 2540 /end CHARACTERISTIC
/begin CHARACTERISTIC T_HINSYN54 "Zeit fuer Ende Haltephase in Synchron KZU/KAB" VALUE 0x1D79AD ZF_kw_ui8_S5_S3 2540 UMR_MSEC__10_1_0_S5_S3 0 2540 /end CHARACTERISTIC
/begin CHARACTERISTIC T_HINSYN65 "Zeit fuer Ende Haltephase in Synchron KZU/KAB" VALUE 0x1D79B2 ZF_kw_ui8_S5_S3 2540 UMR_MSEC__10_1_0_S5_S3 0 2540 /end CHARACTERISTIC
/begin CHARACTERISTIC T_HINSYN76 "Zeit fuer Ende Haltephase in Synchron KZU/KAB" VALUE 0x1D79B7 ZF_kw_ui8_S5_S3 2540 UMR_MSEC__10_1_0_S5_S3 0 2540 /end CHARACTERISTIC
/begin CHARACTERISTIC T_HINSYN87 "Zeit fuer Ende Haltephase in Synchron KZU/KAB" VALUE 0x1D79BC ZF_kw_ui8_S5_S3 2540 UMR_MSEC__10_1_0_S5_S3 0 2540 /end CHARACTERISTIC
/begin CHARACTERISTIC T_HINSYNSP21 "Zeit fuer Ende Haltephase in Synchron KZU/KAB" VALUE 0x1D79BF ZF_kw_ui8_S5_S3 2540 UMR_MSEC__10_1_0_S5_S3 0 2540 /end CHARACTERISTIC
/begin CHARACTERISTIC T_HINSYNSP31 "Zeit fuer Ende Haltephase in Synchron KZU/KAB" VALUE 0x1D79D4 ZF_kw_ui8_S5_S3 2540 UMR_MSEC__10_1_0_S5_S3 0 2540 /end CHARACTERISTIC
/begin CHARACTERISTIC T_HINSYNSP32 "Zeit fuer Ende Haltephase in Synchron KZU/KAB" VALUE 0x1D79C2 ZF_kw_ui8_S5_S3 2540 UMR_MSEC__10_1_0_S5_S3 0 2540 /end CHARACTERISTIC
/begin CHARACTERISTIC T_HINSYNSP42 "Zeit fuer Ende Haltephase in Synchron KZU/KAB" VALUE 0x1D79D7 ZF_kw_ui8_S5_S3 2540 UMR_MSEC__10_1_0_S5_S3 0 2540 /end CHARACTERISTIC
/begin CHARACTERISTIC T_HINSYNSP43 "Zeit fuer Ende Haltephase in Synchron KZU/KAB" VALUE 0x1D79C5 ZF_kw_ui8_S5_S3 2540 UMR_MSEC__10_1_0_S5_S3 0 2540 /end CHARACTERISTIC
/begin CHARACTERISTIC T_HINSYNSP51 "Zeit fuer Ende Haltephase in Synchron KZU/KAB" VALUE 0x1D79DA ZF_kw_ui8_S5_S3 2540 UMR_MSEC__10_1_0_S5_S3 0 2540 /end CHARACTERISTIC
/begin CHARACTERISTIC T_HINSYNSP53 "Zeit fuer Ende Haltephase in Synchron KZU/KAB" VALUE 0x1D79DD ZF_kw_ui8_S5_S3 2540 UMR_MSEC__10_1_0_S5_S3 0 2540 /end CHARACTERISTIC
/begin CHARACTERISTIC T_HINSYNSP54 "Zeit fuer Ende Haltephase in Synchron KZU/KAB" VALUE 0x1D79C8 ZF_kw_ui8_S5_S3 2540 UMR_MSEC__10_1_0_S5_S3 0 2540 /end CHARACTERISTIC
/begin CHARACTERISTIC T_HINSYNSP63 "Zeit fuer Ende Haltephase in Synchron KZU/KAB" VALUE 0x1D79E0 ZF_kw_ui8_S5_S3 2540 UMR_MSEC__10_1_0_S5_S3 0 2540 /end CHARACTERISTIC
/begin CHARACTERISTIC T_HINSYNSP64 "Zeit fuer Ende Haltephase in Synchron KZU/KAB" VALUE 0x1D79E3 ZF_kw_ui8_S5_S3 2540 UMR_MSEC__10_1_0_S5_S3 0 2540 /end CHARACTERISTIC
/begin CHARACTERISTIC T_HINSYNSP65 "Zeit fuer Ende Haltephase in Synchron KZU/KAB" VALUE 0x1D79CB ZF_kw_ui8_S5_S3 2540 UMR_MSEC__10_1_0_S5_S3 0 2540 /end CHARACTERISTIC
/begin CHARACTERISTIC T_HINSYNSP71 "Zeit fuer Ende Haltephase in Synchron KZU/KAB" VALUE 0x1D79E6 ZF_kw_ui8_S5_S3 2540 UMR_MSEC__10_1_0_S5_S3 0 2540 /end CHARACTERISTIC
/begin CHARACTERISTIC T_HINSYNSP75 "Zeit fuer Ende Haltephase in Synchron KZU/KAB" VALUE 0x1D79E9 ZF_kw_ui8_S5_S3 2540 UMR_MSEC__10_1_0_S5_S3 0 2540 /end CHARACTERISTIC
/begin CHARACTERISTIC T_HINSYNSP76 "Zeit fuer Ende Haltephase in Synchron KZU/KAB" VALUE 0x1D79CE ZF_kw_ui8_S5_S3 2540 UMR_MSEC__10_1_0_S5_S3 0 2540 /end CHARACTERISTIC
/begin CHARACTERISTIC T_HINSYNSP82 "Zeit fuer Ende Haltephase in Synchron KZU/KAB" VALUE 0x1D79EC ZF_kw_ui8_S5_S3 2540 UMR_MSEC__10_1_0_S5_S3 0 2540 /end CHARACTERISTIC
/begin CHARACTERISTIC T_HINSYNSP84 "Zeit fuer Ende Haltephase in Synchron KZU/KAB" VALUE 0x1D79EF ZF_kw_ui8_S5_S3 2540 UMR_MSEC__10_1_0_S5_S3 0 2540 /end CHARACTERISTIC
/begin CHARACTERISTIC T_HINSYNSP86 "Zeit fuer Ende Haltephase in Synchron KZU/KAB" VALUE 0x1D79F2 ZF_kw_ui8_S5_S3 2540 UMR_MSEC__10_1_0_S5_S3 0 2540 /end CHARACTERISTIC
/begin CHARACTERISTIC T_HINSYNSP87 "Zeit fuer Ende Haltephase in Synchron KZU/KAB" VALUE 0x1D79D1 ZF_kw_ui8_S5_S3 2540 UMR_MSEC__10_1_0_S5_S3 0 2540 /end CHARACTERISTIC
/begin CHARACTERISTIC T_HINSYNSPORT21 "Zeit fuer Ende Haltephase in Synchron KZU/KAB" VALUE 0x1D79F5 ZF_kw_ui8_S5_S3 2540 UMR_MSEC__10_1_0_S5_S3 0 2540 /end CHARACTERISTIC
/begin CHARACTERISTIC T_HINSYNSPORT31 "Zeit fuer Ende Haltephase in Synchron KZU/KAB" VALUE 0x1D7A0A ZF_kw_ui8_S5_S3 2540 UMR_MSEC__10_1_0_S5_S3 0 2540 /end CHARACTERISTIC
/begin CHARACTERISTIC T_HINSYNSPORT32 "Zeit fuer Ende Haltephase in Synchron KZU/KAB" VALUE 0x1D79F8 ZF_kw_ui8_S5_S3 2540 UMR_MSEC__10_1_0_S5_S3 0 2540 /end CHARACTERISTIC
/begin CHARACTERISTIC T_HINSYNSPORT42 "Zeit fuer Ende Haltephase in Synchron KZU/KAB" VALUE 0x1D7A0D ZF_kw_ui8_S5_S3 2540 UMR_MSEC__10_1_0_S5_S3 0 2540 /end CHARACTERISTIC
/begin CHARACTERISTIC T_HINSYNSPORT43 "Zeit fuer Ende Haltephase in Synchron KZU/KAB" VALUE 0x1D79FB ZF_kw_ui8_S5_S3 2540 UMR_MSEC__10_1_0_S5_S3 0 2540 /end CHARACTERISTIC
/begin CHARACTERISTIC T_HINSYNSPORT51 "Zeit fuer Ende Haltephase in Synchron KZU/KAB" VALUE 0x1D7A10 ZF_kw_ui8_S5_S3 2540 UMR_MSEC__10_1_0_S5_S3 0 2540 /end CHARACTERISTIC
/begin CHARACTERISTIC T_HINSYNSPORT53 "Zeit fuer Ende Haltephase in Synchron KZU/KAB" VALUE 0x1D7A13 ZF_kw_ui8_S5_S3 2540 UMR_MSEC__10_1_0_S5_S3 0 2540 /end CHARACTERISTIC
/begin CHARACTERISTIC T_HINSYNSPORT54 "Zeit fuer Ende Haltephase in Synchron KZU/KAB" VALUE 0x1D79FE ZF_kw_ui8_S5_S3 2540 UMR_MSEC__10_1_0_S5_S3 0 2540 /end CHARACTERISTIC
/begin CHARACTERISTIC T_HINSYNSPORT63 "Zeit fuer Ende Haltephase in Synchron KZU/KAB" VALUE 0x1D7A16 ZF_kw_ui8_S5_S3 2540 UMR_MSEC__10_1_0_S5_S3 0 2540 /end CHARACTERISTIC
/begin CHARACTERISTIC T_HINSYNSPORT64 "Zeit fuer Ende Haltephase in Synchron KZU/KAB" VALUE 0x1D7A19 ZF_kw_ui8_S5_S3 2540 UMR_MSEC__10_1_0_S5_S3 0 2540 /end CHARACTERISTIC
/begin CHARACTERISTIC T_HINSYNSPORT65 "Zeit fuer Ende Haltephase in Synchron KZU/KAB" VALUE 0x1D7A01 ZF_kw_ui8_S5_S3 2540 UMR_MSEC__10_1_0_S5_S3 0 2540 /end CHARACTERISTIC
/begin CHARACTERISTIC T_HINSYNSPORT71 "Zeit fuer Ende Haltephase in Synchron KZU/KAB" VALUE 0x1D7A1C ZF_kw_ui8_S5_S3 2540 UMR_MSEC__10_1_0_S5_S3 0 2540 /end CHARACTERISTIC
/begin CHARACTERISTIC T_HINSYNSPORT75 "Zeit fuer Ende Haltephase in Synchron KZU/KAB" VALUE 0x1D7A1F ZF_kw_ui8_S5_S3 2540 UMR_MSEC__10_1_0_S5_S3 0 2540 /end CHARACTERISTIC
/begin CHARACTERISTIC T_HINSYNSPORT76 "Zeit fuer Ende Haltephase in Synchron KZU/KAB" VALUE 0x1D7A04 ZF_kw_ui8_S5_S3 2540 UMR_MSEC__10_1_0_S5_S3 0 2540 /end CHARACTERISTIC
/begin CHARACTERISTIC T_HINSYNSPORT82 "Zeit fuer Ende Haltephase in Synchron KZU/KAB" VALUE 0x1D7A22 ZF_kw_ui8_S5_S3 2540 UMR_MSEC__10_1_0_S5_S3 0 2540 /end CHARACTERISTIC
/begin CHARACTERISTIC T_SYNKABE12 "Zeit vor sync. Ende Schaltdruck KAB" VALUE 0x1D8A42 ZF_kw_si16_S5_S3 5000 UMR_MSEC__10_1_0_S5_S3 -5000 0 /end CHARACTERISTIC
/begin CHARACTERISTIC T_SYNKABE23 "Zeit vor sync. Ende Schaltdruck KAB" VALUE 0x1D8A48 ZF_kw_si16_S5_S3 5000 UMR_MSEC__10_1_0_S5_S3 -5000 0 /end CHARACTERISTIC
/begin CHARACTERISTIC T_SYNKABE34 "Zeit vor sync. Ende Schaltdruck KAB" VALUE 0x1D8A4E ZF_kw_si16_S5_S3 5000 UMR_MSEC__10_1_0_S5_S3 -5000 0 /end CHARACTERISTIC
/begin CHARACTERISTIC T_SYNKABE45 "Zeit vor sync. Ende Schaltdruck KAB" VALUE 0x1D8A54 ZF_kw_si16_S5_S3 5000 UMR_MSEC__10_1_0_S5_S3 -5000 0 /end CHARACTERISTIC
/begin CHARACTERISTIC T_SYNKABE56 "Zeit vor sync. Ende Schaltdruck KAB" VALUE 0x1D8A5A ZF_kw_si16_S5_S3 5000 UMR_MSEC__10_1_0_S5_S3 -5000 0 /end CHARACTERISTIC
/begin CHARACTERISTIC T_SYNKABE67 "Zeit vor sync. Ende Schaltdruck KAB" VALUE 0x1D8A60 ZF_kw_si16_S5_S3 5000 UMR_MSEC__10_1_0_S5_S3 -5000 0 /end CHARACTERISTIC
/begin CHARACTERISTIC T_SYNKABE78 "Zeit vor sync. Ende Schaltdruck KAB" VALUE 0x1D8A66 ZF_kw_si16_S5_S3 5000 UMR_MSEC__10_1_0_S5_S3 -5000 0 /end CHARACTERISTIC
/begin CHARACTERISTIC T_VKABHSSPORT12 "Verzögerungszeit abschaltende Kupplung bei HS" VALUE 0x1D798C ZF_kw_ui8_S5_S3 2000 UMR_MSEC__10_1_0_S5_S3 0 2000 /end CHARACTERISTIC
/begin CHARACTERISTIC T_VKABHSSPORT23 "Verzögerungszeit abschaltende Kupplung bei HS" VALUE 0x1D798D ZF_kw_ui8_S5_S3 2000 UMR_MSEC__10_1_0_S5_S3 0 2000 /end CHARACTERISTIC
/begin CHARACTERISTIC T_VKABHSSPORT34 "Verzögerungszeit abschaltende Kupplung bei HS" VALUE 0x1D798E ZF_kw_ui8_S5_S3 2000 UMR_MSEC__10_1_0_S5_S3 0 2000 /end CHARACTERISTIC
/begin CHARACTERISTIC T_VKABHSSPORT45 "Verzögerungszeit abschaltende Kupplung bei HS" VALUE 0x1D798F ZF_kw_ui8_S5_S3 2000 UMR_MSEC__10_1_0_S5_S3 0 2000 /end CHARACTERISTIC
/begin CHARACTERISTIC T_VKABHSSPORT56 "Verzögerungszeit abschaltende Kupplung bei HS" VALUE 0x1D7990 ZF_kw_ui8_S5_S3 2000 UMR_MSEC__10_1_0_S5_S3 0 2000 /end CHARACTERISTIC
/begin CHARACTERISTIC T_VKABHSSPORT67 "Verzögerungszeit abschaltende Kupplung bei HS" VALUE 0x1D7991 ZF_kw_ui8_S5_S3 2000 UMR_MSEC__10_1_0_S5_S3 0 2000 /end CHARACTERISTIC
/begin CHARACTERISTIC T_VKABHSSPORT78 "Verzögerungszeit abschaltende Kupplung bei HS" VALUE 0x1D7992 ZF_kw_ui8_S5_S3 2000 UMR_MSEC__10_1_0_S5_S3 0 2000 /end CHARACTERISTIC
/begin FUNCTION jSasKabHSP312_Fktn "Applikationesgroessen Instanz jSasKabHSP312"
 /begin DEF_CHARACTERISTIC KF_THKABMTCGSPORT12 KF_TPKABMTCGSPORT12 KL_PHKABMTSPORT12 KL_POKABCGSPORT12 KL_TOPKABNDSPORT12 T_VKABHSSPORT12 /end DEF_CHARACTERISTIC
/end FUNCTION
/begin FUNCTION jSasKabHSP323_Fktn "Applikationesgroessen Instanz jSasKabHSP323"
 /begin DEF_CHARACTERISTIC KF_THKABMTCGSPORT23 KF_TPKABMTCGSPORT23 KL_PHKABMTSPORT23 KL_POKABCGSPORT23 KL_TOPKABNDSPORT23 T_VKABHSSPORT23 /end DEF_CHARACTERISTIC
/end FUNCTION
/begin FUNCTION jSasKabHSP334_Fktn "Applikationesgroessen Instanz jSasKabHSP334"
 /begin DEF_CHARACTERISTIC KF_THKABMTCGSPORT34 KF_TPKABMTCGSPORT34 KL_PHKABMTSPORT34 KL_POKABCGSPORT34 KL_TOPKABNDSPORT34 T_VKABHSSPORT34 /end DEF_CHARACTERISTIC
/end FUNCTION
/begin FUNCTION jSasKabHSP345_Fktn "Applikationesgroessen Instanz jSasKabHSP345"
 /begin DEF_CHARACTERISTIC KF_THKABMTCGSPORT45 KF_TPKABMTCGSPORT45 KL_PHKABMTSPORT45 KL_POKABCGSPORT45 KL_TOPKABNDSPORT45 T_VKABHSSPORT45 /end DEF_CHARACTERISTIC
/end FUNCTION
/begin FUNCTION jSasKabHSP356_Fktn "Applikationesgroessen Instanz jSasKabHSP356"
 /begin DEF_CHARACTERISTIC KF_THKABMTCGSPORT56 KF_TPKABMTCGSPORT56 KL_PHKABMTSPORT56 KL_POKABCGSPORT56 KL_TOPKABNDSPORT56 T_VKABHSSPORT56 /end DEF_CHARACTERISTIC
/end FUNCTION
/begin FUNCTION jSasKabHSP367_Fktn "Applikationesgroessen Instanz jSasKabHSP367"
 /begin DEF_CHARACTERISTIC KF_THKABMTCGSPORT67 KF_TPKABMTCGSPORT67 KL_PHKABMTSPORT67 KL_POKABCGSPORT67 KL_TOPKABNDSPORT67 T_VKABHSSPORT67 /end DEF_CHARACTERISTIC
/end FUNCTION
/begin FUNCTION jSasKabHSP378_Fktn "Applikationesgroessen Instanz jSasKabHSP378"
 /begin DEF_CHARACTERISTIC KF_THKABMTCGSPORT78 KF_TPKABMTCGSPORT78 KL_PHKABMTSPORT78 KL_POKABCGSPORT78 KL_TOPKABNDSPORT78 T_VKABHSSPORT78 /end DEF_CHARACTERISTIC
/end FUNCTION
/begin FUNCTION jSasKabHSS12_Fktn "Applikationesgroessen Instanz jSasKabHSS12" /begin DEF_CHARACTERISTIC KF_PKAB12 PO_HKAB12 PS_ABBSYNISTHS12 TO_HKAB12 T_SYNKABE12 /end DEF_CHARACTERISTIC /end FUNCTION
/begin FUNCTION jSasKabHSS23_Fktn "Applikationesgroessen Instanz jSasKabHSS23" /begin DEF_CHARACTERISTIC KF_PKAB23 PO_HKAB23 PS_ABBSYNISTHS23 TO_HKAB23 T_SYNKABE23 /end DEF_CHARACTERISTIC /end FUNCTION
/begin FUNCTION jSasKabHSS34_Fktn "Applikationesgroessen Instanz jSasKabHSS34" /begin DEF_CHARACTERISTIC KF_PKAB34 PO_HKAB34 PS_ABBSYNISTHS34 TO_HKAB34 T_SYNKABE34 /end DEF_CHARACTERISTIC /end FUNCTION
/begin FUNCTION jSasKabHSS45_Fktn "Applikationesgroessen Instanz jSasKabHSS45" /begin DEF_CHARACTERISTIC KF_PKAB45 PO_HKAB45 PS_ABBSYNISTHS45 TO_HKAB45 T_SYNKABE45 /end DEF_CHARACTERISTIC /end FUNCTION
/begin FUNCTION jSasKabHSS56_Fktn "Applikationesgroessen Instanz jSasKabHSS56" /begin DEF_CHARACTERISTIC KF_PKAB56 PO_HKAB56 PS_ABBSYNISTHS56 TO_HKAB56 T_SYNKABE56 /end DEF_CHARACTERISTIC /end FUNCTION
/begin FUNCTION jSasKabHSS67_Fktn "Applikationesgroessen Instanz jSasKabHSS67" /begin DEF_CHARACTERISTIC KF_PKAB67 PO_HKAB67 PS_ABBSYNISTHS67 TO_HKAB67 T_SYNKABE67 /end DEF_CHARACTERISTIC /end FUNCTION
/begin FUNCTION jSasKabHSS78_Fktn "Applikationesgroessen Instanz jSasKabHSS78" /begin DEF_CHARACTERISTIC KF_PKAB78 PO_HKAB78 PS_ABBSYNISTHS78 TO_HKAB78 T_SYNKABE78 /end DEF_CHARACTERISTIC /end FUNCTION
/begin FUNCTION jSasKabRSP121_Fktn "Applikationesgroessen Instanz jSasKabRSP121"
 /begin DEF_CHARACTERISTIC F_PRAHKAB21 F_PRAHKAB21_EL F_TRAHKAB21 F_TRAHKAB21_EL KF_PKAB21 KF_PKAB21_EL KF_POHINSYNKAB21 KF_TOHKABMTNT21 KF_TOHKABMTNT21_EL KF_TVKABMTNMOTRS21 KL_POHKAB21 KL_POHKAB21_EL KL_TRAHKAB21 KL_TRAHKAB21_EL KL_TRAMTHINSYNKAB21 KL_TSYNMTKAB21 KL_TSYNMTKAB21_EL T_HINSYN21 /end DEF_CHARACTERISTIC
/end FUNCTION
/begin FUNCTION jSasKabRSP132_Fktn "Applikationesgroessen Instanz jSasKabRSP132"
 /begin DEF_CHARACTERISTIC F_PRAHKAB32 F_PRAHKAB32_EL F_TRAHKAB32 F_TRAHKAB32_EL KF_PKAB32 KF_PKAB32_EL KF_POHINSYNKAB32 KF_TOHKABMTNT32 KF_TOHKABMTNT32_EL KF_TVKABMTNMOTRS32 KL_POHKAB32 KL_POHKAB32_EL KL_TRAHKAB32 KL_TRAHKAB32_EL KL_TRAMTHINSYNKAB32 KL_TSYNMTKAB32 KL_TSYNMTKAB32_EL T_HINSYN32 /end DEF_CHARACTERISTIC
/end FUNCTION
/begin FUNCTION jSasKabRSP143_Fktn "Applikationesgroessen Instanz jSasKabRSP143"
 /begin DEF_CHARACTERISTIC F_PRAHKAB43 F_PRAHKAB43_EL F_TRAHKAB43 F_TRAHKAB43_EL KF_PKAB43 KF_PKAB43_EL KF_POHINSYNKAB43 KF_TOHKABMTNT43 KF_TOHKABMTNT43_EL KF_TVKABMTNMOTRS43 KL_POHKAB43 KL_POHKAB43_EL KL_TRAHKAB43 KL_TRAHKAB43_EL KL_TRAMTHINSYNKAB43 KL_TSYNMTKAB43 KL_TSYNMTKAB43_EL T_HINSYN43 /end DEF_CHARACTERISTIC
/end FUNCTION
/begin FUNCTION jSasKabRSP154_Fktn "Applikationesgroessen Instanz jSasKabRSP154"
 /begin DEF_CHARACTERISTIC F_PRAHKAB54 F_PRAHKAB54_EL F_TRAHKAB54 F_TRAHKAB54_EL KF_PKAB54 KF_PKAB54_EL KF_POHINSYNKAB54 KF_TOHKABMTNT54 KF_TOHKABMTNT54_EL KF_TVKABMTNMOTRS54 KL_POHKAB54 KL_POHKAB54_EL KL_TRAHKAB54 KL_TRAHKAB54_EL KL_TRAMTHINSYNKAB54 KL_TSYNMTKAB54 KL_TSYNMTKAB54_EL T_HINSYN54 /end DEF_CHARACTERISTIC
/end FUNCTION
/begin FUNCTION jSasKabRSP165_Fktn "Applikationesgroessen Instanz jSasKabRSP165"
 /begin DEF_CHARACTERISTIC F_PRAHKAB65 F_PRAHKAB65_EL F_TRAHKAB65 F_TRAHKAB65_EL KF_PKAB65 KF_PKAB65_EL KF_POHINSYNKAB65 KF_TOHKABMTNT65 KF_TOHKABMTNT65_EL KF_TVKABMTNMOTRS65 KL_POHKAB65 KL_POHKAB65_EL KL_TRAHKAB65 KL_TRAHKAB65_EL KL_TRAMTHINSYNKAB65 KL_TSYNMTKAB65 KL_TSYNMTKAB65_EL T_HINSYN65 /end DEF_CHARACTERISTIC
/end FUNCTION
/begin FUNCTION jSasKabRSP176_Fktn "Applikationesgroessen Instanz jSasKabRSP176"
 /begin DEF_CHARACTERISTIC F_PRAHKAB76 F_PRAHKAB76_EL F_TRAHKAB76 F_TRAHKAB76_EL KF_PKAB76 KF_PKAB76_EL KF_POHINSYNKAB76 KF_TOHKABMTNT76 KF_TOHKABMTNT76_EL KF_TVKABMTNMOTRS76 KL_POHKAB76 KL_POHKAB76_EL KL_TRAHKAB76 KL_TRAHKAB76_EL KL_TRAMTHINSYNKAB76 KL_TSYNMTKAB76 KL_TSYNMTKAB76_EL T_HINSYN76 /end DEF_CHARACTERISTIC
/end FUNCTION
/begin FUNCTION jSasKabRSP187_Fktn "Applikationesgroessen Instanz jSasKabRSP187"
 /begin DEF_CHARACTERISTIC F_PRAHKAB87 F_PRAHKAB87_EL F_TRAHKAB87 F_TRAHKAB87_EL KF_PKAB87 KF_PKAB87_EL KF_POHINSYNKAB87 KF_TOHKABMTNT87 KF_TOHKABMTNT87_EL KF_TVKABMTNMOTRS87 KL_POHKAB87 KL_POHKAB87_EL KL_TRAHKAB87 KL_TRAHKAB87_EL KL_TRAMTHINSYNKAB87 KL_TSYNMTKAB87 KL_TSYNMTKAB87_EL T_HINSYN87 /end DEF_CHARACTERISTIC
/end FUNCTION
/begin FUNCTION jSasKabRSP221_Fktn "Applikationesgroessen Instanz jSasKabRSP221"
 /begin DEF_CHARACTERISTIC F_PRAHKABSP21 F_TRAHKABSP21 KF_PKABSP21 KF_POHINSYNKABSP21 KF_TOHKABMTNTSP21 KF_TVKABMTNMOTRSSP21 KL_POHKABSP21 KL_TRAHKABSP21 KL_TRAMTHINSYNKABSP21 KL_TSYNMTKABSP21 T_HINSYNSP21 /end DEF_CHARACTERISTIC
/end FUNCTION
/begin FUNCTION jSasKabRSP231_Fktn "Applikationesgroessen Instanz jSasKabRSP231"
 /begin DEF_CHARACTERISTIC F_PRAHKABSP31 F_TRAHKABSP31 KF_PKABSP31 KF_POHINSYNKABSP31 KF_TOHKABMTNTSP31 KF_TVKABMTNMOTRSSP31 KL_POHKABSP31 KL_TRAHKABSP31 KL_TRAMTHINSYNKABSP31 KL_TSYNMTKABSP31 T_HINSYNSP31 /end DEF_CHARACTERISTIC
/end FUNCTION
/begin FUNCTION jSasKabRSP232_Fktn "Applikationesgroessen Instanz jSasKabRSP232"
 /begin DEF_CHARACTERISTIC F_PRAHKABSP32 F_TRAHKABSP32 KF_PKABSP32 KF_POHINSYNKABSP32 KF_TOHKABMTNTSP32 KF_TVKABMTNMOTRSSP32 KL_POHKABSP32 KL_TRAHKABSP32 KL_TRAMTHINSYNKABSP32 KL_TSYNMTKABSP32 T_HINSYNSP32 /end DEF_CHARACTERISTIC
/end FUNCTION
/begin FUNCTION jSasKabRSP242_Fktn "Applikationesgroessen Instanz jSasKabRSP242"
 /begin DEF_CHARACTERISTIC F_PRAHKABSP42 F_TRAHKABSP42 KF_PKABSP42 KF_POHINSYNKABSP42 KF_TOHKABMTNTSP42 KF_TVKABMTNMOTRSSP42 KL_POHKABSP42 KL_TRAHKABSP42 KL_TRAMTHINSYNKABSP42 KL_TSYNMTKABSP42 T_HINSYNSP42 /end DEF_CHARACTERISTIC
/end FUNCTION
/begin FUNCTION jSasKabRSP243_Fktn "Applikationesgroessen Instanz jSasKabRSP243"
 /begin DEF_CHARACTERISTIC F_PRAHKABSP43 F_TRAHKABSP43 KF_PKABSP43 KF_POHINSYNKABSP43 KF_TOHKABMTNTSP43 KF_TVKABMTNMOTRSSP43 KL_POHKABSP43 KL_TRAHKABSP43 KL_TRAMTHINSYNKABSP43 KL_TSYNMTKABSP43 T_HINSYNSP43 /end DEF_CHARACTERISTIC
/end FUNCTION
/begin FUNCTION jSasKabRSP251_Fktn "Applikationesgroessen Instanz jSasKabRSP251"
 /begin DEF_CHARACTERISTIC F_PRAHKABSP51 F_TRAHKABSP51 KF_PKABSP51 KF_POHINSYNKABSP51 KF_TOHKABMTNTSP51 KF_TVKABMTNMOTRSSP51 KL_POHKABSP51 KL_TRAHKABSP51 KL_TRAMTHINSYNKABSP51 KL_TSYNMTKABSP51 T_HINSYNSP51 /end DEF_CHARACTERISTIC
/end FUNCTION
/begin FUNCTION jSasKabRSP253_Fktn "Applikationesgroessen Instanz jSasKabRSP253"
 /begin DEF_CHARACTERISTIC F_PRAHKABSP53 F_TRAHKABSP53 KF_PKABSP53 KF_POHINSYNKABSP53 KF_TOHKABMTNTSP53 KF_TVKABMTNMOTRSSP53 KL_POHKABSP53 KL_TRAHKABSP53 KL_TRAMTHINSYNKABSP53 KL_TSYNMTKABSP53 T_HINSYNSP53 /end DEF_CHARACTERISTIC
/end FUNCTION
/begin FUNCTION jSasKabRSP254_Fktn "Applikationesgroessen Instanz jSasKabRSP254"
 /begin DEF_CHARACTERISTIC F_PRAHKABSP54 F_TRAHKABSP54 KF_PKABSP54 KF_POHINSYNKABSP54 KF_TOHKABMTNTSP54 KF_TVKABMTNMOTRSSP54 KL_POHKABSP54 KL_TRAHKABSP54 KL_TRAMTHINSYNKABSP54 KL_TSYNMTKABSP54 T_HINSYNSP54 /end DEF_CHARACTERISTIC
/end FUNCTION
/begin FUNCTION jSasKabRSP263_Fktn "Applikationesgroessen Instanz jSasKabRSP263"
 /begin DEF_CHARACTERISTIC F_PRAHKABSP63 F_TRAHKABSP63 KF_PKABSP63 KF_POHINSYNKABSP63 KF_TOHKABMTNTSP63 KF_TVKABMTNMOTRSSP63 KL_POHKABSP63 KL_TRAHKABSP63 KL_TRAMTHINSYNKABSP63 KL_TSYNMTKABSP63 T_HINSYNSP63 /end DEF_CHARACTERISTIC
/end FUNCTION
/begin FUNCTION jSasKabRSP264_Fktn "Applikationesgroessen Instanz jSasKabRSP264"
 /begin DEF_CHARACTERISTIC F_PRAHKABSP64 F_TRAHKABSP64 KF_PKABSP64 KF_POHINSYNKABSP64 KF_TOHKABMTNTSP64 KF_TVKABMTNMOTRSSP64 KL_POHKABSP64 KL_TRAHKABSP64 KL_TRAMTHINSYNKABSP64 KL_TSYNMTKABSP64 T_HINSYNSP64 /end DEF_CHARACTERISTIC
/end FUNCTION
/begin FUNCTION jSasKabRSP265_Fktn "Applikationesgroessen Instanz jSasKabRSP265"
 /begin DEF_CHARACTERISTIC F_PRAHKABSP65 F_TRAHKABSP65 KF_PKABSP65 KF_POHINSYNKABSP65 KF_TOHKABMTNTSP65 KF_TVKABMTNMOTRSSP65 KL_POHKABSP65 KL_TRAHKABSP65 KL_TRAMTHINSYNKABSP65 KL_TSYNMTKABSP65 T_HINSYNSP65 /end DEF_CHARACTERISTIC
/end FUNCTION
/begin FUNCTION jSasKabRSP271_Fktn "Applikationesgroessen Instanz jSasKabRSP271"
 /begin DEF_CHARACTERISTIC F_PRAHKABSP71 F_TRAHKABSP71 KF_PKABSP71 KF_POHINSYNKABSP71 KF_TOHKABMTNTSP71 KF_TVKABMTNMOTRSSP71 KL_POHKABSP71 KL_TRAHKABSP71 KL_TRAMTHINSYNKABSP71 KL_TSYNMTKABSP71 T_HINSYNSP71 /end DEF_CHARACTERISTIC
/end FUNCTION
/begin FUNCTION jSasKabRSP275_Fktn "Applikationesgroessen Instanz jSasKabRSP275"
 /begin DEF_CHARACTERISTIC F_PRAHKABSP75 F_TRAHKABSP75 KF_PKABSP75 KF_POHINSYNKABSP75 KF_TOHKABMTNTSP75 KF_TVKABMTNMOTRSSP75 KL_POHKABSP75 KL_TRAHKABSP75 KL_TRAMTHINSYNKABSP75 KL_TSYNMTKABSP75 T_HINSYNSP75 /end DEF_CHARACTERISTIC
/end FUNCTION
/begin FUNCTION jSasKabRSP276_Fktn "Applikationesgroessen Instanz jSasKabRSP276"
 /begin DEF_CHARACTERISTIC F_PRAHKABSP76 F_TRAHKABSP76 KF_PKABSP76 KF_POHINSYNKABSP76 KF_TOHKABMTNTSP76 KF_TVKABMTNMOTRSSP76 KL_POHKABSP76 KL_TRAHKABSP76 KL_TRAMTHINSYNKABSP76 KL_TSYNMTKABSP76 T_HINSYNSP76 /end DEF_CHARACTERISTIC
/end FUNCTION
/begin FUNCTION jSasKabRSP282_Fktn "Applikationesgroessen Instanz jSasKabRSP282"
 /begin DEF_CHARACTERISTIC F_PRAHKABSP82 F_TRAHKABSP82 KF_PKABSP82 KF_POHINSYNKABSP82 KF_TOHKABMTNTSP82 KF_TVKABMTNMOTRSSP82 KL_POHKABSP82 KL_TRAHKABSP82 KL_TRAMTHINSYNKABSP82 KL_TSYNMTKABSP82 T_HINSYNSP82 /end DEF_CHARACTERISTIC
/end FUNCTION
/begin FUNCTION jSasKabRSP284_Fktn "Applikationesgroessen Instanz jSasKabRSP284"
 /begin DEF_CHARACTERISTIC F_PRAHKABSP84 F_TRAHKABSP84 KF_PKABSP84 KF_POHINSYNKABSP84 KF_TOHKABMTNTSP84 KF_TVKABMTNMOTRSSP84 KL_POHKABSP84 KL_TRAHKABSP84 KL_TRAMTHINSYNKABSP84 KL_TSYNMTKABSP84 T_HINSYNSP84 /end DEF_CHARACTERISTIC
/end FUNCTION
/begin FUNCTION jSasKabRSP286_Fktn "Applikationesgroessen Instanz jSasKabRSP286"
 /begin DEF_CHARACTERISTIC F_PRAHKABSP86 F_TRAHKABSP86 KF_PKABSP86 KF_POHINSYNKABSP86 KF_TOHKABMTNTSP86 KF_TVKABMTNMOTRSSP86 KL_POHKABSP86 KL_TRAHKABSP86 KL_TRAMTHINSYNKABSP86 KL_TSYNMTKABSP86 T_HINSYNSP86 /end DEF_CHARACTERISTIC
/end FUNCTION
/begin FUNCTION jSasKabRSP287_Fktn "Applikationesgroessen Instanz jSasKabRSP287"
 /begin DEF_CHARACTERISTIC F_PRAHKABSP87 F_TRAHKABSP87 KF_PKABSP87 KF_POHINSYNKABSP87 KF_TOHKABMTNTSP87 KF_TVKABMTNMOTRSSP87 KL_POHKABSP87 KL_TRAHKABSP87 KL_TRAMTHINSYNKABSP87 KL_TSYNMTKABSP87 T_HINSYNSP87 /end DEF_CHARACTERISTIC
/end FUNCTION
/begin FUNCTION jSasKabRSP321_Fktn "Applikationesgroessen Instanz jSasKabRSP321"
 /begin DEF_CHARACTERISTIC F_PRAHKABSPORT21 F_TRAHKABSPORT21 KF_PKABSPORT21 KF_POHINSYNKABSPORT21 KF_TOHKABMTNTSPORT21 KF_TVKABMTNMOTRSSPORT21 KL_POHKABSPORT21 KL_TRAHKABSPORT21 KL_TRAMTHINSYNKABSPORT21 KL_TSYNMTKABSPORT21 T_HINSYNSPORT21 /end DEF_CHARACTERISTIC
/end FUNCTION
/begin FUNCTION jSasKabRSP331_Fktn "Applikationesgroessen Instanz jSasKabRSP331"
 /begin DEF_CHARACTERISTIC F_PRAHKABSPORT31 F_TRAHKABSPORT31 KF_PKABSPORT31 KF_POHINSYNKABSPORT31 KF_TOHKABMTNTSPORT31 KF_TVKABMTNMOTRSSPORT31 KL_POHKABSPORT31 KL_TRAHKABSPORT31 KL_TRAMTHINSYNKABSPORT31 KL_TSYNMTKABSPORT31 T_HINSYNSPORT31 /end DEF_CHARACTERISTIC
/end FUNCTION
/begin FUNCTION jSasKabRSP332_Fktn "Applikationesgroessen Instanz jSasKabRSP332"
 /begin DEF_CHARACTERISTIC F_PRAHKABSPORT32 F_TRAHKABSPORT32 KF_PKABSPORT32 KF_POHINSYNKABSPORT32 KF_TOHKABMTNTSPORT32 KF_TVKABMTNMOTRSSPORT32 KL_POHKABSPORT32 KL_TRAHKABSPORT32 KL_TRAMTHINSYNKABSPORT32 KL_TSYNMTKABSPORT32 T_HINSYNSPORT32 /end DEF_CHARACTERISTIC
/end FUNCTION
/begin FUNCTION jSasKabRSP342_Fktn "Applikationesgroessen Instanz jSasKabRSP342"
 /begin DEF_CHARACTERISTIC F_PRAHKABSPORT42 F_TRAHKABSPORT42 KF_PKABSPORT42 KF_POHINSYNKABSPORT42 KF_TOHKABMTNTSPORT42 KF_TVKABMTNMOTRSSPORT42 KL_POHKABSPORT42 KL_TRAHKABSPORT42 KL_TRAMTHINSYNKABSPORT42 KL_TSYNMTKABSPORT42 T_HINSYNSPORT42 /end DEF_CHARACTERISTIC
/end FUNCTION
/begin FUNCTION jSasKabRSP343_Fktn "Applikationesgroessen Instanz jSasKabRSP343"
 /begin DEF_CHARACTERISTIC F_PRAHKABSPORT43 F_TRAHKABSPORT43 KF_PKABSPORT43 KF_POHINSYNKABSPORT43 KF_TOHKABMTNTSPORT43 KF_TVKABMTNMOTRSSPORT43 KL_POHKABSPORT43 KL_TRAHKABSPORT43 KL_TRAMTHINSYNKABSPORT43 KL_TSYNMTKABSPORT43 T_HINSYNSPORT43 /end DEF_CHARACTERISTIC
/end FUNCTION
/begin FUNCTION jSasKabRSP351_Fktn "Applikationesgroessen Instanz jSasKabRSP351"
 /begin DEF_CHARACTERISTIC F_PRAHKABSPORT51 F_TRAHKABSPORT51 KF_PKABSPORT51 KF_POHINSYNKABSPORT51 KF_TOHKABMTNTSPORT51 KF_TVKABMTNMOTRSSPORT51 KL_POHKABSPORT51 KL_TRAHKABSPORT51 KL_TRAMTHINSYNKABSPORT51 KL_TSYNMTKABSPORT51 T_HINSYNSPORT51 /end DEF_CHARACTERISTIC
/end FUNCTION
/begin FUNCTION jSasKabRSP353_Fktn "Applikationesgroessen Instanz jSasKabRSP353"
 /begin DEF_CHARACTERISTIC F_PRAHKABSPORT53 F_TRAHKABSPORT53 KF_PKABSPORT53 KF_POHINSYNKABSPORT53 KF_TOHKABMTNTSPORT53 KF_TVKABMTNMOTRSSPORT53 KL_POHKABSPORT53 KL_TRAHKABSPORT53 KL_TRAMTHINSYNKABSPORT53 KL_TSYNMTKABSPORT53 T_HINSYNSPORT53 /end DEF_CHARACTERISTIC
/end FUNCTION
/begin FUNCTION jSasKabRSP354_Fktn "Applikationesgroessen Instanz jSasKabRSP354"
 /begin DEF_CHARACTERISTIC F_PRAHKABSPORT54 F_TRAHKABSPORT54 KF_PKABSPORT54 KF_POHINSYNKABSPORT54 KF_TOHKABMTNTSPORT54 KF_TVKABMTNMOTRSSPORT54 KL_POHKABSPORT54 KL_TRAHKABSPORT54 KL_TRAMTHINSYNKABSPORT54 KL_TSYNMTKABSPORT54 T_HINSYNSPORT54 /end DEF_CHARACTERISTIC
/end FUNCTION
/begin FUNCTION jSasKabRSP363_Fktn "Applikationesgroessen Instanz jSasKabRSP363"
 /begin DEF_CHARACTERISTIC F_PRAHKABSPORT63 F_TRAHKABSPORT63 KF_PKABSPORT63 KF_POHINSYNKABSPORT63 KF_TOHKABMTNTSPORT63 KF_TVKABMTNMOTRSSPORT63 KL_POHKABSPORT63 KL_TRAHKABSPORT63 KL_TRAMTHINSYNKABSPORT63 KL_TSYNMTKABSPORT63 T_HINSYNSPORT63 /end DEF_CHARACTERISTIC
/end FUNCTION
/begin FUNCTION jSasKabRSP364_Fktn "Applikationesgroessen Instanz jSasKabRSP364"
 /begin DEF_CHARACTERISTIC F_PRAHKABSPORT64 F_TRAHKABSPORT64 KF_PKABSPORT64 KF_POHINSYNKABSPORT64 KF_TOHKABMTNTSPORT64 KF_TVKABMTNMOTRSSPORT64 KL_POHKABSPORT64 KL_TRAHKABSPORT64 KL_TRAMTHINSYNKABSPORT64 KL_TSYNMTKABSPORT64 T_HINSYNSPORT64 /end DEF_CHARACTERISTIC
/end FUNCTION
/begin FUNCTION jSasKabRSP365_Fktn "Applikationesgroessen Instanz jSasKabRSP365"
 /begin DEF_CHARACTERISTIC F_PRAHKABSPORT65 F_TRAHKABSPORT65 KF_PKABSPORT65 KF_POHINSYNKABSPORT65 KF_TOHKABMTNTSPORT65 KF_TVKABMTNMOTRSSPORT65 KL_POHKABSPORT65 KL_TRAHKABSPORT65 KL_TRAMTHINSYNKABSPORT65 KL_TSYNMTKABSPORT65 T_HINSYNSPORT65 /end DEF_CHARACTERISTIC
/end FUNCTION
/begin FUNCTION jSasKabRSP371_Fktn "Applikationesgroessen Instanz jSasKabRSP371"
 /begin DEF_CHARACTERISTIC F_PRAHKABSPORT71 F_TRAHKABSPORT71 KF_PKABSPORT71 KF_POHINSYNKABSPORT71 KF_TOHKABMTNTSPORT71 KF_TVKABMTNMOTRSSPORT71 KL_POHKABSPORT71 KL_TRAHKABSPORT71 KL_TRAMTHINSYNKABSPORT71 KL_TSYNMTKABSPORT71 T_HINSYNSPORT71 /end DEF_CHARACTERISTIC
/end FUNCTION
/begin FUNCTION jSasKabRSP375_Fktn "Applikationesgroessen Instanz jSasKabRSP375"
 /begin DEF_CHARACTERISTIC F_PRAHKABSPORT75 F_TRAHKABSPORT75 KF_PKABSPORT75 KF_POHINSYNKABSPORT75 KF_TOHKABMTNTSPORT75 KF_TVKABMTNMOTRSSPORT75 KL_POHKABSPORT75 KL_TRAHKABSPORT75 KL_TRAMTHINSYNKABSPORT75 KL_TSYNMTKABSPORT75 T_HINSYNSPORT75 /end DEF_CHARACTERISTIC
/end FUNCTION
/begin FUNCTION jSasKabRSP376_Fktn "Applikationesgroessen Instanz jSasKabRSP376"
 /begin DEF_CHARACTERISTIC F_PRAHKABSPORT76 F_TRAHKABSPORT76 KF_PKABSPORT76 KF_POHINSYNKABSPORT76 KF_TOHKABMTNTSPORT76 KF_TVKABMTNMOTRSSPORT76 KL_POHKABSPORT76 KL_TRAHKABSPORT76 KL_TRAMTHINSYNKABSPORT76 KL_TSYNMTKABSPORT76 T_HINSYNSPORT76 /end DEF_CHARACTERISTIC
/end FUNCTION
/begin FUNCTION jSasKabRSP382_Fktn "Applikationesgroessen Instanz jSasKabRSP382"
 /begin DEF_CHARACTERISTIC F_PRAHKABSPORT82 F_TRAHKABSPORT82 KF_PKABSPORT82 KF_POHINSYNKABSPORT82 KF_TOHKABMTNTSPORT82 KF_TVKABMTNMOTRSSPORT82 KL_POHKABSPORT82 KL_TRAHKABSPORT82 KL_TRAMTHINSYNKABSPORT82 KL_TSYNMTKABSPORT82 T_HINSYNSPORT82 /end DEF_CHARACTERISTIC
/end FUNCTION
/begin RECORD_LAYOUT ZF_kf_si16_S5_S3 FNC_VALUES 5 SWORD ROW_DIR DIRECT AXIS_PTS_X 3 SWORD INDEX_INCR DIRECT AXIS_PTS_Y 4 SWORD INDEX_INCR DIRECT NO_AXIS_PTS_X 1 ULONG NO_AXIS_PTS_Y 2 ULONG /end RECORD_LAYOUT
/begin RECORD_LAYOUT ZF_kf_ui8_S5_S3 FNC_VALUES 5 UBYTE ROW_DIR DIRECT AXIS_PTS_X 3 UBYTE INDEX_INCR DIRECT AXIS_PTS_Y 4 UBYTE INDEX_INCR DIRECT NO_AXIS_PTS_X 1 ULONG NO_AXIS_PTS_Y 2 ULONG /end RECORD_LAYOUT
/begin RECORD_LAYOUT ZF_kl_si16_S5_S3 FNC_VALUES 3 SWORD COLUMN_DIR DIRECT AXIS_PTS_X 2 SWORD INDEX_INCR DIRECT NO_AXIS_PTS_X 1 ULONG /end RECORD_LAYOUT
/begin RECORD_LAYOUT ZF_kl_ui8_S5_S3 FNC_VALUES 3 UBYTE COLUMN_DIR DIRECT AXIS_PTS_X 2 UBYTE INDEX_INCR DIRECT NO_AXIS_PTS_X 1 ULONG /end RECORD_LAYOUT
/begin RECORD_LAYOUT ZF_kw_si16_S5_S3 FNC_VALUES 1 SWORD COLUMN_DIR DIRECT /end RECORD_LAYOUT
/begin RECORD_LAYOUT ZF_kw_ui8_S5_S3 FNC_VALUES 1 UBYTE COLUMN_DIR DIRECT /end RECORD_LAYOUT
/end MODULE
/end PROJECT
