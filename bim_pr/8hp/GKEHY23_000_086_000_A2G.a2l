ASAP2_VERSION 1 51
/begin PROJECT ZHBC8600 "Gen2_BMW_System_Supplier_Lib"
/begin MODULE CPP ""
/begin MOD_COMMON "" BYTE_ORDER MSB_FIRST ALIGNMENT_BYTE 1 ALIGNMENT_WORD 2 ALIGNMENT_LONG 4 ALIGNMENT_FLOAT32_IEEE 4 ALIGNMENT_FLOAT64_IEEE 1 /end MOD_COMMON
/begin COMPU_VTAB Conv.cBibRingSpeicher._.init_S5_S3 "Umrechnung fuer Messgroesse cBibRingSpeicher::init" TAB_VERB 2 0 "FALSE" 1 "TRUE" DEFAULT_VALUE "" /end COMPU_VTAB
/begin COMPU_METHOD Conv.cBibRingSpeicher._.init_S5_S3 "Umrechnung fuer Messgroesse cBibRingSpeicher::init" TAB_VERB "%4.0" "" COMPU_TAB_REF Conv.cBibRingSpeicher._.init_S5_S3 /end COMPU_METHOD
/begin COMPU_METHOD default_M "" RAT_FUNC "%6.2" "" COEFFS 0 1 0 0 0 1 /end COMPU_METHOD
/begin COMPU_METHOD EH_100PROZENT255_S4_S3 "int = ((phys * 255) / 100) - (0) %" RAT_FUNC "%5.4" "%" COEFFS 0 2.55 0 0 0 1 /end COMPU_METHOD
/begin COMPU_METHOD EH_C_1CEL_M40_S4_S3 "int = ((phys * 1) / 1) - (-40) Grad Celsius" RAT_FUNC "%1.0" "Grad Celsius" COEFFS 0 1 40 0 0 1 /end COMPU_METHOD
/begin COMPU_METHOD EH_C_1K_S4_S3 "int = ((phys * 1) / 1) - (0) Kelvin" RAT_FUNC "%1.0" "Kelvin" COEFFS 0 1 0 0 0 1 /end COMPU_METHOD
/begin COMPU_METHOD EH_N_1RPM_S4_S3 "int = ((phys * 1) / 1) - (0) 1/min" RAT_FUNC "%1.0" "1/min" COEFFS 0 1 0 0 0 1 /end COMPU_METHOD
/begin COMPU_METHOD EH_N_RPM4_S4_S3 "int = ((phys * 4) / 1) - (0) 1/min" RAT_FUNC "%3.2" "1/min" COEFFS 0 4 0 0 0 1 /end COMPU_METHOD
/begin COMPU_METHOD EH_STANDARD_S4_S3 "int = ((phys * 1) / 1) - (0) -" RAT_FUNC "%1.0" "-" COEFFS 0 1 0 0 0 1 /end COMPU_METHOD
/begin COMPU_METHOD EH_T_1MS_S4_S3 "int = ((phys * 1) / 1) - (0) ms" RAT_FUNC "%1.0" "ms" COEFFS 0 1 0 0 0 1 /end COMPU_METHOD
/begin COMPU_METHOD EH_T_1S_S4_S3 "int = ((phys * 1) / 1) - (0) s" RAT_FUNC "%1.0" "s" COEFFS 0 1 0 0 0 1 /end COMPU_METHOD
/begin COMPU_METHOD EH_U_1VOLT1000_S4_S3 "int = ((phys * 1000) / 1) - (0) V" RAT_FUNC "%4.3" "V" COEFFS 0 1000 0 0 0 1 /end COMPU_METHOD
/begin COMPU_METHOD SAB_C_CGT_1CEL_M40_S2_S3 "int = ((phys * 1) / 1) - (-40) Grad Celsius" RAT_FUNC "%1.0" "Grad Celsius" COEFFS 0 1 40 0 0 1 /end COMPU_METHOD
/begin COMPU_METHOD SAB_K10000_M10_S2_S3 "int = ((phys * 10000) / 1) - (-100000) -" RAT_FUNC "%5.4" "-" COEFFS 0 10000 100000 0 0 1 /end COMPU_METHOD
/begin COMPU_METHOD SAB_K1000_S2_S3 "int = ((phys * 1000) / 1) - (0) -" RAT_FUNC "%4.3" "-" COEFFS 0 1000 0 0 0 1 /end COMPU_METHOD
/begin COMPU_METHOD SAB_K10_S2_S3 "int = ((phys * 10) / 1) - (0) -" RAT_FUNC "%4.3" "-" COEFFS 0 10 0 0 0 1 /end COMPU_METHOD
/begin COMPU_METHOD SAB_L_1MM_S2_S3 "int = ((phys * 1) / 1) - (0) mm" RAT_FUNC "%1.0" "mm" COEFFS 0 1 0 0 0 1 /end COMPU_METHOD
/begin COMPU_METHOD SAB_N_1RPM_S2_S3 "int = ((phys * 1) / 1) - (0) 1/min" RAT_FUNC "%1.0" "1/min" COEFFS 0 1 0 0 0 1 /end COMPU_METHOD
/begin COMPU_METHOD SAB_PROZENT10_S2_S3 "int = ((phys * 10) / 1) - (0) %" RAT_FUNC "%4.3" "%" COEFFS 0 10 0 0 0 1 /end COMPU_METHOD
/begin COMPU_METHOD SAB_STANDARD_S2_S3 "int = ((phys * 1) / 1) - (0) -" RAT_FUNC "%1.0" "-" COEFFS 0 1 0 0 0 1 /end COMPU_METHOD
/begin COMPU_METHOD SAB_T_TIMER_10MS_S2_S3 "int = ((phys * 1) / 10) - (0) ms" RAT_FUNC "%4.3" "ms" COEFFS 0 0.1 0 0 0 1 /end COMPU_METHOD
/begin COMPU_METHOD SAB_U_1VOLT1000_S2_S3 "int = ((phys * 1000) / 1) - (0) Volt" RAT_FUNC "%4.3" "Volt" COEFFS 0 1000 0 0 0 1 /end COMPU_METHOD
/begin COMPU_METHOD SBW_CGT40_M_S1_S3 "int = ((phys * 1) / 1) - (-40) Grad Celsius" RAT_FUNC "%1.0" "Grad Celsius" COEFFS 0 1 40 0 0 1 /end COMPU_METHOD
/begin COMPU_METHOD SBW_HDK_M_S1_S3 "int = ((phys * 2550) / 1004) - (0) %" RAT_FUNC "%3.2" "%" COEFFS 0 2.53984063745 0 0 0 1 /end COMPU_METHOD
/begin COMPU_METHOD SBW_STANDARD_S1_S3 "int = ((phys * 1) / 1) - (0) -" RAT_FUNC "%1.0" "-" COEFFS 0 1 0 0 0 1 /end COMPU_METHOD
/begin COMPU_METHOD SBW_TAUSENDSTEL_U_S1_S3 "int = ((phys * 1000) / 1) - (0) V" RAT_FUNC "%4.3" "V" COEFFS 0 1000 0 0 0 1 /end COMPU_METHOD
/begin COMPU_METHOD SBW_TIMER_10MS_S1_S3 "int = ((phys * 1) / 10) - (0) ms" RAT_FUNC "%1.0" "ms" COEFFS 0 0.1 0 0 0 1 /end COMPU_METHOD
/begin COMPU_METHOD SBW_TIMER_1S_S1_S3 "int = ((phys * 1) / 1) - (0) s" RAT_FUNC "%1.0" "s" COEFFS 0 1 0 0 0 1 /end COMPU_METHOD
/begin COMPU_METHOD SBW_U_STD_S1_S3 "int = ((phys * 1) / 1) - (0) V" RAT_FUNC "%1.0" "V" COEFFS 0 1 0 0 0 1 /end COMPU_METHOD
/begin COMPU_METHOD SBW_VKMH_16_S1_S3 "int = ((phys * 16) / 1) - (0) km/h" RAT_FUNC "%3.2" "km/h" COEFFS 0 16 0 0 0 1 /end COMPU_METHOD
/begin COMPU_METHOD UMR___1_100_0_S5_S3 "int = ((phys * 100) / 1) - (0) [-]" RAT_FUNC "%3.2" "[-]" COEFFS 0 100 0 0 0 1 /end COMPU_METHOD
/begin COMPU_METHOD UMR___1_1_0_3_S5_S3 "int = ((phys * 1) / 1) - (0) [-]" RAT_FUNC "%1.0" "[-]" COEFFS 0 1 0 0 0 1 /end COMPU_METHOD
/begin COMPU_METHOD UMR___1_1_0_S5_S3 "int = ((phys * 1) / 1) - (0) [-]" RAT_FUNC "%1.0" "[-]" COEFFS 0 1 0 0 0 1 /end COMPU_METHOD
/begin COMPU_METHOD UMR_BAR__1_1000_0_S5_S3 "int = ((phys * 1000) / 1) - (0) [bar]" RAT_FUNC "%4.3" "[bar]" COEFFS 0 1000 0 0 0 1 /end COMPU_METHOD
/begin COMPU_METHOD UMR_BAR__1_100_0_S5_S3 "int = ((phys * 100) / 1) - (0) [bar]" RAT_FUNC "%3.2" "[bar]" COEFFS 0 100 0 0 0 1 /end COMPU_METHOD
/begin COMPU_METHOD UMR_BAR_SEC_1_10_0_S5_S3 "int = ((phys * 10) / 1) - (0) [bar/s]" RAT_FUNC "%2.1" "[bar/s]" COEFFS 0 10 0 0 0 1 /end COMPU_METHOD
/begin COMPU_METHOD UMR_GRAD__1_3_M128_S5_S3 "int = ((phys * 3) / 1) - (-128) [Grad]" RAT_FUNC "%4.3" "[Grad]" COEFFS 0 3 128 0 0 1 /end COMPU_METHOD
/begin COMPU_METHOD UMR_GRADC__1_1_0_S5_S3 "int = ((phys * 1) / 1) - (0) [°C]" RAT_FUNC "%1.0" "[°C]" COEFFS 0 1 0 0 0 1 /end COMPU_METHOD
/begin COMPU_METHOD UMR_GRADC__1_1_M40_S5_S3 "int = ((phys * 1) / 1) - (-40) [°C]" RAT_FUNC "%1.0" "[°C]" COEFFS 0 1 40 0 0 1 /end COMPU_METHOD
/begin COMPU_METHOD UMR_KGM2__1_100_0_S5_S3 "int = ((phys * 100) / 1) - (0) [kg*m^2]" RAT_FUNC "%3.2" "[kg*m^2]" COEFFS 0 100 0 0 0 1 /end COMPU_METHOD
/begin COMPU_METHOD UMR_KM_H_1_16_0_S5_S3 "int = ((phys * 16) / 1) - (0) [km/h]" RAT_FUNC "%3.2" "[km/h]" COEFFS 0 16 0 0 0 1 /end COMPU_METHOD
/begin COMPU_METHOD UMR_KW__1_1000_0_S5_S3 "int = ((phys * 1000) / 1) - (0) [KW]" RAT_FUNC "%4.3" "[KW]" COEFFS 0 1000 0 0 0 1 /end COMPU_METHOD
/begin COMPU_METHOD UMR_KW__1_10_0_S5_S3 "int = ((phys * 10) / 1) - (0) [KW]" RAT_FUNC "%2.1" "[KW]" COEFFS 0 10 0 0 0 1 /end COMPU_METHOD
/begin COMPU_METHOD UMR_LITER_MIN_1_10_0_S5_S3 "int = ((phys * 10) / 1) - (0) [Liter/min]" RAT_FUNC "%2.1" "[Liter/min]" COEFFS 0 10 0 0 0 1 /end COMPU_METHOD
/begin COMPU_METHOD UMR_M_SEC2_1_32_0_S5_S3 "int = ((phys * 32) / 1) - (0) [m/s^2]" RAT_FUNC "%3.2" "[m/s^2]" COEFFS 0 32 0 0 0 1 /end COMPU_METHOD
/begin COMPU_METHOD UMR_MSEC__10_1_0_S5_S3 "int = ((phys * 1) / 10) - (0) [ms]" RAT_FUNC "%1.0" "[ms]" COEFFS 0 0.1 0 0 0 1 /end COMPU_METHOD
/begin COMPU_METHOD UMR_MSEC__1_1_0_S5_S3 "int = ((phys * 1) / 1) - (0) [ms]" RAT_FUNC "%1.0" "[ms]" COEFFS 0 1 0 0 0 1 /end COMPU_METHOD
/begin COMPU_METHOD UMR_NM__1_1_0_S5_S3 "int = ((phys * 1) / 1) - (0) [Nm]" RAT_FUNC "%1.0" "[Nm]" COEFFS 0 1 0 0 0 1 /end COMPU_METHOD
/begin COMPU_METHOD UMR_NM_BAR_1_1_0_S5_S3 "int = ((phys * 1) / 1) - (0) [Nm/bar]" RAT_FUNC "%1.0" "[Nm/bar]" COEFFS 0 1 0 0 0 1 /end COMPU_METHOD
/begin COMPU_METHOD UMR_PROZENT__20_51_0_S5_S3 "int = ((phys * 51) / 20) - (0) [%]" RAT_FUNC "%5.4" "[%]" COEFFS 0 2.55 0 0 0 1 /end COMPU_METHOD
/begin COMPU_METHOD UMR_PROZENT_SEC_20_51_0_S5_S3 "int = ((phys * 51) / 20) - (0) [%/s]" RAT_FUNC "%5.4" "[%/s]" COEFFS 0 2.55 0 0 0 1 /end COMPU_METHOD
/begin COMPU_METHOD UMR_SEC__1_100_0_S5_S3 "int = ((phys * 100) / 1) - (0) [s]" RAT_FUNC "%3.2" "[s]" COEFFS 0 100 0 0 0 1 /end COMPU_METHOD
/begin COMPU_METHOD UMR_U_MIN_1_1_0_S5_S3 "int = ((phys * 1) / 1) - (0) [U/min]" RAT_FUNC "%1.0" "[U/min]" COEFFS 0 1 0 0 0 1 /end COMPU_METHOD
/begin COMPU_METHOD UMR_U_MINSEC_1_1_0_S5_S3 "int = ((phys * 1) / 1) - (0) [U/(min*s)]" RAT_FUNC "%1.0" "[U/(min*s)]" COEFFS 0 1 0 0 0 1 /end COMPU_METHOD
/begin CHARACTERISTIC AXS_CLOSE_DIAGIAE "mindest-Beschleunigungsintegral zur ng-ab-Schwelle IAE_CLOSE" VALUE 0x1D833A ZF_kw_si16_S5_S3 10 UMR_M_SEC2_1_32_0_S5_S3 0 10 /end CHARACTERISTIC
/begin CHARACTERISTIC AX_MAX_CLOSE_DIAGIAE "maximale Neigung zur Aktivierung der Diagnosen" VALUE 0x1D8338 ZF_kw_si16_S5_S3 10 UMR_M_SEC2_1_32_0_S5_S3 0 10 /end CHARACTERISTIC
/begin CHARACTERISTIC CS_CGETR_NOCLOSE_DIAGIAE "Aktivierungstemperatur IAE_NOCLOSE" VALUE 0x1D778A ZF_kw_ui8_S5_S3 240 UMR_GRADC__1_1_M40_S5_S3 -40 200 /end CHARACTERISTIC
/begin CHARACTERISTIC CS_MAX_DIAGIAE "Auslöseschwelle KFC_IAEHOT" VALUE 0x1D8318 ZF_kw_ui16_S5_S3 1000 UMR_GRADC__1_1_M40_S5_S3 0 1000 /end CHARACTERISTIC
/begin CHARACTERISTIC CS_MAX_HYS_DIAGIAE "Hysterese auf Auslöseschwelle KFC_IAEHOT" VALUE 0x1D831A ZF_kw_ui16_S5_S3 150 UMR_GRADC__1_1_0_S5_S3 0 150 /end CHARACTERISTIC
/begin CHARACTERISTIC CS_SLGRENZ_IAE "IAE-Stahllamellentemperaturschwelle zur Deaktivierung der IAE-Kühlung bei Tieftemperatur" VALUE 0x1D8366 ZF_kw_ui16_S5_S3 300 UMR_GRADC__1_1_M40_S5_S3 -40 260 /end CHARACTERISTIC
/begin CHARACTERISTIC CS_START_MAX_UEFIAE "Max-Temperatur für Adaption" VALUE 0x1D7782 ZF_kw_ui8_S5_S3 200 UMR_GRADC__1_1_0_S5_S3 0 200 /end CHARACTERISTIC
/begin CHARACTERISTIC CS_START_MIN_UEFIAE "Min-Temperatur für Adaption" VALUE 0x1D7783 ZF_kw_ui8_S5_S3 200 UMR_GRADC__1_1_0_S5_S3 0 200 /end CHARACTERISTIC
/begin CHARACTERISTIC DKIS_ANFAHRT_HYS_IAE "Hysterese für DKI-Schwelle" VALUE 0x1D7795 ZF_kw_ui8_S5_S3 39.2157 UMR_PROZENT__20_51_0_S5_S3 0 39.2156862745 /end CHARACTERISTIC
/begin CHARACTERISTIC DKIS_ANFAHRT_IAE "DKI-Schwelle" VALUE 0x1D7794 ZF_kw_ui8_S5_S3 100 UMR_PROZENT__20_51_0_S5_S3 0 100 /end CHARACTERISTIC
/begin CHARACTERISTIC DO_MUEMAX_UEFIAE "Betrag Adaptionshubbegrenzung (positiv und negativ)" VALUE 0x1D7784 ZF_kw_ui8_S5_S3 100 UMR_NM_BAR_1_1_0_S5_S3 0 100 /end CHARACTERISTIC
/begin CHARACTERISTIC D_AcceleratorPedalAngleTh "Angle threshold for Accelerator Pedal" VALUE 0x191CB6 ZF_KW_NAT8_S1_S3 100.4 SBW_HDK_M_S1_S3 0 100.4 /end CHARACTERISTIC
/begin CHARACTERISTIC D_AcceleratorPedalAngleTh_L2 "Level2 Angle threshold for Accelerator Pedal" VALUE 0x1D8EB7 ZF_KW_NAT8_S1_S3 100.4 SBW_HDK_M_S1_S3 0 100.4 /end CHARACTERISTIC
/begin CHARACTERISTIC D_CC_ID "CCM-ID that is sent via CAN if function ID is active" CURVE 0x192430 ZF_TAB_NAT16_S1_S3 65535 SBW_STANDARD_S1_S3 0 65535
 /begin AXIS_DESCR FIX_AXIS NO_INPUT_QUANTITY SBW_STANDARD_S1_S3 40 0 39 READ_ONLY FIX_AXIS_PAR_DIST 0 1 40 /end AXIS_DESCR
/end CHARACTERISTIC
/begin CHARACTERISTIC D_CC_Prio "Priorization of function IDs. Lowest number = highest prio" CURVE 0x192484 ZF_TAB_NAT8_S1_S3 39 SBW_STANDARD_S1_S3 0 39
 /begin AXIS_DESCR FIX_AXIS NO_INPUT_QUANTITY SBW_STANDARD_S1_S3 40 0 39 READ_ONLY FIX_AXIS_PAR_DIST 0 1 40 /end AXIS_DESCR
/end CHARACTERISTIC
/begin CHARACTERISTIC D_DemFilteredMaxSearch "max. search count for Dem_GetNextFilteredDTC ()" VALUE 0x191BC2 ZF_KW_NAT16_S4_S3 65534 EH_STANDARD_S4_S3 1 65535 /end CHARACTERISTIC
/begin CHARACTERISTIC D_DiActivateSubstFunct "error reactions to be enabled (bitcoded, lower 32 Bit)" VALUE 0x192674 ZF_KW_NAT32_S4_S3 4294970000 EH_STANDARD_S4_S3 0 4294967295 /end CHARACTERISTIC
/begin CHARACTERISTIC D_DiActivateSubstFunctHi "error reactions to be enabled (bitcoded, upper 32 Bit)" VALUE 0x192678 ZF_KW_NAT32_S4_S3 4294970000 EH_STANDARD_S4_S3 0 4294967295 /end CHARACTERISTIC
/begin CHARACTERISTIC D_DiAmbCond "Ambient Condition Matrix" MAP 0x194C90 ZF_TAB2D_OI_NAT16_S4_S3 65535 EH_STANDARD_S4_S3 0 65535
 /begin AXIS_DESCR FIX_AXIS NO_INPUT_QUANTITY EH_STANDARD_S4_S3 25 0 24 READ_ONLY FIX_AXIS_PAR_DIST 0 1 25 /end AXIS_DESCR
 /begin AXIS_DESCR FIX_AXIS NO_INPUT_QUANTITY EH_STANDARD_S4_S3 24 0 23 READ_ONLY FIX_AXIS_PAR_DIST 0 1 24 /end AXIS_DESCR
/end CHARACTERISTIC
/begin CHARACTERISTIC D_DiErmMonitoring_KFC "calibration field to select ERM relevant error codes" VAL_BLK 0x196AE0 ZF_TAB_NAT16_S4_S3 65535 EH_STANDARD_S4_S3 0 65535 MATRIX_DIM 40 1 1 /end CHARACTERISTIC
/begin CHARACTERISTIC D_DiErmMonitoring_KMN "Calibration field to select monitoring of ERM relevant error reactions" MAP 0x196B34 ZF_TAB2D_NAT32_S4_S3 4294970000 EH_STANDARD_S4_S3 0 4294967295
 /begin AXIS_DESCR FIX_AXIS NO_INPUT_QUANTITY EH_STANDARD_S4_S3 40 0 39 READ_ONLY FIX_AXIS_PAR_DIST 0 1 40 /end AXIS_DESCR
 /begin AXIS_DESCR FIX_AXIS NO_INPUT_QUANTITY EH_STANDARD_S4_S3 2 0 1 READ_ONLY FIX_AXIS_PAR_DIST 0 1 2 /end AXIS_DESCR
/end CHARACTERISTIC
/begin CHARACTERISTIC D_DiErrorCodeConvTab "Calibration field between ZF error codes and customer error codes and pCodes" MAP 0x195140 ZF_TAB2D_OI_NAT16_S4_S3 65535 EH_STANDARD_S4_S3 0 65535
 /begin AXIS_DESCR FIX_AXIS NO_INPUT_QUANTITY EH_STANDARD_S4_S3 5 0 4 READ_ONLY FIX_AXIS_PAR_DIST 0 1 5 /end AXIS_DESCR
 /begin AXIS_DESCR FIX_AXIS NO_INPUT_QUANTITY EH_STANDARD_S4_S3 500 0 499 READ_ONLY FIX_AXIS_PAR_DIST 0 1 500 /end AXIS_DESCR
/end CHARACTERISTIC
/begin CHARACTERISTIC D_DiErrorCodeConvTabForAZG "Calibration field between ZF-Errorcode and AZG" VAL_BLK 0x19267C ZF_TAB_NAT16_S4_S3 512 EH_STANDARD_S4_S3 0 512 MATRIX_DIM 300 1 1 /end CHARACTERISTIC
/begin CHARACTERISTIC D_DiErrorCode_1 "Calibration Field for error code 1" VAL_BLK 0x1928D8 ZF_TAB_OI_NAT16_S4_S3 65535 EH_STANDARD_S4_S3 0 65535 MATRIX_DIM 18 1 1 /end CHARACTERISTIC
/begin CHARACTERISTIC D_DiErrorCode_10 "Calibration Field for error code 10" VAL_BLK 0x192A1C ZF_TAB_OI_NAT16_S4_S3 65535 EH_STANDARD_S4_S3 0 65535 MATRIX_DIM 18 1 1 /end CHARACTERISTIC
/begin CHARACTERISTIC D_DiErrorCode_100 "Calibration Field for error code 100" VAL_BLK 0x1936C4 ZF_TAB_OI_NAT16_S4_S3 65535 EH_STANDARD_S4_S3 0 65535 MATRIX_DIM 18 1 1 /end CHARACTERISTIC
/begin CHARACTERISTIC D_DiErrorCode_101 "Calibration Field for error code 101" VAL_BLK 0x1936E8 ZF_TAB_OI_NAT16_S4_S3 65535 EH_STANDARD_S4_S3 0 65535 MATRIX_DIM 18 1 1 /end CHARACTERISTIC
/begin CHARACTERISTIC D_DiErrorCode_102 "Calibration Field for error code 102" VAL_BLK 0x19370C ZF_TAB_OI_NAT16_S4_S3 65535 EH_STANDARD_S4_S3 0 65535 MATRIX_DIM 18 1 1 /end CHARACTERISTIC
/begin CHARACTERISTIC D_DiErrorCode_103 "Calibration Field for error code 103" VAL_BLK 0x193730 ZF_TAB_OI_NAT16_S4_S3 65535 EH_STANDARD_S4_S3 0 65535 MATRIX_DIM 18 1 1 /end CHARACTERISTIC
/begin CHARACTERISTIC D_DiErrorCode_104 "Calibration Field for error code 104" VAL_BLK 0x193754 ZF_TAB_OI_NAT16_S4_S3 65535 EH_STANDARD_S4_S3 0 65535 MATRIX_DIM 18 1 1 /end CHARACTERISTIC
/begin CHARACTERISTIC D_DiErrorCode_105 "Calibration Field for error code 105" VAL_BLK 0x193778 ZF_TAB_OI_NAT16_S4_S3 65535 EH_STANDARD_S4_S3 0 65535 MATRIX_DIM 18 1 1 /end CHARACTERISTIC
/begin CHARACTERISTIC D_DiErrorCode_106 "Calibration Field for error code 106" VAL_BLK 0x19379C ZF_TAB_OI_NAT16_S4_S3 65535 EH_STANDARD_S4_S3 0 65535 MATRIX_DIM 18 1 1 /end CHARACTERISTIC
/begin CHARACTERISTIC D_DiErrorCode_107 "Calibration Field for error code 107" VAL_BLK 0x1937C0 ZF_TAB_OI_NAT16_S4_S3 65535 EH_STANDARD_S4_S3 0 65535 MATRIX_DIM 18 1 1 /end CHARACTERISTIC
/begin CHARACTERISTIC D_DiErrorCode_108 "Calibration Field for error code 108" VAL_BLK 0x1937E4 ZF_TAB_OI_NAT16_S4_S3 65535 EH_STANDARD_S4_S3 0 65535 MATRIX_DIM 18 1 1 /end CHARACTERISTIC
/begin CHARACTERISTIC D_DiErrorCode_109 "Calibration Field for error code 109" VAL_BLK 0x193808 ZF_TAB_OI_NAT16_S4_S3 65535 EH_STANDARD_S4_S3 0 65535 MATRIX_DIM 18 1 1 /end CHARACTERISTIC
/begin CHARACTERISTIC D_DiErrorCode_11 "Calibration Field for error code 11" VAL_BLK 0x192A40 ZF_TAB_OI_NAT16_S4_S3 65535 EH_STANDARD_S4_S3 0 65535 MATRIX_DIM 18 1 1 /end CHARACTERISTIC
/begin CHARACTERISTIC D_DiErrorCode_110 "Calibration Field for error code 110" VAL_BLK 0x19382C ZF_TAB_OI_NAT16_S4_S3 65535 EH_STANDARD_S4_S3 0 65535 MATRIX_DIM 18 1 1 /end CHARACTERISTIC
/begin CHARACTERISTIC D_DiErrorCode_111 "Calibration Field for error code 111" VAL_BLK 0x193850 ZF_TAB_OI_NAT16_S4_S3 65535 EH_STANDARD_S4_S3 0 65535 MATRIX_DIM 18 1 1 /end CHARACTERISTIC
/begin CHARACTERISTIC D_DiErrorCode_112 "Calibration Field for error code 112" VAL_BLK 0x193874 ZF_TAB_OI_NAT16_S4_S3 65535 EH_STANDARD_S4_S3 0 65535 MATRIX_DIM 18 1 1 /end CHARACTERISTIC
/begin CHARACTERISTIC D_DiErrorCode_113 "Calibration Field for error code 113" VAL_BLK 0x193898 ZF_TAB_OI_NAT16_S4_S3 65535 EH_STANDARD_S4_S3 0 65535 MATRIX_DIM 18 1 1 /end CHARACTERISTIC
/begin CHARACTERISTIC D_DiErrorCode_114 "Calibration Field for error code 114" VAL_BLK 0x1938BC ZF_TAB_OI_NAT16_S4_S3 65535 EH_STANDARD_S4_S3 0 65535 MATRIX_DIM 18 1 1 /end CHARACTERISTIC
/begin CHARACTERISTIC D_DiErrorCode_115 "Calibration Field for error code 115" VAL_BLK 0x1938E0 ZF_TAB_OI_NAT16_S4_S3 65535 EH_STANDARD_S4_S3 0 65535 MATRIX_DIM 18 1 1 /end CHARACTERISTIC
/begin CHARACTERISTIC D_DiErrorCode_116 "Calibration Field for error code 116" VAL_BLK 0x193904 ZF_TAB_OI_NAT16_S4_S3 65535 EH_STANDARD_S4_S3 0 65535 MATRIX_DIM 18 1 1 /end CHARACTERISTIC
/begin CHARACTERISTIC D_DiErrorCode_117 "Calibration Field for error code 117" VAL_BLK 0x193928 ZF_TAB_OI_NAT16_S4_S3 65535 EH_STANDARD_S4_S3 0 65535 MATRIX_DIM 18 1 1 /end CHARACTERISTIC
/begin CHARACTERISTIC D_DiErrorCode_118 "Calibration Field for error code 118" VAL_BLK 0x19394C ZF_TAB_OI_NAT16_S4_S3 65535 EH_STANDARD_S4_S3 0 65535 MATRIX_DIM 18 1 1 /end CHARACTERISTIC
/begin CHARACTERISTIC D_DiErrorCode_119 "Calibration Field for error code 119" VAL_BLK 0x193970 ZF_TAB_OI_NAT16_S4_S3 65535 EH_STANDARD_S4_S3 0 65535 MATRIX_DIM 18 1 1 /end CHARACTERISTIC
/begin CHARACTERISTIC D_DiErrorCode_12 "Calibration Field for error code 12" VAL_BLK 0x192A64 ZF_TAB_OI_NAT16_S4_S3 65535 EH_STANDARD_S4_S3 0 65535 MATRIX_DIM 18 1 1 /end CHARACTERISTIC
/begin CHARACTERISTIC D_DiErrorCode_120 "Calibration Field for error code 120" VAL_BLK 0x193994 ZF_TAB_OI_NAT16_S4_S3 65535 EH_STANDARD_S4_S3 0 65535 MATRIX_DIM 18 1 1 /end CHARACTERISTIC
/begin CHARACTERISTIC D_DiErrorCode_121 "Calibration Field for error code 121" VAL_BLK 0x1939B8 ZF_TAB_OI_NAT16_S4_S3 65535 EH_STANDARD_S4_S3 0 65535 MATRIX_DIM 18 1 1 /end CHARACTERISTIC
/begin CHARACTERISTIC D_DiErrorCode_122 "Calibration Field for error code 122" VAL_BLK 0x1939DC ZF_TAB_OI_NAT16_S4_S3 65535 EH_STANDARD_S4_S3 0 65535 MATRIX_DIM 18 1 1 /end CHARACTERISTIC
/begin CHARACTERISTIC D_DiErrorCode_123 "Calibration Field for error code 123" VAL_BLK 0x193A00 ZF_TAB_OI_NAT16_S4_S3 65535 EH_STANDARD_S4_S3 0 65535 MATRIX_DIM 18 1 1 /end CHARACTERISTIC
/begin CHARACTERISTIC D_DiErrorCode_124 "Calibration Field for error code 124" VAL_BLK 0x193A24 ZF_TAB_OI_NAT16_S4_S3 65535 EH_STANDARD_S4_S3 0 65535 MATRIX_DIM 18 1 1 /end CHARACTERISTIC
/begin CHARACTERISTIC D_DiErrorCode_125 "Calibration Field for error code 125" VAL_BLK 0x193A48 ZF_TAB_OI_NAT16_S4_S3 65535 EH_STANDARD_S4_S3 0 65535 MATRIX_DIM 18 1 1 /end CHARACTERISTIC
/begin CHARACTERISTIC D_DiErrorCode_126 "Calibration Field for error code 126" VAL_BLK 0x193A6C ZF_TAB_OI_NAT16_S4_S3 65535 EH_STANDARD_S4_S3 0 65535 MATRIX_DIM 18 1 1 /end CHARACTERISTIC
/begin CHARACTERISTIC D_DiErrorCode_127 "Calibration Field for error code 127" VAL_BLK 0x193A90 ZF_TAB_OI_NAT16_S4_S3 65535 EH_STANDARD_S4_S3 0 65535 MATRIX_DIM 18 1 1 /end CHARACTERISTIC
/begin CHARACTERISTIC D_DiErrorCode_128 "Calibration Field for error code 128" VAL_BLK 0x193AB4 ZF_TAB_OI_NAT16_S4_S3 65535 EH_STANDARD_S4_S3 0 65535 MATRIX_DIM 18 1 1 /end CHARACTERISTIC
/begin CHARACTERISTIC D_DiErrorCode_129 "Calibration Field for error code 129" VAL_BLK 0x193AD8 ZF_TAB_OI_NAT16_S4_S3 65535 EH_STANDARD_S4_S3 0 65535 MATRIX_DIM 18 1 1 /end CHARACTERISTIC
/begin CHARACTERISTIC D_DiErrorCode_13 "Calibration Field for error code 13" VAL_BLK 0x192A88 ZF_TAB_OI_NAT16_S4_S3 65535 EH_STANDARD_S4_S3 0 65535 MATRIX_DIM 18 1 1 /end CHARACTERISTIC
/begin CHARACTERISTIC D_DiErrorCode_130 "Calibration Field for error code 130" VAL_BLK 0x193AFC ZF_TAB_OI_NAT16_S4_S3 65535 EH_STANDARD_S4_S3 0 65535 MATRIX_DIM 18 1 1 /end CHARACTERISTIC
/begin CHARACTERISTIC D_DiErrorCode_131 "Calibration Field for error code 131" VAL_BLK 0x193B20 ZF_TAB_OI_NAT16_S4_S3 65535 EH_STANDARD_S4_S3 0 65535 MATRIX_DIM 18 1 1 /end CHARACTERISTIC
/begin CHARACTERISTIC D_DiErrorCode_132 "Calibration Field for error code 132" VAL_BLK 0x193B44 ZF_TAB_OI_NAT16_S4_S3 65535 EH_STANDARD_S4_S3 0 65535 MATRIX_DIM 18 1 1 /end CHARACTERISTIC
/begin CHARACTERISTIC D_DiErrorCode_133 "Calibration Field for error code 133" VAL_BLK 0x193B68 ZF_TAB_OI_NAT16_S4_S3 65535 EH_STANDARD_S4_S3 0 65535 MATRIX_DIM 18 1 1 /end CHARACTERISTIC
/begin CHARACTERISTIC D_DiErrorCode_134 "Calibration Field for error code 134" VAL_BLK 0x193B8C ZF_TAB_OI_NAT16_S4_S3 65535 EH_STANDARD_S4_S3 0 65535 MATRIX_DIM 18 1 1 /end CHARACTERISTIC
/begin CHARACTERISTIC D_DiErrorCode_135 "Calibration Field for error code 135" VAL_BLK 0x193BB0 ZF_TAB_OI_NAT16_S4_S3 65535 EH_STANDARD_S4_S3 0 65535 MATRIX_DIM 18 1 1 /end CHARACTERISTIC
/begin CHARACTERISTIC D_DiErrorCode_136 "Calibration Field for error code 136" VAL_BLK 0x193BD4 ZF_TAB_OI_NAT16_S4_S3 65535 EH_STANDARD_S4_S3 0 65535 MATRIX_DIM 18 1 1 /end CHARACTERISTIC
/begin CHARACTERISTIC D_DiErrorCode_137 "Calibration Field for error code 137" VAL_BLK 0x193BF8 ZF_TAB_OI_NAT16_S4_S3 65535 EH_STANDARD_S4_S3 0 65535 MATRIX_DIM 18 1 1 /end CHARACTERISTIC
/begin CHARACTERISTIC D_DiErrorCode_138 "Calibration Field for error code 138" VAL_BLK 0x193C1C ZF_TAB_OI_NAT16_S4_S3 65535 EH_STANDARD_S4_S3 0 65535 MATRIX_DIM 18 1 1 /end CHARACTERISTIC
/begin CHARACTERISTIC D_DiErrorCode_139 "Calibration Field for error code 139" VAL_BLK 0x193C40 ZF_TAB_OI_NAT16_S4_S3 65535 EH_STANDARD_S4_S3 0 65535 MATRIX_DIM 18 1 1 /end CHARACTERISTIC
/begin CHARACTERISTIC D_DiErrorCode_14 "Calibration Field for error code 14" VAL_BLK 0x192AAC ZF_TAB_OI_NAT16_S4_S3 65535 EH_STANDARD_S4_S3 0 65535 MATRIX_DIM 18 1 1 /end CHARACTERISTIC
/begin CHARACTERISTIC D_DiErrorCode_140 "Calibration Field for error code 140" VAL_BLK 0x193C64 ZF_TAB_OI_NAT16_S4_S3 65535 EH_STANDARD_S4_S3 0 65535 MATRIX_DIM 18 1 1 /end CHARACTERISTIC
/begin CHARACTERISTIC D_DiErrorCode_141 "Calibration Field for error code 141" VAL_BLK 0x193C88 ZF_TAB_OI_NAT16_S4_S3 65535 EH_STANDARD_S4_S3 0 65535 MATRIX_DIM 18 1 1 /end CHARACTERISTIC
/begin CHARACTERISTIC D_DiErrorCode_142 "Calibration Field for error code 142" VAL_BLK 0x193CAC ZF_TAB_OI_NAT16_S4_S3 65535 EH_STANDARD_S4_S3 0 65535 MATRIX_DIM 18 1 1 /end CHARACTERISTIC
/begin CHARACTERISTIC D_DiErrorCode_143 "Calibration Field for error code 143" VAL_BLK 0x193CD0 ZF_TAB_OI_NAT16_S4_S3 65535 EH_STANDARD_S4_S3 0 65535 MATRIX_DIM 18 1 1 /end CHARACTERISTIC
/begin CHARACTERISTIC D_DiErrorCode_144 "Calibration Field for error code 144" VAL_BLK 0x193CF4 ZF_TAB_OI_NAT16_S4_S3 65535 EH_STANDARD_S4_S3 0 65535 MATRIX_DIM 18 1 1 /end CHARACTERISTIC
/begin CHARACTERISTIC D_DiErrorCode_145 "Calibration Field for error code 145" VAL_BLK 0x193D18 ZF_TAB_OI_NAT16_S4_S3 65535 EH_STANDARD_S4_S3 0 65535 MATRIX_DIM 18 1 1 /end CHARACTERISTIC
/begin CHARACTERISTIC D_DiErrorCode_146 "Calibration Field for error code 146" VAL_BLK 0x193D3C ZF_TAB_OI_NAT16_S4_S3 65535 EH_STANDARD_S4_S3 0 65535 MATRIX_DIM 18 1 1 /end CHARACTERISTIC
/begin CHARACTERISTIC D_DiErrorCode_147 "Calibration Field for error code 147" VAL_BLK 0x193D60 ZF_TAB_OI_NAT16_S4_S3 65535 EH_STANDARD_S4_S3 0 65535 MATRIX_DIM 18 1 1 /end CHARACTERISTIC
/begin CHARACTERISTIC D_DiErrorCode_148 "Calibration Field for error code 148" VAL_BLK 0x193D84 ZF_TAB_OI_NAT16_S4_S3 65535 EH_STANDARD_S4_S3 0 65535 MATRIX_DIM 18 1 1 /end CHARACTERISTIC
/begin CHARACTERISTIC D_DiErrorCode_149 "Calibration Field for error code 149" VAL_BLK 0x193DA8 ZF_TAB_OI_NAT16_S4_S3 65535 EH_STANDARD_S4_S3 0 65535 MATRIX_DIM 18 1 1 /end CHARACTERISTIC
/begin CHARACTERISTIC D_DiErrorCode_15 "Calibration Field for error code 15" VAL_BLK 0x192AD0 ZF_TAB_OI_NAT16_S4_S3 65535 EH_STANDARD_S4_S3 0 65535 MATRIX_DIM 18 1 1 /end CHARACTERISTIC
/begin CHARACTERISTIC D_DiErrorCode_150 "Calibration Field for error code 150" VAL_BLK 0x193DCC ZF_TAB_OI_NAT16_S4_S3 65535 EH_STANDARD_S4_S3 0 65535 MATRIX_DIM 18 1 1 /end CHARACTERISTIC
/begin CHARACTERISTIC D_DiErrorCode_151 "Calibration Field for error code 151" VAL_BLK 0x193DF0 ZF_TAB_OI_NAT16_S4_S3 65535 EH_STANDARD_S4_S3 0 65535 MATRIX_DIM 18 1 1 /end CHARACTERISTIC
/begin CHARACTERISTIC D_DiErrorCode_152 "Calibration Field for error code 152" VAL_BLK 0x193E14 ZF_TAB_OI_NAT16_S4_S3 65535 EH_STANDARD_S4_S3 0 65535 MATRIX_DIM 18 1 1 /end CHARACTERISTIC
/begin CHARACTERISTIC D_DiErrorCode_153 "Calibration Field for error code 153" VAL_BLK 0x193E38 ZF_TAB_OI_NAT16_S4_S3 65535 EH_STANDARD_S4_S3 0 65535 MATRIX_DIM 18 1 1 /end CHARACTERISTIC
/begin CHARACTERISTIC D_DiErrorCode_154 "Calibration Field for error code 154" VAL_BLK 0x193E5C ZF_TAB_OI_NAT16_S4_S3 65535 EH_STANDARD_S4_S3 0 65535 MATRIX_DIM 18 1 1 /end CHARACTERISTIC
/begin CHARACTERISTIC D_DiErrorCode_155 "Calibration Field for error code 155" VAL_BLK 0x193E80 ZF_TAB_OI_NAT16_S4_S3 65535 EH_STANDARD_S4_S3 0 65535 MATRIX_DIM 18 1 1 /end CHARACTERISTIC
/begin CHARACTERISTIC D_DiErrorCode_156 "Calibration Field for error code 156" VAL_BLK 0x193EA4 ZF_TAB_OI_NAT16_S4_S3 65535 EH_STANDARD_S4_S3 0 65535 MATRIX_DIM 18 1 1 /end CHARACTERISTIC
/begin CHARACTERISTIC D_DiErrorCode_157 "Calibration Field for error code 157" VAL_BLK 0x193EC8 ZF_TAB_OI_NAT16_S4_S3 65535 EH_STANDARD_S4_S3 0 65535 MATRIX_DIM 18 1 1 /end CHARACTERISTIC
/begin CHARACTERISTIC D_DiErrorCode_158 "Calibration Field for error code 158" VAL_BLK 0x193EEC ZF_TAB_OI_NAT16_S4_S3 65535 EH_STANDARD_S4_S3 0 65535 MATRIX_DIM 18 1 1 /end CHARACTERISTIC
/begin CHARACTERISTIC D_DiErrorCode_159 "Calibration Field for error code 159" VAL_BLK 0x193F10 ZF_TAB_OI_NAT16_S4_S3 65535 EH_STANDARD_S4_S3 0 65535 MATRIX_DIM 18 1 1 /end CHARACTERISTIC
/begin CHARACTERISTIC D_DiErrorCode_16 "Calibration Field for error code 16" VAL_BLK 0x192AF4 ZF_TAB_OI_NAT16_S4_S3 65535 EH_STANDARD_S4_S3 0 65535 MATRIX_DIM 18 1 1 /end CHARACTERISTIC
/begin CHARACTERISTIC D_DiErrorCode_160 "Calibration Field for error code 160" VAL_BLK 0x193F34 ZF_TAB_OI_NAT16_S4_S3 65535 EH_STANDARD_S4_S3 0 65535 MATRIX_DIM 18 1 1 /end CHARACTERISTIC
/begin CHARACTERISTIC D_DiErrorCode_161 "Calibration Field for error code 161" VAL_BLK 0x193F58 ZF_TAB_OI_NAT16_S4_S3 65535 EH_STANDARD_S4_S3 0 65535 MATRIX_DIM 18 1 1 /end CHARACTERISTIC
/begin CHARACTERISTIC D_DiErrorCode_162 "Calibration Field for error code 162" VAL_BLK 0x193F7C ZF_TAB_OI_NAT16_S4_S3 65535 EH_STANDARD_S4_S3 0 65535 MATRIX_DIM 18 1 1 /end CHARACTERISTIC
/begin CHARACTERISTIC D_DiErrorCode_163 "Calibration Field for error code 163" VAL_BLK 0x193FA0 ZF_TAB_OI_NAT16_S4_S3 65535 EH_STANDARD_S4_S3 0 65535 MATRIX_DIM 18 1 1 /end CHARACTERISTIC
/begin CHARACTERISTIC D_DiErrorCode_164 "Calibration Field for error code 164" VAL_BLK 0x193FC4 ZF_TAB_OI_NAT16_S4_S3 65535 EH_STANDARD_S4_S3 0 65535 MATRIX_DIM 18 1 1 /end CHARACTERISTIC
/begin CHARACTERISTIC D_DiErrorCode_165 "Calibration Field for error code 165" VAL_BLK 0x193FE8 ZF_TAB_OI_NAT16_S4_S3 65535 EH_STANDARD_S4_S3 0 65535 MATRIX_DIM 18 1 1 /end CHARACTERISTIC
/begin CHARACTERISTIC D_DiErrorCode_166 "Calibration Field for error code 166" VAL_BLK 0x19400C ZF_TAB_OI_NAT16_S4_S3 65535 EH_STANDARD_S4_S3 0 65535 MATRIX_DIM 18 1 1 /end CHARACTERISTIC
/begin CHARACTERISTIC D_DiErrorCode_167 "Calibration Field for error code 167" VAL_BLK 0x194030 ZF_TAB_OI_NAT16_S4_S3 65535 EH_STANDARD_S4_S3 0 65535 MATRIX_DIM 18 1 1 /end CHARACTERISTIC
/begin CHARACTERISTIC D_DiErrorCode_168 "Calibration Field for error code 168" VAL_BLK 0x194054 ZF_TAB_OI_NAT16_S4_S3 65535 EH_STANDARD_S4_S3 0 65535 MATRIX_DIM 18 1 1 /end CHARACTERISTIC
/begin CHARACTERISTIC D_DiErrorCode_169 "Calibration Field for error code 169" VAL_BLK 0x194078 ZF_TAB_OI_NAT16_S4_S3 65535 EH_STANDARD_S4_S3 0 65535 MATRIX_DIM 18 1 1 /end CHARACTERISTIC
/begin CHARACTERISTIC D_DiErrorCode_17 "Calibration Field for error code 17" VAL_BLK 0x192B18 ZF_TAB_OI_NAT16_S4_S3 65535 EH_STANDARD_S4_S3 0 65535 MATRIX_DIM 18 1 1 /end CHARACTERISTIC
/begin CHARACTERISTIC D_DiErrorCode_170 "Calibration Field for error code 170" VAL_BLK 0x19409C ZF_TAB_OI_NAT16_S4_S3 65535 EH_STANDARD_S4_S3 0 65535 MATRIX_DIM 18 1 1 /end CHARACTERISTIC
/begin CHARACTERISTIC D_DiErrorCode_171 "Calibration Field for error code 171" VAL_BLK 0x1940C0 ZF_TAB_OI_NAT16_S4_S3 65535 EH_STANDARD_S4_S3 0 65535 MATRIX_DIM 18 1 1 /end CHARACTERISTIC
/begin CHARACTERISTIC D_DiErrorCode_172 "Calibration Field for error code 172" VAL_BLK 0x1940E4 ZF_TAB_OI_NAT16_S4_S3 65535 EH_STANDARD_S4_S3 0 65535 MATRIX_DIM 18 1 1 /end CHARACTERISTIC
/begin CHARACTERISTIC D_DiErrorCode_173 "Calibration Field for error code 173" VAL_BLK 0x194108 ZF_TAB_OI_NAT16_S4_S3 65535 EH_STANDARD_S4_S3 0 65535 MATRIX_DIM 18 1 1 /end CHARACTERISTIC
/begin CHARACTERISTIC D_DiErrorCode_174 "Calibration Field for error code 174" VAL_BLK 0x19412C ZF_TAB_OI_NAT16_S4_S3 65535 EH_STANDARD_S4_S3 0 65535 MATRIX_DIM 18 1 1 /end CHARACTERISTIC
/begin CHARACTERISTIC D_DiErrorCode_175 "Calibration Field for error code 175" VAL_BLK 0x194150 ZF_TAB_OI_NAT16_S4_S3 65535 EH_STANDARD_S4_S3 0 65535 MATRIX_DIM 18 1 1 /end CHARACTERISTIC
/begin CHARACTERISTIC D_DiErrorCode_176 "Calibration Field for error code 176" VAL_BLK 0x194174 ZF_TAB_OI_NAT16_S4_S3 65535 EH_STANDARD_S4_S3 0 65535 MATRIX_DIM 18 1 1 /end CHARACTERISTIC
/begin CHARACTERISTIC D_DiErrorCode_177 "Calibration Field for error code 177" VAL_BLK 0x194198 ZF_TAB_OI_NAT16_S4_S3 65535 EH_STANDARD_S4_S3 0 65535 MATRIX_DIM 18 1 1 /end CHARACTERISTIC
/begin CHARACTERISTIC D_DiErrorCode_178 "Calibration Field for error code 178" VAL_BLK 0x1941BC ZF_TAB_OI_NAT16_S4_S3 65535 EH_STANDARD_S4_S3 0 65535 MATRIX_DIM 18 1 1 /end CHARACTERISTIC
/begin CHARACTERISTIC D_DiErrorCode_179 "Calibration Field for error code 179" VAL_BLK 0x1941E0 ZF_TAB_OI_NAT16_S4_S3 65535 EH_STANDARD_S4_S3 0 65535 MATRIX_DIM 18 1 1 /end CHARACTERISTIC
/begin CHARACTERISTIC D_DiErrorCode_18 "Calibration Field for error code 18" VAL_BLK 0x192B3C ZF_TAB_OI_NAT16_S4_S3 65535 EH_STANDARD_S4_S3 0 65535 MATRIX_DIM 18 1 1 /end CHARACTERISTIC
/begin CHARACTERISTIC D_DiErrorCode_180 "Calibration Field for error code 180" VAL_BLK 0x194204 ZF_TAB_OI_NAT16_S4_S3 65535 EH_STANDARD_S4_S3 0 65535 MATRIX_DIM 18 1 1 /end CHARACTERISTIC
/begin CHARACTERISTIC D_DiErrorCode_181 "Calibration Field for error code 181" VAL_BLK 0x194228 ZF_TAB_OI_NAT16_S4_S3 65535 EH_STANDARD_S4_S3 0 65535 MATRIX_DIM 18 1 1 /end CHARACTERISTIC
/begin CHARACTERISTIC D_DiErrorCode_182 "Calibration Field for error code 182" VAL_BLK 0x19424C ZF_TAB_OI_NAT16_S4_S3 65535 EH_STANDARD_S4_S3 0 65535 MATRIX_DIM 18 1 1 /end CHARACTERISTIC
/begin CHARACTERISTIC D_DiErrorCode_183 "Calibration Field for error code 183" VAL_BLK 0x194270 ZF_TAB_OI_NAT16_S4_S3 65535 EH_STANDARD_S4_S3 0 65535 MATRIX_DIM 18 1 1 /end CHARACTERISTIC
/begin CHARACTERISTIC D_DiErrorCode_184 "Calibration Field for error code 184" VAL_BLK 0x194294 ZF_TAB_OI_NAT16_S4_S3 65535 EH_STANDARD_S4_S3 0 65535 MATRIX_DIM 18 1 1 /end CHARACTERISTIC
/begin CHARACTERISTIC D_DiErrorCode_185 "Calibration Field for error code 185" VAL_BLK 0x1942B8 ZF_TAB_OI_NAT16_S4_S3 65535 EH_STANDARD_S4_S3 0 65535 MATRIX_DIM 18 1 1 /end CHARACTERISTIC
/begin CHARACTERISTIC D_DiErrorCode_186 "Calibration Field for error code 186" VAL_BLK 0x1942DC ZF_TAB_OI_NAT16_S4_S3 65535 EH_STANDARD_S4_S3 0 65535 MATRIX_DIM 18 1 1 /end CHARACTERISTIC
/begin CHARACTERISTIC D_DiErrorCode_187 "Calibration Field for error code 187" VAL_BLK 0x194300 ZF_TAB_OI_NAT16_S4_S3 65535 EH_STANDARD_S4_S3 0 65535 MATRIX_DIM 18 1 1 /end CHARACTERISTIC
/begin CHARACTERISTIC D_DiErrorCode_188 "Calibration Field for error code 188" VAL_BLK 0x194324 ZF_TAB_OI_NAT16_S4_S3 65535 EH_STANDARD_S4_S3 0 65535 MATRIX_DIM 18 1 1 /end CHARACTERISTIC
/begin CHARACTERISTIC D_DiErrorCode_189 "Calibration Field for error code 189" VAL_BLK 0x194348 ZF_TAB_OI_NAT16_S4_S3 65535 EH_STANDARD_S4_S3 0 65535 MATRIX_DIM 18 1 1 /end CHARACTERISTIC
/begin CHARACTERISTIC D_DiErrorCode_19 "Calibration Field for error code 19" VAL_BLK 0x192B60 ZF_TAB_OI_NAT16_S4_S3 65535 EH_STANDARD_S4_S3 0 65535 MATRIX_DIM 18 1 1 /end CHARACTERISTIC
/begin CHARACTERISTIC D_DiErrorCode_190 "Calibration Field for error code 190" VAL_BLK 0x19436C ZF_TAB_OI_NAT16_S4_S3 65535 EH_STANDARD_S4_S3 0 65535 MATRIX_DIM 18 1 1 /end CHARACTERISTIC
/begin CHARACTERISTIC D_DiErrorCode_191 "Calibration Field for error code 191" VAL_BLK 0x194390 ZF_TAB_OI_NAT16_S4_S3 65535 EH_STANDARD_S4_S3 0 65535 MATRIX_DIM 18 1 1 /end CHARACTERISTIC
/begin CHARACTERISTIC D_DiErrorCode_192 "Calibration Field for error code 192" VAL_BLK 0x1943B4 ZF_TAB_OI_NAT16_S4_S3 65535 EH_STANDARD_S4_S3 0 65535 MATRIX_DIM 18 1 1 /end CHARACTERISTIC
/begin CHARACTERISTIC D_DiErrorCode_193 "Calibration Field for error code 193" VAL_BLK 0x1943D8 ZF_TAB_OI_NAT16_S4_S3 65535 EH_STANDARD_S4_S3 0 65535 MATRIX_DIM 18 1 1 /end CHARACTERISTIC
/begin CHARACTERISTIC D_DiErrorCode_194 "Calibration Field for error code 194" VAL_BLK 0x1943FC ZF_TAB_OI_NAT16_S4_S3 65535 EH_STANDARD_S4_S3 0 65535 MATRIX_DIM 18 1 1 /end CHARACTERISTIC
/begin CHARACTERISTIC D_DiErrorCode_195 "Calibration Field for error code 195" VAL_BLK 0x194420 ZF_TAB_OI_NAT16_S4_S3 65535 EH_STANDARD_S4_S3 0 65535 MATRIX_DIM 18 1 1 /end CHARACTERISTIC
/begin CHARACTERISTIC D_DiErrorCode_196 "Calibration Field for error code 196" VAL_BLK 0x194444 ZF_TAB_OI_NAT16_S4_S3 65535 EH_STANDARD_S4_S3 0 65535 MATRIX_DIM 18 1 1 /end CHARACTERISTIC
/begin CHARACTERISTIC D_DiErrorCode_197 "Calibration Field for error code 197" VAL_BLK 0x194468 ZF_TAB_OI_NAT16_S4_S3 65535 EH_STANDARD_S4_S3 0 65535 MATRIX_DIM 18 1 1 /end CHARACTERISTIC
/begin CHARACTERISTIC D_DiErrorCode_198 "Calibration Field for error code 198" VAL_BLK 0x19448C ZF_TAB_OI_NAT16_S4_S3 65535 EH_STANDARD_S4_S3 0 65535 MATRIX_DIM 18 1 1 /end CHARACTERISTIC
/begin CHARACTERISTIC D_DiErrorCode_199 "Calibration Field for error code 199" VAL_BLK 0x1944B0 ZF_TAB_OI_NAT16_S4_S3 65535 EH_STANDARD_S4_S3 0 65535 MATRIX_DIM 18 1 1 /end CHARACTERISTIC
/begin CHARACTERISTIC D_DiErrorCode_2 "Calibration Field for error code 2" VAL_BLK 0x1928FC ZF_TAB_OI_NAT16_S4_S3 65535 EH_STANDARD_S4_S3 0 65535 MATRIX_DIM 18 1 1 /end CHARACTERISTIC
/begin CHARACTERISTIC D_DiErrorCode_20 "Calibration Field for error code 20" VAL_BLK 0x192B84 ZF_TAB_OI_NAT16_S4_S3 65535 EH_STANDARD_S4_S3 0 65535 MATRIX_DIM 18 1 1 /end CHARACTERISTIC
/begin CHARACTERISTIC D_DiErrorCode_200 "Calibration Field for error code 200" VAL_BLK 0x1944D4 ZF_TAB_OI_NAT16_S4_S3 65535 EH_STANDARD_S4_S3 0 65535 MATRIX_DIM 18 1 1 /end CHARACTERISTIC
/begin CHARACTERISTIC D_DiErrorCode_201 "Calibration Field for error code 201" VAL_BLK 0x1944F8 ZF_TAB_OI_NAT16_S4_S3 65535 EH_STANDARD_S4_S3 0 65535 MATRIX_DIM 18 1 1 /end CHARACTERISTIC
/begin CHARACTERISTIC D_DiErrorCode_202 "Calibration Field for error code 202" VAL_BLK 0x19451C ZF_TAB_OI_NAT16_S4_S3 65535 EH_STANDARD_S4_S3 0 65535 MATRIX_DIM 18 1 1 /end CHARACTERISTIC
/begin CHARACTERISTIC D_DiErrorCode_203 "Calibration Field for error code 203" VAL_BLK 0x194540 ZF_TAB_OI_NAT16_S4_S3 65535 EH_STANDARD_S4_S3 0 65535 MATRIX_DIM 18 1 1 /end CHARACTERISTIC
/begin CHARACTERISTIC D_DiErrorCode_204 "Calibration Field for error code 204" VAL_BLK 0x194564 ZF_TAB_OI_NAT16_S4_S3 65535 EH_STANDARD_S4_S3 0 65535 MATRIX_DIM 18 1 1 /end CHARACTERISTIC
/begin CHARACTERISTIC D_DiErrorCode_205 "Calibration Field for error code 205" VAL_BLK 0x194588 ZF_TAB_OI_NAT16_S4_S3 65535 EH_STANDARD_S4_S3 0 65535 MATRIX_DIM 18 1 1 /end CHARACTERISTIC
/begin CHARACTERISTIC D_DiErrorCode_206 "Calibration Field for error code 206" VAL_BLK 0x1945AC ZF_TAB_OI_NAT16_S4_S3 65535 EH_STANDARD_S4_S3 0 65535 MATRIX_DIM 18 1 1 /end CHARACTERISTIC
/begin CHARACTERISTIC D_DiErrorCode_207 "Calibration Field for error code 207" VAL_BLK 0x1945D0 ZF_TAB_OI_NAT16_S4_S3 65535 EH_STANDARD_S4_S3 0 65535 MATRIX_DIM 18 1 1 /end CHARACTERISTIC
/begin CHARACTERISTIC D_DiErrorCode_208 "Calibration Field for error code 208" VAL_BLK 0x1945F4 ZF_TAB_OI_NAT16_S4_S3 65535 EH_STANDARD_S4_S3 0 65535 MATRIX_DIM 18 1 1 /end CHARACTERISTIC
/begin CHARACTERISTIC D_DiErrorCode_209 "Calibration Field for error code 209" VAL_BLK 0x194618 ZF_TAB_OI_NAT16_S4_S3 65535 EH_STANDARD_S4_S3 0 65535 MATRIX_DIM 18 1 1 /end CHARACTERISTIC
/begin CHARACTERISTIC D_DiErrorCode_21 "Calibration Field for error code 21" VAL_BLK 0x192BA8 ZF_TAB_OI_NAT16_S4_S3 65535 EH_STANDARD_S4_S3 0 65535 MATRIX_DIM 18 1 1 /end CHARACTERISTIC
/begin CHARACTERISTIC D_DiErrorCode_210 "Calibration Field for error code 210" VAL_BLK 0x19463C ZF_TAB_OI_NAT16_S4_S3 65535 EH_STANDARD_S4_S3 0 65535 MATRIX_DIM 18 1 1 /end CHARACTERISTIC
/begin CHARACTERISTIC D_DiErrorCode_211 "Calibration Field for error code 211" VAL_BLK 0x194660 ZF_TAB_OI_NAT16_S4_S3 65535 EH_STANDARD_S4_S3 0 65535 MATRIX_DIM 18 1 1 /end CHARACTERISTIC
/begin CHARACTERISTIC D_DiErrorCode_212 "Calibration Field for error code 212" VAL_BLK 0x194684 ZF_TAB_OI_NAT16_S4_S3 65535 EH_STANDARD_S4_S3 0 65535 MATRIX_DIM 18 1 1 /end CHARACTERISTIC
/begin CHARACTERISTIC D_DiErrorCode_213 "Calibration Field for error code 213" VAL_BLK 0x1946A8 ZF_TAB_OI_NAT16_S4_S3 65535 EH_STANDARD_S4_S3 0 65535 MATRIX_DIM 18 1 1 /end CHARACTERISTIC
/begin CHARACTERISTIC D_DiErrorCode_214 "Calibration Field for error code 214" VAL_BLK 0x1946CC ZF_TAB_OI_NAT16_S4_S3 65535 EH_STANDARD_S4_S3 0 65535 MATRIX_DIM 18 1 1 /end CHARACTERISTIC
/begin CHARACTERISTIC D_DiErrorCode_215 "Calibration Field for error code 215" VAL_BLK 0x1946F0 ZF_TAB_OI_NAT16_S4_S3 65535 EH_STANDARD_S4_S3 0 65535 MATRIX_DIM 18 1 1 /end CHARACTERISTIC
/begin CHARACTERISTIC D_DiErrorCode_216 "Calibration Field for error code 216" VAL_BLK 0x194714 ZF_TAB_OI_NAT16_S4_S3 65535 EH_STANDARD_S4_S3 0 65535 MATRIX_DIM 18 1 1 /end CHARACTERISTIC
/begin CHARACTERISTIC D_DiErrorCode_217 "Calibration Field for error code 217" VAL_BLK 0x194738 ZF_TAB_OI_NAT16_S4_S3 65535 EH_STANDARD_S4_S3 0 65535 MATRIX_DIM 18 1 1 /end CHARACTERISTIC
/begin CHARACTERISTIC D_DiErrorCode_218 "Calibration Field for error code 218" VAL_BLK 0x19475C ZF_TAB_OI_NAT16_S4_S3 65535 EH_STANDARD_S4_S3 0 65535 MATRIX_DIM 18 1 1 /end CHARACTERISTIC
/begin CHARACTERISTIC D_DiErrorCode_219 "Calibration Field for error code 219" VAL_BLK 0x194780 ZF_TAB_OI_NAT16_S4_S3 65535 EH_STANDARD_S4_S3 0 65535 MATRIX_DIM 18 1 1 /end CHARACTERISTIC
/begin CHARACTERISTIC D_DiErrorCode_22 "Calibration Field for error code 22" VAL_BLK 0x192BCC ZF_TAB_OI_NAT16_S4_S3 65535 EH_STANDARD_S4_S3 0 65535 MATRIX_DIM 18 1 1 /end CHARACTERISTIC
/begin CHARACTERISTIC D_DiErrorCode_220 "Calibration Field for error code 220" VAL_BLK 0x1947A4 ZF_TAB_OI_NAT16_S4_S3 65535 EH_STANDARD_S4_S3 0 65535 MATRIX_DIM 18 1 1 /end CHARACTERISTIC
/begin CHARACTERISTIC D_DiErrorCode_221 "Calibration Field for error code 221" VAL_BLK 0x1947C8 ZF_TAB_OI_NAT16_S4_S3 65535 EH_STANDARD_S4_S3 0 65535 MATRIX_DIM 18 1 1 /end CHARACTERISTIC
/begin CHARACTERISTIC D_DiErrorCode_222 "Calibration Field for error code 222" VAL_BLK 0x1947EC ZF_TAB_OI_NAT16_S4_S3 65535 EH_STANDARD_S4_S3 0 65535 MATRIX_DIM 18 1 1 /end CHARACTERISTIC
/begin CHARACTERISTIC D_DiErrorCode_223 "Calibration Field for error code 223" VAL_BLK 0x194810 ZF_TAB_OI_NAT16_S4_S3 65535 EH_STANDARD_S4_S3 0 65535 MATRIX_DIM 18 1 1 /end CHARACTERISTIC
/begin CHARACTERISTIC D_DiErrorCode_224 "Calibration Field for error code 224" VAL_BLK 0x194834 ZF_TAB_OI_NAT16_S4_S3 65535 EH_STANDARD_S4_S3 0 65535 MATRIX_DIM 18 1 1 /end CHARACTERISTIC
/begin CHARACTERISTIC D_DiErrorCode_225 "Calibration Field for error code 225" VAL_BLK 0x194858 ZF_TAB_OI_NAT16_S4_S3 65535 EH_STANDARD_S4_S3 0 65535 MATRIX_DIM 18 1 1 /end CHARACTERISTIC
/begin CHARACTERISTIC D_DiErrorCode_226 "Calibration Field for error code 226" VAL_BLK 0x19487C ZF_TAB_OI_NAT16_S4_S3 65535 EH_STANDARD_S4_S3 0 65535 MATRIX_DIM 18 1 1 /end CHARACTERISTIC
/begin CHARACTERISTIC D_DiErrorCode_227 "Calibration Field for error code 227" VAL_BLK 0x1948A0 ZF_TAB_OI_NAT16_S4_S3 65535 EH_STANDARD_S4_S3 0 65535 MATRIX_DIM 18 1 1 /end CHARACTERISTIC
/begin CHARACTERISTIC D_DiErrorCode_228 "Calibration Field for error code 228" VAL_BLK 0x1948C4 ZF_TAB_OI_NAT16_S4_S3 65535 EH_STANDARD_S4_S3 0 65535 MATRIX_DIM 18 1 1 /end CHARACTERISTIC
/begin CHARACTERISTIC D_DiErrorCode_229 "Calibration Field for error code 229" VAL_BLK 0x1948E8 ZF_TAB_OI_NAT16_S4_S3 65535 EH_STANDARD_S4_S3 0 65535 MATRIX_DIM 18 1 1 /end CHARACTERISTIC
/begin CHARACTERISTIC D_DiErrorCode_23 "Calibration Field for error code 23" VAL_BLK 0x192BF0 ZF_TAB_OI_NAT16_S4_S3 65535 EH_STANDARD_S4_S3 0 65535 MATRIX_DIM 18 1 1 /end CHARACTERISTIC
/begin CHARACTERISTIC D_DiErrorCode_230 "Calibration Field for error code 230" VAL_BLK 0x19490C ZF_TAB_OI_NAT16_S4_S3 65535 EH_STANDARD_S4_S3 0 65535 MATRIX_DIM 18 1 1 /end CHARACTERISTIC
/begin CHARACTERISTIC D_DiErrorCode_231 "Calibration Field for error code 231" VAL_BLK 0x194930 ZF_TAB_OI_NAT16_S4_S3 65535 EH_STANDARD_S4_S3 0 65535 MATRIX_DIM 18 1 1 /end CHARACTERISTIC
/begin CHARACTERISTIC D_DiErrorCode_232 "Calibration Field for error code 232" VAL_BLK 0x194954 ZF_TAB_OI_NAT16_S4_S3 65535 EH_STANDARD_S4_S3 0 65535 MATRIX_DIM 18 1 1 /end CHARACTERISTIC
/begin CHARACTERISTIC D_DiErrorCode_233 "Calibration Field for error code 233" VAL_BLK 0x194978 ZF_TAB_OI_NAT16_S4_S3 65535 EH_STANDARD_S4_S3 0 65535 MATRIX_DIM 18 1 1 /end CHARACTERISTIC
/begin CHARACTERISTIC D_DiErrorCode_234 "Calibration Field for error code 234" VAL_BLK 0x19499C ZF_TAB_OI_NAT16_S4_S3 65535 EH_STANDARD_S4_S3 0 65535 MATRIX_DIM 18 1 1 /end CHARACTERISTIC
/begin CHARACTERISTIC D_DiErrorCode_235 "Calibration Field for error code 235" VAL_BLK 0x1949C0 ZF_TAB_OI_NAT16_S4_S3 65535 EH_STANDARD_S4_S3 0 65535 MATRIX_DIM 18 1 1 /end CHARACTERISTIC
/begin CHARACTERISTIC D_DiErrorCode_236 "Calibration Field for error code 236" VAL_BLK 0x1949E4 ZF_TAB_OI_NAT16_S4_S3 65535 EH_STANDARD_S4_S3 0 65535 MATRIX_DIM 18 1 1 /end CHARACTERISTIC
/begin CHARACTERISTIC D_DiErrorCode_237 "Calibration Field for error code 237" VAL_BLK 0x194A08 ZF_TAB_OI_NAT16_S4_S3 65535 EH_STANDARD_S4_S3 0 65535 MATRIX_DIM 18 1 1 /end CHARACTERISTIC
/begin CHARACTERISTIC D_DiErrorCode_238 "Calibration Field for error code 238" VAL_BLK 0x194A2C ZF_TAB_OI_NAT16_S4_S3 65535 EH_STANDARD_S4_S3 0 65535 MATRIX_DIM 18 1 1 /end CHARACTERISTIC
/begin CHARACTERISTIC D_DiErrorCode_239 "Calibration Field for error code 239" VAL_BLK 0x194A50 ZF_TAB_OI_NAT16_S4_S3 65535 EH_STANDARD_S4_S3 0 65535 MATRIX_DIM 18 1 1 /end CHARACTERISTIC
/begin CHARACTERISTIC D_DiErrorCode_24 "Calibration Field for error code 24" VAL_BLK 0x192C14 ZF_TAB_OI_NAT16_S4_S3 65535 EH_STANDARD_S4_S3 0 65535 MATRIX_DIM 18 1 1 /end CHARACTERISTIC
/begin CHARACTERISTIC D_DiErrorCode_240 "Calibration Field for error code 240" VAL_BLK 0x194A74 ZF_TAB_OI_NAT16_S4_S3 65535 EH_STANDARD_S4_S3 0 65535 MATRIX_DIM 18 1 1 /end CHARACTERISTIC
/begin CHARACTERISTIC D_DiErrorCode_241 "Calibration Field for error code 241" VAL_BLK 0x194A98 ZF_TAB_OI_NAT16_S4_S3 65535 EH_STANDARD_S4_S3 0 65535 MATRIX_DIM 18 1 1 /end CHARACTERISTIC
/begin CHARACTERISTIC D_DiErrorCode_242 "Calibration Field for error code 242" VAL_BLK 0x194ABC ZF_TAB_OI_NAT16_S4_S3 65535 EH_STANDARD_S4_S3 0 65535 MATRIX_DIM 18 1 1 /end CHARACTERISTIC
/begin CHARACTERISTIC D_DiErrorCode_243 "Calibration Field for error code 243" VAL_BLK 0x194AE0 ZF_TAB_OI_NAT16_S4_S3 65535 EH_STANDARD_S4_S3 0 65535 MATRIX_DIM 18 1 1 /end CHARACTERISTIC
/begin CHARACTERISTIC D_DiErrorCode_244 "Calibration Field for error code 244" VAL_BLK 0x194B04 ZF_TAB_OI_NAT16_S4_S3 65535 EH_STANDARD_S4_S3 0 65535 MATRIX_DIM 18 1 1 /end CHARACTERISTIC
/begin CHARACTERISTIC D_DiErrorCode_245 "Calibration Field for error code 245" VAL_BLK 0x194B28 ZF_TAB_OI_NAT16_S4_S3 65535 EH_STANDARD_S4_S3 0 65535 MATRIX_DIM 18 1 1 /end CHARACTERISTIC
/begin CHARACTERISTIC D_DiErrorCode_246 "Calibration Field for error code 246" VAL_BLK 0x194B4C ZF_TAB_OI_NAT16_S4_S3 65535 EH_STANDARD_S4_S3 0 65535 MATRIX_DIM 18 1 1 /end CHARACTERISTIC
/begin CHARACTERISTIC D_DiErrorCode_247 "Calibration Field for error code 247" VAL_BLK 0x194B70 ZF_TAB_OI_NAT16_S4_S3 65535 EH_STANDARD_S4_S3 0 65535 MATRIX_DIM 18 1 1 /end CHARACTERISTIC
/begin CHARACTERISTIC D_DiErrorCode_248 "Calibration Field for error code 248" VAL_BLK 0x194B94 ZF_TAB_OI_NAT16_S4_S3 65535 EH_STANDARD_S4_S3 0 65535 MATRIX_DIM 18 1 1 /end CHARACTERISTIC
/begin CHARACTERISTIC D_DiErrorCode_249 "Calibration Field for error code 249" VAL_BLK 0x194BB8 ZF_TAB_OI_NAT16_S4_S3 65535 EH_STANDARD_S4_S3 0 65535 MATRIX_DIM 18 1 1 /end CHARACTERISTIC
/begin CHARACTERISTIC D_DiErrorCode_25 "Calibration Field for error code 25" VAL_BLK 0x192C38 ZF_TAB_OI_NAT16_S4_S3 65535 EH_STANDARD_S4_S3 0 65535 MATRIX_DIM 18 1 1 /end CHARACTERISTIC
/begin CHARACTERISTIC D_DiErrorCode_250 "Calibration Field for error code 250" VAL_BLK 0x194BDC ZF_TAB_OI_NAT16_S4_S3 65535 EH_STANDARD_S4_S3 0 65535 MATRIX_DIM 18 1 1 /end CHARACTERISTIC
/begin CHARACTERISTIC D_DiErrorCode_251 "Calibration Field for error code 251" VAL_BLK 0x194C00 ZF_TAB_OI_NAT16_S4_S3 65535 EH_STANDARD_S4_S3 0 65535 MATRIX_DIM 18 1 1 /end CHARACTERISTIC
/begin CHARACTERISTIC D_DiErrorCode_252 "Calibration Field for error code 252" VAL_BLK 0x194C24 ZF_TAB_OI_NAT16_S4_S3 65535 EH_STANDARD_S4_S3 0 65535 MATRIX_DIM 18 1 1 /end CHARACTERISTIC
/begin CHARACTERISTIC D_DiErrorCode_253 "Calibration Field for error code 253" VAL_BLK 0x194C48 ZF_TAB_OI_NAT16_S4_S3 65535 EH_STANDARD_S4_S3 0 65535 MATRIX_DIM 18 1 1 /end CHARACTERISTIC
/begin CHARACTERISTIC D_DiErrorCode_254 "Calibration Field for error code 254" VAL_BLK 0x194C6C ZF_TAB_OI_NAT16_S4_S3 65535 EH_STANDARD_S4_S3 0 65535 MATRIX_DIM 18 1 1 /end CHARACTERISTIC
/begin CHARACTERISTIC D_DiErrorCode_26 "Calibration Field for error code 26" VAL_BLK 0x192C5C ZF_TAB_OI_NAT16_S4_S3 65535 EH_STANDARD_S4_S3 0 65535 MATRIX_DIM 18 1 1 /end CHARACTERISTIC
/begin CHARACTERISTIC D_DiErrorCode_27 "Calibration Field for error code 27" VAL_BLK 0x192C80 ZF_TAB_OI_NAT16_S4_S3 65535 EH_STANDARD_S4_S3 0 65535 MATRIX_DIM 18 1 1 /end CHARACTERISTIC
/begin CHARACTERISTIC D_DiErrorCode_28 "Calibration Field for error code 28" VAL_BLK 0x192CA4 ZF_TAB_OI_NAT16_S4_S3 65535 EH_STANDARD_S4_S3 0 65535 MATRIX_DIM 18 1 1 /end CHARACTERISTIC
/begin CHARACTERISTIC D_DiErrorCode_29 "Calibration Field for error code 29" VAL_BLK 0x192CC8 ZF_TAB_OI_NAT16_S4_S3 65535 EH_STANDARD_S4_S3 0 65535 MATRIX_DIM 18 1 1 /end CHARACTERISTIC
/begin CHARACTERISTIC D_DiErrorCode_3 "Calibration Field for error code 3" VAL_BLK 0x192920 ZF_TAB_OI_NAT16_S4_S3 65535 EH_STANDARD_S4_S3 0 65535 MATRIX_DIM 18 1 1 /end CHARACTERISTIC
/begin CHARACTERISTIC D_DiErrorCode_30 "Calibration Field for error code 30" VAL_BLK 0x192CEC ZF_TAB_OI_NAT16_S4_S3 65535 EH_STANDARD_S4_S3 0 65535 MATRIX_DIM 18 1 1 /end CHARACTERISTIC
/begin CHARACTERISTIC D_DiErrorCode_31 "Calibration Field for error code 31" VAL_BLK 0x192D10 ZF_TAB_OI_NAT16_S4_S3 65535 EH_STANDARD_S4_S3 0 65535 MATRIX_DIM 18 1 1 /end CHARACTERISTIC
/begin CHARACTERISTIC D_DiErrorCode_32 "Calibration Field for error code 32" VAL_BLK 0x192D34 ZF_TAB_OI_NAT16_S4_S3 65535 EH_STANDARD_S4_S3 0 65535 MATRIX_DIM 18 1 1 /end CHARACTERISTIC
/begin CHARACTERISTIC D_DiErrorCode_33 "Calibration Field for error code 33" VAL_BLK 0x192D58 ZF_TAB_OI_NAT16_S4_S3 65535 EH_STANDARD_S4_S3 0 65535 MATRIX_DIM 18 1 1 /end CHARACTERISTIC
/begin CHARACTERISTIC D_DiErrorCode_34 "Calibration Field for error code 34" VAL_BLK 0x192D7C ZF_TAB_OI_NAT16_S4_S3 65535 EH_STANDARD_S4_S3 0 65535 MATRIX_DIM 18 1 1 /end CHARACTERISTIC
/begin CHARACTERISTIC D_DiErrorCode_35 "Calibration Field for error code 35" VAL_BLK 0x192DA0 ZF_TAB_OI_NAT16_S4_S3 65535 EH_STANDARD_S4_S3 0 65535 MATRIX_DIM 18 1 1 /end CHARACTERISTIC
/begin CHARACTERISTIC D_DiErrorCode_36 "Calibration Field for error code 36" VAL_BLK 0x192DC4 ZF_TAB_OI_NAT16_S4_S3 65535 EH_STANDARD_S4_S3 0 65535 MATRIX_DIM 18 1 1 /end CHARACTERISTIC
/begin CHARACTERISTIC D_DiErrorCode_37 "Calibration Field for error code 37" VAL_BLK 0x192DE8 ZF_TAB_OI_NAT16_S4_S3 65535 EH_STANDARD_S4_S3 0 65535 MATRIX_DIM 18 1 1 /end CHARACTERISTIC
/begin CHARACTERISTIC D_DiErrorCode_38 "Calibration Field for error code 38" VAL_BLK 0x192E0C ZF_TAB_OI_NAT16_S4_S3 65535 EH_STANDARD_S4_S3 0 65535 MATRIX_DIM 18 1 1 /end CHARACTERISTIC
/begin CHARACTERISTIC D_DiErrorCode_39 "Calibration Field for error code 39" VAL_BLK 0x192E30 ZF_TAB_OI_NAT16_S4_S3 65535 EH_STANDARD_S4_S3 0 65535 MATRIX_DIM 18 1 1 /end CHARACTERISTIC
/begin CHARACTERISTIC D_DiErrorCode_4 "Calibration Field for error code 4" VAL_BLK 0x192944 ZF_TAB_OI_NAT16_S4_S3 65535 EH_STANDARD_S4_S3 0 65535 MATRIX_DIM 18 1 1 /end CHARACTERISTIC
/begin CHARACTERISTIC D_DiErrorCode_40 "Calibration Field for error code 40" VAL_BLK 0x192E54 ZF_TAB_OI_NAT16_S4_S3 65535 EH_STANDARD_S4_S3 0 65535 MATRIX_DIM 18 1 1 /end CHARACTERISTIC
/begin CHARACTERISTIC D_DiErrorCode_41 "Calibration Field for error code 41" VAL_BLK 0x192E78 ZF_TAB_OI_NAT16_S4_S3 65535 EH_STANDARD_S4_S3 0 65535 MATRIX_DIM 18 1 1 /end CHARACTERISTIC
/begin CHARACTERISTIC D_DiErrorCode_42 "Calibration Field for error code 42" VAL_BLK 0x192E9C ZF_TAB_OI_NAT16_S4_S3 65535 EH_STANDARD_S4_S3 0 65535 MATRIX_DIM 18 1 1 /end CHARACTERISTIC
/begin CHARACTERISTIC D_DiErrorCode_43 "Calibration Field for error code 43" VAL_BLK 0x192EC0 ZF_TAB_OI_NAT16_S4_S3 65535 EH_STANDARD_S4_S3 0 65535 MATRIX_DIM 18 1 1 /end CHARACTERISTIC
/begin CHARACTERISTIC D_DiErrorCode_44 "Calibration Field for error code 44" VAL_BLK 0x192EE4 ZF_TAB_OI_NAT16_S4_S3 65535 EH_STANDARD_S4_S3 0 65535 MATRIX_DIM 18 1 1 /end CHARACTERISTIC
/begin CHARACTERISTIC D_DiErrorCode_45 "Calibration Field for error code 45" VAL_BLK 0x192F08 ZF_TAB_OI_NAT16_S4_S3 65535 EH_STANDARD_S4_S3 0 65535 MATRIX_DIM 18 1 1 /end CHARACTERISTIC
/begin CHARACTERISTIC D_DiErrorCode_46 "Calibration Field for error code 46" VAL_BLK 0x192F2C ZF_TAB_OI_NAT16_S4_S3 65535 EH_STANDARD_S4_S3 0 65535 MATRIX_DIM 18 1 1 /end CHARACTERISTIC
/begin CHARACTERISTIC D_DiErrorCode_47 "Calibration Field for error code 47" VAL_BLK 0x192F50 ZF_TAB_OI_NAT16_S4_S3 65535 EH_STANDARD_S4_S3 0 65535 MATRIX_DIM 18 1 1 /end CHARACTERISTIC
/begin CHARACTERISTIC D_DiErrorCode_48 "Calibration Field for error code 48" VAL_BLK 0x192F74 ZF_TAB_OI_NAT16_S4_S3 65535 EH_STANDARD_S4_S3 0 65535 MATRIX_DIM 18 1 1 /end CHARACTERISTIC
/begin CHARACTERISTIC D_DiErrorCode_49 "Calibration Field for error code 49" VAL_BLK 0x192F98 ZF_TAB_OI_NAT16_S4_S3 65535 EH_STANDARD_S4_S3 0 65535 MATRIX_DIM 18 1 1 /end CHARACTERISTIC
/begin CHARACTERISTIC D_DiErrorCode_5 "Calibration Field for error code 5" VAL_BLK 0x192968 ZF_TAB_OI_NAT16_S4_S3 65535 EH_STANDARD_S4_S3 0 65535 MATRIX_DIM 18 1 1 /end CHARACTERISTIC
/begin CHARACTERISTIC D_DiErrorCode_50 "Calibration Field for error code 50" VAL_BLK 0x192FBC ZF_TAB_OI_NAT16_S4_S3 65535 EH_STANDARD_S4_S3 0 65535 MATRIX_DIM 18 1 1 /end CHARACTERISTIC
/begin CHARACTERISTIC D_DiErrorCode_51 "Calibration Field for error code 51" VAL_BLK 0x192FE0 ZF_TAB_OI_NAT16_S4_S3 65535 EH_STANDARD_S4_S3 0 65535 MATRIX_DIM 18 1 1 /end CHARACTERISTIC
/begin CHARACTERISTIC D_DiErrorCode_52 "Calibration Field for error code 52" VAL_BLK 0x193004 ZF_TAB_OI_NAT16_S4_S3 65535 EH_STANDARD_S4_S3 0 65535 MATRIX_DIM 18 1 1 /end CHARACTERISTIC
/begin CHARACTERISTIC D_DiErrorCode_53 "Calibration Field for error code 53" VAL_BLK 0x193028 ZF_TAB_OI_NAT16_S4_S3 65535 EH_STANDARD_S4_S3 0 65535 MATRIX_DIM 18 1 1 /end CHARACTERISTIC
/begin CHARACTERISTIC D_DiErrorCode_54 "Calibration Field for error code 54" VAL_BLK 0x19304C ZF_TAB_OI_NAT16_S4_S3 65535 EH_STANDARD_S4_S3 0 65535 MATRIX_DIM 18 1 1 /end CHARACTERISTIC
/begin CHARACTERISTIC D_DiErrorCode_55 "Calibration Field for error code 55" VAL_BLK 0x193070 ZF_TAB_OI_NAT16_S4_S3 65535 EH_STANDARD_S4_S3 0 65535 MATRIX_DIM 18 1 1 /end CHARACTERISTIC
/begin CHARACTERISTIC D_DiErrorCode_56 "Calibration Field for error code 56" VAL_BLK 0x193094 ZF_TAB_OI_NAT16_S4_S3 65535 EH_STANDARD_S4_S3 0 65535 MATRIX_DIM 18 1 1 /end CHARACTERISTIC
/begin CHARACTERISTIC D_DiErrorCode_57 "Calibration Field for error code 57" VAL_BLK 0x1930B8 ZF_TAB_OI_NAT16_S4_S3 65535 EH_STANDARD_S4_S3 0 65535 MATRIX_DIM 18 1 1 /end CHARACTERISTIC
/begin CHARACTERISTIC D_DiErrorCode_58 "Calibration Field for error code 58" VAL_BLK 0x1930DC ZF_TAB_OI_NAT16_S4_S3 65535 EH_STANDARD_S4_S3 0 65535 MATRIX_DIM 18 1 1 /end CHARACTERISTIC
/begin CHARACTERISTIC D_DiErrorCode_59 "Calibration Field for error code 59" VAL_BLK 0x193100 ZF_TAB_OI_NAT16_S4_S3 65535 EH_STANDARD_S4_S3 0 65535 MATRIX_DIM 18 1 1 /end CHARACTERISTIC
/begin CHARACTERISTIC D_DiErrorCode_6 "Calibration Field for error code 6" VAL_BLK 0x19298C ZF_TAB_OI_NAT16_S4_S3 65535 EH_STANDARD_S4_S3 0 65535 MATRIX_DIM 18 1 1 /end CHARACTERISTIC
/begin CHARACTERISTIC D_DiErrorCode_60 "Calibration Field for error code 60" VAL_BLK 0x193124 ZF_TAB_OI_NAT16_S4_S3 65535 EH_STANDARD_S4_S3 0 65535 MATRIX_DIM 18 1 1 /end CHARACTERISTIC
/begin CHARACTERISTIC D_DiErrorCode_61 "Calibration Field for error code 61" VAL_BLK 0x193148 ZF_TAB_OI_NAT16_S4_S3 65535 EH_STANDARD_S4_S3 0 65535 MATRIX_DIM 18 1 1 /end CHARACTERISTIC
/begin CHARACTERISTIC D_DiErrorCode_62 "Calibration Field for error code 62" VAL_BLK 0x19316C ZF_TAB_OI_NAT16_S4_S3 65535 EH_STANDARD_S4_S3 0 65535 MATRIX_DIM 18 1 1 /end CHARACTERISTIC
/begin CHARACTERISTIC D_DiErrorCode_63 "Calibration Field for error code 63" VAL_BLK 0x193190 ZF_TAB_OI_NAT16_S4_S3 65535 EH_STANDARD_S4_S3 0 65535 MATRIX_DIM 18 1 1 /end CHARACTERISTIC
/begin CHARACTERISTIC D_DiErrorCode_64 "Calibration Field for error code 64" VAL_BLK 0x1931B4 ZF_TAB_OI_NAT16_S4_S3 65535 EH_STANDARD_S4_S3 0 65535 MATRIX_DIM 18 1 1 /end CHARACTERISTIC
/begin CHARACTERISTIC D_DiErrorCode_65 "Calibration Field for error code 65" VAL_BLK 0x1931D8 ZF_TAB_OI_NAT16_S4_S3 65535 EH_STANDARD_S4_S3 0 65535 MATRIX_DIM 18 1 1 /end CHARACTERISTIC
/begin CHARACTERISTIC D_DiErrorCode_66 "Calibration Field for error code 66" VAL_BLK 0x1931FC ZF_TAB_OI_NAT16_S4_S3 65535 EH_STANDARD_S4_S3 0 65535 MATRIX_DIM 18 1 1 /end CHARACTERISTIC
/begin CHARACTERISTIC D_DiErrorCode_67 "Calibration Field for error code 67" VAL_BLK 0x193220 ZF_TAB_OI_NAT16_S4_S3 65535 EH_STANDARD_S4_S3 0 65535 MATRIX_DIM 18 1 1 /end CHARACTERISTIC
/begin CHARACTERISTIC D_DiErrorCode_68 "Calibration Field for error code 68" VAL_BLK 0x193244 ZF_TAB_OI_NAT16_S4_S3 65535 EH_STANDARD_S4_S3 0 65535 MATRIX_DIM 18 1 1 /end CHARACTERISTIC
/begin CHARACTERISTIC D_DiErrorCode_69 "Calibration Field for error code 69" VAL_BLK 0x193268 ZF_TAB_OI_NAT16_S4_S3 65535 EH_STANDARD_S4_S3 0 65535 MATRIX_DIM 18 1 1 /end CHARACTERISTIC
/begin CHARACTERISTIC D_DiErrorCode_7 "Calibration Field for error code 7" VAL_BLK 0x1929B0 ZF_TAB_OI_NAT16_S4_S3 65535 EH_STANDARD_S4_S3 0 65535 MATRIX_DIM 18 1 1 /end CHARACTERISTIC
/begin CHARACTERISTIC D_DiErrorCode_70 "Calibration Field for error code 70" VAL_BLK 0x19328C ZF_TAB_OI_NAT16_S4_S3 65535 EH_STANDARD_S4_S3 0 65535 MATRIX_DIM 18 1 1 /end CHARACTERISTIC
/begin CHARACTERISTIC D_DiErrorCode_71 "Calibration Field for error code 71" VAL_BLK 0x1932B0 ZF_TAB_OI_NAT16_S4_S3 65535 EH_STANDARD_S4_S3 0 65535 MATRIX_DIM 18 1 1 /end CHARACTERISTIC
/begin CHARACTERISTIC D_DiErrorCode_72 "Calibration Field for error code 72" VAL_BLK 0x1932D4 ZF_TAB_OI_NAT16_S4_S3 65535 EH_STANDARD_S4_S3 0 65535 MATRIX_DIM 18 1 1 /end CHARACTERISTIC
/begin CHARACTERISTIC D_DiErrorCode_73 "Calibration Field for error code 73" VAL_BLK 0x1932F8 ZF_TAB_OI_NAT16_S4_S3 65535 EH_STANDARD_S4_S3 0 65535 MATRIX_DIM 18 1 1 /end CHARACTERISTIC
/begin CHARACTERISTIC D_DiErrorCode_74 "Calibration Field for error code 74" VAL_BLK 0x19331C ZF_TAB_OI_NAT16_S4_S3 65535 EH_STANDARD_S4_S3 0 65535 MATRIX_DIM 18 1 1 /end CHARACTERISTIC
/begin CHARACTERISTIC D_DiErrorCode_75 "Calibration Field for error code 75" VAL_BLK 0x193340 ZF_TAB_OI_NAT16_S4_S3 65535 EH_STANDARD_S4_S3 0 65535 MATRIX_DIM 18 1 1 /end CHARACTERISTIC
/begin CHARACTERISTIC D_DiErrorCode_76 "Calibration Field for error code 76" VAL_BLK 0x193364 ZF_TAB_OI_NAT16_S4_S3 65535 EH_STANDARD_S4_S3 0 65535 MATRIX_DIM 18 1 1 /end CHARACTERISTIC
/begin CHARACTERISTIC D_DiErrorCode_77 "Calibration Field for error code 77" VAL_BLK 0x193388 ZF_TAB_OI_NAT16_S4_S3 65535 EH_STANDARD_S4_S3 0 65535 MATRIX_DIM 18 1 1 /end CHARACTERISTIC
/begin CHARACTERISTIC D_DiErrorCode_78 "Calibration Field for error code 78" VAL_BLK 0x1933AC ZF_TAB_OI_NAT16_S4_S3 65535 EH_STANDARD_S4_S3 0 65535 MATRIX_DIM 18 1 1 /end CHARACTERISTIC
/begin CHARACTERISTIC D_DiErrorCode_79 "Calibration Field for error code 79" VAL_BLK 0x1933D0 ZF_TAB_OI_NAT16_S4_S3 65535 EH_STANDARD_S4_S3 0 65535 MATRIX_DIM 18 1 1 /end CHARACTERISTIC
/begin CHARACTERISTIC D_DiErrorCode_8 "Calibration Field for error code 8" VAL_BLK 0x1929D4 ZF_TAB_OI_NAT16_S4_S3 65535 EH_STANDARD_S4_S3 0 65535 MATRIX_DIM 18 1 1 /end CHARACTERISTIC
/begin CHARACTERISTIC D_DiErrorCode_80 "Calibration Field for error code 80" VAL_BLK 0x1933F4 ZF_TAB_OI_NAT16_S4_S3 65535 EH_STANDARD_S4_S3 0 65535 MATRIX_DIM 18 1 1 /end CHARACTERISTIC
/begin CHARACTERISTIC D_DiErrorCode_81 "Calibration Field for error code 81" VAL_BLK 0x193418 ZF_TAB_OI_NAT16_S4_S3 65535 EH_STANDARD_S4_S3 0 65535 MATRIX_DIM 18 1 1 /end CHARACTERISTIC
/begin CHARACTERISTIC D_DiErrorCode_82 "Calibration Field for error code 82" VAL_BLK 0x19343C ZF_TAB_OI_NAT16_S4_S3 65535 EH_STANDARD_S4_S3 0 65535 MATRIX_DIM 18 1 1 /end CHARACTERISTIC
/begin CHARACTERISTIC D_DiErrorCode_83 "Calibration Field for error code 83" VAL_BLK 0x193460 ZF_TAB_OI_NAT16_S4_S3 65535 EH_STANDARD_S4_S3 0 65535 MATRIX_DIM 18 1 1 /end CHARACTERISTIC
/begin CHARACTERISTIC D_DiErrorCode_84 "Calibration Field for error code 84" VAL_BLK 0x193484 ZF_TAB_OI_NAT16_S4_S3 65535 EH_STANDARD_S4_S3 0 65535 MATRIX_DIM 18 1 1 /end CHARACTERISTIC
/begin CHARACTERISTIC D_DiErrorCode_85 "Calibration Field for error code 85" VAL_BLK 0x1934A8 ZF_TAB_OI_NAT16_S4_S3 65535 EH_STANDARD_S4_S3 0 65535 MATRIX_DIM 18 1 1 /end CHARACTERISTIC
/begin CHARACTERISTIC D_DiErrorCode_86 "Calibration Field for error code 86" VAL_BLK 0x1934CC ZF_TAB_OI_NAT16_S4_S3 65535 EH_STANDARD_S4_S3 0 65535 MATRIX_DIM 18 1 1 /end CHARACTERISTIC
/begin CHARACTERISTIC D_DiErrorCode_87 "Calibration Field for error code 87" VAL_BLK 0x1934F0 ZF_TAB_OI_NAT16_S4_S3 65535 EH_STANDARD_S4_S3 0 65535 MATRIX_DIM 18 1 1 /end CHARACTERISTIC
/begin CHARACTERISTIC D_DiErrorCode_88 "Calibration Field for error code 88" VAL_BLK 0x193514 ZF_TAB_OI_NAT16_S4_S3 65535 EH_STANDARD_S4_S3 0 65535 MATRIX_DIM 18 1 1 /end CHARACTERISTIC
/begin CHARACTERISTIC D_DiErrorCode_89 "Calibration Field for error code 89" VAL_BLK 0x193538 ZF_TAB_OI_NAT16_S4_S3 65535 EH_STANDARD_S4_S3 0 65535 MATRIX_DIM 18 1 1 /end CHARACTERISTIC
/begin CHARACTERISTIC D_DiErrorCode_9 "Calibration Field for error code 9" VAL_BLK 0x1929F8 ZF_TAB_OI_NAT16_S4_S3 65535 EH_STANDARD_S4_S3 0 65535 MATRIX_DIM 18 1 1 /end CHARACTERISTIC
/begin CHARACTERISTIC D_DiErrorCode_90 "Calibration Field for error code 90" VAL_BLK 0x19355C ZF_TAB_OI_NAT16_S4_S3 65535 EH_STANDARD_S4_S3 0 65535 MATRIX_DIM 18 1 1 /end CHARACTERISTIC
/begin CHARACTERISTIC D_DiErrorCode_91 "Calibration Field for error code 91" VAL_BLK 0x193580 ZF_TAB_OI_NAT16_S4_S3 65535 EH_STANDARD_S4_S3 0 65535 MATRIX_DIM 18 1 1 /end CHARACTERISTIC
/begin CHARACTERISTIC D_DiErrorCode_92 "Calibration Field for error code 92" VAL_BLK 0x1935A4 ZF_TAB_OI_NAT16_S4_S3 65535 EH_STANDARD_S4_S3 0 65535 MATRIX_DIM 18 1 1 /end CHARACTERISTIC
/begin CHARACTERISTIC D_DiErrorCode_93 "Calibration Field for error code 93" VAL_BLK 0x1935C8 ZF_TAB_OI_NAT16_S4_S3 65535 EH_STANDARD_S4_S3 0 65535 MATRIX_DIM 18 1 1 /end CHARACTERISTIC
/begin CHARACTERISTIC D_DiErrorCode_94 "Calibration Field for error code 94" VAL_BLK 0x1935EC ZF_TAB_OI_NAT16_S4_S3 65535 EH_STANDARD_S4_S3 0 65535 MATRIX_DIM 18 1 1 /end CHARACTERISTIC
/begin CHARACTERISTIC D_DiErrorCode_95 "Calibration Field for error code 95" VAL_BLK 0x193610 ZF_TAB_OI_NAT16_S4_S3 65535 EH_STANDARD_S4_S3 0 65535 MATRIX_DIM 18 1 1 /end CHARACTERISTIC
/begin CHARACTERISTIC D_DiErrorCode_96 "Calibration Field for error code 96" VAL_BLK 0x193634 ZF_TAB_OI_NAT16_S4_S3 65535 EH_STANDARD_S4_S3 0 65535 MATRIX_DIM 18 1 1 /end CHARACTERISTIC
/begin CHARACTERISTIC D_DiErrorCode_97 "Calibration Field for error code 97" VAL_BLK 0x193658 ZF_TAB_OI_NAT16_S4_S3 65535 EH_STANDARD_S4_S3 0 65535 MATRIX_DIM 18 1 1 /end CHARACTERISTIC
/begin CHARACTERISTIC D_DiErrorCode_98 "Calibration Field for error code 98" VAL_BLK 0x19367C ZF_TAB_OI_NAT16_S4_S3 65535 EH_STANDARD_S4_S3 0 65535 MATRIX_DIM 18 1 1 /end CHARACTERISTIC
/begin CHARACTERISTIC D_DiErrorCode_99 "Calibration Field for error code 99" VAL_BLK 0x1936A0 ZF_TAB_OI_NAT16_S4_S3 65535 EH_STANDARD_S4_S3 0 65535 MATRIX_DIM 18 1 1 /end CHARACTERISTIC
/begin CHARACTERISTIC D_DiErrorEntryUpdateType "Time when the error type in the error memory is updated (0=at the end of the forward filtering 1=at the end of the forward filtering if the error has been inactive before 2=as long as the error is active)" VALUE 0x191CE2 ZF_KW_NAT8_S4_S3 255 EH_STANDARD_S4_S3 0 255 /end CHARACTERISTIC
/begin CHARACTERISTIC D_DiErrorInhibitionTab "Calibration field for latching faultcodes dependent on others" MAP 0x1964C8 ZF_TAB2D_OI_NAT16_S4_S3 65535 EH_STANDARD_S4_S3 0 65535
 /begin AXIS_DESCR FIX_AXIS NO_INPUT_QUANTITY EH_STANDARD_S4_S3 3 0 2 READ_ONLY FIX_AXIS_PAR_DIST 0 1 3 /end AXIS_DESCR
 /begin AXIS_DESCR FIX_AXIS NO_INPUT_QUANTITY EH_STANDARD_S4_S3 260 0 259 READ_ONLY FIX_AXIS_PAR_DIST 0 1 260 /end AXIS_DESCR
/end CHARACTERISTIC
/begin CHARACTERISTIC D_DiGroupTester1Counter "definition of GroupTesterOne frequency counter" VALUE 0x191CE5 ZF_KW_NAT8_S4_S3 255 EH_STANDARD_S4_S3 0 255 /end CHARACTERISTIC
/begin CHARACTERISTIC D_DiGroupTester1ErrorCode "definition of GroupTesterOne error code" VALUE 0x191BCE ZF_KW_NAT16_S4_S3 65535 EH_STANDARD_S4_S3 0 65535 /end CHARACTERISTIC
/begin CHARACTERISTIC D_DiGroupTester1ErrorType "definition of GroupTesterOne error type" VALUE 0x191BD0 ZF_KW_NAT16_S4_S3 65535 EH_STANDARD_S4_S3 0 65535 /end CHARACTERISTIC
/begin CHARACTERISTIC D_DiGroupTester1Reaction "definition of GroupTesterOne error reaction state" VALUE 0x191CE6 ZF_KW_NAT8_S4_S3 255 EH_STANDARD_S4_S3 0 255 /end CHARACTERISTIC
/begin CHARACTERISTIC D_DiGroupTester1Status "definition of GroupTesterOne status" VALUE 0x191CE4 ZF_KW_NAT8_S4_S3 255 EH_STANDARD_S4_S3 0 255 /end CHARACTERISTIC
/begin CHARACTERISTIC D_DiGroupTester1Switch "switch to activate the GroupTesterOne operation mode (change from 0x00 to 0x5A for activation, others for deactivation)" VALUE 0x191CE3 ZF_KW_NAT8_S4_S3 255 EH_STANDARD_S4_S3 0 255 /end CHARACTERISTIC
/begin CHARACTERISTIC D_DiObdAutoDeleteVariant "kind of error healing for non-OBD-errors: 0=power-up cycles (using the error code specific start value) 1=obd warm-up cycles (see D_DiObdNrWarmUpCycles)" VALUE 0x191CF2 ZF_KW_NAT8_S4_S3 1 EH_STANDARD_S4_S3 0 1 /end CHARACTERISTIC
/begin CHARACTERISTIC D_DiObdCWarmUpCycleDiff "difference temperature for warm-up cycle detection" VALUE 0x191CEB ZF_KW_NAT8_S4_S3 255 EH_C_1K_S4_S3 0 255 /end CHARACTERISTIC
/begin CHARACTERISTIC D_DiObdCWarmUpCycleTh "temperature threshold for warm-up cycle detection" VALUE 0x191CEA ZF_KW_NAT8_S4_S3 255 EH_C_1CEL_M40_S4_S3 -40 215 /end CHARACTERISTIC
/begin CHARACTERISTIC D_DiObdFFIntern "storage of OBD-FreezeFrames 0=extern 1=intern TCU" VALUE 0x191CF3 ZF_KW_NAT8_S4_S3 1 EH_STANDARD_S4_S3 0 1 /end CHARACTERISTIC
/begin CHARACTERISTIC D_DiObdFFMoment "moment to store and delete OBD-FreezeFrame 1=confirmed and not confirmed 2=pending and not pending not confirmed 3=pending and displacement" VALUE 0x191CF4 ZF_KW_NAT8_S4_S3 2 EH_STANDARD_S4_S3 1 3 /end CHARACTERISTIC
/begin CHARACTERISTIC D_DiObdIumprDenominatorCounterTh "counter threshold for denominator incrementation" VALUE 0x191CF6 ZF_KW_NAT8_S4_S3 255 EH_STANDARD_S4_S3 0 255 /end CHARACTERISTIC
/begin CHARACTERISTIC D_DiObdIumprDenominatorTimeTh "time threshold for denominator incrementation" VALUE 0x191CF5 ZF_KW_NAT8_S4_S3 255 EH_T_1S_S4_S3 0 255 /end CHARACTERISTIC
/begin CHARACTERISTIC D_DiObdNEngTh "engine speed threshold for engine start detection" VALUE 0x191BD2 ZF_KW_NAT16_S4_S3 4096 EH_N_RPM4_S4_S3 0 4096 /end CHARACTERISTIC
/begin CHARACTERISTIC D_DiObdNrWarmUpCycles "number of necessary warmup-cycles for clearing obd-errors from error memory" VALUE 0x191CF1 ZF_KW_NAT8_S4_S3 255 EH_STANDARD_S4_S3 0 255 /end CHARACTERISTIC
/begin CHARACTERISTIC D_DiObdTEngTh "time threshold for engine start detection" VALUE 0x191BD4 ZF_KW_NAT16_S4_S3 65535 EH_T_1MS_S4_S3 0 65535 /end CHARACTERISTIC
/begin CHARACTERISTIC D_DiObdTab_0 "OBD calibration datafield for variant 0" MAP 0x196CFC ZF_TAB2D_OI_NAT8_S4_S3 255 EH_STANDARD_S4_S3 0 255
 /begin AXIS_DESCR FIX_AXIS NO_INPUT_QUANTITY EH_STANDARD_S4_S3 2 0 1 READ_ONLY FIX_AXIS_PAR_DIST 0 1 2 /end AXIS_DESCR
 /begin AXIS_DESCR FIX_AXIS NO_INPUT_QUANTITY EH_STANDARD_S4_S3 254 0 253 READ_ONLY FIX_AXIS_PAR_DIST 0 1 254 /end AXIS_DESCR
/end CHARACTERISTIC
/begin CHARACTERISTIC D_DiObdTab_1 "OBD calibration datafield for variant 1" MAP 0x196EF8 ZF_TAB2D_OI_NAT8_S4_S3 255 EH_STANDARD_S4_S3 0 255
 /begin AXIS_DESCR FIX_AXIS NO_INPUT_QUANTITY EH_STANDARD_S4_S3 2 0 1 READ_ONLY FIX_AXIS_PAR_DIST 0 1 2 /end AXIS_DESCR
 /begin AXIS_DESCR FIX_AXIS NO_INPUT_QUANTITY EH_STANDARD_S4_S3 254 0 253 READ_ONLY FIX_AXIS_PAR_DIST 0 1 254 /end AXIS_DESCR
/end CHARACTERISTIC
/begin CHARACTERISTIC D_DiRetryRNFInInit "number of retries for RNF at power-up (only if RNF failed because of missing project specific conditions)" VALUE 0x191CE1 ZF_KW_NAT8_S4_S3 255 EH_STANDARD_S4_S3 0 255 /end CHARACTERISTIC
/begin CHARACTERISTIC D_GearSourceAtFlashOffEngRunning "Array for Gear Source Choice for every DisplayMode" CURVE 0x192220 ZF_TAB_NAT8_S1_S3 3 SBW_STANDARD_S1_S3 0 3
 /begin AXIS_DESCR FIX_AXIS NO_INPUT_QUANTITY SBW_STANDARD_S1_S3 4 0 3 READ_ONLY FIX_AXIS_PAR_DIST 0 1 4 /end AXIS_DESCR
/end CHARACTERISTIC
/begin CHARACTERISTIC D_GearSourceAtFlashOnEngRunning "Array for Gear Source Choice for every DisplayMode" CURVE 0x192228 ZF_TAB_NAT8_S1_S3 3 SBW_STANDARD_S1_S3 0 3
 /begin AXIS_DESCR FIX_AXIS NO_INPUT_QUANTITY SBW_STANDARD_S1_S3 4 0 3 READ_ONLY FIX_AXIS_PAR_DIST 0 1 4 /end AXIS_DESCR
/end CHARACTERISTIC
/begin CHARACTERISTIC D_ModeIfDriveLogic "mode change table used at activation of drive logic (MultAccess.DriveLogic != 0) the array index is the entering mode and the value the resulting mode 0=Adaptive 1=Sport 2=Manual 3=ManualSport 4=ModeReturn" CURVE 0x192278 ZF_TAB_NAT8_S1_S3 4 SBW_STANDARD_S1_S3 0 4
 /begin AXIS_DESCR FIX_AXIS NO_INPUT_QUANTITY SBW_STANDARD_S1_S3 4 0 3 READ_ONLY FIX_AXIS_PAR_DIST 0 1 4 /end AXIS_DESCR
/end CHARACTERISTIC
/begin CHARACTERISTIC D_ModeIfDrvReqD "table for mode change when driver request is D (StoreDrvReq.DrvReqPRND = D) the array index is the entering mode and the value the resulting mode 0=Adaptive 1=Sport 2=Manual 3=ManualSport 4=ModeReturn" CURVE 0x192268 ZF_TAB_NAT8_S1_S3 4 SBW_STANDARD_S1_S3 0 4
 /begin AXIS_DESCR FIX_AXIS NO_INPUT_QUANTITY SBW_STANDARD_S1_S3 4 0 3 READ_ONLY FIX_AXIS_PAR_DIST 0 1 4 /end AXIS_DESCR
/end CHARACTERISTIC
/begin CHARACTERISTIC D_ModeIfLowMode "mode change table used at activation of the LowMode button (f_LowModeButton == 1) the array index is the entering mode and the value the resulting mode 0=Adaptive 1=Sport 2=Manual 3=ManualSport 4=ModeReturn" CURVE 0x192280 ZF_TAB_NAT8_S1_S3 4 SBW_STANDARD_S1_S3 0 4
 /begin AXIS_DESCR FIX_AXIS NO_INPUT_QUANTITY SBW_STANDARD_S1_S3 4 0 3 READ_ONLY FIX_AXIS_PAR_DIST 0 1 4 /end AXIS_DESCR
/end CHARACTERISTIC
/begin CHARACTERISTIC D_ModeIfLowModeInvalid "mode change table used at invalid LowMode button state (f_LowModeInvalid == 1) the array index is the entering mode and the value the resulting mode 0=Adaptive 1=Sport 2=Manual 3=ManualSport 4=ModeReturn" CURVE 0x192288 ZF_TAB_NAT8_S1_S3 4 SBW_STANDARD_S1_S3 0 4
 /begin AXIS_DESCR FIX_AXIS NO_INPUT_QUANTITY SBW_STANDARD_S1_S3 4 0 3 READ_ONLY FIX_AXIS_PAR_DIST 0 1 4 /end AXIS_DESCR
/end CHARACTERISTIC
/begin CHARACTERISTIC D_ModeIfMGateAndTempMan "table for mode change after active f_MGateOn and f_TempMan without tip1 event the array index is the entering mode and the value the resulting mode 0=Adaptive 1=Sport 2=Manual 3=ManualSport 4=ModeReturn" CURVE 0x192238 ZF_TAB_NAT8_S1_S3 4 SBW_STANDARD_S1_S3 0 4
 /begin AXIS_DESCR FIX_AXIS NO_INPUT_QUANTITY SBW_STANDARD_S1_S3 4 0 3 READ_ONLY FIX_AXIS_PAR_DIST 0 1 4 /end AXIS_DESCR
/end CHARACTERISTIC
/begin CHARACTERISTIC D_ModeIfMGateOff "table for mode change at MGate inactive (f_MGateOff == 1) the array index is the entering mode and the value the resulting mode 0=Adaptive 1=Sport 2=Manual 3=ManualSport 4=ModeReturn" CURVE 0x192230 ZF_TAB_NAT8_S1_S3 4 SBW_STANDARD_S1_S3 0 4
 /begin AXIS_DESCR FIX_AXIS NO_INPUT_QUANTITY SBW_STANDARD_S1_S3 4 0 3 READ_ONLY FIX_AXIS_PAR_DIST 0 1 4 /end AXIS_DESCR
/end CHARACTERISTIC
/begin CHARACTERISTIC D_ModeIfMGateOn "table for mode change after MGate active the array index is the entering mode and the value the resulting mode 0=Adaptive 1=Sport 2=Manual 3=ManualSport 4=ModeReturn" CURVE 0x192240 ZF_TAB_NAT8_S1_S3 4 SBW_STANDARD_S1_S3 0 4
 /begin AXIS_DESCR FIX_AXIS NO_INPUT_QUANTITY SBW_STANDARD_S1_S3 4 0 3 READ_ONLY FIX_AXIS_PAR_DIST 0 1 4 /end AXIS_DESCR
/end CHARACTERISTIC
/begin CHARACTERISTIC D_ModeIfSportButton "table for mode change at pressing Sport Button the array index is the entering mode and the value the resulting mode 0=Adaptive 1=Sport 2=Manual 3=ManualSport 4=ModeReturn" CURVE 0x192270 ZF_TAB_NAT8_S1_S3 4 SBW_STANDARD_S1_S3 0 4
 /begin AXIS_DESCR FIX_AXIS NO_INPUT_QUANTITY SBW_STANDARD_S1_S3 4 0 3 READ_ONLY FIX_AXIS_PAR_DIST 0 1 4 /end AXIS_DESCR
/end CHARACTERISTIC
/begin CHARACTERISTIC D_ModeIfTimerExpiredTip1 "table for mode change after ModeReturnTimer of Tip1 expires (f_TimerModeReturnTip1Expired == 1) the array index is the entering mode and the value the resulting mode 0=Adaptive 1=Sport 2=Manual 3=ManualSport 4=ModeReturn" CURVE 0x192258 ZF_TAB_NAT8_S1_S3 4 SBW_STANDARD_S1_S3 0 4
 /begin AXIS_DESCR FIX_AXIS NO_INPUT_QUANTITY SBW_STANDARD_S1_S3 4 0 3 READ_ONLY FIX_AXIS_PAR_DIST 0 1 4 /end AXIS_DESCR
/end CHARACTERISTIC
/begin CHARACTERISTIC D_ModeIfTimerExpiredTip2 "table for mode change after ModeReturnTimer of Tip2 expires (f_TimerModeReturnTip2Expired == 1) the array index is the entering mode and the value the resulting mode 0=Adaptive 1=Sport 2=Manual 3=ManualSport 4=ModeReturn" CURVE 0x192260 ZF_TAB_NAT8_S1_S3 4 SBW_STANDARD_S1_S3 0 4
 /begin AXIS_DESCR FIX_AXIS NO_INPUT_QUANTITY SBW_STANDARD_S1_S3 4 0 3 READ_ONLY FIX_AXIS_PAR_DIST 0 1 4 /end AXIS_DESCR
/end CHARACTERISTIC
/begin CHARACTERISTIC D_ModeIfTip1 "table for mode change after Tip1 the array index is the entering mode and the value the resulting mode 0=Adaptive 1=Sport 2=Manual 3=ManualSport 4=ModeReturn" CURVE 0x192248 ZF_TAB_NAT8_S1_S3 4 SBW_STANDARD_S1_S3 0 4
 /begin AXIS_DESCR FIX_AXIS NO_INPUT_QUANTITY SBW_STANDARD_S1_S3 4 0 3 READ_ONLY FIX_AXIS_PAR_DIST 0 1 4 /end AXIS_DESCR
/end CHARACTERISTIC
/begin CHARACTERISTIC D_ModeIfTip2 "table for mode change after Tip2 the array index is the entering mode and the value the resulting mode 0=Adaptive 1=Sport 2=Manual 3=ManualSport 4=ModeReturn" CURVE 0x192250 ZF_TAB_NAT8_S1_S3 4 SBW_STANDARD_S1_S3 0 4
 /begin AXIS_DESCR FIX_AXIS NO_INPUT_QUANTITY SBW_STANDARD_S1_S3 4 0 3 READ_ONLY FIX_AXIS_PAR_DIST 0 1 4 /end AXIS_DESCR
/end CHARACTERISTIC
/begin CHARACTERISTIC D_Rsp_ErrCnt_FctCRafterCalcSK_Max_B "upper threshold for ews4 error-counter Err_B for wrong or no responses [in fct. Challenge-Resp.after calc. SK]" VALUE 0x191CAA ZF_KW_NAT8_S1_S3 10 SBW_STANDARD_S1_S3 0 10 /end CHARACTERISTIC
/begin CHARACTERISTIC D_Rsp_ErrCnt_SK_avail_Max_A "upper threshold for ews4 rsp_err_cnt_A: non-authentic responses received [when SK available/locked]" VALUE 0x191CA8 ZF_KW_NAT8_S1_S3 10 SBW_STANDARD_S1_S3 0 10 /end CHARACTERISTIC
/begin CHARACTERISTIC D_Rsp_ErrCnt_SK_unavail_Max_C "upper threshold for ews4 rsp_err_cnt_C: responses received [without SK available/locked]" VALUE 0x191CA9 ZF_KW_NAT8_S1_S3 3 SBW_STANDARD_S1_S3 0 3 /end CHARACTERISTIC
/begin CHARACTERISTIC D_Rsp_OkCnt_FctCRafterCalcSK_Min_Ok "upper threshold for ews4 ok-counter Ok_Count for correct responses [in fct. Challenge-Resp.after calc. SK]" VALUE 0x191CAB ZF_KW_NAT8_S1_S3 3 SBW_STANDARD_S1_S3 0 3 /end CHARACTERISTIC
/begin CHARACTERISTIC D_StringObdEcuName "OBD ECU-Name for Mode 09 Infotype 0x0A" VAL_BLK 0x19265C ZF_TAB_NAT8_S4_S3 255 EH_STANDARD_S4_S3 0 255 MATRIX_DIM 20 1 1 /end CHARACTERISTIC
/begin CHARACTERISTIC D_Tab_LockCond "Table of locking condition for cc msgs" MAP 0x1924B0 ZF_TAB2D_NAT32_S1_S3 4294970000 SBW_STANDARD_S1_S3 0 4294967295
 /begin AXIS_DESCR FIX_AXIS NO_INPUT_QUANTITY SBW_STANDARD_S1_S3 2 0 1 READ_ONLY FIX_AXIS_PAR_DIST 0 1 2 /end AXIS_DESCR
 /begin AXIS_DESCR FIX_AXIS NO_INPUT_QUANTITY SBW_STANDARD_S1_S3 40 0 39 READ_ONLY FIX_AXIS_PAR_DIST 0 1 40 /end AXIS_DESCR
/end CHARACTERISTIC
/begin CHARACTERISTIC D_ThrottlePosUThForQSF "throttle position upper threshold for quitting subst function bitmask" VALUE 0x191CE0 ZF_KW_NAT8_S4_S3 100 EH_100PROZENT255_S4_S3 0 100 /end CHARACTERISTIC
/begin CHARACTERISTIC D_UMV3_KFC_PSINOUT_Th "Threshold for voltage u_drmv for KFC_PSIN and KFC_PSOUT" VALUE 0x191C96 ZF_KW_NAT8_S1_S3 16 SBW_U_STD_S1_S3 0 16 /end CHARACTERISTIC
/begin CHARACTERISTIC D_ang_GbxTempReqP "Threshold for accel.pedal angle to prevent Diag-P due to GB temperature" VALUE 0x191CA5 ZF_KW_NAT8_S1_S3 100.4 SBW_HDK_M_S1_S3 0 100.4 /end CHARACTERISTIC
/begin CHARACTERISTIC D_c_CCHotHysOilChip_Th "Hysteresis value for oil and chip temperature Hotmode CC-Msg" VALUE 0x191CBD ZF_KW_NAT8_S1_S3 255 SBW_STANDARD_S1_S3 0 255 /end CHARACTERISTIC
/begin CHARACTERISTIC D_c_GbxTempReqP "Threshhold for Diag-P due to GB temperature" VALUE 0x191CA4 ZF_KW_NAT8_S1_S3 215 SBW_CGT40_M_S1_S3 -40 175 /end CHARACTERISTIC
/begin CHARACTERISTIC D_c_TChipCCHot1_Th "Threshhold for chip temperature for 1st Hotmode CC-Msg" VALUE 0x191CBA ZF_KW_NAT8_S1_S3 215 SBW_CGT40_M_S1_S3 -40 175 /end CHARACTERISTIC
/begin CHARACTERISTIC D_c_TChipCCHot2_Th "Threshhold for chip temperature for 2nd Hotmode CC-Msg" VALUE 0x191CBB ZF_KW_NAT8_S1_S3 215 SBW_CGT40_M_S1_S3 -40 175 /end CHARACTERISTIC
/begin CHARACTERISTIC D_c_TChipCCHot3_Th "Threshhold for chip temperature for 3rd Hotmode CC-Msg" VALUE 0x191CBC ZF_KW_NAT8_S1_S3 215 SBW_CGT40_M_S1_S3 -40 175 /end CHARACTERISTIC
/begin CHARACTERISTIC D_c_TOilCCHot1_Th "Threshhold for oil temperature for 1st Hotmode CC-Msg" VALUE 0x191CB7 ZF_KW_NAT8_S1_S3 215 SBW_CGT40_M_S1_S3 -40 175 /end CHARACTERISTIC
/begin CHARACTERISTIC D_c_TOilCCHot2_Th "Threshhold for oil temperature for 2nd Hotmode CC-Msg" VALUE 0x191CB8 ZF_KW_NAT8_S1_S3 215 SBW_CGT40_M_S1_S3 -40 175 /end CHARACTERISTIC
/begin CHARACTERISTIC D_c_TOilCCHot3_Th "Threshhold for oil temperature for 3rd Hotmode CC-Msg" VALUE 0x191CB9 ZF_KW_NAT8_S1_S3 215 SBW_CGT40_M_S1_S3 -40 175 /end CHARACTERISTIC
/begin CHARACTERISTIC D_c_TOilCCML_Th "temperature threshold for ID_MechLimpInD and ID_ParkLockFault_InMechLimp" VALUE 0x191C9F ZF_KW_NAT8_S1_S3 255 SBW_CGT40_M_S1_S3 -40 215 /end CHARACTERISTIC
/begin CHARACTERISTIC D_dc_Offset "Offset adjustment of the 10 percent/90 percent threshold" VALUE 0x191C7B ZF_KW_NAT8_S2_S3 10 SAB_PROZENT10_S2_S3 0 10 /end CHARACTERISTIC
/begin CHARACTERISTIC D_i_TargetGear "Applizierbarer Wert fuer Uebersetzung des Zielgangs Pos0=R Pos1=Gang1 Pos2=Gang2 usw bis Pos8=Gang8" VAL_BLK 0x192090 ZF_TAB_NAT16_S2_S3 65.535 SAB_K1000_S2_S3 0 65.535 MATRIX_DIM 10 1 1 /end CHARACTERISTIC
/begin CHARACTERISTIC D_k_AbNew "Application parameter weighting factor of new value in n_AbFilt1 calculation" VALUE 0x191C82 ZF_KW_NAT8_S2_S3 30 SAB_STANDARD_S2_S3 1 31 /end CHARACTERISTIC
/begin CHARACTERISTIC D_k_AbOld "Application parameter weighting factor of old values in n_AbFilt1 calculation" VALUE 0x191C81 ZF_KW_NAT8_S2_S3 31 SAB_STANDARD_S2_S3 0 31 /end CHARACTERISTIC
/begin CHARACTERISTIC D_k_AbTuVirtNew "Gewichtungsfaktor neuer Wert fuer sv_n_AbTuVirtFilt" VALUE 0x191C70 ZF_KW_NAT8_S2_S3 255 SAB_STANDARD_S2_S3 0 255 /end CHARACTERISTIC
/begin CHARACTERISTIC D_k_AbTuVirtOld "Gewichtungsfaktor alter Wert fuer sv_n_AbTuVirtFilt" VALUE 0x191C71 ZF_KW_NAT8_S2_S3 255 SAB_STANDARD_S2_S3 0 255 /end CHARACTERISTIC
/begin CHARACTERISTIC D_k_DifIAENew "Gewichtungsfaktor neuer Wert fuer sv_n_Dif_IAEFilt fuer Vorzeichenbestimmung" VALUE 0x191C6A ZF_KW_NAT8_S2_S3 255 SAB_STANDARD_S2_S3 0 255 /end CHARACTERISTIC
/begin CHARACTERISTIC D_k_DifIAEOld "Gewichtungsfaktor alter Wert fuer sv_n_Dif_IAEFilt fuer Vorzeichenbestimmung" VALUE 0x191C6B ZF_KW_NAT8_S2_S3 255 SAB_STANDARD_S2_S3 0 255 /end CHARACTERISTIC
/begin CHARACTERISTIC D_k_EngTuVirtNew "Gewichtungsfaktor neuer Wert fuer sv_n_EngTuVirtFilt" VALUE 0x191C6E ZF_KW_NAT8_S2_S3 255 SAB_STANDARD_S2_S3 0 255 /end CHARACTERISTIC
/begin CHARACTERISTIC D_k_EngTuVirtOld "Gewichtungsfaktor alter Wert fuer sv_n_EngTuVirtFilt" VALUE 0x191C6F ZF_KW_NAT8_S2_S3 255 SAB_STANDARD_S2_S3 0 255 /end CHARACTERISTIC
/begin CHARACTERISTIC D_k_TuVirtNew "Gewichtungsfaktor neuer Wert fuer sv_n_TuVirtFilt fuer Vorzeichenbestimmung" VALUE 0x191C6C ZF_KW_NAT8_S2_S3 255 SAB_STANDARD_S2_S3 0 255 /end CHARACTERISTIC
/begin CHARACTERISTIC D_k_TuVirtOld "Gewichtungsfaktor alter Wert fuer sv_n_TuVirtFilt fuer Vorzeichenbestimmung" VALUE 0x191C6D ZF_KW_NAT8_S2_S3 255 SAB_STANDARD_S2_S3 0 255 /end CHARACTERISTIC
/begin CHARACTERISTIC D_k_n6 "Applizierbarer Wert fuer k_n6" VAL_BLK 0x1921B8 ZF_TAB_NAT32_S2_S3 20 SAB_K10000_M10_S2_S3 -10 10 MATRIX_DIM 20 1 1 /end CHARACTERISTIC
/begin CHARACTERISTIC D_k_n6TuVirtNew "Gewichtungsfaktor neuer Wert fuer iv_n_TuTuVirtFilt" VALUE 0x191C72 ZF_KW_NAT8_S2_S3 255 SAB_STANDARD_S2_S3 0 255 /end CHARACTERISTIC
/begin CHARACTERISTIC D_k_n6TuVirtOld "Gewichtungsfaktor alter Wert fuer iv_n_TuTuVirtFilt" VALUE 0x191C73 ZF_KW_NAT8_S2_S3 255 SAB_STANDARD_S2_S3 0 255 /end CHARACTERISTIC
/begin CHARACTERISTIC D_k_nab "Applizierbarer Wert fuer k_nab" VAL_BLK 0x192164 ZF_TAB_NAT32_S2_S3 20 SAB_K10000_M10_S2_S3 -10 10 MATRIX_DIM 20 1 1 /end CHARACTERISTIC
/begin CHARACTERISTIC D_k_nmot "Applizierbarer Wert fuer k_nmot" VAL_BLK 0x192110 ZF_TAB_NAT32_S2_S3 20 SAB_K10000_M10_S2_S3 -10 10 MATRIX_DIM 20 1 1 /end CHARACTERISTIC
/begin CHARACTERISTIC D_lfz_Wheel "Application parameter of dynamic wheel circumference" VALUE 0x191B2C ZF_KW_NAT16_S2_S3 1741 SAB_L_1MM_S2_S3 1000 2741 /end CHARACTERISTIC
/begin CHARACTERISTIC D_nAbFiltUThForQSF "n_Ab filtered speed upper threshold for quitting subst function bitmask" VALUE 0x191BC4 ZF_KW_NAT16_S4_S3 11000 EH_N_1RPM_S4_S3 0 11000 /end CHARACTERISTIC
/begin CHARACTERISTIC D_nEngLThForCalTC "engine speed lower threshold for calibrateable test conditions" VALUE 0x191BCC ZF_KW_NAT16_S4_S3 11000 EH_N_1RPM_S4_S3 0 11000 /end CHARACTERISTIC
/begin CHARACTERISTIC D_n_AbPosDirD_Lth "threshold drive/output rev.s for recognition of D" VALUE 0x191B3C ZF_KW_NAT16_S1_S3 65535 SBW_STANDARD_S1_S3 0 65535 /end CHARACTERISTIC
/begin CHARACTERISTIC D_n_AbPosDirD_Lth_L2 "level 2 threshold drive/output rev.s for recognition of D" VALUE 0x1D8EA4 ZF_KW_NAT16_S1_S3 65535 SBW_STANDARD_S1_S3 0 65535 /end CHARACTERISTIC
/begin CHARACTERISTIC D_n_AbPosDirP_Uth "threshold drive/output rev.s for recognition of P" VALUE 0x191B3E ZF_KW_NAT16_S1_S3 65535 SBW_STANDARD_S1_S3 0 65535 /end CHARACTERISTIC
/begin CHARACTERISTIC D_n_AbPosDirP_Uth_L2 "L2 threshold drive/output rev.s for recognition of P" VALUE 0x1D8EA6 ZF_KW_NAT16_S1_S3 65535 SBW_STANDARD_S1_S3 0 65535 /end CHARACTERISTIC
/begin CHARACTERISTIC D_n_Ab_AllowFSC_Uth "threshold drive/output rev.s for allowing FSC-operations" VALUE 0x191B6A ZF_KW_NAT16_S1_S3 65535 SBW_STANDARD_S1_S3 0 65535 /end CHARACTERISTIC
/begin CHARACTERISTIC D_n_Ab_Min_nTOpt "Minimale noetige Abtriebsdrehzahl fuer die Berechnung n_Tu_VirtOpt" VALUE 0x191B12 ZF_KW_NAT16_S2_S3 16535 SAB_STANDARD_S2_S3 0 16535 /end CHARACTERISTIC
/begin CHARACTERISTIC D_n_Dif_IAEerkannt "Kraftschluss abhaengige Drehzahlschwelle zur Erkennung von Schlupf an der IAE" VAL_BLK 0x192064 ZF_TAB_NAT16_S2_S3 65535 SAB_STANDARD_S2_S3 0 65535 MATRIX_DIM 7 1 1 /end CHARACTERISTIC
/begin CHARACTERISTIC D_n_Dif_IAEerkanntGANG "Ist- und Zielgang- abhaengige Drehzahlschwelle zur Erkennung von Schlupf an der IAE x: iv_ActualGear y: iv_TargetGearInfo 0 ist R-Gang" MAP 0x1920A8 ZF_TAB2D_NAT16_S2_S3 6553.5 SAB_K10_S2_S3 0 6553.5
 /begin AXIS_DESCR FIX_AXIS NO_INPUT_QUANTITY SAB_STANDARD_S2_S3 6 0 5 READ_ONLY FIX_AXIS_PAR_DIST 0 1 6 /end AXIS_DESCR
 /begin AXIS_DESCR FIX_AXIS NO_INPUT_QUANTITY SAB_STANDARD_S2_S3 8 0 7 READ_ONLY FIX_AXIS_PAR_DIST 0 1 8 /end AXIS_DESCR
/end CHARACTERISTIC
/begin CHARACTERISTIC D_n_Dif_IAEerkanntHYS "Hysterese fuer die Schlupferkennung" VALUE 0x191B10 ZF_KW_NAT16_S2_S3 65535 SAB_STANDARD_S2_S3 0 65535 /end CHARACTERISTIC
/begin CHARACTERISTIC D_n_Dif_IAEerkanntKUP "kup_status_iae abhaengige Drehzahlschwelle zur Erkennung von Schlupf an der IAE" VAL_BLK 0x192078 ZF_TAB_NAT16_S2_S3 65535 SAB_STANDARD_S2_S3 0 65535 MATRIX_DIM 10 1 1 /end CHARACTERISTIC
/begin CHARACTERISTIC D_n_EngDiaShiftlock_Lth "engine rev.s threshold for shiftlock activation if request via CAN" VALUE 0x191B7E ZF_KW_NAT16_S1_S3 10000 SBW_STANDARD_S1_S3 0 10000 /end CHARACTERISTIC
/begin CHARACTERISTIC D_n_EngLThJump "If the engine speed is below this threshold the condition for detecting a jumpstart is fulfilled" VALUE 0x191B24 ZF_KW_NAT16_S2_S3 2000 SAB_N_1RPM_S2_S3 0 2000 /end CHARACTERISTIC
/begin CHARACTERISTIC D_n_EngLth_UBATTU_UBATTL_UBATTO "Engine speed threshold for detecting engine start up (used in the diagnosis of KFC_UBATTU and KFC_UBATTL)" VALUE 0x191B18 ZF_KW_NAT16_S2_S3 1920 SAB_N_1RPM_S2_S3 0 1920 /end CHARACTERISTIC
/begin CHARACTERISTIC D_n_EngShiftlockLth "threshold of engine rev.s for activation shiftlock" VALUE 0x191B7C ZF_KW_NAT16_S1_S3 65535 SBW_STANDARD_S1_S3 0 65535 /end CHARACTERISTIC
/begin CHARACTERISTIC D_n_EngUThJump "If the engine speed is higher than this threshold the reset modus will be activated" VALUE 0x191B26 ZF_KW_NAT16_S2_S3 2000 SAB_N_1RPM_S2_S3 0 2000 /end CHARACTERISTIC
/begin CHARACTERISTIC D_n_TuVirt_Direction "Drehzahlschwelle zur Erkennung der Drehrichtung von sv_n_TuVirt" VALUE 0x191B14 ZF_KW_NAT16_S2_S3 65535 SAB_STANDARD_S2_S3 0 65535 /end CHARACTERISTIC
/begin CHARACTERISTIC D_n_TuVirt_DirectionHYS "Hysterese fuer die Drehzahlschwelle zur Erkennung der Drehrichtung von sv_n_TuVirt" VALUE 0x191B16 ZF_KW_NAT16_S2_S3 65535 SAB_STANDARD_S2_S3 0 65535 /end CHARACTERISTIC
/begin CHARACTERISTIC D_n_Uth_MissingRspSwitchCANpath "counter upper threshold for missing responses after tx challenges" VALUE 0x191CAE ZF_KW_NAT8_S1_S3 255 SBW_STANDARD_S1_S3 0 255 /end CHARACTERISTIC
/begin CHARACTERISTIC D_n_Uth_cnt_TASCASReq "counter upper threshold for TAS-CAS-request-attempts" VALUE 0x191CB0 ZF_KW_NAT8_S1_S3 255 SBW_STANDARD_S1_S3 0 255 /end CHARACTERISTIC
/begin CHARACTERISTIC D_st_VehDrvRdy "State from vehicle readiness" VALUE 0x191C89 ZF_KW_NAT8_S1_S3 255 SBW_STANDARD_S1_S3 0 255 /end CHARACTERISTIC
/begin CHARACTERISTIC D_t_Batt_UBATTU "Timer start value for locking time at engine start in position N or P" VALUE 0x191B1C ZF_KW_NAT16_S2_S3 2550 SAB_T_TIMER_10MS_S2_S3 0 2550 /end CHARACTERISTIC
/begin CHARACTERISTIC D_t_CC_CycleTime "Cycle time of Message [s]" CURVE 0x1923D8 ZF_TAB_NAT8_S1_S3 15 SBW_TIMER_1S_S1_S3 0 15
 /begin AXIS_DESCR FIX_AXIS NO_INPUT_QUANTITY SBW_STANDARD_S1_S3 40 0 39 READ_ONLY FIX_AXIS_PAR_DIST 0 1 40 /end AXIS_DESCR
/end CHARACTERISTIC
/begin CHARACTERISTIC D_t_CC_MinTime "Minimum time of Message [s]" CURVE 0x192404 ZF_TAB_NAT8_S1_S3 255 SBW_TIMER_1S_S1_S3 0 255
 /begin AXIS_DESCR FIX_AXIS NO_INPUT_QUANTITY SBW_STANDARD_S1_S3 40 0 39 READ_ONLY FIX_AXIS_PAR_DIST 0 1 40 /end AXIS_DESCR
/end CHARACTERISTIC
/begin CHARACTERISTIC D_t_CC_delay "Delay displaying message" CURVE 0x192330 ZF_TAB_NAT16_S1_S3 655350 SBW_TIMER_10MS_S1_S3 0 655350
 /begin AXIS_DESCR FIX_AXIS NO_INPUT_QUANTITY SBW_STANDARD_S1_S3 40 0 39 READ_ONLY FIX_AXIS_PAR_DIST 0 1 40 /end AXIS_DESCR
/end CHARACTERISTIC
/begin CHARACTERISTIC D_t_DebounceGearboxReady "time-delay for DebounceGearboxReady" VALUE 0x191C8D ZF_KW_NAT8_S1_S3 2550 SBW_TIMER_10MS_S1_S3 0 2550 /end CHARACTERISTIC
/begin CHARACTERISTIC D_t_DebounceGearboxReadySts "time-delay for DebounceGearboxReadySts" VALUE 0x191C8E ZF_KW_NAT8_S1_S3 2550 SBW_TIMER_10MS_S1_S3 0 2550 /end CHARACTERISTIC
/begin CHARACTERISTIC D_t_DebounceGearboxReadySts_L2 "time-delay for DebounceGearboxReadySts_L2" VALUE 0x1D8EB2 ZF_KW_NAT8_S1_S3 2550 SBW_TIMER_10MS_S1_S3 0 2550 /end CHARACTERISTIC
/begin CHARACTERISTIC D_t_DebounceGearboxReady_L2 "time-delay for DebounceGearboxReady_L2" VALUE 0x1D8EB1 ZF_KW_NAT8_S1_S3 2550 SBW_TIMER_10MS_S1_S3 0 2550 /end CHARACTERISTIC
/begin CHARACTERISTIC D_t_DebounceNA2N "Debounce Time for driver request NA2N" VALUE 0x191C8B ZF_KW_NAT8_S1_S3 2550 SBW_TIMER_10MS_S1_S3 0 2550 /end CHARACTERISTIC
/begin CHARACTERISTIC D_t_DebounceNA2N_L2 "L2 Debounce Time for driver request NA2N" VALUE 0x1D8EB5 ZF_KW_NAT8_S1_S3 2550 SBW_TIMER_10MS_S1_S3 0 2550 /end CHARACTERISTIC
/begin CHARACTERISTIC D_t_DebounceOilChipTransErr "Delay value for timer delaying Signal c_oilTransSts when niO" VALUE 0x191B86 ZF_KW_NAT16_S1_S3 65535 SBW_STANDARD_S1_S3 0 65535 /end CHARACTERISTIC
/begin CHARACTERISTIC D_t_DebounceRD2N "Debounce Time for driver request RD2N" VALUE 0x191C8A ZF_KW_NAT8_S1_S3 2550 SBW_TIMER_10MS_S1_S3 0 2550 /end CHARACTERISTIC
/begin CHARACTERISTIC D_t_DebounceRD2N_L2 "L2 Debounce Time for driver request RD2N" VALUE 0x1D8EB6 ZF_KW_NAT8_S1_S3 2550 SBW_TIMER_10MS_S1_S3 0 2550 /end CHARACTERISTIC
/begin CHARACTERISTIC D_t_DelayAdaptiveToManual "Time for hold Adaptiv after MGate active - 0 deactivate function" VALUE 0x191B42 ZF_KW_NAT16_S1_S3 655350 SBW_TIMER_10MS_S1_S3 0 655350 /end CHARACTERISTIC
/begin CHARACTERISTIC D_t_DelayGbxTempReqP_Lth "Minimum delay time for Diag-P due to GB temperature" VALUE 0x1925F8 ZF_KW_NAT32_S1_S3 42949700000 SBW_TIMER_10MS_S1_S3 0 42949672950 /end CHARACTERISTIC
/begin CHARACTERISTIC D_t_DelayGbxTempReqP_Uth "Minimum delay time for Diag-P due to GB temperature" VALUE 0x1925FC ZF_KW_NAT32_S1_S3 42949700000 SBW_TIMER_10MS_S1_S3 0 42949672950 /end CHARACTERISTIC
/begin CHARACTERISTIC D_t_DelayManualToAdaptive "Time for hold Manual after MGate inactive - 0 deactivate function" VALUE 0x191B44 ZF_KW_NAT16_S1_S3 655350 SBW_TIMER_10MS_S1_S3 0 655350 /end CHARACTERISTIC
/begin CHARACTERISTIC D_t_DelayVIstMaxCalc "Delay time when GET_VIST_MAX uses maximum choice after nAb to nWheel gets unplausible" VALUE 0x191C7D ZF_KW_NAT8_S2_S3 2550 SAB_T_TIMER_10MS_S2_S3 0 2550 /end CHARACTERISTIC
/begin CHARACTERISTIC D_t_Delay_AfterSleepInd_BeforeLockEGS "time-delay in ews4 after sleep-/powerdown readiness [before EGS may be locked]" VALUE 0x191B62 ZF_KW_NAT16_S1_S3 655320 SBW_TIMER_10MS_S1_S3 30 655350 /end CHARACTERISTIC
/begin CHARACTERISTIC D_t_Delay_KeyAuthWhileFACanFailure "time-delay in ews4 after 1st cyclic-call before redundancy-authentication is supposed while damaged FA-CAN" VALUE 0x191CAC ZF_KW_NAT8_S1_S3 2520 SBW_TIMER_10MS_S1_S3 30 2550 /end CHARACTERISTIC
/begin CHARACTERISTIC D_t_Delay_WaitTasCasRequest "time-delay in ews4 after tx TAS-CAS-request" VALUE 0x191CAD ZF_KW_NAT8_S1_S3 2520 SBW_TIMER_10MS_S1_S3 30 2550 /end CHARACTERISTIC
/begin CHARACTERISTIC D_t_DiagActive_UBATTL "Delay time for suppressing the diagnosis of KFC-UBATTL after engine start up" VALUE 0x191C7F ZF_KW_NAT8_S2_S3 2550 SAB_T_TIMER_10MS_S2_S3 0 2550 /end CHARACTERISTIC
/begin CHARACTERISTIC D_t_DiagActive_UBATTU "Delay time for suppressing the diagnosis of KFC-UBATTU after engine start up" VALUE 0x191C7E ZF_KW_NAT8_S2_S3 2550 SAB_T_TIMER_10MS_S2_S3 0 2550 /end CHARACTERISTIC
/begin CHARACTERISTIC D_t_DiagDelPOSSBW "diagnosis delay of position lever communication" VALUE 0x191B48 ZF_KW_NAT16_S1_S3 655350 SBW_TIMER_10MS_S1_S3 0 655350 /end CHARACTERISTIC
/begin CHARACTERISTIC D_t_DrvLeavesCarInN "start value for debounce timer for nr. of events driver leaves car in pos.N" VALUE 0x191B3A ZF_KW_NAT16_S1_S3 655350 SBW_TIMER_10MS_S1_S3 0 655350 /end CHARACTERISTIC
/begin CHARACTERISTIC D_t_FlashDiagPosInWrongDrvDir "Flash duration for pos N if diagnosis position N due to wrong driving direction" VALUE 0x191B54 ZF_KW_NAT16_S1_S3 655350 SBW_TIMER_10MS_S1_S3 0 655350 /end CHARACTERISTIC
/begin CHARACTERISTIC D_t_FlashN "Timer reload value for flash pos N if park lock not inserted in P" VALUE 0x191C90 ZF_KW_NAT8_S1_S3 2550 SBW_TIMER_10MS_S1_S3 0 2550 /end CHARACTERISTIC
/begin CHARACTERISTIC D_t_FlashN_L2 "L2 Timer reload value for flash pos N if park lock not inserted in P" VALUE 0x1D8EBA ZF_KW_NAT8_S1_S3 2550 SBW_TIMER_10MS_S1_S3 0 2550 /end CHARACTERISTIC
/begin CHARACTERISTIC D_t_IgnOnNeverDetected "filter-time to distinguish wake-up impulse - ignition on" VALUE 0x191CB2 ZF_KW_NAT8_S1_S3 2550 SBW_TIMER_10MS_S1_S3 0 2550 /end CHARACTERISTIC
/begin CHARACTERISTIC D_t_JumpstartTh "max time for an active jumpstart" VALUE 0x191B2A ZF_KW_NAT16_S2_S3 655350 SAB_T_TIMER_10MS_S2_S3 0 655350 /end CHARACTERISTIC
/begin CHARACTERISTIC D_t_Lev2DispError "L2 filter time to suspend KFC3_LEV2" VALUE 0x191C94 ZF_KW_NAT8_S1_S3 100 SBW_TIMER_10MS_S1_S3 0 100 /end CHARACTERISTIC
/begin CHARACTERISTIC D_t_Lev2DispError_L2 "L2 filter time to suspend KFC3_LEV2" VALUE 0x1D8EB9 ZF_KW_NAT8_S1_S3 100 SBW_TIMER_10MS_S1_S3 0 100 /end CHARACTERISTIC
/begin CHARACTERISTIC D_t_Min_RxRspUntilTxChal "minimal time in ews4 between receiving DME-response and tx new TCU-challenge" VALUE 0x191B5E ZF_KW_NAT16_S1_S3 655320 SBW_TIMER_10MS_S1_S3 30 655350 /end CHARACTERISTIC
/begin CHARACTERISTIC D_t_Min_TASCASReq "minimal time in ews4 between init-fctn. and triggering TAS-CAS-request transmission" VALUE 0x191CAF ZF_KW_NAT8_S1_S3 2520 SBW_TIMER_10MS_S1_S3 30 2550 /end CHARACTERISTIC
/begin CHARACTERISTIC D_t_Min_TxChalUntilTxChal_NoRsp "minimal time in ews4 between tx new TCU-challenge after tx TCU-Chal. with missing DME-response" VALUE 0x191B60 ZF_KW_NAT16_S1_S3 655320 SBW_TIMER_10MS_S1_S3 30 655350 /end CHARACTERISTIC
/begin CHARACTERISTIC D_t_ModeReturnTip1 "Reload Time for ModeReturnTimer via Tip 1" VALUE 0x191B6E ZF_KW_NAT16_S1_S3 655350 SBW_TIMER_10MS_S1_S3 0 655350 /end CHARACTERISTIC
/begin CHARACTERISTIC D_t_ModeReturnTip2 "Reload Time for ModeReturnTimer via Tip 2" VALUE 0x191B70 ZF_KW_NAT16_S1_S3 655350 SBW_TIMER_10MS_S1_S3 0 655350 /end CHARACTERISTIC
/begin CHARACTERISTIC D_t_P12BadOp "debounce time of park button bad operation" VALUE 0x191CB5 ZF_KW_NAT8_S1_S3 2550 SBW_TIMER_10MS_S1_S3 0 2550 /end CHARACTERISTIC
/begin CHARACTERISTIC D_t_P12BadOpDisp "flash time of park button bad operation" VALUE 0x191B6C ZF_KW_NAT16_S1_S3 655350 SBW_TIMER_10MS_S1_S3 0 655350 /end CHARACTERISTIC
/begin CHARACTERISTIC D_t_PowDownDefault "time to power down in err.case when no valid display pos is displayed - EGS overshoot state 'Nachlauf'" VALUE 0x191B78 ZF_KW_NAT16_S1_S3 600000 SBW_TIMER_10MS_S1_S3 0 600000 /end CHARACTERISTIC
/begin CHARACTERISTIC D_t_PowDownDispN "time to display pos N for 1min in EGS overshoot state 'Nachlauf' if pos P not confirmed" VALUE 0x191B74 ZF_KW_NAT16_S1_S3 600000 SBW_TIMER_10MS_S1_S3 0 600000 /end CHARACTERISTIC
/begin CHARACTERISTIC D_t_PowDownDispP "time to display pos P for 30secs in EGS overshoot state 'Nachlauf'" VALUE 0x191B72 ZF_KW_NAT16_S1_S3 600000 SBW_TIMER_10MS_S1_S3 0 600000 /end CHARACTERISTIC
/begin CHARACTERISTIC D_t_PowDownDispRD "time to display pos RD in EGS overshoot state 'Nachlauf'" VALUE 0x191B76 ZF_KW_NAT16_S1_S3 600000 SBW_TIMER_10MS_S1_S3 0 600000 /end CHARACTERISTIC
/begin CHARACTERISTIC D_t_Prevent_KFC_EWSDRVRQ "timer start-value to prevent err.entry KFC_EWSDRVRQ while timer active" VALUE 0x191B66 ZF_KW_NAT16_S1_S3 10000 SBW_TIMER_10MS_S1_S3 0 10000 /end CHARACTERISTIC
/begin CHARACTERISTIC D_t_StarterInhibitor_Default "Timer reload value for Starter Release" CURVE 0x192290 ZF_KL_NAT16_S1_S3 655350 SBW_TIMER_10MS_S1_S3 0 655350
 /begin AXIS_DESCR STD_AXIS NO_INPUT_QUANTITY SBW_CGT40_M_S1_S3 8 -40 215 DEPOSIT ABSOLUTE /end AXIS_DESCR
/end CHARACTERISTIC
/begin CHARACTERISTIC D_t_StarterInhibitor_Limphome "Timer reload value for Starter Release" CURVE 0x1922B4 ZF_KL_NAT16_S1_S3 655350 SBW_TIMER_10MS_S1_S3 0 655350
 /begin AXIS_DESCR STD_AXIS NO_INPUT_QUANTITY SBW_CGT40_M_S1_S3 8 -40 215 DEPOSIT ABSOLUTE /end AXIS_DESCR
/end CHARACTERISTIC
/begin CHARACTERISTIC D_t_StoreN "Storage Time for driver request N" VALUE 0x191C9D ZF_KW_NAT8_S1_S3 2550 SBW_TIMER_10MS_S1_S3 0 2550 /end CHARACTERISTIC
/begin CHARACTERISTIC D_t_StoreN_L2 "L2 Storage Time for driver request N" VALUE 0x1D8EB3 ZF_KW_NAT8_S1_S3 2550 SBW_TIMER_10MS_S1_S3 0 2550 /end CHARACTERISTIC
/begin CHARACTERISTIC D_t_StoreP "Storage Time for driver request P" VALUE 0x191C9B ZF_KW_NAT8_S1_S3 2550 SBW_TIMER_10MS_S1_S3 0 2550 /end CHARACTERISTIC
/begin CHARACTERISTIC D_t_StoreRD "Storage Time for driver request RD" VALUE 0x191B4C ZF_KW_NAT16_S1_S3 30000 SBW_TIMER_10MS_S1_S3 0 30000 /end CHARACTERISTIC
/begin CHARACTERISTIC D_t_StoreRD_L2 "Attention: Same value as D_t_StoreRD otherwise KFC3_LEV2" VALUE 0x1D8E9E ZF_KW_NAT16_S1_S3 30000 SBW_TIMER_10MS_S1_S3 0 30000 /end CHARACTERISTIC
/begin CHARACTERISTIC D_t_TO_EEprom_StoreImmediate "timeout in ews4 EEprom storage-process: check timeout from store-immediate-cmd and not getting store-in-progress-ready" VALUE 0x191B64 ZF_KW_NAT16_S1_S3 655320 SBW_TIMER_10MS_S1_S3 30 655350 /end CHARACTERISTIC
/begin CHARACTERISTIC D_t_TO_RxKFAfterTxKF_Id_2 "timeout ews4 for receiving DME-KF after tx TCU-KF" VALUE 0x191B5C ZF_KW_NAT16_S1_S3 655320 SBW_TIMER_10MS_S1_S3 30 655350 /end CHARACTERISTIC
/begin CHARACTERISTIC D_t_TO_RxRspAfterTxChal_Id_1 "timeout ews4 for receiving DME-response after tx TCU-challenge" VALUE 0x191B5A ZF_KW_NAT16_S1_S3 655320 SBW_TIMER_10MS_S1_S3 30 655350 /end CHARACTERISTIC
/begin CHARACTERISTIC D_t_TO_StoreCheckFSC "timer to check timeout from storing FSC to checkFSC-cmd" VALUE 0x191B68 ZF_KW_NAT16_S1_S3 655320 SBW_TIMER_10MS_S1_S3 30 655350 /end CHARACTERISTIC
/begin CHARACTERISTIC D_t_n6TuVirtSync "Verzoegerungszeit zur Synchronisierung der sv_n6-Drehzahl" VALUE 0x191C76 ZF_KW_NAT8_S2_S3 50 SAB_T_TIMER_10MS_S2_S3 0 50 /end CHARACTERISTIC
/begin CHARACTERISTIC D_t_nAbTuVirtSync "Verzoegerungszeit zur Synchronisierung der Abtriebsdrehzahl" VALUE 0x191C75 ZF_KW_NAT8_S2_S3 50 SAB_T_TIMER_10MS_S2_S3 0 50 /end CHARACTERISTIC
/begin CHARACTERISTIC D_t_nEngTuVirtSync "Verzoegerungszeit zur Synchronisierung der Getriebeeingangsdrehzahl" VALUE 0x191C74 ZF_KW_NAT8_S2_S3 50 SAB_T_TIMER_10MS_S2_S3 0 50 /end CHARACTERISTIC
/begin CHARACTERISTIC D_t_n_Dif_IAEerkannt "Zeitdauer fuer die die Drehzahlschwellen ueber- bzw unterschritten werden muessen" VALUE 0x191C77 ZF_KW_NAT8_S2_S3 2550 SAB_T_TIMER_10MS_S2_S3 0 2550 /end CHARACTERISTIC
/begin CHARACTERISTIC D_tmr_GearSubstLSSOFF "as long as this timer runs the Notganginfo stays valid" VALUE 0x191B28 ZF_KW_NAT16_S2_S3 655350 SAB_T_TIMER_10MS_S2_S3 0 655350 /end CHARACTERISTIC
/begin CHARACTERISTIC D_type_CC "Type of CC-Msg (event triggerd = 0 / cyclic = 1)" CURVE 0x192304 ZF_TAB_NAT8_S1_S3 1 SBW_STANDARD_S1_S3 0 1
 /begin AXIS_DESCR FIX_AXIS NO_INPUT_QUANTITY SBW_STANDARD_S1_S3 40 0 39 READ_ONLY FIX_AXIS_PAR_DIST 0 1 40 /end AXIS_DESCR
/end CHARACTERISTIC
/begin CHARACTERISTIC D_uBattFiltLTh1ForCalTC "filtered battery voltage lower threshold 1 for calibrateable test conditions" VALUE 0x191BC8 ZF_KW_NAT16_S4_S3 25 EH_U_1VOLT1000_S4_S3 0 25 /end CHARACTERISTIC
/begin CHARACTERISTIC D_uBattFiltLTh2ForCalTC "filtered battery voltage lower threshold 2 for calibrateable test conditions" VALUE 0x191BCA ZF_KW_NAT16_S4_S3 25 EH_U_1VOLT1000_S4_S3 0 25 /end CHARACTERISTIC
/begin CHARACTERISTIC D_uBattFiltUThForCalTC "filtered battery voltage upper threshold for calibrateable test conditions" VALUE 0x191BC6 ZF_KW_NAT16_S4_S3 25 EH_U_1VOLT1000_S4_S3 0 25 /end CHARACTERISTIC
/begin CHARACTERISTIC D_u_BattDiagPos "Threshold for voltage u_BattDiag for KFC_POSSBW" VALUE 0x191B4A ZF_KW_NAT16_S1_S3 20 SBW_TAUSENDSTEL_U_S1_S3 0 20 /end CHARACTERISTIC
/begin CHARACTERISTIC D_u_BattLthFix_UBATTU "If the battery voltage is lower than this threshold (not depends on CGT) an error code (KFC_UBATTU) is forward filtering" VALUE 0x191B1A ZF_KW_NAT16_S2_S3 14 SAB_U_1VOLT1000_S2_S3 6 20 /end CHARACTERISTIC
/begin CHARACTERISTIC D_u_BattLth_UBATTL "If battery voltage is lower than this threshold an error code (KFC_UBATTL) is forward filtered" VALUE 0x191B20 ZF_KW_NAT16_S2_S3 20 SAB_U_1VOLT1000_S2_S3 0 20 /end CHARACTERISTIC
/begin CHARACTERISTIC D_u_BattLth_UBATTU "If the battery voltage is lower than this threshold (depends on CGT) an error code (KFC_UBATTU) is forward filtering" CURVE 0x19220C ZF_KL_NAT16_S2_S3 14 SAB_U_1VOLT1000_S2_S3 6 20
 /begin AXIS_DESCR STD_AXIS NO_INPUT_QUANTITY SAB_C_CGT_1CEL_M40_S2_S3 2 -40 215 DEPOSIT ABSOLUTE /end AXIS_DESCR
/end CHARACTERISTIC
/begin CHARACTERISTIC D_u_BattThHys_UBATTL "Hysteresis of Battery voltage for backward filtering of KFC_UBATTL" VALUE 0x191B1E ZF_KW_NAT16_S2_S3 10 SAB_U_1VOLT1000_S2_S3 0 10 /end CHARACTERISTIC
/begin CHARACTERISTIC D_u_BattUth_UBATTO "If the battery voltage is higher than this threshold an error code (KFC_UBATTO) is forward filtering and an jumpstart modus will be activated" VALUE 0x191B22 ZF_KW_NAT16_S2_S3 14 SAB_U_1VOLT1000_S2_S3 6 20 /end CHARACTERISTIC
/begin CHARACTERISTIC D_v_AutoN_Uth "speed threshold of autom. engagement of N in case of error n_Eng" VALUE 0x191B82 ZF_KW_NAT16_S1_S3 4095.94 SBW_VKMH_16_S1_S3 0 4095.9375 /end CHARACTERISTIC
/begin CHARACTERISTIC D_v_AutoN_Uth_L2 "level 2 speed threshold of autom. engagement of N in case of error n_Eng" VALUE 0x1D8EA2 ZF_KW_NAT16_S1_S3 4095.94 SBW_VKMH_16_S1_S3 0 4095.9375 /end CHARACTERISTIC
/begin CHARACTERISTIC D_v_AutoP_DrvLeavesCar "Auto P Upper Speed Threshold to enable P when driver leaves car" VALUE 0x191B30 ZF_KW_NAT16_S1_S3 4095.94 SBW_VKMH_16_S1_S3 0 4095.9375 /end CHARACTERISTIC
/begin CHARACTERISTIC D_v_AutoP_DrvLeavesCar_L2 "Auto P Upper Speed Threshold to enable P when driver leaves car" VALUE 0x1D8EAA ZF_KW_NAT16_S1_S3 4095.94 SBW_VKMH_16_S1_S3 0 4095.9375 /end CHARACTERISTIC
/begin CHARACTERISTIC D_v_AutoP_DrvPresenceUnknown_Uth "Speed threshold to engage Auto-P due to unknown driver presence" VALUE 0x191B34 ZF_KW_NAT16_S1_S3 4095.94 SBW_VKMH_16_S1_S3 0 4095.9375 /end CHARACTERISTIC
/begin CHARACTERISTIC D_v_AutoP_Uth "Auto P Upper Speed Threshold for xxx" VALUE 0x191B32 ZF_KW_NAT16_S1_S3 4095.94 SBW_VKMH_16_S1_S3 0 4095.9375 /end CHARACTERISTIC
/begin CHARACTERISTIC D_v_AutoP_Uth_L2 "Attention: Same value as D_v_AutoP_Uth otherwise KFC3_LEV2" VALUE 0x1D8EA0 ZF_KW_NAT16_S1_S3 4095.94 SBW_VKMH_16_S1_S3 0 4095.9375 /end CHARACTERISTIC
/begin CHARACTERISTIC D_v_CC "Threshold to v_VehSpdMin" CURVE 0x192384 ZF_TAB_NAT16_S1_S3 4095.94 SBW_VKMH_16_S1_S3 0 4095.9375
 /begin AXIS_DESCR FIX_AXIS NO_INPUT_QUANTITY SBW_STANDARD_S1_S3 40 0 39 READ_ONLY FIX_AXIS_PAR_DIST 0 1 40 /end AXIS_DESCR
/end CHARACTERISTIC
/begin CHARACTERISTIC D_v_CC_Parklock_Lth "lower spd threshold for ID565" VALUE 0x191B50 ZF_KW_NAT16_S1_S3 4095.94 SBW_VKMH_16_S1_S3 0 4095.9375 /end CHARACTERISTIC
/begin CHARACTERISTIC D_v_D_Lth "Lower speed threshold for driver request D" VALUE 0x191B8E ZF_KW_NAT16_S1_S3 4095.94 SBW_VKMH_16_S1_S3 0 4095.9375 /end CHARACTERISTIC
/begin CHARACTERISTIC D_v_D_Uth "Position D upper speed threshold" VALUE 0x191B92 ZF_KW_NAT16_S1_S3 4095.94 SBW_VKMH_16_S1_S3 0 4095.9375 /end CHARACTERISTIC
/begin CHARACTERISTIC D_v_DebounceNA2NUth "Upper Speed Threshold for Debounce of NA to N" VALUE 0x191B38 ZF_KW_NAT16_S1_S3 4095.94 SBW_VKMH_16_S1_S3 0 4095.9375 /end CHARACTERISTIC
/begin CHARACTERISTIC D_v_DrvDir_Lth "speed threshold for releasing driving direction" VALUE 0x191B40 ZF_KW_NAT16_S1_S3 4095.94 SBW_VKMH_16_S1_S3 0 4095.9375 /end CHARACTERISTIC
/begin CHARACTERISTIC D_v_EnableAutoPHelp "Upper Speed Threshold for Enable Auto P by EMF Help Message" VALUE 0x191B2E ZF_KW_NAT16_S1_S3 4095.94 SBW_VKMH_16_S1_S3 0 4095.9375 /end CHARACTERISTIC
/begin CHARACTERISTIC D_v_GbxTempReqP_Lth "Threshold for vehicle spd to allow Diag-P due to GB temperature" VALUE 0x191B56 ZF_KW_NAT16_S1_S3 4095.94 SBW_VKMH_16_S1_S3 0 4095.9375 /end CHARACTERISTIC
/begin CHARACTERISTIC D_v_GbxTempReqP_Uth "Threshold for vehicle spd to prevent Diag-P due to GB temperature" VALUE 0x191B58 ZF_KW_NAT16_S1_S3 4095.94 SBW_VKMH_16_S1_S3 0 4095.9375 /end CHARACTERISTIC
/begin CHARACTERISTIC D_v_HoldN "speed threshold for detection of N-Hold period" VALUE 0x191B36 ZF_KW_NAT16_S1_S3 4095.94 SBW_VKMH_16_S1_S3 0 4095.9375 /end CHARACTERISTIC
/begin CHARACTERISTIC D_v_N_Uth "POS N upper speed threshold" VALUE 0x191B4E ZF_KW_NAT16_S1_S3 4095.94 SBW_VKMH_16_S1_S3 0 4095.9375 /end CHARACTERISTIC
/begin CHARACTERISTIC D_v_N_Uth_L2 "L2 POS N upper speed threshold" VALUE 0x1D8EA8 ZF_KW_NAT16_S1_S3 4095.94 SBW_VKMH_16_S1_S3 0 4095.9375 /end CHARACTERISTIC
/begin CHARACTERISTIC D_v_P12BadOpDisp "speed threshold of bad operation flashing" VALUE 0x191B84 ZF_KW_NAT16_S1_S3 4095.94 SBW_VKMH_16_S1_S3 0 4095.9375 /end CHARACTERISTIC
/begin CHARACTERISTIC D_v_PSAbuse "speed threshold for detecting parklock-abuse" VALUE 0x191B46 ZF_KW_NAT16_S1_S3 15.9375 SBW_VKMH_16_S1_S3 0 15.9375 /end CHARACTERISTIC
/begin CHARACTERISTIC D_v_P_Lth "Position P speed threshold" VALUE 0x191B88 ZF_KW_NAT16_S1_S3 4095.94 SBW_VKMH_16_S1_S3 0 4095.9375 /end CHARACTERISTIC
/begin CHARACTERISTIC D_v_P_Lth_L2 "Attention: Same value as D_v_P_Lth otherwise KFC3_LEV2" VALUE 0x1D8E9C ZF_KW_NAT16_S1_S3 4095.94 SBW_VKMH_16_S1_S3 0 4095.9375 /end CHARACTERISTIC
/begin CHARACTERISTIC D_v_P_Uth "Upper speed threshold for driver request P" VALUE 0x191B8A ZF_KW_NAT16_S1_S3 4095.94 SBW_VKMH_16_S1_S3 0 4095.9375 /end CHARACTERISTIC
/begin CHARACTERISTIC D_v_R_Lth "Lower speed threshold for driver request R" VALUE 0x191B8C ZF_KW_NAT16_S1_S3 4095.94 SBW_VKMH_16_S1_S3 0 4095.9375 /end CHARACTERISTIC
/begin CHARACTERISTIC D_v_R_Uth "Position R upper speed threshold" VALUE 0x191B90 ZF_KW_NAT16_S1_S3 4095.94 SBW_VKMH_16_S1_S3 0 4095.9375 /end CHARACTERISTIC
/begin CHARACTERISTIC D_v_R_Uth_L2 "L2 Upper speed threshold for driver request R" VALUE 0x1D8EAE ZF_KW_NAT16_S1_S3 4095.94 SBW_VKMH_16_S1_S3 0 4095.9375 /end CHARACTERISTIC
/begin CHARACTERISTIC D_v_Shiftlock_Uth "speed threshold for deactivation shiftlock [PN-lock]" VALUE 0x191B7A ZF_KW_NAT16_S1_S3 4095.94 SBW_VKMH_16_S1_S3 0 4095.9375 /end CHARACTERISTIC
/begin CHARACTERISTIC D_v_Shiftlock_Uth_L2 "speed threshold for deactivation shiftlock [PN-lock]" VALUE 0x1D8EAC ZF_KW_NAT16_S1_S3 4095.94 SBW_VKMH_16_S1_S3 0 4095.9375 /end CHARACTERISTIC
/begin CHARACTERISTIC D_v_WrongDrvDir "Speed threshold for diagnosis position N due to position D and driving direction bw and vice vesra" VALUE 0x191B52 ZF_KW_NAT16_S1_S3 4095.94 SBW_VKMH_16_S1_S3 0 4095.9375 /end CHARACTERISTIC
/begin CHARACTERISTIC F_KUEHLOELV_IAE "Faktor für die Verteilung der Ölmenge von IAE-Kühlung & K0-Getriebekühlung, Getriebeschmierung" VALUE 0x1D8362 ZF_kw_si16_S5_S3 1 UMR___1_100_0_S5_S3 0 1 /end CHARACTERISTIC
/begin CHARACTERISTIC F_MMOT_NOCLOSE_DIAGIAE "Schwellenfaktor Momentenkriterium Erkennung IAE_NOCLOSE" VALUE 0x1D831E ZF_kw_si16_S5_S3 10 UMR___1_100_0_S5_S3 0 10 /end CHARACTERISTIC
/begin CHARACTERISTIC F_NSOLL_NOCLOSE_DIAGIAE "Faktor auf Anfahrdrehzahl zur Erkennung übermäßig Schlupf" VALUE 0x1D831C ZF_kw_si16_S5_S3 10 UMR___1_100_0_S5_S3 0 10 /end CHARACTERISTIC
/begin CHARACTERISTIC GS_ANFAHRT_IAE "max. Gang, bei dem von ZU nach Schließen/Kriechen gewechselt werden kann" VALUE 0x1D779B ZF_kw_ui8_S5_S3 8 UMR___1_1_0_S5_S3 0 8 /end CHARACTERISTIC
/begin CHARACTERISTIC GS_ANGELEGT_SCHALT_IAE "max. Gang, bei dem bei ARS ins ANGELEGT gewechselt wird" VALUE 0x1D7799 ZF_kw_ui8_S5_S3 8 UMR___1_1_0_S5_S3 0 8 /end CHARACTERISTIC
/begin CHARACTERISTIC KF_F_KD_ANFAHRT_E_IAE "Faktor für D-Anteil für PID-Regler im E- oder H-Anfahren" MAP 0x19BB9C ZF_kf_fl32_S5_S3 1.999 UMR___1_1_0_3_S5_S3 0.001 2
 /begin AXIS_DESCR STD_AXIS NO_INPUT_QUANTITY UMR___1_1_0_S5_S3 6 -1 8 DEPOSIT ABSOLUTE FORMAT "%3.2" /end AXIS_DESCR
 /begin AXIS_DESCR STD_AXIS NO_INPUT_QUANTITY UMR_GRADC__1_1_0_S5_S3 6 -40 215 DEPOSIT ABSOLUTE /end AXIS_DESCR
 FORMAT "%4.3" /end CHARACTERISTIC
/begin CHARACTERISTIC KF_F_KD_ANFAHRT_H_IAE "Faktor für D-Anteil für PID-Regler im E- oder H-Anfahren" MAP 0x19C100 ZF_kf_fl32_S5_S3 1.999 UMR___1_1_0_3_S5_S3 0.001 2
 /begin AXIS_DESCR STD_AXIS NO_INPUT_QUANTITY UMR___1_1_0_S5_S3 6 -1 8 DEPOSIT ABSOLUTE FORMAT "%3.2" /end AXIS_DESCR
 /begin AXIS_DESCR STD_AXIS NO_INPUT_QUANTITY UMR_GRADC__1_1_0_S5_S3 6 -40 215 DEPOSIT ABSOLUTE /end AXIS_DESCR
 FORMAT "%4.3" /end CHARACTERISTIC
/begin CHARACTERISTIC KF_F_KI_ANFAHRT_E_IAE "Faktor für I-Anteil für PID-Regler im E- oder H-Anfahren" MAP 0x19BC64 ZF_kf_fl32_S5_S3 1.999 UMR___1_1_0_3_S5_S3 0.001 2
 /begin AXIS_DESCR STD_AXIS NO_INPUT_QUANTITY UMR___1_1_0_S5_S3 6 -1 8 DEPOSIT ABSOLUTE FORMAT "%3.2" /end AXIS_DESCR
 /begin AXIS_DESCR STD_AXIS NO_INPUT_QUANTITY UMR_GRADC__1_1_0_S5_S3 6 -40 215 DEPOSIT ABSOLUTE /end AXIS_DESCR
 FORMAT "%4.3" /end CHARACTERISTIC
/begin CHARACTERISTIC KF_F_KI_ANFAHRT_H_IAE "Faktor für I-Anteil für PID-Regler im E- oder H-Anfahren" MAP 0x19C1C8 ZF_kf_fl32_S5_S3 1.999 UMR___1_1_0_3_S5_S3 0.001 2
 /begin AXIS_DESCR STD_AXIS NO_INPUT_QUANTITY UMR___1_1_0_S5_S3 6 -1 8 DEPOSIT ABSOLUTE FORMAT "%3.2" /end AXIS_DESCR
 /begin AXIS_DESCR STD_AXIS NO_INPUT_QUANTITY UMR_GRADC__1_1_0_S5_S3 6 -40 215 DEPOSIT ABSOLUTE /end AXIS_DESCR
 FORMAT "%4.3" /end CHARACTERISTIC
/begin CHARACTERISTIC KF_F_KP_ANFAHRT_E_IAE "Faktor für P-Anteil für PID-Regler im E- oder H-Anfahren" MAP 0x19BD2C ZF_kf_fl32_S5_S3 1.999 UMR___1_1_0_3_S5_S3 0.001 2
 /begin AXIS_DESCR STD_AXIS NO_INPUT_QUANTITY UMR___1_1_0_S5_S3 6 -1 8 DEPOSIT ABSOLUTE FORMAT "%3.2" /end AXIS_DESCR
 /begin AXIS_DESCR STD_AXIS NO_INPUT_QUANTITY UMR_GRADC__1_1_0_S5_S3 6 -40 215 DEPOSIT ABSOLUTE /end AXIS_DESCR
 FORMAT "%4.3" /end CHARACTERISTIC
/begin CHARACTERISTIC KF_F_KP_ANFAHRT_H_IAE "Faktor für P-Anteil für PID-Regler im E- oder H-Anfahren" MAP 0x19C290 ZF_kf_fl32_S5_S3 1.999 UMR___1_1_0_3_S5_S3 0.001 2
 /begin AXIS_DESCR STD_AXIS NO_INPUT_QUANTITY UMR___1_1_0_S5_S3 6 -1 8 DEPOSIT ABSOLUTE FORMAT "%3.2" /end AXIS_DESCR
 /begin AXIS_DESCR STD_AXIS NO_INPUT_QUANTITY UMR_GRADC__1_1_0_S5_S3 6 -40 215 DEPOSIT ABSOLUTE /end AXIS_DESCR
 FORMAT "%4.3" /end CHARACTERISTIC
/begin CHARACTERISTIC KF_F_M_ANFAHRT_E_ECO_IAE "Faktor auf Vorsteueranteil im Zustand H- oder E-Anfahren" MAP 0x19B76C ZF_kf_si16_S5_S3 2 UMR___1_100_0_S5_S3 0 2
 /begin AXIS_DESCR STD_AXIS iIaeMomen.ng_motanfahr_gef_iae UMR_U_MINSEC_1_1_0_S5_S3 6 -8160 8160 DEPOSIT ABSOLUTE /end AXIS_DESCR
 /begin AXIS_DESCR STD_AXIS NO_INPUT_QUANTITY UMR_PROZENT__20_51_0_S5_S3 6 0 100 DEPOSIT ABSOLUTE /end AXIS_DESCR
/end CHARACTERISTIC
/begin CHARACTERISTIC KF_F_M_ANFAHRT_E_IAE "Faktor auf Vorsteueranteil im Zustand H- oder E-Anfahren" MAP 0x19B594 ZF_kf_si16_S5_S3 2 UMR___1_100_0_S5_S3 0 2
 /begin AXIS_DESCR STD_AXIS iIaeMomen.ng_motanfahr_gef_iae UMR_U_MINSEC_1_1_0_S5_S3 6 -8160 8160 DEPOSIT ABSOLUTE /end AXIS_DESCR
 /begin AXIS_DESCR STD_AXIS NO_INPUT_QUANTITY UMR_PROZENT__20_51_0_S5_S3 6 0 100 DEPOSIT ABSOLUTE /end AXIS_DESCR
/end CHARACTERISTIC
/begin CHARACTERISTIC KF_F_M_ANFAHRT_H_ECO_IAE "Faktor auf Vorsteueranteil im Zustand H- oder E-Anfahren" MAP 0x19B858 ZF_kf_si16_S5_S3 2 UMR___1_100_0_S5_S3 0 2
 /begin AXIS_DESCR STD_AXIS iIaeMomen.ng_motanfahr_gef_iae UMR_U_MINSEC_1_1_0_S5_S3 6 -8160 8160 DEPOSIT ABSOLUTE /end AXIS_DESCR
 /begin AXIS_DESCR STD_AXIS NO_INPUT_QUANTITY UMR_PROZENT__20_51_0_S5_S3 6 0 100 DEPOSIT ABSOLUTE /end AXIS_DESCR
/end CHARACTERISTIC
/begin CHARACTERISTIC KF_F_M_ANFAHRT_H_IAE "Faktor auf Vorsteueranteil im Zustand H- oder E-Anfahren" MAP 0x19B680 ZF_kf_si16_S5_S3 2 UMR___1_100_0_S5_S3 0 2
 /begin AXIS_DESCR STD_AXIS iIaeMomen.ng_motanfahr_gef_iae UMR_U_MINSEC_1_1_0_S5_S3 6 -8160 8160 DEPOSIT ABSOLUTE /end AXIS_DESCR
 /begin AXIS_DESCR STD_AXIS NO_INPUT_QUANTITY UMR_PROZENT__20_51_0_S5_S3 6 0 100 DEPOSIT ABSOLUTE /end AXIS_DESCR
/end CHARACTERISTIC
/begin CHARACTERISTIC KF_KD_ANFAHRT_E_IAE "D-Anteil für PID-Regler im E- oder H-Anfahren" MAP 0x19B944 ZF_kf_fl32_S5_S3 9.999 UMR___1_1_0_3_S5_S3 0.001 10
 /begin AXIS_DESCR STD_AXIS NO_INPUT_QUANTITY UMR_U_MINSEC_1_1_0_S5_S3 6 -10000 10000 DEPOSIT ABSOLUTE /end AXIS_DESCR
 /begin AXIS_DESCR STD_AXIS iIaeMomen.xd_iae UMR___1_1_0_S5_S3 6 -10000 10000 DEPOSIT ABSOLUTE FORMAT "%3.2" /end AXIS_DESCR
 FORMAT "%4.3" /end CHARACTERISTIC
/begin CHARACTERISTIC KF_KD_ANFAHRT_H_IAE "D-Anteil für PID-Regler im E- oder H-Anfahren" MAP 0x19BEA8 ZF_kf_fl32_S5_S3 9.999 UMR___1_1_0_3_S5_S3 0.001 10
 /begin AXIS_DESCR STD_AXIS NO_INPUT_QUANTITY UMR_U_MINSEC_1_1_0_S5_S3 6 -10000 10000 DEPOSIT ABSOLUTE /end AXIS_DESCR
 /begin AXIS_DESCR STD_AXIS iIaeMomen.xd_iae UMR___1_1_0_S5_S3 6 -10000 10000 DEPOSIT ABSOLUTE FORMAT "%3.2" /end AXIS_DESCR
 FORMAT "%4.3" /end CHARACTERISTIC
/begin CHARACTERISTIC KF_KI_ANFAHRT_E_IAE "I-Anteil für PID-Regler im E- oder H-Anfahren" MAP 0x19BA0C ZF_kf_fl32_S5_S3 9.999 UMR___1_1_0_3_S5_S3 0.001 10
 /begin AXIS_DESCR STD_AXIS NO_INPUT_QUANTITY UMR_U_MINSEC_1_1_0_S5_S3 6 -10000 10000 DEPOSIT ABSOLUTE /end AXIS_DESCR
 /begin AXIS_DESCR STD_AXIS iIaeMomen.xd_iae UMR___1_1_0_S5_S3 6 -10000 10000 DEPOSIT ABSOLUTE FORMAT "%3.2" /end AXIS_DESCR
 FORMAT "%4.3" /end CHARACTERISTIC
/begin CHARACTERISTIC KF_KI_ANFAHRT_H_IAE "I-Anteil für PID-Regler im E- oder H-Anfahren" MAP 0x19BF70 ZF_kf_fl32_S5_S3 9.999 UMR___1_1_0_3_S5_S3 0.001 10
 /begin AXIS_DESCR STD_AXIS NO_INPUT_QUANTITY UMR_U_MINSEC_1_1_0_S5_S3 6 -10000 10000 DEPOSIT ABSOLUTE /end AXIS_DESCR
 /begin AXIS_DESCR STD_AXIS iIaeMomen.xd_iae UMR___1_1_0_S5_S3 6 -10000 10000 DEPOSIT ABSOLUTE FORMAT "%3.2" /end AXIS_DESCR
 FORMAT "%4.3" /end CHARACTERISTIC
/begin CHARACTERISTIC KF_KP_ANFAHRT_E_IAE "P-Anteil für PID-Regler im E- oder H-Anfahren" MAP 0x19BAD4 ZF_kf_fl32_S5_S3 9.999 UMR___1_1_0_3_S5_S3 0.001 10
 /begin AXIS_DESCR STD_AXIS NO_INPUT_QUANTITY UMR_U_MINSEC_1_1_0_S5_S3 6 -10000 10000 DEPOSIT ABSOLUTE /end AXIS_DESCR
 /begin AXIS_DESCR STD_AXIS iIaeMomen.xd_iae UMR___1_1_0_S5_S3 6 -10000 10000 DEPOSIT ABSOLUTE FORMAT "%3.2" /end AXIS_DESCR
 FORMAT "%4.3" /end CHARACTERISTIC
/begin CHARACTERISTIC KF_KP_ANFAHRT_H_IAE "P-Anteil für PID-Regler im E- oder H-Anfahren" MAP 0x19C038 ZF_kf_fl32_S5_S3 9.999 UMR___1_1_0_3_S5_S3 0.001 10
 /begin AXIS_DESCR STD_AXIS NO_INPUT_QUANTITY UMR_U_MINSEC_1_1_0_S5_S3 6 -10000 10000 DEPOSIT ABSOLUTE /end AXIS_DESCR
 /begin AXIS_DESCR STD_AXIS iIaeMomen.xd_iae UMR___1_1_0_S5_S3 6 -10000 10000 DEPOSIT ABSOLUTE FORMAT "%3.2" /end AXIS_DESCR
 FORMAT "%4.3" /end CHARACTERISTIC
/begin CHARACTERISTIC KF_MDI_DIAGIAE "Definition Motordrücken" MAP 0x19C40C ZF_kf_si16_S5_S3 100 UMR___1_1_0_S5_S3 0 100
 /begin AXIS_DESCR STD_AXIS NO_INPUT_QUANTITY UMR___1_1_0_S5_S3 6 -10000 10000 DEPOSIT ABSOLUTE /end AXIS_DESCR
 /begin AXIS_DESCR STD_AXIS NO_INPUT_QUANTITY UMR_NM__1_1_0_S5_S3 6 -3500 3500 DEPOSIT ABSOLUTE /end AXIS_DESCR
/end CHARACTERISTIC
/begin CHARACTERISTIC KF_MUE_IAE "Reibwert" MAP 0x19C508 ZF_kf_si16_S5_S3 300 UMR_NM_BAR_1_1_0_S5_S3 0 300
 /begin AXIS_DESCR STD_AXIS NO_INPUT_QUANTITY UMR_U_MIN_1_1_0_S5_S3 6 -8000 8000 DEPOSIT ABSOLUTE /end AXIS_DESCR
 /begin AXIS_DESCR STD_AXIS NO_INPUT_QUANTITY UMR_NM__1_1_0_S5_S3 6 -200 1500 DEPOSIT ABSOLUTE /end AXIS_DESCR
/end CHARACTERISTIC
/begin CHARACTERISTIC KF_MUE_OFFSET_IAE "Offset auf Reibwert" MAP 0x19C570 ZF_kf_si16_S5_S3 300 UMR_NM_BAR_1_1_0_S5_S3 0 300
 /begin AXIS_DESCR STD_AXIS NO_INPUT_QUANTITY UMR_GRADC__1_1_M40_S5_S3 6 -40 215 DEPOSIT ABSOLUTE /end AXIS_DESCR
 /begin AXIS_DESCR STD_AXIS NO_INPUT_QUANTITY UMR_NM__1_1_0_S5_S3 6 -200 1500 DEPOSIT ABSOLUTE /end AXIS_DESCR
/end CHARACTERISTIC
/begin CHARACTERISTIC KF_ND_NOOPEN_DIAGIAE "Zustandsabhängige Schlupfschwelle" MAP 0x19C474 ZF_kf_si16_S5_S3 1000 UMR_U_MIN_1_1_0_S5_S3 0 1000
 /begin AXIS_DESCR STD_AXIS NO_INPUT_QUANTITY UMR___1_1_0_S5_S3 3 0 2 DEPOSIT ABSOLUTE /end AXIS_DESCR
 /begin AXIS_DESCR STD_AXIS iIaeSigna.n_motsoll_ll_iae UMR_U_MIN_1_1_0_S5_S3 3 0 8160 DEPOSIT ABSOLUTE /end AXIS_DESCR
/end CHARACTERISTIC
/begin CHARACTERISTIC KF_NMOTANFAHR_SOLL_E_ECO_IAE "" MAP 0x19B7F0 ZF_kf_si16_S5_S3 7000 UMR_U_MIN_1_1_0_S5_S3 0 7000
 /begin AXIS_DESCR STD_AXIS NO_INPUT_QUANTITY UMR___1_1_0_S5_S3 6 -1 8 DEPOSIT ABSOLUTE /end AXIS_DESCR
 /begin AXIS_DESCR STD_AXIS NO_INPUT_QUANTITY UMR_PROZENT__20_51_0_S5_S3 6 0 100 DEPOSIT ABSOLUTE /end AXIS_DESCR
/end CHARACTERISTIC
/begin CHARACTERISTIC KF_NMOTANFAHR_SOLL_E_IAE "" MAP 0x19B618 ZF_kf_si16_S5_S3 7000 UMR_U_MIN_1_1_0_S5_S3 0 7000
 /begin AXIS_DESCR STD_AXIS NO_INPUT_QUANTITY UMR___1_1_0_S5_S3 6 -1 8 DEPOSIT ABSOLUTE /end AXIS_DESCR
 /begin AXIS_DESCR STD_AXIS NO_INPUT_QUANTITY UMR_PROZENT__20_51_0_S5_S3 6 0 100 DEPOSIT ABSOLUTE /end AXIS_DESCR
/end CHARACTERISTIC
/begin CHARACTERISTIC KF_NMOTANFAHR_SOLL_H_ECO_IAE "" MAP 0x19B8DC ZF_kf_si16_S5_S3 7000 UMR_U_MIN_1_1_0_S5_S3 0 7000
 /begin AXIS_DESCR STD_AXIS NO_INPUT_QUANTITY UMR___1_1_0_S5_S3 6 -1 8 DEPOSIT ABSOLUTE /end AXIS_DESCR
 /begin AXIS_DESCR STD_AXIS NO_INPUT_QUANTITY UMR_PROZENT__20_51_0_S5_S3 6 0 100 DEPOSIT ABSOLUTE /end AXIS_DESCR
/end CHARACTERISTIC
/begin CHARACTERISTIC KF_NMOTANFAHR_SOLL_H_IAE "" MAP 0x19B704 ZF_kf_si16_S5_S3 7000 UMR_U_MIN_1_1_0_S5_S3 0 7000
 /begin AXIS_DESCR STD_AXIS NO_INPUT_QUANTITY UMR___1_1_0_S5_S3 6 -1 8 DEPOSIT ABSOLUTE /end AXIS_DESCR
 /begin AXIS_DESCR STD_AXIS NO_INPUT_QUANTITY UMR_PROZENT__20_51_0_S5_S3 6 0 100 DEPOSIT ABSOLUTE /end AXIS_DESCR
/end CHARACTERISTIC
/begin CHARACTERISTIC KF_OGNMOTANFAHR_SOLL_E_IAE "Offsetgradient der Sollanfahrdrehzahl beim E- oder H-Anfahren" MAP 0x19BE40 ZF_kf_si16_S5_S3 10000 UMR_U_MINSEC_1_1_0_S5_S3 0 10000
 /begin AXIS_DESCR STD_AXIS NO_INPUT_QUANTITY UMR_U_MIN_1_1_0_S5_S3 6 -10000 10000 DEPOSIT ABSOLUTE /end AXIS_DESCR
 /begin AXIS_DESCR STD_AXIS iIaeSigna.ng_getrein_iae UMR_U_MINSEC_1_1_0_S5_S3 6 -10000 10000 DEPOSIT ABSOLUTE /end AXIS_DESCR
/end CHARACTERISTIC
/begin CHARACTERISTIC KF_OGNMOTANFAHR_SOLL_H_IAE "Offsetgradient der Sollanfahrdrehzahl beim E- oder H-Anfahren" MAP 0x19C3A4 ZF_kf_si16_S5_S3 10000 UMR_U_MINSEC_1_1_0_S5_S3 0 10000
 /begin AXIS_DESCR STD_AXIS NO_INPUT_QUANTITY UMR_U_MIN_1_1_0_S5_S3 6 -10000 10000 DEPOSIT ABSOLUTE /end AXIS_DESCR
 /begin AXIS_DESCR STD_AXIS iIaeSigna.ng_getrein_iae UMR_U_MINSEC_1_1_0_S5_S3 6 -10000 10000 DEPOSIT ABSOLUTE /end AXIS_DESCR
/end CHARACTERISTIC
/begin CHARACTERISTIC KF_PO_DYN_ANFAHR_IAE "Druckoffset beim Übergang Kriechen -> Schliessen" MAP 0x19C648 ZF_kf_si16_S5_S3 10 UMR_BAR__1_1000_0_S5_S3 0 10
 /begin AXIS_DESCR STD_AXIS NO_INPUT_QUANTITY UMR_U_MINSEC_1_1_0_S5_S3 4 -30000 30000 DEPOSIT ABSOLUTE /end AXIS_DESCR
 /begin AXIS_DESCR STD_AXIS NO_INPUT_QUANTITY UMR_PROZENT_SEC_20_51_0_S5_S3 4 -3921.56862745 3921.56862745 DEPOSIT ABSOLUTE /end AXIS_DESCR
/end CHARACTERISTIC
/begin CHARACTERISTIC KF_T_PT2_NMOTANFAHR_E_IAE "Filterkonstante für PT2-Filter für Solldrehzahl im Anfahren" MAP 0x19BE08 ZF_kf_si16_S5_S3 4000 UMR_MSEC__1_1_0_S5_S3 0 4000
 /begin AXIS_DESCR STD_AXIS NO_INPUT_QUANTITY UMR_PROZENT__20_51_0_S5_S3 4 -3921.56862745 3921.56862745 DEPOSIT ABSOLUTE /end AXIS_DESCR
 /begin AXIS_DESCR STD_AXIS iIaeSigna.dkig_iae UMR_PROZENT_SEC_20_51_0_S5_S3 4 -3921.56862745 3921.56862745 DEPOSIT ABSOLUTE /end AXIS_DESCR
/end CHARACTERISTIC
/begin CHARACTERISTIC KF_T_PT2_NMOTANFAHR_H_IAE "Filterkonstante für PT2-Filter für Solldrehzahl im Anfahren" MAP 0x19C36C ZF_kf_si16_S5_S3 4000 UMR_MSEC__1_1_0_S5_S3 0 4000
 /begin AXIS_DESCR STD_AXIS NO_INPUT_QUANTITY UMR_PROZENT__20_51_0_S5_S3 4 -3921.56862745 3921.56862745 DEPOSIT ABSOLUTE /end AXIS_DESCR
 /begin AXIS_DESCR STD_AXIS iIaeSigna.dkig_iae UMR_PROZENT_SEC_20_51_0_S5_S3 4 -3921.56862745 3921.56862745 DEPOSIT ABSOLUTE /end AXIS_DESCR
/end CHARACTERISTIC
/begin CHARACTERISTIC KF_VP_KUEHL_SOLL_IAE "erforderliche Kühlölmenger für die IAE" MAP 0x19C784 ZF_kf_si16_S5_S3 50 UMR_LITER_MIN_1_10_0_S5_S3 0 50
 /begin AXIS_DESCR STD_AXIS NO_INPUT_QUANTITY UMR_KW__1_1000_0_S5_S3 6 0 32 DEPOSIT ABSOLUTE /end AXIS_DESCR
 /begin AXIS_DESCR STD_AXIS NO_INPUT_QUANTITY UMR_GRADC__1_1_0_S5_S3 6 -500 500 DEPOSIT ABSOLUTE /end AXIS_DESCR
/end CHARACTERISTIC
/begin CHARACTERISTIC KF_VP_LECKAGE_IAE "Kennfeld aus dem die Leckagemengen der Hydraulik ausgelesen werden können" MAP 0x19C830 ZF_kf_ui16_S5_S3 99.99 UMR_LITER_MIN_1_10_0_S5_S3 0.01 100
 /begin AXIS_DESCR STD_AXIS iSasPsyst.p_sys UMR_BAR__1_1000_0_S5_S3 6 0 20 DEPOSIT ABSOLUTE /end AXIS_DESCR
 /begin AXIS_DESCR STD_AXIS NO_INPUT_QUANTITY UMR_GRADC__1_1_M40_S5_S3 6 -40 215 DEPOSIT ABSOLUTE /end AXIS_DESCR
/end CHARACTERISTIC
/begin CHARACTERISTIC KL_CS_NACHKUEHL_IAE "IAE-Temperaturschwelle zur Anforderung einer Nachkühlung" CURVE 0x19C81C ZF_kl_si16_S5_S3 500 UMR_GRADC__1_1_M40_S5_S3 0 500
 /begin AXIS_DESCR STD_AXIS NO_INPUT_QUANTITY UMR_GRADC__1_1_M40_S5_S3 4 -40 215 DEPOSIT ABSOLUTE /end AXIS_DESCR
/end CHARACTERISTIC
/begin CHARACTERISTIC KL_F_MUE_IAE "Korrektur für Übertragungsfähigkeit" CURVE 0x19C5D8 ZF_kl_si16_S5_S3 1.7 UMR___1_100_0_S5_S3 0.3 2
 /begin AXIS_DESCR STD_AXIS NO_INPUT_QUANTITY UMR_GRADC__1_1_M40_S5_S3 4 -40 500 DEPOSIT ABSOLUTE /end AXIS_DESCR
/end CHARACTERISTIC
/begin CHARACTERISTIC KL_F_ND_RESET_DIAGIAE "Schlupfschwelle zur Erkennung IAE schlupft für Fehlerrückfilterung" CURVE 0x19C4C8 ZF_kl_ui16_S5_S3 10 UMR___1_100_0_S5_S3 0 10
 /begin AXIS_DESCR STD_AXIS NO_INPUT_QUANTITY UMR_U_MIN_1_1_0_S5_S3 4 0 8000 DEPOSIT ABSOLUTE /end AXIS_DESCR
/end CHARACTERISTIC
/begin CHARACTERISTIC KL_F_PO_DYN_KRIECH_IAE "Faktor auf Druckoffset beim Übergang ANGELEGT -> Kriechen" CURVE 0x19C680 ZF_kl_si16_S5_S3 5 UMR___1_100_0_S5_S3 0 5
 /begin AXIS_DESCR STD_AXIS NO_INPUT_QUANTITY UMR_MSEC__10_1_0_S5_S3 4 0 2550 DEPOSIT ABSOLUTE /end AXIS_DESCR
/end CHARACTERISTIC
/begin CHARACTERISTIC KL_F_VP_KUEHL_IAE "Faktor zur Korrektur des Temperatureinflusses" CURVE 0x19C808 ZF_kl_si16_S5_S3 5 UMR___1_100_0_S5_S3 0 5
 /begin AXIS_DESCR STD_AXIS NO_INPUT_QUANTITY UMR_GRADC__1_1_M40_S5_S3 4 -40 215 DEPOSIT ABSOLUTE /end AXIS_DESCR
/end CHARACTERISTIC
/begin CHARACTERISTIC KL_J_KOR_UEFIAE "Berechnungskorrektur Massenträgheit" CURVE 0x19B578 ZF_kl_si16_S5_S3 200 UMR_NM_BAR_1_1_0_S5_S3 -100 100
 /begin AXIS_DESCR STD_AXIS NO_INPUT_QUANTITY UMR_U_MINSEC_1_1_0_S5_S3 4 -10000 10000 DEPOSIT ABSOLUTE /end AXIS_DESCR
/end CHARACTERISTIC
/begin CHARACTERISTIC KL_MDI_CLOSE_DIAGIAE "Schwelle Motordrücken 'IAE schließt ungewollt" CURVE 0x19C4A8 ZF_kl_ui8_S5_S3 100 UMR___1_1_0_S5_S3 0 100
 /begin AXIS_DESCR STD_AXIS NO_INPUT_QUANTITY UMR_GRADC__1_1_M40_S5_S3 4 -40 215 DEPOSIT ABSOLUTE /end AXIS_DESCR
/end CHARACTERISTIC
/begin CHARACTERISTIC KL_MDI_NOOPEN_DIAGIAE "Schwelle Motordrücken 'IAE öffnet nicht'" CURVE 0x19C49C ZF_kl_ui8_S5_S3 100 UMR___1_1_0_S5_S3 0 100
 /begin AXIS_DESCR STD_AXIS NO_INPUT_QUANTITY UMR_GRADC__1_1_M40_S5_S3 4 -40 215 DEPOSIT ABSOLUTE /end AXIS_DESCR
/end CHARACTERISTIC
/begin CHARACTERISTIC KL_MPT_NMOTSOLLANFAHR_ROH_E_IAE "Filterparameter auf Zieldrehzahl" CURVE 0x19BDF4 ZF_kl_si16_S5_S3 0.99 UMR___1_100_0_S5_S3 0.01 1
 /begin AXIS_DESCR STD_AXIS NO_INPUT_QUANTITY UMR_PROZENT_SEC_20_51_0_S5_S3 4 -11764.7058824 11764.7058824 DEPOSIT ABSOLUTE /end AXIS_DESCR
/end CHARACTERISTIC
/begin CHARACTERISTIC KL_MPT_NMOTSOLLANFAHR_ROH_H_IAE "Filterparameter auf Zieldrehzahl" CURVE 0x19C358 ZF_kl_si16_S5_S3 0.99 UMR___1_100_0_S5_S3 0.01 1
 /begin AXIS_DESCR STD_AXIS NO_INPUT_QUANTITY UMR_PROZENT_SEC_20_51_0_S5_S3 4 -11764.7058824 11764.7058824 DEPOSIT ABSOLUTE /end AXIS_DESCR
/end CHARACTERISTIC
/begin CHARACTERISTIC KL_NDMOTVMSTARTBEGINN_IAE "Sollanfahrdrehzahlabweichungsänderung um Beginn Motorschleppstart zu erkennen" CURVE 0x19C730 ZF_kl_si16_S5_S3 20000 UMR_U_MIN_1_1_0_S5_S3 -10000 10000
 /begin AXIS_DESCR STD_AXIS iIaeSigna.dki_iae UMR_PROZENT__20_51_0_S5_S3 6 0 100 DEPOSIT ABSOLUTE /end AXIS_DESCR
/end CHARACTERISTIC
/begin CHARACTERISTIC KL_NDS_ANGELEGT_KRIECH_IAE "Betrag Schlupfschwelle Übergang ANGELEGT KRIECHEN" CURVE 0x19C708 ZF_kl_si16_S5_S3 1000 UMR_U_MIN_1_1_0_S5_S3 0 1000
 /begin AXIS_DESCR STD_AXIS iIaeSigna.n_ab_iae UMR_U_MIN_1_1_0_S5_S3 4 0 8000 DEPOSIT ABSOLUTE /end AXIS_DESCR
/end CHARACTERISTIC
/begin CHARACTERISTIC KL_NGMOTANFAHRINIT_E_ECO_IAE "Initialisierungsgradient für den Sollanfahrdrehzahlfilter" CURVE 0x19B7D4 ZF_kl_si16_S5_S3 10000 UMR_U_MINSEC_1_1_0_S5_S3 0 10000
 /begin AXIS_DESCR STD_AXIS NO_INPUT_QUANTITY UMR_PROZENT__20_51_0_S5_S3 6 0 100 DEPOSIT ABSOLUTE /end AXIS_DESCR
/end CHARACTERISTIC
/begin CHARACTERISTIC KL_NGMOTANFAHRINIT_E_IAE "Initialisierungsgradient für den Sollanfahrdrehzahlfilter" CURVE 0x19B5FC ZF_kl_si16_S5_S3 10000 UMR_U_MINSEC_1_1_0_S5_S3 0 10000
 /begin AXIS_DESCR STD_AXIS NO_INPUT_QUANTITY UMR_PROZENT__20_51_0_S5_S3 6 0 100 DEPOSIT ABSOLUTE /end AXIS_DESCR
/end CHARACTERISTIC
/begin CHARACTERISTIC KL_NGMOTANFAHRINIT_H_ECO_IAE "Initialisierungsgradient für den Sollanfahrdrehzahlfilter" CURVE 0x19B8C0 ZF_kl_si16_S5_S3 10000 UMR_U_MINSEC_1_1_0_S5_S3 0 10000
 /begin AXIS_DESCR STD_AXIS NO_INPUT_QUANTITY UMR_PROZENT__20_51_0_S5_S3 6 0 100 DEPOSIT ABSOLUTE /end AXIS_DESCR
/end CHARACTERISTIC
/begin CHARACTERISTIC KL_NGMOTANFAHRINIT_H_IAE "Initialisierungsgradient für den Sollanfahrdrehzahlfilter" CURVE 0x19B6E8 ZF_kl_si16_S5_S3 10000 UMR_U_MINSEC_1_1_0_S5_S3 0 10000
 /begin AXIS_DESCR STD_AXIS NO_INPUT_QUANTITY UMR_PROZENT__20_51_0_S5_S3 6 0 100 DEPOSIT ABSOLUTE /end AXIS_DESCR
/end CHARACTERISTIC
/begin CHARACTERISTIC KL_NGS_NAB_CLOSE_DIAGIAE "Erkennung unzulässige Beschleunigung" CURVE 0x19C4B4 ZF_kl_si16_S5_S3 20000 UMR_U_MINSEC_1_1_0_S5_S3 -10000 10000
 /begin AXIS_DESCR STD_AXIS NO_INPUT_QUANTITY UMR_GRADC__1_1_M40_S5_S3 4 -40 215 DEPOSIT ABSOLUTE /end AXIS_DESCR
/end CHARACTERISTIC
/begin CHARACTERISTIC KL_ONSENTKOPPL_ANGELEGT_IAE "Offsetdrehzahl auf Öffnendrehzahlschwelle aus Entkoppeln nach Angelegt" CURVE 0x19C74C ZF_kl_si16_S5_S3 2000 UMR_U_MIN_1_1_0_S5_S3 -1000 1000
 /begin AXIS_DESCR STD_AXIS iIaeSigna.n_motsoll_ll_iae UMR_U_MIN_1_1_0_S5_S3 3 0 10000 DEPOSIT ABSOLUTE /end AXIS_DESCR
/end CHARACTERISTIC
/begin CHARACTERISTIC KL_POFMIN_IAE "Druckoffset auf Minimaldruck p_fmin" CURVE 0x19C4EC ZF_kl_si16_S5_S3 2 UMR_BAR__1_1000_0_S5_S3 0 2
 /begin AXIS_DESCR STD_AXIS NO_INPUT_QUANTITY UMR_GRADC__1_1_M40_S5_S3 6 -40 215 DEPOSIT ABSOLUTE /end AXIS_DESCR
/end CHARACTERISTIC
/begin CHARACTERISTIC KL_PO_DYN_KRIECH_IAE "Druckoffset beim Übergang ANGELEGT -> Kriechen" CURVE 0x19C694 ZF_kl_si16_S5_S3 10 UMR_BAR__1_1000_0_S5_S3 0 10
 /begin AXIS_DESCR STD_AXIS NO_INPUT_QUANTITY UMR_GRADC__1_1_M40_S5_S3 4 -40 215 DEPOSIT ABSOLUTE /end AXIS_DESCR
/end CHARACTERISTIC
/begin CHARACTERISTIC KL_PO_HYSKOMP_ANGELEGT_IAE "Druck für Hysteresekompensation im ANGELEGT (neg.)" CURVE 0x19C634 ZF_kl_si16_S5_S3 2 UMR_BAR__1_1000_0_S5_S3 -2 0
 /begin AXIS_DESCR STD_AXIS NO_INPUT_QUANTITY UMR_GRADC__1_1_M40_S5_S3 4 -40 215 DEPOSIT ABSOLUTE /end AXIS_DESCR
/end CHARACTERISTIC
/begin CHARACTERISTIC KL_PS_BREMS_ANFAHRT_IAE "Bremsdruckschwelle in Abhängigkeit der Neigung" CURVE 0x19C71C ZF_kl_si16_S5_S3 50 UMR_BAR__1_100_0_S5_S3 0 50
 /begin AXIS_DESCR STD_AXIS iIaeSigna.neigung_iae UMR_GRAD__1_3_M128_S5_S3 4 -3376 3290.66666667 DEPOSIT ABSOLUTE /end AXIS_DESCR
/end CHARACTERISTIC
/begin CHARACTERISTIC KL_P_KUEHL_IAE "Umrechnung vp_kuehl_iae in Kühldruck" CURVE 0x19C7EC ZF_kl_si16_S5_S3 20 UMR_BAR__1_1000_0_S5_S3 0 20
 /begin AXIS_DESCR STD_AXIS NO_INPUT_QUANTITY UMR_LITER_MIN_1_10_0_S5_S3 6 0 50 DEPOSIT ABSOLUTE /end AXIS_DESCR
/end CHARACTERISTIC
/begin CHARACTERISTIC KL_T_HALTE_HYSKOMP_ANGELEGT_IAE "Haltezeit für Hysteresekompensatin im Angelegt" CURVE 0x19C6F4 ZF_kl_ui16_S5_S3 2000 UMR_MSEC__10_1_0_S5_S3 0 2000
 /begin AXIS_DESCR STD_AXIS NO_INPUT_QUANTITY UMR_GRADC__1_1_M40_S5_S3 4 -40 215 DEPOSIT ABSOLUTE /end AXIS_DESCR
/end CHARACTERISTIC
/begin CHARACTERISTIC KL_T_PO_DYN_ANFAHR_IAE "Dauer des Druckoffsets beim Übergang Kriechen -> Schliessen" CURVE 0x19C6BC ZF_kl_ui16_S5_S3 20000 UMR_MSEC__10_1_0_S5_S3 0 20000
 /begin AXIS_DESCR STD_AXIS NO_INPUT_QUANTITY UMR_GRADC__1_1_M40_S5_S3 4 -40 215 DEPOSIT ABSOLUTE /end AXIS_DESCR
/end CHARACTERISTIC
/begin CHARACTERISTIC KL_T_PO_DYN_KRIECH_IAE "Dauer des Druckoffsets beim Übergang ANGELEGT -> Kriechen" CURVE 0x19C6A8 ZF_kl_ui16_S5_S3 20000 UMR_MSEC__10_1_0_S5_S3 0 20000
 /begin AXIS_DESCR STD_AXIS NO_INPUT_QUANTITY UMR_GRADC__1_1_M40_S5_S3 4 -40 215 DEPOSIT ABSOLUTE /end AXIS_DESCR
/end CHARACTERISTIC
/begin CHARACTERISTIC MO_MMOT_NOCLOSE_DIAGIAE "Differenz Soll-Ist Motorbelastung zur Erkennung 'IAE schließt nicht'" VALUE 0x1D8320 ZF_kw_si16_S5_S3 2000 UMR_NM__1_1_0_S5_S3 -1000 1000 /end CHARACTERISTIC
/begin CHARACTERISTIC MPT_KUEHL_IAE "PT1- Filterzeitkonstante für Sollkühlölmenge vp_kuehl_soll_iae" VALUE 0x1D779D ZF_kw_ui8_S5_S3 0.99 UMR___1_100_0_S5_S3 0.01 1 /end CHARACTERISTIC
/begin CHARACTERISTIC MPT_MDI_DIAGIAE "PT1 Filterung Motordrückindex" VALUE 0x1D7789 ZF_kw_ui8_S5_S3 0.99 UMR___1_100_0_S5_S3 0.01 1 /end CHARACTERISTIC
/begin CHARACTERISTIC MPT_MUE_IAE "Filterkonstante für PT1-Filter für mue_iae" VALUE 0x1D778D ZF_kw_ui8_S5_S3 1 UMR___1_100_0_S5_S3 0 1 /end CHARACTERISTIC
/begin CHARACTERISTIC MPT_PO_DYN_ANFAHR_IAE "Filterkonstante für PT1-Filter zum Abfiltern des Druckoffsets" VALUE 0x1D7791 ZF_kw_ui8_S5_S3 0.99 UMR___1_100_0_S5_S3 0.01 1 /end CHARACTERISTIC
/begin CHARACTERISTIC MPT_PO_DYN_KRIECH_IAE "Filterkonstante für PT1-Filter zum Abfiltern des Druckoffsets" VALUE 0x1D7790 ZF_kw_ui8_S5_S3 0.99 UMR___1_100_0_S5_S3 0.01 1 /end CHARACTERISTIC
/begin CHARACTERISTIC MPT_PO_HYSKOMP_ANGELEGT_IAE "Filterkonstante für PT1-Filter für Hysteresekompensation im ANGELEGT" VALUE 0x1D778F ZF_kw_ui8_S5_S3 1 UMR___1_100_0_S5_S3 0 1 /end CHARACTERISTIC
/begin CHARACTERISTIC MPT_PSTELLBASIS_IAE "Filterkonstante für PT1-Filter für p_stellbasis" VALUE 0x1D778E ZF_kw_ui8_S5_S3 1 UMR___1_100_0_S5_S3 0 1 /end CHARACTERISTIC
/begin CHARACTERISTIC MSTELL_ABBR_UEFIAE "Abbruchschwelle Änderung Kupplungsmoment" VALUE 0x1D8300 ZF_kw_si16_S5_S3 1000 UMR_NM__1_1_0_S5_S3 0 1000 /end CHARACTERISTIC
/begin CHARACTERISTIC MS_K0VMSTARTBEGINN_IAE "K0 Momentenschwelle beim VM-Starten für Übergang nach Anfahren_entkoppeln" VALUE 0x1D8360 ZF_kw_si16_S5_S3 1000 UMR_NM__1_1_0_S5_S3 0 1000 /end CHARACTERISTIC
/begin CHARACTERISTIC MS_MOTIST_ABBR_UEFIAE "Abbruchschwelle Aenderung Motormoment" VALUE 0x1D82F6 ZF_kw_si16_S5_S3 1000 UMR_NM__1_1_0_S5_S3 0 1000 /end CHARACTERISTIC
/begin CHARACTERISTIC MS_MOTSOLLREKUEND_IAE "Motorsollmomentenschwelle für Erkennung Schubreku-Ende" VALUE 0x1D834A ZF_kw_si16_S5_S3 200 UMR_NM__1_1_0_S5_S3 -100 100 /end CHARACTERISTIC
/begin CHARACTERISTIC MS_START_MAX_UEFIAE "Max-Kupplungsmoment für Adaption" VALUE 0x1D82FC ZF_kw_si16_S5_S3 1000 UMR_NM__1_1_0_S5_S3 0 1000 /end CHARACTERISTIC
/begin CHARACTERISTIC MS_START_MIN_UEFIAE "Min-Kupplungsmoment für Adaption" VALUE 0x1D82FE ZF_kw_si16_S5_S3 2000 UMR_NM__1_1_0_S5_S3 -1000 1000 /end CHARACTERISTIC
/begin CHARACTERISTIC MUE_IST_MAX_UEFIAE "physiklische Obergrenze von Mue" VALUE 0x1D8316 ZF_kw_si16_S5_S3 300 UMR_NM_BAR_1_1_0_S5_S3 200 500 /end CHARACTERISTIC
/begin CHARACTERISTIC MUE_IST_MIN_UEFIAE "physiklische Untergrenze von Mue" VALUE 0x1D8314 ZF_kw_si16_S5_S3 190 UMR_NM_BAR_1_1_0_S5_S3 10 200 /end CHARACTERISTIC
/begin CHARACTERISTIC M_MOTIST_START_MAX_UEFIAE "Max-Motormoment fuer Adaption" VALUE 0x1D82F8 ZF_kw_si16_S5_S3 1000 UMR_NM__1_1_0_S5_S3 0 1000 /end CHARACTERISTIC
/begin CHARACTERISTIC M_MOTIST_START_MIN_UEFIAE "Min-Motormoment fuer Adaption" VALUE 0x1D82FA ZF_kw_si16_S5_S3 1000 UMR_NM__1_1_0_S5_S3 0 1000 /end CHARACTERISTIC
/begin CHARACTERISTIC M_SOLLMAX_CLOSE_DIAGIAE "Abschaltschwelle IAE Sollmoment zur 'IAE schließt' Erkennung" VALUE 0x1D778B ZF_kw_ui8_S5_S3 100 UMR_NM__1_1_0_S5_S3 0 100 /end CHARACTERISTIC
/begin CHARACTERISTIC NDGS_START_MAX_UEFIAE "Max-Schlupfgradient für Adaption U/min/sek" VALUE 0x1D8302 ZF_kw_si16_S5_S3 1000 UMR_U_MINSEC_1_1_0_S5_S3 0 1000 /end CHARACTERISTIC
/begin CHARACTERISTIC NDGS_START_MIN_UEFIAE "Min-Schlupfgradient für Adaption U/min/sek" VALUE 0x1D8304 ZF_kw_si16_S5_S3 2000 UMR_U_MINSEC_1_1_0_S5_S3 -1000 1000 /end CHARACTERISTIC
/begin CHARACTERISTIC NDS_ABBR_UEFIAE "Abbruchschwelle Änderung IAE-Schlupf" VALUE 0x1D8306 ZF_kw_si16_S5_S3 1000 UMR_U_MIN_1_1_0_S5_S3 0 1000 /end CHARACTERISTIC
/begin CHARACTERISTIC NDS_KUEHLOFFEN_IAE "Differenzdrehzahlschwelle um Kuehlung bei offener IAE einzuschalten" VALUE 0x1D836C ZF_kw_si16_S5_S3 64000 UMR_U_MIN_1_1_0_S5_S3 -32000 32000 /end CHARACTERISTIC
/begin CHARACTERISTIC NDS_MOTINITREG_IAE "Differenzdrehzahlschwelle für Reglerwiederinitialisierung im Entkoppeln während Anfahren." VALUE 0x1D835E ZF_kw_si16_S5_S3 500 UMR_U_MIN_1_1_0_S5_S3 0 500 /end CHARACTERISTIC
/begin CHARACTERISTIC NDS_NDIAE_NOCLOSE_DIAGIAE "unzulässiger IAE Schlupf zur Erkennung 'IAE schließt nicht'" VALUE 0x1D8322 ZF_kw_si16_S5_S3 2000 UMR_U_MIN_1_1_0_S5_S3 -1000 1000 /end CHARACTERISTIC
/begin CHARACTERISTIC NDS_START_MAX_UEFIAE "Max-Grenze IAE-Schlupf für Adaption U/min" VALUE 0x1D8308 ZF_kw_si16_S5_S3 1000 UMR_U_MIN_1_1_0_S5_S3 0 1000 /end CHARACTERISTIC
/begin CHARACTERISTIC NDS_START_MIN_UEFIAE "Min-Grenze IAE-Schlupf für Adaption U/min" VALUE 0x1D830A ZF_kw_si16_S5_S3 2000 UMR_U_MIN_1_1_0_S5_S3 -1000 1000 /end CHARACTERISTIC
/begin CHARACTERISTIC NDS_SYNC_IAE "Differenzdrehzahlschwelle" VALUE 0x1D835A ZF_kw_si16_S5_S3 1000 UMR_U_MIN_1_1_0_S5_S3 0 1000 /end CHARACTERISTIC
/begin CHARACTERISTIC NDS_ZU_HYS_IAE "Hysterese für Drehzahlschwelle" VALUE 0x1D834E ZF_kw_si16_S5_S3 200 UMR_U_MIN_1_1_0_S5_S3 0 200 /end CHARACTERISTIC
/begin CHARACTERISTIC NDS_ZU_IAE "Drehzahlschwelle" VALUE 0x1D834C ZF_kw_si16_S5_S3 200 UMR_U_MIN_1_1_0_S5_S3 0 200 /end CHARACTERISTIC
/begin CHARACTERISTIC ND_HYS_KUEHLOFFEN_IAE "Hysterese auf Differenzdrehzahlschwelle um Kuehlung bei offener IAE einzuschalten" VALUE 0x1D836E ZF_kw_si16_S5_S3 64000 UMR_U_MIN_1_1_0_S5_S3 -32000 32000 /end CHARACTERISTIC
/begin CHARACTERISTIC NGS_ABBR_UEFIAE "Abbruchschwelle Änderung Motordrehzahlgradient U/min/sek" VALUE 0x1D830C ZF_kw_si16_S5_S3 1000 UMR_U_MINSEC_1_1_0_S5_S3 0 1000 /end CHARACTERISTIC
/begin CHARACTERISTIC NGS_ASRREGELT_IAE "Getriebeeingangsdrehzahlgradientenschwelle für Übergang aus Anfahren nach ZU (Sonderfunktion elektr. Diff.-Sperre, VAG)" VALUE 0x1D8348 ZF_kw_si16_S5_S3 20000 UMR_U_MINSEC_1_1_0_S5_S3 -10000 10000 /end CHARACTERISTIC
/begin CHARACTERISTIC NGS_MOT_START_MAX_UEFIAE "Max-Grenze Motordrehzahlgradient für Adaption" VALUE 0x1D830E ZF_kw_si16_S5_S3 1000 UMR_U_MINSEC_1_1_0_S5_S3 0 1000 /end CHARACTERISTIC
/begin CHARACTERISTIC NGS_MOT_START_MIN_UEFIAE "Min-Grenze Motordrehzahlgradient für Adaption" VALUE 0x1D8310 ZF_kw_si16_S5_S3 2000 UMR_U_MINSEC_1_1_0_S5_S3 -1000 1000 /end CHARACTERISTIC
/begin CHARACTERISTIC NGS_NMOT_NOCLOSE_DIAGIAE "Motordrehzahlgradient zur Erkennung 'IAE schließt nicht'" VALUE 0x1D8324 ZF_kw_si16_S5_S3 20000 UMR_U_MINSEC_1_1_0_S5_S3 -10000 10000 /end CHARACTERISTIC
/begin CHARACTERISTIC NO_NSOLL_NOCLOSE_DIAGIAE "Drehzahloffset auf Anfahrdrehzahl zur Erkennung übermäßig Schlupf" VALUE 0x1D8326 ZF_kw_si16_S5_S3 2000 UMR_U_MIN_1_1_0_S5_S3 -1000 1000 /end CHARACTERISTIC
/begin CHARACTERISTIC NO_VM_EHANF_IAE "Verbrennungsmotordrehzahlschwelle für Ubergang E- nach H-Anfahren" VALUE 0x1D8352 ZF_kw_si16_S5_S3 2000 UMR_U_MIN_1_1_0_S5_S3 -1000 1000 /end CHARACTERISTIC
/begin CHARACTERISTIC NS_AB_ANFAHRT_IAE "Abtriebsdrehzahlschwelle" VALUE 0x1D8354 ZF_kw_si16_S5_S3 1000 UMR_U_MIN_1_1_0_S5_S3 0 1000 /end CHARACTERISTIC
/begin CHARACTERISTIC NS_HYS_MOTKRIECH_IAE "Hysteresewert Motordrehzahlschwellwert für Übergang aus Angelegt nach Kriechen" VALUE 0x1D8358 ZF_kw_si16_S5_S3 1000 UMR_U_MIN_1_1_0_S5_S3 0 1000 /end CHARACTERISTIC
/begin CHARACTERISTIC NS_MOTKRIECH_IAE "Motordrehzahlschwellwert für Übergang aus Angelegt nach Kriechen" VALUE 0x1D8356 ZF_kw_si16_S5_S3 5000 UMR_U_MIN_1_1_0_S5_S3 0 5000 /end CHARACTERISTIC
/begin CHARACTERISTIC NS_NAB_CLOSE_DIAGIAE "Geschwindigkeitsschwelle Aktivierung Diagnose 'IAE öffnet nicht'" VALUE 0x1D8328 ZF_kw_si16_S5_S3 2000 UMR_U_MIN_1_1_0_S5_S3 -1000 1000 /end CHARACTERISTIC
/begin CHARACTERISTIC N_ABKODERA "Drehzahlschwelle Korrektur fehlerspezifischer Denominator UWIG" VALUE 0x1D82F4 ZF_kw_ui16_S5_S3 8000 UMR_U_MIN_1_1_0_S5_S3 0 8000 /end CHARACTERISTIC
/begin CHARACTERISTIC N_STOER_KFC_NOCLOSE_DIAGIAE "Auslöseschwelle Störzahler für Eintrag IAE_NOCLOSE" VALUE 0x1D778C ZF_kw_ui8_S5_S3 10 UMR___1_1_0_S5_S3 0 10 /end CHARACTERISTIC
/begin CHARACTERISTIC PDS_HYS_SCHLEIFE_IAE "Druckschwelle der Hysterseschleife" VALUE 0x1D8340 ZF_kw_si16_S5_S3 10 UMR_BAR__1_1000_0_S5_S3 -10 0 /end CHARACTERISTIC
/begin CHARACTERISTIC PG_HYSKOMP_ANGELEGT_MAX_IAE "max. Druckgradient für Hysteresekompensation im ANGELEGT" VALUE 0x1D8342 ZF_kw_si16_S5_S3 10 UMR_BAR_SEC_1_10_0_S5_S3 -10 0 /end CHARACTERISTIC
/begin CHARACTERISTIC PG_HYSKOMP_ANGELEGT_MIN_IAE "min. Druckgradient für Hysteresekompensation im ANGELEGT" VALUE 0x1D8344 ZF_kw_si16_S5_S3 10 UMR_BAR_SEC_1_10_0_S5_S3 -10 0 /end CHARACTERISTIC
/begin CHARACTERISTIC PO_HYSKOMP_ANGELEGT_ZIEL_IAE "Zielwert für PT!-Filter für Hysteresekompensation im ANGELEGT" VALUE 0x1D8346 ZF_kw_si16_S5_S3 2 UMR_BAR__1_1000_0_S5_S3 -2 0 /end CHARACTERISTIC
/begin CHARACTERISTIC PSTELL_ABBR_UEFIAE "Abbruchschwelle Anderung Stelldruck B" VALUE 0x1D8312 ZF_kw_si16_S5_S3 1 UMR_BAR__1_1000_0_S5_S3 0 1 /end CHARACTERISTIC
/begin CHARACTERISTIC PS_BREMS_NOOPEN_DIAGIAE "Bremsdruckschwelle Aktivierung Diagnose 'IAE öffnet nicht'" VALUE 0x1D832A ZF_kw_si16_S5_S3 100 UMR_BAR__1_100_0_S5_S3 0 100 /end CHARACTERISTIC
/begin CHARACTERISTIC PS_HYS_BREMS_IAE "Bremsdruckhysterese" VALUE 0x1D8350 ZF_kw_si16_S5_S3 20 UMR_BAR__1_100_0_S5_S3 0 20 /end CHARACTERISTIC
/begin CHARACTERISTIC PWS_KUEHL_INAKTIV_IAE "Schwelle für Reibleistung zur Deaktivierung der Kühlung" VALUE 0x1D8368 ZF_kw_ui16_S5_S3 100 UMR_KW__1_10_0_S5_S3 0 100 /end CHARACTERISTIC
/begin CHARACTERISTIC SWI_ANFAHRVERB_RS_IAE "Schalter zum Sperren des Übergangs SYNC/ZU nach ANFAHREN" VALUE 0x1D779A ZF_kw_bool8_S5_S3 1 UMR___1_1_0_S5_S3 0 1 /end CHARACTERISTIC
/begin CHARACTERISTIC SWI_ANGELEGT_SCHALT_IAE "Schalter, damit bei einer 2-1 ARS immer nach ANGELEGT gewechselt wird" VALUE 0x1D7798 ZF_kw_ui8_S5_S3 1 UMR___1_1_0_S5_S3 0 1 /end CHARACTERISTIC
/begin CHARACTERISTIC SWI_Auth_IgnOnWUPTo_AddCheck_KeyValidSts "switch to activate influence of KeyValidSts to elapsed tmr_Delay_KeyAuthWhileFACanFailure in authentication-condition" VALUE 0x191CB1 ZF_KW_NAT8_S1_S3 1 SBW_STANDARD_S1_S3 0 1 /end CHARACTERISTIC
/begin CHARACTERISTIC SWI_AutoP_DriverPresenceUnknown "Switch to activate Auto-P function if driver presence is unknown" VALUE 0x191C88 ZF_KW_NAT8_S1_S3 1 SBW_STANDARD_S1_S3 0 1 /end CHARACTERISTIC
/begin CHARACTERISTIC SWI_AutoP_DrvLeavesCar "Enable Auto Postion P for driver leaves car" VALUE 0x191C87 ZF_KW_NAT8_S1_S3 1 SBW_STANDARD_S1_S3 0 1 /end CHARACTERISTIC
/begin CHARACTERISTIC SWI_AutoP_DrvLeavesCar_L2 "Enable Auto Postion P for driver leaves car" VALUE 0x1D8EB8 ZF_KW_NAT8_S1_S3 1 SBW_STANDARD_S1_S3 0 1 /end CHARACTERISTIC
/begin CHARACTERISTIC SWI_AutoP_EMF_Help "Enable Auto Postion P for EMF Help Message" VALUE 0x191C86 ZF_KW_NAT8_S1_S3 1 SBW_STANDARD_S1_S3 0 1 /end CHARACTERISTIC
/begin CHARACTERISTIC SWI_AutoPos "Enable Auto Position (0=OFF 1=ON_but_no_HoldN 2=ON)" VALUE 0x191C85 ZF_KW_NAT8_S1_S3 2 SBW_STANDARD_S1_S3 0 2 /end CHARACTERISTIC
/begin CHARACTERISTIC SWI_AutoPos_L2 "L2 Enable Auto Position (0=OFF 1=ON_but_no_HoldN 2=ON)" VALUE 0x1D8EB4 ZF_KW_NAT8_S1_S3 2 SBW_STANDARD_S1_S3 0 2 /end CHARACTERISTIC
/begin CHARACTERISTIC SWI_CC "Enable CC Msgs" VALUE 0x191C9E ZF_KW_NAT8_S1_S3 1 SBW_STANDARD_S1_S3 0 1 /end CHARACTERISTIC
/begin CHARACTERISTIC SWI_CC_DrvLeavesCarBeltLocked "switch for message mode" VALUE 0x191C8C ZF_KW_NAT8_S1_S3 1 SBW_STANDARD_S1_S3 0 1 /end CHARACTERISTIC
/begin CHARACTERISTIC SWI_CC_Individual "Enable CC Msgs individually (be shure to differ btw. SBW and SBL)" CURVE 0x1922D8 ZF_TAB_NAT8_S1_S3 255 SBW_STANDARD_S1_S3 0 255
 /begin AXIS_DESCR FIX_AXIS NO_INPUT_QUANTITY SBW_STANDARD_S1_S3 40 0 39 READ_ONLY FIX_AXIS_PAR_DIST 0 1 40 /end AXIS_DESCR
/end CHARACTERISTIC
/begin CHARACTERISTIC SWI_DiActivateExtSubstFunct "switch for selecting active substitute functions (0x5A=intern and extern 0xA5=extern only others=intern only)" VALUE 0x191CDF ZF_KW_NAT8_S4_S3 255 EH_STANDARD_S4_S3 0 255 /end CHARACTERISTIC
/begin CHARACTERISTIC SWI_DiClearBkpErrMem "switch for clear up backup error memory. A change between 0x55 and 0xAA (85 and 170 dez) clears the backup error memory content" VALUE 0x191CDE ZF_KW_NAT8_S4_S3 255 EH_STANDARD_S4_S3 0 255 /end CHARACTERISTIC
/begin CHARACTERISTIC SWI_DiClearErrMem "switch for clear up error memory. A change between 0x55 and 0xAA (85 and 170 dez) clears the error memory content" VALUE 0x191CDD ZF_KW_NAT8_S4_S3 255 EH_STANDARD_S4_S3 0 255 /end CHARACTERISTIC
/begin CHARACTERISTIC SWI_DiErmComplementCheck "switch for ERM related complement check 0xA5=deactivated other=activated" VALUE 0x191CE8 ZF_KW_NAT8_S4_S3 255 EH_STANDARD_S4_S3 0 255 /end CHARACTERISTIC
/begin CHARACTERISTIC SWI_DiErmDeactivate "switch for ERM functionality 0xA5=deactivated other=activated" VALUE 0x191CE7 ZF_KW_NAT8_S4_S3 255 EH_STANDARD_S4_S3 0 255 /end CHARACTERISTIC
/begin CHARACTERISTIC SWI_DiGlobalCtrl "Global diagnosis switch (165=diagnosis deactivated and errmem cleared every power up; 170=diagnosis deactivated and errmem not cleared; 90=diagnosis activated and errmem cleared every power up; 0=diagnosis activated and errmem not cleared)" VALUE 0x191CDC ZF_KW_NAT8_S4_S3 170 EH_STANDARD_S4_S3 0 170 /end CHARACTERISTIC
/begin CHARACTERISTIC SWI_DiObdCommunicationAfterIgnitionOff "switch for handling OBD-Communication after Ignition Off (0=ECU responds requests only with ignition on, 1=ECU responds requests not depending on ignition state)" VALUE 0x191CDA ZF_KW_NAT8_S4_S3 1 EH_STANDARD_S4_S3 0 1 /end CHARACTERISTIC
/begin CHARACTERISTIC SWI_DiObdDrivingCycle "detection of driving-cycles 0=intern (by calculation) 1=intern (by 'engine running' signal) 2=extern (by 'driving cycle' signal via CAN)" VALUE 0x191CF0 ZF_KW_NAT8_S4_S3 2 EH_STANDARD_S4_S3 0 2 /end CHARACTERISTIC
/begin CHARACTERISTIC SWI_DiObdIumprIgnitionCycle "detection of ignition-cycle counter 0=intern 1=extern" VALUE 0x191CF8 ZF_KW_NAT8_S4_S3 1 EH_STANDARD_S4_S3 0 1 /end CHARACTERISTIC
/begin CHARACTERISTIC SWI_DiObdIumprReset "reset the IUMPR data with every change between 0x55 and 0xAA" VALUE 0x191CF7 ZF_KW_NAT8_S4_S3 255 EH_STANDARD_S4_S3 0 255 /end CHARACTERISTIC
/begin CHARACTERISTIC SWI_DiObdNormTripB "selection of norm trip B calculation 0=intern 1=extern" VALUE 0x191CEC ZF_KW_NAT8_S4_S3 1 EH_STANDARD_S4_S3 0 1 /end CHARACTERISTIC
/begin CHARACTERISTIC SWI_DiObdPermanentFault_0 "switch for activating permanent fault code handling and Mode 0A for variant 0 (0=disable 1=enable)" VALUE 0x191CEE ZF_KW_NAT8_S4_S3 1 EH_STANDARD_S4_S3 0 1 /end CHARACTERISTIC
/begin CHARACTERISTIC SWI_DiObdPermanentFault_1 "switch for activating permanent fault code handling and Mode 0A for variant 1 (0=disable 1=enable)" VALUE 0x191CED ZF_KW_NAT8_S4_S3 1 EH_STANDARD_S4_S3 0 1 /end CHARACTERISTIC
/begin CHARACTERISTIC SWI_DiObdPermanentModeA "displaying permanent fault codes in Mode 0A 0=at once 1=next ignition cycle" VALUE 0x191CEF ZF_KW_NAT8_S4_S3 1 EH_STANDARD_S4_S3 0 1 /end CHARACTERISTIC
/begin CHARACTERISTIC SWI_DiObdResponseMode "response mode for mode 09 pid 06 data not available (0=response pending for timeout time 1=send single NRC22 immediately)" VALUE 0x191CDB ZF_KW_NAT8_S4_S3 1 EH_STANDARD_S4_S3 0 1 /end CHARACTERISTIC
/begin CHARACTERISTIC SWI_DiObdWarmUpCycle "detection of WarmUp-cycles 0=intern 1=extern" VALUE 0x191CE9 ZF_KW_NAT8_S4_S3 1 EH_STANDARD_S4_S3 0 1 /end CHARACTERISTIC
/begin CHARACTERISTIC SWI_DiagPos "Enable Diag Position" VALUE 0x191CA0 ZF_KW_NAT8_S1_S3 1 SBW_STANDARD_S1_S3 0 1 /end CHARACTERISTIC
/begin CHARACTERISTIC SWI_DiagPosDrvAssist "switch used to deactivate effect of FAS-error flag f_DrvAssistPosModeErr on diagpos P or N" VALUE 0x191CA2 ZF_KW_NAT8_S1_S3 1 SBW_STANDARD_S1_S3 0 1 /end CHARACTERISTIC
/begin CHARACTERISTIC SWI_DiagPosInWrongDrvDir "Switch for diagnosis position N due to wrong driving direction" VALUE 0x191CA3 ZF_KW_NAT8_S1_S3 1 SBW_STANDARD_S1_S3 0 1 /end CHARACTERISTIC
/begin CHARACTERISTIC SWI_DiagPosUWIG "Enable Diag Position by UWIG Symptom" VALUE 0x191CA1 ZF_KW_NAT8_S1_S3 7 SBW_STANDARD_S1_S3 0 7 /end CHARACTERISTIC
/begin CHARACTERISTIC SWI_DispExtension "Switch to determine behaviour of display-pos. in overshoot state: 0=disp.pos immediately dark / 1=not dark after EGS sleep-ready" VALUE 0x191C93 ZF_KW_NAT8_S1_S3 1 SBW_STANDARD_S1_S3 0 1 /end CHARACTERISTIC
/begin CHARACTERISTIC SWI_DispMode "Select Display Mode 0=NoMode 1=SBW 2=FS-driving strategy" VALUE 0x191C91 ZF_KW_NAT8_S1_S3 2 SBW_STANDARD_S1_S3 0 2 /end CHARACTERISTIC
/begin CHARACTERISTIC SWI_DispPosInStandby "Select if position displayed or dark in State Standby before Cruise / f_IgnOnNeverDetected 0=off/dark 1=on" VALUE 0x191C92 ZF_KW_NAT8_S1_S3 1 SBW_STANDARD_S1_S3 0 1 /end CHARACTERISTIC
/begin CHARACTERISTIC SWI_Ews4_E_Label "switch to avoid locking EWS4-secret key in TCU" VALUE 0x191CA7 ZF_KW_NAT8_S1_S3 1 SBW_STANDARD_S1_S3 0 1 /end CHARACTERISTIC
/begin CHARACTERISTIC SWI_FAS_Active "activation-switch for PMA/RCP-functionality" VALUE 0x191C8F ZF_KW_NAT8_S1_S3 1 SBW_STANDARD_S1_S3 0 1 /end CHARACTERISTIC
/begin CHARACTERISTIC SWI_FAS_Active_L2 "L2 activation-switch for PMA/RCP-functionality" VALUE 0x1D8EBB ZF_KW_NAT8_S1_S3 1 SBW_STANDARD_S1_S3 0 1 /end CHARACTERISTIC
/begin CHARACTERISTIC SWI_GangnachfuehrungAktiv "Schalter fuer die Aktivierung der Berechnung waehrend Gangnachfuehrung" VALUE 0x191C79 ZF_KW_NAT8_S2_S3 1 SAB_STANDARD_S2_S3 0 1 /end CHARACTERISTIC
/begin CHARACTERISTIC SWI_GbxTempReqP "Switch to activate Diag-P due to GB temperature" VALUE 0x191CA6 ZF_KW_NAT8_S1_S3 1 SBW_STANDARD_S1_S3 0 1 /end CHARACTERISTIC
/begin CHARACTERISTIC SWI_HSCHALTVERHIAE_ZZS "Hochschaltverhinderung" VALUE 0x1D7797 ZF_kw_bool8_S5_S3 1 UMR___1_1_0_S5_S3 0 1 /end CHARACTERISTIC
/begin CHARACTERISTIC SWI_HotmodeOilChipStsActivation "switch for activating of Hotmode Levels if state of oil- and Chiptemperature is niO" VALUE 0x191CBE ZF_KW_NAT8_S1_S3 3 SBW_STANDARD_S1_S3 0 3 /end CHARACTERISTIC
/begin CHARACTERISTIC SWI_JumpstartN "Switch for Jumpstart in Position N" VALUE 0x191C80 ZF_KW_NAT8_S2_S3 1 SAB_STANDARD_S2_S3 0 1 /end CHARACTERISTIC
/begin CHARACTERISTIC SWI_KL15_PinPlausiOn "Switch for ignition on substitute signal because of SAB plausibilisation" VALUE 0x191CBF ZF_KW_NAT8_S1_S3 1 SBW_STANDARD_S1_S3 0 1 /end CHARACTERISTIC
/begin CHARACTERISTIC SWI_KL15_PinPlausiOn_L2 "Switch for ignition on substitute signal because of SAB plausibilisation" VALUE 0x1D8EBC ZF_KW_NAT8_S1_S3 1 SBW_STANDARD_S1_S3 0 1 /end CHARACTERISTIC
/begin CHARACTERISTIC SWI_M_BASIS_ANFAHRT_E_IAE "Schalter zur Wahl des Basismoments im Anfahren" VALUE 0x1D7786 ZF_kw_ui8_S5_S3 3 UMR___1_1_0_S5_S3 1 4 /end CHARACTERISTIC
/begin CHARACTERISTIC SWI_M_BASIS_ANFAHRT_H_IAE "Schalter zur Wahl des Basismoments im Anfahren" VALUE 0x1D7787 ZF_kw_ui8_S5_S3 3 UMR___1_1_0_S5_S3 1 4 /end CHARACTERISTIC
/begin CHARACTERISTIC SWI_ModeEnabledAFIX "Enable ModeRequest bit if AFIX (bit0 ... bit7)" VALUE 0x191CB3 ZF_KW_NAT8_S1_S3 255 SBW_STANDARD_S1_S3 0 255 /end CHARACTERISTIC
/begin CHARACTERISTIC SWI_NDMOT_DIAGIAE "Schalter zur Auswahl der x-Eingangsgröße für KF_MDI_DIAGIAE" VALUE 0x1D7788 ZF_kw_bool8_S5_S3 1 UMR___1_1_0_S5_S3 0 1 /end CHARACTERISTIC
/begin CHARACTERISTIC SWI_NTVIRTGBBZUG "Schalter fuer Auswahl ob waehrend Gegenbremsbetrieb nur Zugfall betrachtet werden soll" VALUE 0x191C7A ZF_KW_NAT8_S2_S3 1 SAB_STANDARD_S2_S3 0 1 /end CHARACTERISTIC
/begin CHARACTERISTIC SWI_NoDrvAssist_ViaSubstFunct "activated influence of subst-actions in DI_GET_ALL_SUBST_FUNCT for PMA/RCP-functionality" VALUE 0x192218 ZF_KW_NAT32_S1_S3 4294970000 SBW_STANDARD_S1_S3 0 4294967295 /end CHARACTERISTIC
/begin CHARACTERISTIC SWI_NoDrvAssist_ViaSubstFunct_Hi "activated influence of subst-actions in DI_GET_ALL_SUBST_FUNCT_HI for PMA/RCP-functionality" VALUE 0x19221C ZF_KW_NAT32_S1_S3 4294970000 SBW_STANDARD_S1_S3 0 4294967295 /end CHARACTERISTIC
/begin CHARACTERISTIC SWI_PO_DYN_ANFAHR_IAE "Schalter zum Erlauben des dynamischen Druckoffsets" VALUE 0x1D7793 ZF_kw_bool8_S5_S3 1 UMR___1_1_0_S5_S3 0 1 /end CHARACTERISTIC
/begin CHARACTERISTIC SWI_PO_DYN_KRIECH_IAE "Schalter zum Erlauben des dynamischen Druckoffsets" VALUE 0x1D7792 ZF_kw_bool8_S5_S3 1 UMR___1_1_0_S5_S3 0 1 /end CHARACTERISTIC
/begin CHARACTERISTIC SWI_SCHALTVERHIAE_ZZS "Schaltverhinderung im Anfahren" VALUE 0x1D7796 ZF_kw_bool8_S5_S3 1 UMR___1_1_0_S5_S3 0 1 /end CHARACTERISTIC
/begin CHARACTERISTIC SWI_SSGWS "switch for two different 'SchaltSchema GetriebeWahlSchalter': 0=shift from P/N to R by single OR double position forward / shift from P/N to D by single OR double position backward 1=shift from P/N to R only by double position forward / shift from P/N to " VALUE 0x191C95 ZF_KW_NAT8_S1_S3 1 SBW_STANDARD_S1_S3 0 1 /end CHARACTERISTIC
/begin CHARACTERISTIC SWI_SSGWS_L2 "Attention: Same value as SWI_SSGWS otherwise KFC3_LEV2" VALUE 0x1D8EB0 ZF_KW_NAT8_S1_S3 1 SBW_STANDARD_S1_S3 0 1 /end CHARACTERISTIC
/begin CHARACTERISTIC SWI_Shiftlock_Disable "select disable ShiftLock: b0=CAN b1=remote start b2=n_Eng b3=brake b4=theft protection" VALUE 0x191B80 ZF_KW_NAT16_S1_S3 65535 SBW_STANDARD_S1_S3 0 65535 /end CHARACTERISTIC
/begin CHARACTERISTIC SWI_SrvcMsg_Enable "en-/disable srvc. CAN-messages" VALUE 0x191C97 ZF_KW_NAT8_S1_S3 1 SBW_STANDARD_S1_S3 0 1 /end CHARACTERISTIC
/begin CHARACTERISTIC SWI_StarterReleaseDelayOn "switch for Starter Release Delay" VALUE 0x191C98 ZF_KW_NAT8_S1_S3 1 SBW_STANDARD_S1_S3 0 1 /end CHARACTERISTIC
/begin CHARACTERISTIC SWI_StoreMode "Pos D Init Mode is last Mode if enabled (bit0=Sport bit1=Manual Normal bit2=Manual Sport) otherwise adaptive" VALUE 0x191CB4 ZF_KW_NAT8_S1_S3 7 SBW_STANDARD_S1_S3 0 7 /end CHARACTERISTIC
/begin CHARACTERISTIC SWI_StoreOnN "Enable Storage of Postion N" VALUE 0x191C9C ZF_KW_NAT8_S1_S3 1 SBW_STANDARD_S1_S3 0 1 /end CHARACTERISTIC
/begin CHARACTERISTIC SWI_StoreOnP "Enable Storage of Postion P" VALUE 0x191C9A ZF_KW_NAT8_S1_S3 1 SBW_STANDARD_S1_S3 0 1 /end CHARACTERISTIC
/begin CHARACTERISTIC SWI_StoreOnRD "Enable Storage of Postion RD" VALUE 0x191C99 ZF_KW_NAT8_S1_S3 1 SBW_STANDARD_S1_S3 0 1 /end CHARACTERISTIC
/begin CHARACTERISTIC SWI_WheelActivePassive "Switch for selection of driven axle 0=no axle; 1=front wheel drive; 2=rear wheel drive; 3=fourwheel drive" VALUE 0x191C84 ZF_KW_NAT8_S2_S3 3 SAB_STANDARD_S2_S3 0 3 /end CHARACTERISTIC
/begin CHARACTERISTIC SWI_WheelUseAbsVal "Appplication switch for choosing absolut value of wheel speed (0 = signed; 1 = absolute)" VALUE 0x191C83 ZF_KW_NAT8_S2_S3 1 SAB_STANDARD_S2_S3 0 1 /end CHARACTERISTIC
/begin CHARACTERISTIC SWI_n6_InitControlActive "Schalter zur Aktivierung der Geisterdrehzahlunterdrueckung" VALUE 0x191C78 ZF_KW_NAT8_S2_S3 1 SAB_STANDARD_S2_S3 0 1 /end CHARACTERISTIC
/begin CHARACTERISTIC SWI_v_IstMaxCalc "Switch for selection when GET_VIST_MAX uses maximum-choise 0=not; 1=when nAb to nWheel is unplausible; 2=allways" VALUE 0x191C7C ZF_KW_NAT8_S2_S3 2 SAB_STANDARD_S2_S3 0 2 /end CHARACTERISTIC
/begin CHARACTERISTIC TAB_MIN_ND_IAEKFMUE_ENTKOPPL "Zustandsabhängige Mindestdifferenzdrehzahl für Kennfeldzugriff KF_MUE_IAE" CURVE 0x19C6E8 ZF_tab_si16_S5_S3 2000 UMR_U_MIN_1_1_0_S5_S3 0 2000
 /begin AXIS_DESCR FIX_AXIS iKasEkopl.z_entkoppeln UMR___1_1_0_S5_S3 4 0 3 READ_ONLY FIX_AXIS_PAR_DIST 0 1 4 /end AXIS_DESCR
/end CHARACTERISTIC
/begin CHARACTERISTIC TAB_MIN_ND_IAEKFMUE_IAE "Zustandsabhängige Mindestdifferenzdrehzahl für Kennfeldzugriff KF_MUE_IAE" CURVE 0x19C6D0 ZF_tab_si16_S5_S3 2000 UMR_U_MIN_1_1_0_S5_S3 0 2000
 /begin AXIS_DESCR FIX_AXIS iIaeKordi.z_iae UMR___1_1_0_S5_S3 10 0 9 READ_ONLY FIX_AXIS_PAR_DIST 0 1 10 /end AXIS_DESCR
/end CHARACTERISTIC
/begin CHARACTERISTIC TAB_MPT_P_HYS_SCHLEIFE_IAE "Filterkonstante für PT1-Filter für Druck am Ende der Hystereseschleife" CURVE 0x19C5FC ZF_tab_ui8_S5_S3 1 UMR___1_100_0_S5_S3 0 1
 /begin AXIS_DESCR FIX_AXIS NO_INPUT_QUANTITY UMR___1_1_0_S5_S3 10 0 9 READ_ONLY FIX_AXIS_PAR_DIST 0 1 10 /end AXIS_DESCR
/end CHARACTERISTIC
/begin CHARACTERISTIC TAB_MTM_MOT_UEFIAE "Summe Massenträgheitsmoment vor Getriebe" CURVE 0x19B58C ZF_tab_ui8_S5_S3 1 UMR_KGM2__1_100_0_S5_S3 0 1
 /begin AXIS_DESCR FIX_AXIS iItfInput.z_modus_iae UMR___1_1_0_S5_S3 3 0 2 READ_ONLY FIX_AXIS_PAR_DIST 0 1 3 /end AXIS_DESCR
/end CHARACTERISTIC
/begin CHARACTERISTIC TAB_MVG_MSTELL_IAE "Grenzen der Teilintervalle für das Stellmoment der IAE" CURVE 0x19C770 ZF_tab_si16_S5_S3 2500 UMR_NM__1_1_0_S5_S3 -500 2000
 /begin AXIS_DESCR FIX_AXIS NO_INPUT_QUANTITY UMR___1_1_0_S5_S3 7 0 6 READ_ONLY FIX_AXIS_PAR_DIST 0 1 7 /end AXIS_DESCR
/end CHARACTERISTIC
/begin CHARACTERISTIC TAB_MVG_ND_IAE "Grenzen der Teilintervalle für die Differenzdrehzahl der IAE" CURVE 0x19C75C ZF_tab_si16_S5_S3 4000 UMR_U_MIN_1_1_0_S5_S3 -2000 2000
 /begin AXIS_DESCR FIX_AXIS NO_INPUT_QUANTITY UMR___1_1_0_S5_S3 7 0 6 READ_ONLY FIX_AXIS_PAR_DIST 0 1 7 /end AXIS_DESCR
/end CHARACTERISTIC
/begin CHARACTERISTIC TAB_P_HYS_SCHLEIFE_IAE "Fußpunktdruck der Hysterseschleife" CURVE 0x19C60C ZF_tab_si16_S5_S3 20 UMR_BAR__1_1000_0_S5_S3 -10 10
 /begin AXIS_DESCR FIX_AXIS NO_INPUT_QUANTITY UMR___1_1_0_S5_S3 10 0 9 READ_ONLY FIX_AXIS_PAR_DIST 0 1 10 /end AXIS_DESCR
/end CHARACTERISTIC
/begin CHARACTERISTIC TAB_SWI_HYS_SCHLEIFE_IAE "Schalter zur Aktivierung der Hysterseschleife" CURVE 0x19C624 ZF_tab_bool8_S5_S3 1 UMR___1_1_0_S5_S3 0 1
 /begin AXIS_DESCR FIX_AXIS iIaeKordi.z_iae UMR___1_1_0_S5_S3 10 0 9 READ_ONLY FIX_AXIS_PAR_DIST 0 1 10 /end AXIS_DESCR
/end CHARACTERISTIC
/begin CHARACTERISTIC TAB_T_P_HYS_SCHLEIFE_IAE "Zeit für die Dauer der Hystereseschleife" CURVE 0x19C5EC ZF_tab_ui8_S5_S3 500 UMR_MSEC__10_1_0_S5_S3 0 500
 /begin AXIS_DESCR FIX_AXIS NO_INPUT_QUANTITY UMR___1_1_0_S5_S3 10 0 9 READ_ONLY FIX_AXIS_PAR_DIST 0 1 10 /end AXIS_DESCR
/end CHARACTERISTIC
/begin CHARACTERISTIC TAB_ZMODUS_CLOSE_DIAGIAE "Auswahl der IAE Betriebszustände in denen IAE_CLOSE überwacht wird" CURVE 0x19C4DC ZF_tab_bool8_S5_S3 1 UMR___1_1_0_S5_S3 0 1
 /begin AXIS_DESCR FIX_AXIS NO_INPUT_QUANTITY UMR___1_1_0_S5_S3 3 0 2 READ_ONLY FIX_AXIS_PAR_DIST 0 1 3 /end AXIS_DESCR
/end CHARACTERISTIC
/begin CHARACTERISTIC TAB_ZMODUS_NOOPEN_DIAGIAE "Auswahl der IAE Betriebszustände in denen IAE_NOOPEN überwacht wird" CURVE 0x19C4E4 ZF_tab_bool8_S5_S3 1 UMR___1_1_0_S5_S3 0 1
 /begin AXIS_DESCR FIX_AXIS NO_INPUT_QUANTITY UMR___1_1_0_S5_S3 3 0 2 READ_ONLY FIX_AXIS_PAR_DIST 0 1 3 /end AXIS_DESCR
/end CHARACTERISTIC
/begin CHARACTERISTIC TS_AX_CLOSE_DIAGIAE "Integrationzeit zu AXS_CLOSE_DIAGIAE" VALUE 0x1D833C ZF_kw_ui16_S5_S3 1000 UMR_MSEC__10_1_0_S5_S3 0 1000 /end CHARACTERISTIC
/begin CHARACTERISTIC TS_EFAHREN_IAE "Zeitschwelle für z_modus_iae im E-Fahren (Schlupf) für Anforderung einer minimalen EM-Drehzahl" VALUE 0x1D779E ZF_kw_ui8_S5_S3 2550 UMR_MSEC__10_1_0_S5_S3 0 2550 /end CHARACTERISTIC
/begin CHARACTERISTIC TS_INITHYS_SCHLEIFE_IAE "Zeitschwelle zur Auslösung der Hystereseschleife bei Zustandsübergängen" VALUE 0x1D833E ZF_kw_ui16_S5_S3 2550 UMR_MSEC__10_1_0_S5_S3 0 2550 /end CHARACTERISTIC
/begin CHARACTERISTIC T_KUEHL_INAKTIV_IAE "Dauer der Nachkühlung im Zustand zu" VALUE 0x1D836A ZF_kw_ui16_S5_S3 300 UMR_SEC__1_100_0_S5_S3 0 300 /end CHARACTERISTIC
/begin CHARACTERISTIC T_LAUF_UEFIAE "Adaptionsdauer" VALUE 0x1D7785 ZF_kw_ui8_S5_S3 1000 UMR_MSEC__10_1_0_S5_S3 0 1000 /end CHARACTERISTIC
/begin CHARACTERISTIC T_LWREAKT_DIAGIAE "Aktivierungsverzögerung der Diagnose um Lastwechselreaktionen auszublenden" VALUE 0x1D8330 ZF_kw_ui16_S5_S3 10000 UMR_MSEC__10_1_0_S5_S3 0 10000 /end CHARACTERISTIC
/begin CHARACTERISTIC T_NDS_ZU_IAE "Zeit wie lange die Schwelle NDS_ZU unterschritten sein muss für UE_SCHLIESSEN_ZU" VALUE 0x1D779C ZF_kw_ui8_S5_S3 2550 UMR_MSEC__10_1_0_S5_S3 0 2550 /end CHARACTERISTIC
/begin CHARACTERISTIC T_ND_RESET_DIAGIAE "Erkennungsdauer Gutprüfung zur Fehlerrückfilterung" VALUE 0x1D8332 ZF_kw_ui16_S5_S3 10000 UMR_MSEC__10_1_0_S5_S3 0 10000 /end CHARACTERISTIC
/begin CHARACTERISTIC T_NOCLOSE_DIAGIAE "Mindestdauer Erkennung 'IAE schließt nicht'" VALUE 0x1D832C ZF_kw_ui16_S5_S3 10000 UMR_MSEC__10_1_0_S5_S3 0 10000 /end CHARACTERISTIC
/begin CHARACTERISTIC T_NOOPEN_DIAGIAE "Mindestdauer Erkennung 'IAE oeffnet nicht'" VALUE 0x1D832E ZF_kw_ui16_S5_S3 10000 UMR_MSEC__10_1_0_S5_S3 0 10000 /end CHARACTERISTIC
/begin CHARACTERISTIC T_RAMAXSNYC_IAE "Zeit wie lange die Schwelle NDS_ZU unterschritten sein muss für UE_SCHLIESSEN_ZU" VALUE 0x1D835C ZF_kw_ui16_S5_S3 5000 UMR_MSEC__10_1_0_S5_S3 0 5000 /end CHARACTERISTIC
/begin CHARACTERISTIC T_VERZ_HOT_DIAGIAE "Verzögerung des Fehlerspeichereintrags KFC_IAEHOT" VALUE 0x1D8334 ZF_kw_ui16_S5_S3 10000 UMR_MSEC__10_1_0_S5_S3 0 10000 /end CHARACTERISTIC
/begin CHARACTERISTIC VDS_WHEEL_CLOSE_DIAGIAE "max-zul. Raddifferenzdrehzahl zur Aktivierung der Diagnosen" VALUE 0x1D8336 ZF_kw_ui16_S5_S3 10 UMR_KM_H_1_16_0_S5_S3 0 10 /end CHARACTERISTIC
/begin CHARACTERISTIC VP_KUEHLOFFEN_IAE "Kuehloelmenge bei offener IAE, wenn diese aktiviert wird" VALUE 0x1D8370 ZF_kw_si16_S5_S3 50 UMR_LITER_MIN_1_10_0_S5_S3 0 50 /end CHARACTERISTIC
/begin CHARACTERISTIC VP_KUEHL_MAX_IAE "Maximale Kühlölmenge bei aktivier Kühlung" VALUE 0x1D8364 ZF_kw_si16_S5_S3 50 UMR_LITER_MIN_1_10_0_S5_S3 0 50 /end CHARACTERISTIC
/begin FUNCTION jData_zf_SAB_TurbineSpeedVirtualIn_Fktn "Calibration values of the Instance jData_zf_SAB_TurbineSpeedVirtualIn"
 /begin DEF_CHARACTERISTIC D_i_TargetGear D_k_AbTuVirtNew D_k_AbTuVirtOld D_k_DifIAENew D_k_DifIAEOld D_k_EngTuVirtNew D_k_EngTuVirtOld D_k_TuVirtNew D_k_TuVirtOld D_k_n6 D_k_n6TuVirtNew D_k_n6TuVirtOld D_k_nab D_k_nmot D_n_Ab_Min_nTOpt D_n_Dif_IAEerkannt D_n_Dif_IAEerkanntGANG D_n_Dif_IAEerkanntHYS D_n_Dif_IAEerkanntKUP D_n_TuVirt_Direction D_n_TuVirt_DirectionHYS D_t_n6TuVirtSync D_t_nAbTuVirtSync D_t_nEngTuVirtSync D_t_n_Dif_IAEerkannt SWI_GangnachfuehrungAktiv SWI_NTVIRTGBBZUG SWI_n6_InitControlActive /end DEF_CHARACTERISTIC
/end FUNCTION
/begin FUNCTION jData_zf_SAB_TurbineTorqueIn_Fktn "Calibration values of the Instance jData_zf_SAB_TurbineTorqueIn" /begin DEF_CHARACTERISTIC D_dc_Offset /end DEF_CHARACTERISTIC /end FUNCTION
/begin FUNCTION jData_zf_SAB_VehicleSpeedIn_Fktn "Calibration values of the Instance jData_zf_SAB_VehicleSpeedIn" /begin DEF_CHARACTERISTIC D_t_DelayVIstMaxCalc SWI_v_IstMaxCalc /end DEF_CHARACTERISTIC /end FUNCTION
/begin FUNCTION jData_zf_SAB_VoltageMonitoringOut_Fktn "Calibration values of the Instance jData_zf_SAB_VoltageMonitoringOut"
 /begin DEF_CHARACTERISTIC D_n_EngLThJump D_n_EngLth_UBATTU_UBATTL_UBATTO D_n_EngUThJump D_t_Batt_UBATTU D_t_DiagActive_UBATTL D_t_DiagActive_UBATTU D_t_JumpstartTh D_tmr_GearSubstLSSOFF D_u_BattLthFix_UBATTU D_u_BattLth_UBATTL D_u_BattLth_UBATTU D_u_BattThHys_UBATTL D_u_BattUth_UBATTO SWI_JumpstartN /end DEF_CHARACTERISTIC
/end FUNCTION
/begin FUNCTION jData_zf_SAB_WheelIn_Fktn "Calibration values of the Instance jData_zf_SAB_WheelIn"
 /begin DEF_CHARACTERISTIC D_k_AbNew D_k_AbOld D_lfz_Wheel SWI_WheelActivePassive SWI_WheelUseAbsVal /end DEF_CHARACTERISTIC
/end FUNCTION
/begin FUNCTION jData_zff_ABK_AUTOPOS_Fktn "Calibration values of the Instance jData_zff_ABK_AUTOPOS"
 /begin DEF_CHARACTERISTIC D_st_VehDrvRdy D_v_AutoP_DrvLeavesCar D_v_AutoP_DrvPresenceUnknown_Uth D_v_AutoP_Uth D_v_EnableAutoPHelp SWI_AutoP_DriverPresenceUnknown SWI_AutoP_DrvLeavesCar SWI_AutoP_EMF_Help SWI_AutoPos /end DEF_CHARACTERISTIC
/end FUNCTION
/begin FUNCTION jData_zff_ABK_CARWASHMODE_Fktn "Calibration values of the Instance jData_zff_ABK_CARWASHMODE" /begin DEF_CHARACTERISTIC D_v_HoldN /end DEF_CHARACTERISTIC /end FUNCTION
/begin FUNCTION jData_zff_ABK_CC_MSG_Fktn "Calibration values of the Instance jData_zff_ABK_CC_MSG"
 /begin DEF_CHARACTERISTIC D_CC_ID D_CC_Prio D_Tab_LockCond D_c_TOilCCML_Th D_t_CC_CycleTime D_t_CC_MinTime D_t_CC_delay D_type_CC D_v_CC D_v_CC_Parklock_Lth SWI_CC SWI_CC_Individual /end DEF_CHARACTERISTIC
/end FUNCTION
/begin FUNCTION jData_zff_ABK_DEBOUNCEDRVREQ_Fktn "Calibration values of the Instance jData_zff_ABK_DEBOUNCEDRVREQ" /begin DEF_CHARACTERISTIC D_t_DebounceNA2N D_t_DebounceRD2N D_v_DebounceNA2NUth /end DEF_CHARACTERISTIC /end FUNCTION
/begin FUNCTION jData_zff_ABK_DIAGPOS_Fktn "Calibration values of the Instance jData_zff_ABK_DIAGPOS"
 /begin DEF_CHARACTERISTIC D_ang_GbxTempReqP D_c_GbxTempReqP D_t_DelayGbxTempReqP_Lth D_t_DelayGbxTempReqP_Uth D_t_FlashDiagPosInWrongDrvDir D_v_GbxTempReqP_Lth D_v_GbxTempReqP_Uth D_v_WrongDrvDir SWI_DiagPos SWI_DiagPosDrvAssist SWI_DiagPosInWrongDrvDir SWI_DiagPosUWIG SWI_GbxTempReqP /end DEF_CHARACTERISTIC
/end FUNCTION
/begin FUNCTION jData_zff_ABK_DRVPRESENCEDETECTOR_Fktn "Calibration values of the Instance jData_zff_ABK_DRVPRESENCEDETECTOR" /begin DEF_CHARACTERISTIC D_t_DrvLeavesCarInN SWI_CC_DrvLeavesCarBeltLocked /end DEF_CHARACTERISTIC /end FUNCTION
/begin FUNCTION jData_zff_ABK_ENGINESIGNALS_Fktn "Calibration values of the Instance jData_zff_ABK_ENGINESIGNALS" /begin DEF_CHARACTERISTIC D_t_DebounceGearboxReady D_t_DebounceGearboxReadySts /end DEF_CHARACTERISTIC /end FUNCTION
/begin FUNCTION jData_zff_ABK_EWS4_Fktn "Calibration values of the Instance jData_zff_ABK_EWS4"
 /begin DEF_CHARACTERISTIC D_Rsp_ErrCnt_FctCRafterCalcSK_Max_B D_Rsp_ErrCnt_SK_avail_Max_A D_Rsp_ErrCnt_SK_unavail_Max_C D_Rsp_OkCnt_FctCRafterCalcSK_Min_Ok D_n_Ab_AllowFSC_Uth D_n_Uth_MissingRspSwitchCANpath D_n_Uth_cnt_TASCASReq D_t_Delay_AfterSleepInd_BeforeLockEGS D_t_Delay_KeyAuthWhileFACanFailure D_t_Delay_WaitTasCasRequest D_t_Min_RxRspUntilTxChal D_t_Min_TASCASReq D_t_Min_TxChalUntilTxChal_NoRsp D_t_Prevent_KFC_EWSDRVRQ D_t_TO_EEprom_StoreImmediate D_t_TO_RxKFAfterTxKF_Id_2 D_t_TO_RxRspAfterTxChal_Id_1 D_t_TO_StoreCheckFSC SWI_Auth_IgnOnWUPTo_AddCheck_KeyValidSts SWI_Ews4_E_Label /end DEF_CHARACTERISTIC
/end FUNCTION
/begin FUNCTION jData_zff_ABK_FASREQ2POS_Fktn "Calibration values of the Instance jData_zff_ABK_FASREQ2POS"
 /begin DEF_CHARACTERISTIC SWI_FAS_Active SWI_NoDrvAssist_ViaSubstFunct SWI_NoDrvAssist_ViaSubstFunct_Hi /end DEF_CHARACTERISTIC
/end FUNCTION
/begin FUNCTION jData_zff_ABK_KOMBI_MSG_Fktn "Calibration values of the Instance jData_zff_ABK_KOMBI_MSG" /begin DEF_CHARACTERISTIC D_t_IgnOnNeverDetected D_t_P12BadOpDisp /end DEF_CHARACTERISTIC /end FUNCTION
/begin FUNCTION jData_zff_ABK_KOMBIMSGFLASH_Fktn "Calibration values of the Instance jData_zff_ABK_KOMBIMSGFLASH" /begin DEF_CHARACTERISTIC D_t_FlashN /end DEF_CHARACTERISTIC /end FUNCTION
/begin FUNCTION jData_zff_ABK_KOMBIMSGGEAR_Fktn "Calibration values of the Instance jData_zff_ABK_KOMBIMSGGEAR"
 /begin DEF_CHARACTERISTIC D_GearSourceAtFlashOffEngRunning D_GearSourceAtFlashOnEngRunning /end DEF_CHARACTERISTIC
/end FUNCTION
/begin FUNCTION jData_zff_ABK_KOMBIMSGMODE_Fktn "Calibration values of the Instance jData_zff_ABK_KOMBIMSGMODE" /begin DEF_CHARACTERISTIC SWI_DispMode /end DEF_CHARACTERISTIC /end FUNCTION
/begin FUNCTION jData_zff_ABK_KOMBIMSGPOS_Fktn "Calibration values of the Instance jData_zff_ABK_KOMBIMSGPOS" /begin DEF_CHARACTERISTIC SWI_DispExtension SWI_DispPosInStandby /end DEF_CHARACTERISTIC /end FUNCTION
/begin FUNCTION jData_zff_ABK_LEVEL2DIAG_Fktn "Calibration values of the Instance jData_zff_ABK_LEVEL2DIAG"
 /begin DEF_CHARACTERISTIC D_AcceleratorPedalAngleTh_L2 D_n_AbPosDirD_Lth_L2 D_n_AbPosDirP_Uth_L2 D_t_DebounceGearboxReadySts_L2 D_t_DebounceGearboxReady_L2 D_t_DebounceNA2N_L2 D_t_DebounceRD2N_L2 D_t_FlashN_L2 D_t_Lev2DispError D_t_Lev2DispError_L2 D_t_StoreN_L2 D_t_StoreRD_L2 D_v_AutoN_Uth_L2 D_v_AutoP_DrvLeavesCar_L2 D_v_AutoP_Uth_L2 D_v_N_Uth_L2 D_v_P_Lth_L2 D_v_R_Uth_L2 D_v_Shiftlock_Uth_L2 SWI_AutoP_DrvLeavesCar_L2 SWI_AutoPos_L2 SWI_FAS_Active_L2 SWI_KL15_PinPlausiOn_L2 SWI_SSGWS_L2 /end DEF_CHARACTERISTIC
/end FUNCTION
/begin FUNCTION jData_zff_ABK_MODE_Fktn "Calibration values of the Instance jData_zff_ABK_MODE"
 /begin DEF_CHARACTERISTIC D_t_ModeReturnTip1 D_t_ModeReturnTip2 SWI_ModeEnabledAFIX SWI_StoreMode /end DEF_CHARACTERISTIC
/end FUNCTION
/begin FUNCTION jData_zff_ABK_MODECHTABLE_Fktn "Calibration values of the Instance jData_zff_ABK_MODECHTABLE"
 /begin DEF_CHARACTERISTIC D_ModeIfDriveLogic D_ModeIfDrvReqD D_ModeIfLowMode D_ModeIfLowModeInvalid D_ModeIfMGateAndTempMan D_ModeIfMGateOff D_ModeIfMGateOn D_ModeIfSportButton D_ModeIfTimerExpiredTip1 D_ModeIfTimerExpiredTip2 D_ModeIfTip1 D_ModeIfTip2 /end DEF_CHARACTERISTIC
/end FUNCTION
/begin FUNCTION jData_zff_ABK_MODEIN_Fktn "Calibration values of the Instance jData_zff_ABK_MODEIN" /begin DEF_CHARACTERISTIC D_t_DelayAdaptiveToManual D_t_DelayManualToAdaptive /end DEF_CHARACTERISTIC /end FUNCTION
/begin FUNCTION jData_zff_ABK_POS_INITPOS_Fktn "Calibration values of the Instance jData_zff_ABK_POS_INITPOS" /begin DEF_CHARACTERISTIC D_n_AbPosDirD_Lth D_n_AbPosDirP_Uth D_v_DrvDir_Lth /end DEF_CHARACTERISTIC /end FUNCTION
/begin FUNCTION jData_zff_ABK_POWERDOWN_Fktn "Calibration values of the Instance jData_zff_ABK_POWERDOWN"
 /begin DEF_CHARACTERISTIC D_t_PowDownDefault D_t_PowDownDispN D_t_PowDownDispP D_t_PowDownDispRD /end DEF_CHARACTERISTIC
/end FUNCTION
/begin FUNCTION jData_zff_ABK_RELTOABS_Fktn "Calibration values of the Instance jData_zff_ABK_RELTOABS" /begin DEF_CHARACTERISTIC SWI_SSGWS /end DEF_CHARACTERISTIC /end FUNCTION
/begin FUNCTION jData_zff_ABK_SHIFTLOCK_Fktn "Calibration values of the Instance jData_zff_ABK_SHIFTLOCK"
 /begin DEF_CHARACTERISTIC D_n_EngDiaShiftlock_Lth D_n_EngShiftlockLth D_v_Shiftlock_Uth SWI_Shiftlock_Disable /end DEF_CHARACTERISTIC
/end FUNCTION
/begin FUNCTION jData_zff_ABK_SIGCOND_Fktn "Calibration values of the Instance jData_zff_ABK_SIGCOND"
 /begin DEF_CHARACTERISTIC D_UMV3_KFC_PSINOUT_Th D_t_DiagDelPOSSBW D_u_BattDiagPos D_v_PSAbuse /end DEF_CHARACTERISTIC
/end FUNCTION
/begin FUNCTION jData_zff_ABK_SIGNALS_Fktn "Calibration values of the Instance jData_zff_ABK_SIGNALS"
 /begin DEF_CHARACTERISTIC D_AcceleratorPedalAngleTh D_c_CCHotHysOilChip_Th D_c_TChipCCHot1_Th D_c_TChipCCHot2_Th D_c_TChipCCHot3_Th D_c_TOilCCHot1_Th D_c_TOilCCHot2_Th D_c_TOilCCHot3_Th D_t_DebounceOilChipTransErr D_t_P12BadOp D_v_AutoN_Uth D_v_D_Lth D_v_D_Uth D_v_P12BadOpDisp D_v_P_Lth D_v_P_Uth D_v_R_Lth D_v_R_Uth SWI_HotmodeOilChipStsActivation SWI_KL15_PinPlausiOn /end DEF_CHARACTERISTIC
/end FUNCTION
/begin FUNCTION jData_zff_ABK_SrvcMsgHandler_Fktn "Calibration values of the Instance jData_zff_ABK_SrvcMsgHandler" /begin DEF_CHARACTERISTIC SWI_SrvcMsg_Enable /end DEF_CHARACTERISTIC /end FUNCTION
/begin FUNCTION jData_zff_ABK_STARTERRELEASEDELAY_Fktn "Calibration values of the Instance jData_zff_ABK_STARTERRELEASEDELAY"
 /begin DEF_CHARACTERISTIC D_t_StarterInhibitor_Default D_t_StarterInhibitor_Limphome SWI_StarterReleaseDelayOn /end DEF_CHARACTERISTIC
/end FUNCTION
/begin FUNCTION jData_zff_ABK_STOREDRVREQ_Fktn "Calibration values of the Instance jData_zff_ABK_STOREDRVREQ"
 /begin DEF_CHARACTERISTIC D_t_StoreN D_t_StoreP D_t_StoreRD D_v_N_Uth SWI_StoreOnN SWI_StoreOnP SWI_StoreOnRD /end DEF_CHARACTERISTIC
/end FUNCTION
/begin FUNCTION jData_zff_EH_CarbHandler_Fktn "Calibration values of the Instance jData_zff_EH_CarbHandler"
 /begin DEF_CHARACTERISTIC D_StringObdEcuName SWI_DiObdCommunicationAfterIgnitionOff SWI_DiObdResponseMode /end DEF_CHARACTERISTIC
/end FUNCTION
/begin FUNCTION jData_zff_EH_DemWrapper_Fktn "Calibration values of the Instance jData_zff_EH_DemWrapper" /begin DEF_CHARACTERISTIC D_DemFilteredMaxSearch /end DEF_CHARACTERISTIC /end FUNCTION
/begin FUNCTION jData_zff_EH_DiagnosisControl_Fktn "Calibration values of the Instance jData_zff_EH_DiagnosisControl"
 /begin DEF_CHARACTERISTIC D_DiActivateSubstFunct D_DiActivateSubstFunctHi D_DiAmbCond D_DiErrorCodeConvTab D_DiErrorCodeConvTabForAZG D_DiErrorCode_1 D_DiErrorCode_10 D_DiErrorCode_100 D_DiErrorCode_101 D_DiErrorCode_102 D_DiErrorCode_103 D_DiErrorCode_104 D_DiErrorCode_105 D_DiErrorCode_106 D_DiErrorCode_107 D_DiErrorCode_108 D_DiErrorCode_109 D_DiErrorCode_11 D_DiErrorCode_110 D_DiErrorCode_111 D_DiErrorCode_112 D_DiErrorCode_113 D_DiErrorCode_114 D_DiErrorCode_115 D_DiErrorCode_116 D_DiErrorCode_117 D_DiErrorCode_118 D_DiErrorCode_119 D_DiErrorCode_12 D_DiErrorCode_120 D_DiErrorCode_121 D_DiErrorCode_122 D_DiErrorCode_123 D_DiErrorCode_124 D_DiErrorCode_125 D_DiErrorCode_126 D_DiErrorCode_127 D_DiErrorCode_128 D_DiErrorCode_129 D_DiErrorCode_13 D_DiErrorCode_130 D_DiErrorCode_131 D_DiErrorCode_132 D_DiErrorCode_133 D_DiErrorCode_134 D_DiErrorCode_135 D_DiErrorCode_136 D_DiErrorCode_137 D_DiErrorCode_138 D_DiErrorCode_139 D_DiErrorCode_14 D_DiErrorCode_140 D_DiErrorCode_141 D_DiErrorCode_142 D_DiErrorCode_143 D_DiErrorCode_144 D_DiErrorCode_145 D_DiErrorCode_146 D_DiErrorCode_147 D_DiErrorCode_148 D_DiErrorCode_149 D_DiErrorCode_15 D_DiErrorCode_150 D_DiErrorCode_151 D_DiErrorCode_152 D_DiErrorCode_153 D_DiErrorCode_154 D_DiErrorCode_155 D_DiErrorCode_156 D_DiErrorCode_157 D_DiErrorCode_158 D_DiErrorCode_159 D_DiErrorCode_16 D_DiErrorCode_160 D_DiErrorCode_161 D_DiErrorCode_162 D_DiErrorCode_163 D_DiErrorCode_164 D_DiErrorCode_165 D_DiErrorCode_166 D_DiErrorCode_167 D_DiErrorCode_168 D_DiErrorCode_169 D_DiErrorCode_17 D_DiErrorCode_170 D_DiErrorCode_171 D_DiErrorCode_172 D_DiErrorCode_173 D_DiErrorCode_174 D_DiErrorCode_175 D_DiErrorCode_176 D_DiErrorCode_177 D_DiErrorCode_178 D_DiErrorCode_179 D_DiErrorCode_18 D_DiErrorCode_180 D_DiErrorCode_181 D_DiErrorCode_182 D_DiErrorCode_183 D_DiErrorCode_184 D_DiErrorCode_185 D_DiErrorCode_186 D_DiErrorCode_187 D_DiErrorCode_188 D_DiErrorCode_189 D_DiErrorCode_19 D_DiErrorCode_190 D_DiErrorCode_191 D_DiErrorCode_192 D_DiErrorCode_193 D_DiErrorCode_194 D_DiErrorCode_195 D_DiErrorCode_196 D_DiErrorCode_197 D_DiErrorCode_198 D_DiErrorCode_199 D_DiErrorCode_2 D_DiErrorCode_20 D_DiErrorCode_200 D_DiErrorCode_201 D_DiErrorCode_202 D_DiErrorCode_203 D_DiErrorCode_204 D_DiErrorCode_205 D_DiErrorCode_206 D_DiErrorCode_207 D_DiErrorCode_208 D_DiErrorCode_209 D_DiErrorCode_21 D_DiErrorCode_210 D_DiErrorCode_211 D_DiErrorCode_212 D_DiErrorCode_213 D_DiErrorCode_214 D_DiErrorCode_215 D_DiErrorCode_216 D_DiErrorCode_217 D_DiErrorCode_218 D_DiErrorCode_219 D_DiErrorCode_22 D_DiErrorCode_220 D_DiErrorCode_221 D_DiErrorCode_222 D_DiErrorCode_223 D_DiErrorCode_224 D_DiErrorCode_225 D_DiErrorCode_226 D_DiErrorCode_227 D_DiErrorCode_228 D_DiErrorCode_229 D_DiErrorCode_23 D_DiErrorCode_230 D_DiErrorCode_231 D_DiErrorCode_232 D_DiErrorCode_233 D_DiErrorCode_234 D_DiErrorCode_235 D_DiErrorCode_236 D_DiErrorCode_237 D_DiErrorCode_238 D_DiErrorCode_239 D_DiErrorCode_24 D_DiErrorCode_240 D_DiErrorCode_241 D_DiErrorCode_242 D_DiErrorCode_243 D_DiErrorCode_244 D_DiErrorCode_245 D_DiErrorCode_246 D_DiErrorCode_247 D_DiErrorCode_248 D_DiErrorCode_249 D_DiErrorCode_25 D_DiErrorCode_250 D_DiErrorCode_251 D_DiErrorCode_252 D_DiErrorCode_253 D_DiErrorCode_254 D_DiErrorCode_26 D_DiErrorCode_27 D_DiErrorCode_28 D_DiErrorCode_29 D_DiErrorCode_3 D_DiErrorCode_30 D_DiErrorCode_31 D_DiErrorCode_32 D_DiErrorCode_33 D_DiErrorCode_34 D_DiErrorCode_35 D_DiErrorCode_36 D_DiErrorCode_37 D_DiErrorCode_38 D_DiErrorCode_39 D_DiErrorCode_4 D_DiErrorCode_40 D_DiErrorCode_41 D_DiErrorCode_42 D_DiErrorCode_43 D_DiErrorCode_44 D_DiErrorCode_45 D_DiErrorCode_46 D_DiErrorCode_47 D_DiErrorCode_48 D_DiErrorCode_49 D_DiErrorCode_5 D_DiErrorCode_50 D_DiErrorCode_51 D_DiErrorCode_52 D_DiErrorCode_53 D_DiErrorCode_54 D_DiErrorCode_55 D_DiErrorCode_56 D_DiErrorCode_57 D_DiErrorCode_58 D_DiErrorCode_59 D_DiErrorCode_6 D_DiErrorCode_60 D_DiErrorCode_61 D_DiErrorCode_62 D_DiErrorCode_63 D_DiErrorCode_64 D_DiErrorCode_65 D_DiErrorCode_66 D_DiErrorCode_67 D_DiErrorCode_68 D_DiErrorCode_69 D_DiErrorCode_7 D_DiErrorCode_70 D_DiErrorCode_71 D_DiErrorCode_72 D_DiErrorCode_73 D_DiErrorCode_74 D_DiErrorCode_75 D_DiErrorCode_76 D_DiErrorCode_77 D_DiErrorCode_78 D_DiErrorCode_79 D_DiErrorCode_8 D_DiErrorCode_80 D_DiErrorCode_81 D_DiErrorCode_82 D_DiErrorCode_83 D_DiErrorCode_84 D_DiErrorCode_85 D_DiErrorCode_86 D_DiErrorCode_87 D_DiErrorCode_88 D_DiErrorCode_89 D_DiErrorCode_9 D_DiErrorCode_90 D_DiErrorCode_91 D_DiErrorCode_92 D_DiErrorCode_93 D_DiErrorCode_94 D_DiErrorCode_95 D_DiErrorCode_96 D_DiErrorCode_97 D_DiErrorCode_98 D_DiErrorCode_99 D_DiErrorEntryUpdateType D_DiErrorInhibitionTab D_DiGroupTester1Counter D_DiGroupTester1ErrorCode D_DiGroupTester1ErrorType D_DiGroupTester1Reaction D_DiGroupTester1Status D_DiGroupTester1Switch D_DiRetryRNFInInit D_ThrottlePosUThForQSF D_nAbFiltUThForQSF D_nEngLThForCalTC D_uBattFiltLTh1ForCalTC D_uBattFiltLTh2ForCalTC D_uBattFiltUThForCalTC SWI_DiActivateExtSubstFunct SWI_DiClearBkpErrMem SWI_DiClearErrMem SWI_DiGlobalCtrl /end DEF_CHARACTERISTIC
/end FUNCTION
/begin FUNCTION jData_zff_EH_Erm_Fktn "Calibration values of the Instance jData_zff_EH_Erm"
 /begin DEF_CHARACTERISTIC D_DiErmMonitoring_KFC D_DiErmMonitoring_KMN SWI_DiErmComplementCheck SWI_DiErmDeactivate /end DEF_CHARACTERISTIC
/end FUNCTION
/begin FUNCTION jData_zff_EH_Obd_Fktn "Calibration values of the Instance jData_zff_EH_Obd"
 /begin DEF_CHARACTERISTIC D_DiObdAutoDeleteVariant D_DiObdCWarmUpCycleDiff D_DiObdCWarmUpCycleTh D_DiObdFFIntern D_DiObdFFMoment D_DiObdIumprDenominatorCounterTh D_DiObdIumprDenominatorTimeTh D_DiObdNEngTh D_DiObdNrWarmUpCycles D_DiObdTEngTh D_DiObdTab_0 D_DiObdTab_1 SWI_DiObdDrivingCycle SWI_DiObdIumprIgnitionCycle SWI_DiObdIumprReset SWI_DiObdNormTripB SWI_DiObdPermanentFault_0 SWI_DiObdPermanentFault_1 SWI_DiObdPermanentModeA SWI_DiObdWarmUpCycle /end DEF_CHARACTERISTIC
/end FUNCTION
/begin FUNCTION jDiaRbmif_Fktn "Applikationesgroessen Instanz jDiaRbmif" /begin DEF_CHARACTERISTIC N_ABKODERA /end DEF_CHARACTERISTIC /end FUNCTION
/begin FUNCTION jIaeAdauf_Fktn "Applikationesgroessen Instanz jIaeAdauf"
 /begin DEF_CHARACTERISTIC CS_START_MAX_UEFIAE CS_START_MIN_UEFIAE DO_MUEMAX_UEFIAE KL_J_KOR_UEFIAE MSTELL_ABBR_UEFIAE MS_MOTIST_ABBR_UEFIAE MS_START_MAX_UEFIAE MS_START_MIN_UEFIAE MUE_IST_MAX_UEFIAE MUE_IST_MIN_UEFIAE M_MOTIST_START_MAX_UEFIAE M_MOTIST_START_MIN_UEFIAE NDGS_START_MAX_UEFIAE NDGS_START_MIN_UEFIAE NDS_ABBR_UEFIAE NDS_START_MAX_UEFIAE NDS_START_MIN_UEFIAE NGS_ABBR_UEFIAE NGS_MOT_START_MAX_UEFIAE NGS_MOT_START_MIN_UEFIAE PSTELL_ABBR_UEFIAE TAB_MTM_MOT_UEFIAE T_LAUF_UEFIAE /end DEF_CHARACTERISTIC
/end FUNCTION
/begin FUNCTION jIaeAnfahE_Fktn "Applikationesgroessen Instanz jIaeAnfahE"
 /begin DEF_CHARACTERISTIC KF_F_KD_ANFAHRT_E_IAE KF_F_KI_ANFAHRT_E_IAE KF_F_KP_ANFAHRT_E_IAE KF_KD_ANFAHRT_E_IAE KF_KI_ANFAHRT_E_IAE KF_KP_ANFAHRT_E_IAE KF_OGNMOTANFAHR_SOLL_E_IAE KF_T_PT2_NMOTANFAHR_E_IAE KL_MPT_NMOTSOLLANFAHR_ROH_E_IAE SWI_M_BASIS_ANFAHRT_E_IAE /end DEF_CHARACTERISTIC
/end FUNCTION
/begin FUNCTION jIaeAnfahEl_Fktn "Applikationesgroessen Instanz jIaeAnfahEl"
 /begin DEF_CHARACTERISTIC KF_F_M_ANFAHRT_E_IAE KF_NMOTANFAHR_SOLL_E_IAE KL_NGMOTANFAHRINIT_E_IAE /end DEF_CHARACTERISTIC
/end FUNCTION
/begin FUNCTION jIaeAnfahElEco_Fktn "Applikationesgroessen Instanz jIaeAnfahElEco"
 /begin DEF_CHARACTERISTIC KF_F_M_ANFAHRT_E_ECO_IAE KF_NMOTANFAHR_SOLL_E_ECO_IAE KL_NGMOTANFAHRINIT_E_ECO_IAE /end DEF_CHARACTERISTIC
/end FUNCTION
/begin FUNCTION jIaeAnfahH_Fktn "Applikationesgroessen Instanz jIaeAnfahH"
 /begin DEF_CHARACTERISTIC KF_F_KD_ANFAHRT_H_IAE KF_F_KI_ANFAHRT_H_IAE KF_F_KP_ANFAHRT_H_IAE KF_KD_ANFAHRT_H_IAE KF_KI_ANFAHRT_H_IAE KF_KP_ANFAHRT_H_IAE KF_OGNMOTANFAHR_SOLL_H_IAE KF_T_PT2_NMOTANFAHR_H_IAE KL_MPT_NMOTSOLLANFAHR_ROH_H_IAE SWI_M_BASIS_ANFAHRT_H_IAE /end DEF_CHARACTERISTIC
/end FUNCTION
/begin FUNCTION jIaeAnfahHy_Fktn "Applikationesgroessen Instanz jIaeAnfahHy"
 /begin DEF_CHARACTERISTIC KF_F_M_ANFAHRT_H_IAE KF_NMOTANFAHR_SOLL_H_IAE KL_NGMOTANFAHRINIT_H_IAE /end DEF_CHARACTERISTIC
/end FUNCTION
/begin FUNCTION jIaeAnfahHyEco_Fktn "Applikationesgroessen Instanz jIaeAnfahHyEco"
 /begin DEF_CHARACTERISTIC KF_F_M_ANFAHRT_H_ECO_IAE KF_NMOTANFAHR_SOLL_H_ECO_IAE KL_NGMOTANFAHRINIT_H_ECO_IAE /end DEF_CHARACTERISTIC
/end FUNCTION
/begin FUNCTION jIaeDiagn_Fktn "Applikationesgroessen Instanz jIaeDiagn"
 /begin DEF_CHARACTERISTIC AXS_CLOSE_DIAGIAE AX_MAX_CLOSE_DIAGIAE CS_CGETR_NOCLOSE_DIAGIAE CS_MAX_DIAGIAE CS_MAX_HYS_DIAGIAE F_MMOT_NOCLOSE_DIAGIAE F_NSOLL_NOCLOSE_DIAGIAE KF_MDI_DIAGIAE KF_ND_NOOPEN_DIAGIAE KL_F_ND_RESET_DIAGIAE KL_MDI_CLOSE_DIAGIAE KL_MDI_NOOPEN_DIAGIAE KL_NGS_NAB_CLOSE_DIAGIAE MO_MMOT_NOCLOSE_DIAGIAE MPT_MDI_DIAGIAE M_SOLLMAX_CLOSE_DIAGIAE NDS_NDIAE_NOCLOSE_DIAGIAE NGS_NMOT_NOCLOSE_DIAGIAE NO_NSOLL_NOCLOSE_DIAGIAE NS_NAB_CLOSE_DIAGIAE N_STOER_KFC_NOCLOSE_DIAGIAE PS_BREMS_NOOPEN_DIAGIAE SWI_NDMOT_DIAGIAE TAB_ZMODUS_CLOSE_DIAGIAE TAB_ZMODUS_NOOPEN_DIAGIAE TS_AX_CLOSE_DIAGIAE T_LWREAKT_DIAGIAE T_ND_RESET_DIAGIAE T_NOCLOSE_DIAGIAE T_NOOPEN_DIAGIAE T_VERZ_HOT_DIAGIAE VDS_WHEEL_CLOSE_DIAGIAE /end DEF_CHARACTERISTIC
/end FUNCTION
/begin FUNCTION jIaeDraus_Fktn "Applikationesgroessen Instanz jIaeDraus"
 /begin DEF_CHARACTERISTIC KF_MUE_IAE KF_MUE_OFFSET_IAE KF_PO_DYN_ANFAHR_IAE KL_F_MUE_IAE KL_F_PO_DYN_KRIECH_IAE KL_POFMIN_IAE KL_PO_DYN_KRIECH_IAE KL_PO_HYSKOMP_ANGELEGT_IAE KL_T_HALTE_HYSKOMP_ANGELEGT_IAE KL_T_PO_DYN_ANFAHR_IAE KL_T_PO_DYN_KRIECH_IAE MPT_MUE_IAE MPT_PO_DYN_ANFAHR_IAE MPT_PO_DYN_KRIECH_IAE MPT_PO_HYSKOMP_ANGELEGT_IAE MPT_PSTELLBASIS_IAE PDS_HYS_SCHLEIFE_IAE PG_HYSKOMP_ANGELEGT_MAX_IAE PG_HYSKOMP_ANGELEGT_MIN_IAE PO_HYSKOMP_ANGELEGT_ZIEL_IAE SWI_PO_DYN_ANFAHR_IAE SWI_PO_DYN_KRIECH_IAE TAB_MIN_ND_IAEKFMUE_ENTKOPPL TAB_MIN_ND_IAEKFMUE_IAE TAB_MPT_P_HYS_SCHLEIFE_IAE TAB_P_HYS_SCHLEIFE_IAE TAB_SWI_HYS_SCHLEIFE_IAE TAB_T_P_HYS_SCHLEIFE_IAE TS_INITHYS_SCHLEIFE_IAE /end DEF_CHARACTERISTIC
/end FUNCTION
/begin FUNCTION jIaeKordi_Fktn "Applikationesgroessen Instanz jIaeKordi"
 /begin DEF_CHARACTERISTIC DKIS_ANFAHRT_HYS_IAE DKIS_ANFAHRT_IAE GS_ANFAHRT_IAE GS_ANGELEGT_SCHALT_IAE KL_NDMOTVMSTARTBEGINN_IAE KL_NDS_ANGELEGT_KRIECH_IAE KL_ONSENTKOPPL_ANGELEGT_IAE KL_PS_BREMS_ANFAHRT_IAE MS_K0VMSTARTBEGINN_IAE MS_MOTSOLLREKUEND_IAE NDS_MOTINITREG_IAE NDS_SYNC_IAE NDS_ZU_HYS_IAE NDS_ZU_IAE NGS_ASRREGELT_IAE NO_VM_EHANF_IAE NS_AB_ANFAHRT_IAE NS_HYS_MOTKRIECH_IAE NS_MOTKRIECH_IAE PS_HYS_BREMS_IAE SWI_ANFAHRVERB_RS_IAE SWI_ANGELEGT_SCHALT_IAE SWI_HSCHALTVERHIAE_ZZS SWI_SCHALTVERHIAE_ZZS TAB_MVG_MSTELL_IAE TAB_MVG_ND_IAE T_NDS_ZU_IAE T_RAMAXSNYC_IAE /end DEF_CHARACTERISTIC
/end FUNCTION
/begin FUNCTION jIaeKuehl_Fktn "Applikationesgroessen Instanz jIaeKuehl"
 /begin DEF_CHARACTERISTIC CS_SLGRENZ_IAE F_KUEHLOELV_IAE KF_VP_KUEHL_SOLL_IAE KF_VP_LECKAGE_IAE KL_CS_NACHKUEHL_IAE KL_F_VP_KUEHL_IAE KL_P_KUEHL_IAE MPT_KUEHL_IAE NDS_KUEHLOFFEN_IAE ND_HYS_KUEHLOFFEN_IAE PWS_KUEHL_INAKTIV_IAE TS_EFAHREN_IAE T_KUEHL_INAKTIV_IAE VP_KUEHLOFFEN_IAE VP_KUEHL_MAX_IAE /end DEF_CHARACTERISTIC
/end FUNCTION
/begin RECORD_LAYOUT ZF_kf_fl32_S5_S3 FNC_VALUES 5 FLOAT32_IEEE ROW_DIR DIRECT AXIS_PTS_X 3 FLOAT32_IEEE INDEX_INCR DIRECT AXIS_PTS_Y 4 FLOAT32_IEEE INDEX_INCR DIRECT NO_AXIS_PTS_X 1 ULONG NO_AXIS_PTS_Y 2 ULONG /end RECORD_LAYOUT
/begin RECORD_LAYOUT ZF_kf_si16_S5_S3 FNC_VALUES 5 SWORD ROW_DIR DIRECT AXIS_PTS_X 3 SWORD INDEX_INCR DIRECT AXIS_PTS_Y 4 SWORD INDEX_INCR DIRECT NO_AXIS_PTS_X 1 ULONG NO_AXIS_PTS_Y 2 ULONG /end RECORD_LAYOUT
/begin RECORD_LAYOUT ZF_kf_ui16_S5_S3 FNC_VALUES 5 UWORD ROW_DIR DIRECT AXIS_PTS_X 3 UWORD INDEX_INCR DIRECT AXIS_PTS_Y 4 UWORD INDEX_INCR DIRECT NO_AXIS_PTS_X 1 ULONG NO_AXIS_PTS_Y 2 ULONG /end RECORD_LAYOUT
/begin RECORD_LAYOUT ZF_KL_NAT16_S1_S3 FNC_VALUES 3 UWORD COLUMN_DIR DIRECT AXIS_PTS_X 2 UWORD INDEX_INCR DIRECT NO_AXIS_PTS_X 1 ULONG /end RECORD_LAYOUT
/begin RECORD_LAYOUT ZF_KL_NAT16_S2_S3 FNC_VALUES 3 UWORD COLUMN_DIR DIRECT AXIS_PTS_X 2 UWORD INDEX_INCR DIRECT NO_AXIS_PTS_X 1 ULONG /end RECORD_LAYOUT
/begin RECORD_LAYOUT ZF_kl_si16_S5_S3 FNC_VALUES 3 SWORD COLUMN_DIR DIRECT AXIS_PTS_X 2 SWORD INDEX_INCR DIRECT NO_AXIS_PTS_X 1 ULONG /end RECORD_LAYOUT
/begin RECORD_LAYOUT ZF_kl_ui16_S5_S3 FNC_VALUES 3 UWORD COLUMN_DIR DIRECT AXIS_PTS_X 2 UWORD INDEX_INCR DIRECT NO_AXIS_PTS_X 1 ULONG /end RECORD_LAYOUT
/begin RECORD_LAYOUT ZF_kl_ui8_S5_S3 FNC_VALUES 3 UBYTE COLUMN_DIR DIRECT AXIS_PTS_X 2 UBYTE INDEX_INCR DIRECT NO_AXIS_PTS_X 1 ULONG /end RECORD_LAYOUT
/begin RECORD_LAYOUT ZF_kw_bool8_S5_S3 FNC_VALUES 1 UBYTE COLUMN_DIR DIRECT /end RECORD_LAYOUT
/begin RECORD_LAYOUT ZF_KW_NAT16_S1_S3 FNC_VALUES 1 UWORD COLUMN_DIR DIRECT /end RECORD_LAYOUT
/begin RECORD_LAYOUT ZF_KW_NAT16_S2_S3 FNC_VALUES 1 UWORD COLUMN_DIR DIRECT /end RECORD_LAYOUT
/begin RECORD_LAYOUT ZF_KW_NAT16_S4_S3 FNC_VALUES 1 UWORD COLUMN_DIR DIRECT /end RECORD_LAYOUT
/begin RECORD_LAYOUT ZF_KW_NAT32_S1_S3 FNC_VALUES 1 ULONG COLUMN_DIR DIRECT /end RECORD_LAYOUT
/begin RECORD_LAYOUT ZF_KW_NAT32_S4_S3 FNC_VALUES 1 ULONG COLUMN_DIR DIRECT /end RECORD_LAYOUT
/begin RECORD_LAYOUT ZF_KW_NAT8_S1_S3 FNC_VALUES 1 UBYTE COLUMN_DIR DIRECT /end RECORD_LAYOUT
/begin RECORD_LAYOUT ZF_KW_NAT8_S2_S3 FNC_VALUES 1 UBYTE COLUMN_DIR DIRECT /end RECORD_LAYOUT
/begin RECORD_LAYOUT ZF_KW_NAT8_S4_S3 FNC_VALUES 1 UBYTE COLUMN_DIR DIRECT /end RECORD_LAYOUT
/begin RECORD_LAYOUT ZF_kw_si16_S5_S3 FNC_VALUES 1 SWORD COLUMN_DIR DIRECT /end RECORD_LAYOUT
/begin RECORD_LAYOUT ZF_kw_ui16_S5_S3 FNC_VALUES 1 UWORD COLUMN_DIR DIRECT /end RECORD_LAYOUT
/begin RECORD_LAYOUT ZF_kw_ui8_S5_S3 FNC_VALUES 1 UBYTE COLUMN_DIR DIRECT /end RECORD_LAYOUT
/begin RECORD_LAYOUT ZF_TAB2D_NAT16_S2_S3 FNC_VALUES 3 UWORD ROW_DIR DIRECT NO_AXIS_PTS_X 1 ULONG NO_AXIS_PTS_Y 2 ULONG /end RECORD_LAYOUT
/begin RECORD_LAYOUT ZF_TAB2D_NAT32_S1_S3 FNC_VALUES 3 ULONG ROW_DIR DIRECT NO_AXIS_PTS_X 1 ULONG NO_AXIS_PTS_Y 2 ULONG /end RECORD_LAYOUT
/begin RECORD_LAYOUT ZF_TAB2D_NAT32_S4_S3 FNC_VALUES 3 ULONG ROW_DIR DIRECT NO_AXIS_PTS_X 1 ULONG NO_AXIS_PTS_Y 2 ULONG /end RECORD_LAYOUT
/begin RECORD_LAYOUT ZF_TAB2D_OI_NAT16_S4_S3 FNC_VALUES 1 UWORD ROW_DIR DIRECT /end RECORD_LAYOUT
/begin RECORD_LAYOUT ZF_TAB2D_OI_NAT8_S4_S3 FNC_VALUES 1 UBYTE ROW_DIR DIRECT /end RECORD_LAYOUT
/begin RECORD_LAYOUT ZF_tab_bool8_S5_S3 FNC_VALUES 2 UBYTE COLUMN_DIR DIRECT NO_AXIS_PTS_X 1 ULONG /end RECORD_LAYOUT
/begin RECORD_LAYOUT ZF_TAB_NAT16_S1_S3 FNC_VALUES 2 UWORD COLUMN_DIR DIRECT NO_AXIS_PTS_X 1 ULONG /end RECORD_LAYOUT
/begin RECORD_LAYOUT ZF_TAB_NAT16_S2_S3 FNC_VALUES 2 UWORD COLUMN_DIR DIRECT NO_AXIS_PTS_X 1 ULONG /end RECORD_LAYOUT
/begin RECORD_LAYOUT ZF_TAB_NAT16_S4_S3 FNC_VALUES 2 UWORD COLUMN_DIR DIRECT NO_AXIS_PTS_X 1 ULONG /end RECORD_LAYOUT
/begin RECORD_LAYOUT ZF_TAB_NAT32_S2_S3 FNC_VALUES 2 ULONG COLUMN_DIR DIRECT NO_AXIS_PTS_X 1 ULONG /end RECORD_LAYOUT
/begin RECORD_LAYOUT ZF_TAB_NAT8_S1_S3 FNC_VALUES 2 UBYTE COLUMN_DIR DIRECT NO_AXIS_PTS_X 1 ULONG /end RECORD_LAYOUT
/begin RECORD_LAYOUT ZF_TAB_NAT8_S4_S3 FNC_VALUES 2 UBYTE COLUMN_DIR DIRECT NO_AXIS_PTS_X 1 ULONG /end RECORD_LAYOUT
/begin RECORD_LAYOUT ZF_TAB_OI_NAT16_S4_S3 FNC_VALUES 1 UWORD COLUMN_DIR DIRECT /end RECORD_LAYOUT
/begin RECORD_LAYOUT ZF_tab_si16_S5_S3 FNC_VALUES 2 SWORD COLUMN_DIR DIRECT NO_AXIS_PTS_X 1 ULONG /end RECORD_LAYOUT
/begin RECORD_LAYOUT ZF_tab_ui8_S5_S3 FNC_VALUES 2 UBYTE COLUMN_DIR DIRECT NO_AXIS_PTS_X 1 ULONG /end RECORD_LAYOUT
/end MODULE
/end PROJECT
