ASAP2_VERSION 1 51
/begin PROJECT ZHBC8600 "Gen2_BMW_System_Supplier_Lib"
/begin MODULE CPP ""
/begin MOD_COMMON "" BYTE_ORDER MSB_FIRST ALIGNMENT_BYTE 1 ALIGNMENT_WORD 2 ALIGNMENT_LONG 4 ALIGNMENT_FLOAT32_IEEE 4 ALIGNMENT_FLOAT64_IEEE 1 /end MOD_COMMON
/begin COMPU_VTAB Conv.cBasFehlerErfolgFl._.flag_fehler_S5_S3 "Umrechnung fuer Messgroesse cBasFehlerErfolgFl::flag_fehler" TAB_VERB 2 0 "keine Fehler vorhanden" 1 "Fehler vorhanden" DEFAULT_VALUE "" /end COMPU_VTAB
/begin COMPU_VTAB Conv.cBasFehlerErfolgInt._.flag_fehler_S5_S3 "Umrechnung fuer Messgroesse cBasFehlerErfolgInt::flag_fehler" TAB_VERB 2 0 "keine Fehler vorhanden" 1 "Fehler vorhanden" DEFAULT_VALUE "" /end COMPU_VTAB
/begin COMPU_VTAB Conv.cSasAnKzu._.f_hinsyn_kzu_gestartet_S5_S3 "Umrechnung fuer Messgroesse cSasAnKzu::f_hinsyn_kzu_gestartet" TAB_VERB 2 0 "FALSE" 1 "TRUE" DEFAULT_VALUE "" /end COMPU_VTAB
/begin COMPU_VTAB Conv.cSasAnKzu._.f_ngs_abflare_unterschritten_S5_S3 "Umrechnung fuer Messgroesse cSasAnKzu::f_ngs_abflare_unterschritten" TAB_VERB 2 0 "Druckoffset bei Flare nicht gesetzt" 1 "Druckoffset bei Flare gesetzt" DEFAULT_VALUE "" /end COMPU_VTAB
/begin COMPU_VTAB Conv.cSasAnKzu._.f_pokzufol_erlaubt_S5_S3 "Umrechnung fuer Messgroesse cSasAnKzu::f_pokzufol_erlaubt" TAB_VERB 2 0 "FALSE" 1 "TRUE" DEFAULT_VALUE "" /end COMPU_VTAB
/begin COMPU_VTAB Conv.cSasAnKzu._.f_rampenzeitberechnung_fertig_S5_S3 "Umrechnung fuer Messgroesse cSasAnKzu::f_rampenzeitberechnung_fertig" TAB_VERB 2 0 "Schliessrampenzeit nicht berechnet" 1 "Schliessrampenzeit berechnet" DEFAULT_VALUE "" /end COMPU_VTAB
/begin COMPU_VTAB Conv.cSasAnKzu._.f_schnellfuellung_war_aktiv_S5_S3 "Umrechnung fuer Messgroesse cSasAnKzu::f_schnellfuellung_war_aktiv" TAB_VERB 2 0 "FALSE" 1 "TRUE" DEFAULT_VALUE "" /end COMPU_VTAB
/begin COMPU_VTAB Conv.cSasAnKzu._.fa_kzu_gestartet_S5_S3 "Umrechnung fuer Messgroesse cSasAnKzu::fa_kzu_gestartet" TAB_VERB 2 0 "FALSE" 1 "TRUE" DEFAULT_VALUE "" /end COMPU_VTAB
/begin COMPU_VTAB Conv.cSasAnKzu._.flag_pomekzu_erlaubt_S5_S3 "Umrechnung fuer Messgroesse cSasAnKzu::flag_pomekzu_erlaubt" TAB_VERB 2 0 "ME-abhaengiger Druckoffset nicht erlaubt" 1 "ME-abhaengiger Druckoffset erlaubt" DEFAULT_VALUE "" /end COMPU_VTAB
/begin COMPU_VTAB Conv.cSasAnKzu._.kup_kzu_S5_S3 "Umrechnung fuer Messgroesse cSasAnKzu::kup_kzu" TAB_VERB 6 0 "KEINE" 1 "K_A" 2 "K_B" 3 "K_C" 4 "K_D" 5 "K_E" DEFAULT_VALUE "" /end COMPU_VTAB
/begin COMPU_VTAB Conv.cSasAnKzu._.p_fkzu_gueltig_S5_S3 "Umrechnung fuer Messgroesse cSasAnKzu::p_fkzu_gueltig" TAB_VERB 2 0 "Fuelldruckwert nicht gueltig" 1 "Fuelldruckwert gueltig" DEFAULT_VALUE "" /end COMPU_VTAB
/begin COMPU_VTAB Conv.cSasAnKzu._.ra1_hsrs_kzu_gestartet_S5_S3 "Umrechnung fuer Messgroesse cSasAnKzu::ra1_hsrs_kzu_gestartet" TAB_VERB 2 0 "FALSE" 1 "TRUE" DEFAULT_VALUE "" /end COMPU_VTAB
/begin COMPU_VTAB Conv.cSasAnKzu._.ra2_hsrs_kzu_gestartet_S5_S3 "Umrechnung fuer Messgroesse cSasAnKzu::ra2_hsrs_kzu_gestartet" TAB_VERB 2 0 "FALSE" 1 "TRUE" DEFAULT_VALUE "" /end COMPU_VTAB
/begin COMPU_VTAB Conv.cSasAnKzu._.ra3_hsrs_kzu_gestartet_S5_S3 "Umrechnung fuer Messgroesse cSasAnKzu::ra3_hsrs_kzu_gestartet" TAB_VERB 2 0 "FALSE" 1 "TRUE" DEFAULT_VALUE "" /end COMPU_VTAB
/begin COMPU_VTAB Conv.cSasAnKzu._.schalttyp_kzu_S5_S3 "Umrechnung fuer Messgroesse cSasAnKzu::schalttyp_kzu" TAB_VERB 5 0 "nicht genutzt" 1 "Hochschaltung:    ZUGHOCH" 2 "Rueckschaltung:   SCHUBRUECK" 3 "wird nicht verwendet" 4 "Gangein/-auslegen: SCHALTTYP_GE_GA" DEFAULT_VALUE "" /end COMPU_VTAB
/begin COMPU_VTAB Conv.cSasAnKzu._.schliessen_kzu_S5_S3 "Umrechnung fuer Messgroesse cSasAnKzu::schliessen_kzu" TAB_VERB 2 0 "FALSE" 1 "TRUE" DEFAULT_VALUE "" /end COMPU_VTAB
/begin COMPU_VTAB Conv.cSasAnKzu._.statisch_kzu_S5_S3 "Umrechnung fuer Messgroesse cSasAnKzu::statisch_kzu" TAB_VERB 2 0 "KZU arbeitet" 1 "KZU statisch" DEFAULT_VALUE "" /end COMPU_VTAB
/begin COMPU_VTAB Conv.cSasAnKzu._.t_vkabr_abgelaufen_S5_S3 "Umrechnung fuer Messgroesse cSasAnKzu::t_vkabr_abgelaufen" TAB_VERB 2 0 "Verzoegerungszeit nicht abgelaufen" 1 "Verzoegerungszeit abgelaufen" DEFAULT_VALUE "" /end COMPU_VTAB
/begin COMPU_VTAB Conv.cSasAnKzu._.z_kzu_S5_S3 "Umrechnung fuer Messgroesse cSasAnKzu::z_kzu" TAB_VERB 20 0 "Initialisierungszustand" 1 "Warten" 2 "Schnellfuellung" 3 "nicht genutzt" 4 "Fuellausgleich Hochschaltung" 5 "Fuellausgleich Rueckschaltung" 6 "nicht genutzt" 7 "nicht genutzt" 8 "nicht genutzt" 9 "Rampe 1 Hoch- und Rueckschaltung" 10 "Rampe 2 Hoch- und Rueckschaltung" 11 "Rampe auf Haltephase in Synchron" 12 "Haltephase in Synchron" 13 "Rampe 3 Hoch- und Rueckschaltung" 14 "Timeout" 15 "nicht genutzt" 16 "nicht genutzt" 17 "Warten bis Schnellfüllung K0 beendet ist" 18 "Schliessrampe nach Zeit in synchron bei Rueckschaltung" 19 "Fuellausgleich waehrend Vorbereitung" DEFAULT_VALUE "" /end COMPU_VTAB
/begin COMPU_VTAB Conv.cSasSaKor._.index_spsas_S5_S3 "Umrechnung fuer Messgroesse cSasSaKor::index_spsas" TAB_VERB 3 0 "IND_KURZSAS_NORMAL" 1 "IND_KURZSAS_SP" 2 "IND_KURZSAS_SPORT" DEFAULT_VALUE "" /end COMPU_VTAB
/begin COMPU_VTAB Conv.cSasSaKor._.istgang_sas_S5_S3 "Umrechnung fuer Messgroesse cSasSaKor::istgang_sas" TAB_VERB 10 -1 "GR1" 0 "KEIN_GANG" 1 "G1" 2 "G2" 3 "G3" 4 "G4" 5 "G5" 6 "G6" 7 "G7" 8 "G8" DEFAULT_VALUE "" /end COMPU_VTAB
/begin COMPU_VTAB Conv.cSasSaKor._.kup_schutz_massnahme_aktiv_S5_S3 "Umrechnung fuer Messgroesse cSasSaKor::kup_schutz_massnahme_aktiv" TAB_VERB 2 0 "Schutzfunktion inaktiv" 1 "Schutzfunktion aktiv" DEFAULT_VALUE "" /end COMPU_VTAB
/begin COMPU_VTAB Conv.cSasSaKor._.schaltinfo_sas_S5_S3 "Umrechnung fuer Messgroesse cSasSaKor::schaltinfo_sas" TAB_VERB 5 0 "Keine Schaltinfo" 1 "Einzelhochschaltung" 2 "Mehrfachhochschaltung" 3 "Einzelrueckschaltung" 4 "Mehrfachrueckschaltung" DEFAULT_VALUE "" /end COMPU_VTAB
/begin COMPU_VTAB Conv.cSasSaKor._.schaltinfo_sas_vor_folge_S5_S3 "Umrechnung fuer Messgroesse cSasSaKor::schaltinfo_sas_vor_folge" TAB_VERB 9 0 "KEINE_SCHALTINFO" 1 "EHS" 2 "MHS" 3 "ERS" 4 "MRS" 5 "MRS84" 6 "MRS64" 7 "nicht verwendet" 8 "nicht verwendet" DEFAULT_VALUE "" /end COMPU_VTAB
/begin COMPU_VTAB Conv.cSasSaKor._.schaltinfo_syn_S5_S3 "Umrechnung fuer Messgroesse cSasSaKor::schaltinfo_syn" TAB_VERB 5 0 "KEINE_SCHALTINFO" 1 "EHS" 2 "MHS" 3 "ERS" 4 "MRS" DEFAULT_VALUE "" /end COMPU_VTAB
/begin COMPU_VTAB Conv.cSasSaKor._.schnellfuellung_beendet_S5_S3 "Umrechnung fuer Messgroesse cSasSaKor::schnellfuellung_beendet" TAB_VERB 2 0 "Schnellfuellung nicht beendet" 1 "Schnellfuellung beendet" DEFAULT_VALUE "" /end COMPU_VTAB
/begin COMPU_VTAB Conv.cSasSaKor._.schnellfuellung_gestartet_S5_S3 "Umrechnung fuer Messgroesse cSasSaKor::schnellfuellung_gestartet" TAB_VERB 2 0 "Schnellfuellung nicht gestartet" 1 "Schnellfuellung gestartet" DEFAULT_VALUE "" /end COMPU_VTAB
/begin COMPU_VTAB Conv.cSasSaKor._.synchron_S5_S3 "Umrechnung fuer Messgroesse cSasSaKor::synchron" TAB_VERB 2 0 "Synchronpunkt noch nicht erreicht" 1 "Synchronpunkt erreicht" DEFAULT_VALUE "" /end COMPU_VTAB
/begin COMPU_VTAB Conv.cSasSaKor._.synchron_verboten_S5_S3 "Umrechnung fuer Messgroesse cSasSaKor::synchron_verboten" TAB_VERB 2 0 "Synchron nicht verboten" 1 "Synchron verboten" DEFAULT_VALUE "" /end COMPU_VTAB
/begin COMPU_VTAB Conv.cSasSaKor._.timeout_S5_S3 "Umrechnung fuer Messgroesse cSasSaKor::timeout" TAB_VERB 2 0 "kein Timeout" 1 "Timeout erreicht" DEFAULT_VALUE "" /end COMPU_VTAB
/begin COMPU_VTAB Conv.cSasSaKor._.z_kurze_schaltung_S5_S3 "Umrechnung fuer Messgroesse cSasSaKor::z_kurze_schaltung" TAB_VERB 8 0 "Initialisierungszustand" 1 "Passiv keine kurzen Parameter vorhanden" 2 "normale Parameter" 3 "nur teilweise SP-Label verwendet" 4 "alle SP-Label verwendet" 5 "nur teilweise SPORT-Label verwendet" 6 "alle SPORT-Label verwendet" 7 "alle SP-Label und teilweise SPORT-Label" DEFAULT_VALUE "" /end COMPU_VTAB
/begin COMPU_VTAB Conv.cSasSaKor._.zielgang_sas_S5_S3 "Umrechnung fuer Messgroesse cSasSaKor::zielgang_sas" TAB_VERB 10 -1 "GR1" 0 "KEIN_GANG" 1 "G1" 2 "G2" 3 "G3" 4 "G4" 5 "G5" 6 "G6" 7 "G7" 8 "G8" DEFAULT_VALUE "" /end COMPU_VTAB
/begin COMPU_VTAB Conv.cSasSaKor._.zwangssynchron_S5_S3 "Umrechnung fuer Messgroesse cSasSaKor::zwangssynchron" TAB_VERB 2 0 "Kein Zwangssynchron" 1 "Zwangssynchron" DEFAULT_VALUE "" /end COMPU_VTAB
/begin COMPU_VTAB Conv.cSasZentr._.kup_kzu_ada_S5_S3 "Umrechnung fuer Messgroesse cSasZentr::kup_kzu_ada" TAB_VERB 6 0 "KEINE" 1 "K_A" 2 "K_B" 3 "K_C" 4 "K_D" 5 "K_E" DEFAULT_VALUE "" /end COMPU_VTAB
/begin COMPU_VTAB Conv.cSasZentr._.kup_nkraftloesend2_letztes_ga_S5_S3 "Umrechnung fuer Messgroesse cSasZentr::kup_nkraftloesend2_letztes_ga" TAB_VERB 6 0 "KEINE" 1 "K_A" 2 "K_B" 3 "K_C" 4 "K_D" 5 "K_E" DEFAULT_VALUE "" /end COMPU_VTAB
/begin COMPU_VTAB Conv.cSasZentr._.schaltart_sas_S5_S3 "Umrechnung fuer Messgroesse cSasZentr::schaltart_sas" TAB_VERB 6 0 "KEINE_SCHALTUNG" 1 "HS" 2 "RS" 3 "SCHALTART_GE" 4 "SCHALTART_GA" 5 "nicht verwendet" DEFAULT_VALUE "" /end COMPU_VTAB
/begin COMPU_VTAB Conv.cSasZentr._.schalttyp_S5_S3 "Umrechnung fuer Messgroesse cSasZentr::schalttyp" TAB_VERB 5 0 "SCHUBHOCH" 1 "ZUGHOCH" 2 "SCHUBRUECK" 3 "ZUGRUECK" 4 "SCHALTTYP_GE_GA" DEFAULT_VALUE "" /end COMPU_VTAB
/begin COMPU_VTAB Conv.cSasZentr._.schalttyp_sas_S5_S3 "Umrechnung fuer Messgroesse cSasZentr::schalttyp_sas" TAB_VERB 5 0 "SCHUBHOCH" 1 "ZUGHOCH" 2 "SCHUBRUECK" 3 "ZUGRUECK" 4 "SCHALTTYP_GE_GA" DEFAULT_VALUE "" /end COMPU_VTAB
/begin COMPU_VTAB Conv.cSasZentr._.schaltung_abgebrochen_S5_S3 "Umrechnung fuer Messgroesse cSasZentr::schaltung_abgebrochen" TAB_VERB 2 0 "kein Abbruch" 1 "laufende Schaltung ist Abbruch der vorhergehenden" DEFAULT_VALUE "" /end COMPU_VTAB
/begin COMPU_VTAB Conv.cSasZentr._.schaltung_sas_S5_S3 "Umrechnung fuer Messgroesse cSasZentr::schaltung_sas" TAB_VERB 2 0 "Schaltung inaktiv" 1 "Schaltung aktiv" DEFAULT_VALUE "" /end COMPU_VTAB
/begin COMPU_VTAB Conv.cSasZentr._.schaltung_ueber_kzu_S5_S3 "Umrechnung fuer Messgroesse cSasZentr::schaltung_ueber_kzu" TAB_VERB 2 0 "Schaltung nicht ueber KZU" 1 "Schaltung ueber KZU" DEFAULT_VALUE "" /end COMPU_VTAB
/begin COMPU_VTAB Conv.cSasZentr._.schaltungsende_durch_ge_ga_S5_S3 "Umrechnung fuer Messgroesse cSasZentr::schaltungsende_durch_ge_ga" TAB_VERB 2 0 "Kein Beenden der Schaltung durch GE/GA" 1 "GE/GA hat die laufende Schaltung beendet" DEFAULT_VALUE "" /end COMPU_VTAB
/begin COMPU_VTAB Conv.cSasZentr._.schrittschaltung_S5_S3 "Umrechnung fuer Messgroesse cSasZentr::schrittschaltung" TAB_VERB 2 0 "Keine Schrittschaltung" 1 "Schrittschaltung" DEFAULT_VALUE "" /end COMPU_VTAB
/begin COMPU_VTAB Conv.cSasZentr._.sync_istgang_verlassen_me_S5_S3 "Umrechnung fuer Messgroesse cSasZentr::sync_istgang_verlassen_me" TAB_VERB 2 0 "noch nicht verlassen" 1 "synchron istgang verlassen" DEFAULT_VALUE "" /end COMPU_VTAB
/begin COMPU_VTAB Conv.cSasZentr._.sync_istgang_verlassen_S5_S3 "Umrechnung fuer Messgroesse cSasZentr::sync_istgang_verlassen" TAB_VERB 2 0 "noch nicht verlassen" 1 "synchron istgang verlassen" DEFAULT_VALUE "" /end COMPU_VTAB
/begin COMPU_VTAB Conv.cSasZentr._.sync_ziel_erreicht_S5_S3 "Umrechnung fuer Messgroesse cSasZentr::sync_ziel_erreicht" TAB_VERB 2 0 "Synchronpunkt noch nicht erreicht" 1 "Synchronpunkt erreicht" DEFAULT_VALUE "" /end COMPU_VTAB
/begin COMPU_VTAB Conv.cSasZentr._.vorbereitung_im_vordergrund_S5_S3 "Umrechnung fuer Messgroesse cSasZentr::vorbereitung_im_vordergrund" TAB_VERB 2 0 "Vorbereitung nicht auf Kupplung" 1 "Vorbereitender Ablauf hat Kupplung uebernommen" DEFAULT_VALUE "" /end COMPU_VTAB
/begin COMPU_VTAB Conv.cSasZentr._.wechsel_normal_kurz_S5_S3 "Umrechnung fuer Messgroesse cSasZentr::wechsel_normal_kurz" TAB_VERB 2 0 "Kein Wechsel von Normalen auf Spontane Schaltungen" 1 "Wechsel von Normalen auf Spontane Schaltungen hat stattgefunden" DEFAULT_VALUE "" /end COMPU_VTAB
/begin COMPU_VTAB Conv.cSasZentr._.z_m_motmax_kupschtz_S5_S3 "Umrechnung fuer Messgroesse cSasZentr::z_m_motmax_kupschtz" TAB_VERB 5 0 "Nullzustand" 1 "Ausführen Rampe auf m_motmax_kupschtz" 2 "Vorgabe m_motmax_kupschtz aktiv" 3 "Ausführen Rückführungsrampe auf m_mot" 4 "Keine Ausgabe von m_motmax_kupschtz" DEFAULT_VALUE "" /end COMPU_VTAB
/begin COMPU_VTAB Conv.cSasZentr._.z_m_motmax_sas_S5_S3 "Umrechnung fuer Messgroesse cSasZentr::z_m_motmax_sas" TAB_VERB 4 0 "Initialisierungszustand" 1 "Vorgabe m_motmax_sas aktiv" 2 "Ausführen Rückführungsrampe auf m_mot" 3 "Keine Ausgabe von m_motmax_sas" DEFAULT_VALUE "" /end COMPU_VTAB
/begin COMPU_VTAB Conv.cSasZentr._.z_sync_ziel_S5_S3 "Umrechnung fuer Messgroesse cSasZentr::z_sync_ziel" TAB_VERB 3 1 "Synchronpunkt noch nicht erreicht" 2 "Haltephase mit mindestzeit" 3 "Synchronpunkt ist erreicht" DEFAULT_VALUE "" /end COMPU_VTAB
/begin COMPU_VTAB Conv.cSasZentr._.zs_wechsel_verboten_S5_S3 "Umrechnung fuer Messgroesse cSasZentr::zs_wechsel_verboten" TAB_VERB 2 0 "ZS Wechsel nicht verboten" 1 "ZS Wechsel verboten" DEFAULT_VALUE "" /end COMPU_VTAB
/begin COMPU_VTAB Conv.cSasZentr._.zug_schub_sas_S5_S3 "Umrechnung fuer Messgroesse cSasZentr::zug_schub_sas" TAB_VERB 2 0 "Schubschaltung" 1 "Zugschaltung" DEFAULT_VALUE "" /end COMPU_VTAB
/begin COMPU_VTAB Conv.cTciCompu._.f_timer_belast_ber_kab_gestartet_S5_S3 "Umrechnung fuer Messgroesse cTciCompu::f_timer_belast_ber_kab_gestartet" TAB_VERB 2 0 "timer inaktiv" 1 "timer aktiv" DEFAULT_VALUE "" /end COMPU_VTAB
/begin COMPU_VTAB Conv.cTciCompu._.f_timer_belast_ber_kzu_gestartet_S5_S3 "Umrechnung fuer Messgroesse cTciCompu::f_timer_belast_ber_kzu_gestartet" TAB_VERB 2 0 "timer inaktiv" 1 "timer aktiv" DEFAULT_VALUE "" /end COMPU_VTAB
/begin COMPU_VTAB Conv.cTciCompu._.flag_ende_kab_ber_erreicht_S5_S3 "Umrechnung fuer Messgroesse cTciCompu::flag_ende_kab_ber_erreicht" TAB_VERB 2 0 "FALSE" 1 "TRUE" DEFAULT_VALUE "" /end COMPU_VTAB
/begin COMPU_VTAB Conv.cTciCompu._.flag_ende_kzu_ber_erreicht_S5_S3 "Umrechnung fuer Messgroesse cTciCompu::flag_ende_kzu_ber_erreicht" TAB_VERB 2 0 "FALSE" 1 "TRUE" DEFAULT_VALUE "" /end COMPU_VTAB
/begin COMPU_VTAB Conv.cTciCompu._.flag_schaltung_ende_S5_S3 "Umrechnung fuer Messgroesse cTciCompu::flag_schaltung_ende" TAB_VERB 2 0 "Schaltung nicht beendet" 1 "Schaltung beendet" DEFAULT_VALUE "" /end COMPU_VTAB
/begin COMPU_VTAB Conv.cTciCompu._.istgang_idx_merk_S5_S3 "Umrechnung fuer Messgroesse cTciCompu::istgang_idx_merk" TAB_VERB 10 0 "GR1" 1 "KEIN_GANG" 2 "G1" 3 "G2" 4 "G3" 5 "G4" 6 "G5" 7 "G6" 8 "G7" 9 "G8" DEFAULT_VALUE "" /end COMPU_VTAB
/begin COMPU_VTAB Conv.cTciCompu._.k_ab_S5_S3 "Umrechnung fuer Messgroesse cTciCompu::k_ab" TAB_VERB 6 0 "KEINE" 1 "K_A" 2 "K_B" 3 "K_C" 4 "K_D" 5 "K_E" DEFAULT_VALUE "" /end COMPU_VTAB
/begin COMPU_VTAB Conv.cTciCompu._.k_zu_S5_S3 "Umrechnung fuer Messgroesse cTciCompu::k_zu" TAB_VERB 6 0 "KEINE" 1 "K_A" 2 "K_B" 3 "K_C" 4 "K_D" 5 "K_E" DEFAULT_VALUE "" /end COMPU_VTAB
/begin COMPU_VTAB Conv.cTciCompu._.schaltart_sas_red_tci_S5_S3 "Umrechnung fuer Messgroesse cTciCompu::schaltart_sas_red_tci" TAB_VERB 3 1 "HS" 2 "RS" 3 "SCHALTART_GEGA_TCI" DEFAULT_VALUE "" /end COMPU_VTAB
/begin COMPU_VTAB Conv.cTciCompu._.z_tci_S5_S3 "Umrechnung fuer Messgroesse cTciCompu::z_tci" TAB_VERB 3 0 "Kupplungsbelastung passiv" 1 "Berechnung Kupplungsbelastung Gangeinlegen aktiv" 2 "Berechnung Kupplungsbelastung Schaltung aktiv" DEFAULT_VALUE "" /end COMPU_VTAB
/begin COMPU_VTAB Conv.cTciCompu._.zielgang_sas_idx_merk_S5_S3 "Umrechnung fuer Messgroesse cTciCompu::zielgang_sas_idx_merk" TAB_VERB 10 0 "GR1" 1 "KEIN_GANG" 2 "G1" 3 "G2" 4 "G3" 5 "G4" 6 "G5" 7 "G6" 8 "G7" 9 "G8" DEFAULT_VALUE "" /end COMPU_VTAB
/begin COMPU_VTAB Conv.cTciTempM._.f_aufheizung_aktiv_S5_S3 "Umrechnung fuer Messgroesse cTciTempM::f_aufheizung_aktiv" TAB_VERB 2 0 "FALSE" 1 "TRUE" DEFAULT_VALUE "" /end COMPU_VTAB
/begin COMPU_VTAB Conv.cTciTempM._.kupplung_S5_S3 "Umrechnung fuer Messgroesse cTciTempM::kupplung" TAB_VERB 6 0 "KEINE" 1 "K_A" 2 "K_B" 3 "K_C" 4 "K_D" 5 "K_E" DEFAULT_VALUE "" /end COMPU_VTAB
/begin COMPU_VTAB Conv.cUewIgetr._.b_uwig_auf_symptom_pruefen_S5_S3 "Umrechnung fuer Messgroesse cUewIgetr::b_uwig_auf_symptom_pruefen" TAB_VERB 2 0 "kein pruefen auf Symptom" 1 "pruefen auf Symptom" DEFAULT_VALUE "" /end COMPU_VTAB
/begin COMPU_VTAB Conv.cUewIgetr._.f_abbruch_akt_ueberwachung_S5_S3 "Umrechnung fuer Messgroesse cUewIgetr::f_abbruch_akt_ueberwachung" TAB_VERB 2 0 "laufende ueberwachung nicht abbrechen" 1 "laufende ueberwachung abbrechen" DEFAULT_VALUE "" /end COMPU_VTAB
/begin COMPU_VTAB Conv.cUewIgetr._.f_ersatzprogramm_aktiv_S5_S3 "Umrechnung fuer Messgroesse cUewIgetr::f_ersatzprogramm_aktiv" TAB_VERB 2 0 "Ersatzprogramm von UWIG noch nicht ausgeloest" 1 "Ersatzprogramm von UWIG ausgeloest" DEFAULT_VALUE "" /end COMPU_VTAB
/begin COMPU_VTAB Conv.cUewIgetr._.f_ersatzwert_stc_S5_S3 "Umrechnung fuer Messgroesse cUewIgetr::f_ersatzwert_stc" TAB_VERB 2 0 "Originalwert fuer Abtriebsdrehzahl" 1 "Ersatzwert fuer Abtriebsdrehzahl" DEFAULT_VALUE "" /end COMPU_VTAB
/begin COMPU_VTAB Conv.cUewIgetr._.f_ist_ersatzgang_gang_stc_S5_S3 "Umrechnung fuer Messgroesse cUewIgetr::f_ist_ersatzgang_gang_stc" TAB_VERB 2 0 "kein Ersatzgang gesetzt" 1 "Ersatzgang gesetzt" DEFAULT_VALUE "" /end COMPU_VTAB
/begin COMPU_VTAB Conv.cUewIgetr._.f_ist_ersatzgang_ge_stc_S5_S3 "Umrechnung fuer Messgroesse cUewIgetr::f_ist_ersatzgang_ge_stc" TAB_VERB 2 0 "kein Ersatzgang gesetzt" 1 "Ersatzgang gesetzt" DEFAULT_VALUE "" /end COMPU_VTAB
/begin COMPU_VTAB Conv.cUewIgetr._.f_ist_ersatzgang_schalt_stc_S5_S3 "Umrechnung fuer Messgroesse cUewIgetr::f_ist_ersatzgang_schalt_stc" TAB_VERB 2 0 "kein Ersatzgang gesetzt" 1 "Ersatzgang gesetzt" DEFAULT_VALUE "" /end COMPU_VTAB
/begin COMPU_VTAB Conv.cUewIgetr._.f_ist_ge_stc_S5_S3 "Umrechnung fuer Messgroesse cUewIgetr::f_ist_ge_stc" TAB_VERB 2 0 "kein Gangeinlegevorgang" 1 "Gangeinlegevorgang laeuft" DEFAULT_VALUE "" /end COMPU_VTAB
/begin COMPU_VTAB Conv.cUewIgetr._.f_ist_nab_kleiner_schwelle_stc_S5_S3 "Umrechnung fuer Messgroesse cUewIgetr::f_ist_nab_kleiner_schwelle_stc" TAB_VERB 2 0 "nab ist groesser/gleich der Schwelle NS_ABUWIG" 1 "nab ist kleiner als Schwelle NS_ABUWIG" DEFAULT_VALUE "" /end COMPU_VTAB
/begin COMPU_VTAB Conv.cUewIgetr._.f_ist_neue_schaltung_stc_S5_S3 "Umrechnung fuer Messgroesse cUewIgetr::f_ist_neue_schaltung_stc" TAB_VERB 2 0 "keine neue Schaltung" 1 "neue Schaltung" DEFAULT_VALUE "" /end COMPU_VTAB
/begin COMPU_VTAB Conv.cUewIgetr._.f_ist_neues_ge_stc_S5_S3 "Umrechnung fuer Messgroesse cUewIgetr::f_ist_neues_ge_stc" TAB_VERB 2 0 "kein neues Gangeinlegen" 1 "neues Gangeinlegen" DEFAULT_VALUE "" /end COMPU_VTAB
/begin COMPU_VTAB Conv.cUewIgetr._.f_ist_schaltung_stc_S5_S3 "Umrechnung fuer Messgroesse cUewIgetr::f_ist_schaltung_stc" TAB_VERB 2 0 "keine Schaltung laeuft" 1 "Schaltung laeuft" DEFAULT_VALUE "" /end COMPU_VTAB
/begin COMPU_VTAB Conv.cUewIgetr._.f_ist_stoerung_stc_S5_S3 "Umrechnung fuer Messgroesse cUewIgetr::f_ist_stoerung_stc" TAB_VERB 2 0 "keine Stoerung erkannt" 1 "Stoerung erkannt" DEFAULT_VALUE "" /end COMPU_VTAB
/begin COMPU_VTAB Conv.cUewIgetr._.f_ist_symptom_gang_stc_S5_S3 "Umrechnung fuer Messgroesse cUewIgetr::f_ist_symptom_gang_stc" TAB_VERB 2 0 "kein Symptom erkannt" 1 "Symptom erkannt" DEFAULT_VALUE "" /end COMPU_VTAB
/begin COMPU_VTAB Conv.cUewIgetr._.f_ist_symptom_ge_stc_S5_S3 "Umrechnung fuer Messgroesse cUewIgetr::f_ist_symptom_ge_stc" TAB_VERB 2 0 "kein Symptom erkannt" 1 "Symptom erkannt" DEFAULT_VALUE "" /end COMPU_VTAB
/begin COMPU_VTAB Conv.cUewIgetr._.f_ist_symptom_schalt_stc_S5_S3 "Umrechnung fuer Messgroesse cUewIgetr::f_ist_symptom_schalt_stc" TAB_VERB 2 0 "kein Symptom erkannt" 1 "Symptom erkannt" DEFAULT_VALUE "" /end COMPU_VTAB
/begin COMPU_VTAB Conv.cUewIgetr._.f_pruefbed_im_gang_erreicht_stc_S5_S3 "Umrechnung fuer Messgroesse cUewIgetr::f_pruefbed_im_gang_erreicht_stc" TAB_VERB 2 0 "Pruefbedingung nicht erfuellt" 1 "Pruefbedingung erfuellt" DEFAULT_VALUE "" /end COMPU_VTAB
/begin COMPU_VTAB Conv.cUewIgetr._.f_schalt_durch_sym_schalt_stc_S5_S3 "Umrechnung fuer Messgroesse cUewIgetr::f_schalt_durch_sym_schalt_stc" TAB_VERB 2 0 "Schaltung ist keine Reaktion auf ein Schaltungssymptom" 1 "Schaltung ist Reaktion auf ein Schaltungssymptom" DEFAULT_VALUE "" /end COMPU_VTAB
/begin COMPU_VTAB Conv.cUewIgetr._.f_stoer_offset_in_schaltung_stc_S5_S3 "Umrechnung fuer Messgroesse cUewIgetr::f_stoer_offset_in_schaltung_stc" TAB_VERB 2 0 "Momentengradiententenschwelle nicht ueberschritten" 1 "Momentengradiententenschwelle ueberschritten" DEFAULT_VALUE "" /end COMPU_VTAB
/begin COMPU_VTAB Conv.cUewIgetr._.f_timer16_rampe_gestartet_stc_S5_S3 "Umrechnung fuer Messgroesse cUewIgetr::f_timer16_rampe_gestartet_stc" TAB_VERB 2 0 "timer16_rampe noch nicht gestartet" 1 "timer16_rampe ist gestartet" DEFAULT_VALUE "" /end COMPU_VTAB
/begin COMPU_VTAB Conv.cUewIgetr._.f_ueberwache_ge_stc_S5_S3 "Umrechnung fuer Messgroesse cUewIgetr::f_ueberwache_ge_stc" TAB_VERB 2 0 "Startwerte fuer GE noch nicht gesetzt" 1 "Startwerte fuer GE sind gesetzt" DEFAULT_VALUE "" /end COMPU_VTAB
/begin COMPU_VTAB Conv.cUewIgetr._.fl_erf_iepuwig_S5_S3 "Umrechnung fuer Messgroesse cUewIgetr::fl_erf_iepuwig" TAB_VERB 2 0 "keine Gutpruefung aktiv" 1 "Gutpruefugn aktiv" DEFAULT_VALUE "" /end COMPU_VTAB
/begin COMPU_VTAB Conv.cUewIgetr._.fl_sym_iepuwig_S5_S3 "Umrechnung fuer Messgroesse cUewIgetr::fl_sym_iepuwig" TAB_VERB 2 0 "keine Symptom aufgetreten" 1 "Symptom aufgetreten" DEFAULT_VALUE "" /end COMPU_VTAB
/begin COMPU_VTAB Conv.cUewIgetr._.flg_kfc_ratioglobal_S5_S3 "Umrechnung fuer Messgroesse cUewIgetr::flg_kfc_ratioglobal" TAB_VERB 2 0 "KFC_RATIOGLOBAL nicht eingetragen" 1 "KFC_RATIOGLOBAL eingetragen" DEFAULT_VALUE "" /end COMPU_VTAB
/begin COMPU_VTAB Conv.cUewIgetr._.flg_kuppident_S5_S3 "Umrechnung fuer Messgroesse cUewIgetr::flg_kuppident" TAB_VERB 2 0 "Die fehlerausloesende Kupplung wurde noch nicht identifiziert" 1 "Die fehlerausloesende Kupplung wurde identifiziert" DEFAULT_VALUE "" /end COMPU_VTAB
/begin COMPU_VTAB Conv.cUewIgetr._.istgang_akt_uew_stc_S5_S3 "Umrechnung fuer Messgroesse cUewIgetr::istgang_akt_uew_stc" TAB_VERB 10 -1 "GR1" 0 "KEIN_GANG" 1 "G1" 2 "G2" 3 "G3" 4 "G4" 5 "G5" 6 "G6" 7 "G7" 8 "G8" DEFAULT_VALUE "" /end COMPU_VTAB
/begin COMPU_VTAB Conv.cUewIgetr._.istgang_vorherige_schaltung_stc_S5_S3 "Umrechnung fuer Messgroesse cUewIgetr::istgang_vorherige_schaltung_stc" TAB_VERB 10 -1 "GR1" 0 "KEIN_GANG" 1 "G1" 2 "G2" 3 "G3" 4 "G4" 5 "G5" 6 "G6" 7 "G7" 8 "G8" DEFAULT_VALUE "" /end COMPU_VTAB
/begin COMPU_VTAB Conv.cUewIgetr._.kfl_ziel_bei_symptom_stc_S5_S3 "Umrechnung fuer Messgroesse cUewIgetr::kfl_ziel_bei_symptom_stc" TAB_VERB 3 0 "KEIN_KFL" 1 "KFL_VORWAERTS" 2 "KFL_RUECKWAERTS" DEFAULT_VALUE "" /end COMPU_VTAB
/begin COMPU_VTAB Conv.cUewIgetr._.kup_ge1_stc_S5_S3 "Umrechnung fuer Messgroesse cUewIgetr::kup_ge1_stc" TAB_VERB 6 0 "KEINE" 1 "K_A" 2 "K_B" 3 "K_C" 4 "K_D" 5 "K_E" DEFAULT_VALUE "" /end COMPU_VTAB
/begin COMPU_VTAB Conv.cUewIgetr._.kup_ge2_stc_S5_S3 "Umrechnung fuer Messgroesse cUewIgetr::kup_ge2_stc" TAB_VERB 6 0 "KEINE" 1 "K_A" 2 "K_B" 3 "K_C" 4 "K_D" 5 "K_E" DEFAULT_VALUE "" /end COMPU_VTAB
/begin COMPU_VTAB Conv.cUewIgetr._.kup_ge3_stc_S5_S3 "Umrechnung fuer Messgroesse cUewIgetr::kup_ge3_stc" TAB_VERB 6 0 "KEINE" 1 "K_A" 2 "K_B" 3 "K_C" 4 "K_D" 5 "K_E" DEFAULT_VALUE "" /end COMPU_VTAB
/begin COMPU_VTAB Conv.cUewIgetr._.schaltart_akt_uew_stc_S5_S3 "Umrechnung fuer Messgroesse cUewIgetr::schaltart_akt_uew_stc" TAB_VERB 3 0 "nicht definiert" 1 "Hochschaltung (Wert fuer schaltart)" 2 "Rueckschaltung (Wert fuer schaltart)" DEFAULT_VALUE "" /end COMPU_VTAB
/begin COMPU_VTAB Conv.cUewIgetr._.symptom_reaktion_S5_S3 "Umrechnung fuer Messgroesse cUewIgetr::symptom_reaktion" TAB_VERB 4 0 "KEIN_SYMPTOM_AKTIV" 1 "SYMPTOM_GANG" 2 "SYMPTOM_SCHALT" 3 "SYMPTOM_GE" DEFAULT_VALUE "" /end COMPU_VTAB
/begin COMPU_VTAB Conv.cUewIgetr._.symptom_uwig_r_gang_aktiv_S5_S3 "Umrechnung fuer Messgroesse cUewIgetr::symptom_uwig_r_gang_aktiv" TAB_VERB 2 0 "Kein Symptom R-Gang mit Zwangsneutral aktiv" 1 "Symptom R-Gang mit Zwangsneutral aktiv" DEFAULT_VALUE "" /end COMPU_VTAB
/begin COMPU_VTAB Conv.cUewIgetr._.uwig_abbruchgang_S5_S3 "Umrechnung fuer Messgroesse cUewIgetr::uwig_abbruchgang" TAB_VERB 10 -1 "GR1" 0 "KEIN_GANG" 1 "G1" 2 "G2" 3 "G3" 4 "G4" 5 "G5" 6 "G6" 7 "G7" 8 "G8" DEFAULT_VALUE "" /end COMPU_VTAB
/begin COMPU_VTAB Conv.cUewIgetr._.uwig_pruefstatus_kup_a_S5_S3 "Umrechnung fuer Messgroesse cUewIgetr::uwig_pruefstatus_kup_a" TAB_VERB 2 0 "nicht geprueft" 1 "i.o. geprueft" DEFAULT_VALUE "" /end COMPU_VTAB
/begin COMPU_VTAB Conv.cUewIgetr._.uwig_pruefstatus_kup_b_S5_S3 "Umrechnung fuer Messgroesse cUewIgetr::uwig_pruefstatus_kup_b" TAB_VERB 2 0 "nicht geprueft" 1 "i.o. geprueft" DEFAULT_VALUE "" /end COMPU_VTAB
/begin COMPU_VTAB Conv.cUewIgetr._.uwig_pruefstatus_kup_c_S5_S3 "Umrechnung fuer Messgroesse cUewIgetr::uwig_pruefstatus_kup_c" TAB_VERB 2 0 "nicht geprueft" 1 "i.o. geprueft" DEFAULT_VALUE "" /end COMPU_VTAB
/begin COMPU_VTAB Conv.cUewIgetr._.uwig_pruefstatus_kup_d_S5_S3 "Umrechnung fuer Messgroesse cUewIgetr::uwig_pruefstatus_kup_d" TAB_VERB 2 0 "nicht geprueft" 1 "i.o. geprueft" DEFAULT_VALUE "" /end COMPU_VTAB
/begin COMPU_VTAB Conv.cUewIgetr._.uwig_pruefstatus_kup_e_S5_S3 "Umrechnung fuer Messgroesse cUewIgetr::uwig_pruefstatus_kup_e" TAB_VERB 2 0 "nicht geprueft" 1 "i.o. geprueft" DEFAULT_VALUE "" /end COMPU_VTAB
/begin COMPU_VTAB Conv.cUewIgetr._.zielgang_sas_akt_uew_stc_S5_S3 "Umrechnung fuer Messgroesse cUewIgetr::zielgang_sas_akt_uew_stc" TAB_VERB 10 -1 "GR1" 0 "KEIN_GANG" 1 "G1" 2 "G2" 3 "G3" 4 "G4" 5 "G5" 6 "G6" 7 "G7" 8 "G8" DEFAULT_VALUE "" /end COMPU_VTAB
/begin COMPU_VTAB Conv.cUewIgetr._.zustand_uwig_S5_S3 "Umrechnung fuer Messgroesse cUewIgetr::zustand_uwig" TAB_VERB 9 0 "init" 1 "default" 2 "keine Schaltung" 3 "Start Schaltung" 4 "warte auf Reglerstart" 5 "warte Verzoegerungszeit" 6 "Rampe" 7 "Nachlauf" 8 "Schaltungsende" DEFAULT_VALUE "" /end COMPU_VTAB
/begin COMPU_VTAB Conv.cUewParksperrenmagnet._.flag_einstiegsbed_S5_S3 "Umrechnung fuer Messgroesse cUewParksperrenmagnet::flag_einstiegsbed" TAB_VERB 2 0 "Einstiegsbedingungen nicht erfuellt" 1 "Einstiegsbedingungen erfuellt" DEFAULT_VALUE "" /end COMPU_VTAB
/begin COMPU_VTAB Conv.cUewParksperrenmagnet._.flag_pmueb_S5_S3 "Umrechnung fuer Messgroesse cUewParksperrenmagnet::flag_pmueb" TAB_VERB 2 0 "Prüfung wurde nicht durchgeführt" 1 "Prüfung wurde durchgeführt" DEFAULT_VALUE "" /end COMPU_VTAB
/begin COMPU_VTAB Conv.cUewParksperrenmagnet._.zustand_S5_S3 "Umrechnung fuer Messgroesse cUewParksperrenmagnet::zustand" TAB_VERB 5 0 "Initphase" 1 "Defaultzustand" 2 "Verzoegerung vor Prüfung" 3 "Prüfen des Ventils" 4 "Timer PMUEB wird zurückgsetzt" DEFAULT_VALUE "" /end COMPU_VTAB
/begin COMPU_VTAB Conv.cUewSgetf._.f_keine_egs_offtime_S5_S3 "Umrechnung fuer Messgroesse cUewSgetf::f_keine_egs_offtime" TAB_VERB 2 0 "Offset hinzufügen" 1 "kein Offset hinzufügen" DEFAULT_VALUE "" /end COMPU_VTAB
/begin COMPU_VTAB Conv.cUewSgetf._.f_timer_zuendung_reset_S5_S3 "Umrechnung fuer Messgroesse cUewSgetf::f_timer_zuendung_reset" TAB_VERB 2 0 "nicht zurücksetzen" 1 "zurücksetzen" DEFAULT_VALUE "" /end COMPU_VTAB
/begin COMPU_VTAB Conv.cUewSgetf._.i_edsc_min_S5_S3 "Umrechnung fuer Messgroesse cUewSgetf::i_edsc_min" TAB_VERB 2 0 "Kein min. Bestromung I_EDS Kupplung C" 1 "min. Bestromung I_EDS Kupplung C" DEFAULT_VALUE "" /end COMPU_VTAB
/begin COMPU_VTAB Conv.cUewSgetf._.posv_diagnose_aktiv_S5_S3 "Umrechnung fuer Messgroesse cUewSgetf::posv_diagnose_aktiv" TAB_VERB 2 0 "POSV-Ueberwachung ist NICHT aktiv" 1 "POSV-Ueberwachung ist aktiv" DEFAULT_VALUE "" /end COMPU_VTAB
/begin COMPU_VTAB Conv.cUewSgetf._.pruefung_posvmechdef_aktiv_S5_S3 "Umrechnung fuer Messgroesse cUewSgetf::pruefung_posvmechdef_aktiv" TAB_VERB 2 0 "POSV-Ueberwachung laeuft nicht" 1 "POSV-Ueberwachung laeuft" DEFAULT_VALUE "" /end COMPU_VTAB
/begin COMPU_VTAB Conv.cUewSgetf._.ps_sensor_err_S5_S3 "Umrechnung fuer Messgroesse cUewSgetf::ps_sensor_err" TAB_VERB 2 0 "kein Fehler" 1 "Fehler" DEFAULT_VALUE "" /end COMPU_VTAB
/begin COMPU_VTAB Conv.cUewSgetf._.ps_sensor_signal_alt_S5_S3 "Umrechnung fuer Messgroesse cUewSgetf::ps_sensor_signal_alt" TAB_VERB 4 0 "PS_SENSOR_KEIN_P" 1 "PS_SENSOR_P" 2 "PS_SENSOR_Z" 3 "PS_SENSOR_ERR" DEFAULT_VALUE "" /end COMPU_VTAB
/begin COMPU_VTAB Conv.cUewSgetf._.pumpendruck_vorh_posv_uew_alt_S5_S3 "Umrechnung fuer Messgroesse cUewSgetf::pumpendruck_vorh_posv_uew_alt" TAB_VERB 2 0 "pumpendruck_vorh_posv_uew_alt nicht gesetzt" 1 "pumpendruck_vorh_posv_uew_alt gesetzt" DEFAULT_VALUE "" /end COMPU_VTAB
/begin COMPU_VTAB Conv.cUewSgetf._.zwangsposition_p_S5_S3 "Umrechnung fuer Messgroesse cUewSgetf::zwangsposition_p" TAB_VERB 2 0 "Keine Zwangsposition P" 1 "Zwangsposition P einstellen" DEFAULT_VALUE "" /end COMPU_VTAB
/begin COMPU_VTAB Conv.cUewSgetf._.zz_zustand_S5_S3 "Umrechnung fuer Messgroesse cUewSgetf::zz_zustand" TAB_VERB 7 0 "Zustand nach dem Hochfahren der EGS" 1 "warten auf Zündungswechsel nach AUS" 2 "warten auf NMot Bedingung" 3 "wenn EEPROM frei gegeben den Timer nullen" 4 "wenn EEPROM frei gegeben den Timer erhoehen" 5 "wenn EEPROM frei gegeben den Timer nullen" 6 "warten das die Zündung auf EIN geht" DEFAULT_VALUE "" /end COMPU_VTAB
/begin COMPU_VTAB Conv.cUl2DrehzahlBeobFl._.fl_drehzbeob_schaltung_S5_S3 "Umrechnung fuer Messgroesse cUl2DrehzahlBeobFl::fl_drehzbeob_schaltung" TAB_VERB 2 0 "keine Schaltung aktiv" 1 "Schaltung aktiv" DEFAULT_VALUE "" /end COMPU_VTAB
/begin COMPU_VTAB Conv.cUl2DrehzahlBeobInt._.fl_drehzbeob_schaltung_S5_S3 "Umrechnung fuer Messgroesse cUl2DrehzahlBeobInt::fl_drehzbeob_schaltung" TAB_VERB 2 0 "keine Schaltung aktiv" 1 "Schaltung aktiv" DEFAULT_VALUE "" /end COMPU_VTAB
/begin COMPU_VTAB Conv.cUl2EdsBasisInt._.type_S5_S3 "Umrechnung fuer Messgroesse cUl2EdsBasisInt::type" TAB_VERB 3 0 "FALLEND" 1 "STEIGEND" 2 "FALLEND_INV" DEFAULT_VALUE "" /end COMPU_VTAB
/begin COMPU_VTAB Conv.cUl2EdsSignalFl._.globale_einst_bed_S5_S3 "Umrechnung fuer Messgroesse cUl2EdsSignalFl::globale_einst_bed" TAB_VERB 2 0 "Bedingung NICHT erfüllt" 1 "Bedingung erfüllt" DEFAULT_VALUE "" /end COMPU_VTAB
/begin COMPU_VTAB Conv.cUl2EdsSignalFl._.posv_ueb_aktiv_l2_S5_S3 "Umrechnung fuer Messgroesse cUl2EdsSignalFl::posv_ueb_aktiv_l2" TAB_VERB 2 0 "Bedingung NICHT erfüllt" 1 "Bedingung erfüllt" DEFAULT_VALUE "" /end COMPU_VTAB
/begin COMPU_VTAB Conv.cUl2EdsSignalInt._.globale_einst_bed_S5_S3 "Umrechnung fuer Messgroesse cUl2EdsSignalInt::globale_einst_bed" TAB_VERB 2 0 "Bedingung NICHT erfüllt" 1 "Bedingung erfüllt" DEFAULT_VALUE "" /end COMPU_VTAB
/begin COMPU_VTAB Conv.cUl2EdsSignalInt._.pos_alt_S5_S3 "Umrechnung fuer Messgroesse cUl2EdsSignalInt::pos_alt" TAB_VERB 9 0 "Pos. 1" 1 "Pos. 2" 2 "Pos. 3" 3 "Pos. 4" 4 "Pos. 5" 5 "Pos. D" 6 "Pos. N" 7 "Pos. R" 8 "Pos. P" DEFAULT_VALUE "" /end COMPU_VTAB
/begin COMPU_VTAB Conv.cUl2EdsSignalInt._.posv_ueb_aktiv_l2_S5_S3 "Umrechnung fuer Messgroesse cUl2EdsSignalInt::posv_ueb_aktiv_l2" TAB_VERB 2 0 "Bedingung NICHT erfüllt" 1 "Bedingung erfüllt" DEFAULT_VALUE "" /end COMPU_VTAB
/begin COMPU_VTAB Conv.cUl2ItfipFl._.iv_dscfehlerl2komp_S5_S3 "Umrechnung fuer Messgroesse cUl2ItfipFl::iv_dscfehlerl2komp" TAB_VERB 2 254 "DSC (ESP) fehlerhaft / deaktiviert" 255 "DSC (ESP) in ordnung / aktiv" DEFAULT_VALUE "" /end COMPU_VTAB
/begin COMPU_VTAB Conv.cUl2ItfipFl._.iv_pos_l2_komp_S5_S3 "Umrechnung fuer Messgroesse cUl2ItfipFl::iv_pos_l2_komp" TAB_VERB 9 247 "Pos. P" 248 "Pos. R" 249 "Pos. N" 250 "Pos. D" 251 "Pos. 5" 252 "Pos. 4" 253 "Pos. 3" 254 "Pos. 2" 255 "Pos. 1" DEFAULT_VALUE "" /end COMPU_VTAB
/begin COMPU_VTAB Conv.cUl2ItfipFl._.iv_ps_sensor_signal_l2_komp_S5_S3 "Umrechnung fuer Messgroesse cUl2ItfipFl::iv_ps_sensor_signal_l2_komp" TAB_VERB 4 252 "Fehler erkannt" 253 "Zwischenpostition erkannt" 254 "Position P erkannt" 255 "Position nicht P erkannt" DEFAULT_VALUE "" /end COMPU_VTAB
/begin COMPU_VTAB Conv.cUl2ItfipFl._.iv_ps_sensor_status_l2_komp_S5_S3 "Umrechnung fuer Messgroesse cUl2ItfipFl::iv_ps_sensor_status_l2_komp" TAB_VERB 3 253 "Signal fehlerhaft" 254 "Ersatzwert" 255 "Signal i.O." DEFAULT_VALUE "" /end COMPU_VTAB
/begin COMPU_VTAB Conv.cUl2ItfipFl._.iv_v_unplausibel_l2_komp_S5_S3 "Umrechnung fuer Messgroesse cUl2ItfipFl::iv_v_unplausibel_l2_komp" TAB_VERB 2 254 "unplausibel" 255 "plausibel" DEFAULT_VALUE "" /end COMPU_VTAB
/begin COMPU_VTAB Conv.cUl2ItfipFl._.ps_sensor_status_l2_S5_S3 "Umrechnung fuer Messgroesse cUl2ItfipFl::ps_sensor_status_l2" TAB_VERB 3 0 "Signal i.O." 1 "Ersatzwert" 2 "Signal fehlerhaft" DEFAULT_VALUE "" /end COMPU_VTAB
/begin COMPU_VTAB Conv.cUl2ItfipInt._.dsc_fehler_l2_S5_S3 "Umrechnung fuer Messgroesse cUl2ItfipInt::dsc_fehler_l2" TAB_VERB 2 0 "DSC (ESP) in ordnung / aktiv" 1 "DSC (ESP) fehlerhaft / deaktiviert" DEFAULT_VALUE "" /end COMPU_VTAB
/begin COMPU_VTAB Conv.cUl2ItfipInt._.iv_dscfehlerl2_S5_S3 "Umrechnung fuer Messgroesse cUl2ItfipInt::iv_dscfehlerl2" TAB_VERB 2 0 "DSC (ESP) in ordnung / aktiv" 1 "DSC (ESP) fehlerhaft / deaktiviert" DEFAULT_VALUE "" /end COMPU_VTAB
/begin COMPU_VTAB Conv.cUl2ItfipInt._.iv_pos_l2_S5_S3 "Umrechnung fuer Messgroesse cUl2ItfipInt::iv_pos_l2" TAB_VERB 9 0 "Pos. 1" 1 "Pos. 2" 2 "Pos. 3" 3 "Pos. 4" 4 "Pos. 5" 5 "Pos. D" 6 "Pos. N" 7 "Pos. R" 8 "Pos. P" DEFAULT_VALUE "" /end COMPU_VTAB
/begin COMPU_VTAB Conv.cUl2ItfipInt._.iv_ps_sensor_signal_l2_S5_S3 "Umrechnung fuer Messgroesse cUl2ItfipInt::iv_ps_sensor_signal_l2" TAB_VERB 4 0 "Position nicht P erkannt" 1 "Position P erkannt" 2 "Zwischenpostition erkannt" 3 "Fehler erkannt" DEFAULT_VALUE "" /end COMPU_VTAB
/begin COMPU_VTAB Conv.cUl2ItfipInt._.iv_ps_sensor_status_l2_S5_S3 "Umrechnung fuer Messgroesse cUl2ItfipInt::iv_ps_sensor_status_l2" TAB_VERB 3 0 "Signal i.O." 1 "Ersatzwert" 2 "Signal fehlerhaft" DEFAULT_VALUE "" /end COMPU_VTAB
/begin COMPU_VTAB Conv.cUl2ItfipInt._.iv_v_unplausibel_l2_S5_S3 "Umrechnung fuer Messgroesse cUl2ItfipInt::iv_v_unplausibel_l2" TAB_VERB 2 0 "plausibel" 1 "unplausibel" DEFAULT_VALUE "" /end COMPU_VTAB
/begin COMPU_VTAB Conv.cUl2ItfipInt._.pos_l2_S5_S3 "Umrechnung fuer Messgroesse cUl2ItfipInt::pos_l2" TAB_VERB 9 0 "Pos. 1" 1 "Pos. 2" 2 "Pos. 3" 3 "Pos. 4" 4 "Pos. 5" 5 "Pos. D" 6 "Pos. N" 7 "Pos. R" 8 "Pos. P" DEFAULT_VALUE "" /end COMPU_VTAB
/begin COMPU_VTAB Conv.cUl2ItfipInt._.ps_sensor_signal_l2_S5_S3 "Umrechnung fuer Messgroesse cUl2ItfipInt::ps_sensor_signal_l2" TAB_VERB 4 0 "Position nicht P erkannt" 1 "Position P erkannt" 2 "Zwischenpostition erkannt" 3 "Fehler erkannt" DEFAULT_VALUE "" /end COMPU_VTAB
/begin COMPU_VTAB Conv.cUl2ItfipInt._.ps_sensor_status_l2_S5_S3 "Umrechnung fuer Messgroesse cUl2ItfipInt::ps_sensor_status_l2" TAB_VERB 3 0 "Signal i.O." 1 "Ersatzwert" 2 "Signal fehlerhaft" DEFAULT_VALUE "" /end COMPU_VTAB
/begin COMPU_VTAB Conv.cUl2ItfipInt._.v_unplausibel_l2_S5_S3 "Umrechnung fuer Messgroesse cUl2ItfipInt::v_unplausibel_l2" TAB_VERB 2 0 "plausibel" 1 "unplausibel" DEFAULT_VALUE "" /end COMPU_VTAB
/begin COMPU_VTAB Conv.cUl2ItfipUewFl._.me_red_status_S5_S3 "Umrechnung fuer Messgroesse cUl2ItfipUewFl::me_red_status" TAB_VERB 4 0 "keine Momentenanforderung" 1 "Momentenerhoehung" 2 "Momentenerniedrigung" 3 "Signal ungueltig" DEFAULT_VALUE "" /end COMPU_VTAB
/begin COMPU_VTAB Conv.cUl2ItfipUewFl._.zielgang_sas_S5_S3 "Umrechnung fuer Messgroesse cUl2ItfipUewFl::zielgang_sas" TAB_VERB 10 -1 "GR1" 0 "KEIN_GANG" 1 "G1" 2 "G2" 3 "G3" 4 "G4" 5 "G5" 6 "G6" 7 "G7" 8 "G8" DEFAULT_VALUE "" /end COMPU_VTAB
/begin COMPU_VTAB Conv.cUl2ItfipUewInt._.me_red_status_S5_S3 "Umrechnung fuer Messgroesse cUl2ItfipUewInt::me_red_status" TAB_VERB 4 0 "keine Momentenanforderung" 1 "Momentenerhoehung" 2 "Momentenerniedrigung" 3 "Signal ungueltig" DEFAULT_VALUE "" /end COMPU_VTAB
/begin COMPU_VTAB Conv.cUl2ItfipUewInt._.zielgang_sas_S5_S3 "Umrechnung fuer Messgroesse cUl2ItfipUewInt::zielgang_sas" TAB_VERB 10 -1 "GR1" 0 "KEIN_GANG" 1 "G1" 2 "G2" 3 "G3" 4 "G4" 5 "G5" 6 "G6" 7 "G7" 8 "G8" DEFAULT_VALUE "" /end COMPU_VTAB
/begin COMPU_VTAB Conv.cUl2K0SPlausiInt._.n_diff_k0_einmalig_S5_S3 "Umrechnung fuer Messgroesse cUl2K0SPlausiInt::n_diff_k0_einmalig" TAB_VERB 2 0 "Ueberwachen NICHT aktiv" 1 "Ueberwachen aktiv" DEFAULT_VALUE "" /end COMPU_VTAB
/begin COMPU_VTAB Conv.cUl2K0SPlausiInt._.st_fehler_S5_S3 "Umrechnung fuer Messgroesse cUl2K0SPlausiInt::st_fehler" TAB_VERB 3 0 "ST_FEHLER_UNDEFINIERT_INT" 1 "ST_FEHLER_NICHT_VORHANDEN_INT" 2 "ST_FEHLER_VORHANDEN_INT" DEFAULT_VALUE "" /end COMPU_VTAB
/begin COMPU_METHOD Conv.cBasFehlerErfolgFl._.flag_fehler_S5_S3 "Umrechnung fuer Messgroesse cBasFehlerErfolgFl::flag_fehler" TAB_VERB "%4.0" "" COMPU_TAB_REF Conv.cBasFehlerErfolgFl._.flag_fehler_S5_S3 /end COMPU_METHOD
/begin COMPU_METHOD Conv.cBasFehlerErfolgInt._.flag_fehler_S5_S3 "Umrechnung fuer Messgroesse cBasFehlerErfolgInt::flag_fehler" TAB_VERB "%4.0" "" COMPU_TAB_REF Conv.cBasFehlerErfolgInt._.flag_fehler_S5_S3 /end COMPU_METHOD
/begin COMPU_METHOD Conv.cSasAnKzu._.f_hinsyn_kzu_gestartet_S5_S3 "Umrechnung fuer Messgroesse cSasAnKzu::f_hinsyn_kzu_gestartet" TAB_VERB "%4.0" "" COMPU_TAB_REF Conv.cSasAnKzu._.f_hinsyn_kzu_gestartet_S5_S3 /end COMPU_METHOD
/begin COMPU_METHOD Conv.cSasAnKzu._.f_ngs_abflare_unterschritten_S5_S3 "Umrechnung fuer Messgroesse cSasAnKzu::f_ngs_abflare_unterschritten" TAB_VERB "%4.0" "" COMPU_TAB_REF Conv.cSasAnKzu._.f_ngs_abflare_unterschritten_S5_S3 /end COMPU_METHOD
/begin COMPU_METHOD Conv.cSasAnKzu._.f_pokzufol_erlaubt_S5_S3 "Umrechnung fuer Messgroesse cSasAnKzu::f_pokzufol_erlaubt" TAB_VERB "%4.0" "" COMPU_TAB_REF Conv.cSasAnKzu._.f_pokzufol_erlaubt_S5_S3 /end COMPU_METHOD
/begin COMPU_METHOD Conv.cSasAnKzu._.f_rampenzeitberechnung_fertig_S5_S3 "Umrechnung fuer Messgroesse cSasAnKzu::f_rampenzeitberechnung_fertig" TAB_VERB "%4.0" "" COMPU_TAB_REF Conv.cSasAnKzu._.f_rampenzeitberechnung_fertig_S5_S3 /end COMPU_METHOD
/begin COMPU_METHOD Conv.cSasAnKzu._.f_schnellfuellung_war_aktiv_S5_S3 "Umrechnung fuer Messgroesse cSasAnKzu::f_schnellfuellung_war_aktiv" TAB_VERB "%4.0" "" COMPU_TAB_REF Conv.cSasAnKzu._.f_schnellfuellung_war_aktiv_S5_S3 /end COMPU_METHOD
/begin COMPU_METHOD Conv.cSasAnKzu._.fa_kzu_gestartet_S5_S3 "Umrechnung fuer Messgroesse cSasAnKzu::fa_kzu_gestartet" TAB_VERB "%4.0" "" COMPU_TAB_REF Conv.cSasAnKzu._.fa_kzu_gestartet_S5_S3 /end COMPU_METHOD
/begin COMPU_METHOD Conv.cSasAnKzu._.flag_pomekzu_erlaubt_S5_S3 "Umrechnung fuer Messgroesse cSasAnKzu::flag_pomekzu_erlaubt" TAB_VERB "%4.0" "" COMPU_TAB_REF Conv.cSasAnKzu._.flag_pomekzu_erlaubt_S5_S3 /end COMPU_METHOD
/begin COMPU_METHOD Conv.cSasAnKzu._.kup_kzu_S5_S3 "Umrechnung fuer Messgroesse cSasAnKzu::kup_kzu" TAB_VERB "%4.0" "" COMPU_TAB_REF Conv.cSasAnKzu._.kup_kzu_S5_S3 /end COMPU_METHOD
/begin COMPU_METHOD Conv.cSasAnKzu._.p_fkzu_gueltig_S5_S3 "Umrechnung fuer Messgroesse cSasAnKzu::p_fkzu_gueltig" TAB_VERB "%4.0" "" COMPU_TAB_REF Conv.cSasAnKzu._.p_fkzu_gueltig_S5_S3 /end COMPU_METHOD
/begin COMPU_METHOD Conv.cSasAnKzu._.ra1_hsrs_kzu_gestartet_S5_S3 "Umrechnung fuer Messgroesse cSasAnKzu::ra1_hsrs_kzu_gestartet" TAB_VERB "%4.0" "" COMPU_TAB_REF Conv.cSasAnKzu._.ra1_hsrs_kzu_gestartet_S5_S3 /end COMPU_METHOD
/begin COMPU_METHOD Conv.cSasAnKzu._.ra2_hsrs_kzu_gestartet_S5_S3 "Umrechnung fuer Messgroesse cSasAnKzu::ra2_hsrs_kzu_gestartet" TAB_VERB "%4.0" "" COMPU_TAB_REF Conv.cSasAnKzu._.ra2_hsrs_kzu_gestartet_S5_S3 /end COMPU_METHOD
/begin COMPU_METHOD Conv.cSasAnKzu._.ra3_hsrs_kzu_gestartet_S5_S3 "Umrechnung fuer Messgroesse cSasAnKzu::ra3_hsrs_kzu_gestartet" TAB_VERB "%4.0" "" COMPU_TAB_REF Conv.cSasAnKzu._.ra3_hsrs_kzu_gestartet_S5_S3 /end COMPU_METHOD
/begin COMPU_METHOD Conv.cSasAnKzu._.schalttyp_kzu_S5_S3 "Umrechnung fuer Messgroesse cSasAnKzu::schalttyp_kzu" TAB_VERB "%4.0" "" COMPU_TAB_REF Conv.cSasAnKzu._.schalttyp_kzu_S5_S3 /end COMPU_METHOD
/begin COMPU_METHOD Conv.cSasAnKzu._.schliessen_kzu_S5_S3 "Umrechnung fuer Messgroesse cSasAnKzu::schliessen_kzu" TAB_VERB "%4.0" "" COMPU_TAB_REF Conv.cSasAnKzu._.schliessen_kzu_S5_S3 /end COMPU_METHOD
/begin COMPU_METHOD Conv.cSasAnKzu._.statisch_kzu_S5_S3 "Umrechnung fuer Messgroesse cSasAnKzu::statisch_kzu" TAB_VERB "%4.0" "" COMPU_TAB_REF Conv.cSasAnKzu._.statisch_kzu_S5_S3 /end COMPU_METHOD
/begin COMPU_METHOD Conv.cSasAnKzu._.t_vkabr_abgelaufen_S5_S3 "Umrechnung fuer Messgroesse cSasAnKzu::t_vkabr_abgelaufen" TAB_VERB "%4.0" "" COMPU_TAB_REF Conv.cSasAnKzu._.t_vkabr_abgelaufen_S5_S3 /end COMPU_METHOD
/begin COMPU_METHOD Conv.cSasAnKzu._.z_kzu_S5_S3 "Umrechnung fuer Messgroesse cSasAnKzu::z_kzu" TAB_VERB "%4.0" "" COMPU_TAB_REF Conv.cSasAnKzu._.z_kzu_S5_S3 /end COMPU_METHOD
/begin COMPU_METHOD Conv.cSasSaKor._.index_spsas_S5_S3 "Umrechnung fuer Messgroesse cSasSaKor::index_spsas" TAB_VERB "%4.0" "" COMPU_TAB_REF Conv.cSasSaKor._.index_spsas_S5_S3 /end COMPU_METHOD
/begin COMPU_METHOD Conv.cSasSaKor._.istgang_sas_S5_S3 "Umrechnung fuer Messgroesse cSasSaKor::istgang_sas" TAB_VERB "%4.0" "" COMPU_TAB_REF Conv.cSasSaKor._.istgang_sas_S5_S3 /end COMPU_METHOD
/begin COMPU_METHOD Conv.cSasSaKor._.kup_schutz_massnahme_aktiv_S5_S3 "Umrechnung fuer Messgroesse cSasSaKor::kup_schutz_massnahme_aktiv" TAB_VERB "%4.0" "" COMPU_TAB_REF Conv.cSasSaKor._.kup_schutz_massnahme_aktiv_S5_S3 /end COMPU_METHOD
/begin COMPU_METHOD Conv.cSasSaKor._.schaltinfo_sas_S5_S3 "Umrechnung fuer Messgroesse cSasSaKor::schaltinfo_sas" TAB_VERB "%4.0" "" COMPU_TAB_REF Conv.cSasSaKor._.schaltinfo_sas_S5_S3 /end COMPU_METHOD
/begin COMPU_METHOD Conv.cSasSaKor._.schaltinfo_sas_vor_folge_S5_S3 "Umrechnung fuer Messgroesse cSasSaKor::schaltinfo_sas_vor_folge" TAB_VERB "%4.0" "" COMPU_TAB_REF Conv.cSasSaKor._.schaltinfo_sas_vor_folge_S5_S3 /end COMPU_METHOD
/begin COMPU_METHOD Conv.cSasSaKor._.schaltinfo_syn_S5_S3 "Umrechnung fuer Messgroesse cSasSaKor::schaltinfo_syn" TAB_VERB "%4.0" "" COMPU_TAB_REF Conv.cSasSaKor._.schaltinfo_syn_S5_S3 /end COMPU_METHOD
/begin COMPU_METHOD Conv.cSasSaKor._.schnellfuellung_beendet_S5_S3 "Umrechnung fuer Messgroesse cSasSaKor::schnellfuellung_beendet" TAB_VERB "%4.0" "" COMPU_TAB_REF Conv.cSasSaKor._.schnellfuellung_beendet_S5_S3 /end COMPU_METHOD
/begin COMPU_METHOD Conv.cSasSaKor._.schnellfuellung_gestartet_S5_S3 "Umrechnung fuer Messgroesse cSasSaKor::schnellfuellung_gestartet" TAB_VERB "%4.0" "" COMPU_TAB_REF Conv.cSasSaKor._.schnellfuellung_gestartet_S5_S3 /end COMPU_METHOD
/begin COMPU_METHOD Conv.cSasSaKor._.synchron_S5_S3 "Umrechnung fuer Messgroesse cSasSaKor::synchron" TAB_VERB "%4.0" "" COMPU_TAB_REF Conv.cSasSaKor._.synchron_S5_S3 /end COMPU_METHOD
/begin COMPU_METHOD Conv.cSasSaKor._.synchron_verboten_S5_S3 "Umrechnung fuer Messgroesse cSasSaKor::synchron_verboten" TAB_VERB "%4.0" "" COMPU_TAB_REF Conv.cSasSaKor._.synchron_verboten_S5_S3 /end COMPU_METHOD
/begin COMPU_METHOD Conv.cSasSaKor._.timeout_S5_S3 "Umrechnung fuer Messgroesse cSasSaKor::timeout" TAB_VERB "%4.0" "" COMPU_TAB_REF Conv.cSasSaKor._.timeout_S5_S3 /end COMPU_METHOD
/begin COMPU_METHOD Conv.cSasSaKor._.z_kurze_schaltung_S5_S3 "Umrechnung fuer Messgroesse cSasSaKor::z_kurze_schaltung" TAB_VERB "%4.0" "" COMPU_TAB_REF Conv.cSasSaKor._.z_kurze_schaltung_S5_S3 /end COMPU_METHOD
/begin COMPU_METHOD Conv.cSasSaKor._.zielgang_sas_S5_S3 "Umrechnung fuer Messgroesse cSasSaKor::zielgang_sas" TAB_VERB "%4.0" "" COMPU_TAB_REF Conv.cSasSaKor._.zielgang_sas_S5_S3 /end COMPU_METHOD
/begin COMPU_METHOD Conv.cSasSaKor._.zwangssynchron_S5_S3 "Umrechnung fuer Messgroesse cSasSaKor::zwangssynchron" TAB_VERB "%4.0" "" COMPU_TAB_REF Conv.cSasSaKor._.zwangssynchron_S5_S3 /end COMPU_METHOD
/begin COMPU_METHOD Conv.cSasZentr._.kup_kzu_ada_S5_S3 "Umrechnung fuer Messgroesse cSasZentr::kup_kzu_ada" TAB_VERB "%4.0" "" COMPU_TAB_REF Conv.cSasZentr._.kup_kzu_ada_S5_S3 /end COMPU_METHOD
/begin COMPU_METHOD Conv.cSasZentr._.kup_nkraftloesend2_letztes_ga_S5_S3 "Umrechnung fuer Messgroesse cSasZentr::kup_nkraftloesend2_letztes_ga" TAB_VERB "%4.0" "" COMPU_TAB_REF Conv.cSasZentr._.kup_nkraftloesend2_letztes_ga_S5_S3 /end COMPU_METHOD
/begin COMPU_METHOD Conv.cSasZentr._.schaltart_sas_S5_S3 "Umrechnung fuer Messgroesse cSasZentr::schaltart_sas" TAB_VERB "%4.0" "" COMPU_TAB_REF Conv.cSasZentr._.schaltart_sas_S5_S3 /end COMPU_METHOD
/begin COMPU_METHOD Conv.cSasZentr._.schalttyp_S5_S3 "Umrechnung fuer Messgroesse cSasZentr::schalttyp" TAB_VERB "%4.0" "" COMPU_TAB_REF Conv.cSasZentr._.schalttyp_S5_S3 /end COMPU_METHOD
/begin COMPU_METHOD Conv.cSasZentr._.schalttyp_sas_S5_S3 "Umrechnung fuer Messgroesse cSasZentr::schalttyp_sas" TAB_VERB "%4.0" "" COMPU_TAB_REF Conv.cSasZentr._.schalttyp_sas_S5_S3 /end COMPU_METHOD
/begin COMPU_METHOD Conv.cSasZentr._.schaltung_abgebrochen_S5_S3 "Umrechnung fuer Messgroesse cSasZentr::schaltung_abgebrochen" TAB_VERB "%4.0" "" COMPU_TAB_REF Conv.cSasZentr._.schaltung_abgebrochen_S5_S3 /end COMPU_METHOD
/begin COMPU_METHOD Conv.cSasZentr._.schaltung_sas_S5_S3 "Umrechnung fuer Messgroesse cSasZentr::schaltung_sas" TAB_VERB "%4.0" "" COMPU_TAB_REF Conv.cSasZentr._.schaltung_sas_S5_S3 /end COMPU_METHOD
/begin COMPU_METHOD Conv.cSasZentr._.schaltung_ueber_kzu_S5_S3 "Umrechnung fuer Messgroesse cSasZentr::schaltung_ueber_kzu" TAB_VERB "%4.0" "" COMPU_TAB_REF Conv.cSasZentr._.schaltung_ueber_kzu_S5_S3 /end COMPU_METHOD
/begin COMPU_METHOD Conv.cSasZentr._.schaltungsende_durch_ge_ga_S5_S3 "Umrechnung fuer Messgroesse cSasZentr::schaltungsende_durch_ge_ga" TAB_VERB "%4.0" "" COMPU_TAB_REF Conv.cSasZentr._.schaltungsende_durch_ge_ga_S5_S3 /end COMPU_METHOD
/begin COMPU_METHOD Conv.cSasZentr._.schrittschaltung_S5_S3 "Umrechnung fuer Messgroesse cSasZentr::schrittschaltung" TAB_VERB "%4.0" "" COMPU_TAB_REF Conv.cSasZentr._.schrittschaltung_S5_S3 /end COMPU_METHOD
/begin COMPU_METHOD Conv.cSasZentr._.sync_istgang_verlassen_me_S5_S3 "Umrechnung fuer Messgroesse cSasZentr::sync_istgang_verlassen_me" TAB_VERB "%4.0" "" COMPU_TAB_REF Conv.cSasZentr._.sync_istgang_verlassen_me_S5_S3 /end COMPU_METHOD
/begin COMPU_METHOD Conv.cSasZentr._.sync_istgang_verlassen_S5_S3 "Umrechnung fuer Messgroesse cSasZentr::sync_istgang_verlassen" TAB_VERB "%4.0" "" COMPU_TAB_REF Conv.cSasZentr._.sync_istgang_verlassen_S5_S3 /end COMPU_METHOD
/begin COMPU_METHOD Conv.cSasZentr._.sync_ziel_erreicht_S5_S3 "Umrechnung fuer Messgroesse cSasZentr::sync_ziel_erreicht" TAB_VERB "%4.0" "" COMPU_TAB_REF Conv.cSasZentr._.sync_ziel_erreicht_S5_S3 /end COMPU_METHOD
/begin COMPU_METHOD Conv.cSasZentr._.vorbereitung_im_vordergrund_S5_S3 "Umrechnung fuer Messgroesse cSasZentr::vorbereitung_im_vordergrund" TAB_VERB "%4.0" "" COMPU_TAB_REF Conv.cSasZentr._.vorbereitung_im_vordergrund_S5_S3 /end COMPU_METHOD
/begin COMPU_METHOD Conv.cSasZentr._.wechsel_normal_kurz_S5_S3 "Umrechnung fuer Messgroesse cSasZentr::wechsel_normal_kurz" TAB_VERB "%4.0" "" COMPU_TAB_REF Conv.cSasZentr._.wechsel_normal_kurz_S5_S3 /end COMPU_METHOD
/begin COMPU_METHOD Conv.cSasZentr._.z_m_motmax_kupschtz_S5_S3 "Umrechnung fuer Messgroesse cSasZentr::z_m_motmax_kupschtz" TAB_VERB "%4.0" "" COMPU_TAB_REF Conv.cSasZentr._.z_m_motmax_kupschtz_S5_S3 /end COMPU_METHOD
/begin COMPU_METHOD Conv.cSasZentr._.z_m_motmax_sas_S5_S3 "Umrechnung fuer Messgroesse cSasZentr::z_m_motmax_sas" TAB_VERB "%4.0" "" COMPU_TAB_REF Conv.cSasZentr._.z_m_motmax_sas_S5_S3 /end COMPU_METHOD
/begin COMPU_METHOD Conv.cSasZentr._.z_sync_ziel_S5_S3 "Umrechnung fuer Messgroesse cSasZentr::z_sync_ziel" TAB_VERB "%4.0" "" COMPU_TAB_REF Conv.cSasZentr._.z_sync_ziel_S5_S3 /end COMPU_METHOD
/begin COMPU_METHOD Conv.cSasZentr._.zs_wechsel_verboten_S5_S3 "Umrechnung fuer Messgroesse cSasZentr::zs_wechsel_verboten" TAB_VERB "%4.0" "" COMPU_TAB_REF Conv.cSasZentr._.zs_wechsel_verboten_S5_S3 /end COMPU_METHOD
/begin COMPU_METHOD Conv.cSasZentr._.zug_schub_sas_S5_S3 "Umrechnung fuer Messgroesse cSasZentr::zug_schub_sas" TAB_VERB "%4.0" "" COMPU_TAB_REF Conv.cSasZentr._.zug_schub_sas_S5_S3 /end COMPU_METHOD
/begin COMPU_METHOD Conv.cTciCompu._.f_timer_belast_ber_kab_gestartet_S5_S3 "Umrechnung fuer Messgroesse cTciCompu::f_timer_belast_ber_kab_gestartet" TAB_VERB "%4.0" "" COMPU_TAB_REF Conv.cTciCompu._.f_timer_belast_ber_kab_gestartet_S5_S3 /end COMPU_METHOD
/begin COMPU_METHOD Conv.cTciCompu._.f_timer_belast_ber_kzu_gestartet_S5_S3 "Umrechnung fuer Messgroesse cTciCompu::f_timer_belast_ber_kzu_gestartet" TAB_VERB "%4.0" "" COMPU_TAB_REF Conv.cTciCompu._.f_timer_belast_ber_kzu_gestartet_S5_S3 /end COMPU_METHOD
/begin COMPU_METHOD Conv.cTciCompu._.flag_ende_kab_ber_erreicht_S5_S3 "Umrechnung fuer Messgroesse cTciCompu::flag_ende_kab_ber_erreicht" TAB_VERB "%4.0" "" COMPU_TAB_REF Conv.cTciCompu._.flag_ende_kab_ber_erreicht_S5_S3 /end COMPU_METHOD
/begin COMPU_METHOD Conv.cTciCompu._.flag_ende_kzu_ber_erreicht_S5_S3 "Umrechnung fuer Messgroesse cTciCompu::flag_ende_kzu_ber_erreicht" TAB_VERB "%4.0" "" COMPU_TAB_REF Conv.cTciCompu._.flag_ende_kzu_ber_erreicht_S5_S3 /end COMPU_METHOD
/begin COMPU_METHOD Conv.cTciCompu._.flag_schaltung_ende_S5_S3 "Umrechnung fuer Messgroesse cTciCompu::flag_schaltung_ende" TAB_VERB "%4.0" "" COMPU_TAB_REF Conv.cTciCompu._.flag_schaltung_ende_S5_S3 /end COMPU_METHOD
/begin COMPU_METHOD Conv.cTciCompu._.istgang_idx_merk_S5_S3 "Umrechnung fuer Messgroesse cTciCompu::istgang_idx_merk" TAB_VERB "%4.0" "" COMPU_TAB_REF Conv.cTciCompu._.istgang_idx_merk_S5_S3 /end COMPU_METHOD
/begin COMPU_METHOD Conv.cTciCompu._.k_ab_S5_S3 "Umrechnung fuer Messgroesse cTciCompu::k_ab" TAB_VERB "%4.0" "" COMPU_TAB_REF Conv.cTciCompu._.k_ab_S5_S3 /end COMPU_METHOD
/begin COMPU_METHOD Conv.cTciCompu._.k_zu_S5_S3 "Umrechnung fuer Messgroesse cTciCompu::k_zu" TAB_VERB "%4.0" "" COMPU_TAB_REF Conv.cTciCompu._.k_zu_S5_S3 /end COMPU_METHOD
/begin COMPU_METHOD Conv.cTciCompu._.schaltart_sas_red_tci_S5_S3 "Umrechnung fuer Messgroesse cTciCompu::schaltart_sas_red_tci" TAB_VERB "%4.0" "" COMPU_TAB_REF Conv.cTciCompu._.schaltart_sas_red_tci_S5_S3 /end COMPU_METHOD
/begin COMPU_METHOD Conv.cTciCompu._.z_tci_S5_S3 "Umrechnung fuer Messgroesse cTciCompu::z_tci" TAB_VERB "%4.0" "" COMPU_TAB_REF Conv.cTciCompu._.z_tci_S5_S3 /end COMPU_METHOD
/begin COMPU_METHOD Conv.cTciCompu._.zielgang_sas_idx_merk_S5_S3 "Umrechnung fuer Messgroesse cTciCompu::zielgang_sas_idx_merk" TAB_VERB "%4.0" "" COMPU_TAB_REF Conv.cTciCompu._.zielgang_sas_idx_merk_S5_S3 /end COMPU_METHOD
/begin COMPU_METHOD Conv.cTciTempM._.f_aufheizung_aktiv_S5_S3 "Umrechnung fuer Messgroesse cTciTempM::f_aufheizung_aktiv" TAB_VERB "%4.0" "" COMPU_TAB_REF Conv.cTciTempM._.f_aufheizung_aktiv_S5_S3 /end COMPU_METHOD
/begin COMPU_METHOD Conv.cTciTempM._.kupplung_S5_S3 "Umrechnung fuer Messgroesse cTciTempM::kupplung" TAB_VERB "%4.0" "" COMPU_TAB_REF Conv.cTciTempM._.kupplung_S5_S3 /end COMPU_METHOD
/begin COMPU_METHOD Conv.cUewIgetr._.b_uwig_auf_symptom_pruefen_S5_S3 "Umrechnung fuer Messgroesse cUewIgetr::b_uwig_auf_symptom_pruefen" TAB_VERB "%4.0" "" COMPU_TAB_REF Conv.cUewIgetr._.b_uwig_auf_symptom_pruefen_S5_S3 /end COMPU_METHOD
/begin COMPU_METHOD Conv.cUewIgetr._.f_abbruch_akt_ueberwachung_S5_S3 "Umrechnung fuer Messgroesse cUewIgetr::f_abbruch_akt_ueberwachung" TAB_VERB "%4.0" "" COMPU_TAB_REF Conv.cUewIgetr._.f_abbruch_akt_ueberwachung_S5_S3 /end COMPU_METHOD
/begin COMPU_METHOD Conv.cUewIgetr._.f_ersatzprogramm_aktiv_S5_S3 "Umrechnung fuer Messgroesse cUewIgetr::f_ersatzprogramm_aktiv" TAB_VERB "%4.0" "" COMPU_TAB_REF Conv.cUewIgetr._.f_ersatzprogramm_aktiv_S5_S3 /end COMPU_METHOD
/begin COMPU_METHOD Conv.cUewIgetr._.f_ersatzwert_stc_S5_S3 "Umrechnung fuer Messgroesse cUewIgetr::f_ersatzwert_stc" TAB_VERB "%4.0" "" COMPU_TAB_REF Conv.cUewIgetr._.f_ersatzwert_stc_S5_S3 /end COMPU_METHOD
/begin COMPU_METHOD Conv.cUewIgetr._.f_ist_ersatzgang_gang_stc_S5_S3 "Umrechnung fuer Messgroesse cUewIgetr::f_ist_ersatzgang_gang_stc" TAB_VERB "%4.0" "" COMPU_TAB_REF Conv.cUewIgetr._.f_ist_ersatzgang_gang_stc_S5_S3 /end COMPU_METHOD
/begin COMPU_METHOD Conv.cUewIgetr._.f_ist_ersatzgang_ge_stc_S5_S3 "Umrechnung fuer Messgroesse cUewIgetr::f_ist_ersatzgang_ge_stc" TAB_VERB "%4.0" "" COMPU_TAB_REF Conv.cUewIgetr._.f_ist_ersatzgang_ge_stc_S5_S3 /end COMPU_METHOD
/begin COMPU_METHOD Conv.cUewIgetr._.f_ist_ersatzgang_schalt_stc_S5_S3 "Umrechnung fuer Messgroesse cUewIgetr::f_ist_ersatzgang_schalt_stc" TAB_VERB "%4.0" "" COMPU_TAB_REF Conv.cUewIgetr._.f_ist_ersatzgang_schalt_stc_S5_S3 /end COMPU_METHOD
/begin COMPU_METHOD Conv.cUewIgetr._.f_ist_ge_stc_S5_S3 "Umrechnung fuer Messgroesse cUewIgetr::f_ist_ge_stc" TAB_VERB "%4.0" "" COMPU_TAB_REF Conv.cUewIgetr._.f_ist_ge_stc_S5_S3 /end COMPU_METHOD
/begin COMPU_METHOD Conv.cUewIgetr._.f_ist_nab_kleiner_schwelle_stc_S5_S3 "Umrechnung fuer Messgroesse cUewIgetr::f_ist_nab_kleiner_schwelle_stc" TAB_VERB "%4.0" "" COMPU_TAB_REF Conv.cUewIgetr._.f_ist_nab_kleiner_schwelle_stc_S5_S3 /end COMPU_METHOD
/begin COMPU_METHOD Conv.cUewIgetr._.f_ist_neue_schaltung_stc_S5_S3 "Umrechnung fuer Messgroesse cUewIgetr::f_ist_neue_schaltung_stc" TAB_VERB "%4.0" "" COMPU_TAB_REF Conv.cUewIgetr._.f_ist_neue_schaltung_stc_S5_S3 /end COMPU_METHOD
/begin COMPU_METHOD Conv.cUewIgetr._.f_ist_neues_ge_stc_S5_S3 "Umrechnung fuer Messgroesse cUewIgetr::f_ist_neues_ge_stc" TAB_VERB "%4.0" "" COMPU_TAB_REF Conv.cUewIgetr._.f_ist_neues_ge_stc_S5_S3 /end COMPU_METHOD
/begin COMPU_METHOD Conv.cUewIgetr._.f_ist_schaltung_stc_S5_S3 "Umrechnung fuer Messgroesse cUewIgetr::f_ist_schaltung_stc" TAB_VERB "%4.0" "" COMPU_TAB_REF Conv.cUewIgetr._.f_ist_schaltung_stc_S5_S3 /end COMPU_METHOD
/begin COMPU_METHOD Conv.cUewIgetr._.f_ist_stoerung_stc_S5_S3 "Umrechnung fuer Messgroesse cUewIgetr::f_ist_stoerung_stc" TAB_VERB "%4.0" "" COMPU_TAB_REF Conv.cUewIgetr._.f_ist_stoerung_stc_S5_S3 /end COMPU_METHOD
/begin COMPU_METHOD Conv.cUewIgetr._.f_ist_symptom_gang_stc_S5_S3 "Umrechnung fuer Messgroesse cUewIgetr::f_ist_symptom_gang_stc" TAB_VERB "%4.0" "" COMPU_TAB_REF Conv.cUewIgetr._.f_ist_symptom_gang_stc_S5_S3 /end COMPU_METHOD
/begin COMPU_METHOD Conv.cUewIgetr._.f_ist_symptom_ge_stc_S5_S3 "Umrechnung fuer Messgroesse cUewIgetr::f_ist_symptom_ge_stc" TAB_VERB "%4.0" "" COMPU_TAB_REF Conv.cUewIgetr._.f_ist_symptom_ge_stc_S5_S3 /end COMPU_METHOD
/begin COMPU_METHOD Conv.cUewIgetr._.f_ist_symptom_schalt_stc_S5_S3 "Umrechnung fuer Messgroesse cUewIgetr::f_ist_symptom_schalt_stc" TAB_VERB "%4.0" "" COMPU_TAB_REF Conv.cUewIgetr._.f_ist_symptom_schalt_stc_S5_S3 /end COMPU_METHOD
/begin COMPU_METHOD Conv.cUewIgetr._.f_pruefbed_im_gang_erreicht_stc_S5_S3 "Umrechnung fuer Messgroesse cUewIgetr::f_pruefbed_im_gang_erreicht_stc" TAB_VERB "%4.0" "" COMPU_TAB_REF Conv.cUewIgetr._.f_pruefbed_im_gang_erreicht_stc_S5_S3 /end COMPU_METHOD
/begin COMPU_METHOD Conv.cUewIgetr._.f_schalt_durch_sym_schalt_stc_S5_S3 "Umrechnung fuer Messgroesse cUewIgetr::f_schalt_durch_sym_schalt_stc" TAB_VERB "%4.0" "" COMPU_TAB_REF Conv.cUewIgetr._.f_schalt_durch_sym_schalt_stc_S5_S3 /end COMPU_METHOD
/begin COMPU_METHOD Conv.cUewIgetr._.f_stoer_offset_in_schaltung_stc_S5_S3 "Umrechnung fuer Messgroesse cUewIgetr::f_stoer_offset_in_schaltung_stc" TAB_VERB "%4.0" "" COMPU_TAB_REF Conv.cUewIgetr._.f_stoer_offset_in_schaltung_stc_S5_S3 /end COMPU_METHOD
/begin COMPU_METHOD Conv.cUewIgetr._.f_timer16_rampe_gestartet_stc_S5_S3 "Umrechnung fuer Messgroesse cUewIgetr::f_timer16_rampe_gestartet_stc" TAB_VERB "%4.0" "" COMPU_TAB_REF Conv.cUewIgetr._.f_timer16_rampe_gestartet_stc_S5_S3 /end COMPU_METHOD
/begin COMPU_METHOD Conv.cUewIgetr._.f_ueberwache_ge_stc_S5_S3 "Umrechnung fuer Messgroesse cUewIgetr::f_ueberwache_ge_stc" TAB_VERB "%4.0" "" COMPU_TAB_REF Conv.cUewIgetr._.f_ueberwache_ge_stc_S5_S3 /end COMPU_METHOD
/begin COMPU_METHOD Conv.cUewIgetr._.fl_erf_iepuwig_S5_S3 "Umrechnung fuer Messgroesse cUewIgetr::fl_erf_iepuwig" TAB_VERB "%4.0" "" COMPU_TAB_REF Conv.cUewIgetr._.fl_erf_iepuwig_S5_S3 /end COMPU_METHOD
/begin COMPU_METHOD Conv.cUewIgetr._.fl_sym_iepuwig_S5_S3 "Umrechnung fuer Messgroesse cUewIgetr::fl_sym_iepuwig" TAB_VERB "%4.0" "" COMPU_TAB_REF Conv.cUewIgetr._.fl_sym_iepuwig_S5_S3 /end COMPU_METHOD
/begin COMPU_METHOD Conv.cUewIgetr._.flg_kfc_ratioglobal_S5_S3 "Umrechnung fuer Messgroesse cUewIgetr::flg_kfc_ratioglobal" TAB_VERB "%4.0" "" COMPU_TAB_REF Conv.cUewIgetr._.flg_kfc_ratioglobal_S5_S3 /end COMPU_METHOD
/begin COMPU_METHOD Conv.cUewIgetr._.flg_kuppident_S5_S3 "Umrechnung fuer Messgroesse cUewIgetr::flg_kuppident" TAB_VERB "%4.0" "" COMPU_TAB_REF Conv.cUewIgetr._.flg_kuppident_S5_S3 /end COMPU_METHOD
/begin COMPU_METHOD Conv.cUewIgetr._.istgang_akt_uew_stc_S5_S3 "Umrechnung fuer Messgroesse cUewIgetr::istgang_akt_uew_stc" TAB_VERB "%4.0" "" COMPU_TAB_REF Conv.cUewIgetr._.istgang_akt_uew_stc_S5_S3 /end COMPU_METHOD
/begin COMPU_METHOD Conv.cUewIgetr._.istgang_vorherige_schaltung_stc_S5_S3 "Umrechnung fuer Messgroesse cUewIgetr::istgang_vorherige_schaltung_stc" TAB_VERB "%4.0" "" COMPU_TAB_REF Conv.cUewIgetr._.istgang_vorherige_schaltung_stc_S5_S3 /end COMPU_METHOD
/begin COMPU_METHOD Conv.cUewIgetr._.kfl_ziel_bei_symptom_stc_S5_S3 "Umrechnung fuer Messgroesse cUewIgetr::kfl_ziel_bei_symptom_stc" TAB_VERB "%4.0" "" COMPU_TAB_REF Conv.cUewIgetr._.kfl_ziel_bei_symptom_stc_S5_S3 /end COMPU_METHOD
/begin COMPU_METHOD Conv.cUewIgetr._.kup_ge1_stc_S5_S3 "Umrechnung fuer Messgroesse cUewIgetr::kup_ge1_stc" TAB_VERB "%4.0" "" COMPU_TAB_REF Conv.cUewIgetr._.kup_ge1_stc_S5_S3 /end COMPU_METHOD
/begin COMPU_METHOD Conv.cUewIgetr._.kup_ge2_stc_S5_S3 "Umrechnung fuer Messgroesse cUewIgetr::kup_ge2_stc" TAB_VERB "%4.0" "" COMPU_TAB_REF Conv.cUewIgetr._.kup_ge2_stc_S5_S3 /end COMPU_METHOD
/begin COMPU_METHOD Conv.cUewIgetr._.kup_ge3_stc_S5_S3 "Umrechnung fuer Messgroesse cUewIgetr::kup_ge3_stc" TAB_VERB "%4.0" "" COMPU_TAB_REF Conv.cUewIgetr._.kup_ge3_stc_S5_S3 /end COMPU_METHOD
/begin COMPU_METHOD Conv.cUewIgetr._.schaltart_akt_uew_stc_S5_S3 "Umrechnung fuer Messgroesse cUewIgetr::schaltart_akt_uew_stc" TAB_VERB "%4.0" "" COMPU_TAB_REF Conv.cUewIgetr._.schaltart_akt_uew_stc_S5_S3 /end COMPU_METHOD
/begin COMPU_METHOD Conv.cUewIgetr._.symptom_reaktion_S5_S3 "Umrechnung fuer Messgroesse cUewIgetr::symptom_reaktion" TAB_VERB "%4.0" "" COMPU_TAB_REF Conv.cUewIgetr._.symptom_reaktion_S5_S3 /end COMPU_METHOD
/begin COMPU_METHOD Conv.cUewIgetr._.symptom_uwig_r_gang_aktiv_S5_S3 "Umrechnung fuer Messgroesse cUewIgetr::symptom_uwig_r_gang_aktiv" TAB_VERB "%4.0" "" COMPU_TAB_REF Conv.cUewIgetr._.symptom_uwig_r_gang_aktiv_S5_S3 /end COMPU_METHOD
/begin COMPU_METHOD Conv.cUewIgetr._.uwig_abbruchgang_S5_S3 "Umrechnung fuer Messgroesse cUewIgetr::uwig_abbruchgang" TAB_VERB "%4.0" "" COMPU_TAB_REF Conv.cUewIgetr._.uwig_abbruchgang_S5_S3 /end COMPU_METHOD
/begin COMPU_METHOD Conv.cUewIgetr._.uwig_pruefstatus_kup_a_S5_S3 "Umrechnung fuer Messgroesse cUewIgetr::uwig_pruefstatus_kup_a" TAB_VERB "%4.0" "" COMPU_TAB_REF Conv.cUewIgetr._.uwig_pruefstatus_kup_a_S5_S3 /end COMPU_METHOD
/begin COMPU_METHOD Conv.cUewIgetr._.uwig_pruefstatus_kup_b_S5_S3 "Umrechnung fuer Messgroesse cUewIgetr::uwig_pruefstatus_kup_b" TAB_VERB "%4.0" "" COMPU_TAB_REF Conv.cUewIgetr._.uwig_pruefstatus_kup_b_S5_S3 /end COMPU_METHOD
/begin COMPU_METHOD Conv.cUewIgetr._.uwig_pruefstatus_kup_c_S5_S3 "Umrechnung fuer Messgroesse cUewIgetr::uwig_pruefstatus_kup_c" TAB_VERB "%4.0" "" COMPU_TAB_REF Conv.cUewIgetr._.uwig_pruefstatus_kup_c_S5_S3 /end COMPU_METHOD
/begin COMPU_METHOD Conv.cUewIgetr._.uwig_pruefstatus_kup_d_S5_S3 "Umrechnung fuer Messgroesse cUewIgetr::uwig_pruefstatus_kup_d" TAB_VERB "%4.0" "" COMPU_TAB_REF Conv.cUewIgetr._.uwig_pruefstatus_kup_d_S5_S3 /end COMPU_METHOD
/begin COMPU_METHOD Conv.cUewIgetr._.uwig_pruefstatus_kup_e_S5_S3 "Umrechnung fuer Messgroesse cUewIgetr::uwig_pruefstatus_kup_e" TAB_VERB "%4.0" "" COMPU_TAB_REF Conv.cUewIgetr._.uwig_pruefstatus_kup_e_S5_S3 /end COMPU_METHOD
/begin COMPU_METHOD Conv.cUewIgetr._.zielgang_sas_akt_uew_stc_S5_S3 "Umrechnung fuer Messgroesse cUewIgetr::zielgang_sas_akt_uew_stc" TAB_VERB "%4.0" "" COMPU_TAB_REF Conv.cUewIgetr._.zielgang_sas_akt_uew_stc_S5_S3 /end COMPU_METHOD
/begin COMPU_METHOD Conv.cUewIgetr._.zustand_uwig_S5_S3 "Umrechnung fuer Messgroesse cUewIgetr::zustand_uwig" TAB_VERB "%4.0" "" COMPU_TAB_REF Conv.cUewIgetr._.zustand_uwig_S5_S3 /end COMPU_METHOD
/begin COMPU_METHOD Conv.cUewParksperrenmagnet._.flag_einstiegsbed_S5_S3 "Umrechnung fuer Messgroesse cUewParksperrenmagnet::flag_einstiegsbed" TAB_VERB "%4.0" "" COMPU_TAB_REF Conv.cUewParksperrenmagnet._.flag_einstiegsbed_S5_S3 /end COMPU_METHOD
/begin COMPU_METHOD Conv.cUewParksperrenmagnet._.flag_pmueb_S5_S3 "Umrechnung fuer Messgroesse cUewParksperrenmagnet::flag_pmueb" TAB_VERB "%4.0" "" COMPU_TAB_REF Conv.cUewParksperrenmagnet._.flag_pmueb_S5_S3 /end COMPU_METHOD
/begin COMPU_METHOD Conv.cUewParksperrenmagnet._.zustand_S5_S3 "Umrechnung fuer Messgroesse cUewParksperrenmagnet::zustand" TAB_VERB "%4.0" "" COMPU_TAB_REF Conv.cUewParksperrenmagnet._.zustand_S5_S3 /end COMPU_METHOD
/begin COMPU_METHOD Conv.cUewSgetf._.f_keine_egs_offtime_S5_S3 "Umrechnung fuer Messgroesse cUewSgetf::f_keine_egs_offtime" TAB_VERB "%4.0" "" COMPU_TAB_REF Conv.cUewSgetf._.f_keine_egs_offtime_S5_S3 /end COMPU_METHOD
/begin COMPU_METHOD Conv.cUewSgetf._.f_timer_zuendung_reset_S5_S3 "Umrechnung fuer Messgroesse cUewSgetf::f_timer_zuendung_reset" TAB_VERB "%4.0" "" COMPU_TAB_REF Conv.cUewSgetf._.f_timer_zuendung_reset_S5_S3 /end COMPU_METHOD
/begin COMPU_METHOD Conv.cUewSgetf._.i_edsc_min_S5_S3 "Umrechnung fuer Messgroesse cUewSgetf::i_edsc_min" TAB_VERB "%4.0" "" COMPU_TAB_REF Conv.cUewSgetf._.i_edsc_min_S5_S3 /end COMPU_METHOD
/begin COMPU_METHOD Conv.cUewSgetf._.posv_diagnose_aktiv_S5_S3 "Umrechnung fuer Messgroesse cUewSgetf::posv_diagnose_aktiv" TAB_VERB "%4.0" "" COMPU_TAB_REF Conv.cUewSgetf._.posv_diagnose_aktiv_S5_S3 /end COMPU_METHOD
/begin COMPU_METHOD Conv.cUewSgetf._.pruefung_posvmechdef_aktiv_S5_S3 "Umrechnung fuer Messgroesse cUewSgetf::pruefung_posvmechdef_aktiv" TAB_VERB "%4.0" "" COMPU_TAB_REF Conv.cUewSgetf._.pruefung_posvmechdef_aktiv_S5_S3 /end COMPU_METHOD
/begin COMPU_METHOD Conv.cUewSgetf._.ps_sensor_err_S5_S3 "Umrechnung fuer Messgroesse cUewSgetf::ps_sensor_err" TAB_VERB "%4.0" "" COMPU_TAB_REF Conv.cUewSgetf._.ps_sensor_err_S5_S3 /end COMPU_METHOD
/begin COMPU_METHOD Conv.cUewSgetf._.ps_sensor_signal_alt_S5_S3 "Umrechnung fuer Messgroesse cUewSgetf::ps_sensor_signal_alt" TAB_VERB "%4.0" "" COMPU_TAB_REF Conv.cUewSgetf._.ps_sensor_signal_alt_S5_S3 /end COMPU_METHOD
/begin COMPU_METHOD Conv.cUewSgetf._.pumpendruck_vorh_posv_uew_alt_S5_S3 "Umrechnung fuer Messgroesse cUewSgetf::pumpendruck_vorh_posv_uew_alt" TAB_VERB "%4.0" "" COMPU_TAB_REF Conv.cUewSgetf._.pumpendruck_vorh_posv_uew_alt_S5_S3 /end COMPU_METHOD
/begin COMPU_METHOD Conv.cUewSgetf._.zwangsposition_p_S5_S3 "Umrechnung fuer Messgroesse cUewSgetf::zwangsposition_p" TAB_VERB "%4.0" "" COMPU_TAB_REF Conv.cUewSgetf._.zwangsposition_p_S5_S3 /end COMPU_METHOD
/begin COMPU_METHOD Conv.cUewSgetf._.zz_zustand_S5_S3 "Umrechnung fuer Messgroesse cUewSgetf::zz_zustand" TAB_VERB "%4.0" "" COMPU_TAB_REF Conv.cUewSgetf._.zz_zustand_S5_S3 /end COMPU_METHOD
/begin COMPU_METHOD Conv.cUl2DrehzahlBeobFl._.fl_drehzbeob_schaltung_S5_S3 "Umrechnung fuer Messgroesse cUl2DrehzahlBeobFl::fl_drehzbeob_schaltung" TAB_VERB "%4.0" "" COMPU_TAB_REF Conv.cUl2DrehzahlBeobFl._.fl_drehzbeob_schaltung_S5_S3 /end COMPU_METHOD
/begin COMPU_METHOD Conv.cUl2DrehzahlBeobInt._.fl_drehzbeob_schaltung_S5_S3 "Umrechnung fuer Messgroesse cUl2DrehzahlBeobInt::fl_drehzbeob_schaltung" TAB_VERB "%4.0" "" COMPU_TAB_REF Conv.cUl2DrehzahlBeobInt._.fl_drehzbeob_schaltung_S5_S3 /end COMPU_METHOD
/begin COMPU_METHOD Conv.cUl2EdsBasisInt._.type_S5_S3 "Umrechnung fuer Messgroesse cUl2EdsBasisInt::type" TAB_VERB "%4.0" "" COMPU_TAB_REF Conv.cUl2EdsBasisInt._.type_S5_S3 /end COMPU_METHOD
/begin COMPU_METHOD Conv.cUl2EdsSignalFl._.globale_einst_bed_S5_S3 "Umrechnung fuer Messgroesse cUl2EdsSignalFl::globale_einst_bed" TAB_VERB "%4.0" "" COMPU_TAB_REF Conv.cUl2EdsSignalFl._.globale_einst_bed_S5_S3 /end COMPU_METHOD
/begin COMPU_METHOD Conv.cUl2EdsSignalFl._.posv_ueb_aktiv_l2_S5_S3 "Umrechnung fuer Messgroesse cUl2EdsSignalFl::posv_ueb_aktiv_l2" TAB_VERB "%4.0" "" COMPU_TAB_REF Conv.cUl2EdsSignalFl._.posv_ueb_aktiv_l2_S5_S3 /end COMPU_METHOD
/begin COMPU_METHOD Conv.cUl2EdsSignalInt._.globale_einst_bed_S5_S3 "Umrechnung fuer Messgroesse cUl2EdsSignalInt::globale_einst_bed" TAB_VERB "%4.0" "" COMPU_TAB_REF Conv.cUl2EdsSignalInt._.globale_einst_bed_S5_S3 /end COMPU_METHOD
/begin COMPU_METHOD Conv.cUl2EdsSignalInt._.pos_alt_S5_S3 "Umrechnung fuer Messgroesse cUl2EdsSignalInt::pos_alt" TAB_VERB "%4.0" "" COMPU_TAB_REF Conv.cUl2EdsSignalInt._.pos_alt_S5_S3 /end COMPU_METHOD
/begin COMPU_METHOD Conv.cUl2EdsSignalInt._.posv_ueb_aktiv_l2_S5_S3 "Umrechnung fuer Messgroesse cUl2EdsSignalInt::posv_ueb_aktiv_l2" TAB_VERB "%4.0" "" COMPU_TAB_REF Conv.cUl2EdsSignalInt._.posv_ueb_aktiv_l2_S5_S3 /end COMPU_METHOD
/begin COMPU_METHOD Conv.cUl2ItfipFl._.iv_dscfehlerl2komp_S5_S3 "Umrechnung fuer Messgroesse cUl2ItfipFl::iv_dscfehlerl2komp" TAB_VERB "%4.0" "" COMPU_TAB_REF Conv.cUl2ItfipFl._.iv_dscfehlerl2komp_S5_S3 /end COMPU_METHOD
/begin COMPU_METHOD Conv.cUl2ItfipFl._.iv_pos_l2_komp_S5_S3 "Umrechnung fuer Messgroesse cUl2ItfipFl::iv_pos_l2_komp" TAB_VERB "%4.0" "" COMPU_TAB_REF Conv.cUl2ItfipFl._.iv_pos_l2_komp_S5_S3 /end COMPU_METHOD
/begin COMPU_METHOD Conv.cUl2ItfipFl._.iv_ps_sensor_signal_l2_komp_S5_S3 "Umrechnung fuer Messgroesse cUl2ItfipFl::iv_ps_sensor_signal_l2_komp" TAB_VERB "%4.0" "" COMPU_TAB_REF Conv.cUl2ItfipFl._.iv_ps_sensor_signal_l2_komp_S5_S3 /end COMPU_METHOD
/begin COMPU_METHOD Conv.cUl2ItfipFl._.iv_ps_sensor_status_l2_komp_S5_S3 "Umrechnung fuer Messgroesse cUl2ItfipFl::iv_ps_sensor_status_l2_komp" TAB_VERB "%4.0" "" COMPU_TAB_REF Conv.cUl2ItfipFl._.iv_ps_sensor_status_l2_komp_S5_S3 /end COMPU_METHOD
/begin COMPU_METHOD Conv.cUl2ItfipFl._.iv_v_unplausibel_l2_komp_S5_S3 "Umrechnung fuer Messgroesse cUl2ItfipFl::iv_v_unplausibel_l2_komp" TAB_VERB "%4.0" "" COMPU_TAB_REF Conv.cUl2ItfipFl._.iv_v_unplausibel_l2_komp_S5_S3 /end COMPU_METHOD
/begin COMPU_METHOD Conv.cUl2ItfipFl._.ps_sensor_status_l2_S5_S3 "Umrechnung fuer Messgroesse cUl2ItfipFl::ps_sensor_status_l2" TAB_VERB "%4.0" "" COMPU_TAB_REF Conv.cUl2ItfipFl._.ps_sensor_status_l2_S5_S3 /end COMPU_METHOD
/begin COMPU_METHOD Conv.cUl2ItfipInt._.dsc_fehler_l2_S5_S3 "Umrechnung fuer Messgroesse cUl2ItfipInt::dsc_fehler_l2" TAB_VERB "%4.0" "" COMPU_TAB_REF Conv.cUl2ItfipInt._.dsc_fehler_l2_S5_S3 /end COMPU_METHOD
/begin COMPU_METHOD Conv.cUl2ItfipInt._.iv_dscfehlerl2_S5_S3 "Umrechnung fuer Messgroesse cUl2ItfipInt::iv_dscfehlerl2" TAB_VERB "%4.0" "" COMPU_TAB_REF Conv.cUl2ItfipInt._.iv_dscfehlerl2_S5_S3 /end COMPU_METHOD
/begin COMPU_METHOD Conv.cUl2ItfipInt._.iv_pos_l2_S5_S3 "Umrechnung fuer Messgroesse cUl2ItfipInt::iv_pos_l2" TAB_VERB "%4.0" "" COMPU_TAB_REF Conv.cUl2ItfipInt._.iv_pos_l2_S5_S3 /end COMPU_METHOD
/begin COMPU_METHOD Conv.cUl2ItfipInt._.iv_ps_sensor_signal_l2_S5_S3 "Umrechnung fuer Messgroesse cUl2ItfipInt::iv_ps_sensor_signal_l2" TAB_VERB "%4.0" "" COMPU_TAB_REF Conv.cUl2ItfipInt._.iv_ps_sensor_signal_l2_S5_S3 /end COMPU_METHOD
/begin COMPU_METHOD Conv.cUl2ItfipInt._.iv_ps_sensor_status_l2_S5_S3 "Umrechnung fuer Messgroesse cUl2ItfipInt::iv_ps_sensor_status_l2" TAB_VERB "%4.0" "" COMPU_TAB_REF Conv.cUl2ItfipInt._.iv_ps_sensor_status_l2_S5_S3 /end COMPU_METHOD
/begin COMPU_METHOD Conv.cUl2ItfipInt._.iv_v_unplausibel_l2_S5_S3 "Umrechnung fuer Messgroesse cUl2ItfipInt::iv_v_unplausibel_l2" TAB_VERB "%4.0" "" COMPU_TAB_REF Conv.cUl2ItfipInt._.iv_v_unplausibel_l2_S5_S3 /end COMPU_METHOD
/begin COMPU_METHOD Conv.cUl2ItfipInt._.pos_l2_S5_S3 "Umrechnung fuer Messgroesse cUl2ItfipInt::pos_l2" TAB_VERB "%4.0" "" COMPU_TAB_REF Conv.cUl2ItfipInt._.pos_l2_S5_S3 /end COMPU_METHOD
/begin COMPU_METHOD Conv.cUl2ItfipInt._.ps_sensor_signal_l2_S5_S3 "Umrechnung fuer Messgroesse cUl2ItfipInt::ps_sensor_signal_l2" TAB_VERB "%4.0" "" COMPU_TAB_REF Conv.cUl2ItfipInt._.ps_sensor_signal_l2_S5_S3 /end COMPU_METHOD
/begin COMPU_METHOD Conv.cUl2ItfipInt._.ps_sensor_status_l2_S5_S3 "Umrechnung fuer Messgroesse cUl2ItfipInt::ps_sensor_status_l2" TAB_VERB "%4.0" "" COMPU_TAB_REF Conv.cUl2ItfipInt._.ps_sensor_status_l2_S5_S3 /end COMPU_METHOD
/begin COMPU_METHOD Conv.cUl2ItfipInt._.v_unplausibel_l2_S5_S3 "Umrechnung fuer Messgroesse cUl2ItfipInt::v_unplausibel_l2" TAB_VERB "%4.0" "" COMPU_TAB_REF Conv.cUl2ItfipInt._.v_unplausibel_l2_S5_S3 /end COMPU_METHOD
/begin COMPU_METHOD Conv.cUl2ItfipUewFl._.me_red_status_S5_S3 "Umrechnung fuer Messgroesse cUl2ItfipUewFl::me_red_status" TAB_VERB "%4.0" "" COMPU_TAB_REF Conv.cUl2ItfipUewFl._.me_red_status_S5_S3 /end COMPU_METHOD
/begin COMPU_METHOD Conv.cUl2ItfipUewFl._.zielgang_sas_S5_S3 "Umrechnung fuer Messgroesse cUl2ItfipUewFl::zielgang_sas" TAB_VERB "%4.0" "" COMPU_TAB_REF Conv.cUl2ItfipUewFl._.zielgang_sas_S5_S3 /end COMPU_METHOD
/begin COMPU_METHOD Conv.cUl2ItfipUewInt._.me_red_status_S5_S3 "Umrechnung fuer Messgroesse cUl2ItfipUewInt::me_red_status" TAB_VERB "%4.0" "" COMPU_TAB_REF Conv.cUl2ItfipUewInt._.me_red_status_S5_S3 /end COMPU_METHOD
/begin COMPU_METHOD Conv.cUl2ItfipUewInt._.zielgang_sas_S5_S3 "Umrechnung fuer Messgroesse cUl2ItfipUewInt::zielgang_sas" TAB_VERB "%4.0" "" COMPU_TAB_REF Conv.cUl2ItfipUewInt._.zielgang_sas_S5_S3 /end COMPU_METHOD
/begin COMPU_METHOD Conv.cUl2K0SPlausiInt._.n_diff_k0_einmalig_S5_S3 "Umrechnung fuer Messgroesse cUl2K0SPlausiInt::n_diff_k0_einmalig" TAB_VERB "%4.0" "" COMPU_TAB_REF Conv.cUl2K0SPlausiInt._.n_diff_k0_einmalig_S5_S3 /end COMPU_METHOD
/begin COMPU_METHOD Conv.cUl2K0SPlausiInt._.st_fehler_S5_S3 "Umrechnung fuer Messgroesse cUl2K0SPlausiInt::st_fehler" TAB_VERB "%4.0" "" COMPU_TAB_REF Conv.cUl2K0SPlausiInt._.st_fehler_S5_S3 /end COMPU_METHOD
/begin COMPU_METHOD UMR___1_1000_0_S5_S3 "int = ((phys * 1000) / 1) - (0) [-]" RAT_FUNC "%4.3" "[-]" COEFFS 0 1000 0 0 0 1 /end COMPU_METHOD
/begin COMPU_METHOD UMR___1_1_0_S5_S3 "int = ((phys * 1) / 1) - (0) [-]" RAT_FUNC "%1.0" "[-]" COEFFS 0 1 0 0 0 1 /end COMPU_METHOD
/begin COMPU_METHOD UMR_BAR__1_1000_0_S5_S3 "int = ((phys * 1000) / 1) - (0) [bar]" RAT_FUNC "%4.3" "[bar]" COEFFS 0 1000 0 0 0 1 /end COMPU_METHOD
/begin COMPU_METHOD UMR_GRADC__1_1_0_S5_S3 "int = ((phys * 1) / 1) - (0) [°C]" RAT_FUNC "%1.0" "[°C]" COEFFS 0 1 0 0 0 1 /end COMPU_METHOD
/begin COMPU_METHOD UMR_GRADC__1_1_M40_S5_S3 "int = ((phys * 1) / 1) - (-40) [°C]" RAT_FUNC "%1.0" "[°C]" COEFFS 0 1 40 0 0 1 /end COMPU_METHOD
/begin COMPU_METHOD UMR_J_G_1_100_0_S5_S3 "int = ((phys * 100) / 1) - (0) [J/(g)]" RAT_FUNC "%3.2" "[J/(g)]" COEFFS 0 100 0 0 0 1 /end COMPU_METHOD
/begin COMPU_METHOD UMR_J_G_1_1_0_S5_S3 "int = ((phys * 1) / 1) - (0) [J/(g)]" RAT_FUNC "%1.0" "[J/(g)]" COEFFS 0 1 0 0 0 1 /end COMPU_METHOD
/begin COMPU_METHOD UMR_K_SEC_1_1_0_S5_S3 "int = ((phys * 1) / 1) - (0) [K/s]" RAT_FUNC "%1.0" "[K/s]" COEFFS 0 1 0 0 0 1 /end COMPU_METHOD
/begin COMPU_METHOD UMR_KJ__1_1000_0_S5_S3 "int = ((phys * 1000) / 1) - (0) [KJ]" RAT_FUNC "%4.3" "[KJ]" COEFFS 0 1000 0 0 0 1 /end COMPU_METHOD
/begin COMPU_METHOD UMR_KJ__1_1_0_S5_S3 "int = ((phys * 1) / 1) - (0) [KJ]" RAT_FUNC "%1.0" "[KJ]" COEFFS 0 1 0 0 0 1 /end COMPU_METHOD
/begin COMPU_METHOD UMR_KM_H_1_1_0_S5_S3 "int = ((phys * 1) / 1) - (0) [km/h]" RAT_FUNC "%1.0" "[km/h]" COEFFS 0 1 0 0 0 1 /end COMPU_METHOD
/begin COMPU_METHOD UMR_KW__1_1000_0_S5_S3 "int = ((phys * 1000) / 1) - (0) [KW]" RAT_FUNC "%4.3" "[KW]" COEFFS 0 1000 0 0 0 1 /end COMPU_METHOD
/begin COMPU_METHOD UMR_KW__1_1_0_S5_S3 "int = ((phys * 1) / 1) - (0) [KW]" RAT_FUNC "%1.0" "[KW]" COEFFS 0 1 0 0 0 1 /end COMPU_METHOD
/begin COMPU_METHOD UMR_MSEC__10_1_0_S5_S3 "int = ((phys * 1) / 10) - (0) [ms]" RAT_FUNC "%1.0" "[ms]" COEFFS 0 0.1 0 0 0 1 /end COMPU_METHOD
/begin COMPU_METHOD UMR_MSEC__1_1_0_S5_S3 "int = ((phys * 1) / 1) - (0) [ms]" RAT_FUNC "%1.0" "[ms]" COEFFS 0 1 0 0 0 1 /end COMPU_METHOD
/begin COMPU_METHOD UMR_NM__1_1_0_S5_S3 "int = ((phys * 1) / 1) - (0) [Nm]" RAT_FUNC "%1.0" "[Nm]" COEFFS 0 1 0 0 0 1 /end COMPU_METHOD
/begin COMPU_METHOD UMR_NM_SEC_1_1_0_S5_S3 "int = ((phys * 1) / 1) - (0) [Nm/s]" RAT_FUNC "%1.0" "[Nm/s]" COEFFS 0 1 0 0 0 1 /end COMPU_METHOD
/begin COMPU_METHOD UMR_PROZENT__1_100_0_S5_S3 "int = ((phys * 100) / 1) - (0) [%]" RAT_FUNC "%3.2" "[%]" COEFFS 0 100 0 0 0 1 /end COMPU_METHOD
/begin COMPU_METHOD UMR_PROZENT__1_1_0_2_S5_S3 "int = ((phys * 1) / 1) - (0) [%]" RAT_FUNC "%1.0" "[%]" COEFFS 0 1 0 0 0 1 /end COMPU_METHOD
/begin COMPU_METHOD UMR_PROZENT__20_51_0_S5_S3 "int = ((phys * 51) / 20) - (0) [%]" RAT_FUNC "%5.4" "[%]" COEFFS 0 2.55 0 0 0 1 /end COMPU_METHOD
/begin COMPU_METHOD UMR_SEC__1_1_0_S5_S3 "int = ((phys * 1) / 1) - (0) [s]" RAT_FUNC "%1.0" "[s]" COEFFS 0 1 0 0 0 1 /end COMPU_METHOD
/begin COMPU_METHOD UMR_U_MIN_1_1_0_S5_S3 "int = ((phys * 1) / 1) - (0) [U/min]" RAT_FUNC "%1.0" "[U/min]" COEFFS 0 1 0 0 0 1 /end COMPU_METHOD
/begin COMPU_METHOD UMR_U_MIN_32_1_0_S5_S3 "int = ((phys * 1) / 32) - (0) [U/min]" RAT_FUNC "%1.0" "[U/min]" COEFFS 0 0.03125 0 0 0 1 /end COMPU_METHOD
/begin COMPU_METHOD UMR_U_MINSEC_1_1_0_S5_S3 "int = ((phys * 1) / 1) - (0) [U/(min*s)]" RAT_FUNC "%1.0" "[U/(min*s)]" COEFFS 0 1 0 0 0 1 /end COMPU_METHOD
/begin COMPU_METHOD UMR_W_MM2_1_100_0_S5_S3 "int = ((phys * 100) / 1) - (0) [W/(mm^2)]" RAT_FUNC "%3.2" "[W/(mm^2)]" COEFFS 0 100 0 0 0 1 /end COMPU_METHOD
/begin COMPU_METHOD UMR_W_MM2_1_1_0_3_S5_S3 "int = ((phys * 1) / 1) - (0) [W/(mm^2)]" RAT_FUNC "%1.0" "[W/(mm^2)]" COEFFS 0 1 0 0 0 1 /end COMPU_METHOD
/begin MEASUREMENT iSasZentr.iVorbereitend.iKab.zaehler_zkab "Zustandszaehler der abschaltenden Kupplung" UBYTE UMR___1_1_0_S5_S3 1 100 0 255 ECU_ADDRESS 0xFFF8C159 DISPLAY_IDENTIFIER zaehler_zkab.iKab.iVorbereitend.iSasZentr /end MEASUREMENT
/begin MEASUREMENT iSasZentr.iVorbereitend.iKzu.dauer_fa_hsrs_kzu "Merker Dauer Fuellausgleichsphase der KZU" SWORD UMR_MSEC__10_1_0_S5_S3 1 100 -327680 327670 ECU_ADDRESS 0xFFF8C1E4 DISPLAY_IDENTIFIER dauer_fa_hsrs_kzu.iKzu.iVorbereitend.iSasZentr /end MEASUREMENT
/begin MEASUREMENT iSasZentr.iVorbereitend.iKzu.dauer_ra1_hsrs_kzu "Merker Dauer Rampe 1 der KZU" SWORD UMR_MSEC__10_1_0_S5_S3 1 100 -327680 327670 ECU_ADDRESS 0xFFF8C1E0 DISPLAY_IDENTIFIER dauer_ra1_hsrs_kzu.iKzu.iVorbereitend.iSasZentr /end MEASUREMENT
/begin MEASUREMENT iSasZentr.iVorbereitend.iKzu.f_hinsyn_kzu_gestartet "FLAG: HINSYN-Fkt. im KZU-Ablauf gestartet" UBYTE Conv.cSasAnKzu._.f_hinsyn_kzu_gestartet_S5_S3 1 100 0 1 BIT_MASK 0x1 ECU_ADDRESS 0xFFF8C1DE DISPLAY_IDENTIFIER f_hinsyn_kzu_gestartet.iKzu.iVorbereitend.iSasZentr /end MEASUREMENT
/begin MEASUREMENT iSasZentr.iVorbereitend.iKzu.f_ngs_abflare_unterschritten "Merker ob Druckoffset auf Schaltdruck bei Flare gesetzt werden soll" UBYTE Conv.cSasAnKzu._.f_ngs_abflare_unterschritten_S5_S3 1 100 0 1 BIT_MASK 0x1 ECU_ADDRESS 0xFFF8C1FE DISPLAY_IDENTIFIER f_ngs_abflare_unterschritten.iKzu.iVorbereitend.iSasZentr /end MEASUREMENT
/begin MEASUREMENT iSasZentr.iVorbereitend.iKzu.f_pokzufol_erlaubt "FLAG: Verwendung von KF_POKZUFOL ist erlaubt" UBYTE Conv.cSasAnKzu._.f_pokzufol_erlaubt_S5_S3 1 100 0 1 BIT_MASK 0x1 ECU_ADDRESS 0xFFF8C1FF DISPLAY_IDENTIFIER f_pokzufol_erlaubt.iKzu.iVorbereitend.iSasZentr /end MEASUREMENT
/begin MEASUREMENT iSasZentr.iVorbereitend.iKzu.f_rampenzeitberechnung_fertig "Flag: Die Berechnung der Schliessrampenzeit erfolgt einmalig" UBYTE Conv.cSasAnKzu._.f_rampenzeitberechnung_fertig_S5_S3 1 100 0 1 BIT_MASK 0x1 ECU_ADDRESS 0xFFF8C1D6 DISPLAY_IDENTIFIER f_rampenzeitberechnung_fertig.iKzu.iVorbereitend.iSasZentr /end MEASUREMENT
/begin MEASUREMENT iSasZentr.iVorbereitend.iKzu.f_schnellfuellung_war_aktiv "FLAG: Schnellfüllung wurde ausgeführt" UBYTE Conv.cSasAnKzu._.f_schnellfuellung_war_aktiv_S5_S3 1 100 0 1 BIT_MASK 0x1 ECU_ADDRESS 0xFFF8C1E2 DISPLAY_IDENTIFIER f_schnellfuellung_war_aktiv.iKzu.iVorbereitend.iSasZentr /end MEASUREMENT
/begin MEASUREMENT iSasZentr.iVorbereitend.iKzu.fa_kzu_gestartet "Flag: Fuellausgleich KZU gestartet" UBYTE Conv.cSasAnKzu._.fa_kzu_gestartet_S5_S3 1 100 0 1 BIT_MASK 0x1 ECU_ADDRESS 0xFFF8C1C0 DISPLAY_IDENTIFIER fa_kzu_gestartet.iKzu.iVorbereitend.iSasZentr /end MEASUREMENT
/begin MEASUREMENT iSasZentr.iVorbereitend.iKzu.flag_pomekzu_erlaubt "Flag: Aufrechnung ME-abhaengiger Druckoffset erlaubt" UBYTE Conv.cSasAnKzu._.flag_pomekzu_erlaubt_S5_S3 1 100 0 1 BIT_MASK 0x1 ECU_ADDRESS 0xFFF8C1ED DISPLAY_IDENTIFIER flag_pomekzu_erlaubt.iKzu.iVorbereitend.iSasZentr /end MEASUREMENT
/begin MEASUREMENT iSasZentr.iVorbereitend.iKzu.kup_kzu "Kupplungsnummer Zuschaltende Kupplung" UBYTE Conv.cSasAnKzu._.kup_kzu_S5_S3 1 100 0 5 ECU_ADDRESS 0xFFF8C1D8 DISPLAY_IDENTIFIER kup_kzu.iKzu.iVorbereitend.iSasZentr /end MEASUREMENT
/begin MEASUREMENT iSasZentr.iVorbereitend.iKzu.md_motsoll_sas "Motorsollmomentanstieg" SWORD UMR_NM__1_1_0_S5_S3 1 100 -1500 1500 ECU_ADDRESS 0xFFF8C1F8 DISPLAY_IDENTIFIER md_motsoll_sas.iKzu.iVorbereitend.iSasZentr /end MEASUREMENT
/begin MEASUREMENT iSasZentr.iVorbereitend.iKzu.p_0stkzu "Zustandsanfangsdruck gesteuerter Anteil KZU" SWORD UMR_BAR__1_1000_0_S5_S3 1 100 0 20 ECU_ADDRESS 0xFFF8C1E8 DISPLAY_IDENTIFIER p_0stkzu.iKzu.iVorbereitend.iSasZentr /end MEASUREMENT
/begin MEASUREMENT iSasZentr.iVorbereitend.iKzu.p_adaptkzu "Adaptionsdruck zuschaltende Kupplung" SWORD UMR_BAR__1_1000_0_S5_S3 1 100 0 20 ECU_ADDRESS 0xFFF8C1C2 DISPLAY_IDENTIFIER p_adaptkzu.iKzu.iVorbereitend.iSasZentr /end MEASUREMENT
/begin MEASUREMENT iSasZentr.iVorbereitend.iKzu.p_fkzu "Fuelldruck" SWORD UMR_BAR__1_1000_0_S5_S3 1 100 0 20 ECU_ADDRESS 0xFFF8C1EA DISPLAY_IDENTIFIER p_fkzu.iKzu.iVorbereitend.iSasZentr /end MEASUREMENT
/begin MEASUREMENT iSasZentr.iVorbereitend.iKzu.p_fkzu_gueltig "Flag: Fuelldruck wurde berechnet und ausgegeben" UBYTE Conv.cSasAnKzu._.p_fkzu_gueltig_S5_S3 1 100 0 1 BIT_MASK 0x1 ECU_ADDRESS 0xFFF8C1EC DISPLAY_IDENTIFIER p_fkzu_gueltig.iKzu.iVorbereitend.iSasZentr /end MEASUREMENT
/begin MEASUREMENT iSasZentr.iVorbereitend.iKzu.p_kzu "Druck KZU (inklusive GLS-Druck)" SWORD UMR_BAR__1_1000_0_S5_S3 1 100 0 20 ECU_ADDRESS 0xFFF8C1DC DISPLAY_IDENTIFIER p_kzu.iKzu.iVorbereitend.iSasZentr /end MEASUREMENT
/begin MEASUREMENT iSasZentr.iVorbereitend.iKzu.p_offkzu "Offsetdruck der zuschaltenden Kupplung" SWORD UMR_BAR__1_1000_0_S5_S3 1 100 0 20 ECU_ADDRESS 0xFFF8C1F4 DISPLAY_IDENTIFIER p_offkzu.iKzu.iVorbereitend.iSasZentr /end MEASUREMENT
/begin MEASUREMENT iSasZentr.iVorbereitend.iKzu.p_stkzu "Gesteuerter Druckanteil KZU" SWORD UMR_BAR__1_1000_0_S5_S3 1 100 0 20 ECU_ADDRESS 0xFFF8C1C4 DISPLAY_IDENTIFIER p_stkzu.iKzu.iVorbereitend.iSasZentr /end MEASUREMENT
/begin MEASUREMENT iSasZentr.iVorbereitend.iKzu.pgo_kzu_speicher.cBibRampeGradSi16._.letzter_ms_timer "Speichert den letzten BS-Timer" UWORD UMR_MSEC__1_1_0_S5_S3 1 100 0 65535 ECU_ADDRESS 0xFFF8C224 DISPLAY_IDENTIFIER letzter_ms_timer._.cBibRampeGradSi16.pgo_kzu_speicher.iKzu.iVorbereitend.iSasZentr /end MEASUREMENT
/begin MEASUREMENT iSasZentr.iVorbereitend.iKzu.pgo_kzu_speicher.cBibRampeGradSi16._.letzter_wert "Speichert den letzten Eingangswert" FLOAT32_IEEE UMR___1_1_0_S5_S3 1 100 -1e+037 1e+037 ECU_ADDRESS 0xFFF8C220 FORMAT "%3.2" DISPLAY_IDENTIFIER letzter_wert._.cBibRampeGradSi16.pgo_kzu_speicher.iKzu.iVorbereitend.iSasZentr /end MEASUREMENT
/begin MEASUREMENT iSasZentr.iVorbereitend.iKzu.pgo_kzu_speicher.cBibRampeGradSi16._.maximum "Maximum Begrenzung" FLOAT32_IEEE UMR___1_1_0_S5_S3 1 100 -1e+037 1e+037 ECU_ADDRESS 0xFFF8C22C FORMAT "%3.2" DISPLAY_IDENTIFIER maximum._.cBibRampeGradSi16.pgo_kzu_speicher.iKzu.iVorbereitend.iSasZentr /end MEASUREMENT
/begin MEASUREMENT iSasZentr.iVorbereitend.iKzu.pgo_kzu_speicher.cBibRampeGradSi16._.minimum "Minimum Begrenzung" FLOAT32_IEEE UMR___1_1_0_S5_S3 1 100 -1e+037 1e+037 ECU_ADDRESS 0xFFF8C228 FORMAT "%3.2" DISPLAY_IDENTIFIER minimum._.cBibRampeGradSi16.pgo_kzu_speicher.iKzu.iVorbereitend.iSasZentr /end MEASUREMENT
/begin MEASUREMENT iSasZentr.iVorbereitend.iKzu.po_kzuflare "Druckoffset auf Schaltdruck bei Flare" SWORD UMR_BAR__1_1000_0_S5_S3 1 100 0 20 ECU_ADDRESS 0xFFF8C1FC DISPLAY_IDENTIFIER po_kzuflare.iKzu.iVorbereitend.iSasZentr /end MEASUREMENT
/begin MEASUREMENT iSasZentr.iVorbereitend.iKzu.po_mekzu "Schaltdruckoffset, der abhaengig von einem ME ist" SWORD UMR_BAR__1_1000_0_S5_S3 1 100 0 12.75 ECU_ADDRESS 0xFFF8C1EE DISPLAY_IDENTIFIER po_mekzu.iKzu.iVorbereitend.iSasZentr /end MEASUREMENT
/begin MEASUREMENT iSasZentr.iVorbereitend.iKzu.po_mtkzu "momentenabhaengiger Druckoffset" SWORD UMR_BAR__1_1000_0_S5_S3 1 100 0 20 ECU_ADDRESS 0xFFF8C1F6 DISPLAY_IDENTIFIER po_mtkzu.iKzu.iVorbereitend.iSasZentr /end MEASUREMENT
/begin MEASUREMENT iSasZentr.iVorbereitend.iKzu.ra1_hsrs_kzu_gestartet "Flag: Rampe 1 KZU gestartet" UBYTE Conv.cSasAnKzu._.ra1_hsrs_kzu_gestartet_S5_S3 1 100 0 1 BIT_MASK 0x1 ECU_ADDRESS 0xFFF8C1C6 DISPLAY_IDENTIFIER ra1_hsrs_kzu_gestartet.iKzu.iVorbereitend.iSasZentr /end MEASUREMENT
/begin MEASUREMENT iSasZentr.iVorbereitend.iKzu.ra2_hsrs_kzu_gestartet "Flag: Rampe 2 KZU gestartet" UBYTE Conv.cSasAnKzu._.ra2_hsrs_kzu_gestartet_S5_S3 1 100 0 1 BIT_MASK 0x1 ECU_ADDRESS 0xFFF8C1C7 DISPLAY_IDENTIFIER ra2_hsrs_kzu_gestartet.iKzu.iVorbereitend.iSasZentr /end MEASUREMENT
/begin MEASUREMENT iSasZentr.iVorbereitend.iKzu.ra3_hsrs_kzu_gestartet "Flag: Rampe 3 KZU gestartet" UBYTE Conv.cSasAnKzu._.ra3_hsrs_kzu_gestartet_S5_S3 1 100 0 1 BIT_MASK 0x1 ECU_ADDRESS 0xFFF8C1C8 DISPLAY_IDENTIFIER ra3_hsrs_kzu_gestartet.iKzu.iVorbereitend.iSasZentr /end MEASUREMENT
/begin MEASUREMENT iSasZentr.iVorbereitend.iKzu.raph_kzu_speicher.letzter_timer "Speichert den letzten BS-Timer" UBYTE UMR_SEC__1_1_0_S5_S3 1 100 0 255 ECU_ADDRESS 0xFFF8C238 DISPLAY_IDENTIFIER letzter_timer.raph_kzu_speicher.iKzu.iVorbereitend.iSasZentr /end MEASUREMENT
/begin MEASUREMENT iSasZentr.iVorbereitend.iKzu.raph_kzu_speicher.letzter_wert "Speichert den letzten Eingangswert" SLONG UMR___1_1_0_S5_S3 1 100 -2147483648 2147483647 ECU_ADDRESS 0xFFF8C234 DISPLAY_IDENTIFIER letzter_wert.raph_kzu_speicher.iKzu.iVorbereitend.iSasZentr /end MEASUREMENT
/begin MEASUREMENT iSasZentr.iVorbereitend.iKzu.schalttyp_kzu "Schalttyp der zusch. Kupplung" UBYTE Conv.cSasAnKzu._.schalttyp_kzu_S5_S3 1 100 0 4 ECU_ADDRESS 0xFFF8C1E7 DISPLAY_IDENTIFIER schalttyp_kzu.iKzu.iVorbereitend.iSasZentr /end MEASUREMENT
/begin MEASUREMENT iSasZentr.iVorbereitend.iKzu.schliessen_kzu "Flag: KZU soll schliessen" UBYTE Conv.cSasAnKzu._.schliessen_kzu_S5_S3 1 100 0 1 BIT_MASK 0x1 ECU_ADDRESS 0xFFF8C1C9 DISPLAY_IDENTIFIER schliessen_kzu.iKzu.iVorbereitend.iSasZentr /end MEASUREMENT
/begin MEASUREMENT iSasZentr.iVorbereitend.iKzu.statisch_kzu "Flag: Anzeige ob KAB eine Druckvorgabe ausgibt oder Minimal/Maximaldruck angesteuert wird" UBYTE Conv.cSasAnKzu._.statisch_kzu_S5_S3 1 100 0 1 BIT_MASK 0x1 ECU_ADDRESS 0xFFF8C1CA DISPLAY_IDENTIFIER statisch_kzu.iKzu.iVorbereitend.iSasZentr /end MEASUREMENT
/begin MEASUREMENT iSasZentr.iVorbereitend.iKzu.t_0kzu "Zeitdauer des zuletzt durchlaufenen Zustands KZU" SWORD UMR_MSEC__10_1_0_S5_S3 1 100 -327680 327670 ECU_ADDRESS 0xFFF8C1F2 DISPLAY_IDENTIFIER t_0kzu.iKzu.iVorbereitend.iSasZentr /end MEASUREMENT
/begin MEASUREMENT iSasZentr.iVorbereitend.iKzu.t_berechnungszeitpunkt "Zeitpunkt für Berechnungsstart" SWORD UMR_MSEC__10_1_0_S5_S3 1 100 -327680 327670 ECU_ADDRESS 0xFFF8C1D4 DISPLAY_IDENTIFIER t_berechnungszeitpunkt.iKzu.iVorbereitend.iSasZentr /end MEASUREMENT
/begin MEASUREMENT iSasZentr.iVorbereitend.iKzu.t_besfhsrskzu "Zeit bis Ende Schnellfuellung" SWORD UMR_MSEC__1_1_0_S5_S3 1 100 -32768 32767 ECU_ADDRESS 0xFFF8C1DA DISPLAY_IDENTIFIER t_besfhsrskzu.iKzu.iVorbereitend.iSasZentr /end MEASUREMENT
/begin MEASUREMENT iSasZentr.iVorbereitend.iKzu.t_eff_ra1_hsrs_kzu "Effektive Zeit Rampe 1 KZU" UWORD UMR_MSEC__10_1_0_S5_S3 1 100 0 655350 ECU_ADDRESS 0xFFF8C1CE DISPLAY_IDENTIFIER t_eff_ra1_hsrs_kzu.iKzu.iVorbereitend.iSasZentr /end MEASUREMENT
/begin MEASUREMENT iSasZentr.iVorbereitend.iKzu.t_ig_change "Zeit für Momentenübergang" UBYTE UMR_MSEC__10_1_0_S5_S3 1 100 0 2540 ECU_ADDRESS 0xFFF8C1D2 DISPLAY_IDENTIFIER t_ig_change.iKzu.iVorbereitend.iSasZentr /end MEASUREMENT
/begin MEASUREMENT iSasZentr.iVorbereitend.iKzu.t_vkabr_abgelaufen "Flag: Verzoegerungszeit nach Start Rampe2 abgelaufen" UBYTE Conv.cSasAnKzu._.t_vkabr_abgelaufen_S5_S3 1 100 0 1 BIT_MASK 0x1 ECU_ADDRESS 0xFFF8C1CB DISPLAY_IDENTIFIER t_vkabr_abgelaufen.iKzu.iVorbereitend.iSasZentr /end MEASUREMENT
/begin MEASUREMENT iSasZentr.iVorbereitend.iKzu.t_zkzu "Zustandszeitdauer der KZU" SWORD UMR_MSEC__10_1_0_S5_S3 1 100 -327680 327670 ECU_ADDRESS 0xFFF8C1F0 DISPLAY_IDENTIFIER t_zkzu.iKzu.iVorbereitend.iSasZentr /end MEASUREMENT
/begin MEASUREMENT iSasZentr.iVorbereitend.iKzu.timer16_ra1_hsrs_kzu "Zeit seit Start Rampe 1 KZU" UWORD UMR_MSEC__10_1_0_S5_S3 1 100 0 655350 ECU_ADDRESS 0xFFF8C1CC DISPLAY_IDENTIFIER timer16_ra1_hsrs_kzu.iKzu.iVorbereitend.iSasZentr /end MEASUREMENT
/begin MEASUREMENT iSasZentr.iVorbereitend.iKzu.timer_ab_ende_sf_kzu "Timer seit SF Ende Kzu" UWORD UMR_MSEC__10_1_0_S5_S3 1 100 0 655350 ECU_ADDRESS 0xFFF8C1FA DISPLAY_IDENTIFIER timer_ab_ende_sf_kzu.iKzu.iVorbereitend.iSasZentr /end MEASUREMENT
/begin MEASUREMENT iSasZentr.iVorbereitend.iKzu.timer_seit_start_schaltung "Zeit seit Start Schaltung" UBYTE UMR_MSEC__10_1_0_S5_S3 1 100 0 2550 ECU_ADDRESS 0xFFF8C1D3 DISPLAY_IDENTIFIER timer_seit_start_schaltung.iKzu.iVorbereitend.iSasZentr /end MEASUREMENT
/begin MEASUREMENT iSasZentr.iVorbereitend.iKzu.timer_start_fa_kzu "Zeit seit Start Fuellausgleichsphase" UBYTE UMR_MSEC__10_1_0_S5_S3 1 100 0 2550 ECU_ADDRESS 0xFFF8C1D0 DISPLAY_IDENTIFIER timer_start_fa_kzu.iKzu.iVorbereitend.iSasZentr /end MEASUREMENT
/begin MEASUREMENT iSasZentr.iVorbereitend.iKzu.timer_zkzu "Zustandstimer zuschaltende Kupplung" UBYTE UMR_MSEC__10_1_0_S5_S3 1 100 0 2550 ECU_ADDRESS 0xFFF8C1D1 DISPLAY_IDENTIFIER timer_zkzu.iKzu.iVorbereitend.iSasZentr /end MEASUREMENT
/begin MEASUREMENT iSasZentr.iVorbereitend.iKzu.z_kzu "Zustand zuschaltende Kupplung in einer Schaltung" UBYTE Conv.cSasAnKzu._.z_kzu_S5_S3 1 100 0 19 ECU_ADDRESS 0xFFF8C1D7 DISPLAY_IDENTIFIER z_kzu.iKzu.iVorbereitend.iSasZentr /end MEASUREMENT
/begin MEASUREMENT iSasZentr.iVorbereitend.iKzu.zaehler_zkzu "Zustandszaehler der zusch. Kupplung" UBYTE UMR___1_1_0_S5_S3 1 100 0 255 ECU_ADDRESS 0xFFF8C1E6 DISPLAY_IDENTIFIER zaehler_zkzu.iKzu.iVorbereitend.iSasZentr /end MEASUREMENT
/begin MEASUREMENT iSasZentr.iVorbereitend.index_spsas "Vorgabe Schaltung mit SP/SPORT-Parametern" UBYTE Conv.cSasSaKor._.index_spsas_S5_S3 1 100 0 2 ECU_ADDRESS 0xFFF8C11A DISPLAY_IDENTIFIER index_spsas.iVorbereitend.iSasZentr /end MEASUREMENT
/begin MEASUREMENT iSasZentr.iVorbereitend.istgang_sas "Istgang SAS" SBYTE Conv.cSasSaKor._.istgang_sas_S5_S3 1 100 -1 8 ECU_ADDRESS 0xFFF8C112 DISPLAY_IDENTIFIER istgang_sas.iVorbereitend.iSasZentr /end MEASUREMENT
/begin MEASUREMENT iSasZentr.iVorbereitend.kup_schutz_massnahme_aktiv "FLAG: Schutzfunktion auf Grund eines überhitzten Schaltelements aktiv." UBYTE Conv.cSasSaKor._.kup_schutz_massnahme_aktiv_S5_S3 1 100 0 1 BIT_MASK 0x1 ECU_ADDRESS 0xFFF8C13E DISPLAY_IDENTIFIER kup_schutz_massnahme_aktiv.iVorbereitend.iSasZentr /end MEASUREMENT
/begin MEASUREMENT iSasZentr.iVorbereitend.m_motsoll0_sas "Motorsollmoment bei Start Schaltung" SWORD UMR_NM__1_1_0_S5_S3 1 100 -1500 1500 ECU_ADDRESS 0xFFF8C12A DISPLAY_IDENTIFIER m_motsoll0_sas.iVorbereitend.iSasZentr /end MEASUREMENT
/begin MEASUREMENT iSasZentr.iVorbereitend.n_tkf "Turbinendrehzahl f. KF-Zugriff" UBYTE UMR_U_MIN_32_1_0_S5_S3 1 100 0 8160 ECU_ADDRESS 0xFFF8C120 DISPLAY_IDENTIFIER n_tkf.iVorbereitend.iSasZentr /end MEASUREMENT
/begin MEASUREMENT iSasZentr.iVorbereitend.n_tsyn "Turbinensynchrondrehzahl fuer zielgang_sas" UWORD UMR_U_MIN_1_1_0_S5_S3 1 100 0 8160 ECU_ADDRESS 0xFFF8C11E DISPLAY_IDENTIFIER n_tsyn.iVorbereitend.iSasZentr /end MEASUREMENT
/begin MEASUREMENT iSasZentr.iVorbereitend.nd_syn "Differenzdrehzahl zur Synchrondrehzahl neuer Gang (zielgang_sas)" SWORD UMR_U_MIN_1_1_0_S5_S3 1 100 -8000 8000 ECU_ADDRESS 0xFFF8C122 DISPLAY_IDENTIFIER nd_syn.iVorbereitend.iSasZentr /end MEASUREMENT
/begin MEASUREMENT iSasZentr.iVorbereitend.nd_synistgang "Differenzdrehzahl zu synchron Istgang" SWORD UMR_U_MIN_1_1_0_S5_S3 1 100 -8000 8000 ECU_ADDRESS 0xFFF8C128 DISPLAY_IDENTIFIER nd_synistgang.iVorbereitend.iSasZentr /end MEASUREMENT
/begin MEASUREMENT iSasZentr.iVorbereitend.nd_vsyn_betr "Betrag Differenzdrehzahl bis synchron Zielgang" SWORD UMR_U_MIN_1_1_0_S5_S3 1 100 0 8160 ECU_ADDRESS 0xFFF8C124 DISPLAY_IDENTIFIER nd_vsyn_betr.iVorbereitend.iSasZentr /end MEASUREMENT
/begin MEASUREMENT iSasZentr.iVorbereitend.ng_dsynzielgang "Gradient Differenzdrehzahl n_t zu n_t(synchron zielgang)" SWORD UMR_U_MINSEC_1_1_0_S5_S3 1 100 -32000 32000 ECU_ADDRESS 0xFFF8C126 DISPLAY_IDENTIFIER ng_dsynzielgang.iVorbereitend.iSasZentr /end MEASUREMENT
/begin MEASUREMENT iSasZentr.iVorbereitend.p_kab_letzte_schaltung "Druck KAB bei letzter Schaltung" SWORD UMR_BAR__1_1000_0_S5_S3 1 100 0 12.75 ECU_ADDRESS 0xFFF8C12E DISPLAY_IDENTIFIER p_kab_letzte_schaltung.iVorbereitend.iSasZentr /end MEASUREMENT
/begin MEASUREMENT iSasZentr.iVorbereitend.p_kzu_letzte_schaltung "Druck KZU bei letzter Schaltung" SWORD UMR_BAR__1_1000_0_S5_S3 1 100 0 12.75 ECU_ADDRESS 0xFFF8C12C DISPLAY_IDENTIFIER p_kzu_letzte_schaltung.iVorbereitend.iSasZentr /end MEASUREMENT
/begin MEASUREMENT iSasZentr.iVorbereitend.schaltinfo_sas "Aktuelle Schaltinfo des Schaltablaufs" UBYTE Conv.cSasSaKor._.schaltinfo_sas_S5_S3 1 100 0 4 ECU_ADDRESS 0xFFF8C115 DISPLAY_IDENTIFIER schaltinfo_sas.iVorbereitend.iSasZentr /end MEASUREMENT
/begin MEASUREMENT iSasZentr.iVorbereitend.schaltinfo_sas_vor_folge "Schaltinfo der vorhergehenden Schaltung waehrend verschachtelten Sch." UBYTE Conv.cSasSaKor._.schaltinfo_sas_vor_folge_S5_S3 1 100 0 8 ECU_ADDRESS 0xFFF8C132 DISPLAY_IDENTIFIER schaltinfo_sas_vor_folge.iVorbereitend.iSasZentr /end MEASUREMENT
/begin MEASUREMENT iSasZentr.iVorbereitend.schaltinfo_syn "Schaltinfo fuer Synchronerkennung" UBYTE Conv.cSasSaKor._.schaltinfo_syn_S5_S3 1 100 0 4 ECU_ADDRESS 0xFFF8C13A DISPLAY_IDENTIFIER schaltinfo_syn.iVorbereitend.iSasZentr /end MEASUREMENT
/begin MEASUREMENT iSasZentr.iVorbereitend.schnellfuellung_beendet "Flag: Schnellfuellung beendet" UBYTE Conv.cSasSaKor._.schnellfuellung_beendet_S5_S3 1 100 0 1 BIT_MASK 0x1 ECU_ADDRESS 0xFFF8C116 DISPLAY_IDENTIFIER schnellfuellung_beendet.iVorbereitend.iSasZentr /end MEASUREMENT
/begin MEASUREMENT iSasZentr.iVorbereitend.schnellfuellung_gestartet "Flag: Schnellfuellung gestartet" UBYTE Conv.cSasSaKor._.schnellfuellung_gestartet_S5_S3 1 100 0 1 BIT_MASK 0x1 ECU_ADDRESS 0xFFF8C133 DISPLAY_IDENTIFIER schnellfuellung_gestartet.iVorbereitend.iSasZentr /end MEASUREMENT
/begin MEASUREMENT iSasZentr.iVorbereitend.sp_ngdsynzielgang.letzter_ms_timer "letzter Timerwert" UWORD UMR___1_1_0_S5_S3 1 100 0 65535 ECU_ADDRESS 0xFFF8C24C DISPLAY_IDENTIFIER letzter_ms_timer.sp_ngdsynzielgang.iVorbereitend.iSasZentr /end MEASUREMENT
/begin MEASUREMENT iSasZentr.iVorbereitend.sp_ngdsynzielgang.n_f "letzter Wert" SLONG UMR___1_1_0_S5_S3 1 100 -2147483648 2147483647 ECU_ADDRESS 0xFFF8C248 DISPLAY_IDENTIFIER n_f.sp_ngdsynzielgang.iVorbereitend.iSasZentr /end MEASUREMENT
/begin MEASUREMENT iSasZentr.iVorbereitend.synchron "FLAG: Synchronpunkt erreicht" UBYTE Conv.cSasSaKor._.synchron_S5_S3 1 100 0 1 BIT_MASK 0x1 ECU_ADDRESS 0xFFF8C110 DISPLAY_IDENTIFIER synchron.iVorbereitend.iSasZentr /end MEASUREMENT
/begin MEASUREMENT iSasZentr.iVorbereitend.synchron_verboten "FLAG: Synchron verboten" UBYTE Conv.cSasSaKor._.synchron_verboten_S5_S3 1 100 0 1 BIT_MASK 0x1 ECU_ADDRESS 0xFFF8C118 DISPLAY_IDENTIFIER synchron_verboten.iVorbereitend.iSasZentr /end MEASUREMENT
/begin MEASUREMENT iSasZentr.iVorbereitend.t_maxsas "maximale Schaltzeit" UWORD UMR_MSEC__10_1_0_S5_S3 1 100 0 50000 ECU_ADDRESS 0xFFF8C138 DISPLAY_IDENTIFIER t_maxsas.iVorbereitend.iSasZentr /end MEASUREMENT
/begin MEASUREMENT iSasZentr.iVorbereitend.t_syn "vorausberechnete Zeit bis Erreichen Synchron zielgang" SWORD UMR_MSEC__10_1_0_S5_S3 1 100 -327680 327670 ECU_ADDRESS 0xFFF8C11C DISPLAY_IDENTIFIER t_syn.iVorbereitend.iSasZentr /end MEASUREMENT
/begin MEASUREMENT iSasZentr.iVorbereitend.t_timeout "Zeit von Schaltbeginn bis Start Timeoutfunktion" UWORD UMR_MSEC__10_1_0_S5_S3 1 100 0 50000 ECU_ADDRESS 0xFFF8C13C DISPLAY_IDENTIFIER t_timeout.iVorbereitend.iSasZentr /end MEASUREMENT
/begin MEASUREMENT iSasZentr.iVorbereitend.timeout "Flag: Schaltung timeout" UBYTE Conv.cSasSaKor._.timeout_S5_S3 1 100 0 1 BIT_MASK 0x1 ECU_ADDRESS 0xFFF8C114 DISPLAY_IDENTIFIER timeout.iVorbereitend.iSasZentr /end MEASUREMENT
/begin MEASUREMENT iSasZentr.iVorbereitend.timer16_sas "Timer Schaltungsdauer, wird bei Vorhalt schon gestartet" UWORD UMR_MSEC__10_1_0_S5_S3 1 100 0 320000 ECU_ADDRESS 0xFFF8C136 DISPLAY_IDENTIFIER timer16_sas.iVorbereitend.iSasZentr /end MEASUREMENT
/begin MEASUREMENT iSasZentr.iVorbereitend.z_kurze_schaltung "Zustandsgroesse kurze Schaltung" UBYTE Conv.cSasSaKor._.z_kurze_schaltung_S5_S3 1 100 0 7 ECU_ADDRESS 0xFFF8C119 DISPLAY_IDENTIFIER z_kurze_schaltung.iVorbereitend.iSasZentr /end MEASUREMENT
/begin MEASUREMENT iSasZentr.iVorbereitend.zielgang_sas "Zielgang SAS" SBYTE Conv.cSasSaKor._.zielgang_sas_S5_S3 1 100 -1 8 ECU_ADDRESS 0xFFF8C111 DISPLAY_IDENTIFIER zielgang_sas.iVorbereitend.iSasZentr /end MEASUREMENT
/begin MEASUREMENT iSasZentr.iVorbereitend.zwangssynchron "FLAG: Zwangssynchron wird angefordert" UBYTE Conv.cSasSaKor._.zwangssynchron_S5_S3 1 100 0 1 BIT_MASK 0x1 ECU_ADDRESS 0xFFF8C117 DISPLAY_IDENTIFIER zwangssynchron.iVorbereitend.iSasZentr /end MEASUREMENT
/begin MEASUREMENT iSasZentr.kup_kzu_ada "Wie kup_kzu, wird jedoch bei Schaltungsende nicht zurueckgesetzt" UBYTE Conv.cSasZentr._.kup_kzu_ada_S5_S3 1 100 0 5 ECU_ADDRESS 0xFFF8BFAB DISPLAY_IDENTIFIER kup_kzu_ada.iSasZentr /end MEASUREMENT
/begin MEASUREMENT iSasZentr.kup_nkraftloesend2_letztes_ga "2. nichtkraftloesende Kupplung des letzten Gangauslegens" UBYTE Conv.cSasZentr._.kup_nkraftloesend2_letztes_ga_S5_S3 1 100 0 5 ECU_ADDRESS 0xFFF8BFB3 DISPLAY_IDENTIFIER kup_nkraftloesend2_letztes_ga.iSasZentr /end MEASUREMENT
/begin MEASUREMENT iSasZentr.m_motmax_kupschtz "Maximal zulässiges Motormoment bei aktiver Kupplungschutzfkt." SWORD UMR_NM__1_1_0_S5_S3 1 100 -200 1300 ECU_ADDRESS 0xFFF8BFCA DISPLAY_IDENTIFIER m_motmax_kupschtz.iSasZentr /end MEASUREMENT
/begin MEASUREMENT iSasZentr.m_motmax_sas "Maximal zulässiges Motormoment das vom Schaltablauf vorgegeben wird" SWORD UMR_NM__1_1_0_S5_S3 1 100 -200 1300 ECU_ADDRESS 0xFFF8BFAE DISPLAY_IDENTIFIER m_motmax_sas.iSasZentr /end MEASUREMENT
/begin MEASUREMENT iSasZentr.m_motmax_vers "Maximal zulässiges Motormoment während einer verschachtelten Schaltung" SWORD UMR_NM__1_1_0_S5_S3 1 100 -200 1300 ECU_ADDRESS 0xFFF8BFC0 DISPLAY_IDENTIFIER m_motmax_vers.iSasZentr /end MEASUREMENT
/begin MEASUREMENT iSasZentr.m_tpgrasyn "Turbinenmoment fuer Schliessrampenberechnung" SWORD UMR_NM__1_1_0_S5_S3 1 100 -200 1300 ECU_ADDRESS 0xFFF8BF9C DISPLAY_IDENTIFIER m_tpgrasyn.iSasZentr /end MEASUREMENT
/begin MEASUREMENT iSasZentr.md_tpgrasyn "Turbinenmomentanstieg von Minimalwert seit synchron" SWORD UMR_NM__1_1_0_S5_S3 1 100 -200 1300 ECU_ADDRESS 0xFFF8BF9E DISPLAY_IDENTIFIER md_tpgrasyn.iSasZentr /end MEASUREMENT
/begin MEASUREMENT iSasZentr.mg_wert_gesp "Gemerkter Wert des Momentengradienten" SWORD UMR_NM_SEC_1_1_0_S5_S3 1 100 -200 2550 ECU_ADDRESS 0xFFF8BFBE DISPLAY_IDENTIFIER mg_wert_gesp.iSasZentr /end MEASUREMENT
/begin MEASUREMENT iSasZentr.nd_nmot_nt "Differenzdrehzahl (n_mot - n_t)" SWORD UMR_U_MIN_1_1_0_S5_S3 1 100 -16320 16320 ECU_ADDRESS 0xFFF8BFA0 DISPLAY_IDENTIFIER nd_nmot_nt.iSasZentr /end MEASUREMENT
/begin MEASUREMENT iSasZentr.ng_absas "Gradient Abtriebsdrehzahl Schaltablauf" SWORD UMR_U_MINSEC_1_1_0_S5_S3 1 100 -1000 1000 ECU_ADDRESS 0xFFF8BFA8 DISPLAY_IDENTIFIER ng_absas.iSasZentr /end MEASUREMENT
/begin MEASUREMENT iSasZentr.schaltart_sas "Aktuelle Schaltart des Schaltablaufs" UBYTE Conv.cSasZentr._.schaltart_sas_S5_S3 1 100 0 5 ECU_ADDRESS 0xFFF8BF8D DISPLAY_IDENTIFIER schaltart_sas.iSasZentr /end MEASUREMENT
/begin MEASUREMENT iSasZentr.schalttyp "Aktueller Schalttyp" UBYTE Conv.cSasZentr._.schalttyp_S5_S3 1 100 0 4 ECU_ADDRESS 0xFFF8BFB2 DISPLAY_IDENTIFIER schalttyp.iSasZentr /end MEASUREMENT
/begin MEASUREMENT iSasZentr.schalttyp_sas "Aktueller Schalttyp des Schaltablaufs" UBYTE Conv.cSasZentr._.schalttyp_sas_S5_S3 1 100 0 4 ECU_ADDRESS 0xFFF8BF8E DISPLAY_IDENTIFIER schalttyp_sas.iSasZentr /end MEASUREMENT
/begin MEASUREMENT iSasZentr.schaltung_abgebrochen "Flag: Schaltung wurde abgebrochen" UBYTE Conv.cSasZentr._.schaltung_abgebrochen_S5_S3 1 100 0 1 BIT_MASK 0x1 ECU_ADDRESS 0xFFF8BFB0 DISPLAY_IDENTIFIER schaltung_abgebrochen.iSasZentr /end MEASUREMENT
/begin MEASUREMENT iSasZentr.schaltung_sas "Flag: Schaltung aktiv" UBYTE Conv.cSasZentr._.schaltung_sas_S5_S3 1 100 0 1 BIT_MASK 0x1 ECU_ADDRESS 0xFFF8BF8C DISPLAY_IDENTIFIER schaltung_sas.iSasZentr /end MEASUREMENT
/begin MEASUREMENT iSasZentr.schaltung_ueber_kzu "Flag: Schaltung ueber KZU" UBYTE Conv.cSasZentr._.schaltung_ueber_kzu_S5_S3 1 100 0 1 BIT_MASK 0x1 ECU_ADDRESS 0xFFF8BF90 DISPLAY_IDENTIFIER schaltung_ueber_kzu.iSasZentr /end MEASUREMENT
/begin MEASUREMENT iSasZentr.schaltungsende_durch_ge_ga "Flag: Merker, dass GE/GA die laufende Schaltung beendet hat" UBYTE Conv.cSasZentr._.schaltungsende_durch_ge_ga_S5_S3 1 100 0 1 BIT_MASK 0x1 ECU_ADDRESS 0xFFF8BFB7 DISPLAY_IDENTIFIER schaltungsende_durch_ge_ga.iSasZentr /end MEASUREMENT
/begin MEASUREMENT iSasZentr.schrittschaltung "FLAG: Schrittschaltung aktiv" UBYTE Conv.cSasZentr._.schrittschaltung_S5_S3 1 100 0 1 BIT_MASK 0x1 ECU_ADDRESS 0xFFF8BF93 DISPLAY_IDENTIFIER schrittschaltung.iSasZentr /end MEASUREMENT
/begin MEASUREMENT iSasZentr.start_wert_grad "Startwert für Rückfiltergradient." SWORD UMR_NM__1_1_0_S5_S3 1 100 -200 1300 ECU_ADDRESS 0xFFF8BFC8 DISPLAY_IDENTIFIER start_wert_grad.iSasZentr /end MEASUREMENT
/begin MEASUREMENT iSasZentr.sync_istgang_verlassen "FLAG: Synchrondrehzahl istgang verlassen (SCHWELLE_NDSYSN)" UBYTE Conv.cSasZentr._.sync_istgang_verlassen_S5_S3 1 100 0 1 BIT_MASK 0x1 ECU_ADDRESS 0xFFF8BF99 DISPLAY_IDENTIFIER sync_istgang_verlassen.iSasZentr /end MEASUREMENT
/begin MEASUREMENT iSasZentr.sync_istgang_verlassen_me "FLAG: Synchrondrehzahl Istgang verlassen (schaltungsabhaengig) fuer ME und GWK" UBYTE Conv.cSasZentr._.sync_istgang_verlassen_me_S5_S3 1 100 0 1 BIT_MASK 0x1 ECU_ADDRESS 0xFFF8BF98 DISPLAY_IDENTIFIER sync_istgang_verlassen_me.iSasZentr /end MEASUREMENT
/begin MEASUREMENT iSasZentr.sync_ziel_erreicht "FLAG: Synchronpunkt erreicht (bleibt fuer Mindestzeit stehen)" UBYTE Conv.cSasZentr._.sync_ziel_erreicht_S5_S3 1 100 0 1 BIT_MASK 0x1 ECU_ADDRESS 0xFFF8BFAD DISPLAY_IDENTIFIER sync_ziel_erreicht.iSasZentr /end MEASUREMENT
/begin MEASUREMENT iSasZentr.t_schaltverzug "Schaltungsverzugszeit" UWORD UMR_MSEC__10_1_0_S5_S3 1 100 0 50000 ECU_ADDRESS 0xFFF8BFA2 DISPLAY_IDENTIFIER t_schaltverzug.iSasZentr /end MEASUREMENT
/begin MEASUREMENT iSasZentr.t_z_m_motmax_kupschtz "Zustandszeit für z_m_motmax_kupschtz" UBYTE UMR_MSEC__10_1_0_S5_S3 1 100 0 2550 ECU_ADDRESS 0xFFF8BFC6 DISPLAY_IDENTIFIER t_z_m_motmax_kupschtz.iSasZentr /end MEASUREMENT
/begin MEASUREMENT iSasZentr.timer16_nsyn "Startet beim ersten Erkennen von synchron" UWORD UMR_MSEC__10_1_0_S5_S3 1 100 0 655350 ECU_ADDRESS 0xFFF8BFA4 DISPLAY_IDENTIFIER timer16_nsyn.iSasZentr /end MEASUREMENT
/begin MEASUREMENT iSasZentr.timer_hold_sync_ziel "Timer Mindesthaltezeit für sync_ziel_erreicht" UBYTE UMR_MSEC__10_1_0_S5_S3 1 100 0 2550 ECU_ADDRESS 0xFFF8BFBA DISPLAY_IDENTIFIER timer_hold_sync_ziel.iSasZentr /end MEASUREMENT
/begin MEASUREMENT iSasZentr.timer_in_synchron "Zeit seit der n_t innerhalb Synchronschwelle" UBYTE UMR_MSEC__10_1_0_S5_S3 1 100 0 2550 ECU_ADDRESS 0xFFF8BFA6 DISPLAY_IDENTIFIER timer_in_synchron.iSasZentr /end MEASUREMENT
/begin MEASUREMENT iSasZentr.timer_m_motmax_kupschtz "Timer Rückführungsrampe von m_motmax_kupschtz auf m_mot" UBYTE UMR_MSEC__10_1_0_S5_S3 1 100 0 2550 ECU_ADDRESS 0xFFF8BFC5 DISPLAY_IDENTIFIER timer_m_motmax_kupschtz.iSasZentr /end MEASUREMENT
/begin MEASUREMENT iSasZentr.timer_zug_sas "Timer Zugschaltung" UBYTE UMR_MSEC__10_1_0_S5_S3 1 100 0 2550 ECU_ADDRESS 0xFFF8BFCC DISPLAY_IDENTIFIER timer_zug_sas.iSasZentr /end MEASUREMENT
/begin MEASUREMENT iSasZentr.vorbereitung_im_vordergrund "Flag: Vorbereitung steuert Kupplung" UBYTE Conv.cSasZentr._.vorbereitung_im_vordergrund_S5_S3 1 100 0 1 BIT_MASK 0x1 ECU_ADDRESS 0xFFF8BFB4 DISPLAY_IDENTIFIER vorbereitung_im_vordergrund.iSasZentr /end MEASUREMENT
/begin MEASUREMENT iSasZentr.wechsel_normal_kurz "Flag: Wechsel von Normalen auf Spontane Schaltungen" UBYTE Conv.cSasZentr._.wechsel_normal_kurz_S5_S3 1 100 0 1 BIT_MASK 0x1 ECU_ADDRESS 0xFFF8BFB6 DISPLAY_IDENTIFIER wechsel_normal_kurz.iSasZentr /end MEASUREMENT
/begin MEASUREMENT iSasZentr.z_m_motmax_kupschtz "Zustandsgroesse für Zustandsgraph zur Bestimmung von m_motmax_kupschtz" UBYTE Conv.cSasZentr._.z_m_motmax_kupschtz_S5_S3 1 100 0 4 ECU_ADDRESS 0xFFF8BFC2 DISPLAY_IDENTIFIER z_m_motmax_kupschtz.iSasZentr /end MEASUREMENT
/begin MEASUREMENT iSasZentr.z_m_motmax_sas "Zustandsgroesse für Zustandsgraph zur Bestimmung von m_motmax_sas" UBYTE Conv.cSasZentr._.z_m_motmax_sas_S5_S3 1 100 0 3 ECU_ADDRESS 0xFFF8BFBB DISPLAY_IDENTIFIER z_m_motmax_sas.iSasZentr /end MEASUREMENT
/begin MEASUREMENT iSasZentr.z_sync_ziel "Zustandsgroesse für Zustandsgraph zur Bestimmung von sync_ziel_erreicht" UBYTE Conv.cSasZentr._.z_sync_ziel_S5_S3 1 100 0 3 ECU_ADDRESS 0xFFF8BFB9 DISPLAY_IDENTIFIER z_sync_ziel.iSasZentr /end MEASUREMENT
/begin MEASUREMENT iSasZentr.zaehler_z_m_motmax_kupschtz "Zustandszaehler der Zustandsgraph m_motmax_kupschtz" UBYTE UMR___1_1_0_S5_S3 1 100 0 255 ECU_ADDRESS 0xFFF8BFC4 DISPLAY_IDENTIFIER zaehler_z_m_motmax_kupschtz.iSasZentr /end MEASUREMENT
/begin MEASUREMENT iSasZentr.zaehler_z_m_motmax_sas "Zustandszaehler der Zustandsgraph m_motmax_sas" UBYTE UMR___1_1_0_S5_S3 1 100 0 255 ECU_ADDRESS 0xFFF8BFBD DISPLAY_IDENTIFIER zaehler_z_m_motmax_sas.iSasZentr /end MEASUREMENT
/begin MEASUREMENT iSasZentr.zs_wechsel_verboten "FLAG: Zug-Schub Wechsel verboten" UBYTE Conv.cSasZentr._.zs_wechsel_verboten_S5_S3 1 100 0 1 BIT_MASK 0x1 ECU_ADDRESS 0xFFF8BF94 DISPLAY_IDENTIFIER zs_wechsel_verboten.iSasZentr /end MEASUREMENT
/begin MEASUREMENT iSasZentr.zug_schub_sas "FLAG: Zustand Zug oder Schub beim Schaltablauf" UBYTE Conv.cSasZentr._.zug_schub_sas_S5_S3 1 100 0 1 ECU_ADDRESS 0xFFF8BF97 DISPLAY_IDENTIFIER zug_schub_sas.iSasZentr /end MEASUREMENT
/begin MEASUREMENT iTciCompu.auslastung_lkab "Auslastung maximale Reibleistung kab" FLOAT32_IEEE UMR_PROZENT__1_1_0_2_S5_S3 1 100 0 1e+037 ECU_ADDRESS 0xFFF8C408 FORMAT "%3.2" DISPLAY_IDENTIFIER auslastung_lkab.iTciCompu /end MEASUREMENT
/begin MEASUREMENT iTciCompu.auslastung_lkab_int "Auslastung maximale Reibleistung kab" UWORD UMR_PROZENT__1_100_0_S5_S3 1 100 0 655.35 ECU_ADDRESS 0xFFF8C43A DISPLAY_IDENTIFIER auslastung_lkab_int.iTciCompu /end MEASUREMENT
/begin MEASUREMENT iTciCompu.auslastung_lkzu "Auslastung maximale Reibleistung kzu" FLOAT32_IEEE UMR_PROZENT__1_1_0_2_S5_S3 1 100 0 1e+037 ECU_ADDRESS 0xFFF8C404 FORMAT "%3.2" DISPLAY_IDENTIFIER auslastung_lkzu.iTciCompu /end MEASUREMENT
/begin MEASUREMENT iTciCompu.auslastung_lkzu_int "Auslastung maximale Reibleistung kzu" UWORD UMR_PROZENT__1_100_0_S5_S3 1 100 0 655.35 ECU_ADDRESS 0xFFF8C438 DISPLAY_IDENTIFIER auslastung_lkzu_int.iTciCompu /end MEASUREMENT
/begin MEASUREMENT iTciCompu.auslastung_wkab "Auslastung maximale Reibarbeit kab" FLOAT32_IEEE UMR_PROZENT__1_1_0_2_S5_S3 1 100 0 1e+037 ECU_ADDRESS 0xFFF8C410 FORMAT "%3.2" DISPLAY_IDENTIFIER auslastung_wkab.iTciCompu /end MEASUREMENT
/begin MEASUREMENT iTciCompu.auslastung_wkab_int "Auslastung maximale Reibarbeit kab" UWORD UMR_PROZENT__1_100_0_S5_S3 1 100 0 655.35 ECU_ADDRESS 0xFFF8C43E DISPLAY_IDENTIFIER auslastung_wkab_int.iTciCompu /end MEASUREMENT
/begin MEASUREMENT iTciCompu.auslastung_wkzu "Auslastung maximale Reibarbeit kzu" FLOAT32_IEEE UMR_PROZENT__1_1_0_2_S5_S3 1 100 0 1e+037 ECU_ADDRESS 0xFFF8C40C FORMAT "%3.2" DISPLAY_IDENTIFIER auslastung_wkzu.iTciCompu /end MEASUREMENT
/begin MEASUREMENT iTciCompu.auslastung_wkzu_int "Auslastung maximale Reibarbeit kzu" UWORD UMR_PROZENT__1_100_0_S5_S3 1 100 0 655.35 ECU_ADDRESS 0xFFF8C43C DISPLAY_IDENTIFIER auslastung_wkzu_int.iTciCompu /end MEASUREMENT
/begin MEASUREMENT iTciCompu.c_kupplung_gestz "Maximale Kupplungstemperatur aller geschlossenen Schaltelementen in [°C]" SWORD UMR_GRADC__1_1_0_S5_S3 1 100 -40 500 ECU_ADDRESS 0xFFF8C440 DISPLAY_IDENTIFIER c_kupplung_gestz.iTciCompu /end MEASUREMENT
/begin MEASUREMENT iTciCompu.c_kupplung_max "Maximale Kupplungstemperatur aller Schaltelemente in [°C]" SWORD UMR_GRADC__1_1_0_S5_S3 1 100 -40 500 ECU_ADDRESS 0xFFF8C44A DISPLAY_IDENTIFIER c_kupplung_max.iTciCompu /end MEASUREMENT
/begin MEASUREMENT iTciCompu.f_timer_belast_ber_kab_gestartet "Flag: Timer seit Start der Belastungsber. der KAB gestartet" UBYTE Conv.cTciCompu._.f_timer_belast_ber_kab_gestartet_S5_S3 1 100 0 1 BIT_MASK 0x1 ECU_ADDRESS 0xFFF8C443 DISPLAY_IDENTIFIER f_timer_belast_ber_kab_gestartet.iTciCompu /end MEASUREMENT
/begin MEASUREMENT iTciCompu.f_timer_belast_ber_kzu_gestartet "Flag: Timer seit Start der Belastungsber. der KZU gestartet" UBYTE Conv.cTciCompu._.f_timer_belast_ber_kzu_gestartet_S5_S3 1 100 0 1 BIT_MASK 0x1 ECU_ADDRESS 0xFFF8C442 DISPLAY_IDENTIFIER f_timer_belast_ber_kzu_gestartet.iTciCompu /end MEASUREMENT
/begin MEASUREMENT iTciCompu.flag_ende_kab_ber_erreicht "Flag: Ende der Kupplungsbelastungsberechnung für die KAB erreicht" UBYTE Conv.cTciCompu._.flag_ende_kab_ber_erreicht_S5_S3 1 100 0 1 BIT_MASK 0x1 ECU_ADDRESS 0xFFF8C448 DISPLAY_IDENTIFIER flag_ende_kab_ber_erreicht.iTciCompu /end MEASUREMENT
/begin MEASUREMENT iTciCompu.flag_ende_kzu_ber_erreicht "Flag: Ende der Kupplungsbelastungsberechnung für die KZU erreicht" UBYTE Conv.cTciCompu._.flag_ende_kzu_ber_erreicht_S5_S3 1 100 0 1 BIT_MASK 0x1 ECU_ADDRESS 0xFFF8C449 DISPLAY_IDENTIFIER flag_ende_kzu_ber_erreicht.iTciCompu /end MEASUREMENT
/begin MEASUREMENT iTciCompu.flag_schaltung_ende "Flag, ob schaltung beendet" UBYTE Conv.cTciCompu._.flag_schaltung_ende_S5_S3 1 100 0 1 BIT_MASK 0x1 ECU_ADDRESS 0xFFF8C414 DISPLAY_IDENTIFIER flag_schaltung_ende.iTciCompu /end MEASUREMENT
/begin MEASUREMENT iTciCompu.iPKAbFilter.letzter_ms_timer "letzter BS-Timer" UWORD UMR_MSEC__1_1_0_S5_S3 1 100 0 65535 ECU_ADDRESS 0xFFF8C45C DISPLAY_IDENTIFIER letzter_ms_timer.iPKAbFilter.iTciCompu /end MEASUREMENT
/begin MEASUREMENT iTciCompu.iPKAbFilter.x "letzter Wert" SLONG UMR___1_1_0_S5_S3 1 100 -2147483648 2147483647 ECU_ADDRESS 0xFFF8C458 DISPLAY_IDENTIFIER x.iPKAbFilter.iTciCompu /end MEASUREMENT
/begin MEASUREMENT iTciCompu.iPKZuFilter.letzter_ms_timer "letzter BS-Timer" UWORD UMR_MSEC__1_1_0_S5_S3 1 100 0 65535 ECU_ADDRESS 0xFFF8C454 DISPLAY_IDENTIFIER letzter_ms_timer.iPKZuFilter.iTciCompu /end MEASUREMENT
/begin MEASUREMENT iTciCompu.iPKZuFilter.x "letzter Wert" SLONG UMR___1_1_0_S5_S3 1 100 -2147483648 2147483647 ECU_ADDRESS 0xFFF8C450 DISPLAY_IDENTIFIER x.iPKZuFilter.iTciCompu /end MEASUREMENT
/begin MEASUREMENT iTciCompu.istgang_idx_merk "Gemerkter Ist-Gang für Berechnung Kupplungsauslastung bei Schaltungsende" UBYTE Conv.cTciCompu._.istgang_idx_merk_S5_S3 1 100 0 10 ECU_ADDRESS 0xFFF8C415 DISPLAY_IDENTIFIER istgang_idx_merk.iTciCompu /end MEASUREMENT
/begin MEASUREMENT iTciCompu.k_ab "Abschaltende Kupplung" UBYTE Conv.cTciCompu._.k_ab_S5_S3 1 100 0 5 ECU_ADDRESS 0xFFF8C3C8 DISPLAY_IDENTIFIER k_ab.iTciCompu /end MEASUREMENT
/begin MEASUREMENT iTciCompu.k_zu "Zuschaltende Kupplung" UBYTE Conv.cTciCompu._.k_zu_S5_S3 1 100 0 5 ECU_ADDRESS 0xFFF8C3C9 DISPLAY_IDENTIFIER k_zu.iTciCompu /end MEASUREMENT
/begin MEASUREMENT iTciCompu.l_kab "aktuelle Leistung an der abschaltenden Kupplung" FLOAT32_IEEE UMR_KW__1_1_0_S5_S3 1 100 0 1e+037 ECU_ADDRESS 0xFFF8C3D8 FORMAT "%4.3" DISPLAY_IDENTIFIER l_kab.iTciCompu /end MEASUREMENT
/begin MEASUREMENT iTciCompu.l_kab_int "aktuelle Leistung an der abschaltenden Kupplung" SLONG UMR_KW__1_1000_0_S5_S3 1 100 0 2147483.647 ECU_ADDRESS 0xFFF8C41C DISPLAY_IDENTIFIER l_kab_int.iTciCompu /end MEASUREMENT
/begin MEASUREMENT iTciCompu.l_kab_max "maximale Leistung an der abschaltenden Kupplung" FLOAT32_IEEE UMR_KW__1_1_0_S5_S3 1 100 0 1e+037 ECU_ADDRESS 0xFFF8C3E0 FORMAT "%4.3" DISPLAY_IDENTIFIER l_kab_max.iTciCompu /end MEASUREMENT
/begin MEASUREMENT iTciCompu.l_kab_max_int "maximale Leistung an der abschaltenden Kupplung" SLONG UMR_KW__1_1000_0_S5_S3 1 100 0 2147483.647 ECU_ADDRESS 0xFFF8C424 DISPLAY_IDENTIFIER l_kab_max_int.iTciCompu /end MEASUREMENT
/begin MEASUREMENT iTciCompu.l_kab_max_spez "maximale spezifische Reibleistung an der abschaltenden Kupplung" FLOAT32_IEEE UMR_W_MM2_1_1_0_3_S5_S3 1 100 0 1e+037 ECU_ADDRESS 0xFFF8C3E8 FORMAT "%4.3" DISPLAY_IDENTIFIER l_kab_max_spez.iTciCompu /end MEASUREMENT
/begin MEASUREMENT iTciCompu.l_kab_max_spez_int "maximale spezifische Reibleistung an der abschaltenden Kupplung" SWORD UMR_W_MM2_1_100_0_S5_S3 1 100 0 327.67 ECU_ADDRESS 0xFFF8C42A DISPLAY_IDENTIFIER l_kab_max_spez_int.iTciCompu /end MEASUREMENT
/begin MEASUREMENT iTciCompu.l_kzu "aktuelle Leistung an der zuschaltenden Kupplung" FLOAT32_IEEE UMR_KW__1_1_0_S5_S3 1 100 0 1e+037 ECU_ADDRESS 0xFFF8C3D4 FORMAT "%4.3" DISPLAY_IDENTIFIER l_kzu.iTciCompu /end MEASUREMENT
/begin MEASUREMENT iTciCompu.l_kzu_int "aktuelle Leistung an der zuschaltenden Kupplung" SLONG UMR_KW__1_1000_0_S5_S3 1 100 0 2147483.647 ECU_ADDRESS 0xFFF8C418 DISPLAY_IDENTIFIER l_kzu_int.iTciCompu /end MEASUREMENT
/begin MEASUREMENT iTciCompu.l_kzu_max "maximale Leistung an der zuschaltenden Kupplung" FLOAT32_IEEE UMR_KW__1_1_0_S5_S3 1 100 0 1e+037 ECU_ADDRESS 0xFFF8C3DC FORMAT "%4.3" DISPLAY_IDENTIFIER l_kzu_max.iTciCompu /end MEASUREMENT
/begin MEASUREMENT iTciCompu.l_kzu_max_int "maximale Leistung an der zuschaltenden Kupplung" SLONG UMR_KW__1_1000_0_S5_S3 1 100 0 2147483.647 ECU_ADDRESS 0xFFF8C420 DISPLAY_IDENTIFIER l_kzu_max_int.iTciCompu /end MEASUREMENT
/begin MEASUREMENT iTciCompu.l_kzu_max_spez "maximale spezifische Reibleistung an der zuschaltenden Kupplung" FLOAT32_IEEE UMR_W_MM2_1_1_0_3_S5_S3 1 100 0 1e+037 ECU_ADDRESS 0xFFF8C3E4 FORMAT "%4.3" DISPLAY_IDENTIFIER l_kzu_max_spez.iTciCompu /end MEASUREMENT
/begin MEASUREMENT iTciCompu.l_kzu_max_spez_int "maximale spezifische Reibleistung an der zuschaltenden Kupplung" SWORD UMR_W_MM2_1_100_0_S5_S3 1 100 0 327.67 ECU_ADDRESS 0xFFF8C428 DISPLAY_IDENTIFIER l_kzu_max_spez_int.iTciCompu /end MEASUREMENT
/begin MEASUREMENT iTciCompu.m_kab "Kupplungsmoment an der abschaltenden Kupplung" SWORD UMR_NM__1_1_0_S5_S3 1 100 0 1000 ECU_ADDRESS 0xFFF8C3CE DISPLAY_IDENTIFIER m_kab.iTciCompu /end MEASUREMENT
/begin MEASUREMENT iTciCompu.m_kzu "Kupplungsmoment an der zuschaltenden Kupplung" SWORD UMR_NM__1_1_0_S5_S3 1 100 0 1000 ECU_ADDRESS 0xFFF8C3CC DISPLAY_IDENTIFIER m_kzu.iTciCompu /end MEASUREMENT
/begin MEASUREMENT iTciCompu.nd_abs_kab "Differenzdrehzahl an der abschaltenden Kupplung" SWORD UMR_U_MIN_1_1_0_S5_S3 1 100 0 24000 ECU_ADDRESS 0xFFF8C3D2 DISPLAY_IDENTIFIER nd_abs_kab.iTciCompu /end MEASUREMENT
/begin MEASUREMENT iTciCompu.nd_abs_kzu "Differenzdrehzahl an der zuschaltenden Kupplung" SWORD UMR_U_MIN_1_1_0_S5_S3 1 100 0 24000 ECU_ADDRESS 0xFFF8C3D0 DISPLAY_IDENTIFIER nd_abs_kzu.iTciCompu /end MEASUREMENT
/begin MEASUREMENT iTciCompu.schaltart_sas_red_tci "Aktuelle Schaltart nur auf HS, RS, GE reduziert" UBYTE Conv.cTciCompu._.schaltart_sas_red_tci_S5_S3 1 100 1 3 ECU_ADDRESS 0xFFF8C44C DISPLAY_IDENTIFIER schaltart_sas_red_tci.iTciCompu /end MEASUREMENT
/begin MEASUREMENT iTciCompu.timer_seit_start_ber_belastung_kab "Zeit seit Start der Belastungsber. der KAB" UWORD UMR_MSEC__10_1_0_S5_S3 1 100 0 320000 ECU_ADDRESS 0xFFF8C446 DISPLAY_IDENTIFIER timer_seit_start_ber_belastung_kab.iTciCompu /end MEASUREMENT
/begin MEASUREMENT iTciCompu.timer_seit_start_ber_belastung_kzu "Zeit seit Start der Belastungsber. der KZU" UWORD UMR_MSEC__10_1_0_S5_S3 1 100 0 320000 ECU_ADDRESS 0xFFF8C444 DISPLAY_IDENTIFIER timer_seit_start_ber_belastung_kzu.iTciCompu /end MEASUREMENT
/begin MEASUREMENT iTciCompu.w_kab "aktuelle Reibarbeit an der abschaltenden Kupplung" FLOAT32_IEEE UMR_KJ__1_1_0_S5_S3 1 100 0 1e+037 ECU_ADDRESS 0xFFF8C3F0 FORMAT "%4.3" DISPLAY_IDENTIFIER w_kab.iTciCompu /end MEASUREMENT
/begin MEASUREMENT iTciCompu.w_kab_int "aktuelle Reibarbeit an der abschaltenden Kupplung" SLONG UMR_KJ__1_1000_0_S5_S3 1 100 0 2147483.647 ECU_ADDRESS 0xFFF8C430 DISPLAY_IDENTIFIER w_kab_int.iTciCompu /end MEASUREMENT
/begin MEASUREMENT iTciCompu.w_kab_speicher "aktuelle Reibarbeit an der abschaltenden Kupplung" FLOAT32_IEEE UMR_KJ__1_1_0_S5_S3 1 100 0 1e+037 ECU_ADDRESS 0xFFF8C400 FORMAT "%4.3" DISPLAY_IDENTIFIER w_kab_speicher.iTciCompu /end MEASUREMENT
/begin MEASUREMENT iTciCompu.w_kab_spez "Spezifische Reibarbeit an der abschaltenden Kupplung" FLOAT32_IEEE UMR_J_G_1_1_0_S5_S3 1 100 0 1e+037 ECU_ADDRESS 0xFFF8C3F8 FORMAT "%4.3" DISPLAY_IDENTIFIER w_kab_spez.iTciCompu /end MEASUREMENT
/begin MEASUREMENT iTciCompu.w_kab_spez_int "Spezifische Reibarbeit an der abschaltenden Kupplung" SWORD UMR_J_G_1_100_0_S5_S3 1 100 0 327.67 ECU_ADDRESS 0xFFF8C436 DISPLAY_IDENTIFIER w_kab_spez_int.iTciCompu /end MEASUREMENT
/begin MEASUREMENT iTciCompu.w_kzu "aktuelle Reibarbeit an der zuschaltenden Kupplung" FLOAT32_IEEE UMR_KJ__1_1_0_S5_S3 1 100 0 1e+037 ECU_ADDRESS 0xFFF8C3EC FORMAT "%4.3" DISPLAY_IDENTIFIER w_kzu.iTciCompu /end MEASUREMENT
/begin MEASUREMENT iTciCompu.w_kzu_int "aktuelle Reibarbeit an der zuschaltenden Kupplung" SLONG UMR_KJ__1_1000_0_S5_S3 1 100 0 2147483.647 ECU_ADDRESS 0xFFF8C42C DISPLAY_IDENTIFIER w_kzu_int.iTciCompu /end MEASUREMENT
/begin MEASUREMENT iTciCompu.w_kzu_speicher "aktuelle Reibarbeit an der zuschaltenden Kupplung" FLOAT32_IEEE UMR_KJ__1_1_0_S5_S3 1 100 0 1e+037 ECU_ADDRESS 0xFFF8C3FC FORMAT "%4.3" DISPLAY_IDENTIFIER w_kzu_speicher.iTciCompu /end MEASUREMENT
/begin MEASUREMENT iTciCompu.w_kzu_spez "Spezifische Reibarbeit an der zuschaltenden Kupplung" FLOAT32_IEEE UMR_J_G_1_1_0_S5_S3 1 100 0 1e+037 ECU_ADDRESS 0xFFF8C3F4 FORMAT "%4.3" DISPLAY_IDENTIFIER w_kzu_spez.iTciCompu /end MEASUREMENT
/begin MEASUREMENT iTciCompu.w_kzu_spez_int "Spezifische Reibarbeit an der zuschaltenden Kupplung" SWORD UMR_J_G_1_100_0_S5_S3 1 100 0 327.67 ECU_ADDRESS 0xFFF8C434 DISPLAY_IDENTIFIER w_kzu_spez_int.iTciCompu /end MEASUREMENT
/begin MEASUREMENT iTciCompu.z_tci "Zustandszeiger für Berechnung Kupplungsbelastung" UBYTE Conv.cTciCompu._.z_tci_S5_S3 1 100 0 2 ECU_ADDRESS 0xFFF8C3CA DISPLAY_IDENTIFIER z_tci.iTciCompu /end MEASUREMENT
/begin MEASUREMENT iTciCompu.zielgang_sas_idx_merk "Gemerkter Ziel-Gang für Berechnung Kupplungsauslastung bei Schaltungsende" UBYTE Conv.cTciCompu._.zielgang_sas_idx_merk_S5_S3 1 100 0 10 ECU_ADDRESS 0xFFF8C416 DISPLAY_IDENTIFIER zielgang_sas_idx_merk.iTciCompu /end MEASUREMENT
/begin MEASUREMENT iTempMKupA.c_kupplung "Kupplungstemperatur in [°C]" SWORD UMR_GRADC__1_1_0_S5_S3 1 100 -40 500 ECU_ADDRESS 0xFFF8C460 DISPLAY_IDENTIFIER c_kupplung.iTempMKupA /end MEASUREMENT
/begin MEASUREMENT iTempMKupA.c_kupplung_intern "Kupplungstemperatur in [°C]" FLOAT32_IEEE UMR_GRADC__1_1_0_S5_S3 1 100 -1e+037 1e+037 ECU_ADDRESS 0xFFF8C46C DISPLAY_IDENTIFIER c_kupplung_intern.iTempMKupA /end MEASUREMENT
/begin MEASUREMENT iTempMKupA.c_kupplung_merk "Kupplungstemperatur in [°C]" FLOAT32_IEEE UMR_GRADC__1_1_0_S5_S3 1 100 -40 500 ECU_ADDRESS 0xFFF8C470 DISPLAY_IDENTIFIER c_kupplung_merk.iTempMKupA /end MEASUREMENT
/begin MEASUREMENT iTempMKupA.f_aufheizung_aktiv "Flag ob eine Aufheizung der Kupplung stattfindet" UBYTE Conv.cTciTempM._.f_aufheizung_aktiv_S5_S3 1 100 0 1 BIT_MASK 0x1 ECU_ADDRESS 0xFFF8C475 DISPLAY_IDENTIFIER f_aufheizung_aktiv.iTempMKupA /end MEASUREMENT
/begin MEASUREMENT iTempMKupA.kupplung "aktive Kupplung" UBYTE Conv.cTciTempM._.kupplung_S5_S3 1 100 0 5 ECU_ADDRESS 0xFFF8C474 DISPLAY_IDENTIFIER kupplung.iTempMKupA /end MEASUREMENT
/begin MEASUREMENT iTempMKupA.q_ab_kupplung "Von der Kupplung an Kühlöl abgegebener Wärmestrom" FLOAT32_IEEE UMR_K_SEC_1_1_0_S5_S3 1 100 -1e+037 1e+037 ECU_ADDRESS 0xFFF8C464 FORMAT "%3.2" DISPLAY_IDENTIFIER q_ab_kupplung.iTempMKupA /end MEASUREMENT
/begin MEASUREMENT iTempMKupA.q_zu_kupplung "Zugeführter Wärmestrom an Kupplung" FLOAT32_IEEE UMR_K_SEC_1_1_0_S5_S3 1 100 -1e+037 1e+037 ECU_ADDRESS 0xFFF8C468 FORMAT "%3.2" DISPLAY_IDENTIFIER q_zu_kupplung.iTempMKupA /end MEASUREMENT
/begin MEASUREMENT iTempMKupC.c_kupplung "Kupplungstemperatur in [°C]" SWORD UMR_GRADC__1_1_0_S5_S3 1 100 -40 500 ECU_ADDRESS 0xFFF8C47C DISPLAY_IDENTIFIER c_kupplung.iTempMKupC /end MEASUREMENT
/begin MEASUREMENT iTempMKupC.c_kupplung_intern "Kupplungstemperatur in [°C]" FLOAT32_IEEE UMR_GRADC__1_1_0_S5_S3 1 100 -1e+037 1e+037 ECU_ADDRESS 0xFFF8C488 DISPLAY_IDENTIFIER c_kupplung_intern.iTempMKupC /end MEASUREMENT
/begin MEASUREMENT iTempMKupC.c_kupplung_merk "Kupplungstemperatur in [°C]" FLOAT32_IEEE UMR_GRADC__1_1_0_S5_S3 1 100 -40 500 ECU_ADDRESS 0xFFF8C48C DISPLAY_IDENTIFIER c_kupplung_merk.iTempMKupC /end MEASUREMENT
/begin MEASUREMENT iTempMKupC.f_aufheizung_aktiv "Flag ob eine Aufheizung der Kupplung stattfindet" UBYTE Conv.cTciTempM._.f_aufheizung_aktiv_S5_S3 1 100 0 1 BIT_MASK 0x1 ECU_ADDRESS 0xFFF8C491 DISPLAY_IDENTIFIER f_aufheizung_aktiv.iTempMKupC /end MEASUREMENT
/begin MEASUREMENT iTempMKupC.kupplung "aktive Kupplung" UBYTE Conv.cTciTempM._.kupplung_S5_S3 1 100 0 5 ECU_ADDRESS 0xFFF8C490 DISPLAY_IDENTIFIER kupplung.iTempMKupC /end MEASUREMENT
/begin MEASUREMENT iTempMKupC.q_ab_kupplung "Von der Kupplung an Kühlöl abgegebener Wärmestrom" FLOAT32_IEEE UMR_K_SEC_1_1_0_S5_S3 1 100 -1e+037 1e+037 ECU_ADDRESS 0xFFF8C480 FORMAT "%3.2" DISPLAY_IDENTIFIER q_ab_kupplung.iTempMKupC /end MEASUREMENT
/begin MEASUREMENT iTempMKupC.q_zu_kupplung "Zugeführter Wärmestrom an Kupplung" FLOAT32_IEEE UMR_K_SEC_1_1_0_S5_S3 1 100 -1e+037 1e+037 ECU_ADDRESS 0xFFF8C484 FORMAT "%3.2" DISPLAY_IDENTIFIER q_zu_kupplung.iTempMKupC /end MEASUREMENT
/begin MEASUREMENT iTempMKupD.c_kupplung "Kupplungstemperatur in [°C]" SWORD UMR_GRADC__1_1_0_S5_S3 1 100 -40 500 ECU_ADDRESS 0xFFF8C498 DISPLAY_IDENTIFIER c_kupplung.iTempMKupD /end MEASUREMENT
/begin MEASUREMENT iTempMKupD.c_kupplung_intern "Kupplungstemperatur in [°C]" FLOAT32_IEEE UMR_GRADC__1_1_0_S5_S3 1 100 -1e+037 1e+037 ECU_ADDRESS 0xFFF8C4A4 DISPLAY_IDENTIFIER c_kupplung_intern.iTempMKupD /end MEASUREMENT
/begin MEASUREMENT iTempMKupD.c_kupplung_merk "Kupplungstemperatur in [°C]" FLOAT32_IEEE UMR_GRADC__1_1_0_S5_S3 1 100 -40 500 ECU_ADDRESS 0xFFF8C4A8 DISPLAY_IDENTIFIER c_kupplung_merk.iTempMKupD /end MEASUREMENT
/begin MEASUREMENT iTempMKupD.f_aufheizung_aktiv "Flag ob eine Aufheizung der Kupplung stattfindet" UBYTE Conv.cTciTempM._.f_aufheizung_aktiv_S5_S3 1 100 0 1 BIT_MASK 0x1 ECU_ADDRESS 0xFFF8C4AD DISPLAY_IDENTIFIER f_aufheizung_aktiv.iTempMKupD /end MEASUREMENT
/begin MEASUREMENT iTempMKupD.kupplung "aktive Kupplung" UBYTE Conv.cTciTempM._.kupplung_S5_S3 1 100 0 5 ECU_ADDRESS 0xFFF8C4AC DISPLAY_IDENTIFIER kupplung.iTempMKupD /end MEASUREMENT
/begin MEASUREMENT iTempMKupD.q_ab_kupplung "Von der Kupplung an Kühlöl abgegebener Wärmestrom" FLOAT32_IEEE UMR_K_SEC_1_1_0_S5_S3 1 100 -1e+037 1e+037 ECU_ADDRESS 0xFFF8C49C FORMAT "%3.2" DISPLAY_IDENTIFIER q_ab_kupplung.iTempMKupD /end MEASUREMENT
/begin MEASUREMENT iTempMKupD.q_zu_kupplung "Zugeführter Wärmestrom an Kupplung" FLOAT32_IEEE UMR_K_SEC_1_1_0_S5_S3 1 100 -1e+037 1e+037 ECU_ADDRESS 0xFFF8C4A0 FORMAT "%3.2" DISPLAY_IDENTIFIER q_zu_kupplung.iTempMKupD /end MEASUREMENT
/begin MEASUREMENT iTempMKupE.c_kupplung "Kupplungstemperatur in [°C]" SWORD UMR_GRADC__1_1_0_S5_S3 1 100 -40 500 ECU_ADDRESS 0xFFF8C4B4 DISPLAY_IDENTIFIER c_kupplung.iTempMKupE /end MEASUREMENT
/begin MEASUREMENT iTempMKupE.c_kupplung_intern "Kupplungstemperatur in [°C]" FLOAT32_IEEE UMR_GRADC__1_1_0_S5_S3 1 100 -1e+037 1e+037 ECU_ADDRESS 0xFFF8C4C0 DISPLAY_IDENTIFIER c_kupplung_intern.iTempMKupE /end MEASUREMENT
/begin MEASUREMENT iTempMKupE.c_kupplung_merk "Kupplungstemperatur in [°C]" FLOAT32_IEEE UMR_GRADC__1_1_0_S5_S3 1 100 -40 500 ECU_ADDRESS 0xFFF8C4C4 DISPLAY_IDENTIFIER c_kupplung_merk.iTempMKupE /end MEASUREMENT
/begin MEASUREMENT iTempMKupE.f_aufheizung_aktiv "Flag ob eine Aufheizung der Kupplung stattfindet" UBYTE Conv.cTciTempM._.f_aufheizung_aktiv_S5_S3 1 100 0 1 BIT_MASK 0x1 ECU_ADDRESS 0xFFF8C4C9 DISPLAY_IDENTIFIER f_aufheizung_aktiv.iTempMKupE /end MEASUREMENT
/begin MEASUREMENT iTempMKupE.kupplung "aktive Kupplung" UBYTE Conv.cTciTempM._.kupplung_S5_S3 1 100 0 5 ECU_ADDRESS 0xFFF8C4C8 DISPLAY_IDENTIFIER kupplung.iTempMKupE /end MEASUREMENT
/begin MEASUREMENT iTempMKupE.q_ab_kupplung "Von der Kupplung an Kühlöl abgegebener Wärmestrom" FLOAT32_IEEE UMR_K_SEC_1_1_0_S5_S3 1 100 -1e+037 1e+037 ECU_ADDRESS 0xFFF8C4B8 FORMAT "%3.2" DISPLAY_IDENTIFIER q_ab_kupplung.iTempMKupE /end MEASUREMENT
/begin MEASUREMENT iTempMKupE.q_zu_kupplung "Zugeführter Wärmestrom an Kupplung" FLOAT32_IEEE UMR_K_SEC_1_1_0_S5_S3 1 100 -1e+037 1e+037 ECU_ADDRESS 0xFFF8C4BC FORMAT "%3.2" DISPLAY_IDENTIFIER q_zu_kupplung.iTempMKupE /end MEASUREMENT
/begin MEASUREMENT iUewIgBerechnung.iMGSollmoment.letzter_ms_timer "letzter Timerwert" UWORD UMR___1_1_0_S5_S3 1 100 0 65535 ECU_ADDRESS 0xFFF8C570 DISPLAY_IDENTIFIER letzter_ms_timer.iMGSollmoment.iUewIgBerechnung /end MEASUREMENT
/begin MEASUREMENT iUewIgBerechnung.iMGSollmoment.n_f "letzter Wert" SLONG UMR___1_1_0_S5_S3 1 100 -2147483648 2147483647 ECU_ADDRESS 0xFFF8C56C DISPLAY_IDENTIFIER n_f.iMGSollmoment.iUewIgBerechnung /end MEASUREMENT
/begin MEASUREMENT iUewIgBerechnung.mg_motsolluwig "Gradient des Motorsollmomentes" SWORD UMR_NM_SEC_1_1_0_S5_S3 1 100 -32768 32767 ECU_ADDRESS 0xFFF8C574 DISPLAY_IDENTIFIER mg_motsolluwig.iUewIgBerechnung /end MEASUREMENT
/begin MEASUREMENT iUewIgetr.b_uwig_auf_symptom_pruefen "Flag UWIG auf Symptom pruefen" UBYTE Conv.cUewIgetr._.b_uwig_auf_symptom_pruefen_S5_S3 1 100 0 1 BIT_MASK 0x1 ECU_ADDRESS 0xFFF8C51D DISPLAY_IDENTIFIER b_uwig_auf_symptom_pruefen.iUewIgetr /end MEASUREMENT
/begin MEASUREMENT iUewIgetr.delta_dki "Delta Drosselklappe von Start Gangeinlegen an" UBYTE UMR_PROZENT__20_51_0_S5_S3 1 100 0 100 ECU_ADDRESS 0xFFF8C524 DISPLAY_IDENTIFIER delta_dki.iUewIgetr /end MEASUREMENT
/begin MEASUREMENT iUewIgetr.dki_max "maximaler Drosselklappewert von Start Gangeinlegen an" UBYTE UMR_PROZENT__20_51_0_S5_S3 1 100 0 100 ECU_ADDRESS 0xFFF8C525 DISPLAY_IDENTIFIER dki_max.iUewIgetr /end MEASUREMENT
/begin MEASUREMENT iUewIgetr.dki_min "minimaler Drosselklappenwert von Start Gangeinlegen an" UBYTE UMR_PROZENT__20_51_0_S5_S3 1 100 0 100 ECU_ADDRESS 0xFFF8C526 DISPLAY_IDENTIFIER dki_min.iUewIgetr /end MEASUREMENT
/begin MEASUREMENT iUewIgetr.f_abbruch_akt_ueberwachung "Flag: laufende ueberwachung soll abgebrochen werden" UBYTE Conv.cUewIgetr._.f_abbruch_akt_ueberwachung_S5_S3 1 100 0 1 BIT_MASK 0x1 ECU_ADDRESS 0xFFF8C540 DISPLAY_IDENTIFIER f_abbruch_akt_ueberwachung.iUewIgetr /end MEASUREMENT
/begin MEASUREMENT iUewIgetr.f_ersatzprogramm_aktiv "Flag: Ersatzprogramm wurde von UWIG ausgeloest, d.h. Symptomgaenge werden nicht mehr gesetzt" UBYTE Conv.cUewIgetr._.f_ersatzprogramm_aktiv_S5_S3 1 100 0 1 BIT_MASK 0x1 ECU_ADDRESS 0xFFF8C547 DISPLAY_IDENTIFIER f_ersatzprogramm_aktiv.iUewIgetr /end MEASUREMENT
/begin MEASUREMENT iUewIgetr.f_ersatzwert_stc "Flag: Abtriebsdrehzahl wird aus einem Ersatzwert ermittelt" UBYTE Conv.cUewIgetr._.f_ersatzwert_stc_S5_S3 1 100 0 1 BIT_MASK 0x1 ECU_ADDRESS 0xFFF8C546 DISPLAY_IDENTIFIER f_ersatzwert_stc.iUewIgetr /end MEASUREMENT
/begin MEASUREMENT iUewIgetr.f_ist_ersatzgang_gang_stc "Flag: Ersatzgang gesetzt, weil Symptom waehrend Ganghalten erkannt wurde" UBYTE Conv.cUewIgetr._.f_ist_ersatzgang_gang_stc_S5_S3 1 100 0 1 BIT_MASK 0x1 ECU_ADDRESS 0xFFF8C53A DISPLAY_IDENTIFIER f_ist_ersatzgang_gang_stc.iUewIgetr /end MEASUREMENT
/begin MEASUREMENT iUewIgetr.f_ist_ersatzgang_ge_stc "Flag: Ersatzgang gesetzt, weil Symptom waehrend Gangeinlegen erkannt wurde" UBYTE Conv.cUewIgetr._.f_ist_ersatzgang_ge_stc_S5_S3 1 100 0 1 BIT_MASK 0x1 ECU_ADDRESS 0xFFF8C53B DISPLAY_IDENTIFIER f_ist_ersatzgang_ge_stc.iUewIgetr /end MEASUREMENT
/begin MEASUREMENT iUewIgetr.f_ist_ersatzgang_schalt_stc "Flag: Ersatzgang gesetzt, weil Symptom waehrend Schaltung erkannt wurde" UBYTE Conv.cUewIgetr._.f_ist_ersatzgang_schalt_stc_S5_S3 1 100 0 1 BIT_MASK 0x1 ECU_ADDRESS 0xFFF8C539 DISPLAY_IDENTIFIER f_ist_ersatzgang_schalt_stc.iUewIgetr /end MEASUREMENT
/begin MEASUREMENT iUewIgetr.f_ist_ge_stc "Flag: es laeuft ein Gangeinlegevorgang" UBYTE Conv.cUewIgetr._.f_ist_ge_stc_S5_S3 1 100 0 1 BIT_MASK 0x1 ECU_ADDRESS 0xFFF8C542 DISPLAY_IDENTIFIER f_ist_ge_stc.iUewIgetr /end MEASUREMENT
/begin MEASUREMENT iUewIgetr.f_ist_nab_kleiner_schwelle_stc "Flag: nab kleiner als Schwelle NS_ABUWIG" UBYTE Conv.cUewIgetr._.f_ist_nab_kleiner_schwelle_stc_S5_S3 1 100 0 1 BIT_MASK 0x1 ECU_ADDRESS 0xFFF8C541 DISPLAY_IDENTIFIER f_ist_nab_kleiner_schwelle_stc.iUewIgetr /end MEASUREMENT
/begin MEASUREMENT iUewIgetr.f_ist_neue_schaltung_stc "Flag: neue Schaltung begonnen, bevor die alte Schaltung fertig ueberwacht wurde" UBYTE Conv.cUewIgetr._.f_ist_neue_schaltung_stc_S5_S3 1 100 0 1 BIT_MASK 0x1 ECU_ADDRESS 0xFFF8C53C DISPLAY_IDENTIFIER f_ist_neue_schaltung_stc.iUewIgetr /end MEASUREMENT
/begin MEASUREMENT iUewIgetr.f_ist_neues_ge_stc "Flag: neues Gangeinlegen, bevor das alte Gangeinlegen fertig ueberwacht wurde" UBYTE Conv.cUewIgetr._.f_ist_neues_ge_stc_S5_S3 1 100 0 1 BIT_MASK 0x1 ECU_ADDRESS 0xFFF8C53D DISPLAY_IDENTIFIER f_ist_neues_ge_stc.iUewIgetr /end MEASUREMENT
/begin MEASUREMENT iUewIgetr.f_ist_schaltung_stc "Flag: es laeuft eine Schaltung" UBYTE Conv.cUewIgetr._.f_ist_schaltung_stc_S5_S3 1 100 0 1 BIT_MASK 0x1 ECU_ADDRESS 0xFFF8C534 DISPLAY_IDENTIFIER f_ist_schaltung_stc.iUewIgetr /end MEASUREMENT
/begin MEASUREMENT iUewIgetr.f_ist_stoerung_stc "Flag: es ist eine Stoerung erkannt worden" UBYTE Conv.cUewIgetr._.f_ist_stoerung_stc_S5_S3 1 100 0 1 BIT_MASK 0x1 ECU_ADDRESS 0xFFF8C535 DISPLAY_IDENTIFIER f_ist_stoerung_stc.iUewIgetr /end MEASUREMENT
/begin MEASUREMENT iUewIgetr.f_ist_symptom_gang_stc "Flag: es ist ein Symptom waehrend Ganghalten erkannt worden" UBYTE Conv.cUewIgetr._.f_ist_symptom_gang_stc_S5_S3 1 100 0 1 BIT_MASK 0x1 ECU_ADDRESS 0xFFF8C536 DISPLAY_IDENTIFIER f_ist_symptom_gang_stc.iUewIgetr /end MEASUREMENT
/begin MEASUREMENT iUewIgetr.f_ist_symptom_ge_stc "Flag: es ist ein Symptom waehrend Gangeinlegen erkannt worden" UBYTE Conv.cUewIgetr._.f_ist_symptom_ge_stc_S5_S3 1 100 0 1 BIT_MASK 0x1 ECU_ADDRESS 0xFFF8C538 DISPLAY_IDENTIFIER f_ist_symptom_ge_stc.iUewIgetr /end MEASUREMENT
/begin MEASUREMENT iUewIgetr.f_ist_symptom_schalt_stc "Flag: es ist ein Symptom waehrend Schaltung erkannt worden" UBYTE Conv.cUewIgetr._.f_ist_symptom_schalt_stc_S5_S3 1 100 0 1 BIT_MASK 0x1 ECU_ADDRESS 0xFFF8C537 DISPLAY_IDENTIFIER f_ist_symptom_schalt_stc.iUewIgetr /end MEASUREMENT
/begin MEASUREMENT iUewIgetr.f_pruefbed_im_gang_erreicht_stc "Flag: Pruefbedingung fuer RBM war waehrend Ganghalten mindestens einmal erfuellt" UBYTE Conv.cUewIgetr._.f_pruefbed_im_gang_erreicht_stc_S5_S3 1 100 0 1 BIT_MASK 0x1 ECU_ADDRESS 0xFFF8C544 DISPLAY_IDENTIFIER f_pruefbed_im_gang_erreicht_stc.iUewIgetr /end MEASUREMENT
/begin MEASUREMENT iUewIgetr.f_schalt_durch_sym_schalt_stc "Flag: laufende Schaltung ist eine Reaktion auf ein erkanntes Schaltungssymptom" UBYTE Conv.cUewIgetr._.f_schalt_durch_sym_schalt_stc_S5_S3 1 100 0 1 BIT_MASK 0x1 ECU_ADDRESS 0xFFF8C53E DISPLAY_IDENTIFIER f_schalt_durch_sym_schalt_stc.iUewIgetr /end MEASUREMENT
/begin MEASUREMENT iUewIgetr.f_stoer_offset_in_schaltung_stc "Flag: Momentengradient hat die Schwelle MGS_MOTSOLLUWIG waehrend der laufenden Schaltung ueberschritten" UBYTE Conv.cUewIgetr._.f_stoer_offset_in_schaltung_stc_S5_S3 1 100 0 1 BIT_MASK 0x1 ECU_ADDRESS 0xFFF8C545 DISPLAY_IDENTIFIER f_stoer_offset_in_schaltung_stc.iUewIgetr /end MEASUREMENT
/begin MEASUREMENT iUewIgetr.f_timer16_rampe_gestartet_stc "Flag: timer16_rampe wurde gestartet" UBYTE Conv.cUewIgetr._.f_timer16_rampe_gestartet_stc_S5_S3 1 100 0 1 BIT_MASK 0x1 ECU_ADDRESS 0xFFF8C53F DISPLAY_IDENTIFIER f_timer16_rampe_gestartet_stc.iUewIgetr /end MEASUREMENT
/begin MEASUREMENT iUewIgetr.f_ueberwache_ge_stc "Flag: Startwerte fuer Gangeinlegeueberwachung sind gesetzt" UBYTE Conv.cUewIgetr._.f_ueberwache_ge_stc_S5_S3 1 100 0 1 BIT_MASK 0x1 ECU_ADDRESS 0xFFF8C543 DISPLAY_IDENTIFIER f_ueberwache_ge_stc.iUewIgetr /end MEASUREMENT
/begin MEASUREMENT iUewIgetr.fl_erf_iepuwig "Flag: Erfolgspruefung gestartet" UBYTE Conv.cUewIgetr._.fl_erf_iepuwig_S5_S3 1 100 0 1 BIT_MASK 0x1 ECU_ADDRESS 0xFFF8C567 DISPLAY_IDENTIFIER fl_erf_iepuwig.iUewIgetr /end MEASUREMENT
/begin MEASUREMENT iUewIgetr.fl_sym_iepuwig "Flag: Symptom aufgetreten mit IEP-Einstiegsbedingung" UBYTE Conv.cUewIgetr._.fl_sym_iepuwig_S5_S3 1 100 0 1 BIT_MASK 0x1 ECU_ADDRESS 0xFFF8C566 DISPLAY_IDENTIFIER fl_sym_iepuwig.iUewIgetr /end MEASUREMENT
/begin MEASUREMENT iUewIgetr.flg_kfc_ratioglobal "Flag: Gibt an das KFC_RATIOGLOBAL eingetragen wurde." UBYTE Conv.cUewIgetr._.flg_kfc_ratioglobal_S5_S3 1 100 0 1 BIT_MASK 0x1 ECU_ADDRESS 0xFFF8C52A DISPLAY_IDENTIFIER flg_kfc_ratioglobal.iUewIgetr /end MEASUREMENT
/begin MEASUREMENT iUewIgetr.flg_kuppident "Flag: Die fehlerausloesende Kupplung wurde identifiziert" UBYTE Conv.cUewIgetr._.flg_kuppident_S5_S3 1 100 0 1 BIT_MASK 0x1 ECU_ADDRESS 0xFFF8C529 DISPLAY_IDENTIFIER flg_kuppident.iUewIgetr /end MEASUREMENT
/begin MEASUREMENT iUewIgetr.i_gang "Verhaeltniss n_t zu n_ab" SWORD UMR___1_1000_0_S5_S3 1 100 -32.768 32.767 ECU_ADDRESS 0xFFF8C514 DISPLAY_IDENTIFIER i_gang.iUewIgetr /end MEASUREMENT
/begin MEASUREMENT iUewIgetr.i_gang_ge_start "Verhaeltniss n_t zu n_ab bei Start Gangeinlegen" SWORD UMR___1_1000_0_S5_S3 1 100 -32.768 32.767 ECU_ADDRESS 0xFFF8C51A DISPLAY_IDENTIFIER i_gang_ge_start.iUewIgetr /end MEASUREMENT
/begin MEASUREMENT iUewIgetr.i_oben_rampe_start_stc "gemerkte Obergrenzen bei Reglerstart" SWORD UMR___1_1000_0_S5_S3 1 100 -32.768 32.767 ECU_ADDRESS 0xFFF8C550 DISPLAY_IDENTIFIER i_oben_rampe_start_stc.iUewIgetr /end MEASUREMENT
/begin MEASUREMENT iUewIgetr.i_sw_oben "Oberer Schwellwert i_gang" SWORD UMR___1_1000_0_S5_S3 1 100 -32.768 32.767 ECU_ADDRESS 0xFFF8C516 DISPLAY_IDENTIFIER i_sw_oben.iUewIgetr /end MEASUREMENT
/begin MEASUREMENT iUewIgetr.i_sw_unten "Unterer Schwellwert i_gang" SWORD UMR___1_1000_0_S5_S3 1 100 -32.768 32.767 ECU_ADDRESS 0xFFF8C518 DISPLAY_IDENTIFIER i_sw_unten.iUewIgetr /end MEASUREMENT
/begin MEASUREMENT iUewIgetr.i_unten_rampe_start_stc "gemerkte Untergrenzen bei Reglerstart" SWORD UMR___1_1000_0_S5_S3 1 100 -32.768 32.767 ECU_ADDRESS 0xFFF8C552 DISPLAY_IDENTIFIER i_unten_rampe_start_stc.iUewIgetr /end MEASUREMENT
/begin MEASUREMENT iUewIgetr.istgang_akt_uew_stc "istgang zu Beginn der aktuell laufenden ueberwachung" SBYTE Conv.cUewIgetr._.istgang_akt_uew_stc_S5_S3 1 100 -1 8 ECU_ADDRESS 0xFFF8C532 DISPLAY_IDENTIFIER istgang_akt_uew_stc.iUewIgetr /end MEASUREMENT
/begin MEASUREMENT iUewIgetr.istgang_vorherige_schaltung_stc "istgang vor der Schaltung" SBYTE Conv.cUewIgetr._.istgang_vorherige_schaltung_stc_S5_S3 1 100 -1 8 ECU_ADDRESS 0xFFF8C533 DISPLAY_IDENTIFIER istgang_vorherige_schaltung_stc.iUewIgetr /end MEASUREMENT
/begin MEASUREMENT iUewIgetr.kfc_index_set "Kupplungsfehlercode-Index, der beim letzten endgueltigen Fehler gesetzt wurde" UBYTE UMR___1_1_0_S5_S3 1 100 0 255 ECU_ADDRESS 0xFFF8C548 DISPLAY_IDENTIFIER kfc_index_set.iUewIgetr /end MEASUREMENT
/begin MEASUREMENT iUewIgetr.kfl_ziel_bei_symptom_stc "Kraftfluss bei Symptom Gangeinlegen" UBYTE Conv.cUewIgetr._.kfl_ziel_bei_symptom_stc_S5_S3 1 100 0 2 ECU_ADDRESS 0xFFF8C54C DISPLAY_IDENTIFIER kfl_ziel_bei_symptom_stc.iUewIgetr /end MEASUREMENT
/begin MEASUREMENT iUewIgetr.kup_ge1_stc "die am Istgang-Gang beteiligte Kupplung 1" UBYTE Conv.cUewIgetr._.kup_ge1_stc_S5_S3 1 100 0 5 ECU_ADDRESS 0xFFF8C556 DISPLAY_IDENTIFIER kup_ge1_stc.iUewIgetr /end MEASUREMENT
/begin MEASUREMENT iUewIgetr.kup_ge2_stc "die am Istgang-Gang beteiligte Kupplung 2" UBYTE Conv.cUewIgetr._.kup_ge2_stc_S5_S3 1 100 0 5 ECU_ADDRESS 0xFFF8C557 DISPLAY_IDENTIFIER kup_ge2_stc.iUewIgetr /end MEASUREMENT
/begin MEASUREMENT iUewIgetr.kup_ge3_stc "die am Istgang-Gang beteiligte Kupplung 3" UBYTE Conv.cUewIgetr._.kup_ge3_stc_S5_S3 1 100 0 5 ECU_ADDRESS 0xFFF8C558 DISPLAY_IDENTIFIER kup_ge3_stc.iUewIgetr /end MEASUREMENT
/begin MEASUREMENT iUewIgetr.loop_cnt_stc "Schleifenzaehler um moegliche Endlosschleifen abzufangen" UBYTE UMR___1_1_0_S5_S3 1 100 0 255 ECU_ADDRESS 0xFFF8C560 DISPLAY_IDENTIFIER loop_cnt_stc.iUewIgetr /end MEASUREMENT
/begin MEASUREMENT iUewIgetr.m_kup_ge1_stc "Momemt an der Kupplung 1 des Istganges" SWORD UMR_NM__1_1_0_S5_S3 1 100 -32768 32767 ECU_ADDRESS 0xFFF8C55A DISPLAY_IDENTIFIER m_kup_ge1_stc.iUewIgetr /end MEASUREMENT
/begin MEASUREMENT iUewIgetr.m_kup_ge2_stc "Momemt an der Kupplung 2 des Istganges" SWORD UMR_NM__1_1_0_S5_S3 1 100 -32768 32767 ECU_ADDRESS 0xFFF8C55C DISPLAY_IDENTIFIER m_kup_ge2_stc.iUewIgetr /end MEASUREMENT
/begin MEASUREMENT iUewIgetr.m_kup_ge3_stc "Momemt an der Kupplung 3 des Istganges" SWORD UMR_NM__1_1_0_S5_S3 1 100 -32768 32767 ECU_ADDRESS 0xFFF8C55E DISPLAY_IDENTIFIER m_kup_ge3_stc.iUewIgetr /end MEASUREMENT
/begin MEASUREMENT iUewIgetr.m_kupuwigsym_a "minimales Moment bei Symptom an Kupplung A" SWORD UMR_NM__1_1_0_S5_S3 1 100 -32768 32767 ECU_ADDRESS 0xFFF8C50A DISPLAY_IDENTIFIER m_kupuwigsym_a.iUewIgetr /end MEASUREMENT
/begin MEASUREMENT iUewIgetr.m_kupuwigsym_b "minimales Moment bei Symptom an Kupplung B" SWORD UMR_NM__1_1_0_S5_S3 1 100 -32768 32767 ECU_ADDRESS 0xFFF8C50C DISPLAY_IDENTIFIER m_kupuwigsym_b.iUewIgetr /end MEASUREMENT
/begin MEASUREMENT iUewIgetr.m_kupuwigsym_c "minimales Moment bei Symptom an Kupplung C" SWORD UMR_NM__1_1_0_S5_S3 1 100 -32768 32767 ECU_ADDRESS 0xFFF8C50E DISPLAY_IDENTIFIER m_kupuwigsym_c.iUewIgetr /end MEASUREMENT
/begin MEASUREMENT iUewIgetr.m_kupuwigsym_d "minimales Moment bei Symptom an Kupplung D" SWORD UMR_NM__1_1_0_S5_S3 1 100 -32768 32767 ECU_ADDRESS 0xFFF8C510 DISPLAY_IDENTIFIER m_kupuwigsym_d.iUewIgetr /end MEASUREMENT
/begin MEASUREMENT iUewIgetr.m_kupuwigsym_e "minimales Moment bei Symptom an Kupplung E" SWORD UMR_NM__1_1_0_S5_S3 1 100 -32768 32767 ECU_ADDRESS 0xFFF8C512 DISPLAY_IDENTIFIER m_kupuwigsym_e.iUewIgetr /end MEASUREMENT
/begin MEASUREMENT iUewIgetr.n_erfolg_symio_a "Erfolgszaehler zur Symptomheilung bei Kupplung A" UBYTE UMR___1_1_0_S5_S3 1 100 0 255 ECU_ADDRESS 0xFFF8C4FA DISPLAY_IDENTIFIER n_erfolg_symio_a.iUewIgetr /end MEASUREMENT
/begin MEASUREMENT iUewIgetr.n_erfolg_symio_b "Erfolgszaehler zur Symptomheilung bei Kupplung B" UBYTE UMR___1_1_0_S5_S3 1 100 0 255 ECU_ADDRESS 0xFFF8C4FB DISPLAY_IDENTIFIER n_erfolg_symio_b.iUewIgetr /end MEASUREMENT
/begin MEASUREMENT iUewIgetr.n_erfolg_symio_c "Erfolgszaehler zur Symptomheilung bei Kupplung C" UBYTE UMR___1_1_0_S5_S3 1 100 0 255 ECU_ADDRESS 0xFFF8C4FC DISPLAY_IDENTIFIER n_erfolg_symio_c.iUewIgetr /end MEASUREMENT
/begin MEASUREMENT iUewIgetr.n_erfolg_symio_d "Erfolgszaehler zur Symptomheilung bei Kupplung D" UBYTE UMR___1_1_0_S5_S3 1 100 0 255 ECU_ADDRESS 0xFFF8C4FD DISPLAY_IDENTIFIER n_erfolg_symio_d.iUewIgetr /end MEASUREMENT
/begin MEASUREMENT iUewIgetr.n_erfolg_symio_e "Erfolgszaehler zur Symptomheilung bei Kupplung E" UBYTE UMR___1_1_0_S5_S3 1 100 0 255 ECU_ADDRESS 0xFFF8C4FE DISPLAY_IDENTIFIER n_erfolg_symio_e.iUewIgetr /end MEASUREMENT
/begin MEASUREMENT iUewIgetr.n_erfolguwig "Erfolgszaehler waehrend Gangeinlegen bei kleiner n_ab" UBYTE UMR___1_1_0_S5_S3 1 100 0 255 ECU_ADDRESS 0xFFF8C4E0 DISPLAY_IDENTIFIER n_erfolguwig.iUewIgetr /end MEASUREMENT
/begin MEASUREMENT iUewIgetr.n_stoer_gang "Stoerungszaehler im Gang" UBYTE UMR___1_1_0_S5_S3 1 100 0 255 ECU_ADDRESS 0xFFF8C4DD DISPLAY_IDENTIFIER n_stoer_gang.iUewIgetr /end MEASUREMENT
/begin MEASUREMENT iUewIgetr.n_stoer_ge "Stoerungszaehler waehrend Gangeinlegen" UBYTE UMR___1_1_0_S5_S3 1 100 0 255 ECU_ADDRESS 0xFFF8C4DF DISPLAY_IDENTIFIER n_stoer_ge.iUewIgetr /end MEASUREMENT
/begin MEASUREMENT iUewIgetr.n_stoer_schalt "Stoerungszaehler waehrend Schaltung" UBYTE UMR___1_1_0_S5_S3 1 100 0 255 ECU_ADDRESS 0xFFF8C4DE DISPLAY_IDENTIFIER n_stoer_schalt.iUewIgetr /end MEASUREMENT
/begin MEASUREMENT iUewIgetr.n_sym_uwig_cnt_kup_a "Symptomzaehler Kupplung A" UBYTE UMR___1_1_0_S5_S3 1 100 0 255 ECU_ADDRESS 0xFFF8C4FF DISPLAY_IDENTIFIER n_sym_uwig_cnt_kup_a.iUewIgetr /end MEASUREMENT
/begin MEASUREMENT iUewIgetr.n_sym_uwig_cnt_kup_b "Symptomzaehler Kupplung B" UBYTE UMR___1_1_0_S5_S3 1 100 0 255 ECU_ADDRESS 0xFFF8C500 DISPLAY_IDENTIFIER n_sym_uwig_cnt_kup_b.iUewIgetr /end MEASUREMENT
/begin MEASUREMENT iUewIgetr.n_sym_uwig_cnt_kup_c "Symptomzaehler Kupplung C" UBYTE UMR___1_1_0_S5_S3 1 100 0 255 ECU_ADDRESS 0xFFF8C501 DISPLAY_IDENTIFIER n_sym_uwig_cnt_kup_c.iUewIgetr /end MEASUREMENT
/begin MEASUREMENT iUewIgetr.n_sym_uwig_cnt_kup_d "Symptomzaehler Kupplung D" UBYTE UMR___1_1_0_S5_S3 1 100 0 255 ECU_ADDRESS 0xFFF8C502 DISPLAY_IDENTIFIER n_sym_uwig_cnt_kup_d.iUewIgetr /end MEASUREMENT
/begin MEASUREMENT iUewIgetr.n_sym_uwig_cnt_kup_e "Symptomzaehler Kupplung E" UBYTE UMR___1_1_0_S5_S3 1 100 0 255 ECU_ADDRESS 0xFFF8C503 DISPLAY_IDENTIFIER n_sym_uwig_cnt_kup_e.iUewIgetr /end MEASUREMENT
/begin MEASUREMENT iUewIgetr.n_sym_uwig_schalt12 "Symptomzaehler waehrend Schaltung 1 - 2" UBYTE UMR___1_1_0_S5_S3 1 100 0 255 ECU_ADDRESS 0xFFF8C4E1 DISPLAY_IDENTIFIER n_sym_uwig_schalt12.iUewIgetr /end MEASUREMENT
/begin MEASUREMENT iUewIgetr.n_sym_uwig_schalt21 "Symptomzaehler waehrend Schaltung 2 - 1" UBYTE UMR___1_1_0_S5_S3 1 100 0 255 ECU_ADDRESS 0xFFF8C4E2 DISPLAY_IDENTIFIER n_sym_uwig_schalt21.iUewIgetr /end MEASUREMENT
/begin MEASUREMENT iUewIgetr.n_sym_uwig_schalt23 "Symptomzaehler waehrend Schaltung 2 - 3" UBYTE UMR___1_1_0_S5_S3 1 100 0 255 ECU_ADDRESS 0xFFF8C4E3 DISPLAY_IDENTIFIER n_sym_uwig_schalt23.iUewIgetr /end MEASUREMENT
/begin MEASUREMENT iUewIgetr.n_sym_uwig_schalt31 "Symptomzaehler waehrend Schaltung 3 - 1" UBYTE UMR___1_1_0_S5_S3 1 100 0 255 ECU_ADDRESS 0xFFF8C4E4 DISPLAY_IDENTIFIER n_sym_uwig_schalt31.iUewIgetr /end MEASUREMENT
/begin MEASUREMENT iUewIgetr.n_sym_uwig_schalt32 "Symptomzaehler waehrend Schaltung 3 - 2" UBYTE UMR___1_1_0_S5_S3 1 100 0 255 ECU_ADDRESS 0xFFF8C4E5 DISPLAY_IDENTIFIER n_sym_uwig_schalt32.iUewIgetr /end MEASUREMENT
/begin MEASUREMENT iUewIgetr.n_sym_uwig_schalt34 "Symptomzaehler waehrend Schaltung 3 - 4" UBYTE UMR___1_1_0_S5_S3 1 100 0 255 ECU_ADDRESS 0xFFF8C4E6 DISPLAY_IDENTIFIER n_sym_uwig_schalt34.iUewIgetr /end MEASUREMENT
/begin MEASUREMENT iUewIgetr.n_sym_uwig_schalt42 "Symptomzaehler waehrend Schaltung 4 - 2" UBYTE UMR___1_1_0_S5_S3 1 100 0 255 ECU_ADDRESS 0xFFF8C4E7 DISPLAY_IDENTIFIER n_sym_uwig_schalt42.iUewIgetr /end MEASUREMENT
/begin MEASUREMENT iUewIgetr.n_sym_uwig_schalt43 "Symptomzaehler waehrend Schaltung 4 - 3" UBYTE UMR___1_1_0_S5_S3 1 100 0 255 ECU_ADDRESS 0xFFF8C4E8 DISPLAY_IDENTIFIER n_sym_uwig_schalt43.iUewIgetr /end MEASUREMENT
/begin MEASUREMENT iUewIgetr.n_sym_uwig_schalt45 "Symptomzaehler waehrend Schaltung 4 - 5" UBYTE UMR___1_1_0_S5_S3 1 100 0 255 ECU_ADDRESS 0xFFF8C4E9 DISPLAY_IDENTIFIER n_sym_uwig_schalt45.iUewIgetr /end MEASUREMENT
/begin MEASUREMENT iUewIgetr.n_sym_uwig_schalt51 "Symptomzaehler waehrend Schaltung 5 - 1" UBYTE UMR___1_1_0_S5_S3 1 100 0 255 ECU_ADDRESS 0xFFF8C4EA DISPLAY_IDENTIFIER n_sym_uwig_schalt51.iUewIgetr /end MEASUREMENT
/begin MEASUREMENT iUewIgetr.n_sym_uwig_schalt53 "Symptomzaehler waehrend Schaltung 5 - 3" UBYTE UMR___1_1_0_S5_S3 1 100 0 255 ECU_ADDRESS 0xFFF8C4EB DISPLAY_IDENTIFIER n_sym_uwig_schalt53.iUewIgetr /end MEASUREMENT
/begin MEASUREMENT iUewIgetr.n_sym_uwig_schalt54 "Symptomzaehler waehrend Schaltung 5 - 4" UBYTE UMR___1_1_0_S5_S3 1 100 0 255 ECU_ADDRESS 0xFFF8C4EC DISPLAY_IDENTIFIER n_sym_uwig_schalt54.iUewIgetr /end MEASUREMENT
/begin MEASUREMENT iUewIgetr.n_sym_uwig_schalt56 "Symptomzaehler waehrend Schaltung 5 - 6" UBYTE UMR___1_1_0_S5_S3 1 100 0 255 ECU_ADDRESS 0xFFF8C4ED DISPLAY_IDENTIFIER n_sym_uwig_schalt56.iUewIgetr /end MEASUREMENT
/begin MEASUREMENT iUewIgetr.n_sym_uwig_schalt63 "Symptomzaehler waehrend Schaltung 6 - 3" UBYTE UMR___1_1_0_S5_S3 1 100 0 255 ECU_ADDRESS 0xFFF8C4EE DISPLAY_IDENTIFIER n_sym_uwig_schalt63.iUewIgetr /end MEASUREMENT
/begin MEASUREMENT iUewIgetr.n_sym_uwig_schalt64 "Symptomzaehler waehrend Schaltung 6 - 4" UBYTE UMR___1_1_0_S5_S3 1 100 0 255 ECU_ADDRESS 0xFFF8C4EF DISPLAY_IDENTIFIER n_sym_uwig_schalt64.iUewIgetr /end MEASUREMENT
/begin MEASUREMENT iUewIgetr.n_sym_uwig_schalt65 "Symptomzaehler waehrend Schaltung 6 - 5" UBYTE UMR___1_1_0_S5_S3 1 100 0 255 ECU_ADDRESS 0xFFF8C4F0 DISPLAY_IDENTIFIER n_sym_uwig_schalt65.iUewIgetr /end MEASUREMENT
/begin MEASUREMENT iUewIgetr.n_sym_uwig_schalt67 "Symptomzaehler waehrend Schaltung 6 - 7" UBYTE UMR___1_1_0_S5_S3 1 100 0 255 ECU_ADDRESS 0xFFF8C4F1 DISPLAY_IDENTIFIER n_sym_uwig_schalt67.iUewIgetr /end MEASUREMENT
/begin MEASUREMENT iUewIgetr.n_sym_uwig_schalt71 "Symptomzaehler waehrend Schaltung 7 - 1" UBYTE UMR___1_1_0_S5_S3 1 100 0 255 ECU_ADDRESS 0xFFF8C4F2 DISPLAY_IDENTIFIER n_sym_uwig_schalt71.iUewIgetr /end MEASUREMENT
/begin MEASUREMENT iUewIgetr.n_sym_uwig_schalt75 "Symptomzaehler waehrend Schaltung 7 - 5" UBYTE UMR___1_1_0_S5_S3 1 100 0 255 ECU_ADDRESS 0xFFF8C4F3 DISPLAY_IDENTIFIER n_sym_uwig_schalt75.iUewIgetr /end MEASUREMENT
/begin MEASUREMENT iUewIgetr.n_sym_uwig_schalt76 "Symptomzaehler waehrend Schaltung 7 - 6" UBYTE UMR___1_1_0_S5_S3 1 100 0 255 ECU_ADDRESS 0xFFF8C4F4 DISPLAY_IDENTIFIER n_sym_uwig_schalt76.iUewIgetr /end MEASUREMENT
/begin MEASUREMENT iUewIgetr.n_sym_uwig_schalt78 "Symptomzaehler waehrend Schaltung 7 - 8" UBYTE UMR___1_1_0_S5_S3 1 100 0 255 ECU_ADDRESS 0xFFF8C4F5 DISPLAY_IDENTIFIER n_sym_uwig_schalt78.iUewIgetr /end MEASUREMENT
/begin MEASUREMENT iUewIgetr.n_sym_uwig_schalt82 "Symptomzaehler waehrend Schaltung 8 - 2" UBYTE UMR___1_1_0_S5_S3 1 100 0 255 ECU_ADDRESS 0xFFF8C4F6 DISPLAY_IDENTIFIER n_sym_uwig_schalt82.iUewIgetr /end MEASUREMENT
/begin MEASUREMENT iUewIgetr.n_sym_uwig_schalt84 "Symptomzaehler waehrend Schaltung 8 - 4" UBYTE UMR___1_1_0_S5_S3 1 100 0 255 ECU_ADDRESS 0xFFF8C4F7 DISPLAY_IDENTIFIER n_sym_uwig_schalt84.iUewIgetr /end MEASUREMENT
/begin MEASUREMENT iUewIgetr.n_sym_uwig_schalt86 "Symptomzaehler waehrend Schaltung 8 - 6" UBYTE UMR___1_1_0_S5_S3 1 100 0 255 ECU_ADDRESS 0xFFF8C4F8 DISPLAY_IDENTIFIER n_sym_uwig_schalt86.iUewIgetr /end MEASUREMENT
/begin MEASUREMENT iUewIgetr.n_sym_uwig_schalt87 "Symptomzaehler waehrend Schaltung 8 - 7" UBYTE UMR___1_1_0_S5_S3 1 100 0 255 ECU_ADDRESS 0xFFF8C4F9 DISPLAY_IDENTIFIER n_sym_uwig_schalt87.iUewIgetr /end MEASUREMENT
/begin MEASUREMENT iUewIgetr.n_t_0_stc "Turbinendrehzahl zum Startzeitpunkt der Ueberwachungszeit" UWORD UMR_U_MIN_1_1_0_S5_S3 1 100 0 65535 ECU_ADDRESS 0xFFF8C54A DISPLAY_IDENTIFIER n_t_0_stc.iUewIgetr /end MEASUREMENT
/begin MEASUREMENT iUewIgetr.n_t_ge_start_stc "Turbinendrehzahl zu Beginn Gangeinlegen" SWORD UMR_U_MIN_1_1_0_S5_S3 1 100 -32768 32767 ECU_ADDRESS 0xFFF8C54E DISPLAY_IDENTIFIER n_t_ge_start_stc.iUewIgetr /end MEASUREMENT
/begin MEASUREMENT iUewIgetr.nd_synzielgang "Differenzdrehzahl zu Synchron bei UWIG-Ueberwachung" SWORD UMR_U_MIN_1_1_0_S5_S3 1 100 -8000 8000 ECU_ADDRESS 0xFFF8C51E DISPLAY_IDENTIFIER nd_synzielgang.iUewIgetr /end MEASUREMENT
/begin MEASUREMENT iUewIgetr.nd_tuwig_ge "Differenzdrehzahl n_t - n_t0 waehrend GE bei UWIG-Ueberwachung" SWORD UMR_U_MIN_1_1_0_S5_S3 1 100 -8000 8000 ECU_ADDRESS 0xFFF8C522 DISPLAY_IDENTIFIER nd_tuwig_ge.iUewIgetr /end MEASUREMENT
/begin MEASUREMENT iUewIgetr.ng_t_ge_start "Turbinendrehzahlgradient zu Beginn Gangeinlegenueberwachung" SWORD UMR_U_MINSEC_1_1_0_S5_S3 1 100 -10000 10000 ECU_ADDRESS 0xFFF8C520 DISPLAY_IDENTIFIER ng_t_ge_start.iUewIgetr /end MEASUREMENT
/begin MEASUREMENT iUewIgetr.schaltart_akt_uew_stc "lokale Kopie der Schaltart (HS, RS) fuer die Ueberwachung" UBYTE Conv.cUewIgetr._.schaltart_akt_uew_stc_S5_S3 1 100 0 2 ECU_ADDRESS 0xFFF8C530 DISPLAY_IDENTIFIER schaltart_akt_uew_stc.iUewIgetr /end MEASUREMENT
/begin MEASUREMENT iUewIgetr.symptom_reaktion "Symptomreaktion ohne endgültige Fehlerbehandlung" UBYTE Conv.cUewIgetr._.symptom_reaktion_S5_S3 1 100 0 3 ECU_ADDRESS 0xFFF8C568 DISPLAY_IDENTIFIER symptom_reaktion.iUewIgetr /end MEASUREMENT
/begin MEASUREMENT iUewIgetr.symptom_uwig_r_gang_aktiv "FLAG: Symptom R-Gang mit Zwangsneutral aktiv" UBYTE Conv.cUewIgetr._.symptom_uwig_r_gang_aktiv_S5_S3 1 100 0 1 BIT_MASK 0x1 ECU_ADDRESS 0xFFF8C527 DISPLAY_IDENTIFIER symptom_uwig_r_gang_aktiv.iUewIgetr /end MEASUREMENT
/begin MEASUREMENT iUewIgetr.t_maxsas_stc "maximale Schaltzeit ab Zeitpunkt Reglerstart" UWORD UMR_MSEC__10_1_0_S5_S3 1 100 0 655350 ECU_ADDRESS 0xFFF8C554 DISPLAY_IDENTIFIER t_maxsas_stc.iUewIgetr /end MEASUREMENT
/begin MEASUREMENT iUewIgetr.timer16_rampe "Timer Rampenzeit UIG-Ueberwachung" UWORD UMR_MSEC__10_1_0_S5_S3 1 100 0 655350 ECU_ADDRESS 0xFFF8C4D8 DISPLAY_IDENTIFIER timer16_rampe.iUewIgetr /end MEASUREMENT
/begin MEASUREMENT iUewIgetr.timer16_rznuwig "Timer Rueckkehr zur Normalfunktion UIG-Ueberwachung" UWORD UMR_MSEC__10_1_0_S5_S3 1 100 0 655350 ECU_ADDRESS 0xFFF8C4D6 DISPLAY_IDENTIFIER timer16_rznuwig.iUewIgetr /end MEASUREMENT
/begin MEASUREMENT iUewIgetr.timer16_uwig_sas "Zeit seit Start Schaltung" UWORD UMR_MSEC__10_1_0_S5_S3 1 100 0 655350 ECU_ADDRESS 0xFFF8C4D4 DISPLAY_IDENTIFIER timer16_uwig_sas.iUewIgetr /end MEASUREMENT
/begin MEASUREMENT iUewIgetr.timer16_uwigrnf "Timer Verzoegerungszeit Rueckkehr zur Normalfunktion UIG-Ueberwachung" UWORD UMR_MSEC__10_1_0_S5_S3 1 100 0 655350 ECU_ADDRESS 0xFFF8C4DA DISPLAY_IDENTIFIER timer16_uwigrnf.iUewIgetr /end MEASUREMENT
/begin MEASUREMENT iUewIgetr.timer_iepuwig "Timer zum starten des Überwachungszeitraums für einen mgl. IEP-Fehler" UWORD UMR_MSEC__10_1_0_S5_S3 1 100 0 655350 ECU_ADDRESS 0xFFF8C562 DISPLAY_IDENTIFIER timer_iepuwig.iUewIgetr /end MEASUREMENT
/begin MEASUREMENT iUewIgetr.timer_iepuwig_erfolg "Timer zum Starten der Gutprüfung der IEP-Funktionalität" UWORD UMR_MSEC__10_1_0_S5_S3 1 100 0 655350 ECU_ADDRESS 0xFFF8C564 DISPLAY_IDENTIFIER timer_iepuwig_erfolg.iUewIgetr /end MEASUREMENT
/begin MEASUREMENT iUewIgetr.timer_reg_start "Zeit seid Reglerstart" UBYTE UMR_MSEC__10_1_0_S5_S3 1 100 0 2550 ECU_ADDRESS 0xFFF8C4D1 DISPLAY_IDENTIFIER timer_reg_start.iUewIgetr /end MEASUREMENT
/begin MEASUREMENT iUewIgetr.timer_uwig_ge "maximale Ueberwachungzeit GE bei kleinen n_ab" UBYTE UMR_MSEC__10_1_0_S5_S3 1 100 0 2550 ECU_ADDRESS 0xFFF8C4D2 DISPLAY_IDENTIFIER timer_uwig_ge.iUewIgetr /end MEASUREMENT
/begin MEASUREMENT iUewIgetr.timer_uwig_schalt_abbruch "Zeit nach Schaltungsabbruch durch Symptom UWIG" UBYTE UMR_MSEC__10_1_0_S5_S3 1 100 0 2550 ECU_ADDRESS 0xFFF8C4D0 DISPLAY_IDENTIFIER timer_uwig_schalt_abbruch.iUewIgetr /end MEASUREMENT
/begin MEASUREMENT iUewIgetr.timer_vngabuwig "Timer Verzoegerungszeit nach erneutem ueberschreiten der NGS_ABUWIGxy Schwelle" UBYTE UMR_MSEC__10_1_0_S5_S3 1 100 0 2550 ECU_ADDRESS 0xFFF8C4DC DISPLAY_IDENTIFIER timer_vngabuwig.iUewIgetr /end MEASUREMENT
/begin MEASUREMENT iUewIgetr.uwig_abbruchgang "Istgang des Schaltungsabbruch durch UWIG-Ueberwachung!" SBYTE Conv.cUewIgetr._.uwig_abbruchgang_S5_S3 1 100 -1 8 ECU_ADDRESS 0xFFF8C528 DISPLAY_IDENTIFIER uwig_abbruchgang.iUewIgetr /end MEASUREMENT
/begin MEASUREMENT iUewIgetr.uwig_pruefstatus_kup_a "Flag Pruefstatus Kuplung A" UBYTE Conv.cUewIgetr._.uwig_pruefstatus_kup_a_S5_S3 1 100 0 1 BIT_MASK 0x1 ECU_ADDRESS 0xFFF8C504 DISPLAY_IDENTIFIER uwig_pruefstatus_kup_a.iUewIgetr /end MEASUREMENT
/begin MEASUREMENT iUewIgetr.uwig_pruefstatus_kup_b "Flag Pruefstatus Kuplung B" UBYTE Conv.cUewIgetr._.uwig_pruefstatus_kup_b_S5_S3 1 100 0 1 BIT_MASK 0x1 ECU_ADDRESS 0xFFF8C505 DISPLAY_IDENTIFIER uwig_pruefstatus_kup_b.iUewIgetr /end MEASUREMENT
/begin MEASUREMENT iUewIgetr.uwig_pruefstatus_kup_c "Flag Pruefstatus Kuplung C" UBYTE Conv.cUewIgetr._.uwig_pruefstatus_kup_c_S5_S3 1 100 0 1 BIT_MASK 0x1 ECU_ADDRESS 0xFFF8C506 DISPLAY_IDENTIFIER uwig_pruefstatus_kup_c.iUewIgetr /end MEASUREMENT
/begin MEASUREMENT iUewIgetr.uwig_pruefstatus_kup_d "Flag Pruefstatus Kuplung D" UBYTE Conv.cUewIgetr._.uwig_pruefstatus_kup_d_S5_S3 1 100 0 1 BIT_MASK 0x1 ECU_ADDRESS 0xFFF8C507 DISPLAY_IDENTIFIER uwig_pruefstatus_kup_d.iUewIgetr /end MEASUREMENT
/begin MEASUREMENT iUewIgetr.uwig_pruefstatus_kup_e "Flag Pruefstatus Kuplung E" UBYTE Conv.cUewIgetr._.uwig_pruefstatus_kup_e_S5_S3 1 100 0 1 BIT_MASK 0x1 ECU_ADDRESS 0xFFF8C508 DISPLAY_IDENTIFIER uwig_pruefstatus_kup_e.iUewIgetr /end MEASUREMENT
/begin MEASUREMENT iUewIgetr.zielgang_sas_akt_uew_stc "Zielgang zu Beginn der aktuell laufenden ueberwachung" SBYTE Conv.cUewIgetr._.zielgang_sas_akt_uew_stc_S5_S3 1 100 -1 8 ECU_ADDRESS 0xFFF8C531 DISPLAY_IDENTIFIER zielgang_sas_akt_uew_stc.iUewIgetr /end MEASUREMENT
/begin MEASUREMENT iUewIgetr.zustand_uwig "Zustand Zustandsgraph UWIG" UBYTE Conv.cUewIgetr._.zustand_uwig_S5_S3 1 100 0 8 ECU_ADDRESS 0xFFF8C51C DISPLAY_IDENTIFIER zustand_uwig.iUewIgetr /end MEASUREMENT
/begin MEASUREMENT iUewParksperrenmagnet.flag_einstiegsbed "gibt an ob die Einstiegsbedingungen erfuellt sind" UBYTE Conv.cUewParksperrenmagnet._.flag_einstiegsbed_S5_S3 1 100 0 1 BIT_MASK 0x1 ECU_ADDRESS 0xFFF8C578 DISPLAY_IDENTIFIER flag_einstiegsbed.iUewParksperrenmagnet /end MEASUREMENT
/begin MEASUREMENT iUewParksperrenmagnet.flag_pmueb "Gibt an ob in dem aktuellen Fahrzyklus eine Prüfung durchgeführt wurde." UBYTE Conv.cUewParksperrenmagnet._.flag_pmueb_S5_S3 1 100 0 1 BIT_MASK 0x1 ECU_ADDRESS 0xFFF8C579 DISPLAY_IDENTIFIER flag_pmueb.iUewParksperrenmagnet /end MEASUREMENT
/begin MEASUREMENT iUewParksperrenmagnet.iTimerPmdef.timer "Der aktuelle Timerwert" UBYTE UMR_MSEC__10_1_0_S5_S3 1 100 0 2550 ECU_ADDRESS 0xFFF8C57E DISPLAY_IDENTIFIER iTimerPmdef.iUewParksperrenmagnet /end MEASUREMENT
/begin MEASUREMENT iUewParksperrenmagnet.iTimerPmueb.timer "Der aktuelle Timerwert" ULONG UMR_MSEC__10_1_0_S5_S3 1 100 0 42949672950 ECU_ADDRESS 0xFFF8C580 DISPLAY_IDENTIFIER iTimerPmueb.iUewParksperrenmagnet /end MEASUREMENT
/begin MEASUREMENT iUewParksperrenmagnet.iTimerVerzpmueb.timer "Der aktuelle Timerwert" UWORD UMR_MSEC__10_1_0_S5_S3 1 100 0 655350 ECU_ADDRESS 0xFFF8C57C DISPLAY_IDENTIFIER iTimerVerzpmueb.iUewParksperrenmagnet /end MEASUREMENT
/begin MEASUREMENT iUewParksperrenmagnet.n_stoer_pmueb "Störzähler für die Fehlererkennung" UBYTE UMR___1_1_0_S5_S3 1 100 0 255 ECU_ADDRESS 0xFFF8C57B DISPLAY_IDENTIFIER n_stoer_pmueb.iUewParksperrenmagnet /end MEASUREMENT
/begin MEASUREMENT iUewParksperrenmagnet.zustand "Zustand der Ueberwachung" UBYTE Conv.cUewParksperrenmagnet._.zustand_S5_S3 1 100 0 4 ECU_ADDRESS 0xFFF8C57A DISPLAY_IDENTIFIER zustand.iUewParksperrenmagnet /end MEASUREMENT
/begin MEASUREMENT iUewSgetf.f_keine_egs_offtime "Die EGS-OFFTIME soll nicht mehr zu dem Zündungstimer addiert werden. Wird erst mit dem Einschlafen der EGS wieder auf FALSE gesetzt" UBYTE Conv.cUewSgetf._.f_keine_egs_offtime_S5_S3 1 100 0 1 BIT_MASK 0x1 ECU_ADDRESS 0xFFF8C591 DISPLAY_IDENTIFIER f_keine_egs_offtime.iUewSgetf /end MEASUREMENT
/begin MEASUREMENT iUewSgetf.f_timer_zuendung_reset "Aufgrund einer gestarteten PosV muss der Timer wieder zurück gesetz werden. Falls das EEPROM gesperrt ist bleibt das Flag so lange auf TRUE bis es wieder frei gegeben wurde und der timer auf 0 gesetzt ist." UBYTE Conv.cUewSgetf._.f_timer_zuendung_reset_S5_S3 1 100 0 1 BIT_MASK 0x1 ECU_ADDRESS 0xFFF8C592 DISPLAY_IDENTIFIER f_timer_zuendung_reset.iUewSgetf /end MEASUREMENT
/begin MEASUREMENT iUewSgetf.i_edsc_min "FLAG: I_EDS Kupplung C wegen POSV Ueberwachung min bestromen" UBYTE Conv.cUewSgetf._.i_edsc_min_S5_S3 1 100 0 1 BIT_MASK 0x1 ECU_ADDRESS 0xFFF8C584 DISPLAY_IDENTIFIER i_edsc_min.iUewSgetf /end MEASUREMENT
/begin MEASUREMENT iUewSgetf.n_stoer_posv "Stoerungszaehler POSV-Ueberwachung" UBYTE UMR___1_1_0_S5_S3 1 100 0 255 ECU_ADDRESS 0xFFF8C58E DISPLAY_IDENTIFIER n_stoer_posv.iUewSgetf /end MEASUREMENT
/begin MEASUREMENT iUewSgetf.posv_diagnose_aktiv "Indikator POSV-Ueberwachung ist im Moment aktiv" UBYTE Conv.cUewSgetf._.posv_diagnose_aktiv_S5_S3 1 100 0 1 BIT_MASK 0x1 ECU_ADDRESS 0xFFF8C588 DISPLAY_IDENTIFIER posv_diagnose_aktiv.iUewSgetf /end MEASUREMENT
/begin MEASUREMENT iUewSgetf.pruefung_posvmechdef_aktiv "Indikator POSV-Ueberwachung laeuft" UBYTE Conv.cUewSgetf._.pruefung_posvmechdef_aktiv_S5_S3 1 100 0 1 BIT_MASK 0x1 ECU_ADDRESS 0xFFF8C58F DISPLAY_IDENTIFIER pruefung_posvmechdef_aktiv.iUewSgetf /end MEASUREMENT
/begin MEASUREMENT iUewSgetf.ps_sensor_err "FLAG: Fehler durch Wechsel von PS_SENSOR_Z auf PS_SENSOR_ERR" UBYTE Conv.cUewSgetf._.ps_sensor_err_S5_S3 1 100 0 1 BIT_MASK 0x1 ECU_ADDRESS 0xFFF8C586 DISPLAY_IDENTIFIER ps_sensor_err.iUewSgetf /end MEASUREMENT
/begin MEASUREMENT iUewSgetf.ps_sensor_signal_alt "ps_sensor_signal des letzen Zustand" UBYTE Conv.cUewSgetf._.ps_sensor_signal_alt_S5_S3 1 100 0 3 ECU_ADDRESS 0xFFF8C585 DISPLAY_IDENTIFIER ps_sensor_signal_alt.iUewSgetf /end MEASUREMENT
/begin MEASUREMENT iUewSgetf.pumpendruck_vorh_posv_uew_alt "pumpendruck_vorh_posv_uew_alt" UBYTE Conv.cUewSgetf._.pumpendruck_vorh_posv_uew_alt_S5_S3 1 100 0 1 BIT_MASK 0x1 ECU_ADDRESS 0xFFF8C590 DISPLAY_IDENTIFIER pumpendruck_vorh_posv_uew_alt.iUewSgetf /end MEASUREMENT
/begin MEASUREMENT iUewSgetf.timer_posvmechdef "Timer POSV Ueberwachung" UWORD UMR_MSEC__10_1_0_S5_S3 1 100 0 655350 ECU_ADDRESS 0xFFF8C58C DISPLAY_IDENTIFIER timer_posvmechdef.iUewSgetf /end MEASUREMENT
/begin MEASUREMENT iUewSgetf.timer_verzposvueb "Timer Verzoegerungszeit POSV Ueberwachung nach Neustart" UWORD UMR_MSEC__10_1_0_S5_S3 1 100 0 655350 ECU_ADDRESS 0xFFF8C58A DISPLAY_IDENTIFIER timer_verzposvueb.iUewSgetf /end MEASUREMENT
/begin MEASUREMENT iUewSgetf.timer_zuendung "Zeit die seid dem letzten Zuendungaus verstrichen ist" ULONG UMR_MSEC__10_1_0_S5_S3 1 100 0 42949672950 ECU_ADDRESS 0xFFF8C594 DISPLAY_IDENTIFIER timer_zuendung.iUewSgetf /end MEASUREMENT
/begin MEASUREMENT iUewSgetf.zwangsposition_p "FLAG: Zwangsvorgabe Position P wegen MV12 Uew." UBYTE Conv.cUewSgetf._.zwangsposition_p_S5_S3 1 100 0 1 BIT_MASK 0x1 ECU_ADDRESS 0xFFF8C587 DISPLAY_IDENTIFIER zwangsposition_p.iUewSgetf /end MEASUREMENT
/begin MEASUREMENT iUewSgetf.zz_zustand "Zustand der timer_zuendung Initialisierung" UBYTE Conv.cUewSgetf._.zz_zustand_S5_S3 1 100 0 6 ECU_ADDRESS 0xFFF8C593 DISPLAY_IDENTIFIER zz_zustand.iUewSgetf /end MEASUREMENT
/begin MEASUREMENT iUl2AktuatorAnstDRFl.n_erfolg_fahrtr_edslogik "Erfolgszaehler der Überwachungsfunktion" FLOAT32_IEEE UMR___1_1_0_S5_S3 1 100 0 65535 ECU_ADDRESS 0xFFF8D59C FORMAT "%3.2" DISPLAY_IDENTIFIER n_erfolg_fahrtr_edslogik.iUl2AktuatorAnstDRFl /end MEASUREMENT
/begin MEASUREMENT iUl2AktuatorAnstDRFl.n_stoer_fahrtr_edslogik "Fehlerzaehler der Überwachungsfunktion" FLOAT32_IEEE UMR___1_1_0_S5_S3 1 100 0 65535 ECU_ADDRESS 0xFFF8D598 FORMAT "%3.2" DISPLAY_IDENTIFIER n_stoer_fahrtr_edslogik.iUl2AktuatorAnstDRFl /end MEASUREMENT
/begin MEASUREMENT iUl2AktuatorAnstDRInt.n_erfolg_fahrtr_edslogik "Erfolgszaehler der Überwachungsfunktion" UWORD UMR___1_1_0_S5_S3 1 100 0 65535 ECU_ADDRESS 0xFFF8D596 DISPLAY_IDENTIFIER n_erfolg_fahrtr_edslogik.iUl2AktuatorAnstDRInt /end MEASUREMENT
/begin MEASUREMENT iUl2AktuatorAnstDRInt.n_stoer_fahrtr_edslogik "Fehlerzaehler der Überwachungsfunktion" UWORD UMR___1_1_0_S5_S3 1 100 0 65535 ECU_ADDRESS 0xFFF8D594 DISPLAY_IDENTIFIER n_stoer_fahrtr_edslogik.iUl2AktuatorAnstDRInt /end MEASUREMENT
/begin MEASUREMENT iUl2DrehzahlBeobFl.fl_drehzbeob_schaltung "Flag das anzeigt, ob laut Drehzahlbeobachter eine Schaltung aktiv ist oder nicht" FLOAT32_IEEE Conv.cUl2DrehzahlBeobFl._.fl_drehzbeob_schaltung_S5_S3 1 100 0 1 ECU_ADDRESS 0xFFF8D514 FORMAT "%3.2" DISPLAY_IDENTIFIER fl_drehzbeob_schaltung.iUl2DrehzahlBeobFl /end MEASUREMENT
/begin MEASUREMENT iUl2DrehzahlBeobFl.i_drehzahl_beobachter "Aktuelle Übersetzung Floatberechnung" FLOAT32_IEEE UMR___1_1000_0_S5_S3 1 100 0 65.535 ECU_ADDRESS 0xFFF8D518 DISPLAY_IDENTIFIER i_drehzahl_beobachter.iUl2DrehzahlBeobFl /end MEASUREMENT
/begin MEASUREMENT iUl2DrehzahlBeobInt.fl_drehzbeob_schaltung "Flag das anzeigt, ob laut Drehzahlbeobachter eine Schaltung aktiv ist oder nicht" UBYTE Conv.cUl2DrehzahlBeobInt._.fl_drehzbeob_schaltung_S5_S3 1 100 0 1 BIT_MASK 0x1 ECU_ADDRESS 0xFFF8D510 DISPLAY_IDENTIFIER fl_drehzbeob_schaltung.iUl2DrehzahlBeobInt /end MEASUREMENT
/begin MEASUREMENT iUl2DrehzahlBeobInt.i_drehzahl_beobachter "Aktuelle Übersetzung" UWORD UMR___1_1000_0_S5_S3 1 100 0 65.535 ECU_ADDRESS 0xFFF8D512 DISPLAY_IDENTIFIER i_drehzahl_beobachter.iUl2DrehzahlBeobInt /end MEASUREMENT
/begin MEASUREMENT iUl2EdsKupAFl.cUl2EdsBasisFl._.nr "Nummer der EDS" FLOAT32_IEEE UMR___1_1_0_S5_S3 1 100 0 11 ECU_ADDRESS 0xFFF8D3A8 FORMAT "%3.2" DISPLAY_IDENTIFIER nr._.cUl2EdsBasisFl.iUl2EdsKupAFl /end MEASUREMENT
/begin MEASUREMENT iUl2EdsKupAFl.cUl2EdsBasisFl._.type "Nummer der EDS" FLOAT32_IEEE UMR___1_1_0_S5_S3 1 100 0 3 ECU_ADDRESS 0xFFF8D3AC FORMAT "%3.2" DISPLAY_IDENTIFIER type._.cUl2EdsBasisFl.iUl2EdsKupAFl /end MEASUREMENT
/begin MEASUREMENT iUl2EdsKupAInt.cUl2EdsBasisInt._.nr "Nummer der EDS" UBYTE UMR___1_1_0_S5_S3 1 100 0 11 ECU_ADDRESS 0xFFF8D3A0 DISPLAY_IDENTIFIER nr._.cUl2EdsBasisInt.iUl2EdsKupAInt /end MEASUREMENT
/begin MEASUREMENT iUl2EdsKupAInt.cUl2EdsBasisInt._.type "Nummer der EDS" UBYTE Conv.cUl2EdsBasisInt._.type_S5_S3 1 100 0 3 ECU_ADDRESS 0xFFF8D3A1 DISPLAY_IDENTIFIER type._.cUl2EdsBasisInt.iUl2EdsKupAInt /end MEASUREMENT
/begin MEASUREMENT iUl2EdsKupBFl.cUl2EdsBasisFl._.nr "Nummer der EDS" FLOAT32_IEEE UMR___1_1_0_S5_S3 1 100 0 11 ECU_ADDRESS 0xFFF8D3BC FORMAT "%3.2" DISPLAY_IDENTIFIER nr._.cUl2EdsBasisFl.iUl2EdsKupBFl /end MEASUREMENT
/begin MEASUREMENT iUl2EdsKupBFl.cUl2EdsBasisFl._.type "Nummer der EDS" FLOAT32_IEEE UMR___1_1_0_S5_S3 1 100 0 3 ECU_ADDRESS 0xFFF8D3C0 FORMAT "%3.2" DISPLAY_IDENTIFIER type._.cUl2EdsBasisFl.iUl2EdsKupBFl /end MEASUREMENT
/begin MEASUREMENT iUl2EdsKupBInt.cUl2EdsBasisInt._.nr "Nummer der EDS" UBYTE UMR___1_1_0_S5_S3 1 100 0 11 ECU_ADDRESS 0xFFF8D3B4 DISPLAY_IDENTIFIER nr._.cUl2EdsBasisInt.iUl2EdsKupBInt /end MEASUREMENT
/begin MEASUREMENT iUl2EdsKupBInt.cUl2EdsBasisInt._.type "Nummer der EDS" UBYTE Conv.cUl2EdsBasisInt._.type_S5_S3 1 100 0 3 ECU_ADDRESS 0xFFF8D3B5 DISPLAY_IDENTIFIER type._.cUl2EdsBasisInt.iUl2EdsKupBInt /end MEASUREMENT
/begin MEASUREMENT iUl2EdsKupCFl.cUl2EdsBasisFl._.nr "Nummer der EDS" FLOAT32_IEEE UMR___1_1_0_S5_S3 1 100 0 11 ECU_ADDRESS 0xFFF8D3D0 FORMAT "%3.2" DISPLAY_IDENTIFIER nr._.cUl2EdsBasisFl.iUl2EdsKupCFl /end MEASUREMENT
/begin MEASUREMENT iUl2EdsKupCFl.cUl2EdsBasisFl._.type "Nummer der EDS" FLOAT32_IEEE UMR___1_1_0_S5_S3 1 100 0 3 ECU_ADDRESS 0xFFF8D3D4 FORMAT "%3.2" DISPLAY_IDENTIFIER type._.cUl2EdsBasisFl.iUl2EdsKupCFl /end MEASUREMENT
/begin MEASUREMENT iUl2EdsKupCInt.cUl2EdsBasisInt._.nr "Nummer der EDS" UBYTE UMR___1_1_0_S5_S3 1 100 0 11 ECU_ADDRESS 0xFFF8D3C8 DISPLAY_IDENTIFIER nr._.cUl2EdsBasisInt.iUl2EdsKupCInt /end MEASUREMENT
/begin MEASUREMENT iUl2EdsKupCInt.cUl2EdsBasisInt._.type "Nummer der EDS" UBYTE Conv.cUl2EdsBasisInt._.type_S5_S3 1 100 0 3 ECU_ADDRESS 0xFFF8D3C9 DISPLAY_IDENTIFIER type._.cUl2EdsBasisInt.iUl2EdsKupCInt /end MEASUREMENT
/begin MEASUREMENT iUl2EdsKupDFl.cUl2EdsBasisFl._.nr "Nummer der EDS" FLOAT32_IEEE UMR___1_1_0_S5_S3 1 100 0 11 ECU_ADDRESS 0xFFF8D3E4 FORMAT "%3.2" DISPLAY_IDENTIFIER nr._.cUl2EdsBasisFl.iUl2EdsKupDFl /end MEASUREMENT
/begin MEASUREMENT iUl2EdsKupDFl.cUl2EdsBasisFl._.type "Nummer der EDS" FLOAT32_IEEE UMR___1_1_0_S5_S3 1 100 0 3 ECU_ADDRESS 0xFFF8D3E8 FORMAT "%3.2" DISPLAY_IDENTIFIER type._.cUl2EdsBasisFl.iUl2EdsKupDFl /end MEASUREMENT
/begin MEASUREMENT iUl2EdsKupDInt.cUl2EdsBasisInt._.nr "Nummer der EDS" UBYTE UMR___1_1_0_S5_S3 1 100 0 11 ECU_ADDRESS 0xFFF8D3DC DISPLAY_IDENTIFIER nr._.cUl2EdsBasisInt.iUl2EdsKupDInt /end MEASUREMENT
/begin MEASUREMENT iUl2EdsKupDInt.cUl2EdsBasisInt._.type "Nummer der EDS" UBYTE Conv.cUl2EdsBasisInt._.type_S5_S3 1 100 0 3 ECU_ADDRESS 0xFFF8D3DD DISPLAY_IDENTIFIER type._.cUl2EdsBasisInt.iUl2EdsKupDInt /end MEASUREMENT
/begin MEASUREMENT iUl2EdsKupEFl.cUl2EdsBasisFl._.nr "Nummer der EDS" FLOAT32_IEEE UMR___1_1_0_S5_S3 1 100 0 11 ECU_ADDRESS 0xFFF8D3F8 FORMAT "%3.2" DISPLAY_IDENTIFIER nr._.cUl2EdsBasisFl.iUl2EdsKupEFl /end MEASUREMENT
/begin MEASUREMENT iUl2EdsKupEFl.cUl2EdsBasisFl._.type "Nummer der EDS" FLOAT32_IEEE UMR___1_1_0_S5_S3 1 100 0 3 ECU_ADDRESS 0xFFF8D3FC FORMAT "%3.2" DISPLAY_IDENTIFIER type._.cUl2EdsBasisFl.iUl2EdsKupEFl /end MEASUREMENT
/begin MEASUREMENT iUl2EdsKupEInt.cUl2EdsBasisInt._.nr "Nummer der EDS" UBYTE UMR___1_1_0_S5_S3 1 100 0 11 ECU_ADDRESS 0xFFF8D3F0 DISPLAY_IDENTIFIER nr._.cUl2EdsBasisInt.iUl2EdsKupEInt /end MEASUREMENT
/begin MEASUREMENT iUl2EdsKupEInt.cUl2EdsBasisInt._.type "Nummer der EDS" UBYTE Conv.cUl2EdsBasisInt._.type_S5_S3 1 100 0 3 ECU_ADDRESS 0xFFF8D3F1 DISPLAY_IDENTIFIER type._.cUl2EdsBasisInt.iUl2EdsKupEInt /end MEASUREMENT
/begin MEASUREMENT iUl2EdsLogikFl.f_call_ext "Signalisiert ob die Fehlerfunktion aufgerufen wurde" FLOAT32_IEEE UMR___1_1_0_S5_S3 1 100 0 1 ECU_ADDRESS 0xFFF8D5A4 FORMAT "%3.2" DISPLAY_IDENTIFIER f_call_ext.iUl2EdsLogikFl /end MEASUREMENT
/begin MEASUREMENT iUl2EdsLogikFl.n_zaehler_rueck "Zaehler zum Rückfiltern eines Fehlereintrags" FLOAT32_IEEE UMR___1_1_0_S5_S3 1 100 0 32767 ECU_ADDRESS 0xFFF8D5A8 FORMAT "%3.2" DISPLAY_IDENTIFIER n_zaehler_rueck.iUl2EdsLogikFl /end MEASUREMENT
/begin MEASUREMENT iUl2EdsLogikInt.f_call_ext "Signalisiert ob die Fehlerfunktion aufgerufen wurde" UBYTE UMR___1_1_0_S5_S3 1 100 0 1 ECU_ADDRESS 0xFFF8D5A0 DISPLAY_IDENTIFIER f_call_ext.iUl2EdsLogikInt /end MEASUREMENT
/begin MEASUREMENT iUl2EdsLogikInt.n_zaehler_rueck "Zaehler zum Rückfiltern eines Fehlereintrags" UWORD UMR___1_1_0_S5_S3 1 100 0 32767 ECU_ADDRESS 0xFFF8D5A2 DISPLAY_IDENTIFIER n_zaehler_rueck.iUl2EdsLogikInt /end MEASUREMENT
/begin MEASUREMENT iUl2EdsSignalFl.globale_einst_bed "Globale Einstiegsbedingung die für alle Überwachungsfunktionen gilt." FLOAT32_IEEE Conv.cUl2EdsSignalFl._.globale_einst_bed_S5_S3 1 100 0 1 ECU_ADDRESS 0xFFF8D394 FORMAT "%3.2" DISPLAY_IDENTIFIER globale_einst_bed.iUl2EdsSignalFl /end MEASUREMENT
/begin MEASUREMENT iUl2EdsSignalFl.n_poskflwechsel_zaehler "Startet mit verlassen von D bzw. R" FLOAT32_IEEE UMR___1_1_0_S5_S3 1 100 0 65535 ECU_ADDRESS 0xFFF8D398 FORMAT "%3.2" DISPLAY_IDENTIFIER n_poskflwechsel_zaehler.iUl2EdsSignalFl /end MEASUREMENT
/begin MEASUREMENT iUl2EdsSignalFl.pos_alt "merkt sich die vorherige Postion" FLOAT32_IEEE UMR___1_1_0_S5_S3 1 100 0 8 ECU_ADDRESS 0xFFF8D39C FORMAT "%3.2" DISPLAY_IDENTIFIER pos_alt.iUl2EdsSignalFl /end MEASUREMENT
/begin MEASUREMENT iUl2EdsSignalFl.posv_ueb_aktiv_l2 "Die Messgröße wird gesetzt, wenn alle Kupplungen mit, Ausnahme der Kupplung C geschaltet erkannt werden UND das und MV_POS UND der Parksperrenmagnet nicht angesteuert sind" FLOAT32_IEEE Conv.cUl2EdsSignalFl._.posv_ueb_aktiv_l2_S5_S3 1 100 0 1 ECU_ADDRESS 0xFFF8D390 FORMAT "%3.2" DISPLAY_IDENTIFIER posv_ueb_aktiv_l2.iUl2EdsSignalFl /end MEASUREMENT
/begin MEASUREMENT iUl2EdsSignalInt.globale_einst_bed "Globale Einstiegsbedingung die für alle Überwachungsfunktionen gilt." UBYTE Conv.cUl2EdsSignalInt._.globale_einst_bed_S5_S3 1 100 0 1 ECU_ADDRESS 0xFFF8D82B DISPLAY_IDENTIFIER globale_einst_bed.iUl2EdsSignalInt /end MEASUREMENT
/begin MEASUREMENT iUl2EdsSignalInt.n_poskflwechsel_zaehler "Startet mit verlassen von D bzw. R" UWORD UMR___1_1_0_S5_S3 1 100 0 65535 ECU_ADDRESS 0xFFF8D82C DISPLAY_IDENTIFIER n_poskflwechsel_zaehler.iUl2EdsSignalInt /end MEASUREMENT
/begin MEASUREMENT iUl2EdsSignalInt.pos_alt "merkt sich die vorherige Postion" UBYTE Conv.cUl2EdsSignalInt._.pos_alt_S5_S3 1 100 0 8 ECU_ADDRESS 0xFFF8D82E DISPLAY_IDENTIFIER pos_alt.iUl2EdsSignalInt /end MEASUREMENT
/begin MEASUREMENT iUl2EdsSignalInt.posv_ueb_aktiv_l2 "Die Messgröße wird gesetzt, wenn alle Kupplungen mit, Ausnahme der Kupplung C geschaltet erkannt werden UND das und MV_POS UND der Parksperrenmagnet nicht angesteuert sind" UBYTE Conv.cUl2EdsSignalInt._.posv_ueb_aktiv_l2_S5_S3 1 100 0 1 ECU_ADDRESS 0xFFF8D82A DISPLAY_IDENTIFIER posv_ueb_aktiv_l2.iUl2EdsSignalInt /end MEASUREMENT
/begin MEASUREMENT iUl2GetrMAufFl.cBasFehlerErfolgFl._.flag_fehler "Das Flag zeigt an ob die Ueberwachungen einen Fehler entdeckt hat." FLOAT32_IEEE Conv.cBasFehlerErfolgFl._.flag_fehler_S5_S3 1 100 0 1 ECU_ADDRESS 0xFFF8C5B0 FORMAT "%3.2" DISPLAY_IDENTIFIER flag_fehler.iUl2GetrMAufFl /end MEASUREMENT
/begin MEASUREMENT iUl2GetrMAufFl.cBasFehlerErfolgFl._.zaehler_erfolge "Erfolgszaehler der Überwachungsfunktion" FLOAT32_IEEE UMR___1_1_0_S5_S3 1 100 0 65535 ECU_ADDRESS 0xFFF8C5B8 FORMAT "%3.2" DISPLAY_IDENTIFIER zaehler_erfolge.iUl2GetrMAufFl /end MEASUREMENT
/begin MEASUREMENT iUl2GetrMAufFl.cBasFehlerErfolgFl._.zaehler_fehler "Fehlerzaehler der Überwachungsfunktion" FLOAT32_IEEE UMR___1_1_0_S5_S3 1 100 0 65535 ECU_ADDRESS 0xFFF8C5B4 FORMAT "%3.2" DISPLAY_IDENTIFIER zaehler_fehler.iUl2GetrMAufFl /end MEASUREMENT
/begin MEASUREMENT iUl2GetrMAufFl.mmot_auf_zul "Zulässiges Aufnahmemoment" FLOAT32_IEEE UMR_NM__1_1_0_S5_S3 1 100 0 2000 ECU_ADDRESS 0xFFF8C5C0 DISPLAY_IDENTIFIER mmot_auf_zul.iUl2GetrMAufFl /end MEASUREMENT
/begin MEASUREMENT iUl2GetrMAufInt.cBasFehlerErfolgInt._.flag_fehler "Das Flag zeigt an ob die Ueberwachungen einen Fehler entdeckt hat." UBYTE Conv.cBasFehlerErfolgInt._.flag_fehler_S5_S3 1 100 0 1 BIT_MASK 0x1 ECU_ADDRESS 0xFFF8C59C DISPLAY_IDENTIFIER flag_fehler.iUl2GetrMAufInt /end MEASUREMENT
/begin MEASUREMENT iUl2GetrMAufInt.cBasFehlerErfolgInt._.zaehler_erfolge "Erfolgszaehler der Überwachungsfunktion" ULONG UMR___1_1_0_S5_S3 1 100 0 65535 ECU_ADDRESS 0xFFF8C5A4 DISPLAY_IDENTIFIER zaehler_erfolge.iUl2GetrMAufInt /end MEASUREMENT
/begin MEASUREMENT iUl2GetrMAufInt.cBasFehlerErfolgInt._.zaehler_fehler "Fehlerzaehler der Überwachungsfunktion" ULONG UMR___1_1_0_S5_S3 1 100 0 65535 ECU_ADDRESS 0xFFF8C5A0 DISPLAY_IDENTIFIER zaehler_fehler.iUl2GetrMAufInt /end MEASUREMENT
/begin MEASUREMENT iUl2GetrMAufInt.mmot_auf_zul "Zulässiges Aufnahmemoment" UWORD UMR_NM__1_1_0_S5_S3 1 100 0 2000 ECU_ADDRESS 0xFFF8C5AC DISPLAY_IDENTIFIER mmot_auf_zul.iUl2GetrMAufInt /end MEASUREMENT
/begin MEASUREMENT iUl2GetrMAufInt.n_maxstoermgetrauf "Störzähler Überwachung Getr Aufnahmemoment" UWORD UMR___1_1_0_S5_S3 1 100 0 65535 ECU_ADDRESS 0xFFF8C5AE DISPLAY_IDENTIFIER n_maxstoermgetrauf.iUl2GetrMAufInt /end MEASUREMENT
/begin MEASUREMENT iUl2ItfOutIGangFl.i_gang "Level 2: Uebesetzung des aktuellen Gangs" FLOAT32_IEEE UMR___1_1000_0_S5_S3 1 100 -32.768 32.767 ECU_ADDRESS 0xFFF8C64C DISPLAY_IDENTIFIER i_gang.iUl2ItfOutIGangFl /end MEASUREMENT
/begin MEASUREMENT iUl2ItfOutIGangInt.i_gang "Level 2: Uebesetzung des aktuellen Gangs" SWORD UMR___1_1000_0_S5_S3 1 100 -32.768 32.767 ECU_ADDRESS 0xFFF8D81A DISPLAY_IDENTIFIER i_gang.iUl2ItfOutIGangInt /end MEASUREMENT
/begin MEASUREMENT iUl2ItfipFl.c_getr_l2 "Komplementsignal zu Getriebetemperatur fuer Level 2" FLOAT32_IEEE UMR_GRADC__1_1_M40_S5_S3 1 100 -40 215 ECU_ADDRESS 0xFFF8C5F8 DISPLAY_IDENTIFIER c_getr_l2.iUl2ItfipFl /end MEASUREMENT
/begin MEASUREMENT iUl2ItfipFl.dsc_fehler_l2 "Komplement zu DSC (ESP)-Fehlerflag / DSC (ESP)-Inaktiv-Signal" FLOAT32_IEEE UMR___1_1_0_S5_S3 1 100 0 1 ECU_ADDRESS 0xFFF8C5D8 FORMAT "%3.2" DISPLAY_IDENTIFIER dsc_fehler_l2.iUl2ItfipFl /end MEASUREMENT
/begin MEASUREMENT iUl2ItfipFl.fzg_geschwindigkeit_max_l2 "Max. Fahrzeuggeschwindigkeit, Komplement" FLOAT32_IEEE UMR_KM_H_1_1_0_S5_S3 1 100 0 400 ECU_ADDRESS 0xFFF8C630 DISPLAY_IDENTIFIER fzg_geschwindigkeit_max_l2.iUl2ItfipFl /end MEASUREMENT
/begin MEASUREMENT iUl2ItfipFl.iv_c_getr_l2_komp "Komplementsignal zur Inputgroesse der Getriebetemperatur fuer Level2" UBYTE UMR_GRADC__1_1_M40_S5_S3 1 100 -40 215 ECU_ADDRESS 0xFFF8C5F4 DISPLAY_IDENTIFIER iv_c_getr_l2_komp.iUl2ItfipFl /end MEASUREMENT
/begin MEASUREMENT iUl2ItfipFl.iv_dscfehlerl2komp "Eingangssignal Komplement zu DSC (ESP)-Fehlerflag / DSC (ESP)-Inaktiv-Signal" UBYTE Conv.cUl2ItfipFl._.iv_dscfehlerl2komp_S5_S3 1 100 254 255 ECU_ADDRESS 0xFFF8C5D4 DISPLAY_IDENTIFIER iv_dscfehlerl2komp.iUl2ItfipFl /end MEASUREMENT
/begin MEASUREMENT iUl2ItfipFl.iv_fzg_geschwindigkeit_max_l2_komp "Max. Fahrzeuggeschwindigkeit, Komplement" UWORD UMR_KM_H_1_1_0_S5_S3 1 100 65135 65535 ECU_ADDRESS 0xFFF8C62C DISPLAY_IDENTIFIER iv_fzg_geschwindigkeit_max_l2_komp.iUl2ItfipFl /end MEASUREMENT
/begin MEASUREMENT iUl2ItfipFl.iv_m_ist_em_l2_komp "Komplement: Moment an der E-Maschine" SWORD UMR_NM__1_1_0_S5_S3 1 100 -32768 32767 ECU_ADDRESS 0xFFF8C614 DISPLAY_IDENTIFIER iv_m_ist_em_l2_komp.iUl2ItfipFl /end MEASUREMENT
/begin MEASUREMENT iUl2ItfipFl.iv_m_ist_vm_l2_komp "Komplement: Moment an dem Verbrennungsmotor" SWORD UMR_NM__1_1_0_S5_S3 1 100 -32768 32767 ECU_ADDRESS 0xFFF8C61C DISPLAY_IDENTIFIER iv_m_ist_vm_l2_komp.iUl2ItfipFl /end MEASUREMENT
/begin MEASUREMENT iUl2ItfipFl.iv_m_mot_l2_komp "Komplementsignal zu Inputgroesse Level2 fuer Motormoment" SWORD UMR_NM__1_1_0_S5_S3 1 100 -1301 199 ECU_ADDRESS 0xFFF8C5FC DISPLAY_IDENTIFIER iv_m_mot_l2_komp.iUl2ItfipFl /end MEASUREMENT
/begin MEASUREMENT iUl2ItfipFl.iv_mmotist_l2_komp "Komplement Eingangsgroesse Motormoment ohne Motoreingriff Getriebe für Level 2" SWORD UMR_NM__1_1_0_S5_S3 1 100 -200 1300 ECU_ADDRESS 0xFFF8C60C DISPLAY_IDENTIFIER iv_mmotist_l2_komp.iUl2ItfipFl /end MEASUREMENT
/begin MEASUREMENT iUl2ItfipFl.iv_n_ab_l2_komp "Komplementsignal zu Inputgroesse Level2 fuer Abtriebsdrehzahl" UWORD UMR_U_MIN_1_1_0_S5_S3 1 100 57375 65535 ECU_ADDRESS 0xFFF8C5DC DISPLAY_IDENTIFIER iv_n_ab_l2_komp.iUl2ItfipFl /end MEASUREMENT
/begin MEASUREMENT iUl2ItfipFl.iv_n_ab_max_l2_komp "Komplementsignal zu Inputgroesse Level2 fuer max Abtriebsdrehzahl" UWORD UMR_U_MIN_1_1_0_S5_S3 1 100 57375 65535 ECU_ADDRESS 0xFFF8C5E4 DISPLAY_IDENTIFIER iv_n_ab_max_l2_komp.iUl2ItfipFl /end MEASUREMENT
/begin MEASUREMENT iUl2ItfipFl.iv_n_turb_l2_komp "Komplementsignal zu Inputgroesse Level2 fuer Turbinendrehzahl" UWORD UMR_U_MIN_1_1_0_S5_S3 1 100 57375 65535 ECU_ADDRESS 0xFFF8C604 DISPLAY_IDENTIFIER iv_n_turb_l2_komp.iUl2ItfipFl /end MEASUREMENT
/begin MEASUREMENT iUl2ItfipFl.iv_nmo_vm_l2_komp "Komplement: Verbrennungsmotordrehzahl" UWORD UMR_U_MIN_1_1_0_S5_S3 1 100 0 65535 ECU_ADDRESS 0xFFF8C624 DISPLAY_IDENTIFIER iv_nmo_vm_l2_komp.iUl2ItfipFl /end MEASUREMENT
/begin MEASUREMENT iUl2ItfipFl.iv_nmotabregell2komp "Komplementsignal zu Eingangsgroesse Motorabregeldrehzahl für Level2" UWORD UMR_U_MIN_1_1_0_S5_S3 1 100 58535 65535 ECU_ADDRESS 0xFFF8C5CC DISPLAY_IDENTIFIER iv_nmotabregell2komp.iUl2ItfipFl /end MEASUREMENT
/begin MEASUREMENT iUl2ItfipFl.iv_nmotl2komp "Komplementsignal zu Inputgroesse Level2 für Motordrehzahl" UWORD UMR_U_MIN_1_1_0_S5_S3 1 100 57375 65535 ECU_ADDRESS 0xFFF8C5C4 DISPLAY_IDENTIFIER iv_nmotl2komp.iUl2ItfipFl /end MEASUREMENT
/begin MEASUREMENT iUl2ItfipFl.iv_pos_l2_komp "Komplementsignal zu Inputgroesse Level2 fuer Waehlhebelposition" UBYTE Conv.cUl2ItfipFl._.iv_pos_l2_komp_S5_S3 1 100 247 255 ECU_ADDRESS 0xFFF8C5EC DISPLAY_IDENTIFIER iv_pos_l2_komp.iUl2ItfipFl /end MEASUREMENT
/begin MEASUREMENT iUl2ItfipFl.iv_ps_sensor_signal_l2_komp "Komplementsignal, Sensorsignal der Parksperre" UBYTE Conv.cUl2ItfipFl._.iv_ps_sensor_signal_l2_komp_S5_S3 1 100 252 255 ECU_ADDRESS 0xFFF8C63C DISPLAY_IDENTIFIER iv_ps_sensor_signal_l2_komp.iUl2ItfipFl /end MEASUREMENT
/begin MEASUREMENT iUl2ItfipFl.iv_ps_sensor_status_l2_komp "Statussignal zu iv_ps_sensor_signal_l2" UBYTE Conv.cUl2ItfipFl._.iv_ps_sensor_status_l2_komp_S5_S3 1 100 253 255 ECU_ADDRESS 0xFFF8C644 DISPLAY_IDENTIFIER iv_ps_sensor_status_l2_komp.iUl2ItfipFl /end MEASUREMENT
/begin MEASUREMENT iUl2ItfipFl.iv_v_unplausibel_l2_komp "Fahrzeuggeschwindigkeit zur Abtriebsdrehzahl plausibel, Komplement" UBYTE Conv.cUl2ItfipFl._.iv_v_unplausibel_l2_komp_S5_S3 1 100 254 255 ECU_ADDRESS 0xFFF8C634 DISPLAY_IDENTIFIER iv_v_unplausibel_l2_komp.iUl2ItfipFl /end MEASUREMENT
/begin MEASUREMENT iUl2ItfipFl.m_ist_em_l2 "Komplement: Moment an der E-Maschine" FLOAT32_IEEE UMR_NM__1_1_0_S5_S3 1 100 -400 1640 ECU_ADDRESS 0xFFF8C618 DISPLAY_IDENTIFIER m_ist_em_l2.iUl2ItfipFl /end MEASUREMENT
/begin MEASUREMENT iUl2ItfipFl.m_ist_vm_l2 "Komplement: Moment an dem Verbrennungsmotor" FLOAT32_IEEE UMR_NM__1_1_0_S5_S3 1 100 -400 1640 ECU_ADDRESS 0xFFF8C620 DISPLAY_IDENTIFIER m_ist_vm_l2.iUl2ItfipFl /end MEASUREMENT
/begin MEASUREMENT iUl2ItfipFl.m_mot_l2 "Komplementsignal zu Motormoment für Level 2" FLOAT32_IEEE UMR_NM__1_1_0_S5_S3 1 100 -200 1300 ECU_ADDRESS 0xFFF8C600 DISPLAY_IDENTIFIER m_mot_l2.iUl2ItfipFl /end MEASUREMENT
/begin MEASUREMENT iUl2ItfipFl.mmotist_l2 "Komplement Motormoment ohne Motoreingriff Getriebe für Level 2" FLOAT32_IEEE UMR_NM__1_1_0_S5_S3 1 100 -200 1300 ECU_ADDRESS 0xFFF8C610 DISPLAY_IDENTIFIER mmotist_l2.iUl2ItfipFl /end MEASUREMENT
/begin MEASUREMENT iUl2ItfipFl.n_ab_l2 "Komplementsignal zu Abtriebsdrehzahl fuer Level2" FLOAT32_IEEE UMR_U_MIN_1_1_0_S5_S3 1 100 0 8160 ECU_ADDRESS 0xFFF8C5E0 DISPLAY_IDENTIFIER n_ab_l2.iUl2ItfipFl /end MEASUREMENT
/begin MEASUREMENT iUl2ItfipFl.n_ab_max_l2 "Komplementsignal zu max Abtriebsdrehzahl fuer Level2" FLOAT32_IEEE UMR_U_MIN_1_1_0_S5_S3 1 100 0 8160 ECU_ADDRESS 0xFFF8C5E8 DISPLAY_IDENTIFIER n_ab_max_l2.iUl2ItfipFl /end MEASUREMENT
/begin MEASUREMENT iUl2ItfipFl.n_mot_l2 "Komplementsignal zu Motordrehzahl für Level2" FLOAT32_IEEE UMR_U_MIN_1_1_0_S5_S3 1 100 0 8160 ECU_ADDRESS 0xFFF8C5C8 DISPLAY_IDENTIFIER n_mot_l2.iUl2ItfipFl /end MEASUREMENT
/begin MEASUREMENT iUl2ItfipFl.n_motabregel_l2 "Komplementsignal zu Motorabregeldrehzahl für Level2" FLOAT32_IEEE UMR_U_MIN_1_1_0_S5_S3 1 100 0 7000 ECU_ADDRESS 0xFFF8C5D0 DISPLAY_IDENTIFIER n_motabregel_l2.iUl2ItfipFl /end MEASUREMENT
/begin MEASUREMENT iUl2ItfipFl.n_turb_l2 "Komplementsignal fuer TurbinendrehzahlLevel2" FLOAT32_IEEE UMR_U_MIN_1_1_0_S5_S3 1 100 0 8160 ECU_ADDRESS 0xFFF8C608 DISPLAY_IDENTIFIER n_turb_l2.iUl2ItfipFl /end MEASUREMENT
/begin MEASUREMENT iUl2ItfipFl.nmo_vm_l2 "Komplement: Verbrennungsmotordrehzahl" FLOAT32_IEEE UMR_U_MIN_1_1_0_S5_S3 1 100 0 65535 ECU_ADDRESS 0xFFF8C628 DISPLAY_IDENTIFIER nmo_vm_l2.iUl2ItfipFl /end MEASUREMENT
/begin MEASUREMENT iUl2ItfipFl.pos_l2 "Komplementsignal zu Waehlhebelposition fuer Level2" FLOAT32_IEEE UMR___1_1_0_S5_S3 1 100 0 8 ECU_ADDRESS 0xFFF8C5F0 FORMAT "%3.2" DISPLAY_IDENTIFIER pos_l2.iUl2ItfipFl /end MEASUREMENT
/begin MEASUREMENT iUl2ItfipFl.ps_sensor_signal_l2 "Komplementsignal, Sensorsignal der Parksperre" FLOAT32_IEEE UMR___1_1_0_S5_S3 1 100 0 3 ECU_ADDRESS 0xFFF8C640 FORMAT "%3.2" DISPLAY_IDENTIFIER ps_sensor_signal_l2.iUl2ItfipFl /end MEASUREMENT
/begin MEASUREMENT iUl2ItfipFl.ps_sensor_status_l2 "Statussignal zu iv_ps_sensor_signal_l2" FLOAT32_IEEE Conv.cUl2ItfipFl._.ps_sensor_status_l2_S5_S3 1 100 0 2 ECU_ADDRESS 0xFFF8C648 FORMAT "%3.2" DISPLAY_IDENTIFIER ps_sensor_status_l2.iUl2ItfipFl /end MEASUREMENT
/begin MEASUREMENT iUl2ItfipFl.v_unplausibel_l2 "Fahrzeuggeschwindigkeit zur Abtriebsdrehzahl plausibel, Komplement" FLOAT32_IEEE UMR___1_1_0_S5_S3 1 100 0 1 ECU_ADDRESS 0xFFF8C638 FORMAT "%3.2" DISPLAY_IDENTIFIER v_unplausibel_l2.iUl2ItfipFl /end MEASUREMENT
/begin MEASUREMENT iUl2ItfipInt.c_getr_l2 "Getriebetemperatur für Level 2" UBYTE UMR_GRADC__1_1_M40_S5_S3 1 100 -40 215 ECU_ADDRESS 0xFFF8D7FB DISPLAY_IDENTIFIER c_getr_l2.iUl2ItfipInt /end MEASUREMENT
/begin MEASUREMENT iUl2ItfipInt.dsc_fehler_l2 "DSC (ESP)-Fehlerflag / DSC (ESP)-Inaktiv-Signal" UBYTE Conv.cUl2ItfipInt._.dsc_fehler_l2_S5_S3 1 100 0 1 ECU_ADDRESS 0xFFF8D7E9 DISPLAY_IDENTIFIER dsc_fehler_l2.iUl2ItfipInt /end MEASUREMENT
/begin MEASUREMENT iUl2ItfipInt.fzg_geschwindigkeit_max_l2 "Max. Fahrzeuggeschwindigkeit" UWORD UMR_KM_H_1_1_0_S5_S3 1 100 0 400 ECU_ADDRESS 0xFFF8D812 DISPLAY_IDENTIFIER fzg_geschwindigkeit_max_l2.iUl2ItfipInt /end MEASUREMENT
/begin MEASUREMENT iUl2ItfipInt.iv_c_getr_l2 "Eingangsgroesse Getriebetemperatur für Level 2" UBYTE UMR_GRADC__1_1_M40_S5_S3 1 100 -40 215 ECU_ADDRESS 0xFFF8D7FA DISPLAY_IDENTIFIER iv_c_getr_l2.iUl2ItfipInt /end MEASUREMENT
/begin MEASUREMENT iUl2ItfipInt.iv_dscfehlerl2 "Eingangssignal zu DSC (ESP)-Fehlerflag / DSC (ESP)-Inaktiv-Signal" UBYTE Conv.cUl2ItfipInt._.iv_dscfehlerl2_S5_S3 1 100 0 1 ECU_ADDRESS 0xFFF8D7E8 DISPLAY_IDENTIFIER iv_dscfehlerl2.iUl2ItfipInt /end MEASUREMENT
/begin MEASUREMENT iUl2ItfipInt.iv_fzg_geschwindigkeit_max_l2 "Max. Fahrzeuggeschwindigkeit" UWORD UMR_KM_H_1_1_0_S5_S3 1 100 0 400 ECU_ADDRESS 0xFFF8D810 DISPLAY_IDENTIFIER iv_fzg_geschwindigkeit_max_l2.iUl2ItfipInt /end MEASUREMENT
/begin MEASUREMENT iUl2ItfipInt.iv_m_ist_em_l2 "Moment an der E-Maschine" SWORD UMR_NM__1_1_0_S5_S3 1 100 -400 1640 ECU_ADDRESS 0xFFF8D804 DISPLAY_IDENTIFIER iv_m_ist_em_l2.iUl2ItfipInt /end MEASUREMENT
/begin MEASUREMENT iUl2ItfipInt.iv_m_ist_vm_l2 "Moment an dem Verbrennungsmotor" SWORD UMR_NM__1_1_0_S5_S3 1 100 -400 1640 ECU_ADDRESS 0xFFF8D808 DISPLAY_IDENTIFIER iv_m_ist_vm_l2.iUl2ItfipInt /end MEASUREMENT
/begin MEASUREMENT iUl2ItfipInt.iv_m_mot_l2 "Eingangsgroesse Motormoment für Level 2" SWORD UMR_NM__1_1_0_S5_S3 1 100 -200 1300 ECU_ADDRESS 0xFFF8D7F4 DISPLAY_IDENTIFIER iv_m_mot_l2.iUl2ItfipInt /end MEASUREMENT
/begin MEASUREMENT iUl2ItfipInt.iv_mmotist_l2 "Eingangsgroesse Motormoment ohne Motoreingriff Getriebe für Level 2" SWORD UMR_NM__1_1_0_S5_S3 1 100 -200 1300 ECU_ADDRESS 0xFFF8D800 DISPLAY_IDENTIFIER iv_mmotist_l2.iUl2ItfipInt /end MEASUREMENT
/begin MEASUREMENT iUl2ItfipInt.iv_n_ab_l2 "Inputgroesse Level2 fuer Abtriebsdrehzahl" UWORD UMR_U_MIN_1_1_0_S5_S3 1 100 0 8160 ECU_ADDRESS 0xFFF8D7EA DISPLAY_IDENTIFIER iv_n_ab_l2.iUl2ItfipInt /end MEASUREMENT
/begin MEASUREMENT iUl2ItfipInt.iv_n_ab_max_l2 "Inputgroesse Level2 fuer max Abtriebsdrehzahl" UWORD UMR_U_MIN_1_1_0_S5_S3 1 100 0 8160 ECU_ADDRESS 0xFFF8D7EE DISPLAY_IDENTIFIER iv_n_ab_max_l2.iUl2ItfipInt /end MEASUREMENT
/begin MEASUREMENT iUl2ItfipInt.iv_n_turb_l2 "Eingangsgroesse Turbinendrehzahl für Level 2" UWORD UMR_U_MIN_1_1_0_S5_S3 1 100 0 8160 ECU_ADDRESS 0xFFF8D7FC DISPLAY_IDENTIFIER iv_n_turb_l2.iUl2ItfipInt /end MEASUREMENT
/begin MEASUREMENT iUl2ItfipInt.iv_nmo_vm_l2 "Verbrennungsmotordrehzahl" UWORD UMR_U_MIN_1_1_0_S5_S3 1 100 0 65535 ECU_ADDRESS 0xFFF8D80C DISPLAY_IDENTIFIER iv_nmo_vm_l2.iUl2ItfipInt /end MEASUREMENT
/begin MEASUREMENT iUl2ItfipInt.iv_nmotabregell2 "Eingangsgroesse Motorabregeldrehzahl für Level2" UWORD UMR_U_MIN_1_1_0_S5_S3 1 100 0 10000 ECU_ADDRESS 0xFFF8D7E4 DISPLAY_IDENTIFIER iv_nmotabregell2.iUl2ItfipInt /end MEASUREMENT
/begin MEASUREMENT iUl2ItfipInt.iv_nmotl2 "Inputgroesse Level2 für Motordrehzahl" UWORD UMR_U_MIN_1_1_0_S5_S3 1 100 0 8160 ECU_ADDRESS 0xFFF8D7E0 DISPLAY_IDENTIFIER iv_nmotl2.iUl2ItfipInt /end MEASUREMENT
/begin MEASUREMENT iUl2ItfipInt.iv_pos_l2 "Inputgroesse Level2 fuer Waehlhebelposition" UBYTE Conv.cUl2ItfipInt._.iv_pos_l2_S5_S3 1 100 0 12 ECU_ADDRESS 0xFFF8D7F2 DISPLAY_IDENTIFIER iv_pos_l2.iUl2ItfipInt /end MEASUREMENT
/begin MEASUREMENT iUl2ItfipInt.iv_ps_sensor_signal_l2 "Sensorsignal der Parksperre" UBYTE Conv.cUl2ItfipInt._.iv_ps_sensor_signal_l2_S5_S3 1 100 0 3 ECU_ADDRESS 0xFFF8D816 DISPLAY_IDENTIFIER iv_ps_sensor_signal_l2.iUl2ItfipInt /end MEASUREMENT
/begin MEASUREMENT iUl2ItfipInt.iv_ps_sensor_status_l2 "Statussignal zu iv_ps_sensor_signal_l2" UBYTE Conv.cUl2ItfipInt._.iv_ps_sensor_status_l2_S5_S3 1 100 0 2 ECU_ADDRESS 0xFFF8D818 DISPLAY_IDENTIFIER iv_ps_sensor_status_l2.iUl2ItfipInt /end MEASUREMENT
/begin MEASUREMENT iUl2ItfipInt.iv_v_unplausibel_l2 "Fahrzeuggeschwindigkeit zur Abtriebsdrehzahl plausibel" UBYTE Conv.cUl2ItfipInt._.iv_v_unplausibel_l2_S5_S3 1 100 0 1 ECU_ADDRESS 0xFFF8D814 DISPLAY_IDENTIFIER iv_v_unplausibel_l2.iUl2ItfipInt /end MEASUREMENT
/begin MEASUREMENT iUl2ItfipInt.m_ist_em_l2 "Moment an der E-Maschine" SWORD UMR_NM__1_1_0_S5_S3 1 100 -400 1640 ECU_ADDRESS 0xFFF8D806 DISPLAY_IDENTIFIER m_ist_em_l2.iUl2ItfipInt /end MEASUREMENT
/begin MEASUREMENT iUl2ItfipInt.m_ist_vm_l2 "Moment an dem Verbrennungsmotor" SWORD UMR_NM__1_1_0_S5_S3 1 100 -400 1640 ECU_ADDRESS 0xFFF8D80A DISPLAY_IDENTIFIER m_ist_vm_l2.iUl2ItfipInt /end MEASUREMENT
/begin MEASUREMENT iUl2ItfipInt.m_mot_l2 "Motormoment für Level 2" SWORD UMR_NM__1_1_0_S5_S3 1 100 -200 1300 ECU_ADDRESS 0xFFF8D7F6 DISPLAY_IDENTIFIER m_mot_l2.iUl2ItfipInt /end MEASUREMENT
/begin MEASUREMENT iUl2ItfipInt.mmotist_l2 "Motormoment ohne Motoreingriff Getriebe für Level 2" SWORD UMR_NM__1_1_0_S5_S3 1 100 -200 1300 ECU_ADDRESS 0xFFF8D802 DISPLAY_IDENTIFIER mmotist_l2.iUl2ItfipInt /end MEASUREMENT
/begin MEASUREMENT iUl2ItfipInt.n_ab_l2 "Abtriebsdrehzahl fuer Level2" UWORD UMR_U_MIN_1_1_0_S5_S3 1 100 0 8160 ECU_ADDRESS 0xFFF8D7EC DISPLAY_IDENTIFIER n_ab_l2.iUl2ItfipInt /end MEASUREMENT
/begin MEASUREMENT iUl2ItfipInt.n_ab_max_l2 "Max Abtriebsdrehzahl fuer Level2" UWORD UMR_U_MIN_1_1_0_S5_S3 1 100 0 8160 ECU_ADDRESS 0xFFF8D7F0 DISPLAY_IDENTIFIER n_ab_max_l2.iUl2ItfipInt /end MEASUREMENT
/begin MEASUREMENT iUl2ItfipInt.n_mot_l2 "Motordrehzahl für Level2" UWORD UMR_U_MIN_1_1_0_S5_S3 1 100 0 8160 ECU_ADDRESS 0xFFF8D7E2 DISPLAY_IDENTIFIER n_mot_l2.iUl2ItfipInt /end MEASUREMENT
/begin MEASUREMENT iUl2ItfipInt.n_motabregel_l2 "Motorabregeldrehzahl für Level2" UWORD UMR_U_MIN_1_1_0_S5_S3 1 100 0 10000 ECU_ADDRESS 0xFFF8D7E6 DISPLAY_IDENTIFIER n_motabregel_l2.iUl2ItfipInt /end MEASUREMENT
/begin MEASUREMENT iUl2ItfipInt.n_turb_l2 "Turbinendrehzahl für Level 2" UWORD UMR_U_MIN_1_1_0_S5_S3 1 100 0 8160 ECU_ADDRESS 0xFFF8D7FE DISPLAY_IDENTIFIER n_turb_l2.iUl2ItfipInt /end MEASUREMENT
/begin MEASUREMENT iUl2ItfipInt.nmo_vm_l2 "Verbrennungsmotordrehzahl" UWORD UMR_U_MIN_1_1_0_S5_S3 1 100 0 65535 ECU_ADDRESS 0xFFF8D80E DISPLAY_IDENTIFIER nmo_vm_l2.iUl2ItfipInt /end MEASUREMENT
/begin MEASUREMENT iUl2ItfipInt.pos_l2 "Waehlhebelposition fuer Level2" UBYTE Conv.cUl2ItfipInt._.pos_l2_S5_S3 1 100 0 12 ECU_ADDRESS 0xFFF8D7F3 DISPLAY_IDENTIFIER pos_l2.iUl2ItfipInt /end MEASUREMENT
/begin MEASUREMENT iUl2ItfipInt.ps_sensor_signal_l2 "Sensorsignal der Parksperre" UBYTE Conv.cUl2ItfipInt._.ps_sensor_signal_l2_S5_S3 1 100 0 3 ECU_ADDRESS 0xFFF8D817 DISPLAY_IDENTIFIER ps_sensor_signal_l2.iUl2ItfipInt /end MEASUREMENT
/begin MEASUREMENT iUl2ItfipInt.ps_sensor_status_l2 "Statussignal zu iv_ps_sensor_signal_l2" UBYTE Conv.cUl2ItfipInt._.ps_sensor_status_l2_S5_S3 1 100 0 2 ECU_ADDRESS 0xFFF8D819 DISPLAY_IDENTIFIER ps_sensor_status_l2.iUl2ItfipInt /end MEASUREMENT
/begin MEASUREMENT iUl2ItfipInt.swi_m_mot_l2 "dient zum Verstellen des Signal u. seinem Komplement." SWORD UMR___1_1_0_S5_S3 1 100 -32768 32767 ECU_ADDRESS 0xFFF8D7F8 DISPLAY_IDENTIFIER swi_m_mot_l2.iUl2ItfipInt /end MEASUREMENT
/begin MEASUREMENT iUl2ItfipInt.v_unplausibel_l2 "Fahrzeuggeschwindigkeit zur Abtriebsdrehzahl plausibel" UBYTE Conv.cUl2ItfipInt._.v_unplausibel_l2_S5_S3 1 100 0 1 ECU_ADDRESS 0xFFF8D815 DISPLAY_IDENTIFIER v_unplausibel_l2.iUl2ItfipInt /end MEASUREMENT
/begin MEASUREMENT iUl2ItfipUewFl.m_getrauf "Inputgroesse Level2 für Getriebeaufnahmemoment" FLOAT32_IEEE UMR_NM__1_1_0_S5_S3 1 100 0 1300 ECU_ADDRESS 0xFFF8D444 DISPLAY_IDENTIFIER m_getrauf.iUl2ItfipUewFl /end MEASUREMENT
/begin MEASUREMENT iUl2ItfipUewFl.m_motmax "Level2: maximal zulaessiges Motormoment" FLOAT32_IEEE UMR_NM__1_1_0_S5_S3 1 100 -200 1300 ECU_ADDRESS 0xFFF8D43C DISPLAY_IDENTIFIER m_motmax.iUl2ItfipUewFl /end MEASUREMENT
/begin MEASUREMENT iUl2ItfipUewFl.me_red_abs "Level2: Liefert ausgegebene Motormoment als Absolutmoment" FLOAT32_IEEE UMR_NM__1_1_0_S5_S3 1 100 -1500 1500 ECU_ADDRESS 0xFFF8D434 DISPLAY_IDENTIFIER me_red_abs.iUl2ItfipUewFl /end MEASUREMENT
/begin MEASUREMENT iUl2ItfipUewFl.me_red_status "Level2: Liefert Status Momentenvorgabe" FLOAT32_IEEE Conv.cUl2ItfipUewFl._.me_red_status_S5_S3 1 100 0 3 ECU_ADDRESS 0xFFF8D438 FORMAT "%3.2" DISPLAY_IDENTIFIER me_red_status.iUl2ItfipUewFl /end MEASUREMENT
/begin MEASUREMENT iUl2ItfipUewFl.zielgang_sas "Level2: Liefert das zu ueberwachende Eingangssignal von GET_ZIELGANG (zielgang_sas)" FLOAT32_IEEE Conv.cUl2ItfipUewFl._.zielgang_sas_S5_S3 1 100 -1 8 ECU_ADDRESS 0xFFF8D440 FORMAT "%3.2" DISPLAY_IDENTIFIER zielgang_sas.iUl2ItfipUewFl /end MEASUREMENT
/begin MEASUREMENT iUl2ItfipUewInt.m_getrauf "Inputgroesse Level2 für Getriebeaufnahmemoment" SWORD UMR_NM__1_1_0_S5_S3 1 100 0 1300 ECU_ADDRESS 0xFFF8D850 DISPLAY_IDENTIFIER m_getrauf.iUl2ItfipUewInt /end MEASUREMENT
/begin MEASUREMENT iUl2ItfipUewInt.m_motmax "Level2: maximal zulaessiges Motormoment" SWORD UMR_NM__1_1_0_S5_S3 1 100 -200 1300 ECU_ADDRESS 0xFFF8D84C DISPLAY_IDENTIFIER m_motmax.iUl2ItfipUewInt /end MEASUREMENT
/begin MEASUREMENT iUl2ItfipUewInt.me_red_abs "Level2: Liefert ausgegebene Motormoment als Absolutmoment" SWORD UMR_NM__1_1_0_S5_S3 1 100 -1500 1500 ECU_ADDRESS 0xFFF8D848 DISPLAY_IDENTIFIER me_red_abs.iUl2ItfipUewInt /end MEASUREMENT
/begin MEASUREMENT iUl2ItfipUewInt.me_red_status "Level2: Liefert Status Momentenvorgabe" UBYTE Conv.cUl2ItfipUewInt._.me_red_status_S5_S3 1 100 0 3 ECU_ADDRESS 0xFFF8D84A DISPLAY_IDENTIFIER me_red_status.iUl2ItfipUewInt /end MEASUREMENT
/begin MEASUREMENT iUl2ItfipUewInt.zielgang_sas "Level2: Liefert das zu ueberwachende Eingangssignal von GET_ZIELGANG (zielgang_sas)" SBYTE Conv.cUl2ItfipUewInt._.zielgang_sas_S5_S3 1 100 -1 8 ECU_ADDRESS 0xFFF8D84E DISPLAY_IDENTIFIER zielgang_sas.iUl2ItfipUewInt /end MEASUREMENT
/begin MEASUREMENT iUl2K0SPlausiDrehzFl.cUl2K0SPlausiFl._.n_diff_k0 "Differenz zwischen E-Maschinendrehz. u. Verbrennungsmotoerdrehz." FLOAT32_IEEE UMR_U_MIN_1_1_0_S5_S3 1 100 0 65535 ECU_ADDRESS 0xFFF8D5DC DISPLAY_IDENTIFIER n_diff_k0._.cUl2K0SPlausiFl.iUl2K0SPlausiDrehzFl /end MEASUREMENT
/begin MEASUREMENT iUl2K0SPlausiDrehzFl.cUl2K0SPlausiFl._.n_diff_k0_einmalig "Wenn der Wert auf TRUE steht, dann wird die Überwachung gestartet." FLOAT32_IEEE UMR___1_1_0_S5_S3 1 100 0 1 ECU_ADDRESS 0xFFF8D5E0 FORMAT "%3.2" DISPLAY_IDENTIFIER n_diff_k0_einmalig._.cUl2K0SPlausiFl.iUl2K0SPlausiDrehzFl /end MEASUREMENT
/begin MEASUREMENT iUl2K0SPlausiDrehzFl.cUl2K0SPlausiFl._.n_i_eds_k0_bed "Bedingung, nach wieviel Zyklen die Kupplung wieder als offen erkannt wird" FLOAT32_IEEE UMR___1_1_0_S5_S3 1 100 0 256 ECU_ADDRESS 0xFFF8D5EC FORMAT "%3.2" DISPLAY_IDENTIFIER n_i_eds_k0_bed._.cUl2K0SPlausiFl.iUl2K0SPlausiDrehzFl /end MEASUREMENT
/begin MEASUREMENT iUl2K0SPlausiDrehzFl.cUl2K0SPlausiFl._.n_k0ueb "Tasks die der Strom an der K0 unterhalb der Schwelle I_MAXK0 liegt. Bei 0 wird wieder in die Funktion eingestiegen." FLOAT32_IEEE UMR___1_1_0_S5_S3 1 100 0 3 ECU_ADDRESS 0xFFF8D5F0 FORMAT "%3.2" DISPLAY_IDENTIFIER n_k0ueb._.cUl2K0SPlausiFl.iUl2K0SPlausiDrehzFl /end MEASUREMENT
/begin MEASUREMENT iUl2K0SPlausiDrehzFl.cUl2K0SPlausiFl._.n_stoeredslogik_k0 "Störzähler, der angibt ob überwacht wird" FLOAT32_IEEE UMR___1_1_0_S5_S3 1 100 0 65535 ECU_ADDRESS 0xFFF8D5E8 FORMAT "%3.2" DISPLAY_IDENTIFIER n_stoeredslogik_k0._.cUl2K0SPlausiFl.iUl2K0SPlausiDrehzFl /end MEASUREMENT
/begin MEASUREMENT iUl2K0SPlausiDrehzFl.cUl2K0SPlausiFl._.st_fehler "Gibt an ob ein Fehler vorhanden ist" FLOAT32_IEEE UMR___1_1_0_S5_S3 1 100 0 2 ECU_ADDRESS 0xFFF8D5E4 FORMAT "%3.2" DISPLAY_IDENTIFIER st_fehler._.cUl2K0SPlausiFl.iUl2K0SPlausiDrehzFl /end MEASUREMENT
/begin MEASUREMENT iUl2K0SPlausiDrehzFl.diff_n_em "Differenz zwischen E-Maschinendrehzahl nachdem der Störzähler über der applizierten Schwelle MAXSTOER_EDSLOGIK_K0 liegt." FLOAT32_IEEE UMR_U_MIN_1_1_0_S5_S3 1 100 -32768 32767 ECU_ADDRESS 0xFFF8D5FC DISPLAY_IDENTIFIER diff_n_em.iUl2K0SPlausiDrehzFl /end MEASUREMENT
/begin MEASUREMENT iUl2K0SPlausiDrehzFl.n_emeink0_n "Wert der E-Maschinendrehzahl zu Beginn der Überwachung" FLOAT32_IEEE UMR_U_MIN_1_1_0_S5_S3 1 100 0 65535 ECU_ADDRESS 0xFFF8D5F8 DISPLAY_IDENTIFIER n_emeink0_n.iUl2K0SPlausiDrehzFl /end MEASUREMENT
/begin MEASUREMENT iUl2K0SPlausiDrehzInt.cUl2K0SPlausiInt._.n_diff_k0 "Differenz zwischen E-Maschinendrehz. u. Verbrennungsmotoerdrehz." SLONG UMR_U_MIN_1_1_0_S5_S3 1 100 0 65535 ECU_ADDRESS 0xFFF8D5AC DISPLAY_IDENTIFIER n_diff_k0._.cUl2K0SPlausiInt.iUl2K0SPlausiDrehzInt /end MEASUREMENT
/begin MEASUREMENT iUl2K0SPlausiDrehzInt.cUl2K0SPlausiInt._.n_diff_k0_einmalig "Wenn der Wert auf TRUE steht, dann wird die Überwachung gestartet." UBYTE Conv.cUl2K0SPlausiInt._.n_diff_k0_einmalig_S5_S3 1 100 0 1 BIT_MASK 0x1 ECU_ADDRESS 0xFFF8D5B0 DISPLAY_IDENTIFIER n_diff_k0_einmalig._.cUl2K0SPlausiInt.iUl2K0SPlausiDrehzInt /end MEASUREMENT
/begin MEASUREMENT iUl2K0SPlausiDrehzInt.cUl2K0SPlausiInt._.n_i_eds_k0_bed "Bedingung, nach wieviel Zyklen die Kupplung wieder als offen erkannt wird" UWORD UMR___1_1_0_S5_S3 1 100 0 256 ECU_ADDRESS 0xFFF8D5B4 DISPLAY_IDENTIFIER n_i_eds_k0_bed._.cUl2K0SPlausiInt.iUl2K0SPlausiDrehzInt /end MEASUREMENT
/begin MEASUREMENT iUl2K0SPlausiDrehzInt.cUl2K0SPlausiInt._.n_k0ueb "Tasks die der Strom an der K0 unterhalb der Schwelle I_MAXK0 liegt. Bei 0 wird wieder in die Funktion eingestiegen." UBYTE UMR___1_1_0_S5_S3 1 100 0 3 ECU_ADDRESS 0xFFF8D5B6 DISPLAY_IDENTIFIER n_k0ueb._.cUl2K0SPlausiInt.iUl2K0SPlausiDrehzInt /end MEASUREMENT
/begin MEASUREMENT iUl2K0SPlausiDrehzInt.cUl2K0SPlausiInt._.n_stoeredslogik_k0 "Störzähler, der angibt ob überwacht wird" UWORD UMR___1_1_0_S5_S3 1 100 0 65535 ECU_ADDRESS 0xFFF8D5B2 DISPLAY_IDENTIFIER n_stoeredslogik_k0._.cUl2K0SPlausiInt.iUl2K0SPlausiDrehzInt /end MEASUREMENT
/begin MEASUREMENT iUl2K0SPlausiDrehzInt.cUl2K0SPlausiInt._.st_fehler "Gibt an ob ein Fehler vorhanden ist" UBYTE Conv.cUl2K0SPlausiInt._.st_fehler_S5_S3 1 100 0 2 ECU_ADDRESS 0xFFF8D5B1 DISPLAY_IDENTIFIER st_fehler._.cUl2K0SPlausiInt.iUl2K0SPlausiDrehzInt /end MEASUREMENT
/begin MEASUREMENT iUl2K0SPlausiDrehzInt.diff_n_em "Differenz zwischen E-Maschinendrehzahl nachdem der Störzähler über der applizierten Schwelle MAXSTOER_EDSLOGIK_K0 liegt." UWORD UMR_U_MIN_1_1_0_S5_S3 1 100 0 65535 ECU_ADDRESS 0xFFF8D5BE DISPLAY_IDENTIFIER diff_n_em.iUl2K0SPlausiDrehzInt /end MEASUREMENT
/begin MEASUREMENT iUl2K0SPlausiDrehzInt.n_emeink0_n "Wert der E-Maschinendrehzahl zu Beginn der Überwachung" UWORD UMR_U_MIN_1_1_0_S5_S3 1 100 0 65535 ECU_ADDRESS 0xFFF8D5BC DISPLAY_IDENTIFIER n_emeink0_n.iUl2K0SPlausiDrehzInt /end MEASUREMENT
/begin MEASUREMENT iUl2K0SPlausiMomFl.cUl2K0SPlausiFl._.n_diff_k0 "Differenz zwischen E-Maschinendrehz. u. Verbrennungsmotoerdrehz." FLOAT32_IEEE UMR_U_MIN_1_1_0_S5_S3 1 100 0 65535 ECU_ADDRESS 0xFFF8D600 DISPLAY_IDENTIFIER n_diff_k0._.cUl2K0SPlausiFl.iUl2K0SPlausiMomFl /end MEASUREMENT
/begin MEASUREMENT iUl2K0SPlausiMomFl.cUl2K0SPlausiFl._.n_diff_k0_einmalig "Wenn der Wert auf TRUE steht, dann wird die Überwachung gestartet." FLOAT32_IEEE UMR___1_1_0_S5_S3 1 100 0 1 ECU_ADDRESS 0xFFF8D604 FORMAT "%3.2" DISPLAY_IDENTIFIER n_diff_k0_einmalig._.cUl2K0SPlausiFl.iUl2K0SPlausiMomFl /end MEASUREMENT
/begin MEASUREMENT iUl2K0SPlausiMomFl.cUl2K0SPlausiFl._.n_i_eds_k0_bed "Bedingung, nach wieviel Zyklen die Kupplung wieder als offen erkannt wird" FLOAT32_IEEE UMR___1_1_0_S5_S3 1 100 0 256 ECU_ADDRESS 0xFFF8D610 FORMAT "%3.2" DISPLAY_IDENTIFIER n_i_eds_k0_bed._.cUl2K0SPlausiFl.iUl2K0SPlausiMomFl /end MEASUREMENT
/begin MEASUREMENT iUl2K0SPlausiMomFl.cUl2K0SPlausiFl._.n_k0ueb "Tasks die der Strom an der K0 unterhalb der Schwelle I_MAXK0 liegt. Bei 0 wird wieder in die Funktion eingestiegen." FLOAT32_IEEE UMR___1_1_0_S5_S3 1 100 0 3 ECU_ADDRESS 0xFFF8D614 FORMAT "%3.2" DISPLAY_IDENTIFIER n_k0ueb._.cUl2K0SPlausiFl.iUl2K0SPlausiMomFl /end MEASUREMENT
/begin MEASUREMENT iUl2K0SPlausiMomFl.cUl2K0SPlausiFl._.n_stoeredslogik_k0 "Störzähler, der angibt ob überwacht wird" FLOAT32_IEEE UMR___1_1_0_S5_S3 1 100 0 65535 ECU_ADDRESS 0xFFF8D60C FORMAT "%3.2" DISPLAY_IDENTIFIER n_stoeredslogik_k0._.cUl2K0SPlausiFl.iUl2K0SPlausiMomFl /end MEASUREMENT
/begin MEASUREMENT iUl2K0SPlausiMomFl.cUl2K0SPlausiFl._.st_fehler "Gibt an ob ein Fehler vorhanden ist" FLOAT32_IEEE UMR___1_1_0_S5_S3 1 100 0 2 ECU_ADDRESS 0xFFF8D608 FORMAT "%3.2" DISPLAY_IDENTIFIER st_fehler._.cUl2K0SPlausiFl.iUl2K0SPlausiMomFl /end MEASUREMENT
/begin MEASUREMENT iUl2K0SPlausiMomFl.k0_energie_min_reibw_skal "Energie zu Beginn der Überwachung minus dem applizierten Reibwert. und mit 10ms (mal 100) skaliert so. Damit entfällt die Division bei der Berechnung der Summe der Momente." FLOAT32_IEEE UMR_NM__1_1_0_S5_S3 1 100 -32768 32767 ECU_ADDRESS 0xFFF8D620 DISPLAY_IDENTIFIER k0_energie_min_reibw_skal.iUl2K0SPlausiMomFl /end MEASUREMENT
/begin MEASUREMENT iUl2K0SPlausiMomFl.n_emeink0_m "Differenzdrehzahl zwischen E-Maschine und Verbrennungsmotor" FLOAT32_IEEE UMR_U_MIN_1_1_0_S5_S3 1 100 0 65535 ECU_ADDRESS 0xFFF8D61C DISPLAY_IDENTIFIER n_emeink0_m.iUl2K0SPlausiMomFl /end MEASUREMENT
/begin MEASUREMENT iUl2K0SPlausiMomFl.summe_momente "Summe der Momente während der Überwachung." FLOAT32_IEEE UMR_NM__1_1_0_S5_S3 1 100 0 4194304 ECU_ADDRESS 0xFFF8D624 DISPLAY_IDENTIFIER summe_momente.iUl2K0SPlausiMomFl /end MEASUREMENT
/begin MEASUREMENT iUl2K0SPlausiMomInt.cUl2K0SPlausiInt._.n_diff_k0 "Differenz zwischen E-Maschinendrehz. u. Verbrennungsmotoerdrehz." SLONG UMR_U_MIN_1_1_0_S5_S3 1 100 0 65535 ECU_ADDRESS 0xFFF8D5C0 DISPLAY_IDENTIFIER n_diff_k0._.cUl2K0SPlausiInt.iUl2K0SPlausiMomInt /end MEASUREMENT
/begin MEASUREMENT iUl2K0SPlausiMomInt.cUl2K0SPlausiInt._.n_diff_k0_einmalig "Wenn der Wert auf TRUE steht, dann wird die Überwachung gestartet." UBYTE Conv.cUl2K0SPlausiInt._.n_diff_k0_einmalig_S5_S3 1 100 0 1 BIT_MASK 0x1 ECU_ADDRESS 0xFFF8D5C4 DISPLAY_IDENTIFIER n_diff_k0_einmalig._.cUl2K0SPlausiInt.iUl2K0SPlausiMomInt /end MEASUREMENT
/begin MEASUREMENT iUl2K0SPlausiMomInt.cUl2K0SPlausiInt._.n_i_eds_k0_bed "Bedingung, nach wieviel Zyklen die Kupplung wieder als offen erkannt wird" UWORD UMR___1_1_0_S5_S3 1 100 0 256 ECU_ADDRESS 0xFFF8D5C8 DISPLAY_IDENTIFIER n_i_eds_k0_bed._.cUl2K0SPlausiInt.iUl2K0SPlausiMomInt /end MEASUREMENT
/begin MEASUREMENT iUl2K0SPlausiMomInt.cUl2K0SPlausiInt._.n_k0ueb "Tasks die der Strom an der K0 unterhalb der Schwelle I_MAXK0 liegt. Bei 0 wird wieder in die Funktion eingestiegen." UBYTE UMR___1_1_0_S5_S3 1 100 0 3 ECU_ADDRESS 0xFFF8D5CA DISPLAY_IDENTIFIER n_k0ueb._.cUl2K0SPlausiInt.iUl2K0SPlausiMomInt /end MEASUREMENT
/begin MEASUREMENT iUl2K0SPlausiMomInt.cUl2K0SPlausiInt._.n_stoeredslogik_k0 "Störzähler, der angibt ob überwacht wird" UWORD UMR___1_1_0_S5_S3 1 100 0 65535 ECU_ADDRESS 0xFFF8D5C6 DISPLAY_IDENTIFIER n_stoeredslogik_k0._.cUl2K0SPlausiInt.iUl2K0SPlausiMomInt /end MEASUREMENT
/begin MEASUREMENT iUl2K0SPlausiMomInt.cUl2K0SPlausiInt._.st_fehler "Gibt an ob ein Fehler vorhanden ist" UBYTE Conv.cUl2K0SPlausiInt._.st_fehler_S5_S3 1 100 0 2 ECU_ADDRESS 0xFFF8D5C5 DISPLAY_IDENTIFIER st_fehler._.cUl2K0SPlausiInt.iUl2K0SPlausiMomInt /end MEASUREMENT
/begin MEASUREMENT iUl2K0SPlausiMomInt.k0_energie_min_reibw_skal "Energie zu Beginn der Überwachung minus dem applizierten Reibwert. und mit 10ms (mal 100) skaliert so. Damit entfällt die Division bei der Berechnung der Summe der Momente." SLONG UMR_NM__1_1_0_S5_S3 1 100 -32768 32767 ECU_ADDRESS 0xFFF8D5D4 DISPLAY_IDENTIFIER k0_energie_min_reibw_skal.iUl2K0SPlausiMomInt /end MEASUREMENT
/begin MEASUREMENT iUl2K0SPlausiMomInt.n_emeink0_m "Differenzdrehzahl zwischen E-Maschine und Verbrennungsmotor" UWORD UMR_U_MIN_1_1_0_S5_S3 1 100 0 65535 ECU_ADDRESS 0xFFF8D5D0 DISPLAY_IDENTIFIER n_emeink0_m.iUl2K0SPlausiMomInt /end MEASUREMENT
/begin MEASUREMENT iUl2K0SPlausiMomInt.summe_momente "Summe der Momente während der Überwachung." SLONG UMR_NM__1_1_0_S5_S3 1 100 0 4194304 ECU_ADDRESS 0xFFF8D5D8 DISPLAY_IDENTIFIER summe_momente.iUl2K0SPlausiMomInt /end MEASUREMENT
/begin RECORD_LAYOUT ZF_TAB_INT8_S1_S3 FNC_VALUES 2 SBYTE COLUMN_DIR DIRECT NO_AXIS_PTS_X 1 ULONG /end RECORD_LAYOUT
/begin RECORD_LAYOUT ZF_TAB_INT8_S2_S3 FNC_VALUES 2 SBYTE COLUMN_DIR DIRECT NO_AXIS_PTS_X 1 ULONG /end RECORD_LAYOUT
/begin RECORD_LAYOUT ZF_TAB_INT8_S3_S3 FNC_VALUES 2 SBYTE COLUMN_DIR DIRECT NO_AXIS_PTS_X 1 ULONG /end RECORD_LAYOUT
/begin RECORD_LAYOUT ZF_TAB_INT8_S4_S3 FNC_VALUES 2 SBYTE COLUMN_DIR DIRECT NO_AXIS_PTS_X 1 ULONG /end RECORD_LAYOUT
/begin RECORD_LAYOUT ZF_TAB_NAT16_S3_S3 FNC_VALUES 2 UWORD COLUMN_DIR DIRECT NO_AXIS_PTS_X 1 ULONG /end RECORD_LAYOUT
/begin RECORD_LAYOUT ZF_TAB_NAT32_S1_S3 FNC_VALUES 2 ULONG COLUMN_DIR DIRECT NO_AXIS_PTS_X 1 ULONG /end RECORD_LAYOUT
/begin RECORD_LAYOUT ZF_TAB_NAT32_S3_S3 FNC_VALUES 2 ULONG COLUMN_DIR DIRECT NO_AXIS_PTS_X 1 ULONG /end RECORD_LAYOUT
/begin RECORD_LAYOUT ZF_TAB_NAT32_S4_S3 FNC_VALUES 2 ULONG COLUMN_DIR DIRECT NO_AXIS_PTS_X 1 ULONG /end RECORD_LAYOUT
/begin RECORD_LAYOUT ZF_TAB_OI_INT16_S2_S3 FNC_VALUES 1 SWORD COLUMN_DIR DIRECT /end RECORD_LAYOUT
/begin RECORD_LAYOUT ZF_TAB_OI_INT16_S3_S3 FNC_VALUES 1 SWORD COLUMN_DIR DIRECT /end RECORD_LAYOUT
/begin RECORD_LAYOUT ZF_TAB_OI_INT16_S4_S3 FNC_VALUES 1 SWORD COLUMN_DIR DIRECT /end RECORD_LAYOUT
/begin RECORD_LAYOUT ZF_TAB_OI_INT32_S2_S3 FNC_VALUES 1 SLONG COLUMN_DIR DIRECT /end RECORD_LAYOUT
/begin RECORD_LAYOUT ZF_TAB_OI_INT32_S3_S3 FNC_VALUES 1 SLONG COLUMN_DIR DIRECT /end RECORD_LAYOUT
/begin RECORD_LAYOUT ZF_TAB_OI_INT32_S4_S3 FNC_VALUES 1 SLONG COLUMN_DIR DIRECT /end RECORD_LAYOUT
/begin RECORD_LAYOUT ZF_TAB_OI_INT8_S2_S3 FNC_VALUES 1 SBYTE COLUMN_DIR DIRECT /end RECORD_LAYOUT
/begin RECORD_LAYOUT ZF_TAB_OI_INT8_S3_S3 FNC_VALUES 1 SBYTE COLUMN_DIR DIRECT /end RECORD_LAYOUT
/begin RECORD_LAYOUT ZF_TAB_OI_INT8_S4_S3 FNC_VALUES 1 SBYTE COLUMN_DIR DIRECT /end RECORD_LAYOUT
/begin RECORD_LAYOUT ZF_TAB_OI_NAT16_S2_S3 FNC_VALUES 1 UWORD COLUMN_DIR DIRECT /end RECORD_LAYOUT
/begin RECORD_LAYOUT ZF_TAB_OI_NAT16_S3_S3 FNC_VALUES 1 UWORD COLUMN_DIR DIRECT /end RECORD_LAYOUT
/begin RECORD_LAYOUT ZF_TAB_OI_NAT32_S2_S3 FNC_VALUES 1 ULONG COLUMN_DIR DIRECT /end RECORD_LAYOUT
/begin RECORD_LAYOUT ZF_TAB_OI_NAT32_S3_S3 FNC_VALUES 1 ULONG COLUMN_DIR DIRECT /end RECORD_LAYOUT
/begin RECORD_LAYOUT ZF_TAB_OI_NAT32_S4_S3 FNC_VALUES 1 ULONG COLUMN_DIR DIRECT /end RECORD_LAYOUT
/end MODULE
/end PROJECT
