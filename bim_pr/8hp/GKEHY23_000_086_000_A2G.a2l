ASAP2_VERSION 1 51
/begin PROJECT ZHBC8600 "Gen2_BMW_System_Supplier_Lib"
/begin MODULE CPP ""
/begin MOD_COMMON "" BYTE_ORDER MSB_FIRST ALIGNMENT_BYTE 1 ALIGNMENT_WORD 2 ALIGNMENT_LONG 4 ALIGNMENT_FLOAT32_IEEE 4 ALIGNMENT_FLOAT64_IEEE 1 /end MOD_COMMON
/begin COMPU_METHOD EH_STANDARD_S4_S3 "int = ((phys * 1) / 1) - (0) -" RAT_FUNC "%1.0" "-" COEFFS 0 1 0 0 0 1 /end COMPU_METHOD
/begin COMPU_METHOD SAB_N_2RPM_S2_S3 "int = ((phys * 1) / 2) - (0) 1/min" RAT_FUNC "%4.3" "1/min" COEFFS 0 0.5 0 0 0 1 /end COMPU_METHOD
/begin COMPU_METHOD SAB_N_3RPM20_S2_S3 "int = ((phys * 20) / 3) - (0) 1/min" RAT_FUNC "%4.3" "1/min" COEFFS 0 6.66666666667 0 0 0 1 /end COMPU_METHOD
/begin COMPU_METHOD SAB_N_417RPM10000_S2_S3 "int = ((phys * 10000) / 417) - (0) 1/min" RAT_FUNC "%4.3" "1/min" COEFFS 0 23.9808153477 0 0 0 1 /end COMPU_METHOD
/begin COMPU_METHOD SAB_N_4RPM_P500_S2_S3 "int = ((phys * 1) / 4) - (-500) U/min" RAT_FUNC "%4.3" "U/min" COEFFS 0 0.25 500 0 0 1 /end COMPU_METHOD
/begin COMPU_METHOD SAB_N_4RPM_S2_S3 "int = ((phys * 1) / 4) - (0) 1/min" RAT_FUNC "%4.3" "1/min" COEFFS 0 0.25 0 0 0 1 /end COMPU_METHOD
/begin COMPU_METHOD SAB_N_64RPM_S2_S3 "int = ((phys * 1) / 64) - (0) 1/min" RAT_FUNC "%4.3" "1/min" COEFFS 0 0.015625 0 0 0 1 /end COMPU_METHOD
/begin COMPU_METHOD SAB_N_8RPM_S2_S3 "int = ((phys * 1) / 8) - (0) 1/min" RAT_FUNC "%4.3" "1/min" COEFFS 0 0.125 0 0 0 1 /end COMPU_METHOD
/begin COMPU_METHOD SAB_N_GRADPS10_S2_S3 "int = ((phys * 10) / 1) - (0) Grad/s" RAT_FUNC "%4.3" "Grad/s" COEFFS 0 10 0 0 0 1 /end COMPU_METHOD
/begin COMPU_METHOD SAB_N_RPM10_S2_S3 "int = ((phys * 10) / 1) - (0) 1/min" RAT_FUNC "%4.3" "1/min" COEFFS 0 10 0 0 0 1 /end COMPU_METHOD
/begin COMPU_METHOD SAB_N_RPM24_S2_S3 "int = ((phys * 24) / 1) - (0) U/min" RAT_FUNC "%4.3" "U/min" COEFFS 0 24 0 0 0 1 /end COMPU_METHOD
/begin COMPU_METHOD SAB_N_RPM25_S2_S3 "int = ((phys * 25) / 1) - (0) U/min" RAT_FUNC "%4.3" "U/min" COEFFS 0 25 0 0 0 1 /end COMPU_METHOD
/begin COMPU_METHOD SAB_N_RPM2_M10000_S2_S3 "int = ((phys * 2) / 1) - (-20000) 1/min" RAT_FUNC "%4.3" "1/min" COEFFS 0 2 20000 0 0 1 /end COMPU_METHOD
/begin COMPU_METHOD SAB_N_RPM2_S2_S3 "int = ((phys * 2) / 1) - (0) 1/min" RAT_FUNC "%4.3" "1/min" COEFFS 0 2 0 0 0 1 /end COMPU_METHOD
/begin COMPU_METHOD SAB_N_RPM32_S2_S3 "int = ((phys * 32) / 1) - (0) 1/min" RAT_FUNC "%4.3" "1/min" COEFFS 0 32 0 0 0 1 /end COMPU_METHOD
/begin COMPU_METHOD SAB_N_RPM8_S2_S3 "int = ((phys * 8) / 1) - (0) 1/min" RAT_FUNC "%4.3" "1/min" COEFFS 0 8 0 0 0 1 /end COMPU_METHOD
/begin COMPU_METHOD SAB_N_RPM_M16382_S2_S3 "int = ((phys * 1) / 1) - (-16382) 1/min" RAT_FUNC "%1.0" "1/min" COEFFS 0 1 16382 0 0 1 /end COMPU_METHOD
/begin COMPU_METHOD SAB_N_RPM_S2_S3 "int = ((phys * 1) / 1) - (0) 1/min" RAT_FUNC "%1.0" "1/min" COEFFS 0 1 0 0 0 1 /end COMPU_METHOD
/begin COMPU_METHOD SAB_NG_100RPM_S2_S3 "int = ((phys * 1) / 100) - (0) 100rpm/sec" RAT_FUNC "%4.3" "100rpm/sec" COEFFS 0 0.01 0 0 0 1 /end COMPU_METHOD
/begin COMPU_METHOD SAB_OM_YAWRATE_1GRADPS10_M126_S2_S3 "int = ((phys * 10) / 1) - (-126) Grad/s" RAT_FUNC "%3.2" "Grad/s" COEFFS 0 10 126 0 0 1 /end COMPU_METHOD
/begin COMPU_METHOD SAB_OM_YAWRATE_GRADPS100_S2_S3 "int = ((phys * 100) / 1) - (0) Grad/s" RAT_FUNC "%3.2" "Grad/s" COEFFS 0 100 0 0 0 1 /end COMPU_METHOD
/begin COMPU_METHOD SAB_P_15HPA_P685_S2_S3 "int = ((phys * 1) / 15) - (45) hPa" RAT_FUNC "%4.3" "hPa" COEFFS 0 0.0666666666667 -45 0 0 1 /end COMPU_METHOD
/begin COMPU_METHOD SAB_P_1BAR_S2_S3 "int = ((phys * 1) / 1) - (0) bar" RAT_FUNC "%1.0" "bar" COEFFS 0 1 0 0 0 1 /end COMPU_METHOD
/begin COMPU_METHOD SAB_P_20KPA_S2_S3 "int = ((phys * 1) / 20) - (0) kPa" RAT_FUNC "%4.3" "kPa" COEFFS 0 0.05 0 0 0 1 /end COMPU_METHOD
/begin MEASUREMENT ZFEH_EepromData.ydiBackupMemory_xau16[8].amb_cond.ambient_condition[0][8] "ambient condition shot [0 .. 2-1] with 25 data bytes [0 .. 25-1] for the error code stored in this error memory slot" UBYTE EH_STANDARD_S4_S3 1 100 0 255 ECU_ADDRESS 0xFFF82AC0 DISPLAY_IDENTIFIER ambient_condition[0][8].amb_cond.ydiBackupMemory_xau16[8].ZFEH_EepromData /end MEASUREMENT
/begin MEASUREMENT ZFEH_EepromData.ydiBackupMemory_xau16[8].amb_cond.ambient_condition[0][9] "ambient condition shot [0 .. 2-1] with 25 data bytes [0 .. 25-1] for the error code stored in this error memory slot" UBYTE EH_STANDARD_S4_S3 1 100 0 255 ECU_ADDRESS 0xFFF82AC1 DISPLAY_IDENTIFIER ambient_condition[0][9].amb_cond.ydiBackupMemory_xau16[8].ZFEH_EepromData /end MEASUREMENT
/begin MEASUREMENT ZFEH_EepromData.ydiBackupMemory_xau16[8].amb_cond.ambient_condition[1][0] "ambient condition shot [0 .. 2-1] with 25 data bytes [0 .. 25-1] for the error code stored in this error memory slot" UBYTE EH_STANDARD_S4_S3 1 100 0 255 ECU_ADDRESS 0xFFF82AD1 DISPLAY_IDENTIFIER ambient_condition[1][0].amb_cond.ydiBackupMemory_xau16[8].ZFEH_EepromData /end MEASUREMENT
/begin MEASUREMENT ZFEH_EepromData.ydiBackupMemory_xau16[8].amb_cond.ambient_condition[1][10] "ambient condition shot [0 .. 2-1] with 25 data bytes [0 .. 25-1] for the error code stored in this error memory slot" UBYTE EH_STANDARD_S4_S3 1 100 0 255 ECU_ADDRESS 0xFFF82ADB DISPLAY_IDENTIFIER ambient_condition[1][10].amb_cond.ydiBackupMemory_xau16[8].ZFEH_EepromData /end MEASUREMENT
/begin MEASUREMENT ZFEH_EepromData.ydiBackupMemory_xau16[8].amb_cond.ambient_condition[1][11] "ambient condition shot [0 .. 2-1] with 25 data bytes [0 .. 25-1] for the error code stored in this error memory slot" UBYTE EH_STANDARD_S4_S3 1 100 0 255 ECU_ADDRESS 0xFFF82ADC DISPLAY_IDENTIFIER ambient_condition[1][11].amb_cond.ydiBackupMemory_xau16[8].ZFEH_EepromData /end MEASUREMENT
/begin MEASUREMENT ZFEH_EepromData.ydiBackupMemory_xau16[8].amb_cond.ambient_condition[1][12] "ambient condition shot [0 .. 2-1] with 25 data bytes [0 .. 25-1] for the error code stored in this error memory slot" UBYTE EH_STANDARD_S4_S3 1 100 0 255 ECU_ADDRESS 0xFFF82ADD DISPLAY_IDENTIFIER ambient_condition[1][12].amb_cond.ydiBackupMemory_xau16[8].ZFEH_EepromData /end MEASUREMENT
/begin MEASUREMENT ZFEH_EepromData.ydiBackupMemory_xau16[8].amb_cond.ambient_condition[1][13] "ambient condition shot [0 .. 2-1] with 25 data bytes [0 .. 25-1] for the error code stored in this error memory slot" UBYTE EH_STANDARD_S4_S3 1 100 0 255 ECU_ADDRESS 0xFFF82ADE DISPLAY_IDENTIFIER ambient_condition[1][13].amb_cond.ydiBackupMemory_xau16[8].ZFEH_EepromData /end MEASUREMENT
/begin MEASUREMENT ZFEH_EepromData.ydiBackupMemory_xau16[8].amb_cond.ambient_condition[1][14] "ambient condition shot [0 .. 2-1] with 25 data bytes [0 .. 25-1] for the error code stored in this error memory slot" UBYTE EH_STANDARD_S4_S3 1 100 0 255 ECU_ADDRESS 0xFFF82ADF DISPLAY_IDENTIFIER ambient_condition[1][14].amb_cond.ydiBackupMemory_xau16[8].ZFEH_EepromData /end MEASUREMENT
/begin MEASUREMENT ZFEH_EepromData.ydiBackupMemory_xau16[8].amb_cond.ambient_condition[1][15] "ambient condition shot [0 .. 2-1] with 25 data bytes [0 .. 25-1] for the error code stored in this error memory slot" UBYTE EH_STANDARD_S4_S3 1 100 0 255 ECU_ADDRESS 0xFFF82AE0 DISPLAY_IDENTIFIER ambient_condition[1][15].amb_cond.ydiBackupMemory_xau16[8].ZFEH_EepromData /end MEASUREMENT
/begin MEASUREMENT ZFEH_EepromData.ydiBackupMemory_xau16[8].amb_cond.ambient_condition[1][16] "ambient condition shot [0 .. 2-1] with 25 data bytes [0 .. 25-1] for the error code stored in this error memory slot" UBYTE EH_STANDARD_S4_S3 1 100 0 255 ECU_ADDRESS 0xFFF82AE1 DISPLAY_IDENTIFIER ambient_condition[1][16].amb_cond.ydiBackupMemory_xau16[8].ZFEH_EepromData /end MEASUREMENT
/begin MEASUREMENT ZFEH_EepromData.ydiBackupMemory_xau16[8].amb_cond.ambient_condition[1][17] "ambient condition shot [0 .. 2-1] with 25 data bytes [0 .. 25-1] for the error code stored in this error memory slot" UBYTE EH_STANDARD_S4_S3 1 100 0 255 ECU_ADDRESS 0xFFF82AE2 DISPLAY_IDENTIFIER ambient_condition[1][17].amb_cond.ydiBackupMemory_xau16[8].ZFEH_EepromData /end MEASUREMENT
/begin MEASUREMENT ZFEH_EepromData.ydiBackupMemory_xau16[8].amb_cond.ambient_condition[1][18] "ambient condition shot [0 .. 2-1] with 25 data bytes [0 .. 25-1] for the error code stored in this error memory slot" UBYTE EH_STANDARD_S4_S3 1 100 0 255 ECU_ADDRESS 0xFFF82AE3 DISPLAY_IDENTIFIER ambient_condition[1][18].amb_cond.ydiBackupMemory_xau16[8].ZFEH_EepromData /end MEASUREMENT
/begin MEASUREMENT ZFEH_EepromData.ydiBackupMemory_xau16[8].amb_cond.ambient_condition[1][19] "ambient condition shot [0 .. 2-1] with 25 data bytes [0 .. 25-1] for the error code stored in this error memory slot" UBYTE EH_STANDARD_S4_S3 1 100 0 255 ECU_ADDRESS 0xFFF82AE4 DISPLAY_IDENTIFIER ambient_condition[1][19].amb_cond.ydiBackupMemory_xau16[8].ZFEH_EepromData /end MEASUREMENT
/begin MEASUREMENT ZFEH_EepromData.ydiBackupMemory_xau16[8].amb_cond.ambient_condition[1][1] "ambient condition shot [0 .. 2-1] with 25 data bytes [0 .. 25-1] for the error code stored in this error memory slot" UBYTE EH_STANDARD_S4_S3 1 100 0 255 ECU_ADDRESS 0xFFF82AD2 DISPLAY_IDENTIFIER ambient_condition[1][1].amb_cond.ydiBackupMemory_xau16[8].ZFEH_EepromData /end MEASUREMENT
/begin MEASUREMENT ZFEH_EepromData.ydiBackupMemory_xau16[8].amb_cond.ambient_condition[1][20] "ambient condition shot [0 .. 2-1] with 25 data bytes [0 .. 25-1] for the error code stored in this error memory slot" UBYTE EH_STANDARD_S4_S3 1 100 0 255 ECU_ADDRESS 0xFFF82AE5 DISPLAY_IDENTIFIER ambient_condition[1][20].amb_cond.ydiBackupMemory_xau16[8].ZFEH_EepromData /end MEASUREMENT
/begin MEASUREMENT ZFEH_EepromData.ydiBackupMemory_xau16[8].amb_cond.ambient_condition[1][21] "ambient condition shot [0 .. 2-1] with 25 data bytes [0 .. 25-1] for the error code stored in this error memory slot" UBYTE EH_STANDARD_S4_S3 1 100 0 255 ECU_ADDRESS 0xFFF82AE6 DISPLAY_IDENTIFIER ambient_condition[1][21].amb_cond.ydiBackupMemory_xau16[8].ZFEH_EepromData /end MEASUREMENT
/begin MEASUREMENT ZFEH_EepromData.ydiBackupMemory_xau16[8].amb_cond.ambient_condition[1][22] "ambient condition shot [0 .. 2-1] with 25 data bytes [0 .. 25-1] for the error code stored in this error memory slot" UBYTE EH_STANDARD_S4_S3 1 100 0 255 ECU_ADDRESS 0xFFF82AE7 DISPLAY_IDENTIFIER ambient_condition[1][22].amb_cond.ydiBackupMemory_xau16[8].ZFEH_EepromData /end MEASUREMENT
/begin MEASUREMENT ZFEH_EepromData.ydiBackupMemory_xau16[8].amb_cond.ambient_condition[1][23] "ambient condition shot [0 .. 2-1] with 25 data bytes [0 .. 25-1] for the error code stored in this error memory slot" UBYTE EH_STANDARD_S4_S3 1 100 0 255 ECU_ADDRESS 0xFFF82AE8 DISPLAY_IDENTIFIER ambient_condition[1][23].amb_cond.ydiBackupMemory_xau16[8].ZFEH_EepromData /end MEASUREMENT
/begin MEASUREMENT ZFEH_EepromData.ydiBackupMemory_xau16[8].amb_cond.ambient_condition[1][24] "ambient condition shot [0 .. 2-1] with 25 data bytes [0 .. 25-1] for the error code stored in this error memory slot" UBYTE EH_STANDARD_S4_S3 1 100 0 255 ECU_ADDRESS 0xFFF82AE9 DISPLAY_IDENTIFIER ambient_condition[1][24].amb_cond.ydiBackupMemory_xau16[8].ZFEH_EepromData /end MEASUREMENT
/begin MEASUREMENT ZFEH_EepromData.ydiBackupMemory_xau16[8].amb_cond.ambient_condition[1][2] "ambient condition shot [0 .. 2-1] with 25 data bytes [0 .. 25-1] for the error code stored in this error memory slot" UBYTE EH_STANDARD_S4_S3 1 100 0 255 ECU_ADDRESS 0xFFF82AD3 DISPLAY_IDENTIFIER ambient_condition[1][2].amb_cond.ydiBackupMemory_xau16[8].ZFEH_EepromData /end MEASUREMENT
/begin MEASUREMENT ZFEH_EepromData.ydiBackupMemory_xau16[8].amb_cond.ambient_condition[1][3] "ambient condition shot [0 .. 2-1] with 25 data bytes [0 .. 25-1] for the error code stored in this error memory slot" UBYTE EH_STANDARD_S4_S3 1 100 0 255 ECU_ADDRESS 0xFFF82AD4 DISPLAY_IDENTIFIER ambient_condition[1][3].amb_cond.ydiBackupMemory_xau16[8].ZFEH_EepromData /end MEASUREMENT
/begin MEASUREMENT ZFEH_EepromData.ydiBackupMemory_xau16[8].amb_cond.ambient_condition[1][4] "ambient condition shot [0 .. 2-1] with 25 data bytes [0 .. 25-1] for the error code stored in this error memory slot" UBYTE EH_STANDARD_S4_S3 1 100 0 255 ECU_ADDRESS 0xFFF82AD5 DISPLAY_IDENTIFIER ambient_condition[1][4].amb_cond.ydiBackupMemory_xau16[8].ZFEH_EepromData /end MEASUREMENT
/begin MEASUREMENT ZFEH_EepromData.ydiBackupMemory_xau16[8].amb_cond.ambient_condition[1][5] "ambient condition shot [0 .. 2-1] with 25 data bytes [0 .. 25-1] for the error code stored in this error memory slot" UBYTE EH_STANDARD_S4_S3 1 100 0 255 ECU_ADDRESS 0xFFF82AD6 DISPLAY_IDENTIFIER ambient_condition[1][5].amb_cond.ydiBackupMemory_xau16[8].ZFEH_EepromData /end MEASUREMENT
/begin MEASUREMENT ZFEH_EepromData.ydiBackupMemory_xau16[8].amb_cond.ambient_condition[1][6] "ambient condition shot [0 .. 2-1] with 25 data bytes [0 .. 25-1] for the error code stored in this error memory slot" UBYTE EH_STANDARD_S4_S3 1 100 0 255 ECU_ADDRESS 0xFFF82AD7 DISPLAY_IDENTIFIER ambient_condition[1][6].amb_cond.ydiBackupMemory_xau16[8].ZFEH_EepromData /end MEASUREMENT
/begin MEASUREMENT ZFEH_EepromData.ydiBackupMemory_xau16[8].amb_cond.ambient_condition[1][7] "ambient condition shot [0 .. 2-1] with 25 data bytes [0 .. 25-1] for the error code stored in this error memory slot" UBYTE EH_STANDARD_S4_S3 1 100 0 255 ECU_ADDRESS 0xFFF82AD8 DISPLAY_IDENTIFIER ambient_condition[1][7].amb_cond.ydiBackupMemory_xau16[8].ZFEH_EepromData /end MEASUREMENT
/begin MEASUREMENT ZFEH_EepromData.ydiBackupMemory_xau16[8].amb_cond.ambient_condition[1][8] "ambient condition shot [0 .. 2-1] with 25 data bytes [0 .. 25-1] for the error code stored in this error memory slot" UBYTE EH_STANDARD_S4_S3 1 100 0 255 ECU_ADDRESS 0xFFF82AD9 DISPLAY_IDENTIFIER ambient_condition[1][8].amb_cond.ydiBackupMemory_xau16[8].ZFEH_EepromData /end MEASUREMENT
/begin MEASUREMENT ZFEH_EepromData.ydiBackupMemory_xau16[8].amb_cond.ambient_condition[1][9] "ambient condition shot [0 .. 2-1] with 25 data bytes [0 .. 25-1] for the error code stored in this error memory slot" UBYTE EH_STANDARD_S4_S3 1 100 0 255 ECU_ADDRESS 0xFFF82ADA DISPLAY_IDENTIFIER ambient_condition[1][9].amb_cond.ydiBackupMemory_xau16[8].ZFEH_EepromData /end MEASUREMENT
/begin MEASUREMENT ZFEH_EepromData.ydiBackupMemory_xau16[8].amb_cond.status_of_ambient_conditions[0] "status of ambient condition shot x: 0=invalid 1=valid" UBYTE EH_STANDARD_S4_S3 1 100 0 1 ECU_ADDRESS 0xFFF82AEA DISPLAY_IDENTIFIER status_of_ambient_conditions[0].amb_cond.ydiBackupMemory_xau16[8].ZFEH_EepromData /end MEASUREMENT
/begin MEASUREMENT ZFEH_EepromData.ydiBackupMemory_xau16[8].amb_cond.status_of_ambient_conditions[1] "status of ambient condition shot x: 0=invalid 1=valid" UBYTE EH_STANDARD_S4_S3 1 100 0 1 ECU_ADDRESS 0xFFF82AEB DISPLAY_IDENTIFIER status_of_ambient_conditions[1].amb_cond.ydiBackupMemory_xau16[8].ZFEH_EepromData /end MEASUREMENT
/begin MEASUREMENT ZFEH_EepromData.ydiBackupMemory_xau16[8].backwards_counter "backwards counter of error code stored in error memory slot" UBYTE EH_STANDARD_S4_S3 1 100 0 255 ECU_ADDRESS 0xFFF82AAB DISPLAY_IDENTIFIER backwards_counter.ydiBackupMemory_xau16[8].ZFEH_EepromData /end MEASUREMENT
/begin MEASUREMENT ZFEH_EepromData.ydiBackupMemory_xau16[8].condition_byte "condition byte of error code stored in error memory slot" UBYTE EH_STANDARD_S4_S3 1 100 0 255 ECU_ADDRESS 0xFFF82AB5 DISPLAY_IDENTIFIER condition_byte.ydiBackupMemory_xau16[8].ZFEH_EepromData /end MEASUREMENT
/begin MEASUREMENT ZFEH_EepromData.ydiBackupMemory_xau16[8].error_code "error code stored in error memory slot" UWORD EH_STANDARD_S4_S3 1 100 0 65535 ECU_ADDRESS 0xFFF82AA4 DISPLAY_IDENTIFIER error_code.ydiBackupMemory_xau16[8].ZFEH_EepromData /end MEASUREMENT
/begin MEASUREMENT ZFEH_EepromData.ydiBackupMemory_xau16[8].error_type "error type of error code stored in error memory slot" UWORD EH_STANDARD_S4_S3 1 100 0 65535 ECU_ADDRESS 0xFFF82AA6 DISPLAY_IDENTIFIER error_type.ydiBackupMemory_xau16[8].ZFEH_EepromData /end MEASUREMENT
/begin MEASUREMENT ZFEH_EepromData.ydiBackupMemory_xau16[8].frequency_counter "frequency counter of error code stored in error memory slot" UBYTE EH_STANDARD_S4_S3 1 100 0 255 ECU_ADDRESS 0xFFF82AAA DISPLAY_IDENTIFIER frequency_counter.ydiBackupMemory_xau16[8].ZFEH_EepromData /end MEASUREMENT
/begin MEASUREMENT ZFEH_EepromData.ydiBackupMemory_xau16[8].master_time "master time of error code stored in error memory slot" ULONG EH_STANDARD_S4_S3 1 100 0 4294967295 ECU_ADDRESS 0xFFF82AB0 DISPLAY_IDENTIFIER master_time.ydiBackupMemory_xau16[8].ZFEH_EepromData /end MEASUREMENT
/begin MEASUREMENT ZFEH_EepromData.ydiBackupMemory_xau16[8].obd_driving_cycle_counter "obd driving cycle counter of error code stored in error memory slot" UWORD EH_STANDARD_S4_S3 1 100 0 65535 ECU_ADDRESS 0xFFF82AB6 DISPLAY_IDENTIFIER obd_driving_cycle_counter.ydiBackupMemory_xau16[8].ZFEH_EepromData /end MEASUREMENT
/begin MEASUREMENT ZFEH_EepromData.ydiBackupMemory_xau16[8].permanent_counter "counter of permanent error codes stored in error memory slot" UBYTE EH_STANDARD_S4_S3 1 100 0 255 ECU_ADDRESS 0xFFF82AAC DISPLAY_IDENTIFIER permanent_counter.ydiBackupMemory_xau16[8].ZFEH_EepromData /end MEASUREMENT
/begin MEASUREMENT ZFEH_EepromData.ydiBackupMemory_xau16[8].sequence_counter "sequence counter of error code stored in error memory slot" UBYTE EH_STANDARD_S4_S3 1 100 0 255 ECU_ADDRESS 0xFFF82AAD DISPLAY_IDENTIFIER sequence_counter.ydiBackupMemory_xau16[8].ZFEH_EepromData /end MEASUREMENT
/begin MEASUREMENT ZFEH_EepromData.ydiBackupMemory_xau16[8].status_word "status word of error code stored in error memory slot" UWORD EH_STANDARD_S4_S3 1 100 0 65535 ECU_ADDRESS 0xFFF82AA8 DISPLAY_IDENTIFIER status_word.ydiBackupMemory_xau16[8].ZFEH_EepromData /end MEASUREMENT
/begin MEASUREMENT ZFEH_EepromData.ydiBackupMemory_xau16[9].amb_cond.ambient_condition[0][0] "ambient condition shot [0 .. 2-1] with 25 data bytes [0 .. 25-1] for the error code stored in this error memory slot" UBYTE EH_STANDARD_S4_S3 1 100 0 255 ECU_ADDRESS 0xFFF82B00 DISPLAY_IDENTIFIER ambient_condition[0][0].amb_cond.ydiBackupMemory_xau16[9].ZFEH_EepromData /end MEASUREMENT
/begin MEASUREMENT ZFEH_EepromData.ydiBackupMemory_xau16[9].amb_cond.ambient_condition[0][10] "ambient condition shot [0 .. 2-1] with 25 data bytes [0 .. 25-1] for the error code stored in this error memory slot" UBYTE EH_STANDARD_S4_S3 1 100 0 255 ECU_ADDRESS 0xFFF82B0A DISPLAY_IDENTIFIER ambient_condition[0][10].amb_cond.ydiBackupMemory_xau16[9].ZFEH_EepromData /end MEASUREMENT
/begin MEASUREMENT ZFEH_EepromData.ydiBackupMemory_xau16[9].amb_cond.ambient_condition[0][11] "ambient condition shot [0 .. 2-1] with 25 data bytes [0 .. 25-1] for the error code stored in this error memory slot" UBYTE EH_STANDARD_S4_S3 1 100 0 255 ECU_ADDRESS 0xFFF82B0B DISPLAY_IDENTIFIER ambient_condition[0][11].amb_cond.ydiBackupMemory_xau16[9].ZFEH_EepromData /end MEASUREMENT
/begin MEASUREMENT ZFEH_EepromData.ydiBackupMemory_xau16[9].amb_cond.ambient_condition[0][12] "ambient condition shot [0 .. 2-1] with 25 data bytes [0 .. 25-1] for the error code stored in this error memory slot" UBYTE EH_STANDARD_S4_S3 1 100 0 255 ECU_ADDRESS 0xFFF82B0C DISPLAY_IDENTIFIER ambient_condition[0][12].amb_cond.ydiBackupMemory_xau16[9].ZFEH_EepromData /end MEASUREMENT
/begin MEASUREMENT ZFEH_EepromData.ydiBackupMemory_xau16[9].amb_cond.ambient_condition[0][13] "ambient condition shot [0 .. 2-1] with 25 data bytes [0 .. 25-1] for the error code stored in this error memory slot" UBYTE EH_STANDARD_S4_S3 1 100 0 255 ECU_ADDRESS 0xFFF82B0D DISPLAY_IDENTIFIER ambient_condition[0][13].amb_cond.ydiBackupMemory_xau16[9].ZFEH_EepromData /end MEASUREMENT
/begin MEASUREMENT ZFEH_EepromData.ydiBackupMemory_xau16[9].amb_cond.ambient_condition[0][14] "ambient condition shot [0 .. 2-1] with 25 data bytes [0 .. 25-1] for the error code stored in this error memory slot" UBYTE EH_STANDARD_S4_S3 1 100 0 255 ECU_ADDRESS 0xFFF82B0E DISPLAY_IDENTIFIER ambient_condition[0][14].amb_cond.ydiBackupMemory_xau16[9].ZFEH_EepromData /end MEASUREMENT
/begin MEASUREMENT ZFEH_EepromData.ydiBackupMemory_xau16[9].amb_cond.ambient_condition[0][15] "ambient condition shot [0 .. 2-1] with 25 data bytes [0 .. 25-1] for the error code stored in this error memory slot" UBYTE EH_STANDARD_S4_S3 1 100 0 255 ECU_ADDRESS 0xFFF82B0F DISPLAY_IDENTIFIER ambient_condition[0][15].amb_cond.ydiBackupMemory_xau16[9].ZFEH_EepromData /end MEASUREMENT
/begin MEASUREMENT ZFEH_EepromData.ydiBackupMemory_xau16[9].amb_cond.ambient_condition[0][16] "ambient condition shot [0 .. 2-1] with 25 data bytes [0 .. 25-1] for the error code stored in this error memory slot" UBYTE EH_STANDARD_S4_S3 1 100 0 255 ECU_ADDRESS 0xFFF82B10 DISPLAY_IDENTIFIER ambient_condition[0][16].amb_cond.ydiBackupMemory_xau16[9].ZFEH_EepromData /end MEASUREMENT
/begin MEASUREMENT ZFEH_EepromData.ydiBackupMemory_xau16[9].amb_cond.ambient_condition[0][17] "ambient condition shot [0 .. 2-1] with 25 data bytes [0 .. 25-1] for the error code stored in this error memory slot" UBYTE EH_STANDARD_S4_S3 1 100 0 255 ECU_ADDRESS 0xFFF82B11 DISPLAY_IDENTIFIER ambient_condition[0][17].amb_cond.ydiBackupMemory_xau16[9].ZFEH_EepromData /end MEASUREMENT
/begin MEASUREMENT ZFEH_EepromData.ydiBackupMemory_xau16[9].amb_cond.ambient_condition[0][18] "ambient condition shot [0 .. 2-1] with 25 data bytes [0 .. 25-1] for the error code stored in this error memory slot" UBYTE EH_STANDARD_S4_S3 1 100 0 255 ECU_ADDRESS 0xFFF82B12 DISPLAY_IDENTIFIER ambient_condition[0][18].amb_cond.ydiBackupMemory_xau16[9].ZFEH_EepromData /end MEASUREMENT
/begin MEASUREMENT ZFEH_EepromData.ydiBackupMemory_xau16[9].amb_cond.ambient_condition[0][19] "ambient condition shot [0 .. 2-1] with 25 data bytes [0 .. 25-1] for the error code stored in this error memory slot" UBYTE EH_STANDARD_S4_S3 1 100 0 255 ECU_ADDRESS 0xFFF82B13 DISPLAY_IDENTIFIER ambient_condition[0][19].amb_cond.ydiBackupMemory_xau16[9].ZFEH_EepromData /end MEASUREMENT
/begin MEASUREMENT ZFEH_EepromData.ydiBackupMemory_xau16[9].amb_cond.ambient_condition[0][1] "ambient condition shot [0 .. 2-1] with 25 data bytes [0 .. 25-1] for the error code stored in this error memory slot" UBYTE EH_STANDARD_S4_S3 1 100 0 255 ECU_ADDRESS 0xFFF82B01 DISPLAY_IDENTIFIER ambient_condition[0][1].amb_cond.ydiBackupMemory_xau16[9].ZFEH_EepromData /end MEASUREMENT
/begin MEASUREMENT ZFEH_EepromData.ydiBackupMemory_xau16[9].amb_cond.ambient_condition[0][20] "ambient condition shot [0 .. 2-1] with 25 data bytes [0 .. 25-1] for the error code stored in this error memory slot" UBYTE EH_STANDARD_S4_S3 1 100 0 255 ECU_ADDRESS 0xFFF82B14 DISPLAY_IDENTIFIER ambient_condition[0][20].amb_cond.ydiBackupMemory_xau16[9].ZFEH_EepromData /end MEASUREMENT
/begin MEASUREMENT ZFEH_EepromData.ydiBackupMemory_xau16[9].amb_cond.ambient_condition[0][21] "ambient condition shot [0 .. 2-1] with 25 data bytes [0 .. 25-1] for the error code stored in this error memory slot" UBYTE EH_STANDARD_S4_S3 1 100 0 255 ECU_ADDRESS 0xFFF82B15 DISPLAY_IDENTIFIER ambient_condition[0][21].amb_cond.ydiBackupMemory_xau16[9].ZFEH_EepromData /end MEASUREMENT
/begin MEASUREMENT ZFEH_EepromData.ydiBackupMemory_xau16[9].amb_cond.ambient_condition[0][22] "ambient condition shot [0 .. 2-1] with 25 data bytes [0 .. 25-1] for the error code stored in this error memory slot" UBYTE EH_STANDARD_S4_S3 1 100 0 255 ECU_ADDRESS 0xFFF82B16 DISPLAY_IDENTIFIER ambient_condition[0][22].amb_cond.ydiBackupMemory_xau16[9].ZFEH_EepromData /end MEASUREMENT
/begin MEASUREMENT ZFEH_EepromData.ydiBackupMemory_xau16[9].amb_cond.ambient_condition[0][23] "ambient condition shot [0 .. 2-1] with 25 data bytes [0 .. 25-1] for the error code stored in this error memory slot" UBYTE EH_STANDARD_S4_S3 1 100 0 255 ECU_ADDRESS 0xFFF82B17 DISPLAY_IDENTIFIER ambient_condition[0][23].amb_cond.ydiBackupMemory_xau16[9].ZFEH_EepromData /end MEASUREMENT
/begin MEASUREMENT ZFEH_EepromData.ydiBackupMemory_xau16[9].amb_cond.ambient_condition[0][24] "ambient condition shot [0 .. 2-1] with 25 data bytes [0 .. 25-1] for the error code stored in this error memory slot" UBYTE EH_STANDARD_S4_S3 1 100 0 255 ECU_ADDRESS 0xFFF82B18 DISPLAY_IDENTIFIER ambient_condition[0][24].amb_cond.ydiBackupMemory_xau16[9].ZFEH_EepromData /end MEASUREMENT
/begin MEASUREMENT ZFEH_EepromData.ydiBackupMemory_xau16[9].amb_cond.ambient_condition[0][2] "ambient condition shot [0 .. 2-1] with 25 data bytes [0 .. 25-1] for the error code stored in this error memory slot" UBYTE EH_STANDARD_S4_S3 1 100 0 255 ECU_ADDRESS 0xFFF82B02 DISPLAY_IDENTIFIER ambient_condition[0][2].amb_cond.ydiBackupMemory_xau16[9].ZFEH_EepromData /end MEASUREMENT
/begin MEASUREMENT ZFEH_EepromData.ydiBackupMemory_xau16[9].amb_cond.ambient_condition[0][3] "ambient condition shot [0 .. 2-1] with 25 data bytes [0 .. 25-1] for the error code stored in this error memory slot" UBYTE EH_STANDARD_S4_S3 1 100 0 255 ECU_ADDRESS 0xFFF82B03 DISPLAY_IDENTIFIER ambient_condition[0][3].amb_cond.ydiBackupMemory_xau16[9].ZFEH_EepromData /end MEASUREMENT
/begin MEASUREMENT ZFEH_EepromData.ydiBackupMemory_xau16[9].amb_cond.ambient_condition[0][4] "ambient condition shot [0 .. 2-1] with 25 data bytes [0 .. 25-1] for the error code stored in this error memory slot" UBYTE EH_STANDARD_S4_S3 1 100 0 255 ECU_ADDRESS 0xFFF82B04 DISPLAY_IDENTIFIER ambient_condition[0][4].amb_cond.ydiBackupMemory_xau16[9].ZFEH_EepromData /end MEASUREMENT
/begin MEASUREMENT ZFEH_EepromData.ydiBackupMemory_xau16[9].amb_cond.ambient_condition[0][5] "ambient condition shot [0 .. 2-1] with 25 data bytes [0 .. 25-1] for the error code stored in this error memory slot" UBYTE EH_STANDARD_S4_S3 1 100 0 255 ECU_ADDRESS 0xFFF82B05 DISPLAY_IDENTIFIER ambient_condition[0][5].amb_cond.ydiBackupMemory_xau16[9].ZFEH_EepromData /end MEASUREMENT
/begin MEASUREMENT ZFEH_EepromData.ydiBackupMemory_xau16[9].amb_cond.ambient_condition[0][6] "ambient condition shot [0 .. 2-1] with 25 data bytes [0 .. 25-1] for the error code stored in this error memory slot" UBYTE EH_STANDARD_S4_S3 1 100 0 255 ECU_ADDRESS 0xFFF82B06 DISPLAY_IDENTIFIER ambient_condition[0][6].amb_cond.ydiBackupMemory_xau16[9].ZFEH_EepromData /end MEASUREMENT
/begin MEASUREMENT ZFEH_EepromData.ydiBackupMemory_xau16[9].amb_cond.ambient_condition[0][7] "ambient condition shot [0 .. 2-1] with 25 data bytes [0 .. 25-1] for the error code stored in this error memory slot" UBYTE EH_STANDARD_S4_S3 1 100 0 255 ECU_ADDRESS 0xFFF82B07 DISPLAY_IDENTIFIER ambient_condition[0][7].amb_cond.ydiBackupMemory_xau16[9].ZFEH_EepromData /end MEASUREMENT
/begin MEASUREMENT ZFEH_EepromData.ydiBackupMemory_xau16[9].amb_cond.ambient_condition[0][8] "ambient condition shot [0 .. 2-1] with 25 data bytes [0 .. 25-1] for the error code stored in this error memory slot" UBYTE EH_STANDARD_S4_S3 1 100 0 255 ECU_ADDRESS 0xFFF82B08 DISPLAY_IDENTIFIER ambient_condition[0][8].amb_cond.ydiBackupMemory_xau16[9].ZFEH_EepromData /end MEASUREMENT
/begin MEASUREMENT ZFEH_EepromData.ydiBackupMemory_xau16[9].amb_cond.ambient_condition[0][9] "ambient condition shot [0 .. 2-1] with 25 data bytes [0 .. 25-1] for the error code stored in this error memory slot" UBYTE EH_STANDARD_S4_S3 1 100 0 255 ECU_ADDRESS 0xFFF82B09 DISPLAY_IDENTIFIER ambient_condition[0][9].amb_cond.ydiBackupMemory_xau16[9].ZFEH_EepromData /end MEASUREMENT
/begin MEASUREMENT ZFEH_EepromData.ydiBackupMemory_xau16[9].amb_cond.ambient_condition[1][0] "ambient condition shot [0 .. 2-1] with 25 data bytes [0 .. 25-1] for the error code stored in this error memory slot" UBYTE EH_STANDARD_S4_S3 1 100 0 255 ECU_ADDRESS 0xFFF82B19 DISPLAY_IDENTIFIER ambient_condition[1][0].amb_cond.ydiBackupMemory_xau16[9].ZFEH_EepromData /end MEASUREMENT
/begin MEASUREMENT ZFEH_EepromData.ydiBackupMemory_xau16[9].amb_cond.ambient_condition[1][10] "ambient condition shot [0 .. 2-1] with 25 data bytes [0 .. 25-1] for the error code stored in this error memory slot" UBYTE EH_STANDARD_S4_S3 1 100 0 255 ECU_ADDRESS 0xFFF82B23 DISPLAY_IDENTIFIER ambient_condition[1][10].amb_cond.ydiBackupMemory_xau16[9].ZFEH_EepromData /end MEASUREMENT
/begin MEASUREMENT ZFEH_EepromData.ydiBackupMemory_xau16[9].amb_cond.ambient_condition[1][11] "ambient condition shot [0 .. 2-1] with 25 data bytes [0 .. 25-1] for the error code stored in this error memory slot" UBYTE EH_STANDARD_S4_S3 1 100 0 255 ECU_ADDRESS 0xFFF82B24 DISPLAY_IDENTIFIER ambient_condition[1][11].amb_cond.ydiBackupMemory_xau16[9].ZFEH_EepromData /end MEASUREMENT
/begin MEASUREMENT ZFEH_EepromData.ydiBackupMemory_xau16[9].amb_cond.ambient_condition[1][12] "ambient condition shot [0 .. 2-1] with 25 data bytes [0 .. 25-1] for the error code stored in this error memory slot" UBYTE EH_STANDARD_S4_S3 1 100 0 255 ECU_ADDRESS 0xFFF82B25 DISPLAY_IDENTIFIER ambient_condition[1][12].amb_cond.ydiBackupMemory_xau16[9].ZFEH_EepromData /end MEASUREMENT
/begin MEASUREMENT ZFEH_EepromData.ydiBackupMemory_xau16[9].amb_cond.ambient_condition[1][13] "ambient condition shot [0 .. 2-1] with 25 data bytes [0 .. 25-1] for the error code stored in this error memory slot" UBYTE EH_STANDARD_S4_S3 1 100 0 255 ECU_ADDRESS 0xFFF82B26 DISPLAY_IDENTIFIER ambient_condition[1][13].amb_cond.ydiBackupMemory_xau16[9].ZFEH_EepromData /end MEASUREMENT
/begin MEASUREMENT ZFEH_EepromData.ydiBackupMemory_xau16[9].amb_cond.ambient_condition[1][14] "ambient condition shot [0 .. 2-1] with 25 data bytes [0 .. 25-1] for the error code stored in this error memory slot" UBYTE EH_STANDARD_S4_S3 1 100 0 255 ECU_ADDRESS 0xFFF82B27 DISPLAY_IDENTIFIER ambient_condition[1][14].amb_cond.ydiBackupMemory_xau16[9].ZFEH_EepromData /end MEASUREMENT
/begin MEASUREMENT ZFEH_EepromData.ydiBackupMemory_xau16[9].amb_cond.ambient_condition[1][15] "ambient condition shot [0 .. 2-1] with 25 data bytes [0 .. 25-1] for the error code stored in this error memory slot" UBYTE EH_STANDARD_S4_S3 1 100 0 255 ECU_ADDRESS 0xFFF82B28 DISPLAY_IDENTIFIER ambient_condition[1][15].amb_cond.ydiBackupMemory_xau16[9].ZFEH_EepromData /end MEASUREMENT
/begin MEASUREMENT ZFEH_EepromData.ydiBackupMemory_xau16[9].amb_cond.ambient_condition[1][16] "ambient condition shot [0 .. 2-1] with 25 data bytes [0 .. 25-1] for the error code stored in this error memory slot" UBYTE EH_STANDARD_S4_S3 1 100 0 255 ECU_ADDRESS 0xFFF82B29 DISPLAY_IDENTIFIER ambient_condition[1][16].amb_cond.ydiBackupMemory_xau16[9].ZFEH_EepromData /end MEASUREMENT
/begin MEASUREMENT ZFEH_EepromData.ydiBackupMemory_xau16[9].amb_cond.ambient_condition[1][17] "ambient condition shot [0 .. 2-1] with 25 data bytes [0 .. 25-1] for the error code stored in this error memory slot" UBYTE EH_STANDARD_S4_S3 1 100 0 255 ECU_ADDRESS 0xFFF82B2A DISPLAY_IDENTIFIER ambient_condition[1][17].amb_cond.ydiBackupMemory_xau16[9].ZFEH_EepromData /end MEASUREMENT
/begin MEASUREMENT ZFEH_EepromData.ydiBackupMemory_xau16[9].amb_cond.ambient_condition[1][18] "ambient condition shot [0 .. 2-1] with 25 data bytes [0 .. 25-1] for the error code stored in this error memory slot" UBYTE EH_STANDARD_S4_S3 1 100 0 255 ECU_ADDRESS 0xFFF82B2B DISPLAY_IDENTIFIER ambient_condition[1][18].amb_cond.ydiBackupMemory_xau16[9].ZFEH_EepromData /end MEASUREMENT
/begin MEASUREMENT ZFEH_EepromData.ydiBackupMemory_xau16[9].amb_cond.ambient_condition[1][19] "ambient condition shot [0 .. 2-1] with 25 data bytes [0 .. 25-1] for the error code stored in this error memory slot" UBYTE EH_STANDARD_S4_S3 1 100 0 255 ECU_ADDRESS 0xFFF82B2C DISPLAY_IDENTIFIER ambient_condition[1][19].amb_cond.ydiBackupMemory_xau16[9].ZFEH_EepromData /end MEASUREMENT
/begin MEASUREMENT ZFEH_EepromData.ydiBackupMemory_xau16[9].amb_cond.ambient_condition[1][1] "ambient condition shot [0 .. 2-1] with 25 data bytes [0 .. 25-1] for the error code stored in this error memory slot" UBYTE EH_STANDARD_S4_S3 1 100 0 255 ECU_ADDRESS 0xFFF82B1A DISPLAY_IDENTIFIER ambient_condition[1][1].amb_cond.ydiBackupMemory_xau16[9].ZFEH_EepromData /end MEASUREMENT
/begin MEASUREMENT ZFEH_EepromData.ydiBackupMemory_xau16[9].amb_cond.ambient_condition[1][20] "ambient condition shot [0 .. 2-1] with 25 data bytes [0 .. 25-1] for the error code stored in this error memory slot" UBYTE EH_STANDARD_S4_S3 1 100 0 255 ECU_ADDRESS 0xFFF82B2D DISPLAY_IDENTIFIER ambient_condition[1][20].amb_cond.ydiBackupMemory_xau16[9].ZFEH_EepromData /end MEASUREMENT
/begin MEASUREMENT ZFEH_EepromData.ydiBackupMemory_xau16[9].amb_cond.ambient_condition[1][21] "ambient condition shot [0 .. 2-1] with 25 data bytes [0 .. 25-1] for the error code stored in this error memory slot" UBYTE EH_STANDARD_S4_S3 1 100 0 255 ECU_ADDRESS 0xFFF82B2E DISPLAY_IDENTIFIER ambient_condition[1][21].amb_cond.ydiBackupMemory_xau16[9].ZFEH_EepromData /end MEASUREMENT
/begin MEASUREMENT ZFEH_EepromData.ydiBackupMemory_xau16[9].amb_cond.ambient_condition[1][22] "ambient condition shot [0 .. 2-1] with 25 data bytes [0 .. 25-1] for the error code stored in this error memory slot" UBYTE EH_STANDARD_S4_S3 1 100 0 255 ECU_ADDRESS 0xFFF82B2F DISPLAY_IDENTIFIER ambient_condition[1][22].amb_cond.ydiBackupMemory_xau16[9].ZFEH_EepromData /end MEASUREMENT
/begin MEASUREMENT ZFEH_EepromData.ydiBackupMemory_xau16[9].amb_cond.ambient_condition[1][23] "ambient condition shot [0 .. 2-1] with 25 data bytes [0 .. 25-1] for the error code stored in this error memory slot" UBYTE EH_STANDARD_S4_S3 1 100 0 255 ECU_ADDRESS 0xFFF82B30 DISPLAY_IDENTIFIER ambient_condition[1][23].amb_cond.ydiBackupMemory_xau16[9].ZFEH_EepromData /end MEASUREMENT
/begin MEASUREMENT ZFEH_EepromData.ydiBackupMemory_xau16[9].amb_cond.ambient_condition[1][24] "ambient condition shot [0 .. 2-1] with 25 data bytes [0 .. 25-1] for the error code stored in this error memory slot" UBYTE EH_STANDARD_S4_S3 1 100 0 255 ECU_ADDRESS 0xFFF82B31 DISPLAY_IDENTIFIER ambient_condition[1][24].amb_cond.ydiBackupMemory_xau16[9].ZFEH_EepromData /end MEASUREMENT
/begin MEASUREMENT ZFEH_EepromData.ydiBackupMemory_xau16[9].amb_cond.ambient_condition[1][2] "ambient condition shot [0 .. 2-1] with 25 data bytes [0 .. 25-1] for the error code stored in this error memory slot" UBYTE EH_STANDARD_S4_S3 1 100 0 255 ECU_ADDRESS 0xFFF82B1B DISPLAY_IDENTIFIER ambient_condition[1][2].amb_cond.ydiBackupMemory_xau16[9].ZFEH_EepromData /end MEASUREMENT
/begin MEASUREMENT ZFEH_EepromData.ydiBackupMemory_xau16[9].amb_cond.ambient_condition[1][3] "ambient condition shot [0 .. 2-1] with 25 data bytes [0 .. 25-1] for the error code stored in this error memory slot" UBYTE EH_STANDARD_S4_S3 1 100 0 255 ECU_ADDRESS 0xFFF82B1C DISPLAY_IDENTIFIER ambient_condition[1][3].amb_cond.ydiBackupMemory_xau16[9].ZFEH_EepromData /end MEASUREMENT
/begin MEASUREMENT ZFEH_EepromData.ydiBackupMemory_xau16[9].amb_cond.ambient_condition[1][4] "ambient condition shot [0 .. 2-1] with 25 data bytes [0 .. 25-1] for the error code stored in this error memory slot" UBYTE EH_STANDARD_S4_S3 1 100 0 255 ECU_ADDRESS 0xFFF82B1D DISPLAY_IDENTIFIER ambient_condition[1][4].amb_cond.ydiBackupMemory_xau16[9].ZFEH_EepromData /end MEASUREMENT
/begin MEASUREMENT ZFEH_EepromData.ydiBackupMemory_xau16[9].amb_cond.ambient_condition[1][5] "ambient condition shot [0 .. 2-1] with 25 data bytes [0 .. 25-1] for the error code stored in this error memory slot" UBYTE EH_STANDARD_S4_S3 1 100 0 255 ECU_ADDRESS 0xFFF82B1E DISPLAY_IDENTIFIER ambient_condition[1][5].amb_cond.ydiBackupMemory_xau16[9].ZFEH_EepromData /end MEASUREMENT
/begin MEASUREMENT ZFEH_EepromData.ydiBackupMemory_xau16[9].amb_cond.ambient_condition[1][6] "ambient condition shot [0 .. 2-1] with 25 data bytes [0 .. 25-1] for the error code stored in this error memory slot" UBYTE EH_STANDARD_S4_S3 1 100 0 255 ECU_ADDRESS 0xFFF82B1F DISPLAY_IDENTIFIER ambient_condition[1][6].amb_cond.ydiBackupMemory_xau16[9].ZFEH_EepromData /end MEASUREMENT
/begin MEASUREMENT ZFEH_EepromData.ydiBackupMemory_xau16[9].amb_cond.ambient_condition[1][7] "ambient condition shot [0 .. 2-1] with 25 data bytes [0 .. 25-1] for the error code stored in this error memory slot" UBYTE EH_STANDARD_S4_S3 1 100 0 255 ECU_ADDRESS 0xFFF82B20 DISPLAY_IDENTIFIER ambient_condition[1][7].amb_cond.ydiBackupMemory_xau16[9].ZFEH_EepromData /end MEASUREMENT
/begin MEASUREMENT ZFEH_EepromData.ydiBackupMemory_xau16[9].amb_cond.ambient_condition[1][8] "ambient condition shot [0 .. 2-1] with 25 data bytes [0 .. 25-1] for the error code stored in this error memory slot" UBYTE EH_STANDARD_S4_S3 1 100 0 255 ECU_ADDRESS 0xFFF82B21 DISPLAY_IDENTIFIER ambient_condition[1][8].amb_cond.ydiBackupMemory_xau16[9].ZFEH_EepromData /end MEASUREMENT
/begin MEASUREMENT ZFEH_EepromData.ydiBackupMemory_xau16[9].amb_cond.ambient_condition[1][9] "ambient condition shot [0 .. 2-1] with 25 data bytes [0 .. 25-1] for the error code stored in this error memory slot" UBYTE EH_STANDARD_S4_S3 1 100 0 255 ECU_ADDRESS 0xFFF82B22 DISPLAY_IDENTIFIER ambient_condition[1][9].amb_cond.ydiBackupMemory_xau16[9].ZFEH_EepromData /end MEASUREMENT
/begin MEASUREMENT ZFEH_EepromData.ydiBackupMemory_xau16[9].amb_cond.status_of_ambient_conditions[0] "status of ambient condition shot x: 0=invalid 1=valid" UBYTE EH_STANDARD_S4_S3 1 100 0 1 ECU_ADDRESS 0xFFF82B32 DISPLAY_IDENTIFIER status_of_ambient_conditions[0].amb_cond.ydiBackupMemory_xau16[9].ZFEH_EepromData /end MEASUREMENT
/begin MEASUREMENT ZFEH_EepromData.ydiBackupMemory_xau16[9].amb_cond.status_of_ambient_conditions[1] "status of ambient condition shot x: 0=invalid 1=valid" UBYTE EH_STANDARD_S4_S3 1 100 0 1 ECU_ADDRESS 0xFFF82B33 DISPLAY_IDENTIFIER status_of_ambient_conditions[1].amb_cond.ydiBackupMemory_xau16[9].ZFEH_EepromData /end MEASUREMENT
/begin MEASUREMENT ZFEH_EepromData.ydiBackupMemory_xau16[9].backwards_counter "backwards counter of error code stored in error memory slot" UBYTE EH_STANDARD_S4_S3 1 100 0 255 ECU_ADDRESS 0xFFF82AF3 DISPLAY_IDENTIFIER backwards_counter.ydiBackupMemory_xau16[9].ZFEH_EepromData /end MEASUREMENT
/begin MEASUREMENT ZFEH_EepromData.ydiBackupMemory_xau16[9].condition_byte "condition byte of error code stored in error memory slot" UBYTE EH_STANDARD_S4_S3 1 100 0 255 ECU_ADDRESS 0xFFF82AFD DISPLAY_IDENTIFIER condition_byte.ydiBackupMemory_xau16[9].ZFEH_EepromData /end MEASUREMENT
/begin MEASUREMENT ZFEH_EepromData.ydiBackupMemory_xau16[9].error_code "error code stored in error memory slot" UWORD EH_STANDARD_S4_S3 1 100 0 65535 ECU_ADDRESS 0xFFF82AEC DISPLAY_IDENTIFIER error_code.ydiBackupMemory_xau16[9].ZFEH_EepromData /end MEASUREMENT
/begin MEASUREMENT ZFEH_EepromData.ydiBackupMemory_xau16[9].error_type "error type of error code stored in error memory slot" UWORD EH_STANDARD_S4_S3 1 100 0 65535 ECU_ADDRESS 0xFFF82AEE DISPLAY_IDENTIFIER error_type.ydiBackupMemory_xau16[9].ZFEH_EepromData /end MEASUREMENT
/begin MEASUREMENT ZFEH_EepromData.ydiBackupMemory_xau16[9].frequency_counter "frequency counter of error code stored in error memory slot" UBYTE EH_STANDARD_S4_S3 1 100 0 255 ECU_ADDRESS 0xFFF82AF2 DISPLAY_IDENTIFIER frequency_counter.ydiBackupMemory_xau16[9].ZFEH_EepromData /end MEASUREMENT
/begin MEASUREMENT ZFEH_EepromData.ydiBackupMemory_xau16[9].master_time "master time of error code stored in error memory slot" ULONG EH_STANDARD_S4_S3 1 100 0 4294967295 ECU_ADDRESS 0xFFF82AF8 DISPLAY_IDENTIFIER master_time.ydiBackupMemory_xau16[9].ZFEH_EepromData /end MEASUREMENT
/begin MEASUREMENT ZFEH_EepromData.ydiBackupMemory_xau16[9].obd_driving_cycle_counter "obd driving cycle counter of error code stored in error memory slot" UWORD EH_STANDARD_S4_S3 1 100 0 65535 ECU_ADDRESS 0xFFF82AFE DISPLAY_IDENTIFIER obd_driving_cycle_counter.ydiBackupMemory_xau16[9].ZFEH_EepromData /end MEASUREMENT
/begin MEASUREMENT ZFEH_EepromData.ydiBackupMemory_xau16[9].permanent_counter "counter of permanent error codes stored in error memory slot" UBYTE EH_STANDARD_S4_S3 1 100 0 255 ECU_ADDRESS 0xFFF82AF4 DISPLAY_IDENTIFIER permanent_counter.ydiBackupMemory_xau16[9].ZFEH_EepromData /end MEASUREMENT
/begin MEASUREMENT ZFEH_EepromData.ydiBackupMemory_xau16[9].sequence_counter "sequence counter of error code stored in error memory slot" UBYTE EH_STANDARD_S4_S3 1 100 0 255 ECU_ADDRESS 0xFFF82AF5 DISPLAY_IDENTIFIER sequence_counter.ydiBackupMemory_xau16[9].ZFEH_EepromData /end MEASUREMENT
/begin MEASUREMENT ZFEH_EepromData.ydiBackupMemory_xau16[9].status_word "status word of error code stored in error memory slot" UWORD EH_STANDARD_S4_S3 1 100 0 65535 ECU_ADDRESS 0xFFF82AF0 DISPLAY_IDENTIFIER status_word.ydiBackupMemory_xau16[9].ZFEH_EepromData /end MEASUREMENT
/begin MEASUREMENT ZFEH_EepromData.ydiMemory_xau16[0].amb_cond.ambient_condition[0][0] "ambient condition shot [0 .. 2-1] with 25 data bytes [0 .. 25-1] for the error code stored in this error memory slot" UBYTE EH_STANDARD_S4_S3 1 100 0 255 ECU_ADDRESS 0xFFF822D8 DISPLAY_IDENTIFIER ambient_condition[0][0].amb_cond.ydiMemory_xau16[0].ZFEH_EepromData /end MEASUREMENT
/begin MEASUREMENT ZFEH_EepromData.ydiMemory_xau16[0].amb_cond.ambient_condition[0][10] "ambient condition shot [0 .. 2-1] with 25 data bytes [0 .. 25-1] for the error code stored in this error memory slot" UBYTE EH_STANDARD_S4_S3 1 100 0 255 ECU_ADDRESS 0xFFF822E2 DISPLAY_IDENTIFIER ambient_condition[0][10].amb_cond.ydiMemory_xau16[0].ZFEH_EepromData /end MEASUREMENT
/begin MEASUREMENT ZFEH_EepromData.ydiMemory_xau16[0].amb_cond.ambient_condition[0][11] "ambient condition shot [0 .. 2-1] with 25 data bytes [0 .. 25-1] for the error code stored in this error memory slot" UBYTE EH_STANDARD_S4_S3 1 100 0 255 ECU_ADDRESS 0xFFF822E3 DISPLAY_IDENTIFIER ambient_condition[0][11].amb_cond.ydiMemory_xau16[0].ZFEH_EepromData /end MEASUREMENT
/begin MEASUREMENT ZFEH_EepromData.ydiMemory_xau16[0].amb_cond.ambient_condition[0][12] "ambient condition shot [0 .. 2-1] with 25 data bytes [0 .. 25-1] for the error code stored in this error memory slot" UBYTE EH_STANDARD_S4_S3 1 100 0 255 ECU_ADDRESS 0xFFF822E4 DISPLAY_IDENTIFIER ambient_condition[0][12].amb_cond.ydiMemory_xau16[0].ZFEH_EepromData /end MEASUREMENT
/begin MEASUREMENT ZFEH_EepromData.ydiMemory_xau16[0].amb_cond.ambient_condition[0][13] "ambient condition shot [0 .. 2-1] with 25 data bytes [0 .. 25-1] for the error code stored in this error memory slot" UBYTE EH_STANDARD_S4_S3 1 100 0 255 ECU_ADDRESS 0xFFF822E5 DISPLAY_IDENTIFIER ambient_condition[0][13].amb_cond.ydiMemory_xau16[0].ZFEH_EepromData /end MEASUREMENT
/begin MEASUREMENT ZFEH_EepromData.ydiMemory_xau16[0].amb_cond.ambient_condition[0][14] "ambient condition shot [0 .. 2-1] with 25 data bytes [0 .. 25-1] for the error code stored in this error memory slot" UBYTE EH_STANDARD_S4_S3 1 100 0 255 ECU_ADDRESS 0xFFF822E6 DISPLAY_IDENTIFIER ambient_condition[0][14].amb_cond.ydiMemory_xau16[0].ZFEH_EepromData /end MEASUREMENT
/begin MEASUREMENT ZFEH_EepromData.ydiMemory_xau16[0].amb_cond.ambient_condition[0][15] "ambient condition shot [0 .. 2-1] with 25 data bytes [0 .. 25-1] for the error code stored in this error memory slot" UBYTE EH_STANDARD_S4_S3 1 100 0 255 ECU_ADDRESS 0xFFF822E7 DISPLAY_IDENTIFIER ambient_condition[0][15].amb_cond.ydiMemory_xau16[0].ZFEH_EepromData /end MEASUREMENT
/begin MEASUREMENT ZFEH_EepromData.ydiMemory_xau16[0].amb_cond.ambient_condition[0][16] "ambient condition shot [0 .. 2-1] with 25 data bytes [0 .. 25-1] for the error code stored in this error memory slot" UBYTE EH_STANDARD_S4_S3 1 100 0 255 ECU_ADDRESS 0xFFF822E8 DISPLAY_IDENTIFIER ambient_condition[0][16].amb_cond.ydiMemory_xau16[0].ZFEH_EepromData /end MEASUREMENT
/begin MEASUREMENT ZFEH_EepromData.ydiMemory_xau16[0].amb_cond.ambient_condition[0][17] "ambient condition shot [0 .. 2-1] with 25 data bytes [0 .. 25-1] for the error code stored in this error memory slot" UBYTE EH_STANDARD_S4_S3 1 100 0 255 ECU_ADDRESS 0xFFF822E9 DISPLAY_IDENTIFIER ambient_condition[0][17].amb_cond.ydiMemory_xau16[0].ZFEH_EepromData /end MEASUREMENT
/begin MEASUREMENT ZFEH_EepromData.ydiMemory_xau16[0].amb_cond.ambient_condition[0][18] "ambient condition shot [0 .. 2-1] with 25 data bytes [0 .. 25-1] for the error code stored in this error memory slot" UBYTE EH_STANDARD_S4_S3 1 100 0 255 ECU_ADDRESS 0xFFF822EA DISPLAY_IDENTIFIER ambient_condition[0][18].amb_cond.ydiMemory_xau16[0].ZFEH_EepromData /end MEASUREMENT
/begin MEASUREMENT ZFEH_EepromData.ydiMemory_xau16[0].amb_cond.ambient_condition[0][19] "ambient condition shot [0 .. 2-1] with 25 data bytes [0 .. 25-1] for the error code stored in this error memory slot" UBYTE EH_STANDARD_S4_S3 1 100 0 255 ECU_ADDRESS 0xFFF822EB DISPLAY_IDENTIFIER ambient_condition[0][19].amb_cond.ydiMemory_xau16[0].ZFEH_EepromData /end MEASUREMENT
/begin MEASUREMENT ZFEH_EepromData.ydiMemory_xau16[0].amb_cond.ambient_condition[0][1] "ambient condition shot [0 .. 2-1] with 25 data bytes [0 .. 25-1] for the error code stored in this error memory slot" UBYTE EH_STANDARD_S4_S3 1 100 0 255 ECU_ADDRESS 0xFFF822D9 DISPLAY_IDENTIFIER ambient_condition[0][1].amb_cond.ydiMemory_xau16[0].ZFEH_EepromData /end MEASUREMENT
/begin MEASUREMENT ZFEH_EepromData.ydiMemory_xau16[0].amb_cond.ambient_condition[0][20] "ambient condition shot [0 .. 2-1] with 25 data bytes [0 .. 25-1] for the error code stored in this error memory slot" UBYTE EH_STANDARD_S4_S3 1 100 0 255 ECU_ADDRESS 0xFFF822EC DISPLAY_IDENTIFIER ambient_condition[0][20].amb_cond.ydiMemory_xau16[0].ZFEH_EepromData /end MEASUREMENT
/begin MEASUREMENT ZFEH_EepromData.ydiMemory_xau16[0].amb_cond.ambient_condition[0][21] "ambient condition shot [0 .. 2-1] with 25 data bytes [0 .. 25-1] for the error code stored in this error memory slot" UBYTE EH_STANDARD_S4_S3 1 100 0 255 ECU_ADDRESS 0xFFF822ED DISPLAY_IDENTIFIER ambient_condition[0][21].amb_cond.ydiMemory_xau16[0].ZFEH_EepromData /end MEASUREMENT
/begin MEASUREMENT ZFEH_EepromData.ydiMemory_xau16[0].amb_cond.ambient_condition[0][22] "ambient condition shot [0 .. 2-1] with 25 data bytes [0 .. 25-1] for the error code stored in this error memory slot" UBYTE EH_STANDARD_S4_S3 1 100 0 255 ECU_ADDRESS 0xFFF822EE DISPLAY_IDENTIFIER ambient_condition[0][22].amb_cond.ydiMemory_xau16[0].ZFEH_EepromData /end MEASUREMENT
/begin MEASUREMENT ZFEH_EepromData.ydiMemory_xau16[0].amb_cond.ambient_condition[0][23] "ambient condition shot [0 .. 2-1] with 25 data bytes [0 .. 25-1] for the error code stored in this error memory slot" UBYTE EH_STANDARD_S4_S3 1 100 0 255 ECU_ADDRESS 0xFFF822EF DISPLAY_IDENTIFIER ambient_condition[0][23].amb_cond.ydiMemory_xau16[0].ZFEH_EepromData /end MEASUREMENT
/begin MEASUREMENT ZFEH_EepromData.ydiMemory_xau16[0].amb_cond.ambient_condition[0][24] "ambient condition shot [0 .. 2-1] with 25 data bytes [0 .. 25-1] for the error code stored in this error memory slot" UBYTE EH_STANDARD_S4_S3 1 100 0 255 ECU_ADDRESS 0xFFF822F0 DISPLAY_IDENTIFIER ambient_condition[0][24].amb_cond.ydiMemory_xau16[0].ZFEH_EepromData /end MEASUREMENT
/begin MEASUREMENT ZFEH_EepromData.ydiMemory_xau16[0].amb_cond.ambient_condition[0][2] "ambient condition shot [0 .. 2-1] with 25 data bytes [0 .. 25-1] for the error code stored in this error memory slot" UBYTE EH_STANDARD_S4_S3 1 100 0 255 ECU_ADDRESS 0xFFF822DA DISPLAY_IDENTIFIER ambient_condition[0][2].amb_cond.ydiMemory_xau16[0].ZFEH_EepromData /end MEASUREMENT
/begin MEASUREMENT ZFEH_EepromData.ydiMemory_xau16[0].amb_cond.ambient_condition[0][3] "ambient condition shot [0 .. 2-1] with 25 data bytes [0 .. 25-1] for the error code stored in this error memory slot" UBYTE EH_STANDARD_S4_S3 1 100 0 255 ECU_ADDRESS 0xFFF822DB DISPLAY_IDENTIFIER ambient_condition[0][3].amb_cond.ydiMemory_xau16[0].ZFEH_EepromData /end MEASUREMENT
/begin MEASUREMENT ZFEH_EepromData.ydiMemory_xau16[0].amb_cond.ambient_condition[0][4] "ambient condition shot [0 .. 2-1] with 25 data bytes [0 .. 25-1] for the error code stored in this error memory slot" UBYTE EH_STANDARD_S4_S3 1 100 0 255 ECU_ADDRESS 0xFFF822DC DISPLAY_IDENTIFIER ambient_condition[0][4].amb_cond.ydiMemory_xau16[0].ZFEH_EepromData /end MEASUREMENT
/begin MEASUREMENT ZFEH_EepromData.ydiMemory_xau16[0].amb_cond.ambient_condition[0][5] "ambient condition shot [0 .. 2-1] with 25 data bytes [0 .. 25-1] for the error code stored in this error memory slot" UBYTE EH_STANDARD_S4_S3 1 100 0 255 ECU_ADDRESS 0xFFF822DD DISPLAY_IDENTIFIER ambient_condition[0][5].amb_cond.ydiMemory_xau16[0].ZFEH_EepromData /end MEASUREMENT
/begin MEASUREMENT ZFEH_EepromData.ydiMemory_xau16[0].amb_cond.ambient_condition[0][6] "ambient condition shot [0 .. 2-1] with 25 data bytes [0 .. 25-1] for the error code stored in this error memory slot" UBYTE EH_STANDARD_S4_S3 1 100 0 255 ECU_ADDRESS 0xFFF822DE DISPLAY_IDENTIFIER ambient_condition[0][6].amb_cond.ydiMemory_xau16[0].ZFEH_EepromData /end MEASUREMENT
/begin MEASUREMENT ZFEH_EepromData.ydiMemory_xau16[0].amb_cond.ambient_condition[0][7] "ambient condition shot [0 .. 2-1] with 25 data bytes [0 .. 25-1] for the error code stored in this error memory slot" UBYTE EH_STANDARD_S4_S3 1 100 0 255 ECU_ADDRESS 0xFFF822DF DISPLAY_IDENTIFIER ambient_condition[0][7].amb_cond.ydiMemory_xau16[0].ZFEH_EepromData /end MEASUREMENT
/begin MEASUREMENT ZFEH_EepromData.ydiMemory_xau16[0].amb_cond.ambient_condition[0][8] "ambient condition shot [0 .. 2-1] with 25 data bytes [0 .. 25-1] for the error code stored in this error memory slot" UBYTE EH_STANDARD_S4_S3 1 100 0 255 ECU_ADDRESS 0xFFF822E0 DISPLAY_IDENTIFIER ambient_condition[0][8].amb_cond.ydiMemory_xau16[0].ZFEH_EepromData /end MEASUREMENT
/begin MEASUREMENT ZFEH_EepromData.ydiMemory_xau16[0].amb_cond.ambient_condition[0][9] "ambient condition shot [0 .. 2-1] with 25 data bytes [0 .. 25-1] for the error code stored in this error memory slot" UBYTE EH_STANDARD_S4_S3 1 100 0 255 ECU_ADDRESS 0xFFF822E1 DISPLAY_IDENTIFIER ambient_condition[0][9].amb_cond.ydiMemory_xau16[0].ZFEH_EepromData /end MEASUREMENT
/begin MEASUREMENT ZFEH_EepromData.ydiMemory_xau16[0].amb_cond.ambient_condition[1][0] "ambient condition shot [0 .. 2-1] with 25 data bytes [0 .. 25-1] for the error code stored in this error memory slot" UBYTE EH_STANDARD_S4_S3 1 100 0 255 ECU_ADDRESS 0xFFF822F1 DISPLAY_IDENTIFIER ambient_condition[1][0].amb_cond.ydiMemory_xau16[0].ZFEH_EepromData /end MEASUREMENT
/begin MEASUREMENT ZFEH_EepromData.ydiMemory_xau16[0].amb_cond.ambient_condition[1][10] "ambient condition shot [0 .. 2-1] with 25 data bytes [0 .. 25-1] for the error code stored in this error memory slot" UBYTE EH_STANDARD_S4_S3 1 100 0 255 ECU_ADDRESS 0xFFF822FB DISPLAY_IDENTIFIER ambient_condition[1][10].amb_cond.ydiMemory_xau16[0].ZFEH_EepromData /end MEASUREMENT
/begin MEASUREMENT ZFEH_EepromData.ydiMemory_xau16[0].amb_cond.ambient_condition[1][11] "ambient condition shot [0 .. 2-1] with 25 data bytes [0 .. 25-1] for the error code stored in this error memory slot" UBYTE EH_STANDARD_S4_S3 1 100 0 255 ECU_ADDRESS 0xFFF822FC DISPLAY_IDENTIFIER ambient_condition[1][11].amb_cond.ydiMemory_xau16[0].ZFEH_EepromData /end MEASUREMENT
/begin MEASUREMENT ZFEH_EepromData.ydiMemory_xau16[0].amb_cond.ambient_condition[1][12] "ambient condition shot [0 .. 2-1] with 25 data bytes [0 .. 25-1] for the error code stored in this error memory slot" UBYTE EH_STANDARD_S4_S3 1 100 0 255 ECU_ADDRESS 0xFFF822FD DISPLAY_IDENTIFIER ambient_condition[1][12].amb_cond.ydiMemory_xau16[0].ZFEH_EepromData /end MEASUREMENT
/begin MEASUREMENT ZFEH_EepromData.ydiMemory_xau16[0].amb_cond.ambient_condition[1][13] "ambient condition shot [0 .. 2-1] with 25 data bytes [0 .. 25-1] for the error code stored in this error memory slot" UBYTE EH_STANDARD_S4_S3 1 100 0 255 ECU_ADDRESS 0xFFF822FE DISPLAY_IDENTIFIER ambient_condition[1][13].amb_cond.ydiMemory_xau16[0].ZFEH_EepromData /end MEASUREMENT
/begin MEASUREMENT ZFEH_EepromData.ydiMemory_xau16[0].amb_cond.ambient_condition[1][14] "ambient condition shot [0 .. 2-1] with 25 data bytes [0 .. 25-1] for the error code stored in this error memory slot" UBYTE EH_STANDARD_S4_S3 1 100 0 255 ECU_ADDRESS 0xFFF822FF DISPLAY_IDENTIFIER ambient_condition[1][14].amb_cond.ydiMemory_xau16[0].ZFEH_EepromData /end MEASUREMENT
/begin MEASUREMENT ZFEH_EepromData.ydiMemory_xau16[0].amb_cond.ambient_condition[1][15] "ambient condition shot [0 .. 2-1] with 25 data bytes [0 .. 25-1] for the error code stored in this error memory slot" UBYTE EH_STANDARD_S4_S3 1 100 0 255 ECU_ADDRESS 0xFFF82300 DISPLAY_IDENTIFIER ambient_condition[1][15].amb_cond.ydiMemory_xau16[0].ZFEH_EepromData /end MEASUREMENT
/begin MEASUREMENT ZFEH_EepromData.ydiMemory_xau16[0].amb_cond.ambient_condition[1][16] "ambient condition shot [0 .. 2-1] with 25 data bytes [0 .. 25-1] for the error code stored in this error memory slot" UBYTE EH_STANDARD_S4_S3 1 100 0 255 ECU_ADDRESS 0xFFF82301 DISPLAY_IDENTIFIER ambient_condition[1][16].amb_cond.ydiMemory_xau16[0].ZFEH_EepromData /end MEASUREMENT
/begin MEASUREMENT ZFEH_EepromData.ydiMemory_xau16[0].amb_cond.ambient_condition[1][17] "ambient condition shot [0 .. 2-1] with 25 data bytes [0 .. 25-1] for the error code stored in this error memory slot" UBYTE EH_STANDARD_S4_S3 1 100 0 255 ECU_ADDRESS 0xFFF82302 DISPLAY_IDENTIFIER ambient_condition[1][17].amb_cond.ydiMemory_xau16[0].ZFEH_EepromData /end MEASUREMENT
/begin MEASUREMENT ZFEH_EepromData.ydiMemory_xau16[0].amb_cond.ambient_condition[1][18] "ambient condition shot [0 .. 2-1] with 25 data bytes [0 .. 25-1] for the error code stored in this error memory slot" UBYTE EH_STANDARD_S4_S3 1 100 0 255 ECU_ADDRESS 0xFFF82303 DISPLAY_IDENTIFIER ambient_condition[1][18].amb_cond.ydiMemory_xau16[0].ZFEH_EepromData /end MEASUREMENT
/begin MEASUREMENT ZFEH_EepromData.ydiMemory_xau16[0].amb_cond.ambient_condition[1][19] "ambient condition shot [0 .. 2-1] with 25 data bytes [0 .. 25-1] for the error code stored in this error memory slot" UBYTE EH_STANDARD_S4_S3 1 100 0 255 ECU_ADDRESS 0xFFF82304 DISPLAY_IDENTIFIER ambient_condition[1][19].amb_cond.ydiMemory_xau16[0].ZFEH_EepromData /end MEASUREMENT
/begin MEASUREMENT ZFEH_EepromData.ydiMemory_xau16[0].amb_cond.ambient_condition[1][1] "ambient condition shot [0 .. 2-1] with 25 data bytes [0 .. 25-1] for the error code stored in this error memory slot" UBYTE EH_STANDARD_S4_S3 1 100 0 255 ECU_ADDRESS 0xFFF822F2 DISPLAY_IDENTIFIER ambient_condition[1][1].amb_cond.ydiMemory_xau16[0].ZFEH_EepromData /end MEASUREMENT
/begin MEASUREMENT ZFEH_EepromData.ydiMemory_xau16[0].amb_cond.ambient_condition[1][20] "ambient condition shot [0 .. 2-1] with 25 data bytes [0 .. 25-1] for the error code stored in this error memory slot" UBYTE EH_STANDARD_S4_S3 1 100 0 255 ECU_ADDRESS 0xFFF82305 DISPLAY_IDENTIFIER ambient_condition[1][20].amb_cond.ydiMemory_xau16[0].ZFEH_EepromData /end MEASUREMENT
/begin MEASUREMENT ZFEH_EepromData.ydiMemory_xau16[0].amb_cond.ambient_condition[1][21] "ambient condition shot [0 .. 2-1] with 25 data bytes [0 .. 25-1] for the error code stored in this error memory slot" UBYTE EH_STANDARD_S4_S3 1 100 0 255 ECU_ADDRESS 0xFFF82306 DISPLAY_IDENTIFIER ambient_condition[1][21].amb_cond.ydiMemory_xau16[0].ZFEH_EepromData /end MEASUREMENT
/begin MEASUREMENT ZFEH_EepromData.ydiMemory_xau16[0].amb_cond.ambient_condition[1][22] "ambient condition shot [0 .. 2-1] with 25 data bytes [0 .. 25-1] for the error code stored in this error memory slot" UBYTE EH_STANDARD_S4_S3 1 100 0 255 ECU_ADDRESS 0xFFF82307 DISPLAY_IDENTIFIER ambient_condition[1][22].amb_cond.ydiMemory_xau16[0].ZFEH_EepromData /end MEASUREMENT
/begin MEASUREMENT ZFEH_EepromData.ydiMemory_xau16[0].amb_cond.ambient_condition[1][23] "ambient condition shot [0 .. 2-1] with 25 data bytes [0 .. 25-1] for the error code stored in this error memory slot" UBYTE EH_STANDARD_S4_S3 1 100 0 255 ECU_ADDRESS 0xFFF82308 DISPLAY_IDENTIFIER ambient_condition[1][23].amb_cond.ydiMemory_xau16[0].ZFEH_EepromData /end MEASUREMENT
/begin MEASUREMENT ZFEH_EepromData.ydiMemory_xau16[0].amb_cond.ambient_condition[1][24] "ambient condition shot [0 .. 2-1] with 25 data bytes [0 .. 25-1] for the error code stored in this error memory slot" UBYTE EH_STANDARD_S4_S3 1 100 0 255 ECU_ADDRESS 0xFFF82309 DISPLAY_IDENTIFIER ambient_condition[1][24].amb_cond.ydiMemory_xau16[0].ZFEH_EepromData /end MEASUREMENT
/begin MEASUREMENT ZFEH_EepromData.ydiMemory_xau16[0].amb_cond.ambient_condition[1][2] "ambient condition shot [0 .. 2-1] with 25 data bytes [0 .. 25-1] for the error code stored in this error memory slot" UBYTE EH_STANDARD_S4_S3 1 100 0 255 ECU_ADDRESS 0xFFF822F3 DISPLAY_IDENTIFIER ambient_condition[1][2].amb_cond.ydiMemory_xau16[0].ZFEH_EepromData /end MEASUREMENT
/begin MEASUREMENT ZFEH_EepromData.ydiMemory_xau16[0].amb_cond.ambient_condition[1][3] "ambient condition shot [0 .. 2-1] with 25 data bytes [0 .. 25-1] for the error code stored in this error memory slot" UBYTE EH_STANDARD_S4_S3 1 100 0 255 ECU_ADDRESS 0xFFF822F4 DISPLAY_IDENTIFIER ambient_condition[1][3].amb_cond.ydiMemory_xau16[0].ZFEH_EepromData /end MEASUREMENT
/begin MEASUREMENT ZFEH_EepromData.ydiMemory_xau16[0].amb_cond.ambient_condition[1][4] "ambient condition shot [0 .. 2-1] with 25 data bytes [0 .. 25-1] for the error code stored in this error memory slot" UBYTE EH_STANDARD_S4_S3 1 100 0 255 ECU_ADDRESS 0xFFF822F5 DISPLAY_IDENTIFIER ambient_condition[1][4].amb_cond.ydiMemory_xau16[0].ZFEH_EepromData /end MEASUREMENT
/begin MEASUREMENT ZFEH_EepromData.ydiMemory_xau16[0].amb_cond.ambient_condition[1][5] "ambient condition shot [0 .. 2-1] with 25 data bytes [0 .. 25-1] for the error code stored in this error memory slot" UBYTE EH_STANDARD_S4_S3 1 100 0 255 ECU_ADDRESS 0xFFF822F6 DISPLAY_IDENTIFIER ambient_condition[1][5].amb_cond.ydiMemory_xau16[0].ZFEH_EepromData /end MEASUREMENT
/begin MEASUREMENT ZFEH_EepromData.ydiMemory_xau16[0].amb_cond.ambient_condition[1][6] "ambient condition shot [0 .. 2-1] with 25 data bytes [0 .. 25-1] for the error code stored in this error memory slot" UBYTE EH_STANDARD_S4_S3 1 100 0 255 ECU_ADDRESS 0xFFF822F7 DISPLAY_IDENTIFIER ambient_condition[1][6].amb_cond.ydiMemory_xau16[0].ZFEH_EepromData /end MEASUREMENT
/begin MEASUREMENT ZFEH_EepromData.ydiMemory_xau16[0].amb_cond.ambient_condition[1][7] "ambient condition shot [0 .. 2-1] with 25 data bytes [0 .. 25-1] for the error code stored in this error memory slot" UBYTE EH_STANDARD_S4_S3 1 100 0 255 ECU_ADDRESS 0xFFF822F8 DISPLAY_IDENTIFIER ambient_condition[1][7].amb_cond.ydiMemory_xau16[0].ZFEH_EepromData /end MEASUREMENT
/begin MEASUREMENT ZFEH_EepromData.ydiMemory_xau16[0].amb_cond.ambient_condition[1][8] "ambient condition shot [0 .. 2-1] with 25 data bytes [0 .. 25-1] for the error code stored in this error memory slot" UBYTE EH_STANDARD_S4_S3 1 100 0 255 ECU_ADDRESS 0xFFF822F9 DISPLAY_IDENTIFIER ambient_condition[1][8].amb_cond.ydiMemory_xau16[0].ZFEH_EepromData /end MEASUREMENT
/begin MEASUREMENT ZFEH_EepromData.ydiMemory_xau16[0].amb_cond.ambient_condition[1][9] "ambient condition shot [0 .. 2-1] with 25 data bytes [0 .. 25-1] for the error code stored in this error memory slot" UBYTE EH_STANDARD_S4_S3 1 100 0 255 ECU_ADDRESS 0xFFF822FA DISPLAY_IDENTIFIER ambient_condition[1][9].amb_cond.ydiMemory_xau16[0].ZFEH_EepromData /end MEASUREMENT
/begin MEASUREMENT ZFEH_EepromData.ydiMemory_xau16[0].amb_cond.status_of_ambient_conditions[0] "status of ambient condition shot x: 0=invalid 1=valid" UBYTE EH_STANDARD_S4_S3 1 100 0 1 ECU_ADDRESS 0xFFF8230A DISPLAY_IDENTIFIER status_of_ambient_conditions[0].amb_cond.ydiMemory_xau16[0].ZFEH_EepromData /end MEASUREMENT
/begin MEASUREMENT ZFEH_EepromData.ydiMemory_xau16[0].amb_cond.status_of_ambient_conditions[1] "status of ambient condition shot x: 0=invalid 1=valid" UBYTE EH_STANDARD_S4_S3 1 100 0 1 ECU_ADDRESS 0xFFF8230B DISPLAY_IDENTIFIER status_of_ambient_conditions[1].amb_cond.ydiMemory_xau16[0].ZFEH_EepromData /end MEASUREMENT
/begin MEASUREMENT ZFEH_EepromData.ydiMemory_xau16[0].backwards_counter "backwards counter of error code stored in error memory slot" UBYTE EH_STANDARD_S4_S3 1 100 0 255 ECU_ADDRESS 0xFFF822CB DISPLAY_IDENTIFIER backwards_counter.ydiMemory_xau16[0].ZFEH_EepromData /end MEASUREMENT
/begin MEASUREMENT ZFEH_EepromData.ydiMemory_xau16[0].condition_byte "condition byte of error code stored in error memory slot" UBYTE EH_STANDARD_S4_S3 1 100 0 255 ECU_ADDRESS 0xFFF822D5 DISPLAY_IDENTIFIER condition_byte.ydiMemory_xau16[0].ZFEH_EepromData /end MEASUREMENT
/begin MEASUREMENT ZFEH_EepromData.ydiMemory_xau16[0].error_code "error code stored in error memory slot" UWORD EH_STANDARD_S4_S3 1 100 0 65535 ECU_ADDRESS 0xFFF822C4 DISPLAY_IDENTIFIER error_code.ydiMemory_xau16[0].ZFEH_EepromData /end MEASUREMENT
/begin MEASUREMENT ZFEH_EepromData.ydiMemory_xau16[0].error_type "error type of error code stored in error memory slot" UWORD EH_STANDARD_S4_S3 1 100 0 65535 ECU_ADDRESS 0xFFF822C6 DISPLAY_IDENTIFIER error_type.ydiMemory_xau16[0].ZFEH_EepromData /end MEASUREMENT
/begin MEASUREMENT ZFEH_EepromData.ydiMemory_xau16[0].frequency_counter "frequency counter of error code stored in error memory slot" UBYTE EH_STANDARD_S4_S3 1 100 0 255 ECU_ADDRESS 0xFFF822CA DISPLAY_IDENTIFIER frequency_counter.ydiMemory_xau16[0].ZFEH_EepromData /end MEASUREMENT
/begin MEASUREMENT ZFEH_EepromData.ydiMemory_xau16[0].master_time "master time of error code stored in error memory slot" ULONG EH_STANDARD_S4_S3 1 100 0 4294967295 ECU_ADDRESS 0xFFF822D0 DISPLAY_IDENTIFIER master_time.ydiMemory_xau16[0].ZFEH_EepromData /end MEASUREMENT
/begin MEASUREMENT ZFEH_EepromData.ydiMemory_xau16[0].obd_driving_cycle_counter "obd driving cycle counter of error code stored in error memory slot" UWORD EH_STANDARD_S4_S3 1 100 0 65535 ECU_ADDRESS 0xFFF822D6 DISPLAY_IDENTIFIER obd_driving_cycle_counter.ydiMemory_xau16[0].ZFEH_EepromData /end MEASUREMENT
/begin MEASUREMENT ZFEH_EepromData.ydiMemory_xau16[0].permanent_counter "counter of permanent error codes stored in error memory slot" UBYTE EH_STANDARD_S4_S3 1 100 0 255 ECU_ADDRESS 0xFFF822CC DISPLAY_IDENTIFIER permanent_counter.ydiMemory_xau16[0].ZFEH_EepromData /end MEASUREMENT
/begin MEASUREMENT ZFEH_EepromData.ydiMemory_xau16[0].sequence_counter "sequence counter of error code stored in error memory slot" UBYTE EH_STANDARD_S4_S3 1 100 0 255 ECU_ADDRESS 0xFFF822CD DISPLAY_IDENTIFIER sequence_counter.ydiMemory_xau16[0].ZFEH_EepromData /end MEASUREMENT
/begin MEASUREMENT ZFEH_EepromData.ydiMemory_xau16[0].status_word "status word of error code stored in error memory slot" UWORD EH_STANDARD_S4_S3 1 100 0 65535 ECU_ADDRESS 0xFFF822C8 DISPLAY_IDENTIFIER status_word.ydiMemory_xau16[0].ZFEH_EepromData /end MEASUREMENT
/begin MEASUREMENT ZFEH_EepromData.ydiMemory_xau16[10].amb_cond.ambient_condition[0][0] "ambient condition shot [0 .. 2-1] with 25 data bytes [0 .. 25-1] for the error code stored in this error memory slot" UBYTE EH_STANDARD_S4_S3 1 100 0 255 ECU_ADDRESS 0xFFF825A8 DISPLAY_IDENTIFIER ambient_condition[0][0].amb_cond.ydiMemory_xau16[10].ZFEH_EepromData /end MEASUREMENT
/begin MEASUREMENT ZFEH_EepromData.ydiMemory_xau16[10].amb_cond.ambient_condition[0][10] "ambient condition shot [0 .. 2-1] with 25 data bytes [0 .. 25-1] for the error code stored in this error memory slot" UBYTE EH_STANDARD_S4_S3 1 100 0 255 ECU_ADDRESS 0xFFF825B2 DISPLAY_IDENTIFIER ambient_condition[0][10].amb_cond.ydiMemory_xau16[10].ZFEH_EepromData /end MEASUREMENT
/begin MEASUREMENT ZFEH_EepromData.ydiMemory_xau16[10].amb_cond.ambient_condition[0][11] "ambient condition shot [0 .. 2-1] with 25 data bytes [0 .. 25-1] for the error code stored in this error memory slot" UBYTE EH_STANDARD_S4_S3 1 100 0 255 ECU_ADDRESS 0xFFF825B3 DISPLAY_IDENTIFIER ambient_condition[0][11].amb_cond.ydiMemory_xau16[10].ZFEH_EepromData /end MEASUREMENT
/begin MEASUREMENT ZFEH_EepromData.ydiMemory_xau16[10].amb_cond.ambient_condition[0][12] "ambient condition shot [0 .. 2-1] with 25 data bytes [0 .. 25-1] for the error code stored in this error memory slot" UBYTE EH_STANDARD_S4_S3 1 100 0 255 ECU_ADDRESS 0xFFF825B4 DISPLAY_IDENTIFIER ambient_condition[0][12].amb_cond.ydiMemory_xau16[10].ZFEH_EepromData /end MEASUREMENT
/begin MEASUREMENT ZFEH_EepromData.ydiMemory_xau16[10].amb_cond.ambient_condition[0][13] "ambient condition shot [0 .. 2-1] with 25 data bytes [0 .. 25-1] for the error code stored in this error memory slot" UBYTE EH_STANDARD_S4_S3 1 100 0 255 ECU_ADDRESS 0xFFF825B5 DISPLAY_IDENTIFIER ambient_condition[0][13].amb_cond.ydiMemory_xau16[10].ZFEH_EepromData /end MEASUREMENT
/begin MEASUREMENT ZFEH_EepromData.ydiMemory_xau16[10].amb_cond.ambient_condition[0][14] "ambient condition shot [0 .. 2-1] with 25 data bytes [0 .. 25-1] for the error code stored in this error memory slot" UBYTE EH_STANDARD_S4_S3 1 100 0 255 ECU_ADDRESS 0xFFF825B6 DISPLAY_IDENTIFIER ambient_condition[0][14].amb_cond.ydiMemory_xau16[10].ZFEH_EepromData /end MEASUREMENT
/begin MEASUREMENT ZFEH_EepromData.ydiMemory_xau16[10].amb_cond.ambient_condition[0][15] "ambient condition shot [0 .. 2-1] with 25 data bytes [0 .. 25-1] for the error code stored in this error memory slot" UBYTE EH_STANDARD_S4_S3 1 100 0 255 ECU_ADDRESS 0xFFF825B7 DISPLAY_IDENTIFIER ambient_condition[0][15].amb_cond.ydiMemory_xau16[10].ZFEH_EepromData /end MEASUREMENT
/begin MEASUREMENT ZFEH_EepromData.ydiMemory_xau16[10].amb_cond.ambient_condition[0][16] "ambient condition shot [0 .. 2-1] with 25 data bytes [0 .. 25-1] for the error code stored in this error memory slot" UBYTE EH_STANDARD_S4_S3 1 100 0 255 ECU_ADDRESS 0xFFF825B8 DISPLAY_IDENTIFIER ambient_condition[0][16].amb_cond.ydiMemory_xau16[10].ZFEH_EepromData /end MEASUREMENT
/begin MEASUREMENT ZFEH_EepromData.ydiMemory_xau16[10].amb_cond.ambient_condition[0][17] "ambient condition shot [0 .. 2-1] with 25 data bytes [0 .. 25-1] for the error code stored in this error memory slot" UBYTE EH_STANDARD_S4_S3 1 100 0 255 ECU_ADDRESS 0xFFF825B9 DISPLAY_IDENTIFIER ambient_condition[0][17].amb_cond.ydiMemory_xau16[10].ZFEH_EepromData /end MEASUREMENT
/begin MEASUREMENT ZFEH_EepromData.ydiMemory_xau16[10].amb_cond.ambient_condition[0][18] "ambient condition shot [0 .. 2-1] with 25 data bytes [0 .. 25-1] for the error code stored in this error memory slot" UBYTE EH_STANDARD_S4_S3 1 100 0 255 ECU_ADDRESS 0xFFF825BA DISPLAY_IDENTIFIER ambient_condition[0][18].amb_cond.ydiMemory_xau16[10].ZFEH_EepromData /end MEASUREMENT
/begin MEASUREMENT ZFEH_EepromData.ydiMemory_xau16[10].amb_cond.ambient_condition[0][19] "ambient condition shot [0 .. 2-1] with 25 data bytes [0 .. 25-1] for the error code stored in this error memory slot" UBYTE EH_STANDARD_S4_S3 1 100 0 255 ECU_ADDRESS 0xFFF825BB DISPLAY_IDENTIFIER ambient_condition[0][19].amb_cond.ydiMemory_xau16[10].ZFEH_EepromData /end MEASUREMENT
/begin MEASUREMENT ZFEH_EepromData.ydiMemory_xau16[10].amb_cond.ambient_condition[0][1] "ambient condition shot [0 .. 2-1] with 25 data bytes [0 .. 25-1] for the error code stored in this error memory slot" UBYTE EH_STANDARD_S4_S3 1 100 0 255 ECU_ADDRESS 0xFFF825A9 DISPLAY_IDENTIFIER ambient_condition[0][1].amb_cond.ydiMemory_xau16[10].ZFEH_EepromData /end MEASUREMENT
/begin MEASUREMENT ZFEH_EepromData.ydiMemory_xau16[10].amb_cond.ambient_condition[0][20] "ambient condition shot [0 .. 2-1] with 25 data bytes [0 .. 25-1] for the error code stored in this error memory slot" UBYTE EH_STANDARD_S4_S3 1 100 0 255 ECU_ADDRESS 0xFFF825BC DISPLAY_IDENTIFIER ambient_condition[0][20].amb_cond.ydiMemory_xau16[10].ZFEH_EepromData /end MEASUREMENT
/begin MEASUREMENT ZFEH_EepromData.ydiMemory_xau16[10].amb_cond.ambient_condition[0][21] "ambient condition shot [0 .. 2-1] with 25 data bytes [0 .. 25-1] for the error code stored in this error memory slot" UBYTE EH_STANDARD_S4_S3 1 100 0 255 ECU_ADDRESS 0xFFF825BD DISPLAY_IDENTIFIER ambient_condition[0][21].amb_cond.ydiMemory_xau16[10].ZFEH_EepromData /end MEASUREMENT
/begin MEASUREMENT ZFEH_EepromData.ydiMemory_xau16[10].amb_cond.ambient_condition[0][22] "ambient condition shot [0 .. 2-1] with 25 data bytes [0 .. 25-1] for the error code stored in this error memory slot" UBYTE EH_STANDARD_S4_S3 1 100 0 255 ECU_ADDRESS 0xFFF825BE DISPLAY_IDENTIFIER ambient_condition[0][22].amb_cond.ydiMemory_xau16[10].ZFEH_EepromData /end MEASUREMENT
/begin MEASUREMENT ZFEH_EepromData.ydiMemory_xau16[10].amb_cond.ambient_condition[0][23] "ambient condition shot [0 .. 2-1] with 25 data bytes [0 .. 25-1] for the error code stored in this error memory slot" UBYTE EH_STANDARD_S4_S3 1 100 0 255 ECU_ADDRESS 0xFFF825BF DISPLAY_IDENTIFIER ambient_condition[0][23].amb_cond.ydiMemory_xau16[10].ZFEH_EepromData /end MEASUREMENT
/begin MEASUREMENT ZFEH_EepromData.ydiMemory_xau16[10].amb_cond.ambient_condition[0][24] "ambient condition shot [0 .. 2-1] with 25 data bytes [0 .. 25-1] for the error code stored in this error memory slot" UBYTE EH_STANDARD_S4_S3 1 100 0 255 ECU_ADDRESS 0xFFF825C0 DISPLAY_IDENTIFIER ambient_condition[0][24].amb_cond.ydiMemory_xau16[10].ZFEH_EepromData /end MEASUREMENT
/begin MEASUREMENT ZFEH_EepromData.ydiMemory_xau16[10].amb_cond.ambient_condition[0][2] "ambient condition shot [0 .. 2-1] with 25 data bytes [0 .. 25-1] for the error code stored in this error memory slot" UBYTE EH_STANDARD_S4_S3 1 100 0 255 ECU_ADDRESS 0xFFF825AA DISPLAY_IDENTIFIER ambient_condition[0][2].amb_cond.ydiMemory_xau16[10].ZFEH_EepromData /end MEASUREMENT
/begin MEASUREMENT ZFEH_EepromData.ydiMemory_xau16[10].amb_cond.ambient_condition[0][3] "ambient condition shot [0 .. 2-1] with 25 data bytes [0 .. 25-1] for the error code stored in this error memory slot" UBYTE EH_STANDARD_S4_S3 1 100 0 255 ECU_ADDRESS 0xFFF825AB DISPLAY_IDENTIFIER ambient_condition[0][3].amb_cond.ydiMemory_xau16[10].ZFEH_EepromData /end MEASUREMENT
/begin MEASUREMENT ZFEH_EepromData.ydiMemory_xau16[10].amb_cond.ambient_condition[0][4] "ambient condition shot [0 .. 2-1] with 25 data bytes [0 .. 25-1] for the error code stored in this error memory slot" UBYTE EH_STANDARD_S4_S3 1 100 0 255 ECU_ADDRESS 0xFFF825AC DISPLAY_IDENTIFIER ambient_condition[0][4].amb_cond.ydiMemory_xau16[10].ZFEH_EepromData /end MEASUREMENT
/begin MEASUREMENT ZFEH_EepromData.ydiMemory_xau16[10].amb_cond.ambient_condition[0][5] "ambient condition shot [0 .. 2-1] with 25 data bytes [0 .. 25-1] for the error code stored in this error memory slot" UBYTE EH_STANDARD_S4_S3 1 100 0 255 ECU_ADDRESS 0xFFF825AD DISPLAY_IDENTIFIER ambient_condition[0][5].amb_cond.ydiMemory_xau16[10].ZFEH_EepromData /end MEASUREMENT
/begin MEASUREMENT ZFEH_EepromData.ydiMemory_xau16[10].amb_cond.ambient_condition[0][6] "ambient condition shot [0 .. 2-1] with 25 data bytes [0 .. 25-1] for the error code stored in this error memory slot" UBYTE EH_STANDARD_S4_S3 1 100 0 255 ECU_ADDRESS 0xFFF825AE DISPLAY_IDENTIFIER ambient_condition[0][6].amb_cond.ydiMemory_xau16[10].ZFEH_EepromData /end MEASUREMENT
/begin MEASUREMENT ZFEH_EepromData.ydiMemory_xau16[10].amb_cond.ambient_condition[0][7] "ambient condition shot [0 .. 2-1] with 25 data bytes [0 .. 25-1] for the error code stored in this error memory slot" UBYTE EH_STANDARD_S4_S3 1 100 0 255 ECU_ADDRESS 0xFFF825AF DISPLAY_IDENTIFIER ambient_condition[0][7].amb_cond.ydiMemory_xau16[10].ZFEH_EepromData /end MEASUREMENT
/begin MEASUREMENT ZFEH_EepromData.ydiMemory_xau16[10].amb_cond.ambient_condition[0][8] "ambient condition shot [0 .. 2-1] with 25 data bytes [0 .. 25-1] for the error code stored in this error memory slot" UBYTE EH_STANDARD_S4_S3 1 100 0 255 ECU_ADDRESS 0xFFF825B0 DISPLAY_IDENTIFIER ambient_condition[0][8].amb_cond.ydiMemory_xau16[10].ZFEH_EepromData /end MEASUREMENT
/begin MEASUREMENT ZFEH_EepromData.ydiMemory_xau16[10].amb_cond.ambient_condition[0][9] "ambient condition shot [0 .. 2-1] with 25 data bytes [0 .. 25-1] for the error code stored in this error memory slot" UBYTE EH_STANDARD_S4_S3 1 100 0 255 ECU_ADDRESS 0xFFF825B1 DISPLAY_IDENTIFIER ambient_condition[0][9].amb_cond.ydiMemory_xau16[10].ZFEH_EepromData /end MEASUREMENT
/begin MEASUREMENT ZFEH_EepromData.ydiMemory_xau16[10].amb_cond.ambient_condition[1][0] "ambient condition shot [0 .. 2-1] with 25 data bytes [0 .. 25-1] for the error code stored in this error memory slot" UBYTE EH_STANDARD_S4_S3 1 100 0 255 ECU_ADDRESS 0xFFF825C1 DISPLAY_IDENTIFIER ambient_condition[1][0].amb_cond.ydiMemory_xau16[10].ZFEH_EepromData /end MEASUREMENT
/begin MEASUREMENT ZFEH_EepromData.ydiMemory_xau16[10].amb_cond.ambient_condition[1][10] "ambient condition shot [0 .. 2-1] with 25 data bytes [0 .. 25-1] for the error code stored in this error memory slot" UBYTE EH_STANDARD_S4_S3 1 100 0 255 ECU_ADDRESS 0xFFF825CB DISPLAY_IDENTIFIER ambient_condition[1][10].amb_cond.ydiMemory_xau16[10].ZFEH_EepromData /end MEASUREMENT
/begin MEASUREMENT ZFEH_EepromData.ydiMemory_xau16[10].amb_cond.ambient_condition[1][11] "ambient condition shot [0 .. 2-1] with 25 data bytes [0 .. 25-1] for the error code stored in this error memory slot" UBYTE EH_STANDARD_S4_S3 1 100 0 255 ECU_ADDRESS 0xFFF825CC DISPLAY_IDENTIFIER ambient_condition[1][11].amb_cond.ydiMemory_xau16[10].ZFEH_EepromData /end MEASUREMENT
/begin MEASUREMENT ZFEH_EepromData.ydiMemory_xau16[10].amb_cond.ambient_condition[1][12] "ambient condition shot [0 .. 2-1] with 25 data bytes [0 .. 25-1] for the error code stored in this error memory slot" UBYTE EH_STANDARD_S4_S3 1 100 0 255 ECU_ADDRESS 0xFFF825CD DISPLAY_IDENTIFIER ambient_condition[1][12].amb_cond.ydiMemory_xau16[10].ZFEH_EepromData /end MEASUREMENT
/begin MEASUREMENT ZFEH_EepromData.ydiMemory_xau16[10].amb_cond.ambient_condition[1][13] "ambient condition shot [0 .. 2-1] with 25 data bytes [0 .. 25-1] for the error code stored in this error memory slot" UBYTE EH_STANDARD_S4_S3 1 100 0 255 ECU_ADDRESS 0xFFF825CE DISPLAY_IDENTIFIER ambient_condition[1][13].amb_cond.ydiMemory_xau16[10].ZFEH_EepromData /end MEASUREMENT
/begin MEASUREMENT ZFEH_EepromData.ydiMemory_xau16[10].amb_cond.ambient_condition[1][14] "ambient condition shot [0 .. 2-1] with 25 data bytes [0 .. 25-1] for the error code stored in this error memory slot" UBYTE EH_STANDARD_S4_S3 1 100 0 255 ECU_ADDRESS 0xFFF825CF DISPLAY_IDENTIFIER ambient_condition[1][14].amb_cond.ydiMemory_xau16[10].ZFEH_EepromData /end MEASUREMENT
/begin MEASUREMENT ZFEH_EepromData.ydiMemory_xau16[10].amb_cond.ambient_condition[1][15] "ambient condition shot [0 .. 2-1] with 25 data bytes [0 .. 25-1] for the error code stored in this error memory slot" UBYTE EH_STANDARD_S4_S3 1 100 0 255 ECU_ADDRESS 0xFFF825D0 DISPLAY_IDENTIFIER ambient_condition[1][15].amb_cond.ydiMemory_xau16[10].ZFEH_EepromData /end MEASUREMENT
/begin MEASUREMENT ZFEH_EepromData.ydiMemory_xau16[10].amb_cond.ambient_condition[1][16] "ambient condition shot [0 .. 2-1] with 25 data bytes [0 .. 25-1] for the error code stored in this error memory slot" UBYTE EH_STANDARD_S4_S3 1 100 0 255 ECU_ADDRESS 0xFFF825D1 DISPLAY_IDENTIFIER ambient_condition[1][16].amb_cond.ydiMemory_xau16[10].ZFEH_EepromData /end MEASUREMENT
/begin MEASUREMENT ZFEH_EepromData.ydiMemory_xau16[10].amb_cond.ambient_condition[1][17] "ambient condition shot [0 .. 2-1] with 25 data bytes [0 .. 25-1] for the error code stored in this error memory slot" UBYTE EH_STANDARD_S4_S3 1 100 0 255 ECU_ADDRESS 0xFFF825D2 DISPLAY_IDENTIFIER ambient_condition[1][17].amb_cond.ydiMemory_xau16[10].ZFEH_EepromData /end MEASUREMENT
/begin MEASUREMENT ZFEH_EepromData.ydiMemory_xau16[10].amb_cond.ambient_condition[1][18] "ambient condition shot [0 .. 2-1] with 25 data bytes [0 .. 25-1] for the error code stored in this error memory slot" UBYTE EH_STANDARD_S4_S3 1 100 0 255 ECU_ADDRESS 0xFFF825D3 DISPLAY_IDENTIFIER ambient_condition[1][18].amb_cond.ydiMemory_xau16[10].ZFEH_EepromData /end MEASUREMENT
/begin MEASUREMENT ZFEH_EepromData.ydiMemory_xau16[10].amb_cond.ambient_condition[1][19] "ambient condition shot [0 .. 2-1] with 25 data bytes [0 .. 25-1] for the error code stored in this error memory slot" UBYTE EH_STANDARD_S4_S3 1 100 0 255 ECU_ADDRESS 0xFFF825D4 DISPLAY_IDENTIFIER ambient_condition[1][19].amb_cond.ydiMemory_xau16[10].ZFEH_EepromData /end MEASUREMENT
/begin MEASUREMENT ZFEH_EepromData.ydiMemory_xau16[10].amb_cond.ambient_condition[1][1] "ambient condition shot [0 .. 2-1] with 25 data bytes [0 .. 25-1] for the error code stored in this error memory slot" UBYTE EH_STANDARD_S4_S3 1 100 0 255 ECU_ADDRESS 0xFFF825C2 DISPLAY_IDENTIFIER ambient_condition[1][1].amb_cond.ydiMemory_xau16[10].ZFEH_EepromData /end MEASUREMENT
/begin MEASUREMENT ZFEH_EepromData.ydiMemory_xau16[10].amb_cond.ambient_condition[1][20] "ambient condition shot [0 .. 2-1] with 25 data bytes [0 .. 25-1] for the error code stored in this error memory slot" UBYTE EH_STANDARD_S4_S3 1 100 0 255 ECU_ADDRESS 0xFFF825D5 DISPLAY_IDENTIFIER ambient_condition[1][20].amb_cond.ydiMemory_xau16[10].ZFEH_EepromData /end MEASUREMENT
/begin MEASUREMENT ZFEH_EepromData.ydiMemory_xau16[10].amb_cond.ambient_condition[1][21] "ambient condition shot [0 .. 2-1] with 25 data bytes [0 .. 25-1] for the error code stored in this error memory slot" UBYTE EH_STANDARD_S4_S3 1 100 0 255 ECU_ADDRESS 0xFFF825D6 DISPLAY_IDENTIFIER ambient_condition[1][21].amb_cond.ydiMemory_xau16[10].ZFEH_EepromData /end MEASUREMENT
/begin MEASUREMENT ZFEH_EepromData.ydiMemory_xau16[10].amb_cond.ambient_condition[1][22] "ambient condition shot [0 .. 2-1] with 25 data bytes [0 .. 25-1] for the error code stored in this error memory slot" UBYTE EH_STANDARD_S4_S3 1 100 0 255 ECU_ADDRESS 0xFFF825D7 DISPLAY_IDENTIFIER ambient_condition[1][22].amb_cond.ydiMemory_xau16[10].ZFEH_EepromData /end MEASUREMENT
/begin MEASUREMENT ZFEH_EepromData.ydiMemory_xau16[10].amb_cond.ambient_condition[1][23] "ambient condition shot [0 .. 2-1] with 25 data bytes [0 .. 25-1] for the error code stored in this error memory slot" UBYTE EH_STANDARD_S4_S3 1 100 0 255 ECU_ADDRESS 0xFFF825D8 DISPLAY_IDENTIFIER ambient_condition[1][23].amb_cond.ydiMemory_xau16[10].ZFEH_EepromData /end MEASUREMENT
/begin MEASUREMENT ZFEH_EepromData.ydiMemory_xau16[10].amb_cond.ambient_condition[1][24] "ambient condition shot [0 .. 2-1] with 25 data bytes [0 .. 25-1] for the error code stored in this error memory slot" UBYTE EH_STANDARD_S4_S3 1 100 0 255 ECU_ADDRESS 0xFFF825D9 DISPLAY_IDENTIFIER ambient_condition[1][24].amb_cond.ydiMemory_xau16[10].ZFEH_EepromData /end MEASUREMENT
/begin MEASUREMENT ZFEH_EepromData.ydiMemory_xau16[10].amb_cond.ambient_condition[1][2] "ambient condition shot [0 .. 2-1] with 25 data bytes [0 .. 25-1] for the error code stored in this error memory slot" UBYTE EH_STANDARD_S4_S3 1 100 0 255 ECU_ADDRESS 0xFFF825C3 DISPLAY_IDENTIFIER ambient_condition[1][2].amb_cond.ydiMemory_xau16[10].ZFEH_EepromData /end MEASUREMENT
/begin MEASUREMENT ZFEH_EepromData.ydiMemory_xau16[10].amb_cond.ambient_condition[1][3] "ambient condition shot [0 .. 2-1] with 25 data bytes [0 .. 25-1] for the error code stored in this error memory slot" UBYTE EH_STANDARD_S4_S3 1 100 0 255 ECU_ADDRESS 0xFFF825C4 DISPLAY_IDENTIFIER ambient_condition[1][3].amb_cond.ydiMemory_xau16[10].ZFEH_EepromData /end MEASUREMENT
/begin MEASUREMENT ZFEH_EepromData.ydiMemory_xau16[10].amb_cond.ambient_condition[1][4] "ambient condition shot [0 .. 2-1] with 25 data bytes [0 .. 25-1] for the error code stored in this error memory slot" UBYTE EH_STANDARD_S4_S3 1 100 0 255 ECU_ADDRESS 0xFFF825C5 DISPLAY_IDENTIFIER ambient_condition[1][4].amb_cond.ydiMemory_xau16[10].ZFEH_EepromData /end MEASUREMENT
/begin MEASUREMENT ZFEH_EepromData.ydiMemory_xau16[10].amb_cond.ambient_condition[1][5] "ambient condition shot [0 .. 2-1] with 25 data bytes [0 .. 25-1] for the error code stored in this error memory slot" UBYTE EH_STANDARD_S4_S3 1 100 0 255 ECU_ADDRESS 0xFFF825C6 DISPLAY_IDENTIFIER ambient_condition[1][5].amb_cond.ydiMemory_xau16[10].ZFEH_EepromData /end MEASUREMENT
/begin MEASUREMENT ZFEH_EepromData.ydiMemory_xau16[10].amb_cond.ambient_condition[1][6] "ambient condition shot [0 .. 2-1] with 25 data bytes [0 .. 25-1] for the error code stored in this error memory slot" UBYTE EH_STANDARD_S4_S3 1 100 0 255 ECU_ADDRESS 0xFFF825C7 DISPLAY_IDENTIFIER ambient_condition[1][6].amb_cond.ydiMemory_xau16[10].ZFEH_EepromData /end MEASUREMENT
/begin MEASUREMENT ZFEH_EepromData.ydiMemory_xau16[10].amb_cond.ambient_condition[1][7] "ambient condition shot [0 .. 2-1] with 25 data bytes [0 .. 25-1] for the error code stored in this error memory slot" UBYTE EH_STANDARD_S4_S3 1 100 0 255 ECU_ADDRESS 0xFFF825C8 DISPLAY_IDENTIFIER ambient_condition[1][7].amb_cond.ydiMemory_xau16[10].ZFEH_EepromData /end MEASUREMENT
/begin MEASUREMENT ZFEH_EepromData.ydiMemory_xau16[10].amb_cond.ambient_condition[1][8] "ambient condition shot [0 .. 2-1] with 25 data bytes [0 .. 25-1] for the error code stored in this error memory slot" UBYTE EH_STANDARD_S4_S3 1 100 0 255 ECU_ADDRESS 0xFFF825C9 DISPLAY_IDENTIFIER ambient_condition[1][8].amb_cond.ydiMemory_xau16[10].ZFEH_EepromData /end MEASUREMENT
/begin MEASUREMENT ZFEH_EepromData.ydiMemory_xau16[10].amb_cond.ambient_condition[1][9] "ambient condition shot [0 .. 2-1] with 25 data bytes [0 .. 25-1] for the error code stored in this error memory slot" UBYTE EH_STANDARD_S4_S3 1 100 0 255 ECU_ADDRESS 0xFFF825CA DISPLAY_IDENTIFIER ambient_condition[1][9].amb_cond.ydiMemory_xau16[10].ZFEH_EepromData /end MEASUREMENT
/begin MEASUREMENT ZFEH_EepromData.ydiMemory_xau16[10].amb_cond.status_of_ambient_conditions[0] "status of ambient condition shot x: 0=invalid 1=valid" UBYTE EH_STANDARD_S4_S3 1 100 0 1 ECU_ADDRESS 0xFFF825DA DISPLAY_IDENTIFIER status_of_ambient_conditions[0].amb_cond.ydiMemory_xau16[10].ZFEH_EepromData /end MEASUREMENT
/begin MEASUREMENT ZFEH_EepromData.ydiMemory_xau16[10].amb_cond.status_of_ambient_conditions[1] "status of ambient condition shot x: 0=invalid 1=valid" UBYTE EH_STANDARD_S4_S3 1 100 0 1 ECU_ADDRESS 0xFFF825DB DISPLAY_IDENTIFIER status_of_ambient_conditions[1].amb_cond.ydiMemory_xau16[10].ZFEH_EepromData /end MEASUREMENT
/begin MEASUREMENT ZFEH_EepromData.ydiMemory_xau16[10].backwards_counter "backwards counter of error code stored in error memory slot" UBYTE EH_STANDARD_S4_S3 1 100 0 255 ECU_ADDRESS 0xFFF8259B DISPLAY_IDENTIFIER backwards_counter.ydiMemory_xau16[10].ZFEH_EepromData /end MEASUREMENT
/begin MEASUREMENT ZFEH_EepromData.ydiMemory_xau16[10].condition_byte "condition byte of error code stored in error memory slot" UBYTE EH_STANDARD_S4_S3 1 100 0 255 ECU_ADDRESS 0xFFF825A5 DISPLAY_IDENTIFIER condition_byte.ydiMemory_xau16[10].ZFEH_EepromData /end MEASUREMENT
/begin MEASUREMENT ZFEH_EepromData.ydiMemory_xau16[10].error_code "error code stored in error memory slot" UWORD EH_STANDARD_S4_S3 1 100 0 65535 ECU_ADDRESS 0xFFF82594 DISPLAY_IDENTIFIER error_code.ydiMemory_xau16[10].ZFEH_EepromData /end MEASUREMENT
/begin MEASUREMENT ZFEH_EepromData.ydiMemory_xau16[10].error_type "error type of error code stored in error memory slot" UWORD EH_STANDARD_S4_S3 1 100 0 65535 ECU_ADDRESS 0xFFF82596 DISPLAY_IDENTIFIER error_type.ydiMemory_xau16[10].ZFEH_EepromData /end MEASUREMENT
/begin MEASUREMENT ZFEH_EepromData.ydiMemory_xau16[10].frequency_counter "frequency counter of error code stored in error memory slot" UBYTE EH_STANDARD_S4_S3 1 100 0 255 ECU_ADDRESS 0xFFF8259A DISPLAY_IDENTIFIER frequency_counter.ydiMemory_xau16[10].ZFEH_EepromData /end MEASUREMENT
/begin MEASUREMENT ZFEH_EepromData.ydiMemory_xau16[10].master_time "master time of error code stored in error memory slot" ULONG EH_STANDARD_S4_S3 1 100 0 4294967295 ECU_ADDRESS 0xFFF825A0 DISPLAY_IDENTIFIER master_time.ydiMemory_xau16[10].ZFEH_EepromData /end MEASUREMENT
/begin MEASUREMENT ZFEH_EepromData.ydiMemory_xau16[10].obd_driving_cycle_counter "obd driving cycle counter of error code stored in error memory slot" UWORD EH_STANDARD_S4_S3 1 100 0 65535 ECU_ADDRESS 0xFFF825A6 DISPLAY_IDENTIFIER obd_driving_cycle_counter.ydiMemory_xau16[10].ZFEH_EepromData /end MEASUREMENT
/begin MEASUREMENT ZFEH_EepromData.ydiMemory_xau16[10].permanent_counter "counter of permanent error codes stored in error memory slot" UBYTE EH_STANDARD_S4_S3 1 100 0 255 ECU_ADDRESS 0xFFF8259C DISPLAY_IDENTIFIER permanent_counter.ydiMemory_xau16[10].ZFEH_EepromData /end MEASUREMENT
/begin MEASUREMENT ZFEH_EepromData.ydiMemory_xau16[10].sequence_counter "sequence counter of error code stored in error memory slot" UBYTE EH_STANDARD_S4_S3 1 100 0 255 ECU_ADDRESS 0xFFF8259D DISPLAY_IDENTIFIER sequence_counter.ydiMemory_xau16[10].ZFEH_EepromData /end MEASUREMENT
/begin MEASUREMENT ZFEH_EepromData.ydiMemory_xau16[10].status_word "status word of error code stored in error memory slot" UWORD EH_STANDARD_S4_S3 1 100 0 65535 ECU_ADDRESS 0xFFF82598 DISPLAY_IDENTIFIER status_word.ydiMemory_xau16[10].ZFEH_EepromData /end MEASUREMENT
/begin MEASUREMENT ZFEH_EepromData.ydiMemory_xau16[11].amb_cond.ambient_condition[0][0] "ambient condition shot [0 .. 2-1] with 25 data bytes [0 .. 25-1] for the error code stored in this error memory slot" UBYTE EH_STANDARD_S4_S3 1 100 0 255 ECU_ADDRESS 0xFFF825F0 DISPLAY_IDENTIFIER ambient_condition[0][0].amb_cond.ydiMemory_xau16[11].ZFEH_EepromData /end MEASUREMENT
/begin MEASUREMENT ZFEH_EepromData.ydiMemory_xau16[11].amb_cond.ambient_condition[0][10] "ambient condition shot [0 .. 2-1] with 25 data bytes [0 .. 25-1] for the error code stored in this error memory slot" UBYTE EH_STANDARD_S4_S3 1 100 0 255 ECU_ADDRESS 0xFFF825FA DISPLAY_IDENTIFIER ambient_condition[0][10].amb_cond.ydiMemory_xau16[11].ZFEH_EepromData /end MEASUREMENT
/begin MEASUREMENT ZFEH_EepromData.ydiMemory_xau16[11].amb_cond.ambient_condition[0][11] "ambient condition shot [0 .. 2-1] with 25 data bytes [0 .. 25-1] for the error code stored in this error memory slot" UBYTE EH_STANDARD_S4_S3 1 100 0 255 ECU_ADDRESS 0xFFF825FB DISPLAY_IDENTIFIER ambient_condition[0][11].amb_cond.ydiMemory_xau16[11].ZFEH_EepromData /end MEASUREMENT
/begin MEASUREMENT ZFEH_EepromData.ydiMemory_xau16[11].amb_cond.ambient_condition[0][12] "ambient condition shot [0 .. 2-1] with 25 data bytes [0 .. 25-1] for the error code stored in this error memory slot" UBYTE EH_STANDARD_S4_S3 1 100 0 255 ECU_ADDRESS 0xFFF825FC DISPLAY_IDENTIFIER ambient_condition[0][12].amb_cond.ydiMemory_xau16[11].ZFEH_EepromData /end MEASUREMENT
/begin MEASUREMENT ZFEH_EepromData.ydiMemory_xau16[11].amb_cond.ambient_condition[0][13] "ambient condition shot [0 .. 2-1] with 25 data bytes [0 .. 25-1] for the error code stored in this error memory slot" UBYTE EH_STANDARD_S4_S3 1 100 0 255 ECU_ADDRESS 0xFFF825FD DISPLAY_IDENTIFIER ambient_condition[0][13].amb_cond.ydiMemory_xau16[11].ZFEH_EepromData /end MEASUREMENT
/begin MEASUREMENT ZFEH_EepromData.ydiMemory_xau16[11].amb_cond.ambient_condition[0][14] "ambient condition shot [0 .. 2-1] with 25 data bytes [0 .. 25-1] for the error code stored in this error memory slot" UBYTE EH_STANDARD_S4_S3 1 100 0 255 ECU_ADDRESS 0xFFF825FE DISPLAY_IDENTIFIER ambient_condition[0][14].amb_cond.ydiMemory_xau16[11].ZFEH_EepromData /end MEASUREMENT
/begin MEASUREMENT ZFEH_EepromData.ydiMemory_xau16[11].amb_cond.ambient_condition[0][15] "ambient condition shot [0 .. 2-1] with 25 data bytes [0 .. 25-1] for the error code stored in this error memory slot" UBYTE EH_STANDARD_S4_S3 1 100 0 255 ECU_ADDRESS 0xFFF825FF DISPLAY_IDENTIFIER ambient_condition[0][15].amb_cond.ydiMemory_xau16[11].ZFEH_EepromData /end MEASUREMENT
/begin MEASUREMENT ZFEH_EepromData.ydiMemory_xau16[11].amb_cond.ambient_condition[0][16] "ambient condition shot [0 .. 2-1] with 25 data bytes [0 .. 25-1] for the error code stored in this error memory slot" UBYTE EH_STANDARD_S4_S3 1 100 0 255 ECU_ADDRESS 0xFFF82600 DISPLAY_IDENTIFIER ambient_condition[0][16].amb_cond.ydiMemory_xau16[11].ZFEH_EepromData /end MEASUREMENT
/begin MEASUREMENT ZFEH_EepromData.ydiMemory_xau16[11].amb_cond.ambient_condition[0][17] "ambient condition shot [0 .. 2-1] with 25 data bytes [0 .. 25-1] for the error code stored in this error memory slot" UBYTE EH_STANDARD_S4_S3 1 100 0 255 ECU_ADDRESS 0xFFF82601 DISPLAY_IDENTIFIER ambient_condition[0][17].amb_cond.ydiMemory_xau16[11].ZFEH_EepromData /end MEASUREMENT
/begin MEASUREMENT ZFEH_EepromData.ydiMemory_xau16[11].amb_cond.ambient_condition[0][18] "ambient condition shot [0 .. 2-1] with 25 data bytes [0 .. 25-1] for the error code stored in this error memory slot" UBYTE EH_STANDARD_S4_S3 1 100 0 255 ECU_ADDRESS 0xFFF82602 DISPLAY_IDENTIFIER ambient_condition[0][18].amb_cond.ydiMemory_xau16[11].ZFEH_EepromData /end MEASUREMENT
/begin MEASUREMENT ZFEH_EepromData.ydiMemory_xau16[11].amb_cond.ambient_condition[0][19] "ambient condition shot [0 .. 2-1] with 25 data bytes [0 .. 25-1] for the error code stored in this error memory slot" UBYTE EH_STANDARD_S4_S3 1 100 0 255 ECU_ADDRESS 0xFFF82603 DISPLAY_IDENTIFIER ambient_condition[0][19].amb_cond.ydiMemory_xau16[11].ZFEH_EepromData /end MEASUREMENT
/begin MEASUREMENT ZFEH_EepromData.ydiMemory_xau16[11].amb_cond.ambient_condition[0][1] "ambient condition shot [0 .. 2-1] with 25 data bytes [0 .. 25-1] for the error code stored in this error memory slot" UBYTE EH_STANDARD_S4_S3 1 100 0 255 ECU_ADDRESS 0xFFF825F1 DISPLAY_IDENTIFIER ambient_condition[0][1].amb_cond.ydiMemory_xau16[11].ZFEH_EepromData /end MEASUREMENT
/begin MEASUREMENT ZFEH_EepromData.ydiMemory_xau16[11].amb_cond.ambient_condition[0][20] "ambient condition shot [0 .. 2-1] with 25 data bytes [0 .. 25-1] for the error code stored in this error memory slot" UBYTE EH_STANDARD_S4_S3 1 100 0 255 ECU_ADDRESS 0xFFF82604 DISPLAY_IDENTIFIER ambient_condition[0][20].amb_cond.ydiMemory_xau16[11].ZFEH_EepromData /end MEASUREMENT
/begin MEASUREMENT ZFEH_EepromData.ydiMemory_xau16[11].amb_cond.ambient_condition[0][21] "ambient condition shot [0 .. 2-1] with 25 data bytes [0 .. 25-1] for the error code stored in this error memory slot" UBYTE EH_STANDARD_S4_S3 1 100 0 255 ECU_ADDRESS 0xFFF82605 DISPLAY_IDENTIFIER ambient_condition[0][21].amb_cond.ydiMemory_xau16[11].ZFEH_EepromData /end MEASUREMENT
/begin MEASUREMENT ZFEH_EepromData.ydiMemory_xau16[11].amb_cond.ambient_condition[0][22] "ambient condition shot [0 .. 2-1] with 25 data bytes [0 .. 25-1] for the error code stored in this error memory slot" UBYTE EH_STANDARD_S4_S3 1 100 0 255 ECU_ADDRESS 0xFFF82606 DISPLAY_IDENTIFIER ambient_condition[0][22].amb_cond.ydiMemory_xau16[11].ZFEH_EepromData /end MEASUREMENT
/begin MEASUREMENT ZFEH_EepromData.ydiMemory_xau16[11].amb_cond.ambient_condition[0][23] "ambient condition shot [0 .. 2-1] with 25 data bytes [0 .. 25-1] for the error code stored in this error memory slot" UBYTE EH_STANDARD_S4_S3 1 100 0 255 ECU_ADDRESS 0xFFF82607 DISPLAY_IDENTIFIER ambient_condition[0][23].amb_cond.ydiMemory_xau16[11].ZFEH_EepromData /end MEASUREMENT
/begin MEASUREMENT ZFEH_EepromData.ydiMemory_xau16[11].amb_cond.ambient_condition[0][24] "ambient condition shot [0 .. 2-1] with 25 data bytes [0 .. 25-1] for the error code stored in this error memory slot" UBYTE EH_STANDARD_S4_S3 1 100 0 255 ECU_ADDRESS 0xFFF82608 DISPLAY_IDENTIFIER ambient_condition[0][24].amb_cond.ydiMemory_xau16[11].ZFEH_EepromData /end MEASUREMENT
/begin MEASUREMENT ZFEH_EepromData.ydiMemory_xau16[11].amb_cond.ambient_condition[0][2] "ambient condition shot [0 .. 2-1] with 25 data bytes [0 .. 25-1] for the error code stored in this error memory slot" UBYTE EH_STANDARD_S4_S3 1 100 0 255 ECU_ADDRESS 0xFFF825F2 DISPLAY_IDENTIFIER ambient_condition[0][2].amb_cond.ydiMemory_xau16[11].ZFEH_EepromData /end MEASUREMENT
/begin MEASUREMENT ZFEH_EepromData.ydiMemory_xau16[11].amb_cond.ambient_condition[0][3] "ambient condition shot [0 .. 2-1] with 25 data bytes [0 .. 25-1] for the error code stored in this error memory slot" UBYTE EH_STANDARD_S4_S3 1 100 0 255 ECU_ADDRESS 0xFFF825F3 DISPLAY_IDENTIFIER ambient_condition[0][3].amb_cond.ydiMemory_xau16[11].ZFEH_EepromData /end MEASUREMENT
/begin MEASUREMENT ZFEH_EepromData.ydiMemory_xau16[11].amb_cond.ambient_condition[0][4] "ambient condition shot [0 .. 2-1] with 25 data bytes [0 .. 25-1] for the error code stored in this error memory slot" UBYTE EH_STANDARD_S4_S3 1 100 0 255 ECU_ADDRESS 0xFFF825F4 DISPLAY_IDENTIFIER ambient_condition[0][4].amb_cond.ydiMemory_xau16[11].ZFEH_EepromData /end MEASUREMENT
/begin MEASUREMENT ZFEH_EepromData.ydiMemory_xau16[11].amb_cond.ambient_condition[0][5] "ambient condition shot [0 .. 2-1] with 25 data bytes [0 .. 25-1] for the error code stored in this error memory slot" UBYTE EH_STANDARD_S4_S3 1 100 0 255 ECU_ADDRESS 0xFFF825F5 DISPLAY_IDENTIFIER ambient_condition[0][5].amb_cond.ydiMemory_xau16[11].ZFEH_EepromData /end MEASUREMENT
/begin MEASUREMENT ZFEH_EepromData.ydiMemory_xau16[11].amb_cond.ambient_condition[0][6] "ambient condition shot [0 .. 2-1] with 25 data bytes [0 .. 25-1] for the error code stored in this error memory slot" UBYTE EH_STANDARD_S4_S3 1 100 0 255 ECU_ADDRESS 0xFFF825F6 DISPLAY_IDENTIFIER ambient_condition[0][6].amb_cond.ydiMemory_xau16[11].ZFEH_EepromData /end MEASUREMENT
/begin MEASUREMENT ZFEH_EepromData.ydiMemory_xau16[11].amb_cond.ambient_condition[0][7] "ambient condition shot [0 .. 2-1] with 25 data bytes [0 .. 25-1] for the error code stored in this error memory slot" UBYTE EH_STANDARD_S4_S3 1 100 0 255 ECU_ADDRESS 0xFFF825F7 DISPLAY_IDENTIFIER ambient_condition[0][7].amb_cond.ydiMemory_xau16[11].ZFEH_EepromData /end MEASUREMENT
/begin MEASUREMENT ZFEH_EepromData.ydiMemory_xau16[11].amb_cond.ambient_condition[0][8] "ambient condition shot [0 .. 2-1] with 25 data bytes [0 .. 25-1] for the error code stored in this error memory slot" UBYTE EH_STANDARD_S4_S3 1 100 0 255 ECU_ADDRESS 0xFFF825F8 DISPLAY_IDENTIFIER ambient_condition[0][8].amb_cond.ydiMemory_xau16[11].ZFEH_EepromData /end MEASUREMENT
/begin MEASUREMENT ZFEH_EepromData.ydiMemory_xau16[11].amb_cond.ambient_condition[0][9] "ambient condition shot [0 .. 2-1] with 25 data bytes [0 .. 25-1] for the error code stored in this error memory slot" UBYTE EH_STANDARD_S4_S3 1 100 0 255 ECU_ADDRESS 0xFFF825F9 DISPLAY_IDENTIFIER ambient_condition[0][9].amb_cond.ydiMemory_xau16[11].ZFEH_EepromData /end MEASUREMENT
/begin MEASUREMENT ZFEH_EepromData.ydiMemory_xau16[11].amb_cond.ambient_condition[1][0] "ambient condition shot [0 .. 2-1] with 25 data bytes [0 .. 25-1] for the error code stored in this error memory slot" UBYTE EH_STANDARD_S4_S3 1 100 0 255 ECU_ADDRESS 0xFFF82609 DISPLAY_IDENTIFIER ambient_condition[1][0].amb_cond.ydiMemory_xau16[11].ZFEH_EepromData /end MEASUREMENT
/begin MEASUREMENT ZFEH_EepromData.ydiMemory_xau16[11].amb_cond.ambient_condition[1][10] "ambient condition shot [0 .. 2-1] with 25 data bytes [0 .. 25-1] for the error code stored in this error memory slot" UBYTE EH_STANDARD_S4_S3 1 100 0 255 ECU_ADDRESS 0xFFF82613 DISPLAY_IDENTIFIER ambient_condition[1][10].amb_cond.ydiMemory_xau16[11].ZFEH_EepromData /end MEASUREMENT
/begin MEASUREMENT ZFEH_EepromData.ydiMemory_xau16[11].amb_cond.ambient_condition[1][11] "ambient condition shot [0 .. 2-1] with 25 data bytes [0 .. 25-1] for the error code stored in this error memory slot" UBYTE EH_STANDARD_S4_S3 1 100 0 255 ECU_ADDRESS 0xFFF82614 DISPLAY_IDENTIFIER ambient_condition[1][11].amb_cond.ydiMemory_xau16[11].ZFEH_EepromData /end MEASUREMENT
/begin MEASUREMENT ZFEH_EepromData.ydiMemory_xau16[11].amb_cond.ambient_condition[1][12] "ambient condition shot [0 .. 2-1] with 25 data bytes [0 .. 25-1] for the error code stored in this error memory slot" UBYTE EH_STANDARD_S4_S3 1 100 0 255 ECU_ADDRESS 0xFFF82615 DISPLAY_IDENTIFIER ambient_condition[1][12].amb_cond.ydiMemory_xau16[11].ZFEH_EepromData /end MEASUREMENT
/begin MEASUREMENT ZFEH_EepromData.ydiMemory_xau16[11].amb_cond.ambient_condition[1][13] "ambient condition shot [0 .. 2-1] with 25 data bytes [0 .. 25-1] for the error code stored in this error memory slot" UBYTE EH_STANDARD_S4_S3 1 100 0 255 ECU_ADDRESS 0xFFF82616 DISPLAY_IDENTIFIER ambient_condition[1][13].amb_cond.ydiMemory_xau16[11].ZFEH_EepromData /end MEASUREMENT
/begin MEASUREMENT ZFEH_EepromData.ydiMemory_xau16[11].amb_cond.ambient_condition[1][14] "ambient condition shot [0 .. 2-1] with 25 data bytes [0 .. 25-1] for the error code stored in this error memory slot" UBYTE EH_STANDARD_S4_S3 1 100 0 255 ECU_ADDRESS 0xFFF82617 DISPLAY_IDENTIFIER ambient_condition[1][14].amb_cond.ydiMemory_xau16[11].ZFEH_EepromData /end MEASUREMENT
/begin MEASUREMENT ZFEH_EepromData.ydiMemory_xau16[11].amb_cond.ambient_condition[1][15] "ambient condition shot [0 .. 2-1] with 25 data bytes [0 .. 25-1] for the error code stored in this error memory slot" UBYTE EH_STANDARD_S4_S3 1 100 0 255 ECU_ADDRESS 0xFFF82618 DISPLAY_IDENTIFIER ambient_condition[1][15].amb_cond.ydiMemory_xau16[11].ZFEH_EepromData /end MEASUREMENT
/begin MEASUREMENT ZFEH_EepromData.ydiMemory_xau16[11].amb_cond.ambient_condition[1][16] "ambient condition shot [0 .. 2-1] with 25 data bytes [0 .. 25-1] for the error code stored in this error memory slot" UBYTE EH_STANDARD_S4_S3 1 100 0 255 ECU_ADDRESS 0xFFF82619 DISPLAY_IDENTIFIER ambient_condition[1][16].amb_cond.ydiMemory_xau16[11].ZFEH_EepromData /end MEASUREMENT
/begin MEASUREMENT ZFEH_EepromData.ydiMemory_xau16[11].amb_cond.ambient_condition[1][17] "ambient condition shot [0 .. 2-1] with 25 data bytes [0 .. 25-1] for the error code stored in this error memory slot" UBYTE EH_STANDARD_S4_S3 1 100 0 255 ECU_ADDRESS 0xFFF8261A DISPLAY_IDENTIFIER ambient_condition[1][17].amb_cond.ydiMemory_xau16[11].ZFEH_EepromData /end MEASUREMENT
/begin MEASUREMENT ZFEH_EepromData.ydiMemory_xau16[11].amb_cond.ambient_condition[1][18] "ambient condition shot [0 .. 2-1] with 25 data bytes [0 .. 25-1] for the error code stored in this error memory slot" UBYTE EH_STANDARD_S4_S3 1 100 0 255 ECU_ADDRESS 0xFFF8261B DISPLAY_IDENTIFIER ambient_condition[1][18].amb_cond.ydiMemory_xau16[11].ZFEH_EepromData /end MEASUREMENT
/begin MEASUREMENT ZFEH_EepromData.ydiMemory_xau16[11].amb_cond.ambient_condition[1][19] "ambient condition shot [0 .. 2-1] with 25 data bytes [0 .. 25-1] for the error code stored in this error memory slot" UBYTE EH_STANDARD_S4_S3 1 100 0 255 ECU_ADDRESS 0xFFF8261C DISPLAY_IDENTIFIER ambient_condition[1][19].amb_cond.ydiMemory_xau16[11].ZFEH_EepromData /end MEASUREMENT
/begin MEASUREMENT ZFEH_EepromData.ydiMemory_xau16[11].amb_cond.ambient_condition[1][1] "ambient condition shot [0 .. 2-1] with 25 data bytes [0 .. 25-1] for the error code stored in this error memory slot" UBYTE EH_STANDARD_S4_S3 1 100 0 255 ECU_ADDRESS 0xFFF8260A DISPLAY_IDENTIFIER ambient_condition[1][1].amb_cond.ydiMemory_xau16[11].ZFEH_EepromData /end MEASUREMENT
/begin MEASUREMENT ZFEH_EepromData.ydiMemory_xau16[11].amb_cond.ambient_condition[1][20] "ambient condition shot [0 .. 2-1] with 25 data bytes [0 .. 25-1] for the error code stored in this error memory slot" UBYTE EH_STANDARD_S4_S3 1 100 0 255 ECU_ADDRESS 0xFFF8261D DISPLAY_IDENTIFIER ambient_condition[1][20].amb_cond.ydiMemory_xau16[11].ZFEH_EepromData /end MEASUREMENT
/begin MEASUREMENT ZFEH_EepromData.ydiMemory_xau16[11].amb_cond.ambient_condition[1][21] "ambient condition shot [0 .. 2-1] with 25 data bytes [0 .. 25-1] for the error code stored in this error memory slot" UBYTE EH_STANDARD_S4_S3 1 100 0 255 ECU_ADDRESS 0xFFF8261E DISPLAY_IDENTIFIER ambient_condition[1][21].amb_cond.ydiMemory_xau16[11].ZFEH_EepromData /end MEASUREMENT
/begin MEASUREMENT ZFEH_EepromData.ydiMemory_xau16[11].amb_cond.ambient_condition[1][22] "ambient condition shot [0 .. 2-1] with 25 data bytes [0 .. 25-1] for the error code stored in this error memory slot" UBYTE EH_STANDARD_S4_S3 1 100 0 255 ECU_ADDRESS 0xFFF8261F DISPLAY_IDENTIFIER ambient_condition[1][22].amb_cond.ydiMemory_xau16[11].ZFEH_EepromData /end MEASUREMENT
/begin MEASUREMENT ZFEH_EepromData.ydiMemory_xau16[11].amb_cond.ambient_condition[1][23] "ambient condition shot [0 .. 2-1] with 25 data bytes [0 .. 25-1] for the error code stored in this error memory slot" UBYTE EH_STANDARD_S4_S3 1 100 0 255 ECU_ADDRESS 0xFFF82620 DISPLAY_IDENTIFIER ambient_condition[1][23].amb_cond.ydiMemory_xau16[11].ZFEH_EepromData /end MEASUREMENT
/begin MEASUREMENT ZFEH_EepromData.ydiMemory_xau16[11].amb_cond.ambient_condition[1][24] "ambient condition shot [0 .. 2-1] with 25 data bytes [0 .. 25-1] for the error code stored in this error memory slot" UBYTE EH_STANDARD_S4_S3 1 100 0 255 ECU_ADDRESS 0xFFF82621 DISPLAY_IDENTIFIER ambient_condition[1][24].amb_cond.ydiMemory_xau16[11].ZFEH_EepromData /end MEASUREMENT
/begin MEASUREMENT ZFEH_EepromData.ydiMemory_xau16[11].amb_cond.ambient_condition[1][2] "ambient condition shot [0 .. 2-1] with 25 data bytes [0 .. 25-1] for the error code stored in this error memory slot" UBYTE EH_STANDARD_S4_S3 1 100 0 255 ECU_ADDRESS 0xFFF8260B DISPLAY_IDENTIFIER ambient_condition[1][2].amb_cond.ydiMemory_xau16[11].ZFEH_EepromData /end MEASUREMENT
/begin MEASUREMENT ZFEH_EepromData.ydiMemory_xau16[11].amb_cond.ambient_condition[1][3] "ambient condition shot [0 .. 2-1] with 25 data bytes [0 .. 25-1] for the error code stored in this error memory slot" UBYTE EH_STANDARD_S4_S3 1 100 0 255 ECU_ADDRESS 0xFFF8260C DISPLAY_IDENTIFIER ambient_condition[1][3].amb_cond.ydiMemory_xau16[11].ZFEH_EepromData /end MEASUREMENT
/begin MEASUREMENT ZFEH_EepromData.ydiMemory_xau16[11].amb_cond.ambient_condition[1][4] "ambient condition shot [0 .. 2-1] with 25 data bytes [0 .. 25-1] for the error code stored in this error memory slot" UBYTE EH_STANDARD_S4_S3 1 100 0 255 ECU_ADDRESS 0xFFF8260D DISPLAY_IDENTIFIER ambient_condition[1][4].amb_cond.ydiMemory_xau16[11].ZFEH_EepromData /end MEASUREMENT
/begin MEASUREMENT ZFEH_EepromData.ydiMemory_xau16[11].amb_cond.ambient_condition[1][5] "ambient condition shot [0 .. 2-1] with 25 data bytes [0 .. 25-1] for the error code stored in this error memory slot" UBYTE EH_STANDARD_S4_S3 1 100 0 255 ECU_ADDRESS 0xFFF8260E DISPLAY_IDENTIFIER ambient_condition[1][5].amb_cond.ydiMemory_xau16[11].ZFEH_EepromData /end MEASUREMENT
/begin MEASUREMENT ZFEH_EepromData.ydiMemory_xau16[11].amb_cond.ambient_condition[1][6] "ambient condition shot [0 .. 2-1] with 25 data bytes [0 .. 25-1] for the error code stored in this error memory slot" UBYTE EH_STANDARD_S4_S3 1 100 0 255 ECU_ADDRESS 0xFFF8260F DISPLAY_IDENTIFIER ambient_condition[1][6].amb_cond.ydiMemory_xau16[11].ZFEH_EepromData /end MEASUREMENT
/begin MEASUREMENT ZFEH_EepromData.ydiMemory_xau16[11].amb_cond.ambient_condition[1][7] "ambient condition shot [0 .. 2-1] with 25 data bytes [0 .. 25-1] for the error code stored in this error memory slot" UBYTE EH_STANDARD_S4_S3 1 100 0 255 ECU_ADDRESS 0xFFF82610 DISPLAY_IDENTIFIER ambient_condition[1][7].amb_cond.ydiMemory_xau16[11].ZFEH_EepromData /end MEASUREMENT
/begin MEASUREMENT ZFEH_EepromData.ydiMemory_xau16[11].amb_cond.ambient_condition[1][8] "ambient condition shot [0 .. 2-1] with 25 data bytes [0 .. 25-1] for the error code stored in this error memory slot" UBYTE EH_STANDARD_S4_S3 1 100 0 255 ECU_ADDRESS 0xFFF82611 DISPLAY_IDENTIFIER ambient_condition[1][8].amb_cond.ydiMemory_xau16[11].ZFEH_EepromData /end MEASUREMENT
/begin MEASUREMENT ZFEH_EepromData.ydiMemory_xau16[11].amb_cond.ambient_condition[1][9] "ambient condition shot [0 .. 2-1] with 25 data bytes [0 .. 25-1] for the error code stored in this error memory slot" UBYTE EH_STANDARD_S4_S3 1 100 0 255 ECU_ADDRESS 0xFFF82612 DISPLAY_IDENTIFIER ambient_condition[1][9].amb_cond.ydiMemory_xau16[11].ZFEH_EepromData /end MEASUREMENT
/begin MEASUREMENT ZFEH_EepromData.ydiMemory_xau16[11].amb_cond.status_of_ambient_conditions[0] "status of ambient condition shot x: 0=invalid 1=valid" UBYTE EH_STANDARD_S4_S3 1 100 0 1 ECU_ADDRESS 0xFFF82622 DISPLAY_IDENTIFIER status_of_ambient_conditions[0].amb_cond.ydiMemory_xau16[11].ZFEH_EepromData /end MEASUREMENT
/begin MEASUREMENT ZFEH_EepromData.ydiMemory_xau16[11].amb_cond.status_of_ambient_conditions[1] "status of ambient condition shot x: 0=invalid 1=valid" UBYTE EH_STANDARD_S4_S3 1 100 0 1 ECU_ADDRESS 0xFFF82623 DISPLAY_IDENTIFIER status_of_ambient_conditions[1].amb_cond.ydiMemory_xau16[11].ZFEH_EepromData /end MEASUREMENT
/begin MEASUREMENT ZFEH_EepromData.ydiMemory_xau16[11].backwards_counter "backwards counter of error code stored in error memory slot" UBYTE EH_STANDARD_S4_S3 1 100 0 255 ECU_ADDRESS 0xFFF825E3 DISPLAY_IDENTIFIER backwards_counter.ydiMemory_xau16[11].ZFEH_EepromData /end MEASUREMENT
/begin MEASUREMENT ZFEH_EepromData.ydiMemory_xau16[11].condition_byte "condition byte of error code stored in error memory slot" UBYTE EH_STANDARD_S4_S3 1 100 0 255 ECU_ADDRESS 0xFFF825ED DISPLAY_IDENTIFIER condition_byte.ydiMemory_xau16[11].ZFEH_EepromData /end MEASUREMENT
/begin MEASUREMENT ZFEH_EepromData.ydiMemory_xau16[11].error_code "error code stored in error memory slot" UWORD EH_STANDARD_S4_S3 1 100 0 65535 ECU_ADDRESS 0xFFF825DC DISPLAY_IDENTIFIER error_code.ydiMemory_xau16[11].ZFEH_EepromData /end MEASUREMENT
/begin MEASUREMENT ZFEH_EepromData.ydiMemory_xau16[11].error_type "error type of error code stored in error memory slot" UWORD EH_STANDARD_S4_S3 1 100 0 65535 ECU_ADDRESS 0xFFF825DE DISPLAY_IDENTIFIER error_type.ydiMemory_xau16[11].ZFEH_EepromData /end MEASUREMENT
/begin MEASUREMENT ZFEH_EepromData.ydiMemory_xau16[11].frequency_counter "frequency counter of error code stored in error memory slot" UBYTE EH_STANDARD_S4_S3 1 100 0 255 ECU_ADDRESS 0xFFF825E2 DISPLAY_IDENTIFIER frequency_counter.ydiMemory_xau16[11].ZFEH_EepromData /end MEASUREMENT
/begin MEASUREMENT ZFEH_EepromData.ydiMemory_xau16[11].master_time "master time of error code stored in error memory slot" ULONG EH_STANDARD_S4_S3 1 100 0 4294967295 ECU_ADDRESS 0xFFF825E8 DISPLAY_IDENTIFIER master_time.ydiMemory_xau16[11].ZFEH_EepromData /end MEASUREMENT
/begin MEASUREMENT ZFEH_EepromData.ydiMemory_xau16[11].obd_driving_cycle_counter "obd driving cycle counter of error code stored in error memory slot" UWORD EH_STANDARD_S4_S3 1 100 0 65535 ECU_ADDRESS 0xFFF825EE DISPLAY_IDENTIFIER obd_driving_cycle_counter.ydiMemory_xau16[11].ZFEH_EepromData /end MEASUREMENT
/begin MEASUREMENT ZFEH_EepromData.ydiMemory_xau16[11].permanent_counter "counter of permanent error codes stored in error memory slot" UBYTE EH_STANDARD_S4_S3 1 100 0 255 ECU_ADDRESS 0xFFF825E4 DISPLAY_IDENTIFIER permanent_counter.ydiMemory_xau16[11].ZFEH_EepromData /end MEASUREMENT
/begin MEASUREMENT ZFEH_EepromData.ydiMemory_xau16[11].sequence_counter "sequence counter of error code stored in error memory slot" UBYTE EH_STANDARD_S4_S3 1 100 0 255 ECU_ADDRESS 0xFFF825E5 DISPLAY_IDENTIFIER sequence_counter.ydiMemory_xau16[11].ZFEH_EepromData /end MEASUREMENT
/begin MEASUREMENT ZFEH_EepromData.ydiMemory_xau16[11].status_word "status word of error code stored in error memory slot" UWORD EH_STANDARD_S4_S3 1 100 0 65535 ECU_ADDRESS 0xFFF825E0 DISPLAY_IDENTIFIER status_word.ydiMemory_xau16[11].ZFEH_EepromData /end MEASUREMENT
/begin MEASUREMENT ZFEH_EepromData.ydiMemory_xau16[12].amb_cond.ambient_condition[0][0] "ambient condition shot [0 .. 2-1] with 25 data bytes [0 .. 25-1] for the error code stored in this error memory slot" UBYTE EH_STANDARD_S4_S3 1 100 0 255 ECU_ADDRESS 0xFFF82638 DISPLAY_IDENTIFIER ambient_condition[0][0].amb_cond.ydiMemory_xau16[12].ZFEH_EepromData /end MEASUREMENT
/begin MEASUREMENT ZFEH_EepromData.ydiMemory_xau16[12].amb_cond.ambient_condition[0][10] "ambient condition shot [0 .. 2-1] with 25 data bytes [0 .. 25-1] for the error code stored in this error memory slot" UBYTE EH_STANDARD_S4_S3 1 100 0 255 ECU_ADDRESS 0xFFF82642 DISPLAY_IDENTIFIER ambient_condition[0][10].amb_cond.ydiMemory_xau16[12].ZFEH_EepromData /end MEASUREMENT
/begin MEASUREMENT ZFEH_EepromData.ydiMemory_xau16[12].amb_cond.ambient_condition[0][11] "ambient condition shot [0 .. 2-1] with 25 data bytes [0 .. 25-1] for the error code stored in this error memory slot" UBYTE EH_STANDARD_S4_S3 1 100 0 255 ECU_ADDRESS 0xFFF82643 DISPLAY_IDENTIFIER ambient_condition[0][11].amb_cond.ydiMemory_xau16[12].ZFEH_EepromData /end MEASUREMENT
/begin MEASUREMENT ZFEH_EepromData.ydiMemory_xau16[12].amb_cond.ambient_condition[0][12] "ambient condition shot [0 .. 2-1] with 25 data bytes [0 .. 25-1] for the error code stored in this error memory slot" UBYTE EH_STANDARD_S4_S3 1 100 0 255 ECU_ADDRESS 0xFFF82644 DISPLAY_IDENTIFIER ambient_condition[0][12].amb_cond.ydiMemory_xau16[12].ZFEH_EepromData /end MEASUREMENT
/begin MEASUREMENT ZFEH_EepromData.ydiMemory_xau16[12].amb_cond.ambient_condition[0][13] "ambient condition shot [0 .. 2-1] with 25 data bytes [0 .. 25-1] for the error code stored in this error memory slot" UBYTE EH_STANDARD_S4_S3 1 100 0 255 ECU_ADDRESS 0xFFF82645 DISPLAY_IDENTIFIER ambient_condition[0][13].amb_cond.ydiMemory_xau16[12].ZFEH_EepromData /end MEASUREMENT
/begin MEASUREMENT ZFEH_EepromData.ydiMemory_xau16[12].amb_cond.ambient_condition[0][14] "ambient condition shot [0 .. 2-1] with 25 data bytes [0 .. 25-1] for the error code stored in this error memory slot" UBYTE EH_STANDARD_S4_S3 1 100 0 255 ECU_ADDRESS 0xFFF82646 DISPLAY_IDENTIFIER ambient_condition[0][14].amb_cond.ydiMemory_xau16[12].ZFEH_EepromData /end MEASUREMENT
/begin MEASUREMENT ZFEH_EepromData.ydiMemory_xau16[12].amb_cond.ambient_condition[0][15] "ambient condition shot [0 .. 2-1] with 25 data bytes [0 .. 25-1] for the error code stored in this error memory slot" UBYTE EH_STANDARD_S4_S3 1 100 0 255 ECU_ADDRESS 0xFFF82647 DISPLAY_IDENTIFIER ambient_condition[0][15].amb_cond.ydiMemory_xau16[12].ZFEH_EepromData /end MEASUREMENT
/begin MEASUREMENT ZFEH_EepromData.ydiMemory_xau16[12].amb_cond.ambient_condition[0][16] "ambient condition shot [0 .. 2-1] with 25 data bytes [0 .. 25-1] for the error code stored in this error memory slot" UBYTE EH_STANDARD_S4_S3 1 100 0 255 ECU_ADDRESS 0xFFF82648 DISPLAY_IDENTIFIER ambient_condition[0][16].amb_cond.ydiMemory_xau16[12].ZFEH_EepromData /end MEASUREMENT
/begin MEASUREMENT ZFEH_EepromData.ydiMemory_xau16[12].amb_cond.ambient_condition[0][17] "ambient condition shot [0 .. 2-1] with 25 data bytes [0 .. 25-1] for the error code stored in this error memory slot" UBYTE EH_STANDARD_S4_S3 1 100 0 255 ECU_ADDRESS 0xFFF82649 DISPLAY_IDENTIFIER ambient_condition[0][17].amb_cond.ydiMemory_xau16[12].ZFEH_EepromData /end MEASUREMENT
/begin MEASUREMENT ZFEH_EepromData.ydiMemory_xau16[12].amb_cond.ambient_condition[0][18] "ambient condition shot [0 .. 2-1] with 25 data bytes [0 .. 25-1] for the error code stored in this error memory slot" UBYTE EH_STANDARD_S4_S3 1 100 0 255 ECU_ADDRESS 0xFFF8264A DISPLAY_IDENTIFIER ambient_condition[0][18].amb_cond.ydiMemory_xau16[12].ZFEH_EepromData /end MEASUREMENT
/begin MEASUREMENT ZFEH_EepromData.ydiMemory_xau16[12].amb_cond.ambient_condition[0][19] "ambient condition shot [0 .. 2-1] with 25 data bytes [0 .. 25-1] for the error code stored in this error memory slot" UBYTE EH_STANDARD_S4_S3 1 100 0 255 ECU_ADDRESS 0xFFF8264B DISPLAY_IDENTIFIER ambient_condition[0][19].amb_cond.ydiMemory_xau16[12].ZFEH_EepromData /end MEASUREMENT
/begin MEASUREMENT ZFEH_EepromData.ydiMemory_xau16[12].amb_cond.ambient_condition[0][1] "ambient condition shot [0 .. 2-1] with 25 data bytes [0 .. 25-1] for the error code stored in this error memory slot" UBYTE EH_STANDARD_S4_S3 1 100 0 255 ECU_ADDRESS 0xFFF82639 DISPLAY_IDENTIFIER ambient_condition[0][1].amb_cond.ydiMemory_xau16[12].ZFEH_EepromData /end MEASUREMENT
/begin MEASUREMENT ZFEH_EepromData.ydiMemory_xau16[12].amb_cond.ambient_condition[0][20] "ambient condition shot [0 .. 2-1] with 25 data bytes [0 .. 25-1] for the error code stored in this error memory slot" UBYTE EH_STANDARD_S4_S3 1 100 0 255 ECU_ADDRESS 0xFFF8264C DISPLAY_IDENTIFIER ambient_condition[0][20].amb_cond.ydiMemory_xau16[12].ZFEH_EepromData /end MEASUREMENT
/begin MEASUREMENT ZFEH_EepromData.ydiMemory_xau16[12].amb_cond.ambient_condition[0][21] "ambient condition shot [0 .. 2-1] with 25 data bytes [0 .. 25-1] for the error code stored in this error memory slot" UBYTE EH_STANDARD_S4_S3 1 100 0 255 ECU_ADDRESS 0xFFF8264D DISPLAY_IDENTIFIER ambient_condition[0][21].amb_cond.ydiMemory_xau16[12].ZFEH_EepromData /end MEASUREMENT
/begin MEASUREMENT ZFEH_EepromData.ydiMemory_xau16[12].amb_cond.ambient_condition[0][22] "ambient condition shot [0 .. 2-1] with 25 data bytes [0 .. 25-1] for the error code stored in this error memory slot" UBYTE EH_STANDARD_S4_S3 1 100 0 255 ECU_ADDRESS 0xFFF8264E DISPLAY_IDENTIFIER ambient_condition[0][22].amb_cond.ydiMemory_xau16[12].ZFEH_EepromData /end MEASUREMENT
/begin MEASUREMENT ZFEH_EepromData.ydiMemory_xau16[12].amb_cond.ambient_condition[0][23] "ambient condition shot [0 .. 2-1] with 25 data bytes [0 .. 25-1] for the error code stored in this error memory slot" UBYTE EH_STANDARD_S4_S3 1 100 0 255 ECU_ADDRESS 0xFFF8264F DISPLAY_IDENTIFIER ambient_condition[0][23].amb_cond.ydiMemory_xau16[12].ZFEH_EepromData /end MEASUREMENT
/begin MEASUREMENT ZFEH_EepromData.ydiMemory_xau16[12].amb_cond.ambient_condition[0][24] "ambient condition shot [0 .. 2-1] with 25 data bytes [0 .. 25-1] for the error code stored in this error memory slot" UBYTE EH_STANDARD_S4_S3 1 100 0 255 ECU_ADDRESS 0xFFF82650 DISPLAY_IDENTIFIER ambient_condition[0][24].amb_cond.ydiMemory_xau16[12].ZFEH_EepromData /end MEASUREMENT
/begin MEASUREMENT ZFEH_EepromData.ydiMemory_xau16[12].amb_cond.ambient_condition[0][2] "ambient condition shot [0 .. 2-1] with 25 data bytes [0 .. 25-1] for the error code stored in this error memory slot" UBYTE EH_STANDARD_S4_S3 1 100 0 255 ECU_ADDRESS 0xFFF8263A DISPLAY_IDENTIFIER ambient_condition[0][2].amb_cond.ydiMemory_xau16[12].ZFEH_EepromData /end MEASUREMENT
/begin MEASUREMENT ZFEH_EepromData.ydiMemory_xau16[12].amb_cond.ambient_condition[0][3] "ambient condition shot [0 .. 2-1] with 25 data bytes [0 .. 25-1] for the error code stored in this error memory slot" UBYTE EH_STANDARD_S4_S3 1 100 0 255 ECU_ADDRESS 0xFFF8263B DISPLAY_IDENTIFIER ambient_condition[0][3].amb_cond.ydiMemory_xau16[12].ZFEH_EepromData /end MEASUREMENT
/begin MEASUREMENT ZFEH_EepromData.ydiMemory_xau16[12].amb_cond.ambient_condition[0][4] "ambient condition shot [0 .. 2-1] with 25 data bytes [0 .. 25-1] for the error code stored in this error memory slot" UBYTE EH_STANDARD_S4_S3 1 100 0 255 ECU_ADDRESS 0xFFF8263C DISPLAY_IDENTIFIER ambient_condition[0][4].amb_cond.ydiMemory_xau16[12].ZFEH_EepromData /end MEASUREMENT
/begin MEASUREMENT ZFEH_EepromData.ydiMemory_xau16[12].amb_cond.ambient_condition[0][5] "ambient condition shot [0 .. 2-1] with 25 data bytes [0 .. 25-1] for the error code stored in this error memory slot" UBYTE EH_STANDARD_S4_S3 1 100 0 255 ECU_ADDRESS 0xFFF8263D DISPLAY_IDENTIFIER ambient_condition[0][5].amb_cond.ydiMemory_xau16[12].ZFEH_EepromData /end MEASUREMENT
/begin MEASUREMENT ZFEH_EepromData.ydiMemory_xau16[12].amb_cond.ambient_condition[0][6] "ambient condition shot [0 .. 2-1] with 25 data bytes [0 .. 25-1] for the error code stored in this error memory slot" UBYTE EH_STANDARD_S4_S3 1 100 0 255 ECU_ADDRESS 0xFFF8263E DISPLAY_IDENTIFIER ambient_condition[0][6].amb_cond.ydiMemory_xau16[12].ZFEH_EepromData /end MEASUREMENT
/begin MEASUREMENT ZFEH_EepromData.ydiMemory_xau16[12].amb_cond.ambient_condition[0][7] "ambient condition shot [0 .. 2-1] with 25 data bytes [0 .. 25-1] for the error code stored in this error memory slot" UBYTE EH_STANDARD_S4_S3 1 100 0 255 ECU_ADDRESS 0xFFF8263F DISPLAY_IDENTIFIER ambient_condition[0][7].amb_cond.ydiMemory_xau16[12].ZFEH_EepromData /end MEASUREMENT
/begin MEASUREMENT ZFEH_EepromData.ydiMemory_xau16[12].amb_cond.ambient_condition[0][8] "ambient condition shot [0 .. 2-1] with 25 data bytes [0 .. 25-1] for the error code stored in this error memory slot" UBYTE EH_STANDARD_S4_S3 1 100 0 255 ECU_ADDRESS 0xFFF82640 DISPLAY_IDENTIFIER ambient_condition[0][8].amb_cond.ydiMemory_xau16[12].ZFEH_EepromData /end MEASUREMENT
/begin MEASUREMENT ZFEH_EepromData.ydiMemory_xau16[12].amb_cond.ambient_condition[0][9] "ambient condition shot [0 .. 2-1] with 25 data bytes [0 .. 25-1] for the error code stored in this error memory slot" UBYTE EH_STANDARD_S4_S3 1 100 0 255 ECU_ADDRESS 0xFFF82641 DISPLAY_IDENTIFIER ambient_condition[0][9].amb_cond.ydiMemory_xau16[12].ZFEH_EepromData /end MEASUREMENT
/begin MEASUREMENT ZFEH_EepromData.ydiMemory_xau16[12].amb_cond.ambient_condition[1][0] "ambient condition shot [0 .. 2-1] with 25 data bytes [0 .. 25-1] for the error code stored in this error memory slot" UBYTE EH_STANDARD_S4_S3 1 100 0 255 ECU_ADDRESS 0xFFF82651 DISPLAY_IDENTIFIER ambient_condition[1][0].amb_cond.ydiMemory_xau16[12].ZFEH_EepromData /end MEASUREMENT
/begin MEASUREMENT ZFEH_EepromData.ydiMemory_xau16[12].amb_cond.ambient_condition[1][10] "ambient condition shot [0 .. 2-1] with 25 data bytes [0 .. 25-1] for the error code stored in this error memory slot" UBYTE EH_STANDARD_S4_S3 1 100 0 255 ECU_ADDRESS 0xFFF8265B DISPLAY_IDENTIFIER ambient_condition[1][10].amb_cond.ydiMemory_xau16[12].ZFEH_EepromData /end MEASUREMENT
/begin MEASUREMENT ZFEH_EepromData.ydiMemory_xau16[12].amb_cond.ambient_condition[1][11] "ambient condition shot [0 .. 2-1] with 25 data bytes [0 .. 25-1] for the error code stored in this error memory slot" UBYTE EH_STANDARD_S4_S3 1 100 0 255 ECU_ADDRESS 0xFFF8265C DISPLAY_IDENTIFIER ambient_condition[1][11].amb_cond.ydiMemory_xau16[12].ZFEH_EepromData /end MEASUREMENT
/begin MEASUREMENT ZFEH_EepromData.ydiMemory_xau16[12].amb_cond.ambient_condition[1][12] "ambient condition shot [0 .. 2-1] with 25 data bytes [0 .. 25-1] for the error code stored in this error memory slot" UBYTE EH_STANDARD_S4_S3 1 100 0 255 ECU_ADDRESS 0xFFF8265D DISPLAY_IDENTIFIER ambient_condition[1][12].amb_cond.ydiMemory_xau16[12].ZFEH_EepromData /end MEASUREMENT
/begin MEASUREMENT ZFEH_EepromData.ydiMemory_xau16[12].amb_cond.ambient_condition[1][13] "ambient condition shot [0 .. 2-1] with 25 data bytes [0 .. 25-1] for the error code stored in this error memory slot" UBYTE EH_STANDARD_S4_S3 1 100 0 255 ECU_ADDRESS 0xFFF8265E DISPLAY_IDENTIFIER ambient_condition[1][13].amb_cond.ydiMemory_xau16[12].ZFEH_EepromData /end MEASUREMENT
/begin MEASUREMENT ZFEH_EepromData.ydiMemory_xau16[12].amb_cond.ambient_condition[1][14] "ambient condition shot [0 .. 2-1] with 25 data bytes [0 .. 25-1] for the error code stored in this error memory slot" UBYTE EH_STANDARD_S4_S3 1 100 0 255 ECU_ADDRESS 0xFFF8265F DISPLAY_IDENTIFIER ambient_condition[1][14].amb_cond.ydiMemory_xau16[12].ZFEH_EepromData /end MEASUREMENT
/begin MEASUREMENT ZFEH_EepromData.ydiMemory_xau16[12].amb_cond.ambient_condition[1][15] "ambient condition shot [0 .. 2-1] with 25 data bytes [0 .. 25-1] for the error code stored in this error memory slot" UBYTE EH_STANDARD_S4_S3 1 100 0 255 ECU_ADDRESS 0xFFF82660 DISPLAY_IDENTIFIER ambient_condition[1][15].amb_cond.ydiMemory_xau16[12].ZFEH_EepromData /end MEASUREMENT
/begin MEASUREMENT ZFEH_EepromData.ydiMemory_xau16[12].amb_cond.ambient_condition[1][16] "ambient condition shot [0 .. 2-1] with 25 data bytes [0 .. 25-1] for the error code stored in this error memory slot" UBYTE EH_STANDARD_S4_S3 1 100 0 255 ECU_ADDRESS 0xFFF82661 DISPLAY_IDENTIFIER ambient_condition[1][16].amb_cond.ydiMemory_xau16[12].ZFEH_EepromData /end MEASUREMENT
/begin MEASUREMENT ZFEH_EepromData.ydiMemory_xau16[12].amb_cond.ambient_condition[1][17] "ambient condition shot [0 .. 2-1] with 25 data bytes [0 .. 25-1] for the error code stored in this error memory slot" UBYTE EH_STANDARD_S4_S3 1 100 0 255 ECU_ADDRESS 0xFFF82662 DISPLAY_IDENTIFIER ambient_condition[1][17].amb_cond.ydiMemory_xau16[12].ZFEH_EepromData /end MEASUREMENT
/begin MEASUREMENT ZFEH_EepromData.ydiMemory_xau16[12].amb_cond.ambient_condition[1][18] "ambient condition shot [0 .. 2-1] with 25 data bytes [0 .. 25-1] for the error code stored in this error memory slot" UBYTE EH_STANDARD_S4_S3 1 100 0 255 ECU_ADDRESS 0xFFF82663 DISPLAY_IDENTIFIER ambient_condition[1][18].amb_cond.ydiMemory_xau16[12].ZFEH_EepromData /end MEASUREMENT
/begin MEASUREMENT ZFEH_EepromData.ydiMemory_xau16[12].amb_cond.ambient_condition[1][19] "ambient condition shot [0 .. 2-1] with 25 data bytes [0 .. 25-1] for the error code stored in this error memory slot" UBYTE EH_STANDARD_S4_S3 1 100 0 255 ECU_ADDRESS 0xFFF82664 DISPLAY_IDENTIFIER ambient_condition[1][19].amb_cond.ydiMemory_xau16[12].ZFEH_EepromData /end MEASUREMENT
/begin MEASUREMENT ZFEH_EepromData.ydiMemory_xau16[12].amb_cond.ambient_condition[1][1] "ambient condition shot [0 .. 2-1] with 25 data bytes [0 .. 25-1] for the error code stored in this error memory slot" UBYTE EH_STANDARD_S4_S3 1 100 0 255 ECU_ADDRESS 0xFFF82652 DISPLAY_IDENTIFIER ambient_condition[1][1].amb_cond.ydiMemory_xau16[12].ZFEH_EepromData /end MEASUREMENT
/begin MEASUREMENT ZFEH_EepromData.ydiMemory_xau16[12].amb_cond.ambient_condition[1][20] "ambient condition shot [0 .. 2-1] with 25 data bytes [0 .. 25-1] for the error code stored in this error memory slot" UBYTE EH_STANDARD_S4_S3 1 100 0 255 ECU_ADDRESS 0xFFF82665 DISPLAY_IDENTIFIER ambient_condition[1][20].amb_cond.ydiMemory_xau16[12].ZFEH_EepromData /end MEASUREMENT
/begin MEASUREMENT ZFEH_EepromData.ydiMemory_xau16[12].amb_cond.ambient_condition[1][21] "ambient condition shot [0 .. 2-1] with 25 data bytes [0 .. 25-1] for the error code stored in this error memory slot" UBYTE EH_STANDARD_S4_S3 1 100 0 255 ECU_ADDRESS 0xFFF82666 DISPLAY_IDENTIFIER ambient_condition[1][21].amb_cond.ydiMemory_xau16[12].ZFEH_EepromData /end MEASUREMENT
/begin MEASUREMENT ZFEH_EepromData.ydiMemory_xau16[12].amb_cond.ambient_condition[1][22] "ambient condition shot [0 .. 2-1] with 25 data bytes [0 .. 25-1] for the error code stored in this error memory slot" UBYTE EH_STANDARD_S4_S3 1 100 0 255 ECU_ADDRESS 0xFFF82667 DISPLAY_IDENTIFIER ambient_condition[1][22].amb_cond.ydiMemory_xau16[12].ZFEH_EepromData /end MEASUREMENT
/begin MEASUREMENT ZFEH_EepromData.ydiMemory_xau16[12].amb_cond.ambient_condition[1][23] "ambient condition shot [0 .. 2-1] with 25 data bytes [0 .. 25-1] for the error code stored in this error memory slot" UBYTE EH_STANDARD_S4_S3 1 100 0 255 ECU_ADDRESS 0xFFF82668 DISPLAY_IDENTIFIER ambient_condition[1][23].amb_cond.ydiMemory_xau16[12].ZFEH_EepromData /end MEASUREMENT
/begin MEASUREMENT ZFEH_EepromData.ydiMemory_xau16[12].amb_cond.ambient_condition[1][24] "ambient condition shot [0 .. 2-1] with 25 data bytes [0 .. 25-1] for the error code stored in this error memory slot" UBYTE EH_STANDARD_S4_S3 1 100 0 255 ECU_ADDRESS 0xFFF82669 DISPLAY_IDENTIFIER ambient_condition[1][24].amb_cond.ydiMemory_xau16[12].ZFEH_EepromData /end MEASUREMENT
/begin MEASUREMENT ZFEH_EepromData.ydiMemory_xau16[12].amb_cond.ambient_condition[1][2] "ambient condition shot [0 .. 2-1] with 25 data bytes [0 .. 25-1] for the error code stored in this error memory slot" UBYTE EH_STANDARD_S4_S3 1 100 0 255 ECU_ADDRESS 0xFFF82653 DISPLAY_IDENTIFIER ambient_condition[1][2].amb_cond.ydiMemory_xau16[12].ZFEH_EepromData /end MEASUREMENT
/begin MEASUREMENT ZFEH_EepromData.ydiMemory_xau16[12].amb_cond.ambient_condition[1][3] "ambient condition shot [0 .. 2-1] with 25 data bytes [0 .. 25-1] for the error code stored in this error memory slot" UBYTE EH_STANDARD_S4_S3 1 100 0 255 ECU_ADDRESS 0xFFF82654 DISPLAY_IDENTIFIER ambient_condition[1][3].amb_cond.ydiMemory_xau16[12].ZFEH_EepromData /end MEASUREMENT
/begin MEASUREMENT ZFEH_EepromData.ydiMemory_xau16[12].amb_cond.ambient_condition[1][4] "ambient condition shot [0 .. 2-1] with 25 data bytes [0 .. 25-1] for the error code stored in this error memory slot" UBYTE EH_STANDARD_S4_S3 1 100 0 255 ECU_ADDRESS 0xFFF82655 DISPLAY_IDENTIFIER ambient_condition[1][4].amb_cond.ydiMemory_xau16[12].ZFEH_EepromData /end MEASUREMENT
/begin MEASUREMENT ZFEH_EepromData.ydiMemory_xau16[12].amb_cond.ambient_condition[1][5] "ambient condition shot [0 .. 2-1] with 25 data bytes [0 .. 25-1] for the error code stored in this error memory slot" UBYTE EH_STANDARD_S4_S3 1 100 0 255 ECU_ADDRESS 0xFFF82656 DISPLAY_IDENTIFIER ambient_condition[1][5].amb_cond.ydiMemory_xau16[12].ZFEH_EepromData /end MEASUREMENT
/begin MEASUREMENT ZFEH_EepromData.ydiMemory_xau16[12].amb_cond.ambient_condition[1][6] "ambient condition shot [0 .. 2-1] with 25 data bytes [0 .. 25-1] for the error code stored in this error memory slot" UBYTE EH_STANDARD_S4_S3 1 100 0 255 ECU_ADDRESS 0xFFF82657 DISPLAY_IDENTIFIER ambient_condition[1][6].amb_cond.ydiMemory_xau16[12].ZFEH_EepromData /end MEASUREMENT
/begin MEASUREMENT ZFEH_EepromData.ydiMemory_xau16[12].amb_cond.ambient_condition[1][7] "ambient condition shot [0 .. 2-1] with 25 data bytes [0 .. 25-1] for the error code stored in this error memory slot" UBYTE EH_STANDARD_S4_S3 1 100 0 255 ECU_ADDRESS 0xFFF82658 DISPLAY_IDENTIFIER ambient_condition[1][7].amb_cond.ydiMemory_xau16[12].ZFEH_EepromData /end MEASUREMENT
/begin MEASUREMENT ZFEH_EepromData.ydiMemory_xau16[12].amb_cond.ambient_condition[1][8] "ambient condition shot [0 .. 2-1] with 25 data bytes [0 .. 25-1] for the error code stored in this error memory slot" UBYTE EH_STANDARD_S4_S3 1 100 0 255 ECU_ADDRESS 0xFFF82659 DISPLAY_IDENTIFIER ambient_condition[1][8].amb_cond.ydiMemory_xau16[12].ZFEH_EepromData /end MEASUREMENT
/begin MEASUREMENT ZFEH_EepromData.ydiMemory_xau16[12].amb_cond.ambient_condition[1][9] "ambient condition shot [0 .. 2-1] with 25 data bytes [0 .. 25-1] for the error code stored in this error memory slot" UBYTE EH_STANDARD_S4_S3 1 100 0 255 ECU_ADDRESS 0xFFF8265A DISPLAY_IDENTIFIER ambient_condition[1][9].amb_cond.ydiMemory_xau16[12].ZFEH_EepromData /end MEASUREMENT
/begin MEASUREMENT ZFEH_EepromData.ydiMemory_xau16[12].amb_cond.status_of_ambient_conditions[0] "status of ambient condition shot x: 0=invalid 1=valid" UBYTE EH_STANDARD_S4_S3 1 100 0 1 ECU_ADDRESS 0xFFF8266A DISPLAY_IDENTIFIER status_of_ambient_conditions[0].amb_cond.ydiMemory_xau16[12].ZFEH_EepromData /end MEASUREMENT
/begin MEASUREMENT ZFEH_EepromData.ydiMemory_xau16[12].amb_cond.status_of_ambient_conditions[1] "status of ambient condition shot x: 0=invalid 1=valid" UBYTE EH_STANDARD_S4_S3 1 100 0 1 ECU_ADDRESS 0xFFF8266B DISPLAY_IDENTIFIER status_of_ambient_conditions[1].amb_cond.ydiMemory_xau16[12].ZFEH_EepromData /end MEASUREMENT
/begin MEASUREMENT ZFEH_EepromData.ydiMemory_xau16[12].backwards_counter "backwards counter of error code stored in error memory slot" UBYTE EH_STANDARD_S4_S3 1 100 0 255 ECU_ADDRESS 0xFFF8262B DISPLAY_IDENTIFIER backwards_counter.ydiMemory_xau16[12].ZFEH_EepromData /end MEASUREMENT
/begin MEASUREMENT ZFEH_EepromData.ydiMemory_xau16[12].condition_byte "condition byte of error code stored in error memory slot" UBYTE EH_STANDARD_S4_S3 1 100 0 255 ECU_ADDRESS 0xFFF82635 DISPLAY_IDENTIFIER condition_byte.ydiMemory_xau16[12].ZFEH_EepromData /end MEASUREMENT
/begin MEASUREMENT ZFEH_EepromData.ydiMemory_xau16[12].error_code "error code stored in error memory slot" UWORD EH_STANDARD_S4_S3 1 100 0 65535 ECU_ADDRESS 0xFFF82624 DISPLAY_IDENTIFIER error_code.ydiMemory_xau16[12].ZFEH_EepromData /end MEASUREMENT
/begin MEASUREMENT ZFEH_EepromData.ydiMemory_xau16[12].error_type "error type of error code stored in error memory slot" UWORD EH_STANDARD_S4_S3 1 100 0 65535 ECU_ADDRESS 0xFFF82626 DISPLAY_IDENTIFIER error_type.ydiMemory_xau16[12].ZFEH_EepromData /end MEASUREMENT
/begin MEASUREMENT ZFEH_EepromData.ydiMemory_xau16[12].frequency_counter "frequency counter of error code stored in error memory slot" UBYTE EH_STANDARD_S4_S3 1 100 0 255 ECU_ADDRESS 0xFFF8262A DISPLAY_IDENTIFIER frequency_counter.ydiMemory_xau16[12].ZFEH_EepromData /end MEASUREMENT
/begin MEASUREMENT ZFEH_EepromData.ydiMemory_xau16[12].master_time "master time of error code stored in error memory slot" ULONG EH_STANDARD_S4_S3 1 100 0 4294967295 ECU_ADDRESS 0xFFF82630 DISPLAY_IDENTIFIER master_time.ydiMemory_xau16[12].ZFEH_EepromData /end MEASUREMENT
/begin MEASUREMENT ZFEH_EepromData.ydiMemory_xau16[12].obd_driving_cycle_counter "obd driving cycle counter of error code stored in error memory slot" UWORD EH_STANDARD_S4_S3 1 100 0 65535 ECU_ADDRESS 0xFFF82636 DISPLAY_IDENTIFIER obd_driving_cycle_counter.ydiMemory_xau16[12].ZFEH_EepromData /end MEASUREMENT
/begin MEASUREMENT ZFEH_EepromData.ydiMemory_xau16[12].permanent_counter "counter of permanent error codes stored in error memory slot" UBYTE EH_STANDARD_S4_S3 1 100 0 255 ECU_ADDRESS 0xFFF8262C DISPLAY_IDENTIFIER permanent_counter.ydiMemory_xau16[12].ZFEH_EepromData /end MEASUREMENT
/begin MEASUREMENT ZFEH_EepromData.ydiMemory_xau16[12].sequence_counter "sequence counter of error code stored in error memory slot" UBYTE EH_STANDARD_S4_S3 1 100 0 255 ECU_ADDRESS 0xFFF8262D DISPLAY_IDENTIFIER sequence_counter.ydiMemory_xau16[12].ZFEH_EepromData /end MEASUREMENT
/begin MEASUREMENT ZFEH_EepromData.ydiMemory_xau16[12].status_word "status word of error code stored in error memory slot" UWORD EH_STANDARD_S4_S3 1 100 0 65535 ECU_ADDRESS 0xFFF82628 DISPLAY_IDENTIFIER status_word.ydiMemory_xau16[12].ZFEH_EepromData /end MEASUREMENT
/begin MEASUREMENT ZFEH_EepromData.ydiMemory_xau16[13].amb_cond.ambient_condition[0][0] "ambient condition shot [0 .. 2-1] with 25 data bytes [0 .. 25-1] for the error code stored in this error memory slot" UBYTE EH_STANDARD_S4_S3 1 100 0 255 ECU_ADDRESS 0xFFF82680 DISPLAY_IDENTIFIER ambient_condition[0][0].amb_cond.ydiMemory_xau16[13].ZFEH_EepromData /end MEASUREMENT
/begin MEASUREMENT ZFEH_EepromData.ydiMemory_xau16[13].amb_cond.ambient_condition[0][10] "ambient condition shot [0 .. 2-1] with 25 data bytes [0 .. 25-1] for the error code stored in this error memory slot" UBYTE EH_STANDARD_S4_S3 1 100 0 255 ECU_ADDRESS 0xFFF8268A DISPLAY_IDENTIFIER ambient_condition[0][10].amb_cond.ydiMemory_xau16[13].ZFEH_EepromData /end MEASUREMENT
/begin MEASUREMENT ZFEH_EepromData.ydiMemory_xau16[13].amb_cond.ambient_condition[0][11] "ambient condition shot [0 .. 2-1] with 25 data bytes [0 .. 25-1] for the error code stored in this error memory slot" UBYTE EH_STANDARD_S4_S3 1 100 0 255 ECU_ADDRESS 0xFFF8268B DISPLAY_IDENTIFIER ambient_condition[0][11].amb_cond.ydiMemory_xau16[13].ZFEH_EepromData /end MEASUREMENT
/begin MEASUREMENT ZFEH_EepromData.ydiMemory_xau16[13].amb_cond.ambient_condition[0][12] "ambient condition shot [0 .. 2-1] with 25 data bytes [0 .. 25-1] for the error code stored in this error memory slot" UBYTE EH_STANDARD_S4_S3 1 100 0 255 ECU_ADDRESS 0xFFF8268C DISPLAY_IDENTIFIER ambient_condition[0][12].amb_cond.ydiMemory_xau16[13].ZFEH_EepromData /end MEASUREMENT
/begin MEASUREMENT ZFEH_EepromData.ydiMemory_xau16[13].amb_cond.ambient_condition[0][13] "ambient condition shot [0 .. 2-1] with 25 data bytes [0 .. 25-1] for the error code stored in this error memory slot" UBYTE EH_STANDARD_S4_S3 1 100 0 255 ECU_ADDRESS 0xFFF8268D DISPLAY_IDENTIFIER ambient_condition[0][13].amb_cond.ydiMemory_xau16[13].ZFEH_EepromData /end MEASUREMENT
/begin MEASUREMENT ZFEH_EepromData.ydiMemory_xau16[13].amb_cond.ambient_condition[0][14] "ambient condition shot [0 .. 2-1] with 25 data bytes [0 .. 25-1] for the error code stored in this error memory slot" UBYTE EH_STANDARD_S4_S3 1 100 0 255 ECU_ADDRESS 0xFFF8268E DISPLAY_IDENTIFIER ambient_condition[0][14].amb_cond.ydiMemory_xau16[13].ZFEH_EepromData /end MEASUREMENT
/begin MEASUREMENT ZFEH_EepromData.ydiMemory_xau16[13].amb_cond.ambient_condition[0][15] "ambient condition shot [0 .. 2-1] with 25 data bytes [0 .. 25-1] for the error code stored in this error memory slot" UBYTE EH_STANDARD_S4_S3 1 100 0 255 ECU_ADDRESS 0xFFF8268F DISPLAY_IDENTIFIER ambient_condition[0][15].amb_cond.ydiMemory_xau16[13].ZFEH_EepromData /end MEASUREMENT
/begin MEASUREMENT ZFEH_EepromData.ydiMemory_xau16[13].amb_cond.ambient_condition[0][16] "ambient condition shot [0 .. 2-1] with 25 data bytes [0 .. 25-1] for the error code stored in this error memory slot" UBYTE EH_STANDARD_S4_S3 1 100 0 255 ECU_ADDRESS 0xFFF82690 DISPLAY_IDENTIFIER ambient_condition[0][16].amb_cond.ydiMemory_xau16[13].ZFEH_EepromData /end MEASUREMENT
/begin MEASUREMENT ZFEH_EepromData.ydiMemory_xau16[13].amb_cond.ambient_condition[0][17] "ambient condition shot [0 .. 2-1] with 25 data bytes [0 .. 25-1] for the error code stored in this error memory slot" UBYTE EH_STANDARD_S4_S3 1 100 0 255 ECU_ADDRESS 0xFFF82691 DISPLAY_IDENTIFIER ambient_condition[0][17].amb_cond.ydiMemory_xau16[13].ZFEH_EepromData /end MEASUREMENT
/begin MEASUREMENT ZFEH_EepromData.ydiMemory_xau16[13].amb_cond.ambient_condition[0][18] "ambient condition shot [0 .. 2-1] with 25 data bytes [0 .. 25-1] for the error code stored in this error memory slot" UBYTE EH_STANDARD_S4_S3 1 100 0 255 ECU_ADDRESS 0xFFF82692 DISPLAY_IDENTIFIER ambient_condition[0][18].amb_cond.ydiMemory_xau16[13].ZFEH_EepromData /end MEASUREMENT
/begin MEASUREMENT ZFEH_EepromData.ydiMemory_xau16[13].amb_cond.ambient_condition[0][19] "ambient condition shot [0 .. 2-1] with 25 data bytes [0 .. 25-1] for the error code stored in this error memory slot" UBYTE EH_STANDARD_S4_S3 1 100 0 255 ECU_ADDRESS 0xFFF82693 DISPLAY_IDENTIFIER ambient_condition[0][19].amb_cond.ydiMemory_xau16[13].ZFEH_EepromData /end MEASUREMENT
/begin MEASUREMENT ZFEH_EepromData.ydiMemory_xau16[13].amb_cond.ambient_condition[0][1] "ambient condition shot [0 .. 2-1] with 25 data bytes [0 .. 25-1] for the error code stored in this error memory slot" UBYTE EH_STANDARD_S4_S3 1 100 0 255 ECU_ADDRESS 0xFFF82681 DISPLAY_IDENTIFIER ambient_condition[0][1].amb_cond.ydiMemory_xau16[13].ZFEH_EepromData /end MEASUREMENT
/begin MEASUREMENT ZFEH_EepromData.ydiMemory_xau16[13].amb_cond.ambient_condition[0][20] "ambient condition shot [0 .. 2-1] with 25 data bytes [0 .. 25-1] for the error code stored in this error memory slot" UBYTE EH_STANDARD_S4_S3 1 100 0 255 ECU_ADDRESS 0xFFF82694 DISPLAY_IDENTIFIER ambient_condition[0][20].amb_cond.ydiMemory_xau16[13].ZFEH_EepromData /end MEASUREMENT
/begin MEASUREMENT ZFEH_EepromData.ydiMemory_xau16[13].amb_cond.ambient_condition[0][21] "ambient condition shot [0 .. 2-1] with 25 data bytes [0 .. 25-1] for the error code stored in this error memory slot" UBYTE EH_STANDARD_S4_S3 1 100 0 255 ECU_ADDRESS 0xFFF82695 DISPLAY_IDENTIFIER ambient_condition[0][21].amb_cond.ydiMemory_xau16[13].ZFEH_EepromData /end MEASUREMENT
/begin MEASUREMENT ZFEH_EepromData.ydiMemory_xau16[13].amb_cond.ambient_condition[0][22] "ambient condition shot [0 .. 2-1] with 25 data bytes [0 .. 25-1] for the error code stored in this error memory slot" UBYTE EH_STANDARD_S4_S3 1 100 0 255 ECU_ADDRESS 0xFFF82696 DISPLAY_IDENTIFIER ambient_condition[0][22].amb_cond.ydiMemory_xau16[13].ZFEH_EepromData /end MEASUREMENT
/begin MEASUREMENT ZFEH_EepromData.ydiMemory_xau16[13].amb_cond.ambient_condition[0][23] "ambient condition shot [0 .. 2-1] with 25 data bytes [0 .. 25-1] for the error code stored in this error memory slot" UBYTE EH_STANDARD_S4_S3 1 100 0 255 ECU_ADDRESS 0xFFF82697 DISPLAY_IDENTIFIER ambient_condition[0][23].amb_cond.ydiMemory_xau16[13].ZFEH_EepromData /end MEASUREMENT
/begin MEASUREMENT ZFEH_EepromData.ydiMemory_xau16[13].amb_cond.ambient_condition[0][24] "ambient condition shot [0 .. 2-1] with 25 data bytes [0 .. 25-1] for the error code stored in this error memory slot" UBYTE EH_STANDARD_S4_S3 1 100 0 255 ECU_ADDRESS 0xFFF82698 DISPLAY_IDENTIFIER ambient_condition[0][24].amb_cond.ydiMemory_xau16[13].ZFEH_EepromData /end MEASUREMENT
/begin MEASUREMENT ZFEH_EepromData.ydiMemory_xau16[13].amb_cond.ambient_condition[0][2] "ambient condition shot [0 .. 2-1] with 25 data bytes [0 .. 25-1] for the error code stored in this error memory slot" UBYTE EH_STANDARD_S4_S3 1 100 0 255 ECU_ADDRESS 0xFFF82682 DISPLAY_IDENTIFIER ambient_condition[0][2].amb_cond.ydiMemory_xau16[13].ZFEH_EepromData /end MEASUREMENT
/begin MEASUREMENT ZFEH_EepromData.ydiMemory_xau16[13].amb_cond.ambient_condition[0][3] "ambient condition shot [0 .. 2-1] with 25 data bytes [0 .. 25-1] for the error code stored in this error memory slot" UBYTE EH_STANDARD_S4_S3 1 100 0 255 ECU_ADDRESS 0xFFF82683 DISPLAY_IDENTIFIER ambient_condition[0][3].amb_cond.ydiMemory_xau16[13].ZFEH_EepromData /end MEASUREMENT
/begin MEASUREMENT ZFEH_EepromData.ydiMemory_xau16[13].amb_cond.ambient_condition[0][4] "ambient condition shot [0 .. 2-1] with 25 data bytes [0 .. 25-1] for the error code stored in this error memory slot" UBYTE EH_STANDARD_S4_S3 1 100 0 255 ECU_ADDRESS 0xFFF82684 DISPLAY_IDENTIFIER ambient_condition[0][4].amb_cond.ydiMemory_xau16[13].ZFEH_EepromData /end MEASUREMENT
/begin MEASUREMENT ZFEH_EepromData.ydiMemory_xau16[13].amb_cond.ambient_condition[0][5] "ambient condition shot [0 .. 2-1] with 25 data bytes [0 .. 25-1] for the error code stored in this error memory slot" UBYTE EH_STANDARD_S4_S3 1 100 0 255 ECU_ADDRESS 0xFFF82685 DISPLAY_IDENTIFIER ambient_condition[0][5].amb_cond.ydiMemory_xau16[13].ZFEH_EepromData /end MEASUREMENT
/begin MEASUREMENT ZFEH_EepromData.ydiMemory_xau16[13].amb_cond.ambient_condition[0][6] "ambient condition shot [0 .. 2-1] with 25 data bytes [0 .. 25-1] for the error code stored in this error memory slot" UBYTE EH_STANDARD_S4_S3 1 100 0 255 ECU_ADDRESS 0xFFF82686 DISPLAY_IDENTIFIER ambient_condition[0][6].amb_cond.ydiMemory_xau16[13].ZFEH_EepromData /end MEASUREMENT
/begin MEASUREMENT ZFEH_EepromData.ydiMemory_xau16[13].amb_cond.ambient_condition[0][7] "ambient condition shot [0 .. 2-1] with 25 data bytes [0 .. 25-1] for the error code stored in this error memory slot" UBYTE EH_STANDARD_S4_S3 1 100 0 255 ECU_ADDRESS 0xFFF82687 DISPLAY_IDENTIFIER ambient_condition[0][7].amb_cond.ydiMemory_xau16[13].ZFEH_EepromData /end MEASUREMENT
/begin MEASUREMENT ZFEH_EepromData.ydiMemory_xau16[13].amb_cond.ambient_condition[0][8] "ambient condition shot [0 .. 2-1] with 25 data bytes [0 .. 25-1] for the error code stored in this error memory slot" UBYTE EH_STANDARD_S4_S3 1 100 0 255 ECU_ADDRESS 0xFFF82688 DISPLAY_IDENTIFIER ambient_condition[0][8].amb_cond.ydiMemory_xau16[13].ZFEH_EepromData /end MEASUREMENT
/begin MEASUREMENT ZFEH_EepromData.ydiMemory_xau16[13].amb_cond.ambient_condition[0][9] "ambient condition shot [0 .. 2-1] with 25 data bytes [0 .. 25-1] for the error code stored in this error memory slot" UBYTE EH_STANDARD_S4_S3 1 100 0 255 ECU_ADDRESS 0xFFF82689 DISPLAY_IDENTIFIER ambient_condition[0][9].amb_cond.ydiMemory_xau16[13].ZFEH_EepromData /end MEASUREMENT
/begin MEASUREMENT ZFEH_EepromData.ydiMemory_xau16[13].amb_cond.ambient_condition[1][0] "ambient condition shot [0 .. 2-1] with 25 data bytes [0 .. 25-1] for the error code stored in this error memory slot" UBYTE EH_STANDARD_S4_S3 1 100 0 255 ECU_ADDRESS 0xFFF82699 DISPLAY_IDENTIFIER ambient_condition[1][0].amb_cond.ydiMemory_xau16[13].ZFEH_EepromData /end MEASUREMENT
/begin MEASUREMENT ZFEH_EepromData.ydiMemory_xau16[13].amb_cond.ambient_condition[1][10] "ambient condition shot [0 .. 2-1] with 25 data bytes [0 .. 25-1] for the error code stored in this error memory slot" UBYTE EH_STANDARD_S4_S3 1 100 0 255 ECU_ADDRESS 0xFFF826A3 DISPLAY_IDENTIFIER ambient_condition[1][10].amb_cond.ydiMemory_xau16[13].ZFEH_EepromData /end MEASUREMENT
/begin MEASUREMENT ZFEH_EepromData.ydiMemory_xau16[13].amb_cond.ambient_condition[1][11] "ambient condition shot [0 .. 2-1] with 25 data bytes [0 .. 25-1] for the error code stored in this error memory slot" UBYTE EH_STANDARD_S4_S3 1 100 0 255 ECU_ADDRESS 0xFFF826A4 DISPLAY_IDENTIFIER ambient_condition[1][11].amb_cond.ydiMemory_xau16[13].ZFEH_EepromData /end MEASUREMENT
/begin MEASUREMENT ZFEH_EepromData.ydiMemory_xau16[13].amb_cond.ambient_condition[1][12] "ambient condition shot [0 .. 2-1] with 25 data bytes [0 .. 25-1] for the error code stored in this error memory slot" UBYTE EH_STANDARD_S4_S3 1 100 0 255 ECU_ADDRESS 0xFFF826A5 DISPLAY_IDENTIFIER ambient_condition[1][12].amb_cond.ydiMemory_xau16[13].ZFEH_EepromData /end MEASUREMENT
/begin MEASUREMENT ZFEH_EepromData.ydiMemory_xau16[13].amb_cond.ambient_condition[1][13] "ambient condition shot [0 .. 2-1] with 25 data bytes [0 .. 25-1] for the error code stored in this error memory slot" UBYTE EH_STANDARD_S4_S3 1 100 0 255 ECU_ADDRESS 0xFFF826A6 DISPLAY_IDENTIFIER ambient_condition[1][13].amb_cond.ydiMemory_xau16[13].ZFEH_EepromData /end MEASUREMENT
/begin MEASUREMENT ZFEH_EepromData.ydiMemory_xau16[13].amb_cond.ambient_condition[1][14] "ambient condition shot [0 .. 2-1] with 25 data bytes [0 .. 25-1] for the error code stored in this error memory slot" UBYTE EH_STANDARD_S4_S3 1 100 0 255 ECU_ADDRESS 0xFFF826A7 DISPLAY_IDENTIFIER ambient_condition[1][14].amb_cond.ydiMemory_xau16[13].ZFEH_EepromData /end MEASUREMENT
/begin MEASUREMENT ZFEH_EepromData.ydiMemory_xau16[13].amb_cond.ambient_condition[1][15] "ambient condition shot [0 .. 2-1] with 25 data bytes [0 .. 25-1] for the error code stored in this error memory slot" UBYTE EH_STANDARD_S4_S3 1 100 0 255 ECU_ADDRESS 0xFFF826A8 DISPLAY_IDENTIFIER ambient_condition[1][15].amb_cond.ydiMemory_xau16[13].ZFEH_EepromData /end MEASUREMENT
/begin MEASUREMENT ZFEH_EepromData.ydiMemory_xau16[13].amb_cond.ambient_condition[1][16] "ambient condition shot [0 .. 2-1] with 25 data bytes [0 .. 25-1] for the error code stored in this error memory slot" UBYTE EH_STANDARD_S4_S3 1 100 0 255 ECU_ADDRESS 0xFFF826A9 DISPLAY_IDENTIFIER ambient_condition[1][16].amb_cond.ydiMemory_xau16[13].ZFEH_EepromData /end MEASUREMENT
/begin MEASUREMENT ZFEH_EepromData.ydiMemory_xau16[13].amb_cond.ambient_condition[1][17] "ambient condition shot [0 .. 2-1] with 25 data bytes [0 .. 25-1] for the error code stored in this error memory slot" UBYTE EH_STANDARD_S4_S3 1 100 0 255 ECU_ADDRESS 0xFFF826AA DISPLAY_IDENTIFIER ambient_condition[1][17].amb_cond.ydiMemory_xau16[13].ZFEH_EepromData /end MEASUREMENT
/begin MEASUREMENT ZFEH_EepromData.ydiMemory_xau16[13].amb_cond.ambient_condition[1][18] "ambient condition shot [0 .. 2-1] with 25 data bytes [0 .. 25-1] for the error code stored in this error memory slot" UBYTE EH_STANDARD_S4_S3 1 100 0 255 ECU_ADDRESS 0xFFF826AB DISPLAY_IDENTIFIER ambient_condition[1][18].amb_cond.ydiMemory_xau16[13].ZFEH_EepromData /end MEASUREMENT
/begin MEASUREMENT ZFEH_EepromData.ydiMemory_xau16[13].amb_cond.ambient_condition[1][19] "ambient condition shot [0 .. 2-1] with 25 data bytes [0 .. 25-1] for the error code stored in this error memory slot" UBYTE EH_STANDARD_S4_S3 1 100 0 255 ECU_ADDRESS 0xFFF826AC DISPLAY_IDENTIFIER ambient_condition[1][19].amb_cond.ydiMemory_xau16[13].ZFEH_EepromData /end MEASUREMENT
/begin MEASUREMENT ZFEH_EepromData.ydiMemory_xau16[13].amb_cond.ambient_condition[1][1] "ambient condition shot [0 .. 2-1] with 25 data bytes [0 .. 25-1] for the error code stored in this error memory slot" UBYTE EH_STANDARD_S4_S3 1 100 0 255 ECU_ADDRESS 0xFFF8269A DISPLAY_IDENTIFIER ambient_condition[1][1].amb_cond.ydiMemory_xau16[13].ZFEH_EepromData /end MEASUREMENT
/begin MEASUREMENT ZFEH_EepromData.ydiMemory_xau16[13].amb_cond.ambient_condition[1][20] "ambient condition shot [0 .. 2-1] with 25 data bytes [0 .. 25-1] for the error code stored in this error memory slot" UBYTE EH_STANDARD_S4_S3 1 100 0 255 ECU_ADDRESS 0xFFF826AD DISPLAY_IDENTIFIER ambient_condition[1][20].amb_cond.ydiMemory_xau16[13].ZFEH_EepromData /end MEASUREMENT
/begin MEASUREMENT ZFEH_EepromData.ydiMemory_xau16[13].amb_cond.ambient_condition[1][21] "ambient condition shot [0 .. 2-1] with 25 data bytes [0 .. 25-1] for the error code stored in this error memory slot" UBYTE EH_STANDARD_S4_S3 1 100 0 255 ECU_ADDRESS 0xFFF826AE DISPLAY_IDENTIFIER ambient_condition[1][21].amb_cond.ydiMemory_xau16[13].ZFEH_EepromData /end MEASUREMENT
/begin MEASUREMENT ZFEH_EepromData.ydiMemory_xau16[13].amb_cond.ambient_condition[1][22] "ambient condition shot [0 .. 2-1] with 25 data bytes [0 .. 25-1] for the error code stored in this error memory slot" UBYTE EH_STANDARD_S4_S3 1 100 0 255 ECU_ADDRESS 0xFFF826AF DISPLAY_IDENTIFIER ambient_condition[1][22].amb_cond.ydiMemory_xau16[13].ZFEH_EepromData /end MEASUREMENT
/begin MEASUREMENT ZFEH_EepromData.ydiMemory_xau16[13].amb_cond.ambient_condition[1][23] "ambient condition shot [0 .. 2-1] with 25 data bytes [0 .. 25-1] for the error code stored in this error memory slot" UBYTE EH_STANDARD_S4_S3 1 100 0 255 ECU_ADDRESS 0xFFF826B0 DISPLAY_IDENTIFIER ambient_condition[1][23].amb_cond.ydiMemory_xau16[13].ZFEH_EepromData /end MEASUREMENT
/begin MEASUREMENT ZFEH_EepromData.ydiMemory_xau16[13].amb_cond.ambient_condition[1][24] "ambient condition shot [0 .. 2-1] with 25 data bytes [0 .. 25-1] for the error code stored in this error memory slot" UBYTE EH_STANDARD_S4_S3 1 100 0 255 ECU_ADDRESS 0xFFF826B1 DISPLAY_IDENTIFIER ambient_condition[1][24].amb_cond.ydiMemory_xau16[13].ZFEH_EepromData /end MEASUREMENT
/begin MEASUREMENT ZFEH_EepromData.ydiMemory_xau16[13].amb_cond.ambient_condition[1][2] "ambient condition shot [0 .. 2-1] with 25 data bytes [0 .. 25-1] for the error code stored in this error memory slot" UBYTE EH_STANDARD_S4_S3 1 100 0 255 ECU_ADDRESS 0xFFF8269B DISPLAY_IDENTIFIER ambient_condition[1][2].amb_cond.ydiMemory_xau16[13].ZFEH_EepromData /end MEASUREMENT
/begin MEASUREMENT ZFEH_EepromData.ydiMemory_xau16[13].amb_cond.ambient_condition[1][3] "ambient condition shot [0 .. 2-1] with 25 data bytes [0 .. 25-1] for the error code stored in this error memory slot" UBYTE EH_STANDARD_S4_S3 1 100 0 255 ECU_ADDRESS 0xFFF8269C DISPLAY_IDENTIFIER ambient_condition[1][3].amb_cond.ydiMemory_xau16[13].ZFEH_EepromData /end MEASUREMENT
/begin MEASUREMENT ZFEH_EepromData.ydiMemory_xau16[13].amb_cond.ambient_condition[1][4] "ambient condition shot [0 .. 2-1] with 25 data bytes [0 .. 25-1] for the error code stored in this error memory slot" UBYTE EH_STANDARD_S4_S3 1 100 0 255 ECU_ADDRESS 0xFFF8269D DISPLAY_IDENTIFIER ambient_condition[1][4].amb_cond.ydiMemory_xau16[13].ZFEH_EepromData /end MEASUREMENT
/begin MEASUREMENT ZFEH_EepromData.ydiMemory_xau16[13].amb_cond.ambient_condition[1][5] "ambient condition shot [0 .. 2-1] with 25 data bytes [0 .. 25-1] for the error code stored in this error memory slot" UBYTE EH_STANDARD_S4_S3 1 100 0 255 ECU_ADDRESS 0xFFF8269E DISPLAY_IDENTIFIER ambient_condition[1][5].amb_cond.ydiMemory_xau16[13].ZFEH_EepromData /end MEASUREMENT
/begin MEASUREMENT ZFEH_EepromData.ydiMemory_xau16[13].amb_cond.ambient_condition[1][6] "ambient condition shot [0 .. 2-1] with 25 data bytes [0 .. 25-1] for the error code stored in this error memory slot" UBYTE EH_STANDARD_S4_S3 1 100 0 255 ECU_ADDRESS 0xFFF8269F DISPLAY_IDENTIFIER ambient_condition[1][6].amb_cond.ydiMemory_xau16[13].ZFEH_EepromData /end MEASUREMENT
/begin MEASUREMENT ZFEH_EepromData.ydiMemory_xau16[13].amb_cond.ambient_condition[1][7] "ambient condition shot [0 .. 2-1] with 25 data bytes [0 .. 25-1] for the error code stored in this error memory slot" UBYTE EH_STANDARD_S4_S3 1 100 0 255 ECU_ADDRESS 0xFFF826A0 DISPLAY_IDENTIFIER ambient_condition[1][7].amb_cond.ydiMemory_xau16[13].ZFEH_EepromData /end MEASUREMENT
/begin MEASUREMENT ZFEH_EepromData.ydiMemory_xau16[13].amb_cond.ambient_condition[1][8] "ambient condition shot [0 .. 2-1] with 25 data bytes [0 .. 25-1] for the error code stored in this error memory slot" UBYTE EH_STANDARD_S4_S3 1 100 0 255 ECU_ADDRESS 0xFFF826A1 DISPLAY_IDENTIFIER ambient_condition[1][8].amb_cond.ydiMemory_xau16[13].ZFEH_EepromData /end MEASUREMENT
/begin MEASUREMENT ZFEH_EepromData.ydiMemory_xau16[13].amb_cond.ambient_condition[1][9] "ambient condition shot [0 .. 2-1] with 25 data bytes [0 .. 25-1] for the error code stored in this error memory slot" UBYTE EH_STANDARD_S4_S3 1 100 0 255 ECU_ADDRESS 0xFFF826A2 DISPLAY_IDENTIFIER ambient_condition[1][9].amb_cond.ydiMemory_xau16[13].ZFEH_EepromData /end MEASUREMENT
/begin MEASUREMENT ZFEH_EepromData.ydiMemory_xau16[13].amb_cond.status_of_ambient_conditions[0] "status of ambient condition shot x: 0=invalid 1=valid" UBYTE EH_STANDARD_S4_S3 1 100 0 1 ECU_ADDRESS 0xFFF826B2 DISPLAY_IDENTIFIER status_of_ambient_conditions[0].amb_cond.ydiMemory_xau16[13].ZFEH_EepromData /end MEASUREMENT
/begin MEASUREMENT ZFEH_EepromData.ydiMemory_xau16[13].amb_cond.status_of_ambient_conditions[1] "status of ambient condition shot x: 0=invalid 1=valid" UBYTE EH_STANDARD_S4_S3 1 100 0 1 ECU_ADDRESS 0xFFF826B3 DISPLAY_IDENTIFIER status_of_ambient_conditions[1].amb_cond.ydiMemory_xau16[13].ZFEH_EepromData /end MEASUREMENT
/begin MEASUREMENT ZFEH_EepromData.ydiMemory_xau16[13].backwards_counter "backwards counter of error code stored in error memory slot" UBYTE EH_STANDARD_S4_S3 1 100 0 255 ECU_ADDRESS 0xFFF82673 DISPLAY_IDENTIFIER backwards_counter.ydiMemory_xau16[13].ZFEH_EepromData /end MEASUREMENT
/begin MEASUREMENT ZFEH_EepromData.ydiMemory_xau16[13].condition_byte "condition byte of error code stored in error memory slot" UBYTE EH_STANDARD_S4_S3 1 100 0 255 ECU_ADDRESS 0xFFF8267D DISPLAY_IDENTIFIER condition_byte.ydiMemory_xau16[13].ZFEH_EepromData /end MEASUREMENT
/begin MEASUREMENT ZFEH_EepromData.ydiMemory_xau16[13].error_code "error code stored in error memory slot" UWORD EH_STANDARD_S4_S3 1 100 0 65535 ECU_ADDRESS 0xFFF8266C DISPLAY_IDENTIFIER error_code.ydiMemory_xau16[13].ZFEH_EepromData /end MEASUREMENT
/begin MEASUREMENT ZFEH_EepromData.ydiMemory_xau16[13].error_type "error type of error code stored in error memory slot" UWORD EH_STANDARD_S4_S3 1 100 0 65535 ECU_ADDRESS 0xFFF8266E DISPLAY_IDENTIFIER error_type.ydiMemory_xau16[13].ZFEH_EepromData /end MEASUREMENT
/begin MEASUREMENT ZFEH_EepromData.ydiMemory_xau16[13].frequency_counter "frequency counter of error code stored in error memory slot" UBYTE EH_STANDARD_S4_S3 1 100 0 255 ECU_ADDRESS 0xFFF82672 DISPLAY_IDENTIFIER frequency_counter.ydiMemory_xau16[13].ZFEH_EepromData /end MEASUREMENT
/begin MEASUREMENT ZFEH_EepromData.ydiMemory_xau16[13].master_time "master time of error code stored in error memory slot" ULONG EH_STANDARD_S4_S3 1 100 0 4294967295 ECU_ADDRESS 0xFFF82678 DISPLAY_IDENTIFIER master_time.ydiMemory_xau16[13].ZFEH_EepromData /end MEASUREMENT
/begin MEASUREMENT ZFEH_EepromData.ydiMemory_xau16[13].obd_driving_cycle_counter "obd driving cycle counter of error code stored in error memory slot" UWORD EH_STANDARD_S4_S3 1 100 0 65535 ECU_ADDRESS 0xFFF8267E DISPLAY_IDENTIFIER obd_driving_cycle_counter.ydiMemory_xau16[13].ZFEH_EepromData /end MEASUREMENT
/begin MEASUREMENT ZFEH_EepromData.ydiMemory_xau16[13].permanent_counter "counter of permanent error codes stored in error memory slot" UBYTE EH_STANDARD_S4_S3 1 100 0 255 ECU_ADDRESS 0xFFF82674 DISPLAY_IDENTIFIER permanent_counter.ydiMemory_xau16[13].ZFEH_EepromData /end MEASUREMENT
/begin MEASUREMENT ZFEH_EepromData.ydiMemory_xau16[13].sequence_counter "sequence counter of error code stored in error memory slot" UBYTE EH_STANDARD_S4_S3 1 100 0 255 ECU_ADDRESS 0xFFF82675 DISPLAY_IDENTIFIER sequence_counter.ydiMemory_xau16[13].ZFEH_EepromData /end MEASUREMENT
/begin MEASUREMENT ZFEH_EepromData.ydiMemory_xau16[13].status_word "status word of error code stored in error memory slot" UWORD EH_STANDARD_S4_S3 1 100 0 65535 ECU_ADDRESS 0xFFF82670 DISPLAY_IDENTIFIER status_word.ydiMemory_xau16[13].ZFEH_EepromData /end MEASUREMENT
/begin MEASUREMENT ZFEH_EepromData.ydiMemory_xau16[14].amb_cond.ambient_condition[0][0] "ambient condition shot [0 .. 2-1] with 25 data bytes [0 .. 25-1] for the error code stored in this error memory slot" UBYTE EH_STANDARD_S4_S3 1 100 0 255 ECU_ADDRESS 0xFFF826C8 DISPLAY_IDENTIFIER ambient_condition[0][0].amb_cond.ydiMemory_xau16[14].ZFEH_EepromData /end MEASUREMENT
/begin MEASUREMENT ZFEH_EepromData.ydiMemory_xau16[14].amb_cond.ambient_condition[0][10] "ambient condition shot [0 .. 2-1] with 25 data bytes [0 .. 25-1] for the error code stored in this error memory slot" UBYTE EH_STANDARD_S4_S3 1 100 0 255 ECU_ADDRESS 0xFFF826D2 DISPLAY_IDENTIFIER ambient_condition[0][10].amb_cond.ydiMemory_xau16[14].ZFEH_EepromData /end MEASUREMENT
/begin MEASUREMENT ZFEH_EepromData.ydiMemory_xau16[14].amb_cond.ambient_condition[0][11] "ambient condition shot [0 .. 2-1] with 25 data bytes [0 .. 25-1] for the error code stored in this error memory slot" UBYTE EH_STANDARD_S4_S3 1 100 0 255 ECU_ADDRESS 0xFFF826D3 DISPLAY_IDENTIFIER ambient_condition[0][11].amb_cond.ydiMemory_xau16[14].ZFEH_EepromData /end MEASUREMENT
/begin MEASUREMENT ZFEH_EepromData.ydiMemory_xau16[14].amb_cond.ambient_condition[0][12] "ambient condition shot [0 .. 2-1] with 25 data bytes [0 .. 25-1] for the error code stored in this error memory slot" UBYTE EH_STANDARD_S4_S3 1 100 0 255 ECU_ADDRESS 0xFFF826D4 DISPLAY_IDENTIFIER ambient_condition[0][12].amb_cond.ydiMemory_xau16[14].ZFEH_EepromData /end MEASUREMENT
/begin MEASUREMENT ZFEH_EepromData.ydiMemory_xau16[14].amb_cond.ambient_condition[0][13] "ambient condition shot [0 .. 2-1] with 25 data bytes [0 .. 25-1] for the error code stored in this error memory slot" UBYTE EH_STANDARD_S4_S3 1 100 0 255 ECU_ADDRESS 0xFFF826D5 DISPLAY_IDENTIFIER ambient_condition[0][13].amb_cond.ydiMemory_xau16[14].ZFEH_EepromData /end MEASUREMENT
/begin MEASUREMENT ZFEH_EepromData.ydiMemory_xau16[14].amb_cond.ambient_condition[0][14] "ambient condition shot [0 .. 2-1] with 25 data bytes [0 .. 25-1] for the error code stored in this error memory slot" UBYTE EH_STANDARD_S4_S3 1 100 0 255 ECU_ADDRESS 0xFFF826D6 DISPLAY_IDENTIFIER ambient_condition[0][14].amb_cond.ydiMemory_xau16[14].ZFEH_EepromData /end MEASUREMENT
/begin MEASUREMENT ZFEH_EepromData.ydiMemory_xau16[14].amb_cond.ambient_condition[0][15] "ambient condition shot [0 .. 2-1] with 25 data bytes [0 .. 25-1] for the error code stored in this error memory slot" UBYTE EH_STANDARD_S4_S3 1 100 0 255 ECU_ADDRESS 0xFFF826D7 DISPLAY_IDENTIFIER ambient_condition[0][15].amb_cond.ydiMemory_xau16[14].ZFEH_EepromData /end MEASUREMENT
/begin MEASUREMENT ZFEH_EepromData.ydiMemory_xau16[14].amb_cond.ambient_condition[0][16] "ambient condition shot [0 .. 2-1] with 25 data bytes [0 .. 25-1] for the error code stored in this error memory slot" UBYTE EH_STANDARD_S4_S3 1 100 0 255 ECU_ADDRESS 0xFFF826D8 DISPLAY_IDENTIFIER ambient_condition[0][16].amb_cond.ydiMemory_xau16[14].ZFEH_EepromData /end MEASUREMENT
/begin MEASUREMENT ZFEH_EepromData.ydiMemory_xau16[14].amb_cond.ambient_condition[0][17] "ambient condition shot [0 .. 2-1] with 25 data bytes [0 .. 25-1] for the error code stored in this error memory slot" UBYTE EH_STANDARD_S4_S3 1 100 0 255 ECU_ADDRESS 0xFFF826D9 DISPLAY_IDENTIFIER ambient_condition[0][17].amb_cond.ydiMemory_xau16[14].ZFEH_EepromData /end MEASUREMENT
/begin MEASUREMENT ZFEH_EepromData.ydiMemory_xau16[14].amb_cond.ambient_condition[0][18] "ambient condition shot [0 .. 2-1] with 25 data bytes [0 .. 25-1] for the error code stored in this error memory slot" UBYTE EH_STANDARD_S4_S3 1 100 0 255 ECU_ADDRESS 0xFFF826DA DISPLAY_IDENTIFIER ambient_condition[0][18].amb_cond.ydiMemory_xau16[14].ZFEH_EepromData /end MEASUREMENT
/begin MEASUREMENT ZFEH_EepromData.ydiMemory_xau16[14].amb_cond.ambient_condition[0][19] "ambient condition shot [0 .. 2-1] with 25 data bytes [0 .. 25-1] for the error code stored in this error memory slot" UBYTE EH_STANDARD_S4_S3 1 100 0 255 ECU_ADDRESS 0xFFF826DB DISPLAY_IDENTIFIER ambient_condition[0][19].amb_cond.ydiMemory_xau16[14].ZFEH_EepromData /end MEASUREMENT
/begin MEASUREMENT ZFEH_EepromData.ydiMemory_xau16[14].amb_cond.ambient_condition[0][1] "ambient condition shot [0 .. 2-1] with 25 data bytes [0 .. 25-1] for the error code stored in this error memory slot" UBYTE EH_STANDARD_S4_S3 1 100 0 255 ECU_ADDRESS 0xFFF826C9 DISPLAY_IDENTIFIER ambient_condition[0][1].amb_cond.ydiMemory_xau16[14].ZFEH_EepromData /end MEASUREMENT
/begin MEASUREMENT ZFEH_EepromData.ydiMemory_xau16[14].amb_cond.ambient_condition[0][20] "ambient condition shot [0 .. 2-1] with 25 data bytes [0 .. 25-1] for the error code stored in this error memory slot" UBYTE EH_STANDARD_S4_S3 1 100 0 255 ECU_ADDRESS 0xFFF826DC DISPLAY_IDENTIFIER ambient_condition[0][20].amb_cond.ydiMemory_xau16[14].ZFEH_EepromData /end MEASUREMENT
/begin MEASUREMENT ZFEH_EepromData.ydiMemory_xau16[14].amb_cond.ambient_condition[0][21] "ambient condition shot [0 .. 2-1] with 25 data bytes [0 .. 25-1] for the error code stored in this error memory slot" UBYTE EH_STANDARD_S4_S3 1 100 0 255 ECU_ADDRESS 0xFFF826DD DISPLAY_IDENTIFIER ambient_condition[0][21].amb_cond.ydiMemory_xau16[14].ZFEH_EepromData /end MEASUREMENT
/begin MEASUREMENT ZFEH_EepromData.ydiMemory_xau16[14].amb_cond.ambient_condition[0][22] "ambient condition shot [0 .. 2-1] with 25 data bytes [0 .. 25-1] for the error code stored in this error memory slot" UBYTE EH_STANDARD_S4_S3 1 100 0 255 ECU_ADDRESS 0xFFF826DE DISPLAY_IDENTIFIER ambient_condition[0][22].amb_cond.ydiMemory_xau16[14].ZFEH_EepromData /end MEASUREMENT
/begin MEASUREMENT ZFEH_EepromData.ydiMemory_xau16[14].amb_cond.ambient_condition[0][23] "ambient condition shot [0 .. 2-1] with 25 data bytes [0 .. 25-1] for the error code stored in this error memory slot" UBYTE EH_STANDARD_S4_S3 1 100 0 255 ECU_ADDRESS 0xFFF826DF DISPLAY_IDENTIFIER ambient_condition[0][23].amb_cond.ydiMemory_xau16[14].ZFEH_EepromData /end MEASUREMENT
/begin MEASUREMENT ZFEH_EepromData.ydiMemory_xau16[14].amb_cond.ambient_condition[0][24] "ambient condition shot [0 .. 2-1] with 25 data bytes [0 .. 25-1] for the error code stored in this error memory slot" UBYTE EH_STANDARD_S4_S3 1 100 0 255 ECU_ADDRESS 0xFFF826E0 DISPLAY_IDENTIFIER ambient_condition[0][24].amb_cond.ydiMemory_xau16[14].ZFEH_EepromData /end MEASUREMENT
/begin MEASUREMENT ZFEH_EepromData.ydiMemory_xau16[14].amb_cond.ambient_condition[0][2] "ambient condition shot [0 .. 2-1] with 25 data bytes [0 .. 25-1] for the error code stored in this error memory slot" UBYTE EH_STANDARD_S4_S3 1 100 0 255 ECU_ADDRESS 0xFFF826CA DISPLAY_IDENTIFIER ambient_condition[0][2].amb_cond.ydiMemory_xau16[14].ZFEH_EepromData /end MEASUREMENT
/begin MEASUREMENT ZFEH_EepromData.ydiMemory_xau16[14].amb_cond.ambient_condition[0][3] "ambient condition shot [0 .. 2-1] with 25 data bytes [0 .. 25-1] for the error code stored in this error memory slot" UBYTE EH_STANDARD_S4_S3 1 100 0 255 ECU_ADDRESS 0xFFF826CB DISPLAY_IDENTIFIER ambient_condition[0][3].amb_cond.ydiMemory_xau16[14].ZFEH_EepromData /end MEASUREMENT
/begin MEASUREMENT ZFEH_EepromData.ydiMemory_xau16[14].amb_cond.ambient_condition[0][4] "ambient condition shot [0 .. 2-1] with 25 data bytes [0 .. 25-1] for the error code stored in this error memory slot" UBYTE EH_STANDARD_S4_S3 1 100 0 255 ECU_ADDRESS 0xFFF826CC DISPLAY_IDENTIFIER ambient_condition[0][4].amb_cond.ydiMemory_xau16[14].ZFEH_EepromData /end MEASUREMENT
/begin MEASUREMENT ZFEH_EepromData.ydiMemory_xau16[14].amb_cond.ambient_condition[0][5] "ambient condition shot [0 .. 2-1] with 25 data bytes [0 .. 25-1] for the error code stored in this error memory slot" UBYTE EH_STANDARD_S4_S3 1 100 0 255 ECU_ADDRESS 0xFFF826CD DISPLAY_IDENTIFIER ambient_condition[0][5].amb_cond.ydiMemory_xau16[14].ZFEH_EepromData /end MEASUREMENT
/begin MEASUREMENT ZFEH_EepromData.ydiMemory_xau16[14].amb_cond.ambient_condition[0][6] "ambient condition shot [0 .. 2-1] with 25 data bytes [0 .. 25-1] for the error code stored in this error memory slot" UBYTE EH_STANDARD_S4_S3 1 100 0 255 ECU_ADDRESS 0xFFF826CE DISPLAY_IDENTIFIER ambient_condition[0][6].amb_cond.ydiMemory_xau16[14].ZFEH_EepromData /end MEASUREMENT
/begin MEASUREMENT ZFEH_EepromData.ydiMemory_xau16[14].amb_cond.ambient_condition[0][7] "ambient condition shot [0 .. 2-1] with 25 data bytes [0 .. 25-1] for the error code stored in this error memory slot" UBYTE EH_STANDARD_S4_S3 1 100 0 255 ECU_ADDRESS 0xFFF826CF DISPLAY_IDENTIFIER ambient_condition[0][7].amb_cond.ydiMemory_xau16[14].ZFEH_EepromData /end MEASUREMENT
/begin MEASUREMENT ZFEH_EepromData.ydiMemory_xau16[14].amb_cond.ambient_condition[0][8] "ambient condition shot [0 .. 2-1] with 25 data bytes [0 .. 25-1] for the error code stored in this error memory slot" UBYTE EH_STANDARD_S4_S3 1 100 0 255 ECU_ADDRESS 0xFFF826D0 DISPLAY_IDENTIFIER ambient_condition[0][8].amb_cond.ydiMemory_xau16[14].ZFEH_EepromData /end MEASUREMENT
/begin MEASUREMENT ZFEH_EepromData.ydiMemory_xau16[14].amb_cond.ambient_condition[0][9] "ambient condition shot [0 .. 2-1] with 25 data bytes [0 .. 25-1] for the error code stored in this error memory slot" UBYTE EH_STANDARD_S4_S3 1 100 0 255 ECU_ADDRESS 0xFFF826D1 DISPLAY_IDENTIFIER ambient_condition[0][9].amb_cond.ydiMemory_xau16[14].ZFEH_EepromData /end MEASUREMENT
/begin MEASUREMENT ZFEH_EepromData.ydiMemory_xau16[14].amb_cond.ambient_condition[1][0] "ambient condition shot [0 .. 2-1] with 25 data bytes [0 .. 25-1] for the error code stored in this error memory slot" UBYTE EH_STANDARD_S4_S3 1 100 0 255 ECU_ADDRESS 0xFFF826E1 DISPLAY_IDENTIFIER ambient_condition[1][0].amb_cond.ydiMemory_xau16[14].ZFEH_EepromData /end MEASUREMENT
/begin MEASUREMENT ZFEH_EepromData.ydiMemory_xau16[14].amb_cond.ambient_condition[1][10] "ambient condition shot [0 .. 2-1] with 25 data bytes [0 .. 25-1] for the error code stored in this error memory slot" UBYTE EH_STANDARD_S4_S3 1 100 0 255 ECU_ADDRESS 0xFFF826EB DISPLAY_IDENTIFIER ambient_condition[1][10].amb_cond.ydiMemory_xau16[14].ZFEH_EepromData /end MEASUREMENT
/begin MEASUREMENT ZFEH_EepromData.ydiMemory_xau16[14].amb_cond.ambient_condition[1][11] "ambient condition shot [0 .. 2-1] with 25 data bytes [0 .. 25-1] for the error code stored in this error memory slot" UBYTE EH_STANDARD_S4_S3 1 100 0 255 ECU_ADDRESS 0xFFF826EC DISPLAY_IDENTIFIER ambient_condition[1][11].amb_cond.ydiMemory_xau16[14].ZFEH_EepromData /end MEASUREMENT
/begin MEASUREMENT ZFEH_EepromData.ydiMemory_xau16[14].amb_cond.ambient_condition[1][12] "ambient condition shot [0 .. 2-1] with 25 data bytes [0 .. 25-1] for the error code stored in this error memory slot" UBYTE EH_STANDARD_S4_S3 1 100 0 255 ECU_ADDRESS 0xFFF826ED DISPLAY_IDENTIFIER ambient_condition[1][12].amb_cond.ydiMemory_xau16[14].ZFEH_EepromData /end MEASUREMENT
/begin MEASUREMENT ZFEH_EepromData.ydiMemory_xau16[14].amb_cond.ambient_condition[1][13] "ambient condition shot [0 .. 2-1] with 25 data bytes [0 .. 25-1] for the error code stored in this error memory slot" UBYTE EH_STANDARD_S4_S3 1 100 0 255 ECU_ADDRESS 0xFFF826EE DISPLAY_IDENTIFIER ambient_condition[1][13].amb_cond.ydiMemory_xau16[14].ZFEH_EepromData /end MEASUREMENT
/begin MEASUREMENT ZFEH_EepromData.ydiMemory_xau16[14].amb_cond.ambient_condition[1][14] "ambient condition shot [0 .. 2-1] with 25 data bytes [0 .. 25-1] for the error code stored in this error memory slot" UBYTE EH_STANDARD_S4_S3 1 100 0 255 ECU_ADDRESS 0xFFF826EF DISPLAY_IDENTIFIER ambient_condition[1][14].amb_cond.ydiMemory_xau16[14].ZFEH_EepromData /end MEASUREMENT
/begin MEASUREMENT ZFEH_EepromData.ydiMemory_xau16[14].amb_cond.ambient_condition[1][15] "ambient condition shot [0 .. 2-1] with 25 data bytes [0 .. 25-1] for the error code stored in this error memory slot" UBYTE EH_STANDARD_S4_S3 1 100 0 255 ECU_ADDRESS 0xFFF826F0 DISPLAY_IDENTIFIER ambient_condition[1][15].amb_cond.ydiMemory_xau16[14].ZFEH_EepromData /end MEASUREMENT
/begin MEASUREMENT ZFEH_EepromData.ydiMemory_xau16[14].amb_cond.ambient_condition[1][16] "ambient condition shot [0 .. 2-1] with 25 data bytes [0 .. 25-1] for the error code stored in this error memory slot" UBYTE EH_STANDARD_S4_S3 1 100 0 255 ECU_ADDRESS 0xFFF826F1 DISPLAY_IDENTIFIER ambient_condition[1][16].amb_cond.ydiMemory_xau16[14].ZFEH_EepromData /end MEASUREMENT
/begin MEASUREMENT ZFEH_EepromData.ydiMemory_xau16[14].amb_cond.ambient_condition[1][17] "ambient condition shot [0 .. 2-1] with 25 data bytes [0 .. 25-1] for the error code stored in this error memory slot" UBYTE EH_STANDARD_S4_S3 1 100 0 255 ECU_ADDRESS 0xFFF826F2 DISPLAY_IDENTIFIER ambient_condition[1][17].amb_cond.ydiMemory_xau16[14].ZFEH_EepromData /end MEASUREMENT
/begin MEASUREMENT ZFEH_EepromData.ydiMemory_xau16[14].amb_cond.ambient_condition[1][18] "ambient condition shot [0 .. 2-1] with 25 data bytes [0 .. 25-1] for the error code stored in this error memory slot" UBYTE EH_STANDARD_S4_S3 1 100 0 255 ECU_ADDRESS 0xFFF826F3 DISPLAY_IDENTIFIER ambient_condition[1][18].amb_cond.ydiMemory_xau16[14].ZFEH_EepromData /end MEASUREMENT
/begin MEASUREMENT ZFEH_EepromData.ydiMemory_xau16[14].amb_cond.ambient_condition[1][19] "ambient condition shot [0 .. 2-1] with 25 data bytes [0 .. 25-1] for the error code stored in this error memory slot" UBYTE EH_STANDARD_S4_S3 1 100 0 255 ECU_ADDRESS 0xFFF826F4 DISPLAY_IDENTIFIER ambient_condition[1][19].amb_cond.ydiMemory_xau16[14].ZFEH_EepromData /end MEASUREMENT
/begin MEASUREMENT ZFEH_EepromData.ydiMemory_xau16[14].amb_cond.ambient_condition[1][1] "ambient condition shot [0 .. 2-1] with 25 data bytes [0 .. 25-1] for the error code stored in this error memory slot" UBYTE EH_STANDARD_S4_S3 1 100 0 255 ECU_ADDRESS 0xFFF826E2 DISPLAY_IDENTIFIER ambient_condition[1][1].amb_cond.ydiMemory_xau16[14].ZFEH_EepromData /end MEASUREMENT
/begin MEASUREMENT ZFEH_EepromData.ydiMemory_xau16[14].amb_cond.ambient_condition[1][20] "ambient condition shot [0 .. 2-1] with 25 data bytes [0 .. 25-1] for the error code stored in this error memory slot" UBYTE EH_STANDARD_S4_S3 1 100 0 255 ECU_ADDRESS 0xFFF826F5 DISPLAY_IDENTIFIER ambient_condition[1][20].amb_cond.ydiMemory_xau16[14].ZFEH_EepromData /end MEASUREMENT
/begin MEASUREMENT ZFEH_EepromData.ydiMemory_xau16[14].amb_cond.ambient_condition[1][21] "ambient condition shot [0 .. 2-1] with 25 data bytes [0 .. 25-1] for the error code stored in this error memory slot" UBYTE EH_STANDARD_S4_S3 1 100 0 255 ECU_ADDRESS 0xFFF826F6 DISPLAY_IDENTIFIER ambient_condition[1][21].amb_cond.ydiMemory_xau16[14].ZFEH_EepromData /end MEASUREMENT
/begin MEASUREMENT ZFEH_EepromData.ydiMemory_xau16[14].amb_cond.ambient_condition[1][22] "ambient condition shot [0 .. 2-1] with 25 data bytes [0 .. 25-1] for the error code stored in this error memory slot" UBYTE EH_STANDARD_S4_S3 1 100 0 255 ECU_ADDRESS 0xFFF826F7 DISPLAY_IDENTIFIER ambient_condition[1][22].amb_cond.ydiMemory_xau16[14].ZFEH_EepromData /end MEASUREMENT
/begin MEASUREMENT ZFEH_EepromData.ydiMemory_xau16[14].amb_cond.ambient_condition[1][23] "ambient condition shot [0 .. 2-1] with 25 data bytes [0 .. 25-1] for the error code stored in this error memory slot" UBYTE EH_STANDARD_S4_S3 1 100 0 255 ECU_ADDRESS 0xFFF826F8 DISPLAY_IDENTIFIER ambient_condition[1][23].amb_cond.ydiMemory_xau16[14].ZFEH_EepromData /end MEASUREMENT
/begin MEASUREMENT ZFEH_EepromData.ydiMemory_xau16[14].amb_cond.ambient_condition[1][24] "ambient condition shot [0 .. 2-1] with 25 data bytes [0 .. 25-1] for the error code stored in this error memory slot" UBYTE EH_STANDARD_S4_S3 1 100 0 255 ECU_ADDRESS 0xFFF826F9 DISPLAY_IDENTIFIER ambient_condition[1][24].amb_cond.ydiMemory_xau16[14].ZFEH_EepromData /end MEASUREMENT
/begin MEASUREMENT ZFEH_EepromData.ydiMemory_xau16[14].amb_cond.ambient_condition[1][2] "ambient condition shot [0 .. 2-1] with 25 data bytes [0 .. 25-1] for the error code stored in this error memory slot" UBYTE EH_STANDARD_S4_S3 1 100 0 255 ECU_ADDRESS 0xFFF826E3 DISPLAY_IDENTIFIER ambient_condition[1][2].amb_cond.ydiMemory_xau16[14].ZFEH_EepromData /end MEASUREMENT
/begin MEASUREMENT ZFEH_EepromData.ydiMemory_xau16[14].amb_cond.ambient_condition[1][3] "ambient condition shot [0 .. 2-1] with 25 data bytes [0 .. 25-1] for the error code stored in this error memory slot" UBYTE EH_STANDARD_S4_S3 1 100 0 255 ECU_ADDRESS 0xFFF826E4 DISPLAY_IDENTIFIER ambient_condition[1][3].amb_cond.ydiMemory_xau16[14].ZFEH_EepromData /end MEASUREMENT
/begin MEASUREMENT ZFEH_EepromData.ydiMemory_xau16[14].amb_cond.ambient_condition[1][4] "ambient condition shot [0 .. 2-1] with 25 data bytes [0 .. 25-1] for the error code stored in this error memory slot" UBYTE EH_STANDARD_S4_S3 1 100 0 255 ECU_ADDRESS 0xFFF826E5 DISPLAY_IDENTIFIER ambient_condition[1][4].amb_cond.ydiMemory_xau16[14].ZFEH_EepromData /end MEASUREMENT
/begin MEASUREMENT ZFEH_EepromData.ydiMemory_xau16[14].amb_cond.ambient_condition[1][5] "ambient condition shot [0 .. 2-1] with 25 data bytes [0 .. 25-1] for the error code stored in this error memory slot" UBYTE EH_STANDARD_S4_S3 1 100 0 255 ECU_ADDRESS 0xFFF826E6 DISPLAY_IDENTIFIER ambient_condition[1][5].amb_cond.ydiMemory_xau16[14].ZFEH_EepromData /end MEASUREMENT
/begin MEASUREMENT ZFEH_EepromData.ydiMemory_xau16[14].amb_cond.ambient_condition[1][6] "ambient condition shot [0 .. 2-1] with 25 data bytes [0 .. 25-1] for the error code stored in this error memory slot" UBYTE EH_STANDARD_S4_S3 1 100 0 255 ECU_ADDRESS 0xFFF826E7 DISPLAY_IDENTIFIER ambient_condition[1][6].amb_cond.ydiMemory_xau16[14].ZFEH_EepromData /end MEASUREMENT
/begin MEASUREMENT ZFEH_EepromData.ydiMemory_xau16[14].amb_cond.ambient_condition[1][7] "ambient condition shot [0 .. 2-1] with 25 data bytes [0 .. 25-1] for the error code stored in this error memory slot" UBYTE EH_STANDARD_S4_S3 1 100 0 255 ECU_ADDRESS 0xFFF826E8 DISPLAY_IDENTIFIER ambient_condition[1][7].amb_cond.ydiMemory_xau16[14].ZFEH_EepromData /end MEASUREMENT
/begin MEASUREMENT ZFEH_EepromData.ydiMemory_xau16[14].amb_cond.ambient_condition[1][8] "ambient condition shot [0 .. 2-1] with 25 data bytes [0 .. 25-1] for the error code stored in this error memory slot" UBYTE EH_STANDARD_S4_S3 1 100 0 255 ECU_ADDRESS 0xFFF826E9 DISPLAY_IDENTIFIER ambient_condition[1][8].amb_cond.ydiMemory_xau16[14].ZFEH_EepromData /end MEASUREMENT
/begin MEASUREMENT ZFEH_EepromData.ydiMemory_xau16[14].amb_cond.ambient_condition[1][9] "ambient condition shot [0 .. 2-1] with 25 data bytes [0 .. 25-1] for the error code stored in this error memory slot" UBYTE EH_STANDARD_S4_S3 1 100 0 255 ECU_ADDRESS 0xFFF826EA DISPLAY_IDENTIFIER ambient_condition[1][9].amb_cond.ydiMemory_xau16[14].ZFEH_EepromData /end MEASUREMENT
/begin MEASUREMENT ZFEH_EepromData.ydiMemory_xau16[14].amb_cond.status_of_ambient_conditions[0] "status of ambient condition shot x: 0=invalid 1=valid" UBYTE EH_STANDARD_S4_S3 1 100 0 1 ECU_ADDRESS 0xFFF826FA DISPLAY_IDENTIFIER status_of_ambient_conditions[0].amb_cond.ydiMemory_xau16[14].ZFEH_EepromData /end MEASUREMENT
/begin MEASUREMENT ZFEH_EepromData.ydiMemory_xau16[14].amb_cond.status_of_ambient_conditions[1] "status of ambient condition shot x: 0=invalid 1=valid" UBYTE EH_STANDARD_S4_S3 1 100 0 1 ECU_ADDRESS 0xFFF826FB DISPLAY_IDENTIFIER status_of_ambient_conditions[1].amb_cond.ydiMemory_xau16[14].ZFEH_EepromData /end MEASUREMENT
/begin MEASUREMENT ZFEH_EepromData.ydiMemory_xau16[14].backwards_counter "backwards counter of error code stored in error memory slot" UBYTE EH_STANDARD_S4_S3 1 100 0 255 ECU_ADDRESS 0xFFF826BB DISPLAY_IDENTIFIER backwards_counter.ydiMemory_xau16[14].ZFEH_EepromData /end MEASUREMENT
/begin MEASUREMENT ZFEH_EepromData.ydiMemory_xau16[14].condition_byte "condition byte of error code stored in error memory slot" UBYTE EH_STANDARD_S4_S3 1 100 0 255 ECU_ADDRESS 0xFFF826C5 DISPLAY_IDENTIFIER condition_byte.ydiMemory_xau16[14].ZFEH_EepromData /end MEASUREMENT
/begin MEASUREMENT ZFEH_EepromData.ydiMemory_xau16[14].error_code "error code stored in error memory slot" UWORD EH_STANDARD_S4_S3 1 100 0 65535 ECU_ADDRESS 0xFFF826B4 DISPLAY_IDENTIFIER error_code.ydiMemory_xau16[14].ZFEH_EepromData /end MEASUREMENT
/begin MEASUREMENT ZFEH_EepromData.ydiMemory_xau16[14].error_type "error type of error code stored in error memory slot" UWORD EH_STANDARD_S4_S3 1 100 0 65535 ECU_ADDRESS 0xFFF826B6 DISPLAY_IDENTIFIER error_type.ydiMemory_xau16[14].ZFEH_EepromData /end MEASUREMENT
/begin MEASUREMENT ZFEH_EepromData.ydiMemory_xau16[14].frequency_counter "frequency counter of error code stored in error memory slot" UBYTE EH_STANDARD_S4_S3 1 100 0 255 ECU_ADDRESS 0xFFF826BA DISPLAY_IDENTIFIER frequency_counter.ydiMemory_xau16[14].ZFEH_EepromData /end MEASUREMENT
/begin MEASUREMENT ZFEH_EepromData.ydiMemory_xau16[14].master_time "master time of error code stored in error memory slot" ULONG EH_STANDARD_S4_S3 1 100 0 4294967295 ECU_ADDRESS 0xFFF826C0 DISPLAY_IDENTIFIER master_time.ydiMemory_xau16[14].ZFEH_EepromData /end MEASUREMENT
/begin MEASUREMENT ZFEH_EepromData.ydiMemory_xau16[14].obd_driving_cycle_counter "obd driving cycle counter of error code stored in error memory slot" UWORD EH_STANDARD_S4_S3 1 100 0 65535 ECU_ADDRESS 0xFFF826C6 DISPLAY_IDENTIFIER obd_driving_cycle_counter.ydiMemory_xau16[14].ZFEH_EepromData /end MEASUREMENT
/begin MEASUREMENT ZFEH_EepromData.ydiMemory_xau16[14].permanent_counter "counter of permanent error codes stored in error memory slot" UBYTE EH_STANDARD_S4_S3 1 100 0 255 ECU_ADDRESS 0xFFF826BC DISPLAY_IDENTIFIER permanent_counter.ydiMemory_xau16[14].ZFEH_EepromData /end MEASUREMENT
/begin MEASUREMENT ZFEH_EepromData.ydiMemory_xau16[14].sequence_counter "sequence counter of error code stored in error memory slot" UBYTE EH_STANDARD_S4_S3 1 100 0 255 ECU_ADDRESS 0xFFF826BD DISPLAY_IDENTIFIER sequence_counter.ydiMemory_xau16[14].ZFEH_EepromData /end MEASUREMENT
/begin MEASUREMENT ZFEH_EepromData.ydiMemory_xau16[14].status_word "status word of error code stored in error memory slot" UWORD EH_STANDARD_S4_S3 1 100 0 65535 ECU_ADDRESS 0xFFF826B8 DISPLAY_IDENTIFIER status_word.ydiMemory_xau16[14].ZFEH_EepromData /end MEASUREMENT
/begin MEASUREMENT ZFEH_EepromData.ydiMemory_xau16[15].amb_cond.ambient_condition[0][0] "ambient condition shot [0 .. 2-1] with 25 data bytes [0 .. 25-1] for the error code stored in this error memory slot" UBYTE EH_STANDARD_S4_S3 1 100 0 255 ECU_ADDRESS 0xFFF82710 DISPLAY_IDENTIFIER ambient_condition[0][0].amb_cond.ydiMemory_xau16[15].ZFEH_EepromData /end MEASUREMENT
/begin MEASUREMENT ZFEH_EepromData.ydiMemory_xau16[15].amb_cond.ambient_condition[0][10] "ambient condition shot [0 .. 2-1] with 25 data bytes [0 .. 25-1] for the error code stored in this error memory slot" UBYTE EH_STANDARD_S4_S3 1 100 0 255 ECU_ADDRESS 0xFFF8271A DISPLAY_IDENTIFIER ambient_condition[0][10].amb_cond.ydiMemory_xau16[15].ZFEH_EepromData /end MEASUREMENT
/begin MEASUREMENT ZFEH_EepromData.ydiMemory_xau16[15].amb_cond.ambient_condition[0][11] "ambient condition shot [0 .. 2-1] with 25 data bytes [0 .. 25-1] for the error code stored in this error memory slot" UBYTE EH_STANDARD_S4_S3 1 100 0 255 ECU_ADDRESS 0xFFF8271B DISPLAY_IDENTIFIER ambient_condition[0][11].amb_cond.ydiMemory_xau16[15].ZFEH_EepromData /end MEASUREMENT
/begin MEASUREMENT ZFEH_EepromData.ydiMemory_xau16[15].amb_cond.ambient_condition[0][12] "ambient condition shot [0 .. 2-1] with 25 data bytes [0 .. 25-1] for the error code stored in this error memory slot" UBYTE EH_STANDARD_S4_S3 1 100 0 255 ECU_ADDRESS 0xFFF8271C DISPLAY_IDENTIFIER ambient_condition[0][12].amb_cond.ydiMemory_xau16[15].ZFEH_EepromData /end MEASUREMENT
/begin MEASUREMENT ZFEH_EepromData.ydiMemory_xau16[15].amb_cond.ambient_condition[0][13] "ambient condition shot [0 .. 2-1] with 25 data bytes [0 .. 25-1] for the error code stored in this error memory slot" UBYTE EH_STANDARD_S4_S3 1 100 0 255 ECU_ADDRESS 0xFFF8271D DISPLAY_IDENTIFIER ambient_condition[0][13].amb_cond.ydiMemory_xau16[15].ZFEH_EepromData /end MEASUREMENT
/begin MEASUREMENT ZFEH_EepromData.ydiMemory_xau16[15].amb_cond.ambient_condition[0][14] "ambient condition shot [0 .. 2-1] with 25 data bytes [0 .. 25-1] for the error code stored in this error memory slot" UBYTE EH_STANDARD_S4_S3 1 100 0 255 ECU_ADDRESS 0xFFF8271E DISPLAY_IDENTIFIER ambient_condition[0][14].amb_cond.ydiMemory_xau16[15].ZFEH_EepromData /end MEASUREMENT
/begin MEASUREMENT ZFEH_EepromData.ydiMemory_xau16[15].amb_cond.ambient_condition[0][15] "ambient condition shot [0 .. 2-1] with 25 data bytes [0 .. 25-1] for the error code stored in this error memory slot" UBYTE EH_STANDARD_S4_S3 1 100 0 255 ECU_ADDRESS 0xFFF8271F DISPLAY_IDENTIFIER ambient_condition[0][15].amb_cond.ydiMemory_xau16[15].ZFEH_EepromData /end MEASUREMENT
/begin MEASUREMENT ZFEH_EepromData.ydiMemory_xau16[15].amb_cond.ambient_condition[0][16] "ambient condition shot [0 .. 2-1] with 25 data bytes [0 .. 25-1] for the error code stored in this error memory slot" UBYTE EH_STANDARD_S4_S3 1 100 0 255 ECU_ADDRESS 0xFFF82720 DISPLAY_IDENTIFIER ambient_condition[0][16].amb_cond.ydiMemory_xau16[15].ZFEH_EepromData /end MEASUREMENT
/begin MEASUREMENT ZFEH_EepromData.ydiMemory_xau16[15].amb_cond.ambient_condition[0][17] "ambient condition shot [0 .. 2-1] with 25 data bytes [0 .. 25-1] for the error code stored in this error memory slot" UBYTE EH_STANDARD_S4_S3 1 100 0 255 ECU_ADDRESS 0xFFF82721 DISPLAY_IDENTIFIER ambient_condition[0][17].amb_cond.ydiMemory_xau16[15].ZFEH_EepromData /end MEASUREMENT
/begin MEASUREMENT ZFEH_EepromData.ydiMemory_xau16[15].amb_cond.ambient_condition[0][18] "ambient condition shot [0 .. 2-1] with 25 data bytes [0 .. 25-1] for the error code stored in this error memory slot" UBYTE EH_STANDARD_S4_S3 1 100 0 255 ECU_ADDRESS 0xFFF82722 DISPLAY_IDENTIFIER ambient_condition[0][18].amb_cond.ydiMemory_xau16[15].ZFEH_EepromData /end MEASUREMENT
/begin MEASUREMENT ZFEH_EepromData.ydiMemory_xau16[15].amb_cond.ambient_condition[0][19] "ambient condition shot [0 .. 2-1] with 25 data bytes [0 .. 25-1] for the error code stored in this error memory slot" UBYTE EH_STANDARD_S4_S3 1 100 0 255 ECU_ADDRESS 0xFFF82723 DISPLAY_IDENTIFIER ambient_condition[0][19].amb_cond.ydiMemory_xau16[15].ZFEH_EepromData /end MEASUREMENT
/begin MEASUREMENT ZFEH_EepromData.ydiMemory_xau16[15].amb_cond.ambient_condition[0][1] "ambient condition shot [0 .. 2-1] with 25 data bytes [0 .. 25-1] for the error code stored in this error memory slot" UBYTE EH_STANDARD_S4_S3 1 100 0 255 ECU_ADDRESS 0xFFF82711 DISPLAY_IDENTIFIER ambient_condition[0][1].amb_cond.ydiMemory_xau16[15].ZFEH_EepromData /end MEASUREMENT
/begin MEASUREMENT ZFEH_EepromData.ydiMemory_xau16[15].amb_cond.ambient_condition[0][20] "ambient condition shot [0 .. 2-1] with 25 data bytes [0 .. 25-1] for the error code stored in this error memory slot" UBYTE EH_STANDARD_S4_S3 1 100 0 255 ECU_ADDRESS 0xFFF82724 DISPLAY_IDENTIFIER ambient_condition[0][20].amb_cond.ydiMemory_xau16[15].ZFEH_EepromData /end MEASUREMENT
/begin MEASUREMENT ZFEH_EepromData.ydiMemory_xau16[15].amb_cond.ambient_condition[0][21] "ambient condition shot [0 .. 2-1] with 25 data bytes [0 .. 25-1] for the error code stored in this error memory slot" UBYTE EH_STANDARD_S4_S3 1 100 0 255 ECU_ADDRESS 0xFFF82725 DISPLAY_IDENTIFIER ambient_condition[0][21].amb_cond.ydiMemory_xau16[15].ZFEH_EepromData /end MEASUREMENT
/begin MEASUREMENT ZFEH_EepromData.ydiMemory_xau16[15].amb_cond.ambient_condition[0][22] "ambient condition shot [0 .. 2-1] with 25 data bytes [0 .. 25-1] for the error code stored in this error memory slot" UBYTE EH_STANDARD_S4_S3 1 100 0 255 ECU_ADDRESS 0xFFF82726 DISPLAY_IDENTIFIER ambient_condition[0][22].amb_cond.ydiMemory_xau16[15].ZFEH_EepromData /end MEASUREMENT
/begin MEASUREMENT ZFEH_EepromData.ydiMemory_xau16[15].amb_cond.ambient_condition[0][23] "ambient condition shot [0 .. 2-1] with 25 data bytes [0 .. 25-1] for the error code stored in this error memory slot" UBYTE EH_STANDARD_S4_S3 1 100 0 255 ECU_ADDRESS 0xFFF82727 DISPLAY_IDENTIFIER ambient_condition[0][23].amb_cond.ydiMemory_xau16[15].ZFEH_EepromData /end MEASUREMENT
/begin MEASUREMENT ZFEH_EepromData.ydiMemory_xau16[15].amb_cond.ambient_condition[0][24] "ambient condition shot [0 .. 2-1] with 25 data bytes [0 .. 25-1] for the error code stored in this error memory slot" UBYTE EH_STANDARD_S4_S3 1 100 0 255 ECU_ADDRESS 0xFFF82728 DISPLAY_IDENTIFIER ambient_condition[0][24].amb_cond.ydiMemory_xau16[15].ZFEH_EepromData /end MEASUREMENT
/begin MEASUREMENT ZFEH_EepromData.ydiMemory_xau16[15].amb_cond.ambient_condition[0][2] "ambient condition shot [0 .. 2-1] with 25 data bytes [0 .. 25-1] for the error code stored in this error memory slot" UBYTE EH_STANDARD_S4_S3 1 100 0 255 ECU_ADDRESS 0xFFF82712 DISPLAY_IDENTIFIER ambient_condition[0][2].amb_cond.ydiMemory_xau16[15].ZFEH_EepromData /end MEASUREMENT
/begin MEASUREMENT ZFEH_EepromData.ydiMemory_xau16[15].amb_cond.ambient_condition[0][3] "ambient condition shot [0 .. 2-1] with 25 data bytes [0 .. 25-1] for the error code stored in this error memory slot" UBYTE EH_STANDARD_S4_S3 1 100 0 255 ECU_ADDRESS 0xFFF82713 DISPLAY_IDENTIFIER ambient_condition[0][3].amb_cond.ydiMemory_xau16[15].ZFEH_EepromData /end MEASUREMENT
/begin MEASUREMENT ZFEH_EepromData.ydiMemory_xau16[15].amb_cond.ambient_condition[0][4] "ambient condition shot [0 .. 2-1] with 25 data bytes [0 .. 25-1] for the error code stored in this error memory slot" UBYTE EH_STANDARD_S4_S3 1 100 0 255 ECU_ADDRESS 0xFFF82714 DISPLAY_IDENTIFIER ambient_condition[0][4].amb_cond.ydiMemory_xau16[15].ZFEH_EepromData /end MEASUREMENT
/begin MEASUREMENT ZFEH_EepromData.ydiMemory_xau16[15].amb_cond.ambient_condition[0][5] "ambient condition shot [0 .. 2-1] with 25 data bytes [0 .. 25-1] for the error code stored in this error memory slot" UBYTE EH_STANDARD_S4_S3 1 100 0 255 ECU_ADDRESS 0xFFF82715 DISPLAY_IDENTIFIER ambient_condition[0][5].amb_cond.ydiMemory_xau16[15].ZFEH_EepromData /end MEASUREMENT
/begin MEASUREMENT ZFEH_EepromData.ydiMemory_xau16[15].amb_cond.ambient_condition[0][6] "ambient condition shot [0 .. 2-1] with 25 data bytes [0 .. 25-1] for the error code stored in this error memory slot" UBYTE EH_STANDARD_S4_S3 1 100 0 255 ECU_ADDRESS 0xFFF82716 DISPLAY_IDENTIFIER ambient_condition[0][6].amb_cond.ydiMemory_xau16[15].ZFEH_EepromData /end MEASUREMENT
/begin MEASUREMENT ZFEH_EepromData.ydiMemory_xau16[15].amb_cond.ambient_condition[0][7] "ambient condition shot [0 .. 2-1] with 25 data bytes [0 .. 25-1] for the error code stored in this error memory slot" UBYTE EH_STANDARD_S4_S3 1 100 0 255 ECU_ADDRESS 0xFFF82717 DISPLAY_IDENTIFIER ambient_condition[0][7].amb_cond.ydiMemory_xau16[15].ZFEH_EepromData /end MEASUREMENT
/begin MEASUREMENT ZFEH_EepromData.ydiMemory_xau16[15].amb_cond.ambient_condition[0][8] "ambient condition shot [0 .. 2-1] with 25 data bytes [0 .. 25-1] for the error code stored in this error memory slot" UBYTE EH_STANDARD_S4_S3 1 100 0 255 ECU_ADDRESS 0xFFF82718 DISPLAY_IDENTIFIER ambient_condition[0][8].amb_cond.ydiMemory_xau16[15].ZFEH_EepromData /end MEASUREMENT
/begin MEASUREMENT ZFEH_EepromData.ydiMemory_xau16[15].amb_cond.ambient_condition[0][9] "ambient condition shot [0 .. 2-1] with 25 data bytes [0 .. 25-1] for the error code stored in this error memory slot" UBYTE EH_STANDARD_S4_S3 1 100 0 255 ECU_ADDRESS 0xFFF82719 DISPLAY_IDENTIFIER ambient_condition[0][9].amb_cond.ydiMemory_xau16[15].ZFEH_EepromData /end MEASUREMENT
/begin MEASUREMENT ZFEH_EepromData.ydiMemory_xau16[15].amb_cond.ambient_condition[1][0] "ambient condition shot [0 .. 2-1] with 25 data bytes [0 .. 25-1] for the error code stored in this error memory slot" UBYTE EH_STANDARD_S4_S3 1 100 0 255 ECU_ADDRESS 0xFFF82729 DISPLAY_IDENTIFIER ambient_condition[1][0].amb_cond.ydiMemory_xau16[15].ZFEH_EepromData /end MEASUREMENT
/begin MEASUREMENT ZFEH_EepromData.ydiMemory_xau16[15].amb_cond.ambient_condition[1][10] "ambient condition shot [0 .. 2-1] with 25 data bytes [0 .. 25-1] for the error code stored in this error memory slot" UBYTE EH_STANDARD_S4_S3 1 100 0 255 ECU_ADDRESS 0xFFF82733 DISPLAY_IDENTIFIER ambient_condition[1][10].amb_cond.ydiMemory_xau16[15].ZFEH_EepromData /end MEASUREMENT
/begin MEASUREMENT ZFEH_EepromData.ydiMemory_xau16[15].amb_cond.ambient_condition[1][11] "ambient condition shot [0 .. 2-1] with 25 data bytes [0 .. 25-1] for the error code stored in this error memory slot" UBYTE EH_STANDARD_S4_S3 1 100 0 255 ECU_ADDRESS 0xFFF82734 DISPLAY_IDENTIFIER ambient_condition[1][11].amb_cond.ydiMemory_xau16[15].ZFEH_EepromData /end MEASUREMENT
/begin MEASUREMENT ZFEH_EepromData.ydiMemory_xau16[15].amb_cond.ambient_condition[1][12] "ambient condition shot [0 .. 2-1] with 25 data bytes [0 .. 25-1] for the error code stored in this error memory slot" UBYTE EH_STANDARD_S4_S3 1 100 0 255 ECU_ADDRESS 0xFFF82735 DISPLAY_IDENTIFIER ambient_condition[1][12].amb_cond.ydiMemory_xau16[15].ZFEH_EepromData /end MEASUREMENT
/begin MEASUREMENT ZFEH_EepromData.ydiMemory_xau16[15].amb_cond.ambient_condition[1][13] "ambient condition shot [0 .. 2-1] with 25 data bytes [0 .. 25-1] for the error code stored in this error memory slot" UBYTE EH_STANDARD_S4_S3 1 100 0 255 ECU_ADDRESS 0xFFF82736 DISPLAY_IDENTIFIER ambient_condition[1][13].amb_cond.ydiMemory_xau16[15].ZFEH_EepromData /end MEASUREMENT
/begin MEASUREMENT ZFEH_EepromData.ydiMemory_xau16[15].amb_cond.ambient_condition[1][14] "ambient condition shot [0 .. 2-1] with 25 data bytes [0 .. 25-1] for the error code stored in this error memory slot" UBYTE EH_STANDARD_S4_S3 1 100 0 255 ECU_ADDRESS 0xFFF82737 DISPLAY_IDENTIFIER ambient_condition[1][14].amb_cond.ydiMemory_xau16[15].ZFEH_EepromData /end MEASUREMENT
/begin MEASUREMENT ZFEH_EepromData.ydiMemory_xau16[15].amb_cond.ambient_condition[1][15] "ambient condition shot [0 .. 2-1] with 25 data bytes [0 .. 25-1] for the error code stored in this error memory slot" UBYTE EH_STANDARD_S4_S3 1 100 0 255 ECU_ADDRESS 0xFFF82738 DISPLAY_IDENTIFIER ambient_condition[1][15].amb_cond.ydiMemory_xau16[15].ZFEH_EepromData /end MEASUREMENT
/begin MEASUREMENT ZFEH_EepromData.ydiMemory_xau16[15].amb_cond.ambient_condition[1][16] "ambient condition shot [0 .. 2-1] with 25 data bytes [0 .. 25-1] for the error code stored in this error memory slot" UBYTE EH_STANDARD_S4_S3 1 100 0 255 ECU_ADDRESS 0xFFF82739 DISPLAY_IDENTIFIER ambient_condition[1][16].amb_cond.ydiMemory_xau16[15].ZFEH_EepromData /end MEASUREMENT
/begin MEASUREMENT ZFEH_EepromData.ydiMemory_xau16[15].amb_cond.ambient_condition[1][17] "ambient condition shot [0 .. 2-1] with 25 data bytes [0 .. 25-1] for the error code stored in this error memory slot" UBYTE EH_STANDARD_S4_S3 1 100 0 255 ECU_ADDRESS 0xFFF8273A DISPLAY_IDENTIFIER ambient_condition[1][17].amb_cond.ydiMemory_xau16[15].ZFEH_EepromData /end MEASUREMENT
/begin MEASUREMENT ZFEH_EepromData.ydiMemory_xau16[15].amb_cond.ambient_condition[1][18] "ambient condition shot [0 .. 2-1] with 25 data bytes [0 .. 25-1] for the error code stored in this error memory slot" UBYTE EH_STANDARD_S4_S3 1 100 0 255 ECU_ADDRESS 0xFFF8273B DISPLAY_IDENTIFIER ambient_condition[1][18].amb_cond.ydiMemory_xau16[15].ZFEH_EepromData /end MEASUREMENT
/begin MEASUREMENT ZFEH_EepromData.ydiMemory_xau16[15].amb_cond.ambient_condition[1][19] "ambient condition shot [0 .. 2-1] with 25 data bytes [0 .. 25-1] for the error code stored in this error memory slot" UBYTE EH_STANDARD_S4_S3 1 100 0 255 ECU_ADDRESS 0xFFF8273C DISPLAY_IDENTIFIER ambient_condition[1][19].amb_cond.ydiMemory_xau16[15].ZFEH_EepromData /end MEASUREMENT
/begin MEASUREMENT ZFEH_EepromData.ydiMemory_xau16[15].amb_cond.ambient_condition[1][1] "ambient condition shot [0 .. 2-1] with 25 data bytes [0 .. 25-1] for the error code stored in this error memory slot" UBYTE EH_STANDARD_S4_S3 1 100 0 255 ECU_ADDRESS 0xFFF8272A DISPLAY_IDENTIFIER ambient_condition[1][1].amb_cond.ydiMemory_xau16[15].ZFEH_EepromData /end MEASUREMENT
/begin MEASUREMENT ZFEH_EepromData.ydiMemory_xau16[15].amb_cond.ambient_condition[1][20] "ambient condition shot [0 .. 2-1] with 25 data bytes [0 .. 25-1] for the error code stored in this error memory slot" UBYTE EH_STANDARD_S4_S3 1 100 0 255 ECU_ADDRESS 0xFFF8273D DISPLAY_IDENTIFIER ambient_condition[1][20].amb_cond.ydiMemory_xau16[15].ZFEH_EepromData /end MEASUREMENT
/begin MEASUREMENT ZFEH_EepromData.ydiMemory_xau16[15].amb_cond.ambient_condition[1][21] "ambient condition shot [0 .. 2-1] with 25 data bytes [0 .. 25-1] for the error code stored in this error memory slot" UBYTE EH_STANDARD_S4_S3 1 100 0 255 ECU_ADDRESS 0xFFF8273E DISPLAY_IDENTIFIER ambient_condition[1][21].amb_cond.ydiMemory_xau16[15].ZFEH_EepromData /end MEASUREMENT
/begin MEASUREMENT ZFEH_EepromData.ydiMemory_xau16[15].amb_cond.ambient_condition[1][22] "ambient condition shot [0 .. 2-1] with 25 data bytes [0 .. 25-1] for the error code stored in this error memory slot" UBYTE EH_STANDARD_S4_S3 1 100 0 255 ECU_ADDRESS 0xFFF8273F DISPLAY_IDENTIFIER ambient_condition[1][22].amb_cond.ydiMemory_xau16[15].ZFEH_EepromData /end MEASUREMENT
/begin MEASUREMENT ZFEH_EepromData.ydiMemory_xau16[15].amb_cond.ambient_condition[1][23] "ambient condition shot [0 .. 2-1] with 25 data bytes [0 .. 25-1] for the error code stored in this error memory slot" UBYTE EH_STANDARD_S4_S3 1 100 0 255 ECU_ADDRESS 0xFFF82740 DISPLAY_IDENTIFIER ambient_condition[1][23].amb_cond.ydiMemory_xau16[15].ZFEH_EepromData /end MEASUREMENT
/begin MEASUREMENT ZFEH_EepromData.ydiMemory_xau16[15].amb_cond.ambient_condition[1][24] "ambient condition shot [0 .. 2-1] with 25 data bytes [0 .. 25-1] for the error code stored in this error memory slot" UBYTE EH_STANDARD_S4_S3 1 100 0 255 ECU_ADDRESS 0xFFF82741 DISPLAY_IDENTIFIER ambient_condition[1][24].amb_cond.ydiMemory_xau16[15].ZFEH_EepromData /end MEASUREMENT
/begin MEASUREMENT ZFEH_EepromData.ydiMemory_xau16[15].amb_cond.ambient_condition[1][2] "ambient condition shot [0 .. 2-1] with 25 data bytes [0 .. 25-1] for the error code stored in this error memory slot" UBYTE EH_STANDARD_S4_S3 1 100 0 255 ECU_ADDRESS 0xFFF8272B DISPLAY_IDENTIFIER ambient_condition[1][2].amb_cond.ydiMemory_xau16[15].ZFEH_EepromData /end MEASUREMENT
/begin MEASUREMENT ZFEH_EepromData.ydiMemory_xau16[15].amb_cond.ambient_condition[1][3] "ambient condition shot [0 .. 2-1] with 25 data bytes [0 .. 25-1] for the error code stored in this error memory slot" UBYTE EH_STANDARD_S4_S3 1 100 0 255 ECU_ADDRESS 0xFFF8272C DISPLAY_IDENTIFIER ambient_condition[1][3].amb_cond.ydiMemory_xau16[15].ZFEH_EepromData /end MEASUREMENT
/begin MEASUREMENT ZFEH_EepromData.ydiMemory_xau16[15].amb_cond.ambient_condition[1][4] "ambient condition shot [0 .. 2-1] with 25 data bytes [0 .. 25-1] for the error code stored in this error memory slot" UBYTE EH_STANDARD_S4_S3 1 100 0 255 ECU_ADDRESS 0xFFF8272D DISPLAY_IDENTIFIER ambient_condition[1][4].amb_cond.ydiMemory_xau16[15].ZFEH_EepromData /end MEASUREMENT
/begin MEASUREMENT ZFEH_EepromData.ydiMemory_xau16[15].amb_cond.ambient_condition[1][5] "ambient condition shot [0 .. 2-1] with 25 data bytes [0 .. 25-1] for the error code stored in this error memory slot" UBYTE EH_STANDARD_S4_S3 1 100 0 255 ECU_ADDRESS 0xFFF8272E DISPLAY_IDENTIFIER ambient_condition[1][5].amb_cond.ydiMemory_xau16[15].ZFEH_EepromData /end MEASUREMENT
/begin MEASUREMENT ZFEH_EepromData.ydiMemory_xau16[15].amb_cond.ambient_condition[1][6] "ambient condition shot [0 .. 2-1] with 25 data bytes [0 .. 25-1] for the error code stored in this error memory slot" UBYTE EH_STANDARD_S4_S3 1 100 0 255 ECU_ADDRESS 0xFFF8272F DISPLAY_IDENTIFIER ambient_condition[1][6].amb_cond.ydiMemory_xau16[15].ZFEH_EepromData /end MEASUREMENT
/begin MEASUREMENT ZFEH_EepromData.ydiMemory_xau16[15].amb_cond.ambient_condition[1][7] "ambient condition shot [0 .. 2-1] with 25 data bytes [0 .. 25-1] for the error code stored in this error memory slot" UBYTE EH_STANDARD_S4_S3 1 100 0 255 ECU_ADDRESS 0xFFF82730 DISPLAY_IDENTIFIER ambient_condition[1][7].amb_cond.ydiMemory_xau16[15].ZFEH_EepromData /end MEASUREMENT
/begin MEASUREMENT ZFEH_EepromData.ydiMemory_xau16[15].amb_cond.ambient_condition[1][8] "ambient condition shot [0 .. 2-1] with 25 data bytes [0 .. 25-1] for the error code stored in this error memory slot" UBYTE EH_STANDARD_S4_S3 1 100 0 255 ECU_ADDRESS 0xFFF82731 DISPLAY_IDENTIFIER ambient_condition[1][8].amb_cond.ydiMemory_xau16[15].ZFEH_EepromData /end MEASUREMENT
/begin MEASUREMENT ZFEH_EepromData.ydiMemory_xau16[15].amb_cond.ambient_condition[1][9] "ambient condition shot [0 .. 2-1] with 25 data bytes [0 .. 25-1] for the error code stored in this error memory slot" UBYTE EH_STANDARD_S4_S3 1 100 0 255 ECU_ADDRESS 0xFFF82732 DISPLAY_IDENTIFIER ambient_condition[1][9].amb_cond.ydiMemory_xau16[15].ZFEH_EepromData /end MEASUREMENT
/begin MEASUREMENT ZFEH_EepromData.ydiMemory_xau16[15].amb_cond.status_of_ambient_conditions[0] "status of ambient condition shot x: 0=invalid 1=valid" UBYTE EH_STANDARD_S4_S3 1 100 0 1 ECU_ADDRESS 0xFFF82742 DISPLAY_IDENTIFIER status_of_ambient_conditions[0].amb_cond.ydiMemory_xau16[15].ZFEH_EepromData /end MEASUREMENT
/begin MEASUREMENT ZFEH_EepromData.ydiMemory_xau16[15].amb_cond.status_of_ambient_conditions[1] "status of ambient condition shot x: 0=invalid 1=valid" UBYTE EH_STANDARD_S4_S3 1 100 0 1 ECU_ADDRESS 0xFFF82743 DISPLAY_IDENTIFIER status_of_ambient_conditions[1].amb_cond.ydiMemory_xau16[15].ZFEH_EepromData /end MEASUREMENT
/begin MEASUREMENT ZFEH_EepromData.ydiMemory_xau16[15].backwards_counter "backwards counter of error code stored in error memory slot" UBYTE EH_STANDARD_S4_S3 1 100 0 255 ECU_ADDRESS 0xFFF82703 DISPLAY_IDENTIFIER backwards_counter.ydiMemory_xau16[15].ZFEH_EepromData /end MEASUREMENT
/begin MEASUREMENT ZFEH_EepromData.ydiMemory_xau16[15].condition_byte "condition byte of error code stored in error memory slot" UBYTE EH_STANDARD_S4_S3 1 100 0 255 ECU_ADDRESS 0xFFF8270D DISPLAY_IDENTIFIER condition_byte.ydiMemory_xau16[15].ZFEH_EepromData /end MEASUREMENT
/begin MEASUREMENT ZFEH_EepromData.ydiMemory_xau16[15].error_code "error code stored in error memory slot" UWORD EH_STANDARD_S4_S3 1 100 0 65535 ECU_ADDRESS 0xFFF826FC DISPLAY_IDENTIFIER error_code.ydiMemory_xau16[15].ZFEH_EepromData /end MEASUREMENT
/begin MEASUREMENT ZFEH_EepromData.ydiMemory_xau16[15].error_type "error type of error code stored in error memory slot" UWORD EH_STANDARD_S4_S3 1 100 0 65535 ECU_ADDRESS 0xFFF826FE DISPLAY_IDENTIFIER error_type.ydiMemory_xau16[15].ZFEH_EepromData /end MEASUREMENT
/begin MEASUREMENT ZFEH_EepromData.ydiMemory_xau16[15].frequency_counter "frequency counter of error code stored in error memory slot" UBYTE EH_STANDARD_S4_S3 1 100 0 255 ECU_ADDRESS 0xFFF82702 DISPLAY_IDENTIFIER frequency_counter.ydiMemory_xau16[15].ZFEH_EepromData /end MEASUREMENT
/begin MEASUREMENT ZFEH_EepromData.ydiMemory_xau16[15].master_time "master time of error code stored in error memory slot" ULONG EH_STANDARD_S4_S3 1 100 0 4294967295 ECU_ADDRESS 0xFFF82708 DISPLAY_IDENTIFIER master_time.ydiMemory_xau16[15].ZFEH_EepromData /end MEASUREMENT
/begin MEASUREMENT ZFEH_EepromData.ydiMemory_xau16[15].obd_driving_cycle_counter "obd driving cycle counter of error code stored in error memory slot" UWORD EH_STANDARD_S4_S3 1 100 0 65535 ECU_ADDRESS 0xFFF8270E DISPLAY_IDENTIFIER obd_driving_cycle_counter.ydiMemory_xau16[15].ZFEH_EepromData /end MEASUREMENT
/begin MEASUREMENT ZFEH_EepromData.ydiMemory_xau16[15].permanent_counter "counter of permanent error codes stored in error memory slot" UBYTE EH_STANDARD_S4_S3 1 100 0 255 ECU_ADDRESS 0xFFF82704 DISPLAY_IDENTIFIER permanent_counter.ydiMemory_xau16[15].ZFEH_EepromData /end MEASUREMENT
/begin MEASUREMENT ZFEH_EepromData.ydiMemory_xau16[15].sequence_counter "sequence counter of error code stored in error memory slot" UBYTE EH_STANDARD_S4_S3 1 100 0 255 ECU_ADDRESS 0xFFF82705 DISPLAY_IDENTIFIER sequence_counter.ydiMemory_xau16[15].ZFEH_EepromData /end MEASUREMENT
/begin MEASUREMENT ZFEH_EepromData.ydiMemory_xau16[15].status_word "status word of error code stored in error memory slot" UWORD EH_STANDARD_S4_S3 1 100 0 65535 ECU_ADDRESS 0xFFF82700 DISPLAY_IDENTIFIER status_word.ydiMemory_xau16[15].ZFEH_EepromData /end MEASUREMENT
/begin MEASUREMENT ZFEH_EepromData.ydiMemory_xau16[16].amb_cond.ambient_condition[0][0] "ambient condition shot [0 .. 2-1] with 25 data bytes [0 .. 25-1] for the error code stored in this error memory slot" UBYTE EH_STANDARD_S4_S3 1 100 0 255 ECU_ADDRESS 0xFFF82758 DISPLAY_IDENTIFIER ambient_condition[0][0].amb_cond.ydiMemory_xau16[16].ZFEH_EepromData /end MEASUREMENT
/begin MEASUREMENT ZFEH_EepromData.ydiMemory_xau16[16].amb_cond.ambient_condition[0][10] "ambient condition shot [0 .. 2-1] with 25 data bytes [0 .. 25-1] for the error code stored in this error memory slot" UBYTE EH_STANDARD_S4_S3 1 100 0 255 ECU_ADDRESS 0xFFF82762 DISPLAY_IDENTIFIER ambient_condition[0][10].amb_cond.ydiMemory_xau16[16].ZFEH_EepromData /end MEASUREMENT
/begin MEASUREMENT ZFEH_EepromData.ydiMemory_xau16[16].amb_cond.ambient_condition[0][11] "ambient condition shot [0 .. 2-1] with 25 data bytes [0 .. 25-1] for the error code stored in this error memory slot" UBYTE EH_STANDARD_S4_S3 1 100 0 255 ECU_ADDRESS 0xFFF82763 DISPLAY_IDENTIFIER ambient_condition[0][11].amb_cond.ydiMemory_xau16[16].ZFEH_EepromData /end MEASUREMENT
/begin MEASUREMENT ZFEH_EepromData.ydiMemory_xau16[16].amb_cond.ambient_condition[0][12] "ambient condition shot [0 .. 2-1] with 25 data bytes [0 .. 25-1] for the error code stored in this error memory slot" UBYTE EH_STANDARD_S4_S3 1 100 0 255 ECU_ADDRESS 0xFFF82764 DISPLAY_IDENTIFIER ambient_condition[0][12].amb_cond.ydiMemory_xau16[16].ZFEH_EepromData /end MEASUREMENT
/begin MEASUREMENT ZFEH_EepromData.ydiMemory_xau16[16].amb_cond.ambient_condition[0][13] "ambient condition shot [0 .. 2-1] with 25 data bytes [0 .. 25-1] for the error code stored in this error memory slot" UBYTE EH_STANDARD_S4_S3 1 100 0 255 ECU_ADDRESS 0xFFF82765 DISPLAY_IDENTIFIER ambient_condition[0][13].amb_cond.ydiMemory_xau16[16].ZFEH_EepromData /end MEASUREMENT
/begin MEASUREMENT ZFEH_EepromData.ydiMemory_xau16[16].amb_cond.ambient_condition[0][14] "ambient condition shot [0 .. 2-1] with 25 data bytes [0 .. 25-1] for the error code stored in this error memory slot" UBYTE EH_STANDARD_S4_S3 1 100 0 255 ECU_ADDRESS 0xFFF82766 DISPLAY_IDENTIFIER ambient_condition[0][14].amb_cond.ydiMemory_xau16[16].ZFEH_EepromData /end MEASUREMENT
/begin MEASUREMENT ZFEH_EepromData.ydiMemory_xau16[16].amb_cond.ambient_condition[0][15] "ambient condition shot [0 .. 2-1] with 25 data bytes [0 .. 25-1] for the error code stored in this error memory slot" UBYTE EH_STANDARD_S4_S3 1 100 0 255 ECU_ADDRESS 0xFFF82767 DISPLAY_IDENTIFIER ambient_condition[0][15].amb_cond.ydiMemory_xau16[16].ZFEH_EepromData /end MEASUREMENT
/begin MEASUREMENT ZFEH_EepromData.ydiMemory_xau16[16].amb_cond.ambient_condition[0][16] "ambient condition shot [0 .. 2-1] with 25 data bytes [0 .. 25-1] for the error code stored in this error memory slot" UBYTE EH_STANDARD_S4_S3 1 100 0 255 ECU_ADDRESS 0xFFF82768 DISPLAY_IDENTIFIER ambient_condition[0][16].amb_cond.ydiMemory_xau16[16].ZFEH_EepromData /end MEASUREMENT
/end MODULE
/end PROJECT
