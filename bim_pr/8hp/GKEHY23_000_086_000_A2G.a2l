/* @@@@ File written by CANAPE_VERSION 11 0 20 @@@@ */
ASAP2_VERSION 1 51
/begin PROJECT ZHBC8600 "Gen2_BMW_System_Supplier_Lib"
/begin MODULE CPP ""
/begin MOD_COMMON "" BYTE_ORDER MSB_FIRST ALIGNMENT_BYTE 1 ALIGNMENT_WORD 2 ALIGNMENT_LONG 4 ALIGNMENT_FLOAT32_IEEE 4 ALIGNMENT_FLOAT64_IEEE 1 /end MOD_COMMON
/begin IF_DATA XCP
 /begin XCP_ON_CAN 0x0100 CAN_ID_MASTER 0x07AD CAN_ID_SLAVE 0x0784 BAUDRATE 0x07A120 SAMPLE_POINT 0x44 SAMPLE_RATE SINGLE BTL_CYCLES 0x10 SJW 0x02 SYNC_EDGE SINGLE
  /begin PROTOCOL_LAYER 0x0100 0x0514 0x03E8 0x00 0x00 0x00 0x00 0x00 0x08 0x08 BYTE_ORDER_MSB_FIRST ADDRESS_GRANULARITY_BYTE OPTIONAL_CMD GET_ID OPTIONAL_CMD SET_REQUEST OPTIONAL_CMD SET_MTA OPTIONAL_CMD UPLOAD OPTIONAL_CMD SHORT_UPLOAD OPTIONAL_CMD BUILD_CHECKSUM OPTIONAL_CMD DOWNLOAD_NEXT OPTIONAL_CMD GET_PAG_PROCESSOR_INFO OPTIONAL_CMD SET_SEGMENT_MODE OPTIONAL_CMD GET_SEGMENT_MODE OPTIONAL_CMD COPY_CAL_PAGE OPTIONAL_CMD GET_DAQ_CLOCK OPTIONAL_CMD GET_DAQ_PROCESSOR_INFO OPTIONAL_CMD FREE_DAQ OPTIONAL_CMD ALLOC_DAQ OPTIONAL_CMD ALLOC_ODT OPTIONAL_CMD ALLOC_ODT_ENTRY COMMUNICATION_MODE_SUPPORTED BLOCK SLAVE MASTER 0x04 0x00 /end PROTOCOL_LAYER
  /begin DAQ STATIC 0x03 0x03 0x00 OPTIMISATION_TYPE_DEFAULT ADDRESS_EXTENSION_FREE IDENTIFICATION_FIELD_TYPE_ABSOLUTE GRANULARITY_ODT_ENTRY_SIZE_DAQ_BYTE 0x04 NO_OVERLOAD_INDICATION
   /begin DAQ_LIST 0x00 DAQ_LIST_TYPE DAQ MAX_ODT 0x08 MAX_ODT_ENTRIES 0x07 FIRST_PID 0x00 EVENT_FIXED 0x00 /end DAQ_LIST
   /begin DAQ_LIST 0x01 DAQ_LIST_TYPE DAQ MAX_ODT 0x04 MAX_ODT_ENTRIES 0x07 FIRST_PID 0x08 EVENT_FIXED 0x01 /end DAQ_LIST
   /begin DAQ_LIST 0x02 DAQ_LIST_TYPE DAQ MAX_ODT 0x08 MAX_ODT_ENTRIES 0x07 FIRST_PID 0x0C EVENT_FIXED 0x02 /end DAQ_LIST
   /begin EVENT "10ms time synchronous" "10ms" 0x00 DAQ 0x01 0x0A 0x06 0x07 /end EVENT
   /begin EVENT "20ms time synchronous" "20ms" 0x01 DAQ 0x01 0x14 0x06 0x06 /end EVENT
   /begin EVENT "100ms time synchronous" "100ms" 0x02 DAQ 0x01 0x64 0x06 0x05 /end EVENT
  /end DAQ
  MAX_DLC_REQUIRED /end XCP_ON_CAN
 /begin PROTOCOL_LAYER 0x0100 0x0514 0x03E8 0x00 0x00 0x00 0x00 0x00 0x08 0x08 BYTE_ORDER_MSB_FIRST ADDRESS_GRANULARITY_BYTE OPTIONAL_CMD ALLOC_ODT_ENTRY OPTIONAL_CMD ALLOC_ODT OPTIONAL_CMD ALLOC_DAQ OPTIONAL_CMD FREE_DAQ OPTIONAL_CMD GET_DAQ_PROCESSOR_INFO OPTIONAL_CMD GET_DAQ_CLOCK OPTIONAL_CMD COPY_CAL_PAGE OPTIONAL_CMD GET_SEGMENT_MODE OPTIONAL_CMD SET_SEGMENT_MODE OPTIONAL_CMD GET_PAG_PROCESSOR_INFO OPTIONAL_CMD DOWNLOAD_NEXT OPTIONAL_CMD BUILD_CHECKSUM OPTIONAL_CMD SHORT_UPLOAD OPTIONAL_CMD UPLOAD OPTIONAL_CMD SET_MTA OPTIONAL_CMD SET_REQUEST OPTIONAL_CMD GET_ID COMMUNICATION_MODE_SUPPORTED BLOCK SLAVE MASTER 0x04 0x00 /end PROTOCOL_LAYER
 /begin DAQ STATIC 0x03 0x03 0x00 OPTIMISATION_TYPE_DEFAULT ADDRESS_EXTENSION_FREE IDENTIFICATION_FIELD_TYPE_ABSOLUTE GRANULARITY_ODT_ENTRY_SIZE_DAQ_BYTE 0x04 NO_OVERLOAD_INDICATION
  /begin DAQ_LIST 0x00 DAQ_LIST_TYPE DAQ MAX_ODT 0x08 MAX_ODT_ENTRIES 0x07 FIRST_PID 0x00 EVENT_FIXED 0x00 /end DAQ_LIST
  /begin DAQ_LIST 0x01 DAQ_LIST_TYPE DAQ MAX_ODT 0x04 MAX_ODT_ENTRIES 0x07 FIRST_PID 0x08 EVENT_FIXED 0x01 /end DAQ_LIST
  /begin DAQ_LIST 0x02 DAQ_LIST_TYPE DAQ MAX_ODT 0x08 MAX_ODT_ENTRIES 0x07 FIRST_PID 0x0C EVENT_FIXED 0x02 /end DAQ_LIST
  /begin EVENT "10ms time synchronous" "10ms time" 0x00 DAQ 0x01 0x0A 0x06 0x07 /end EVENT
  /begin EVENT "20ms time synchronous" "20ms time" 0x01 DAQ 0x01 0x14 0x06 0x06 /end EVENT
  /begin EVENT "100ms time synchronous" "100ms tim" 0x02 DAQ 0x01 0x64 0x06 0x05 /end EVENT
 /end DAQ
 /begin PAG 0x0C /end PAG
 /begin PGM PGM_MODE_ABSOLUTE 0x00 0x00 /end PGM
/end IF_DATA
/begin IF_DATA ASAP1B_DIAGNOSTIC_SERVICES
 /begin SOURCE "diagnostic 10ms" 4 1 QP_BLOB QP_BLOB_VERSION 0x0300 BLOCKMODE LOCAL_ID 0xF301 MAX_NO_OF_SIGNALS 0x14 MAX_NO_OF_BYTES 0x50 AVAILABLE_ON CAN /end SOURCE
 /begin TP_BLOB 0x0300 ISO14229_1_2003 BYTEORDER_MSB_FIRST /begin SESSION "InCircuit_CAL" 0x66 SessionOpeningOrder StartDiagSession /end SESSION /begin DATA_ACCESS 0x00 0x00 0x01 0x01 0x01 0x01 /end DATA_ACCESS /begin CHECKSUM 0x010201 0x01 0xFE81 CHECKSUM_RESULT StartRoutine /end CHECKSUM /begin COPY RAM_InitByEcu /end COPY
  /begin FLASH TOOLFLASHBACK 0x03 COPY_FRAME 0x01 RequestRoutineResults RNC_RESULT 0x23 0xFB 0xFC /end FLASH
  /begin PAGE_SWITCH PAGE_CODE 0x00 0x01 LOCAL_ROUTINE ROUTINE_NUMBER_SET 0xFE80 ROUTINE_NUMBER_READ 0xFE82 ROUTINE_PARAM_READ 0xA0 ROUTINE_RESULTS StartRoutine /end PAGE_SWITCH
  /begin ADDRESS_AND_LENGTH_FORMAT_IDENTIFIER 0x14 AALFI_FOR_CHECKSUM_CALCULATION 0x44 AALFI_FOR_ERASE_MEMORY 0x14 AALFI_FOR_WRITE_MEMORY_BY_ADDR 0x14 AALFI_FOR_READ_MEMORY_BY_ADDR 0x14 AALFI_FOR_DYNAMICALLY_DEFINE_DATA_ID 0x14 AALFI_FOR_REQUEST_DOWNLOAD 0x34 /end ADDRESS_AND_LENGTH_FORMAT_IDENTIFIER
  /begin CAN 0x07A120 SamplePoint 0x46 SamplesPerBit 0x01 BTL_CYCLES 0x10 SJW 0x02 SYNC_EDGE 0x00 /begin ADDRESS 0x07E9 0x07E1 /end ADDRESS /begin TransportProtocolVersion ISO15765_2_2003 /end TransportProtocolVersion NETWORK_LIMITS 0x0A 0x0500 USDTP_TIMING_DEFAULTS 0x03E8 0x03E8 0x03E8 0x00 0x32 0x00 0x1388 USDTP_TIMING 0x03E8 0x03E8 0x03E8 0x00 0x32 0x00 0x1388 /end CAN
 /end TP_BLOB
/end IF_DATA
/begin IF_DATA ASAP1B_Bypass
 /begin TP_BLOB 0x0100 0x0100 /end TP_BLOB
/end IF_DATA
/begin IF_DATA ETK
 /begin SOURCE "2.5ms time synchronous" 2 25 QP_BLOB 0x0102 0x01 DIRECT 0x20 MEASUREMENT 0xFFFC0D04 0x60 0xFFF80134 0xFFF89018 0x00 0x00 0x00 0x04E2 0x60 0x00 0x01 /end SOURCE
 /begin SOURCE "5ms time synchronous" 3 5 QP_BLOB 0x0102 0x02 DIRECT 0x1F MEASUREMENT 0xFFFC0D04 0x60 0xFFF802BC 0xFFF89078 0x00 0x00 0x00 0x09C4 0x60 0x00 0x02 /end SOURCE
 /begin SOURCE "10ms time synchronous" 4 1 QP_BLOB 0x0102 0x03 DIRECT 0x1E MEASUREMENT 0xFFFC0D04 0x60 0xFFF80444 0xFFF890D8 0x00 0x00 0x00 0x1388 0x60 0x00 0x03 /end SOURCE
 /begin SOURCE "20ms time synchronous" 4 2 QP_BLOB 0x0102 0x04 DIRECT 0x1C MEASUREMENT 0xFFFC0D04 0x60 0xFFF805CC 0xFFF89138 0x00 0x00 0x00 0x2710 0x60 0x00 0x04 /end SOURCE
 /begin SOURCE "50ms time synchronous" 4 5 QP_BLOB 0x0102 0x05 DIRECT 0x1B MEASUREMENT 0xFFFC0D04 0x60 0xFFF80754 0xFFF89198 0x00 0x00 0x00 0x61A8 0x60 0x00 0x05 /end SOURCE
 /begin SOURCE "100ms time synchronous" 4 10 QP_BLOB 0x0102 0x06 DIRECT 0x1A MEASUREMENT 0xFFFC0D04 0x60 0xFFF808DC 0xFFF891F8 0x00 0x00 0x00 0xC350 0x60 0x00 0x06 /end SOURCE
 /begin SOURCE "Bypass 10ms time synchronous" 4 1 QP_BLOB 0x0102 0x07 DIRECT 0x1D BYPASS 0xFFFC0D04 0x78 0xFFF80A64 0xFFF89258 0x78 0x00 0xFFF892D0 0x1388 0x78 0x78 0x03 /end SOURCE
 /begin TP_BLOB 0x01000104 INTERFACE_SPEED_100MBIT 0x7FFFFF07 DISTAB_CFG 0x0D 0x0122 0x01 0xFFFC0D04 0x01010100 TRG_MOD 0x00 0xFF 0x00 0x00 0x00 ETK_CFG 0x10 0x17 0x69 0x00 0x00 0xFF 0xFF 0x6F 0xB2 0x70 0x78 0x64 0x0B 0x74 0xC8 0x72 0xC7 0x71 0x9D 0x73 0xBA 0x75 0xC5 ETK_MAILBOX 0x46425251 EXRAM 0xFFF89000 0x18 EXRAM 0xFFF89000 0x18 0x03 0x0100
  /begin COLDSTART_HANDSHAKE 0xFFF909F4 WAIT 0x57 0x41 0x49 0x54 READY 0x51 0x45 0x41 0x44 /end COLDSTART_HANDSHAKE
  PAGE_SWITCH_METHOD 0x01 MAILBOX 0x01 0x14 0xFFF80C4C AUTOSTART_BEHAVIOR LAST_ACTIVE_PAGE OCT_WORKINGPAGE 0x21 0xFFF80100 0x34 /end TP_BLOB
/end IF_DATA
/begin MOD_PAR "Gen2_BMW_System_Supplier_Lib" VERSION "none" CUSTOMER_NO "0" USER "Spindler" PHONE_NO "+49-711-811-43376" ECU "TCU_2_3_1" CPU_TYPE "SH2A" ADDR_EPK 0x190100 EPK "0327C05_ZHBC8600_8PXYH_BMW_L860C"
 /begin MEMORY_SEGMENT Pst0 "" RESERVED FLASH INTERN 0x0 0x40000 -1 -1 -1 -1 -1 /begin IF_DATA ETK ADDRESS_MAPPING 0x00 0x00 0x040000 /end IF_DATA
  /begin IF_DATA ASAP1B_DIAGNOSTIC_SERVICES ADDRESS_MAPPING 0x00 0x00 0x040000 /end IF_DATA
  /begin IF_DATA XCP
   /begin SEGMENT 0x00 0x02 0x00 0x00 0x00 /begin CHECKSUM XCP_ADD_14 MAX_BLOCK_SIZE 0xFFFFFFFF /end CHECKSUM
    /begin PAGE 0x00 ECU_ACCESS_DONT_CARE XCP_READ_ACCESS_WITH_ECU_ONLY XCP_WRITE_ACCESS_NOT_ALLOWED /end PAGE
    /begin PAGE 0x01 ECU_ACCESS_DONT_CARE XCP_READ_ACCESS_DONT_CARE XCP_WRITE_ACCESS_WITH_ECU_ONLY /end PAGE
   /end SEGMENT
  /end IF_DATA
 /end MEMORY_SEGMENT
 /begin MEMORY_SEGMENT Pst40000 "" RESERVED FLASH INTERN 0x40000 0x80 -1 -1 -1 -1 -1 /begin IF_DATA ETK ADDRESS_MAPPING 0x040000 0x040000 0x80 /end IF_DATA
  /begin IF_DATA ASAP1B_DIAGNOSTIC_SERVICES ADDRESS_MAPPING 0x040000 0x040000 0x80 /end IF_DATA
  /begin IF_DATA XCP
   /begin SEGMENT 0x01 0x02 0x00 0x00 0x00 /begin CHECKSUM XCP_ADD_14 MAX_BLOCK_SIZE 0xFFFFFFFF /end CHECKSUM
    /begin PAGE 0x00 ECU_ACCESS_DONT_CARE XCP_READ_ACCESS_WITH_ECU_ONLY XCP_WRITE_ACCESS_NOT_ALLOWED /end PAGE
    /begin PAGE 0x01 ECU_ACCESS_DONT_CARE XCP_READ_ACCESS_DONT_CARE XCP_WRITE_ACCESS_WITH_ECU_ONLY /end PAGE
   /end SEGMENT
  /end IF_DATA
 /end MEMORY_SEGMENT
 /begin MEMORY_SEGMENT Pst40080 "" CODE FLASH INTERN 0x40080 0x13FAF0 -1 -1 -1 -1 -1 /begin IF_DATA ETK ADDRESS_MAPPING 0x040080 0x040080 0x13FAF0 /end IF_DATA
  /begin IF_DATA ASAP1B_DIAGNOSTIC_SERVICES ADDRESS_MAPPING 0x040080 0x040080 0x13FAF0 /end IF_DATA
  /begin IF_DATA XCP
   /begin SEGMENT 0x02 0x02 0x00 0x00 0x00 /begin CHECKSUM XCP_ADD_14 MAX_BLOCK_SIZE 0xFFFFFFFF /end CHECKSUM
    /begin PAGE 0x00 ECU_ACCESS_DONT_CARE XCP_READ_ACCESS_WITH_ECU_ONLY XCP_WRITE_ACCESS_NOT_ALLOWED /end PAGE
    /begin PAGE 0x01 ECU_ACCESS_DONT_CARE XCP_READ_ACCESS_DONT_CARE XCP_WRITE_ACCESS_WITH_ECU_ONLY /end PAGE
   /end SEGMENT
  /end IF_DATA
 /end MEMORY_SEGMENT
 /begin MEMORY_SEGMENT Pst17FB70 "" RESERVED FLASH INTERN 0x17FB70 0x490 -1 -1 -1 -1 -1 /begin IF_DATA ETK ADDRESS_MAPPING 0x17FB70 0x17FB70 0x0490 /end IF_DATA
  /begin IF_DATA ASAP1B_DIAGNOSTIC_SERVICES ADDRESS_MAPPING 0x17FB70 0x17FB70 0x0490 /end IF_DATA
  /begin IF_DATA XCP
   /begin SEGMENT 0x03 0x02 0x00 0x00 0x00 /begin CHECKSUM XCP_ADD_14 MAX_BLOCK_SIZE 0xFFFFFFFF /end CHECKSUM
    /begin PAGE 0x00 ECU_ACCESS_DONT_CARE XCP_READ_ACCESS_WITH_ECU_ONLY XCP_WRITE_ACCESS_NOT_ALLOWED /end PAGE
    /begin PAGE 0x01 ECU_ACCESS_DONT_CARE XCP_READ_ACCESS_DONT_CARE XCP_WRITE_ACCESS_WITH_ECU_ONLY /end PAGE
   /end SEGMENT
  /end IF_DATA
 /end MEMORY_SEGMENT
 /begin MEMORY_SEGMENT Dst180000 "" RESERVED FLASH INTERN 0x180000 0x280 -1 -1 -1 -1 -1 /begin IF_DATA ETK ADDRESS_MAPPING 0x180000 0x180000 0x0280 /end IF_DATA
  /begin IF_DATA ASAP1B_DIAGNOSTIC_SERVICES ADDRESS_MAPPING 0x180000 0x180000 0x0280 /end IF_DATA
  /begin IF_DATA XCP
   /begin SEGMENT 0x04 0x02 0x00 0x00 0x00 /begin CHECKSUM XCP_ADD_14 MAX_BLOCK_SIZE 0xFFFFFFFF /end CHECKSUM
    /begin PAGE 0x00 ECU_ACCESS_DONT_CARE XCP_READ_ACCESS_WITH_ECU_ONLY XCP_WRITE_ACCESS_NOT_ALLOWED /end PAGE
    /begin PAGE 0x01 ECU_ACCESS_DONT_CARE XCP_READ_ACCESS_DONT_CARE XCP_WRITE_ACCESS_WITH_ECU_ONLY /end PAGE
   /end SEGMENT
  /end IF_DATA
 /end MEMORY_SEGMENT
 /begin MEMORY_SEGMENT Dst180280 "" CODE FLASH INTERN 0x180280 0xFD80 -1 -1 -1 -1 -1 /begin IF_DATA ETK ADDRESS_MAPPING 0x180280 0x180280 0xFD80 /end IF_DATA
  /begin IF_DATA ASAP1B_DIAGNOSTIC_SERVICES ADDRESS_MAPPING 0x180280 0x180280 0xFD80 /end IF_DATA
  /begin IF_DATA XCP
   /begin SEGMENT 0x05 0x02 0x00 0x00 0x00 /begin CHECKSUM XCP_ADD_14 MAX_BLOCK_SIZE 0xFFFFFFFF /end CHECKSUM
    /begin PAGE 0x00 ECU_ACCESS_DONT_CARE XCP_READ_ACCESS_WITH_ECU_ONLY XCP_WRITE_ACCESS_NOT_ALLOWED /end PAGE
    /begin PAGE 0x01 ECU_ACCESS_DONT_CARE XCP_READ_ACCESS_DONT_CARE XCP_WRITE_ACCESS_WITH_ECU_ONLY /end PAGE
   /end SEGMENT
  /end IF_DATA
 /end MEMORY_SEGMENT
 /begin MEMORY_SEGMENT Dst190000 "" DATA FLASH INTERN 0x190000 0x6FD60 -1 -1 -1 -1 -1 /begin IF_DATA ETK ADDRESS_MAPPING 0x190000 0x190000 0x06FD60 /end IF_DATA
  /begin IF_DATA ASAP1B_DIAGNOSTIC_SERVICES ADDRESS_MAPPING 0x190000 0x190000 0x06FD60 /end IF_DATA
  /begin IF_DATA XCP
   /begin SEGMENT 0x06 0x02 0x00 0x00 0x00 /begin CHECKSUM XCP_ADD_14 MAX_BLOCK_SIZE 0xFFFFFFFF /end CHECKSUM
    /begin PAGE 0x00 ECU_ACCESS_DONT_CARE XCP_READ_ACCESS_WITH_ECU_ONLY XCP_WRITE_ACCESS_NOT_ALLOWED /end PAGE
    /begin PAGE 0x01 ECU_ACCESS_DONT_CARE XCP_READ_ACCESS_DONT_CARE XCP_WRITE_ACCESS_WITH_ECU_ONLY /end PAGE
   /end SEGMENT
  /end IF_DATA
 /end MEMORY_SEGMENT
 /begin MEMORY_SEGMENT Dst1FFD60 "" RESERVED FLASH INTERN 0x1FFD60 0x2A0 -1 -1 -1 -1 -1 /begin IF_DATA ETK ADDRESS_MAPPING 0x1FFD60 0x1FFD60 0x02A0 /end IF_DATA
  /begin IF_DATA ASAP1B_DIAGNOSTIC_SERVICES ADDRESS_MAPPING 0x1FFD60 0x1FFD60 0x02A0 /end IF_DATA
  /begin IF_DATA XCP
   /begin SEGMENT 0x07 0x02 0x00 0x00 0x00 /begin CHECKSUM XCP_ADD_14 MAX_BLOCK_SIZE 0xFFFFFFFF /end CHECKSUM
    /begin PAGE 0x00 ECU_ACCESS_DONT_CARE XCP_READ_ACCESS_WITH_ECU_ONLY XCP_WRITE_ACCESS_NOT_ALLOWED /end PAGE
    /begin PAGE 0x01 ECU_ACCESS_DONT_CARE XCP_READ_ACCESS_DONT_CARE XCP_WRITE_ACCESS_WITH_ECU_ONLY /end PAGE
   /end SEGMENT
  /end IF_DATA
 /end MEMORY_SEGMENT
 /begin MEMORY_SEGMENT RamFFF80000 "" VARIABLES RAM INTERN 0xFFF80000 0x1B000 -1 -1 -1 -1 -1
  /begin IF_DATA XCP
   /begin SEGMENT 0x08 0x02 0x00 0x00 0x00
    /begin CHECKSUM XCP_ADD_14 MAX_BLOCK_SIZE 0xFFFFFFFF EXTERNAL_FUNCTION "chksum.dll" /end CHECKSUM
    /begin PAGE 0x00 ECU_ACCESS_WITH_XCP_ONLY XCP_READ_ACCESS_WITH_ECU_ONLY XCP_WRITE_ACCESS_NOT_ALLOWED /end PAGE
    /begin PAGE 0x01 ECU_ACCESS_WITH_XCP_ONLY XCP_READ_ACCESS_WITH_ECU_ONLY XCP_WRITE_ACCESS_WITH_ECU_ONLY /end PAGE
   /end SEGMENT
  /end IF_DATA
 /end MEMORY_SEGMENT
 /begin MEMORY_SEGMENT RamFFF9B000 "" SERAM RAM INTERN 0xFFF9B000 0x3000 -1 -1 -1 -1 -1
  /begin IF_DATA XCP
   /begin SEGMENT 0x09 0x02 0x00 0x00 0x00
    /begin CHECKSUM XCP_ADD_14 MAX_BLOCK_SIZE 0xFFFFFFFF EXTERNAL_FUNCTION "chksum.dll" /end CHECKSUM
    /begin PAGE 0x00 ECU_ACCESS_WITH_XCP_ONLY XCP_READ_ACCESS_WITH_ECU_ONLY XCP_WRITE_ACCESS_NOT_ALLOWED /end PAGE
    /begin PAGE 0x01 ECU_ACCESS_WITH_XCP_ONLY XCP_READ_ACCESS_WITH_ECU_ONLY XCP_WRITE_ACCESS_WITH_ECU_ONLY /end PAGE
   /end SEGMENT
  /end IF_DATA
 /end MEMORY_SEGMENT
 /begin MEMORY_SEGMENT RamFFF9E000 "" VARIABLES RAM INTERN 0xFFF9E000 0x2000 -1 -1 -1 -1 -1
  /begin IF_DATA XCP
   /begin SEGMENT 0x0A 0x02 0x00 0x00 0x00
    /begin CHECKSUM XCP_ADD_14 MAX_BLOCK_SIZE 0xFFFFFFFF EXTERNAL_FUNCTION "chksum.dll" /end CHECKSUM
    /begin PAGE 0x00 ECU_ACCESS_WITH_XCP_ONLY XCP_READ_ACCESS_WITH_ECU_ONLY XCP_WRITE_ACCESS_NOT_ALLOWED /end PAGE
    /begin PAGE 0x01 ECU_ACCESS_WITH_XCP_ONLY XCP_READ_ACCESS_WITH_ECU_ONLY XCP_WRITE_ACCESS_WITH_ECU_ONLY /end PAGE
   /end SEGMENT
  /end IF_DATA
 /end MEMORY_SEGMENT
 /begin MEMORY_SEGMENT RamFFFC0000 "" VARIABLES RAM INTERN 0xFFFC0000 0x40000 -1 -1 -1 -1 -1
  /begin IF_DATA XCP
   /begin SEGMENT 0x0B 0x02 0x00 0x00 0x00
    /begin CHECKSUM XCP_ADD_14 MAX_BLOCK_SIZE 0xFFFFFFFF EXTERNAL_FUNCTION "chksum.dll" /end CHECKSUM
    /begin PAGE 0x00 ECU_ACCESS_WITH_XCP_ONLY XCP_READ_ACCESS_WITH_ECU_ONLY XCP_WRITE_ACCESS_NOT_ALLOWED /end PAGE
    /begin PAGE 0x01 ECU_ACCESS_WITH_XCP_ONLY XCP_READ_ACCESS_WITH_ECU_ONLY XCP_WRITE_ACCESS_WITH_ECU_ONLY /end PAGE
   /end SEGMENT
  /end IF_DATA
 /end MEMORY_SEGMENT
 SYSTEM_CONSTANT "CAN_NUM_CLASSES_SY" "8"
 SYSTEM_CONSTANT "CAN_NUM_FIFOR_SY" "16"
 SYSTEM_CONSTANT "CAN_NUM_NODES_SY" "3"
 SYSTEM_CONSTANT "CAN_Num_CnBus_SY" "2"
 SYSTEM_CONSTANT "CAN_PROJ_CFG_SY" "351"
 SYSTEM_CONSTANT "CAN_RxMode2_SY" "10"
 SYSTEM_CONSTANT "CAN_RxMode2act_SY" "1"
 SYSTEM_CONSTANT "CNE_SWTNETMNMT_SY" "1"
 SYSTEM_CONSTANT "OmmCfg_CFG_USESDNSLP" "0"
 SYSTEM_CONSTANT "OmmIfSys_CFG_USE10MSTSKINI_SY" "1"
 SYSTEM_CONSTANT "OmmIfSys_CFG_USE30MSTSK_SY" "1"
 SYSTEM_CONSTANT "OmmIfSys_CFG_USEDSMCLRTSK_SY" "0"
 SYSTEM_CONSTANT "RCT_CFG_SCHEDPREEMPBG_SY" "1"
 SYSTEM_CONSTANT "RCT_CFG_USE10MSTSKINI_SY" "1"
 SYSTEM_CONSTANT "RCT_CFG_USE30MSTSK_SY" "1"
 SYSTEM_CONSTANT "RCT_CFG_USE5MSINITSK_SY" "1"
 SYSTEM_CONSTANT "RCT_CFG_USEDSMCLRTSK_SY" "0"
 SYSTEM_CONSTANT "RCT_MODE_NUM_SY" "6"
 SYSTEM_CONSTANT "RCT_TSK_NUM_SY" "9"
 SYSTEM_CONSTANT "RMN_CFG_TSKENH_SY" "1"
 SYSTEM_CONSTANT "RMN_CFG_TSK_SY" "1"
 SYSTEM_CONSTANT "ROS_IN_LIB_SY" "1"
 SYSTEM_CONSTANT "ROS_NUM_MNTSK_100MS_SY" "20"
 SYSTEM_CONSTANT "RRT_CFG_CPULD2_SY" "1"
 SYSTEM_CONSTANT "RRT_CFG_FGP_SY" "1"
 SYSTEM_CONSTANT "RRT_CFG_ISR_SY" "1"
 SYSTEM_CONSTANT "RRT_CFG_PROC_ALL_SY" "1"
 SYSTEM_CONSTANT "RRT_CFG_PROC_SY" "1"
 SYSTEM_CONSTANT "RRT_CFG_SWT_SY" "63"
 SYSTEM_CONSTANT "RRT_CFG_TSK_SY" "1"
 SYSTEM_CONSTANT "RRT_NUMPROCRUN_100_SY" "35"
 SYSTEM_CONSTANT "RRT_NUMPROCRUN_10_SY" "120"
 SYSTEM_CONSTANT "RRT_NUMPROCRUN_20_SY" "35"
 SYSTEM_CONSTANT "RRT_NUMPROCRUN_2X5_SY" "20"
 SYSTEM_CONSTANT "RRT_NUMPROCRUN_30_SY" "50"
 SYSTEM_CONSTANT "RRT_NUMPROCRUN_50_SY" "20"
 SYSTEM_CONSTANT "RRT_NUMPROCRUN_5_SY" "40"
 SYSTEM_CONSTANT "RRT_NUMPROCRUN_BG_SY" "10"
 SYSTEM_CONSTANT "RRT_NUMPROCRUN_FN_SY" "45"
 SYSTEM_CONSTANT "RRT_NUMPROCRUN_TRS_SY" "55"
 SYSTEM_CONSTANT "RRT_NUMPROCTAB_SY" "7"
 SYSTEM_CONSTANT "RRT_PROC_NUM_SY" "5"
 SYSTEM_CONSTANT "RRT_SWTPROCCTL_X_SY" "6"
 SYSTEM_CONSTANT "SHRVAR_CAFID_LNGTH_SY" "8"
 SYSTEM_CONSTANT "SHRVAR_CPS_LNGTH_SY" "7"
 SYSTEM_CONSTANT "SHRVAR_SGNTR_LNGTH_SY" "132"
 SYSTEM_CONSTANT "SHRVAR_VARCOD_LNGTH_SY_1" "2"
 SYSTEM_CONSTANT "SHRVAR_VARCOD_LNGTH_SY_2" "2"
 SYSTEM_CONSTANT "TPRT_CFG_DIA_MIN_DSM_CLR_SY" "0"
 SYSTEM_CONSTANT "TPRT_CFG_DIA_MIN_DSM_SY" "0"
 SYSTEM_CONSTANT "TPRT_CFG_DIA_MNG_SY" "2"
 SYSTEM_CONSTANT "TPRT_CFG_MEM_DP_NUM_BYTE_SY" "100"
 SYSTEM_CONSTANT "TPRT_CFG_OUCD_TAB_SY" "1"
 SYSTEM_CONSTANT "TPRT_CFG_SEED_KEY_SY" "1"
 SYSTEM_CONSTANT "TPRT_CFG_SIG_OUT_TAB_SY" "1"
 SYSTEM_CONSTANT "TPRT_CFG_TOUT_SY" "1"
 SYSTEM_CONSTANT "TPRT_MSG_BUF_NUM_ELM_SY" "8"
 /begin CALIBRATION_METHOD "InCircuit" 0x2 /begin CALIBRATION_HANDLE 0x180280 0xCFE0 0x4 0x0 0x0 /end CALIBRATION_HANDLE /end CALIBRATION_METHOD
/end MOD_PAR
/begin COMPU_VTAB _CNV_S_2_Enum_EFLAN_268_S2 "" TAB_VERB 2 0 "Steigend_oder_Gleich" 1 "Fallend" DEFAULT_VALUE "" /end COMPU_VTAB
/begin COMPU_VTAB _CNV_S_2_Enum_EMINM_258_S2 "" TAB_VERB 2 0 "MIN_NAB" 1 "MAX_NAB" DEFAULT_VALUE "" /end COMPU_VTAB
/begin COMPU_VTAB _CNV_S_2_Enum_ERSP__136_S2 "" TAB_VERB 2 0 "RSP_NOT_STEPTR" 1 "RSP_STEPTR" DEFAULT_VALUE "" /end COMPU_VTAB
/begin COMPU_VTAB _CNV_S_2_Enum_EWKMA_127_S2 "" TAB_VERB 2 0 "WKMAX_AUF" 1 "WKMAX_GER" DEFAULT_VALUE "" /end COMPU_VTAB
/begin COMPU_VTAB _CNV_S_2_EnumMINMAX_269_S2 "" TAB_VERB 2 0 "MIN" 1 "MAX" DEFAULT_VALUE "" /end COMPU_VTAB
/begin COMPU_VTAB _CNV_S_3_Enum_EDNWK_270_S2 "" TAB_VERB 3 0 "KEIN_HOTMODE_KEINE_SCHALTUNG" 1 "HOTMODE" 2 "KEIN_HOTMODE_SCHALTUNG" DEFAULT_VALUE "" /end COMPU_VTAB
/begin COMPU_VTAB _CNV_S_3_Enum_EWKZ__126_S2 "" TAB_VERB 3 0 "WKZ" 1 "WKZNT" 2 "WKZFENSTER" DEFAULT_VALUE "" /end COMPU_VTAB
/begin COMPU_VTAB _CNV_S_4_Enum_EFGRB_58_S2 "" TAB_VERB 4 0 "A_AGS" 1 "S_AGS" 2 "A_AGS_BERG" 3 "S_AGS_BERG" DEFAULT_VALUE "" /end COMPU_VTAB
/begin COMPU_VTAB _CNV_S_5_Enum_ZDRIV_159_S2 "" TAB_VERB 5 0 "D_DRIVE" 1 "S_DRIVE" 2 "M_DRIVE" 3 "TID_DRIVE" 4 "LMODE_DRIVE" DEFAULT_VALUE "" /end COMPU_VTAB
/begin COMPU_VTAB _CNV_S_6_Enum_EFWSI_178_S2 "" TAB_VERB 6 0 "KeinBerg" 1 "A1" 2 "A2" 3 "A3" 4 "A4" 5 "A5" DEFAULT_VALUE "" /end COMPU_VTAB
/begin COMPU_VTAB _CNV_S_6_Enum_ELDMB_60_S2 "" TAB_VERB 6 0 "LDM_A" 1 "LDM_S" 2 "LDM_A_BERG1" 3 "LDM_S_BERG1" 4 "LDM_A_BERG2" 5 "LDM_S_BERG2" DEFAULT_VALUE "" /end COMPU_VTAB
/begin COMPU_VTAB _CNV_S_8_Enum_EFGR_59_S2 "" TAB_VERB 8 0 "FGR_PASSIV" 1 "FGR_AKTIV_KONSTANTFAHRT" 2 "FGR_ACC_REGELUNG_STANDARD" 3 "FGR_AKTIV_WIEDERAUFNAHME" 4 "FGR_ACC_REGELUNG_ERH_DYNAMIK" 5 "FGR_AKTIV_SETZEN_BESCHL" 6 "FGR_ACC_REGELUNG_ABSCHALTUNG" 7 "FGR_AKTIV_VERZOEGERN" DEFAULT_VALUE "" /end COMPU_VTAB
/begin COMPU_VTAB CONV_TAB_E_FEHLERIEP_S6_S3 "Conversion table" TAB_VERB 2 0 "NORMALBETRIEB" 1 "FEHLER" DEFAULT_VALUE "" /end COMPU_VTAB
/begin COMPU_VTAB CONV_TAB_E_HYBFKT_S6_S3 "Conversion table" TAB_VERB 16 0 "PASSIV" 1 "ANKOPPELN_VM" 2 "ABKOPPELN_VM" 3 "GANGEINLEGEN" 4 "GANGAUSLEGEN" 5 "OHNABLAUFFKT" 6 "DIREKTSTART" 7 "VM_ZUSTART" 8 "ABSTELLEN_VM" 9 "NICHTDEFINIERT_4" 10 "VM_SCHLEPPSTART" 11 "VM_NOTSTART" 12 "VM_EIN" 13 "VM_AUS" 14 "NICHTDEFINIERT_3" 15 "FEHLER" DEFAULT_VALUE "" /end COMPU_VTAB
/begin COMPU_VTAB CONV_TAB_E_POS_S6_S3 "Conversion table" TAB_VERB 9 0 "D1" 1 "D2" 2 "D3" 3 "D4" 4 "D5" 5 "D" 6 "N" 7 "R" 8 "P" DEFAULT_VALUE "" /end COMPU_VTAB
/begin COMPU_VTAB CONV_TAB_E_SIGSTATUS_S6_S3 "Conversion table" TAB_VERB 3 0 "SIGNAL_OK" 1 "ERSATZWERT" 2 "SIGNAL_FEHLER" DEFAULT_VALUE "" /end COMPU_VTAB
/begin COMPU_VTAB CONV_TAB_E_STATUSADA_S6_S3 "Conversion table" TAB_VERB 3 0 "KEINADAPTION" 1 "TOUCHPOINT_ADAPTION" 2 "REIBWERT_ADAPTION" DEFAULT_VALUE "" /end COMPU_VTAB
/begin COMPU_VTAB CONV_TAB_E_STATUSIAE_S6_S3 "Conversion table" TAB_VERB 9 0 "NICHTDEFINIERT" 1 "OFFEN" 2 "ANGELEGT" 3 "ANFAHREN" 4 "ENTKOPPELT" 5 "ENTKOPPELT_ANFAHREN" 6 "SYNCHRONISIEREN" 7 "GESCHLOSSEN" 8 "OEFFNEN" DEFAULT_VALUE "" /end COMPU_VTAB
/begin COMPU_VTAB CONV_TAB_E_STATUSIEP_S6_S3 "Conversion table" TAB_VERB 5 0 "AUS" 1 "SLEEP" 2 "LP1" 3 "LP2" 4 "LP3" DEFAULT_VALUE "" /end COMPU_VTAB
/begin COMPU_VTAB CONV_TAB_E_STATUSK0_S6_S3 "Conversion table" TAB_VERB 6 0 "OFFEN" 1 "ANGELEGT" 2 "DRUCKSTELLUNG" 3 "SCHLUPFGEREGELT" 4 "GEREGELTGESCHL" 5 "GESCHLOSSEN" DEFAULT_VALUE "" /end COMPU_VTAB
/begin COMPU_VTAB CONV_TAB_E_STATUSKSL_S6_S3 "Conversion table" TAB_VERB 7 0 "KEIN_KRAFTSCHLUSS" 1 "VORW_AUF_ABBAUEND" 2 "VORWAERTS" 3 "RUECKW_AUF_ABBAUEND" 4 "RUECKWAERTS" 5 "VORWAERTS_SCHLUPF" 6 "RUECKWAERTS_SCHLUPF" DEFAULT_VALUE "" /end COMPU_VTAB
/begin COMPU_VTAB CONV_TAB_E_STATUSPSY_S6_S3 "Conversion table" TAB_VERB 5 0 "AUS" 1 "NICHTDEFINIERT" 2 "LP1" 3 "LP2" 4 "LP3" DEFAULT_VALUE "" /end COMPU_VTAB
/begin COMPU_VTAB CONV_TAB_E_STBZHAS_S6_S3 "Conversion table" TAB_VERB 16 0 "INIT_INAKTIV" 1 "ANGEKOPPELT" 2 "ENTKOPPELT" 3 "EFAHREN" 4 "STOP" 5 "LADEN" 6 "ENTK_VMEIN" 7 "EFAHREN_VMEIN" 8 "HYBRID" 9 "NICHTDEFINIERT_1" 10 "NICHTDEFINIERT_2" 11 "NICHTDEFINIERT_3" 12 "NICHTDEFINIERT_4" 13 "NICHTDEFINIERT_5" 14 "INIT_KL15" 15 "FEHLER" DEFAULT_VALUE "" /end COMPU_VTAB
/begin COMPU_VTAB CONV_TAB_E_ZIEP_S6_S3 "Conversion table" TAB_VERB 5 0 "AUS" 1 "SLEEP" 2 "LP1" 3 "LP2" 4 "LP3" DEFAULT_VALUE "" /end COMPU_VTAB
/begin COMPU_VTAB CONV_TAB_E_ZK0_S6_S3 "Conversion table" TAB_VERB 6 0 "OEFFNENSW" 1 "BEFUELLEN" 2 "DRUCKSTELLUNG" 3 "SCHLUPFREGELUNG" 4 "GEREGELTGESCHL" 5 "GESCHLOSSEN" DEFAULT_VALUE "" /end COMPU_VTAB
/begin COMPU_VTAB CONV_TAB_E_ZK0FSTIN_S6_S3 "Conversion table" TAB_VERB 4 0 "OFFEN" 1 "SCHLUPFGEREGELT" 2 "GEREGELTGESCHL" 3 "GESCHLOSSEN" DEFAULT_VALUE "" /end COMPU_VTAB
/begin COMPU_VTAB CONV_TAB_E_ZMODUSIAE_S6_S3 "Conversion table" TAB_VERB 3 0 "EFAHREN_SCHLUPF" 1 "EFAHREN_KRAFTSCHL" 2 "HYBRIDFAHREN" DEFAULT_VALUE "" /end COMPU_VTAB
/begin COMPU_VTAB CONV_TAB_E_ZMODUSIEP_S6_S3 "Conversion table" TAB_VERB 5 0 "KEINVORGABE" 1 "AUS" 2 "LP1" 3 "LP2" 4 "LP3" DEFAULT_VALUE "" /end COMPU_VTAB
/begin COMPU_VTAB CONV_TAB_E_ZNLLSOLL_S6_S3 "Conversion table" TAB_VERB 3 0 "KEINANF" 1 "ANF_ADAP" 2 "ANF_ALLG" DEFAULT_VALUE "" /end COMPU_VTAB
/begin COMPU_METHOD b_int_S6_S3 "Bit Feld" RAT_FUNC "%10.0" "-" COEFFS 0 1 0 0 0 1 /end COMPU_METHOD
/begin COMPU_METHOD c_int_S6_S3 "Temperatur" RAT_FUNC "%12.6" "°C" COEFFS 0 1 0 0 0 1 /end COMPU_METHOD
/begin COMPU_METHOD E_FEHLERIEP_S6_S3 "" TAB_VERB "%12.6" "" COMPU_TAB_REF CONV_TAB_E_FEHLERIEP_S6_S3 /end COMPU_METHOD
/begin COMPU_METHOD E_HYBFKT_S6_S3 "" TAB_VERB "%12.6" "" COMPU_TAB_REF CONV_TAB_E_HYBFKT_S6_S3 /end COMPU_METHOD
/begin COMPU_METHOD E_POS_S6_S3 "" TAB_VERB "%12.6" "" COMPU_TAB_REF CONV_TAB_E_POS_S6_S3 /end COMPU_METHOD
/begin COMPU_METHOD E_SIGSTATUS_S6_S3 "" TAB_VERB "%12.6" "" COMPU_TAB_REF CONV_TAB_E_SIGSTATUS_S6_S3 /end COMPU_METHOD
/begin COMPU_METHOD E_STATUSADA_S6_S3 "" TAB_VERB "%12.6" "" COMPU_TAB_REF CONV_TAB_E_STATUSADA_S6_S3 /end COMPU_METHOD
/begin COMPU_METHOD E_STATUSIAE_S6_S3 "" TAB_VERB "%12.6" "" COMPU_TAB_REF CONV_TAB_E_STATUSIAE_S6_S3 /end COMPU_METHOD
/begin COMPU_METHOD E_STATUSIEP_S6_S3 "" TAB_VERB "%12.6" "" COMPU_TAB_REF CONV_TAB_E_STATUSIEP_S6_S3 /end COMPU_METHOD
/begin COMPU_METHOD E_STATUSK0_S6_S3 "" TAB_VERB "%12.6" "" COMPU_TAB_REF CONV_TAB_E_STATUSK0_S6_S3 /end COMPU_METHOD
/begin COMPU_METHOD E_STATUSKSL_S6_S3 "" TAB_VERB "%12.6" "" COMPU_TAB_REF CONV_TAB_E_STATUSKSL_S6_S3 /end COMPU_METHOD
/begin COMPU_METHOD E_STATUSPSY_S6_S3 "" TAB_VERB "%12.6" "" COMPU_TAB_REF CONV_TAB_E_STATUSPSY_S6_S3 /end COMPU_METHOD
/begin COMPU_METHOD E_STBZHAS_S6_S3 "" TAB_VERB "%12.6" "" COMPU_TAB_REF CONV_TAB_E_STBZHAS_S6_S3 /end COMPU_METHOD
/begin COMPU_METHOD E_ZIEP_S6_S3 "" TAB_VERB "%12.6" "" COMPU_TAB_REF CONV_TAB_E_ZIEP_S6_S3 /end COMPU_METHOD
/begin COMPU_METHOD E_ZK0_S6_S3 "" TAB_VERB "%12.6" "" COMPU_TAB_REF CONV_TAB_E_ZK0_S6_S3 /end COMPU_METHOD
/begin COMPU_METHOD E_ZK0FSTIN_S6_S3 "" TAB_VERB "%12.6" "" COMPU_TAB_REF CONV_TAB_E_ZK0FSTIN_S6_S3 /end COMPU_METHOD
/begin COMPU_METHOD E_ZMODUSIAE_S6_S3 "" TAB_VERB "%12.6" "" COMPU_TAB_REF CONV_TAB_E_ZMODUSIAE_S6_S3 /end COMPU_METHOD
/begin COMPU_METHOD E_ZMODUSIEP_S6_S3 "" TAB_VERB "%12.6" "" COMPU_TAB_REF CONV_TAB_E_ZMODUSIEP_S6_S3 /end COMPU_METHOD
/begin COMPU_METHOD E_ZNLLSOLL_S6_S3 "" TAB_VERB "%12.6" "" COMPU_TAB_REF CONV_TAB_E_ZNLLSOLL_S6_S3 /end COMPU_METHOD
/begin COMPU_METHOD n_fl_S6_S3 "Drehzahl" RAT_FUNC "%12.6" "1/min" COEFFS 0 1 0 0 0 1 /end COMPU_METHOD
/begin COMPU_METHOD ng_fl_S6_S3 "Drehzahlgradient" RAT_FUNC "%12.6" "1/min/s" COEFFS 0 1 0 0 0 1 /end COMPU_METHOD
/begin COMPU_METHOD p_fl_S6_S3 "Druck" RAT_FUNC "%12.6" "bar" COEFFS 0 1 0 0 0 1 /end COMPU_METHOD
/begin COMPU_METHOD phi_fl_S6_S3 "Winkel" RAT_FUNC "%12.6" "rad" COEFFS 0 1 0 0 0 1 /end COMPU_METHOD
/begin COMPU_METHOD t_fl_S6_S3 "Zeit" RAT_FUNC "%12.6" "s" COEFFS 0 1 0 0 0 1 /end COMPU_METHOD
/begin COMPU_METHOD t_int_S6_S3 "Zeit" RAT_FUNC "%11.2" "s" COEFFS 0 100 0 0 0 1 /end COMPU_METHOD
/begin COMPU_METHOD trq_fl_a_S6_S3 "Moment" RAT_FUNC "%12.6" "Nm" COEFFS 0 1 0 0 0 1 /end COMPU_METHOD
/begin COMPU_METHOD trqg_fl_c_S6_S3 "Momentengradient" RAT_FUNC "%12.6" "Nm/s" COEFFS 0 1 0 0 0 1 /end COMPU_METHOD
/begin COMPU_METHOD v_fl_S6_S3 "Geschwindigkeit" RAT_FUNC "%12.6" "km/h" COEFFS 0 1 0 0 0 1 /end COMPU_METHOD
/begin COMPU_METHOD vg_fl_S6_S3 "Geschwindigkeitsgradient" RAT_FUNC "%12.6" "km/h/s" COEFFS 0 1 0 0 0 1 /end COMPU_METHOD
/begin COMPU_METHOD void_fl_S6_S3 "ohne Umrechnung" RAT_FUNC "%12.6" "-" COEFFS 0 1 0 0 0 1 /end COMPU_METHOD
/begin COMPU_METHOD void_int_b_S6_S3 "ohne Umrechnung" RAT_FUNC "%5.0" "-" COEFFS 0 1 0 0 0 1 /end COMPU_METHOD
/begin COMPU_METHOD void_int_e_S6_S3 "ohne Umrechnung" RAT_FUNC "%1.0" "-" COEFFS 0 1 0 0 0 1 /end COMPU_METHOD
/begin COMPU_METHOD void_int_S6_S3 "ohne Umrechnung" RAT_FUNC "%3.0" "-" COEFFS 0 1 0 0 0 1 /end COMPU_METHOD
/begin COMPU_METHOD VOID_SCALING_f_S6_S3 "Void scaling for unscaled variables" RAT_FUNC "%12.6" "" COEFFS 0 1 0 0 0 1 /end COMPU_METHOD
/begin CHARACTERISTIC ABSTELLPOS_OS_ERK_ABO "Obere Schwelle der Abstellpos für cd_andrehen_k0_oeffnen" VALUE 0x1CFE64 FLOAT32_IEEE_COL_DIRECT_S6_S3 0 phi_fl_S6_S3 -3.40282e+038 3.40282e+038 /end CHARACTERISTIC
/begin CHARACTERISTIC ABSTELLPOS_US_ERK_ABO "Ubere Schwelle der Abstellpos für cd_andrehen_k0_oeffnen" VALUE 0x1CFE68 FLOAT32_IEEE_COL_DIRECT_S6_S3 0 phi_fl_S6_S3 -3.40282e+038 3.40282e+038 /end CHARACTERISTIC
/begin AXIS_PTS KL_1NONEMABLVAR_ANS_X "X-Achse: z_ablaufvariante" 0x1D5D0C NO_INPUT_QUANTITY UBYTE_X_INCR_DIRECT_S6_S3 0 void_int_S6_S3 8 0 255 DEPOSIT ABSOLUTE /end AXIS_PTS
/begin CHARACTERISTIC KL_1NONEMABLVAR_ANS_Y "KL_1NONEMABLVAR_ANS" CURVE 0x1D5464 FLOAT32_IEEE_COL_DIRECT_S6_S3 0 n_fl_S6_S3 -3.40282e+038 3.40282e+038
 /begin AXIS_DESCR COM_AXIS NO_INPUT_QUANTITY void_int_S6_S3 8 0 255 DEPOSIT ABSOLUTE AXIS_PTS_REF KL_1NONEMABLVAR_ANS_X /end AXIS_DESCR
/end CHARACTERISTIC
/begin AXIS_PTS KL_1NSMINEMCGETR_ANS_X "X-Achse: c_getriebe_egs_in" 0x1D5484 NO_INPUT_QUANTITY FLOAT32_IEEE_X_INCR_DIRECT_S6_S3 0 c_int_S6_S3 8 -40 110 DEPOSIT ABSOLUTE /end AXIS_PTS
/begin CHARACTERISTIC KL_1NSMINEMCGETR_ANS_Y "Minimale EM-Drehzahl für Übergang nach Anschleppen  f(c_getriebe_egs_in)" CURVE 0x1D54A4 FLOAT32_IEEE_COL_DIRECT_S6_S3 0 n_fl_S6_S3 0 10000
 /begin AXIS_DESCR COM_AXIS NO_INPUT_QUANTITY c_int_S6_S3 8 -40 110 DEPOSIT ABSOLUTE AXIS_PTS_REF KL_1NSMINEMCGETR_ANS_X /end AXIS_DESCR
/end CHARACTERISTIC
/begin AXIS_PTS KL_KSVHRESETAUSZST_SAK_ZUS_X "Bedingtes Rücksetzen einer Schaltverhinderung während VM-Zustart in Abhängigkeit des Istgangs im Zustand Schaltung aktiv (255 = alle Arten von Schaltungen zurücksetzen, 0 = keine Schaltung zurücksetzen) -> Bit-Codierung siehe Handbuch" 0x1D72A0 NO_INPUT_QUANTITY SBYTE_X_INCR_DIRECT_S6_S3 0 void_int_S6_S3 8 -1 8 DEPOSIT ABSOLUTE /end AXIS_PTS
/begin CHARACTERISTIC KL_KSVHRESETAUSZST_SAK_ZUS_Y "Bedingtes Rücksetzen einer Schaltverhinderung während VM-Zustart in Abhängigkeit des Istgangs im Zustand Schaltung aktiv (255 = alle Arten von Schaltungen zurücksetzen, 0 = keine Schaltung zurücksetzen) -> Bit-Codierung siehe Handbuch" CURVE 0x1D72A8 UBYTE_COL_DIRECT_S6_S3 0 void_int_S6_S3 0 255
 /begin AXIS_DESCR COM_AXIS NO_INPUT_QUANTITY void_int_S6_S3 8 -1 8 DEPOSIT ABSOLUTE AXIS_PTS_REF KL_KSVHRESETAUSZST_SAK_ZUS_X /end AXIS_DESCR
/end CHARACTERISTIC
/begin AXIS_PTS KL_KSVHRESET_ZST_ZUS_X "Ruecksetzen einer Schaltverhinderung in Abhängigkeit des Istgangs im Zustand Zustarten beim Zustart (255 = alle Arten von Schaltungen zuruecksetzen, 0 = keine Schaltung zuruecksetzen) -> Bit-Codierung siehe Handbuch" 0x1D7310 NO_INPUT_QUANTITY SBYTE_X_INCR_DIRECT_S6_S3 0 void_int_S6_S3 8 -1 8 DEPOSIT ABSOLUTE /end AXIS_PTS
/begin CHARACTERISTIC KL_KSVHRESET_ZST_ZUS_Y "Ruecksetzen einer Schaltverhinderung in Abhängigkeit des Istgangs im Zustand Zustarten beim Zustart (255 = alle Arten von Schaltungen zuruecksetzen, 0 = keine Schaltung zuruecksetzen) -> Bit-Codierung siehe Handbuch" CURVE 0x1D7318 UBYTE_COL_DIRECT_S6_S3 0 void_int_S6_S3 0 255
 /begin AXIS_DESCR COM_AXIS NO_INPUT_QUANTITY void_int_S6_S3 8 -1 8 DEPOSIT ABSOLUTE AXIS_PTS_REF KL_KSVHRESET_ZST_ZUS_X /end AXIS_DESCR
/end CHARACTERISTIC
/begin AXIS_PTS KL_NDGSK0SYNCERK_SYN_ZUS_X "Maximaler Betrag des K0-Differenzdrehzahlgradienten zur Erkennung Synchron im Zustand K0 Synchronisieren beim Zustart in Abhängigkeit des VM Zielmoments beim Zustart" 0x1D7100 NO_INPUT_QUANTITY FLOAT32_IEEE_X_INCR_DIRECT_S6_S3 0 trq_fl_a_S6_S3 10 -3.40282e+038 3.40282e+038 DEPOSIT ABSOLUTE /end AXIS_PTS
/begin CHARACTERISTIC KL_NDGSK0SYNCERK_SYN_ZUS_Y "Maximaler Betrag des K0-Differenzdrehzahlgradienten zur Erkennung Synchron im Zustand K0 Synchronisieren beim Zustart in Abhängigkeit des VM Zielmoments beim Zustart" CURVE 0x1D7128 FLOAT32_IEEE_COL_DIRECT_S6_S3 0 ng_fl_S6_S3 -10000 10000
 /begin AXIS_DESCR COM_AXIS NO_INPUT_QUANTITY trq_fl_a_S6_S3 10 -3.40282e+038 3.40282e+038 DEPOSIT ABSOLUTE AXIS_PTS_REF KL_NDGSK0SYNCERK_SYN_ZUS_X /end AXIS_DESCR
/end CHARACTERISTIC
/begin AXIS_PTS KL_NDSK0MAXSCHLBED_SRT_ZUS_X "Maximale K0-Differenzdrehzahl für direkten Übergang nach K0-Schließen bei Abbruch Abstellen in Abhängigkeit der EM Drehzahl im Zustand Start beim Zustart" 0x1D7178 NO_INPUT_QUANTITY FLOAT32_IEEE_X_INCR_DIRECT_S6_S3 0 n_fl_S6_S3 5 -3.40282e+038 3.40282e+038 DEPOSIT ABSOLUTE /end AXIS_PTS
/begin CHARACTERISTIC KL_NDSK0MAXSCHLBED_SRT_ZUS_Y "Maximale K0-Differenzdrehzahl für direkten Übergang nach K0-Schließen bei Abbruch Abstellen in Abhängigkeit der EM Drehzahl im Zustand Start beim Zustart" CURVE 0x1D718C FLOAT32_IEEE_COL_DIRECT_S6_S3 0 n_fl_S6_S3 0 10000
 /begin AXIS_DESCR COM_AXIS NO_INPUT_QUANTITY n_fl_S6_S3 5 -3.40282e+038 3.40282e+038 DEPOSIT ABSOLUTE AXIS_PTS_REF KL_NDSK0MAXSCHLBED_SRT_ZUS_X /end AXIS_DESCR
/end CHARACTERISTIC
/begin AXIS_PTS KL_NDSK0MINSCHLBED_SRT_ZUS_X "Minimale K0-Differenzdrehzahl für direkten Übergang nach K0-Schließen bei Abbruch Abstellen in Abhängigkeit der EM Drehzahl im Zustand Start beim Zustart" 0x1D71A0 NO_INPUT_QUANTITY FLOAT32_IEEE_X_INCR_DIRECT_S6_S3 0 n_fl_S6_S3 5 -3.40282e+038 3.40282e+038 DEPOSIT ABSOLUTE /end AXIS_PTS
/begin CHARACTERISTIC KL_NDSK0MINSCHLBED_SRT_ZUS_Y "Minimale K0-Differenzdrehzahl für direkten Übergang nach K0-Schließen bei Abbruch Abstellen in Abhängigkeit der EM Drehzahl im Zustand Start beim Zustart" CURVE 0x1D71B4 FLOAT32_IEEE_COL_DIRECT_S6_S3 0 n_fl_S6_S3 -10000 0
 /begin AXIS_DESCR COM_AXIS NO_INPUT_QUANTITY n_fl_S6_S3 5 -3.40282e+038 3.40282e+038 DEPOSIT ABSOLUTE AXIS_PTS_REF KL_NDSK0MINSCHLBED_SRT_ZUS_X /end AXIS_DESCR
/end CHARACTERISTIC
/begin CHARACTERISTIC MAX_GANG "Maximaler Gang" VALUE 0x1D7D00 UBYTE_COL_DIRECT_S6_S3 0 void_int_S6_S3 0 255 /end CHARACTERISTIC
/begin CHARACTERISTIC MAX_GANGENTKPPL "Maximaler Gang für die Entkopplung über die IAE" VALUE 0x1D7D01 UBYTE_COL_DIRECT_S6_S3 0 void_int_S6_S3 0 255 /end CHARACTERISTIC
/begin CHARACTERISTIC MO_5VMSOLLK0GESCHL_ANS "Offset Kupplungsmoment für Erkennung Kupplung geschlossen" VALUE 0x1D19C8 FLOAT32_IEEE_COL_DIRECT_S6_S3 0 trq_fl_a_S6_S3 -3.40282e+038 3.40282e+038 /end CHARACTERISTIC
/begin CHARACTERISTIC MO_K0BED_SCL_ANS "Offset auf das K0 Istmoment zum Ver-gleich mit dem modifizierten K0-Moment der HAS als Übergangsbedin-gung nach Übergabe im Zustand K0-Schliessen beim Schleppstart" VALUE 0x1D19CC FLOAT32_IEEE_COL_DIRECT_S6_S3 0 trq_fl_a_S6_S3 -1000 1000 /end CHARACTERISTIC
/begin CHARACTERISTIC MO_SOLLVMHSTBED_SCL_ZUS "Offset auf das VM-Sollmoment der HST zum Vergleich mit dem modifizierten K0-Moment der HAS als Übergangsbedingung nach Übergabe im Zustand K0-Schliessen beim Zustart" VALUE 0x1D5E0C FLOAT32_IEEE_COL_DIRECT_S6_S3 0 trq_fl_a_S6_S3 -1000 1000 /end CHARACTERISTIC
/begin CHARACTERISTIC MO_SOLLVMLHSTBED_SCL_ZUS "Offset auf das VM-Luftpfadsollmoment der HST zum Vergleich mit dem modifizierten K0-Moment der HAS als Übergangsbedingung nach Übergabe im Zustand K0-Schliessen beim Zustart" VALUE 0x1D5E14 FLOAT32_IEEE_COL_DIRECT_S6_S3 0 trq_fl_a_S6_S3 -1000 1000 /end CHARACTERISTIC
/begin CHARACTERISTIC MS_10K0_ANS "Momentschwelle für Übergangsbedingung Abbruchzustand nach Übergabe" VALUE 0x1D19D4 FLOAT32_IEEE_COL_DIRECT_S6_S3 0 trq_fl_a_S6_S3 -100 1000 /end CHARACTERISTIC
/begin CHARACTERISTIC MS_K0BED_ABB_ZUS "K0-Momentenschwelle für den Übergang von Abbruch nach Übergabe" VALUE 0x1D5E24 FLOAT32_IEEE_COL_DIRECT_S6_S3 0 trq_fl_a_S6_S3 -1000 1000 /end CHARACTERISTIC
/begin CHARACTERISTIC MS_K0MINFUWKALTBED_ANH_ZUS "K0-Momentenschwelle bei aktiver FUW oder bei Kaltstart mit abgesenkter EM-Drehzahl als Übergangsbedingung nach K0 Schliessen im Zustand VM Drehzahlanhebung beim Zustart" VALUE 0x1D5E28 FLOAT32_IEEE_COL_DIRECT_S6_S3 0 trq_fl_a_S6_S3 -1000 1000 /end CHARACTERISTIC
/begin CHARACTERISTIC MS_K0OEFFNEN_KOE_ABO "Schwellwert für Oeffnen K0" VALUE 0x1CFE74 FLOAT32_IEEE_COL_DIRECT_S6_S3 0 trq_fl_a_S6_S3 -1000 1000 /end CHARACTERISTIC
/begin CHARACTERISTIC MS_K0SCHLBED_SRT_ZUS "Momentenschwelle für K0 für direkten Übergang nach K0 schließen bei Abbruch Abstellen" VALUE 0x1D5E30 FLOAT32_IEEE_COL_DIRECT_S6_S3 0 trq_fl_a_S6_S3 -1000 1000 /end CHARACTERISTIC
/begin CHARACTERISTIC MS_K0_ABB_NOS "K0-Momentenschwelle für den Übergang von ABB nach UEA" VALUE 0x1D1904 FLOAT32_IEEE_COL_DIRECT_S6_S3 0 trq_fl_a_S6_S3 -1000 1000 /end CHARACTERISTIC
/begin CHARACTERISTIC NDGS_K0SYNCERK_SYN_ZUS "Minimaler K0-Differenzdrehzahlgradient (negativer Wert!) zur Erkennung Synchron im Zustand K0 Synchronisieren beim Zustart" VALUE 0x1D5E50 FLOAT32_IEEE_COL_DIRECT_S6_S3 0 ng_fl_S6_S3 -10000 10000 /end CHARACTERISTIC
/begin CHARACTERISTIC NDS_3K0_ANS "Differenzdrehzahlschwelle Kupplung zum Umschalten auf Synchronisieren" VALUE 0x1D1A20 FLOAT32_IEEE_COL_DIRECT_S6_S3 0 n_fl_S6_S3 -3.40282e+038 3.40282e+038 /end CHARACTERISTIC
/begin CHARACTERISTIC NDS_EMNSOLLLLVMBED_ANH_ZUS "Schwellwert der Differenzdrehzahl zwischen EM Drehzahl und VM LL-Soll-Drehzahl als Übergangsbedingung nach K0 Synchronisieren im Zustand VM Drehzahlanhebung beim Zustart" VALUE 0x1D5E58 FLOAT32_IEEE_COL_DIRECT_S6_S3 0 n_fl_S6_S3 -10000 10000 /end CHARACTERISTIC
/begin CHARACTERISTIC NDS_K0K0SCHL_FUW_ZUS "K0 Differenzdrehzahlschwelle für den Übergang nach K0 Schliessen bei EM Fehlfunktion der Funktionsüberwachung der EM Funktion beim Zustart" VALUE 0x1D5E60 FLOAT32_IEEE_COL_DIRECT_S6_S3 0 n_fl_S6_S3 0 10000 /end CHARACTERISTIC
/begin CHARACTERISTIC NDS_K0KALTNEMBED_ANH_ZUS "K0-Differenzdrehzahlschwelle beim Kaltstart mit abgesenkter EM-Drehzahl als Übergangsbedingung nach K0 Schliessen im Zustand VM Drehzahlanhebung beim Zustart" VALUE 0x1D5E64 FLOAT32_IEEE_COL_DIRECT_S6_S3 0 n_fl_S6_S3 0 10000 /end CHARACTERISTIC
/begin CHARACTERISTIC NDS_SOLLVMNVMBED_ANH_ZUS "Schwellwert der Differenzdrehzahl zwischen ungefilterter VM Solldrehzahl und VM Ist-Drehzahl als Übergangsbedingung nach K0 Synchronisieren im Zustand Drehzahlanhebung beim Zustart" VALUE 0x1D5E70 FLOAT32_IEEE_COL_DIRECT_S6_S3 0 n_fl_S6_S3 0 10000 /end CHARACTERISTIC
/begin CHARACTERISTIC NDS_VMNEMBED_ANH_ZUS "Schwellwert der Differenzdrehzahl zwischen VM und EM Drehzahl als Übergangsbedingung nach K0 Synchronisieren im Zustand Drehzahlanhebung beim Zustart" VALUE 0x1D5E78 FLOAT32_IEEE_COL_DIRECT_S6_S3 0 n_fl_S6_S3 -10000 0 /end CHARACTERISTIC
/begin CHARACTERISTIC ND_1IAE_ANS "Differenzdrehzahlschwelle WK ab der in Variante 2 und 4  (E-Fahren mit geschlossener WK), ab der das Anschleppen beginnt" VALUE 0x1D1A30 FLOAT32_IEEE_COL_DIRECT_S6_S3 0 n_fl_S6_S3 -3.40282e+038 3.40282e+038 /end CHARACTERISTIC
/begin CHARACTERISTIC NGS_VMSYNCERK_SYN_ZUS "Maximaler VM Drehzahlgradient zur Erkennung Synchron im Zustand K0 Synchronisieren beim Zustart" VALUE 0x1D5E8C FLOAT32_IEEE_COL_DIRECT_S6_S3 0 ng_fl_S6_S3 -10000 10000 /end CHARACTERISTIC
/begin CHARACTERISTIC NS_0NVMCOND_ANS "Drehzahlschwelle n_vm fuer das Freischalten der Kondition Richtung Konditionieren" VALUE 0x1D1A4C FLOAT32_IEEE_COL_DIRECT_S6_S3 0 n_fl_S6_S3 -10000 10000 /end CHARACTERISTIC
/begin CHARACTERISTIC NS_2VMDREHT_ANS "Drehzahlschwelle n_VN dreht" VALUE 0x1D1A64 FLOAT32_IEEE_COL_DIRECT_S6_S3 0 n_fl_S6_S3 -10000 10000 /end CHARACTERISTIC
/begin CHARACTERISTIC NS_2VMLAEUFT_ANS "VM Drehzahlschwelle n_VM laeuft" VALUE 0x1D1A68 FLOAT32_IEEE_COL_DIRECT_S6_S3 0 n_fl_S6_S3 -10000 10000 /end CHARACTERISTIC
/begin CHARACTERISTIC NS_EMMINBED_NST_NOS "minimale EM-Drehzahlschwelle als Übergangsbedin-gung vom Zustand Notstarten (st_notstarten_nos) in den Zustand K0-Schließen (st_k0schliessen_nos)" VALUE 0x1D191C FLOAT32_IEEE_COL_DIRECT_S6_S3 0 n_fl_S6_S3 0 10000 /end CHARACTERISTIC
/begin CHARACTERISTIC NS_EMMINBED_SCL_NOS "minimale EM-Drehzahlschwelle als Übergangsbedin-gung vom Zustand K0-Schließen (st_k0schliessen_nos) in den Zustand Übergabe (st_uebergabe)" VALUE 0x1D1920 FLOAT32_IEEE_COL_DIRECT_S6_S3 0 n_fl_S6_S3 0 10000 /end CHARACTERISTIC
/begin CHARACTERISTIC NS_EMMINBED_SCL_ZUS "EM-Drehzahlschwelle zur Erkennung 'EM läuft noch' als Übergangsbedingung nach Übergabe im Zustand K0 Schliessen beim Zustart" VALUE 0x1D5EAC FLOAT32_IEEE_COL_DIRECT_S6_S3 0 n_fl_S6_S3 0 2000 /end CHARACTERISTIC
/begin CHARACTERISTIC NS_EMMINBED_SYN_ZUS "EM-Drehzahlschwelle zur Erkennung 'EM läuft noch' als Übergangsbedingung nach K0-Schliessen im Zustand K0 Synchronisieren beim Zustart" VALUE 0x1D5EB0 FLOAT32_IEEE_COL_DIRECT_S6_S3 0 n_fl_S6_S3 0 2000 /end CHARACTERISTIC
/begin CHARACTERISTIC NS_EMMINFUWKALTBED_ANH_ZUS "EM-Drehzahlschwelle zur Erkennung 'EM läuft' bei aktiver FUW oder bei Kaltstart mit abgesenkter EM-Drehzahl als Übergangsbedingung nach K0 Schliessen im Zustand VM Drehzahlanhebung beim Zustart" VALUE 0x1D5EB4 FLOAT32_IEEE_COL_DIRECT_S6_S3 0 n_fl_S6_S3 0 2000 /end CHARACTERISTIC
/begin CHARACTERISTIC NS_EMSAKBED_ZST_ZUS "EM-Drehzahlschwelle als Übergangsbedingung nach Schaltung aktiv im Zustand Zustarten beim Zustart" VALUE 0x1D5EBC FLOAT32_IEEE_COL_DIRECT_S6_S3 0 n_fl_S6_S3 0 10000 /end CHARACTERISTIC
/begin CHARACTERISTIC NS_VMEINBED_ZST_ZUS "VM-Drehzahlschwelle zur Erkennung VM läuft als Übergangsbedingung nach VM-Drehzahlanhebung im Zustand Zustarten beim Zustart" VALUE 0x1D5EC8 FLOAT32_IEEE_COL_DIRECT_S6_S3 0 n_fl_S6_S3 0 2000 /end CHARACTERISTIC
/begin CHARACTERISTIC NS_VMMINNEMFEHLERBED_FUW_ZUS "VM-Drehzahlschwelle zur Absicherung VM läuft bei Ablauf mit fehlerhafter EM-Drehzahl der Funktionsüberwachung der EM-Funktion beim Zustart" VALUE 0x1D5ECC FLOAT32_IEEE_COL_DIRECT_S6_S3 0 n_fl_S6_S3 0 2000 /end CHARACTERISTIC
/begin MEASUREMENT SFOp_Zus15_KL___SYNCERK_SYN_ZUS "" FLOAT32_IEEE VOID_SCALING_f_S6_S3 1 100 -3.40282e+038 3.40282e+038 ECU_ADDRESS 0xFFF96AD0 /end MEASUREMENT
/begin MEASUREMENT SFOp_Zus78_xp_ "" FLOAT32_IEEE VOID_SCALING_f_S6_S3 1 100 -3.40282e+038 3.40282e+038 ECU_ADDRESS 0xFFF96C38 /end MEASUREMENT
/begin CHARACTERISTIC STATUS_2ABLVMDREHT_HST_ANS "Anzeige der Strategie für VM dreht" VALUE 0x1D7D04 UBYTE_COL_DIRECT_S6_S3 0 void_int_S6_S3 0 8 /end CHARACTERISTIC
/begin CHARACTERISTIC STATUS_2ABLVMFEHLER_HST_ANS "Status Ablauf von HST VM startet fehlerhaft im zustand Ans" VALUE 0x1D7D05 UBYTE_COL_DIRECT_S6_S3 0 void_int_S6_S3 0 8 /end CHARACTERISTIC
/begin CHARACTERISTIC STATUS_2ABLVMLAEUFT_HST_ANS "Anzeige der Strategie für VM laeuft" VALUE 0x1D7D06 UBYTE_COL_DIRECT_S6_S3 0 void_int_S6_S3 0 8 /end CHARACTERISTIC
/begin CHARACTERISTIC STATUS_3ABLVMDREHT_HST_ANS "Anzeige der Strategie für VM dreht" VALUE 0x1D7D07 UBYTE_COL_DIRECT_S6_S3 0 void_int_S6_S3 0 8 /end CHARACTERISTIC
/begin CHARACTERISTIC STATUS_3ABLVMFEHLER_HST_ANS "Status Ablauf von HST VM startet fehlerhaft" VALUE 0x1D7D08 UBYTE_COL_DIRECT_S6_S3 0 void_int_S6_S3 0 8 /end CHARACTERISTIC
/begin CHARACTERISTIC STATUS_3ABLVMLAEUFT_HST_ANS "Anzeige der Strategie für VM laeuft" VALUE 0x1D7D09 UBYTE_COL_DIRECT_S6_S3 0 void_int_S6_S3 0 8 /end CHARACTERISTIC
/begin CHARACTERISTIC STATUS_ABLVM_ABF_ZUS "Projektspezifische Statusrueckmeldung der VM Selbstlauffaehigkeit als Uebergangsbedingung nach K0- Synchronisieren im Zustand VM-Abfangen beim Zustart" VALUE 0x1D801B UBYTE_COL_DIRECT_S6_S3 0 void_int_S6_S3 0 15 /end CHARACTERISTIC
/begin CHARACTERISTIC STATUS_ABLVM_ANH_ZUS "Projektspezifische Statusrueckmeldung der VM Selbstlauffaehigkeit als Uebergangsbedingung nach K0- Synchronisieren im Zustand VM-Drehzahlanhebung beim Zustart" VALUE 0x1D801C UBYTE_COL_DIRECT_S6_S3 0 void_int_S6_S3 0 15 /end CHARACTERISTIC
/begin CHARACTERISTIC STATUS_ABSVMGUEL_ABO "X" VALUE 0x1D7CAC UBYTE_COL_DIRECT_S6_S3 0 void_int_S6_S3 0 255 /end CHARACTERISTIC
/begin CHARACTERISTIC SWI_5ZNSOLLEM_KON_ANS "Aktivierung Abfrage znsollem im Uebergang von Schliessen nach Uebergabe" VALUE 0x1D7D42 UBYTE_COL_DIRECT_S6_S3 0 void_int_e_S6_S3 0 1 /end CHARACTERISTIC
/begin CHARACTERISTIC SWI_ABBRUCH_AKTIV_ANS "Schalter Abbruch Schleppstart" VALUE 0x1D7D43 UBYTE_COL_DIRECT_S6_S3 0 void_int_e_S6_S3 0 1 /end CHARACTERISTIC
/begin CHARACTERISTIC SWI_ABBRUCH_AKTIV_NOS "SWI für die Aktivierung des Abbruch Ablauf Notstart" VALUE 0x1D7CEE UBYTE_COL_DIRECT_S6_S3 0 void_int_e_S6_S3 0 1 /end CHARACTERISTIC
/begin CHARACTERISTIC SWI_ABBRUCH_AKTIV_ZUS "SWI für die Aktivierung des Abbruch Ablauf Zustart" VALUE 0x1D8024 UBYTE_COL_DIRECT_S6_S3 0 void_int_e_S6_S3 0 1 /end CHARACTERISTIC
/begin CHARACTERISTIC SWI_VMABFANGEN_SRT_ZUS "Aktivierung des Zustands VM Abfangen beim VM Starten Variante VM Zustarten" VALUE 0x1D802D UBYTE_COL_DIRECT_S6_S3 0 void_int_e_S6_S3 0 1 /end CHARACTERISTIC
/begin CHARACTERISTIC TAB_MOMZIELK0BED_SYN_ZUS "Drehmomentoffset auf das K0 Zielmoment in Abhängigkeit des IAE Status als Übergangsbedingung nach K0-Schliessen im Zustand K0 Synchronisieren beim Zustart" VAL_BLK 0x1D5D54 FLOAT32_IEEE_COL_DIRECT_S6_S3 0 trq_fl_a_S6_S3 -1000 1000 MATRIX_DIM 9 1 1 /end CHARACTERISTIC
/begin CHARACTERISTIC Z_ABLAUF_ABBRUCH_ZUS "Anzeigen eines Abbruchs durch die HAS-Zustandssteuerung (OML) beim Zustart" VALUE 0x1D8041 UBYTE_COL_DIRECT_S6_S3 0 void_int_S6_S3 0 255 /end CHARACTERISTIC
/begin MEASUREMENT abstellpos_vm_in "Abstellposition VM vor nächstem ZOT" UBYTE void_int_S6_S3 1 100 0 180 ECU_ADDRESS 0xFFF86698 /end MEASUREMENT
/begin MEASUREMENT abstellpos_vm_status_in "Status Abstellposition VM" UBYTE void_int_S6_S3 1 100 0 2 ECU_ADDRESS 0xFFF86699 /end MEASUREMENT
/begin MEASUREMENT bErrorHybrid "" UBYTE void_int_S6_S3 1 100 0 15 ECU_ADDRESS 0xFFF86666 /end MEASUREMENT
/begin MEASUREMENT bExceptionHybrid "" UBYTE void_int_S6_S3 1 100 0 15 ECU_ADDRESS 0xFFF86667 /end MEASUREMENT
/begin MEASUREMENT c_getriebe_egs_in "" FLOAT32_IEEE c_int_S6_S3 1 100 -40 215 ECU_ADDRESS 0xFFF85DDC /end MEASUREMENT
/begin MEASUREMENT c_vm_in "" FLOAT32_IEEE c_int_S6_S3 1 100 -3.40282e+038 3.40282e+038 ECU_ADDRESS 0xFFF85E38 /end MEASUREMENT
/begin MEASUREMENT gangwechsel_egs_in "Flag während laufender Schaltung, bei synchron verlassen bis synchron erreicht" UBYTE void_int_S6_S3 1 100 0 1 ECU_ADDRESS 0xFFF86677 /end MEASUREMENT
/begin MEASUREMENT i_istgang_egs "" FLOAT32_IEEE void_fl_S6_S3 1 100 0 8 ECU_ADDRESS 0xFFF85D8C /end MEASUREMENT
/begin MEASUREMENT i_zielgang_egs "" FLOAT32_IEEE void_fl_S6_S3 1 100 0 8 ECU_ADDRESS 0xFFF85D90 /end MEASUREMENT
/begin MEASUREMENT istgang_egs_in "" SBYTE void_int_S6_S3 1 100 -128 127 ECU_ADDRESS 0xFFF86678 /end MEASUREMENT
/begin MEASUREMENT k_mstoerk0em_zus "Faktor zur Modifikation des K0-Störmoments zur Bestimmung des EM-Vorsteuermoments beim Zustart" FLOAT32_IEEE void_fl_S6_S3 1 100 0 2 ECU_ADDRESS 0xFFF85B50 /end MEASUREMENT
/begin MEASUREMENT m_em_in "" FLOAT32_IEEE trq_fl_a_S6_S3 1 100 -1024 1024 ECU_ADDRESS 0xFFF85DE0 /end MEASUREMENT
/begin MEASUREMENT m_iae_in "" FLOAT32_IEEE trq_fl_a_S6_S3 1 100 -32768 32767 ECU_ADDRESS 0xFFF85DE4 /end MEASUREMENT
/begin MEASUREMENT m_k0_in "" FLOAT32_IEEE trq_fl_a_S6_S3 1 100 -32768 32767 ECU_ADDRESS 0xFFF85DE8 /end MEASUREMENT
/begin MEASUREMENT m_k0_mber_has_sbe "K0-Moment der HAS zur Motormomentbegrenzung in der SAB" FLOAT32_IEEE trq_fl_a_S6_S3 1 100 -3.40282e+038 3.40282e+038 ECU_ADDRESS 0xFFF85DC4 /end MEASUREMENT
/begin MEASUREMENT m_k0_mod_has_fkt "" FLOAT32_IEEE trq_fl_a_S6_S3 1 100 -1200 1200 ECU_ADDRESS 0xFFF85D4C /end MEASUREMENT
/begin MEASUREMENT m_max_dyn_em_in "" FLOAT32_IEEE trq_fl_a_S6_S3 1 100 -32768 32767 ECU_ADDRESS 0xFFF85DEC /end MEASUREMENT
/begin MEASUREMENT m_max_em_has_fkt "" FLOAT32_IEEE trq_fl_a_S6_S3 1 100 -1200 1200 ECU_ADDRESS 0xFFF85D50 /end MEASUREMENT
/begin MEASUREMENT m_max_iae_has_fkt "" FLOAT32_IEEE trq_fl_a_S6_S3 1 100 -1200 1200 ECU_ADDRESS 0xFFF85D54 /end MEASUREMENT
/begin MEASUREMENT m_min_dyn_em_in "" FLOAT32_IEEE trq_fl_a_S6_S3 1 100 -3.40282e+038 3.40282e+038 ECU_ADDRESS 0xFFF85DF0 /end MEASUREMENT
/begin MEASUREMENT m_min_em_has_fkt "" FLOAT32_IEEE trq_fl_a_S6_S3 1 100 -1200 1200 ECU_ADDRESS 0xFFF85D58 /end MEASUREMENT
/begin MEASUREMENT m_min_vm_in "" FLOAT32_IEEE trq_fl_a_S6_S3 1 100 -3.40282e+038 3.40282e+038 ECU_ADDRESS 0xFFF85E3C /end MEASUREMENT
/begin MEASUREMENT m_mot_in "" FLOAT32_IEEE trq_fl_a_S6_S3 1 100 -1024 1024 ECU_ADDRESS 0xFFF85DF4 /end MEASUREMENT
/begin MEASUREMENT m_motmax_has "" FLOAT32_IEEE trq_fl_a_S6_S3 1 100 -1200 1200 ECU_ADDRESS 0xFFF85DC8 /end MEASUREMENT
/begin MEASUREMENT m_soll_em_has_fkt "" FLOAT32_IEEE trq_fl_a_S6_S3 1 100 -1200 1200 ECU_ADDRESS 0xFFF85D5C /end MEASUREMENT
/begin MEASUREMENT m_soll_em_hst_in "" FLOAT32_IEEE trq_fl_a_S6_S3 1 100 -32768 32767 ECU_ADDRESS 0xFFF85DF8 /end MEASUREMENT
/begin MEASUREMENT m_soll_k0_has_fkt "" FLOAT32_IEEE trq_fl_a_S6_S3 1 100 -1200 1200 ECU_ADDRESS 0xFFF85D60 /end MEASUREMENT
/begin MEASUREMENT m_soll_res_em_bas_sbe "" FLOAT32_IEEE trq_fl_a_S6_S3 1 100 -3.40282e+038 3.40282e+038 ECU_ADDRESS 0xFFF85DCC /end MEASUREMENT
/begin MEASUREMENT m_soll_res_em_has_fkt "" FLOAT32_IEEE trq_fl_a_S6_S3 1 100 -1200 1200 ECU_ADDRESS 0xFFF85D64 /end MEASUREMENT
/begin MEASUREMENT m_soll_res_em_has_sbe "" FLOAT32_IEEE trq_fl_a_S6_S3 1 100 -3.40282e+038 3.40282e+038 ECU_ADDRESS 0xFFF85DD0 /end MEASUREMENT
/begin MEASUREMENT m_soll_vm_has_fkt "" FLOAT32_IEEE trq_fl_a_S6_S3 1 100 -1200 1200 ECU_ADDRESS 0xFFF85D68 /end MEASUREMENT
/begin MEASUREMENT m_soll_vm_hst_in "" FLOAT32_IEEE trq_fl_a_S6_S3 1 100 -32768 32767 ECU_ADDRESS 0xFFF85DFC /end MEASUREMENT
/begin MEASUREMENT m_soll_vm_l_has_fkt "" FLOAT32_IEEE trq_fl_a_S6_S3 1 100 -1200 1200 ECU_ADDRESS 0xFFF85D6C /end MEASUREMENT
/begin MEASUREMENT m_soll_vm_l_hst_in "" FLOAT32_IEEE trq_fl_a_S6_S3 1 100 -3.40282e+038 3.40282e+038 ECU_ADDRESS 0xFFF85E40 /end MEASUREMENT
/begin MEASUREMENT m_stoer_k0_em "Gem. in Output_alt" FLOAT32_IEEE trq_fl_a_S6_S3 1 100 -3.40282e+038 3.40282e+038 ECU_ADDRESS 0xFFF969E0 /end MEASUREMENT
/begin MEASUREMENT m_stoer_k0_em_fil "Gefiltertes Stoermoment der K0 im Schleppstart" FLOAT32_IEEE trq_fl_a_S6_S3 1 100 -3.40282e+038 3.40282e+038 ECU_ADDRESS 0xFFF969E4 /end MEASUREMENT
/begin MEASUREMENT m_stoer_k0_em_fil_abo "Gefiltertes Stoermoment der K0 im Schleppstart" FLOAT32_IEEE trq_fl_a_S6_S3 1 100 -3.40282e+038 3.40282e+038 ECU_ADDRESS 0xFFF965E4 /end MEASUREMENT
/begin MEASUREMENT m_stoerk0em_fil_zus "Gefiltertes K0-Störmoment zur Bestimmung des EM-Vorsteuermoments beim Zustart" FLOAT32_IEEE trq_fl_a_S6_S3 1 100 -1000 1000 ECU_ADDRESS 0xFFF85B5C /end MEASUREMENT
/begin MEASUREMENT m_stoerk0em_zus "Ungefiltertes K0-Störmoments zur Bestimmung des EM-Vorsteuermoments beim Zustart" FLOAT32_IEEE trq_fl_a_S6_S3 1 100 -1000 1000 ECU_ADDRESS 0xFFF85B60 /end MEASUREMENT
/begin MEASUREMENT m_vm_in "" FLOAT32_IEEE trq_fl_a_S6_S3 1 100 -1024 1023.5 ECU_ADDRESS 0xFFF85E00 /end MEASUREMENT
/begin MEASUREMENT m_vm_start_in "" FLOAT32_IEEE trq_fl_a_S6_S3 1 100 -1024 1023.5 ECU_ADDRESS 0xFFF85E04 /end MEASUREMENT
/begin MEASUREMENT m_wunsch_fpw_hst_fil "" FLOAT32_IEEE trqg_fl_c_S6_S3 1 100 -2000 2000 ECU_ADDRESS 0xFFF85D94 /end MEASUREMENT
/begin MEASUREMENT m_wunsch_fpw_hst_in "" FLOAT32_IEEE trq_fl_a_S6_S3 1 100 -3.40282e+038 3.40282e+038 ECU_ADDRESS 0xFFF85E44 /end MEASUREMENT
/begin MEASUREMENT m_wunsch_fpw_in "" FLOAT32_IEEE trq_fl_a_S6_S3 1 100 -32768 32767 ECU_ADDRESS 0xFFF85E08 /end MEASUREMENT
/begin MEASUREMENT m_ziel_k0_has_zus "Zielmoment der Trennkupplung K0 beim Zustart" FLOAT32_IEEE trq_fl_a_S6_S3 1 100 -1000 1000 ECU_ADDRESS 0xFFF85B64 /end MEASUREMENT
/begin MEASUREMENT m_ziel_vm_has_ans "Zielmoment des VM beim Schleppstart" FLOAT32_IEEE trq_fl_a_S6_S3 1 100 -3.40282e+038 3.40282e+038 ECU_ADDRESS 0xFFF969E8 /end MEASUREMENT
/begin MEASUREMENT m_ziel_vm_has_zus "Zielmoment des VM bei Zustart" FLOAT32_IEEE trq_fl_a_S6_S3 1 100 -3.40282e+038 3.40282e+038 ECU_ADDRESS 0xFFF96C58 /end MEASUREMENT
/begin MEASUREMENT mg_max_em_has_fkt "" FLOAT32_IEEE trqg_fl_c_S6_S3 1 100 -3000 3000 ECU_ADDRESS 0xFFF85D70 /end MEASUREMENT
/begin MEASUREMENT mg_min_em_has_fkt "" FLOAT32_IEEE trqg_fl_c_S6_S3 1 100 -3000 3000 ECU_ADDRESS 0xFFF85D74 /end MEASUREMENT
/begin MEASUREMENT mg_soll_k0_has_fkt "" FLOAT32_IEEE trqg_fl_c_S6_S3 1 100 -3000 3000 ECU_ADDRESS 0xFFF85D7C /end MEASUREMENT
/begin MEASUREMENT mg_wunsch_fpw "" FLOAT32_IEEE trqg_fl_c_S6_S3 1 100 -2000 2000 ECU_ADDRESS 0xFFF85D98 /end MEASUREMENT
/begin MEASUREMENT mg_wunsch_fpw_hst "" FLOAT32_IEEE trqg_fl_c_S6_S3 1 100 -2000 2000 ECU_ADDRESS 0xFFF85D9C /end MEASUREMENT
/begin MEASUREMENT msollresem_stat_abo_mes "Gem. in Input nach Getr. Subsystem" FLOAT32_IEEE trq_fl_a_S6_S3 1 100 -3.40282e+038 3.40282e+038 ECU_ADDRESS 0xFFF965E8 /end MEASUREMENT
/begin MEASUREMENT n_ab_egs_in "" FLOAT32_IEEE n_fl_S6_S3 1 100 0 65535 ECU_ADDRESS 0xFFF85E0C /end MEASUREMENT
/begin MEASUREMENT n_em_in "" FLOAT32_IEEE n_fl_S6_S3 1 100 -3.40282e+038 3.40282e+038 ECU_ADDRESS 0xFFF85E10 /end MEASUREMENT
/begin MEASUREMENT n_min_em_has_sbe "Minimale EM Drehzahl der Leerlaufsimulation der HAS (LLS)" FLOAT32_IEEE n_fl_S6_S3 1 100 -32767 32767 ECU_ADDRESS 0xFFF85DD4 /end MEASUREMENT
/begin MEASUREMENT n_min_psys_em_has_sbe "Minimale EM Drehzahl zur Sicherstellung Ölversorgung" FLOAT32_IEEE n_fl_S6_S3 1 100 -32767 32767 ECU_ADDRESS 0xFFF85DA0 /end MEASUREMENT
/begin MEASUREMENT n_mot_soll_iae_in "" FLOAT32_IEEE n_fl_S6_S3 1 100 -3.40282e+038 3.40282e+038 ECU_ADDRESS 0xFFF85E14 /end MEASUREMENT
/begin MEASUREMENT n_sec_iae "" FLOAT32_IEEE n_fl_S6_S3 1 100 -10000 10000 ECU_ADDRESS 0xFFF85DA4 /end MEASUREMENT
/begin MEASUREMENT n_sec_iae_ist_zus "Abtriebsseitige IAE-Drehzahl bezogen auf den Getriebeeeingang und den aktuellen  Istgang während einer Schaltung beim Zustart" FLOAT32_IEEE n_fl_S6_S3 1 100 0 10000 ECU_ADDRESS 0xFFF96C6C /end MEASUREMENT
/begin MEASUREMENT n_sec_iae_ziel_zus "Abtriebsseitige IAE Zieldrehzahl bezogen auf den Getriebeeingang während einer Schaltung beim Zustart" FLOAT32_IEEE n_fl_S6_S3 1 100 -3.40282e+038 3.40282e+038 ECU_ADDRESS 0xFFF96C70 /end MEASUREMENT
/begin MEASUREMENT n_soll_em_has_fkt "" FLOAT32_IEEE n_fl_S6_S3 1 100 0 8000 ECU_ADDRESS 0xFFF85D80 /end MEASUREMENT
/begin MEASUREMENT n_soll_em_hst_in "" FLOAT32_IEEE n_fl_S6_S3 1 100 -3.40282e+038 3.40282e+038 ECU_ADDRESS 0xFFF85E48 /end MEASUREMENT
/begin MEASUREMENT n_soll_ll_vm_in "" FLOAT32_IEEE n_fl_S6_S3 1 100 0 2540 ECU_ADDRESS 0xFFF85E18 /end MEASUREMENT
/begin MEASUREMENT n_soll_vm_has_fkt "" FLOAT32_IEEE n_fl_S6_S3 1 100 0 8000 ECU_ADDRESS 0xFFF85D84 /end MEASUREMENT
/begin MEASUREMENT n_t_egs_in "" FLOAT32_IEEE n_fl_S6_S3 1 100 0 65535 ECU_ADDRESS 0xFFF85E1C /end MEASUREMENT
/begin MEASUREMENT n_vm_in "" FLOAT32_IEEE n_fl_S6_S3 1 100 0 65535 ECU_ADDRESS 0xFFF85E20 /end MEASUREMENT
/begin MEASUREMENT nd_iae "" FLOAT32_IEEE n_fl_S6_S3 1 100 -10000 10000 ECU_ADDRESS 0xFFF85DA8 /end MEASUREMENT
/begin MEASUREMENT nd_k0_in "" FLOAT32_IEEE n_fl_S6_S3 1 100 -10000 10000 ECU_ADDRESS 0xFFF85DAC /end MEASUREMENT
/begin MEASUREMENT ndg_k0_in "" FLOAT32_IEEE ng_fl_S6_S3 1 100 -10000 10000 ECU_ADDRESS 0xFFF85DB0 /end MEASUREMENT
/begin MEASUREMENT ng_vm "" FLOAT32_IEEE ng_fl_S6_S3 1 100 -10000 10000 ECU_ADDRESS 0xFFF85DB4 /end MEASUREMENT
/begin MEASUREMENT osmode_next_in "" UBYTE void_int_S6_S3 1 100 1 3 ECU_ADDRESS 0xFFF86679 /end MEASUREMENT
/begin MEASUREMENT p_bremse_fzg_in "" FLOAT32_IEEE p_fl_S6_S3 1 100 -32000 0 ECU_ADDRESS 0xFFF85E24 /end MEASUREMENT
/begin MEASUREMENT phi_neigung_in "Fahrzeug-Neigungswinkel" FLOAT32_IEEE void_fl_S6_S3 1 100 -3.40282e+038 3.40282e+038 ECU_ADDRESS 0xFFF85E28 /end MEASUREMENT
/begin MEASUREMENT pos_egs_in "Waehlhebelposition" UBYTE E_POS_S6_S3 1 100 0 8 ECU_ADDRESS 0xFFF8667A /end MEASUREMENT
/begin MEASUREMENT sollgang_egs_in "" SBYTE void_int_S6_S3 1 100 -128 127 ECU_ADDRESS 0xFFF8667B /end MEASUREMENT
/begin MEASUREMENT st_OMLID_act_stg "Innere Zustände der OML" UWORD void_int_b_S6_S3 1 100 0 4999 ECU_ADDRESS 0xFFF860CA /end MEASUREMENT
/begin MEASUREMENT st_ablauf_fkt "Phase des Ablauf" UWORD void_int_b_S6_S3 1 100 0 65535 ECU_ADDRESS 0xFFF860CC /end MEASUREMENT
/begin MEASUREMENT st_ist_bz_has_stg "Istzustand OML" UBYTE E_STBZHAS_S6_S3 1 100 0 15 ECU_ADDRESS 0xFFF86635 /end MEASUREMENT
/begin MEASUREMENT st_ist_bz_hst_sta "Ist-Betriebszustand aus der Startegieanpassung als Eingangsgroesse der Hybridzustandssteuerung (OML)" UBYTE E_STBZHAS_S6_S3 1 100 0 15 ECU_ADDRESS 0xFFF86668 /end MEASUREMENT
/begin MEASUREMENT st_soll_bz_has_hst "interner HST Soll-Betriebszustand der Strategieanpassung (variantenunabhaengig)" UBYTE void_int_S6_S3 1 100 0 1 ECU_ADDRESS 0xFFF8669A /end MEASUREMENT
/begin MEASUREMENT st_soll_bz_hst_sta "Soll-Betriebszustand aus der Startegieanpassung als Eingangsgroesse der Hybridzustandssteuerung (OML)" UBYTE E_STBZHAS_S6_S3 1 100 0 15 ECU_ADDRESS 0xFFF86669 /end MEASUREMENT
/begin MEASUREMENT st_ziel_bz_has_stg "Zielzustand OML" UBYTE E_STBZHAS_S6_S3 1 100 0 15 ECU_ADDRESS 0xFFF86636 /end MEASUREMENT
/begin MEASUREMENT status_ablauf_has_fkt "" UBYTE void_int_S6_S3 1 100 0 50 ECU_ADDRESS 0xFFF8663B /end MEASUREMENT
/begin MEASUREMENT status_alaengs_adaoff_in "Information, ob die Adaptionen aufgrund erkannter Laengsbeschleunigung deaktiviert wird. 0 = Adaption aktiv aufgrund erkannter Laengsbeschleunigung
1 = Adaption inaktiv aufgrund nicht erkannter Laengsbeschleunigung" UBYTE void_int_S6_S3 1 100 0 1 ECU_ADDRESS 0xFFF8667C /end MEASUREMENT
/begin MEASUREMENT status_betriebsbereit_hst_in "" UBYTE void_int_S6_S3 1 100 0 1 ECU_ADDRESS 0xFFF8669B /end MEASUREMENT
/begin MEASUREMENT status_efahren_has_sbe "Status E-Fahren der HAS zur Festlegung der entsprechenden Portout-Größe in der HAS Signalaufbereitung_Out" UBYTE void_int_S6_S3 1 100 0 1 ECU_ADDRESS 0xFFF8665A /end MEASUREMENT
/begin MEASUREMENT status_fehler15_eh_diagin "Info vom Errorhandler ob Ersatzfkt. aktiv" UBYTE void_int_S6_S3 1 100 0 1 ECU_ADDRESS 0xFFF8662E /end MEASUREMENT
/begin MEASUREMENT status_fehler_iep_in "" UBYTE E_FEHLERIEP_S6_S3 1 100 0 1 ECU_ADDRESS 0xFFF8667D /end MEASUREMENT
/begin MEASUREMENT status_iae_adap_in "Status der Adaption des Integrierten Anfahrelements IAE" UBYTE E_STATUSADA_S6_S3 1 100 0 2 ECU_ADDRESS 0xFFF8667E /end MEASUREMENT
/begin MEASUREMENT status_iae_in "" UBYTE E_STATUSIAE_S6_S3 1 100 0 8 ECU_ADDRESS 0xFFF8667F /end MEASUREMENT
/begin MEASUREMENT status_iep_in "" UBYTE E_STATUSIEP_S6_S3 1 100 0 4 ECU_ADDRESS 0xFFF86680 /end MEASUREMENT
/begin MEASUREMENT status_k0_adap_in "" UBYTE E_STATUSADA_S6_S3 1 100 0 2 ECU_ADDRESS 0xFFF86681 /end MEASUREMENT
/begin MEASUREMENT status_k0_in "" UBYTE E_STATUSK0_S6_S3 1 100 0 5 ECU_ADDRESS 0xFFF86682 /end MEASUREMENT
/begin MEASUREMENT status_kl15_in "" UBYTE void_int_S6_S3 1 100 0 1 ECU_ADDRESS 0xFFF8669C /end MEASUREMENT
/begin MEASUREMENT status_kolbenpos_k0_in "" UBYTE void_int_S6_S3 1 100 0 255 ECU_ADDRESS 0xFFF86683 /end MEASUREMENT
/begin MEASUREMENT status_kraftfluss_egs_in "" UBYTE E_STATUSKSL_S6_S3 1 100 0 6 ECU_ADDRESS 0xFFF86684 /end MEASUREMENT
/begin MEASUREMENT status_kraftfluss_egs_roh_in "" UBYTE void_int_S6_S3 1 100 0 255 ECU_ADDRESS 0xFFF86685 /end MEASUREMENT
/begin MEASUREMENT status_ll_vm_in "" UBYTE void_int_S6_S3 1 100 0 255 ECU_ADDRESS 0xFFF86686 /end MEASUREMENT
/begin MEASUREMENT status_nem_in "Status zur Drehzahl E-Motor" UBYTE E_SIGSTATUS_S6_S3 1 100 0 2 ECU_ADDRESS 0xFFF86687 /end MEASUREMENT
/begin MEASUREMENT status_nreg_em_hst_in "Status E-Motor Drehzahlregelung der HST" UBYTE void_int_S6_S3 1 100 0 255 ECU_ADDRESS 0xFFF8669D /end MEASUREMENT
/begin MEASUREMENT status_nvm_in "Status zur Drehzahl VM-Motor" UBYTE E_SIGSTATUS_S6_S3 1 100 0 2 ECU_ADDRESS 0xFFF86688 /end MEASUREMENT
/begin MEASUREMENT status_posvueb_in "Erkennung PosV Diagnose" UBYTE void_int_S6_S3 1 100 0 255 ECU_ADDRESS 0xFFF86689 /end MEASUREMENT
/begin MEASUREMENT status_psys_has_sbe "" UBYTE E_STATUSPSY_S6_S3 1 100 0 4 ECU_ADDRESS 0xFFF86654 /end MEASUREMENT
/begin MEASUREMENT status_sa_vm_in "00 Keine Beeinflussung; 01 Schubabschaltung aktiv; 10 Nicht stellbarer Bereich; 11 Signal ungültig" UBYTE void_int_S6_S3 1 100 0 3 ECU_ADDRESS 0xFFF8669E /end MEASUREMENT
/begin MEASUREMENT status_schaltart_svh_has_sbe "Schaltart der angeforderten Schaltung der Schaltverhinderung der HAS (0 = keine Schaltung angefordert) - Bit-Codierung (m/oL=mit/ohne Lanstanh.)=: bit0=ZRSmL,1=ZHSmL,2=SRSmL,3=SHSmL,4=ZRSoL,5=ZHSoL,6=SRSoL,7=SHSoL" UBYTE void_int_S6_S3 1 100 0 255 ECU_ADDRESS 0xFFF8665B /end MEASUREMENT
/begin MEASUREMENT status_schaltung_egs_in "" SBYTE void_int_S6_S3 1 100 -9 9 ECU_ADDRESS 0xFFF86655 /end MEASUREMENT
/begin MEASUREMENT status_sync_schaltung_sbe "Anzeige der Synchronerkennung der aktuellen Schaltung innerhalb der HAS" UBYTE void_int_S6_S3 1 100 0 1 ECU_ADDRESS 0xFFF86656 /end MEASUREMENT
/begin MEASUREMENT status_waschstr_in "" UBYTE void_int_S6_S3 1 100 0 255 ECU_ADDRESS 0xFFF8668A /end MEASUREMENT
/begin MEASUREMENT status_zug_svh_sbe "Status für Anzeige Zug/Schub" UBYTE void_int_S6_S3 1 100 0 1 ECU_ADDRESS 0xFFF8665C /end MEASUREMENT
/begin MEASUREMENT t_betrieb_pvu_has_ee_in "" ULONG t_int_S6_S3 1 100 0 10000 ECU_ADDRESS 0xFFF85E2C /end MEASUREMENT
/begin MEASUREMENT t_betrieb_pvu_has_sbe "Betriebsdauer seit dem letzten Ablauf der Diagnosefunktion \"Positionsventil-Überwachung\" der Funktion zur Unterstüt-zung der Positionsventil-Überwachung der HAS" FLOAT32_IEEE t_fl_S6_S3 1 100 0 1000000 ECU_ADDRESS 0xFFF85DB8 /end MEASUREMENT
/begin MEASUREMENT t_emaktiv_fuw_zus "Timer zur Funktionsüberwachung der EM-Funktion beim Zustart" FLOAT32_IEEE t_fl_S6_S3 1 100 0 1000 ECU_ADDRESS 0xFFF85B84 /end MEASUREMENT
/begin MEASUREMENT v_f_sbe "Fahrzeuggeschwindigkeit auf Basis der Getriebeabtriebsdrehzahl in der  Hybridablaufsteuerung" FLOAT32_IEEE v_fl_S6_S3 1 100 -3.40282e+038 3.40282e+038 ECU_ADDRESS 0xFFF85DBC /end MEASUREMENT
/begin MEASUREMENT vg_f_sbe "Fahrzeuggeschwindigkeitsgradient auf Basis der Getriebeabtriebsdrehzahl in der  Hybridablaufsteuerung" FLOAT32_IEEE vg_fl_S6_S3 1 100 -3.40282e+038 3.40282e+038 ECU_ADDRESS 0xFFF85DC0 /end MEASUREMENT
/begin MEASUREMENT z_ablauf_has_hst_in "" UBYTE void_int_S6_S3 1 100 0 15 ECU_ADDRESS 0xFFF8668B /end MEASUREMENT
/begin MEASUREMENT z_ablauf_has_stg "Zusaetzliche Steuergroesse zur Ablaufsteuerung" UBYTE void_int_S6_S3 1 100 0 15 ECU_ADDRESS 0xFFF86637 /end MEASUREMENT
/begin MEASUREMENT z_ablauf_svh_reset_has_fkt "" UBYTE void_int_S6_S3 1 100 0 255 ECU_ADDRESS 0xFFF8663D /end MEASUREMENT
/begin MEASUREMENT z_ablaufreinit_frk_dihi "Zeigt an, dass der aktuelle HAS-Ablauf erneut begonnen werden soll" UBYTE void_int_S6_S3 1 100 0 1 ECU_ADDRESS 0xFFF8662F /end MEASUREMENT
/begin MEASUREMENT z_ablaufvariante_has_hst_in "" UBYTE void_int_S6_S3 1 100 0 15 ECU_ADDRESS 0xFFF8668C /end MEASUREMENT
/begin MEASUREMENT z_ablaufvariante_has_stg "Ablaufvariante, die  die OML ausgibt" UBYTE void_int_S6_S3 1 100 0 99 ECU_ADDRESS 0xFFF86638 /end MEASUREMENT
/begin MEASUREMENT z_ablaufvariante_kalt_zus "Anzeige der aktiven Ablaufvariante Kaltstart beim Zustart - 0 = kein Kaltstart, 1 = Kaltstart mit abgesenkter EM-Drehzahl" UBYTE void_int_S6_S3 1 100 0 255 ECU_ADDRESS 0xFFF8663E /end MEASUREMENT
/begin MEASUREMENT z_ba_has_k0_hst_in "" UBYTE void_int_S6_S3 1 100 0 1 ECU_ADDRESS 0xFFF8669F /end MEASUREMENT
/begin MEASUREMENT z_ba_has_vm_hst_in "" UBYTE void_int_S6_S3 1 100 0 1 ECU_ADDRESS 0xFFF866A0 /end MEASUREMENT
/begin MEASUREMENT z_diag_ersfkt_has_in "Funktionsschnittstelle zur Ermittlung ob irgendeine Ersatzmaßnahme in der Diagnoseverwaltung aktiv ist" ULONG b_int_S6_S3 1 100 0 4294967295 ECU_ADDRESS 0xFFF85E30 /end MEASUREMENT
/begin MEASUREMENT z_diag_ersfkt_hi_has_in "Funktionsschnittstelle zur Ermittlung ob irgendeine Ersatzmaßnahme in der Diagnoseverwaltung aktiv ist" ULONG b_int_S6_S3 1 100 0 4294967295 ECU_ADDRESS 0xFFF85E34 /end MEASUREMENT
/begin MEASUREMENT z_diag_notgang_has_in "Notganginformation" UBYTE void_int_S6_S3 1 100 0 255 ECU_ADDRESS 0xFFF8668D /end MEASUREMENT
/begin MEASUREMENT z_emaktiv_fuw_zus_fkt "Anzeige der EM Fehlfuntion der Funktionsüberwachung der EM beim Zustart" UBYTE void_int_S6_S3 1 100 0 1 ECU_ADDRESS 0xFFF8663F /end MEASUREMENT
/begin MEASUREMENT z_emaktiv_nemfehler_fuw_zus "Anzeige des Ablaufs bei  fehlerhafter EM-Drehzahl der Funktionsüberwachung der EM-Funktion beim Zustart " UBYTE void_int_S6_S3 1 100 0 1 ECU_ADDRESS 0xFFF86583 /end MEASUREMENT
/begin MEASUREMENT z_emfehler_frk_dihi "Zeigt an, dass eine EM Fehlfunktion erkannt wurde, die in der HAS ausgewertet werden soll" UBYTE void_int_S6_S3 1 100 0 1 ECU_ADDRESS 0xFFF86630 /end MEASUREMENT
/begin MEASUREMENT z_fehler15_eh_fkt "" UBYTE void_int_S6_S3 1 100 0 1 ECU_ADDRESS 0xFFF86640 /end MEASUREMENT
/begin MEASUREMENT z_freigabe_pvu_has_sbe "Freigabe zur Aktivierung der Diagnosefunktion \"Positionsventil-Überwachung\" der Funktion zur Unterstützung der Positi-onsventil-Überwachung der HAS" UBYTE void_int_S6_S3 1 100 0 1 ECU_ADDRESS 0xFFF86657 /end MEASUREMENT
/begin MEASUREMENT z_fuwdeakt_frk_dihi "Zeigt an, dass die FUW-Funktion nicht aktiviert werden darf" UBYTE void_int_S6_S3 1 100 0 1 ECU_ADDRESS 0xFFF86631 /end MEASUREMENT
/begin MEASUREMENT z_hybfkt_stg "Anforderung der Aktivierung einer Hybridfunktion durch die Hyrid-Zustandssteuerung" UBYTE E_HYBFKT_S6_S3 1 100 0 15 ECU_ADDRESS 0xFFF86639 /end MEASUREMENT
/begin MEASUREMENT z_iae_entkoppelt_has "Gemessen in Zustart Out" UBYTE void_int_S6_S3 1 100 0 255 ECU_ADDRESS 0xFFF96DC7 /end MEASUREMENT
/begin MEASUREMENT z_iep_in "" UBYTE E_ZIEP_S6_S3 1 100 0 4 ECU_ADDRESS 0xFFF8668E /end MEASUREMENT
/begin MEASUREMENT z_init_sta "Anforderung der Initialisierung der Zustandssteuerung (OML) durch die Strategieanpassung" UBYTE void_int_S6_S3 1 100 0 15 ECU_ADDRESS 0xFFF8666A /end MEASUREMENT
/begin MEASUREMENT z_k0_befuellopt_has "Gemessen in Zustart/Output" UBYTE void_int_S6_S3 1 100 0 255 ECU_ADDRESS 0xFFF96DC9 /end MEASUREMENT
/begin MEASUREMENT z_k0_befuellopt_has_fkt "" UBYTE void_int_S6_S3 1 100 0 1 ECU_ADDRESS 0xFFF86642 /end MEASUREMENT
/begin MEASUREMENT z_k0_fst_in "" UBYTE E_ZK0FSTIN_S6_S3 1 100 0 3 ECU_ADDRESS 0xFFF8668F /end MEASUREMENT
/begin MEASUREMENT z_k0_has_fkt "" UBYTE E_ZK0_S6_S3 1 100 0 5 ECU_ADDRESS 0xFFF86643 /end MEASUREMENT
/begin MEASUREMENT z_k0_has_sbe "" UBYTE E_ZK0_S6_S3 1 100 0 5 ECU_ADDRESS 0xFFF8665D /end MEASUREMENT
/begin MEASUREMENT z_k0sregaktiv_zus "Anforderung der Aktivierung der K0 Schlupfregelung beim Zustart" UBYTE void_int_S6_S3 1 100 0 1 ECU_ADDRESS 0xFFF86584 /end MEASUREMENT
/begin MEASUREMENT z_k0sregbasis_zus "Anzeige der Basisbedingung für die Anforderung der Aktivierung der K0 Schlupfregelung beim Zustart" UBYTE void_int_S6_S3 1 100 0 1 ECU_ADDRESS 0xFFF86585 /end MEASUREMENT
/begin MEASUREMENT z_k0syncmk0erh_frk_dihi "Zeigt an, dass eine K0-Zwangsynchronisation mittels Erhöhung des K0-Moments erfolgen soll" UBYTE void_int_S6_S3 1 100 0 1 ECU_ADDRESS 0xFFF86632 /end MEASUREMENT
/begin MEASUREMENT z_kps_stada_in "Sollvorgabe für die Trennkupplung K0 durch die Stillstandsadaption" UBYTE void_int_S6_S3 1 100 0 255 ECU_ADDRESS 0xFFF86690 /end MEASUREMENT
/begin MEASUREMENT z_m_max_iae_has_fkt "" UBYTE void_int_S6_S3 1 100 0 50 ECU_ADDRESS 0xFFF86645 /end MEASUREMENT
/begin MEASUREMENT z_m_soll_em_has_fkt "" UBYTE void_int_S6_S3 1 100 0 50 ECU_ADDRESS 0xFFF86646 /end MEASUREMENT
/begin MEASUREMENT z_m_soll_vm_has_fkt "" UBYTE void_int_S6_S3 1 100 0 50 ECU_ADDRESS 0xFFF86647 /end MEASUREMENT
/begin MEASUREMENT z_modus_em_hst_in "" UBYTE void_int_S6_S3 1 100 0 255 ECU_ADDRESS 0xFFF86691 /end MEASUREMENT
/begin MEASUREMENT z_modus_iae_has_sbe "" UBYTE E_ZMODUSIAE_S6_S3 1 100 0 2 ECU_ADDRESS 0xFFF8665E /end MEASUREMENT
/begin MEASUREMENT z_modus_iep_has_sbe "Vorgabe des Betriebsmodus der IEP durch die HAS" UBYTE E_ZMODUSIEP_S6_S3 1 100 0 4 ECU_ADDRESS 0xFFF8665F /end MEASUREMENT
/begin MEASUREMENT z_msa_avh_moni_has_sbe "Anforderung einer Schaltverhinderung der HAS" UBYTE void_int_S6_S3 1 100 0 255 ECU_ADDRESS 0xFFF86660 /end MEASUREMENT
/begin MEASUREMENT z_msa_eaf_moni_has_sbe "Anforderung einer Schaltverhinderung der HAS" UBYTE void_int_S6_S3 1 100 0 255 ECU_ADDRESS 0xFFF86661 /end MEASUREMENT
/begin MEASUREMENT z_msa_fst_in "Anforderung einer Abschaltverhinderung durch die Fahrstrategie ASIS" UBYTE void_int_S6_S3 1 100 0 255 ECU_ADDRESS 0xFFF86692 /end MEASUREMENT
/begin MEASUREMENT z_msa_has_sbe "Anforderung der Beeinflussung der MSA-Funktionalität durch die Hybridablaufsteuerung - Codierung: bit0 = AVZ, bit1 = AVH, bit2 = EAF, bit3 = EVH, bit4 = Deaktivierung, bit7 = Störungsbedingt" UBYTE void_int_S6_S3 1 100 0 255 ECU_ADDRESS 0xFFF86662 /end MEASUREMENT
/begin MEASUREMENT z_msa_stada_in "" UBYTE void_int_S6_S3 1 100 0 6 ECU_ADDRESS 0xFFF866A1 /end MEASUREMENT
/begin MEASUREMENT z_n_min_em_parksp_has_in "Anforderung einer EM-Drehzahlanhebung beim Auslegen der Parksperre infolge unzureichender Ölversorgung" UBYTE void_int_S6_S3 1 100 0 1 ECU_ADDRESS 0xFFF86693 /end MEASUREMENT
/begin MEASUREMENT z_n_min_iep_in "Anforderung Ausgabe EM-Mindestdrehzahl zur Sicherstellung der Ölversorgung durch die IEP" UBYTE void_int_S6_S3 1 100 0 1 ECU_ADDRESS 0xFFF86694 /end MEASUREMENT
/begin MEASUREMENT z_n_soll_em_aktiv_ans_mes "Gemessen in SLST Input" UBYTE void_int_S6_S3 1 100 0 1 ECU_ADDRESS 0xFFF96DCB /end MEASUREMENT
/begin MEASUREMENT z_n_soll_em_has_fkt "" UBYTE void_int_S6_S3 1 100 0 50 ECU_ADDRESS 0xFFF86649 /end MEASUREMENT
/begin MEASUREMENT z_n_soll_vm_has_fkt "" UBYTE void_int_S6_S3 1 100 0 50 ECU_ADDRESS 0xFFF8664A /end MEASUREMENT
/begin MEASUREMENT z_nllsoll_iae_in "Anforderung der IAE, dass eine definierte LL-Drehzahl durch den Motor eingestellt werden soll" UBYTE E_ZNLLSOLL_S6_S3 1 100 0 2 ECU_ADDRESS 0xFFF86695 /end MEASUREMENT
/begin MEASUREMENT z_nminemnull_frk_dihi "Zeigt an, dass die Ausgabe der minimalen EM Drehzahl der HAS unterdrückt werden soll." UBYTE void_int_S6_S3 1 100 0 1 ECU_ADDRESS 0xFFF86633 /end MEASUREMENT
/begin MEASUREMENT z_nvmsollbegr_frk_dihi "Zeigt an, dass die VM-Solldrehzahl auf die EM-Istdrehzahl be-grenzt werden soll" UBYTE void_int_S6_S3 1 100 0 1 ECU_ADDRESS 0xFFF86634 /end MEASUREMENT
/begin MEASUREMENT z_p_hys_k0_has_fkt "Hysteresekompensation" UBYTE void_int_S6_S3 1 100 0 1 ECU_ADDRESS 0xFFF8664B /end MEASUREMENT
/begin MEASUREMENT z_ponr_fkt "point of no return" UBYTE void_int_S6_S3 1 100 0 1 ECU_ADDRESS 0xFFF8664C /end MEASUREMENT
/begin MEASUREMENT z_pvu_has_sbe "Beeinflussung des Hybridsystems zur Unterstützung der Positionsventil- Überwachung der HAS-Codierung: 0 = keine Beeinflussung, 1 = Beeinflussung Stufe 1, 2 = Beeinflussung Stufe 2" UBYTE void_int_S6_S3 1 100 0 2 ECU_ADDRESS 0xFFF86658 /end MEASUREMENT
/begin MEASUREMENT z_respschleschaltaktiv_ans "Gemessen in Schleppstart/Input" UBYTE void_int_S6_S3 1 100 0 255 ECU_ADDRESS 0xFFF96DCC /end MEASUREMENT
/begin MEASUREMENT z_saf_has "Gemessen in Zustart Out" UBYTE void_int_S6_S3 1 100 0 255 ECU_ADDRESS 0xFFF96DCD /end MEASUREMENT
/begin MEASUREMENT z_saf_has_fkt "Schaltanforderung 1...aktiv" UBYTE void_int_S6_S3 1 100 0 1 ECU_ADDRESS 0xFFF8664D /end MEASUREMENT
/begin MEASUREMENT z_sas_has_sbe "Ändert im Wahrheitsfall die KupplungsBefüllreihenfolge" UBYTE void_int_S6_S3 1 100 0 1 ECU_ADDRESS 0xFFF86663 /end MEASUREMENT
/begin MEASUREMENT z_sbe_has "Gemessen in Zustart Out" UBYTE void_int_S6_S3 1 100 0 255 ECU_ADDRESS 0xFFF96DCE /end MEASUREMENT
/begin MEASUREMENT z_start_modus_has_sbe "Anforderung eines Anlasserstarts" UBYTE void_int_S6_S3 1 100 0 255 ECU_ADDRESS 0xFFF86664 /end MEASUREMENT
/begin MEASUREMENT z_status_psys_mps_sbe "Flag, das eine Modifikation des Pumpendruckstatus anzeigt" UBYTE void_int_S6_S3 1 100 0 1 ECU_ADDRESS 0xFFF86659 /end MEASUREMENT
/begin MEASUREMENT z_svh_has_sbe "Anforderung einer Schaltverhinderung der HAS" UBYTE void_int_S6_S3 1 100 0 1 ECU_ADDRESS 0xFFF86665 /end MEASUREMENT
/begin MEASUREMENT z_svh_palaus_sak_zus "Anzeige der Schaltart der zum Rest des Zustart-Ablaufs parallel laufenden Schaltungen im Zustand Schaltung aktiv beim Zustart -> Bit-Codierung wie z_ablauf_shv_reset_has" UBYTE void_int_S6_S3 1 100 0 255 ECU_ADDRESS 0xFFF8658A /end MEASUREMENT
/begin MEASUREMENT z_svh_reset_zustand_zus "Anzeige der Schaltart der in den einzelnen Zuständen des Zustart-Ablaufs freigegebenen Schaltungen beim Zustart -> Bit-Codierung wie z_ablauf_shv_reset_has" UBYTE void_int_S6_S3 1 100 0 255 ECU_ADDRESS 0xFFF8658C /end MEASUREMENT
/begin MEASUREMENT z_t_k0syncerk_syn_zus "Bedingung Timer zur Initialisierung der VM Solldrehzahlberechnung beim K0 Synchronisieren beim Zustart" UBYTE void_int_S6_S3 1 100 0 255 ECU_ADDRESS 0xFFF96DE6 /end MEASUREMENT
/begin MEASUREMENT z_t_maxbed_abb_zus "Bedingung Timer zur Überwachung der maximalen Verweildauer im Zustand zustart_abbruch_zus im Zustart" UBYTE void_int_S6_S3 1 100 0 255 ECU_ADDRESS 0xFFF96DE8 /end MEASUREMENT
/begin MEASUREMENT z_t_maxbed_scl_zus "Bedingung Timer zur Überwachung der maximalen VErweildauer im Zustand Schaltung aktiv im Zustart" UBYTE void_int_S6_S3 1 100 0 255 ECU_ADDRESS 0xFFF96DEA /end MEASUREMENT
/begin MEASUREMENT z_tmin_fehler15_fkt "Status Timer für Verweilzeit in Fehler15" UBYTE void_int_S6_S3 1 100 0 255 ECU_ADDRESS 0xFFF86651 /end MEASUREMENT
/begin MEASUREMENT z_ziel_kraftfluss_egs_in "" UBYTE void_int_S6_S3 1 100 0 255 ECU_ADDRESS 0xFFF86696 /end MEASUREMENT
/begin MEASUREMENT z_zuendfreigabe_vm_fkt "" UBYTE void_int_S6_S3 1 100 0 1 ECU_ADDRESS 0xFFF86652 /end MEASUREMENT
/begin MEASUREMENT z_zuendfreigabe_vm_has_fkt "" UBYTE void_int_S6_S3 1 100 0 1 ECU_ADDRESS 0xFFF86653 /end MEASUREMENT
/begin MEASUREMENT zielgang_egs_in "" SBYTE void_int_S6_S3 1 100 -128 127 ECU_ADDRESS 0xFFF86697 /end MEASUREMENT
/begin FUNCTION Action_FOp_ABK "" /begin SUB_FUNCTION SFOp_ABK2_FOp_ABK /end SUB_FUNCTION
 /begin LOC_MEASUREMENT abstellpos_vm_in abstellpos_vm_status_in c_getriebe_egs_in c_vm_in gangwechsel_egs_in i_istgang_egs i_zielgang_egs istgang_egs_in m_em_in m_iae_in m_k0_in m_k0_mber_has_sbe m_k0_mod_has_fkt m_max_dyn_em_in m_min_dyn_em_in m_min_vm_in m_mot_in m_motmax_has m_soll_em_has_fkt m_soll_em_hst_in m_soll_k0_has_fkt m_soll_res_em_bas_sbe m_soll_res_em_has_sbe m_soll_vm_has_fkt m_soll_vm_hst_in m_soll_vm_l_hst_in m_vm_in m_vm_start_in m_wunsch_fpw_hst_fil m_wunsch_fpw_hst_in m_wunsch_fpw_in mg_wunsch_fpw mg_wunsch_fpw_hst n_ab_egs_in n_em_in n_min_em_has_sbe n_min_psys_em_has_sbe n_mot_soll_iae_in n_sec_iae n_soll_em_has_fkt n_soll_em_hst_in n_soll_ll_vm_in n_soll_vm_has_fkt n_t_egs_in n_vm_in nd_iae nd_k0_in ndg_k0_in ng_vm osmode_next_in p_bremse_fzg_in phi_neigung_in pos_egs_in sollgang_egs_in st_OMLID_act_stg st_ablauf_fkt st_ist_bz_has_stg st_soll_bz_has_hst st_ziel_bz_has_stg status_ablauf_has_fkt status_alaengs_adaoff_in status_betriebsbereit_hst_in status_efahren_has_sbe status_fehler15_eh_diagin status_fehler_iep_in status_iae_adap_in status_iae_in status_iep_in status_k0_adap_in status_k0_in status_kl15_in status_kolbenpos_k0_in status_kraftfluss_egs_in status_kraftfluss_egs_roh_in status_ll_vm_in status_nem_in status_nreg_em_hst_in status_nvm_in status_posvueb_in status_psys_has_sbe status_sa_vm_in status_schaltart_svh_has_sbe status_schaltung_egs_in status_sync_schaltung_sbe status_waschstr_in status_zug_svh_sbe t_betrieb_pvu_has_ee_in t_betrieb_pvu_has_sbe v_f_sbe vg_f_sbe z_ablauf_has_hst_in z_ablauf_has_stg z_ablauf_svh_reset_has_fkt z_ablaufreinit_frk_dihi z_ablaufvariante_has_hst_in z_ablaufvariante_has_stg z_ba_has_k0_hst_in z_ba_has_vm_hst_in z_diag_ersfkt_has_in z_diag_ersfkt_hi_has_in z_diag_notgang_has_in z_emfehler_frk_dihi z_freigabe_pvu_has_sbe z_fuwdeakt_frk_dihi z_hybfkt_stg z_iep_in z_k0_fst_in z_k0_has_fkt z_k0_has_sbe z_k0syncmk0erh_frk_dihi z_kps_stada_in z_m_soll_em_has_fkt z_m_soll_vm_has_fkt z_modus_em_hst_in z_modus_iae_has_sbe z_modus_iep_has_sbe z_msa_avh_moni_has_sbe z_msa_eaf_moni_has_sbe z_msa_fst_in z_msa_has_sbe z_msa_stada_in z_n_min_em_parksp_has_in z_n_min_iep_in z_n_soll_em_has_fkt z_n_soll_vm_has_fkt z_nllsoll_iae_in z_nminemnull_frk_dihi z_nvmsollbegr_frk_dihi z_p_hys_k0_has_fkt z_pvu_has_sbe z_sas_has_sbe z_start_modus_has_sbe z_status_psys_mps_sbe z_svh_has_sbe z_ziel_kraftfluss_egs_in z_zuendfreigabe_vm_has_fkt zielgang_egs_in /end LOC_MEASUREMENT
/end FUNCTION
/begin FUNCTION Action_FOp_ABO ""
 /begin SUB_FUNCTION SFOp_ABO10_St_Start SFOp_ABO9_St_Ablauf SFOp_ABO7_Output SFOp_ABO5_Input /end SUB_FUNCTION
 /begin DEF_CHARACTERISTIC ABSTELLPOS_OS_ERK_ABO ABSTELLPOS_US_ERK_ABO MS_K0OEFFNEN_KOE_ABO STATUS_ABSVMGUEL_ABO /end DEF_CHARACTERISTIC
 /begin LOC_MEASUREMENT abstellpos_vm_in abstellpos_vm_status_in c_getriebe_egs_in c_vm_in gangwechsel_egs_in i_istgang_egs i_zielgang_egs istgang_egs_in m_em_in m_iae_in m_k0_in m_k0_mber_has_sbe m_k0_mod_has_fkt m_max_dyn_em_in m_min_dyn_em_in m_min_vm_in m_mot_in m_motmax_has m_soll_em_has_fkt m_soll_em_hst_in m_soll_k0_has_fkt m_soll_res_em_bas_sbe m_soll_res_em_has_fkt m_soll_res_em_has_sbe m_soll_vm_hst_in m_soll_vm_l_hst_in m_stoer_k0_em_fil_abo m_vm_in m_vm_start_in m_wunsch_fpw_hst_fil m_wunsch_fpw_hst_in m_wunsch_fpw_in mg_soll_k0_has_fkt mg_wunsch_fpw mg_wunsch_fpw_hst msollresem_stat_abo_mes n_ab_egs_in n_em_in n_min_em_has_sbe n_min_psys_em_has_sbe n_mot_soll_iae_in n_sec_iae n_soll_em_hst_in n_soll_ll_vm_in n_t_egs_in n_vm_in nd_iae nd_k0_in ndg_k0_in ng_vm osmode_next_in p_bremse_fzg_in phi_neigung_in pos_egs_in sollgang_egs_in st_OMLID_act_stg st_ablauf_fkt st_ist_bz_has_stg st_soll_bz_has_hst st_ziel_bz_has_stg status_ablauf_has_fkt status_alaengs_adaoff_in status_betriebsbereit_hst_in status_efahren_has_sbe status_fehler15_eh_diagin status_fehler_iep_in status_iae_adap_in status_iae_in status_iep_in status_k0_adap_in status_k0_in status_kl15_in status_kolbenpos_k0_in status_kraftfluss_egs_in status_kraftfluss_egs_roh_in status_ll_vm_in status_nem_in status_nreg_em_hst_in status_nvm_in status_posvueb_in status_psys_has_sbe status_sa_vm_in status_schaltart_svh_has_sbe status_schaltung_egs_in status_sync_schaltung_sbe status_waschstr_in status_zug_svh_sbe t_betrieb_pvu_has_ee_in t_betrieb_pvu_has_sbe v_f_sbe vg_f_sbe z_ablauf_has_hst_in z_ablauf_has_stg z_ablaufreinit_frk_dihi z_ablaufvariante_has_hst_in z_ablaufvariante_has_stg z_ba_has_k0_hst_in z_ba_has_vm_hst_in z_diag_ersfkt_has_in z_diag_ersfkt_hi_has_in z_diag_notgang_has_in z_emfehler_frk_dihi z_freigabe_pvu_has_sbe z_fuwdeakt_frk_dihi z_hybfkt_stg z_iep_in z_k0_befuellopt_has_fkt z_k0_fst_in z_k0_has_fkt z_k0_has_sbe z_k0syncmk0erh_frk_dihi z_kps_stada_in z_m_soll_em_has_fkt z_modus_em_hst_in z_modus_iae_has_sbe z_modus_iep_has_sbe z_msa_avh_moni_has_sbe z_msa_eaf_moni_has_sbe z_msa_fst_in z_msa_has_sbe z_msa_stada_in z_n_min_em_parksp_has_in z_n_min_iep_in z_nllsoll_iae_in z_nminemnull_frk_dihi z_nvmsollbegr_frk_dihi z_p_hys_k0_has_fkt z_pvu_has_sbe z_sas_has_sbe z_start_modus_has_sbe z_status_psys_mps_sbe z_svh_has_sbe z_ziel_kraftfluss_egs_in zielgang_egs_in /end LOC_MEASUREMENT
/end FUNCTION
/begin FUNCTION Action_FOp_ABST "" /begin SUB_FUNCTION SFOp_ABST2_FOp_ABS /end SUB_FUNCTION
 /begin LOC_MEASUREMENT abstellpos_vm_in abstellpos_vm_status_in c_getriebe_egs_in c_vm_in gangwechsel_egs_in i_istgang_egs i_zielgang_egs istgang_egs_in m_em_in m_iae_in m_k0_in m_k0_mber_has_sbe m_k0_mod_has_fkt m_max_dyn_em_in m_max_em_has_fkt m_min_dyn_em_in m_min_em_has_fkt m_min_vm_in m_mot_in m_motmax_has m_soll_em_has_fkt m_soll_em_hst_in m_soll_k0_has_fkt m_soll_res_em_bas_sbe m_soll_res_em_has_sbe m_soll_vm_has_fkt m_soll_vm_hst_in m_soll_vm_l_has_fkt m_soll_vm_l_hst_in m_vm_in m_vm_start_in m_wunsch_fpw_hst_fil m_wunsch_fpw_hst_in m_wunsch_fpw_in mg_max_em_has_fkt mg_min_em_has_fkt mg_wunsch_fpw mg_wunsch_fpw_hst n_ab_egs_in n_em_in n_min_em_has_sbe n_min_psys_em_has_sbe n_mot_soll_iae_in n_sec_iae n_soll_em_has_fkt n_soll_em_hst_in n_soll_ll_vm_in n_t_egs_in n_vm_in nd_iae nd_k0_in ndg_k0_in ng_vm osmode_next_in p_bremse_fzg_in phi_neigung_in pos_egs_in sollgang_egs_in st_OMLID_act_stg st_ablauf_fkt st_ist_bz_has_stg st_soll_bz_has_hst st_ziel_bz_has_stg status_ablauf_has_fkt status_alaengs_adaoff_in status_betriebsbereit_hst_in status_efahren_has_sbe status_fehler15_eh_diagin status_fehler_iep_in status_iae_adap_in status_iae_in status_iep_in status_k0_adap_in status_k0_in status_kl15_in status_kolbenpos_k0_in status_kraftfluss_egs_in status_kraftfluss_egs_roh_in status_ll_vm_in status_nem_in status_nreg_em_hst_in status_nvm_in status_posvueb_in status_psys_has_sbe status_sa_vm_in status_schaltart_svh_has_sbe status_schaltung_egs_in status_sync_schaltung_sbe status_waschstr_in status_zug_svh_sbe t_betrieb_pvu_has_ee_in t_betrieb_pvu_has_sbe v_f_sbe vg_f_sbe z_ablauf_has_hst_in z_ablauf_has_stg z_ablauf_svh_reset_has_fkt z_ablaufreinit_frk_dihi z_ablaufvariante_has_hst_in z_ablaufvariante_has_stg z_ba_has_k0_hst_in z_ba_has_vm_hst_in z_diag_ersfkt_has_in z_diag_ersfkt_hi_has_in z_diag_notgang_has_in z_emfehler_frk_dihi z_freigabe_pvu_has_sbe z_fuwdeakt_frk_dihi z_hybfkt_stg z_iep_in z_k0_fst_in z_k0_has_fkt z_k0_has_sbe z_k0syncmk0erh_frk_dihi z_kps_stada_in z_m_soll_em_has_fkt z_m_soll_vm_has_fkt z_modus_em_hst_in z_modus_iae_has_sbe z_modus_iep_has_sbe z_msa_avh_moni_has_sbe z_msa_eaf_moni_has_sbe z_msa_fst_in z_msa_has_sbe z_msa_stada_in z_n_min_em_parksp_has_in z_n_min_iep_in z_n_soll_em_has_fkt z_n_soll_vm_has_fkt z_nllsoll_iae_in z_nminemnull_frk_dihi z_nvmsollbegr_frk_dihi z_p_hys_k0_has_fkt z_ponr_fkt z_pvu_has_sbe z_sas_has_sbe z_start_modus_has_sbe z_status_psys_mps_sbe z_svh_has_sbe z_ziel_kraftfluss_egs_in z_zuendfreigabe_vm_has_fkt zielgang_egs_in /end LOC_MEASUREMENT
/end FUNCTION
/begin FUNCTION Action_FOp_DRS "" /begin SUB_FUNCTION SFOp_DRS2_Action_FOp_DRS2 /end SUB_FUNCTION
 /begin LOC_MEASUREMENT abstellpos_vm_in abstellpos_vm_status_in c_getriebe_egs_in c_vm_in gangwechsel_egs_in i_istgang_egs i_zielgang_egs istgang_egs_in m_em_in m_iae_in m_k0_in m_k0_mber_has_sbe m_k0_mod_has_fkt m_max_dyn_em_in m_min_dyn_em_in m_min_vm_in m_mot_in m_motmax_has m_soll_em_hst_in m_soll_k0_has_fkt m_soll_res_em_bas_sbe m_soll_res_em_has_sbe m_soll_vm_hst_in m_soll_vm_l_hst_in m_vm_in m_vm_start_in m_wunsch_fpw_hst_fil m_wunsch_fpw_hst_in m_wunsch_fpw_in mg_wunsch_fpw mg_wunsch_fpw_hst n_ab_egs_in n_em_in n_min_em_has_sbe n_min_psys_em_has_sbe n_mot_soll_iae_in n_sec_iae n_soll_em_hst_in n_soll_ll_vm_in n_t_egs_in n_vm_in nd_iae nd_k0_in ndg_k0_in ng_vm osmode_next_in p_bremse_fzg_in phi_neigung_in pos_egs_in sollgang_egs_in st_OMLID_act_stg st_ablauf_fkt st_ist_bz_has_stg st_soll_bz_has_hst st_ziel_bz_has_stg status_ablauf_has_fkt status_alaengs_adaoff_in status_betriebsbereit_hst_in status_efahren_has_sbe status_fehler15_eh_diagin status_fehler_iep_in status_iae_adap_in status_iae_in status_iep_in status_k0_adap_in status_k0_in status_kl15_in status_kolbenpos_k0_in status_kraftfluss_egs_in status_kraftfluss_egs_roh_in status_ll_vm_in status_nem_in status_nreg_em_hst_in status_nvm_in status_posvueb_in status_psys_has_sbe status_sa_vm_in status_schaltart_svh_has_sbe status_schaltung_egs_in status_sync_schaltung_sbe status_waschstr_in status_zug_svh_sbe t_betrieb_pvu_has_ee_in t_betrieb_pvu_has_sbe v_f_sbe vg_f_sbe z_ablauf_has_hst_in z_ablauf_has_stg z_ablaufreinit_frk_dihi z_ablaufvariante_has_hst_in z_ablaufvariante_has_stg z_ba_has_k0_hst_in z_ba_has_vm_hst_in z_diag_ersfkt_has_in z_diag_ersfkt_hi_has_in z_diag_notgang_has_in z_emfehler_frk_dihi z_freigabe_pvu_has_sbe z_fuwdeakt_frk_dihi z_hybfkt_stg z_iep_in z_k0_fst_in z_k0_has_fkt z_k0_has_sbe z_k0syncmk0erh_frk_dihi z_kps_stada_in z_modus_em_hst_in z_modus_iae_has_sbe z_modus_iep_has_sbe z_msa_avh_moni_has_sbe z_msa_eaf_moni_has_sbe z_msa_fst_in z_msa_has_sbe z_msa_stada_in z_n_min_em_parksp_has_in z_n_min_iep_in z_nllsoll_iae_in z_nminemnull_frk_dihi z_nvmsollbegr_frk_dihi z_p_hys_k0_has_fkt z_pvu_has_sbe z_sas_has_sbe z_start_modus_has_sbe z_status_psys_mps_sbe z_svh_has_sbe z_ziel_kraftfluss_egs_in zielgang_egs_in /end LOC_MEASUREMENT
/end FUNCTION
/begin FUNCTION Action_FOp_Fehler15 "" /begin SUB_FUNCTION SFop_Fehl155_Subsystem /end SUB_FUNCTION
 /begin LOC_MEASUREMENT c_getriebe_egs_in gangwechsel_egs_in istgang_egs_in m_em_in m_iae_in m_k0_in m_max_dyn_em_in m_min_dyn_em_in m_mot_in m_soll_em_has_fkt m_soll_em_hst_in m_soll_vm_hst_in m_vm_in m_vm_start_in m_wunsch_fpw_in n_ab_egs_in n_em_in n_mot_soll_iae_in n_soll_em_has_fkt n_soll_ll_vm_in n_soll_vm_has_fkt n_t_egs_in n_vm_in osmode_next_in p_bremse_fzg_in phi_neigung_in pos_egs_in sollgang_egs_in st_ablauf_fkt status_ablauf_has_fkt status_alaengs_adaoff_in status_fehler_iep_in status_iae_adap_in status_iae_in status_iep_in status_k0_adap_in status_k0_in status_kolbenpos_k0_in status_kraftfluss_egs_in status_kraftfluss_egs_roh_in status_ll_vm_in status_nem_in status_nvm_in status_posvueb_in status_waschstr_in t_betrieb_pvu_has_ee_in z_ablauf_has_hst_in z_ablaufvariante_has_hst_in z_diag_ersfkt_has_in z_diag_ersfkt_hi_has_in z_diag_notgang_has_in z_fehler15_eh_fkt z_iep_in z_k0_fst_in z_k0_has_fkt z_kps_stada_in z_m_soll_em_has_fkt z_modus_em_hst_in z_msa_fst_in z_n_min_em_parksp_has_in z_n_min_iep_in z_n_soll_em_has_fkt z_n_soll_vm_has_fkt z_nllsoll_iae_in z_tmin_fehler15_fkt z_ziel_kraftfluss_egs_in zielgang_egs_in /end LOC_MEASUREMENT
/end FUNCTION
/begin FUNCTION Action_FOp_GAA "" /begin SUB_FUNCTION SFOp_GA9_If_Action_Subsystem SFOp_GA3_Entry /end SUB_FUNCTION
 /begin LOC_MEASUREMENT abstellpos_vm_in abstellpos_vm_status_in bErrorHybrid bExceptionHybrid c_getriebe_egs_in c_vm_in gangwechsel_egs_in i_istgang_egs i_zielgang_egs istgang_egs_in m_em_in m_iae_in m_k0_in m_k0_mber_has_sbe m_max_dyn_em_in m_min_dyn_em_in m_min_vm_in m_mot_in m_motmax_has m_soll_em_hst_in m_soll_res_em_bas_sbe m_soll_res_em_has_sbe m_soll_vm_hst_in m_soll_vm_l_hst_in m_vm_in m_vm_start_in m_wunsch_fpw_hst_fil m_wunsch_fpw_hst_in m_wunsch_fpw_in mg_wunsch_fpw mg_wunsch_fpw_hst n_ab_egs_in n_em_in n_min_em_has_sbe n_min_psys_em_has_sbe n_mot_soll_iae_in n_sec_iae n_soll_em_hst_in n_soll_ll_vm_in n_t_egs_in n_vm_in nd_iae nd_k0_in ndg_k0_in ng_vm osmode_next_in p_bremse_fzg_in phi_neigung_in pos_egs_in sollgang_egs_in st_OMLID_act_stg st_ablauf_fkt st_ist_bz_has_stg st_ist_bz_hst_sta st_soll_bz_has_hst st_soll_bz_hst_sta st_ziel_bz_has_stg status_ablauf_has_fkt status_alaengs_adaoff_in status_betriebsbereit_hst_in status_efahren_has_sbe status_fehler15_eh_diagin status_fehler_iep_in status_iae_adap_in status_iae_in status_iep_in status_k0_adap_in status_k0_in status_kl15_in status_kolbenpos_k0_in status_kraftfluss_egs_in status_kraftfluss_egs_roh_in status_ll_vm_in status_nem_in status_nreg_em_hst_in status_nvm_in status_posvueb_in status_psys_has_sbe status_sa_vm_in status_schaltart_svh_has_sbe status_schaltung_egs_in status_sync_schaltung_sbe status_waschstr_in status_zug_svh_sbe t_betrieb_pvu_has_ee_in t_betrieb_pvu_has_sbe v_f_sbe vg_f_sbe z_ablauf_has_hst_in z_ablauf_has_stg z_ablaufreinit_frk_dihi z_ablaufvariante_has_hst_in z_ablaufvariante_has_stg z_ba_has_k0_hst_in z_ba_has_vm_hst_in z_diag_ersfkt_has_in z_diag_ersfkt_hi_has_in z_diag_notgang_has_in z_emfehler_frk_dihi z_freigabe_pvu_has_sbe z_fuwdeakt_frk_dihi z_hybfkt_stg z_iep_in z_init_sta z_k0_fst_in z_k0_has_sbe z_k0syncmk0erh_frk_dihi z_kps_stada_in z_modus_em_hst_in z_modus_iae_has_sbe z_modus_iep_has_sbe z_msa_avh_moni_has_sbe z_msa_eaf_moni_has_sbe z_msa_fst_in z_msa_has_sbe z_msa_stada_in z_n_min_em_parksp_has_in z_n_min_iep_in z_nllsoll_iae_in z_nminemnull_frk_dihi z_nvmsollbegr_frk_dihi z_pvu_has_sbe z_sas_has_sbe z_start_modus_has_sbe z_status_psys_mps_sbe z_svh_has_sbe z_ziel_kraftfluss_egs_in zielgang_egs_in /end LOC_MEASUREMENT
/end FUNCTION
/begin FUNCTION Action_FOp_GAE "" /begin SUB_FUNCTION SFOp_GE9_If_Action_Subsystem SFOp_GE3_Entry /end SUB_FUNCTION
 /begin LOC_MEASUREMENT abstellpos_vm_in abstellpos_vm_status_in c_getriebe_egs_in c_vm_in gangwechsel_egs_in i_istgang_egs i_zielgang_egs istgang_egs_in m_em_in m_iae_in m_k0_in m_k0_mber_has_sbe m_k0_mod_has_fkt m_max_dyn_em_in m_min_dyn_em_in m_min_vm_in m_mot_in m_motmax_has m_soll_em_hst_in m_soll_k0_has_fkt m_soll_res_em_bas_sbe m_soll_res_em_has_sbe m_soll_vm_hst_in m_soll_vm_l_hst_in m_vm_in m_vm_start_in m_wunsch_fpw_hst_fil m_wunsch_fpw_hst_in m_wunsch_fpw_in mg_wunsch_fpw mg_wunsch_fpw_hst n_ab_egs_in n_em_in n_min_em_has_sbe n_min_psys_em_has_sbe n_mot_soll_iae_in n_sec_iae n_soll_em_hst_in n_soll_ll_vm_in n_t_egs_in n_vm_in nd_iae nd_k0_in ndg_k0_in ng_vm osmode_next_in p_bremse_fzg_in phi_neigung_in pos_egs_in sollgang_egs_in st_OMLID_act_stg st_ablauf_fkt st_ist_bz_has_stg st_soll_bz_has_hst st_ziel_bz_has_stg status_ablauf_has_fkt status_alaengs_adaoff_in status_betriebsbereit_hst_in status_efahren_has_sbe status_fehler15_eh_diagin status_fehler_iep_in status_iae_adap_in status_iae_in status_iep_in status_k0_adap_in status_k0_in status_kl15_in status_kolbenpos_k0_in status_kraftfluss_egs_in status_kraftfluss_egs_roh_in status_ll_vm_in status_nem_in status_nreg_em_hst_in status_nvm_in status_posvueb_in status_psys_has_sbe status_sa_vm_in status_schaltart_svh_has_sbe status_schaltung_egs_in status_sync_schaltung_sbe status_waschstr_in status_zug_svh_sbe t_betrieb_pvu_has_ee_in t_betrieb_pvu_has_sbe v_f_sbe vg_f_sbe z_ablauf_has_hst_in z_ablauf_has_stg z_ablaufreinit_frk_dihi z_ablaufvariante_has_hst_in z_ablaufvariante_has_stg z_ba_has_k0_hst_in z_ba_has_vm_hst_in z_diag_ersfkt_has_in z_diag_ersfkt_hi_has_in z_diag_notgang_has_in z_emfehler_frk_dihi z_freigabe_pvu_has_sbe z_fuwdeakt_frk_dihi z_hybfkt_stg z_iep_in z_k0_fst_in z_k0_has_fkt z_k0_has_sbe z_k0syncmk0erh_frk_dihi z_kps_stada_in z_modus_em_hst_in z_modus_iae_has_sbe z_modus_iep_has_sbe z_msa_avh_moni_has_sbe z_msa_eaf_moni_has_sbe z_msa_fst_in z_msa_has_sbe z_msa_stada_in z_n_min_em_parksp_has_in z_n_min_iep_in z_nllsoll_iae_in z_nminemnull_frk_dihi z_nvmsollbegr_frk_dihi z_pvu_has_sbe z_sas_has_sbe z_start_modus_has_sbe z_status_psys_mps_sbe z_svh_has_sbe z_ziel_kraftfluss_egs_in zielgang_egs_in /end LOC_MEASUREMENT
/end FUNCTION
/begin FUNCTION Action_FOp_NOS "" /begin SUB_FUNCTION SFOp_NOS10_St_Start SFOp_NOS9_St_Ablauf SFOp_NOS6_Input /end SUB_FUNCTION
 /begin DEF_CHARACTERISTIC MS_K0_ABB_NOS NS_EMMINBED_NST_NOS NS_EMMINBED_SCL_NOS SWI_ABBRUCH_AKTIV_NOS /end DEF_CHARACTERISTIC
 /begin LOC_MEASUREMENT abstellpos_vm_in abstellpos_vm_status_in c_getriebe_egs_in c_vm_in gangwechsel_egs_in i_istgang_egs i_zielgang_egs istgang_egs_in m_em_in m_iae_in m_k0_in m_k0_mber_has_sbe m_k0_mod_has_fkt m_max_dyn_em_in m_min_dyn_em_in m_min_vm_in m_mot_in m_motmax_has m_soll_em_hst_in m_soll_k0_has_fkt m_soll_res_em_bas_sbe m_soll_res_em_has_sbe m_soll_vm_hst_in m_soll_vm_l_hst_in m_vm_in m_vm_start_in m_wunsch_fpw_hst_fil m_wunsch_fpw_hst_in m_wunsch_fpw_in mg_wunsch_fpw mg_wunsch_fpw_hst n_ab_egs_in n_em_in n_min_em_has_sbe n_min_psys_em_has_sbe n_mot_soll_iae_in n_sec_iae n_soll_em_hst_in n_soll_ll_vm_in n_t_egs_in n_vm_in nd_iae nd_k0_in ndg_k0_in ng_vm osmode_next_in p_bremse_fzg_in phi_neigung_in pos_egs_in sollgang_egs_in st_OMLID_act_stg st_ablauf_fkt st_ist_bz_has_stg st_soll_bz_has_hst st_ziel_bz_has_stg status_ablauf_has_fkt status_alaengs_adaoff_in status_betriebsbereit_hst_in status_efahren_has_sbe status_fehler15_eh_diagin status_fehler_iep_in status_iae_adap_in status_iae_in status_iep_in status_k0_adap_in status_k0_in status_kl15_in status_kolbenpos_k0_in status_kraftfluss_egs_in status_kraftfluss_egs_roh_in status_ll_vm_in status_nem_in status_nreg_em_hst_in status_nvm_in status_posvueb_in status_psys_has_sbe status_sa_vm_in status_schaltart_svh_has_sbe status_schaltung_egs_in status_sync_schaltung_sbe status_waschstr_in status_zug_svh_sbe t_betrieb_pvu_has_ee_in t_betrieb_pvu_has_sbe v_f_sbe vg_f_sbe z_ablauf_has_hst_in z_ablauf_has_stg z_ablaufreinit_frk_dihi z_ablaufvariante_has_hst_in z_ablaufvariante_has_stg z_ba_has_k0_hst_in z_ba_has_vm_hst_in z_diag_ersfkt_has_in z_diag_ersfkt_hi_has_in z_diag_notgang_has_in z_emfehler_frk_dihi z_freigabe_pvu_has_sbe z_fuwdeakt_frk_dihi z_hybfkt_stg z_iep_in z_k0_fst_in z_k0_has_fkt z_k0_has_sbe z_k0syncmk0erh_frk_dihi z_kps_stada_in z_modus_em_hst_in z_modus_iae_has_sbe z_modus_iep_has_sbe z_msa_avh_moni_has_sbe z_msa_eaf_moni_has_sbe z_msa_fst_in z_msa_has_sbe z_msa_stada_in z_n_min_em_parksp_has_in z_n_min_iep_in z_nllsoll_iae_in z_nminemnull_frk_dihi z_nvmsollbegr_frk_dihi z_p_hys_k0_has_fkt z_pvu_has_sbe z_sas_has_sbe z_start_modus_has_sbe z_status_psys_mps_sbe z_svh_has_sbe z_ziel_kraftfluss_egs_in z_zuendfreigabe_vm_fkt zielgang_egs_in /end LOC_MEASUREMENT
/end FUNCTION
/begin FUNCTION Action_FOp_OhneAblauffkt "" /begin SUB_FUNCTION SFOp_OhneAb5_Input /end SUB_FUNCTION
 /begin LOC_MEASUREMENT c_getriebe_egs_in gangwechsel_egs_in istgang_egs_in m_em_in m_iae_in m_k0_in m_max_dyn_em_in m_min_dyn_em_in m_mot_in m_soll_em_hst_in m_soll_vm_hst_in m_vm_in m_vm_start_in m_wunsch_fpw_in n_ab_egs_in n_em_in n_mot_soll_iae_in n_soll_ll_vm_in n_t_egs_in n_vm_in osmode_next_in p_bremse_fzg_in phi_neigung_in pos_egs_in sollgang_egs_in status_ablauf_has_fkt status_alaengs_adaoff_in status_fehler_iep_in status_iae_adap_in status_iae_in status_iep_in status_k0_adap_in status_k0_in status_kolbenpos_k0_in status_kraftfluss_egs_in status_kraftfluss_egs_roh_in status_ll_vm_in status_nem_in status_nvm_in status_posvueb_in status_waschstr_in t_betrieb_pvu_has_ee_in z_ablauf_has_hst_in z_ablaufvariante_has_hst_in z_diag_ersfkt_has_in z_diag_ersfkt_hi_has_in z_diag_notgang_has_in z_iep_in z_k0_fst_in z_kps_stada_in z_modus_em_hst_in z_msa_fst_in z_n_min_em_parksp_has_in z_n_min_iep_in z_nllsoll_iae_in z_ziel_kraftfluss_egs_in zielgang_egs_in /end LOC_MEASUREMENT
/end FUNCTION
/begin FUNCTION Action_FOp_Passiv "" /begin SUB_FUNCTION SFOp_Passiv2_Action_Passiv2 /end SUB_FUNCTION
 /begin LOC_MEASUREMENT abstellpos_vm_in abstellpos_vm_status_in c_getriebe_egs_in c_vm_in gangwechsel_egs_in i_istgang_egs i_zielgang_egs istgang_egs_in m_em_in m_iae_in m_k0_in m_k0_mber_has_sbe m_k0_mod_has_fkt m_max_dyn_em_in m_max_iae_has_fkt m_min_dyn_em_in m_min_vm_in m_mot_in m_motmax_has m_soll_em_has_fkt m_soll_em_hst_in m_soll_k0_has_fkt m_soll_res_em_bas_sbe m_soll_res_em_has_sbe m_soll_vm_has_fkt m_soll_vm_hst_in m_soll_vm_l_has_fkt m_soll_vm_l_hst_in m_vm_in m_vm_start_in m_wunsch_fpw_hst_fil m_wunsch_fpw_hst_in m_wunsch_fpw_in mg_max_em_has_fkt mg_min_em_has_fkt mg_soll_k0_has_fkt mg_wunsch_fpw mg_wunsch_fpw_hst n_ab_egs_in n_em_in n_min_em_has_sbe n_min_psys_em_has_sbe n_mot_soll_iae_in n_sec_iae n_soll_em_has_fkt n_soll_em_hst_in n_soll_ll_vm_in n_soll_vm_has_fkt n_t_egs_in n_vm_in nd_iae nd_k0_in ndg_k0_in ng_vm osmode_next_in p_bremse_fzg_in phi_neigung_in pos_egs_in sollgang_egs_in st_OMLID_act_stg st_ablauf_fkt st_ist_bz_has_stg st_soll_bz_has_hst st_ziel_bz_has_stg status_ablauf_has_fkt status_alaengs_adaoff_in status_betriebsbereit_hst_in status_efahren_has_sbe status_fehler15_eh_diagin status_fehler_iep_in status_iae_adap_in status_iae_in status_iep_in status_k0_adap_in status_k0_in status_kl15_in status_kolbenpos_k0_in status_kraftfluss_egs_in status_kraftfluss_egs_roh_in status_ll_vm_in status_nem_in status_nreg_em_hst_in status_nvm_in status_posvueb_in status_psys_has_sbe status_sa_vm_in status_schaltart_svh_has_sbe status_schaltung_egs_in status_sync_schaltung_sbe status_waschstr_in status_zug_svh_sbe t_betrieb_pvu_has_ee_in t_betrieb_pvu_has_sbe v_f_sbe vg_f_sbe z_ablauf_has_hst_in z_ablauf_has_stg z_ablauf_svh_reset_has_fkt z_ablaufreinit_frk_dihi z_ablaufvariante_has_hst_in z_ablaufvariante_has_stg z_ba_has_k0_hst_in z_ba_has_vm_hst_in z_diag_ersfkt_has_in z_diag_ersfkt_hi_has_in z_diag_notgang_has_in z_emaktiv_fuw_zus_fkt z_emfehler_frk_dihi z_fehler15_eh_fkt z_freigabe_pvu_has_sbe z_fuwdeakt_frk_dihi z_hybfkt_stg z_iep_in z_k0_fst_in z_k0_has_fkt z_k0_has_sbe z_k0syncmk0erh_frk_dihi z_kps_stada_in z_m_max_iae_has_fkt z_m_soll_em_has_fkt z_m_soll_vm_has_fkt z_modus_em_hst_in z_modus_iae_has_sbe z_modus_iep_has_sbe z_msa_avh_moni_has_sbe z_msa_eaf_moni_has_sbe z_msa_fst_in z_msa_has_sbe z_msa_stada_in z_n_min_em_parksp_has_in z_n_min_iep_in z_n_soll_em_has_fkt z_n_soll_vm_has_fkt z_nllsoll_iae_in z_nminemnull_frk_dihi z_nvmsollbegr_frk_dihi z_p_hys_k0_has_fkt z_ponr_fkt z_pvu_has_sbe z_sas_has_sbe z_start_modus_has_sbe z_status_psys_mps_sbe z_svh_has_sbe z_ziel_kraftfluss_egs_in z_zuendfreigabe_vm_has_fkt zielgang_egs_in /end LOC_MEASUREMENT
/end FUNCTION
/begin FUNCTION Action_FOp_SCHLST ""
 /begin SUB_FUNCTION SFOp_SLST10_St_Start SFOp_SLST9_St_Ablauf SFOp_SLST7_Output SFOp_SLST6_Input /end SUB_FUNCTION
 /begin DEF_CHARACTERISTIC KL_1NONEMABLVAR_ANS_X KL_1NONEMABLVAR_ANS_Y KL_1NSMINEMCGETR_ANS_X KL_1NSMINEMCGETR_ANS_Y MAX_GANG MAX_GANGENTKPPL MO_5VMSOLLK0GESCHL_ANS MO_K0BED_SCL_ANS MS_10K0_ANS NDS_3K0_ANS ND_1IAE_ANS NS_0NVMCOND_ANS NS_2VMDREHT_ANS NS_2VMLAEUFT_ANS STATUS_2ABLVMDREHT_HST_ANS STATUS_2ABLVMFEHLER_HST_ANS STATUS_2ABLVMLAEUFT_HST_ANS STATUS_3ABLVMDREHT_HST_ANS STATUS_3ABLVMFEHLER_HST_ANS STATUS_3ABLVMLAEUFT_HST_ANS SWI_5ZNSOLLEM_KON_ANS SWI_ABBRUCH_AKTIV_ANS /end DEF_CHARACTERISTIC
 /begin LOC_MEASUREMENT abstellpos_vm_in abstellpos_vm_status_in bErrorHybrid bExceptionHybrid c_getriebe_egs_in c_vm_in gangwechsel_egs_in i_istgang_egs i_zielgang_egs istgang_egs_in m_em_in m_iae_in m_k0_in m_k0_mber_has_sbe m_k0_mod_has_fkt m_max_dyn_em_in m_max_em_has_fkt m_max_iae_has_fkt m_min_dyn_em_in m_min_em_has_fkt m_min_vm_in m_mot_in m_motmax_has m_soll_em_has_fkt m_soll_em_hst_in m_soll_k0_has_fkt m_soll_res_em_bas_sbe m_soll_res_em_has_fkt m_soll_res_em_has_sbe m_soll_vm_hst_in m_soll_vm_l_hst_in m_stoer_k0_em m_stoer_k0_em_fil m_vm_in m_vm_start_in m_wunsch_fpw_hst_fil m_wunsch_fpw_hst_in m_wunsch_fpw_in m_ziel_vm_has_ans mg_soll_k0_has_fkt mg_wunsch_fpw mg_wunsch_fpw_hst n_ab_egs_in n_em_in n_min_em_has_sbe n_min_psys_em_has_sbe n_mot_soll_iae_in n_sec_iae n_soll_em_has_fkt n_soll_em_hst_in n_soll_ll_vm_in n_soll_vm_has_fkt n_t_egs_in n_vm_in nd_iae nd_k0_in ndg_k0_in ng_vm osmode_next_in p_bremse_fzg_in phi_neigung_in pos_egs_in sollgang_egs_in st_OMLID_act_stg st_ablauf_fkt st_ist_bz_has_stg st_ist_bz_hst_sta st_soll_bz_has_hst st_soll_bz_hst_sta st_ziel_bz_has_stg status_ablauf_has_fkt status_alaengs_adaoff_in status_betriebsbereit_hst_in status_efahren_has_sbe status_fehler15_eh_diagin status_fehler_iep_in status_iae_adap_in status_iae_in status_iep_in status_k0_adap_in status_k0_in status_kl15_in status_kolbenpos_k0_in status_kraftfluss_egs_in status_kraftfluss_egs_roh_in status_ll_vm_in status_nem_in status_nreg_em_hst_in status_nvm_in status_posvueb_in status_psys_has_sbe status_sa_vm_in status_schaltart_svh_has_sbe status_schaltung_egs_in status_sync_schaltung_sbe status_waschstr_in status_zug_svh_sbe t_betrieb_pvu_has_ee_in t_betrieb_pvu_has_sbe v_f_sbe vg_f_sbe z_ablauf_has_hst_in z_ablauf_has_stg z_ablauf_svh_reset_has_fkt z_ablaufreinit_frk_dihi z_ablaufvariante_has_hst_in z_ablaufvariante_has_stg z_ba_has_k0_hst_in z_ba_has_vm_hst_in z_diag_ersfkt_has_in z_diag_ersfkt_hi_has_in z_diag_notgang_has_in z_emfehler_frk_dihi z_freigabe_pvu_has_sbe z_fuwdeakt_frk_dihi z_hybfkt_stg z_iae_entkoppelt_has z_iep_in z_init_sta z_k0_befuellopt_has z_k0_befuellopt_has_fkt z_k0_fst_in z_k0_has_fkt z_k0_has_sbe z_k0syncmk0erh_frk_dihi z_kps_stada_in z_m_max_iae_has_fkt z_m_soll_em_has_fkt z_modus_em_hst_in z_modus_iae_has_sbe z_modus_iep_has_sbe z_msa_avh_moni_has_sbe z_msa_eaf_moni_has_sbe z_msa_fst_in z_msa_has_sbe z_msa_stada_in z_n_min_em_parksp_has_in z_n_min_iep_in z_n_soll_em_aktiv_ans_mes z_n_soll_em_has_fkt z_n_soll_vm_has_fkt z_nllsoll_iae_in z_nminemnull_frk_dihi z_nvmsollbegr_frk_dihi z_p_hys_k0_has_fkt z_pvu_has_sbe z_respschleschaltaktiv_ans z_saf_has z_saf_has_fkt z_sas_has_sbe z_sbe_has z_start_modus_has_sbe z_status_psys_mps_sbe z_svh_has_sbe z_ziel_kraftfluss_egs_in zielgang_egs_in /end LOC_MEASUREMENT
/end FUNCTION
/begin FUNCTION Action_FOp_VMaus "" /begin SUB_FUNCTION SFOp_VMA2_FOp_VMA /end SUB_FUNCTION
 /begin LOC_MEASUREMENT abstellpos_vm_in abstellpos_vm_status_in c_getriebe_egs_in c_vm_in gangwechsel_egs_in i_istgang_egs i_zielgang_egs istgang_egs_in m_em_in m_iae_in m_k0_in m_k0_mber_has_sbe m_k0_mod_has_fkt m_max_dyn_em_in m_min_dyn_em_in m_min_vm_in m_mot_in m_motmax_has m_soll_em_hst_in m_soll_k0_has_fkt m_soll_res_em_bas_sbe m_soll_res_em_has_sbe m_soll_vm_hst_in m_soll_vm_l_hst_in m_vm_in m_vm_start_in m_wunsch_fpw_hst_fil m_wunsch_fpw_hst_in m_wunsch_fpw_in mg_wunsch_fpw mg_wunsch_fpw_hst n_ab_egs_in n_em_in n_min_em_has_sbe n_min_psys_em_has_sbe n_mot_soll_iae_in n_sec_iae n_soll_em_hst_in n_soll_ll_vm_in n_t_egs_in n_vm_in nd_iae nd_k0_in ndg_k0_in ng_vm osmode_next_in p_bremse_fzg_in phi_neigung_in pos_egs_in sollgang_egs_in st_OMLID_act_stg st_ablauf_fkt st_ist_bz_has_stg st_soll_bz_has_hst st_ziel_bz_has_stg status_ablauf_has_fkt status_alaengs_adaoff_in status_betriebsbereit_hst_in status_efahren_has_sbe status_fehler15_eh_diagin status_fehler_iep_in status_iae_adap_in status_iae_in status_iep_in status_k0_adap_in status_k0_in status_kl15_in status_kolbenpos_k0_in status_kraftfluss_egs_in status_kraftfluss_egs_roh_in status_ll_vm_in status_nem_in status_nreg_em_hst_in status_nvm_in status_posvueb_in status_psys_has_sbe status_sa_vm_in status_schaltart_svh_has_sbe status_schaltung_egs_in status_sync_schaltung_sbe status_waschstr_in status_zug_svh_sbe t_betrieb_pvu_has_ee_in t_betrieb_pvu_has_sbe v_f_sbe vg_f_sbe z_ablauf_has_hst_in z_ablauf_has_stg z_ablauf_svh_reset_has_fkt z_ablaufreinit_frk_dihi z_ablaufvariante_has_hst_in z_ablaufvariante_has_stg z_ba_has_k0_hst_in z_ba_has_vm_hst_in z_diag_ersfkt_has_in z_diag_ersfkt_hi_has_in z_diag_notgang_has_in z_emfehler_frk_dihi z_freigabe_pvu_has_sbe z_fuwdeakt_frk_dihi z_hybfkt_stg z_iep_in z_k0_fst_in z_k0_has_fkt z_k0_has_sbe z_k0syncmk0erh_frk_dihi z_kps_stada_in z_modus_em_hst_in z_modus_iae_has_sbe z_modus_iep_has_sbe z_msa_avh_moni_has_sbe z_msa_eaf_moni_has_sbe z_msa_fst_in z_msa_has_sbe z_msa_stada_in z_n_min_em_parksp_has_in z_n_min_iep_in z_nllsoll_iae_in z_nminemnull_frk_dihi z_nvmsollbegr_frk_dihi z_pvu_has_sbe z_sas_has_sbe z_start_modus_has_sbe z_status_psys_mps_sbe z_svh_has_sbe z_ziel_kraftfluss_egs_in z_zuendfreigabe_vm_has_fkt zielgang_egs_in /end LOC_MEASUREMENT
/end FUNCTION
/begin FUNCTION Action_FOp_VMein "" /begin SUB_FUNCTION SFOp_VME2_FOp_VME /end SUB_FUNCTION
 /begin LOC_MEASUREMENT abstellpos_vm_in abstellpos_vm_status_in c_getriebe_egs_in c_vm_in gangwechsel_egs_in i_istgang_egs i_zielgang_egs istgang_egs_in m_em_in m_iae_in m_k0_in m_k0_mber_has_sbe m_k0_mod_has_fkt m_max_dyn_em_in m_min_dyn_em_in m_min_vm_in m_mot_in m_motmax_has m_soll_em_hst_in m_soll_k0_has_fkt m_soll_res_em_bas_sbe m_soll_res_em_has_sbe m_soll_vm_hst_in m_soll_vm_l_hst_in m_vm_in m_vm_start_in m_wunsch_fpw_hst_fil m_wunsch_fpw_hst_in m_wunsch_fpw_in mg_wunsch_fpw mg_wunsch_fpw_hst n_ab_egs_in n_em_in n_min_em_has_sbe n_min_psys_em_has_sbe n_mot_soll_iae_in n_sec_iae n_soll_em_hst_in n_soll_ll_vm_in n_t_egs_in n_vm_in nd_iae nd_k0_in ndg_k0_in ng_vm osmode_next_in p_bremse_fzg_in phi_neigung_in pos_egs_in sollgang_egs_in st_OMLID_act_stg st_ablauf_fkt st_ist_bz_has_stg st_soll_bz_has_hst st_ziel_bz_has_stg status_ablauf_has_fkt status_alaengs_adaoff_in status_betriebsbereit_hst_in status_efahren_has_sbe status_fehler15_eh_diagin status_fehler_iep_in status_iae_adap_in status_iae_in status_iep_in status_k0_adap_in status_k0_in status_kl15_in status_kolbenpos_k0_in status_kraftfluss_egs_in status_kraftfluss_egs_roh_in status_ll_vm_in status_nem_in status_nreg_em_hst_in status_nvm_in status_posvueb_in status_psys_has_sbe status_sa_vm_in status_schaltart_svh_has_sbe status_schaltung_egs_in status_sync_schaltung_sbe status_waschstr_in status_zug_svh_sbe t_betrieb_pvu_has_ee_in t_betrieb_pvu_has_sbe v_f_sbe vg_f_sbe z_ablauf_has_hst_in z_ablauf_has_stg z_ablauf_svh_reset_has_fkt z_ablaufreinit_frk_dihi z_ablaufvariante_has_hst_in z_ablaufvariante_has_stg z_ba_has_k0_hst_in z_ba_has_vm_hst_in z_diag_ersfkt_has_in z_diag_ersfkt_hi_has_in z_diag_notgang_has_in z_emfehler_frk_dihi z_freigabe_pvu_has_sbe z_fuwdeakt_frk_dihi z_hybfkt_stg z_iep_in z_k0_fst_in z_k0_has_fkt z_k0_has_sbe z_k0syncmk0erh_frk_dihi z_kps_stada_in z_modus_em_hst_in z_modus_iae_has_sbe z_modus_iep_has_sbe z_msa_avh_moni_has_sbe z_msa_eaf_moni_has_sbe z_msa_fst_in z_msa_has_sbe z_msa_stada_in z_n_min_em_parksp_has_in z_n_min_iep_in z_nllsoll_iae_in z_nminemnull_frk_dihi z_nvmsollbegr_frk_dihi z_pvu_has_sbe z_sas_has_sbe z_start_modus_has_sbe z_status_psys_mps_sbe z_svh_has_sbe z_ziel_kraftfluss_egs_in z_zuendfreigabe_vm_has_fkt zielgang_egs_in /end LOC_MEASUREMENT
/end FUNCTION
/begin FUNCTION Action_FOp_ZUST ""
 /begin SUB_FUNCTION SFOp_Zus10_st_start SFOp_Zus9_St_Ablauf SFOp_Zus7_Output SFOp_Zus6_Input /end SUB_FUNCTION
 /begin DEF_CHARACTERISTIC KL_KSVHRESETAUSZST_SAK_ZUS_X KL_KSVHRESETAUSZST_SAK_ZUS_Y KL_KSVHRESET_ZST_ZUS_X KL_KSVHRESET_ZST_ZUS_Y KL_NDGSK0SYNCERK_SYN_ZUS_X KL_NDGSK0SYNCERK_SYN_ZUS_Y KL_NDSK0MAXSCHLBED_SRT_ZUS_X KL_NDSK0MAXSCHLBED_SRT_ZUS_Y KL_NDSK0MINSCHLBED_SRT_ZUS_X KL_NDSK0MINSCHLBED_SRT_ZUS_Y MO_SOLLVMHSTBED_SCL_ZUS MO_SOLLVMLHSTBED_SCL_ZUS MS_K0BED_ABB_ZUS MS_K0MINFUWKALTBED_ANH_ZUS MS_K0SCHLBED_SRT_ZUS NDGS_K0SYNCERK_SYN_ZUS NDS_EMNSOLLLLVMBED_ANH_ZUS NDS_K0K0SCHL_FUW_ZUS NDS_K0KALTNEMBED_ANH_ZUS NDS_SOLLVMNVMBED_ANH_ZUS NDS_VMNEMBED_ANH_ZUS NGS_VMSYNCERK_SYN_ZUS NS_EMMINBED_SCL_ZUS NS_EMMINBED_SYN_ZUS NS_EMMINFUWKALTBED_ANH_ZUS NS_EMSAKBED_ZST_ZUS NS_VMEINBED_ZST_ZUS NS_VMMINNEMFEHLERBED_FUW_ZUS STATUS_ABLVM_ABF_ZUS STATUS_ABLVM_ANH_ZUS SWI_ABBRUCH_AKTIV_ZUS SWI_VMABFANGEN_SRT_ZUS TAB_MOMZIELK0BED_SYN_ZUS Z_ABLAUF_ABBRUCH_ZUS /end DEF_CHARACTERISTIC
 /begin LOC_MEASUREMENT SFOp_Zus15_KL___SYNCERK_SYN_ZUS SFOp_Zus78_xp_ abstellpos_vm_in abstellpos_vm_status_in c_getriebe_egs_in c_vm_in gangwechsel_egs_in i_istgang_egs i_zielgang_egs istgang_egs_in k_mstoerk0em_zus m_em_in m_iae_in m_k0_in m_k0_mber_has_sbe m_k0_mod_has_fkt m_max_dyn_em_in m_max_iae_has_fkt m_min_dyn_em_in m_min_vm_in m_mot_in m_motmax_has m_soll_em_has_fkt m_soll_em_hst_in m_soll_k0_has_fkt m_soll_res_em_bas_sbe m_soll_res_em_has_fkt m_soll_res_em_has_sbe m_soll_vm_has_fkt m_soll_vm_hst_in m_soll_vm_l_hst_in m_stoerk0em_fil_zus m_stoerk0em_zus m_vm_in m_vm_start_in m_wunsch_fpw_hst_fil m_wunsch_fpw_hst_in m_wunsch_fpw_in m_ziel_k0_has_zus m_ziel_vm_has_zus mg_wunsch_fpw mg_wunsch_fpw_hst n_ab_egs_in n_em_in n_min_em_has_sbe n_min_psys_em_has_sbe n_mot_soll_iae_in n_sec_iae n_sec_iae_ist_zus n_sec_iae_ziel_zus n_soll_em_has_fkt n_soll_em_hst_in n_soll_ll_vm_in n_soll_vm_has_fkt n_t_egs_in n_vm_in nd_iae nd_k0_in ndg_k0_in ng_vm osmode_next_in p_bremse_fzg_in phi_neigung_in pos_egs_in sollgang_egs_in st_OMLID_act_stg st_ablauf_fkt st_ist_bz_has_stg st_soll_bz_has_hst st_ziel_bz_has_stg status_ablauf_has_fkt status_alaengs_adaoff_in status_betriebsbereit_hst_in status_efahren_has_sbe status_fehler15_eh_diagin status_fehler_iep_in status_iae_adap_in status_iae_in status_iep_in status_k0_adap_in status_k0_in status_kl15_in status_kolbenpos_k0_in status_kraftfluss_egs_in status_kraftfluss_egs_roh_in status_ll_vm_in status_nem_in status_nreg_em_hst_in status_nvm_in status_posvueb_in status_psys_has_sbe status_sa_vm_in status_schaltart_svh_has_sbe status_schaltung_egs_in status_sync_schaltung_sbe status_waschstr_in status_zug_svh_sbe t_betrieb_pvu_has_ee_in t_betrieb_pvu_has_sbe t_emaktiv_fuw_zus v_f_sbe vg_f_sbe z_ablauf_has_hst_in z_ablauf_has_stg z_ablauf_svh_reset_has_fkt z_ablaufreinit_frk_dihi z_ablaufvariante_has_hst_in z_ablaufvariante_has_stg z_ablaufvariante_kalt_zus z_ba_has_k0_hst_in z_ba_has_vm_hst_in z_diag_ersfkt_has_in z_diag_ersfkt_hi_has_in z_diag_notgang_has_in z_emaktiv_fuw_zus_fkt z_emaktiv_nemfehler_fuw_zus z_emfehler_frk_dihi z_freigabe_pvu_has_sbe z_fuwdeakt_frk_dihi z_hybfkt_stg z_iep_in z_k0_fst_in z_k0_has_fkt z_k0_has_sbe z_k0sregaktiv_zus z_k0sregbasis_zus z_k0syncmk0erh_frk_dihi z_kps_stada_in z_m_max_iae_has_fkt z_m_soll_em_has_fkt z_m_soll_vm_has_fkt z_modus_em_hst_in z_modus_iae_has_sbe z_modus_iep_has_sbe z_msa_avh_moni_has_sbe z_msa_eaf_moni_has_sbe z_msa_fst_in z_msa_has_sbe z_msa_stada_in z_n_min_em_parksp_has_in z_n_min_iep_in z_n_soll_em_has_fkt z_n_soll_vm_has_fkt z_nllsoll_iae_in z_nminemnull_frk_dihi z_nvmsollbegr_frk_dihi z_p_hys_k0_has_fkt z_ponr_fkt z_pvu_has_sbe z_saf_has_fkt z_sas_has_sbe z_start_modus_has_sbe z_status_psys_mps_sbe z_svh_has_sbe z_svh_palaus_sak_zus z_svh_reset_zustand_zus z_t_k0syncerk_syn_zus z_t_maxbed_abb_zus z_t_maxbed_scl_zus z_ziel_kraftfluss_egs_in z_zuendfreigabe_vm_has_fkt zielgang_egs_in /end LOC_MEASUREMENT
/end FUNCTION
/begin FUNCTION ADA "Das Paket ADA enthält alle Klassen und Funktionalitäten, welche für die Adaption von Getriebedaten notwendig sind." /begin SUB_FUNCTION ADA_KUP ADA_SAS ADA_GLOBAL ADA_IAE ADA_URLUFT /end SUB_FUNCTION /end FUNCTION
/begin FUNCTION ADA_GLOBAL "Adaptionsübergreifende Funktionen"
 /begin IN_MEASUREMENT iAdaGlosc.FiAxRefAdaOff.x iAdaGlosc.ada_iae_info iAdaGlosc.ada_istgang iAdaGlosc.ada_k_zu iAdaGlosc.ada_p_gls_kab iAdaGlosc.ada_p_gls_kzu iAdaGlosc.ada_schaltart iAdaGlosc.ada_schaltung_kzu iAdaGlosc.ada_schaltungs_index iAdaGlosc.ada_synchron iAdaGlosc.ada_zielgang iAdaGlosc.adabew_verbot_sas iAdaGlosc.adaption_counter iAdaGlosc.ax_ref_gef_ada iAdaGlosc.bew_verbot_laengs_beschl iAdaGlosc.f_ada_bew_verboten iAdaGlosc.f_aenderung_adaram_daten iAdaGlosc.f_letzte_schaltung_rs iAdaGlosc.flag_alaengs_adaoff iAdaGlosc.flag_allada_del iAdaGlosc.init_mit_azg iAdaGlosc.z_ada_schaltung /end IN_MEASUREMENT
/end FUNCTION
/begin FUNCTION ADA_GLOKU "In ADA_GLOKU sind globale Kupplungsfunktionen zur Adaption enthalten"
 /begin IN_MEASUREMENT iAdaGloku.kup_beeinfluss_ada_delta_wert iAdaGloku.kup_beeinfluss_ada_typ iAdaGloku.kup_beeinfluss_d_ada_wert iAdaGloku.pre_timer_lock iAdaGloku.pre_timer_max_lock iAdaGloku.puls_lock /end IN_MEASUREMENT
/end FUNCTION
/begin FUNCTION ADA_IAE "In ADA_IAE sind Adaptionsfunktionen zur integrierten Anfahrelement enthalten"
 /begin IN_MEASUREMENT iAdaIaeap.FiMGMotIstIntern.Pt1Si16.x iAdaIaeap.FiMGMotIstIntern.xp iAdaIaeap.FiMMotIstIntern.x iAdaIaeap.FiNGMotIntern.Pt1Si16.x iAdaIaeap.FiNGMotIntern.xp iAdaIaeap.FiNMotIntern.x iAdaIaeap.RampeAdaIae.letzter_ms_timer iAdaIaeap.RampeAdaIae.letzter_wert iAdaIaeap.RampeAdaIae.maximum iAdaIaeap.RampeAdaIae.minimum iAdaIaeap.TimerAdaIae.time iAdaIaeap.TimerKriterienAdaIae.time iAdaIaeap.TimerMaxWartenAdaIae.time iAdaIaeap.abbruch_bit_ada_iae iAdaIaeap.ada_wert_iae iAdaIaeap.ada_wert_in_n_iae iAdaIaeap.c_getr_ref_iae iAdaIaeap.delta_anlege_druck_iae iAdaIaeap.f_abbruch_global_iae iAdaIaeap.f_ada_iae_ein iAdaIaeap.f_angelegt_mmot_iae iAdaIaeap.f_angelegt_nmot_iae iAdaIaeap.f_bew_verboten_iae iAdaIaeap.f_gmmot_begrenzungs_rampe iAdaIaeap.f_rampinit_iae iAdaIaeap.m_mot_ref_ada_iae iAdaIaeap.m_motist_intern iAdaIaeap.m_mw_motist_aperk_iae iAdaIaeap.m_stell_start_ada_iae iAdaIaeap.mg_motist_intern iAdaIaeap.n_mot_intern iAdaIaeap.n_mot_ref_ada_iae iAdaIaeap.n_mot_soll_ada_iae iAdaIaeap.n_mot_soll_leer_start iAdaIaeap.ng_mot_intern iAdaIaeap.pg_rampe_ada_iae iAdaIaeap.po_ada_iae iAdaIaeap.po_rampen_init iAdaIaeap.po_uef_start iAdaIaeap.po_uef_ziel iAdaIaeap.req_n_mot_llsoll_iae iAdaIaeap.summe_m_motist_intern iAdaIaeap.z_apada_iae iAdaIaeuf.adbr_lesen iAdaIaeuf.adbr_schreiben iAdaIaeuf.f_ada_sperren_werteuebername iAdaIaeuf.f_read_kf_gueltig /end IN_MEASUREMENT
/end FUNCTION
/begin FUNCTION ADA_KUP "In ADA_KUP sind kupplungsbezogene Adaptionsfunktionen enthalten" /begin SUB_FUNCTION ADA_GLOKU ADA_PULS ADA_PFUSF ADA_STADA /end SUB_FUNCTION /end FUNCTION
/begin FUNCTION ADA_PFUSF "In ADA_PFUSF sind die Adaptionsfunktionen zur TSF-Prüfung enthalten"
 /begin IN_MEASUREMENT iAdaPfusf.ada_wert_pfad iAdaPfusf.adapfn_status iAdaPfusf.adkl_pfad iAdaPfusf.bew_fuer_adkl_pfad iAdaPfusf.cycle_count_pfad iAdaPfusf.dki_pfad iAdaPfusf.f_max_flare_erreicht_hs_pfad iAdaPfusf.f_mt_krit_aktiv_pfad iAdaPfusf.m_t_pfad iAdaPfusf.n_f_alt.letzter_ms_timer iAdaPfusf.n_f_alt.n_f iAdaPfusf.n_tsync_pfad iAdaPfusf.nd_syn_istgang_min_pfad iAdaPfusf.nd_syn_istgang_pfad iAdaPfusf.ng_ab_pfad iAdaPfusf.pgls_speicher_pfad iAdaPfusf.pm_gls_pfad iAdaPfusf.pm_gls_status iAdaPfusf.schaltart_pfad iAdaPfusf.schaltcode_pfad iAdaPfusf.t_bezug_pfad iAdaPfusf.t_mess_pfad iAdaPfusf.td_pfad iAdaPfusf.td_pfadtsyn iAdaPfusf.timer_pfad /end IN_MEASUREMENT
/end FUNCTION
/begin FUNCTION ADA_PULS "In ADA_PULS sind alle Funktionen zur Pulsadaptionen enthalten"
 /begin IN_MEASUREMENT iAdaPulKr.aktive_pulspruefung iAdaPulzs.anz_kup_puls iAdaPulzs.anz_n_pruefschleife iAdaPulzs.anz_n_pruefzyklen iAdaPulzs.anz_n_pulsgrenz iAdaPulzs.anz_pf_adawert iAdaPulzs.anz_prueftyp iAdaPulzs.anz_pulsid iAdaPulzs.anz_tsf_adawert iAdaPulzs.anz_zwsp_pf iAdaPulzs.anz_zwsp_tsf iAdaPulzs.dki_start iAdaPulzs.druck_statisch iAdaPulzs.f_in_gang_fertig iAdaPulzs.f_ndabbr_verletzt iAdaPulzs.f_nmotsoll_em iAdaPulzs.f_schubabschaltung_aktiv_start iAdaPulzs.f_startpruefung_aktiv iAdaPulzs.f_startpuls_nguete iAdaPulzs.iBew.amplitude_ss iAdaPulzs.iBew.f_start_t_sperrt_nach_reak iAdaPulzs.iBew.iFensterNeg.f_aktiv iAdaPulzs.iBew.iFensterNeg.f_beenden iAdaPulzs.iBew.iFensterNeg.f_starten iAdaPulzs.iBew.iFensterNeg.iTimerBeenden.timer iAdaPulzs.iBew.iFensterNeg.iTimerStarten.timer iAdaPulzs.iBew.iFensterPos.f_aktiv iAdaPulzs.iBew.iFensterPos.f_beenden iAdaPulzs.iBew.iFensterPos.f_starten iAdaPulzs.iBew.iFensterPos.iTimerBeenden.timer iAdaPulzs.iBew.iFensterPos.iTimerStarten.timer iAdaPulzs.iBew.iTimerAmp.timer iAdaPulzs.iBew.iTimerNVerlauf.timer iAdaPulzs.iBew.max_adawert iAdaPulzs.iBew.n_guete_min iAdaPulzs.iBew.nd_pulsamp iAdaPulzs.iBew.nd_pulsneg iAdaPulzs.iBew.nd_pulspos iAdaPulzs.iBew.nd_pulszwneg iAdaPulzs.iBew.nd_pulszwpos iAdaPulzs.iBew.neg_rea iAdaPulzs.iBew.pos_rea iAdaPulzs.iBew.rea_amplitude iAdaPulzs.iBew.testresultat iAdaPulzs.iBew.z_n_verlauf iAdaPulzs.iBew.zeit_erk_amp iAdaPulzs.iBew.zustand iAdaPulzs.iHsv.hs_verzoegerung iAdaPulzs.iHsv.iAbbruch.timer iAdaPulzs.iHsv.t_bis_puls iAdaPulzs.iHsv.zustand iAdaPulzs.iPf.fenster_nach_sf iAdaPulzs.iPf.iZustandstimer.timer iAdaPulzs.iPf.t_fenster_nach_sf iAdaPulzs.iPf.zustand iAdaPulzs.iTSf.zustand iAdaPulzs.iTimerSpzNRea.timer iAdaPulzs.iZustandstimer.timer iAdaPulzs.kup_puls iAdaPulzs.kup_puls_alt iAdaPulzs.kup_puls_neu iAdaPulzs.m_t_start iAdaPulzs.n_pruefschleife iAdaPulzs.n_pruefzyklen iAdaPulzs.n_pulsgrenz iAdaPulzs.p_pulsausgabe iAdaPulzs.prueftyp iAdaPulzs.prueftyp_alt iAdaPulzs.pruefung_kup_fertig iAdaPulzs.pulsid iAdaPulzs.pulszyklus_beenden iAdaPulzs.schnellfuellung_aktiv iAdaPulzs.startinfo_index iAdaPulzs.timer_fenster iAdaPulzs.zeit_sf_1ms iAdaPulzs.zustand iAdaPulzs.zwsp_pf iAdaPulzs.zwsp_tsf /end IN_MEASUREMENT
/end FUNCTION
/begin FUNCTION ADA_SAS "In ADA_SAS sind schaltungsbezogene Adaptionsfunktionen enthalten"
 /begin IN_MEASUREMENT iAdaGlast.adaps_status iAdaGlast.bew_kennfeld iAdaGlast.bew_kennfeld_lesen iAdaGlast.bew_kup iAdaGlast.bew_schaltcode iAdaGlast.bew_schaltcode_lesen iAdaGlast.bew_schalttyp iAdaGlast.bew_schalttyp_lesen iAdaGlast.con_cycle_count iAdaGlast.dki_abbrschwelle iAdaGlast.f_e_fahren_aktiv_schaltbeginn iAdaGlast.gls_ada_state iAdaGlast.gls_adbr iAdaGlast.gls_dki_schaltbeginn iAdaGlast.gls_flag_abbruch_wg_adapfn iAdaGlast.gls_trimm_gang iAdaGlast.gls_trimm_spont_beeinflussung iAdaGlast.gls_trimm_verbot_versch_rs iAdaGlast.glsbew_fuer_adbr iAdaGlast.n_tsyn_gls iAdaGlast.pgls_speicher iAdaGlast.pm_gls iAdaGlast.ps_adadruck iAdaGlast.status_ausgabe_verzoegern /end IN_MEASUREMENT
/end FUNCTION
/begin FUNCTION ADA_STADA "Stillstandsadaption: Pulspruefung im Stillstand aufgrund Testeranforderung."
 /begin IN_MEASUREMENT iAdaPstCondition.preadaption_condition_stada iAdaPstCondition.preadaption_condition_stada_int iAdaPstState.preadaption_state_stada iAdaPstUserinfo.preadaption_userinfo_stada iAdaPstzs.akt_ada iAdaPstzs.anz_kup_puls_stada iAdaPstzs.anz_n_pruefschleife_stada iAdaPstzs.anz_n_pulsgrenz_stada iAdaPstzs.anz_pf_adawert_stada iAdaPstzs.anz_pf_counter_stada iAdaPstzs.anz_pf_durchgefuehrt_stada iAdaPstzs.anz_prueftyp_stada iAdaPstzs.anz_pulsid_stada iAdaPstzs.anz_tsf_adawert_stada iAdaPstzs.anz_tsf_counter_stada iAdaPstzs.anz_tsf_durchgefuehrt_stada iAdaPstzs.anz_zwsp_pf_stada iAdaPstzs.anz_zwsp_tsf_stada iAdaPstzs.druck_statisch_stada iAdaPstzs.f_deaktivierung_erkannt iAdaPstzs.f_nmotsoll_stada_em iAdaPstzs.fzg_stillstand_k0_stada iAdaPstzs.fzg_stillstand_stada iAdaPstzs.gang_zzs_stada iAdaPstzs.grundbedingung_erfuellt_einmalig_k0_stada iAdaPstzs.grundbedingung_erfuellt_einmalig_stada iAdaPstzs.grundbedingung_erfuellt_zyklisch_k0_stada iAdaPstzs.grundbedingung_erfuellt_zyklisch_stada iAdaPstzs.iBew.amplitude_ss_stada iAdaPstzs.iBew.iFensterNeg.f_aktiv_stada iAdaPstzs.iBew.iFensterNeg.f_beenden_stada iAdaPstzs.iBew.iFensterNeg.f_starten_stada iAdaPstzs.iBew.iFensterNeg.iTimerBeenden.timer iAdaPstzs.iBew.iFensterNeg.iTimerStarten.timer iAdaPstzs.iBew.iFensterPos.f_aktiv_stada iAdaPstzs.iBew.iFensterPos.f_beenden_stada iAdaPstzs.iBew.iFensterPos.f_starten_stada iAdaPstzs.iBew.iFensterPos.iTimerBeenden.timer iAdaPstzs.iBew.iFensterPos.iTimerStarten.timer iAdaPstzs.iBew.iTimerAmp.timer iAdaPstzs.iBew.max_adawert_stada iAdaPstzs.iBew.n_guete_min_stada iAdaPstzs.iBew.nd_pulsamp_stada iAdaPstzs.iBew.nd_pulsneg_stada iAdaPstzs.iBew.nd_pulspos_stada iAdaPstzs.iBew.nd_pulszwneg_stada iAdaPstzs.iBew.nd_pulszwpos_stada iAdaPstzs.iBew.neg_rea_stada iAdaPstzs.iBew.pos_rea_stada iAdaPstzs.iBew.rea_amplitude_stada iAdaPstzs.iBew.testresultat_stada iAdaPstzs.iBew.zeit_erk_amp_stada iAdaPstzs.iBew.zustand_stada iAdaPstzs.iPf.fenster_nach_sf_stada iAdaPstzs.iPf.fenster_sf_stada iAdaPstzs.iPf.iZustandstimerStada.timer iAdaPstzs.iPf.t_fenster_nach_sf_stada iAdaPstzs.iPf.t_fenster_sf_stada iAdaPstzs.iPf.zustand_stada iAdaPstzs.iTMaxInitStada.timer iAdaPstzs.iTSf.zustand_stada iAdaPstzs.iTimerNmotleersollAktivStada.timer iAdaPstzs.iZustandstimerStada.timer iAdaPstzs.kup_pruefpuls_ausgabe_stada iAdaPstzs.kup_puls_stada iAdaPstzs.n_mot_start iAdaPstzs.n_pruefschleife_stada iAdaPstzs.n_pulsgrenz_stada iAdaPstzs.p_pulsausgabe_stada iAdaPstzs.pre_ada_zustand_stada iAdaPstzs.pulsid_stada iAdaPstzs.pulszyklus_beenden_stada iAdaPstzs.sal_eng_start_req iAdaPstzs.sal_eng_stop_disable iAdaPstzs.schnellfuellung_aktiv_stada iAdaPstzs.testfall_counter_stada iAdaPstzs.testfall_gang_stada iAdaPstzs.testfall_ind_stada iAdaPstzs.testfall_kup_ind_stada iAdaPstzs.testfall_prueftyp_stada iAdaPstzs.z_k0_stada iAdaPstzs.z_systemkondit_agl iAdaPstzs.z_systemkondit_funkdeakt iAdaPstzs.z_systemkondit_nmot iAdaPstzs.z_systemkondit_zzs iAdaPstzs.zeit_sf_10ms_stada iAdaPstzs.zeit_sf_1ms_stada iAdaPstzs.zustand_stada iAdaPstzs.zwsp_pf_stada iAdaPstzs.zwsp_tsf_stada /end IN_MEASUREMENT
/end FUNCTION
/begin FUNCTION ADA_URLUFT "Urlufterkennung: Es wird während Schaltung und während einer Pulsprüfung detektiert ob aufgrund von Urluft ein falscher Schnellfüllwert adaptiert wurde."
 /begin IN_MEASUREMENT iAdaUrlufterkPuls.iZeitfenster.timer iAdaUrlufterkPuls.istgang_start iAdaUrlufterkPuls.kfl_ist_start iAdaUrlufterkPuls.kup iAdaUrlufterkPuls.zustand iAdaUrlufterkPulsAnz.f_loeschen_puls_url iAdaUrlufterkPulsAnz.kup_puls_url iAdaUrlufterkPulsAnz.n_guete_puls_url iAdaUrlufterkPulsAnz.t_zeitfenster_puls_url iAdaUrlufterkSchaltung.iSignal.f_grad_inti iAdaUrlufterkSchaltung.iSignal.f_pt1_inti iAdaUrlufterkSchaltung.iSignal.f_signal_ungueltig iAdaUrlufterkSchaltung.iSignal.filt_gradient iAdaUrlufterkSchaltung.iSignal.iPt1.x iAdaUrlufterkSchaltung.iSignal.rowert_gradient iAdaUrlufterkSchaltung.iSignal.rowert_signal iAdaUrlufterkSchaltung.iSignal.sig_grad iAdaUrlufterkSchaltung.iSignal.sig_grad_alt iAdaUrlufterkSchaltung.iSignal.sig_grad_diff iAdaUrlufterkSchaltung.iSignal.signal_quelle iAdaUrlufterkSchaltung.iSignal.signal_quelle_alt iAdaUrlufterkSchaltung.iZeitfenster.timer iAdaUrlufterkSchaltung.kup iAdaUrlufterkSchaltung.m_motist_start iAdaUrlufterkSchaltung.zustand iAdaUrlufterkSchaltungAnz.f_loeschen_schalung_url iAdaUrlufterkSchaltungAnz.kup_schaltung_url iAdaUrlufterkSchaltungAnz.m_motist_start_schaltung_url iAdaUrlufterkSchaltungAnz.ng_schaltung_url iAdaUrlufterkSchaltungAnz.t_zeitfenster_schaltung_url /end IN_MEASUREMENT
/end FUNCTION
/begin FUNCTION ALLGMEIN "Allgemein"
 /begin IN_MEASUREMENT iUewIgBerechnung.iMGSollmoment.letzter_ms_timer iUewIgBerechnung.iMGSollmoment.n_f iUewIgBerechnung.mg_motsolluwig /end IN_MEASUREMENT
/end FUNCTION
/begin FUNCTION AT_Algad.doc "Adaption allgemein" /begin SUB_FUNCTION ADA ADA_GLOBAL NVR /end SUB_FUNCTION /end FUNCTION
/begin FUNCTION AT_ARS.doc "Ausrollschaltung" /begin SUB_FUNCTION SAS /end SUB_FUNCTION /end FUNCTION
/begin FUNCTION AT_ATSYS.doc "ATSYS allgemein" /begin SUB_FUNCTION AZS BIBLIO BIH /end SUB_FUNCTION /end FUNCTION
/begin FUNCTION AT_BEFM.doc "Befuellmodell" /begin SUB_FUNCTION HYD /end SUB_FUNCTION /end FUNCTION
/begin FUNCTION AT_BYP.doc "ETK-Bypass" /begin SUB_FUNCTION BIH /end SUB_FUNCTION /end FUNCTION
/begin FUNCTION AT_CSC.doc "Clutch Slip Control" /begin SUB_FUNCTION ADA KAS NVR /end SUB_FUNCTION /end FUNCTION
/begin FUNCTION AT_Daten.doc "Getriebedaten" /begin SUB_FUNCTION HYD /end SUB_FUNCTION /end FUNCTION
/begin FUNCTION AT_EDS.doc "EDS- und Systemdruckansteuerung" /begin SUB_FUNCTION SAS /end SUB_FUNCTION /end FUNCTION
/begin FUNCTION AT_EDSLOGIK.doc "Überwachung EDS-Logik" /begin SUB_FUNCTION BIH UL2 UL2_UEW_EDSLOGIK /end SUB_FUNCTION /end FUNCTION
/begin FUNCTION AT_ERSTZ.doc "Ersatzprogramme" /begin SUB_FUNCTION BIH UEW /end SUB_FUNCTION /end FUNCTION
/begin FUNCTION AT_Esch.doc "E-Schaltung" /begin SUB_FUNCTION ADA AZS BIH KAS SAS UEW /end SUB_FUNCTION /end FUNCTION
/begin FUNCTION AT_ESig.doc "Signalbeschreibung" /begin SUB_FUNCTION BIH SAS /end SUB_FUNCTION /end FUNCTION
/begin FUNCTION AT_GEFD.doc "Fuelldruckadaption GE" /begin SUB_FUNCTION ADA ADA_SAS /end SUB_FUNCTION /end FUNCTION
/begin FUNCTION AT_GEGA.doc "Gangeinlegen / -auslegen" /begin SUB_FUNCTION SAS /end SUB_FUNCTION /end FUNCTION
/begin FUNCTION AT_GEGA_EP.doc "Gangeinlegen/ Gangauslegen MBGEA" /begin SUB_FUNCTION GEA /end SUB_FUNCTION /end FUNCTION
/begin FUNCTION AT_GESTZ.doc "Getriebeschutz" /begin SUB_FUNCTION BIH /end SUB_FUNCTION /end FUNCTION
/begin FUNCTION AT_GLS.doc "GLS" /begin SUB_FUNCTION SAS /end SUB_FUNCTION /end FUNCTION
/begin FUNCTION AT_GLSA.DOC "GLS-Adaption" /begin SUB_FUNCTION ADA ADA_SAS /end SUB_FUNCTION /end FUNCTION
/begin FUNCTION AT_GLU.doc "GLUE" /begin SUB_FUNCTION SAS /end SUB_FUNCTION /end FUNCTION
/begin FUNCTION AT_HISPlausi.doc "HIS Plausibilisierung" /begin SUB_FUNCTION UL2 /end SUB_FUNCTION /end FUNCTION
/begin FUNCTION AT_HOTM.doc "Getriebeuebertemperatur- funktion" /begin SUB_FUNCTION BIH /end SUB_FUNCTION /end FUNCTION
/begin FUNCTION AT_HS.doc "Hochschaltung" /begin SUB_FUNCTION SAS /end SUB_FUNCTION /end FUNCTION
/begin FUNCTION AT_HSad.doc "Fuelldruckadaption HS" /begin SUB_FUNCTION ADA ADA_PFUSF /end SUB_FUNCTION /end FUNCTION
/begin FUNCTION AT_HSGLU.doc "Hochschaltung mit GLU" /begin SUB_FUNCTION SAS /end SUB_FUNCTION /end FUNCTION
/begin FUNCTION AT_HYB_IEP.doc "IEP Ansteuerung" /begin SUB_FUNCTION IEP /end SUB_FUNCTION /end FUNCTION
/begin FUNCTION AT_HYB_K0.doc "Trennkupplung K0" /begin SUB_FUNCTION K0S /end SUB_FUNCTION /end FUNCTION
/begin FUNCTION AT_HYSKOMP.doc "Hysteresekompensation" /begin SUB_FUNCTION HYD /end SUB_FUNCTION /end FUNCTION
/begin FUNCTION AT_IAE.doc "Integriertes AnfahrElement (IAE)" /begin SUB_FUNCTION IAE KAS /end SUB_FUNCTION /end FUNCTION
/begin FUNCTION AT_IAE_ADA.doc "Integriertes AnfahrElement (IAE) UF Adaptionen" /begin SUB_FUNCTION ADA ADA_IAE /end SUB_FUNCTION /end FUNCTION
/begin FUNCTION AT_IAE_DIAG.doc "Integriertes AnfahrElement (IAE) Diagnose" /begin SUB_FUNCTION IAE /end SUB_FUNCTION /end FUNCTION
/begin FUNCTION AT_IAE_TPADA.doc "Integriertes AnfahrElement (IAE) TP Adaptionen" /begin SUB_FUNCTION ADA ADA_IAE /end SUB_FUNCTION /end FUNCTION
/begin FUNCTION AT_KFL_UEB.doc "Überwachung Kraftschluss in Neutral und ungewollter Fahrtrichtungswechsel" /begin SUB_FUNCTION UEW /end SUB_FUNCTION /end FUNCTION
/begin FUNCTION AT_KLAUENUEB.doc "Klauenüberwachung" /begin SUB_FUNCTION UEW UL2 /end SUB_FUNCTION /end FUNCTION
/begin FUNCTION AT_KPLBP.doc "Kupplungsbefuellpruefung" /begin SUB_FUNCTION ADA ADA_GLOKU ADA_URLUFT /end SUB_FUNCTION /end FUNCTION
/begin FUNCTION AT_KUPBEL.doc "Berechnung Kupplungsbelastung" /begin SUB_FUNCTION SAS /end SUB_FUNCTION /end FUNCTION
/begin FUNCTION AT_LCCADA.doc "LCC-Adaption/ Fusspunktadaption" /begin SUB_FUNCTION ADA /end SUB_FUNCTION /end FUNCTION
/begin FUNCTION AT_LHMVUEB.doc "Notlaufventilüberwachung/ LHMV-Überwachung" /begin SUB_FUNCTION UEW /end SUB_FUNCTION /end FUNCTION
/begin FUNCTION AT_MABDYN.doc "Dynamisches Abtriebsmodell" /begin SUB_FUNCTION BIH /end SUB_FUNCTION /end FUNCTION
/begin FUNCTION AT_MAUF.doc "Getriebeaufnahmemoment" /begin SUB_FUNCTION BIH /end SUB_FUNCTION /end FUNCTION
/begin FUNCTION AT_MAUFUEB.doc "Überwachung Getriebeaufnahmemoment" /begin SUB_FUNCTION BIH UL2 UL2_UEW_GETR_M_AUF /end SUB_FUNCTION /end FUNCTION
/begin FUNCTION AT_MAXVERZ.doc "Überwachung auf maximale Verzögerung" /begin SUB_FUNCTION UL2 /end SUB_FUNCTION /end FUNCTION
/begin FUNCTION AT_MESAS.doc "Motoreingriff" /begin SUB_FUNCTION SAS /end SUB_FUNCTION /end FUNCTION
/begin FUNCTION AT_MEueb.doc "Motoreingriffsueberwachung" /begin SUB_FUNCTION BIH UL2 UL2_UEW_MOTOREINGRIFF /end SUB_FUNCTION /end FUNCTION
/begin FUNCTION AT_Mv.doc "MV-Ansteuerung" /begin SUB_FUNCTION HYD /end SUB_FUNCTION /end FUNCTION
/begin FUNCTION AT_MvG.doc "Monitoring von Getriebegroessen" /begin SUB_FUNCTION MON /end SUB_FUNCTION /end FUNCTION
/begin FUNCTION AT_NABGRADUEB.doc "Abtriebsdrehzahlgradientenüberwachung" /begin SUB_FUNCTION UEW /end SUB_FUNCTION /end FUNCTION
/begin FUNCTION AT_NMOTUEB.doc "Ueberdrehzahlueberwachung" /begin SUB_FUNCTION UL2 UL2_UEW_NMOT /end SUB_FUNCTION /end FUNCTION
/begin FUNCTION AT_OS_Modeumschaltung.doc "OS Mode Nachbildung" /begin SUB_FUNCTION BIH /end SUB_FUNCTION /end FUNCTION
/begin FUNCTION AT_PAK.doc "Programmablaufkontrolle" /begin SUB_FUNCTION BIH /end SUB_FUNCTION /end FUNCTION
/begin FUNCTION AT_PARUMSCH.doc "Parameterumschaltung" /begin SUB_FUNCTION BIH /end SUB_FUNCTION /end FUNCTION
/begin FUNCTION AT_PFA.doc "Fuelldruckpulsadaption" /begin SUB_FUNCTION ADA ADA_PULS /end SUB_FUNCTION /end FUNCTION
/begin FUNCTION AT_PKF.doc "Parksperrenkomfortfunktion" /begin SUB_FUNCTION KAS /end SUB_FUNCTION /end FUNCTION
/begin FUNCTION AT_PMUEB.doc "Parksperrenmagnetüberwachung" /begin SUB_FUNCTION UEW UEW_PARKSPERRENMAGNET /end SUB_FUNCTION /end FUNCTION
/begin FUNCTION AT_POSUEB.doc "Überwachung der Positionsvorgabe" /begin SUB_FUNCTION BIH UL2 UL2_UEW_KFLPL /end SUB_FUNCTION /end FUNCTION
/begin FUNCTION AT_POSVUEB.doc "Positionsventilueberwachung" /begin SUB_FUNCTION BIH UEW_POSITIONSVENTIL /end SUB_FUNCTION /end FUNCTION
/begin FUNCTION AT_PRSENSUEB.doc "Klauensensierung" /begin SUB_FUNCTION UEW UL2 /end SUB_FUNCTION /end FUNCTION
/begin FUNCTION AT_RS.doc "Rueckschaltung" /begin SUB_FUNCTION SAS /end SUB_FUNCTION /end FUNCTION
/begin FUNCTION AT_RSad.doc "Fuelldruckadaption RS" /begin SUB_FUNCTION ADA ADA_PFUSF /end SUB_FUNCTION /end FUNCTION
/begin FUNCTION AT_SAC.doc "Rueckrollverhinderung" /begin SUB_FUNCTION KAS /end SUB_FUNCTION /end FUNCTION
/begin FUNCTION AT_SBAK.doc "Schnelle Adaption" /begin SUB_FUNCTION ADA ADA_IAE ADA_SAS /end SUB_FUNCTION /end FUNCTION
/begin FUNCTION AT_SCHA.doc "Schlupfadaption" /begin SUB_FUNCTION ADA /end SUB_FUNCTION /end FUNCTION
/begin FUNCTION AT_SCHST.doc "Schnittstellen allgemein" /begin SUB_FUNCTION BIH /end SUB_FUNCTION /end FUNCTION
/begin FUNCTION AT_SEGELN.doc "Sonderfunktion Segeln" /begin SUB_FUNCTION SAS /end SUB_FUNCTION /end FUNCTION
/begin FUNCTION AT_SFKT.doc "Schutzfunktion" /begin SUB_FUNCTION AZS BIH /end SUB_FUNCTION /end FUNCTION
/begin FUNCTION AT_Sltal.doc "Schaltung allgemein" /begin SUB_FUNCTION ADA SAS /end SUB_FUNCTION /end FUNCTION
/begin FUNCTION AT_Sltg.doc "Grundfunktionen Schaltung" /begin SUB_FUNCTION SAS /end SUB_FUNCTION /end FUNCTION
/begin FUNCTION AT_SLTSF.doc "Sonderfunktion Schaltung" /begin SUB_FUNCTION SAS /end SUB_FUNCTION /end FUNCTION
/begin FUNCTION AT_SLTSP.doc "Spontane Schaltung" /begin SUB_FUNCTION SAS /end SUB_FUNCTION /end FUNCTION
/begin FUNCTION AT_SSCHR.doc "Schrittschaltung" /begin SUB_FUNCTION SAS /end SUB_FUNCTION /end FUNCTION
/begin FUNCTION AT_STADA.doc "Stillstandsadaption" /begin SUB_FUNCTION ADA ADA_KUP ADA_STADA /end SUB_FUNCTION /end FUNCTION
/begin FUNCTION AT_STRVUeb.doc "Ueberwachung Getriebestrangverstaerkung" /begin SUB_FUNCTION BIH /end SUB_FUNCTION /end FUNCTION
/begin FUNCTION AT_TEST.doc "Testfunktion Rolle" /begin SUB_FUNCTION BIH /end SUB_FUNCTION /end FUNCTION
/begin FUNCTION AT_TSENS.doc "Drehmomenten Sensor" /begin SUB_FUNCTION BIH /end SUB_FUNCTION /end FUNCTION
/begin FUNCTION AT_TSFA.doc "Schnellfuellzeitpulsadaption" /begin SUB_FUNCTION ADA ADA_PULS /end SUB_FUNCTION /end FUNCTION
/begin FUNCTION AT_TUNINGueb.doc "Chip Tuning Erkennung" /begin SUB_FUNCTION ADA BIH NVR /end SUB_FUNCTION /end FUNCTION
/begin FUNCTION AT_UWIG.doc "Übersetzungsueberwachung" /begin SUB_FUNCTION BIH UEW UEW_UWIG UEW_UWIG_ALT /end SUB_FUNCTION /end FUNCTION
/begin FUNCTION AT_VERS.doc "Verschachtelte Schaltung" /begin SUB_FUNCTION SAS /end SUB_FUNCTION /end FUNCTION
/begin FUNCTION AT_ZZS.doc "Zentrale Zustandssteuerung" /begin SUB_FUNCTION AZS /end SUB_FUNCTION /end FUNCTION
/begin FUNCTION AZS "Das Paket AZS enthält alle Klassen und Funktionalitäten, welche für die zentrale Zustandssteuerung notwendig sind."
 /begin SUB_FUNCTION AZS_GLOBAL AZS_SONDER_ANSTEUERUNG AZS_KFL_WECHSEL AZS_SCHALTUNG AZS_UEBERWACHUNG /end SUB_FUNCTION
/end FUNCTION
/begin FUNCTION AZS_GLOBAL "die globalen Klassen beinhalten zentrale Größen der AZS und die Verwaltung der Betriebssystem-Aufrufe"
 /begin IN_MEASUREMENT iAzsKorgl.f_abbruch_schaltung_durch_ga iAzsKorgl.f_kfl_direkt iAzsKorgl.f_notgang_gesetzt iAzsKorgl.f_schaltung_direkt iAzsKorgl.f_stromlos_zzs iAzsKorgl.parksperre_ziel iAzsKorgl.pos_red iAzsUeFunktionen.ue_fkt_abschalten iAzsUeFunktionen.ue_fkt_aufgerufen /end IN_MEASUREMENT
/end FUNCTION
/begin FUNCTION AZS_KFL_WECHSEL "beinhaltet die verschiedenen Klassen und Kfl-Groessen, die an einem Kraftfluss-Wechsel beteiligt sind"
 /begin IN_MEASUREMENT iAzsKflIst.kfl_ist iAzsKflSoll.kfl_soll iAzsKflZiel.kfl_ziel /end IN_MEASUREMENT
/end FUNCTION
/begin FUNCTION AZS_SCHALTUNG "beinhaltet die verschiedenen Klassen/Gaenge, die an einer Schaltung beteiligt sind"
 /begin IN_MEASUREMENT iAzsIstgang.f_saf_abbruch_invers iAzsIstgang.f_saf_folgeschaltung iAzsIstgang.f_saf_freigegeben iAzsIstgang.istgang iAzsSollgangMoeglich.sollgang_moeglich iAzsVorgabeGang.f_abbruch_vorb_angefordert iAzsVorgabeGang.f_schleppstart_erkannt iAzsVorgabeGang.gang_schleppstart iAzsVorgabeGang.vorgabegang iAzsZielgang.f_schalt_abbruch_invers iAzsZielgang.zielgang iAzsZielgangSas.schaltart iAzsZielgangSas.schaltinfo iAzsZielgangSas.schaltung iAzsZielgangSas.zielgang_sas iAzsZielgangSas.zielgang_sas_komp iAzsZielgangSoll.zielgang_soll /end IN_MEASUREMENT
/end FUNCTION
/begin FUNCTION AZS_SONDER_ANSTEUERUNG "Sonderansteuerungen gibt es für den Schlüsselstart sowie für die Pulsadaption im Stillstand -Werkstatt-"
 /begin IN_MEASUREMENT iAzsNeutralEbene.TimerNE.time iAzsNeutralEbene.fkt_neutral_ebene iAzsNeutralEbene.pos_neutral_n_stern iAzsNeutralEbene.z_neutral_ebene iAzsSZPulsAda.TimerMaxTime.time iAzsSZPulsAda.TimerSZPulsAda.time iAzsSZPulsAda.f_abbruch_pre_ada_azs iAzsSZPulsAda.f_gang_vorgabe iAzsSZPulsAda.f_neutral_vorgabe iAzsSZPulsAda.f_sz_puls_ada_aktiv iAzsSZPulsAda.sz_puls_ada_gang iAzsSZPulsAda.z_sonder_zustand_puls_ada iAzsSchluesselStart.s_start_status /end IN_MEASUREMENT
/end FUNCTION
/begin FUNCTION AZS_UEBERWACHUNG "Kupplungsschutz und Plausibilisierung der AZS Gang- und Kfl-Groessen"
 /begin IN_MEASUREMENT iAzsKupMassnahmenKoord.beeinfl_spont_index iAzsKupMassnahmenKoord.iSchaltungTrans.k_ab_temp iAzsKupMassnahmenKoord.iSchaltungTrans.k_zu_temp iAzsKupMassnahmenKoord.iSchaltungTrans.kup_mass iAzsKupMassnahmenKoord.iSchaltungTrans.manuell iAzsKupMassnahmenKoord.iSchaltungTrans.temp_schwelle iAzsKupMassnahmenKoord.iSchaltungTrans.temp_schwelle_hys iAzsKupMassnahmenKoord.iSchaltungVerz.cSchaltung._.k_ab_temp iAzsKupMassnahmenKoord.iSchaltungVerz.cSchaltung._.k_zu_temp iAzsKupMassnahmenKoord.iSchaltungVerz.cSchaltung._.kup_mass iAzsKupMassnahmenKoord.iSchaltungVerz.cSchaltung._.manuell iAzsKupMassnahmenKoord.iSchaltungVerz.cSchaltung._.temp_schwelle iAzsKupMassnahmenKoord.iSchaltungVerz.cSchaltung._.temp_schwelle_hys iAzsKupMassnahmenKoord.iSchaltungVerz.iVerzZeit.time iAzsKupMassnahmenKoord.iSchaltungVerz.k_a_schalt_verh iAzsKupMassnahmenKoord.iSchaltungVerz.k_b_schalt_verh iAzsKupMassnahmenKoord.iSchaltungVerz.k_c_schalt_verh iAzsKupMassnahmenKoord.iSchaltungVerz.k_d_schalt_verh iAzsKupMassnahmenKoord.iSchaltungVerz.k_e_schalt_verh iAzsKupMassnahmenKoord.iSchaltungVerz.sollgang iAzsKupMassnahmenKoord.reduzierung_m_mot_max iAzsKupMassnahmenKoord.versch_schalt_verh iAzsKupMassnahmenKoord.zustand_schaltungsverh /end IN_MEASUREMENT
/end FUNCTION
/begin FUNCTION BIB_ENTW_DIAG "In BIB_ENTW_DIAG sind die Klassen zur Entwicklungsdiagnose enthalten" /begin IN_MEASUREMENT iBihZfinf.timer32_betrieb /end IN_MEASUREMENT /end FUNCTION
/begin FUNCTION BIB_FUNKTION "In BIB_FUNKTION sind alle Funktionsbibliotheken enthalten"
 /begin IN_MEASUREMENT iAdaGlosc.FiAxRefAdaOff.x iAdaIaeap.FiMGMotIstIntern.Pt1Si16.x iAdaIaeap.FiMGMotIstIntern.xp iAdaIaeap.FiMMotIstIntern.x iAdaIaeap.FiNGMotIntern.Pt1Si16.x iAdaIaeap.FiNGMotIntern.xp iAdaIaeap.FiNMotIntern.x iAdaIaeap.RampeAdaIae.letzter_ms_timer iAdaIaeap.RampeAdaIae.letzter_wert iAdaIaeap.RampeAdaIae.maximum iAdaIaeap.RampeAdaIae.minimum iAdaIaeap.TimerAdaIae.time iAdaIaeap.TimerKriterienAdaIae.time iAdaIaeap.TimerMaxWartenAdaIae.time iAdaPfusf.n_f_alt.letzter_ms_timer iAdaPfusf.n_f_alt.n_f iAdaPstzs.iBew.iFensterNeg.iTimerBeenden.timer iAdaPstzs.iBew.iFensterNeg.iTimerStarten.timer iAdaPstzs.iBew.iFensterPos.iTimerBeenden.timer iAdaPstzs.iBew.iFensterPos.iTimerStarten.timer iAdaPstzs.iBew.iTimerAmp.timer iAdaPstzs.iPf.iZustandstimerStada.timer iAdaPstzs.iTMaxInitStada.timer iAdaPstzs.iTimerNmotleersollAktivStada.timer iAdaPstzs.iZustandstimerStada.timer iAdaPulzs.iBew.iFensterNeg.iTimerBeenden.timer iAdaPulzs.iBew.iFensterNeg.iTimerStarten.timer iAdaPulzs.iBew.iFensterPos.iTimerBeenden.timer iAdaPulzs.iBew.iFensterPos.iTimerStarten.timer iAdaPulzs.iBew.iTimerAmp.timer iAdaPulzs.iBew.iTimerNVerlauf.timer iAdaPulzs.iHsv.iAbbruch.timer iAdaPulzs.iPf.iZustandstimer.timer iAdaPulzs.iTimerSpzNRea.timer iAdaPulzs.iZustandstimer.timer iAdaUrlufterkPuls.iZeitfenster.timer iAdaUrlufterkSchaltung.iSignal.iPt1.x iAdaUrlufterkSchaltung.iZeitfenster.timer iAzsKupMassnahmenKoord.iSchaltungVerz.iVerzZeit.time iAzsNeutralEbene.TimerNE.time iAzsSZPulsAda.TimerMaxTime.time iAzsSZPulsAda.TimerSZPulsAda.time iBibAglex.anzahl_werte iBibAglex.extrapolationsschritte iBibAglex.extrapolierter_wert iBibAglex.f_nicht_berechnen iBibAglex.func_agl iBibAglex.index_aeltester_wert iBibAglex.index_erster_wert iBibAglex.laenge iBibAglex.n_aktuell iBibAglex.n_guete iBibAglex.noch_benoetigte_werte iBibAglex.signal_agl iBibAglex.steigung iBibAglex.sum_xi_q iBibAglex.sum_yi iBibAglex.x_0 iBibAglex.x_expol iBibAglex.y_0 iBibAglex.z_agl iBibAglex.z_ringspeicher iBihMomen.Pt1MPuAuf.x iBihMomen.TimerK0Verlust.time iBihTimer.timer_difference iBihTimer.timer_difference_10ms_skal iBihTimer.timer_difference_1ms_skal iBihTimer.timer_old_value iBihTimer.timer_reset.timer iIaeAdauf.iTLaufUefiae.timer iIaeDiagn.Pt1Axrefiae.x iIaeDiagn.Pt1Mdidiagiae.x iIaeDiagn.TimerCloseBewAktiv.maxtime iIaeDiagn.TimerCloseBewAktiv.time iIaeDiagn.TimerCloseNgab.maxtime iIaeDiagn.TimerCloseNgab.time iIaeDiagn.TimerCloseRueckF.maxtime iIaeDiagn.TimerCloseRueckF.time iIaeDiagn.TimerHotDiagiae.time iIaeDiagn.TimerNoCloseDiagiae.maxtime iIaeDiagn.TimerNoCloseDiagiae.time iIaeDiagn.TimerNoOpenDiagiae.maxtime iIaeDiagn.TimerNoOpenDiagiae.time iIaeDiagn.TimerNocloseBewAktiv.maxtime iIaeDiagn.TimerNocloseBewAktiv.time iIaeDiagn.TimerNoopenBewAktiv.maxtime iIaeDiagn.TimerNoopenBewAktiv.time iIaeDiagn.TimerNoopenRueckF.maxtime iIaeDiagn.TimerNoopenRueckF.time iIaeDraus.Dt1PGStell.Pt1Si16.x iIaeDraus.Dt1PGStell.xp iIaeDraus.Pt1Mue.x iIaeDraus.Pt1PDStellHysS.x iIaeDraus.Pt1PStellbasis.x iIaeDraus.Pt1PoDyn.x iIaeDraus.Pt1PoHysKoStill.x iIaeDraus.Pt2PIst.x iIaeDraus.Pt2PIst.xp iIaeDraus.TimerHysSchl.maxtime iIaeDraus.TimerHysSchl.time iIaeDraus.TimerHyskompan.maxtime iIaeDraus.TimerHyskompan.time iIaeDraus.TimerPoDyn.maxtime iIaeDraus.TimerPoDyn.time iIaeKordi.TimerZIae.maxtime iIaeKordi.TimerZIae.time iIaeKuehl.Pt1Vpsoll.x iIaeKuehl.TimerZModusIae.maxtime iIaeKuehl.TimerZModusIae.time iIaeMomen.BibPIDIae.faktor_d iIaeMomen.BibPIDIae.faktor_i iIaeMomen.BibPIDIae.faktor_p iIaeMomen.BibPIDIae.faktor_t1 iIaeMomen.BibPIDIae.regel_diff_alt iIaeMomen.BibPIDIae.stell_max iIaeMomen.BibPIDIae.stell_min iIaeMomen.BibPIDIae.stellgr_alt iIaeMomen.BibPIDIae.stellgr_d_alt iIaeMomen.BibPIDIae.stellgr_i_alt iIaeMomen.BibPIDIae.stellgr_i_modulo iIaeMomen.Pt1IStuetz.x iIaeMomen.Pt1NMotAnfah.x iIaeMomen.Pt2MIstVorstIae.x iIaeMomen.Pt2MIstVorstIae.xp iIaeMomen.Pt2NMotAnfahrt.x iIaeMomen.Pt2NMotAnfahrt.xp iIaeMomen.TimerKflMiaeauf.maxtime iIaeMomen.TimerKflMiaeauf.time iIaeMomen.TimerMiaeaufAnfahr.maxtime iIaeMomen.TimerMiaeaufAnfahr.time iIaeMomen.TimerNachMmaxHas.maxtime iIaeMomen.TimerNachMmaxHas.time iIaeMomen.TimerPulsCue.maxtime iIaeMomen.TimerPulsCue.time iIaeMomen.TimerPulsCueAktiv.maxtime iIaeMomen.TimerPulsCueAktiv.time iIaeMomen.TimerUefIstuetz.maxtime iIaeMomen.TimerUefIstuetz.time iIaeMomen.TimerUefKriechen.maxtime iIaeMomen.TimerUefKriechen.time iIaeMomen.TimerUefMVorKriechen.maxtime iIaeMomen.TimerUefMVorKriechen.time iIaeMotmx.Pt1MMotmax.x iIaeMotmx.TimerStallIae.maxtime iIaeMotmx.TimerStallIae.time iIaeSigna.DelayMMotgem.write_index iIaeSigna.DelayMMotist.write_index iIaeSigna.DelayMMotistoe.write_index iIaeSigna.DelayMMotsolloe.write_index iIaeSigna.DelayNab.write_index iIaeSigna.DelayNt.write_index iIaeSigna.Dt1Dkig.Pt1Si16.x iIaeSigna.Dt1Dkig.xp iIaeSigna.Dt1MgMotist.Pt1Si16.x iIaeSigna.Dt1MgMotist.xp iIaeSigna.Dt1NdgIae.Pt1Si16.x iIaeSigna.Dt1NdgIae.xp iIaeSigna.Dt1NgAb.Pt1Si16.x iIaeSigna.Dt1NgAb.xp iIaeSigna.Dt1NgGetrein.Pt1Si16.x iIaeSigna.Dt1NgGetrein.xp iIaeSigna.Dt1NgMot.Pt1Si16.x iIaeSigna.Dt1NgMot.xp iIaeSigna.Dt1Pbremsg.Pt1Si16.x iIaeSigna.Dt1Pbremsg.xp iIaeSigna.Pt1AxrefIae.x iIaeSigna.Pt1Dki.x iIaeSigna.Pt1MMotgem.x iIaeSigna.Pt1MMotist.x iIaeSigna.Pt1MMotistoe.x iIaeSigna.Pt1MMotsolloe.x iIaeSigna.Pt1NAb.x iIaeSigna.Pt1NMot.x iIaeSigna.Pt1NT.x iIaeSigna.Pt1NdGetrein.x iIaeSigna.Pt1NdIae.x iIaeSigna.Pt1NdMot.x iIaeSigna.Pt1Nue.x iIaeSigna.Pt1PBrems.x iIaeSigna.Pt2NeigungIae.x iIaeSigna.Pt2NeigungIae.xp iIaeTempm.TimerVzInit.maxtime iIaeTempm.TimerVzInit.time iIepBerLp.iTimerNminIep.timer iIepBerLp.iTimerSenkenLP3.timer iIepKordi.iTimerGesamtLP1.maxtime iIepKordi.iTimerGesamtLP1.time iIepKordi.iTimerGesamtLP2.maxtime iIepKordi.iTimerGesamtLP2.time iIepKordi.iTimerGesamtLP3.maxtime iIepKordi.iTimerGesamtLP3.time iIepLeckagemodell.Pt1NgMotIep.x iIepLeckagemodell.Pt1NsMotAnKorrIep.x iIepSchuz.iTimerGesamt.timer iIepSchuz.iTimerLP.time iIepSigna.Pt1NeigungsFilterIep.x iIepSigna.iTimerFehlerReset.time iIepSigna.iTimerGefaelleIep.timer iIepSigna.iTimerLuftAktiv.timer iIepSigna.iTimerLuftSperr.timer iIepSigna.iTimerNabIep.timer iIepSigna.iTimerPsysPssIep.time iIepSigna.iTimerWstr.timer iIepStSig.iTimerStatusIep.timer iK0sDiagnose.TimerK0IO.time iK0sDiagnose.TimerK0defekt.time iK0sDruck.DruckFilter.x iK0sDruck.DruckFilterHys.x iK0sDruck.Dt1PkorrK0.Pt1Fl32.x iK0sDruck.Dt1PkorrK0.xp iK0sDruck.FilterPoTorus.x iK0sDruck.FilterPoTorusDyn.x iK0sDruck.FuellrampeK0.letzter_timer iK0sDruck.FuellrampeK0.letzter_wert iK0sDruck.LFOffsetFilter.x iK0sDruck.p0_ist_filter.x iK0sDruck.p0_ist_filter.xp iK0sKorSW.iSODyn.fdyn_timer.time iK0sKorSW.iSODyn.wndo_fdyn_filter.x iK0sKorSW.iSODyn.wndo_fdyn_filter.xp iK0sKorSW.iSOShi.wndo_schalt_pt1_filter.x iK0sKorSW.iSOShi.wndo_schalt_pt2_filter.x iK0sKorSW.iSOShi.wndo_schalt_pt2_filter.xp iK0sKorSW.iStdSW.ada_timer.time iK0sKorSW.iStdSW.einreg_timer.time iK0sKorSW.iStdSW.wnd_init_filter.x iK0sKorSW.iStdSW.wnd_init_filter.xp iK0sKorSW.iStdSW.wnd_std_filter.x iK0sKorSW.iStdSW.wnd_std_filter.xp iK0sKorSignale.delay_m_em_max_dyn_sync_k0.write_index iK0sKorSignale.delay_m_em_min_dyn_sync_k0.write_index iK0sKorSignale.delay_m_emist_k0.write_index iK0sKorSignale.delay_m_motist_k0.write_index iK0sKorSignale.delay_m_vmist_k0.write_index iK0sKorSignale.delay_m_vmsollgemvor_k0.write_index iK0sKorSignale.delay_n_mot_k0.write_index iK0sKorSignale.delay_n_tneu_k0.write_index iK0sKorSignale.delay_n_vm_k0.write_index iK0sKorSignale.delay_nabneu_k0.write_index iK0sKorSignale.dk_pedal_k0_dt1.Pt1Si16.x iK0sKorSignale.dk_pedal_k0_dt1.xp iK0sKorSignale.dt1_m_vmsollgemvor_k0.Pt1Si16.x iK0sKorSignale.dt1_m_vmsollgemvor_k0.xp iK0sKorSignale.dt1_ngab_k0.Pt1Si16.x iK0sKorSignale.dt1_ngab_k0.xp iK0sKorSignale.dt1_ngem_sync_k0.Pt1Si16.x iK0sKorSignale.dt1_ngem_sync_k0.xp iK0sKorSignale.m_em_max_dyn_sync_filter_k0.x iK0sKorSignale.m_em_min_dyn_sync_filter_k0.x iK0sKorSignale.m_emist_filter_k0.x iK0sKorSignale.m_motist_filter_k0.x iK0sKorSignale.m_vmist_filter_k0.x iK0sKorSignale.m_vmsoll_filter_k0.x iK0sKorSignale.n_abneu_filter_k0.x iK0sKorSignale.n_mot_filter_k0.x iK0sKorSignale.n_tneu_filter_k0.x iK0sKorSignale.n_vm_filter_k0.x iK0sKorSignale.nd_zszug_filter_k0.x iK0sMeUtf.TspK0Schutz.time iK0sParam.Pt1IGetriebeVirtK0Roh.x iK0sShLog.VzInitSchalt.time iK0sSteuerung.Pt1ZuregelnK0.x iK0sSteuerung.TimerFuellzeit.time iK0sSteuerung.TimerOffenK0.maxtime iK0sSteuerung.TimerOffenK0.time iK0sSteuerung.TimerZuregelnmax.time iK0sSteuerung.iLBibPID.faktor_d iK0sSteuerung.iLBibPID.faktor_i iK0sSteuerung.iLBibPID.faktor_p iK0sSteuerung.iLBibPID.faktor_t1 iK0sSteuerung.iLBibPID.regel_diff_alt iK0sSteuerung.iLBibPID.stell_max iK0sSteuerung.iLBibPID.stell_min iK0sSteuerung.iLBibPID.stellgr_alt iK0sSteuerung.iLBibPID.stellgr_d_alt iK0sSteuerung.iLBibPID.stellgr_i_alt iK0sSteuerung.iLBibPID.stellgr_i_modulo iK0sSteuerung.m_ist_k0_filter.x iK0sSteuerung.m_ist_k0_filter.xp iK0sSteuerung.m_schlepp_k0_filter.x iK0sSteuerung.m_schlepp_k0_filter.xp iK0sTempM.Pt1VpOelK0.x iK0sVorst.DelayDme.write_index iK0sVorst.Pt1MInitEinregK0.x iK0sVorst.Pt1MInitSchaltK0.x iK0sVorst.Pt1MoLwK0.x iK0sVorst.Pt1MschaltK0.x iK0sVorst.Pt2MschaltabK0.x iK0sVorst.Pt2MschaltabK0.xp iK0sVorst.TimerTMSchaltK0.time iK0sVorst.TimerTMoLwK0.time iKasEkopl.Pt1MoEntkoppl.x iKasEkopl.TimerSchlEkop.maxtime iKasEkopl.TimerSchlEkop.time iKasEkopl.TimerZEkopl.maxtime iKasEkopl.TimerZEkopl.time iKupA.p_filter.letzter_ms_timer iKupA.p_filter.x iKupA.t_kpl_aktiv.timer iKupA.t_kpl_inaktiv.timer iKupA.timer_sas_ende_mit_pmax.timer iKupA.zustandstimer.timer iKupB.p_filter.letzter_ms_timer iKupB.p_filter.x iKupB.t_kpl_aktiv.timer iKupB.t_kpl_inaktiv.timer iKupB.timer_sas_ende_mit_pmax.timer iKupB.zustandstimer.timer iKupC.p_filter.letzter_ms_timer iKupC.p_filter.x iKupC.t_kpl_aktiv.timer iKupC.t_kpl_inaktiv.timer iKupC.timer_sas_ende_mit_pmax.timer iKupC.zustandstimer.timer iKupD.p_filter.letzter_ms_timer iKupD.p_filter.x iKupD.t_kpl_aktiv.timer iKupD.t_kpl_inaktiv.timer iKupD.timer_sas_ende_mit_pmax.timer iKupD.zustandstimer.timer iKupE.p_filter.letzter_ms_timer iKupE.p_filter.x iKupE.t_kpl_aktiv.timer iKupE.t_kpl_inaktiv.timer iKupE.timer_sas_ende_mit_pmax.timer iKupE.zustandstimer.timer iKupHysA.iDt1IEds.Pt1Si16.x iKupHysA.iDt1IEds.xp iKupHysA.iDt1PAbssoll.Pt1Fl32.x iKupHysA.iDt1PAbssoll.xp iKupHysA.iDt1Verz.Pt1Fl32.x iKupHysA.iDt1Verz.xp iKupHysA.iPt2IoKomp.x iKupHysA.iPt2IoKomp.xp iKupHysA.iPt2MoKomp.x iKupHysA.iPt2MoKomp.xp iKupHysB.iDt1IEds.Pt1Si16.x iKupHysB.iDt1IEds.xp iKupHysB.iDt1PAbssoll.Pt1Fl32.x iKupHysB.iDt1PAbssoll.xp iKupHysB.iDt1Verz.Pt1Fl32.x iKupHysB.iDt1Verz.xp iKupHysB.iPt2IoKomp.x iKupHysB.iPt2IoKomp.xp iKupHysB.iPt2MoKomp.x iKupHysB.iPt2MoKomp.xp iKupHysC.iDt1IEds.Pt1Si16.x iKupHysC.iDt1IEds.xp iKupHysC.iDt1PAbssoll.Pt1Fl32.x iKupHysC.iDt1PAbssoll.xp iKupHysC.iDt1Verz.Pt1Fl32.x iKupHysC.iDt1Verz.xp iKupHysC.iPt2IoKomp.x iKupHysC.iPt2IoKomp.xp iKupHysC.iPt2MoKomp.x iKupHysC.iPt2MoKomp.xp iKupHysD.iDt1IEds.Pt1Si16.x iKupHysD.iDt1IEds.xp iKupHysD.iDt1PAbssoll.Pt1Fl32.x iKupHysD.iDt1PAbssoll.xp iKupHysD.iDt1Verz.Pt1Fl32.x iKupHysD.iDt1Verz.xp iKupHysD.iPt2IoKomp.x iKupHysD.iPt2IoKomp.xp iKupHysD.iPt2MoKomp.x iKupHysD.iPt2MoKomp.xp iKupHysE.iDt1IEds.Pt1Si16.x iKupHysE.iDt1IEds.xp iKupHysE.iDt1PAbssoll.Pt1Fl32.x iKupHysE.iDt1PAbssoll.xp iKupHysE.iDt1Verz.Pt1Fl32.x iKupHysE.iDt1Verz.xp iKupHysE.iPt2IoKomp.x iKupHysE.iPt2IoKomp.xp iKupHysE.iPt2MoKomp.x iKupHysE.iPt2MoKomp.xp iKupHysK0.iDt1IEds.Pt1Si16.x iKupHysK0.iDt1IEds.xp iKupHysK0.iDt1PAbssoll.Pt1Fl32.x iKupHysK0.iDt1PAbssoll.xp iKupHysK0.iDt1Verz.Pt1Fl32.x iKupHysK0.iDt1Verz.xp iKupHysK0.iPt2IoKomp.x iKupHysK0.iPt2IoKomp.xp iKupHysK0.iPt2MoKomp.x iKupHysK0.iPt2MoKomp.xp iKupK0.p_filter.letzter_ms_timer iKupK0.p_filter.x iKupK0.t_kpl_aktiv.timer iKupK0.t_kpl_inaktiv.timer iKupK0.timer_sas_ende_mit_pmax.timer iKupK0.zustandstimer.timer iMoeMesaf.filter_spez_me.letzter_ms_timer iMoeMesaf.filter_spez_me.start_wert iMoeMesaf.filter_spez_me.x iMvsZentr.iTimerKeinKfl.timer iMvsZentr.iTimerMagnet.timer iMvsZentr.iTimerParksp.timer iSasAnGeaKraftschl.pgo_gea_rampe.cBibRampeGradSi16._.letzter_ms_timer iSasAnGeaKraftschl.pgo_gea_rampe.cBibRampeGradSi16._.letzter_wert iSasAnGeaKraftschl.pgo_gea_rampe.cBibRampeGradSi16._.maximum iSasAnGeaKraftschl.pgo_gea_rampe.cBibRampeGradSi16._.minimum iSasAnGeaNichtKraftschl1.pgo_gea_rampe.cBibRampeGradSi16._.letzter_ms_timer iSasAnGeaNichtKraftschl1.pgo_gea_rampe.cBibRampeGradSi16._.letzter_wert iSasAnGeaNichtKraftschl1.pgo_gea_rampe.cBibRampeGradSi16._.maximum iSasAnGeaNichtKraftschl1.pgo_gea_rampe.cBibRampeGradSi16._.minimum iSasAnGeaNichtKraftschl2.pgo_gea_rampe.cBibRampeGradSi16._.letzter_ms_timer iSasAnGeaNichtKraftschl2.pgo_gea_rampe.cBibRampeGradSi16._.letzter_wert iSasAnGeaNichtKraftschl2.pgo_gea_rampe.cBibRampeGradSi16._.maximum iSasAnGeaNichtKraftschl2.pgo_gea_rampe.cBibRampeGradSi16._.minimum iSasAnGls.filter_wngtgls.letzter_ms_timer iSasAnGls.filter_wngtgls.x iSasAnGls.gls_para.cBibRegle._.faktor_d iSasAnGls.gls_para.cBibRegle._.faktor_i iSasAnGls.gls_para.cBibRegle._.faktor_p iSasAnGls.gls_para.cBibRegle._.faktor_t1 iSasAnGls.gls_para.cBibRegle._.regel_diff_alt iSasAnGls.gls_para.cBibRegle._.stell_max iSasAnGls.gls_para.cBibRegle._.stell_min iSasAnGls.gls_para.cBibRegle._.stellgr_alt iSasAnGls.gls_para.cBibRegle._.stellgr_d_alt iSasAnGls.gls_para.cBibRegle._.stellgr_i_alt iSasAnGls.gls_para.cBibRegle._.stellgr_i_modulo iSasKflwe.p_kab_kflw2_speicher.letzter_ms_timer iSasKflwe.p_kab_kflw2_speicher.letzter_wert iSasKflwe.p_kab_kflw2_speicher.maximum iSasKflwe.p_kab_kflw2_speicher.minimum iSasKflwe.p_kab_kflw_speicher.letzter_ms_timer iSasKflwe.p_kab_kflw_speicher.letzter_wert iSasKflwe.p_kab_kflw_speicher.maximum iSasKflwe.p_kab_kflw_speicher.minimum iSasPsyst.filter_p_sysist.letzter_ms_timer iSasPsyst.filter_p_sysist.x iSasPsyst.rampe_p_sysiae.letzter_ms_timer iSasPsyst.rampe_p_sysiae.letzter_wert iSasPsyst.rampe_p_sysiae.maximum iSasPsyst.rampe_p_sysiae.minimum iSasPsyst.rampe_p_syspulsada.letzter_ms_timer iSasPsyst.rampe_p_syspulsada.letzter_wert iSasPsyst.rampe_p_syspulsada.maximum iSasPsyst.rampe_p_syspulsada.minimum iSasZentr.iSchaltend.iKab.pgo_kab_speicher.cBibRampeGradSi16._.letzter_ms_timer iSasZentr.iSchaltend.iKab.pgo_kab_speicher.cBibRampeGradSi16._.letzter_wert iSasZentr.iSchaltend.iKab.pgo_kab_speicher.cBibRampeGradSi16._.maximum iSasZentr.iSchaltend.iKab.pgo_kab_speicher.cBibRampeGradSi16._.minimum iSasZentr.iSchaltend.iKab.raph_kab_speicher.letzter_timer iSasZentr.iSchaltend.iKab.raph_kab_speicher.letzter_wert iSasZentr.iSchaltend.iKab.raps_kab_speicher.letzter_timer iSasZentr.iSchaltend.iKab.raps_kab_speicher.letzter_wert iSasZentr.iSchaltend.iKzu.pgo_kzu_speicher.cBibRampeGradSi16._.letzter_ms_timer iSasZentr.iSchaltend.iKzu.pgo_kzu_speicher.cBibRampeGradSi16._.letzter_wert iSasZentr.iSchaltend.iKzu.pgo_kzu_speicher.cBibRampeGradSi16._.maximum iSasZentr.iSchaltend.iKzu.pgo_kzu_speicher.cBibRampeGradSi16._.minimum iSasZentr.iSchaltend.iKzu.raph_kzu_speicher.letzter_timer iSasZentr.iSchaltend.iKzu.raph_kzu_speicher.letzter_wert iSasZentr.iSchaltend.sp_ngdsynzielgang.letzter_ms_timer iSasZentr.iSchaltend.sp_ngdsynzielgang.n_f iSasZentr.iVorbereitend.iKab.pgo_kab_speicher.cBibRampeGradSi16._.letzter_ms_timer iSasZentr.iVorbereitend.iKab.pgo_kab_speicher.cBibRampeGradSi16._.letzter_wert iSasZentr.iVorbereitend.iKab.pgo_kab_speicher.cBibRampeGradSi16._.maximum iSasZentr.iVorbereitend.iKab.pgo_kab_speicher.cBibRampeGradSi16._.minimum iSasZentr.iVorbereitend.iKab.raph_kab_speicher.letzter_timer iSasZentr.iVorbereitend.iKab.raph_kab_speicher.letzter_wert iSasZentr.iVorbereitend.iKab.raps_kab_speicher.letzter_timer iSasZentr.iVorbereitend.iKab.raps_kab_speicher.letzter_wert iSasZentr.iVorbereitend.iKzu.pgo_kzu_speicher.cBibRampeGradSi16._.letzter_ms_timer iSasZentr.iVorbereitend.iKzu.pgo_kzu_speicher.cBibRampeGradSi16._.letzter_wert iSasZentr.iVorbereitend.iKzu.pgo_kzu_speicher.cBibRampeGradSi16._.maximum iSasZentr.iVorbereitend.iKzu.pgo_kzu_speicher.cBibRampeGradSi16._.minimum iSasZentr.iVorbereitend.iKzu.raph_kzu_speicher.letzter_timer iSasZentr.iVorbereitend.iKzu.raph_kzu_speicher.letzter_wert iSasZentr.iVorbereitend.sp_ngdsynzielgang.letzter_ms_timer iSasZentr.iVorbereitend.sp_ngdsynzielgang.n_f iTciCompu.iPKAbFilter.letzter_ms_timer iTciCompu.iPKAbFilter.x iTciCompu.iPKZuFilter.letzter_ms_timer iTciCompu.iPKZuFilter.x iUewIgBerechnung.iMGSollmoment.letzter_ms_timer iUewIgBerechnung.iMGSollmoment.n_f iUewParksperrenmagnet.iTimerPmdef.timer iUewParksperrenmagnet.iTimerPmueb.timer iUewParksperrenmagnet.iTimerVerzpmueb.timer /end IN_MEASUREMENT
/end FUNCTION
/begin FUNCTION BIBLIO "Die Unterstruktur BIBLIO enthält alle Klassen, die Standardfunktionalitäten enthalten. Bei BIBLIO handelt es sich nicht um ein Paket, da jeder auf diese Funktionalitäten ohne eine weitere Schnittstellenklasse zugreifen darf." /begin SUB_FUNCTION BIB_ENTW_DIAG BIB_FUNKTION /end SUB_FUNCTION /end FUNCTION
/begin FUNCTION BIH "Das Paket BIH enthält alle Klassen und Funktionalitäten, welche für die Signalaufbereitung der Komponentenschnittstellen notwendig sind." /begin SUB_FUNCTION BIH_HILFSMODULE /end SUB_FUNCTION /end FUNCTION
/begin FUNCTION BIH_HILFSMODULE "In BIH_HILFSMODULE sind Hilffunktionen zur Berechung der Schnittstellen enthalten"
 /begin IN_MEASUREMENT iBihMobef.counter_meschlupf iBihMobef.f_rganglimitaktiv iBihMobef.fl_meschlupfaktiv iBihMobef.flag_meschlupf iBihMobef.m_getrmax_schlupf iBihMobef.m_motmax_getr iBihMobef.m_motmax_getr_alt iBihMobef.m_motmax_getr_neu iBihMobef.m_motmax_stall iBihMobef.m_motmax_strang iBihMobef.m_t_meschlupfaktiv iBihMobef.me_abs iBihMobef.me_diff iBihMobef.nd_synmmotmax iBihMobef.nd_synschutz iBihMobef.timer16_meuw iBihMobef.timer_m_motmax_schlupf_aktiv iBihMobef.timer_metot iBihMobef.timer_ndsynme iBihMobef.timer_notlaufsprung iBihMobef.timer_ra_m_motmax iBihMobef.timer_ra_m_motmax_schlupf iBihMobef.timer_vstall iBihMobef.z_m_motmax_kor_strang iBihMobef.z_m_motmax_schlupf iBihMomen.Pt1MPuAuf.x iBihMomen.TimerK0Verlust.time iBihMomen.m_ab_dyn iBihMomen.m_getrauf iBihMomen.m_getrverl iBihMomen.m_puauf iBihMomen.md_motsollist iBihMomen.n_mot_pu iBihMomen.n_tsynist iBihMomen.n_tsynziel iBihMomen.z_t_mverl_k0 iBihPumpendruck.f_evt_pumpendruck_motor iBihPumpendruck.f_evt_pumpendruck_turbine iBihPumpendruck.f_pumpendruck_motor iBihPumpendruck.f_sfkt_pumpendruck_aktiv iBihPumpendruck.z_pumpendruck iBihSigna.bremsbed iBihSigna.bremsbed_ofstb iBihSigna.c_maxhotmode iBihSigna.steigung_hang_filter iBihSigna.timer_neigung iBihSigna.timer_sollgang_pruefung /end IN_MEASUREMENT
/end FUNCTION
/begin FUNCTION dAdaGlast_Fktn "Applikationesgroessen der Komponente dAdaGlast" /begin SUB_FUNCTION jAdaGlast_Fktn /end SUB_FUNCTION /end FUNCTION
/begin FUNCTION dAdaGlastHSP_Fktn "Applikationesgroessen der Komponente dAdaGlastHSP"
 /begin SUB_FUNCTION jAdaGlastHSP112_Fktn jAdaGlastHSP123_Fktn jAdaGlastHSP134_Fktn jAdaGlastHSP145_Fktn jAdaGlastHSP156_Fktn jAdaGlastHSP167_Fktn jAdaGlastHSP178_Fktn jAdaGlastHSP212_Fktn jAdaGlastHSP223_Fktn jAdaGlastHSP234_Fktn jAdaGlastHSP245_Fktn jAdaGlastHSP256_Fktn jAdaGlastHSP267_Fktn jAdaGlastHSP278_Fktn /end SUB_FUNCTION
/end FUNCTION
/begin FUNCTION dAdaGlastRSP_Fktn "Applikationesgroessen der Komponente dAdaGlastRSP"
 /begin SUB_FUNCTION jAdaGlastRSP121_Fktn jAdaGlastRSP132_Fktn jAdaGlastRSP143_Fktn jAdaGlastRSP154_Fktn jAdaGlastRSP165_Fktn jAdaGlastRSP176_Fktn jAdaGlastRSP187_Fktn jAdaGlastRSP221_Fktn jAdaGlastRSP232_Fktn jAdaGlastRSP243_Fktn jAdaGlastRSP254_Fktn jAdaGlastRSP265_Fktn jAdaGlastRSP276_Fktn jAdaGlastRSP287_Fktn jAdaGlastRSP231_Fktn jAdaGlastRSP242_Fktn jAdaGlastRSP251_Fktn jAdaGlastRSP253_Fktn jAdaGlastRSP263_Fktn jAdaGlastRSP264_Fktn jAdaGlastRSP271_Fktn jAdaGlastRSP275_Fktn jAdaGlastRSP282_Fktn jAdaGlastRSP284_Fktn jAdaGlastRSP286_Fktn jAdaGlastRSP331_Fktn jAdaGlastRSP342_Fktn jAdaGlastRSP351_Fktn jAdaGlastRSP353_Fktn jAdaGlastRSP363_Fktn jAdaGlastRSP364_Fktn jAdaGlastRSP371_Fktn jAdaGlastRSP375_Fktn jAdaGlastRSP382_Fktn jAdaGlastRSP384_Fktn jAdaGlastRSP386_Fktn /end SUB_FUNCTION
/end FUNCTION
/begin FUNCTION dAdaGloku_Fktn "Applikationesgroessen der Komponente dAdaGloku" /begin SUB_FUNCTION jAdaGloku_Fktn /end SUB_FUNCTION /end FUNCTION
/begin FUNCTION dAdaGlokuK_Fktn "Applikationesgroessen der Komponente dAdaGlokuK"
 /begin SUB_FUNCTION jAdaGlokuKA_Fktn jAdaGlokuKB_Fktn jAdaGlokuKC_Fktn jAdaGlokuKD_Fktn jAdaGlokuKE_Fktn jAdaGlokuKK0_Fktn /end SUB_FUNCTION
/end FUNCTION
/begin FUNCTION dAdaGlosc_Fktn "Applikationesgroessen der Komponente dAdaGlosc" /begin SUB_FUNCTION jAdaGlosc_Fktn /end SUB_FUNCTION /end FUNCTION
/begin FUNCTION dAdaIaeap_Fktn "Applikationesgroessen der Komponente dAdaIaeap" /begin SUB_FUNCTION jAdaIaeap_Fktn /end SUB_FUNCTION /end FUNCTION
/begin FUNCTION dAdaIaeuf_Fktn "Applikationesgroessen der Komponente dAdaIaeuf" /begin SUB_FUNCTION jAdaIaeuf_Fktn /end SUB_FUNCTION /end FUNCTION
/begin FUNCTION dAdaPfusf_Fktn "Applikationesgroessen der Komponente dAdaPfusf" /begin SUB_FUNCTION jAdaPfusf_Fktn /end SUB_FUNCTION /end FUNCTION
/begin FUNCTION dAdaPfusfEHS_Fktn "Applikationesgroessen der Komponente dAdaPfusfEHS"
 /begin SUB_FUNCTION jAdaPfusfEHS12_Fktn jAdaPfusfEHS23_Fktn jAdaPfusfEHS34_Fktn jAdaPfusfEHS45_Fktn jAdaPfusfEHS56_Fktn jAdaPfusfEHS67_Fktn jAdaPfusfEHS78_Fktn /end SUB_FUNCTION
/end FUNCTION
/begin FUNCTION dAdaPfusfERS_Fktn "Applikationesgroessen der Komponente dAdaPfusfERS"
 /begin SUB_FUNCTION jAdaPfusfERS21_Fktn jAdaPfusfERS32_Fktn jAdaPfusfERS43_Fktn jAdaPfusfERS54_Fktn jAdaPfusfERS65_Fktn jAdaPfusfERS76_Fktn jAdaPfusfERS87_Fktn /end SUB_FUNCTION
/end FUNCTION
/begin FUNCTION dAdaPstbwX_Fktn "Applikationesgroessen der Komponente dAdaPstbwX" /begin SUB_FUNCTION jAdaPstbwXSF_Fktn jAdaPstbwXPF_Fktn /end SUB_FUNCTION /end FUNCTION
/begin FUNCTION dAdaPstpf_Fktn "Applikationesgroessen der Komponente dAdaPstpf" /begin SUB_FUNCTION jAdaPstpf_Fktn /end SUB_FUNCTION /end FUNCTION
/begin FUNCTION dAdaPstpfK_Fktn "Applikationesgroessen der Komponente dAdaPstpfK"
 /begin SUB_FUNCTION jAdaPstpfKA_Fktn jAdaPstpfKB_Fktn jAdaPstpfKC_Fktn jAdaPstpfKD_Fktn jAdaPstpfKE_Fktn jAdaPstpfKK0_Fktn /end SUB_FUNCTION
/end FUNCTION
/begin FUNCTION dAdaPstsf_Fktn "Applikationesgroessen der Komponente dAdaPstsf" /begin SUB_FUNCTION jAdaPstsf_Fktn /end SUB_FUNCTION /end FUNCTION
/begin FUNCTION dAdaPstsfK_Fktn "Applikationesgroessen der Komponente dAdaPstsfK"
 /begin SUB_FUNCTION jAdaPstsfKA_Fktn jAdaPstsfKB_Fktn jAdaPstsfKC_Fktn jAdaPstsfKD_Fktn jAdaPstsfKE_Fktn jAdaPstsfKK0_Fktn /end SUB_FUNCTION
/end FUNCTION
/begin FUNCTION dAdaPstzs_Fktn "Applikationesgroessen der Komponente dAdaPstzs" /begin SUB_FUNCTION jAdaPstzs_Fktn /end SUB_FUNCTION /end FUNCTION
/begin FUNCTION dAdaPstzsK_Fktn "Applikationesgroessen der Komponente dAdaPstzsK"
 /begin SUB_FUNCTION jAdaPstzsKA_Fktn jAdaPstzsKB_Fktn jAdaPstzsKC_Fktn jAdaPstzsKD_Fktn jAdaPstzsKE_Fktn jAdaPstzsKK0_Fktn /end SUB_FUNCTION
/end FUNCTION
/begin FUNCTION dAdaPulbwX_Fktn "Applikationesgroessen der Komponente dAdaPulbwX" /begin SUB_FUNCTION jAdaPulbwXSF_Fktn jAdaPulbwXPF_Fktn /end SUB_FUNCTION /end FUNCTION
/begin FUNCTION dAdaPulpf_Fktn "Applikationesgroessen der Komponente dAdaPulpf" /begin SUB_FUNCTION jAdaPulpf_Fktn /end SUB_FUNCTION /end FUNCTION
/begin FUNCTION dAdaPulpfK_Fktn "Applikationesgroessen der Komponente dAdaPulpfK"
 /begin SUB_FUNCTION jAdaPulpfKA_Fktn jAdaPulpfKB_Fktn jAdaPulpfKC_Fktn jAdaPulpfKD_Fktn jAdaPulpfKE_Fktn jAdaPulpfKK0_Fktn /end SUB_FUNCTION
/end FUNCTION
/begin FUNCTION dAdaPulsf_Fktn "Applikationesgroessen der Komponente dAdaPulsf" /begin SUB_FUNCTION jAdaPulsf_Fktn /end SUB_FUNCTION /end FUNCTION
/begin FUNCTION dAdaPulsfK_Fktn "Applikationesgroessen der Komponente dAdaPulsfK"
 /begin SUB_FUNCTION jAdaPulsfKA_Fktn jAdaPulsfKB_Fktn jAdaPulsfKC_Fktn jAdaPulsfKD_Fktn jAdaPulsfKE_Fktn jAdaPulsfKK0_Fktn /end SUB_FUNCTION
/end FUNCTION
/begin FUNCTION dAdaPulzs_Fktn "Applikationesgroessen der Komponente dAdaPulzs" /begin SUB_FUNCTION jAdaPulzs_Fktn /end SUB_FUNCTION /end FUNCTION
/begin FUNCTION dAdaPulzsK_Fktn "Applikationesgroessen der Komponente dAdaPulzsK"
 /begin SUB_FUNCTION jAdaPulzsKA_Fktn jAdaPulzsKB_Fktn jAdaPulzsKC_Fktn jAdaPulzsKD_Fktn jAdaPulzsKE_Fktn jAdaPulzsKK0_Fktn /end SUB_FUNCTION
/end FUNCTION
/begin FUNCTION dAdaUrlufterk_Fktn "Applikationesgroessen der Komponente dAdaUrlufterk" /begin SUB_FUNCTION jAdaUrlufterk_Fktn /end SUB_FUNCTION /end FUNCTION
/begin FUNCTION dAdaUrlufterkPuls_Fktn "Applikationesgroessen der Komponente dAdaUrlufterkPuls" /begin SUB_FUNCTION jAdaUrlufterkPuls_Fktn /end SUB_FUNCTION /end FUNCTION
/begin FUNCTION dAdaUrlufterkSchaltung_Fktn "Applikationesgroessen der Komponente dAdaUrlufterkSchaltung" /begin SUB_FUNCTION jAdaUrlufterkSchaltung_Fktn /end SUB_FUNCTION /end FUNCTION
/begin FUNCTION dAzsGangb_Fktn "Applikationesgroessen der Komponente dAzsGangb" /begin SUB_FUNCTION jAzsGangb_Fktn /end SUB_FUNCTION /end FUNCTION
/begin FUNCTION dAzsManko_Fktn "Applikationesgroessen der Komponente dAzsManko" /begin SUB_FUNCTION jAzsManko_Fktn /end SUB_FUNCTION /end FUNCTION
/begin FUNCTION dBibAglex_Fktn "Applikationesgroessen der Komponente dBibAglex" /begin SUB_FUNCTION jBibAglex_Fktn /end SUB_FUNCTION /end FUNCTION
/begin FUNCTION dBihDrehz_Fktn "Applikationesgroessen der Komponente dBihDrehz" /begin SUB_FUNCTION jBihDrehz_Fktn /end SUB_FUNCTION /end FUNCTION
/begin FUNCTION dBihHydra_Fktn "Applikationesgroessen der Komponente dBihHydra" /begin SUB_FUNCTION jBihHydra_Fktn /end SUB_FUNCTION /end FUNCTION
/begin FUNCTION dBihMobef_Fktn "Applikationesgroessen der Komponente dBihMobef" /begin SUB_FUNCTION jBihMobef_Fktn /end SUB_FUNCTION /end FUNCTION
/begin FUNCTION dBihMobefG_Fktn "Applikationesgroessen der Komponente dBihMobefG"
 /begin SUB_FUNCTION jBihMobefGR_Fktn jBihMobefG1_Fktn jBihMobefG2_Fktn jBihMobefG3_Fktn jBihMobefG4_Fktn jBihMobefG5_Fktn jBihMobefG6_Fktn jBihMobefG7_Fktn jBihMobefG8_Fktn /end SUB_FUNCTION
/end FUNCTION
/begin FUNCTION dBihMomen_Fktn "Applikationesgroessen der Komponente dBihMomen" /begin SUB_FUNCTION jBihMomen_Fktn /end SUB_FUNCTION /end FUNCTION
/begin FUNCTION dBihMomenG_Fktn "Applikationesgroessen der Komponente dBihMomenG"
 /begin SUB_FUNCTION jBihMomenGR_Fktn jBihMomenG1_Fktn jBihMomenG2_Fktn jBihMomenG3_Fktn jBihMomenG4_Fktn jBihMomenG5_Fktn jBihMomenG6_Fktn jBihMomenG7_Fktn jBihMomenG8_Fktn /end SUB_FUNCTION
/end FUNCTION
/begin FUNCTION dBihSigna_Fktn "Applikationesgroessen der Komponente dBihSigna" /begin SUB_FUNCTION jBihSigna_Fktn /end SUB_FUNCTION /end FUNCTION
/begin FUNCTION dBihSignaG_Fktn "Applikationesgroessen der Komponente dBihSignaG"
 /begin SUB_FUNCTION jBihSignaGR_Fktn jBihSignaG1_Fktn jBihSignaG2_Fktn jBihSignaG3_Fktn jBihSignaG4_Fktn jBihSignaG5_Fktn jBihSignaG6_Fktn jBihSignaG7_Fktn jBihSignaG8_Fktn /end SUB_FUNCTION
/end FUNCTION
/begin FUNCTION dData_zf_SAB2_EngineInterventionMonitoringOut_Fktn "Calibration values of the Component dData_zf_SAB2_EngineInterventionMonitoringOut" /begin SUB_FUNCTION jData_zf_SAB2_EngineInterventionMonitoringOut_Fktn /end SUB_FUNCTION /end FUNCTION
/begin FUNCTION dData_zf_SAB2_EngineInterventionOut_Fktn "Calibration values of the Component dData_zf_SAB2_EngineInterventionOut" /begin SUB_FUNCTION jData_zf_SAB2_EngineInterventionOut_Fktn /end SUB_FUNCTION /end FUNCTION
/begin FUNCTION dData_zf_SAB2_ErrorEntryOut_Fktn "Calibration values of the Component dData_zf_SAB2_ErrorEntryOut" /begin SUB_FUNCTION jData_zf_SAB2_ErrorEntryOut_Fktn /end SUB_FUNCTION /end FUNCTION
/begin FUNCTION dData_zf_SAB2_GearboxReinforcementOut_Fktn "Calibration values of the Component dData_zf_SAB2_GearboxReinforcementOut" /begin SUB_FUNCTION jData_zf_SAB2_GearboxReinforcementOut_Fktn /end SUB_FUNCTION /end FUNCTION
/begin FUNCTION dData_zf_SAB2_GearboxTorqueOut_Fktn "Calibration values of the Component dData_zf_SAB2_GearboxTorqueOut" /begin SUB_FUNCTION jData_zf_SAB2_GearboxTorqueOut_Fktn /end SUB_FUNCTION /end FUNCTION
/begin FUNCTION dData_zf_SAB2_HybridSignalsOut_Fktn "Calibration values of the Component dData_zf_SAB2_HybridSignalsOut" /begin SUB_FUNCTION jData_zf_SAB2_HybridSignalsOut_Fktn /end SUB_FUNCTION /end FUNCTION
/begin FUNCTION dData_zf_SAB2_PumpIntakeTorqueOut_Fktn "Calibration values of the Component dData_zf_SAB2_PumpIntakeTorqueOut" /begin SUB_FUNCTION jData_zf_SAB2_PumpIntakeTorqueOut_Fktn /end SUB_FUNCTION /end FUNCTION
/begin FUNCTION dData_zf_SAB2_ShiftingActiveOut_Fktn "Calibration values of the Component dData_zf_SAB2_ShiftingActiveOut" /begin SUB_FUNCTION jData_zf_SAB2_ShiftingActiveOut_Fktn /end SUB_FUNCTION /end FUNCTION
/begin FUNCTION dData_zf_SAB2_TorqueConverterOut_Fktn "Calibration values of the Component dData_zf_SAB2_TorqueConverterOut" /begin SUB_FUNCTION jData_zf_SAB2_TorqueConverterOut_Fktn /end SUB_FUNCTION /end FUNCTION
/begin FUNCTION dData_zf_SAB_ActuatorSignalsIn_Fktn "Calibration values of the Component dData_zf_SAB_ActuatorSignalsIn" /begin SUB_FUNCTION jData_zf_SAB_ActuatorSignalsIn_Fktn /end SUB_FUNCTION /end FUNCTION
/begin FUNCTION dData_zf_SAB_AzgDriver_Fktn "Calibration values of the Component dData_zf_SAB_AzgDriver" /begin SUB_FUNCTION jData_zf_SAB_AzgDriver_Fktn /end SUB_FUNCTION /end FUNCTION
/begin FUNCTION dData_zf_SAB_BackToNormalFunctionViaReset_Fktn "Calibration values of the Component dData_zf_SAB_BackToNormalFunctionViaReset" /begin SUB_FUNCTION jData_zf_SAB_BackToNormalFunctionViaReset_Fktn /end SUB_FUNCTION /end FUNCTION
/begin FUNCTION dData_zf_SAB_BootJump_Fktn "Calibration values of the Component dData_zf_SAB_BootJump" /begin SUB_FUNCTION jData_zf_SAB_BootJump_Fktn /end SUB_FUNCTION /end FUNCTION
/begin FUNCTION dData_zf_SAB_BrakePedalIn_Fktn "Calibration values of the Component dData_zf_SAB_BrakePedalIn" /begin SUB_FUNCTION jData_zf_SAB_BrakePedalIn_Fktn /end SUB_FUNCTION /end FUNCTION
/begin FUNCTION dData_zf_SAB_BrakeTorqueIn_Fktn "Calibration values of the Component dData_zf_SAB_BrakeTorqueIn" /begin SUB_FUNCTION jData_zf_SAB_BrakeTorqueIn_Fktn /end SUB_FUNCTION /end FUNCTION
/begin FUNCTION dData_zf_SAB_CAN_Handling_Fktn "Calibration values of the Component dData_zf_SAB_CAN_Handling" /begin SUB_FUNCTION jData_zf_SAB_CAN_Handling_Fktn /end SUB_FUNCTION /end FUNCTION
/begin FUNCTION dData_zf_SAB_CAN_SwitchingIn_Fktn "Calibration values of the Component dData_zf_SAB_CAN_SwitchingIn" /begin SUB_FUNCTION jData_zf_SAB_CAN_SwitchingIn_Fktn /end SUB_FUNCTION /end FUNCTION
/begin FUNCTION dData_zf_SAB_Coding_Fktn "Calibration values of the Component dData_zf_SAB_Coding" /begin SUB_FUNCTION jData_zf_SAB_Coding_Fktn /end SUB_FUNCTION /end FUNCTION
/begin FUNCTION dData_zf_SAB_ComConditionsIn_Fktn "Calibration values of the Component dData_zf_SAB_ComConditionsIn" /begin SUB_FUNCTION jData_zf_SAB_ComConditionsIn_Fktn /end SUB_FUNCTION /end FUNCTION
/begin FUNCTION dData_zf_SAB_CrankShaftCurTorqueIn_Fktn "Calibration values of the Component dData_zf_SAB_CrankShaftCurTorqueIn" /begin SUB_FUNCTION jData_zf_SAB_CrankShaftCurTorqueIn_Fktn /end SUB_FUNCTION /end FUNCTION
/begin FUNCTION dData_zf_SAB_DesiredTorqueIn_Fktn "Calibration values of the Component dData_zf_SAB_DesiredTorqueIn" /begin SUB_FUNCTION jData_zf_SAB_DesiredTorqueIn_Fktn /end SUB_FUNCTION /end FUNCTION
/begin FUNCTION dData_zf_SAB_DoorStatusIn_Fktn "Calibration values of the Component dData_zf_SAB_DoorStatusIn" /begin SUB_FUNCTION jData_zf_SAB_DoorStatusIn_Fktn /end SUB_FUNCTION /end FUNCTION
/begin FUNCTION dData_zf_SAB_DriverSeatStatusIn_Fktn "Calibration values of the Component dData_zf_SAB_DriverSeatStatusIn" /begin SUB_FUNCTION jData_zf_SAB_DriverSeatStatusIn_Fktn /end SUB_FUNCTION /end FUNCTION
/begin FUNCTION dData_zf_SAB_DrivingDirectionIn_Fktn "Calibration values of the Component dData_zf_SAB_DrivingDirectionIn" /begin SUB_FUNCTION jData_zf_SAB_DrivingDirectionIn_Fktn /end SUB_FUNCTION /end FUNCTION
/begin FUNCTION dData_zf_SAB_EEpromZentralHandler_Fktn "Calibration values of the Component dData_zf_SAB_EEpromZentralHandler" /begin SUB_FUNCTION jData_zf_SAB_EEpromZentralHandler_Fktn /end SUB_FUNCTION /end FUNCTION
/begin FUNCTION dData_zf_SAB_EmergencyGearInfo_Fktn "Calibration values of the Component dData_zf_SAB_EmergencyGearInfo" /begin SUB_FUNCTION jData_zf_SAB_EmergencyGearInfo_Fktn /end SUB_FUNCTION /end FUNCTION
/begin FUNCTION dData_zf_SAB_EngineCoolantTempIn_Fktn "Calibration values of the Component dData_zf_SAB_EngineCoolantTempIn" /begin SUB_FUNCTION jData_zf_SAB_EngineCoolantTempIn_Fktn /end SUB_FUNCTION /end FUNCTION
/begin FUNCTION dData_zf_SAB_EngineIdleSpeedReqIn_Fktn "Calibration values of the Component dData_zf_SAB_EngineIdleSpeedReqIn" /begin SUB_FUNCTION jData_zf_SAB_EngineIdleSpeedReqIn_Fktn /end SUB_FUNCTION /end FUNCTION
/begin FUNCTION dData_zf_SAB_EngineSignalDiagnosis_Fktn "Calibration values of the Component dData_zf_SAB_EngineSignalDiagnosis" /begin SUB_FUNCTION jData_zf_SAB_EngineSignalDiagnosis_Fktn /end SUB_FUNCTION /end FUNCTION
/begin FUNCTION dData_zf_SAB_EngineSpeedIn_Fktn "Calibration values of the Component dData_zf_SAB_EngineSpeedIn" /begin SUB_FUNCTION jData_zf_SAB_EngineSpeedIn_Fktn /end SUB_FUNCTION /end FUNCTION
/begin FUNCTION dData_zf_SAB_EngineSpeedRedIn_Fktn "Calibration values of the Component dData_zf_SAB_EngineSpeedRedIn" /begin SUB_FUNCTION jData_zf_SAB_EngineSpeedRedIn_Fktn /end SUB_FUNCTION /end FUNCTION
/begin FUNCTION dData_zf_SAB_EngineTorqueIn_Fktn "Calibration values of the Component dData_zf_SAB_EngineTorqueIn" /begin SUB_FUNCTION jData_zf_SAB_EngineTorqueIn_Fktn /end SUB_FUNCTION /end FUNCTION
/begin FUNCTION dData_zf_SAB_ExtBrakeInterventionIn_Fktn "Calibration values of the Component dData_zf_SAB_ExtBrakeInterventionIn" /begin SUB_FUNCTION jData_zf_SAB_ExtBrakeInterventionIn_Fktn /end SUB_FUNCTION /end FUNCTION
/begin FUNCTION dData_zf_SAB_FpDkVpIn_Fktn "Calibration values of the Component dData_zf_SAB_FpDkVpIn" /begin SUB_FUNCTION jData_zf_SAB_FpDkVpIn_Fktn /end SUB_FUNCTION /end FUNCTION
/begin FUNCTION dData_zf_SAB_GearBoxState_Fktn "Calibration values of the Component dData_zf_SAB_GearBoxState" /begin SUB_FUNCTION jData_zf_SAB_GearBoxState_Fktn /end SUB_FUNCTION /end FUNCTION
/begin FUNCTION dData_zf_SAB_GearboxTempIn_Fktn "Calibration values of the Component dData_zf_SAB_GearboxTempIn" /begin SUB_FUNCTION jData_zf_SAB_GearboxTempIn_Fktn /end SUB_FUNCTION /end FUNCTION
/begin FUNCTION dData_zf_SAB_GearLeverDiagnosis_Fktn "Calibration values of the Component dData_zf_SAB_GearLeverDiagnosis" /begin SUB_FUNCTION jData_zf_SAB_GearLeverDiagnosis_Fktn /end SUB_FUNCTION /end FUNCTION
/begin FUNCTION dData_zf_SAB_GearLeverIn_Fktn "Calibration values of the Component dData_zf_SAB_GearLeverIn" /begin SUB_FUNCTION jData_zf_SAB_GearLeverIn_Fktn /end SUB_FUNCTION /end FUNCTION
/begin FUNCTION dData_zf_SAB_GearLimitation_Fktn "Calibration values of the Component dData_zf_SAB_GearLimitation" /begin SUB_FUNCTION jData_zf_SAB_GearLimitation_Fktn /end SUB_FUNCTION /end FUNCTION
/begin FUNCTION dData_zf_SAB_GearRatioByCurrents_Fktn "Calibration values of the Component dData_zf_SAB_GearRatioByCurrents" /begin SUB_FUNCTION jData_zf_SAB_GearRatioByCurrents_Fktn /end SUB_FUNCTION /end FUNCTION
/begin FUNCTION dData_zf_SAB_HybridGearboxReadyToDriveIn_Fktn "Calibration values of the Component dData_zf_SAB_HybridGearboxReadyToDriveIn" /begin SUB_FUNCTION jData_zf_SAB_HybridGearboxReadyToDriveIn_Fktn /end SUB_FUNCTION /end FUNCTION
/begin FUNCTION dData_zf_SAB_HybridVehicleReadyToDriveIn_Fktn "Calibration values of the Component dData_zf_SAB_HybridVehicleReadyToDriveIn" /begin SUB_FUNCTION jData_zf_SAB_HybridVehicleReadyToDriveIn_Fktn /end SUB_FUNCTION /end FUNCTION
/begin FUNCTION dData_zf_SAB_IgnitionStatusIn_Fktn "Calibration values of the Component dData_zf_SAB_IgnitionStatusIn" /begin SUB_FUNCTION jData_zf_SAB_IgnitionStatusIn_Fktn /end SUB_FUNCTION /end FUNCTION
/begin FUNCTION dData_zf_SAB_InclinationIn_Fktn "Calibration values of the Component dData_zf_SAB_InclinationIn" /begin SUB_FUNCTION jData_zf_SAB_InclinationIn_Fktn /end SUB_FUNCTION /end FUNCTION
/begin FUNCTION dData_zf_SAB_LayerAGS_Fktn "Calibration values of the Component dData_zf_SAB_LayerAGS" /begin SUB_FUNCTION jData_zf_SAB_LayerAGS_Fktn /end SUB_FUNCTION /end FUNCTION
/begin FUNCTION dData_zf_SAB_MSAIn_Fktn "Calibration values of the Component dData_zf_SAB_MSAIn" /begin SUB_FUNCTION jData_zf_SAB_MSAIn_Fktn /end SUB_FUNCTION /end FUNCTION
/begin FUNCTION dData_zf_SAB_OBD_CyclesIn_Fktn "Calibration values of the Component dData_zf_SAB_OBD_CyclesIn" /begin SUB_FUNCTION jData_zf_SAB_OBD_CyclesIn_Fktn /end SUB_FUNCTION /end FUNCTION
/begin FUNCTION dData_zf_SAB_OSModeSwitchingOut_Fktn "Calibration values of the Component dData_zf_SAB_OSModeSwitchingOut" /begin SUB_FUNCTION jData_zf_SAB_OSModeSwitchingOut_Fktn /end SUB_FUNCTION /end FUNCTION
/begin FUNCTION dData_zf_SAB_ParklockSensorIn_Fktn "Calibration values of the Component dData_zf_SAB_ParklockSensorIn" /begin SUB_FUNCTION jData_zf_SAB_ParklockSensorIn_Fktn /end SUB_FUNCTION /end FUNCTION
/begin FUNCTION dData_zf_SAB_ParkManeuverAssistant_Fktn "Calibration values of the Component dData_zf_SAB_ParkManeuverAssistant" /begin SUB_FUNCTION jData_zf_SAB_ParkManeuverAssistant_Fktn /end SUB_FUNCTION /end FUNCTION
/begin FUNCTION dData_zf_SAB_PMA_ErrorHandling_Fktn "Calibration values of the Component dData_zf_SAB_PMA_ErrorHandling" /begin SUB_FUNCTION jData_zf_SAB_PMA_ErrorHandling_Fktn /end SUB_FUNCTION /end FUNCTION
/begin FUNCTION dData_zf_SAB_PowerdownIn_Fktn "Calibration values of the Component dData_zf_SAB_PowerdownIn" /begin SUB_FUNCTION jData_zf_SAB_PowerdownIn_Fktn /end SUB_FUNCTION /end FUNCTION
/begin FUNCTION dData_zf_SAB_ReadECUIdentification_Fktn "Calibration values of the Component dData_zf_SAB_ReadECUIdentification" /begin SUB_FUNCTION jData_zf_SAB_ReadECUIdentification_Fktn /end SUB_FUNCTION /end FUNCTION
/begin FUNCTION dData_zf_SAB_RearAxleRatioIn_Fktn "Calibration values of the Component dData_zf_SAB_RearAxleRatioIn" /begin SUB_FUNCTION jData_zf_SAB_RearAxleRatioIn_Fktn /end SUB_FUNCTION /end FUNCTION
/begin FUNCTION dData_zf_SAB_RollPreventIn_Fktn "Calibration values of the Component dData_zf_SAB_RollPreventIn" /begin SUB_FUNCTION jData_zf_SAB_RollPreventIn_Fktn /end SUB_FUNCTION /end FUNCTION
/begin FUNCTION dData_zf_SAB_RoutineControl_UDS_Fktn "Calibration values of the Component dData_zf_SAB_RoutineControl_UDS" /begin SUB_FUNCTION jData_zf_SAB_RoutineControl_UDS_Fktn /end SUB_FUNCTION /end FUNCTION
/begin FUNCTION dData_zf_SAB_RPM_Diagnosis_Fktn "Calibration values of the Component dData_zf_SAB_RPM_Diagnosis" /begin SUB_FUNCTION jData_zf_SAB_RPM_Diagnosis_Fktn /end SUB_FUNCTION /end FUNCTION
/begin FUNCTION dData_zf_SAB_RPM_SensingIn_Fktn "Calibration values of the Component dData_zf_SAB_RPM_SensingIn" /begin SUB_FUNCTION jData_zf_SAB_RPM_SensingIn_Fktn /end SUB_FUNCTION /end FUNCTION
/begin FUNCTION dData_zf_SAB_SensorSupplyMonitoring_Fktn "Calibration values of the Component dData_zf_SAB_SensorSupplyMonitoring" /begin SUB_FUNCTION jData_zf_SAB_SensorSupplyMonitoring_Fktn /end SUB_FUNCTION /end FUNCTION
/begin FUNCTION dData_zf_SAB_SpeedPlausibilityIn_Fktn "Calibration values of the Component dData_zf_SAB_SpeedPlausibilityIn" /begin SUB_FUNCTION jData_zf_SAB_SpeedPlausibilityIn_Fktn /end SUB_FUNCTION /end FUNCTION
/begin FUNCTION dData_zf_SAB_SportButtonIn_Fktn "Calibration values of the Component dData_zf_SAB_SportButtonIn" /begin SUB_FUNCTION jData_zf_SAB_SportButtonIn_Fktn /end SUB_FUNCTION /end FUNCTION
/begin FUNCTION dData_zf_SAB_SubstTempIn_Fktn "Calibration values of the Component dData_zf_SAB_SubstTempIn" /begin SUB_FUNCTION jData_zf_SAB_SubstTempIn_Fktn /end SUB_FUNCTION /end FUNCTION
/begin FUNCTION dData_zf_SAB_TempDiagnosis_Fktn "Calibration values of the Component dData_zf_SAB_TempDiagnosis" /begin SUB_FUNCTION jData_zf_SAB_TempDiagnosis_Fktn /end SUB_FUNCTION /end FUNCTION
/begin FUNCTION dData_zf_SAB_TimeEGSOffIn_Fktn "Calibration values of the Component dData_zf_SAB_TimeEGSOffIn" /begin SUB_FUNCTION jData_zf_SAB_TimeEGSOffIn_Fktn /end SUB_FUNCTION /end FUNCTION
/begin FUNCTION dData_zf_SAB_TipTasterIn_Fktn "Calibration values of the Component dData_zf_SAB_TipTasterIn" /begin SUB_FUNCTION jData_zf_SAB_TipTasterIn_Fktn /end SUB_FUNCTION /end FUNCTION
/begin FUNCTION dData_zf_SAB_TorqueReserveIn_Fktn "Calibration values of the Component dData_zf_SAB_TorqueReserveIn" /begin SUB_FUNCTION jData_zf_SAB_TorqueReserveIn_Fktn /end SUB_FUNCTION /end FUNCTION
/begin FUNCTION dData_zf_SAB_TransmissionOutputSpeedIn_Fktn "Calibration values of the Component dData_zf_SAB_TransmissionOutputSpeedIn" /begin SUB_FUNCTION jData_zf_SAB_TransmissionOutputSpeedIn_Fktn /end SUB_FUNCTION /end FUNCTION
/begin FUNCTION dData_zf_SAB_TurbineSpeedIn_Fktn "Calibration values of the Component dData_zf_SAB_TurbineSpeedIn" /begin SUB_FUNCTION jData_zf_SAB_TurbineSpeedIn_Fktn /end SUB_FUNCTION /end FUNCTION
/begin FUNCTION dData_zf_SAB_TurbineSpeedVirtualIn_Fktn "Calibration values of the Component dData_zf_SAB_TurbineSpeedVirtualIn" /begin SUB_FUNCTION jData_zf_SAB_TurbineSpeedVirtualIn_Fktn /end SUB_FUNCTION /end FUNCTION
/begin FUNCTION dData_zf_SAB_TurbineTorqueIn_Fktn "Calibration values of the Component dData_zf_SAB_TurbineTorqueIn" /begin SUB_FUNCTION jData_zf_SAB_TurbineTorqueIn_Fktn /end SUB_FUNCTION /end FUNCTION
/begin FUNCTION dData_zf_SAB_VehicleSpeedIn_Fktn "Calibration values of the Component dData_zf_SAB_VehicleSpeedIn" /begin SUB_FUNCTION jData_zf_SAB_VehicleSpeedIn_Fktn /end SUB_FUNCTION /end FUNCTION
/begin FUNCTION dData_zf_SAB_VoltageMonitoringOut_Fktn "Calibration values of the Component dData_zf_SAB_VoltageMonitoringOut" /begin SUB_FUNCTION jData_zf_SAB_VoltageMonitoringOut_Fktn /end SUB_FUNCTION /end FUNCTION
/begin FUNCTION dData_zf_SAB_WheelIn_Fktn "Calibration values of the Component dData_zf_SAB_WheelIn" /begin SUB_FUNCTION jData_zf_SAB_WheelIn_Fktn /end SUB_FUNCTION /end FUNCTION
/begin FUNCTION dData_zff_ABK_AUTOPOS_Fktn "Calibration values of the Component dData_zff_ABK_AUTOPOS" /begin SUB_FUNCTION jData_zff_ABK_AUTOPOS_Fktn /end SUB_FUNCTION /end FUNCTION
/begin FUNCTION dData_zff_ABK_CARWASHMODE_Fktn "Calibration values of the Component dData_zff_ABK_CARWASHMODE" /begin SUB_FUNCTION jData_zff_ABK_CARWASHMODE_Fktn /end SUB_FUNCTION /end FUNCTION
/begin FUNCTION dData_zff_ABK_CC_MSG_Fktn "Calibration values of the Component dData_zff_ABK_CC_MSG" /begin SUB_FUNCTION jData_zff_ABK_CC_MSG_Fktn /end SUB_FUNCTION /end FUNCTION
/begin FUNCTION dData_zff_ABK_DEBOUNCEDRVREQ_Fktn "Calibration values of the Component dData_zff_ABK_DEBOUNCEDRVREQ" /begin SUB_FUNCTION jData_zff_ABK_DEBOUNCEDRVREQ_Fktn /end SUB_FUNCTION /end FUNCTION
/begin FUNCTION dData_zff_ABK_DIAGPOS_Fktn "Calibration values of the Component dData_zff_ABK_DIAGPOS" /begin SUB_FUNCTION jData_zff_ABK_DIAGPOS_Fktn /end SUB_FUNCTION /end FUNCTION
/begin FUNCTION dData_zff_ABK_DRVPRESENCEDETECTOR_Fktn "Calibration values of the Component dData_zff_ABK_DRVPRESENCEDETECTOR" /begin SUB_FUNCTION jData_zff_ABK_DRVPRESENCEDETECTOR_Fktn /end SUB_FUNCTION /end FUNCTION
/begin FUNCTION dData_zff_ABK_ENGINESIGNALS_Fktn "Calibration values of the Component dData_zff_ABK_ENGINESIGNALS" /begin SUB_FUNCTION jData_zff_ABK_ENGINESIGNALS_Fktn /end SUB_FUNCTION /end FUNCTION
/begin FUNCTION dData_zff_ABK_EWS4_Fktn "Calibration values of the Component dData_zff_ABK_EWS4" /begin SUB_FUNCTION jData_zff_ABK_EWS4_Fktn /end SUB_FUNCTION /end FUNCTION
/begin FUNCTION dData_zff_ABK_FASREQ2POS_Fktn "Calibration values of the Component dData_zff_ABK_FASREQ2POS" /begin SUB_FUNCTION jData_zff_ABK_FASREQ2POS_Fktn /end SUB_FUNCTION /end FUNCTION
/begin FUNCTION dData_zff_ABK_KOMBI_MSG_Fktn "Calibration values of the Component dData_zff_ABK_KOMBI_MSG" /begin SUB_FUNCTION jData_zff_ABK_KOMBI_MSG_Fktn /end SUB_FUNCTION /end FUNCTION
/begin FUNCTION dData_zff_ABK_KOMBIMSGFLASH_Fktn "Calibration values of the Component dData_zff_ABK_KOMBIMSGFLASH" /begin SUB_FUNCTION jData_zff_ABK_KOMBIMSGFLASH_Fktn /end SUB_FUNCTION /end FUNCTION
/begin FUNCTION dData_zff_ABK_KOMBIMSGGEAR_Fktn "Calibration values of the Component dData_zff_ABK_KOMBIMSGGEAR" /begin SUB_FUNCTION jData_zff_ABK_KOMBIMSGGEAR_Fktn /end SUB_FUNCTION /end FUNCTION
/begin FUNCTION dData_zff_ABK_KOMBIMSGMODE_Fktn "Calibration values of the Component dData_zff_ABK_KOMBIMSGMODE" /begin SUB_FUNCTION jData_zff_ABK_KOMBIMSGMODE_Fktn /end SUB_FUNCTION /end FUNCTION
/begin FUNCTION dData_zff_ABK_KOMBIMSGPOS_Fktn "Calibration values of the Component dData_zff_ABK_KOMBIMSGPOS" /begin SUB_FUNCTION jData_zff_ABK_KOMBIMSGPOS_Fktn /end SUB_FUNCTION /end FUNCTION
/begin FUNCTION dData_zff_ABK_LEVEL2DIAG_Fktn "Calibration values of the Component dData_zff_ABK_LEVEL2DIAG" /begin SUB_FUNCTION jData_zff_ABK_LEVEL2DIAG_Fktn /end SUB_FUNCTION /end FUNCTION
/begin FUNCTION dData_zff_ABK_MODE_Fktn "Calibration values of the Component dData_zff_ABK_MODE" /begin SUB_FUNCTION jData_zff_ABK_MODE_Fktn /end SUB_FUNCTION /end FUNCTION
/begin FUNCTION dData_zff_ABK_MODECHTABLE_Fktn "Calibration values of the Component dData_zff_ABK_MODECHTABLE" /begin SUB_FUNCTION jData_zff_ABK_MODECHTABLE_Fktn /end SUB_FUNCTION /end FUNCTION
/begin FUNCTION dData_zff_ABK_MODEIN_Fktn "Calibration values of the Component dData_zff_ABK_MODEIN" /begin SUB_FUNCTION jData_zff_ABK_MODEIN_Fktn /end SUB_FUNCTION /end FUNCTION
/begin FUNCTION dData_zff_ABK_POS_INITPOS_Fktn "Calibration values of the Component dData_zff_ABK_POS_INITPOS" /begin SUB_FUNCTION jData_zff_ABK_POS_INITPOS_Fktn /end SUB_FUNCTION /end FUNCTION
/begin FUNCTION dData_zff_ABK_POWERDOWN_Fktn "Calibration values of the Component dData_zff_ABK_POWERDOWN" /begin SUB_FUNCTION jData_zff_ABK_POWERDOWN_Fktn /end SUB_FUNCTION /end FUNCTION
/begin FUNCTION dData_zff_ABK_RELTOABS_Fktn "Calibration values of the Component dData_zff_ABK_RELTOABS" /begin SUB_FUNCTION jData_zff_ABK_RELTOABS_Fktn /end SUB_FUNCTION /end FUNCTION
/begin FUNCTION dData_zff_ABK_SHIFTLOCK_Fktn "Calibration values of the Component dData_zff_ABK_SHIFTLOCK" /begin SUB_FUNCTION jData_zff_ABK_SHIFTLOCK_Fktn /end SUB_FUNCTION /end FUNCTION
/begin FUNCTION dData_zff_ABK_SIGCOND_Fktn "Calibration values of the Component dData_zff_ABK_SIGCOND" /begin SUB_FUNCTION jData_zff_ABK_SIGCOND_Fktn /end SUB_FUNCTION /end FUNCTION
/begin FUNCTION dData_zff_ABK_SIGNALS_Fktn "Calibration values of the Component dData_zff_ABK_SIGNALS" /begin SUB_FUNCTION jData_zff_ABK_SIGNALS_Fktn /end SUB_FUNCTION /end FUNCTION
/begin FUNCTION dData_zff_ABK_SrvcMsgHandler_Fktn "Calibration values of the Component dData_zff_ABK_SrvcMsgHandler" /begin SUB_FUNCTION jData_zff_ABK_SrvcMsgHandler_Fktn /end SUB_FUNCTION /end FUNCTION
/begin FUNCTION dData_zff_ABK_STARTERRELEASEDELAY_Fktn "Calibration values of the Component dData_zff_ABK_STARTERRELEASEDELAY" /begin SUB_FUNCTION jData_zff_ABK_STARTERRELEASEDELAY_Fktn /end SUB_FUNCTION /end FUNCTION
/begin FUNCTION dData_zff_ABK_STOREDRVREQ_Fktn "Calibration values of the Component dData_zff_ABK_STOREDRVREQ" /begin SUB_FUNCTION jData_zff_ABK_STOREDRVREQ_Fktn /end SUB_FUNCTION /end FUNCTION
/begin FUNCTION dData_zff_EH_CarbHandler_Fktn "Calibration values of the Component dData_zff_EH_CarbHandler" /begin SUB_FUNCTION jData_zff_EH_CarbHandler_Fktn /end SUB_FUNCTION /end FUNCTION
/begin FUNCTION dData_zff_EH_DemWrapper_Fktn "Calibration values of the Component dData_zff_EH_DemWrapper" /begin SUB_FUNCTION jData_zff_EH_DemWrapper_Fktn /end SUB_FUNCTION /end FUNCTION
/begin FUNCTION dData_zff_EH_DiagnosisControl_Fktn "Calibration values of the Component dData_zff_EH_DiagnosisControl" /begin SUB_FUNCTION jData_zff_EH_DiagnosisControl_Fktn /end SUB_FUNCTION /end FUNCTION
/begin FUNCTION dData_zff_EH_Erm_Fktn "Calibration values of the Component dData_zff_EH_Erm" /begin SUB_FUNCTION jData_zff_EH_Erm_Fktn /end SUB_FUNCTION /end FUNCTION
/begin FUNCTION dData_zff_EH_Obd_Fktn "Calibration values of the Component dData_zff_EH_Obd" /begin SUB_FUNCTION jData_zff_EH_Obd_Fktn /end SUB_FUNCTION /end FUNCTION
/begin FUNCTION dDiaRbmif_Fktn "Applikationesgroessen der Komponente dDiaRbmif" /begin SUB_FUNCTION jDiaRbmif_Fktn /end SUB_FUNCTION /end FUNCTION
/begin FUNCTION dIaeAdauf_Fktn "Applikationesgroessen der Komponente dIaeAdauf" /begin SUB_FUNCTION jIaeAdauf_Fktn /end SUB_FUNCTION /end FUNCTION
/begin FUNCTION dIaeAnfahEcoX_Fktn "Applikationesgroessen der Komponente dIaeAnfahEcoX"
 /begin SUB_FUNCTION jIaeAnfahEl_Fktn jIaeAnfahHy_Fktn jIaeAnfahElEco_Fktn jIaeAnfahHyEco_Fktn /end SUB_FUNCTION
/end FUNCTION
/begin FUNCTION dIaeAnfahX_Fktn "Applikationesgroessen der Komponente dIaeAnfahX" /begin SUB_FUNCTION jIaeAnfahE_Fktn jIaeAnfahH_Fktn /end SUB_FUNCTION /end FUNCTION
/begin FUNCTION dIaeDiagn_Fktn "Applikationesgroessen der Komponente dIaeDiagn" /begin SUB_FUNCTION jIaeDiagn_Fktn /end SUB_FUNCTION /end FUNCTION
/begin FUNCTION dIaeDraus_Fktn "Applikationesgroessen der Komponente dIaeDraus" /begin SUB_FUNCTION jIaeDraus_Fktn /end SUB_FUNCTION /end FUNCTION
/begin FUNCTION dIaeKordi_Fktn "Applikationesgroessen der Komponente dIaeKordi" /begin SUB_FUNCTION jIaeKordi_Fktn /end SUB_FUNCTION /end FUNCTION
/begin FUNCTION dIaeKuehl_Fktn "Applikationesgroessen der Komponente dIaeKuehl" /begin SUB_FUNCTION jIaeKuehl_Fktn /end SUB_FUNCTION /end FUNCTION
/begin FUNCTION dIaeMomen_Fktn "Applikationesgroessen der Komponente dIaeMomen" /begin SUB_FUNCTION jIaeMomen_Fktn /end SUB_FUNCTION /end FUNCTION
/begin FUNCTION dIaeMotmx_Fktn "Applikationesgroessen der Komponente dIaeMotmx" /begin SUB_FUNCTION jIaeMotmx_Fktn /end SUB_FUNCTION /end FUNCTION
/begin FUNCTION dIaeParaEcoX_Fktn "Applikationesgroessen der Komponente dIaeParaEcoX" /begin SUB_FUNCTION jIaeParaEco_Fktn jIaePara_Fktn /end SUB_FUNCTION /end FUNCTION
/begin FUNCTION dIaeSigna_Fktn "Applikationesgroessen der Komponente dIaeSigna" /begin SUB_FUNCTION jIaeSigna_Fktn /end SUB_FUNCTION /end FUNCTION
/begin FUNCTION dIaeTempm_Fktn "Applikationesgroessen der Komponente dIaeTempm" /begin SUB_FUNCTION jIaeTempm_Fktn /end SUB_FUNCTION /end FUNCTION
/begin FUNCTION dIepBerLp_Fktn "Applikationesgroessen der Komponente dIepBerLp" /begin SUB_FUNCTION jIepBerLp_Fktn /end SUB_FUNCTION /end FUNCTION
/begin FUNCTION dIepKordi_Fktn "Applikationesgroessen der Komponente dIepKordi" /begin SUB_FUNCTION jIepKordi_Fktn /end SUB_FUNCTION /end FUNCTION
/begin FUNCTION dIepLeckagemodell_Fktn "Applikationesgroessen der Komponente dIepLeckagemodell" /begin SUB_FUNCTION jIepLeckagemodell_Fktn /end SUB_FUNCTION /end FUNCTION
/begin FUNCTION dIepSchuz_Fktn "Applikationesgroessen der Komponente dIepSchuz" /begin SUB_FUNCTION jIepSchuz_Fktn /end SUB_FUNCTION /end FUNCTION
/begin FUNCTION dIepSigna_Fktn "Applikationesgroessen der Komponente dIepSigna" /begin SUB_FUNCTION jIepSigna_Fktn /end SUB_FUNCTION /end FUNCTION
/begin FUNCTION dIepStSig_Fktn "Applikationesgroessen der Komponente dIepStSig" /begin SUB_FUNCTION jIepStSig_Fktn /end SUB_FUNCTION /end FUNCTION
/begin FUNCTION dK0sSigna_Fktn "Applikationesgroessen der Komponente dK0sSigna" /begin SUB_FUNCTION jK0sSigna_Fktn /end SUB_FUNCTION /end FUNCTION
/begin FUNCTION dK0sSollw_Fktn "Applikationesgroessen der Komponente dK0sSollw" /begin SUB_FUNCTION jK0sSollw_Fktn /end SUB_FUNCTION /end FUNCTION
/begin FUNCTION dK0sSollwSP_Fktn "Applikationesgroessen der Komponente dK0sSollwSP" /begin SUB_FUNCTION jK0sSollwSP0_Fktn jK0sSollwSP1_Fktn /end SUB_FUNCTION /end FUNCTION
/begin FUNCTION dK0sSollwX_Fktn "Applikationesgroessen der Komponente dK0sSollwX" /begin SUB_FUNCTION jK0sSollwX_Fktn jK0sSollwXASD_Fktn /end SUB_FUNCTION /end FUNCTION
/begin FUNCTION dK0sSteur_Fktn "Applikationesgroessen der Komponente dK0sSteur" /begin SUB_FUNCTION jK0sSteur_Fktn /end SUB_FUNCTION /end FUNCTION
/begin FUNCTION dK0sSteurSP_Fktn "Applikationesgroessen der Komponente dK0sSteurSP" /begin SUB_FUNCTION jK0sSteurSP0_Fktn jK0sSteurSP1_Fktn /end SUB_FUNCTION /end FUNCTION
/begin FUNCTION dK0sSteurX_Fktn "Applikationesgroessen der Komponente dK0sSteurX" /begin SUB_FUNCTION jK0sSteurX1_Fktn jK0sSteurX2_Fktn /end SUB_FUNCTION /end FUNCTION
/begin FUNCTION dKasEkopl_Fktn "Applikationesgroessen der Komponente dKasEkopl" /begin SUB_FUNCTION jKasEkopl_Fktn /end SUB_FUNCTION /end FUNCTION
/begin FUNCTION dModHydlg_Fktn "Applikationesgroessen der Komponente dModHydlg" /begin SUB_FUNCTION jModHydlg_Fktn /end SUB_FUNCTION /end FUNCTION
/begin FUNCTION dModHysKo_Fktn "Applikationesgroessen der Komponente dModHysKo" /begin SUB_FUNCTION jModHysKo_Fktn /end SUB_FUNCTION /end FUNCTION
/begin FUNCTION dModHysKoK_Fktn "Applikationesgroessen der Komponente dModHysKoK"
 /begin SUB_FUNCTION jModHysKoKA_Fktn jModHysKoKB_Fktn jModHysKoKC_Fktn jModHysKoKD_Fktn jModHysKoKE_Fktn jModHysKoKK0_Fktn /end SUB_FUNCTION
/end FUNCTION
/begin FUNCTION dModKuppl_Fktn "Applikationesgroessen der Komponente dModKuppl" /begin SUB_FUNCTION jModKuppl_Fktn /end SUB_FUNCTION /end FUNCTION
/begin FUNCTION dModKupplK_Fktn "Applikationesgroessen der Komponente dModKupplK"
 /begin SUB_FUNCTION jModKupplKA_Fktn jModKupplKB_Fktn jModKupplKC_Fktn jModKupplKD_Fktn jModKupplKE_Fktn jModKupplK0_Fktn /end SUB_FUNCTION
/end FUNCTION
/begin FUNCTION dMoeMekHSP_Fktn "Applikationesgroessen der Komponente dMoeMekHSP"
 /begin SUB_FUNCTION jMoeZwrHSP112_Fktn jMoeZwrHSP123_Fktn jMoeZwrHSP134_Fktn jMoeZwrHSP145_Fktn jMoeZwrHSP156_Fktn jMoeZwrHSP167_Fktn jMoeZwrHSP178_Fktn jMoeZwrHSP212_Fktn jMoeZwrHSP223_Fktn jMoeZwrHSP234_Fktn jMoeZwrHSP245_Fktn jMoeZwrHSP256_Fktn jMoeZwrHSP267_Fktn jMoeZwrHSP278_Fktn jMoeZwrHSP312_Fktn jMoeZwrHSP323_Fktn jMoeZwrHSP334_Fktn jMoeZwrHSP345_Fktn jMoeZwrHSP356_Fktn jMoeZwrHSP367_Fktn jMoeZwrHSP378_Fktn /end SUB_FUNCTION
/end FUNCTION
/begin FUNCTION dMoeSasAl_Fktn "Applikationesgroessen der Komponente dMoeSasAl" /begin SUB_FUNCTION jMoeSasAl_Fktn /end SUB_FUNCTION /end FUNCTION
/begin RECORD_LAYOUT FLOAT32_IEEE_COL_DIRECT_S6_S3 FNC_VALUES 1 FLOAT32_IEEE COLUMN_DIR DIRECT /end RECORD_LAYOUT
/begin RECORD_LAYOUT FLOAT32_IEEE_X_INCR_DIRECT_S6_S3 AXIS_PTS_X 1 FLOAT32_IEEE INDEX_INCR DIRECT /end RECORD_LAYOUT
/begin RECORD_LAYOUT SBYTE_X_INCR_DIRECT_S6_S3 AXIS_PTS_X 1 SBYTE INDEX_INCR DIRECT /end RECORD_LAYOUT
/begin RECORD_LAYOUT UBYTE_COL_DIRECT_S6_S3 FNC_VALUES 1 UBYTE COLUMN_DIR DIRECT /end RECORD_LAYOUT
/begin RECORD_LAYOUT UBYTE_X_INCR_DIRECT_S6_S3 AXIS_PTS_X 1 UBYTE INDEX_INCR DIRECT /end RECORD_LAYOUT
/end MODULE
/end PROJECT
