ASAP2_VERSION 1 51
/begin PROJECT ZHBC8600 "Gen2_BMW_System_Supplier_Lib"
/begin MODULE CPP ""
/begin MOD_COMMON "" BYTE_ORDER MSB_FIRST ALIGNMENT_BYTE 1 ALIGNMENT_WORD 2 ALIGNMENT_LONG 4 ALIGNMENT_FLOAT32_IEEE 4 ALIGNMENT_FLOAT64_IEEE 1 /end MOD_COMMON
/begin COMPU_TAB _CNV_P_2_A_I_5_S2 "" TAB_INTP 2 0 0 255 255 /end COMPU_TAB
/begin COMPU_VTAB _CNV_S_10_Enum_EDBMT_254_S2 "" TAB_VERB 10 0 "DBMZKA_IDX1" 1 "DBMZKA_IDX2" 2 "DBMZKA_IDX3" 3 "DBMZKA_IDX4" 4 "DBMZKA_IDX5" 5 "DBMZKA_IDX6" 6 "DBMZKA_IDX7" 7 "DBMZKA_IDX8" 8 "DBMZKA_IDX9" 9 "DBMZKA_IDX10" DEFAULT_VALUE "" /end COMPU_VTAB
/begin COMPU_VTAB _CNV_S_10_Enum_EDMRS_22_S2 "" TAB_VERB 10 0 "D2RS_A_AGS" 1 "D3RS_A_AGS" 2 "D4RS_A_AGS" 3 "D5RS_A_AGS" 4 "D6RS_A_AGS" 5 "D2RS_S_AGS" 6 "D3RS_S_AGS" 7 "D4RS_S_AGS" 8 "D5RS_S_AGS" 9 "D6RS_S_AGS" DEFAULT_VALUE "" /end COMPU_VTAB
/begin COMPU_VTAB _CNV_S_10_Enum_EHASS_119_S2 "" TAB_VERB 10 0 "INIT_INAKTIV" 1 "ANGEKOPPELT" 2 "ENTKOPPELT" 3 "E_FAHREN" 4 "STOP" 5 "LADEN" 6 "ENTKOPPELT_VM_EIN" 7 "E_FAHREN_VM_EIN" 8 "HYBRIDFAHREN" 15 "FEHLER" DEFAULT_VALUE "" /end COMPU_VTAB
/begin COMPU_VTAB _CNV_S_16_Enum_EMAXR_260_S2 "" TAB_VERB 16 0 "MAX_RFWS_IDX0" 1 "MAX_RFWS_IDX1" 2 "MAX_RFWS_IDX2" 3 "MAX_RFWS_IDX3" 4 "MAX_RFWS_IDX4" 5 "MAX_RFWS_IDX5" 6 "MAX_RFWS_IDX6" 7 "MAX_RFWS_IDX7" 8 "MAX_RFWS_IDX8" 9 "MAX_RFWS_IDX9" 10 "MAX_RFWS_IDX10" 11 "MAX_RFWS_IDX11" 12 "MAX_RFWS_IDX12" 13 "MAX_RFWS_IDX13" 14 "MAX_RFWS_IDX14" 15 "MAX_RFWS_IDX15" DEFAULT_VALUE "" /end COMPU_VTAB
/begin COMPU_VTAB _CNV_S_16_Enum_EMINR_261_S2 "" TAB_VERB 16 0 "MIN_RFWS_IDX0" 1 "MIN_RFWS_IDX1" 2 "MIN_RFWS_IDX2" 3 "MIN_RFWS_IDX3" 4 "MIN_RFWS_IDX4" 5 "MIN_RFWS_IDX5" 6 "MIN_RFWS_IDX6" 7 "MIN_RFWS_IDX7" 8 "MIN_RFWS_IDX8" 9 "MIN_RFWS_IDX9" 10 "MIN_RFWS_IDX10" 11 "MIN_RFWS_IDX11" 12 "MIN_RFWS_IDX12" 13 "MIN_RFWS_IDX13" 14 "MIN_RFWS_IDX14" 15 "MIN_RFWS_IDX15" DEFAULT_VALUE "" /end COMPU_VTAB
/begin COMPU_VTAB _CNV_S_2_Enum_EAGS_18_S2 "" TAB_VERB 2 0 "A_AGS" 1 "S_AGS" DEFAULT_VALUE "" /end COMPU_VTAB
/begin COMPU_VTAB _CNV_S_2_Enum_EBABE_40_S2 "" TAB_VERB 2 0 "Grundschwelle_EINSTIEG" 1 "Grundschwelle_AUSSTIEG" DEFAULT_VALUE "" /end COMPU_VTAB
/begin COMPU_VTAB _CNV_S_2_Enum_EBABF_41_S2 "" TAB_VERB 2 0 "BAB_KEINE_FGRKF" 1 "BAB_UND_FGRKF" DEFAULT_VALUE "" /end COMPU_VTAB
/begin COMPU_VTAB _CNV_S_2_Enum_ECOD__16_S2 "" TAB_VERB 2 0 "KEIN_SPORTSCHALTER" 1 "SPORTSCHALTER" DEFAULT_VALUE "" /end COMPU_VTAB
/begin COMPU_VTAB _CNV_S_2_Enum_EDBMT_253_S2 "" TAB_VERB 2 0 "MinDrehzahl" 1 "MaxDrehzahl" DEFAULT_VALUE "" /end COMPU_VTAB
/begin COMPU_VTAB _CNV_S_2_Enum_EEFAH_120_S2 "" TAB_VERB 2 0 "EFAHREN_1_ERK" 1 "EFAHREN_2_ERK" DEFAULT_VALUE "" /end COMPU_VTAB
/begin COMPU_VTAB _CNV_S_2_Enum_EFP_D_101_S2 "" TAB_VERB 2 0 "FP_POS" 1 "FP_NEG" DEFAULT_VALUE "" /end COMPU_VTAB
/begin COMPU_VTAB _CNV_S_2_Enum_EGEW__13_S2 "" TAB_VERB 2 0 "IN_GEW" 1 "OUT_GEW" DEFAULT_VALUE "" /end COMPU_VTAB
/begin COMPU_VTAB _CNV_S_2_Enum_EHDC__99_S2 "" TAB_VERB 2 0 "N_MOT_SCHALTEN" 1 "N_MOT_GANGHALTEN" DEFAULT_VALUE "" /end COMPU_VTAB
/begin COMPU_VTAB _CNV_S_2_Enum_EK0_S_251_S2 "" TAB_VERB 2 3 "SCHLUPFGEREGELT" 5 "GESCHLOSSEN" DEFAULT_VALUE "" /end COMPU_VTAB
/begin COMPU_VTAB _CNV_S_2_Enum_ENOTL_96_S2 "" TAB_VERB 2 0 "MOTOR_NOTLAUF_1" 1 "MOTOR_NOTLAUF_2" DEFAULT_VALUE "" /end COMPU_VTAB
/begin COMPU_VTAB _CNV_S_2_Enum_EPT1__15_S2 "" TAB_VERB 2 0 "PT1_VERST" 1 "PT1_TRAEG" DEFAULT_VALUE "" /end COMPU_VTAB
/begin COMPU_VTAB _CNV_S_2_Enum_ESCHG_167_S2 "" TAB_VERB 2 0 "SCH_ACTIVE" 1 "SCH_WAIT" DEFAULT_VALUE "" /end COMPU_VTAB
/begin COMPU_VTAB _CNV_S_2_Enum_ESCHT_154_S2 "" TAB_VERB 2 0 "Ueberschreiten" 1 "Unterschreiten" DEFAULT_VALUE "" /end COMPU_VTAB
/begin COMPU_VTAB _CNV_S_2_Enum_ESDYN_155_S2 "" TAB_VERB 2 0 "TEMP1" 1 "TEMP2" DEFAULT_VALUE "" /end COMPU_VTAB
/begin COMPU_VTAB _CNV_S_2_Enum_ESPOR_193_S2 "" TAB_VERB 2 0 "AUTOMATC" 1 "SPORT" DEFAULT_VALUE "" /end COMPU_VTAB
/begin COMPU_VTAB _CNV_S_2_Enum_ESTEI_250_S2 "" TAB_VERB 2 0 "W_STEIGUNG" 1 "W_STEIGUNG_FILT" DEFAULT_VALUE "" /end COMPU_VTAB
/begin COMPU_VTAB _CNV_S_2_Enum_EWKAN_162_S2 "" TAB_VERB 2 0 "GER_WKSOLL" 1 "ZU_WKSOLL" DEFAULT_VALUE "" /end COMPU_VTAB
/begin COMPU_VTAB _CNV_S_2_Enum_EWL2_122_S2 "" TAB_VERB 2 0 "WL2_nichtaktiv" 1 "WL2_aktiv" DEFAULT_VALUE "" /end COMPU_VTAB
/begin COMPU_VTAB _CNV_S_2_Enum_EZKAT_185_S2 "" TAB_VERB 2 0 "OPT_ZUG" 1 "OPT_SCHUB" DEFAULT_VALUE "" /end COMPU_VTAB
/begin COMPU_VTAB _CNV_S_2_Enum_HSRS_157_S2 "" TAB_VERB 2 0 "HS" 1 "RS" DEFAULT_VALUE "" /end COMPU_VTAB
/begin COMPU_VTAB _CNV_S_2_Enum_HSURE_100_S2 "" TAB_VERB 2 0 "Muelow_intern" 1 "Muelow_extern" DEFAULT_VALUE "" /end COMPU_VTAB
/begin COMPU_VTAB _CNV_S_2_Enum_MFRSK_80_S2 "" TAB_VERB 2 1 "TEMP_KUP_A (max. 2-fach RS)" 2 "TEMP_KUP_A (keine direkte MRS)" DEFAULT_VALUE "" /end COMPU_VTAB
/begin COMPU_VTAB _CNV_S_2_Enum_PRUEF_256_S2 "" TAB_VERB 2 0 "ADD_FKT" 1 "KOOP_FKT" DEFAULT_VALUE "" /end COMPU_VTAB
/begin COMPU_VTAB _CNV_S_2_Enum_REKUP_259_S2 "" TAB_VERB 2 0 "M_REKUP_DBM" 1 "M_MOT_STAT" DEFAULT_VALUE "" /end COMPU_VTAB
/begin COMPU_VTAB _CNV_S_2_Schalter_A_4_S2 "Schalter: 0 = AUS, 1 = EIN" TAB_VERB 2 0 "AUS" 1 "EIN" DEFAULT_VALUE "" /end COMPU_VTAB
/begin COMPU_VTAB _CNV_S_32_Enum_EEXCF_19_S2 "" TAB_VERB 32 0 "XE_FKT" 1 "E_FKT" 2 "S_FKT" 3 "XS_FKT" 4 "STEPTR" 5 "TID" 6 "DL_2" 7 "DL_3" 8 "DL_4" 9 "DL_5" 10 "DL_6" 11 "FAS" 12 "HDC" 13 "DPF_REG" 14 "TMS" 15 "WL1" 16 "WL2" 17 "HOTMODE" 18 "BERG_A1" 19 "BERG_A2" 20 "BERG_A3" 21 "BERG_A4" 22 "BERG_A5" 23 "MUELOW" 24 "LM" 25 "EFAHREN_1" 26 "EFAHREN_2" 27 "NOTLAUF_EM_LOW" 28 "NOTLAUF_EM_HIGH" 29 "REKUP" 30 "FREI_1" 31 "FREI_2" DEFAULT_VALUE "" /end COMPU_VTAB
/begin COMPU_VTAB _CNV_S_3_Enum_EAGST_248_S2 "" TAB_VERB 3 0 "A_AGS_KU" 1 "S_AGS_KU" 2 "TID_KU" DEFAULT_VALUE "" /end COMPU_VTAB
/begin COMPU_VTAB _CNV_S_3_Enum_EDERS_191_S2 "" TAB_VERB 3 0 "DERS_NL" 1 "DERS_LWVA" 2 "DERS_NIC" DEFAULT_VALUE "" /end COMPU_VTAB
/begin COMPU_VTAB _CNV_S_3_Enum_EDSC__139_S2 "" TAB_VERB 3 0 "SPORTSTEP_DSC_PASSIVE" 1 "SPORTSTEP_DSC_PASSIVE_OR_DTC_ACTIVE" 2 "SPORTSTEP_NEVER" DEFAULT_VALUE "0" /end COMPU_VTAB
/begin COMPU_VTAB _CNV_S_3_Enum_EDSCS_50_S2 "" TAB_VERB 3 0 "DSC_ACTIVE" 1 "DSC_PASSIVE" 2 "DTC_ACTIVE" DEFAULT_VALUE "" /end COMPU_VTAB
/begin COMPU_VTAB _CNV_S_3_Enum_EDYND_130_S2 "" TAB_VERB 3 0 "QS0" 1 "QS1" 2 "QS2" DEFAULT_VALUE "" /end COMPU_VTAB
/begin COMPU_VTAB _CNV_S_3_Enum_EHDM__48_S2 "" TAB_VERB 3 0 "XHDM_AB_FWSDOWN" 1 "XHDM_AB_FWSZW_HS" 2 "XHDM_AB_FWSUP" DEFAULT_VALUE "" /end COMPU_VTAB
/begin COMPU_VTAB _CNV_S_3_Enum_EHOTD_137_S2 "" TAB_VERB 3 0 "DUE" 1 "DUE_RSZVERBOT" 2 "HOTMODE" DEFAULT_VALUE "" /end COMPU_VTAB
/begin COMPU_VTAB _CNV_S_3_Enum_EHSUA_109_S2 "" TAB_VERB 3 0 "KEEP_HSU" 1 "OUT_HSU_ONLY" 2 "OUT_HSU_PLUS_BUFF" DEFAULT_VALUE "" /end COMPU_VTAB
/begin COMPU_VTAB _CNV_S_3_Enum_ELDMA_102_S2 "" TAB_VERB 3 0 "LDM_ZUG" 1 "LDM_SCHUB_BAB_INAKTIV" 2 "LDM_SCHUB_BAB_AKTIV" DEFAULT_VALUE "" /end COMPU_VTAB
/begin COMPU_VTAB _CNV_S_3_Enum_EMOT__181_S2 "" TAB_VERB 3 0 "MOT_SCHUB_IDX1" 1 "MOT_SCHUB_IDX2" 2 "MOT_SCHUB_IDX3" DEFAULT_VALUE "" /end COMPU_VTAB
/begin COMPU_VTAB _CNV_S_3_Enum_EQS_D_166_S2 "" TAB_VERB 3 0 "QS1_DOWN_QS0" 1 "QS2_DOWN_QS1" 2 "QS2_DOWN_QS0" DEFAULT_VALUE "" /end COMPU_VTAB
/begin COMPU_VTAB _CNV_S_3_Enum_EREQA_103_S2 "" TAB_VERB 3 0 "NO_REQUEST" 1 "REQUEST_PRIO_LOW" 2 "REQUEST_PRIO_HIGH" DEFAULT_VALUE "" /end COMPU_VTAB
/begin COMPU_VTAB _CNV_S_3_Enum_ERRDS_70_S2 "" TAB_VERB 3 0 "ABS_DSC_Ok" 1 "ABS_DSC_ERR_RolleCAN_False" 2 "ABS_DSC_ERR_RolleCAN_True" DEFAULT_VALUE "" /end COMPU_VTAB
/begin COMPU_VTAB _CNV_S_3_Enum_ESCHL_28_S2 "" TAB_VERB 3 0 "HAFT_REIBUNG" 1 "ZUG_SCHLUPF" 2 "SCHUB_SCHLUPF" DEFAULT_VALUE "" /end COMPU_VTAB
/begin COMPU_VTAB _CNV_S_3_Enum_ESCHW_165_S2 "" TAB_VERB 3 0 "SCH_HS" 1 "SCH_RS" 2 "H_HSRS" DEFAULT_VALUE "" /end COMPU_VTAB
/begin COMPU_VTAB _CNV_S_3_Enum_EWDKK_163_S2 "" TAB_VERB 3 0 "WDKKD1_QS" 1 "WDKKD2_QS" 2 "WDKKD3_QS" DEFAULT_VALUE "" /end COMPU_VTAB
/begin COMPU_VTAB _CNV_S_3_Enum_EWL_255_S2 "" TAB_VERB 3 0 "WL_inaktiv" 1 "WL1_aktiv" 2 "WL2_aktiv" DEFAULT_VALUE "" /end COMPU_VTAB
/begin COMPU_VTAB _CNV_S_4_Enum_EAGS__17_S2 "" TAB_VERB 4 0 "A_AGS" 1 "S_AGS" 2 "ECO" 3 "E_FAHREN" DEFAULT_VALUE "" /end COMPU_VTAB
/begin COMPU_VTAB _CNV_S_4_Enum_EEXCF_91_S2 "" TAB_VERB 4 0 "AUTOMAT" 1 "MANUELL" 2 "FAHRERASSISTENT" 3 "ZUGKRAFTALGO" DEFAULT_VALUE "" /end COMPU_VTAB
/begin COMPU_VTAB _CNV_S_4_Enum_EFILT_238_S2 "" TAB_VERB 4 0 "DOWN_IN_GEW" 1 "DOWN_OUT_GEW" 2 "UP_IN_GEW" 3 "UP_OUT_GEW" DEFAULT_VALUE "" /end COMPU_VTAB
/begin COMPU_VTAB _CNV_S_4_Enum_EFT_20_S2 "" TAB_VERB 4 0 "XE_FT" 1 "E_FT" 2 "S_FT" 3 "XS_FT" DEFAULT_VALUE "" /end COMPU_VTAB
/begin COMPU_VTAB _CNV_S_4_Enum_EHSUR_105_S2 "" TAB_VERB 4 0 "HSURE_KUVOR_A_AGS" 1 "HSURE_KUVOR_S_AGS" 2 "HSURE_KUVOR_LDMAAGS" 3 "HSURE_KUVOR_LDMSAGS" DEFAULT_VALUE "" /end COMPU_VTAB
/begin COMPU_VTAB _CNV_S_4_Enum_EKOMB_78_S2 "" TAB_VERB 4 0 "DARK_KOMBI" 1 "SPORT_KOMBI" 2 "STEPTRONIC_KOMBI" 3 "L_KOMBI" DEFAULT_VALUE "" /end COMPU_VTAB
/begin COMPU_VTAB _CNV_S_4_Enum_ENABH_93_S2 "" TAB_VERB 4 0 "KEINE_HSURERS" 1 "NABHSURERS_NULLDECRVL_1" 2 "NABHSURERS_NULLDECRVL_2" 3 "NABHSURERS_NULLDECRVL_3" DEFAULT_VALUE "" /end COMPU_VTAB
/begin COMPU_VTAB _CNV_S_4_Enum_EPOSA_29_S2 "" TAB_VERB 4 0 "POS_D" 1 "POS_N" 2 "POS_R" 3 "POS_P" DEFAULT_VALUE "" /end COMPU_VTAB
/begin COMPU_VTAB _CNV_S_4_Enum_EPOWE_87_S2 "" TAB_VERB 4 0 "PS_FREI" 1 "PS_KOMFORT" 2 "PS_SPORT" 3 "PS_SPORT_PLUS" DEFAULT_VALUE "" /end COMPU_VTAB
/begin COMPU_VTAB _CNV_S_4_Enum_EPROG_26_S2 "" TAB_VERB 4 0 "NORMAL_MODE" 1 "SPORT_MODE" 2 "STEPTRONIC_MODE" 3 "L_MODE" DEFAULT_VALUE "" /end COMPU_VTAB
/begin COMPU_VTAB _CNV_S_4_Enum_EPROG_55_S2 "" TAB_VERB 4 0 "EXTREME_ECONOMY_PROG" 1 "ECONOMY_PROG" 2 "SPORT_PROG" 3 "EXTREME_SPORT_PROG" DEFAULT_VALUE "" /end COMPU_VTAB
/begin COMPU_VTAB_RANGE _CNV_S_4_Enum_ESCHA_151_R_S2 "Schaltungstypen" 4 0 0 "ZH" 1 1 "SH" 2 2 "ZR" 3 4 "SR" DEFAULT_VALUE "" /end COMPU_VTAB_RANGE
/begin COMPU_VTAB _CNV_S_4_Enum_ETIDA_263_S2 "" TAB_VERB 4 0 "KUHSURE_TID" 1 "BABHSU_TID" 2 "FPMIN_TID" 3 "FPMAX_TID" DEFAULT_VALUE "" /end COMPU_VTAB
/begin COMPU_VTAB _CNV_S_5_Enum_EDMRS_265_S2 "" TAB_VERB 5 0 "T_D2RS" 1 "T_D3RS" 2 "T_D4RS" 3 "T_D5RS" 4 "T_D6RS" DEFAULT_VALUE "" /end COMPU_VTAB
/begin COMPU_VTAB _CNV_S_5_Enum_EFT2_53_S2 "" TAB_VERB 5 0 "XXE_FT" 1 "XE_FT" 2 "E_FT" 3 "S_FT" 4 "XS_FT" DEFAULT_VALUE "" /end COMPU_VTAB
/begin COMPU_VTAB _CNV_S_5_Enum_EGWDK_161_S2 "" TAB_VERB 5 0 "GWDKKD1_QS" 1 "GWDKKD2_QS" 2 "GWDKKD3_QS" 3 "GWDKKD4_QS" 4 "GWDKKD5_QS" DEFAULT_VALUE "" /end COMPU_VTAB
/begin COMPU_VTAB _CNV_S_5_Enum_EMOT__180_S2 "" TAB_VERB 5 0 "MOT_IDX1" 1 "MOT_IDX2" 2 "MOT_IDX3" 3 "MOT_IDX4" 4 "MOT_IDX5" DEFAULT_VALUE "" /end COMPU_VTAB
/begin COMPU_VTAB _CNV_S_5_Enum_EPROG_106_S2 "" TAB_VERB 5 0 "NORMAL_MODE" 1 "SPORT_MODE" 2 "STEPTRONIC_MODE" 3 "L_MODE" 4 "TIP_in_D" DEFAULT_VALUE "" /end COMPU_VTAB
/begin COMPU_VTAB _CNV_S_5_Enum_ETUPE_23_S2 "" TAB_VERB 5 0 "NMOTHS_TUPEL_0" 1 "NMOTHS_TUPEL_1" 2 "NMOTHS_TUPEL_2" 3 "NMOTHS_TUPEL_3" 4 "NMOTHS_TUPEL_4" DEFAULT_VALUE "" /end COMPU_VTAB
/begin COMPU_VTAB _CNV_S_5_Enum_EZKAK_183_S2 "" TAB_VERB 5 0 "Anford" 1 "Stabi" 2 "leer1" 3 "leer2" 4 "leer3" DEFAULT_VALUE "" /end COMPU_VTAB
/begin COMPU_VTAB _CNV_S_5_Enum_EZKAT_184_S2 "" TAB_VERB 5 0 "ZKA_IDX1" 1 "ZKA_IDX2" 2 "ZKA_IDX3" 3 "ZKA_IDX4" 4 "ZKA_IDX5" DEFAULT_VALUE "" /end COMPU_VTAB
/begin COMPU_VTAB _CNV_S_5_Enum_REKUP_257_S2 "" TAB_VERB 5 0 "REKUP_IDX1" 1 "REKUP_IDX2" 2 "REKUP_IDX3" 3 "REKUP_IDX4" 4 "REKUP_IDX5" DEFAULT_VALUE "" /end COMPU_VTAB
/begin COMPU_VTAB _CNV_S_6_Enum_EANZE_152_S2 "" TAB_VERB 6 0 "MANUELLGANG_ANZ" 1 "ISTGANG_ANZ" 2 "ZIELGANG_ANZ" 3 "AUTOMATGANG_ANZ" 4 "LMODEGANG_ANZ" 5 "KEINGANG_ANZ" DEFAULT_VALUE "" /end COMPU_VTAB
/begin COMPU_VTAB _CNV_S_6_Enum_EANZG_150_S2 "" TAB_VERB 6 0 "GANGART_AUTOMAT" 1 "GANGART_MANUELL" 2 "GANGART_SPORT" 3 "GANGART_FAS" 4 "GANGART_ZKA" 5 "GANGART_LMODE" DEFAULT_VALUE "" /end COMPU_VTAB
/begin COMPU_VTAB _CNV_S_6_Enum_EBERG_47_S2 "" TAB_VERB 6 0 "BERGANH_OFF" 1 "BERGANH_A1" 2 "BERGANH_A2" 3 "BERGANH_A3" 4 "BERGANH_A4" 5 "BERGANH_A5" DEFAULT_VALUE "" /end COMPU_VTAB
/begin COMPU_VTAB _CNV_S_6_Enum_EDL_11_S2 "" TAB_VERB 6 1 "DL_1" 2 "DL_2" 3 "DL_3" 4 "DL_4" 5 "DL_5" 6 "DL_6" DEFAULT_VALUE "" /end COMPU_VTAB
/begin COMPU_VTAB _CNV_S_6_Enum_EEFAH_118_S2 "" TAB_VERB 6 0 "KEIN_E_FAHREN" 1 "MSA_KENNLINIE" 2 "HOCHEFFIZIENZ_KL" 3 "EFFIZIENZ_KL" 4 "KUNDENWERTE_KL" 5 "EDRIVE_KL" DEFAULT_VALUE "" /end COMPU_VTAB
/begin COMPU_VTAB _CNV_S_6_Enum_EK0_224_S2 "" TAB_VERB 6 0 "OFFEN" 1 "ANGELEGT" 2 "DRUCKSTELLUNG" 3 "SCHLUPFGEREGELT" 4 "GEREGELTGESCHLOSSEN" 5 "GESCHLOSSEN" DEFAULT_VALUE "" /end COMPU_VTAB
/begin COMPU_VTAB _CNV_S_6_Enum_EQS_T_156_S2 "" TAB_VERB 6 0 "QS1_MIN" 1 "QS1_MAX" 2 "QS2_MIN" 3 "QS2_MAX" 4 "QS3_MIN" 5 "QS3_MAX" DEFAULT_VALUE "" /end COMPU_VTAB
/begin COMPU_VTAB _CNV_S_7_Enum_EDRIV_158_S2 "" TAB_VERB 7 0 "DRIVEDYN_BASIS" 1 "DRIVEDYN_KOMFORT" 2 "DRIVEDYN_TRAKTION" 3 "DRIVEDYN_SPORT" 4 "DRIVEDYN_SPORT_PLUS" 5 "DRIVEDYN_RACE" 6 "DRIVEDYN_ECO" DEFAULT_VALUE "" /end COMPU_VTAB
/begin COMPU_VTAB _CNV_S_7_Enum_ESDYN_175_S2 "" TAB_VERB 7 0 "KOMFORT_SDYN" 1 "QS1_SDYN" 2 "QS2_SDYN" 3 "QS3_SDYN" 4 "QS4_SDYN" 5 "QS5_SDYN" 6 "QS6_SDYN" DEFAULT_VALUE "" /end COMPU_VTAB
/begin COMPU_VTAB _CNV_S_8_Enum_EEXCF_168_S2 "" TAB_VERB 8 0 "EXCFKT1_QS" 1 "EXCFKT2_QS" 2 "EXCFKT3_QS" 3 "EXCFKT4_QS" 4 "EXCFKT5_QS" 5 "EXCFKT6_QS" 6 "EXCFKT7_QS" 7 "EXCFKT8_QS" DEFAULT_VALUE "" /end COMPU_VTAB
/begin COMPU_VTAB _CNV_S_8_Enum_EHSUB_104_S2 "" TAB_VERB 8 0 "HSUBEDAUS_D" 1 "HSUBEDAUS_D_FDC" 2 "HSUBEDAUS_S" 3 "HSUBEDAUS_S_FDC" 4 "HSUBEDAUS_STEP" 5 "HSUBEDAUS_STEP_FDC" 6 "HSUBEDAUS_TID" 7 "HSUBEDAUS_TID_FDC" DEFAULT_VALUE "" /end COMPU_VTAB
/begin COMPU_VTAB _CNV_S_8_Enum_EPOS_24_S2 "" TAB_VERB 8 0 "POS_1" 1 "POS_2" 2 "POS_3" 3 "POS_4" 4 "POS_D" 5 "POS_N" 6 "POS_R" 7 "POS_P" DEFAULT_VALUE "" /end COMPU_VTAB
/begin COMPU_VTAB _CNV_S_9_Enum_EARSS_252_S2 "" TAB_VERB 9 0 "MIN_EXC" 1 "MIN_RFWS" 2 "MIN_CMOPLUFT" 3 "MIN_DPFREG" 4 "MIN_AEP" 5 "MIN_HOTMODE" 6 "MIN_MOTSOLLLL" 7 "MIN_CGT" 8 "MIN_REKUPRS" DEFAULT_VALUE "" /end COMPU_VTAB
/begin COMPU_VTAB _CNV_S_9_Enum_EGANG_21_S2 "" TAB_VERB 9 0 "GANG_1" 1 "GANG_2" 2 "GANG_3" 3 "GANG_4" 4 "GANG_5" 5 "GANG_6" 6 "GANG_7" 7 "GANG_8" 8 "GANG_9" DEFAULT_VALUE "" /end COMPU_VTAB
/begin COMPU_VTAB _CNV_S_9_Enum_EMAPD_212_S2 "" TAB_VERB 9 0 "LMODE_DL" 1 "FDC_DL" 2 "FDS_BASIS" 3 "FDS_KOMFORT" 4 "FDS_TRAKTION" 5 "FDS_SPORT" 6 "FDS_SPORT_PLUS" 7 "FDS_RACE" 8 "FDS_ECO" DEFAULT_VALUE "" /end COMPU_VTAB
/begin COMPU_VTAB _CNV_S_9_Enum_ESEQ__31_S2 "" TAB_VERB 9 0 "DEC_0" 1 "DEC_1" 2 "DEC_2" 3 "DEC_3" 4 "DEC_4" 5 "DEC_5" 6 "DEC_6" 7 "DEC_7" 8 "DEC_8" DEFAULT_VALUE "" /end COMPU_VTAB
/begin COMPU_METHOD _CNV_P_2_A_I_5_CM_S2 "" TAB_INTP "%6.3" "" COMPU_TAB_REF _CNV_P_2_A_I_5_S2 /end COMPU_METHOD
/begin COMPU_METHOD _CNV_R_R_Umr_1000_z_36_CM_S2 "" RAT_FUNC "%6.3" "" COEFFS 0 1000 0 0 0 1 /end COMPU_METHOD
/begin COMPU_METHOD _CNV_R_R_Umr_100_zu_153_CM_S2 "" RAT_FUNC "%6.3" "U/min" COEFFS 0 100 0 0 0 1 /end COMPU_METHOD
/begin COMPU_METHOD _CNV_R_R_Umr_100_zu_194_CM_S2 "" RAT_FUNC "%6.3" "U/(min*ms)" COEFFS 0 100 0 0 0 1 /end COMPU_METHOD
/begin COMPU_METHOD _CNV_R_R_Umr_100_zu_42_CM_S2 "" RAT_FUNC "%6.3" "" COEFFS 0 100 0 0 0 1 /end COMPU_METHOD
/begin COMPU_METHOD _CNV_R_R_Umr_100_zu_88_CM_S2 "" RAT_FUNC "%6.3" "%" COEFFS 0 100 0 0 0 1 /end COMPU_METHOD
/begin COMPU_METHOD _CNV_R_R_Umr_10_zu__108_CM_S2 "" RAT_FUNC "%6.3" "" COEFFS 0 10 0 0 0 1 /end COMPU_METHOD
/begin COMPU_METHOD _CNV_R_R_Umr_10_zu__10_CM_S2 "" RAT_FUNC "%6.3" "°" COEFFS 0 10 0 0 0 1 /end COMPU_METHOD
/begin COMPU_METHOD _CNV_R_R_Umr_10_zu__138_CM_S2 "" RAT_FUNC "%6.3" "1/s²" COEFFS 0 10 0 0 0 1 /end COMPU_METHOD
/begin COMPU_METHOD _CNV_R_R_Umr_10_zu__186_CM_S2 "" RAT_FUNC "%6.3" "km/h" COEFFS 0 10 0 0 0 1 /end COMPU_METHOD
/begin COMPU_METHOD _CNV_R_R_Umr_10_zu__37_CM_S2 "" RAT_FUNC "%6.3" "m/s*s" COEFFS 0 10 0 0 0 1 /end COMPU_METHOD
/begin COMPU_METHOD _CNV_R_R_Umr_10_zu__9_CM_S2 "" RAT_FUNC "%6.3" "%" COEFFS 0 10 0 0 0 1 /end COMPU_METHOD
/begin COMPU_METHOD _CNV_R_R_Umr_1_zu_1_0_CM_S2 "" RAT_FUNC "%6.3" "hPa" COEFFS 0 1 0 0 0 1 /end COMPU_METHOD
/begin COMPU_METHOD _CNV_R_R_Umr_1_zu_1_107_CM_S2 "" RAT_FUNC "%6.3" "" COEFFS 0 0.1 0 0 0 1 /end COMPU_METHOD
/begin COMPU_METHOD _CNV_R_R_Umr_1_zu_1_190_CM_S2 "" RAT_FUNC "%6.3" "Nm" COEFFS 0 0.1 0 0 0 1 /end COMPU_METHOD
/begin COMPU_METHOD _CNV_R_R_Umr_1_zu_1_1_CM_S2 "" RAT_FUNC "%6.3" "°C" COEFFS 0 1 0 0 0 1 /end COMPU_METHOD
/begin COMPU_METHOD _CNV_R_R_Umr_1_zu_1_239_CM_S2 "" RAT_FUNC "%6.3" "hPa" COEFFS 0 0.1 0 0 0 1 /end COMPU_METHOD
/begin COMPU_METHOD _CNV_R_R_Umr_1_zu_1_266_CM_S2 "" RAT_FUNC "%6.3" "% von %" COEFFS 0 1 0 0 0 1 /end COMPU_METHOD
/begin COMPU_METHOD _CNV_R_R_Umr_1_zu_1_2_CM_S2 "" RAT_FUNC "%6.3" "" COEFFS 0 1 0 0 0 1 /end COMPU_METHOD
/begin COMPU_METHOD _CNV_R_R_Umr_1_zu_1_30_CM_S2 "" RAT_FUNC "%6.3" "%" COEFFS 0 1 0 0 0 1 /end COMPU_METHOD
/begin COMPU_METHOD _CNV_R_R_Umr_1_zu_1_38_CM_S2 "" RAT_FUNC "%6.3" "Nm" COEFFS 0 1 0 0 0 1 /end COMPU_METHOD
/begin COMPU_METHOD _CNV_R_R_Umr_1_zu_1_3_CM_S2 "" RAT_FUNC "%6.3" "U/min" COEFFS 0 1 0 0 0 1 /end COMPU_METHOD
/begin COMPU_METHOD _CNV_R_R_Umr_1_zu_1_54_CM_S2 "" RAT_FUNC "%6.3" "%" COEFFS 0 0.1 0 0 0 1 /end COMPU_METHOD
/begin COMPU_METHOD _CNV_R_R_Umr_1_zu_1_62_CM_S2 "" RAT_FUNC "%6.3" "Nm/s" COEFFS 0 0.1 0 0 0 1 /end COMPU_METHOD
/begin COMPU_METHOD _CNV_R_R_Umr_1_zu_1_67_CM_S2 "" RAT_FUNC "%6.3" "ms" COEFFS 0 0.1 0 0 0 1 /end COMPU_METHOD
/begin COMPU_METHOD _CNV_R_R_Umr_1_zu_1_6_CM_S2 "" RAT_FUNC "%6.3" "ms" COEFFS 0 1 0 0 0 1 /end COMPU_METHOD
/begin COMPU_METHOD _CNV_R_R_Umr_1_zu_1_7_CM_S2 "" RAT_FUNC "%6.3" "%/s" COEFFS 0 1 0 0 0 1 /end COMPU_METHOD
/begin COMPU_METHOD _CNV_R_R_Umr_1_zu_1_8_CM_S2 "" RAT_FUNC "%6.3" "km/h" COEFFS 0 1 0 0 0 1 /end COMPU_METHOD
/begin COMPU_METHOD _CNV_R_R_Umr_1_zu_2_132_CM_S2 "" RAT_FUNC "%6.3" "" COEFFS 0 0.05 0 0 0 1 /end COMPU_METHOD
/begin COMPU_METHOD _CNV_R_R_Umr_1_zu_5_71_CM_S2 "" RAT_FUNC "%6.3" "U/min" COEFFS 0 0.02 0 0 0 1 /end COMPU_METHOD
/begin COMPU_METHOD _CNV_R_R_Umr_1_zu_5_97_CM_S2 "" RAT_FUNC "%6.3" "U/min" COEFFS 0 0.2 0 0 0 1 /end COMPU_METHOD
/begin COMPU_METHOD _CNV_R_R_Umr_2_zu_1_179_CM_S2 "" RAT_FUNC "%6.3" "Bar" COEFFS 0 2 0 0 0 1 /end COMPU_METHOD
/begin COMPU_METHOD _CNV_R_R_Umr_32_zu__147_CM_S2 "" RAT_FUNC "%6.3" "m/s*s" COEFFS 0 32 0 0 0 1 /end COMPU_METHOD
/begin COMPU_METHOD _CNV_R_R_Umr_80_zu__192_CM_S2 "" RAT_FUNC "%6.3" "" COEFFS 0 80 0 0 0 1 /end COMPU_METHOD
/begin COMPU_METHOD _CNV_S_10_Enum_EDBMT_254_CM_S2 "" TAB_VERB "%6.3" "" COMPU_TAB_REF _CNV_S_10_Enum_EDBMT_254_S2 /end COMPU_METHOD
/begin COMPU_METHOD _CNV_S_10_Enum_EDMRS_22_CM_S2 "" TAB_VERB "%6.3" "" COMPU_TAB_REF _CNV_S_10_Enum_EDMRS_22_S2 /end COMPU_METHOD
/begin COMPU_METHOD _CNV_S_10_Enum_EHASS_119_CM_S2 "" TAB_VERB "%6.3" "" COMPU_TAB_REF _CNV_S_10_Enum_EHASS_119_S2 /end COMPU_METHOD
/begin COMPU_METHOD _CNV_S_16_Enum_EMAXR_260_CM_S2 "" TAB_VERB "%6.3" "" COMPU_TAB_REF _CNV_S_16_Enum_EMAXR_260_S2 /end COMPU_METHOD
/begin COMPU_METHOD _CNV_S_16_Enum_EMINR_261_CM_S2 "" TAB_VERB "%6.3" "" COMPU_TAB_REF _CNV_S_16_Enum_EMINR_261_S2 /end COMPU_METHOD
/begin COMPU_METHOD _CNV_S_2_Enum_EAGS_18_CM_S2 "" TAB_VERB "%6.3" "" COMPU_TAB_REF _CNV_S_2_Enum_EAGS_18_S2 /end COMPU_METHOD
/begin COMPU_METHOD _CNV_S_2_Enum_EBABE_40_CM_S2 "" TAB_VERB "%6.3" "" COMPU_TAB_REF _CNV_S_2_Enum_EBABE_40_S2 /end COMPU_METHOD
/begin COMPU_METHOD _CNV_S_2_Enum_EBABF_41_CM_S2 "" TAB_VERB "%6.3" "" COMPU_TAB_REF _CNV_S_2_Enum_EBABF_41_S2 /end COMPU_METHOD
/begin COMPU_METHOD _CNV_S_2_Enum_ECOD__16_CM_S2 "" TAB_VERB "%6.3" "" COMPU_TAB_REF _CNV_S_2_Enum_ECOD__16_S2 /end COMPU_METHOD
/begin COMPU_METHOD _CNV_S_2_Enum_EDBMT_253_CM_S2 "" TAB_VERB "%6.3" "" COMPU_TAB_REF _CNV_S_2_Enum_EDBMT_253_S2 /end COMPU_METHOD
/begin COMPU_METHOD _CNV_S_2_Enum_EEFAH_120_CM_S2 "" TAB_VERB "%6.3" "" COMPU_TAB_REF _CNV_S_2_Enum_EEFAH_120_S2 /end COMPU_METHOD
/begin COMPU_METHOD _CNV_S_2_Enum_EFP_D_101_CM_S2 "" TAB_VERB "%6.3" "" COMPU_TAB_REF _CNV_S_2_Enum_EFP_D_101_S2 /end COMPU_METHOD
/begin COMPU_METHOD _CNV_S_2_Enum_EGEW__13_CM_S2 "" TAB_VERB "%6.3" "" COMPU_TAB_REF _CNV_S_2_Enum_EGEW__13_S2 /end COMPU_METHOD
/begin COMPU_METHOD _CNV_S_2_Enum_EHDC__99_CM_S2 "" TAB_VERB "%6.3" "" COMPU_TAB_REF _CNV_S_2_Enum_EHDC__99_S2 /end COMPU_METHOD
/begin COMPU_METHOD _CNV_S_2_Enum_EK0_S_251_CM_S2 "" TAB_VERB "%6.3" "" COMPU_TAB_REF _CNV_S_2_Enum_EK0_S_251_S2 /end COMPU_METHOD
/begin COMPU_METHOD _CNV_S_2_Enum_ENOTL_96_CM_S2 "" TAB_VERB "%6.3" "" COMPU_TAB_REF _CNV_S_2_Enum_ENOTL_96_S2 /end COMPU_METHOD
/begin COMPU_METHOD _CNV_S_2_Enum_EPT1__15_CM_S2 "" TAB_VERB "%6.3" "" COMPU_TAB_REF _CNV_S_2_Enum_EPT1__15_S2 /end COMPU_METHOD
/begin COMPU_METHOD _CNV_S_2_Enum_ESCHG_167_CM_S2 "" TAB_VERB "%6.3" "" COMPU_TAB_REF _CNV_S_2_Enum_ESCHG_167_S2 /end COMPU_METHOD
/begin COMPU_METHOD _CNV_S_2_Enum_ESCHT_154_CM_S2 "" TAB_VERB "%6.3" "" COMPU_TAB_REF _CNV_S_2_Enum_ESCHT_154_S2 /end COMPU_METHOD
/begin COMPU_METHOD _CNV_S_2_Enum_ESDYN_155_CM_S2 "" TAB_VERB "%6.3" "" COMPU_TAB_REF _CNV_S_2_Enum_ESDYN_155_S2 /end COMPU_METHOD
/begin COMPU_METHOD _CNV_S_2_Enum_ESPOR_193_CM_S2 "" TAB_VERB "%6.3" "" COMPU_TAB_REF _CNV_S_2_Enum_ESPOR_193_S2 /end COMPU_METHOD
/begin COMPU_METHOD _CNV_S_2_Enum_ESTEI_250_CM_S2 "" TAB_VERB "%6.3" "" COMPU_TAB_REF _CNV_S_2_Enum_ESTEI_250_S2 /end COMPU_METHOD
/begin COMPU_METHOD _CNV_S_2_Enum_EWKAN_162_CM_S2 "" TAB_VERB "%6.3" "" COMPU_TAB_REF _CNV_S_2_Enum_EWKAN_162_S2 /end COMPU_METHOD
/begin COMPU_METHOD _CNV_S_2_Enum_EWL2_122_CM_S2 "" TAB_VERB "%6.3" "" COMPU_TAB_REF _CNV_S_2_Enum_EWL2_122_S2 /end COMPU_METHOD
/begin COMPU_METHOD _CNV_S_2_Enum_EZKAT_185_CM_S2 "" TAB_VERB "%6.3" "" COMPU_TAB_REF _CNV_S_2_Enum_EZKAT_185_S2 /end COMPU_METHOD
/begin COMPU_METHOD _CNV_S_2_Enum_HSRS_157_CM_S2 "" TAB_VERB "%6.3" "" COMPU_TAB_REF _CNV_S_2_Enum_HSRS_157_S2 /end COMPU_METHOD
/begin COMPU_METHOD _CNV_S_2_Enum_HSURE_100_CM_S2 "" TAB_VERB "%6.3" "" COMPU_TAB_REF _CNV_S_2_Enum_HSURE_100_S2 /end COMPU_METHOD
/begin COMPU_METHOD _CNV_S_2_Enum_MFRSK_80_CM_S2 "" TAB_VERB "%6.3" "" COMPU_TAB_REF _CNV_S_2_Enum_MFRSK_80_S2 /end COMPU_METHOD
/begin COMPU_METHOD _CNV_S_2_Enum_PRUEF_256_CM_S2 "" TAB_VERB "%6.3" "" COMPU_TAB_REF _CNV_S_2_Enum_PRUEF_256_S2 /end COMPU_METHOD
/begin COMPU_METHOD _CNV_S_2_Enum_REKUP_259_CM_S2 "" TAB_VERB "%6.3" "" COMPU_TAB_REF _CNV_S_2_Enum_REKUP_259_S2 /end COMPU_METHOD
/begin COMPU_METHOD _CNV_S_2_Schalter_A_4_CM_S2 "Schalter: 0 = AUS, 1 = EIN" TAB_VERB "%6.3" "" COMPU_TAB_REF _CNV_S_2_Schalter_A_4_S2 /end COMPU_METHOD
/begin COMPU_METHOD _CNV_S_32_Enum_EEXCF_19_CM_S2 "" TAB_VERB "%6.3" "" COMPU_TAB_REF _CNV_S_32_Enum_EEXCF_19_S2 /end COMPU_METHOD
/begin COMPU_METHOD _CNV_S_3_Enum_EAGST_248_CM_S2 "" TAB_VERB "%6.3" "" COMPU_TAB_REF _CNV_S_3_Enum_EAGST_248_S2 /end COMPU_METHOD
/begin COMPU_METHOD _CNV_S_3_Enum_EDERS_191_CM_S2 "" TAB_VERB "%6.3" "" COMPU_TAB_REF _CNV_S_3_Enum_EDERS_191_S2 /end COMPU_METHOD
/begin COMPU_METHOD _CNV_S_3_Enum_EDSC__139_CM_S2 "" TAB_VERB "%6.3" "" COMPU_TAB_REF _CNV_S_3_Enum_EDSC__139_S2 /end COMPU_METHOD
/begin COMPU_METHOD _CNV_S_3_Enum_EDSCS_50_CM_S2 "" TAB_VERB "%6.3" "" COMPU_TAB_REF _CNV_S_3_Enum_EDSCS_50_S2 /end COMPU_METHOD
/begin COMPU_METHOD _CNV_S_3_Enum_EDYND_130_CM_S2 "" TAB_VERB "%6.3" "" COMPU_TAB_REF _CNV_S_3_Enum_EDYND_130_S2 /end COMPU_METHOD
/begin COMPU_METHOD _CNV_S_3_Enum_EHDM__48_CM_S2 "" TAB_VERB "%6.3" "" COMPU_TAB_REF _CNV_S_3_Enum_EHDM__48_S2 /end COMPU_METHOD
/begin COMPU_METHOD _CNV_S_3_Enum_EHOTD_137_CM_S2 "" TAB_VERB "%6.3" "" COMPU_TAB_REF _CNV_S_3_Enum_EHOTD_137_S2 /end COMPU_METHOD
/begin COMPU_METHOD _CNV_S_3_Enum_EHSUA_109_CM_S2 "" TAB_VERB "%6.3" "" COMPU_TAB_REF _CNV_S_3_Enum_EHSUA_109_S2 /end COMPU_METHOD
/begin COMPU_METHOD _CNV_S_3_Enum_ELDMA_102_CM_S2 "" TAB_VERB "%6.3" "" COMPU_TAB_REF _CNV_S_3_Enum_ELDMA_102_S2 /end COMPU_METHOD
/begin COMPU_METHOD _CNV_S_3_Enum_EMOT__181_CM_S2 "" TAB_VERB "%6.3" "" COMPU_TAB_REF _CNV_S_3_Enum_EMOT__181_S2 /end COMPU_METHOD
/begin COMPU_METHOD _CNV_S_3_Enum_EQS_D_166_CM_S2 "" TAB_VERB "%6.3" "" COMPU_TAB_REF _CNV_S_3_Enum_EQS_D_166_S2 /end COMPU_METHOD
/begin COMPU_METHOD _CNV_S_3_Enum_EREQA_103_CM_S2 "" TAB_VERB "%6.3" "" COMPU_TAB_REF _CNV_S_3_Enum_EREQA_103_S2 /end COMPU_METHOD
/begin COMPU_METHOD _CNV_S_3_Enum_ERRDS_70_CM_S2 "" TAB_VERB "%6.3" "" COMPU_TAB_REF _CNV_S_3_Enum_ERRDS_70_S2 /end COMPU_METHOD
/begin COMPU_METHOD _CNV_S_3_Enum_ESCHL_28_CM_S2 "" TAB_VERB "%6.3" "" COMPU_TAB_REF _CNV_S_3_Enum_ESCHL_28_S2 /end COMPU_METHOD
/begin COMPU_METHOD _CNV_S_3_Enum_ESCHW_165_CM_S2 "" TAB_VERB "%6.3" "" COMPU_TAB_REF _CNV_S_3_Enum_ESCHW_165_S2 /end COMPU_METHOD
/begin COMPU_METHOD _CNV_S_3_Enum_EWDKK_163_CM_S2 "" TAB_VERB "%6.3" "" COMPU_TAB_REF _CNV_S_3_Enum_EWDKK_163_S2 /end COMPU_METHOD
/begin COMPU_METHOD _CNV_S_3_Enum_EWL_255_CM_S2 "" TAB_VERB "%6.3" "" COMPU_TAB_REF _CNV_S_3_Enum_EWL_255_S2 /end COMPU_METHOD
/begin COMPU_METHOD _CNV_S_4_Enum_EAGS__17_CM_S2 "" TAB_VERB "%6.3" "" COMPU_TAB_REF _CNV_S_4_Enum_EAGS__17_S2 /end COMPU_METHOD
/begin COMPU_METHOD _CNV_S_4_Enum_EEXCF_91_CM_S2 "" TAB_VERB "%6.3" "" COMPU_TAB_REF _CNV_S_4_Enum_EEXCF_91_S2 /end COMPU_METHOD
/begin COMPU_METHOD _CNV_S_4_Enum_EFILT_238_CM_S2 "" TAB_VERB "%6.3" "" COMPU_TAB_REF _CNV_S_4_Enum_EFILT_238_S2 /end COMPU_METHOD
/begin COMPU_METHOD _CNV_S_4_Enum_EFT_20_CM_S2 "" TAB_VERB "%6.3" "" COMPU_TAB_REF _CNV_S_4_Enum_EFT_20_S2 /end COMPU_METHOD
/begin COMPU_METHOD _CNV_S_4_Enum_EHSUR_105_CM_S2 "" TAB_VERB "%6.3" "" COMPU_TAB_REF _CNV_S_4_Enum_EHSUR_105_S2 /end COMPU_METHOD
/begin COMPU_METHOD _CNV_S_4_Enum_EKOMB_78_CM_S2 "" TAB_VERB "%6.3" "" COMPU_TAB_REF _CNV_S_4_Enum_EKOMB_78_S2 /end COMPU_METHOD
/begin COMPU_METHOD _CNV_S_4_Enum_ENABH_93_CM_S2 "" TAB_VERB "%6.3" "" COMPU_TAB_REF _CNV_S_4_Enum_ENABH_93_S2 /end COMPU_METHOD
/begin COMPU_METHOD _CNV_S_4_Enum_EPOSA_29_CM_S2 "" TAB_VERB "%6.3" "" COMPU_TAB_REF _CNV_S_4_Enum_EPOSA_29_S2 /end COMPU_METHOD
/begin COMPU_METHOD _CNV_S_4_Enum_EPOWE_87_CM_S2 "" TAB_VERB "%6.3" "" COMPU_TAB_REF _CNV_S_4_Enum_EPOWE_87_S2 /end COMPU_METHOD
/begin COMPU_METHOD _CNV_S_4_Enum_EPROG_26_CM_S2 "" TAB_VERB "%6.3" "" COMPU_TAB_REF _CNV_S_4_Enum_EPROG_26_S2 /end COMPU_METHOD
/begin COMPU_METHOD _CNV_S_4_Enum_EPROG_55_CM_S2 "" TAB_VERB "%6.3" "" COMPU_TAB_REF _CNV_S_4_Enum_EPROG_55_S2 /end COMPU_METHOD
/begin COMPU_METHOD _CNV_S_4_Enum_ESCHA_151_R_CM_S2 "Schaltungstypen" TAB_VERB "%6.3" "" COMPU_TAB_REF _CNV_S_4_Enum_ESCHA_151_R_S2 /end COMPU_METHOD
/begin COMPU_METHOD _CNV_S_4_Enum_ETIDA_263_CM_S2 "" TAB_VERB "%6.3" "" COMPU_TAB_REF _CNV_S_4_Enum_ETIDA_263_S2 /end COMPU_METHOD
/begin COMPU_METHOD _CNV_S_5_Enum_EDMRS_265_CM_S2 "" TAB_VERB "%6.3" "" COMPU_TAB_REF _CNV_S_5_Enum_EDMRS_265_S2 /end COMPU_METHOD
/begin COMPU_METHOD _CNV_S_5_Enum_EFT2_53_CM_S2 "" TAB_VERB "%6.3" "" COMPU_TAB_REF _CNV_S_5_Enum_EFT2_53_S2 /end COMPU_METHOD
/begin COMPU_METHOD _CNV_S_5_Enum_EGWDK_161_CM_S2 "" TAB_VERB "%6.3" "" COMPU_TAB_REF _CNV_S_5_Enum_EGWDK_161_S2 /end COMPU_METHOD
/begin COMPU_METHOD _CNV_S_5_Enum_EMOT__180_CM_S2 "" TAB_VERB "%6.3" "" COMPU_TAB_REF _CNV_S_5_Enum_EMOT__180_S2 /end COMPU_METHOD
/begin COMPU_METHOD _CNV_S_5_Enum_EPROG_106_CM_S2 "" TAB_VERB "%6.3" "" COMPU_TAB_REF _CNV_S_5_Enum_EPROG_106_S2 /end COMPU_METHOD
/begin COMPU_METHOD _CNV_S_5_Enum_ETUPE_23_CM_S2 "" TAB_VERB "%6.3" "" COMPU_TAB_REF _CNV_S_5_Enum_ETUPE_23_S2 /end COMPU_METHOD
/begin COMPU_METHOD _CNV_S_5_Enum_EZKAK_183_CM_S2 "" TAB_VERB "%6.3" "" COMPU_TAB_REF _CNV_S_5_Enum_EZKAK_183_S2 /end COMPU_METHOD
/begin COMPU_METHOD _CNV_S_5_Enum_EZKAT_184_CM_S2 "" TAB_VERB "%6.3" "" COMPU_TAB_REF _CNV_S_5_Enum_EZKAT_184_S2 /end COMPU_METHOD
/begin COMPU_METHOD _CNV_S_5_Enum_REKUP_257_CM_S2 "" TAB_VERB "%6.3" "" COMPU_TAB_REF _CNV_S_5_Enum_REKUP_257_S2 /end COMPU_METHOD
/begin COMPU_METHOD _CNV_S_6_Enum_EANZE_152_CM_S2 "" TAB_VERB "%6.3" "" COMPU_TAB_REF _CNV_S_6_Enum_EANZE_152_S2 /end COMPU_METHOD
/begin COMPU_METHOD _CNV_S_6_Enum_EANZG_150_CM_S2 "" TAB_VERB "%6.3" "" COMPU_TAB_REF _CNV_S_6_Enum_EANZG_150_S2 /end COMPU_METHOD
/begin COMPU_METHOD _CNV_S_6_Enum_EBERG_47_CM_S2 "" TAB_VERB "%6.3" "" COMPU_TAB_REF _CNV_S_6_Enum_EBERG_47_S2 /end COMPU_METHOD
/begin COMPU_METHOD _CNV_S_6_Enum_EDL_11_CM_S2 "" TAB_VERB "%6.3" "" COMPU_TAB_REF _CNV_S_6_Enum_EDL_11_S2 /end COMPU_METHOD
/begin COMPU_METHOD _CNV_S_6_Enum_EEFAH_118_CM_S2 "" TAB_VERB "%6.3" "" COMPU_TAB_REF _CNV_S_6_Enum_EEFAH_118_S2 /end COMPU_METHOD
/begin COMPU_METHOD _CNV_S_6_Enum_EK0_224_CM_S2 "" TAB_VERB "%6.3" "" COMPU_TAB_REF _CNV_S_6_Enum_EK0_224_S2 /end COMPU_METHOD
/begin COMPU_METHOD _CNV_S_6_Enum_EQS_T_156_CM_S2 "" TAB_VERB "%6.3" "" COMPU_TAB_REF _CNV_S_6_Enum_EQS_T_156_S2 /end COMPU_METHOD
/begin COMPU_METHOD _CNV_S_7_Enum_EDRIV_158_CM_S2 "" TAB_VERB "%6.3" "" COMPU_TAB_REF _CNV_S_7_Enum_EDRIV_158_S2 /end COMPU_METHOD
/begin COMPU_METHOD _CNV_S_7_Enum_ESDYN_175_CM_S2 "" TAB_VERB "%6.3" "" COMPU_TAB_REF _CNV_S_7_Enum_ESDYN_175_S2 /end COMPU_METHOD
/begin COMPU_METHOD _CNV_S_8_Enum_EEXCF_168_CM_S2 "" TAB_VERB "%6.3" "" COMPU_TAB_REF _CNV_S_8_Enum_EEXCF_168_S2 /end COMPU_METHOD
/begin COMPU_METHOD _CNV_S_8_Enum_EHSUB_104_CM_S2 "" TAB_VERB "%6.3" "" COMPU_TAB_REF _CNV_S_8_Enum_EHSUB_104_S2 /end COMPU_METHOD
/begin COMPU_METHOD _CNV_S_8_Enum_EPOS_24_CM_S2 "" TAB_VERB "%6.3" "" COMPU_TAB_REF _CNV_S_8_Enum_EPOS_24_S2 /end COMPU_METHOD
/begin COMPU_METHOD _CNV_S_9_Enum_EARSS_252_CM_S2 "" TAB_VERB "%6.3" "" COMPU_TAB_REF _CNV_S_9_Enum_EARSS_252_S2 /end COMPU_METHOD
/begin COMPU_METHOD _CNV_S_9_Enum_EGANG_21_CM_S2 "" TAB_VERB "%6.3" "" COMPU_TAB_REF _CNV_S_9_Enum_EGANG_21_S2 /end COMPU_METHOD
/begin COMPU_METHOD _CNV_S_9_Enum_EMAPD_212_CM_S2 "" TAB_VERB "%6.3" "" COMPU_TAB_REF _CNV_S_9_Enum_EMAPD_212_S2 /end COMPU_METHOD
/begin COMPU_METHOD _CNV_S_9_Enum_ESEQ__31_CM_S2 "" TAB_VERB "%6.3" "" COMPU_TAB_REF _CNV_S_9_Enum_ESEQ__31_S2 /end COMPU_METHOD
/begin COMPU_METHOD SAB_C_CEL2_M100_S2_S3 "int = ((phys * 2) / 1) - (-100) Grad Celsius" RAT_FUNC "%4.3" "Grad Celsius" COEFFS 0 2 100 0 0 1 /end COMPU_METHOD
/begin COMPU_METHOD SAB_C_CEL2_M40_S2_S3 "int = ((phys * 2) / 1) - (-80) C" RAT_FUNC "%2.1" "C" COEFFS 0 2 80 0 0 1 /end COMPU_METHOD
/begin COMPU_METHOD SAB_C_CEL2_M50_S2_S3 "int = ((phys * 2) / 1) - (-100) Unit_DegreCelsi" RAT_FUNC "%4.3" "Unit_DegreCelsi" COEFFS 0 2 100 0 0 1 /end COMPU_METHOD
/begin COMPU_METHOD SAB_C_CEL32_M273_S2_S3 "int = ((phys * 32) / 1) - (-8736) Grad Celsius" RAT_FUNC "%4.3" "Grad Celsius" COEFFS 0 32 8736 0 0 1 /end COMPU_METHOD
/begin COMPU_METHOD SAB_C_CEL_M40_S2_S3 "int = ((phys * 1) / 1) - (-40) Grad Celsius" RAT_FUNC "%1.0" "Grad Celsius" COEFFS 0 1 40 0 0 1 /end COMPU_METHOD
/begin COMPU_METHOD SAB_C_CEL_M48_S2_S3 "int = ((phys * 1) / 1) - (-48) Grad Celsius" RAT_FUNC "%1.0" "Grad Celsius" COEFFS 0 1 48 0 0 1 /end COMPU_METHOD
/begin COMPU_METHOD SAB_C_CEL_M50_S2_S3 "int = ((phys * 1) / 1) - (-50) C" RAT_FUNC "%1.0" "C" COEFFS 0 1 50 0 0 1 /end COMPU_METHOD
/begin COMPU_METHOD SAB_C_CEL_M60_S2_S3 "int = ((phys * 1) / 1) - (-60) Grad Celsius" RAT_FUNC "%1.0" "Grad Celsius" COEFFS 0 1 60 0 0 1 /end COMPU_METHOD
/begin COMPU_METHOD SAB_C_CEL_S2_S3 "int = ((phys * 1) / 1) - (0) Grad Celsius" RAT_FUNC "%1.0" "Grad Celsius" COEFFS 0 1 0 0 0 1 /end COMPU_METHOD
/begin COMPU_METHOD SAB_C_CGT_1000CEL_M40000_S2_S3 "int = ((phys * 1000) / 1) - (-40000) Grad Celsius" RAT_FUNC "%4.3" "Grad Celsius" COEFFS 0 1000 40000 0 0 1 /end COMPU_METHOD
/begin COMPU_METHOD SAB_C_CGT_1CEL_M50_S2_S3 "int = ((phys * 1) / 1) - (-50) Grad Celsius" RAT_FUNC "%1.0" "Grad Celsius" COEFFS 0 1 50 0 0 1 /end COMPU_METHOD
/begin COMPU_METHOD SAB_C_CGT_CEL100_M4000_S2_S3 "int = ((phys * 100) / 1) - (-4000) Grad Celsius" RAT_FUNC "%4.3" "Grad Celsius" COEFFS 0 100 4000 0 0 1 /end COMPU_METHOD
/begin COMPU_METHOD SAB_C_CMO_1CEL_M60_S2_S3 "int = ((phys * 1) / 1) - (-60) Grad Celsius" RAT_FUNC "%1.0" "Grad Celsius" COEFFS 0 1 60 0 0 1 /end COMPU_METHOD
/begin COMPU_METHOD SAB_C_CMO_3CEL4_M48_S2_S3 "int = ((phys * 4) / 3) - (-64) Grad Celsius" RAT_FUNC "%4.3" "Grad Celsius" COEFFS 0 1.33333333333 64 0 0 1 /end COMPU_METHOD
/begin COMPU_METHOD SAB_C_TEMPEXTERN_CEL2_M50_S2_S3 "int = ((phys * 2) / 1) - (-100) Grad Celsius" RAT_FUNC "%4.3" "Grad Celsius" COEFFS 0 2 100 0 0 1 /end COMPU_METHOD
/begin COMPU_METHOD SAB_C_TEMPEXTERN_CEL4_M128_S2_S3 "int = ((phys * 4) / 1) - (-512) Grad Celsius" RAT_FUNC "%4.3" "Grad Celsius" COEFFS 0 4 512 0 0 1 /end COMPU_METHOD
/begin COMPU_METHOD SAB_DAY_S2_S3 "int = ((phys * 1) / 1) - (0) day" RAT_FUNC "%1.0" "day" COEFFS 0 1 0 0 0 1 /end COMPU_METHOD
/begin COMPU_METHOD SAB_GRAD10_S2_S3 "int = ((phys * 10) / 1) - (0) Grad" RAT_FUNC "%4.3" "Grad" COEFFS 0 10 0 0 0 1 /end COMPU_METHOD
/begin AXIS_PTS SSTTAB_MRADOPTS_GANG1 "" 0x1DDA80 N_AB _REC_A2AXS_31_u2_S2 65535 _CNV_R_R_Umr_1_zu_1_3_CM_S2 5 0 65535 DEPOSIT ABSOLUTE /end AXIS_PTS
/begin AXIS_PTS SSTTAB_MRADOPTS_GANG2 "" 0x1DDA8C N_AB _REC_A2AXS_31_u2_S2 65535 _CNV_R_R_Umr_1_zu_1_3_CM_S2 5 0 65535 DEPOSIT ABSOLUTE /end AXIS_PTS
/begin AXIS_PTS SSTTAB_MRADOPTS_GANG3 "" 0x1DDA98 N_AB _REC_A2AXS_31_u2_S2 65535 _CNV_R_R_Umr_1_zu_1_3_CM_S2 5 0 65535 DEPOSIT ABSOLUTE /end AXIS_PTS
/begin AXIS_PTS SSTTAB_MRADOPTS_GANG4 "" 0x1DDAA4 N_AB _REC_A2AXS_31_u2_S2 65535 _CNV_R_R_Umr_1_zu_1_3_CM_S2 5 0 65535 DEPOSIT ABSOLUTE /end AXIS_PTS
/begin AXIS_PTS SSTTAB_MRADOPTS_GANG5 "" 0x1DDAB0 N_AB _REC_A2AXS_31_u2_S2 65535 _CNV_R_R_Umr_1_zu_1_3_CM_S2 5 0 65535 DEPOSIT ABSOLUTE /end AXIS_PTS
/begin AXIS_PTS SSTTAB_MRADOPTS_GANG6 "" 0x1DDABC N_AB _REC_A2AXS_31_u2_S2 65535 _CNV_R_R_Umr_1_zu_1_3_CM_S2 5 0 65535 DEPOSIT ABSOLUTE /end AXIS_PTS
/begin AXIS_PTS SSTTAB_MRADOPTS_GANG7 "" 0x1DDAC8 N_AB _REC_A2AXS_31_u2_S2 65535 _CNV_R_R_Umr_1_zu_1_3_CM_S2 5 0 65535 DEPOSIT ABSOLUTE /end AXIS_PTS
/begin AXIS_PTS SSTTAB_MRADOPTS_GANG8 "" 0x1DDAD4 N_AB _REC_A2AXS_31_u2_S2 65535 _CNV_R_R_Umr_1_zu_1_3_CM_S2 5 0 65535 DEPOSIT ABSOLUTE /end AXIS_PTS
/begin AXIS_PTS SSTTAB_MRADOPTS_GANG9 "" 0x1DDAE0 N_AB _REC_A2AXS_31_u2_S2 65535 _CNV_R_R_Umr_1_zu_1_3_CM_S2 5 0 65535 DEPOSIT ABSOLUTE /end AXIS_PTS
/begin CHARACTERISTIC XTAB2W_DKKD_STOPGO2 "" CURVE 0x1DD540 _REC_A1CUR_30_u2_u2_S2 110 _CNV_R_R_Umr_10_zu__9_CM_S2 0 110
 /begin AXIS_DESCR FIX_AXIS NO_INPUT_QUANTITY _CNV_S_2_Enum_EWL2_122_CM_S2 2 0 1 READ_ONLY FIX_AXIS_PAR_DIST 0 1 2 /end AXIS_DESCR
 FORMAT "%2.0" /end CHARACTERISTIC
/begin CHARACTERISTIC XTAB2W_STEIGUNGGEW_MSA "" CURVE 0x1DE3D6 _REC_A1CUR_30_u1_u1_S2 100 _CNV_R_R_Umr_1_zu_1_2_CM_S2 0 100
 /begin AXIS_DESCR FIX_AXIS NO_INPUT_QUANTITY _CNV_S_2_Enum_ESTEI_250_CM_S2 2 0 1 READ_ONLY /begin FIX_AXIS_PAR_LIST 0 1 /end FIX_AXIS_PAR_LIST /end AXIS_DESCR
 FORMAT "%2.0" /end CHARACTERISTIC
/begin CHARACTERISTIC XTAB2X2C_HSUREFPVOR_DECRVAL "" MAP 0x1DC944 _REC_A1MAP_9_u1_u1_u1_S2 255 _CNV_R_R_Umr_1_zu_1_2_CM_S2 0 255
 /begin AXIS_DESCR FIX_AXIS Z_AGS_MODBEDEL _CNV_S_2_Enum_EAGS_18_CM_S2 2 0 1 READ_ONLY FIX_AXIS_PAR_DIST 0 1 2 /end AXIS_DESCR
 /begin AXIS_DESCR FIX_AXIS FP_DIR_HSURE _CNV_S_2_Enum_EFP_D_101_CM_S2 2 0 1 READ_ONLY FIX_AXIS_PAR_DIST 0 1 2 /end AXIS_DESCR
 FORMAT "%2.0" /end CHARACTERISTIC
/begin CHARACTERISTIC XTAB2X2SCHGW_FP_SDYNGWFP "" MAP 0x1DD494 _REC_A1MAP_9_s2_u2_u2_S2 65535 _CNV_R_R_Umr_1_zu_1_7_CM_S2 -32768 32767
 /begin AXIS_DESCR FIX_AXIS NO_INPUT_QUANTITY _CNV_S_5_Enum_EGWDK_161_CM_S2 2 0 4 READ_ONLY FIX_AXIS_PAR_DIST 0 1 2 /end AXIS_DESCR
 /begin AXIS_DESCR FIX_AXIS NO_INPUT_QUANTITY _CNV_S_2_Enum_ESCHG_167_CM_S2 2 0 1 READ_ONLY FIX_AXIS_PAR_DIST 0 1 2 /end AXIS_DESCR
 FORMAT "%2.0" /end CHARACTERISTIC
/begin CHARACTERISTIC XTAB2X2SCHTEMP_DMRSKS "" MAP 0x1DBFE4 _REC_A1MAP_8_s2_u1_u1_S2 500 _CNV_R_R_Umr_1_zu_1_1_CM_S2 0 500
 /begin AXIS_DESCR FIX_AXIS NO_INPUT_QUANTITY _CNV_S_2_Enum_MFRSK_80_CM_S2 2 1 2 READ_ONLY FIX_AXIS_PAR_DIST 1 1 2 /end AXIS_DESCR
 /begin AXIS_DESCR FIX_AXIS Z_GANG_ZIEL _CNV_S_9_Enum_EGANG_21_CM_S2 2 0 8 READ_ONLY FIX_AXIS_PAR_DIST 6 1 2 /end AXIS_DESCR
 FORMAT "%2.0" /end CHARACTERISTIC
/begin CHARACTERISTIC XTAB2X2SCHTEMP_SDYNTEMP "" MAP 0x1DD49C _REC_A1MAP_9_s2_u1_u1_S2 240 _CNV_R_R_Umr_1_zu_1_1_CM_S2 -40 200
 /begin AXIS_DESCR FIX_AXIS NO_INPUT_QUANTITY _CNV_S_2_Enum_ESDYN_155_CM_S2 2 0 1 READ_ONLY /begin FIX_AXIS_PAR_LIST 0 1 /end FIX_AXIS_PAR_LIST /end AXIS_DESCR
 /begin AXIS_DESCR FIX_AXIS NO_INPUT_QUANTITY _CNV_S_2_Enum_ESCHT_154_CM_S2 2 0 1 READ_ONLY /begin FIX_AXIS_PAR_LIST 0 1 /end FIX_AXIS_PAR_LIST /end AXIS_DESCR
 FORMAT "%2.0" /end CHARACTERISTIC
/begin CHARACTERISTIC XTAB2X2T_SEQUENZER_LDMHS_ZKA "" MAP 0x1DD5D0 _REC_A1MAP_8_s4_u1_u1_S2 10000 _CNV_R_R_Umr_1_zu_1_67_CM_S2 0 10000
 /begin AXIS_DESCR FIX_AXIS S_LDM_STELLUNSTETIGKEIT _CNV_R_R_Umr_1_zu_1_2_CM_S2 2 0 255 READ_ONLY /begin FIX_AXIS_PAR_LIST 0 1 /end FIX_AXIS_PAR_LIST /end AXIS_DESCR
 /begin AXIS_DESCR FIX_AXIS S_LDMBAB_ENBL _CNV_P_2_A_I_5_CM_S2 2 0 255 READ_ONLY /begin FIX_AXIS_PAR_LIST 0 1 /end FIX_AXIS_PAR_LIST /end AXIS_DESCR
 FORMAT "%2.0" /end CHARACTERISTIC
/begin CHARACTERISTIC XTAB2X2T_SEQUENZER_LDMRS_ZKA "" MAP 0x1DD5E0 _REC_A1MAP_8_s4_u1_u1_S2 10000 _CNV_R_R_Umr_1_zu_1_67_CM_S2 0 10000
 /begin AXIS_DESCR FIX_AXIS S_LDM_STELLUNSTETIGKEIT _CNV_R_R_Umr_1_zu_1_2_CM_S2 2 0 255 READ_ONLY /begin FIX_AXIS_PAR_LIST 0 1 /end FIX_AXIS_PAR_LIST /end AXIS_DESCR
 /begin AXIS_DESCR FIX_AXIS S_LDMBAB_ENBL _CNV_P_2_A_I_5_CM_S2 2 0 255 READ_ONLY /begin FIX_AXIS_PAR_LIST 0 1 /end FIX_AXIS_PAR_LIST /end AXIS_DESCR
 FORMAT "%2.0" /end CHARACTERISTIC
/begin CHARACTERISTIC XTAB2X2W_STEIGUNG_KORGEW "" MAP 0x1DD4E0 _REC_A1MAP_9_s2_u1_u1_S2 32767 _CNV_R_R_Umr_1_zu_1_2_CM_S2 0 32767
 /begin AXIS_DESCR FIX_AXIS S_STEIGUNG_FILT_SCHNELL _CNV_S_2_Schalter_A_4_CM_S2 2 0 1 READ_ONLY /begin FIX_AXIS_PAR_LIST 0 1 /end FIX_AXIS_PAR_LIST /end AXIS_DESCR
 /begin AXIS_DESCR FIX_AXIS NO_INPUT_QUANTITY _CNV_S_2_Enum_EGEW__13_CM_S2 2 0 1 READ_ONLY /begin FIX_AXIS_PAR_LIST 0 1 /end FIX_AXIS_PAR_LIST /end AXIS_DESCR
 FORMAT "%2.0" /end CHARACTERISTIC
/begin CHARACTERISTIC XTAB2X5ON_T_ARSDYNMAX_DBM "" MAP 0x1DB56C _REC_S3MAP_54_s2_s2_u1_S2 10000 _CNV_R_R_Umr_1_zu_1_3_CM_S2 0 10000
 /begin AXIS_DESCR STD_AXIS NO_INPUT_QUANTITY _CNV_R_R_Umr_1_zu_1_3_CM_S2 5 -32768 32767 DEPOSIT ABSOLUTE FORMAT "%2.0" /end AXIS_DESCR
 /begin AXIS_DESCR FIX_AXIS Z_AGS_MODBEDEL _CNV_S_2_Enum_EAGS_18_CM_S2 2 0 1 READ_ONLY FIX_AXIS_PAR_DIST 0 1 2 /end AXIS_DESCR
 FORMAT "%2.0" /end CHARACTERISTIC
/begin CHARACTERISTIC XTAB2X6FWS_FILTGEW_MODAFB "" MAP 0x1DF35C _REC_S3MAP_54_s2_s2_u1_S2 10000 _CNV_R_R_Umr_1_zu_1_2_CM_S2 0 10000
 /begin AXIS_DESCR STD_AXIS DM_AB_FWSDELTA _CNV_R_R_Umr_1_zu_1_38_CM_S2 6 -32768 32767 DEPOSIT ABSOLUTE FORMAT "%2.0" /end AXIS_DESCR
 /begin AXIS_DESCR FIX_AXIS NO_INPUT_QUANTITY _CNV_S_2_Enum_EGEW__13_CM_S2 2 0 1 READ_ONLY /begin FIX_AXIS_PAR_LIST 0 1 /end FIX_AXIS_PAR_LIST /end AXIS_DESCR
 FORMAT "%2.0" /end CHARACTERISTIC
/begin CHARACTERISTIC XTAB2X9DM_AB_FWSBAB "" MAP 0x1DD610 _REC_A1MAP_9_s2_u1_u1_S2 1500 _CNV_R_R_Umr_1_zu_1_38_CM_S2 -1000 500
 /begin AXIS_DESCR FIX_AXIS S_BAB_FGRKF _CNV_S_2_Enum_EBABF_41_CM_S2 2 0 1 READ_ONLY FIX_AXIS_PAR_DIST 0 1 2 /end AXIS_DESCR
 /begin AXIS_DESCR FIX_AXIS Z_GANG_RSZFWS _CNV_S_9_Enum_EGANG_21_CM_S2 9 0 8 READ_ONLY FIX_AXIS_PAR_DIST 0 1 9 /end AXIS_DESCR
 FORMAT "%2.0" /end CHARACTERISTIC
/begin CHARACTERISTIC XTAB2X9T_RS_MAB "" MAP 0x1DC98C _REC_A1MAP_9_u4_u1_u1_S2 2048 _CNV_R_R_Umr_1_zu_1_6_CM_S2 0 2048
 /begin AXIS_DESCR FIX_AXIS S_COD_MAB _CNV_R_R_Umr_1_zu_1_2_CM_S2 2 0 255 READ_ONLY FIX_AXIS_PAR_DIST 0 1 2 /end AXIS_DESCR
 /begin AXIS_DESCR FIX_AXIS Z_GANG_ZIEL _CNV_S_9_Enum_EGANG_21_CM_S2 9 0 8 READ_ONLY FIX_AXIS_PAR_DIST 0 1 9 /end AXIS_DESCR
 FORMAT "%2.0" /end CHARACTERISTIC
/begin CHARACTERISTIC XTAB2X9_RELATION_N_VAHA_DOWN "" MAP 0x1DE428 _REC_A1MAP_9_u1_u1_u1_S2 2 _CNV_R_R_Umr_100_zu_42_CM_S2 0 2
 /begin AXIS_DESCR FIX_AXIS NO_INPUT_QUANTITY _CNV_R_R_Umr_1_zu_1_2_CM_S2 2 0 255 READ_ONLY /begin FIX_AXIS_PAR_LIST 0 1 /end FIX_AXIS_PAR_LIST /end AXIS_DESCR
 /begin AXIS_DESCR FIX_AXIS Z_GANG_ZIEL_SSTEP _CNV_S_9_Enum_EGANG_21_CM_S2 9 0 8 READ_ONLY FIX_AXIS_PAR_DIST 0 1 9 /end AXIS_DESCR
 FORMAT "%4.2" /end CHARACTERISTIC
/begin CHARACTERISTIC XTAB2X9_RELATION_N_VAHA_UP "" MAP 0x1DE43A _REC_A1MAP_9_u1_u1_u1_S2 2 _CNV_R_R_Umr_100_zu_42_CM_S2 0 2
 /begin AXIS_DESCR FIX_AXIS NO_INPUT_QUANTITY _CNV_R_R_Umr_1_zu_1_2_CM_S2 2 0 255 READ_ONLY /begin FIX_AXIS_PAR_LIST 0 1 /end FIX_AXIS_PAR_LIST /end AXIS_DESCR
 /begin AXIS_DESCR FIX_AXIS Z_GANG_ZIEL_SSTEP _CNV_S_9_Enum_EGANG_21_CM_S2 9 0 8 READ_ONLY FIX_AXIS_PAR_DIST 0 1 9 /end AXIS_DESCR
 FORMAT "%4.2" /end CHARACTERISTIC
/begin CHARACTERISTIC XTAB2Z_GANG_MIN_BAB "" CURVE 0x1E24BA _REC_A1CUR_30_u1_u1_S2 8 _CNV_S_9_Enum_EGANG_21_CM_S2 0 8
 /begin AXIS_DESCR FIX_AXIS Z_AGS_MODBEDEL _CNV_S_2_Enum_EAGS_18_CM_S2 2 0 1 READ_ONLY FIX_AXIS_PAR_DIST 0 1 2 /end AXIS_DESCR
/end CHARACTERISTIC
/begin CHARACTERISTIC XTAB2Z_GANG_MIN_MAB "" CURVE 0x1DF356 _REC_A1CUR_30_u1_u1_S2 8 _CNV_S_9_Enum_EGANG_21_CM_S2 0 8
 /begin AXIS_DESCR FIX_AXIS S_COD_MAB _CNV_R_R_Umr_1_zu_1_2_CM_S2 2 0 255 READ_ONLY FIX_AXIS_PAR_DIST 0 1 2 /end AXIS_DESCR
/end CHARACTERISTIC
/begin CHARACTERISTIC XTAB2Z_GANG_RSSEQ_MAB "" CURVE 0x1DF358 _REC_A1CUR_30_u1_u1_S2 8 _CNV_S_9_Enum_EGANG_21_CM_S2 0 8
 /begin AXIS_DESCR FIX_AXIS S_COD_MAB _CNV_R_R_Umr_1_zu_1_2_CM_S2 2 0 255 READ_ONLY FIX_AXIS_PAR_DIST 0 1 2 /end AXIS_DESCR
/end CHARACTERISTIC
/begin CHARACTERISTIC XTAB2Z_SPORT "" CURVE 0x1DE908 _REC_A1CUR_30_u1_u1_S2 1 _CNV_S_2_Enum_ESPOR_193_CM_S2 0 1
 /begin AXIS_DESCR FIX_AXIS S_COD_GETRTYP _CNV_S_2_Enum_ECOD__16_CM_S2 2 0 1 READ_ONLY FIX_AXIS_PAR_DIST 0 1 2 /end AXIS_DESCR
/end CHARACTERISTIC
/begin CHARACTERISTIC XTAB2_DSC_TASTER_ZHSAUS "" CURVE 0x1DE4B8 _REC_A1CUR_30_u1_u1_S2 2 _CNV_S_3_Enum_EDSC__139_CM_S2 0 2
 /begin AXIS_DESCR FIX_AXIS NO_INPUT_QUANTITY _CNV_R_R_Umr_1_zu_1_2_CM_S2 2 0 255 READ_ONLY /begin FIX_AXIS_PAR_LIST 0 1 /end FIX_AXIS_PAR_LIST /end AXIS_DESCR
/end CHARACTERISTIC
/begin CHARACTERISTIC XTAB32S_EXCFKT_BDLENB_D "" CURVE 0x1DCAF0 _REC_A1CUR_30_u1_u2_S2 1 _CNV_R_R_Umr_1_zu_1_2_CM_S2 0 1
 /begin AXIS_DESCR FIX_AXIS NO_INPUT_QUANTITY _CNV_S_32_Enum_EEXCF_19_CM_S2 32 0 31 READ_ONLY FIX_AXIS_PAR_DIST 0 1 32 /end AXIS_DESCR
 FORMAT "%2.0" /end CHARACTERISTIC
/begin CHARACTERISTIC XTAB32S_EXCFKT_BDLENB_N "" CURVE 0x1DCB10 _REC_A1CUR_30_u1_u2_S2 1 _CNV_R_R_Umr_1_zu_1_2_CM_S2 0 1
 /begin AXIS_DESCR FIX_AXIS NO_INPUT_QUANTITY _CNV_S_32_Enum_EEXCF_19_CM_S2 32 0 31 READ_ONLY FIX_AXIS_PAR_DIST 0 1 32 /end AXIS_DESCR
 FORMAT "%2.0" /end CHARACTERISTIC
/begin CHARACTERISTIC XTAB32S_EXCFKT_BDLENB_P "" CURVE 0x1DCB30 _REC_A1CUR_30_u1_u2_S2 1 _CNV_R_R_Umr_1_zu_1_2_CM_S2 0 1
 /begin AXIS_DESCR FIX_AXIS NO_INPUT_QUANTITY _CNV_S_32_Enum_EEXCF_19_CM_S2 32 0 31 READ_ONLY FIX_AXIS_PAR_DIST 0 1 32 /end AXIS_DESCR
 FORMAT "%2.0" /end CHARACTERISTIC
/begin CHARACTERISTIC XTAB32S_EXCFKT_BDLENB_R "" CURVE 0x1DCB50 _REC_A1CUR_30_u1_u2_S2 1 _CNV_R_R_Umr_1_zu_1_2_CM_S2 0 1
 /begin AXIS_DESCR FIX_AXIS NO_INPUT_QUANTITY _CNV_S_32_Enum_EEXCF_19_CM_S2 32 0 31 READ_ONLY FIX_AXIS_PAR_DIST 0 1 32 /end AXIS_DESCR
 FORMAT "%2.0" /end CHARACTERISTIC
/begin CHARACTERISTIC XTAB32S_EXCFKT_GLBENBL "" CURVE 0x1DAE18 _REC_A1CUR_30_u1_u2_S2 1 _CNV_R_R_Umr_1_zu_1_2_CM_S2 0 1
 /begin AXIS_DESCR FIX_AXIS NO_INPUT_QUANTITY _CNV_S_32_Enum_EEXCF_19_CM_S2 32 0 31 READ_ONLY FIX_AXIS_PAR_DIST 0 1 32 /end AXIS_DESCR
 FORMAT "%2.0" /end CHARACTERISTIC
/begin CHARACTERISTIC XTAB3DC_SCHLEPP_KICKFAST "" CURVE 0x1E2602 _REC_A1CUR_30_s2_u1_S2 65535 _CNV_R_R_Umr_1_zu_1_2_CM_S2 -32768 32767
 /begin AXIS_DESCR FIX_AXIS Z_FT _CNV_S_4_Enum_EFT_20_CM_S2 3 0 3 READ_ONLY FIX_AXIS_PAR_DIST 0 1 3 /end AXIS_DESCR
 FORMAT "%2.0" /end CHARACTERISTIC
/begin CHARACTERISTIC XTAB3HN_MOT_ABREGEL "" CURVE 0x1DF31C _REC_S7CUR_53_u2_u2_S2 2000 _CNV_R_R_Umr_1_zu_1_3_CM_S2 0 2000
 /begin AXIS_DESCR STD_AXIS N_MOT_ABREGEL_ROH _CNV_R_R_Umr_1_zu_1_3_CM_S2 3 0 10000 DEPOSIT ABSOLUTE FORMAT "%2.0" /end AXIS_DESCR
 FORMAT "%2.0" /end CHARACTERISTIC
/begin CHARACTERISTIC XTAB3N_AB_OUTGEW "" CURVE 0x1DE61A _REC_S7CUR_53_u2_s2_S2 250 _CNV_R_R_Umr_1_zu_1_2_CM_S2 0 250
 /begin AXIS_DESCR STD_AXIS GN_T _CNV_R_R_Umr_100_zu_194_CM_S2 3 -327.68 327.67 DEPOSIT ABSOLUTE FORMAT "%4.2" /end AXIS_DESCR
 FORMAT "%2.0" /end CHARACTERISTIC
/begin CHARACTERISTIC XTAB3ODM_AB_FWS_PLUFT "" CURVE 0x1DEB30 _REC_S7CUR_53_s2_u2_S2 1000 _CNV_R_R_Umr_1_zu_1_38_CM_S2 0 1000
 /begin AXIS_DESCR STD_AXIS NO_INPUT_QUANTITY _CNV_R_R_Umr_1_zu_1_239_CM_S2 3 500 1100 DEPOSIT ABSOLUTE FORMAT "%2.0" /end AXIS_DESCR
 FORMAT "%2.0" /end CHARACTERISTIC
/begin CHARACTERISTIC XTAB3SCHGM_MOT_FW_HKOR "" CURVE 0x1DED1C _REC_S7CUR_53_u2_u2_S2 250 _CNV_R_R_Umr_1_zu_1_2_CM_S2 0 250
 /begin AXIS_DESCR STD_AXIS P_LUFT _CNV_R_R_Umr_1_zu_1_0_CM_S2 3 598 1108 DEPOSIT ABSOLUTE FORMAT "%2.0" /end AXIS_DESCR
 FORMAT "%2.0" /end CHARACTERISTIC
/begin CHARACTERISTIC XTAB3SCHM_MOT_FW_HKOR "" CURVE 0x1DED2A _REC_S7CUR_53_u2_s2_S2 2500 _CNV_R_R_Umr_1_zu_1_190_CM_S2 0 2500
 /begin AXIS_DESCR STD_AXIS DM_AB_FWSKOR_FILTFAST_BGH _CNV_R_R_Umr_1_zu_1_38_CM_S2 3 -32768 32767 DEPOSIT ABSOLUTE FORMAT "%2.0" /end AXIS_DESCR
 FORMAT "%2.0" /end CHARACTERISTIC
/begin CHARACTERISTIC XTAB3SCHN_MOTSOLLMAX_DBM "" CURVE 0x1DE1C8 _REC_S7CUR_53_u2_u2_S2 32000 _CNV_R_R_Umr_1_zu_1_3_CM_S2 0 32000
 /begin AXIS_DESCR STD_AXIS P_LUFT _CNV_R_R_Umr_1_zu_1_0_CM_S2 3 550 1150 DEPOSIT ABSOLUTE FORMAT "%4.2" /end AXIS_DESCR
 FORMAT "%2.0" /end CHARACTERISTIC
/begin CHARACTERISTIC XTAB3SCHN_TMIN_CGT_DBM "" CURVE 0x1DE1D6 _REC_S7CUR_53_s2_s2_S2 32000 _CNV_R_R_Umr_1_zu_1_3_CM_S2 0 32000
 /begin AXIS_DESCR STD_AXIS TEMP_GETR _CNV_R_R_Umr_1_zu_1_1_CM_S2 3 -32768 32767 DEPOSIT ABSOLUTE FORMAT "%2.0" /end AXIS_DESCR
 FORMAT "%2.0" /end CHARACTERISTIC
/begin CHARACTERISTIC XTAB3SCHW_DKKD_DERS "" CURVE 0x1E269C _REC_S7CUR_53_u2_s2_S2 120 _CNV_R_R_Umr_10_zu__9_CM_S2 0 120
 /begin AXIS_DESCR STD_AXIS DM_RAD_FWS_FILT _CNV_R_R_Umr_1_zu_1_38_CM_S2 3 -32768 32767 DEPOSIT ABSOLUTE FORMAT "%2.0" /end AXIS_DESCR
 FORMAT "%3.1" /end CHARACTERISTIC
/begin CHARACTERISTIC XTAB3T_DERS_HS "" CURVE 0x1E26AA _REC_A1CUR_30_u2_u1_S2 65535 _CNV_R_R_Umr_1_zu_1_2_CM_S2 0 65535
 /begin AXIS_DESCR FIX_AXIS NO_INPUT_QUANTITY _CNV_S_3_Enum_EDERS_191_CM_S2 3 0 2 READ_ONLY FIX_AXIS_PAR_DIST 0 1 3 /end AXIS_DESCR
 FORMAT "%2.0" /end CHARACTERISTIC
/begin CHARACTERISTIC XTAB3X2C_HSUREINST_DECRVAL_LDM "" MAP 0x1DC7D0 _REC_A1MAP_9_u2_u1_u1_S2 255 _CNV_R_R_Umr_1_zu_1_2_CM_S2 0 255
 /begin AXIS_DESCR FIX_AXIS Z_LDMBAB_HSURE_IDX _CNV_S_3_Enum_ELDMA_102_CM_S2 3 0 2 READ_ONLY FIX_AXIS_PAR_DIST 0 1 3 /end AXIS_DESCR
 /begin AXIS_DESCR FIX_AXIS Z_AGS_MODBEDEL _CNV_S_2_Enum_EAGS_18_CM_S2 2 0 1 READ_ONLY FIX_AXIS_PAR_DIST 0 1 2 /end AXIS_DESCR
 FORMAT "%2.0" /end CHARACTERISTIC
/begin CHARACTERISTIC XTAB3X2GEW_FILT_WK_DYNDZM "" MAP 0x1DC4D0 _REC_A1MAP_9_u2_u1_u1_S2 2000 _CNV_R_R_Umr_1_zu_1_2_CM_S2 0 2000
 /begin AXIS_DESCR FIX_AXIS NO_INPUT_QUANTITY _CNV_P_2_A_I_5_CM_S2 3 0 255 READ_ONLY /begin FIX_AXIS_PAR_LIST 0 1 2 /end FIX_AXIS_PAR_LIST /end AXIS_DESCR
 /begin AXIS_DESCR FIX_AXIS NO_INPUT_QUANTITY _CNV_S_2_Enum_EGEW__13_CM_S2 2 0 1 READ_ONLY /begin FIX_AXIS_PAR_LIST 0 1 /end FIX_AXIS_PAR_LIST /end AXIS_DESCR
 FORMAT "%2.0" /end CHARACTERISTIC
/begin CHARACTERISTIC XTAB3X2SCHGM_LDM_INIT_HSUREINST "" MAP 0x1DC7DC _REC_A1MAP_9_s2_u1_u1_S2 20000 _CNV_R_R_Umr_1_zu_1_62_CM_S2 -10000 10000
 /begin AXIS_DESCR FIX_AXIS Z_LDMBAB_HSURE_IDX _CNV_S_3_Enum_ELDMA_102_CM_S2 3 0 2 READ_ONLY FIX_AXIS_PAR_DIST 0 1 3 /end AXIS_DESCR
 /begin AXIS_DESCR FIX_AXIS Z_AGS_MODBEDEL _CNV_S_2_Enum_EAGS_18_CM_S2 2 0 1 READ_ONLY FIX_AXIS_PAR_DIST 0 1 2 /end AXIS_DESCR
 FORMAT "%2.0" /end CHARACTERISTIC
/begin CHARACTERISTIC XTAB3X2SCHGM_LDM_START_HSUREINST "" MAP 0x1DC7E8 _REC_A1MAP_9_s2_u1_u1_S2 20000 _CNV_R_R_Umr_1_zu_1_107_CM_S2 -10000 10000
 /begin AXIS_DESCR FIX_AXIS Z_LDMBAB_HSURE_IDX _CNV_S_3_Enum_ELDMA_102_CM_S2 3 0 2 READ_ONLY FIX_AXIS_PAR_DIST 0 1 3 /end AXIS_DESCR
 /begin AXIS_DESCR FIX_AXIS Z_AGS_MODBEDEL _CNV_S_2_Enum_EAGS_18_CM_S2 2 0 1 READ_ONLY FIX_AXIS_PAR_DIST 0 1 2 /end AXIS_DESCR
 FORMAT "%2.0" /end CHARACTERISTIC
/begin CHARACTERISTIC XTAB3X3CN_AB_DELTANMOTHS_DECR "" MAP 0x1DC130 _REC_S7MAP_53_u2_u2_u2_S2 5000 _CNV_R_R_Umr_1_zu_1_3_CM_S2 0 5000
 /begin AXIS_DESCR STD_AXIS N_AB_DELTANMOTHS _CNV_R_R_Umr_1_zu_1_3_CM_S2 3 0 15000 DEPOSIT ABSOLUTE FORMAT "%2.0" /end AXIS_DESCR
 /begin AXIS_DESCR STD_AXIS N_T _CNV_R_R_Umr_1_zu_1_3_CM_S2 3 0 15000 DEPOSIT ABSOLUTE FORMAT "%2.0" /end AXIS_DESCR
 FORMAT "%2.0" /end CHARACTERISTIC
/begin CHARACTERISTIC XTAB3X3FAKT_HEISSHOCH "" MAP 0x1DD940 _REC_S7MAP_53_u2_s2_u2_S2 500 _CNV_R_R_Umr_1_zu_1_54_CM_S2 0 500
 /begin AXIS_DESCR STD_AXIS TEMP_UMG _CNV_R_R_Umr_1_zu_1_1_CM_S2 3 -50 80 DEPOSIT ABSOLUTE FORMAT "%2.0" /end AXIS_DESCR
 /begin AXIS_DESCR STD_AXIS P_LUFT _CNV_R_R_Umr_1_zu_1_0_CM_S2 3 598 1108 DEPOSIT ABSOLUTE FORMAT "%2.0" /end AXIS_DESCR
 FORMAT "%2.0" /end CHARACTERISTIC
/begin CHARACTERISTIC XTAB3X3SCHW_DKKD_SDYNWDKKD "" MAP 0x1E20C2 _REC_A1MAP_9_u2_u2_u2_S2 110 _CNV_R_R_Umr_10_zu__9_CM_S2 0 110
 /begin AXIS_DESCR FIX_AXIS NO_INPUT_QUANTITY _CNV_S_3_Enum_EWDKK_163_CM_S2 3 0 2 READ_ONLY FIX_AXIS_PAR_DIST 0 1 3 /end AXIS_DESCR
 /begin AXIS_DESCR FIX_AXIS NO_INPUT_QUANTITY _CNV_S_3_Enum_ESCHW_165_CM_S2 3 0 2 READ_ONLY FIX_AXIS_PAR_DIST 0 1 3 /end AXIS_DESCR
 FORMAT "%3.1" /end CHARACTERISTIC
/begin CHARACTERISTIC XTAB3X3SMPL_SCHLUPFGEW_HSURE "" MAP 0x1DEDCC _REC_A1MAP_9_u2_u1_u1_S2 65535 _CNV_R_R_Umr_1_zu_1_2_CM_S2 0 65535
 /begin AXIS_DESCR FIX_AXIS Z_SCHLUPF_ANTRIEB_RR _CNV_S_3_Enum_ESCHL_28_CM_S2 3 0 2 READ_ONLY FIX_AXIS_PAR_DIST 0 1 3 /end AXIS_DESCR
 /begin AXIS_DESCR FIX_AXIS Z_SCHLUPF_ANTRIEB_RL _CNV_S_3_Enum_ESCHL_28_CM_S2 3 0 2 READ_ONLY FIX_AXIS_PAR_DIST 0 1 3 /end AXIS_DESCR
 FORMAT "%2.0" /end CHARACTERISTIC
/begin CHARACTERISTIC XTAB3X3SMPL_SCHLUPF_GEW "" MAP 0x1DF422 _REC_A1MAP_9_u2_u1_u1_S2 65535 _CNV_R_R_Umr_1_zu_1_2_CM_S2 0 65535
 /begin AXIS_DESCR FIX_AXIS Z_SCHLUPF_ANTRIEB_RR _CNV_S_3_Enum_ESCHL_28_CM_S2 3 0 2 READ_ONLY FIX_AXIS_PAR_DIST 0 1 3 /end AXIS_DESCR
 /begin AXIS_DESCR FIX_AXIS Z_SCHLUPF_ANTRIEB_RL _CNV_S_3_Enum_ESCHL_28_CM_S2 3 0 2 READ_ONLY FIX_AXIS_PAR_DIST 0 1 3 /end AXIS_DESCR
 FORMAT "%2.0" /end CHARACTERISTIC
/begin CHARACTERISTIC XTAB3X3T_KURVE_NACHL "" MAP 0x1DF28A _REC_S3MAP_54_u2_u2_u1_S2 10000 _CNV_R_R_Umr_1_zu_1_6_CM_S2 0 10000
 /begin AXIS_DESCR STD_AXIS V_FZG _CNV_R_R_Umr_1_zu_1_8_CM_S2 3 0 250 DEPOSIT ABSOLUTE FORMAT "%2.0" /end AXIS_DESCR
 /begin AXIS_DESCR FIX_AXIS Z_AGS_TID_MOD _CNV_S_3_Enum_EAGST_248_CM_S2 3 0 2 READ_ONLY FIX_AXIS_PAR_DIST 0 1 3 /end AXIS_DESCR
 FORMAT "%2.0" /end CHARACTERISTIC
/begin CHARACTERISTIC XTAB3X4_KICKFAST "" MAP 0x1DD960 _REC_A1MAP_9_s2_u1_u1_S2 65535 _CNV_R_R_Umr_1_zu_1_7_CM_S2 -32768 32767
 /begin AXIS_DESCR FIX_AXIS Z_FT _CNV_S_4_Enum_EFT_20_CM_S2 3 0 3 READ_ONLY FIX_AXIS_PAR_DIST 0 1 3 /end AXIS_DESCR
 /begin AXIS_DESCR FIX_AXIS Z_FT _CNV_S_4_Enum_EFT_20_CM_S2 4 0 3 READ_ONLY FIX_AXIS_PAR_DIST 0 1 4 /end AXIS_DESCR
 FORMAT "%2.0" /end CHARACTERISTIC
/begin CHARACTERISTIC XTAB3X5C_HSUKS_DECRVAL_IDX1 "" MAP 0x1DDA20 _REC_S7MAP_53_u2_u2_s2_S2 255 _CNV_R_R_Umr_1_zu_1_2_CM_S2 0 255
 /begin AXIS_DESCR STD_AXIS N_MOT _CNV_R_R_Umr_1_zu_1_3_CM_S2 3 0 10000 DEPOSIT ABSOLUTE FORMAT "%2.0" /end AXIS_DESCR
 /begin AXIS_DESCR STD_AXIS TEMP_KUP_A _CNV_R_R_Umr_1_zu_1_1_CM_S2 5 -40 500 DEPOSIT ABSOLUTE FORMAT "%2.0" /end AXIS_DESCR
 FORMAT "%2.0" /end CHARACTERISTIC
/begin CHARACTERISTIC XTAB3X5C_HSUKS_DECRVAL_IDX2 "" MAP 0x1DDA50 _REC_S7MAP_53_u2_u2_s2_S2 255 _CNV_R_R_Umr_1_zu_1_2_CM_S2 0 255
 /begin AXIS_DESCR STD_AXIS N_MOT _CNV_R_R_Umr_1_zu_1_3_CM_S2 3 0 10000 DEPOSIT ABSOLUTE FORMAT "%2.0" /end AXIS_DESCR
 /begin AXIS_DESCR STD_AXIS TEMP_KUP_A _CNV_R_R_Umr_1_zu_1_1_CM_S2 5 -40 500 DEPOSIT ABSOLUTE FORMAT "%2.0" /end AXIS_DESCR
 FORMAT "%2.0" /end CHARACTERISTIC
/begin CHARACTERISTIC XTAB3X5T_AUSROLLRS_DBM "" MAP 0x1DDF9E _REC_S3MAP_54_s2_u2_u1_S2 2500 _CNV_R_R_Umr_1_zu_1_6_CM_S2 0 2500
 /begin AXIS_DESCR STD_AXIS N_T _CNV_R_R_Umr_1_zu_1_3_CM_S2 5 0 65535 DEPOSIT ABSOLUTE FORMAT "%2.0" /end AXIS_DESCR
 /begin AXIS_DESCR FIX_AXIS Z_SCHALTDYN _CNV_S_7_Enum_ESDYN_175_CM_S2 3 0 6 READ_ONLY /begin FIX_AXIS_PAR_LIST 0 1 2 /end FIX_AXIS_PAR_LIST /end AXIS_DESCR
 FORMAT "%2.0" /end CHARACTERISTIC
/begin CHARACTERISTIC XTAB3X9ON_AB_RSSTPR_HOTDUE "" MAP 0x1DE44C _REC_A1MAP_9_s2_u1_u1_S2 10000 _CNV_R_R_Umr_1_zu_1_3_CM_S2 -1000 9000
 /begin AXIS_DESCR FIX_AXIS Z_HOTDUE _CNV_S_3_Enum_EHOTD_137_CM_S2 3 0 2 READ_ONLY FIX_AXIS_PAR_DIST 0 1 3 /end AXIS_DESCR
 /begin AXIS_DESCR FIX_AXIS Z_GANG_ZIEL_SSTEP _CNV_S_9_Enum_EGANG_21_CM_S2 9 0 8 READ_ONLY FIX_AXIS_PAR_DIST 0 1 9 /end AXIS_DESCR
 FORMAT "%2.0" /end CHARACTERISTIC
/begin CHARACTERISTIC XTAB3X9SCHN_AB_HSURERS "" MAP 0x1DEFFA _REC_A1MAP_9_u2_u1_u1_S2 15000 _CNV_R_R_Umr_1_zu_1_2_CM_S2 0 15000
 /begin AXIS_DESCR FIX_AXIS Z_NABHSURERS_FFG _CNV_S_4_Enum_ENABH_93_CM_S2 3 0 3 READ_ONLY FIX_AXIS_PAR_DIST 1 1 3 /end AXIS_DESCR
 /begin AXIS_DESCR FIX_AXIS Z_GANG_ZIEL_HSURE _CNV_S_9_Enum_EGANG_21_CM_S2 9 0 8 READ_ONLY FIX_AXIS_PAR_DIST 0 1 9 /end AXIS_DESCR
 FORMAT "%2.0" /end CHARACTERISTIC
/begin CHARACTERISTIC XTAB3X9SCHN_MOT_QS_DOWNGRADE "" MAP 0x1DE3E8 _REC_A1MAP_9_u2_u1_u2_S2 8160 _CNV_R_R_Umr_1_zu_1_3_CM_S2 0 8160
 /begin AXIS_DESCR FIX_AXIS Z_GANG_IST _CNV_S_9_Enum_EGANG_21_CM_S2 9 0 8 READ_ONLY FIX_AXIS_PAR_DIST 0 1 9 /end AXIS_DESCR
 /begin AXIS_DESCR FIX_AXIS NO_INPUT_QUANTITY _CNV_S_3_Enum_EQS_D_166_CM_S2 3 0 2 READ_ONLY FIX_AXIS_PAR_DIST 0 1 3 /end AXIS_DESCR
 FORMAT "%2.0" /end CHARACTERISTIC
/begin CHARACTERISTIC XTAB3Z_FT_KICKFAST "" CURVE 0x1D9797 _REC_A1CUR_30_u1_u1_S2 3 _CNV_R_R_Umr_1_zu_1_2_CM_S2 0 3
 /begin AXIS_DESCR FIX_AXIS Z_FT _CNV_S_4_Enum_EFT_20_CM_S2 3 0 3 READ_ONLY FIX_AXIS_PAR_DIST 0 1 3 /end AXIS_DESCR
 FORMAT "%2.0" /end CHARACTERISTIC
/begin CHARACTERISTIC XTAB3Z_MMOT_DYNDZM "" CURVE 0x1DEA7E _REC_S7CUR_53_u2_s2_S2 1 _CNV_R_R_Umr_1_zu_1_2_CM_S2 1 2
 /begin AXIS_DESCR STD_AXIS M_MOT_STAT _CNV_R_R_Umr_1_zu_1_38_CM_S2 3 -32768 32767 DEPOSIT ABSOLUTE FORMAT "%2.0" /end AXIS_DESCR
/end CHARACTERISTIC
/begin CHARACTERISTIC XTAB4C_ABREGLER_DECRVAL "" CURVE 0x1DF39C _REC_S7CUR_53_u2_u2_S2 65535 _CNV_R_R_Umr_1_zu_1_2_CM_S2 0 65535
 /begin AXIS_DESCR STD_AXIS N_MOT_HSVIRT _CNV_R_R_Umr_1_zu_1_3_CM_S2 4 0 10000 DEPOSIT ABSOLUTE FORMAT "%2.0" /end AXIS_DESCR
 FORMAT "%2.0" /end CHARACTERISTIC
/begin CHARACTERISTIC XTAB4C_FT_MAX "" CURVE 0x1DD8EC _REC_A1CUR_30_s2_u1_S2 65535 _CNV_R_R_Umr_1_zu_1_2_CM_S2 -32768 32767
 /begin AXIS_DESCR FIX_AXIS Z_FT _CNV_S_4_Enum_EFT_20_CM_S2 4 0 3 READ_ONLY FIX_AXIS_PAR_DIST 0 1 4 /end AXIS_DESCR
 FORMAT "%2.0" /end CHARACTERISTIC
/begin CHARACTERISTIC XTAB4C_FT_MIN "" CURVE 0x1DD8F4 _REC_A1CUR_30_s2_u1_S2 65535 _CNV_R_R_Umr_1_zu_1_2_CM_S2 -32768 32767
 /begin AXIS_DESCR FIX_AXIS Z_FT _CNV_S_4_Enum_EFT_20_CM_S2 4 0 3 READ_ONLY FIX_AXIS_PAR_DIST 0 1 4 /end AXIS_DESCR
 FORMAT "%2.0" /end CHARACTERISTIC
/begin CHARACTERISTIC XTAB4C_FT_MIT "" CURVE 0x1DD8FC _REC_A1CUR_30_s2_u1_S2 65535 _CNV_R_R_Umr_1_zu_1_2_CM_S2 -32768 32767
 /begin AXIS_DESCR FIX_AXIS Z_FT _CNV_S_4_Enum_EFT_20_CM_S2 4 0 3 READ_ONLY FIX_AXIS_PAR_DIST 0 1 4 /end AXIS_DESCR
 FORMAT "%2.0" /end CHARACTERISTIC
/begin CHARACTERISTIC XTAB4DAQ_KURVE_HSURE "" CURVE 0x1DC914 _REC_A1CUR_30_s2_u1_S2 100 _CNV_R_R_Umr_10_zu__108_CM_S2 0 100
 /begin AXIS_DESCR FIX_AXIS Z_MOD_KURVE_HSURE _CNV_S_4_Enum_EHSUR_105_CM_S2 4 0 3 READ_ONLY FIX_AXIS_PAR_DIST 0 1 4 /end AXIS_DESCR
 FORMAT "%3.1" /end CHARACTERISTIC
/begin CHARACTERISTIC XTAB4FAKT_AQ_HSUREKU "" CURVE 0x1DEF60 _REC_S7CUR_53_u2_u2_S2 2 _CNV_R_R_Umr_100_zu_42_CM_S2 0 2
 /begin AXIS_DESCR STD_AXIS V_FZG _CNV_R_R_Umr_1_zu_1_8_CM_S2 4 0 400 DEPOSIT ABSOLUTE FORMAT "%2.0" /end AXIS_DESCR
 FORMAT "%4.2" /end CHARACTERISTIC
/begin CHARACTERISTIC XTAB4FAKT_N_HS_DYN "" CURVE 0x1DF464 _REC_S7CUR_53_u2_u2_S2 200 _CNV_R_R_Umr_1_zu_1_30_CM_S2 0 200
 /begin AXIS_DESCR STD_AXIS N_MOT_HSVIRT_STAT _CNV_R_R_Umr_1_zu_1_3_CM_S2 4 0 12000 DEPOSIT ABSOLUTE FORMAT "%3.1" /end AXIS_DESCR
 FORMAT "%3.1" /end CHARACTERISTIC
/begin CHARACTERISTIC XTAB4M_AB_BREMS "" CURVE 0x1E276E _REC_S7CUR_53_s2_u2_S2 32768 _CNV_R_R_Umr_1_zu_1_38_CM_S2 -32768 0
 /begin AXIS_DESCR STD_AXIS P_BR _CNV_R_R_Umr_2_zu_1_179_CM_S2 4 0 254 DEPOSIT ABSOLUTE FORMAT "%2.0" /end AXIS_DESCR
 FORMAT "%2.0" /end CHARACTERISTIC
/begin CHARACTERISTIC XTAB4SCHDM_RFWS_EIN_DBM "" CURVE 0x1DB58C _REC_A1CUR_30_s2_u1_S2 65535 _CNV_R_R_Umr_1_zu_1_38_CM_S2 -32768 32767
 /begin AXIS_DESCR FIX_AXIS Z_AGSMOD_ECO_EFAHREN _CNV_S_4_Enum_EAGS__17_CM_S2 4 0 3 READ_ONLY FIX_AXIS_PAR_DIST 0 1 4 /end AXIS_DESCR
 FORMAT "%2.0" /end CHARACTERISTIC
/begin CHARACTERISTIC XTAB4SCH_N_RATIO_ANZEIGE "" CURVE 0x1DBFEC _REC_A1CUR_30_s2_u1_S2 20 _CNV_R_R_Umr_100_zu_42_CM_S2 -10 10
 /begin AXIS_DESCR FIX_AXIS Z_SCHALTUNGSTYP _CNV_S_4_Enum_ESCHA_151_R_CM_S2 4 0 4 READ_ONLY FIX_AXIS_PAR_DIST 0 1 4 /end AXIS_DESCR
 FORMAT "%4.2" /end CHARACTERISTIC
/begin CHARACTERISTIC XTAB4S_SOC_AGSMOD_HSURETYPE "" CURVE 0x1DC6B0 _REC_A1CUR_30_u1_u1_S2 1 _CNV_R_R_Umr_1_zu_1_2_CM_S2 0 1
 /begin AXIS_DESCR FIX_AXIS Z_AGSMOD_ECO_EFAHREN _CNV_S_4_Enum_EAGS__17_CM_S2 4 0 3 READ_ONLY FIX_AXIS_PAR_DIST 0 1 4 /end AXIS_DESCR
 FORMAT "%2.0" /end CHARACTERISTIC
/begin CHARACTERISTIC XTAB4S_SOC_NMOTMAXRS_BAB "" CURVE 0x1DD634 _REC_A1CUR_30_u1_u1_S2 1 _CNV_R_R_Umr_1_zu_1_2_CM_S2 0 1
 /begin AXIS_DESCR FIX_AXIS Z_AGSMOD_ECO_EFAHREN _CNV_S_4_Enum_EAGS__17_CM_S2 4 0 3 READ_ONLY FIX_AXIS_PAR_DIST 0 1 4 /end AXIS_DESCR
 FORMAT "%2.0" /end CHARACTERISTIC
/begin CHARACTERISTIC XTAB4T_QSHIFTMFRS_ACTIVE "" CURVE 0x1E20D4 _REC_S7CUR_53_u2_s2_S2 65535 _CNV_R_R_Umr_1_zu_1_6_CM_S2 0 65535
 /begin AXIS_DESCR STD_AXIS TEMP_GETR _CNV_R_R_Umr_1_zu_1_1_CM_S2 4 -200 200 DEPOSIT ABSOLUTE FORMAT "%2.0" /end AXIS_DESCR
 FORMAT "%2.0" /end CHARACTERISTIC
/begin CHARACTERISTIC XTAB4X10DMABFWS_FILT_GEW "" MAP 0x1DEB54 _REC_S3MAP_54_s2_s2_u2_S2 10000 _CNV_R_R_Umr_1_zu_1_2_CM_S2 0 10000
 /begin AXIS_DESCR STD_AXIS DM_AB_FWSDELTA _CNV_R_R_Umr_1_zu_1_38_CM_S2 10 -32768 32767 DEPOSIT ABSOLUTE FORMAT "%2.0" /end AXIS_DESCR
 /begin AXIS_DESCR FIX_AXIS NO_INPUT_QUANTITY _CNV_S_4_Enum_EFILT_238_CM_S2 4 0 3 READ_ONLY FIX_AXIS_PAR_DIST 0 1 4 /end AXIS_DESCR
 FORMAT "%2.0" /end CHARACTERISTIC
/begin CHARACTERISTIC XTAB4X10DM_RAD_FWSKOMP_GEW "" MAP 0x1DF1E0 _REC_S3MAP_54_s2_s2_u2_S2 10000 _CNV_R_R_Umr_1_zu_1_2_CM_S2 0 10000
 /begin AXIS_DESCR STD_AXIS DM_AB_FWSDELTA _CNV_R_R_Umr_1_zu_1_38_CM_S2 10 -32768 32767 DEPOSIT ABSOLUTE FORMAT "%2.0" /end AXIS_DESCR
 /begin AXIS_DESCR FIX_AXIS NO_INPUT_QUANTITY _CNV_S_4_Enum_EFILT_238_CM_S2 4 0 3 READ_ONLY FIX_AXIS_PAR_DIST 0 1 4 /end AXIS_DESCR
 FORMAT "%2.0" /end CHARACTERISTIC
/begin CHARACTERISTIC XTAB4X10FWSKOR_FAST_GEW "" MAP 0x1DEBBA _REC_S3MAP_54_s2_s2_u2_S2 10000 _CNV_R_R_Umr_1_zu_1_2_CM_S2 0 10000
 /begin AXIS_DESCR STD_AXIS DM_AB_FWSDELTA _CNV_R_R_Umr_1_zu_1_38_CM_S2 10 -32768 32767 DEPOSIT ABSOLUTE FORMAT "%2.0" /end AXIS_DESCR
 /begin AXIS_DESCR FIX_AXIS NO_INPUT_QUANTITY _CNV_S_4_Enum_EFILT_238_CM_S2 4 0 3 READ_ONLY FIX_AXIS_PAR_DIST 0 1 4 /end AXIS_DESCR
 FORMAT "%2.0" /end CHARACTERISTIC
/begin CHARACTERISTIC XTAB4X10FWSKOR_SLOW_GEW "" MAP 0x1DEC20 _REC_S3MAP_54_s2_s2_u2_S2 10000 _CNV_R_R_Umr_1_zu_1_2_CM_S2 0 10000
 /begin AXIS_DESCR STD_AXIS DM_AB_FWSDELTA _CNV_R_R_Umr_1_zu_1_38_CM_S2 10 -32768 32767 DEPOSIT ABSOLUTE FORMAT "%2.0" /end AXIS_DESCR
 /begin AXIS_DESCR FIX_AXIS NO_INPUT_QUANTITY _CNV_S_4_Enum_EFILT_238_CM_S2 4 0 3 READ_ONLY FIX_AXIS_PAR_DIST 0 1 4 /end AXIS_DESCR
 FORMAT "%2.0" /end CHARACTERISTIC
/begin CHARACTERISTIC XTAB4X12W_DKKD_PS "" MAP 0x1DDE48 _REC_S3MAP_54_u2_u2_u2_S2 110 _CNV_R_R_Umr_10_zu__9_CM_S2 0 110
 /begin AXIS_DESCR STD_AXIS W_DKKD _CNV_R_R_Umr_10_zu__9_CM_S2 12 0 110 DEPOSIT ABSOLUTE FORMAT "%3.1" /end AXIS_DESCR
 /begin AXIS_DESCR FIX_AXIS NO_INPUT_QUANTITY _CNV_S_4_Enum_EPOWE_87_CM_S2 4 0 3 READ_ONLY FIX_AXIS_PAR_DIST 0 1 4 /end AXIS_DESCR
 FORMAT "%3.1" /end CHARACTERISTIC
/begin CHARACTERISTIC XTAB4X2C_HSUREBRS_DECRVAL "" MAP 0x1DED6E _REC_S3MAP_54_u2_u2_u1_S2 255 _CNV_R_R_Umr_1_zu_1_2_CM_S2 0 255
 /begin AXIS_DESCR STD_AXIS W_DKKD _CNV_R_R_Umr_10_zu__9_CM_S2 4 0 110 DEPOSIT ABSOLUTE FORMAT "%3.1" /end AXIS_DESCR
 /begin AXIS_DESCR FIX_AXIS Z_AGS_MODBEDEL _CNV_S_2_Enum_EAGS_18_CM_S2 2 0 1 READ_ONLY FIX_AXIS_PAR_DIST 0 1 2 /end AXIS_DESCR
 FORMAT "%2.0" /end CHARACTERISTIC
/begin CHARACTERISTIC XTAB4X2C_HSUREFOF_DECRVAL "" MAP 0x1DEDE4 _REC_S3MAP_54_u2_u2_u1_S2 255 _CNV_R_R_Umr_1_zu_1_2_CM_S2 0 255
 /begin AXIS_DESCR STD_AXIS W_DKKD _CNV_R_R_Umr_10_zu__9_CM_S2 4 0 110 DEPOSIT ABSOLUTE FORMAT "%3.1" /end AXIS_DESCR
 /begin AXIS_DESCR FIX_AXIS Z_AGS_MODBEDEL _CNV_S_2_Enum_EAGS_18_CM_S2 2 0 1 READ_ONLY FIX_AXIS_PAR_DIST 0 1 2 /end AXIS_DESCR
 FORMAT "%2.0" /end CHARACTERISTIC
/begin CHARACTERISTIC XTAB4X2C_HSURENL_DECRVAL "" MAP 0x1DEFDC _REC_S3MAP_54_u2_u2_u1_S2 255 _CNV_R_R_Umr_1_zu_1_2_CM_S2 0 255
 /begin AXIS_DESCR STD_AXIS W_DKKD _CNV_R_R_Umr_10_zu__9_CM_S2 4 0 110 DEPOSIT ABSOLUTE FORMAT "%3.1" /end AXIS_DESCR
 /begin AXIS_DESCR FIX_AXIS Z_AGS_MODBEDEL _CNV_S_2_Enum_EAGS_18_CM_S2 2 0 1 READ_ONLY FIX_AXIS_PAR_DIST 0 1 2 /end AXIS_DESCR
 FORMAT "%2.0" /end CHARACTERISTIC
/begin CHARACTERISTIC XTAB4X2S_EXCFKTFFG_ENBL_DBM "" MAP 0x1DAF38 _REC_A1MAP_8_u1_u1_u1_S2 1 _CNV_R_R_Umr_1_zu_1_2_CM_S2 0 1
 /begin AXIS_DESCR FIX_AXIS Z_EXCFKT_DBM _CNV_S_4_Enum_EEXCF_91_CM_S2 4 0 3 READ_ONLY /begin FIX_AXIS_PAR_LIST 0 1 2 3 /end FIX_AXIS_PAR_LIST /end AXIS_DESCR
 /begin AXIS_DESCR FIX_AXIS NO_INPUT_QUANTITY _CNV_S_2_Enum_PRUEF_256_CM_S2 2 0 1 READ_ONLY /begin FIX_AXIS_PAR_LIST 0 1 /end FIX_AXIS_PAR_LIST /end AXIS_DESCR
 FORMAT "%2.0" /end CHARACTERISTIC
/begin CHARACTERISTIC XTAB4X3C_HSUREADAPT_DECRVAL "" MAP 0x1DED4C _REC_S3MAP_54_u2_s2_u1_S2 255 _CNV_R_R_Umr_1_zu_1_2_CM_S2 0 255
 /begin AXIS_DESCR STD_AXIS DELTA_NT_HSSKL _CNV_R_R_Umr_1_zu_1_3_CM_S2 4 -32768 32767 DEPOSIT ABSOLUTE FORMAT "%2.0" /end AXIS_DESCR
 /begin AXIS_DESCR FIX_AXIS Z_ADAPT_REQ _CNV_S_3_Enum_EREQA_103_CM_S2 3 0 2 READ_ONLY /begin FIX_AXIS_PAR_LIST 0 1 2 /end FIX_AXIS_PAR_LIST /end AXIS_DESCR
 FORMAT "%2.0" /end CHARACTERISTIC
/begin CHARACTERISTIC XTAB4X4_CR "" MAP 0x1DD908 _REC_A1MAP_9_s2_u1_u1_S2 65535 _CNV_R_R_Umr_1_zu_1_2_CM_S2 -32768 32767
 /begin AXIS_DESCR FIX_AXIS Z_FT _CNV_S_4_Enum_EFT_20_CM_S2 4 0 3 READ_ONLY FIX_AXIS_PAR_DIST 0 1 4 /end AXIS_DESCR
 /begin AXIS_DESCR FIX_AXIS Z_FT_BPL _CNV_S_4_Enum_EFT_20_CM_S2 4 0 3 READ_ONLY FIX_AXIS_PAR_DIST 0 1 4 /end AXIS_DESCR
 FORMAT "%2.0" /end CHARACTERISTIC
/begin CHARACTERISTIC XTAB4X5DC_SCHLEPP_BRMAX "" MAP 0x1DD8BC _REC_A1MAP_9_s2_u1_u1_S2 65535 _CNV_R_R_Umr_1_zu_1_2_CM_S2 -32768 32767
 /begin AXIS_DESCR FIX_AXIS Z_AGSMOD_ECO_EFAHREN _CNV_S_4_Enum_EAGS__17_CM_S2 4 0 3 READ_ONLY FIX_AXIS_PAR_DIST 0 1 4 /end AXIS_DESCR
 /begin AXIS_DESCR FIX_AXIS Z_FT_MBR _CNV_S_5_Enum_EFT2_53_CM_S2 5 0 4 READ_ONLY FIX_AXIS_PAR_DIST 0 1 5 /end AXIS_DESCR
 FORMAT "%2.0" /end CHARACTERISTIC
/begin CHARACTERISTIC XTAB4X6Z_BEDEL_FT_AGS "" MAP 0x1DD4C0 _REC_A1MAP_9_u1_u1_u1_S2 1 _CNV_S_2_Enum_EAGS_18_CM_S2 0 1
 /begin AXIS_DESCR FIX_AXIS Z_PROG_MODE _CNV_S_4_Enum_EPROG_26_CM_S2 4 0 3 READ_ONLY FIX_AXIS_PAR_DIST 0 1 4 /end AXIS_DESCR
 /begin AXIS_DESCR FIX_AXIS Z_DRIVELOGIC _CNV_S_6_Enum_EDL_11_CM_S2 6 1 6 READ_ONLY FIX_AXIS_PAR_DIST 1 1 6 /end AXIS_DESCR
/end CHARACTERISTIC
/begin CHARACTERISTIC XTAB4X6Z_PROG_FT_MAX "" MAP 0x1DD928 _REC_A1MAP_9_u1_u1_u1_S2 3 _CNV_S_4_Enum_EPROG_55_CM_S2 0 3
 /begin AXIS_DESCR FIX_AXIS Z_PROG_MODE _CNV_S_4_Enum_EPROG_26_CM_S2 4 0 3 READ_ONLY FIX_AXIS_PAR_DIST 0 1 4 /end AXIS_DESCR
 /begin AXIS_DESCR FIX_AXIS Z_DRIVELOGIC _CNV_S_6_Enum_EDL_11_CM_S2 6 1 6 READ_ONLY FIX_AXIS_PAR_DIST 1 1 6 /end AXIS_DESCR
/end CHARACTERISTIC
/begin CHARACTERISTIC XTAB4X9N_TMAXERS_MODEW_DBM "" MAP 0x1DDFC8 _REC_S3MAP_54_s2_u2_u1_S2 10000 _CNV_R_R_Umr_1_zu_1_3_CM_S2 0 10000
 /begin AXIS_DESCR STD_AXIS W_DKKD _CNV_R_R_Umr_10_zu__9_CM_S2 4 0 120 DEPOSIT ABSOLUTE FORMAT "%3.1" /end AXIS_DESCR
 /begin AXIS_DESCR FIX_AXIS Z_GANG_ZIEL_DBM _CNV_S_9_Enum_EGANG_21_CM_S2 9 0 8 READ_ONLY FIX_AXIS_PAR_DIST 0 1 9 /end AXIS_DESCR
 FORMAT "%2.0" /end CHARACTERISTIC
/begin CHARACTERISTIC XTAB4X9N_TMAXMRS_MODEW_DBM "" MAP 0x1DE01A _REC_S3MAP_54_s2_u2_u1_S2 10000 _CNV_R_R_Umr_1_zu_1_3_CM_S2 0 10000
 /begin AXIS_DESCR STD_AXIS W_DKKD _CNV_R_R_Umr_10_zu__9_CM_S2 4 0 120 DEPOSIT ABSOLUTE FORMAT "%3.1" /end AXIS_DESCR
 /begin AXIS_DESCR FIX_AXIS Z_GANG_ZIEL_DBM _CNV_S_9_Enum_EGANG_21_CM_S2 9 0 8 READ_ONLY FIX_AXIS_PAR_DIST 0 1 9 /end AXIS_DESCR
 FORMAT "%2.0" /end CHARACTERISTIC
/begin CHARACTERISTIC XTAB4Z_POS_MUELOW_ERLAUBT "" CURVE 0x1DCA4C _REC_A1CUR_30_u1_u1_S2 1 _CNV_R_R_Umr_1_zu_1_2_CM_S2 0 1
 /begin AXIS_DESCR FIX_AXIS Z_POS_AGS _CNV_S_4_Enum_EPOSA_29_CM_S2 4 0 3 READ_ONLY /begin FIX_AXIS_PAR_LIST 0 1 2 3 /end FIX_AXIS_PAR_LIST /end AXIS_DESCR
 FORMAT "%2.0" /end CHARACTERISTIC
/begin CHARACTERISTIC XTAB4Z_PROG_FT "" CURVE 0x1DD904 _REC_A1CUR_30_u1_u1_S2 3 _CNV_S_4_Enum_EPROG_55_CM_S2 0 3
 /begin AXIS_DESCR FIX_AXIS Z_FT _CNV_S_4_Enum_EFT_20_CM_S2 4 0 3 READ_ONLY FIX_AXIS_PAR_DIST 0 1 4 /end AXIS_DESCR
/end CHARACTERISTIC
/begin CHARACTERISTIC XTAB4_TID_AUSSTIEG_ENBL "" CURVE 0x1DDD74 _REC_A1CUR_30_u2_u2_S2 1 _CNV_R_R_Umr_1_zu_1_2_CM_S2 0 1
 /begin AXIS_DESCR FIX_AXIS NO_INPUT_QUANTITY _CNV_S_4_Enum_ETIDA_263_CM_S2 4 0 3 READ_ONLY FIX_AXIS_PAR_DIST 0 1 4 /end AXIS_DESCR
 FORMAT "%2.0" /end CHARACTERISTIC
/begin CHARACTERISTIC XTAB5A_WINKEL "" CURVE 0x1E2112 _REC_S7CUR_53_u2_s2_S2 200 _CNV_R_R_Umr_10_zu__108_CM_S2 0 200
 /begin AXIS_DESCR STD_AXIS A_L_REFFILT _CNV_R_R_Umr_32_zu__147_CM_S2 5 -1024 1023.96875 DEPOSIT ABSOLUTE FORMAT "%4.2" /end AXIS_DESCR
 FORMAT "%3.1" /end CHARACTERISTIC
/begin CHARACTERISTIC XTAB5C_HSURESCHLUPF_DECRVAL "" CURVE 0x1DF0FE _REC_S7CUR_53_u2_u2_S2 255 _CNV_R_R_Umr_1_zu_1_2_CM_S2 0 255
 /begin AXIS_DESCR STD_AXIS N_MOT _CNV_R_R_Umr_1_zu_1_3_CM_S2 5 0 20000 DEPOSIT ABSOLUTE FORMAT "%2.0" /end AXIS_DESCR
 FORMAT "%2.0" /end CHARACTERISTIC
/begin CHARACTERISTIC XTAB5DM_RAD_FWSKOMP_MAX "" CURVE 0x1DF246 _REC_S7CUR_53_s2_s2_S2 10000 _CNV_R_R_Umr_1_zu_1_190_CM_S2 -5000 5000
 /begin AXIS_DESCR STD_AXIS W_STEIGUNG_KORFILT _CNV_R_R_Umr_10_zu__9_CM_S2 5 -200 200 DEPOSIT ABSOLUTE FORMAT "%2.0" /end AXIS_DESCR
 FORMAT "%2.0" /end CHARACTERISTIC
/begin CHARACTERISTIC XTAB5DM_RAD_FWSKOMP_MIN "" CURVE 0x1DF25C _REC_S7CUR_53_s2_s2_S2 10000 _CNV_R_R_Umr_1_zu_1_190_CM_S2 -5000 5000
 /begin AXIS_DESCR STD_AXIS W_STEIGUNG_KORFILT _CNV_R_R_Umr_10_zu__9_CM_S2 5 -200 200 DEPOSIT ABSOLUTE FORMAT "%2.0" /end AXIS_DESCR
 FORMAT "%2.0" /end CHARACTERISTIC
/begin CHARACTERISTIC XTAB5FAKT_EM_POT_REKUP_BAB "" CURVE 0x1E24D2 _REC_S7CUR_53_u2_s2_S2 100 _CNV_R_R_Umr_1_zu_1_30_CM_S2 0 100
 /begin AXIS_DESCR STD_AXIS M_AB_REKUP_BAB _CNV_R_R_Umr_1_zu_1_38_CM_S2 5 -1000 0 DEPOSIT ABSOLUTE FORMAT "%3.1" /end AXIS_DESCR
 FORMAT "%3.1" /end CHARACTERISTIC
/begin CHARACTERISTIC XTAB5FAKT_SOC_NMOTMAXRS_BAB "" CURVE 0x1E24BC _REC_S7CUR_53_u2_u2_S2 1 _CNV_R_R_Umr_100_zu_42_CM_S2 0 1
 /begin AXIS_DESCR STD_AXIS Z_SOC _CNV_R_R_Umr_1_zu_1_30_CM_S2 5 0 100 DEPOSIT ABSOLUTE FORMAT "%2.0" /end AXIS_DESCR
 FORMAT "%4.2" /end CHARACTERISTIC
/begin CHARACTERISTIC XTAB5FAKT_T_AUSROLLRSFWS_DBM "" CURVE 0x1DE1E4 _REC_S7CUR_53_s2_s2_S2 255 _CNV_R_R_Umr_1_zu_1_30_CM_S2 0 255
 /begin AXIS_DESCR STD_AXIS DM_AB_FWS_FILT_BAB _CNV_R_R_Umr_1_zu_1_38_CM_S2 5 -2500 2500 DEPOSIT ABSOLUTE /end AXIS_DESCR
 FORMAT "%2.0" /end CHARACTERISTIC
/begin CHARACTERISTIC XTAB5GEW_NTNAB_SCHALT_DYNHSPV "" CURVE 0x1DF476 _REC_S7CUR_53_u2_u2_S2 1000 _CNV_R_R_Umr_1_zu_1_2_CM_S2 0 1000
 /begin AXIS_DESCR STD_AXIS N_RELATION_VAHA _CNV_R_R_Umr_100_zu_42_CM_S2 5 0 2.5 DEPOSIT ABSOLUTE FORMAT "%4.2" /end AXIS_DESCR
 FORMAT "%2.0" /end CHARACTERISTIC
/begin CHARACTERISTIC XTAB5KORFAKT_MBR_ROLLE "" CURVE 0x1DF32A _REC_S7CUR_53_s2_u2_S2 1 _CNV_R_R_Umr_100_zu_42_CM_S2 0 1
 /begin AXIS_DESCR STD_AXIS V_FZG _CNV_R_R_Umr_1_zu_1_8_CM_S2 5 0 400 DEPOSIT ABSOLUTE FORMAT "%2.0" /end AXIS_DESCR
 FORMAT "%4.2" /end CHARACTERISTIC
/begin CHARACTERISTIC XTAB5M_EM1_OPTSCHUB_ZKA "" CURVE 0x1E21F4 _REC_S7CUR_53_u2_u2_S2 200 _CNV_R_R_Umr_1_zu_1_30_CM_S2 0 200
 /begin AXIS_DESCR STD_AXIS Z_SOC _CNV_R_R_Umr_1_zu_1_30_CM_S2 5 0 100 DEPOSIT ABSOLUTE FORMAT "%2.0" /end AXIS_DESCR
 FORMAT "%2.0" /end CHARACTERISTIC
/begin CHARACTERISTIC XTAB5M_EM1_OPT_ZKA "" CURVE 0x1E220A _REC_S7CUR_53_u2_u2_S2 200 _CNV_R_R_Umr_1_zu_1_30_CM_S2 0 200
 /begin AXIS_DESCR STD_AXIS Z_SOC _CNV_R_R_Umr_1_zu_1_30_CM_S2 5 0 100 DEPOSIT ABSOLUTE FORMAT "%2.0" /end AXIS_DESCR
 FORMAT "%2.0" /end CHARACTERISTIC
/begin CHARACTERISTIC XTAB5N_TOFFSET_HSURESCHLUPF_0 "" CURVE 0x1DF114 _REC_S7CUR_53_u2_u2_S2 2000 _CNV_R_R_Umr_1_zu_1_3_CM_S2 0 2000
 /begin AXIS_DESCR STD_AXIS N_T _CNV_R_R_Umr_1_zu_1_3_CM_S2 5 0 20000 DEPOSIT ABSOLUTE FORMAT "%2.0" /end AXIS_DESCR
 FORMAT "%2.0" /end CHARACTERISTIC
/begin CHARACTERISTIC XTAB5N_TOFFSET_HSURESCHLUPF_1 "" CURVE 0x1DF12A _REC_S7CUR_53_u2_u2_S2 2000 _CNV_R_R_Umr_1_zu_1_3_CM_S2 0 2000
 /begin AXIS_DESCR STD_AXIS N_T _CNV_R_R_Umr_1_zu_1_3_CM_S2 5 0 20000 DEPOSIT ABSOLUTE FORMAT "%2.0" /end AXIS_DESCR
 FORMAT "%2.0" /end CHARACTERISTIC
/begin CHARACTERISTIC XTAB5N_TOFFSET_HSURESCHLUPF_2 "" CURVE 0x1DF140 _REC_S7CUR_53_u2_u2_S2 2000 _CNV_R_R_Umr_1_zu_1_3_CM_S2 0 2000
 /begin AXIS_DESCR STD_AXIS N_T _CNV_R_R_Umr_1_zu_1_3_CM_S2 5 0 20000 DEPOSIT ABSOLUTE FORMAT "%2.0" /end AXIS_DESCR
 FORMAT "%2.0" /end CHARACTERISTIC
/begin CHARACTERISTIC XTAB5ON_MOTMAX_KD_RSUMUELOW "" CURVE 0x1E34F6 _REC_A1CUR_30_u2_u2_S2 2000 _CNV_R_R_Umr_1_zu_1_3_CM_S2 0 2000
 /begin AXIS_DESCR FIX_AXIS NO_INPUT_QUANTITY _CNV_S_9_Enum_EGANG_21_CM_S2 5 0 8 READ_ONLY /begin FIX_AXIS_PAR_LIST 0 1 2 3 4 /end FIX_AXIS_PAR_LIST /end AXIS_DESCR
 FORMAT "%2.0" /end CHARACTERISTIC
/begin CHARACTERISTIC XTAB5ON_MOTMAX_WK_RSUMUELOW "" CURVE 0x1E3500 _REC_A1CUR_30_u2_u2_S2 2000 _CNV_R_R_Umr_1_zu_1_3_CM_S2 0 2000
 /begin AXIS_DESCR FIX_AXIS NO_INPUT_QUANTITY _CNV_S_9_Enum_EGANG_21_CM_S2 5 0 8 READ_ONLY /begin FIX_AXIS_PAR_LIST 0 1 2 3 4 /end FIX_AXIS_PAR_LIST /end AXIS_DESCR
 FORMAT "%2.0" /end CHARACTERISTIC
/begin CHARACTERISTIC XTAB5SCHA_Q_EINLENK "" CURVE 0x1DF2A4 _REC_S7CUR_53_u2_u2_S2 6553.5 _CNV_R_R_Umr_10_zu__37_CM_S2 0 6553.5
 /begin AXIS_DESCR STD_AXIS V_FZG _CNV_R_R_Umr_1_zu_1_8_CM_S2 5 0 500 DEPOSIT ABSOLUTE FORMAT "%2.0" /end AXIS_DESCR
 FORMAT "%3.1" /end CHARACTERISTIC
/begin CHARACTERISTIC XTAB5SCHA_Q_HSUREKU_AAGS "" CURVE 0x1DEF72 _REC_S7CUR_53_s2_u2_S2 6553.5 _CNV_R_R_Umr_10_zu__37_CM_S2 -3276.8 3276.7
 /begin AXIS_DESCR STD_AXIS N_T _CNV_R_R_Umr_1_zu_1_3_CM_S2 5 0 65535 DEPOSIT ABSOLUTE /end AXIS_DESCR
 FORMAT "%3.1" /end CHARACTERISTIC
/begin CHARACTERISTIC XTAB5SCHA_Q_HSUREKU_LDMAAGS "" CURVE 0x1DEF88 _REC_S7CUR_53_s2_u2_S2 6553.5 _CNV_R_R_Umr_10_zu__37_CM_S2 -3276.8 3276.7
 /begin AXIS_DESCR STD_AXIS N_T _CNV_R_R_Umr_1_zu_1_3_CM_S2 5 0 65535 DEPOSIT ABSOLUTE /end AXIS_DESCR
 FORMAT "%3.1" /end CHARACTERISTIC
/begin CHARACTERISTIC XTAB5SCHA_Q_HSUREKU_LDMSAGS "" CURVE 0x1DEF9E _REC_S7CUR_53_s2_u2_S2 6553.5 _CNV_R_R_Umr_10_zu__37_CM_S2 -3276.8 3276.7
 /begin AXIS_DESCR STD_AXIS N_T _CNV_R_R_Umr_1_zu_1_3_CM_S2 5 0 65535 DEPOSIT ABSOLUTE /end AXIS_DESCR
 FORMAT "%3.1" /end CHARACTERISTIC
/begin CHARACTERISTIC XTAB5SCHA_Q_HSUREKU_SAGS "" CURVE 0x1DEFB4 _REC_S7CUR_53_s2_u2_S2 6553.5 _CNV_R_R_Umr_10_zu__37_CM_S2 -3276.8 3276.7
 /begin AXIS_DESCR STD_AXIS N_T _CNV_R_R_Umr_1_zu_1_3_CM_S2 5 0 65535 DEPOSIT ABSOLUTE /end AXIS_DESCR
 FORMAT "%3.1" /end CHARACTERISTIC
/begin CHARACTERISTIC XTAB5SCHA_Q_SERP "" CURVE 0x1DF2BA _REC_S7CUR_53_u2_u2_S2 6553.5 _CNV_R_R_Umr_10_zu__37_CM_S2 0 6553.5
 /begin AXIS_DESCR STD_AXIS V_FZG _CNV_R_R_Umr_1_zu_1_8_CM_S2 5 0 65535 DEPOSIT ABSOLUTE FORMAT "%2.0" /end AXIS_DESCR
 FORMAT "%3.1" /end CHARACTERISTIC
/begin CHARACTERISTIC XTAB5SCHGN_TRAD_MAX "" CURVE 0x1DF48C _REC_S7CUR_53_s2_u2_S2 100 _CNV_R_R_Umr_100_zu_194_CM_S2 0 100
 /begin AXIS_DESCR STD_AXIS I_STRANG_NMOT_HSVIRT _CNV_R_R_Umr_80_zu__192_CM_S2 5 0 520 DEPOSIT ABSOLUTE FORMAT "%4.2" /end AXIS_DESCR
 FORMAT "%4.2" /end CHARACTERISTIC
/begin CHARACTERISTIC XTAB5SCHGWFP_FOFEINST_AAGS "" CURVE 0x1DEDFE _REC_S7CUR_53_s2_u2_S2 32768 _CNV_R_R_Umr_1_zu_1_7_CM_S2 -32768 0
 /begin AXIS_DESCR STD_AXIS N_MOT _CNV_R_R_Umr_1_zu_1_3_CM_S2 5 0 65535 DEPOSIT ABSOLUTE FORMAT "%2.0" /end AXIS_DESCR
 FORMAT "%2.0" /end CHARACTERISTIC
/begin CHARACTERISTIC XTAB5SCHGWFP_FOFEINST_SAGS "" CURVE 0x1DEE14 _REC_S7CUR_53_s2_u2_S2 32768 _CNV_R_R_Umr_1_zu_1_7_CM_S2 -32768 0
 /begin AXIS_DESCR STD_AXIS N_MOT _CNV_R_R_Umr_1_zu_1_3_CM_S2 5 0 65535 DEPOSIT ABSOLUTE FORMAT "%2.0" /end AXIS_DESCR
 FORMAT "%2.0" /end CHARACTERISTIC
/begin CHARACTERISTIC XTAB5SCHGWFP_HSUREFPVORNEG_AAGS "" CURVE 0x1DF16A _REC_S7CUR_53_s2_u2_S2 32768 _CNV_R_R_Umr_1_zu_1_7_CM_S2 -32768 0
 /begin AXIS_DESCR STD_AXIS N_MOT _CNV_R_R_Umr_1_zu_1_3_CM_S2 5 0 65535 DEPOSIT ABSOLUTE FORMAT "%2.0" /end AXIS_DESCR
 FORMAT "%2.0" /end CHARACTERISTIC
/begin CHARACTERISTIC XTAB5SCHGWFP_HSUREFPVORNEG_SAGS "" CURVE 0x1DF180 _REC_S7CUR_53_s2_u2_S2 32768 _CNV_R_R_Umr_1_zu_1_7_CM_S2 -32768 0
 /begin AXIS_DESCR STD_AXIS N_MOT _CNV_R_R_Umr_1_zu_1_3_CM_S2 5 0 65535 DEPOSIT ABSOLUTE /end AXIS_DESCR
 FORMAT "%2.0" /end CHARACTERISTIC
/begin CHARACTERISTIC XTAB5SCHM_AB_BREMS_FWSBER "" CURVE 0x1DEB3E _REC_S7CUR_53_s2_u2_S2 10000 _CNV_R_R_Umr_1_zu_1_38_CM_S2 -10000 0
 /begin AXIS_DESCR STD_AXIS V_FZG _CNV_R_R_Umr_1_zu_1_8_CM_S2 5 0 250 DEPOSIT ABSOLUTE FORMAT "%2.0" /end AXIS_DESCR
 FORMAT "%2.0" /end CHARACTERISTIC
/begin CHARACTERISTIC XTAB5SCHM_BR_ARSDYN_AUS_DBM "" CURVE 0x1DE1FA _REC_S7CUR_53_s2_s2_S2 32768 _CNV_R_R_Umr_1_zu_1_38_CM_S2 -32768 0
 /begin AXIS_DESCR STD_AXIS G2W_AB_FILT _CNV_R_R_Umr_10_zu__138_CM_S2 5 -3276.8 3276.7 DEPOSIT ABSOLUTE FORMAT "%3.1" /end AXIS_DESCR
 FORMAT "%2.0" /end CHARACTERISTIC
/begin CHARACTERISTIC XTAB5SCHM_BR_ARSDYN_EIN_DBM "" CURVE 0x1DE210 _REC_S7CUR_53_s2_s2_S2 32768 _CNV_R_R_Umr_1_zu_1_38_CM_S2 -32768 0
 /begin AXIS_DESCR STD_AXIS G2W_AB_FILT _CNV_R_R_Umr_10_zu__138_CM_S2 5 -3276.8 3276.7 DEPOSIT ABSOLUTE FORMAT "%3.1" /end AXIS_DESCR
 FORMAT "%2.0" /end CHARACTERISTIC
/begin CHARACTERISTIC XTAB5SCHM_BR_LWVA_DERS "" CURVE 0x1E26D4 _REC_S7CUR_53_s2_u2_S2 2500 _CNV_R_R_Umr_1_zu_1_38_CM_S2 -2500 0
 /begin AXIS_DESCR STD_AXIS V_FZG _CNV_R_R_Umr_1_zu_1_8_CM_S2 5 0 250 DEPOSIT ABSOLUTE FORMAT "%2.0" /end AXIS_DESCR
 FORMAT "%2.0" /end CHARACTERISTIC
/begin CHARACTERISTIC XTAB5SCHP_BR_ARSDYN_AUS_DBM "" CURVE 0x1DE226 _REC_S7CUR_53_u2_s2_S2 32767 _CNV_R_R_Umr_2_zu_1_179_CM_S2 0 32767
 /begin AXIS_DESCR STD_AXIS G2W_AB_FILT _CNV_R_R_Umr_10_zu__138_CM_S2 5 -3276.8 3276.7 DEPOSIT ABSOLUTE FORMAT "%3.1" /end AXIS_DESCR
 FORMAT "%3.1" /end CHARACTERISTIC
/begin CHARACTERISTIC XTAB5SCHP_BR_ARSDYN_EIN_DBM "" CURVE 0x1DE23C _REC_S7CUR_53_u2_s2_S2 32767 _CNV_R_R_Umr_2_zu_1_179_CM_S2 0 32767
 /begin AXIS_DESCR STD_AXIS G2W_AB_FILT _CNV_R_R_Umr_10_zu__138_CM_S2 5 -3276.8 3276.7 DEPOSIT ABSOLUTE FORMAT "%3.1" /end AXIS_DESCR
 FORMAT "%3.1" /end CHARACTERISTIC
/begin CHARACTERISTIC XTAB5SCHTEMP_MOT_WL "" CURVE 0x1E216C _REC_S7CUR_53_s2_u2_S2 200 _CNV_R_R_Umr_1_zu_1_1_CM_S2 -50 150
 /begin AXIS_DESCR STD_AXIS P_LUFT _CNV_R_R_Umr_1_zu_1_0_CM_S2 5 600 1106 DEPOSIT ABSOLUTE FORMAT "%4.2" /end AXIS_DESCR
 FORMAT "%2.0" /end CHARACTERISTIC
/begin CHARACTERISTIC XTAB5SCHTEMP_MOT_WLSPV "" CURVE 0x1E2182 _REC_S7CUR_53_s2_u2_S2 200 _CNV_R_R_Umr_1_zu_1_1_CM_S2 -50 150
 /begin AXIS_DESCR STD_AXIS P_LUFT _CNV_R_R_Umr_1_zu_1_0_CM_S2 5 600 1106 DEPOSIT ABSOLUTE FORMAT "%4.2" /end AXIS_DESCR
 FORMAT "%2.0" /end CHARACTERISTIC
/begin CHARACTERISTIC XTAB5SCHW_DKKD_MUELOWAUSLAST "" CURVE 0x1DF434 _REC_S7CUR_53_u2_s2_S2 200 _CNV_R_R_Umr_1_zu_1_30_CM_S2 0 200
 /begin AXIS_DESCR STD_AXIS W_STEIGUNG_KORFILT _CNV_R_R_Umr_10_zu__9_CM_S2 5 -200 200 DEPOSIT ABSOLUTE FORMAT "%3.1" /end AXIS_DESCR
 FORMAT "%2.0" /end CHARACTERISTIC
/begin CHARACTERISTIC XTAB5SCHW_LWVA_EFF_EINLENK "" CURVE 0x1DF2D0 _REC_S7CUR_53_u2_u2_S2 50 _CNV_R_R_Umr_10_zu__10_CM_S2 0 50
 /begin AXIS_DESCR STD_AXIS V_FZG _CNV_R_R_Umr_1_zu_1_8_CM_S2 5 0 500 DEPOSIT ABSOLUTE FORMAT "%2.0" /end AXIS_DESCR
 FORMAT "%3.1" /end CHARACTERISTIC
/begin CHARACTERISTIC XTAB5SCHW_LWVA_EFF_KURVE "" CURVE 0x1DF2E6 _REC_S7CUR_53_s2_u2_S2 50 _CNV_R_R_Umr_10_zu__10_CM_S2 0 50
 /begin AXIS_DESCR STD_AXIS V_FZG _CNV_R_R_Umr_1_zu_1_8_CM_S2 5 0 400 DEPOSIT ABSOLUTE FORMAT "%2.0" /end AXIS_DESCR
 FORMAT "%3.1" /end CHARACTERISTIC
/begin CHARACTERISTIC XTAB5SCHW_LWVA_EFF_SERP "" CURVE 0x1DF2FC _REC_S7CUR_53_s2_u2_S2 50 _CNV_R_R_Umr_10_zu__10_CM_S2 0 50
 /begin AXIS_DESCR STD_AXIS V_FZG _CNV_R_R_Umr_1_zu_1_8_CM_S2 5 0 400 DEPOSIT ABSOLUTE FORMAT "%2.0" /end AXIS_DESCR
 FORMAT "%3.1" /end CHARACTERISTIC
/begin CHARACTERISTIC XTAB5S_KRIT_ENBL_ZKA "" CURVE 0x1D9725 _REC_A1CUR_30_u1_u2_S2 1 _CNV_R_R_Umr_1_zu_1_2_CM_S2 0 1
 /begin AXIS_DESCR FIX_AXIS NO_INPUT_QUANTITY _CNV_S_5_Enum_EZKAK_183_CM_S2 5 0 4 READ_ONLY /begin FIX_AXIS_PAR_LIST 0 1 2 3 4 /end FIX_AXIS_PAR_LIST /end AXIS_DESCR
 FORMAT "%2.0" /end CHARACTERISTIC
/begin CHARACTERISTIC XTAB5S_PROG_MODE_HSUKS "" CURVE 0x1D97AD _REC_A1CUR_30_u1_u1_S2 1 _CNV_R_R_Umr_1_zu_1_2_CM_S2 0 1
 /begin AXIS_DESCR FIX_AXIS NO_INPUT_QUANTITY _CNV_S_5_Enum_EPROG_106_CM_S2 5 0 4 READ_ONLY FIX_AXIS_PAR_DIST 0 1 5 /end AXIS_DESCR
 FORMAT "%2.0" /end CHARACTERISTIC
/begin CHARACTERISTIC XTAB5T_BGH_NACHL "" CURVE 0x1DE7C2 _REC_S7CUR_53_u2_s2_S2 65535 _CNV_R_R_Umr_1_zu_1_6_CM_S2 0 65535
 /begin AXIS_DESCR STD_AXIS DM_AB_FWSBGHNACHLDELTA _CNV_R_R_Umr_1_zu_1_38_CM_S2 5 -32768 32767 DEPOSIT ABSOLUTE FORMAT "%2.0" /end AXIS_DESCR
 FORMAT "%2.0" /end CHARACTERISTIC
/begin CHARACTERISTIC XTAB5T_DMRS_WAIT "" CURVE 0x1DC354 _REC_A1CUR_30_u4_u2_S2 2147480000 _CNV_R_R_Umr_1_zu_1_6_CM_S2 0 2147483647
 /begin AXIS_DESCR FIX_AXIS NO_INPUT_QUANTITY _CNV_S_5_Enum_EDMRS_265_CM_S2 5 0 4 READ_ONLY FIX_AXIS_PAR_DIST 0 1 5 /end AXIS_DESCR
 FORMAT "%2.0" /end CHARACTERISTIC
/begin CHARACTERISTIC XTAB5X2FILT_DYNHSPV_0 "" MAP 0x1DF4C4 _REC_S3MAP_54_u1_u2_u1_S2 2 _CNV_R_R_Umr_100_zu_42_CM_S2 0 2
 /begin AXIS_DESCR STD_AXIS N_MOT_DYNHSPV _CNV_R_R_Umr_1_zu_1_3_CM_S2 5 0 20000 DEPOSIT ABSOLUTE FORMAT "%2.0" /end AXIS_DESCR
 /begin AXIS_DESCR FIX_AXIS NO_INPUT_QUANTITY _CNV_S_2_Enum_EPT1__15_CM_S2 2 0 1 READ_ONLY /begin FIX_AXIS_PAR_LIST 0 1 /end FIX_AXIS_PAR_LIST /end AXIS_DESCR
 FORMAT "%4.2" /end CHARACTERISTIC
/begin CHARACTERISTIC XTAB5X2FILT_DYNHSPV_1 "" MAP 0x1DF4DA _REC_S3MAP_54_u1_u2_u1_S2 2 _CNV_R_R_Umr_100_zu_42_CM_S2 0 2
 /begin AXIS_DESCR STD_AXIS N_MOT_DYNHSPV _CNV_R_R_Umr_1_zu_1_3_CM_S2 5 0 20000 DEPOSIT ABSOLUTE FORMAT "%2.0" /end AXIS_DESCR
 /begin AXIS_DESCR FIX_AXIS NO_INPUT_QUANTITY _CNV_S_2_Enum_EPT1__15_CM_S2 2 0 1 READ_ONLY /begin FIX_AXIS_PAR_LIST 0 1 /end FIX_AXIS_PAR_LIST /end AXIS_DESCR
 FORMAT "%4.2" /end CHARACTERISTIC
/begin CHARACTERISTIC XTAB5X2FILT_DYNHSPV_2 "" MAP 0x1DF4F0 _REC_S3MAP_54_u1_u2_u1_S2 2 _CNV_R_R_Umr_100_zu_42_CM_S2 0 2
 /begin AXIS_DESCR STD_AXIS N_MOT_DYNHSPV _CNV_R_R_Umr_1_zu_1_3_CM_S2 5 0 20000 DEPOSIT ABSOLUTE FORMAT "%2.0" /end AXIS_DESCR
 /begin AXIS_DESCR FIX_AXIS NO_INPUT_QUANTITY _CNV_S_2_Enum_EPT1__15_CM_S2 2 0 1 READ_ONLY /begin FIX_AXIS_PAR_LIST 0 1 /end FIX_AXIS_PAR_LIST /end AXIS_DESCR
 FORMAT "%4.2" /end CHARACTERISTIC
/begin CHARACTERISTIC XTAB5X2FILT_DYNHSPV_3 "" MAP 0x1DF506 _REC_S3MAP_54_u1_u2_u1_S2 2 _CNV_R_R_Umr_100_zu_42_CM_S2 0 2
 /begin AXIS_DESCR STD_AXIS N_MOT_DYNHSPV _CNV_R_R_Umr_1_zu_1_3_CM_S2 5 0 20000 DEPOSIT ABSOLUTE FORMAT "%2.0" /end AXIS_DESCR
 /begin AXIS_DESCR FIX_AXIS NO_INPUT_QUANTITY _CNV_S_2_Enum_EPT1__15_CM_S2 2 0 1 READ_ONLY /begin FIX_AXIS_PAR_LIST 0 1 /end FIX_AXIS_PAR_LIST /end AXIS_DESCR
 FORMAT "%4.2" /end CHARACTERISTIC
/begin CHARACTERISTIC XTAB5X2FILT_DYNHSPV_4 "" MAP 0x1DF51C _REC_S3MAP_54_u1_u2_u1_S2 2 _CNV_R_R_Umr_100_zu_42_CM_S2 0 2
 /begin AXIS_DESCR STD_AXIS N_MOT_DYNHSPV _CNV_R_R_Umr_1_zu_1_3_CM_S2 5 0 20000 DEPOSIT ABSOLUTE FORMAT "%2.0" /end AXIS_DESCR
 /begin AXIS_DESCR FIX_AXIS NO_INPUT_QUANTITY _CNV_S_2_Enum_EPT1__15_CM_S2 2 0 1 READ_ONLY /begin FIX_AXIS_PAR_LIST 0 1 /end FIX_AXIS_PAR_LIST /end AXIS_DESCR
 FORMAT "%4.2" /end CHARACTERISTIC
/begin CHARACTERISTIC XTAB5X2FILT_DYNHSPV_5 "" MAP 0x1DF532 _REC_S3MAP_54_u1_u2_u1_S2 2 _CNV_R_R_Umr_100_zu_42_CM_S2 0 2
 /begin AXIS_DESCR STD_AXIS N_MOT_DYNHSPV _CNV_R_R_Umr_1_zu_1_3_CM_S2 5 0 20000 DEPOSIT ABSOLUTE FORMAT "%2.0" /end AXIS_DESCR
 /begin AXIS_DESCR FIX_AXIS NO_INPUT_QUANTITY _CNV_S_2_Enum_EPT1__15_CM_S2 2 0 1 READ_ONLY /begin FIX_AXIS_PAR_LIST 0 1 /end FIX_AXIS_PAR_LIST /end AXIS_DESCR
 FORMAT "%4.2" /end CHARACTERISTIC
/begin CHARACTERISTIC XTAB5X2FILT_DYNHSPV_6 "" MAP 0x1DF548 _REC_S3MAP_54_u1_u2_u1_S2 2 _CNV_R_R_Umr_100_zu_42_CM_S2 0 2
 /begin AXIS_DESCR STD_AXIS N_MOT_DYNHSPV _CNV_R_R_Umr_1_zu_1_3_CM_S2 5 0 20000 DEPOSIT ABSOLUTE FORMAT "%2.0" /end AXIS_DESCR
 /begin AXIS_DESCR FIX_AXIS NO_INPUT_QUANTITY _CNV_S_2_Enum_EPT1__15_CM_S2 2 0 1 READ_ONLY /begin FIX_AXIS_PAR_LIST 0 1 /end FIX_AXIS_PAR_LIST /end AXIS_DESCR
 FORMAT "%4.2" /end CHARACTERISTIC
/begin CHARACTERISTIC XTAB5X2FILT_DYNHSPV_7 "" MAP 0x1DF55E _REC_S3MAP_54_u1_u2_u1_S2 2 _CNV_R_R_Umr_100_zu_42_CM_S2 0 2
 /begin AXIS_DESCR STD_AXIS N_MOT_DYNHSPV _CNV_R_R_Umr_1_zu_1_3_CM_S2 5 0 20000 DEPOSIT ABSOLUTE FORMAT "%2.0" /end AXIS_DESCR
 /begin AXIS_DESCR FIX_AXIS NO_INPUT_QUANTITY _CNV_S_2_Enum_EPT1__15_CM_S2 2 0 1 READ_ONLY /begin FIX_AXIS_PAR_LIST 0 1 /end FIX_AXIS_PAR_LIST /end AXIS_DESCR
 FORMAT "%4.2" /end CHARACTERISTIC
/begin CHARACTERISTIC XTAB5X2FILT_DYNHSPV_8 "" MAP 0x1DF574 _REC_S3MAP_54_u1_u2_u1_S2 2 _CNV_R_R_Umr_100_zu_42_CM_S2 0 2
 /begin AXIS_DESCR STD_AXIS N_MOT_DYNHSPV _CNV_R_R_Umr_1_zu_1_3_CM_S2 5 0 20000 DEPOSIT ABSOLUTE FORMAT "%2.0" /end AXIS_DESCR
 /begin AXIS_DESCR FIX_AXIS NO_INPUT_QUANTITY _CNV_S_2_Enum_EPT1__15_CM_S2 2 0 1 READ_ONLY /begin FIX_AXIS_PAR_LIST 0 1 /end FIX_AXIS_PAR_LIST /end AXIS_DESCR
 FORMAT "%4.2" /end CHARACTERISTIC
/begin CHARACTERISTIC XTAB5X2FILT_DYNHSPV_9 "" MAP 0x1DF58A _REC_S3MAP_54_u1_u2_u1_S2 2 _CNV_R_R_Umr_100_zu_42_CM_S2 0 2
 /begin AXIS_DESCR STD_AXIS N_MOT_DYNHSPV _CNV_R_R_Umr_1_zu_1_3_CM_S2 5 0 20000 DEPOSIT ABSOLUTE FORMAT "%2.0" /end AXIS_DESCR
 /begin AXIS_DESCR FIX_AXIS NO_INPUT_QUANTITY _CNV_S_2_Enum_EPT1__15_CM_S2 2 0 1 READ_ONLY /begin FIX_AXIS_PAR_LIST 0 1 /end FIX_AXIS_PAR_LIST /end AXIS_DESCR
 FORMAT "%4.2" /end CHARACTERISTIC
/begin CHARACTERISTIC XTAB5X2M_RADOPTS_AKTGANG1_ZKA "" MAP 0x1DDC0C _REC_A1MAP_8_u2_u2_u2_S2 1000 _CNV_R_R_Umr_1_zu_1_30_CM_S2 0 1000
 /begin AXIS_DESCR COM_AXIS N_AB _CNV_R_R_Umr_1_zu_1_3_CM_S2 5 0 65535 DEPOSIT ABSOLUTE AXIS_PTS_REF SSTTAB_MRADOPTS_GANG1 /end AXIS_DESCR
 /begin AXIS_DESCR FIX_AXIS NO_INPUT_QUANTITY _CNV_S_5_Enum_EZKAT_184_CM_S2 2 0 4 READ_ONLY /begin FIX_AXIS_PAR_LIST 0 1 /end FIX_AXIS_PAR_LIST /end AXIS_DESCR
 FORMAT "%2.0" /end CHARACTERISTIC
/begin CHARACTERISTIC XTAB5X2M_RADOPTS_AKTGANG2_ZKA "" MAP 0x1DDC20 _REC_A1MAP_8_u2_u2_u2_S2 1000 _CNV_R_R_Umr_1_zu_1_30_CM_S2 0 1000
 /begin AXIS_DESCR COM_AXIS N_AB _CNV_R_R_Umr_1_zu_1_3_CM_S2 5 0 65535 DEPOSIT ABSOLUTE AXIS_PTS_REF SSTTAB_MRADOPTS_GANG2 /end AXIS_DESCR
 /begin AXIS_DESCR FIX_AXIS NO_INPUT_QUANTITY _CNV_S_5_Enum_EZKAT_184_CM_S2 2 0 4 READ_ONLY /begin FIX_AXIS_PAR_LIST 0 1 /end FIX_AXIS_PAR_LIST /end AXIS_DESCR
 FORMAT "%2.0" /end CHARACTERISTIC
/begin CHARACTERISTIC XTAB5X2M_RADOPTS_AKTGANG3_ZKA "" MAP 0x1DDC34 _REC_A1MAP_8_u2_u2_u2_S2 1000 _CNV_R_R_Umr_1_zu_1_30_CM_S2 0 1000
 /begin AXIS_DESCR COM_AXIS N_AB _CNV_R_R_Umr_1_zu_1_3_CM_S2 5 0 65535 DEPOSIT ABSOLUTE AXIS_PTS_REF SSTTAB_MRADOPTS_GANG3 /end AXIS_DESCR
 /begin AXIS_DESCR FIX_AXIS NO_INPUT_QUANTITY _CNV_S_5_Enum_EZKAT_184_CM_S2 2 0 4 READ_ONLY /begin FIX_AXIS_PAR_LIST 0 1 /end FIX_AXIS_PAR_LIST /end AXIS_DESCR
 FORMAT "%2.0" /end CHARACTERISTIC
/begin CHARACTERISTIC XTAB5X2M_RADOPTS_AKTGANG4_ZKA "" MAP 0x1DDC48 _REC_A1MAP_8_u2_u2_u2_S2 1000 _CNV_R_R_Umr_1_zu_1_30_CM_S2 0 1000
 /begin AXIS_DESCR COM_AXIS N_AB _CNV_R_R_Umr_1_zu_1_3_CM_S2 5 0 65535 DEPOSIT ABSOLUTE AXIS_PTS_REF SSTTAB_MRADOPTS_GANG4 /end AXIS_DESCR
 /begin AXIS_DESCR FIX_AXIS NO_INPUT_QUANTITY _CNV_S_5_Enum_EZKAT_184_CM_S2 2 0 4 READ_ONLY /begin FIX_AXIS_PAR_LIST 0 1 /end FIX_AXIS_PAR_LIST /end AXIS_DESCR
 FORMAT "%2.0" /end CHARACTERISTIC
/begin CHARACTERISTIC XTAB5X2M_RADOPTS_AKTGANG5_ZKA "" MAP 0x1DDC5C _REC_A1MAP_8_u2_u2_u2_S2 1000 _CNV_R_R_Umr_1_zu_1_30_CM_S2 0 1000
 /begin AXIS_DESCR COM_AXIS N_AB _CNV_R_R_Umr_1_zu_1_3_CM_S2 5 0 65535 DEPOSIT ABSOLUTE AXIS_PTS_REF SSTTAB_MRADOPTS_GANG5 /end AXIS_DESCR
 /begin AXIS_DESCR FIX_AXIS NO_INPUT_QUANTITY _CNV_S_5_Enum_EZKAT_184_CM_S2 2 0 4 READ_ONLY /begin FIX_AXIS_PAR_LIST 0 1 /end FIX_AXIS_PAR_LIST /end AXIS_DESCR
 FORMAT "%2.0" /end CHARACTERISTIC
/begin CHARACTERISTIC XTAB5X2M_RADOPTS_AKTGANG6_ZKA "" MAP 0x1DDC70 _REC_A1MAP_8_u2_u2_u2_S2 1000 _CNV_R_R_Umr_1_zu_1_30_CM_S2 0 1000
 /begin AXIS_DESCR COM_AXIS N_AB _CNV_R_R_Umr_1_zu_1_3_CM_S2 5 0 65535 DEPOSIT ABSOLUTE AXIS_PTS_REF SSTTAB_MRADOPTS_GANG6 /end AXIS_DESCR
 /begin AXIS_DESCR FIX_AXIS NO_INPUT_QUANTITY _CNV_S_5_Enum_EZKAT_184_CM_S2 2 0 4 READ_ONLY /begin FIX_AXIS_PAR_LIST 0 1 /end FIX_AXIS_PAR_LIST /end AXIS_DESCR
 FORMAT "%2.0" /end CHARACTERISTIC
/begin CHARACTERISTIC XTAB5X2M_RADOPTS_AKTGANG7_ZKA "" MAP 0x1DDC84 _REC_A1MAP_8_u2_u2_u2_S2 1000 _CNV_R_R_Umr_1_zu_1_30_CM_S2 0 1000
 /begin AXIS_DESCR COM_AXIS N_AB _CNV_R_R_Umr_1_zu_1_3_CM_S2 5 0 65535 DEPOSIT ABSOLUTE AXIS_PTS_REF SSTTAB_MRADOPTS_GANG7 /end AXIS_DESCR
 /begin AXIS_DESCR FIX_AXIS NO_INPUT_QUANTITY _CNV_S_5_Enum_EZKAT_184_CM_S2 2 0 4 READ_ONLY /begin FIX_AXIS_PAR_LIST 0 1 /end FIX_AXIS_PAR_LIST /end AXIS_DESCR
 FORMAT "%2.0" /end CHARACTERISTIC
/begin CHARACTERISTIC XTAB5X2M_RADOPTS_AKTGANG8_ZKA "" MAP 0x1DDC98 _REC_A1MAP_8_u2_u2_u2_S2 1000 _CNV_R_R_Umr_1_zu_1_30_CM_S2 0 1000
 /begin AXIS_DESCR COM_AXIS N_AB _CNV_R_R_Umr_1_zu_1_3_CM_S2 5 0 65535 DEPOSIT ABSOLUTE AXIS_PTS_REF SSTTAB_MRADOPTS_GANG8 /end AXIS_DESCR
 /begin AXIS_DESCR FIX_AXIS NO_INPUT_QUANTITY _CNV_S_5_Enum_EZKAT_184_CM_S2 2 0 4 READ_ONLY /begin FIX_AXIS_PAR_LIST 0 1 /end FIX_AXIS_PAR_LIST /end AXIS_DESCR
 FORMAT "%2.0" /end CHARACTERISTIC
/begin CHARACTERISTIC XTAB5X2M_RADOPTS_AKTGANG9_ZKA "" MAP 0x1DDCAC _REC_A1MAP_8_u2_u2_u2_S2 1000 _CNV_R_R_Umr_1_zu_1_30_CM_S2 0 1000
 /begin AXIS_DESCR COM_AXIS N_AB _CNV_R_R_Umr_1_zu_1_3_CM_S2 5 0 65535 DEPOSIT ABSOLUTE AXIS_PTS_REF SSTTAB_MRADOPTS_GANG9 /end AXIS_DESCR
 /begin AXIS_DESCR FIX_AXIS NO_INPUT_QUANTITY _CNV_S_5_Enum_EZKAT_184_CM_S2 2 0 4 READ_ONLY /begin FIX_AXIS_PAR_LIST 0 1 /end FIX_AXIS_PAR_LIST /end AXIS_DESCR
 FORMAT "%2.0" /end CHARACTERISTIC
/begin CHARACTERISTIC XTAB5X2M_RADOPTS_LOWGANG1_ZKA "" MAP 0x1DDCC0 _REC_A1MAP_8_u2_u2_u2_S2 1000 _CNV_R_R_Umr_1_zu_1_30_CM_S2 0 1000
 /begin AXIS_DESCR COM_AXIS N_AB _CNV_R_R_Umr_1_zu_1_3_CM_S2 5 0 65535 DEPOSIT ABSOLUTE AXIS_PTS_REF SSTTAB_MRADOPTS_GANG1 /end AXIS_DESCR
 /begin AXIS_DESCR FIX_AXIS NO_INPUT_QUANTITY _CNV_S_5_Enum_EZKAT_184_CM_S2 2 0 4 READ_ONLY /begin FIX_AXIS_PAR_LIST 0 1 /end FIX_AXIS_PAR_LIST /end AXIS_DESCR
 FORMAT "%2.0" /end CHARACTERISTIC
/begin CHARACTERISTIC XTAB5X2M_RADOPTS_LOWGANG2_ZKA "" MAP 0x1DDCD4 _REC_A1MAP_8_u2_u2_u2_S2 1000 _CNV_R_R_Umr_1_zu_1_30_CM_S2 0 1000
 /begin AXIS_DESCR COM_AXIS N_AB _CNV_R_R_Umr_1_zu_1_3_CM_S2 5 0 65535 DEPOSIT ABSOLUTE AXIS_PTS_REF SSTTAB_MRADOPTS_GANG2 /end AXIS_DESCR
 /begin AXIS_DESCR FIX_AXIS NO_INPUT_QUANTITY _CNV_S_5_Enum_EZKAT_184_CM_S2 2 0 4 READ_ONLY /begin FIX_AXIS_PAR_LIST 0 1 /end FIX_AXIS_PAR_LIST /end AXIS_DESCR
 FORMAT "%2.0" /end CHARACTERISTIC
/begin CHARACTERISTIC XTAB5X2M_RADOPTS_LOWGANG3_ZKA "" MAP 0x1DDCE8 _REC_A1MAP_8_u2_u2_u2_S2 1000 _CNV_R_R_Umr_1_zu_1_30_CM_S2 0 1000
 /begin AXIS_DESCR COM_AXIS N_AB _CNV_R_R_Umr_1_zu_1_3_CM_S2 5 0 65535 DEPOSIT ABSOLUTE AXIS_PTS_REF SSTTAB_MRADOPTS_GANG3 /end AXIS_DESCR
 /begin AXIS_DESCR FIX_AXIS NO_INPUT_QUANTITY _CNV_S_5_Enum_EZKAT_184_CM_S2 2 0 4 READ_ONLY /begin FIX_AXIS_PAR_LIST 0 1 /end FIX_AXIS_PAR_LIST /end AXIS_DESCR
 FORMAT "%2.0" /end CHARACTERISTIC
/begin CHARACTERISTIC XTAB5X2M_RADOPTS_LOWGANG4_ZKA "" MAP 0x1DDCFC _REC_A1MAP_8_u2_u2_u2_S2 1000 _CNV_R_R_Umr_1_zu_1_30_CM_S2 0 1000
 /begin AXIS_DESCR COM_AXIS N_AB _CNV_R_R_Umr_1_zu_1_3_CM_S2 5 0 65535 DEPOSIT ABSOLUTE AXIS_PTS_REF SSTTAB_MRADOPTS_GANG4 /end AXIS_DESCR
 /begin AXIS_DESCR FIX_AXIS NO_INPUT_QUANTITY _CNV_S_5_Enum_EZKAT_184_CM_S2 2 0 4 READ_ONLY /begin FIX_AXIS_PAR_LIST 0 1 /end FIX_AXIS_PAR_LIST /end AXIS_DESCR
 FORMAT "%2.0" /end CHARACTERISTIC
/begin CHARACTERISTIC XTAB5X2M_RADOPTS_LOWGANG5_ZKA "" MAP 0x1DDD10 _REC_A1MAP_8_u2_u2_u2_S2 1000 _CNV_R_R_Umr_1_zu_1_30_CM_S2 0 1000
 /begin AXIS_DESCR COM_AXIS N_AB _CNV_R_R_Umr_1_zu_1_3_CM_S2 5 0 65535 DEPOSIT ABSOLUTE AXIS_PTS_REF SSTTAB_MRADOPTS_GANG5 /end AXIS_DESCR
 /begin AXIS_DESCR FIX_AXIS NO_INPUT_QUANTITY _CNV_S_5_Enum_EZKAT_184_CM_S2 2 0 4 READ_ONLY /begin FIX_AXIS_PAR_LIST 0 1 /end FIX_AXIS_PAR_LIST /end AXIS_DESCR
 FORMAT "%2.0" /end CHARACTERISTIC
/begin CHARACTERISTIC XTAB5X2M_RADOPTS_LOWGANG6_ZKA "" MAP 0x1DDD24 _REC_A1MAP_8_u2_u2_u2_S2 1000 _CNV_R_R_Umr_1_zu_1_30_CM_S2 0 1000
 /begin AXIS_DESCR COM_AXIS N_AB _CNV_R_R_Umr_1_zu_1_3_CM_S2 5 0 65535 DEPOSIT ABSOLUTE AXIS_PTS_REF SSTTAB_MRADOPTS_GANG6 /end AXIS_DESCR
 /begin AXIS_DESCR FIX_AXIS NO_INPUT_QUANTITY _CNV_S_5_Enum_EZKAT_184_CM_S2 2 0 4 READ_ONLY /begin FIX_AXIS_PAR_LIST 0 1 /end FIX_AXIS_PAR_LIST /end AXIS_DESCR
 FORMAT "%2.0" /end CHARACTERISTIC
/begin CHARACTERISTIC XTAB5X2M_RADOPTS_LOWGANG7_ZKA "" MAP 0x1DDD38 _REC_A1MAP_8_u2_u2_u2_S2 1000 _CNV_R_R_Umr_1_zu_1_30_CM_S2 0 1000
 /begin AXIS_DESCR COM_AXIS N_AB _CNV_R_R_Umr_1_zu_1_3_CM_S2 5 0 65535 DEPOSIT ABSOLUTE AXIS_PTS_REF SSTTAB_MRADOPTS_GANG7 /end AXIS_DESCR
 /begin AXIS_DESCR FIX_AXIS NO_INPUT_QUANTITY _CNV_S_5_Enum_EZKAT_184_CM_S2 2 0 4 READ_ONLY /begin FIX_AXIS_PAR_LIST 0 1 /end FIX_AXIS_PAR_LIST /end AXIS_DESCR
 FORMAT "%2.0" /end CHARACTERISTIC
/begin CHARACTERISTIC XTAB5X2M_RADOPTS_LOWGANG8_ZKA "" MAP 0x1DDD4C _REC_A1MAP_8_u2_u2_u2_S2 1000 _CNV_R_R_Umr_1_zu_1_30_CM_S2 0 1000
 /begin AXIS_DESCR COM_AXIS N_AB _CNV_R_R_Umr_1_zu_1_3_CM_S2 5 0 65535 DEPOSIT ABSOLUTE AXIS_PTS_REF SSTTAB_MRADOPTS_GANG8 /end AXIS_DESCR
 /begin AXIS_DESCR FIX_AXIS NO_INPUT_QUANTITY _CNV_S_5_Enum_EZKAT_184_CM_S2 2 0 4 READ_ONLY /begin FIX_AXIS_PAR_LIST 0 1 /end FIX_AXIS_PAR_LIST /end AXIS_DESCR
 FORMAT "%2.0" /end CHARACTERISTIC
/begin CHARACTERISTIC XTAB5X2M_RADOPTS_LOWGANG9_ZKA "" MAP 0x1DDD60 _REC_A1MAP_8_u2_u2_u2_S2 1000 _CNV_R_R_Umr_1_zu_1_30_CM_S2 0 1000
 /begin AXIS_DESCR COM_AXIS N_AB _CNV_R_R_Umr_1_zu_1_3_CM_S2 5 0 65535 DEPOSIT ABSOLUTE AXIS_PTS_REF SSTTAB_MRADOPTS_GANG9 /end AXIS_DESCR
 /begin AXIS_DESCR FIX_AXIS NO_INPUT_QUANTITY _CNV_S_5_Enum_EZKAT_184_CM_S2 2 0 4 READ_ONLY /begin FIX_AXIS_PAR_LIST 0 1 /end FIX_AXIS_PAR_LIST /end AXIS_DESCR
 FORMAT "%2.0" /end CHARACTERISTIC
/begin CHARACTERISTIC XTAB5X2SCHM_REKUPRS_DBM "" MAP 0x1DAF40 _REC_A1MAP_8_s2_u1_u1_S2 2046 _CNV_R_R_Umr_1_zu_1_38_CM_S2 -1023 1023
 /begin AXIS_DESCR FIX_AXIS NO_INPUT_QUANTITY _CNV_S_2_Enum_REKUP_259_CM_S2 2 0 1 READ_ONLY /begin FIX_AXIS_PAR_LIST 0 1 /end FIX_AXIS_PAR_LIST /end AXIS_DESCR
 /begin AXIS_DESCR FIX_AXIS Z_REKUP_IDX_DBM _CNV_S_5_Enum_REKUP_257_CM_S2 5 0 4 READ_ONLY /begin FIX_AXIS_PAR_LIST 0 1 2 3 4 /end FIX_AXIS_PAR_LIST /end AXIS_DESCR
 FORMAT "%2.0" /end CHARACTERISTIC
/begin CHARACTERISTIC XTAB5X2SCHW_LWVA_EFF_DERS "" MAP 0x1DD994 _REC_S3MAP_54_u2_u2_u1_S2 90 _CNV_R_R_Umr_10_zu__10_CM_S2 0 90
 /begin AXIS_DESCR STD_AXIS V_FZG _CNV_R_R_Umr_1_zu_1_8_CM_S2 5 0 250 DEPOSIT ABSOLUTE FORMAT "%2.0" /end AXIS_DESCR
 /begin AXIS_DESCR FIX_AXIS S_B_BCA _CNV_P_2_A_I_5_CM_S2 2 0 255 READ_ONLY /begin FIX_AXIS_PAR_LIST 0 1 /end FIX_AXIS_PAR_LIST /end AXIS_DESCR
 FORMAT "%3.1" /end CHARACTERISTIC
/begin CHARACTERISTIC XTAB5X2SCHW_STEIGUNG_BAB "" MAP 0x1DC17C _REC_S3MAP_54_s2_u2_u1_S2 400 _CNV_R_R_Umr_10_zu__9_CM_S2 -200 200
 /begin AXIS_DESCR STD_AXIS V_FZG _CNV_R_R_Umr_1_zu_1_8_CM_S2 5 0 400 DEPOSIT ABSOLUTE FORMAT "%2.0" /end AXIS_DESCR
 /begin AXIS_DESCR FIX_AXIS NO_INPUT_QUANTITY _CNV_S_2_Enum_EBABE_40_CM_S2 2 0 1 READ_ONLY FIX_AXIS_PAR_DIST 0 1 2 /end AXIS_DESCR
 FORMAT "%3.1" /end CHARACTERISTIC
/begin CHARACTERISTIC XTAB5X2SCHW_STEIGUNG_BABLDM "" MAP 0x1DC19C _REC_S3MAP_54_s2_u2_u1_S2 400 _CNV_R_R_Umr_10_zu__9_CM_S2 -200 200
 /begin AXIS_DESCR STD_AXIS V_FZG _CNV_R_R_Umr_1_zu_1_8_CM_S2 5 0 400 DEPOSIT ABSOLUTE FORMAT "%2.0" /end AXIS_DESCR
 /begin AXIS_DESCR FIX_AXIS NO_INPUT_QUANTITY _CNV_S_2_Enum_EBABE_40_CM_S2 2 0 1 READ_ONLY FIX_AXIS_PAR_DIST 0 1 2 /end AXIS_DESCR
 FORMAT "%3.1" /end CHARACTERISTIC
/begin CHARACTERISTIC XTAB5X3FAKT_M_MOTDYNMIN_HKOR "" MAP 0x1DC5A8 _REC_S7MAP_53_u2_u2_s2_S2 100 _CNV_R_R_Umr_1_zu_1_30_CM_S2 0 100
 /begin AXIS_DESCR STD_AXIS VM_MOT_HKOR _CNV_R_R_Umr_1_zu_1_30_CM_S2 5 0 100 DEPOSIT ABSOLUTE FORMAT "%2.0" /end AXIS_DESCR
 /begin AXIS_DESCR STD_AXIS M_MOT_STAT _CNV_R_R_Umr_1_zu_1_38_CM_S2 3 0 1000 DEPOSIT ABSOLUTE FORMAT "%2.0" /end AXIS_DESCR
 FORMAT "%2.0" /end CHARACTERISTIC
/begin CHARACTERISTIC XTAB5X3KORFAKT_FWS_TEMP "" MAP 0x1DC4F8 _REC_S7MAP_53_u2_s2_s2_S2 2 _CNV_R_R_Umr_100_zu_42_CM_S2 0 2
 /begin AXIS_DESCR STD_AXIS TEMP_MOT _CNV_R_R_Umr_1_zu_1_1_CM_S2 5 -50 150 DEPOSIT ABSOLUTE FORMAT "%2.0" /end AXIS_DESCR
 /begin AXIS_DESCR STD_AXIS TEMP_GETR _CNV_R_R_Umr_1_zu_1_1_CM_S2 3 -50 150 DEPOSIT ABSOLUTE FORMAT "%2.0" /end AXIS_DESCR
 FORMAT "%4.2" /end CHARACTERISTIC
/begin CHARACTERISTIC XTAB5X3ODM_AB_FWS_TEMP "" MAP 0x1DC528 _REC_S7MAP_53_s2_s2_s2_S2 65535 _CNV_R_R_Umr_1_zu_1_38_CM_S2 -32768 32767
 /begin AXIS_DESCR STD_AXIS TEMP_MOT _CNV_R_R_Umr_1_zu_1_1_CM_S2 5 -50 150 DEPOSIT ABSOLUTE FORMAT "%2.0" /end AXIS_DESCR
 /begin AXIS_DESCR STD_AXIS TEMP_GETR _CNV_R_R_Umr_1_zu_1_1_CM_S2 3 -50 150 DEPOSIT ABSOLUTE FORMAT "%2.0" /end AXIS_DESCR
 FORMAT "%4.2" /end CHARACTERISTIC
/begin CHARACTERISTIC XTAB5X3SCHDM_AB_FWS "" MAP 0x1DE7D8 _REC_A1MAP_9_s2_u1_u1_S2 32767 _CNV_R_R_Umr_1_zu_1_38_CM_S2 0 32767
 /begin AXIS_DESCR FIX_AXIS Z_BERGANH _CNV_S_6_Enum_EBERG_47_CM_S2 5 0 5 READ_ONLY FIX_AXIS_PAR_DIST 0 1 5 /end AXIS_DESCR
 /begin AXIS_DESCR FIX_AXIS NO_INPUT_QUANTITY _CNV_S_3_Enum_EHDM__48_CM_S2 3 0 2 READ_ONLY FIX_AXIS_PAR_DIST 0 1 3 /end AXIS_DESCR
 FORMAT "%2.0" /end CHARACTERISTIC
/begin CHARACTERISTIC XTAB5X3SCHN_TMIN_CMOPLUFT_DBM "" MAP 0x1DB594 _REC_S7MAP_53_s2_s2_u2_S2 32000 _CNV_R_R_Umr_1_zu_1_3_CM_S2 0 32000
 /begin AXIS_DESCR STD_AXIS TEMP_MOT _CNV_R_R_Umr_1_zu_1_1_CM_S2 5 -50 150 DEPOSIT ABSOLUTE FORMAT "%2.0" /end AXIS_DESCR
 /begin AXIS_DESCR STD_AXIS P_LUFT _CNV_R_R_Umr_1_zu_1_0_CM_S2 3 598 1108 DEPOSIT ABSOLUTE FORMAT "%2.0" /end AXIS_DESCR
 FORMAT "%2.0" /end CHARACTERISTIC
/begin CHARACTERISTIC XTAB5X3SCHN_TMIN_NMOTSOLL_DBM "" MAP 0x1DE06C _REC_S3MAP_54_s2_u2_u2_S2 32000 _CNV_R_R_Umr_1_zu_1_3_CM_S2 0 32000
 /begin AXIS_DESCR STD_AXIS N_MOT_SOLLLL _CNV_R_R_Umr_1_zu_1_3_CM_S2 5 0 65535 DEPOSIT ABSOLUTE FORMAT "%2.0" /end AXIS_DESCR
 /begin AXIS_DESCR FIX_AXIS NO_INPUT_QUANTITY _CNV_S_3_Enum_EWL_255_CM_S2 3 0 2 READ_ONLY /begin FIX_AXIS_PAR_LIST 0 1 2 /end FIX_AXIS_PAR_LIST /end AXIS_DESCR
 FORMAT "%2.0" /end CHARACTERISTIC
/begin CHARACTERISTIC XTAB5X4N_MOTMAX_RSZ_BAB "" MAP 0x1DD638 _REC_S3MAP_54_u2_s2_u1_S2 10000 _CNV_R_R_Umr_1_zu_1_3_CM_S2 0 10000
 /begin AXIS_DESCR STD_AXIS DM_AB_FWS_FILT_BAB _CNV_R_R_Umr_1_zu_1_38_CM_S2 5 -5000 0 DEPOSIT ABSOLUTE /end AXIS_DESCR
 /begin AXIS_DESCR FIX_AXIS Z_AGSMOD_ECO_EFAHREN _CNV_S_4_Enum_EAGS__17_CM_S2 4 0 3 READ_ONLY FIX_AXIS_PAR_DIST 0 1 4 /end AXIS_DESCR
 FORMAT "%2.0" /end CHARACTERISTIC
/begin CHARACTERISTIC XTAB5X5FAKT_HEISSHOCH "" MAP 0x1DD544 _REC_S7MAP_53_u2_s2_u2_S2 250 _CNV_R_R_Umr_1_zu_1_30_CM_S2 0 250
 /begin AXIS_DESCR STD_AXIS TEMP_UMG _CNV_R_R_Umr_1_zu_1_1_CM_S2 5 -50 80 DEPOSIT ABSOLUTE FORMAT "%2.0" /end AXIS_DESCR
 /begin AXIS_DESCR STD_AXIS P_LUFT _CNV_R_R_Umr_1_zu_1_0_CM_S2 5 598 1108 DEPOSIT ABSOLUTE FORMAT "%2.0" /end AXIS_DESCR
 FORMAT "%2.0" /end CHARACTERISTIC
/begin CHARACTERISTIC XTAB5X5FAKT_HKORROH "" MAP 0x1DC5D8 _REC_S7MAP_53_u2_s2_u2_S2 250 _CNV_R_R_Umr_1_zu_1_30_CM_S2 0 250
 /begin AXIS_DESCR STD_AXIS TEMP_UMG _CNV_R_R_Umr_1_zu_1_1_CM_S2 5 -50 80 DEPOSIT ABSOLUTE FORMAT "%2.0" /end AXIS_DESCR
 /begin AXIS_DESCR STD_AXIS P_LUFT _CNV_R_R_Umr_1_zu_1_0_CM_S2 5 598 1108 DEPOSIT ABSOLUTE FORMAT "%2.0" /end AXIS_DESCR
 FORMAT "%2.0" /end CHARACTERISTIC
/begin CHARACTERISTIC XTAB5X5FAKT_M_MOTDYN_HKOR "" MAP 0x1DC620 _REC_S7MAP_53_u2_u2_u2_S2 200 _CNV_R_R_Umr_1_zu_1_30_CM_S2 0 200
 /begin AXIS_DESCR STD_AXIS N_GE_NAB_ZIELGANG _CNV_R_R_Umr_1_zu_1_3_CM_S2 5 0 10000 DEPOSIT ABSOLUTE FORMAT "%2.0" /end AXIS_DESCR
 /begin AXIS_DESCR STD_AXIS VM_MOT_ISTFW_KOR _CNV_R_R_Umr_100_zu_88_CM_S2 5 0 2 DEPOSIT ABSOLUTE FORMAT "%4.2" /end AXIS_DESCR
 FORMAT "%2.0" /end CHARACTERISTIC
/begin CHARACTERISTIC XTAB5X5FAKT_SOC_HSURETYPE "" MAP 0x1DC6B4 _REC_S7MAP_53_u2_u2_s2_S2 1 _CNV_R_R_Umr_100_zu_42_CM_S2 0 1
 /begin AXIS_DESCR STD_AXIS Z_SOC _CNV_R_R_Umr_1_zu_1_30_CM_S2 5 0 100 DEPOSIT ABSOLUTE FORMAT "%2.0" /end AXIS_DESCR
 /begin AXIS_DESCR STD_AXIS W_STEIGUNG_KORFILT _CNV_R_R_Umr_10_zu__9_CM_S2 5 -200 200 DEPOSIT ABSOLUTE FORMAT "%3.1" /end AXIS_DESCR
 FORMAT "%4.2" /end CHARACTERISTIC
/begin CHARACTERISTIC XTAB5X5HSUREKU_DECRVAL_AAGS "" MAP 0x1DC7F4 _REC_S7MAP_53_u2_u2_s2_S2 255 _CNV_R_R_Umr_1_zu_1_2_CM_S2 0 255
 /begin AXIS_DESCR STD_AXIS N_MOT _CNV_R_R_Umr_1_zu_1_3_CM_S2 5 0 65535 DEPOSIT ABSOLUTE /end AXIS_DESCR
 /begin AXIS_DESCR STD_AXIS A_Q_KURVE _CNV_R_R_Umr_10_zu__37_CM_S2 5 0 3276.7 DEPOSIT ABSOLUTE /end AXIS_DESCR
 FORMAT "%2.0" /end CHARACTERISTIC
/begin CHARACTERISTIC XTAB5X5HSUREKU_DECRVAL_LDMAAGS "" MAP 0x1DC83C _REC_S7MAP_53_u2_u2_s2_S2 255 _CNV_R_R_Umr_1_zu_1_2_CM_S2 0 255
 /begin AXIS_DESCR STD_AXIS N_MOT _CNV_R_R_Umr_1_zu_1_3_CM_S2 5 0 65535 DEPOSIT ABSOLUTE /end AXIS_DESCR
 /begin AXIS_DESCR STD_AXIS A_Q_KURVE _CNV_R_R_Umr_10_zu__37_CM_S2 5 0 3276.7 DEPOSIT ABSOLUTE /end AXIS_DESCR
 FORMAT "%2.0" /end CHARACTERISTIC
/begin CHARACTERISTIC XTAB5X5HSUREKU_DECRVAL_LDMSAGS "" MAP 0x1DC884 _REC_S7MAP_53_u2_u2_s2_S2 255 _CNV_R_R_Umr_1_zu_1_2_CM_S2 0 255
 /begin AXIS_DESCR STD_AXIS N_MOT _CNV_R_R_Umr_1_zu_1_3_CM_S2 5 0 65535 DEPOSIT ABSOLUTE /end AXIS_DESCR
 /begin AXIS_DESCR STD_AXIS A_Q_KURVE _CNV_R_R_Umr_10_zu__37_CM_S2 5 0 3276.7 DEPOSIT ABSOLUTE /end AXIS_DESCR
 FORMAT "%2.0" /end CHARACTERISTIC
/begin CHARACTERISTIC XTAB5X5HSUREKU_DECRVAL_SAGS "" MAP 0x1DC8CC _REC_S7MAP_53_u2_u2_s2_S2 255 _CNV_R_R_Umr_1_zu_1_2_CM_S2 0 255
 /begin AXIS_DESCR STD_AXIS N_MOT _CNV_R_R_Umr_1_zu_1_3_CM_S2 5 0 65535 DEPOSIT ABSOLUTE /end AXIS_DESCR
 /begin AXIS_DESCR STD_AXIS A_Q_KURVE _CNV_R_R_Umr_10_zu__37_CM_S2 5 0 3276.7 DEPOSIT ABSOLUTE /end AXIS_DESCR
 FORMAT "%2.0" /end CHARACTERISTIC
/begin CHARACTERISTIC XTAB5X5SCHN_MOTMAX_RSUMUELOW "" MAP 0x1E350A _REC_S3MAP_54_u2_u2_u2_S2 10000 _CNV_R_R_Umr_1_zu_1_3_CM_S2 0 10000
 /begin AXIS_DESCR STD_AXIS MUE_DYN _CNV_R_R_Umr_1000_z_36_CM_S2 5 0 65.535 DEPOSIT ABSOLUTE FORMAT "%5.3" /end AXIS_DESCR
 /begin AXIS_DESCR FIX_AXIS NO_INPUT_QUANTITY _CNV_S_9_Enum_EGANG_21_CM_S2 5 0 8 READ_ONLY /begin FIX_AXIS_PAR_LIST 0 1 2 3 4 /end FIX_AXIS_PAR_LIST /end AXIS_DESCR
 FORMAT "%2.0" /end CHARACTERISTIC
/begin CHARACTERISTIC XTAB5X5VM_MOT_ISTFW_HKOR "" MAP 0x1DC668 _REC_S7MAP_53_u2_s2_u2_S2 3 _CNV_R_R_Umr_100_zu_88_CM_S2 0 3
 /begin AXIS_DESCR STD_AXIS GM_MOT_FW_FILT _CNV_R_R_Umr_1_zu_1_2_CM_S2 5 0 1000 DEPOSIT ABSOLUTE FORMAT "%3.1" /end AXIS_DESCR
 /begin AXIS_DESCR STD_AXIS VM_MOT_ISTFW_FILT _CNV_R_R_Umr_100_zu_88_CM_S2 5 0 2 DEPOSIT ABSOLUTE FORMAT "%4.2" /end AXIS_DESCR
 FORMAT "%4.2" /end CHARACTERISTIC
/begin CHARACTERISTIC XTAB5X5W_NICK "" MAP 0x1DD4E8 _REC_S7MAP_53_s2_s2_u2_S2 40 _CNV_R_R_Umr_10_zu__108_CM_S2 -20 20
 /begin AXIS_DESCR STD_AXIS M_AB_NICK _CNV_R_R_Umr_1_zu_1_38_CM_S2 5 -32768 32767 DEPOSIT ABSOLUTE FORMAT "%2.0" /end AXIS_DESCR
 /begin AXIS_DESCR STD_AXIS V_FZG _CNV_R_R_Umr_1_zu_1_8_CM_S2 5 0 400 DEPOSIT ABSOLUTE FORMAT "%2.0" /end AXIS_DESCR
 FORMAT "%4.2" /end CHARACTERISTIC
/begin CHARACTERISTIC XTAB5X9C_HSUREBAB_DECRVAL_AAGS "" MAP 0x1E27BA _REC_S3MAP_54_u2_u2_u1_S2 255 _CNV_R_R_Umr_1_zu_1_2_CM_S2 0 255
 /begin AXIS_DESCR STD_AXIS N_MOT _CNV_R_R_Umr_1_zu_1_3_CM_S2 5 0 20000 DEPOSIT ABSOLUTE FORMAT "%2.0" /end AXIS_DESCR
 /begin AXIS_DESCR FIX_AXIS Z_GANG_ZIEL_HSURE _CNV_S_9_Enum_EGANG_21_CM_S2 9 0 8 READ_ONLY FIX_AXIS_PAR_DIST 0 1 9 /end AXIS_DESCR
 FORMAT "%2.0" /end CHARACTERISTIC
/begin CHARACTERISTIC XTAB5X9C_HSUREBAB_DECRVAL_SAGS "" MAP 0x1E2820 _REC_S3MAP_54_u2_u2_u1_S2 255 _CNV_R_R_Umr_1_zu_1_2_CM_S2 0 255
 /begin AXIS_DESCR STD_AXIS N_MOT _CNV_R_R_Umr_1_zu_1_3_CM_S2 5 0 20000 DEPOSIT ABSOLUTE FORMAT "%2.0" /end AXIS_DESCR
 /begin AXIS_DESCR FIX_AXIS Z_GANG_ZIEL_HSURE _CNV_S_9_Enum_EGANG_21_CM_S2 9 0 8 READ_ONLY FIX_AXIS_PAR_DIST 0 1 9 /end AXIS_DESCR
 FORMAT "%2.0" /end CHARACTERISTIC
/begin CHARACTERISTIC XTAB5X9C_HSUREHSDECR_NMOT_AAGS "" MAP 0x1DEE2C _REC_S3MAP_54_u2_u2_u1_S2 255 _CNV_R_R_Umr_1_zu_1_2_CM_S2 0 255
 /begin AXIS_DESCR STD_AXIS N_MOTNACHHS_HSUREHS _CNV_R_R_Umr_1_zu_1_3_CM_S2 5 0 20000 DEPOSIT ABSOLUTE FORMAT "%2.0" /end AXIS_DESCR
 /begin AXIS_DESCR FIX_AXIS Z_GANG_ZIEL_HSURE _CNV_S_9_Enum_EGANG_21_CM_S2 9 0 8 READ_ONLY FIX_AXIS_PAR_DIST 0 1 9 /end AXIS_DESCR
 FORMAT "%2.0" /end CHARACTERISTIC
/begin CHARACTERISTIC XTAB5X9C_HSUREHSDECR_NMOT_SAGS "" MAP 0x1DEE92 _REC_S3MAP_54_u2_u2_u1_S2 255 _CNV_R_R_Umr_1_zu_1_2_CM_S2 0 255
 /begin AXIS_DESCR STD_AXIS N_MOTNACHHS_HSUREHS _CNV_R_R_Umr_1_zu_1_3_CM_S2 5 0 20000 DEPOSIT ABSOLUTE FORMAT "%2.0" /end AXIS_DESCR
 /begin AXIS_DESCR FIX_AXIS Z_GANG_ZIEL_HSURE _CNV_S_9_Enum_EGANG_21_CM_S2 9 0 8 READ_ONLY FIX_AXIS_PAR_DIST 0 1 9 /end AXIS_DESCR
 FORMAT "%2.0" /end CHARACTERISTIC
/begin CHARACTERISTIC XTAB5X9C_HSUREINSTDECR_NMOT "" MAP 0x1DEEFA _REC_S3MAP_54_u2_u2_u1_S2 20000 _CNV_R_R_Umr_1_zu_1_2_CM_S2 0 20000
 /begin AXIS_DESCR STD_AXIS N_MOT _CNV_R_R_Umr_1_zu_1_3_CM_S2 5 0 20000 DEPOSIT ABSOLUTE FORMAT "%2.0" /end AXIS_DESCR
 /begin AXIS_DESCR FIX_AXIS Z_GANG_ZIEL _CNV_S_9_Enum_EGANG_21_CM_S2 9 0 8 READ_ONLY FIX_AXIS_PAR_DIST 0 1 9 /end AXIS_DESCR
 FORMAT "%2.0" /end CHARACTERISTIC
/begin CHARACTERISTIC XTAB5X9C_HSURERSDECR_NMOT_AAGS "" MAP 0x1DF030 _REC_S3MAP_54_u2_u2_u1_S2 255 _CNV_R_R_Umr_1_zu_1_2_CM_S2 0 255
 /begin AXIS_DESCR STD_AXIS N_MOT _CNV_R_R_Umr_1_zu_1_3_CM_S2 5 0 20000 DEPOSIT ABSOLUTE FORMAT "%2.0" /end AXIS_DESCR
 /begin AXIS_DESCR FIX_AXIS Z_GANG_ZIEL_HSURE _CNV_S_9_Enum_EGANG_21_CM_S2 9 0 8 READ_ONLY FIX_AXIS_PAR_DIST 0 1 9 /end AXIS_DESCR
 FORMAT "%2.0" /end CHARACTERISTIC
/begin CHARACTERISTIC XTAB5X9C_HSURERSDECR_NMOT_SAGS "" MAP 0x1DF096 _REC_S3MAP_54_u2_u2_u1_S2 255 _CNV_R_R_Umr_1_zu_1_2_CM_S2 0 255
 /begin AXIS_DESCR STD_AXIS N_MOT _CNV_R_R_Umr_1_zu_1_3_CM_S2 5 0 20000 DEPOSIT ABSOLUTE FORMAT "%2.0" /end AXIS_DESCR
 /begin AXIS_DESCR FIX_AXIS Z_GANG_ZIEL_HSURE _CNV_S_9_Enum_EGANG_21_CM_S2 9 0 8 READ_ONLY FIX_AXIS_PAR_DIST 0 1 9 /end AXIS_DESCR
 FORMAT "%2.0" /end CHARACTERISTIC
/begin CHARACTERISTIC XTAB5X9F_NMOTBEGR "" MAP 0x1DF3B2 _REC_S3MAP_54_u2_s2_u1_S2 2 _CNV_R_R_Umr_100_zu_153_CM_S2 0 2
 /begin AXIS_DESCR STD_AXIS G2W_AB_FILT _CNV_R_R_Umr_10_zu__138_CM_S2 5 -3276.8 3276.7 DEPOSIT ABSOLUTE FORMAT "%3.1" /end AXIS_DESCR
 /begin AXIS_DESCR FIX_AXIS Z_GANG_ZIEL _CNV_S_9_Enum_EGANG_21_CM_S2 9 0 8 READ_ONLY FIX_AXIS_PAR_DIST 0 1 9 /end AXIS_DESCR
 FORMAT "%4.2" /end CHARACTERISTIC
/begin CHARACTERISTIC XTAB5X9G2W_AB_REFDYNHSPV "" MAP 0x1DF5A0 _REC_S3MAP_54_s2_u2_u1_S2 6553.5 _CNV_R_R_Umr_10_zu__138_CM_S2 -3276.8 3276.7
 /begin AXIS_DESCR STD_AXIS N_MOT _CNV_R_R_Umr_1_zu_1_3_CM_S2 5 0 20000 DEPOSIT ABSOLUTE FORMAT "%2.0" /end AXIS_DESCR
 /begin AXIS_DESCR FIX_AXIS Z_GANG_ZIEL _CNV_S_9_Enum_EGANG_21_CM_S2 9 0 8 READ_ONLY FIX_AXIS_PAR_DIST 0 1 9 /end AXIS_DESCR
 FORMAT "%3.1" /end CHARACTERISTIC
/begin CHARACTERISTIC XTAB5X9N_TIPPRS_NOT_STPTRsport "" MAP 0x1DE4F0 _REC_S3MAP_54_u2_s2_u1_S2 9000 _CNV_R_R_Umr_1_zu_1_3_CM_S2 0 9000
 /begin AXIS_DESCR STD_AXIS G2W_AB_FILT _CNV_R_R_Umr_10_zu__138_CM_S2 5 -3276.8 3276.7 DEPOSIT ABSOLUTE FORMAT "%3.1" /end AXIS_DESCR
 /begin AXIS_DESCR FIX_AXIS Z_GANG_TIPP_SPORT _CNV_S_9_Enum_EGANG_21_CM_S2 9 0 8 READ_ONLY FIX_AXIS_PAR_DIST 0 1 9 /end AXIS_DESCR
 FORMAT "%2.0" /end CHARACTERISTIC
/begin CHARACTERISTIC XTAB5X9ON_AB_HS_A1_A2 "" MAP 0x1DE688 _REC_S3MAP_54_u1_u2_u1_S2 1255 _CNV_R_R_Umr_1_zu_5_97_CM_S2 0 1255
 /begin AXIS_DESCR STD_AXIS W_DKKD _CNV_R_R_Umr_10_zu__9_CM_S2 5 0 120 DEPOSIT ABSOLUTE FORMAT "%3.1" /end AXIS_DESCR
 /begin AXIS_DESCR FIX_AXIS Z_GANG_ZIEL _CNV_S_9_Enum_EGANG_21_CM_S2 9 0 8 READ_ONLY FIX_AXIS_PAR_DIST 0 1 9 /end AXIS_DESCR
 FORMAT "%2.0" /end CHARACTERISTIC
/begin CHARACTERISTIC XTAB5X9ON_AB_HS_A2_A3 "" MAP 0x1DE6C2 _REC_S3MAP_54_u1_u2_u1_S2 1255 _CNV_R_R_Umr_1_zu_5_97_CM_S2 0 1255
 /begin AXIS_DESCR STD_AXIS W_DKKD _CNV_R_R_Umr_10_zu__9_CM_S2 5 0 120 DEPOSIT ABSOLUTE FORMAT "%3.1" /end AXIS_DESCR
 /begin AXIS_DESCR FIX_AXIS Z_GANG_ZIEL _CNV_S_9_Enum_EGANG_21_CM_S2 9 0 8 READ_ONLY FIX_AXIS_PAR_DIST 0 1 9 /end AXIS_DESCR
 FORMAT "%2.0" /end CHARACTERISTIC
/begin CHARACTERISTIC XTAB5X9ON_AB_HS_A3_A4 "" MAP 0x1DE6FC _REC_S3MAP_54_u1_u2_u1_S2 1255 _CNV_R_R_Umr_1_zu_5_97_CM_S2 0 1255
 /begin AXIS_DESCR STD_AXIS W_DKKD _CNV_R_R_Umr_10_zu__9_CM_S2 5 0 120 DEPOSIT ABSOLUTE FORMAT "%3.1" /end AXIS_DESCR
 /begin AXIS_DESCR FIX_AXIS Z_GANG_ZIEL _CNV_S_9_Enum_EGANG_21_CM_S2 9 0 8 READ_ONLY FIX_AXIS_PAR_DIST 0 1 9 /end AXIS_DESCR
 FORMAT "%2.0" /end CHARACTERISTIC
/begin CHARACTERISTIC XTAB5X9ON_AB_HS_A4_A5 "" MAP 0x1DE736 _REC_S3MAP_54_u1_u2_u1_S2 1255 _CNV_R_R_Umr_1_zu_5_97_CM_S2 0 1255
 /begin AXIS_DESCR STD_AXIS W_DKKD _CNV_R_R_Umr_10_zu__9_CM_S2 5 0 120 DEPOSIT ABSOLUTE FORMAT "%3.1" /end AXIS_DESCR
 /begin AXIS_DESCR FIX_AXIS Z_GANG_ZIEL _CNV_S_9_Enum_EGANG_21_CM_S2 9 0 8 READ_ONLY FIX_AXIS_PAR_DIST 0 1 9 /end AXIS_DESCR
 FORMAT "%2.0" /end CHARACTERISTIC
/begin CHARACTERISTIC XTAB5X9ON_AB_HS_OFF_A1 "" MAP 0x1DE770 _REC_S3MAP_54_u1_u2_u1_S2 1255 _CNV_R_R_Umr_1_zu_5_97_CM_S2 0 1255
 /begin AXIS_DESCR STD_AXIS W_DKKD _CNV_R_R_Umr_10_zu__9_CM_S2 5 0 120 DEPOSIT ABSOLUTE FORMAT "%3.1" /end AXIS_DESCR
 /begin AXIS_DESCR FIX_AXIS Z_GANG_ZIEL _CNV_S_9_Enum_EGANG_21_CM_S2 9 0 8 READ_ONLY FIX_AXIS_PAR_DIST 0 1 9 /end AXIS_DESCR
 FORMAT "%2.0" /end CHARACTERISTIC
/begin CHARACTERISTIC XTAB5X9ON_AB_RSSTPR "" MAP 0x1DE556 _REC_S3MAP_54_s2_s2_u1_S2 6000 _CNV_R_R_Umr_1_zu_1_3_CM_S2 -1000 5000
 /begin AXIS_DESCR STD_AXIS G2W_AB_FILT _CNV_R_R_Umr_10_zu__138_CM_S2 5 -3276.8 3276.7 DEPOSIT ABSOLUTE FORMAT "%3.1" /end AXIS_DESCR
 /begin AXIS_DESCR FIX_AXIS Z_GANG_ZIEL_SSTEP _CNV_S_9_Enum_EGANG_21_CM_S2 9 0 8 READ_ONLY FIX_AXIS_PAR_DIST 0 1 9 /end AXIS_DESCR
 FORMAT "%2.0" /end CHARACTERISTIC
/begin CHARACTERISTIC XTAB5X9ON_T_ARSSTAT_DBM "" MAP 0x1DE096 _REC_S3MAP_54_s2_s2_u2_S2 32000 _CNV_R_R_Umr_1_zu_1_3_CM_S2 0 32000
 /begin AXIS_DESCR STD_AXIS G2W_AB_FILT _CNV_R_R_Umr_10_zu__138_CM_S2 5 -3276.8 3276.7 DEPOSIT ABSOLUTE FORMAT "%2.0" /end AXIS_DESCR
 /begin AXIS_DESCR FIX_AXIS NO_INPUT_QUANTITY _CNV_S_9_Enum_EGANG_21_CM_S2 9 0 8 READ_ONLY /begin FIX_AXIS_PAR_LIST 0 1 2 3 4 5 6 7 8 /end FIX_AXIS_PAR_LIST /end AXIS_DESCR
 FORMAT "%2.0" /end CHARACTERISTIC
/begin CHARACTERISTIC XTAB5Z_FT_BR "" CURVE 0x1D9791 _REC_A1CUR_30_u1_u1_S2 3 _CNV_S_4_Enum_EFT_20_CM_S2 0 3
 /begin AXIS_DESCR FIX_AXIS Z_FT_MBR _CNV_S_5_Enum_EFT2_53_CM_S2 5 0 4 READ_ONLY FIX_AXIS_PAR_DIST 0 1 5 /end AXIS_DESCR
/end CHARACTERISTIC
/begin CHARACTERISTIC XTAB5_KORFAKT_MBR_BRS "" CURVE 0x1E24EC _REC_S7CUR_53_u2_s2_S2 500 _CNV_R_R_Umr_1_zu_1_30_CM_S2 0 500
 /begin AXIS_DESCR STD_AXIS M_BR _CNV_R_R_Umr_1_zu_1_38_CM_S2 5 -32768 0 DEPOSIT ABSOLUTE FORMAT "%4.2" /end AXIS_DESCR
 FORMAT "%2.0" /end CHARACTERISTIC
/begin CHARACTERISTIC XTAB5_KORFAKT_MBR_FWS "" CURVE 0x1E2780 _REC_S7CUR_53_u2_s2_S2 500 _CNV_R_R_Umr_1_zu_1_30_CM_S2 0 500
 /begin AXIS_DESCR STD_AXIS M_BR _CNV_R_R_Umr_1_zu_1_38_CM_S2 5 -32768 0 DEPOSIT ABSOLUTE FORMAT "%4.2" /end AXIS_DESCR
 FORMAT "%2.0" /end CHARACTERISTIC
/begin CHARACTERISTIC XTAB6M_EM1_MAX_ZKA "" CURVE 0x1DD5AC _REC_A1CUR_30_s2_u1_S2 500 _CNV_R_R_Umr_1_zu_1_38_CM_S2 0 500
 /begin AXIS_DESCR FIX_AXIS Z_DRIVELOGIC _CNV_S_6_Enum_EDL_11_CM_S2 6 1 6 READ_ONLY FIX_AXIS_PAR_DIST 1 1 6 /end AXIS_DESCR
 FORMAT "%2.0" /end CHARACTERISTIC
/begin CHARACTERISTIC XTAB6M_MOT_MAX_ZKA "" CURVE 0x1DD5B8 _REC_A1CUR_30_s4_u1_S2 1000 _CNV_R_R_Umr_1_zu_1_38_CM_S2 0 1000
 /begin AXIS_DESCR FIX_AXIS Z_DRIVELOGIC _CNV_S_6_Enum_EDL_11_CM_S2 6 1 6 READ_ONLY FIX_AXIS_PAR_DIST 1 1 6 /end AXIS_DESCR
 FORMAT "%2.0" /end CHARACTERISTIC
/begin CHARACTERISTIC XTAB6S_EFAHREN_ERK "" CURVE 0x1DF196 _REC_A1CUR_30_u1_u1_S2 255 _CNV_R_R_Umr_1_zu_1_2_CM_S2 0 255
 /begin AXIS_DESCR FIX_AXIS NO_INPUT_QUANTITY _CNV_R_R_Umr_1_zu_1_2_CM_S2 6 0 5 READ_ONLY FIX_AXIS_PAR_DIST 0 1 6 /end AXIS_DESCR
 FORMAT "%2.0" /end CHARACTERISTIC
/begin CHARACTERISTIC XTAB6S_EFAHR_KL_ERK "" CURVE 0x1DF19C _REC_A1CUR_30_u1_u1_S2 1 _CNV_S_2_Enum_EEFAH_120_CM_S2 0 1
 /begin AXIS_DESCR FIX_AXIS Z_EFAHRKL _CNV_S_6_Enum_EEFAH_118_CM_S2 6 0 5 READ_ONLY /begin FIX_AXIS_PAR_LIST 0 1 2 3 4 5 /end FIX_AXIS_PAR_LIST /end AXIS_DESCR
/end CHARACTERISTIC
/begin CHARACTERISTIC XTAB6X2GEW_FILTDAEMPF_DYNDZM "" MAP 0x1DC4DC _REC_A1MAP_9_u2_u1_u1_S2 2000 _CNV_R_R_Umr_1_zu_1_2_CM_S2 0 2000
 /begin AXIS_DESCR FIX_AXIS NO_INPUT_QUANTITY _CNV_P_2_A_I_5_CM_S2 6 0 255 READ_ONLY /begin FIX_AXIS_PAR_LIST 0 1 2 3 4 5 /end FIX_AXIS_PAR_LIST /end AXIS_DESCR
 /begin AXIS_DESCR FIX_AXIS NO_INPUT_QUANTITY _CNV_S_2_Enum_EGEW__13_CM_S2 2 0 1 READ_ONLY /begin FIX_AXIS_PAR_LIST 0 1 /end FIX_AXIS_PAR_LIST /end AXIS_DESCR
 FORMAT "%2.0" /end CHARACTERISTIC
/begin CHARACTERISTIC XTAB6X2SCHTEMP_GETR_QSMAX "" MAP 0x1DD4A4 _REC_A1MAP_9_s2_u2_u2_S2 400 _CNV_R_R_Umr_1_zu_1_1_CM_S2 -200 200
 /begin AXIS_DESCR FIX_AXIS NO_INPUT_QUANTITY _CNV_S_6_Enum_EQS_T_156_CM_S2 6 0 5 READ_ONLY FIX_AXIS_PAR_DIST 0 1 6 /end AXIS_DESCR
 /begin AXIS_DESCR FIX_AXIS NO_INPUT_QUANTITY _CNV_S_2_Enum_HSRS_157_CM_S2 2 0 1 READ_ONLY /begin FIX_AXIS_PAR_LIST 0 1 /end FIX_AXIS_PAR_LIST /end AXIS_DESCR
 FORMAT "%2.0" /end CHARACTERISTIC
/begin CHARACTERISTIC XTAB6X2Z_DYNSPVTUPEL_ECO_DBM "" MAP 0x1DAF54 _REC_A1MAP_8_s1_u1_u1_S2 4 _CNV_S_5_Enum_ETUPE_23_CM_S2 0 4
 /begin AXIS_DESCR FIX_AXIS Z_BERGANH _CNV_S_6_Enum_EBERG_47_CM_S2 6 0 5 READ_ONLY /begin FIX_AXIS_PAR_LIST 0 1 2 3 4 5 /end FIX_AXIS_PAR_LIST /end AXIS_DESCR
 /begin AXIS_DESCR FIX_AXIS S_KD _CNV_P_2_A_I_5_CM_S2 2 0 255 READ_ONLY /begin FIX_AXIS_PAR_LIST 0 1 /end FIX_AXIS_PAR_LIST /end AXIS_DESCR
/end CHARACTERISTIC
/begin CHARACTERISTIC XTAB6X2Z_GANGANZEIGE "" MAP 0x1DBFF4 _REC_A1MAP_9_u1_u1_u1_S2 5 _CNV_S_6_Enum_EANZE_152_CM_S2 0 5
 /begin AXIS_DESCR FIX_AXIS Z_ANZGANGART _CNV_S_6_Enum_EANZG_150_CM_S2 6 0 5 READ_ONLY FIX_AXIS_PAR_DIST 0 1 6 /end AXIS_DESCR
 /begin AXIS_DESCR FIX_AXIS S_COD_GETRTYP _CNV_S_2_Enum_ECOD__16_CM_S2 2 0 1 READ_ONLY FIX_AXIS_PAR_DIST 0 1 2 /end AXIS_DESCR
/end CHARACTERISTIC
/begin CHARACTERISTIC XTAB6X2_PRISQ_LDMAAGS_ZKA "" MAP 0x1DD5F0 _REC_A1MAP_8_s1_u2_u1_S2 5 _CNV_R_R_Umr_1_zu_1_2_CM_S2 0 5
 /begin AXIS_DESCR FIX_AXIS NO_INPUT_QUANTITY _CNV_S_2_Enum_EZKAT_185_CM_S2 2 0 1 READ_ONLY /begin FIX_AXIS_PAR_LIST 0 1 /end FIX_AXIS_PAR_LIST /end AXIS_DESCR
 /begin AXIS_DESCR FIX_AXIS Z_BERGANH _CNV_S_6_Enum_EBERG_47_CM_S2 6 0 5 READ_ONLY /begin FIX_AXIS_PAR_LIST 0 1 2 3 4 5 /end FIX_AXIS_PAR_LIST /end AXIS_DESCR
 FORMAT "%2.0" /end CHARACTERISTIC
/begin CHARACTERISTIC XTAB6X2_PRISQ_LDMSAGS_ZKA "" MAP 0x1DD5FC _REC_A1MAP_8_s1_u2_u1_S2 5 _CNV_R_R_Umr_1_zu_1_2_CM_S2 0 5
 /begin AXIS_DESCR FIX_AXIS NO_INPUT_QUANTITY _CNV_S_2_Enum_EZKAT_185_CM_S2 2 0 1 READ_ONLY /begin FIX_AXIS_PAR_LIST 0 1 /end FIX_AXIS_PAR_LIST /end AXIS_DESCR
 /begin AXIS_DESCR FIX_AXIS Z_BERGANH _CNV_S_6_Enum_EBERG_47_CM_S2 6 0 5 READ_ONLY /begin FIX_AXIS_PAR_LIST 0 1 2 3 4 5 /end FIX_AXIS_PAR_LIST /end AXIS_DESCR
 FORMAT "%2.0" /end CHARACTERISTIC
/begin CHARACTERISTIC XTAB6X2_PRISQ_ZKALDMAAGS_DBM "" MAP 0x1DAF60 _REC_A1MAP_8_s1_u2_u1_S2 11 _CNV_R_R_Umr_1_zu_1_2_CM_S2 -1 10
 /begin AXIS_DESCR FIX_AXIS NO_INPUT_QUANTITY _CNV_S_2_Enum_EDBMT_253_CM_S2 2 0 1 READ_ONLY /begin FIX_AXIS_PAR_LIST 0 1 /end FIX_AXIS_PAR_LIST /end AXIS_DESCR
 /begin AXIS_DESCR FIX_AXIS Z_BERGANH _CNV_S_6_Enum_EBERG_47_CM_S2 6 0 5 READ_ONLY /begin FIX_AXIS_PAR_LIST 0 1 2 3 4 5 /end FIX_AXIS_PAR_LIST /end AXIS_DESCR
 FORMAT "%2.0" /end CHARACTERISTIC
/begin CHARACTERISTIC XTAB6X2_PRISQ_ZKALDMECO_DBM "" MAP 0x1DAF6C _REC_A1MAP_8_s1_u2_u1_S2 11 _CNV_R_R_Umr_1_zu_1_2_CM_S2 -1 10
 /begin AXIS_DESCR FIX_AXIS NO_INPUT_QUANTITY _CNV_S_2_Enum_EDBMT_253_CM_S2 2 0 1 READ_ONLY /begin FIX_AXIS_PAR_LIST 0 1 /end FIX_AXIS_PAR_LIST /end AXIS_DESCR
 /begin AXIS_DESCR FIX_AXIS Z_BERGANH _CNV_S_6_Enum_EBERG_47_CM_S2 6 0 5 READ_ONLY /begin FIX_AXIS_PAR_LIST 0 1 2 3 4 5 /end FIX_AXIS_PAR_LIST /end AXIS_DESCR
 FORMAT "%2.0" /end CHARACTERISTIC
/begin CHARACTERISTIC XTAB6X2_PRISQ_ZKALDMSAGS_DBM "" MAP 0x1DAF78 _REC_A1MAP_8_s1_u2_u1_S2 11 _CNV_R_R_Umr_1_zu_1_2_CM_S2 -1 10
 /begin AXIS_DESCR FIX_AXIS NO_INPUT_QUANTITY _CNV_S_2_Enum_EDBMT_253_CM_S2 2 0 1 READ_ONLY /begin FIX_AXIS_PAR_LIST 0 1 /end FIX_AXIS_PAR_LIST /end AXIS_DESCR
 /begin AXIS_DESCR FIX_AXIS Z_BERGANH _CNV_S_6_Enum_EBERG_47_CM_S2 6 0 5 READ_ONLY /begin FIX_AXIS_PAR_LIST 0 1 2 3 4 5 /end FIX_AXIS_PAR_LIST /end AXIS_DESCR
 FORMAT "%2.0" /end CHARACTERISTIC
/begin CHARACTERISTIC XTAB6X3M_MOT_POTSCHUB_ZKA "" MAP 0x1E23EC _REC_S3MAP_54_u2_u2_u2_S2 200 _CNV_R_R_Umr_1_zu_1_30_CM_S2 0 200
 /begin AXIS_DESCR STD_AXIS N_MOT _CNV_R_R_Umr_1_zu_1_3_CM_S2 6 0 65535 DEPOSIT ABSOLUTE FORMAT "%2.0" /end AXIS_DESCR
 /begin AXIS_DESCR FIX_AXIS NO_INPUT_QUANTITY _CNV_S_3_Enum_EMOT__181_CM_S2 3 0 2 READ_ONLY /begin FIX_AXIS_PAR_LIST 0 1 2 /end FIX_AXIS_PAR_LIST /end AXIS_DESCR
 FORMAT "%2.0" /end CHARACTERISTIC
/begin CHARACTERISTIC XTAB6X3SCHN_GEMAXAKT_RFWS_10_DBM "" MAP 0x1DB5C4 _REC_S7MAP_53_u2_s2_u2_S2 32000 _CNV_R_R_Umr_1_zu_1_38_CM_S2 0 32000
 /begin AXIS_DESCR STD_AXIS DM_RAD_FWS_FILT _CNV_R_R_Umr_1_zu_1_38_CM_S2 6 0 2500 DEPOSIT ABSOLUTE FORMAT "%2.0" /end AXIS_DESCR
 /begin AXIS_DESCR STD_AXIS W_DKKD_FFG _CNV_R_R_Umr_10_zu__9_CM_S2 3 0 110 DEPOSIT ABSOLUTE FORMAT "%2.0" /end AXIS_DESCR
 FORMAT "%2.0" /end CHARACTERISTIC
/begin CHARACTERISTIC XTAB6X3SCHN_GEMAXAKT_RFWS_11_DBM "" MAP 0x1DB5FC _REC_S7MAP_53_u2_s2_u2_S2 32000 _CNV_R_R_Umr_1_zu_1_38_CM_S2 0 32000
 /begin AXIS_DESCR STD_AXIS DM_RAD_FWS_FILT _CNV_R_R_Umr_1_zu_1_38_CM_S2 6 0 2500 DEPOSIT ABSOLUTE FORMAT "%2.0" /end AXIS_DESCR
 /begin AXIS_DESCR STD_AXIS W_DKKD_FFG _CNV_R_R_Umr_10_zu__9_CM_S2 3 0 110 DEPOSIT ABSOLUTE FORMAT "%2.0" /end AXIS_DESCR
 FORMAT "%2.0" /end CHARACTERISTIC
/begin CHARACTERISTIC XTAB6X3SCHN_GEMAXAKT_RFWS_12_DBM "" MAP 0x1DB634 _REC_S7MAP_53_u2_s2_u2_S2 32000 _CNV_R_R_Umr_1_zu_1_38_CM_S2 0 32000
 /begin AXIS_DESCR STD_AXIS DM_RAD_FWS_FILT _CNV_R_R_Umr_1_zu_1_38_CM_S2 6 0 2500 DEPOSIT ABSOLUTE FORMAT "%2.0" /end AXIS_DESCR
 /begin AXIS_DESCR STD_AXIS W_DKKD_FFG _CNV_R_R_Umr_10_zu__9_CM_S2 3 0 110 DEPOSIT ABSOLUTE FORMAT "%2.0" /end AXIS_DESCR
 FORMAT "%2.0" /end CHARACTERISTIC
/begin CHARACTERISTIC XTAB6X3SCHN_GEMAXAKT_RFWS_13_DBM "" MAP 0x1DB66C _REC_S7MAP_53_u2_s2_u2_S2 32000 _CNV_R_R_Umr_1_zu_1_38_CM_S2 0 32000
 /begin AXIS_DESCR STD_AXIS DM_RAD_FWS_FILT _CNV_R_R_Umr_1_zu_1_38_CM_S2 6 0 2500 DEPOSIT ABSOLUTE FORMAT "%2.0" /end AXIS_DESCR
 /begin AXIS_DESCR STD_AXIS W_DKKD_FFG _CNV_R_R_Umr_10_zu__9_CM_S2 3 0 110 DEPOSIT ABSOLUTE FORMAT "%2.0" /end AXIS_DESCR
 FORMAT "%2.0" /end CHARACTERISTIC
/begin CHARACTERISTIC XTAB6X3SCHN_GEMAXAKT_RFWS_14_DBM "" MAP 0x1DB6A4 _REC_S7MAP_53_u2_s2_u2_S2 32000 _CNV_R_R_Umr_1_zu_1_38_CM_S2 0 32000
 /begin AXIS_DESCR STD_AXIS DM_RAD_FWS_FILT _CNV_R_R_Umr_1_zu_1_38_CM_S2 6 0 2500 DEPOSIT ABSOLUTE FORMAT "%2.0" /end AXIS_DESCR
 /begin AXIS_DESCR STD_AXIS W_DKKD_FFG _CNV_R_R_Umr_10_zu__9_CM_S2 3 0 110 DEPOSIT ABSOLUTE FORMAT "%2.0" /end AXIS_DESCR
 FORMAT "%2.0" /end CHARACTERISTIC
/begin CHARACTERISTIC XTAB6X3SCHN_GEMAXAKT_RFWS_15_DBM "" MAP 0x1DB6DC _REC_S7MAP_53_u2_s2_u2_S2 32000 _CNV_R_R_Umr_1_zu_1_38_CM_S2 0 32000
 /begin AXIS_DESCR STD_AXIS DM_RAD_FWS_FILT _CNV_R_R_Umr_1_zu_1_38_CM_S2 6 0 2500 DEPOSIT ABSOLUTE FORMAT "%2.0" /end AXIS_DESCR
 /begin AXIS_DESCR STD_AXIS W_DKKD_FFG _CNV_R_R_Umr_10_zu__9_CM_S2 3 0 110 DEPOSIT ABSOLUTE FORMAT "%2.0" /end AXIS_DESCR
 FORMAT "%2.0" /end CHARACTERISTIC
/begin CHARACTERISTIC XTAB6X3SCHN_GEMAXAKT_RFWS_1_DBM "" MAP 0x1DB714 _REC_S7MAP_53_u2_s2_u2_S2 32000 _CNV_R_R_Umr_1_zu_1_38_CM_S2 0 32000
 /begin AXIS_DESCR STD_AXIS DM_RAD_FWS_FILT _CNV_R_R_Umr_1_zu_1_38_CM_S2 6 0 2500 DEPOSIT ABSOLUTE FORMAT "%2.0" /end AXIS_DESCR
 /begin AXIS_DESCR STD_AXIS W_DKKD_FFG _CNV_R_R_Umr_10_zu__9_CM_S2 3 0 110 DEPOSIT ABSOLUTE FORMAT "%2.0" /end AXIS_DESCR
 FORMAT "%2.0" /end CHARACTERISTIC
/begin CHARACTERISTIC XTAB6X3SCHN_GEMAXAKT_RFWS_2_DBM "" MAP 0x1DB74C _REC_S7MAP_53_u2_s2_u2_S2 32000 _CNV_R_R_Umr_1_zu_1_38_CM_S2 0 32000
 /begin AXIS_DESCR STD_AXIS DM_RAD_FWS_FILT _CNV_R_R_Umr_1_zu_1_38_CM_S2 6 0 2500 DEPOSIT ABSOLUTE FORMAT "%2.0" /end AXIS_DESCR
 /begin AXIS_DESCR STD_AXIS W_DKKD_FFG _CNV_R_R_Umr_10_zu__9_CM_S2 3 0 110 DEPOSIT ABSOLUTE FORMAT "%2.0" /end AXIS_DESCR
 FORMAT "%2.0" /end CHARACTERISTIC
/begin CHARACTERISTIC XTAB6X3SCHN_GEMAXAKT_RFWS_3_DBM "" MAP 0x1DB784 _REC_S7MAP_53_u2_s2_u2_S2 32000 _CNV_R_R_Umr_1_zu_1_38_CM_S2 0 32000
 /begin AXIS_DESCR STD_AXIS DM_RAD_FWS_FILT _CNV_R_R_Umr_1_zu_1_38_CM_S2 6 0 2500 DEPOSIT ABSOLUTE FORMAT "%2.0" /end AXIS_DESCR
 /begin AXIS_DESCR STD_AXIS W_DKKD_FFG _CNV_R_R_Umr_10_zu__9_CM_S2 3 0 110 DEPOSIT ABSOLUTE FORMAT "%2.0" /end AXIS_DESCR
 FORMAT "%2.0" /end CHARACTERISTIC
/begin CHARACTERISTIC XTAB6X3SCHN_GEMAXAKT_RFWS_4_DBM "" MAP 0x1DB7BC _REC_S7MAP_53_u2_s2_u2_S2 32000 _CNV_R_R_Umr_1_zu_1_38_CM_S2 0 32000
 /begin AXIS_DESCR STD_AXIS DM_RAD_FWS_FILT _CNV_R_R_Umr_1_zu_1_38_CM_S2 6 0 2500 DEPOSIT ABSOLUTE FORMAT "%2.0" /end AXIS_DESCR
 /begin AXIS_DESCR STD_AXIS W_DKKD_FFG _CNV_R_R_Umr_10_zu__9_CM_S2 3 0 110 DEPOSIT ABSOLUTE FORMAT "%2.0" /end AXIS_DESCR
 FORMAT "%2.0" /end CHARACTERISTIC
/begin CHARACTERISTIC XTAB6X3SCHN_GEMAXAKT_RFWS_5_DBM "" MAP 0x1DB7F4 _REC_S7MAP_53_u2_s2_u2_S2 32000 _CNV_R_R_Umr_1_zu_1_38_CM_S2 0 32000
 /begin AXIS_DESCR STD_AXIS DM_RAD_FWS_FILT _CNV_R_R_Umr_1_zu_1_38_CM_S2 6 0 2500 DEPOSIT ABSOLUTE FORMAT "%2.0" /end AXIS_DESCR
 /begin AXIS_DESCR STD_AXIS W_DKKD_FFG _CNV_R_R_Umr_10_zu__9_CM_S2 3 0 110 DEPOSIT ABSOLUTE FORMAT "%2.0" /end AXIS_DESCR
 FORMAT "%2.0" /end CHARACTERISTIC
/begin CHARACTERISTIC XTAB6X3SCHN_GEMAXAKT_RFWS_6_DBM "" MAP 0x1DB82C _REC_S7MAP_53_u2_s2_u2_S2 32000 _CNV_R_R_Umr_1_zu_1_38_CM_S2 0 32000
 /begin AXIS_DESCR STD_AXIS DM_RAD_FWS_FILT _CNV_R_R_Umr_1_zu_1_38_CM_S2 6 0 2500 DEPOSIT ABSOLUTE FORMAT "%2.0" /end AXIS_DESCR
 /begin AXIS_DESCR STD_AXIS W_DKKD_FFG _CNV_R_R_Umr_10_zu__9_CM_S2 3 0 110 DEPOSIT ABSOLUTE FORMAT "%2.0" /end AXIS_DESCR
 FORMAT "%2.0" /end CHARACTERISTIC
/begin CHARACTERISTIC XTAB6X3SCHN_GEMAXAKT_RFWS_7_DBM "" MAP 0x1DB864 _REC_S7MAP_53_u2_s2_u2_S2 32000 _CNV_R_R_Umr_1_zu_1_38_CM_S2 0 32000
 /begin AXIS_DESCR STD_AXIS DM_RAD_FWS_FILT _CNV_R_R_Umr_1_zu_1_38_CM_S2 6 0 2500 DEPOSIT ABSOLUTE FORMAT "%2.0" /end AXIS_DESCR
 /begin AXIS_DESCR STD_AXIS W_DKKD_FFG _CNV_R_R_Umr_10_zu__9_CM_S2 3 0 110 DEPOSIT ABSOLUTE FORMAT "%2.0" /end AXIS_DESCR
 FORMAT "%2.0" /end CHARACTERISTIC
/begin CHARACTERISTIC XTAB6X3SCHN_GEMAXAKT_RFWS_8_DBM "" MAP 0x1DB89C _REC_S7MAP_53_u2_s2_u2_S2 32000 _CNV_R_R_Umr_1_zu_1_38_CM_S2 0 32000
 /begin AXIS_DESCR STD_AXIS DM_RAD_FWS_FILT _CNV_R_R_Umr_1_zu_1_38_CM_S2 6 0 2500 DEPOSIT ABSOLUTE FORMAT "%2.0" /end AXIS_DESCR
 /begin AXIS_DESCR STD_AXIS W_DKKD_FFG _CNV_R_R_Umr_10_zu__9_CM_S2 3 0 110 DEPOSIT ABSOLUTE FORMAT "%2.0" /end AXIS_DESCR
 FORMAT "%2.0" /end CHARACTERISTIC
/begin CHARACTERISTIC XTAB6X3SCHN_GEMAXAKT_RFWS_9_DBM "" MAP 0x1DB8D4 _REC_S7MAP_53_u2_s2_u2_S2 32000 _CNV_R_R_Umr_1_zu_1_38_CM_S2 0 32000
 /begin AXIS_DESCR STD_AXIS DM_RAD_FWS_FILT _CNV_R_R_Umr_1_zu_1_38_CM_S2 6 0 2500 DEPOSIT ABSOLUTE FORMAT "%2.0" /end AXIS_DESCR
 /begin AXIS_DESCR STD_AXIS W_DKKD_FFG _CNV_R_R_Umr_10_zu__9_CM_S2 3 0 110 DEPOSIT ABSOLUTE FORMAT "%2.0" /end AXIS_DESCR
 FORMAT "%2.0" /end CHARACTERISTIC
/begin CHARACTERISTIC XTAB6X3SCHN_GEMINAKT_RFWS_10_DBM "" MAP 0x1DB90C _REC_S7MAP_53_u2_s2_u2_S2 10000 _CNV_R_R_Umr_1_zu_1_38_CM_S2 0 10000
 /begin AXIS_DESCR STD_AXIS DM_RAD_FWS_FILT _CNV_R_R_Umr_1_zu_1_38_CM_S2 6 0 2500 DEPOSIT ABSOLUTE FORMAT "%2.0" /end AXIS_DESCR
 /begin AXIS_DESCR STD_AXIS W_DKKD_FFG _CNV_R_R_Umr_10_zu__9_CM_S2 3 0 110 DEPOSIT ABSOLUTE FORMAT "%2.0" /end AXIS_DESCR
 FORMAT "%2.0" /end CHARACTERISTIC
/begin CHARACTERISTIC XTAB6X3SCHN_GEMINAKT_RFWS_11_DBM "" MAP 0x1DB944 _REC_S7MAP_53_u2_s2_u2_S2 10000 _CNV_R_R_Umr_1_zu_1_38_CM_S2 0 10000
 /begin AXIS_DESCR STD_AXIS DM_RAD_FWS_FILT _CNV_R_R_Umr_1_zu_1_38_CM_S2 6 0 2500 DEPOSIT ABSOLUTE FORMAT "%2.0" /end AXIS_DESCR
 /begin AXIS_DESCR STD_AXIS W_DKKD_FFG _CNV_R_R_Umr_10_zu__9_CM_S2 3 0 110 DEPOSIT ABSOLUTE FORMAT "%2.0" /end AXIS_DESCR
 FORMAT "%2.0" /end CHARACTERISTIC
/begin CHARACTERISTIC XTAB6X3SCHN_GEMINAKT_RFWS_12_DBM "" MAP 0x1DB97C _REC_S7MAP_53_u2_s2_u2_S2 10000 _CNV_R_R_Umr_1_zu_1_38_CM_S2 0 10000
 /begin AXIS_DESCR STD_AXIS DM_RAD_FWS_FILT _CNV_R_R_Umr_1_zu_1_38_CM_S2 6 0 2500 DEPOSIT ABSOLUTE FORMAT "%2.0" /end AXIS_DESCR
 /begin AXIS_DESCR STD_AXIS W_DKKD_FFG _CNV_R_R_Umr_10_zu__9_CM_S2 3 0 110 DEPOSIT ABSOLUTE FORMAT "%2.0" /end AXIS_DESCR
 FORMAT "%2.0" /end CHARACTERISTIC
/begin CHARACTERISTIC XTAB6X3SCHN_GEMINAKT_RFWS_13_DBM "" MAP 0x1DB9B4 _REC_S7MAP_53_u2_s2_u2_S2 10000 _CNV_R_R_Umr_1_zu_1_38_CM_S2 0 10000
 /begin AXIS_DESCR STD_AXIS DM_RAD_FWS_FILT _CNV_R_R_Umr_1_zu_1_38_CM_S2 6 0 2500 DEPOSIT ABSOLUTE FORMAT "%2.0" /end AXIS_DESCR
 /begin AXIS_DESCR STD_AXIS W_DKKD_FFG _CNV_R_R_Umr_10_zu__9_CM_S2 3 0 110 DEPOSIT ABSOLUTE FORMAT "%2.0" /end AXIS_DESCR
 FORMAT "%2.0" /end CHARACTERISTIC
/begin CHARACTERISTIC XTAB6X3SCHN_GEMINAKT_RFWS_14_DBM "" MAP 0x1DB9EC _REC_S7MAP_53_u2_s2_u2_S2 10000 _CNV_R_R_Umr_1_zu_1_38_CM_S2 0 10000
 /begin AXIS_DESCR STD_AXIS DM_RAD_FWS_FILT _CNV_R_R_Umr_1_zu_1_38_CM_S2 6 0 2500 DEPOSIT ABSOLUTE FORMAT "%2.0" /end AXIS_DESCR
 /begin AXIS_DESCR STD_AXIS W_DKKD_FFG _CNV_R_R_Umr_10_zu__9_CM_S2 3 0 110 DEPOSIT ABSOLUTE FORMAT "%2.0" /end AXIS_DESCR
 FORMAT "%2.0" /end CHARACTERISTIC
/begin CHARACTERISTIC XTAB6X3SCHN_GEMINAKT_RFWS_15_DBM "" MAP 0x1DBA24 _REC_S7MAP_53_u2_s2_u2_S2 10000 _CNV_R_R_Umr_1_zu_1_38_CM_S2 0 10000
 /begin AXIS_DESCR STD_AXIS DM_RAD_FWS_FILT _CNV_R_R_Umr_1_zu_1_38_CM_S2 6 0 2500 DEPOSIT ABSOLUTE FORMAT "%2.0" /end AXIS_DESCR
 /begin AXIS_DESCR STD_AXIS W_DKKD_FFG _CNV_R_R_Umr_10_zu__9_CM_S2 3 0 110 DEPOSIT ABSOLUTE FORMAT "%2.0" /end AXIS_DESCR
 FORMAT "%2.0" /end CHARACTERISTIC
/begin CHARACTERISTIC XTAB6X3SCHN_GEMINAKT_RFWS_1_DBM "" MAP 0x1DBA5C _REC_S7MAP_53_u2_s2_u2_S2 10000 _CNV_R_R_Umr_1_zu_1_38_CM_S2 0 10000
 /begin AXIS_DESCR STD_AXIS DM_RAD_FWS_FILT _CNV_R_R_Umr_1_zu_1_38_CM_S2 6 0 2500 DEPOSIT ABSOLUTE FORMAT "%2.0" /end AXIS_DESCR
 /begin AXIS_DESCR STD_AXIS W_DKKD_FFG _CNV_R_R_Umr_10_zu__9_CM_S2 3 0 110 DEPOSIT ABSOLUTE FORMAT "%2.0" /end AXIS_DESCR
 FORMAT "%2.0" /end CHARACTERISTIC
/begin CHARACTERISTIC XTAB6X3SCHN_GEMINAKT_RFWS_2_DBM "" MAP 0x1DBA94 _REC_S7MAP_53_u2_s2_u2_S2 10000 _CNV_R_R_Umr_1_zu_1_38_CM_S2 0 10000
 /begin AXIS_DESCR STD_AXIS DM_RAD_FWS_FILT _CNV_R_R_Umr_1_zu_1_38_CM_S2 6 0 2500 DEPOSIT ABSOLUTE FORMAT "%2.0" /end AXIS_DESCR
 /begin AXIS_DESCR STD_AXIS W_DKKD_FFG _CNV_R_R_Umr_10_zu__9_CM_S2 3 0 110 DEPOSIT ABSOLUTE FORMAT "%2.0" /end AXIS_DESCR
 FORMAT "%2.0" /end CHARACTERISTIC
/begin CHARACTERISTIC XTAB6X3SCHN_GEMINAKT_RFWS_3_DBM "" MAP 0x1DBACC _REC_S7MAP_53_u2_s2_u2_S2 10000 _CNV_R_R_Umr_1_zu_1_38_CM_S2 0 10000
 /begin AXIS_DESCR STD_AXIS DM_RAD_FWS_FILT _CNV_R_R_Umr_1_zu_1_38_CM_S2 6 0 2500 DEPOSIT ABSOLUTE FORMAT "%2.0" /end AXIS_DESCR
 /begin AXIS_DESCR STD_AXIS W_DKKD_FFG _CNV_R_R_Umr_10_zu__9_CM_S2 3 0 110 DEPOSIT ABSOLUTE FORMAT "%2.0" /end AXIS_DESCR
 FORMAT "%2.0" /end CHARACTERISTIC
/begin CHARACTERISTIC XTAB6X3SCHN_GEMINAKT_RFWS_4_DBM "" MAP 0x1DBB04 _REC_S7MAP_53_u2_s2_u2_S2 10000 _CNV_R_R_Umr_1_zu_1_38_CM_S2 0 10000
 /begin AXIS_DESCR STD_AXIS DM_RAD_FWS_FILT _CNV_R_R_Umr_1_zu_1_38_CM_S2 6 0 2500 DEPOSIT ABSOLUTE FORMAT "%2.0" /end AXIS_DESCR
 /begin AXIS_DESCR STD_AXIS W_DKKD_FFG _CNV_R_R_Umr_10_zu__9_CM_S2 3 0 110 DEPOSIT ABSOLUTE FORMAT "%2.0" /end AXIS_DESCR
 FORMAT "%2.0" /end CHARACTERISTIC
/begin CHARACTERISTIC XTAB6X3SCHN_GEMINAKT_RFWS_5_DBM "" MAP 0x1DBB3C _REC_S7MAP_53_u2_s2_u2_S2 10000 _CNV_R_R_Umr_1_zu_1_38_CM_S2 0 10000
 /begin AXIS_DESCR STD_AXIS DM_RAD_FWS_FILT _CNV_R_R_Umr_1_zu_1_38_CM_S2 6 0 2500 DEPOSIT ABSOLUTE FORMAT "%2.0" /end AXIS_DESCR
 /begin AXIS_DESCR STD_AXIS W_DKKD_FFG _CNV_R_R_Umr_10_zu__9_CM_S2 3 0 110 DEPOSIT ABSOLUTE FORMAT "%2.0" /end AXIS_DESCR
 FORMAT "%2.0" /end CHARACTERISTIC
/begin CHARACTERISTIC XTAB6X3SCHN_GEMINAKT_RFWS_6_DBM "" MAP 0x1DBB74 _REC_S7MAP_53_u2_s2_u2_S2 10000 _CNV_R_R_Umr_1_zu_1_38_CM_S2 0 10000
 /begin AXIS_DESCR STD_AXIS DM_RAD_FWS_FILT _CNV_R_R_Umr_1_zu_1_38_CM_S2 6 0 2500 DEPOSIT ABSOLUTE FORMAT "%2.0" /end AXIS_DESCR
 /begin AXIS_DESCR STD_AXIS W_DKKD_FFG _CNV_R_R_Umr_10_zu__9_CM_S2 3 0 110 DEPOSIT ABSOLUTE FORMAT "%2.0" /end AXIS_DESCR
 FORMAT "%2.0" /end CHARACTERISTIC
/begin CHARACTERISTIC XTAB6X3SCHN_GEMINAKT_RFWS_7_DBM "" MAP 0x1DBBAC _REC_S7MAP_53_u2_s2_u2_S2 10000 _CNV_R_R_Umr_1_zu_1_38_CM_S2 0 10000
 /begin AXIS_DESCR STD_AXIS DM_RAD_FWS_FILT _CNV_R_R_Umr_1_zu_1_38_CM_S2 6 0 2500 DEPOSIT ABSOLUTE FORMAT "%2.0" /end AXIS_DESCR
 /begin AXIS_DESCR STD_AXIS W_DKKD_FFG _CNV_R_R_Umr_10_zu__9_CM_S2 3 0 110 DEPOSIT ABSOLUTE FORMAT "%2.0" /end AXIS_DESCR
 FORMAT "%2.0" /end CHARACTERISTIC
/begin CHARACTERISTIC XTAB6X3SCHN_GEMINAKT_RFWS_8_DBM "" MAP 0x1DBBE4 _REC_S7MAP_53_u2_s2_u2_S2 10000 _CNV_R_R_Umr_1_zu_1_38_CM_S2 0 10000
 /begin AXIS_DESCR STD_AXIS DM_RAD_FWS_FILT _CNV_R_R_Umr_1_zu_1_38_CM_S2 6 0 2500 DEPOSIT ABSOLUTE FORMAT "%2.0" /end AXIS_DESCR
 /begin AXIS_DESCR STD_AXIS W_DKKD_FFG _CNV_R_R_Umr_10_zu__9_CM_S2 3 0 110 DEPOSIT ABSOLUTE FORMAT "%2.0" /end AXIS_DESCR
 FORMAT "%2.0" /end CHARACTERISTIC
/begin CHARACTERISTIC XTAB6X3SCHN_GEMINAKT_RFWS_9_DBM "" MAP 0x1DBC1C _REC_S7MAP_53_u2_s2_u2_S2 10000 _CNV_R_R_Umr_1_zu_1_38_CM_S2 0 10000
 /begin AXIS_DESCR STD_AXIS DM_RAD_FWS_FILT _CNV_R_R_Umr_1_zu_1_38_CM_S2 6 0 2500 DEPOSIT ABSOLUTE FORMAT "%2.0" /end AXIS_DESCR
 /begin AXIS_DESCR STD_AXIS W_DKKD_FFG _CNV_R_R_Umr_10_zu__9_CM_S2 3 0 110 DEPOSIT ABSOLUTE FORMAT "%2.0" /end AXIS_DESCR
 FORMAT "%2.0" /end CHARACTERISTIC
/begin CHARACTERISTIC XTAB6X3SCHN_GEMINLO_RFWS_10_DBM "" MAP 0x1DBC54 _REC_S7MAP_53_u2_s2_u2_S2 10000 _CNV_R_R_Umr_1_zu_1_38_CM_S2 0 10000
 /begin AXIS_DESCR STD_AXIS DM_RAD_FWS_FILT _CNV_R_R_Umr_1_zu_1_38_CM_S2 6 0 2500 DEPOSIT ABSOLUTE FORMAT "%2.0" /end AXIS_DESCR
 /begin AXIS_DESCR STD_AXIS W_DKKD_FFG _CNV_R_R_Umr_10_zu__9_CM_S2 3 0 110 DEPOSIT ABSOLUTE FORMAT "%2.0" /end AXIS_DESCR
 FORMAT "%2.0" /end CHARACTERISTIC
/begin CHARACTERISTIC XTAB6X3SCHN_GEMINLO_RFWS_11_DBM "" MAP 0x1DBC8C _REC_S7MAP_53_u2_s2_u2_S2 10000 _CNV_R_R_Umr_1_zu_1_38_CM_S2 0 10000
 /begin AXIS_DESCR STD_AXIS DM_RAD_FWS_FILT _CNV_R_R_Umr_1_zu_1_38_CM_S2 6 0 2500 DEPOSIT ABSOLUTE FORMAT "%2.0" /end AXIS_DESCR
 /begin AXIS_DESCR STD_AXIS W_DKKD_FFG _CNV_R_R_Umr_10_zu__9_CM_S2 3 0 110 DEPOSIT ABSOLUTE FORMAT "%2.0" /end AXIS_DESCR
 FORMAT "%2.0" /end CHARACTERISTIC
/begin CHARACTERISTIC XTAB6X3SCHN_GEMINLO_RFWS_12_DBM "" MAP 0x1DBCC4 _REC_S7MAP_53_u2_s2_u2_S2 10000 _CNV_R_R_Umr_1_zu_1_38_CM_S2 0 10000
 /begin AXIS_DESCR STD_AXIS DM_RAD_FWS_FILT _CNV_R_R_Umr_1_zu_1_38_CM_S2 6 0 2500 DEPOSIT ABSOLUTE FORMAT "%2.0" /end AXIS_DESCR
 /begin AXIS_DESCR STD_AXIS W_DKKD_FFG _CNV_R_R_Umr_10_zu__9_CM_S2 3 0 110 DEPOSIT ABSOLUTE FORMAT "%2.0" /end AXIS_DESCR
 FORMAT "%2.0" /end CHARACTERISTIC
/begin CHARACTERISTIC XTAB6X3SCHN_GEMINLO_RFWS_13_DBM "" MAP 0x1DBCFC _REC_S7MAP_53_u2_s2_u2_S2 10000 _CNV_R_R_Umr_1_zu_1_38_CM_S2 0 10000
 /begin AXIS_DESCR STD_AXIS DM_RAD_FWS_FILT _CNV_R_R_Umr_1_zu_1_38_CM_S2 6 0 2500 DEPOSIT ABSOLUTE FORMAT "%2.0" /end AXIS_DESCR
 /begin AXIS_DESCR STD_AXIS W_DKKD_FFG _CNV_R_R_Umr_10_zu__9_CM_S2 3 0 110 DEPOSIT ABSOLUTE FORMAT "%2.0" /end AXIS_DESCR
 FORMAT "%2.0" /end CHARACTERISTIC
/begin CHARACTERISTIC XTAB6X3SCHN_GEMINLO_RFWS_14_DBM "" MAP 0x1DBD34 _REC_S7MAP_53_u2_s2_u2_S2 10000 _CNV_R_R_Umr_1_zu_1_38_CM_S2 0 10000
 /begin AXIS_DESCR STD_AXIS DM_RAD_FWS_FILT _CNV_R_R_Umr_1_zu_1_38_CM_S2 6 0 2500 DEPOSIT ABSOLUTE FORMAT "%2.0" /end AXIS_DESCR
 /begin AXIS_DESCR STD_AXIS W_DKKD_FFG _CNV_R_R_Umr_10_zu__9_CM_S2 3 0 110 DEPOSIT ABSOLUTE FORMAT "%2.0" /end AXIS_DESCR
 FORMAT "%2.0" /end CHARACTERISTIC
/begin CHARACTERISTIC XTAB6X3SCHN_GEMINLO_RFWS_15_DBM "" MAP 0x1DBD6C _REC_S7MAP_53_u2_s2_u2_S2 10000 _CNV_R_R_Umr_1_zu_1_38_CM_S2 0 10000
 /begin AXIS_DESCR STD_AXIS DM_RAD_FWS_FILT _CNV_R_R_Umr_1_zu_1_38_CM_S2 6 0 2500 DEPOSIT ABSOLUTE FORMAT "%2.0" /end AXIS_DESCR
 /begin AXIS_DESCR STD_AXIS W_DKKD_FFG _CNV_R_R_Umr_10_zu__9_CM_S2 3 0 110 DEPOSIT ABSOLUTE FORMAT "%2.0" /end AXIS_DESCR
 FORMAT "%2.0" /end CHARACTERISTIC
/begin CHARACTERISTIC XTAB6X3SCHN_GEMINLO_RFWS_1_DBM "" MAP 0x1DBDA4 _REC_S7MAP_53_u2_s2_u2_S2 10000 _CNV_R_R_Umr_1_zu_1_38_CM_S2 0 10000
 /begin AXIS_DESCR STD_AXIS DM_RAD_FWS_FILT _CNV_R_R_Umr_1_zu_1_38_CM_S2 6 0 2500 DEPOSIT ABSOLUTE FORMAT "%2.0" /end AXIS_DESCR
 /begin AXIS_DESCR STD_AXIS W_DKKD_FFG _CNV_R_R_Umr_10_zu__9_CM_S2 3 0 110 DEPOSIT ABSOLUTE FORMAT "%2.0" /end AXIS_DESCR
 FORMAT "%2.0" /end CHARACTERISTIC
/begin CHARACTERISTIC XTAB6X3SCHN_GEMINLO_RFWS_2_DBM "" MAP 0x1DBDDC _REC_S7MAP_53_u2_s2_u2_S2 10000 _CNV_R_R_Umr_1_zu_1_38_CM_S2 0 10000
 /begin AXIS_DESCR STD_AXIS DM_RAD_FWS_FILT _CNV_R_R_Umr_1_zu_1_38_CM_S2 6 0 2500 DEPOSIT ABSOLUTE FORMAT "%2.0" /end AXIS_DESCR
 /begin AXIS_DESCR STD_AXIS W_DKKD_FFG _CNV_R_R_Umr_10_zu__9_CM_S2 3 0 110 DEPOSIT ABSOLUTE FORMAT "%2.0" /end AXIS_DESCR
 FORMAT "%2.0" /end CHARACTERISTIC
/begin CHARACTERISTIC XTAB6X3SCHN_GEMINLO_RFWS_3_DBM "" MAP 0x1DBE14 _REC_S7MAP_53_u2_s2_u2_S2 10000 _CNV_R_R_Umr_1_zu_1_38_CM_S2 0 10000
 /begin AXIS_DESCR STD_AXIS DM_RAD_FWS_FILT _CNV_R_R_Umr_1_zu_1_38_CM_S2 6 0 2500 DEPOSIT ABSOLUTE FORMAT "%2.0" /end AXIS_DESCR
 /begin AXIS_DESCR STD_AXIS W_DKKD_FFG _CNV_R_R_Umr_10_zu__9_CM_S2 3 0 110 DEPOSIT ABSOLUTE FORMAT "%2.0" /end AXIS_DESCR
 FORMAT "%2.0" /end CHARACTERISTIC
/begin CHARACTERISTIC XTAB6X3SCHN_GEMINLO_RFWS_4_DBM "" MAP 0x1DBE4C _REC_S7MAP_53_u2_s2_u2_S2 10000 _CNV_R_R_Umr_1_zu_1_38_CM_S2 0 10000
 /begin AXIS_DESCR STD_AXIS DM_RAD_FWS_FILT _CNV_R_R_Umr_1_zu_1_38_CM_S2 6 0 2500 DEPOSIT ABSOLUTE FORMAT "%2.0" /end AXIS_DESCR
 /begin AXIS_DESCR STD_AXIS W_DKKD_FFG _CNV_R_R_Umr_10_zu__9_CM_S2 3 0 110 DEPOSIT ABSOLUTE FORMAT "%2.0" /end AXIS_DESCR
 FORMAT "%2.0" /end CHARACTERISTIC
/begin CHARACTERISTIC XTAB6X3SCHN_GEMINLO_RFWS_5_DBM "" MAP 0x1DBE84 _REC_S7MAP_53_u2_s2_u2_S2 10000 _CNV_R_R_Umr_1_zu_1_38_CM_S2 0 10000
 /begin AXIS_DESCR STD_AXIS DM_RAD_FWS_FILT _CNV_R_R_Umr_1_zu_1_38_CM_S2 6 0 2500 DEPOSIT ABSOLUTE FORMAT "%2.0" /end AXIS_DESCR
 /begin AXIS_DESCR STD_AXIS W_DKKD_FFG _CNV_R_R_Umr_10_zu__9_CM_S2 3 0 110 DEPOSIT ABSOLUTE FORMAT "%2.0" /end AXIS_DESCR
 FORMAT "%2.0" /end CHARACTERISTIC
/begin CHARACTERISTIC XTAB6X3SCHN_GEMINLO_RFWS_6_DBM "" MAP 0x1DBEBC _REC_S7MAP_53_u2_s2_u2_S2 10000 _CNV_R_R_Umr_1_zu_1_38_CM_S2 0 10000
 /begin AXIS_DESCR STD_AXIS DM_RAD_FWS_FILT _CNV_R_R_Umr_1_zu_1_38_CM_S2 6 0 2500 DEPOSIT ABSOLUTE FORMAT "%2.0" /end AXIS_DESCR
 /begin AXIS_DESCR STD_AXIS W_DKKD_FFG _CNV_R_R_Umr_10_zu__9_CM_S2 3 0 110 DEPOSIT ABSOLUTE FORMAT "%2.0" /end AXIS_DESCR
 FORMAT "%2.0" /end CHARACTERISTIC
/begin CHARACTERISTIC XTAB6X3SCHN_GEMINLO_RFWS_7_DBM "" MAP 0x1DBEF4 _REC_S7MAP_53_u2_s2_u2_S2 10000 _CNV_R_R_Umr_1_zu_1_38_CM_S2 0 10000
 /begin AXIS_DESCR STD_AXIS DM_RAD_FWS_FILT _CNV_R_R_Umr_1_zu_1_38_CM_S2 6 0 2500 DEPOSIT ABSOLUTE FORMAT "%2.0" /end AXIS_DESCR
 /begin AXIS_DESCR STD_AXIS W_DKKD_FFG _CNV_R_R_Umr_10_zu__9_CM_S2 3 0 110 DEPOSIT ABSOLUTE FORMAT "%2.0" /end AXIS_DESCR
 FORMAT "%2.0" /end CHARACTERISTIC
/begin CHARACTERISTIC XTAB6X3SCHN_GEMINLO_RFWS_8_DBM "" MAP 0x1DBF2C _REC_S7MAP_53_u2_s2_u2_S2 10000 _CNV_R_R_Umr_1_zu_1_38_CM_S2 0 10000
 /begin AXIS_DESCR STD_AXIS DM_RAD_FWS_FILT _CNV_R_R_Umr_1_zu_1_38_CM_S2 6 0 2500 DEPOSIT ABSOLUTE FORMAT "%2.0" /end AXIS_DESCR
 /begin AXIS_DESCR STD_AXIS W_DKKD_FFG _CNV_R_R_Umr_10_zu__9_CM_S2 3 0 110 DEPOSIT ABSOLUTE FORMAT "%2.0" /end AXIS_DESCR
 FORMAT "%2.0" /end CHARACTERISTIC
/begin CHARACTERISTIC XTAB6X3SCHN_GEMINLO_RFWS_9_DBM "" MAP 0x1DBF64 _REC_S7MAP_53_u2_s2_u2_S2 10000 _CNV_R_R_Umr_1_zu_1_38_CM_S2 0 10000
 /begin AXIS_DESCR STD_AXIS DM_RAD_FWS_FILT _CNV_R_R_Umr_1_zu_1_38_CM_S2 6 0 2500 DEPOSIT ABSOLUTE FORMAT "%2.0" /end AXIS_DESCR
 /begin AXIS_DESCR STD_AXIS W_DKKD_FFG _CNV_R_R_Umr_10_zu__9_CM_S2 3 0 110 DEPOSIT ABSOLUTE FORMAT "%2.0" /end AXIS_DESCR
 FORMAT "%2.0" /end CHARACTERISTIC
/begin CHARACTERISTIC XTAB6X3_ZHSKDRS_VERBOT_STEPS "" MAP 0x1DE482 _REC_A1MAP_9_u1_u1_u1_S2 1 _CNV_R_R_Umr_1_zu_1_2_CM_S2 0 1
 /begin AXIS_DESCR FIX_AXIS Z_DRIVELOGIC _CNV_S_6_Enum_EDL_11_CM_S2 6 1 6 READ_ONLY FIX_AXIS_PAR_DIST 1 1 6 /end AXIS_DESCR
 /begin AXIS_DESCR FIX_AXIS Z_DSC _CNV_S_3_Enum_EDSCS_50_CM_S2 3 0 2 READ_ONLY FIX_AXIS_PAR_DIST 0 1 3 /end AXIS_DESCR
 FORMAT "%2.0" /end CHARACTERISTIC
/begin CHARACTERISTIC XTAB6X3_ZHSKDRS_VERBOT_STEPS_CS "" MAP 0x1DE494 _REC_A1MAP_9_u1_u1_u1_S2 1 _CNV_R_R_Umr_1_zu_1_2_CM_S2 0 1
 /begin AXIS_DESCR FIX_AXIS Z_DRIVELOGIC _CNV_S_6_Enum_EDL_11_CM_S2 6 1 6 READ_ONLY FIX_AXIS_PAR_DIST 1 1 6 /end AXIS_DESCR
 /begin AXIS_DESCR FIX_AXIS Z_DSC _CNV_S_3_Enum_EDSCS_50_CM_S2 3 0 2 READ_ONLY FIX_AXIS_PAR_DIST 0 1 3 /end AXIS_DESCR
 FORMAT "%2.0" /end CHARACTERISTIC
/begin CHARACTERISTIC XTAB6X4Z_ANFGANG2_ERK "" MAP 0x1DC114 _REC_A1MAP_9_u1_u1_u1_S2 1 _CNV_R_R_Umr_1_zu_1_2_CM_S2 0 1
 /begin AXIS_DESCR FIX_AXIS Z_DRIVELOGIC _CNV_S_6_Enum_EDL_11_CM_S2 6 1 6 READ_ONLY FIX_AXIS_PAR_DIST 1 1 6 /end AXIS_DESCR
 /begin AXIS_DESCR FIX_AXIS Z_PROG_MODE _CNV_S_4_Enum_EPROG_26_CM_S2 4 0 3 READ_ONLY FIX_AXIS_PAR_DIST 0 1 4 /end AXIS_DESCR
 FORMAT "%2.0" /end CHARACTERISTIC
/begin CHARACTERISTIC XTAB6X4Z_HSZIEL_FLM_0 "" MAP 0x1DCA90 _REC_A1MAP_9_u1_u1_u1_S2 1 _CNV_R_R_Umr_1_zu_1_2_CM_S2 0 1
 /begin AXIS_DESCR FIX_AXIS Z_DRIVELOGIC _CNV_S_6_Enum_EDL_11_CM_S2 6 1 6 READ_ONLY FIX_AXIS_PAR_DIST 1 1 6 /end AXIS_DESCR
 /begin AXIS_DESCR FIX_AXIS Z_PROG_MODE _CNV_S_4_Enum_EPROG_26_CM_S2 4 0 3 READ_ONLY FIX_AXIS_PAR_DIST 0 1 4 /end AXIS_DESCR
 FORMAT "%2.0" /end CHARACTERISTIC
/begin CHARACTERISTIC XTAB6X4Z_HSZIEL_FLM_1 "" MAP 0x1DCAA8 _REC_A1MAP_9_u1_u1_u1_S2 1 _CNV_R_R_Umr_1_zu_1_2_CM_S2 0 1
 /begin AXIS_DESCR FIX_AXIS Z_DRIVELOGIC _CNV_S_6_Enum_EDL_11_CM_S2 6 1 6 READ_ONLY FIX_AXIS_PAR_DIST 1 1 6 /end AXIS_DESCR
 /begin AXIS_DESCR FIX_AXIS Z_PROG_MODE _CNV_S_4_Enum_EPROG_26_CM_S2 4 0 3 READ_ONLY FIX_AXIS_PAR_DIST 0 1 4 /end AXIS_DESCR
 FORMAT "%2.0" /end CHARACTERISTIC
/begin CHARACTERISTIC XTAB6X4Z_KF_FP_0 "" MAP 0x1DC000 _REC_A1MAP_9_u1_u1_u1_S2 2 _CNV_R_R_Umr_1_zu_1_2_CM_S2 0 2
 /begin AXIS_DESCR FIX_AXIS Z_DRIVELOGIC _CNV_S_6_Enum_EDL_11_CM_S2 6 1 6 READ_ONLY FIX_AXIS_PAR_DIST 1 1 6 /end AXIS_DESCR
 /begin AXIS_DESCR FIX_AXIS Z_PROG_MODE _CNV_S_4_Enum_EPROG_26_CM_S2 4 0 3 READ_ONLY FIX_AXIS_PAR_DIST 0 1 4 /end AXIS_DESCR
 FORMAT "%2.0" /end CHARACTERISTIC
/begin CHARACTERISTIC XTAB6X4Z_KF_FP_1 "" MAP 0x1DC018 _REC_A1MAP_9_u1_u1_u1_S2 2 _CNV_R_R_Umr_1_zu_1_2_CM_S2 0 2
 /begin AXIS_DESCR FIX_AXIS Z_DRIVELOGIC _CNV_S_6_Enum_EDL_11_CM_S2 6 1 6 READ_ONLY FIX_AXIS_PAR_DIST 1 1 6 /end AXIS_DESCR
 /begin AXIS_DESCR FIX_AXIS Z_PROG_MODE _CNV_S_4_Enum_EPROG_26_CM_S2 4 0 3 READ_ONLY FIX_AXIS_PAR_DIST 0 1 4 /end AXIS_DESCR
 FORMAT "%2.0" /end CHARACTERISTIC
/begin CHARACTERISTIC XTAB6X4_MBR_AAGS_BRS "" MAP 0x1E2502 _REC_S3MAP_54_s2_s2_u1_S2 65535 _CNV_R_R_Umr_1_zu_1_38_CM_S2 -32768 32767
 /begin AXIS_DESCR STD_AXIS DM_AB_FWS_FILT _CNV_R_R_Umr_1_zu_1_38_CM_S2 6 -32768 32767 DEPOSIT ABSOLUTE /end AXIS_DESCR
 /begin AXIS_DESCR FIX_AXIS Z_FT_MBR _CNV_S_5_Enum_EFT2_53_CM_S2 4 0 4 READ_ONLY FIX_AXIS_PAR_DIST 0 1 4 /end AXIS_DESCR
 FORMAT "%2.0" /end CHARACTERISTIC
/begin CHARACTERISTIC XTAB6X4_MBR_ECO_BRS "" MAP 0x1E2540 _REC_S3MAP_54_s2_s2_u1_S2 65535 _CNV_R_R_Umr_1_zu_1_38_CM_S2 -32768 32767
 /begin AXIS_DESCR STD_AXIS DM_AB_FWS_FILT _CNV_R_R_Umr_1_zu_1_38_CM_S2 6 -32768 32767 DEPOSIT ABSOLUTE /end AXIS_DESCR
 /begin AXIS_DESCR FIX_AXIS Z_FT_MBR _CNV_S_5_Enum_EFT2_53_CM_S2 4 0 4 READ_ONLY FIX_AXIS_PAR_DIST 0 1 4 /end AXIS_DESCR
 FORMAT "%2.0" /end CHARACTERISTIC
/begin CHARACTERISTIC XTAB6X4_MBR_EFAHREN_BRS "" MAP 0x1E257E _REC_S3MAP_54_s2_s2_u1_S2 65535 _CNV_R_R_Umr_1_zu_1_38_CM_S2 -32768 32767
 /begin AXIS_DESCR STD_AXIS DM_AB_FWS_FILT _CNV_R_R_Umr_1_zu_1_38_CM_S2 6 -32768 32767 DEPOSIT ABSOLUTE /end AXIS_DESCR
 /begin AXIS_DESCR FIX_AXIS Z_FT_MBR _CNV_S_5_Enum_EFT2_53_CM_S2 4 0 4 READ_ONLY FIX_AXIS_PAR_DIST 0 1 4 /end AXIS_DESCR
 FORMAT "%2.0" /end CHARACTERISTIC
/begin CHARACTERISTIC XTAB6X4_MBR_SAGS_BRS "" MAP 0x1E25BC _REC_S3MAP_54_s2_s2_u1_S2 65535 _CNV_R_R_Umr_1_zu_1_38_CM_S2 -32768 32767
 /begin AXIS_DESCR STD_AXIS DM_AB_FWS_FILT _CNV_R_R_Umr_1_zu_1_38_CM_S2 6 -32768 32767 DEPOSIT ABSOLUTE /end AXIS_DESCR
 /begin AXIS_DESCR FIX_AXIS Z_FT_MBR _CNV_S_5_Enum_EFT2_53_CM_S2 4 0 4 READ_ONLY FIX_AXIS_PAR_DIST 0 1 4 /end AXIS_DESCR
 FORMAT "%2.0" /end CHARACTERISTIC
/begin CHARACTERISTIC XTAB6X5M_MOT_POTZUG_ZKA "" MAP 0x1E241E _REC_S3MAP_54_u2_u2_u2_S2 200 _CNV_R_R_Umr_1_zu_1_30_CM_S2 0 200
 /begin AXIS_DESCR STD_AXIS N_MOT _CNV_R_R_Umr_1_zu_1_3_CM_S2 6 0 65535 DEPOSIT ABSOLUTE FORMAT "%2.0" /end AXIS_DESCR
 /begin AXIS_DESCR FIX_AXIS NO_INPUT_QUANTITY _CNV_S_5_Enum_EMOT__180_CM_S2 5 0 4 READ_ONLY /begin FIX_AXIS_PAR_LIST 0 1 2 3 4 /end FIX_AXIS_PAR_LIST /end AXIS_DESCR
 FORMAT "%2.0" /end CHARACTERISTIC
/begin CHARACTERISTIC XTAB6Z_K0_BAUTSCHUTZ_DBM "" CURVE 0x1DE252 _REC_A1CUR_30_u1_u1_S2 255 _CNV_R_R_Umr_1_zu_1_2_CM_S2 0 255
 /begin AXIS_DESCR FIX_AXIS Z_K0_IST _CNV_S_6_Enum_EK0_224_CM_S2 6 0 5 READ_ONLY FIX_AXIS_PAR_DIST 0 1 6 /end AXIS_DESCR
/end CHARACTERISTIC
/begin CHARACTERISTIC XTAB6Z_MODUSANZEIGE "" CURVE 0x1DE3C4 _REC_A1CUR_30_u1_u1_S2 3 _CNV_S_4_Enum_EKOMB_78_CM_S2 0 3
 /begin AXIS_DESCR FIX_AXIS Z_ANZGANGART _CNV_S_6_Enum_EANZG_150_CM_S2 6 0 5 READ_ONLY FIX_AXIS_PAR_DIST 0 1 6 /end AXIS_DESCR
/end CHARACTERISTIC
/begin CHARACTERISTIC XTAB7W_DKKD_FILT1 "" CURVE 0x1DDEC2 _REC_S7CUR_53_u2_u2_S2 120 _CNV_R_R_Umr_10_zu__9_CM_S2 0 120
 /begin AXIS_DESCR STD_AXIS W_DKKD_PS _CNV_R_R_Umr_10_zu__9_CM_S2 7 0 120 DEPOSIT ABSOLUTE FORMAT "%3.1" /end AXIS_DESCR
 FORMAT "%3.1" /end CHARACTERISTIC
/begin CHARACTERISTIC XTAB7X2FAKT_HSURE_FWS "" MAP 0x1DC7A4 _REC_S3MAP_54_u2_s2_u1_S2 200 _CNV_R_R_Umr_1_zu_1_30_CM_S2 0 200
 /begin AXIS_DESCR STD_AXIS DM_AB_FWSKOR_FILTFAST_BGH _CNV_R_R_Umr_1_zu_1_38_CM_S2 7 -32768 32767 DEPOSIT ABSOLUTE /end AXIS_DESCR
 /begin AXIS_DESCR FIX_AXIS Z_AGS_MODBEDEL _CNV_S_2_Enum_EAGS_18_CM_S2 2 0 1 READ_ONLY FIX_AXIS_PAR_DIST 0 1 2 /end AXIS_DESCR
 FORMAT "%2.0" /end CHARACTERISTIC
/begin CHARACTERISTIC XTAB7X3Z_DRIVEDYN_FDC "" MAP 0x1D953F _REC_A1MAP_9_u1_u1_u1_S2 1 _CNV_R_R_Umr_1_zu_1_2_CM_S2 0 1
 /begin AXIS_DESCR FIX_AXIS Z_DRIVEDYN_IDX _CNV_S_7_Enum_EDRIV_158_CM_S2 7 0 6 READ_ONLY FIX_AXIS_PAR_DIST 0 1 7 /end AXIS_DESCR
 /begin AXIS_DESCR FIX_AXIS Z_DSC _CNV_S_3_Enum_EDSCS_50_CM_S2 3 0 2 READ_ONLY FIX_AXIS_PAR_DIST 0 1 3 /end AXIS_DESCR
 FORMAT "%2.0" /end CHARACTERISTIC
/begin CHARACTERISTIC XTAB7X4W_DKKD_PLUFT "" MAP 0x1DAE38 _REC_S7MAP_53_u2_u2_u2_S2 110 _CNV_R_R_Umr_10_zu__9_CM_S2 0 110
 /begin AXIS_DESCR STD_AXIS W_DKKD_PS _CNV_R_R_Umr_10_zu__9_CM_S2 7 0 110 DEPOSIT ABSOLUTE FORMAT "%3.1" /end AXIS_DESCR
 /begin AXIS_DESCR STD_AXIS P_LUFT _CNV_R_R_Umr_1_zu_1_0_CM_S2 4 598 1108 DEPOSIT ABSOLUTE FORMAT "%2.0" /end AXIS_DESCR
 FORMAT "%3.1" /end CHARACTERISTIC
/begin CHARACTERISTIC XTAB7X5FAKTW_DKKD_PLUFT "" MAP 0x1DAE88 _REC_S7MAP_53_u2_u2_u2_S2 100 _CNV_R_R_Umr_1_zu_1_30_CM_S2 0 100
 /begin AXIS_DESCR STD_AXIS N_MOT _CNV_R_R_Umr_1_zu_1_3_CM_S2 7 0 8000 DEPOSIT ABSOLUTE FORMAT "%2.0" /end AXIS_DESCR
 /begin AXIS_DESCR STD_AXIS VM_MOT_ISTFW_FILT _CNV_R_R_Umr_100_zu_88_CM_S2 5 0 10 DEPOSIT ABSOLUTE FORMAT "%4.2" /end AXIS_DESCR
 FORMAT "%2.0" /end CHARACTERISTIC
/begin CHARACTERISTIC XTAB8FILTKOR_DYNHSPV "" CURVE 0x1DF4A2 _REC_S7CUR_53_u2_s2_S2 50000 _CNV_R_R_Umr_1_zu_1_30_CM_S2 0 50000
 /begin AXIS_DESCR STD_AXIS G2W_AB_DYNHSPV _CNV_R_R_Umr_10_zu__138_CM_S2 8 -3276.8 3276.7 DEPOSIT ABSOLUTE FORMAT "%3.1" /end AXIS_DESCR
 FORMAT "%2.0" /end CHARACTERISTIC
/begin CHARACTERISTIC XTAB8HM_VM_Z_K0 "" CURVE 0x1DE39E _REC_A1CUR_30_s2_u1_S2 100 _CNV_R_R_Umr_1_zu_1_38_CM_S2 0 100
 /begin AXIS_DESCR FIX_AXIS Z_GANG_ZIEL _CNV_S_9_Enum_EGANG_21_CM_S2 9 0 8 READ_ONLY FIX_AXIS_PAR_DIST 0 1 9 /end AXIS_DESCR
 FORMAT "%2.0" /end CHARACTERISTIC
/begin CHARACTERISTIC XTAB8HN_VM_Z_K0 "" CURVE 0x1DE3B0 _REC_A1CUR_30_s2_u1_S2 500 _CNV_R_R_Umr_1_zu_1_3_CM_S2 0 500
 /begin AXIS_DESCR FIX_AXIS Z_GANG_ZIEL _CNV_S_9_Enum_EGANG_21_CM_S2 9 0 8 READ_ONLY FIX_AXIS_PAR_DIST 0 1 9 /end AXIS_DESCR
 FORMAT "%2.0" /end CHARACTERISTIC
/begin CHARACTERISTIC XTAB8S_BEDEL_MODAFB "" CURVE 0x1DCA34 _REC_A1CUR_30_u1_u1_S2 1 _CNV_R_R_Umr_1_zu_1_2_CM_S2 0 1
 /begin AXIS_DESCR FIX_AXIS Z_POS _CNV_S_8_Enum_EPOS_24_CM_S2 8 0 7 READ_ONLY FIX_AXIS_PAR_DIST 0 1 8 /end AXIS_DESCR
 FORMAT "%2.0" /end CHARACTERISTIC
/begin CHARACTERISTIC XTAB8X32Z_SDYN_EXCFKTFFG "" MAP 0x1DD390 _REC_A1MAP_8_u1_u2_u2_S2 1 _CNV_R_R_Umr_1_zu_1_2_CM_S2 0 1
 /begin AXIS_DESCR FIX_AXIS NO_INPUT_QUANTITY _CNV_S_32_Enum_EEXCF_19_CM_S2 32 0 31 READ_ONLY FIX_AXIS_PAR_DIST 0 1 32 /end AXIS_DESCR
 /begin AXIS_DESCR FIX_AXIS NO_INPUT_QUANTITY _CNV_S_8_Enum_EEXCF_168_CM_S2 8 0 7 READ_ONLY FIX_AXIS_PAR_DIST 0 1 8 /end AXIS_DESCR
 FORMAT "%2.0" /end CHARACTERISTIC
/begin CHARACTERISTIC XTAB8X7Z_K0_SOLL_ASDAKT_GANG1 "" MAP 0x1DCB70 _REC_S7MAP_53_u1_s2_u2_S2 2 _CNV_S_2_Enum_EK0_S_251_CM_S2 3 5
 /begin AXIS_DESCR STD_AXIS M_MOT_STAT _CNV_R_R_Umr_1_zu_1_38_CM_S2 8 0 500 DEPOSIT ABSOLUTE FORMAT "%2.0" /end AXIS_DESCR
 /begin AXIS_DESCR STD_AXIS N_MOT _CNV_R_R_Umr_1_zu_1_3_CM_S2 7 0 8000 DEPOSIT ABSOLUTE FORMAT "%2.0" /end AXIS_DESCR
/end CHARACTERISTIC
/begin CHARACTERISTIC XTAB8X7Z_K0_SOLL_ASDAKT_GANG2 "" MAP 0x1DCBC8 _REC_S7MAP_53_u1_s2_u2_S2 2 _CNV_S_2_Enum_EK0_S_251_CM_S2 3 5
 /begin AXIS_DESCR STD_AXIS M_MOT_STAT _CNV_R_R_Umr_1_zu_1_38_CM_S2 8 0 500 DEPOSIT ABSOLUTE FORMAT "%2.0" /end AXIS_DESCR
 /begin AXIS_DESCR STD_AXIS N_MOT _CNV_R_R_Umr_1_zu_1_3_CM_S2 7 0 8000 DEPOSIT ABSOLUTE FORMAT "%2.0" /end AXIS_DESCR
/end CHARACTERISTIC
/begin CHARACTERISTIC XTAB8X7Z_K0_SOLL_ASDAKT_GANG3 "" MAP 0x1DCC20 _REC_S7MAP_53_u1_s2_u2_S2 2 _CNV_S_2_Enum_EK0_S_251_CM_S2 3 5
 /begin AXIS_DESCR STD_AXIS M_MOT_STAT _CNV_R_R_Umr_1_zu_1_38_CM_S2 8 0 500 DEPOSIT ABSOLUTE FORMAT "%2.0" /end AXIS_DESCR
 /begin AXIS_DESCR STD_AXIS N_MOT _CNV_R_R_Umr_1_zu_1_3_CM_S2 7 0 8000 DEPOSIT ABSOLUTE FORMAT "%2.0" /end AXIS_DESCR
/end CHARACTERISTIC
/begin CHARACTERISTIC XTAB8X7Z_K0_SOLL_ASDAKT_GANG4 "" MAP 0x1DCC78 _REC_S7MAP_53_u1_s2_u2_S2 2 _CNV_S_2_Enum_EK0_S_251_CM_S2 3 5
 /begin AXIS_DESCR STD_AXIS M_MOT_STAT _CNV_R_R_Umr_1_zu_1_38_CM_S2 8 0 500 DEPOSIT ABSOLUTE FORMAT "%2.0" /end AXIS_DESCR
 /begin AXIS_DESCR STD_AXIS N_MOT _CNV_R_R_Umr_1_zu_1_3_CM_S2 7 0 8000 DEPOSIT ABSOLUTE FORMAT "%2.0" /end AXIS_DESCR
/end CHARACTERISTIC
/begin CHARACTERISTIC XTAB8X7Z_K0_SOLL_ASDAKT_GANG5 "" MAP 0x1DCCD0 _REC_S7MAP_53_u1_s2_u2_S2 2 _CNV_S_2_Enum_EK0_S_251_CM_S2 3 5
 /begin AXIS_DESCR STD_AXIS M_MOT_STAT _CNV_R_R_Umr_1_zu_1_38_CM_S2 8 0 500 DEPOSIT ABSOLUTE FORMAT "%2.0" /end AXIS_DESCR
 /begin AXIS_DESCR STD_AXIS N_MOT _CNV_R_R_Umr_1_zu_1_3_CM_S2 7 0 8000 DEPOSIT ABSOLUTE FORMAT "%2.0" /end AXIS_DESCR
/end CHARACTERISTIC
/begin CHARACTERISTIC XTAB8X7Z_K0_SOLL_ASDAKT_GANG6 "" MAP 0x1DCD28 _REC_S7MAP_53_u1_s2_u2_S2 2 _CNV_S_2_Enum_EK0_S_251_CM_S2 3 5
 /begin AXIS_DESCR STD_AXIS M_MOT_STAT _CNV_R_R_Umr_1_zu_1_38_CM_S2 8 0 500 DEPOSIT ABSOLUTE FORMAT "%2.0" /end AXIS_DESCR
 /begin AXIS_DESCR STD_AXIS N_MOT _CNV_R_R_Umr_1_zu_1_3_CM_S2 7 0 8000 DEPOSIT ABSOLUTE FORMAT "%2.0" /end AXIS_DESCR
/end CHARACTERISTIC
/begin CHARACTERISTIC XTAB8X7Z_K0_SOLL_ASDAKT_GANG7 "" MAP 0x1DCF90 _REC_S7MAP_53_u1_s2_u2_S2 2 _CNV_S_2_Enum_EK0_S_251_CM_S2 3 5
 /begin AXIS_DESCR STD_AXIS M_MOT_STAT _CNV_R_R_Umr_1_zu_1_38_CM_S2 8 0 500 DEPOSIT ABSOLUTE FORMAT "%2.0" /end AXIS_DESCR
 /begin AXIS_DESCR STD_AXIS N_MOT _CNV_R_R_Umr_1_zu_1_3_CM_S2 7 0 8000 DEPOSIT ABSOLUTE FORMAT "%2.0" /end AXIS_DESCR
/end CHARACTERISTIC
/begin CHARACTERISTIC XTAB8X7Z_K0_SOLL_ASDAKT_GANG8 "" MAP 0x1DD040 _REC_S7MAP_53_u1_s2_u2_S2 2 _CNV_S_2_Enum_EK0_S_251_CM_S2 3 5
 /begin AXIS_DESCR STD_AXIS M_MOT_STAT _CNV_R_R_Umr_1_zu_1_38_CM_S2 8 0 500 DEPOSIT ABSOLUTE FORMAT "%2.0" /end AXIS_DESCR
 /begin AXIS_DESCR STD_AXIS N_MOT _CNV_R_R_Umr_1_zu_1_3_CM_S2 7 0 8000 DEPOSIT ABSOLUTE FORMAT "%2.0" /end AXIS_DESCR
/end CHARACTERISTIC
/begin CHARACTERISTIC XTAB8X7Z_K0_SOLL_ASDINA_GANG1 "" MAP 0x1DCD80 _REC_S7MAP_53_u1_s2_u2_S2 2 _CNV_S_2_Enum_EK0_S_251_CM_S2 3 5
 /begin AXIS_DESCR STD_AXIS M_MOT_STAT _CNV_R_R_Umr_1_zu_1_38_CM_S2 8 0 500 DEPOSIT ABSOLUTE FORMAT "%2.0" /end AXIS_DESCR
 /begin AXIS_DESCR STD_AXIS N_MOT _CNV_R_R_Umr_1_zu_1_3_CM_S2 7 0 8000 DEPOSIT ABSOLUTE FORMAT "%2.0" /end AXIS_DESCR
/end CHARACTERISTIC
/begin CHARACTERISTIC XTAB8X7Z_K0_SOLL_ASDINA_GANG2 "" MAP 0x1DCDD8 _REC_S7MAP_53_u1_s2_u2_S2 2 _CNV_S_2_Enum_EK0_S_251_CM_S2 3 5
 /begin AXIS_DESCR STD_AXIS M_MOT_STAT _CNV_R_R_Umr_1_zu_1_38_CM_S2 8 0 500 DEPOSIT ABSOLUTE FORMAT "%2.0" /end AXIS_DESCR
 /begin AXIS_DESCR STD_AXIS N_MOT _CNV_R_R_Umr_1_zu_1_3_CM_S2 7 0 8000 DEPOSIT ABSOLUTE FORMAT "%2.0" /end AXIS_DESCR
/end CHARACTERISTIC
/begin CHARACTERISTIC XTAB8X7Z_K0_SOLL_ASDINA_GANG3 "" MAP 0x1DCE30 _REC_S7MAP_53_u1_s2_u2_S2 2 _CNV_S_2_Enum_EK0_S_251_CM_S2 3 5
 /begin AXIS_DESCR STD_AXIS M_MOT_STAT _CNV_R_R_Umr_1_zu_1_38_CM_S2 8 0 500 DEPOSIT ABSOLUTE FORMAT "%2.0" /end AXIS_DESCR
 /begin AXIS_DESCR STD_AXIS N_MOT _CNV_R_R_Umr_1_zu_1_3_CM_S2 7 0 8000 DEPOSIT ABSOLUTE FORMAT "%2.0" /end AXIS_DESCR
/end CHARACTERISTIC
/begin CHARACTERISTIC XTAB8X7Z_K0_SOLL_ASDINA_GANG4 "" MAP 0x1DCE88 _REC_S7MAP_53_u1_s2_u2_S2 2 _CNV_S_2_Enum_EK0_S_251_CM_S2 3 5
 /begin AXIS_DESCR STD_AXIS M_MOT_STAT _CNV_R_R_Umr_1_zu_1_38_CM_S2 8 0 500 DEPOSIT ABSOLUTE FORMAT "%2.0" /end AXIS_DESCR
 /begin AXIS_DESCR STD_AXIS N_MOT _CNV_R_R_Umr_1_zu_1_3_CM_S2 7 0 8000 DEPOSIT ABSOLUTE FORMAT "%2.0" /end AXIS_DESCR
/end CHARACTERISTIC
/begin CHARACTERISTIC XTAB8X7Z_K0_SOLL_ASDINA_GANG5 "" MAP 0x1DCEE0 _REC_S7MAP_53_u1_s2_u2_S2 2 _CNV_S_2_Enum_EK0_S_251_CM_S2 3 5
 /begin AXIS_DESCR STD_AXIS M_MOT_STAT _CNV_R_R_Umr_1_zu_1_38_CM_S2 8 0 500 DEPOSIT ABSOLUTE FORMAT "%2.0" /end AXIS_DESCR
 /begin AXIS_DESCR STD_AXIS N_MOT _CNV_R_R_Umr_1_zu_1_3_CM_S2 7 0 8000 DEPOSIT ABSOLUTE FORMAT "%2.0" /end AXIS_DESCR
/end CHARACTERISTIC
/begin CHARACTERISTIC XTAB8X7Z_K0_SOLL_ASDINA_GANG6 "" MAP 0x1DCF38 _REC_S7MAP_53_u1_s2_u2_S2 2 _CNV_S_2_Enum_EK0_S_251_CM_S2 3 5
 /begin AXIS_DESCR STD_AXIS M_MOT_STAT _CNV_R_R_Umr_1_zu_1_38_CM_S2 8 0 500 DEPOSIT ABSOLUTE FORMAT "%2.0" /end AXIS_DESCR
 /begin AXIS_DESCR STD_AXIS N_MOT _CNV_R_R_Umr_1_zu_1_3_CM_S2 7 0 8000 DEPOSIT ABSOLUTE FORMAT "%2.0" /end AXIS_DESCR
/end CHARACTERISTIC
/begin CHARACTERISTIC XTAB8X7Z_K0_SOLL_ASDINA_GANG7 "" MAP 0x1DCFE8 _REC_S7MAP_53_u1_s2_u2_S2 2 _CNV_S_2_Enum_EK0_S_251_CM_S2 3 5
 /begin AXIS_DESCR STD_AXIS M_MOT_STAT _CNV_R_R_Umr_1_zu_1_38_CM_S2 8 0 500 DEPOSIT ABSOLUTE FORMAT "%2.0" /end AXIS_DESCR
 /begin AXIS_DESCR STD_AXIS N_MOT _CNV_R_R_Umr_1_zu_1_3_CM_S2 7 0 8000 DEPOSIT ABSOLUTE FORMAT "%2.0" /end AXIS_DESCR
/end CHARACTERISTIC
/begin CHARACTERISTIC XTAB8X7Z_K0_SOLL_ASDINA_GANG8 "" MAP 0x1DD098 _REC_S7MAP_53_u1_s2_u2_S2 2 _CNV_S_2_Enum_EK0_S_251_CM_S2 3 5
 /begin AXIS_DESCR STD_AXIS M_MOT_STAT _CNV_R_R_Umr_1_zu_1_38_CM_S2 8 0 500 DEPOSIT ABSOLUTE FORMAT "%2.0" /end AXIS_DESCR
 /begin AXIS_DESCR STD_AXIS N_MOT _CNV_R_R_Umr_1_zu_1_3_CM_S2 7 0 8000 DEPOSIT ABSOLUTE FORMAT "%2.0" /end AXIS_DESCR
/end CHARACTERISTIC
/begin CHARACTERISTIC XTAB8X8S_BEDELWECHSEL_AUSHSU "" MAP 0x1DC764 _REC_A1MAP_8_u1_u1_u1_S2 2 _CNV_S_3_Enum_EHSUA_109_CM_S2 0 2
 /begin AXIS_DESCR FIX_AXIS Z_HSUBED _CNV_S_8_Enum_EHSUB_104_CM_S2 8 0 7 READ_ONLY FIX_AXIS_PAR_DIST 0 1 8 /end AXIS_DESCR
 /begin AXIS_DESCR FIX_AXIS Z_HSUBED _CNV_S_8_Enum_EHSUB_104_CM_S2 8 0 7 READ_ONLY FIX_AXIS_PAR_DIST 0 1 8 /end AXIS_DESCR
/end CHARACTERISTIC
/begin CHARACTERISTIC XTAB9DV_FZG_STABKRI_ZKA "" CURVE 0x1E2468 _REC_A1CUR_30_u2_u1_S2 25 _CNV_R_R_Umr_10_zu__186_CM_S2 0 25
 /begin AXIS_DESCR FIX_AXIS Z_GANG_ZIEL _CNV_S_9_Enum_EGANG_21_CM_S2 9 0 8 READ_ONLY FIX_AXIS_PAR_DIST 0 1 9 /end AXIS_DESCR
 FORMAT "%3.1" /end CHARACTERISTIC
/begin CHARACTERISTIC XTAB9DZ_GANG_RSSEQ "" CURVE 0x1D9627 _REC_A1CUR_30_u1_u1_S2 8 _CNV_S_9_Enum_ESEQ__31_CM_S2 0 8
 /begin AXIS_DESCR FIX_AXIS Z_GANG_ZIEL _CNV_S_9_Enum_EGANG_21_CM_S2 9 0 8 READ_ONLY FIX_AXIS_PAR_DIST 0 1 9 /end AXIS_DESCR
/end CHARACTERISTIC
/begin CHARACTERISTIC XTAB9D_GANGMAX_NTMINMODEW_DBM "" CURVE 0x1DE258 _REC_A1CUR_30_s2_u1_S2 4 _CNV_R_R_Umr_1_zu_1_2_CM_S2 0 4
 /begin AXIS_DESCR FIX_AXIS Z_GANG_ZIEL_DBM _CNV_S_9_Enum_EGANG_21_CM_S2 9 0 8 READ_ONLY FIX_AXIS_PAR_DIST 0 1 9 /end AXIS_DESCR
 FORMAT "%2.0" /end CHARACTERISTIC
/begin CHARACTERISTIC XTAB9FAKT_AQ_HSUREKU "" CURVE 0x1DEFCA _REC_A1CUR_30_u2_u1_S2 10 _CNV_R_R_Umr_100_zu_42_CM_S2 0 10
 /begin AXIS_DESCR FIX_AXIS Z_GANG_ZIEL_HSURE _CNV_S_9_Enum_EGANG_21_CM_S2 9 0 8 READ_ONLY FIX_AXIS_PAR_DIST 0 1 9 /end AXIS_DESCR
 FORMAT "%4.2" /end CHARACTERISTIC
/begin CHARACTERISTIC XTAB9FAKT_MRAD_HDC "" CURVE 0x1D9590 _REC_A1CUR_30_u1_u1_S2 100 _CNV_R_R_Umr_1_zu_1_30_CM_S2 0 100
 /begin AXIS_DESCR FIX_AXIS Z_GANG_ZIEL _CNV_S_9_Enum_EGANG_21_CM_S2 9 0 8 READ_ONLY FIX_AXIS_PAR_DIST 0 1 9 /end AXIS_DESCR
 FORMAT "%2.0" /end CHARACTERISTIC
/begin CHARACTERISTIC XTAB9FAKT_M_MOTDYNHKOR_ZKA "" CURVE 0x1E247A _REC_A1CUR_30_u2_u2_S2 2 _CNV_R_R_Umr_100_zu_42_CM_S2 0 2
 /begin AXIS_DESCR FIX_AXIS NO_INPUT_QUANTITY _CNV_S_9_Enum_EGANG_21_CM_S2 9 0 8 READ_ONLY FIX_AXIS_PAR_DIST 0 1 9 /end AXIS_DESCR
 FORMAT "%4.2" /end CHARACTERISTIC
/begin CHARACTERISTIC XTAB9FAKT_T_AUSROLLRS_DBM "" CURVE 0x1DE26A _REC_A1CUR_30_s2_u2_S2 500 _CNV_R_R_Umr_1_zu_1_30_CM_S2 0 500
 /begin AXIS_DESCR FIX_AXIS NO_INPUT_QUANTITY _CNV_S_9_Enum_EGANG_21_CM_S2 9 0 8 READ_ONLY /begin FIX_AXIS_PAR_LIST 0 1 2 3 4 5 6 7 8 /end FIX_AXIS_PAR_LIST /end AXIS_DESCR
 FORMAT "%2.0" /end CHARACTERISTIC
/begin CHARACTERISTIC XTAB9HSCHN_GEMAXHI_RFWS_DBM "" CURVE 0x1DE27C _REC_A1CUR_30_u2_u2_S2 10000 _CNV_R_R_Umr_1_zu_1_38_CM_S2 0 10000
 /begin AXIS_DESCR FIX_AXIS NO_INPUT_QUANTITY _CNV_S_9_Enum_EGANG_21_CM_S2 9 0 8 READ_ONLY /begin FIX_AXIS_PAR_LIST 0 1 2 3 4 5 6 7 8 /end FIX_AXIS_PAR_LIST /end AXIS_DESCR
 FORMAT "%2.0" /end CHARACTERISTIC
/begin CHARACTERISTIC XTAB9HSCHN_T_CMOPLUFT_DBM "" CURVE 0x1DE28E _REC_A1CUR_30_s2_u2_S2 32000 _CNV_R_R_Umr_1_zu_1_3_CM_S2 0 32000
 /begin AXIS_DESCR FIX_AXIS NO_INPUT_QUANTITY _CNV_S_9_Enum_EGANG_21_CM_S2 9 0 8 READ_ONLY /begin FIX_AXIS_PAR_LIST 0 1 2 3 4 5 6 7 8 /end FIX_AXIS_PAR_LIST /end AXIS_DESCR
 FORMAT "%2.0" /end CHARACTERISTIC
/begin CHARACTERISTIC XTAB9H_NAB_STABI_DBM "" CURVE 0x1DE2A0 _REC_A1CUR_30_s2_u2_S2 500 _CNV_R_R_Umr_1_zu_1_3_CM_S2 0 500
 /begin AXIS_DESCR FIX_AXIS NO_INPUT_QUANTITY _CNV_S_9_Enum_EGANG_21_CM_S2 9 0 8 READ_ONLY /begin FIX_AXIS_PAR_LIST 0 1 2 3 4 5 6 7 8 /end FIX_AXIS_PAR_LIST /end AXIS_DESCR
 FORMAT "%2.0" /end CHARACTERISTIC
/begin CHARACTERISTIC XTAB9J_KORFAKT "" CURVE 0x1E2796 _REC_A1CUR_30_s2_u1_S2 4999 _CNV_R_R_Umr_1_zu_1_2_CM_S2 1 5000
 /begin AXIS_DESCR FIX_AXIS Z_GANG_ZIEL _CNV_S_9_Enum_EGANG_21_CM_S2 9 0 8 READ_ONLY FIX_AXIS_PAR_DIST 0 1 9 /end AXIS_DESCR
 FORMAT "%2.0" /end CHARACTERISTIC
/begin CHARACTERISTIC XTAB9N_AB_MAXRSTEMP "" CURVE 0x1DE664 _REC_A1CUR_30_u2_u1_S2 20000 _CNV_R_R_Umr_1_zu_1_3_CM_S2 0 20000
 /begin AXIS_DESCR FIX_AXIS Z_GANG_ZIEL _CNV_S_9_Enum_EGANG_21_CM_S2 9 0 8 READ_ONLY FIX_AXIS_PAR_DIST 0 1 9 /end AXIS_DESCR
 FORMAT "%2.0" /end CHARACTERISTIC
/begin CHARACTERISTIC XTAB9N_AB_MUELOW_HSURESCHLUPF "" CURVE 0x1DF156 _REC_A1CUR_30_u2_u1_S2 20000 _CNV_R_R_Umr_1_zu_1_3_CM_S2 0 20000
 /begin AXIS_DESCR FIX_AXIS Z_GANG_ZIEL_HSURE _CNV_S_9_Enum_EGANG_21_CM_S2 9 0 8 READ_ONLY FIX_AXIS_PAR_DIST 0 1 9 /end AXIS_DESCR
 FORMAT "%2.0" /end CHARACTERISTIC
/begin CHARACTERISTIC XTAB9N_MAX_RENNSTART "" CURVE 0x1DE4BA _REC_A1CUR_30_u2_u1_S2 20000 _CNV_R_R_Umr_1_zu_1_3_CM_S2 0 20000
 /begin AXIS_DESCR FIX_AXIS Z_GANG_IST _CNV_S_9_Enum_EGANG_21_CM_S2 9 0 8 READ_ONLY FIX_AXIS_PAR_DIST 0 1 9 /end AXIS_DESCR
 FORMAT "%2.0" /end CHARACTERISTIC
/begin CHARACTERISTIC XTAB9N_MOT_DYNHSPV "" CURVE 0x1DF606 _REC_A1CUR_30_u2_u1_S2 20000 _CNV_R_R_Umr_1_zu_1_3_CM_S2 0 20000
 /begin AXIS_DESCR FIX_AXIS Z_GANG_ZIEL _CNV_S_9_Enum_EGANG_21_CM_S2 9 0 8 READ_ONLY FIX_AXIS_PAR_DIST 0 1 9 /end AXIS_DESCR
 FORMAT "%2.0" /end CHARACTERISTIC
/begin CHARACTERISTIC XTAB9OM_RADOPTS_HIGHGANG_ZKA "" CURVE 0x1D9757 _REC_A1CUR_30_u1_u1_S2 200 _CNV_R_R_Umr_1_zu_1_30_CM_S2 0 200
 /begin AXIS_DESCR FIX_AXIS Z_GANG_ZIEL _CNV_S_9_Enum_EGANG_21_CM_S2 9 0 8 READ_ONLY FIX_AXIS_PAR_DIST 0 1 9 /end AXIS_DESCR
 FORMAT "%2.0" /end CHARACTERISTIC
/begin CHARACTERISTIC XTAB9OM_RADOPTZ_HIGHGANG_ZKA "" CURVE 0x1D9760 _REC_A1CUR_30_u1_u1_S2 200 _CNV_R_R_Umr_1_zu_1_30_CM_S2 0 200
 /begin AXIS_DESCR FIX_AXIS Z_GANG_ZIEL _CNV_S_9_Enum_EGANG_21_CM_S2 9 0 8 READ_ONLY FIX_AXIS_PAR_DIST 0 1 9 /end AXIS_DESCR
 FORMAT "%2.0" /end CHARACTERISTIC
/begin CHARACTERISTIC XTAB9ON_AB_HSVERZ_DBM "" CURVE 0x1DE2B2 _REC_A1CUR_30_s2_u1_S2 500 _CNV_R_R_Umr_1_zu_1_3_CM_S2 0 500
 /begin AXIS_DESCR FIX_AXIS Z_GANG_ZIEL _CNV_S_9_Enum_EGANG_21_CM_S2 9 0 8 READ_ONLY FIX_AXIS_PAR_DIST 0 1 9 /end AXIS_DESCR
 FORMAT "%2.0" /end CHARACTERISTIC
/begin CHARACTERISTIC XTAB9ON_AB_HSWK "" CURVE 0x1DE676 _REC_A1CUR_30_u2_u1_S2 1023 _CNV_R_R_Umr_1_zu_1_3_CM_S2 0 1023
 /begin AXIS_DESCR FIX_AXIS Z_GANG_ZIEL_SKL _CNV_S_9_Enum_EGANG_21_CM_S2 9 0 8 READ_ONLY FIX_AXIS_PAR_DIST 0 1 9 /end AXIS_DESCR
 FORMAT "%2.0" /end CHARACTERISTIC
/begin CHARACTERISTIC XTAB9ON_AB_HS_LWVA_DERS "" CURVE 0x1E26EA _REC_A1CUR_30_u2_u1_S2 20000 _CNV_R_R_Umr_1_zu_1_3_CM_S2 0 20000
 /begin AXIS_DESCR FIX_AXIS Z_GANG_ZIEL _CNV_S_9_Enum_EGANG_21_CM_S2 9 0 8 READ_ONLY FIX_AXIS_PAR_DIST 0 1 9 /end AXIS_DESCR
 FORMAT "%2.0" /end CHARACTERISTIC
/begin CHARACTERISTIC XTAB9ON_AB_HS_NIC_DERS "" CURVE 0x1E26B0 _REC_A1CUR_30_u2_u1_S2 2000 _CNV_R_R_Umr_1_zu_1_3_CM_S2 0 2000
 /begin AXIS_DESCR FIX_AXIS Z_GANG_ZIEL _CNV_S_9_Enum_EGANG_21_CM_S2 9 0 8 READ_ONLY FIX_AXIS_PAR_DIST 0 1 9 /end AXIS_DESCR
 FORMAT "%2.0" /end CHARACTERISTIC
/begin CHARACTERISTIC XTAB9ON_MAXHI_DBM "" CURVE 0x1DE2C4 _REC_A1CUR_30_s2_u2_S2 32000 _CNV_R_R_Umr_1_zu_1_3_CM_S2 -32000 0
 /begin AXIS_DESCR FIX_AXIS NO_INPUT_QUANTITY _CNV_S_9_Enum_EGANG_21_CM_S2 9 0 8 READ_ONLY /begin FIX_AXIS_PAR_LIST 0 1 2 3 4 5 6 7 8 /end FIX_AXIS_PAR_LIST /end AXIS_DESCR
 FORMAT "%2.0" /end CHARACTERISTIC
/begin CHARACTERISTIC XTAB9ON_TIPPHS_NOT_STEPS "" CURVE 0x1DE4CC _REC_A1CUR_30_s2_u1_S2 4000 _CNV_R_R_Umr_1_zu_1_3_CM_S2 -2000 2000
 /begin AXIS_DESCR FIX_AXIS Z_GANG_TIPP_SPORT _CNV_S_9_Enum_EGANG_21_CM_S2 9 0 8 READ_ONLY FIX_AXIS_PAR_DIST 0 1 9 /end AXIS_DESCR
 FORMAT "%2.0" /end CHARACTERISTIC
/begin CHARACTERISTIC XTAB9ON_TIPPHS_NOT_STEPSDUE "" CURVE 0x1DE4DE _REC_A1CUR_30_s2_u1_S2 8000 _CNV_R_R_Umr_1_zu_1_3_CM_S2 -2000 6000
 /begin AXIS_DESCR FIX_AXIS Z_GANG_TIPP_SPORT _CNV_S_9_Enum_EGANG_21_CM_S2 9 0 8 READ_ONLY FIX_AXIS_PAR_DIST 0 1 9 /end AXIS_DESCR
 FORMAT "%2.0" /end CHARACTERISTIC
/begin CHARACTERISTIC XTAB9SCHDM_AB_FWSDUE "" CURVE 0x1E26FE _REC_A1CUR_30_s2_u1_S2 65535 _CNV_R_R_Umr_1_zu_1_38_CM_S2 -32768 32767
 /begin AXIS_DESCR FIX_AXIS Z_GANG_IST _CNV_S_9_Enum_EGANG_21_CM_S2 9 0 8 READ_ONLY FIX_AXIS_PAR_DIST 0 1 9 /end AXIS_DESCR
 FORMAT "%2.0" /end CHARACTERISTIC
/begin CHARACTERISTIC XTAB9SCHG2W_FILT_VALIDFWS "" CURVE 0x1DEB1E _REC_A1CUR_30_s2_u1_S2 2000 _CNV_R_R_Umr_10_zu__138_CM_S2 0 2000
 /begin AXIS_DESCR FIX_AXIS Z_GANG_ZIEL _CNV_S_9_Enum_EGANG_21_CM_S2 9 0 8 READ_ONLY FIX_AXIS_PAR_DIST 0 1 9 /end AXIS_DESCR
 FORMAT "%3.1" /end CHARACTERISTIC
/begin CHARACTERISTIC XTAB9SCHN_AB_NIC_DERS "" CURVE 0x1E26C2 _REC_A1CUR_30_u2_u1_S2 20000 _CNV_R_R_Umr_1_zu_1_3_CM_S2 0 20000
 /begin AXIS_DESCR FIX_AXIS Z_GANG_ZIEL_SKL _CNV_S_9_Enum_EGANG_21_CM_S2 9 0 8 READ_ONLY FIX_AXIS_PAR_DIST 0 1 9 /end AXIS_DESCR
 FORMAT "%2.0" /end CHARACTERISTIC
/begin CHARACTERISTIC XTAB9SCHN_AB_REG_HSURESCHLUPF "" CURVE 0x1DEDA8 _REC_A1CUR_30_u2_u1_S2 10000 _CNV_R_R_Umr_1_zu_1_3_CM_S2 0 10000
 /begin AXIS_DESCR FIX_AXIS Z_GANG_IST _CNV_S_9_Enum_EGANG_21_CM_S2 9 0 8 READ_ONLY FIX_AXIS_PAR_DIST 0 1 9 /end AXIS_DESCR
 FORMAT "%2.0" /end CHARACTERISTIC
/begin CHARACTERISTIC XTAB9SCHN_MAXAKT_HOTMODE_DBM "" CURVE 0x1DE2D6 _REC_A1CUR_30_s2_u2_S2 32000 _CNV_R_R_Umr_1_zu_1_3_CM_S2 0 32000
 /begin AXIS_DESCR FIX_AXIS NO_INPUT_QUANTITY _CNV_S_9_Enum_EGANG_21_CM_S2 9 0 8 READ_ONLY /begin FIX_AXIS_PAR_LIST 0 1 2 3 4 5 6 7 8 /end FIX_AXIS_PAR_LIST /end AXIS_DESCR
 FORMAT "%2.0" /end CHARACTERISTIC
/begin CHARACTERISTIC XTAB9SCHN_MAXAKT_TMS_DBM "" CURVE 0x1DE2E8 _REC_A1CUR_30_s2_u2_S2 32000 _CNV_R_R_Umr_1_zu_1_3_CM_S2 0 32000
 /begin AXIS_DESCR FIX_AXIS NO_INPUT_QUANTITY _CNV_S_9_Enum_EGANG_21_CM_S2 9 0 8 READ_ONLY /begin FIX_AXIS_PAR_LIST 0 1 2 3 4 5 6 7 8 /end FIX_AXIS_PAR_LIST /end AXIS_DESCR
 FORMAT "%2.0" /end CHARACTERISTIC
/begin CHARACTERISTIC XTAB9SCHN_MAXHI_HOTMODE_DBM "" CURVE 0x1DE2FA _REC_A1CUR_30_s2_u2_S2 32000 _CNV_R_R_Umr_1_zu_1_3_CM_S2 0 32000
 /begin AXIS_DESCR FIX_AXIS NO_INPUT_QUANTITY _CNV_S_9_Enum_EGANG_21_CM_S2 9 0 8 READ_ONLY /begin FIX_AXIS_PAR_LIST 0 1 2 3 4 5 6 7 8 /end FIX_AXIS_PAR_LIST /end AXIS_DESCR
 FORMAT "%2.0" /end CHARACTERISTIC
/begin CHARACTERISTIC XTAB9SCHN_MAXHI_TMS_DBM "" CURVE 0x1DE30C _REC_A1CUR_30_s2_u2_S2 32000 _CNV_R_R_Umr_1_zu_1_3_CM_S2 0 32000
 /begin AXIS_DESCR FIX_AXIS NO_INPUT_QUANTITY _CNV_S_9_Enum_EGANG_21_CM_S2 9 0 8 READ_ONLY /begin FIX_AXIS_PAR_LIST 0 1 2 3 4 5 6 7 8 /end FIX_AXIS_PAR_LIST /end AXIS_DESCR
 FORMAT "%2.0" /end CHARACTERISTIC
/begin CHARACTERISTIC XTAB9SCHN_MINAKT_DPFREG_DBM "" CURVE 0x1DE31E _REC_A1CUR_30_s2_u2_S2 32000 _CNV_R_R_Umr_1_zu_1_3_CM_S2 0 32000
 /begin AXIS_DESCR FIX_AXIS NO_INPUT_QUANTITY _CNV_S_9_Enum_EGANG_21_CM_S2 9 0 8 READ_ONLY /begin FIX_AXIS_PAR_LIST 0 1 2 3 4 5 6 7 8 /end FIX_AXIS_PAR_LIST /end AXIS_DESCR
 FORMAT "%2.0" /end CHARACTERISTIC
/begin CHARACTERISTIC XTAB9SCHN_MINAKT_HOTMODE_DBM "" CURVE 0x1DE330 _REC_A1CUR_30_s2_u2_S2 32000 _CNV_R_R_Umr_1_zu_1_3_CM_S2 0 32000
 /begin AXIS_DESCR FIX_AXIS NO_INPUT_QUANTITY _CNV_S_9_Enum_EGANG_21_CM_S2 9 0 8 READ_ONLY /begin FIX_AXIS_PAR_LIST 0 1 2 3 4 5 6 7 8 /end FIX_AXIS_PAR_LIST /end AXIS_DESCR
 FORMAT "%2.0" /end CHARACTERISTIC
/begin CHARACTERISTIC XTAB9SCHN_MINLO_DPFREG_DBM "" CURVE 0x1DE342 _REC_A1CUR_30_s2_u2_S2 32000 _CNV_R_R_Umr_1_zu_1_3_CM_S2 0 32000
 /begin AXIS_DESCR FIX_AXIS NO_INPUT_QUANTITY _CNV_S_9_Enum_EGANG_21_CM_S2 9 0 8 READ_ONLY /begin FIX_AXIS_PAR_LIST 0 1 2 3 4 5 6 7 8 /end FIX_AXIS_PAR_LIST /end AXIS_DESCR
 FORMAT "%2.0" /end CHARACTERISTIC
/begin CHARACTERISTIC XTAB9SCHN_MINLO_HOTMODE_DBM "" CURVE 0x1DE354 _REC_A1CUR_30_s2_u2_S2 32000 _CNV_R_R_Umr_1_zu_1_3_CM_S2 0 32000
 /begin AXIS_DESCR FIX_AXIS NO_INPUT_QUANTITY _CNV_S_9_Enum_EGANG_21_CM_S2 9 0 8 READ_ONLY /begin FIX_AXIS_PAR_LIST 0 1 2 3 4 5 6 7 8 /end FIX_AXIS_PAR_LIST /end AXIS_DESCR
 FORMAT "%2.0" /end CHARACTERISTIC
/begin CHARACTERISTIC XTAB9SCHN_MOT_HSZIEL_FLM "" CURVE 0x1DFA20 _REC_A1CUR_30_u2_u1_S2 20000 _CNV_R_R_Umr_1_zu_1_3_CM_S2 0 20000
 /begin AXIS_DESCR FIX_AXIS Z_GANG_ZIEL _CNV_S_9_Enum_EGANG_21_CM_S2 9 0 8 READ_ONLY FIX_AXIS_PAR_DIST 0 1 9 /end AXIS_DESCR
 FORMAT "%2.0" /end CHARACTERISTIC
/begin CHARACTERISTIC XTAB9SCHW_DKKD_AUSHSU "" CURVE 0x1DEDBA _REC_A1CUR_30_u2_u1_S2 110 _CNV_R_R_Umr_10_zu__9_CM_S2 0 110
 /begin AXIS_DESCR FIX_AXIS Z_GANG_ZIEL_HSURE _CNV_S_9_Enum_EGANG_21_CM_S2 9 0 8 READ_ONLY FIX_AXIS_PAR_DIST 0 1 9 /end AXIS_DESCR
 FORMAT "%3.1" /end CHARACTERISTIC
/begin CHARACTERISTIC XTAB9SCHW_DKKD_NTMIN_DDRS "" CURVE 0x1E2688 _REC_A1CUR_30_u2_u1_S2 110 _CNV_R_R_Umr_10_zu__9_CM_S2 0 110
 /begin AXIS_DESCR FIX_AXIS Z_GANG_ZIEL_SKL _CNV_S_9_Enum_EGANG_21_CM_S2 9 0 8 READ_ONLY FIX_AXIS_PAR_DIST 0 1 9 /end AXIS_DESCR
 FORMAT "%3.1" /end CHARACTERISTIC
/begin CHARACTERISTIC XTAB9SCHW_DKKD_TID_AUSMAX "" CURVE 0x1E3548 _REC_S7CUR_53_u2_u2_S2 110 _CNV_R_R_Umr_10_zu__9_CM_S2 0 110
 /begin AXIS_DESCR STD_AXIS N_AB _CNV_R_R_Umr_1_zu_1_3_CM_S2 10 0 20000 DEPOSIT ABSOLUTE /end AXIS_DESCR
 FORMAT "%3.1" /end CHARACTERISTIC
/begin CHARACTERISTIC XTAB9S_BPL_MODE "" CURVE 0x1D97BD _REC_A1CUR_30_u1_u1_S2 1 _CNV_R_R_Umr_1_zu_1_2_CM_S2 0 1
 /begin AXIS_DESCR FIX_AXIS Z_GANG_IST _CNV_S_9_Enum_EGANG_21_CM_S2 9 0 8 READ_ONLY FIX_AXIS_PAR_DIST 0 1 9 /end AXIS_DESCR
 FORMAT "%2.0" /end CHARACTERISTIC
/begin CHARACTERISTIC XTAB9S_EIN_ERKBERGANH "" CURVE 0x1DE7F6 _REC_A1CUR_30_u2_u1_S2 1 _CNV_R_R_Umr_1_zu_1_2_CM_S2 0 1
 /begin AXIS_DESCR FIX_AXIS Z_GANG_IST _CNV_S_9_Enum_EGANG_21_CM_S2 9 0 8 READ_ONLY FIX_AXIS_PAR_DIST 0 1 9 /end AXIS_DESCR
 FORMAT "%2.0" /end CHARACTERISTIC
/begin CHARACTERISTIC XTAB9S_HYBRID_HAS_IST_ERK "" CURVE 0x1D95D4 _REC_A1CUR_30_u1_u1_S2 1 _CNV_R_R_Umr_1_zu_1_2_CM_S2 0 1
 /begin AXIS_DESCR FIX_AXIS Z_HAS_IST _CNV_S_10_Enum_EHASS_119_CM_S2 9 0 15 READ_ONLY FIX_AXIS_PAR_DIST 0 1 9 /end AXIS_DESCR
 FORMAT "%2.0" /end CHARACTERISTIC
/begin CHARACTERISTIC XTAB9S_HYBRID_HAS_ZIEL_ERK "" CURVE 0x1D95DD _REC_A1CUR_30_u1_u1_S2 1 _CNV_R_R_Umr_1_zu_1_2_CM_S2 0 1
 /begin AXIS_DESCR FIX_AXIS Z_HAS_ZIEL _CNV_S_10_Enum_EHASS_119_CM_S2 9 0 15 READ_ONLY FIX_AXIS_PAR_DIST 0 1 9 /end AXIS_DESCR
 FORMAT "%2.0" /end CHARACTERISTIC
/begin CHARACTERISTIC XTAB9S_NAB_ARSSTDENBL_DBM "" CURVE 0x1DE366 _REC_A1CUR_30_s2_s2_S2 1 _CNV_R_R_Umr_1_zu_1_2_CM_S2 0 1
 /begin AXIS_DESCR FIX_AXIS NO_INPUT_QUANTITY _CNV_S_9_Enum_EARSS_252_CM_S2 9 0 8 READ_ONLY /begin FIX_AXIS_PAR_LIST 0 1 2 3 4 5 6 7 8 /end FIX_AXIS_PAR_LIST /end AXIS_DESCR
 FORMAT "%2.0" /end CHARACTERISTIC
/begin CHARACTERISTIC XTAB9X10SCHGW_FP_DMRSDOWN "" MAP 0x1DC368 _REC_A1MAP_9_s2_u1_u1_S2 65535 _CNV_R_R_Umr_1_zu_1_7_CM_S2 -32768 32767
 /begin AXIS_DESCR FIX_AXIS Z_GANG_ZIEL _CNV_S_9_Enum_EGANG_21_CM_S2 9 0 8 READ_ONLY FIX_AXIS_PAR_DIST 0 1 9 /end AXIS_DESCR
 /begin AXIS_DESCR FIX_AXIS Z_GWFP_DMRS_AGS _CNV_S_10_Enum_EDMRS_22_CM_S2 10 0 9 READ_ONLY FIX_AXIS_PAR_DIST 0 1 10 /end AXIS_DESCR
 FORMAT "%2.0" /end CHARACTERISTIC
/begin CHARACTERISTIC XTAB9X10SCHGW_FP_DMRSUP "" MAP 0x1DC41C _REC_A1MAP_9_s2_u1_u1_S2 65535 _CNV_R_R_Umr_1_zu_1_7_CM_S2 -32768 32767
 /begin AXIS_DESCR FIX_AXIS Z_GANG_ZIEL _CNV_S_9_Enum_EGANG_21_CM_S2 9 0 8 READ_ONLY FIX_AXIS_PAR_DIST 0 1 9 /end AXIS_DESCR
 /begin AXIS_DESCR FIX_AXIS Z_GWFP_DMRS_AGS _CNV_S_10_Enum_EDMRS_22_CM_S2 10 0 9 READ_ONLY FIX_AXIS_PAR_DIST 0 1 10 /end AXIS_DESCR
 FORMAT "%2.0" /end CHARACTERISTIC
/begin CHARACTERISTIC XTAB9X10SCHN_ABMAXAKT_FAS_DBM "" MAP 0x1DAF84 _REC_A1MAP_8_s2_u2_u2_S2 32000 _CNV_R_R_Umr_1_zu_1_3_CM_S2 0 32000
 /begin AXIS_DESCR FIX_AXIS NO_INPUT_QUANTITY _CNV_S_9_Enum_EGANG_21_CM_S2 9 0 8 READ_ONLY /begin FIX_AXIS_PAR_LIST 0 1 2 3 4 5 6 7 8 /end FIX_AXIS_PAR_LIST /end AXIS_DESCR
 /begin AXIS_DESCR FIX_AXIS NO_INPUT_QUANTITY _CNV_S_10_Enum_EDBMT_254_CM_S2 10 0 9 READ_ONLY /begin FIX_AXIS_PAR_LIST 0 1 2 3 4 5 6 7 8 9 /end FIX_AXIS_PAR_LIST /end AXIS_DESCR
 FORMAT "%2.0" /end CHARACTERISTIC
/begin CHARACTERISTIC XTAB9X10SCHN_ABMAXAKT_ZKA_DBM "" MAP 0x1DB038 _REC_A1MAP_8_s2_u2_u2_S2 32000 _CNV_R_R_Umr_1_zu_1_3_CM_S2 0 32000
 /begin AXIS_DESCR FIX_AXIS NO_INPUT_QUANTITY _CNV_S_9_Enum_EGANG_21_CM_S2 9 0 8 READ_ONLY /begin FIX_AXIS_PAR_LIST 0 1 2 3 4 5 6 7 8 /end FIX_AXIS_PAR_LIST /end AXIS_DESCR
 /begin AXIS_DESCR FIX_AXIS NO_INPUT_QUANTITY _CNV_S_10_Enum_EDBMT_254_CM_S2 10 0 9 READ_ONLY /begin FIX_AXIS_PAR_LIST 0 1 2 3 4 5 6 7 8 9 /end FIX_AXIS_PAR_LIST /end AXIS_DESCR
 FORMAT "%2.0" /end CHARACTERISTIC
/begin CHARACTERISTIC XTAB9X10SCHN_ABMAXHI_FAS_DBM "" MAP 0x1DB0EC _REC_A1MAP_8_s2_u2_u2_S2 32000 _CNV_R_R_Umr_1_zu_1_3_CM_S2 0 32000
 /begin AXIS_DESCR FIX_AXIS NO_INPUT_QUANTITY _CNV_S_9_Enum_EGANG_21_CM_S2 9 0 8 READ_ONLY /begin FIX_AXIS_PAR_LIST 0 1 2 3 4 5 6 7 8 /end FIX_AXIS_PAR_LIST /end AXIS_DESCR
 /begin AXIS_DESCR FIX_AXIS NO_INPUT_QUANTITY _CNV_S_10_Enum_EDBMT_254_CM_S2 10 0 9 READ_ONLY /begin FIX_AXIS_PAR_LIST 0 1 2 3 4 5 6 7 8 9 /end FIX_AXIS_PAR_LIST /end AXIS_DESCR
 FORMAT "%2.0" /end CHARACTERISTIC
/begin CHARACTERISTIC XTAB9X10SCHN_ABMAXHI_ZKA_DBM "" MAP 0x1DB1A0 _REC_A1MAP_8_s2_u2_u2_S2 32000 _CNV_R_R_Umr_1_zu_1_3_CM_S2 0 32000
 /begin AXIS_DESCR FIX_AXIS NO_INPUT_QUANTITY _CNV_S_9_Enum_EGANG_21_CM_S2 9 0 8 READ_ONLY /begin FIX_AXIS_PAR_LIST 0 1 2 3 4 5 6 7 8 /end FIX_AXIS_PAR_LIST /end AXIS_DESCR
 /begin AXIS_DESCR FIX_AXIS NO_INPUT_QUANTITY _CNV_S_10_Enum_EDBMT_254_CM_S2 10 0 9 READ_ONLY /begin FIX_AXIS_PAR_LIST 0 1 2 3 4 5 6 7 8 9 /end FIX_AXIS_PAR_LIST /end AXIS_DESCR
 FORMAT "%2.0" /end CHARACTERISTIC
/begin CHARACTERISTIC XTAB9X10SCHN_ABMINAKT_FAS_DBM "" MAP 0x1DB254 _REC_A1MAP_8_s2_u2_u2_S2 32000 _CNV_R_R_Umr_1_zu_1_3_CM_S2 0 32000
 /begin AXIS_DESCR FIX_AXIS NO_INPUT_QUANTITY _CNV_S_9_Enum_EGANG_21_CM_S2 9 0 8 READ_ONLY /begin FIX_AXIS_PAR_LIST 0 1 2 3 4 5 6 7 8 /end FIX_AXIS_PAR_LIST /end AXIS_DESCR
 /begin AXIS_DESCR FIX_AXIS NO_INPUT_QUANTITY _CNV_S_10_Enum_EDBMT_254_CM_S2 10 0 9 READ_ONLY /begin FIX_AXIS_PAR_LIST 0 1 2 3 4 5 6 7 8 9 /end FIX_AXIS_PAR_LIST /end AXIS_DESCR
 FORMAT "%2.0" /end CHARACTERISTIC
/begin CHARACTERISTIC XTAB9X10SCHN_ABMINAKT_ZKA_DBM "" MAP 0x1DB308 _REC_A1MAP_8_s2_u2_u2_S2 32000 _CNV_R_R_Umr_1_zu_1_3_CM_S2 0 32000
 /begin AXIS_DESCR FIX_AXIS NO_INPUT_QUANTITY _CNV_S_9_Enum_EGANG_21_CM_S2 9 0 8 READ_ONLY /begin FIX_AXIS_PAR_LIST 0 1 2 3 4 5 6 7 8 /end FIX_AXIS_PAR_LIST /end AXIS_DESCR
 /begin AXIS_DESCR FIX_AXIS NO_INPUT_QUANTITY _CNV_S_10_Enum_EDBMT_254_CM_S2 10 0 9 READ_ONLY /begin FIX_AXIS_PAR_LIST 0 1 2 3 4 5 6 7 8 9 /end FIX_AXIS_PAR_LIST /end AXIS_DESCR
 FORMAT "%2.0" /end CHARACTERISTIC
/begin CHARACTERISTIC XTAB9X10SCHN_ABMINLO_FAS_DBM "" MAP 0x1DB3BC _REC_A1MAP_8_s2_u2_u2_S2 32000 _CNV_R_R_Umr_1_zu_1_3_CM_S2 0 32000
 /begin AXIS_DESCR FIX_AXIS NO_INPUT_QUANTITY _CNV_S_9_Enum_EGANG_21_CM_S2 9 0 8 READ_ONLY /begin FIX_AXIS_PAR_LIST 0 1 2 3 4 5 6 7 8 /end FIX_AXIS_PAR_LIST /end AXIS_DESCR
 /begin AXIS_DESCR FIX_AXIS NO_INPUT_QUANTITY _CNV_S_10_Enum_EDBMT_254_CM_S2 10 0 9 READ_ONLY /begin FIX_AXIS_PAR_LIST 0 1 2 3 4 5 6 7 8 9 /end FIX_AXIS_PAR_LIST /end AXIS_DESCR
 FORMAT "%2.0" /end CHARACTERISTIC
/begin CHARACTERISTIC XTAB9X10SCHN_ABMINLO_ZKA_DBM "" MAP 0x1DB470 _REC_A1MAP_8_s2_u2_u2_S2 32000 _CNV_R_R_Umr_1_zu_1_3_CM_S2 0 32000
 /begin AXIS_DESCR FIX_AXIS NO_INPUT_QUANTITY _CNV_S_9_Enum_EGANG_21_CM_S2 9 0 8 READ_ONLY /begin FIX_AXIS_PAR_LIST 0 1 2 3 4 5 6 7 8 /end FIX_AXIS_PAR_LIST /end AXIS_DESCR
 /begin AXIS_DESCR FIX_AXIS NO_INPUT_QUANTITY _CNV_S_10_Enum_EDBMT_254_CM_S2 10 0 9 READ_ONLY /begin FIX_AXIS_PAR_LIST 0 1 2 3 4 5 6 7 8 9 /end FIX_AXIS_PAR_LIST /end AXIS_DESCR
 FORMAT "%2.0" /end CHARACTERISTIC
/begin CHARACTERISTIC XTAB9X10Z_DWDKKD_DMRS "" MAP 0x1DE90E _REC_A1MAP_9_u1_u1_u1_S2 9 _CNV_R_R_Umr_1_zu_1_266_CM_S2 0 9
 /begin AXIS_DESCR FIX_AXIS Z_GANG_ZIEL _CNV_S_9_Enum_EGANG_21_CM_S2 9 0 8 READ_ONLY FIX_AXIS_PAR_DIST 0 1 9 /end AXIS_DESCR
 /begin AXIS_DESCR FIX_AXIS Z_DWDKKD_DMRS_AGS _CNV_S_10_Enum_EDMRS_22_CM_S2 10 0 9 READ_ONLY FIX_AXIS_PAR_DIST 0 1 10 /end AXIS_DESCR
 FORMAT "%2.0" /end CHARACTERISTIC
/begin CHARACTERISTIC XTAB9X2KORFAKT_FWSBAB_MUELOW "" MAP 0x1E24A8 _REC_A1MAP_9_u1_u1_u1_S2 150 _CNV_R_R_Umr_1_zu_1_30_CM_S2 100 250
 /begin AXIS_DESCR FIX_AXIS Z_GANG_RSZFWS _CNV_S_9_Enum_EGANG_21_CM_S2 9 0 8 READ_ONLY FIX_AXIS_PAR_DIST 0 1 9 /end AXIS_DESCR
 /begin AXIS_DESCR FIX_AXIS S_BAB_FGRKF _CNV_S_2_Enum_EBABF_41_CM_S2 2 0 1 READ_ONLY FIX_AXIS_PAR_DIST 0 1 2 /end AXIS_DESCR
 FORMAT "%2.0" /end CHARACTERISTIC
/begin CHARACTERISTIC XTAB9X2N_MOT_HSURESCHLUPF "" MAP 0x1DC91C _REC_A1MAP_8_u2_u1_u1_S2 20000 _CNV_R_R_Umr_1_zu_1_3_CM_S2 0 20000
 /begin AXIS_DESCR FIX_AXIS Z_GANG_ZIEL_HSURE _CNV_S_9_Enum_EGANG_21_CM_S2 9 0 8 READ_ONLY FIX_AXIS_PAR_DIST 0 1 9 /end AXIS_DESCR
 /begin AXIS_DESCR FIX_AXIS NO_INPUT_QUANTITY _CNV_S_2_Enum_HSURE_100_CM_S2 2 0 1 READ_ONLY /begin FIX_AXIS_PAR_LIST 0 1 /end FIX_AXIS_PAR_LIST /end AXIS_DESCR
 FORMAT "%2.0" /end CHARACTERISTIC
/begin CHARACTERISTIC XTAB9X2N_T_WKANBIND_0 "" MAP 0x1DC030 _REC_A1MAP_9_u2_u1_u1_S2 15000 _CNV_R_R_Umr_1_zu_1_3_CM_S2 0 15000
 /begin AXIS_DESCR FIX_AXIS Z_WKSOLL_IDX _CNV_S_2_Enum_EWKAN_162_CM_S2 2 0 1 READ_ONLY FIX_AXIS_PAR_DIST 0 1 2 /end AXIS_DESCR
 /begin AXIS_DESCR FIX_AXIS Z_GANG_IST _CNV_S_9_Enum_EGANG_21_CM_S2 9 0 8 READ_ONLY FIX_AXIS_PAR_DIST 0 1 9 /end AXIS_DESCR
 FORMAT "%2.0" /end CHARACTERISTIC
/begin CHARACTERISTIC XTAB9X2N_T_WKANBIND_1 "" MAP 0x1DC054 _REC_A1MAP_9_u2_u1_u1_S2 15000 _CNV_R_R_Umr_1_zu_1_3_CM_S2 0 15000
 /begin AXIS_DESCR FIX_AXIS Z_WKSOLL_IDX _CNV_S_2_Enum_EWKAN_162_CM_S2 2 0 1 READ_ONLY FIX_AXIS_PAR_DIST 0 1 2 /end AXIS_DESCR
 /begin AXIS_DESCR FIX_AXIS Z_GANG_IST _CNV_S_9_Enum_EGANG_21_CM_S2 9 0 8 READ_ONLY FIX_AXIS_PAR_DIST 0 1 9 /end AXIS_DESCR
 FORMAT "%2.0" /end CHARACTERISTIC
/begin CHARACTERISTIC XTAB9X2N_T_WKANBIND_2 "" MAP 0x1DC078 _REC_A1MAP_9_u2_u1_u1_S2 15000 _CNV_R_R_Umr_1_zu_1_3_CM_S2 0 15000
 /begin AXIS_DESCR FIX_AXIS Z_WKSOLL_IDX _CNV_S_2_Enum_EWKAN_162_CM_S2 2 0 1 READ_ONLY FIX_AXIS_PAR_DIST 0 1 2 /end AXIS_DESCR
 /begin AXIS_DESCR FIX_AXIS Z_GANG_IST _CNV_S_9_Enum_EGANG_21_CM_S2 9 0 8 READ_ONLY FIX_AXIS_PAR_DIST 0 1 9 /end AXIS_DESCR
 FORMAT "%2.0" /end CHARACTERISTIC
/begin CHARACTERISTIC XTAB9X2N_T_WKANBIND_3 "" MAP 0x1DC09C _REC_A1MAP_9_u2_u1_u1_S2 15000 _CNV_R_R_Umr_1_zu_1_3_CM_S2 0 15000
 /begin AXIS_DESCR FIX_AXIS Z_WKSOLL_IDX _CNV_S_2_Enum_EWKAN_162_CM_S2 2 0 1 READ_ONLY FIX_AXIS_PAR_DIST 0 1 2 /end AXIS_DESCR
 /begin AXIS_DESCR FIX_AXIS Z_GANG_IST _CNV_S_9_Enum_EGANG_21_CM_S2 9 0 8 READ_ONLY FIX_AXIS_PAR_DIST 0 1 9 /end AXIS_DESCR
 FORMAT "%2.0" /end CHARACTERISTIC
/begin CHARACTERISTIC XTAB9X2N_T_WKANBIND_4 "" MAP 0x1DC0C0 _REC_A1MAP_9_u2_u1_u1_S2 15000 _CNV_R_R_Umr_1_zu_1_3_CM_S2 0 15000
 /begin AXIS_DESCR FIX_AXIS Z_WKSOLL_IDX _CNV_S_2_Enum_EWKAN_162_CM_S2 2 0 1 READ_ONLY FIX_AXIS_PAR_DIST 0 1 2 /end AXIS_DESCR
 /begin AXIS_DESCR FIX_AXIS Z_GANG_IST _CNV_S_9_Enum_EGANG_21_CM_S2 9 0 8 READ_ONLY FIX_AXIS_PAR_DIST 0 1 9 /end AXIS_DESCR
 FORMAT "%2.0" /end CHARACTERISTIC
/begin CHARACTERISTIC XTAB9X2N_T_WKANBIND_5 "" MAP 0x1DC0E4 _REC_A1MAP_9_u2_u1_u1_S2 15000 _CNV_R_R_Umr_1_zu_1_3_CM_S2 0 15000
 /begin AXIS_DESCR FIX_AXIS Z_WKSOLL_IDX _CNV_S_2_Enum_EWKAN_162_CM_S2 2 0 1 READ_ONLY FIX_AXIS_PAR_DIST 0 1 2 /end AXIS_DESCR
 /begin AXIS_DESCR FIX_AXIS Z_GANG_IST _CNV_S_9_Enum_EGANG_21_CM_S2 9 0 8 READ_ONLY FIX_AXIS_PAR_DIST 0 1 9 /end AXIS_DESCR
 FORMAT "%2.0" /end CHARACTERISTIC
/begin CHARACTERISTIC XTAB9X2ON_AB_HS_DERS "" MAP 0x1DD9D8 _REC_A1MAP_9_u2_u1_u1_S2 20000 _CNV_R_R_Umr_1_zu_1_3_CM_S2 0 20000
 /begin AXIS_DESCR FIX_AXIS Z_GANG_ZIEL _CNV_S_9_Enum_EGANG_21_CM_S2 9 0 8 READ_ONLY FIX_AXIS_PAR_DIST 0 1 9 /end AXIS_DESCR
 /begin AXIS_DESCR FIX_AXIS Z_DERS_YIDX _CNV_R_R_Umr_1_zu_1_2_CM_S2 2 0 1 READ_ONLY FORMAT "%2.0" FIX_AXIS_PAR_DIST 0 1 2 /end AXIS_DESCR
 FORMAT "%2.0" /end CHARACTERISTIC
/begin CHARACTERISTIC XTAB9X2SCHN_ABMAXHIS_FAS_DBM "" MAP 0x1DB524 _REC_A1MAP_8_s2_u2_u1_S2 10000 _CNV_R_R_Umr_1_zu_1_3_CM_S2 0 10000
 /begin AXIS_DESCR FIX_AXIS NO_INPUT_QUANTITY _CNV_S_9_Enum_EGANG_21_CM_S2 9 0 8 READ_ONLY /begin FIX_AXIS_PAR_LIST 0 1 2 3 4 5 6 7 8 /end FIX_AXIS_PAR_LIST /end AXIS_DESCR
 /begin AXIS_DESCR FIX_AXIS Z_AGS_MODBEDEL _CNV_S_2_Enum_EAGS_18_CM_S2 2 0 1 READ_ONLY FIX_AXIS_PAR_DIST 0 1 2 /end AXIS_DESCR
 FORMAT "%2.0" /end CHARACTERISTIC
/begin CHARACTERISTIC XTAB9X2SCHN_ABMINAKTS_FAS_DBM "" MAP 0x1DB548 _REC_A1MAP_8_s2_u2_u1_S2 10000 _CNV_R_R_Umr_1_zu_1_3_CM_S2 0 10000
 /begin AXIS_DESCR FIX_AXIS NO_INPUT_QUANTITY _CNV_S_9_Enum_EGANG_21_CM_S2 9 0 8 READ_ONLY /begin FIX_AXIS_PAR_LIST 0 1 2 3 4 5 6 7 8 /end FIX_AXIS_PAR_LIST /end AXIS_DESCR
 /begin AXIS_DESCR FIX_AXIS Z_AGS_MODBEDEL _CNV_S_2_Enum_EAGS_18_CM_S2 2 0 1 READ_ONLY FIX_AXIS_PAR_DIST 0 1 2 /end AXIS_DESCR
 FORMAT "%2.0" /end CHARACTERISTIC
/begin CHARACTERISTIC XTAB9X2SCHN_AB_DERS "" MAP 0x1DD9FC _REC_A1MAP_9_u2_u1_u1_S2 20000 _CNV_R_R_Umr_1_zu_1_3_CM_S2 0 20000
 /begin AXIS_DESCR FIX_AXIS Z_GANG_ZIEL_SKL _CNV_S_9_Enum_EGANG_21_CM_S2 9 0 8 READ_ONLY FIX_AXIS_PAR_DIST 0 1 9 /end AXIS_DESCR
 /begin AXIS_DESCR FIX_AXIS Z_DERS_YIDX _CNV_R_R_Umr_1_zu_1_2_CM_S2 2 0 1 READ_ONLY FORMAT "%2.0" FIX_AXIS_PAR_DIST 0 1 2 /end AXIS_DESCR
 FORMAT "%2.0" /end CHARACTERISTIC
/begin CHARACTERISTIC XTAB9X2SCHN_AB_LWVA_DERS "" MAP 0x1DD9B4 _REC_A1MAP_9_u2_u1_u1_S2 20000 _CNV_R_R_Umr_1_zu_1_3_CM_S2 0 20000
 /begin AXIS_DESCR FIX_AXIS Z_GANG_ZIEL_SKL _CNV_S_9_Enum_EGANG_21_CM_S2 9 0 8 READ_ONLY FIX_AXIS_PAR_DIST 0 1 9 /end AXIS_DESCR
 /begin AXIS_DESCR FIX_AXIS S_B_BCA _CNV_P_2_A_I_5_CM_S2 2 0 255 READ_ONLY /begin FIX_AXIS_PAR_LIST 0 1 /end FIX_AXIS_PAR_LIST /end AXIS_DESCR
 FORMAT "%2.0" /end CHARACTERISTIC
/begin CHARACTERISTIC XTAB9X2SCHN_AB_MOTORNOTLAUF "" MAP 0x1DC150 _REC_A1MAP_9_u2_u1_u1_S2 20000 _CNV_R_R_Umr_1_zu_1_3_CM_S2 0 20000
 /begin AXIS_DESCR FIX_AXIS Z_GANG_ZIEL _CNV_S_9_Enum_EGANG_21_CM_S2 9 0 8 READ_ONLY FIX_AXIS_PAR_DIST 0 1 9 /end AXIS_DESCR
 /begin AXIS_DESCR FIX_AXIS NO_INPUT_QUANTITY _CNV_S_2_Enum_ENOTL_96_CM_S2 2 0 1 READ_ONLY FIX_AXIS_PAR_DIST 0 1 2 /end AXIS_DESCR
 FORMAT "%2.0" /end CHARACTERISTIC
/begin CHARACTERISTIC XTAB9X2SCHN_MOTMAX_DSC_ERR "" MAP 0x1DC960 _REC_A1MAP_9_u2_u1_u1_S2 10000 _CNV_R_R_Umr_1_zu_1_3_CM_S2 0 10000
 /begin AXIS_DESCR FIX_AXIS Z_GANG_ZIEL _CNV_S_9_Enum_EGANG_21_CM_S2 9 0 8 READ_ONLY FIX_AXIS_PAR_DIST 0 1 9 /end AXIS_DESCR
 /begin AXIS_DESCR FIX_AXIS S_ROLLE_CAN _CNV_S_2_Schalter_A_4_CM_S2 2 0 1 READ_ONLY /begin FIX_AXIS_PAR_LIST 0 1 /end FIX_AXIS_PAR_LIST /end AXIS_DESCR
 FORMAT "%2.0" /end CHARACTERISTIC
/begin CHARACTERISTIC XTAB9X2SCHN_MOT_HSHDC "" MAP 0x1DC560 _REC_A1MAP_9_u2_u1_u1_S2 20000 _CNV_R_R_Umr_1_zu_1_3_CM_S2 0 20000
 /begin AXIS_DESCR FIX_AXIS Z_GANG_ZIEL _CNV_S_9_Enum_EGANG_21_CM_S2 9 0 8 READ_ONLY FIX_AXIS_PAR_DIST 0 1 9 /end AXIS_DESCR
 /begin AXIS_DESCR FIX_AXIS S_HDC_BER _CNV_S_2_Enum_EHDC__99_CM_S2 2 0 1 READ_ONLY FIX_AXIS_PAR_DIST 0 1 2 /end AXIS_DESCR
 FORMAT "%2.0" /end CHARACTERISTIC
/begin CHARACTERISTIC XTAB9X2SCHN_MOT_RSHDC "" MAP 0x1DC584 _REC_A1MAP_9_u2_u1_u1_S2 20000 _CNV_R_R_Umr_1_zu_1_3_CM_S2 0 20000
 /begin AXIS_DESCR FIX_AXIS Z_GANG_ZIEL _CNV_S_9_Enum_EGANG_21_CM_S2 9 0 8 READ_ONLY FIX_AXIS_PAR_DIST 0 1 9 /end AXIS_DESCR
 /begin AXIS_DESCR FIX_AXIS S_HDC_BER _CNV_S_2_Enum_EHDC__99_CM_S2 2 0 1 READ_ONLY FIX_AXIS_PAR_DIST 0 1 2 /end AXIS_DESCR
 FORMAT "%2.0" /end CHARACTERISTIC
/begin CHARACTERISTIC XTAB9X2Z_GANG_ZRS "" MAP 0x1DE4A6 _REC_A1MAP_9_u1_u1_u1_S2 8 _CNV_S_9_Enum_EGANG_21_CM_S2 0 8
 /begin AXIS_DESCR FIX_AXIS Z_GANG_ZIEL_SSTEP _CNV_S_9_Enum_EGANG_21_CM_S2 9 0 8 READ_ONLY FIX_AXIS_PAR_DIST 0 1 9 /end AXIS_DESCR
 /begin AXIS_DESCR FIX_AXIS S_ZRS_MOD_STEPS _CNV_S_2_Schalter_A_4_CM_S2 2 0 1 READ_ONLY /begin FIX_AXIS_PAR_LIST 0 1 /end FIX_AXIS_PAR_LIST /end AXIS_DESCR
/end CHARACTERISTIC
/begin CHARACTERISTIC XTAB9X3FAKT_LDMDYNAMIC2_ZKA "" MAP 0x1D973C _REC_A1MAP_8_u1_u1_u2_S2 100 _CNV_R_R_Umr_1_zu_1_30_CM_S2 0 100
 /begin AXIS_DESCR FIX_AXIS Z_GANG_ZIEL_ZKA _CNV_S_9_Enum_EGANG_21_CM_S2 9 0 8 READ_ONLY FIX_AXIS_PAR_DIST 0 1 9 /end AXIS_DESCR
 /begin AXIS_DESCR FIX_AXIS NO_INPUT_QUANTITY _CNV_R_R_Umr_1_zu_1_2_CM_S2 3 0 65535 READ_ONLY /begin FIX_AXIS_PAR_LIST 0 1 2 /end FIX_AXIS_PAR_LIST /end AXIS_DESCR
 FORMAT "%2.0" /end CHARACTERISTIC
/begin CHARACTERISTIC XTAB9X3N_MOTMAX_RS_ABSDSC "" MAP 0x1D8F57 _REC_A1MAP_9_u1_u1_u1_S2 10000 _CNV_R_R_Umr_1_zu_5_71_CM_S2 0 10000
 /begin AXIS_DESCR FIX_AXIS S_ERR_DSC_ROLLECAN _CNV_S_3_Enum_ERRDS_70_CM_S2 3 0 2 READ_ONLY /begin FIX_AXIS_PAR_LIST 0 1 2 /end FIX_AXIS_PAR_LIST /end AXIS_DESCR
 /begin AXIS_DESCR FIX_AXIS Z_GANG_SOLLAGS _CNV_S_9_Enum_EGANG_21_CM_S2 9 0 8 READ_ONLY FIX_AXIS_PAR_DIST 0 1 9 /end AXIS_DESCR
 FORMAT "%2.0" /end CHARACTERISTIC
/begin CHARACTERISTIC XTAB9X3O_WARTEZEIT_ZWHS_DYNDZM "" MAP 0x1D914B _REC_A1MAP_9_u1_u1_u1_S2 250 _CNV_R_R_Umr_1_zu_1_6_CM_S2 0 250
 /begin AXIS_DESCR FIX_AXIS Z_GANG_ZIEL_DYNDZM _CNV_S_9_Enum_EGANG_21_CM_S2 9 0 8 READ_ONLY FIX_AXIS_PAR_DIST 0 1 9 /end AXIS_DESCR
 /begin AXIS_DESCR FIX_AXIS NO_INPUT_QUANTITY _CNV_S_3_Enum_EDYND_130_CM_S2 3 0 2 READ_ONLY /begin FIX_AXIS_PAR_LIST 0 1 2 /end FIX_AXIS_PAR_LIST /end AXIS_DESCR
 FORMAT "%2.0" /end CHARACTERISTIC
/begin CHARACTERISTIC XTAB9X3Z_DRIVELOGIC_MODE "" MAP 0x1D9554 _REC_A1MAP_9_u1_u1_u1_S2 5 _CNV_S_6_Enum_EDL_11_CM_S2 1 6
 /begin AXIS_DESCR FIX_AXIS Z_DL_IDX _CNV_S_9_Enum_EMAPD_212_CM_S2 9 0 8 READ_ONLY FIX_AXIS_PAR_DIST 0 1 9 /end AXIS_DESCR
 /begin AXIS_DESCR FIX_AXIS Z_DSC _CNV_S_3_Enum_EDSCS_50_CM_S2 3 0 2 READ_ONLY FIX_AXIS_PAR_DIST 0 1 3 /end AXIS_DESCR
/end CHARACTERISTIC
/begin CHARACTERISTIC XTAB9X4SCHN_AB_HOCH_BRS "" MAP 0x1DD67C _REC_A1MAP_9_u2_u1_u1_S2 20000 _CNV_R_R_Umr_1_zu_1_3_CM_S2 0 20000
 /begin AXIS_DESCR FIX_AXIS Z_GANG_ZIEL _CNV_S_9_Enum_EGANG_21_CM_S2 9 0 8 READ_ONLY FIX_AXIS_PAR_DIST 0 1 9 /end AXIS_DESCR
 /begin AXIS_DESCR FIX_AXIS Z_AGSMOD_ECO_EFAHREN _CNV_S_4_Enum_EAGS__17_CM_S2 4 0 3 READ_ONLY FIX_AXIS_PAR_DIST 0 1 4 /end AXIS_DESCR
 FORMAT "%2.0" /end CHARACTERISTIC
/begin CHARACTERISTIC XTAB9X4SCHN_AB_HOCH_D2RS_BRS "" MAP 0x1DD6C4 _REC_A1MAP_9_u2_u1_u1_S2 20000 _CNV_R_R_Umr_1_zu_1_3_CM_S2 0 20000
 /begin AXIS_DESCR FIX_AXIS Z_GANG_ZIEL _CNV_S_9_Enum_EGANG_21_CM_S2 9 0 8 READ_ONLY FIX_AXIS_PAR_DIST 0 1 9 /end AXIS_DESCR
 /begin AXIS_DESCR FIX_AXIS Z_AGSMOD_ECO_EFAHREN _CNV_S_4_Enum_EAGS__17_CM_S2 4 0 3 READ_ONLY FIX_AXIS_PAR_DIST 0 1 4 /end AXIS_DESCR
 FORMAT "%2.0" /end CHARACTERISTIC
/begin CHARACTERISTIC XTAB9X4SCHN_AB_MITTEL_BRS "" MAP 0x1DD70C _REC_A1MAP_9_u2_u1_u1_S2 20000 _CNV_R_R_Umr_1_zu_1_3_CM_S2 0 20000
 /begin AXIS_DESCR FIX_AXIS Z_GANG_ZIEL _CNV_S_9_Enum_EGANG_21_CM_S2 9 0 8 READ_ONLY FIX_AXIS_PAR_DIST 0 1 9 /end AXIS_DESCR
 /begin AXIS_DESCR FIX_AXIS Z_AGSMOD_ECO_EFAHREN _CNV_S_4_Enum_EAGS__17_CM_S2 4 0 3 READ_ONLY FIX_AXIS_PAR_DIST 0 1 4 /end AXIS_DESCR
 FORMAT "%2.0" /end CHARACTERISTIC
/begin CHARACTERISTIC XTAB9X4SCHN_AB_MITTEL_D2RS_BRS "" MAP 0x1DD754 _REC_A1MAP_9_u2_u1_u1_S2 20000 _CNV_R_R_Umr_1_zu_1_3_CM_S2 0 20000
 /begin AXIS_DESCR FIX_AXIS Z_GANG_ZIEL _CNV_S_9_Enum_EGANG_21_CM_S2 9 0 8 READ_ONLY FIX_AXIS_PAR_DIST 0 1 9 /end AXIS_DESCR
 /begin AXIS_DESCR FIX_AXIS Z_AGSMOD_ECO_EFAHREN _CNV_S_4_Enum_EAGS__17_CM_S2 4 0 3 READ_ONLY FIX_AXIS_PAR_DIST 0 1 4 /end AXIS_DESCR
 FORMAT "%2.0" /end CHARACTERISTIC
/begin CHARACTERISTIC XTAB9X4SCHN_AB_SCHWACH_BRS "" MAP 0x1DD79C _REC_A1MAP_9_u2_u1_u1_S2 20000 _CNV_R_R_Umr_1_zu_1_3_CM_S2 0 20000
 /begin AXIS_DESCR FIX_AXIS Z_GANG_ZIEL _CNV_S_9_Enum_EGANG_21_CM_S2 9 0 8 READ_ONLY FIX_AXIS_PAR_DIST 0 1 9 /end AXIS_DESCR
 /begin AXIS_DESCR FIX_AXIS Z_AGSMOD_ECO_EFAHREN _CNV_S_4_Enum_EAGS__17_CM_S2 4 0 3 READ_ONLY FIX_AXIS_PAR_DIST 0 1 4 /end AXIS_DESCR
 FORMAT "%2.0" /end CHARACTERISTIC
/begin CHARACTERISTIC XTAB9X4SCHN_AB_SCHWACH_D2RS_BRS "" MAP 0x1DD7E4 _REC_A1MAP_9_u2_u1_u1_S2 20000 _CNV_R_R_Umr_1_zu_1_3_CM_S2 0 20000
 /begin AXIS_DESCR FIX_AXIS Z_GANG_ZIEL _CNV_S_9_Enum_EGANG_21_CM_S2 9 0 8 READ_ONLY FIX_AXIS_PAR_DIST 0 1 9 /end AXIS_DESCR
 /begin AXIS_DESCR FIX_AXIS Z_AGSMOD_ECO_EFAHREN _CNV_S_4_Enum_EAGS__17_CM_S2 4 0 3 READ_ONLY FIX_AXIS_PAR_DIST 0 1 4 /end AXIS_DESCR
 FORMAT "%2.0" /end CHARACTERISTIC
/begin CHARACTERISTIC XTAB9X4SCHN_AB_SMOOTH_BRS "" MAP 0x1DD82C _REC_A1MAP_9_u2_u1_u1_S2 20000 _CNV_R_R_Umr_1_zu_1_3_CM_S2 0 20000
 /begin AXIS_DESCR FIX_AXIS Z_GANG_ZIEL _CNV_S_9_Enum_EGANG_21_CM_S2 9 0 8 READ_ONLY FIX_AXIS_PAR_DIST 0 1 9 /end AXIS_DESCR
 /begin AXIS_DESCR FIX_AXIS Z_AGSMOD_ECO_EFAHREN _CNV_S_4_Enum_EAGS__17_CM_S2 4 0 3 READ_ONLY FIX_AXIS_PAR_DIST 0 1 4 /end AXIS_DESCR
 FORMAT "%2.0" /end CHARACTERISTIC
/begin CHARACTERISTIC XTAB9X4SCHN_AB_SMOOTH_D2RS_BRS "" MAP 0x1DD874 _REC_A1MAP_9_u2_u1_u1_S2 20000 _CNV_R_R_Umr_1_zu_1_3_CM_S2 0 20000
 /begin AXIS_DESCR FIX_AXIS Z_GANG_ZIEL _CNV_S_9_Enum_EGANG_21_CM_S2 9 0 8 READ_ONLY FIX_AXIS_PAR_DIST 0 1 9 /end AXIS_DESCR
 /begin AXIS_DESCR FIX_AXIS Z_AGSMOD_ECO_EFAHREN _CNV_S_4_Enum_EAGS__17_CM_S2 4 0 3 READ_ONLY FIX_AXIS_PAR_DIST 0 1 4 /end AXIS_DESCR
 FORMAT "%2.0" /end CHARACTERISTIC
/begin CHARACTERISTIC XTAB9X4Z_MAX_RFWSIDX_DBM "" MAP 0x1DBF9C _REC_A1MAP_9_u1_u1_u2_S2 15 _CNV_S_16_Enum_EMAXR_260_CM_S2 0 15
 /begin AXIS_DESCR FIX_AXIS Z_AGSMOD_ECO_EFAHREN _CNV_S_4_Enum_EAGS__17_CM_S2 4 0 3 READ_ONLY FIX_AXIS_PAR_DIST 0 1 4 /end AXIS_DESCR
 /begin AXIS_DESCR FIX_AXIS NO_INPUT_QUANTITY _CNV_S_9_Enum_EGANG_21_CM_S2 9 0 8 READ_ONLY /begin FIX_AXIS_PAR_LIST 0 1 2 3 4 5 6 7 8 /end FIX_AXIS_PAR_LIST /end AXIS_DESCR
/end CHARACTERISTIC
/begin CHARACTERISTIC XTAB9X4Z_MIN_RFWSIDX_DBM "" MAP 0x1DBFC0 _REC_A1MAP_9_u1_u1_u2_S2 15 _CNV_S_16_Enum_EMINR_261_CM_S2 0 15
 /begin AXIS_DESCR FIX_AXIS Z_AGSMOD_ECO_EFAHREN _CNV_S_4_Enum_EAGS__17_CM_S2 4 0 3 READ_ONLY FIX_AXIS_PAR_DIST 0 1 4 /end AXIS_DESCR
 /begin AXIS_DESCR FIX_AXIS NO_INPUT_QUANTITY _CNV_S_9_Enum_EGANG_21_CM_S2 9 0 8 READ_ONLY /begin FIX_AXIS_PAR_LIST 0 1 2 3 4 5 6 7 8 /end FIX_AXIS_PAR_LIST /end AXIS_DESCR
/end CHARACTERISTIC
/begin CHARACTERISTIC XTAB9X4_DYNHSPV_IDX "" MAP 0x1DCA6C _REC_A1MAP_9_u1_u1_u1_S2 9 _CNV_R_R_Umr_1_zu_1_2_CM_S2 0 9
 /begin AXIS_DESCR FIX_AXIS Z_GANG_ZIEL _CNV_S_9_Enum_EGANG_21_CM_S2 9 0 8 READ_ONLY FIX_AXIS_PAR_DIST 0 1 9 /end AXIS_DESCR
 /begin AXIS_DESCR FIX_AXIS NO_INPUT_QUANTITY _CNV_S_7_Enum_ESDYN_175_CM_S2 4 0 6 READ_ONLY /begin FIX_AXIS_PAR_LIST 0 1 2 3 /end FIX_AXIS_PAR_LIST /end AXIS_DESCR
 FORMAT "%2.0" /end CHARACTERISTIC
/begin CHARACTERISTIC XTAB9X5SCHN_MINAKT_AEP_DBM "" MAP 0x1DE0FC _REC_S3MAP_54_s2_s2_u2_S2 32000 _CNV_R_R_Umr_1_zu_1_3_CM_S2 0 32000
 /begin AXIS_DESCR STD_AXIS W_STEIGUNG_KORFILT _CNV_R_R_Umr_10_zu__9_CM_S2 5 -3276.8 3276.7 DEPOSIT ABSOLUTE /end AXIS_DESCR
 /begin AXIS_DESCR FIX_AXIS NO_INPUT_QUANTITY _CNV_S_9_Enum_EGANG_21_CM_S2 9 0 8 READ_ONLY /begin FIX_AXIS_PAR_LIST 0 1 2 3 4 5 6 7 8 /end FIX_AXIS_PAR_LIST /end AXIS_DESCR
 FORMAT "%2.0" /end CHARACTERISTIC
/begin CHARACTERISTIC XTAB9X5SCHN_MINAK_REKUPRS_DBM "" MAP 0x1DDEEA _REC_A1MAP_8_s2_u1_u2_S2 10000 _CNV_R_R_Umr_1_zu_1_3_CM_S2 0 10000
 /begin AXIS_DESCR FIX_AXIS Z_REKUP_IDX_DBM _CNV_S_5_Enum_REKUP_257_CM_S2 5 0 4 READ_ONLY /begin FIX_AXIS_PAR_LIST 0 1 2 3 4 /end FIX_AXIS_PAR_LIST /end AXIS_DESCR
 /begin AXIS_DESCR FIX_AXIS NO_INPUT_QUANTITY _CNV_S_9_Enum_EGANG_21_CM_S2 9 0 8 READ_ONLY /begin FIX_AXIS_PAR_LIST 0 1 2 3 4 5 6 7 8 /end FIX_AXIS_PAR_LIST /end AXIS_DESCR
 FORMAT "%2.0" /end CHARACTERISTIC
/begin CHARACTERISTIC XTAB9X5SCHN_MINLO_AEP_DBM "" MAP 0x1DE162 _REC_S3MAP_54_s2_s2_u2_S2 32000 _CNV_R_R_Umr_1_zu_1_3_CM_S2 0 32000
 /begin AXIS_DESCR STD_AXIS W_STEIGUNG_KORFILT _CNV_R_R_Umr_10_zu__9_CM_S2 5 -3276.8 3276.7 DEPOSIT ABSOLUTE /end AXIS_DESCR
 /begin AXIS_DESCR FIX_AXIS NO_INPUT_QUANTITY _CNV_S_9_Enum_EGANG_21_CM_S2 9 0 8 READ_ONLY /begin FIX_AXIS_PAR_LIST 0 1 2 3 4 5 6 7 8 /end FIX_AXIS_PAR_LIST /end AXIS_DESCR
 FORMAT "%2.0" /end CHARACTERISTIC
/begin CHARACTERISTIC XTAB9X5SCHN_MINLO_REKUPRS_DBM "" MAP 0x1DDF44 _REC_A1MAP_8_s2_u1_u2_S2 10000 _CNV_R_R_Umr_1_zu_1_3_CM_S2 0 10000
 /begin AXIS_DESCR FIX_AXIS Z_REKUP_IDX_DBM _CNV_S_5_Enum_REKUP_257_CM_S2 5 0 4 READ_ONLY /begin FIX_AXIS_PAR_LIST 0 1 2 3 4 /end FIX_AXIS_PAR_LIST /end AXIS_DESCR
 /begin AXIS_DESCR FIX_AXIS NO_INPUT_QUANTITY _CNV_S_9_Enum_EGANG_21_CM_S2 9 0 8 READ_ONLY /begin FIX_AXIS_PAR_LIST 0 1 2 3 4 5 6 7 8 /end FIX_AXIS_PAR_LIST /end AXIS_DESCR
 FORMAT "%2.0" /end CHARACTERISTIC
/begin CHARACTERISTIC XTAB9X5SCHN_MOT_HSZIELKD "" MAP 0x1DF69C _REC_A1MAP_9_u2_u1_u1_S2 10000 _CNV_R_R_Umr_1_zu_1_3_CM_S2 0 10000
 /begin AXIS_DESCR FIX_AXIS Z_GANG_ZIEL _CNV_S_9_Enum_EGANG_21_CM_S2 9 0 8 READ_ONLY FIX_AXIS_PAR_DIST 0 1 9 /end AXIS_DESCR
 /begin AXIS_DESCR FIX_AXIS Z_NMOTHSTUPEL_FFG _CNV_S_5_Enum_ETUPE_23_CM_S2 5 0 4 READ_ONLY FIX_AXIS_PAR_DIST 0 1 5 /end AXIS_DESCR
 FORMAT "%2.0" /end CHARACTERISTIC
/begin CHARACTERISTIC XTAB9X5SCHN_MOT_HSZIEL_0 "" MAP 0x1DF6F6 _REC_A1MAP_9_u2_u1_u1_S2 10000 _CNV_R_R_Umr_1_zu_1_3_CM_S2 0 10000
 /begin AXIS_DESCR FIX_AXIS Z_GANG_ZIEL _CNV_S_9_Enum_EGANG_21_CM_S2 9 0 8 READ_ONLY FIX_AXIS_PAR_DIST 0 1 9 /end AXIS_DESCR
 /begin AXIS_DESCR FIX_AXIS Z_NMOTHSTUPEL_FFG _CNV_S_5_Enum_ETUPE_23_CM_S2 5 0 4 READ_ONLY FIX_AXIS_PAR_DIST 0 1 5 /end AXIS_DESCR
 FORMAT "%2.0" /end CHARACTERISTIC
/begin CHARACTERISTIC XTAB9X5SCHN_MOT_HSZIEL_1 "" MAP 0x1DF750 _REC_A1MAP_9_u2_u1_u1_S2 10000 _CNV_R_R_Umr_1_zu_1_3_CM_S2 0 10000
 /begin AXIS_DESCR FIX_AXIS Z_GANG_ZIEL _CNV_S_9_Enum_EGANG_21_CM_S2 9 0 8 READ_ONLY FIX_AXIS_PAR_DIST 0 1 9 /end AXIS_DESCR
 /begin AXIS_DESCR FIX_AXIS Z_NMOTHSTUPEL_FFG _CNV_S_5_Enum_ETUPE_23_CM_S2 5 0 4 READ_ONLY FIX_AXIS_PAR_DIST 0 1 5 /end AXIS_DESCR
 FORMAT "%2.0" /end CHARACTERISTIC
/begin CHARACTERISTIC XTAB9X5SCHN_MOT_HSZIEL_2 "" MAP 0x1DF7AA _REC_A1MAP_9_u2_u1_u1_S2 10000 _CNV_R_R_Umr_1_zu_1_3_CM_S2 0 10000
 /begin AXIS_DESCR FIX_AXIS Z_GANG_ZIEL _CNV_S_9_Enum_EGANG_21_CM_S2 9 0 8 READ_ONLY FIX_AXIS_PAR_DIST 0 1 9 /end AXIS_DESCR
 /begin AXIS_DESCR FIX_AXIS Z_NMOTHSTUPEL_FFG _CNV_S_5_Enum_ETUPE_23_CM_S2 5 0 4 READ_ONLY FIX_AXIS_PAR_DIST 0 1 5 /end AXIS_DESCR
 FORMAT "%2.0" /end CHARACTERISTIC
/begin CHARACTERISTIC XTAB9X5SCHN_MOT_HSZIEL_3 "" MAP 0x1DF804 _REC_A1MAP_9_u2_u1_u1_S2 10000 _CNV_R_R_Umr_1_zu_1_3_CM_S2 0 10000
 /begin AXIS_DESCR FIX_AXIS Z_GANG_ZIEL _CNV_S_9_Enum_EGANG_21_CM_S2 9 0 8 READ_ONLY FIX_AXIS_PAR_DIST 0 1 9 /end AXIS_DESCR
 /begin AXIS_DESCR FIX_AXIS Z_NMOTHSTUPEL_FFG _CNV_S_5_Enum_ETUPE_23_CM_S2 5 0 4 READ_ONLY FIX_AXIS_PAR_DIST 0 1 5 /end AXIS_DESCR
 FORMAT "%2.0" /end CHARACTERISTIC
/begin CHARACTERISTIC XTAB9X5SCHN_MOT_RSZIELKD "" MAP 0x1DF85E _REC_A1MAP_9_u2_u1_u1_S2 10000 _CNV_R_R_Umr_1_zu_1_3_CM_S2 0 10000
 /begin AXIS_DESCR FIX_AXIS Z_GANG_ZIEL _CNV_S_9_Enum_EGANG_21_CM_S2 9 0 8 READ_ONLY FIX_AXIS_PAR_DIST 0 1 9 /end AXIS_DESCR
 /begin AXIS_DESCR FIX_AXIS Z_NMOTHSTUPEL_FFG _CNV_S_5_Enum_ETUPE_23_CM_S2 5 0 4 READ_ONLY FIX_AXIS_PAR_DIST 0 1 5 /end AXIS_DESCR
 FORMAT "%2.0" /end CHARACTERISTIC
/begin CHARACTERISTIC XTAB9X5SCHN_MOT_RSZIEL_0 "" MAP 0x1DF8B8 _REC_A1MAP_9_u2_u1_u1_S2 10000 _CNV_R_R_Umr_1_zu_1_3_CM_S2 0 10000
 /begin AXIS_DESCR FIX_AXIS Z_GANG_ZIEL _CNV_S_9_Enum_EGANG_21_CM_S2 9 0 8 READ_ONLY FIX_AXIS_PAR_DIST 0 1 9 /end AXIS_DESCR
 /begin AXIS_DESCR FIX_AXIS Z_NMOTHSTUPEL_FFG _CNV_S_5_Enum_ETUPE_23_CM_S2 5 0 4 READ_ONLY FIX_AXIS_PAR_DIST 0 1 5 /end AXIS_DESCR
 FORMAT "%2.0" /end CHARACTERISTIC
/begin CHARACTERISTIC XTAB9X5SCHN_MOT_RSZIEL_1 "" MAP 0x1DF912 _REC_A1MAP_9_u2_u1_u1_S2 10000 _CNV_R_R_Umr_1_zu_1_3_CM_S2 0 10000
 /begin AXIS_DESCR FIX_AXIS Z_GANG_ZIEL _CNV_S_9_Enum_EGANG_21_CM_S2 9 0 8 READ_ONLY FIX_AXIS_PAR_DIST 0 1 9 /end AXIS_DESCR
 /begin AXIS_DESCR FIX_AXIS Z_NMOTHSTUPEL_FFG _CNV_S_5_Enum_ETUPE_23_CM_S2 5 0 4 READ_ONLY FIX_AXIS_PAR_DIST 0 1 5 /end AXIS_DESCR
 FORMAT "%2.0" /end CHARACTERISTIC
/begin CHARACTERISTIC XTAB9X5SCHN_MOT_RSZIEL_2 "" MAP 0x1DF96C _REC_A1MAP_9_u2_u1_u1_S2 10000 _CNV_R_R_Umr_1_zu_1_3_CM_S2 0 10000
 /begin AXIS_DESCR FIX_AXIS Z_GANG_ZIEL _CNV_S_9_Enum_EGANG_21_CM_S2 9 0 8 READ_ONLY FIX_AXIS_PAR_DIST 0 1 9 /end AXIS_DESCR
 /begin AXIS_DESCR FIX_AXIS Z_NMOTHSTUPEL_FFG _CNV_S_5_Enum_ETUPE_23_CM_S2 5 0 4 READ_ONLY FIX_AXIS_PAR_DIST 0 1 5 /end AXIS_DESCR
 FORMAT "%2.0" /end CHARACTERISTIC
/begin CHARACTERISTIC XTAB9X5SCHN_MOT_RSZIEL_3 "" MAP 0x1DF9C6 _REC_A1MAP_9_u2_u1_u1_S2 10000 _CNV_R_R_Umr_1_zu_1_3_CM_S2 0 10000
 /begin AXIS_DESCR FIX_AXIS Z_GANG_ZIEL _CNV_S_9_Enum_EGANG_21_CM_S2 9 0 8 READ_ONLY FIX_AXIS_PAR_DIST 0 1 9 /end AXIS_DESCR
 /begin AXIS_DESCR FIX_AXIS Z_NMOTHSTUPEL_FFG _CNV_S_5_Enum_ETUPE_23_CM_S2 5 0 4 READ_ONLY FIX_AXIS_PAR_DIST 0 1 5 /end AXIS_DESCR
 FORMAT "%2.0" /end CHARACTERISTIC
/begin CHARACTERISTIC XTAB9X7_KORREKTUR_HSZEITNMOTHS "" MAP 0x1DF618 _REC_A1MAP_9_u2_u1_u1_S2 1300 _CNV_R_R_Umr_1_zu_1_30_CM_S2 0 1300
 /begin AXIS_DESCR FIX_AXIS Z_GANG_ZIEL _CNV_S_9_Enum_EGANG_21_CM_S2 9 0 8 READ_ONLY FIX_AXIS_PAR_DIST 0 1 9 /end AXIS_DESCR
 /begin AXIS_DESCR FIX_AXIS Z_SCHALTDYN _CNV_S_7_Enum_ESDYN_175_CM_S2 7 0 6 READ_ONLY FIX_AXIS_PAR_DIST 0 1 7 /end AXIS_DESCR
 FORMAT "%2.0" /end CHARACTERISTIC
/begin CHARACTERISTIC XTAB9X9FAKT_GRAD_SSG_DYNDZM_0 "" MAP 0x1D9166 _REC_A1MAP_9_u1_u1_u1_S2 200 _CNV_R_R_Umr_1_zu_1_30_CM_S2 0 200
 /begin AXIS_DESCR FIX_AXIS Z_GANG_ZIEL_DYNDZM _CNV_S_9_Enum_EGANG_21_CM_S2 9 0 8 READ_ONLY FIX_AXIS_PAR_DIST 0 1 9 /end AXIS_DESCR
 /begin AXIS_DESCR FIX_AXIS Z_GANG_IST _CNV_S_9_Enum_EGANG_21_CM_S2 9 0 8 READ_ONLY FIX_AXIS_PAR_DIST 0 1 9 /end AXIS_DESCR
 FORMAT "%2.0" /end CHARACTERISTIC
/begin CHARACTERISTIC XTAB9X9FAKT_GRAD_SSG_DYNDZM_1 "" MAP 0x1D91B7 _REC_A1MAP_9_u1_u1_u1_S2 200 _CNV_R_R_Umr_1_zu_1_30_CM_S2 0 200
 /begin AXIS_DESCR FIX_AXIS Z_GANG_ZIEL_DYNDZM _CNV_S_9_Enum_EGANG_21_CM_S2 9 0 8 READ_ONLY FIX_AXIS_PAR_DIST 0 1 9 /end AXIS_DESCR
 /begin AXIS_DESCR FIX_AXIS Z_GANG_IST _CNV_S_9_Enum_EGANG_21_CM_S2 9 0 8 READ_ONLY FIX_AXIS_PAR_DIST 0 1 9 /end AXIS_DESCR
 FORMAT "%2.0" /end CHARACTERISTIC
/begin CHARACTERISTIC XTAB9X9FAKT_GRAD_SSG_DYNDZM_2 "" MAP 0x1D9208 _REC_A1MAP_9_u1_u1_u1_S2 200 _CNV_R_R_Umr_1_zu_1_30_CM_S2 0 200
 /begin AXIS_DESCR FIX_AXIS Z_GANG_ZIEL_DYNDZM _CNV_S_9_Enum_EGANG_21_CM_S2 9 0 8 READ_ONLY FIX_AXIS_PAR_DIST 0 1 9 /end AXIS_DESCR
 /begin AXIS_DESCR FIX_AXIS Z_GANG_IST _CNV_S_9_Enum_EGANG_21_CM_S2 9 0 8 READ_ONLY FIX_AXIS_PAR_DIST 0 1 9 /end AXIS_DESCR
 FORMAT "%2.0" /end CHARACTERISTIC
/begin CHARACTERISTIC XTAB9X9FAKT_WARTE_SSG_DYNDZM_0 "" MAP 0x1D9259 _REC_A1MAP_9_u1_u1_u1_S2 200 _CNV_R_R_Umr_1_zu_1_30_CM_S2 0 200
 /begin AXIS_DESCR FIX_AXIS Z_GANG_ZIEL_DYNDZM _CNV_S_9_Enum_EGANG_21_CM_S2 9 0 8 READ_ONLY FIX_AXIS_PAR_DIST 0 1 9 /end AXIS_DESCR
 /begin AXIS_DESCR FIX_AXIS Z_GANG_IST _CNV_S_9_Enum_EGANG_21_CM_S2 9 0 8 READ_ONLY FIX_AXIS_PAR_DIST 0 1 9 /end AXIS_DESCR
 FORMAT "%2.0" /end CHARACTERISTIC
/begin CHARACTERISTIC XTAB9X9FAKT_WARTE_SSG_DYNDZM_1 "" MAP 0x1D92AA _REC_A1MAP_9_u1_u1_u1_S2 200 _CNV_R_R_Umr_1_zu_1_30_CM_S2 0 200
 /begin AXIS_DESCR FIX_AXIS Z_GANG_ZIEL_DYNDZM _CNV_S_9_Enum_EGANG_21_CM_S2 9 0 8 READ_ONLY FIX_AXIS_PAR_DIST 0 1 9 /end AXIS_DESCR
 /begin AXIS_DESCR FIX_AXIS Z_GANG_IST _CNV_S_9_Enum_EGANG_21_CM_S2 9 0 8 READ_ONLY FIX_AXIS_PAR_DIST 0 1 9 /end AXIS_DESCR
 FORMAT "%2.0" /end CHARACTERISTIC
/begin CHARACTERISTIC XTAB9X9FAKT_WARTE_SSG_DYNDZM_2 "" MAP 0x1D92FB _REC_A1MAP_9_u1_u1_u1_S2 200 _CNV_R_R_Umr_1_zu_1_30_CM_S2 0 200
 /begin AXIS_DESCR FIX_AXIS Z_GANG_ZIEL_DYNDZM _CNV_S_9_Enum_EGANG_21_CM_S2 9 0 8 READ_ONLY FIX_AXIS_PAR_DIST 0 1 9 /end AXIS_DESCR
 /begin AXIS_DESCR FIX_AXIS Z_GANG_IST _CNV_S_9_Enum_EGANG_21_CM_S2 9 0 8 READ_ONLY FIX_AXIS_PAR_DIST 0 1 9 /end AXIS_DESCR
 FORMAT "%2.0" /end CHARACTERISTIC
/begin CHARACTERISTIC XTAB9X9T_GRADIENT_DYNDZM_0 "" MAP 0x1D934C _REC_A1MAP_9_u1_u1_u1_S2 5100 _CNV_R_R_Umr_1_zu_2_132_CM_S2 0 5100
 /begin AXIS_DESCR FIX_AXIS Z_GANG_ZIEL_DYNDZM _CNV_S_9_Enum_EGANG_21_CM_S2 9 0 8 READ_ONLY FIX_AXIS_PAR_DIST 0 1 9 /end AXIS_DESCR
 /begin AXIS_DESCR FIX_AXIS Z_GANG_IST _CNV_S_9_Enum_EGANG_21_CM_S2 9 0 8 READ_ONLY FIX_AXIS_PAR_DIST 0 1 9 /end AXIS_DESCR
/end CHARACTERISTIC
/begin RECORD_LAYOUT _REC_A1CUR_30_s2_s2_S2 FNC_VALUES 1 SWORD COLUMN_DIR DIRECT /end RECORD_LAYOUT
/begin RECORD_LAYOUT _REC_A1CUR_30_s2_u1_S2 FNC_VALUES 1 SWORD COLUMN_DIR DIRECT /end RECORD_LAYOUT
/begin RECORD_LAYOUT _REC_A1CUR_30_s2_u2_S2 FNC_VALUES 1 SWORD COLUMN_DIR DIRECT /end RECORD_LAYOUT
/begin RECORD_LAYOUT _REC_A1CUR_30_s4_u1_S2 FNC_VALUES 1 SLONG COLUMN_DIR DIRECT /end RECORD_LAYOUT
/begin RECORD_LAYOUT _REC_A1CUR_30_u1_u1_S2 FNC_VALUES 1 UBYTE COLUMN_DIR DIRECT /end RECORD_LAYOUT
/begin RECORD_LAYOUT _REC_A1CUR_30_u1_u2_S2 FNC_VALUES 1 UBYTE COLUMN_DIR DIRECT /end RECORD_LAYOUT
/begin RECORD_LAYOUT _REC_A1CUR_30_u2_u1_S2 FNC_VALUES 1 UWORD COLUMN_DIR DIRECT /end RECORD_LAYOUT
/begin RECORD_LAYOUT _REC_A1CUR_30_u2_u2_S2 FNC_VALUES 1 UWORD COLUMN_DIR DIRECT /end RECORD_LAYOUT
/begin RECORD_LAYOUT _REC_A1CUR_30_u4_u2_S2 FNC_VALUES 1 ULONG COLUMN_DIR DIRECT /end RECORD_LAYOUT
/begin RECORD_LAYOUT _REC_A1MAP_8_s1_u1_u1_S2 FNC_VALUES 1 SBYTE ROW_DIR DIRECT /end RECORD_LAYOUT
/begin RECORD_LAYOUT _REC_A1MAP_8_s1_u2_u1_S2 FNC_VALUES 1 SBYTE ROW_DIR DIRECT /end RECORD_LAYOUT
/begin RECORD_LAYOUT _REC_A1MAP_8_s2_u1_u1_S2 FNC_VALUES 1 SWORD ROW_DIR DIRECT /end RECORD_LAYOUT
/begin RECORD_LAYOUT _REC_A1MAP_8_s2_u1_u2_S2 FNC_VALUES 1 SWORD ROW_DIR DIRECT /end RECORD_LAYOUT
/begin RECORD_LAYOUT _REC_A1MAP_8_s2_u2_u1_S2 FNC_VALUES 1 SWORD ROW_DIR DIRECT /end RECORD_LAYOUT
/begin RECORD_LAYOUT _REC_A1MAP_8_s2_u2_u2_S2 FNC_VALUES 1 SWORD ROW_DIR DIRECT /end RECORD_LAYOUT
/begin RECORD_LAYOUT _REC_A1MAP_8_s4_u1_u1_S2 FNC_VALUES 1 SLONG ROW_DIR DIRECT /end RECORD_LAYOUT
/begin RECORD_LAYOUT _REC_A1MAP_8_u1_u1_u1_S2 FNC_VALUES 1 UBYTE ROW_DIR DIRECT /end RECORD_LAYOUT
/begin RECORD_LAYOUT _REC_A1MAP_8_u1_u1_u2_S2 FNC_VALUES 1 UBYTE ROW_DIR DIRECT /end RECORD_LAYOUT
/begin RECORD_LAYOUT _REC_A1MAP_8_u1_u2_u2_S2 FNC_VALUES 1 UBYTE ROW_DIR DIRECT /end RECORD_LAYOUT
/begin RECORD_LAYOUT _REC_A1MAP_8_u2_u1_u1_S2 FNC_VALUES 1 UWORD ROW_DIR DIRECT /end RECORD_LAYOUT
/begin RECORD_LAYOUT _REC_A1MAP_8_u2_u2_u2_S2 FNC_VALUES 1 UWORD ROW_DIR DIRECT /end RECORD_LAYOUT
/begin RECORD_LAYOUT _REC_A1MAP_9_s2_u1_u1_S2 FNC_VALUES 1 SWORD COLUMN_DIR DIRECT /end RECORD_LAYOUT
/begin RECORD_LAYOUT _REC_A1MAP_9_s2_u2_u2_S2 FNC_VALUES 1 SWORD COLUMN_DIR DIRECT /end RECORD_LAYOUT
/begin RECORD_LAYOUT _REC_A1MAP_9_u1_u1_u1_S2 FNC_VALUES 1 UBYTE COLUMN_DIR DIRECT /end RECORD_LAYOUT
/begin RECORD_LAYOUT _REC_A1MAP_9_u1_u1_u2_S2 FNC_VALUES 1 UBYTE COLUMN_DIR DIRECT /end RECORD_LAYOUT
/begin RECORD_LAYOUT _REC_A1MAP_9_u2_u1_u1_S2 FNC_VALUES 1 UWORD COLUMN_DIR DIRECT /end RECORD_LAYOUT
/begin RECORD_LAYOUT _REC_A1MAP_9_u2_u1_u2_S2 FNC_VALUES 1 UWORD COLUMN_DIR DIRECT /end RECORD_LAYOUT
/begin RECORD_LAYOUT _REC_A1MAP_9_u2_u2_u2_S2 FNC_VALUES 1 UWORD COLUMN_DIR DIRECT /end RECORD_LAYOUT
/begin RECORD_LAYOUT _REC_A1MAP_9_u4_u1_u1_S2 FNC_VALUES 1 ULONG COLUMN_DIR DIRECT /end RECORD_LAYOUT
/begin RECORD_LAYOUT _REC_A2AXS_31_u2_S2 AXIS_PTS_X 2 UWORD INDEX_INCR DIRECT NO_AXIS_PTS_X 1 UWORD /end RECORD_LAYOUT
/begin RECORD_LAYOUT _REC_S3MAP_54_s2_s2_u1_S2 FNC_VALUES 3 SWORD ROW_DIR DIRECT AXIS_PTS_X 2 SWORD INDEX_INCR DIRECT NO_AXIS_PTS_X 1 UBYTE /end RECORD_LAYOUT
/begin RECORD_LAYOUT _REC_S3MAP_54_s2_s2_u2_S2 FNC_VALUES 3 SWORD ROW_DIR DIRECT AXIS_PTS_X 2 SWORD INDEX_INCR DIRECT NO_AXIS_PTS_X 1 UBYTE /end RECORD_LAYOUT
/begin RECORD_LAYOUT _REC_S3MAP_54_s2_u2_u1_S2 FNC_VALUES 3 SWORD ROW_DIR DIRECT AXIS_PTS_X 2 UWORD INDEX_INCR DIRECT NO_AXIS_PTS_X 1 UBYTE /end RECORD_LAYOUT
/begin RECORD_LAYOUT _REC_S3MAP_54_s2_u2_u2_S2 FNC_VALUES 3 SWORD ROW_DIR DIRECT AXIS_PTS_X 2 UWORD INDEX_INCR DIRECT NO_AXIS_PTS_X 1 UBYTE /end RECORD_LAYOUT
/begin RECORD_LAYOUT _REC_S3MAP_54_u1_u2_u1_S2 FNC_VALUES 3 UBYTE ROW_DIR DIRECT AXIS_PTS_X 2 UWORD INDEX_INCR DIRECT NO_AXIS_PTS_X 1 UBYTE /end RECORD_LAYOUT
/begin RECORD_LAYOUT _REC_S3MAP_54_u2_s2_u1_S2 FNC_VALUES 3 UWORD ROW_DIR DIRECT AXIS_PTS_X 2 SWORD INDEX_INCR DIRECT NO_AXIS_PTS_X 1 UBYTE /end RECORD_LAYOUT
/begin RECORD_LAYOUT _REC_S3MAP_54_u2_u2_u1_S2 FNC_VALUES 3 UWORD ROW_DIR DIRECT AXIS_PTS_X 2 UWORD INDEX_INCR DIRECT NO_AXIS_PTS_X 1 UBYTE /end RECORD_LAYOUT
/begin RECORD_LAYOUT _REC_S3MAP_54_u2_u2_u2_S2 FNC_VALUES 3 UWORD ROW_DIR DIRECT AXIS_PTS_X 2 UWORD INDEX_INCR DIRECT NO_AXIS_PTS_X 1 UBYTE /end RECORD_LAYOUT
/begin RECORD_LAYOUT _REC_S7CUR_53_s2_s2_S2 FNC_VALUES 3 SWORD COLUMN_DIR DIRECT AXIS_PTS_X 2 SWORD INDEX_INCR DIRECT NO_AXIS_PTS_X 1 UBYTE /end RECORD_LAYOUT
/begin RECORD_LAYOUT _REC_S7CUR_53_s2_u2_S2 FNC_VALUES 3 SWORD COLUMN_DIR DIRECT AXIS_PTS_X 2 UWORD INDEX_INCR DIRECT NO_AXIS_PTS_X 1 UBYTE /end RECORD_LAYOUT
/begin RECORD_LAYOUT _REC_S7CUR_53_u2_s2_S2 FNC_VALUES 3 UWORD COLUMN_DIR DIRECT AXIS_PTS_X 2 SWORD INDEX_INCR DIRECT NO_AXIS_PTS_X 1 UBYTE /end RECORD_LAYOUT
/begin RECORD_LAYOUT _REC_S7CUR_53_u2_u2_S2 FNC_VALUES 3 UWORD COLUMN_DIR DIRECT AXIS_PTS_X 2 UWORD INDEX_INCR DIRECT NO_AXIS_PTS_X 1 UBYTE /end RECORD_LAYOUT
/begin RECORD_LAYOUT _REC_S7MAP_53_s2_s2_s2_S2 FNC_VALUES 5 SWORD COLUMN_DIR DIRECT AXIS_PTS_X 3 SWORD INDEX_INCR DIRECT AXIS_PTS_Y 4 SWORD INDEX_INCR DIRECT NO_AXIS_PTS_X 1 UBYTE NO_AXIS_PTS_Y 2 UBYTE /end RECORD_LAYOUT
/begin RECORD_LAYOUT _REC_S7MAP_53_s2_s2_u2_S2 FNC_VALUES 5 SWORD COLUMN_DIR DIRECT AXIS_PTS_X 3 SWORD INDEX_INCR DIRECT AXIS_PTS_Y 4 UWORD INDEX_INCR DIRECT NO_AXIS_PTS_X 1 UBYTE NO_AXIS_PTS_Y 2 UBYTE /end RECORD_LAYOUT
/begin RECORD_LAYOUT _REC_S7MAP_53_u1_s2_u2_S2 FNC_VALUES 5 UBYTE COLUMN_DIR DIRECT AXIS_PTS_X 3 SWORD INDEX_INCR DIRECT AXIS_PTS_Y 4 UWORD INDEX_INCR DIRECT NO_AXIS_PTS_X 1 UBYTE NO_AXIS_PTS_Y 2 UBYTE /end RECORD_LAYOUT
/begin RECORD_LAYOUT _REC_S7MAP_53_u2_s2_s2_S2 FNC_VALUES 5 UWORD COLUMN_DIR DIRECT AXIS_PTS_X 3 SWORD INDEX_INCR DIRECT AXIS_PTS_Y 4 SWORD INDEX_INCR DIRECT NO_AXIS_PTS_X 1 UBYTE NO_AXIS_PTS_Y 2 UBYTE /end RECORD_LAYOUT
/begin RECORD_LAYOUT _REC_S7MAP_53_u2_s2_u2_S2 FNC_VALUES 5 UWORD COLUMN_DIR DIRECT AXIS_PTS_X 3 SWORD INDEX_INCR DIRECT AXIS_PTS_Y 4 UWORD INDEX_INCR DIRECT NO_AXIS_PTS_X 1 UBYTE NO_AXIS_PTS_Y 2 UBYTE /end RECORD_LAYOUT
/begin RECORD_LAYOUT _REC_S7MAP_53_u2_u2_s2_S2 FNC_VALUES 5 UWORD COLUMN_DIR DIRECT AXIS_PTS_X 3 UWORD INDEX_INCR DIRECT AXIS_PTS_Y 4 SWORD INDEX_INCR DIRECT NO_AXIS_PTS_X 1 UBYTE NO_AXIS_PTS_Y 2 UBYTE /end RECORD_LAYOUT
/begin RECORD_LAYOUT _REC_S7MAP_53_u2_u2_u2_S2 FNC_VALUES 5 UWORD COLUMN_DIR DIRECT AXIS_PTS_X 3 UWORD INDEX_INCR DIRECT AXIS_PTS_Y 4 UWORD INDEX_INCR DIRECT NO_AXIS_PTS_X 1 UBYTE NO_AXIS_PTS_Y 2 UBYTE /end RECORD_LAYOUT
/end MODULE
/end PROJECT
